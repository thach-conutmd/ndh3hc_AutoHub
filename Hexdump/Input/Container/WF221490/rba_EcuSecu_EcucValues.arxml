AUTOSAR XML (schema 4-0-2)
package /RB/UBK/Project/EcucModuleConfigurationValuess
  module config rba_EcuSecu
    rba_EcuSecu_OID_Common (rba_EcuSecu_OID):
      rba_EcuSecu_OID_Dotted = 1.3.6.1.4.1.5318.2504.21.2.1.1.4.0
      rba_EcuSecu_OID_IdNum = 0
      rba_EcuSecu_OID_Name = OID_Common
      rba_EcuSecu_OID_PreDefObj = rba_CryObj_OID_1_e
    rba_EcuSecu_OID_HONDA (rba_EcuSecu_OID):
      rba_EcuSecu_OID_Dotted = 1.3.6.1.4.1.5318.2504.21.2.1.1.7.159.368
      rba_EcuSecu_OID_IdNum = 1
      rba_EcuSecu_OID_Name = OID_HONDA
      rba_EcuSecu_OID_PreDefObj = rba_CryObj_OID_2_e
    rba_EcuSecu_General: rba_EcuSecu_Reset_OnOff=false, rba_EcuSecu_She_OnOff=true, rba_EcuSecu_SwitchOver=true, rba_EcuSecu_TestSerial=false, rba_EcuSecu_WaitTime=30
    rba_EcuSecu_Certificate_Common (rba_EcuSecu_Certificate):
      rba_EcuSecu_Certificate_Class = rba_CryObj_Certificate_Root_e
      rba_EcuSecu_Certificate_Cont = 7F2182028E7F4E8201845F290100421052424131444753313A434E3030303032 7F49820118060D2B06010401A94693481501000181820100A3914EC606A27C45 A091CF1804F369FD629DD5BCCBA3BBFAEF75CFA4509FCC7447D8E63320080D85 48CED14CD36CFBB7E757B1799A626511BA77360C8E458C3CA68610597D64150D FCDB1FDCB9BCB4C9982E5EB8BE3E0104390B97AA05563551200BAFB966851290 ECF2F589B37E1F713162BC642D421D3A6EF1D666DE304427D839D076264F428C 9B3BA6ADF913A8BEBA7F7E9B9AC4EC95362F56FEB149C895D7A4D9CCC4BF7E46 E7F907371923FC10A24E0675ED005ED61172BD7FF73872198825CA7A163F4E41 26E1241F2FB328E75DC7D3D508BDDED5D547FBF332102C885E671BB7DBE81036 79D58C354A7A01F30F852F61A68D755FBBE8CD4987FA7E3582030100015F2018 52424131444753312F434F4D4D4F4E313A434E30303030327F4C21060D2B0601 0401A94693481502010053100400FFFFFFFFFFFFFFFFFFFFFFFFFFFF5F250601 04000502085F24060209010203005F378201003CA3C8DD8CDF1ECADA14ED37B8 9CF16B573488539BE3891D8F83A3F67D5AA0D93F9560A81D58A07A897085D381 3FAE0520C38D461F14B4934002418BA5441266F55D69CFD1AC3101D1CD7B1DD7 CB7261B89BC432D01D0F5198E0D4C915FC5642B29998265D243DC4D812299716 48CDC9412E7ED1444A14151519E07853F4F6A3EB225324EBCD6048B626C5966C 2CA1C148459F118A2D51FB812A4EEB06875492162ADC9382A610FE7FD8B3196D 9A7A03CE1C0C8C81594BAF0C282469E5376B45418C1F7939AA36161585EE9042 0FF14274086F913F19D78F11D5E4D611EBFCE32FBE548EA8255127F82B5ACAFE 82C2E55133D75BCB725A5E9618C851F50DC767
      rba_EcuSecu_Certificate_IdNum = 0
      rba_EcuSecu_Certificate_Name = RootCert_Common
      rba_EcuSecu_Certificate_PreDefObj = rba_CryObj_Certificate_1_e
      rba_EcuSecu_Certificate_Subject = 
    rba_EcuSecu_Certificate_HONDA (rba_EcuSecu_Certificate):
      rba_EcuSecu_Certificate_Class = rba_CryObj_Certificate_Root_e
      rba_EcuSecu_Certificate_Cont = 7F2182028D7F4E8201835F290100421052424131444753313A434E30303030327F49820118060D2B06010401A94693481501000181820100E33F075B9B2CAAB0D0DC5AADFC4019530F064DFDA7B3D775967E811AA2C206E404E0F41C9D68546DBB9E036A43E95A191E2D6067FDC0183B6EFAB88768B5BDCBFC295D1DE9CDB46C574D70DF5FD415F82F0E1D5C10969F4BBA9CEE866EFD53D2AE8228F37E82531675082FED5FCAB50E9E8154A0BBE86E566E8F2592A01AF8CE98256C4846E1BCF5F78413CD49368C067E25C7D7FBB9039D61BB4BE2B9A01CA470B0BD6064D36CBC478A9A86AA4FB0CFFFBAD9EA16F730361C36833DD3AB355A0CEE5B4DF23339544F906DBD110FB5C182E53B45435FB918EBF3EAB1A83DE77880340A37486011119B273214EB0C2B78042F6D7A3A912D11C6D925B8F9608F3982030100015F201752424131444753312F484F4E4441313A434E30303030317F4C21060D2B06010401A94693481502010053100400FFFFFFFFFFFFFFFFFFFFFFFFFFFF5F25060203000101005F24060308010102095F37820100576297B3811843165C00D960C25663287FE436BAC149F4F29ACE75730C55946CEBBBC58BE89BD77C3BFE827DC2FD07A1443A4E00302D75E65F7AF74BDC505213A1C48FDFF0805283CEEE9F04BC93B5A45108C946FE7C939E3C32357E9C4E23C08620FB3087B9CFD515CBA9A1BA3C308AE5F4A09286C797DA0EC9ED43404EAE510B9E3DE475A90BF6DF93A5D216A9255CD25AF5C705A0EE47E7281C718166A639E2D607266841108A21BCFAD08B6929352201F4BC03E8E1C4831D9CD7FF7FF1376497D76F7941A8D8F212B087ADBDD30006789C02173D2AC3E3913FBE4328AAE269D1F91228D756267A81D0BCCE3920AA79448D354319E8FBF7271611C9B91CD0
      rba_EcuSecu_Certificate_IdNum = 1
      rba_EcuSecu_Certificate_Name = UserCert_HONDA
      rba_EcuSecu_Certificate_PreDefObj = rba_CryObj_Certificate_2_e
      rba_EcuSecu_Certificate_Subject = RBA1DGS1/HONDA1:CN00001
    rba_EcuSecu_RSA_Keys_0 (rba_EcuSecu_RSA_Keys):
      rba_EcuSecu_RSA_IdNum = 0
      rba_EcuSecu_RSA_KeyExponent = 010001
      rba_EcuSecu_RSA_KeyString = B37D5C76E56B8F46EB04241EEF6875AF6A9F47B93AB5B368E9A022545A961C23A8C51FBA050C5B9D3A58807FFBDD544838A3EC174B181D8BF5A10A98AF592993D737BD7733A06E1AFB2443D042B245501FE9ED1AC5B3427A5D03383F4589DBE33BDB874859DCF7CB0ED4F891B4699ECA89C11D0E8F6402C4F46429C19EEF9C1EE08E3E1EC5FD031E8929684B63D645886153E5C2B006B411AB21899E4A78E4C2C52E034F2269DCC4A69AF44D1DDA27059873EC72C4357D125758BBCCFB105E92032FC55398AE794BA23E47ED12880E526C2E2D3487843912DB8B34A07AA54954DFE0B785B9080033012A474F36E311762970152B1528D9DADA5B9EBCAFB975E1
      rba_EcuSecu_RSA_Name = RSA Key 1
      rba_EcuSecu_RSA_PreDefObj = rba_CryObj_RSAKey_256_1_e
      variation-point = sw-syscond=0
    rba_EcuSecu_Rttd:
      rba_EcuSecu_rttd_Blocksize = 2048
      rba_EcuSecu_rttd_Debounce = 3
      rba_EcuSecu_rttd_Delay = 1
      rba_EcuSecu_rttd_DynamicScan_OnOff = false
      rba_EcuSecu_rttd_OnOff = true
    rba_EcuSecu_Usage
      rba_EcuSecu_CBProgAuth: rba_EcuSecu_CryptoObj=rba_EcuSecu_SymmetricKey_CBProgAuth
      rba_EcuSecu_RBProgAuth: rba_EcuSecu_CryptoObj=rba_EcuSecu_PublicKey_RBProgAuth
      rba_EcuSecu_TSWProgAuth: rba_EcuSecu_CryptoObj=rba_EcuSecu_PublicKey_TSWProgAuth
      rba_EcuSecu_Z_SecuAcc_CertMode_Common: rba_EcuSecu_CallerId=2, rba_EcuSecu_CryptoObj=rba_EcuSecu_OID_Common, rba_EcuSecu_CryptoObj=rba_EcuSecu_Certificate_Common
      rba_EcuSecu_Z_SecuAcc_LegAsymMode_Common: rba_EcuSecu_CallerId=2, rba_EcuSecu_CryptoObj=rba_EcuSecu_PublicKey_TSWProgAuth
    rba_EcuSecu_LegacyKeys
      rba_EcuSecu_PublicKey_RBProgAuth (rba_EcuSecu_PublicKey):
        rba_EcuSecu_Exponent = 65537
        rba_EcuSecu_Modulus = B9FEB6196530E94CA5C47530FE519E99B8FE489CD7CD5BBECFF8D2940AD2B5B876940C15B192F07B96D3EFB56793467BFD142F858E36DB05619846F5C424C8868CB0B0C18F0EE9F0B6CC0B110C6ED25E5384EAC2010A4C1C38425FABD295777AF6BA89BBEE7FDDC5B9EC020FF784EE0EB0E6E6921B234BD7335CC986333A5E07
        rba_EcuSecu_PubKey_IdNum = 0
        rba_EcuSecu_PubKey_Name = Bosch.GS_0159_0368.Auth_Prog.MDG1.V001
        rba_EcuSecu_PubKey_PreDefObj = rba_CryObj_MEDC17_PublicKey_1_e
      rba_EcuSecu_PublicKey_TSWProgAuth (rba_EcuSecu_PublicKey):
        rba_EcuSecu_Exponent = 65537
        rba_EcuSecu_Modulus = C020F08005D01E5D80CB569167332D6F7B72BF4FD102D971C3E77D90CBD7F815C43628448581B7FA3CD79E3C1E6A5DF80D9B0A8B53943E1D8D64245B8B5E5D578D42B662E814B6228AC35E82C23108E735DE73EAF0541324C95570E5FA10B78464EA9F37282D6F9879DDDFB194C245396C8FCBA51888EF4117A09E0013E3528D
        rba_EcuSecu_PubKey_IdNum = 2
        rba_EcuSecu_PubKey_Name = Bosch.common.Auth_TSW.MDG1.V003
        rba_EcuSecu_PubKey_PreDefObj = rba_CryObj_MEDC17_PublicKey_2_e
      rba_EcuSecu_SymmetricKey_CBProgAuth (rba_EcuSecu_SymmetricKey):
        rba_EcuSecu_Exponent = 0
        rba_EcuSecu_Modulus = E1AF5A30BF9A93CC8121425C318A59BA
        rba_EcuSecu_SymmKey_IdNum = 1
        rba_EcuSecu_SymmKey_Name = Bosch.p_0.Auth_Prog.MEDC17.V001
        rba_EcuSecu_SymmKey_PreDefObj = rba_CryObj_MEDC17_SymmKey_1_e
