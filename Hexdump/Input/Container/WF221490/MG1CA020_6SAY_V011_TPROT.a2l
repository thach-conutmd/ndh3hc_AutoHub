ASAP2_VERSION 1 60
/begin PROJECT MG1CA020 "MG1CA020"
/begin HEADER "" VERSION "MG1CA020_6SAY_V011_TPROT" PROJECT_NO MG1CA020 /end HEADER
/begin MODULE DIM ""
/begin MOD_COMMON "" BYTE_ORDER MSB_LAST ALIGNMENT_BYTE 1 ALIGNMENT_WORD 2 ALIGNMENT_LONG 4 ALIGNMENT_INT64 4 ALIGNMENT_FLOAT32_IEEE 4 ALIGNMENT_FLOAT64_IEEE 4 DATA_SIZE 32 /end MOD_COMMON
/begin CHARACTERISTIC ComEBS_BattID_C "Battery ID" VALUE 0x8051E744 RB_Val_Wu8 255.0 dez 0.00 255.0 FORMAT "%5.1" /end CHARACTERISTIC
/begin CHARACTERISTIC ComEBS_flgBitEna_C "Default value of signal Enable_bit" VALUE 0x8051E745 RB_Val_Wu8 255.0 OneToOne 0.00 255.0 FORMAT "%5.1" /end CHARACTERISTIC
/begin CHARACTERISTIC ComEBS_LinTypTx_C "Default value of signal LIN_Type_Tx" VALUE 0x8051E746 RB_Val_Wu8 255.0 OneToOne 0.00 255.0 FORMAT "%5.1" /end CHARACTERISTIC
/begin CHARACTERISTIC ComEBS_stReLrngReq_C "Default value of signal Re_Study_REQ" VALUE 0x8051E747 RB_Val_Wu8 255.0 OneToOne 0.00 255.0 FORMAT "%5.1" /end CHARACTERISTIC
/begin CHARACTERISTIC Com_ctCRingENGL_C "CAN RingCounter for ENGL Frame" VALUE 0x8051E6BC RB_Val_Wu8 255.0 OneToOne 0.00 255.0 FORMAT "%5.1" /end CHARACTERISTIC
/begin CHARACTERISTIC Com_ctCRingENGQ_C "Intial value for Alive counter of ENGQ frame" VALUE 0x8051E6C2 RB_Val_Wu8 3.000 OneToOne 0.00 3.000 FORMAT "%5.3" EXTENDED_LIMITS 0.00 255.0 /end CHARACTERISTIC
/begin CHARACTERISTIC Com_dENGBSigSel_C "Signal selection data for ENGB frame" VALUE 0x8051E660 RB_Val_Wu8 255.0 OneToOne 0.00 255.0 FORMAT "%5.1" /end CHARACTERISTIC
/begin CHARACTERISTIC Com_dENGK3SigSel_C "Signal selection data for ENGK3 frame" VALUE 0x8051E698 RB_Val_Wu8 255.0 OneToOne 0.00 255.0 FORMAT "%5.1" /end CHARACTERISTIC
/begin CHARACTERISTIC Com_dENGOSigSel_C "Signal selection data for ENGO frame" VALUE 0x8051E6C0 RB_Val_Wu8 255.0 OneToOne 0.00 255.0 FORMAT "%5.1" /end CHARACTERISTIC
/begin CHARACTERISTIC Com_dENGQSigSel_C "Signal selection data for ENGQ frame" VALUE 0x8051E6C3 RB_Val_Wu8 255.0 OneToOne 0.00 255.0 FORMAT "%5.1" /end CHARACTERISTIC
/begin CHARACTERISTIC Com_dENGRSigSel_C "Signal selection data for ENGR frame" VALUE 0x8051E6E6 RB_Val_Wu8 255.0 OneToOne 0.00 255.0 FORMAT "%5.1" /end CHARACTERISTIC
/begin CHARACTERISTIC Com_dENGT2SigSel_C "Signal selection data for ENGT2 frame" VALUE 0x8051E6E8 RB_Val_Wu8 255.0 OneToOne 0.00 255.0 FORMAT "%5.1" /end CHARACTERISTIC
/begin CHARACTERISTIC Com_dENGV2SigSel_C "Signal selection data for ENGV2 frame" VALUE 0x8051E6F0 RB_Val_Wu8 255.0 OneToOne 0.00 255.0 FORMAT "%5.1" /end CHARACTERISTIC
/begin CHARACTERISTIC Com_dENGZSigSel_C "Signal selection data for ENGZ frame" VALUE 0x8051E742 RB_Val_Wu8 255.0 OneToOne 0.00 255.0 FORMAT "%5.1" /end CHARACTERISTIC
/begin CHARACTERISTIC Com_dPhysAdr_C "Physical address sent to Meter unit from Engine ECU" VALUE 0x8051E6BE Val_Wu8 255.0 OneToOne 0.00 255.0 FORMAT "%5.1" /end CHARACTERISTIC
/begin CHARACTERISTIC Com_ErrDeb_Tmr1ACh_C "Timer Calibration value for which error in 1AC Frame should be present to set ENG_RECEIVE_ERROR information to 1" VALUE 0x8051E6EC RB_Val_Ws32 42949672950.0 Time_ms -21474836480.0 21474836470.0 FORMAT "%13.1" /end CHARACTERISTIC
/begin CHARACTERISTIC Com_facACGDeMagCnclConv_CUR "conversion curve for alternator excitation cancel speed" CURVE 0x8051E748 RB_Curve_S16_S16 15.00000 Fact1 0.00 15.00000 FORMAT "%8.5" EXTENDED_LIMITS -256.0000 255.9922
 /begin AXIS_DESCR STD_AXIS Alt_nCutOff EngN 15 20.00 10000.00 FORMAT "%8.2" EXTENDED_LIMITS -16384.00 16383.50 DEPOSIT ABSOLUTE /end AXIS_DESCR
/end CHARACTERISTIC
/begin CHARACTERISTIC Com_facFlConsAdd_C "Calibration parameter" VALUE 0x8051E664 RB_Val_Ws32 4294967295.00 OneToOne -2147483648.00 2147483647.00 FORMAT "%13.2" /end CHARACTERISTIC
/begin CHARACTERISTIC Com_iACGMagCrntLimOfs_C "Offset of Alternator excitation current limitation" VALUE 0x8051E786 RB_Val_Ws16 65535.00 Curr -32768.00 32767.00 FORMAT "%8.2" /end CHARACTERISTIC
/begin CHARACTERISTIC Com_iACGMagCrntLimSlp_C "Slpoe of Alternator excitation current limitation" VALUE 0x8051E788 RB_Val_Ws32 250.000000000 Fact 0.00 250.000000000 FORMAT "%13.9" EXTENDED_LIMITS -262144.000000 262143.999878 /end CHARACTERISTIC
/begin CHARACTERISTIC Com_nEngSpdRampNeg_C "Negative slope of Ramp switch in smoothing of Tachometer" VALUE 0x8051E69C RB_Val_Ws32 32767999.9924 RmpEngN -16384000.0000 16383999.9924 FORMAT "%13.4" /end CHARACTERISTIC
/begin CHARACTERISTIC Com_nEngSpdRampPos_C "Positive slope of Ramp switch in smoothing of Tachometer" VALUE 0x8051E6A0 RB_Val_Ws32 32767999.9924 RmpEngN -16384000.0000 16383999.9924 FORMAT "%13.4" /end CHARACTERISTIC
/begin CHARACTERISTIC Com_nrACGDbgInfoTx_C "ACG Debug information for transmission" VALUE 0x8051E78C RB_Val_Wu8 7.000 OneToOne 0.00 7.000 FORMAT "%5.3" EXTENDED_LIMITS 0.00 255.0 /end CHARACTERISTIC
/begin CHARACTERISTIC Com_nstatThdXHysHi_C "High Hysteresis Threshold X value of Engine Speed" VALUE 0x8051E6A4 RB_Val_Ws8 2550. nmot_ub_q10 -1280. 1270. FORMAT "%5.0" /end CHARACTERISTIC
/begin CHARACTERISTIC Com_nstatThdXHysLo_C "Low Hysteresis Threshold X value of Engine Speed" VALUE 0x8051E6A5 RB_Val_Ws8 2550. nmot_ub_q10 -1280. 1270. FORMAT "%5.0" /end CHARACTERISTIC
/begin CHARACTERISTIC Com_nstatThdYHysHi_C "High Hysteresis Threshold Y value of Engine Speed" VALUE 0x8051E6A6 RB_Val_Ws8 1280. nmot_ub_q10 -1280. 0.00 FORMAT "%5.0" EXTENDED_LIMITS -1280. 1270. /end CHARACTERISTIC
/begin CHARACTERISTIC Com_nstatThdYHysLo_C "Low Hysteresis Threshold Y value of Engine Speed" VALUE 0x8051E6A7 RB_Val_Ws8 1280. nmot_ub_q10 -1280. 0.00 FORMAT "%5.0" EXTENDED_LIMITS -1280. 1270. /end CHARACTERISTIC
/begin CHARACTERISTIC Com_numCsumENGL_C "CAN CheckSum for ENGL Frame" VALUE 0x8051E6BD RB_Val_Wu8 255.0 OneToOne 0.00 255.0 FORMAT "%5.1" /end CHARACTERISTIC
/begin CHARACTERISTIC Com_numCsumENGQ_C "Intial value for Checksum of ENGQ frame" VALUE 0x8051E6C4 RB_Val_Wu8 15.00 OneToOne 0.00 15.00 FORMAT "%5.2" EXTENDED_LIMITS 0.00 255.0 /end CHARACTERISTIC
/begin CHARACTERISTIC Com_numTCUMilReqDFC_CA "Calibration Array of DFCs that triggers MIL on Request" VAL_BLK 0x804EE5C6 RB_ValA_Wu16 703.000000000 DFC_Verb 0.00 703.000000000 FORMAT "%13.9" NUMBER 12 /end CHARACTERISTIC
/begin CHARACTERISTIC Com_rAppHysHi_C "High hysteresis value of Accelerator pedal" VALUE 0x8051E6A8 RB_Val_Ws16 799.9878 Prc -400.0000 399.9878 FORMAT "%8.4" /end CHARACTERISTIC
/begin CHARACTERISTIC Com_rAppHysLo_C "Low hysteresis value of Accelerator pedal" VALUE 0x8051E6AA RB_Val_Ws16 799.9878 Prc -400.0000 399.9878 FORMAT "%8.4" /end CHARACTERISTIC
/begin CHARACTERISTIC Com_stBlkSensWaEna_C "Calibration for Block Sensor warning" VALUE 0x8051E668 RB_Val_Wu8 1.000 OneToOne 0.00 1.000 FORMAT "%5.3" EXTENDED_LIMITS 0.00 255.0 /end CHARACTERISTIC
/begin CHARACTERISTIC Com_stConvalch_CUR "Curve to convert Ethanol concentration to factor" CURVE 0x8051E6C5 RB_Curve_U8_U8 255.0 OneToOne 0.00 255.0 FORMAT "%5.1" READ_ONLY
 /begin AXIS_DESCR STD_AXIS alchpct_msg rel_ub_b100 16 0.00 99.61 FORMAT "%5.2" DEPOSIT ABSOLUTE /end AXIS_DESCR
/end CHARACTERISTIC
/begin CHARACTERISTIC Com_stDrvModDisp_C "Driver Mode Display Calibration" VALUE 0x8051E6AC RB_Val_Wu8 255.0 OneToOne 0.00 255.0 FORMAT "%5.1" /end CHARACTERISTIC
/begin CHARACTERISTIC Com_stEngRemSt_C "calibration for remote engine starter status" VALUE 0x8051E6C1 RB_Val_Wu8 1.000 OneToOne 0.00 1.000 FORMAT "%5.3" EXTENDED_LIMITS 0.00 255.0 /end CHARACTERISTIC
/begin CHARACTERISTIC Com_stHIP1Visibility_CA "restriction mask array for DTCs reported on ENGHIP1 Frame" VAL_BLK 0x8051E672 RB_ValA_Wu8 255.0 OneToOne 0.00 255.0 FORMAT "%5.1" NUMBER 32 /end CHARACTERISTIC
/begin CHARACTERISTIC Com_swtENGYFrmTypSel_C "Frame type selection switch for ENGY and ENGY2" VALUE 0x8053AD54 Val_Wu8 1.000 OneToOne 0.00 1.000 FORMAT "%5.3" EXTENDED_LIMITS 0.00 255.0 /end CHARACTERISTIC
/begin CHARACTERISTIC Com_swtImsLmpDisbl_C "Immobilizer key lamp Enable/Disable switch" VALUE 0x8051E669 RB_Val_Wu8 1.000 OneToOne 0.00 1.000 FORMAT "%5.3" EXTENDED_LIMITS 0.00 255.0 /end CHARACTERISTIC
/begin CHARACTERISTIC Com_swtSmotngCtrl_C "Smoothing Control switch" VALUE 0x8051E6AD RB_Val_Wu8 255.0 OneToOne 0.00 255.0 FORMAT "%5.1" /end CHARACTERISTIC
/begin CHARACTERISTIC Com_tiACGDeMagOfs_C "Offset of Alternator excitation time" VALUE 0x8051E78E RB_Val_Ws16 400.0000 Period 0.00 400.0000 FORMAT "%8.4" EXTENDED_LIMITS -3276.800 3276.700 /end CHARACTERISTIC
/begin CHARACTERISTIC Com_tiACGDeMagSlp_C "Slope of Alternator excitation time" VALUE 0x8051E790 RB_Val_Ws16 65535.00 OneToOne -32768.00 32767.00 FORMAT "%8.2" /end CHARACTERISTIC
/begin CHARACTERISTIC Com_tiEngSpdPT1_C "PT1 filter timer for Engine Speed" VALUE 0x8051E6B0 RB_Val_Ws32 4294.9672940000000 TimeDelay_s 0.0000020000000 4294.9672959999998 FORMAT "%19.14" EXTENDED_LIMITS 0.000002000000001 4294.9672959999998 /end CHARACTERISTIC
/begin CHARACTERISTIC Com_tiFlFWLvlLmp_C "Delay time for Com_stFlFWLvl to get updated by FlFWLvl_stLmp" VALUE 0x8051E692 RB_Val_Ws16 65540.00 Time_ms -32770.00 32770.00 FORMAT "%8.2" EXTENDED_LIMITS -327680.0 327670.0 /end CHARACTERISTIC
/begin CHARACTERISTIC Com_tiOilLmpOff_C "Delay time for oil pressure warning lamp" VALUE 0x8051E66A RB_Val_Ws16 655350.0 Time_ms -327680.0 327670.0 FORMAT "%8.1" /end CHARACTERISTIC
/begin CHARACTERISTIC Com_tiOilLowOn_C "Delay time for oil low warning lamp" VALUE 0x8051E694 RB_Val_Ws16 65540.00 Time_ms -32770.00 32770.00 FORMAT "%8.2" EXTENDED_LIMITS -327680.0 327670.0 /end CHARACTERISTIC
/begin CHARACTERISTIC Com_tiSmotngFlag_C "Time calibration for Smoothing function condition flag" VALUE 0x8051E6B4 RB_Val_Wu8 2550. Time_ms 0.00 2550. FORMAT "%5.0" /end CHARACTERISTIC
/begin CHARACTERISTIC Com_tTFixSensFail_C "Fix temperature value in case of sensor fail" VALUE 0x8051E66C RB_Val_Ws16 6553.500 Temp_Cels -3549.940 3003.560 FORMAT "%8.3" /end CHARACTERISTIC
/begin CHARACTERISTIC Com_uACGAdjVltgDemOfs_C "Offset of Alternator adjusting voltage demand" VALUE 0x8051E792 RB_Val_Ws16 65535.00 Volt1 -32768.00 32767.00 FORMAT "%8.2" /end CHARACTERISTIC
/begin CHARACTERISTIC Com_uACGAdjVltgDemSlp_C "Slope of Alternator adjusting voltage demand" VALUE 0x8051E794 RB_Val_Ws16 65535.00 OneToOne -32768.00 32767.00 FORMAT "%8.2" /end CHARACTERISTIC
/begin CHARACTERISTIC Com_VehVFltMin_C "Minimum vehicle speed at transimission" VALUE 0x8051E670 RB_Val_Ws16 20.00000 Vel 0.00 20.00000 FORMAT "%8.5" EXTENDED_LIMITS -327.6800 327.6700 /end CHARACTERISTIC
/begin CHARACTERISTIC Com_vVehSpdHysHi_C "High hysteresis value of Vehicle Speed" VALUE 0x8051E6B6 RB_Val_Ws16 655.3500 Vel -327.6800 327.6700 FORMAT "%8.4" /end CHARACTERISTIC
/begin CHARACTERISTIC Com_vVehSpdHysLo_C "low hysteresis value of Vehicle Speed" VALUE 0x8051E6B8 RB_Val_Ws16 655.3500 Vel -327.6800 327.6700 FORMAT "%8.4" /end CHARACTERISTIC
/begin CHARACTERISTIC Com_xAsgnFrzSig_CA "Calibration for Freeze signals" VAL_BLK 0x8051E6F2 RB_ValA_Wu16 782.000000000 Signals_IntSigNumVerb 0.00 782.000000000 FORMAT "%13.9" NUMBER 40 /end CHARACTERISTIC
/begin CHARACTERISTIC CWAEVABU "code word for function AEVABU" VALUE 0x8051E798 RB_Val_Wu8 255.0 dez 0.00 255.0 FORMAT "%5.1" /end CHARACTERISTIC
/begin CHARACTERISTIC DNMAXH "Exceeding of the engine speed limit leading to fuel cut-off in all cylinders" VALUE 0x8051E79A RB_Val_Wu16 16383.75 nmot_sw_q0p25 0.00 16383.75 FORMAT "%8.2" /end CHARACTERISTIC
/begin CHARACTERISTIC EngICO_nMaxAppDfct_C "Max engine Speed in case of defect App signal" VALUE 0x8051E79C RB_Val_Wu8 8160. nmot_q32 0.00 8160. FORMAT "%5.0" /end CHARACTERISTIC
/begin CHARACTERISTIC EngICO_nMaxAppDpd_Cur "Engine speed dependent on App" CURVE 0x8051E79D RB_Curve_U8_U8 8160. nmot_q32 0.00 8160. FORMAT "%5.0"
 /begin AXIS_DESCR STD_AXIS EngICO_nMaxApp relPED_ub_b100 6 0.00 100.0 FORMAT "%5.1" DEPOSIT ABSOLUTE /end AXIS_DESCR
/end CHARACTERISTIC
/begin CHARACTERISTIC EngICO_nMaxVDpd_Cur "Engine speed dependent on Veocity" CURVE 0x8051E7AA RB_Curve_S16_U8_Static 8160. nmot_q32 0.00 8160. FORMAT "%5.0"
 /begin AXIS_DESCR STD_AXIS EngICO_nMaxV vel_q0p01 6 -327.6800 327.6700 FORMAT "%8.4" DEPOSIT ABSOLUTE /end AXIS_DESCR
/end CHARACTERISTIC
/begin CHARACTERISTIC EngICO_nMax_C "Engine speed over all limiting" VALUE 0x8051E7BE RB_Val_Wu8 8160. nmot_q32 0.00 8160. FORMAT "%5.0" /end CHARACTERISTIC
/begin CHARACTERISTIC EngPrt_nMaxFltDetn_C "Threshold for maximum speed fault detection" VALUE 0x8051E81C RB_Val_Ws16 32767.50 EngN -16384.00 16383.50 FORMAT "%8.2" /end CHARACTERISTIC
/begin CHARACTERISTIC EngPrt_nOvhtEngLim_T "Time-dependent engine-speed limitation for overheat protection in standstill" CURVE 0x8051E7E0 RB_Curve_U16_S16_Static 16383.50 EngN 0.00 16383.50 FORMAT "%8.2" EXTENDED_LIMITS -16384.00 16383.50
 /begin AXIS_DESCR STD_AXIS EngPrt_tiNOvhtEngLim Time_s 8 0.00 655.3500 FORMAT "%8.4" DEPOSIT ABSOLUTE /end AXIS_DESCR
/end CHARACTERISTIC
/begin CHARACTERISTIC EngPrt_nOvhtOff_C "Engine speed threshold for deactivating the engine speed limitation at standstill" VALUE 0x8051E802 RB_Val_Ws16 32767.50 EngN -16384.00 16383.50 FORMAT "%8.2" /end CHARACTERISTIC
/begin CHARACTERISTIC EngPrt_nOvhtOn_C "Engine speed threshold for activating the engine speed limitation at standstill" VALUE 0x8051E804 RB_Val_Ws16 32767.50 EngN -16384.00 16383.50 FORMAT "%8.2" /end CHARACTERISTIC
/begin CHARACTERISTIC EngPrt_nStatOvht_C "Offset for increasing NMAX during overheating protection" VALUE 0x8051E806 RB_Val_Ws16 16383.00 EngN -8192.000 8191.000 FORMAT "%8.3" EXTENDED_LIMITS -16384.00 16383.50 /end CHARACTERISTIC
/begin CHARACTERISTIC EngPrt_numEngTBltDampr_C "Parameter to select the suitable temperature from the temperature array" VALUE 0x8051E7C0 RB_Val_Wu8 255.0 OneToOne 0.00 255.0 FORMAT "%5.1" /end CHARACTERISTIC
/begin CHARACTERISTIC EngPrt_pwrTqIntMaxOffs_C "Offset for power target value when no exhaust gas overheating present" VALUE 0x8051E822 RB_Val_Ws16 327.6700 Pwr_kW 0.00 327.6700 FORMAT "%8.4" EXTENDED_LIMITS -327.6800 327.6700 /end CHARACTERISTIC
/begin CHARACTERISTIC EngPrt_rOvhtApp_C "Definition of the accelerator pedal position for the activation of the engine speed limitation at vehicle standstill" VALUE 0x8051E808 RB_Val_Ws16 799.9878 Prc -400.0000 399.9878 FORMAT "%8.4" /end CHARACTERISTIC
/begin CHARACTERISTIC EngPrt_stDiagOverSpd_C "Status of engine overspeed diagnosis. Diagnosis feature is inactive and counter is reset" VALUE 0x8051E81E RB_Val_Wu8 255.0 OneToOne 0.00 255.0 FORMAT "%5.1" /end CHARACTERISTIC
/begin CHARACTERISTIC EngPrt_stNMaxOvht_CW "Code word for the reduction NMAX to the temperature protection" VALUE 0x8051E80A RB_Val_Wu8 255.0 OneToOne 0.00 255.0 FORMAT "%5.1" /end CHARACTERISTIC
/begin CHARACTERISTIC EngPrt_swtInpTSeln_C "Temperature selector switch" VALUE 0x8051E7C1 RB_Val_Wu8 1.00000000000 B_TRUE 0.00 1.00000000000 FORMAT "%13.11" /end CHARACTERISTIC
/begin CHARACTERISTIC EngPrt_swtNrNMaxFltClrEna_C "Calibration parameter to enable reset of overspeed counter when FCM is cleared" VALUE 0x8051E81F RB_Val_Wu8 1.00000000000 B_TRUE 0.00 1.00000000000 FORMAT "%13.11" /end CHARACTERISTIC
/begin CHARACTERISTIC EngPrt_tAirThd_C "Temperature Threshold" VALUE 0x8051E7C2 RB_Val_Ws16 6553.500 Temp_Cels -3549.940 3003.560 FORMAT "%8.3" /end CHARACTERISTIC
/begin CHARACTERISTIC EngPrt_tiDlyBltDrvVbrDampr_C "Time Delay parameter" VALUE 0x8051E7C4 RB_Val_Wu16 655.3500 Time_s 0.00 655.3500 FORMAT "%8.4" /end CHARACTERISTIC
/begin CHARACTERISTIC EngPrt_tiNMaxFltDetn_C "Debouncing time fault detection max critical engine speed" VALUE 0x8051E820 RB_Val_Wu8 51.00 t_q0p2 0.00 51.00 FORMAT "%5.2" /end CHARACTERISTIC
/begin CHARACTERISTIC EngPrt_tiNMaxFltHeal_C "Debouncing time fault healing max critical engine speed" VALUE 0x8051E821 RB_Val_Wu8 51.00 t_q0p2 0.00 51.00 FORMAT "%5.2" /end CHARACTERISTIC
/begin CHARACTERISTIC EngPrt_tiNMaxOvht_C "Maximum time for the operation in limitation NMAX before engine speed reduction" VALUE 0x8051E80C RB_Val_Wu16 655.3500 Time_s 0.00 655.3500 FORMAT "%8.4" /end CHARACTERISTIC
/begin CHARACTERISTIC EngPrt_tiNOvhtOff_C "Time delay for the deactivation of the engine speed limitation at vehicle standstill" VALUE 0x8051E80E RB_Val_Wu16 655.3500 Time_s 0.00 655.3500 FORMAT "%8.4" /end CHARACTERISTIC
/begin CHARACTERISTIC EngPrt_tmrAftStrtThd_C "Timer threshold" VALUE 0x8051E7C6 RB_Val_Wu16 655.3500 t_q0p01 0.00 655.3500 FORMAT "%8.4" /end CHARACTERISTIC
/begin CHARACTERISTIC EngPrt_tOvhtCEngDsTLim_C "Coolant temperature threshold for the activation of the engine speed limitation at vehicle standstill" VALUE 0x8051E810 RB_Val_Ws16 6553.500 Temp_Cels -3549.940 3003.560 FORMAT "%8.3" /end CHARACTERISTIC
/begin CHARACTERISTIC EngPrt_tqBltDrvVbrDampr_C "Torque threshold" VALUE 0x8051E7C8 RB_Val_Ws16 6553.500 Trq -3276.800 3276.700 FORMAT "%8.3" /end CHARACTERISTIC
/begin CHARACTERISTIC EngPrt_tqDeltaBltDrvVbrDampr_C "Delta torque for the hysteresis" VALUE 0x8051E7CA RB_Val_Ws16 6553.500 Trq -3276.800 3276.700 FORMAT "%8.3" /end CHARACTERISTIC
/begin CHARACTERISTIC EngPrt_trqDesOff_C "Relative driver request torque threshold for the cruise control and accelerator overheating protection" VALUE 0x8051E814 RB_Val_Ws32 32767.0000000 TrqPrpHigh 0.00 32767.0000000 FORMAT "%13.7" EXTENDED_LIMITS -214748364.800 214748364.700 /end CHARACTERISTIC
/begin CHARACTERISTIC EngPrt_trqInrNLim_CUR "HEV: curve for limitation of engine speed on ENG (inner engine torque)" CURVE 0x8051E7CC RB_Curve_S16_S16 3276.700 Trq 0.00 3276.700 FORMAT "%8.3" EXTENDED_LIMITS -3276.800 3276.700
 /begin AXIS_DESCR STD_AXIS Epm_nEng EngN 4 -16384.00 16383.50 FORMAT "%8.2" DEPOSIT ABSOLUTE /end AXIS_DESCR
/end CHARACTERISTIC
/begin CHARACTERISTIC EngPrt_trqLimOvrSpdFCODem_C "Torque threshold for release of fuel cut-off" VALUE 0x8051E7DE RB_Val_Ws16 3276.700 Trq 0.00 3276.700 FORMAT "%8.3" EXTENDED_LIMITS -3276.800 3276.700 /end CHARACTERISTIC
/begin CHARACTERISTIC EngPrt_vOvhtOn_C "Below this speed threshold EngPrt_OvhtNLim to vehicle stagnation is recognized in the function." VALUE 0x8051E818 RB_Val_Ws16 655.3500 Vel -327.6800 327.6700 FORMAT "%8.4" /end CHARACTERISTIC
/begin CHARACTERISTIC EngStrt_dataStrtCoor_C "Codeword EngStrt_StrtCoor" VALUE 0x8051E838 RB_Val_Wu8 255.0 OneToOne 0.00 255.0 FORMAT "%5.1" /end CHARACTERISTIC
/begin CHARACTERISTIC EngStrt_dnEngCoM1_T "Engine speed offset for start type ENGSTRT_COMRUNNG" CURVE 0x8051E83A RB_Curve_S16_S16 32767.50 EngN -16384.00 16383.50 FORMAT "%8.2"
 /begin AXIS_DESCR STD_AXIS HLSDem_nSetPLo EngN 3 -16384.00 16383.50 FORMAT "%8.2" DEPOSIT ABSOLUTE /end AXIS_DESCR
/end CHARACTERISTIC
/begin CHARACTERISTIC EngStrt_dnEngCoM2_T "Engine speed offset for start type ENGSTRT_COMSTRTG" CURVE 0x8051E848 RB_Curve_S16_S16 32767.50 EngN -16384.00 16383.50 FORMAT "%8.2"
 /begin AXIS_DESCR STD_AXIS HLSDem_nSetPLo EngN 3 -16384.00 16383.50 FORMAT "%8.2" DEPOSIT ABSOLUTE /end AXIS_DESCR
/end CHARACTERISTIC
/begin CHARACTERISTIC EngStrt_nDisblNewSync_C "Engine speed threshold for using re-synchro prohibition for T15 stops" VALUE 0x804FA3A2 Val_Ws16 32767.50 EngN -16384.00 16383.50 FORMAT "%8.2" /end CHARACTERISTIC
/begin CHARACTERISTIC EngStrt_nEngCoM1_M "Engine speed threshold for start type ENGSTRT_COMRUNNG" MAP 0x8051E856 RB_Map_U16S16_S16 32767.50 EngN -16384.00 16383.50 FORMAT "%8.2"
 /begin AXIS_DESCR STD_AXIS PEnv_p p_q0p039 5 0.00 2559.961 FORMAT "%8.3" DEPOSIT ABSOLUTE /end AXIS_DESCR
 /begin AXIS_DESCR STD_AXIS EngStrt_tStrtCoor Temp_Cels 5 -273.140 3003.560 FORMAT "%8.3" EXTENDED_LIMITS -3549.940 3003.560 DEPOSIT ABSOLUTE /end AXIS_DESCR
/end CHARACTERISTIC
/begin CHARACTERISTIC EngStrt_nEngCoM2_M "Engine speed threshold for start type ENGSTRT_COMSTRTG" MAP 0x8051E8A0 RB_Map_U16S16_S16 32767.50 EngN -16384.00 16383.50 FORMAT "%8.2"
 /begin AXIS_DESCR STD_AXIS PEnv_p p_q0p039 5 0.00 2559.961 FORMAT "%8.3" DEPOSIT ABSOLUTE /end AXIS_DESCR
 /begin AXIS_DESCR STD_AXIS EngStrt_tStrtCoor Temp_Cels 5 -273.140 3003.560 FORMAT "%8.3" EXTENDED_LIMITS -3549.940 3003.560 DEPOSIT ABSOLUTE /end AXIS_DESCR
/end CHARACTERISTIC
/begin CHARACTERISTIC EngStrt_stCfgCoMBhvr_T "curve to configure the behaviour of the process Proc_EngReStrt at change of mind" CURVE 0x8051E824 RB_Curve_U16_U8_Static 255.0 OneToOne 0.00 255.0 FORMAT "%5.1"
 /begin AXIS_DESCR STD_AXIS EngStrt_stStrtReq ENGSTRT_STSTRTREQ_SET_COMPU_VERB 6 0.00 16384.0000000 FORMAT "%13.7" DEPOSIT ABSOLUTE /end AXIS_DESCR
/end CHARACTERISTIC
/begin CHARACTERISTIC EngStrt_stEomStrt_C "State of the mode of operation Start" VALUE 0x8051E8EA RB_Val_Wu16 7951.00000000 CoEOM_stEomStgTot_VERB 0.00 7951.00000000 FORMAT "%13.8" /end CHARACTERISTIC
/begin CHARACTERISTIC EngStrt_stStrtPrioCoM_CA "Priority list for the selection of the start type at change of mind" VAL_BLK 0x8051E8EC RB_ValA_Wu16 16384.0000000 ENGSTRT_STSTRTREQ_SET_COMPU_VERB 0.00 16384.0000000 FORMAT "%13.7" NUMBER 6 /end CHARACTERISTIC
/begin CHARACTERISTIC EngStrt_stStrtPrioFirst_CA "Priority list for the selection of the start type at first start" VAL_BLK 0x8051E8F8 RB_ValA_Wu16 16384.0000000 ENGSTRT_STSTRTREQ_SET_COMPU_VERB 0.00 16384.0000000 FORMAT "%13.7" NUMBER 6 /end CHARACTERISTIC
/begin CHARACTERISTIC EngStrt_stStrtPrioFolw_CA "Priority list for the selection of the start type at following start" VAL_BLK 0x8051E904 RB_ValA_Wu16 16384.0000000 ENGSTRT_STSTRTREQ_SET_COMPU_VERB 0.00 16384.0000000 FORMAT "%13.7" NUMBER 6 /end CHARACTERISTIC
/begin CHARACTERISTIC EngStrt_stStrtReqAppl_C "Application value for start type (independant of priorisation)" VALUE 0x8051E910 RB_Val_Wu16 16384.0000000 ENGSTRT_STSTRTREQ_SET_COMPU_VERB 0.00 16384.0000000 FORMAT "%13.7" /end CHARACTERISTIC
/begin CHARACTERISTIC EngStrt_stStrtSitAppl_C "Application value for start situation (independant of priorisation)" VALUE 0x8051E912 RB_Val_Wu8 255.0 OneToOne 0.00 255.0 FORMAT "%5.1" /end CHARACTERISTIC
/begin CHARACTERISTIC EngStrt_tFrstStrtStallgConf_C "Calibration for temperature threshold for First Start situation during engine stalling" VALUE 0x8051E914 RB_Val_Ws16 6553.500 Temp_Cels -3549.940 3003.560 FORMAT "%8.3" /end CHARACTERISTIC
/begin CHARACTERISTIC EngStrt_tiDisblNewSyncMax_C "maximum time until DisblNewSync is ended" VALUE 0x804FA3A4 Val_Wu16 655.3500 ti_s_q0p01_COMPU 0.00 655.3500 FORMAT "%8.4" /end CHARACTERISTIC
/begin CHARACTERISTIC EngStrt_tiDlyCoMWaitStrtr_C "Delay time to maintain ENGSTRT_COMWAITSTRTR in case of start request close to engine standstill" VALUE 0x8051E916 RB_Val_Wu8 2.550 t_q0p01 0.00 2.550 FORMAT "%5.3" /end CHARACTERISTIC
/begin CHARACTERISTIC EngStrt_tiDlyNoStrtReq_C "time delay to trigger a priorisation without start request" VALUE 0x8051E917 RB_Val_Wu8 2.550 t_q0p01 0.00 2.550 FORMAT "%5.3" /end CHARACTERISTIC
/begin CHARACTERISTIC EngStrt_tPfiStrtHi_C "upper threshold temperature range for the PFI Start" VALUE 0x8051E918 RB_Val_Ws16 3276.700 Temp_Cels -273.140 3003.560 FORMAT "%8.3" EXTENDED_LIMITS -3549.940 3003.560 /end CHARACTERISTIC
/begin CHARACTERISTIC EngStrt_tPfiStrtLo_C "lower threshold temperature range for the PFI Start" VALUE 0x8051E91A RB_Val_Ws16 3276.700 Temp_Cels -273.140 3003.560 FORMAT "%8.3" EXTENDED_LIMITS -3549.940 3003.560 /end CHARACTERISTIC
/begin MEASUREMENT B_evabu_msg "Condition: Ev- disconnection by monitoring functions" UBYTE B_TRUE 1 100 0.00 1.00000000000 BIT_MASK 0x1 FORMAT "%13.11" ECU_ADDRESS 0x70000A6F /end MEASUREMENT
/begin MEASUREMENT ComEBS_BattID "Battery ID" UBYTE dez 1 100 0.00 255.0 FORMAT "%5.1" ECU_ADDRESS 0x60006562 /end MEASUREMENT
/begin MEASUREMENT ComEBS_flgBitEna "Enabel bit (Enable Flag)" UBYTE B_TRUE 1 100 0.00 1.00000000000 BIT_MASK 0x1 FORMAT "%13.11" ECU_ADDRESS 0x60006561 /end MEASUREMENT
/begin MEASUREMENT ComEBS_LinTypTx "LIN_Type_Tx (LIN format)" UBYTE OneToOne 1 100 0.00 255.0 FORMAT "%5.1" ECU_ADDRESS 0x60006560 /end MEASUREMENT
/begin MEASUREMENT ComEBS_stReLrngReq "Relearning request state" UBYTE B_TRUE 1 100 0.00 1.00000000000 BIT_MASK 0x1 FORMAT "%13.11" ECU_ADDRESS 0x6000655F /end MEASUREMENT
/begin MEASUREMENT Com_cntBankFrozenNew "Count of Bank frozen in Current DCY" UBYTE OneToOne 1 100 0.00 255.0 FORMAT "%5.1" ECU_ADDRESS 0x60006567 /end MEASUREMENT
/begin MEASUREMENT Com_cntBankFrozenNewOld "Count of Bank frozen in Current DCY old" UBYTE OneToOne 1 100 0.00 255.0 FORMAT "%5.1" ECU_ADDRESS 0x60006566 /end MEASUREMENT
/begin MEASUREMENT Com_cntDTCCfmdOld "Holds the previously confirmed DTC count" UBYTE OneToOne 1 100 0.00 255.0 FORMAT "%5.1" ECU_ADDRESS 0x600365EE /end MEASUREMENT
/begin MEASUREMENT Com_cntDTCPendingOld "Holds the previously pending DTC count" UBYTE OneToOne 1 100 0.00 255.0 FORMAT "%5.1" ECU_ADDRESS 0x600365ED /end MEASUREMENT
/begin MEASUREMENT Com_cntOBSOld "Holds the previous OBS freeze count" UBYTE OneToOne 1 100 0.00 255.0 FORMAT "%5.1" ECU_ADDRESS 0x600365EC /end MEASUREMENT
/begin MEASUREMENT Com_ctCRingENGAE "Message for ring counter oF ENGAE frame" UBYTE OneToOne 1 100 0.00 3.000 FORMAT "%5.3" ECU_ADDRESS 0x6000A0DD /end MEASUREMENT
/begin MEASUREMENT Com_ctCRingENGB "message counter info of ENGB" UBYTE OneToOne 1 100 0.00 255.0 FORMAT "%5.1" ECU_ADDRESS 0x6000A61B /end MEASUREMENT
/begin MEASUREMENT Com_ctCRingENGC "Frame counter info for ENGC" UBYTE OneToOne 1 100 0.00 255.0 FORMAT "%5.1" ECU_ADDRESS 0x6000A61A /end MEASUREMENT
/begin MEASUREMENT Com_ctCRingENGD "Message counter of ENGD frame" UBYTE OneToOne 1 100 0.00 3.000 FORMAT "%5.3" ECU_ADDRESS 0x6000A619 /end MEASUREMENT
/begin MEASUREMENT Com_ctCRingENGE "Structure for ring counter of CAN frame ENGE" UBYTE OneToOne 1 100 0.00 3.000 FORMAT "%5.3" ECU_ADDRESS 0x6000A0DC /end MEASUREMENT
/begin MEASUREMENT Com_ctCRingENGF "Message counter info ENGF" UBYTE OneToOne 1 100 0.00 255.0 FORMAT "%5.1" ECU_ADDRESS 0x6000A618 /end MEASUREMENT
/begin MEASUREMENT Com_ctCRingENGHIP1 "CAN message counter of ENGHIP1 frame" UBYTE OneToOne 1 100 0.00 255.0 FORMAT "%5.1" ECU_ADDRESS 0x6000A617 /end MEASUREMENT
/begin MEASUREMENT Com_ctCRingENGIMG1 "Ring Counter for ENGIMG1 frame" UBYTE OneToOne 1 100 0.00 3.000 FORMAT "%5.3" ECU_ADDRESS 0x6000A0DB /end MEASUREMENT
/begin MEASUREMENT Com_ctCRingENGJ "Message counter info ENGJ" UBYTE OneToOne 1 100 0.00 255.0 FORMAT "%5.1" ECU_ADDRESS 0x6000A616 /end MEASUREMENT
/begin MEASUREMENT Com_ctCRingENGK "Frame counter info ENGK" UBYTE OneToOne 1 100 0.00 255.0 FORMAT "%5.1" ECU_ADDRESS 0x6000A615 /end MEASUREMENT
/begin MEASUREMENT Com_ctCRingENGL "CAN RingCounter for ENGL Frame" UBYTE OneToOne 1 100 0.00 255.0 FORMAT "%5.1" ECU_ADDRESS 0x6000A614 /end MEASUREMENT
/begin MEASUREMENT Com_ctCRingENGN "Ring counter for frame ENGN" UBYTE OneToOne 1 100 0.00 255.0 FORMAT "%5.1" ECU_ADDRESS 0x6000A0DA /end MEASUREMENT
/begin MEASUREMENT Com_ctCRingENGO "message counter info ENGO" UBYTE OneToOne 1 100 0.00 255.0 FORMAT "%5.1" ECU_ADDRESS 0x6000A0D9 /end MEASUREMENT
/begin MEASUREMENT Com_ctCRingENGQ "Ring counter for ENGQ frame" UBYTE OneToOne 1 100 0.00 3.000 FORMAT "%5.3" ECU_ADDRESS 0x6000A0D8 /end MEASUREMENT
/begin MEASUREMENT Com_ctCRingENGR "Message counter info ENGR" UBYTE OneToOne 1 100 0.00 255.0 FORMAT "%5.1" ECU_ADDRESS 0x6000A613 /end MEASUREMENT
/begin MEASUREMENT Com_ctCRingENGT "Can ring counter for ENGT frame" UBYTE OneToOne 1 100 0.00 255.0 FORMAT "%5.1" ECU_ADDRESS 0x6000A610 /end MEASUREMENT
/begin MEASUREMENT Com_ctCRingENGT1 "Engine T1 alive counter" UBYTE OneToOne 1 100 0.00 255.0 FORMAT "%5.1" ECU_ADDRESS 0x6000A612 /end MEASUREMENT
/begin MEASUREMENT Com_ctCRingENGT2 "Ring Counter message for ENGT2 Frame" UBYTE OneToOne 1 100 0.00 255.0 FORMAT "%5.1" ECU_ADDRESS 0x6000A611 /end MEASUREMENT
/begin MEASUREMENT Com_ctCRingENGU "Ring Counter Message for Transmission frame ENGU" UBYTE OneToOne 1 100 0.00 255.0 FORMAT "%5.1" ECU_ADDRESS 0x6000A60F /end MEASUREMENT
/begin MEASUREMENT Com_ctCRingENGV2 "Ring Counter message for ENGV2 Frame" UBYTE OneToOne 1 100 0.00 255.0 FORMAT "%5.1" ECU_ADDRESS 0x6000A60E /end MEASUREMENT
/begin MEASUREMENT Com_ctCRingENGW "Message counter info ENGW" UBYTE OneToOne 1 100 0.00 255.0 FORMAT "%5.1" ECU_ADDRESS 0x6000A60D /end MEASUREMENT
/begin MEASUREMENT Com_ctCRingENGX "Message counter for EngX frame" UBYTE OneToOne 1 100 0.00 255.0 FORMAT "%5.1" ECU_ADDRESS 0x6000A0D7 /end MEASUREMENT
/begin MEASUREMENT Com_ctCRingENGY "Message counter for EngY frame" UBYTE OneToOne 1 100 0.00 255.0 FORMAT "%5.1" ECU_ADDRESS 0x6000A7F9 /end MEASUREMENT
/begin MEASUREMENT Com_ctCRingENGZ "Message counter for ENGZ frame." UBYTE OneToOne 1 100 0.00 255.0 FORMAT "%5.1" ECU_ADDRESS 0x6000A7FC /end MEASUREMENT
/begin MEASUREMENT Com_ctEngData "Data frame counter for ENGV2" UBYTE OneToOne 1 100 0.00 255.0 FORMAT "%5.1" ECU_ADDRESS 0x6000A5F9 /end MEASUREMENT
/begin MEASUREMENT Com_ctFrmENGN "Frame number for frame ENGN" UBYTE OneToOne 1 100 0.00 255.0 FORMAT "%5.1" ECU_ADDRESS 0x6000A5F8 /end MEASUREMENT
/begin MEASUREMENT Com_ctFrzSyn "Freeze data synchronization counter" UBYTE OneToOne 1 100 0.00 255.0 FORMAT "%5.1" ECU_ADDRESS 0x6000A5F7 /end MEASUREMENT
/begin MEASUREMENT Com_ctIdxCptr "Count of captured entires for DFC_ComATMILReq in DFES_numDFC" UBYTE OneToOne 1 100 0.00 255.0 FORMAT "%5.1" ECU_ADDRESS 0x6000A5F6 /end MEASUREMENT
/begin MEASUREMENT Com_dDTCInfo "Array to hold the values of DTCs in confirmed state that is to be sent to Meter unit" UWORD OneToOne 1 100 0.00 65535.00 FORMAT "%8.2" ARRAY_SIZE 6 ECU_ADDRESS 0x60004D7E /end MEASUREMENT
/begin MEASUREMENT Com_dDTCRaw1 "Raw value of DTC output to Meter" UWORD OneToOne 1 100 0.00 65535.00 FORMAT "%8.2" ECU_ADDRESS 0x60004D7C /end MEASUREMENT
/begin MEASUREMENT Com_dDTCRaw2 "Raw value of DTC output to Meter" UWORD OneToOne 1 100 0.00 65535.00 FORMAT "%8.2" ECU_ADDRESS 0x60004D7A /end MEASUREMENT
/begin MEASUREMENT Com_dDTCRaw3 "Raw value of DTC output to Meter" UWORD OneToOne 1 100 0.00 65535.00 FORMAT "%8.2" ECU_ADDRESS 0x60004D78 /end MEASUREMENT
/begin MEASUREMENT Com_dIdxDFESEntry "Index data of DFES_numENtries for DFC_ComATMILReq" UBYTE OneToOne 1 100 0.00 255.0 FORMAT "%5.1" ARRAY_SIZE 20 ECU_ADDRESS 0x6000A0C1 /end MEASUREMENT
/begin MEASUREMENT Com_dPhysAdr "Physical address sent to Meter unit by Engine ECU" UBYTE OneToOne 1 100 0.00 255.0 FORMAT "%5.1" ECU_ADDRESS 0x6000A5EF /end MEASUREMENT
/begin MEASUREMENT Com_flgISABReq "status of ISAB Request" UBYTE OneToOne 1 100 0.00 255.0 FORMAT "%5.1" ECU_ADDRESS 0x6000A5E6 /end MEASUREMENT
/begin MEASUREMENT Com_flgTCUMilReqDFCErase "FCM Erase status flag for DFC_ComATMILReq" UBYTE B_TRUE 1 100 0.00 1.00000000000 BIT_MASK 0x1 FORMAT "%13.11" ECU_ADDRESS 0x6000A1B1 /end MEASUREMENT
/begin MEASUREMENT Com_lTotRing "Value of distance travelled by vehicle transmitted over CAN" SWORD Length_Km_q0p001 1 100 -32.76800 32.76700 FORMAT "%8.5" ECU_ADDRESS 0x600051B6 /end MEASUREMENT
/begin MEASUREMENT Com_nEngSpdSmotng "Smoothing control of tachometer Value" SWORD EngN 1 100 -16384.00 16383.50 FORMAT "%8.2" ECU_ADDRESS 0x600051B2 /end MEASUREMENT
/begin MEASUREMENT Com_nEngSpdSmotng_MP "Switch ramp output of Engine Speed" SWORD EngN 1 100 -16384.00 16383.50 FORMAT "%8.2" ECU_ADDRESS 0x70008D9C /end MEASUREMENT
/begin MEASUREMENT Com_nEngSpd_MP "Filtered Engine Speed measuring point" SWORD EngN 1 100 -16384.00 16383.50 FORMAT "%8.2" ECU_ADDRESS 0x70008D9A /end MEASUREMENT
/begin MEASUREMENT Com_nrEngByte1 "Engine data byte1" UBYTE OneToOne 1 100 0.00 255.0 FORMAT "%5.1" ECU_ADDRESS 0x6000A5DE /end MEASUREMENT
/begin MEASUREMENT Com_nrEngByte2 "Engine data byte2" UBYTE OneToOne 1 100 0.00 255.0 FORMAT "%5.1" ECU_ADDRESS 0x6000A5DD /end MEASUREMENT
/begin MEASUREMENT Com_nrEngByte3 "Engine data byte3" UBYTE OneToOne 1 100 0.00 255.0 FORMAT "%5.1" ECU_ADDRESS 0x6000A5DC /end MEASUREMENT
/begin MEASUREMENT Com_nrEngByte4 "Engine data byte4" UBYTE OneToOne 1 100 0.00 255.0 FORMAT "%5.1" ECU_ADDRESS 0x6000A5DB /end MEASUREMENT
/begin MEASUREMENT Com_nrEngByte5 "Engine data byte5" UBYTE OneToOne 1 100 0.00 255.0 FORMAT "%5.1" ECU_ADDRESS 0x6000A5DA /end MEASUREMENT
/begin MEASUREMENT Com_nrEngByte6 "Engine data byte6" UBYTE OneToOne 1 100 0.00 255.0 FORMAT "%5.1" ECU_ADDRESS 0x6000A5D9 /end MEASUREMENT
/begin MEASUREMENT Com_numCsumENGAE "Message fr checksum of frame ENGAE" UBYTE OneToOne 1 100 0.00 15.00 FORMAT "%5.2" ECU_ADDRESS 0x6000A0B2 /end MEASUREMENT
/begin MEASUREMENT Com_numCsumENGB "Checksum message for ENGB frame" UBYTE OneToOne 1 100 0.00 255.0 FORMAT "%5.1" ECU_ADDRESS 0x6000A5BF /end MEASUREMENT
/begin MEASUREMENT Com_numCsumENGC "Checksum message for frame ENGC" UBYTE OneToOne 1 100 0.00 255.0 FORMAT "%5.1" ECU_ADDRESS 0x6000A5BE /end MEASUREMENT
/begin MEASUREMENT Com_numCsumENGD "Checksum message for frame ENGD" UBYTE OneToOne 1 100 0.00 15.00 FORMAT "%5.2" ECU_ADDRESS 0x6000A5BD /end MEASUREMENT
/begin MEASUREMENT Com_numCsumENGE "Checksum message for ENGE frame" UBYTE OneToOne 1 100 0.00 15.00 FORMAT "%5.2" ECU_ADDRESS 0x6000A0B1 /end MEASUREMENT
/begin MEASUREMENT Com_numCsumENGF "Checksum message for frame ENGF" UBYTE OneToOne 1 100 0.00 255.0 FORMAT "%5.1" ECU_ADDRESS 0x6000A5BC /end MEASUREMENT
/begin MEASUREMENT Com_numCsumENGHIP1 "Checksum message for frame ENGHIP1" UBYTE OneToOne 1 100 0.00 255.0 FORMAT "%5.1" ECU_ADDRESS 0x6000A5BB /end MEASUREMENT
/begin MEASUREMENT Com_numCsumENGIMG1 "Checksum message for Engine IMG1 Frame" UBYTE OneToOne 1 100 0.00 15.00 FORMAT "%5.2" ECU_ADDRESS 0x6000A0B0 /end MEASUREMENT
/begin MEASUREMENT Com_numCsumENGJ "Checksum message for frame ENGJ" UBYTE OneToOne 1 100 0.00 255.0 FORMAT "%5.1" ECU_ADDRESS 0x6000A5BA /end MEASUREMENT
/begin MEASUREMENT Com_numCsumENGK "Checksum message for frame ENGK" UBYTE OneToOne 1 100 0.00 255.0 FORMAT "%5.1" ECU_ADDRESS 0x6000A5B9 /end MEASUREMENT
/begin MEASUREMENT Com_numCsumENGL "Check sum for ENGL frame" UBYTE OneToOne 1 100 0.00 255.0 FORMAT "%5.1" ECU_ADDRESS 0x6000A5B8 /end MEASUREMENT
/begin MEASUREMENT Com_numCsumENGN "Checksum for the CAN frame ENGN" UBYTE OneToOne 1 100 0.00 255.0 FORMAT "%5.1" ECU_ADDRESS 0x6000A0AF /end MEASUREMENT
/begin MEASUREMENT Com_numCsumENGO "Checksum message for ENGO frame" UBYTE OneToOne 1 100 0.00 255.0 FORMAT "%5.1" ECU_ADDRESS 0x6000A0AE /end MEASUREMENT
/begin MEASUREMENT Com_numCsumENGQ "Checksum for ENGQ frame" UBYTE OneToOne 1 100 0.00 15.00 FORMAT "%5.2" ECU_ADDRESS 0x6000A0AD /end MEASUREMENT
/begin MEASUREMENT Com_numCsumENGR "Checksum message for frame ENGR" UBYTE OneToOne 1 100 0.00 255.0 FORMAT "%5.1" ECU_ADDRESS 0x6000A5B7 /end MEASUREMENT
/begin MEASUREMENT Com_numCsumENGT "Checksum message for ENGT frame" UBYTE OneToOne 1 100 0.00 255.0 FORMAT "%5.1" ECU_ADDRESS 0x6000A5B4 /end MEASUREMENT
/begin MEASUREMENT Com_numCsumENGT1 "Checksum counter for ENGT1" UBYTE OneToOne 1 100 0.00 255.0 FORMAT "%5.1" ECU_ADDRESS 0x6000A5B6 /end MEASUREMENT
/begin MEASUREMENT Com_numCsumENGT2 "Check sum Message for ENGT2" UBYTE OneToOne 1 100 0.00 255.0 FORMAT "%5.1" ECU_ADDRESS 0x6000A5B5 /end MEASUREMENT
/begin MEASUREMENT Com_numCsumENGU "Checksum message for ENGU Trasnmission frame" UBYTE OneToOne 1 100 0.00 255.0 FORMAT "%5.1" ECU_ADDRESS 0x6000A5B3 /end MEASUREMENT
/begin MEASUREMENT Com_numCsumENGV2 "Checksum of ENGV2 Frame" UBYTE OneToOne 1 100 0.00 255.0 FORMAT "%5.1" ECU_ADDRESS 0x6000A5B2 /end MEASUREMENT
/begin MEASUREMENT Com_numCsumENGW "Checksum for ENGW frame" UBYTE OneToOne 1 100 0.00 255.0 FORMAT "%5.1" ECU_ADDRESS 0x6000A5B1 /end MEASUREMENT
/begin MEASUREMENT Com_numCsumENGX "Checksum message for EngX frame" UBYTE OneToOne 1 100 0.00 255.0 FORMAT "%5.1" ECU_ADDRESS 0x6000A0AC /end MEASUREMENT
/begin MEASUREMENT Com_numCsumENGY "Checksum message for EngY frame" UBYTE OneToOne 1 100 0.00 255.0 FORMAT "%5.1" ECU_ADDRESS 0x6000A7F8 /end MEASUREMENT
/begin MEASUREMENT Com_numCsumENGZ "Checksum message for ENGZ frame" UBYTE OneToOne 1 100 0.00 255.0 FORMAT "%5.1" ECU_ADDRESS 0x6000A7FA /end MEASUREMENT
/begin MEASUREMENT Com_numCurrfrzDFC "Current Freeze frame DFC available on tester" UWORD DFC_Verb 1 100 0.00 703.000000000 FORMAT "%13.9" ECU_ADDRESS 0x60003A8C /end MEASUREMENT
/begin MEASUREMENT Com_numCurrfrzDFCOld "Old Freeze frame DFC available on tester" UWORD DFC_Verb 1 100 0.00 703.000000000 FORMAT "%13.9" ECU_ADDRESS 0x600365EA /end MEASUREMENT
/begin MEASUREMENT Com_numDTCHi "Highbyte of DTC confirmed in current Driving Cycle (ENGHIP1 Frame)" UBYTE OneToOne 1 100 0.00 255.0 FORMAT "%5.1" ECU_ADDRESS 0x6000A59C /end MEASUREMENT
/begin MEASUREMENT Com_numDTCLo "Lowbyte of DTC confirmed in current Driving Cycle (ENGHIP1 Frame)" UBYTE OneToOne 1 100 0.00 255.0 FORMAT "%5.1" ECU_ADDRESS 0x6000A59B /end MEASUREMENT
/begin MEASUREMENT Com_numIdxDFC "Index of current Freeze frame DFC available on tester" UBYTE OneToOne 1 100 0.00 255.0 FORMAT "%5.1" ECU_ADDRESS 0x6000A0A9 /end MEASUREMENT
/begin MEASUREMENT Com_numIdxDFCOld "Index of old Freeze frame DFC available on tester" UBYTE OneToOne 1 100 0.00 255.0 FORMAT "%5.1" ECU_ADDRESS 0x600365E9 /end MEASUREMENT
/begin MEASUREMENT Com_numTCUMilReqDFC "DFC Id info of DFC_ComATMILReq" UWORD OneToOne 1 100 0.00 65535.00 FORMAT "%8.2" ARRAY_SIZE 12 ECU_ADDRESS 0x50005A04 /end MEASUREMENT
/begin MEASUREMENT Com_pClnt "Temporary value of A/C head pressure in bar" UWORD Pres_kPa_ENGY 1 100 0.00 65535.00 FORMAT "%8.2" ECU_ADDRESS 0x600053BE /end MEASUREMENT
/begin MEASUREMENT Com_pEnvPRawENGL "Raw value for Ambient pressure value transmitted on the CAN" UWORD Pres_1_kPa 1 100 0.00 65535.00 FORMAT "%8.2" ECU_ADDRESS 0x60004D6E /end MEASUREMENT
/begin MEASUREMENT Com_pforISABIdleStop "Brake Fluid Pressure For Idling Stop" SWORD Pres 1 100 -3276.800 3276.700 FORMAT "%8.3" ECU_ADDRESS 0x600051A6 /end MEASUREMENT
/begin MEASUREMENT Com_rACCTxEstSlp "Estimated slope of the road transmitted over CAN" SBYTE Prc_CrCtl3 1 100 -16.00 15.88 FORMAT "%5.2" ECU_ADDRESS 0x6000A6D3 /end MEASUREMENT
/begin MEASUREMENT Com_stalchpct "Ethanol concentration factor" UBYTE OneToOne 1 100 0.00 255.0 FORMAT "%5.1" ECU_ADDRESS 0x6000A086 /end MEASUREMENT
/begin MEASUREMENT Com_stAutoSta1DCY "Output of SR FlipFlop of Each 1DCY DFCs" UWORD OneToOne 1 100 0.00 65535.00 FORMAT "%8.2" ECU_ADDRESS 0x60036146 /end MEASUREMENT
/begin MEASUREMENT Com_stAutoSta1DCYOld "Previous Driving Cycle value of Output of SR FlipFlop of Each 1DCY DFCs" UWORD OneToOne 1 100 0.00 65535.00 FORMAT "%8.2" ECU_ADDRESS 0x60004D64 /end MEASUREMENT
/begin MEASUREMENT Com_stAutoSta2DCY "Output of SR FlipFlop of Each 2DCY DFCs" UBYTE OneToOne 1 100 0.00 255.0 FORMAT "%5.1" ECU_ADDRESS 0x60036145 /end MEASUREMENT
/begin MEASUREMENT Com_stAutoSta2DCYInterStrt "Confirmed Error status for 2DCY DFC_Clth2ONStuckLdc" UBYTE OneToOne 1 100 0.00 255.0 FORMAT "%5.1" ECU_ADDRESS 0x60036144 /end MEASUREMENT
/begin MEASUREMENT Com_stAutoSta2DCYOld "Previous Driving Cycle value of Output of SR FlipFlop of Each 2DCY DFCs" UBYTE OneToOne 1 100 0.00 255.0 FORMAT "%5.1" ECU_ADDRESS 0x6000A56F /end MEASUREMENT
/begin MEASUREMENT Com_stAutoStaInfo "The status of automatic starter system warning lamp for MID" UBYTE OneToOne 1 100 0.00 255.0 FORMAT "%5.1" ECU_ADDRESS 0x6000A56E /end MEASUREMENT
/begin MEASUREMENT Com_stAutoStaInfoMtr "Status of Starter system warning lamp for meter display" UBYTE OneToOne 1 100 0.00 255.0 FORMAT "%5.1" ECU_ADDRESS 0x6000A56D /end MEASUREMENT
/begin MEASUREMENT Com_stAYCFErr "CAN Recieve Error Information" UBYTE OneToOne 1 100 0.00 255.0 FORMAT "%5.1" ECU_ADDRESS 0x6000A57C /end MEASUREMENT
/begin MEASUREMENT Com_stBankFrozen "status of OBS banks frozen from over DCYs" UBYTE OneToOne 1 100 0.00 255.0 FORMAT "%5.1" ECU_ADDRESS 0x60006565 /end MEASUREMENT
/begin MEASUREMENT Com_stBankFrozenNew "status of OBS banks frozen current DCY" UBYTE OneToOne 1 100 0.00 255.0 FORMAT "%5.1" ECU_ADDRESS 0x60006564 /end MEASUREMENT
/begin MEASUREMENT Com_stBankFrozenNewOld "status of OBS banks frozen current DCY old" UBYTE OneToOne 1 100 0.00 255.0 FORMAT "%5.1" ECU_ADDRESS 0x60006563 /end MEASUREMENT
/begin MEASUREMENT Com_stCCClthSwt "Clutch switch signal for Cruise control" UBYTE OneToOne 1 100 0.00 255.0 FORMAT "%5.1" ECU_ADDRESS 0x6000A563 /end MEASUREMENT
/begin MEASUREMENT Com_stChkChgnSysInfo "Checking charging system information" UBYTE OneToOne 1 100 0.00 255.0 FORMAT "%5.1" ECU_ADDRESS 0x6000A0A2 /end MEASUREMENT
/begin MEASUREMENT Com_stChrgnSys "Status of Request Check Charging System" UBYTE OneToOne 1 100 0.00 255.0 FORMAT "%5.1" ECU_ADDRESS 0x6000A0A1 /end MEASUREMENT
/begin MEASUREMENT Com_stDrvModDisp "Driver Mode Display" UBYTE OneToOne 1 100 0.00 255.0 FORMAT "%5.1" ECU_ADDRESS 0x6000A546 /end MEASUREMENT
/begin MEASUREMENT Com_stDTCMem "DTC Storage State, ENGHIP1 Frame (0= no ENGHIP1 relevant stored in FCM, 1 = at least one ENGHIP1 relevant DTC stored in FCM)" UBYTE OneToOne 1 100 0.00 255.0 BIT_MASK 0x1 FORMAT "%5.1" ECU_ADDRESS 0x6000A1AB /end MEASUREMENT
/begin MEASUREMENT Com_stDTCTyp "DTC Typ (0=SAE, 1= Customer), ENGHIP1 Frame" UBYTE OneToOne 1 100 0.00 255.0 BIT_MASK 0x1 FORMAT "%5.1" ECU_ADDRESS 0x6000A1AA /end MEASUREMENT
/begin MEASUREMENT Com_stDTCUpd "Holds the DTC update notofication status" UBYTE OneToOne 1 100 0.00 3.000 FORMAT "%5.3" ECU_ADDRESS 0x600365E8 /end MEASUREMENT
/begin MEASUREMENT Com_stEMTestModEna "Test Mode Enable Status" UBYTE OneToOne 1 100 0.00 255.0 FORMAT "%5.1" ECU_ADDRESS 0x6000A536 /end MEASUREMENT
/begin MEASUREMENT Com_stEngBrkApp "Brake for the accelerator pedal on information" UBYTE OneToOne 1 100 0.00 255.0 FORMAT "%5.1" ECU_ADDRESS 0x6000A528 /end MEASUREMENT
/begin MEASUREMENT Com_stEngBrkOvrdInfo "Engine-ECU Messages (EngECU)" UBYTE OneToOne 1 100 0.00 255.0 FORMAT "%5.1" ECU_ADDRESS 0x6000A527 /end MEASUREMENT
/begin MEASUREMENT Com_stEngBrkOvrdMtr "Engine-ECU Messages (EngECU)" UBYTE OneToOne 1 100 0.00 255.0 FORMAT "%5.1" ECU_ADDRESS 0x6000A526 /end MEASUREMENT
/begin MEASUREMENT Com_stENGECUIG1 "ENG-ECU IG1 status" UBYTE OneToOne 1 100 0.00 255.0 FORMAT "%5.1" ECU_ADDRESS 0x6000A535 /end MEASUREMENT
/begin MEASUREMENT Com_stEngRemSt "remote engine starter status" UBYTE OneToOne 1 100 0.00 255.0 FORMAT "%5.1" ECU_ADDRESS 0x6000A091 /end MEASUREMENT
/begin MEASUREMENT Com_stEngRtMilUpd "Status of engine runtime MIL update" UBYTE OneToOne 1 100 0.00 255.0 FORMAT "%5.1" ECU_ADDRESS 0x6000A521 /end MEASUREMENT
/begin MEASUREMENT Com_stEngSpdThdX "Threshold X calculation of Engine Speed" UBYTE OneToOne 1 100 0.00 255.0 BIT_MASK 0x1 FORMAT "%5.1" ECU_ADDRESS 0x6000A1A9 /end MEASUREMENT
/begin MEASUREMENT Com_stEngSpdThdY "Threshold Y calculation of Engine Speed" UBYTE OneToOne 1 100 0.00 255.0 BIT_MASK 0x1 FORMAT "%5.1" ECU_ADDRESS 0x6000A1A8 /end MEASUREMENT
/begin MEASUREMENT Com_stENGT2AYCAck "Message for ENGT2 AYC acknowledgement" UBYTE OneToOne 1 100 0.00 255.0 FORMAT "%5.1" ECU_ADDRESS 0x6000A534 /end MEASUREMENT
/begin MEASUREMENT Com_stENGT2NPos "Status of com Gear box neutral position based on transmission type" UBYTE OneToOne 1 100 0.00 255.0 FORMAT "%5.1" ECU_ADDRESS 0x6000A533 /end MEASUREMENT
/begin MEASUREMENT Com_stENGT2RvsPos "Status of com Gear box reverse position based on transmission type" UBYTE OneToOne 1 100 0.00 255.0 FORMAT "%5.1" ECU_ADDRESS 0x6000A532 /end MEASUREMENT
/begin MEASUREMENT Com_stENGT2TraType_mp "Status of transmission type" UBYTE OneToOne 1 100 0.00 255.0 FORMAT "%5.1" ECU_ADDRESS 0x70008D98 /end MEASUREMENT
/begin MEASUREMENT Com_stENGTAYCAck "Message for status of AYC" UBYTE OneToOne 1 100 0.00 255.0 FORMAT "%5.1" ECU_ADDRESS 0x6000A531 /end MEASUREMENT
/begin MEASUREMENT Com_stENGTNPos "Status of com Gear box neutral position based on transmission type" UBYTE OneToOne 1 100 0.00 255.0 FORMAT "%5.1" ECU_ADDRESS 0x6000A530 /end MEASUREMENT
/begin MEASUREMENT Com_stENGTTraType_mp "Status of transmission type" UBYTE OneToOne 1 100 0.00 255.0 FORMAT "%5.1" ECU_ADDRESS 0x70008D99 /end MEASUREMENT
/begin MEASUREMENT Com_stEngWrmUp40CycWoFail "40 Warm-up cycle condition positive" UBYTE OneToOne 1 100 0.00 1.000 FORMAT "%5.3" ECU_ADDRESS 0x6000A51D /end MEASUREMENT
/begin MEASUREMENT Com_stFailrDetn "Failure Detection status" UBYTE OneToOne 1 100 0.00 3.000 FORMAT "%5.3" ECU_ADDRESS 0x6000A517 /end MEASUREMENT
/begin MEASUREMENT Com_stFIDInhbn "Inhibition status of current driving cycle" UBYTE OneToOne 1 100 0.00 255.0 FORMAT "%5.1" ECU_ADDRESS 0x60036148 /end MEASUREMENT
/begin MEASUREMENT Com_stFIDInhbnOld "old Status of Inhibition" UBYTE OneToOne 1 100 0.00 255.0 FORMAT "%5.1" ECU_ADDRESS 0x6000A090 /end MEASUREMENT
/begin MEASUREMENT Com_stFrzLvl "Freeze level" UBYTE OneToOne 1 100 0.00 255.0 FORMAT "%5.1" ECU_ADDRESS 0x6000A506 /end MEASUREMENT
/begin MEASUREMENT Com_stFrzUpd "Holds the Freeze data update notification" UBYTE OneToOne 1 100 0.00 3.000 FORMAT "%5.3" ECU_ADDRESS 0x600365E7 /end MEASUREMENT
/begin MEASUREMENT Com_stGbxNPosSFailEngT2 "Message for gear box Neutral Position failure for ENGT2 frame" UBYTE OneToOne 1 100 0.00 255.0 FORMAT "%5.1" ECU_ADDRESS 0x6000A503 /end MEASUREMENT
/begin MEASUREMENT Com_stIdxDelCntr_MP "measurement point" UBYTE OneToOne 1 100 0.00 255.0 FORMAT "%5.1" ECU_ADDRESS 0x70008D9E /end MEASUREMENT
/begin MEASUREMENT Com_stImsLmp "Immobilizer key lamp status" UBYTE OneToOne 1 100 0.00 255.0 FORMAT "%5.1" ECU_ADDRESS 0x6000A4EA /end MEASUREMENT
/begin MEASUREMENT Com_stLmp5AltIO "Lamp5 signal or Signal for Alternator is generating voltage" UBYTE OneToOne 1 100 0.00 255.0 FORMAT "%5.1" ECU_ADDRESS 0x6000A4E2 /end MEASUREMENT
/begin MEASUREMENT Com_stLmp5AltIOENGO "Message for Charge Lamp Request" UBYTE OneToOne 1 100 0.00 255.0 FORMAT "%5.1" ECU_ADDRESS 0x6000A08D /end MEASUREMENT
/begin MEASUREMENT Com_stOBSUpd "Holds the OBS update notification" UBYTE OneToOne 1 100 0.00 3.000 FORMAT "%5.3" ECU_ADDRESS 0x600365E6 /end MEASUREMENT
/begin MEASUREMENT Com_stOilLmp "Oil pressure warning lamp" UBYTE OneToOne 1 100 0.00 255.0 FORMAT "%5.1" ECU_ADDRESS 0x6000A4C9 /end MEASUREMENT
/begin MEASUREMENT Com_stOilLmpInfo "Oil pressure warning lamp status for multi information" UBYTE OneToOne 1 100 0.00 255.0 FORMAT "%5.1" ECU_ADDRESS 0x6000A4C8 /end MEASUREMENT
/begin MEASUREMENT Com_stOilLow "Low oil level status" UBYTE OneToOne 1 100 0.00 255.0 FORMAT "%5.1" ECU_ADDRESS 0x6000A4C7 /end MEASUREMENT
/begin MEASUREMENT Com_stPASensFail "PA Sensor Fail Status" UBYTE OneToOne 1 100 0.00 255.0 FORMAT "%5.1" ECU_ADDRESS 0x6000A4C6 /end MEASUREMENT
/begin MEASUREMENT Com_stSILClthSwt "Com message: Clutch switch state for SIL" UBYTE OneToOne 1 100 0.00 255.0 FORMAT "%5.1" ECU_ADDRESS 0x6000A4A8 /end MEASUREMENT
/begin MEASUREMENT Com_stSmotngFlag "Smoothing condition Flag" UBYTE OneToOne 1 100 0.00 255.0 BIT_MASK 0x1 FORMAT "%5.1" ECU_ADDRESS 0x6000A1A2 /end MEASUREMENT
/begin MEASUREMENT Com_stVINErrENGV2 "EEPROM Fail status" UBYTE OneToOne 1 100 0.00 255.0 FORMAT "%5.1" ECU_ADDRESS 0x6000A47E /end MEASUREMENT
/begin MEASUREMENT Com_stVINUnRegENGV2 "VIN resistance status" UBYTE OneToOne 1 100 0.00 255.0 FORMAT "%5.1" ECU_ADDRESS 0x6000A47D /end MEASUREMENT
/begin MEASUREMENT Com_stWarnOilLvl "Oil level sensor failure warning lamp" UBYTE OneToOne 1 100 0.00 255.0 FORMAT "%5.1" ECU_ADDRESS 0x6000A460 /end MEASUREMENT
/begin MEASUREMENT Com_stWrmUp40Cyc "40 wuc completed in dcy" UBYTE OneToOne 1 100 0.00 1.000 FORMAT "%5.3" ECU_ADDRESS 0x60037F7F /end MEASUREMENT
/begin MEASUREMENT Com_tAirCACDs "Message for FId" SWORD Temp_Cels 1 100 -3549.940 3003.560 FORMAT "%8.3" ECU_ADDRESS 0x60005186 /end MEASUREMENT
/begin MEASUREMENT Com_tCEngDsT "Received Coolant Temperature" SWORD Temp_Cels 1 100 -3549.940 3003.560 FORMAT "%8.3" ECU_ADDRESS 0x6000517E /end MEASUREMENT
/begin MEASUREMENT Com_ThrVlvActSens1AbsltB1 "absolute throttle position" UBYTE relDK_q0p3922 1 100 0.00 100.0 FORMAT "%5.1" ECU_ADDRESS 0x6000A63F /end MEASUREMENT
/begin MEASUREMENT Com_ThrVlvActSens1RelB1 "relative throttle position" UBYTE relDK_q0p3922 1 100 0.00 100.0 FORMAT "%5.1" ECU_ADDRESS 0x6000A63E /end MEASUREMENT
/begin MEASUREMENT Com_tiMiCumContGlb "Counter of external MIL occurence time" UWORD DSMDUR_MICntr_COMPU 1 100 0.00 65535.00 FORMAT "%8.2" ECU_ADDRESS 0x60037F86 /end MEASUREMENT
/begin MEASUREMENT Com_trqDes "structure for conversion of parameter for torque" SLONG TrqCom 1 100 -429496729.600 429496729.400 FORMAT "%13.3" ECU_ADDRESS 0x60001D28 /end MEASUREMENT
/begin MEASUREMENT Com_trqEng "Engine Torque" SWORD TrqCom 1 100 -6553.600 6553.400 FORMAT "%8.3" ECU_ADDRESS 0x60005162 /end MEASUREMENT
/begin MEASUREMENT Com_trqEngENGT2 "Engine torque for ENGT2 frame" SLONG RBPtCel_tq_1p0_1 1 100 -2147483648.00 2147483647.00 FORMAT "%13.2" ECU_ADDRESS 0x50004C18 /end MEASUREMENT
/begin MEASUREMENT Com_trqEngENGT2Temp "Tempory Engine torque for ENGT2 frame" SLONG trq_q0p1 1 100 -214748364.800 214748364.700 FORMAT "%13.3" ECU_ADDRESS 0x60001DC8 /end MEASUREMENT
/begin MEASUREMENT Com_uBattDetnENGECU "Battery detection voltage value of ENG-ECU" UWORD q0p01_V 1 100 0.00 40.95000 FORMAT "%8.5" ECU_ADDRESS 0x60004D5A /end MEASUREMENT
/begin MEASUREMENT Com_uIG1DetnENGECU "IG1 detection voltage value of ENG-ECU" UWORD q0p01_V 1 100 0.00 40.95000 FORMAT "%8.5" ECU_ADDRESS 0x60004D54 /end MEASUREMENT
/begin MEASUREMENT Com_vhegfe "VTEC switching status" UBYTE OneToOne 1 100 0.00 255.0 FORMAT "%5.1" ECU_ADDRESS 0x6000A453 /end MEASUREMENT
/begin MEASUREMENT Com_volFlConsAdd "Consumed fuel volume for ENGB frame" SLONG OneToOne 1 100 -2147483648.00 2147483647.00 FORMAT "%13.2" ECU_ADDRESS 0x50004C1C /end MEASUREMENT
/begin MEASUREMENT Com_vVeh "Vehicle speed from CAN-bus" SWORD Vel 1 100 -327.6800 327.6700 FORMAT "%8.4" ECU_ADDRESS 0x60005152 /end MEASUREMENT
/begin MEASUREMENT Com_vVeh2 "Vehicle speed from Kombi 1 Message" SWORD Vel 1 100 -327.6800 327.6700 FORMAT "%8.4" ECU_ADDRESS 0x60005154 /end MEASUREMENT
/begin MEASUREMENT EngECU_numDTCFrzHi "HIGH Byte of DTC of Freeze signal" UBYTE OneToOne 1 100 0.00 255.0 FORMAT "%5.1" ECU_ADDRESS 0x6000A3B8 /end MEASUREMENT
/begin MEASUREMENT EngECU_numDTCFrzLo "Low Byte of DTC of Freeze signal" UBYTE OneToOne 1 100 0.00 255.0 FORMAT "%5.1" ECU_ADDRESS 0x6000A3B7 /end MEASUREMENT
/begin MEASUREMENT EngICO_nCtOff "Maximum setpoint speed for masking the injections via the engine-speed controller (Comfort ICO)" SWORD nmot_q0p5 1 100 -16384.00 16383.50 FORMAT "%8.2" ECU_ADDRESS 0x600050B2 /end MEASUREMENT
/begin MEASUREMENT EngICO_nMaxApp "Engine sped value dependent on App" UBYTE relPED_ub_b100 1 100 0.00 100.0 FORMAT "%5.1" ECU_ADDRESS 0x6000655E /end MEASUREMENT
/begin MEASUREMENT EngICO_nMaxV "Engine sped value dependent on Velocity" SWORD vel_q0p01 1 100 -327.6800 327.6700 FORMAT "%8.4" ECU_ADDRESS 0x60003A8A /end MEASUREMENT
/begin MEASUREMENT EngICO_stICO "Demand for masking the injections via the shut-off coordinator (standard ICO)" UBYTE OneToOne 1 100 0.00 255.0 FORMAT "%5.1" ECU_ADDRESS 0x6000A3B6 /end MEASUREMENT
/begin MEASUREMENT EngPrt_bLimOvrSpd "Condition: Engine speed limitation active" UBYTE B_TRUE 1 100 0.00 1.00000000000 BIT_MASK 0x1 FORMAT "%13.11" ECU_ADDRESS 0x7000080D /end MEASUREMENT
/begin MEASUREMENT EngPrt_bOvhtEngLim "Motordrehzahlbegrenzung für Überhitzungsschutz im Stillstand aktiv" UBYTE B_TRUE 1 100 0.00 1.00000000000 BIT_MASK 0x1 FORMAT "%13.11" ECU_ADDRESS 0x7000080C /end MEASUREMENT
/begin MEASUREMENT EngPrt_flgActv "function activation flag" UBYTE B_TRUE 1 100 0.00 1.00000000000 BIT_MASK 0x1 FORMAT "%13.11" ECU_ADDRESS 0x6000655D /end MEASUREMENT
/begin MEASUREMENT EngPrt_flgBltDrvVbrDampr "Belt drive vibration damper set condition for torque limitation" UBYTE B_TRUE 1 100 0.00 1.00000000000 BIT_MASK 0x1 FORMAT "%13.11" ECU_ADDRESS 0x6000655C /end MEASUREMENT
/begin MEASUREMENT EngPrt_flgBltDrvVbrDamprFF_I.status "FlipFlop to setor reset the limitation / current value of RS-FF" UBYTE B_TRUE 1 100 0.00 1.00000000000 BIT_MASK 0x1 FORMAT "%13.11" ECU_ADDRESS 0x6000655B /end MEASUREMENT
/begin MEASUREMENT EngPrt_flgDiagErrHeal "Condition : Fault heal, when max critical engine speed has not occurred" UBYTE B_TRUE 1 100 0.00 1.00000000000 BIT_MASK 0x1 FORMAT "%13.11" ECU_ADDRESS 0x70000280 /end MEASUREMENT
/begin MEASUREMENT EngPrt_flgDsmClr "DSM clear flag (synchronisation of operations within the DSM clear and the 200ms task)" UBYTE B_TRUE 1 100 0.00 1.00000000000 BIT_MASK 0x1 FORMAT "%13.11" ECU_ADDRESS 0x7000027F /end MEASUREMENT
/begin MEASUREMENT EngPrt_flgErrHealCfmd "Condition : Error healing is confirmed" UBYTE B_TRUE 1 100 0.00 1.00000000000 BIT_MASK 0x1 FORMAT "%13.11" ECU_ADDRESS 0x7000027E /end MEASUREMENT
/begin MEASUREMENT EngPrt_flgFallEdgeFF_I.status "FlipFlop to select the reset path / current value of RS-FF" UBYTE B_TRUE 1 100 0.00 1.00000000000 BIT_MASK 0x1 FORMAT "%13.11" ECU_ADDRESS 0x6000655A /end MEASUREMENT
/begin MEASUREMENT EngPrt_flgNxtCyc "Condition : Next driving cycle" UBYTE B_TRUE 1 100 0.00 1.00000000000 BIT_MASK 0x1 FORMAT "%13.11" ECU_ADDRESS 0x7000027D /end MEASUREMENT
/begin MEASUREMENT EngPrt_flgOverSpd "Condition: Engine overspeed" UBYTE B_TRUE 1 100 0.00 1.00000000000 BIT_MASK 0x1 FORMAT "%13.11" ECU_ADDRESS 0x7000080B /end MEASUREMENT
/begin MEASUREMENT EngPrt_flgTqThdTONVNM_I.time "Turn on delay to avoid toggling / Delay Time" UWORD t_q0p01 1 100 0.00 655.3500 FORMAT "%8.4" ECU_ADDRESS 0x60003A88 /end MEASUREMENT
/begin MEASUREMENT EngPrt_flgtrqLimEngLoTempActvn_MP "Release condition for limiting the torque during engine low temperature" UBYTE B_TRUE 1 100 0.00 1.00000000000 BIT_MASK 0x1 FORMAT "%13.11" ECU_ADDRESS 0x70008D93 /end MEASUREMENT
/begin MEASUREMENT EngPrt_nMaxOvhtFF_I.status "Debouncing of set condition for overheat protection (during vehicle standstill) / current value of RS-FF" UBYTE B_TRUE 1 100 0.00 1.00000000000 BIT_MASK 0x1 FORMAT "%13.11" ECU_ADDRESS 0x60006559 /end MEASUREMENT
/begin MEASUREMENT EngPrt_nMaxOvhtOffTONV_I.outbit "Debouncing of reset condition for overheat protection (during vehicle standstill) / return value" UBYTE B_TRUE 1 100 0.00 1.00000000000 BIT_MASK 0x1 FORMAT "%13.11" ECU_ADDRESS 0x6000D8B6 /end MEASUREMENT
/begin MEASUREMENT EngPrt_nMaxOvhtOffTONV_I.time "Debouncing of reset condition for overheat protection (during vehicle standstill) / expired delay time" UWORD t_q0p01 1 100 0.00 655.3500 FORMAT "%8.4" ECU_ADDRESS 0x6000D8B8 /end MEASUREMENT
/begin MEASUREMENT EngPrt_nMaxOvhtTONV_I.outbit "FlipFlop for engine speed limitation due to overheat protection (during vehicle standstill) / return value" UBYTE B_TRUE 1 100 0.00 1.00000000000 BIT_MASK 0x1 FORMAT "%13.11" ECU_ADDRESS 0x6000D8BA /end MEASUREMENT
/begin MEASUREMENT EngPrt_nMaxOvhtTONV_I.time "FlipFlop for engine speed limitation due to overheat protection (during vehicle standstill) / expired delay time" UWORD t_q0p01 1 100 0.00 655.3500 FORMAT "%8.4" ECU_ADDRESS 0x6000D8BC /end MEASUREMENT
/begin MEASUREMENT EngPrt_nOvhtEngLim "Motordrehzahlgrenzwert für Überhitzungsschutz im Stillstand" SWORD EngN 1 100 -16384.00 16383.50 FORMAT "%8.2" ECU_ADDRESS 0x70002C36 /end MEASUREMENT
/begin MEASUREMENT EngPrt_NOvhtEngLimSW_I.timeCounter "Stop-watch time calculation after start of engine-speed limitaiton due to overheat protection / expired time since start" UWORD Time_s 1 100 0.00 655.3500 FORMAT "%8.4" ECU_ADDRESS 0x60003A84 /end MEASUREMENT
/begin MEASUREMENT EngPrt_nrNMaxFlt "Counter for exceedings of critical engine speed" UWORD OneToOne 1 100 0.00 65535.00 FORMAT "%8.2" ECU_ADDRESS 0x600048F2 /end MEASUREMENT
/begin MEASUREMENT EngPrt_pwrIntMax_MP "Target value for power limitation" SLONG Pwr_kW 1 100 -21474836.4800 21474836.4700 FORMAT "%13.4" ECU_ADDRESS 0x70008D94 /end MEASUREMENT
/begin MEASUREMENT EngPrt_pwrLimOvht "Power limitation due to high temperatures" SLONG Pwr_kW 1 100 0.00 21474836.4700 FORMAT "%13.4" ECU_ADDRESS 0x70002A40 /end MEASUREMENT
/begin MEASUREMENT EngPrt_stOvrSpd "State of overspeed" UBYTE OneToOne 1 100 0.00 255.0 FORMAT "%5.1" ECU_ADDRESS 0x6000A070 /end MEASUREMENT
/begin MEASUREMENT EngPrt_tiNOvhtEngLim "Time after start of engine-speed limitaiton due to overheat protection" UWORD Time_s 1 100 0.00 655.3500 FORMAT "%8.4" ECU_ADDRESS 0x60003A86 /end MEASUREMENT
/begin MEASUREMENT EngPrt_tqBltDrvVbrDampr "Belt drive vibration damper torque limitation" SWORD Trq 1 100 0.00 3276.700 FORMAT "%8.3" ECU_ADDRESS 0x600050B0 /end MEASUREMENT
/begin MEASUREMENT EngPrt_trqLim "Limitation torque for engine mechanic protection by torque limitation (as inner engine torque)" SWORD Trq 1 100 0.00 3276.700 FORMAT "%8.3" ECU_ADDRESS 0x600050AE /end MEASUREMENT
/begin MEASUREMENT EngPrt_trqLimLead "Resulting limiting torque engine protection lead path" SWORD Trq 1 100 0.00 3276.700 FORMAT "%8.3" ECU_ADDRESS 0x600050AC /end MEASUREMENT
/begin MEASUREMENT EngPrt_trqLimMech "Torque limitation due to NMAX-limitation" SWORD Trq 1 100 -3276.800 3276.700 FORMAT "%8.3" ECU_ADDRESS 0x600050AA /end MEASUREMENT
/begin MEASUREMENT EngPrt_trqLimMechLead "Torque limitation (Leadpath) due to NMAX-limitation" SWORD Trq 1 100 -3276.800 3276.700 FORMAT "%8.3" ECU_ADDRESS 0x600050A8 /end MEASUREMENT
/begin MEASUREMENT EngPrt_trqLimOvhtPrv "Torque limitation due to high temperatures" SWORD Trq 1 100 0.00 3276.700 FORMAT "%8.3" ECU_ADDRESS 0x600050A6 /end MEASUREMENT
/begin MEASUREMENT EngReq_trqLim "Torque limitation due to engine requests" SWORD Trq 1 100 0.00 3276.700 FORMAT "%8.3" ECU_ADDRESS 0x600050A4 /end MEASUREMENT
/begin MEASUREMENT EngReq_trqLimLead "Torque limitation (Lead-path) dur to engine requests" SWORD Trq 1 100 0.00 3276.700 FORMAT "%8.3" ECU_ADDRESS 0x600050A2 /end MEASUREMENT
/begin MEASUREMENT EngStrt_cntrRstrtEve "(rolling) counter for restart-events" UBYTE OneToOne 1 100 0.00 255.0 FORMAT "%5.1" ECU_ADDRESS 0x6000A3B5 /end MEASUREMENT
/begin MEASUREMENT EngStrt_EomStrt_I.stOperMod "Class instance for interface between the start coordinator and CoEng / Priority-element of the operation mode structure" ULONG OneToOne 1 100 0.00 4294967295.00 FORMAT "%13.2" ECU_ADDRESS 0x6000020C /end MEASUREMENT
/begin MEASUREMENT EngStrt_EomStrt_I.stOperModPrio "Class instance for interface between the start coordinator and CoEng / Stage-element of the operation mode structure" UBYTE OneToOne 1 100 0.00 255.0 FORMAT "%5.1" ECU_ADDRESS 0x60000210 /end MEASUREMENT
/begin MEASUREMENT EngStrt_EomStrt_I.stOperModStg "Class instance for interface between the start coordinator and CoEng / Operation-mode element of the operation mode structure" UWORD OneToOne 1 100 0.00 65535.00 FORMAT "%8.2" ECU_ADDRESS 0x60000212 /end MEASUREMENT
/begin MEASUREMENT EngStrt_flgComReqd "change of mind was requested (by combustion engine start coordinator)" UBYTE B_TRUE 1 100 0.00 1.00000000000 BIT_MASK 0x1 FORMAT "%13.11" ECU_ADDRESS 0x70000805 /end MEASUREMENT
/begin MEASUREMENT EngStrt_flgDisblNewSyncActv "Re-synchro prohibition active" UBYTE OneToOne 1 100 0.00 1.000 BIT_MASK 0x1 FORMAT "%5.3" ECU_ADDRESS 0x60006558 /end MEASUREMENT
/begin MEASUREMENT EngStrt_flgDisblNewSyncActvOld "Flag to disable new sync active old" UBYTE OneToOne 1 100 0.00 1.000 BIT_MASK 0x1 FORMAT "%5.3" ECU_ADDRESS 0x60006557 /end MEASUREMENT
/begin MEASUREMENT EngStrt_flgDisblNewSyncLtq "condition disable new synchonization in post drive" UBYTE OneToOne 1 100 0.00 1.000 BIT_MASK 0x1 FORMAT "%5.3" ECU_ADDRESS 0x60006556 /end MEASUREMENT
/begin MEASUREMENT EngStrt_flgEngStall "Condition for engine stall" UBYTE B_TRUE 1 100 0.00 1.00000000000 BIT_MASK 0x1 FORMAT "%13.11" ECU_ADDRESS 0x7000027C /end MEASUREMENT
/begin MEASUREMENT EngStrt_flgEngStallg "Condition egine stalling detected" UBYTE B_TRUE 1 100 0.00 1.00000000000 BIT_MASK 0x1 FORMAT "%13.11" ECU_ADDRESS 0x70000803 /end MEASUREMENT
/begin MEASUREMENT EngStrt_flgEngStrtOrd "detection of start order for the start coordination" UBYTE B_TRUE 1 100 0.00 1.00000000000 BIT_MASK 0x1 FORMAT "%13.11" ECU_ADDRESS 0x70000802 /end MEASUREMENT
/begin MEASUREMENT EngStrt_flgInjProhb "Injection Prohibition during start" UBYTE B_TRUE 1 100 0.00 1.00000000000 BIT_MASK 0x1 FORMAT "%13.11" ECU_ADDRESS 0x70000801 /end MEASUREMENT
/begin MEASUREMENT EngStrt_flgRePrio "Start reprioritisation" UBYTE B_TRUE 1 100 0.00 1.00000000000 BIT_MASK 0x1 FORMAT "%13.11" ECU_ADDRESS 0x700007FD /end MEASUREMENT
/begin MEASUREMENT EngStrt_flgRePrioEngStrtg "repriorisation at engine starting" UBYTE B_TRUE 1 100 0.00 1.00000000000 BIT_MASK 0x1 FORMAT "%13.11" ECU_ADDRESS 0x7000027B /end MEASUREMENT
/begin MEASUREMENT EngStrt_flgReStrtCoMReqd "Restart-Task Change-of-Mind requested (but not yet executed)" UBYTE B_TRUE 1 100 0.00 1.00000000000 BIT_MASK 0x1 FORMAT "%13.11" ECU_ADDRESS 0x700007FC /end MEASUREMENT
/begin MEASUREMENT EngStrt_flgReStrtStpReqd "Restart-Task Stopped Engine requested (but not yet executed)" UBYTE B_TRUE 1 100 0.00 1.00000000000 BIT_MASK 0x1 FORMAT "%13.11" ECU_ADDRESS 0x700007FB /end MEASUREMENT
/begin MEASUREMENT EngStrt_flgReStrtStrtReqd "Restart-Task at Engine Start requested (but not yet executed)" UBYTE B_TRUE 1 100 0.00 1.00000000000 BIT_MASK 0x1 FORMAT "%13.11" ECU_ADDRESS 0x700007FA /end MEASUREMENT
/begin MEASUREMENT EngStrt_flgStrtAbort "Start abort" UBYTE B_TRUE 1 100 0.00 1.00000000000 BIT_MASK 0x1 FORMAT "%13.11" ECU_ADDRESS 0x700007F8 /end MEASUREMENT
/begin MEASUREMENT EngStrt_flgStrtEna "Current start type is active" UBYTE B_TRUE 1 100 0.00 1.00000000000 BIT_MASK 0x1 FORMAT "%13.11" ECU_ADDRESS 0x7000027A /end MEASUREMENT
/begin MEASUREMENT EngStrt_flgStrtEnaCoMRunng "start type ENGSTRT_COMRUNNG is possible" UBYTE B_TRUE 1 100 0.00 1.00000000000 BIT_MASK 0x1 FORMAT "%13.11" ECU_ADDRESS 0x70000279 /end MEASUREMENT
/begin MEASUREMENT EngStrt_flgStrtEnaCoMStrtg "start type ENGSTRT_COMSTRTG is possible" UBYTE B_TRUE 1 100 0.00 1.00000000000 BIT_MASK 0x1 FORMAT "%13.11" ECU_ADDRESS 0x70000278 /end MEASUREMENT
/begin MEASUREMENT EngStrt_flgStrtEnaCoMWait "start type ENGSTRT_COMWAITSTRTR is possible" UBYTE B_TRUE 1 100 0.00 1.00000000000 BIT_MASK 0x1 FORMAT "%13.11" ECU_ADDRESS 0x70000277 /end MEASUREMENT
/begin MEASUREMENT EngStrt_flgStrtFaild "failed start is detected" UBYTE B_TRUE 1 100 0.00 1.00000000000 BIT_MASK 0x1 FORMAT "%13.11" ECU_ADDRESS 0x700007F3 /end MEASUREMENT
/begin MEASUREMENT EngStrt_flgTrigRstrtCom "trigger Restart-Task in case of Change-of-Mind" UBYTE B_TRUE 1 100 0.00 1.00000000000 BIT_MASK 0x1 FORMAT "%13.11" ECU_ADDRESS 0x700007F1 /end MEASUREMENT
/begin MEASUREMENT EngStrt_stInjRelsStrtg "Status injection release during start" UBYTE OneToOne 1 100 0.00 255.0 FORMAT "%5.1" ECU_ADDRESS 0x6000A3B2 /end MEASUREMENT
/begin MEASUREMENT EngStrt_stListCoMRunng "Assignment of ENGSTRT_COMRUNNG in the priority lists" UBYTE OneToOne 1 100 0.00 255.0 FORMAT "%5.1" ECU_ADDRESS 0x60006555 /end MEASUREMENT
/begin MEASUREMENT EngStrt_stListCoMStrtg "Assignment of ENGSTRT_COMSTRTG in the priority lists" UBYTE OneToOne 1 100 0.00 255.0 FORMAT "%5.1" ECU_ADDRESS 0x60006554 /end MEASUREMENT
/begin MEASUREMENT EngStrt_stListCoMWaitStrtr "Assignment of ENGSTRT_COMWAITSTRTR in the priority lists" UBYTE OneToOne 1 100 0.00 255.0 FORMAT "%5.1" ECU_ADDRESS 0x60006553 /end MEASUREMENT
/begin MEASUREMENT EngStrt_stListFolw "Assignment of ENGSTRT_FOLW in the priority lists" UBYTE OneToOne 1 100 0.00 255.0 FORMAT "%5.1" ECU_ADDRESS 0x60006552 /end MEASUREMENT
/begin MEASUREMENT EngStrt_stListPfi "Assignment of ENGSTRT_PFI in the priority lists" UBYTE OneToOne 1 100 0.00 255.0 FORMAT "%5.1" ECU_ADDRESS 0x60006551 /end MEASUREMENT
/begin MEASUREMENT EngStrt_stRstrtRsn "reason for last call of ReStartTask" UBYTE EngStrt_stRstrtRsn_VERB 1 100 0.00 5.00000000000 FORMAT "%13.11" ECU_ADDRESS 0x6000A3B1 /end MEASUREMENT
/begin MEASUREMENT EngStrt_stRstrtStgy "restart strategy in case of Change of Mind" UBYTE EngStrt_stRstrtStgy_VERB 1 100 0.00 4.00000000000 FORMAT "%13.11" ECU_ADDRESS 0x6000A760 /end MEASUREMENT
/begin MEASUREMENT EngStrt_stStrtAvlAry "Array available start type" UWORD ENGSTRT_STSTRTREQ_SET_COMPU_VERB 1 100 0.00 16384.0000000 FORMAT "%13.7" ARRAY_SIZE 6 ECU_ADDRESS 0x50005338 /end MEASUREMENT
/begin MEASUREMENT EngStrt_stStrtPrio "Priority of the selected start type" UWORD OneToOne 1 100 0.00 65535.00 FORMAT "%8.2" ECU_ADDRESS 0x60003A82 /end MEASUREMENT
/begin MEASUREMENT EngStrt_stStrtReq "Start type from the start coordinator" UWORD ENGSTRT_STSTRTREQ_SET_COMPU_VERB 1 100 0.00 16384.0000000 FORMAT "%13.7" ECU_ADDRESS 0x6000E1D2 /end MEASUREMENT
/begin MEASUREMENT EngStrt_stStrtReqLoc "Start type from the start coordinator (local variable)" UWORD ENGSTRT_STSTRTREQ_SET_COMPU_VERB 1 100 0.00 16384.0000000 FORMAT "%13.7" ECU_ADDRESS 0x60003A80 /end MEASUREMENT
/begin MEASUREMENT EngStrt_stStrtSit "engine start situation (first start, following start, change of mind...)" UBYTE OneToOne 1 100 0.00 255.0 FORMAT "%5.1" ECU_ADDRESS 0x6000E413 /end MEASUREMENT
/begin MEASUREMENT EngStrt_tiDisblNewSyncMax "time counter: duration of DisblNewSync" UWORD ti_s_q0p01_COMPU 1 100 0.00 655.3500 FORMAT "%8.4" ECU_ADDRESS 0x600365E4 /end MEASUREMENT
/begin MEASUREMENT Lin_Alt_Signal_AdjVltgDem_6_w_msg "Adjusting voltage LIN raw value" UBYTE OneToOne 1 100 0.00 255.0 FORMAT "%5.1" ECU_ADDRESS 0x6000A361 /end MEASUREMENT
/begin MEASUREMENT Lin_Alt_Signal_DbgInfoTx_3_w_msg "Debug information for transmission LIN raw value" UBYTE OneToOne 1 100 0.00 255.0 FORMAT "%5.1" ECU_ADDRESS 0x6000A360 /end MEASUREMENT
/begin MEASUREMENT Lin_Alt_Signal_DeMagCnclSpd_4_w_msg "Gradual Excitation Cancel Speed LIN raw value" UBYTE OneToOne 1 100 0.00 255.0 FORMAT "%5.1" ECU_ADDRESS 0x6000A35F /end MEASUREMENT
/begin MEASUREMENT Lin_Alt_Signal_DeMagTime_4_w_msg "Gradual Excitation time LIN raw value" UBYTE OneToOne 1 100 0.00 255.0 FORMAT "%5.1" ECU_ADDRESS 0x6000A35E /end MEASUREMENT
/begin MEASUREMENT Lin_Alt_Signal_MagCrntLim_8_w_msg "Excitation Current Limitation LIN raw value" UBYTE OneToOne 1 100 0.00 255.0 FORMAT "%5.1" ECU_ADDRESS 0x6000A35D /end MEASUREMENT
/begin MEASUREMENT Lin_BS_B_Signal_BattID_8_w_msg "Battery ID LIN raw value" UBYTE OneToOne 1 100 0.00 255.0 FORMAT "%5.1" ECU_ADDRESS 0x6000A35C /end MEASUREMENT
/begin MEASUREMENT Lin_BS_B_Signal_T15_st_1_w_msg "IG1 ONOFF LIN raw value" UBYTE B_TRUE 1 100 0.00 1.00000000000 BIT_MASK 0x1 FORMAT "%13.11" ECU_ADDRESS 0x6000A177 /end MEASUREMENT
/begin MEASUREMENT Lin_BS_Signal_B_BitEna_1_w_msg "Enable flag raw value" UBYTE B_TRUE 1 100 0.00 1.00000000000 BIT_MASK 0x1 FORMAT "%13.11" ECU_ADDRESS 0x6000A176 /end MEASUREMENT
/begin MEASUREMENT Lin_BS_Signal_B_LINTypTx_4_w_msg "LIN format raw value" UBYTE OneToOne 1 100 0.00 255.0 FORMAT "%5.1" ECU_ADDRESS 0x6000A350 /end MEASUREMENT
/begin MEASUREMENT Lin_BS_Signal_B_ReLrngReq_st_1_w_msg "Relearning request state raw value" UBYTE B_TRUE 1 100 0.00 1.00000000000 BIT_MASK 0x1 FORMAT "%13.11" ECU_ADDRESS 0x6000A175 /end MEASUREMENT
/begin MEASUREMENT MoX_nMaxICOMsg "Engine speed threshold at disabled throttle control by monitoring function" SWORD EngN 1 100 -16384.00 16383.50 FORMAT "%8.2" ECU_ADDRESS 0x6000E296 /end MEASUREMENT
/begin MEASUREMENT ndcdis_w_msg "engine speed threshold at disabled throttle control by monitoring function" UWORD nmot_uw_q0p25 1 100 0.00 16383.75 FORMAT "%8.2" ECU_ADDRESS 0x60004BC8 /end MEASUREMENT
/begin FUNCTION EngECU_ENGAE "3.4.0_6SAASignal processing of message ENGAE"
 /begin OUT_MEASUREMENT Com_cntBankFrozenNew Com_cntBankFrozenNewOld Com_ctCRingENGAE Com_numCsumENGAE Com_numIdxDFC Com_stBankFrozen Com_stBankFrozenNew Com_stBankFrozenNewOld Com_stDTCUpd Com_stFrzUpd Com_stOBSUpd /end OUT_MEASUREMENT
 /begin LOC_MEASUREMENT Com_cntDTCCfmdOld Com_cntDTCPendingOld Com_cntOBSOld Com_numCurrfrzDFC Com_numCurrfrzDFCOld Com_numIdxDFCOld /end LOC_MEASUREMENT
 FUNCTION_VERSION "3.4.0_6SAA" /end FUNCTION
/begin FUNCTION EngECU_EngB "18.7.0_1.0.0Transmission process for the CAN frame Engine B"
 /begin DEF_CHARACTERISTIC Com_dENGBSigSel_C Com_facFlConsAdd_C Com_numTCUMilReqDFC_CA Com_stBlkSensWaEna_C Com_swtImsLmpDisbl_C Com_tiOilLmpOff_C Com_tTFixSensFail_C /end DEF_CHARACTERISTIC
 /begin IN_MEASUREMENT Air_tCACDs AltIO_stCon CEngDsT_t CoDsplCtl_stLmp5Out CoDsplCtl_stOilLmp CoDsplCtl_stOilLmpInfo CrCtl_rACCTxEstSlp I14229_stABSFailCnclActv InjSys_volFuConsDrvCycCAN Sia_stOK SyC_ctPostDrvLeave SysDiag_flgCModJdg T15_st Tra_stEcoLmpIdc /end IN_MEASUREMENT
 /begin OUT_MEASUREMENT Com_ctCRingENGB Com_ctIdxCptr Com_dIdxDFESEntry Com_flgTCUMilReqDFCErase Com_numCsumENGB Com_numTCUMilReqDFC Com_rACCTxEstSlp Com_stEMTestModEna Com_stEngWrmUp40CycWoFail Com_stImsLmp Com_stLmp5AltIO Com_stOilLmp Com_stOilLmpInfo Com_stWrmUp40Cyc Com_tAirCACDs Com_tCEngDsT Com_volFlConsAdd /end OUT_MEASUREMENT
 /begin LOC_MEASUREMENT Com_stIdxDelCntr_MP /end LOC_MEASUREMENT
 FUNCTION_VERSION "18.7.0_1.0.0" /end FUNCTION
/begin FUNCTION EngECU_EngC "12.1.0_6SAATransmission process for the CAN frame Engine C" /begin DEF_CHARACTERISTIC Com_VehVFltMin_C /end DEF_CHARACTERISTIC /begin IN_MEASUREMENT Com_vVehCtl GlbDa_lTotDst PT_stTraType VehV_v /end IN_MEASUREMENT
 /begin OUT_MEASUREMENT Com_ctCRingENGC Com_lTotRing Com_numCsumENGC Com_vVeh Com_vVeh2 /end OUT_MEASUREMENT
 FUNCTION_VERSION "12.1.0_6SAA" /end FUNCTION
/begin FUNCTION EngECU_EngD "6.1.0_6SAATransmission process for the CAN frame Engine D" /begin OUT_MEASUREMENT Com_ctCRingENGD Com_numCsumENGD /end OUT_MEASUREMENT FUNCTION_VERSION "6.1.0_6SAA" /end FUNCTION
/begin FUNCTION EngECU_EngE "6.1.0_6SAATransmission process for the CAN frame Engine E" /begin OUT_MEASUREMENT Com_ctCRingENGE Com_numCsumENGE /end OUT_MEASUREMENT FUNCTION_VERSION "6.1.0_6SAA" /end FUNCTION
/begin FUNCTION EngECU_EngF "8.2.0_6SAATransmission process for the CAN frame Engine F"
 /begin IN_MEASUREMENT BrkPed_flgISABReq BrkPed_flgSwtISABAvl BrkPed_pForISABIdleStop /end IN_MEASUREMENT
 /begin OUT_MEASUREMENT Com_ctCRingENGF Com_flgISABReq Com_numCsumENGF Com_pforISABIdleStop /end OUT_MEASUREMENT
 FUNCTION_VERSION "8.2.0_6SAA" /end FUNCTION
/begin FUNCTION EngECU_EngHIP1 "6.2.0_6SAATransmission process for the CAN frame EngHIP1" /begin DEF_CHARACTERISTIC Com_stHIP1Visibility_CA /end DEF_CHARACTERISTIC /begin IN_MEASUREMENT Com_stLmp5AltIO Com_stMILMul T15_st /end IN_MEASUREMENT
 /begin OUT_MEASUREMENT Com_ctCRingENGHIP1 Com_numCsumENGHIP1 Com_numDTCHi Com_numDTCLo Com_stDTCMem Com_stDTCTyp /end OUT_MEASUREMENT
 FUNCTION_VERSION "6.2.0_6SAA" /end FUNCTION
/begin FUNCTION EngECU_EngIMG1 "714.0.0_1.0.0Transmission process for the CAN frame Engine IMG1 (Integrated Management Gateway 1)" /begin IN_MEASUREMENT BattU_stEngCmbCmpl BattU_uSnsrFild T15_st /end IN_MEASUREMENT
 /begin OUT_MEASUREMENT Com_ctCRingENGIMG1 Com_numCsumENGIMG1 Com_stENGECUIG1 Com_stFailrDetn Com_uBattDetnENGECU Com_uIG1DetnENGECU /end OUT_MEASUREMENT
 FUNCTION_VERSION "714.0.0_1.0.0" /end FUNCTION
/begin FUNCTION EngECU_EngJ "16.2.0_6SAATransmission process for the CAN frame Engine J" /begin DEF_CHARACTERISTIC Com_tiFlFWLvlLmp_C Com_tiOilLowOn_C /end DEF_CHARACTERISTIC
 /begin IN_MEASUREMENT B_vhegfe CoDsplCtl_stLmp4Out OilSwmpT_tDispl OilSwmpT_tMtrDisp Oil_stOilLow T15_st /end IN_MEASUREMENT
 /begin OUT_MEASUREMENT Com_ctCRingENGJ Com_numCsumENGJ Com_stEngBrkOvrdInfo Com_stEngBrkOvrdMtr Com_stOilLow Com_stWarnOilLvl Com_vhegfe /end OUT_MEASUREMENT
 FUNCTION_VERSION "16.2.0_6SAA" /end FUNCTION
/begin FUNCTION EngECU_EngK "18.3.0_6SAATransmission process for the CAN frame Engine K"
 /begin DEF_CHARACTERISTIC Com_dENGK3SigSel_C Com_nEngSpdRampNeg_C Com_nEngSpdRampPos_C Com_nstatThdXHysHi_C Com_nstatThdXHysLo_C Com_nstatThdYHysHi_C Com_nstatThdYHysLo_C Com_rAppHysHi_C Com_rAppHysLo_C Com_stDrvModDisp_C Com_swtSmotngCtrl_C Com_tiEngSpdPT1_C Com_tiSmotngFlag_C Com_vVehSpdHysHi_C Com_vVehSpdHysLo_C /end DEF_CHARACTERISTIC
 /begin IN_MEASUREMENT APP_r CoEng_st CoVOM_bSSEEngStopPassed Eep_EnvRamInvld Epm_nEng nstat T15_st VehV_v /end IN_MEASUREMENT
 /begin OUT_MEASUREMENT Com_ctCRingENGK Com_nEngSpdSmotng Com_numCsumENGK Com_stAutoSta1DCY Com_stAutoSta1DCYOld Com_stAutoSta2DCY Com_stAutoSta2DCYInterStrt Com_stAutoSta2DCYOld Com_stAutoStaInfo Com_stAutoStaInfoMtr Com_stDrvModDisp Com_stEngSpdThdX Com_stEngSpdThdY Com_stSmotngFlag /end OUT_MEASUREMENT
 /begin LOC_MEASUREMENT Com_nEngSpdSmotng_MP Com_nEngSpd_MP /end LOC_MEASUREMENT
 FUNCTION_VERSION "18.3.0_6SAA" /end FUNCTION
/begin FUNCTION EngECU_EngL "6.1.0_6SAATransmission process for the CAN frame Engine L" /begin DEF_CHARACTERISTIC Com_ctCRingENGL_C Com_numCsumENGL_C /end DEF_CHARACTERISTIC
 /begin IN_MEASUREMENT AirMod_ratRelAirM DSMDur_tiMICumContGlb Eep_EnvRamInvld Epm_nEngRaw ErrLmp_stMIL PEnv_pRaw T15_st ThrVlv_ratActSens1AbsltB1_u8 ThrVlv_ratActSens1RelB1_u8 /end IN_MEASUREMENT
 /begin OUT_MEASUREMENT Com_ctCRingENGL Com_numCsumENGL Com_pEnvPRawENGL Com_stEngRtMilUpd Com_ThrVlvActSens1AbsltB1 Com_ThrVlvActSens1RelB1 /end OUT_MEASUREMENT
 /begin LOC_MEASUREMENT Com_tiMiCumContGlb /end LOC_MEASUREMENT
 FUNCTION_VERSION "6.1.0_6SAA" /end FUNCTION
/begin FUNCTION EngECU_EngN "11.3.0_6SAATransmission process for the CAN frame Engine N (ENGN)" /begin DEF_CHARACTERISTIC Com_dPhysAdr_C /end DEF_CHARACTERISTIC /begin IN_MEASUREMENT Com_stFrmTxEna T15_st /end IN_MEASUREMENT
 /begin OUT_MEASUREMENT Com_ctCRingENGN Com_ctFrmENGN Com_dDTCInfo Com_dDTCRaw1 Com_dDTCRaw2 Com_dDTCRaw3 Com_dPhysAdr Com_numCsumENGN /end OUT_MEASUREMENT
 FUNCTION_VERSION "11.3.0_6SAA" /end FUNCTION
/begin FUNCTION EngECU_EngO "15.5.0_6SAATransmission process for the CAN frame Engine O(ENGO)" /begin DEF_CHARACTERISTIC Com_dENGOSigSel_C Com_stEngRemSt_C /end DEF_CHARACTERISTIC
 /begin IN_MEASUREMENT AltIO_stCon Batt_flgDarkIAllwCondA CoDsplCtl_stLmp5Out Com_stFrmTxEna CoVeh_flgPtcShtOff CoVOM_bSSEEna Eep_EnvRamInvld EnvP_p OilLfT_stFailOilTSnsr SyC_ctPostDrvLeave T15_st /end IN_MEASUREMENT
 /begin OUT_MEASUREMENT Com_ctCRingENGO Com_numCsumENGO Com_stChkChgnSysInfo Com_stChrgnSys Com_stEngRemSt Com_stFIDInhbn Com_stFIDInhbnOld Com_stLmp5AltIOENGO Com_stPASensFail /end OUT_MEASUREMENT
 FUNCTION_VERSION "15.5.0_6SAA" /end FUNCTION
/begin FUNCTION EngECU_EngQ "9.1.0_6SAATransmission process for the CAN frame EngineQ(ENGQ)"
 /begin DEF_CHARACTERISTIC Com_ctCRingENGQ_C Com_dENGQSigSel_C Com_numCsumENGQ_C Com_stConvalch_CUR /end DEF_CHARACTERISTIC
 /begin IN_MEASUREMENT alchpct_msg /end IN_MEASUREMENT
 /begin OUT_MEASUREMENT Com_ctCRingENGQ Com_numCsumENGQ Com_stalchpct /end OUT_MEASUREMENT
 FUNCTION_VERSION "9.1.0_6SAA" /end FUNCTION
/begin FUNCTION EngECU_EngR "9.5.0_6SAATransmission process for the CAN frame Engine R" /begin DEF_CHARACTERISTIC Com_dENGRSigSel_C /end DEF_CHARACTERISTIC
 /begin IN_MEASUREMENT CrCtl_stActive CrCUI_stVehUn LLim_flgASLCtrlTmpHalt LLim_flgASLOverSpd LLim_numMETAlrm LLim_numMETMemSpd LLim_stActvLmp LLim_stMetCCMode1 LLim_stMetCCMode2 LLim_stMETVehUn /end IN_MEASUREMENT
 /begin OUT_MEASUREMENT Com_ctCRingENGR Com_numCsumENGR /end OUT_MEASUREMENT
 FUNCTION_VERSION "9.5.0_6SAA" /end FUNCTION
/begin FUNCTION EngECU_EngT "15.1.0_6SAACAN messages of the Engine ECU (ENGT)"
 /begin IN_MEASUREMENT ActMod_trqClth ASDrf_trqInrSet Com_stVSAInhbInfo Gbx_stNPos LsComp_tqSwilLossNotFild PT_stTraType RngMod_trqClthMin /end IN_MEASUREMENT
 /begin OUT_MEASUREMENT Com_ctCRingENGT Com_numCsumENGT Com_stENGTAYCAck Com_stENGTNPos Com_trqDes Com_trqEng /end OUT_MEASUREMENT
 /begin LOC_MEASUREMENT Com_stENGTTraType_mp /end LOC_MEASUREMENT
 FUNCTION_VERSION "15.1.0_6SAA" /end FUNCTION
/begin FUNCTION EngECU_EngT1 "5.1.0_6SAACAN messages of the Engine ECU 1 (ENGT)" /begin OUT_MEASUREMENT Com_ctCRingENGT1 Com_numCsumENGT1 /end OUT_MEASUREMENT FUNCTION_VERSION "5.1.0_6SAA" /end FUNCTION
/begin FUNCTION EngECU_EngT2 "9.9.0_6SAACAN messages of the Engine ECU (ENGT2)" /begin DEF_CHARACTERISTIC Com_dENGT2SigSel_C Com_ErrDeb_Tmr1ACh_C /end DEF_CHARACTERISTIC
 /begin IN_MEASUREMENT ActMod_trqClth APP_bTempErr APP_r APP_stSigSrc Clth2_st Clth_st Com_stVSAInh Com_stVSAInhbInfo Conv_trqOilPmpLoss Gbx_stAnaNPosnWoAlvChk Gbx_stRvsPos PT_stTraType T15_st /end IN_MEASUREMENT
 /begin OUT_MEASUREMENT Com_ctCRingENGT2 Com_numCsumENGT2 Com_stAYCFErr Com_stCCClthSwt Com_stEngBrkApp Com_stENGT2AYCAck Com_stENGT2NPos Com_stENGT2RvsPos Com_stGbxNPosSFailEngT2 Com_stSILClthSwt Com_trqEngENGT2 Com_trqEngENGT2Temp /end OUT_MEASUREMENT
 /begin LOC_MEASUREMENT Com_stENGT2TraType_mp /end LOC_MEASUREMENT
 FUNCTION_VERSION "9.9.0_6SAA" /end FUNCTION
/begin FUNCTION EngECU_EngU "12.1.0_6SAACAN messages of the Engine ECU (ENGU)" /begin OUT_MEASUREMENT Com_ctCRingENGU Com_numCsumENGU /end OUT_MEASUREMENT FUNCTION_VERSION "12.1.0_6SAA" /end FUNCTION
/begin FUNCTION EngECU_EngV2 "5.4.0_6SAATransmission process of the CAN frame ENGV2" /begin DEF_CHARACTERISTIC Com_dENGV2SigSel_C Com_xAsgnFrzSig_CA /end DEF_CHARACTERISTIC /begin REF_CHARACTERISTIC I14229_numReWrECUID_CA /end REF_CHARACTERISTIC
 /begin OUT_MEASUREMENT Com_ctCRingENGV2 Com_ctEngData Com_ctFrzSyn Com_nrEngByte1 Com_nrEngByte2 Com_nrEngByte3 Com_nrEngByte4 Com_nrEngByte5 Com_nrEngByte6 Com_numCsumENGV2 Com_stFrzLvl Com_stVINErrENGV2 Com_stVINUnRegENGV2 EngECU_numDTCFrzHi EngECU_numDTCFrzLo /end OUT_MEASUREMENT
 FUNCTION_VERSION "5.4.0_6SAA" /end FUNCTION
/begin FUNCTION EngECU_EngW "10.1.0_6SAACAN messages of the Engine ECU (ENGW)" /begin IN_MEASUREMENT Tra_stAmbLmp /end IN_MEASUREMENT /begin OUT_MEASUREMENT Com_ctCRingENGW Com_numCsumENGW /end OUT_MEASUREMENT FUNCTION_VERSION "10.1.0_6SAA" /end FUNCTION
/begin FUNCTION EngECU_EngX "11.1.0_6SAATransmission process for the CAN frame Engine X" /begin OUT_MEASUREMENT Com_ctCRingENGX Com_numCsumENGX /end OUT_MEASUREMENT FUNCTION_VERSION "11.1.0_6SAA" /end FUNCTION
/begin FUNCTION EngECU_EngY "6.3.0_6SAATransmission process for the CAN frame Engine Y" /begin DEF_CHARACTERISTIC Com_swtENGYFrmTypSel_C /end DEF_CHARACTERISTIC /begin IN_MEASUREMENT AirC_pClnt AirC_stPsCmpr Com_stFrmTxEna /end IN_MEASUREMENT /begin OUT_MEASUREMENT Com_ctCRingENGY Com_numCsumENGY Com_pClnt /end OUT_MEASUREMENT FUNCTION_VERSION "6.3.0_6SAA" /end FUNCTION
/begin FUNCTION EngECU_EngZ "9.2.0_6SAATransmission process for the CAN frame Engine Z(ENGZ)" /begin DEF_CHARACTERISTIC Com_dENGZSigSel_C /end DEF_CHARACTERISTIC /begin IN_MEASUREMENT Gbx_stAnaNPosBrkHld /end IN_MEASUREMENT /begin OUT_MEASUREMENT Com_ctCRingENGZ Com_numCsumENGZ /end OUT_MEASUREMENT FUNCTION_VERSION "9.2.0_6SAA" /end FUNCTION
/begin FUNCTION EngECU_LinTx "36.1.0_6SAAEngECU LIN frames"
 /begin DEF_CHARACTERISTIC ComEBS_BattID_C ComEBS_flgBitEna_C ComEBS_LinTypTx_C ComEBS_stReLrngReq_C Com_facACGDeMagCnclConv_CUR Com_iACGMagCrntLimOfs_C Com_iACGMagCrntLimSlp_C Com_nrACGDbgInfoTx_C Com_tiACGDeMagOfs_C Com_tiACGDeMagSlp_C Com_uACGAdjVltgDemOfs_C Com_uACGAdjVltgDemSlp_C /end DEF_CHARACTERISTIC
 /begin IN_MEASUREMENT Alt_iExctLim Alt_nCutOff Alt_tiLoadResp Alt_uFinalDes T15_st /end IN_MEASUREMENT
 /begin OUT_MEASUREMENT ComEBS_BattID ComEBS_flgBitEna ComEBS_LinTypTx ComEBS_stReLrngReq Lin_Alt_Signal_AdjVltgDem_6_w_msg Lin_Alt_Signal_DbgInfoTx_3_w_msg Lin_Alt_Signal_DeMagCnclSpd_4_w_msg Lin_Alt_Signal_DeMagTime_4_w_msg Lin_Alt_Signal_MagCrntLim_8_w_msg Lin_BS_B_Signal_BattID_8_w_msg Lin_BS_B_Signal_T15_st_1_w_msg Lin_BS_Signal_B_BitEna_1_w_msg Lin_BS_Signal_B_LINTypTx_4_w_msg Lin_BS_Signal_B_ReLrngReq_st_1_w_msg /end OUT_MEASUREMENT
 FUNCTION_VERSION "36.1.0_6SAA" /end FUNCTION
/begin FUNCTION EngICO_Co "44.2.0    Extended Monitoring: Injection Cut Off"
 /begin DEF_CHARACTERISTIC CWAEVABU DNMAXH EngICO_nMaxAppDfct_C EngICO_nMaxAppDpd_Cur EngICO_nMaxVDpd_Cur EngICO_nMax_C /end DEF_CHARACTERISTIC
 /begin IN_MEASUREMENT APP_r APP_stSigSrc Epm_nEng SyC_stSub ThrVlv_flgLimpModeB1 ThrVlv_flgReqFuCutOffB1 ThrVlv_flgUBattSuffB1 VehV_vSens /end IN_MEASUREMENT
 /begin OUT_MEASUREMENT B_evabu_msg EngICO_nCtOff EngICO_stICO MoX_nMaxICOMsg ndcdis_w_msg /end OUT_MEASUREMENT
 /begin LOC_MEASUREMENT EngICO_nMaxApp EngICO_nMaxV /end LOC_MEASUREMENT
 FUNCTION_VERSION "44.2.0" /end FUNCTION
/begin FUNCTION EngPrt_BltDrvVbrDampr "2.0.0     Engine Protection Belt Drive Vibration Damper"
 /begin DEF_CHARACTERISTIC EngPrt_numEngTBltDampr_C EngPrt_swtInpTSeln_C EngPrt_tAirThd_C EngPrt_tiDlyBltDrvVbrDampr_C EngPrt_tmrAftStrtThd_C EngPrt_tqBltDrvVbrDampr_C EngPrt_tqDeltaBltDrvVbrDampr_C /end DEF_CHARACTERISTIC
 /begin IN_MEASUREMENT AirSys_tFld CoPT_trqClthWoIntv EngDa_tFld RngMod_trqClthMin tnst_w_msg /end IN_MEASUREMENT
 /begin OUT_MEASUREMENT EngPrt_tqBltDrvVbrDampr /end OUT_MEASUREMENT
 /begin LOC_MEASUREMENT EngPrt_flgActv EngPrt_flgBltDrvVbrDampr EngPrt_flgBltDrvVbrDamprFF_I.status EngPrt_flgFallEdgeFF_I.status EngPrt_flgTqThdTONVNM_I.time /end LOC_MEASUREMENT
 FUNCTION_VERSION "2.0.0" /end FUNCTION
/begin FUNCTION EngPrt_NLim "1.7.0     Limitation of maximum engine speed in case of open clutch for hybrid systems" /begin DEF_CHARACTERISTIC EngPrt_trqInrNLim_CUR EngPrt_trqLimOvrSpdFCODem_C /end DEF_CHARACTERISTIC /begin IN_MEASUREMENT Epm_nEng /end IN_MEASUREMENT /begin OUT_MEASUREMENT EngPrt_bLimOvrSpd EngPrt_trqLimMech EngPrt_trqLimMechLead /end OUT_MEASUREMENT FUNCTION_VERSION "1.7.0" /end FUNCTION
/begin FUNCTION EngPrt_NMaxOvht "1.8.0     Calculation maximum engine speed to the overheating protection"
 /begin DEF_CHARACTERISTIC EngPrt_nOvhtEngLim_T EngPrt_nOvhtOff_C EngPrt_nOvhtOn_C EngPrt_nStatOvht_C EngPrt_rOvhtApp_C EngPrt_stNMaxOvht_CW EngPrt_tiNMaxOvht_C EngPrt_tiNOvhtOff_C EngPrt_tOvhtCEngDsTLim_C EngPrt_trqDesOff_C EngPrt_vOvhtOn_C /end DEF_CHARACTERISTIC
 /begin IN_MEASUREMENT APP_r CEngDsT_t Epm_nEng HLSDem_nSetPLo SpdGov_bNLimActv VehMot_trqDes VehV_v /end IN_MEASUREMENT
 /begin OUT_MEASUREMENT EngPrt_bOvhtEngLim EngPrt_nOvhtEngLim /end OUT_MEASUREMENT
 /begin LOC_MEASUREMENT EngPrt_nMaxOvhtFF_I.status EngPrt_nMaxOvhtOffTONV_I.outbit EngPrt_nMaxOvhtOffTONV_I.time EngPrt_nMaxOvhtTONV_I.outbit EngPrt_nMaxOvhtTONV_I.time EngPrt_NOvhtEngLimSW_I.timeCounter EngPrt_tiNOvhtEngLim /end LOC_MEASUREMENT
 FUNCTION_VERSION "1.8.0" /end FUNCTION
/begin FUNCTION EngPrt_OvrSpdMon "1.10.0    Engine protection - Monitoring of engine overspeed events"
 /begin DEF_CHARACTERISTIC EngPrt_nMaxFltDetn_C EngPrt_stDiagOverSpd_C EngPrt_swtNrNMaxFltClrEna_C EngPrt_tiNMaxFltDetn_C EngPrt_tiNMaxFltHeal_C /end DEF_CHARACTERISTIC
 /begin IN_MEASUREMENT CoEng_st CoEng_stOld Epm_nEng Epm_stSpd /end IN_MEASUREMENT
 /begin OUT_MEASUREMENT EngPrt_flgOverSpd EngPrt_nrNMaxFlt EngPrt_stOvrSpd /end OUT_MEASUREMENT
 /begin LOC_MEASUREMENT EngPrt_flgDiagErrHeal EngPrt_flgDsmClr EngPrt_flgErrHealCfmd EngPrt_flgNxtCyc /end LOC_MEASUREMENT
 FUNCTION_VERSION "1.10.0" /end FUNCTION
/begin FUNCTION EngPrt_PrtLimOvht "21.6.0    Overheat Protection" /begin DEF_CHARACTERISTIC EngPrt_pwrTqIntMaxOffs_C /end DEF_CHARACTERISTIC /begin IN_MEASUREMENT Epm_nEng ExhMod_tExhMnfB1 RngMod_trqInrMax /end IN_MEASUREMENT /begin OUT_MEASUREMENT EngPrt_trqLimOvhtPrv /end OUT_MEASUREMENT /begin LOC_MEASUREMENT EngPrt_pwrIntMax_MP EngPrt_pwrLimOvht /end LOC_MEASUREMENT FUNCTION_VERSION "21.6.0" /end FUNCTION
/begin FUNCTION EngPrt_TrqLimCalc "4.30.0    Resulting Engine Protection Limitation" /begin IN_MEASUREMENT EngPrt_tqBltDrvVbrDampr EngPrt_trqLimOvhtPrv /end IN_MEASUREMENT /begin OUT_MEASUREMENT EngPrt_trqLim EngPrt_trqLimLead /end OUT_MEASUREMENT /begin LOC_MEASUREMENT EngPrt_flgtrqLimEngLoTempActvn_MP /end LOC_MEASUREMENT FUNCTION_VERSION "4.30.0" /end FUNCTION
/begin FUNCTION EngReq_TrqLimCalc "4.20.0    Motor Requirements" /begin OUT_MEASUREMENT EngReq_trqLim EngReq_trqLimLead /end OUT_MEASUREMENT FUNCTION_VERSION "4.20.0" /end FUNCTION
/begin FUNCTION EngStrt_GlbDef "3.4.0     Global definitions in EngStrt" FUNCTION_VERSION "3.4.0" /end FUNCTION
/begin FUNCTION EngStrt_InjProhb "1.12.0    Injection Prohibition during Start" /begin IN_MEASUREMENT CoEng_stMai EngStrt_flgStrtEndInj /end IN_MEASUREMENT /begin OUT_MEASUREMENT EngStrt_flgInjProhb /end OUT_MEASUREMENT /begin LOC_MEASUREMENT EngStrt_stInjRelsStrtg /end LOC_MEASUREMENT FUNCTION_VERSION "1.12.0" /end FUNCTION
/begin FUNCTION EngStrt_Stop "240.11.0  engine stop" /begin DEF_CHARACTERISTIC EngStrt_nDisblNewSync_C EngStrt_tiDisblNewSyncMax_C /end DEF_CHARACTERISTIC /begin IN_MEASUREMENT CoEng_stMai EngStrt_stStrtReq Epm_nEngTooth10ms Epm_stSpd /end IN_MEASUREMENT /begin OUT_MEASUREMENT EngStrt_stRstrtStgy /end OUT_MEASUREMENT
 /begin LOC_MEASUREMENT EngStrt_flgDisblNewSyncActv EngStrt_flgDisblNewSyncActvOld EngStrt_flgDisblNewSyncLtq EngStrt_tiDisblNewSyncMax /end LOC_MEASUREMENT
 FUNCTION_VERSION "240.11.0" /end FUNCTION
/begin FUNCTION EngStrt_Strt "140.17.0  start preparation, activation of restart-task" /begin DEF_CHARACTERISTIC EngStrt_stCfgCoMBhvr_T /end DEF_CHARACTERISTIC
 /begin IN_MEASUREMENT CoEng_stMai EngStrt_flgEngStrtOrd EngStrt_stStrtReq EngStrt_stStrtSit Epm_stSpd Strt_stStaActv /end IN_MEASUREMENT
 /begin OUT_MEASUREMENT EngStrt_cntrRstrtEve EngStrt_stRstrtRsn /end OUT_MEASUREMENT
 /begin LOC_MEASUREMENT EngStrt_flgComReqd EngStrt_flgReStrtCoMReqd EngStrt_flgReStrtStpReqd EngStrt_flgReStrtStrtReqd EngStrt_flgTrigRstrtCom /end LOC_MEASUREMENT
 FUNCTION_VERSION "140.17.0" /end FUNCTION
/begin FUNCTION EngStrt_StrtCoor "1.28.0    Start coordinator for combustion engine"
 /begin DEF_CHARACTERISTIC EngStrt_dataStrtCoor_C EngStrt_dnEngCoM1_T EngStrt_dnEngCoM2_T EngStrt_nEngCoM1_M EngStrt_nEngCoM2_M EngStrt_stEomStrt_C EngStrt_stStrtPrioCoM_CA EngStrt_stStrtPrioFirst_CA EngStrt_stStrtPrioFolw_CA EngStrt_stStrtReqAppl_C EngStrt_stStrtSitAppl_C EngStrt_tFrstStrtStallgConf_C EngStrt_tiDlyCoMWaitStrtr_C EngStrt_tiDlyNoStrtReq_C EngStrt_tPfiStrtHi_C EngStrt_tPfiStrtLo_C /end DEF_CHARACTERISTIC
 /begin IN_MEASUREMENT CoEng_stMai CoEng_stMaiOld CoVeh_stEngStrtOrd EngStrt_bFrstStrtEnd EngStrt_flgInjSysRels EngStrt_flgStrtrStrtRels EngStrt_tStrtCoor EpmRRS_bEngSwOff Epm_nEng10ms HLSDem_nSetPLo PEnv_p Strt_stStaActv /end IN_MEASUREMENT
 /begin OUT_MEASUREMENT EngStrt_EomStrt_I.stOperMod EngStrt_EomStrt_I.stOperModPrio EngStrt_EomStrt_I.stOperModStg EngStrt_flgEngStallg EngStrt_flgEngStrtOrd EngStrt_flgRePrio EngStrt_flgStrtAbort EngStrt_flgStrtFaild EngStrt_stStrtReq EngStrt_stStrtSit /end OUT_MEASUREMENT
 /begin LOC_MEASUREMENT EngStrt_flgEngStall EngStrt_flgRePrioEngStrtg EngStrt_flgStrtEna EngStrt_flgStrtEnaCoMRunng EngStrt_flgStrtEnaCoMStrtg EngStrt_flgStrtEnaCoMWait EngStrt_stListCoMRunng EngStrt_stListCoMStrtg EngStrt_stListCoMWaitStrtr EngStrt_stListFolw EngStrt_stListPfi EngStrt_stStrtAvlAry EngStrt_stStrtPrio EngStrt_stStrtReqLoc /end LOC_MEASUREMENT
 FUNCTION_VERSION "1.28.0" /end FUNCTION
/begin COMPU_METHOD B_TRUE "" TAB_VERB "%6.3" "" COMPU_TAB_REF B_TRUE /end COMPU_METHOD
/begin COMPU_VTAB B_TRUE "" TAB_VERB 2 0 "FALSE" 1 "TRUE" /end COMPU_VTAB
/begin COMPU_METHOD CoEOM_stEomStgTot_VERB "" TAB_VERB "%6.3" "-" COMPU_TAB_REF CoEOM_stEomStgTot_VERB /end COMPU_METHOD
/begin COMPU_VTAB CoEOM_stEomStgTot_VERB "" TAB_VERB 513 0 "Base_HOM_FullLft" 1 "n/a [00;01]" 2 "n/a [00;02]" 3 "n/a [00;03]" 4 "Base_HOM_EIVC" 5 "n/a [00;05]" 6 "n/a [00;06]" 7 "n/a [00;07]" 8 "n/a [00;08]" 9 "n/a [00;09]" 10 "n/a [00;10]" 11 "n/a [00;11]" 12 "n/a [00;12]" 13 "n/a [00;13]" 14 "n/a [00;14]" 15 "n/a [00;15]" 255 "No_Demand" 256 "n/a [01;00]" 257 "n/a [01;01]" 258 "n/a [01;02]" 259 "n/a [01;03]" 260 "n/a [01;04]" 261 "n/a [01;05]" 262 "n/a [01;06]" 263 "n/a [01;07]" 264 "n/a [01;08]" 265 "n/a [01;09]" 266 "n/a [01;10]" 267 "n/a [01;11]" 268 "n/a [01;12]" 269 "n/a [01;13]" 270 "n/a [01;14]" 271 "n/a [01;15]" 512 "n/a [02;00]" 513 "n/a [02;01]" 514 "n/a [02;02]" 515 "n/a [02;03]" 516 "n/a [02;04]" 517 "n/a [02;05]" 518 "n/a [02;06]" 519 "n/a [02;07]" 520 "n/a [02;08]" 521 "n/a [02;09]" 522 "n/a [02;10]" 523 "n/a [02;11]" 524 "n/a [02;12]" 525 "n/a [02;13]" 526 "n/a [02;14]" 527 "n/a [02;15]" 768 "Start_FullLft" 769 "n/a [03;01]" 770 "n/a [03;02]" 771 "n/a [03;03]" 772 "Start_EIVC" 773 "n/a [03;05]" 774 "n/a [03;06]" 775 "n/a [03;07]" 776 "n/a [03;08]" 777 "n/a [03;09]" 778 "n/a [03;10]" 779 "n/a [03;11]" 780 "n/a [03;12]" 781 "n/a [03;13]" 782 "n/a [03;14]" 783 "n/a [03;15]" 1024 "n/a [04;00]" 1025 "n/a [04;01]" 1026 "n/a [04;02]" 1027 "n/a [04;03]" 1028 "n/a [04;04]" 1029 "n/a [04;05]" 1030 "n/a [04;06]" 1031 "n/a [04;07]" 1032 "n/a [04;08]" 1033 "n/a [04;09]" 1034 "n/a [04;10]" 1035 "n/a [04;11]" 1036 "n/a [04;12]" 1037 "n/a [04;13]" 1038 "n/a [04;14]" 1039 "n/a [04;15]" 1280 "n/a [05;00]" 1281 "n/a [05;01]" 1282 "n/a [05;02]" 1283 "n/a [05;03]" 1284 "n/a [05;04]" 1285 "n/a [05;05]" 1286 "n/a [05;06]" 1287 "n/a [05;07]" 1288 "n/a [05;08]" 1289 "n/a [05;09]" 1290 "n/a [05;10]" 1291 "n/a [05;11]" 1292 "n/a [05;12]" 1293 "n/a [05;13]" 1294 "n/a [05;14]" 1295 "n/a [05;15]" 1536 "n/a [06;00]" 1537 "n/a [06;01]" 1538 "n/a [06;02]" 1539 "n/a [06;03]" 1540 "n/a [06;04]" 1541 "n/a [06;05]" 1542 "n/a [06;06]" 1543 "n/a [06;07]" 1544 "n/a [06;08]" 1545 "n/a [06;09]" 1546 "n/a [06;10]" 1547 "n/a [06;11]" 1548 "n/a [06;12]" 1549 "n/a [06;13]" 1550 "n/a [06;14]" 1551 "n/a [06;15]" 1792 "n/a [07;00]" 1793 "n/a [07;01]" 1794 "n/a [07;02]" 1795 "n/a [07;03]" 1796 "n/a [07;04]" 1797 "n/a [07;05]" 1798 "n/a [07;06]" 1799 "n/a [07;07]" 1800 "n/a [07;08]" 1801 "n/a [07;09]" 1802 "n/a [07;10]" 1803 "n/a [07;11]" 1804 "n/a [07;12]" 1805 "n/a [07;13]" 1806 "n/a [07;14]" 1807 "n/a [07;15]" 2048 "n/a [08;00]" 2049 "n/a [08;01]" 2050 "n/a [08;02]" 2051 "n/a [08;03]" 2052 "n/a [08;04]" 2053 "n/a [08;05]" 2054 "n/a [08;06]" 2055 "n/a [08;07]" 2056 "n/a [08;08]" 2057 "n/a [08;09]" 2058 "n/a [08;10]" 2059 "n/a [08;11]" 2060 "n/a [08;12]" 2061 "n/a [08;13]" 2062 "n/a [08;14]" 2063 "n/a [08;15]" 2304 "n/a [09;00]" 2305 "n/a [09;01]" 2306 "n/a [09;02]" 2307 "n/a [09;03]" 2308 "n/a [09;04]" 2309 "n/a [09;05]" 2310 "n/a [09;06]" 2311 "n/a [09;07]" 2312 "n/a [09;08]" 2313 "n/a [09;09]" 2314 "n/a [09;10]" 2315 "n/a [09;11]" 2316 "n/a [09;12]" 2317 "n/a [09;13]" 2318 "n/a [09;14]" 2319 "n/a [09;15]" 2560 "n/a [10;00]" 2561 "n/a [10;01]" 2562 "n/a [10;02]" 2563 "n/a [10;03]" 2564 "n/a [10;04]" 2565 "n/a [10;05]" 2566 "n/a [10;06]" 2567 "n/a [10;07]" 2568 "n/a [10;08]" 2569 "n/a [10;09]" 2570 "n/a [10;10]" 2571 "n/a [10;11]" 2572 "n/a [10;12]" 2573 "n/a [10;13]" 2574 "n/a [10;14]" 2575 "n/a [10;15]" 2816 "n/a [11;00]" 2817 "n/a [11;01]" 2818 "n/a [11;02]" 2819 "n/a [11;03]" 2820 "n/a [11;04]" 2821 "n/a [11;05]" 2822 "n/a [11;06]" 2823 "n/a [11;07]" 2824 "n/a [11;08]" 2825 "n/a [11;09]" 2826 "n/a [11;10]" 2827 "n/a [11;11]" 2828 "n/a [11;12]" 2829 "n/a [11;13]" 2830 "n/a [11;14]" 2831 "n/a [11;15]" 3072 "n/a [12;00]" 3073 "n/a [12;01]" 3074 "n/a [12;02]" 3075 "n/a [12;03]" 3076 "n/a [12;04]" 3077 "n/a [12;05]" 3078 "n/a [12;06]" 3079 "n/a [12;07]" 3080 "n/a [12;08]" 3081 "n/a [12;09]" 3082 "n/a [12;10]" 3083 "n/a [12;11]" 3084 "n/a [12;12]" 3085 "n/a [12;13]" 3086 "n/a [12;14]" 3087 "n/a [12;15]" 3328 "n/a [13;00]" 3329 "n/a [13;01]" 3330 "n/a [13;02]" 3331 "n/a [13;03]" 3332 "n/a [13;04]" 3333 "n/a [13;05]" 3334 "n/a [13;06]" 3335 "n/a [13;07]" 3336 "n/a [13;08]" 3337 "n/a [13;09]" 3338 "n/a [13;10]" 3339 "n/a [13;11]" 3340 "n/a [13;12]" 3341 "n/a [13;13]" 3342 "n/a [13;14]" 3343 "n/a [13;15]" 3584 "n/a [14;00]" 3585 "n/a [14;01]" 3586 "n/a [14;02]" 3587 "n/a [14;03]" 3588 "n/a [14;04]" 3589 "n/a [14;05]" 3590 "n/a [14;06]" 3591 "n/a [14;07]" 3592 "n/a [14;08]" 3593 "n/a [14;09]" 3594 "n/a [14;10]" 3595 "n/a [14;11]" 3596 "n/a [14;12]" 3597 "n/a [14;13]" 3598 "n/a [14;14]" 3599 "n/a [14;15]" 3840 "n/a [15;00]" 3841 "n/a [15;01]" 3842 "n/a [15;02]" 3843 "n/a [15;03]" 3844 "n/a [15;04]" 3845 "n/a [15;05]" 3846 "n/a [15;06]" 3847 "n/a [15;07]" 3848 "n/a [15;08]" 3849 "n/a [15;09]" 3850 "n/a [15;10]" 3851 "n/a [15;11]" 3852 "n/a [15;12]" 3853 "n/a [15;13]" 3854 "n/a [15;14]" 3855 "n/a [15;15]" 4096 "n/a [16;00]" 4097 "n/a [16;01]" 4098 "n/a [16;02]" 4099 "n/a [16;03]" 4100 "n/a [16;04]" 4101 "n/a [16;05]" 4102 "n/a [16;06]" 4103 "n/a [16;07]" 4104 "n/a [16;08]" 4105 "n/a [16;09]" 4106 "n/a [16;10]" 4107 "n/a [16;11]" 4108 "n/a [16;12]" 4109 "n/a [16;13]" 4110 "n/a [16;14]" 4111 "n/a [16;15]" 4352 "n/a [17;00]" 4353 "n/a [17;01]" 4354 "n/a [17;02]" 4355 "n/a [17;03]" 4356 "n/a [17;04]" 4357 "n/a [17;05]" 4358 "n/a [17;06]" 4359 "n/a [17;07]" 4360 "n/a [17;08]" 4361 "n/a [17;09]" 4362 "n/a [17;10]" 4363 "n/a [17;11]" 4364 "n/a [17;12]" 4365 "n/a [17;13]" 4366 "n/a [17;14]" 4367 "n/a [17;15]" 4608 "n/a [18;00]" 4609 "n/a [18;01]" 4610 "n/a [18;02]" 4611 "n/a [18;03]" 4612 "n/a [18;04]" 4613 "n/a [18;05]" 4614 "n/a [18;06]" 4615 "n/a [18;07]" 4616 "n/a [18;08]" 4617 "n/a [18;09]" 4618 "n/a [18;10]" 4619 "n/a [18;11]" 4620 "n/a [18;12]" 4621 "n/a [18;13]" 4622 "n/a [18;14]" 4623 "n/a [18;15]" 4864 "n/a [19;00]" 4865 "n/a [19;01]" 4866 "n/a [19;02]" 4867 "n/a [19;03]" 4868 "n/a [19;04]" 4869 "n/a [19;05]" 4870 "n/a [19;06]" 4871 "n/a [19;07]" 4872 "n/a [19;08]" 4873 "n/a [19;09]" 4874 "n/a [19;10]" 4875 "n/a [19;11]" 4876 "n/a [19;12]" 4877 "n/a [19;13]" 4878 "n/a [19;14]" 4879 "n/a [19;15]" 5120 "n/a [20;00]" 5121 "n/a [20;01]" 5122 "n/a [20;02]" 5123 "n/a [20;03]" 5124 "n/a [20;04]" 5125 "n/a [20;05]" 5126 "n/a [20;06]" 5127 "n/a [20;07]" 5128 "n/a [20;08]" 5129 "n/a [20;09]" 5130 "n/a [20;10]" 5131 "n/a [20;11]" 5132 "n/a [20;12]" 5133 "n/a [20;13]" 5134 "n/a [20;14]" 5135 "n/a [20;15]" 5376 "n/a [21;00]" 5377 "n/a [21;01]" 5378 "n/a [21;02]" 5379 "n/a [21;03]" 5380 "n/a [21;04]" 5381 "n/a [21;05]" 5382 "n/a [21;06]" 5383 "n/a [21;07]" 5384 "n/a [21;08]" 5385 "n/a [21;09]" 5386 "n/a [21;10]" 5387 "n/a [21;11]" 5388 "n/a [21;12]" 5389 "n/a [21;13]" 5390 "n/a [21;14]" 5391 "n/a [21;15]" 5632 "n/a [22;00]" 5633 "n/a [22;01]" 5634 "n/a [22;02]" 5635 "n/a [22;03]" 5636 "n/a [22;04]" 5637 "n/a [22;05]" 5638 "n/a [22;06]" 5639 "n/a [22;07]" 5640 "n/a [22;08]" 5641 "n/a [22;09]" 5642 "n/a [22;10]" 5643 "n/a [22;11]" 5644 "n/a [22;12]" 5645 "n/a [22;13]" 5646 "n/a [22;14]" 5647 "n/a [22;15]" 5888 "n/a [23;00]" 5889 "n/a [23;01]" 5890 "n/a [23;02]" 5891 "n/a [23;03]" 5892 "n/a [23;04]" 5893 "n/a [23;05]" 5894 "n/a [23;06]" 5895 "n/a [23;07]" 5896 "n/a [23;08]" 5897 "n/a [23;09]" 5898 "n/a [23;10]" 5899 "n/a [23;11]" 5900 "n/a [23;12]" 5901 "n/a [23;13]" 5902 "n/a [23;14]" 5903 "n/a [23;15]" 6144 "n/a [24;00]" 6145 "n/a [24;01]" 6146 "n/a [24;02]" 6147 "n/a [24;03]" 6148 "n/a [24;04]" 6149 "n/a [24;05]" 6150 "n/a [24;06]" 6151 "n/a [24;07]" 6152 "n/a [24;08]" 6153 "n/a [24;09]" 6154 "n/a [24;10]" 6155 "n/a [24;11]" 6156 "n/a [24;12]" 6157 "n/a [24;13]" 6158 "n/a [24;14]" 6159 "n/a [24;15]" 6400 "n/a [25;00]" 6401 "n/a [25;01]" 6402 "n/a [25;02]" 6403 "n/a [25;03]" 6404 "n/a [25;04]" 6405 "n/a [25;05]" 6406 "n/a [25;06]" 6407 "n/a [25;07]" 6408 "n/a [25;08]" 6409 "n/a [25;09]" 6410 "n/a [25;10]" 6411 "n/a [25;11]" 6412 "n/a [25;12]" 6413 "n/a [25;13]" 6414 "n/a [25;14]" 6415 "n/a [25;15]" 6656 "n/a [26;00]" 6657 "n/a [26;01]" 6658 "n/a [26;02]" 6659 "n/a [26;03]" 6660 "n/a [26;04]" 6661 "n/a [26;05]" 6662 "n/a [26;06]" 6663 "n/a [26;07]" 6664 "n/a [26;08]" 6665 "n/a [26;09]" 6666 "n/a [26;10]" 6667 "n/a [26;11]" 6668 "n/a [26;12]" 6669 "n/a [26;13]" 6670 "n/a [26;14]" 6671 "n/a [26;15]" 6912 "n/a [27;00]" 6913 "n/a [27;01]" 6914 "n/a [27;02]" 6915 "n/a [27;03]" 6916 "n/a [27;04]" 6917 "n/a [27;05]" 6918 "n/a [27;06]" 6919 "n/a [27;07]" 6920 "n/a [27;08]" 6921 "n/a [27;09]" 6922 "n/a [27;10]" 6923 "n/a [27;11]" 6924 "n/a [27;12]" 6925 "n/a [27;13]" 6926 "n/a [27;14]" 6927 "n/a [27;15]" 7168 "n/a [28;00]" 7169 "n/a [28;01]" 7170 "n/a [28;02]" 7171 "n/a [28;03]" 7172 "n/a [28;04]" 7173 "n/a [28;05]" 7174 "n/a [28;06]" 7175 "n/a [28;07]" 7176 "n/a [28;08]" 7177 "n/a [28;09]" 7178 "n/a [28;10]" 7179 "n/a [28;11]" 7180 "n/a [28;12]" 7181 "n/a [28;13]" 7182 "n/a [28;14]" 7183 "n/a [28;15]" 7424 "n/a [29;00]" 7425 "n/a [29;01]" 7426 "n/a [29;02]" 7427 "n/a [29;03]" 7428 "n/a [29;04]" 7429 "n/a [29;05]" 7430 "n/a [29;06]" 7431 "n/a [29;07]" 7432 "n/a [29;08]" 7433 "n/a [29;09]" 7434 "n/a [29;10]" 7435 "n/a [29;11]" 7436 "n/a [29;12]" 7437 "n/a [29;13]" 7438 "n/a [29;14]" 7439 "n/a [29;15]" 7680 "n/a [30;00]" 7681 "n/a [30;01]" 7682 "n/a [30;02]" 7683 "n/a [30;03]" 7684 "n/a [30;04]" 7685 "n/a [30;05]" 7686 "n/a [30;06]" 7687 "n/a [30;07]" 7688 "n/a [30;08]" 7689 "n/a [30;09]" 7690 "n/a [30;10]" 7691 "n/a [30;11]" 7692 "n/a [30;12]" 7693 "n/a [30;13]" 7694 "n/a [30;14]" 7695 "n/a [30;15]" 7936 "n/a [31;00]" 7937 "n/a [31;01]" 7938 "n/a [31;02]" 7939 "n/a [31;03]" 7940 "n/a [31;04]" 7941 "n/a [31;05]" 7942 "n/a [31;06]" 7943 "n/a [31;07]" 7944 "n/a [31;08]" 7945 "n/a [31;09]" 7946 "n/a [31;10]" 7947 "n/a [31;11]" 7948 "n/a [31;12]" 7949 "n/a [31;13]" 7950 "n/a [31;14]" 7951 "n/a [31;15]" /end COMPU_VTAB
/begin COMPU_METHOD Curr "" RAT_FUNC "%6.2" "mA" COEFFS 0 1 0 0 0 1 /end COMPU_METHOD
/begin COMPU_METHOD dez "" RAT_FUNC "%6.2" "" COEFFS 0 1 0 0 0 1 /end COMPU_METHOD
/begin COMPU_METHOD DFC_Verb "" TAB_VERB "%6.3" "-" COMPU_TAB_REF DFC_Verb /end COMPU_METHOD
/begin COMPU_VTAB DFC_Verb "" TAB_VERB 704 0 "DFC_Unused" 318 "DFC_ACEvpTSRCMax" 319 "DFC_ACEvpTSRCMin" 320 "DFC_AirCClntPAnaSRCMax" 321 "DFC_AirCClntPAnaSRCMin" 259 "DFC_AirCCmprOL" 260 "DFC_AirCCmprOvrTemp" 261 "DFC_AirCCmprSCB" 262 "DFC_AirCCmprSCG" 322 "DFC_AirCSwtNpl" 323 "DFC_AirCSwtSig" 263 "DFC_AltErr" 1 "DFC_AltIOACGFailr" 2 "DFC_AltIOACGHiVltg" 3 "DFC_AltIOACGLoVltg" 4 "DFC_AltIOACGTHi" 5 "DFC_AltIODConnACG" 429 "DFC_AppAllSnsrDfct" 6 "DFC_BattUHiFailr" 7 "DFC_BattULoFailr" 264 "DFC_BattUSRCMax" 265 "DFC_BattUSRCMin" 430 "DFC_BattUStdbyDiaOL" 431 "DFC_BigLeakIntkMnfldEmiInfl" 324 "DFC_Brk" 8 "DFC_BrkBstPDriftHiErr" 9 "DFC_BrkBstPDriftLoErr" 10 "DFC_BrkBstPSnsrStuck" 11 "DFC_BrkMnSwtContOn" 432 "DFC_BrkMnSwtContOnWarnLmp" 12 "DFC_BrkMnSwtNotStp" 433 "DFC_BrkMnSwtNotStpWarnLmp" 13 "DFC_BrkNpl" 14 "DFC_BrkRdntSwtContOn" 434 "DFC_BrkRdntSwtContOnWarnLmp" 15 "DFC_BrkRdntSwtNotStp" 435 "DFC_BrkRdntSwtNotStpWarnLmp" 325 "DFC_BrkSig" 417 "DFC_BSWM_E_ACTION_FAILED" 418 "DFC_BSWM_E_INTRPTQUEUE_FULL" 393 "DFC_BusDiagCANAPPLBusOff" 394 "DFC_BusDiagCANCANCBusOff" 395 "DFC_BusDiagCANVEHICLEBusOff" 411 "DFC_CAN_E_TIMEOUT" 436 "DFC_CEngDsTColdStrtMax" 437 "DFC_CEngDsTColdStrtMin" 438 "DFC_CEngDsTImps" 439 "DFC_CEngDsTPlausLSC" 440 "DFC_CEngDsTPlausSTC" 443 "DFC_CEngDsTSig" 441 "DFC_CEngDsTSRCMax" 442 "DFC_CEngDsTSRCMin" 444 "DFC_CEngUsTSRCMax" 445 "DFC_CEngUsTSRCMin" 366 "DFC_Clth2ONStuck" 367 "DFC_Clth2ONStuckLdc" 16 "DFC_Clth3ONStuck" 368 "DFC_Clth3ONStuckLdc" 369 "DFC_Clth3ONStuckPostDrv" 17 "DFC_Clth4OFFStuck" 370 "DFC_Clth4ONStuck" 371 "DFC_Clth4ONStuckLdc" 236 "DFC_ClthMax" 336 "DFC_ClthNpl" 18 "DFC_ClthOFFStuck" 19 "DFC_ClthONStuck" 326 "DFC_ClthSig" 20 "DFC_ClthStkFailInfo" 21 "DFC_ComACFailInfo" 22 "DFC_ComATFTValErr" 23 "DFC_ComATMILReq" 24 "DFC_ComAYCAChksum" 25 "DFC_ComAYCARingCnt" 26 "DFC_ComAYCATOut" 27 "DFC_ComAYCDChkSum" 28 "DFC_ComAYCDTOut" 29 "DFC_ComAYCFChksum" 30 "DFC_ComAYCFRingCnt" 31 "DFC_ComAYCFTOut" 32 "DFC_ComAYCGChksum" 33 "DFC_ComAYCGRingCnt" 34 "DFC_ComAYCGTOut" 35 "DFC_ComAYCIChkSum" 36 "DFC_ComAYCIRingCnt" 37 "DFC_ComAYCITOut" 38 "DFC_ComBCM1ChkSum" 39 "DFC_ComBCM1RingCnt" 40 "DFC_ComBCM1TOut" 41 "DFC_ComCANABusOffErr" 42 "DFC_ComCANBBusOffErr" 43 "DFC_ComCANCBusOffErr" 44 "DFC_ComCGW1ChkSum" 45 "DFC_ComCGW1RingCnt" 46 "DFC_ComCGW1TOut" 266 "DFC_ComChksTCU1" 267 "DFC_ComChksTCU11" 268 "DFC_ComChksTCU12" 269 "DFC_ComChksTCU13" 270 "DFC_ComChksTCU2" 271 "DFC_ComChksTCU3" 272 "DFC_ComChksTCU4" 273 "DFC_ComCntTCU1" 274 "DFC_ComCntTCU11" 275 "DFC_ComCntTCU12" 276 "DFC_ComCntTCU13" 277 "DFC_ComCntTCU2" 278 "DFC_ComCntTCU3" 279 "DFC_ComCntTCU4" 47 "DFC_ComConvBoostErr" 48 "DFC_ComConvSlipErr" 372 "DFC_ComDLCTCU01" 373 "DFC_ComDLCTCU02" 374 "DFC_ComDLCTCU1" 375 "DFC_ComDLCTCU11" 376 "DFC_ComDLCTCU12" 377 "DFC_ComDLCTCU13" 378 "DFC_ComDLCTCU14" 379 "DFC_ComDLCTCU2" 380 "DFC_ComDLCTCU3" 381 "DFC_ComDLCTCU4" 49 "DFC_ComEAT10Chksum" 50 "DFC_ComEAT10RingCnt" 51 "DFC_ComEAT10TOut" 52 "DFC_ComEAT11ChkSum" 53 "DFC_ComEAT11RingCnt" 54 "DFC_ComEAT11TOut" 55 "DFC_ComEAT12ChkSum" 56 "DFC_ComEAT12RingCnt" 57 "DFC_ComEAT12TOut" 58 "DFC_ComEAT13ChkSum" 59 "DFC_ComEAT13RingCnt" 60 "DFC_ComEAT13TOut" 61 "DFC_ComEAT1Chksum" 62 "DFC_ComEAT1RingCnt" 63 "DFC_ComEAT1TOut" 64 "DFC_ComEAT2ChkSum" 65 "DFC_ComEAT2RingCnt" 66 "DFC_ComEAT2TOut" 67 "DFC_ComEAT4ChkSum" 68 "DFC_ComEAT4RingCnt" 69 "DFC_ComEAT4TOut" 70 "DFC_ComEAT6Chksum" 71 "DFC_ComEAT6RingCnt" 72 "DFC_ComEAT6TOut" 73 "DFC_ComEAT7Chksum" 74 "DFC_ComEAT7RingCnt" 75 "DFC_ComEAT7TOut" 76 "DFC_ComEAT8Chksum" 77 "DFC_ComEAT8RingCnt" 78 "DFC_ComEAT8TOut" 79 "DFC_ComEATAChksum" 80 "DFC_ComEATARingCnt" 81 "DFC_ComEATATOut" 82 "DFC_ComEATBChkSum" 83 "DFC_ComEATBRingCnt" 84 "DFC_ComEATBTOut" 85 "DFC_ComEATCChksum" 86 "DFC_ComEATCRingCnt" 87 "DFC_ComEATCTOut" 88 "DFC_ComEBBAChksum" 89 "DFC_ComEBBARingCnt" 90 "DFC_ComEBBATOut" 94 "DFC_ComEngCanRxErr" 91 "DFC_ComEPS1Chksum" 92 "DFC_ComEPS1RingCnt" 93 "DFC_ComEPS1TOut" 95 "DFC_ComGrvySnsrErr" 96 "DFC_ComGwIMG1ChkSum" 97 "DFC_ComGwIMG1RingCnt" 98 "DFC_ComGwIMG1TOut" 99 "DFC_ComGwIMG3ChkSum" 100 "DFC_ComGwIMG3RingCnt" 101 "DFC_ComGwIMG3TOut" 102 "DFC_ComGwIMG4ChkSum" 103 "DFC_ComGwIMG4RingCnt" 104 "DFC_ComGwIMG4TOut" 105 "DFC_ComGwIMG5ChkSum" 106 "DFC_ComGwIMG5RingCnt" 107 "DFC_ComGwIMG5TOut" 108 "DFC_ComGwIMG6ChkSum" 109 "DFC_ComGwIMG6RingCnt" 110 "DFC_ComGwIMG6TOut" 111 "DFC_ComIDASBChksum" 112 "DFC_ComIDASBRingCnt" 113 "DFC_ComIDASBTOut" 114 "DFC_ComIMGMILReq" 115 "DFC_ComISSPrms" 116 "DFC_ComMETAChksum" 117 "DFC_ComMETARingCnt" 118 "DFC_ComMETATOut" 119 "DFC_ComMETCChksum" 120 "DFC_ComMETCRingCnt" 121 "DFC_ComMETCTOut" 122 "DFC_ComMETDChksum" 123 "DFC_ComMETDRingCnt" 124 "DFC_ComMETDTOut" 125 "DFC_ComMETE2Chksum" 126 "DFC_ComMETE2RingCnt" 127 "DFC_ComMETE2TOut" 128 "DFC_ComMETFChksum" 129 "DFC_ComMETFRingCnt" 130 "DFC_ComMETFTOut" 131 "DFC_ComMETGChksum" 132 "DFC_ComMETGRingCnt" 133 "DFC_ComMETGTOut" 134 "DFC_ComMETH2Chksum" 135 "DFC_ComMETH2RingCnt" 136 "DFC_ComMETH2TOut" 137 "DFC_ComMETHChksum" 138 "DFC_ComMETHRingCnt" 139 "DFC_ComMETHTOut" 140 "DFC_ComMETIChksum" 141 "DFC_ComMETIRingCnt" 142 "DFC_ComMETITOut" 143 "DFC_ComMETKChksum" 144 "DFC_ComMETKRingCnt" 145 "DFC_ComMETKTOut" 146 "DFC_ComMETLChksum" 147 "DFC_ComMETLRingCnt" 148 "DFC_ComMETLTOut" 149 "DFC_ComMETMChksum" 150 "DFC_ComMETMRingCnt" 151 "DFC_ComMETMTOut" 152 "DFC_ComMETNChksum" 153 "DFC_ComMETNRingCnt" 154 "DFC_ComMETNTOut" 155 "DFC_ComMtrCom" 156 "DFC_ComPCUChkSum" 157 "DFC_ComPCURingCnt" 158 "DFC_ComPCUTOut" 159 "DFC_ComSRSAChksum" 160 "DFC_ComSRSARingCnt" 161 "DFC_ComSRSATOut" 162 "DFC_ComSRSBChksum" 163 "DFC_ComSRSBRingCnt" 164 "DFC_ComSRSBTOut" 165 "DFC_ComSRSChksum" 166 "DFC_ComSRSErr" 167 "DFC_ComSRSRingCnt" 168 "DFC_ComSRSTOut" 280 "DFC_ComTOutTCU01" 281 "DFC_ComTOutTCU02" 282 "DFC_ComTOutTCU1" 283 "DFC_ComTOutTCU11" 284 "DFC_ComTOutTCU12" 285 "DFC_ComTOutTCU13" 286 "DFC_ComTOutTCU14" 287 "DFC_ComTOutTCU2" 288 "DFC_ComTOutTCU3" 289 "DFC_ComTOutTCU4" 169 "DFC_ComVehSpdPndFltTCU" 446 "DFC_DCDCFltDet" 290 "DFC_DevLibBattUHi" 291 "DFC_DevLibBattULo" 449 "DFC_DKnpl" 447 "DFC_DKRSA" 448 "DFC_DKVSmax" 450 "DFC_DSSmax" 451 "DFC_DSTTI" 452 "DFC_DSUmax" 170 "DFC_EbsChartcCurrErr" 171 "DFC_EbsSelfDiagErr" 383 "DFC_EbsSocFlt" 453 "DFC_EGRVlvOL" 454 "DFC_EGRVlvSCB" 455 "DFC_EGRVlvSCG" 456 "DFC_EGSDUS2B1LtrDly" 457 "DFC_EGSDUS2B1LtrPT1" 458 "DFC_EGSDUS2B1RtlDly" 459 "DFC_EGSDUS2B1RtlPT1" 460 "DFC_EGSDUS2B1TarLean" 461 "DFC_EGSDUS2B1TarRich" 464 "DFC_EngICO" 465 "DFC_EngPrtOvrSpdMon" 466 "DFC_EpmCaSI1ErrSig" 467 "DFC_EpmCaSI1NoSig" 468 "DFC_EpmCaSI1OfsErr" 469 "DFC_EpmCrSErrSig" 470 "DFC_EpmCrSNoSig" 471 "DFC_EtaEngIdleNonCsers" 472 "DFC_EtaEngPtlNonCsers" 462 "DFC_ETAKHLmax" 463 "DFC_ETAKHTmax" 337 "DFC_EV1max" 338 "DFC_EV1min" 339 "DFC_EV1sig" 340 "DFC_EV2max" 341 "DFC_EV2min" 342 "DFC_EV2sig" 343 "DFC_EV3max" 344 "DFC_EV3min" 345 "DFC_EV3sig" 346 "DFC_EV4max" 347 "DFC_EV4min" 348 "DFC_EV4sig" 382 "DFC_EVX" 292 "DFC_FanDIOOL_0" 293 "DFC_FanDIOOL_1" 294 "DFC_FanDIOOvrTemp_0" 295 "DFC_FanDIOOvrTemp_1" 296 "DFC_FanDIOSCB_0" 297 "DFC_FanDIOSCB_1" 298 "DFC_FanDIOSCG_0" 299 "DFC_FanDIOSCG_1" 473 "DFC_FRAmax" 474 "DFC_FRAmin" 172 "DFC_GbxCANDigPlausErr" 173 "DFC_GbxNPos1SRCMax" 174 "DFC_GbxNPos1SRCMin" 175 "DFC_GbxNPos2SRCMax" 176 "DFC_GbxNPos2SRCMin" 177 "DFC_GbxNPosAlvChk" 178 "DFC_GbxNPosSyncErr" 349 "DFC_GbxPNPosnDrvCdn" 350 "DFC_GbxPNPosnPlausy" 475 "DFC_GbxRvsSwtStk" 476 "DFC_HDRmax" 477 "DFC_HEGOS2B1ElecMax" 478 "DFC_HEGOS2B1ElecMin" 479 "DFC_HEGOS2B1ElecSig" 480 "DFC_HEGOS2B1HtgNpl" 179 "DFC_HEGOS2B1HtrPsMax" 180 "DFC_HEGOS2B1HtrPsMin" 181 "DFC_HEGOS2B1HtrPsSig" 327 "DFC_HLSDemOvhtEngLim" 384 "DFC_I14229VINErr" 237 "DFC_IgnClPs_DevComErr" 238 "DFC_IgnClPs_LineOl_0" 239 "DFC_IgnClPs_LineOl_1" 240 "DFC_IgnClPs_LineOl_2" 241 "DFC_IgnClPs_LineOl_3" 242 "DFC_IgnClPs_LineScb_0" 243 "DFC_IgnClPs_LineScb_1" 244 "DFC_IgnClPs_LineScb_2" 245 "DFC_IgnClPs_LineScb_3" 246 "DFC_IgnClPs_LineScg_0" 247 "DFC_IgnClPs_LineScg_1" 248 "DFC_IgnClPs_LineScg_2" 249 "DFC_IgnClPs_LineScg_3" 481 "DFC_IntkAirTIntkMnfldCrssMax" 482 "DFC_IntkAirTIntkMnfldCrssMin" 483 "DFC_IntkAirTIntkMnfldHSCMax" 484 "DFC_IntkAirTIntkMnfldImps" 485 "DFC_IntkAirTIntkMnfldPRCMax" 486 "DFC_IntkAirTIntkMnfldPRCMin" 487 "DFC_IntkAirTIntkMnfldSRCMax" 488 "DFC_IntkAirTIntkMnfldSRCMin" 489 "DFC_IntkAirTIntkMnfldSTC" 362 "DFC_KnDetSens1PortAMax" 363 "DFC_KnDetSens1PortAMin" 364 "DFC_KnDetSens1PortBMax" 365 "DFC_KnDetSens1PortBMin" 490 "DFC_KS1max" 491 "DFC_KS1min" 494 "DFC_LamDynDiagS1B1" 495 "DFC_LeakIntkMnfldEmiInfl" 412 "DFC_LIN_E_TIMEOUT" 182 "DFC_LinCSErrACG" 183 "DFC_LinCSErrEBS" 184 "DFC_LinHdrTimeoutErrACG" 185 "DFC_LinHdrTimeoutErrEBS" 186 "DFC_LinMsgTimeoutErrACG" 187 "DFC_LinMsgTimeoutErrEBS" 188 "DFC_LinNoStrtComErr" 385 "DFC_LLRKHmax" 386 "DFC_LLRKHmin" 387 "DFC_LLRmax" 388 "DFC_LLRmin" 492 "DFC_LMmax" 493 "DFC_LZSRnpl" 496 "DFC_MD00max" 497 "DFC_MDBmax" 498 "DFC_MDCat" 499 "DFC_MDCatCrit" 500 "DFC_MDCatCurr" 501 "DFC_MDCyl_0" 502 "DFC_MDCyl_1" 503 "DFC_MDCyl_2" 504 "DFC_MDCyl_3" 505 "DFC_MDEmi" 506 "DFC_MDEmiStrt" 507 "DFC_MDFco" 510 "DFC_MDmax" 508 "DFC_MDMpl" 509 "DFC_MDSegTiAdpn" 205 "DFC_MisfDetdVWhlFrntLePlaus" 206 "DFC_MisfDetdVWhlFrntRiPlaus" 207 "DFC_MisfDetdVWhlReLePlaus" 208 "DFC_MisfDetdVWhlReRiPlaus" 189 "DFC_MisfDetVWhlFrntLeOORHi" 190 "DFC_MisfDetVWhlFrntLeRatyHi" 191 "DFC_MisfDetVWhlFrntLeRatyLo" 192 "DFC_MisfDetVWhlFrntLeStuck" 193 "DFC_MisfDetVWhlFrntRiOORHi" 194 "DFC_MisfDetVWhlFrntRiRatyHi" 195 "DFC_MisfDetVWhlFrntRiRatyLo" 196 "DFC_MisfDetVWhlFrntRiStuck" 197 "DFC_MisfDetVWhlReLeOORHi" 198 "DFC_MisfDetVWhlReLeRatyHi" 199 "DFC_MisfDetVWhlReLeRatyLo" 200 "DFC_MisfDetVWhlReLeStuck" 201 "DFC_MisfDetVWhlReRiOORHi" 202 "DFC_MisfDetVWhlReRiRatyHi" 203 "DFC_MisfDetVWhlReRiRatyLo" 204 "DFC_MisfDetVWhlReRiStuck" 605 "DFC_MoCADCNTP" 606 "DFC_MoCADCTst" 607 "DFC_MoCSOPICO" 609 "DFC_MoFAirFilgPrdc" 610 "DFC_MoFAirFlCtOffPfi" 611 "DFC_MoFAirFlCylPfi" 612 "DFC_MoFAirFlIn" 613 "DFC_MoFAirFlMixCtlPfiChkAirFl" 614 "DFC_MoFAirFlMixCtlPfiChkCtrl" 615 "DFC_MoFAirFlMode" 608 "DFC_MoFAPP" 616 "DFC_MoFESpd" 617 "DFC_MoFIACo" 618 "DFC_MoFICOL1" 619 "DFC_MoFICOL2" 620 "DFC_MoFStrt" 621 "DFC_MoFTrqCmp" 622 "DFC_MoFTrqCmpMax" 623 "DFC_MoFTrqCmpMin" 624 "DFC_MoFVarPostBldSel" 511 "DFC_MOXEMM_SMU_ALM0_0" 512 "DFC_MOXEMM_SMU_ALM0_1" 513 "DFC_MOXEMM_SMU_ALM0_10" 514 "DFC_MOXEMM_SMU_ALM0_11" 515 "DFC_MOXEMM_SMU_ALM0_13" 516 "DFC_MOXEMM_SMU_ALM0_14" 517 "DFC_MOXEMM_SMU_ALM0_2" 518 "DFC_MOXEMM_SMU_ALM0_22" 519 "DFC_MOXEMM_SMU_ALM0_23" 520 "DFC_MOXEMM_SMU_ALM0_4" 521 "DFC_MOXEMM_SMU_ALM0_5" 522 "DFC_MOXEMM_SMU_ALM0_7" 523 "DFC_MOXEMM_SMU_ALM0_8" 524 "DFC_MOXEMM_SMU_ALM10_16" 525 "DFC_MOXEMM_SMU_ALM10_17" 526 "DFC_MOXEMM_SMU_ALM10_21" 527 "DFC_MOXEMM_SMU_ALM11_0" 528 "DFC_MOXEMM_SMU_ALM11_1" 529 "DFC_MOXEMM_SMU_ALM11_2" 530 "DFC_MOXEMM_SMU_ALM11_3" 531 "DFC_MOXEMM_SMU_ALM11_4" 532 "DFC_MOXEMM_SMU_ALM11_5" 533 "DFC_MOXEMM_SMU_ALM11_8" 534 "DFC_MOXEMM_SMU_ALM11_9" 535 "DFC_MOXEMM_SMU_ALM1_0" 536 "DFC_MOXEMM_SMU_ALM1_1" 537 "DFC_MOXEMM_SMU_ALM1_10" 538 "DFC_MOXEMM_SMU_ALM1_11" 539 "DFC_MOXEMM_SMU_ALM1_13" 540 "DFC_MOXEMM_SMU_ALM1_14" 541 "DFC_MOXEMM_SMU_ALM1_2" 542 "DFC_MOXEMM_SMU_ALM1_22" 543 "DFC_MOXEMM_SMU_ALM1_23" 544 "DFC_MOXEMM_SMU_ALM1_4" 545 "DFC_MOXEMM_SMU_ALM1_5" 546 "DFC_MOXEMM_SMU_ALM1_7" 547 "DFC_MOXEMM_SMU_ALM1_8" 548 "DFC_MOXEMM_SMU_ALM21_0" 549 "DFC_MOXEMM_SMU_ALM21_16" 550 "DFC_MOXEMM_SMU_ALM21_3" 551 "DFC_MOXEMM_SMU_ALM2_1" 552 "DFC_MOXEMM_SMU_ALM2_10" 553 "DFC_MOXEMM_SMU_ALM2_11" 554 "DFC_MOXEMM_SMU_ALM2_13" 555 "DFC_MOXEMM_SMU_ALM2_14" 556 "DFC_MOXEMM_SMU_ALM2_22" 557 "DFC_MOXEMM_SMU_ALM2_23" 558 "DFC_MOXEMM_SMU_ALM2_4" 559 "DFC_MOXEMM_SMU_ALM2_5" 560 "DFC_MOXEMM_SMU_ALM2_7" 561 "DFC_MOXEMM_SMU_ALM2_8" 562 "DFC_MOXEMM_SMU_ALM6_0" 563 "DFC_MOXEMM_SMU_ALM6_11" 564 "DFC_MOXEMM_SMU_ALM6_12" 565 "DFC_MOXEMM_SMU_ALM6_14" 566 "DFC_MOXEMM_SMU_ALM6_15" 567 "DFC_MOXEMM_SMU_ALM6_17" 568 "DFC_MOXEMM_SMU_ALM6_18" 569 "DFC_MOXEMM_SMU_ALM6_20" 570 "DFC_MOXEMM_SMU_ALM6_21" 571 "DFC_MOXEMM_SMU_ALM6_25" 572 "DFC_MOXEMM_SMU_ALM6_4" 573 "DFC_MOXEMM_SMU_ALM6_5" 574 "DFC_MOXEMM_SMU_ALM6_7" 575 "DFC_MOXEMM_SMU_ALM6_8" 576 "DFC_MOXEMM_SMU_ALM7_1" 577 "DFC_MOXEMM_SMU_ALM7_12" 578 "DFC_MOXEMM_SMU_ALM7_13" 579 "DFC_MOXEMM_SMU_ALM7_14" 580 "DFC_MOXEMM_SMU_ALM7_15" 581 "DFC_MOXEMM_SMU_ALM7_16" 582 "DFC_MOXEMM_SMU_ALM7_17" 583 "DFC_MOXEMM_SMU_ALM7_2" 584 "DFC_MOXEMM_SMU_ALM7_20" 585 "DFC_MOXEMM_SMU_ALM7_25" 586 "DFC_MOXEMM_SMU_ALM7_26" 587 "DFC_MOXEMM_SMU_ALM7_28" 588 "DFC_MOXEMM_SMU_ALM7_29" 589 "DFC_MOXEMM_SMU_ALM7_30" 590 "DFC_MOXEMM_SMU_ALM7_31" 591 "DFC_MOXEMM_SMU_ALM8_0" 592 "DFC_MOXEMM_SMU_ALM8_1" 593 "DFC_MOXEMM_SMU_ALM8_10" 594 "DFC_MOXEMM_SMU_ALM8_11" 595 "DFC_MOXEMM_SMU_ALM8_12" 596 "DFC_MOXEMM_SMU_ALM8_16" 597 "DFC_MOXEMM_SMU_ALM8_18" 598 "DFC_MOXEMM_SMU_ALM8_2" 599 "DFC_MOXEMM_SMU_ALM8_3" 600 "DFC_MOXEMM_SMU_ALM8_31" 601 "DFC_MOXEMM_SMU_ALM8_4" 602 "DFC_MOXEMM_SMU_ALM9_0" 603 "DFC_MOXEMM_SMU_ALM9_15" 604 "DFC_MOXEMM_SMU_ALM9_3" 625 "DFC_MoXEMMHwLTMCUFW" 626 "DFC_MoXEMMHwLTMonBIST" 627 "DFC_MoXEMMHwLTRegMonTest" 628 "DFC_MoXEMMHwLTStbySMUAlvTest" 629 "DFC_MoXEMMHwLTTempSens" 630 "DFC_MoXEMMHwLTUCBCfg" 300 "DFC_MRlyDcOL" 301 "DFC_MRlyDcSCB" 302 "DFC_MRlyDcSCG" 413 "DFC_MRlyOL" 414 "DFC_MRlySCB" 415 "DFC_MRlySCG" 631 "DFC_OCWDAABEActv" 632 "DFC_OCWDACom" 633 "DFC_OCWDAErrPin" 634 "DFC_OCWDAOvrVltg" 328 "DFC_OilPNpl" 635 "DFC_ORAmax" 636 "DFC_ORAmin" 647 "DFC_P_VSE11_OL" 648 "DFC_P_VSE11_SCB" 649 "DFC_P_VSE11_SCG" 351 "DFC_PEnvCcMax" 352 "DFC_PEnvCcMin" 353 "DFC_PEnvRngChkMax" 354 "DFC_PEnvRngChkMin" 209 "DFC_PEnvSigRngMax" 210 "DFC_PEnvSigRngMin" 355 "DFC_PEnvSnsrPlaus" 650 "DFC_PhyHighAPP1" 651 "DFC_PhyHighAPP2" 652 "DFC_PhyLowAPP1" 653 "DFC_PhyLowAPP2" 329 "DFC_PIntkVUsLineHiB1" 330 "DFC_PIntkVUsLineLoB1" 637 "DFC_PLLSUmax" 638 "DFC_PLLSUmin" 303 "DFC_PSPOL" 304 "DFC_PSPOvrTemp" 305 "DFC_PSPSCB" 306 "DFC_PSPSCG" 639 "DFC_PSR1max" 640 "DFC_PSRBmax" 641 "DFC_PSRBmin" 645 "DFC_PSRmax" 642 "DFC_PSRPmax" 643 "DFC_PSRPmin" 644 "DFC_PSRPsig" 646 "DFC_PUmax" 396 "DFC_RBA_IODIAGPWR_rba_IoExtCy329_SignalVltSply_0" 397 "DFC_RBA_IODIAGPWR_rba_IoExtCy329_SignalVltSply_0OT" 398 "DFC_RBA_IODIAGPWR_rba_IoExtCy329_SignalVltSply_0OV" 399 "DFC_RBA_IODIAGPWR_rba_IoExtCy329_SignalVltSply_0SCG" 400 "DFC_RBA_IODIAGPWR_rba_IoExtCy329_SignalVltSply_0UV" 401 "DFC_RBA_IODIAGPWR_rba_IoExtCy329_SignalVltSply_1" 402 "DFC_RBA_IODIAGPWR_rba_IoExtCy329_SignalVltSply_1OT" 403 "DFC_RBA_IODIAGPWR_rba_IoExtCy329_SignalVltSply_1OV" 404 "DFC_RBA_IODIAGPWR_rba_IoExtCy329_SignalVltSply_1SCG" 405 "DFC_RBA_IODIAGPWR_rba_IoExtCy329_SignalVltSply_1UV" 406 "DFC_RBA_IODIAGPWR_rba_IoExtCy329_SignalVltSply_2" 407 "DFC_RBA_IODIAGPWR_rba_IoExtCy329_SignalVltSply_2OT" 408 "DFC_RBA_IODIAGPWR_rba_IoExtCy329_SignalVltSply_2OV" 409 "DFC_RBA_IODIAGPWR_rba_IoExtCy329_SignalVltSply_2SCG" 410 "DFC_RBA_IODIAGPWR_rba_IoExtCy329_SignalVltSply_2UV" 419 "DFC_RBA_IOEXTLIB_KEEPALIVE_DRV" 420 "DFC_RBA_IOEXTLIB_KEEPALIVE_INI" 421 "DFC_rba_IoSigRtc_StopCounter" 423 "DFC_rba_MemDiag_MemReadErr" 424 "DFC_rba_MemDiag_MemWrErr" 422 "DFC_rba_MRly_Diag_Stk_Event" 416 "DFC_rba_MultiStackTrace_Threshold" 425 "DFC_rba_SyC_IrrSwOffTrigEngRun_Event" 426 "DFC_rba_T15_Diag_ComInVld_Event" 427 "DFC_rba_T15_Diag_ComOff_HwOn_Event" 428 "DFC_rba_T15_Diag_ComOn_HwOff_Event" 389 "DFC_RoughRoad" 390 "DFC_SiaEEPRdErr" 391 "DFC_SiaEEPWrngCod" 654 "DFC_SRCHighAPP1" 655 "DFC_SRCHighAPP2" 656 "DFC_SRCLowAPP1" 657 "DFC_SRCLowAPP2" 658 "DFC_SSpMon2" 211 "DFC_StmFault" 213 "DFC_StrtCtlErr" 212 "DFC_StrtCtOffPth" 214 "DFC_StrtFault" 215 "DFC_StrtLckJudg1" 216 "DFC_StrtLckJudg2" 217 "DFC_StrtOL" 218 "DFC_StrtOL2" 219 "DFC_StrtSCB" 220 "DFC_StrtSCB2" 221 "DFC_StrtSCG" 222 "DFC_StrtSCG2" 223 "DFC_StrtStkRly1" 224 "DFC_StrtStkRly2" 659 "DFC_SWReset_0" 660 "DFC_SWReset_1" 661 "DFC_SWReset_2" 662 "DFC_SyncAPP" 307 "DFC_T50Err" 663 "DFC_TAmax_Dummy" 225 "DFC_TEVEmax" 226 "DFC_TEVEmin" 227 "DFC_TEVEsig" 671 "DFC_ThrVlvClsdPosnFirstOffsLrnImpoB1" 672 "DFC_ThrVlvClsdPosnOffsLrnImpoB1" 673 "DFC_ThrVlvClsdPosnOffsLrnMaxB1" 674 "DFC_ThrVlvClsdPosnOffsLrnMinB1" 675 "DFC_ThrVlvCtrlDeB1" 676 "DFC_ThrVlvDycB1" 677 "DFC_ThrVlvLimpAirPosnMaxAbsltDriftB1" 678 "DFC_ThrVlvLimpAirPosnMaxB1" 679 "DFC_ThrVlvLimpAirPosnMaxRelDriftB1" 680 "DFC_ThrVlvLimpAirPosnMinB1" 308 "DFC_ThrVlvLoBattB1" 681 "DFC_ThrVlvOpenLoadB1" 682 "DFC_ThrVlvOpenSprgB1" 683 "DFC_ThrVlvOpenSprgSprdB1" 684 "DFC_ThrVlvOpenSprgTwnB1" 685 "DFC_ThrVlvOverTB1" 686 "DFC_ThrVlvRetSprgB1" 687 "DFC_ThrVlvRetSprgSprdB1" 688 "DFC_ThrVlvRetSprgTwnB1" 689 "DFC_ThrVlvSens1MaxB1" 696 "DFC_ThrvlvSens1MinB1" 690 "DFC_ThrVlvSens1NplB1" 691 "DFC_ThrVlvSens2MaxB1" 692 "DFC_ThrVlvSens2MinB1" 693 "DFC_ThrVlvSens2NplB1" 694 "DFC_ThrVlvShoCircB1" 695 "DFC_ThrVlvSpiErrB1" 697 "DFC_TiOffTBasdChkFast" 698 "DFC_TiOffTBasdChkSlow" 664 "DFC_TKAEmax" 665 "DFC_TKAEmin" 666 "DFC_TKARmax" 667 "DFC_TKARnpl" 668 "DFC_TMmax_Dummy" 669 "DFC_TUMmax_Dummy" 670 "DFC_TWCDPriCatB1" 250 "DFC_UEGOASICS1B1" 392 "DFC_UegoDummy" 699 "DFC_UEGOHeatrCtlS1B1" 356 "DFC_UEGOHeatrPsS1B1Max" 357 "DFC_UEGOHeatrPsS1B1Min" 358 "DFC_UEGOHeatrPsS1B1Sig" 359 "DFC_UEGOHeatrRlyPsOLS1B1" 360 "DFC_UEGOHeatrRlyPsSCBS1B1" 361 "DFC_UEGOHeatrRlyPsSCGS1B1" 257 "DFC_UegoOlApesS1B1" 251 "DFC_UEGOOLIPES1B1" 258 "DFC_UegoOlRCmpS1B1" 252 "DFC_UEGOOLRES1B1" 253 "DFC_UEGOSCBS1B1" 254 "DFC_UEGOSCGS1B1" 700 "DFC_UEGOSnsrMntdS1B1" 256 "DFC_UEGOSnsrS1B1" 255 "DFC_UEGOSPIS1B1" 228 "DFC_VehVAllPlaus" 229 "DFC_VehVNCSnsrElecFailr" 309 "DFC_VehVPhysRngHi" 331 "DFC_VehVPhysRngLo" 230 "DFC_VehVPlausCan" 231 "DFC_VehVPlausFco" 232 "DFC_VehVPlausPwr" 233 "DFC_VehVPlausV2N" 310 "DFC_VehVSclOutOL" 311 "DFC_VehVSclOutOT" 312 "DFC_VehVSclOutSCB" 313 "DFC_VehVSclOutSCG" 701 "DFC_VehVSig" 332 "DFC_VehVSigCan" 333 "DFC_VehVSigCanSafe" 314 "DFC_VehVSnsrARngHi" 315 "DFC_VehVSnsrBRngHi" 316 "DFC_VehVSpdRtyDiag" 234 "DFC_VehVSpdSnsrAElecFailr" 235 "DFC_VehVSpdSnsrBElecFailr" 317 "DFC_VehVWhlErr" 334 "DFC_VlvLftFbOilPSnsrIntk11SRCMax" 335 "DFC_VlvLftFbOilPSnsrIntk11SRCMin" 702 "DFC_VlvLftFbSwtIntk11SpclFail" 703 "DFC_VlvLftFbSwtIntk11StdFail" DEFAULT_VALUE "---" /end COMPU_VTAB
/begin COMPU_METHOD DSMDUR_MICntr_COMPU "" RAT_FUNC "%6.2" "h" COEFFS 0 1 0 0 0 1 /end COMPU_METHOD
/begin COMPU_METHOD EngN "" RAT_FUNC "%6.3" "rpm" COEFFS 0 2 0 0 0 1 /end COMPU_METHOD
/begin COMPU_METHOD EngStrt_stRstrtRsn_VERB "" TAB_VERB "%6.3" "" COMPU_TAB_REF EngStrt_stRstrtRsn_VERB /end COMPU_METHOD
/begin COMPU_VTAB EngStrt_stRstrtRsn_VERB "" TAB_VERB 6 0 "ENGSTRT_RSTRTRSN_NONE" 1 "ENGSTRT_RSTRTRSN_STRT" 2 "ENGSTRT_RSTRTRSN_STP" 3 "ENGSTRT_RSTRTRSN_COMSTARTING" 4 "ENGSTRT_RSTRTRSN_COMRUNNING" 5 "ENGSTRT_RESTRTRSN_EXTERNAL" /end COMPU_VTAB
/begin COMPU_METHOD EngStrt_stRstrtStgy_VERB "" TAB_VERB "%6.3" "" COMPU_TAB_REF EngStrt_stRstrtStgy_VERB /end COMPU_METHOD
/begin COMPU_VTAB EngStrt_stRstrtStgy_VERB "" TAB_VERB 5 0 "ENGSTRT_RSTRTSTGY_UNDEF" 1 "ENGSTRT_RSTRTSTGY_RUNNING" 2 "ENGSTRT_RSTRTSTGY_STARTING" 3 "ENGSTRT_RSTRTSTGY_WAIT_FOR_STARTER" 4 "ENGSTRT_RSTRTSTGY_NOCOM_STARTER" /end COMPU_VTAB
/begin COMPU_METHOD ENGSTRT_STSTRTREQ_SET_COMPU_VERB "" TAB_VERB "%6.3" "-" COMPU_TAB_REF ENGSTRT_STSTRTREQ_SET_COMPU_VERB /end COMPU_METHOD
/begin COMPU_VTAB ENGSTRT_STSTRTREQ_SET_COMPU_VERB "" TAB_VERB 6 0 "ENGSTRT_NOSTRT" 1025 "ENGSTRT_PFI" 8192 "ENGSTRT_COMRUNNG" 8193 "ENGSTRT_COMSTRTG" 8194 "ENGSTRT_COMWAITSTRTR" 16384 "ENGSTRT_FOLW" /end COMPU_VTAB
/begin COMPU_METHOD Fact "" RAT_FUNC "%6.5" "-" COEFFS 0 8192 0 0 0 1 /end COMPU_METHOD
/begin COMPU_METHOD Fact1 "" RAT_FUNC "%6.4" "-" COEFFS 0 128 0 0 0 1 /end COMPU_METHOD
/begin COMPU_METHOD FLSPLSYSTST_SC_Compu "" TAB_VERB "%6.3" "" COMPU_TAB_REF FLSPLSYSTST_SC_Compu /end COMPU_METHOD
/begin COMPU_VTAB FLSPLSYSTST_SC_Compu "" TAB_VERB 3 0 "0" 1 "1" 2 "2" /end COMPU_VTAB
/begin COMPU_METHOD FLSYS_RUNDRYPRV_SY_Compu "" TAB_VERB "%6.3" "" COMPU_TAB_REF FLSYS_RUNDRYPRV_SY_Compu /end COMPU_METHOD
/begin COMPU_VTAB FLSYS_RUNDRYPRV_SY_Compu "" TAB_VERB 2 0 "False" 1 "True" /end COMPU_VTAB
/begin COMPU_METHOD FLT_IALCK_SY_Compu "" TAB_VERB "%6.3" "" COMPU_TAB_REF FLT_IALCK_SY_Compu /end COMPU_METHOD
/begin COMPU_VTAB FLT_IALCK_SY_Compu "" TAB_VERB 2 0 "0" 1 "1" /end COMPU_VTAB
/begin COMPU_METHOD FLT_IARLS_SY_Compu "" TAB_VERB "%6.3" "" COMPU_TAB_REF FLT_IARLS_SY_Compu /end COMPU_METHOD
/begin COMPU_VTAB FLT_IARLS_SY_Compu "" TAB_VERB 2 0 "0" 1 "1" /end COMPU_VTAB
/begin COMPU_METHOD FlVolFlw_COMPU "" RAT_FUNC "%6.3" "l/h" COEFFS 0 10 0 0 0 1 /end COMPU_METHOD
/begin COMPU_METHOD FLXR_SY_Compu "" TAB_VERB "%6.3" "" COMPU_TAB_REF FLXR_SY_Compu /end COMPU_METHOD
/begin COMPU_VTAB FLXR_SY_Compu "" TAB_VERB 2 0 "FALSE" 1 "TRUE" /end COMPU_VTAB
/begin COMPU_METHOD Fl_2 "" RAT_FUNC "%6.1" "l" COEFFS 0 0.1 0 0 0 1 /end COMPU_METHOD
/begin COMPU_METHOD Fl_Half_L "" RAT_FUNC "%6.3" "l" COEFFS 0 2 0 0 0 1 /end COMPU_METHOD
/begin COMPU_METHOD Fl_L "" RAT_FUNC "%6.4" "l" COEFFS 0 100 0 0 0 1 /end COMPU_METHOD
/begin COMPU_METHOD Fl_Vol "" RAT_FUNC "%6.5" "l/100km" COEFFS 0 1000 0 0 0 1 /end COMPU_METHOD
/begin COMPU_METHOD Fl_Vol_q0p05 "" RAT_FUNC "%6.4" "l" COEFFS 0 20 0 0 0 1 /end COMPU_METHOD
/begin COMPU_METHOD FPCACTVDCARBONFILMDL_SC_Compu "" TAB_VERB "%6.3" "" COMPU_TAB_REF FPCACTVDCARBONFILMDL_SC_Compu /end COMPU_METHOD
/begin COMPU_VTAB FPCACTVDCARBONFILMDL_SC_Compu "" TAB_VERB 2 0 "False" 1 "True" /end COMPU_VTAB
/begin COMPU_METHOD FPCAIRLIMN_SC_Compu "" TAB_VERB "%6.3" "" COMPU_TAB_REF FPCAIRLIMN_SC_Compu /end COMPU_METHOD
/begin COMPU_VTAB FPCAIRLIMN_SC_Compu "" TAB_VERB 2 0 "False" 1 "True" /end COMPU_VTAB
/begin COMPU_METHOD FPCCPVADPN_SC_Compu "" TAB_VERB "%6.3" "" COMPU_TAB_REF FPCCPVADPN_SC_Compu /end COMPU_METHOD
/begin COMPU_VTAB FPCCPVADPN_SC_Compu "" TAB_VERB 2 0 "False" 1 "True" /end COMPU_VTAB
/begin COMPU_METHOD FPCDHV_SC_Compu "" TAB_VERB "%6.3" "" COMPU_TAB_REF FPCDHV_SC_Compu /end COMPU_METHOD
/begin COMPU_VTAB FPCDHV_SC_Compu "" TAB_VERB 2 0 "False" 1 "True" /end COMPU_VTAB
/begin COMPU_METHOD FPCDSSP_SC_Compu "" TAB_VERB "%6.3" "" COMPU_TAB_REF FPCDSSP_SC_Compu /end COMPU_METHOD
/begin COMPU_VTAB FPCDSSP_SC_Compu "" TAB_VERB 2 0 "False" 1 "True" /end COMPU_VTAB
/begin COMPU_METHOD FPCEVLNRLMIN_SC_Compu "" TAB_VERB "%6.3" "" COMPU_TAB_REF FPCEVLNRLMIN_SC_Compu /end COMPU_METHOD
/begin COMPU_VTAB FPCEVLNRLMIN_SC_Compu "" TAB_VERB 2 0 "False" 1 "True" /end COMPU_VTAB
/begin COMPU_METHOD FPCEXTTANKFCTMODL_SC_Compu "" TAB_VERB "%6.3" "" COMPU_TAB_REF FPCEXTTANKFCTMODL_SC_Compu /end COMPU_METHOD
/begin COMPU_VTAB FPCEXTTANKFCTMODL_SC_Compu "" TAB_VERB 2 0 "False" 1 "True" /end COMPU_VTAB
/begin COMPU_METHOD FPCGGRW_SC_Compu "" TAB_VERB "%6.3" "" COMPU_TAB_REF FPCGGRW_SC_Compu /end COMPU_METHOD
/begin COMPU_VTAB FPCGGRW_SC_Compu "" TAB_VERB 2 0 "False" 1 "True" /end COMPU_VTAB
/begin COMPU_METHOD FPCMCAN_SC_Compu "" TAB_VERB "%6.3" "" COMPU_TAB_REF FPCMCAN_SC_Compu /end COMPU_METHOD
/begin COMPU_VTAB FPCMCAN_SC_Compu "" TAB_VERB 3 0 "0" 1 "1" 2 "2" /end COMPU_VTAB
/begin COMPU_METHOD FPCMSLSU_SC_Compu "" TAB_VERB "%6.3" "" COMPU_TAB_REF FPCMSLSU_SC_Compu /end COMPU_METHOD
/begin COMPU_VTAB FPCMSLSU_SC_Compu "" TAB_VERB 2 0 "False" 1 "True" /end COMPU_VTAB
/begin COMPU_METHOD FPCOPTSTOPINHBN_SC_Compu "" TAB_VERB "%6.3" "" COMPU_TAB_REF FPCOPTSTOPINHBN_SC_Compu /end COMPU_METHOD
/begin COMPU_VTAB FPCOPTSTOPINHBN_SC_Compu "" TAB_VERB 2 0 "False" 1 "True" /end COMPU_VTAB
/begin COMPU_METHOD FPCPRIOTEHEX_SC_Compu "" TAB_VERB "%6.3" "" COMPU_TAB_REF FPCPRIOTEHEX_SC_Compu /end COMPU_METHOD
/begin COMPU_VTAB FPCPRIOTEHEX_SC_Compu "" TAB_VERB 2 0 "False" 1 "True" /end COMPU_VTAB
/begin COMPU_METHOD FPCTL_ADPNWOMIXADPNFLT_SC_Compu "" TAB_VERB "%6.3" "" COMPU_TAB_REF FPCTL_ADPNWOMIXADPNFLT_SC_Compu /end COMPU_METHOD
/begin COMPU_VTAB FPCTL_ADPNWOMIXADPNFLT_SC_Compu "" TAB_VERB 2 0 "False" 1 "True" /end COMPU_VTAB
/begin COMPU_METHOD FPCTL_MFLOWLIMNLOADCHG_SC_Compu "" TAB_VERB "%6.3" "" COMPU_TAB_REF FPCTL_MFLOWLIMNLOADCHG_SC_Compu /end COMPU_METHOD
/begin COMPU_VTAB FPCTL_MFLOWLIMNLOADCHG_SC_Compu "" TAB_VERB 2 0 "NO_LIMNMFLOW" 1 "ACTV_LIMNMFLOW" /end COMPU_VTAB
/begin COMPU_METHOD FPCTL_REDNPURGIDLEMOD_SC_Compu "" TAB_VERB "%6.3" "" COMPU_TAB_REF FPCTL_REDNPURGIDLEMOD_SC_Compu /end COMPU_METHOD
/begin COMPU_VTAB FPCTL_REDNPURGIDLEMOD_SC_Compu "" TAB_VERB 2 0 "False" 1 "True" /end COMPU_VTAB
/begin COMPU_METHOD FPCTL_VAR_SY_Compu "" TAB_VERB "%6.3" "" COMPU_TAB_REF FPCTL_VAR_SY_Compu /end COMPU_METHOD
/begin COMPU_VTAB FPCTL_VAR_SY_Compu "" TAB_VERB 44 1 "DAI" 3 "VWW" 4 "POR" 5 "AUD" 6 "OPE" 9 "FIA" 11 "BMW" 14 "PSA" 15 "REN" 17 "ALF" 18 "SAB" 19 "VOL" 20 "NIS" 21 "GMU" 22 "FOR" 26 "IMJ" 51 "SEA" 53 "CHR" 54 "JAG" 55 "ROL" 69 "FER" 72 "TOY" 123 "MIT" 147 "HYU" 159 "HON" 160 "MAZ" 183 "CU" 190 "LRG" 204 "VVW" 214 "AVT" 242 "Iveco" 243 "DMC" 248 "SUZ" 267 "SSANGYONG" 270 "KEF" 289 "AMG" 308 "TAT" 319 "MVM" 385 "UAES" 590 "Scania" 828 "RBCD" 999 "ALL" 2887 "Nonox" 9454 "Fuso" /end COMPU_VTAB
/begin COMPU_METHOD FPCTL_VOLFLOWTOMFLOW_SC_Compu "" TAB_VERB "%6.3" "" COMPU_TAB_REF FPCTL_VOLFLOWTOMFLOW_SC_Compu /end COMPU_METHOD
/begin COMPU_VTAB FPCTL_VOLFLOWTOMFLOW_SC_Compu "" TAB_VERB 2 0 "normalized_mass_flow_PCV" 1 "volume_flow" /end COMPU_VTAB
/begin COMPU_METHOD FRARTP_SC_Compu "" TAB_VERB "%6.3" "" COMPU_TAB_REF FRARTP_SC_Compu /end COMPU_METHOD
/begin COMPU_VTAB FRARTP_SC_Compu "" TAB_VERB 2 0 "NO_FRARTP" 1 "FRARTP_USED" /end COMPU_VTAB
/begin COMPU_METHOD FRNM_SC_Compu "" TAB_VERB "%6.3" "" COMPU_TAB_REF FRNM_SC_Compu /end COMPU_METHOD
/begin COMPU_VTAB FRNM_SC_Compu "" TAB_VERB 2 0 "False" 1 "True" /end COMPU_VTAB
/begin COMPU_METHOD FrqCylPres "" RAT_FUNC "%6.2" "Hz" COEFFS 0 1 0 0 0 1 /end COMPU_METHOD
/begin COMPU_METHOD FRTP_SC_Compu "" TAB_VERB "%6.3" "" COMPU_TAB_REF FRTP_SC_Compu /end COMPU_METHOD
/begin COMPU_VTAB FRTP_SC_Compu "" TAB_VERB 2 0 "False" 1 "True" /end COMPU_VTAB
/begin COMPU_METHOD FRTSYN_SC_Compu "" TAB_VERB "%6.3" "" COMPU_TAB_REF FRTSYN_SC_Compu /end COMPU_METHOD
/begin COMPU_VTAB FRTSYN_SC_Compu "" TAB_VERB 2 0 "False" 1 "True" /end COMPU_VTAB
/begin COMPU_METHOD FSNW_SY_Compu "" TAB_VERB "%6.3" "" COMPU_TAB_REF FSNW_SY_Compu /end COMPU_METHOD
/begin COMPU_VTAB FSNW_SY_Compu "" TAB_VERB 2 0 "0" 1 "1" /end COMPU_VTAB
/begin COMPU_METHOD FSPDSFLDP_TYPAVL_SC_Compu "" TAB_VERB "%6.3" "" COMPU_TAB_REF FSPDSFLDP_TYPAVL_SC_Compu /end COMPU_METHOD
/begin COMPU_VTAB FSPDSFLDP_TYPAVL_SC_Compu "" TAB_VERB 2 0 "False" 1 "True" /end COMPU_VTAB
/begin COMPU_METHOD FTIVCPVR_SC_Compu "" TAB_VERB "%6.3" "" COMPU_TAB_REF FTIVCPVR_SC_Compu /end COMPU_METHOD
/begin COMPU_VTAB FTIVCPVR_SC_Compu "" TAB_VERB 2 0 "False" 1 "True" /end COMPU_VTAB
/begin COMPU_METHOD FUAGIDETN_INDCNENA_SC_Compu "" TAB_VERB "%6.3" "" COMPU_TAB_REF FUAGIDETN_INDCNENA_SC_Compu /end COMPU_METHOD
/begin COMPU_VTAB FUAGIDETN_INDCNENA_SC_Compu "" TAB_VERB 2 0 "False" 1 "True" /end COMPU_VTAB
/begin COMPU_METHOD FUELP_SENSTYP_SY_Compu "" TAB_VERB "%6.3" "" COMPU_TAB_REF FUELP_SENSTYP_SY_Compu /end COMPU_METHOD
/begin COMPU_VTAB FUELP_SENSTYP_SY_Compu "" TAB_VERB 5 0 "NO_P" 1 "P_ABS_ADC" 2 "P_REL_ADC" 3 "P_ABS_CAN" 4 "P_REL_CAN" /end COMPU_VTAB
/begin COMPU_METHOD FUELP_TYPAVL_SY_Compu "" TAB_VERB "%6.3" "" COMPU_TAB_REF FUELP_TYPAVL_SY_Compu /end COMPU_METHOD
/begin COMPU_VTAB FUELP_TYPAVL_SY_Compu "" TAB_VERB 2 0 "False" 1 "True" /end COMPU_VTAB
/begin COMPU_METHOD FUELT2_TYPAVL_SC_Compu "" TAB_VERB "%6.3" "" COMPU_TAB_REF FUELT2_TYPAVL_SC_Compu /end COMPU_METHOD
/begin COMPU_VTAB FUELT2_TYPAVL_SC_Compu "" TAB_VERB 2 0 "False" 1 "True" /end COMPU_VTAB
/begin COMPU_METHOD FUELT_TYPAVL_SY_Compu "" TAB_VERB "%6.3" "" COMPU_TAB_REF FUELT_TYPAVL_SY_Compu /end COMPU_METHOD
/begin COMPU_VTAB FUELT_TYPAVL_SY_Compu "" TAB_VERB 2 0 "False" 1 "True" /end COMPU_VTAB
/begin COMPU_METHOD FUEVAPOIL_SC_Compu "" TAB_VERB "%6.3" "" COMPU_TAB_REF FUEVAPOIL_SC_Compu /end COMPU_METHOD
/begin COMPU_VTAB FUEVAPOIL_SC_Compu "" TAB_VERB 4 0 "no modelling" 1 "only model" 2 "lambda adaptation" 3 "LAMKORRLL adaptation" /end COMPU_VTAB
/begin COMPU_METHOD FUEVAPPURGP_TYPAVL_SC_Compu "" TAB_VERB "%6.3" "" COMPU_TAB_REF FUEVAPPURGP_TYPAVL_SC_Compu /end COMPU_METHOD
/begin COMPU_VTAB FUEVAPPURGP_TYPAVL_SC_Compu "" TAB_VERB 2 0 "False" 1 "True" /end COMPU_VTAB
/begin COMPU_METHOD FUEVAPPURGT_TYPAVL_SC_Compu "" TAB_VERB "%6.3" "" COMPU_TAB_REF FUEVAPPURGT_TYPAVL_SC_Compu /end COMPU_METHOD
/begin COMPU_VTAB FUEVAPPURGT_TYPAVL_SC_Compu "" TAB_VERB 2 0 "False" 1 "True" /end COMPU_VTAB
/begin COMPU_METHOD FUEVAPPURGT_TYPTWINFLW_SC_Compu "" TAB_VERB "%6.3" "" COMPU_TAB_REF FUEVAPPURGT_TYPTWINFLW_SC_Compu /end COMPU_METHOD
/begin COMPU_VTAB FUEVAPPURGT_TYPTWINFLW_SC_Compu "" TAB_VERB 2 0 "False" 1 "True" /end COMPU_VTAB
/begin COMPU_METHOD FULCOMP_SY_Compu "" TAB_VERB "%6.3" "" COMPU_TAB_REF FULCOMP_SY_Compu /end COMPU_METHOD
/begin COMPU_VTAB FULCOMP_SY_Compu "" TAB_VERB 2 0 "False" 1 "True" /end COMPU_VTAB
/begin COMPU_METHOD FULVLSNSRARCHSWT_SC_Compu "" TAB_VERB "%6.3" "" COMPU_TAB_REF FULVLSNSRARCHSWT_SC_Compu /end COMPU_METHOD
/begin COMPU_VTAB FULVLSNSRARCHSWT_SC_Compu "" TAB_VERB 2 0 "0" 1 "1" /end COMPU_VTAB
/begin COMPU_METHOD FUMIXPCALCN_SC_Compu "" TAB_VERB "%6.3" "" COMPU_TAB_REF FUMIXPCALCN_SC_Compu /end COMPU_METHOD
/begin COMPU_VTAB FUMIXPCALCN_SC_Compu "" TAB_VERB 2 0 "False" 1 "True" /end COMPU_VTAB
/begin COMPU_METHOD FUPURGEMGYFCO_SC_Compu "" TAB_VERB "%6.3" "" COMPU_TAB_REF FUPURGEMGYFCO_SC_Compu /end COMPU_METHOD
/begin COMPU_VTAB FUPURGEMGYFCO_SC_Compu "" TAB_VERB 2 0 "False" 1 "True" /end COMPU_VTAB
/begin COMPU_METHOD GBXCSC_SY_Compu "" TAB_VERB "%6.3" "" COMPU_TAB_REF GBXCSC_SY_Compu /end COMPU_METHOD
/begin COMPU_VTAB GBXCSC_SY_Compu "" TAB_VERB 2 0 "False" 1 "True" /end COMPU_VTAB
/begin COMPU_METHOD GBXIDLECRP_SC_Compu "" TAB_VERB "%6.3" "" COMPU_TAB_REF GBXIDLECRP_SC_Compu /end COMPU_METHOD
/begin COMPU_VTAB GBXIDLECRP_SC_Compu "" TAB_VERB 2 0 "False" 1 "True" /end COMPU_VTAB
/begin COMPU_METHOD GBXNPOS_SY_Compu "" TAB_VERB "%6.3" "" COMPU_TAB_REF GBXNPOS_SY_Compu /end COMPU_METHOD
/begin COMPU_VTAB GBXNPOS_SY_Compu "" TAB_VERB 7 0 "GBXNPOS_OFF" 1 "GBXNPOS_ADC" 2 "GBXNPOS_PWM" 3 "GBXNPOS_INTSENS" 4 "GBXNPOS_CAL" 5 "GBXNPOS_DIO" 6 "GBXNPOS_CAN" /end COMPU_VTAB
/begin COMPU_METHOD GBXOILP_TYPAVL_SY_Compu "" TAB_VERB "%6.3" "" COMPU_TAB_REF GBXOILP_TYPAVL_SY_Compu /end COMPU_METHOD
/begin COMPU_VTAB GBXOILP_TYPAVL_SY_Compu "" TAB_VERB 2 0 "False" 1 "True" /end COMPU_VTAB
/begin COMPU_METHOD GBXOILT_TYPAVL_SY_Compu "" TAB_VERB "%6.3" "" COMPU_TAB_REF GBXOILT_TYPAVL_SY_Compu /end COMPU_METHOD
/begin COMPU_VTAB GBXOILT_TYPAVL_SY_Compu "" TAB_VERB 2 0 "False" 1 "True" /end COMPU_VTAB
/begin COMPU_METHOD GBXPNPOS_SC_Compu "" TAB_VERB "%6.3" "" COMPU_TAB_REF GBXPNPOS_SC_Compu /end COMPU_METHOD
/begin COMPU_VTAB GBXPNPOS_SC_Compu "" TAB_VERB 2 0 "False" 1 "True" /end COMPU_VTAB
/begin COMPU_METHOD GBX_ATNEUTCTRLSYS_SC_Compu "" TAB_VERB "%6.3" "" COMPU_TAB_REF GBX_ATNEUTCTRLSYS_SC_Compu /end COMPU_METHOD
/begin COMPU_VTAB GBX_ATNEUTCTRLSYS_SC_Compu "" TAB_VERB 2 0 "False" 1 "True" /end COMPU_VTAB
/begin COMPU_METHOD GC_Volt "" RAT_FUNC "%6.2" "mV" COEFFS 0 0.2046 0 0 0 1 /end COMPU_METHOD
/begin COMPU_METHOD GDI_SY_Compu "" TAB_VERB "%6.3" "" COMPU_TAB_REF GDI_SY_Compu /end COMPU_METHOD
/begin COMPU_VTAB GDI_SY_Compu "" TAB_VERB 2 0 "GDI_NO" 1 "GDI" /end COMPU_VTAB
/begin COMPU_METHOD GEARBX_NUMGEAR_MAX_Compu "" RAT_FUNC "%6.2" "" COEFFS 0 1 0 0 0 1 /end COMPU_METHOD
/begin COMPU_METHOD GEARSHIFTSUPRTMT_SC_Compu "" TAB_VERB "%6.3" "" COMPU_TAB_REF GEARSHIFTSUPRTMT_SC_Compu /end COMPU_METHOD
/begin COMPU_VTAB GEARSHIFTSUPRTMT_SC_Compu "" TAB_VERB 2 0 "not_available" 1 "active_MT" /end COMPU_VTAB
/begin COMPU_METHOD GENERICLIMNOVRDSTSCINC_SC_Compu "" TAB_VERB "%6.3" "" COMPU_TAB_REF GENERICLIMNOVRDSTSCINC_SC_Compu /end COMPU_METHOD
/begin COMPU_VTAB GENERICLIMNOVRDSTSCINC_SC_Compu "" TAB_VERB 2 0 "False" 1 "True" /end COMPU_VTAB
/begin COMPU_METHOD GENINHIB_SY_Compu "" TAB_VERB "%6.3" "" COMPU_TAB_REF GENINHIB_SY_Compu /end COMPU_METHOD
/begin COMPU_VTAB GENINHIB_SY_Compu "" TAB_VERB 2 0 "False" 1 "True" /end COMPU_VTAB
/begin COMPU_METHOD GEVCTL_BASCONLY_SC_Compu "" TAB_VERB "%6.3" "" COMPU_TAB_REF GEVCTL_BASCONLY_SC_Compu /end COMPU_METHOD
/begin COMPU_VTAB GEVCTL_BASCONLY_SC_Compu "" TAB_VERB 2 0 "False" 1 "True" /end COMPU_VTAB
/begin COMPU_METHOD GEVCTL_REQADPNEXT_SC_Compu "" TAB_VERB "%6.3" "" COMPU_TAB_REF GEVCTL_REQADPNEXT_SC_Compu /end COMPU_METHOD
/begin COMPU_VTAB GEVCTL_REQADPNEXT_SC_Compu "" TAB_VERB 2 0 "NoReq" 1 "Req" /end COMPU_VTAB
/begin COMPU_METHOD GEVCTL_VAR_SY_Compu "" TAB_VERB "%6.3" "" COMPU_TAB_REF GEVCTL_VAR_SY_Compu /end COMPU_METHOD
/begin COMPU_VTAB GEVCTL_VAR_SY_Compu "" TAB_VERB 44 1 "DAI" 3 "VWW" 4 "POR" 5 "AUD" 6 "OPE" 9 "FIA" 11 "BMW" 14 "PSA" 15 "REN" 17 "ALF" 18 "SAB" 19 "VOL" 20 "NIS" 21 "GMU" 22 "FOR" 26 "IMJ" 51 "SEA" 53 "CHR" 54 "JAG" 55 "ROL" 69 "FER" 72 "TOY" 123 "MIT" 147 "HYU" 159 "HON" 160 "MAZ" 183 "CU" 190 "LRG" 204 "VVW" 214 "AVT" 242 "Iveco" 243 "DMC" 248 "SUZ" 267 "SSANGYONG" 270 "KEF" 289 "AMG" 308 "TAT" 319 "MVM" 385 "UAES" 590 "Scania" 828 "RBCD" 999 "ALL" 2887 "Nonox" 9454 "Fuso" /end COMPU_VTAB
/begin COMPU_METHOD GEVCTL_VLVOPENCLSDARY_SC_Compu "" TAB_VERB "%6.3" "" COMPU_TAB_REF GEVCTL_VLVOPENCLSDARY_SC_Compu /end COMPU_METHOD
/begin COMPU_VTAB GEVCTL_VLVOPENCLSDARY_SC_Compu "" TAB_VERB 2 0 "NoArray" 1 "Array" /end COMPU_VTAB
/begin COMPU_METHOD GLBDALSUMAVS_SY_Compu "" TAB_VERB "%6.3" "" COMPU_TAB_REF GLBDALSUMAVS_SY_Compu /end COMPU_METHOD
/begin COMPU_VTAB GLBDALSUMAVS_SY_Compu "" TAB_VERB 2 0 "False" 1 "True" /end COMPU_VTAB
/begin COMPU_METHOD GLBDA_ACTRACTVN_SC_Compu "" TAB_VERB "%6.3" "" COMPU_TAB_REF GLBDA_ACTRACTVN_SC_Compu /end COMPU_METHOD
/begin COMPU_VTAB GLBDA_ACTRACTVN_SC_Compu "" TAB_VERB 2 0 "Disable_Actuator_Activation" 1 "Enable_Actuator_Activation" /end COMPU_VTAB
/begin COMPU_METHOD GLBDA_ENAVEHDRVGDIRDETN_SC_Compu "" TAB_VERB "%6.3" "" COMPU_TAB_REF GLBDA_ENAVEHDRVGDIRDETN_SC_Compu /end COMPU_METHOD
/begin COMPU_VTAB GLBDA_ENAVEHDRVGDIRDETN_SC_Compu "" TAB_VERB 2 0 "False" 1 "True" /end COMPU_VTAB
/begin COMPU_METHOD GLBDA_LSUMMODE_SC_Compu "" TAB_VERB "%6.3" "" COMPU_TAB_REF GLBDA_LSUMMODE_SC_Compu /end COMPU_METHOD
/begin COMPU_VTAB GLBDA_LSUMMODE_SC_Compu "" TAB_VERB 3 0 "0" 1 "1" 2 "2" /end COMPU_VTAB
/begin COMPU_METHOD GPFRGNAIRVLV_SC_Compu "" TAB_VERB "%6.3" "" COMPU_TAB_REF GPFRGNAIRVLV_SC_Compu /end COMPU_METHOD
/begin COMPU_VTAB GPFRGNAIRVLV_SC_Compu "" TAB_VERB 2 0 "Does_not_exist" 1 "Exists" /end COMPU_VTAB
/begin COMPU_METHOD GPFRGNFANENA_INHOUSE_SC_Compu "" TAB_VERB "%6.3" "" COMPU_TAB_REF GPFRGNFANENA_INHOUSE_SC_Compu /end COMPU_METHOD
/begin COMPU_VTAB GPFRGNFANENA_INHOUSE_SC_Compu "" TAB_VERB 2 0 "RB" 1 "SWSH" /end COMPU_VTAB
/begin COMPU_METHOD GrpDlyTime "" RAT_FUNC "%6.3" "usec" COEFFS 0 10 0 0 0 1 /end COMPU_METHOD
/begin COMPU_METHOD GSHDEM_AVL_SC_Compu "" TAB_VERB "%6.3" "" COMPU_TAB_REF GSHDEM_AVL_SC_Compu /end COMPU_METHOD
/begin COMPU_VTAB GSHDEM_AVL_SC_Compu "" TAB_VERB 3 0 "0" 1 "1" 2 "2" /end COMPU_VTAB
/begin COMPU_METHOD GSHDEM_PRELOAD_SC_Compu "" TAB_VERB "%6.3" "" COMPU_TAB_REF GSHDEM_PRELOAD_SC_Compu /end COMPU_METHOD
/begin COMPU_VTAB GSHDEM_PRELOAD_SC_Compu "" TAB_VERB 2 0 "False" 1 "True" /end COMPU_VTAB
/begin COMPU_METHOD GSSYS_TYPEEXHFLW_SY_Compu "" TAB_VERB "%6.3" "" COMPU_TAB_REF GSSYS_TYPEEXHFLW_SY_Compu /end COMPU_METHOD
/begin COMPU_VTAB GSSYS_TYPEEXHFLW_SY_Compu "" TAB_VERB 2 1 "HESRV_SNGLFLW" 2 "HESRV_TWFLW" /end COMPU_VTAB
/begin COMPU_METHOD GSSYS_TYPENG_SY_Compu "" TAB_VERB "%6.3" "" COMPU_TAB_REF GSSYS_TYPENG_SY_Compu /end COMPU_METHOD
/begin COMPU_VTAB GSSYS_TYPENG_SY_Compu "" TAB_VERB 2 1 "HESRV_SNGLFLW" 2 "HESRV_TWFLW" /end COMPU_VTAB
/begin COMPU_METHOD GSSYS_TYPINDVOL_SY_Compu "" TAB_VERB "%6.3" "" COMPU_TAB_REF GSSYS_TYPINDVOL_SY_Compu /end COMPU_METHOD
/begin COMPU_VTAB GSSYS_TYPINDVOL_SY_Compu "" TAB_VERB 3 0 "HESRV_NOTUSED" 1 "HESRV_SNGLFLW" 2 "HESRV_TWFLW" /end COMPU_VTAB
/begin COMPU_METHOD GSSYS_TYPPCR_SY_Compu "" TAB_VERB "%6.3" "" COMPU_TAB_REF GSSYS_TYPPCR_SY_Compu /end COMPU_METHOD
/begin COMPU_VTAB GSSYS_TYPPCR_SY_Compu "" TAB_VERB 2 1 "HESRV_SNGLFLW" 2 "HESRV_TWFLW" /end COMPU_VTAB
/begin COMPU_METHOD H2CORS2_SY_Compu "" TAB_VERB "%6.3" "" COMPU_TAB_REF H2CORS2_SY_Compu /end COMPU_METHOD
/begin COMPU_VTAB H2CORS2_SY_Compu "" TAB_VERB 2 0 "False" 1 "True" /end COMPU_VTAB
/begin COMPU_METHOD H2CORS3_SY_Compu "" TAB_VERB "%6.3" "" COMPU_TAB_REF H2CORS3_SY_Compu /end COMPU_METHOD
/begin COMPU_VTAB H2CORS3_SY_Compu "" TAB_VERB 2 0 "False" 1 "True" /end COMPU_VTAB
/begin COMPU_METHOD H2ICE_SC_Compu "" TAB_VERB "%6.3" "" COMPU_TAB_REF H2ICE_SC_Compu /end COMPU_METHOD
/begin COMPU_VTAB H2ICE_SC_Compu "" TAB_VERB 3 0 "NO_H2ICE" 1 "H2ICE_PI" 2 "H2ICE_DI" /end COMPU_VTAB
/begin COMPU_METHOD HBR_SC_Compu "" TAB_VERB "%6.3" "" COMPU_TAB_REF HBR_SC_Compu /end COMPU_METHOD
/begin COMPU_VTAB HBR_SC_Compu "" TAB_VERB 2 0 "False" 1 "True" /end COMPU_VTAB
/begin COMPU_METHOD HCI_HCDOSSYS_SC_Compu "" TAB_VERB "%6.3" "" COMPU_TAB_REF HCI_HCDOSSYS_SC_Compu /end COMPU_METHOD
/begin COMPU_VTAB HCI_HCDOSSYS_SC_Compu "" TAB_VERB 4 0 "no_HCI" 1 "HCDos_with_DCU" 2 "HCDos_with_PowerSwitch" 3 "HCDos_integrated" /end COMPU_VTAB
/begin COMPU_METHOD HCMassPerTime "" RAT_FUNC "%6.3" "mg/s" COEFFS 0 10 0 0 0 1 /end COMPU_METHOD
/begin COMPU_METHOD HCMassPerTime_q0p0000004 "" RAT_FUNC "%9.8" "kg/s" COEFFS 0 2500000 0 0 0 1 /end COMPU_METHOD
/begin COMPU_METHOD HCMassPerTime_q0p4 "" RAT_FUNC "%6.3" "mg/s" COEFFS 0 2.5 0 0 0 1 /end COMPU_METHOD
/begin COMPU_METHOD HCMassPerTime_q0p8 "" RAT_FUNC "%6.2" "mg/s" COEFFS 0 1.25 0 0 0 1 /end COMPU_METHOD
/begin COMPU_METHOD HCMass_q0p005 "" RAT_FUNC "%6.4" "g" COEFFS 0 200 0 0 0 1 /end COMPU_METHOD
/begin COMPU_METHOD HDC_SY_Compu "" TAB_VERB "%6.3" "" COMPU_TAB_REF HDC_SY_Compu /end COMPU_METHOD
/begin COMPU_VTAB HDC_SY_Compu "" TAB_VERB 2 0 "False" 1 "True" /end COMPU_VTAB
/begin COMPU_METHOD HDLI_HWACTV_SY_Compu "" TAB_VERB "%6.3" "" COMPU_TAB_REF HDLI_HWACTV_SY_Compu /end COMPU_METHOD
/begin COMPU_VTAB HDLI_HWACTV_SY_Compu "" TAB_VERB 2 0 "False" 1 "True" /end COMPU_VTAB
/begin COMPU_METHOD HeatCapacity "" RAT_FUNC "%6.3" "J/K" COEFFS 0 10 0 0 0 1 /end COMPU_METHOD
/begin COMPU_METHOD HEATRCORET_TYPAVL_SC_Compu "" TAB_VERB "%6.3" "" COMPU_TAB_REF HEATRCORET_TYPAVL_SC_Compu /end COMPU_METHOD
/begin COMPU_VTAB HEATRCORET_TYPAVL_SC_Compu "" TAB_VERB 2 0 "False" 1 "True" /end COMPU_VTAB
/begin COMPU_METHOD HEGNDIAGU_SC_Compu "" TAB_VERB "%6.3" "" COMPU_TAB_REF HEGNDIAGU_SC_Compu /end COMPU_METHOD
/begin COMPU_VTAB HEGNDIAGU_SC_Compu "" TAB_VERB 2 0 "WoDiagSnsrU" 1 "WithDiagSnsrU" /end COMPU_VTAB
/begin COMPU_METHOD HEGNNMNGCNVTN_SC_Compu "" TAB_VERB "%6.3" "" COMPU_TAB_REF HEGNNMNGCNVTN_SC_Compu /end COMPU_METHOD
/begin COMPU_VTAB HEGNNMNGCNVTN_SC_Compu "" TAB_VERB 6 0 "GS-classic" 1 "AUTOSAR R2.0" 2 "AUTOSAR R4.0" 3 "mixed AUTOSAR R2.0/GS-classic" 4 "mixed AUTOSAR R4.0/GS-classic" 5 "mixed AUTOSAR R2.0/AUTOSAR R4.0" /end COMPU_VTAB
/begin COMPU_METHOD HEGNS3B1_SC_Compu "" TAB_VERB "%6.3" "" COMPU_TAB_REF HEGNS3B1_SC_Compu /end COMPU_METHOD
/begin COMPU_VTAB HEGNS3B1_SC_Compu "" TAB_VERB 2 0 "False" 1 "True" /end COMPU_VTAB
/begin COMPU_METHOD HEGNS3B2_SC_Compu "" TAB_VERB "%6.3" "" COMPU_TAB_REF HEGNS3B2_SC_Compu /end COMPU_METHOD
/begin COMPU_VTAB HEGNS3B2_SC_Compu "" TAB_VERB 2 0 "False" 1 "True" /end COMPU_VTAB
/begin COMPU_METHOD HEGNS4B1_SC_Compu "" TAB_VERB "%6.3" "" COMPU_TAB_REF HEGNS4B1_SC_Compu /end COMPU_METHOD
/begin COMPU_VTAB HEGNS4B1_SC_Compu "" TAB_VERB 2 0 "False" 1 "True" /end COMPU_VTAB
/begin COMPU_METHOD HEGNS4B2_SC_Compu "" TAB_VERB "%6.3" "" COMPU_TAB_REF HEGNS4B2_SC_Compu /end COMPU_METHOD
/begin COMPU_VTAB HEGNS4B2_SC_Compu "" TAB_VERB 2 0 "False" 1 "True" /end COMPU_VTAB
/begin COMPU_METHOD HEGODDLYDS_SY_Compu "" TAB_VERB "%6.3" "" COMPU_TAB_REF HEGODDLYDS_SY_Compu /end COMPU_METHOD
/begin COMPU_VTAB HEGODDLYDS_SY_Compu "" TAB_VERB 2 0 "False" 1 "True" /end COMPU_VTAB
/begin COMPU_METHOD HEGODDYNSIMN_SY_Compu "" TAB_VERB "%6.3" "" COMPU_TAB_REF HEGODDYNSIMN_SY_Compu /end COMPU_METHOD
/begin COMPU_VTAB HEGODDYNSIMN_SY_Compu "" TAB_VERB 2 0 "False" 1 "True" /end COMPU_VTAB
/begin COMPU_METHOD HEGODDYNUS_SY_Compu "" TAB_VERB "%6.3" "" COMPU_TAB_REF HEGODDYNUS_SY_Compu /end COMPU_METHOD
/begin COMPU_VTAB HEGODDYNUS_SY_Compu "" TAB_VERB 2 0 "False" 1 "True" /end COMPU_VTAB
/begin COMPU_METHOD HEGODLIMDS_SY_Compu "" TAB_VERB "%6.3" "" COMPU_TAB_REF HEGODLIMDS_SY_Compu /end COMPU_METHOD
/begin COMPU_VTAB HEGODLIMDS_SY_Compu "" TAB_VERB 2 0 "False" 1 "True" /end COMPU_VTAB
/begin COMPU_METHOD HEGODRSTRCNDS_SY_Compu "" TAB_VERB "%6.3" "" COMPU_TAB_REF HEGODRSTRCNDS_SY_Compu /end COMPU_METHOD
/begin COMPU_VTAB HEGODRSTRCNDS_SY_Compu "" TAB_VERB 2 0 "False" 1 "True" /end COMPU_VTAB
/begin COMPU_METHOD HEGODSYMCTLUS_SY_Compu "" TAB_VERB "%6.3" "" COMPU_TAB_REF HEGODSYMCTLUS_SY_Compu /end COMPU_METHOD
/begin COMPU_VTAB HEGODSYMCTLUS_SY_Compu "" TAB_VERB 2 0 "False" 1 "True" /end COMPU_VTAB
/begin COMPU_METHOD HEGODTRANDS_SY_Compu "" TAB_VERB "%6.3" "" COMPU_TAB_REF HEGODTRANDS_SY_Compu /end COMPU_METHOD
/begin COMPU_VTAB HEGODTRANDS_SY_Compu "" TAB_VERB 3 0 "0" 1 "1" 2 "2" /end COMPU_VTAB
/begin COMPU_METHOD HEGOFUELCOR_SY_Compu "" TAB_VERB "%6.3" "" COMPU_TAB_REF HEGOFUELCOR_SY_Compu /end COMPU_METHOD
/begin COMPU_VTAB HEGOFUELCOR_SY_Compu "" TAB_VERB 2 0 "False" 1 "True" /end COMPU_VTAB
/begin COMPU_METHOD HEGONMNGCNVTN_SC_Compu "" TAB_VERB "%6.3" "" COMPU_TAB_REF HEGONMNGCNVTN_SC_Compu /end COMPU_METHOD
/begin COMPU_VTAB HEGONMNGCNVTN_SC_Compu "" TAB_VERB 6 0 "GS-classic" 1 "AUTOSAR R2.0" 2 "AUTOSAR R4.0" 3 "mixed AUTOSAR R2.0/GS-classic" 4 "mixed AUTOSAR R4.0/GS-classic" 5 "mixed AUTOSAR R2.0/AUTOSAR R4.0" /end COMPU_VTAB
/begin COMPU_METHOD HEGONTK_SY_Compu "" TAB_VERB "%6.3" "" COMPU_TAB_REF HEGONTK_SY_Compu /end COMPU_METHOD
/begin COMPU_VTAB HEGONTK_SY_Compu "" TAB_VERB 2 0 "False" 1 "True" /end COMPU_VTAB
/begin COMPU_METHOD HEGOPREHEATG_SC_Compu "" TAB_VERB "%6.3" "" COMPU_TAB_REF HEGOPREHEATG_SC_Compu /end COMPU_METHOD
/begin COMPU_VTAB HEGOPREHEATG_SC_Compu "" TAB_VERB 2 0 "False" 1 "True" /end COMPU_VTAB
/begin COMPU_METHOD HEGOS1B1_SY_Compu "" TAB_VERB "%6.3" "" COMPU_TAB_REF HEGOS1B1_SY_Compu /end COMPU_METHOD
/begin COMPU_VTAB HEGOS1B1_SY_Compu "" TAB_VERB 2 0 "False" 1 "True" /end COMPU_VTAB
/begin COMPU_METHOD HEGOS1B2_SY_Compu "" TAB_VERB "%6.3" "" COMPU_TAB_REF HEGOS1B2_SY_Compu /end COMPU_METHOD
/begin COMPU_VTAB HEGOS1B2_SY_Compu "" TAB_VERB 2 0 "False" 1 "True" /end COMPU_VTAB
/begin COMPU_METHOD HEGOS1COLDOPER_SC_Compu "" TAB_VERB "%6.3" "" COMPU_TAB_REF HEGOS1COLDOPER_SC_Compu /end COMPU_METHOD
/begin COMPU_VTAB HEGOS1COLDOPER_SC_Compu "" TAB_VERB 2 0 "False" 1 "True" /end COMPU_VTAB
/begin COMPU_METHOD HEGOS1FET_SY_Compu "" TAB_VERB "%6.3" "" COMPU_TAB_REF HEGOS1FET_SY_Compu /end COMPU_METHOD
/begin COMPU_VTAB HEGOS1FET_SY_Compu "" TAB_VERB 2 0 "False" 1 "True" /end COMPU_VTAB
/begin COMPU_METHOD HEGOS1HTGENAEXT_SC_Compu "" TAB_VERB "%6.3" "" COMPU_TAB_REF HEGOS1HTGENAEXT_SC_Compu /end COMPU_METHOD
/begin COMPU_VTAB HEGOS1HTGENAEXT_SC_Compu "" TAB_VERB 2 0 "False" 1 "True" /end COMPU_VTAB
/begin COMPU_METHOD HEGOS1HTGEXT_SC_Compu "" TAB_VERB "%6.3" "" COMPU_TAB_REF HEGOS1HTGEXT_SC_Compu /end COMPU_METHOD
/begin COMPU_VTAB HEGOS1HTGEXT_SC_Compu "" TAB_VERB 2 0 "False" 1 "True" /end COMPU_VTAB
/begin COMPU_METHOD HEGOS1MNTGTST_SC_Compu "" TAB_VERB "%6.3" "" COMPU_TAB_REF HEGOS1MNTGTST_SC_Compu /end COMPU_METHOD
/begin COMPU_VTAB HEGOS1MNTGTST_SC_Compu "" TAB_VERB 2 0 "False" 1 "True" /end COMPU_VTAB
/begin COMPU_METHOD HEGOS2B1_SY_Compu "" TAB_VERB "%6.3" "" COMPU_TAB_REF HEGOS2B1_SY_Compu /end COMPU_METHOD
/begin COMPU_VTAB HEGOS2B1_SY_Compu "" TAB_VERB 2 0 "False" 1 "True" /end COMPU_VTAB
/begin COMPU_METHOD HEGOS2B2_SY_Compu "" TAB_VERB "%6.3" "" COMPU_TAB_REF HEGOS2B2_SY_Compu /end COMPU_METHOD
/begin COMPU_VTAB HEGOS2B2_SY_Compu "" TAB_VERB 2 0 "False" 1 "True" /end COMPU_VTAB
/begin COMPU_METHOD HEGOS2COLDOPER_SC_Compu "" TAB_VERB "%6.3" "" COMPU_TAB_REF HEGOS2COLDOPER_SC_Compu /end COMPU_METHOD
/begin COMPU_VTAB HEGOS2COLDOPER_SC_Compu "" TAB_VERB 2 0 "False" 1 "True" /end COMPU_VTAB
/begin COMPU_METHOD HEGOS2FET_SY_Compu "" TAB_VERB "%6.3" "" COMPU_TAB_REF HEGOS2FET_SY_Compu /end COMPU_METHOD
/begin COMPU_VTAB HEGOS2FET_SY_Compu "" TAB_VERB 2 0 "False" 1 "True" /end COMPU_VTAB
/begin COMPU_METHOD HEGOS2HTGENAEXT_SC_Compu "" TAB_VERB "%6.3" "" COMPU_TAB_REF HEGOS2HTGENAEXT_SC_Compu /end COMPU_METHOD
/begin COMPU_VTAB HEGOS2HTGENAEXT_SC_Compu "" TAB_VERB 2 0 "False" 1 "True" /end COMPU_VTAB
/begin COMPU_METHOD Length_Km_q0p001 "" RAT_FUNC "%6.5" "km" COEFFS 0 1000 0 0 0 1 /end COMPU_METHOD
/begin COMPU_METHOD nmot_q0p5 "" RAT_FUNC "%6.3" "1/min" COEFFS 0 2 0 0 0 1 /end COMPU_METHOD
/begin COMPU_METHOD nmot_q32 "" RAT_FUNC "%6.1" "1/min" COEFFS 0 1 0 0 0 32 /end COMPU_METHOD
/begin COMPU_METHOD nmot_sw_q0p25 "" RAT_FUNC "%6.3" "1/min" COEFFS 0 1 0 0 0 0.25 /end COMPU_METHOD
/begin COMPU_METHOD nmot_ub_q10 "" RAT_FUNC "%6.1" "1/min" COEFFS 0 1 0 0 0 10 /end COMPU_METHOD
/begin COMPU_METHOD nmot_uw_q0p25 "" RAT_FUNC "%6.3" "1/min" COEFFS 0 1 0 0 0 0.25 /end COMPU_METHOD
/begin COMPU_METHOD OneToOne "" RAT_FUNC "%6.2" "-" COEFFS 0 1 0 0 0 1 /end COMPU_METHOD
/begin COMPU_METHOD Period "" RAT_FUNC "%6.3" "ms" COEFFS 0 10 0 0 0 1 /end COMPU_METHOD
/begin COMPU_METHOD Prc "" RAT_FUNC "%6.4" "%" COEFFS 0 81.92 0 0 0 1 /end COMPU_METHOD
/begin COMPU_METHOD Prc_CrCtl3 "" RAT_FUNC "%6.3" "%" COEFFS 0 8 0 0 0 1 /end COMPU_METHOD
/begin COMPU_METHOD Pres "" RAT_FUNC "%6.3" "kPa" COEFFS 0 10 0 0 0 1 /end COMPU_METHOD
/begin COMPU_METHOD Pres_1_kPa "" RAT_FUNC "%6.2" "kPa" COEFFS 0 1 0 0 0 1 /end COMPU_METHOD
/begin COMPU_METHOD Pres_kPa_ENGY "" RAT_FUNC "%6.2" "kPa" COEFFS 0 1 0 0 0 1 /end COMPU_METHOD
/begin COMPU_METHOD Pwr_kW "" RAT_FUNC "%6.4" "kW" COEFFS 0 100 0 0 0 1 /end COMPU_METHOD
/begin COMPU_METHOD p_q0p039 "" RAT_FUNC "%6.4" "hPa" COEFFS 0 256 0 0 0 10 /end COMPU_METHOD
/begin COMPU_METHOD q0p01_V "" RAT_FUNC "%6.4" "V" COEFFS 0 100 0 0 0 1 /end COMPU_METHOD
/begin COMPU_METHOD RBPtCel_tq_1p0_1 "" RAT_FUNC "%6.2" "Nm" COEFFS 0 1 0 0 0 1 /end COMPU_METHOD
/begin COMPU_METHOD relDK_q0p3922 "" RAT_FUNC "%6.3" "%DK" COEFFS 0 255 0 0 0 100 /end COMPU_METHOD
/begin COMPU_METHOD relPED_ub_b100 "" RAT_FUNC "%6.3" "%PED" COEFFS 0 255 0 0 0 100 /end COMPU_METHOD
/begin COMPU_METHOD rel_ub_b100 "" RAT_FUNC "%6.3" "%" COEFFS 0 256 0 0 0 100 /end COMPU_METHOD
/begin COMPU_METHOD RmpEngN "" RAT_FUNC "%6.4" "rpm/s" COEFFS 0 131.072 0 0 0 1 /end COMPU_METHOD
/begin COMPU_METHOD Signals_IntSigNumVerb "" TAB_VERB "%6.3" "" COMPU_TAB_REF Signals_IntSigNumVerb /end COMPU_METHOD
/begin COMPU_VTAB Signals_IntSigNumVerb "" TAB_VERB 783 0 "SIGNALS_Signals_Default" 1 "SIGNALS_APP_rUnFlt" 2 "SIGNALS_APP_r_sig" 3 "SIGNALS_APP_r_signal" 4 "SIGNALS_APP_uRaw1_signal" 5 "SIGNALS_APP_uRaw2_signal" 6 "SIGNALS_AbsLdCom8Bit_PID43h" 7 "SIGNALS_AccPed_tqMapBasd_BENG_signal" 8 "SIGNALS_AccPed_tqMapBasd_TRQB_signal" 9 "SIGNALS_ActMod_trqInr_signal" 10 "SIGNALS_AirC_uAnaRawClnt_signal" 11 "SIGNALS_Alt_iExctLim_signal" 12 "SIGNALS_Alt_rAltExct_signal" 13 "SIGNALS_Alt_uFinalDes_signal" 14 "SIGNALS_BattU_u" 15 "SIGNALS_BattU_uSens1_signal" 16 "SIGNALS_BattU_uSens2_s" 17 "SIGNALS_BattU_uSens_signal" 18 "SIGNALS_Batt_lMaxCnsChk_signal" 19 "SIGNALS_Batt_lMinCnsChk_signal" 20 "SIGNALS_Batt_qCnsChkAH_signal" 21 "SIGNALS_Brk_st" 22 "SIGNALS_Brk_stRed" 23 "SIGNALS_CEngDsT_uRaw_s" 24 "SIGNALS_CoEng_tiCranking_signal" 25 "SIGNALS_CoEng_tiScneEngStrtPrmIdH1F_signal" 26 "SIGNALS_CoVeh_trqAcs_s" 27 "SIGNALS_ComEBS_BattID_signal" 28 "SIGNALS_ComEBS_rBattSensCh_signal" 29 "SIGNALS_ComEBS_uBattSens_signal" 30 "SIGNALS_ComEBS_uBattUCO_signal" 31 "SIGNALS_Com_iBattEBS_signal" 32 "SIGNALS_Com_lDst_signal" 33 "SIGNALS_Com_rMeasdBattREbs_signal" 34 "SIGNALS_Com_tBattEBS_signal" 35 "SIGNALS_Com_trqAYCFDes_signal" 36 "SIGNALS_Com_uPeak_signal" 37 "SIGNALS_CrCtl_stShutOffCode0_signal" 38 "SIGNALS_CrCtl_stShutOffCode1_signal" 39 "SIGNALS_CrCtl_stShutOffCode2_signal" 40 "SIGNALS_CrCtl_stShutOffCode3_signal" 41 "SIGNALS_CrCtl_stShutOffCode4_signal" 42 "SIGNALS_CrCtl_stShutOffCode5_signal" 43 "SIGNALS_CrCtl_stShutOffCode6_signal" 44 "SIGNALS_CrCtl_stShutOffCode7_signal" 45 "SIGNALS_CrCtl_stShutOffCode8_signal" 46 "SIGNALS_CrCtl_stShutOffCode9_signal" 47 "SIGNALS_DIUMPR_ctGenDenom_signal" 48 "SIGNALS_DIUMPR_ctIgn_signal" 49 "SIGNALS_DRIVE_numDTCFrz_s" 50 "SIGNALS_DRIVE_stCurTrgMode_signal" 51 "SIGNALS_DRIVE_stHardToStrt_s" 52 "SIGNALS_DSMDur_ctPID21h_signal" 53 "SIGNALS_DSMDur_ctPID31h_signal" 54 "SIGNALS_DcmDspUDS_rdbi_2612Byte10_signal" 55 "SIGNALS_DcmDspUDS_rdbi_2612Byte11_signal" 56 "SIGNALS_DcmDspUDS_rdbi_fixed_signal" 57 "SIGNALS_DcmDspUDS_rdbi_reserved0_signal_s" 58 "SIGNALS_DcmDspUDS_rdbi_reserved0_signal_w_s" 59 "SIGNALS_DcmDspUDS_rdbi_reserved1_signal" 60 "SIGNALS_Dspl_stCrsSwtInfo_signal" 61 "SIGNALS_Ebs_qBliChrg_signal" 62 "SIGNALS_Ebs_qBliDchaTotDcyc_0_signal" 63 "SIGNALS_Ebs_qBliDchaTotDcyc_1_signal" 64 "SIGNALS_Ebs_qBliDchaTotDcyc_2_signal" 65 "SIGNALS_Ebs_qBliDchaTotDcyc_3_signal" 66 "SIGNALS_Ebs_qBliDchaTotDcyc_4_signal" 67 "SIGNALS_Ebs_qBliDcha_signal" 68 "SIGNALS_Ebs_stStbIEBSByt0_0_signal" 69 "SIGNALS_Ebs_stStbIEBSByt0_1_signal" 70 "SIGNALS_Ebs_stStbIEBSByt0_2_signal" 71 "SIGNALS_Ebs_stStbIEBSByt0_3_signal" 72 "SIGNALS_Ebs_stStbIEBSByt0_4_signal" 73 "SIGNALS_Ebs_stStbIEBSByt1_0_signal" 74 "SIGNALS_Ebs_stStbIEBSByt1_1_signal" 75 "SIGNALS_Ebs_stStbIEBSByt1_2_signal" 76 "SIGNALS_Ebs_stStbIEBSByt1_3_signal" 77 "SIGNALS_Ebs_stStbIEBSByt1_4_signal" 78 "SIGNALS_Ebs_stStbIEBSByt2_0_signal" 79 "SIGNALS_Ebs_stStbIEBSByt2_1_signal" 80 "SIGNALS_Ebs_stStbIEBSByt2_2_signal" 81 "SIGNALS_Ebs_stStbIEBSByt2_3_signal" 82 "SIGNALS_Ebs_stStbIEBSByt2_4_signal" 83 "SIGNALS_Ebs_stStbIEBSByt3_0_signal" 84 "SIGNALS_Ebs_stStbIEBSByt3_1_signal" 85 "SIGNALS_Ebs_stStbIEBSByt3_2_signal" 86 "SIGNALS_Ebs_stStbIEBSByt3_3_signal" 87 "SIGNALS_Ebs_stStbIEBSByt3_4_signal" 88 "SIGNALS_Ebs_stStbIEBSByt4_0_signal" 89 "SIGNALS_Ebs_stStbIEBSByt4_1_signal" 90 "SIGNALS_Ebs_stStbIEBSByt4_2_signal" 91 "SIGNALS_Ebs_stStbIEBSByt4_3_signal" 92 "SIGNALS_Ebs_stStbIEBSByt4_4_signal" 93 "SIGNALS_EngTrqPtd_trqLead_s" 94 "SIGNALS_EngTrqPtd_trqLead_signal" 95 "SIGNALS_EngTrqPtd_trqSet_s" 96 "SIGNALS_EngTrqPtd_trqSet_signal" 97 "SIGNALS_EpmCaS_ctErrSig_signal" 98 "SIGNALS_EpmCaS_ctNoSig_signal" 99 "SIGNALS_EpmCaS_phiDiffCal2AdapEqAvg_0" 100 "SIGNALS_EpmCaS_phiOfsCorr" 101 "SIGNALS_EpmCrS_ctCaSRev_mp_signal" 102 "SIGNALS_EpmCrS_ctErrSig_signal" 103 "SIGNALS_Epm_nEngAct" 104 "SIGNALS_Epm_nEngRaw_s" 105 "SIGNALS_Epm_nEngRaw_signal" 106 "SIGNALS_Epm_stOpMode" 107 "SIGNALS_Epm_stSync" 108 "SIGNALS_ExhMod_tCat1B1_signal" 109 "SIGNALS_GlbDa_lenTotDstDcycHiResl_signal" 110 "SIGNALS_HEGO_uS2B1Extd_s" 111 "SIGNALS_HEGO_uS2B1HiRes_signal" 112 "SIGNALS_I14229CoEng_tiNormalOBDPrevDcyc_s" 113 "SIGNALS_I14229GlbDa_lTotDstDCHiReslPrevDcyc_s" 114 "SIGNALS_I14229IntkAirT_tSnsrTstrMax_s" 115 "SIGNALS_I14229IntkAirT_tSnsrTstrMin_s" 116 "SIGNALS_I14229RDBI_nOvrSpd_signal" 117 "SIGNALS_I14229RDBI_tiOvrSpd_signal" 118 "SIGNALS_I14229_ElecLd_iEPSLoadOnly_signal" 119 "SIGNALS_I14229_EpmCrS_ctErrSig_signal" 120 "SIGNALS_I14229_ivzabg_w_signal" 121 "SIGNALS_I14229_lDst_signal" 122 "SIGNALS_I14229_ml_w_msg_signal" 123 "SIGNALS_I14229_nstat_signal" 124 "SIGNALS_I14229_numDTCFrzFrmHi_signal" 125 "SIGNALS_I14229_numDTCFrzFrmLo_signal" 126 "SIGNALS_I14229_numDTCFrzFrmMid_signal" 127 "SIGNALS_I14229_ps_w_signal" 128 "SIGNALS_I14229_rTrqPT_signal" 129 "SIGNALS_I14229_tSnsrFild1_signal" 130 "SIGNALS_I14229_tiInj1On_signal" 131 "SIGNALS_I14229_tiOilFlowCompl_signal" 132 "SIGNALS_I14229_tiSia_signal" 133 "SIGNALS_I14229_tkaMax_s" 134 "SIGNALS_I14229_tkaMin_s" 135 "SIGNALS_I14229_tka_signal" 136 "SIGNALS_I14229_tmotMaxCurrDcyc_s" 137 "SIGNALS_I14229_tmotMaxPrevDcyc_s" 138 "SIGNALS_I14229_tmotMinCurrDcyc_s" 139 "SIGNALS_I14229_tmotMinPrevDcyc_s" 140 "SIGNALS_I14229_ubsq_signal" 141 "SIGNALS_I14229_umsrln_w_signal" 142 "SIGNALS_I14229_wdks_w_signal" 143 "SIGNALS_I14229_wped1_signal" 144 "SIGNALS_I14229_wped2_signal" 145 "SIGNALS_I14229_zwist_signal" 146 "SIGNALS_I14229iocpMDA_numACGC_signal" 147 "SIGNALS_I14229iocpMDA_numAPS_signal" 148 "SIGNALS_I14229iocpMDA_numPSC_signal" 149 "SIGNALS_I14229iocpMDA_numRFAN_signal" 150 "SIGNALS_I14229iocpMDA_numVTEC_signal" 151 "SIGNALS_I14229iocp_numCtlSt_s" 152 "SIGNALS_I14229iocp_numEXE_signal" 153 "SIGNALS_I14229iocp_numREQ_s" 154 "SIGNALS_I14229iocp_stSFTRJC_s" 155 "SIGNALS_I15031_PID1Dh" 156 "SIGNALS_I15031_PID65Ah" 157 "SIGNALS_I15031_PID66Ah" 158 "SIGNALS_I15031_PID68Ah" 159 "SIGNALS_I15031_PID69Ah" 160 "SIGNALS_I15031_PID6AAh" 161 "SIGNALS_I15031_PID6BAh" 162 "SIGNALS_I15031_PID6CAh" 163 "SIGNALS_I15031_PID6DAh" 164 "SIGNALS_I15031_PID6EAh" 165 "SIGNALS_I15031_PID6FAh" 166 "SIGNALS_I15031_PID70Ah" 167 "SIGNALS_I15031_PID71Ah" 168 "SIGNALS_I15031_PID72Ah" 169 "SIGNALS_I15031_PID73Ah" 170 "SIGNALS_I15031_PID74Ah" 171 "SIGNALS_I15031_PID75Ah" 172 "SIGNALS_I15031_PID76Ah" 173 "SIGNALS_I15031_PID77Ah" 174 "SIGNALS_I15031_PID78Ah" 175 "SIGNALS_I15031_PID79Ah" 176 "SIGNALS_I15031_PID7AAh" 177 "SIGNALS_I15031_PID7BAh" 178 "SIGNALS_I15031_PID7CAh" 179 "SIGNALS_I15031_PID7FAh" 180 "SIGNALS_I15031_PID81Ah" 181 "SIGNALS_I15031_PID82Ah" 182 "SIGNALS_I15031_PID85Ah" 183 "SIGNALS_I15031_PID86Ah" 184 "SIGNALS_I15031_PID87Ah" 185 "SIGNALS_I15031_PID89Ah" 186 "SIGNALS_I15031_PID8AAh" 187 "SIGNALS_I15031_PID8FAh" 188 "SIGNALS_I15031_PID92Ah" 189 "SIGNALS_I15031_PID93Ah" 190 "SIGNALS_I15031_PID94Ah" 191 "SIGNALS_I15031_PID98Ah" 192 "SIGNALS_I15031_PID99Ah" 193 "SIGNALS_I15031_PID9CAh" 194 "SIGNALS_I15031_PIDA3Ah" 195 "SIGNALS_I15031_PIDA4Ah" 196 "SIGNALS_I15031_PIDA5Ah" 197 "SIGNALS_I15031_PIDA9Ah" 198 "SIGNALS_I15031_PIDACAh" 199 "SIGNALS_IKCtl_agAdpnCurr_s16_signal" 200 "SIGNALS_IKCtl_agKnkAvrg_s8_signal" 201 "SIGNALS_InjSys_volFuConsDrvCycCAN_s" 202 "SIGNALS_IntkAirT_uSnsr1Exprt_signal" 203 "SIGNALS_IntkAirT_uSnsr3CrssSwtLoc_s" 204 "SIGNALS_MoF_rTrqInrAct_s" 205 "SIGNALS_MoF_rTrqPtdFlt_s" 206 "SIGNALS_OilLfT_degOilDetern_signal" 207 "SIGNALS_OilSwmpT_uSnsrRaw_s" 208 "SIGNALS_PID01h" 209 "SIGNALS_PID03h_0" 210 "SIGNALS_PID03h_1" 211 "SIGNALS_PID04h" 212 "SIGNALS_PID05h" 213 "SIGNALS_PID06h_0" 214 "SIGNALS_PID07h_0" 215 "SIGNALS_PID0Ch_Epm_nEng" 216 "SIGNALS_PID0D_VehV_vSens" 217 "SIGNALS_PID0Eh" 218 "SIGNALS_PID0Fh" 219 "SIGNALS_PID0Fh_s" 220 "SIGNALS_PID0bh" 221 "SIGNALS_PID0bh_PIntkVUs_pRawObd" 222 "SIGNALS_PID11h_ThrVlv_ratActSens1AbsltB1_u8" 223 "SIGNALS_PID13h" 224 "SIGNALS_PID15h_0" 225 "SIGNALS_PID15h_1" 226 "SIGNALS_PID1Ch" 227 "SIGNALS_PID1Fh_TiScneEngStrt" 228 "SIGNALS_PID21h" 229 "SIGNALS_PID2Eh" 230 "SIGNALS_PID30h" 231 "SIGNALS_PID31h" 232 "SIGNALS_PID33h_PEnv_pRaw" 233 "SIGNALS_PID34h_0" 234 "SIGNALS_PID34h_1" 235 "SIGNALS_PID3Ch" 236 "SIGNALS_PID42_BattU_uSens" 237 "SIGNALS_PID43h" 238 "SIGNALS_PID44h" 239 "SIGNALS_PID45h_ThrVlv_ratActSens1RelB1_u8" 240 "SIGNALS_PID46h" 241 "SIGNALS_PID47h_ThrVlv_ratActSens2AbsltB1_u8" 242 "SIGNALS_PID49_APP_uRaw1unLim" 243 "SIGNALS_PID4A_APP_uRaw2unLim" 244 "SIGNALS_PID4Ch_wdks_msg" 245 "SIGNALS_PID4FAh" 246 "SIGNALS_PID4FBh" 247 "SIGNALS_PID4FCh" 248 "SIGNALS_PID4FDh" 249 "SIGNALS_PID50Ah" 250 "SIGNALS_PID50Bh" 251 "SIGNALS_PID50Ch" 252 "SIGNALS_PID50Dh" 253 "SIGNALS_PID51h_PID51_stFuTyp" 254 "SIGNALS_PID56h_0" 255 "SIGNALS_PID5A_APP_rOBDPID5A" 256 "SIGNALS_PID5Fh" 257 "SIGNALS_PID62h_TME_ratActEngPercTqPrmIdH62" 258 "SIGNALS_IntFloat_PID63h_TqEngRef" 259 "SIGNALS_PID67h_ects2sva_msg" 260 "SIGNALS_PID67h_ects2svb_msg" 261 "SIGNALS_PID67h_ects2svc_msg" 262 "SIGNALS_PID68h_iats2svb" 263 "SIGNALS_PID68h_iats2svc" 264 "SIGNALS_PID68h_iats2svd" 265 "SIGNALS_PID68h_iats2sve" 266 "SIGNALS_PID68h_iats2svf" 267 "SIGNALS_PID68h_iats2svg" 268 "SIGNALS_PID7Fh_RTId_TotRt" 269 "SIGNALS_PID7Fh_RtId_TotIdleRt" 270 "SIGNALS_PID7Fh_RtId_TotPtoRt" 271 "SIGNALS_PID87h_PIntkVUs_pRawObd" 272 "SIGNALS_PID8BAh" 273 "SIGNALS_PID8CAh" 274 "SIGNALS_PID8Eh_TME_ratEngFricPercTqPrmIdH8E" 275 "SIGNALS_PID9AAh" 276 "SIGNALS_PID9Dh_InjSys_mfEngFuRate" 277 "SIGNALS_PID9Dh_InjSys_mfVehFuRate" 278 "SIGNALS_PID9FAh" 279 "SIGNALS_PIDA6h_lTotDst" 280 "SIGNALS_PID_FILLSIG_1BIT" 281 "SIGNALS_PID_FILLSIG_1BITNZ" 282 "SIGNALS_PID_FILLSIG_1BYTE" 283 "SIGNALS_PID_FILLSIG_1BYTENZ" 284 "SIGNALS_PID_FILLSIG_2BIT" 285 "SIGNALS_PID_FILLSIG_2BITNZ" 286 "SIGNALS_PID_FILLSIG_2BYTE" 287 "SIGNALS_PID_FILLSIG_2BYTENZ" 288 "SIGNALS_PID_FILLSIG_3BIT" 289 "SIGNALS_PID_FILLSIG_3BITNZ" 290 "SIGNALS_PID_FILLSIG_4BIT" 291 "SIGNALS_PID_FILLSIG_4BITNZ" 292 "SIGNALS_PID_FILLSIG_4BYTE" 293 "SIGNALS_PID_FILLSIG_4BYTENZ" 294 "SIGNALS_PID_FILLSIG_5BIT" 295 "SIGNALS_PID_FILLSIG_5BITNZ" 296 "SIGNALS_PID_FILLSIG_6BIT" 297 "SIGNALS_PID_FILLSIG_6BITNZ" 298 "SIGNALS_PID_FILLSIG_7BIT" 299 "SIGNALS_PID_FILLSIG_7BITNZ" 300 "SIGNALS_PIntkVUs_uRawUnFlt_signal" 301 "SIGNALS_PT_rGrip_signal" 302 "SIGNALS_PT_trqLos_signal" 303 "SIGNALS_PtCoornDyn_tqCluDes_signal" 304 "SIGNALS_PtCoornDyn_tqCluLeadTrsmIntv_signal" 305 "SIGNALS_PthLead_trqInrNoMon_s" 306 "SIGNALS_PthLead_trqInrNoMon_signal" 307 "SIGNALS_PthSet_trqInrIABef_s" 308 "SIGNALS_PthSet_trqInrLtd_s" 309 "SIGNALS_RngMod_trqDiffAdap_signal" 310 "SIGNALS_RngMod_trqInrBs_s" 311 "SIGNALS_TWCD_numMeasB1_s" 312 "SIGNALS_TWCD_rOSCAvrgPriB1_s" 313 "SIGNALS_ThrVlv_uRawSens1B1_signal" 314 "SIGNALS_ThrVlv_uRawSens2B1_signal" 315 "SIGNALS_TiEngOff_ti_signal" 316 "SIGNALS_UEGO_ratLamSrv1S1B1_signal" 317 "SIGNALS_VehStc_numFuDiagRecA_0_s" 318 "SIGNALS_VehStc_numFuDiagRecA_10_s" 319 "SIGNALS_VehStc_numFuDiagRecA_11_s" 320 "SIGNALS_VehStc_numFuDiagRecA_12_s" 321 "SIGNALS_VehStc_numFuDiagRecA_13_s" 322 "SIGNALS_VehStc_numFuDiagRecA_14_s" 323 "SIGNALS_VehStc_numFuDiagRecA_15_s" 324 "SIGNALS_VehStc_numFuDiagRecA_16_s" 325 "SIGNALS_VehStc_numFuDiagRecA_17_s" 326 "SIGNALS_VehStc_numFuDiagRecA_18_s" 327 "SIGNALS_VehStc_numFuDiagRecA_19_s" 328 "SIGNALS_VehStc_numFuDiagRecA_1_s" 329 "SIGNALS_VehStc_numFuDiagRecA_20_s" 330 "SIGNALS_VehStc_numFuDiagRecA_2_s" 331 "SIGNALS_VehStc_numFuDiagRecA_3_s" 332 "SIGNALS_VehStc_numFuDiagRecA_4_s" 333 "SIGNALS_VehStc_numFuDiagRecA_5_s" 334 "SIGNALS_VehStc_numFuDiagRecA_6_s" 335 "SIGNALS_VehStc_numFuDiagRecA_7_s" 336 "SIGNALS_VehStc_numFuDiagRecA_8_s" 337 "SIGNALS_VehStc_numFuDiagRecA_9_s" 338 "SIGNALS_VehStc_numMisfDetnHiEctA_0_s" 339 "SIGNALS_VehStc_numMisfDetnHiEctA_10_s" 340 "SIGNALS_VehStc_numMisfDetnHiEctA_11_s" 341 "SIGNALS_VehStc_numMisfDetnHiEctA_12_s" 342 "SIGNALS_VehStc_numMisfDetnHiEctA_13_s" 343 "SIGNALS_VehStc_numMisfDetnHiEctA_14_s" 344 "SIGNALS_VehStc_numMisfDetnHiEctA_15_s" 345 "SIGNALS_VehStc_numMisfDetnHiEctA_16_s" 346 "SIGNALS_VehStc_numMisfDetnHiEctA_17_s" 347 "SIGNALS_VehStc_numMisfDetnHiEctA_18_s" 348 "SIGNALS_VehStc_numMisfDetnHiEctA_19_s" 349 "SIGNALS_VehStc_numMisfDetnHiEctA_1_s" 350 "SIGNALS_VehStc_numMisfDetnHiEctA_20_s" 351 "SIGNALS_VehStc_numMisfDetnHiEctA_2_s" 352 "SIGNALS_VehStc_numMisfDetnHiEctA_3_s" 353 "SIGNALS_VehStc_numMisfDetnHiEctA_4_s" 354 "SIGNALS_VehStc_numMisfDetnHiEctA_5_s" 355 "SIGNALS_VehStc_numMisfDetnHiEctA_6_s" 356 "SIGNALS_VehStc_numMisfDetnHiEctA_7_s" 357 "SIGNALS_VehStc_numMisfDetnHiEctA_8_s" 358 "SIGNALS_VehStc_numMisfDetnHiEctA_9_s" 359 "SIGNALS_VehStc_numMisfDetnLoEctA_0_s" 360 "SIGNALS_VehStc_numMisfDetnLoEctA_10_s" 361 "SIGNALS_VehStc_numMisfDetnLoEctA_11_s" 362 "SIGNALS_VehStc_numMisfDetnLoEctA_12_s" 363 "SIGNALS_VehStc_numMisfDetnLoEctA_13_s" 364 "SIGNALS_VehStc_numMisfDetnLoEctA_14_s" 365 "SIGNALS_VehStc_numMisfDetnLoEctA_15_s" 366 "SIGNALS_VehStc_numMisfDetnLoEctA_16_s" 367 "SIGNALS_VehStc_numMisfDetnLoEctA_17_s" 368 "SIGNALS_VehStc_numMisfDetnLoEctA_18_s" 369 "SIGNALS_VehStc_numMisfDetnLoEctA_19_s" 370 "SIGNALS_VehStc_numMisfDetnLoEctA_1_s" 371 "SIGNALS_VehStc_numMisfDetnLoEctA_20_s" 372 "SIGNALS_VehStc_numMisfDetnLoEctA_2_s" 373 "SIGNALS_VehStc_numMisfDetnLoEctA_3_s" 374 "SIGNALS_VehStc_numMisfDetnLoEctA_4_s" 375 "SIGNALS_VehStc_numMisfDetnLoEctA_5_s" 376 "SIGNALS_VehStc_numMisfDetnLoEctA_6_s" 377 "SIGNALS_VehStc_numMisfDetnLoEctA_7_s" 378 "SIGNALS_VehStc_numMisfDetnLoEctA_8_s" 379 "SIGNALS_VehStc_numMisfDetnLoEctA_9_s" 380 "SIGNALS_VehStc_numMisfDetnNormA_0_s" 381 "SIGNALS_VehStc_numMisfDetnNormA_10_s" 382 "SIGNALS_VehStc_numMisfDetnNormA_11_s" 383 "SIGNALS_VehStc_numMisfDetnNormA_12_s" 384 "SIGNALS_VehStc_numMisfDetnNormA_13_s" 385 "SIGNALS_VehStc_numMisfDetnNormA_14_s" 386 "SIGNALS_VehStc_numMisfDetnNormA_15_s" 387 "SIGNALS_VehStc_numMisfDetnNormA_16_s" 388 "SIGNALS_VehStc_numMisfDetnNormA_17_s" 389 "SIGNALS_VehStc_numMisfDetnNormA_18_s" 390 "SIGNALS_VehStc_numMisfDetnNormA_19_s" 391 "SIGNALS_VehStc_numMisfDetnNormA_1_s" 392 "SIGNALS_VehStc_numMisfDetnNormA_20_s" 393 "SIGNALS_VehStc_numMisfDetnNormA_2_s" 394 "SIGNALS_VehStc_numMisfDetnNormA_3_s" 395 "SIGNALS_VehStc_numMisfDetnNormA_4_s" 396 "SIGNALS_VehStc_numMisfDetnNormA_5_s" 397 "SIGNALS_VehStc_numMisfDetnNormA_6_s" 398 "SIGNALS_VehStc_numMisfDetnNormA_7_s" 399 "SIGNALS_VehStc_numMisfDetnNormA_8_s" 400 "SIGNALS_VehStc_numMisfDetnNormA_9_s" 401 "SIGNALS_VehStc_rDiagRsltB1A_0_s" 402 "SIGNALS_VehStc_rDiagRsltB1A_1_s" 403 "SIGNALS_VehStc_rDiagRsltB1A_2_s" 404 "SIGNALS_VehStc_rDiagRsltB1A_3_s" 405 "SIGNALS_VehStc_rDiagRsltB1A_4_s" 406 "SIGNALS_VehV_a" 407 "SIGNALS_VehV_v" 408 "SIGNALS_VehV_vSens_signal" 409 "SIGNALS_flglrs_msg_s" 410 "SIGNALS_fra_w_msg_signal" 411 "SIGNALS_fra_w_s" 412 "SIGNALS_ftead_w_msg_s" 413 "SIGNALS_ftead_w_si" 414 "SIGNALS_ftead_w_signal" 415 "SIGNALS_lamsobd_w_msg_s" 416 "SIGNALS_lutskzyl_w_0_signal" 417 "SIGNALS_lutskzyl_w_1_signal" 418 "SIGNALS_lutskzyl_w_2_signal" 419 "SIGNALS_lutskzyl_w_3_signal" 420 "SIGNALS_lutskzyl_w_msg_0_signal" 421 "SIGNALS_lutskzyl_w_msg_1_signal" 422 "SIGNALS_lutskzyl_w_msg_2_signal" 423 "SIGNALS_lutskzyl_w_msg_3_signal" 424 "SIGNALS_ofmsndkh1_w_msg_signal" 425 "SIGNALS_ofmsndkh2_w_msg_signal" 426 "SIGNALS_ora_w_msg_signal" 427 "SIGNALS_tateout_w_msg_signal" 428 "SIGNALS_tateout_w_signal" 429 "SIGNALS_tatesoll_w_msg_signal" 430 "SIGNALS_tmst_signal" 431 "SIGNALS_wkratst_signal" 432 "SIGNALS_PID83h_A_BitCombineSignal" 433 "SIGNALS_PID9Bh_A_BitCombineSignal" 434 "SIGNALS_PIDA1h_A_BitCombineSignal" 435 "SIGNALS_PIDA7h_A_BitCombineSignal" 436 "SIGNALS_PIDA8h_A_BitCombineSignal" 437 "SIGNALS_Virtual_CEngDsT_uRaw_signal" 438 "SIGNALS_Virtual_DcmDspUDS_2600Byte06_signal" 439 "SIGNALS_Virtual_DcmDspUDS_2610Byte00_signal" 440 "SIGNALS_Virtual_DcmDspUDS_2610Byte01_signal" 441 "SIGNALS_Virtual_DcmDspUDS_2610Byte02_signal" 442 "SIGNALS_Virtual_DcmDspUDS_2610Byte03_signal" 443 "SIGNALS_Virtual_DcmDspUDS_2610Byte04_signal" 444 "SIGNALS_Virtual_DcmDspUDS_2610Byte05_signal" 445 "SIGNALS_Virtual_DcmDspUDS_2610Byte10_signal" 446 "SIGNALS_Virtual_DcmDspUDS_2610Byte1F_signal" 447 "SIGNALS_Virtual_DcmDspUDS_2610Byte20_signal" 448 "SIGNALS_Virtual_DcmDspUDS_2610Byte25_signal" 449 "SIGNALS_Virtual_DcmDspUDS_2610Byte26_signal" 450 "SIGNALS_Virtual_DcmDspUDS_2611Byte00_signal" 451 "SIGNALS_Virtual_DcmDspUDS_2611Byte01_signal" 452 "SIGNALS_Virtual_DcmDspUDS_2611Byte02_signal" 453 "SIGNALS_Virtual_DcmDspUDS_2611Byte03_signal" 454 "SIGNALS_Virtual_DcmDspUDS_2611Byte04_signal" 455 "SIGNALS_Virtual_DcmDspUDS_2611Byte05_signal" 456 "SIGNALS_Virtual_DcmDspUDS_2611Byte06_07_signal" 457 "SIGNALS_Virtual_DcmDspUDS_2611Byte2A_signal" 458 "SIGNALS_Virtual_DcmDspUDS_2611Byte2B_signal" 459 "SIGNALS_Virtual_DcmDspUDS_2612Byte00_signal" 460 "SIGNALS_Virtual_DcmDspUDS_2612Byte01_signal" 461 "SIGNALS_Virtual_DcmDspUDS_2612Byte02_signal" 462 "SIGNALS_Virtual_DcmDspUDS_2612Byte03_signal" 463 "SIGNALS_Virtual_DcmDspUDS_2612Byte04_signal" 464 "SIGNALS_Virtual_DcmDspUDS_2612Byte05_signal" 465 "SIGNALS_Virtual_DcmDspUDS_2612Byte14_signal" 466 "SIGNALS_Virtual_DcmDspUDS_2612Byte15_signal" 467 "SIGNALS_Virtual_DcmDspUDS_2612Byte16_signal" 468 "SIGNALS_Virtual_DcmDspUDS_2612Byte17_signal" 469 "SIGNALS_Virtual_DcmDspUDS_2612Byte29_signal" 470 "SIGNALS_Virtual_DcmDspUDS_2612Byte2A_signal" 471 "SIGNALS_Virtual_DcmDspUDS_2612Byte2B_signal" 472 "SIGNALS_Virtual_DcmDspUDS_2613Byte00_signal" 473 "SIGNALS_Virtual_DcmDspUDS_2613Byte01_signal" 474 "SIGNALS_Virtual_DcmDspUDS_2613Byte02_signal" 475 "SIGNALS_Virtual_DcmDspUDS_2613Byte03_signal" 476 "SIGNALS_Virtual_DcmDspUDS_2613Byte04_signal" 477 "SIGNALS_Virtual_DcmDspUDS_2613Byte05_signal" 478 "SIGNALS_Virtual_DcmDspUDS_2620Byte00_signal" 479 "SIGNALS_Virtual_DcmDspUDS_2620Byte01_signal" 480 "SIGNALS_Virtual_DcmDspUDS_2620Byte02_signal" 481 "SIGNALS_Virtual_DcmDspUDS_2620Byte03_signal" 482 "SIGNALS_Virtual_DcmDspUDS_2620Byte04_signal" 483 "SIGNALS_Virtual_DcmDspUDS_2620Byte05_signal" 484 "SIGNALS_Virtual_DcmDspUDS_2621Byte00_signal" 485 "SIGNALS_Virtual_DcmDspUDS_2621Byte01_signal" 486 "SIGNALS_Virtual_DcmDspUDS_2621Byte02_signal" 487 "SIGNALS_Virtual_DcmDspUDS_2621Byte03_signal" 488 "SIGNALS_Virtual_DcmDspUDS_2621Byte04_signal" 489 "SIGNALS_Virtual_DcmDspUDS_2621Byte05_signal" 490 "SIGNALS_Virtual_DcmDspUDS_2622Byte00_signal" 491 "SIGNALS_Virtual_DcmDspUDS_2622Byte01_signal" 492 "SIGNALS_Virtual_DcmDspUDS_2622Byte02_signal" 493 "SIGNALS_Virtual_DcmDspUDS_2622Byte03_signal" 494 "SIGNALS_Virtual_DcmDspUDS_2622Byte04_signal" 495 "SIGNALS_Virtual_DcmDspUDS_2622Byte05_signal" 496 "SIGNALS_Virtual_DcmDspUDS_2623Byte00_signal" 497 "SIGNALS_Virtual_DcmDspUDS_2623Byte01_signal" 498 "SIGNALS_Virtual_DcmDspUDS_2623Byte02_signal" 499 "SIGNALS_Virtual_DcmDspUDS_2623Byte03_signal" 500 "SIGNALS_Virtual_DcmDspUDS_2623Byte04_signal" 501 "SIGNALS_Virtual_DcmDspUDS_2623Byte05_signal" 502 "SIGNALS_Virtual_DcmDspUDS_2660Byte0_signal" 503 "SIGNALS_Virtual_DcmDspUDS_2660Byte15_signal" 504 "SIGNALS_Virtual_DcmDspUDS_2660Byte16_signal" 505 "SIGNALS_Virtual_DcmDspUDS_2660Byte17_signal" 506 "SIGNALS_Virtual_DcmDspUDS_2660Byte18_signal" 507 "SIGNALS_Virtual_DcmDspUDS_2660Byte19_signal" 508 "SIGNALS_Virtual_DcmDspUDS_2660Byte1A_signal" 509 "SIGNALS_Virtual_DcmDspUDS_2660Byte1B_signal" 510 "SIGNALS_Virtual_DcmDspUDS_2660Byte1C_signal" 511 "SIGNALS_Virtual_DcmDspUDS_2660Byte1D_signal" 512 "SIGNALS_Virtual_DcmDspUDS_2660Byte1E_signal" 513 "SIGNALS_Virtual_DcmDspUDS_2660Byte1_signal" 514 "SIGNALS_Virtual_DcmDspUDS_2660Byte2_signal" 515 "SIGNALS_Virtual_DcmDspUDS_2660Byte3_signal" 516 "SIGNALS_Virtual_DcmDspUDS_2660Byte4_signal" 517 "SIGNALS_Virtual_DcmDspUDS_2660Byte5_signal" 518 "SIGNALS_Virtual_DcmDspUDS_2660Byte6_signal" 519 "SIGNALS_Virtual_DcmDspUDS_2661Byte0A_signal" 520 "SIGNALS_Virtual_DcmDspUDS_2661Byte0B_signal" 521 "SIGNALS_Virtual_DcmDspUDS_2661Byte0C_signal" 522 "SIGNALS_Virtual_DcmDspUDS_2661Byte0D_signal" 523 "SIGNALS_Virtual_DcmDspUDS_2661Byte0E_signal" 524 "SIGNALS_Virtual_DcmDspUDS_2661Byte0F_signal" 525 "SIGNALS_Virtual_DcmDspUDS_2661Byte0_signal" 526 "SIGNALS_Virtual_DcmDspUDS_2661Byte1_signal" 527 "SIGNALS_Virtual_DcmDspUDS_2661Byte27_signal" 528 "SIGNALS_Virtual_DcmDspUDS_2661Byte2A_signal" 529 "SIGNALS_Virtual_DcmDspUDS_2661Byte2D_signal" 530 "SIGNALS_Virtual_DcmDspUDS_2661Byte2E_signal" 531 "SIGNALS_Virtual_DcmDspUDS_2661Byte2F_signal" 532 "SIGNALS_Virtual_DcmDspUDS_2661Byte2_signal" 533 "SIGNALS_Virtual_DcmDspUDS_2661Byte30_signal" 534 "SIGNALS_Virtual_DcmDspUDS_2661Byte31_signal" 535 "SIGNALS_Virtual_DcmDspUDS_2661Byte32_signal" 536 "SIGNALS_Virtual_DcmDspUDS_2661Byte35_signal" 537 "SIGNALS_Virtual_DcmDspUDS_2661Byte3_signal" 538 "SIGNALS_Virtual_DcmDspUDS_2661Byte4_signal" 539 "SIGNALS_Virtual_DcmDspUDS_2661Byte5_signal" 540 "SIGNALS_Virtual_DcmDspUDS_2661Byte6_signal" 541 "SIGNALS_Virtual_DcmDspUDS_2661Byte7_signal" 542 "SIGNALS_Virtual_DcmDspUDS_2661Byte8_signal" 543 "SIGNALS_Virtual_DcmDspUDS_2661Byte9_signal" 544 "SIGNALS_Virtual_DcmDspUDS_2662Byte0_signal" 545 "SIGNALS_Virtual_DcmDspUDS_2662Byte18_signal" 546 "SIGNALS_Virtual_DcmDspUDS_2662Byte19_signal" 547 "SIGNALS_Virtual_DcmDspUDS_2662Byte1_signal" 548 "SIGNALS_Virtual_DcmDspUDS_2662Byte2_signal" 549 "SIGNALS_Virtual_DcmDspUDS_2662Byte3_signal" 550 "SIGNALS_Virtual_DcmDspUDS_2662Byte4_signal" 551 "SIGNALS_Virtual_DcmDspUDS_2662Byte5_signal" 552 "SIGNALS_Virtual_DcmDspUDS_2663Byte0_signal" 553 "SIGNALS_Virtual_DcmDspUDS_2663Byte1_signal" 554 "SIGNALS_Virtual_DcmDspUDS_2663Byte2_signal" 555 "SIGNALS_Virtual_DcmDspUDS_2663Byte3_signal" 556 "SIGNALS_Virtual_DcmDspUDS_2663Byte4_signal" 557 "SIGNALS_Virtual_DcmDspUDS_2663Byte5_signal" 558 "SIGNALS_Virtual_DcmDspUDS_2664Byte0_signal" 559 "SIGNALS_Virtual_DcmDspUDS_2664Byte1_signal" 560 "SIGNALS_Virtual_DcmDspUDS_2664Byte25_signal" 561 "SIGNALS_Virtual_DcmDspUDS_2664Byte26_signal" 562 "SIGNALS_Virtual_DcmDspUDS_2664Byte2_signal" 563 "SIGNALS_Virtual_DcmDspUDS_2664Byte3_signal" 564 "SIGNALS_Virtual_DcmDspUDS_2664Byte4_signal" 565 "SIGNALS_Virtual_DcmDspUDS_2664Byte5_signal" 566 "SIGNALS_Virtual_DcmDspUDS_2664Byte6_signal" 567 "SIGNALS_Virtual_DcmDspUDS_2664Byte7_signal" 568 "SIGNALS_Virtual_DcmDspUDS_2665Byte0_signal" 569 "SIGNALS_Virtual_DcmDspUDS_2665Byte1_signal" 570 "SIGNALS_Virtual_DcmDspUDS_2665Byte2_signal" 571 "SIGNALS_Virtual_DcmDspUDS_2665Byte3_signal" 572 "SIGNALS_Virtual_DcmDspUDS_2665Byte4_signal" 573 "SIGNALS_Virtual_DcmDspUDS_2665Byte5_signal" 574 "SIGNALS_Virtual_DcmDspUDS_2668Byte0_signal" 575 "SIGNALS_Virtual_DcmDspUDS_2668Byte1B_signal" 576 "SIGNALS_Virtual_DcmDspUDS_2668Byte1_signal" 577 "SIGNALS_Virtual_DcmDspUDS_2668Byte2_signal" 578 "SIGNALS_Virtual_DcmDspUDS_2668Byte3_signal" 579 "SIGNALS_Virtual_DcmDspUDS_2668Byte4_signal" 580 "SIGNALS_Virtual_DcmDspUDS_2668Byte5_signal" 581 "SIGNALS_Virtual_DcmDspUDS_266CByte0_signal" 582 "SIGNALS_Virtual_DcmDspUDS_266CByte1_signal" 583 "SIGNALS_Virtual_DcmDspUDS_266CByte26_signal" 584 "SIGNALS_Virtual_DcmDspUDS_266CByte27_signal" 585 "SIGNALS_Virtual_DcmDspUDS_266CByte2_signal" 586 "SIGNALS_Virtual_DcmDspUDS_266CByte3_signal" 587 "SIGNALS_Virtual_DcmDspUDS_266CByte4_signal" 588 "SIGNALS_Virtual_DcmDspUDS_266CByte5_signal" 589 "SIGNALS_Virtual_DcmDspUDS_266DByte0_signal" 590 "SIGNALS_Virtual_DcmDspUDS_266DByte1_signal" 591 "SIGNALS_Virtual_DcmDspUDS_266DByte2_signal" 592 "SIGNALS_Virtual_DcmDspUDS_266DByte3_signal" 593 "SIGNALS_Virtual_DcmDspUDS_266DByte4_signal" 594 "SIGNALS_Virtual_DcmDspUDS_266DByte5_signal" 595 "SIGNALS_Virtual_DcmDspUDS_266FByte0_signal" 596 "SIGNALS_Virtual_DcmDspUDS_266FByte1_signal" 597 "SIGNALS_Virtual_DcmDspUDS_266FByte2_signal" 598 "SIGNALS_Virtual_DcmDspUDS_266FByte3_signal" 599 "SIGNALS_Virtual_DcmDspUDS_2673Byte0A_signal" 600 "SIGNALS_Virtual_DcmDspUDS_2673Byte0B_signal" 601 "SIGNALS_Virtual_DcmDspUDS_2673Byte0_signal" 602 "SIGNALS_Virtual_DcmDspUDS_2673Byte12_signal" 603 "SIGNALS_Virtual_DcmDspUDS_2673Byte13_signal" 604 "SIGNALS_Virtual_DcmDspUDS_2673Byte16_signal" 605 "SIGNALS_Virtual_DcmDspUDS_2673Byte17_signal" 606 "SIGNALS_Virtual_DcmDspUDS_2673Byte1E_signal" 607 "SIGNALS_Virtual_DcmDspUDS_2673Byte1F_signal" 608 "SIGNALS_Virtual_DcmDspUDS_2673Byte1_signal" 609 "SIGNALS_Virtual_DcmDspUDS_2673Byte2_signal" 610 "SIGNALS_Virtual_DcmDspUDS_2673Byte3_signal" 611 "SIGNALS_Virtual_DcmDspUDS_2673Byte4_signal" 612 "SIGNALS_Virtual_DcmDspUDS_2673Byte5_signal" 613 "SIGNALS_Virtual_DcmDspUDS_2673Byte6_signal" 614 "SIGNALS_Virtual_DcmDspUDS_2673Byte7_signal" 615 "SIGNALS_Virtual_DcmDspUDS_2676Byte0_signal" 616 "SIGNALS_Virtual_DcmDspUDS_2676Byte1_signal" 617 "SIGNALS_Virtual_DcmDspUDS_2676Byte2E_signal" 618 "SIGNALS_Virtual_DcmDspUDS_2676Byte2F_signal" 619 "SIGNALS_Virtual_DcmDspUDS_2676Byte2_signal" 620 "SIGNALS_Virtual_DcmDspUDS_2676Byte3_signal" 621 "SIGNALS_Virtual_DcmDspUDS_2676Byte4_signal" 622 "SIGNALS_Virtual_DcmDspUDS_2676Byte5_signal" 623 "SIGNALS_Virtual_DcmDspUDS_2676Byte6_signal" 624 "SIGNALS_Virtual_DcmDspUDS_2676Byte7_signal" 625 "SIGNALS_Virtual_DcmDspUDS_2676Byte8_signal" 626 "SIGNALS_Virtual_DcmDspUDS_2676Byte9_signal" 627 "SIGNALS_Virtual_DcmDspUDS_267BByte0_signal" 628 "SIGNALS_Virtual_DcmDspUDS_267BByte1_signal" 629 "SIGNALS_Virtual_DcmDspUDS_267BByte2_signal" 630 "SIGNALS_Virtual_DcmDspUDS_267BByte3_signal" 631 "SIGNALS_Virtual_DcmDspUDS_267BByte4_signal" 632 "SIGNALS_Virtual_DcmDspUDS_267BByte5_signal" 633 "SIGNALS_Virtual_DcmDspUDS_267EByte0_signal" 634 "SIGNALS_Virtual_DcmDspUDS_267EByte1_signal" 635 "SIGNALS_Virtual_DcmDspUDS_267EByte22_signal" 636 "SIGNALS_Virtual_DcmDspUDS_2680Byte00_signal" 637 "SIGNALS_Virtual_DcmDspUDS_2680Byte01_signal" 638 "SIGNALS_Virtual_DcmDspUDS_2680Byte02_signal" 639 "SIGNALS_Virtual_DcmDspUDS_2680Byte03_signal" 640 "SIGNALS_Virtual_DcmDspUDS_2680Byte04_signal" 641 "SIGNALS_Virtual_DcmDspUDS_2680Byte05_signal" 642 "SIGNALS_Virtual_DcmDspUDS_2680Byte08_signal" 643 "SIGNALS_Virtual_DcmDspUDS_2680Byte09_signal" 644 "SIGNALS_Virtual_DcmDspUDS_2680Byte0E_signal" 645 "SIGNALS_Virtual_DcmDspUDS_2680Byte0F_signal" 646 "SIGNALS_Virtual_DcmDspUDS_2681Byte00_signal" 647 "SIGNALS_Virtual_DcmDspUDS_2681Byte01_signal" 648 "SIGNALS_Virtual_DcmDspUDS_2681Byte02_signal" 649 "SIGNALS_Virtual_DcmDspUDS_2681Byte03_signal" 650 "SIGNALS_Virtual_DcmDspUDS_2681Byte04_signal" 651 "SIGNALS_Virtual_DcmDspUDS_2681Byte05_signal" 652 "SIGNALS_Virtual_DcmDspUDS_2681Byte0F_signal" 653 "SIGNALS_Virtual_DcmDspUDS_2681Byte10_signal" 654 "SIGNALS_Virtual_DcmDspUDS_2681Byte13_signal" 655 "SIGNALS_Virtual_DcmDspUDS_2681Byte14_signal" 656 "SIGNALS_Virtual_DcmDspUDS_2681Byte1D_signal" 657 "SIGNALS_Virtual_DcmDspUDS_2681Byte1E_signal" 658 "SIGNALS_Virtual_DcmDspUDS_2682Byte00_signal" 659 "SIGNALS_Virtual_DcmDspUDS_2682Byte01_signal" 660 "SIGNALS_Virtual_DcmDspUDS_2682Byte02_signal" 661 "SIGNALS_Virtual_DcmDspUDS_2682Byte03_signal" 662 "SIGNALS_Virtual_DcmDspUDS_2682Byte04_signal" 663 "SIGNALS_Virtual_DcmDspUDS_2682Byte05_signal" 664 "SIGNALS_Virtual_DcmDspUDS_2682Byte06_07_signal" 665 "SIGNALS_Virtual_DcmDspUDS_2682Byte08_09_signal" 666 "SIGNALS_Virtual_DcmDspUDS_2682Byte0E_signal" 667 "SIGNALS_Virtual_DcmDspUDS_2682Byte11_12_signal" 668 "SIGNALS_Virtual_DcmDspUDS_2682Byte13_14_signal" 669 "SIGNALS_Virtual_DcmDspUDS_2682Byte15_16_signal" 670 "SIGNALS_Virtual_DcmDspUDS_2682Byte18_19_signal" 671 "SIGNALS_Virtual_DcmDspUDS_2682Byte1B_signal" 672 "SIGNALS_Virtual_DcmDspUDS_2682Byte1C_signal" 673 "SIGNALS_Virtual_DcmDspUDS_268FByte00_signal" 674 "SIGNALS_Virtual_DcmDspUDS_268FByte01_signal" 675 "SIGNALS_Virtual_DcmDspUDS_268FByte02_signal" 676 "SIGNALS_Virtual_DcmDspUDS_268FByte03_signal" 677 "SIGNALS_Virtual_DcmDspUDS_268FByte04_signal" 678 "SIGNALS_Virtual_DcmDspUDS_268FByte05_signal" 679 "SIGNALS_Virtual_DcmDspUDS_268FByte0A_signal" 680 "SIGNALS_Virtual_DcmDspUDS_268FByte0B_signal" 681 "SIGNALS_Virtual_DcmDspUDS_268FByte0C_signal" 682 "SIGNALS_Virtual_DcmDspUDS_269AByte00_signal" 683 "SIGNALS_Virtual_DcmDspUDS_269AByte01_signal" 684 "SIGNALS_Virtual_DcmDspUDS_269AByte02_signal" 685 "SIGNALS_Virtual_DcmDspUDS_269AByte03_signal" 686 "SIGNALS_Virtual_DcmDspUDS_269AByte04_signal" 687 "SIGNALS_Virtual_DcmDspUDS_269AByte05_signal" 688 "SIGNALS_Virtual_DcmDspUDS_26A2Byte00_signal" 689 "SIGNALS_Virtual_DcmDspUDS_26A2Byte01_signal" 690 "SIGNALS_Virtual_DcmDspUDS_26A2Byte02_signal" 691 "SIGNALS_Virtual_DcmDspUDS_26A2Byte03_signal" 692 "SIGNALS_Virtual_DcmDspUDS_26A2Byte04_signal" 693 "SIGNALS_Virtual_DcmDspUDS_26A2Byte05_signal" 694 "SIGNALS_Virtual_DcmDspUDS_26A2Byte12_13_signal" 695 "SIGNALS_Virtual_DcmDspUDS_Acm_fzabgs_w_signal" 696 "SIGNALS_Virtual_DcmDspUDS_Acm_fzabgzyl_w_0_signal" 697 "SIGNALS_Virtual_DcmDspUDS_Acm_fzabgzyl_w_1_signal" 698 "SIGNALS_Virtual_DcmDspUDS_Acm_fzabgzyl_w_2_signal" 699 "SIGNALS_Virtual_DcmDspUDS_Acm_fzabgzyl_w_3_signal" 700 "SIGNALS_Virtual_DcmDspUDS_DID_E402Byte00_signal" 701 "SIGNALS_Virtual_DcmDspUDS_DID_E402Byte01_signal" 702 "SIGNALS_Virtual_DcmDspUDS_DID_E402Byte07to08_signal" 703 "SIGNALS_Virtual_DcmDspUDS_DID_E402Byte10to11_signal" 704 "SIGNALS_Virtual_DcmDspUDS_DID_E402Byte19to1A_signal" 705 "SIGNALS_Virtual_DcmDspUDS_DID_E402Byte22to23_signal" 706 "SIGNALS_Virtual_DcmDspUDS_DID_E402Byte2Bto2C_signal" 707 "SIGNALS_Virtual_DcmDspUDS_DID_F110Byte0_3_signal" 708 "SIGNALS_Virtual_DcmDspUDS_DID_F110Byte12_15_signal" 709 "SIGNALS_Virtual_DcmDspUDS_DID_F110Byte16_signal" 710 "SIGNALS_Virtual_DcmDspUDS_DID_F110Byte4_7_signal" 711 "SIGNALS_Virtual_DcmDspUDS_DID_F110Byte8_11_signal" 712 "SIGNALS_Virtual_DcmDspUDS_DID_F112Byte0_3_signal" 713 "SIGNALS_Virtual_DcmDspUDS_DID_F112Byte12_15_signal" 714 "SIGNALS_Virtual_DcmDspUDS_DID_F112Byte16_19_signal" 715 "SIGNALS_Virtual_DcmDspUDS_DID_F112Byte20_23_signal" 716 "SIGNALS_Virtual_DcmDspUDS_DID_F112Byte24_27_signal" 717 "SIGNALS_Virtual_DcmDspUDS_DID_F112Byte28_29_signal" 718 "SIGNALS_Virtual_DcmDspUDS_DID_F112Byte30_signal" 719 "SIGNALS_Virtual_DcmDspUDS_DID_F112Byte4_7_signal" 720 "SIGNALS_Virtual_DcmDspUDS_DID_F112Byte8_11_signal" 721 "SIGNALS_Virtual_DcmDspUDS_E602Byte2_signal" 722 "SIGNALS_Virtual_DcmDspUDS_F181Byte0_3_signal" 723 "SIGNALS_Virtual_DcmDspUDS_F181Byte12_15_signal" 724 "SIGNALS_Virtual_DcmDspUDS_F181Byte4_7_signal" 725 "SIGNALS_Virtual_DcmDspUDS_F181Byte8_11_signal" 726 "SIGNALS_Virtual_DcmDspUDS_fzabgs_w_signal" 727 "SIGNALS_Virtual_DcmDspUDS_fzabgzyl_w_0_signal" 728 "SIGNALS_Virtual_DcmDspUDS_fzabgzyl_w_1_signal" 729 "SIGNALS_Virtual_DcmDspUDS_fzabgzyl_w_2_signal" 730 "SIGNALS_Virtual_DcmDspUDS_fzabgzyl_w_3_signal" 731 "SIGNALS_Virtual_DcmDspUDS_numReWrECUID1_signal" 732 "SIGNALS_Virtual_DcmDspUDS_numReWrECUID2_signal" 733 "SIGNALS_Virtual_I14229B9_0490_FrNo09_signal" 734 "SIGNALS_Virtual_I14229B9_0490_FrNo10_signal" 735 "SIGNALS_Virtual_I14229B9_04B1_FrNo16_signal" 736 "SIGNALS_Virtual_I14229B9_04B1_FrNo17_signal" 737 "SIGNALS_Virtual_I14229B9_04B1_FrNo20_signal" 738 "SIGNALS_Virtual_I14229B9_04B1_FrNo21_signal" 739 "SIGNALS_Virtual_I14229B9_04B1_FrNo22_signal" 740 "SIGNALS_Virtual_I14229B9_04B1_FrNo23_signal" 741 "SIGNALS_Virtual_I14229B9_04C2_FrNo2021_signal" 742 "SIGNALS_Virtual_I14229B9_04D2_FrNo24_signal" 743 "SIGNALS_Virtual_I14229B9_04D2_FrNo25_signal" 744 "SIGNALS_Virtual_I14229B9_0520_FrNo15_signal" 745 "SIGNALS_Virtual_I14229B9_0520_FrNo16_signal" 746 "SIGNALS_Virtual_I14229B9_0523_FrNo42_signal" 747 "SIGNALS_Virtual_I14229B9_0523_FrNo43_signal" 748 "SIGNALS_Virtual_I14229B9_0524_FrNo09_signal" 749 "SIGNALS_Virtual_I14229B9_0524_FrNo10_signal" 750 "SIGNALS_Virtual_I14229B9_0550_FrNo09_signal" 751 "SIGNALS_Virtual_I14229B9_0550_FrNo10_signal" 752 "SIGNALS_Virtual_I14229B9_0553_FrNo13_signal" 753 "SIGNALS_Virtual_I14229B9_0553_FrNo14_signal" 754 "SIGNALS_Virtual_I14229B9_056A_FrNo8_signal" 755 "SIGNALS_Virtual_I14229B9_056A_FrNo9_signal" 756 "SIGNALS_Virtual_I14229B9_0588_FrNo15_signal" 757 "SIGNALS_Virtual_I14229B9_0588_FrNo16_signal" 758 "SIGNALS_Virtual_I14229B9_05A0_FrNo40_signal" 759 "SIGNALS_Virtual_I14229B9_05A0_FrNo41_signal" 760 "SIGNALS_Virtual_I14229B9_05B0_FrNo13_signal" 761 "SIGNALS_Virtual_I14229B9_05B0_FrNo14_signal" 762 "SIGNALS_Virtual_I14229B9_05C0_FrNo12_signal" 763 "SIGNALS_Virtual_I14229B9_05C0_FrNo13_signal" 764 "SIGNALS_Virtual_I14229B9_05E0_FrNo19_signal" 765 "SIGNALS_Virtual_I14229B9_05E0_FrNo20_signal" 766 "SIGNALS_Virtual_I14229B9_05E0_FrNo21_signal" 767 "SIGNALS_Virtual_I14229B9_05E0_FrNo22_signal" 768 "SIGNALS_Virtual_I14229B9_05E0_FrNo23_signal" 769 "SIGNALS_Virtual_I14229B9_05E0_FrNo24_signal" 770 "SIGNALS_Virtual_I14229B9_1208_FrNo34_signal" 771 "SIGNALS_Virtual_I14229B9_1208_FrNo35_signal" 772 "SIGNALS_Virtual_I14229B9_1208_FrNo36_signal" 773 "SIGNALS_Virtual_I14229B9_1208_FrNo37_signal" 774 "SIGNALS_Virtual_I14229B9_120A_FrNo09_signal" 775 "SIGNALS_Virtual_I14229B9_120A_FrNo10_signal" 776 "SIGNALS_Virtual_I14229B9_120B_FrNo09_signal" 777 "SIGNALS_Virtual_I14229B9_120B_FrNo10_signal" 778 "SIGNALS_Virtual_I14229_AirC_pAnaClnt_signal" 779 "SIGNALS_Virtual_I14229_EpmCaS_ctErrSig2_signal" 780 "SIGNALS_Virtual_I14229_pEngSrtMin_signal" 781 "SIGNALS_Virtual_I14229_wdkba_w_signal" 782 "SIGNALS_Virtual_Tra_numGear_signal" /end COMPU_VTAB
/begin COMPU_METHOD Temp_Cels "" RAT_FUNC "%6.1" "deg C" COEFFS 0 10 2731.4 0 0 1 /end COMPU_METHOD
/begin COMPU_METHOD TimeDelay_s "" RAT_FUNC "%6.1" "s" COEFFS 0 0 1 0 0.00023283064365387 0 /end COMPU_METHOD
/begin COMPU_METHOD Time_ms "" RAT_FUNC "%6.1" "ms" COEFFS 0 0.1 0 0 0 1 /end COMPU_METHOD
/begin COMPU_METHOD Time_s "" RAT_FUNC "%6.4" "s" COEFFS 0 100 0 0 0 1 /end COMPU_METHOD
/begin COMPU_METHOD ti_s_q0p01_COMPU "" RAT_FUNC "%6.4" "s" COEFFS 0 100 0 0 0 1 /end COMPU_METHOD
/begin COMPU_METHOD Trq "" RAT_FUNC "%6.3" "Nm" COEFFS 0 10 0 0 0 1 /end COMPU_METHOD
/begin COMPU_METHOD TrqCom "" RAT_FUNC "%6.3" "Nm" COEFFS 0 5 0 0 0 1 /end COMPU_METHOD
/begin COMPU_METHOD TrqPrpHigh "" RAT_FUNC "%6.3" "Nm" COEFFS 0 10 0 0 0 1 /end COMPU_METHOD
/begin COMPU_METHOD trq_q0p1 "" RAT_FUNC "%6.3" "Nm" COEFFS 0 10 0 0 0 1 /end COMPU_METHOD
/begin COMPU_METHOD t_q0p01 "" RAT_FUNC "%6.4" "s" COEFFS 0 100 0 0 0 1 /end COMPU_METHOD
/begin COMPU_METHOD t_q0p2 "" RAT_FUNC "%6.3" "s" COEFFS 0 10 0 0 0 2 /end COMPU_METHOD
/begin COMPU_METHOD Vel "" RAT_FUNC "%6.4" "km/h" COEFFS 0 100 0 0 0 1 /end COMPU_METHOD
/begin COMPU_METHOD vel_q0p01 "" RAT_FUNC "%6.4" "km/h" COEFFS 0 100 0 0 0 1 /end COMPU_METHOD
/begin COMPU_METHOD Volt1 "" RAT_FUNC "%6.2" "mV" COEFFS 0 1 0 0 0 1 /end COMPU_METHOD
/begin RECORD_LAYOUT RB_Curve_S16_S16 NO_AXIS_PTS_X 1 SWORD AXIS_PTS_X 2 SWORD INDEX_INCR DIRECT FNC_VALUES 3 SWORD COLUMN_DIR DIRECT /end RECORD_LAYOUT
/begin RECORD_LAYOUT RB_Curve_S16_U8_Static NO_AXIS_PTS_X 1 SWORD AXIS_PTS_X 2 SWORD INDEX_INCR DIRECT FNC_VALUES 3 UBYTE COLUMN_DIR DIRECT STATIC_RECORD_LAYOUT /end RECORD_LAYOUT
/begin RECORD_LAYOUT RB_Curve_U16_S16_Static NO_AXIS_PTS_X 1 UWORD AXIS_PTS_X 2 UWORD INDEX_INCR DIRECT FNC_VALUES 3 SWORD COLUMN_DIR DIRECT STATIC_RECORD_LAYOUT /end RECORD_LAYOUT
/begin RECORD_LAYOUT RB_Curve_U16_U8_Static NO_AXIS_PTS_X 1 UWORD AXIS_PTS_X 2 UWORD INDEX_INCR DIRECT FNC_VALUES 3 UBYTE COLUMN_DIR DIRECT STATIC_RECORD_LAYOUT /end RECORD_LAYOUT
/begin RECORD_LAYOUT RB_Curve_U8_U8 NO_AXIS_PTS_X 1 UBYTE AXIS_PTS_X 2 UBYTE INDEX_INCR DIRECT FNC_VALUES 3 UBYTE COLUMN_DIR DIRECT /end RECORD_LAYOUT
/begin RECORD_LAYOUT RB_Map_U16S16_S16 NO_AXIS_PTS_X 1 UWORD NO_AXIS_PTS_Y 2 UWORD AXIS_PTS_X 3 UWORD INDEX_INCR DIRECT AXIS_PTS_Y 4 SWORD INDEX_INCR DIRECT FNC_VALUES 5 SWORD COLUMN_DIR DIRECT /end RECORD_LAYOUT
/begin RECORD_LAYOUT RB_ValA_Wu16 FNC_VALUES 1 UWORD COLUMN_DIR DIRECT /end RECORD_LAYOUT
/begin RECORD_LAYOUT RB_ValA_Wu8 FNC_VALUES 1 UBYTE COLUMN_DIR DIRECT /end RECORD_LAYOUT
/begin RECORD_LAYOUT RB_Val_Ws16 FNC_VALUES 1 SWORD COLUMN_DIR DIRECT /end RECORD_LAYOUT
/begin RECORD_LAYOUT RB_Val_Ws32 FNC_VALUES 1 SLONG COLUMN_DIR DIRECT /end RECORD_LAYOUT
/begin RECORD_LAYOUT RB_Val_Ws8 FNC_VALUES 1 SBYTE COLUMN_DIR DIRECT /end RECORD_LAYOUT
/begin RECORD_LAYOUT RB_Val_Wu16 FNC_VALUES 1 UWORD COLUMN_DIR DIRECT /end RECORD_LAYOUT
/begin RECORD_LAYOUT RB_Val_Wu8 FNC_VALUES 1 UBYTE COLUMN_DIR DIRECT /end RECORD_LAYOUT
/begin RECORD_LAYOUT Val_Ws16 FNC_VALUES 1 SWORD COLUMN_DIR DIRECT /end RECORD_LAYOUT
/begin RECORD_LAYOUT Val_Wu16 FNC_VALUES 1 UWORD COLUMN_DIR DIRECT /end RECORD_LAYOUT
/begin RECORD_LAYOUT Val_Wu8 FNC_VALUES 1 UBYTE COLUMN_DIR DIRECT /end RECORD_LAYOUT
/end MODULE
/end PROJECT
