ASAP2_VERSION 1 60
/begin PROJECT MG1CA020 "MG1CA020"
/begin HEADER "" VERSION "MG1CA020_6SAY_V011_TPROT" PROJECT_NO MG1CA020 /end HEADER
/begin MODULE DIM ""
/begin MOD_COMMON "" BYTE_ORDER MSB_LAST ALIGNMENT_BYTE 1 ALIGNMENT_WORD 2 ALIGNMENT_LONG 4 ALIGNMENT_INT64 4 ALIGNMENT_FLOAT32_IEEE 4 ALIGNMENT_FLOAT64_IEEE 4 DATA_SIZE 32 /end MOD_COMMON
/begin CHARACTERISTIC DFC_DisblMsk.DFC_Clth2ONStuckLdc_C "disable mask / Disable masks of check DFC_Clth2ONStuckLdc" VALUE 0x804EE90C Val_Wu16 65535.00 DFES_OneToOne 0.00 65535.00 FORMAT "%8.2" /end CHARACTERISTIC
/begin CHARACTERISTIC DFC_DisblMsk.DFC_Clth3ONStuckLdc_C "disable mask / Disable masks of check DFC_Clth3ONStuckLdc" VALUE 0x804EE90E Val_Wu16 65535.00 DFES_OneToOne 0.00 65535.00 FORMAT "%8.2" /end CHARACTERISTIC
/begin CHARACTERISTIC DFC_DisblMsk.DFC_Clth3ONStuckPostDrv_C "disable mask / Disable masks of check DFC_Clth3ONStuckPostDrv" VALUE 0x804EE910 Val_Wu16 65535.00 DFES_OneToOne 0.00 65535.00 FORMAT "%8.2" /end CHARACTERISTIC
/begin CHARACTERISTIC DFC_DisblMsk.DFC_Clth4ONStuck_C "disable mask / Disable masks of check DFC_Clth4ONStuck" VALUE 0x804EE912 Val_Wu16 65535.00 DFES_OneToOne 0.00 65535.00 FORMAT "%8.2" /end CHARACTERISTIC
/begin CHARACTERISTIC DFC_DisblMsk.DFC_Clth4ONStuckLdc_C "disable mask / Disable masks of check DFC_Clth4ONStuckLdc" VALUE 0x804EE914 Val_Wu16 65535.00 DFES_OneToOne 0.00 65535.00 FORMAT "%8.2" /end CHARACTERISTIC
/begin CHARACTERISTIC DFC_DisblMsk.DFC_ComDLCTCU01_C "disable mask / Disable masks of check DFC_ComDLCTCU01" VALUE 0x804EE916 Val_Wu16 65535.00 DFES_OneToOne 0.00 65535.00 FORMAT "%8.2" /end CHARACTERISTIC
/begin CHARACTERISTIC DFC_DisblMsk.DFC_ComDLCTCU02_C "disable mask / Disable masks of check DFC_ComDLCTCU02" VALUE 0x804EE918 Val_Wu16 65535.00 DFES_OneToOne 0.00 65535.00 FORMAT "%8.2" /end CHARACTERISTIC
/begin CHARACTERISTIC DFC_DisblMsk.DFC_ComDLCTCU1_C "disable mask / Disable masks of check DFC_ComDLCTCU1" VALUE 0x804EE91A Val_Wu16 65535.00 DFES_OneToOne 0.00 65535.00 FORMAT "%8.2" /end CHARACTERISTIC
/begin CHARACTERISTIC DFC_DisblMsk.DFC_ComDLCTCU11_C "disable mask / Disable masks of check DFC_ComDLCTCU11" VALUE 0x804EE91C Val_Wu16 65535.00 DFES_OneToOne 0.00 65535.00 FORMAT "%8.2" /end CHARACTERISTIC
/begin CHARACTERISTIC DFC_DisblMsk.DFC_ComDLCTCU12_C "disable mask / Disable masks of check DFC_ComDLCTCU12" VALUE 0x804EE91E Val_Wu16 65535.00 DFES_OneToOne 0.00 65535.00 FORMAT "%8.2" /end CHARACTERISTIC
/begin CHARACTERISTIC DFC_DisblMsk.DFC_ComDLCTCU13_C "disable mask / Disable masks of check DFC_ComDLCTCU13" VALUE 0x804EE920 Val_Wu16 65535.00 DFES_OneToOne 0.00 65535.00 FORMAT "%8.2" /end CHARACTERISTIC
/begin CHARACTERISTIC DFC_DisblMsk.DFC_ComDLCTCU14_C "disable mask / Disable masks of check DFC_ComDLCTCU14" VALUE 0x804EE922 Val_Wu16 65535.00 DFES_OneToOne 0.00 65535.00 FORMAT "%8.2" /end CHARACTERISTIC
/begin CHARACTERISTIC DFC_DisblMsk.DFC_ComDLCTCU2_C "disable mask / Disable masks of check DFC_ComDLCTCU2" VALUE 0x804EE924 Val_Wu16 65535.00 DFES_OneToOne 0.00 65535.00 FORMAT "%8.2" /end CHARACTERISTIC
/begin CHARACTERISTIC DFC_DisblMsk.DFC_ComDLCTCU3_C "disable mask / Disable masks of check DFC_ComDLCTCU3" VALUE 0x804EE926 Val_Wu16 65535.00 DFES_OneToOne 0.00 65535.00 FORMAT "%8.2" /end CHARACTERISTIC
/begin CHARACTERISTIC DFC_DisblMsk.DFC_ComDLCTCU4_C "disable mask / Disable masks of check DFC_ComDLCTCU4" VALUE 0x804EE928 Val_Wu16 65535.00 DFES_OneToOne 0.00 65535.00 FORMAT "%8.2" /end CHARACTERISTIC
/begin CHARACTERISTIC DFC_DisblMsk.DFC_EVX_C "disable mask / Disable masks of check DFC_EVX" VALUE 0x804EE92A Val_Wu16 65535.00 DFES_OneToOne 0.00 65535.00 FORMAT "%8.2" /end CHARACTERISTIC
/begin CHARACTERISTIC DFC_DisblMsk.DFC_EbsSocFlt_C "disable mask / Disable masks of check DFC_EbsSocFlt" VALUE 0x804EE92C Val_Wu16 65535.00 DFES_OneToOne 0.00 65535.00 FORMAT "%8.2" /end CHARACTERISTIC
/begin CHARACTERISTIC DFC_DisblMsk.DFC_I14229VINErr_C "disable mask / Disable masks of check DFC_I14229VINErr" VALUE 0x804EE92E Val_Wu16 65535.00 DFES_OneToOne 0.00 65535.00 FORMAT "%8.2" /end CHARACTERISTIC
/begin CHARACTERISTIC DFC_DisblMsk.DFC_LLRKHmax_C "disable mask / Disable masks of check DFC_LLRKHmax" VALUE 0x804EE930 Val_Wu16 65535.00 DFES_OneToOne 0.00 65535.00 FORMAT "%8.2" /end CHARACTERISTIC
/begin CHARACTERISTIC DFC_DisblMsk.DFC_LLRKHmin_C "disable mask / Disable masks of check DFC_LLRKHmin" VALUE 0x804EE932 Val_Wu16 65535.00 DFES_OneToOne 0.00 65535.00 FORMAT "%8.2" /end CHARACTERISTIC
/begin CHARACTERISTIC DFC_DisblMsk.DFC_LLRmax_C "disable mask / Disable masks of check DFC_LLRmax" VALUE 0x804EE934 Val_Wu16 65535.00 DFES_OneToOne 0.00 65535.00 FORMAT "%8.2" /end CHARACTERISTIC
/begin CHARACTERISTIC DFC_DisblMsk.DFC_LLRmin_C "disable mask / Disable masks of check DFC_LLRmin" VALUE 0x804EE936 Val_Wu16 65535.00 DFES_OneToOne 0.00 65535.00 FORMAT "%8.2" /end CHARACTERISTIC
/begin CHARACTERISTIC DFC_DisblMsk.DFC_RoughRoad_C "disable mask / Disable masks of check DFC_RoughRoad" VALUE 0x804EE938 Val_Wu16 65535.00 DFES_OneToOne 0.00 65535.00 FORMAT "%8.2" /end CHARACTERISTIC
/begin CHARACTERISTIC DFC_DisblMsk.DFC_SiaEEPRdErr_C "disable mask / Disable masks of check DFC_SiaEEPRdErr" VALUE 0x804EE93A Val_Wu16 65535.00 DFES_OneToOne 0.00 65535.00 FORMAT "%8.2" /end CHARACTERISTIC
/begin CHARACTERISTIC DFC_DisblMsk.DFC_SiaEEPWrngCod_C "disable mask / Disable masks of check DFC_SiaEEPWrngCod" VALUE 0x804EE93C Val_Wu16 65535.00 DFES_OneToOne 0.00 65535.00 FORMAT "%8.2" /end CHARACTERISTIC
/begin CHARACTERISTIC DFC_DisblMsk.DFC_UegoDummy_C "disable mask / Disable masks of check DFC_UegoDummy" VALUE 0x804EE93E Val_Wu16 65535.00 DFES_OneToOne 0.00 65535.00 FORMAT "%8.2" /end CHARACTERISTIC
/begin CHARACTERISTIC DFC_DisblMsk.DFC_BusDiagCANAPPLBusOff_C "disable mask / Disable masks of check DFC_BusDiagCANAPPLBusOff" VALUE 0x804EE940 Val_Wu16 65535.00 DFES_OneToOne 0.00 65535.00 FORMAT "%8.2" /end CHARACTERISTIC
/begin CHARACTERISTIC DFC_DisblMsk.DFC_BusDiagCANCANCBusOff_C "disable mask / Disable masks of check DFC_BusDiagCANCANCBusOff" VALUE 0x804EE942 Val_Wu16 65535.00 DFES_OneToOne 0.00 65535.00 FORMAT "%8.2" /end CHARACTERISTIC
/begin CHARACTERISTIC DFC_DisblMsk.DFC_BusDiagCANVEHICLEBusOff_C "disable mask / Disable masks of check DFC_BusDiagCANVEHICLEBusOff" VALUE 0x804EE944 Val_Wu16 65535.00 DFES_OneToOne 0.00 65535.00 FORMAT "%8.2" /end CHARACTERISTIC
/begin CHARACTERISTIC DFC_DisblMsk.DFC_RBA_IODIAGPWR_rba_IoExtCy329_SignalVltSply_0_C "disable mask / Disable masks of check DFC_RBA_IODIAGPWR_rba_IoExtCy329_SignalVltSply_0" VALUE 0x804EE946 Val_Wu16 65535.00 DFES_OneToOne 0.00 65535.00 FORMAT "%8.2" /end CHARACTERISTIC
/begin CHARACTERISTIC DFC_DisblMsk.DFC_RBA_IODIAGPWR_rba_IoExtCy329_SignalVltSply_0OT_C "disable mask / Disable masks of check DFC_RBA_IODIAGPWR_rba_IoExtCy329_SignalVltSply_0OT" VALUE 0x804EE948 Val_Wu16 65535.00 DFES_OneToOne 0.00 65535.00 FORMAT "%8.2" /end CHARACTERISTIC
/begin CHARACTERISTIC DFC_DisblMsk.DFC_RBA_IODIAGPWR_rba_IoExtCy329_SignalVltSply_0OV_C "disable mask / Disable masks of check DFC_RBA_IODIAGPWR_rba_IoExtCy329_SignalVltSply_0OV" VALUE 0x804EE94A Val_Wu16 65535.00 DFES_OneToOne 0.00 65535.00 FORMAT "%8.2" /end CHARACTERISTIC
/begin CHARACTERISTIC DFC_DisblMsk.DFC_RBA_IODIAGPWR_rba_IoExtCy329_SignalVltSply_0SCG_C "disable mask / Disable masks of check DFC_RBA_IODIAGPWR_rba_IoExtCy329_SignalVltSply_0SCG" VALUE 0x804EE94C Val_Wu16 65535.00 DFES_OneToOne 0.00 65535.00 FORMAT "%8.2" /end CHARACTERISTIC
/begin CHARACTERISTIC DFC_DisblMsk.DFC_RBA_IODIAGPWR_rba_IoExtCy329_SignalVltSply_0UV_C "disable mask / Disable masks of check DFC_RBA_IODIAGPWR_rba_IoExtCy329_SignalVltSply_0UV" VALUE 0x804EE94E Val_Wu16 65535.00 DFES_OneToOne 0.00 65535.00 FORMAT "%8.2" /end CHARACTERISTIC
/begin CHARACTERISTIC DFC_DisblMsk.DFC_RBA_IODIAGPWR_rba_IoExtCy329_SignalVltSply_1_C "disable mask / Disable masks of check DFC_RBA_IODIAGPWR_rba_IoExtCy329_SignalVltSply_1" VALUE 0x804EE950 Val_Wu16 65535.00 DFES_OneToOne 0.00 65535.00 FORMAT "%8.2" /end CHARACTERISTIC
/begin CHARACTERISTIC DFC_DisblMsk.DFC_RBA_IODIAGPWR_rba_IoExtCy329_SignalVltSply_1OT_C "disable mask / Disable masks of check DFC_RBA_IODIAGPWR_rba_IoExtCy329_SignalVltSply_1OT" VALUE 0x804EE952 Val_Wu16 65535.00 DFES_OneToOne 0.00 65535.00 FORMAT "%8.2" /end CHARACTERISTIC
/begin CHARACTERISTIC DFC_DisblMsk.DFC_RBA_IODIAGPWR_rba_IoExtCy329_SignalVltSply_1OV_C "disable mask / Disable masks of check DFC_RBA_IODIAGPWR_rba_IoExtCy329_SignalVltSply_1OV" VALUE 0x804EE954 Val_Wu16 65535.00 DFES_OneToOne 0.00 65535.00 FORMAT "%8.2" /end CHARACTERISTIC
/begin CHARACTERISTIC DFC_DisblMsk.DFC_RBA_IODIAGPWR_rba_IoExtCy329_SignalVltSply_1SCG_C "disable mask / Disable masks of check DFC_RBA_IODIAGPWR_rba_IoExtCy329_SignalVltSply_1SCG" VALUE 0x804EE956 Val_Wu16 65535.00 DFES_OneToOne 0.00 65535.00 FORMAT "%8.2" /end CHARACTERISTIC
/begin CHARACTERISTIC DFC_DisblMsk.DFC_RBA_IODIAGPWR_rba_IoExtCy329_SignalVltSply_1UV_C "disable mask / Disable masks of check DFC_RBA_IODIAGPWR_rba_IoExtCy329_SignalVltSply_1UV" VALUE 0x804EE958 Val_Wu16 65535.00 DFES_OneToOne 0.00 65535.00 FORMAT "%8.2" /end CHARACTERISTIC
/begin CHARACTERISTIC DFC_DisblMsk.DFC_RBA_IODIAGPWR_rba_IoExtCy329_SignalVltSply_2_C "disable mask / Disable masks of check DFC_RBA_IODIAGPWR_rba_IoExtCy329_SignalVltSply_2" VALUE 0x804EE95A Val_Wu16 65535.00 DFES_OneToOne 0.00 65535.00 FORMAT "%8.2" /end CHARACTERISTIC
/begin CHARACTERISTIC DFC_DisblMsk.DFC_RBA_IODIAGPWR_rba_IoExtCy329_SignalVltSply_2OT_C "disable mask / Disable masks of check DFC_RBA_IODIAGPWR_rba_IoExtCy329_SignalVltSply_2OT" VALUE 0x804EE95C Val_Wu16 65535.00 DFES_OneToOne 0.00 65535.00 FORMAT "%8.2" /end CHARACTERISTIC
/begin CHARACTERISTIC DFC_DisblMsk.DFC_RBA_IODIAGPWR_rba_IoExtCy329_SignalVltSply_2OV_C "disable mask / Disable masks of check DFC_RBA_IODIAGPWR_rba_IoExtCy329_SignalVltSply_2OV" VALUE 0x804EE95E Val_Wu16 65535.00 DFES_OneToOne 0.00 65535.00 FORMAT "%8.2" /end CHARACTERISTIC
/begin CHARACTERISTIC DFC_DisblMsk.DFC_RBA_IODIAGPWR_rba_IoExtCy329_SignalVltSply_2SCG_C "disable mask / Disable masks of check DFC_RBA_IODIAGPWR_rba_IoExtCy329_SignalVltSply_2SCG" VALUE 0x804EE960 Val_Wu16 65535.00 DFES_OneToOne 0.00 65535.00 FORMAT "%8.2" /end CHARACTERISTIC
/begin CHARACTERISTIC DFC_DisblMsk.DFC_RBA_IODIAGPWR_rba_IoExtCy329_SignalVltSply_2UV_C "disable mask / Disable masks of check DFC_RBA_IODIAGPWR_rba_IoExtCy329_SignalVltSply_2UV" VALUE 0x804EE962 Val_Wu16 65535.00 DFES_OneToOne 0.00 65535.00 FORMAT "%8.2" /end CHARACTERISTIC
/begin CHARACTERISTIC DFC_DisblMsk.DFC_CAN_E_TIMEOUT_C "disable mask / Disable masks of check DFC_CAN_E_TIMEOUT" VALUE 0x804EE964 Val_Wu16 65535.00 DFES_OneToOne 0.00 65535.00 FORMAT "%8.2" /end CHARACTERISTIC
/begin CHARACTERISTIC DFC_DisblMsk.DFC_LIN_E_TIMEOUT_C "disable mask / Disable masks of check DFC_LIN_E_TIMEOUT" VALUE 0x804EE966 Val_Wu16 65535.00 DFES_OneToOne 0.00 65535.00 FORMAT "%8.2" /end CHARACTERISTIC
/begin CHARACTERISTIC DFC_DisblMsk.DFC_MRlyOL_C "disable mask / Disable masks of check DFC_MRlyOL" VALUE 0x804EE968 Val_Wu16 65535.00 DFES_OneToOne 0.00 65535.00 FORMAT "%8.2" /end CHARACTERISTIC
/begin CHARACTERISTIC DFC_DisblMsk.DFC_MRlySCB_C "disable mask / Disable masks of check DFC_MRlySCB" VALUE 0x804EE96A Val_Wu16 65535.00 DFES_OneToOne 0.00 65535.00 FORMAT "%8.2" /end CHARACTERISTIC
/begin CHARACTERISTIC DFC_DisblMsk.DFC_MRlySCG_C "disable mask / Disable masks of check DFC_MRlySCG" VALUE 0x804EE96C Val_Wu16 65535.00 DFES_OneToOne 0.00 65535.00 FORMAT "%8.2" /end CHARACTERISTIC
/begin CHARACTERISTIC DFC_DisblMsk.DFC_rba_MultiStackTrace_Threshold_C "disable mask / Disable masks of check DFC_rba_MultiStackTrace_Threshold" VALUE 0x804EE96E Val_Wu16 65535.00 DFES_OneToOne 0.00 65535.00 FORMAT "%8.2" /end CHARACTERISTIC
/begin CHARACTERISTIC DFC_DisblMsk.DFC_BSWM_E_ACTION_FAILED_C "disable mask / Disable masks of check DFC_BSWM_E_ACTION_FAILED" VALUE 0x804EE970 Val_Wu16 65535.00 DFES_OneToOne 0.00 65535.00 FORMAT "%8.2" /end CHARACTERISTIC
/begin CHARACTERISTIC DFC_DisblMsk.DFC_BSWM_E_INTRPTQUEUE_FULL_C "disable mask / Disable masks of check DFC_BSWM_E_INTRPTQUEUE_FULL" VALUE 0x804EE972 Val_Wu16 65535.00 DFES_OneToOne 0.00 65535.00 FORMAT "%8.2" /end CHARACTERISTIC
/begin CHARACTERISTIC DFC_DisblMsk.DFC_RBA_IOEXTLIB_KEEPALIVE_DRV_C "disable mask / Disable masks of check DFC_RBA_IOEXTLIB_KEEPALIVE_DRV" VALUE 0x804EE974 Val_Wu16 65535.00 DFES_OneToOne 0.00 65535.00 FORMAT "%8.2" /end CHARACTERISTIC
/begin CHARACTERISTIC DFC_DisblMsk.DFC_RBA_IOEXTLIB_KEEPALIVE_INI_C "disable mask / Disable masks of check DFC_RBA_IOEXTLIB_KEEPALIVE_INI" VALUE 0x804EE976 Val_Wu16 65535.00 DFES_OneToOne 0.00 65535.00 FORMAT "%8.2" /end CHARACTERISTIC
/begin CHARACTERISTIC DFC_DisblMsk.DFC_rba_IoSigRtc_StopCounter_C "disable mask / Disable masks of check DFC_rba_IoSigRtc_StopCounter" VALUE 0x804EE978 Val_Wu16 65535.00 DFES_OneToOne 0.00 65535.00 FORMAT "%8.2" /end CHARACTERISTIC
/begin CHARACTERISTIC DFC_DisblMsk.DFC_rba_MRly_Diag_Stk_Event_C "disable mask / Disable masks of check DFC_rba_MRly_Diag_Stk_Event" VALUE 0x804EE97A Val_Wu16 65535.00 DFES_OneToOne 0.00 65535.00 FORMAT "%8.2" /end CHARACTERISTIC
/begin CHARACTERISTIC DFC_DisblMsk.DFC_rba_MemDiag_MemReadErr_C "disable mask / Disable masks of check DFC_rba_MemDiag_MemReadErr" VALUE 0x804EE97C Val_Wu16 65535.00 DFES_OneToOne 0.00 65535.00 FORMAT "%8.2" /end CHARACTERISTIC
/begin CHARACTERISTIC DFC_DisblMsk.DFC_rba_MemDiag_MemWrErr_C "disable mask / Disable masks of check DFC_rba_MemDiag_MemWrErr" VALUE 0x804EE97E Val_Wu16 65535.00 DFES_OneToOne 0.00 65535.00 FORMAT "%8.2" /end CHARACTERISTIC
/begin CHARACTERISTIC DFC_DisblMsk.DFC_rba_SyC_IrrSwOffTrigEngRun_Event_C "disable mask / Disable masks of check DFC_rba_SyC_IrrSwOffTrigEngRun_Event" VALUE 0x804EE980 Val_Wu16 65535.00 DFES_OneToOne 0.00 65535.00 FORMAT "%8.2" /end CHARACTERISTIC
/begin CHARACTERISTIC DFC_DisblMsk.DFC_rba_T15_Diag_ComInVld_Event_C "disable mask / Disable masks of check DFC_rba_T15_Diag_ComInVld_Event" VALUE 0x804EE982 Val_Wu16 65535.00 DFES_OneToOne 0.00 65535.00 FORMAT "%8.2" /end CHARACTERISTIC
/begin CHARACTERISTIC DFC_DisblMsk.DFC_rba_T15_Diag_ComOff_HwOn_Event_C "disable mask / Disable masks of check DFC_rba_T15_Diag_ComOff_HwOn_Event" VALUE 0x804EE984 Val_Wu16 65535.00 DFES_OneToOne 0.00 65535.00 FORMAT "%8.2" /end CHARACTERISTIC
/begin CHARACTERISTIC DFC_DisblMsk.DFC_rba_T15_Diag_ComOn_HwOff_Event_C "disable mask / Disable masks of check DFC_rba_T15_Diag_ComOn_HwOff_Event" VALUE 0x804EE986 Val_Wu16 65535.00 DFES_OneToOne 0.00 65535.00 FORMAT "%8.2" /end CHARACTERISTIC
/begin CHARACTERISTIC DFC_DisblMsk.DFC_AppAllSnsrDfct_C "disable mask / Disable masks of check DFC_AppAllSnsrDfct" VALUE 0x804EE988 Val_Wu16 65535.00 DFES_OneToOne 0.00 65535.00 FORMAT "%8.2" /end CHARACTERISTIC
/begin CHARACTERISTIC DFC_DisblMsk.DFC_BattUStdbyDiaOL_C "disable mask / Disable masks of check DFC_BattUStdbyDiaOL" VALUE 0x804EE98A Val_Wu16 65535.00 DFES_OneToOne 0.00 65535.00 FORMAT "%8.2" /end CHARACTERISTIC
/begin CHARACTERISTIC DFC_DisblMsk.DFC_BigLeakIntkMnfldEmiInfl_C "disable mask / Disable masks of check DFC_BigLeakIntkMnfldEmiInfl" VALUE 0x804EE98C Val_Wu16 65535.00 DFES_OneToOne 0.00 65535.00 FORMAT "%8.2" /end CHARACTERISTIC
/begin CHARACTERISTIC DFC_DisblMsk.DFC_BrkMnSwtContOnWarnLmp_C "disable mask / Disable masks of check DFC_BrkMnSwtContOnWarnLmp" VALUE 0x804EE98E Val_Wu16 65535.00 DFES_OneToOne 0.00 65535.00 FORMAT "%8.2" /end CHARACTERISTIC
/begin CHARACTERISTIC DFC_DisblMsk.DFC_BrkMnSwtNotStpWarnLmp_C "disable mask / Disable masks of check DFC_BrkMnSwtNotStpWarnLmp" VALUE 0x804EE990 Val_Wu16 65535.00 DFES_OneToOne 0.00 65535.00 FORMAT "%8.2" /end CHARACTERISTIC
/begin CHARACTERISTIC DFC_DisblMsk.DFC_BrkRdntSwtContOnWarnLmp_C "disable mask / Disable masks of check DFC_BrkRdntSwtContOnWarnLmp" VALUE 0x804EE992 Val_Wu16 65535.00 DFES_OneToOne 0.00 65535.00 FORMAT "%8.2" /end CHARACTERISTIC
/begin CHARACTERISTIC DFC_DisblMsk.DFC_BrkRdntSwtNotStpWarnLmp_C "disable mask / Disable masks of check DFC_BrkRdntSwtNotStpWarnLmp" VALUE 0x804EE994 Val_Wu16 65535.00 DFES_OneToOne 0.00 65535.00 FORMAT "%8.2" /end CHARACTERISTIC
/begin CHARACTERISTIC DFC_DisblMsk.DFC_CEngDsTColdStrtMax_C "disable mask / Disable masks of check DFC_CEngDsTColdStrtMax" VALUE 0x804EE996 Val_Wu16 65535.00 DFES_OneToOne 0.00 65535.00 FORMAT "%8.2" /end CHARACTERISTIC
/begin CHARACTERISTIC DFC_DisblMsk.DFC_CEngDsTColdStrtMin_C "disable mask / Disable masks of check DFC_CEngDsTColdStrtMin" VALUE 0x804EE998 Val_Wu16 65535.00 DFES_OneToOne 0.00 65535.00 FORMAT "%8.2" /end CHARACTERISTIC
/begin CHARACTERISTIC DFC_DisblMsk.DFC_CEngDsTImps_C "disable mask / Disable masks of check DFC_CEngDsTImps" VALUE 0x804EE99A Val_Wu16 65535.00 DFES_OneToOne 0.00 65535.00 FORMAT "%8.2" /end CHARACTERISTIC
/begin CHARACTERISTIC DFC_DisblMsk.DFC_CEngDsTPlausLSC_C "disable mask / Disable masks of check DFC_CEngDsTPlausLSC" VALUE 0x804EE99C Val_Wu16 65535.00 DFES_OneToOne 0.00 65535.00 FORMAT "%8.2" /end CHARACTERISTIC
/begin CHARACTERISTIC DFC_DisblMsk.DFC_CEngDsTPlausSTC_C "disable mask / Disable masks of check DFC_CEngDsTPlausSTC" VALUE 0x804EE99E Val_Wu16 65535.00 DFES_OneToOne 0.00 65535.00 FORMAT "%8.2" /end CHARACTERISTIC
/begin CHARACTERISTIC DFC_DisblMsk.DFC_CEngDsTSRCMax_C "disable mask / Disable masks of check DFC_CEngDsTSRCMax" VALUE 0x804EE9A0 Val_Wu16 65535.00 DFES_OneToOne 0.00 65535.00 FORMAT "%8.2" /end CHARACTERISTIC
/begin CHARACTERISTIC DFC_DisblMsk.DFC_CEngDsTSRCMin_C "disable mask / Disable masks of check DFC_CEngDsTSRCMin" VALUE 0x804EE9A2 Val_Wu16 65535.00 DFES_OneToOne 0.00 65535.00 FORMAT "%8.2" /end CHARACTERISTIC
/begin CHARACTERISTIC DFC_DisblMsk.DFC_CEngDsTSig_C "disable mask / Disable masks of check DFC_CEngDsTSig" VALUE 0x804EE9A4 Val_Wu16 65535.00 DFES_OneToOne 0.00 65535.00 FORMAT "%8.2" /end CHARACTERISTIC
/begin CHARACTERISTIC DFC_DisblMsk.DFC_CEngUsTSRCMax_C "disable mask / Disable masks of check DFC_CEngUsTSRCMax" VALUE 0x804EE9A6 Val_Wu16 65535.00 DFES_OneToOne 0.00 65535.00 FORMAT "%8.2" /end CHARACTERISTIC
/begin CHARACTERISTIC DFC_DisblMsk.DFC_CEngUsTSRCMin_C "disable mask / Disable masks of check DFC_CEngUsTSRCMin" VALUE 0x804EE9A8 Val_Wu16 65535.00 DFES_OneToOne 0.00 65535.00 FORMAT "%8.2" /end CHARACTERISTIC
/begin CHARACTERISTIC DFC_DisblMsk.DFC_DCDCFltDet_C "disable mask / Disable masks of check DFC_DCDCFltDet" VALUE 0x804EE9AA Val_Wu16 65535.00 DFES_OneToOne 0.00 65535.00 FORMAT "%8.2" /end CHARACTERISTIC
/begin CHARACTERISTIC DFC_DisblMsk.DFC_DKRSA_C "disable mask / Disable masks of check DFC_DKRSA" VALUE 0x804EE9AC Val_Wu16 65535.00 DFES_OneToOne 0.00 65535.00 FORMAT "%8.2" /end CHARACTERISTIC
/begin CHARACTERISTIC DFC_DisblMsk.DFC_DKVSmax_C "disable mask / Disable masks of check DFC_DKVSmax" VALUE 0x804EE9AE Val_Wu16 65535.00 DFES_OneToOne 0.00 65535.00 FORMAT "%8.2" /end CHARACTERISTIC
/begin CHARACTERISTIC DFC_DisblMsk.DFC_DKnpl_C "disable mask / Disable masks of check DFC_DKnpl" VALUE 0x804EE9B0 Val_Wu16 65535.00 DFES_OneToOne 0.00 65535.00 FORMAT "%8.2" /end CHARACTERISTIC
/begin CHARACTERISTIC DFC_DisblMsk.DFC_DSSmax_C "disable mask / Disable masks of check DFC_DSSmax" VALUE 0x804EE9B2 Val_Wu16 65535.00 DFES_OneToOne 0.00 65535.00 FORMAT "%8.2" /end CHARACTERISTIC
/begin CHARACTERISTIC DFC_DisblMsk.DFC_DSTTI_C "disable mask / Disable masks of check DFC_DSTTI" VALUE 0x804EE9B4 Val_Wu16 65535.00 DFES_OneToOne 0.00 65535.00 FORMAT "%8.2" /end CHARACTERISTIC
/begin CHARACTERISTIC DFC_DisblMsk.DFC_DSUmax_C "disable mask / Disable masks of check DFC_DSUmax" VALUE 0x804EE9B6 Val_Wu16 65535.00 DFES_OneToOne 0.00 65535.00 FORMAT "%8.2" /end CHARACTERISTIC
/begin CHARACTERISTIC DFC_DisblMsk.DFC_EGRVlvOL_C "disable mask / Disable masks of check DFC_EGRVlvOL" VALUE 0x804EE9B8 Val_Wu16 65535.00 DFES_OneToOne 0.00 65535.00 FORMAT "%8.2" /end CHARACTERISTIC
/begin CHARACTERISTIC DFC_DisblMsk.DFC_EGRVlvSCB_C "disable mask / Disable masks of check DFC_EGRVlvSCB" VALUE 0x804EE9BA Val_Wu16 65535.00 DFES_OneToOne 0.00 65535.00 FORMAT "%8.2" /end CHARACTERISTIC
/begin CHARACTERISTIC DFC_DisblMsk.DFC_EGRVlvSCG_C "disable mask / Disable masks of check DFC_EGRVlvSCG" VALUE 0x804EE9BC Val_Wu16 65535.00 DFES_OneToOne 0.00 65535.00 FORMAT "%8.2" /end CHARACTERISTIC
/begin CHARACTERISTIC DFC_DisblMsk.DFC_EGSDUS2B1LtrDly_C "disable mask / Disable masks of check DFC_EGSDUS2B1LtrDly" VALUE 0x804EE9BE Val_Wu16 65535.00 DFES_OneToOne 0.00 65535.00 FORMAT "%8.2" /end CHARACTERISTIC
/begin CHARACTERISTIC DFC_DisblMsk.DFC_EGSDUS2B1LtrPT1_C "disable mask / Disable masks of check DFC_EGSDUS2B1LtrPT1" VALUE 0x804EE9C0 Val_Wu16 65535.00 DFES_OneToOne 0.00 65535.00 FORMAT "%8.2" /end CHARACTERISTIC
/begin CHARACTERISTIC DFC_DisblMsk.DFC_EGSDUS2B1RtlDly_C "disable mask / Disable masks of check DFC_EGSDUS2B1RtlDly" VALUE 0x804EE9C2 Val_Wu16 65535.00 DFES_OneToOne 0.00 65535.00 FORMAT "%8.2" /end CHARACTERISTIC
/begin CHARACTERISTIC DFC_DisblMsk.DFC_EGSDUS2B1RtlPT1_C "disable mask / Disable masks of check DFC_EGSDUS2B1RtlPT1" VALUE 0x804EE9C4 Val_Wu16 65535.00 DFES_OneToOne 0.00 65535.00 FORMAT "%8.2" /end CHARACTERISTIC
/begin CHARACTERISTIC DFC_DisblMsk.DFC_EGSDUS2B1TarLean_C "disable mask / Disable masks of check DFC_EGSDUS2B1TarLean" VALUE 0x804EE9C6 Val_Wu16 65535.00 DFES_OneToOne 0.00 65535.00 FORMAT "%8.2" /end CHARACTERISTIC
/begin CHARACTERISTIC DFC_DisblMsk.DFC_EGSDUS2B1TarRich_C "disable mask / Disable masks of check DFC_EGSDUS2B1TarRich" VALUE 0x804EE9C8 Val_Wu16 65535.00 DFES_OneToOne 0.00 65535.00 FORMAT "%8.2" /end CHARACTERISTIC
/begin CHARACTERISTIC DFC_DisblMsk.DFC_ETAKHLmax_C "disable mask / Disable masks of check DFC_ETAKHLmax" VALUE 0x804EE9CA Val_Wu16 65535.00 DFES_OneToOne 0.00 65535.00 FORMAT "%8.2" /end CHARACTERISTIC
/begin CHARACTERISTIC DFC_DisblMsk.DFC_ETAKHTmax_C "disable mask / Disable masks of check DFC_ETAKHTmax" VALUE 0x804EE9CC Val_Wu16 65535.00 DFES_OneToOne 0.00 65535.00 FORMAT "%8.2" /end CHARACTERISTIC
/begin CHARACTERISTIC DFC_DisblMsk.DFC_EngICO_C "disable mask / Disable masks of check DFC_EngICO" VALUE 0x804EE9CE Val_Wu16 65535.00 DFES_OneToOne 0.00 65535.00 FORMAT "%8.2" /end CHARACTERISTIC
/begin CHARACTERISTIC DFC_DisblMsk.DFC_EngPrtOvrSpdMon_C "disable mask / Disable masks of check DFC_EngPrtOvrSpdMon" VALUE 0x804EE9D0 Val_Wu16 65535.00 DFES_OneToOne 0.00 65535.00 FORMAT "%8.2" /end CHARACTERISTIC
/begin CHARACTERISTIC DFC_DisblMsk.DFC_EpmCaSI1ErrSig_C "disable mask / Disable masks of check DFC_EpmCaSI1ErrSig" VALUE 0x804EE9D2 Val_Wu16 65535.00 DFES_OneToOne 0.00 65535.00 FORMAT "%8.2" /end CHARACTERISTIC
/begin CHARACTERISTIC DFC_DisblMsk.DFC_EpmCaSI1NoSig_C "disable mask / Disable masks of check DFC_EpmCaSI1NoSig" VALUE 0x804EE9D4 Val_Wu16 65535.00 DFES_OneToOne 0.00 65535.00 FORMAT "%8.2" /end CHARACTERISTIC
/begin CHARACTERISTIC DFC_DisblMsk.DFC_EpmCaSI1OfsErr_C "disable mask / Disable masks of check DFC_EpmCaSI1OfsErr" VALUE 0x804EE9D6 Val_Wu16 65535.00 DFES_OneToOne 0.00 65535.00 FORMAT "%8.2" /end CHARACTERISTIC
/begin CHARACTERISTIC DFC_DisblMsk.DFC_EpmCrSErrSig_C "disable mask / Disable masks of check DFC_EpmCrSErrSig" VALUE 0x804EE9D8 Val_Wu16 65535.00 DFES_OneToOne 0.00 65535.00 FORMAT "%8.2" /end CHARACTERISTIC
/begin CHARACTERISTIC DFC_DisblMsk.DFC_EpmCrSNoSig_C "disable mask / Disable masks of check DFC_EpmCrSNoSig" VALUE 0x804EE9DA Val_Wu16 65535.00 DFES_OneToOne 0.00 65535.00 FORMAT "%8.2" /end CHARACTERISTIC
/begin CHARACTERISTIC DFC_DisblMsk.DFC_EtaEngIdleNonCsers_C "disable mask / Disable masks of check DFC_EtaEngIdleNonCsers" VALUE 0x804EE9DC Val_Wu16 65535.00 DFES_OneToOne 0.00 65535.00 FORMAT "%8.2" /end CHARACTERISTIC
/begin CHARACTERISTIC DFC_DisblMsk.DFC_EtaEngPtlNonCsers_C "disable mask / Disable masks of check DFC_EtaEngPtlNonCsers" VALUE 0x804EE9DE Val_Wu16 65535.00 DFES_OneToOne 0.00 65535.00 FORMAT "%8.2" /end CHARACTERISTIC
/begin CHARACTERISTIC DFC_DisblMsk.DFC_FRAmax_C "disable mask / Disable masks of check DFC_FRAmax" VALUE 0x804EE9E0 Val_Wu16 65535.00 DFES_OneToOne 0.00 65535.00 FORMAT "%8.2" /end CHARACTERISTIC
/begin CHARACTERISTIC DFC_DisblMsk.DFC_FRAmin_C "disable mask / Disable masks of check DFC_FRAmin" VALUE 0x804EE9E2 Val_Wu16 65535.00 DFES_OneToOne 0.00 65535.00 FORMAT "%8.2" /end CHARACTERISTIC
/begin CHARACTERISTIC DFC_DisblMsk.DFC_GbxRvsSwtStk_C "disable mask / Disable masks of check DFC_GbxRvsSwtStk" VALUE 0x804EE9E4 Val_Wu16 65535.00 DFES_OneToOne 0.00 65535.00 FORMAT "%8.2" /end CHARACTERISTIC
/begin CHARACTERISTIC DFC_DisblMsk.DFC_HDRmax_C "disable mask / Disable masks of check DFC_HDRmax" VALUE 0x804EE9E6 Val_Wu16 65535.00 DFES_OneToOne 0.00 65535.00 FORMAT "%8.2" /end CHARACTERISTIC
/begin CHARACTERISTIC DFC_DisblMsk.DFC_HEGOS2B1ElecMax_C "disable mask / Disable masks of check DFC_HEGOS2B1ElecMax" VALUE 0x804EE9E8 Val_Wu16 65535.00 DFES_OneToOne 0.00 65535.00 FORMAT "%8.2" /end CHARACTERISTIC
/begin CHARACTERISTIC DFC_DisblMsk.DFC_HEGOS2B1ElecMin_C "disable mask / Disable masks of check DFC_HEGOS2B1ElecMin" VALUE 0x804EE9EA Val_Wu16 65535.00 DFES_OneToOne 0.00 65535.00 FORMAT "%8.2" /end CHARACTERISTIC
/begin CHARACTERISTIC DFC_DisblMsk.DFC_HEGOS2B1ElecSig_C "disable mask / Disable masks of check DFC_HEGOS2B1ElecSig" VALUE 0x804EE9EC Val_Wu16 65535.00 DFES_OneToOne 0.00 65535.00 FORMAT "%8.2" /end CHARACTERISTIC
/begin CHARACTERISTIC DFC_DisblMsk.DFC_HEGOS2B1HtgNpl_C "disable mask / Disable masks of check DFC_HEGOS2B1HtgNpl" VALUE 0x804EE9EE Val_Wu16 65535.00 DFES_OneToOne 0.00 65535.00 FORMAT "%8.2" /end CHARACTERISTIC
/begin CHARACTERISTIC DFC_DisblMsk.DFC_IntkAirTIntkMnfldCrssMax_C "disable mask / Disable masks of check DFC_IntkAirTIntkMnfldCrssMax" VALUE 0x804EE9F0 Val_Wu16 65535.00 DFES_OneToOne 0.00 65535.00 FORMAT "%8.2" /end CHARACTERISTIC
/begin CHARACTERISTIC DFC_DisblMsk.DFC_IntkAirTIntkMnfldCrssMin_C "disable mask / Disable masks of check DFC_IntkAirTIntkMnfldCrssMin" VALUE 0x804EE9F2 Val_Wu16 65535.00 DFES_OneToOne 0.00 65535.00 FORMAT "%8.2" /end CHARACTERISTIC
/begin CHARACTERISTIC DFC_DisblMsk.DFC_IntkAirTIntkMnfldHSCMax_C "disable mask / Disable masks of check DFC_IntkAirTIntkMnfldHSCMax" VALUE 0x804EE9F4 Val_Wu16 65535.00 DFES_OneToOne 0.00 65535.00 FORMAT "%8.2" /end CHARACTERISTIC
/begin CHARACTERISTIC DFC_DisblMsk.DFC_IntkAirTIntkMnfldImps_C "disable mask / Disable masks of check DFC_IntkAirTIntkMnfldImps" VALUE 0x804EE9F6 Val_Wu16 65535.00 DFES_OneToOne 0.00 65535.00 FORMAT "%8.2" /end CHARACTERISTIC
/begin CHARACTERISTIC DFC_DisblMsk.DFC_IntkAirTIntkMnfldPRCMax_C "disable mask / Disable masks of check DFC_IntkAirTIntkMnfldPRCMax" VALUE 0x804EE9F8 Val_Wu16 65535.00 DFES_OneToOne 0.00 65535.00 FORMAT "%8.2" /end CHARACTERISTIC
/begin CHARACTERISTIC DFC_DisblMsk.DFC_IntkAirTIntkMnfldPRCMin_C "disable mask / Disable masks of check DFC_IntkAirTIntkMnfldPRCMin" VALUE 0x804EE9FA Val_Wu16 65535.00 DFES_OneToOne 0.00 65535.00 FORMAT "%8.2" /end CHARACTERISTIC
/begin CHARACTERISTIC DFC_DisblMsk.DFC_IntkAirTIntkMnfldSRCMax_C "disable mask / Disable masks of check DFC_IntkAirTIntkMnfldSRCMax" VALUE 0x804EE9FC Val_Wu16 65535.00 DFES_OneToOne 0.00 65535.00 FORMAT "%8.2" /end CHARACTERISTIC
/begin CHARACTERISTIC DFC_DisblMsk.DFC_IntkAirTIntkMnfldSRCMin_C "disable mask / Disable masks of check DFC_IntkAirTIntkMnfldSRCMin" VALUE 0x804EE9FE Val_Wu16 65535.00 DFES_OneToOne 0.00 65535.00 FORMAT "%8.2" /end CHARACTERISTIC
/begin CHARACTERISTIC DFC_DisblMsk.DFC_IntkAirTIntkMnfldSTC_C "disable mask / Disable masks of check DFC_IntkAirTIntkMnfldSTC" VALUE 0x804EEA00 Val_Wu16 65535.00 DFES_OneToOne 0.00 65535.00 FORMAT "%8.2" /end CHARACTERISTIC
/begin CHARACTERISTIC DFC_DisblMsk.DFC_KS1max_C "disable mask / Disable masks of check DFC_KS1max" VALUE 0x804EEA02 Val_Wu16 65535.00 DFES_OneToOne 0.00 65535.00 FORMAT "%8.2" /end CHARACTERISTIC
/begin CHARACTERISTIC DFC_DisblMsk.DFC_KS1min_C "disable mask / Disable masks of check DFC_KS1min" VALUE 0x804EEA04 Val_Wu16 65535.00 DFES_OneToOne 0.00 65535.00 FORMAT "%8.2" /end CHARACTERISTIC
/begin CHARACTERISTIC DFC_DisblMsk.DFC_LMmax_C "disable mask / Disable masks of check DFC_LMmax" VALUE 0x804EEA06 Val_Wu16 65535.00 DFES_OneToOne 0.00 65535.00 FORMAT "%8.2" /end CHARACTERISTIC
/begin CHARACTERISTIC DFC_DisblMsk.DFC_LZSRnpl_C "disable mask / Disable masks of check DFC_LZSRnpl" VALUE 0x804EEA08 Val_Wu16 65535.00 DFES_OneToOne 0.00 65535.00 FORMAT "%8.2" /end CHARACTERISTIC
/begin CHARACTERISTIC DFC_DisblMsk.DFC_LamDynDiagS1B1_C "disable mask / Disable masks of check DFC_LamDynDiagS1B1" VALUE 0x804EEA0A Val_Wu16 65535.00 DFES_OneToOne 0.00 65535.00 FORMAT "%8.2" /end CHARACTERISTIC
/begin CHARACTERISTIC DFC_DisblMsk.DFC_LeakIntkMnfldEmiInfl_C "disable mask / Disable masks of check DFC_LeakIntkMnfldEmiInfl" VALUE 0x804EEA0C Val_Wu16 65535.00 DFES_OneToOne 0.00 65535.00 FORMAT "%8.2" /end CHARACTERISTIC
/begin CHARACTERISTIC DFC_DisblMsk.DFC_MD00max_C "disable mask / Disable masks of check DFC_MD00max" VALUE 0x804EEA0E Val_Wu16 65535.00 DFES_OneToOne 0.00 65535.00 FORMAT "%8.2" /end CHARACTERISTIC
/begin CHARACTERISTIC DFC_DisblMsk.DFC_MDBmax_C "disable mask / Disable masks of check DFC_MDBmax" VALUE 0x804EEA10 Val_Wu16 65535.00 DFES_OneToOne 0.00 65535.00 FORMAT "%8.2" /end CHARACTERISTIC
/begin CHARACTERISTIC DFC_DisblMsk.DFC_MDCat_C "disable mask / Disable masks of check DFC_MDCat" VALUE 0x804EEA12 Val_Wu16 65535.00 DFES_OneToOne 0.00 65535.00 FORMAT "%8.2" /end CHARACTERISTIC
/begin CHARACTERISTIC DFC_DisblMsk.DFC_MDCatCrit_C "disable mask / Disable masks of check DFC_MDCatCrit" VALUE 0x804EEA14 Val_Wu16 65535.00 DFES_OneToOne 0.00 65535.00 FORMAT "%8.2" /end CHARACTERISTIC
/begin CHARACTERISTIC DFC_DisblMsk.DFC_MDCatCurr_C "disable mask / Disable masks of check DFC_MDCatCurr" VALUE 0x804EEA16 Val_Wu16 65535.00 DFES_OneToOne 0.00 65535.00 FORMAT "%8.2" /end CHARACTERISTIC
/begin CHARACTERISTIC DFC_DisblMsk.DFC_MDCyl_0_C "disable mask / Disable masks of check DFC_MDCyl_0" VALUE 0x804EEA18 Val_Wu16 65535.00 DFES_OneToOne 0.00 65535.00 FORMAT "%8.2" /end CHARACTERISTIC
/begin CHARACTERISTIC DFC_DisblMsk.DFC_MDCyl_1_C "disable mask / Disable masks of check DFC_MDCyl_1" VALUE 0x804EEA1A Val_Wu16 65535.00 DFES_OneToOne 0.00 65535.00 FORMAT "%8.2" /end CHARACTERISTIC
/begin CHARACTERISTIC DFC_DisblMsk.DFC_MDCyl_2_C "disable mask / Disable masks of check DFC_MDCyl_2" VALUE 0x804EEA1C Val_Wu16 65535.00 DFES_OneToOne 0.00 65535.00 FORMAT "%8.2" /end CHARACTERISTIC
/begin CHARACTERISTIC DFC_DisblMsk.DFC_MDCyl_3_C "disable mask / Disable masks of check DFC_MDCyl_3" VALUE 0x804EEA1E Val_Wu16 65535.00 DFES_OneToOne 0.00 65535.00 FORMAT "%8.2" /end CHARACTERISTIC
/begin CHARACTERISTIC DFC_DisblMsk.DFC_MDEmi_C "disable mask / Disable masks of check DFC_MDEmi" VALUE 0x804EEA20 Val_Wu16 65535.00 DFES_OneToOne 0.00 65535.00 FORMAT "%8.2" /end CHARACTERISTIC
/begin CHARACTERISTIC DFC_DisblMsk.DFC_MDEmiStrt_C "disable mask / Disable masks of check DFC_MDEmiStrt" VALUE 0x804EEA22 Val_Wu16 65535.00 DFES_OneToOne 0.00 65535.00 FORMAT "%8.2" /end CHARACTERISTIC
/begin CHARACTERISTIC DFC_DisblMsk.DFC_MDFco_C "disable mask / Disable masks of check DFC_MDFco" VALUE 0x804EEA24 Val_Wu16 65535.00 DFES_OneToOne 0.00 65535.00 FORMAT "%8.2" /end CHARACTERISTIC
/begin CHARACTERISTIC DFC_DisblMsk.DFC_MDMpl_C "disable mask / Disable masks of check DFC_MDMpl" VALUE 0x804EEA26 Val_Wu16 65535.00 DFES_OneToOne 0.00 65535.00 FORMAT "%8.2" /end CHARACTERISTIC
/begin CHARACTERISTIC DFC_DisblMsk.DFC_MDSegTiAdpn_C "disable mask / Disable masks of check DFC_MDSegTiAdpn" VALUE 0x804EEA28 Val_Wu16 65535.00 DFES_OneToOne 0.00 65535.00 FORMAT "%8.2" /end CHARACTERISTIC
/begin CHARACTERISTIC DFC_DisblMsk.DFC_MDmax_C "disable mask / Disable masks of check DFC_MDmax" VALUE 0x804EEA2A Val_Wu16 65535.00 DFES_OneToOne 0.00 65535.00 FORMAT "%8.2" /end CHARACTERISTIC
/begin CHARACTERISTIC DFC_DisblMsk.DFC_MOXEMM_SMU_ALM0_0_C "disable mask / Disable masks of check DFC_MOXEMM_SMU_ALM0_0" VALUE 0x804EEA2C Val_Wu16 65535.00 DFES_OneToOne 0.00 65535.00 FORMAT "%8.2" /end CHARACTERISTIC
/begin CHARACTERISTIC DFC_DisblMsk.DFC_MOXEMM_SMU_ALM0_1_C "disable mask / Disable masks of check DFC_MOXEMM_SMU_ALM0_1" VALUE 0x804EEA2E Val_Wu16 65535.00 DFES_OneToOne 0.00 65535.00 FORMAT "%8.2" /end CHARACTERISTIC
/begin CHARACTERISTIC DFC_DisblMsk.DFC_MOXEMM_SMU_ALM0_10_C "disable mask / Disable masks of check DFC_MOXEMM_SMU_ALM0_10" VALUE 0x804EEA30 Val_Wu16 65535.00 DFES_OneToOne 0.00 65535.00 FORMAT "%8.2" /end CHARACTERISTIC
/begin CHARACTERISTIC DFC_DisblMsk.DFC_MOXEMM_SMU_ALM0_11_C "disable mask / Disable masks of check DFC_MOXEMM_SMU_ALM0_11" VALUE 0x804EEA32 Val_Wu16 65535.00 DFES_OneToOne 0.00 65535.00 FORMAT "%8.2" /end CHARACTERISTIC
/begin CHARACTERISTIC DFC_DisblMsk.DFC_MOXEMM_SMU_ALM0_13_C "disable mask / Disable masks of check DFC_MOXEMM_SMU_ALM0_13" VALUE 0x804EEA34 Val_Wu16 65535.00 DFES_OneToOne 0.00 65535.00 FORMAT "%8.2" /end CHARACTERISTIC
/begin CHARACTERISTIC DFC_DisblMsk.DFC_MOXEMM_SMU_ALM0_14_C "disable mask / Disable masks of check DFC_MOXEMM_SMU_ALM0_14" VALUE 0x804EEA36 Val_Wu16 65535.00 DFES_OneToOne 0.00 65535.00 FORMAT "%8.2" /end CHARACTERISTIC
/begin CHARACTERISTIC DFC_DisblMsk.DFC_MOXEMM_SMU_ALM0_2_C "disable mask / Disable masks of check DFC_MOXEMM_SMU_ALM0_2" VALUE 0x804EEA38 Val_Wu16 65535.00 DFES_OneToOne 0.00 65535.00 FORMAT "%8.2" /end CHARACTERISTIC
/begin CHARACTERISTIC DFC_DisblMsk.DFC_MOXEMM_SMU_ALM0_22_C "disable mask / Disable masks of check DFC_MOXEMM_SMU_ALM0_22" VALUE 0x804EEA3A Val_Wu16 65535.00 DFES_OneToOne 0.00 65535.00 FORMAT "%8.2" /end CHARACTERISTIC
/begin CHARACTERISTIC DFC_DisblMsk.DFC_MOXEMM_SMU_ALM0_23_C "disable mask / Disable masks of check DFC_MOXEMM_SMU_ALM0_23" VALUE 0x804EEA3C Val_Wu16 65535.00 DFES_OneToOne 0.00 65535.00 FORMAT "%8.2" /end CHARACTERISTIC
/begin CHARACTERISTIC DFC_DisblMsk.DFC_MOXEMM_SMU_ALM0_4_C "disable mask / Disable masks of check DFC_MOXEMM_SMU_ALM0_4" VALUE 0x804EEA3E Val_Wu16 65535.00 DFES_OneToOne 0.00 65535.00 FORMAT "%8.2" /end CHARACTERISTIC
/begin CHARACTERISTIC DFC_DisblMsk.DFC_MOXEMM_SMU_ALM0_5_C "disable mask / Disable masks of check DFC_MOXEMM_SMU_ALM0_5" VALUE 0x804EEA40 Val_Wu16 65535.00 DFES_OneToOne 0.00 65535.00 FORMAT "%8.2" /end CHARACTERISTIC
/begin CHARACTERISTIC DFC_DisblMsk.DFC_MOXEMM_SMU_ALM0_7_C "disable mask / Disable masks of check DFC_MOXEMM_SMU_ALM0_7" VALUE 0x804EEA42 Val_Wu16 65535.00 DFES_OneToOne 0.00 65535.00 FORMAT "%8.2" /end CHARACTERISTIC
/begin CHARACTERISTIC DFC_DisblMsk.DFC_MOXEMM_SMU_ALM0_8_C "disable mask / Disable masks of check DFC_MOXEMM_SMU_ALM0_8" VALUE 0x804EEA44 Val_Wu16 65535.00 DFES_OneToOne 0.00 65535.00 FORMAT "%8.2" /end CHARACTERISTIC
/begin CHARACTERISTIC DFC_DisblMsk.DFC_MOXEMM_SMU_ALM10_16_C "disable mask / Disable masks of check DFC_MOXEMM_SMU_ALM10_16" VALUE 0x804EEA46 Val_Wu16 65535.00 DFES_OneToOne 0.00 65535.00 FORMAT "%8.2" /end CHARACTERISTIC
/begin CHARACTERISTIC DFC_DisblMsk.DFC_MOXEMM_SMU_ALM10_17_C "disable mask / Disable masks of check DFC_MOXEMM_SMU_ALM10_17" VALUE 0x804EEA48 Val_Wu16 65535.00 DFES_OneToOne 0.00 65535.00 FORMAT "%8.2" /end CHARACTERISTIC
/begin CHARACTERISTIC DFC_DisblMsk.DFC_MOXEMM_SMU_ALM10_21_C "disable mask / Disable masks of check DFC_MOXEMM_SMU_ALM10_21" VALUE 0x804EEA4A Val_Wu16 65535.00 DFES_OneToOne 0.00 65535.00 FORMAT "%8.2" /end CHARACTERISTIC
/begin CHARACTERISTIC DFC_DisblMsk.DFC_MOXEMM_SMU_ALM11_0_C "disable mask / Disable masks of check DFC_MOXEMM_SMU_ALM11_0" VALUE 0x804EEA4C Val_Wu16 65535.00 DFES_OneToOne 0.00 65535.00 FORMAT "%8.2" /end CHARACTERISTIC
/begin CHARACTERISTIC DFC_DisblMsk.DFC_MOXEMM_SMU_ALM11_1_C "disable mask / Disable masks of check DFC_MOXEMM_SMU_ALM11_1" VALUE 0x804EEA4E Val_Wu16 65535.00 DFES_OneToOne 0.00 65535.00 FORMAT "%8.2" /end CHARACTERISTIC
/begin CHARACTERISTIC DFC_DisblMsk.DFC_MOXEMM_SMU_ALM11_2_C "disable mask / Disable masks of check DFC_MOXEMM_SMU_ALM11_2" VALUE 0x804EEA50 Val_Wu16 65535.00 DFES_OneToOne 0.00 65535.00 FORMAT "%8.2" /end CHARACTERISTIC
/begin CHARACTERISTIC DFC_DisblMsk.DFC_MOXEMM_SMU_ALM11_3_C "disable mask / Disable masks of check DFC_MOXEMM_SMU_ALM11_3" VALUE 0x804EEA52 Val_Wu16 65535.00 DFES_OneToOne 0.00 65535.00 FORMAT "%8.2" /end CHARACTERISTIC
/begin CHARACTERISTIC DFC_DisblMsk.DFC_MOXEMM_SMU_ALM11_4_C "disable mask / Disable masks of check DFC_MOXEMM_SMU_ALM11_4" VALUE 0x804EEA54 Val_Wu16 65535.00 DFES_OneToOne 0.00 65535.00 FORMAT "%8.2" /end CHARACTERISTIC
/begin CHARACTERISTIC DFC_DisblMsk.DFC_MOXEMM_SMU_ALM11_5_C "disable mask / Disable masks of check DFC_MOXEMM_SMU_ALM11_5" VALUE 0x804EEA56 Val_Wu16 65535.00 DFES_OneToOne 0.00 65535.00 FORMAT "%8.2" /end CHARACTERISTIC
/begin CHARACTERISTIC DFC_DisblMsk.DFC_MOXEMM_SMU_ALM11_8_C "disable mask / Disable masks of check DFC_MOXEMM_SMU_ALM11_8" VALUE 0x804EEA58 Val_Wu16 65535.00 DFES_OneToOne 0.00 65535.00 FORMAT "%8.2" /end CHARACTERISTIC
/begin CHARACTERISTIC DFC_DisblMsk.DFC_MOXEMM_SMU_ALM11_9_C "disable mask / Disable masks of check DFC_MOXEMM_SMU_ALM11_9" VALUE 0x804EEA5A Val_Wu16 65535.00 DFES_OneToOne 0.00 65535.00 FORMAT "%8.2" /end CHARACTERISTIC
/begin CHARACTERISTIC DFC_DisblMsk.DFC_MOXEMM_SMU_ALM1_0_C "disable mask / Disable masks of check DFC_MOXEMM_SMU_ALM1_0" VALUE 0x804EEA5C Val_Wu16 65535.00 DFES_OneToOne 0.00 65535.00 FORMAT "%8.2" /end CHARACTERISTIC
/begin CHARACTERISTIC DFC_DisblMsk.DFC_MOXEMM_SMU_ALM1_1_C "disable mask / Disable masks of check DFC_MOXEMM_SMU_ALM1_1" VALUE 0x804EEA5E Val_Wu16 65535.00 DFES_OneToOne 0.00 65535.00 FORMAT "%8.2" /end CHARACTERISTIC
/begin CHARACTERISTIC DFC_DisblMsk.DFC_MOXEMM_SMU_ALM1_10_C "disable mask / Disable masks of check DFC_MOXEMM_SMU_ALM1_10" VALUE 0x804EEA60 Val_Wu16 65535.00 DFES_OneToOne 0.00 65535.00 FORMAT "%8.2" /end CHARACTERISTIC
/begin CHARACTERISTIC DFC_DisblMsk.DFC_MOXEMM_SMU_ALM1_11_C "disable mask / Disable masks of check DFC_MOXEMM_SMU_ALM1_11" VALUE 0x804EEA62 Val_Wu16 65535.00 DFES_OneToOne 0.00 65535.00 FORMAT "%8.2" /end CHARACTERISTIC
/begin CHARACTERISTIC DFC_DisblMsk.DFC_MOXEMM_SMU_ALM1_13_C "disable mask / Disable masks of check DFC_MOXEMM_SMU_ALM1_13" VALUE 0x804EEA64 Val_Wu16 65535.00 DFES_OneToOne 0.00 65535.00 FORMAT "%8.2" /end CHARACTERISTIC
/begin CHARACTERISTIC DFC_DisblMsk.DFC_MOXEMM_SMU_ALM1_14_C "disable mask / Disable masks of check DFC_MOXEMM_SMU_ALM1_14" VALUE 0x804EEA66 Val_Wu16 65535.00 DFES_OneToOne 0.00 65535.00 FORMAT "%8.2" /end CHARACTERISTIC
/begin CHARACTERISTIC DFC_DisblMsk.DFC_MOXEMM_SMU_ALM1_2_C "disable mask / Disable masks of check DFC_MOXEMM_SMU_ALM1_2" VALUE 0x804EEA68 Val_Wu16 65535.00 DFES_OneToOne 0.00 65535.00 FORMAT "%8.2" /end CHARACTERISTIC
/begin CHARACTERISTIC DFC_DisblMsk.DFC_MOXEMM_SMU_ALM1_22_C "disable mask / Disable masks of check DFC_MOXEMM_SMU_ALM1_22" VALUE 0x804EEA6A Val_Wu16 65535.00 DFES_OneToOne 0.00 65535.00 FORMAT "%8.2" /end CHARACTERISTIC
/begin CHARACTERISTIC DFC_DisblMsk.DFC_MOXEMM_SMU_ALM1_23_C "disable mask / Disable masks of check DFC_MOXEMM_SMU_ALM1_23" VALUE 0x804EEA6C Val_Wu16 65535.00 DFES_OneToOne 0.00 65535.00 FORMAT "%8.2" /end CHARACTERISTIC
/begin CHARACTERISTIC DFC_DisblMsk.DFC_MOXEMM_SMU_ALM1_4_C "disable mask / Disable masks of check DFC_MOXEMM_SMU_ALM1_4" VALUE 0x804EEA6E Val_Wu16 65535.00 DFES_OneToOne 0.00 65535.00 FORMAT "%8.2" /end CHARACTERISTIC
/begin CHARACTERISTIC DFC_DisblMsk.DFC_MOXEMM_SMU_ALM1_5_C "disable mask / Disable masks of check DFC_MOXEMM_SMU_ALM1_5" VALUE 0x804EEA70 Val_Wu16 65535.00 DFES_OneToOne 0.00 65535.00 FORMAT "%8.2" /end CHARACTERISTIC
/begin CHARACTERISTIC DFC_DisblMsk.DFC_MOXEMM_SMU_ALM1_7_C "disable mask / Disable masks of check DFC_MOXEMM_SMU_ALM1_7" VALUE 0x804EEA72 Val_Wu16 65535.00 DFES_OneToOne 0.00 65535.00 FORMAT "%8.2" /end CHARACTERISTIC
/begin CHARACTERISTIC DFC_DisblMsk.DFC_MOXEMM_SMU_ALM1_8_C "disable mask / Disable masks of check DFC_MOXEMM_SMU_ALM1_8" VALUE 0x804EEA74 Val_Wu16 65535.00 DFES_OneToOne 0.00 65535.00 FORMAT "%8.2" /end CHARACTERISTIC
/begin CHARACTERISTIC DFC_DisblMsk.DFC_MOXEMM_SMU_ALM21_0_C "disable mask / Disable masks of check DFC_MOXEMM_SMU_ALM21_0" VALUE 0x804EEA76 Val_Wu16 65535.00 DFES_OneToOne 0.00 65535.00 FORMAT "%8.2" /end CHARACTERISTIC
/begin CHARACTERISTIC DFC_DisblMsk.DFC_MOXEMM_SMU_ALM21_16_C "disable mask / Disable masks of check DFC_MOXEMM_SMU_ALM21_16" VALUE 0x804EEA78 Val_Wu16 65535.00 DFES_OneToOne 0.00 65535.00 FORMAT "%8.2" /end CHARACTERISTIC
/begin CHARACTERISTIC DFC_DisblMsk.DFC_MOXEMM_SMU_ALM21_3_C "disable mask / Disable masks of check DFC_MOXEMM_SMU_ALM21_3" VALUE 0x804EEA7A Val_Wu16 65535.00 DFES_OneToOne 0.00 65535.00 FORMAT "%8.2" /end CHARACTERISTIC
/begin CHARACTERISTIC DFC_DisblMsk.DFC_MOXEMM_SMU_ALM2_1_C "disable mask / Disable masks of check DFC_MOXEMM_SMU_ALM2_1" VALUE 0x804EEA7C Val_Wu16 65535.00 DFES_OneToOne 0.00 65535.00 FORMAT "%8.2" /end CHARACTERISTIC
/begin CHARACTERISTIC DFC_DisblMsk.DFC_MOXEMM_SMU_ALM2_10_C "disable mask / Disable masks of check DFC_MOXEMM_SMU_ALM2_10" VALUE 0x804EEA7E Val_Wu16 65535.00 DFES_OneToOne 0.00 65535.00 FORMAT "%8.2" /end CHARACTERISTIC
/begin CHARACTERISTIC DFC_DisblMsk.DFC_MOXEMM_SMU_ALM2_11_C "disable mask / Disable masks of check DFC_MOXEMM_SMU_ALM2_11" VALUE 0x804EEA80 Val_Wu16 65535.00 DFES_OneToOne 0.00 65535.00 FORMAT "%8.2" /end CHARACTERISTIC
/begin CHARACTERISTIC DFC_DisblMsk.DFC_MOXEMM_SMU_ALM2_13_C "disable mask / Disable masks of check DFC_MOXEMM_SMU_ALM2_13" VALUE 0x804EEA82 Val_Wu16 65535.00 DFES_OneToOne 0.00 65535.00 FORMAT "%8.2" /end CHARACTERISTIC
/begin CHARACTERISTIC DFC_DisblMsk.DFC_MOXEMM_SMU_ALM2_14_C "disable mask / Disable masks of check DFC_MOXEMM_SMU_ALM2_14" VALUE 0x804EEA84 Val_Wu16 65535.00 DFES_OneToOne 0.00 65535.00 FORMAT "%8.2" /end CHARACTERISTIC
/begin CHARACTERISTIC DFC_DisblMsk.DFC_MOXEMM_SMU_ALM2_22_C "disable mask / Disable masks of check DFC_MOXEMM_SMU_ALM2_22" VALUE 0x804EEA86 Val_Wu16 65535.00 DFES_OneToOne 0.00 65535.00 FORMAT "%8.2" /end CHARACTERISTIC
/begin CHARACTERISTIC DFC_DisblMsk.DFC_MOXEMM_SMU_ALM2_23_C "disable mask / Disable masks of check DFC_MOXEMM_SMU_ALM2_23" VALUE 0x804EEA88 Val_Wu16 65535.00 DFES_OneToOne 0.00 65535.00 FORMAT "%8.2" /end CHARACTERISTIC
/begin CHARACTERISTIC DFC_DisblMsk.DFC_MOXEMM_SMU_ALM2_4_C "disable mask / Disable masks of check DFC_MOXEMM_SMU_ALM2_4" VALUE 0x804EEA8A Val_Wu16 65535.00 DFES_OneToOne 0.00 65535.00 FORMAT "%8.2" /end CHARACTERISTIC
/begin CHARACTERISTIC DFC_DisblMsk.DFC_MOXEMM_SMU_ALM2_5_C "disable mask / Disable masks of check DFC_MOXEMM_SMU_ALM2_5" VALUE 0x804EEA8C Val_Wu16 65535.00 DFES_OneToOne 0.00 65535.00 FORMAT "%8.2" /end CHARACTERISTIC
/begin CHARACTERISTIC DFC_DisblMsk.DFC_MOXEMM_SMU_ALM2_7_C "disable mask / Disable masks of check DFC_MOXEMM_SMU_ALM2_7" VALUE 0x804EEA8E Val_Wu16 65535.00 DFES_OneToOne 0.00 65535.00 FORMAT "%8.2" /end CHARACTERISTIC
/begin CHARACTERISTIC DFC_DisblMsk.DFC_MOXEMM_SMU_ALM2_8_C "disable mask / Disable masks of check DFC_MOXEMM_SMU_ALM2_8" VALUE 0x804EEA90 Val_Wu16 65535.00 DFES_OneToOne 0.00 65535.00 FORMAT "%8.2" /end CHARACTERISTIC
/begin CHARACTERISTIC DFC_DisblMsk.DFC_MOXEMM_SMU_ALM6_0_C "disable mask / Disable masks of check DFC_MOXEMM_SMU_ALM6_0" VALUE 0x804EEA92 Val_Wu16 65535.00 DFES_OneToOne 0.00 65535.00 FORMAT "%8.2" /end CHARACTERISTIC
/begin CHARACTERISTIC DFC_DisblMsk.DFC_MOXEMM_SMU_ALM6_11_C "disable mask / Disable masks of check DFC_MOXEMM_SMU_ALM6_11" VALUE 0x804EEA94 Val_Wu16 65535.00 DFES_OneToOne 0.00 65535.00 FORMAT "%8.2" /end CHARACTERISTIC
/begin CHARACTERISTIC DFC_DisblMsk.DFC_MOXEMM_SMU_ALM6_12_C "disable mask / Disable masks of check DFC_MOXEMM_SMU_ALM6_12" VALUE 0x804EEA96 Val_Wu16 65535.00 DFES_OneToOne 0.00 65535.00 FORMAT "%8.2" /end CHARACTERISTIC
/begin CHARACTERISTIC DFC_DisblMsk.DFC_MOXEMM_SMU_ALM6_14_C "disable mask / Disable masks of check DFC_MOXEMM_SMU_ALM6_14" VALUE 0x804EEA98 Val_Wu16 65535.00 DFES_OneToOne 0.00 65535.00 FORMAT "%8.2" /end CHARACTERISTIC
/begin CHARACTERISTIC DFC_DisblMsk.DFC_MOXEMM_SMU_ALM6_15_C "disable mask / Disable masks of check DFC_MOXEMM_SMU_ALM6_15" VALUE 0x804EEA9A Val_Wu16 65535.00 DFES_OneToOne 0.00 65535.00 FORMAT "%8.2" /end CHARACTERISTIC
/begin CHARACTERISTIC DFC_DisblMsk.DFC_MOXEMM_SMU_ALM6_17_C "disable mask / Disable masks of check DFC_MOXEMM_SMU_ALM6_17" VALUE 0x804EEA9C Val_Wu16 65535.00 DFES_OneToOne 0.00 65535.00 FORMAT "%8.2" /end CHARACTERISTIC
/begin CHARACTERISTIC DFC_DisblMsk.DFC_MOXEMM_SMU_ALM6_18_C "disable mask / Disable masks of check DFC_MOXEMM_SMU_ALM6_18" VALUE 0x804EEA9E Val_Wu16 65535.00 DFES_OneToOne 0.00 65535.00 FORMAT "%8.2" /end CHARACTERISTIC
/begin CHARACTERISTIC DFC_DisblMsk.DFC_MOXEMM_SMU_ALM6_20_C "disable mask / Disable masks of check DFC_MOXEMM_SMU_ALM6_20" VALUE 0x804EEAA0 Val_Wu16 65535.00 DFES_OneToOne 0.00 65535.00 FORMAT "%8.2" /end CHARACTERISTIC
/begin CHARACTERISTIC DFC_DisblMsk.DFC_MOXEMM_SMU_ALM6_21_C "disable mask / Disable masks of check DFC_MOXEMM_SMU_ALM6_21" VALUE 0x804EEAA2 Val_Wu16 65535.00 DFES_OneToOne 0.00 65535.00 FORMAT "%8.2" /end CHARACTERISTIC
/begin CHARACTERISTIC DFC_DisblMsk.DFC_MOXEMM_SMU_ALM6_25_C "disable mask / Disable masks of check DFC_MOXEMM_SMU_ALM6_25" VALUE 0x804EEAA4 Val_Wu16 65535.00 DFES_OneToOne 0.00 65535.00 FORMAT "%8.2" /end CHARACTERISTIC
/begin CHARACTERISTIC DFC_DisblMsk.DFC_MOXEMM_SMU_ALM6_4_C "disable mask / Disable masks of check DFC_MOXEMM_SMU_ALM6_4" VALUE 0x804EEAA6 Val_Wu16 65535.00 DFES_OneToOne 0.00 65535.00 FORMAT "%8.2" /end CHARACTERISTIC
/begin CHARACTERISTIC DFC_DisblMsk.DFC_MOXEMM_SMU_ALM6_5_C "disable mask / Disable masks of check DFC_MOXEMM_SMU_ALM6_5" VALUE 0x804EEAA8 Val_Wu16 65535.00 DFES_OneToOne 0.00 65535.00 FORMAT "%8.2" /end CHARACTERISTIC
/begin CHARACTERISTIC DFC_DisblMsk.DFC_MOXEMM_SMU_ALM6_7_C "disable mask / Disable masks of check DFC_MOXEMM_SMU_ALM6_7" VALUE 0x804EEAAA Val_Wu16 65535.00 DFES_OneToOne 0.00 65535.00 FORMAT "%8.2" /end CHARACTERISTIC
/begin CHARACTERISTIC DFC_DisblMsk.DFC_MOXEMM_SMU_ALM6_8_C "disable mask / Disable masks of check DFC_MOXEMM_SMU_ALM6_8" VALUE 0x804EEAAC Val_Wu16 65535.00 DFES_OneToOne 0.00 65535.00 FORMAT "%8.2" /end CHARACTERISTIC
/begin CHARACTERISTIC DFC_DisblMsk.DFC_MOXEMM_SMU_ALM7_1_C "disable mask / Disable masks of check DFC_MOXEMM_SMU_ALM7_1" VALUE 0x804EEAAE Val_Wu16 65535.00 DFES_OneToOne 0.00 65535.00 FORMAT "%8.2" /end CHARACTERISTIC
/begin CHARACTERISTIC DFC_DisblMsk.DFC_MOXEMM_SMU_ALM7_12_C "disable mask / Disable masks of check DFC_MOXEMM_SMU_ALM7_12" VALUE 0x804EEAB0 Val_Wu16 65535.00 DFES_OneToOne 0.00 65535.00 FORMAT "%8.2" /end CHARACTERISTIC
/begin CHARACTERISTIC DFC_DisblMsk.DFC_MOXEMM_SMU_ALM7_13_C "disable mask / Disable masks of check DFC_MOXEMM_SMU_ALM7_13" VALUE 0x804EEAB2 Val_Wu16 65535.00 DFES_OneToOne 0.00 65535.00 FORMAT "%8.2" /end CHARACTERISTIC
/begin CHARACTERISTIC DFC_DisblMsk.DFC_MOXEMM_SMU_ALM7_14_C "disable mask / Disable masks of check DFC_MOXEMM_SMU_ALM7_14" VALUE 0x804EEAB4 Val_Wu16 65535.00 DFES_OneToOne 0.00 65535.00 FORMAT "%8.2" /end CHARACTERISTIC
/begin CHARACTERISTIC DFC_DisblMsk.DFC_MOXEMM_SMU_ALM7_15_C "disable mask / Disable masks of check DFC_MOXEMM_SMU_ALM7_15" VALUE 0x804EEAB6 Val_Wu16 65535.00 DFES_OneToOne 0.00 65535.00 FORMAT "%8.2" /end CHARACTERISTIC
/begin CHARACTERISTIC DFC_DisblMsk.DFC_MOXEMM_SMU_ALM7_16_C "disable mask / Disable masks of check DFC_MOXEMM_SMU_ALM7_16" VALUE 0x804EEAB8 Val_Wu16 65535.00 DFES_OneToOne 0.00 65535.00 FORMAT "%8.2" /end CHARACTERISTIC
/begin CHARACTERISTIC DFC_DisblMsk.DFC_MOXEMM_SMU_ALM7_17_C "disable mask / Disable masks of check DFC_MOXEMM_SMU_ALM7_17" VALUE 0x804EEABA Val_Wu16 65535.00 DFES_OneToOne 0.00 65535.00 FORMAT "%8.2" /end CHARACTERISTIC
/begin CHARACTERISTIC DFC_DisblMsk.DFC_MOXEMM_SMU_ALM7_2_C "disable mask / Disable masks of check DFC_MOXEMM_SMU_ALM7_2" VALUE 0x804EEABC Val_Wu16 65535.00 DFES_OneToOne 0.00 65535.00 FORMAT "%8.2" /end CHARACTERISTIC
/begin CHARACTERISTIC DFC_DisblMsk.DFC_MOXEMM_SMU_ALM7_20_C "disable mask / Disable masks of check DFC_MOXEMM_SMU_ALM7_20" VALUE 0x804EEABE Val_Wu16 65535.00 DFES_OneToOne 0.00 65535.00 FORMAT "%8.2" /end CHARACTERISTIC
/begin CHARACTERISTIC DFC_DisblMsk.DFC_MOXEMM_SMU_ALM7_25_C "disable mask / Disable masks of check DFC_MOXEMM_SMU_ALM7_25" VALUE 0x804EEAC0 Val_Wu16 65535.00 DFES_OneToOne 0.00 65535.00 FORMAT "%8.2" /end CHARACTERISTIC
/begin CHARACTERISTIC DFC_DisblMsk.DFC_MOXEMM_SMU_ALM7_26_C "disable mask / Disable masks of check DFC_MOXEMM_SMU_ALM7_26" VALUE 0x804EEAC2 Val_Wu16 65535.00 DFES_OneToOne 0.00 65535.00 FORMAT "%8.2" /end CHARACTERISTIC
/begin CHARACTERISTIC DFC_DisblMsk.DFC_MOXEMM_SMU_ALM7_28_C "disable mask / Disable masks of check DFC_MOXEMM_SMU_ALM7_28" VALUE 0x804EEAC4 Val_Wu16 65535.00 DFES_OneToOne 0.00 65535.00 FORMAT "%8.2" /end CHARACTERISTIC
/begin CHARACTERISTIC DFC_DisblMsk.DFC_MOXEMM_SMU_ALM7_29_C "disable mask / Disable masks of check DFC_MOXEMM_SMU_ALM7_29" VALUE 0x804EEAC6 Val_Wu16 65535.00 DFES_OneToOne 0.00 65535.00 FORMAT "%8.2" /end CHARACTERISTIC
/begin CHARACTERISTIC DFC_DisblMsk.DFC_MOXEMM_SMU_ALM7_30_C "disable mask / Disable masks of check DFC_MOXEMM_SMU_ALM7_30" VALUE 0x804EEAC8 Val_Wu16 65535.00 DFES_OneToOne 0.00 65535.00 FORMAT "%8.2" /end CHARACTERISTIC
/begin CHARACTERISTIC DFC_DisblMsk.DFC_MOXEMM_SMU_ALM7_31_C "disable mask / Disable masks of check DFC_MOXEMM_SMU_ALM7_31" VALUE 0x804EEACA Val_Wu16 65535.00 DFES_OneToOne 0.00 65535.00 FORMAT "%8.2" /end CHARACTERISTIC
/begin CHARACTERISTIC DFC_DisblMsk.DFC_MOXEMM_SMU_ALM8_0_C "disable mask / Disable masks of check DFC_MOXEMM_SMU_ALM8_0" VALUE 0x804EEACC Val_Wu16 65535.00 DFES_OneToOne 0.00 65535.00 FORMAT "%8.2" /end CHARACTERISTIC
/begin CHARACTERISTIC DFC_DisblMsk.DFC_MOXEMM_SMU_ALM8_1_C "disable mask / Disable masks of check DFC_MOXEMM_SMU_ALM8_1" VALUE 0x804EEACE Val_Wu16 65535.00 DFES_OneToOne 0.00 65535.00 FORMAT "%8.2" /end CHARACTERISTIC
/begin CHARACTERISTIC DFC_DisblMsk.DFC_MOXEMM_SMU_ALM8_10_C "disable mask / Disable masks of check DFC_MOXEMM_SMU_ALM8_10" VALUE 0x804EEAD0 Val_Wu16 65535.00 DFES_OneToOne 0.00 65535.00 FORMAT "%8.2" /end CHARACTERISTIC
/begin CHARACTERISTIC DFC_DisblMsk.DFC_MOXEMM_SMU_ALM8_11_C "disable mask / Disable masks of check DFC_MOXEMM_SMU_ALM8_11" VALUE 0x804EEAD2 Val_Wu16 65535.00 DFES_OneToOne 0.00 65535.00 FORMAT "%8.2" /end CHARACTERISTIC
/begin CHARACTERISTIC DFC_DisblMsk.DFC_MOXEMM_SMU_ALM8_12_C "disable mask / Disable masks of check DFC_MOXEMM_SMU_ALM8_12" VALUE 0x804EEAD4 Val_Wu16 65535.00 DFES_OneToOne 0.00 65535.00 FORMAT "%8.2" /end CHARACTERISTIC
/begin CHARACTERISTIC DFC_DisblMsk.DFC_MOXEMM_SMU_ALM8_16_C "disable mask / Disable masks of check DFC_MOXEMM_SMU_ALM8_16" VALUE 0x804EEAD6 Val_Wu16 65535.00 DFES_OneToOne 0.00 65535.00 FORMAT "%8.2" /end CHARACTERISTIC
/begin CHARACTERISTIC DFC_DisblMsk.DFC_MOXEMM_SMU_ALM8_18_C "disable mask / Disable masks of check DFC_MOXEMM_SMU_ALM8_18" VALUE 0x804EEAD8 Val_Wu16 65535.00 DFES_OneToOne 0.00 65535.00 FORMAT "%8.2" /end CHARACTERISTIC
/begin CHARACTERISTIC DFC_DisblMsk.DFC_MOXEMM_SMU_ALM8_2_C "disable mask / Disable masks of check DFC_MOXEMM_SMU_ALM8_2" VALUE 0x804EEADA Val_Wu16 65535.00 DFES_OneToOne 0.00 65535.00 FORMAT "%8.2" /end CHARACTERISTIC
/begin CHARACTERISTIC DFC_DisblMsk.DFC_MOXEMM_SMU_ALM8_3_C "disable mask / Disable masks of check DFC_MOXEMM_SMU_ALM8_3" VALUE 0x804EEADC Val_Wu16 65535.00 DFES_OneToOne 0.00 65535.00 FORMAT "%8.2" /end CHARACTERISTIC
/begin CHARACTERISTIC DFC_DisblMsk.DFC_MOXEMM_SMU_ALM8_31_C "disable mask / Disable masks of check DFC_MOXEMM_SMU_ALM8_31" VALUE 0x804EEADE Val_Wu16 65535.00 DFES_OneToOne 0.00 65535.00 FORMAT "%8.2" /end CHARACTERISTIC
/begin CHARACTERISTIC DFC_DisblMsk.DFC_MOXEMM_SMU_ALM8_4_C "disable mask / Disable masks of check DFC_MOXEMM_SMU_ALM8_4" VALUE 0x804EEAE0 Val_Wu16 65535.00 DFES_OneToOne 0.00 65535.00 FORMAT "%8.2" /end CHARACTERISTIC
/begin CHARACTERISTIC DFC_DisblMsk.DFC_MOXEMM_SMU_ALM9_0_C "disable mask / Disable masks of check DFC_MOXEMM_SMU_ALM9_0" VALUE 0x804EEAE2 Val_Wu16 65535.00 DFES_OneToOne 0.00 65535.00 FORMAT "%8.2" /end CHARACTERISTIC
/begin CHARACTERISTIC DFC_DisblMsk.DFC_MOXEMM_SMU_ALM9_15_C "disable mask / Disable masks of check DFC_MOXEMM_SMU_ALM9_15" VALUE 0x804EEAE4 Val_Wu16 65535.00 DFES_OneToOne 0.00 65535.00 FORMAT "%8.2" /end CHARACTERISTIC
/begin CHARACTERISTIC DFC_DisblMsk.DFC_MOXEMM_SMU_ALM9_3_C "disable mask / Disable masks of check DFC_MOXEMM_SMU_ALM9_3" VALUE 0x804EEAE6 Val_Wu16 65535.00 DFES_OneToOne 0.00 65535.00 FORMAT "%8.2" /end CHARACTERISTIC
/begin CHARACTERISTIC DFC_DisblMsk.DFC_MoCADCNTP_C "disable mask / Disable masks of check DFC_MoCADCNTP" VALUE 0x804EEAE8 Val_Wu16 65535.00 DFES_OneToOne 0.00 65535.00 FORMAT "%8.2" /end CHARACTERISTIC
/begin CHARACTERISTIC DFC_DisblMsk.DFC_MoCADCTst_C "disable mask / Disable masks of check DFC_MoCADCTst" VALUE 0x804EEAEA Val_Wu16 65535.00 DFES_OneToOne 0.00 65535.00 FORMAT "%8.2" /end CHARACTERISTIC
/begin CHARACTERISTIC DFC_DisblMsk.DFC_MoCSOPICO_C "disable mask / Disable masks of check DFC_MoCSOPICO" VALUE 0x804EEAEC Val_Wu16 65535.00 DFES_OneToOne 0.00 65535.00 FORMAT "%8.2" /end CHARACTERISTIC
/begin CHARACTERISTIC DFC_DisblMsk.DFC_MoFAPP_C "disable mask / Disable masks of check DFC_MoFAPP" VALUE 0x804EEAEE Val_Wu16 65535.00 DFES_OneToOne 0.00 65535.00 FORMAT "%8.2" /end CHARACTERISTIC
/begin CHARACTERISTIC DFC_DisblMsk.DFC_MoFAirFilgPrdc_C "disable mask / Disable masks of check DFC_MoFAirFilgPrdc" VALUE 0x804EEAF0 Val_Wu16 65535.00 DFES_OneToOne 0.00 65535.00 FORMAT "%8.2" /end CHARACTERISTIC
/begin CHARACTERISTIC DFC_DisblMsk.DFC_MoFAirFlCtOffPfi_C "disable mask / Disable masks of check DFC_MoFAirFlCtOffPfi" VALUE 0x804EEAF2 Val_Wu16 65535.00 DFES_OneToOne 0.00 65535.00 FORMAT "%8.2" /end CHARACTERISTIC
/begin CHARACTERISTIC DFC_DisblMsk.DFC_MoFAirFlCylPfi_C "disable mask / Disable masks of check DFC_MoFAirFlCylPfi" VALUE 0x804EEAF4 Val_Wu16 65535.00 DFES_OneToOne 0.00 65535.00 FORMAT "%8.2" /end CHARACTERISTIC
/begin CHARACTERISTIC DFC_DisblMsk.DFC_MoFAirFlIn_C "disable mask / Disable masks of check DFC_MoFAirFlIn" VALUE 0x804EEAF6 Val_Wu16 65535.00 DFES_OneToOne 0.00 65535.00 FORMAT "%8.2" /end CHARACTERISTIC
/begin CHARACTERISTIC DFC_DisblMsk.DFC_MoFAirFlMixCtlPfiChkAirFl_C "disable mask / Disable masks of check DFC_MoFAirFlMixCtlPfiChkAirFl" VALUE 0x804EEAF8 Val_Wu16 65535.00 DFES_OneToOne 0.00 65535.00 FORMAT "%8.2" /end CHARACTERISTIC
/begin CHARACTERISTIC DFC_DisblMsk.DFC_MoFAirFlMixCtlPfiChkCtrl_C "disable mask / Disable masks of check DFC_MoFAirFlMixCtlPfiChkCtrl" VALUE 0x804EEAFA Val_Wu16 65535.00 DFES_OneToOne 0.00 65535.00 FORMAT "%8.2" /end CHARACTERISTIC
/begin CHARACTERISTIC DFC_DisblMsk.DFC_MoFAirFlMode_C "disable mask / Disable masks of check DFC_MoFAirFlMode" VALUE 0x804EEAFC Val_Wu16 65535.00 DFES_OneToOne 0.00 65535.00 FORMAT "%8.2" /end CHARACTERISTIC
/begin CHARACTERISTIC DFC_DisblMsk.DFC_MoFESpd_C "disable mask / Disable masks of check DFC_MoFESpd" VALUE 0x804EEAFE Val_Wu16 65535.00 DFES_OneToOne 0.00 65535.00 FORMAT "%8.2" /end CHARACTERISTIC
/begin CHARACTERISTIC DFC_DisblMsk.DFC_MoFIACo_C "disable mask / Disable masks of check DFC_MoFIACo" VALUE 0x804EEB00 Val_Wu16 65535.00 DFES_OneToOne 0.00 65535.00 FORMAT "%8.2" /end CHARACTERISTIC
/begin CHARACTERISTIC DFC_DisblMsk.DFC_MoFICOL1_C "disable mask / Disable masks of check DFC_MoFICOL1" VALUE 0x804EEB02 Val_Wu16 65535.00 DFES_OneToOne 0.00 65535.00 FORMAT "%8.2" /end CHARACTERISTIC
/begin CHARACTERISTIC DFC_DisblMsk.DFC_MoFICOL2_C "disable mask / Disable masks of check DFC_MoFICOL2" VALUE 0x804EEB04 Val_Wu16 65535.00 DFES_OneToOne 0.00 65535.00 FORMAT "%8.2" /end CHARACTERISTIC
/begin CHARACTERISTIC DFC_DisblMsk.DFC_MoFStrt_C "disable mask / Disable masks of check DFC_MoFStrt" VALUE 0x804EEB06 Val_Wu16 65535.00 DFES_OneToOne 0.00 65535.00 FORMAT "%8.2" /end CHARACTERISTIC
/begin CHARACTERISTIC DFC_DisblMsk.DFC_MoFTrqCmp_C "disable mask / Disable masks of check DFC_MoFTrqCmp" VALUE 0x804EEB08 Val_Wu16 65535.00 DFES_OneToOne 0.00 65535.00 FORMAT "%8.2" /end CHARACTERISTIC
/begin CHARACTERISTIC DFC_DisblMsk.DFC_MoFTrqCmpMax_C "disable mask / Disable masks of check DFC_MoFTrqCmpMax" VALUE 0x804EEB0A Val_Wu16 65535.00 DFES_OneToOne 0.00 65535.00 FORMAT "%8.2" /end CHARACTERISTIC
/begin CHARACTERISTIC DFC_DisblMsk.DFC_MoFTrqCmpMin_C "disable mask / Disable masks of check DFC_MoFTrqCmpMin" VALUE 0x804EEB0C Val_Wu16 65535.00 DFES_OneToOne 0.00 65535.00 FORMAT "%8.2" /end CHARACTERISTIC
/begin CHARACTERISTIC DFC_DisblMsk.DFC_MoFVarPostBldSel_C "disable mask / Disable masks of check DFC_MoFVarPostBldSel" VALUE 0x804EEB0E Val_Wu16 65535.00 DFES_OneToOne 0.00 65535.00 FORMAT "%8.2" /end CHARACTERISTIC
/begin CHARACTERISTIC DFC_DisblMsk.DFC_MoXEMMHwLTMCUFW_C "disable mask / Disable masks of check DFC_MoXEMMHwLTMCUFW" VALUE 0x804EEB10 Val_Wu16 65535.00 DFES_OneToOne 0.00 65535.00 FORMAT "%8.2" /end CHARACTERISTIC
/begin CHARACTERISTIC DFC_DisblMsk.DFC_MoXEMMHwLTMonBIST_C "disable mask / Disable masks of check DFC_MoXEMMHwLTMonBIST" VALUE 0x804EEB12 Val_Wu16 65535.00 DFES_OneToOne 0.00 65535.00 FORMAT "%8.2" /end CHARACTERISTIC
/begin CHARACTERISTIC DFC_DisblMsk.DFC_MoXEMMHwLTRegMonTest_C "disable mask / Disable masks of check DFC_MoXEMMHwLTRegMonTest" VALUE 0x804EEB14 Val_Wu16 65535.00 DFES_OneToOne 0.00 65535.00 FORMAT "%8.2" /end CHARACTERISTIC
/begin CHARACTERISTIC DFC_DisblMsk.DFC_MoXEMMHwLTStbySMUAlvTest_C "disable mask / Disable masks of check DFC_MoXEMMHwLTStbySMUAlvTest" VALUE 0x804EEB16 Val_Wu16 65535.00 DFES_OneToOne 0.00 65535.00 FORMAT "%8.2" /end CHARACTERISTIC
/begin CHARACTERISTIC DFC_DisblMsk.DFC_MoXEMMHwLTTempSens_C "disable mask / Disable masks of check DFC_MoXEMMHwLTTempSens" VALUE 0x804EEB18 Val_Wu16 65535.00 DFES_OneToOne 0.00 65535.00 FORMAT "%8.2" /end CHARACTERISTIC
/begin CHARACTERISTIC DFC_DisblMsk.DFC_MoXEMMHwLTUCBCfg_C "disable mask / Disable masks of check DFC_MoXEMMHwLTUCBCfg" VALUE 0x804EEB1A Val_Wu16 65535.00 DFES_OneToOne 0.00 65535.00 FORMAT "%8.2" /end CHARACTERISTIC
/begin CHARACTERISTIC DFC_DisblMsk.DFC_OCWDAABEActv_C "disable mask / Disable masks of check DFC_OCWDAABEActv" VALUE 0x804EEB1C Val_Wu16 65535.00 DFES_OneToOne 0.00 65535.00 FORMAT "%8.2" /end CHARACTERISTIC
/begin CHARACTERISTIC DFC_DisblMsk.DFC_OCWDACom_C "disable mask / Disable masks of check DFC_OCWDACom" VALUE 0x804EEB1E Val_Wu16 65535.00 DFES_OneToOne 0.00 65535.00 FORMAT "%8.2" /end CHARACTERISTIC
/begin CHARACTERISTIC DFC_DisblMsk.DFC_OCWDAErrPin_C "disable mask / Disable masks of check DFC_OCWDAErrPin" VALUE 0x804EEB20 Val_Wu16 65535.00 DFES_OneToOne 0.00 65535.00 FORMAT "%8.2" /end CHARACTERISTIC
/begin CHARACTERISTIC DFC_DisblMsk.DFC_OCWDAOvrVltg_C "disable mask / Disable masks of check DFC_OCWDAOvrVltg" VALUE 0x804EEB22 Val_Wu16 65535.00 DFES_OneToOne 0.00 65535.00 FORMAT "%8.2" /end CHARACTERISTIC
/begin CHARACTERISTIC DFC_DisblMsk.DFC_ORAmax_C "disable mask / Disable masks of check DFC_ORAmax" VALUE 0x804EEB24 Val_Wu16 65535.00 DFES_OneToOne 0.00 65535.00 FORMAT "%8.2" /end CHARACTERISTIC
/begin CHARACTERISTIC DFC_DisblMsk.DFC_ORAmin_C "disable mask / Disable masks of check DFC_ORAmin" VALUE 0x804EEB26 Val_Wu16 65535.00 DFES_OneToOne 0.00 65535.00 FORMAT "%8.2" /end CHARACTERISTIC
/begin CHARACTERISTIC DFC_DisblMsk.DFC_PLLSUmax_C "disable mask / Disable masks of check DFC_PLLSUmax" VALUE 0x804EEB28 Val_Wu16 65535.00 DFES_OneToOne 0.00 65535.00 FORMAT "%8.2" /end CHARACTERISTIC
/begin CHARACTERISTIC DFC_DisblMsk.DFC_PLLSUmin_C "disable mask / Disable masks of check DFC_PLLSUmin" VALUE 0x804EEB2A Val_Wu16 65535.00 DFES_OneToOne 0.00 65535.00 FORMAT "%8.2" /end CHARACTERISTIC
/begin CHARACTERISTIC DFC_DisblMsk.DFC_PSR1max_C "disable mask / Disable masks of check DFC_PSR1max" VALUE 0x804EEB2C Val_Wu16 65535.00 DFES_OneToOne 0.00 65535.00 FORMAT "%8.2" /end CHARACTERISTIC
/begin CHARACTERISTIC DFC_DisblMsk.DFC_PSRBmax_C "disable mask / Disable masks of check DFC_PSRBmax" VALUE 0x804EEB2E Val_Wu16 65535.00 DFES_OneToOne 0.00 65535.00 FORMAT "%8.2" /end CHARACTERISTIC
/begin CHARACTERISTIC DFC_DisblMsk.DFC_PSRBmin_C "disable mask / Disable masks of check DFC_PSRBmin" VALUE 0x804EEB30 Val_Wu16 65535.00 DFES_OneToOne 0.00 65535.00 FORMAT "%8.2" /end CHARACTERISTIC
/begin CHARACTERISTIC DFC_DisblMsk.DFC_PSRPmax_C "disable mask / Disable masks of check DFC_PSRPmax" VALUE 0x804EEB32 Val_Wu16 65535.00 DFES_OneToOne 0.00 65535.00 FORMAT "%8.2" /end CHARACTERISTIC
/begin CHARACTERISTIC DFC_DisblMsk.DFC_PSRPmin_C "disable mask / Disable masks of check DFC_PSRPmin" VALUE 0x804EEB34 Val_Wu16 65535.00 DFES_OneToOne 0.00 65535.00 FORMAT "%8.2" /end CHARACTERISTIC
/begin CHARACTERISTIC DFC_DisblMsk.DFC_PSRPsig_C "disable mask / Disable masks of check DFC_PSRPsig" VALUE 0x804EEB36 Val_Wu16 65535.00 DFES_OneToOne 0.00 65535.00 FORMAT "%8.2" /end CHARACTERISTIC
/begin CHARACTERISTIC DFC_DisblMsk.DFC_PSRmax_C "disable mask / Disable masks of check DFC_PSRmax" VALUE 0x804EEB38 Val_Wu16 65535.00 DFES_OneToOne 0.00 65535.00 FORMAT "%8.2" /end CHARACTERISTIC
/begin CHARACTERISTIC DFC_DisblMsk.DFC_PUmax_C "disable mask / Disable masks of check DFC_PUmax" VALUE 0x804EEB3A Val_Wu16 65535.00 DFES_OneToOne 0.00 65535.00 FORMAT "%8.2" /end CHARACTERISTIC
/begin CHARACTERISTIC DFC_DisblMsk.DFC_P_VSE11_OL_C "disable mask / Disable masks of check DFC_P_VSE11_OL" VALUE 0x804EEB3C Val_Wu16 65535.00 DFES_OneToOne 0.00 65535.00 FORMAT "%8.2" /end CHARACTERISTIC
/begin CHARACTERISTIC DFC_DisblMsk.DFC_P_VSE11_SCB_C "disable mask / Disable masks of check DFC_P_VSE11_SCB" VALUE 0x804EEB3E Val_Wu16 65535.00 DFES_OneToOne 0.00 65535.00 FORMAT "%8.2" /end CHARACTERISTIC
/begin CHARACTERISTIC DFC_DisblMsk.DFC_P_VSE11_SCG_C "disable mask / Disable masks of check DFC_P_VSE11_SCG" VALUE 0x804EEB40 Val_Wu16 65535.00 DFES_OneToOne 0.00 65535.00 FORMAT "%8.2" /end CHARACTERISTIC
/begin CHARACTERISTIC DFC_DisblMsk.DFC_PhyHighAPP1_C "disable mask / Disable masks of check DFC_PhyHighAPP1" VALUE 0x804EEB42 Val_Wu16 65535.00 DFES_OneToOne 0.00 65535.00 FORMAT "%8.2" /end CHARACTERISTIC
/begin CHARACTERISTIC DFC_DisblMsk.DFC_PhyHighAPP2_C "disable mask / Disable masks of check DFC_PhyHighAPP2" VALUE 0x804EEB44 Val_Wu16 65535.00 DFES_OneToOne 0.00 65535.00 FORMAT "%8.2" /end CHARACTERISTIC
/begin CHARACTERISTIC DFC_DisblMsk.DFC_PhyLowAPP1_C "disable mask / Disable masks of check DFC_PhyLowAPP1" VALUE 0x804EEB46 Val_Wu16 65535.00 DFES_OneToOne 0.00 65535.00 FORMAT "%8.2" /end CHARACTERISTIC
/begin CHARACTERISTIC DFC_DisblMsk.DFC_PhyLowAPP2_C "disable mask / Disable masks of check DFC_PhyLowAPP2" VALUE 0x804EEB48 Val_Wu16 65535.00 DFES_OneToOne 0.00 65535.00 FORMAT "%8.2" /end CHARACTERISTIC
/begin CHARACTERISTIC DFC_DisblMsk.DFC_SRCHighAPP1_C "disable mask / Disable masks of check DFC_SRCHighAPP1" VALUE 0x804EEB4A Val_Wu16 65535.00 DFES_OneToOne 0.00 65535.00 FORMAT "%8.2" /end CHARACTERISTIC
/begin CHARACTERISTIC DFC_DisblMsk.DFC_SRCHighAPP2_C "disable mask / Disable masks of check DFC_SRCHighAPP2" VALUE 0x804EEB4C Val_Wu16 65535.00 DFES_OneToOne 0.00 65535.00 FORMAT "%8.2" /end CHARACTERISTIC
/begin CHARACTERISTIC DFC_DisblMsk.DFC_SRCLowAPP1_C "disable mask / Disable masks of check DFC_SRCLowAPP1" VALUE 0x804EEB4E Val_Wu16 65535.00 DFES_OneToOne 0.00 65535.00 FORMAT "%8.2" /end CHARACTERISTIC
/begin CHARACTERISTIC DFC_DisblMsk.DFC_SRCLowAPP2_C "disable mask / Disable masks of check DFC_SRCLowAPP2" VALUE 0x804EEB50 Val_Wu16 65535.00 DFES_OneToOne 0.00 65535.00 FORMAT "%8.2" /end CHARACTERISTIC
/begin CHARACTERISTIC DFC_DisblMsk.DFC_SSpMon2_C "disable mask / Disable masks of check DFC_SSpMon2" VALUE 0x804EEB52 Val_Wu16 65535.00 DFES_OneToOne 0.00 65535.00 FORMAT "%8.2" /end CHARACTERISTIC
/begin CHARACTERISTIC DFC_DisblMsk.DFC_SWReset_0_C "disable mask / Disable masks of check DFC_SWReset_0" VALUE 0x804EEB54 Val_Wu16 65535.00 DFES_OneToOne 0.00 65535.00 FORMAT "%8.2" /end CHARACTERISTIC
/begin CHARACTERISTIC DFC_DisblMsk.DFC_SWReset_1_C "disable mask / Disable masks of check DFC_SWReset_1" VALUE 0x804EEB56 Val_Wu16 65535.00 DFES_OneToOne 0.00 65535.00 FORMAT "%8.2" /end CHARACTERISTIC
/begin CHARACTERISTIC DFC_DisblMsk.DFC_SWReset_2_C "disable mask / Disable masks of check DFC_SWReset_2" VALUE 0x804EEB58 Val_Wu16 65535.00 DFES_OneToOne 0.00 65535.00 FORMAT "%8.2" /end CHARACTERISTIC
/begin CHARACTERISTIC DFC_DisblMsk.DFC_SyncAPP_C "disable mask / Disable masks of check DFC_SyncAPP" VALUE 0x804EEB5A Val_Wu16 65535.00 DFES_OneToOne 0.00 65535.00 FORMAT "%8.2" /end CHARACTERISTIC
/begin CHARACTERISTIC DFC_DisblMsk.DFC_TAmax_Dummy_C "disable mask / Disable masks of check DFC_TAmax_Dummy" VALUE 0x804EEB5C Val_Wu16 65535.00 DFES_OneToOne 0.00 65535.00 FORMAT "%8.2" /end CHARACTERISTIC
/begin CHARACTERISTIC DFC_DisblMsk.DFC_TKAEmax_C "disable mask / Disable masks of check DFC_TKAEmax" VALUE 0x804EEB5E Val_Wu16 65535.00 DFES_OneToOne 0.00 65535.00 FORMAT "%8.2" /end CHARACTERISTIC
/begin CHARACTERISTIC DFC_DisblMsk.DFC_TKAEmin_C "disable mask / Disable masks of check DFC_TKAEmin" VALUE 0x804EEB60 Val_Wu16 65535.00 DFES_OneToOne 0.00 65535.00 FORMAT "%8.2" /end CHARACTERISTIC
/begin CHARACTERISTIC DFC_DisblMsk.DFC_TKARmax_C "disable mask / Disable masks of check DFC_TKARmax" VALUE 0x804EEB62 Val_Wu16 65535.00 DFES_OneToOne 0.00 65535.00 FORMAT "%8.2" /end CHARACTERISTIC
/begin CHARACTERISTIC DFC_DisblMsk.DFC_TKARnpl_C "disable mask / Disable masks of check DFC_TKARnpl" VALUE 0x804EEB64 Val_Wu16 65535.00 DFES_OneToOne 0.00 65535.00 FORMAT "%8.2" /end CHARACTERISTIC
/begin CHARACTERISTIC DFC_DisblMsk.DFC_TMmax_Dummy_C "disable mask / Disable masks of check DFC_TMmax_Dummy" VALUE 0x804EEB66 Val_Wu16 65535.00 DFES_OneToOne 0.00 65535.00 FORMAT "%8.2" /end CHARACTERISTIC
/begin CHARACTERISTIC DFC_DisblMsk.DFC_TUMmax_Dummy_C "disable mask / Disable masks of check DFC_TUMmax_Dummy" VALUE 0x804EEB68 Val_Wu16 65535.00 DFES_OneToOne 0.00 65535.00 FORMAT "%8.2" /end CHARACTERISTIC
/begin CHARACTERISTIC DFC_DisblMsk.DFC_TWCDPriCatB1_C "disable mask / Disable masks of check DFC_TWCDPriCatB1" VALUE 0x804EEB6A Val_Wu16 65535.00 DFES_OneToOne 0.00 65535.00 FORMAT "%8.2" /end CHARACTERISTIC
/begin CHARACTERISTIC DFC_DisblMsk.DFC_ThrVlvClsdPosnFirstOffsLrnImpoB1_C "disable mask / Disable masks of check DFC_ThrVlvClsdPosnFirstOffsLrnImpoB1" VALUE 0x804EEB6C Val_Wu16 65535.00 DFES_OneToOne 0.00 65535.00 FORMAT "%8.2" /end CHARACTERISTIC
/begin CHARACTERISTIC DFC_DisblMsk.DFC_ThrVlvClsdPosnOffsLrnImpoB1_C "disable mask / Disable masks of check DFC_ThrVlvClsdPosnOffsLrnImpoB1" VALUE 0x804EEB6E Val_Wu16 65535.00 DFES_OneToOne 0.00 65535.00 FORMAT "%8.2" /end CHARACTERISTIC
/begin CHARACTERISTIC DFC_DisblMsk.DFC_ThrVlvClsdPosnOffsLrnMaxB1_C "disable mask / Disable masks of check DFC_ThrVlvClsdPosnOffsLrnMaxB1" VALUE 0x804EEB70 Val_Wu16 65535.00 DFES_OneToOne 0.00 65535.00 FORMAT "%8.2" /end CHARACTERISTIC
/begin CHARACTERISTIC DFC_DisblMsk.DFC_ThrVlvClsdPosnOffsLrnMinB1_C "disable mask / Disable masks of check DFC_ThrVlvClsdPosnOffsLrnMinB1" VALUE 0x804EEB72 Val_Wu16 65535.00 DFES_OneToOne 0.00 65535.00 FORMAT "%8.2" /end CHARACTERISTIC
/begin CHARACTERISTIC DFC_DisblMsk.DFC_ThrVlvCtrlDeB1_C "disable mask / Disable masks of check DFC_ThrVlvCtrlDeB1" VALUE 0x804EEB74 Val_Wu16 65535.00 DFES_OneToOne 0.00 65535.00 FORMAT "%8.2" /end CHARACTERISTIC
/begin CHARACTERISTIC DFC_DisblMsk.DFC_ThrVlvDycB1_C "disable mask / Disable masks of check DFC_ThrVlvDycB1" VALUE 0x804EEB76 Val_Wu16 65535.00 DFES_OneToOne 0.00 65535.00 FORMAT "%8.2" /end CHARACTERISTIC
/begin CHARACTERISTIC DFC_DisblMsk.DFC_ThrVlvLimpAirPosnMaxAbsltDriftB1_C "disable mask / Disable masks of check DFC_ThrVlvLimpAirPosnMaxAbsltDriftB1" VALUE 0x804EEB78 Val_Wu16 65535.00 DFES_OneToOne 0.00 65535.00 FORMAT "%8.2" /end CHARACTERISTIC
/begin CHARACTERISTIC DFC_DisblMsk.DFC_ThrVlvLimpAirPosnMaxB1_C "disable mask / Disable masks of check DFC_ThrVlvLimpAirPosnMaxB1" VALUE 0x804EEB7A Val_Wu16 65535.00 DFES_OneToOne 0.00 65535.00 FORMAT "%8.2" /end CHARACTERISTIC
/begin CHARACTERISTIC DFC_DisblMsk.DFC_ThrVlvLimpAirPosnMaxRelDriftB1_C "disable mask / Disable masks of check DFC_ThrVlvLimpAirPosnMaxRelDriftB1" VALUE 0x804EEB7C Val_Wu16 65535.00 DFES_OneToOne 0.00 65535.00 FORMAT "%8.2" /end CHARACTERISTIC
/begin CHARACTERISTIC DFC_DisblMsk.DFC_ThrVlvLimpAirPosnMinB1_C "disable mask / Disable masks of check DFC_ThrVlvLimpAirPosnMinB1" VALUE 0x804EEB7E Val_Wu16 65535.00 DFES_OneToOne 0.00 65535.00 FORMAT "%8.2" /end CHARACTERISTIC
/begin CHARACTERISTIC DFC_DisblMsk.DFC_ThrVlvOpenLoadB1_C "disable mask / Disable masks of check DFC_ThrVlvOpenLoadB1" VALUE 0x804EEB80 Val_Wu16 65535.00 DFES_OneToOne 0.00 65535.00 FORMAT "%8.2" /end CHARACTERISTIC
/begin CHARACTERISTIC DFC_DisblMsk.DFC_ThrVlvOpenSprgB1_C "disable mask / Disable masks of check DFC_ThrVlvOpenSprgB1" VALUE 0x804EEB82 Val_Wu16 65535.00 DFES_OneToOne 0.00 65535.00 FORMAT "%8.2" /end CHARACTERISTIC
/begin CHARACTERISTIC DFC_DisblMsk.DFC_ThrVlvOpenSprgSprdB1_C "disable mask / Disable masks of check DFC_ThrVlvOpenSprgSprdB1" VALUE 0x804EEB84 Val_Wu16 65535.00 DFES_OneToOne 0.00 65535.00 FORMAT "%8.2" /end CHARACTERISTIC
/begin CHARACTERISTIC DFC_DisblMsk.DFC_ThrVlvOpenSprgTwnB1_C "disable mask / Disable masks of check DFC_ThrVlvOpenSprgTwnB1" VALUE 0x804EEB86 Val_Wu16 65535.00 DFES_OneToOne 0.00 65535.00 FORMAT "%8.2" /end CHARACTERISTIC
/begin CHARACTERISTIC DFC_DisblMsk.DFC_ThrVlvOverTB1_C "disable mask / Disable masks of check DFC_ThrVlvOverTB1" VALUE 0x804EEB88 Val_Wu16 65535.00 DFES_OneToOne 0.00 65535.00 FORMAT "%8.2" /end CHARACTERISTIC
/begin CHARACTERISTIC DFC_DisblMsk.DFC_ThrVlvRetSprgB1_C "disable mask / Disable masks of check DFC_ThrVlvRetSprgB1" VALUE 0x804EEB8A Val_Wu16 65535.00 DFES_OneToOne 0.00 65535.00 FORMAT "%8.2" /end CHARACTERISTIC
/begin CHARACTERISTIC DFC_DisblMsk.DFC_ThrVlvRetSprgSprdB1_C "disable mask / Disable masks of check DFC_ThrVlvRetSprgSprdB1" VALUE 0x804EEB8C Val_Wu16 65535.00 DFES_OneToOne 0.00 65535.00 FORMAT "%8.2" /end CHARACTERISTIC
/begin CHARACTERISTIC DFC_DisblMsk.DFC_ThrVlvRetSprgTwnB1_C "disable mask / Disable masks of check DFC_ThrVlvRetSprgTwnB1" VALUE 0x804EEB8E Val_Wu16 65535.00 DFES_OneToOne 0.00 65535.00 FORMAT "%8.2" /end CHARACTERISTIC
/begin CHARACTERISTIC DFC_DisblMsk.DFC_ThrVlvSens1MaxB1_C "disable mask / Disable masks of check DFC_ThrVlvSens1MaxB1" VALUE 0x804EEB90 Val_Wu16 65535.00 DFES_OneToOne 0.00 65535.00 FORMAT "%8.2" /end CHARACTERISTIC
/begin CHARACTERISTIC DFC_DisblMsk.DFC_ThrVlvSens1NplB1_C "disable mask / Disable masks of check DFC_ThrVlvSens1NplB1" VALUE 0x804EEB92 Val_Wu16 65535.00 DFES_OneToOne 0.00 65535.00 FORMAT "%8.2" /end CHARACTERISTIC
/begin CHARACTERISTIC DFC_DisblMsk.DFC_ThrVlvSens2MaxB1_C "disable mask / Disable masks of check DFC_ThrVlvSens2MaxB1" VALUE 0x804EEB94 Val_Wu16 65535.00 DFES_OneToOne 0.00 65535.00 FORMAT "%8.2" /end CHARACTERISTIC
/begin CHARACTERISTIC DFC_DisblMsk.DFC_ThrVlvSens2MinB1_C "disable mask / Disable masks of check DFC_ThrVlvSens2MinB1" VALUE 0x804EEB96 Val_Wu16 65535.00 DFES_OneToOne 0.00 65535.00 FORMAT "%8.2" /end CHARACTERISTIC
/begin CHARACTERISTIC DFC_DisblMsk.DFC_ThrVlvSens2NplB1_C "disable mask / Disable masks of check DFC_ThrVlvSens2NplB1" VALUE 0x804EEB98 Val_Wu16 65535.00 DFES_OneToOne 0.00 65535.00 FORMAT "%8.2" /end CHARACTERISTIC
/begin CHARACTERISTIC DFC_DisblMsk.DFC_ThrVlvShoCircB1_C "disable mask / Disable masks of check DFC_ThrVlvShoCircB1" VALUE 0x804EEB9A Val_Wu16 65535.00 DFES_OneToOne 0.00 65535.00 FORMAT "%8.2" /end CHARACTERISTIC
/begin CHARACTERISTIC DFC_DisblMsk.DFC_ThrVlvSpiErrB1_C "disable mask / Disable masks of check DFC_ThrVlvSpiErrB1" VALUE 0x804EEB9C Val_Wu16 65535.00 DFES_OneToOne 0.00 65535.00 FORMAT "%8.2" /end CHARACTERISTIC
/begin CHARACTERISTIC DFC_DisblMsk.DFC_ThrvlvSens1MinB1_C "disable mask / Disable masks of check DFC_ThrvlvSens1MinB1" VALUE 0x804EEB9E Val_Wu16 65535.00 DFES_OneToOne 0.00 65535.00 FORMAT "%8.2" /end CHARACTERISTIC
/begin CHARACTERISTIC DFC_DisblMsk.DFC_TiOffTBasdChkFast_C "disable mask / Disable masks of check DFC_TiOffTBasdChkFast" VALUE 0x804EEBA0 Val_Wu16 65535.00 DFES_OneToOne 0.00 65535.00 FORMAT "%8.2" /end CHARACTERISTIC
/begin CHARACTERISTIC DFC_DisblMsk.DFC_TiOffTBasdChkSlow_C "disable mask / Disable masks of check DFC_TiOffTBasdChkSlow" VALUE 0x804EEBA2 Val_Wu16 65535.00 DFES_OneToOne 0.00 65535.00 FORMAT "%8.2" /end CHARACTERISTIC
/begin CHARACTERISTIC DFC_DisblMsk.DFC_UEGOHeatrCtlS1B1_C "disable mask / Disable masks of check DFC_UEGOHeatrCtlS1B1" VALUE 0x804EEBA4 Val_Wu16 65535.00 DFES_OneToOne 0.00 65535.00 FORMAT "%8.2" /end CHARACTERISTIC
/begin CHARACTERISTIC DFC_DisblMsk.DFC_UEGOSnsrMntdS1B1_C "disable mask / Disable masks of check DFC_UEGOSnsrMntdS1B1" VALUE 0x804EEBA6 Val_Wu16 65535.00 DFES_OneToOne 0.00 65535.00 FORMAT "%8.2" /end CHARACTERISTIC
/begin CHARACTERISTIC DFC_DisblMsk.DFC_VehVSig_C "disable mask / Disable masks of check DFC_VehVSig" VALUE 0x804EEBA8 Val_Wu16 65535.00 DFES_OneToOne 0.00 65535.00 FORMAT "%8.2" /end CHARACTERISTIC
/begin CHARACTERISTIC DFC_DisblMsk.DFC_VlvLftFbSwtIntk11SpclFail_C "disable mask / Disable masks of check DFC_VlvLftFbSwtIntk11SpclFail" VALUE 0x804EEBAA Val_Wu16 65535.00 DFES_OneToOne 0.00 65535.00 FORMAT "%8.2" /end CHARACTERISTIC
/begin CHARACTERISTIC DFC_DisblMsk.DFC_VlvLftFbSwtIntk11StdFail_C "disable mask / Disable masks of check DFC_VlvLftFbSwtIntk11StdFail" VALUE 0x804EEBAC Val_Wu16 65535.00 DFES_OneToOne 0.00 65535.00 FORMAT "%8.2" /end CHARACTERISTIC
/begin CHARACTERISTIC DFC_DtcFuncUnit_C "AUTOSAR: Functional unit of DTC of all events" VALUE 0x804D9128 Val_Wu8 255.0 OneToOne 0.00 255.0 FORMAT "%5.1" /end CHARACTERISTIC
/begin CHARACTERISTIC DFC_DtcGroup_C "AUTOSAR: Matching DTC group of all events" VALUE 0x804D9129 Val_Wu8 16.0000000000 Dem_DTCGroup_Verb 0.00 16.0000000000 FORMAT "%13.10" /end CHARACTERISTIC
/begin CHARACTERISTIC DFC_DtcSeverity_C "AUTOSAR: DTC severity class of all events" VALUE 0x804D912A Val_Wu8 128.000000000 Dem_DTCSeverity_Verb 0.00 128.000000000 FORMAT "%13.9" /end CHARACTERISTIC
/begin CHARACTERISTIC DFES_Cls.DFC_Unused_C "fault class per DFC / " VALUE 0x804D912C Val_Wu8 30.00 DFES_OneToOne 0.00 30.00 FORMAT "%5.2" EXTENDED_LIMITS 0.00 255.0 READ_ONLY /end CHARACTERISTIC
/begin CHARACTERISTIC DFES_Cls.DFC_AltIOACGFailr_C "fault class per DFC / Fault class for check DFC_AltIOACGFailr" VALUE 0x804D912D Val_Wu8 30.00 DFES_OneToOne 0.00 30.00 FORMAT "%5.2" EXTENDED_LIMITS 0.00 255.0 /end CHARACTERISTIC
/begin CHARACTERISTIC DFES_Cls.DFC_AltIOACGHiVltg_C "fault class per DFC / Fault class for check DFC_AltIOACGHiVltg" VALUE 0x804D912E Val_Wu8 30.00 DFES_OneToOne 0.00 30.00 FORMAT "%5.2" EXTENDED_LIMITS 0.00 255.0 /end CHARACTERISTIC
/begin CHARACTERISTIC DFES_Cls.DFC_AltIOACGLoVltg_C "fault class per DFC / Fault class for check DFC_AltIOACGLoVltg" VALUE 0x804D912F Val_Wu8 30.00 DFES_OneToOne 0.00 30.00 FORMAT "%5.2" EXTENDED_LIMITS 0.00 255.0 /end CHARACTERISTIC
/begin CHARACTERISTIC DFES_Cls.DFC_AltIOACGTHi_C "fault class per DFC / Fault class for check DFC_AltIOACGTHi" VALUE 0x804D9130 Val_Wu8 30.00 DFES_OneToOne 0.00 30.00 FORMAT "%5.2" EXTENDED_LIMITS 0.00 255.0 /end CHARACTERISTIC
/begin CHARACTERISTIC DFES_Cls.DFC_AltIODConnACG_C "fault class per DFC / Fault class for check DFC_AltIODConnACG" VALUE 0x804D9131 Val_Wu8 30.00 DFES_OneToOne 0.00 30.00 FORMAT "%5.2" EXTENDED_LIMITS 0.00 255.0 /end CHARACTERISTIC
/begin CHARACTERISTIC DFES_Cls.DFC_BattUHiFailr_C "fault class per DFC / Fault class for check DFC_BattUHiFailr" VALUE 0x804D9132 Val_Wu8 30.00 DFES_OneToOne 0.00 30.00 FORMAT "%5.2" EXTENDED_LIMITS 0.00 255.0 /end CHARACTERISTIC
/begin CHARACTERISTIC DFES_Cls.DFC_BattULoFailr_C "fault class per DFC / Fault class for check DFC_BattULoFailr" VALUE 0x804D9133 Val_Wu8 30.00 DFES_OneToOne 0.00 30.00 FORMAT "%5.2" EXTENDED_LIMITS 0.00 255.0 /end CHARACTERISTIC
/begin CHARACTERISTIC DFES_Cls.DFC_BrkBstPDriftHiErr_C "fault class per DFC / Fault class for check DFC_BrkBstPDriftHiErr" VALUE 0x804D9134 Val_Wu8 30.00 DFES_OneToOne 0.00 30.00 FORMAT "%5.2" EXTENDED_LIMITS 0.00 255.0 /end CHARACTERISTIC
/begin CHARACTERISTIC DFES_Cls.DFC_BrkBstPDriftLoErr_C "fault class per DFC / Fault class for check DFC_BrkBstPDriftLoErr" VALUE 0x804D9135 Val_Wu8 30.00 DFES_OneToOne 0.00 30.00 FORMAT "%5.2" EXTENDED_LIMITS 0.00 255.0 /end CHARACTERISTIC
/begin CHARACTERISTIC DFES_Cls.DFC_BrkBstPSnsrStuck_C "fault class per DFC / Fault class for check DFC_BrkBstPSnsrStuck" VALUE 0x804D9136 Val_Wu8 30.00 DFES_OneToOne 0.00 30.00 FORMAT "%5.2" EXTENDED_LIMITS 0.00 255.0 /end CHARACTERISTIC
/begin CHARACTERISTIC DFES_Cls.DFC_BrkMnSwtContOn_C "fault class per DFC / Fault class for check DFC_BrkMnSwtContOn" VALUE 0x804D9137 Val_Wu8 30.00 DFES_OneToOne 0.00 30.00 FORMAT "%5.2" EXTENDED_LIMITS 0.00 255.0 /end CHARACTERISTIC
/begin CHARACTERISTIC DFES_Cls.DFC_BrkMnSwtNotStp_C "fault class per DFC / Fault class for check DFC_BrkMnSwtNotStp" VALUE 0x804D9138 Val_Wu8 30.00 DFES_OneToOne 0.00 30.00 FORMAT "%5.2" EXTENDED_LIMITS 0.00 255.0 /end CHARACTERISTIC
/begin CHARACTERISTIC DFES_Cls.DFC_BrkNpl_C "fault class per DFC / Fault class for check DFC_BrkNpl" VALUE 0x804D9139 Val_Wu8 30.00 DFES_OneToOne 0.00 30.00 FORMAT "%5.2" EXTENDED_LIMITS 0.00 255.0 /end CHARACTERISTIC
/begin CHARACTERISTIC DFES_Cls.DFC_BrkRdntSwtContOn_C "fault class per DFC / Fault class for check DFC_BrkRdntSwtContOn" VALUE 0x804D913A Val_Wu8 30.00 DFES_OneToOne 0.00 30.00 FORMAT "%5.2" EXTENDED_LIMITS 0.00 255.0 /end CHARACTERISTIC
/begin CHARACTERISTIC DFES_Cls.DFC_BrkRdntSwtNotStp_C "fault class per DFC / Fault class for check DFC_BrkRdntSwtNotStp" VALUE 0x804D913B Val_Wu8 30.00 DFES_OneToOne 0.00 30.00 FORMAT "%5.2" EXTENDED_LIMITS 0.00 255.0 /end CHARACTERISTIC
/begin CHARACTERISTIC DFES_Cls.DFC_Clth3ONStuck_C "fault class per DFC / Fault class for check DFC_Clth3ONStuck" VALUE 0x804D913C Val_Wu8 30.00 DFES_OneToOne 0.00 30.00 FORMAT "%5.2" EXTENDED_LIMITS 0.00 255.0 /end CHARACTERISTIC
/begin CHARACTERISTIC DFES_Cls.DFC_Clth4OFFStuck_C "fault class per DFC / Fault class for check DFC_Clth4OFFStuck" VALUE 0x804D913D Val_Wu8 30.00 DFES_OneToOne 0.00 30.00 FORMAT "%5.2" EXTENDED_LIMITS 0.00 255.0 /end CHARACTERISTIC
/begin CHARACTERISTIC DFES_Cls.DFC_ClthOFFStuck_C "fault class per DFC / Fault class for check DFC_ClthOFFStuck" VALUE 0x804D913E Val_Wu8 30.00 DFES_OneToOne 0.00 30.00 FORMAT "%5.2" EXTENDED_LIMITS 0.00 255.0 /end CHARACTERISTIC
/begin CHARACTERISTIC DFES_Cls.DFC_ClthONStuck_C "fault class per DFC / Fault class for check DFC_ClthONStuck" VALUE 0x804D913F Val_Wu8 30.00 DFES_OneToOne 0.00 30.00 FORMAT "%5.2" EXTENDED_LIMITS 0.00 255.0 /end CHARACTERISTIC
/begin CHARACTERISTIC DFES_Cls.DFC_ClthStkFailInfo_C "fault class per DFC / Fault class for check DFC_ClthStkFailInfo" VALUE 0x804D9140 Val_Wu8 30.00 DFES_OneToOne 0.00 30.00 FORMAT "%5.2" EXTENDED_LIMITS 0.00 255.0 /end CHARACTERISTIC
/begin CHARACTERISTIC DFES_Cls.DFC_ComACFailInfo_C "fault class per DFC / Fault class for check DFC_ComACFailInfo" VALUE 0x804D9141 Val_Wu8 30.00 DFES_OneToOne 0.00 30.00 FORMAT "%5.2" EXTENDED_LIMITS 0.00 255.0 /end CHARACTERISTIC
/begin CHARACTERISTIC DFES_Cls.DFC_ComATFTValErr_C "fault class per DFC / Fault class for check DFC_ComATFTValErr" VALUE 0x804D9142 Val_Wu8 30.00 DFES_OneToOne 0.00 30.00 FORMAT "%5.2" EXTENDED_LIMITS 0.00 255.0 /end CHARACTERISTIC
/begin CHARACTERISTIC DFES_Cls.DFC_ComATMILReq_C "fault class per DFC / Fault class for check DFC_ComATMILReq" VALUE 0x804D9143 Val_Wu8 30.00 DFES_OneToOne 0.00 30.00 FORMAT "%5.2" EXTENDED_LIMITS 0.00 255.0 /end CHARACTERISTIC
/begin CHARACTERISTIC DFES_Cls.DFC_ComAYCAChksum_C "fault class per DFC / Fault class for check DFC_ComAYCAChksum" VALUE 0x804D9144 Val_Wu8 30.00 DFES_OneToOne 0.00 30.00 FORMAT "%5.2" EXTENDED_LIMITS 0.00 255.0 /end CHARACTERISTIC
/begin CHARACTERISTIC DFES_Cls.DFC_ComAYCARingCnt_C "fault class per DFC / Fault class for check DFC_ComAYCARingCnt" VALUE 0x804D9145 Val_Wu8 30.00 DFES_OneToOne 0.00 30.00 FORMAT "%5.2" EXTENDED_LIMITS 0.00 255.0 /end CHARACTERISTIC
/begin CHARACTERISTIC DFES_Cls.DFC_ComAYCATOut_C "fault class per DFC / Fault class for check DFC_ComAYCATOut" VALUE 0x804D9146 Val_Wu8 30.00 DFES_OneToOne 0.00 30.00 FORMAT "%5.2" EXTENDED_LIMITS 0.00 255.0 /end CHARACTERISTIC
/begin CHARACTERISTIC DFES_Cls.DFC_ComAYCDChkSum_C "fault class per DFC / Fault class for check DFC_ComAYCDChkSum" VALUE 0x804D9147 Val_Wu8 30.00 DFES_OneToOne 0.00 30.00 FORMAT "%5.2" EXTENDED_LIMITS 0.00 255.0 /end CHARACTERISTIC
/begin CHARACTERISTIC DFES_Cls.DFC_ComAYCDTOut_C "fault class per DFC / Fault class for check DFC_ComAYCDTOut" VALUE 0x804D9148 Val_Wu8 30.00 DFES_OneToOne 0.00 30.00 FORMAT "%5.2" EXTENDED_LIMITS 0.00 255.0 /end CHARACTERISTIC
/begin CHARACTERISTIC DFES_Cls.DFC_ComAYCFChksum_C "fault class per DFC / Fault class for check DFC_ComAYCFChksum" VALUE 0x804D9149 Val_Wu8 30.00 DFES_OneToOne 0.00 30.00 FORMAT "%5.2" EXTENDED_LIMITS 0.00 255.0 /end CHARACTERISTIC
/begin CHARACTERISTIC DFES_Cls.DFC_ComAYCFRingCnt_C "fault class per DFC / Fault class for check DFC_ComAYCFRingCnt" VALUE 0x804D914A Val_Wu8 30.00 DFES_OneToOne 0.00 30.00 FORMAT "%5.2" EXTENDED_LIMITS 0.00 255.0 /end CHARACTERISTIC
/begin CHARACTERISTIC DFES_Cls.DFC_ComAYCFTOut_C "fault class per DFC / Fault class for check DFC_ComAYCFTOut" VALUE 0x804D914B Val_Wu8 30.00 DFES_OneToOne 0.00 30.00 FORMAT "%5.2" EXTENDED_LIMITS 0.00 255.0 /end CHARACTERISTIC
/begin CHARACTERISTIC DFES_Cls.DFC_ComAYCGChksum_C "fault class per DFC / Fault class for check DFC_ComAYCGChksum" VALUE 0x804D914C Val_Wu8 30.00 DFES_OneToOne 0.00 30.00 FORMAT "%5.2" EXTENDED_LIMITS 0.00 255.0 /end CHARACTERISTIC
/begin CHARACTERISTIC DFES_Cls.DFC_ComAYCGRingCnt_C "fault class per DFC / Fault class for check DFC_ComAYCGRingCnt" VALUE 0x804D914D Val_Wu8 30.00 DFES_OneToOne 0.00 30.00 FORMAT "%5.2" EXTENDED_LIMITS 0.00 255.0 /end CHARACTERISTIC
/begin CHARACTERISTIC DFES_Cls.DFC_ComAYCGTOut_C "fault class per DFC / Fault class for check DFC_ComAYCGTOut" VALUE 0x804D914E Val_Wu8 30.00 DFES_OneToOne 0.00 30.00 FORMAT "%5.2" EXTENDED_LIMITS 0.00 255.0 /end CHARACTERISTIC
/begin CHARACTERISTIC DFES_Cls.DFC_ComAYCIChkSum_C "fault class per DFC / Fault class for check DFC_ComAYCIChkSum" VALUE 0x804D914F Val_Wu8 30.00 DFES_OneToOne 0.00 30.00 FORMAT "%5.2" EXTENDED_LIMITS 0.00 255.0 /end CHARACTERISTIC
/begin CHARACTERISTIC DFES_Cls.DFC_ComAYCIRingCnt_C "fault class per DFC / Fault class for check DFC_ComAYCIRingCnt" VALUE 0x804D9150 Val_Wu8 30.00 DFES_OneToOne 0.00 30.00 FORMAT "%5.2" EXTENDED_LIMITS 0.00 255.0 /end CHARACTERISTIC
/begin CHARACTERISTIC DFES_Cls.DFC_ComAYCITOut_C "fault class per DFC / Fault class for check DFC_ComAYCITOut" VALUE 0x804D9151 Val_Wu8 30.00 DFES_OneToOne 0.00 30.00 FORMAT "%5.2" EXTENDED_LIMITS 0.00 255.0 /end CHARACTERISTIC
/begin CHARACTERISTIC DFES_Cls.DFC_ComBCM1ChkSum_C "fault class per DFC / Fault class for check DFC_ComBCM1ChkSum" VALUE 0x804D9152 Val_Wu8 30.00 DFES_OneToOne 0.00 30.00 FORMAT "%5.2" EXTENDED_LIMITS 0.00 255.0 /end CHARACTERISTIC
/begin CHARACTERISTIC DFES_Cls.DFC_ComBCM1RingCnt_C "fault class per DFC / Fault class for check DFC_ComBCM1RingCnt" VALUE 0x804D9153 Val_Wu8 30.00 DFES_OneToOne 0.00 30.00 FORMAT "%5.2" EXTENDED_LIMITS 0.00 255.0 /end CHARACTERISTIC
/begin CHARACTERISTIC DFES_Cls.DFC_ComBCM1TOut_C "fault class per DFC / Fault class for check DFC_ComBCM1TOut" VALUE 0x804D9154 Val_Wu8 30.00 DFES_OneToOne 0.00 30.00 FORMAT "%5.2" EXTENDED_LIMITS 0.00 255.0 /end CHARACTERISTIC
/begin CHARACTERISTIC DFES_Cls.DFC_ComCANABusOffErr_C "fault class per DFC / Fault class for check DFC_ComCANABusOffErr" VALUE 0x804D9155 Val_Wu8 30.00 DFES_OneToOne 0.00 30.00 FORMAT "%5.2" EXTENDED_LIMITS 0.00 255.0 /end CHARACTERISTIC
/begin CHARACTERISTIC DFES_Cls.DFC_ComCANBBusOffErr_C "fault class per DFC / Fault class for check DFC_ComCANBBusOffErr" VALUE 0x804D9156 Val_Wu8 30.00 DFES_OneToOne 0.00 30.00 FORMAT "%5.2" EXTENDED_LIMITS 0.00 255.0 /end CHARACTERISTIC
/begin CHARACTERISTIC DFES_Cls.DFC_ComCANCBusOffErr_C "fault class per DFC / Fault class for check DFC_ComCANCBusOffErr" VALUE 0x804D9157 Val_Wu8 30.00 DFES_OneToOne 0.00 30.00 FORMAT "%5.2" EXTENDED_LIMITS 0.00 255.0 /end CHARACTERISTIC
/begin CHARACTERISTIC DFES_Cls.DFC_ComCGW1ChkSum_C "fault class per DFC / Fault class for check DFC_ComCGW1ChkSum" VALUE 0x804D9158 Val_Wu8 30.00 DFES_OneToOne 0.00 30.00 FORMAT "%5.2" EXTENDED_LIMITS 0.00 255.0 /end CHARACTERISTIC
/begin CHARACTERISTIC DFES_Cls.DFC_ComCGW1RingCnt_C "fault class per DFC / Fault class for check DFC_ComCGW1RingCnt" VALUE 0x804D9159 Val_Wu8 30.00 DFES_OneToOne 0.00 30.00 FORMAT "%5.2" EXTENDED_LIMITS 0.00 255.0 /end CHARACTERISTIC
/begin CHARACTERISTIC DFES_Cls.DFC_ComCGW1TOut_C "fault class per DFC / Fault class for check DFC_ComCGW1TOut" VALUE 0x804D915A Val_Wu8 30.00 DFES_OneToOne 0.00 30.00 FORMAT "%5.2" EXTENDED_LIMITS 0.00 255.0 /end CHARACTERISTIC
/begin CHARACTERISTIC DFES_Cls.DFC_ComConvBoostErr_C "fault class per DFC / Fault class for check DFC_ComConvBoostErr" VALUE 0x804D915B Val_Wu8 30.00 DFES_OneToOne 0.00 30.00 FORMAT "%5.2" EXTENDED_LIMITS 0.00 255.0 /end CHARACTERISTIC
/begin CHARACTERISTIC DFES_Cls.DFC_ComConvSlipErr_C "fault class per DFC / Fault class for check DFC_ComConvSlipErr" VALUE 0x804D915C Val_Wu8 30.00 DFES_OneToOne 0.00 30.00 FORMAT "%5.2" EXTENDED_LIMITS 0.00 255.0 /end CHARACTERISTIC
/begin CHARACTERISTIC DFES_Cls.DFC_ComEAT10Chksum_C "fault class per DFC / Fault class for check DFC_ComEAT10Chksum" VALUE 0x804D915D Val_Wu8 30.00 DFES_OneToOne 0.00 30.00 FORMAT "%5.2" EXTENDED_LIMITS 0.00 255.0 /end CHARACTERISTIC
/begin CHARACTERISTIC DFES_Cls.DFC_ComEAT10RingCnt_C "fault class per DFC / Fault class for check DFC_ComEAT10RingCnt" VALUE 0x804D915E Val_Wu8 30.00 DFES_OneToOne 0.00 30.00 FORMAT "%5.2" EXTENDED_LIMITS 0.00 255.0 /end CHARACTERISTIC
/begin CHARACTERISTIC DFES_Cls.DFC_ComEAT10TOut_C "fault class per DFC / Fault class for check DFC_ComEAT10TOut" VALUE 0x804D915F Val_Wu8 30.00 DFES_OneToOne 0.00 30.00 FORMAT "%5.2" EXTENDED_LIMITS 0.00 255.0 /end CHARACTERISTIC
/begin CHARACTERISTIC DFES_Cls.DFC_ComEAT11ChkSum_C "fault class per DFC / Fault class for check DFC_ComEAT11ChkSum" VALUE 0x804D9160 Val_Wu8 30.00 DFES_OneToOne 0.00 30.00 FORMAT "%5.2" EXTENDED_LIMITS 0.00 255.0 /end CHARACTERISTIC
/begin CHARACTERISTIC DFES_Cls.DFC_ComEAT11RingCnt_C "fault class per DFC / Fault class for check DFC_ComEAT11RingCnt" VALUE 0x804D9161 Val_Wu8 30.00 DFES_OneToOne 0.00 30.00 FORMAT "%5.2" EXTENDED_LIMITS 0.00 255.0 /end CHARACTERISTIC
/begin CHARACTERISTIC DFES_Cls.DFC_ComEAT11TOut_C "fault class per DFC / Fault class for check DFC_ComEAT11TOut" VALUE 0x804D9162 Val_Wu8 30.00 DFES_OneToOne 0.00 30.00 FORMAT "%5.2" EXTENDED_LIMITS 0.00 255.0 /end CHARACTERISTIC
/begin CHARACTERISTIC DFES_Cls.DFC_ComEAT12ChkSum_C "fault class per DFC / Fault class for check DFC_ComEAT12ChkSum" VALUE 0x804D9163 Val_Wu8 30.00 DFES_OneToOne 0.00 30.00 FORMAT "%5.2" EXTENDED_LIMITS 0.00 255.0 /end CHARACTERISTIC
/begin CHARACTERISTIC DFES_Cls.DFC_ComEAT12RingCnt_C "fault class per DFC / Fault class for check DFC_ComEAT12RingCnt" VALUE 0x804D9164 Val_Wu8 30.00 DFES_OneToOne 0.00 30.00 FORMAT "%5.2" EXTENDED_LIMITS 0.00 255.0 /end CHARACTERISTIC
/begin CHARACTERISTIC DFES_Cls.DFC_ComEAT12TOut_C "fault class per DFC / Fault class for check DFC_ComEAT12TOut" VALUE 0x804D9165 Val_Wu8 30.00 DFES_OneToOne 0.00 30.00 FORMAT "%5.2" EXTENDED_LIMITS 0.00 255.0 /end CHARACTERISTIC
/begin CHARACTERISTIC DFES_Cls.DFC_ComEAT13ChkSum_C "fault class per DFC / Fault class for check DFC_ComEAT13ChkSum" VALUE 0x804D9166 Val_Wu8 30.00 DFES_OneToOne 0.00 30.00 FORMAT "%5.2" EXTENDED_LIMITS 0.00 255.0 /end CHARACTERISTIC
/begin CHARACTERISTIC DFES_Cls.DFC_ComEAT13RingCnt_C "fault class per DFC / Fault class for check DFC_ComEAT13RingCnt" VALUE 0x804D9167 Val_Wu8 30.00 DFES_OneToOne 0.00 30.00 FORMAT "%5.2" EXTENDED_LIMITS 0.00 255.0 /end CHARACTERISTIC
/begin CHARACTERISTIC DFES_Cls.DFC_ComEAT13TOut_C "fault class per DFC / Fault class for check DFC_ComEAT13TOut" VALUE 0x804D9168 Val_Wu8 30.00 DFES_OneToOne 0.00 30.00 FORMAT "%5.2" EXTENDED_LIMITS 0.00 255.0 /end CHARACTERISTIC
/begin CHARACTERISTIC DFES_Cls.DFC_ComEAT1Chksum_C "fault class per DFC / Fault class for check DFC_ComEAT1Chksum" VALUE 0x804D9169 Val_Wu8 30.00 DFES_OneToOne 0.00 30.00 FORMAT "%5.2" EXTENDED_LIMITS 0.00 255.0 /end CHARACTERISTIC
/begin CHARACTERISTIC DFES_Cls.DFC_ComEAT1RingCnt_C "fault class per DFC / Fault class for check DFC_ComEAT1RingCnt" VALUE 0x804D916A Val_Wu8 30.00 DFES_OneToOne 0.00 30.00 FORMAT "%5.2" EXTENDED_LIMITS 0.00 255.0 /end CHARACTERISTIC
/begin CHARACTERISTIC DFES_Cls.DFC_ComEAT1TOut_C "fault class per DFC / Fault class for check DFC_ComEAT1TOut" VALUE 0x804D916B Val_Wu8 30.00 DFES_OneToOne 0.00 30.00 FORMAT "%5.2" EXTENDED_LIMITS 0.00 255.0 /end CHARACTERISTIC
/begin CHARACTERISTIC DFES_Cls.DFC_ComEAT2ChkSum_C "fault class per DFC / Fault class for check DFC_ComEAT2ChkSum" VALUE 0x804D916C Val_Wu8 30.00 DFES_OneToOne 0.00 30.00 FORMAT "%5.2" EXTENDED_LIMITS 0.00 255.0 /end CHARACTERISTIC
/begin CHARACTERISTIC DFES_Cls.DFC_ComEAT2RingCnt_C "fault class per DFC / Fault class for check DFC_ComEAT2RingCnt" VALUE 0x804D916D Val_Wu8 30.00 DFES_OneToOne 0.00 30.00 FORMAT "%5.2" EXTENDED_LIMITS 0.00 255.0 /end CHARACTERISTIC
/begin CHARACTERISTIC DFES_Cls.DFC_ComEAT2TOut_C "fault class per DFC / Fault class for check DFC_ComEAT2TOut" VALUE 0x804D916E Val_Wu8 30.00 DFES_OneToOne 0.00 30.00 FORMAT "%5.2" EXTENDED_LIMITS 0.00 255.0 /end CHARACTERISTIC
/begin CHARACTERISTIC DFES_Cls.DFC_ComEAT4ChkSum_C "fault class per DFC / Fault class for check DFC_ComEAT4ChkSum" VALUE 0x804D916F Val_Wu8 30.00 DFES_OneToOne 0.00 30.00 FORMAT "%5.2" EXTENDED_LIMITS 0.00 255.0 /end CHARACTERISTIC
/begin CHARACTERISTIC DFES_Cls.DFC_ComEAT4RingCnt_C "fault class per DFC / Fault class for check DFC_ComEAT4RingCnt" VALUE 0x804D9170 Val_Wu8 30.00 DFES_OneToOne 0.00 30.00 FORMAT "%5.2" EXTENDED_LIMITS 0.00 255.0 /end CHARACTERISTIC
/begin CHARACTERISTIC DFES_Cls.DFC_ComEAT4TOut_C "fault class per DFC / Fault class for check DFC_ComEAT4TOut" VALUE 0x804D9171 Val_Wu8 30.00 DFES_OneToOne 0.00 30.00 FORMAT "%5.2" EXTENDED_LIMITS 0.00 255.0 /end CHARACTERISTIC
/begin CHARACTERISTIC DFES_Cls.DFC_ComEAT6Chksum_C "fault class per DFC / Fault class for check DFC_ComEAT6Chksum" VALUE 0x804D9172 Val_Wu8 30.00 DFES_OneToOne 0.00 30.00 FORMAT "%5.2" EXTENDED_LIMITS 0.00 255.0 /end CHARACTERISTIC
/begin CHARACTERISTIC DFES_Cls.DFC_ComEAT6RingCnt_C "fault class per DFC / Fault class for check DFC_ComEAT6RingCnt" VALUE 0x804D9173 Val_Wu8 30.00 DFES_OneToOne 0.00 30.00 FORMAT "%5.2" EXTENDED_LIMITS 0.00 255.0 /end CHARACTERISTIC
/begin CHARACTERISTIC DFES_Cls.DFC_ComEAT6TOut_C "fault class per DFC / Fault class for check DFC_ComEAT6TOut" VALUE 0x804D9174 Val_Wu8 30.00 DFES_OneToOne 0.00 30.00 FORMAT "%5.2" EXTENDED_LIMITS 0.00 255.0 /end CHARACTERISTIC
/begin CHARACTERISTIC DFES_Cls.DFC_ComEAT7Chksum_C "fault class per DFC / Fault class for check DFC_ComEAT7Chksum" VALUE 0x804D9175 Val_Wu8 30.00 DFES_OneToOne 0.00 30.00 FORMAT "%5.2" EXTENDED_LIMITS 0.00 255.0 /end CHARACTERISTIC
/begin CHARACTERISTIC DFES_Cls.DFC_ComEAT7RingCnt_C "fault class per DFC / Fault class for check DFC_ComEAT7RingCnt" VALUE 0x804D9176 Val_Wu8 30.00 DFES_OneToOne 0.00 30.00 FORMAT "%5.2" EXTENDED_LIMITS 0.00 255.0 /end CHARACTERISTIC
/begin CHARACTERISTIC DFES_Cls.DFC_ComEAT7TOut_C "fault class per DFC / Fault class for check DFC_ComEAT7TOut" VALUE 0x804D9177 Val_Wu8 30.00 DFES_OneToOne 0.00 30.00 FORMAT "%5.2" EXTENDED_LIMITS 0.00 255.0 /end CHARACTERISTIC
/begin CHARACTERISTIC DFES_Cls.DFC_ComEAT8Chksum_C "fault class per DFC / Fault class for check DFC_ComEAT8Chksum" VALUE 0x804D9178 Val_Wu8 30.00 DFES_OneToOne 0.00 30.00 FORMAT "%5.2" EXTENDED_LIMITS 0.00 255.0 /end CHARACTERISTIC
/begin CHARACTERISTIC DFES_Cls.DFC_ComEAT8RingCnt_C "fault class per DFC / Fault class for check DFC_ComEAT8RingCnt" VALUE 0x804D9179 Val_Wu8 30.00 DFES_OneToOne 0.00 30.00 FORMAT "%5.2" EXTENDED_LIMITS 0.00 255.0 /end CHARACTERISTIC
/begin CHARACTERISTIC DFES_Cls.DFC_ComEAT8TOut_C "fault class per DFC / Fault class for check DFC_ComEAT8TOut" VALUE 0x804D917A Val_Wu8 30.00 DFES_OneToOne 0.00 30.00 FORMAT "%5.2" EXTENDED_LIMITS 0.00 255.0 /end CHARACTERISTIC
/begin CHARACTERISTIC DFES_Cls.DFC_ComEATAChksum_C "fault class per DFC / Fault class for check DFC_ComEATAChksum" VALUE 0x804D917B Val_Wu8 30.00 DFES_OneToOne 0.00 30.00 FORMAT "%5.2" EXTENDED_LIMITS 0.00 255.0 /end CHARACTERISTIC
/begin CHARACTERISTIC DFES_Cls.DFC_ComEATARingCnt_C "fault class per DFC / Fault class for check DFC_ComEATARingCnt" VALUE 0x804D917C Val_Wu8 30.00 DFES_OneToOne 0.00 30.00 FORMAT "%5.2" EXTENDED_LIMITS 0.00 255.0 /end CHARACTERISTIC
/begin CHARACTERISTIC DFES_Cls.DFC_ComEATATOut_C "fault class per DFC / Fault class for check DFC_ComEATATOut" VALUE 0x804D917D Val_Wu8 30.00 DFES_OneToOne 0.00 30.00 FORMAT "%5.2" EXTENDED_LIMITS 0.00 255.0 /end CHARACTERISTIC
/begin CHARACTERISTIC DFES_Cls.DFC_ComEATBChkSum_C "fault class per DFC / Fault class for check DFC_ComEATBChkSum" VALUE 0x804D917E Val_Wu8 30.00 DFES_OneToOne 0.00 30.00 FORMAT "%5.2" EXTENDED_LIMITS 0.00 255.0 /end CHARACTERISTIC
/begin CHARACTERISTIC DFES_Cls.DFC_ComEATBRingCnt_C "fault class per DFC / Fault class for check DFC_ComEATBRingCnt" VALUE 0x804D917F Val_Wu8 30.00 DFES_OneToOne 0.00 30.00 FORMAT "%5.2" EXTENDED_LIMITS 0.00 255.0 /end CHARACTERISTIC
/begin CHARACTERISTIC DFES_Cls.DFC_ComEATBTOut_C "fault class per DFC / Fault class for check DFC_ComEATBTOut" VALUE 0x804D9180 Val_Wu8 30.00 DFES_OneToOne 0.00 30.00 FORMAT "%5.2" EXTENDED_LIMITS 0.00 255.0 /end CHARACTERISTIC
/begin CHARACTERISTIC DFES_Cls.DFC_ComEATCChksum_C "fault class per DFC / Fault class for check DFC_ComEATCChksum" VALUE 0x804D9181 Val_Wu8 30.00 DFES_OneToOne 0.00 30.00 FORMAT "%5.2" EXTENDED_LIMITS 0.00 255.0 /end CHARACTERISTIC
/begin CHARACTERISTIC DFES_Cls.DFC_ComEATCRingCnt_C "fault class per DFC / Fault class for check DFC_ComEATCRingCnt" VALUE 0x804D9182 Val_Wu8 30.00 DFES_OneToOne 0.00 30.00 FORMAT "%5.2" EXTENDED_LIMITS 0.00 255.0 /end CHARACTERISTIC
/begin CHARACTERISTIC DFES_Cls.DFC_ComEATCTOut_C "fault class per DFC / Fault class for check DFC_ComEATCTOut" VALUE 0x804D9183 Val_Wu8 30.00 DFES_OneToOne 0.00 30.00 FORMAT "%5.2" EXTENDED_LIMITS 0.00 255.0 /end CHARACTERISTIC
/begin CHARACTERISTIC DFES_Cls.DFC_ComEBBAChksum_C "fault class per DFC / Fault class for check DFC_ComEBBAChksum" VALUE 0x804D9184 Val_Wu8 30.00 DFES_OneToOne 0.00 30.00 FORMAT "%5.2" EXTENDED_LIMITS 0.00 255.0 /end CHARACTERISTIC
/begin CHARACTERISTIC DFES_Cls.DFC_ComEBBARingCnt_C "fault class per DFC / Fault class for check DFC_ComEBBARingCnt" VALUE 0x804D9185 Val_Wu8 30.00 DFES_OneToOne 0.00 30.00 FORMAT "%5.2" EXTENDED_LIMITS 0.00 255.0 /end CHARACTERISTIC
/begin CHARACTERISTIC DFES_Cls.DFC_ComEBBATOut_C "fault class per DFC / Fault class for check DFC_ComEBBATOut" VALUE 0x804D9186 Val_Wu8 30.00 DFES_OneToOne 0.00 30.00 FORMAT "%5.2" EXTENDED_LIMITS 0.00 255.0 /end CHARACTERISTIC
/begin CHARACTERISTIC DFES_Cls.DFC_ComEPS1Chksum_C "fault class per DFC / Fault class for check DFC_ComEPS1Chksum" VALUE 0x804D9187 Val_Wu8 30.00 DFES_OneToOne 0.00 30.00 FORMAT "%5.2" EXTENDED_LIMITS 0.00 255.0 /end CHARACTERISTIC
/begin CHARACTERISTIC DFES_Cls.DFC_ComEPS1RingCnt_C "fault class per DFC / Fault class for check DFC_ComEPS1RingCnt" VALUE 0x804D9188 Val_Wu8 30.00 DFES_OneToOne 0.00 30.00 FORMAT "%5.2" EXTENDED_LIMITS 0.00 255.0 /end CHARACTERISTIC
/begin CHARACTERISTIC DFES_Cls.DFC_ComEPS1TOut_C "fault class per DFC / Fault class for check DFC_ComEPS1TOut" VALUE 0x804D9189 Val_Wu8 30.00 DFES_OneToOne 0.00 30.00 FORMAT "%5.2" EXTENDED_LIMITS 0.00 255.0 /end CHARACTERISTIC
/begin CHARACTERISTIC DFES_Cls.DFC_ComEngCanRxErr_C "fault class per DFC / Fault class for check DFC_ComEngCanRxErr" VALUE 0x804D918A Val_Wu8 30.00 DFES_OneToOne 0.00 30.00 FORMAT "%5.2" EXTENDED_LIMITS 0.00 255.0 /end CHARACTERISTIC
/begin CHARACTERISTIC DFES_Cls.DFC_ComGrvySnsrErr_C "fault class per DFC / Fault class for check DFC_ComGrvySnsrErr" VALUE 0x804D918B Val_Wu8 30.00 DFES_OneToOne 0.00 30.00 FORMAT "%5.2" EXTENDED_LIMITS 0.00 255.0 /end CHARACTERISTIC
/begin CHARACTERISTIC DFES_Cls.DFC_ComGwIMG1ChkSum_C "fault class per DFC / Fault class for check DFC_ComGwIMG1ChkSum" VALUE 0x804D918C Val_Wu8 30.00 DFES_OneToOne 0.00 30.00 FORMAT "%5.2" EXTENDED_LIMITS 0.00 255.0 /end CHARACTERISTIC
/begin CHARACTERISTIC DFES_Cls.DFC_ComGwIMG1RingCnt_C "fault class per DFC / Fault class for check DFC_ComGwIMG1RingCnt" VALUE 0x804D918D Val_Wu8 30.00 DFES_OneToOne 0.00 30.00 FORMAT "%5.2" EXTENDED_LIMITS 0.00 255.0 /end CHARACTERISTIC
/begin CHARACTERISTIC DFES_Cls.DFC_ComGwIMG1TOut_C "fault class per DFC / Fault class for check DFC_ComGwIMG1TOut" VALUE 0x804D918E Val_Wu8 30.00 DFES_OneToOne 0.00 30.00 FORMAT "%5.2" EXTENDED_LIMITS 0.00 255.0 /end CHARACTERISTIC
/begin CHARACTERISTIC DFES_Cls.DFC_ComGwIMG3ChkSum_C "fault class per DFC / Fault class for check DFC_ComGwIMG3ChkSum" VALUE 0x804D918F Val_Wu8 30.00 DFES_OneToOne 0.00 30.00 FORMAT "%5.2" EXTENDED_LIMITS 0.00 255.0 /end CHARACTERISTIC
/begin CHARACTERISTIC DFES_Cls.DFC_ComGwIMG3RingCnt_C "fault class per DFC / Fault class for check DFC_ComGwIMG3RingCnt" VALUE 0x804D9190 Val_Wu8 30.00 DFES_OneToOne 0.00 30.00 FORMAT "%5.2" EXTENDED_LIMITS 0.00 255.0 /end CHARACTERISTIC
/begin CHARACTERISTIC DFES_Cls.DFC_ComGwIMG3TOut_C "fault class per DFC / Fault class for check DFC_ComGwIMG3TOut" VALUE 0x804D9191 Val_Wu8 30.00 DFES_OneToOne 0.00 30.00 FORMAT "%5.2" EXTENDED_LIMITS 0.00 255.0 /end CHARACTERISTIC
/begin CHARACTERISTIC DFES_Cls.DFC_ComGwIMG4ChkSum_C "fault class per DFC / Fault class for check DFC_ComGwIMG4ChkSum" VALUE 0x804D9192 Val_Wu8 30.00 DFES_OneToOne 0.00 30.00 FORMAT "%5.2" EXTENDED_LIMITS 0.00 255.0 /end CHARACTERISTIC
/begin CHARACTERISTIC DFES_Cls.DFC_ComGwIMG4RingCnt_C "fault class per DFC / Fault class for check DFC_ComGwIMG4RingCnt" VALUE 0x804D9193 Val_Wu8 30.00 DFES_OneToOne 0.00 30.00 FORMAT "%5.2" EXTENDED_LIMITS 0.00 255.0 /end CHARACTERISTIC
/begin CHARACTERISTIC DFES_Cls.DFC_ComGwIMG4TOut_C "fault class per DFC / Fault class for check DFC_ComGwIMG4TOut" VALUE 0x804D9194 Val_Wu8 30.00 DFES_OneToOne 0.00 30.00 FORMAT "%5.2" EXTENDED_LIMITS 0.00 255.0 /end CHARACTERISTIC
/begin CHARACTERISTIC DFES_Cls.DFC_ComGwIMG5ChkSum_C "fault class per DFC / Fault class for check DFC_ComGwIMG5ChkSum" VALUE 0x804D9195 Val_Wu8 30.00 DFES_OneToOne 0.00 30.00 FORMAT "%5.2" EXTENDED_LIMITS 0.00 255.0 /end CHARACTERISTIC
/begin CHARACTERISTIC DFES_Cls.DFC_ComGwIMG5RingCnt_C "fault class per DFC / Fault class for check DFC_ComGwIMG5RingCnt" VALUE 0x804D9196 Val_Wu8 30.00 DFES_OneToOne 0.00 30.00 FORMAT "%5.2" EXTENDED_LIMITS 0.00 255.0 /end CHARACTERISTIC
/begin CHARACTERISTIC DFES_Cls.DFC_ComGwIMG5TOut_C "fault class per DFC / Fault class for check DFC_ComGwIMG5TOut" VALUE 0x804D9197 Val_Wu8 30.00 DFES_OneToOne 0.00 30.00 FORMAT "%5.2" EXTENDED_LIMITS 0.00 255.0 /end CHARACTERISTIC
/begin CHARACTERISTIC DFES_Cls.DFC_ComGwIMG6ChkSum_C "fault class per DFC / Fault class for check DFC_ComGwIMG6ChkSum" VALUE 0x804D9198 Val_Wu8 30.00 DFES_OneToOne 0.00 30.00 FORMAT "%5.2" EXTENDED_LIMITS 0.00 255.0 /end CHARACTERISTIC
/begin CHARACTERISTIC DFES_Cls.DFC_ComGwIMG6RingCnt_C "fault class per DFC / Fault class for check DFC_ComGwIMG6RingCnt" VALUE 0x804D9199 Val_Wu8 30.00 DFES_OneToOne 0.00 30.00 FORMAT "%5.2" EXTENDED_LIMITS 0.00 255.0 /end CHARACTERISTIC
/begin CHARACTERISTIC DFES_Cls.DFC_ComGwIMG6TOut_C "fault class per DFC / Fault class for check DFC_ComGwIMG6TOut" VALUE 0x804D919A Val_Wu8 30.00 DFES_OneToOne 0.00 30.00 FORMAT "%5.2" EXTENDED_LIMITS 0.00 255.0 /end CHARACTERISTIC
/begin CHARACTERISTIC DFES_Cls.DFC_ComIDASBChksum_C "fault class per DFC / Fault class for check DFC_ComIDASBChksum" VALUE 0x804D919B Val_Wu8 30.00 DFES_OneToOne 0.00 30.00 FORMAT "%5.2" EXTENDED_LIMITS 0.00 255.0 /end CHARACTERISTIC
/begin CHARACTERISTIC DFES_Cls.DFC_ComIDASBRingCnt_C "fault class per DFC / Fault class for check DFC_ComIDASBRingCnt" VALUE 0x804D919C Val_Wu8 30.00 DFES_OneToOne 0.00 30.00 FORMAT "%5.2" EXTENDED_LIMITS 0.00 255.0 /end CHARACTERISTIC
/begin CHARACTERISTIC DFES_Cls.DFC_ComIDASBTOut_C "fault class per DFC / Fault class for check DFC_ComIDASBTOut" VALUE 0x804D919D Val_Wu8 30.00 DFES_OneToOne 0.00 30.00 FORMAT "%5.2" EXTENDED_LIMITS 0.00 255.0 /end CHARACTERISTIC
/begin CHARACTERISTIC DFES_Cls.DFC_ComIMGMILReq_C "fault class per DFC / Fault class for check DFC_ComIMGMILReq" VALUE 0x804D919E Val_Wu8 30.00 DFES_OneToOne 0.00 30.00 FORMAT "%5.2" EXTENDED_LIMITS 0.00 255.0 /end CHARACTERISTIC
/begin CHARACTERISTIC DFES_Cls.DFC_ComISSPrms_C "fault class per DFC / Fault class for check DFC_ComISSPrms" VALUE 0x804D919F Val_Wu8 30.00 DFES_OneToOne 0.00 30.00 FORMAT "%5.2" EXTENDED_LIMITS 0.00 255.0 /end CHARACTERISTIC
/begin CHARACTERISTIC DFES_Cls.DFC_ComMETAChksum_C "fault class per DFC / Fault class for check DFC_ComMETAChksum" VALUE 0x804D91A0 Val_Wu8 30.00 DFES_OneToOne 0.00 30.00 FORMAT "%5.2" EXTENDED_LIMITS 0.00 255.0 /end CHARACTERISTIC
/begin CHARACTERISTIC DFES_Cls.DFC_ComMETARingCnt_C "fault class per DFC / Fault class for check DFC_ComMETARingCnt" VALUE 0x804D91A1 Val_Wu8 30.00 DFES_OneToOne 0.00 30.00 FORMAT "%5.2" EXTENDED_LIMITS 0.00 255.0 /end CHARACTERISTIC
/begin CHARACTERISTIC DFES_Cls.DFC_ComMETATOut_C "fault class per DFC / Fault class for check DFC_ComMETATOut" VALUE 0x804D91A2 Val_Wu8 30.00 DFES_OneToOne 0.00 30.00 FORMAT "%5.2" EXTENDED_LIMITS 0.00 255.0 /end CHARACTERISTIC
/begin CHARACTERISTIC DFES_Cls.DFC_ComMETCChksum_C "fault class per DFC / Fault class for check DFC_ComMETCChksum" VALUE 0x804D91A3 Val_Wu8 30.00 DFES_OneToOne 0.00 30.00 FORMAT "%5.2" EXTENDED_LIMITS 0.00 255.0 /end CHARACTERISTIC
/begin CHARACTERISTIC DFES_Cls.DFC_ComMETCRingCnt_C "fault class per DFC / Fault class for check DFC_ComMETCRingCnt" VALUE 0x804D91A4 Val_Wu8 30.00 DFES_OneToOne 0.00 30.00 FORMAT "%5.2" EXTENDED_LIMITS 0.00 255.0 /end CHARACTERISTIC
/begin CHARACTERISTIC DFES_Cls.DFC_ComMETCTOut_C "fault class per DFC / Fault class for check DFC_ComMETCTOut" VALUE 0x804D91A5 Val_Wu8 30.00 DFES_OneToOne 0.00 30.00 FORMAT "%5.2" EXTENDED_LIMITS 0.00 255.0 /end CHARACTERISTIC
/begin CHARACTERISTIC DFES_Cls.DFC_ComMETDChksum_C "fault class per DFC / Fault class for check DFC_ComMETDChksum" VALUE 0x804D91A6 Val_Wu8 30.00 DFES_OneToOne 0.00 30.00 FORMAT "%5.2" EXTENDED_LIMITS 0.00 255.0 /end CHARACTERISTIC
/begin CHARACTERISTIC DFES_Cls.DFC_ComMETDRingCnt_C "fault class per DFC / Fault class for check DFC_ComMETDRingCnt" VALUE 0x804D91A7 Val_Wu8 30.00 DFES_OneToOne 0.00 30.00 FORMAT "%5.2" EXTENDED_LIMITS 0.00 255.0 /end CHARACTERISTIC
/begin CHARACTERISTIC DFES_Cls.DFC_ComMETDTOut_C "fault class per DFC / Fault class for check DFC_ComMETDTOut" VALUE 0x804D91A8 Val_Wu8 30.00 DFES_OneToOne 0.00 30.00 FORMAT "%5.2" EXTENDED_LIMITS 0.00 255.0 /end CHARACTERISTIC
/begin CHARACTERISTIC DFES_Cls.DFC_ComMETE2Chksum_C "fault class per DFC / Fault class for check DFC_ComMETE2Chksum" VALUE 0x804D91A9 Val_Wu8 30.00 DFES_OneToOne 0.00 30.00 FORMAT "%5.2" EXTENDED_LIMITS 0.00 255.0 /end CHARACTERISTIC
/begin CHARACTERISTIC DFES_Cls.DFC_ComMETE2RingCnt_C "fault class per DFC / Fault class for check DFC_ComMETE2RingCnt" VALUE 0x804D91AA Val_Wu8 30.00 DFES_OneToOne 0.00 30.00 FORMAT "%5.2" EXTENDED_LIMITS 0.00 255.0 /end CHARACTERISTIC
/begin CHARACTERISTIC DFES_Cls.DFC_ComMETE2TOut_C "fault class per DFC / Fault class for check DFC_ComMETE2TOut" VALUE 0x804D91AB Val_Wu8 30.00 DFES_OneToOne 0.00 30.00 FORMAT "%5.2" EXTENDED_LIMITS 0.00 255.0 /end CHARACTERISTIC
/begin CHARACTERISTIC DFES_Cls.DFC_ComMETFChksum_C "fault class per DFC / Fault class for check DFC_ComMETFChksum" VALUE 0x804D91AC Val_Wu8 30.00 DFES_OneToOne 0.00 30.00 FORMAT "%5.2" EXTENDED_LIMITS 0.00 255.0 /end CHARACTERISTIC
/begin CHARACTERISTIC DFES_Cls.DFC_ComMETFRingCnt_C "fault class per DFC / Fault class for check DFC_ComMETFRingCnt" VALUE 0x804D91AD Val_Wu8 30.00 DFES_OneToOne 0.00 30.00 FORMAT "%5.2" EXTENDED_LIMITS 0.00 255.0 /end CHARACTERISTIC
/begin CHARACTERISTIC DFES_Cls.DFC_ComMETFTOut_C "fault class per DFC / Fault class for check DFC_ComMETFTOut" VALUE 0x804D91AE Val_Wu8 30.00 DFES_OneToOne 0.00 30.00 FORMAT "%5.2" EXTENDED_LIMITS 0.00 255.0 /end CHARACTERISTIC
/begin CHARACTERISTIC DFES_Cls.DFC_ComMETGChksum_C "fault class per DFC / Fault class for check DFC_ComMETGChksum" VALUE 0x804D91AF Val_Wu8 30.00 DFES_OneToOne 0.00 30.00 FORMAT "%5.2" EXTENDED_LIMITS 0.00 255.0 /end CHARACTERISTIC
/begin CHARACTERISTIC DFES_Cls.DFC_ComMETGRingCnt_C "fault class per DFC / Fault class for check DFC_ComMETGRingCnt" VALUE 0x804D91B0 Val_Wu8 30.00 DFES_OneToOne 0.00 30.00 FORMAT "%5.2" EXTENDED_LIMITS 0.00 255.0 /end CHARACTERISTIC
/begin CHARACTERISTIC DFES_Cls.DFC_ComMETGTOut_C "fault class per DFC / Fault class for check DFC_ComMETGTOut" VALUE 0x804D91B1 Val_Wu8 30.00 DFES_OneToOne 0.00 30.00 FORMAT "%5.2" EXTENDED_LIMITS 0.00 255.0 /end CHARACTERISTIC
/begin CHARACTERISTIC DFES_Cls.DFC_ComMETH2Chksum_C "fault class per DFC / Fault class for check DFC_ComMETH2Chksum" VALUE 0x804D91B2 Val_Wu8 30.00 DFES_OneToOne 0.00 30.00 FORMAT "%5.2" EXTENDED_LIMITS 0.00 255.0 /end CHARACTERISTIC
/begin CHARACTERISTIC DFES_Cls.DFC_ComMETH2RingCnt_C "fault class per DFC / Fault class for check DFC_ComMETH2RingCnt" VALUE 0x804D91B3 Val_Wu8 30.00 DFES_OneToOne 0.00 30.00 FORMAT "%5.2" EXTENDED_LIMITS 0.00 255.0 /end CHARACTERISTIC
/begin CHARACTERISTIC DFES_Cls.DFC_ComMETH2TOut_C "fault class per DFC / Fault class for check DFC_ComMETH2TOut" VALUE 0x804D91B4 Val_Wu8 30.00 DFES_OneToOne 0.00 30.00 FORMAT "%5.2" EXTENDED_LIMITS 0.00 255.0 /end CHARACTERISTIC
/begin CHARACTERISTIC DFES_Cls.DFC_ComMETHChksum_C "fault class per DFC / Fault class for check DFC_ComMETHChksum" VALUE 0x804D91B5 Val_Wu8 30.00 DFES_OneToOne 0.00 30.00 FORMAT "%5.2" EXTENDED_LIMITS 0.00 255.0 /end CHARACTERISTIC
/begin CHARACTERISTIC DFES_Cls.DFC_ComMETHRingCnt_C "fault class per DFC / Fault class for check DFC_ComMETHRingCnt" VALUE 0x804D91B6 Val_Wu8 30.00 DFES_OneToOne 0.00 30.00 FORMAT "%5.2" EXTENDED_LIMITS 0.00 255.0 /end CHARACTERISTIC
/begin CHARACTERISTIC DFES_Cls.DFC_ComMETHTOut_C "fault class per DFC / Fault class for check DFC_ComMETHTOut" VALUE 0x804D91B7 Val_Wu8 30.00 DFES_OneToOne 0.00 30.00 FORMAT "%5.2" EXTENDED_LIMITS 0.00 255.0 /end CHARACTERISTIC
/begin CHARACTERISTIC DFES_Cls.DFC_ComMETIChksum_C "fault class per DFC / Fault class for check DFC_ComMETIChksum" VALUE 0x804D91B8 Val_Wu8 30.00 DFES_OneToOne 0.00 30.00 FORMAT "%5.2" EXTENDED_LIMITS 0.00 255.0 /end CHARACTERISTIC
/begin CHARACTERISTIC DFES_Cls.DFC_ComMETIRingCnt_C "fault class per DFC / Fault class for check DFC_ComMETIRingCnt" VALUE 0x804D91B9 Val_Wu8 30.00 DFES_OneToOne 0.00 30.00 FORMAT "%5.2" EXTENDED_LIMITS 0.00 255.0 /end CHARACTERISTIC
/begin CHARACTERISTIC DFES_Cls.DFC_ComMETITOut_C "fault class per DFC / Fault class for check DFC_ComMETITOut" VALUE 0x804D91BA Val_Wu8 30.00 DFES_OneToOne 0.00 30.00 FORMAT "%5.2" EXTENDED_LIMITS 0.00 255.0 /end CHARACTERISTIC
/begin CHARACTERISTIC DFES_Cls.DFC_ComMETKChksum_C "fault class per DFC / Fault class for check DFC_ComMETKChksum" VALUE 0x804D91BB Val_Wu8 30.00 DFES_OneToOne 0.00 30.00 FORMAT "%5.2" EXTENDED_LIMITS 0.00 255.0 /end CHARACTERISTIC
/begin CHARACTERISTIC DFES_Cls.DFC_ComMETKRingCnt_C "fault class per DFC / Fault class for check DFC_ComMETKRingCnt" VALUE 0x804D91BC Val_Wu8 30.00 DFES_OneToOne 0.00 30.00 FORMAT "%5.2" EXTENDED_LIMITS 0.00 255.0 /end CHARACTERISTIC
/begin CHARACTERISTIC DFES_Cls.DFC_ComMETKTOut_C "fault class per DFC / Fault class for check DFC_ComMETKTOut" VALUE 0x804D91BD Val_Wu8 30.00 DFES_OneToOne 0.00 30.00 FORMAT "%5.2" EXTENDED_LIMITS 0.00 255.0 /end CHARACTERISTIC
/begin CHARACTERISTIC DFES_Cls.DFC_ComMETLChksum_C "fault class per DFC / Fault class for check DFC_ComMETLChksum" VALUE 0x804D91BE Val_Wu8 30.00 DFES_OneToOne 0.00 30.00 FORMAT "%5.2" EXTENDED_LIMITS 0.00 255.0 /end CHARACTERISTIC
/begin CHARACTERISTIC DFES_Cls.DFC_ComMETLRingCnt_C "fault class per DFC / Fault class for check DFC_ComMETLRingCnt" VALUE 0x804D91BF Val_Wu8 30.00 DFES_OneToOne 0.00 30.00 FORMAT "%5.2" EXTENDED_LIMITS 0.00 255.0 /end CHARACTERISTIC
/begin CHARACTERISTIC DFES_Cls.DFC_ComMETLTOut_C "fault class per DFC / Fault class for check DFC_ComMETLTOut" VALUE 0x804D91C0 Val_Wu8 30.00 DFES_OneToOne 0.00 30.00 FORMAT "%5.2" EXTENDED_LIMITS 0.00 255.0 /end CHARACTERISTIC
/begin CHARACTERISTIC DFES_Cls.DFC_ComMETMChksum_C "fault class per DFC / Fault class for check DFC_ComMETMChksum" VALUE 0x804D91C1 Val_Wu8 30.00 DFES_OneToOne 0.00 30.00 FORMAT "%5.2" EXTENDED_LIMITS 0.00 255.0 /end CHARACTERISTIC
/begin CHARACTERISTIC DFES_Cls.DFC_ComMETMRingCnt_C "fault class per DFC / Fault class for check DFC_ComMETMRingCnt" VALUE 0x804D91C2 Val_Wu8 30.00 DFES_OneToOne 0.00 30.00 FORMAT "%5.2" EXTENDED_LIMITS 0.00 255.0 /end CHARACTERISTIC
/begin CHARACTERISTIC DFES_Cls.DFC_ComMETMTOut_C "fault class per DFC / Fault class for check DFC_ComMETMTOut" VALUE 0x804D91C3 Val_Wu8 30.00 DFES_OneToOne 0.00 30.00 FORMAT "%5.2" EXTENDED_LIMITS 0.00 255.0 /end CHARACTERISTIC
/begin CHARACTERISTIC DFES_Cls.DFC_ComMETNChksum_C "fault class per DFC / Fault class for check DFC_ComMETNChksum" VALUE 0x804D91C4 Val_Wu8 30.00 DFES_OneToOne 0.00 30.00 FORMAT "%5.2" EXTENDED_LIMITS 0.00 255.0 /end CHARACTERISTIC
/begin CHARACTERISTIC DFES_Cls.DFC_ComMETNRingCnt_C "fault class per DFC / Fault class for check DFC_ComMETNRingCnt" VALUE 0x804D91C5 Val_Wu8 30.00 DFES_OneToOne 0.00 30.00 FORMAT "%5.2" EXTENDED_LIMITS 0.00 255.0 /end CHARACTERISTIC
/begin CHARACTERISTIC DFES_Cls.DFC_ComMETNTOut_C "fault class per DFC / Fault class for check DFC_ComMETNTOut" VALUE 0x804D91C6 Val_Wu8 30.00 DFES_OneToOne 0.00 30.00 FORMAT "%5.2" EXTENDED_LIMITS 0.00 255.0 /end CHARACTERISTIC
/begin CHARACTERISTIC DFES_Cls.DFC_ComMtrCom_C "fault class per DFC / Fault class for check DFC_ComMtrCom" VALUE 0x804D91C7 Val_Wu8 30.00 DFES_OneToOne 0.00 30.00 FORMAT "%5.2" EXTENDED_LIMITS 0.00 255.0 /end CHARACTERISTIC
/begin CHARACTERISTIC DFES_Cls.DFC_ComPCUChkSum_C "fault class per DFC / Fault class for check DFC_ComPCUChkSum" VALUE 0x804D91C8 Val_Wu8 30.00 DFES_OneToOne 0.00 30.00 FORMAT "%5.2" EXTENDED_LIMITS 0.00 255.0 /end CHARACTERISTIC
/begin CHARACTERISTIC DFES_Cls.DFC_ComPCURingCnt_C "fault class per DFC / Fault class for check DFC_ComPCURingCnt" VALUE 0x804D91C9 Val_Wu8 30.00 DFES_OneToOne 0.00 30.00 FORMAT "%5.2" EXTENDED_LIMITS 0.00 255.0 /end CHARACTERISTIC
/begin CHARACTERISTIC DFES_Cls.DFC_ComPCUTOut_C "fault class per DFC / Fault class for check DFC_ComPCUTOut" VALUE 0x804D91CA Val_Wu8 30.00 DFES_OneToOne 0.00 30.00 FORMAT "%5.2" EXTENDED_LIMITS 0.00 255.0 /end CHARACTERISTIC
/begin CHARACTERISTIC DFES_Cls.DFC_ComSRSAChksum_C "fault class per DFC / Fault class for check DFC_ComSRSAChksum" VALUE 0x804D91CB Val_Wu8 30.00 DFES_OneToOne 0.00 30.00 FORMAT "%5.2" EXTENDED_LIMITS 0.00 255.0 /end CHARACTERISTIC
/begin CHARACTERISTIC DFES_Cls.DFC_ComSRSARingCnt_C "fault class per DFC / Fault class for check DFC_ComSRSARingCnt" VALUE 0x804D91CC Val_Wu8 30.00 DFES_OneToOne 0.00 30.00 FORMAT "%5.2" EXTENDED_LIMITS 0.00 255.0 /end CHARACTERISTIC
/begin CHARACTERISTIC DFES_Cls.DFC_ComSRSATOut_C "fault class per DFC / Fault class for check DFC_ComSRSATOut" VALUE 0x804D91CD Val_Wu8 30.00 DFES_OneToOne 0.00 30.00 FORMAT "%5.2" EXTENDED_LIMITS 0.00 255.0 /end CHARACTERISTIC
/begin CHARACTERISTIC DFES_Cls.DFC_ComSRSBChksum_C "fault class per DFC / Fault class for check DFC_ComSRSBChksum" VALUE 0x804D91CE Val_Wu8 30.00 DFES_OneToOne 0.00 30.00 FORMAT "%5.2" EXTENDED_LIMITS 0.00 255.0 /end CHARACTERISTIC
/begin CHARACTERISTIC DFES_Cls.DFC_ComSRSBRingCnt_C "fault class per DFC / Fault class for check DFC_ComSRSBRingCnt" VALUE 0x804D91CF Val_Wu8 30.00 DFES_OneToOne 0.00 30.00 FORMAT "%5.2" EXTENDED_LIMITS 0.00 255.0 /end CHARACTERISTIC
/begin CHARACTERISTIC DFES_Cls.DFC_ComSRSBTOut_C "fault class per DFC / Fault class for check DFC_ComSRSBTOut" VALUE 0x804D91D0 Val_Wu8 30.00 DFES_OneToOne 0.00 30.00 FORMAT "%5.2" EXTENDED_LIMITS 0.00 255.0 /end CHARACTERISTIC
/begin CHARACTERISTIC DFES_Cls.DFC_ComSRSChksum_C "fault class per DFC / Fault class for check DFC_ComSRSChksum" VALUE 0x804D91D1 Val_Wu8 30.00 DFES_OneToOne 0.00 30.00 FORMAT "%5.2" EXTENDED_LIMITS 0.00 255.0 /end CHARACTERISTIC
/begin CHARACTERISTIC DFES_Cls.DFC_ComSRSErr_C "fault class per DFC / Fault class for check DFC_ComSRSErr" VALUE 0x804D91D2 Val_Wu8 30.00 DFES_OneToOne 0.00 30.00 FORMAT "%5.2" EXTENDED_LIMITS 0.00 255.0 /end CHARACTERISTIC
/begin CHARACTERISTIC DFES_Cls.DFC_ComSRSRingCnt_C "fault class per DFC / Fault class for check DFC_ComSRSRingCnt" VALUE 0x804D91D3 Val_Wu8 30.00 DFES_OneToOne 0.00 30.00 FORMAT "%5.2" EXTENDED_LIMITS 0.00 255.0 /end CHARACTERISTIC
/begin CHARACTERISTIC DFES_Cls.DFC_ComSRSTOut_C "fault class per DFC / Fault class for check DFC_ComSRSTOut" VALUE 0x804D91D4 Val_Wu8 30.00 DFES_OneToOne 0.00 30.00 FORMAT "%5.2" EXTENDED_LIMITS 0.00 255.0 /end CHARACTERISTIC
/begin CHARACTERISTIC DFES_Cls.DFC_ComVehSpdPndFltTCU_C "fault class per DFC / Fault class for check DFC_ComVehSpdPndFltTCU" VALUE 0x804D91D5 Val_Wu8 30.00 DFES_OneToOne 0.00 30.00 FORMAT "%5.2" EXTENDED_LIMITS 0.00 255.0 /end CHARACTERISTIC
/begin CHARACTERISTIC DFES_Cls.DFC_EbsChartcCurrErr_C "fault class per DFC / Fault class for check DFC_EbsChartcCurrErr" VALUE 0x804D91D6 Val_Wu8 30.00 DFES_OneToOne 0.00 30.00 FORMAT "%5.2" EXTENDED_LIMITS 0.00 255.0 /end CHARACTERISTIC
/begin CHARACTERISTIC DFES_Cls.DFC_EbsSelfDiagErr_C "fault class per DFC / Fault class for check DFC_EbsSelfDiagErr" VALUE 0x804D91D7 Val_Wu8 30.00 DFES_OneToOne 0.00 30.00 FORMAT "%5.2" EXTENDED_LIMITS 0.00 255.0 /end CHARACTERISTIC
/begin CHARACTERISTIC DFES_Cls.DFC_GbxCANDigPlausErr_C "fault class per DFC / Fault class for check DFC_GbxCANDigPlausErr" VALUE 0x804D91D8 Val_Wu8 30.00 DFES_OneToOne 0.00 30.00 FORMAT "%5.2" EXTENDED_LIMITS 0.00 255.0 /end CHARACTERISTIC
/begin CHARACTERISTIC DFES_Cls.DFC_GbxNPos1SRCMax_C "fault class per DFC / Fault class for check DFC_GbxNPos1SRCMax" VALUE 0x804D91D9 Val_Wu8 30.00 DFES_OneToOne 0.00 30.00 FORMAT "%5.2" EXTENDED_LIMITS 0.00 255.0 /end CHARACTERISTIC
/begin CHARACTERISTIC DFES_Cls.DFC_GbxNPos1SRCMin_C "fault class per DFC / Fault class for check DFC_GbxNPos1SRCMin" VALUE 0x804D91DA Val_Wu8 30.00 DFES_OneToOne 0.00 30.00 FORMAT "%5.2" EXTENDED_LIMITS 0.00 255.0 /end CHARACTERISTIC
/begin CHARACTERISTIC DFES_Cls.DFC_GbxNPos2SRCMax_C "fault class per DFC / Fault class for check DFC_GbxNPos2SRCMax" VALUE 0x804D91DB Val_Wu8 30.00 DFES_OneToOne 0.00 30.00 FORMAT "%5.2" EXTENDED_LIMITS 0.00 255.0 /end CHARACTERISTIC
/begin CHARACTERISTIC DFES_Cls.DFC_GbxNPos2SRCMin_C "fault class per DFC / Fault class for check DFC_GbxNPos2SRCMin" VALUE 0x804D91DC Val_Wu8 30.00 DFES_OneToOne 0.00 30.00 FORMAT "%5.2" EXTENDED_LIMITS 0.00 255.0 /end CHARACTERISTIC
/begin CHARACTERISTIC DFES_Cls.DFC_GbxNPosAlvChk_C "fault class per DFC / Fault class for check DFC_GbxNPosAlvChk" VALUE 0x804D91DD Val_Wu8 30.00 DFES_OneToOne 0.00 30.00 FORMAT "%5.2" EXTENDED_LIMITS 0.00 255.0 /end CHARACTERISTIC
/begin CHARACTERISTIC DFES_Cls.DFC_GbxNPosSyncErr_C "fault class per DFC / Fault class for check DFC_GbxNPosSyncErr" VALUE 0x804D91DE Val_Wu8 30.00 DFES_OneToOne 0.00 30.00 FORMAT "%5.2" EXTENDED_LIMITS 0.00 255.0 /end CHARACTERISTIC
/begin CHARACTERISTIC DFES_Cls.DFC_HEGOS2B1HtrPsMax_C "fault class per DFC / Fault class for check DFC_HEGOS2B1HtrPsMax" VALUE 0x804D91DF Val_Wu8 30.00 DFES_OneToOne 0.00 30.00 FORMAT "%5.2" EXTENDED_LIMITS 0.00 255.0 /end CHARACTERISTIC
/begin CHARACTERISTIC DFES_Cls.DFC_HEGOS2B1HtrPsMin_C "fault class per DFC / Fault class for check DFC_HEGOS2B1HtrPsMin" VALUE 0x804D91E0 Val_Wu8 30.00 DFES_OneToOne 0.00 30.00 FORMAT "%5.2" EXTENDED_LIMITS 0.00 255.0 /end CHARACTERISTIC
/begin CHARACTERISTIC DFES_Cls.DFC_HEGOS2B1HtrPsSig_C "fault class per DFC / Fault class for check DFC_HEGOS2B1HtrPsSig" VALUE 0x804D91E1 Val_Wu8 30.00 DFES_OneToOne 0.00 30.00 FORMAT "%5.2" EXTENDED_LIMITS 0.00 255.0 /end CHARACTERISTIC
/begin CHARACTERISTIC DFES_Cls.DFC_LinCSErrACG_C "fault class per DFC / Fault class for check DFC_LinCSErrACG" VALUE 0x804D91E2 Val_Wu8 30.00 DFES_OneToOne 0.00 30.00 FORMAT "%5.2" EXTENDED_LIMITS 0.00 255.0 /end CHARACTERISTIC
/begin CHARACTERISTIC DFES_Cls.DFC_LinCSErrEBS_C "fault class per DFC / Fault class for check DFC_LinCSErrEBS" VALUE 0x804D91E3 Val_Wu8 30.00 DFES_OneToOne 0.00 30.00 FORMAT "%5.2" EXTENDED_LIMITS 0.00 255.0 /end CHARACTERISTIC
/begin MEASUREMENT DFES_ChkLstDltDemExCond_mp "Exit condition of last delete demand check during initialisation" UBYTE OneToOne 1 100 0.00 255.0 FORMAT "%5.1" ECU_ADDRESS 0x70008AB4 /end MEASUREMENT
/begin MEASUREMENT DFES_chkSt "Check state of all DFCs stored in the error memory" UWORD OneToOne 1 100 0.00 65535.00 FORMAT "%8.2" ARRAY_SIZE 20 ECU_ADDRESS 0x60035ADC /end MEASUREMENT
/begin MEASUREMENT DFES_cnfSequence "DSM internal sequence counter to obtain confirmed entry sorting of all error memory entries" UBYTE OneToOne 1 100 0.00 255.0 FORMAT "%5.1" ARRAY_SIZE 20 ECU_ADDRESS 0x6003599A /end MEASUREMENT
/begin MEASUREMENT DFES_ctDef "Fault counters (FLC) of error memory entries" UBYTE DFES_OneToOne 1 100 0.00 255.0 FORMAT "%5.1" ARRAY_SIZE 20 ECU_ADDRESS 0x60035A50 /end MEASUREMENT
/begin MEASUREMENT DFES_ctDel "Delete counters (DLC) of error memory entries" UBYTE DFES_OneToOne 1 100 0.00 255.0 FORMAT "%5.1" ARRAY_SIZE 20 ECU_ADDRESS 0x60035A00 /end MEASUREMENT
/begin MEASUREMENT DFES_ctEntry "Number of occupied DFES Entries" UBYTE DFES_OneToOne 1 100 0.00 255.0 FORMAT "%5.1" ECU_ADDRESS 0x6000E3C6 /end MEASUREMENT
/begin MEASUREMENT DFES_ctFrq "Frequency counters of error memory entries" UBYTE DFES_OneToOne 1 100 0.00 255.0 FORMAT "%5.1" ARRAY_SIZE 20 ECU_ADDRESS 0x60034CCA /end MEASUREMENT
/begin MEASUREMENT DFES_ctManuDef "Manufacturer fault counters of error memory entries" UBYTE DFES_OneToOne 1 100 0.00 255.0 FORMAT "%5.1" ARRAY_SIZE 20 ECU_ADDRESS 0x60035A28 /end MEASUREMENT
/begin MEASUREMENT DFES_ctManuOk "Manufacturer healing counters of error memory entries" UBYTE DFES_OneToOne 1 100 0.00 255.0 FORMAT "%5.1" ARRAY_SIZE 20 ECU_ADDRESS 0x60035A14 /end MEASUREMENT
/begin MEASUREMENT DFES_ctMIL "Number of DFES Entries illuminating the MIL(Only continuous illumination, no blinking counted)" UBYTE DFES_OneToOne 1 100 0.00 255.0 FORMAT "%5.1" ECU_ADDRESS 0x6000E3C8 /end MEASUREMENT
/begin MEASUREMENT DFES_ctOBD "Number of DFES Entries visible in OBD Mode 3" UBYTE DFES_OneToOne 1 100 0.00 255.0 FORMAT "%5.1" ECU_ADDRESS 0x6000A9BB /end MEASUREMENT
/begin MEASUREMENT DFES_ctOBDPend "Number of DFES Entries visible in OBD Mode 7 (pending)" UBYTE DFES_OneToOne 1 100 0.00 255.0 FORMAT "%5.1" ECU_ADDRESS 0x6000E3C9 /end MEASUREMENT
/begin MEASUREMENT DFES_ctOk "Healing counters (HLC) of error memory entries" UBYTE DFES_OneToOne 1 100 0.00 255.0 FORMAT "%5.1" ARRAY_SIZE 20 ECU_ADDRESS 0x60035A3C /end MEASUREMENT
/begin MEASUREMENT DFES_ctSrv "Number of DFES Entries visible for Service tester" UBYTE DFES_OneToOne 1 100 0.00 255.0 FORMAT "%5.1" ECU_ADDRESS 0x6000A9BA /end MEASUREMENT
/begin MEASUREMENT DFES_entrySt "Entry state of all DFCs stored in the error memory" UBYTE DFES_Entry_Verb 1 100 0.00 34.0000000000 FORMAT "%13.10" ARRAY_SIZE 20 ECU_ADDRESS 0x60035AC8 /end MEASUREMENT
/begin MEASUREMENT DFES_EnvBlock "Environmental data of all fault entries" UBYTE DFES_OneToOne 1 100 0.00 255.0 FORMAT "%5.1" ARRAY_SIZE 20 ECU_ADDRESS 0x60034CDE /end MEASUREMENT
/begin MEASUREMENT DFES_FrzFrVal "Freeze frame values of all fault entries" UBYTE DFES_OneToOne 1 100 0.00 255.0 FORMAT "%5.1" ARRAY_SIZE 3240 ECU_ADDRESS 0x60034CF2 /end MEASUREMENT
/begin MEASUREMENT DFES_idxSequence "Sequence in which DFES entries were allocated (became Service$03 or Service$07 visible)" UBYTE DFES_OneToOne 1 100 0.00 255.0 FORMAT "%5.1" ARRAY_SIZE 20 ECU_ADDRESS 0x600359AF /end MEASUREMENT
/begin MEASUREMENT DFES_ISOFrstCnfDFC "DFC matching to criteria of first confirmed DTC" UWORD DFCDFP_Verb 1 100 0.00 762.000000000 FORMAT "%13.9" ECU_ADDRESS 0x60034CC8 /end MEASUREMENT
/begin MEASUREMENT DFES_ISOFrstFailDFC "DFC matching to criteria of first failed DTC" UWORD DFCDFP_Verb 1 100 0.00 762.000000000 FORMAT "%13.9" ECU_ADDRESS 0x60035B06 /end MEASUREMENT
/begin MEASUREMENT DFES_ISORcntCnfDFC "DFC matching to criteria of most recent confirmed DTC" UWORD DFCDFP_Verb 1 100 0.00 762.000000000 FORMAT "%13.9" ECU_ADDRESS 0x60034CC6 /end MEASUREMENT
/begin MEASUREMENT DFES_ISORcntFailDFC "DFC matching to criteria of most recent failed DTC" UWORD DFCDFP_Verb 1 100 0.00 762.000000000 FORMAT "%13.9" ECU_ADDRESS 0x60035B04 /end MEASUREMENT
/begin MEASUREMENT DFES_MonEvnt "DFES monitoring - Event Id" UWORD DFES_Mon_Verb 1 100 0.00 32786.0000000 FORMAT "%13.7" ARRAY_SIZE 2 ECU_ADDRESS 0x60035B8A /end MEASUREMENT
/begin MEASUREMENT DFES_MonObjt "DFES monitoring - Object Id" UWORD OneToOne 1 100 0.00 65535.00 FORMAT "%8.2" ARRAY_SIZE 2 ECU_ADDRESS 0x60035B86 /end MEASUREMENT
/begin MEASUREMENT DFES_MonParm "DFES monitoring - Parameter" UWORD OneToOne 1 100 0.00 65535.00 FORMAT "%8.2" ARRAY_SIZE 2 ECU_ADDRESS 0x60035B82 /end MEASUREMENT
/begin MEASUREMENT DFES_MonPtr "DSM internal pointer for DFES monitoring" UBYTE DFES_OneToOne 1 100 0.00 255.0 FORMAT "%5.1" ECU_ADDRESS 0x60035B8E /end MEASUREMENT
/begin MEASUREMENT DFES_numDFC "Names of stored fault checks in the error memory" UWORD DFC_Verb 1 100 0.00 703.000000000 FORMAT "%13.9" ARRAY_SIZE 20 ECU_ADDRESS 0x60035AA0 /end MEASUREMENT
/begin MEASUREMENT DFES_numDFCAck "acknowledged ID of fault entry (scanned and handled)" UWORD DFC_Verb 1 100 0.00 703.000000000 FORMAT "%13.9" ARRAY_SIZE 20 ECU_ADDRESS 0x600359D8 /end MEASUREMENT
/begin MEASUREMENT DFES_numDFCImdt "Names of immediately stored fault checks in the error memory" UWORD DFC_Verb 1 100 0.00 703.000000000 FORMAT "%13.9" ARRAY_SIZE 20 ECU_ADDRESS 0x60035B58 /end MEASUREMENT
/begin MEASUREMENT DFES_numEntryAvl "Number of possible DFES Entries" UBYTE DFES_OneToOne 1 100 0.00 255.0 FORMAT "%5.1" ECU_ADDRESS 0x6000E3CA /end MEASUREMENT
/begin MEASUREMENT DFES_numEnvSize "Number of bytes in one environment block" UBYTE DFES_OneToOne 1 100 0.00 255.0 FORMAT "%5.1" ECU_ADDRESS 0x6000E3CB /end MEASUREMENT
/begin MEASUREMENT DFES_numExtdFrzFrmSize "Number of bytes for environmental conditions contained in one freeze frame extension set" UBYTE DFES_OneToOne 1 100 0.00 255.0 FORMAT "%5.1" ECU_ADDRESS 0x6000E3CC /end MEASUREMENT
/begin MEASUREMENT DFES_numFrzFrmSize "Number of bytes in one freeze frame" UBYTE DFES_OneToOne 1 100 0.00 255.0 FORMAT "%5.1" ECU_ADDRESS 0x6000E3CD /end MEASUREMENT
/begin MEASUREMENT DFES_OutLamps "Error lamp status of error memory entries" UBYTE DFES_OneToOne 1 100 0.00 255.0 FORMAT "%5.1" ARRAY_SIZE 20 ECU_ADDRESS 0x6000A989 /end MEASUREMENT
/begin MEASUREMENT DFES_PDTCStore "indication to store permanent DTCs at beginning of postdrive" UBYTE OneToOne 1 100 0.00 255.0 BIT_MASK 0x1 FORMAT "%5.1" ECU_ADDRESS 0x6000A9B4 /end MEASUREMENT
/begin MEASUREMENT DFES_prioEntryImdt "Priority of error memory entries" UBYTE DFES_OneToOne 1 100 0.00 255.0 FORMAT "%5.1" ARRAY_SIZE 20 ECU_ADDRESS 0x60035B44 /end MEASUREMENT
/begin MEASUREMENT DFES_StateVisibility "Tester visibility of error memory entries" UWORD DFES_OneToOne 1 100 0.00 65535.00 FORMAT "%8.2" ARRAY_SIZE 20 ECU_ADDRESS 0x60005470 /end MEASUREMENT
/begin MEASUREMENT DFES_stChk "Legacy check state of all DFCs stored in the error memory" UBYTE DFES_stCheck_Verb 1 100 0.00 7.00000000000 FORMAT "%13.11" ARRAY_SIZE 20 ECU_ADDRESS 0x60035A8C /end MEASUREMENT
/begin MEASUREMENT DFES_stCounters "Counter state of all DFCs stored in the error memory" UBYTE DFES_stCnt_Verb 1 100 0.00 85.0000000000 FORMAT "%13.10" ARRAY_SIZE 20 ECU_ADDRESS 0x60035A64 /end MEASUREMENT
/begin MEASUREMENT DFES_stCtlSetting "internal and central disable request" UBYTE OneToOne 1 100 0.00 255.0 FORMAT "%5.1" ECU_ADDRESS 0x50005D44 /end MEASUREMENT
/begin MEASUREMENT DFES_stDataImdt "Environment data state of error memory entries" UBYTE DFES_stDataImdt_Verb 1 100 0.00 21.0000000000 FORMAT "%13.10" ARRAY_SIZE 20 ECU_ADDRESS 0x60035B08 /end MEASUREMENT
/begin MEASUREMENT DFES_stDataImdtTrans "Alternative environment data state of error memory entries during transition." UBYTE DFES_stDataImdt_Verb 1 100 0.00 21.0000000000 FORMAT "%13.10" ARRAY_SIZE 20 ECU_ADDRESS 0x6000A99D /end MEASUREMENT
/begin MEASUREMENT DFES_stDTCRecUpdt "state of disable DTC record update, AUTOSAR feature" UBYTE OneToOne 1 100 0.00 255.0 FORMAT "%5.1" ECU_ADDRESS 0x6000A9B2 /end MEASUREMENT
/begin MEASUREMENT DFES_stDTCStorage "state of disable DTC storage AUTOSAR feature" UBYTE OneToOne 1 100 0.00 255.0 FORMAT "%5.1" ECU_ADDRESS 0x6000A9B1 /end MEASUREMENT
/begin MEASUREMENT DFES_stEepWrReq "request for an EEPROM storage" UBYTE OneToOne 1 100 0.00 255.0 FORMAT "%5.1" ECU_ADDRESS 0x6000A9B7 /end MEASUREMENT
/begin MEASUREMENT DFES_stEntry "Legacy entry state of all DFCs stored in the error memory" UBYTE DFES_stEntry_Verb 1 100 0.00 254.000000000 FORMAT "%13.9" ARRAY_SIZE 20 ECU_ADDRESS 0x60035A78 /end MEASUREMENT
/begin MEASUREMENT DFES_stErrDia "DSM internal status of all tester visibilities" UBYTE DFES_OneToOne 1 100 0.00 255.0 FORMAT "%5.1" ECU_ADDRESS 0x6000A9BD /end MEASUREMENT
/begin MEASUREMENT DFES_stErrLamp "DFES error lamp demands" UBYTE DFES_OneToOne 1 100 0.00 255.0 FORMAT "%5.1" ECU_ADDRESS 0x6000A9BE /end MEASUREMENT
/begin MEASUREMENT DFES_stErrLamp_msg "DFES error lamp demands" UBYTE DFES_OneToOne 1 100 0.00 255.0 FORMAT "%5.1" ECU_ADDRESS 0x6000A3C8 /end MEASUREMENT
/begin MEASUREMENT DFES_stInh "Inhibit (FIM) relevant state of fault entry" UBYTE DFES_OneToOne 1 100 0.00 255.0 FORMAT "%5.1" ARRAY_SIZE 20 ECU_ADDRESS 0x600359C4 /end MEASUREMENT
/begin MEASUREMENT DFES_stOrdImdt "Order state of error memory entries" UWORD DFES_OneToOne 1 100 0.00 65535.00 FORMAT "%8.2" ARRAY_SIZE 20 ECU_ADDRESS 0x60035B1C /end MEASUREMENT
/begin MEASUREMENT DFES_stOrdImdtTrans "" UBYTE DFES_OneToOne 1 100 0.00 255.0 FORMAT "%5.1" ARRAY_SIZE 20 ECU_ADDRESS 0x6003402A /end MEASUREMENT
/begin MEASUREMENT DFES_stOutstate "DSM Flag status to check whether error counter is valid or not." UBYTE DFES_OneToOne 1 100 0.00 255.0 FORMAT "%5.1" ECU_ADDRESS 0x6000A9BC /end MEASUREMENT
/begin MEASUREMENT DFES_stPrgEvt "ECU programming event detected (reset of all diagnostic informations including IUMPR and permanent DTCs)" UBYTE OneToOne 1 100 0.00 255.0 BIT_MASK 0x1 FORMAT "%5.1" ECU_ADDRESS 0x6000A9B3 /end MEASUREMENT
/begin MEASUREMENT DFES_stPrgEvt_msg "Interface that gives information about ECU programming event." UBYTE OneToOne 1 100 0.00 255.0 BIT_MASK 0x1 FORMAT "%5.1" ECU_ADDRESS 0x6000A6DC /end MEASUREMENT
/begin MEASUREMENT DFES_stRepClrAftPwrFail "Repeated DSM clear after powerfail necessary" UBYTE B_TRUE 1 100 0.00 1.00000000000 BIT_MASK 0x1 FORMAT "%13.11" ECU_ADDRESS 0x60009B76 /end MEASUREMENT
/begin MEASUREMENT DFES_xAsgnEnvAllDataSize "Memory usage of common calibrated environment data" UBYTE DFES_OneToOne 1 100 0.00 255.0 FORMAT "%5.1" ECU_ADDRESS 0x6000A988 /end MEASUREMENT
/begin MEASUREMENT DSM_stProtdRamVld "DFES protected ram content is valid" UBYTE OneToOne 1 100 0.00 255.0 BIT_MASK 0x1 FORMAT "%5.1" ECU_ADDRESS 0x60034040 /end MEASUREMENT
/begin FUNCTION DFC "30000.33.0Diagnostic Fault Check"
 /begin DEF_CHARACTERISTIC DFC_DisblMsk.DFC_Clth2ONStuckLdc_C DFC_DisblMsk.DFC_Clth3ONStuckLdc_C DFC_DisblMsk.DFC_Clth3ONStuckPostDrv_C DFC_DisblMsk.DFC_Clth4ONStuck_C DFC_DisblMsk.DFC_Clth4ONStuckLdc_C DFC_DisblMsk.DFC_ComDLCTCU01_C DFC_DisblMsk.DFC_ComDLCTCU02_C DFC_DisblMsk.DFC_ComDLCTCU1_C DFC_DisblMsk.DFC_ComDLCTCU11_C DFC_DisblMsk.DFC_ComDLCTCU12_C DFC_DisblMsk.DFC_ComDLCTCU13_C DFC_DisblMsk.DFC_ComDLCTCU14_C DFC_DisblMsk.DFC_ComDLCTCU2_C DFC_DisblMsk.DFC_ComDLCTCU3_C DFC_DisblMsk.DFC_ComDLCTCU4_C DFC_DisblMsk.DFC_EVX_C DFC_DisblMsk.DFC_EbsSocFlt_C DFC_DisblMsk.DFC_I14229VINErr_C DFC_DisblMsk.DFC_LLRKHmax_C DFC_DisblMsk.DFC_LLRKHmin_C DFC_DisblMsk.DFC_LLRmax_C DFC_DisblMsk.DFC_LLRmin_C DFC_DisblMsk.DFC_RoughRoad_C DFC_DisblMsk.DFC_SiaEEPRdErr_C DFC_DisblMsk.DFC_SiaEEPWrngCod_C DFC_DisblMsk.DFC_UegoDummy_C DFC_DisblMsk.DFC_BusDiagCANAPPLBusOff_C DFC_DisblMsk.DFC_BusDiagCANCANCBusOff_C DFC_DisblMsk.DFC_BusDiagCANVEHICLEBusOff_C DFC_DisblMsk.DFC_RBA_IODIAGPWR_rba_IoExtCy329_SignalVltSply_0_C DFC_DisblMsk.DFC_RBA_IODIAGPWR_rba_IoExtCy329_SignalVltSply_0OT_C DFC_DisblMsk.DFC_RBA_IODIAGPWR_rba_IoExtCy329_SignalVltSply_0OV_C DFC_DisblMsk.DFC_RBA_IODIAGPWR_rba_IoExtCy329_SignalVltSply_0SCG_C DFC_DisblMsk.DFC_RBA_IODIAGPWR_rba_IoExtCy329_SignalVltSply_0UV_C DFC_DisblMsk.DFC_RBA_IODIAGPWR_rba_IoExtCy329_SignalVltSply_1_C DFC_DisblMsk.DFC_RBA_IODIAGPWR_rba_IoExtCy329_SignalVltSply_1OT_C DFC_DisblMsk.DFC_RBA_IODIAGPWR_rba_IoExtCy329_SignalVltSply_1OV_C DFC_DisblMsk.DFC_RBA_IODIAGPWR_rba_IoExtCy329_SignalVltSply_1SCG_C DFC_DisblMsk.DFC_RBA_IODIAGPWR_rba_IoExtCy329_SignalVltSply_1UV_C DFC_DisblMsk.DFC_RBA_IODIAGPWR_rba_IoExtCy329_SignalVltSply_2_C DFC_DisblMsk.DFC_RBA_IODIAGPWR_rba_IoExtCy329_SignalVltSply_2OT_C DFC_DisblMsk.DFC_RBA_IODIAGPWR_rba_IoExtCy329_SignalVltSply_2OV_C DFC_DisblMsk.DFC_RBA_IODIAGPWR_rba_IoExtCy329_SignalVltSply_2SCG_C DFC_DisblMsk.DFC_RBA_IODIAGPWR_rba_IoExtCy329_SignalVltSply_2UV_C DFC_DisblMsk.DFC_CAN_E_TIMEOUT_C DFC_DisblMsk.DFC_LIN_E_TIMEOUT_C DFC_DisblMsk.DFC_MRlyOL_C DFC_DisblMsk.DFC_MRlySCB_C DFC_DisblMsk.DFC_MRlySCG_C DFC_DisblMsk.DFC_rba_MultiStackTrace_Threshold_C DFC_DisblMsk.DFC_BSWM_E_ACTION_FAILED_C DFC_DisblMsk.DFC_BSWM_E_INTRPTQUEUE_FULL_C DFC_DisblMsk.DFC_RBA_IOEXTLIB_KEEPALIVE_DRV_C DFC_DisblMsk.DFC_RBA_IOEXTLIB_KEEPALIVE_INI_C DFC_DisblMsk.DFC_rba_IoSigRtc_StopCounter_C DFC_DisblMsk.DFC_rba_MRly_Diag_Stk_Event_C DFC_DisblMsk.DFC_rba_MemDiag_MemReadErr_C DFC_DisblMsk.DFC_rba_MemDiag_MemWrErr_C DFC_DisblMsk.DFC_rba_SyC_IrrSwOffTrigEngRun_Event_C DFC_DisblMsk.DFC_rba_T15_Diag_ComInVld_Event_C DFC_DisblMsk.DFC_rba_T15_Diag_ComOff_HwOn_Event_C DFC_DisblMsk.DFC_rba_T15_Diag_ComOn_HwOff_Event_C DFC_DisblMsk.DFC_AppAllSnsrDfct_C DFC_DisblMsk.DFC_BattUStdbyDiaOL_C DFC_DisblMsk.DFC_BigLeakIntkMnfldEmiInfl_C DFC_DisblMsk.DFC_BrkMnSwtContOnWarnLmp_C DFC_DisblMsk.DFC_BrkMnSwtNotStpWarnLmp_C DFC_DisblMsk.DFC_BrkRdntSwtContOnWarnLmp_C DFC_DisblMsk.DFC_BrkRdntSwtNotStpWarnLmp_C DFC_DisblMsk.DFC_CEngDsTColdStrtMax_C DFC_DisblMsk.DFC_CEngDsTColdStrtMin_C DFC_DisblMsk.DFC_CEngDsTImps_C DFC_DisblMsk.DFC_CEngDsTPlausLSC_C DFC_DisblMsk.DFC_CEngDsTPlausSTC_C DFC_DisblMsk.DFC_CEngDsTSRCMax_C DFC_DisblMsk.DFC_CEngDsTSRCMin_C DFC_DisblMsk.DFC_CEngDsTSig_C DFC_DisblMsk.DFC_CEngUsTSRCMax_C DFC_DisblMsk.DFC_CEngUsTSRCMin_C DFC_DisblMsk.DFC_DCDCFltDet_C DFC_DisblMsk.DFC_DKRSA_C DFC_DisblMsk.DFC_DKVSmax_C DFC_DisblMsk.DFC_DKnpl_C DFC_DisblMsk.DFC_DSSmax_C DFC_DisblMsk.DFC_DSTTI_C DFC_DisblMsk.DFC_DSUmax_C DFC_DisblMsk.DFC_EGRVlvOL_C DFC_DisblMsk.DFC_EGRVlvSCB_C DFC_DisblMsk.DFC_EGRVlvSCG_C DFC_DisblMsk.DFC_EGSDUS2B1LtrDly_C DFC_DisblMsk.DFC_EGSDUS2B1LtrPT1_C DFC_DisblMsk.DFC_EGSDUS2B1RtlDly_C DFC_DisblMsk.DFC_EGSDUS2B1RtlPT1_C DFC_DisblMsk.DFC_EGSDUS2B1TarLean_C DFC_DisblMsk.DFC_EGSDUS2B1TarRich_C DFC_DisblMsk.DFC_ETAKHLmax_C DFC_DisblMsk.DFC_ETAKHTmax_C DFC_DisblMsk.DFC_EngICO_C DFC_DisblMsk.DFC_EngPrtOvrSpdMon_C DFC_DisblMsk.DFC_EpmCaSI1ErrSig_C DFC_DisblMsk.DFC_EpmCaSI1NoSig_C DFC_DisblMsk.DFC_EpmCaSI1OfsErr_C DFC_DisblMsk.DFC_EpmCrSErrSig_C DFC_DisblMsk.DFC_EpmCrSNoSig_C DFC_DisblMsk.DFC_EtaEngIdleNonCsers_C DFC_DisblMsk.DFC_EtaEngPtlNonCsers_C DFC_DisblMsk.DFC_FRAmax_C DFC_DisblMsk.DFC_FRAmin_C DFC_DisblMsk.DFC_GbxRvsSwtStk_C DFC_DisblMsk.DFC_HDRmax_C DFC_DisblMsk.DFC_HEGOS2B1ElecMax_C DFC_DisblMsk.DFC_HEGOS2B1ElecMin_C DFC_DisblMsk.DFC_HEGOS2B1ElecSig_C DFC_DisblMsk.DFC_HEGOS2B1HtgNpl_C DFC_DisblMsk.DFC_IntkAirTIntkMnfldCrssMax_C DFC_DisblMsk.DFC_IntkAirTIntkMnfldCrssMin_C DFC_DisblMsk.DFC_IntkAirTIntkMnfldHSCMax_C DFC_DisblMsk.DFC_IntkAirTIntkMnfldImps_C DFC_DisblMsk.DFC_IntkAirTIntkMnfldPRCMax_C DFC_DisblMsk.DFC_IntkAirTIntkMnfldPRCMin_C DFC_DisblMsk.DFC_IntkAirTIntkMnfldSRCMax_C DFC_DisblMsk.DFC_IntkAirTIntkMnfldSRCMin_C DFC_DisblMsk.DFC_IntkAirTIntkMnfldSTC_C DFC_DisblMsk.DFC_KS1max_C DFC_DisblMsk.DFC_KS1min_C DFC_DisblMsk.DFC_LMmax_C DFC_DisblMsk.DFC_LZSRnpl_C DFC_DisblMsk.DFC_LamDynDiagS1B1_C DFC_DisblMsk.DFC_LeakIntkMnfldEmiInfl_C DFC_DisblMsk.DFC_MD00max_C DFC_DisblMsk.DFC_MDBmax_C DFC_DisblMsk.DFC_MDCat_C DFC_DisblMsk.DFC_MDCatCrit_C DFC_DisblMsk.DFC_MDCatCurr_C DFC_DisblMsk.DFC_MDCyl_0_C DFC_DisblMsk.DFC_MDCyl_1_C DFC_DisblMsk.DFC_MDCyl_2_C DFC_DisblMsk.DFC_MDCyl_3_C DFC_DisblMsk.DFC_MDEmi_C DFC_DisblMsk.DFC_MDEmiStrt_C DFC_DisblMsk.DFC_MDFco_C DFC_DisblMsk.DFC_MDMpl_C DFC_DisblMsk.DFC_MDSegTiAdpn_C DFC_DisblMsk.DFC_MDmax_C DFC_DisblMsk.DFC_MOXEMM_SMU_ALM0_0_C DFC_DisblMsk.DFC_MOXEMM_SMU_ALM0_1_C DFC_DisblMsk.DFC_MOXEMM_SMU_ALM0_10_C DFC_DisblMsk.DFC_MOXEMM_SMU_ALM0_11_C DFC_DisblMsk.DFC_MOXEMM_SMU_ALM0_13_C DFC_DisblMsk.DFC_MOXEMM_SMU_ALM0_14_C DFC_DisblMsk.DFC_MOXEMM_SMU_ALM0_2_C DFC_DisblMsk.DFC_MOXEMM_SMU_ALM0_22_C DFC_DisblMsk.DFC_MOXEMM_SMU_ALM0_23_C DFC_DisblMsk.DFC_MOXEMM_SMU_ALM0_4_C DFC_DisblMsk.DFC_MOXEMM_SMU_ALM0_5_C DFC_DisblMsk.DFC_MOXEMM_SMU_ALM0_7_C DFC_DisblMsk.DFC_MOXEMM_SMU_ALM0_8_C DFC_DisblMsk.DFC_MOXEMM_SMU_ALM10_16_C DFC_DisblMsk.DFC_MOXEMM_SMU_ALM10_17_C DFC_DisblMsk.DFC_MOXEMM_SMU_ALM10_21_C DFC_DisblMsk.DFC_MOXEMM_SMU_ALM11_0_C DFC_DisblMsk.DFC_MOXEMM_SMU_ALM11_1_C DFC_DisblMsk.DFC_MOXEMM_SMU_ALM11_2_C DFC_DisblMsk.DFC_MOXEMM_SMU_ALM11_3_C DFC_DisblMsk.DFC_MOXEMM_SMU_ALM11_4_C DFC_DisblMsk.DFC_MOXEMM_SMU_ALM11_5_C DFC_DisblMsk.DFC_MOXEMM_SMU_ALM11_8_C DFC_DisblMsk.DFC_MOXEMM_SMU_ALM11_9_C DFC_DisblMsk.DFC_MOXEMM_SMU_ALM1_0_C DFC_DisblMsk.DFC_MOXEMM_SMU_ALM1_1_C DFC_DisblMsk.DFC_MOXEMM_SMU_ALM1_10_C DFC_DisblMsk.DFC_MOXEMM_SMU_ALM1_11_C DFC_DisblMsk.DFC_MOXEMM_SMU_ALM1_13_C DFC_DisblMsk.DFC_MOXEMM_SMU_ALM1_14_C DFC_DisblMsk.DFC_MOXEMM_SMU_ALM1_2_C DFC_DisblMsk.DFC_MOXEMM_SMU_ALM1_22_C DFC_DisblMsk.DFC_MOXEMM_SMU_ALM1_23_C DFC_DisblMsk.DFC_MOXEMM_SMU_ALM1_4_C DFC_DisblMsk.DFC_MOXEMM_SMU_ALM1_5_C DFC_DisblMsk.DFC_MOXEMM_SMU_ALM1_7_C DFC_DisblMsk.DFC_MOXEMM_SMU_ALM1_8_C DFC_DisblMsk.DFC_MOXEMM_SMU_ALM21_0_C DFC_DisblMsk.DFC_MOXEMM_SMU_ALM21_16_C DFC_DisblMsk.DFC_MOXEMM_SMU_ALM21_3_C DFC_DisblMsk.DFC_MOXEMM_SMU_ALM2_1_C DFC_DisblMsk.DFC_MOXEMM_SMU_ALM2_10_C DFC_DisblMsk.DFC_MOXEMM_SMU_ALM2_11_C DFC_DisblMsk.DFC_MOXEMM_SMU_ALM2_13_C DFC_DisblMsk.DFC_MOXEMM_SMU_ALM2_14_C DFC_DisblMsk.DFC_MOXEMM_SMU_ALM2_22_C DFC_DisblMsk.DFC_MOXEMM_SMU_ALM2_23_C DFC_DisblMsk.DFC_MOXEMM_SMU_ALM2_4_C DFC_DisblMsk.DFC_MOXEMM_SMU_ALM2_5_C DFC_DisblMsk.DFC_MOXEMM_SMU_ALM2_7_C DFC_DisblMsk.DFC_MOXEMM_SMU_ALM2_8_C DFC_DisblMsk.DFC_MOXEMM_SMU_ALM6_0_C DFC_DisblMsk.DFC_MOXEMM_SMU_ALM6_11_C DFC_DisblMsk.DFC_MOXEMM_SMU_ALM6_12_C DFC_DisblMsk.DFC_MOXEMM_SMU_ALM6_14_C DFC_DisblMsk.DFC_MOXEMM_SMU_ALM6_15_C DFC_DisblMsk.DFC_MOXEMM_SMU_ALM6_17_C DFC_DisblMsk.DFC_MOXEMM_SMU_ALM6_18_C DFC_DisblMsk.DFC_MOXEMM_SMU_ALM6_20_C DFC_DisblMsk.DFC_MOXEMM_SMU_ALM6_21_C DFC_DisblMsk.DFC_MOXEMM_SMU_ALM6_25_C DFC_DisblMsk.DFC_MOXEMM_SMU_ALM6_4_C DFC_DisblMsk.DFC_MOXEMM_SMU_ALM6_5_C DFC_DisblMsk.DFC_MOXEMM_SMU_ALM6_7_C DFC_DisblMsk.DFC_MOXEMM_SMU_ALM6_8_C DFC_DisblMsk.DFC_MOXEMM_SMU_ALM7_1_C DFC_DisblMsk.DFC_MOXEMM_SMU_ALM7_12_C DFC_DisblMsk.DFC_MOXEMM_SMU_ALM7_13_C DFC_DisblMsk.DFC_MOXEMM_SMU_ALM7_14_C DFC_DisblMsk.DFC_MOXEMM_SMU_ALM7_15_C DFC_DisblMsk.DFC_MOXEMM_SMU_ALM7_16_C DFC_DisblMsk.DFC_MOXEMM_SMU_ALM7_17_C DFC_DisblMsk.DFC_MOXEMM_SMU_ALM7_2_C DFC_DisblMsk.DFC_MOXEMM_SMU_ALM7_20_C DFC_DisblMsk.DFC_MOXEMM_SMU_ALM7_25_C DFC_DisblMsk.DFC_MOXEMM_SMU_ALM7_26_C DFC_DisblMsk.DFC_MOXEMM_SMU_ALM7_28_C DFC_DisblMsk.DFC_MOXEMM_SMU_ALM7_29_C DFC_DisblMsk.DFC_MOXEMM_SMU_ALM7_30_C DFC_DisblMsk.DFC_MOXEMM_SMU_ALM7_31_C DFC_DisblMsk.DFC_MOXEMM_SMU_ALM8_0_C DFC_DisblMsk.DFC_MOXEMM_SMU_ALM8_1_C DFC_DisblMsk.DFC_MOXEMM_SMU_ALM8_10_C DFC_DisblMsk.DFC_MOXEMM_SMU_ALM8_11_C DFC_DisblMsk.DFC_MOXEMM_SMU_ALM8_12_C DFC_DisblMsk.DFC_MOXEMM_SMU_ALM8_16_C DFC_DisblMsk.DFC_MOXEMM_SMU_ALM8_18_C DFC_DisblMsk.DFC_MOXEMM_SMU_ALM8_2_C DFC_DisblMsk.DFC_MOXEMM_SMU_ALM8_3_C DFC_DisblMsk.DFC_MOXEMM_SMU_ALM8_31_C DFC_DisblMsk.DFC_MOXEMM_SMU_ALM8_4_C DFC_DisblMsk.DFC_MOXEMM_SMU_ALM9_0_C DFC_DisblMsk.DFC_MOXEMM_SMU_ALM9_15_C DFC_DisblMsk.DFC_MOXEMM_SMU_ALM9_3_C DFC_DisblMsk.DFC_MoCADCNTP_C DFC_DisblMsk.DFC_MoCADCTst_C DFC_DisblMsk.DFC_MoCSOPICO_C DFC_DisblMsk.DFC_MoFAPP_C DFC_DisblMsk.DFC_MoFAirFilgPrdc_C DFC_DisblMsk.DFC_MoFAirFlCtOffPfi_C DFC_DisblMsk.DFC_MoFAirFlCylPfi_C DFC_DisblMsk.DFC_MoFAirFlIn_C DFC_DisblMsk.DFC_MoFAirFlMixCtlPfiChkAirFl_C DFC_DisblMsk.DFC_MoFAirFlMixCtlPfiChkCtrl_C DFC_DisblMsk.DFC_MoFAirFlMode_C DFC_DisblMsk.DFC_MoFESpd_C DFC_DisblMsk.DFC_MoFIACo_C DFC_DisblMsk.DFC_MoFICOL1_C DFC_DisblMsk.DFC_MoFICOL2_C DFC_DisblMsk.DFC_MoFStrt_C DFC_DisblMsk.DFC_MoFTrqCmp_C DFC_DisblMsk.DFC_MoFTrqCmpMax_C DFC_DisblMsk.DFC_MoFTrqCmpMin_C DFC_DisblMsk.DFC_MoFVarPostBldSel_C DFC_DisblMsk.DFC_MoXEMMHwLTMCUFW_C DFC_DisblMsk.DFC_MoXEMMHwLTMonBIST_C DFC_DisblMsk.DFC_MoXEMMHwLTRegMonTest_C DFC_DisblMsk.DFC_MoXEMMHwLTStbySMUAlvTest_C DFC_DisblMsk.DFC_MoXEMMHwLTTempSens_C DFC_DisblMsk.DFC_MoXEMMHwLTUCBCfg_C DFC_DisblMsk.DFC_OCWDAABEActv_C DFC_DisblMsk.DFC_OCWDACom_C DFC_DisblMsk.DFC_OCWDAErrPin_C DFC_DisblMsk.DFC_OCWDAOvrVltg_C DFC_DisblMsk.DFC_ORAmax_C DFC_DisblMsk.DFC_ORAmin_C DFC_DisblMsk.DFC_PLLSUmax_C DFC_DisblMsk.DFC_PLLSUmin_C DFC_DisblMsk.DFC_PSR1max_C DFC_DisblMsk.DFC_PSRBmax_C DFC_DisblMsk.DFC_PSRBmin_C DFC_DisblMsk.DFC_PSRPmax_C DFC_DisblMsk.DFC_PSRPmin_C DFC_DisblMsk.DFC_PSRPsig_C DFC_DisblMsk.DFC_PSRmax_C DFC_DisblMsk.DFC_PUmax_C DFC_DisblMsk.DFC_P_VSE11_OL_C DFC_DisblMsk.DFC_P_VSE11_SCB_C DFC_DisblMsk.DFC_P_VSE11_SCG_C DFC_DisblMsk.DFC_PhyHighAPP1_C DFC_DisblMsk.DFC_PhyHighAPP2_C DFC_DisblMsk.DFC_PhyLowAPP1_C DFC_DisblMsk.DFC_PhyLowAPP2_C DFC_DisblMsk.DFC_SRCHighAPP1_C DFC_DisblMsk.DFC_SRCHighAPP2_C DFC_DisblMsk.DFC_SRCLowAPP1_C DFC_DisblMsk.DFC_SRCLowAPP2_C DFC_DisblMsk.DFC_SSpMon2_C DFC_DisblMsk.DFC_SWReset_0_C DFC_DisblMsk.DFC_SWReset_1_C DFC_DisblMsk.DFC_SWReset_2_C DFC_DisblMsk.DFC_SyncAPP_C DFC_DisblMsk.DFC_TAmax_Dummy_C DFC_DisblMsk.DFC_TKAEmax_C DFC_DisblMsk.DFC_TKAEmin_C DFC_DisblMsk.DFC_TKARmax_C DFC_DisblMsk.DFC_TKARnpl_C DFC_DisblMsk.DFC_TMmax_Dummy_C DFC_DisblMsk.DFC_TUMmax_Dummy_C DFC_DisblMsk.DFC_TWCDPriCatB1_C DFC_DisblMsk.DFC_ThrVlvClsdPosnFirstOffsLrnImpoB1_C DFC_DisblMsk.DFC_ThrVlvClsdPosnOffsLrnImpoB1_C DFC_DisblMsk.DFC_ThrVlvClsdPosnOffsLrnMaxB1_C DFC_DisblMsk.DFC_ThrVlvClsdPosnOffsLrnMinB1_C DFC_DisblMsk.DFC_ThrVlvCtrlDeB1_C DFC_DisblMsk.DFC_ThrVlvDycB1_C DFC_DisblMsk.DFC_ThrVlvLimpAirPosnMaxAbsltDriftB1_C DFC_DisblMsk.DFC_ThrVlvLimpAirPosnMaxB1_C DFC_DisblMsk.DFC_ThrVlvLimpAirPosnMaxRelDriftB1_C DFC_DisblMsk.DFC_ThrVlvLimpAirPosnMinB1_C DFC_DisblMsk.DFC_ThrVlvOpenLoadB1_C DFC_DisblMsk.DFC_ThrVlvOpenSprgB1_C DFC_DisblMsk.DFC_ThrVlvOpenSprgSprdB1_C DFC_DisblMsk.DFC_ThrVlvOpenSprgTwnB1_C DFC_DisblMsk.DFC_ThrVlvOverTB1_C DFC_DisblMsk.DFC_ThrVlvRetSprgB1_C DFC_DisblMsk.DFC_ThrVlvRetSprgSprdB1_C DFC_DisblMsk.DFC_ThrVlvRetSprgTwnB1_C DFC_DisblMsk.DFC_ThrVlvSens1MaxB1_C DFC_DisblMsk.DFC_ThrVlvSens1NplB1_C DFC_DisblMsk.DFC_ThrVlvSens2MaxB1_C DFC_DisblMsk.DFC_ThrVlvSens2MinB1_C DFC_DisblMsk.DFC_ThrVlvSens2NplB1_C DFC_DisblMsk.DFC_ThrVlvShoCircB1_C DFC_DisblMsk.DFC_ThrVlvSpiErrB1_C DFC_DisblMsk.DFC_ThrvlvSens1MinB1_C DFC_DisblMsk.DFC_TiOffTBasdChkFast_C DFC_DisblMsk.DFC_TiOffTBasdChkSlow_C DFC_DisblMsk.DFC_UEGOHeatrCtlS1B1_C DFC_DisblMsk.DFC_UEGOSnsrMntdS1B1_C DFC_DisblMsk.DFC_VehVSig_C DFC_DisblMsk.DFC_VlvLftFbSwtIntk11SpclFail_C DFC_DisblMsk.DFC_VlvLftFbSwtIntk11StdFail_C DFC_DtcFuncUnit_C DFC_DtcGroup_C DFC_DtcSeverity_C /end DEF_CHARACTERISTIC
 FUNCTION_VERSION "30000.33.0" /end FUNCTION
/begin FUNCTION DFES "30000.73.0_2.0.0Diagnostic Fault Event Storage"
 /begin DEF_CHARACTERISTIC DFES_Cls.DFC_Unused_C DFES_Cls.DFC_AltIOACGFailr_C DFES_Cls.DFC_AltIOACGHiVltg_C DFES_Cls.DFC_AltIOACGLoVltg_C DFES_Cls.DFC_AltIOACGTHi_C DFES_Cls.DFC_AltIODConnACG_C DFES_Cls.DFC_BattUHiFailr_C DFES_Cls.DFC_BattULoFailr_C DFES_Cls.DFC_BrkBstPDriftHiErr_C DFES_Cls.DFC_BrkBstPDriftLoErr_C DFES_Cls.DFC_BrkBstPSnsrStuck_C DFES_Cls.DFC_BrkMnSwtContOn_C DFES_Cls.DFC_BrkMnSwtNotStp_C DFES_Cls.DFC_BrkNpl_C DFES_Cls.DFC_BrkRdntSwtContOn_C DFES_Cls.DFC_BrkRdntSwtNotStp_C DFES_Cls.DFC_Clth3ONStuck_C DFES_Cls.DFC_Clth4OFFStuck_C DFES_Cls.DFC_ClthOFFStuck_C DFES_Cls.DFC_ClthONStuck_C DFES_Cls.DFC_ClthStkFailInfo_C DFES_Cls.DFC_ComACFailInfo_C DFES_Cls.DFC_ComATFTValErr_C DFES_Cls.DFC_ComATMILReq_C DFES_Cls.DFC_ComAYCAChksum_C DFES_Cls.DFC_ComAYCARingCnt_C DFES_Cls.DFC_ComAYCATOut_C DFES_Cls.DFC_ComAYCDChkSum_C DFES_Cls.DFC_ComAYCDTOut_C DFES_Cls.DFC_ComAYCFChksum_C DFES_Cls.DFC_ComAYCFRingCnt_C DFES_Cls.DFC_ComAYCFTOut_C DFES_Cls.DFC_ComAYCGChksum_C DFES_Cls.DFC_ComAYCGRingCnt_C DFES_Cls.DFC_ComAYCGTOut_C DFES_Cls.DFC_ComAYCIChkSum_C DFES_Cls.DFC_ComAYCIRingCnt_C DFES_Cls.DFC_ComAYCITOut_C DFES_Cls.DFC_ComBCM1ChkSum_C DFES_Cls.DFC_ComBCM1RingCnt_C DFES_Cls.DFC_ComBCM1TOut_C DFES_Cls.DFC_ComCANABusOffErr_C DFES_Cls.DFC_ComCANBBusOffErr_C DFES_Cls.DFC_ComCANCBusOffErr_C DFES_Cls.DFC_ComCGW1ChkSum_C DFES_Cls.DFC_ComCGW1RingCnt_C DFES_Cls.DFC_ComCGW1TOut_C DFES_Cls.DFC_ComConvBoostErr_C DFES_Cls.DFC_ComConvSlipErr_C DFES_Cls.DFC_ComEAT10Chksum_C DFES_Cls.DFC_ComEAT10RingCnt_C DFES_Cls.DFC_ComEAT10TOut_C DFES_Cls.DFC_ComEAT11ChkSum_C DFES_Cls.DFC_ComEAT11RingCnt_C DFES_Cls.DFC_ComEAT11TOut_C DFES_Cls.DFC_ComEAT12ChkSum_C DFES_Cls.DFC_ComEAT12RingCnt_C DFES_Cls.DFC_ComEAT12TOut_C DFES_Cls.DFC_ComEAT13ChkSum_C DFES_Cls.DFC_ComEAT13RingCnt_C DFES_Cls.DFC_ComEAT13TOut_C DFES_Cls.DFC_ComEAT1Chksum_C DFES_Cls.DFC_ComEAT1RingCnt_C DFES_Cls.DFC_ComEAT1TOut_C DFES_Cls.DFC_ComEAT2ChkSum_C DFES_Cls.DFC_ComEAT2RingCnt_C DFES_Cls.DFC_ComEAT2TOut_C DFES_Cls.DFC_ComEAT4ChkSum_C DFES_Cls.DFC_ComEAT4RingCnt_C DFES_Cls.DFC_ComEAT4TOut_C DFES_Cls.DFC_ComEAT6Chksum_C DFES_Cls.DFC_ComEAT6RingCnt_C DFES_Cls.DFC_ComEAT6TOut_C DFES_Cls.DFC_ComEAT7Chksum_C DFES_Cls.DFC_ComEAT7RingCnt_C DFES_Cls.DFC_ComEAT7TOut_C DFES_Cls.DFC_ComEAT8Chksum_C DFES_Cls.DFC_ComEAT8RingCnt_C DFES_Cls.DFC_ComEAT8TOut_C DFES_Cls.DFC_ComEATAChksum_C DFES_Cls.DFC_ComEATARingCnt_C DFES_Cls.DFC_ComEATATOut_C DFES_Cls.DFC_ComEATBChkSum_C DFES_Cls.DFC_ComEATBRingCnt_C DFES_Cls.DFC_ComEATBTOut_C DFES_Cls.DFC_ComEATCChksum_C DFES_Cls.DFC_ComEATCRingCnt_C DFES_Cls.DFC_ComEATCTOut_C DFES_Cls.DFC_ComEBBAChksum_C DFES_Cls.DFC_ComEBBARingCnt_C DFES_Cls.DFC_ComEBBATOut_C DFES_Cls.DFC_ComEPS1Chksum_C DFES_Cls.DFC_ComEPS1RingCnt_C DFES_Cls.DFC_ComEPS1TOut_C DFES_Cls.DFC_ComEngCanRxErr_C DFES_Cls.DFC_ComGrvySnsrErr_C DFES_Cls.DFC_ComGwIMG1ChkSum_C DFES_Cls.DFC_ComGwIMG1RingCnt_C DFES_Cls.DFC_ComGwIMG1TOut_C DFES_Cls.DFC_ComGwIMG3ChkSum_C DFES_Cls.DFC_ComGwIMG3RingCnt_C DFES_Cls.DFC_ComGwIMG3TOut_C DFES_Cls.DFC_ComGwIMG4ChkSum_C DFES_Cls.DFC_ComGwIMG4RingCnt_C DFES_Cls.DFC_ComGwIMG4TOut_C DFES_Cls.DFC_ComGwIMG5ChkSum_C DFES_Cls.DFC_ComGwIMG5RingCnt_C DFES_Cls.DFC_ComGwIMG5TOut_C DFES_Cls.DFC_ComGwIMG6ChkSum_C DFES_Cls.DFC_ComGwIMG6RingCnt_C DFES_Cls.DFC_ComGwIMG6TOut_C DFES_Cls.DFC_ComIDASBChksum_C DFES_Cls.DFC_ComIDASBRingCnt_C DFES_Cls.DFC_ComIDASBTOut_C DFES_Cls.DFC_ComIMGMILReq_C DFES_Cls.DFC_ComISSPrms_C DFES_Cls.DFC_ComMETAChksum_C DFES_Cls.DFC_ComMETARingCnt_C DFES_Cls.DFC_ComMETATOut_C DFES_Cls.DFC_ComMETCChksum_C DFES_Cls.DFC_ComMETCRingCnt_C DFES_Cls.DFC_ComMETCTOut_C DFES_Cls.DFC_ComMETDChksum_C DFES_Cls.DFC_ComMETDRingCnt_C DFES_Cls.DFC_ComMETDTOut_C DFES_Cls.DFC_ComMETE2Chksum_C DFES_Cls.DFC_ComMETE2RingCnt_C DFES_Cls.DFC_ComMETE2TOut_C DFES_Cls.DFC_ComMETFChksum_C DFES_Cls.DFC_ComMETFRingCnt_C DFES_Cls.DFC_ComMETFTOut_C DFES_Cls.DFC_ComMETGChksum_C DFES_Cls.DFC_ComMETGRingCnt_C DFES_Cls.DFC_ComMETGTOut_C DFES_Cls.DFC_ComMETH2Chksum_C DFES_Cls.DFC_ComMETH2RingCnt_C DFES_Cls.DFC_ComMETH2TOut_C DFES_Cls.DFC_ComMETHChksum_C DFES_Cls.DFC_ComMETHRingCnt_C DFES_Cls.DFC_ComMETHTOut_C DFES_Cls.DFC_ComMETIChksum_C DFES_Cls.DFC_ComMETIRingCnt_C DFES_Cls.DFC_ComMETITOut_C DFES_Cls.DFC_ComMETKChksum_C DFES_Cls.DFC_ComMETKRingCnt_C DFES_Cls.DFC_ComMETKTOut_C DFES_Cls.DFC_ComMETLChksum_C DFES_Cls.DFC_ComMETLRingCnt_C DFES_Cls.DFC_ComMETLTOut_C DFES_Cls.DFC_ComMETMChksum_C DFES_Cls.DFC_ComMETMRingCnt_C DFES_Cls.DFC_ComMETMTOut_C DFES_Cls.DFC_ComMETNChksum_C DFES_Cls.DFC_ComMETNRingCnt_C DFES_Cls.DFC_ComMETNTOut_C DFES_Cls.DFC_ComMtrCom_C DFES_Cls.DFC_ComPCUChkSum_C DFES_Cls.DFC_ComPCURingCnt_C DFES_Cls.DFC_ComPCUTOut_C DFES_Cls.DFC_ComSRSAChksum_C DFES_Cls.DFC_ComSRSARingCnt_C DFES_Cls.DFC_ComSRSATOut_C DFES_Cls.DFC_ComSRSBChksum_C DFES_Cls.DFC_ComSRSBRingCnt_C DFES_Cls.DFC_ComSRSBTOut_C DFES_Cls.DFC_ComSRSChksum_C DFES_Cls.DFC_ComSRSErr_C DFES_Cls.DFC_ComSRSRingCnt_C DFES_Cls.DFC_ComSRSTOut_C DFES_Cls.DFC_ComVehSpdPndFltTCU_C DFES_Cls.DFC_EbsChartcCurrErr_C DFES_Cls.DFC_EbsSelfDiagErr_C DFES_Cls.DFC_GbxCANDigPlausErr_C DFES_Cls.DFC_GbxNPos1SRCMax_C DFES_Cls.DFC_GbxNPos1SRCMin_C DFES_Cls.DFC_GbxNPos2SRCMax_C DFES_Cls.DFC_GbxNPos2SRCMin_C DFES_Cls.DFC_GbxNPosAlvChk_C DFES_Cls.DFC_GbxNPosSyncErr_C DFES_Cls.DFC_HEGOS2B1HtrPsMax_C DFES_Cls.DFC_HEGOS2B1HtrPsMin_C DFES_Cls.DFC_HEGOS2B1HtrPsSig_C DFES_Cls.DFC_LinCSErrACG_C DFES_Cls.DFC_LinCSErrEBS_C /end DEF_CHARACTERISTIC
 /begin IN_MEASUREMENT DSMAUX_stDCy DSM_TripChgAndClrFinshd /end IN_MEASUREMENT
 /begin OUT_MEASUREMENT DFES_stEepWrReq DFES_stErrLamp DFES_stErrLamp_msg DFES_stOutstate DFES_stPrgEvt_msg DSM_stProtdRamVld /end OUT_MEASUREMENT
 /begin LOC_MEASUREMENT DFES_ChkLstDltDemExCond_mp DFES_chkSt DFES_cnfSequence DFES_ctDef DFES_ctDel DFES_ctEntry DFES_ctFrq DFES_ctManuDef DFES_ctManuOk DFES_ctMIL DFES_ctOBD DFES_ctOBDPend DFES_ctOk DFES_ctSrv DFES_entrySt DFES_EnvBlock DFES_FrzFrVal DFES_idxSequence DFES_ISOFrstCnfDFC DFES_ISOFrstFailDFC DFES_ISORcntCnfDFC DFES_ISORcntFailDFC DFES_MonEvnt DFES_MonObjt DFES_MonParm DFES_MonPtr DFES_numDFC DFES_numDFCAck DFES_numDFCImdt DFES_numEntryAvl DFES_numEnvSize DFES_numExtdFrzFrmSize DFES_numFrzFrmSize DFES_OutLamps DFES_PDTCStore DFES_prioEntryImdt DFES_StateVisibility DFES_stChk DFES_stCounters DFES_stCtlSetting DFES_stDataImdt DFES_stDataImdtTrans DFES_stDTCRecUpdt DFES_stDTCStorage DFES_stEntry DFES_stErrDia DFES_stInh DFES_stOrdImdt DFES_stOrdImdtTrans DFES_stPrgEvt DFES_stRepClrAftPwrFail DFES_xAsgnEnvAllDataSize /end LOC_MEASUREMENT
 FUNCTION_VERSION "30000.73.0_2.0.0" /end FUNCTION
/begin COMPU_METHOD B_TRUE "" TAB_VERB "%6.3" "" COMPU_TAB_REF B_TRUE /end COMPU_METHOD
/begin COMPU_VTAB B_TRUE "" TAB_VERB 2 0 "FALSE" 1 "TRUE" /end COMPU_VTAB
/begin COMPU_METHOD Dem_DTCGroup_Verb "" TAB_VERB "%6.3" "-" COMPU_TAB_REF Dem_DTCGroup_Verb /end COMPU_METHOD
/begin COMPU_VTAB Dem_DTCGroup_Verb "" TAB_VERB 6 0 "DEM_DTC_GROUP_NONE" 1 "DEM_DTC_GROUP_EMISSION_REL" 2 "DEM_DTC_GROUP_POWERTRAIN" 4 "DEM_DTC_GROUP_CHASSIS" 8 "DEM_DTC_GROUP_BODY" 16 "DEM_DTC_GROUP_NETWORK_COM" /end COMPU_VTAB
/begin COMPU_METHOD Dem_DTCSeverity_Verb "" TAB_VERB "%6.3" "-" COMPU_TAB_REF Dem_DTCSeverity_Verb /end COMPU_METHOD
/begin COMPU_VTAB Dem_DTCSeverity_Verb "" TAB_VERB 4 0 "DEM_SEVERITY_NO_SEVERITY" 32 "DEM_SEVERITY_MAINTENANCE_ONLY" 64 "DEM_SEVERITY_CHECK_AT_NEXT_HALT" 128 "DEM_SEVERITY_CHECK_IMMEDIATELY" /end COMPU_VTAB
/begin COMPU_METHOD DFCDFP_Verb "" TAB_VERB "%6.3" "-" COMPU_TAB_REF DFCDFP_Verb /end COMPU_METHOD
/begin COMPU_VTAB DFCDFP_Verb "" TAB_VERB 763 0 "NoEntry" 1 "DFC_AltIOACGFailr" 2 "DFC_AltIOACGHiVltg" 3 "DFC_AltIOACGLoVltg" 4 "DFC_AltIOACGTHi" 5 "DFC_AltIODConnACG" 6 "DFC_BattUHiFailr" 7 "DFC_BattULoFailr" 8 "DFC_BrkBstPDriftHiErr" 9 "DFC_BrkBstPDriftLoErr" 10 "DFC_BrkBstPSnsrStuck" 11 "DFC_BrkMnSwtContOn" 12 "DFC_BrkMnSwtNotStp" 13 "DFC_BrkNpl" 14 "DFC_BrkRdntSwtContOn" 15 "DFC_BrkRdntSwtNotStp" 16 "DFC_Clth3ONStuck" 17 "DFC_Clth4OFFStuck" 18 "DFC_ClthOFFStuck" 19 "DFC_ClthONStuck" 20 "DFC_ClthStkFailInfo" 21 "DFC_ComACFailInfo" 22 "DFC_ComATFTValErr" 23 "DFC_ComATMILReq" 24 "DFC_ComAYCAChksum" 25 "DFC_ComAYCARingCnt" 26 "DFC_ComAYCATOut" 27 "DFC_ComAYCDChkSum" 28 "DFC_ComAYCDTOut" 29 "DFC_ComAYCFChksum" 30 "DFC_ComAYCFRingCnt" 31 "DFC_ComAYCFTOut" 32 "DFC_ComAYCGChksum" 33 "DFC_ComAYCGRingCnt" 34 "DFC_ComAYCGTOut" 35 "DFC_ComAYCIChkSum" 36 "DFC_ComAYCIRingCnt" 37 "DFC_ComAYCITOut" 38 "DFC_ComBCM1ChkSum" 39 "DFC_ComBCM1RingCnt" 40 "DFC_ComBCM1TOut" 41 "DFC_ComCANABusOffErr" 42 "DFC_ComCANBBusOffErr" 43 "DFC_ComCANCBusOffErr" 44 "DFC_ComCGW1ChkSum" 45 "DFC_ComCGW1RingCnt" 46 "DFC_ComCGW1TOut" 47 "DFC_ComConvBoostErr" 48 "DFC_ComConvSlipErr" 49 "DFC_ComEAT10Chksum" 50 "DFC_ComEAT10RingCnt" 51 "DFC_ComEAT10TOut" 52 "DFC_ComEAT11ChkSum" 53 "DFC_ComEAT11RingCnt" 54 "DFC_ComEAT11TOut" 55 "DFC_ComEAT12ChkSum" 56 "DFC_ComEAT12RingCnt" 57 "DFC_ComEAT12TOut" 58 "DFC_ComEAT13ChkSum" 59 "DFC_ComEAT13RingCnt" 60 "DFC_ComEAT13TOut" 61 "DFC_ComEAT1Chksum" 62 "DFC_ComEAT1RingCnt" 63 "DFC_ComEAT1TOut" 64 "DFC_ComEAT2ChkSum" 65 "DFC_ComEAT2RingCnt" 66 "DFC_ComEAT2TOut" 67 "DFC_ComEAT4ChkSum" 68 "DFC_ComEAT4RingCnt" 69 "DFC_ComEAT4TOut" 70 "DFC_ComEAT6Chksum" 71 "DFC_ComEAT6RingCnt" 72 "DFC_ComEAT6TOut" 73 "DFC_ComEAT7Chksum" 74 "DFC_ComEAT7RingCnt" 75 "DFC_ComEAT7TOut" 76 "DFC_ComEAT8Chksum" 77 "DFC_ComEAT8RingCnt" 78 "DFC_ComEAT8TOut" 79 "DFC_ComEATAChksum" 80 "DFC_ComEATARingCnt" 81 "DFC_ComEATATOut" 82 "DFC_ComEATBChkSum" 83 "DFC_ComEATBRingCnt" 84 "DFC_ComEATBTOut" 85 "DFC_ComEATCChksum" 86 "DFC_ComEATCRingCnt" 87 "DFC_ComEATCTOut" 88 "DFC_ComEBBAChksum" 89 "DFC_ComEBBARingCnt" 90 "DFC_ComEBBATOut" 91 "DFC_ComEPS1Chksum" 92 "DFC_ComEPS1RingCnt" 93 "DFC_ComEPS1TOut" 94 "DFC_ComEngCanRxErr" 95 "DFC_ComGrvySnsrErr" 96 "DFC_ComGwIMG1ChkSum" 97 "DFC_ComGwIMG1RingCnt" 98 "DFC_ComGwIMG1TOut" 99 "DFC_ComGwIMG3ChkSum" 100 "DFC_ComGwIMG3RingCnt" 101 "DFC_ComGwIMG3TOut" 102 "DFC_ComGwIMG4ChkSum" 103 "DFC_ComGwIMG4RingCnt" 104 "DFC_ComGwIMG4TOut" 105 "DFC_ComGwIMG5ChkSum" 106 "DFC_ComGwIMG5RingCnt" 107 "DFC_ComGwIMG5TOut" 108 "DFC_ComGwIMG6ChkSum" 109 "DFC_ComGwIMG6RingCnt" 110 "DFC_ComGwIMG6TOut" 111 "DFC_ComIDASBChksum" 112 "DFC_ComIDASBRingCnt" 113 "DFC_ComIDASBTOut" 114 "DFC_ComIMGMILReq" 115 "DFC_ComISSPrms" 116 "DFC_ComMETAChksum" 117 "DFC_ComMETARingCnt" 118 "DFC_ComMETATOut" 119 "DFC_ComMETCChksum" 120 "DFC_ComMETCRingCnt" 121 "DFC_ComMETCTOut" 122 "DFC_ComMETDChksum" 123 "DFC_ComMETDRingCnt" 124 "DFC_ComMETDTOut" 125 "DFC_ComMETE2Chksum" 126 "DFC_ComMETE2RingCnt" 127 "DFC_ComMETE2TOut" 128 "DFC_ComMETFChksum" 129 "DFC_ComMETFRingCnt" 130 "DFC_ComMETFTOut" 131 "DFC_ComMETGChksum" 132 "DFC_ComMETGRingCnt" 133 "DFC_ComMETGTOut" 134 "DFC_ComMETH2Chksum" 135 "DFC_ComMETH2RingCnt" 136 "DFC_ComMETH2TOut" 137 "DFC_ComMETHChksum" 138 "DFC_ComMETHRingCnt" 139 "DFC_ComMETHTOut" 140 "DFC_ComMETIChksum" 141 "DFC_ComMETIRingCnt" 142 "DFC_ComMETITOut" 143 "DFC_ComMETKChksum" 144 "DFC_ComMETKRingCnt" 145 "DFC_ComMETKTOut" 146 "DFC_ComMETLChksum" 147 "DFC_ComMETLRingCnt" 148 "DFC_ComMETLTOut" 149 "DFC_ComMETMChksum" 150 "DFC_ComMETMRingCnt" 151 "DFC_ComMETMTOut" 152 "DFC_ComMETNChksum" 153 "DFC_ComMETNRingCnt" 154 "DFC_ComMETNTOut" 155 "DFC_ComMtrCom" 156 "DFC_ComPCUChkSum" 157 "DFC_ComPCURingCnt" 158 "DFC_ComPCUTOut" 159 "DFC_ComSRSAChksum" 160 "DFC_ComSRSARingCnt" 161 "DFC_ComSRSATOut" 162 "DFC_ComSRSBChksum" 163 "DFC_ComSRSBRingCnt" 164 "DFC_ComSRSBTOut" 165 "DFC_ComSRSChksum" 166 "DFC_ComSRSErr" 167 "DFC_ComSRSRingCnt" 168 "DFC_ComSRSTOut" 169 "DFC_ComVehSpdPndFltTCU" 170 "DFC_EbsChartcCurrErr" 171 "DFC_EbsSelfDiagErr" 172 "DFC_GbxCANDigPlausErr" 173 "DFC_GbxNPos1SRCMax" 174 "DFC_GbxNPos1SRCMin" 175 "DFC_GbxNPos2SRCMax" 176 "DFC_GbxNPos2SRCMin" 177 "DFC_GbxNPosAlvChk" 178 "DFC_GbxNPosSyncErr" 179 "DFC_HEGOS2B1HtrPsMax" 180 "DFC_HEGOS2B1HtrPsMin" 181 "DFC_HEGOS2B1HtrPsSig" 182 "DFC_LinCSErrACG" 183 "DFC_LinCSErrEBS" 184 "DFC_LinHdrTimeoutErrACG" 185 "DFC_LinHdrTimeoutErrEBS" 186 "DFC_LinMsgTimeoutErrACG" 187 "DFC_LinMsgTimeoutErrEBS" 188 "DFC_LinNoStrtComErr" 189 "DFC_MisfDetVWhlFrntLeOORHi" 190 "DFC_MisfDetVWhlFrntLeRatyHi" 191 "DFC_MisfDetVWhlFrntLeRatyLo" 192 "DFC_MisfDetVWhlFrntLeStuck" 193 "DFC_MisfDetVWhlFrntRiOORHi" 194 "DFC_MisfDetVWhlFrntRiRatyHi" 195 "DFC_MisfDetVWhlFrntRiRatyLo" 196 "DFC_MisfDetVWhlFrntRiStuck" 197 "DFC_MisfDetVWhlReLeOORHi" 198 "DFC_MisfDetVWhlReLeRatyHi" 199 "DFC_MisfDetVWhlReLeRatyLo" 200 "DFC_MisfDetVWhlReLeStuck" 201 "DFC_MisfDetVWhlReRiOORHi" 202 "DFC_MisfDetVWhlReRiRatyHi" 203 "DFC_MisfDetVWhlReRiRatyLo" 204 "DFC_MisfDetVWhlReRiStuck" 205 "DFC_MisfDetdVWhlFrntLePlaus" 206 "DFC_MisfDetdVWhlFrntRiPlaus" 207 "DFC_MisfDetdVWhlReLePlaus" 208 "DFC_MisfDetdVWhlReRiPlaus" 209 "DFC_PEnvSigRngMax" 210 "DFC_PEnvSigRngMin" 211 "DFC_StmFault" 212 "DFC_StrtCtOffPth" 213 "DFC_StrtCtlErr" 214 "DFC_StrtFault" 215 "DFC_StrtLckJudg1" 216 "DFC_StrtLckJudg2" 217 "DFC_StrtOL" 218 "DFC_StrtOL2" 219 "DFC_StrtSCB" 220 "DFC_StrtSCB2" 221 "DFC_StrtSCG" 222 "DFC_StrtSCG2" 223 "DFC_StrtStkRly1" 224 "DFC_StrtStkRly2" 225 "DFC_TEVEmax" 226 "DFC_TEVEmin" 227 "DFC_TEVEsig" 228 "DFC_VehVAllPlaus" 229 "DFC_VehVNCSnsrElecFailr" 230 "DFC_VehVPlausCan" 231 "DFC_VehVPlausFco" 232 "DFC_VehVPlausPwr" 233 "DFC_VehVPlausV2N" 234 "DFC_VehVSpdSnsrAElecFailr" 235 "DFC_VehVSpdSnsrBElecFailr" 236 "DFC_ClthMax" 237 "DFC_IgnClPs_DevComErr" 238 "DFC_IgnClPs_LineOl_0" 239 "DFC_IgnClPs_LineOl_1" 240 "DFC_IgnClPs_LineOl_2" 241 "DFC_IgnClPs_LineOl_3" 242 "DFC_IgnClPs_LineScb_0" 243 "DFC_IgnClPs_LineScb_1" 244 "DFC_IgnClPs_LineScb_2" 245 "DFC_IgnClPs_LineScb_3" 246 "DFC_IgnClPs_LineScg_0" 247 "DFC_IgnClPs_LineScg_1" 248 "DFC_IgnClPs_LineScg_2" 249 "DFC_IgnClPs_LineScg_3" 250 "DFC_UEGOASICS1B1" 251 "DFC_UEGOOLIPES1B1" 252 "DFC_UEGOOLRES1B1" 253 "DFC_UEGOSCBS1B1" 254 "DFC_UEGOSCGS1B1" 255 "DFC_UEGOSPIS1B1" 256 "DFC_UEGOSnsrS1B1" 257 "DFC_UegoOlApesS1B1" 258 "DFC_UegoOlRCmpS1B1" 259 "DFC_AirCCmprOL" 260 "DFC_AirCCmprOvrTemp" 261 "DFC_AirCCmprSCB" 262 "DFC_AirCCmprSCG" 263 "DFC_AltErr" 264 "DFC_BattUSRCMax" 265 "DFC_BattUSRCMin" 266 "DFC_ComChksTCU1" 267 "DFC_ComChksTCU11" 268 "DFC_ComChksTCU12" 269 "DFC_ComChksTCU13" 270 "DFC_ComChksTCU2" 271 "DFC_ComChksTCU3" 272 "DFC_ComChksTCU4" 273 "DFC_ComCntTCU1" 274 "DFC_ComCntTCU11" 275 "DFC_ComCntTCU12" 276 "DFC_ComCntTCU13" 277 "DFC_ComCntTCU2" 278 "DFC_ComCntTCU3" 279 "DFC_ComCntTCU4" 280 "DFC_ComTOutTCU01" 281 "DFC_ComTOutTCU02" 282 "DFC_ComTOutTCU1" 283 "DFC_ComTOutTCU11" 284 "DFC_ComTOutTCU12" 285 "DFC_ComTOutTCU13" 286 "DFC_ComTOutTCU14" 287 "DFC_ComTOutTCU2" 288 "DFC_ComTOutTCU3" 289 "DFC_ComTOutTCU4" 290 "DFC_DevLibBattUHi" 291 "DFC_DevLibBattULo" 292 "DFC_FanDIOOL_0" 293 "DFC_FanDIOOL_1" 294 "DFC_FanDIOOvrTemp_0" 295 "DFC_FanDIOOvrTemp_1" 296 "DFC_FanDIOSCB_0" 297 "DFC_FanDIOSCB_1" 298 "DFC_FanDIOSCG_0" 299 "DFC_FanDIOSCG_1" 300 "DFC_MRlyDcOL" 301 "DFC_MRlyDcSCB" 302 "DFC_MRlyDcSCG" 303 "DFC_PSPOL" 304 "DFC_PSPOvrTemp" 305 "DFC_PSPSCB" 306 "DFC_PSPSCG" 307 "DFC_T50Err" 308 "DFC_ThrVlvLoBattB1" 309 "DFC_VehVPhysRngHi" 310 "DFC_VehVSclOutOL" 311 "DFC_VehVSclOutOT" 312 "DFC_VehVSclOutSCB" 313 "DFC_VehVSclOutSCG" 314 "DFC_VehVSnsrARngHi" 315 "DFC_VehVSnsrBRngHi" 316 "DFC_VehVSpdRtyDiag" 317 "DFC_VehVWhlErr" 318 "DFC_ACEvpTSRCMax" 319 "DFC_ACEvpTSRCMin" 320 "DFC_AirCClntPAnaSRCMax" 321 "DFC_AirCClntPAnaSRCMin" 322 "DFC_AirCSwtNpl" 323 "DFC_AirCSwtSig" 324 "DFC_Brk" 325 "DFC_BrkSig" 326 "DFC_ClthSig" 327 "DFC_HLSDemOvhtEngLim" 328 "DFC_OilPNpl" 329 "DFC_PIntkVUsLineHiB1" 330 "DFC_PIntkVUsLineLoB1" 331 "DFC_VehVPhysRngLo" 332 "DFC_VehVSigCan" 333 "DFC_VehVSigCanSafe" 334 "DFC_VlvLftFbOilPSnsrIntk11SRCMax" 335 "DFC_VlvLftFbOilPSnsrIntk11SRCMin" 336 "DFC_ClthNpl" 337 "DFC_EV1max" 338 "DFC_EV1min" 339 "DFC_EV1sig" 340 "DFC_EV2max" 341 "DFC_EV2min" 342 "DFC_EV2sig" 343 "DFC_EV3max" 344 "DFC_EV3min" 345 "DFC_EV3sig" 346 "DFC_EV4max" 347 "DFC_EV4min" 348 "DFC_EV4sig" 349 "DFC_GbxPNPosnDrvCdn" 350 "DFC_GbxPNPosnPlausy" 351 "DFC_PEnvCcMax" 352 "DFC_PEnvCcMin" 353 "DFC_PEnvRngChkMax" 354 "DFC_PEnvRngChkMin" 355 "DFC_PEnvSnsrPlaus" 356 "DFC_UEGOHeatrPsS1B1Max" 357 "DFC_UEGOHeatrPsS1B1Min" 358 "DFC_UEGOHeatrPsS1B1Sig" 359 "DFC_UEGOHeatrRlyPsOLS1B1" 360 "DFC_UEGOHeatrRlyPsSCBS1B1" 361 "DFC_UEGOHeatrRlyPsSCGS1B1" 362 "DFC_KnDetSens1PortAMax" 363 "DFC_KnDetSens1PortAMin" 364 "DFC_KnDetSens1PortBMax" 365 "DFC_KnDetSens1PortBMin" 366 "DFC_Clth2ONStuck" 367 "DFC_Clth2ONStuckLdc" 368 "DFC_Clth3ONStuckLdc" 369 "DFC_Clth3ONStuckPostDrv" 370 "DFC_Clth4ONStuck" 371 "DFC_Clth4ONStuckLdc" 372 "DFC_ComDLCTCU01" 373 "DFC_ComDLCTCU02" 374 "DFC_ComDLCTCU1" 375 "DFC_ComDLCTCU11" 376 "DFC_ComDLCTCU12" 377 "DFC_ComDLCTCU13" 378 "DFC_ComDLCTCU14" 379 "DFC_ComDLCTCU2" 380 "DFC_ComDLCTCU3" 381 "DFC_ComDLCTCU4" 382 "DFC_EVX" 383 "DFC_EbsSocFlt" 384 "DFC_I14229VINErr" 385 "DFC_LLRKHmax" 386 "DFC_LLRKHmin" 387 "DFC_LLRmax" 388 "DFC_LLRmin" 389 "DFC_RoughRoad" 390 "DFC_SiaEEPRdErr" 391 "DFC_SiaEEPWrngCod" 392 "DFC_UegoDummy" 393 "DFC_BusDiagCANAPPLBusOff" 394 "DFC_BusDiagCANCANCBusOff" 395 "DFC_BusDiagCANVEHICLEBusOff" 396 "DFC_RBA_IODIAGPWR_rba_IoExtCy329_SignalVltSply_0" 397 "DFC_RBA_IODIAGPWR_rba_IoExtCy329_SignalVltSply_0OT" 398 "DFC_RBA_IODIAGPWR_rba_IoExtCy329_SignalVltSply_0OV" 399 "DFC_RBA_IODIAGPWR_rba_IoExtCy329_SignalVltSply_0SCG" 400 "DFC_RBA_IODIAGPWR_rba_IoExtCy329_SignalVltSply_0UV" 401 "DFC_RBA_IODIAGPWR_rba_IoExtCy329_SignalVltSply_1" 402 "DFC_RBA_IODIAGPWR_rba_IoExtCy329_SignalVltSply_1OT" 403 "DFC_RBA_IODIAGPWR_rba_IoExtCy329_SignalVltSply_1OV" 404 "DFC_RBA_IODIAGPWR_rba_IoExtCy329_SignalVltSply_1SCG" 405 "DFC_RBA_IODIAGPWR_rba_IoExtCy329_SignalVltSply_1UV" 406 "DFC_RBA_IODIAGPWR_rba_IoExtCy329_SignalVltSply_2" 407 "DFC_RBA_IODIAGPWR_rba_IoExtCy329_SignalVltSply_2OT" 408 "DFC_RBA_IODIAGPWR_rba_IoExtCy329_SignalVltSply_2OV" 409 "DFC_RBA_IODIAGPWR_rba_IoExtCy329_SignalVltSply_2SCG" 410 "DFC_RBA_IODIAGPWR_rba_IoExtCy329_SignalVltSply_2UV" 411 "DFC_CAN_E_TIMEOUT" 412 "DFC_LIN_E_TIMEOUT" 413 "DFC_MRlyOL" 414 "DFC_MRlySCB" 415 "DFC_MRlySCG" 416 "DFC_rba_MultiStackTrace_Threshold" 417 "DFC_BSWM_E_ACTION_FAILED" 418 "DFC_BSWM_E_INTRPTQUEUE_FULL" 419 "DFC_RBA_IOEXTLIB_KEEPALIVE_DRV" 420 "DFC_RBA_IOEXTLIB_KEEPALIVE_INI" 421 "DFC_rba_IoSigRtc_StopCounter" 422 "DFC_rba_MRly_Diag_Stk_Event" 423 "DFC_rba_MemDiag_MemReadErr" 424 "DFC_rba_MemDiag_MemWrErr" 425 "DFC_rba_SyC_IrrSwOffTrigEngRun_Event" 426 "DFC_rba_T15_Diag_ComInVld_Event" 427 "DFC_rba_T15_Diag_ComOff_HwOn_Event" 428 "DFC_rba_T15_Diag_ComOn_HwOff_Event" 429 "DFC_AppAllSnsrDfct" 430 "DFC_BattUStdbyDiaOL" 431 "DFC_BigLeakIntkMnfldEmiInfl" 432 "DFC_BrkMnSwtContOnWarnLmp" 433 "DFC_BrkMnSwtNotStpWarnLmp" 434 "DFC_BrkRdntSwtContOnWarnLmp" 435 "DFC_BrkRdntSwtNotStpWarnLmp" 436 "DFC_CEngDsTColdStrtMax" 437 "DFC_CEngDsTColdStrtMin" 438 "DFC_CEngDsTImps" 439 "DFC_CEngDsTPlausLSC" 440 "DFC_CEngDsTPlausSTC" 441 "DFC_CEngDsTSRCMax" 442 "DFC_CEngDsTSRCMin" 443 "DFC_CEngDsTSig" 444 "DFC_CEngUsTSRCMax" 445 "DFC_CEngUsTSRCMin" 446 "DFC_DCDCFltDet" 447 "DFC_DKRSA" 448 "DFC_DKVSmax" 449 "DFC_DKnpl" 450 "DFC_DSSmax" 451 "DFC_DSTTI" 452 "DFC_DSUmax" 453 "DFC_EGRVlvOL" 454 "DFC_EGRVlvSCB" 455 "DFC_EGRVlvSCG" 456 "DFC_EGSDUS2B1LtrDly" 457 "DFC_EGSDUS2B1LtrPT1" 458 "DFC_EGSDUS2B1RtlDly" 459 "DFC_EGSDUS2B1RtlPT1" 460 "DFC_EGSDUS2B1TarLean" 461 "DFC_EGSDUS2B1TarRich" 462 "DFC_ETAKHLmax" 463 "DFC_ETAKHTmax" 464 "DFC_EngICO" 465 "DFC_EngPrtOvrSpdMon" 466 "DFC_EpmCaSI1ErrSig" 467 "DFC_EpmCaSI1NoSig" 468 "DFC_EpmCaSI1OfsErr" 469 "DFC_EpmCrSErrSig" 470 "DFC_EpmCrSNoSig" 471 "DFC_EtaEngIdleNonCsers" 472 "DFC_EtaEngPtlNonCsers" 473 "DFC_FRAmax" 474 "DFC_FRAmin" 475 "DFC_GbxRvsSwtStk" 476 "DFC_HDRmax" 477 "DFC_HEGOS2B1ElecMax" 478 "DFC_HEGOS2B1ElecMin" 479 "DFC_HEGOS2B1ElecSig" 480 "DFC_HEGOS2B1HtgNpl" 481 "DFC_IntkAirTIntkMnfldCrssMax" 482 "DFC_IntkAirTIntkMnfldCrssMin" 483 "DFC_IntkAirTIntkMnfldHSCMax" 484 "DFC_IntkAirTIntkMnfldImps" 485 "DFC_IntkAirTIntkMnfldPRCMax" 486 "DFC_IntkAirTIntkMnfldPRCMin" 487 "DFC_IntkAirTIntkMnfldSRCMax" 488 "DFC_IntkAirTIntkMnfldSRCMin" 489 "DFC_IntkAirTIntkMnfldSTC" 490 "DFC_KS1max" 491 "DFC_KS1min" 492 "DFC_LMmax" 493 "DFC_LZSRnpl" 494 "DFC_LamDynDiagS1B1" 495 "DFC_LeakIntkMnfldEmiInfl" 496 "DFC_MD00max" 497 "DFC_MDBmax" 498 "DFC_MDCat" 499 "DFC_MDCatCrit" 500 "DFC_MDCatCurr" 501 "DFC_MDCyl_0" 502 "DFC_MDCyl_1" 503 "DFC_MDCyl_2" 504 "DFC_MDCyl_3" 505 "DFC_MDEmi" 506 "DFC_MDEmiStrt" 507 "DFC_MDFco" 508 "DFC_MDMpl" 509 "DFC_MDSegTiAdpn" 510 "DFC_MDmax" 511 "DFC_MOXEMM_SMU_ALM0_0" 512 "DFC_MOXEMM_SMU_ALM0_1" 513 "DFC_MOXEMM_SMU_ALM0_10" 514 "DFC_MOXEMM_SMU_ALM0_11" 515 "DFC_MOXEMM_SMU_ALM0_13" 516 "DFC_MOXEMM_SMU_ALM0_14" 517 "DFC_MOXEMM_SMU_ALM0_2" 518 "DFC_MOXEMM_SMU_ALM0_22" 519 "DFC_MOXEMM_SMU_ALM0_23" 520 "DFC_MOXEMM_SMU_ALM0_4" 521 "DFC_MOXEMM_SMU_ALM0_5" 522 "DFC_MOXEMM_SMU_ALM0_7" 523 "DFC_MOXEMM_SMU_ALM0_8" 524 "DFC_MOXEMM_SMU_ALM10_16" 525 "DFC_MOXEMM_SMU_ALM10_17" 526 "DFC_MOXEMM_SMU_ALM10_21" 527 "DFC_MOXEMM_SMU_ALM11_0" 528 "DFC_MOXEMM_SMU_ALM11_1" 529 "DFC_MOXEMM_SMU_ALM11_2" 530 "DFC_MOXEMM_SMU_ALM11_3" 531 "DFC_MOXEMM_SMU_ALM11_4" 532 "DFC_MOXEMM_SMU_ALM11_5" 533 "DFC_MOXEMM_SMU_ALM11_8" 534 "DFC_MOXEMM_SMU_ALM11_9" 535 "DFC_MOXEMM_SMU_ALM1_0" 536 "DFC_MOXEMM_SMU_ALM1_1" 537 "DFC_MOXEMM_SMU_ALM1_10" 538 "DFC_MOXEMM_SMU_ALM1_11" 539 "DFC_MOXEMM_SMU_ALM1_13" 540 "DFC_MOXEMM_SMU_ALM1_14" 541 "DFC_MOXEMM_SMU_ALM1_2" 542 "DFC_MOXEMM_SMU_ALM1_22" 543 "DFC_MOXEMM_SMU_ALM1_23" 544 "DFC_MOXEMM_SMU_ALM1_4" 545 "DFC_MOXEMM_SMU_ALM1_5" 546 "DFC_MOXEMM_SMU_ALM1_7" 547 "DFC_MOXEMM_SMU_ALM1_8" 548 "DFC_MOXEMM_SMU_ALM21_0" 549 "DFC_MOXEMM_SMU_ALM21_16" 550 "DFC_MOXEMM_SMU_ALM21_3" 551 "DFC_MOXEMM_SMU_ALM2_1" 552 "DFC_MOXEMM_SMU_ALM2_10" 553 "DFC_MOXEMM_SMU_ALM2_11" 554 "DFC_MOXEMM_SMU_ALM2_13" 555 "DFC_MOXEMM_SMU_ALM2_14" 556 "DFC_MOXEMM_SMU_ALM2_22" 557 "DFC_MOXEMM_SMU_ALM2_23" 558 "DFC_MOXEMM_SMU_ALM2_4" 559 "DFC_MOXEMM_SMU_ALM2_5" 560 "DFC_MOXEMM_SMU_ALM2_7" 561 "DFC_MOXEMM_SMU_ALM2_8" 562 "DFC_MOXEMM_SMU_ALM6_0" 563 "DFC_MOXEMM_SMU_ALM6_11" 564 "DFC_MOXEMM_SMU_ALM6_12" 565 "DFC_MOXEMM_SMU_ALM6_14" 566 "DFC_MOXEMM_SMU_ALM6_15" 567 "DFC_MOXEMM_SMU_ALM6_17" 568 "DFC_MOXEMM_SMU_ALM6_18" 569 "DFC_MOXEMM_SMU_ALM6_20" 570 "DFC_MOXEMM_SMU_ALM6_21" 571 "DFC_MOXEMM_SMU_ALM6_25" 572 "DFC_MOXEMM_SMU_ALM6_4" 573 "DFC_MOXEMM_SMU_ALM6_5" 574 "DFC_MOXEMM_SMU_ALM6_7" 575 "DFC_MOXEMM_SMU_ALM6_8" 576 "DFC_MOXEMM_SMU_ALM7_1" 577 "DFC_MOXEMM_SMU_ALM7_12" 578 "DFC_MOXEMM_SMU_ALM7_13" 579 "DFC_MOXEMM_SMU_ALM7_14" 580 "DFC_MOXEMM_SMU_ALM7_15" 581 "DFC_MOXEMM_SMU_ALM7_16" 582 "DFC_MOXEMM_SMU_ALM7_17" 583 "DFC_MOXEMM_SMU_ALM7_2" 584 "DFC_MOXEMM_SMU_ALM7_20" 585 "DFC_MOXEMM_SMU_ALM7_25" 586 "DFC_MOXEMM_SMU_ALM7_26" 587 "DFC_MOXEMM_SMU_ALM7_28" 588 "DFC_MOXEMM_SMU_ALM7_29" 589 "DFC_MOXEMM_SMU_ALM7_30" 590 "DFC_MOXEMM_SMU_ALM7_31" 591 "DFC_MOXEMM_SMU_ALM8_0" 592 "DFC_MOXEMM_SMU_ALM8_1" 593 "DFC_MOXEMM_SMU_ALM8_10" 594 "DFC_MOXEMM_SMU_ALM8_11" 595 "DFC_MOXEMM_SMU_ALM8_12" 596 "DFC_MOXEMM_SMU_ALM8_16" 597 "DFC_MOXEMM_SMU_ALM8_18" 598 "DFC_MOXEMM_SMU_ALM8_2" 599 "DFC_MOXEMM_SMU_ALM8_3" 600 "DFC_MOXEMM_SMU_ALM8_31" 601 "DFC_MOXEMM_SMU_ALM8_4" 602 "DFC_MOXEMM_SMU_ALM9_0" 603 "DFC_MOXEMM_SMU_ALM9_15" 604 "DFC_MOXEMM_SMU_ALM9_3" 605 "DFC_MoCADCNTP" 606 "DFC_MoCADCTst" 607 "DFC_MoCSOPICO" 608 "DFC_MoFAPP" 609 "DFC_MoFAirFilgPrdc" 610 "DFC_MoFAirFlCtOffPfi" 611 "DFC_MoFAirFlCylPfi" 612 "DFC_MoFAirFlIn" 613 "DFC_MoFAirFlMixCtlPfiChkAirFl" 614 "DFC_MoFAirFlMixCtlPfiChkCtrl" 615 "DFC_MoFAirFlMode" 616 "DFC_MoFESpd" 617 "DFC_MoFIACo" 618 "DFC_MoFICOL1" 619 "DFC_MoFICOL2" 620 "DFC_MoFStrt" 621 "DFC_MoFTrqCmp" 622 "DFC_MoFTrqCmpMax" 623 "DFC_MoFTrqCmpMin" 624 "DFC_MoFVarPostBldSel" 625 "DFC_MoXEMMHwLTMCUFW" 626 "DFC_MoXEMMHwLTMonBIST" 627 "DFC_MoXEMMHwLTRegMonTest" 628 "DFC_MoXEMMHwLTStbySMUAlvTest" 629 "DFC_MoXEMMHwLTTempSens" 630 "DFC_MoXEMMHwLTUCBCfg" 631 "DFC_OCWDAABEActv" 632 "DFC_OCWDACom" 633 "DFC_OCWDAErrPin" 634 "DFC_OCWDAOvrVltg" 635 "DFC_ORAmax" 636 "DFC_ORAmin" 637 "DFC_PLLSUmax" 638 "DFC_PLLSUmin" 639 "DFC_PSR1max" 640 "DFC_PSRBmax" 641 "DFC_PSRBmin" 642 "DFC_PSRPmax" 643 "DFC_PSRPmin" 644 "DFC_PSRPsig" 645 "DFC_PSRmax" 646 "DFC_PUmax" 647 "DFC_P_VSE11_OL" 648 "DFC_P_VSE11_SCB" 649 "DFC_P_VSE11_SCG" 650 "DFC_PhyHighAPP1" 651 "DFC_PhyHighAPP2" 652 "DFC_PhyLowAPP1" 653 "DFC_PhyLowAPP2" 654 "DFC_SRCHighAPP1" 655 "DFC_SRCHighAPP2" 656 "DFC_SRCLowAPP1" 657 "DFC_SRCLowAPP2" 658 "DFC_SSpMon2" 659 "DFC_SWReset_0" 660 "DFC_SWReset_1" 661 "DFC_SWReset_2" 662 "DFC_SyncAPP" 663 "DFC_TAmax_Dummy" 664 "DFC_TKAEmax" 665 "DFC_TKAEmin" 666 "DFC_TKARmax" 667 "DFC_TKARnpl" 668 "DFC_TMmax_Dummy" 669 "DFC_TUMmax_Dummy" 670 "DFC_TWCDPriCatB1" 671 "DFC_ThrVlvClsdPosnFirstOffsLrnImpoB1" 672 "DFC_ThrVlvClsdPosnOffsLrnImpoB1" 673 "DFC_ThrVlvClsdPosnOffsLrnMaxB1" 674 "DFC_ThrVlvClsdPosnOffsLrnMinB1" 675 "DFC_ThrVlvCtrlDeB1" 676 "DFC_ThrVlvDycB1" 677 "DFC_ThrVlvLimpAirPosnMaxAbsltDriftB1" 678 "DFC_ThrVlvLimpAirPosnMaxB1" 679 "DFC_ThrVlvLimpAirPosnMaxRelDriftB1" 680 "DFC_ThrVlvLimpAirPosnMinB1" 681 "DFC_ThrVlvOpenLoadB1" 682 "DFC_ThrVlvOpenSprgB1" 683 "DFC_ThrVlvOpenSprgSprdB1" 684 "DFC_ThrVlvOpenSprgTwnB1" 685 "DFC_ThrVlvOverTB1" 686 "DFC_ThrVlvRetSprgB1" 687 "DFC_ThrVlvRetSprgSprdB1" 688 "DFC_ThrVlvRetSprgTwnB1" 689 "DFC_ThrVlvSens1MaxB1" 690 "DFC_ThrVlvSens1NplB1" 691 "DFC_ThrVlvSens2MaxB1" 692 "DFC_ThrVlvSens2MinB1" 693 "DFC_ThrVlvSens2NplB1" 694 "DFC_ThrVlvShoCircB1" 695 "DFC_ThrVlvSpiErrB1" 696 "DFC_ThrvlvSens1MinB1" 697 "DFC_TiOffTBasdChkFast" 698 "DFC_TiOffTBasdChkSlow" 699 "DFC_UEGOHeatrCtlS1B1" 700 "DFC_UEGOSnsrMntdS1B1" 701 "DFC_VehVSig" 702 "DFC_VlvLftFbSwtIntk11SpclFail" 703 "DFC_VlvLftFbSwtIntk11StdFail" 704 "DFP_AAA" 705 "DFP_AGRE" 706 "DFP_AGRL" 707 "DFP_DK" 708 "DFP_DK1P" 709 "DFP_DK2P" 710 "DFP_DKVS" 711 "DFP_DSS" 712 "DFP_DSU" 713 "DFP_DVEE" 714 "DFP_DVEF" 715 "DFP_DVEFO" 716 "DFP_DVEL" 717 "DFP_DVEN" 718 "DFP_DVER" 719 "DFP_DVEU" 720 "DFP_DVEUB" 721 "DFP_DVEUW" 722 "DFP_DYLSU" 723 "DFP_FP1P" 724 "DFP_FP2P" 725 "DFP_FRA" 726 "DFP_HSH" 727 "DFP_HSHE" 728 "DFP_KAT" 729 "DFP_KPE" 730 "DFP_KS1" 731 "DFP_LASH" 732 "DFP_LLR" 733 "DFP_LLRKH" 734 "DFP_LM" 735 "DFP_LSH" 736 "DFP_LZSR" 737 "DFP_MD" 738 "DFP_ORA" 739 "DFP_PLLSU" 740 "DFP_PS2E" 741 "DFP_PSR" 742 "DFP_PSR1" 743 "DFP_PSRB" 744 "DFP_PSRE" 745 "DFP_PSRP" 746 "DFP_PU" 747 "DFP_PUE" 748 "DFP_PUPL" 749 "DFP_PUR" 750 "DFP_TA" 751 "DFP_TASRCS" 752 "DFP_TASRE" 753 "DFP_TASRPRC" 754 "DFP_TASRR" 755 "DFP_TEVE" 756 "DFP_TM" 757 "DFP_TMCS" 758 "DFP_TME" 759 "DFP_TMP" 760 "DFP_UB" 761 "DFP_VFZ" 762 "DFP_ZZZ" DEFAULT_VALUE "---" /end COMPU_VTAB
/begin COMPU_METHOD DFC_Verb "" TAB_VERB "%6.3" "-" COMPU_TAB_REF DFC_Verb /end COMPU_METHOD
/begin COMPU_VTAB DFC_Verb "" TAB_VERB 704 0 "DFC_Unused" 318 "DFC_ACEvpTSRCMax" 319 "DFC_ACEvpTSRCMin" 320 "DFC_AirCClntPAnaSRCMax" 321 "DFC_AirCClntPAnaSRCMin" 259 "DFC_AirCCmprOL" 260 "DFC_AirCCmprOvrTemp" 261 "DFC_AirCCmprSCB" 262 "DFC_AirCCmprSCG" 322 "DFC_AirCSwtNpl" 323 "DFC_AirCSwtSig" 263 "DFC_AltErr" 1 "DFC_AltIOACGFailr" 2 "DFC_AltIOACGHiVltg" 3 "DFC_AltIOACGLoVltg" 4 "DFC_AltIOACGTHi" 5 "DFC_AltIODConnACG" 429 "DFC_AppAllSnsrDfct" 6 "DFC_BattUHiFailr" 7 "DFC_BattULoFailr" 264 "DFC_BattUSRCMax" 265 "DFC_BattUSRCMin" 430 "DFC_BattUStdbyDiaOL" 431 "DFC_BigLeakIntkMnfldEmiInfl" 324 "DFC_Brk" 8 "DFC_BrkBstPDriftHiErr" 9 "DFC_BrkBstPDriftLoErr" 10 "DFC_BrkBstPSnsrStuck" 11 "DFC_BrkMnSwtContOn" 432 "DFC_BrkMnSwtContOnWarnLmp" 12 "DFC_BrkMnSwtNotStp" 433 "DFC_BrkMnSwtNotStpWarnLmp" 13 "DFC_BrkNpl" 14 "DFC_BrkRdntSwtContOn" 434 "DFC_BrkRdntSwtContOnWarnLmp" 15 "DFC_BrkRdntSwtNotStp" 435 "DFC_BrkRdntSwtNotStpWarnLmp" 325 "DFC_BrkSig" 417 "DFC_BSWM_E_ACTION_FAILED" 418 "DFC_BSWM_E_INTRPTQUEUE_FULL" 393 "DFC_BusDiagCANAPPLBusOff" 394 "DFC_BusDiagCANCANCBusOff" 395 "DFC_BusDiagCANVEHICLEBusOff" 411 "DFC_CAN_E_TIMEOUT" 436 "DFC_CEngDsTColdStrtMax" 437 "DFC_CEngDsTColdStrtMin" 438 "DFC_CEngDsTImps" 439 "DFC_CEngDsTPlausLSC" 440 "DFC_CEngDsTPlausSTC" 443 "DFC_CEngDsTSig" 441 "DFC_CEngDsTSRCMax" 442 "DFC_CEngDsTSRCMin" 444 "DFC_CEngUsTSRCMax" 445 "DFC_CEngUsTSRCMin" 366 "DFC_Clth2ONStuck" 367 "DFC_Clth2ONStuckLdc" 16 "DFC_Clth3ONStuck" 368 "DFC_Clth3ONStuckLdc" 369 "DFC_Clth3ONStuckPostDrv" 17 "DFC_Clth4OFFStuck" 370 "DFC_Clth4ONStuck" 371 "DFC_Clth4ONStuckLdc" 236 "DFC_ClthMax" 336 "DFC_ClthNpl" 18 "DFC_ClthOFFStuck" 19 "DFC_ClthONStuck" 326 "DFC_ClthSig" 20 "DFC_ClthStkFailInfo" 21 "DFC_ComACFailInfo" 22 "DFC_ComATFTValErr" 23 "DFC_ComATMILReq" 24 "DFC_ComAYCAChksum" 25 "DFC_ComAYCARingCnt" 26 "DFC_ComAYCATOut" 27 "DFC_ComAYCDChkSum" 28 "DFC_ComAYCDTOut" 29 "DFC_ComAYCFChksum" 30 "DFC_ComAYCFRingCnt" 31 "DFC_ComAYCFTOut" 32 "DFC_ComAYCGChksum" 33 "DFC_ComAYCGRingCnt" 34 "DFC_ComAYCGTOut" 35 "DFC_ComAYCIChkSum" 36 "DFC_ComAYCIRingCnt" 37 "DFC_ComAYCITOut" 38 "DFC_ComBCM1ChkSum" 39 "DFC_ComBCM1RingCnt" 40 "DFC_ComBCM1TOut" 41 "DFC_ComCANABusOffErr" 42 "DFC_ComCANBBusOffErr" 43 "DFC_ComCANCBusOffErr" 44 "DFC_ComCGW1ChkSum" 45 "DFC_ComCGW1RingCnt" 46 "DFC_ComCGW1TOut" 266 "DFC_ComChksTCU1" 267 "DFC_ComChksTCU11" 268 "DFC_ComChksTCU12" 269 "DFC_ComChksTCU13" 270 "DFC_ComChksTCU2" 271 "DFC_ComChksTCU3" 272 "DFC_ComChksTCU4" 273 "DFC_ComCntTCU1" 274 "DFC_ComCntTCU11" 275 "DFC_ComCntTCU12" 276 "DFC_ComCntTCU13" 277 "DFC_ComCntTCU2" 278 "DFC_ComCntTCU3" 279 "DFC_ComCntTCU4" 47 "DFC_ComConvBoostErr" 48 "DFC_ComConvSlipErr" 372 "DFC_ComDLCTCU01" 373 "DFC_ComDLCTCU02" 374 "DFC_ComDLCTCU1" 375 "DFC_ComDLCTCU11" 376 "DFC_ComDLCTCU12" 377 "DFC_ComDLCTCU13" 378 "DFC_ComDLCTCU14" 379 "DFC_ComDLCTCU2" 380 "DFC_ComDLCTCU3" 381 "DFC_ComDLCTCU4" 49 "DFC_ComEAT10Chksum" 50 "DFC_ComEAT10RingCnt" 51 "DFC_ComEAT10TOut" 52 "DFC_ComEAT11ChkSum" 53 "DFC_ComEAT11RingCnt" 54 "DFC_ComEAT11TOut" 55 "DFC_ComEAT12ChkSum" 56 "DFC_ComEAT12RingCnt" 57 "DFC_ComEAT12TOut" 58 "DFC_ComEAT13ChkSum" 59 "DFC_ComEAT13RingCnt" 60 "DFC_ComEAT13TOut" 61 "DFC_ComEAT1Chksum" 62 "DFC_ComEAT1RingCnt" 63 "DFC_ComEAT1TOut" 64 "DFC_ComEAT2ChkSum" 65 "DFC_ComEAT2RingCnt" 66 "DFC_ComEAT2TOut" 67 "DFC_ComEAT4ChkSum" 68 "DFC_ComEAT4RingCnt" 69 "DFC_ComEAT4TOut" 70 "DFC_ComEAT6Chksum" 71 "DFC_ComEAT6RingCnt" 72 "DFC_ComEAT6TOut" 73 "DFC_ComEAT7Chksum" 74 "DFC_ComEAT7RingCnt" 75 "DFC_ComEAT7TOut" 76 "DFC_ComEAT8Chksum" 77 "DFC_ComEAT8RingCnt" 78 "DFC_ComEAT8TOut" 79 "DFC_ComEATAChksum" 80 "DFC_ComEATARingCnt" 81 "DFC_ComEATATOut" 82 "DFC_ComEATBChkSum" 83 "DFC_ComEATBRingCnt" 84 "DFC_ComEATBTOut" 85 "DFC_ComEATCChksum" 86 "DFC_ComEATCRingCnt" 87 "DFC_ComEATCTOut" 88 "DFC_ComEBBAChksum" 89 "DFC_ComEBBARingCnt" 90 "DFC_ComEBBATOut" 94 "DFC_ComEngCanRxErr" 91 "DFC_ComEPS1Chksum" 92 "DFC_ComEPS1RingCnt" 93 "DFC_ComEPS1TOut" 95 "DFC_ComGrvySnsrErr" 96 "DFC_ComGwIMG1ChkSum" 97 "DFC_ComGwIMG1RingCnt" 98 "DFC_ComGwIMG1TOut" 99 "DFC_ComGwIMG3ChkSum" 100 "DFC_ComGwIMG3RingCnt" 101 "DFC_ComGwIMG3TOut" 102 "DFC_ComGwIMG4ChkSum" 103 "DFC_ComGwIMG4RingCnt" 104 "DFC_ComGwIMG4TOut" 105 "DFC_ComGwIMG5ChkSum" 106 "DFC_ComGwIMG5RingCnt" 107 "DFC_ComGwIMG5TOut" 108 "DFC_ComGwIMG6ChkSum" 109 "DFC_ComGwIMG6RingCnt" 110 "DFC_ComGwIMG6TOut" 111 "DFC_ComIDASBChksum" 112 "DFC_ComIDASBRingCnt" 113 "DFC_ComIDASBTOut" 114 "DFC_ComIMGMILReq" 115 "DFC_ComISSPrms" 116 "DFC_ComMETAChksum" 117 "DFC_ComMETARingCnt" 118 "DFC_ComMETATOut" 119 "DFC_ComMETCChksum" 120 "DFC_ComMETCRingCnt" 121 "DFC_ComMETCTOut" 122 "DFC_ComMETDChksum" 123 "DFC_ComMETDRingCnt" 124 "DFC_ComMETDTOut" 125 "DFC_ComMETE2Chksum" 126 "DFC_ComMETE2RingCnt" 127 "DFC_ComMETE2TOut" 128 "DFC_ComMETFChksum" 129 "DFC_ComMETFRingCnt" 130 "DFC_ComMETFTOut" 131 "DFC_ComMETGChksum" 132 "DFC_ComMETGRingCnt" 133 "DFC_ComMETGTOut" 134 "DFC_ComMETH2Chksum" 135 "DFC_ComMETH2RingCnt" 136 "DFC_ComMETH2TOut" 137 "DFC_ComMETHChksum" 138 "DFC_ComMETHRingCnt" 139 "DFC_ComMETHTOut" 140 "DFC_ComMETIChksum" 141 "DFC_ComMETIRingCnt" 142 "DFC_ComMETITOut" 143 "DFC_ComMETKChksum" 144 "DFC_ComMETKRingCnt" 145 "DFC_ComMETKTOut" 146 "DFC_ComMETLChksum" 147 "DFC_ComMETLRingCnt" 148 "DFC_ComMETLTOut" 149 "DFC_ComMETMChksum" 150 "DFC_ComMETMRingCnt" 151 "DFC_ComMETMTOut" 152 "DFC_ComMETNChksum" 153 "DFC_ComMETNRingCnt" 154 "DFC_ComMETNTOut" 155 "DFC_ComMtrCom" 156 "DFC_ComPCUChkSum" 157 "DFC_ComPCURingCnt" 158 "DFC_ComPCUTOut" 159 "DFC_ComSRSAChksum" 160 "DFC_ComSRSARingCnt" 161 "DFC_ComSRSATOut" 162 "DFC_ComSRSBChksum" 163 "DFC_ComSRSBRingCnt" 164 "DFC_ComSRSBTOut" 165 "DFC_ComSRSChksum" 166 "DFC_ComSRSErr" 167 "DFC_ComSRSRingCnt" 168 "DFC_ComSRSTOut" 280 "DFC_ComTOutTCU01" 281 "DFC_ComTOutTCU02" 282 "DFC_ComTOutTCU1" 283 "DFC_ComTOutTCU11" 284 "DFC_ComTOutTCU12" 285 "DFC_ComTOutTCU13" 286 "DFC_ComTOutTCU14" 287 "DFC_ComTOutTCU2" 288 "DFC_ComTOutTCU3" 289 "DFC_ComTOutTCU4" 169 "DFC_ComVehSpdPndFltTCU" 446 "DFC_DCDCFltDet" 290 "DFC_DevLibBattUHi" 291 "DFC_DevLibBattULo" 449 "DFC_DKnpl" 447 "DFC_DKRSA" 448 "DFC_DKVSmax" 450 "DFC_DSSmax" 451 "DFC_DSTTI" 452 "DFC_DSUmax" 170 "DFC_EbsChartcCurrErr" 171 "DFC_EbsSelfDiagErr" 383 "DFC_EbsSocFlt" 453 "DFC_EGRVlvOL" 454 "DFC_EGRVlvSCB" 455 "DFC_EGRVlvSCG" 456 "DFC_EGSDUS2B1LtrDly" 457 "DFC_EGSDUS2B1LtrPT1" 458 "DFC_EGSDUS2B1RtlDly" 459 "DFC_EGSDUS2B1RtlPT1" 460 "DFC_EGSDUS2B1TarLean" 461 "DFC_EGSDUS2B1TarRich" 464 "DFC_EngICO" 465 "DFC_EngPrtOvrSpdMon" 466 "DFC_EpmCaSI1ErrSig" 467 "DFC_EpmCaSI1NoSig" 468 "DFC_EpmCaSI1OfsErr" 469 "DFC_EpmCrSErrSig" 470 "DFC_EpmCrSNoSig" 471 "DFC_EtaEngIdleNonCsers" 472 "DFC_EtaEngPtlNonCsers" 462 "DFC_ETAKHLmax" 463 "DFC_ETAKHTmax" 337 "DFC_EV1max" 338 "DFC_EV1min" 339 "DFC_EV1sig" 340 "DFC_EV2max" 341 "DFC_EV2min" 342 "DFC_EV2sig" 343 "DFC_EV3max" 344 "DFC_EV3min" 345 "DFC_EV3sig" 346 "DFC_EV4max" 347 "DFC_EV4min" 348 "DFC_EV4sig" 382 "DFC_EVX" 292 "DFC_FanDIOOL_0" 293 "DFC_FanDIOOL_1" 294 "DFC_FanDIOOvrTemp_0" 295 "DFC_FanDIOOvrTemp_1" 296 "DFC_FanDIOSCB_0" 297 "DFC_FanDIOSCB_1" 298 "DFC_FanDIOSCG_0" 299 "DFC_FanDIOSCG_1" 473 "DFC_FRAmax" 474 "DFC_FRAmin" 172 "DFC_GbxCANDigPlausErr" 173 "DFC_GbxNPos1SRCMax" 174 "DFC_GbxNPos1SRCMin" 175 "DFC_GbxNPos2SRCMax" 176 "DFC_GbxNPos2SRCMin" 177 "DFC_GbxNPosAlvChk" 178 "DFC_GbxNPosSyncErr" 349 "DFC_GbxPNPosnDrvCdn" 350 "DFC_GbxPNPosnPlausy" 475 "DFC_GbxRvsSwtStk" 476 "DFC_HDRmax" 477 "DFC_HEGOS2B1ElecMax" 478 "DFC_HEGOS2B1ElecMin" 479 "DFC_HEGOS2B1ElecSig" 480 "DFC_HEGOS2B1HtgNpl" 179 "DFC_HEGOS2B1HtrPsMax" 180 "DFC_HEGOS2B1HtrPsMin" 181 "DFC_HEGOS2B1HtrPsSig" 327 "DFC_HLSDemOvhtEngLim" 384 "DFC_I14229VINErr" 237 "DFC_IgnClPs_DevComErr" 238 "DFC_IgnClPs_LineOl_0" 239 "DFC_IgnClPs_LineOl_1" 240 "DFC_IgnClPs_LineOl_2" 241 "DFC_IgnClPs_LineOl_3" 242 "DFC_IgnClPs_LineScb_0" 243 "DFC_IgnClPs_LineScb_1" 244 "DFC_IgnClPs_LineScb_2" 245 "DFC_IgnClPs_LineScb_3" 246 "DFC_IgnClPs_LineScg_0" 247 "DFC_IgnClPs_LineScg_1" 248 "DFC_IgnClPs_LineScg_2" 249 "DFC_IgnClPs_LineScg_3" 481 "DFC_IntkAirTIntkMnfldCrssMax" 482 "DFC_IntkAirTIntkMnfldCrssMin" 483 "DFC_IntkAirTIntkMnfldHSCMax" 484 "DFC_IntkAirTIntkMnfldImps" 485 "DFC_IntkAirTIntkMnfldPRCMax" 486 "DFC_IntkAirTIntkMnfldPRCMin" 487 "DFC_IntkAirTIntkMnfldSRCMax" 488 "DFC_IntkAirTIntkMnfldSRCMin" 489 "DFC_IntkAirTIntkMnfldSTC" 362 "DFC_KnDetSens1PortAMax" 363 "DFC_KnDetSens1PortAMin" 364 "DFC_KnDetSens1PortBMax" 365 "DFC_KnDetSens1PortBMin" 490 "DFC_KS1max" 491 "DFC_KS1min" 494 "DFC_LamDynDiagS1B1" 495 "DFC_LeakIntkMnfldEmiInfl" 412 "DFC_LIN_E_TIMEOUT" 182 "DFC_LinCSErrACG" 183 "DFC_LinCSErrEBS" 184 "DFC_LinHdrTimeoutErrACG" 185 "DFC_LinHdrTimeoutErrEBS" 186 "DFC_LinMsgTimeoutErrACG" 187 "DFC_LinMsgTimeoutErrEBS" 188 "DFC_LinNoStrtComErr" 385 "DFC_LLRKHmax" 386 "DFC_LLRKHmin" 387 "DFC_LLRmax" 388 "DFC_LLRmin" 492 "DFC_LMmax" 493 "DFC_LZSRnpl" 496 "DFC_MD00max" 497 "DFC_MDBmax" 498 "DFC_MDCat" 499 "DFC_MDCatCrit" 500 "DFC_MDCatCurr" 501 "DFC_MDCyl_0" 502 "DFC_MDCyl_1" 503 "DFC_MDCyl_2" 504 "DFC_MDCyl_3" 505 "DFC_MDEmi" 506 "DFC_MDEmiStrt" 507 "DFC_MDFco" 510 "DFC_MDmax" 508 "DFC_MDMpl" 509 "DFC_MDSegTiAdpn" 205 "DFC_MisfDetdVWhlFrntLePlaus" 206 "DFC_MisfDetdVWhlFrntRiPlaus" 207 "DFC_MisfDetdVWhlReLePlaus" 208 "DFC_MisfDetdVWhlReRiPlaus" 189 "DFC_MisfDetVWhlFrntLeOORHi" 190 "DFC_MisfDetVWhlFrntLeRatyHi" 191 "DFC_MisfDetVWhlFrntLeRatyLo" 192 "DFC_MisfDetVWhlFrntLeStuck" 193 "DFC_MisfDetVWhlFrntRiOORHi" 194 "DFC_MisfDetVWhlFrntRiRatyHi" 195 "DFC_MisfDetVWhlFrntRiRatyLo" 196 "DFC_MisfDetVWhlFrntRiStuck" 197 "DFC_MisfDetVWhlReLeOORHi" 198 "DFC_MisfDetVWhlReLeRatyHi" 199 "DFC_MisfDetVWhlReLeRatyLo" 200 "DFC_MisfDetVWhlReLeStuck" 201 "DFC_MisfDetVWhlReRiOORHi" 202 "DFC_MisfDetVWhlReRiRatyHi" 203 "DFC_MisfDetVWhlReRiRatyLo" 204 "DFC_MisfDetVWhlReRiStuck" 605 "DFC_MoCADCNTP" 606 "DFC_MoCADCTst" 607 "DFC_MoCSOPICO" 609 "DFC_MoFAirFilgPrdc" 610 "DFC_MoFAirFlCtOffPfi" 611 "DFC_MoFAirFlCylPfi" 612 "DFC_MoFAirFlIn" 613 "DFC_MoFAirFlMixCtlPfiChkAirFl" 614 "DFC_MoFAirFlMixCtlPfiChkCtrl" 615 "DFC_MoFAirFlMode" 608 "DFC_MoFAPP" 616 "DFC_MoFESpd" 617 "DFC_MoFIACo" 618 "DFC_MoFICOL1" 619 "DFC_MoFICOL2" 620 "DFC_MoFStrt" 621 "DFC_MoFTrqCmp" 622 "DFC_MoFTrqCmpMax" 623 "DFC_MoFTrqCmpMin" 624 "DFC_MoFVarPostBldSel" 511 "DFC_MOXEMM_SMU_ALM0_0" 512 "DFC_MOXEMM_SMU_ALM0_1" 513 "DFC_MOXEMM_SMU_ALM0_10" 514 "DFC_MOXEMM_SMU_ALM0_11" 515 "DFC_MOXEMM_SMU_ALM0_13" 516 "DFC_MOXEMM_SMU_ALM0_14" 517 "DFC_MOXEMM_SMU_ALM0_2" 518 "DFC_MOXEMM_SMU_ALM0_22" 519 "DFC_MOXEMM_SMU_ALM0_23" 520 "DFC_MOXEMM_SMU_ALM0_4" 521 "DFC_MOXEMM_SMU_ALM0_5" 522 "DFC_MOXEMM_SMU_ALM0_7" 523 "DFC_MOXEMM_SMU_ALM0_8" 524 "DFC_MOXEMM_SMU_ALM10_16" 525 "DFC_MOXEMM_SMU_ALM10_17" 526 "DFC_MOXEMM_SMU_ALM10_21" 527 "DFC_MOXEMM_SMU_ALM11_0" 528 "DFC_MOXEMM_SMU_ALM11_1" 529 "DFC_MOXEMM_SMU_ALM11_2" 530 "DFC_MOXEMM_SMU_ALM11_3" 531 "DFC_MOXEMM_SMU_ALM11_4" 532 "DFC_MOXEMM_SMU_ALM11_5" 533 "DFC_MOXEMM_SMU_ALM11_8" 534 "DFC_MOXEMM_SMU_ALM11_9" 535 "DFC_MOXEMM_SMU_ALM1_0" 536 "DFC_MOXEMM_SMU_ALM1_1" 537 "DFC_MOXEMM_SMU_ALM1_10" 538 "DFC_MOXEMM_SMU_ALM1_11" 539 "DFC_MOXEMM_SMU_ALM1_13" 540 "DFC_MOXEMM_SMU_ALM1_14" 541 "DFC_MOXEMM_SMU_ALM1_2" 542 "DFC_MOXEMM_SMU_ALM1_22" 543 "DFC_MOXEMM_SMU_ALM1_23" 544 "DFC_MOXEMM_SMU_ALM1_4" 545 "DFC_MOXEMM_SMU_ALM1_5" 546 "DFC_MOXEMM_SMU_ALM1_7" 547 "DFC_MOXEMM_SMU_ALM1_8" 548 "DFC_MOXEMM_SMU_ALM21_0" 549 "DFC_MOXEMM_SMU_ALM21_16" 550 "DFC_MOXEMM_SMU_ALM21_3" 551 "DFC_MOXEMM_SMU_ALM2_1" 552 "DFC_MOXEMM_SMU_ALM2_10" 553 "DFC_MOXEMM_SMU_ALM2_11" 554 "DFC_MOXEMM_SMU_ALM2_13" 555 "DFC_MOXEMM_SMU_ALM2_14" 556 "DFC_MOXEMM_SMU_ALM2_22" 557 "DFC_MOXEMM_SMU_ALM2_23" 558 "DFC_MOXEMM_SMU_ALM2_4" 559 "DFC_MOXEMM_SMU_ALM2_5" 560 "DFC_MOXEMM_SMU_ALM2_7" 561 "DFC_MOXEMM_SMU_ALM2_8" 562 "DFC_MOXEMM_SMU_ALM6_0" 563 "DFC_MOXEMM_SMU_ALM6_11" 564 "DFC_MOXEMM_SMU_ALM6_12" 565 "DFC_MOXEMM_SMU_ALM6_14" 566 "DFC_MOXEMM_SMU_ALM6_15" 567 "DFC_MOXEMM_SMU_ALM6_17" 568 "DFC_MOXEMM_SMU_ALM6_18" 569 "DFC_MOXEMM_SMU_ALM6_20" 570 "DFC_MOXEMM_SMU_ALM6_21" 571 "DFC_MOXEMM_SMU_ALM6_25" 572 "DFC_MOXEMM_SMU_ALM6_4" 573 "DFC_MOXEMM_SMU_ALM6_5" 574 "DFC_MOXEMM_SMU_ALM6_7" 575 "DFC_MOXEMM_SMU_ALM6_8" 576 "DFC_MOXEMM_SMU_ALM7_1" 577 "DFC_MOXEMM_SMU_ALM7_12" 578 "DFC_MOXEMM_SMU_ALM7_13" 579 "DFC_MOXEMM_SMU_ALM7_14" 580 "DFC_MOXEMM_SMU_ALM7_15" 581 "DFC_MOXEMM_SMU_ALM7_16" 582 "DFC_MOXEMM_SMU_ALM7_17" 583 "DFC_MOXEMM_SMU_ALM7_2" 584 "DFC_MOXEMM_SMU_ALM7_20" 585 "DFC_MOXEMM_SMU_ALM7_25" 586 "DFC_MOXEMM_SMU_ALM7_26" 587 "DFC_MOXEMM_SMU_ALM7_28" 588 "DFC_MOXEMM_SMU_ALM7_29" 589 "DFC_MOXEMM_SMU_ALM7_30" 590 "DFC_MOXEMM_SMU_ALM7_31" 591 "DFC_MOXEMM_SMU_ALM8_0" 592 "DFC_MOXEMM_SMU_ALM8_1" 593 "DFC_MOXEMM_SMU_ALM8_10" 594 "DFC_MOXEMM_SMU_ALM8_11" 595 "DFC_MOXEMM_SMU_ALM8_12" 596 "DFC_MOXEMM_SMU_ALM8_16" 597 "DFC_MOXEMM_SMU_ALM8_18" 598 "DFC_MOXEMM_SMU_ALM8_2" 599 "DFC_MOXEMM_SMU_ALM8_3" 600 "DFC_MOXEMM_SMU_ALM8_31" 601 "DFC_MOXEMM_SMU_ALM8_4" 602 "DFC_MOXEMM_SMU_ALM9_0" 603 "DFC_MOXEMM_SMU_ALM9_15" 604 "DFC_MOXEMM_SMU_ALM9_3" 625 "DFC_MoXEMMHwLTMCUFW" 626 "DFC_MoXEMMHwLTMonBIST" 627 "DFC_MoXEMMHwLTRegMonTest" 628 "DFC_MoXEMMHwLTStbySMUAlvTest" 629 "DFC_MoXEMMHwLTTempSens" 630 "DFC_MoXEMMHwLTUCBCfg" 300 "DFC_MRlyDcOL" 301 "DFC_MRlyDcSCB" 302 "DFC_MRlyDcSCG" 413 "DFC_MRlyOL" 414 "DFC_MRlySCB" 415 "DFC_MRlySCG" 631 "DFC_OCWDAABEActv" 632 "DFC_OCWDACom" 633 "DFC_OCWDAErrPin" 634 "DFC_OCWDAOvrVltg" 328 "DFC_OilPNpl" 635 "DFC_ORAmax" 636 "DFC_ORAmin" 647 "DFC_P_VSE11_OL" 648 "DFC_P_VSE11_SCB" 649 "DFC_P_VSE11_SCG" 351 "DFC_PEnvCcMax" 352 "DFC_PEnvCcMin" 353 "DFC_PEnvRngChkMax" 354 "DFC_PEnvRngChkMin" 209 "DFC_PEnvSigRngMax" 210 "DFC_PEnvSigRngMin" 355 "DFC_PEnvSnsrPlaus" 650 "DFC_PhyHighAPP1" 651 "DFC_PhyHighAPP2" 652 "DFC_PhyLowAPP1" 653 "DFC_PhyLowAPP2" 329 "DFC_PIntkVUsLineHiB1" 330 "DFC_PIntkVUsLineLoB1" 637 "DFC_PLLSUmax" 638 "DFC_PLLSUmin" 303 "DFC_PSPOL" 304 "DFC_PSPOvrTemp" 305 "DFC_PSPSCB" 306 "DFC_PSPSCG" 639 "DFC_PSR1max" 640 "DFC_PSRBmax" 641 "DFC_PSRBmin" 645 "DFC_PSRmax" 642 "DFC_PSRPmax" 643 "DFC_PSRPmin" 644 "DFC_PSRPsig" 646 "DFC_PUmax" 396 "DFC_RBA_IODIAGPWR_rba_IoExtCy329_SignalVltSply_0" 397 "DFC_RBA_IODIAGPWR_rba_IoExtCy329_SignalVltSply_0OT" 398 "DFC_RBA_IODIAGPWR_rba_IoExtCy329_SignalVltSply_0OV" 399 "DFC_RBA_IODIAGPWR_rba_IoExtCy329_SignalVltSply_0SCG" 400 "DFC_RBA_IODIAGPWR_rba_IoExtCy329_SignalVltSply_0UV" 401 "DFC_RBA_IODIAGPWR_rba_IoExtCy329_SignalVltSply_1" 402 "DFC_RBA_IODIAGPWR_rba_IoExtCy329_SignalVltSply_1OT" 403 "DFC_RBA_IODIAGPWR_rba_IoExtCy329_SignalVltSply_1OV" 404 "DFC_RBA_IODIAGPWR_rba_IoExtCy329_SignalVltSply_1SCG" 405 "DFC_RBA_IODIAGPWR_rba_IoExtCy329_SignalVltSply_1UV" 406 "DFC_RBA_IODIAGPWR_rba_IoExtCy329_SignalVltSply_2" 407 "DFC_RBA_IODIAGPWR_rba_IoExtCy329_SignalVltSply_2OT" 408 "DFC_RBA_IODIAGPWR_rba_IoExtCy329_SignalVltSply_2OV" 409 "DFC_RBA_IODIAGPWR_rba_IoExtCy329_SignalVltSply_2SCG" 410 "DFC_RBA_IODIAGPWR_rba_IoExtCy329_SignalVltSply_2UV" 419 "DFC_RBA_IOEXTLIB_KEEPALIVE_DRV" 420 "DFC_RBA_IOEXTLIB_KEEPALIVE_INI" 421 "DFC_rba_IoSigRtc_StopCounter" 423 "DFC_rba_MemDiag_MemReadErr" 424 "DFC_rba_MemDiag_MemWrErr" 422 "DFC_rba_MRly_Diag_Stk_Event" 416 "DFC_rba_MultiStackTrace_Threshold" 425 "DFC_rba_SyC_IrrSwOffTrigEngRun_Event" 426 "DFC_rba_T15_Diag_ComInVld_Event" 427 "DFC_rba_T15_Diag_ComOff_HwOn_Event" 428 "DFC_rba_T15_Diag_ComOn_HwOff_Event" 389 "DFC_RoughRoad" 390 "DFC_SiaEEPRdErr" 391 "DFC_SiaEEPWrngCod" 654 "DFC_SRCHighAPP1" 655 "DFC_SRCHighAPP2" 656 "DFC_SRCLowAPP1" 657 "DFC_SRCLowAPP2" 658 "DFC_SSpMon2" 211 "DFC_StmFault" 213 "DFC_StrtCtlErr" 212 "DFC_StrtCtOffPth" 214 "DFC_StrtFault" 215 "DFC_StrtLckJudg1" 216 "DFC_StrtLckJudg2" 217 "DFC_StrtOL" 218 "DFC_StrtOL2" 219 "DFC_StrtSCB" 220 "DFC_StrtSCB2" 221 "DFC_StrtSCG" 222 "DFC_StrtSCG2" 223 "DFC_StrtStkRly1" 224 "DFC_StrtStkRly2" 659 "DFC_SWReset_0" 660 "DFC_SWReset_1" 661 "DFC_SWReset_2" 662 "DFC_SyncAPP" 307 "DFC_T50Err" 663 "DFC_TAmax_Dummy" 225 "DFC_TEVEmax" 226 "DFC_TEVEmin" 227 "DFC_TEVEsig" 671 "DFC_ThrVlvClsdPosnFirstOffsLrnImpoB1" 672 "DFC_ThrVlvClsdPosnOffsLrnImpoB1" 673 "DFC_ThrVlvClsdPosnOffsLrnMaxB1" 674 "DFC_ThrVlvClsdPosnOffsLrnMinB1" 675 "DFC_ThrVlvCtrlDeB1" 676 "DFC_ThrVlvDycB1" 677 "DFC_ThrVlvLimpAirPosnMaxAbsltDriftB1" 678 "DFC_ThrVlvLimpAirPosnMaxB1" 679 "DFC_ThrVlvLimpAirPosnMaxRelDriftB1" 680 "DFC_ThrVlvLimpAirPosnMinB1" 308 "DFC_ThrVlvLoBattB1" 681 "DFC_ThrVlvOpenLoadB1" 682 "DFC_ThrVlvOpenSprgB1" 683 "DFC_ThrVlvOpenSprgSprdB1" 684 "DFC_ThrVlvOpenSprgTwnB1" 685 "DFC_ThrVlvOverTB1" 686 "DFC_ThrVlvRetSprgB1" 687 "DFC_ThrVlvRetSprgSprdB1" 688 "DFC_ThrVlvRetSprgTwnB1" 689 "DFC_ThrVlvSens1MaxB1" 696 "DFC_ThrvlvSens1MinB1" 690 "DFC_ThrVlvSens1NplB1" 691 "DFC_ThrVlvSens2MaxB1" 692 "DFC_ThrVlvSens2MinB1" 693 "DFC_ThrVlvSens2NplB1" 694 "DFC_ThrVlvShoCircB1" 695 "DFC_ThrVlvSpiErrB1" 697 "DFC_TiOffTBasdChkFast" 698 "DFC_TiOffTBasdChkSlow" 664 "DFC_TKAEmax" 665 "DFC_TKAEmin" 666 "DFC_TKARmax" 667 "DFC_TKARnpl" 668 "DFC_TMmax_Dummy" 669 "DFC_TUMmax_Dummy" 670 "DFC_TWCDPriCatB1" 250 "DFC_UEGOASICS1B1" 392 "DFC_UegoDummy" 699 "DFC_UEGOHeatrCtlS1B1" 356 "DFC_UEGOHeatrPsS1B1Max" 357 "DFC_UEGOHeatrPsS1B1Min" 358 "DFC_UEGOHeatrPsS1B1Sig" 359 "DFC_UEGOHeatrRlyPsOLS1B1" 360 "DFC_UEGOHeatrRlyPsSCBS1B1" 361 "DFC_UEGOHeatrRlyPsSCGS1B1" 257 "DFC_UegoOlApesS1B1" 251 "DFC_UEGOOLIPES1B1" 258 "DFC_UegoOlRCmpS1B1" 252 "DFC_UEGOOLRES1B1" 253 "DFC_UEGOSCBS1B1" 254 "DFC_UEGOSCGS1B1" 700 "DFC_UEGOSnsrMntdS1B1" 256 "DFC_UEGOSnsrS1B1" 255 "DFC_UEGOSPIS1B1" 228 "DFC_VehVAllPlaus" 229 "DFC_VehVNCSnsrElecFailr" 309 "DFC_VehVPhysRngHi" 331 "DFC_VehVPhysRngLo" 230 "DFC_VehVPlausCan" 231 "DFC_VehVPlausFco" 232 "DFC_VehVPlausPwr" 233 "DFC_VehVPlausV2N" 310 "DFC_VehVSclOutOL" 311 "DFC_VehVSclOutOT" 312 "DFC_VehVSclOutSCB" 313 "DFC_VehVSclOutSCG" 701 "DFC_VehVSig" 332 "DFC_VehVSigCan" 333 "DFC_VehVSigCanSafe" 314 "DFC_VehVSnsrARngHi" 315 "DFC_VehVSnsrBRngHi" 316 "DFC_VehVSpdRtyDiag" 234 "DFC_VehVSpdSnsrAElecFailr" 235 "DFC_VehVSpdSnsrBElecFailr" 317 "DFC_VehVWhlErr" 334 "DFC_VlvLftFbOilPSnsrIntk11SRCMax" 335 "DFC_VlvLftFbOilPSnsrIntk11SRCMin" 702 "DFC_VlvLftFbSwtIntk11SpclFail" 703 "DFC_VlvLftFbSwtIntk11StdFail" DEFAULT_VALUE "---" /end COMPU_VTAB
/begin COMPU_METHOD DFES_Entry_Verb "" TAB_VERB "%6.3" "" COMPU_TAB_REF DFES_Entry_Verb /end COMPU_METHOD
/begin COMPU_VTAB DFES_Entry_Verb "" TAB_VERB 35 0 "Empty" 1 "Erased" 2 "Erased_PdtcClrd" 3 "Erased_PdtcClrdMinTrip" 4 "Erased_PdtcClrdOk" 5 "FrzFrm" 6 "FrzFrm_PdtcClrd" 7 "FrzFrm_PdtcClrdMinTrip" 8 "FrzFrm_PdtcClrdOk" 9 "Shadow" 10 "Shadow_PdtcClrd" 11 "Shadow_PdtcClrdMinTrip" 12 "Shadow_PdtcClrdOk" 13 "Service" 14 "Service_PdtcClrd" 15 "Service_PdtcClrdMinTrip" 16 "Service_PdtcClrdOk" 17 "Service_Shdw" 18 "Service_ShdwPdtcClrd" 19 "Service_ShdwPdtcClrdMinTrip" 20 "Service_ShdwPdtcClrdOk" 21 "Service_FrzFrm" 22 "Service_FrzFrmPdtcClrd" 23 "Service_FrzFrmPdtcClrdMinTrip" 24 "Service_FrzFrmPdtcClrdOk" 25 "Pending" 26 "Pending_PdtcClrd" 27 "Pending_PdtcClrdMinTrip" 28 "Pending_PdtcClrdOk" 29 "Confirmed" 30 "Confirmed_Pdtc" 31 "ConfirmedHealing" 32 "ConfirmedHealing_Pdtc" 33 "ConfirmedPending" 34 "ConfirmedAging" /end COMPU_VTAB
/begin COMPU_METHOD DFES_Mon_Verb "" TAB_VERB "%6.3" "-" COMPU_TAB_REF DFES_Mon_Verb /end COMPU_METHOD
/begin COMPU_VTAB DFES_Mon_Verb "" TAB_VERB 22 0 "-----" 257 "double entry" 1025 "LDF_Diff DFCst - ORD" 513 "Counter exceeds" 258 "MEM missing" 1032 "retry entry" 514 "DEL Counter Serv ex" 260 "MEM no Entry" 516 "DEL Counter Pend ex" 1026 "Deb ok missing" 520 "DEL Counter OBD ex" 1028 "Deb def missing" 2049 "EepQueOvfl" 2050 "EepIniFailed" 2051 "EepIniNoSucss" 4097 "Erased_prioHigh" 4098 "slow_scan" 8193 "miss diumpr Fid" 16385 "invalid DTR limit" 32770 "event lost due to rollback limit" 32785 "number active InhUdp negative" 32786 "non zero InhUpd counter used" /end COMPU_VTAB
/begin COMPU_METHOD DFES_OneToOne "" RAT_FUNC "%6.2" "-" COEFFS 0 1 0 0 0 1 /end COMPU_METHOD
/begin COMPU_METHOD DFES_stCheck_Verb "" TAB_VERB "%6.3" "-" COMPU_TAB_REF DFES_stCheck_Verb /end COMPU_METHOD
/begin COMPU_VTAB DFES_stCheck_Verb "" TAB_VERB 8 0 "OkNoTst" 1 "OkTested" 2 "OkHealed" 3 "OkRstNoTst" 4 "DefectNoTst" 5 "DefectDelay" 6 "Defect" 7 "DefectRstNoTst" /end COMPU_VTAB
/begin COMPU_METHOD DFES_stCnt_Verb "" TAB_VERB "%6.3" "-" COMPU_TAB_REF DFES_stCnt_Verb /end COMPU_METHOD
/begin COMPU_VTAB DFES_stCnt_Verb "" TAB_VERB 36 0 "SVS_NONE__MIL_NONE" 1 "SVS_NONE__MIL_HLC_TRG" 2 "SVS_NONE__MIL_HLC_ELAP" 3 "SVS_NONE__MIL_FLC_CNT" 4 "SVS_NONE__MIL_FLC_TIME" 5 "SVS_NONE__MIL_HLC_TIME" 16 "SVS_HLC_TRG__MIL_NONE" 17 "SVS_HLC_TRG__MIL_HLC_TRG" 18 "SVS_HLC_TRG__MIL_HLC_ELAP" 19 "SVS_HLC_TRG__MIL_FLC_CNT" 20 "SVS_HLC_TRG__MIL_FLC_TIME" 21 "SVS_HLC_TRG__MIL_HLC_TIME" 32 "SVS_HLC_ELAP__MIL_NONE" 33 "SVS_HLC_ELAP__MIL_HLC_TRG" 34 "SVS_HLC_ELAP__MIL_HLC_ELAP" 35 "SVS_HLC_ELAP__MIL_FLC_CNT" 36 "SVS_HLC_ELAP__MIL_FLC_TIME" 37 "SVS_HLC_ELAP__MIL_HLC_TIME" 48 "SVS_FLC_CNT__MIL_NONE" 49 "SVS_FLC_CNT__MIL_HLC_TRG" 50 "SVS_FLC_CNT__MIL_HLC_ELAP" 51 "SVS_FLC_CNT__MIL_FLC_CNT" 52 "SVS_FLC_CNT__MIL_FLC_TIME" 53 "SVS_FLC_CNT__MIL_HLC_TIME" 64 "SVS_FLC_TIME__MIL_NONE" 65 "SVS_FLC_TIME__MIL_HLC_TRG" 66 "SVS_FLC_TIME__MIL_HLC_ELAP" 67 "SVS_FLC_TIME__MIL_FLC_CNT" 68 "SVS_FLC_TIME__MIL_FLC_TIME" 69 "SVS_FLC_TIME__MIL_HLC_TIME" 80 "SVS_HLC_TIME__MIL_NONE" 81 "SVS_HLC_TIME__MIL_HLC_TRG" 82 "SVS_HLC_TIME__MIL_HLC_ELAP" 83 "SVS_HLC_TIME__MIL_FLC_CNT" 84 "SVS_HLC_TIME__MIL_FLC_TIME" 85 "SVS_HLC_TIME__MIL_HLC_TIME" /end COMPU_VTAB
/begin COMPU_METHOD DFES_stDataImdt_Verb "" TAB_VERB "%6.3" "" COMPU_TAB_REF DFES_stDataImdt_Verb /end COMPU_METHOD
/begin COMPU_VTAB DFES_stDataImdt_Verb "" TAB_VERB 22 0 "ERASED" 1 "ERASED_ACTSEQ_FRZ_ENV" 2 "FRZONLY" 3 "FRZONLY_ACTSEQ_FRZ_ENV" 4 "SHADOW" 5 "SHADOW_ACTSEQ_FRZ_ENV" 12 "OKENTRY" 13 "OKENTRY_ACTSEQ_LCK" 14 "OKENTRY_ACTSEQ_LCK_ENV_LCK" 15 "OKENTRY_ACTSEQ_FRZ_ENV_LCK" 16 "OKENTRY_ACTSEQ_ENV_LCK" 17 "ERROR" 18 "ERROR_ACTSEQ_LCK" 19 "ERROR_ACTSEQ_LCK_ENV_LCK" 20 "ERROR_ACTSEQ_FRZ_ENV_LCK" 21 "ERROR_ACTSEQ_ENV_LCK" 6 "SHADOWFRZ" 7 "SHADOWFRZ_ACTSEQ_FRZ_ENV" 8 "SHADOWOK" 9 "SHADOWOK_ACTSEQ_FRZ_ENV" 10 "SHADOWOKFRZ" 11 "SHADOWOKFRZ_ACTSEQ_FRZ_ENV" /end COMPU_VTAB
/begin COMPU_METHOD DFES_stEntry_Verb "" TAB_VERB "%6.3" "-" COMPU_TAB_REF DFES_stEntry_Verb /end COMPU_METHOD
/begin COMPU_VTAB DFES_stEntry_Verb "" TAB_VERB 240 0 "NoEntry" 1 "Erased" 2 "PrivateTemporary" 3 "SVSOff_FreezeFrameOnly" 4 "SVSOff_DelayActiveDefect" 5 "SVSOff_ServiceNoDefect" 6 "SVSOff_ServiceDefect" 7 "SVSOff_ServiceHistoryDefect" 8 "SVSOff_ServiceHistoryNoDefect" 9 "SVSOff_DelayActiveNoDefect" 10 "SVSOff_PendingDefect" 11 "SVSOff_DebouncedDefect" 12 "SVSOff_HistoryPendingDefect" 13 "SVSOff_HealingNoDefect" 14 "SVSOff_HistoryNoDefect" 16 "DelD_NoEntry" 17 "DelD_Erased" 18 "DelD_PrivateTemporary" 19 "SVSOff_DelD_FreezeFrameOnly" 20 "SVSOff_DelD_DelayActiveDefect" 21 "SVSOff_DelD_ServiceNoDefect" 22 "SVSOff_DelD_ServiceDefect" 23 "SVSOff_DelD_ServiceHistoryDefect" 24 "SVSOff_DelD_ServiceHistoryNoDefect" 25 "SVSOff_DelD_DelayActiveNoDefect" 26 "SVSOff_DelD_PendingDefect" 27 "SVSOff_DelD_DebouncedDefect" 28 "SVSOff_DelD_HistoryPendingDefect" 29 "SVSOff_DelD_HealingNoDefect" 30 "SVSOff_DelD_HistoryNoDefect" 32 "P_NoEntry" 33 "P_Erased" 34 "P_PrivateTemporary" 35 "SVSOff_P_FreezeFrameOnly" 36 "SVSOff_P_DelayActiveDefect" 37 "SVSOff_P_ServiceNoDefect" 38 "SVSOff_P_ServiceDefect" 39 "SVSOff_P_ServiceHistoryDefect" 40 "SVSOff_P_ServiceHistoryNoDefect" 41 "SVSOff_P_DelayActiveNoDefect" 42 "SVSOff_P_PendingDefect" 43 "SVSOff_P_DebouncedDefect" 44 "SVSOff_P_HistoryPendingDefect" 45 "SVSOff_P_HealingNoDefect" 46 "SVSOff_P_HistoryNoDefect" 48 "P_DelD_NoEntry" 49 "P_DelD_Erased" 50 "P_DelD_PrivateTemporary" 51 "SVSOff_P_DelD_FreezeFrameOnly" 52 "SVSOff_P_DelD_DelayActiveDefect" 53 "SVSOff_P_DelD_ServiceNoDefect" 54 "SVSOff_P_DelD_ServiceDefect" 55 "SVSOff_P_DelD_ServiceHistoryDefect" 56 "SVSOff_P_DelD_ServiceHistoryNoDefect" 57 "SVSOff_P_DelD_DelayActiveNoDefect" 58 "SVSOff_P_DelD_PendingDefect" 59 "SVSOff_P_DelD_DebouncedDefect" 60 "SVSOff_P_DelD_HistoryPendingDefect" 61 "SVSOff_P_DelD_HealingNoDefect" 62 "SVSOff_P_DelD_HistoryNoDefect" 64 "PS_NoEntry" 65 "PS_Erased" 66 "PS_PrivateTemporary" 67 "SVSOff_PS_FreezeFrameOnly" 68 "SVSOff_PS_DelayActiveDefect" 69 "SVSOff_PS_ServiceNoDefect" 70 "SVSOff_PS_ServiceDefect" 71 "SVSOff_PS_ServiceHistoryDefect" 72 "SVSOff_PS_ServiceHistoryNoDefect" 73 "SVSOff_PS_DelayActiveNoDefect" 74 "SVSOff_PS_PendingDefect" 75 "SVSOff_PS_DebouncedDefect" 76 "SVSOff_PS_HistoryPendingDefect" 77 "SVSOff_PS_HealingNoDefect" 78 "SVSOff_PS_HistoryNoDefect" 80 "PS_DelD_NoEntry" 81 "PS_DelD_Erased" 82 "PS_DelD_PrivateTemporary" 83 "SVSOff_PS_DelD_FreezeFrameOnly" 84 "SVSOff_PS_DelD_DelayActiveDefect" 85 "SVSOff_PS_DelD_ServiceNoDefect" 86 "SVSOff_PS_DelD_ServiceDefect" 87 "SVSOff_PS_DelD_ServiceHistoryDefect" 88 "SVSOff_PS_DelD_ServiceHistoryNoDefect" 89 "SVSOff_PS_DelD_DelayActiveNoDefect" 90 "SVSOff_PS_DelD_PendingDefect" 91 "SVSOff_PS_DelD_DebouncedDefect" 92 "SVSOff_PS_DelD_HistoryPendingDefect" 93 "SVSOff_PS_DelD_HealingNoDefect" 94 "SVSOff_PS_DelD_HistoryNoDefect" 96 "PS_P_NoEntry" 97 "PS_P_Erased" 98 "PS_P_PrivateTemporary" 99 "SVSOff_PS_P_FreezeFrameOnly" 100 "SVSOff_PS_P_DelayActiveDefect" 101 "SVSOff_PS_P_ServiceNoDefect" 102 "SVSOff_PS_P_ServiceDefect" 103 "SVSOff_PS_P_ServiceHistoryDefect" 104 "SVSOff_PS_P_ServiceHistoryNoDefect" 105 "SVSOff_PS_P_DelayActiveNoDefect" 106 "SVSOff_PS_P_PendingDefect" 107 "SVSOff_PS_P_DebouncedDefect" 108 "SVSOff_PS_P_HistoryPendingDefect" 109 "SVSOff_PS_P_HealingNoDefect" 110 "SVSOff_PS_P_HistoryNoDefect" 112 "PS_P_DelD_NoEntry" 113 "PS_P_DelD_Erased" 114 "PS_P_DelD_PrivateTemporary" 115 "SVSOff_PS_P_DelD_FreezeFrameOnly" 116 "SVSOff_PS_P_DelD_DelayActiveDefect" 117 "SVSOff_PS_P_DelD_ServiceNoDefect" 118 "SVSOff_PS_P_DelD_ServiceDefect" 119 "SVSOff_PS_P_DelD_ServiceHistoryDefect" 120 "SVSOff_PS_P_DelD_ServiceHistoryNoDefect" 121 "SVSOff_PS_P_DelD_DelayActiveNoDefect" 122 "SVSOff_PS_P_DelD_PendingDefect" 123 "SVSOff_PS_P_DelD_DebouncedDefect" 124 "SVSOff_PS_P_DelD_HistoryPendingDefect" 125 "SVSOff_PS_P_DelD_HealingNoDefect" 126 "SVSOff_PS_P_DelD_HistoryNoDefect" 128 "SVSOn_NoEntry" 129 "SVSOn_Erased" 130 "SVSOn_PrivateTemporary" 131 "SVSOn_FreezeFrameOnly" 132 "SVSOn_DelayActiveDefect" 133 "SVSOn_ServiceNoDefect" 134 "SVSOn_ServiceDefect" 135 "SVSOn_ServiceHistoryDefect" 136 "SVSOn_ServiceHistoryNoDefect" 137 "SVSOn_DelayActiveNoDefect" 138 "SVSOn_PendingDefect" 139 "SVSOn_DebouncedDefect" 140 "SVSOn_HistoryPendingDefect" 141 "SVSOn_HealingNoDefect" 142 "SVSOn_HistoryNoDefect" 144 "SVSOn_DelD_NoEntry" 145 "SVSOn_DelD_Erased" 146 "SVSOn_DelD_PrivateTemporary" 147 "SVSOn_DelD_FreezeFrameOnly" 148 "SVSOn_DelD_DelayActiveDefect" 149 "SVSOn_DelD_ServiceNoDefect" 150 "SVSOn_DelD_ServiceDefect" 151 "SVSOn_DelD_ServiceHistoryDefect" 152 "SVSOn_DelD_ServiceHistoryNoDefect" 153 "SVSOn_DelD_DelayActiveNoDefect" 154 "SVSOn_DelD_PendingDefect" 155 "SVSOn_DelD_DebouncedDefect" 156 "SVSOn_DelD_HistoryPendingDefect" 157 "SVSOn_DelD_HealingNoDefect" 158 "SVSOn_DelD_HistoryNoDefect" 160 "SVSOn_P_NoEntry" 161 "SVSOn_P_Erased" 162 "SVSOn_P_PrivateTemporary" 163 "SVSOn_P_FreezeFrameOnly" 164 "SVSOn_P_DelayActiveDefect" 165 "SVSOn_P_ServiceNoDefect" 166 "SVSOn_P_ServiceDefect" 167 "SVSOn_P_ServiceHistoryDefect" 168 "SVSOn_P_ServiceHistoryNoDefect" 169 "SVSOn_P_DelayActiveNoDefect" 170 "SVSOn_P_PendingDefect" 171 "SVSOn_P_DebouncedDefect" 172 "SVSOn_P_HistoryPendingDefect" 173 "SVSOn_P_HealingNoDefect" 174 "SVSOn_P_HistoryNoDefect" 176 "SVSOn_P_DelD_NoEntry" 177 "SVSOn_P_DelD_Erased" 178 "SVSOn_P_DelD_PrivateTemporary" 179 "SVSOn_P_DelD_FreezeFrameOnly" 180 "SVSOn_P_DelD_DelayActiveDefect" 181 "SVSOn_P_DelD_ServiceNoDefect" 182 "SVSOn_P_DelD_ServiceDefect" 183 "SVSOn_P_DelD_ServiceHistoryDefect" 184 "SVSOn_P_DelD_ServiceHistoryNoDefect" 185 "SVSOn_P_DelD_DelayActiveNoDefect" 186 "SVSOn_P_DelD_PendingDefect" 187 "SVSOn_P_DelD_DebouncedDefect" 188 "SVSOn_P_DelD_HistoryPendingDefect" 189 "SVSOn_P_DelD_HealingNoDefect" 190 "SVSOn_P_DelD_HistoryNoDefect" 192 "SVSOn_PS_NoEntry" 193 "SVSOn_PS_Erased" 194 "SVSOn_PS_PrivateTemporary" 195 "SVSOn_PS_FreezeFrameOnly" 196 "SVSOn_PS_DelayActiveDefect" 197 "SVSOn_PS_ServiceNoDefect" 198 "SVSOn_PS_ServiceDefect" 199 "SVSOn_PS_ServiceHistoryDefect" 200 "SVSOn_PS_ServiceHistoryNoDefect" 201 "SVSOn_PS_DelayActiveNoDefect" 202 "SVSOn_PS_PendingDefect" 203 "SVSOn_PS_DebouncedDefect" 204 "SVSOn_PS_HistoryPendingDefect" 205 "SVSOn_PS_HealingNoDefect" 206 "SVSOn_PS_HistoryNoDefect" 208 "SVSOn_PS_DelD_NoEntry" 209 "SVSOn_PS_DelD_Erased" 210 "SVSOn_PS_DelD_PrivateTemporary" 211 "SVSOn_PS_DelD_FreezeFrameOnly" 212 "SVSOn_PS_DelD_DelayActiveDefect" 213 "SVSOn_PS_DelD_ServiceNoDefect" 214 "SVSOn_PS_DelD_ServiceDefect" 215 "SVSOn_PS_DelD_ServiceHistoryDefect" 216 "SVSOn_PS_DelD_ServiceHistoryNoDefect" 217 "SVSOn_PS_DelD_DelayActiveNoDefect" 218 "SVSOn_PS_DelD_PendingDefect" 219 "SVSOn_PS_DelD_DebouncedDefect" 220 "SVSOn_PS_DelD_HistoryPendingDefect" 221 "SVSOn_PS_DelD_HealingNoDefect" 222 "SVSOn_PS_DelD_HistoryNoDefect" 224 "SVSOn_PS_P_NoEntry" 225 "SVSOn_PS_P_Erased" 226 "SVSOn_PS_P_PrivateTemporary" 227 "SVSOn_PS_P_FreezeFrameOnly" 228 "SVSOn_PS_P_DelayActiveDefect" 229 "SVSOn_PS_P_ServiceNoDefect" 230 "SVSOn_PS_P_ServiceDefect" 231 "SVSOn_PS_P_ServiceHistoryDefect" 232 "SVSOn_PS_P_ServiceHistoryNoDefect" 233 "SVSOn_PS_P_DelayActiveNoDefect" 234 "SVSOn_PS_P_PendingDefect" 235 "SVSOn_PS_P_DebouncedDefect" 236 "SVSOn_PS_P_HistoryPendingDefect" 237 "SVSOn_PS_P_HealingNoDefect" 238 "SVSOn_PS_P_HistoryNoDefect" 240 "SVSOn_PS_P_DelD_NoEntry" 241 "SVSOn_PS_P_DelD_Erased" 242 "SVSOn_PS_P_DelD_PrivateTemporary" 243 "SVSOn_PS_P_DelD_FreezeFrameOnly" 244 "SVSOn_PS_P_DelD_DelayActiveDefect" 245 "SVSOn_PS_P_DelD_ServiceNoDefect" 246 "SVSOn_PS_P_DelD_ServiceDefect" 247 "SVSOn_PS_P_DelD_ServiceHistoryDefect" 248 "SVSOn_PS_P_DelD_ServiceHistoryNoDefect" 249 "SVSOn_PS_P_DelD_DelayActiveNoDefect" 250 "SVSOn_PS_P_DelD_PendingDefect" 251 "SVSOn_PS_P_DelD_DebouncedDefect" 252 "SVSOn_PS_P_DelD_HistoryPendingDefect" 253 "SVSOn_PS_P_DelD_HealingNoDefect" 254 "SVSOn_PS_P_DelD_HistoryNoDefect" /end COMPU_VTAB
/begin COMPU_METHOD EPMCAS_PHITEMPCOR05_DSTX_SC_Compu "" RAT_FUNC "%6.2" "" COEFFS 0 1 0 0 0 1 /end COMPU_METHOD
/begin COMPU_METHOD EPMCAS_PRODCORRNVAL_SC_Compu "" TAB_VERB "%6.3" "" COMPU_TAB_REF EPMCAS_PRODCORRNVAL_SC_Compu /end COMPU_METHOD
/begin COMPU_VTAB EPMCAS_PRODCORRNVAL_SC_Compu "" TAB_VERB 2 0 "OFF" 1 "ON" /end COMPU_VTAB
/begin COMPU_METHOD EPMCAS_REFADPNTSTRENARESP_SC_Compu "" RAT_FUNC "%6.2" "" COEFFS 0 1 0 0 0 1 /end COMPU_METHOD
/begin COMPU_METHOD EPMCAS_REFADPNTSTR_SC_Compu "" TAB_VERB "%6.3" "" COMPU_TAB_REF EPMCAS_REFADPNTSTR_SC_Compu /end COMPU_METHOD
/begin COMPU_VTAB EPMCAS_REFADPNTSTR_SC_Compu "" TAB_VERB 2 0 "False" 1 "True" /end COMPU_VTAB
/begin COMPU_METHOD OneToOne "" RAT_FUNC "%6.2" "-" COEFFS 0 1 0 0 0 1 /end COMPU_METHOD
/begin RECORD_LAYOUT Val_Wu16 FNC_VALUES 1 UWORD COLUMN_DIR DIRECT /end RECORD_LAYOUT
/begin RECORD_LAYOUT Val_Wu8 FNC_VALUES 1 UBYTE COLUMN_DIR DIRECT /end RECORD_LAYOUT
/end MODULE
/end PROJECT
