ASAP2_VERSION 1 60
/begin PROJECT MG1CA020 "MG1CA020"
/begin HEADER "" VERSION "MG1CA020_6SAY_V011_TPROT" PROJECT_NO MG1CA020 /end HEADER
/begin MODULE DIM ""
/begin MOD_COMMON "" BYTE_ORDER MSB_LAST ALIGNMENT_BYTE 1 ALIGNMENT_WORD 2 ALIGNMENT_LONG 4 ALIGNMENT_INT64 4 ALIGNMENT_FLOAT32_IEEE 4 ALIGNMENT_FLOAT64_IEEE 4 DATA_SIZE 32 /end MOD_COMMON
/begin CHARACTERISTIC BPHUTEB "characteristic line for physically uegency für purge control" CURVE 0x805350F8 RB_Curve_S8_U8_Static 255.0 dez 0.00 255.0 FORMAT "%5.1"
 /begin AXIS_DESCR STD_AXIS fteadvir fak_q0p5 4 -64.00 63.50 FORMAT "%5.2" DEPOSIT ABSOLUTE /end AXIS_DESCR
/end CHARACTERISTIC
/begin CHARACTERISTIC CstrPurg_ChartcDlyTiCpv_M "Characteristic map for the canister purge valve (CPV) delay time (pressure ratio based)" MAP 0x80534834 RB_Map_U8U16_U16 655.3500 t_q0p01_ms 0.00 655.3500 FORMAT "%8.4"
 /begin AXIS_DESCR STD_AXIS BattU_u_ubrsq spg_q0p1 6 0.00 25.50 FORMAT "%5.2" DEPOSIT ABSOLUTE /end AXIS_DESCR
 /begin AXIS_DESCR STD_AXIS pndkpu_w_msg fak_uw_b8 5 0.00 7.999878 FORMAT "%8.6" DEPOSIT ABSOLUTE /end AXIS_DESCR
/end CHARACTERISTIC
/begin CHARACTERISTIC CstrPurg_dstMinBnk1LoLoad_C "minimum value for transportation distance in delay-time block for low load purge line" VALUE 0x80534FFA RB_Val_Wu16 0.9999390 fak_uw_b2 0.0000305 0.9999695 FORMAT "%9.7" EXTENDED_LIMITS 0.00 1.999969 /end CHARACTERISTIC
/begin CHARACTERISTIC CstrPurg_dstTrvlMFlowLoLd_M "Distance travelled by the mass flow in the transport model in delay-time block in the low load purge line." MAP 0x80534FFC RB_Map_U16S16_U16 0.9999390 fak_uw_b2 0.0000305 0.9999695 FORMAT "%9.7" EXTENDED_LIMITS 0.00 1.999969
 /begin AXIS_DESCR STD_AXIS rltevol_w_msg rel_uw_b100 8 0.00 99.99847 FORMAT "%8.5" DEPOSIT ABSOLUTE /end AXIS_DESCR
 /begin AXIS_DESCR STD_AXIS Epm_nEng EngN 5 -16384.00 16383.50 FORMAT "%8.2" DEPOSIT ABSOLUTE /end AXIS_DESCR
/end CHARACTERISTIC
/begin CHARACTERISTIC CstrPurg_facChartcFlowCorrnCpv_M "Map correction value for mass flow through the canister purge valve (CPV)" MAP 0x80534948 RB_Map_U16U16_U16 1.999969 fak_uw_b2 0.00 1.999969 FORMAT "%8.6"
 /begin AXIS_DESCR STD_AXIS tateout_w_msg rel_q0p00153 10 0.00 99.99847 FORMAT "%8.5" DEPOSIT ABSOLUTE /end AXIS_DESCR
 /begin AXIS_DESCR STD_AXIS CstrPurg_ratPLoLoadPurgLnToEnv fak_uw_b8 10 0.00 7.999878 FORMAT "%8.6" DEPOSIT ABSOLUTE /end AXIS_DESCR
/end CHARACTERISTIC
/begin CHARACTERISTIC CstrPurg_facChartcFlowCpv_M "Map flow-characteristic through canister purge line (CPV) incl. line from active carbon filter (ACF) to CPV - low load purge line" MAP 0x80534A3C RB_Map_S16U16_U16 1.999969 fak_uw_b2 0.00 1.999969 FORMAT "%8.6"
 /begin AXIS_DESCR STD_AXIS Epm_nEng EngN 8 -16384.00 16383.50 FORMAT "%8.2" DEPOSIT ABSOLUTE /end AXIS_DESCR
 /begin AXIS_DESCR STD_AXIS CstrPurg_ratPLoLoadPurgLnToEnv fak_uw_b8 20 0.00 7.999878 FORMAT "%8.6" DEPOSIT ABSOLUTE /end AXIS_DESCR
/end CHARACTERISTIC
/begin CHARACTERISTIC CstrPurg_facChartcFlowHalfEngModCpv_M "map flow-characteristic of CPV (incl. CPV carcoal-canister line) - during HEM or small cam" MAP 0x80534BB8 RB_Map_S16U16_U16 1.999969 fak_uw_b2 0.00 1.999969 FORMAT "%8.6"
 /begin AXIS_DESCR STD_AXIS Epm_nEng EngN 8 -16384.00 16383.50 FORMAT "%8.2" DEPOSIT ABSOLUTE /end AXIS_DESCR
 /begin AXIS_DESCR STD_AXIS CstrPurg_ratPLoLoadPurgLnToEnv fak_uw_b8 20 0.00 7.999878 FORMAT "%8.6" DEPOSIT ABSOLUTE /end AXIS_DESCR
/end CHARACTERISTIC
/begin CHARACTERISTIC CstrPurg_facCorrnAltiTCpvMod_T "Altitude correction factor" CURVE 0x80534D34 RB_Curve_U16_U16 1.999969 fak_sw_b1 0.00 1.999969 FORMAT "%8.6"
 /begin AXIS_DESCR STD_AXIS PEnv_facCorrAlti fak_uw_b4 6 0.00 3.999939 FORMAT "%8.6" DEPOSIT ABSOLUTE /end AXIS_DESCR
/end CHARACTERISTIC
/begin CHARACTERISTIC CstrPurg_facCpvDlyTiCorrn_Cur "Factor basic correction of the CPV delay time" CURVE 0x80534882 RB_Curve_U8_U8 1.992188 fak_ub_b2 0.00 1.992188 FORMAT "%8.6"
 /begin AXIS_DESCR STD_AXIS tCpvModloc temp_ub_q0p75_o48 4 -48.0 143.3 FORMAT "%5.1" DEPOSIT ABSOLUTE /end AXIS_DESCR
/end CHARACTERISTIC
/begin CHARACTERISTIC CstrPurg_facDeltaLam_C "factor for reset the filter during fuel cut off" VALUE 0x8053519C RB_Val_Wu16 15.99976 fak_uw_b16 0.00 15.99976 FORMAT "%8.5" /end CHARACTERISTIC
/begin CHARACTERISTIC CstrPurg_facDftEthGsl_C "default ethanol content in gasoline" VALUE 0x80535178 RB_Val_Wu16 1.999969 fak_uw_b2 0.00 1.999969 FORMAT "%8.6" /end CHARACTERISTIC
/begin CHARACTERISTIC CstrPurg_facDilPurgAirLoLoadPCmp_M "Characteristic map: filter factor of dilution purge flow with fresh air in low load purge line (depending on engine speed and air charge, pressure compensated)" MAP 0x8053506A RB_Map_U8U16_U8 0.9922 fak_ub_b1 0.0039 0.9961 EXTENDED_LIMITS 0.00 0.9961
 /begin AXIS_DESCR STD_AXIS Epm_nEngLRes EngN_LRes 6 0.00 10200. FORMAT "%5.0" DEPOSIT ABSOLUTE /end AXIS_DESCR
 /begin AXIS_DESCR STD_AXIS rltevol_w_msg rel_uw_b100 6 0.00 99.99847 FORMAT "%8.5" DEPOSIT ABSOLUTE /end AXIS_DESCR
/end CHARACTERISTIC
/begin CHARACTERISTIC CstrPurg_facDilPurgAirLoLoad_M "Characteristic map: filter factor of dilution purge flow with fresh air in low load purge line (depending on engine speed and air charge)" MAP 0x805350A2 RB_Map_U8U16_U8 0.9922 fak_ub_b1 0.0039 0.9961 EXTENDED_LIMITS 0.00 0.9961
 /begin AXIS_DESCR STD_AXIS Epm_nEngLRes EngN_LRes 6 0.00 10200. FORMAT "%5.0" DEPOSIT ABSOLUTE /end AXIS_DESCR
 /begin AXIS_DESCR STD_AXIS NO_INPUT_QUANTITY rel_uw_q0p0234 6 0.00 1535.977 FORMAT "%8.3" DEPOSIT ABSOLUTE /end AXIS_DESCR
/end CHARACTERISTIC
/begin CHARACTERISTIC CstrPurg_facDynDilLoLoadBnk1_GT "dynamic factor of dilution purge flow with fresh air in low load purge line" CURVE 0x805350DA RB_CurveGroup_U8 7.938 fak_ub_b8 0.031 7.969 FORMAT "%5.3" EXTENDED_LIMITS 0.00 7.969
 /begin AXIS_DESCR COM_AXIS qmsdyn fak_ub_b16 5 0.00 15.94 FORMAT "%5.2" AXIS_PTS_REF SQM05TEUB /end AXIS_DESCR
/end CHARACTERISTIC
/begin CHARACTERISTIC CstrPurg_facDynDlyBnk1LoLoad_GT "dynamic factor delay of purge flow in low load purge line" CURVE 0x805350E0 RB_CurveGroup_U16 0.003906190 t_q5p96046Em8_min 0.00 0.003906190 FORMAT "%11.9"
 /begin AXIS_DESCR COM_AXIS qmsdyn fak_ub_b16 5 0.00 15.94 FORMAT "%5.2" AXIS_PTS_REF SQM05TEUB /end AXIS_DESCR
/end CHARACTERISTIC
/begin CHARACTERISTIC CstrPurg_facFilBndyValCtrl_T "Characteristic curve factor time constant for filtering of limit control fuel evaporation" CURVE 0x8053519E RB_Curve_S8_U8_Static 0.9961 fak_ub_b1 0.00 0.9961
 /begin AXIS_DESCR STD_AXIS fteadf_msg fak_sb_b64 5 -64.00 63.50 FORMAT "%5.2" DEPOSIT ABSOLUTE /end AXIS_DESCR
/end CHARACTERISTIC
/begin CHARACTERISTIC CstrPurg_facImpsCstrLoadMax_T "the maximum threshold for ftead" CURVE 0x80535102 RB_Curve_S16_S16 127.9980 fak_sw_b64 -64.00000 63.99805 FORMAT "%8.5"
 /begin AXIS_DESCR STD_AXIS CstrPurg_temploc Temp_Cels 4 -3549.940 3003.560 FORMAT "%8.3" DEPOSIT ABSOLUTE /end AXIS_DESCR
/end CHARACTERISTIC
/begin CHARACTERISTIC CstrPurg_facImpsCstrLoadMin_C "the minimum threshold for ftead" VALUE 0x80535114 RB_Val_Ws16 127.9980 fak_sw_b64 -64.00000 63.99805 FORMAT "%8.5" /end CHARACTERISTIC
/begin CHARACTERISTIC CstrPurg_facLoadCoeff_T "curve load coefficient" CURVE 0x80534D4E RB_Curve_U16_U16 3.999939 fak_uw_b4 0.00 3.999939 FORMAT "%8.6"
 /begin AXIS_DESCR STD_AXIS rl_w_msg rel_uw_q0p0234 8 0.00 1535.977 FORMAT "%8.3" DEPOSIT ABSOLUTE /end AXIS_DESCR
/end CHARACTERISTIC
/begin CHARACTERISTIC CstrPurg_facLoadIni_C "Initial factor factor canister purge valve temperature effect on account of the vehicle speed and the weighteded filtered load" VALUE 0x80534D70 RB_Val_Ws16 1.999969 fak_sw_b1 -1.000000 0.999969 FORMAT "%8.6" EXTENDED_LIMITS -1.000000 0.9999695 /end CHARACTERISTIC
/begin CHARACTERISTIC CstrPurg_facLoad_M "Characteristic field to the determination of the unfiltered factor canister purge valve temperature effect on account of the vehicle speed and the weighteded filtered load" MAP 0x80534D72 RB_Map_S16U16_S16 1.999969 fak_sw_b1 -1.000000 0.999969 FORMAT "%8.6" EXTENDED_LIMITS -1.000000 0.9999695
 /begin AXIS_DESCR STD_AXIS VehV_v Vel 6 -327.6800 327.6700 FORMAT "%8.4" DEPOSIT ABSOLUTE /end AXIS_DESCR
 /begin AXIS_DESCR STD_AXIS CstrPurg_ratWghtRelAirFillgFilt rel_uw_q0p0234 4 0.00 1535.977 FORMAT "%8.3" DEPOSIT ABSOLUTE /end AXIS_DESCR
/end CHARACTERISTIC
/begin CHARACTERISTIC CstrPurg_facPurgCtrlAdapnOffs_T "Offset value for purge control adaption" CURVE 0x8053472C RB_Curve_S16_S16 127.9980 fak_sw_b64 -64.00000 63.99805 FORMAT "%8.5"
 /begin AXIS_DESCR STD_AXIS CstrPurg_facLamDeMin fak_sw_b1 5 -1.000000 0.999969 FORMAT "%8.6" EXTENDED_LIMITS -1.000000 0.9999695 DEPOSIT ABSOLUTE /end AXIS_DESCR
/end CHARACTERISTIC
/begin CHARACTERISTIC CstrPurg_facPurgRateRednMin_C "Minimum value of purge rate reduction due to deviations of lambda controller" VALUE 0x80534742 RB_Val_Wu8 15.94 fak_ub_b16 0.00 15.94 FORMAT "%5.2" /end CHARACTERISTIC
/begin CHARACTERISTIC CstrPurg_facStoiAirFlexfu_T "stoichiometric air-to-fuel ratio of gas-ethanol-mixture dependent on the ethanol content" CURVE 0x8053517A RB_Curve_U16_U16 15.99976 fak_uw_b16 0.00 15.99976 FORMAT "%8.5"
 /begin AXIS_DESCR STD_AXIS CstrPurg_facEthGsl fak_uw_b2 5 0.00 1.999969 FORMAT "%8.6" DEPOSIT ABSOLUTE /end AXIS_DESCR
/end CHARACTERISTIC
/begin CHARACTERISTIC CstrPurg_facTCorrnFuPurgAdpn_M "Correction factor for fuel purge adaptation based on temperature and engine off state" MAP 0x80534744 RB_Map_U16S16_U16 1.999969 fak_uw_b2 0.00 1.999969 FORMAT "%8.6"
 /begin AXIS_DESCR STD_AXIS TiEngOff_ti_loc t_q1 6 0.00 65535.00 FORMAT "%8.2" DEPOSIT ABSOLUTE /end AXIS_DESCR
 /begin AXIS_DESCR STD_AXIS CstrPurg_tPurgAdpnCorrn Temp_Cels 6 -3549.940 3003.560 FORMAT "%8.3" DEPOSIT ABSOLUTE /end AXIS_DESCR
/end CHARACTERISTIC
/begin CHARACTERISTIC CstrPurg_fakMFlowAcfIni_C "init value of the factor containing the fuel part of the massflow from ACF in order to take into considerantion the cooling effect in CPV" VALUE 0x80534DBA RB_Val_Wu16 0.9999847 fak_uw_b1 0.00 0.9999847 FORMAT "%9.7" /end CHARACTERISTIC
/begin CHARACTERISTIC CstrPurg_fakMFlowAcfLd_M "Map for determination of the factor containing the fuel part of the massflow from ACF in order to take into considerantion the cooling effect in CPV" MAP 0x80534DBC RB_Map_U16S16_U16 0.9999847 fak_uw_b1 0.00 0.9999847 FORMAT "%9.7"
 /begin AXIS_DESCR STD_AXIS mste_w_msg m_uw_b25p6 6 0.00 25.59961 FORMAT "%8.5" DEPOSIT ABSOLUTE /end AXIS_DESCR
 /begin AXIS_DESCR STD_AXIS ftead_w_msg fak_sw_b64 6 -64.00000 63.99805 FORMAT "%8.5" DEPOSIT ABSOLUTE /end AXIS_DESCR
/end CHARACTERISTIC
/begin CHARACTERISTIC CstrPurg_fakRadrCoolgIni_C "init value CPV cooling effect due to vehicle speed and radiator shutter position" VALUE 0x80534E20 RB_Val_Ws16 1.999969 fak_sw_b1 -1.000000 0.999969 FORMAT "%8.6" EXTENDED_LIMITS -1.000000 0.9999695 /end CHARACTERISTIC
/begin CHARACTERISTIC CstrPurg_fakRadrCoolg_M "Map for determination of the factor, CPV cooling effect due to vehicle speed and radiator shutter position" MAP 0x80534E22 RB_Map_S16U16_S16 1.999969 fak_sw_b1 -1.000000 0.999969 FORMAT "%8.6" EXTENDED_LIMITS -1.000000 0.9999695
 /begin AXIS_DESCR STD_AXIS VehV_v Vel 6 -327.6800 327.6700 FORMAT "%8.4" DEPOSIT ABSOLUTE /end AXIS_DESCR
 /begin AXIS_DESCR STD_AXIS CstrPurg_ratRadShtDes rel_uw_b200 4 0.00 199.9969 FORMAT "%8.4" DEPOSIT ABSOLUTE /end AXIS_DESCR
/end CHARACTERISTIC
/begin CHARACTERISTIC CstrPurg_LambdaEnaMax_C "Lambda control factor Maximum calibration value" VALUE 0x80534EDA RB_Val_Wu16 1.999969 fak_uw_b2 0.00 1.999969 FORMAT "%8.6" /end CHARACTERISTIC
/begin CHARACTERISTIC CstrPurg_LambdaEnaMin_C "Lambda control factor Minimum calibration value" VALUE 0x80534EDC RB_Val_Wu16 1.999969 fak_uw_b2 0.00 1.999969 FORMAT "%8.6" /end CHARACTERISTIC
/begin CHARACTERISTIC CstrPurg_nEngMinDlyLoLoad_C "Minimum Engine speed for calculating the distance travelled by the mass flow in the transport model in delay-time block in the low load purge line." VALUE 0x805350EA RB_Val_Wu16 32767.50 EngN 0.00 32767.50 FORMAT "%8.2" /end CHARACTERISTIC
/begin CHARACTERISTIC CstrPurg_nEngThd_T "Additional threshold for engine speed out of idle speed for canister purge control" CURVE 0x80534EDE RB_Curve_S16_S16 32767.50 EngN -16384.00 16383.50 FORMAT "%8.2"
 /begin AXIS_DESCR STD_AXIS VehV_v Vel 8 -327.6800 327.6700 FORMAT "%8.4" DEPOSIT ABSOLUTE /end AXIS_DESCR
/end CHARACTERISTIC
/begin CHARACTERISTIC CstrPurg_ratMinChgReIni_C "Minimum change in the duty cycle that leads to an immediate adoption of the new duty cycle" VALUE 0x8053488C RB_Val_Wu16 89.99786 rel_q0p00153 10.00061 99.99847 FORMAT "%8.5" EXTENDED_LIMITS 0.00 99.99847 /end CHARACTERISTIC
/begin CHARACTERISTIC CstrPurg_ratWghtRelAirFillgIni_C "Initial factor weighteded relative air charge" VALUE 0x80534E6A RB_Val_Wu16 1535.977 rel_uw_q0p0234 0.00 1535.977 FORMAT "%8.3" /end CHARACTERISTIC
/begin CHARACTERISTIC CstrPurg_stCpvClsFcoDly_C "codeword for reset the filter after a delay when fuel cut off is finished" VALUE 0x805351AA RB_Val_Wu8 255.0 dez 0.00 255.0 FORMAT "%5.1" /end CHARACTERISTIC
/begin CHARACTERISTIC CstrPurg_stIniTESKSOL_C "Codeword for initialisation in the function: Set value calculation for specific fuel rate of purge control (TESKSOL)" VALUE 0x805351AB RB_Val_Wu8 255.0 OneToOne 0.00 255.0 FORMAT "%5.1" /end CHARACTERISTIC
/begin CHARACTERISTIC CstrPurg_stSelnLamRdy_C "Lambda selection ready for Canister Purging" VALUE 0x80534F34 RB_Val_Wu8 255.0 dez 0.00 255.0 FORMAT "%5.1" /end CHARACTERISTIC
/begin CHARACTERISTIC CstrPurg_stTMdl_C "CW to configure the temperature model of the CPV" VALUE 0x8053488E RB_Val_Wu8 255.0 dez 0.00 255.0 FORMAT "%5.1" /end CHARACTERISTIC
/begin CHARACTERISTIC CstrPurg_tiBndyValCtrl_M "time constant for filtering of boundary value control fuel evaporation" MAP 0x805351AC RB_Map_S16U16_U8 25.40 t_q0p1 0.10 25.50 FORMAT "%5.2" EXTENDED_LIMITS 0.00 25.50
 /begin AXIS_DESCR STD_AXIS Epm_nEng EngN 5 -16384.00 16383.50 FORMAT "%8.2" DEPOSIT ABSOLUTE /end AXIS_DESCR
 /begin AXIS_DESCR STD_AXIS rl_w_msg rel_uw_q0p0234 5 0.00 1535.977 FORMAT "%8.3" DEPOSIT ABSOLUTE /end AXIS_DESCR
/end CHARACTERISTIC
/begin CHARACTERISTIC CstrPurg_tiCpvClsFcoDly_C "time delay to reset the filter during fuel cut off" VALUE 0x805351DE RB_Val_Wu8 25.50 t_q0p1 0.00 25.50 FORMAT "%5.2" /end CHARACTERISTIC
/begin CHARACTERISTIC CstrPurg_tiCstrLdAdpnDly_C "Canister load adaption Delay time after fuel cut off was disabled" VALUE 0x805347A8 RB_Val_Wu8 25.50 t_q0p1 0.00 25.50 FORMAT "%5.2" /end CHARACTERISTIC
/begin CHARACTERISTIC CstrPurg_tiFakMFlowAcfLd_T "Filtered factor, load of the massflow flowing through the CPV" CURVE 0x80534E6C RB_Curve_U16_U16 1310.680 t_q0p02 0.020 1310.700 FORMAT "%8.3" EXTENDED_LIMITS 0.00 1310.700
 /begin AXIS_DESCR STD_AXIS mste_w_msg m_uw_b25p6 5 0.00 25.59961 FORMAT "%8.5" DEPOSIT ABSOLUTE /end AXIS_DESCR
/end CHARACTERISTIC
/begin CHARACTERISTIC CstrPurg_tiFilEtc_M "Filter-Value for the distance-Modeling from ETC to CPV" MAP 0x80534E82 RB_Map_U16U16_U16 1310.680 t_q0p02 0.020 1310.700 FORMAT "%8.3" EXTENDED_LIMITS 0.00 1310.700
 /begin AXIS_DESCR STD_AXIS rl_w_msg rel_uw_q0p0234 5 0.00 1535.977 FORMAT "%8.3" DEPOSIT ABSOLUTE /end AXIS_DESCR
 /begin AXIS_DESCR STD_AXIS CstrPurg_tDifThr2Env temp_q0p0234_o273 5 0.014 1262.827 FORMAT "%8.3" EXTENDED_LIMITS -273.1500 1262.827 DEPOSIT ABSOLUTE /end AXIS_DESCR
/end CHARACTERISTIC
/begin CHARACTERISTIC CstrPurg_tiInhLamDevMax_C "Max. time for a large deviation in the lambda value to inhibit the canister purging" VALUE 0x80534F00 RB_Val_Wu16 6553.500 t_q0p1 0.00 6553.500 FORMAT "%8.3" /end CHARACTERISTIC
/begin CHARACTERISTIC CstrPurg_tiLoadFilt_C "Time constant for filtering of the factor canister purge valve temperature effect on account of the vehicle speed and the weighteded filtered load" VALUE 0x80534ECC RB_Val_Wu16 1310.680 t_q0p02 0.020 1310.700 FORMAT "%8.3" EXTENDED_LIMITS 0.00 1310.700 /end CHARACTERISTIC
/begin CHARACTERISTIC CstrPurg_tiMfRmpDwnDft_C "Default Ramp down time for desired mass flow" VALUE 0x80534F3A RB_Val_Wu8 5.100 t20msxs_uw_b1310 0.00 5.100 FORMAT "%5.3" /end CHARACTERISTIC
/begin CHARACTERISTIC CstrPurg_tiRadrCoolgFilt_C "Time constante for filtering factor, CPV cooling effect due to vehicle speed and radiator shutter position" VALUE 0x80534ECE RB_Val_Wu16 1310.6999997 zk20msxs_uw_b1310p72 0.0200003 1310.7200000 FORMAT "%12.7" EXTENDED_LIMITS 0.020000305180 1310.7200000 /end CHARACTERISTIC
/begin CHARACTERISTIC CstrPurg_tiWghtRelAirFillgFilt_C "Time constant for filtering of the weighteded relative air charge" VALUE 0x80534ED0 RB_Val_Wu16 1310.680 t_q0p02 0.020 1310.700 FORMAT "%8.3" EXTENDED_LIMITS 0.00 1310.700 /end CHARACTERISTIC
/begin CHARACTERISTIC CstrPurg_ttadkmax_C "maximum intake air temperature at throttle" VALUE 0x80534ED2 RB_Val_Wu16 1535.977 temp_q0p0234_o273 -273.150 1262.827 FORMAT "%8.3" /end CHARACTERISTIC
/begin CHARACTERISTIC CstrPurg_uBattMax_C "Maximum battery voltage for fuel purge activated" VALUE 0x80534F02 RB_Val_Ws16 1310700. Volt_Batt -655360.0 655340.0 FORMAT "%8.1" /end CHARACTERISTIC
/begin CHARACTERISTIC CstrPurg_uBattMin_C "Minimum battery voltage for fuel purge activated" VALUE 0x80534F04 RB_Val_Ws16 1310700. Volt_Batt -655360.0 655340.0 FORMAT "%8.1" /end CHARACTERISTIC
/begin CHARACTERISTIC CWDTETERK "Configuration for the relative fuel part calculation in the fuel purge system" VALUE 0x805350EC RB_Val_Wu8 255.0 dez 0.00 255.0 FORMAT "%5.1" /end CHARACTERISTIC
/begin CHARACTERISTIC CWFPC "Codeword fuel purge control" VALUE 0x80534F06 RB_Val_Wu8 255.0 dez 0.00 255.0 FORMAT "%5.1" /end CHARACTERISTIC
/begin CHARACTERISTIC CWFPCES "Codeword closed loop purge control for error suspicion" VALUE 0x80534F07 RB_Val_Wu8 255.0 dez 0.00 255.0 FORMAT "%5.1" /end CHARACTERISTIC
/begin CHARACTERISTIC CWFPCKH "codeword to configure purge control during catalyst heating" VALUE 0x80534F08 RB_Val_Wu8 255.0 dez 0.00 255.0 FORMAT "%5.1" /end CHARACTERISTIC
/begin CHARACTERISTIC CWFPCPHU "codeword physical urgency fuel purge control" VALUE 0x80535116 RB_Val_Wu8 255.0 dez 0.00 255.0 FORMAT "%5.1" /end CHARACTERISTIC
/begin CHARACTERISTIC CWFPCPRIO "codeword to activate high canister load" VALUE 0x80534F09 RB_Val_Wu8 255.0 dez 0.00 255.0 FORMAT "%5.1" /end CHARACTERISTIC
/begin CHARACTERISTIC CWFPCTEN "Code word: reset integral of purge mass flow (imsteini) in case of tank ventilation in emergency" VALUE 0x805351DF RB_Val_Wu8 255.0 dez 0.00 255.0 FORMAT "%5.1" /end CHARACTERISTIC
/begin CHARACTERISTIC CWFPCTVTEV "Codeword choice pressure ratio or absolute pressure" VALUE 0x8053488F RB_Val_Wu8 255.0 dez 0.00 255.0 FORMAT "%5.1" /end CHARACTERISTIC
/begin CHARACTERISTIC CWFTEVFTEAD "Codeword for the configuration of the relative canister purge valve (CPV) opening dependent of the fuel purge adaptation factor" VALUE 0x805351E0 RB_Val_Wu8 255.0 dez 0.00 255.0 FORMAT "%5.1" /end CHARACTERISTIC
/begin CHARACTERISTIC CWTEBGTEV "Codeword for several configurations in the function: calculation of the actual massflow (TEBGTEV)" VALUE 0x80534ED4 RB_Val_Wu8 255.0 dez 0.00 255.0 FORMAT "%5.1" /end CHARACTERISTIC
/begin CHARACTERISTIC CWTEINI "Codeword to switch between ambient air temperature, engine temperature or the model temperature for fuel" VALUE 0x805351E1 RB_Val_Wu8 255.0 dez 0.00 255.0 FORMAT "%5.1" /end CHARACTERISTIC
/begin CHARACTERISTIC CWTERK "Configuration for the relative fuel part calculation in the fuel purge system" VALUE 0x805350ED RB_Val_Wu8 255.0 dez 0.00 255.0 FORMAT "%5.1" /end CHARACTERISTIC
/begin CHARACTERISTIC CWTTEV "Codeword choice for canister purge valve (CPV) duty cycle through tester request" VALUE 0x80534890 RB_Val_Wu8 255.0 dez 0.00 255.0 FORMAT "%5.1" /end CHARACTERISTIC
/begin CHARACTERISTIC DRLTELL "Delta hyteresis for the minimum air filling at the idle speed" VALUE 0x80534F0A RB_Val_Wu16 1535.977 rel_q0p0234 0.00 1535.977 FORMAT "%8.3" /end CHARACTERISTIC
/begin CHARACTERISTIC FBTEFKA "Correction factor for the learning speed of the fuel purge adaptation due to the actual specific fuel amount" CURVE 0x805347A9 RB_Curve_U8_U8 0.9961 fak_ub_b1 0.00 0.9961
 /begin AXIS_DESCR STD_AXIS fkaste_msg fak_ub_b0p5 5 0.00 0.4980 DEPOSIT ABSOLUTE /end AXIS_DESCR
/end CHARACTERISTIC
/begin CHARACTERISTIC FBTEFKAX "Correction factor for the learning speed of the fuel purge adaptation due to the max. possible specific fuel amount" CURVE 0x805347B4 RB_Curve_U8_U8 0.9961 fak_ub_b1 0.00 0.9961
 /begin AXIS_DESCR STD_AXIS fkastexm fak_ub_b0p5 5 0.00 0.4980 DEPOSIT ABSOLUTE /end AXIS_DESCR
/end CHARACTERISTIC
/begin CHARACTERISTIC FGWRMSMX "Max. value of the lambda controller depending mass flow reduction" VALUE 0x80534F3B RB_Val_Wu8 15.94 fak_ub_b16 0.00 15.94 FORMAT "%5.2" /end CHARACTERISTIC
/begin CHARACTERISTIC FKAKORBMN "minimum of the range of fkakormt_w for identification of mixture error suspicion" VALUE 0x80535118 RB_Val_Wu16 1.999969 fak_uw_b2 0.00 1.999969 FORMAT "%8.6" /end CHARACTERISTIC
/begin CHARACTERISTIC FKAKORBMX "maximum of the range of fkakormt_w for identification of mixture error suspicion" VALUE 0x8053511A RB_Val_Wu16 1.999969 fak_uw_b2 0.00 1.999969 FORMAT "%8.6" /end CHARACTERISTIC
/begin CHARACTERISTIC FKAPROG "Progression for opening speed for the specific fuel purge fuel amount calculation" CURVE 0x805351E2 RB_Curve_U8_U8 7.969 fak_ub_b8 0.00 7.969 FORMAT "%5.3"
 /begin AXIS_DESCR STD_AXIS fkastes fak_ub_b0p5 5 0.00 0.4980 DEPOSIT ABSOLUTE /end AXIS_DESCR
/end CHARACTERISTIC
/begin CHARACTERISTIC FKASTINXH "Characteristic line maximum specific fuel amount with integral of purge mass flow after long purge stop" CURVE 0x805351EE RB_Curve_U8_U16_Static 0.4999924 fak_uw_b0p5 0.00 0.4999924 FORMAT "%9.7"
 /begin AXIS_DESCR STD_AXIS imsteini_msg m_ub_q0p0444 5 0.00 11.32 FORMAT "%5.2" DEPOSIT ABSOLUTE /end AXIS_DESCR
/end CHARACTERISTIC
/begin CHARACTERISTIC FKATEB "Characteristic curve for fuel portion depending on injection time to minimum injection time" CURVE 0x805351FE RB_Curve_U8_U8 0.9961 fak_ub_b1 0.00 0.9961
 /begin AXIS_DESCR STD_AXIS qtetemin_msg fak_ub_b4 4 0.00 3.984 FORMAT "%5.3" DEPOSIT ABSOLUTE /end AXIS_DESCR
/end CHARACTERISTIC
/begin CHARACTERISTIC FKATEIBGMN "Min threshold for evaluation gradient fuel rate purge control" VALUE 0x8053511C RB_Val_Ws8 3.984 fak_sb_b2 -2.000 1.984 FORMAT "%5.3" /end CHARACTERISTIC
/begin CHARACTERISTIC FKATEINPMN "Min threshold for identification of unplausible fuel rate purge control" VALUE 0x8053511D RB_Val_Ws8 1.992 fak_sb_b1 -1.000 0.992 FORMAT "%5.3" EXTENDED_LIMITS -1.000 0.9922 /end CHARACTERISTIC
/begin CHARACTERISTIC FKATEINPMX "Max threshold for identification of unplausible fuel rate purge control" VALUE 0x8053511E RB_Val_Ws8 3.984 fak_sb_b2 -2.000 1.984 FORMAT "%5.3" /end CHARACTERISTIC
/begin CHARACTERISTIC FPCtl_mfThdCpvFlow_C "lower threshold for the integrated purge mass flow" VALUE 0x80534F0C RB_Val_Wu8 11.32 m_ub_q0p0444 0.00 11.32 FORMAT "%5.2" /end CHARACTERISTIC
/begin CHARACTERISTIC FRKTEMN "Factor for minimum permissible relative fuel part calculation in the fuel purge system" VALUE 0x805350EE RB_Val_Ws16 1.999969 fak_sw_b1 -1.000000 0.999969 FORMAT "%8.6" EXTENDED_LIMITS -1.000000 0.9999695 /end CHARACTERISTIC
/begin CHARACTERISTIC FRKTEMX "Factor for maximum permissible relative fuel part calculation in the fuel purge system" VALUE 0x805350F0 RB_Val_Ws16 1.999969 fak_sw_b1 -1.000000 0.999969 FORMAT "%8.6" EXTENDED_LIMITS -1.000000 0.9999695 /end CHARACTERISTIC
/begin CHARACTERISTIC FSRFKAS "Factor for control speed of specific purge fuel rate controller" VALUE 0x80535207 RB_Val_Wu8 31.75 fak_ub_b64 0.25 32.00 FORMAT "%5.2" EXTENDED_LIMITS 0.00 63.75 /end CHARACTERISTIC
/begin CHARACTERISTIC FTEADMAX "maximum value purge control adaptation" VALUE 0x805347BF RB_Val_Ws8 127.5 fak_sb_b64 -64.00 63.50 FORMAT "%5.2" /end CHARACTERISTIC
/begin CHARACTERISTIC FTEADMINH "minimum limitation purge control adaptation homogenous mode" VALUE 0x805347C0 RB_Val_Ws8 127.5 fak_sb_b64 -64.00 63.50 FORMAT "%5.2" /end CHARACTERISTIC
/begin CHARACTERISTIC FTEADRPL "load threshold for reset from medium load to low load" VALUE 0x80534F0D RB_Val_Ws8 127.5 fak_sb_b64 -64.00 63.50 FORMAT "%5.2" /end CHARACTERISTIC
/begin CHARACTERISTIC FTEADSPH "load threshold for set from medium load to high load" VALUE 0x80534F0E RB_Val_Ws8 127.5 fak_sb_b64 -64.00 63.50 FORMAT "%5.2" /end CHARACTERISTIC
/begin CHARACTERISTIC FTVTEVTANS "Factor delay time correction by temperature of the sucked in air" CURVE 0x80534891 RB_Curve_U8_U8 1.992188 fak_ub_b2 0.00 1.992188 FORMAT "%8.6"
 /begin AXIS_DESCR STD_AXIS tansloc temp_ub_q0p75_o48 4 -48.0 143.3 FORMAT "%5.1" DEPOSIT ABSOLUTE /end AXIS_DESCR
/end CHARACTERISTIC
/begin CHARACTERISTIC FuPurg_facAdpnVlvLftMax_C "maximum ftead to request large valve lift during high canister load" VALUE 0x80534ED6 RB_Val_Ws8 127.5 fak_sb_b64 -64.00 63.50 FORMAT "%5.2" /end CHARACTERISTIC
/begin CHARACTERISTIC FuPurg_facAdpnVlvLftMin_C "minimum ftead to reset request of large valve lift during high canister load" VALUE 0x80534ED7 RB_Val_Ws8 127.5 fak_sb_b64 -64.00 63.50 FORMAT "%5.2" /end CHARACTERISTIC
/begin CHARACTERISTIC FuPurg_stCfgExtReqCoorn_C "Codeword for configuration of external system reaction on high canister load" VALUE 0x80534ED8 RB_Val_Wu8 255.0 dez 0.00 255.0 FORMAT "%5.1" /end CHARACTERISTIC
/begin CHARACTERISTIC IMSTEFVMN "Threshold minimum purge rate for error suspicion fuel purge control" VALUE 0x80535120 RB_Val_Wu16 2909.754 m_ub_q0p0444 0.00 2909.754 FORMAT "%8.3" /end CHARACTERISTIC
/begin CHARACTERISTIC IMSTFTEVMN "Min. threshold for the integrated mass flow through the canister purge valve (CPV) to limit the relative CPV opening dependent of fuel purge adaptation factor" VALUE 0x80535208 RB_Val_Wu8 11.32 m_ub_q0p0444 0.00 11.32 FORMAT "%5.2" /end CHARACTERISTIC
/begin CHARACTERISTIC KFDMSTES "characteristic line maximum increase of purge mass flow" MAP 0x80534F3C RB_Map_U16U8_U16 26214.07 mgrad_q0p400001 0.00 26214.07 FORMAT "%8.2"
 /begin AXIS_DESCR STD_AXIS mstesoll_w_msg m_uw_b25p6 5 0.00 25.59961 FORMAT "%8.5" DEPOSIT ABSOLUTE /end AXIS_DESCR
 /begin AXIS_DESCR STD_AXIS mksbg_msg m_ub_b25p6 6 0.00 25.50 FORMAT "%5.2" DEPOSIT ABSOLUTE /end AXIS_DESCR
/end CHARACTERISTIC
/begin CHARACTERISTIC KFFGWRKA "Map for purge rate reduction due to deviations of lambda controller" MAP 0x80535209 RB_Map_U8U8_U8 15.94 fak_ub_b16 0.00 15.94 FORMAT "%5.2"
 /begin AXIS_DESCR STD_AXIS fkakordl fak_ub_b4 10 0.00 3.984 FORMAT "%5.3" DEPOSIT ABSOLUTE /end AXIS_DESCR
 /begin AXIS_DESCR STD_AXIS mksbg_msg m_ub_b25p6 6 0.00 25.50 FORMAT "%5.2" DEPOSIT ABSOLUTE /end AXIS_DESCR
/end CHARACTERISTIC
/begin CHARACTERISTIC KFFKASVHE "characteristic map max. spec. purge fuel amount for variable valve lifting" MAP 0x80535257 RB_MapGroup_U8 0.4980 fak_ub_b0p5 0.00 0.4980
 /begin AXIS_DESCR COM_AXIS mksbg_msg m_ub_b25p6 5 0.00 25.50 FORMAT "%5.2" AXIS_PTS_REF SMK05TEUB /end AXIS_DESCR
 /begin AXIS_DESCR COM_AXIS tans_msg temp_ub_q0p75_o48 4 -48.0 143.3 FORMAT "%5.1" AXIS_PTS_REF STA04TEUB /end AXIS_DESCR
/end CHARACTERISTIC
/begin CHARACTERISTIC KFFKASX "Characteristic map for max. specific fuel purge fuel amount" MAP 0x8053526B RB_MapGroup_U8 0.4980 fak_ub_b0p5 0.00 0.4980
 /begin AXIS_DESCR COM_AXIS mksbg_msg m_ub_b25p6 5 0.00 25.50 FORMAT "%5.2" AXIS_PTS_REF SMK05TEUB /end AXIS_DESCR
 /begin AXIS_DESCR COM_AXIS tans_msg temp_ub_q0p75_o48 4 -48.0 143.3 FORMAT "%5.1" AXIS_PTS_REF STA04TEUB /end AXIS_DESCR
/end CHARACTERISTIC
/begin CHARACTERISTIC KFFTEAD "curve factor purge control adaptation" MAP 0x805347C1 RB_Map_U8U8_U8 79.69 perio_q0p3125 0.00 79.69 FORMAT "%5.2"
 /begin AXIS_DESCR STD_AXIS mksbg_msg m_ub_b25p6 5 0.00 25.50 FORMAT "%5.2" DEPOSIT ABSOLUTE /end AXIS_DESCR
 /begin AXIS_DESCR STD_AXIS imsteini_msg m_ub_q0p0444 3 0.00 11.32 FORMAT "%5.2" DEPOSIT ABSOLUTE /end AXIS_DESCR
/end CHARACTERISTIC
/begin CHARACTERISTIC KFFTEVFTEADLIM "Characteristic map for max. percentage of purge valve opening near full load in port fuel injection mode (PFI-mode) for fuel purge adaptation factor" MAP 0x80535280 RB_Map_S16S16_S16 0.9999695 fak_sw_b1 0.00 0.9999695 FORMAT "%9.7" EXTENDED_LIMITS -1.000000 0.9999695
 /begin AXIS_DESCR STD_AXIS ftead_w_msg fak_sw_b64 4 -64.00000 63.99805 FORMAT "%8.5" DEPOSIT ABSOLUTE /end AXIS_DESCR
 /begin AXIS_DESCR STD_AXIS pdiff_w p_sw_q0p039 6 -1280.000 1279.961 FORMAT "%8.3" DEPOSIT ABSOLUTE /end AXIS_DESCR
/end CHARACTERISTIC
/begin CHARACTERISTIC KFFTEVFX "characteristic map for max. percentage of purge valve opening" MAP 0x805352C8 RB_Map_U16U8_U8 0.9961 fak_ub_b1 0.00 0.9961
 /begin AXIS_DESCR STD_AXIS EpmnEng_nmotw nmot_uw_q0p25 4 0.00 16383.75 FORMAT "%8.2" DEPOSIT ABSOLUTE /end AXIS_DESCR
 /begin AXIS_DESCR STD_AXIS pndkpu_msg fak_ub_b2 4 0.00 1.992188 FORMAT "%8.6" DEPOSIT ABSOLUTE /end AXIS_DESCR
/end CHARACTERISTIC
/begin CHARACTERISTIC KFFTEVLIM "Characteristic map for max. percentage of purge valve opening near full load in port fuel injection mode (PFI-mode) for engine speed" MAP 0x805352E8 RB_Map_U16S16_S16 0.9999695 fak_sw_b1 0.00 0.9999695 FORMAT "%9.7" EXTENDED_LIMITS -1.000000 0.9999695
 /begin AXIS_DESCR STD_AXIS EpmnEng_nmotw nmot_uw_q0p25 5 0.00 16383.75 FORMAT "%8.2" DEPOSIT ABSOLUTE /end AXIS_DESCR
 /begin AXIS_DESCR STD_AXIS pdiff_w p_sw_q0p039 6 -1280.000 1279.961 FORMAT "%8.3" DEPOSIT ABSOLUTE /end AXIS_DESCR
/end CHARACTERISTIC
/begin CHARACTERISTIC KFHTEKAH "characteristic map of desired fuel portion purge control in homogeneous mode" MAP 0x8053533E RB_MapGroup_U8 0.9961 fak_ub_b1 0.00 0.9961
 /begin AXIS_DESCR COM_AXIS Epm_nEngLRes EngN_LRes 4 0.00 10200. FORMAT "%5.0" AXIS_PTS_REF SNM04TEUB /end AXIS_DESCR
 /begin AXIS_DESCR COM_AXIS misol_w_msg rel_uw_b100 8 0.00 99.99847 FORMAT "%8.5" AXIS_PTS_REF SMI08TEUW /end AXIS_DESCR
/end CHARACTERISTIC
/begin CHARACTERISTIC KFKASNH "Characteristic map for max. specific fuel purge fuel amount for limp home homogeneous mode" MAP 0x8053535E RB_MapGroup_U8 0.4980 fak_ub_b0p5 0.00 0.4980
 /begin AXIS_DESCR COM_AXIS Epm_nEngLRes EngN_LRes 4 0.00 10200. FORMAT "%5.0" AXIS_PTS_REF SNM04TEUB /end AXIS_DESCR
 /begin AXIS_DESCR COM_AXIS misol_w_msg rel_uw_b100 4 0.00 99.99847 FORMAT "%8.5" AXIS_PTS_REF SMI04TEUW /end AXIS_DESCR
/end CHARACTERISTIC
/begin CHARACTERISTIC KFKORMTMOD "characteristic map for max. percentage of purge valve opening" MAP 0x805347DA RB_Map_U8U16_U16 1.999969 fak_uw_b2 0.00 1.999969 FORMAT "%8.6"
 /begin AXIS_DESCR STD_AXIS mksbg_msg m_ub_b25p6 4 0.00 25.50 FORMAT "%5.2" DEPOSIT ABSOLUTE /end AXIS_DESCR
 /begin AXIS_DESCR STD_AXIS fkakormt_loc fak_uw_b2 8 0.00 1.999969 FORMAT "%8.6" DEPOSIT ABSOLUTE /end AXIS_DESCR
/end CHARACTERISTIC
/begin CHARACTERISTIC KFTEINI "Map to calculate the time for detecting a purge stop based on ambient air, engine or model temperature of the fuel and the fuel purge adaptation factor" MAP 0x8053536E RB_Map_S16U8_U16 6553.500 t_q0p1 0.00 6553.500 FORMAT "%8.3"
 /begin AXIS_DESCR STD_AXIS fteadf_msg fak_sb_b64 6 -64.00000 63.50000 FORMAT "%8.5" EXTENDED_LIMITS -16384.00 16383.50 DEPOSIT ABSOLUTE /end AXIS_DESCR
 /begin AXIS_DESCR STD_AXIS teini temp_ub_q0p75_o48 6 -48.0 143.3 FORMAT "%5.1" DEPOSIT ABSOLUTE /end AXIS_DESCR
/end CHARACTERISTIC
/begin CHARACTERISTIC KFTETPU "map temperature pressure fuel purge control" MAP 0x80535122 RB_Map_U8U8_U8 1.992 fak_q0p0078 0.00 1.992 FORMAT "%5.3"
 /begin AXIS_DESCR STD_AXIS EnvTt_tumg temp_ub_q0p75_o48 4 -48.0 143.3 FORMAT "%5.1" DEPOSIT ABSOLUTE /end AXIS_DESCR
 /begin AXIS_DESCR STD_AXIS PEnv_pu p_ub_q5 4 0.00 1275. FORMAT "%5.0" DEPOSIT ABSOLUTE /end AXIS_DESCR
/end CHARACTERISTIC
/begin CHARACTERISTIC KFTEVP "Characteristic map for time period of the Canister purge valve" MAP 0x8053489A RB_Map_U8U8_U8 127.0 t500usxms_ub_q0p5 0.5 127.5 FORMAT "%5.1" EXTENDED_LIMITS 0.00 127.5
 /begin AXIS_DESCR STD_AXIS Epm_nEngLRes_nmot nmot_ub_q40 5 0.00 10200. FORMAT "%5.0" DEPOSIT ABSOLUTE /end AXIS_DESCR
 /begin AXIS_DESCR STD_AXIS tatesoll1 rel_ub_b99p6 9 0.00 99.61 FORMAT "%5.2" DEPOSIT ABSOLUTE /end AXIS_DESCR
/end CHARACTERISTIC
/begin CHARACTERISTIC KFTQTEABF "Map for Canister Purge Valve shutoff time selection depending on the mass flow (mste_w) and the Carbon Canister load (ftead_w)" MAP 0x80534F8C RB_Map_U16S16_U16 1.999969 fak_uw_b2 0.00 1.999969 FORMAT "%8.6"
 /begin AXIS_DESCR STD_AXIS mste_w_msg m_uw_b25p6 5 0.00 25.59961 FORMAT "%8.5" DEPOSIT ABSOLUTE /end AXIS_DESCR
 /begin AXIS_DESCR STD_AXIS ftead_w_msg fak_sw_b64 5 -64.00000 63.99805 FORMAT "%8.5" DEPOSIT ABSOLUTE /end AXIS_DESCR
/end CHARACTERISTIC
/begin CHARACTERISTIC KFTVPHTEV "Characteristic map for the canister purge valve (CPV) delay time (absolute pressure based)" MAP 0x805348D8 RB_Map_U8U16_U16 655.3500 t_q0p01_ms 0.00 655.3500 FORMAT "%8.4"
 /begin AXIS_DESCR STD_AXIS BattU_u_ubrsq spg_q0p1 4 0.00 25.50 FORMAT "%5.2" DEPOSIT ABSOLUTE /end AXIS_DESCR
 /begin AXIS_DESCR STD_AXIS phtev_w p_q0p0195 6 0.00 1279.980 FORMAT "%8.3" DEPOSIT ABSOLUTE /end AXIS_DESCR
/end CHARACTERISTIC
/begin CHARACTERISTIC KLFDMSTES "Factor to calculate the input to Integrator for purge mass flow (dmstes_w)" CURVE 0x80534FD6 RB_Curve_U16_S16_Static 3.999878 fak_sw_b4 0.00 3.999878 FORMAT "%8.6" EXTENDED_LIMITS -4.000000 3.999878
 /begin AXIS_DESCR STD_AXIS msteo_w_msg m_uw_b25p6 4 0.00 25.59961 FORMAT "%8.5" DEPOSIT ABSOLUTE /end AXIS_DESCR
/end CHARACTERISTIC
/begin CHARACTERISTIC KLFTEVFTEAD "Time constant for lowpass filtered canister purge valve (CPV) opening limitation dependent of fuel purge adaptation factor" CURVE 0x805353CC RB_Curve_S16_U16_Static 1310.700 t_q0p02 0.00 1310.700 FORMAT "%8.3"
 /begin AXIS_DESCR STD_AXIS ftead_w_msg fak_sw_b64 4 -64.00000 63.99805 FORMAT "%8.5" DEPOSIT ABSOLUTE /end AXIS_DESCR
/end CHARACTERISTIC
/begin CHARACTERISTIC KLFTEVFX "characteristic line for max. percentage of purge valve opening" CURVE 0x805353DE RB_Curve_U8_U8 0.9961 fak_ub_b1 0.00 0.9961
 /begin AXIS_DESCR STD_AXIS EnvT_ttumg temp_ub_q0p75_o48 4 -48.0 143.3 FORMAT "%5.1" DEPOSIT ABSOLUTE /end AXIS_DESCR
/end CHARACTERISTIC
/begin CHARACTERISTIC KLIMSTEFV "Curve decrease factor fuel part error suspicion fuel purge control" CURVE 0x8053513C RB_Curve_U16_U16 1.992188 fak_ub_b2 0.00 1.992188 FORMAT "%8.6" EXTENDED_LIMITS 0.00 511.9922
 /begin AXIS_DESCR STD_AXIS imstefv_w m_ub_q0p0444 8 0.00 2909.754 FORMAT "%8.3" DEPOSIT ABSOLUTE /end AXIS_DESCR
/end CHARACTERISTIC
/begin CHARACTERISTIC KLTEINIFHO "Characteristic line of time for detection of purge stop based on altitude correction factor (fho_w)" CURVE 0x805353E8 RB_Curve_U8_U16_Static 6553.500 t_q0p1 0.00 6553.500 FORMAT "%8.3"
 /begin AXIS_DESCR STD_AXIS PEnvfacCorrAlti_fho fak_ub_b4 5 0.00 3.984 FORMAT "%5.3" DEPOSIT ABSOLUTE /end AXIS_DESCR
/end CHARACTERISTIC
/begin CHARACTERISTIC KLTEMSZ "curve counter massflow fuel purge control" CURVE 0x8053515E RB_Curve_U16_U8_Static 1.992 fak_q0p0078 0.00 1.992 FORMAT "%5.3"
 /begin AXIS_DESCR STD_AXIS coumsnte_w t_q0p1 5 0.00 6553.500 FORMAT "%8.3" DEPOSIT ABSOLUTE /end AXIS_DESCR
/end CHARACTERISTIC
/begin CHARACTERISTIC KLZKMSTES "Time constant to low pass filter for maximum possible desired purge mass flow (mstesmx_w)" CURVE 0x80534FE8 RB_Curve_U16_U16 1310.680 t_q0p02 0.020 1310.700 FORMAT "%8.3" EXTENDED_LIMITS 0.00 1310.700
 /begin AXIS_DESCR STD_AXIS msteo_w_msg m_uw_b25p6 4 0.00 25.59961 FORMAT "%8.5" DEPOSIT ABSOLUTE /end AXIS_DESCR
/end CHARACTERISTIC
/begin CHARACTERISTIC KTEVANMK "characteristic line for purge valve opening speed" CURVE 0x80535190 RB_CurveGroup_U8 0.0121593164 perio_ub_b0p012207 0.00 0.0121593164 FORMAT "%12.10"
 /begin AXIS_DESCR COM_AXIS mksbg_msg m_ub_b25p6 5 0.00 25.50 FORMAT "%5.2" AXIS_PTS_REF SMK05TEUB /end AXIS_DESCR
/end CHARACTERISTIC
/begin CHARACTERISTIC LAMTEMN "minimum of lambda threshold for canister purge control active" VALUE 0x80534F36 RB_Val_Wu16 15.99976 fak_uw_b16 0.00 15.99976 FORMAT "%8.5" /end CHARACTERISTIC
/begin CHARACTERISTIC LAMTEMX "maximum of lambda threshold for canister purge control active" VALUE 0x80534F38 RB_Val_Wu16 15.99976 fak_uw_b16 0.00 15.99976 FORMAT "%8.5" /end CHARACTERISTIC
/begin CHARACTERISTIC MSNTEVO "Standardized mass flow through the complete open canister purge valve (CPV) (8 Bit)" VALUE 0x8053491A RB_Val_Wu16 25.59961 m_uw_b25p6 0.00 25.59961 FORMAT "%8.5" /end CHARACTERISTIC
/begin CHARACTERISTIC MSTEFTEAD "Threshold release calculation HC(HydroCarbon)-load fuel purge control" VALUE 0x80534830 RB_Val_Wu16 25.59961 m_uw_b25p6 0.00 25.59961 FORMAT "%8.5" /end CHARACTERISTIC
/begin CHARACTERISTIC RLTELLMN "min threshold of air charge to release the canister at the idle speed" VALUE 0x80534F10 RB_Val_Wu16 1535.977 rel_q0p0234 0.00 1535.977 FORMAT "%8.3" /end CHARACTERISTIC
/begin AXIS_PTS SMI04TEUW "desired troque dependent basic point (number =4)" 0x805353F8 misol_w_msg RB_Axis_U16 99.99847 rel_uw_b100 4 0.00 99.99847 FORMAT "%8.5" DEPOSIT ABSOLUTE /end AXIS_PTS
/begin AXIS_PTS SMI08TEUW "desired troque dependent basic point (number =8)" 0x80535402 misol_w_msg RB_Axis_U16 99.99847 rel_uw_b100 8 0.00 99.99847 FORMAT "%8.5" DEPOSIT ABSOLUTE /end AXIS_PTS
/begin AXIS_PTS SMK05TEUB "fuel dependent basic point (number =5)" 0x80535195 mksbg_msg RB_Axis_U8 25.50 m_ub_b25p6 5 0.00 25.50 FORMAT "%5.2" DEPOSIT ABSOLUTE /end AXIS_PTS
/begin AXIS_PTS SNM04TEUB "engine speed dependent basic point (number =4)" 0x80535414 Epm_nEngLRes RB_Axis_U8 10200. EngN_LRes 4 0.00 10200. FORMAT "%5.0" DEPOSIT ABSOLUTE /end AXIS_PTS
/begin AXIS_PTS SQM05TEUB "air mass quotient dependent basic point (number =5)" 0x805350F2 qmsdyn RB_Axis_U8 15.94 fak_ub_b16 5 0.00 15.94 FORMAT "%5.2" DEPOSIT ABSOLUTE /end AXIS_PTS
/begin AXIS_PTS STA04TEUB "intake air dependent basic point (number = 4)" 0x80535419 tans_msg RB_Axis_U8 191.3 temp_ub_q0p75_o48 4 -48.0 143.3 FORMAT "%5.1" DEPOSIT ABSOLUTE /end AXIS_PTS
/begin CHARACTERISTIC T50_stDftVal_C "Calibratable default value of T50 status" VALUE 0x805345B2 Val_Wu8 255.0 OneToOne 0.00 255.0 FORMAT "%5.1" /end CHARACTERISTIC
/begin CHARACTERISTIC T50_stEmgyDfl_C "Default value for emergency start request from T50" VALUE 0x8053B63C Val_Wu8 255.0 OneToOne 0.00 255.0 FORMAT "%5.1" /end CHARACTERISTIC
/begin CHARACTERISTIC T50_stNormDfl_C "Default value for normal start request from T50" VALUE 0x8053B63D Val_Wu8 255.0 OneToOne 0.00 255.0 FORMAT "%5.1" /end CHARACTERISTIC
/begin CHARACTERISTIC T50_swtEmgyReq_C "Switch to select whether the emergency start request is from hardware, OutSel or both." VALUE 0x8053B63E Val_Wu8 255.0 OneToOne 0.00 255.0 FORMAT "%5.1" /end CHARACTERISTIC
/begin CHARACTERISTIC T50_swtNormReq_C "Switch to select whether the normal start request is from hardware, OutSel or both." VALUE 0x8053B63F Val_Wu8 255.0 OneToOne 0.00 255.0 FORMAT "%5.1" /end CHARACTERISTIC
/begin CHARACTERISTIC T50_swtSigSel_C "To select between h\w signal or can signal" VALUE 0x805345B3 Val_Wu8 2.000 OneToOne 0.00 2.000 FORMAT "%5.3" EXTENDED_LIMITS 0.00 255.0 /end CHARACTERISTIC
/begin CHARACTERISTIC T50_tiDebHiLo_C "Debounce time period for High to Low transition for T50 signal" VALUE 0x8053B638 Val_Wu16 655350.0 TimeDeb 0.00 655350.0 FORMAT "%8.1" /end CHARACTERISTIC
/begin CHARACTERISTIC T50_tiDebLoHi_C "Debounce time peiod for Low to High transition for T50 signal" VALUE 0x8053B63A Val_Wu16 655350.0 TimeDeb 0.00 655350.0 FORMAT "%8.1" /end CHARACTERISTIC
/begin CHARACTERISTIC T50_tiEmgcyReq_C "Applicable time for emergency request" VALUE 0x8053B640 Val_Wu16 655350.0 Time_ms 0.00 655350.0 FORMAT "%8.1" /end CHARACTERISTIC
/begin CHARACTERISTIC TATEGMX "Maximum canister purge valve (CPV) duty cycle for pulsed CPV activation" VALUE 0x8053491C RB_Val_Wu16 99.99847 rel_q0p00153 0.00 99.99847 FORMAT "%8.5" /end CHARACTERISTIC
/begin CHARACTERISTIC TATELL "Intake air temperature threshold for canister purge control with idle speed" VALUE 0x80534F12 RB_Val_Wu8 191.3 temp_ub_q0p75_o48 -48.0 143.3 FORMAT "%5.1" /end CHARACTERISTIC
/begin CHARACTERISTIC TATEMSN "Characteristic curve for the duty cycle of the canister purge valve (CPV) depending on the massflow" CURVE 0x8053491E RB_Curve_U16_U16 99.99847 rel_q0p00153 0.00 99.99847 FORMAT "%8.5"
 /begin AXIS_DESCR STD_AXIS msntesol_w_msg m_uw_b25p6 10 0.00 25.59961 FORMAT "%8.5" DEPOSIT ABSOLUTE /end AXIS_DESCR
/end CHARACTERISTIC
/begin CHARACTERISTIC TCE_flgGenericFcoReq_C "Calibration for generic Fuel Cut Off request" VALUE 0x805345B4 RB_Val_Wboolean 1.00000000000 B_TRUE 0.00 1.00000000000 FORMAT "%13.11" /end CHARACTERISTIC
/begin CHARACTERISTIC TCE_flgGenericFcoRst_C "Calibration for generic Fuel Cut Off reset" VALUE 0x805345B5 RB_Val_Wboolean 1.00000000000 B_TRUE 0.00 1.00000000000 FORMAT "%13.11" /end CHARACTERISTIC
/begin CHARACTERISTIC TCE_numCcoThd_C "Threshold for number of cylinder in cut-off to set the FCO started flag" VALUE 0x805345B8 RB_Val_Wu8 255.0 OneToOne 0.00 255.0 FORMAT "%5.1" /end CHARACTERISTIC
/begin CHARACTERISTIC TCE_tiExptFcoStrt_C "Time after which FCO will start" VALUE 0x805345BC RB_Val_Wu32 4294967.29500 Time_ms2us 0.00 4294967.29500 FORMAT "%13.5" /end CHARACTERISTIC
/begin CHARACTERISTIC TCE_tqOverrunOffsThdAcOn_M "Threshold torque when AC ON" MAP 0x805345C0 RB_Map_S16S16_S16 6553.500 Trq -3276.800 3276.700 FORMAT "%8.3"
 /begin AXIS_DESCR STD_AXIS TCE_nEngTmp EngN 8 -16384.00 16383.50 FORMAT "%8.2" DEPOSIT ABSOLUTE /end AXIS_DESCR
 /begin AXIS_DESCR STD_AXIS TCE_tqInnrSetCo Trq 8 0.00 3276.700 FORMAT "%8.3" EXTENDED_LIMITS -3276.800 3276.700 DEPOSIT ABSOLUTE /end AXIS_DESCR
/end CHARACTERISTIC
/begin CHARACTERISTIC TCE_tqOverrunOffsThd_M "Threshold torque" MAP 0x80534664 RB_Map_S16S16_S16 6553.500 Trq -3276.800 3276.700 FORMAT "%8.3"
 /begin AXIS_DESCR STD_AXIS TCE_nEngTmp EngN 8 -16384.00 16383.50 FORMAT "%8.2" DEPOSIT ABSOLUTE /end AXIS_DESCR
 /begin AXIS_DESCR STD_AXIS TCE_tqInnrSetCo Trq 8 0.00 3276.700 FORMAT "%8.3" EXTENDED_LIMITS -3276.800 3276.700 DEPOSIT ABSOLUTE /end AXIS_DESCR
/end CHARACTERISTIC
/begin CHARACTERISTIC TDevCrssChk_stCfgSwt_C "Configuration switch for Tdev_CrssChk" VALUE 0x80534708 RB_Val_Wu8 255.0 OneToOne 0.00 255.0 FORMAT "%5.1" /end CHARACTERISTIC
/begin CHARACTERISTIC TDevCrssChk_stEnaSnsrForCalcAvrg_C "Codeword for choise of sensors for calculation of mean value in coldstart diagnosis" VALUE 0x8053470A RB_Val_Wu16 65535.00 OneToOne 0.00 65535.00 FORMAT "%8.2" /end CHARACTERISTIC
/begin CHARACTERISTIC TDevCrssChk_tDiffColdStrtMaxThd_C "Upper Threshold for detection of coldstart error" VALUE 0x8053470C RB_Val_Ws16 6553.500 Temp_Cels -3549.940 3003.560 FORMAT "%8.3" /end CHARACTERISTIC
/begin CHARACTERISTIC TDevCrssChk_tDiffColdStrtMinThd_C "Lower Threshold for detection of coldstart error" VALUE 0x8053470E RB_Val_Ws16 6553.500 Temp_Cels -3549.940 3003.560 FORMAT "%8.3" /end CHARACTERISTIC
/begin CHARACTERISTIC TDevCrssChk_tDiffIntkAirTMaxThd_C "Upper Threshold for detection of coldstart error (IntkAirT)" VALUE 0x80534710 RB_Val_Ws16 6553.500 Temp_Cels -3549.940 3003.560 FORMAT "%8.3" /end CHARACTERISTIC
/begin CHARACTERISTIC TDevCrssChk_tDiffIntkAirTMinThd_C "Lower Threshold for detection of coldstart error (IntkAirT)" VALUE 0x80534712 RB_Val_Ws16 6553.500 Temp_Cels -3549.940 3003.560 FORMAT "%8.3" /end CHARACTERISTIC
/begin CHARACTERISTIC TDevCrssChk_tiDebEngOff_C "CrossCheck parameter for debounce of engine speed signal (turn off delay)" VALUE 0x80534714 RB_Val_Wu8 255.0 t_q1 0.00 255.0 FORMAT "%5.1" /end CHARACTERISTIC
/begin CHARACTERISTIC TDevCrssChk_tiDebEngOn_C "CrossCheck parameter for debounce of engine speed signal (turn ofndelay)" VALUE 0x80534715 RB_Val_Wu8 255.0 t_q1 0.00 255.0 FORMAT "%5.1" /end CHARACTERISTIC
/begin CHARACTERISTIC TDevCrssChk_tiForBlkHeatrDetn_C "CrossCheck timeslot for block heater detection" VALUE 0x80534716 RB_Val_Wu8 255.0 t_q1 0.00 255.0 FORMAT "%5.1" /end CHARACTERISTIC
/begin CHARACTERISTIC TDevCrssChk_tiForEngStrtFaild_C "CrossCheck timeslot for detection of engine start failure" VALUE 0x80534717 RB_Val_Wu8 255.0 t_q1 0.00 255.0 FORMAT "%5.1" /end CHARACTERISTIC
/begin CHARACTERISTIC TDevCrssChk_tiMaxForColdStrtDiag_C "CrossCheck maximum timeslot for coldstart diagnosis" VALUE 0x80534718 RB_Val_Wu8 10.00 t_q1 0.00 10.00 FORMAT "%5.2" EXTENDED_LIMITS 0.00 255.0 /end CHARACTERISTIC
/begin CHARACTERISTIC TDevCrssChk_tiMinEngCoolgDwn_T "Minimum engine cool down time corresponding to engine stop temperature" CURVE 0x8053471A RB_Curve_S16_U16_Static 262140.0 t_q4_s 0.00 262140.0 FORMAT "%8.1"
 /begin AXIS_DESCR STD_AXIS CEngDsT_tStop Temp_Cels 3 -3549.940 3003.560 FORMAT "%8.3" DEPOSIT ABSOLUTE /end AXIS_DESCR
/end CHARACTERISTIC
/begin CHARACTERISTIC TDevCrssChk_tiT15Dly_C "CrossCheck time for T15 delay" VALUE 0x80534728 RB_Val_Wu8 255.0 t_q1 0.00 255.0 FORMAT "%5.1" /end CHARACTERISTIC
/begin CHARACTERISTIC TDevCrssChk_tMinThdForEngStal_C "CrossCheck Minimum temperaute threshold for diagnosis at abortive start" VALUE 0x8053472A RB_Val_Ws16 6553.500 Temp_Cels -3549.940 3003.560 FORMAT "%8.3" /end CHARACTERISTIC
/begin CHARACTERISTIC TEDLKH "Time delay for activation of canister purge control after catalyst heating" VALUE 0x80534F14 RB_Val_Wu16 6553.500 t_q0p1 0.00 6553.500 FORMAT "%8.3" /end CHARACTERISTIC
/begin CHARACTERISTIC TFGWRTEFV "time for identification of mixture error suspicion due to lambda controller deviations" VALUE 0x80535170 RB_Val_Wu8 25.50 t_q0p1 0.00 25.50 FORMAT "%5.2" /end CHARACTERISTIC
/begin CHARACTERISTIC TFKAKORFV "time for identification of mixture error suspicion" VALUE 0x80535172 RB_Val_Wu16 25.00000 t_q0p1 5.00000 30.00000 FORMAT "%8.5" EXTENDED_LIMITS 0.00 6553.500 /end CHARACTERISTIC
/begin CHARACTERISTIC TFTEINI "Time for detection of purge stop" VALUE 0x8053541E RB_Val_Wu16 6553.500 t_q0p1 0.00 6553.500 FORMAT "%8.3" /end CHARACTERISTIC
/begin CHARACTERISTIC ThDev_flgACMaiSwtCodVal_C "Status of AC switch in case of coded configuration" VALUE 0x80535F74 RB_Val_Wu8 1.00000000000 B_TRUE 0.00 1.00000000000 FORMAT "%13.11" /end CHARACTERISTIC
/begin CHARACTERISTIC ThDev_stACMaiSwtSig_C "The source of the main AC switch" VALUE 0x80535F75 RB_Val_Wu8 255.0 OneToOne 0.00 255.0 FORMAT "%5.1" /end CHARACTERISTIC
/begin CHARACTERISTIC ThrVlv_nThdForIrrvFuCutOffB1_C "Engine speed threshold to trigger safety fuel cut off in case of battery voltage depression" VALUE 0x804FA3AC Val_Ws16 18384.50 EngN -16384.00 2000.50 FORMAT "%8.2" EXTENDED_LIMITS -16384.00 16383.50 /end CHARACTERISTIC
/begin CHARACTERISTIC ThrVlv_stMonCfgB1_C "ThrVlv_stMon: Applicationmask" VALUE 0x804FA3AE Val_Wu8 255.0 OneToOne 0.00 255.0 FORMAT "%5.1" /end CHARACTERISTIC
/begin CHARACTERISTIC ThrVlv_tiDebBattUDepB1_C "Debounce time for battery voltage depression" VALUE 0x804FA3AF Val_Wu8 0.1000 t10msxs_ub_b2p55 0.00 0.1000 EXTENDED_LIMITS 0.00 2.550 /end CHARACTERISTIC
/begin CHARACTERISTIC ThrVlv_tiDebDblErrSuspc_C "Debounce time: Double sensor error suspicion" VALUE 0x804FA3A8 Val_Ws32 4294.96729500 Time_Dt -2147.48364800 2147.48364700 FORMAT "%13.8" /end CHARACTERISTIC
/begin CHARACTERISTIC TMSTTE "Engine start temperature threshold at this the Canister Purge valve can be directly active" VALUE 0x80534F16 RB_Val_Wu8 191.3 temp_ub_q0p75_o48 -48.0 143.3 FORMAT "%5.1" /end CHARACTERISTIC
/begin CHARACTERISTIC TMTE "engine-temperature threshold for canister purge" VALUE 0x80534F17 RB_Val_Wu8 191.3 temp_ub_q0p75_o48 -48.0 143.3 FORMAT "%5.1" /end CHARACTERISTIC
/begin CHARACTERISTIC TQTEAB "time for decrementation of the purge rate" VALUE 0x80535420 RB_Val_Wu8 81.60 t_q0p32000082 0.00 81.60 FORMAT "%5.2" /end CHARACTERISTIC
/begin CHARACTERISTIC TRFTEVFTEAD "Time constant for lowpass filtered canister purge valve (CPV) opening limitation" VALUE 0x80535422 RB_Val_Wu16 1310.680 t_q0p02 0.020 1310.700 FORMAT "%8.3" EXTENDED_LIMITS 0.00 1310.700 /end CHARACTERISTIC
/begin CHARACTERISTIC TSABTE_CUR "Delay time curve for deactivation of the canister purge with fuel cut off request" CURVE 0x80534F18 RB_Curve_S16_U16_Static 1310.700 t_q0p02 0.00 1310.700 FORMAT "%8.3"
 /begin AXIS_DESCR STD_AXIS Epm_nEng EngN 4 -16384.00 16383.50 FORMAT "%8.2" DEPOSIT ABSOLUTE /end AXIS_DESCR
/end CHARACTERISTIC
/begin CHARACTERISTIC TTEATMTPA "Delay time purge control after upstream catalyst exceeds dew-point" VALUE 0x80534F2A RB_Val_Wu16 6553.500 t_q0p1 0.00 6553.500 FORMAT "%8.3" /end CHARACTERISTIC
/begin CHARACTERISTIC TTEAUS "Delay time after engine start for activating the purge control valve" VALUE 0x80534F2C RB_Val_Wu16 6553.500 t_q0p1 0.00 6553.500 FORMAT "%8.3" /end CHARACTERISTIC
/begin CHARACTERISTIC TTEGERTE "delay deactivation controlled purging" VALUE 0x80534F2E RB_Val_Wu16 6553.500 t_q0p1 0.00 6553.500 FORMAT "%8.3" /end CHARACTERISTIC
/begin CHARACTERISTIC TVATEH "delay time to inhibit purge control, high canister load" VALUE 0x80534F30 RB_Val_Wu8 25.50 t_q0p1 0.00 25.50 FORMAT "%5.2" /end CHARACTERISTIC
/begin CHARACTERISTIC TVATEL "delay time to inhibit purge control, low canister load" VALUE 0x80534F31 RB_Val_Wu8 25.50 t_q0p1 0.00 25.50 FORMAT "%5.2" /end CHARACTERISTIC
/begin CHARACTERISTIC TVEVLOCTE "delay time for injection restart after suppression" VALUE 0x80534F32 RB_Val_Wu8 5.100 t_q0p02 0.00 5.100 FORMAT "%5.3" /end CHARACTERISTIC
/begin CHARACTERISTIC TVTEB "delay time for locking of Purge control after switch off of Injection" VALUE 0x80534F33 RB_Val_Wu8 25.50 t_q0p1 0.00 25.50 FORMAT "%5.2" /end CHARACTERISTIC
/begin CHARACTERISTIC ZKFKATEIFV "Time constant filtered factor fuel rate for error suspicion" VALUE 0x80535174 RB_Val_Wu8 25.4996 zk100msxs_ub_b25p6 0.1004 25.6000 FORMAT "%7.4" EXTENDED_LIMITS 0.100392 25.6000 /end CHARACTERISTIC
/begin CHARACTERISTIC ZKFTEAD "Time constant for lowpass filtered fuel purge adaptation factor during fuel purging" VALUE 0x80534832 RB_Val_Wu16 6553.4999985 zk100msxs_uw_b6553p6 0.1000015 6553.6000000 FORMAT "%12.7" EXTENDED_LIMITS 0.10000152590 6553.6000000 /end CHARACTERISTIC
/begin CHARACTERISTIC ZKFTEADVA "filter time constant fuel purge adaptation: purge control active" VALUE 0x80535175 RB_Val_Wu8 25.4996 zk100msxs_ub_b25p6 0.1004 25.6000 FORMAT "%7.4" EXTENDED_LIMITS 0.100392 25.6000 /end CHARACTERISTIC
/begin CHARACTERISTIC ZKFTEADVNA "filter time constant fuel purge adaptation: purge control not active" VALUE 0x80535176 RB_Val_Wu8 25.4996 zk100msxs_ub_b25p6 0.1004 25.6000 FORMAT "%7.4" EXTENDED_LIMITS 0.100392 25.6000 /end CHARACTERISTIC
/begin MEASUREMENT AirMod_flgMaiChrgSensErr "Error main charge sensor" UBYTE OneToOne 1 100 0.00 1.000 BIT_MASK 0x1 FORMAT "%5.3" ECU_ADDRESS 0x6000A7F7 /end MEASUREMENT
/begin MEASUREMENT BattU_u_ubrsq "Temporary Battery voltage x-input for characteristic map calculating delay time for Canister purge" UBYTE spg_q0p1 1 100 0.00 25.50 FORMAT "%5.2" ECU_ADDRESS 0x6000628D /end MEASUREMENT
/begin MEASUREMENT B_avateh_msg "current active state of function Purge control, high canister load" UBYTE B_TRUE 1 100 0.00 1.00000000000 BIT_MASK 0x1 FORMAT "%13.11" ECU_ADDRESS 0x70000ABC /end MEASUREMENT
/begin MEASUREMENT B_avatel_msg "current active state of function Purge control, low canister load" UBYTE B_TRUE 1 100 0.00 1.00000000000 BIT_MASK 0x1 FORMAT "%13.11" ECU_ADDRESS 0x70000ABB /end MEASUREMENT
/begin MEASUREMENT B_avaten_msg "current active state of function emergency canister purge" UBYTE B_TRUE 1 100 0.00 1.00000000000 BIT_MASK 0x1 FORMAT "%13.11" ECU_ADDRESS 0x70000ABA /end MEASUREMENT
/begin MEASUREMENT B_dknolu_msg "condition: limp-home operation active" UBYTE OneToOne 1 100 0.00 1.000 BIT_MASK 0x1 FORMAT "%5.3" ECU_ADDRESS 0x6000E3E9 /end MEASUREMENT
/begin MEASUREMENT B_dknotb_msg "Condition: some throttle valve backup mode active" UBYTE OneToOne 1 100 0.00 1.000 BIT_MASK 0x1 FORMAT "%5.3" ECU_ADDRESS 0x6000A7F6 /end MEASUREMENT
/begin MEASUREMENT B_dknot_msg "condition: continued operation with a single remaining throttle actuator poti" UBYTE OneToOne 1 100 0.00 1.000 BIT_MASK 0x1 FORMAT "%5.3" ECU_ADDRESS 0x6000E3EA /end MEASUREMENT
/begin MEASUREMENT B_dkp1e_msg "Condition: defect in throttle actuator potentiometer 1" UBYTE OneToOne 1 100 0.00 1.000 BIT_MASK 0x1 FORMAT "%5.3" ECU_ADDRESS 0x6000E3EB /end MEASUREMENT
/begin MEASUREMENT B_dkp2e_msg "condition: defect in throttle actuator potentiometer 2" UBYTE OneToOne 1 100 0.00 1.000 BIT_MASK 0x1 FORMAT "%5.3" ECU_ADDRESS 0x6000E3EC /end MEASUREMENT
/begin MEASUREMENT B_dkpiu_msg "Condition: irreversible SKA (ICO)" UBYTE OneToOne 1 100 0.00 1.000 BIT_MASK 0x1 FORMAT "%5.3" ECU_ADDRESS 0x6000A7F5 /end MEASUREMENT
/begin MEASUREMENT B_dkpru_msg "Condition: reversible SKA (ICO)" UBYTE OneToOne 1 100 0.00 1.000 BIT_MASK 0x1 FORMAT "%5.3" ECU_ADDRESS 0x6000E3ED /end MEASUREMENT
/begin MEASUREMENT B_dkpu_msg "condition: safety fuel cut-off" UBYTE OneToOne 1 100 0.00 1.000 BIT_MASK 0x1 FORMAT "%5.3" ECU_ADDRESS 0x6000E3EE /end MEASUREMENT
/begin MEASUREMENT B_dksbeg_msg "condition: limiting throttle-valve setpoint value" UBYTE OneToOne 1 100 0.00 1.000 BIT_MASK 0x1 FORMAT "%5.3" ECU_ADDRESS 0x6000A7F4 /end MEASUREMENT
/begin MEASUREMENT B_dveada_msg "condition: disabling injection during DV-E-adaptation" UBYTE OneToOne 1 100 0.00 1.000 BIT_MASK 0x1 FORMAT "%5.3" ECU_ADDRESS 0x6000A7F3 /end MEASUREMENT
/begin MEASUREMENT B_edks_msg "Condition fault in throttle-valve sensor" UBYTE OneToOne 1 100 0.00 1.000 BIT_MASK 0x1 FORMAT "%5.3" ECU_ADDRESS 0x6000E3EF /end MEASUREMENT
/begin MEASUREMENT B_fkateifv "Condition error suspicion from fkatei" UBYTE B_TRUE 1 100 0.00 1.00000000000 BIT_MASK 0x1 FORMAT "%13.11" ECU_ADDRESS 0x70000118 /end MEASUREMENT
/begin MEASUREMENT B_frteatmtpa_msg "enable condition dewpoint exceeded or tmst greater threshold" UBYTE B_TRUE 1 100 0.00 1.00000000000 BIT_MASK 0x1 FORMAT "%13.11" ECU_ADDRESS 0x70000A5C /end MEASUREMENT
/begin MEASUREMENT B_fteadber_msg "Condition HC load may be adapted" UBYTE B_TRUE 1 100 0.00 1.00000000000 BIT_MASK 0x1 FORMAT "%13.11" ECU_ADDRESS 0x70000A59 /end MEASUREMENT
/begin MEASUREMENT B_fteadh_msg "Condition high canister load" UBYTE B_TRUE 1 100 0.00 1.00000000000 BIT_MASK 0x1 FORMAT "%13.11" ECU_ADDRESS 0x70000A58 /end MEASUREMENT
/begin MEASUREMENT B_fvfgwrte "mixture error suspicion from purge rate reduction during fr-controller deviations" UBYTE B_TRUE 1 100 0.00 1.00000000000 BIT_MASK 0x1 FORMAT "%13.11" ECU_ADDRESS 0x70000117 /end MEASUREMENT
/begin MEASUREMENT B_fvfkakormt "mixture error suspicion from lambdafactor deviations" UBYTE B_TRUE 1 100 0.00 1.00000000000 BIT_MASK 0x1 FORMAT "%13.11" ECU_ADDRESS 0x70000116 /end MEASUREMENT
/begin MEASUREMENT B_fvftead "mixture error suspicion from ACF-load" UBYTE B_TRUE 1 100 0.00 1.00000000000 BIT_MASK 0x1 FORMAT "%13.11" ECU_ADDRESS 0x70000115 /end MEASUREMENT
/begin MEASUREMENT B_fvgte_msg "mixture error suspicion from canister purge" UBYTE B_TRUE 1 100 0.00 1.00000000000 BIT_MASK 0x1 FORMAT "%13.11" ECU_ADDRESS 0x70000A55 /end MEASUREMENT
/begin MEASUREMENT B_gerte_msg "Condition for closed loop control" UBYTE B_TRUE 1 100 0.00 1.00000000000 BIT_MASK 0x1 FORMAT "%13.11" ECU_ADDRESS 0x70000A50 /end MEASUREMENT
/begin MEASUREMENT B_imstemin "condition minimum purge rate reached and stored" UBYTE B_TRUE 1 100 0.00 1.00000000000 BIT_MASK 0x1 FORMAT "%13.11" ECU_ADDRESS 0x70000114 /end MEASUREMENT
/begin MEASUREMENT B_i_ska_fr_msg "FR error reaction irreversible SKA (safety fuel shut-down)" UBYTE OneToOne 1 100 0.00 1.000 BIT_MASK 0x1 FORMAT "%5.3" ECU_ADDRESS 0x6000A7F2 /end MEASUREMENT
/begin MEASUREMENT B_kl15_msg "condition ignition switch on" UBYTE B_TRUE 1 100 0.00 1.00000000000 BIT_MASK 0x1 FORMAT "%13.11" ECU_ADDRESS 0x6000014A /end MEASUREMENT
/begin MEASUREMENT B_lamrb_msg "Set value of lambda within allowed thresholds for canister purge" UBYTE B_TRUE 1 100 0.00 1.00000000000 BIT_MASK 0x1 FORMAT "%13.11" ECU_ADDRESS 0x70000A10 /end MEASUREMENT
/begin MEASUREMENT B_lltans "low intake air temperature in Idle speed" UBYTE B_TRUE 1 100 0.00 1.00000000000 BIT_MASK 0x1 FORMAT "%13.11" ECU_ADDRESS 0x70000125 /end MEASUREMENT
/begin MEASUREMENT B_lrar_msg "condition for reducted correction ranges at LRA" UBYTE B_TRUE 1 100 0.00 1.00000000000 BIT_MASK 0x1 FORMAT "%13.11" ECU_ADDRESS 0x700009FC /end MEASUREMENT
/begin MEASUREMENT B_lrnwsur_msg "Cond.: Storing of DV-E adaption values into original system successful (RAM-Val.)" UBYTE OneToOne 1 100 0.00 1.000 BIT_MASK 0x1 FORMAT "%5.3" ECU_ADDRESS 0x6000A7F0 /end MEASUREMENT
/begin MEASUREMENT B_lrnws_msg "learned value save bit" UBYTE OneToOne 1 100 0.00 1.000 BIT_MASK 0x1 FORMAT "%5.3" ECU_ADDRESS 0x6000A7F1 /end MEASUREMENT
/begin MEASUREMENT B_lteab_msg "Condition slow decrementation of purge rate" UBYTE B_TRUE 1 100 0.00 1.00000000000 BIT_MASK 0x1 FORMAT "%13.11" ECU_ADDRESS 0x700009F3 /end MEASUREMENT
/begin MEASUREMENT B_mstefg_msg "condition enabling of the mass flow over the canister purge valve" UBYTE B_TRUE 1 100 0.00 1.00000000000 BIT_MASK 0x1 FORMAT "%13.11" ECU_ADDRESS 0x700009EB /end MEASUREMENT
/begin MEASUREMENT B_nldve_msg "Request of control unit after-run by DVE" UBYTE OneToOne 1 100 0.00 1.000 BIT_MASK 0x1 FORMAT "%5.3" ECU_ADDRESS 0x6000E3F3 /end MEASUREMENT
/begin MEASUREMENT B_notlu_fr_msg "Request for NFB from Function controller" UBYTE OneToOne 1 100 0.00 1.000 BIT_MASK 0x1 FORMAT "%5.3" ECU_ADDRESS 0x6000E3F4 /end MEASUREMENT
/begin MEASUREMENT B_otdiag "local variable ftiv or piv diagnosis activ" UBYTE B_TRUE 1 100 0.00 1.00000000000 BIT_MASK 0x1 FORMAT "%13.11" ECU_ADDRESS 0x70000119 /end MEASUREMENT
/begin MEASUREMENT b_pyatenloc "local variable to check the status of purge for exclusions of FID" UBYTE B_TRUE 1 100 0.00 1.00000000000 BIT_MASK 0x1 FORMAT "%13.11" ECU_ADDRESS 0x70000124 /end MEASUREMENT
/begin MEASUREMENT B_rbte_msg "Condition cloesd loop control readiness for canister purge" UBYTE B_TRUE 1 100 0.00 1.00000000000 BIT_MASK 0x1 FORMAT "%13.11" ECU_ADDRESS 0x700009C2 /end MEASUREMENT
/begin MEASUREMENT B_resimftiv "request to close Canister Purge valve, reset imsteini" UBYTE B_TRUE 1 100 0.00 1.00000000000 BIT_MASK 0x1 FORMAT "%13.11" ECU_ADDRESS 0x7000010F /end MEASUREMENT
/begin MEASUREMENT B_resims_msg "condition reset integrated massflow" UBYTE B_TRUE 1 100 0.00 1.00000000000 BIT_MASK 0x1 FORMAT "%13.11" ECU_ADDRESS 0x700009BE /end MEASUREMENT
/begin MEASUREMENT B_rkteb_msg "fuel portion of canister purge at its limit" UBYTE B_TRUE 1 100 0.00 1.00000000000 BIT_MASK 0x1 FORMAT "%13.11" ECU_ADDRESS 0x700009BC /end MEASUREMENT
/begin MEASUREMENT B_tatewi_msg "condition immediate ouput of the duty cycle" UBYTE B_TRUE 1 100 0.00 1.00000000000 BIT_MASK 0x1 FORMAT "%13.11" ECU_ADDRESS 0x7000098F /end MEASUREMENT
/begin MEASUREMENT B_teakt_msg "condition purge control active (open loop or closed loop)" UBYTE B_TRUE 1 100 0.00 1.00000000000 BIT_MASK 0x1 FORMAT "%13.11" ECU_ADDRESS 0x7000098B /end MEASUREMENT
/begin MEASUREMENT B_tef_msg "Condition canister purge function basically released" UBYTE B_TRUE 1 100 0.00 1.00000000000 BIT_MASK 0x1 FORMAT "%13.11" ECU_ADDRESS 0x7000098A /end MEASUREMENT
/begin MEASUREMENT B_tei_msg "Internal condition: canister purge function active" UBYTE B_TRUE 1 100 0.00 1.00000000000 BIT_MASK 0x1 FORMAT "%13.11" ECU_ADDRESS 0x70000988 /end MEASUREMENT
/begin MEASUREMENT B_telrlei "Condition no fuel purge due to limit of low rl in engine idle" UBYTE B_TRUE 1 100 0.00 1.00000000000 BIT_MASK 0x1 FORMAT "%13.11" ECU_ADDRESS 0x70000123 /end MEASUREMENT
/begin MEASUREMENT B_ten_msg "condition open loop purging" UBYTE B_TRUE 1 100 0.00 1.00000000000 BIT_MASK 0x1 FORMAT "%13.11" ECU_ADDRESS 0x70000987 /end MEASUREMENT
/begin MEASUREMENT B_te_msg "Condition canister purge active" UBYTE B_TRUE 1 100 0.00 1.00000000000 BIT_MASK 0x1 FORMAT "%13.11" ECU_ADDRESS 0x7000098C /end MEASUREMENT
/begin MEASUREMENT B_tvateh "condition delay time expired to inhibit purge control, high canister load" UBYTE B_TRUE 1 100 0.00 1.00000000000 BIT_MASK 0x1 FORMAT "%13.11" ECU_ADDRESS 0x70000122 /end MEASUREMENT
/begin MEASUREMENT B_tvatel "condition delay time expired to inhibit purge control, low canister load" UBYTE B_TRUE 1 100 0.00 1.00000000000 BIT_MASK 0x1 FORMAT "%13.11" ECU_ADDRESS 0x70000121 /end MEASUREMENT
/begin MEASUREMENT B_ubdve_msg "Condition: Battery voltage for DV-E control OK" UBYTE OneToOne 1 100 0.00 1.000 BIT_MASK 0x1 FORMAT "%5.3" ECU_ADDRESS 0x6000E3F6 /end MEASUREMENT
/begin MEASUREMENT B_ubpvg_msg "condition: battery voltage sufficient for 5-V potentiometer supply" UBYTE OneToOne 1 100 0.00 1.000 BIT_MASK 0x1 FORMAT "%5.3" ECU_ADDRESS 0x6000E3F7 /end MEASUREMENT
/begin MEASUREMENT B_ub_ok_msg "Battery voltage o.k." UBYTE OneToOne 1 100 0.00 1.000 BIT_MASK 0x1 FORMAT "%5.3" ECU_ADDRESS 0x6000E3F5 /end MEASUREMENT
/begin MEASUREMENT B_wdksg_msg "Condition: Setpoint Angle Throttle Valve valid" UBYTE OneToOne 1 100 0.00 1.000 BIT_MASK 0x1 FORMAT "%5.3" ECU_ADDRESS 0x6000A7EF /end MEASUREMENT
/begin MEASUREMENT CEngDsT_flgColdStrtDi "Coolant temperature sensor cold start diagnosis disabled" UBYTE B_TRUE 1 100 0.00 1.00000000000 BIT_MASK 0x1 FORMAT "%13.11" ECU_ADDRESS 0x70000945 /end MEASUREMENT
/begin MEASUREMENT CEngDsT_flgColdStrtFinal "Final flag of coolant temperature sensor cold start diagnosis" UBYTE B_TRUE 1 100 0.00 1.00000000000 BIT_MASK 0x1 FORMAT "%13.11" ECU_ADDRESS 0x70000944 /end MEASUREMENT
/begin MEASUREMENT CEngDsT_flgColdStrtHeal "Heal flag of coolant temperature sensor cold start diagnosis" UBYTE B_TRUE 1 100 0.00 1.00000000000 BIT_MASK 0x1 FORMAT "%13.11" ECU_ADDRESS 0x70000943 /end MEASUREMENT
/begin MEASUREMENT CEngDsT_flgColdStrtMaxErr "Max error flag of coolant temperature sensor cold start diagnosis" UBYTE B_TRUE 1 100 0.00 1.00000000000 BIT_MASK 0x1 FORMAT "%13.11" ECU_ADDRESS 0x70000942 /end MEASUREMENT
/begin MEASUREMENT CEngDsT_flgColdStrtMinErr "Min error flag of coolant temperature sensor cold start diagnosis" UBYTE B_TRUE 1 100 0.00 1.00000000000 BIT_MASK 0x1 FORMAT "%13.11" ECU_ADDRESS 0x70000941 /end MEASUREMENT
/begin MEASUREMENT CEngDsT_flgColdStrtRiseNr "Increment IUMPR counter of coolant temperature sensor cold start diagnosis" UBYTE B_TRUE 1 100 0.00 1.00000000000 BIT_MASK 0x1 FORMAT "%13.11" ECU_ADDRESS 0x70000940 /end MEASUREMENT
/begin MEASUREMENT ChrCtl_flgUnthrAgMaiSens "Flag: Throttle angle calculated from main charge sensor is unthrottled" UBYTE OneToOne 1 100 0.00 1.000 BIT_MASK 0x1 FORMAT "%5.3" ECU_ADDRESS 0x6000A7EE /end MEASUREMENT
/begin MEASUREMENT ChrCtl_rActPosMnChrgSensB1 "Unthrottled replacement angle from main charge sensor" SWORD rel_q0p0078125 1 100 -256.0000 255.9922 FORMAT "%8.4" ECU_ADDRESS 0x600053B2 /end MEASUREMENT
/begin MEASUREMENT ChrCtl_ratDesPosnThrVlvB1 "Desired throttle valve position" SWORD rel_q0p0078125 1 100 -256.0000 255.9922 FORMAT "%8.4" ECU_ADDRESS 0x600053B0 /end MEASUREMENT
/begin MEASUREMENT coumsnte_w "time-counter fuel purge control inactive" UWORD t_q0p1 1 100 0.00 6553.500 FORMAT "%8.3" ECU_ADDRESS 0x60003524 /end MEASUREMENT
/begin MEASUREMENT CstrPurg_dstNrmBnk1LoLoad "normalised distance of further transport from purge flow in low load purge line" UWORD fak_uw_b2 1 100 0.00 1.999969 FORMAT "%8.6" ECU_ADDRESS 0x6000352E /end MEASUREMENT
/begin MEASUREMENT CstrPurg_facCorrnT "correction factor for temperature CPV" UWORD fak_uw_b2 1 100 0.00 1.999969 FORMAT "%8.6" ECU_ADDRESS 0x60003572 /end MEASUREMENT
/begin MEASUREMENT CstrPurg_facCorrnTCpvMod "correction factor for temperature CPV from temperature model" UWORD fak_uw_b2 1 100 0.00 1.999969 FORMAT "%8.6" ECU_ADDRESS 0x60003570 /end MEASUREMENT
/begin MEASUREMENT CstrPurg_facEthGsl "actual ethanol content in gasoline for stoichiometric correction" UWORD fak_uw_b2 1 100 0.00 1.999969 FORMAT "%8.6" ECU_ADDRESS 0x6000351E /end MEASUREMENT
/begin MEASUREMENT CstrPurg_facFlowCpvLoLoad "Factor flow through PCV (for low load)" UWORD fak_uw_b2 1 100 0.00 1.999969 FORMAT "%8.6" ECU_ADDRESS 0x6000356E /end MEASUREMENT
/begin MEASUREMENT CstrPurg_facFlowCpvLoLoadCda "Factor flow through Canister Purge valve for high load during Half Engine mode (HEM) or small cam" UWORD fak_uw_b2 1 100 0.00 1.999969 FORMAT "%8.6" ECU_ADDRESS 0x6000356C /end MEASUREMENT
/begin MEASUREMENT CstrPurg_facFlowCpvTAltiLoLoad "factor flow through CPV corrected by altitude and temperature for low load" UWORD fak_uw_b2 1 100 0.00 1.999969 FORMAT "%8.6" ECU_ADDRESS 0x6000356A /end MEASUREMENT
/begin MEASUREMENT CstrPurg_facFlowDutyCycCpv "correction factor flow through CPV" UWORD fak_uw_b2 1 100 0.00 1.999969 FORMAT "%8.6" ECU_ADDRESS 0x60003568 /end MEASUREMENT
/begin MEASUREMENT CstrPurg_facLamDeMin "Minimum value of lambda deviation" SWORD fak_sw_b1 1 100 -1.000000 0.999969 FORMAT "%8.6" ECU_ADDRESS 0x60003588 /end MEASUREMENT
/begin MEASUREMENT CstrPurg_facLamRecprBnk1LoLoadIntkVlv "reciprocal time-delayed Lambda due to purge gas in low load purge line" SWORD fak_q0p000488 1 100 -16.00000 15.99951 FORMAT "%8.5" ECU_ADDRESS 0x6000352C /end MEASUREMENT
/begin MEASUREMENT CstrPurg_facLamRecprDlyBnk1LoLoad "reciprocal time-delayed Lambda due to purge gas in low load purge line" SWORD fak_q0p000488 1 100 -16.00000 15.99951 FORMAT "%8.5" ECU_ADDRESS 0x6000352A /end MEASUREMENT
/begin MEASUREMENT CstrPurg_facLoad "unfiltered factor canister purge valve temperature effect on account of the vehicle speed and the weighteded filtered load" SWORD fak_sw_b1 1 100 -1.000000 0.999969 FORMAT "%8.6" ECU_ADDRESS 0x60003566 /end MEASUREMENT
/begin MEASUREMENT CstrPurg_facLoadFilt "filtered factor canister purge valve temperature effect on account of the vehicle speed and the weighteded filtered load" SWORD fak_sw_b1 1 100 -1.000000 0.999969 FORMAT "%8.6" ECU_ADDRESS 0x60003564 /end MEASUREMENT
/begin MEASUREMENT CstrPurg_facWghtLoadCoeff "Weighting factor for the relative air charge from the identity line load coefficient" UWORD fak_uw_b4 1 100 0.00 3.999939 FORMAT "%8.6" ECU_ADDRESS 0x60003562 /end MEASUREMENT
/begin MEASUREMENT CstrPurg_fakMFlowAcfLd "Unfiltered value of the factor containing the fuel part of the massflow from ACF in order to take into considerantion the cooling effect in CPV" UWORD fak_uw_b1 1 100 0.00 0.9999847 FORMAT "%9.7" ECU_ADDRESS 0x60003560 /end MEASUREMENT
/begin MEASUREMENT CstrPurg_fakMFlowAcfLdFilt "Filtered value of the factor containing the fuel part of the massflow from ACF in order to take into considerantion the cooling effect in CPV" UWORD fak_uw_b1 1 100 0.00 0.9999847 FORMAT "%9.7" ECU_ADDRESS 0x6000355E /end MEASUREMENT
/begin MEASUREMENT CstrPurg_fakRadrCoolg "Unfiltered factor, CPV cooling effect due to vehicle speed and radiator shutter position" SWORD fak_sw_b1 1 100 -1.000000 0.999969 FORMAT "%8.6" ECU_ADDRESS 0x6000355C /end MEASUREMENT
/begin MEASUREMENT CstrPurg_fakRadrCoolgFilt "Filtered factor, CPV cooling effect due to vehicle speed and radiator shutter position" SWORD fak_sw_b1 1 100 -1.000000 0.999969 FORMAT "%8.6" ECU_ADDRESS 0x6000355A /end MEASUREMENT
/begin MEASUREMENT CstrPurg_flgAbrt "Condition: Canister purge is not allowed" UBYTE B_TRUE 1 100 0.00 1.00000000000 BIT_MASK 0x1 FORMAT "%13.11" ECU_ADDRESS 0x70000120 /end MEASUREMENT
/begin MEASUREMENT CstrPurg_flgBigLamDev "Big Lambda deviation inhibit Canister purging enable flag" UBYTE B_TRUE 1 100 0.00 1.00000000000 BIT_MASK 0x1 FORMAT "%13.11" ECU_ADDRESS 0x7000011F /end MEASUREMENT
/begin MEASUREMENT CstrPurg_flgCdnFuCutOffDly "Condition for release of canister purge valve control due to fuel cut off" UBYTE B_TRUE 1 100 0.00 1.00000000000 BIT_MASK 0x1 FORMAT "%13.11" ECU_ADDRESS 0x700008BE /end MEASUREMENT
/begin MEASUREMENT CstrPurg_flgEnaCdnCatHeatg "Enable Condition for catalyst heating" UBYTE B_TRUE 1 100 0.00 1.00000000000 BIT_MASK 0x1 FORMAT "%13.11" ECU_ADDRESS 0x7000011E /end MEASUREMENT
/begin MEASUREMENT CstrPurg_flgEnaCdnTiStrtEnd "enable condition if the engine start is finished and time after startend is reached" UBYTE B_TRUE 1 100 0.00 1.00000000000 BIT_MASK 0x1 FORMAT "%13.11" ECU_ADDRESS 0x7000011D /end MEASUREMENT
/begin MEASUREMENT CstrPurg_flgImsteiniNV "Flag: NV-stored value of integral of purge mass flow (imsteini_msg) is used" UBYTE B_TRUE 1 100 0.00 1.00000000000 BIT_MASK 0x1 FORMAT "%13.11" ECU_ADDRESS 0x700008B2 /end MEASUREMENT
/begin MEASUREMENT CstrPurg_flgIniTEADAP100ms "Initialisation necessary for TEADAP 100ms" UBYTE B_TRUE 1 100 0.00 1.00000000000 BIT_MASK 0x1 FORMAT "%13.11" ECU_ADDRESS 0x60009FB4 /end MEASUREMENT
/begin MEASUREMENT CstrPurg_flgIniTESKSOL100ms "Initialisation necessary for TESKSOL 100ms" UBYTE B_TRUE 1 100 0.00 1.00000000000 BIT_MASK 0x1 FORMAT "%13.11" ECU_ADDRESS 0x7000010E /end MEASUREMENT
/begin MEASUREMENT CstrPurg_flgPurgActv "Purge active" UBYTE B_TRUE 1 100 0.00 1.00000000000 BIT_MASK 0x1 FORMAT "%13.11" ECU_ADDRESS 0x700008B1 /end MEASUREMENT
/begin MEASUREMENT CstrPurg_flgReIniTEADAP100ms "Re-Initialisation necessary for TEADAP 100ms" UBYTE B_TRUE 1 100 0.00 1.00000000000 BIT_MASK 0x1 FORMAT "%13.11" ECU_ADDRESS 0x60009FB3 /end MEASUREMENT
/begin MEASUREMENT CstrPurg_flgReIniTEBGTEV20ms "Re-Initialisation necessary for TEBGTEV 20ms" UBYTE B_TRUE 1 100 0.00 1.00000000000 BIT_MASK 0x1 FORMAT "%13.11" ECU_ADDRESS 0x7000012A /end MEASUREMENT
/begin MEASUREMENT CstrPurg_flgReIniTELAM100ms "Re-Initialisation necessary for TELAM 100ms" UBYTE B_TRUE 1 100 0.00 1.00000000000 BIT_MASK 0x1 FORMAT "%13.11" ECU_ADDRESS 0x700008B0 /end MEASUREMENT
/begin MEASUREMENT CstrPurg_flgReIniTESIGTE100ms "Re-Initialisation necessary for TESIGTE 100ms" UBYTE B_TRUE 1 100 0.00 1.00000000000 BIT_MASK 0x1 FORMAT "%13.11" ECU_ADDRESS 0x70000111 /end MEASUREMENT
/begin MEASUREMENT CstrPurg_flgReIniTESIGTE20ms "Re-Initialisation necessary for TESIGTE 20ms" UBYTE B_TRUE 1 100 0.00 1.00000000000 BIT_MASK 0x1 FORMAT "%13.11" ECU_ADDRESS 0x70000110 /end MEASUREMENT
/begin MEASUREMENT CstrPurg_flgReIniTESKSOL100ms "Re-Initialisation necessary for TESKSOL 100ms" UBYTE B_TRUE 1 100 0.00 1.00000000000 BIT_MASK 0x1 FORMAT "%13.11" ECU_ADDRESS 0x7000010D /end MEASUREMENT
/begin MEASUREMENT CstrPurg_flgReIniTESKSOL20ms "Re-Initialisation necessary for TESKSOL 20ms" UBYTE B_TRUE 1 100 0.00 1.00000000000 BIT_MASK 0x1 FORMAT "%13.11" ECU_ADDRESS 0x7000010C /end MEASUREMENT
/begin MEASUREMENT CstrPurg_flgTiEngOffRst "Condition: Reset integral mass flow rate canister purge valve" UBYTE B_TRUE 1 100 0.00 1.00000000000 BIT_MASK 0x1 FORMAT "%13.11" ECU_ADDRESS 0x7000010B /end MEASUREMENT
/begin MEASUREMENT CstrPurg_flgUBattOk "Battery voltage OK for CPV components (within limits CstrPurg_uBattMin and CstrPurg_uBattMax)" UBYTE B_TRUE 1 100 0.00 1.00000000000 BIT_MASK 0x1 FORMAT "%13.11" ECU_ADDRESS 0x700008AF /end MEASUREMENT
/begin MEASUREMENT CstrPurg_mfDeltaRampDwn "Delta Canister purge mass flow for ramp down" ULONG m_uw_b25p6 1 100 0.00 1677721.59961 FORMAT "%13.5" ECU_ADDRESS 0x500011A0 /end MEASUREMENT
/begin MEASUREMENT CstrPurg_mFlowCpv1LoLdPurgLn "Cannister Purging massflow in low load purge line CPV1" UWORD m_uw_b25p6 1 100 0.00 25.59961 FORMAT "%8.5" ECU_ADDRESS 0x60004D28 /end MEASUREMENT
/begin MEASUREMENT CstrPurg_ratPAftCpvToEnv "quotient: pressure behind CPV ambient pressure" UWORD fak_uw_b8 1 100 0.00 7.999878 FORMAT "%8.6" ECU_ADDRESS 0x60004D26 /end MEASUREMENT
/begin MEASUREMENT CstrPurg_ratPLoLoadPurgLnToEnv "Ratio between pressure low load purgeline and ambient pressure" UWORD fak_uw_b8 1 100 0.00 7.999878 FORMAT "%8.6" ECU_ADDRESS 0x60003558 /end MEASUREMENT
/begin MEASUREMENT CstrPurg_ratRadShtDes "local variable for determination of the factor, CPV cooling effect due to vehicle speed and radiator shutter position" UWORD rel_uw_b200 1 100 0.00 199.9969 FORMAT "%8.4" ECU_ADDRESS 0x60003556 /end MEASUREMENT
/begin MEASUREMENT CstrPurg_ratSp "desired duty cycle of the first PCV" UWORD rel_q0p00153 1 100 0.00 99.99847 FORMAT "%8.5" ECU_ADDRESS 0x60004D24 /end MEASUREMENT
/begin MEASUREMENT CstrPurg_ratSpCorrn "correction desired duty cycle of the first PCV" SWORD rel_sw_b100 1 100 -100.0000 99.9969 FORMAT "%8.4" ECU_ADDRESS 0x6000357E /end MEASUREMENT
/begin MEASUREMENT CstrPurg_ratWghtRelAirFillg "weighteded relative air charge" UWORD rel_uw_q0p0234 1 100 0.00 1535.977 FORMAT "%8.3" ECU_ADDRESS 0x60003554 /end MEASUREMENT
/begin MEASUREMENT CstrPurg_ratWghtRelAirFillgFilt "weighteded relative air charge filtered" UWORD rel_uw_q0p0234 1 100 0.00 1535.977 FORMAT "%8.3" ECU_ADDRESS 0x60003552 /end MEASUREMENT
/begin MEASUREMENT CstrPurg_stFuCmpTERKDeact "Current state of deactivation of the fuel compensation during the cannister purging diagnosis (diagnosis that use a lambda deviation as an OK criteria should deactivate the compensation) Bitwise coded" UBYTE OneToOne 1 100 0.00 255.0 FORMAT "%5.1" ECU_ADDRESS 0x60006286 /end MEASUREMENT
/begin MEASUREMENT CstrPurg_tCpvMod "Modled Cpv-temperature" UWORD temp_q0p0234_o273 1 100 -273.150 1262.827 FORMAT "%8.3" ECU_ADDRESS 0x60004D22 /end MEASUREMENT
/begin MEASUREMENT CstrPurg_tDifThr2Env "Temperature difference between throttle and environment temperature" UWORD temp_q0p0234_o273 1 100 0.014 1262.827 FORMAT "%8.3" ECU_ADDRESS 0x60003550 /end MEASUREMENT
/begin MEASUREMENT CstrPurg_TEADAPdkhckorrIKL_I.memory "Internal TEADAP Integrator measurement value Current Integrator value / Current Integrator value" SLONG fak_sw_b64 1 100 -4194304.00000 4194303.99805 FORMAT "%13.5" ECU_ADDRESS 0x60001310 /end MEASUREMENT
/begin MEASUREMENT CstrPurg_TEADAPRstIntegFF_I.status "Internal TEADAP FlipFlop measurement value current value of RS-FF / current value of RS-FF" UBYTE B_TRUE 1 100 0.00 1.00000000000 BIT_MASK 0x1 FORMAT "%13.11" ECU_ADDRESS 0x6000628E /end MEASUREMENT
/begin MEASUREMENT CstrPurg_TEEBAllLocInjVlvActvTONV_I.outbit "Condition all injection valves are activated, two camshaft revolutions delayed after fuel cutoff / return value" UBYTE B_TRUE 1 100 0.00 1.00000000000 BIT_MASK 0x1 FORMAT "%13.11" ECU_ADDRESS 0x60003540 /end MEASUREMENT
/begin MEASUREMENT CstrPurg_TEEBAllLocInjVlvActvTONV_I.time "Condition all injection valves are activated, two camshaft revolutions delayed after fuel cutoff / expired delay time" UBYTE t_q0p02 1 100 0.00 5.100 FORMAT "%5.3" ECU_ADDRESS 0x60003541 /end MEASUREMENT
/begin MEASUREMENT CstrPurg_TEEBClsdLoopCtrlTOFFV_I.outbit "Condition cloesd loop control readiness for canister purge / Output Bit" UBYTE B_TRUE 1 100 0.00 1.00000000000 BIT_MASK 0x1 FORMAT "%13.11" ECU_ADDRESS 0x500052BE /end MEASUREMENT
/begin MEASUREMENT CstrPurg_TEEBClsdLoopCtrlTOFFV_I.time "Condition cloesd loop control readiness for canister purge / Occured Time" UWORD t_q0p1 1 100 0.00 6553.500 FORMAT "%8.3" ECU_ADDRESS 0x500052C0 /end MEASUREMENT
/begin MEASUREMENT CstrPurg_TEEBCpvClsForFcoTOFFV_I.outbit "Flag: close canister purge valve for fuel cut-off. / Output Bit" UBYTE B_TRUE 1 100 0.00 1.00000000000 BIT_MASK 0x1 FORMAT "%13.11" ECU_ADDRESS 0x6000353E /end MEASUREMENT
/begin MEASUREMENT CstrPurg_TEEBCpvClsForFcoTOFFV_I.time "Flag: close canister purge valve for fuel cut-off. / Occured Time" UBYTE t_q0p1 1 100 0.00 25.50 FORMAT "%5.2" ECU_ADDRESS 0x6000353F /end MEASUREMENT
/begin MEASUREMENT CstrPurg_TEEBHiLoadTONVNM.time "condition delay time expired to inhibit purge control, high canister load / Delay Time" UBYTE t_q0p1 1 100 0.00 25.50 FORMAT "%5.2" ECU_ADDRESS 0x60006288 /end MEASUREMENT
/begin MEASUREMENT CstrPurg_TEEBLoLoadTONVNM.time "condition delay time expired to inhibit purge control, low canister load / Delay Time" UBYTE t_q0p1 1 100 0.00 25.50 FORMAT "%5.2" ECU_ADDRESS 0x60006287 /end MEASUREMENT
/begin MEASUREMENT CstrPurg_temploc "local variable for temperature" SWORD Temp_Cels 1 100 -3549.940 3003.560 FORMAT "%8.3" ECU_ADDRESS 0x60003522 /end MEASUREMENT
/begin MEASUREMENT CstrPurg_tFiltDifThr2Env "Filtered temperature difference between throttle and environment temperature" UWORD temp_q0p0234_o273 1 100 -273.150 1262.827 FORMAT "%8.3" ECU_ADDRESS 0x6000354E /end MEASUREMENT
/begin MEASUREMENT CstrPurg_tiAftStrt "Time after Start (EngineOffTime stands still)" UWORD t_q0p1 1 100 0.00 6553.500 FORMAT "%8.3" ECU_ADDRESS 0x60003516 /end MEASUREMENT
/begin MEASUREMENT CstrPurg_tiInhLamDev "Elapsed time since a big lambda deviation not caused by the canister purging has been detected." UWORD t_q0p1 1 100 0.00 6553.500 FORMAT "%8.3" ECU_ADDRESS 0x60003542 /end MEASUREMENT
/begin MEASUREMENT CstrPurg_tiMfRmpDwn "Ramp down time for desired mass flow" UWORD t20msxs_uw_b1310 1 100 0.00 1310.700 FORMAT "%8.3" ECU_ADDRESS 0x6000353A /end MEASUREMENT
/begin MEASUREMENT CstrPurg_tLoadTChgCpv "Component the canister purge valve temperature due to vehicle speed and the relative air charge" UWORD temp_q0p0234_o273 1 100 -273.150 1262.827 FORMAT "%8.3" ECU_ADDRESS 0x6000354C /end MEASUREMENT
/begin MEASUREMENT CstrPurg_tPurgAdpnCorrn "input temperature to fuel purge adaptation correction factor map" SWORD Temp_Cels 1 100 -3549.940 3003.560 FORMAT "%8.3" ECU_ADDRESS 0x60003586 /end MEASUREMENT
/begin MEASUREMENT CstrPurg_tRadrCoolgCpv "CPV cooling effect due to vehicle speed and radiator shutter position" UWORD temp_q0p0234_o273 1 100 -273.150 1262.827 FORMAT "%8.3" ECU_ADDRESS 0x6000354A /end MEASUREMENT
/begin MEASUREMENT CstrPurg_tThrHeatgCpv "Filtered throttle temperature (depending on the engine load and difference to environment temperature)" UWORD temp_q0p0234_o273 1 100 -273.150 1262.827 FORMAT "%8.3" ECU_ADDRESS 0x60003548 /end MEASUREMENT
/begin MEASUREMENT CstrPurg_tThrIntAirFilt "Filtered throttle temperature (depending on the engine load and difference to environment temperature)" UWORD temp_q0p0234_o273 1 100 -273.150 1262.827 FORMAT "%8.3" ECU_ADDRESS 0x60003546 /end MEASUREMENT
/begin MEASUREMENT dfkasteold_w "Old input value for integrator specific desired purge fuel amount" SWORD perio_q4p76836Em5 1 100 -1.562496 1.562448 FORMAT "%8.6" ECU_ADDRESS 0x60003514 /end MEASUREMENT
/begin MEASUREMENT dfkaster "basic input value for integrator specific desired purge fuel amount" SBYTE fak_sb_b16 1 100 -16.00 15.88 FORMAT "%5.2" ECU_ADDRESS 0x6000627C /end MEASUREMENT
/begin MEASUREMENT dfkastes_w "input value for integrator specific desired purge fuel amount" SWORD perio_q4p76836Em5 1 100 -1.562496 1.562448 FORMAT "%8.6" ECU_ADDRESS 0x60003512 /end MEASUREMENT
/begin MEASUREMENT dfkasteub "Unlimited control deviation specific set fuel amount" SBYTE fak_sb_b16 1 100 -16.00 15.88 FORMAT "%5.2" ECU_ADDRESS 0x6000627B /end MEASUREMENT
/begin MEASUREMENT divtqteabf "Variable for Canister Purge Valve shutoff time selection depending on the mass flow (mste_w) and the Carbon Canister load (ftead_w)" UWORD fak_uw_b2 1 100 0.00 1.999969 FORMAT "%8.6" ECU_ADDRESS 0x60003538 /end MEASUREMENT
/begin MEASUREMENT dmstes_w "Input Integrator purge mass flow" SWORD m_q0p002441_kg_DIV_h_s 1 100 -80.00000 79.99756 FORMAT "%8.5" ECU_ADDRESS 0x60004DDC /end MEASUREMENT
/begin MEASUREMENT dwdkba_w_msg "gradient of actual throttle blade position" SWORD relDK_q0p02441 1 100 -800.0000 799.9756 FORMAT "%8.4" ECU_ADDRESS 0x6000E306 /end MEASUREMENT
/begin MEASUREMENT EnvTt_tumg "Temporary variable for x-input of KFTETPU" UBYTE temp_ub_q0p75_o48 1 100 -48.0 143.3 FORMAT "%5.1" ECU_ADDRESS 0x60006284 /end MEASUREMENT
/begin MEASUREMENT EnvT_ttumg "Local variable for Environment temperature for purge valve opening calculation" UBYTE temp_ub_q0p75_o48 1 100 -48.0 143.3 FORMAT "%5.1" ECU_ADDRESS 0x6000627D /end MEASUREMENT
/begin MEASUREMENT EpmnEng_nmotw "Local variable for Engine speed for purge valve opening calculation" UWORD nmot_uw_q0p25 1 100 0.00 16383.75 FORMAT "%8.2" ECU_ADDRESS 0x6000351C /end MEASUREMENT
/begin MEASUREMENT Epm_nEngLRes_nmot "Temporary engine speed x-input for characteristic map for time period of canister purge." UBYTE nmot_ub_q40 1 100 0.00 10200. FORMAT "%5.0" ECU_ADDRESS 0x6000628C /end MEASUREMENT
/begin MEASUREMENT fgwrteufld "value: unfiltered purge rate reduction because of fr-controller deviations" UBYTE fak_ub_b16 1 100 0.00 15.94 FORMAT "%5.2" ECU_ADDRESS 0x6000627A /end MEASUREMENT
/begin MEASUREMENT fgwrte_msg "value: purge rate reduction because of fr-controller deviations" UBYTE fak_ub_b16 1 100 0.00 15.94 FORMAT "%5.2" ECU_ADDRESS 0x60009FFA /end MEASUREMENT
/begin MEASUREMENT fkakordl "With delta lambda calculation of mean value product of Lambda and Lambda factor deviation" UBYTE fak_ub_b4 1 100 0.00 3.984 FORMAT "%5.3" ECU_ADDRESS 0x60006279 /end MEASUREMENT
/begin MEASUREMENT fkakormt_loc "Local copy of mean value bank1, bank2 of the product of the Lambda and Lambda factor deviation (fkakormt_w)" UWORD fak_uw_b2 1 100 0.00 1.999969 FORMAT "%8.6" ECU_ADDRESS 0x60003584 /end MEASUREMENT
/begin MEASUREMENT fkakormt_w_msg "mean value bank1, bank2 of the produkt of the Lambda and Lambdafactor deviation" UWORD fak_uw_b2 1 100 0.00 1.999969 FORMAT "%8.6" ECU_ADDRESS 0x60004838 /end MEASUREMENT
/begin MEASUREMENT fkakormx_w_msg "Maximum value bank1, bank2 of the product of the Lambda and Lambda factor deviation" UWORD fak_uw_b4 1 100 0.00 3.999939 FORMAT "%8.6" ECU_ADDRESS 0x60004836 /end MEASUREMENT
/begin MEASUREMENT fkakor_w_msg "Product of the Lambda and Lambda factor deviation, bank1" UWORD fak_uw_b4 1 100 0.00 3.999939 FORMAT "%8.6" ECU_ADDRESS 0x6000483A /end MEASUREMENT
/begin MEASUREMENT fkastemax "maximum value of specific purge fuel amount" UBYTE fak_ub_b0p5 1 100 0.00 0.4980 ECU_ADDRESS 0x60006278 /end MEASUREMENT
/begin MEASUREMENT fkastemaxlim_w "Limit of maximum value of specific purge fuel amount" UWORD fak_uw_b0p5 1 100 0.00 0.4999924 FORMAT "%9.7" ECU_ADDRESS 0x60003510 /end MEASUREMENT
/begin MEASUREMENT fkastes "desired value of the specific purge fuel amount" UBYTE fak_ub_b0p5 1 100 0.00 0.4980 ECU_ADDRESS 0x60006277 /end MEASUREMENT
/begin MEASUREMENT fkastes_w_msg "desired value of the specific purge fuel amount (16 bit)" UWORD fak_uw_b0p5 1 100 0.00 0.4999924 FORMAT "%9.7" ECU_ADDRESS 0x60004834 /end MEASUREMENT
/begin MEASUREMENT fkastexm "Maximum possible value specific fuel component for canister purging" UBYTE fak_ub_b0p5 1 100 0.00 0.4980 ECU_ADDRESS 0x60006290 /end MEASUREMENT
/begin MEASUREMENT fkastexm_w_msg "Max possible value of the specific purge fuel amount, unlimited" UWORD fak_uw_b0p5 1 100 0.00 0.4999924 FORMAT "%9.7" ECU_ADDRESS 0x60004832 /end MEASUREMENT
/begin MEASUREMENT fkastex_w "Max value of the specific purge fuel amount" UWORD fak_uw_b0p5 1 100 0.00 0.4999924 FORMAT "%9.7" ECU_ADDRESS 0x6000350E /end MEASUREMENT
/begin MEASUREMENT fkaste_msg "actual value of the specific purge fuel amount" UBYTE fak_ub_b0p5 1 100 0.00 0.4980 ECU_ADDRESS 0x60009FF9 /end MEASUREMENT
/begin MEASUREMENT fkastold_w "Old value of the specific purge fuel amount (16 bit)" UWORD fak_uw_b0p5 1 100 0.00 0.4999924 FORMAT "%9.7" ECU_ADDRESS 0x6000350C /end MEASUREMENT
/begin MEASUREMENT fkatefrg_w_msg "factor fuel rate purge control at desired purge rate" SWORD fak_q0p0009766 1 100 -32.00000 31.99902 FORMAT "%8.5" ECU_ADDRESS 0x60004942 /end MEASUREMENT
/begin MEASUREMENT fkateif "filtered factor fuel part purge control (actual value)" SBYTE fak_sb_b1 1 100 -1.000 0.992 FORMAT "%5.3" ECU_ADDRESS 0x60006283 /end MEASUREMENT
/begin MEASUREMENT fkateifv "factor fuel part purge control error suspicion" SBYTE fak_sb_b2 1 100 -2.000 1.984 FORMAT "%5.3" ECU_ADDRESS 0x60006282 /end MEASUREMENT
/begin MEASUREMENT fkateiims "factor fuel part purge control at minimum purge rate" SBYTE fak_sb_b1 1 100 -1.000 0.992 FORMAT "%5.3" ECU_ADDRESS 0x60006281 /end MEASUREMENT
/begin MEASUREMENT fkatei_msg "factor fuel part purge control (actual value)" SBYTE fak_sb_b1 1 100 -1.000 0.992 FORMAT "%5.3" ECU_ADDRESS 0x6000A108 /end MEASUREMENT
/begin MEASUREMENT FPCtl_flg100msReIniTEEB "Re-Initialisation necessary for TEEB 100ms" UBYTE B_TRUE 1 100 0.00 1.00000000000 BIT_MASK 0x1 FORMAT "%13.11" ECU_ADDRESS 0x7000011C /end MEASUREMENT
/begin MEASUREMENT FPCtl_flg20msReIniTEEB "Re-Initialisation necessary for TEEB 20ms" UBYTE B_TRUE 1 100 0.00 1.00000000000 BIT_MASK 0x1 FORMAT "%13.11" ECU_ADDRESS 0x7000011B /end MEASUREMENT
/begin MEASUREMENT FPCtl_flgIniDrvTEBGTEV "flag to be set if there is a inidrv raster called" UBYTE B_TRUE 1 100 0.00 1.00000000000 BIT_MASK 0x1 FORMAT "%13.11" ECU_ADDRESS 0x70000129 /end MEASUREMENT
/begin MEASUREMENT FPCtl_flgIniTEATEV20ms "Initialisation necessary for TEATEV 20ms" UBYTE B_TRUE 1 100 0.00 1.00000000000 BIT_MASK 0x1 FORMAT "%13.11" ECU_ADDRESS 0x7000012C /end MEASUREMENT
/begin MEASUREMENT FPCtl_flgIniTECOOR20ms "Initialisation necessary for TECOOR 20ms" UBYTE B_TRUE 1 100 0.00 1.00000000000 BIT_MASK 0x1 FORMAT "%13.11" ECU_ADDRESS 0x70000128 /end MEASUREMENT
/begin MEASUREMENT FPCtl_flgReIniTEATEV20ms "Re-Initialisation necessary for TEATEV 20ms" UBYTE B_TRUE 1 100 0.00 1.00000000000 BIT_MASK 0x1 FORMAT "%13.11" ECU_ADDRESS 0x7000012B /end MEASUREMENT
/begin MEASUREMENT FPCtl_flgReIniTECOOR100ms "Re-Initialisation necessary for TECOOR 100ms" UBYTE B_TRUE 1 100 0.00 1.00000000000 BIT_MASK 0x1 FORMAT "%13.11" ECU_ADDRESS 0x70000127 /end MEASUREMENT
/begin MEASUREMENT FPCtl_flgReIniTECOOR20ms "Re-Initialisation necessary for TECOOR 20ms" UBYTE B_TRUE 1 100 0.00 1.00000000000 BIT_MASK 0x1 FORMAT "%13.11" ECU_ADDRESS 0x70000126 /end MEASUREMENT
/begin MEASUREMENT FPCtl_flgReIniTEMSSOLS20ms "Re-Initialisation necessary for TEMSSOLS 20ms" UBYTE B_TRUE 1 100 0.00 1.00000000000 BIT_MASK 0x1 FORMAT "%13.11" ECU_ADDRESS 0x700007A2 /end MEASUREMENT
/begin MEASUREMENT FPCtl_flgReIniTESIGOUT100ms "Re-Initialisation necessary for TESIGOUT 100ms" UBYTE B_TRUE 1 100 0.00 1.00000000000 BIT_MASK 0x1 FORMAT "%13.11" ECU_ADDRESS 0x70000113 /end MEASUREMENT
/begin MEASUREMENT FPCtl_flgReIniTESIGOUT20ms "Re-Initialisation necessary for TESIGOUT 20ms" UBYTE B_TRUE 1 100 0.00 1.00000000000 BIT_MASK 0x1 FORMAT "%13.11" ECU_ADDRESS 0x70000112 /end MEASUREMENT
/begin MEASUREMENT FPCtl_flgSyncS1ReIniTEEB "Local variable to store the global drive cycle counter (SyC_ctPostDrvLeave)" UBYTE B_TRUE 1 100 0.00 1.00000000000 BIT_MASK 0x1 FORMAT "%13.11" ECU_ADDRESS 0x7000011A /end MEASUREMENT
/begin MEASUREMENT fteadf_msg "filtered factor purge control adaptation" SBYTE fak_sb_b64 1 100 -64.00 63.50 FORMAT "%5.2" ECU_ADDRESS 0x6000A107 /end MEASUREMENT
/begin MEASUREMENT fteadf_w_msg "filtered factor purge control adaptation" SWORD fak_sw_b64 1 100 -64.00000 63.99805 FORMAT "%8.5" ECU_ADDRESS 0x60004940 /end MEASUREMENT
/begin MEASUREMENT fteadvir "virtual factor fuel purge adaption" SBYTE fak_q0p5 1 100 -64.00 63.50 FORMAT "%5.2" ECU_ADDRESS 0x60006280 /end MEASUREMENT
/begin MEASUREMENT ftead_w_msg "factor fuel purge adaptation" SWORD fak_sw_b64 1 100 -64.00000 63.99805 FORMAT "%8.5" ECU_ADDRESS 0x60037F2A /end MEASUREMENT
/begin MEASUREMENT ftefsoll_w_msg "desired canister purge rate" UWORD fak_uw_b0p5 1 100 0.00 0.4999924 FORMAT "%9.7" ECU_ADDRESS 0x60004C08 /end MEASUREMENT
/begin MEASUREMENT ftevflox_w_msg "Max. value of purge valve relative opening (16 bit)" UWORD fak_uw_b1 1 100 0.00 0.9999847 FORMAT "%9.7" ECU_ADDRESS 0x60004C06 /end MEASUREMENT
/begin MEASUREMENT ftevflxm_w "Max. value characteristic map of purge valve relative opening (16 bit)" UWORD fak_uw_b1 1 100 0.00 0.9999847 FORMAT "%9.7" ECU_ADDRESS 0x60004C04 /end MEASUREMENT
/begin MEASUREMENT ftevfteadlim_w "limitation of relative opening CPV" UWORD fak_uw_b1 1 100 0.00 0.9999847 FORMAT "%9.7" ECU_ADDRESS 0x6000351A /end MEASUREMENT
/begin MEASUREMENT ftho_w_msg "factor temperature and altitude depending correction of mass flow" UWORD fak_uw_b2 1 100 0.00 1.999969 FORMAT "%8.6" ECU_ADDRESS 0x60004C02 /end MEASUREMENT
/begin MEASUREMENT FuPurg_flgReqVlvFullLftIntk "Condition request intake valve with large lift during fuel purge with high canister load" UBYTE B_TRUE 1 100 0.00 1.00000000000 BIT_MASK 0x1 FORMAT "%13.11" ECU_ADDRESS 0x70000796 /end MEASUREMENT
/begin MEASUREMENT imstefv_w "Integral of purge mass flow for error suspicion" UWORD m_ub_q0p0444 1 100 0.00 2909.754 FORMAT "%8.3" ECU_ADDRESS 0x60003520 /end MEASUREMENT
/begin MEASUREMENT imsteini_msg "integral of purge mass flow" UBYTE m_ub_q0p0444 1 100 0.00 11.32 FORMAT "%5.2" ECU_ADDRESS 0x60037F01 /end MEASUREMENT
/begin MEASUREMENT IntkAirT_flgColdStrt1Final "Final flag of intake air temperature sensor 1 cold start diagnosis" UBYTE B_TRUE 1 100 0.00 1.00000000000 BIT_MASK 0x1 FORMAT "%13.11" ECU_ADDRESS 0x7000072D /end MEASUREMENT
/begin MEASUREMENT IntkAirT_flgCrss1MaxErr "Error flag of the max.error of the Cross-Check by cold start for sensor 1, debounced" UBYTE B_TRUE 1 100 0.00 1.00000000000 BIT_MASK 0x1 FORMAT "%13.11" ECU_ADDRESS 0x7000072C /end MEASUREMENT
/begin MEASUREMENT IntkAirT_flgCrss1MaxHeal "Healing flag of the max.error of the Cross-Check by cold start for sensor 1, debounced" UBYTE B_TRUE 1 100 0.00 1.00000000000 BIT_MASK 0x1 FORMAT "%13.11" ECU_ADDRESS 0x7000072B /end MEASUREMENT
/begin MEASUREMENT IntkAirT_flgCrss1MinErr "Error flag of the min.error of the Cross-Check by cold start for sensor 1, debounced" UBYTE B_TRUE 1 100 0.00 1.00000000000 BIT_MASK 0x1 FORMAT "%13.11" ECU_ADDRESS 0x7000072A /end MEASUREMENT
/begin MEASUREMENT IntkAirT_flgCrss1MinHeal "Healing flag of the max.error of the Cross-Check by cold start for sensor 1, debounced" UBYTE B_TRUE 1 100 0.00 1.00000000000 BIT_MASK 0x1 FORMAT "%13.11" ECU_ADDRESS 0x70000729 /end MEASUREMENT
/begin MEASUREMENT IntkAirT_flgCrssChk1NumrInc "release iumpr-numerator for the Cross-Check by cold start for intake air temperature sensor 1" UBYTE B_TRUE 1 100 0.00 1.00000000000 BIT_MASK 0x1 FORMAT "%13.11" ECU_ADDRESS 0x70000728 /end MEASUREMENT
/begin MEASUREMENT kintftead "Learning speed fuel component regeneration gas" UBYTE perio_q0p3125 1 100 0.00 79.69 FORMAT "%5.2" ECU_ADDRESS 0x6000628F /end MEASUREMENT
/begin MEASUREMENT kormtmod_w "Mean value bank1, bank2 of the product of the Lambda and Lambda factor deviation" UWORD fak_uw_b2 1 100 0.00 1.999969 FORMAT "%8.6" ECU_ADDRESS 0x60003582 /end MEASUREMENT
/begin MEASUREMENT ktevanst_msg "Basic value of purge valve opening speed" UBYTE perio_ub_b0p012207 1 100 0.00 0.0121593164 FORMAT "%12.10" ECU_ADDRESS 0x60009FEC /end MEASUREMENT
/begin MEASUREMENT lamsbgm_w_msg "Mean value of the limited desired lambda of bank 1 and bank 2" UWORD fak_uw_b16 1 100 0.00 15.99976 FORMAT "%8.5" ECU_ADDRESS 0x6000481E /end MEASUREMENT
/begin MEASUREMENT lrnstat_msg "statusbyte DV-E-adaption routine for tester-communication" UBYTE dez 1 100 0.00 255.0 FORMAT "%5.1" ECU_ADDRESS 0x6000A6E6 /end MEASUREMENT
/begin MEASUREMENT mksbg_msg "fuel mass flow calculated from air mass flow filtered (ml_w) and Desired Lambda limitation (lamsbg_w)" UBYTE m_ub_b25p6 1 100 0.00 25.50 FORMAT "%5.2" ECU_ADDRESS 0x60009FEB /end MEASUREMENT
/begin MEASUREMENT msntesol_w_msg "standardized mass flow through CPV" UWORD m_uw_b25p6 1 100 0.00 25.59961 FORMAT "%8.5" ECU_ADDRESS 0x60004BDC /end MEASUREMENT
/begin MEASUREMENT msntes_w_msg "standardized mass flow from canister purge control" UWORD m_uw_b25p6 1 100 0.00 25.59961 FORMAT "%8.5" ECU_ADDRESS 0x60004BDE /end MEASUREMENT
/begin MEASUREMENT msntetev_w_msg "normalized mass flow PCV (16 bit)" UWORD m_uw_b25p6 1 100 0.00 25.59961 FORMAT "%8.5" ECU_ADDRESS 0x50005C6A /end MEASUREMENT
/begin MEASUREMENT msntevo_w_msg "normalized mass flow through the complete open PCV" UWORD m_uw_b25p6 1 100 0.00 25.59961 FORMAT "%8.5" ECU_ADDRESS 0x60004BDA /end MEASUREMENT
/begin MEASUREMENT msotdiag_w "local variable for standardized mass flow through CPV" UWORD m_uw_b25p6 1 100 0.00 25.59961 FORMAT "%8.5" ECU_ADDRESS 0x6000353C /end MEASUREMENT
/begin MEASUREMENT mssgin_w_msg "mass flow into manifold (through throttle and PCV)" UWORD m_uw_b6553p5 1 100 0.00 6553.500 FORMAT "%8.3" ECU_ADDRESS 0x60004BD8 /end MEASUREMENT
/begin MEASUREMENT mssgout_w_msg "mass flow out of manifold (through throttle and PCV + EGR)" UWORD m_uw_b6553p5 1 100 0.00 6553.500 FORMAT "%8.3" ECU_ADDRESS 0x60004BD6 /end MEASUREMENT
/begin MEASUREMENT mstedte_msg "Purge mass flow for Canister purge valve diagnosis." UBYTE m_ub_b25p6 1 100 0.00 25.50 FORMAT "%5.2" ECU_ADDRESS 0x6000A29B /end MEASUREMENT
/begin MEASUREMENT mstedte_w_msg "purge mass flow for DTEV (word)" UWORD m_uw_b25p6 1 100 0.00 25.59961 FORMAT "%8.5" ECU_ADDRESS 0x60004BD2 /end MEASUREMENT
/begin MEASUREMENT mstemaxi_w "max. possible desired purge mass flow" UWORD m_uw_b25p6 1 100 0.00 25.59961 FORMAT "%8.5" ECU_ADDRESS 0x60003536 /end MEASUREMENT
/begin MEASUREMENT msteo_w_msg "Mass flow the 100 % opened TEV" UWORD m_uw_b25p6 1 100 0.00 25.59961 FORMAT "%8.5" ECU_ADDRESS 0x60004BD0 /end MEASUREMENT
/begin MEASUREMENT mstesmxi_w "Input signal of low pass filter for max. possible desired purge mass flow(mstesmx_w)" UWORD m_uw_b25p6 1 100 0.00 25.59961 FORMAT "%8.5" ECU_ADDRESS 0x60003534 /end MEASUREMENT
/begin MEASUREMENT mstesmx_w "max. possible desired purge mass flow" UWORD m_uw_b25p6 1 100 0.00 25.59961 FORMAT "%8.5" ECU_ADDRESS 0x60003532 /end MEASUREMENT
/begin MEASUREMENT mstesnc_w_msg "max. massflow over CPV, limited during engine mode switchover" UWORD m_uw_b25p6 1 100 0.00 25.59961 FORMAT "%8.5" ECU_ADDRESS 0x60004BCE /end MEASUREMENT
/begin MEASUREMENT mstesold_w "old desired purge mass flow" UWORD m_uw_b25p6 1 100 0.00 25.59961 FORMAT "%8.5" ECU_ADDRESS 0x60003530 /end MEASUREMENT
/begin MEASUREMENT mstesoll_w_msg "desired purge mass flow" UWORD m_uw_b25p6 1 100 0.00 25.59961 FORMAT "%8.5" ECU_ADDRESS 0x60004BCC /end MEASUREMENT
/begin MEASUREMENT mstesr_w "Mass flow manifold" UWORD m_uw_b25p6 1 100 0.00 25.59961 FORMAT "%8.5" ECU_ADDRESS 0x60003544 /end MEASUREMENT
/begin MEASUREMENT mste_msg "mass flow purge control into the manifold" UBYTE m_ub_b25p6 1 100 0.00 25.50 FORMAT "%5.2" ECU_ADDRESS 0x50005DD2 /end MEASUREMENT
/begin MEASUREMENT mste_w_msg "mass flow purge control into the manifold" UWORD m_uw_b25p6 1 100 0.00 25.59961 FORMAT "%8.5" ECU_ADDRESS 0x60004BD4 /end MEASUREMENT
/begin MEASUREMENT pdiff_w "difference pressure between CPV-line and environment" SWORD p_sw_q0p039 1 100 -1280.000 1279.961 FORMAT "%8.3" ECU_ADDRESS 0x60003518 /end MEASUREMENT
/begin MEASUREMENT PEnvfacCorrAlti_fho "Temporary variable before KLTEINIFHO" UBYTE fak_ub_b4 1 100 0.00 3.984 FORMAT "%5.3" ECU_ADDRESS 0x60006276 /end MEASUREMENT
/begin MEASUREMENT PEnv_pu "Temporary variable for y-input of KFTETPU" UBYTE p_ub_q5 1 100 0.00 1275. FORMAT "%5.0" ECU_ADDRESS 0x6000627F /end MEASUREMENT
/begin MEASUREMENT phtev_w "pressure behind CPV" UWORD p_q0p0195 1 100 0.00 1279.980 FORMAT "%8.3" ECU_ADDRESS 0x6000357C /end MEASUREMENT
/begin MEASUREMENT phurgen "physical urgency Canister Purge" UBYTE dez 1 100 0.00 255.0 FORMAT "%5.1" ECU_ADDRESS 0x6000627E /end MEASUREMENT
/begin MEASUREMENT pndkpu_msg "quotient: pressure downstream throttle valve ambient pressure" UBYTE fak_ub_b2 1 100 0.00 1.992188 FORMAT "%8.6" ECU_ADDRESS 0x6000A28F /end MEASUREMENT
/begin MEASUREMENT pndkpu_w_msg "quotient: pressure downstream throttle valve ambient pressure" UWORD fak_uw_b8 1 100 0.00 7.999878 FORMAT "%8.6" ECU_ADDRESS 0x60004BC6 /end MEASUREMENT
/begin MEASUREMENT pstems_w_msg "max. permitted intake manifold pressure from the canister purge" UWORD p_uw_q0p039 1 100 0.00 2559.961 FORMAT "%8.3" ECU_ADDRESS 0x60004BC0 /end MEASUREMENT
/begin MEASUREMENT qmsdyn "Quotient from mass flow into manifold (mssgin_w_msg) and mass flow out of manifold (mssgout_w_msg)" UBYTE fak_ub_b16 1 100 0.00 15.94 FORMAT "%5.2" ECU_ADDRESS 0x60006285 /end MEASUREMENT
/begin MEASUREMENT qtetemin_msg "quotient: te TEMIN for BDE teh_wteminh_w resp. tes_wtemins_w" UBYTE fak_ub_b4 1 100 0.00 3.984 FORMAT "%5.3" ECU_ADDRESS 0x6000A28C /end MEASUREMENT
/begin MEASUREMENT rkgb_w "relative fuel mass total used for limitation" UWORD rel_uw_b3072 1 100 0.00 3071.953 FORMAT "%8.3" ECU_ADDRESS 0x60003528 /end MEASUREMENT
/begin MEASUREMENT rkg_old_w "relative fuel mass total old value" UWORD rel_uw_b3072 1 100 0.00 3071.953 FORMAT "%8.3" ECU_ADDRESS 0x60003526 /end MEASUREMENT
/begin MEASUREMENT rkte_w_msg "relative fuel part of the purge control" SWORD rel_sw_q0p0468 1 100 -1536.000 1535.953 FORMAT "%8.3" ECU_ADDRESS 0x50005C74 /end MEASUREMENT
/begin MEASUREMENT rltevol_w_msg "Relative air charge with Pressure compensation" UWORD rel_uw_b100 1 100 0.00 99.99847 FORMAT "%8.5" ECU_ADDRESS 0x60004BB4 /end MEASUREMENT
/begin MEASUREMENT s1fl2p11_msg "Interface for mode 01+02 absolute throttle position in supply voltage" UBYTE dez 1 100 0.00 255.0 FORMAT "%5.1" ARRAY_SIZE 2 ECU_ADDRESS 0x6000A6E4 /end MEASUREMENT
/begin MEASUREMENT T15_flgOn "Terminal 15 state" UBYTE OneToOne 1 100 0.00 1.000 BIT_MASK 0x1 FORMAT "%5.3" ECU_ADDRESS 0x70002D95 /end MEASUREMENT
/begin MEASUREMENT T15_st "Terminal 15 status after debouncing" UBYTE OneToOne 1 100 0.00 1.000 BIT_MASK 0x1 FORMAT "%5.3" ECU_ADDRESS 0x6000A6D6 /end MEASUREMENT
/begin MEASUREMENT T15_stRaw "Raw value of Terminal 15 status" UBYTE OneToOne 1 100 0.00 255.0 FORMAT "%5.1" ECU_ADDRESS 0x70002D96 /end MEASUREMENT
/begin MEASUREMENT T15_stRawTurnOffDly_Sq "signal quality message for T15stRAW" UBYTE SigQly_COMPU_VERB 1 100 0.00 15.0000000000 FORMAT "%13.10" ECU_ADDRESS 0x6000A2E0 /end MEASUREMENT
/begin MEASUREMENT T50_st "Status of T50 signal" UBYTE OneToOne 1 100 0.00 255.0 FORMAT "%5.1" ECU_ADDRESS 0x6000A6EC /end MEASUREMENT
/begin MEASUREMENT T50_stDebVal "Debounce value of T50 status from Digital input" UBYTE OneToOne 1 100 0.00 255.0 FORMAT "%5.1" ECU_ADDRESS 0x6000A2DF /end MEASUREMENT
/begin MEASUREMENT T50_stEmgcy "status of T50 emergency cranking request" UBYTE OneToOne 1 100 0.00 255.0 FORMAT "%5.1" ECU_ADDRESS 0x6000A6EB /end MEASUREMENT
/begin MEASUREMENT T50_stRaw "Terminal 50 feedback raw signal" UBYTE OneToOne 1 100 0.00 255.0 FORMAT "%5.1" ECU_ADDRESS 0x6000A2DE /end MEASUREMENT
/begin MEASUREMENT tansloc "intake air temperature local copy" UBYTE temp_ub_q0p75_o48 1 100 -48.0 143.3 FORMAT "%5.1" ECU_ADDRESS 0x6000628B /end MEASUREMENT
/begin MEASUREMENT tatekorrin_w "corrected duty cycle for canister purge valve" UWORD rel_uw_b100 1 100 0.00 99.99847 FORMAT "%8.5" ECU_ADDRESS 0x6000357A /end MEASUREMENT
/begin MEASUREMENT tatekorr_w "corrected duty cycle for canister purge valve" UWORD rel_uw_b100 1 100 0.00 99.99847 FORMAT "%8.5" ECU_ADDRESS 0x60003578 /end MEASUREMENT
/begin MEASUREMENT tateout_w_msg "output duty cycle for canister purge valve (16 bit)" UWORD rel_q0p00153 1 100 0.00 99.99847 FORMAT "%8.5" ECU_ADDRESS 0x60004BAA /end MEASUREMENT
/begin MEASUREMENT tatesoll1 "desired duty cycle of the first PCV" UBYTE rel_ub_b99p6 1 100 0.00 99.61 FORMAT "%5.2" ECU_ADDRESS 0x6000628A /end MEASUREMENT
/begin MEASUREMENT tatesoll1old_w "Old value of desired duty cycle used for calculation the variation of duty cycle between 2 process executions." UWORD rel_q0p00153 1 100 0.00 99.99847 FORMAT "%8.5" ECU_ADDRESS 0x60003576 /end MEASUREMENT
/begin MEASUREMENT tatesoll1_w_msg "desired duty cycle of the first PCV (16 bit)" UWORD rel_q0p00153 1 100 0.00 99.99847 FORMAT "%8.5" ECU_ADDRESS 0x60004BA8 /end MEASUREMENT
/begin MEASUREMENT tatesoll_w_msg "desired duty cycle of the PCV (16 bit)" UWORD rel_q0p00153 1 100 0.00 99.99847 FORMAT "%8.5" ECU_ADDRESS 0x60004BA6 /end MEASUREMENT
/begin MEASUREMENT TCE_flgCylIndFcoStrtd "Flag to indicates individual FCO is started" UBYTE B_TRUE 1 100 0.00 1.00000000000 BIT_MASK 0x1 FORMAT "%13.11" ECU_ADDRESS 0x6000A11D /end MEASUREMENT
/begin MEASUREMENT TCE_flgFcoRdy "Flag to indicates FCO Ready" UBYTE B_TRUE 1 100 0.00 1.00000000000 BIT_MASK 0x1 FORMAT "%13.11" ECU_ADDRESS 0x6000A11C /end MEASUREMENT
/begin MEASUREMENT TCE_flgGenericFcoReq "Fuel Cut Off Generic Request" UBYTE B_TRUE 1 100 0.00 1.00000000000 BIT_MASK 0x1 FORMAT "%13.11" ECU_ADDRESS 0x6000A11B /end MEASUREMENT
/begin MEASUREMENT TCE_flgGenericFcoRst "Fuel Cut Off Generic Reset" UBYTE B_TRUE 1 100 0.00 1.00000000000 BIT_MASK 0x1 FORMAT "%13.11" ECU_ADDRESS 0x6000A11A /end MEASUREMENT
/begin MEASUREMENT TCE_nEngTmp "Engine speed at the time when the fuel cutoff release from coeng is set" SWORD EngN 1 100 -16384.00 16383.50 FORMAT "%8.2" ECU_ADDRESS 0x6000358C /end MEASUREMENT
/begin MEASUREMENT TCE_tiExptFcoStrt "Expected time to start FCO" ULONG Time_ms2us 1 100 0.00 4294967.29500 FORMAT "%13.5" ECU_ADDRESS 0x60001C50 /end MEASUREMENT
/begin MEASUREMENT TCE_tiExptFcoTmr "Time output of expected fuel cut-off timer" ULONG Time_ms2us 1 100 0.00 2147483.64700 FORMAT "%13.5" ECU_ADDRESS 0x60001314 /end MEASUREMENT
/begin MEASUREMENT TCE_tqInnrSetCo "Driver demand torque at the time when the fuel cutoff release from coeng is set" SWORD Trq 1 100 0.00 3276.700 FORMAT "%8.3" ECU_ADDRESS 0x6000358A /end MEASUREMENT
/begin MEASUREMENT tCpvModloc "local variable for CstrPurg_tCpv or CstrPurg_tCpvMod switch" UBYTE temp_ub_q0p75_o48 1 100 -48.0 143.3 FORMAT "%5.1" ECU_ADDRESS 0x60006289 /end MEASUREMENT
/begin MEASUREMENT TDevCrssChk_flgBlkHeatrActvd "Blockheater activated at coldstart diagnosis" UBYTE B_TRUE 1 100 0.00 1.00000000000 BIT_MASK 0x1 FORMAT "%13.11" ECU_ADDRESS 0x7000067D /end MEASUREMENT
/begin MEASUREMENT TDevCrssChk_flgCEngBlkTDiagRel "Enginge Block Temperature electic valid" UBYTE B_TRUE 1 100 0.00 1.00000000000 BIT_MASK 0x1 FORMAT "%13.11" ECU_ADDRESS 0x7000067C /end MEASUREMENT
/begin MEASUREMENT TDevCrssChk_flgCEngDsTDiagRel "Enginge Downstream Temperature electic valid" UBYTE B_TRUE 1 100 0.00 1.00000000000 BIT_MASK 0x1 FORMAT "%13.11" ECU_ADDRESS 0x7000067B /end MEASUREMENT
/begin MEASUREMENT TDevCrssChk_flgCEngUsTDiagRel "Enginge Upstream Temperature electic valid" UBYTE B_TRUE 1 100 0.00 1.00000000000 BIT_MASK 0x1 FORMAT "%13.11" ECU_ADDRESS 0x7000067A /end MEASUREMENT
/begin MEASUREMENT TDevCrssChk_flgCHdTDiagRel "Cylinderhead Temperature electic valid" UBYTE B_TRUE 1 100 0.00 1.00000000000 BIT_MASK 0x1 FORMAT "%13.11" ECU_ADDRESS 0x70000679 /end MEASUREMENT
/begin MEASUREMENT TDevCrssChk_flgCTHeatgRetDiagRel "Heating Return Temperature electic valid" UBYTE B_TRUE 1 100 0.00 1.00000000000 BIT_MASK 0x1 FORMAT "%13.11" ECU_ADDRESS 0x70000678 /end MEASUREMENT
/begin MEASUREMENT TDevCrssChk_flgDiagRels "CrossCheck Diagnosis released" UBYTE B_TRUE 1 100 0.00 1.00000000000 BIT_MASK 0x1 FORMAT "%13.11" ECU_ADDRESS 0x70000677 /end MEASUREMENT
/begin MEASUREMENT TDevCrssChk_flgEngMidTDiagRel "Engine Middle Temperature electic valid" UBYTE B_TRUE 1 100 0.00 1.00000000000 BIT_MASK 0x1 FORMAT "%13.11" ECU_ADDRESS 0x70000676 /end MEASUREMENT
/begin MEASUREMENT TDevCrssChk_flgEngRunngDeb "CrossCheck Diagnosis Combustion Engine running, debounced" UBYTE B_TRUE 1 100 0.00 1.00000000000 BIT_MASK 0x1 FORMAT "%13.11" ECU_ADDRESS 0x70000675 /end MEASUREMENT
/begin MEASUREMENT TDevCrssChk_flgEngStrtNotSucCyc "Engine Start in currenct cycle not successful yet" UBYTE B_TRUE 1 100 0.00 1.00000000000 BIT_MASK 0x1 FORMAT "%13.11" ECU_ADDRESS 0x70000674 /end MEASUREMENT
/begin MEASUREMENT TDevCrssChk_flgEnvTDiagRel "Environment-Temperature electic valid" UBYTE B_TRUE 1 100 0.00 1.00000000000 BIT_MASK 0x1 FORMAT "%13.11" ECU_ADDRESS 0x70000673 /end MEASUREMENT
/begin MEASUREMENT TDevCrssChk_flgFirstStrt "CrossCheck FirstStart of combustion engine executed" UBYTE B_TRUE 1 100 0.00 1.00000000000 BIT_MASK 0x1 FORMAT "%13.11" ECU_ADDRESS 0x70000672 /end MEASUREMENT
/begin MEASUREMENT TDevCrssChk_flgInhbnCptDfct "Lock of CrossCheck in case of component defect" UBYTE B_TRUE 1 100 0.00 1.00000000000 BIT_MASK 0x1 FORMAT "%13.11" ECU_ADDRESS 0x70000671 /end MEASUREMENT
/begin MEASUREMENT TDevCrssChk_flgIntkAirT1DiagRel "Intake Air Temperature 1 electic valid" UBYTE B_TRUE 1 100 0.00 1.00000000000 BIT_MASK 0x1 FORMAT "%13.11" ECU_ADDRESS 0x70000670 /end MEASUREMENT
/begin MEASUREMENT TDevCrssChk_flgIntkAirT2DiagRel "Intake Air Temperature 2 electic valid" UBYTE B_TRUE 1 100 0.00 1.00000000000 BIT_MASK 0x1 FORMAT "%13.11" ECU_ADDRESS 0x7000066F /end MEASUREMENT
/begin MEASUREMENT TDevCrssChk_flgIntkAirT3DiagRel "Intake Air Temperature 3 electic valid" UBYTE B_TRUE 1 100 0.00 1.00000000000 BIT_MASK 0x1 FORMAT "%13.11" ECU_ADDRESS 0x7000066E /end MEASUREMENT
/begin MEASUREMENT TDevCrssChk_flgIntkAirT4DiagRel "Intake Air Temperature 4 electic valid" UBYTE B_TRUE 1 100 0.00 1.00000000000 BIT_MASK 0x1 FORMAT "%13.11" ECU_ADDRESS 0x7000066D /end MEASUREMENT
/begin MEASUREMENT TDevCrssChk_flgOilFilTDiagRel "Oil Filter Temperature electic valid" UBYTE B_TRUE 1 100 0.00 1.00000000000 BIT_MASK 0x1 FORMAT "%13.11" ECU_ADDRESS 0x7000066C /end MEASUREMENT
/begin MEASUREMENT TDevCrssChk_flgOilGlryTDiagRel "Oil Gallery Temperature Sensor electrical valid" UBYTE B_TRUE 1 100 0.00 1.00000000000 BIT_MASK 0x1 FORMAT "%13.11" ECU_ADDRESS 0x7000066B /end MEASUREMENT
/begin MEASUREMENT TDevCrssChk_flgOilSwmpTDiagRel "OilSwamp Temperature electic valid" UBYTE B_TRUE 1 100 0.00 1.00000000000 BIT_MASK 0x1 FORMAT "%13.11" ECU_ADDRESS 0x7000066A /end MEASUREMENT
/begin MEASUREMENT TDevCrssChk_flgPrelCEngDsTErr "ColdstartdDiagnosis preliminary error CEngDsT" UBYTE B_TRUE 1 100 0.00 1.00000000000 BIT_MASK 0x1 FORMAT "%13.11" ECU_ADDRESS 0x70000669 /end MEASUREMENT
/begin MEASUREMENT TDevCrssChk_flgPrelCEngDsTHeal "ColdstartdDiagnosis preliminary healing CEngDsT" UBYTE B_TRUE 1 100 0.00 1.00000000000 BIT_MASK 0x1 FORMAT "%13.11" ECU_ADDRESS 0x70000668 /end MEASUREMENT
/begin MEASUREMENT TDevCrssChk_flgPrelCEngDsTMaxErr "ColdstartdDiagnosis preliminary max error CEngDsT" UBYTE B_TRUE 1 100 0.00 1.00000000000 BIT_MASK 0x1 FORMAT "%13.11" ECU_ADDRESS 0x70000667 /end MEASUREMENT
/begin MEASUREMENT TDevCrssChk_flgPrelCEngDsTMinErr "ColdstartdDiagnosis preliminary min error CEngDsT" UBYTE B_TRUE 1 100 0.00 1.00000000000 BIT_MASK 0x1 FORMAT "%13.11" ECU_ADDRESS 0x70000666 /end MEASUREMENT
/begin MEASUREMENT TDevCrssChk_flgPrelIntkAirT1Heal "ColdstartdDiagnosis preliminary healing IntkAirT1" UBYTE B_TRUE 1 100 0.00 1.00000000000 BIT_MASK 0x1 FORMAT "%13.11" ECU_ADDRESS 0x70000665 /end MEASUREMENT
/begin MEASUREMENT TDevCrssChk_flgPrelIntkAirT1MaxErr "ColdstartdDiagnosis preliminary max error IntkAirT1" UBYTE B_TRUE 1 100 0.00 1.00000000000 BIT_MASK 0x1 FORMAT "%13.11" ECU_ADDRESS 0x70000664 /end MEASUREMENT
/begin MEASUREMENT TDevCrssChk_flgPrelIntkAirT1MinErr "ColdstartdDiagnosis preliminary min error IntkAirT1" UBYTE B_TRUE 1 100 0.00 1.00000000000 BIT_MASK 0x1 FORMAT "%13.11" ECU_ADDRESS 0x70000663 /end MEASUREMENT
/begin MEASUREMENT TDevCrssChk_flgPrpSysInactv "CrossCheck Flag for propulsion system inactive" UBYTE B_TRUE 1 100 0.00 1.00000000000 BIT_MASK 0x1 FORMAT "%13.11" ECU_ADDRESS 0x70000662 /end MEASUREMENT
/begin MEASUREMENT TDevCrssChk_flgT15Dly "CrossCheck Flag T15 delayed" UBYTE B_TRUE 1 100 0.00 1.00000000000 BIT_MASK 0x1 FORMAT "%13.11" ECU_ADDRESS 0x70000661 /end MEASUREMENT
/begin MEASUREMENT TDevCrssChk_flgTFlTnkDiagRel "TFlTnk signal electrical valid" UBYTE B_TRUE 1 100 0.00 1.00000000000 BIT_MASK 0x1 FORMAT "%13.11" ECU_ADDRESS 0x70000660 /end MEASUREMENT
/begin MEASUREMENT TDevCrssChk_st "State of Tdev CrossCheck Diagnosis" UBYTE OneToOne 1 100 0.00 255.0 FORMAT "%5.1" ECU_ADDRESS 0x6000A010 /end MEASUREMENT
/begin MEASUREMENT TDevCrssChk_tFrzAvg "Temperture mean value, calculated out of freeze values from provided temperature sensors" SWORD Temp_Cels 1 100 -3549.940 3003.560 FORMAT "%8.3" ECU_ADDRESS 0x6000496C /end MEASUREMENT
/begin MEASUREMENT TDevCrssChk_tIntkAirT1Min "CrossCheck Minimum IntkAirT1 temperature. Monitor" SWORD Temp_Cels 1 100 -3549.940 3003.560 FORMAT "%8.3" ECU_ADDRESS 0x6000496A /end MEASUREMENT
/begin MEASUREMENT TDev_flgColdStrtDiagFinshd "Flag to indicate successful completion of cold start diagnosis(error could be found)" UBYTE B_TRUE 1 100 0.00 1.00000000000 BIT_MASK 0x1 FORMAT "%13.11" ECU_ADDRESS 0x7000065F /end MEASUREMENT
/begin MEASUREMENT TDev_flgDSMRprt1000ms "Flag to enable reporting of diagnosis results to DSM (after DSM Re-Initialization) for 1000ms task" UBYTE B_TRUE 1 100 0.00 1.00000000000 BIT_MASK 0x1 FORMAT "%13.11" ECU_ADDRESS 0x7000065E /end MEASUREMENT
/begin MEASUREMENT TDev_flgDSMRprt100ms "Flag to enable reporting of diagnosis results to DSM (after DSM Re-Initialization) for 100ms task" UBYTE B_TRUE 1 100 0.00 1.00000000000 BIT_MASK 0x1 FORMAT "%13.11" ECU_ADDRESS 0x7000065D /end MEASUREMENT
/begin MEASUREMENT TDev_tRefColdStrtChk "Refernce value for cold start diagnosis from all available sensors" SWORD temp_q0p75 1 100 -24576.00 24575.25 FORMAT "%8.2" ECU_ADDRESS 0x60004968 /end MEASUREMENT
/begin MEASUREMENT teini "Y-input (ambient air temperature, engine temperature or the model temperature for fuel) to the map KFTEINI" UBYTE temp_ub_q0p75_o48 1 100 -48.0 143.3 FORMAT "%5.1" ECU_ADDRESS 0x60006275 /end MEASUREMENT
/begin MEASUREMENT tevper_msg "periode time of purge control valve" UBYTE t500usxms_ub_q0p5 1 100 0.00 127.5 FORMAT "%5.1" ECU_ADDRESS 0x6000A284 /end MEASUREMENT
/begin MEASUREMENT tfteini_w "time for detection of purge stop" UWORD t_q0p1 1 100 0.00 6553.500 FORMAT "%8.3" ECU_ADDRESS 0x6000350A /end MEASUREMENT
/begin MEASUREMENT ThDev_flgACMaiSwtCodVal "Status of AC switch in case of coded configuration" UBYTE B_TRUE 1 100 0.00 1.00000000000 BIT_MASK 0x1 FORMAT "%13.11" ECU_ADDRESS 0x60009F86 /end MEASUREMENT
/begin MEASUREMENT ThDev_stMaiSwtACSig "The source of the main AC switch" UBYTE OneToOne 1 100 0.00 255.0 FORMAT "%5.1" ECU_ADDRESS 0x6000A00B /end MEASUREMENT
/begin MEASUREMENT ThrVlv_bDblSensErrSuspcDeb_msg "Double sensor error suspicion - debounced" UBYTE OneToOne 1 100 0.00 1.000 BIT_MASK 0x1 FORMAT "%5.3" ECU_ADDRESS 0x6000E432 /end MEASUREMENT
/begin MEASUREMENT ThrVlv_bSngSensErr_msg "Single Sensor Error at Throttle Valve occured" UBYTE OneToOne 1 100 0.00 1.000 BIT_MASK 0x1 FORMAT "%5.3" ECU_ADDRESS 0x6000E433 /end MEASUREMENT
/begin MEASUREMENT ThrVlv_flgBattFltB1 "Too low battery voltage bank 1" UBYTE OneToOne 1 100 0.00 1.000 BIT_MASK 0x1 FORMAT "%5.3" ECU_ADDRESS 0x60006274 /end MEASUREMENT
/begin MEASUREMENT ThrVlv_flgDKnplErrActB1 "Rising edge to set sum error B1" UBYTE OneToOne 1 100 0.00 1.000 BIT_MASK 0x1 FORMAT "%5.3" ECU_ADDRESS 0x6000E3B7 /end MEASUREMENT
/begin MEASUREMENT ThrVlv_flgDKnplErrOldB1 "Falling edge healing sum error B1" UBYTE OneToOne 1 100 0.00 1.000 BIT_MASK 0x1 FORMAT "%5.3" ECU_ADDRESS 0x6000E3B8 /end MEASUREMENT
/begin MEASUREMENT ThrVlv_flgIrrvBattFltB1 "Irreversible battery fault bank 1" UBYTE OneToOne 1 100 0.00 1.000 BIT_MASK 0x1 FORMAT "%5.3" ECU_ADDRESS 0x60006273 /end MEASUREMENT
/begin MEASUREMENT ThrVlv_flgIrrvFuCutOffB1 "Irreversible safety fuel cut off SKA" UBYTE OneToOne 1 100 0.00 1.000 BIT_MASK 0x1 FORMAT "%5.3" ECU_ADDRESS 0x6000E434 /end MEASUREMENT
/begin MEASUREMENT ThrVlv_flgLimpModeB1 "Limp home driving requested" UBYTE OneToOne 1 100 0.00 1.000 BIT_MASK 0x1 FORMAT "%5.3" ECU_ADDRESS 0x50005DC7 /end MEASUREMENT
/begin MEASUREMENT ThrVlv_flgMonDsmClearDmd_B1 "Demand for fault memory clearing bank 1" UBYTE OneToOne 1 100 0.00 1.000 BIT_MASK 0x1 FORMAT "%5.3" ECU_ADDRESS 0x60006272 /end MEASUREMENT
/begin MEASUREMENT ThrVlv_flgRegTqRednB1 "Request torque limitation" UBYTE OneToOne 1 100 0.00 1.000 BIT_MASK 0x1 FORMAT "%5.3" ECU_ADDRESS 0x6000A7DD /end MEASUREMENT
/begin MEASUREMENT ThrVlv_flgReqFuCutOffB1 "Request safety fuel cut off" UBYTE OneToOne 1 100 0.00 1.000 BIT_MASK 0x1 FORMAT "%5.3" ECU_ADDRESS 0x50005DC8 /end MEASUREMENT
/begin MEASUREMENT ThrVlv_flgRvsbBattFltB1 "Reversible battery fault bank 1" UBYTE OneToOne 1 100 0.00 1.000 BIT_MASK 0x1 FORMAT "%5.3" ECU_ADDRESS 0x60006271 /end MEASUREMENT
/begin MEASUREMENT ThrVlv_flgRvsbFuCutOffB1 "Request reversible safety fuel cut off SKA" UBYTE OneToOne 1 100 0.00 1.000 BIT_MASK 0x1 FORMAT "%5.3" ECU_ADDRESS 0x6000A7DB /end MEASUREMENT
/begin MEASUREMENT ThrVlv_flgSnsrDiagPrmsB1 "Flag: Permission for sensor diagnosis given" UBYTE OneToOne 1 100 0.00 1.000 BIT_MASK 0x1 FORMAT "%5.3" ECU_ADDRESS 0x60006270 /end MEASUREMENT
/begin MEASUREMENT ThrVlv_flgUBattSuffB1 "Battery voltage for throttle valve operation sufficient" UBYTE OneToOne 1 100 0.00 1.000 BIT_MASK 0x1 FORMAT "%5.3" ECU_ADDRESS 0x6000A7D9 /end MEASUREMENT
/begin MEASUREMENT ThrVlv_tiDebBattUB1_CL_I.cntDebTi "Debounce timer battery voltage depression bank 1 / Internal counter of the DebUpDwn class" SLONG Time_Dt 1 100 -2147.48364800 2147.48364700 FORMAT "%13.8" ECU_ADDRESS 0x6000130C /end MEASUREMENT
/begin MEASUREMENT TiEngOff_ti_loc "local variable to determine engine off time" UWORD t_q1 1 100 0.00 65535.00 FORMAT "%8.2" ECU_ADDRESS 0x60003580 /end MEASUREMENT
/begin MEASUREMENT tvtevptu_w "delay time of PCV (pressure, battery voltage, temperature dependent)" UWORD t_q0p01_ms 1 100 0.00 655.3500 FORMAT "%8.4" ECU_ADDRESS 0x60003574 /end MEASUREMENT
/begin MEASUREMENT wdk1ba_w_msg "throttle angle with respect to lower mechanical stop (Throttle 1)" SWORD relDK_q0p02441 1 100 -800.0000 799.9756 FORMAT "%8.4" ECU_ADDRESS 0x70002D16 /end MEASUREMENT
/begin MEASUREMENT wdkba_msg "throttle angle referred to lower limit" UBYTE relDK_ub_b100 1 100 0.00 100.0 FORMAT "%5.1" ECU_ADDRESS 0x6000E45C /end MEASUREMENT
/begin MEASUREMENT wdkba_w_msg "throttle angle with respect to lower mechanical stop" SWORD relDK_q0p02441 1 100 -800.0000 799.9756 FORMAT "%8.4" ECU_ADDRESS 0x6000537A /end MEASUREMENT
/begin MEASUREMENT wdkink_w_msg "Current increment of throttle-valve target value" UWORD rel_uw_b100 1 100 0.00 99.99847 FORMAT "%8.5" ECU_ADDRESS 0x6000E33A /end MEASUREMENT
/begin MEASUREMENT wdkma_w_msg "Throttle position angle signal with tolerances maximal" UWORD rel_uw_b100 1 100 0.00 99.99847 FORMAT "%8.5" ECU_ADDRESS 0x6000E33C /end MEASUREMENT
/begin MEASUREMENT wdkmi_w_msg "Throttle position angle signal with tolerances minimal" UWORD rel_uw_b100 1 100 0.00 99.99847 FORMAT "%8.5" ECU_ADDRESS 0x6000E33E /end MEASUREMENT
/begin MEASUREMENT wdknlp_w_msg "throttle angle in the limphome air position" UWORD relDK_uw_b100 1 100 0.00 100.0000 FORMAT "%8.4" ECU_ADDRESS 0x6000E340 /end MEASUREMENT
/begin MEASUREMENT wdkpm_w_msg "throttle angle with respect to lower mechanical stop (average value or in case of sensor error, the current chosen throttle plate angle wdk_w)" UWORD rel_uw_b100 1 100 0.00 99.99847 FORMAT "%8.5" ECU_ADDRESS 0x6000E342 /end MEASUREMENT
/begin MEASUREMENT wdk_w_msg "Throttle position angle signal 16 bits" UWORD rel_uw_b100 1 100 0.00 99.99847 FORMAT "%8.5" ECU_ADDRESS 0x70002D18 /end MEASUREMENT
/begin FUNCTION T152MED "10.6.0    Interface Adapter T15 to MED" /begin IN_MEASUREMENT T15_st /end IN_MEASUREMENT /begin OUT_MEASUREMENT B_kl15_msg /end OUT_MEASUREMENT FUNCTION_VERSION "10.6.0" /end FUNCTION
/begin FUNCTION T15_Vld2Lcy "1.11.0    SW Adapter Terminal15 Component Package: Mapping Valid to Legacy Interface Elements" /begin OUT_MEASUREMENT T15_flgOn T15_st T15_stRaw T15_stRawTurnOffDly_Sq /end OUT_MEASUREMENT FUNCTION_VERSION "1.11.0" /end FUNCTION
/begin FUNCTION T50_DD "41.1.0    Start request T50 - driver device"
 /begin DEF_CHARACTERISTIC T50_stDftVal_C T50_swtSigSel_C T50_tiDebHiLo_C T50_tiDebLoHi_C /end DEF_CHARACTERISTIC
 /begin IN_MEASUREMENT Com_stT50 /end IN_MEASUREMENT
 /begin OUT_MEASUREMENT T50_stDebVal /end OUT_MEASUREMENT
 /begin LOC_MEASUREMENT T50_stRaw /end LOC_MEASUREMENT
 FUNCTION_VERSION "41.1.0" /end FUNCTION
/begin FUNCTION T50_VD "36.0.0    Start request T50 - virtual device"
 /begin DEF_CHARACTERISTIC T50_stEmgyDfl_C T50_stNormDfl_C T50_swtEmgyReq_C T50_swtNormReq_C T50_tiEmgcyReq_C /end DEF_CHARACTERISTIC
 /begin IN_MEASUREMENT Com_stEmgcyStrtReqOutSel Com_stStrtReqOutSel MoFTerminal_stT50EmgyMsg /end IN_MEASUREMENT
 /begin OUT_MEASUREMENT T50_st T50_stEmgcy /end OUT_MEASUREMENT
 FUNCTION_VERSION "36.0.0" /end FUNCTION
/begin FUNCTION TCE_Adpr "123.0.0_1.2.0Torque Coordination Engine Adapter" /begin DEF_CHARACTERISTIC TCE_flgGenericFcoReq_C TCE_flgGenericFcoRst_C /end DEF_CHARACTERISTIC /begin IN_MEASUREMENT CoPT_flgFuCutOffActv /end IN_MEASUREMENT /begin OUT_MEASUREMENT TCE_flgGenericFcoReq TCE_flgGenericFcoRst /end OUT_MEASUREMENT FUNCTION_VERSION "123.0.0_1.2.0" /end FUNCTION
/begin FUNCTION TCE_ComSigPrepn "1.1.0     TCE Communication Signal Preparation"
 /begin DEF_CHARACTERISTIC TCE_numCcoThd_C TCE_tiExptFcoStrt_C TCE_tqOverrunOffsThdAcOn_M TCE_tqOverrunOffsThd_M /end DEF_CHARACTERISTIC
 /begin IN_MEASUREMENT AirC_stCmprAct CoEng_bCtOffConDel CoETS_trqInrSetCo ECT_bFCOEnaCmpnPrt Epm_nEng Gbx_stPNPos InjSys_stActRedStg PthSet_bCylIndivFCOBef PthSet_stOvrRun RngMod_trqInrMinWoCtOff /end IN_MEASUREMENT
 /begin OUT_MEASUREMENT TCE_flgCylIndFcoStrtd TCE_flgFcoRdy TCE_tiExptFcoStrt /end OUT_MEASUREMENT
 /begin LOC_MEASUREMENT TCE_nEngTmp TCE_tiExptFcoTmr TCE_tqInnrSetCo /end LOC_MEASUREMENT
 FUNCTION_VERSION "1.1.0" /end FUNCTION
/begin FUNCTION TDev_Adpr "3.2.0     Adapter Function for calculation of component within BC TDev" /begin IN_MEASUREMENT DSMAUX_stDsmClrActv /end IN_MEASUREMENT /begin OUT_MEASUREMENT TDev_flgDSMRprt1000ms TDev_flgDSMRprt100ms /end OUT_MEASUREMENT FUNCTION_VERSION "3.2.0" /end FUNCTION
/begin FUNCTION TDev_CrssChk "5.5.0     CrossCkeck-Diagnosis for TemperatureDevices"
 /begin DEF_CHARACTERISTIC TDevCrssChk_stCfgSwt_C TDevCrssChk_stEnaSnsrForCalcAvrg_C TDevCrssChk_tDiffColdStrtMaxThd_C TDevCrssChk_tDiffColdStrtMinThd_C TDevCrssChk_tDiffIntkAirTMaxThd_C TDevCrssChk_tDiffIntkAirTMinThd_C TDevCrssChk_tiDebEngOff_C TDevCrssChk_tiDebEngOn_C TDevCrssChk_tiForBlkHeatrDetn_C TDevCrssChk_tiForEngStrtFaild_C TDevCrssChk_tiMaxForColdStrtDiag_C TDevCrssChk_tiMinEngCoolgDwn_T TDevCrssChk_tiT15Dly_C TDevCrssChk_tMinThdForEngStal_C /end DEF_CHARACTERISTIC
 /begin IN_MEASUREMENT B_tmmn_msg CEngDsT_flgSnsrColdStrtClr CEngDsT_tSnsrFild CEngDsT_tStop CEngUsT_tSens EngStrt_bStrtEnd Epm_stSpd IntkAirT_flgSnsr1CrssChkClr IntkAirT_tSnsrFild1 SyC_stSub T15_st TiEngOff_stTi TiEngOff_ti /end IN_MEASUREMENT
 /begin OUT_MEASUREMENT CEngDsT_flgColdStrtDi CEngDsT_flgColdStrtFinal CEngDsT_flgColdStrtHeal CEngDsT_flgColdStrtMaxErr CEngDsT_flgColdStrtMinErr CEngDsT_flgColdStrtRiseNr IntkAirT_flgColdStrt1Final IntkAirT_flgCrss1MaxErr IntkAirT_flgCrss1MaxHeal IntkAirT_flgCrss1MinErr IntkAirT_flgCrss1MinHeal IntkAirT_flgCrssChk1NumrInc TDevCrssChk_tFrzAvg TDev_flgColdStrtDiagFinshd TDev_tRefColdStrtChk /end OUT_MEASUREMENT
 /begin LOC_MEASUREMENT TDevCrssChk_flgBlkHeatrActvd TDevCrssChk_flgCEngBlkTDiagRel TDevCrssChk_flgCEngDsTDiagRel TDevCrssChk_flgCEngUsTDiagRel TDevCrssChk_flgCHdTDiagRel TDevCrssChk_flgCTHeatgRetDiagRel TDevCrssChk_flgDiagRels TDevCrssChk_flgEngMidTDiagRel TDevCrssChk_flgEngRunngDeb TDevCrssChk_flgEngStrtNotSucCyc TDevCrssChk_flgEnvTDiagRel TDevCrssChk_flgFirstStrt TDevCrssChk_flgInhbnCptDfct TDevCrssChk_flgIntkAirT1DiagRel TDevCrssChk_flgIntkAirT2DiagRel TDevCrssChk_flgIntkAirT3DiagRel TDevCrssChk_flgIntkAirT4DiagRel TDevCrssChk_flgOilFilTDiagRel TDevCrssChk_flgOilGlryTDiagRel TDevCrssChk_flgOilSwmpTDiagRel TDevCrssChk_flgPrelCEngDsTErr TDevCrssChk_flgPrelCEngDsTHeal TDevCrssChk_flgPrelCEngDsTMaxErr TDevCrssChk_flgPrelCEngDsTMinErr TDevCrssChk_flgPrelIntkAirT1Heal TDevCrssChk_flgPrelIntkAirT1MaxErr TDevCrssChk_flgPrelIntkAirT1MinErr TDevCrssChk_flgPrpSysInactv TDevCrssChk_flgT15Dly TDevCrssChk_flgTFlTnkDiagRel TDevCrssChk_st TDevCrssChk_tIntkAirT1Min /end LOC_MEASUREMENT
 FUNCTION_VERSION "5.5.0" /end FUNCTION
/begin FUNCTION TEADAP "30301.9.0 Adaptation Mixture Deviation during Purge Control"
 /begin DEF_CHARACTERISTIC CstrPurg_facPurgCtrlAdapnOffs_T CstrPurg_facPurgRateRednMin_C CstrPurg_facTCorrnFuPurgAdpn_M CstrPurg_tiCstrLdAdpnDly_C FBTEFKA FBTEFKAX FTEADMAX FTEADMINH KFFTEAD KFKORMTMOD MSTEFTEAD ZKFTEAD /end DEF_CHARACTERISTIC
 /begin REF_CHARACTERISTIC CWFPCES /end REF_CHARACTERISTIC
 /begin IN_MEASUREMENT B_fvgte_msg B_rkteb_msg B_ten_msg B_te_msg CoEng_flgCpvClsForFco CstrPurg_flgImsteiniNV dfr_w_msg EnvT_t fgwrte_msg fkakormt_w_msg fkastexm_w_msg fkaste_msg imsteini_msg mksbg_msg msntetev_w_msg SyC_stSub TiEngOff_stTi TiEngOff_ti /end IN_MEASUREMENT
 /begin OUT_MEASUREMENT B_fteadber_msg fteadf_msg fteadf_w_msg ftead_w_msg /end OUT_MEASUREMENT
 /begin LOC_MEASUREMENT CstrPurg_facLamDeMin CstrPurg_flgIniTEADAP100ms CstrPurg_flgReIniTEADAP100ms CstrPurg_TEADAPdkhckorrIKL_I.memory CstrPurg_TEADAPRstIntegFF_I.status CstrPurg_tPurgAdpnCorrn fkakormt_loc fkastexm kintftead kormtmod_w TiEngOff_ti_loc /end LOC_MEASUREMENT
 FUNCTION_VERSION "30301.9.0" /end FUNCTION
/begin FUNCTION TEATEV "30301.8.0 Calculation duty cycle and period for controlling of canister purge valve"
 /begin DEF_CHARACTERISTIC CstrPurg_ChartcDlyTiCpv_M CstrPurg_facCpvDlyTiCorrn_Cur CstrPurg_ratMinChgReIni_C CstrPurg_stTMdl_C CWFPCTVTEV CWTTEV FTVTEVTANS KFTEVP KFTVPHTEV MSNTEVO TATEGMX TATEMSN /end DEF_CHARACTERISTIC
 /begin IN_MEASUREMENT arqttev_w_msg BattU_u B_rqttev_msg B_tevtini_msg CstrPurg_ratPAftCpvToEnv CstrPurg_tCpvMod Epm_nEngLRes msntesol_w_msg PEnv_p pndk_w_msg SyC_stSub tans_msg /end IN_MEASUREMENT
 /begin OUT_MEASUREMENT B_tatewi_msg CstrPurg_ratSp msntetev_w_msg msntevo_w_msg pndkpu_msg pndkpu_w_msg tateout_w_msg tatesoll1_w_msg tatesoll_w_msg tevper_msg /end OUT_MEASUREMENT
 /begin LOC_MEASUREMENT BattU_u_ubrsq CstrPurg_ratSpCorrn Epm_nEngLRes_nmot FPCtl_flgIniTEATEV20ms FPCtl_flgReIniTEATEV20ms phtev_w tansloc tatekorrin_w tatekorr_w tatesoll1 tatesoll1old_w tCpvModloc tvtevptu_w /end LOC_MEASUREMENT
 FUNCTION_VERSION "30301.8.0" /end FUNCTION
/begin FUNCTION TEBGTEV "101.23.0  Calculation of actual mass flow"
 /begin DEF_CHARACTERISTIC CstrPurg_facChartcFlowCorrnCpv_M CstrPurg_facChartcFlowCpv_M CstrPurg_facChartcFlowHalfEngModCpv_M CstrPurg_facCorrnAltiTCpvMod_T CstrPurg_facLoadCoeff_T CstrPurg_facLoadIni_C CstrPurg_facLoad_M CstrPurg_fakMFlowAcfIni_C CstrPurg_fakMFlowAcfLd_M CstrPurg_fakRadrCoolgIni_C CstrPurg_fakRadrCoolg_M CstrPurg_ratWghtRelAirFillgIni_C CstrPurg_tiFakMFlowAcfLd_T CstrPurg_tiFilEtc_M CstrPurg_tiLoadFilt_C CstrPurg_tiRadrCoolgFilt_C CstrPurg_tiWghtRelAirFillgFilt_C CstrPurg_ttadkmax_C CWTEBGTEV /end DEF_CHARACTERISTIC
 /begin REF_CHARACTERISTIC FTVDKTAVDK /end REF_CHARACTERISTIC
 /begin IN_MEASUREMENT B_vheg_msg EnvT_t Epm_nEng ftead_w_msg ftvdk_w_msg msntetev_w_msg msntevo_w_msg PEnv_facCorrAlti pndkpu_w_msg rl_w_msg SyC_stSub tadk_w_msg tateout_w_msg VehV_v /end IN_MEASUREMENT
 /begin OUT_MEASUREMENT CstrPurg_mFlowCpv1LoLdPurgLn CstrPurg_ratPAftCpvToEnv CstrPurg_tCpvMod ftho_w_msg mstedte_msg mstedte_w_msg msteo_w_msg mste_msg mste_w_msg /end OUT_MEASUREMENT
 /begin LOC_MEASUREMENT CstrPurg_facCorrnT CstrPurg_facCorrnTCpvMod CstrPurg_facFlowCpvLoLoad CstrPurg_facFlowCpvLoLoadCda CstrPurg_facFlowCpvTAltiLoLoad CstrPurg_facFlowDutyCycCpv CstrPurg_facLoad CstrPurg_facLoadFilt CstrPurg_facWghtLoadCoeff CstrPurg_fakMFlowAcfLd CstrPurg_fakMFlowAcfLdFilt CstrPurg_fakRadrCoolg CstrPurg_fakRadrCoolgFilt CstrPurg_flgReIniTEBGTEV20ms CstrPurg_ratPLoLoadPurgLnToEnv CstrPurg_ratRadShtDes CstrPurg_ratWghtRelAirFillg CstrPurg_ratWghtRelAirFillgFilt CstrPurg_tDifThr2Env CstrPurg_tFiltDifThr2Env CstrPurg_tLoadTChgCpv CstrPurg_tRadrCoolgCpv CstrPurg_tThrHeatgCpv CstrPurg_tThrIntAirFilt FPCtl_flgIniDrvTEBGTEV mstesr_w /end LOC_MEASUREMENT
 FUNCTION_VERSION "101.23.0" /end FUNCTION
/begin FUNCTION TECOOR "30301.1.0 Coordination purge control"
 /begin DEF_CHARACTERISTIC FuPurg_facAdpnVlvLftMax_C FuPurg_facAdpnVlvLftMin_C FuPurg_stCfgExtReqCoorn_C /end DEF_CHARACTERISTIC
 /begin IN_MEASUREMENT B_te_msg fteadf_msg SyC_stSub /end IN_MEASUREMENT
 /begin OUT_MEASUREMENT FuPurg_flgReqVlvFullLftIntk pstems_w_msg /end OUT_MEASUREMENT
 /begin LOC_MEASUREMENT FPCtl_flgIniTECOOR20ms FPCtl_flgReIniTECOOR100ms FPCtl_flgReIniTECOOR20ms /end LOC_MEASUREMENT
 FUNCTION_VERSION "30301.1.0" /end FUNCTION
/begin FUNCTION TEEB "30301.10.0Operating conditions for canister purge valve"
 /begin DEF_CHARACTERISTIC CstrPurg_LambdaEnaMax_C CstrPurg_LambdaEnaMin_C CstrPurg_nEngThd_T CstrPurg_tiInhLamDevMax_C CstrPurg_uBattMax_C CstrPurg_uBattMin_C CWFPC CWFPCES CWFPCKH CWFPCPRIO DRLTELL FPCtl_mfThdCpvFlow_C FTEADRPL FTEADSPH RLTELLMN TATELL TEDLKH TMSTTE TMTE TSABTE_CUR TTEATMTPA TTEAUS TTEGERTE TVATEH TVATEL TVEVLOCTE TVTEB /end DEF_CHARACTERISTIC
 /begin IN_MEASUREMENT BattU_u B_evloc_msg B_fvgte_msg B_lamkh_msg B_lamrb_msg B_ll_msg B_rbte_msg B_stoevab_msg CEngDsT_t CEngDsT_tStrt CoEng_flgCpvClsForFco Epm_nEng Epm_stSpd ExhMod_flgDewPntEndS1B1 frm_w_msg fteadf_msg imsteini_msg msntetev_w_msg rl_w_msg SyC_stSub tans_msg tnsez_w_msg VehV_v /end IN_MEASUREMENT
 /begin OUT_MEASUREMENT B_avateh_msg B_avatel_msg B_avaten_msg B_frteatmtpa_msg B_fteadh_msg B_gerte_msg B_lteab_msg B_mstefg_msg B_teakt_msg B_tef_msg B_tei_msg B_ten_msg B_te_msg CstrPurg_flgUBattOk /end OUT_MEASUREMENT
 /begin LOC_MEASUREMENT B_lltans b_pyatenloc B_telrlei B_tvateh B_tvatel CstrPurg_flgAbrt CstrPurg_flgBigLamDev CstrPurg_flgCdnFuCutOffDly CstrPurg_flgEnaCdnCatHeatg CstrPurg_flgEnaCdnTiStrtEnd CstrPurg_TEEBAllLocInjVlvActvTONV_I.outbit CstrPurg_TEEBAllLocInjVlvActvTONV_I.time CstrPurg_TEEBClsdLoopCtrlTOFFV_I.outbit CstrPurg_TEEBClsdLoopCtrlTOFFV_I.time CstrPurg_TEEBCpvClsForFcoTOFFV_I.outbit CstrPurg_TEEBCpvClsForFcoTOFFV_I.time CstrPurg_TEEBHiLoadTONVNM.time CstrPurg_TEEBLoLoadTONVNM.time CstrPurg_tiInhLamDev FPCtl_flg100msReIniTEEB FPCtl_flg20msReIniTEEB FPCtl_flgSyncS1ReIniTEEB /end LOC_MEASUREMENT
 FUNCTION_VERSION "30301.10.0" /end FUNCTION
/begin FUNCTION TEKOMS "30304.1.0 Coordinator of CPV" /begin IN_MEASUREMENT msntes_w_msg SyC_stSub /end IN_MEASUREMENT /begin OUT_MEASUREMENT msntesol_w_msg /end OUT_MEASUREMENT /begin LOC_MEASUREMENT B_otdiag msotdiag_w /end LOC_MEASUREMENT FUNCTION_VERSION "30304.1.0" /end FUNCTION
/begin FUNCTION TELAM "30301.2.0 processing signals of cloosed lopp lambda control for purge control" /begin DEF_CHARACTERISTIC CstrPurg_stSelnLamRdy_C LAMTEMN LAMTEMX /end DEF_CHARACTERISTIC
 /begin IN_MEASUREMENT B_lrs_msg B_mstefg_msg B_sbblsu_msg frm_w_msg lamsons_w_msg lamssok_w_msg lamzak_w_msg SyC_stSub /end IN_MEASUREMENT
 /begin OUT_MEASUREMENT B_lamrb_msg B_rbte_msg fkakormt_w_msg fkakormx_w_msg fkakor_w_msg /end OUT_MEASUREMENT
 /begin LOC_MEASUREMENT CstrPurg_flgReIniTELAM100ms /end LOC_MEASUREMENT
 FUNCTION_VERSION "30301.2.0" /end FUNCTION
/begin FUNCTION TEMSSOLS "30301.3.0 Desired mass flow of purge control"
 /begin DEF_CHARACTERISTIC CstrPurg_tiMfRmpDwnDft_C FGWRMSMX KFDMSTES KFTQTEABF KLFDMSTES KLZKMSTES /end DEF_CHARACTERISTIC
 /begin IN_MEASUREMENT B_mstefg_msg CstrPurg_flgPurgActv fgwrte_msg ftead_w_msg ftevflox_w_msg ktevanst_msg mksbg_msg msntevo_w_msg msteo_w_msg mste_w_msg SyC_stSub /end IN_MEASUREMENT
 /begin OUT_MEASUREMENT msntes_w_msg mstesnc_w_msg mstesoll_w_msg /end OUT_MEASUREMENT
 /begin LOC_MEASUREMENT CstrPurg_mfDeltaRampDwn CstrPurg_tiMfRmpDwn divtqteabf dmstes_w FPCtl_flgReIniTEMSSOLS20ms mstemaxi_w mstesmxi_w mstesmx_w mstesold_w /end LOC_MEASUREMENT
 FUNCTION_VERSION "30301.3.0" /end FUNCTION
/begin FUNCTION TERK "101.8.0   corrcection relative fuel-mass-flow because of purge flow"
 /begin DEF_CHARACTERISTIC CstrPurg_dstMinBnk1LoLoad_C CstrPurg_dstTrvlMFlowLoLd_M CstrPurg_facDilPurgAirLoLoadPCmp_M CstrPurg_facDilPurgAirLoLoad_M CstrPurg_facDynDilLoLoadBnk1_GT CstrPurg_facDynDlyBnk1LoLoad_GT CstrPurg_nEngMinDlyLoLoad_C CWDTETERK CWTERK FRKTEMN FRKTEMX SQM05TEUB /end DEF_CHARACTERISTIC
 /begin IN_MEASUREMENT CoEng_stMai CstrPurg_mFlowCpv1LoLdPurgLn Epm_nEng Epm_nEngLRes ftead_w_msg InjSys_ratFuMTot mssgin_w_msg mssgout_w_msg psr_w_msg rl_w_msg umsrln_w_msg /end IN_MEASUREMENT
 /begin OUT_MEASUREMENT B_rkteb_msg rkte_w_msg rltevol_w_msg /end OUT_MEASUREMENT
 /begin LOC_MEASUREMENT CstrPurg_dstNrmBnk1LoLoad CstrPurg_facLamRecprBnk1LoLoadIntkVlv CstrPurg_facLamRecprDlyBnk1LoLoad CstrPurg_stFuCmpTERKDeact qmsdyn rkgb_w rkg_old_w /end LOC_MEASUREMENT
 FUNCTION_VERSION "101.8.0" /end FUNCTION
/begin FUNCTION TESIGOUT "30301.1.0 output signals of purge control"
 /begin DEF_CHARACTERISTIC BPHUTEB CstrPurg_facImpsCstrLoadMax_T CstrPurg_facImpsCstrLoadMin_C CWFPCPHU FKAKORBMN FKAKORBMX FKATEIBGMN FKATEINPMN FKATEINPMX IMSTEFVMN KFTETPU KLIMSTEFV KLTEMSZ TFGWRTEFV TFKAKORFV ZKFKATEIFV ZKFTEADVA ZKFTEADVNA /end DEF_CHARACTERISTIC
 /begin IN_MEASUREMENT B_fteadber_msg B_rkteb_msg B_tei_msg B_zfra_msg B_zora_msg EngStrt_bStrtEnd EnvT_t fgwrte_msg fkakormt_w_msg fkatei_msg fteadf_msg ftead_w_msg msntetev_w_msg mstedte_w_msg PEnv_p SyC_stSub tateout_w_msg /end IN_MEASUREMENT
 /begin OUT_MEASUREMENT B_fvgte_msg B_lrar_msg /end OUT_MEASUREMENT
 /begin LOC_MEASUREMENT B_fkateifv B_fvfgwrte B_fvfkakormt B_fvftead B_imstemin coumsnte_w CstrPurg_temploc EnvTt_tumg fkateif fkateifv fkateiims FPCtl_flgReIniTESIGOUT100ms FPCtl_flgReIniTESIGOUT20ms fteadvir imstefv_w PEnv_pu phurgen /end LOC_MEASUREMENT
 FUNCTION_VERSION "30301.1.0" /end FUNCTION
/begin FUNCTION TESIGTE "30301.0.0 Calculation of FPC-signals"
 /begin DEF_CHARACTERISTIC CstrPurg_facDftEthGsl_C CstrPurg_facStoiAirFlexfu_T KTEVANMK SMK05TEUB /end DEF_CHARACTERISTIC
 /begin IN_MEASUREMENT lamsbg_w_msg ml_w_msg qtitimnh_msg rflmorgi_w_msg rlfgroh_w_msg SyC_stSub umsrln_w_msg /end IN_MEASUREMENT
 /begin OUT_MEASUREMENT ktevanst_msg lamsbgm_w_msg mksbg_msg mssgin_w_msg mssgout_w_msg qtetemin_msg /end OUT_MEASUREMENT
 /begin LOC_MEASUREMENT CstrPurg_facEthGsl CstrPurg_flgReIniTESIGTE100ms CstrPurg_flgReIniTESIGTE20ms /end LOC_MEASUREMENT
 FUNCTION_VERSION "30301.0.0" /end FUNCTION
/begin FUNCTION TESKSOL "30303.0.1 Set value calculation for specific fuel rate of purge control"
 /begin DEF_CHARACTERISTIC CstrPurg_facDeltaLam_C CstrPurg_facFilBndyValCtrl_T CstrPurg_stCpvClsFcoDly_C CstrPurg_stIniTESKSOL_C CstrPurg_tiBndyValCtrl_M CstrPurg_tiCpvClsFcoDly_C CWFPCTEN CWFTEVFTEAD CWTEINI FKAPROG FKASTINXH FKATEB FSRFKAS IMSTFTEVMN KFFGWRKA KFFKASVHE KFFKASX KFFTEVFTEADLIM KFFTEVFX KFFTEVLIM KFHTEKAH KFKASNH KFTEINI KLFTEVFTEAD KLFTEVFX KLTEINIFHO SMI04TEUW SMI08TEUW SNM04TEUB STA04TEUB TFTEINI TQTEAB TRFTEVFTEAD /end DEF_CHARACTERISTIC
 /begin REF_CHARACTERISTIC CWFPCES SMK05TEUB /end REF_CHARACTERISTIC
 /begin IN_MEASUREMENT B_fvgte_msg B_rkteb_msg B_teakt_msg B_tef_msg B_ten_msg B_vheg_msg CEngDsT_t CoEng_flgCpvClsForFco EnvT_t Epm_nEng Epm_nEngLRes fkakormx_w_msg fteadf_msg ftead_w_msg ktevanst_msg lamsbgm_w_msg lamsons_w_msg misol_w_msg mksbg_msg msntetev_w_msg mssgin_w_msg mstedte_w_msg msteo_w_msg mste_w_msg PEnv_facCorrAlti PEnv_p pndkpu_msg psr_w_msg pvv_w_msg qtetemin_msg rl_w_msg SyC_stSub tans_msg TiEngOff_bEngRot TiEngOff_stTi TiEngOff_ti /end IN_MEASUREMENT
 /begin OUT_MEASUREMENT B_resims_msg CstrPurg_flgImsteiniNV CstrPurg_flgPurgActv fgwrte_msg fkastes_w_msg fkastexm_w_msg fkaste_msg fkatefrg_w_msg fkatei_msg ftefsoll_w_msg ftevflox_w_msg imsteini_msg /end OUT_MEASUREMENT
 /begin LOC_MEASUREMENT B_resimftiv CstrPurg_flgIniTESKSOL100ms CstrPurg_flgReIniTESKSOL100ms CstrPurg_flgReIniTESKSOL20ms CstrPurg_flgTiEngOffRst CstrPurg_tiAftStrt dfkasteold_w dfkaster dfkastes_w dfkasteub EnvT_ttumg EpmnEng_nmotw fgwrteufld fkakordl fkastemax fkastemaxlim_w fkastes fkastex_w fkastold_w ftevflxm_w ftevfteadlim_w pdiff_w PEnvfacCorrAlti_fho teini tfteini_w /end LOC_MEASUREMENT
 FUNCTION_VERSION "30303.0.1" /end FUNCTION
/begin FUNCTION ThDev_Cfg "1.1.0     Provides specific configurations for ThDev" /begin DEF_CHARACTERISTIC ThDev_flgACMaiSwtCodVal_C ThDev_stACMaiSwtSig_C /end DEF_CHARACTERISTIC /begin OUT_MEASUREMENT ThDev_flgACMaiSwtCodVal ThDev_stMaiSwtACSig /end OUT_MEASUREMENT FUNCTION_VERSION "1.1.0" /end FUNCTION
/begin FUNCTION ThrVlv_Adpn "6.7.0     Adapter for new throttle valve DGS software" /begin DEF_CHARACTERISTIC ThrVlv_tiDebDblErrSuspc_C /end DEF_CHARACTERISTIC
 /begin IN_MEASUREMENT B_fhfs_msg B_wdkhfu_msg SyC_stSub ThrVlv_dRatPrVB1 ThrVlv_flgDblSensErrSuspcB1 ThrVlv_flgDesValVldB1 ThrVlv_flgDiInjB1 ThrVlv_flgIrrvFuCutOffB1 ThrVlv_flgLimpModeB1 ThrVlv_flgRegTqRednB1 ThrVlv_flgReqFuCutOffB1 ThrVlv_flgRvsbFuCutOffB1 ThrVlv_flgSngSensErrB1 ThrVlv_flgSngSensErrSuspcB1 ThrVlv_flgUBattSuffB1 ThrVlv_flgXPostDrvB1 ThrVlv_ratActPosnB1 ThrVlv_ratActPosnMaxB1 ThrVlv_ratActPosnMinB1 ThrVlv_ratLimpAirPosnB1 ThrVlv_stMonSensB1 ThrVlv_uSens1B1 wdkhf_w_msg wdks_w_msg /end IN_MEASUREMENT
 /begin OUT_MEASUREMENT AirMod_flgMaiChrgSensErr B_dknolu_msg B_dknotb_msg B_dknot_msg B_dkp1e_msg B_dkp2e_msg B_dkpiu_msg B_dkpru_msg B_dkpu_msg B_dksbeg_msg B_dveada_msg B_edks_msg B_i_ska_fr_msg B_lrnwsur_msg B_lrnws_msg B_nldve_msg B_notlu_fr_msg B_ubdve_msg B_ubpvg_msg B_ub_ok_msg B_wdksg_msg ChrCtl_flgUnthrAgMaiSens ChrCtl_rActPosMnChrgSensB1 ChrCtl_ratDesPosnThrVlvB1 dwdkba_w_msg lrnstat_msg s1fl2p11_msg ThrVlv_bDblSensErrSuspcDeb_msg ThrVlv_bSngSensErr_msg wdk1ba_w_msg wdkba_msg wdkba_w_msg wdkink_w_msg wdkma_w_msg wdkmi_w_msg wdknlp_w_msg wdkpm_w_msg wdk_w_msg /end OUT_MEASUREMENT
 FUNCTION_VERSION "6.7.0" /end FUNCTION
/begin FUNCTION ThrVlv_Mon "1.24.1    Interface to DSM"
 /begin DEF_CHARACTERISTIC ThrVlv_nThdForIrrvFuCutOffB1_C ThrVlv_stMonCfgB1_C ThrVlv_tiDebBattUDepB1_C /end DEF_CHARACTERISTIC
 /begin IN_MEASUREMENT BattU_u CoEng_stMai DSMAUX_stDsmClrActv Epm_nEng Mo_flgICOMsg SyC_stSub ThrVlv_flgDblSensErrB1 ThrVlv_flgLimpAirPosnNotReaB1 ThrVlv_flgSngSensErrB1 ThrVlv_stMonClsdPosnOffsLrnB1 ThrVlv_stMonLimpAirPosnLrnB1 ThrVlv_stMonOpenSprgChkB1 ThrVlv_stMonPosnCtrlB1 ThrVlv_stMonPsIfB1 ThrVlv_stMonRetSprgChkB1 ThrVlv_stMonSensB1 ThrVlv_stOffsLrnAbortCaseB1 /end IN_MEASUREMENT
 /begin OUT_MEASUREMENT ThrVlv_flgIrrvFuCutOffB1 ThrVlv_flgLimpModeB1 ThrVlv_flgRegTqRednB1 ThrVlv_flgReqFuCutOffB1 ThrVlv_flgRvsbFuCutOffB1 ThrVlv_flgUBattSuffB1 /end OUT_MEASUREMENT
 /begin LOC_MEASUREMENT ThrVlv_flgBattFltB1 ThrVlv_flgDKnplErrActB1 ThrVlv_flgDKnplErrOldB1 ThrVlv_flgIrrvBattFltB1 ThrVlv_flgMonDsmClearDmd_B1 ThrVlv_flgRvsbBattFltB1 ThrVlv_flgSnsrDiagPrmsB1 ThrVlv_tiDebBattUB1_CL_I.cntDebTi /end LOC_MEASUREMENT
 FUNCTION_VERSION "1.24.1" /end FUNCTION
/begin COMPU_METHOD B_TRUE "" TAB_VERB "%6.3" "" COMPU_TAB_REF B_TRUE /end COMPU_METHOD
/begin COMPU_VTAB B_TRUE "" TAB_VERB 2 0 "FALSE" 1 "TRUE" /end COMPU_VTAB
/begin COMPU_METHOD dez "" RAT_FUNC "%6.2" "" COEFFS 0 1 0 0 0 1 /end COMPU_METHOD
/begin COMPU_METHOD EngN "" RAT_FUNC "%6.3" "rpm" COEFFS 0 2 0 0 0 1 /end COMPU_METHOD
/begin COMPU_METHOD EngN_LRes "" RAT_FUNC "%6.1" "rpm" COEFFS 0 0.025 0 0 0 1 /end COMPU_METHOD
/begin COMPU_METHOD fak_q0p000488 "" RAT_FUNC "%6.5" "-" COEFFS 0 65536 0 0 0 32 /end COMPU_METHOD
/begin COMPU_METHOD fak_q0p0009766 "" RAT_FUNC "%6.5" "-" COEFFS 0 65536 0 0 0 64 /end COMPU_METHOD
/begin COMPU_METHOD fak_q0p0078 "" RAT_FUNC "%6.4" "-" COEFFS 0 128 0 0 0 1 /end COMPU_METHOD
/begin COMPU_METHOD fak_q0p5 "" RAT_FUNC "%6.3" "-" COEFFS 0 1 0 0 0 0.5 /end COMPU_METHOD
/begin COMPU_METHOD fak_sb_b1 "" RAT_FUNC "%6.4" "-" COEFFS 0 256 0 0 0 2 /end COMPU_METHOD
/begin COMPU_METHOD fak_sb_b16 "" RAT_FUNC "%6.3" "-" COEFFS 0 256 0 0 0 32 /end COMPU_METHOD
/begin COMPU_METHOD fak_sb_b2 "" RAT_FUNC "%6.4" "-" COEFFS 0 256 0 0 0 4 /end COMPU_METHOD
/begin COMPU_METHOD fak_sb_b64 "" RAT_FUNC "%6.3" "-" COEFFS 0 256 0 0 0 128 /end COMPU_METHOD
/begin COMPU_METHOD fak_sw_b1 "" RAT_FUNC "%7.6" "-" COEFFS 0 65536 0 0 0 2 /end COMPU_METHOD
/begin COMPU_METHOD fak_sw_b4 "" RAT_FUNC "%6.5" "-" COEFFS 0 65536 0 0 0 8 /end COMPU_METHOD
/begin COMPU_METHOD fak_sw_b64 "" RAT_FUNC "%6.4" "-" COEFFS 0 65536 0 0 0 128 /end COMPU_METHOD
/begin COMPU_METHOD fak_ub_b0p5 "" RAT_FUNC "%6.4" "-" COEFFS 0 256 0 0 0 0.5 /end COMPU_METHOD
/begin COMPU_METHOD fak_ub_b1 "" RAT_FUNC "%6.4" "-" COEFFS 0 256 0 0 0 1 /end COMPU_METHOD
/begin COMPU_METHOD fak_ub_b16 "" RAT_FUNC "%6.4" "-" COEFFS 0 256 0 0 0 16 /end COMPU_METHOD
/begin COMPU_METHOD fak_ub_b2 "" RAT_FUNC "%8.5" "-" COEFFS 0 256 0 0 0 2 /end COMPU_METHOD
/begin COMPU_METHOD fak_ub_b4 "" RAT_FUNC "%6.4" "-" COEFFS 0 256 0 0 0 4 /end COMPU_METHOD
/begin COMPU_METHOD fak_ub_b64 "" RAT_FUNC "%6.3" "-" COEFFS 0 256 0 0 0 64 /end COMPU_METHOD
/begin COMPU_METHOD fak_ub_b8 "" RAT_FUNC "%6.4" "-" COEFFS 0 256 0 0 0 8 /end COMPU_METHOD
/begin COMPU_METHOD fak_uw_b0p5 "" RAT_FUNC "%8.7" "-" COEFFS 0 65536 0 0 0 0.5 /end COMPU_METHOD
/begin COMPU_METHOD fak_uw_b1 "" RAT_FUNC "%7.6" "-" COEFFS 0 65536 0 0 0 1 /end COMPU_METHOD
/begin COMPU_METHOD fak_uw_b16 "" RAT_FUNC "%6.5" "-" COEFFS 0 65536 0 0 0 16 /end COMPU_METHOD
/begin COMPU_METHOD fak_uw_b2 "" RAT_FUNC "%7.6" "-" COEFFS 0 65536 0 0 0 2 /end COMPU_METHOD
/begin COMPU_METHOD fak_uw_b4 "" RAT_FUNC "%7.6" "-" COEFFS 0 65536 0 0 0 4 /end COMPU_METHOD
/begin COMPU_METHOD fak_uw_b8 "" RAT_FUNC "%6.5" "-" COEFFS 0 65536 0 0 0 8 /end COMPU_METHOD
/begin COMPU_METHOD mgrad_q0p400001 "" RAT_FUNC "%6.3" "kg/h" COEFFS 0 195312 0 0 0 78125 /end COMPU_METHOD
/begin COMPU_METHOD m_q0p002441_kg_DIV_h_s "" RAT_FUNC "%6.4" "kg/(h*s)" COEFFS 0 65536 0 0 0 160 /end COMPU_METHOD
/begin COMPU_METHOD m_ub_b25p6 "" RAT_FUNC "%6.3" "kg/h" COEFFS 0 256 0 0 0 25.6 /end COMPU_METHOD
/begin COMPU_METHOD m_ub_q0p0444 "" RAT_FUNC "%6.4" "g" COEFFS 0 1 0 0 0 0.0444 /end COMPU_METHOD
/begin COMPU_METHOD m_uw_b25p6 "" RAT_FUNC "%6.5" "kg/h" COEFFS 0 65536 0 0 0 25.6 /end COMPU_METHOD
/begin COMPU_METHOD m_uw_b6553p5 "" RAT_FUNC "%6.3" "kg/h" COEFFS 0 1 0 0 0 0.1 /end COMPU_METHOD
/begin COMPU_METHOD nmot_ub_q40 "" RAT_FUNC "%6.1" "1/min" COEFFS 0 1 0 0 0 40 /end COMPU_METHOD
/begin COMPU_METHOD nmot_uw_q0p25 "" RAT_FUNC "%6.3" "1/min" COEFFS 0 1 0 0 0 0.25 /end COMPU_METHOD
/begin COMPU_METHOD OneToOne "" RAT_FUNC "%6.2" "-" COEFFS 0 1 0 0 0 1 /end COMPU_METHOD
/begin COMPU_METHOD perio_q0p3125 "" RAT_FUNC "%6.3" "1/s" COEFFS 0 32 0 0 0 10 /end COMPU_METHOD
/begin COMPU_METHOD perio_q4p76836Em5 "" RAT_FUNC "%7.6" "1/s" COEFFS 0 256000000 0 0 0 12207 /end COMPU_METHOD
/begin COMPU_METHOD perio_ub_b0p012207 "" RAT_FUNC "%10.8" "1/s" COEFFS 0 256 0 0 0 0.012207 /end COMPU_METHOD
/begin COMPU_METHOD p_q0p0195 "" RAT_FUNC "%6.4" "hPa" COEFFS 0 256 0 0 0 5 /end COMPU_METHOD
/begin COMPU_METHOD p_sw_q0p039 "" RAT_FUNC "%6.4" "hPa" COEFFS 0 256 0 0 0 10 /end COMPU_METHOD
/begin COMPU_METHOD p_ub_q5 "" RAT_FUNC "%6.2" "hPa" COEFFS 0 1 0 0 0 5 /end COMPU_METHOD
/begin COMPU_METHOD p_uw_q0p039 "" RAT_FUNC "%6.4" "hPa" COEFFS 0 256 0 0 0 10 /end COMPU_METHOD
/begin COMPU_METHOD relDK_q0p02441 "" RAT_FUNC "%6.4" "%DK" COEFFS 0 65536 0 0 0 1600 /end COMPU_METHOD
/begin COMPU_METHOD relDK_ub_b100 "" RAT_FUNC "%6.3" "%DK" COEFFS 0 255 0 0 0 100 /end COMPU_METHOD
/begin COMPU_METHOD relDK_uw_b100 "" RAT_FUNC "%6.4" "%DK" COEFFS 0 65535 0 0 0 100 /end COMPU_METHOD
/begin COMPU_METHOD rel_q0p00153 "" RAT_FUNC "%6.4" "%" COEFFS 0 65536 0 0 0 100 /end COMPU_METHOD
/begin COMPU_METHOD rel_q0p0078125 "" RAT_FUNC "%6.4" "%" COEFFS 0 128 0 0 0 1 /end COMPU_METHOD
/begin COMPU_METHOD rel_q0p0234 "" RAT_FUNC "%6.4" "%" COEFFS 0 128 0 0 0 3 /end COMPU_METHOD
/begin COMPU_METHOD rel_sw_b100 "" RAT_FUNC "%6.4" "%" COEFFS 0 32768 0 0 0 100 /end COMPU_METHOD
/begin COMPU_METHOD rel_sw_q0p0468 "" RAT_FUNC "%6.4" "%" COEFFS 0 65536 0 0 0 3072 /end COMPU_METHOD
/begin COMPU_METHOD rel_ub_b99p6 "" RAT_FUNC "%6.3" "%" COEFFS 0 256 0 0 0 100 /end COMPU_METHOD
/begin COMPU_METHOD rel_uw_b100 "" RAT_FUNC "%6.4" "%" COEFFS 0 65536 0 0 0 100 /end COMPU_METHOD
/begin COMPU_METHOD rel_uw_b200 "" RAT_FUNC "%6.4" "%" COEFFS 0 65536 0 0 0 200 /end COMPU_METHOD
/begin COMPU_METHOD rel_uw_b3072 "" RAT_FUNC "%6.4" "%" COEFFS 0 65536 0 0 0 3072 /end COMPU_METHOD
/begin COMPU_METHOD rel_uw_q0p0234 "" RAT_FUNC "%6.4" "%" COEFFS 0 32 0 0 0 0.75 /end COMPU_METHOD
/begin COMPU_METHOD SigQly_COMPU_VERB "" TAB_VERB "%6.3" "" COMPU_TAB_REF SigQly_COMPU_VERB /end COMPU_METHOD
/begin COMPU_VTAB SigQly_COMPU_VERB "" TAB_VERB 16 0 "SIGQLY_NOTCALC" 1 "SIGQLY_INIT" 2 "SIGQLY_OK" 3 "SIGQLY_MODEL" 4 "SIGQLY_REPLACEMENT" 5 "SIGQLY_FROZEN" 6 "SIGQLY_INVALID" 7 "SIGQLY_RESERVED_7" 8 "SIGQLY_RESERVED_8" 9 "SIGQLY_RESERVED_9" 10 "SIGQLY_RESERVED_10" 11 "SIGQLY_RESERVED_11" 12 "SIGQLY_RESERVED_12" 13 "SIGQLY_RESERVED_13" 14 "SIGQLY_RESERVED_14" 15 "SIGQLY_RESERVED_15" /end COMPU_VTAB
/begin COMPU_METHOD spg_q0p1 "" RAT_FUNC "%6.3" "V" COEFFS 0 1 0 0 0 0.1 /end COMPU_METHOD
/begin COMPU_METHOD t10msxs_ub_b2p55 "" RAT_FUNC "%6.4" "s" COEFFS 0 1 0 0 0 0.01 /end COMPU_METHOD
/begin COMPU_METHOD t20msxs_uw_b1310 "" RAT_FUNC "%6.4" "s" COEFFS 0 1 0 0 0 0.02 /end COMPU_METHOD
/begin COMPU_METHOD t500usxms_ub_q0p5 "" RAT_FUNC "%6.3" "ms" COEFFS 0 1 0 0 0 0.5 /end COMPU_METHOD
/begin COMPU_METHOD Temp_Cels "" RAT_FUNC "%6.1" "deg C" COEFFS 0 10 2731.4 0 0 1 /end COMPU_METHOD
/begin COMPU_METHOD temp_q0p0234_o273 "" RAT_FUNC "%6.1" "Grad C" COEFFS 0 1 273.15 0 0 0.0234375 /end COMPU_METHOD
/begin COMPU_METHOD temp_q0p75 "" RAT_FUNC "%6.3" "GradC" COEFFS 0 4 0 0 0 3 /end COMPU_METHOD
/begin COMPU_METHOD temp_ub_q0p75_o48 "" RAT_FUNC "%6.2" "Grad C" COEFFS 0 1 48 0 0 0.75 /end COMPU_METHOD
/begin COMPU_METHOD THERMCOORNENGTQRESVENA_SC_Compu "" TAB_VERB "%6.3" "" COMPU_TAB_REF THERMCOORNENGTQRESVENA_SC_Compu /end COMPU_METHOD
/begin COMPU_VTAB THERMCOORNENGTQRESVENA_SC_Compu "" TAB_VERB 2 0 "False" 1 "True" /end COMPU_VTAB
/begin COMPU_METHOD ThmCnd "" RAT_FUNC "%6.5" "W/m/K" COEFFS 0 1000 0 0 0 1 /end COMPU_METHOD
/begin COMPU_METHOD THROVRHEATGPROTN_SC_Compu "" TAB_VERB "%6.3" "" COMPU_TAB_REF THROVRHEATGPROTN_SC_Compu /end COMPU_METHOD
/begin COMPU_VTAB THROVRHEATGPROTN_SC_Compu "" TAB_VERB 2 0 "False" 1 "True" /end COMPU_VTAB
/begin COMPU_METHOD THRVLVAIRACTR_SC_Compu "" TAB_VERB "%6.3" "" COMPU_TAB_REF THRVLVAIRACTR_SC_Compu /end COMPU_METHOD
/begin COMPU_VTAB THRVLVAIRACTR_SC_Compu "" TAB_VERB 2 0 "False" 1 "True" /end COMPU_VTAB
/begin COMPU_METHOD THRVLVCONTMN_SC_Compu "" TAB_VERB "%6.3" "" COMPU_TAB_REF THRVLVCONTMN_SC_Compu /end COMPU_METHOD
/begin COMPU_VTAB THRVLVCONTMN_SC_Compu "" TAB_VERB 2 0 "False" 1 "True" /end COMPU_VTAB
/begin COMPU_METHOD THRVLVI_TYPAVL_SC_Compu "" TAB_VERB "%6.3" "" COMPU_TAB_REF THRVLVI_TYPAVL_SC_Compu /end COMPU_METHOD
/begin COMPU_VTAB THRVLVI_TYPAVL_SC_Compu "" TAB_VERB 2 0 "False" 1 "True" /end COMPU_VTAB
/begin COMPU_METHOD THRVLVLP_AIRACTR_SC_Compu "" TAB_VERB "%6.3" "" COMPU_TAB_REF THRVLVLP_AIRACTR_SC_Compu /end COMPU_METHOD
/begin COMPU_VTAB THRVLVLP_AIRACTR_SC_Compu "" TAB_VERB 2 0 "0" 1 "1" /end COMPU_VTAB
/begin COMPU_METHOD THRVLVLP_ATSENA_SC_Compu "" TAB_VERB "%6.3" "" COMPU_TAB_REF THRVLVLP_ATSENA_SC_Compu /end COMPU_METHOD
/begin COMPU_VTAB THRVLVLP_ATSENA_SC_Compu "" TAB_VERB 2 0 "0" 1 "1" /end COMPU_VTAB
/begin COMPU_METHOD THRVLVPROD_SY_Compu "" TAB_VERB "%6.3" "" COMPU_TAB_REF THRVLVPROD_SY_Compu /end COMPU_METHOD
/begin COMPU_VTAB THRVLVPROD_SY_Compu "" TAB_VERB 2 0 "RBTHRVLV" 1 "VISTTHRVLV" /end COMPU_VTAB
/begin COMPU_METHOD THRVLVSNGSNSR_SC_Compu "" TAB_VERB "%6.3" "" COMPU_TAB_REF THRVLVSNGSNSR_SC_Compu /end COMPU_METHOD
/begin COMPU_VTAB THRVLVSNGSNSR_SC_Compu "" TAB_VERB 2 0 "0" 1 "1" /end COMPU_VTAB
/begin COMPU_METHOD THRVLVUST_TYPAVL_SC_Compu "" TAB_VERB "%6.3" "" COMPU_TAB_REF THRVLVUST_TYPAVL_SC_Compu /end COMPU_METHOD
/begin COMPU_VTAB THRVLVUST_TYPAVL_SC_Compu "" TAB_VERB 2 0 "False" 1 "True" /end COMPU_VTAB
/begin COMPU_METHOD THRVLV_AGLIMDAMON_SC_Compu "" TAB_VERB "%6.3" "" COMPU_TAB_REF THRVLV_AGLIMDAMON_SC_Compu /end COMPU_METHOD
/begin COMPU_VTAB THRVLV_AGLIMDAMON_SC_Compu "" TAB_VERB 2 0 "False" 1 "True" /end COMPU_VTAB
/begin COMPU_METHOD THRVLV_ATSENA_SC_Compu "" TAB_VERB "%6.3" "" COMPU_TAB_REF THRVLV_ATSENA_SC_Compu /end COMPU_METHOD
/begin COMPU_VTAB THRVLV_ATSENA_SC_Compu "" TAB_VERB 2 0 "False" 1 "True" /end COMPU_VTAB
/begin COMPU_METHOD THRVLV_BLDCMOT_SC_Compu "" TAB_VERB "%6.3" "" COMPU_TAB_REF THRVLV_BLDCMOT_SC_Compu /end COMPU_METHOD
/begin COMPU_VTAB THRVLV_BLDCMOT_SC_Compu "" TAB_VERB 2 0 "inactive" 1 "active" /end COMPU_VTAB
/begin COMPU_METHOD THRVLV_CLNVRFY_SY_Compu "" TAB_VERB "%6.3" "" COMPU_TAB_REF THRVLV_CLNVRFY_SY_Compu /end COMPU_METHOD
/begin COMPU_VTAB THRVLV_CLNVRFY_SY_Compu "" TAB_VERB 2 0 "False" 1 "True" /end COMPU_VTAB
/begin COMPU_METHOD THRVLV_DCMOT_SC_Compu "" TAB_VERB "%6.3" "" COMPU_TAB_REF THRVLV_DCMOT_SC_Compu /end COMPU_METHOD
/begin COMPU_VTAB THRVLV_DCMOT_SC_Compu "" TAB_VERB 2 0 "inactive" 1 "active" /end COMPU_VTAB
/begin COMPU_METHOD THRVLV_DEDIA_SC_Compu "" TAB_VERB "%6.3" "" COMPU_TAB_REF THRVLV_DEDIA_SC_Compu /end COMPU_METHOD
/begin COMPU_VTAB THRVLV_DEDIA_SC_Compu "" TAB_VERB 2 0 "False" 1 "True" /end COMPU_VTAB
/begin COMPU_METHOD THRVLV_ENAHBRDGSPLYCHK_SC_Compu "" TAB_VERB "%6.3" "" COMPU_TAB_REF THRVLV_ENAHBRDGSPLYCHK_SC_Compu /end COMPU_METHOD
/begin COMPU_VTAB THRVLV_ENAHBRDGSPLYCHK_SC_Compu "" TAB_VERB 2 0 "Disable" 1 "Enable" /end COMPU_VTAB
/begin COMPU_METHOD THRVLV_ENASENTFBSEPSIGLINE_SC_Compu "" TAB_VERB "%6.3" "" COMPU_TAB_REF THRVLV_ENASENTFBSEPSIGLINE_SC_Compu /end COMPU_METHOD
/begin COMPU_VTAB THRVLV_ENASENTFBSEPSIGLINE_SC_Compu "" TAB_VERB 2 0 "False" 1 "True" /end COMPU_VTAB
/begin COMPU_METHOD THRVLV_ENGSPDACTRSPENA_SC_Compu "" TAB_VERB "%6.3" "" COMPU_TAB_REF THRVLV_ENGSPDACTRSPENA_SC_Compu /end COMPU_METHOD
/begin COMPU_VTAB THRVLV_ENGSPDACTRSPENA_SC_Compu "" TAB_VERB 2 0 "False" 1 "True" /end COMPU_VTAB
/begin COMPU_METHOD THRVLV_ENHDICERMVMOD_SC_Compu "" TAB_VERB "%6.3" "" COMPU_TAB_REF THRVLV_ENHDICERMVMOD_SC_Compu /end COMPU_METHOD
/begin COMPU_VTAB THRVLV_ENHDICERMVMOD_SC_Compu "" TAB_VERB 5 0 "Disable" 1 "PRE_DRV" 2 "T15_ON_STRT_INJ_SUPP" 3 "T15_ON_INJ_SUPP" 4 "T15_ON_STRT_INJ_RELD" /end COMPU_VTAB
/begin COMPU_METHOD THRVLV_ICECHKATENGRUN_SC_Compu "" TAB_VERB "%6.3" "" COMPU_TAB_REF THRVLV_ICECHKATENGRUN_SC_Compu /end COMPU_METHOD
/begin COMPU_VTAB THRVLV_ICECHKATENGRUN_SC_Compu "" TAB_VERB 2 0 "False" 1 "True" /end COMPU_VTAB
/begin COMPU_METHOD THRVLV_IOSIGHALFBRDG_SC_Compu "" TAB_VERB "%6.3" "" COMPU_TAB_REF THRVLV_IOSIGHALFBRDG_SC_Compu /end COMPU_METHOD
/begin COMPU_VTAB THRVLV_IOSIGHALFBRDG_SC_Compu "" TAB_VERB 2 0 "False" 1 "True" /end COMPU_VTAB
/begin COMPU_METHOD THRVLV_LIMPAIRPOSNFCTENA_SC_Compu "" TAB_VERB "%6.3" "" COMPU_TAB_REF THRVLV_LIMPAIRPOSNFCTENA_SC_Compu /end COMPU_METHOD
/begin COMPU_VTAB THRVLV_LIMPAIRPOSNFCTENA_SC_Compu "" TAB_VERB 2 0 "False" 1 "True" /end COMPU_VTAB
/begin COMPU_METHOD THRVLV_OPENPOSNLRN_SC_Compu "" TAB_VERB "%6.3" "" COMPU_TAB_REF THRVLV_OPENPOSNLRN_SC_Compu /end COMPU_METHOD
/begin COMPU_VTAB THRVLV_OPENPOSNLRN_SC_Compu "" TAB_VERB 2 0 "False" 1 "True" /end COMPU_VTAB
/begin COMPU_METHOD THRVLV_PARLCHRGCTRL_SC_Compu "" TAB_VERB "%6.3" "" COMPU_TAB_REF THRVLV_PARLCHRGCTRL_SC_Compu /end COMPU_METHOD
/begin COMPU_VTAB THRVLV_PARLCHRGCTRL_SC_Compu "" TAB_VERB 2 0 "False" 1 "True" /end COMPU_VTAB
/begin COMPU_METHOD THRVLV_PHYSRNGCHK_SY_Compu "" TAB_VERB "%6.3" "" COMPU_TAB_REF THRVLV_PHYSRNGCHK_SY_Compu /end COMPU_METHOD
/begin COMPU_VTAB THRVLV_PHYSRNGCHK_SY_Compu "" TAB_VERB 2 0 "False" 1 "True" /end COMPU_VTAB
/begin COMPU_METHOD THRVLV_SENTENA_SC_Compu "" TAB_VERB "%6.3" "" COMPU_TAB_REF THRVLV_SENTENA_SC_Compu /end COMPU_METHOD
/begin COMPU_VTAB THRVLV_SENTENA_SC_Compu "" TAB_VERB 2 0 "False" 1 "True" /end COMPU_VTAB
/begin COMPU_METHOD THRVLV_SNSRDRIFTCMP_SC_Compu "" TAB_VERB "%6.3" "" COMPU_TAB_REF THRVLV_SNSRDRIFTCMP_SC_Compu /end COMPU_METHOD
/begin COMPU_VTAB THRVLV_SNSRDRIFTCMP_SC_Compu "" TAB_VERB 2 0 "DISABLED" 1 "ENABLED" /end COMPU_VTAB
/begin COMPU_METHOD THRVLV_SNSRSPLYB2_SC_Compu "" TAB_VERB "%6.3" "" COMPU_TAB_REF THRVLV_SNSRSPLYB2_SC_Compu /end COMPU_METHOD
/begin COMPU_VTAB THRVLV_SNSRSPLYB2_SC_Compu "" TAB_VERB 9 0 "Powersupply diagnosis deactivated" 1 "Throttle sensors connected to powerstage1" 2 "Throttle sensors connected to powerstage2" 3 "Throttle sensors connected to powerstage3" 4 "Throttle sensors connected to powerstage 4" 5 "Throttle sensors connected to powerstage 5" 6 "Throttle sensors connected to powerstage 6" 7 "Throttle sensors connected to powerstage 7" 8 "Throttle sensors connected to powerstage 8" /end COMPU_VTAB
/begin COMPU_METHOD THRVLV_SNSRSPLY_SC_Compu "" TAB_VERB "%6.3" "" COMPU_TAB_REF THRVLV_SNSRSPLY_SC_Compu /end COMPU_METHOD
/begin COMPU_VTAB THRVLV_SNSRSPLY_SC_Compu "" TAB_VERB 9 0 "Powersupply diagnosis deactivated" 1 "Throttle sensors connected to powerstage1" 2 "Throttle sensors connected to powerstage2" 3 "Throttle sensors connected to powerstage3" 4 "Throttle sensors connected to powerstage 4" 5 "Throttle sensors connected to powerstage 5" 6 "Throttle sensors connected to powerstage 6" 7 "Throttle sensors connected to powerstage 7" 8 "Throttle sensors connected to powerstage 8" /end COMPU_VTAB
/begin COMPU_METHOD THRVLV_TWNDESVAL_SC_Compu "" TAB_VERB "%6.3" "" COMPU_TAB_REF THRVLV_TWNDESVAL_SC_Compu /end COMPU_METHOD
/begin COMPU_VTAB THRVLV_TWNDESVAL_SC_Compu "" TAB_VERB 2 0 "False" 1 "True" /end COMPU_VTAB
/begin COMPU_METHOD THRVLV_TYPTWINFLW_SY_Compu "" TAB_VERB "%6.3" "" COMPU_TAB_REF THRVLV_TYPTWINFLW_SY_Compu /end COMPU_METHOD
/begin COMPU_VTAB THRVLV_TYPTWINFLW_SY_Compu "" TAB_VERB 2 0 "0" 1 "1" /end COMPU_VTAB
/begin COMPU_METHOD THS_GBXVLVDIAG_SC_Compu "" TAB_VERB "%6.3" "" COMPU_TAB_REF THS_GBXVLVDIAG_SC_Compu /end COMPU_METHOD
/begin COMPU_VTAB THS_GBXVLVDIAG_SC_Compu "" TAB_VERB 2 0 "False" 1 "True" /end COMPU_VTAB
/begin COMPU_METHOD THS_VAR_SY_Compu "" TAB_VERB "%6.3" "" COMPU_TAB_REF THS_VAR_SY_Compu /end COMPU_METHOD
/begin COMPU_VTAB THS_VAR_SY_Compu "" TAB_VERB 45 1 "DAI" 3 "VWW" 4 "POR" 5 "AUD" 6 "OPE" 9 "FIA" 11 "BMW" 14 "PSA" 15 "REN" 17 "ALF" 18 "SAB" 19 "VOL" 20 "NIS" 21 "GMU" 22 "FOR" 26 "IMJ" 51 "SEA" 53 "CHR" 54 "JAG" 55 "ROL" 69 "FER" 72 "TOY" 123 "MIT" 147 "HYU" 159 "HON" 160 "MAZ" 183 "CU" 190 "LRG" 204 "VVW" 214 "AVT" 242 "Iveco" 243 "DMC" 248 "SUZ" 267 "SSANGYONG" 270 "KEF" 289 "AMG" 308 "TAT" 319 "MVM" 328 "MM" 385 "UAES" 590 "Scania" 760 "WEICHAI" 828 "RBCD" 999 "ALL" 9454 "Fuso" /end COMPU_VTAB
/begin COMPU_METHOD TIBASDCMB_SC_Compu "" TAB_VERB "%6.3" "" COMPU_TAB_REF TIBASDCMB_SC_Compu /end COMPU_METHOD
/begin COMPU_VTAB TIBASDCMB_SC_Compu "" TAB_VERB 2 0 "False" 1 "True" /end COMPU_VTAB
/begin COMPU_METHOD Time100HrsEngOn "" RAT_FUNC "%6.2" "[100h]" COEFFS 0 1 0 0 0 1 /end COMPU_METHOD
/begin COMPU_METHOD Time100_us "" RAT_FUNC "%6.0" "us" COEFFS 0 0.01 0 0 0 1 /end COMPU_METHOD
/begin COMPU_METHOD TimeDeb "" RAT_FUNC "%6.1" "ms" COEFFS 0 0.1 0 0 0 1 /end COMPU_METHOD
/begin COMPU_METHOD TimeDelay_s_2 "" RAT_FUNC "%13.6" "s" COEFFS 0 0 1 0 0.0596046447753906 0 /end COMPU_METHOD
/begin COMPU_METHOD TimeEngOnOBD "" RAT_FUNC "%6.2" "min" COEFFS 0 1 0 0 0 1 /end COMPU_METHOD
/begin COMPU_METHOD TimeGPTATick "" RAT_FUNC "%6.4" "ns" COEFFS 0 20 0 0 0 1 /end COMPU_METHOD
/begin COMPU_METHOD TimeHrsEngOn "" RAT_FUNC "%6.0" "[100h]" COEFFS 0 0.01 0 0 0 1 /end COMPU_METHOD
/begin COMPU_METHOD TimeRed_OvrNght "" RAT_FUNC "%6.2" "s" COEFFS 0 0.390625 0 0 0 1 /end COMPU_METHOD
/begin COMPU_METHOD Time_1s "" RAT_FUNC "%6.2" "s" COEFFS 0 1 0 0 0 1 /end COMPU_METHOD
/begin COMPU_METHOD Time_Dt "" RAT_FUNC "%9.8" "s" COEFFS 0 1000000 0 0 0 1 /end COMPU_METHOD
/begin COMPU_METHOD Time_Dt_ms "" RAT_FUNC "%6.5" "" COEFFS 0 1000 0 0 0 1 /end COMPU_METHOD
/begin COMPU_METHOD Time_ms "" RAT_FUNC "%6.1" "ms" COEFFS 0 0.1 0 0 0 1 /end COMPU_METHOD
/begin COMPU_METHOD Time_ms2us "" RAT_FUNC "%6.5" "ms" COEFFS 0 1000 0 0 0 1 /end COMPU_METHOD
/begin COMPU_METHOD Time_ms_q0p01_COMPU "" RAT_FUNC "%6.4" "ms" COEFFS 0 100 0 0 0 1 /end COMPU_METHOD
/begin COMPU_METHOD Time_s_Ext "" RAT_FUNC "%6.3" "" COEFFS 0 10 0 0 0 1 /end COMPU_METHOD
/begin COMPU_METHOD Time_s_LoRes "" RAT_FUNC "%6.2" "s" COEFFS 0 1 0 0 0 1 /end COMPU_METHOD
/begin COMPU_METHOD Time_WLvlPWM "" RAT_FUNC "%6.4" "ms" COEFFS 0 20 0 0 0 1 /end COMPU_METHOD
/begin COMPU_METHOD TINTKVLVDSDYN_SC_Compu "" TAB_VERB "%6.3" "" COMPU_TAB_REF TINTKVLVDSDYN_SC_Compu /end COMPU_METHOD
/begin COMPU_VTAB TINTKVLVDSDYN_SC_Compu "" TAB_VERB 2 0 "False" 1 "True" /end COMPU_VTAB
/begin COMPU_METHOD TINTKVUS_TYPAVL_SY_Compu "" TAB_VERB "%6.3" "" COMPU_TAB_REF TINTKVUS_TYPAVL_SY_Compu /end COMPU_METHOD
/begin COMPU_VTAB TINTKVUS_TYPAVL_SY_Compu "" TAB_VERB 2 0 "False" 1 "True" /end COMPU_VTAB
/begin COMPU_METHOD TIOFF_DIAGENA_SC_Compu "" TAB_VERB "%6.3" "" COMPU_TAB_REF TIOFF_DIAGENA_SC_Compu /end COMPU_METHOD
/begin COMPU_VTAB TIOFF_DIAGENA_SC_Compu "" TAB_VERB 2 0 "False" 1 "True" /end COMPU_VTAB
/begin COMPU_METHOD TIOFF_VDMDLCLKENA_SC_Compu "" TAB_VERB "%6.3" "" COMPU_TAB_REF TIOFF_VDMDLCLKENA_SC_Compu /end COMPU_METHOD
/begin COMPU_VTAB TIOFF_VDMDLCLKENA_SC_Compu "" TAB_VERB 2 0 "False" 1 "True" /end COMPU_VTAB
/begin COMPU_METHOD TIOFF_VDTICMBOFFENA_SC_Compu "" TAB_VERB "%6.3" "" COMPU_TAB_REF TIOFF_VDTICMBOFFENA_SC_Compu /end COMPU_METHOD
/begin COMPU_VTAB TIOFF_VDTICMBOFFENA_SC_Compu "" TAB_VERB 2 0 "False" 1 "True" /end COMPU_VTAB
/begin COMPU_METHOD TIOFF_VDTIENGOFFENA_SC_Compu "" TAB_VERB "%6.3" "" COMPU_TAB_REF TIOFF_VDTIENGOFFENA_SC_Compu /end COMPU_METHOD
/begin COMPU_VTAB TIOFF_VDTIENGOFFENA_SC_Compu "" TAB_VERB 2 0 "False" 1 "True" /end COMPU_VTAB
/begin COMPU_METHOD TIOFF_VDTIPRPSYSACTVOFFENA_SC_Compu "" TAB_VERB "%6.3" "" COMPU_TAB_REF TIOFF_VDTIPRPSYSACTVOFFENA_SC_Compu /end COMPU_METHOD
/begin COMPU_VTAB TIOFF_VDTIPRPSYSACTVOFFENA_SC_Compu "" TAB_VERB 2 0 "False" 1 "True" /end COMPU_VTAB
/begin COMPU_METHOD TIPIN_SY_Compu "" TAB_VERB "%6.3" "" COMPU_TAB_REF TIPIN_SY_Compu /end COMPU_METHOD
/begin COMPU_VTAB TIPIN_SY_Compu "" TAB_VERB 2 0 "0" 1 "1" /end COMPU_VTAB
/begin COMPU_METHOD TLE7209_SY_Compu "" TAB_VERB "%6.3" "" COMPU_TAB_REF TLE7209_SY_Compu /end COMPU_METHOD
/begin COMPU_VTAB TLE7209_SY_Compu "" TAB_VERB 3 0 "no TLE7209" 1 "one TLE7209" 2 "two TLE7209" /end COMPU_VTAB
/begin COMPU_METHOD TLE7244_SC_Compu "" TAB_VERB "%6.3" "" COMPU_TAB_REF TLE7244_SC_Compu /end COMPU_METHOD
/begin COMPU_VTAB TLE7244_SC_Compu "" TAB_VERB 3 0 "No_TLE7244" 1 "One_TLE7244" 2 "Two_TLE7244" /end COMPU_VTAB
/begin COMPU_METHOD TLE75602_SC_Compu "" TAB_VERB "%6.3" "" COMPU_TAB_REF TLE75602_SC_Compu /end COMPU_METHOD
/begin COMPU_VTAB TLE75602_SC_Compu "" TAB_VERB 4 0 "no Tle75602" 1 "one Tle75602" 2 "two Tle75602" 3 "three Tle75602" /end COMPU_VTAB
/begin COMPU_METHOD TMEOBDACTV_SC_Compu "" TAB_VERB "%6.3" "" COMPU_TAB_REF TMEOBDACTV_SC_Compu /end COMPU_METHOD
/begin COMPU_VTAB TMEOBDACTV_SC_Compu "" TAB_VERB 2 0 "False" 1 "True" /end COMPU_VTAB
/begin COMPU_METHOD TME_CCOFADEOUT_SC_Compu "" TAB_VERB "%6.3" "" COMPU_TAB_REF TME_CCOFADEOUT_SC_Compu /end COMPU_METHOD
/begin COMPU_VTAB TME_CCOFADEOUT_SC_Compu "" TAB_VERB 2 0 "False" 1 "True" /end COMPU_VTAB
/begin COMPU_METHOD TME_CHRGAIRVLVSWT_SC_Compu "" TAB_VERB "%6.3" "" COMPU_TAB_REF TME_CHRGAIRVLVSWT_SC_Compu /end COMPU_METHOD
/begin COMPU_VTAB TME_CHRGAIRVLVSWT_SC_Compu "" TAB_VERB 2 0 "False" 1 "True" /end COMPU_VTAB
/begin COMPU_METHOD TME_CHRGEXCHLOSSMDLSELN_SC_Compu "" TAB_VERB "%6.3" "" COMPU_TAB_REF TME_CHRGEXCHLOSSMDLSELN_SC_Compu /end COMPU_METHOD
/begin COMPU_VTAB TME_CHRGEXCHLOSSMDLSELN_SC_Compu "" TAB_VERB 3 0 "0" 1 "1" 2 "2" /end COMPU_VTAB
/begin COMPU_METHOD TME_CHRGEXCHLOSSPOSNSELN_SC_Compu "" TAB_VERB "%6.3" "" COMPU_TAB_REF TME_CHRGEXCHLOSSPOSNSELN_SC_Compu /end COMPU_METHOD
/begin COMPU_VTAB TME_CHRGEXCHLOSSPOSNSELN_SC_Compu "" TAB_VERB 2 0 "not_combined" 1 "combined" /end COMPU_VTAB
/begin COMPU_METHOD TME_CYLBNKSPCIAACTEFF_SC_Compu "" TAB_VERB "%6.3" "" COMPU_TAB_REF TME_CYLBNKSPCIAACTEFF_SC_Compu /end COMPU_METHOD
/begin COMPU_VTAB TME_CYLBNKSPCIAACTEFF_SC_Compu "" TAB_VERB 2 0 "Deactivated" 1 "Activated" /end COMPU_VTAB
/begin COMPU_METHOD TME_CYLSPCAIRSYSIF_SC_Compu "" TAB_VERB "%6.3" "" COMPU_TAB_REF TME_CYLSPCAIRSYSIF_SC_Compu /end COMPU_METHOD
/begin COMPU_VTAB TME_CYLSPCAIRSYSIF_SC_Compu "" TAB_VERB 2 0 "DISABLED" 1 "ENABLED" /end COMPU_VTAB
/begin COMPU_METHOD TME_CYLSPCIGNIF_SC_Compu "" TAB_VERB "%6.3" "" COMPU_TAB_REF TME_CYLSPCIGNIF_SC_Compu /end COMPU_METHOD
/begin COMPU_VTAB TME_CYLSPCIGNIF_SC_Compu "" TAB_VERB 2 0 "DISABLED" 1 "ENABLED" /end COMPU_VTAB
/begin COMPU_METHOD TME_CYLSPCTQMDLIF_SC_Compu "" TAB_VERB "%6.3" "" COMPU_TAB_REF TME_CYLSPCTQMDLIF_SC_Compu /end COMPU_METHOD
/begin COMPU_VTAB TME_CYLSPCTQMDLIF_SC_Compu "" TAB_VERB 2 0 "DISABLED" 1 "ENABLED" /end COMPU_VTAB
/begin COMPU_METHOD TME_DRGTQMDLSELN_SC_Compu "" TAB_VERB "%6.3" "" COMPU_TAB_REF TME_DRGTQMDLSELN_SC_Compu /end COMPU_METHOD
/begin COMPU_VTAB TME_DRGTQMDLSELN_SC_Compu "" TAB_VERB 2 0 "Conventional model" 1 "Engine load dependent model" /end COMPU_VTAB
/begin COMPU_METHOD TME_FAKETAIA_SC_Compu "" TAB_VERB "%6.3" "" COMPU_TAB_REF TME_FAKETAIA_SC_Compu /end COMPU_METHOD
/begin COMPU_VTAB TME_FAKETAIA_SC_Compu "" TAB_VERB 7 0 "none" 1 "common curve, load" 2 "sep. curves, load" 3 "sep. curves + 2nd fuel, load" 4 "common map, load and speed" 5 "sep. maps, load and speed" 6 "sep. maps + 2nd fuel, load and speed" /end COMPU_VTAB
/begin COMPU_METHOD TME_STATYLTEIAEFFCALCN_SC_Compu "" TAB_VERB "%6.3" "" COMPU_TAB_REF TME_STATYLTEIAEFFCALCN_SC_Compu /end COMPU_METHOD
/begin COMPU_VTAB TME_STATYLTEIAEFFCALCN_SC_Compu "" TAB_VERB 2 0 "False" 1 "True" /end COMPU_VTAB
/begin COMPU_METHOD TME_TCORRETA_SC_Compu "" TAB_VERB "%6.3" "" COMPU_TAB_REF TME_TCORRETA_SC_Compu /end COMPU_METHOD
/begin COMPU_VTAB TME_TCORRETA_SC_Compu "" TAB_VERB 2 0 "False" 1 "True" /end COMPU_VTAB
/begin COMPU_METHOD TME_TQINNRMAXGBX_SC_Compu "" RAT_FUNC "%6.2" "" COEFFS 0 1 0 0 0 1 /end COMPU_METHOD
/begin COMPU_METHOD TME_TQMINACCRPEDL_SC_Compu "" TAB_VERB "%6.3" "" COMPU_TAB_REF TME_TQMINACCRPEDL_SC_Compu /end COMPU_METHOD
/begin COMPU_VTAB TME_TQMINACCRPEDL_SC_Compu "" TAB_VERB 2 0 "Disabled" 1 "Enabled" /end COMPU_VTAB
/begin COMPU_METHOD TME_VAR_SY_Compu "" TAB_VERB "%6.3" "" COMPU_TAB_REF TME_VAR_SY_Compu /end COMPU_METHOD
/begin COMPU_VTAB TME_VAR_SY_Compu "" TAB_VERB 45 1 "DAI" 3 "VWW" 4 "POR" 5 "AUD" 6 "OPE" 9 "FIA" 11 "BMW" 14 "PSA" 15 "REN" 17 "ALF" 18 "SAB" 19 "VOL" 20 "NIS" 21 "GMU" 22 "FOR" 26 "IMJ" 51 "SEA" 53 "CHR" 54 "JAG" 55 "ROL" 69 "FER" 72 "TOY" 123 "MIT" 147 "HYU" 159 "HON" 160 "MAZ" 183 "CU" 190 "LRG" 204 "VVW" 214 "AVT" 242 "Iveco" 243 "DMC" 248 "SUZ" 267 "SSANGYONG" 270 "KEF" 289 "AMG" 308 "TAT" 319 "MVM" 328 "MM" 385 "UAES" 590 "Scania" 828 "RBCD" 999 "ALL" 2887 "Nonox" 9454 "Fuso" /end COMPU_VTAB
/begin COMPU_METHOD Trq "" RAT_FUNC "%6.3" "Nm" COEFFS 0 10 0 0 0 1 /end COMPU_METHOD
/begin COMPU_METHOD t_q0p01_ms "" RAT_FUNC "%6.4" "ms" COEFFS 0 1 0 0 0 0.01 /end COMPU_METHOD
/begin COMPU_METHOD t_q0p02 "" RAT_FUNC "%6.4" "s" COEFFS 0 100 0 0 0 2 /end COMPU_METHOD
/begin COMPU_METHOD t_q0p1 "" RAT_FUNC "%6.3" "s" COEFFS 0 10 0 0 0 1 /end COMPU_METHOD
/begin COMPU_METHOD t_q0p32000082 "" RAT_FUNC "%6.3" "s" COEFFS 0 48828 0 0 0 15625 /end COMPU_METHOD
/begin COMPU_METHOD t_q1 "" RAT_FUNC "%6.2" "s" COEFFS 0 1 0 0 0 1 /end COMPU_METHOD
/begin COMPU_METHOD t_q4_s "" RAT_FUNC "%6.2" "s" COEFFS 0 1 0 0 0 4 /end COMPU_METHOD
/begin COMPU_METHOD t_q5p96046Em8_min "" RAT_FUNC "%10.9" "min" COEFFS 0 16777216 0 0 0 1 /end COMPU_METHOD
/begin COMPU_METHOD Vel "" RAT_FUNC "%6.4" "km/h" COEFFS 0 100 0 0 0 1 /end COMPU_METHOD
/begin COMPU_METHOD Volt_Batt "" RAT_FUNC "%6.1" "mV" COEFFS 0 0.05 0 0 0 1 /end COMPU_METHOD
/begin COMPU_METHOD zk100msxs_ub_b25p6 "" RAT_FUNC "%6.3" "s" COEFFS 0 0 256 0 10 0 /end COMPU_METHOD
/begin COMPU_METHOD zk100msxs_uw_b6553p6 "" RAT_FUNC "%6.1" "s" COEFFS 0 0 65536 0 10 0 /end COMPU_METHOD
/begin COMPU_METHOD zk20msxs_uw_b1310p72 "" RAT_FUNC "%6.1" "s" COEFFS 0 0 65536 0 50 0 /end COMPU_METHOD
/begin RECORD_LAYOUT RB_Axis_U16 NO_AXIS_PTS_X 1 UWORD AXIS_PTS_X 2 UWORD INDEX_INCR DIRECT /end RECORD_LAYOUT
/begin RECORD_LAYOUT RB_Axis_U8 NO_AXIS_PTS_X 1 UBYTE AXIS_PTS_X 2 UBYTE INDEX_INCR DIRECT /end RECORD_LAYOUT
/begin RECORD_LAYOUT RB_CurveGroup_U16 FNC_VALUES 1 UWORD COLUMN_DIR DIRECT /end RECORD_LAYOUT
/begin RECORD_LAYOUT RB_CurveGroup_U8 FNC_VALUES 1 UBYTE COLUMN_DIR DIRECT /end RECORD_LAYOUT
/begin RECORD_LAYOUT RB_Curve_S16_S16 NO_AXIS_PTS_X 1 SWORD AXIS_PTS_X 2 SWORD INDEX_INCR DIRECT FNC_VALUES 3 SWORD COLUMN_DIR DIRECT /end RECORD_LAYOUT
/begin RECORD_LAYOUT RB_Curve_S16_U16_Static NO_AXIS_PTS_X 1 SWORD AXIS_PTS_X 2 SWORD INDEX_INCR DIRECT FNC_VALUES 3 UWORD COLUMN_DIR DIRECT STATIC_RECORD_LAYOUT /end RECORD_LAYOUT
/begin RECORD_LAYOUT RB_Curve_S8_U8_Static NO_AXIS_PTS_X 1 SBYTE AXIS_PTS_X 2 SBYTE INDEX_INCR DIRECT FNC_VALUES 3 UBYTE COLUMN_DIR DIRECT STATIC_RECORD_LAYOUT /end RECORD_LAYOUT
/begin RECORD_LAYOUT RB_Curve_U16_S16_Static NO_AXIS_PTS_X 1 UWORD AXIS_PTS_X 2 UWORD INDEX_INCR DIRECT FNC_VALUES 3 SWORD COLUMN_DIR DIRECT STATIC_RECORD_LAYOUT /end RECORD_LAYOUT
/begin RECORD_LAYOUT RB_Curve_U16_U16 NO_AXIS_PTS_X 1 UWORD AXIS_PTS_X 2 UWORD INDEX_INCR DIRECT FNC_VALUES 3 UWORD COLUMN_DIR DIRECT /end RECORD_LAYOUT
/begin RECORD_LAYOUT RB_Curve_U16_U8_Static NO_AXIS_PTS_X 1 UWORD AXIS_PTS_X 2 UWORD INDEX_INCR DIRECT FNC_VALUES 3 UBYTE COLUMN_DIR DIRECT STATIC_RECORD_LAYOUT /end RECORD_LAYOUT
/begin RECORD_LAYOUT RB_Curve_U8_U16_Static NO_AXIS_PTS_X 1 UBYTE AXIS_PTS_X 2 UBYTE INDEX_INCR DIRECT FNC_VALUES 3 UWORD COLUMN_DIR DIRECT STATIC_RECORD_LAYOUT /end RECORD_LAYOUT
/begin RECORD_LAYOUT RB_Curve_U8_U8 NO_AXIS_PTS_X 1 UBYTE AXIS_PTS_X 2 UBYTE INDEX_INCR DIRECT FNC_VALUES 3 UBYTE COLUMN_DIR DIRECT /end RECORD_LAYOUT
/begin RECORD_LAYOUT RB_MapGroup_U8 FNC_VALUES 1 UBYTE COLUMN_DIR DIRECT /end RECORD_LAYOUT
/begin RECORD_LAYOUT RB_Map_S16S16_S16 NO_AXIS_PTS_X 1 SWORD NO_AXIS_PTS_Y 2 SWORD AXIS_PTS_X 3 SWORD INDEX_INCR DIRECT AXIS_PTS_Y 4 SWORD INDEX_INCR DIRECT FNC_VALUES 5 SWORD COLUMN_DIR DIRECT /end RECORD_LAYOUT
/begin RECORD_LAYOUT RB_Map_S16U16_S16 NO_AXIS_PTS_X 1 SWORD NO_AXIS_PTS_Y 2 SWORD AXIS_PTS_X 3 SWORD INDEX_INCR DIRECT AXIS_PTS_Y 4 UWORD INDEX_INCR DIRECT FNC_VALUES 5 SWORD ROW_DIR DIRECT /end RECORD_LAYOUT
/begin RECORD_LAYOUT RB_Map_S16U16_U16 NO_AXIS_PTS_X 1 SWORD NO_AXIS_PTS_Y 2 SWORD AXIS_PTS_X 3 SWORD INDEX_INCR DIRECT AXIS_PTS_Y 4 UWORD INDEX_INCR DIRECT FNC_VALUES 5 UWORD ROW_DIR DIRECT /end RECORD_LAYOUT
/begin RECORD_LAYOUT RB_Map_S16U16_U8 NO_AXIS_PTS_X 1 SWORD NO_AXIS_PTS_Y 2 SWORD AXIS_PTS_X 3 SWORD INDEX_INCR DIRECT AXIS_PTS_Y 4 UWORD INDEX_INCR DIRECT FNC_VALUES 5 UBYTE ROW_DIR DIRECT /end RECORD_LAYOUT
/begin RECORD_LAYOUT RB_Map_S16U8_U16 NO_AXIS_PTS_X 1 SWORD NO_AXIS_PTS_Y 2 SWORD AXIS_PTS_X 3 SWORD INDEX_INCR DIRECT AXIS_PTS_Y 4 UBYTE INDEX_INCR DIRECT FNC_VALUES 5 UWORD COLUMN_DIR DIRECT /end RECORD_LAYOUT
/begin RECORD_LAYOUT RB_Map_U16S16_S16 NO_AXIS_PTS_X 1 UWORD NO_AXIS_PTS_Y 2 UWORD AXIS_PTS_X 3 UWORD INDEX_INCR DIRECT AXIS_PTS_Y 4 SWORD INDEX_INCR DIRECT FNC_VALUES 5 SWORD COLUMN_DIR DIRECT /end RECORD_LAYOUT
/begin RECORD_LAYOUT RB_Map_U16S16_U16 NO_AXIS_PTS_X 1 UWORD NO_AXIS_PTS_Y 2 UWORD AXIS_PTS_X 3 UWORD INDEX_INCR DIRECT AXIS_PTS_Y 4 SWORD INDEX_INCR DIRECT FNC_VALUES 5 UWORD COLUMN_DIR DIRECT /end RECORD_LAYOUT
/begin RECORD_LAYOUT RB_Map_U16U16_U16 NO_AXIS_PTS_X 1 UWORD NO_AXIS_PTS_Y 2 UWORD AXIS_PTS_X 3 UWORD INDEX_INCR DIRECT AXIS_PTS_Y 4 UWORD INDEX_INCR DIRECT FNC_VALUES 5 UWORD COLUMN_DIR DIRECT /end RECORD_LAYOUT
/begin RECORD_LAYOUT RB_Map_U16U8_U16 NO_AXIS_PTS_X 1 UWORD NO_AXIS_PTS_Y 2 UWORD AXIS_PTS_X 3 UWORD INDEX_INCR DIRECT AXIS_PTS_Y 4 UBYTE INDEX_INCR DIRECT FNC_VALUES 5 UWORD COLUMN_DIR DIRECT /end RECORD_LAYOUT
/begin RECORD_LAYOUT RB_Map_U16U8_U8 NO_AXIS_PTS_X 1 UWORD NO_AXIS_PTS_Y 2 UWORD AXIS_PTS_X 3 UWORD INDEX_INCR DIRECT AXIS_PTS_Y 4 UBYTE INDEX_INCR DIRECT FNC_VALUES 5 UBYTE COLUMN_DIR DIRECT /end RECORD_LAYOUT
/begin RECORD_LAYOUT RB_Map_U8U16_U16 NO_AXIS_PTS_X 1 UBYTE NO_AXIS_PTS_Y 2 UBYTE AXIS_PTS_X 3 UBYTE INDEX_INCR DIRECT AXIS_PTS_Y 4 UWORD INDEX_INCR DIRECT FNC_VALUES 5 UWORD ROW_DIR DIRECT /end RECORD_LAYOUT
/begin RECORD_LAYOUT RB_Map_U8U16_U8 NO_AXIS_PTS_X 1 UBYTE NO_AXIS_PTS_Y 2 UBYTE AXIS_PTS_X 3 UBYTE INDEX_INCR DIRECT AXIS_PTS_Y 4 UWORD INDEX_INCR DIRECT FNC_VALUES 5 UBYTE ROW_DIR DIRECT /end RECORD_LAYOUT
/begin RECORD_LAYOUT RB_Map_U8U8_U8 NO_AXIS_PTS_X 1 UBYTE NO_AXIS_PTS_Y 2 UBYTE AXIS_PTS_X 3 UBYTE INDEX_INCR DIRECT AXIS_PTS_Y 4 UBYTE INDEX_INCR DIRECT FNC_VALUES 5 UBYTE COLUMN_DIR DIRECT /end RECORD_LAYOUT
/begin RECORD_LAYOUT RB_Val_Wboolean FNC_VALUES 1 UBYTE COLUMN_DIR DIRECT /end RECORD_LAYOUT
/begin RECORD_LAYOUT RB_Val_Ws16 FNC_VALUES 1 SWORD COLUMN_DIR DIRECT /end RECORD_LAYOUT
/begin RECORD_LAYOUT RB_Val_Ws8 FNC_VALUES 1 SBYTE COLUMN_DIR DIRECT /end RECORD_LAYOUT
/begin RECORD_LAYOUT RB_Val_Wu16 FNC_VALUES 1 UWORD COLUMN_DIR DIRECT /end RECORD_LAYOUT
/begin RECORD_LAYOUT RB_Val_Wu32 FNC_VALUES 1 ULONG COLUMN_DIR DIRECT /end RECORD_LAYOUT
/begin RECORD_LAYOUT RB_Val_Wu8 FNC_VALUES 1 UBYTE COLUMN_DIR DIRECT /end RECORD_LAYOUT
/begin RECORD_LAYOUT Val_Ws16 FNC_VALUES 1 SWORD COLUMN_DIR DIRECT /end RECORD_LAYOUT
/begin RECORD_LAYOUT Val_Ws32 FNC_VALUES 1 SLONG COLUMN_DIR DIRECT /end RECORD_LAYOUT
/begin RECORD_LAYOUT Val_Wu16 FNC_VALUES 1 UWORD COLUMN_DIR DIRECT /end RECORD_LAYOUT
/begin RECORD_LAYOUT Val_Wu8 FNC_VALUES 1 UBYTE COLUMN_DIR DIRECT /end RECORD_LAYOUT
/end MODULE
/end PROJECT
