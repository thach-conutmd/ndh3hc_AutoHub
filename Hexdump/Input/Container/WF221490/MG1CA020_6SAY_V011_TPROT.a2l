ASAP2_VERSION 1 60
/begin PROJECT MG1CA020 "MG1CA020"
/begin HEADER "" VERSION "MG1CA020_6SAY_V011_TPROT" PROJECT_NO MG1CA020 /end HEADER
/begin MODULE DIM ""
/begin MOD_COMMON "" BYTE_ORDER MSB_LAST ALIGNMENT_BYTE 1 ALIGNMENT_WORD 2 ALIGNMENT_LONG 4 ALIGNMENT_INT64 4 ALIGNMENT_FLOAT32_IEEE 4 ALIGNMENT_FLOAT64_IEEE 4 DATA_SIZE 32 /end MOD_COMMON
/begin CHARACTERISTIC UEGO_dUHtrRmp_C "increase gradient of the heater voltage during ramp phase in open-loop-control" VALUE 0x80537B68 RB_Val_Wu16 327.6750 RBPtCel_du_0p005_1 0.00 327.6750 FORMAT "%8.4" /end CHARACTERISTIC
/begin CHARACTERISTIC UEGO_facdeltaURampErr_C "correction factor of gradient of heater voltage in ramp phase at open load error" VALUE 0x80537B6A RB_Val_Wu8 3.984 fak_ub_b4 0.00 3.984 FORMAT "%5.3" /end CHARACTERISTIC
/begin CHARACTERISTIC UEGO_facEgyRHeatr_C "factor to estimate the heater resistor" VALUE 0x80537F6C RB_Val_Wu16 0.1249981 q1p907Em6_Ohm_DIV_J 0.00 0.1249981 FORMAT "%9.7" /end CHARACTERISTIC
/begin CHARACTERISTIC UEGO_facGovKD_C "control amplification heater control D-part" VALUE 0x80537B6C RB_Val_Wu16 54.61250 fak_uw_q0p00083 0.00 54.61250 FORMAT "%8.5" /end CHARACTERISTIC
/begin CHARACTERISTIC UEGO_facGovKI_C "control amplification heater control I-part" VALUE 0x80537B6E RB_Val_Wu16 54.61250 fak_uw_q0p00083 0.00 54.61250 FORMAT "%8.5" /end CHARACTERISTIC
/begin CHARACTERISTIC UEGO_facGovKP_C "control amplification heater control P-part" VALUE 0x80537B70 RB_Val_Wu16 54.61250 fak_uw_q0p00083 0.00 54.61250 FORMAT "%8.5" /end CHARACTERISTIC
/begin CHARACTERISTIC UEGO_facPCorrLean_CUR "lean pressure correction curve" CURVE 0x80537C54 RB_Curve_U16_U16 1.999969 fak_uw_b2 0.00 1.999969 FORMAT "%8.6"
 /begin AXIS_DESCR STD_AXIS NO_INPUT_QUANTITY p_q0p078 12 0.00 5119.922 FORMAT "%8.3" DEPOSIT ABSOLUTE /end AXIS_DESCR
/end CHARACTERISTIC
/begin CHARACTERISTIC UEGO_facPCorrRich_CUR "rich pressure correction curve" CURVE 0x80537C86 RB_Curve_U16_U16 1.999969 fak_uw_b2 0.00 1.999969 FORMAT "%8.6"
 /begin AXIS_DESCR STD_AXIS NO_INPUT_QUANTITY p_q0p078 12 0.00 5119.922 FORMAT "%8.3" DEPOSIT ABSOLUTE /end AXIS_DESCR
/end CHARACTERISTIC
/begin CHARACTERISTIC UEGO_facTCorr_CUR "temperature correction curve" CURVE 0x80537CB8 RB_Curve_S16_U16_Static 1.999969 fak_uw_b2 0.00 1.999969 FORMAT "%8.6"
 /begin AXIS_DESCR STD_AXIS NO_INPUT_QUANTITY temp_q0p0234 11 -768.0000 767.9766 FORMAT "%8.4" DEPOSIT ABSOLUTE /end AXIS_DESCR
/end CHARACTERISTIC
/begin CHARACTERISTIC UEGO_facTiCrvErr_C "correction factor for maximum time for curve phase at open load error" VALUE 0x80537B72 RB_Val_Wu8 3.984 fak_ub_b4 0.00 3.984 FORMAT "%5.3" /end CHARACTERISTIC
/begin CHARACTERISTIC UEGO_facTiHldErr_C "correction factor for maximum time for hold phase at open load error" VALUE 0x80537B73 RB_Val_Wu8 3.984 fak_ub_b4 0.00 3.984 FORMAT "%5.3" /end CHARACTERISTIC
/begin CHARACTERISTIC UEGO_facUCrvErr_C "correction factor for heater voltage for curve phase at open load error" VALUE 0x80537B74 RB_Val_Wu8 3.984 fak_ub_b4 0.00 3.984 FORMAT "%5.3" /end CHARACTERISTIC
/begin CHARACTERISTIC UEGO_facUHldErr_C "correction factor for heater voltage for hold phase at open load error" VALUE 0x80537B75 RB_Val_Wu8 3.984 fak_ub_b4 0.00 3.984 FORMAT "%5.3" /end CHARACTERISTIC
/begin CHARACTERISTIC UEGO_facURampErr_C "correction factor for heater voltage for ramp phase at open load error" VALUE 0x80537B76 RB_Val_Wu8 3.984 fak_ub_b4 0.00 3.984 FORMAT "%5.3" /end CHARACTERISTIC
/begin CHARACTERISTIC UEGO_HeatrCtrlDiagClassS1B1.UEGO_tiDlyAllVlvActv_C "Class heater power diagnosis sensor 1 bank 1 / Time delay on overrun until start diagnosis duration is increased" VALUE 0x80537BF8 RB_Val_Wu16 6553.500 t_q0p1 0.00 6553.500 FORMAT "%8.3" /end CHARACTERISTIC
/begin CHARACTERISTIC UEGO_HeatrCtrlDiagClassS1B1.UEGO_tiHeatrOff_C "Class heater power diagnosis sensor 1 bank 1 / Heater off time threshold for releasing the start diagnosis healing check" VALUE 0x80537BFC RB_Val_Wu32 429496729.500 t_q0p1 0.00 429496729.500 FORMAT "%13.3" /end CHARACTERISTIC
/begin CHARACTERISTIC UEGO_HeatrCtrlDiagClassS1B1.stHeatrCtrlDiag_C "Class heater power diagnosis sensor 1 bank 1 / Codeword diagnosis heater power" VALUE 0x80537C00 RB_Val_Wu8 255.0 OneToOne 0.00 255.0 FORMAT "%5.1" /end CHARACTERISTIC
/begin CHARACTERISTIC UEGO_HeatrCtrlDiagClassS1B1.tCerMin_C "Class heater power diagnosis sensor 1 bank 1 / Minimum temperature of sensor ceramic for low diagnosis" VALUE 0x80537C02 RB_Val_Wu16 1535.977 temp_q0p0234_o273 -273.150 1262.827 FORMAT "%8.3" /end CHARACTERISTIC
/begin CHARACTERISTIC UEGO_HeatrCtrlDiagClassS1B1.tCerOpMin_C "Class heater power diagnosis sensor 1 bank 1 / Minimum operational sensor ceramic temperature for start and permanent diagnosis" VALUE 0x80537C04 RB_Val_Wu16 1535.977 temp_q0p0234_o273 -273.150 1262.827 FORMAT "%8.3" /end CHARACTERISTIC
/begin CHARACTERISTIC UEGO_HeatrCtrlDiagClassS1B1.tEgSysLoDiag_C "Class heater power diagnosis sensor 1 bank 1 / Temperatur exhaust gas for low diagnosis release" VALUE 0x80537C06 RB_Val_Ws16 6553.500 Temp_Cels -3549.940 3003.560 FORMAT "%8.3" /end CHARACTERISTIC
/begin CHARACTERISTIC UEGO_HeatrCtrlDiagClassS1B1.tEgSysPrmntDiag_C "Class heater power diagnosis sensor 1 bank 1 / Temperatur exhaust gas for permanent diagnosis release" VALUE 0x80537C08 RB_Val_Ws16 6553.500 Temp_Cels -3549.940 3003.560 FORMAT "%8.3" /end CHARACTERISTIC
/begin CHARACTERISTIC UEGO_HeatrCtrlDiagClassS1B1.tWallHealFctDemTstr_C "Class heater power diagnosis sensor 1 bank 1 / Temperature pipe wall modelled for healing heater power error from service tester" VALUE 0x80537C0A RB_Val_Ws16 6553.500 Temp_Cels -3549.940 3003.560 FORMAT "%8.3" /end CHARACTERISTIC
/begin CHARACTERISTIC UEGO_HeatrCtrlDiagClassS1B1.tWallHeal_C "Class heater power diagnosis sensor 1 bank 1 / Temperature pipe wall modelled for healing heater power error" VALUE 0x80537C0C RB_Val_Ws16 6553.500 Temp_Cels -3549.940 3003.560 FORMAT "%8.3" /end CHARACTERISTIC
/begin CHARACTERISTIC UEGO_HeatrCtrlDiagClassS1B1.tWallMdl_C "Class heater power diagnosis sensor 1 bank 1 / Temperature pipe wall modelled for releasing the healing of start diagnosis" VALUE 0x80537C0E RB_Val_Ws16 6553.500 Temp_Cels -3549.940 3003.560 FORMAT "%8.3" /end CHARACTERISTIC
/begin CHARACTERISTIC UEGO_HeatrCtrlDiagClassS1B1.tiDlyFlgOvrRunTOFFV_C "Class heater power diagnosis sensor 1 bank 1 / Turn-off-delay-time overrun" VALUE 0x80537C10 RB_Val_Wu16 6553.500 t_q0p1 0.00 6553.500 FORMAT "%8.3" /end CHARACTERISTIC
/begin CHARACTERISTIC UEGO_HeatrCtrlDiagClassS1B1.tiDlyFlgOvrRunTONV_C "Class heater power diagnosis sensor 1 bank 1 / Turn-on-delay-time overrun" VALUE 0x80537C12 RB_Val_Wu16 6553.500 t_q0p1 0.00 6553.500 FORMAT "%8.3" /end CHARACTERISTIC
/begin CHARACTERISTIC UEGO_HeatrCtrlDiagClassS1B1.tiDlyHealPasHeatgFctDemTstr_C "Class heater power diagnosis sensor 1 bank 1 / Debounce time for delay healing at high pipe wall temperatures at service tester demand" VALUE 0x80537C14 RB_Val_Wu16 6553.500 t_q0p1 0.00 6553.500 FORMAT "%8.3" /end CHARACTERISTIC
/begin CHARACTERISTIC UEGO_HeatrCtrlDiagClassS1B1.tiDlyHealPasHeatg_C "Class heater power diagnosis sensor 1 bank 1 / Debounce time for delay healing at high pipe wall temperatures" VALUE 0x80537C16 RB_Val_Wu16 6553.500 t_q0p1 0.00 6553.500 FORMAT "%8.3" /end CHARACTERISTIC
/begin CHARACTERISTIC UEGO_HeatrCtrlDiagClassS1B1.tiFuCutOffDlyLoDiag_C "Class heater power diagnosis sensor 1 bank 1 / Delay time after fuel cut off until release low diagnosis" VALUE 0x80537C18 RB_Val_Wu16 6553.500 t_q0p1 0.00 6553.500 FORMAT "%8.3" /end CHARACTERISTIC
/begin CHARACTERISTIC UEGO_HeatrCtrlDiagClassS1B1.tiHeatgCtrlActvDly_C "Class heater power diagnosis sensor 1 bank 1 / Delay time until release permanent diagnosis" VALUE 0x80537C1A RB_Val_Wu16 6553.500 t_q0p1 0.00 6553.500 FORMAT "%8.3" /end CHARACTERISTIC
/begin CHARACTERISTIC UEGO_HeatrCtrlDiagClassS1B1.tiLoDiagDly_C "Class heater power diagnosis sensor 1 bank 1 / Delay time after sensor readiness" VALUE 0x80537C1C RB_Val_Wu16 6553.500 t_q0p1 0.00 6553.500 FORMAT "%8.3" /end CHARACTERISTIC
/begin CHARACTERISTIC UEGO_HeatrCtrlDiagClassS1B1.tiLoDiagErrDly_C "Class heater power diagnosis sensor 1 bank 1 / Delay time for low temperatur errors" VALUE 0x80537C1E RB_Val_Wu16 6553.500 t_q0p1 0.00 6553.500 FORMAT "%8.3" /end CHARACTERISTIC
/begin CHARACTERISTIC UEGO_HeatrCtrlDiagClassS1B1.tiPrmntDiagDurn_C "Class heater power diagnosis sensor 1 bank 1 / Duration time until permanent diagnosis is complete" VALUE 0x80537C20 RB_Val_Wu16 6553.400 t_q0p1 0.100 6553.500 FORMAT "%8.3" EXTENDED_LIMITS 0.00 6553.500 /end CHARACTERISTIC
/begin CHARACTERISTIC UEGO_HeatrCtrlDiagClassS1B1.tiPrmntDiagHealDly_C "Class heater power diagnosis sensor 1 bank 1 / Delay time after sensor has reached temperatur" VALUE 0x80537C22 RB_Val_Wu16 6553.500 t_q0p1 0.00 6553.500 FORMAT "%8.3" /end CHARACTERISTIC
/begin CHARACTERISTIC UEGO_HeatrCtrlDiagClassS1B1.tiStrtDiagDurnCalcd_T "Class heater power diagnosis sensor 1 bank 1 / Factor to Duration of Start Diagnosis calculated depending on battery voltage" CURVE 0x80537C24 RB_Curve_U8_U16_Static 6553.500 t_q0p1 0.00 6553.500 FORMAT "%8.3"
 /begin AXIS_DESCR STD_AXIS NO_INPUT_QUANTITY fak_ub_b2 5 0.00 1.992188 FORMAT "%8.6" DEPOSIT ABSOLUTE /end AXIS_DESCR
/end CHARACTERISTIC
/begin CHARACTERISTIC UEGO_HeatrCtrlDiagClassS1B1.tiWrgSysCdnDurn_C "Class heater power diagnosis sensor 1 bank 1 / Delay time until locking start diagnosis in case of bad environment conditions" VALUE 0x80537C34 RB_Val_Wu16 6553.500 t_q0p1 0.00 6553.500 FORMAT "%8.3" /end CHARACTERISTIC
/begin CHARACTERISTIC UEGO_HeatrCtrlDiagClassS1B1.uHeatgCtrlEfcPrmntDiagThd_C "Class heater power diagnosis sensor 1 bank 1 / Minimum necessary voltage threshold in order to find a permanent diagnosis error" VALUE 0x80537C36 RB_Val_Wu16 327.6750 spg_q0p005 0.00 327.6750 FORMAT "%8.4" /end CHARACTERISTIC
/begin CHARACTERISTIC UEGO_HtrCtlS1B1_I.stHeatrCtrl_C "heater control sensor 1 bank 1 / Status word for the heater controller" VALUE 0x80537BA4 RB_Val_Wu8 255.0 dez 0.00 255.0 FORMAT "%5.1" /end CHARACTERISTIC
/begin CHARACTERISTIC UEGO_HtrCtlS1B1_I.uHeatrCrv_T "heater control sensor 1 bank 1 / heater voltage of open loop control during curve phase" CURVE 0x80537BA6 RB_Curve_U16_U16 327.6750 spg_q0p005 0.00 327.6750 FORMAT "%8.4"
 /begin AXIS_DESCR STD_AXIS NO_INPUT_QUANTITY t_q0p02 10 0.00 1310.700 FORMAT "%8.3" DEPOSIT ABSOLUTE /end AXIS_DESCR
/end CHARACTERISTIC
/begin CHARACTERISTIC UEGO_HtrCtlS1B1_I.uHeatrHoldRmpStrt_T "heater control sensor 1 bank 1 / heater voltage at hold phase, so start value of ramp phase" CURVE 0x80537BD0 RB_Curve_S16_U16_Static 327.6750 spg_q0p005 0.00 327.6750 FORMAT "%8.4"
 /begin AXIS_DESCR STD_AXIS NO_INPUT_QUANTITY temp_q0p1_o273 5 -3549.940 3003.560 FORMAT "%8.3" DEPOSIT ABSOLUTE /end AXIS_DESCR
/end CHARACTERISTIC
/begin CHARACTERISTIC UEGO_idxTypS1B1_C "sensor type sensor 1 bank 1" VALUE 0x80537F6B RB_Val_Wu8 255.0 dez 0.00 255.0 FORMAT "%5.1" /end CHARACTERISTIC
/begin CHARACTERISTIC UEGO_IntfrCorrn_CUR "" CURVE 0x80537CF8 RB_Curve_U16_U8_Static 1.992188 fak_ub_b2 0.00 1.992188 FORMAT "%8.6"
 /begin AXIS_DESCR STD_AXIS NO_INPUT_QUANTITY fak_uw_b16 5 0.00 15.99976 FORMAT "%8.5" DEPOSIT ABSOLUTE /end AXIS_DESCR
/end CHARACTERISTIC
/begin CHARACTERISTIC UEGO_nrTstPls_C "Number of test pulse in on driving cycle" VALUE 0x80537C48 RB_Val_Wu32 4294967295.00 OneToOne 0.00 4294967295.00 FORMAT "%13.2" /end CHARACTERISTIC
/begin CHARACTERISTIC UEGO_ratHeatrPSCtrlErrMax_C "Maximum duty cycle for LSU Heater at power stage error" VALUE 0x80537C38 RB_Val_Wu16 199.9969 rel_q0p003052 0.00 199.9969 FORMAT "%8.4" /end CHARACTERISTIC
/begin CHARACTERISTIC UEGO_ratHeatrPSCtrlMax_C "Maximum duty cycle for LSU-Heater" VALUE 0x80537C40 RB_Val_Wu16 199.9969 rel_q0p003052 0.00 199.9969 FORMAT "%8.4" /end CHARACTERISTIC
/begin CHARACTERISTIC UEGO_ratHeatrPSDiagMin_C "Minimum dutycycle diagnosis powerstage LSU heater" VALUE 0x80537C44 RB_Val_Wu16 199.9969 rel_q0p003052 0.00 199.9969 FORMAT "%8.4" /end CHARACTERISTIC
/begin CHARACTERISTIC UEGO_rHeatrAmbT_C "Resistance with which the heater resistance is initialized" VALUE 0x80537F6E RB_Val_Wu16 63.99902 r_q9p765625Em4_Ohm 0.00 63.99902 FORMAT "%8.5" /end CHARACTERISTIC
/begin CHARACTERISTIC UEGO_rHeatrMax_C "maximum heater resistor" VALUE 0x80537F70 RB_Val_Wu16 63.99902 r_q9p765625Em4_Ohm 0.00 63.99902 FORMAT "%8.5" /end CHARACTERISTIC
/begin CHARACTERISTIC UEGO_rHeatrMin_C "minimum heater resistor" VALUE 0x80537F72 RB_Val_Wu16 63.99902 r_q9p765625Em4_Ohm 0.00 63.99902 FORMAT "%8.5" /end CHARACTERISTIC
/begin CHARACTERISTIC UEGO_rIntfrCorrnHomMod_MAP "MAP cross sensitivity correction in Lambda for Homogeneous operation mode" MAP 0x80537D82 RB_Map_U8U16_S16 15.99976 fak_sw_b8 -8.000000 7.999756 FORMAT "%8.6"
 /begin AXIS_DESCR STD_AXIS Epm_nEngLRes nmot_q40 10 0.00 10200. FORMAT "%5.0" DEPOSIT ABSOLUTE /end AXIS_DESCR
 /begin AXIS_DESCR STD_AXIS rl_w_msg rel_uw_q0p0234 10 0.00 1535.977 FORMAT "%8.3" DEPOSIT ABSOLUTE /end AXIS_DESCR
/end CHARACTERISTIC
/begin CHARACTERISTIC UEGO_rIntfrCorrnVHEMod_MAP "MAP cross sensitivity correction in Lambda with SY_VHE0" MAP 0x80537E6A RB_Map_U8U16_S16 15.99976 fak_sw_b8 -8.000000 7.999756 FORMAT "%8.6"
 /begin AXIS_DESCR STD_AXIS Epm_nEngLRes nmot_q40 10 0.00 10200. FORMAT "%5.0" DEPOSIT ABSOLUTE /end AXIS_DESCR
 /begin AXIS_DESCR STD_AXIS rl_w_msg rel_uw_q0p0234 10 0.00 1535.977 FORMAT "%8.3" DEPOSIT ABSOLUTE /end AXIS_DESCR
/end CHARACTERISTIC
/begin CHARACTERISTIC UEGO_rIp2LamRecprBasFu_CUR "Curve pump current Ip to reciprocal lambda" CURVE 0x80537D0A RB_Curve_S16_U16_Static 15.99976 fak_uw_b16 0.00 15.99976 FORMAT "%8.5"
 /begin AXIS_DESCR STD_AXIS NO_INPUT_QUANTITY i_q6p6667Em7_A 25 -0.02184533 0.02184467 FORMAT "%10.8" DEPOSIT ABSOLUTE /end AXIS_DESCR
/end CHARACTERISTIC
/begin CHARACTERISTIC UEGO_rLossHeatrPS_C "resistor wirering of the heater" VALUE 0x80537F74 RB_Val_Wu16 63.99902 r_q9p765625Em4_Ohm 0.00 63.99902 FORMAT "%8.5" /end CHARACTERISTIC
/begin CHARACTERISTIC UEGO_stFastLiOffHeatg_C "Switch for Fast Ligth off (FLO)" VALUE 0x80537F6A RB_Val_Wu8 1.00000000000 B_TRUE 0.00 1.00000000000 FORMAT "%13.11" /end CHARACTERISTIC
/begin CHARACTERISTIC UEGO_stHeatrPSCtrl_C "Codeword for UEGO_HtrPSCtl" VALUE 0x80537C3A RB_Val_Wu8 255.0 dez 0.00 255.0 FORMAT "%5.1" /end CHARACTERISTIC
/begin CHARACTERISTIC UEGO_stHeatrPSDiagDeactvn_C "Code word Deactivation Release of LSU Heater Circuit." VALUE 0x80537C46 RB_Val_Wu16 65535.00 OneToOne 0.00 65535.00 FORMAT "%8.2" /end CHARACTERISTIC
/begin CHARACTERISTIC UEGO_stHeatrPsDiag_C "Codeword Diagnosis Powerstage Heater LSU" VALUE 0x80537C4C RB_Val_Wu8 255.0 dez 0.00 255.0 FORMAT "%5.1" /end CHARACTERISTIC
/begin CHARACTERISTIC UEGO_stIpPhysCor_C "Code word function UEGO_IpPhysCor" VALUE 0x80537CEE RB_Val_Wu8 255.0 dez 0.00 255.0 FORMAT "%5.1" /end CHARACTERISTIC
/begin CHARACTERISTIC UEGO_stLamCalc_C "code word for UEGO_LamCalc" VALUE 0x80537F52 RB_Val_Wu8 255.0 dez 0.00 255.0 FORMAT "%5.1" /end CHARACTERISTIC
/begin CHARACTERISTIC UEGO_stLamRdyGSIf_C "level of signal quality for sensor readiness bit B_sbblsu" VALUE 0x80537F53 RB_Val_Wu8 255.0 dez 0.00 255.0 FORMAT "%5.1" /end CHARACTERISTIC
/begin CHARACTERISTIC UEGO_stLamRelsBitMask_C "bit mask for general lambda release" VALUE 0x80537D70 RB_Val_Wu8 255.0 dez 0.00 255.0 FORMAT "%5.1" /end CHARACTERISTIC
/begin CHARACTERISTIC UEGO_stO2PhyRelsBitMask_C "bit mask for physical O2 release" VALUE 0x80537CE6 RB_Val_Wu8 255.0 OneToOne 0.00 255.0 FORMAT "%5.1" /end CHARACTERISTIC
/begin CHARACTERISTIC UEGO_stOperRelsCdnMask_C "Condtion for sensor readiness for operation release" VALUE 0x80537F54 RB_Val_Wu16 65535.00 OneToOne 0.00 65535.00 FORMAT "%8.2" /end CHARACTERISTIC
/begin CHARACTERISTIC UEGO_stRstOperRelsMask_C "Bit mask to reset sensor operation release in case of MSA or during engine restart." VALUE 0x80537F56 RB_Val_Wu8 255.0 OneToOne 0.00 255.0 FORMAT "%5.1" /end CHARACTERISTIC
/begin CHARACTERISTIC UEGO_tCerLamInvld_C "Threshold for the invalid temperature ceramic" VALUE 0x80537D72 RB_Val_Wu16 1535.977 temp_q0p0234_o273 -273.150 1262.827 FORMAT "%8.3" /end CHARACTERISTIC
/begin CHARACTERISTIC UEGO_tCerSetPt_C "temperature set point for heater control" VALUE 0x80537B96 RB_Val_Wu16 1535.977 temp_q0p0234_o273 -273.150 1262.827 FORMAT "%8.3" /end CHARACTERISTIC
/begin CHARACTERISTIC UEGO_tDeRstElecPwrHi_C "deviation of temperature set point to reset increased heater power demand" VALUE 0x80537B78 RB_Val_Ws16 1535.977 temp_q0p0234 -768.0000 767.9766 FORMAT "%8.4" /end CHARACTERISTIC
/begin CHARACTERISTIC UEGO_tDeSetElecPwrHi_C "deviation of temperature set point to set increased heater power demand" VALUE 0x80537B7A RB_Val_Ws16 1535.977 temp_q0p0234 -768.0000 767.9766 FORMAT "%8.4" /end CHARACTERISTIC
/begin CHARACTERISTIC UEGO_tEngStrt_C "Temperature engine for release start diagnosis" VALUE 0x80537BE8 RB_Val_Ws16 6553.500 Temp_Cels -3549.940 3003.560 FORMAT "%8.3" /end CHARACTERISTIC
/begin CHARACTERISTIC UEGO_tHeatrCrvMax_C "temperature threshold for end of curve phase of closed loop heater control" VALUE 0x80537B7C RB_Val_Wu16 1535.977 temp_q0p0234_o273 -273.150 1262.827 FORMAT "%8.3" /end CHARACTERISTIC
/begin CHARACTERISTIC UEGO_tHtrCtlCLEna_C "temperature threshold for release of closed loop heater control" VALUE 0x80537B7E RB_Val_Wu16 1535.977 temp_q0p0234_o273 -273.150 1262.827 FORMAT "%8.3" /end CHARACTERISTIC
/begin CHARACTERISTIC UEGO_tiAftAsicShtOffFastLamRels_C "Time window for fast Lambda release after ASIC shut-off" VALUE 0x80537F58 RB_Val_Wu16 655.3500 t_q0p01 0.00 655.3500 FORMAT "%8.4" /end CHARACTERISTIC
/begin CHARACTERISTIC UEGO_tiBtwElecFlt_C "Time between two test pulses during electrical fault" VALUE 0x80537C4E RB_Val_Ws16 655350.0 Time_ms -327680.0 327670.0 FORMAT "%8.1" /end CHARACTERISTIC
/begin CHARACTERISTIC UEGO_tiBtwOTFlt_C "Time between two test pulses during overtemperature fault" VALUE 0x80537C50 RB_Val_Ws16 655.3500 Time_s -327.6800 327.6700 FORMAT "%8.4" /end CHARACTERISTIC
/begin CHARACTERISTIC UEGO_tiConTrigFil_C "" VALUE 0x80537D74 RB_Val_Wu16 655.34999985 zk10msxs_uw_b655p36 0.01000015 655.36000000 FORMAT "%12.8" EXTENDED_LIMITS 0.010000152590 655.36000000 /end CHARACTERISTIC
/begin CHARACTERISTIC UEGO_tiDiagRprtRelsOff_C "Time delay after inhibit of diagnosis report" VALUE 0x80537CF0 RB_Val_Wu16 655.3500 t_q0p01 0.00 655.3500 FORMAT "%8.4" /end CHARACTERISTIC
/begin CHARACTERISTIC UEGO_tiDlyEngStop_C "delay if the engine off time is not reseted synchoneouse with the engine stop" VALUE 0x80537F98 RB_Val_Wu8 12.75 t_q0p05 0.00 12.75 FORMAT "%5.2" /end CHARACTERISTIC
/begin CHARACTERISTIC UEGO_tiDlyFctDemTstr_C "Delay time after function request from service tester" VALUE 0x80537BEA RB_Val_Wu8 25.50 t_q0p1 0.00 25.50 FORMAT "%5.2" /end CHARACTERISTIC
/begin CHARACTERISTIC UEGO_tiDlyHeatrPSOff_C "turn off delay of closed loop heater control if power stage is switched off" VALUE 0x80537B80 RB_Val_Wu8 5.100 t_q0p02 0.00 5.100 FORMAT "%5.3" /end CHARACTERISTIC
/begin CHARACTERISTIC UEGO_tiDlyOLEnded_C "delay time end of open loop heating up" VALUE 0x80537B82 RB_Val_Wu16 1310.700 t_q0p02 0.00 1310.700 FORMAT "%8.3" /end CHARACTERISTIC
/begin CHARACTERISTIC UEGO_tiDlyRstOperRlsLoBatt_C "Turn-On delay for the Status low battery voltage after Engine restart." VALUE 0x80537F62 RB_Val_Wu16 655.3500 t_q0p01 0.00 655.3500 FORMAT "%8.4" /end CHARACTERISTIC
/begin CHARACTERISTIC UEGO_tiDlySetElecPwrHi_C "Delaytime increased heater power demand" VALUE 0x80537B84 RB_Val_Wu16 1310.700 t_q0p02 0.00 1310.700 FORMAT "%8.3" /end CHARACTERISTIC
/begin CHARACTERISTIC UEGO_tiDlySnsrHot_C "delay time after heating up phase until sensor is respected as hot" VALUE 0x80537B86 RB_Val_Wu16 1310.700 t_q0p02 0.00 1310.700 FORMAT "%8.3" /end CHARACTERISTIC
/begin CHARACTERISTIC UEGO_tiDlySuffBattAftEngRstrt_C "Turn-On delay for the Status sufficient battery voltage after Engine restart." VALUE 0x80537F64 RB_Val_Wu16 655.3500 t_q0p01 0.00 655.3500 FORMAT "%8.4" /end CHARACTERISTIC
/begin CHARACTERISTIC UEGO_tiDlyUBattLo_C "Time delay when the battery voltage decreases below the sufficient battery voltage" VALUE 0x80537F5A RB_Val_Wu16 655.3500 t_q0p01 0.00 655.3500 FORMAT "%8.4" /end CHARACTERISTIC
/begin CHARACTERISTIC UEGO_tiDlyUBattMax_C "Time delay when the battery voltage exceeds the maximum battery voltage" VALUE 0x80537F5C RB_Val_Wu16 655.3500 t_q0p01 0.00 655.3500 FORMAT "%8.4" /end CHARACTERISTIC
/begin CHARACTERISTIC UEGO_tiDlyUBattSuffLamRels_C "Time delay for resetting the lambda validity when flgUBattSuff=0" VALUE 0x80537D76 RB_Val_Wu16 655.3500 t_q0p01 0.00 655.3500 FORMAT "%8.4" /end CHARACTERISTIC
/begin CHARACTERISTIC UEGO_tiDsbcActv_C "Time delay after short time pump control shut off" VALUE 0x80537CF2 RB_Val_Wu16 655.3500 t_q0p01 0.00 655.3500 FORMAT "%8.4" /end CHARACTERISTIC
/begin CHARACTERISTIC UEGO_tiEngStop_C "Minimum engine stop time for healing release of start diagnosis" VALUE 0x80537F78 RB_Val_Ws32 4294967295.00 t_q1 -2147483648.00 2147483647.00 FORMAT "%13.2" /end CHARACTERISTIC
/begin CHARACTERISTIC UEGO_tiHeatrCrvMax_C "maximum time for curve phase of open loop heater control" VALUE 0x80537B88 RB_Val_Wu16 1310.700 t_q0p02 0.00 1310.700 FORMAT "%8.3" /end CHARACTERISTIC
/begin CHARACTERISTIC UEGO_tiHeatrHold_C "period of hold phase in open loop heater control" VALUE 0x80537B8A RB_Val_Wu16 1310.700 t_q0p02 0.00 1310.700 FORMAT "%8.3" /end CHARACTERISTIC
/begin CHARACTERISTIC UEGO_tiHeatrPerdDurn_C "Period duration of duty cylce for heater power stage of lambdasensor" VALUE 0x80537C3C RB_Val_Wu16 0.06553500 t_q0p000001_s 0.00 0.06553500 FORMAT "%10.8" /end CHARACTERISTIC
/begin CHARACTERISTIC UEGO_tiIPmpEvlnVld_C "Time delay for O2 signal release after setting IP signal validity" VALUE 0x80537CE8 RB_Val_Wu16 655.3500 t_q0p01 0.00 655.3500 FORMAT "%8.4" /end CHARACTERISTIC
/begin CHARACTERISTIC UEGO_tiLamRelsEngStrt_C "Time duration like UEGO_tiLamRels_C but corresponding to faster lambda release during engine restart" VALUE 0x80537D78 RB_Val_Wu16 655.3500 t_q0p01 0.00 655.3500 FORMAT "%8.4" /end CHARACTERISTIC
/begin CHARACTERISTIC UEGO_tiLamRels_C "Delay time after release by the FId_UEGOIPmpTRels" VALUE 0x80537D7A RB_Val_Wu16 655.3500 t_q0p01 0.00 655.3500 FORMAT "%8.4" /end CHARACTERISTIC
/begin CHARACTERISTIC UEGO_tiRmpEnaDiffMin_C "locking time between start of different sensor heating" VALUE 0x80537B94 RB_Val_Wu16 1310.700 t_q0p02 0.00 1310.700 FORMAT "%8.3" /end CHARACTERISTIC
/begin CHARACTERISTIC UEGO_tiRPCNotActv_C "Time delay after exiting pump current revers mode for O2 signal release" VALUE 0x80537CF4 RB_Val_Wu16 655.3500 t_q0p01 0.00 655.3500 FORMAT "%8.4" /end CHARACTERISTIC
/begin CHARACTERISTIC UEGO_tiRTEvlnInvld_C "Delay time for reset flgBascCdnReld by invalid temprature info" VALUE 0x80537D7C RB_Val_Wu16 655.3500 t_q0p01 0.00 655.3500 FORMAT "%8.4" /end CHARACTERISTIC
/begin CHARACTERISTIC UEGO_tiRTEvlnvld_C "Delay parameter for temperature invalidity." VALUE 0x80537CEA RB_Val_Wu16 655.3500 t_q0p01 0.00 655.3500 FORMAT "%8.4" /end CHARACTERISTIC
/begin CHARACTERISTIC UEGO_tiSnglCellSigValid_C "Time delay after exiting Up control for O2 signal release" VALUE 0x80537CF6 RB_Val_Wu16 655.3500 t_q0p01 0.00 655.3500 FORMAT "%8.4" /end CHARACTERISTIC
/begin CHARACTERISTIC UEGO_tiTCerLamInvld_C "Delay time for reset flgBascCdnReld by low temperature" VALUE 0x80537D7E RB_Val_Wu16 655.3500 t_q0p01 0.00 655.3500 FORMAT "%8.4" /end CHARACTERISTIC
/begin CHARACTERISTIC UEGO_tiWinAftEngRstrt_C "Time window after engine restart for detection of ASIC in IDLE" VALUE 0x80537F5E RB_Val_Wu16 655.3500 t_q0p01 0.00 655.3500 FORMAT "%8.4" /end CHARACTERISTIC
/begin CHARACTERISTIC UEGO_tiWinAftSuffBatt_C "Time period after battery voltage is above the threshold of UEGO_uLoBattAsicHiThd_C during engine restart." VALUE 0x80537F60 RB_Val_Wu16 655.3500 t_q0p01 0.00 655.3500 FORMAT "%8.4" /end CHARACTERISTIC
/begin CHARACTERISTIC UEGO_tMaxCLCtlDvtLrg_C "large temperature threshold of the control deviation of heater control" VALUE 0x80537B98 RB_Val_Ws16 1535.977 temp_q0p0234 -768.0000 767.9766 FORMAT "%8.4" /end CHARACTERISTIC
/begin CHARACTERISTIC UEGO_tMaxCLCtlDvtSml_C "small temperature threshold of the control deviation of heater control" VALUE 0x80537B9A RB_Val_Wu16 1535.977 temp_q0p0234 0.00 1535.977 FORMAT "%8.3" /end CHARACTERISTIC
/begin CHARACTERISTIC UEGO_tMinLamRels_C "min. temperature threshold for sensor release" VALUE 0x80537D80 RB_Val_Wu16 1535.977 temp_q0p0234_o273 -273.150 1262.827 FORMAT "%8.3" /end CHARACTERISTIC
/begin CHARACTERISTIC UEGO_tMinO2Rels_C "Minimum sensor temperature for release of O2 signal" VALUE 0x80537CEC RB_Val_Wu16 1535.977 temp_q0p0234_o273 -273.150 1262.827 FORMAT "%8.3" /end CHARACTERISTIC
/begin CHARACTERISTIC UEGO_tSnsrHotThd_C "temperature threshold for the state: sensor hot" VALUE 0x80537F7C RB_Val_Wu16 1535.977 temp_q0p0234_o273 -273.150 1262.827 FORMAT "%8.3" /end CHARACTERISTIC
/begin CHARACTERISTIC UEGO_TstrClassS1B1_I.stTstrCtl_C "Class tester release for lambda sensor 1 bank 1 / status, codeword for tester control" VALUE 0x80537FA0 RB_Val_Wu8 255.0 dez 0.00 255.0 FORMAT "%5.1" /end CHARACTERISTIC
/begin CHARACTERISTIC UEGO_uExtPwrSply_C "Voltage of the external power supply" VALUE 0x80537C3E RB_Val_Wu8 25.50 spg_q0p1 0.00 25.50 FORMAT "%5.2" /end CHARACTERISTIC
/begin CHARACTERISTIC UEGO_uHtrCLMax_C "maximum heater voltage of the closed loop heater control" VALUE 0x80537B9C RB_Val_Wu16 327.6750 spg_q0p005 0.00 327.6750 FORMAT "%8.4" /end CHARACTERISTIC
/begin CHARACTERISTIC UEGO_uHtrEffMin_C "Effectiev heater voltage in protection mode" VALUE 0x80537B8C RB_Val_Wu16 327.6750 spg_q0p005 0.00 327.6750 FORMAT "%8.4" /end CHARACTERISTIC
/begin CHARACTERISTIC UEGO_uHtrEffRed_C "heater voltage during reduced heating" VALUE 0x80537B8E RB_Val_Wu16 327.6750 spg_q0p005 0.00 327.6750 FORMAT "%8.4" /end CHARACTERISTIC
/begin CHARACTERISTIC UEGO_uHtrRmpMax_C "maximum heater voltage at the end of the ramp phase of open loop control" VALUE 0x80537B90 RB_Val_Wu16 327.6750 spg_q0p005 0.00 327.6750 FORMAT "%8.4" /end CHARACTERISTIC
/begin CHARACTERISTIC UEGO_uHtrStopIntgl_C "Holding the I-part of the heater control at fault suspicion to prevent a cooling down of the heater" VALUE 0x80537B92 RB_Val_Wu16 327.6750 spg_q0p005 0.00 327.6750 FORMAT "%8.4" /end CHARACTERISTIC
/begin CHARACTERISTIC UEGO_uLoBattAsicHiThd_C "Battery voltage threshold to release sensor operation after engine restart in MSA" VALUE 0x80537F66 RB_Val_Ws16 1310700. Volt_Batt -655360.0 655340.0 FORMAT "%8.1" /end CHARACTERISTIC
/begin CHARACTERISTIC UEGO_uLoBattAsicLowrThd_C "Battery voltage threshold to reset sensor operation due to engine restart in MSA" VALUE 0x80537F68 RB_Val_Ws16 1310700. Volt_Batt -655360.0 655340.0 FORMAT "%8.1" /end CHARACTERISTIC
/begin CHARACTERISTIC UEGO_wSnsrMdlHotThd_T "energy threshold for the state: sensor hot" CURVE 0x80537F7E RB_Curve_U16_U16 1023.984 q_q0p015625_J 0.00 1023.984 FORMAT "%8.3"
 /begin AXIS_DESCR STD_AXIS NO_INPUT_QUANTITY t_q0p02 6 0.00 1310.700 FORMAT "%8.3" DEPOSIT ABSOLUTE /end AXIS_DESCR
/end CHARACTERISTIC
/begin CHARACTERISTIC VehMot2ME_CW "Codeword for adapter function %VehMot2ME" VALUE 0x805380B8 RB_Val_Wu8 255.0 dez 0.00 255.0 FORMAT "%5.1" /end CHARACTERISTIC
/begin CHARACTERISTIC VehMot2ME_trqAccPed_CUR "adpter curve maximum torque accelerator pedal angle" CURVE 0x805380BA RB_Curve_S16_U16_Static 199.9969 rel_uw_b200 0.00 199.9969 FORMAT "%8.4"
 /begin AXIS_DESCR STD_AXIS APP_r Prc 5 -400.0000 399.9878 FORMAT "%8.4" DEPOSIT ABSOLUTE /end AXIS_DESCR
/end CHARACTERISTIC
/begin CHARACTERISTIC VehMot_mInrt_C "total vehicle inertia" VALUE 0x8053810C RB_Val_Ws16 65535.00 Mass -32768.00 32767.00 FORMAT "%8.2" /end CHARACTERISTIC
/begin CHARACTERISTIC VehMot_nEngSpdThd_C "Engine speed threshold to detect high load condition" VALUE 0x80538128 RB_Val_Ws16 32767.50 EngN -16384.00 16383.50 FORMAT "%8.2" /end CHARACTERISTIC
/begin CHARACTERISTIC VehMot_rAppNegDiff_C "Negative threshold slope for accelerator pedal" VALUE 0x8053812A RB_Val_Ws16 39999.39 PrcPerSec -20000.00 19999.39 FORMAT "%8.2" /end CHARACTERISTIC
/begin CHARACTERISTIC VehMot_rAppPosDiff_C "Positive threshold slope for accelerator pedal" VALUE 0x8053812C RB_Val_Ws16 39999.39 PrcPerSec -20000.00 19999.39 FORMAT "%8.2" /end CHARACTERISTIC
/begin CHARACTERISTIC VehMot_rAppThd2VehDyn_C "Accped threshold to detect high load condition" VALUE 0x8053812E RB_Val_Ws16 799.9878 Prc -400.0000 399.9878 FORMAT "%8.4" /end CHARACTERISTIC
/begin CHARACTERISTIC VehMot_rAppThd3VehDyn_C "Accelerator pedal Threshold 3." VALUE 0x80538130 RB_Val_Ws16 799.9878 Prc -400.0000 399.9878 FORMAT "%8.4" /end CHARACTERISTIC
/begin CHARACTERISTIC VehMot_rAppThdVehDyn_C "Accped threshold above which vehicle dynamic state is set" VALUE 0x80538132 RB_Val_Ws16 799.9878 Prc -400.0000 399.9878 FORMAT "%8.4" /end CHARACTERISTIC
/begin CHARACTERISTIC VehMot_tiAppVartnDly_C "Time delay to hold the status,after accped crosses positive or negetive threholds" VALUE 0x80538134 RB_Val_Wu8 2.550 t_q0p01 0.00 2.550 FORMAT "%5.3" /end CHARACTERISTIC
/begin CHARACTERISTIC VehMot_tiFastLearn_C "Time for fast learn modus" VALUE 0x8053810E RB_Val_Ws16 65.53500 Time_s_1 -32.76800 32.76700 FORMAT "%8.5" /end CHARACTERISTIC
/begin CHARACTERISTIC VehMot_tiTrqDragMin_C "Minimum time constant for filtering drag esimation" VALUE 0x80538110 RB_Val_Ws16 65.53500 Time_s_1 -32.76800 32.76700 FORMAT "%8.5" /end CHARACTERISTIC
/begin CHARACTERISTIC VehMot_tiTrqDragVx_CUR "Characteristic line of time constant dependend from velocity" CURVE 0x80538112 RB_Curve_S16_S16 65.53500 Time_s_1 -32.76800 32.76700 FORMAT "%8.5"
 /begin AXIS_DESCR STD_AXIS GlbDa_vX Vel 2 -327.6800 327.6700 FORMAT "%8.4" DEPOSIT ABSOLUTE /end AXIS_DESCR
/end CHARACTERISTIC
/begin CHARACTERISTIC VehMot_tiTrqPrpPT1_C "Time constant for torque filter" VALUE 0x8053811C RB_Val_Ws32 4294.9672940000000 TimeDelay_s 0.0000020000000 4294.9672959999998 FORMAT "%19.14" EXTENDED_LIMITS 0.000002000000001 4294.9672959999998 /end CHARACTERISTIC
/begin CHARACTERISTIC VehMot_trqDragMax_C "Maximum drag torque" VALUE 0x80538120 RB_Val_Ws32 429496729.500 TrqPrpHigh -214748364.800 214748364.700 FORMAT "%13.3" /end CHARACTERISTIC
/begin CHARACTERISTIC VehMot_vMinDragEst_C "Minimum velocity for drag esimation" VALUE 0x80538124 RB_Val_Ws16 655.3500 Vel -327.6800 327.6700 FORMAT "%8.4" /end CHARACTERISTIC
/begin CHARACTERISTIC VehMot_wThd2rlsol_C "Load threshold to detect high load condition" VALUE 0x80538136 RB_Val_Wu16 1535.977 rel_q0p02344 0.00 1535.977 FORMAT "%8.3" /end CHARACTERISTIC
/begin CHARACTERISTIC VehMot_wThdrlsol_C "Load threshold" VALUE 0x80538138 RB_Val_Wu16 1535.977 rel_q0p02344 0.00 1535.977 FORMAT "%8.3" /end CHARACTERISTIC
/begin CHARACTERISTIC VehStc_nEngHi3000_C "Engine speed over 3000rpm" VALUE 0x8053813C RB_Val_Ws16 32767.50 EngN -16384.00 16383.50 FORMAT "%8.2" /end CHARACTERISTIC
/begin CHARACTERISTIC VehStc_nEngHi4500_C "Engine speed under 4500rpm" VALUE 0x8053813E RB_Val_Ws16 32767.50 EngN -16384.00 16383.50 FORMAT "%8.2" /end CHARACTERISTIC
/begin CHARACTERISTIC VehStc_nEngLo1000_C "Engine speed over 1000rpm" VALUE 0x80538140 RB_Val_Ws16 32767.50 EngN -16384.00 16383.50 FORMAT "%8.2" /end CHARACTERISTIC
/begin CHARACTERISTIC VehStc_nEngLo2000_C "Engine speed under 2000rpm" VALUE 0x80538142 RB_Val_Ws16 32767.50 EngN -16384.00 16383.50 FORMAT "%8.2" /end CHARACTERISTIC
/begin CHARACTERISTIC VehStc_nEngLowr1000_C "Engine speed under 1000rpm" VALUE 0x80538144 RB_Val_Ws16 32767.50 EngN -16384.00 16383.50 FORMAT "%8.2" /end CHARACTERISTIC
/begin CHARACTERISTIC VehStc_nEngMed2000_C "Engine speed over 2000rpm" VALUE 0x80538146 RB_Val_Ws16 32767.50 EngN -16384.00 16383.50 FORMAT "%8.2" /end CHARACTERISTIC
/begin CHARACTERISTIC VehStc_nEngMed3000_C "Engine speed under 3000rpm" VALUE 0x80538148 RB_Val_Ws16 32767.50 EngN -16384.00 16383.50 FORMAT "%8.2" /end CHARACTERISTIC
/begin CHARACTERISTIC VehStc_nEngSpdThd_C "engine speed threshold" VALUE 0x8053814A RB_Val_Ws16 32767.50 EngN -16384.00 16383.50 FORMAT "%8.2" /end CHARACTERISTIC
/begin CHARACTERISTIC VehStc_nEngTop4500_C "Engine speed over 4500rpm" VALUE 0x8053814C RB_Val_Ws16 32767.50 EngN -16384.00 16383.50 FORMAT "%8.2" /end CHARACTERISTIC
/begin CHARACTERISTIC VehStc_pIntkHi450_C "Intake manifold pressure over 450mmHG" VALUE 0x80538150 RB_Val_Wu32 125839807.057 p_uw_q0p039_mmHg 0.00 125839807.057 FORMAT "%13.3" /end CHARACTERISTIC
/begin CHARACTERISTIC VehStc_pIntkHi600_C "Intake manifold pressure under 450mmHg" VALUE 0x80538154 RB_Val_Wu32 125839807.057 p_uw_q0p039_mmHg 0.00 125839807.057 FORMAT "%13.3" /end CHARACTERISTIC
/begin CHARACTERISTIC VehStc_pIntkLo_C "Intake manifold pressure under 300mmHg" VALUE 0x80538158 RB_Val_Wu32 125839807.057 p_uw_q0p039_mmHg 0.00 125839807.057 FORMAT "%13.3" /end CHARACTERISTIC
/begin CHARACTERISTIC VehStc_pIntkMed300_C "Intake manifold pressure over 300mmHg" VALUE 0x8053815C RB_Val_Wu32 125839807.057 p_uw_q0p039_mmHg 0.00 125839807.057 FORMAT "%13.3" /end CHARACTERISTIC
/begin CHARACTERISTIC VehStc_pIntkMed450_C "Intake manifold pressure under 450mmHg" VALUE 0x80538160 RB_Val_Wu32 125839807.057 p_uw_q0p039_mmHg 0.00 125839807.057 FORMAT "%13.3" /end CHARACTERISTIC
/begin CHARACTERISTIC VehStc_pIntkTop600_C "Intake manifold pressure over 600mmHg" VALUE 0x80538164 RB_Val_Wu32 125839807.057 p_uw_q0p039_mmHg 0.00 125839807.057 FORMAT "%13.3" /end CHARACTERISTIC
/begin CHARACTERISTIC VehStc_stAutoRstrtEna_C "autorestart enable\disable calibration" VALUE 0x80538168 RB_Val_Wboolean 1.00000000000 B_TRUE 0.00 1.00000000000 FORMAT "%13.11" /end CHARACTERISTIC
/begin CHARACTERISTIC VehStc_stISSOffACMsk_C "Bit mask for Idle Stop off due to air conditioning" VALUE 0x8053816A RB_Val_Wu16 65535.00 OneToOne 0.00 65535.00 FORMAT "%8.2" /end CHARACTERISTIC
/begin CHARACTERISTIC VehStc_stISSOffATMsk_C "Bit mask for Idle Stop off due to AT request" VALUE 0x8053816C RB_Val_Wu16 65535.00 OneToOne 0.00 65535.00 FORMAT "%8.2" /end CHARACTERISTIC
/begin CHARACTERISTIC VehStc_stISSOffATSlopeMsk_C "Bit mask for Idle Stop off due to slope detection of AT" VALUE 0x8053816E RB_Val_Wu16 65535.00 OneToOne 0.00 65535.00 FORMAT "%8.2" /end CHARACTERISTIC
/begin CHARACTERISTIC VehStc_stISSOffBatMsk_C "Bit mask for Idle Stop off due to battery charging" VALUE 0x80538170 RB_Val_Wu16 65535.00 OneToOne 0.00 65535.00 FORMAT "%8.2" /end CHARACTERISTIC
/begin CHARACTERISTIC VehStc_stISSOffBrkBoostMsk_C "Bit mask for Idle Stop off due to request of brake booster" VALUE 0x80538172 RB_Val_Wu16 65535.00 OneToOne 0.00 65535.00 FORMAT "%8.2" /end CHARACTERISTIC
/begin CHARACTERISTIC VehStc_stISSOffDCDCMsk_C "Bit mask for Idle Stop off due to DCDC converter" VALUE 0x80538174 RB_Val_Wu16 65535.00 OneToOne 0.00 65535.00 FORMAT "%8.2" /end CHARACTERISTIC
/begin CHARACTERISTIC VehStc_stISSOffPwrSteerMsk_C "Bit mask for Idle Stop off due to power steering" VALUE 0x80538176 RB_Val_Wu16 65535.00 OneToOne 0.00 65535.00 FORMAT "%8.2" /end CHARACTERISTIC
/begin CHARACTERISTIC VehStc_stISSOffTempEngMsk_C "Bit mask for Idle Stop off due to engine temperature" VALUE 0x80538178 RB_Val_Wu16 65535.00 OneToOne 0.00 65535.00 FORMAT "%8.2" /end CHARACTERISTIC
/begin CHARACTERISTIC VehStc_stISSOffUserMsk_C "Bit mask for Idle Stop off due to user turned off" VALUE 0x8053817A RB_Val_Wu16 65535.00 OneToOne 0.00 65535.00 FORMAT "%8.2" /end CHARACTERISTIC
/begin CHARACTERISTIC VehStc_stISSOffvVehMsk_C "Bit mask for Idle Stop off due to vehicle speed condition" VALUE 0x8053817C RB_Val_Wu16 65535.00 OneToOne 0.00 65535.00 FORMAT "%8.2" /end CHARACTERISTIC
/begin CHARACTERISTIC VehStc_stStalEngReasMsk_C "engine stall mask calibration" VALUE 0x8053817E RB_Val_Wu8 255.0 OneToOne 0.00 255.0 FORMAT "%5.1" /end CHARACTERISTIC
/begin CHARACTERISTIC VehStc_tClntThd_C "Threshold engine coolant temperature" VALUE 0x80538180 RB_Val_Ws16 6553.500 Temp_Cels -3549.940 3003.560 FORMAT "%8.3" /end CHARACTERISTIC
/begin CHARACTERISTIC VehStc_tiSSEChgOfMindOff_C "parameter to set the change of mind time" VALUE 0x80538182 RB_Val_Wu16 655350.0 Time_ms 0.00 655350.0 FORMAT "%8.1" /end CHARACTERISTIC
/begin CHARACTERISTIC VehStc_tiStopTrigDly_C "calibration to set the stop trigger delay" VALUE 0x80538184 RB_Val_Ws16 327.6700 Time_s 0.00 327.6700 FORMAT "%8.4" EXTENDED_LIMITS -327.6800 327.6700 /end CHARACTERISTIC
/begin CHARACTERISTIC VehStc_volInputSel_C "Calibration to select the vehicle fuel consumption input" VALUE 0x80538186 RB_Val_Wu8 255.0 OneToOne 0.00 255.0 FORMAT "%5.1" /end CHARACTERISTIC
/begin CHARACTERISTIC VehStc_vVehZonSeln_C "vehicle zone selection parameter" VALUE 0x80538188 RB_Val_Ws16 655.3500 Vel -327.6800 327.6700 FORMAT "%8.4" /end CHARACTERISTIC
/begin CHARACTERISTIC VehStc_vWhlSpdThresHi_C "vehicle speed threshold value" VALUE 0x8053818A RB_Val_Ws16 655.3500 Vel -327.6800 327.6700 FORMAT "%8.4" /end CHARACTERISTIC
/begin CHARACTERISTIC VF2ME_MRFAVLN_CUR "Full load recognition threshold driver's demand" CURVE 0x805380D0 RB_Curve_U16_U16 199.9969 rel_uw_b200 0.00 199.9969 FORMAT "%8.4"
 /begin AXIS_DESCR STD_AXIS Epm_nEng EngN 14 0.00 32767.50 FORMAT "%8.2" DEPOSIT ABSOLUTE /end AXIS_DESCR
/end CHARACTERISTIC
/begin CHARACTERISTIC VF2ME_MRMAX_C "maximum relative torque ofr driver's demand from adapter VF2ME" VALUE 0x8053810A RB_Val_Wu16 199.9969 rel_uw_b200 0.00 199.9969 FORMAT "%8.4" /end CHARACTERISTIC
/begin MEASUREMENT B_asr_msg "condition for ASR active" UBYTE B_TRUE 1 100 0.00 1.00000000000 BIT_MASK 0x1 FORMAT "%13.11" ECU_ADDRESS 0x70000ABF /end MEASUREMENT
/begin MEASUREMENT B_elsxbb_msg "error LS upstream catalyst resetting operational readiness" UBYTE B_TRUE 1 100 0.00 1.00000000000 BIT_MASK 0x1 FORMAT "%13.11" ECU_ADDRESS 0x70000A7F /end MEASUREMENT
/begin MEASUREMENT B_fgr_msg "condition: drivers set engine torque determined by cruise control" UBYTE B_TRUE 1 100 0.00 1.00000000000 BIT_MASK 0x1 FORMAT "%13.11" ECU_ADDRESS 0x70000A63 /end MEASUREMENT
/begin MEASUREMENT B_hlsumx_msg "Condition U_bat corrected controller output is max (=100), Bank 2" UBYTE B_TRUE 1 100 0.00 1.00000000000 BIT_MASK 0x1 FORMAT "%13.11" ECU_ADDRESS 0x70000A45 /end MEASUREMENT
/begin MEASUREMENT B_hstlsua_msg "Condition: status A of heater, sensor heated up, reaches set temperature" UBYTE B_TRUE 1 100 0.00 1.00000000000 BIT_MASK 0x1 FORMAT "%13.11" ECU_ADDRESS 0x70000A2D /end MEASUREMENT
/begin MEASUREMENT B_ll_msg "Idle speed from drivers sight" UBYTE B_TRUE 1 100 0.00 1.00000000000 BIT_MASK 0x1 FORMAT "%13.11" ECU_ADDRESS 0x70000A06 /end MEASUREMENT
/begin MEASUREMENT B_msr_msg "Condition MSR" UBYTE B_TRUE 1 100 0.00 1.00000000000 BIT_MASK 0x1 FORMAT "%13.11" ECU_ADDRESS 0x700009EC /end MEASUREMENT
/begin MEASUREMENT B_sbblsu_msg "condition for sensor LSU upstream cat ready for operation f(lamsons_w)" UBYTE B_TRUE 1 100 0.00 1.00000000000 BIT_MASK 0x1 FORMAT "%13.11" ECU_ADDRESS 0x700009B8 /end MEASUREMENT
/begin MEASUREMENT B_sbbvk_msg "condition for lambda sensor upstream cat ready for operation" UBYTE B_TRUE 1 100 0.00 1.00000000000 BIT_MASK 0x1 FORMAT "%13.11" ECU_ADDRESS 0x700009B7 /end MEASUREMENT
/begin MEASUREMENT B_vl_msg "Condition for wide open throttle" UBYTE B_TRUE 1 100 0.00 1.00000000000 BIT_MASK 0x1 FORMAT "%13.11" ECU_ADDRESS 0x7000095D /end MEASUREMENT
/begin MEASUREMENT lamsonb_w_msg "base lambda actual value" UWORD fak_uw_b16 1 100 0.00 15.99976 FORMAT "%8.5" ECU_ADDRESS 0x70002CFC /end MEASUREMENT
/begin MEASUREMENT lsukorp_w_msg "factor for pressure correction of LSU" UWORD fak_uw_b2 1 100 0.00 1.999969 FORMAT "%8.6" ECU_ADDRESS 0x70002CFE /end MEASUREMENT
/begin MEASUREMENT mivbeb_w_msg "Indicated torque before slope limitation, limited to mimax_w" UWORD rel_uw_b100 1 100 0.00 99.99847 FORMAT "%8.5" ECU_ADDRESS 0x60004BE4 /end MEASUREMENT
/begin MEASUREMENT mivbeg_w_msg "Indicated torque requested by driver before slope limitation" UWORD rel_uw_b100 1 100 0.00 99.99847 FORMAT "%8.5" ECU_ADDRESS 0x60004BE2 /end MEASUREMENT
/begin MEASUREMENT mrfa_w_msg "relative driver request torque from cruise control and pedal" UWORD rel_uw_b200 1 100 0.00 199.9969 FORMAT "%8.4" ECU_ADDRESS 0x50005C66 /end MEASUREMENT
/begin MEASUREMENT tahrlsu_w_msg "Duty cycle for lambda sensor heater" UWORD rel_q0p003052 1 100 0.00 199.9969 FORMAT "%8.4" ECU_ADDRESS 0x60004BB0 /end MEASUREMENT
/begin MEASUREMENT tkerdcmn_w_msg "UBat-dependent diagnostic thresh. f. max. duty cycle" UWORD temp_q0p0234_o273 1 100 -273.150 1262.827 FORMAT "%8.3" ECU_ADDRESS 0x600047EA /end MEASUREMENT
/begin MEASUREMENT twvsom_w_msg "Wall temperature front sensor modelled" UWORD temp_q0p0234_o273 1 100 -273.150 1262.827 FORMAT "%8.3" ECU_ADDRESS 0x600047DA /end MEASUREMENT
/begin MEASUREMENT UEGO_bHtrCtlActvS1B1 "heater control active (open- or closed loop), sensor 1 bank 1" UBYTE B_TRUE 1 100 0.00 1.00000000000 BIT_MASK 0x1 FORMAT "%13.11" ECU_ADDRESS 0x70000637 /end MEASUREMENT
/begin MEASUREMENT UEGO_bHtrCtlCLtDvtLrgS1B1 "control deviation of heater control below large threshold, sensor 1 bank 1" UBYTE B_TRUE 1 100 0.00 1.00000000000 BIT_MASK 0x1 FORMAT "%13.11" ECU_ADDRESS 0x70000636 /end MEASUREMENT
/begin MEASUREMENT UEGO_bHtrCtlCLtDvtSmlS1B1 "control deviation of heater control below small threshold, sensor 1 bank 1" UBYTE B_TRUE 1 100 0.00 1.00000000000 BIT_MASK 0x1 FORMAT "%13.11" ECU_ADDRESS 0x70000635 /end MEASUREMENT
/begin MEASUREMENT UEGO_EngRunngDlyEFNM_I.oldSignal "Determination of a falling edge of flgEngRunng / memory to detect falling edge" UBYTE B_TRUE 1 100 0.00 1.00000000000 BIT_MASK 0x1 FORMAT "%13.11" ECU_ADDRESS 0x60006221 /end MEASUREMENT
/begin MEASUREMENT UEGO_flgAuxPwrRly "Status Auxiliary Power Relay" UBYTE B_TRUE 1 100 0.00 1.00000000000 BIT_MASK 0x1 FORMAT "%13.11" ECU_ADDRESS 0x700000CD /end MEASUREMENT
/begin MEASUREMENT UEGO_flgCtrldModActvS1B1 "heater control, controlled mode activ, sensor 1 bank 1" UBYTE B_TRUE 1 100 0.00 1.00000000000 BIT_MASK 0x1 FORMAT "%13.11" ECU_ADDRESS 0x7000062B /end MEASUREMENT
/begin MEASUREMENT UEGO_flgDewPntRelsS1B1 "dew point release sensor 1 bank 1" UBYTE B_TRUE 1 100 0.00 1.00000000000 BIT_MASK 0x1 FORMAT "%13.11" ECU_ADDRESS 0x7000062A /end MEASUREMENT
/begin MEASUREMENT UEGO_flgElecPwrHi "increased heater power demand" UBYTE B_TRUE 1 100 0.00 1.00000000000 BIT_MASK 0x1 FORMAT "%13.11" ECU_ADDRESS 0x70000626 /end MEASUREMENT
/begin MEASUREMENT UEGO_flgElecPwrHiS1B1 "increased heater power demand sensor 1 bank 1" UBYTE B_TRUE 1 100 0.00 1.00000000000 BIT_MASK 0x1 FORMAT "%13.11" ECU_ADDRESS 0x700000CF /end MEASUREMENT
/begin MEASUREMENT UEGO_flgEngRunngTiEngOffRaw "raw signal of the state: engine on" UBYTE B_TRUE 1 100 0.00 1.00000000000 BIT_MASK 0x1 FORMAT "%13.11" ECU_ADDRESS 0x700000CA /end MEASUREMENT
/begin MEASUREMENT UEGO_flgErrSuspcLoBattS1B1 "Information if during set flgUBattMin and set flgUBattSuff an error suspicion exists. Sensor1 Bank1" UBYTE B_TRUE 1 100 0.00 1.00000000000 BIT_MASK 0x1 FORMAT "%13.11" ECU_ADDRESS 0x70000619 /end MEASUREMENT
/begin MEASUREMENT UEGO_flgFastLamRelsAftAsicShtOffS1B1 "Status for fast Lambda release after ASIC shut-off, Sensor1 Bank1" UBYTE B_TRUE 1 100 0.00 1.00000000000 BIT_MASK 0x1 FORMAT "%13.11" ECU_ADDRESS 0x70000614 /end MEASUREMENT
/begin MEASUREMENT UEGO_flgHeatgUpFinshdS1B1 "Heating Up Open Loop finished; Sensor 1, Bank 1" UBYTE B_TRUE 1 100 0.00 1.00000000000 BIT_MASK 0x1 FORMAT "%13.11" ECU_ADDRESS 0x70000613 /end MEASUREMENT
/begin MEASUREMENT UEGO_flgHeatrCtrlErrS1B1 "Fault diagnosis heater power, Sensor 1 Bank 1" UBYTE B_TRUE 1 100 0.00 1.00000000000 BIT_MASK 0x1 FORMAT "%13.11" ECU_ADDRESS 0x70000612 /end MEASUREMENT
/begin MEASUREMENT UEGO_flgHeatrPSCtrlMaxS1B1 "Condition: Maximum duty cycle for control heater powerstage reached sensor 1 bank 1" UBYTE B_TRUE 1 100 0.00 1.00000000000 BIT_MASK 0x1 FORMAT "%13.11" ECU_ADDRESS 0x70000611 /end MEASUREMENT
/begin MEASUREMENT UEGO_flgHeatrPsErrS1B1 "Sum Error Heater; Sensor 1, Bank 1" UBYTE B_TRUE 1 100 0.00 1.00000000000 BIT_MASK 0x1 FORMAT "%13.11" ECU_ADDRESS 0x7000060F /end MEASUREMENT
/begin MEASUREMENT UEGO_flgHeatrPSOffS1B1 "Heater power stage switched off sensor 1 bank 1" UBYTE B_TRUE 1 100 0.00 1.00000000000 BIT_MASK 0x1 FORMAT "%13.11" ECU_ADDRESS 0x70000610 /end MEASUREMENT
/begin MEASUREMENT UEGO_flgHeatrRelsATSS1B1 "Heater release by ATS, Sensor 1 Bank 1" UBYTE B_TRUE 1 100 0.00 1.00000000000 BIT_MASK 0x1 FORMAT "%13.11" ECU_ADDRESS 0x7000060E /end MEASUREMENT
/begin MEASUREMENT UEGO_flgHomOperMod "Homogeneous operation mode" UBYTE B_TRUE 1 100 0.00 1.00000000000 BIT_MASK 0x1 FORMAT "%13.11" ECU_ADDRESS 0x700000CE /end MEASUREMENT
/begin MEASUREMENT UEGO_flgHtrCtlHeatgUpFinshdS1B1 "heating up finished, sensor 1 bank 1" UBYTE B_TRUE 1 100 0.00 1.00000000000 BIT_MASK 0x1 FORMAT "%13.11" ECU_ADDRESS 0x7000060C /end MEASUREMENT
/begin MEASUREMENT UEGO_flgLamRecprMdlVld "reciprocal lambda model value valid" UBYTE B_TRUE 1 100 0.00 1.00000000000 BIT_MASK 0x1 FORMAT "%13.11" ECU_ADDRESS 0x70000602 /end MEASUREMENT
/begin MEASUREMENT UEGO_flgO2HiPrcsnS1B1 "Condition O2 signal with high precision, sensor 1, bank 1" UBYTE B_TRUE 1 100 0.00 1.00000000000 BIT_MASK 0x1 FORMAT "%13.11" ECU_ADDRESS 0x700005D6 /end MEASUREMENT
/begin MEASUREMENT UEGO_flgO2PhyRelsS1B1 "Condition physical release conditions for O2 signal fulfilled, sensor 1, bank 1" UBYTE B_TRUE 1 100 0.00 1.00000000000 BIT_MASK 0x1 FORMAT "%13.11" ECU_ADDRESS 0x700005D5 /end MEASUREMENT
/begin MEASUREMENT UEGO_flgOperRelsPreEngStrtS1B1 "Activation of lambda sensor heating before engine starts, Sensor1 Bank1" UBYTE B_TRUE 1 100 0.00 1.00000000000 BIT_MASK 0x1 FORMAT "%13.11" ECU_ADDRESS 0x700005D4 /end MEASUREMENT
/begin MEASUREMENT UEGO_flgOperRelsS1B1 "Sensor operation release, Sensor 1 Bank 1" UBYTE B_TRUE 1 100 0.00 1.00000000000 BIT_MASK 0x1 FORMAT "%13.11" ECU_ADDRESS 0x700005D3 /end MEASUREMENT
/begin MEASUREMENT UEGO_flgOperRelsWoDewPntS1B1 "Activation of lambda sensor heating before dew point release, Sensor1 Bank1" UBYTE B_TRUE 1 100 0.00 1.00000000000 BIT_MASK 0x1 FORMAT "%13.11" ECU_ADDRESS 0x700005D2 /end MEASUREMENT
/begin MEASUREMENT UEGO_flgReqPreStrtHeatgS1B1 "Request for pre-start heating, Sensor 1 Bank1" UBYTE B_TRUE 1 100 0.00 1.00000000000 BIT_MASK 0x1 FORMAT "%13.11" ECU_ADDRESS 0x700005C7 /end MEASUREMENT
/begin MEASUREMENT UEGO_flgRstOperRlsLoBatt "Status low battery due to Engine restart in MSA" UBYTE B_TRUE 1 100 0.00 1.00000000000 BIT_MASK 0x1 FORMAT "%13.11" ECU_ADDRESS 0x700000CC /end MEASUREMENT
/begin MEASUREMENT UEGO_flgRstOperRlsLoBattTONVNM_I.time "Turn-On delay for the Status low battery voltage after Engine restart. / Delay Time" UWORD t_q0p01 1 100 0.00 655.3500 FORMAT "%8.4" ECU_ADDRESS 0x70002B9C /end MEASUREMENT
/begin MEASUREMENT UEGO_flgSnsrHotS1B1 "delay time after heating up phase until sensor 1 bank 1 is respected as hot" UBYTE B_TRUE 1 100 0.00 1.00000000000 BIT_MASK 0x1 FORMAT "%13.11" ECU_ADDRESS 0x700005BF /end MEASUREMENT
/begin MEASUREMENT UEGO_flgSnsrMdlHotS1B1 "Condition lambda sensor would be hot, Sensor1 Bank1" UBYTE B_TRUE 1 100 0.00 1.00000000000 BIT_MASK 0x1 FORMAT "%13.11" ECU_ADDRESS 0x700005BE /end MEASUREMENT
/begin MEASUREMENT UEGO_flgSnsrOperRdyS1B1 "Tester interface for sensor LSU upstream cat ready for operation S1B1" UBYTE B_TRUE 1 100 0.00 1.00000000000 BIT_MASK 0x1 FORMAT "%13.11" ECU_ADDRESS 0x700005BD /end MEASUREMENT
/begin MEASUREMENT UEGO_flgSrvTestActv "service request by tester active" UBYTE B_TRUE 1 100 0.00 1.00000000000 BIT_MASK 0x1 FORMAT "%13.11" ECU_ADDRESS 0x700000C9 /end MEASUREMENT
/begin MEASUREMENT UEGO_flgSrvTestDewPntRels "request dew point release by service tester" UBYTE B_TRUE 1 100 0.00 1.00000000000 BIT_MASK 0x1 FORMAT "%13.11" ECU_ADDRESS 0x700005BC /end MEASUREMENT
/begin MEASUREMENT UEGO_flgStrtDiagCmplS1B1 "Condition: Start diagnosis is completed" UBYTE B_TRUE 1 100 0.00 1.00000000000 BIT_MASK 0x1 FORMAT "%13.11" ECU_ADDRESS 0x700005B9 /end MEASUREMENT
/begin MEASUREMENT UEGO_flgSuffBattAftEngRstrt "Status sufficient battery voltage after Engine restart in MSA" UBYTE B_TRUE 1 100 0.00 1.00000000000 BIT_MASK 0x1 FORMAT "%13.11" ECU_ADDRESS 0x700000CB /end MEASUREMENT
/begin MEASUREMENT UEGO_flgSuffBattAftEngRstrtTONVNM_I.time "Turn-On delay for the Status sufficient battery voltage after Engine restart. / Delay Time" UWORD t_q0p01 1 100 0.00 655.3500 FORMAT "%8.4" ECU_ADDRESS 0x6000345E /end MEASUREMENT
/begin MEASUREMENT UEGO_flgTCtrlDeLrgS1B1 "control deviation of heater control below large threshold, sensor 1 bank 1" UBYTE B_TRUE 1 100 0.00 1.00000000000 BIT_MASK 0x1 FORMAT "%13.11" ECU_ADDRESS 0x700005B6 /end MEASUREMENT
/begin MEASUREMENT UEGO_flgTCtrlDeSmallS1B1 "control deviation of heater control below small threshold, sensor 1 bank 1" UBYTE B_TRUE 1 100 0.00 1.00000000000 BIT_MASK 0x1 FORMAT "%13.11" ECU_ADDRESS 0x700005B5 /end MEASUREMENT
/begin MEASUREMENT UEGO_flgTiEngOffVld "validity of the engine of time UEGO_tiEngOff" UBYTE B_TRUE 1 100 0.00 1.00000000000 BIT_MASK 0x1 FORMAT "%13.11" ECU_ADDRESS 0x700005B4 /end MEASUREMENT
/begin MEASUREMENT UEGO_flgTstrReqProtdHeatgS1B1 "Status tester request for protection heating Sensor 1 bank 1" UBYTE B_TRUE 1 100 0.00 1.00000000000 BIT_MASK 0x1 FORMAT "%13.11" ECU_ADDRESS 0x700005AF /end MEASUREMENT
/begin MEASUREMENT UEGO_HeatrCtrlDiagClassS1B1.cntrNotEngRunng "Class heater power diagnosis sensor 1 bank 1 / Counter how often combustion engine was stopped" UWORD OneToOne 1 100 0.00 65535.00 FORMAT "%8.2" ECU_ADDRESS 0x60001266 /end MEASUREMENT
/begin MEASUREMENT UEGO_HeatrCtrlDiagClassS1B1.cntrReiniCalc100ms "Class heater power diagnosis sensor 1 bank 1 / Counter of local ReIni processes" UBYTE OneToOne 1 100 0.00 255.0 FORMAT "%5.1" ECU_ADDRESS 0x60001268 /end MEASUREMENT
/begin MEASUREMENT UEGO_HeatrCtrlDiagClassS1B1.flgDSMClrReq "Class heater power diagnosis sensor 1 bank 1 / Request for erasing fault memory" UBYTE B_TRUE 1 100 0.00 1.00000000000 BIT_MASK 0x1 FORMAT "%13.11" ECU_ADDRESS 0x60001269 /end MEASUREMENT
/begin MEASUREMENT UEGO_HeatrCtrlDiagClassS1B1.flgDiagHeatgCtrlHeal "Class heater power diagnosis sensor 1 bank 1 / Condition: Diagnosis heater power healing, no fault" UBYTE B_TRUE 1 100 0.00 1.00000000000 BIT_MASK 0x2 FORMAT "%13.11" ECU_ADDRESS 0x60001260 /end MEASUREMENT
/begin MEASUREMENT UEGO_HeatrCtrlDiagClassS1B1.flgEGMdlInvld "Class heater power diagnosis sensor 1 bank 1 / Exhaust gas model is valid - local variable" UBYTE B_TRUE 1 100 0.00 1.00000000000 BIT_MASK 0x2 FORMAT "%13.11" ECU_ADDRESS 0x60001264 /end MEASUREMENT
/begin MEASUREMENT UEGO_HeatrCtrlDiagClassS1B1.flgFctDem "Class heater power diagnosis sensor 1 bank 1 / condition general function request, stored" UBYTE B_TRUE 1 100 0.00 1.00000000000 BIT_MASK 0x8 FORMAT "%13.11" ECU_ADDRESS 0x60001260 /end MEASUREMENT
/begin MEASUREMENT UEGO_HeatrCtrlDiagClassS1B1.flgFctDemTstrBEnd "Class heater power diagnosis sensor 1 bank 1 / Testerrequest for shorter startdiagnosis at end of line" UBYTE B_TRUE 1 100 0.00 1.00000000000 BIT_MASK 0x8 FORMAT "%13.11" ECU_ADDRESS 0x60001264 /end MEASUREMENT
/begin MEASUREMENT UEGO_HeatrCtrlDiagClassS1B1.flgHeatrCtlErr "Class heater power diagnosis sensor 1 bank 1 / Set the Heater control error" UBYTE B_TRUE 1 100 0.00 1.00000000000 BIT_MASK 0x1 FORMAT "%13.11" ECU_ADDRESS 0x6000126A /end MEASUREMENT
/begin MEASUREMENT UEGO_HeatrCtrlDiagClassS1B1.flgHeatrStrtd "Class heater power diagnosis sensor 1 bank 1 / Sensor is heated in controlled mode" UBYTE B_TRUE 1 100 0.00 1.00000000000 BIT_MASK 0x2 FORMAT "%13.11" ECU_ADDRESS 0x60001262 /end MEASUREMENT
/begin MEASUREMENT UEGO_HeatrCtrlDiagClassS1B1.flgHeatrStrtdEdgeRise "Class heater power diagnosis sensor 1 bank 1 / falg for heater started edge rise out put in PID41" UBYTE B_TRUE 1 100 0.00 1.00000000000 BIT_MASK 0x1 FORMAT "%13.11" ECU_ADDRESS 0x6000126B /end MEASUREMENT
/begin MEASUREMENT UEGO_HeatrCtrlDiagClassS1B1.flgIUMPRCmpl "Class heater power diagnosis sensor 1 bank 1 / Condition: IUMPR numerator increased" UBYTE B_TRUE 1 100 0.00 1.00000000000 BIT_MASK 0x4 FORMAT "%13.11" ECU_ADDRESS 0x60001260 /end MEASUREMENT
/begin MEASUREMENT UEGO_HeatrCtrlDiagClassS1B1.flgLoDiagErr "Class heater power diagnosis sensor 1 bank 1 / Condition: Low diagnosis heater power error" UBYTE B_TRUE 1 100 0.00 1.00000000000 BIT_MASK 0x20 FORMAT "%13.11" ECU_ADDRESS 0x60001260 /end MEASUREMENT
/begin MEASUREMENT UEGO_HeatrCtrlDiagClassS1B1.flgLoDiagRels "Class heater power diagnosis sensor 1 bank 1 / Condition: Low diagnosis heater power released" UBYTE B_TRUE 1 100 0.00 1.00000000000 BIT_MASK 0x40 FORMAT "%13.11" ECU_ADDRESS 0x60001260 /end MEASUREMENT
/begin MEASUREMENT UEGO_HeatrCtrlDiagClassS1B1.flgLockCntrNotEngRunng "Class heater power diagnosis sensor 1 bank 1 / lock on counting how often combustion engine has been stopped" UBYTE B_TRUE 1 100 0.00 1.00000000000 BIT_MASK 0x1 FORMAT "%13.11" ECU_ADDRESS 0x6000126C /end MEASUREMENT
/begin MEASUREMENT UEGO_HeatrCtrlDiagClassS1B1.flgOvrRun "Class heater power diagnosis sensor 1 bank 1 / Overrun - local variable" UBYTE B_TRUE 1 100 0.00 1.00000000000 BIT_MASK 0x10 FORMAT "%13.11" ECU_ADDRESS 0x60001264 /end MEASUREMENT
/begin MEASUREMENT UEGO_HeatrCtrlDiagClassS1B1.flgPasHeatgNot "Class heater power diagnosis sensor 1 bank 1 / Condition: Diagnosis heater power no passive heating of lambdasensor" UBYTE B_TRUE 1 100 0.00 1.00000000000 BIT_MASK 0x10 FORMAT "%13.11" ECU_ADDRESS 0x60001261 /end MEASUREMENT
/begin MEASUREMENT UEGO_HeatrCtrlDiagClassS1B1.flgPrmntDiagCmpl "Class heater power diagnosis sensor 1 bank 1 / Condition: Permanent diagnosis heater power completed" UBYTE B_TRUE 1 100 0.00 1.00000000000 BIT_MASK 0x2 FORMAT "%13.11" ECU_ADDRESS 0x60001261 /end MEASUREMENT
/begin MEASUREMENT UEGO_HeatrCtrlDiagClassS1B1.flgPrmntDiagErr "Class heater power diagnosis sensor 1 bank 1 / Condition: Permanent diagnosis heater power error" UBYTE B_TRUE 1 100 0.00 1.00000000000 BIT_MASK 0x80 FORMAT "%13.11" ECU_ADDRESS 0x60001260 /end MEASUREMENT
/begin MEASUREMENT UEGO_HeatrCtrlDiagClassS1B1.flgPrmntDiagHeal "Class heater power diagnosis sensor 1 bank 1 / Condition: Permanent diagnosis healing" UBYTE B_TRUE 1 100 0.00 1.00000000000 BIT_MASK 0x1 FORMAT "%13.11" ECU_ADDRESS 0x60001261 /end MEASUREMENT
/begin MEASUREMENT UEGO_HeatrCtrlDiagClassS1B1.flgPrmntDiagHealSuspc "Class heater power diagnosis sensor 1 bank 1 / permanent diagnosis healing suspicion" UBYTE B_TRUE 1 100 0.00 1.00000000000 BIT_MASK 0x1 FORMAT "%13.11" ECU_ADDRESS 0x6000126D /end MEASUREMENT
/begin MEASUREMENT UEGO_HeatrCtrlDiagClassS1B1.flgPrmntDiagNumCmpl "Class heater power diagnosis sensor 1 bank 1 / Condition: Permanent diagnosis heater power IUMPR Numerator complete" UBYTE B_TRUE 1 100 0.00 1.00000000000 BIT_MASK 0x10 FORMAT "%13.11" ECU_ADDRESS 0x60001260 /end MEASUREMENT
/begin MEASUREMENT UEGO_HeatrCtrlDiagClassS1B1.flgPrmntDiagRels "Class heater power diagnosis sensor 1 bank 1 / Condition: Permanent diagnosis heater power released" UBYTE B_TRUE 1 100 0.00 1.00000000000 BIT_MASK 0x20 FORMAT "%13.11" ECU_ADDRESS 0x60001261 /end MEASUREMENT
/begin MEASUREMENT UEGO_HeatrCtrlDiagClassS1B1.flgRprtErrStrtDiag "Class heater power diagnosis sensor 1 bank 1 / Release to report an error for start diagnosis" UBYTE B_TRUE 1 100 0.00 1.00000000000 BIT_MASK 0x4 FORMAT "%13.11" ECU_ADDRESS 0x60001264 /end MEASUREMENT
/begin MEASUREMENT UEGO_HeatrCtrlDiagClassS1B1.flgSrv06Actv "Class heater power diagnosis sensor 1 bank 1 / Condition: values reported to mode 06" UBYTE B_TRUE 1 100 0.00 1.00000000000 BIT_MASK 0x4 FORMAT "%13.11" ECU_ADDRESS 0x60001261 /end MEASUREMENT
/begin MEASUREMENT UEGO_HeatrCtrlDiagClassS1B1.flgSrv06ResAvl "Class heater power diagnosis sensor 1 bank 1 / Service 06 result available" UBYTE B_TRUE 1 100 0.00 1.00000000000 BIT_MASK 0x1 FORMAT "%13.11" ECU_ADDRESS 0x6000126E /end MEASUREMENT
/begin MEASUREMENT UEGO_HeatrCtrlDiagClassS1B1.flgStrtDiagCmpl "Class heater power diagnosis sensor 1 bank 1 / Condition: Start diagnosis is completed" UBYTE B_TRUE 1 100 0.00 1.00000000000 BIT_MASK 0x1 FORMAT "%13.11" ECU_ADDRESS 0x6000126F /end MEASUREMENT
/begin MEASUREMENT UEGO_HeatrCtrlDiagClassS1B1.flgStrtDiagEna "Class heater power diagnosis sensor 1 bank 1 / Condition: Start diagnosis is enabled" UBYTE B_TRUE 1 100 0.00 1.00000000000 BIT_MASK 0x4 FORMAT "%13.11" ECU_ADDRESS 0x60001263 /end MEASUREMENT
/begin MEASUREMENT UEGO_HeatrCtrlDiagClassS1B1.flgStrtDiagEngNotRunng "Class heater power diagnosis sensor 1 bank 1 / retriggering of the start diagnosis after stop-phase or electrical drive in hybrid" UBYTE B_TRUE 1 100 0.00 1.00000000000 BIT_MASK 0x10 FORMAT "%13.11" ECU_ADDRESS 0x60001263 /end MEASUREMENT
/begin MEASUREMENT UEGO_HeatrCtrlDiagClassS1B1.flgStrtDiagEnvtlErr "Class heater power diagnosis sensor 1 bank 1 / Condition: Start diagnosis environment condition for error result fulfiled" UBYTE B_TRUE 1 100 0.00 1.00000000000 BIT_MASK 0x10 FORMAT "%13.11" ECU_ADDRESS 0x60001262 /end MEASUREMENT
/begin MEASUREMENT UEGO_HeatrCtrlDiagClassS1B1.flgStrtDiagEnvtlHeal "Class heater power diagnosis sensor 1 bank 1 / Condition: Start diagnosis environment condition for healing result fulfiled" UBYTE B_TRUE 1 100 0.00 1.00000000000 BIT_MASK 0x4 FORMAT "%13.11" ECU_ADDRESS 0x60001262 /end MEASUREMENT
/begin MEASUREMENT UEGO_HeatrCtrlDiagClassS1B1.flgStrtDiagErr "Class heater power diagnosis sensor 1 bank 1 / Condition: Start diagnosis heater power error" UBYTE B_TRUE 1 100 0.00 1.00000000000 BIT_MASK 0x8 FORMAT "%13.11" ECU_ADDRESS 0x60001262 /end MEASUREMENT
/begin MEASUREMENT UEGO_HeatrCtrlDiagClassS1B1.flgStrtDiagErrRels "Class heater power diagnosis sensor 1 bank 1 / Condition: Start diagnosis error detection is enabled" UBYTE B_TRUE 1 100 0.00 1.00000000000 BIT_MASK 0x20 FORMAT "%13.11" ECU_ADDRESS 0x60001262 /end MEASUREMENT
/begin MEASUREMENT UEGO_HeatrCtrlDiagClassS1B1.flgStrtDiagErrSuspc "Class heater power diagnosis sensor 1 bank 1 / Fehlerverdacht in Startdiagnose" UBYTE B_TRUE 1 100 0.00 1.00000000000 BIT_MASK 0x40 FORMAT "%13.11" ECU_ADDRESS 0x60001263 /end MEASUREMENT
/begin MEASUREMENT UEGO_HeatrCtrlDiagClassS1B1.flgStrtDiagHeal "Class heater power diagnosis sensor 1 bank 1 / Condition: Start diagnosis heater power healing" UBYTE B_TRUE 1 100 0.00 1.00000000000 BIT_MASK 0x40 FORMAT "%13.11" ECU_ADDRESS 0x60001262 /end MEASUREMENT
/begin MEASUREMENT UEGO_HeatrCtrlDiagClassS1B1.flgStrtDiagHealRels "Class heater power diagnosis sensor 1 bank 1 / Condition: Start diagnosis healing is released" UBYTE B_TRUE 1 100 0.00 1.00000000000 BIT_MASK 0x80 FORMAT "%13.11" ECU_ADDRESS 0x60001262 /end MEASUREMENT
/begin MEASUREMENT UEGO_HeatrCtrlDiagClassS1B1.flgStrtDiagNoResEdgeFall "Class heater power diagnosis sensor 1 bank 1 / flag for heater started edge fall out put in PID41" UBYTE B_TRUE 1 100 0.00 1.00000000000 BIT_MASK 0x1 FORMAT "%13.11" ECU_ADDRESS 0x60001270 /end MEASUREMENT
/begin MEASUREMENT UEGO_HeatrCtrlDiagClassS1B1.flgStrtDiagNumCmpl "Class heater power diagnosis sensor 1 bank 1 / Condition: Start diagnosis IUMPR numerator complete" UBYTE B_TRUE 1 100 0.00 1.00000000000 BIT_MASK 0x1 FORMAT "%13.11" ECU_ADDRESS 0x60001263 /end MEASUREMENT
/begin MEASUREMENT UEGO_HeatrCtrlDiagClassS1B1.flgStrtDiagPid41 "Class heater power diagnosis sensor 1 bank 1 / Falg to set teh strart diagnosis PID41" UBYTE B_TRUE 1 100 0.00 1.00000000000 BIT_MASK 0x1 FORMAT "%13.11" ECU_ADDRESS 0x60001271 /end MEASUREMENT
/begin MEASUREMENT UEGO_HeatrCtrlDiagClassS1B1.flgStrtDiagStrtd "Class heater power diagnosis sensor 1 bank 1 / Condition: Start diagnosis has started" UBYTE B_TRUE 1 100 0.00 1.00000000000 BIT_MASK 0x2 FORMAT "%13.11" ECU_ADDRESS 0x60001263 /end MEASUREMENT
/begin MEASUREMENT UEGO_HeatrCtrlDiagClassS1B1.flgStrtDiagSysCdnOk "Class heater power diagnosis sensor 1 bank 1 / Condition: Start diagnosis systemconditions ok" UBYTE B_TRUE 1 100 0.00 1.00000000000 BIT_MASK 0x8 FORMAT "%13.11" ECU_ADDRESS 0x60001261 /end MEASUREMENT
/begin MEASUREMENT UEGO_HeatrCtrlDiagClassS1B1.flgStrtDiagTCeramicOK "Class heater power diagnosis sensor 1 bank 1 / ceramic temperature ok" UBYTE B_TRUE 1 100 0.00 1.00000000000 BIT_MASK 0x80 FORMAT "%13.11" ECU_ADDRESS 0x60001261 /end MEASUREMENT
/begin MEASUREMENT UEGO_HeatrCtrlDiagClassS1B1.flgStrtWatching "Class heater power diagnosis sensor 1 bank 1 / start watching for valid clock" UBYTE B_TRUE 1 100 0.00 1.00000000000 BIT_MASK 0x1 FORMAT "%13.11" ECU_ADDRESS 0x60001265 /end MEASUREMENT
/begin MEASUREMENT UEGO_HeatrCtrlDiagClassS1B1.flgTiHeatrOffOK "Class heater power diagnosis sensor 1 bank 1 / Heater-off-time high enough for start diagnosis healing check" UBYTE B_TRUE 1 100 0.00 1.00000000000 BIT_MASK 0x80 FORMAT "%13.11" ECU_ADDRESS 0x60001263 /end MEASUREMENT
/begin MEASUREMENT UEGO_HeatrCtrlDiagClassS1B1.flgTiHeatrOffVld "Class heater power diagnosis sensor 1 bank 1 / Heater off time is valid" UBYTE B_TRUE 1 100 0.00 1.00000000000 BIT_MASK 0x40 FORMAT "%13.11" ECU_ADDRESS 0x60001261 /end MEASUREMENT
/begin MEASUREMENT UEGO_HeatrCtrlDiagClassS1B1.flgTiStampHeatrOffVld "Class heater power diagnosis sensor 1 bank 1 / Time stamp heater off is valid" UBYTE B_TRUE 1 100 0.00 1.00000000000 BIT_MASK 0x2 FORMAT "%13.11" ECU_ADDRESS 0x60036280 /end MEASUREMENT
/begin MEASUREMENT UEGO_HeatrCtrlDiagClassS1B1.flgTiStampHeatrOnVld "Class heater power diagnosis sensor 1 bank 1 / Time stamp heater on is valid" UBYTE B_TRUE 1 100 0.00 1.00000000000 BIT_MASK 0x8 FORMAT "%13.11" ECU_ADDRESS 0x60001263 /end MEASUREMENT
/begin MEASUREMENT UEGO_HeatrCtrlDiagClassS1B1.tCerLoDiagSrv06 "Class heater power diagnosis sensor 1 bank 1 / Temperature sensor in case of error from low temperature diagnosis for service 06" UWORD temp_q0p0234_o273 1 100 -273.150 1262.827 FORMAT "%8.3" ECU_ADDRESS 0x60001272 /end MEASUREMENT
/begin MEASUREMENT UEGO_HeatrCtrlDiagClassS1B1.tCerLoThdSrv06 "Class heater power diagnosis sensor 1 bank 1 / Value of minimal threshold for service 06" UWORD temp_q0p0234_o273 1 100 -273.150 1262.827 FORMAT "%8.3" ECU_ADDRESS 0x60001274 /end MEASUREMENT
/begin MEASUREMENT UEGO_HeatrCtrlDiagClassS1B1.tCerPrmntDiagSrv06 "Class heater power diagnosis sensor 1 bank 1 / Temperature sensor in case of error from permanent diagnosis for service 06" UWORD temp_q0p0234_o273 1 100 -273.150 1262.827 FORMAT "%8.3" ECU_ADDRESS 0x60001276 /end MEASUREMENT
/begin MEASUREMENT UEGO_HeatrCtrlDiagClassS1B1.tCerSrv06 "Class heater power diagnosis sensor 1 bank 1 / Actual temperature sensor for service 06" UWORD temp_q0p0234_o273 1 100 -273.150 1262.827 FORMAT "%8.3" ECU_ADDRESS 0x60001278 /end MEASUREMENT
/begin MEASUREMENT UEGO_HeatrCtrlDiagClassS1B1.tCerStrtDiagSrv06 "Class heater power diagnosis sensor 1 bank 1 / Temperature sensor in case of error from start diagnosis for service 06" UWORD temp_q0p0234_o273 1 100 -273.150 1262.827 FORMAT "%8.3" ECU_ADDRESS 0x6000127A /end MEASUREMENT
/begin MEASUREMENT UEGO_HeatrCtrlDiagClassS1B1.tCerStrtDiagSrv06Suspc "Class heater power diagnosis sensor 1 bank 1 / Sondentemperatur zum Zeitpunkt des Setztens eines Fehlerverdachtes" UWORD temp_q0p0234_o273 1 100 -273.150 1262.827 FORMAT "%8.3" ECU_ADDRESS 0x6000127C /end MEASUREMENT
/begin MEASUREMENT UEGO_HeatrCtrlDiagClassS1B1.tiHeatg "Class heater power diagnosis sensor 1 bank 1 / time in which is heated while waiting for valid clock" ULONG t_q0p1 1 100 0.00 429496729.500 FORMAT "%13.3" ECU_ADDRESS 0x60001280 /end MEASUREMENT
/begin MEASUREMENT UEGO_HeatrCtrlDiagClassS1B1.tiHeatrOff "Class heater power diagnosis sensor 1 bank 1 / Heater-off-time" ULONG t_q0p1 1 100 0.00 429496729.500 FORMAT "%13.3" ECU_ADDRESS 0x60036284 /end MEASUREMENT
/begin MEASUREMENT UEGO_HeatrCtrlDiagClassS1B1.tiPrmntDiagCmpl "Class heater power diagnosis sensor 1 bank 1 / Permanent diagnosis counter for diagnosis time elapsed" UWORD t_q0p1 1 100 0.00 6553.500 FORMAT "%8.3" ECU_ADDRESS 0x60001284 /end MEASUREMENT
/begin MEASUREMENT UEGO_HeatrCtrlDiagClassS1B1.tiPrmntDiagDurn "Class heater power diagnosis sensor 1 bank 1 / Permanent diagnosis counter for error result time elapsed" UWORD t_q0p1 1 100 0.00 6553.500 FORMAT "%8.3" ECU_ADDRESS 0x60001286 /end MEASUREMENT
/begin MEASUREMENT UEGO_HeatrCtrlDiagClassS1B1.tiStampHeatrOff "Class heater power diagnosis sensor 1 bank 1 / Time stamp heater off" ULONG Time_sec_q1_COMPU 1 100 0.00 4294967295.00 FORMAT "%13.2" ECU_ADDRESS 0x60036288 /end MEASUREMENT
/begin MEASUREMENT UEGO_HeatrCtrlDiagClassS1B1.tiStampHeatrOffTmp "Class heater power diagnosis sensor 1 bank 1 / temporary time stamp heater off" ULONG Time_sec_q1_COMPU 1 100 0.00 4294967295.00 FORMAT "%13.2" ECU_ADDRESS 0x60001288 /end MEASUREMENT
/begin MEASUREMENT UEGO_HeatrCtrlDiagClassS1B1.tiStampHeatrOn "Class heater power diagnosis sensor 1 bank 1 / Time stamp heater on" ULONG Time_sec_q1_COMPU 1 100 0.00 4294967295.00 FORMAT "%13.2" ECU_ADDRESS 0x6000128C /end MEASUREMENT
/begin MEASUREMENT UEGO_HeatrCtrlDiagClassS1B1.tiStrtDiagDurn "Class heater power diagnosis sensor 1 bank 1 / Start diagnosis counter for diagnosis time elapsed" UWORD t_q0p1 1 100 0.00 6553.500 FORMAT "%8.3" ECU_ADDRESS 0x60001290 /end MEASUREMENT
/begin MEASUREMENT UEGO_HeatrCtrlDiagClassS1B1.tiStrtDiagDurnCalcd "Class heater power diagnosis sensor 1 bank 1 / Duration of Start Diagnosis calculated depending on battery voltage" UWORD t_q0p1 1 100 0.00 6553.500 FORMAT "%8.3" ECU_ADDRESS 0x60001292 /end MEASUREMENT
/begin MEASUREMENT UEGO_HeatrCtrlDiagClassS1B1.tiWrgSysCdn "Class heater power diagnosis sensor 1 bank 1 / Start diagnosis counter time elapsed in case of bad environment conditions" UWORD t_q0p1 1 100 0.00 6553.500 FORMAT "%8.3" ECU_ADDRESS 0x60001294 /end MEASUREMENT
/begin MEASUREMENT UEGO_HeatrCtrlDiagClassS1B1.flgAllVlvActvTOFFV_I.outbit "Class heater power diagnosis sensor 1 bank 1 / turn off delay for injection valvs / Output Bit" UBYTE B_TRUE 1 100 0.00 1.00000000000 BIT_MASK 0x1 FORMAT "%13.11" ECU_ADDRESS 0x60001296 /end MEASUREMENT
/begin MEASUREMENT UEGO_HeatrCtrlDiagClassS1B1.flgAllVlvActvTOFFV_I.time "Class heater power diagnosis sensor 1 bank 1 / turn off delay for injection valvs / Occured Time" UWORD t_q0p1 1 100 0.00 6553.500 FORMAT "%8.3" ECU_ADDRESS 0x60001298 /end MEASUREMENT
/begin MEASUREMENT UEGO_HeatrCtrlDiagClassS1B1.flgEngActvStsEFNM_I.oldSignal "Class heater power diagnosis sensor 1 bank 1 / falling edge flgEngActvSts / memory to detect falling edge" UBYTE B_TRUE 1 100 0.00 1.00000000000 BIT_MASK 0x1 FORMAT "%13.11" ECU_ADDRESS 0x6000129A /end MEASUREMENT
/begin MEASUREMENT UEGO_HeatrCtrlDiagClassS1B1.flgFctDemTstrFF_I.status "Class heater power diagnosis sensor 1 bank 1 / SR flip flop delay function demand tester / current value of RS-FF" UBYTE B_TRUE 1 100 0.00 1.00000000000 BIT_MASK 0x1 FORMAT "%13.11" ECU_ADDRESS 0x6000129B /end MEASUREMENT
/begin MEASUREMENT UEGO_HeatrCtrlDiagClassS1B1.flgFctDemTstrTONV_I.outbit "Class heater power diagnosis sensor 1 bank 1 / turn on delay function demand tester / return value" UBYTE B_TRUE 1 100 0.00 1.00000000000 BIT_MASK 0x1 FORMAT "%13.11" ECU_ADDRESS 0x6000129C /end MEASUREMENT
/begin MEASUREMENT UEGO_HeatrCtrlDiagClassS1B1.flgFctDemTstrTONV_I.time "Class heater power diagnosis sensor 1 bank 1 / turn on delay function demand tester / expired delay time" UBYTE t_q0p1 1 100 0.00 25.50 FORMAT "%5.2" ECU_ADDRESS 0x6000129D /end MEASUREMENT
/begin MEASUREMENT UEGO_HeatrCtrlDiagClassS1B1.flgHeatrStrtdERNM_I.oldSignal "Class heater power diagnosis sensor 1 bank 1 / Flag heater start edge rising / value of input signal last calculation" UBYTE B_TRUE 1 100 0.00 1.00000000000 BIT_MASK 0x1 FORMAT "%13.11" ECU_ADDRESS 0x6003472E /end MEASUREMENT
/begin MEASUREMENT UEGO_HeatrCtrlDiagClassS1B1.flgHtrCtlActvTONV_I.outbit "Class heater power diagnosis sensor 1 bank 1 / turn on delay heater control active / return value" UBYTE B_TRUE 1 100 0.00 1.00000000000 BIT_MASK 0x1 FORMAT "%13.11" ECU_ADDRESS 0x6000129E /end MEASUREMENT
/begin MEASUREMENT UEGO_HeatrCtrlDiagClassS1B1.flgHtrCtlActvTONV_I.time "Class heater power diagnosis sensor 1 bank 1 / turn on delay heater control active / expired delay time" UWORD t_q0p1 1 100 0.00 6553.500 FORMAT "%8.3" ECU_ADDRESS 0x600012A0 /end MEASUREMENT
/begin MEASUREMENT UEGO_HeatrCtrlDiagClassS1B1.flgLoDiagErrERNM_I.oldSignal "Class heater power diagnosis sensor 1 bank 1 / steigende Flanke Low - Temperature Diagnosis Fehler / value of input signal last calculation" UBYTE B_TRUE 1 100 0.00 1.00000000000 BIT_MASK 0x1 FORMAT "%13.11" ECU_ADDRESS 0x600012A2 /end MEASUREMENT
/begin MEASUREMENT UEGO_HeatrCtrlDiagClassS1B1.flgLoDiagErrTONVNM_I.time "Class heater power diagnosis sensor 1 bank 1 / turn on delay low diagnosis error / Delay Time" UWORD t_q0p1 1 100 0.00 6553.500 FORMAT "%8.3" ECU_ADDRESS 0x600012A4 /end MEASUREMENT
/begin MEASUREMENT UEGO_HeatrCtrlDiagClassS1B1.flgOperRelsEFNM_I.oldSignal "Class heater power diagnosis sensor 1 bank 1 / Falling edge of operation release / memory to detect falling edge" UBYTE B_TRUE 1 100 0.00 1.00000000000 BIT_MASK 0x1 FORMAT "%13.11" ECU_ADDRESS 0x6003472F /end MEASUREMENT
/begin MEASUREMENT UEGO_HeatrCtrlDiagClassS1B1.flgOperRelsERNM_I.oldSignal "Class heater power diagnosis sensor 1 bank 1 / Rising edge flgOperRels / value of input signal last calculation" UBYTE B_TRUE 1 100 0.00 1.00000000000 BIT_MASK 0x1 FORMAT "%13.11" ECU_ADDRESS 0x600012A6 /end MEASUREMENT
/begin MEASUREMENT UEGO_HeatrCtrlDiagClassS1B1.flgOvrRunLoTempTOFFV_I.outbit "Class heater power diagnosis sensor 1 bank 1 / turn off delay low temp due to overrun / Output Bit" UBYTE B_TRUE 1 100 0.00 1.00000000000 BIT_MASK 0x1 FORMAT "%13.11" ECU_ADDRESS 0x600012A8 /end MEASUREMENT
/begin MEASUREMENT UEGO_HeatrCtrlDiagClassS1B1.flgOvrRunLoTempTOFFV_I.time "Class heater power diagnosis sensor 1 bank 1 / turn off delay low temp due to overrun / Occured Time" UWORD t_q0p1 1 100 0.00 6553.500 FORMAT "%8.3" ECU_ADDRESS 0x600012AA /end MEASUREMENT
/begin MEASUREMENT UEGO_HeatrCtrlDiagClassS1B1.flgOvrRunTOFFV_I.outbit "Class heater power diagnosis sensor 1 bank 1 / Turn off delay for flgOvrRun / Output Bit" UBYTE B_TRUE 1 100 0.00 1.00000000000 BIT_MASK 0x1 FORMAT "%13.11" ECU_ADDRESS 0x600012AC /end MEASUREMENT
/begin MEASUREMENT UEGO_HeatrCtrlDiagClassS1B1.flgOvrRunTOFFV_I.time "Class heater power diagnosis sensor 1 bank 1 / Turn off delay for flgOvrRun / Occured Time" UWORD t_q0p1 1 100 0.00 6553.500 FORMAT "%8.3" ECU_ADDRESS 0x600012AE /end MEASUREMENT
/begin MEASUREMENT UEGO_HeatrCtrlDiagClassS1B1.flgOvrRunTONV_I.outbit "Class heater power diagnosis sensor 1 bank 1 / overrun turn on delay / return value" UBYTE B_TRUE 1 100 0.00 1.00000000000 BIT_MASK 0x1 FORMAT "%13.11" ECU_ADDRESS 0x600012B0 /end MEASUREMENT
/begin MEASUREMENT UEGO_HeatrCtrlDiagClassS1B1.flgOvrRunTONV_I.time "Class heater power diagnosis sensor 1 bank 1 / overrun turn on delay / expired delay time" UWORD t_q0p1 1 100 0.00 6553.500 FORMAT "%8.3" ECU_ADDRESS 0x600012B2 /end MEASUREMENT
/begin MEASUREMENT UEGO_HeatrCtrlDiagClassS1B1.flgPasHeatgDiTONVNM_I.time "Class heater power diagnosis sensor 1 bank 1 / turn on delay passive heating error / Delay Time" UWORD t_q0p1 1 100 0.00 6553.500 FORMAT "%8.3" ECU_ADDRESS 0x600012B4 /end MEASUREMENT
/begin MEASUREMENT UEGO_HeatrCtrlDiagClassS1B1.flgPasHeatgTONVNM_I.time "Class heater power diagnosis sensor 1 bank 1 / turn on delay passive heating / Delay Time" UWORD t_q0p1 1 100 0.00 6553.500 FORMAT "%8.3" ECU_ADDRESS 0x600012B6 /end MEASUREMENT
/begin MEASUREMENT UEGO_HeatrCtrlDiagClassS1B1.flgPrmntDiagErrERNM_I.oldSignal "Class heater power diagnosis sensor 1 bank 1 / Edge rising for permeanent diag duration / value of input signal last calculation" UBYTE B_TRUE 1 100 0.00 1.00000000000 BIT_MASK 0x1 FORMAT "%13.11" ECU_ADDRESS 0x600012B8 /end MEASUREMENT
/begin MEASUREMENT UEGO_HeatrCtrlDiagClassS1B1.flgPrmntDiagHealSuspcERNM_I.oldSignal "Class heater power diagnosis sensor 1 bank 1 / permanent diagnosis healing suspicion Edge Rising No Memory / value of input signal last calculation" UBYTE B_TRUE 1 100 0.00 1.00000000000 BIT_MASK 0x1 FORMAT "%13.11" ECU_ADDRESS 0x600012B9 /end MEASUREMENT
/begin MEASUREMENT UEGO_HeatrCtrlDiagClassS1B1.flgPrmntDiagHealTONVNM_I.time "Class heater power diagnosis sensor 1 bank 1 / turn on delay perm diag heal / Delay Time" UWORD t_q0p1 1 100 0.00 6553.500 FORMAT "%8.3" ECU_ADDRESS 0x600012BA /end MEASUREMENT
/begin MEASUREMENT UEGO_HeatrCtrlDiagClassS1B1.flgSnsrRdyTONV_I.outbit "Class heater power diagnosis sensor 1 bank 1 / turn on delay sensor ready / return value" UBYTE B_TRUE 1 100 0.00 1.00000000000 BIT_MASK 0x1 FORMAT "%13.11" ECU_ADDRESS 0x600012BC /end MEASUREMENT
/begin MEASUREMENT UEGO_HeatrCtrlDiagClassS1B1.flgSnsrRdyTONV_I.time "Class heater power diagnosis sensor 1 bank 1 / turn on delay sensor ready / expired delay time" UWORD t_q0p1 1 100 0.00 6553.500 FORMAT "%8.3" ECU_ADDRESS 0x600012BE /end MEASUREMENT
/begin MEASUREMENT UEGO_HeatrCtrlDiagClassS1B1.flgStrtDiagErrERNM_I.oldSignal "Class heater power diagnosis sensor 1 bank 1 / Edge rising of flgStrtDiagErr / value of input signal last calculation" UBYTE B_TRUE 1 100 0.00 1.00000000000 BIT_MASK 0x1 FORMAT "%13.11" ECU_ADDRESS 0x600012C0 /end MEASUREMENT
/begin MEASUREMENT UEGO_HeatrCtrlDiagClassS1B1.flgStrtDiagErrSuspcERNM_I.oldSignal "Class heater power diagnosis sensor 1 bank 1 / ERNM error suspicion start diagnosis / value of input signal last calculation" UBYTE B_TRUE 1 100 0.00 1.00000000000 BIT_MASK 0x1 FORMAT "%13.11" ECU_ADDRESS 0x600012C1 /end MEASUREMENT
/begin MEASUREMENT UEGO_HeatrCtrlDiagClassS1B1.flgStrtDiagHealERNM_I.oldSignal "Class heater power diagnosis sensor 1 bank 1 / Edge rising of flgStrtDiagHeal / value of input signal last calculation" UBYTE B_TRUE 1 100 0.00 1.00000000000 BIT_MASK 0x1 FORMAT "%13.11" ECU_ADDRESS 0x600012C2 /end MEASUREMENT
/begin MEASUREMENT UEGO_HeatrCtrlDiagClassS1B1.flgStrtDiagNoResEFNM_I.oldSignal "Class heater power diagnosis sensor 1 bank 1 / Flag start diagnosis no release edge falling / memory to detect falling edge" UBYTE B_TRUE 1 100 0.00 1.00000000000 BIT_MASK 0x1 FORMAT "%13.11" ECU_ADDRESS 0x600012C3 /end MEASUREMENT
/begin MEASUREMENT UEGO_HeatrCtrlDiagClassS1B1.flgStrtDiagStrtdER_I.buffer "Class heater power diagnosis sensor 1 bank 1 / EdgeRising StartDiag / rising edge detected" UBYTE B_TRUE 1 100 0.00 1.00000000000 BIT_MASK 0x1 FORMAT "%13.11" ECU_ADDRESS 0x600012C4 /end MEASUREMENT
/begin MEASUREMENT UEGO_HeatrCtrlDiagClassS1B1.flgStrtDiagStrtdER_I.oldSignal "Class heater power diagnosis sensor 1 bank 1 / EdgeRising StartDiag / flag rising edge" UBYTE B_TRUE 1 100 0.00 1.00000000000 BIT_MASK 0x1 FORMAT "%13.11" ECU_ADDRESS 0x600012C5 /end MEASUREMENT
/begin MEASUREMENT UEGO_HeatrCtrlDiagClassS1B1.tCerTONV_I.outbit "Class heater power diagnosis sensor 1 bank 1 / turn on delay for sensor temperature above min temp. / return value" UBYTE B_TRUE 1 100 0.00 1.00000000000 BIT_MASK 0x1 FORMAT "%13.11" ECU_ADDRESS 0x600012C6 /end MEASUREMENT
/begin MEASUREMENT UEGO_HeatrCtrlDiagClassS1B1.tCerTONV_I.time "Class heater power diagnosis sensor 1 bank 1 / turn on delay for sensor temperature above min temp. / expired delay time" UWORD t_q0p1 1 100 0.00 6553.500 FORMAT "%8.3" ECU_ADDRESS 0x600012C8 /end MEASUREMENT
/begin MEASUREMENT UEGO_HeatrCtrlDiagClassS1B1.tiDlyPrmntDiagTONVNM_I.time "Class heater power diagnosis sensor 1 bank 1 / turn on delay for permanent diag heal / Delay Time" UWORD t_q0p1 1 100 0.00 6553.500 FORMAT "%8.3" ECU_ADDRESS 0x600012CA /end MEASUREMENT
/begin MEASUREMENT UEGO_HeatrCtrlDiagClassS1B1.tiStrtDiagDurnA_I.memory "Class heater power diagnosis sensor 1 bank 1 / Accumulator StartDiag / Accumulator" SLONG t_q0p001 1 100 -2147483.64800 2147483.64700 FORMAT "%13.5" ECU_ADDRESS 0x600012CC /end MEASUREMENT
/begin MEASUREMENT UEGO_HeatrCtrlDiagClassS1B1.uBattFilLT_I.memory "Class heater power diagnosis sensor 1 bank 1 / battery voltage low pass filter / current lowpass value" SLONG spg_q3p05Em4_mV 1 100 -655370.000153 655369.999847 FORMAT "%13.6" ECU_ADDRESS 0x600012D0 /end MEASUREMENT
/begin MEASUREMENT UEGO_HeatrPSCtrlS1B1_I.ratReqd "Class Heater Power Stage Control Sensor 1 Bank 1 / Duty Cycle requested for LSU heater powerstage" UWORD rel_q0p003052 1 100 0.00 199.9969 FORMAT "%8.4" ECU_ADDRESS 0x60003464 /end MEASUREMENT
/begin MEASUREMENT UEGO_HeatrPsDiagS1B1_I.cntrReiniProc100ms "Class Diagnosis Powerstage Heater LSU Sensor 1 Bank 1 / Counter of decentralized ReIni processes" UBYTE OneToOne 1 100 0.00 255.0 FORMAT "%5.1" ECU_ADDRESS 0x5000226A /end MEASUREMENT
/begin MEASUREMENT UEGO_HeatrPsDiagS1B1_I.flgDSMClrReq "Class Diagnosis Powerstage Heater LSU Sensor 1 Bank 1 / Request to clear the fault memory" UBYTE B_TRUE 1 100 0.00 1.00000000000 BIT_MASK 0x1 FORMAT "%13.11" ECU_ADDRESS 0x5000226B /end MEASUREMENT
/begin MEASUREMENT UEGO_HeatrPsDiagS1B1_I.flgDiagRels "Class Diagnosis Powerstage Heater LSU Sensor 1 Bank 1 / Release heater power stage diagnosis LSU heater" UBYTE B_TRUE 1 100 0.00 1.00000000000 BIT_MASK 0x1 FORMAT "%13.11" ECU_ADDRESS 0x50002268 /end MEASUREMENT
/begin MEASUREMENT UEGO_HeatrPsDiagS1B1_I.flgErrOL "Class Diagnosis Powerstage Heater LSU Sensor 1 Bank 1 / Signal fault power stage LSU heater, open line (OL)" UBYTE B_TRUE 1 100 0.00 1.00000000000 BIT_MASK 0x4 FORMAT "%13.11" ECU_ADDRESS 0x50002268 /end MEASUREMENT
/begin MEASUREMENT UEGO_HeatrPsDiagS1B1_I.flgErrOLRaw "Class Diagnosis Powerstage Heater LSU Sensor 1 Bank 1 / Raw Signal fault power stage LSU heater, open line (OL)" UBYTE B_TRUE 1 100 0.00 1.00000000000 BIT_MASK 0x1 FORMAT "%13.11" ECU_ADDRESS 0x50002269 /end MEASUREMENT
/begin MEASUREMENT UEGO_HeatrPsDiagS1B1_I.flgErrSCB "Class Diagnosis Powerstage Heater LSU Sensor 1 Bank 1 / Max fault power stage LSU heater, short circuit to battery (SCB)" UBYTE B_TRUE 1 100 0.00 1.00000000000 BIT_MASK 0x2 FORMAT "%13.11" ECU_ADDRESS 0x50002268 /end MEASUREMENT
/begin MEASUREMENT UEGO_HeatrPsDiagS1B1_I.flgErrSCBRaw "Class Diagnosis Powerstage Heater LSU Sensor 1 Bank 1 / Raw Max fault power stage LSU heater, short circuit to battery (SCB)" UBYTE B_TRUE 1 100 0.00 1.00000000000 BIT_MASK 0x2 FORMAT "%13.11" ECU_ADDRESS 0x50002269 /end MEASUREMENT
/begin MEASUREMENT UEGO_HeatrPsDiagS1B1_I.flgErrSCG "Class Diagnosis Powerstage Heater LSU Sensor 1 Bank 1 / Min fault power stage LSU heater, short circuit to ground (SCG)" UBYTE B_TRUE 1 100 0.00 1.00000000000 BIT_MASK 0x8 FORMAT "%13.11" ECU_ADDRESS 0x50002268 /end MEASUREMENT
/begin MEASUREMENT UEGO_HeatrPsDiagS1B1_I.flgErrSCGRaw "Class Diagnosis Powerstage Heater LSU Sensor 1 Bank 1 / Raw Min fault power stage LSU heater, short circuit to ground (SCG)" UBYTE B_TRUE 1 100 0.00 1.00000000000 BIT_MASK 0x4 FORMAT "%13.11" ECU_ADDRESS 0x50002269 /end MEASUREMENT
/begin MEASUREMENT UEGO_HeatrPsDiagS1B1_I.flgHeatrPsErr "Class Diagnosis Powerstage Heater LSU Sensor 1 Bank 1 / Sum error power stage heater" UBYTE B_TRUE 1 100 0.00 1.00000000000 BIT_MASK 0x20 FORMAT "%13.11" ECU_ADDRESS 0x50002268 /end MEASUREMENT
/begin MEASUREMENT UEGO_HeatrPsDiagS1B1_I.flgIniEnd "Class Diagnosis Powerstage Heater LSU Sensor 1 Bank 1 / Initialisation diagnosis powerstage LSU heater finished" UBYTE B_TRUE 1 100 0.00 1.00000000000 BIT_MASK 0x10 FORMAT "%13.11" ECU_ADDRESS 0x50002268 /end MEASUREMENT
/begin MEASUREMENT UEGO_HeatrPsDiagS1B1_I.stErrInfo "Class Diagnosis Powerstage Heater LSU Sensor 1 Bank 1 / Status diagnosis power stage heater" ULONG OneToOne 1 100 0.00 4294967295.00 FORMAT "%13.2" ECU_ADDRESS 0x5000226C /end MEASUREMENT
/begin MEASUREMENT UEGO_HtrCtlS1B1_I.cntrReiniProc20msec "heater control sensor 1 bank 1 / counter of interrupted postdrives in 20ms proc" UBYTE OneToOne 1 100 0.00 255.0 FORMAT "%5.1" ECU_ADDRESS 0x50002272 /end MEASUREMENT
/begin MEASUREMENT UEGO_HtrCtlS1B1_I.flgCLActv "heater control sensor 1 bank 1 / Close-Loop active" UBYTE B_TRUE 1 100 0.00 1.00000000000 BIT_MASK 0x2 FORMAT "%13.11" ECU_ADDRESS 0x50002270 /end MEASUREMENT
/begin MEASUREMENT UEGO_HtrCtlS1B1_I.flgCtlCLLimd "heater control sensor 1 bank 1 / Close-Loop controler limited" UBYTE B_TRUE 1 100 0.00 1.00000000000 BIT_MASK 0x1 FORMAT "%13.11" ECU_ADDRESS 0x50002273 /end MEASUREMENT
/begin MEASUREMENT UEGO_HtrCtlS1B1_I.flgCtrldModActv "heater control sensor 1 bank 1 / heater control, controlled mode activ" UBYTE B_TRUE 1 100 0.00 1.00000000000 BIT_MASK 0x1 FORMAT "%13.11" ECU_ADDRESS 0x50002274 /end MEASUREMENT
/begin MEASUREMENT UEGO_HtrCtlS1B1_I.flgElecPwrHi "heater control sensor 1 bank 1 / increased heater power demand" UBYTE B_TRUE 1 100 0.00 1.00000000000 BIT_MASK 0x80 FORMAT "%13.11" ECU_ADDRESS 0x50002271 /end MEASUREMENT
/begin MEASUREMENT UEGO_HtrCtlS1B1_I.flgErrModActv "heater control sensor 1 bank 1 / Error mode activ" UBYTE B_TRUE 1 100 0.00 1.00000000000 BIT_MASK 0x80 FORMAT "%13.11" ECU_ADDRESS 0x50002270 /end MEASUREMENT
/begin MEASUREMENT UEGO_HtrCtlS1B1_I.flgOLActv "heater control sensor 1 bank 1 / Open-Loop acitve" UBYTE B_TRUE 1 100 0.00 1.00000000000 BIT_MASK 0x40 FORMAT "%13.11" ECU_ADDRESS 0x50002270 /end MEASUREMENT
/begin MEASUREMENT UEGO_HtrCtlS1B1_I.flgOLCrvFinshd "heater control sensor 1 bank 1 / Open-Loop curve phase finished" UBYTE B_TRUE 1 100 0.00 1.00000000000 BIT_MASK 0x4 FORMAT "%13.11" ECU_ADDRESS 0x50002270 /end MEASUREMENT
/begin MEASUREMENT UEGO_HtrCtlS1B1_I.flgOLEna "heater control sensor 1 bank 1 / Open-Loop released" UBYTE B_TRUE 1 100 0.00 1.00000000000 BIT_MASK 0x10 FORMAT "%13.11" ECU_ADDRESS 0x50002270 /end MEASUREMENT
/begin MEASUREMENT UEGO_HtrCtlS1B1_I.flgOLHldFinshd "heater control sensor 1 bank 1 / Open-Loop hold phase finished" UBYTE B_TRUE 1 100 0.00 1.00000000000 BIT_MASK 0x8 FORMAT "%13.11" ECU_ADDRESS 0x50002270 /end MEASUREMENT
/begin MEASUREMENT UEGO_HtrCtlS1B1_I.flgOLRampFinshd "heater control sensor 1 bank 1 / Open-Loop ramp phase finished" UBYTE B_TRUE 1 100 0.00 1.00000000000 BIT_MASK 0x1 FORMAT "%13.11" ECU_ADDRESS 0x50002271 /end MEASUREMENT
/begin MEASUREMENT UEGO_HtrCtlS1B1_I.flgProtdModActv "heater control sensor 1 bank 1 / Protected mode active" UBYTE B_TRUE 1 100 0.00 1.00000000000 BIT_MASK 0x10 FORMAT "%13.11" ECU_ADDRESS 0x50002271 /end MEASUREMENT
/begin MEASUREMENT UEGO_HtrCtlS1B1_I.flgSnsrHot "heater control sensor 1 bank 1 / delay time after heating up phase until sensor is respected as hot" UBYTE B_TRUE 1 100 0.00 1.00000000000 BIT_MASK 0x40 FORMAT "%13.11" ECU_ADDRESS 0x50002271 /end MEASUREMENT
/begin MEASUREMENT UEGO_HtrCtlS1B1_I.flgStopIntgl "heater control sensor 1 bank 1 / integral part of heater control stopped" UBYTE B_TRUE 1 100 0.00 1.00000000000 BIT_MASK 0x1 FORMAT "%13.11" ECU_ADDRESS 0x50002270 /end MEASUREMENT
/begin MEASUREMENT UEGO_HtrCtlS1B1_I.flgTDsbc "heater control sensor 1 bank 1 / temperature disturbance present" UBYTE B_TRUE 1 100 0.00 1.00000000000 BIT_MASK 0x20 FORMAT "%13.11" ECU_ADDRESS 0x50002270 /end MEASUREMENT
/begin MEASUREMENT UEGO_HtrCtlS1B1_I.tDvtCLOld "heater control sensor 1 bank 1 / control deviation last cycle (for D-part)" SWORD temp_q0p0234 1 100 -768.0000 767.9766 FORMAT "%8.4" ECU_ADDRESS 0x50002276 /end MEASUREMENT
/begin MEASUREMENT UEGO_HtrCtlS1B1_I.uCtl "heater control sensor 1 bank 1 / Heater control output voltage" UWORD spg_q0p005 1 100 0.00 327.6750 FORMAT "%8.4" ECU_ADDRESS 0x50002278 /end MEASUREMENT
/begin MEASUREMENT UEGO_HtrCtlS1B1_I.uCtlCL "heater control sensor 1 bank 1 / Close-Loop output voltage" UWORD spg_q0p005 1 100 0.00 327.6750 FORMAT "%8.4" ECU_ADDRESS 0x5000227A /end MEASUREMENT
/begin MEASUREMENT UEGO_HtrCtlS1B1_I.uCtlCLD "heater control sensor 1 bank 1 / D-part of heater control" SWORD spg_q0p005 1 100 -163.8400 163.8350 FORMAT "%8.4" ECU_ADDRESS 0x5000227C /end MEASUREMENT
/begin MEASUREMENT UEGO_HtrCtlS1B1_I.uCtlCLI "heater control sensor 1 bank 1 / I-part of heater control" UWORD spg_q0p005 1 100 0.00 327.6750 FORMAT "%8.4" ECU_ADDRESS 0x5000227E /end MEASUREMENT
/begin MEASUREMENT UEGO_HtrCtlS1B1_I.uCtlCLP "heater control sensor 1 bank 1 / P-part of heater control" SWORD spg_q0p005 1 100 -163.8400 163.8350 FORMAT "%8.4" ECU_ADDRESS 0x50002280 /end MEASUREMENT
/begin MEASUREMENT UEGO_HtrCtlS1B1_I.uCtlCLTot "heater control sensor 1 bank 1 / unlimited voltage of heater control" UWORD spg_q0p005 1 100 0.00 327.6750 FORMAT "%8.4" ECU_ADDRESS 0x50002282 /end MEASUREMENT
/begin MEASUREMENT UEGO_HtrCtlS1B1_I.uCtlOL "heater control sensor 1 bank 1 / Open-Loop output voltage" UWORD spg_q0p005 1 100 0.00 327.6750 FORMAT "%8.4" ECU_ADDRESS 0x50002284 /end MEASUREMENT
/begin MEASUREMENT UEGO_HtrCtlS1B1_I.CtrlCLIntglITL_I.memory "heater control sensor 1 bank 1 / integral of heater control I-part / current integrator value" ULONG fak_uw_b0p005 1 100 0.00 327.679999924 FORMAT "%13.9" ECU_ADDRESS 0x50002288 /end MEASUREMENT
/begin MEASUREMENT UEGO_HtrCtlS1B1_I.DlyElecPwrHiTONV_I.outbit "heater control sensor 1 bank 1 / Delaytime increased heater power demand / return value" UBYTE B_TRUE 1 100 0.00 1.00000000000 BIT_MASK 0x1 FORMAT "%13.11" ECU_ADDRESS 0x5000228C /end MEASUREMENT
/begin MEASUREMENT UEGO_HtrCtlS1B1_I.DlyElecPwrHiTONV_I.time "heater control sensor 1 bank 1 / Delaytime increased heater power demand / expired delay time" UWORD t_q0p02 1 100 0.00 1310.700 FORMAT "%8.3" ECU_ADDRESS 0x5000228E /end MEASUREMENT
/begin MEASUREMENT UEGO_HtrCtlS1B1_I.HeatgUpFinshdFF_I.status "heater control sensor 1 bank 1 / flip flop heating up finished / current value of RS-FF" UBYTE B_TRUE 1 100 0.00 1.00000000000 BIT_MASK 0x1 FORMAT "%13.11" ECU_ADDRESS 0x50002290 /end MEASUREMENT
/begin MEASUREMENT UEGO_HtrCtlS1B1_I.OLEndedTONV_I.outbit "heater control sensor 1 bank 1 / End of heater open loop mode delayed / return value" UBYTE B_TRUE 1 100 0.00 1.00000000000 BIT_MASK 0x1 FORMAT "%13.11" ECU_ADDRESS 0x50002292 /end MEASUREMENT
/begin MEASUREMENT UEGO_HtrCtlS1B1_I.OLEndedTONV_I.time "heater control sensor 1 bank 1 / End of heater open loop mode delayed / expired delay time" UWORD t_q0p02 1 100 0.00 1310.700 FORMAT "%8.3" ECU_ADDRESS 0x50002294 /end MEASUREMENT
/begin MEASUREMENT UEGO_HtrCtlS1B1_I.SwitchOverFF_I.status "heater control sensor 1 bank 1 / RS-FlipFlopp SwitchOver / current value of RS-FF" UBYTE B_TRUE 1 100 0.00 1.00000000000 BIT_MASK 0x1 FORMAT "%13.11" ECU_ADDRESS 0x50002296 /end MEASUREMENT
/begin MEASUREMENT UEGO_HtrCtlS1B1_I.bHtrCtlCLActvER_I.buffer "heater control sensor 1 bank 1 / trigger for start of closed loop heater control / rising edge detected" UBYTE B_TRUE 1 100 0.00 1.00000000000 BIT_MASK 0x1 FORMAT "%13.11" ECU_ADDRESS 0x50002298 /end MEASUREMENT
/begin MEASUREMENT UEGO_HtrCtlS1B1_I.bHtrCtlCLActvER_I.oldSignal "heater control sensor 1 bank 1 / trigger for start of closed loop heater control / flag rising edge" UBYTE B_TRUE 1 100 0.00 1.00000000000 BIT_MASK 0x1 FORMAT "%13.11" ECU_ADDRESS 0x50002299 /end MEASUREMENT
/begin MEASUREMENT UEGO_HtrCtlS1B1_I.flgHeatgUpFinshdTONV_I.outbit "heater control sensor 1 bank 1 / End heater ramp delayed / return value" UBYTE B_TRUE 1 100 0.00 1.00000000000 BIT_MASK 0x1 FORMAT "%13.11" ECU_ADDRESS 0x5000229A /end MEASUREMENT
/begin MEASUREMENT UEGO_HtrCtlS1B1_I.flgHeatgUpFinshdTONV_I.time "heater control sensor 1 bank 1 / End heater ramp delayed / expired delay time" UWORD t_q0p02 1 100 0.00 1310.700 FORMAT "%8.3" ECU_ADDRESS 0x5000229C /end MEASUREMENT
/begin MEASUREMENT UEGO_HtrCtlS1B1_I.flgOLActvER_I.buffer "heater control sensor 1 bank 1 / ER for flgOLActv / rising edge detected" UBYTE B_TRUE 1 100 0.00 1.00000000000 BIT_MASK 0x1 FORMAT "%13.11" ECU_ADDRESS 0x5000229E /end MEASUREMENT
/begin MEASUREMENT UEGO_HtrCtlS1B1_I.flgOLActvER_I.oldSignal "heater control sensor 1 bank 1 / ER for flgOLActv / flag rising edge" UBYTE B_TRUE 1 100 0.00 1.00000000000 BIT_MASK 0x1 FORMAT "%13.11" ECU_ADDRESS 0x5000229F /end MEASUREMENT
/begin MEASUREMENT UEGO_HtrCtlS1B1_I.flgOLCrvFinshdER_I.buffer "heater control sensor 1 bank 1 / Edge Rising Open-Loop curve phase finished / rising edge detected" UBYTE B_TRUE 1 100 0.00 1.00000000000 BIT_MASK 0x1 FORMAT "%13.11" ECU_ADDRESS 0x500022A0 /end MEASUREMENT
/begin MEASUREMENT UEGO_HtrCtlS1B1_I.flgOLCrvFinshdER_I.oldSignal "heater control sensor 1 bank 1 / Edge Rising Open-Loop curve phase finished / flag rising edge" UBYTE B_TRUE 1 100 0.00 1.00000000000 BIT_MASK 0x1 FORMAT "%13.11" ECU_ADDRESS 0x500022A1 /end MEASUREMENT
/begin MEASUREMENT UEGO_HtrCtlS1B1_I.flgOLHldFinshdTONV_I.outbit "heater control sensor 1 bank 1 / TONV for flgOLHldFinshd / return value" UBYTE B_TRUE 1 100 0.00 1.00000000000 BIT_MASK 0x1 FORMAT "%13.11" ECU_ADDRESS 0x500022A2 /end MEASUREMENT
/begin MEASUREMENT UEGO_HtrCtlS1B1_I.flgOLHldFinshdTONV_I.time "heater control sensor 1 bank 1 / TONV for flgOLHldFinshd / expired delay time" UWORD t_q0p02 1 100 0.00 1310.700 FORMAT "%8.3" ECU_ADDRESS 0x500022A4 /end MEASUREMENT
/begin MEASUREMENT UEGO_HtrCtlS1B1_I.flgPSOffTONV_I.outbit "heater control sensor 1 bank 1 / turn off delay power stage switched off / return value" UBYTE B_TRUE 1 100 0.00 1.00000000000 BIT_MASK 0x1 FORMAT "%13.11" ECU_ADDRESS 0x500022A6 /end MEASUREMENT
/begin MEASUREMENT UEGO_HtrCtlS1B1_I.flgPSOffTONV_I.time "heater control sensor 1 bank 1 / turn off delay power stage switched off / expired delay time" UBYTE t_q0p02 1 100 0.00 5.100 FORMAT "%5.3" ECU_ADDRESS 0x500022A7 /end MEASUREMENT
/begin MEASUREMENT UEGO_HtrCtlS1B1_I.tiCurvePhaseSW_I.timeCounter "heater control sensor 1 bank 1 / timer of curve phase / expired time since start" UWORD t_q0p02 1 100 0.00 1310.700 FORMAT "%8.3" ECU_ADDRESS 0x500022A8 /end MEASUREMENT
/begin MEASUREMENT UEGO_HtrCtlS1B1_I.uHtrRampIT_I.memory "heater control sensor 1 bank 1 / integral of heater voltage at ramp phase / current integrator value" ULONG dez 1 100 0.00 4294967295.00 FORMAT "%13.2" ECU_ADDRESS 0x500022AC /end MEASUREMENT
/begin MEASUREMENT UEGO_idxTypS1B1 "sensor type sensor 1 bank 1" UBYTE dez 1 100 0.00 255.0 FORMAT "%5.1" ECU_ADDRESS 0x6000A002 /end MEASUREMENT
/begin MEASUREMENT UEGO_iIPmpPCorrdS1B1 "pressure-corrected pump current sensor 1 bank 1" SWORD i_q6p6667Em7_A 1 100 -0.02184533 0.02184467 FORMAT "%10.8" ECU_ADDRESS 0x70002CA4 /end MEASUREMENT
/begin MEASUREMENT UEGO_iIPmpPhyCorrdS1B1 "physically corrected pump current sensor 1 bank 1" SWORD i_q6p6667Em7_A 1 100 -0.02184533 0.02184467 FORMAT "%10.8" ECU_ADDRESS 0x60004EA6 /end MEASUREMENT
/begin MEASUREMENT UEGO_iIPmpPTCorrdS1B1 "pressure-corrected and temperature-corrected pump current sensor 1 bank 1" SWORD i_q6p6667Em7_A 1 100 -0.02184533 0.02184467 FORMAT "%10.8" ECU_ADDRESS 0x70002CA6 /end MEASUREMENT
/begin MEASUREMENT UEGO_iIPmpSrv1S1B1 "physically corrected pump current for tester sensor 1 bank 1" SWORD i_q1_uA 1 100 -32768.00 32767.00 FORMAT "%8.2" ECU_ADDRESS 0x70002CAE /end MEASUREMENT
/begin MEASUREMENT UEGO_IpPhysCorS1B1_I.UEGO_stO2PhyRels "physically corrected pump current sensor 1 bank 1 / status of bit list for physical O2 release condition" UBYTE OneToOne 1 100 0.00 127.0 FORMAT "%5.1" ECU_ADDRESS 0x500055D8 /end MEASUREMENT
/begin MEASUREMENT UEGO_IpPhysCorS1B1_I.facPCorrLean "physically corrected pump current sensor 1 bank 1 / Pressure correction factor for lean pump current" UWORD fak_uw_b2 1 100 0.00 1.999969 FORMAT "%8.6" ECU_ADDRESS 0x500055DA /end MEASUREMENT
/begin MEASUREMENT UEGO_IpPhysCorS1B1_I.facPCorrRich "physically corrected pump current sensor 1 bank 1 / Pressure correction factor for rich pump current" UWORD fak_uw_b2 1 100 0.00 1.999969 FORMAT "%8.6" ECU_ADDRESS 0x500055DC /end MEASUREMENT
/begin MEASUREMENT UEGO_IpPhysCorS1B1_I.facTCorr "physically corrected pump current sensor 1 bank 1 / Temperature correction factor for pump current" UWORD fak_uw_b2 1 100 0.00 1.999969 FORMAT "%8.6" ECU_ADDRESS 0x500055DE /end MEASUREMENT
/begin MEASUREMENT UEGO_IpPhysCorS1B1_I.iPmpElecCorrdIn "physically corrected pump current sensor 1 bank 1 / Dyanmic error simulation delay logic - Accumulated electrically correct pump current value." SWORD i_q6p6667Em7_A 1 100 -0.02184533 0.02184467 FORMAT "%10.8" ECU_ADDRESS 0x500055E0 /end MEASUREMENT
/begin MEASUREMENT UEGO_IpPhysCorS1B1_I.DsbcActvdTOFFV_I.outbit "physically corrected pump current sensor 1 bank 1 / Turn off delay / Output Bit" UBYTE B_TRUE 1 100 0.00 1.00000000000 BIT_MASK 0x1 FORMAT "%13.11" ECU_ADDRESS 0x500055E2 /end MEASUREMENT
/begin MEASUREMENT UEGO_IpPhysCorS1B1_I.DsbcActvdTOFFV_I.time "physically corrected pump current sensor 1 bank 1 / Turn off delay / Occured Time" UWORD t_q0p01 1 100 0.00 655.3500 FORMAT "%8.4" ECU_ADDRESS 0x500055E4 /end MEASUREMENT
/begin MEASUREMENT UEGO_IpPhysCorS1B1_I.UEGO_tiDiagRprtRelsTOFFV_I.outbit "physically corrected pump current sensor 1 bank 1 / Turn Off Delay / Output Bit" UBYTE B_TRUE 1 100 0.00 1.00000000000 BIT_MASK 0x1 FORMAT "%13.11" ECU_ADDRESS 0x500055E6 /end MEASUREMENT
/begin MEASUREMENT UEGO_IpPhysCorS1B1_I.UEGO_tiDiagRprtRelsTOFFV_I.time "physically corrected pump current sensor 1 bank 1 / Turn Off Delay / Occured Time" UWORD t_q0p01 1 100 0.00 655.3500 FORMAT "%8.4" ECU_ADDRESS 0x500055E8 /end MEASUREMENT
/begin MEASUREMENT UEGO_IpPhysCorS1B1_I.UEGO_tiRTEvlnvldTOFFV_I.outbit "physically corrected pump current sensor 1 bank 1 / turnoff delay variable for temperature invalidity / Output Bit" UBYTE B_TRUE 1 100 0.00 1.00000000000 BIT_MASK 0x1 FORMAT "%13.11" ECU_ADDRESS 0x500055EA /end MEASUREMENT
/begin MEASUREMENT UEGO_IpPhysCorS1B1_I.UEGO_tiRTEvlnvldTOFFV_I.time "physically corrected pump current sensor 1 bank 1 / turnoff delay variable for temperature invalidity / Occured Time" UWORD t_q0p01 1 100 0.00 655.3500 FORMAT "%8.4" ECU_ADDRESS 0x500055EC /end MEASUREMENT
/begin MEASUREMENT UEGO_IpPhysCorS1B1_I.flgIPmpEvlnVldTONV_I.outbit "physically corrected pump current sensor 1 bank 1 / Turn on delay / return value" UBYTE B_TRUE 1 100 0.00 1.00000000000 BIT_MASK 0x1 FORMAT "%13.11" ECU_ADDRESS 0x500055EE /end MEASUREMENT
/begin MEASUREMENT UEGO_IpPhysCorS1B1_I.flgIPmpEvlnVldTONV_I.time "physically corrected pump current sensor 1 bank 1 / Turn on delay / expired delay time" UWORD t_q0p01 1 100 0.00 655.3500 FORMAT "%8.4" ECU_ADDRESS 0x500055F0 /end MEASUREMENT
/begin MEASUREMENT UEGO_IpPhysCorS1B1_I.flgRPCNotActvTONV_I.outbit "physically corrected pump current sensor 1 bank 1 / Turn on delay / return value" UBYTE B_TRUE 1 100 0.00 1.00000000000 BIT_MASK 0x1 FORMAT "%13.11" ECU_ADDRESS 0x500055F2 /end MEASUREMENT
/begin MEASUREMENT UEGO_IpPhysCorS1B1_I.flgRPCNotActvTONV_I.time "physically corrected pump current sensor 1 bank 1 / Turn on delay / expired delay time" UWORD t_q0p01 1 100 0.00 655.3500 FORMAT "%8.4" ECU_ADDRESS 0x500055F4 /end MEASUREMENT
/begin MEASUREMENT UEGO_IpPhysCorS1B1_I.flgSnglCellSigValidTONV_I.outbit "physically corrected pump current sensor 1 bank 1 / Turn on delay / return value" UBYTE B_TRUE 1 100 0.00 1.00000000000 BIT_MASK 0x1 FORMAT "%13.11" ECU_ADDRESS 0x500055F6 /end MEASUREMENT
/begin MEASUREMENT UEGO_IpPhysCorS1B1_I.flgSnglCellSigValidTONV_I.time "physically corrected pump current sensor 1 bank 1 / Turn on delay / expired delay time" UWORD t_q0p01 1 100 0.00 655.3500 FORMAT "%8.4" ECU_ADDRESS 0x500055F8 /end MEASUREMENT
/begin MEASUREMENT UEGO_LamCalcS1B1_I.flgBascCdnReld "calculation of Lambda sensor 1 bank 1 / Basic conditions Lambda quality" UBYTE B_TRUE 1 100 0.00 1.00000000000 BIT_MASK 0x1 FORMAT "%13.11" ECU_ADDRESS 0x6000D090 /end MEASUREMENT
/begin MEASUREMENT UEGO_LamCalcS1B1_I.flgDynAdpnFil "calculation of Lambda sensor 1 bank 1 / Flag dynamics symmetrization filter effective" UBYTE B_TRUE 1 100 0.00 1.00000000000 BIT_MASK 0x4 FORMAT "%13.11" ECU_ADDRESS 0x6000D090 /end MEASUREMENT
/begin MEASUREMENT UEGO_LamCalcS1B1_I.rLamDynAdpn "calculation of Lambda sensor 1 bank 1 / Lambda output from dynamics symmetrization filter" UWORD fak_q0p000244 1 100 0.00 15.99976 FORMAT "%8.5" ECU_ADDRESS 0x6000D092 /end MEASUREMENT
/begin MEASUREMENT UEGO_LamCalcS1B1_I.rLamDynAdpnDir "calculation of Lambda sensor 1 bank 1 / Filtered lambda value for determination of direction" UWORD fak_q0p000244 1 100 0.00 15.99976 FORMAT "%8.5" ECU_ADDRESS 0x6000D094 /end MEASUREMENT
/begin MEASUREMENT UEGO_LamCalcS1B1_I.rLamIntfrCorrd "calculation of Lambda sensor 1 bank 1 / Lambda actual value with cross sensitivity correction" UWORD fak_q0p000244 1 100 0.00 15.99976 FORMAT "%8.5" ECU_ADDRESS 0x6000D096 /end MEASUREMENT
/begin MEASUREMENT UEGO_LamCalcS1B1_I.rLamRecprBas "calculation of Lambda sensor 1 bank 1 / measured lambda reciprocal value" UWORD fak_q0p000244 1 100 0.00 15.99976 FORMAT "%8.5" ECU_ADDRESS 0x6000D098 /end MEASUREMENT
/begin MEASUREMENT UEGO_LamCalcS1B1_I.rLamRecprIntfrCorrd "calculation of Lambda sensor 1 bank 1 / measured Lambda reciprocal value with cross sensitivity correction" UWORD fak_uw_b16 1 100 0.00 15.99976 FORMAT "%8.5" ECU_ADDRESS 0x6000D09A /end MEASUREMENT
/begin MEASUREMENT UEGO_LamCalcS1B1_I.rLamRecprOffsCorrd "calculation of Lambda sensor 1 bank 1 / measured Lambda reciprocal value with offset correction" UWORD fak_uw_b16 1 100 0.00 15.99976 FORMAT "%8.5" ECU_ADDRESS 0x6000D09C /end MEASUREMENT
/begin MEASUREMENT UEGO_LamCalcS1B1_I.stLamRels "calculation of Lambda sensor 1 bank 1 / Status of bit list for general lambda release" UBYTE dez 1 100 0.00 255.0 FORMAT "%5.1" ECU_ADDRESS 0x6000D09E /end MEASUREMENT
/begin MEASUREMENT UEGO_LamCalcS1B1_I.stRstBascCdn "calculation of Lambda sensor 1 bank 1 / Status of reset of generic lambda release" UWORD dez 1 100 0.00 65535.00 FORMAT "%8.2" ECU_ADDRESS 0x6000D0A0 /end MEASUREMENT
/begin MEASUREMENT UEGO_LamCalcS1B1_I.BascCdnReld_FF_I.status "calculation of Lambda sensor 1 bank 1 / RSFlipFlop BascCdnReld / current value of RS-FF" UBYTE B_TRUE 1 100 0.00 1.00000000000 BIT_MASK 0x1 FORMAT "%13.11" ECU_ADDRESS 0x6000D0A2 /end MEASUREMENT
/begin MEASUREMENT UEGO_LamCalcS1B1_I.LamRels_TONV_I.outbit "calculation of Lambda sensor 1 bank 1 / TurnOnDelayVariable LamRels / return value" UBYTE B_TRUE 1 100 0.00 1.00000000000 BIT_MASK 0x1 FORMAT "%13.11" ECU_ADDRESS 0x6000D0A4 /end MEASUREMENT
/begin MEASUREMENT UEGO_LamCalcS1B1_I.LamRels_TONV_I.time "calculation of Lambda sensor 1 bank 1 / TurnOnDelayVariable LamRels / expired delay time" UWORD t_q0p01 1 100 0.00 655.3500 FORMAT "%8.4" ECU_ADDRESS 0x6000D0A6 /end MEASUREMENT
/begin MEASUREMENT UEGO_LamCalcS1B1_I.flgDsbcActvTOFFV_I.outbit "calculation of Lambda sensor 1 bank 1 / temporary variable for the named class attribute / Output Bit" UBYTE B_TRUE 1 100 0.00 1.00000000000 BIT_MASK 0x1 FORMAT "%13.11" ECU_ADDRESS 0x6000D0A8 /end MEASUREMENT
/begin MEASUREMENT UEGO_LamCalcS1B1_I.flgDsbcActvTOFFV_I.time "calculation of Lambda sensor 1 bank 1 / temporary variable for the named class attribute / Occured Time" UWORD t_q0p01 1 100 0.00 655.3500 FORMAT "%8.4" ECU_ADDRESS 0x6000D0AA /end MEASUREMENT
/begin MEASUREMENT UEGO_LamCalcS1B1_I.flgFastLamRelsEngStrtTOFFV_I.outbit "calculation of Lambda sensor 1 bank 1 / Turn-off delay for fast lambda release after asic shut off / Output Bit" UBYTE B_TRUE 1 100 0.00 1.00000000000 BIT_MASK 0x1 FORMAT "%13.11" ECU_ADDRESS 0x6000D0AC /end MEASUREMENT
/begin MEASUREMENT UEGO_LamCalcS1B1_I.flgFastLamRelsEngStrtTOFFV_I.time "calculation of Lambda sensor 1 bank 1 / Turn-off delay for fast lambda release after asic shut off / Occured Time" UWORD t_q0p01 1 100 0.00 655.3500 FORMAT "%8.4" ECU_ADDRESS 0x6000D0AE /end MEASUREMENT
/begin MEASUREMENT UEGO_LamCalcS1B1_I.flgRPCActTOFFV_I.outbit "calculation of Lambda sensor 1 bank 1 / temporary variable for the named class attribute / Output Bit" UBYTE B_TRUE 1 100 0.00 1.00000000000 BIT_MASK 0x1 FORMAT "%13.11" ECU_ADDRESS 0x6000D0B0 /end MEASUREMENT
/begin MEASUREMENT UEGO_LamCalcS1B1_I.flgRPCActTOFFV_I.time "calculation of Lambda sensor 1 bank 1 / temporary variable for the named class attribute / Occured Time" UWORD t_q0p01 1 100 0.00 655.3500 FORMAT "%8.4" ECU_ADDRESS 0x6000D0B2 /end MEASUREMENT
/begin MEASUREMENT UEGO_LamCalcS1B1_I.flgRTEvlnInvld_TONV_I.outbit "calculation of Lambda sensor 1 bank 1 / TurnOnDelayVariable flgRTEvlnInvld / return value" UBYTE B_TRUE 1 100 0.00 1.00000000000 BIT_MASK 0x1 FORMAT "%13.11" ECU_ADDRESS 0x6000D0B4 /end MEASUREMENT
/begin MEASUREMENT UEGO_LamCalcS1B1_I.flgRTEvlnInvld_TONV_I.time "calculation of Lambda sensor 1 bank 1 / TurnOnDelayVariable flgRTEvlnInvld / expired delay time" UWORD t_q0p01 1 100 0.00 655.3500 FORMAT "%8.4" ECU_ADDRESS 0x6000D0B6 /end MEASUREMENT
/begin MEASUREMENT UEGO_LamCalcS1B1_I.flgSnglCellSigValidTOFFV_I.outbit "calculation of Lambda sensor 1 bank 1 / temporary variable for the named class attribute / Output Bit" UBYTE B_TRUE 1 100 0.00 1.00000000000 BIT_MASK 0x1 FORMAT "%13.11" ECU_ADDRESS 0x6000D0B8 /end MEASUREMENT
/begin MEASUREMENT UEGO_LamCalcS1B1_I.flgSnglCellSigValidTOFFV_I.time "calculation of Lambda sensor 1 bank 1 / temporary variable for the named class attribute / Occured Time" UWORD t_q0p01 1 100 0.00 655.3500 FORMAT "%8.4" ECU_ADDRESS 0x6000D0BA /end MEASUREMENT
/begin MEASUREMENT UEGO_LamCalcS1B1_I.flgTCerLamInvld_TONV_I.outbit "calculation of Lambda sensor 1 bank 1 / TurnOnDelayVariable flgTCerLamInvld / return value" UBYTE B_TRUE 1 100 0.00 1.00000000000 BIT_MASK 0x1 FORMAT "%13.11" ECU_ADDRESS 0x6000D0BC /end MEASUREMENT
/begin MEASUREMENT UEGO_LamCalcS1B1_I.flgTCerLamInvld_TONV_I.time "calculation of Lambda sensor 1 bank 1 / TurnOnDelayVariable flgTCerLamInvld / expired delay time" UWORD t_q0p01 1 100 0.00 655.3500 FORMAT "%8.4" ECU_ADDRESS 0x6000D0BE /end MEASUREMENT
/begin MEASUREMENT UEGO_LamCalcS1B1_I.flgUBattSuffTOFFV_I.outbit "calculation of Lambda sensor 1 bank 1 / turn off delay for flgUBattSuff / Output Bit" UBYTE B_TRUE 1 100 0.00 1.00000000000 BIT_MASK 0x1 FORMAT "%13.11" ECU_ADDRESS 0x6000D0C0 /end MEASUREMENT
/begin MEASUREMENT UEGO_LamCalcS1B1_I.flgUBattSuffTOFFV_I.time "calculation of Lambda sensor 1 bank 1 / turn off delay for flgUBattSuff / Occured Time" UWORD t_q0p01 1 100 0.00 655.3500 FORMAT "%8.4" ECU_ADDRESS 0x6000D0C2 /end MEASUREMENT
/begin MEASUREMENT UEGO_LamCalcS1B1_I.rLamDynAdpn_LT_I.memory "calculation of Lambda sensor 1 bank 1 / LowpassT rLamDynAdpn / current lowpass value" ULONG fak_q3p72529Em9 1 100 0.00 15.9999999963 FORMAT "%13.10" ECU_ADDRESS 0x6000D0C4 /end MEASUREMENT
/begin MEASUREMENT UEGO_LamCalcS1B1_I.tiConDynAdpnLeanRich_LT_I.memory "calculation of Lambda sensor 1 bank 1 / LowpassT tiConDynAdpnLeanRich / current lowpass value" ULONG fak_q3p72529Em9 1 100 0.00 15.9999999963 FORMAT "%13.10" ECU_ADDRESS 0x6000D0C8 /end MEASUREMENT
/begin MEASUREMENT UEGO_LamCalcS1B1_I.tiDynAdpnLeanRichDTTtOpt_I.buffer "calculation of Lambda sensor 1 bank 1 / delay element for dynamic adaption lean to rich / buffer element of delay time class" UWORD fak_q0p000244 1 100 0.00 15.99976 FORMAT "%8.5" ARRAY_SIZE 21 ECU_ADDRESS 0x6000D0CC /end MEASUREMENT
/begin MEASUREMENT UEGO_LamCalcS1B1_I.tiDynAdpnLeanRichDTTtOpt_I.counter "calculation of Lambda sensor 1 bank 1 / delay element for dynamic adaption lean to rich / counter element of delay time class" UWORD fak_q0p000244 1 100 0.00 15.99976 FORMAT "%8.5" ECU_ADDRESS 0x6000D0F6 /end MEASUREMENT
/begin MEASUREMENT UEGO_LamCalcS1B1_I.tiDynAdpnLeanRichDTTtOpt_I.ds "calculation of Lambda sensor 1 bank 1 / delay element for dynamic adaption lean to rich / ds element of delay time class" UWORD fak_q0p000244 1 100 0.00 15.99976 FORMAT "%8.5" ECU_ADDRESS 0x6000D0F8 /end MEASUREMENT
/begin MEASUREMENT UEGO_LamCalcS1B1_I.tiDynAdpnLeanRichDTTtOpt_I.pointer "calculation of Lambda sensor 1 bank 1 / delay element for dynamic adaption lean to rich / pointer element of delay time class" UBYTE dez 1 100 0.00 255.0 FORMAT "%5.1" ECU_ADDRESS 0x6000D0FA /end MEASUREMENT
/begin MEASUREMENT UEGO_LamMdlClassS1B1_I.ratLamRecprMdl "Modelled Lambda value for Sensor 1 Bank 1 / reciprocal lambda model" UWORD fak_uw_b16 1 100 0.00 15.99976 FORMAT "%8.5" ECU_ADDRESS 0x60003460 /end MEASUREMENT
/begin MEASUREMENT UEGO_OperRelsS1B1_I.cntrReiniProc10msec "Class instance of the functional class of FC UEGO_OperRels for Sensor 1 Bank 1 / Drive cycle counter that increments when system state exits Post-drive in 10ms proc" UBYTE OneToOne 1 100 0.00 255.0 FORMAT "%5.1" ECU_ADDRESS 0x500055FA /end MEASUREMENT
/begin MEASUREMENT UEGO_OperRelsS1B1_I.flgErrSuspcLoBatt "Class instance of the functional class of FC UEGO_OperRels for Sensor 1 Bank 1 / Information if during set flgUBattMin and set flgUBattSuff an error suspicion exists." UBYTE B_TRUE 1 100 0.00 1.00000000000 BIT_MASK 0x1 FORMAT "%13.11" ECU_ADDRESS 0x500055FB /end MEASUREMENT
/begin MEASUREMENT UEGO_OperRelsS1B1_I.flgFastLamRelsAftAsicShtOff "Class instance of the functional class of FC UEGO_OperRels for Sensor 1 Bank 1 / Status for fast Lambda release after ASIC shut-off" UBYTE B_TRUE 1 100 0.00 1.00000000000 BIT_MASK 0x1 FORMAT "%13.11" ECU_ADDRESS 0x500055FC /end MEASUREMENT
/begin MEASUREMENT UEGO_OperRelsS1B1_I.flgOperRels "Class instance of the functional class of FC UEGO_OperRels for Sensor 1 Bank 1 / Sensor operation release" UBYTE B_TRUE 1 100 0.00 1.00000000000 BIT_MASK 0x1 FORMAT "%13.11" ECU_ADDRESS 0x500055FD /end MEASUREMENT
/begin MEASUREMENT UEGO_OperRelsS1B1_I.flgRstOperRls "Class instance of the functional class of FC UEGO_OperRels for Sensor 1 Bank 1 / Reset trigger event to reset sensor operation release in case of MSA" UBYTE B_TRUE 1 100 0.00 1.00000000000 BIT_MASK 0x1 FORMAT "%13.11" ECU_ADDRESS 0x500055FE /end MEASUREMENT
/begin MEASUREMENT UEGO_OperRelsS1B1_I.flgRstrtAsicAftLoBatt "Class instance of the functional class of FC UEGO_OperRels for Sensor 1 Bank 1 / The status to reset or set the sensor operation release due to low battery in case of MSA" UBYTE B_TRUE 1 100 0.00 1.00000000000 BIT_MASK 0x1 FORMAT "%13.11" ECU_ADDRESS 0x500055FF /end MEASUREMENT
/begin MEASUREMENT UEGO_OperRelsS1B1_I.flgTiWinAftSuffBatt "Class instance of the functional class of FC UEGO_OperRels for Sensor 1 Bank 1 / status indicating the time period after battery voltage is above the threshold of UEGO_uLoBattAsicHiThd_C" UBYTE B_TRUE 1 100 0.00 1.00000000000 BIT_MASK 0x1 FORMAT "%13.11" ECU_ADDRESS 0x50005600 /end MEASUREMENT
/begin MEASUREMENT UEGO_OperRelsS1B1_I.flgTiWithinWinAftEngRstrt "Class instance of the functional class of FC UEGO_OperRels for Sensor 1 Bank 1 / Time window active after startstop for detection of ASIC in IDLE" UBYTE B_TRUE 1 100 0.00 1.00000000000 BIT_MASK 0x1 FORMAT "%13.11" ECU_ADDRESS 0x50005601 /end MEASUREMENT
/begin MEASUREMENT UEGO_OperRelsS1B1_I.stOperRels "Class instance of the functional class of FC UEGO_OperRels for Sensor 1 Bank 1 / observe the condition for sensor operation release" UWORD OneToOne 1 100 0.00 65535.00 FORMAT "%8.2" ECU_ADDRESS 0x50005602 /end MEASUREMENT
/begin MEASUREMENT UEGO_OperRelsS1B1_I.stRstOperRels "Class instance of the functional class of FC UEGO_OperRels for Sensor 1 Bank 1 / Bit coded conditions to reset sensor operation release in case of MSA" UBYTE OneToOne 1 100 0.00 255.0 FORMAT "%5.1" ECU_ADDRESS 0x50005604 /end MEASUREMENT
/begin MEASUREMENT UEGO_OperRelsS1B1_I.TmrAftEngRstrtTR_I.timeCounter "Class instance of the functional class of FC UEGO_OperRels for Sensor 1 Bank 1 / Timer after startstop or engine restart for detection of ASIC in IDLE / Remaining time of the timer" UWORD t_q0p01 1 100 0.00 655.3500 FORMAT "%8.4" ECU_ADDRESS 0x50005606 /end MEASUREMENT
/begin MEASUREMENT UEGO_OperRelsS1B1_I.flgEngCrkERNM_I.oldSignal "Class instance of the functional class of FC UEGO_OperRels for Sensor 1 Bank 1 / Rising edge of Status engine is cranking / value of input signal last calculation" UBYTE B_TRUE 1 100 0.00 1.00000000000 BIT_MASK 0x1 FORMAT "%13.11" ECU_ADDRESS 0x50005608 /end MEASUREMENT
/begin MEASUREMENT UEGO_OperRelsS1B1_I.flgEngRstrtEFNM_I.oldSignal "Class instance of the functional class of FC UEGO_OperRels for Sensor 1 Bank 1 / Falling edge of status stop-phase is finished and engine is restarting / memory to detect falling edge" UBYTE B_TRUE 1 100 0.00 1.00000000000 BIT_MASK 0x1 FORMAT "%13.11" ECU_ADDRESS 0x50005609 /end MEASUREMENT
/begin MEASUREMENT UEGO_OperRelsS1B1_I.flgFastLamRelsAftAsicShtOffTOFFVNM_I.time "Class instance of the functional class of FC UEGO_OperRels for Sensor 1 Bank 1 / Turn-Off delayfor fast Lambda release after ASIC shut-off / delay time" UWORD t_q0p01 1 100 0.00 655.3500 FORMAT "%8.4" ECU_ADDRESS 0x5000560A /end MEASUREMENT
/begin MEASUREMENT UEGO_OperRelsS1B1_I.flgRstOperRlsERNM_I.oldSignal "Class instance of the functional class of FC UEGO_OperRels for Sensor 1 Bank 1 / Rising edge to reset sensor operation release due to ASIC in IDLE mode. / value of input signal last calculation" UBYTE B_TRUE 1 100 0.00 1.00000000000 BIT_MASK 0x1 FORMAT "%13.11" ECU_ADDRESS 0x5000560C /end MEASUREMENT
/begin MEASUREMENT UEGO_OperRelsS1B1_I.flgRstrtAsicAftLoBattFF_I.status "Class instance of the functional class of FC UEGO_OperRels for Sensor 1 Bank 1 / SR flipflop to hold the status to reset or set the sensor operation release due to low battery in case of MSA / current value of RS-FF" UBYTE B_TRUE 1 100 0.00 1.00000000000 BIT_MASK 0x1 FORMAT "%13.11" ECU_ADDRESS 0x5000560D /end MEASUREMENT
/begin MEASUREMENT UEGO_OperRelsS1B1_I.flgTiWinAftSuffBattTOFFVNM_I.time "Class instance of the functional class of FC UEGO_OperRels for Sensor 1 Bank 1 / Turn-Off delay after battery voltage is above the threshold of UEGO_uLoBattAsicHiThd_C during engine restart. / delay time" UWORD t_q0p01 1 100 0.00 655.3500 FORMAT "%8.4" ECU_ADDRESS 0x5000560E /end MEASUREMENT
/begin MEASUREMENT UEGO_OperRelsS1B1_I.flgUBattLoTOFFVNM_I.time "Class instance of the functional class of FC UEGO_OperRels for Sensor 1 Bank 1 / Turn-off delay for low battery voltage / delay time" UWORD t_q0p01 1 100 0.00 655.3500 FORMAT "%8.4" ECU_ADDRESS 0x50005610 /end MEASUREMENT
/begin MEASUREMENT UEGO_OperRelsS1B1_I.flgUBattMaxTOFFVNM_I.time "Class instance of the functional class of FC UEGO_OperRels for Sensor 1 Bank 1 / Turn-off delay for maximum battery voltage / delay time" UWORD t_q0p01 1 100 0.00 655.3500 FORMAT "%8.4" ECU_ADDRESS 0x50005612 /end MEASUREMENT
/begin MEASUREMENT UEGO_OperRelsS1B1_I.flgUBattMinTOFFVNM_I.time "Class instance of the functional class of FC UEGO_OperRels for Sensor 1 Bank 1 / Turn-off delay for minimum battery voltage / delay time" UWORD t_q0p01 1 100 0.00 655.3500 FORMAT "%8.4" ECU_ADDRESS 0x50005614 /end MEASUREMENT
/begin MEASUREMENT UEGO_OperRelsWoDewPntS1B1_I.flgFastLiOffActvSts "Class instance of the functional class of FC UEGO_OperRelsWoDewPnt for Sensor 1 Bank 1 / Status of fast light-off for Lambda sensor" UBYTE B_TRUE 1 100 0.00 1.00000000000 BIT_MASK 0x2 FORMAT "%13.11" ECU_ADDRESS 0x6000345C /end MEASUREMENT
/begin MEASUREMENT UEGO_OperRelsWoDewPntS1B1_I.flgOperRelsPreEngStrt "Class instance of the functional class of FC UEGO_OperRelsWoDewPnt for Sensor 1 Bank 1 / Activation of lambda sensor heating before engine start" UBYTE B_TRUE 1 100 0.00 1.00000000000 BIT_MASK 0x1 FORMAT "%13.11" ECU_ADDRESS 0x6000345D /end MEASUREMENT
/begin MEASUREMENT UEGO_OperRels_cntrReiniProc10msec "Drive cycle counter that increments when system state exits Post-drive in 10ms proc" UBYTE OneToOne 1 100 0.00 255.0 FORMAT "%5.1" ECU_ADDRESS 0x60006222 /end MEASUREMENT
/begin MEASUREMENT UEGO_ratHeatrPSCtrlS1B1 "Duty cycle control powerstage heater sensor 1 bank 1" UWORD rel_q0p003052 1 100 0.00 199.9969 FORMAT "%8.4" ECU_ADDRESS 0x60004C34 /end MEASUREMENT
/begin MEASUREMENT UEGO_ratLamRecprMdlS1B1 "reciprocal lambda model at sensor 1 bank 1" UWORD fak_uw_b16 1 100 0.00 15.99976 FORMAT "%8.5" ECU_ADDRESS 0x60004C32 /end MEASUREMENT
/begin MEASUREMENT UEGO_ratLamSrv1S1B1 "Lambda actual value for service 01 sensor 1 bank 1" UWORD fak_uw_b16 1 100 0.00 15.99976 FORMAT "%8.5" ECU_ADDRESS 0x70002CC4 /end MEASUREMENT
/begin MEASUREMENT UEGO_ratLamSymS1B1 "Actual lambda after symmetrization (sensor 1, bank 1)" UWORD fak_uw_b16 1 100 0.00 15.99976 FORMAT "%8.5" ECU_ADDRESS 0x6000E2E0 /end MEASUREMENT
/begin MEASUREMENT UEGO_rLamDeltaIntfr "lambda shift regarding sensor cross sensitivity in H2,CO,HC" SWORD fak_sw_b8 1 100 -8.000000 7.999756 FORMAT "%8.6" ECU_ADDRESS 0x60003462 /end MEASUREMENT
/begin MEASUREMENT UEGO_rLamDeltaScavg "lambda shift regarding scavenging" SWORD fak_sw_b1 1 100 -1.000000 0.999969 FORMAT "%8.6" ECU_ADDRESS 0x70002BA2 /end MEASUREMENT
/begin MEASUREMENT UEGO_rLamDeltaScavgBnk2 "lambda shift of bank 2 regarding scavenging" SWORD fak_sw_b1 1 100 -1.000000 0.999969 FORMAT "%8.6" ECU_ADDRESS 0x70002BA4 /end MEASUREMENT
/begin MEASUREMENT UEGO_rLamEquivElecCorrdS1B1 "Lambda equivalent based on electrically corrected pump current sensor 1 bank 1" UWORD fak_uw_b16 1 100 0.00 15.99976 FORMAT "%8.5" ECU_ADDRESS 0x70002CBE /end MEASUREMENT
/begin MEASUREMENT UEGO_rLamRecprS1B1 "lambda reciprocal value sensor 1 bank 1" UWORD fak_uw_b16 1 100 0.00 15.99976 FORMAT "%8.5" ECU_ADDRESS 0x70002CC0 /end MEASUREMENT
/begin MEASUREMENT UEGO_rLamS1B1 "Lambda actual value sensor 1 bank 1" UWORD fak_uw_b16 1 100 0.00 15.99976 FORMAT "%8.5" ECU_ADDRESS 0x50005BBC /end MEASUREMENT
/begin MEASUREMENT UEGO_SimRampLock_I.cntrReinicalc20msec "locking mechanism for sensor heating / Counter ReIni processes for SimRampLock class" UBYTE OneToOne 1 100 0.00 255.0 FORMAT "%5.1" ECU_ADDRESS 0x60003466 /end MEASUREMENT
/begin MEASUREMENT UEGO_SimRampLock_I.lock "locking mechanism for sensor heating / locking mechanism active" UBYTE B_TRUE 1 100 0.00 1.00000000000 BIT_MASK 0x1 FORMAT "%13.11" ECU_ADDRESS 0x60003467 /end MEASUREMENT
/begin MEASUREMENT UEGO_SimRampLock_I.tiRmpStrtDiffSW_I.timeCounter "locking mechanism for sensor heating / timer for locking mechanism / expired time since start" UWORD t_q0p02 1 100 0.00 1310.700 FORMAT "%8.3" ECU_ADDRESS 0x60003468 /end MEASUREMENT
/begin MEASUREMENT UEGO_SnsrMdlHotS1B1_I.ctReIniProc20msec "Calculation if sensor is hot or cold / Counter for reinitialisation in 20 ms raster in SnsrMdlHotClass" UBYTE OneToOne 1 100 0.00 255.0 FORMAT "%5.1" ECU_ADDRESS 0x500022B0 /end MEASUREMENT
/begin MEASUREMENT UEGO_SnsrMdlHotS1B1_I.egyHeatr "Calculation if sensor is hot or cold / Heater energy put into the sensor" UWORD q_q0p015625_J 1 100 0.00 1023.984 FORMAT "%8.3" ECU_ADDRESS 0x500022B2 /end MEASUREMENT
/begin MEASUREMENT UEGO_SnsrMdlHotS1B1_I.egySnsrMdlHotThd "Calculation if sensor is hot or cold / Release threshhold for snsrmdlhot" UWORD q_q0p015625_J 1 100 0.00 1023.984 FORMAT "%8.3" ECU_ADDRESS 0x500022B4 /end MEASUREMENT
/begin MEASUREMENT UEGO_SnsrMdlHotS1B1_I.flgIniFinshd "Calculation if sensor is hot or cold / flag for initialisation SnsrMdlHot Class" UBYTE B_TRUE 1 100 0.00 1.00000000000 BIT_MASK 0x1 FORMAT "%13.11" ECU_ADDRESS 0x500022B6 /end MEASUREMENT
/begin MEASUREMENT UEGO_SnsrMdlHotS1B1_I.flgSnsrMdlHot "Calculation if sensor is hot or cold / Condition lambda sensor would be hot" UBYTE B_TRUE 1 100 0.00 1.00000000000 BIT_MASK 0x1 FORMAT "%13.11" ECU_ADDRESS 0x500022B7 /end MEASUREMENT
/begin MEASUREMENT UEGO_SnsrMdlHotS1B1_I.rHeatr "Calculation if sensor is hot or cold / heater resistor" UWORD r_q9p765625Em4_Ohm 1 100 0.00 63.99902 FORMAT "%8.5" ECU_ADDRESS 0x500022B8 /end MEASUREMENT
/begin MEASUREMENT UEGO_SnsrMdlHotS1B1_I.tiHeatr "Calculation if sensor is hot or cold / passed time since heating up started" UWORD t_q0p02 1 100 0.00 1310.700 FORMAT "%8.3" ECU_ADDRESS 0x500022BA /end MEASUREMENT
/begin MEASUREMENT UEGO_SnsrMdlHotS1B1_I.uBattCorrd "Calculation if sensor is hot or cold / corrected battery voltage at sensor" UBYTE spg_q0p1 1 100 0.00 25.50 FORMAT "%5.2" ECU_ADDRESS 0x500022BC /end MEASUREMENT
/begin MEASUREMENT UEGO_SnsrMdlHotS1B1_I.UEGO_egyHeatrIK_I.memory "Calculation if sensor is hot or cold / integrator / current integrator value" ULONG q_q2p3842Em7_J 1 100 0.00 1023.99999976 FORMAT "%13.8" ECU_ADDRESS 0x500022C0 /end MEASUREMENT
/begin MEASUREMENT UEGO_stDsqTCtrlS1B1 "signal quality of heater control, sensor 1 bank 1" UWORD dez 1 100 0.00 65535.00 FORMAT "%8.2" ECU_ADDRESS 0x6000E2E2 /end MEASUREMENT
/begin MEASUREMENT UEGO_stLamQlyS1B1 "Lambda signal quality sensor 1 bank 1" UBYTE dez 1 100 0.00 255.0 FORMAT "%5.1" ECU_ADDRESS 0x6000A2BA /end MEASUREMENT
/begin MEASUREMENT UEGO_tCtlDvtS1B1 "control deviation of heater control sensor 1 bank 1" SWORD temp_q0p0234 1 100 -768.0000 767.9766 FORMAT "%8.4" ECU_ADDRESS 0x60004E90 /end MEASUREMENT
/begin MEASUREMENT UEGO_tiEngOff "enigine off time" SLONG t_q1 1 100 -2147483648.00 2147483647.00 FORMAT "%13.2" ECU_ADDRESS 0x60001BF0 /end MEASUREMENT
/begin MEASUREMENT UEGO_TiEngOffTOFFVNM_I.time "Turn off delay, if flgEngRunng changed from true to false / delay time" UBYTE t_q0p05 1 100 0.00 12.75 FORMAT "%5.2" ECU_ADDRESS 0x60006220 /end MEASUREMENT
/begin MEASUREMENT UEGO_TstrClassS1B1_I.flgReqPreStrtHeatg "Class tester release for lambda sensor 1 bank 1 / ststus request pre-start heating" UBYTE B_TRUE 1 100 0.00 1.00000000000 BIT_MASK 0x1 FORMAT "%13.11" ECU_ADDRESS 0x60003456 /end MEASUREMENT
/begin MEASUREMENT UEGO_TstrClassS1B1_I.bHtrActvPrevStrtER_I.buffer "Class tester release for lambda sensor 1 bank 1 / rising edge for precious heating / rising edge detected" UBYTE B_TRUE 1 100 0.00 1.00000000000 BIT_MASK 0x1 FORMAT "%13.11" ECU_ADDRESS 0x60003458 /end MEASUREMENT
/begin MEASUREMENT UEGO_TstrClassS1B1_I.bHtrActvPrevStrtER_I.oldSignal "Class tester release for lambda sensor 1 bank 1 / rising edge for precious heating / flag rising edge" UBYTE B_TRUE 1 100 0.00 1.00000000000 BIT_MASK 0x1 FORMAT "%13.11" ECU_ADDRESS 0x60003459 /end MEASUREMENT
/begin MEASUREMENT UEGO_TstrClassS1B1_I.bHtrActvPrevStrtFF_I.status "Class tester release for lambda sensor 1 bank 1 / flip flop for previous heating / current value of RS-FF" UBYTE B_TRUE 1 100 0.00 1.00000000000 BIT_MASK 0x1 FORMAT "%13.11" ECU_ADDRESS 0x6000345A /end MEASUREMENT
/begin MEASUREMENT UEGO_uBattCorrdS1B1 "corrected battery voltage sensor 1 bank 1" UBYTE spg_q0p1 1 100 0.00 25.50 FORMAT "%5.2" ECU_ADDRESS 0x6000A2B7 /end MEASUREMENT
/begin MEASUREMENT UEGO_uHtrCtlEffS1B1 "effective heater voltage (reqested by heater control from heater power stage control) sensor 1 bank 1" UWORD spg_q0p005 1 100 0.00 327.6750 FORMAT "%8.4" ECU_ADDRESS 0x60004C18 /end MEASUREMENT
/begin MEASUREMENT VehMot_a2trq "Conversion factor acceleration to propulsion torque" SWORD MassLength 1 100 -6553.600 6553.400 FORMAT "%8.3" ECU_ADDRESS 0x60004E18 /end MEASUREMENT
/begin MEASUREMENT VehMot_aPrpCurr "Current estimated acceleration" SWORD Acc 1 100 -32.76800 32.76700 FORMAT "%8.5" ECU_ADDRESS 0x60004E16 /end MEASUREMENT
/begin MEASUREMENT VehMot_aPrpMax "Maximum estimated acceleration at current engaged gear" SWORD Acc 1 100 -32.76800 32.76700 FORMAT "%8.5" ECU_ADDRESS 0x60004E14 /end MEASUREMENT
/begin MEASUREMENT VehMot_aPrpMin "Minimum estimated acceleration at current engaged gear" SWORD Acc 1 100 -32.76800 32.76700 FORMAT "%8.5" ECU_ADDRESS 0x60004E12 /end MEASUREMENT
/begin MEASUREMENT VehMot_flgAppVartn "Flag which is set when acc.ped. Slope is higher than positive or negetive threshold" UBYTE B_TRUE 1 100 0.00 1.00000000000 BIT_MASK 0x1 FORMAT "%13.11" ECU_ADDRESS 0x6000621F /end MEASUREMENT
/begin MEASUREMENT VehMot_flgDlyAppVartn "Flag which remains set for a delay time after acc.ped slope has crossed positive or negetice threshold" UBYTE B_TRUE 1 100 0.00 1.00000000000 BIT_MASK 0x1 FORMAT "%13.11" ECU_ADDRESS 0x6000621E /end MEASUREMENT
/begin MEASUREMENT VehMot_flgHighLdVehDyn "Flag to indicate high load condition" UBYTE B_TRUE 1 100 0.00 1.00000000000 BIT_MASK 0x1 FORMAT "%13.11" ECU_ADDRESS 0x6000621D /end MEASUREMENT
/begin MEASUREMENT VehMot_rApp "Accelerator pedal position based on driver, CC, and ASL demanded ratio" SWORD Prc 1 100 -400.0000 399.9878 FORMAT "%8.4" ECU_ADDRESS 0x60003454 /end MEASUREMENT
/begin MEASUREMENT VehMot_rAppDiff "Difference between the current and 20ms previous value of accelerator pedal expressed in PrcPerSec" SWORD PrcPerSec 1 100 -20000.00 19999.39 FORMAT "%8.2" ECU_ADDRESS 0x60003452 /end MEASUREMENT
/begin MEASUREMENT VehMot_rAppPrev1 "Previous raster(10ms) vaule of accped" SWORD Prc 1 100 -400.0000 399.9878 FORMAT "%8.4" ECU_ADDRESS 0x60003450 /end MEASUREMENT
/begin MEASUREMENT VehMot_rAppPrev2 "Second previous raster(20ms) value of accped" SWORD Prc 1 100 -400.0000 399.9878 FORMAT "%8.4" ECU_ADDRESS 0x6000344E /end MEASUREMENT
/begin MEASUREMENT VehMot_tiTrqDragPT1 "Time constant for filtering drag esimation" SWORD Time_s_1 1 100 -32.76800 32.76700 FORMAT "%8.5" ECU_ADDRESS 0x60004E06 /end MEASUREMENT
/begin MEASUREMENT VehMot_tqWhlMax "Maximum wheel torque from engine" SLONG TrqPrpHigh 1 100 -214748364.800 214748364.700 FORMAT "%13.3" ECU_ADDRESS 0x60001C9C /end MEASUREMENT
/begin MEASUREMENT VehMot_trqDrag "calculated driving resistance" SLONG TrqPrpHigh 1 100 -214748364.800 214748364.700 FORMAT "%13.3" ECU_ADDRESS 0x60001C98 /end MEASUREMENT
/begin MEASUREMENT VehMot_trqDragEst_mp "Estimated drag torque" SLONG TrqPrpHigh 1 100 -214748364.800 214748364.700 FORMAT "%13.3" ECU_ADDRESS 0x70008B08 /end MEASUREMENT
/begin MEASUREMENT VehMot_trqPrpFlt_mp "Current torque, filtered" SLONG TrqPrpHigh 1 100 -214748364.800 214748364.700 FORMAT "%13.3" ECU_ADDRESS 0x70008B04 /end MEASUREMENT
/begin MEASUREMENT VehMot_trqWoComp_mp "Propulsion torque without compensation term" SLONG TrqPrpHigh 1 100 -214748364.800 214748364.700 FORMAT "%13.3" ECU_ADDRESS 0x70008B00 /end MEASUREMENT
/begin MEASUREMENT VehStc_cntFuDiagRecA "Fuel system diagnos counter is recording parameter" ULONG OneToOne 1 100 0.00 4294967295.00 FORMAT "%13.2" ARRAY_SIZE 21 ECU_ADDRESS 0x6000120C /end MEASUREMENT
/begin MEASUREMENT VehStc_cntrMisfDetn "Counter for Number of misfire every 100ms" UWORD OneToOne 1 100 0.00 65535.00 FORMAT "%8.2" ECU_ADDRESS 0x6000344C /end MEASUREMENT
/begin MEASUREMENT VehStc_flgMisfDetd "Flag to indicate misfire to be detected" UBYTE B_TRUE 1 100 0.00 1.00000000000 BIT_MASK 0x1 FORMAT "%13.11" ECU_ADDRESS 0x60000B83 /end MEASUREMENT
/begin MEASUREMENT VehStc_flgMisfDetn "Flag of the misfire detection" UBYTE B_TRUE 1 100 0.00 1.00000000000 BIT_MASK 0x1 FORMAT "%13.11" ECU_ADDRESS 0x6003627C /end MEASUREMENT
/begin MEASUREMENT VehStc_flgPwrSteerRstrtActv "Power steering auto restart is activated" UBYTE B_TRUE 1 100 0.00 1.00000000000 BIT_MASK 0x1 FORMAT "%13.11" ECU_ADDRESS 0x60000B82 /end MEASUREMENT
/begin MEASUREMENT VehStc_flgRstrtFromIdleStop "flag indicating auto restart happend from idle stop" UBYTE B_TRUE 1 100 0.00 1.00000000000 BIT_MASK 0x1 FORMAT "%13.11" ECU_ADDRESS 0x60009F82 /end MEASUREMENT
/begin MEASUREMENT VehStc_flgSSEChgOfMind "flag indicating the change of mind happend" UBYTE B_TRUE 1 100 0.00 1.00000000000 BIT_MASK 0x1 FORMAT "%13.11" ECU_ADDRESS 0x60000B84 /end MEASUREMENT
/begin MEASUREMENT VehStc_flgStopInhbCdnChkEna "flag to block the inhibiting condition updating after the auto restart" UBYTE B_TRUE 1 100 0.00 1.00000000000 BIT_MASK 0x1 FORMAT "%13.11" ECU_ADDRESS 0x60009F81 /end MEASUREMENT
/begin MEASUREMENT VehStc_flgStopTrigDly "flag indicating the stop trigger status" UBYTE B_TRUE 1 100 0.00 1.00000000000 BIT_MASK 0x1 FORMAT "%13.11" ECU_ADDRESS 0x60009F80 /end MEASUREMENT
/begin MEASUREMENT VehStc_flgStopTrigDlyFinshd "flag indicating the stop trigger is finished" UBYTE B_TRUE 1 100 0.00 1.00000000000 BIT_MASK 0x1 FORMAT "%13.11" ECU_ADDRESS 0x60000B81 /end MEASUREMENT
/begin MEASUREMENT VehStc_flgUserRstrtActv "flag indicating the auto restart is activated by user" UBYTE B_TRUE 1 100 0.00 1.00000000000 BIT_MASK 0x1 FORMAT "%13.11" ECU_ADDRESS 0x60000B80 /end MEASUREMENT
/begin MEASUREMENT VehStc_idxCalcnAry "Calculation index for array" UBYTE OneToOne 1 100 0.00 255.0 FORMAT "%5.1" ECU_ADDRESS 0x60000B7F /end MEASUREMENT
/begin MEASUREMENT VehStc_idxDiagRsltB1A "Index for catalyst monitor array" UBYTE OneToOne 1 100 0.00 255.0 FORMAT "%5.1" ECU_ADDRESS 0x60000B7E /end MEASUREMENT
/begin MEASUREMENT VehStc_lDeltaDst "Delta distance travelled in a Driving cycle" UWORD Length 1 100 0.00 65535.00 FORMAT "%8.2" ECU_ADDRESS 0x60000B7C /end MEASUREMENT
/begin MEASUREMENT VehStc_lDstCity "Delta distance travelled in a Driving cycle of city zone" ULONG Length 1 100 0.00 4294967295.00 FORMAT "%13.2" ECU_ADDRESS 0x60036278 /end MEASUREMENT
/begin MEASUREMENT VehStc_lDstCityEco "Delta distance travelled in a Driving cycle of city zone during Economy mode ON" ULONG Length 1 100 0.00 4294967295.00 FORMAT "%13.2" ECU_ADDRESS 0x60036274 /end MEASUREMENT
/begin MEASUREMENT VehStc_lDstHighWay "Delta distance travelled in a Driving cycle of highway zone" ULONG Length 1 100 0.00 4294967295.00 FORMAT "%13.2" ECU_ADDRESS 0x60036270 /end MEASUREMENT
/begin MEASUREMENT VehStc_lDstHighWayEco "Delta distance travelled in a Driving cycle of Highway zone during ECO mode ON" ULONG Length 1 100 0.00 4294967295.00 FORMAT "%13.2" ECU_ADDRESS 0x6003626C /end MEASUREMENT
/begin MEASUREMENT VehStc_lDstold "Delta distance travelled in a previous Driving Cycle" SLONG Length 1 100 -2147483648.00 2147483647.00 FORMAT "%13.2" ECU_ADDRESS 0x60000B78 /end MEASUREMENT
/begin MEASUREMENT VehStc_NrOfMisfOldA "array for number of misfire per cylinder Old Value" UWORD dez 1 100 0.00 65535.00 FORMAT "%8.2" ARRAY_SIZE 4 ECU_ADDRESS 0x60003444 /end MEASUREMENT
/begin MEASUREMENT VehStc_numFuDiagRecA "Fuel system diagnos average is recording parameter" UWORD fak_uw_b2 1 100 0.00 1.999969 FORMAT "%8.6" ARRAY_SIZE 21 ECU_ADDRESS 0x6000484E /end MEASUREMENT
/begin MEASUREMENT VehStc_numMisfDetnHiEct0 "Misfire diagnos is recording parameter - High ECT_0" ULONG OneToOne 1 100 0.00 4294967295.00 FORMAT "%13.2" ECU_ADDRESS 0x60036268 /end MEASUREMENT
/begin MEASUREMENT VehStc_numMisfDetnHiEct1 "Misfire diagnos is recording parameter - High ECT_1" ULONG OneToOne 1 100 0.00 4294967295.00 FORMAT "%13.2" ECU_ADDRESS 0x60036264 /end MEASUREMENT
/begin MEASUREMENT VehStc_numMisfDetnHiEct10 "Misfire diagnos is recording parameter - High ECT_10" ULONG OneToOne 1 100 0.00 4294967295.00 FORMAT "%13.2" ECU_ADDRESS 0x60036260 /end MEASUREMENT
/begin MEASUREMENT VehStc_numMisfDetnHiEct11 "Misfire diagnos is recording parameter - High ECT_11" ULONG OneToOne 1 100 0.00 4294967295.00 FORMAT "%13.2" ECU_ADDRESS 0x6003625C /end MEASUREMENT
/begin MEASUREMENT VehStc_numMisfDetnHiEct12 "Misfire diagnos is recording parameter - High ECT_12" ULONG OneToOne 1 100 0.00 4294967295.00 FORMAT "%13.2" ECU_ADDRESS 0x60036258 /end MEASUREMENT
/begin MEASUREMENT VehStc_numMisfDetnHiEct13 "Misfire diagnos is recording parameter - High ECT_13" ULONG OneToOne 1 100 0.00 4294967295.00 FORMAT "%13.2" ECU_ADDRESS 0x60036254 /end MEASUREMENT
/begin MEASUREMENT VehStc_numMisfDetnHiEct14 "Misfire diagnos is recording parameter - High ECT_14" ULONG OneToOne 1 100 0.00 4294967295.00 FORMAT "%13.2" ECU_ADDRESS 0x60036250 /end MEASUREMENT
/begin MEASUREMENT VehStc_numMisfDetnHiEct15 "Misfire diagnos is recording parameter - High ECT_15" ULONG OneToOne 1 100 0.00 4294967295.00 FORMAT "%13.2" ECU_ADDRESS 0x6003624C /end MEASUREMENT
/begin MEASUREMENT VehStc_numMisfDetnHiEct16 "Misfire diagnos is recording parameter - High ECT_16" ULONG OneToOne 1 100 0.00 4294967295.00 FORMAT "%13.2" ECU_ADDRESS 0x60036248 /end MEASUREMENT
/begin MEASUREMENT VehStc_numMisfDetnHiEct17 "Misfire diagnos is recording parameter - High ECT_17" ULONG OneToOne 1 100 0.00 4294967295.00 FORMAT "%13.2" ECU_ADDRESS 0x60036244 /end MEASUREMENT
/begin MEASUREMENT VehStc_numMisfDetnHiEct18 "Misfire diagnos is recording parameter - High ECT_18" ULONG OneToOne 1 100 0.00 4294967295.00 FORMAT "%13.2" ECU_ADDRESS 0x60036240 /end MEASUREMENT
/begin MEASUREMENT VehStc_numMisfDetnHiEct19 "Misfire diagnos is recording parameter - High ECT_19" ULONG OneToOne 1 100 0.00 4294967295.00 FORMAT "%13.2" ECU_ADDRESS 0x6003623C /end MEASUREMENT
/begin MEASUREMENT VehStc_numMisfDetnHiEct2 "Misfire diagnos is recording parameter - High ECT_2" ULONG OneToOne 1 100 0.00 4294967295.00 FORMAT "%13.2" ECU_ADDRESS 0x60036238 /end MEASUREMENT
/begin MEASUREMENT VehStc_numMisfDetnHiEct20 "Misfire diagnos is recording parameter - High ECT_20" ULONG OneToOne 1 100 0.00 4294967295.00 FORMAT "%13.2" ECU_ADDRESS 0x60036234 /end MEASUREMENT
/begin MEASUREMENT VehStc_numMisfDetnHiEct3 "Misfire diagnos is recording parameter - High ECT_3" ULONG OneToOne 1 100 0.00 4294967295.00 FORMAT "%13.2" ECU_ADDRESS 0x60036230 /end MEASUREMENT
/begin MEASUREMENT VehStc_numMisfDetnHiEct4 "Misfire diagnos is recording parameter - High ECT_4" ULONG OneToOne 1 100 0.00 4294967295.00 FORMAT "%13.2" ECU_ADDRESS 0x6003622C /end MEASUREMENT
/begin MEASUREMENT VehStc_numMisfDetnHiEct5 "Misfire diagnos is recording parameter - High ECT_5" ULONG OneToOne 1 100 0.00 4294967295.00 FORMAT "%13.2" ECU_ADDRESS 0x60036228 /end MEASUREMENT
/begin MEASUREMENT VehStc_numMisfDetnHiEct6 "Misfire diagnos is recording parameter - High ECT_6" ULONG OneToOne 1 100 0.00 4294967295.00 FORMAT "%13.2" ECU_ADDRESS 0x60036224 /end MEASUREMENT
/begin MEASUREMENT VehStc_numMisfDetnHiEct7 "Misfire diagnos is recording parameter - High ECT_7" ULONG OneToOne 1 100 0.00 4294967295.00 FORMAT "%13.2" ECU_ADDRESS 0x60036220 /end MEASUREMENT
/begin MEASUREMENT VehStc_numMisfDetnHiEct8 "Misfire diagnos is recording parameter - High ECT_8" ULONG OneToOne 1 100 0.00 4294967295.00 FORMAT "%13.2" ECU_ADDRESS 0x6003621C /end MEASUREMENT
/begin MEASUREMENT VehStc_numMisfDetnHiEct9 "Misfire diagnos is recording parameter - High ECT_9" ULONG OneToOne 1 100 0.00 4294967295.00 FORMAT "%13.2" ECU_ADDRESS 0x60036218 /end MEASUREMENT
/begin MEASUREMENT VehStc_numMisfDetnHiEctA "Misfire diagnos is recording parameter - High ECT_Array" ULONG OneToOne 1 100 0.00 4294967295.00 FORMAT "%13.2" ARRAY_SIZE 21 ECU_ADDRESS 0x60001B68 /end MEASUREMENT
/begin MEASUREMENT VehStc_numMisfDetnLo0 "Misfire diagnos is recording parameter- Low ECT_0" ULONG OneToOne 1 100 0.00 4294967295.00 FORMAT "%13.2" ECU_ADDRESS 0x60036214 /end MEASUREMENT
/begin MEASUREMENT VehStc_numMisfDetnLo1 "Misfire diagnos is recording parameter- Low ECT_1" ULONG OneToOne 1 100 0.00 4294967295.00 FORMAT "%13.2" ECU_ADDRESS 0x60036210 /end MEASUREMENT
/begin MEASUREMENT VehStc_numMisfDetnLo10 "Misfire diagnos is recording parameter- Low ECT_10" ULONG OneToOne 1 100 0.00 4294967295.00 FORMAT "%13.2" ECU_ADDRESS 0x6003620C /end MEASUREMENT
/begin MEASUREMENT VehStc_numMisfDetnLo11 "Misfire diagnos is recording parameter- Low ECT_11" ULONG OneToOne 1 100 0.00 4294967295.00 FORMAT "%13.2" ECU_ADDRESS 0x60036208 /end MEASUREMENT
/begin MEASUREMENT VehStc_numMisfDetnLo12 "Misfire diagnos is recording parameter- Low ECT_12" ULONG OneToOne 1 100 0.00 4294967295.00 FORMAT "%13.2" ECU_ADDRESS 0x60036204 /end MEASUREMENT
/begin MEASUREMENT VehStc_numMisfDetnLo13 "Misfire diagnos is recording parameter- Low ECT_13" ULONG OneToOne 1 100 0.00 4294967295.00 FORMAT "%13.2" ECU_ADDRESS 0x60036200 /end MEASUREMENT
/begin MEASUREMENT VehStc_numMisfDetnLo14 "Misfire diagnos is recording parameter- Low ECT_14" ULONG OneToOne 1 100 0.00 4294967295.00 FORMAT "%13.2" ECU_ADDRESS 0x600361FC /end MEASUREMENT
/begin MEASUREMENT VehStc_numMisfDetnLo15 "Misfire diagnos is recording parameter- Low ECT_15" ULONG OneToOne 1 100 0.00 4294967295.00 FORMAT "%13.2" ECU_ADDRESS 0x600361F8 /end MEASUREMENT
/begin MEASUREMENT VehStc_numMisfDetnLo16 "Misfire diagnos is recording parameter- Low ECT_16" ULONG OneToOne 1 100 0.00 4294967295.00 FORMAT "%13.2" ECU_ADDRESS 0x600361F4 /end MEASUREMENT
/begin MEASUREMENT VehStc_numMisfDetnLo17 "Misfire diagnos is recording parameter- Low ECT_17" ULONG OneToOne 1 100 0.00 4294967295.00 FORMAT "%13.2" ECU_ADDRESS 0x600361F0 /end MEASUREMENT
/begin MEASUREMENT VehStc_numMisfDetnLo18 "Misfire diagnos is recording parameter- Low ECT_18" ULONG OneToOne 1 100 0.00 4294967295.00 FORMAT "%13.2" ECU_ADDRESS 0x600361EC /end MEASUREMENT
/begin MEASUREMENT VehStc_numMisfDetnLo19 "Misfire diagnos is recording parameter- Low ECT_19" ULONG OneToOne 1 100 0.00 4294967295.00 FORMAT "%13.2" ECU_ADDRESS 0x600361E8 /end MEASUREMENT
/begin MEASUREMENT VehStc_numMisfDetnLo2 "Misfire diagnos is recording parameter- Low ECT_2" ULONG OneToOne 1 100 0.00 4294967295.00 FORMAT "%13.2" ECU_ADDRESS 0x600361E4 /end MEASUREMENT
/begin MEASUREMENT VehStc_numMisfDetnLo20 "Misfire diagnos is recording parameter- Low ECT_20" ULONG OneToOne 1 100 0.00 4294967295.00 FORMAT "%13.2" ECU_ADDRESS 0x600361E0 /end MEASUREMENT
/begin MEASUREMENT VehStc_numMisfDetnLo3 "Misfire diagnos is recording parameter- Low ECT_3" ULONG OneToOne 1 100 0.00 4294967295.00 FORMAT "%13.2" ECU_ADDRESS 0x600361DC /end MEASUREMENT
/begin MEASUREMENT VehStc_numMisfDetnLo4 "Misfire diagnos is recording parameter- Low ECT_4" ULONG OneToOne 1 100 0.00 4294967295.00 FORMAT "%13.2" ECU_ADDRESS 0x600361D8 /end MEASUREMENT
/begin MEASUREMENT VehStc_numMisfDetnLo5 "Misfire diagnos is recording parameter- Low ECT_5" ULONG OneToOne 1 100 0.00 4294967295.00 FORMAT "%13.2" ECU_ADDRESS 0x600361D4 /end MEASUREMENT
/begin MEASUREMENT VehStc_numMisfDetnLo6 "Misfire diagnos is recording parameter- Low ECT_6" ULONG OneToOne 1 100 0.00 4294967295.00 FORMAT "%13.2" ECU_ADDRESS 0x600361D0 /end MEASUREMENT
/begin MEASUREMENT VehStc_numMisfDetnLo7 "Misfire diagnos is recording parameter- Low ECT_7" ULONG OneToOne 1 100 0.00 4294967295.00 FORMAT "%13.2" ECU_ADDRESS 0x600361CC /end MEASUREMENT
/begin MEASUREMENT VehStc_numMisfDetnLo8 "Misfire diagnos is recording parameter- Low ECT_8" ULONG OneToOne 1 100 0.00 4294967295.00 FORMAT "%13.2" ECU_ADDRESS 0x600361C8 /end MEASUREMENT
/begin MEASUREMENT VehStc_numMisfDetnLo9 "Misfire diagnos is recording parameter- Low ECT_9" ULONG OneToOne 1 100 0.00 4294967295.00 FORMAT "%13.2" ECU_ADDRESS 0x600361C4 /end MEASUREMENT
/begin MEASUREMENT VehStc_numMisfDetnLoEctA "Misfire diagnos is recording parameter- Low ECT_Array" ULONG OneToOne 1 100 0.00 4294967295.00 FORMAT "%13.2" ARRAY_SIZE 21 ECU_ADDRESS 0x60001B14 /end MEASUREMENT
/begin MEASUREMENT VehStc_numMisfDetnNormA "Misfire diagnos is recording parameter" ULONG OneToOne 1 100 0.00 4294967295.00 FORMAT "%13.2" ARRAY_SIZE 21 ECU_ADDRESS 0x60001AC0 /end MEASUREMENT
/begin MEASUREMENT VehStc_pIntkMnfld "Intake manifold pressure (mmHg)" ULONG p_uw_q0p039_mmHg 1 100 0.00 125839807.057 FORMAT "%13.3" ECU_ADDRESS 0x60000B74 /end MEASUREMENT
/begin MEASUREMENT VehStc_rDiagRsltB10 "Result catalyst diagnosis _ first element" UWORD fak_uw_b16 1 100 0.00 15.99976 FORMAT "%8.5" ECU_ADDRESS 0x600361C0 /end MEASUREMENT
/begin MEASUREMENT VehStc_rDiagRsltB11 "Result catalyst diagnosis _ second element" UWORD fak_uw_b16 1 100 0.00 15.99976 FORMAT "%8.5" ECU_ADDRESS 0x600361BE /end MEASUREMENT
/begin MEASUREMENT VehStc_rDiagRsltB12 "Result catalyst diagnosis _ third element" UWORD fak_uw_b16 1 100 0.00 15.99976 FORMAT "%8.5" ECU_ADDRESS 0x600361BC /end MEASUREMENT
/begin MEASUREMENT VehStc_rDiagRsltB13 "Result catalyst diagnosis _ fourth element" UWORD fak_uw_b16 1 100 0.00 15.99976 FORMAT "%8.5" ECU_ADDRESS 0x600361BA /end MEASUREMENT
/begin MEASUREMENT VehStc_rDiagRsltB14 "Result catalyst diagnosis _ fifth element" UWORD fak_uw_b16 1 100 0.00 15.99976 FORMAT "%8.5" ECU_ADDRESS 0x600361B8 /end MEASUREMENT
/begin MEASUREMENT VehStc_rDiagRsltB1A "The latest 5 times of catalyst monitor test result" UWORD fak_uw_b16 1 100 0.00 15.99976 FORMAT "%8.5" ARRAY_SIZE 5 ECU_ADDRESS 0x6000343A /end MEASUREMENT
/begin MEASUREMENT VehStc_stbasalCdn "flag indicating the basal condition status" UBYTE B_TRUE 1 100 0.00 1.00000000000 BIT_MASK 0x1 FORMAT "%13.11" ECU_ADDRESS 0x60000B73 /end MEASUREMENT
/begin MEASUREMENT VehStc_stEngManStrtd "status indicating engine manually started" UBYTE B_TRUE 1 100 0.00 1.00000000000 BIT_MASK 0x1 FORMAT "%13.11" ECU_ADDRESS 0x60000B72 /end MEASUREMENT
/begin MEASUREMENT VehStc_stEngSpdLo "Engine speed status low" UBYTE B_TRUE 1 100 0.00 1.00000000000 BIT_MASK 0x1 FORMAT "%13.11" ECU_ADDRESS 0x60000B71 /end MEASUREMENT
/begin MEASUREMENT VehStc_stEngSpdLowr "Engine speed status lower 1000rpm" UBYTE B_TRUE 1 100 0.00 1.00000000000 BIT_MASK 0x1 FORMAT "%13.11" ECU_ADDRESS 0x60000B70 /end MEASUREMENT
/begin MEASUREMENT VehStc_stEngSpdMed "Engine speed status medium" UBYTE B_TRUE 1 100 0.00 1.00000000000 BIT_MASK 0x1 FORMAT "%13.11" ECU_ADDRESS 0x60000B6F /end MEASUREMENT
/begin MEASUREMENT VehStc_stEngSpdSHi "Engine speed status high" UBYTE B_TRUE 1 100 0.00 1.00000000000 BIT_MASK 0x1 FORMAT "%13.11" ECU_ADDRESS 0x60000B6E /end MEASUREMENT
/begin MEASUREMENT VehStc_stEngSpdTop "Engine speed status top" UBYTE B_TRUE 1 100 0.00 1.00000000000 BIT_MASK 0x1 FORMAT "%13.11" ECU_ADDRESS 0x60000B6D /end MEASUREMENT
/begin MEASUREMENT VehStc_stEntryCdn "entry condition indicating status ISS fault" UBYTE B_TRUE 1 100 0.00 1.00000000000 BIT_MASK 0x1 FORMAT "%13.11" ECU_ADDRESS 0x60000B6C /end MEASUREMENT
/begin MEASUREMENT VehStc_stIntkPHi "Intake manifold pressure high" UBYTE B_TRUE 1 100 0.00 1.00000000000 BIT_MASK 0x1 FORMAT "%13.11" ECU_ADDRESS 0x60000B6B /end MEASUREMENT
/begin MEASUREMENT VehStc_stIntkPLo "Intake manifold pressure low" UBYTE B_TRUE 1 100 0.00 1.00000000000 BIT_MASK 0x1 FORMAT "%13.11" ECU_ADDRESS 0x60000B6A /end MEASUREMENT
/begin MEASUREMENT VehStc_stIntkPMed "Intake manifold pressure medium" UBYTE B_TRUE 1 100 0.00 1.00000000000 BIT_MASK 0x1 FORMAT "%13.11" ECU_ADDRESS 0x60000B69 /end MEASUREMENT
/begin MEASUREMENT VehStc_stIntkPTop "Intake manifold pressure top" UBYTE B_TRUE 1 100 0.00 1.00000000000 BIT_MASK 0x1 FORMAT "%13.11" ECU_ADDRESS 0x60000B68 /end MEASUREMENT
/begin MEASUREMENT VehStc_stISSOff "Status indicates reasons caused the Idle Stop off" UWORD OneToOne 1 100 0.00 65535.00 FORMAT "%8.2" ECU_ADDRESS 0x60000B66 /end MEASUREMENT
/begin MEASUREMENT VehStc_stSSE "COVOM current status" UBYTE OneToOne 1 100 0.00 255.0 FORMAT "%5.1" ECU_ADDRESS 0x60000B65 /end MEASUREMENT
/begin MEASUREMENT VehStc_stSSEOld "COVOM old staus" UBYTE OneToOne 1 100 0.00 255.0 FORMAT "%5.1" ECU_ADDRESS 0x60000B64 /end MEASUREMENT
/begin MEASUREMENT VehStc_stStopReqCdn "status Stop Request Condition in Off AT" UBYTE B_TRUE 1 100 0.00 1.00000000000 BIT_MASK 0x1 FORMAT "%13.11" ECU_ADDRESS 0x60000B63 /end MEASUREMENT
/begin MEASUREMENT VehStc_stVehSpdCdn "status of the vehicle speed condition" UBYTE B_TRUE 1 100 0.00 1.00000000000 BIT_MASK 0x1 FORMAT "%13.11" ECU_ADDRESS 0x60000B62 /end MEASUREMENT
/begin MEASUREMENT VehStc_sumFuDiagRecA "Fuel system diagnos sum is recording parameter" ULONG fak_uw_b2 1 100 0.00 131071.999969 FORMAT "%13.6" ARRAY_SIZE 21 ECU_ADDRESS 0x600011B8 /end MEASUREMENT
/begin MEASUREMENT VehStc_tiRtCity "Time taken by the vehicle in city zone during current driving cycle" ULONG t_q0p1 1 100 0.00 429496729.500 FORMAT "%13.3" ECU_ADDRESS 0x600361B4 /end MEASUREMENT
/begin MEASUREMENT VehStc_tiRtCityEco "Time taken by the vehicle in city zone during current driving cycle with Economy mode ON" ULONG t_q0p1 1 100 0.00 429496729.500 FORMAT "%13.3" ECU_ADDRESS 0x600361B0 /end MEASUREMENT
/begin MEASUREMENT VehStc_tiRtHighWay "Time taken by the vehicle in Highway zone during current driving cycle" ULONG t_q0p1 1 100 0.00 429496729.500 FORMAT "%13.3" ECU_ADDRESS 0x600361AC /end MEASUREMENT
/begin MEASUREMENT VehStc_tiRtHighWayEco "Time taken by the vehicle in Highway zone during current driving cycle with Economy Mode ON" ULONG t_q0p1 1 100 0.00 429496729.500 FORMAT "%13.3" ECU_ADDRESS 0x600361A8 /end MEASUREMENT
/begin MEASUREMENT VehStc_tiRtISSOffAC "Time taken to prevent the vehicle from Idle Stop due to air conditioning" ULONG t_q0p1 1 100 0.00 429496729.500 FORMAT "%13.3" ECU_ADDRESS 0x600361A4 /end MEASUREMENT
/begin MEASUREMENT VehStc_tiRtISSOffAT "Time taken to prevent the vehicle from Idle Stop due to AT request" ULONG t_q0p1 1 100 0.00 429496729.500 FORMAT "%13.3" ECU_ADDRESS 0x600361A0 /end MEASUREMENT
/begin MEASUREMENT VehStc_tiRtISSOffATSlope "Time taken to prevent the vehicle from Idle Stop due to slope detection of AT" ULONG t_q0p1 1 100 0.00 429496729.500 FORMAT "%13.3" ECU_ADDRESS 0x6003619C /end MEASUREMENT
/begin MEASUREMENT VehStc_tiRtISSOffBat "Time taken to prevent the vehicle from Idle Stop due to battery charging" ULONG t_q0p1 1 100 0.00 429496729.500 FORMAT "%13.3" ECU_ADDRESS 0x60036198 /end MEASUREMENT
/begin MEASUREMENT VehStc_tiRtISSOffBrkBoost "Time taken to prevent the vehicle from Idle Stop due to request of brake booster" ULONG t_q0p1 1 100 0.00 429496729.500 FORMAT "%13.3" ECU_ADDRESS 0x60036194 /end MEASUREMENT
/begin MEASUREMENT VehStc_tiRtISSOffDCDC "Time taken to prevent the vehicle from Idle Stop due to DCDC converter" ULONG t_q0p1 1 100 0.00 429496729.500 FORMAT "%13.3" ECU_ADDRESS 0x60036190 /end MEASUREMENT
/begin MEASUREMENT VehStc_tiRtISSOffPwrSteer "Time taken to prevent the vehicle from Idle Stop due to power steering" ULONG t_q0p1 1 100 0.00 429496729.500 FORMAT "%13.3" ECU_ADDRESS 0x6003618C /end MEASUREMENT
/begin MEASUREMENT VehStc_tiRtISSOffSys "Time taken to prevent the vehicle from Idle Stop due to system failure, or driver absent" ULONG t_q0p1 1 100 0.00 429496729.500 FORMAT "%13.3" ECU_ADDRESS 0x60036188 /end MEASUREMENT
/begin MEASUREMENT VehStc_tiRtISSOffTempEng "Time taken to prevent the vehicle from Idle Stop due to engine temperature" ULONG t_q0p1 1 100 0.00 429496729.500 FORMAT "%13.3" ECU_ADDRESS 0x60036184 /end MEASUREMENT
/begin MEASUREMENT VehStc_tiRtISSOffUser "Time taken to prevent the vehicle from Idle Stop due to user turned off" ULONG t_q0p1 1 100 0.00 429496729.500 FORMAT "%13.3" ECU_ADDRESS 0x60036180 /end MEASUREMENT
/begin MEASUREMENT VehStc_tiRtISSOffvVeh "Time taken to prevent the vehicle from Idle Stop due to vehicle speed condition" ULONG t_q0p1 1 100 0.00 429496729.500 FORMAT "%13.3" ECU_ADDRESS 0x6003617C /end MEASUREMENT
/begin MEASUREMENT VehStc_tiRtISSStop "Time taken by the vehicle when the vehicle being in Idle stop" ULONG t_q0p1 1 100 0.00 429496729.500 FORMAT "%13.3" ECU_ADDRESS 0x60036178 /end MEASUREMENT
/begin MEASUREMENT VehStc_tiRtStop "Time taken by the vehicle in Stop zone during current driving cycle" ULONG t_q0p1 1 100 0.00 429496729.500 FORMAT "%13.3" ECU_ADDRESS 0x60036174 /end MEASUREMENT
/begin MEASUREMENT VehStc_tiRtStopSpstOn "Time Taken by the vehicle in Idle Stop condition" ULONG t_q0p1 1 100 0.00 429496729.500 FORMAT "%13.3" ECU_ADDRESS 0x60036170 /end MEASUREMENT
/begin MEASUREMENT VehStc_tiRtStopStspDrvrOff "Time the ISS Inhibit switch is Enabled intentionally by the Driver" ULONG t_q0p1 1 100 0.00 429496729.500 FORMAT "%13.3" ECU_ADDRESS 0x6003616C /end MEASUREMENT
/begin MEASUREMENT VehStc_tiRtStopStspOffSysReq "Time taken to prevent the vehicle from Idle Stop due to System Requirements not satisfied for ISS" ULONG t_q0p1 1 100 0.00 429496729.500 FORMAT "%13.3" ECU_ADDRESS 0x60036168 /end MEASUREMENT
/begin MEASUREMENT VehStc_volActFuCns "Actual volume of Fuel consumed by the vehicle" UWORD volFilgLvl_ml 1 100 0.00 65535.00 FORMAT "%8.2" ECU_ADDRESS 0x60000B60 /end MEASUREMENT
/begin MEASUREMENT VehStc_volCnsCityDcyc "Volume consumed in current driving cycle by the vehicle in the city zone" ULONG volFilgLvl_ml 1 100 0.00 4294967295.00 FORMAT "%13.2" ECU_ADDRESS 0x60036164 /end MEASUREMENT
/begin MEASUREMENT VehStc_volCnsCityEcoDcyc "Volume consumed in current driving cycle by the vehicle in the city zone with Economy mode ON" ULONG volFilgLvl_ml 1 100 0.00 4294967295.00 FORMAT "%13.2" ECU_ADDRESS 0x60036160 /end MEASUREMENT
/begin MEASUREMENT VehStc_volCnsHighWayDcyc "Volume Consumed by the vehicle in the highway zone for current driving cycle" ULONG volFilgLvl_ml 1 100 0.00 4294967295.00 FORMAT "%13.2" ECU_ADDRESS 0x6003615C /end MEASUREMENT
/begin MEASUREMENT VehStc_volCnsHighWayEcoDcyc "Volume Consumed by the vehicle in the highway zone for current driving cycle with Economy Mode ON" ULONG volFilgLvl_ml 1 100 0.00 4294967295.00 FORMAT "%13.2" ECU_ADDRESS 0x60036158 /end MEASUREMENT
/begin MEASUREMENT VehStc_volCnsStopDcyc "Volume Consumed by the vehicle in the Stop zone for current driving cycle" ULONG volFilgLvl_ml 1 100 0.00 4294967295.00 FORMAT "%13.2" ECU_ADDRESS 0x60036154 /end MEASUREMENT
/begin MEASUREMENT VehStc_volFuCnsOld "Value in the previous raster (in 100ms) of cumulative fuel quantity that has been injected since the start of the driving cycle." ULONG volFilgLvl_ml 1 100 0.00 4294967295.00 FORMAT "%13.2" ECU_ADDRESS 0x60000B5C /end MEASUREMENT
/begin MEASUREMENT Veh_flgDyn "Vehicle state dynamic drive active" UBYTE B_TRUE 1 100 0.00 1.00000000000 BIT_MASK 0x1 FORMAT "%13.11" ECU_ADDRESS 0x6000A10D /end MEASUREMENT
/begin FUNCTION UEGO_HtrCtl "1.29.0    UEGO heater control"
 /begin DEF_CHARACTERISTIC UEGO_dUHtrRmp_C UEGO_facdeltaURampErr_C UEGO_facGovKD_C UEGO_facGovKI_C UEGO_facGovKP_C UEGO_facTiCrvErr_C UEGO_facTiHldErr_C UEGO_facUCrvErr_C UEGO_facUHldErr_C UEGO_facURampErr_C UEGO_tDeRstElecPwrHi_C UEGO_tDeSetElecPwrHi_C UEGO_tHeatrCrvMax_C UEGO_tHtrCtlCLEna_C UEGO_tiDlyHeatrPSOff_C UEGO_tiDlyOLEnded_C UEGO_tiDlySetElecPwrHi_C UEGO_tiDlySnsrHot_C UEGO_tiHeatrCrvMax_C UEGO_tiHeatrHold_C UEGO_uHtrEffMin_C UEGO_uHtrEffRed_C UEGO_uHtrRmpMax_C UEGO_uHtrStopIntgl_C UEGO_tiRmpEnaDiffMin_C UEGO_HtrCtlS1B1_I.stHeatrCtrl_C UEGO_HtrCtlS1B1_I.uHeatrCrv_T UEGO_HtrCtlS1B1_I.uHeatrHoldRmpStrt_T UEGO_tCerSetPt_C UEGO_tMaxCLCtlDvtLrg_C UEGO_tMaxCLCtlDvtSml_C UEGO_uHtrCLMax_C /end DEF_CHARACTERISTIC
 /begin IN_MEASUREMENT BattU_u EnvT_t SyC_ctPostDrvLeave SyC_stSub UEGO_flgDiagRprtRelsS1B1 UEGO_flgDsmTripChgFinshd UEGO_flgEngActvStsS1B1 UEGO_flgHeatrPSCtrlMaxS1B1 UEGO_flgHeatrPsErrS1B1 UEGO_flgHeatrPSOffS1B1 UEGO_flgHeatrRelsATSS1B1 UEGO_flgOperRelsPreEngStrtS1B1 UEGO_flgOperRelsS1B1 UEGO_flgRTEvlnVldS1B1 UEGO_flgSnsrMdlHotS1B1 UEGO_idxTypS1B1 UEGO_mEgFlowS1B1 UEGO_tCerS1B1 UEGO_tEgMdlS1B1 UEGO_tWallMdlS1B1 /end IN_MEASUREMENT
 /begin OUT_MEASUREMENT B_hlsumx_msg B_hstlsua_msg UEGO_bHtrCtlActvS1B1 UEGO_bHtrCtlCLtDvtLrgS1B1 UEGO_bHtrCtlCLtDvtSmlS1B1 UEGO_flgCtrldModActvS1B1 UEGO_flgElecPwrHi UEGO_flgHeatgUpFinshdS1B1 UEGO_flgHtrCtlHeatgUpFinshdS1B1 UEGO_flgSnsrHotS1B1 UEGO_flgTCtrlDeLrgS1B1 UEGO_flgTCtrlDeSmallS1B1 UEGO_stDsqTCtrlS1B1 UEGO_tCtlDvtS1B1 UEGO_uHtrCtlEffS1B1 /end OUT_MEASUREMENT
 /begin LOC_MEASUREMENT UEGO_flgElecPwrHiS1B1 UEGO_HtrCtlS1B1_I.cntrReiniProc20msec UEGO_HtrCtlS1B1_I.flgCLActv UEGO_HtrCtlS1B1_I.flgCtlCLLimd UEGO_HtrCtlS1B1_I.flgCtrldModActv UEGO_HtrCtlS1B1_I.flgElecPwrHi UEGO_HtrCtlS1B1_I.flgErrModActv UEGO_HtrCtlS1B1_I.flgOLActv UEGO_HtrCtlS1B1_I.flgOLCrvFinshd UEGO_HtrCtlS1B1_I.flgOLEna UEGO_HtrCtlS1B1_I.flgOLHldFinshd UEGO_HtrCtlS1B1_I.flgOLRampFinshd UEGO_HtrCtlS1B1_I.flgProtdModActv UEGO_HtrCtlS1B1_I.flgSnsrHot UEGO_HtrCtlS1B1_I.flgStopIntgl UEGO_HtrCtlS1B1_I.flgTDsbc UEGO_HtrCtlS1B1_I.tDvtCLOld UEGO_HtrCtlS1B1_I.uCtl UEGO_HtrCtlS1B1_I.uCtlCL UEGO_HtrCtlS1B1_I.uCtlCLD UEGO_HtrCtlS1B1_I.uCtlCLI UEGO_HtrCtlS1B1_I.uCtlCLP UEGO_HtrCtlS1B1_I.uCtlCLTot UEGO_HtrCtlS1B1_I.uCtlOL UEGO_HtrCtlS1B1_I.CtrlCLIntglITL_I.memory UEGO_HtrCtlS1B1_I.DlyElecPwrHiTONV_I.outbit UEGO_HtrCtlS1B1_I.DlyElecPwrHiTONV_I.time UEGO_HtrCtlS1B1_I.HeatgUpFinshdFF_I.status UEGO_HtrCtlS1B1_I.OLEndedTONV_I.outbit UEGO_HtrCtlS1B1_I.OLEndedTONV_I.time UEGO_HtrCtlS1B1_I.SwitchOverFF_I.status UEGO_HtrCtlS1B1_I.bHtrCtlCLActvER_I.buffer UEGO_HtrCtlS1B1_I.bHtrCtlCLActvER_I.oldSignal UEGO_HtrCtlS1B1_I.flgHeatgUpFinshdTONV_I.outbit UEGO_HtrCtlS1B1_I.flgHeatgUpFinshdTONV_I.time UEGO_HtrCtlS1B1_I.flgOLActvER_I.buffer UEGO_HtrCtlS1B1_I.flgOLActvER_I.oldSignal UEGO_HtrCtlS1B1_I.flgOLCrvFinshdER_I.buffer UEGO_HtrCtlS1B1_I.flgOLCrvFinshdER_I.oldSignal UEGO_HtrCtlS1B1_I.flgOLHldFinshdTONV_I.outbit UEGO_HtrCtlS1B1_I.flgOLHldFinshdTONV_I.time UEGO_HtrCtlS1B1_I.flgPSOffTONV_I.outbit UEGO_HtrCtlS1B1_I.flgPSOffTONV_I.time UEGO_HtrCtlS1B1_I.tiCurvePhaseSW_I.timeCounter UEGO_HtrCtlS1B1_I.uHtrRampIT_I.memory UEGO_SimRampLock_I.cntrReinicalc20msec UEGO_SimRampLock_I.lock UEGO_SimRampLock_I.tiRmpStrtDiffSW_I.timeCounter /end LOC_MEASUREMENT
 FUNCTION_VERSION "1.29.0" /end FUNCTION
/begin FUNCTION UEGO_HtrCtlDia "1.31.1    UEGO heater control diagnosis"
 /begin DEF_CHARACTERISTIC UEGO_tEngStrt_C UEGO_tiDlyFctDemTstr_C UEGO_HeatrCtrlDiagClassS1B1.UEGO_tiDlyAllVlvActv_C UEGO_HeatrCtrlDiagClassS1B1.UEGO_tiHeatrOff_C UEGO_HeatrCtrlDiagClassS1B1.stHeatrCtrlDiag_C UEGO_HeatrCtrlDiagClassS1B1.tCerMin_C UEGO_HeatrCtrlDiagClassS1B1.tCerOpMin_C UEGO_HeatrCtrlDiagClassS1B1.tEgSysLoDiag_C UEGO_HeatrCtrlDiagClassS1B1.tEgSysPrmntDiag_C UEGO_HeatrCtrlDiagClassS1B1.tWallHealFctDemTstr_C UEGO_HeatrCtrlDiagClassS1B1.tWallHeal_C UEGO_HeatrCtrlDiagClassS1B1.tWallMdl_C UEGO_HeatrCtrlDiagClassS1B1.tiDlyFlgOvrRunTOFFV_C UEGO_HeatrCtrlDiagClassS1B1.tiDlyFlgOvrRunTONV_C UEGO_HeatrCtrlDiagClassS1B1.tiDlyHealPasHeatgFctDemTstr_C UEGO_HeatrCtrlDiagClassS1B1.tiDlyHealPasHeatg_C UEGO_HeatrCtrlDiagClassS1B1.tiFuCutOffDlyLoDiag_C UEGO_HeatrCtrlDiagClassS1B1.tiHeatgCtrlActvDly_C UEGO_HeatrCtrlDiagClassS1B1.tiLoDiagDly_C UEGO_HeatrCtrlDiagClassS1B1.tiLoDiagErrDly_C UEGO_HeatrCtrlDiagClassS1B1.tiPrmntDiagDurn_C UEGO_HeatrCtrlDiagClassS1B1.tiPrmntDiagHealDly_C UEGO_HeatrCtrlDiagClassS1B1.tiStrtDiagDurnCalcd_T UEGO_HeatrCtrlDiagClassS1B1.tiWrgSysCdnDurn_C UEGO_HeatrCtrlDiagClassS1B1.uHeatgCtrlEfcPrmntDiagThd_C /end DEF_CHARACTERISTIC
 /begin REF_CHARACTERISTIC UEGO_tCerSetPt_C UEGO_tMaxCLCtlDvtLrg_C UEGO_uHtrCLMax_C /end REF_CHARACTERISTIC
 /begin IN_MEASUREMENT Eep_EnvRamHist Eep_EnvRamInvld BattU_u B_fabe_msg B_fa_msg B_sa_msg CEngDsT_t CEngDsT_tStrt SyC_ctPostDrvLeave TiOff_stTiStrtEndOff TiOff_tiStrtEndOff UEGO_flgAllVlvActv UEGO_flgDiagRprtRelsS1B1 UEGO_flgDsmTripChgFinshd UEGO_flgEngActvStsS1B1 UEGO_flgEngRunng UEGO_flgOperRelsS1B1 UEGO_flgUBattMax UEGO_idxTypS1B1 UEGO_mEgFlowS1B1 UEGO_tCerS1B1 UEGO_tEgMdlS1B1 UEGO_tWallMdlS1B1 UEGO_uHtrCtlEffS1B1 /end IN_MEASUREMENT
 /begin OUT_MEASUREMENT tkerdcmn_w_msg twvsom_w_msg UEGO_flgHeatrCtrlErrS1B1 UEGO_flgStrtDiagCmplS1B1 /end OUT_MEASUREMENT
 /begin LOC_MEASUREMENT UEGO_HeatrCtrlDiagClassS1B1.cntrNotEngRunng UEGO_HeatrCtrlDiagClassS1B1.cntrReiniCalc100ms UEGO_HeatrCtrlDiagClassS1B1.flgDSMClrReq UEGO_HeatrCtrlDiagClassS1B1.flgDiagHeatgCtrlHeal UEGO_HeatrCtrlDiagClassS1B1.flgEGMdlInvld UEGO_HeatrCtrlDiagClassS1B1.flgFctDem UEGO_HeatrCtrlDiagClassS1B1.flgFctDemTstrBEnd UEGO_HeatrCtrlDiagClassS1B1.flgHeatrCtlErr UEGO_HeatrCtrlDiagClassS1B1.flgHeatrStrtd UEGO_HeatrCtrlDiagClassS1B1.flgHeatrStrtdEdgeRise UEGO_HeatrCtrlDiagClassS1B1.flgIUMPRCmpl UEGO_HeatrCtrlDiagClassS1B1.flgLoDiagErr UEGO_HeatrCtrlDiagClassS1B1.flgLoDiagRels UEGO_HeatrCtrlDiagClassS1B1.flgLockCntrNotEngRunng UEGO_HeatrCtrlDiagClassS1B1.flgOvrRun UEGO_HeatrCtrlDiagClassS1B1.flgPasHeatgNot UEGO_HeatrCtrlDiagClassS1B1.flgPrmntDiagCmpl UEGO_HeatrCtrlDiagClassS1B1.flgPrmntDiagErr UEGO_HeatrCtrlDiagClassS1B1.flgPrmntDiagHeal UEGO_HeatrCtrlDiagClassS1B1.flgPrmntDiagHealSuspc UEGO_HeatrCtrlDiagClassS1B1.flgPrmntDiagNumCmpl UEGO_HeatrCtrlDiagClassS1B1.flgPrmntDiagRels UEGO_HeatrCtrlDiagClassS1B1.flgRprtErrStrtDiag UEGO_HeatrCtrlDiagClassS1B1.flgSrv06Actv UEGO_HeatrCtrlDiagClassS1B1.flgSrv06ResAvl UEGO_HeatrCtrlDiagClassS1B1.flgStrtDiagCmpl UEGO_HeatrCtrlDiagClassS1B1.flgStrtDiagEna UEGO_HeatrCtrlDiagClassS1B1.flgStrtDiagEngNotRunng UEGO_HeatrCtrlDiagClassS1B1.flgStrtDiagEnvtlErr UEGO_HeatrCtrlDiagClassS1B1.flgStrtDiagEnvtlHeal UEGO_HeatrCtrlDiagClassS1B1.flgStrtDiagErr UEGO_HeatrCtrlDiagClassS1B1.flgStrtDiagErrRels UEGO_HeatrCtrlDiagClassS1B1.flgStrtDiagErrSuspc UEGO_HeatrCtrlDiagClassS1B1.flgStrtDiagHeal UEGO_HeatrCtrlDiagClassS1B1.flgStrtDiagHealRels UEGO_HeatrCtrlDiagClassS1B1.flgStrtDiagNoResEdgeFall UEGO_HeatrCtrlDiagClassS1B1.flgStrtDiagNumCmpl UEGO_HeatrCtrlDiagClassS1B1.flgStrtDiagPid41 UEGO_HeatrCtrlDiagClassS1B1.flgStrtDiagStrtd UEGO_HeatrCtrlDiagClassS1B1.flgStrtDiagSysCdnOk UEGO_HeatrCtrlDiagClassS1B1.flgStrtDiagTCeramicOK UEGO_HeatrCtrlDiagClassS1B1.flgStrtWatching UEGO_HeatrCtrlDiagClassS1B1.flgTiHeatrOffOK UEGO_HeatrCtrlDiagClassS1B1.flgTiHeatrOffVld UEGO_HeatrCtrlDiagClassS1B1.flgTiStampHeatrOffVld UEGO_HeatrCtrlDiagClassS1B1.flgTiStampHeatrOnVld UEGO_HeatrCtrlDiagClassS1B1.tCerLoDiagSrv06 UEGO_HeatrCtrlDiagClassS1B1.tCerLoThdSrv06 UEGO_HeatrCtrlDiagClassS1B1.tCerPrmntDiagSrv06 UEGO_HeatrCtrlDiagClassS1B1.tCerSrv06 UEGO_HeatrCtrlDiagClassS1B1.tCerStrtDiagSrv06 UEGO_HeatrCtrlDiagClassS1B1.tCerStrtDiagSrv06Suspc UEGO_HeatrCtrlDiagClassS1B1.tiHeatg UEGO_HeatrCtrlDiagClassS1B1.tiHeatrOff UEGO_HeatrCtrlDiagClassS1B1.tiPrmntDiagCmpl UEGO_HeatrCtrlDiagClassS1B1.tiPrmntDiagDurn UEGO_HeatrCtrlDiagClassS1B1.tiStampHeatrOff UEGO_HeatrCtrlDiagClassS1B1.tiStampHeatrOffTmp UEGO_HeatrCtrlDiagClassS1B1.tiStampHeatrOn UEGO_HeatrCtrlDiagClassS1B1.tiStrtDiagDurn UEGO_HeatrCtrlDiagClassS1B1.tiStrtDiagDurnCalcd UEGO_HeatrCtrlDiagClassS1B1.tiWrgSysCdn UEGO_HeatrCtrlDiagClassS1B1.flgAllVlvActvTOFFV_I.outbit UEGO_HeatrCtrlDiagClassS1B1.flgAllVlvActvTOFFV_I.time UEGO_HeatrCtrlDiagClassS1B1.flgEngActvStsEFNM_I.oldSignal UEGO_HeatrCtrlDiagClassS1B1.flgFctDemTstrFF_I.status UEGO_HeatrCtrlDiagClassS1B1.flgFctDemTstrTONV_I.outbit UEGO_HeatrCtrlDiagClassS1B1.flgFctDemTstrTONV_I.time UEGO_HeatrCtrlDiagClassS1B1.flgHeatrStrtdERNM_I.oldSignal UEGO_HeatrCtrlDiagClassS1B1.flgHtrCtlActvTONV_I.outbit UEGO_HeatrCtrlDiagClassS1B1.flgHtrCtlActvTONV_I.time UEGO_HeatrCtrlDiagClassS1B1.flgLoDiagErrERNM_I.oldSignal UEGO_HeatrCtrlDiagClassS1B1.flgLoDiagErrTONVNM_I.time UEGO_HeatrCtrlDiagClassS1B1.flgOperRelsEFNM_I.oldSignal UEGO_HeatrCtrlDiagClassS1B1.flgOperRelsERNM_I.oldSignal UEGO_HeatrCtrlDiagClassS1B1.flgOvrRunLoTempTOFFV_I.outbit UEGO_HeatrCtrlDiagClassS1B1.flgOvrRunLoTempTOFFV_I.time UEGO_HeatrCtrlDiagClassS1B1.flgOvrRunTOFFV_I.outbit UEGO_HeatrCtrlDiagClassS1B1.flgOvrRunTOFFV_I.time UEGO_HeatrCtrlDiagClassS1B1.flgOvrRunTONV_I.outbit UEGO_HeatrCtrlDiagClassS1B1.flgOvrRunTONV_I.time UEGO_HeatrCtrlDiagClassS1B1.flgPasHeatgDiTONVNM_I.time UEGO_HeatrCtrlDiagClassS1B1.flgPasHeatgTONVNM_I.time UEGO_HeatrCtrlDiagClassS1B1.flgPrmntDiagErrERNM_I.oldSignal UEGO_HeatrCtrlDiagClassS1B1.flgPrmntDiagHealSuspcERNM_I.oldSignal UEGO_HeatrCtrlDiagClassS1B1.flgPrmntDiagHealTONVNM_I.time UEGO_HeatrCtrlDiagClassS1B1.flgSnsrRdyTONV_I.outbit UEGO_HeatrCtrlDiagClassS1B1.flgSnsrRdyTONV_I.time UEGO_HeatrCtrlDiagClassS1B1.flgStrtDiagErrERNM_I.oldSignal UEGO_HeatrCtrlDiagClassS1B1.flgStrtDiagErrSuspcERNM_I.oldSignal UEGO_HeatrCtrlDiagClassS1B1.flgStrtDiagHealERNM_I.oldSignal UEGO_HeatrCtrlDiagClassS1B1.flgStrtDiagNoResEFNM_I.oldSignal UEGO_HeatrCtrlDiagClassS1B1.flgStrtDiagStrtdER_I.buffer UEGO_HeatrCtrlDiagClassS1B1.flgStrtDiagStrtdER_I.oldSignal UEGO_HeatrCtrlDiagClassS1B1.tCerTONV_I.outbit UEGO_HeatrCtrlDiagClassS1B1.tCerTONV_I.time UEGO_HeatrCtrlDiagClassS1B1.tiDlyPrmntDiagTONVNM_I.time UEGO_HeatrCtrlDiagClassS1B1.tiStrtDiagDurnA_I.memory UEGO_HeatrCtrlDiagClassS1B1.uBattFilLT_I.memory /end LOC_MEASUREMENT
 FUNCTION_VERSION "1.31.1" /end FUNCTION
/begin FUNCTION UEGO_HtrPSCtl "1.12.0    UEGO heater power stage control"
 /begin DEF_CHARACTERISTIC UEGO_ratHeatrPSCtrlErrMax_C UEGO_stHeatrPSCtrl_C UEGO_tiHeatrPerdDurn_C UEGO_uExtPwrSply_C UEGO_ratHeatrPSCtrlMax_C /end DEF_CHARACTERISTIC
 /begin REF_CHARACTERISTIC UEGO_idxHWES1B1_C /end REF_CHARACTERISTIC
 /begin IN_MEASUREMENT BattU_u UEGO_flgTCtrlDeLrgS1B1 UEGO_flgUBattMax UEGO_idxTypS1B1 UEGO_uBattCorrdS1B1 UEGO_uHtrCtlEffS1B1 /end IN_MEASUREMENT
 /begin OUT_MEASUREMENT tahrlsu_w_msg UEGO_flgHeatrPSCtrlMaxS1B1 UEGO_flgHeatrPSOffS1B1 UEGO_ratHeatrPSCtrlS1B1 /end OUT_MEASUREMENT
 /begin LOC_MEASUREMENT UEGO_HeatrPSCtrlS1B1_I.ratReqd /end LOC_MEASUREMENT
 FUNCTION_VERSION "1.12.0" /end FUNCTION
/begin FUNCTION UEGO_HtrPSDia "2.17.0    UEGO heater power stage diagnosis"
 /begin DEF_CHARACTERISTIC UEGO_ratHeatrPSDiagMin_C UEGO_stHeatrPSDiagDeactvn_C UEGO_nrTstPls_C UEGO_stHeatrPsDiag_C UEGO_tiBtwElecFlt_C UEGO_tiBtwOTFlt_C /end DEF_CHARACTERISTIC
 /begin IN_MEASUREMENT DevLib_stPwrStgEnaCond SyC_ctPostDrvLeave UEGO_flgDiagRprtRelsS1B1 UEGO_flgHeatrRlyActvS1B1 UEGO_idxTypS1B1 UEGO_ratHeatrPSCtrlS1B1 /end IN_MEASUREMENT
 /begin OUT_MEASUREMENT UEGO_flgHeatrPsErrS1B1 /end OUT_MEASUREMENT
 /begin LOC_MEASUREMENT UEGO_HeatrPsDiagS1B1_I.cntrReiniProc100ms UEGO_HeatrPsDiagS1B1_I.flgDSMClrReq UEGO_HeatrPsDiagS1B1_I.flgDiagRels UEGO_HeatrPsDiagS1B1_I.flgErrOL UEGO_HeatrPsDiagS1B1_I.flgErrOLRaw UEGO_HeatrPsDiagS1B1_I.flgErrSCB UEGO_HeatrPsDiagS1B1_I.flgErrSCBRaw UEGO_HeatrPsDiagS1B1_I.flgErrSCG UEGO_HeatrPsDiagS1B1_I.flgErrSCGRaw UEGO_HeatrPsDiagS1B1_I.flgHeatrPsErr UEGO_HeatrPsDiagS1B1_I.flgIniEnd UEGO_HeatrPsDiagS1B1_I.stErrInfo /end LOC_MEASUREMENT
 FUNCTION_VERSION "2.17.0" /end FUNCTION
/begin FUNCTION UEGO_IpPhysCor "1.26.0    UEGO physical correction on ip"
 /begin DEF_CHARACTERISTIC UEGO_facPCorrLean_CUR UEGO_facPCorrRich_CUR UEGO_facTCorr_CUR UEGO_stO2PhyRelsBitMask_C UEGO_tiIPmpEvlnVld_C UEGO_tiRTEvlnvld_C UEGO_tMinO2Rels_C UEGO_stIpPhysCor_C UEGO_tiDiagRprtRelsOff_C UEGO_tiDsbcActv_C UEGO_tiRPCNotActv_C UEGO_tiSnglCellSigValid_C /end DEF_CHARACTERISTIC
 /begin IN_MEASUREMENT ExhMod_pExhCat1UsB1 pabnav_w_msg UEGO_flgDiagRprtRelsS1B1 UEGO_flgIPmpEvlnVldS1B1 UEGO_flgIPmpRvsChrgVldS1B1 UEGO_flgRpcActvS1B1 UEGO_flgRTEvlnVldS1B1 UEGO_flgRvsChrgMeasActvS1B1 UEGO_flgTCtrlDeSmallS1B1 UEGO_idxTypS1B1 UEGO_iIPmpElecCorrdS1B1 UEGO_tCerS1B1 UEGO_tCtlDvtS1B1 /end IN_MEASUREMENT
 /begin OUT_MEASUREMENT lsukorp_w_msg UEGO_flgO2HiPrcsnS1B1 UEGO_flgO2PhyRelsS1B1 UEGO_iIPmpPCorrdS1B1 UEGO_iIPmpPhyCorrdS1B1 UEGO_iIPmpPTCorrdS1B1 UEGO_iIPmpSrv1S1B1 /end OUT_MEASUREMENT
 /begin LOC_MEASUREMENT UEGO_IpPhysCorS1B1_I.UEGO_stO2PhyRels UEGO_IpPhysCorS1B1_I.facPCorrLean UEGO_IpPhysCorS1B1_I.facPCorrRich UEGO_IpPhysCorS1B1_I.facTCorr UEGO_IpPhysCorS1B1_I.iPmpElecCorrdIn UEGO_IpPhysCorS1B1_I.DsbcActvdTOFFV_I.outbit UEGO_IpPhysCorS1B1_I.DsbcActvdTOFFV_I.time UEGO_IpPhysCorS1B1_I.UEGO_tiDiagRprtRelsTOFFV_I.outbit UEGO_IpPhysCorS1B1_I.UEGO_tiDiagRprtRelsTOFFV_I.time UEGO_IpPhysCorS1B1_I.UEGO_tiRTEvlnvldTOFFV_I.outbit UEGO_IpPhysCorS1B1_I.UEGO_tiRTEvlnvldTOFFV_I.time UEGO_IpPhysCorS1B1_I.flgIPmpEvlnVldTONV_I.outbit UEGO_IpPhysCorS1B1_I.flgIPmpEvlnVldTONV_I.time UEGO_IpPhysCorS1B1_I.flgRPCNotActvTONV_I.outbit UEGO_IpPhysCorS1B1_I.flgRPCNotActvTONV_I.time UEGO_IpPhysCorS1B1_I.flgSnglCellSigValidTONV_I.outbit UEGO_IpPhysCorS1B1_I.flgSnglCellSigValidTONV_I.time /end LOC_MEASUREMENT
 FUNCTION_VERSION "1.26.0" /end FUNCTION
/begin FUNCTION UEGO_LamCalc "1.34.0    UEGO lambda calculation"
 /begin DEF_CHARACTERISTIC UEGO_IntfrCorrn_CUR UEGO_rIp2LamRecprBasFu_CUR UEGO_stLamRelsBitMask_C UEGO_tCerLamInvld_C UEGO_tiConTrigFil_C UEGO_tiDlyUBattSuffLamRels_C UEGO_tiLamRelsEngStrt_C UEGO_tiLamRels_C UEGO_tiRTEvlnInvld_C UEGO_tiTCerLamInvld_C UEGO_tMinLamRels_C UEGO_rIntfrCorrnHomMod_MAP UEGO_rIntfrCorrnVHEMod_MAP UEGO_stLamCalc_C UEGO_stLamRdyGSIf_C /end DEF_CHARACTERISTIC
 /begin REF_CHARACTERISTIC UEGO_tCerSetPt_C UEGO_tiDsbcActv_C UEGO_tiRPCNotActv_C UEGO_tiSnglCellSigValid_C UEGO_tMaxCLCtlDvtSml_C /end REF_CHARACTERISTIC
 /begin IN_MEASUREMENT B_vhegfe_msg EGSDO2_flgDynAdpnLtrS1B1 EGSDO2_flgDynAdpnRtlS1B1 EGSDO2_ratLamOffsS1B1 EGSDO2_tiDlyAdpnS1B1 EGSDO2_tiTranAdpnS1B1 Epm_nEngLRes rl_w_msg T15_st UEGO_flgAirScav UEGO_flgCtrldModActvS1B1 UEGO_flgErrSuspcLoBattS1B1 UEGO_flgFastLamRelsAftAsicShtOffS1B1 UEGO_flgIPmpCtrlDsbcS1B1 UEGO_flgLamRecprMdlVld UEGO_flgRpcActvS1B1 UEGO_flgRTEvlnVldS1B1 UEGO_flgRvsChrgMeasActvS1B1 UEGO_flgUBattMin UEGO_flgUBattSuff UEGO_idxTypS1B1 UEGO_iIPmpElecCorrdS1B1 UEGO_iIPmpPhyCorrdS1B1 UEGO_ratLamRecprMdlS1B1 UEGO_tCerS1B1 /end IN_MEASUREMENT
 /begin OUT_MEASUREMENT B_elsxbb_msg B_sbblsu_msg B_sbbvk_msg lamsonb_w_msg UEGO_flgHomOperMod UEGO_flgSnsrOperRdyS1B1 UEGO_ratLamSrv1S1B1 UEGO_ratLamSymS1B1 UEGO_rLamEquivElecCorrdS1B1 UEGO_rLamRecprS1B1 UEGO_rLamS1B1 UEGO_stLamQlyS1B1 /end OUT_MEASUREMENT
 /begin LOC_MEASUREMENT UEGO_LamCalcS1B1_I.flgBascCdnReld UEGO_LamCalcS1B1_I.flgDynAdpnFil UEGO_LamCalcS1B1_I.rLamDynAdpn UEGO_LamCalcS1B1_I.rLamDynAdpnDir UEGO_LamCalcS1B1_I.rLamIntfrCorrd UEGO_LamCalcS1B1_I.rLamRecprBas UEGO_LamCalcS1B1_I.rLamRecprIntfrCorrd UEGO_LamCalcS1B1_I.rLamRecprOffsCorrd UEGO_LamCalcS1B1_I.stLamRels UEGO_LamCalcS1B1_I.stRstBascCdn UEGO_LamCalcS1B1_I.BascCdnReld_FF_I.status UEGO_LamCalcS1B1_I.LamRels_TONV_I.outbit UEGO_LamCalcS1B1_I.LamRels_TONV_I.time UEGO_LamCalcS1B1_I.flgDsbcActvTOFFV_I.outbit UEGO_LamCalcS1B1_I.flgDsbcActvTOFFV_I.time UEGO_LamCalcS1B1_I.flgFastLamRelsEngStrtTOFFV_I.outbit UEGO_LamCalcS1B1_I.flgFastLamRelsEngStrtTOFFV_I.time UEGO_LamCalcS1B1_I.flgRPCActTOFFV_I.outbit UEGO_LamCalcS1B1_I.flgRPCActTOFFV_I.time UEGO_LamCalcS1B1_I.flgRTEvlnInvld_TONV_I.outbit UEGO_LamCalcS1B1_I.flgRTEvlnInvld_TONV_I.time UEGO_LamCalcS1B1_I.flgSnglCellSigValidTOFFV_I.outbit UEGO_LamCalcS1B1_I.flgSnglCellSigValidTOFFV_I.time UEGO_LamCalcS1B1_I.flgTCerLamInvld_TONV_I.outbit UEGO_LamCalcS1B1_I.flgTCerLamInvld_TONV_I.time UEGO_LamCalcS1B1_I.flgUBattSuffTOFFV_I.outbit UEGO_LamCalcS1B1_I.flgUBattSuffTOFFV_I.time UEGO_LamCalcS1B1_I.rLamDynAdpn_LT_I.memory UEGO_LamCalcS1B1_I.tiConDynAdpnLeanRich_LT_I.memory UEGO_LamCalcS1B1_I.tiDynAdpnLeanRichDTTtOpt_I.buffer UEGO_LamCalcS1B1_I.tiDynAdpnLeanRichDTTtOpt_I.counter UEGO_LamCalcS1B1_I.tiDynAdpnLeanRichDTTtOpt_I.ds UEGO_LamCalcS1B1_I.tiDynAdpnLeanRichDTTtOpt_I.pointer UEGO_rLamDeltaIntfr UEGO_rLamDeltaScavg UEGO_rLamDeltaScavgBnk2 /end LOC_MEASUREMENT
 FUNCTION_VERSION "1.34.0" /end FUNCTION
/begin FUNCTION UEGO_LamMdl "2.0.0     Calculation of model lambda value"
 /begin IN_MEASUREMENT lamsons_w_msg UEGO_flgCmbEngTmpStop UEGO_flgEomAftRun UEGO_idxTypS1B1 /end IN_MEASUREMENT
 /begin OUT_MEASUREMENT UEGO_flgLamRecprMdlVld UEGO_ratLamRecprMdlS1B1 /end OUT_MEASUREMENT
 /begin LOC_MEASUREMENT UEGO_LamMdlClassS1B1_I.ratLamRecprMdl /end LOC_MEASUREMENT
 FUNCTION_VERSION "2.0.0" /end FUNCTION
/begin FUNCTION UEGO_OperRels "2.3.0     Sensor operation release"
 /begin DEF_CHARACTERISTIC UEGO_stOperRelsCdnMask_C UEGO_stRstOperRelsMask_C UEGO_tiAftAsicShtOffFastLamRels_C UEGO_tiDlyUBattLo_C UEGO_tiDlyUBattMax_C UEGO_tiWinAftEngRstrt_C UEGO_tiWinAftSuffBatt_C UEGO_tiDlyRstOperRlsLoBatt_C UEGO_tiDlySuffBattAftEngRstrt_C UEGO_uLoBattAsicHiThd_C UEGO_uLoBattAsicLowrThd_C /end DEF_CHARACTERISTIC
 /begin REF_CHARACTERISTIC UEGO_tiDlyUBattMin_C /end REF_CHARACTERISTIC
 /begin IN_MEASUREMENT BattU_u ExhMod_flgDewPntEndS1B1 ExhMod_flgHeatgTspS1B1 SyC_ctPostDrvLeave UEGO_flgEngActvStsS1B1 UEGO_flgEngAndEcuSt UEGO_flgEngCrk UEGO_flgEngStopPhaRaw UEGO_flgEomAftRun UEGO_flgHeatgUpFinshdS1B1 UEGO_flgHeatrPsErrS1B1 UEGO_flgOperRelsWoDewPntS1B1 UEGO_flgSrvTestDewPntRels UEGO_flgTstrReqProtdHeatgS1B1 UEGO_flgUBattMax UEGO_flgUBattMin UEGO_flgUBattSuff UEGO_idxTypS1B1 UEGO_numModCtrlS1B1 UEGO_numModCurrS1B1 UEGO_numRamSts3S1B1 /end IN_MEASUREMENT
 /begin OUT_MEASUREMENT UEGO_flgDewPntRelsS1B1 UEGO_flgErrSuspcLoBattS1B1 UEGO_flgFastLamRelsAftAsicShtOffS1B1 UEGO_flgOperRelsS1B1 /end OUT_MEASUREMENT
 /begin LOC_MEASUREMENT UEGO_flgAuxPwrRly UEGO_flgRstOperRlsLoBatt UEGO_flgRstOperRlsLoBattTONVNM_I.time UEGO_flgSuffBattAftEngRstrt UEGO_flgSuffBattAftEngRstrtTONVNM_I.time UEGO_OperRelsS1B1_I.cntrReiniProc10msec UEGO_OperRelsS1B1_I.flgErrSuspcLoBatt UEGO_OperRelsS1B1_I.flgFastLamRelsAftAsicShtOff UEGO_OperRelsS1B1_I.flgOperRels UEGO_OperRelsS1B1_I.flgRstOperRls UEGO_OperRelsS1B1_I.flgRstrtAsicAftLoBatt UEGO_OperRelsS1B1_I.flgTiWinAftSuffBatt UEGO_OperRelsS1B1_I.flgTiWithinWinAftEngRstrt UEGO_OperRelsS1B1_I.stOperRels UEGO_OperRelsS1B1_I.stRstOperRels UEGO_OperRelsS1B1_I.TmrAftEngRstrtTR_I.timeCounter UEGO_OperRelsS1B1_I.flgEngCrkERNM_I.oldSignal UEGO_OperRelsS1B1_I.flgEngRstrtEFNM_I.oldSignal UEGO_OperRelsS1B1_I.flgFastLamRelsAftAsicShtOffTOFFVNM_I.time UEGO_OperRelsS1B1_I.flgRstOperRlsERNM_I.oldSignal UEGO_OperRelsS1B1_I.flgRstrtAsicAftLoBattFF_I.status UEGO_OperRelsS1B1_I.flgTiWinAftSuffBattTOFFVNM_I.time UEGO_OperRelsS1B1_I.flgUBattLoTOFFVNM_I.time UEGO_OperRelsS1B1_I.flgUBattMaxTOFFVNM_I.time UEGO_OperRelsS1B1_I.flgUBattMinTOFFVNM_I.time UEGO_OperRels_cntrReiniProc10msec /end LOC_MEASUREMENT
 FUNCTION_VERSION "2.3.0" /end FUNCTION
/begin FUNCTION UEGO_OperRelsWoDewPnt "2.5.0     Sensor Operation release independent of dew point" /begin DEF_CHARACTERISTIC UEGO_stFastLiOffHeatg_C /end DEF_CHARACTERISTIC
 /begin IN_MEASUREMENT UEGO_flgCmbEngTmpStop UEGO_flgHeatrRelsATSS1B1 UEGO_flgReqPreStrtHeatgS1B1 UEGO_idxTypS1B1 /end IN_MEASUREMENT
 /begin OUT_MEASUREMENT UEGO_flgOperRelsPreEngStrtS1B1 UEGO_flgOperRelsWoDewPntS1B1 /end OUT_MEASUREMENT
 /begin LOC_MEASUREMENT UEGO_OperRelsWoDewPntS1B1_I.flgFastLiOffActvSts UEGO_OperRelsWoDewPntS1B1_I.flgOperRelsPreEngStrt /end LOC_MEASUREMENT
 FUNCTION_VERSION "2.5.0" /end FUNCTION
/begin FUNCTION UEGO_Snsr "1.1.0     Initializes sensor parameters" /begin DEF_CHARACTERISTIC UEGO_idxTypS1B1_C /end DEF_CHARACTERISTIC /begin OUT_MEASUREMENT UEGO_idxTypS1B1 /end OUT_MEASUREMENT FUNCTION_VERSION "1.1.0" /end FUNCTION
/begin FUNCTION UEGO_SnsrTMdl "2.2.0     Temperature Model for Lambda Sensors"
 /begin DEF_CHARACTERISTIC UEGO_facEgyRHeatr_C UEGO_rHeatrAmbT_C UEGO_rHeatrMax_C UEGO_rHeatrMin_C UEGO_rLossHeatrPS_C UEGO_tiEngStop_C UEGO_tSnsrHotThd_C UEGO_wSnsrMdlHotThd_T UEGO_tiDlyEngStop_C /end DEF_CHARACTERISTIC
 /begin IN_MEASUREMENT BattU_u EngStrt_bStrtEnd EnvT_t SyC_ctPostDrvLeave SyC_stSub TiOff_stTiStrtEndOff TiOff_tiStrtEndOff UEGO_flgOperRelsS1B1 UEGO_flgRTEvlnVldS1B1 UEGO_idxTypS1B1 UEGO_ratHeatrPSCtrlS1B1 UEGO_tCerS1B1 /end IN_MEASUREMENT
 /begin OUT_MEASUREMENT UEGO_flgSnsrMdlHotS1B1 UEGO_flgTiEngOffVld UEGO_tiEngOff UEGO_uBattCorrdS1B1 /end OUT_MEASUREMENT
 /begin LOC_MEASUREMENT UEGO_EngRunngDlyEFNM_I.oldSignal UEGO_flgEngRunngTiEngOffRaw UEGO_SnsrMdlHotS1B1_I.ctReIniProc20msec UEGO_SnsrMdlHotS1B1_I.egyHeatr UEGO_SnsrMdlHotS1B1_I.egySnsrMdlHotThd UEGO_SnsrMdlHotS1B1_I.flgIniFinshd UEGO_SnsrMdlHotS1B1_I.flgSnsrMdlHot UEGO_SnsrMdlHotS1B1_I.rHeatr UEGO_SnsrMdlHotS1B1_I.tiHeatr UEGO_SnsrMdlHotS1B1_I.uBattCorrd UEGO_SnsrMdlHotS1B1_I.UEGO_egyHeatrIK_I.memory UEGO_TiEngOffTOFFVNM_I.time /end LOC_MEASUREMENT
 FUNCTION_VERSION "2.2.0" /end FUNCTION
/begin FUNCTION UEGO_Tstr "2.4.0     Tester releases for UEGO functions" /begin DEF_CHARACTERISTIC UEGO_TstrClassS1B1_I.stTstrCtl_C /end DEF_CHARACTERISTIC /begin IN_MEASUREMENT B_falshvs_msg UEGO_idxTypS1B1 /end IN_MEASUREMENT
 /begin OUT_MEASUREMENT UEGO_flgSrvTestActv UEGO_flgHeatrRelsATSS1B1 UEGO_flgReqPreStrtHeatgS1B1 UEGO_flgSrvTestDewPntRels UEGO_flgTstrReqProtdHeatgS1B1 /end OUT_MEASUREMENT
 /begin LOC_MEASUREMENT UEGO_TstrClassS1B1_I.flgReqPreStrtHeatg UEGO_TstrClassS1B1_I.bHtrActvPrevStrtER_I.buffer UEGO_TstrClassS1B1_I.bHtrActvPrevStrtER_I.oldSignal UEGO_TstrClassS1B1_I.bHtrActvPrevStrtFF_I.status /end LOC_MEASUREMENT
 FUNCTION_VERSION "2.4.0" /end FUNCTION
/begin FUNCTION VehMot2ME "135.4.1   Interface Adapter VehMot to MED 7/9"
 /begin DEF_CHARACTERISTIC VehMot2ME_CW VehMot2ME_trqAccPed_CUR VF2ME_MRFAVLN_CUR VF2ME_MRMAX_C /end DEF_CHARACTERISTIC
 /begin REF_CHARACTERISTIC MDNORM /end REF_CHARACTERISTIC
 /begin IN_MEASUREMENT AccPed_rTrq AccPed_trqDes APP_r CoVeh_trqAcs CoVMD_trqCrCtl CoVM_bSIActvLead Epm_nEng GlbDa_stTrqDem mimax_w_msg PthSet_stOvrRunEna PT_rTrq PT_trqLos RngMod_trqCrSMax RngMod_trqCrSMin VehMot_rTrqDfftl VehMot_stPrpAccPed VehMot_stPrpCrCtl /end IN_MEASUREMENT
 /begin OUT_MEASUREMENT B_asr_msg B_fgr_msg B_ll_msg B_msr_msg B_vl_msg mivbeb_w_msg mivbeg_w_msg mrfa_w_msg /end OUT_MEASUREMENT
 /begin LOC_MEASUREMENT VehMot_tqWhlMax /end LOC_MEASUREMENT
 FUNCTION_VERSION "135.4.1" /end FUNCTION
/begin FUNCTION VehMot_CalcTrqDrag "25.4.0    Vehicle Motion Drag Torque Calculation"
 /begin DEF_CHARACTERISTIC VehMot_mInrt_C VehMot_tiFastLearn_C VehMot_tiTrqDragMin_C VehMot_tiTrqDragVx_CUR VehMot_tiTrqPrpPT1_C VehMot_trqDragMax_C VehMot_vMinDragEst_C /end DEF_CHARACTERISTIC
 /begin IN_MEASUREMENT ActMod_trqCrS CoVeh_trqAcs GlbDa_aX GlbDa_lWhlCirc GlbDa_vX PT_bGrip PT_bNoGrip PT_rTrq PT_stTraType PT_trqLos RngMod_trqCrSMax RngMod_trqCrSMin VehMot_rTrqDfftl VehMot_stBrkPed VMD_trqDes /end IN_MEASUREMENT
 /begin OUT_MEASUREMENT VehMot_a2trq VehMot_aPrpCurr VehMot_aPrpMax VehMot_aPrpMin VehMot_tiTrqDragPT1 VehMot_trqDrag /end OUT_MEASUREMENT
 /begin LOC_MEASUREMENT VehMot_trqDragEst_mp VehMot_trqPrpFlt_mp VehMot_trqWoComp_mp /end LOC_MEASUREMENT
 FUNCTION_VERSION "25.4.0" /end FUNCTION
/begin FUNCTION VehMot_DSD "162.1.0   Drive State Detection"
 /begin DEF_CHARACTERISTIC VehMot_nEngSpdThd_C VehMot_rAppNegDiff_C VehMot_rAppPosDiff_C VehMot_rAppThd2VehDyn_C VehMot_rAppThd3VehDyn_C VehMot_rAppThdVehDyn_C VehMot_tiAppVartnDly_C VehMot_wThd2rlsol_C VehMot_wThdrlsol_C /end DEF_CHARACTERISTIC
 /begin IN_MEASUREMENT APP_r CrCtl_stActive Epm_nEng LLim_stActive rlsol_w_msg T15_st VMD_rVirtAPP /end IN_MEASUREMENT
 /begin OUT_MEASUREMENT Veh_flgDyn /end OUT_MEASUREMENT
 /begin LOC_MEASUREMENT VehMot_flgAppVartn VehMot_flgDlyAppVartn VehMot_flgHighLdVehDyn VehMot_rApp VehMot_rAppDiff VehMot_rAppPrev1 VehMot_rAppPrev2 /end LOC_MEASUREMENT
 FUNCTION_VERSION "162.1.0" /end FUNCTION
/begin FUNCTION VehStc_FuCnsData "2.0.0     Fuel Consumption Data for Vehicle Statistics"
 /begin DEF_CHARACTERISTIC VehStc_nEngHi3000_C VehStc_nEngHi4500_C VehStc_nEngLo1000_C VehStc_nEngLo2000_C VehStc_nEngLowr1000_C VehStc_nEngMed2000_C VehStc_nEngMed3000_C VehStc_nEngSpdThd_C VehStc_nEngTop4500_C VehStc_pIntkHi450_C VehStc_pIntkHi600_C VehStc_pIntkLo_C VehStc_pIntkMed300_C VehStc_pIntkMed450_C VehStc_pIntkTop600_C VehStc_stAutoRstrtEna_C VehStc_stISSOffACMsk_C VehStc_stISSOffATMsk_C VehStc_stISSOffATSlopeMsk_C VehStc_stISSOffBatMsk_C VehStc_stISSOffBrkBoostMsk_C VehStc_stISSOffDCDCMsk_C VehStc_stISSOffPwrSteerMsk_C VehStc_stISSOffTempEngMsk_C VehStc_stISSOffUserMsk_C VehStc_stISSOffvVehMsk_C VehStc_stStalEngReasMsk_C VehStc_tClntThd_C VehStc_tiSSEChgOfMindOff_C VehStc_tiStopTrigDly_C VehStc_volInputSel_C VehStc_vVehZonSeln_C VehStc_vWhlSpdThresHi_C /end DEF_CHARACTERISTIC
 /begin IN_MEASUREMENT BrkPed_flgSwtISABAvl BrkPed_flgVehStandStill B_ll_msg CEngDsT_t CoEng_st CoEng_stStalEngReas Com_stECON Com_stEngHoodOpn Com_stEPSISSInhbReq Com_stSeatBltInfo CoVeh_stEngStrtOrd CoVOM_bChangeOfMind CoVOM_bSSEEngStopPassed CoVOM_bStopDrvReq CoVOM_bStopTraReq CoVOM_bSysOff CoVOM_bVehCdnStopTrig CoVOM_stISGoJud CoVOM_stSSE CoVOM_stStopRelsMask CoVOM_stStopReqCdn CoVOM_stStopReqMask CoVOM_stStopRls CoVOM_stStrtReqBefMsk CoVOM_stStrtReqCluPosn CoVOM_stStrtReqMask Eep_EnvRamInvld Epm_nEng frm_w_msg fzmdzyl_w_msg GlbDa_lTotDst InjSys_volFuConsDrvCyc InjSys_volFuConsDrvCycCAN psr_w_msg PT_stTraType StSpSwt_st T15_st Tra_stEcoLmpIdc TWCD_bEnaOSCB1 TWCD_bFinOSCMeasB1 TWCD_rDiagRsltB1 VehV_v /end IN_MEASUREMENT
 /begin OUT_MEASUREMENT VehStc_flgRstrtFromIdleStop VehStc_flgStopInhbCdnChkEna VehStc_flgStopTrigDly VehStc_numFuDiagRecA VehStc_numMisfDetnHiEctA VehStc_numMisfDetnLoEctA VehStc_numMisfDetnNormA /end OUT_MEASUREMENT
 /begin LOC_MEASUREMENT VehStc_cntFuDiagRecA VehStc_cntrMisfDetn VehStc_flgMisfDetd VehStc_flgMisfDetn VehStc_flgPwrSteerRstrtActv VehStc_flgSSEChgOfMind VehStc_flgStopTrigDlyFinshd VehStc_flgUserRstrtActv VehStc_idxCalcnAry VehStc_idxDiagRsltB1A VehStc_lDeltaDst VehStc_lDstCity VehStc_lDstCityEco VehStc_lDstHighWay VehStc_lDstHighWayEco VehStc_lDstold VehStc_NrOfMisfOldA VehStc_numMisfDetnHiEct0 VehStc_numMisfDetnHiEct1 VehStc_numMisfDetnHiEct10 VehStc_numMisfDetnHiEct11 VehStc_numMisfDetnHiEct12 VehStc_numMisfDetnHiEct13 VehStc_numMisfDetnHiEct14 VehStc_numMisfDetnHiEct15 VehStc_numMisfDetnHiEct16 VehStc_numMisfDetnHiEct17 VehStc_numMisfDetnHiEct18 VehStc_numMisfDetnHiEct19 VehStc_numMisfDetnHiEct2 VehStc_numMisfDetnHiEct20 VehStc_numMisfDetnHiEct3 VehStc_numMisfDetnHiEct4 VehStc_numMisfDetnHiEct5 VehStc_numMisfDetnHiEct6 VehStc_numMisfDetnHiEct7 VehStc_numMisfDetnHiEct8 VehStc_numMisfDetnHiEct9 VehStc_numMisfDetnLo0 VehStc_numMisfDetnLo1 VehStc_numMisfDetnLo10 VehStc_numMisfDetnLo11 VehStc_numMisfDetnLo12 VehStc_numMisfDetnLo13 VehStc_numMisfDetnLo14 VehStc_numMisfDetnLo15 VehStc_numMisfDetnLo16 VehStc_numMisfDetnLo17 VehStc_numMisfDetnLo18 VehStc_numMisfDetnLo19 VehStc_numMisfDetnLo2 VehStc_numMisfDetnLo20 VehStc_numMisfDetnLo3 VehStc_numMisfDetnLo4 VehStc_numMisfDetnLo5 VehStc_numMisfDetnLo6 VehStc_numMisfDetnLo7 VehStc_numMisfDetnLo8 VehStc_numMisfDetnLo9 VehStc_pIntkMnfld VehStc_rDiagRsltB10 VehStc_rDiagRsltB11 VehStc_rDiagRsltB12 VehStc_rDiagRsltB13 VehStc_rDiagRsltB14 VehStc_rDiagRsltB1A VehStc_stbasalCdn VehStc_stEngManStrtd VehStc_stEngSpdLo VehStc_stEngSpdLowr VehStc_stEngSpdMed VehStc_stEngSpdSHi VehStc_stEngSpdTop VehStc_stEntryCdn VehStc_stIntkPHi VehStc_stIntkPLo VehStc_stIntkPMed VehStc_stIntkPTop VehStc_stISSOff VehStc_stSSE VehStc_stSSEOld VehStc_stStopReqCdn VehStc_stVehSpdCdn VehStc_sumFuDiagRecA VehStc_tiRtCity VehStc_tiRtCityEco VehStc_tiRtHighWay VehStc_tiRtHighWayEco VehStc_tiRtISSOffAC VehStc_tiRtISSOffAT VehStc_tiRtISSOffATSlope VehStc_tiRtISSOffBat VehStc_tiRtISSOffBrkBoost VehStc_tiRtISSOffDCDC VehStc_tiRtISSOffPwrSteer VehStc_tiRtISSOffSys VehStc_tiRtISSOffTempEng VehStc_tiRtISSOffUser VehStc_tiRtISSOffvVeh VehStc_tiRtISSStop VehStc_tiRtStop VehStc_tiRtStopSpstOn VehStc_tiRtStopStspDrvrOff VehStc_tiRtStopStspOffSysReq VehStc_volActFuCns VehStc_volCnsCityDcyc VehStc_volCnsCityEcoDcyc VehStc_volCnsHighWayDcyc VehStc_volCnsHighWayEcoDcyc VehStc_volCnsStopDcyc VehStc_volFuCnsOld /end LOC_MEASUREMENT
 FUNCTION_VERSION "2.0.0" /end FUNCTION
/begin FUNCTION VehV2MED "5.6.0     Interface adapter VehV to MED" FUNCTION_VERSION "5.6.0" /end FUNCTION
/begin COMPU_METHOD Acc "" RAT_FUNC "%6.5" "m/s^2" COEFFS 0 1000 0 0 0 1 /end COMPU_METHOD
/begin COMPU_METHOD B_TRUE "" TAB_VERB "%6.3" "" COMPU_TAB_REF B_TRUE /end COMPU_METHOD
/begin COMPU_VTAB B_TRUE "" TAB_VERB 2 0 "FALSE" 1 "TRUE" /end COMPU_VTAB
/begin COMPU_METHOD dez "" RAT_FUNC "%6.2" "" COEFFS 0 1 0 0 0 1 /end COMPU_METHOD
/begin COMPU_METHOD EngN "" RAT_FUNC "%6.3" "rpm" COEFFS 0 2 0 0 0 1 /end COMPU_METHOD
/begin COMPU_METHOD fak_q0p000244 "" RAT_FUNC "%6.5" "-" COEFFS 0 65536 0 0 0 16 /end COMPU_METHOD
/begin COMPU_METHOD fak_q3p72529Em9 "" RAT_FUNC "%11.10" "" COEFFS 0 268435456 0 0 0 1 /end COMPU_METHOD
/begin COMPU_METHOD fak_sw_b1 "" RAT_FUNC "%7.6" "-" COEFFS 0 65536 0 0 0 2 /end COMPU_METHOD
/begin COMPU_METHOD fak_sw_b8 "" RAT_FUNC "%6.5" "-" COEFFS 0 65536 0 0 0 16 /end COMPU_METHOD
/begin COMPU_METHOD fak_ub_b2 "" RAT_FUNC "%8.5" "-" COEFFS 0 256 0 0 0 2 /end COMPU_METHOD
/begin COMPU_METHOD fak_ub_b4 "" RAT_FUNC "%6.4" "-" COEFFS 0 256 0 0 0 4 /end COMPU_METHOD
/begin COMPU_METHOD fak_uw_b0p005 "" RAT_FUNC "%10.9" "" COEFFS 0 65536 0 0 0 0.005 /end COMPU_METHOD
/begin COMPU_METHOD fak_uw_b16 "" RAT_FUNC "%6.5" "-" COEFFS 0 65536 0 0 0 16 /end COMPU_METHOD
/begin COMPU_METHOD fak_uw_b2 "" RAT_FUNC "%7.6" "-" COEFFS 0 65536 0 0 0 2 /end COMPU_METHOD
/begin COMPU_METHOD fak_uw_q0p00083 "" RAT_FUNC "%6.5" "-" COEFFS 0 1200 0 0 0 1 /end COMPU_METHOD
/begin COMPU_METHOD i_q1_uA "" RAT_FUNC "%6.2" "uA" COEFFS 0 1 0 0 0 1 /end COMPU_METHOD
/begin COMPU_METHOD i_q6p6667Em7_A "" RAT_FUNC "%9.8" "A" COEFFS 0 1500000 0 0 0 1 /end COMPU_METHOD
/begin COMPU_METHOD Length "" RAT_FUNC "%6.2" "m" COEFFS 0 1 0 0 0 1 /end COMPU_METHOD
/begin COMPU_METHOD Mass "" RAT_FUNC "%6.2" "-" COEFFS 0 1 0 0 0 1 /end COMPU_METHOD
/begin COMPU_METHOD MassLength "" RAT_FUNC "%6.3" "" COEFFS 0 5 0 0 0 1 /end COMPU_METHOD
/begin COMPU_METHOD nmot_q40 "" RAT_FUNC "%6.1" "1/min" COEFFS 0 1 0 0 0 40 /end COMPU_METHOD
/begin COMPU_METHOD OneToOne "" RAT_FUNC "%6.2" "-" COEFFS 0 1 0 0 0 1 /end COMPU_METHOD
/begin COMPU_METHOD Prc "" RAT_FUNC "%6.4" "%" COEFFS 0 81.92 0 0 0 1 /end COMPU_METHOD
/begin COMPU_METHOD PrcPerSec "" RAT_FUNC "%6.3" "%/s" COEFFS 0 1.6384 0 0 0 1 /end COMPU_METHOD
/begin COMPU_METHOD p_q0p078 "" RAT_FUNC "%6.4" "hPa" COEFFS 0 64 0 0 0 5 /end COMPU_METHOD
/begin COMPU_METHOD p_uw_q0p039_mmHg "" RAT_FUNC "%6.4" "mmHg" COEFFS 0 256 0 0 0 7.500637 /end COMPU_METHOD
/begin COMPU_METHOD q1p907Em6_Ohm_DIV_J "" RAT_FUNC "%8.7" "Ohm/J" COEFFS 0 524288 0 0 0 1 /end COMPU_METHOD
/begin COMPU_METHOD q_q0p015625_J "" RAT_FUNC "%6.4" "J" COEFFS 0 65536 0 0 0 1024 /end COMPU_METHOD
/begin COMPU_METHOD q_q2p3842Em7_J "" RAT_FUNC "%9.8" "J" COEFFS 0 4194304 0 0 0 1 /end COMPU_METHOD
/begin COMPU_METHOD RBPtCel_du_0p005_1 "" RAT_FUNC "%6.4" "V/s" COEFFS 0 1 0 0 0 0.005 /end COMPU_METHOD
/begin COMPU_METHOD rel_q0p003052 "" RAT_FUNC "%6.4" "%" COEFFS 0 65536 0 0 0 200 /end COMPU_METHOD
/begin COMPU_METHOD rel_q0p02344 "" RAT_FUNC "%6.4" "%" COEFFS 0 32 0 0 0 0.75 /end COMPU_METHOD
/begin COMPU_METHOD rel_uw_b100 "" RAT_FUNC "%6.4" "%" COEFFS 0 65536 0 0 0 100 /end COMPU_METHOD
/begin COMPU_METHOD rel_uw_b200 "" RAT_FUNC "%6.4" "%" COEFFS 0 65536 0 0 0 200 /end COMPU_METHOD
/begin COMPU_METHOD rel_uw_q0p0234 "" RAT_FUNC "%6.4" "%" COEFFS 0 32 0 0 0 0.75 /end COMPU_METHOD
/begin COMPU_METHOD r_q9p765625Em4_Ohm "" RAT_FUNC "%6.5" "Ohm" COEFFS 0 65536 0 0 0 64 /end COMPU_METHOD
/begin COMPU_METHOD spg_q0p005 "" RAT_FUNC "%6.4" "V" COEFFS 0 1 0 0 0 0.005 /end COMPU_METHOD
/begin COMPU_METHOD spg_q0p1 "" RAT_FUNC "%6.3" "V" COEFFS 0 1 0 0 0 0.1 /end COMPU_METHOD
/begin COMPU_METHOD spg_q3p05Em4_mV "" RAT_FUNC "%6.5" "mV" COEFFS 0 3276.75 0 0 0 1 /end COMPU_METHOD
/begin COMPU_METHOD Temp_Cels "" RAT_FUNC "%6.1" "deg C" COEFFS 0 10 2731.4 0 0 1 /end COMPU_METHOD
/begin COMPU_METHOD temp_q0p0234 "" RAT_FUNC "%6.4" "K" COEFFS 0 256 0 0 0 6 /end COMPU_METHOD
/begin COMPU_METHOD temp_q0p0234_o273 "" RAT_FUNC "%6.1" "Grad C" COEFFS 0 1 273.15 0 0 0.0234375 /end COMPU_METHOD
/begin COMPU_METHOD temp_q0p1_o273 "" RAT_FUNC "%6.1" "Grad C" COEFFS 0 10 2731.4 0 0 1 /end COMPU_METHOD
/begin COMPU_METHOD TimeDelay_s "" RAT_FUNC "%6.1" "s" COEFFS 0 0 1 0 0.00023283064365387 0 /end COMPU_METHOD
/begin COMPU_METHOD Time_ms "" RAT_FUNC "%6.1" "ms" COEFFS 0 0.1 0 0 0 1 /end COMPU_METHOD
/begin COMPU_METHOD Time_s "" RAT_FUNC "%6.4" "s" COEFFS 0 100 0 0 0 1 /end COMPU_METHOD
/begin COMPU_METHOD Time_sec_q1_COMPU "" RAT_FUNC "%6.2" "s" COEFFS 0 1 0 0 0 1 /end COMPU_METHOD
/begin COMPU_METHOD Time_s_1 "" RAT_FUNC "%6.5" "" COEFFS 0 1000 0 0 0 1 /end COMPU_METHOD
/begin COMPU_METHOD TrqPrpHigh "" RAT_FUNC "%6.3" "Nm" COEFFS 0 10 0 0 0 1 /end COMPU_METHOD
/begin COMPU_METHOD t_q0p000001_s "" RAT_FUNC "%9.8" "s" COEFFS 0 1000000 0 0 0 1 /end COMPU_METHOD
/begin COMPU_METHOD t_q0p001 "" RAT_FUNC "%6.5" "s" COEFFS 0 1000 0 0 0 1 /end COMPU_METHOD
/begin COMPU_METHOD t_q0p01 "" RAT_FUNC "%6.4" "s" COEFFS 0 100 0 0 0 1 /end COMPU_METHOD
/begin COMPU_METHOD t_q0p02 "" RAT_FUNC "%6.4" "s" COEFFS 0 100 0 0 0 2 /end COMPU_METHOD
/begin COMPU_METHOD t_q0p05 "" RAT_FUNC "%6.4" "s" COEFFS 0 100 0 0 0 5 /end COMPU_METHOD
/begin COMPU_METHOD t_q0p1 "" RAT_FUNC "%6.3" "s" COEFFS 0 10 0 0 0 1 /end COMPU_METHOD
/begin COMPU_METHOD t_q1 "" RAT_FUNC "%6.2" "s" COEFFS 0 1 0 0 0 1 /end COMPU_METHOD
/begin COMPU_METHOD UEGO_RCMPPRSNT_SC_Compu "" TAB_VERB "%6.3" "" COMPU_TAB_REF UEGO_RCMPPRSNT_SC_Compu /end COMPU_METHOD
/begin COMPU_VTAB UEGO_RCMPPRSNT_SC_Compu "" TAB_VERB 2 0 "False" 1 "True" /end COMPU_VTAB
/begin COMPU_METHOD UEGO_RICHCPBYDIAG_SC_Compu "" TAB_VERB "%6.3" "" COMPU_TAB_REF UEGO_RICHCPBYDIAG_SC_Compu /end COMPU_METHOD
/begin COMPU_VTAB UEGO_RICHCPBYDIAG_SC_Compu "" TAB_VERB 2 0 "Deactivate" 1 "Activate" /end COMPU_VTAB
/begin COMPU_METHOD UEGO_RPC_SC_Compu "" TAB_VERB "%6.3" "" COMPU_TAB_REF UEGO_RPC_SC_Compu /end COMPU_METHOD
/begin COMPU_VTAB UEGO_RPC_SC_Compu "" TAB_VERB 2 0 "False" 1 "True" /end COMPU_VTAB
/begin COMPU_METHOD UEGO_SELCENDATAEVLN_SC_Compu "" TAB_VERB "%6.3" "" COMPU_TAB_REF UEGO_SELCENDATAEVLN_SC_Compu /end COMPU_METHOD
/begin COMPU_VTAB UEGO_SELCENDATAEVLN_SC_Compu "" TAB_VERB 2 0 "False" 1 "True" /end COMPU_VTAB
/begin COMPU_METHOD UEGO_SELTSKIPMPEVLN_SC_Compu "" TAB_VERB "%6.3" "" COMPU_TAB_REF UEGO_SELTSKIPMPEVLN_SC_Compu /end COMPU_METHOD
/begin COMPU_VTAB UEGO_SELTSKIPMPEVLN_SC_Compu "" TAB_VERB 5 0 "DISABLE" 1 "ONE_MS" 2 "TWO_MS" 3 "UNUSED" 4 "FOUR_MS" /end COMPU_VTAB
/begin COMPU_METHOD UEGO_SEPUBATTTHDRIDIAG_SC_Compu "" TAB_VERB "%6.3" "" COMPU_TAB_REF UEGO_SEPUBATTTHDRIDIAG_SC_Compu /end COMPU_METHOD
/begin COMPU_VTAB UEGO_SEPUBATTTHDRIDIAG_SC_Compu "" TAB_VERB 2 0 "False" 1 "True" /end COMPU_VTAB
/begin COMPU_METHOD UEGO_SIGRELSUN0CTRLDPDT_SC_Compu "" TAB_VERB "%6.3" "" COMPU_TAB_REF UEGO_SIGRELSUN0CTRLDPDT_SC_Compu /end COMPU_METHOD
/begin COMPU_VTAB UEGO_SIGRELSUN0CTRLDPDT_SC_Compu "" TAB_VERB 2 0 "False" 1 "True" /end COMPU_VTAB
/begin COMPU_METHOD UEGO_SNGLCEL_SC_Compu "" TAB_VERB "%6.3" "" COMPU_TAB_REF UEGO_SNGLCEL_SC_Compu /end COMPU_METHOD
/begin COMPU_VTAB UEGO_SNGLCEL_SC_Compu "" TAB_VERB 2 0 "False" 1 "True" /end COMPU_VTAB
/begin COMPU_METHOD UEGO_SNSR1INTK1_SC_Compu "" TAB_VERB "%6.3" "" COMPU_TAB_REF UEGO_SNSR1INTK1_SC_Compu /end COMPU_METHOD
/begin COMPU_VTAB UEGO_SNSR1INTK1_SC_Compu "" TAB_VERB 2 0 "False" 1 "True" /end COMPU_VTAB
/begin COMPU_METHOD UEGO_SNSROPERPREENGSTRT_SC_Compu "" TAB_VERB "%6.3" "" COMPU_TAB_REF UEGO_SNSROPERPREENGSTRT_SC_Compu /end COMPU_METHOD
/begin COMPU_VTAB UEGO_SNSROPERPREENGSTRT_SC_Compu "" TAB_VERB 2 0 "False" 1 "True" /end COMPU_VTAB
/begin COMPU_METHOD UEGO_SNSRTMDLENA_SC_Compu "" TAB_VERB "%6.3" "" COMPU_TAB_REF UEGO_SNSRTMDLENA_SC_Compu /end COMPU_METHOD
/begin COMPU_VTAB UEGO_SNSRTMDLENA_SC_Compu "" TAB_VERB 2 0 "False" 1 "True" /end COMPU_VTAB
/begin COMPU_METHOD UEGO_SUMERR_SY_Compu "" TAB_VERB "%6.3" "" COMPU_TAB_REF UEGO_SUMERR_SY_Compu /end COMPU_METHOD
/begin COMPU_VTAB UEGO_SUMERR_SY_Compu "" TAB_VERB 2 0 "False" 1 "True" /end COMPU_VTAB
/begin COMPU_METHOD UEGO_SYSDIAG_SC_Compu "" RAT_FUNC "%6.2" "" COEFFS 0 1 0 0 0 1 /end COMPU_METHOD
/begin COMPU_METHOD UEGO_UNERNSTSETCTRLENA_SC_Compu "" TAB_VERB "%6.3" "" COMPU_TAB_REF UEGO_UNERNSTSETCTRLENA_SC_Compu /end COMPU_METHOD
/begin COMPU_VTAB UEGO_UNERNSTSETCTRLENA_SC_Compu "" TAB_VERB 2 0 "False" 1 "True" /end COMPU_VTAB
/begin COMPU_METHOD UEGO_VAR_SY_Compu "" TAB_VERB "%6.3" "" COMPU_TAB_REF UEGO_VAR_SY_Compu /end COMPU_METHOD
/begin COMPU_VTAB UEGO_VAR_SY_Compu "" TAB_VERB 45 0 "kein Kundenbezug" 1 "DAI" 3 "VWW" 4 "POR" 5 "AUD" 6 "OPE" 9 "FIA" 11 "BMW" 14 "PSA" 15 "REN" 17 "ALF" 18 "SAB" 19 "VOL" 20 "NIS" 21 "GMU" 22 "FOR" 26 "IMJ" 51 "SEA" 53 "CHR" 54 "JAG" 55 "ROL" 69 "FER" 72 "TOY" 123 "MIT" 147 "HYU" 159 "HON" 160 "MAZ" 183 "CU" 190 "LRG" 204 "VVW" 214 "AVT" 242 "Iveco" 243 "DMC" 248 "SUZ" 267 "SSANGYONG" 270 "KEF" 289 "AMG" 308 "TAT" 319 "MVM" 385 "UAES" 590 "Scania" 828 "RBCD" 999 "ALL" 2887 "Nonox" 9454 "Fuso" /end COMPU_VTAB
/begin COMPU_METHOD UEGO_VCCMEAS_SC_Compu "" TAB_VERB "%6.3" "" COMPU_TAB_REF UEGO_VCCMEAS_SC_Compu /end COMPU_METHOD
/begin COMPU_VTAB UEGO_VCCMEAS_SC_Compu "" TAB_VERB 2 0 "False" 1 "True" /end COMPU_VTAB
/begin COMPU_METHOD UEGO_VRNTSELN_SC_Compu "" TAB_VERB "%6.3" "" COMPU_TAB_REF UEGO_VRNTSELN_SC_Compu /end COMPU_METHOD
/begin COMPU_VTAB UEGO_VRNTSELN_SC_Compu "" TAB_VERB 3 0 "0" 42 "42" 56 "56" /end COMPU_VTAB
/begin COMPU_METHOD UEGO_WIRESIGOLDSTCN_SC_Compu "" TAB_VERB "%6.3" "" COMPU_TAB_REF UEGO_WIRESIGOLDSTCN_SC_Compu /end COMPU_METHOD
/begin COMPU_VTAB UEGO_WIRESIGOLDSTCN_SC_Compu "" TAB_VERB 2 0 "False" 1 "True" /end COMPU_VTAB
/begin COMPU_METHOD UEGO_WTRELECLYENA_SC_Compu "" TAB_VERB "%6.3" "" COMPU_TAB_REF UEGO_WTRELECLYENA_SC_Compu /end COMPU_METHOD
/begin COMPU_VTAB UEGO_WTRELECLYENA_SC_Compu "" TAB_VERB 2 0 "Deactivate" 1 "Activate" /end COMPU_VTAB
/begin COMPU_METHOD undefined "" RAT_FUNC "%6.2" "" COEFFS 0 1 0 0 0 1 /end COMPU_METHOD
/begin COMPU_METHOD UNIAIRINTKLIVOMOD_SC_Compu "" TAB_VERB "%6.3" "" COMPU_TAB_REF UNIAIRINTKLIVOMOD_SC_Compu /end COMPU_METHOD
/begin COMPU_VTAB UNIAIRINTKLIVOMOD_SC_Compu "" TAB_VERB 2 0 "NO_LIVO" 1 "LIVO" /end COMPU_VTAB
/begin COMPU_METHOD USESTRTSYNCINTRPTCFG_SC_Compu "" TAB_VERB "%6.3" "" COMPU_TAB_REF USESTRTSYNCINTRPTCFG_SC_Compu /end COMPU_METHOD
/begin COMPU_VTAB USESTRTSYNCINTRPTCFG_SC_Compu "" TAB_VERB 2 0 "disabled" 1 "enabled" /end COMPU_VTAB
/begin COMPU_METHOD USGOFFTIGENNIF_SC_Compu "" TAB_VERB "%6.3" "" COMPU_TAB_REF USGOFFTIGENNIF_SC_Compu /end COMPU_METHOD
/begin COMPU_VTAB USGOFFTIGENNIF_SC_Compu "" TAB_VERB 2 1 "IF_GEN1" 2 "IF_GEN2" /end COMPU_VTAB
/begin COMPU_METHOD VARCOD_SY_Compu "" TAB_VERB "%6.3" "" COMPU_TAB_REF VARCOD_SY_Compu /end COMPU_METHOD
/begin COMPU_VTAB VARCOD_SY_Compu "" TAB_VERB 4 0 "VARCOD_NO" 1 "VARCOD_LONG" 2 "VARCOD_SHORT" 3 "VARCOD_CONCERN" /end COMPU_VTAB
/begin COMPU_METHOD VCRTYP_SC_Compu "" TAB_VERB "%6.3" "" COMPU_TAB_REF VCRTYP_SC_Compu /end COMPU_METHOD
/begin COMPU_VTAB VCRTYP_SC_Compu "" TAB_VERB 2 0 "Fixed" 1 "Continuous" /end COMPU_VTAB
/begin COMPU_METHOD VEHC_VAR_SY_Compu "" TAB_VERB "%6.3" "" COMPU_TAB_REF VEHC_VAR_SY_Compu /end COMPU_METHOD
/begin COMPU_VTAB VEHC_VAR_SY_Compu "" TAB_VERB 44 1 "DAI" 3 "VWW" 4 "POR" 5 "AUD" 6 "OPE" 9 "FIA" 11 "BMW" 14 "PSA" 15 "REN" 17 "ALF" 18 "SAB" 19 "VOL" 20 "NIS" 21 "GMU" 22 "FOR" 26 "IMJ" 51 "SEA" 53 "CHR" 54 "JAG" 55 "ROL" 69 "FER" 72 "TOY" 123 "MIT" 147 "HYU" 159 "HON" 160 "MAZ" 183 "CU" 190 "LRG" 204 "VVW" 214 "AVT" 242 "Iveco" 243 "DMC" 248 "SUZ" 267 "SSANGYONG" 270 "KEF" 289 "AMG" 308 "TAT" 319 "MVM" 385 "UAES" 590 "Scania" 828 "RBCD" 999 "ALL" 2887 "Nonox" 9454 "Fuso" /end COMPU_VTAB
/begin COMPU_METHOD VEHDEV_APPPIDENA_SC_Compu "" TAB_VERB "%6.3" "" COMPU_TAB_REF VEHDEV_APPPIDENA_SC_Compu /end COMPU_METHOD
/begin COMPU_VTAB VEHDEV_APPPIDENA_SC_Compu "" TAB_VERB 2 0 "False" 1 "True" /end COMPU_VTAB
/begin COMPU_METHOD VEHDEV_HNDBRKENA_SC_Compu "" TAB_VERB "%6.3" "" COMPU_TAB_REF VEHDEV_HNDBRKENA_SC_Compu /end COMPU_METHOD
/begin COMPU_VTAB VEHDEV_HNDBRKENA_SC_Compu "" TAB_VERB 2 0 "False" 1 "True" /end COMPU_VTAB
/begin COMPU_METHOD VEHDEV_HNDBRKLAMPENA_SC_Compu "" TAB_VERB "%6.3" "" COMPU_TAB_REF VEHDEV_HNDBRKLAMPENA_SC_Compu /end COMPU_METHOD
/begin COMPU_VTAB VEHDEV_HNDBRKLAMPENA_SC_Compu "" TAB_VERB 2 0 "False" 1 "True" /end COMPU_VTAB
/begin COMPU_METHOD VEHDEV_VAR_SY_Compu "" TAB_VERB "%6.3" "" COMPU_TAB_REF VEHDEV_VAR_SY_Compu /end COMPU_METHOD
/begin COMPU_VTAB VEHDEV_VAR_SY_Compu "" TAB_VERB 47 1 "DAI" 3 "VWW" 4 "POR" 5 "AUD" 6 "OPE" 9 "FIA" 11 "BMW" 14 "PSA" 15 "REN" 17 "ALF" 18 "SAB" 19 "VOL" 20 "NIS" 21 "GMU" 22 "FOR" 26 "IMJ" 36 "MAN" 51 "SEA" 53 "CHR" 54 "JAG" 55 "ROL" 69 "FER" 72 "TOY" 123 "MIT" 147 "HYU" 159 "HON" 160 "MAZ" 183 "CU" 190 "LRG" 204 "VVW" 214 "AVT" 226 "YUCHAI_OHW" 242 "Iveco" 243 "DMC" 248 "SUZ" 267 "SSANGYONG" 270 "KEF" 289 "AMG" 308 "TAT" 319 "MVM" 385 "UAES" 590 "Scania" 828 "RBCD" 973 "YANMAR" 999 "ALL" 2887 "Nonox" 9454 "Fuso" /end COMPU_VTAB
/begin COMPU_METHOD VEHFDE_NRCNDTRIG_SC_Compu "" RAT_FUNC "%6.2" "" COEFFS 0 1 0 0 0 1 /end COMPU_METHOD
/begin COMPU_METHOD VEHFDE_NRCNVTNLDISTBN_SC_Compu "" RAT_FUNC "%6.2" "" COEFFS 0 1 0 0 0 1 /end COMPU_METHOD
/begin COMPU_METHOD VEHFDE_NREXTTRIG_SC_Compu "" RAT_FUNC "%6.2" "" COEFFS 0 1 0 0 0 1 /end COMPU_METHOD
/begin COMPU_METHOD VEHFDE_NRFREETRIG_SC_Compu "" RAT_FUNC "%6.2" "" COEFFS 0 1 0 0 0 1 /end COMPU_METHOD
/begin COMPU_METHOD VEHFDE_NRINDCLASS_SC_Compu "" RAT_FUNC "%6.2" "" COEFFS 0 1 0 0 0 1 /end COMPU_METHOD
/begin COMPU_METHOD VEHFDE_NRMILGTRIG_SC_Compu "" RAT_FUNC "%6.2" "" COEFFS 0 1 0 0 0 1 /end COMPU_METHOD
/begin COMPU_METHOD VEHFDE_NRSNGVALSTC_SC_Compu "" RAT_FUNC "%6.2" "" COEFFS 0 1 0 0 0 1 /end COMPU_METHOD
/begin COMPU_METHOD VEHFDE_NRSTC_SC_Compu "" RAT_FUNC "%6.2" "" COEFFS 0 1 0 0 0 1 /end COMPU_METHOD
/begin COMPU_METHOD VEHFDE_NRVALCHGTRIG_SC_Compu "" RAT_FUNC "%6.2" "" COEFFS 0 1 0 0 0 1 /end COMPU_METHOD
/begin COMPU_METHOD VEHSTC_ECOLAMPACTV_SC_Compu "" TAB_VERB "%6.3" "" COMPU_TAB_REF VEHSTC_ECOLAMPACTV_SC_Compu /end COMPU_METHOD
/begin COMPU_VTAB VEHSTC_ECOLAMPACTV_SC_Compu "" TAB_VERB 2 0 "False" 1 "True" /end COMPU_VTAB
/begin COMPU_METHOD VEHTYPSELN_SC_Compu "" TAB_VERB "%6.3" "" COMPU_TAB_REF VEHTYPSELN_SC_Compu /end COMPU_METHOD
/begin COMPU_VTAB VEHTYPSELN_SC_Compu "" TAB_VERB 4 0 "PV" 1 "CV" 2 "OHW" 3 "LCV" /end COMPU_VTAB
/begin COMPU_METHOD VEHTYP_SC_Compu "" TAB_VERB "%6.3" "" COMPU_TAB_REF VEHTYP_SC_Compu /end COMPU_METHOD
/begin COMPU_VTAB VEHTYP_SC_Compu "" TAB_VERB 2 1 "Two_Wheeler" 2 "Four_Wheeler" /end COMPU_VTAB
/begin COMPU_METHOD VEHVCANSRCSEL_SC_Compu "" TAB_VERB "%6.3" "" COMPU_TAB_REF VEHVCANSRCSEL_SC_Compu /end COMPU_METHOD
/begin COMPU_VTAB VEHVCANSRCSEL_SC_Compu "" TAB_VERB 2 0 "rotational_speed" 1 "speed" /end COMPU_VTAB
/begin COMPU_METHOD VEHVPWMOUT_SC_Compu "" TAB_VERB "%6.3" "" COMPU_TAB_REF VEHVPWMOUT_SC_Compu /end COMPU_METHOD
/begin COMPU_VTAB VEHVPWMOUT_SC_Compu "" TAB_VERB 2 0 "False" 1 "True" /end COMPU_VTAB
/begin COMPU_METHOD VEHV_CANSAFE_SC_Compu "" TAB_VERB "%6.3" "" COMPU_TAB_REF VEHV_CANSAFE_SC_Compu /end COMPU_METHOD
/begin COMPU_VTAB VEHV_CANSAFE_SC_Compu "" TAB_VERB 4 0 "0" 1 "1" 2 "2" 3 "3" /end COMPU_VTAB
/begin COMPU_METHOD VEHV_CAN_SC_Compu "" TAB_VERB "%6.3" "" COMPU_TAB_REF VEHV_CAN_SC_Compu /end COMPU_METHOD
/begin COMPU_VTAB VEHV_CAN_SC_Compu "" TAB_VERB 4 0 "No_CAN" 1 "CONSOLIDATED_CAN" 2 "SINGLEWHEELSPEED_CAN" 3 "CONSOLIDATED_SINGLEWHEELSPEED" /end COMPU_VTAB
/begin COMPU_METHOD VEHV_DUALCANSRCACTV_SC_Compu "" TAB_VERB "%6.3" "" COMPU_TAB_REF VEHV_DUALCANSRCACTV_SC_Compu /end COMPU_METHOD
/begin COMPU_VTAB VEHV_DUALCANSRCACTV_SC_Compu "" TAB_VERB 2 0 "NOT_ACTIVE" 1 "ACTIVE" /end COMPU_VTAB
/begin COMPU_METHOD VEHV_DUALSIG_SC_Compu "" TAB_VERB "%6.3" "" COMPU_TAB_REF VEHV_DUALSIG_SC_Compu /end COMPU_METHOD
/begin COMPU_VTAB VEHV_DUALSIG_SC_Compu "" TAB_VERB 2 0 "False" 1 "True" /end COMPU_VTAB
/begin COMPU_METHOD VEHV_FCOPLAUS_SY_Compu "" TAB_VERB "%6.3" "" COMPU_TAB_REF VEHV_FCOPLAUS_SY_Compu /end COMPU_METHOD
/begin COMPU_VTAB VEHV_FCOPLAUS_SY_Compu "" TAB_VERB 2 0 "False" 1 "True" /end COMPU_VTAB
/begin COMPU_METHOD VEHV_INHOUSE_SC_Compu "" TAB_VERB "%6.3" "" COMPU_TAB_REF VEHV_INHOUSE_SC_Compu /end COMPU_METHOD
/begin COMPU_VTAB VEHV_INHOUSE_SC_Compu "" TAB_VERB 2 0 "False" 1 "True" /end COMPU_VTAB
/begin COMPU_METHOD VEHV_NUMTTHWHL_SY_Compu "" RAT_FUNC "%6.2" "" COEFFS 0 1 0 0 0 1 /end COMPU_METHOD
/begin COMPU_METHOD VEHV_OBDPLAUS_SY_Compu "" TAB_VERB "%6.3" "" COMPU_TAB_REF VEHV_OBDPLAUS_SY_Compu /end COMPU_METHOD
/begin COMPU_VTAB VEHV_OBDPLAUS_SY_Compu "" TAB_VERB 2 0 "False" 1 "True" /end COMPU_VTAB
/begin COMPU_METHOD VEHV_PHYSRNGCHK_SY_Compu "" TAB_VERB "%6.3" "" COMPU_TAB_REF VEHV_PHYSRNGCHK_SY_Compu /end COMPU_METHOD
/begin COMPU_VTAB VEHV_PHYSRNGCHK_SY_Compu "" TAB_VERB 2 0 "False" 1 "True" /end COMPU_VTAB
/begin COMPU_METHOD VEHV_PWMSAFE_SC_Compu "" TAB_VERB "%6.3" "" COMPU_TAB_REF VEHV_PWMSAFE_SC_Compu /end COMPU_METHOD
/begin COMPU_VTAB VEHV_PWMSAFE_SC_Compu "" TAB_VERB 2 0 "False" 1 "True" /end COMPU_VTAB
/begin COMPU_METHOD Vel "" RAT_FUNC "%6.4" "km/h" COEFFS 0 100 0 0 0 1 /end COMPU_METHOD
/begin COMPU_METHOD volFilgLvl_ml "" RAT_FUNC "%6.2" "ml" COEFFS 0 1 0 0 0 1 /end COMPU_METHOD
/begin COMPU_METHOD Volt_Batt "" RAT_FUNC "%6.1" "mV" COEFFS 0 0.05 0 0 0 1 /end COMPU_METHOD
/begin COMPU_METHOD zk10msxs_uw_b655p36 "" RAT_FUNC "%6.2" "s" COEFFS 0 0 65536 0 100 0 /end COMPU_METHOD
/begin RECORD_LAYOUT RB_Curve_S16_S16 NO_AXIS_PTS_X 1 SWORD AXIS_PTS_X 2 SWORD INDEX_INCR DIRECT FNC_VALUES 3 SWORD COLUMN_DIR DIRECT /end RECORD_LAYOUT
/begin RECORD_LAYOUT RB_Curve_S16_U16_Static NO_AXIS_PTS_X 1 SWORD AXIS_PTS_X 2 SWORD INDEX_INCR DIRECT FNC_VALUES 3 UWORD COLUMN_DIR DIRECT STATIC_RECORD_LAYOUT /end RECORD_LAYOUT
/begin RECORD_LAYOUT RB_Curve_U16_U16 NO_AXIS_PTS_X 1 UWORD AXIS_PTS_X 2 UWORD INDEX_INCR DIRECT FNC_VALUES 3 UWORD COLUMN_DIR DIRECT /end RECORD_LAYOUT
/begin RECORD_LAYOUT RB_Curve_U16_U8_Static NO_AXIS_PTS_X 1 UWORD AXIS_PTS_X 2 UWORD INDEX_INCR DIRECT FNC_VALUES 3 UBYTE COLUMN_DIR DIRECT STATIC_RECORD_LAYOUT /end RECORD_LAYOUT
/begin RECORD_LAYOUT RB_Curve_U8_U16_Static NO_AXIS_PTS_X 1 UBYTE AXIS_PTS_X 2 UBYTE INDEX_INCR DIRECT FNC_VALUES 3 UWORD COLUMN_DIR DIRECT STATIC_RECORD_LAYOUT /end RECORD_LAYOUT
/begin RECORD_LAYOUT RB_Map_U8U16_S16 NO_AXIS_PTS_X 1 UBYTE NO_AXIS_PTS_Y 2 UBYTE AXIS_PTS_X 3 UBYTE INDEX_INCR DIRECT AXIS_PTS_Y 4 UWORD INDEX_INCR DIRECT FNC_VALUES 5 SWORD ROW_DIR DIRECT /end RECORD_LAYOUT
/begin RECORD_LAYOUT RB_Val_Wboolean FNC_VALUES 1 UBYTE COLUMN_DIR DIRECT /end RECORD_LAYOUT
/begin RECORD_LAYOUT RB_Val_Ws16 FNC_VALUES 1 SWORD COLUMN_DIR DIRECT /end RECORD_LAYOUT
/begin RECORD_LAYOUT RB_Val_Ws32 FNC_VALUES 1 SLONG COLUMN_DIR DIRECT /end RECORD_LAYOUT
/begin RECORD_LAYOUT RB_Val_Wu16 FNC_VALUES 1 UWORD COLUMN_DIR DIRECT /end RECORD_LAYOUT
/begin RECORD_LAYOUT RB_Val_Wu32 FNC_VALUES 1 ULONG COLUMN_DIR DIRECT /end RECORD_LAYOUT
/begin RECORD_LAYOUT RB_Val_Wu8 FNC_VALUES 1 UBYTE COLUMN_DIR DIRECT /end RECORD_LAYOUT
/end MODULE
/end PROJECT
