ASAP2_VERSION 1 60
/begin PROJECT MG1CA020 "MG1CA020"
/begin HEADER "" VERSION "MG1CA020_6SAY_V011_TPROT" PROJECT_NO MG1CA020 /end HEADER
/begin MODULE DIM ""
/begin MOD_COMMON "" BYTE_ORDER MSB_LAST ALIGNMENT_BYTE 1 ALIGNMENT_WORD 2 ALIGNMENT_LONG 4 ALIGNMENT_INT64 4 ALIGNMENT_FLOAT32_IEEE 4 ALIGNMENT_FLOAT64_IEEE 4 DATA_SIZE 32 /end MOD_COMMON
/begin CHARACTERISTIC ExhMod_coeffPDiffCatTB1_M "Characteristic map temperature-dep. factor in pressure gradient catalysts" MAP 0x8052236C RB_Map_S16U8_U16 63.99902 fak_uw_b64 0.00 63.99902 FORMAT "%8.5"
 /begin AXIS_DESCR STD_AXIS NO_INPUT_QUANTITY Temp_Cels 6 -3549.940 3003.560 FORMAT "%8.3" DEPOSIT ABSOLUTE /end AXIS_DESCR
 /begin AXIS_DESCR STD_AXIS NO_INPUT_QUANTITY dez 2 0.00 255.0 FORMAT "%5.1" DEPOSIT ABSOLUTE /end AXIS_DESCR
/end CHARACTERISTIC
/begin CHARACTERISTIC ExhMod_cpAbsltCannB1_M "absolute thermal capacity catalyst canning bank 1" MAP 0x80522CAE RB_Map_S16U8_U16 14563.11 fak_q0p2222_JK 0.22 14563.33 FORMAT "%8.2" EXTENDED_LIMITS 0.00 14563.33
 /begin AXIS_DESCR STD_AXIS NO_INPUT_QUANTITY Temp_Cels 6 -3549.940 3003.560 FORMAT "%8.3" DEPOSIT ABSOLUTE /end AXIS_DESCR
 /begin AXIS_DESCR STD_AXIS NO_INPUT_QUANTITY dez 6 0.00 255.0 FORMAT "%5.1" DEPOSIT ABSOLUTE /end AXIS_DESCR
/end CHARACTERISTIC
/begin CHARACTERISTIC ExhMod_cpAbsltPipCatB1_M "absolute thermal capacity pipes and catalyst bricks bank 1" MAP 0x80522D0C RB_Map_S16U8_U16 14563.11 fak_q0p2222_JK 0.22 14563.33 FORMAT "%8.2" EXTENDED_LIMITS 0.00 14563.33
 /begin AXIS_DESCR STD_AXIS NO_INPUT_QUANTITY Temp_Cels 6 -3549.940 3003.560 FORMAT "%8.3" DEPOSIT ABSOLUTE /end AXIS_DESCR
 /begin AXIS_DESCR STD_AXIS NO_INPUT_QUANTITY dez 13 0.00 255.0 FORMAT "%5.1" DEPOSIT ABSOLUTE /end AXIS_DESCR
/end CHARACTERISTIC
/begin CHARACTERISTIC ExhMod_cpAbsltVlvFildB1_C "absolute thermal capacity valve (dynamic model filter) bank 1" VALUE 0x805223EA RB_Val_Wu16 3881.069 q5p922Em2_JK 0.059 3881.128 FORMAT "%8.3" EXTENDED_LIMITS 0.00 3881.128 /end CHARACTERISTIC
/begin CHARACTERISTIC ExhMod_egyEnthCmbExhGas_C "enthalpy of exhaust gas during regeneration air injection" VALUE 0x80522DC6 RB_Val_Wu16 31.99951 qm_q4p883Em4 0.00 31.99951 FORMAT "%8.5" /end CHARACTERISTIC
/begin CHARACTERISTIC ExhMod_egyEnthCmbHcCco_C "enthalpie HC cylinder cut off (exhaust gas lambda =1)" VALUE 0x80522DC8 RB_Val_Wu16 67107840. q1024_J_DIV_kg 0.00 67107840. FORMAT "%8.0" /end CHARACTERISTIC
/begin CHARACTERISTIC ExhMod_egyEnthHcCco_C "enthalpie HC cylinder cut off" VALUE 0x80522DCA RB_Val_Wu16 67107840. q1024_J_DIV_kg 0.00 67107840. FORMAT "%8.0" /end CHARACTERISTIC
/begin CHARACTERISTIC ExhMod_egyEnthRichExh_C "enthalpie rich exhaust" VALUE 0x80522DCC RB_Val_Wu16 31.99951 qm_q4p883Em4 0.00 31.99951 FORMAT "%8.5" /end CHARACTERISTIC
/begin CHARACTERISTIC ExhMod_facDistbnTDeltaExo_M "distribution factor total exothermy catalyst bricks" MAP 0x80522DCE RB_Map_U8U16_U8 1.000000 fak_ub_b2 0.00 1.000000 FORMAT "%8.6" EXTENDED_LIMITS 0.00 1.992188
 /begin AXIS_DESCR STD_AXIS NO_INPUT_QUANTITY dez 6 0.00 255.0 FORMAT "%5.1" DEPOSIT ABSOLUTE /end AXIS_DESCR
 /begin AXIS_DESCR STD_AXIS NO_INPUT_QUANTITY m_q0p1 11 0.00 6553.500 FORMAT "%8.3" DEPOSIT ABSOLUTE /end AXIS_DESCR
/end CHARACTERISTIC
/begin CHARACTERISTIC ExhMod_facEffFcoReacn_M "effectivity factor reaction fuel cut off exothemicity in catalyst bricks depending on temperature" MAP 0x80522E2E RB_Map_U8U16_U8 1.000000 fak_ub_b2 0.00 1.000000 FORMAT "%8.6" EXTENDED_LIMITS 0.00 1.992188
 /begin AXIS_DESCR STD_AXIS NO_INPUT_QUANTITY dez 6 0.00 255.0 FORMAT "%5.1" DEPOSIT ABSOLUTE /end AXIS_DESCR
 /begin AXIS_DESCR STD_AXIS NO_INPUT_QUANTITY temp_q0p0234_o273 4 -273.150 1262.827 FORMAT "%8.3" DEPOSIT ABSOLUTE /end AXIS_DESCR
/end CHARACTERISTIC
/begin CHARACTERISTIC ExhMod_facEgyThdTspNoCatHeatgS1B1_M "reduction factor of heat quantity threshold for dew-point end detection for thermo shock protected sensor 1 without catalyst heating, bank 1" MAP 0x80523754 RB_Map_S16S16_U8 1.000000 fak_ub_b2 0.00 1.000000 FORMAT "%8.6" EXTENDED_LIMITS 0.00 1.992188
 /begin AXIS_DESCR STD_AXIS NO_INPUT_QUANTITY Temp_Cels 7 -3549.940 3003.560 FORMAT "%8.3" DEPOSIT ABSOLUTE /end AXIS_DESCR
 /begin AXIS_DESCR STD_AXIS NO_INPUT_QUANTITY Temp_Cels 7 -3549.940 3003.560 FORMAT "%8.3" DEPOSIT ABSOLUTE /end AXIS_DESCR
/end CHARACTERISTIC
/begin CHARACTERISTIC ExhMod_facEgyThdTspS1B1_M "reduction factor of heat quantity threshold for dew-point end detection for TSP sensor 1" MAP 0x805237A6 RB_Map_S16S16_U8 1.000000 fak_ub_b2 0.00 1.000000 FORMAT "%8.6" EXTENDED_LIMITS 0.00 1.992188
 /begin AXIS_DESCR STD_AXIS NO_INPUT_QUANTITY Temp_Cels 7 -3549.940 3003.560 FORMAT "%8.3" DEPOSIT ABSOLUTE /end AXIS_DESCR
 /begin AXIS_DESCR STD_AXIS NO_INPUT_QUANTITY Temp_Cels 7 -3549.940 3003.560 FORMAT "%8.3" DEPOSIT ABSOLUTE /end AXIS_DESCR
/end CHARACTERISTIC
/begin CHARACTERISTIC ExhMod_facEnvPCorrnHtcWallEnv_T "Ambient pressure based correction factor for heat transmission coefficient between wall and the environment" CURVE 0x80522E56 RB_Curve_U16_U8_Static 1.992188 fak_ub_b2 0.00 1.992188 FORMAT "%8.6"
 /begin AXIS_DESCR STD_AXIS ExhMod_pEnvTMdl p_uw_q0p039 6 0.00 2559.961 FORMAT "%8.3" DEPOSIT ABSOLUTE /end AXIS_DESCR
/end CHARACTERISTIC
/begin CHARACTERISTIC ExhMod_facExoCorrnIgnAgHomB1_T "Zündwinkelkorrektur kennlinie für die exotherme Temperaturerhöhung im Katalysator für Homogenbetrieb Bank 1" CURVE 0x80522E6A RB_Curve_U8_U8 1.992188 fak_ub_b2 0.00 1.992188 FORMAT "%8.6"
 /begin AXIS_DESCR STD_AXIS NO_INPUT_QUANTITY rel_ub_b127p5 8 0.00 127.5 FORMAT "%5.1" DEPOSIT ABSOLUTE /end AXIS_DESCR
/end CHARACTERISTIC
/begin CHARACTERISTIC ExhMod_facExoCorrnIgnAgHomCatHeatgB1_T "Zündwinkelkorrektur kennlinie für die exotherme Temperaturerhöhung im Katalysator während Katheizen für kalt Motorstart in Homogenbetrieb Bank 1" CURVE 0x80522E7B RB_Curve_U8_U8 1.992188 fak_ub_b2 0.00 1.992188 FORMAT "%8.6"
 /begin AXIS_DESCR STD_AXIS NO_INPUT_QUANTITY rel_ub_b127p5 8 0.00 127.5 FORMAT "%5.1" DEPOSIT ABSOLUTE /end AXIS_DESCR
/end CHARACTERISTIC
/begin CHARACTERISTIC ExhMod_facExoCorrnIgnAgHomCatHeatSustB1_T "Zündwinkelkorrektur kennlinie für die exotherme Temperaturerhöhung im Katalysator während Katheizen für warmhalten in Homogenbetrieb Bank 1" CURVE 0x80522E8C RB_Curve_U8_U8 1.992188 fak_ub_b2 0.00 1.992188 FORMAT "%8.6"
 /begin AXIS_DESCR STD_AXIS NO_INPUT_QUANTITY rel_ub_b127p5 8 0.00 127.5 FORMAT "%5.1" DEPOSIT ABSOLUTE /end AXIS_DESCR
/end CHARACTERISTIC
/begin CHARACTERISTIC ExhMod_facExoCorrnLamB1_M "lambda correction exothermal temperature increase in catalyst bank 1" MAP 0x80522E9E RB_Map_U16U8_U8 1.992188 fak_ub_b2 0.00 1.992188 FORMAT "%8.6"
 /begin AXIS_DESCR STD_AXIS NO_INPUT_QUANTITY fak_uw_b16 7 0.00 15.99976 FORMAT "%8.5" DEPOSIT ABSOLUTE /end AXIS_DESCR
 /begin AXIS_DESCR STD_AXIS NO_INPUT_QUANTITY dez 2 0.00 255.0 FORMAT "%5.1" DEPOSIT ABSOLUTE /end AXIS_DESCR
/end CHARACTERISTIC
/begin CHARACTERISTIC ExhMod_facIntrpnCoolgCrv_M "interpolation factor cooling curve" MAP 0x80522C50 RB_Map_U16U8_U8 0.9961 fak_ub_b1 0.00 0.9961
 /begin AXIS_DESCR STD_AXIS TMdl_tiEngOff t1sxs_uw_q1 10 0.00 65535.00 FORMAT "%8.2" DEPOSIT ABSOLUTE /end AXIS_DESCR
 /begin AXIS_DESCR STD_AXIS NO_INPUT_QUANTITY dez 5 0.00 255.0 FORMAT "%5.1" DEPOSIT ABSOLUTE /end AXIS_DESCR
/end CHARACTERISTIC
/begin CHARACTERISTIC ExhMod_facTauTExhB1_T "Factor time constant for successive filtering of gas temperatures" CURVE 0x80522BDA RB_Curve_U16_U16 1.000000 fak_uw_b2 0.00 1.000000 FORMAT "%8.6" EXTENDED_LIMITS 0.00 1.999969
 /begin AXIS_DESCR STD_AXIS NO_INPUT_QUANTITY m_q0p1 6 0.00 6553.500 FORMAT "%8.3" DEPOSIT ABSOLUTE /end AXIS_DESCR
/end CHARACTERISTIC
/begin CHARACTERISTIC ExhMod_facTExhVlvCorrnIgnAgHomB1_M "correction temperature exhaust at valve homogenous mode for ignition angle bank 1" MAP 0x805223EC RB_Map_U8U16_U16 1.999969 fak_uw_b2 0.00 1.999969 FORMAT "%8.6"
 /begin AXIS_DESCR STD_AXIS NO_INPUT_QUANTITY rel_ub_b127p5 8 0.00 127.5 FORMAT "%5.1" DEPOSIT ABSOLUTE /end AXIS_DESCR
 /begin AXIS_DESCR STD_AXIS NO_INPUT_QUANTITY m_uw_b6553p5 8 0.00 6553.500 FORMAT "%8.3" DEPOSIT ABSOLUTE /end AXIS_DESCR
/end CHARACTERISTIC
/begin CHARACTERISTIC ExhMod_facTExhVlvCorrnIgnAgHomB1_T "ignition efficiency correction exhaust gas temperature downstream homogeneous bank 1" CURVE 0x80522486 RB_Curve_U8_U16_Static 1.999969 fak_uw_b2 0.00 1.999969 FORMAT "%8.6"
 /begin AXIS_DESCR STD_AXIS ExhMod_effIgnAgAvrgB1 rel_ub_b127p5 6 0.00 127.5 FORMAT "%5.1" DEPOSIT ABSOLUTE /end AXIS_DESCR
/end CHARACTERISTIC
/begin CHARACTERISTIC ExhMod_facTExhVlvCorrnIntkAir_T "correction temperature exhaust at valve homogeneous mode for intake air temperature" CURVE 0x8052249A RB_Curve_S16_S8_Static 3.984 fak_sb_b2 -2.000 1.984 FORMAT "%5.3"
 /begin AXIS_DESCR STD_AXIS ExhMod_tExhVlvIntkAir Temp_Cels 6 -3549.940 3003.560 FORMAT "%8.3" DEPOSIT ABSOLUTE /end AXIS_DESCR
/end CHARACTERISTIC
/begin CHARACTERISTIC ExhMod_facTExhVlvCorrnLamB1_M "lambda correction exhaust temperature at valve bank 1" MAP 0x805224AE RB_Map_U16U16_U16 1.999969 fak_uw_b2 0.00 1.999969 FORMAT "%8.6"
 /begin AXIS_DESCR STD_AXIS NO_INPUT_QUANTITY fak_uw_b16 12 0.00 15.99976 FORMAT "%8.5" DEPOSIT ABSOLUTE /end AXIS_DESCR
 /begin AXIS_DESCR STD_AXIS NO_INPUT_QUANTITY m_uw_b6553p5 6 0.00 6553.500 FORMAT "%8.3" DEPOSIT ABSOLUTE /end AXIS_DESCR
/end CHARACTERISTIC
/begin CHARACTERISTIC ExhMod_facTExhVlvCorrnLamB1_T "lambda correction exhaust gas temperature downstream bank 1" CURVE 0x80522566 RB_Curve_U16_U16 1.999969 fak_uw_b2 0.00 1.999969 FORMAT "%8.6"
 /begin AXIS_DESCR STD_AXIS NO_INPUT_QUANTITY fak_uw_b16 12 0.00 15.99976 FORMAT "%8.5" DEPOSIT ABSOLUTE /end AXIS_DESCR
/end CHARACTERISTIC
/begin CHARACTERISTIC ExhMod_facTExhVlvCorrnRri_T "Exhaust temperature correction factor characteristic based on inert gas rate" CURVE 0x80522598 RB_Curve_U16_U16 1.999969 fak_uw_b2 0.00 1.999969 FORMAT "%8.6"
 /begin AXIS_DESCR STD_AXIS rri_w_msg rel_uw_b100 10 0.00 99.99847 FORMAT "%8.5" DEPOSIT ABSOLUTE /end AXIS_DESCR
/end CHARACTERISTIC
/begin CHARACTERISTIC ExhMod_facWghtMnfldCatExoCcoLam_M "weighting factor manifold catalyst exothermy cylinder cut-off depending on lambda" MAP 0x80522EC0 RB_Map_U16U16_U16 1.000000 fak_uw_b2 0.00 1.000000 FORMAT "%8.6" EXTENDED_LIMITS 0.00 1.999969
 /begin AXIS_DESCR STD_AXIS NO_INPUT_QUANTITY fak_uw_b16 8 0.00 15.99976 FORMAT "%8.5" DEPOSIT ABSOLUTE /end AXIS_DESCR
 /begin AXIS_DESCR STD_AXIS NO_INPUT_QUANTITY fak_uw_b16 8 0.00 15.99976 FORMAT "%8.5" DEPOSIT ABSOLUTE /end AXIS_DESCR
/end CHARACTERISTIC
/begin CHARACTERISTIC ExhMod_facWghtMnfldCatExoCcoTB1_T "weighting factor manifold catalyst exothermy cylinder cut-off depending on temperature bank 1" CURVE 0x80522F64 RB_Curve_S16_S16 1.000000 fak_ub_b2 0.00 1.000000 FORMAT "%8.6" EXTENDED_LIMITS -256.0000 255.9922
 /begin AXIS_DESCR STD_AXIS NO_INPUT_QUANTITY Temp_Cels 8 -3549.940 3003.560 FORMAT "%8.3" DEPOSIT ABSOLUTE /end AXIS_DESCR
/end CHARACTERISTIC
/begin CHARACTERISTIC ExhMod_flgActvtExoCalcnTranLtr_C "Activate exothermicity calculation for a Lambda transition from lean-to-rich" VALUE 0x80522F86 RB_Val_Wu8 1.00000000000 B_TRUE 0.00 1.00000000000 FORMAT "%13.11" /end CHARACTERISTIC
/begin CHARACTERISTIC ExhMod_flgActvtExoCalcnTranRtl_C "Activate exothermicity calculation for a Lambda transition from rich-to-lean" VALUE 0x80522F87 RB_Val_Wu8 1.00000000000 B_TRUE 0.00 1.00000000000 FORMAT "%13.11" /end CHARACTERISTIC
/begin CHARACTERISTIC ExhMod_htcCatCannB1_M "heat transport coefficient catalyst catalyst canning bank 1" MAP 0x80522F88 RB_Map_U16U16_U16 113.7760 fak_q0p00174_JsK 0.00 113.7760 FORMAT "%8.4"
 /begin AXIS_DESCR STD_AXIS NO_INPUT_QUANTITY m_uw_b6553p5 5 0.00 6553.500 FORMAT "%8.3" DEPOSIT ABSOLUTE /end AXIS_DESCR
 /begin AXIS_DESCR STD_AXIS NO_INPUT_QUANTITY dez 6 0.00 255.0000 FORMAT "%8.4" EXTENDED_LIMITS 0.00 65535.00 DEPOSIT ABSOLUTE /end AXIS_DESCR
/end CHARACTERISTIC
/begin CHARACTERISTIC ExhMod_htcExhWallB1_M "heat transport coefficient exhaust wall bank 1" MAP 0x80522FDE RB_Map_U16U16_U16 0.9999847 fak_uw_b1 0.00 0.9999847 FORMAT "%9.7"
 /begin AXIS_DESCR STD_AXIS NO_INPUT_QUANTITY m_uw_b6553p5 12 0.00 6553.500 FORMAT "%8.3" DEPOSIT ABSOLUTE /end AXIS_DESCR
 /begin AXIS_DESCR STD_AXIS NO_INPUT_QUANTITY dez 7 0.00 255.0000 FORMAT "%8.4" EXTENDED_LIMITS 0.00 65535.00 DEPOSIT ABSOLUTE /end AXIS_DESCR
/end CHARACTERISTIC
/begin CHARACTERISTIC ExhMod_htcWallEnvB1_M "heat transport coefficient wall environment bank 1" MAP 0x805230B0 RB_Map_U16U16_U16 113.7760 fak_q0p00174_JsK 0.00 113.7760 FORMAT "%8.4"
 /begin AXIS_DESCR STD_AXIS vfzg_wloc vfzg_uw_b512 7 0.00 511.9922 FORMAT "%8.4" DEPOSIT ABSOLUTE /end AXIS_DESCR
 /begin AXIS_DESCR STD_AXIS NO_INPUT_QUANTITY dez 13 0.00 255.0000 FORMAT "%8.4" EXTENDED_LIMITS 0.00 65535.00 DEPOSIT ABSOLUTE /end AXIS_DESCR
/end CHARACTERISTIC
/begin CHARACTERISTIC ExhMod_idxIninSctn_CA "index initialisation section" VAL_BLK 0x80522CA0 RB_ValA_Wu8 4.000 dez 0.00 4.000 FORMAT "%5.3" EXTENDED_LIMITS 0.00 255.0 NUMBER 13 /end CHARACTERISTIC
/begin CHARACTERISTIC ExhMod_idxSnsrB1_CA "Configuration array sensor positions" VAL_BLK 0x80522BF4 RB_ValA_Wu8 12.00 dez 0.00 12.00 FORMAT "%5.2" EXTENDED_LIMITS 0.00 255.0 NUMBER 2 /end CHARACTERISTIC
/begin CHARACTERISTIC ExhMod_idxTCat1ExtdB1_CA "Extended configuration array temperatures catalyst 1" VAL_BLK 0x80522BF6 RB_ValA_Wu8 12.00 dez 0.00 12.00 FORMAT "%5.2" EXTENDED_LIMITS 0.00 255.0 NUMBER 5 /end CHARACTERISTIC
/begin CHARACTERISTIC ExhMod_idxTCat2ExtdB1_CA "Extended configuration array temperatures catalyst 2" VAL_BLK 0x80522BFB RB_ValA_Wu8 12.00 dez 0.00 12.00 FORMAT "%5.2" EXTENDED_LIMITS 0.00 255.0 NUMBER 5 /end CHARACTERISTIC
/begin CHARACTERISTIC ExhMod_idxTExhB1_CA "Configuration array exhaust gas temperatures" VAL_BLK 0x80522C00 RB_ValA_Wu8 12.00 dez 0.00 12.00 FORMAT "%5.2" EXTENDED_LIMITS 0.00 255.0 NUMBER 3 /end CHARACTERISTIC
/begin CHARACTERISTIC ExhMod_nrIterPDiffCat_C "Number of iterations pressure drop calculation catalysts" VALUE 0x80522396 RB_Val_Wu8 255.0 dez 0.00 255.0 FORMAT "%5.1" /end CHARACTERISTIC
/begin CHARACTERISTIC ExhMod_nrMaxColdStrtTspS1_C "maximum value cold start counter for thermo shock protected sensor fast release feature sensor 1" VALUE 0x805237F8 RB_Val_Wu8 255.0 dez 0.00 255.0 FORMAT "%5.1" /end CHARACTERISTIC
/begin CHARACTERISTIC ExhMod_offsTExhVlvCorrnIgnAgHomB1_M "offset lambda correction exhaust gas temperature downstream homogeneous split caheating valve bank 1" MAP 0x805225C2 RB_Map_S16U16_S16 1535.977 temp_q0p0234 -768.0000 767.9766 FORMAT "%8.4"
 /begin AXIS_DESCR STD_AXIS Epm_nEng nmot_q0p5 11 -16384.00 16383.50 FORMAT "%8.2" DEPOSIT ABSOLUTE /end AXIS_DESCR
 /begin AXIS_DESCR STD_AXIS AirMod_ratChrgAirCyl rel_q0p0234 11 0.00 1535.977 FORMAT "%8.3" DEPOSIT ABSOLUTE /end AXIS_DESCR
/end CHARACTERISTIC
/begin CHARACTERISTIC ExhMod_offsTExhVlvCorrnIntkAirB1_M "correction temperature exhaust at valve homogenous mode for intake air temperature (offset) Bank 1" MAP 0x805226E4 RB_Map_S16U16_U16 1535.977 temp_q0p0234 0.00 1535.977 FORMAT "%8.3"
 /begin AXIS_DESCR STD_AXIS Epm_nEng nmot_q0p5 11 -16384.00 16383.50 FORMAT "%8.2" DEPOSIT ABSOLUTE /end AXIS_DESCR
 /begin AXIS_DESCR STD_AXIS AirMod_ratChrgAirCyl rel_q0p0234 11 0.00 1535.977 FORMAT "%8.3" DEPOSIT ABSOLUTE /end AXIS_DESCR
/end CHARACTERISTIC
/begin CHARACTERISTIC ExhMod_offsTExhVlvCorrnLamB1_M "offset lambda correction exhaust gas temperature downstream valve bank 1" MAP 0x80522806 RB_Map_S16U16_S16 1535.977 temp_q0p0234 -768.0000 767.9766 FORMAT "%8.4"
 /begin AXIS_DESCR STD_AXIS Epm_nEng nmot_q0p5 11 -16384.00 16383.50 FORMAT "%8.2" DEPOSIT ABSOLUTE /end AXIS_DESCR
 /begin AXIS_DESCR STD_AXIS AirMod_ratChrgAirCyl rel_q0p0234 11 0.00 1535.977 FORMAT "%8.3" DEPOSIT ABSOLUTE /end AXIS_DESCR
/end CHARACTERISTIC
/begin CHARACTERISTIC ExhMod_pDiffCatMFlow_M "Characteristic map mass flow-dependent factor in press. gradient catalysts" MAP 0x80522398 RB_Map_S16U16_U16 1048560. fak_q16_hPahPa 0.00 1048560. FORMAT "%8.0"
 /begin AXIS_DESCR STD_AXIS NO_INPUT_QUANTITY m_q0p1 12 -3276.800 3276.700 FORMAT "%8.3" DEPOSIT ABSOLUTE /end AXIS_DESCR
 /begin AXIS_DESCR STD_AXIS NO_INPUT_QUANTITY dez 2 0.00 255.0000 FORMAT "%8.4" EXTENDED_LIMITS 0.00 65535.00 DEPOSIT ABSOLUTE /end AXIS_DESCR
/end CHARACTERISTIC
/begin CHARACTERISTIC ExhMod_pEnvDiffAppl_C "Offset on ambient pressure for the exhaust backpressure model" VALUE 0x805223E8 RB_Val_Wu16 2559.961 p_q0p039 0.00 2559.961 FORMAT "%8.3" /end CHARACTERISTIC
/begin CHARACTERISTIC ExhMod_ratLamThdLean_C "Threshold lambda ratio lean for exothermy calculation" VALUE 0x80523192 RB_Val_Wu16 15.99976 fak_uw_b16 0.00 15.99976 FORMAT "%8.5" /end CHARACTERISTIC
/begin CHARACTERISTIC ExhMod_ratLamThdRich_C "threshold lambda ratio rich for exothermy calculation" VALUE 0x80523194 RB_Val_Wu16 15.99976 fak_uw_b16 0.00 15.99976 FORMAT "%8.5" /end CHARACTERISTIC
/begin CHARACTERISTIC ExhMod_stCfgExhSysB1_CA "configuration array exhaust system bank 1" VAL_BLK 0x80523196 RB_ValA_Wu8 13.00 dez 0.00 13.00 FORMAT "%5.2" EXTENDED_LIMITS 0.00 255.0 NUMBER 13 /end CHARACTERISTIC
/begin CHARACTERISTIC ExhMod_stCfgIninB1_CA "Configuration array for determination of the initialisation strategy bank 1" VAL_BLK 0x805231A3 RB_ValA_Wu8 2.000 dez 1.000 3.000 FORMAT "%5.3" EXTENDED_LIMITS 0.00 255.0 NUMBER 13 /end CHARACTERISTIC
/begin CHARACTERISTIC ExhMod_stExoCalcnActvTransLtr_C "Status bit to activate the exothermicity calculation during a lean-to-rich lambda transition" VALUE 0x805231B0 RB_Val_Wu8 255.0 OneToOne 0.00 255.0 FORMAT "%5.1" /end CHARACTERISTIC
/begin CHARACTERISTIC ExhMod_stExoCat1Br1_C "codeword first catalyst first brick" VALUE 0x805231B1 RB_Val_Wu8 255.0 dez 0.00 255.0 FORMAT "%5.1" /end CHARACTERISTIC
/begin CHARACTERISTIC ExhMod_stOsc_C "Code word regulation oxygen storage capability" VALUE 0x80521D48 RB_Val_Wu16 65535.00 dez 0.00 65535.00 FORMAT "%8.2" /end CHARACTERISTIC
/begin CHARACTERISTIC ExhMod_stSigQlyMskEnvT_C "status of signal quality mask for the environment temperature" VALUE 0x805231B2 RB_Val_Wu16 65535.00 OneToOne 0.00 65535.00 FORMAT "%8.2" /end CHARACTERISTIC
/begin CHARACTERISTIC ExhMod_stTExhCat1_C "codeword for the assignment of the exhaust temperatures at cat 1 with application values" VALUE 0x80522C04 RB_Val_Wu16 65535.00 dez 0.00 65535.00 FORMAT "%8.2" /end CHARACTERISTIC
/begin CHARACTERISTIC ExhMod_stTExhCat2_C "codeword for the assignment of the exhaust temperatures at cat 2 with application values" VALUE 0x80522C06 RB_Val_Wu16 65535.00 dez 0.00 65535.00 FORMAT "%8.2" /end CHARACTERISTIC
/begin CHARACTERISTIC ExhMod_stTExhFltd_C "Codeword for additional filtering of exhaust gas temperatures" VALUE 0x80522C08 RB_Val_Wu8 255.0 dez 0.00 255.0 FORMAT "%5.1" /end CHARACTERISTIC
/begin CHARACTERISTIC ExhMod_stTExhMnfFirstPipY_C "codeword for the assignment of the exhaust temperatures in manifold, first pipe and Y-configuration with application values" VALUE 0x80522C0A RB_Val_Wu16 65535.00 dez 0.00 65535.00 FORMAT "%8.2" /end CHARACTERISTIC
/begin CHARACTERISTIC ExhMod_stTExhSnsr_C "codeword for the assignment of the exhaust temperatures at the sensors with application values" VALUE 0x80522C0C RB_Val_Wu16 65535.00 dez 0.00 65535.00 FORMAT "%8.2" /end CHARACTERISTIC
/begin CHARACTERISTIC ExhMod_stTExo_C "Codeword for exothermic modells (internal)" VALUE 0x805231B4 RB_Val_Wu8 255.0 dez 0.00 255.0 FORMAT "%5.1" /end CHARACTERISTIC
/begin CHARACTERISTIC ExhMod_stTMdl1_C "codeword temperature modell" VALUE 0x805231B6 RB_Val_Wu16 65535.00 dez 0.00 65535.00 FORMAT "%8.2" /end CHARACTERISTIC
/begin CHARACTERISTIC ExhMod_stTMdl2_C "codeword temperature modell" VALUE 0x805231B8 RB_Val_Wu8 255.0 dez 0.00 255.0 FORMAT "%5.1" /end CHARACTERISTIC
/begin CHARACTERISTIC ExhMod_stTMdl_C "codeword temperature modell" VALUE 0x805231BA RB_Val_Wu16 65535.00 dez 0.00 65535.00 FORMAT "%8.2" /end CHARACTERISTIC
/begin CHARACTERISTIC ExhMod_stTspSnsrRelsB1_CA "sensor specific code word array for ExhMod_TspSnsrRels" VAL_BLK 0x805237F9 RB_ValA_Wu8 255.0 OneToOne 0.00 255.0 FORMAT "%5.1" NUMBER 2 /end CHARACTERISTIC
/begin CHARACTERISTIC ExhMod_stTspSnsrRels_C "codeword for ExhMod_StTspSnsrRels" VALUE 0x805237FB RB_Val_Wu8 255.0 dez 0.00 255.0 FORMAT "%5.1" /end CHARACTERISTIC
/begin CHARACTERISTIC ExhMod_stTVlvMdl_C "codeword TExhVlvMdl" VALUE 0x80522928 RB_Val_Wu8 255.0 dez 0.00 255.0 FORMAT "%5.1" /end CHARACTERISTIC
/begin CHARACTERISTIC ExhMod_stTWallSnsr_C "codeword for the assignment of the wall temperatures at the sensors with application values" VALUE 0x80522C0E RB_Val_Wu16 65535.00 dez 0.00 65535.00 FORMAT "%8.2" /end CHARACTERISTIC
/begin CHARACTERISTIC ExhMod_tauTExhCat1ExtdB1_CA "Extended array time constants for additional filtering of exhaust temperatures in catalyst 1, bank 1" VAL_BLK 0x80522C10 RB_ValA_Wu16 3276.700 t_q0p05 0.050 3276.750 FORMAT "%8.3" EXTENDED_LIMITS 0.00 3276.750 NUMBER 5 /end CHARACTERISTIC
/begin CHARACTERISTIC ExhMod_tauTExhCat2ExtdB1_CA "Extended array time constants for additional filtering of exhaust temperatures in catalyst 2, bank 1" VAL_BLK 0x80522C1A RB_ValA_Wu16 3276.700 t_q0p05 0.050 3276.750 FORMAT "%8.3" EXTENDED_LIMITS 0.00 3276.750 NUMBER 5 /end CHARACTERISTIC
/begin CHARACTERISTIC ExhMod_tauTExhMnfFirstPipYB1_CA "array time constants for additional filtering of exhaust temperature in manifold, first brick and Y-configuration, bank 1" VAL_BLK 0x80522C24 RB_ValA_Wu16 3276.700 t_q0p05 0.050 3276.750 FORMAT "%8.3" EXTENDED_LIMITS 0.00 3276.750 NUMBER 3 /end CHARACTERISTIC
/begin CHARACTERISTIC ExhMod_tauTExhSnsrB1_CA "array time constants for additional filtering of exhaust temperature at the sensors, bank 1" VAL_BLK 0x80522C2A RB_ValA_Wu16 3276.700 t_q0p05 0.050 3276.750 FORMAT "%8.3" EXTENDED_LIMITS 0.00 3276.750 NUMBER 2 /end CHARACTERISTIC
/begin CHARACTERISTIC ExhMod_tDeltaExoColdCatB1_CA "exothermy cold catalyst bank 1" VAL_BLK 0x805231BC RB_ValA_Ws16 1535.977 temp_q0p0234 -768.0000 767.9766 FORMAT "%8.4" NUMBER 2 /end CHARACTERISTIC
/begin CHARACTERISTIC ExhMod_tDeltaExoFco_M "exothermy fuel cut-off" MAP 0x805231C0 RB_Map_U16U16_U16 3071.953 temp_uw_q0p0468 0.00 3071.953 FORMAT "%8.3"
 /begin AXIS_DESCR STD_AXIS NO_INPUT_QUANTITY m_uw_b6553p5 6 0.00 6553.500 FORMAT "%8.3" DEPOSIT ABSOLUTE /end AXIS_DESCR
 /begin AXIS_DESCR STD_AXIS NO_INPUT_QUANTITY fak_uw_b16 6 0.00 15.99976 FORMAT "%8.5" DEPOSIT ABSOLUTE /end AXIS_DESCR
/end CHARACTERISTIC
/begin CHARACTERISTIC ExhMod_tDeltaExoHomB1_M "exothermy catalyst bricks homogenous operation bank 1" MAP 0x80523224 RB_Map_U16U16_S16 1535.977 temp_q0p0234 -768.0000 767.9766 FORMAT "%8.4"
 /begin AXIS_DESCR STD_AXIS NO_INPUT_QUANTITY m_uw_b6553p5 11 0.00 6553.500 FORMAT "%8.3" DEPOSIT ABSOLUTE /end AXIS_DESCR
 /begin AXIS_DESCR STD_AXIS NO_INPUT_QUANTITY dez 6 0.00 255.0000 FORMAT "%8.4" EXTENDED_LIMITS 0.00 65535.00 DEPOSIT ABSOLUTE /end AXIS_DESCR
/end CHARACTERISTIC
/begin CHARACTERISTIC ExhMod_tDeltaExoTotHomB1_M "total exothermy catalyst bricks homogenous operation bank 1" MAP 0x805232CE RB_Map_S16U16_U16 8191.875 temp_sw_q0p125 0.00 8191.875 FORMAT "%8.3"
 /begin AXIS_DESCR STD_AXIS Epm_nEng nmot_q0p5 11 -16384.00 16383.50 FORMAT "%8.2" DEPOSIT ABSOLUTE /end AXIS_DESCR
 /begin AXIS_DESCR STD_AXIS AirMod_ratChrgAirCyl Perc_q0p0234375_COMPU 11 0.00 1535.977 FORMAT "%8.3" DEPOSIT ABSOLUTE /end AXIS_DESCR
/end CHARACTERISTIC
/begin CHARACTERISTIC ExhMod_tDeltaExoTotHomCatHeatgB1_M "total exothermy catalyst bricks homogenous catalyst heating operation bank 1" MAP 0x805233F0 RB_Map_S16U16_U16 8191.875 temp_sw_q0p125 0.00 8191.875 FORMAT "%8.3"
 /begin AXIS_DESCR STD_AXIS Epm_nEng nmot_q0p5 11 -16384.00 16383.50 FORMAT "%8.2" DEPOSIT ABSOLUTE /end AXIS_DESCR
 /begin AXIS_DESCR STD_AXIS AirMod_ratChrgAirCyl Perc_q0p0234375_COMPU 11 0.00 1535.977 FORMAT "%8.3" DEPOSIT ABSOLUTE /end AXIS_DESCR
/end CHARACTERISTIC
/begin CHARACTERISTIC ExhMod_tDeltaExoTotHomCatHeatSustB1_M "total exothermy catalyst bricks homogenous catalyst heat sustain operation bank 1" MAP 0x80523512 RB_Map_S16U16_U16 8191.875 temp_sw_q0p125 0.00 8191.875 FORMAT "%8.3"
 /begin AXIS_DESCR STD_AXIS Epm_nEng nmot_q0p5 11 -16384.00 16383.50 FORMAT "%8.2" DEPOSIT ABSOLUTE /end AXIS_DESCR
 /begin AXIS_DESCR STD_AXIS AirMod_ratChrgAirCyl Perc_q0p0234375_COMPU 11 0.00 1535.977 FORMAT "%8.3" DEPOSIT ABSOLUTE /end AXIS_DESCR
/end CHARACTERISTIC
/begin CHARACTERISTIC ExhMod_tDeltaExoTranLtr_M "Exothermicity in catalyst bricks during lean-to-rich lambda transition" MAP 0x80523634 RB_Map_U16U16_S16 1535.977 temp_q0p0234 -768.0000 767.9766 FORMAT "%8.4"
 /begin AXIS_DESCR STD_AXIS NO_INPUT_QUANTITY m_uw_b6553p5 6 0.00 6553.500 FORMAT "%8.3" DEPOSIT ABSOLUTE /end AXIS_DESCR
 /begin AXIS_DESCR STD_AXIS lamsbg_wloc fak_uw_b16 6 0.00 15.99976 FORMAT "%8.5" DEPOSIT ABSOLUTE /end AXIS_DESCR
/end CHARACTERISTIC
/begin CHARACTERISTIC ExhMod_tDeltaExoTranRtl_M "Exothermicity in catalyst bricks during rich-to-lean lambda transition" MAP 0x80523698 RB_Map_U16U16_S16 1535.977 temp_q0p0234 -768.0000 767.9766 FORMAT "%8.4"
 /begin AXIS_DESCR STD_AXIS NO_INPUT_QUANTITY m_uw_b6553p5 6 0.00 6553.500 FORMAT "%8.3" DEPOSIT ABSOLUTE /end AXIS_DESCR
 /begin AXIS_DESCR STD_AXIS lamsbg_wloc fak_uw_b16 6 0.00 15.99976 FORMAT "%8.5" DEPOSIT ABSOLUTE /end AXIS_DESCR
/end CHARACTERISTIC
/begin CHARACTERISTIC ExhMod_tExhCat1ExtdAppl_CA "Extended application array for the exhaust temperatures at cat 1" VAL_BLK 0x80522C2E RB_ValA_Ws16 6553.500 Temp_Cels -3549.940 3003.560 FORMAT "%8.3" NUMBER 5 /end CHARACTERISTIC
/begin CHARACTERISTIC ExhMod_tExhCat2ExtdAppl_CA "Extended application array for the exhaust temperatures at cat 2" VAL_BLK 0x80522C38 RB_ValA_Ws16 6553.500 Temp_Cels -3549.940 3003.560 FORMAT "%8.3" NUMBER 5 /end CHARACTERISTIC
/begin CHARACTERISTIC ExhMod_tExhIninB1_CA "initialisation temperature exhaust gas bank 1" VAL_BLK 0x805236FC RB_ValA_Wu16 1535.977 temp_q0p0234_o273 -273.150 1262.827 FORMAT "%8.3" NUMBER 13 /end CHARACTERISTIC
/begin CHARACTERISTIC ExhMod_tExhSnsrAppl_CA "application array for the exhaust temperatures at the sensors" VAL_BLK 0x80522C42 RB_ValA_Ws16 6553.500 Temp_Cels -3549.940 3003.560 FORMAT "%8.3" NUMBER 2 /end CHARACTERISTIC
/begin CHARACTERISTIC ExhMod_tExhVlvFcoB1_M "exhaust temperature valve fuel cut off bank 1" MAP 0x8052292A RB_Map_S16U16_U16 1535.977 temp_q0p0234_o273 -273.150 1262.827 FORMAT "%8.3"
 /begin AXIS_DESCR STD_AXIS Epm_nEng nmot_q0p5 5 -16384.00 16383.50 FORMAT "%8.2" DEPOSIT ABSOLUTE /end AXIS_DESCR
 /begin AXIS_DESCR STD_AXIS CEngDsT_t Temp_Cels 5 -273.140 3003.560 FORMAT "%8.3" EXTENDED_LIMITS -273.1400 6280.360 DEPOSIT ABSOLUTE /end AXIS_DESCR
/end CHARACTERISTIC
/begin CHARACTERISTIC ExhMod_tExhVlvHomB1_M "exhaust temperature valve homogenous mode bank 1" MAP 0x80522974 RB_Map_S16U16_U16 1262.836 temp_q0p0234_o273 -0.009 1262.827 FORMAT "%8.3" EXTENDED_LIMITS -273.1500 1262.827
 /begin AXIS_DESCR STD_AXIS Epm_nEng nmot_q0p5 11 -16384.00 16383.50 FORMAT "%8.2" DEPOSIT ABSOLUTE /end AXIS_DESCR
 /begin AXIS_DESCR STD_AXIS NO_INPUT_QUANTITY rel_uw_b3072 11 0.00 3071.953 FORMAT "%8.3" DEPOSIT ABSOLUTE /end AXIS_DESCR
/end CHARACTERISTIC
/begin CHARACTERISTIC ExhMod_tExhVlvHomHiVlvLftB1_M "exhaust temperature valve homogenous mode high valve lift bank 1" MAP 0x80522A96 RB_Map_S16U16_U16 1262.836 temp_q0p0234_o273 -0.009 1262.827 FORMAT "%8.3" EXTENDED_LIMITS -273.1500 1262.827
 /begin AXIS_DESCR STD_AXIS Epm_nEng nmot_q0p5 11 -16384.00 16383.50 FORMAT "%8.2" DEPOSIT ABSOLUTE /end AXIS_DESCR
 /begin AXIS_DESCR STD_AXIS NO_INPUT_QUANTITY rel_uw_b3072 11 0.00 3071.953 FORMAT "%8.3" DEPOSIT ABSOLUTE /end AXIS_DESCR
/end CHARACTERISTIC
/begin CHARACTERISTIC ExhMod_tiConExoFco_T "time constant exothermy fuel cut-off" CURVE 0x80523716 RB_Curve_U16_U16 3276.750 t_q0p05 0.00 3276.750 FORMAT "%8.3"
 /begin AXIS_DESCR STD_AXIS NO_INPUT_QUANTITY m_uw_b6553p5 4 0.00 6553.500 FORMAT "%8.3" DEPOSIT ABSOLUTE /end AXIS_DESCR
/end CHARACTERISTIC
/begin CHARACTERISTIC ExhMod_tiConExoTranLtr_T "Time constant for filtering the exothermicity in catalyst after a lean-to-rich lambda transition bank 1" CURVE 0x80523728 RB_Curve_U16_U16 3276.750 t_q0p05 0.00 3276.750 FORMAT "%8.3"
 /begin AXIS_DESCR STD_AXIS NO_INPUT_QUANTITY m_uw_b6553p5 4 0.00 6553.500 FORMAT "%8.3" DEPOSIT ABSOLUTE /end AXIS_DESCR
/end CHARACTERISTIC
/begin CHARACTERISTIC ExhMod_tiConExoTranRtl_T "Time constant for filtering the exothermicity in catalyst after a rich-to-lean lambda transition" CURVE 0x8052373A RB_Curve_U16_U16 3276.750 t_q0p05 0.00 3276.750 FORMAT "%8.3"
 /begin AXIS_DESCR STD_AXIS NO_INPUT_QUANTITY m_uw_b6553p5 4 0.00 6553.500 FORMAT "%8.3" DEPOSIT ABSOLUTE /end AXIS_DESCR
/end CHARACTERISTIC
/begin CHARACTERISTIC ExhMod_tiConTExhVlvFcoB1_T "time constant exhaust temperature fuel cut-off bank 1" CURVE 0x80522BB8 RB_Curve_U16_U16 3276.7499992 zk50msxs_uw_b3276p8 0.0500008 3276.8000000 FORMAT "%12.7" EXTENDED_LIMITS 0.050000762951 3276.8000000
 /begin AXIS_DESCR STD_AXIS NO_INPUT_QUANTITY m_uw_b6553p5 8 0.00 6553.500 FORMAT "%8.3" DEPOSIT ABSOLUTE /end AXIS_DESCR
/end CHARACTERISTIC
/begin CHARACTERISTIC ExhMod_tiDlyEngStop_C "Time to hold engine off time for ExhMod zero after engine shut down" VALUE 0x80523752 RB_Val_Wu8 12.75 t_q0p05 0.00 12.75 FORMAT "%5.2" /end CHARACTERISTIC
/begin CHARACTERISTIC ExhMod_tiSigHoldEngRunng_C "Calculation interval of the slowest raster which imports ExhMod_flgEngRunngTiEngOff" VALUE 0x80523753 RB_Val_Wu8 12.75 t_q0p05 0.00 12.75 FORMAT "%5.2" /end CHARACTERISTIC
/begin CHARACTERISTIC ExhMod_tMnfFirstPipYAppl_CA "application array for the exhaust temperatures in manifold, first pipe and Y-configuration" VAL_BLK 0x80522C46 RB_ValA_Ws16 6553.500 Temp_Cels -3549.940 3003.560 FORMAT "%8.3" NUMBER 3 /end CHARACTERISTIC
/begin CHARACTERISTIC ExhMod_tReplcmtEnvTInvldEepFailr_C "Replacement value for temperature for an invalid ambient temperature signal and EEP Failure" VALUE 0x8052374C RB_Val_Wu16 1535.977 temp_q0p0234_o273 -273.150 1262.827 FORMAT "%8.3" /end CHARACTERISTIC
/begin CHARACTERISTIC ExhMod_tThdIgnCatB1_CA "temperature threshold ignition catalyst bank 1" VAL_BLK 0x8052374E RB_ValA_Wu16 1535.977 temp_q0p0234_o273 -273.150 1262.827 FORMAT "%8.3" NUMBER 2 /end CHARACTERISTIC
/begin CHARACTERISTIC ExhMod_tWallSnsrAppl_CA "application array for the wall temperatures at the sensors" VAL_BLK 0x80522C4C RB_ValA_Ws16 6553.500 Temp_Cels -3549.940 3003.560 FORMAT "%8.3" NUMBER 2 /end CHARACTERISTIC
/begin CHARACTERISTIC FanCtl_facAftRunCorrd_CUR "correction factor afterrun time" CURVE 0x80523AA4 RB_Curve_S16_S16 511.9922 Fact1 -256.0000 255.9922 FORMAT "%8.4"
 /begin AXIS_DESCR STD_AXIS GlbDa_tEnv Temp_Cels 4 -3549.940 3003.560 FORMAT "%8.3" DEPOSIT ABSOLUTE /end AXIS_DESCR
/end CHARACTERISTIC
/begin CHARACTERISTIC FanCtl_flgSwtAntiFlickDeactv_C "Anti headlight flicker de-actived switch" VALUE 0x80523AB6 RB_Val_Wu8 1.00000000000 B_TRUE 0.00 1.00000000000 FORMAT "%13.11" READ_ONLY /end CHARACTERISTIC
/begin CHARACTERISTIC FanCtl_nAntiFlickThd_C "Low engine speed threshold for anti headlight flicker" VALUE 0x80523AB8 RB_Val_Ws16 32767.50 EngN -16384.00 16383.50 FORMAT "%8.2" READ_ONLY /end CHARACTERISTIC
/begin CHARACTERISTIC FanCtl_nFanDecelHi_C "High speed value for Fan deceleration." VALUE 0x80523ABA RB_Val_Ws16 32767.50 EngN -16384.00 16383.50 FORMAT "%8.2" /end CHARACTERISTIC
/begin CHARACTERISTIC FanCtl_nFanDecelLo_C "Low speed value for Fan deceleration." VALUE 0x80523ABC RB_Val_Ws16 32767.50 EngN -16384.00 16383.50 FORMAT "%8.2" /end CHARACTERISTIC
/begin CHARACTERISTIC FanCtl_nSpdHi_C "Hysteresis threshold Hi of vehicle speed for FanCtl demand of vehicle speed" VALUE 0x80523ABE RB_Val_Ws16 32767.50 EngN -16384.00 16383.50 FORMAT "%8.2" /end CHARACTERISTIC
/begin CHARACTERISTIC FanCtl_nSpdLo_C "Hysteresis threshold Lo of vehicle speed for FanCtl demand of vehicle speed" VALUE 0x80523AC0 RB_Val_Ws16 32767.50 EngN -16384.00 16383.50 FORMAT "%8.2" /end CHARACTERISTIC
/begin CHARACTERISTIC FanCtl_pCooltPDeltaHi_C "Hysteresis threshold Hi delta value of coolant pressure" VALUE 0x80523AC2 RB_Val_Ws16 131070.0 PresAC_hPa -65536.00 65534.00 FORMAT "%8.2" /end CHARACTERISTIC
/begin CHARACTERISTIC FanCtl_pCooltPHiHi_T "Hysteresis threshold Hi value of coolant pressure depends on vehicle speed" CURVE 0x80523AC4 RB_Curve_S16_S16 131070.0 PresAC_hPa -65536.00 65534.00 FORMAT "%8.2"
 /begin AXIS_DESCR STD_AXIS VehV_v Vel 5 -327.6800 327.6700 FORMAT "%8.4" DEPOSIT ABSOLUTE /end AXIS_DESCR
/end CHARACTERISTIC
/begin CHARACTERISTIC FanCtl_pCooltPLoHi_C "Hysteresis threshold Hi of E-Comp coolant pressure prohibition" VALUE 0x80523ADA RB_Val_Ws16 131070.0 PresAC_hPa -65536.00 65534.00 FORMAT "%8.2" /end CHARACTERISTIC
/begin CHARACTERISTIC FanCtl_pCooltPLoLo_C "Hysteresis threshold Low of E-Comp coolant pressure prohibition" VALUE 0x80523ADC RB_Val_Ws16 131070.0 PresAC_hPa -65536.00 65534.00 FORMAT "%8.2" /end CHARACTERISTIC
/begin CHARACTERISTIC FanCtl_pCooltPProhbHi_C "Hysteresis threshold Hi of coolant pressure prohibition" VALUE 0x80523ADE RB_Val_Ws16 131070.0 PresAC_hPa -65536.00 65534.00 FORMAT "%8.2" /end CHARACTERISTIC
/begin CHARACTERISTIC FanCtl_pCooltPProhbLo_C "Hysteresis threshold Low of coolant pressure prohibition" VALUE 0x80523AE0 RB_Val_Ws16 131070.0 PresAC_hPa -65536.00 65534.00 FORMAT "%8.2" /end CHARACTERISTIC
/begin CHARACTERISTIC FanCtl_pDutyPerdP11Hi_C "High Coolant pressure for Duty period 11" VALUE 0x80523AE2 RB_Val_Ws16 32767.00 RBPtCel_p_1p0_3 0.00 32767.00 FORMAT "%8.2" EXTENDED_LIMITS -32768.00 32767.00 /end CHARACTERISTIC
/begin CHARACTERISTIC FanCtl_pDutyPerdP11Lo_C "Low Coolant pressure for Duty period 11" VALUE 0x80523AE4 RB_Val_Ws16 32767.00 RBPtCel_p_1p0_3 0.00 32767.00 FORMAT "%8.2" EXTENDED_LIMITS -32768.00 32767.00 /end CHARACTERISTIC
/begin CHARACTERISTIC FanCtl_pDutyPerdP12Hi_C "High Coolant pressure for Duty period 12" VALUE 0x80523AE6 RB_Val_Ws16 32767.00 RBPtCel_p_1p0_3 0.00 32767.00 FORMAT "%8.2" EXTENDED_LIMITS -32768.00 32767.00 /end CHARACTERISTIC
/begin CHARACTERISTIC FanCtl_pDutyPerdP12Lo_C "Low Coolant pressure for Duty period 12" VALUE 0x80523AE8 RB_Val_Ws16 32767.00 RBPtCel_p_1p0_3 0.00 32767.00 FORMAT "%8.2" EXTENDED_LIMITS -32768.00 32767.00 /end CHARACTERISTIC
/begin CHARACTERISTIC FanCtl_pDutyPerdP13Hi_C "High Coolant pressure for Duty period 13" VALUE 0x80523AEA RB_Val_Ws16 32767.00 RBPtCel_p_1p0_3 0.00 32767.00 FORMAT "%8.2" EXTENDED_LIMITS -32768.00 32767.00 /end CHARACTERISTIC
/begin CHARACTERISTIC FanCtl_pDutyPerdP13Lo_C "Low Coolant pressure for Duty period 13" VALUE 0x80523AEC RB_Val_Ws16 32767.00 RBPtCel_p_1p0_3 0.00 32767.00 FORMAT "%8.2" EXTENDED_LIMITS -32768.00 32767.00 /end CHARACTERISTIC
/begin CHARACTERISTIC FanCtl_pDutyPerdP14Hi_C "High Coolant pressure for Duty period 14" VALUE 0x80523AEE RB_Val_Ws16 32767.00 RBPtCel_p_1p0_3 0.00 32767.00 FORMAT "%8.2" EXTENDED_LIMITS -32768.00 32767.00 /end CHARACTERISTIC
/begin CHARACTERISTIC FanCtl_pDutyPerdP14Lo_C "Low Coolant pressure for Duty period 14" VALUE 0x80523AF0 RB_Val_Ws16 32767.00 RBPtCel_p_1p0_3 0.00 32767.00 FORMAT "%8.2" EXTENDED_LIMITS -32768.00 32767.00 /end CHARACTERISTIC
/begin CHARACTERISTIC FanCtl_pDutyPerdP1Hi_C "High Coolant pressure for Duty period 1" VALUE 0x80523AF2 RB_Val_Ws16 32767.00 RBPtCel_p_1p0_3 0.00 32767.00 FORMAT "%8.2" EXTENDED_LIMITS -32768.00 32767.00 /end CHARACTERISTIC
/begin CHARACTERISTIC FanCtl_pDutyPerdP1Lo_C "Low Coolant pressure for Duty period 1" VALUE 0x80523AF4 RB_Val_Ws16 32767.00 RBPtCel_p_1p0_3 0.00 32767.00 FORMAT "%8.2" EXTENDED_LIMITS -32768.00 32767.00 /end CHARACTERISTIC
/begin CHARACTERISTIC FanCtl_pDutyPerdP21Hi_C "High Coolant pressure for Duty period 21" VALUE 0x80523AF6 RB_Val_Ws16 32767.00 RBPtCel_p_1p0_3 0.00 32767.00 FORMAT "%8.2" EXTENDED_LIMITS -32768.00 32767.00 /end CHARACTERISTIC
/begin CHARACTERISTIC FanCtl_pDutyPerdP21Lo_C "Low Coolant pressure for Duty period 21" VALUE 0x80523AF8 RB_Val_Ws16 32767.00 RBPtCel_p_1p0_3 0.00 32767.00 FORMAT "%8.2" EXTENDED_LIMITS -32768.00 32767.00 /end CHARACTERISTIC
/begin CHARACTERISTIC FanCtl_pDutyPerdP22Hi_C "High Coolant pressure for Duty period 22" VALUE 0x80523AFA RB_Val_Ws16 32767.00 RBPtCel_p_1p0_3 0.00 32767.00 FORMAT "%8.2" EXTENDED_LIMITS -32768.00 32767.00 /end CHARACTERISTIC
/begin CHARACTERISTIC FanCtl_pDutyPerdP22Lo_C "Low Coolant pressure for Duty period 22" VALUE 0x80523AFC RB_Val_Ws16 32767.00 RBPtCel_p_1p0_3 0.00 32767.00 FORMAT "%8.2" EXTENDED_LIMITS -32768.00 32767.00 /end CHARACTERISTIC
/begin CHARACTERISTIC FanCtl_pDutyPerdP23Hi_C "High Coolant pressure for Duty period 23" VALUE 0x80523AFE RB_Val_Ws16 32767.00 RBPtCel_p_1p0_3 0.00 32767.00 FORMAT "%8.2" EXTENDED_LIMITS -32768.00 32767.00 /end CHARACTERISTIC
/begin CHARACTERISTIC FanCtl_pDutyPerdP23Lo_C "Low Coolant pressure for Duty period 23" VALUE 0x80523B00 RB_Val_Ws16 32767.00 RBPtCel_p_1p0_3 0.00 32767.00 FORMAT "%8.2" EXTENDED_LIMITS -32768.00 32767.00 /end CHARACTERISTIC
/begin CHARACTERISTIC FanCtl_pDutyPerdP24Hi_C "High Coolant pressure for Duty period 24" VALUE 0x80523B02 RB_Val_Ws16 32767.00 RBPtCel_p_1p0_3 0.00 32767.00 FORMAT "%8.2" EXTENDED_LIMITS -32768.00 32767.00 /end CHARACTERISTIC
/begin CHARACTERISTIC FanCtl_pDutyPerdP24Lo_C "Low Coolant pressure for Duty period 24" VALUE 0x80523B04 RB_Val_Ws16 32767.00 RBPtCel_p_1p0_3 0.00 32767.00 FORMAT "%8.2" EXTENDED_LIMITS -32768.00 32767.00 /end CHARACTERISTIC
/begin CHARACTERISTIC FanCtl_pDutyPerdP2Hi_C "High Coolant pressure for Duty period 2" VALUE 0x80523B06 RB_Val_Ws16 32767.00 RBPtCel_p_1p0_3 0.00 32767.00 FORMAT "%8.2" EXTENDED_LIMITS -32768.00 32767.00 /end CHARACTERISTIC
/begin CHARACTERISTIC FanCtl_pDutyPerdP2Lo_C "Low Coolant pressure for Duty period 2" VALUE 0x80523B08 RB_Val_Ws16 32767.00 RBPtCel_p_1p0_3 0.00 32767.00 FORMAT "%8.2" EXTENDED_LIMITS -32768.00 32767.00 /end CHARACTERISTIC
/begin CHARACTERISTIC FanCtl_pDutyPerdP3HiHi_C "High Coolant pressure for Duty period 3 High" VALUE 0x80523B0A RB_Val_Ws16 32767.00 RBPtCel_p_1p0_3 0.00 32767.00 FORMAT "%8.2" EXTENDED_LIMITS -32768.00 32767.00 /end CHARACTERISTIC
/begin CHARACTERISTIC FanCtl_pDutyPerdP3HiLo_C "Low Coolant pressure for Duty period 3 Low" VALUE 0x80523B0C RB_Val_Ws16 32767.00 RBPtCel_p_1p0_3 0.00 32767.00 FORMAT "%8.2" EXTENDED_LIMITS -32768.00 32767.00 /end CHARACTERISTIC
/begin CHARACTERISTIC FanCtl_pDutyPerdP3Hi_C "High Coolant pressure for Duty period 3" VALUE 0x80523B0E RB_Val_Ws16 32767.00 RBPtCel_p_1p0_3 0.00 32767.00 FORMAT "%8.2" EXTENDED_LIMITS -32768.00 32767.00 /end CHARACTERISTIC
/begin CHARACTERISTIC FanCtl_pDutyPerdP3Lo_C "Low Coolant pressure for Duty period 3" VALUE 0x80523B10 RB_Val_Ws16 32767.00 RBPtCel_p_1p0_3 0.00 32767.00 FORMAT "%8.2" EXTENDED_LIMITS -32768.00 32767.00 /end CHARACTERISTIC
/begin CHARACTERISTIC FanCtl_pDutyPerdP4Hi_C "High Coolant pressure for Duty period 4" VALUE 0x80523B12 RB_Val_Ws16 32767.00 RBPtCel_p_1p0_3 0.00 32767.00 FORMAT "%8.2" EXTENDED_LIMITS -32768.00 32767.00 /end CHARACTERISTIC
/begin CHARACTERISTIC FanCtl_pDutyPerdP4Lo_C "Low Coolant pressure for Duty period 4" VALUE 0x80523B14 RB_Val_Ws16 32767.00 RBPtCel_p_1p0_3 0.00 32767.00 FORMAT "%8.2" EXTENDED_LIMITS -32768.00 32767.00 /end CHARACTERISTIC
/begin CHARACTERISTIC FanCtl_rAftRunDutyPred_C "Duty period percentage during after run." VALUE 0x80523B16 RB_Val_Ws16 799.9878 Prc -400.0000 399.9878 FORMAT "%8.4" /end CHARACTERISTIC
/begin CHARACTERISTIC FanCtl_rAftRunEnd_C "Duty period percentage for after run end." VALUE 0x80523B18 RB_Val_Ws16 799.9878 Prc -400.0000 399.9878 FORMAT "%8.4" /end CHARACTERISTIC
/begin CHARACTERISTIC FanCtl_rDutyPredHi_C "Fan Duty period high percentage value" VALUE 0x80523B1A RB_Val_Ws16 799.9878 Prc -400.0000 399.9878 FORMAT "%8.4" /end CHARACTERISTIC
/begin CHARACTERISTIC FanCtl_rDutyPredLo_C "Fan Duty period low percentage value" VALUE 0x80523B1C RB_Val_Ws16 799.9878 Prc -400.0000 399.9878 FORMAT "%8.4" /end CHARACTERISTIC
/begin CHARACTERISTIC FanCtl_rDutyPredMid1_C "Fan Duty period Mid1 percentage value" VALUE 0x80523B1E RB_Val_Ws16 799.9878 Prc -400.0000 399.9878 FORMAT "%8.4" /end CHARACTERISTIC
/begin CHARACTERISTIC FanCtl_rDutyPredMid2_C "Fan Duty period Mid2 percentage value" VALUE 0x80523B20 RB_Val_Ws16 799.9878 Prc -400.0000 399.9878 FORMAT "%8.4" /end CHARACTERISTIC
/begin CHARACTERISTIC FanCtl_rFailSafeDutyPerd_C "Fail safe value for fan duty period" VALUE 0x80523B22 RB_Val_Ws16 799.9878 Prc -400.0000 399.9878 FORMAT "%8.4" /end CHARACTERISTIC
/begin CHARACTERISTIC FanCtl_rFanDutyHi_C "Percentage value for Fan duty high" VALUE 0x80523B24 RB_Val_Ws16 799.9878 Prc -400.0000 399.9878 FORMAT "%8.4" /end CHARACTERISTIC
/begin CHARACTERISTIC FanCtl_rFanDutyLo_C "Percentage value for Fan duty low" VALUE 0x80523B26 RB_Val_Ws16 799.9878 Prc -400.0000 399.9878 FORMAT "%8.4" /end CHARACTERISTIC
/begin CHARACTERISTIC FanCtl_rFanDutyOff_C "Percentage value for Fan duty cycle in off state" VALUE 0x80523B28 RB_Val_Ws16 799.9878 Prc -400.0000 399.9878 FORMAT "%8.4" /end CHARACTERISTIC
/begin CHARACTERISTIC FanCtl_rPDpdtDutyPerd11_C "Fan Duty period based on coolant pressure 11 value" VALUE 0x80523B2A RB_Val_Ws16 799.9878 Prc -400.0000 399.9878 FORMAT "%8.4" /end CHARACTERISTIC
/begin CHARACTERISTIC FanCtl_rPDpdtDutyPerd12_C "Fan Duty period based on coolant pressure 12 value" VALUE 0x80523B2C RB_Val_Ws16 799.9878 Prc -400.0000 399.9878 FORMAT "%8.4" /end CHARACTERISTIC
/begin CHARACTERISTIC FanCtl_rPDpdtDutyPerd13_C "Fan Duty period based on coolant pressure 13 value" VALUE 0x80523B2E RB_Val_Ws16 799.9878 Prc -400.0000 399.9878 FORMAT "%8.4" /end CHARACTERISTIC
/begin CHARACTERISTIC FanCtl_rPDpdtDutyPerd14_C "Fan Duty period based on coolant pressure 14 value" VALUE 0x80523B30 RB_Val_Ws16 799.9878 Prc -400.0000 399.9878 FORMAT "%8.4" /end CHARACTERISTIC
/begin CHARACTERISTIC FanCtl_rPDpdtDutyPerd15_C "Fan Duty period based on coolant pressure 15 value" VALUE 0x80523B32 RB_Val_Ws16 799.9878 Prc -400.0000 399.9878 FORMAT "%8.4" /end CHARACTERISTIC
/begin CHARACTERISTIC FanCtl_rPDpdtDutyPerd1_C "Fan Duty period based on coolant pressure 1 value" VALUE 0x80523B34 RB_Val_Ws16 799.9878 Prc -400.0000 399.9878 FORMAT "%8.4" /end CHARACTERISTIC
/begin CHARACTERISTIC FanCtl_rPDpdtDutyPerd21_C "Fan Duty period based on coolant pressure 21 value" VALUE 0x80523B36 RB_Val_Ws16 799.9878 Prc -400.0000 399.9878 FORMAT "%8.4" /end CHARACTERISTIC
/begin CHARACTERISTIC FanCtl_rPDpdtDutyPerd22_C "Fan Duty period based on coolant pressure 22 value" VALUE 0x80523B38 RB_Val_Ws16 799.9878 Prc -400.0000 399.9878 FORMAT "%8.4" /end CHARACTERISTIC
/begin CHARACTERISTIC FanCtl_rPDpdtDutyPerd23_C "Fan Duty period based on coolant pressure 23 value" VALUE 0x80523B3A RB_Val_Ws16 799.9878 Prc -400.0000 399.9878 FORMAT "%8.4" /end CHARACTERISTIC
/begin CHARACTERISTIC FanCtl_rPDpdtDutyPerd24_C "Fan Duty period based on coolant pressure 24 value" VALUE 0x80523B3C RB_Val_Ws16 799.9878 Prc -400.0000 399.9878 FORMAT "%8.4" /end CHARACTERISTIC
/begin CHARACTERISTIC FanCtl_rPDpdtDutyPerd25_C "Fan Duty period based on coolant pressure 25 value" VALUE 0x80523B3E RB_Val_Ws16 799.9878 Prc -400.0000 399.9878 FORMAT "%8.4" /end CHARACTERISTIC
/begin CHARACTERISTIC FanCtl_rPDpdtDutyPerd2_C "Fan Duty period based on coolant pressure 2 value" VALUE 0x80523B40 RB_Val_Ws16 799.9878 Prc -400.0000 399.9878 FORMAT "%8.4" /end CHARACTERISTIC
/begin CHARACTERISTIC FanCtl_rPDpdtDutyPerd3_C "Fan Duty period based on coolant pressure 3 value" VALUE 0x80523B42 RB_Val_Ws16 799.9878 Prc -400.0000 399.9878 FORMAT "%8.4" /end CHARACTERISTIC
/begin CHARACTERISTIC FanCtl_rPDpdtDutyPerd4_C "Fan Duty period based on coolant pressure 4 value" VALUE 0x80523B44 RB_Val_Ws16 799.9878 Prc -400.0000 399.9878 FORMAT "%8.4" /end CHARACTERISTIC
/begin CHARACTERISTIC FanCtl_rPDpdtDutyPerd5_C "Fan Duty period based on coolant pressure 5 value" VALUE 0x80523B46 RB_Val_Ws16 799.9878 Prc -400.0000 399.9878 FORMAT "%8.4" /end CHARACTERISTIC
/begin CHARACTERISTIC FanCtl_rRadrFanDutyHi_C "Radiator fan duty period high value" VALUE 0x80523B48 RB_Val_Ws16 799.9878 Prc -400.0000 399.9878 FORMAT "%8.4" /end CHARACTERISTIC
/begin CHARACTERISTIC FanCtl_rTDpdtDutyPerd1_C "Fan Duty period based on coolant temperature 1 value" VALUE 0x80523B4A RB_Val_Ws16 799.9878 Prc -400.0000 399.9878 FORMAT "%8.4" /end CHARACTERISTIC
/begin CHARACTERISTIC FanCtl_rTDpdtDutyPerd2_C "Fan Duty period based on coolant temperature 2 value" VALUE 0x80523B4C RB_Val_Ws16 799.9878 Prc -400.0000 399.9878 FORMAT "%8.4" /end CHARACTERISTIC
/begin CHARACTERISTIC FanCtl_rTDpdtDutyPerd3_C "Fan Duty period based on coolant temperature 3 value" VALUE 0x80523B4E RB_Val_Ws16 799.9878 Prc -400.0000 399.9878 FORMAT "%8.4" /end CHARACTERISTIC
/begin CHARACTERISTIC FanCtl_rTDpdtDutyPerd4_C "Fan Duty period based on coolant temperature 4value" VALUE 0x80523B50 RB_Val_Ws16 799.9878 Prc -400.0000 399.9878 FORMAT "%8.4" /end CHARACTERISTIC
/begin CHARACTERISTIC FanCtl_stACCooltPSnsr_C "AC coolant pressure sensor status" VALUE 0x80523B52 RB_Val_Wu8 1.000 OneToOne 0.00 1.000 FORMAT "%5.3" EXTENDED_LIMITS 0.00 255.0 /end CHARACTERISTIC
/begin CHARACTERISTIC FanCtl_swtPWMFanActv_C "Switch to select for PWM or Two-Stage logic" VALUE 0x80523B53 RB_Val_Wu8 1.00000000000 B_TRUE 0.00 1.00000000000 FORMAT "%13.11" /end CHARACTERISTIC
/begin CHARACTERISTIC FanCtl_swtTW2SnsrAvl_C "Calibration switch when TW2 sensor available" VALUE 0x80523B54 RB_Val_Wu8 1.00000000000 B_TRUE 0.00 1.00000000000 FORMAT "%13.11" /end CHARACTERISTIC
/begin CHARACTERISTIC FanCtl_tCooltTHi_C "Hysteresis threshold Hi for coolant temperature" VALUE 0x80523B56 RB_Val_Ws16 6553.500 Temp_Cels -3549.940 3003.560 FORMAT "%8.3" /end CHARACTERISTIC
/begin CHARACTERISTIC FanCtl_tCooltTLoHi_C "Radiator fan Lo\Hi contol, Lo mode implement water temperature (Hysteresis Hi)" VALUE 0x80523B58 RB_Val_Ws16 6553.500 Temp_Cels -3549.940 3003.560 FORMAT "%8.3" /end CHARACTERISTIC
/begin CHARACTERISTIC FanCtl_tCooltTLoLo_C "Radiator fan Lo\Hi control, Lo mode implement water temperature (Hysteresis Lo)" VALUE 0x80523B5A RB_Val_Ws16 6553.500 Temp_Cels -3549.940 3003.560 FORMAT "%8.3" /end CHARACTERISTIC
/begin CHARACTERISTIC FanCtl_tCooltTLo_C "Hysteresis threshold Lo for coolant temperature" VALUE 0x80523B5C RB_Val_Ws16 6553.500 Temp_Cels -3549.940 3003.560 FORMAT "%8.3" /end CHARACTERISTIC
/begin CHARACTERISTIC FanCtl_tCooltT_C "Threshold of coolant temperature which is used for FanCtl demand of reducing vehicle speed" VALUE 0x80523B5E RB_Val_Ws16 6553.500 Temp_Cels -3549.940 3003.560 FORMAT "%8.3" /end CHARACTERISTIC
/begin CHARACTERISTIC FanCtl_tDutyPerdT1Hi_C "Fan Duty period based on coolant temperature 1 high value" VALUE 0x80523B60 RB_Val_Ws16 6553.500 Temp_Cels -3549.940 3003.560 FORMAT "%8.3" /end CHARACTERISTIC
/begin CHARACTERISTIC FanCtl_tDutyPerdT1Lo_C "Fan Duty period based on coolant temperature 1 low value" VALUE 0x80523B62 RB_Val_Ws16 6553.500 Temp_Cels -3549.940 3003.560 FORMAT "%8.3" /end CHARACTERISTIC
/begin CHARACTERISTIC FanCtl_tDutyPerdT2Hi_C "Fan Duty period based on coolant temperature 2 high value" VALUE 0x80523B64 RB_Val_Ws16 6553.500 Temp_Cels -3549.940 3003.560 FORMAT "%8.3" /end CHARACTERISTIC
/begin CHARACTERISTIC FanCtl_tDutyPerdT2Lo_C "Fan Duty period based on coolant temperature 2 low value" VALUE 0x80523B66 RB_Val_Ws16 6553.500 Temp_Cels -3549.940 3003.560 FORMAT "%8.3" /end CHARACTERISTIC
/begin CHARACTERISTIC FanCtl_tDutyPerdT3Hi_C "Fan Duty period based on coolant temperature 3 high value" VALUE 0x80523B68 RB_Val_Ws16 6553.500 Temp_Cels -3549.940 3003.560 FORMAT "%8.3" /end CHARACTERISTIC
/begin CHARACTERISTIC FanCtl_tDutyPerdT3Lo_C "Fan Duty period based on coolant temperature 3 low value" VALUE 0x80523B6A RB_Val_Ws16 6553.500 Temp_Cels -3549.940 3003.560 FORMAT "%8.3" /end CHARACTERISTIC
/begin CHARACTERISTIC FanCtl_tiACGFixdMod_C "Delay Time for ACG fixed mode" VALUE 0x80523B6C RB_Val_Ws16 327.6700 Time_s 0.00 327.6700 FORMAT "%8.4" EXTENDED_LIMITS -327.6800 327.6700 /end CHARACTERISTIC
/begin CHARACTERISTIC FanCtl_tiAftRun_C "fan afterrun time" VALUE 0x80523B6E RB_Val_Ws16 65535.00 TimeEngOn -32768.00 32767.00 FORMAT "%8.2" /end CHARACTERISTIC
/begin CHARACTERISTIC FanCtl_tiAftRun_CUR "fan afterrun time" CURVE 0x80523B70 RB_Curve_S16_S16 65535.00 TimeEngOn -32768.00 32767.00 FORMAT "%8.2"
 /begin AXIS_DESCR STD_AXIS FanCtl_tCooltT Temp_Cels 4 -3549.940 3003.560 FORMAT "%8.3" DEPOSIT ABSOLUTE /end AXIS_DESCR
/end CHARACTERISTIC
/begin CHARACTERISTIC FanCtl_tiAntiFlickLim_C "Delay Time for limit anti headlight flicker" VALUE 0x80523B82 RB_Val_Ws16 327.6700 Time_s 0.00 327.6700 FORMAT "%8.4" EXTENDED_LIMITS -327.6800 327.6700 READ_ONLY /end CHARACTERISTIC
/begin CHARACTERISTIC FanCtl_tiImdtHiStgOnDly_C "Time delay for Immediate High stage ON" VALUE 0x80523B84 RB_Val_Wu16 655.3500 Time_s 0.00 655.3500 FORMAT "%8.4" /end CHARACTERISTIC
/begin CHARACTERISTIC FanCtl_tiRlyCtrlDly_C "Time for fan relay control delay" VALUE 0x80523B86 RB_Val_Ws16 655350.0 Time_ms -327680.0 327670.0 FORMAT "%8.1" /end CHARACTERISTIC
/begin CHARACTERISTIC FanCtl_tiSpdOffDly_C "TrnOffDly threshold for FanCtl demand of vehicle speed" VALUE 0x80523B88 RB_Val_Ws16 327.6700 Time_s 0.00 327.6700 FORMAT "%8.4" EXTENDED_LIMITS -327.6800 327.6700 /end CHARACTERISTIC
/begin CHARACTERISTIC FanCtl_tiSpdOnDly_C "TrnOnDly threshold for FanCtl demand of vehicle speed" VALUE 0x80523B8A RB_Val_Ws16 327.6700 Time_s 0.00 327.6700 FORMAT "%8.4" EXTENDED_LIMITS -327.6800 327.6700 /end CHARACTERISTIC
/begin CHARACTERISTIC FanCtl_tiTrqResvFan1_C "Delay Time for reserve torque for Fan 1" VALUE 0x80523B8C RB_Val_Ws16 327.6700 Time_s 0.00 327.6700 FORMAT "%8.4" EXTENDED_LIMITS -327.6800 327.6700 /end CHARACTERISTIC
/begin CHARACTERISTIC FanCtl_tiTrqResvFan2_C "Delay Time for reserve torque for Fan 2" VALUE 0x80523B8E RB_Val_Ws16 327.6700 Time_s 0.00 327.6700 FORMAT "%8.4" EXTENDED_LIMITS -327.6800 327.6700 /end CHARACTERISTIC
/begin CHARACTERISTIC FanCtl_tqThrIdleTqValHi_C "Throttle idle torque for fan control high" VALUE 0x80523B90 RB_Val_Ws32 429496729.500 TrqPrpHigh -214748364.800 214748364.700 FORMAT "%13.3" /end CHARACTERISTIC
/begin CHARACTERISTIC FanCtl_tqThrIdleTqValLo_C "Throttle idle torque for fan control low" VALUE 0x80523B94 RB_Val_Ws32 429496729.500 TrqPrpHigh -214748364.800 214748364.700 FORMAT "%13.3" /end CHARACTERISTIC
/begin CHARACTERISTIC FanCtl_uAntiFlickThd_C "Under transition voltage threshold for anti headlight flicker" VALUE 0x80523B98 RB_Val_Ws16 1310700. Volt_Batt -655360.0 655340.0 FORMAT "%8.1" READ_ONLY /end CHARACTERISTIC
/begin CHARACTERISTIC FanCtl_uDutyPerdUHi_C "Blower fan high voltage for fan duty period" VALUE 0x80523B9A RB_Val_Ws16 1638.350 RBPtCel_u_0p05_1 0.00 1638.350 FORMAT "%8.3" EXTENDED_LIMITS -1638.400 1638.350 /end CHARACTERISTIC
/begin CHARACTERISTIC FanCtl_uDutyPerdULo_C "Blower fan low voltage for fan duty period" VALUE 0x80523B9C RB_Val_Ws16 1638.350 RBPtCel_u_0p05_1 0.00 1638.350 FORMAT "%8.3" EXTENDED_LIMITS -1638.400 1638.350 /end CHARACTERISTIC
/begin CHARACTERISTIC FanCtl_uFailSafeBlowrU_C "Fail safe blower fan voltage" VALUE 0x80523B9E RB_Val_Ws16 1638.350 RBPtCel_u_0p05_1 0.00 1638.350 FORMAT "%8.3" EXTENDED_LIMITS -1638.400 1638.350 /end CHARACTERISTIC
/begin CHARACTERISTIC FanCtl_vLoVehSpdHi_C "Hysteresis threshold Hi of vehicle speed for FanCtl demand of AC" VALUE 0x80523BA0 RB_Val_Ws16 655.3500 Vel -327.6800 327.6700 FORMAT "%8.4" /end CHARACTERISTIC
/begin CHARACTERISTIC FanCtl_vModSelnSpdHiHi_C "Mode selection velocity for high high" VALUE 0x80523BA2 RB_Val_Ws16 655.3500 Vel -327.6800 327.6700 FORMAT "%8.4" /end CHARACTERISTIC
/begin CHARACTERISTIC FanCtl_vModSelnSpdHiLo_C "Mode selection velocity for high low" VALUE 0x80523BA4 RB_Val_Ws16 655.3500 Vel -327.6800 327.6700 FORMAT "%8.4" /end CHARACTERISTIC
/begin CHARACTERISTIC FanCtl_vModSelnSpdLoHi_C "Mode selection velocity for low high" VALUE 0x80523BA6 RB_Val_Ws16 655.3500 Vel -327.6800 327.6700 FORMAT "%8.4" /end CHARACTERISTIC
/begin CHARACTERISTIC FanCtl_vModSelnSpdLoLo_C "Mode selection velocity for low low" VALUE 0x80523BA8 RB_Val_Ws16 655.3500 Vel -327.6800 327.6700 FORMAT "%8.4" /end CHARACTERISTIC
/begin CHARACTERISTIC FanCtl_vSpdHiHi_C "Hysteresis threshold Hi of Hi vehicle speed for FanCtl demand of AC" VALUE 0x80523BAA RB_Val_Ws16 655.3500 Vel -327.6800 327.6700 FORMAT "%8.4" /end CHARACTERISTIC
/begin CHARACTERISTIC FanCtl_vSpdHiLo_C "Hysteresis threshold Lo of Hi vehicle speed for FanCtl demand of AC" VALUE 0x80523BAC RB_Val_Ws16 655.3500 Vel -327.6800 327.6700 FORMAT "%8.4" /end CHARACTERISTIC
/begin CHARACTERISTIC FanCtl_vSpdLoHi_C "Hysteresis threshold Hi of Lo vehicle speed for FanCtl demand of AC" VALUE 0x80523BAE RB_Val_Ws16 655.3500 Vel -327.6800 327.6700 FORMAT "%8.4" /end CHARACTERISTIC
/begin CHARACTERISTIC FanCtl_vSpdLoLo_C "Hysteresis threshold Lo of Lo vehicle speed for FanCtl demand of AC" VALUE 0x80523BB0 RB_Val_Ws16 655.3500 Vel -327.6800 327.6700 FORMAT "%8.4" /end CHARACTERISTIC
/begin CHARACTERISTIC Fans_tiTrqConsFltFan1_C "Time Delay for Filtering of static Torque Consumed of Fan 1" VALUE 0x80523BB4 RB_Val_Ws32 4294.9672940000000 TimeDelay_s 0.0000020000000 4294.9672959999998 FORMAT "%19.14" EXTENDED_LIMITS 0.000002000000001 4294.9672959999998 /end CHARACTERISTIC
/begin CHARACTERISTIC Fans_tiTrqConsFltFan2_C "Time Delay for Filtering of static Torque Consumed of Fan 2" VALUE 0x80523BB8 RB_Val_Ws32 4294.9672940000000 TimeDelay_s 0.0000020000000 4294.9672959999998 FORMAT "%19.14" EXTENDED_LIMITS 0.000002000000001 4294.9672959999998 /end CHARACTERISTIC
/begin CHARACTERISTIC Fans_tiTrqResvFan1_C "Time Delay Off of static Torque Reserve for Fan 1 running" VALUE 0x80523BBC RB_Val_Ws32 21474836.4700 Time_s 0.00 21474836.4700 FORMAT "%13.4" EXTENDED_LIMITS -21474836.4800 21474836.4700 /end CHARACTERISTIC
/begin CHARACTERISTIC Fans_tiTrqResvFan2_C "Time Delay Off of static Torque Reserve for Fan 2 running" VALUE 0x80523BC0 RB_Val_Ws32 21474836.4700 Time_s 0.00 21474836.4700 FORMAT "%13.4" EXTENDED_LIMITS -21474836.4800 21474836.4700 /end CHARACTERISTIC
/begin CHARACTERISTIC Fans_tiTrqResvFltFan1_C "Time Delay for Filtering of static Torque Reserve of Fan 1" VALUE 0x80523BC4 RB_Val_Ws32 4294.9672940000000 TimeDelay_s 0.0000020000000 4294.9672959999998 FORMAT "%19.14" EXTENDED_LIMITS 0.000002000000001 4294.9672959999998 /end CHARACTERISTIC
/begin CHARACTERISTIC Fans_tiTrqResvFltFan2_C "Time Delay for Filtering of static Torque Reserve of Fan 2" VALUE 0x80523BC8 RB_Val_Ws32 4294.9672940000000 TimeDelay_s 0.0000020000000 4294.9672959999998 FORMAT "%19.14" EXTENDED_LIMITS 0.000002000000001 4294.9672959999998 /end CHARACTERISTIC
/begin CHARACTERISTIC Fans_trqConsFan1_CUR "Mapping between PWM signal of Fan_r and the resulting static torque consumed for Fan 1" CURVE 0x80523BCC RB_Curve_S16_S16 6553.500 Trq -3276.800 3276.700 FORMAT "%8.3"
 /begin AXIS_DESCR STD_AXIS Fan_r Prc 2 -400.0000 399.9878 FORMAT "%8.4" DEPOSIT ABSOLUTE /end AXIS_DESCR
/end CHARACTERISTIC
/begin CHARACTERISTIC Fans_trqConsFan2_CUR "Mapping between PWM signal of Fan_r and the resulting static torque consumed for Fan 2" CURVE 0x80523BD6 RB_Curve_S16_S16 6553.500 Trq -3276.800 3276.700 FORMAT "%8.3"
 /begin AXIS_DESCR STD_AXIS Fan_r2 Prc 2 -400.0000 399.9878 FORMAT "%8.4" DEPOSIT ABSOLUTE /end AXIS_DESCR
/end CHARACTERISTIC
/begin CHARACTERISTIC Fans_trqResvFan1_C "Reserve Torque Consumed for Fan 1" VALUE 0x80523BE0 RB_Val_Ws16 6553.500 Trq -3276.800 3276.700 FORMAT "%8.3" /end CHARACTERISTIC
/begin CHARACTERISTIC Fans_trqResvFan1_CUR "Curve to determine the equivalent torque as per the request for Fan 1" CURVE 0x80523BE2 RB_Curve_S16_S16 6553.500 Trq -3276.800 3276.700 FORMAT "%8.3"
 /begin AXIS_DESCR STD_AXIS Epm_nEng EngN 4 -16384.00 16383.50 FORMAT "%8.2" DEPOSIT ABSOLUTE /end AXIS_DESCR
/end CHARACTERISTIC
/begin CHARACTERISTIC Fans_trqResvFan2_C "Reserve Torque Consumed for Fan 2" VALUE 0x80523BF4 RB_Val_Ws16 6553.500 Trq -3276.800 3276.700 FORMAT "%8.3" /end CHARACTERISTIC
/begin CHARACTERISTIC Fans_trqResvFan2_CUR "Curve to determine the equivalent torque as per the request for fan 2" CURVE 0x80523BF6 RB_Curve_S16_S16 6553.500 Trq -3276.800 3276.700 FORMAT "%8.3"
 /begin AXIS_DESCR STD_AXIS Epm_nEng EngN 4 -16384.00 16383.50 FORMAT "%8.2" DEPOSIT ABSOLUTE /end AXIS_DESCR
/end CHARACTERISTIC
/begin CHARACTERISTIC O2St_dmMaxThdMeasCat1_C "Maximum mass flow for OSC measurement catalyst 1" VALUE 0x80521D4A RB_Val_Wu16 6553.500 m_uw_b6553p5 0.00 6553.500 FORMAT "%8.3" /end CHARACTERISTIC
/begin CHARACTERISTIC O2St_dmMinThdMeasCat1_C "Minimum mass flow for OSC measurement catalyst 1" VALUE 0x80521D4C RB_Val_Wu16 6553.500 m_uw_b6553p5 0.00 6553.500 FORMAT "%8.3" /end CHARACTERISTIC
/begin CHARACTERISTIC O2St_facAgiAgedCat_C "Ageing factor catalyst" VALUE 0x80521D4E RB_Val_Wu8 1.000000 fak_ub_b2 0.00 1.000000 FORMAT "%8.6" EXTENDED_LIMITS 0.00 1.992188 /end CHARACTERISTIC
/begin CHARACTERISTIC O2St_facCorrnDlyLeanRichDsCat1_T "Table delay correction time for measurement of storage capability cat for sensor downstream catalyst 1 (transition lean-rich)" CURVE 0x80521D50 RB_Curve_U16_U16 655.3500 t_q0p01 0.00 655.3500 FORMAT "%8.4"
 /begin AXIS_DESCR STD_AXIS NO_INPUT_QUANTITY t_q0p01 4 0.00 655.3500 FORMAT "%8.4" DEPOSIT ABSOLUTE /end AXIS_DESCR
/end CHARACTERISTIC
/begin CHARACTERISTIC O2St_facCorrnDlyRichLeanDsCat1_T "Table delay correction time for measurement of storage capability cat for sensor downstream catalyst 1 (transition rich-lean)" CURVE 0x80521D62 RB_Curve_U16_U16 655.3500 t_q0p01 0.00 655.3500 FORMAT "%8.4"
 /begin AXIS_DESCR STD_AXIS NO_INPUT_QUANTITY t_q0p01 4 0.00 655.3500 FORMAT "%8.4" DEPOSIT ABSOLUTE /end AXIS_DESCR
/end CHARACTERISTIC
/begin CHARACTERISTIC O2St_facCorrnMfLamCat1B1_M "Correction map for lambda and massflow dependence of OSC catalyst 1 bank 1" MAP 0x80521D74 RB_Map_U16U16_U16 3.999939 fak_q6p1035Em5 0.00 3.999939 FORMAT "%8.6"
 /begin AXIS_DESCR STD_AXIS O2St_ratLamAvrgCat1B1 fak_q0p000244 8 0.00 15.99976 FORMAT "%8.5" DEPOSIT ABSOLUTE /end AXIS_DESCR
 /begin AXIS_DESCR STD_AXIS O2St_dmAvrgCurrMeasCat1B1 m_uw_b6553p5 8 0.00 6553.500 FORMAT "%8.3" DEPOSIT ABSOLUTE /end AXIS_DESCR
/end CHARACTERISTIC
/begin CHARACTERISTIC O2St_facCorrnMissSensDsCat2_T "OSC corection factor, in case of missing sensor downstream catalyst 2" CURVE 0x80521E18 RB_Curve_U8_U8 1.992188 fak_ub_b2 0.00 1.992188 FORMAT "%8.6"
 /begin AXIS_DESCR STD_AXIS NO_INPUT_QUANTITY fak_ub_b2 5 0.00 1.992188 FORMAT "%8.6" DEPOSIT ABSOLUTE /end AXIS_DESCR
/end CHARACTERISTIC
/begin CHARACTERISTIC O2St_facCorrnTranLeanRichDsCat1_T "Table correction time for measurement of storage capability cat for sensor downstream catalyst 1 (transition lean-rich)" CURVE 0x80521E24 RB_Curve_U16_U16 655.3500 t_q0p01 0.00 655.3500 FORMAT "%8.4"
 /begin AXIS_DESCR STD_AXIS NO_INPUT_QUANTITY t_q0p01 4 0.00 655.3500 FORMAT "%8.4" DEPOSIT ABSOLUTE /end AXIS_DESCR
/end CHARACTERISTIC
/begin CHARACTERISTIC O2St_facCorrnTranRichLeanDsCat1_T "Table correction time for measurement of storage capability cat for sensor downstream catalyst 1 (transition rich-lean)" CURVE 0x80521E36 RB_Curve_U16_U16 655.3500 t_q0p01 0.00 655.3500 FORMAT "%8.4"
 /begin AXIS_DESCR STD_AXIS NO_INPUT_QUANTITY t_q0p01 4 0.00 655.3500 FORMAT "%8.4" DEPOSIT ABSOLUTE /end AXIS_DESCR
/end CHARACTERISTIC
/begin CHARACTERISTIC O2St_facCorrO2StorgUCat1_T "OSC correction according to the sensor voltage downstream catalyst 1" CURVE 0x80521E48 RB_Curve_U16_U16 1.999969 fak_uw_b2 0.00 1.999969 FORMAT "%8.6"
 /begin AXIS_DESCR STD_AXIS NO_INPUT_QUANTITY spg_uw_q0p00488 8 0.00 319.9951 FORMAT "%8.4" DEPOSIT ABSOLUTE /end AXIS_DESCR
/end CHARACTERISTIC
/begin CHARACTERISTIC O2St_facIninOscCorrnCat1_C "Initial value of OSC correction factor of catalyst 1" VALUE 0x80521E6A RB_Val_Wu8 1.992188 fak_ub_b2 0.00 1.992188 FORMAT "%8.6" /end CHARACTERISTIC
/begin CHARACTERISTIC O2St_facIninOscCorrnCat2_C "Initial value of OSC correction factor of catalyst 2" VALUE 0x80521E6B RB_Val_Wu8 1.992188 fak_ub_b2 0.00 1.992188 FORMAT "%8.6" /end CHARACTERISTIC
/begin CHARACTERISTIC O2St_facMaxThdLamCtrl_C "upper threshold of lambda controller output for valid OSC calculation" VALUE 0x80521E6C RB_Val_Wu16 1.999969 fak_q3p0518Em5 0.00 1.999969 FORMAT "%8.6" /end CHARACTERISTIC
/begin CHARACTERISTIC O2St_facMinThdLamCtrl_C "lower threshold of lambda controller output for valid OSC calculation" VALUE 0x80521E6E RB_Val_Wu16 1.999969 fak_q3p0518Em5 0.00 1.999969 FORMAT "%8.6" /end CHARACTERISTIC
/begin CHARACTERISTIC O2St_facOscFilDiag_C "event filter constant for OSC correction factor during diagnosis of catalyst" VALUE 0x80521E70 RB_Val_Wu8 0.9961 fak_ub_b1 0.00 0.9961 /end CHARACTERISTIC
/begin CHARACTERISTIC O2St_facOscFilMax_C "maximum event filter constant for OSC correction factor" VALUE 0x80521E71 RB_Val_Wu8 0.9961 fak_ub_b1 0.00 0.9961 /end CHARACTERISTIC
/begin CHARACTERISTIC O2St_facOscFilMin_C "event filter constant for OSC correction factor" VALUE 0x80521E72 RB_Val_Wu8 0.9961 fak_ub_b1 0.00 0.9961 /end CHARACTERISTIC
/begin CHARACTERISTIC O2St_facRoscOscCat1_T "Table conversion ROSC to OSC catalyst 1" CURVE 0x80521E74 RB_Curve_R32_U16_Static 31.99951 fak_q4p883Em4 0.00 31.99951 FORMAT "%8.5"
 /begin AXIS_DESCR STD_AXIS NO_INPUT_QUANTITY RBPtCel_m_1p0_5 10 -1.00000000E+037 1.00000000E+037 FORMAT "%13.3" EXTENDED_LIMITS -3.40282347E+038 3.40282347E+038 DEPOSIT ABSOLUTE /end AXIS_DESCR
/end CHARACTERISTIC
/begin CHARACTERISTIC O2St_facTiCorrnSnsrAftCat_C "factor time threshold sensor dynamic correction for measurement of storage capability of catalyst plausible, sensor downstream catalyst" VALUE 0x80521EB4 RB_Val_Wu8 0.9961 fak_ub_b1 0.00 0.9961 /end CHARACTERISTIC
/begin CHARACTERISTIC O2St_facTiCorrnSnsrBefCat_C "factor time threshold sensor dynamic correction for measurement of storage capability of catalyst plausible, sensor upstream catalyst" VALUE 0x80521EB5 RB_Val_Wu8 0.9961 fak_ub_b1 0.00 0.9961 /end CHARACTERISTIC
/begin CHARACTERISTIC O2St_mfO2ThdStoi_C "Threashold oxygen mass flow richlean" VALUE 0x80521D3C RB_Val_Wr32 2.00000000E+037 mgrad_q1_mgdivs -1.00000000E+037 1.00000000E+037 FORMAT "%14.8" EXTENDED_LIMITS -3.40282347E+038 3.40282347E+038 /end CHARACTERISTIC
/begin CHARACTERISTIC O2St_mMaxThdMeasCat1_C "Maximum air mass threshold for favourable OSC measurement catalyst 1" VALUE 0x80521EB6 RB_Val_Wu16 1820.417 m_q0p0277_g 0.00 1820.417 FORMAT "%8.3" /end CHARACTERISTIC
/begin CHARACTERISTIC O2St_mOscAgedCat1B1_M "Table oxygen storage capability of a aged catalyst 1 bank 1" MAP 0x80521EB8 RB_Map_U16U16_R32 131072.000 RBPtCel_m_1p0_5 0.00 131072.000 FORMAT "%10.3" EXTENDED_LIMITS -3.40282347E+038 3.40282347E+038
 /begin AXIS_DESCR STD_AXIS NO_INPUT_QUANTITY temp_q0p0234_o273 8 -273.150 1262.827 FORMAT "%8.3" DEPOSIT ABSOLUTE /end AXIS_DESCR
 /begin AXIS_DESCR STD_AXIS NO_INPUT_QUANTITY m_q0p1 8 0.00 6553.500 FORMAT "%8.3" DEPOSIT ABSOLUTE /end AXIS_DESCR
/end CHARACTERISTIC
/begin CHARACTERISTIC O2St_mOscAgedCat2B1_M "Table oxygen storage capability of a aged catalyst 2 bank 1" MAP 0x80521FDC RB_Map_U16U16_R32 131072.000 RBPtCel_m_1p0_5 0.00 131072.000 FORMAT "%10.3" EXTENDED_LIMITS -3.40282347E+038 3.40282347E+038
 /begin AXIS_DESCR STD_AXIS NO_INPUT_QUANTITY temp_q0p0234_o273 8 -273.150 1262.827 FORMAT "%8.3" DEPOSIT ABSOLUTE /end AXIS_DESCR
 /begin AXIS_DESCR STD_AXIS NO_INPUT_QUANTITY m_uw_b6553p5 8 0.00 6553.500 FORMAT "%8.3" DEPOSIT ABSOLUTE /end AXIS_DESCR
/end CHARACTERISTIC
/begin CHARACTERISTIC O2St_mOscNewCat1B1_M "Table oxygen storage capability of a new catalyst 1 bank 1" MAP 0x80522100 RB_Map_U16U16_R32 131072.000 RBPtCel_m_1p0_5 0.00 131072.000 FORMAT "%10.3" EXTENDED_LIMITS -3.40282347E+038 3.40282347E+038
 /begin AXIS_DESCR STD_AXIS NO_INPUT_QUANTITY temp_q0p0234_o273 8 -273.150 1262.827 FORMAT "%8.3" DEPOSIT ABSOLUTE /end AXIS_DESCR
 /begin AXIS_DESCR STD_AXIS NO_INPUT_QUANTITY m_uw_b6553p5 8 0.00 6553.500 FORMAT "%8.3" DEPOSIT ABSOLUTE /end AXIS_DESCR
/end CHARACTERISTIC
/begin CHARACTERISTIC O2St_mOscNewCat2B1_M "Table oxygen storage capability of a new catalyst 2 bank 1" MAP 0x80522224 RB_Map_U16U16_R32 131072.000 RBPtCel_m_1p0_5 0.00 131072.000 FORMAT "%10.3" EXTENDED_LIMITS -3.40282347E+038 3.40282347E+038
 /begin AXIS_DESCR STD_AXIS NO_INPUT_QUANTITY temp_q0p0234_o273 8 -273.150 1262.827 FORMAT "%8.3" DEPOSIT ABSOLUTE /end AXIS_DESCR
 /begin AXIS_DESCR STD_AXIS NO_INPUT_QUANTITY m_uw_b6553p5 8 0.00 6553.500 FORMAT "%8.3" DEPOSIT ABSOLUTE /end AXIS_DESCR
/end CHARACTERISTIC
/begin CHARACTERISTIC O2St_SpareRatO2StrCat1_C "spare value for OSC correction factor catalyst 1" VALUE 0x80522348 RB_Val_Wu8 1.992188 fak_ub_b2 0.00 1.992188 FORMAT "%8.6" /end CHARACTERISTIC
/begin CHARACTERISTIC O2St_stApplMod_C "code word application mode for reset of ageing factor" VALUE 0x80522349 RB_Val_Wu8 255.0 dez 0.00 255.0 FORMAT "%5.1" /end CHARACTERISTIC
/begin CHARACTERISTIC O2St_stOscCatDiag_C "Code word modelling of oxygen storage capacity dependency on catalyst diagnosis" VALUE 0x8052234A RB_Val_Wu8 255.0 dez 0.00 255.0 FORMAT "%5.1" /end CHARACTERISTIC
/begin CHARACTERISTIC O2St_stOscMeas_C "code word for options of OSC measurement in FC ExhMod_LamMdl" VALUE 0x8052234B RB_Val_Wu8 255.0 dez 0.00 255.0 FORMAT "%5.1" /end CHARACTERISTIC
/begin CHARACTERISTIC O2St_stOscRosc_C "code word calculation OSC-ROSC" VALUE 0x8052234C RB_Val_Wu8 255.0 dez 0.00 255.0 FORMAT "%5.1" /end CHARACTERISTIC
/begin CHARACTERISTIC O2St_tDeltaMaxMeasCat1_C "Maximum temperature difference between start and end of the measurement of OSC catalyst 1" VALUE 0x8052234E RB_Val_Wu16 1535.977 temp_q0p0234 0.00 1535.977 FORMAT "%8.3" /end CHARACTERISTIC
/begin CHARACTERISTIC O2St_tiConMFlowEna_C "time constant for mass flow for enable condition" VALUE 0x80521D46 RB_Val_Wu16 1310.680 t_q0p02 0.020 1310.700 FORMAT "%8.3" EXTENDED_LIMITS 0.00 1310.700 /end CHARACTERISTIC
/begin CHARACTERISTIC O2St_tiDlyEnagOscCat1_C "time delay enabling OSC measurement after temperature condition catalyst 1" VALUE 0x80522350 RB_Val_Wu16 1310.700 t_q0p02 0.00 1310.700 FORMAT "%8.3" /end CHARACTERISTIC
/begin CHARACTERISTIC O2St_tiDlyMaxS1_C "maximal deadtime senor 1 for OSC calculation" VALUE 0x80522352 RB_Val_Wu16 655.3500 t_q0p01 0.00 655.3500 FORMAT "%8.4" /end CHARACTERISTIC
/begin CHARACTERISTIC O2St_tiMaxMeasOscCat1_C "Maximum measurement time for OSC catalyst 1" VALUE 0x80522354 RB_Val_Wu16 1310.700 t_q0p02 0.00 1310.700 FORMAT "%8.3" /end CHARACTERISTIC
/begin CHARACTERISTIC O2St_tiThdStrtMeas_C "Time threshold after start-end, after that a OSC-ROSC measurement is possible" VALUE 0x80522356 RB_Val_Wu16 6553.500 t100msxs_uw_b6553p5 0.00 6553.500 FORMAT "%8.3" /end CHARACTERISTIC
/begin CHARACTERISTIC O2St_tiTranDecelCat1_C "Delay time rich-lean or lean-rich transition of catalyst 1" VALUE 0x80522358 RB_Val_Wu16 1310.680 t_q0p02 0.020 1310.700 FORMAT "%8.3" EXTENDED_LIMITS 0.00 1310.700 /end CHARACTERISTIC
/begin CHARACTERISTIC O2St_tiTranDecelMeas_C "Deceleration time for allowed lambda=1 transition during measurement" VALUE 0x8052235A RB_Val_Wu16 1310.700 t_q0p02 0.00 1310.700 FORMAT "%8.3" /end CHARACTERISTIC
/begin CHARACTERISTIC O2St_tiTranMaxS1_C "maximal time constant sensor 1 for OSC calculation" VALUE 0x8052235C RB_Val_Wu16 655.3500 t_q0p01 0.00 655.3500 FORMAT "%8.4" /end CHARACTERISTIC
/begin CHARACTERISTIC O2St_tMaxThdMeasCat1_C "Maximum catalyst temperature for OSC measurement catalyst 1" VALUE 0x8052235E RB_Val_Wu16 1535.977 temp_q0p0234_o273 -273.150 1262.827 FORMAT "%8.3" /end CHARACTERISTIC
/begin CHARACTERISTIC O2St_tMaxThdMeasHysCat1_C "Maximum threshold of switch-on hysteresis of OSC measurement catalyst 1" VALUE 0x80522360 RB_Val_Wu16 1535.977 temp_q0p0234_o273 -273.150 1262.827 FORMAT "%8.3" /end CHARACTERISTIC
/begin CHARACTERISTIC O2St_tMinThdMeasCat1_C "Minimum catalyst temperature for OSC measurement catalyst 1" VALUE 0x80522362 RB_Val_Wu16 1535.977 temp_q0p0234_o273 -273.150 1262.827 FORMAT "%8.3" /end CHARACTERISTIC
/begin CHARACTERISTIC O2St_tMinThdMeasHysCat1_C "Minimum threshold of switch-on hysteresis of OSC measurement catalyst 1" VALUE 0x80522364 RB_Val_Wu16 1535.977 temp_q0p0234_o273 -273.150 1262.827 FORMAT "%8.3" /end CHARACTERISTIC
/begin CHARACTERISTIC O2St_uDeltaDecMaxSensHi_C "Threshold maximal decrease of post-cat voltage for detection of empty catalyst" VALUE 0x80521D40 RB_Val_Ws16 319.9951 spg_q0p00488 -160.0000 159.9951 FORMAT "%8.4" /end CHARACTERISTIC
/begin CHARACTERISTIC O2St_uDeltaDecMax_C "Threshold maximal decrease of post-cat voltage for detection of empty catalyst" VALUE 0x80521D42 RB_Val_Ws16 319.9951 spg_q0p00488 -160.0000 159.9951 FORMAT "%8.4" /end CHARACTERISTIC
/begin CHARACTERISTIC O2St_uDeltaIncMin_C "Increase of post-cat voltage required for the detection of an empty catalyst" VALUE 0x80521D44 RB_Val_Ws16 319.9951 spg_q0p00488 -160.0000 159.9951 FORMAT "%8.4" /end CHARACTERISTIC
/begin CHARACTERISTIC O2St_uThdCat1DsO2EmptyB1_C "Voltage threshold exhaust rich downstream catalyst 1 bank 1" VALUE 0x80522366 RB_Val_Wu16 319.9951 spg_uw_q0p00488 0.00 319.9951 FORMAT "%8.4" /end CHARACTERISTIC
/begin CHARACTERISTIC O2St_uThdCat1DsO2FullB1_C "Voltage threshold exhaust lean downstream catalyst 1 bank 1" VALUE 0x80522368 RB_Val_Wu16 319.9951 spg_uw_q0p00488 0.00 319.9951 FORMAT "%8.4" /end CHARACTERISTIC
/begin MEASUREMENT cntrSumB1 "counter for sum efficency depending on ignition angle bank 1" UBYTE dez 1 100 0.00 255.0 FORMAT "%5.1" ECU_ADDRESS 0x6000648F /end MEASUREMENT
/begin MEASUREMENT effIgnAgSumB1 "sum efficency depending on ignition angle bank 1" UWORD rel_q0p5 1 100 0.00 32767.50 FORMAT "%8.2" ECU_ADDRESS 0x6000D9B8 /end MEASUREMENT
/begin MEASUREMENT ExhMod_bStrtEndOffActiveLst "local Bit: start-end off-time in hold mode (bit start end active)" UBYTE B_TRUE 1 100 0.00 1.00000000000 BIT_MASK 0x1 FORMAT "%13.11" ECU_ADDRESS 0x6000648E /end MEASUREMENT
/begin MEASUREMENT ExhMod_cntrMplBricksB1 "Counter over all multi bricks bank 1" UBYTE dez 1 100 0.00 255.0 FORMAT "%5.1" ECU_ADDRESS 0x6000648B /end MEASUREMENT
/begin MEASUREMENT ExhMod_cntrStrtEndOffRstLst "local reset-counter of engine of engine off time based on start-end" UBYTE OneToOne 1 100 0.00 255.0 FORMAT "%5.1" ECU_ADDRESS 0x6003476C /end MEASUREMENT
/begin MEASUREMENT ExhMod_coeffPDiffCatTB1Ary "Output array haracteristic map temperature-dep. factor in pressure gradient catalysts" UWORD fak_uw_b64 1 100 0.00 63.99902 FORMAT "%8.5" ARRAY_SIZE 2 ECU_ADDRESS 0x6000386A /end MEASUREMENT
/begin MEASUREMENT ExhMod_dmAirB1 "air mass flow" SWORD m_q0p1 1 100 -3276.800 3276.700 FORMAT "%8.3" ECU_ADDRESS 0x6000E210 /end MEASUREMENT
/begin MEASUREMENT ExhMod_dmExhAryB1 "mass flow array exhaust gas" SWORD m_q0p1 1 100 -3276.800 3276.700 FORMAT "%8.3" ARRAY_SIZE 13 ECU_ADDRESS 0x50005A60 /end MEASUREMENT
/begin MEASUREMENT ExhMod_dmExhCat1B1 "mass flow exhaust gas catalyst 1" SWORD m_q0p1 1 100 -3276.800 3276.700 FORMAT "%8.3" ECU_ADDRESS 0x60005096 /end MEASUREMENT
/begin MEASUREMENT ExhMod_dmExhCat2B1 "mass flow exhaust gas catalyst 2" SWORD m_q0p1 1 100 -3276.800 3276.700 FORMAT "%8.3" ECU_ADDRESS 0x6000E212 /end MEASUREMENT
/begin MEASUREMENT ExhMod_dmExhMnfB1 "mass flow exhaust gas, manifold" SWORD m_q0p1 1 100 -3276.800 3276.700 FORMAT "%8.3" ECU_ADDRESS 0x6000E214 /end MEASUREMENT
/begin MEASUREMENT ExhMod_dmExhS1B1 "mass flow exhaust gas sensor 1" SWORD m_q0p1 1 100 -3276.800 3276.700 FORMAT "%8.3" ECU_ADDRESS 0x60005094 /end MEASUREMENT
/begin MEASUREMENT ExhMod_dmExhS2B1 "mass flow exhaust gas sensor 2" SWORD m_q0p1 1 100 -3276.800 3276.700 FORMAT "%8.3" ECU_ADDRESS 0x6000E216 /end MEASUREMENT
/begin MEASUREMENT ExhMod_dmExhVlvB1 "exhaust gas mass flow at outlet valves" SWORD m_q0p1 1 100 -3276.800 3276.700 FORMAT "%8.3" ECU_ADDRESS 0x6000E218 /end MEASUREMENT
/begin MEASUREMENT ExhMod_dmExhWoFuUsCat1B1 "Mass flow exhaust gas minus fuel part upstream of catalyst 1" SWORD m_q0p1 1 100 -3276.800 3276.700 FORMAT "%8.3" ECU_ADDRESS 0x60005092 /end MEASUREMENT
/begin MEASUREMENT ExhMod_dmExhWoFuUsCat2B1 "Mass flow exhaust gas minus fuel part upstream of catalyst 2" SWORD m_q0p1 1 100 -3276.800 3276.700 FORMAT "%8.3" ECU_ADDRESS 0x60005090 /end MEASUREMENT
/begin MEASUREMENT ExhMod_dmFuB1 "fuel mass flow" SWORD m_q0p1 1 100 -3276.800 3276.700 FORMAT "%8.3" ECU_ADDRESS 0x6000E21A /end MEASUREMENT
/begin MEASUREMENT ExhMod_effIgnAgAvrgB1 "average efficency depending on ignition angle bank 1" UBYTE rel_ub_b127p5 1 100 0.00 127.5 FORMAT "%5.1" ECU_ADDRESS 0x6000A056 /end MEASUREMENT
/begin MEASUREMENT ExhMod_egyExoCatB1 "Heat energy in catalyst due to exhothermic reactions bank 1" FLOAT32_IEEE HtFlw_Fl 1 100 -5000000.000 5000000.000 FORMAT "%11.3" ARRAY_SIZE 6 ECU_ADDRESS 0x50001554 /end MEASUREMENT
/begin MEASUREMENT ExhMod_facEgyThdTspS1B1 "reduction factor of heat quantity threshold for dew-point end detection for TSP sensor 1 bank 1" UBYTE fak_ub_b2 1 100 0.00 1.000000 FORMAT "%8.6" ECU_ADDRESS 0x60006486 /end MEASUREMENT
/begin MEASUREMENT ExhMod_facExoCorrnIgnAgHomB1 "Zündwinkelkorrektur für die exotherme Temperaturerhöhung im Katalysator für Homogenbetrieb Bank 1" UBYTE fak_ub_b2 1 100 0.00 1.992188 FORMAT "%8.6" ECU_ADDRESS 0x6000648A /end MEASUREMENT
/begin MEASUREMENT ExhMod_facExoCorrnLamB1 "lambda correction exothermal temperature increase in catalyst bank 1" UBYTE fak_ub_b2 1 100 0.00 1.992188 FORMAT "%8.6" ECU_ADDRESS 0x60006489 /end MEASUREMENT
/begin MEASUREMENT ExhMod_facTExhVlvCorrnIgnAgHomB1 "Ignition angle correction for the gas temperature at exhaust valve in homogenous operation bank 1" UWORD fak_uw_b2 1 100 0.00 1.999969 FORMAT "%8.6" ECU_ADDRESS 0x60003864 /end MEASUREMENT
/begin MEASUREMENT ExhMod_facTExhVlvCorrnRri "Exhaust temperature correction factor based on inert gas rate" UWORD fak_uw_b2 1 100 0.00 1.999969 FORMAT "%8.6" ECU_ADDRESS 0x60003862 /end MEASUREMENT
/begin MEASUREMENT ExhMod_facWghtMnfldCatExoLamCcoB1 "weighting factor manifold catalyst exothermy cylinder cut-off depending on lambda bank 1" UBYTE fak_ub_b2 1 100 0.00 1.000000 FORMAT "%8.6" ECU_ADDRESS 0x60006488 /end MEASUREMENT
/begin MEASUREMENT ExhMod_flgCatHtgColdStrtTsp "flag catalyst heating cold start for TSP sensors detected" UBYTE B_TRUE 1 100 0.00 1.00000000000 BIT_MASK 0x1 FORMAT "%13.11" ECU_ADDRESS 0x7000020D /end MEASUREMENT
/begin MEASUREMENT ExhMod_flgDewPntEndRstTspS1B1 "flag reset dew-point end for thermal shock protected sensor 1" UBYTE B_TRUE 1 100 0.00 1.00000000000 BIT_MASK 0x1 FORMAT "%13.11" ECU_ADDRESS 0x700007BD /end MEASUREMENT
/begin MEASUREMENT ExhMod_flgEmptyO2Cat1B1 "Flag catalyst 1 bank 1 is exhausted of oxygen" UBYTE B_TRUE 1 100 0.00 1.00000000000 BIT_MASK 0x1 FORMAT "%13.11" ECU_ADDRESS 0x700007B8 /end MEASUREMENT
/begin MEASUREMENT ExhMod_flgEndMeasCat1B1ER_I.buffer "Flag end of measurement storage capability catalyst 1 bank 1 / rising edge detected" UBYTE B_TRUE 1 100 0.00 1.00000000000 BIT_MASK 0x1 FORMAT "%13.11" ECU_ADDRESS 0x6000387A /end MEASUREMENT
/begin MEASUREMENT ExhMod_flgEndMeasCat1B1ER_I.oldSignal "Flag end of measurement storage capability catalyst 1 bank 1 / flag rising edge" UBYTE B_TRUE 1 100 0.00 1.00000000000 BIT_MASK 0x1 FORMAT "%13.11" ECU_ADDRESS 0x6000387B /end MEASUREMENT
/begin MEASUREMENT ExhMod_flgEngFrstRunng "Bit first end of engine start in cycle was reached" UBYTE B_TRUE 1 100 0.00 1.00000000000 BIT_MASK 0x1 FORMAT "%13.11" ECU_ADDRESS 0x70000213 /end MEASUREMENT
/begin MEASUREMENT ExhMod_flgEngRunngTiEngOff "Engine-running-status corresponding to the engine off time used in ExhMod" UBYTE B_TRUE 1 100 0.00 1.00000000000 BIT_MASK 0x1 FORMAT "%13.11" ECU_ADDRESS 0x700007B7 /end MEASUREMENT
/begin MEASUREMENT ExhMod_flgEngRunngTiEngOffRaw "Engine-running-status corresponding to the engine off time used in ExhMod (raw value)" UBYTE B_TRUE 1 100 0.00 1.00000000000 BIT_MASK 0x1 FORMAT "%13.11" ECU_ADDRESS 0x70000214 /end MEASUREMENT
/begin MEASUREMENT ExhMod_flgFullO2Cat1B1 "Flag catalyst 1 bank 1 is filled with oxygen" UBYTE B_TRUE 1 100 0.00 1.00000000000 BIT_MASK 0x1 FORMAT "%13.11" ECU_ADDRESS 0x700007B4 /end MEASUREMENT
/begin MEASUREMENT ExhMod_flgHeatgTspS1B1 "flag reduced heat quantity threshold for TSP(Thermal shock protection) sensor 1 reached" UBYTE B_TRUE 1 100 0.00 1.00000000000 BIT_MASK 0x1 FORMAT "%13.11" ECU_ADDRESS 0x700007B3 /end MEASUREMENT
/begin MEASUREMENT ExhMod_flgInhbnCat1B1 "Inhibit calculation catalyst 1 Bank 1" UBYTE B_TRUE 1 100 0.00 1.00000000000 BIT_MASK 0x1 FORMAT "%13.11" ECU_ADDRESS 0x700007B2 /end MEASUREMENT
/begin MEASUREMENT ExhMod_flgInhbnCat2B1 "inhibition of calculation catalyst 2 bank 1" UBYTE B_TRUE 1 100 0.00 1.00000000000 BIT_MASK 0x1 FORMAT "%13.11" ECU_ADDRESS 0x700007B1 /end MEASUREMENT
/begin MEASUREMENT ExhMod_flgInpMfLeanCat1B1 "Flag input mass flow lean catalyst 1 bank 1" UBYTE B_TRUE 1 100 0.00 1.00000000000 BIT_MASK 0x1 FORMAT "%13.11" ECU_ADDRESS 0x700007B0 /end MEASUREMENT
/begin MEASUREMENT ExhMod_flgInpMfRichCat1B1 "Flag input mass flow rich catalyst 1 bank 1" UBYTE B_TRUE 1 100 0.00 1.00000000000 BIT_MASK 0x1 FORMAT "%13.11" ECU_ADDRESS 0x700007AF /end MEASUREMENT
/begin MEASUREMENT ExhMod_flgLamLeanB1 "lambda ratio greater than threshold for exothermicity calculation, bank 1" UBYTE B_TRUE 1 100 0.00 1.00000000000 BIT_MASK 0x1 FORMAT "%13.11" ECU_ADDRESS 0x70000212 /end MEASUREMENT
/begin MEASUREMENT ExhMod_flgLamRichB1 "lambda ratio lower than threshold for exothermy calculation, bank 1" UBYTE B_TRUE 1 100 0.00 1.00000000000 BIT_MASK 0x1 FORMAT "%13.11" ECU_ADDRESS 0x70000211 /end MEASUREMENT
/begin MEASUREMENT ExhMod_flgLSEnaCat1B1 "Flag lambda sensor valid downstream catalyst1 bank1" UBYTE B_TRUE 1 100 0.00 1.00000000000 BIT_MASK 0x1 FORMAT "%13.11" ECU_ADDRESS 0x700007AD /end MEASUREMENT
/begin MEASUREMENT ExhMod_flgO2MeasRdyCat1B1 "Flag readiness for oxygen storage capacity measurement catalyst 1 bank 1" UBYTE B_TRUE 1 100 0.00 1.00000000000 BIT_MASK 0x1 FORMAT "%13.11" ECU_ADDRESS 0x700007A8 /end MEASUREMENT
/begin MEASUREMENT ExhMod_flgOscMeasdCat1B1 "Flag current oxygen storage capability measured catalyst 1 bank 1" UBYTE B_TRUE 1 100 0.00 1.00000000000 BIT_MASK 0x1 FORMAT "%13.11" ECU_ADDRESS 0x700007A7 /end MEASUREMENT
/begin MEASUREMENT ExhMod_flgPasOSCMeasmt "condition of passive measurement of oxygen storage capacity bank 1" UBYTE B_TRUE 1 100 0.00 1.00000000000 BIT_MASK 0x1 FORMAT "%13.11" ECU_ADDRESS 0x600064A4 /end MEASUREMENT
/begin MEASUREMENT ExhMod_flgRoscMeasdCat1B1 "Flag current oxygen storage capability measured catalyst 1 bank 1" UBYTE B_TRUE 1 100 0.00 1.00000000000 BIT_MASK 0x1 FORMAT "%13.11" ECU_ADDRESS 0x700007A6 /end MEASUREMENT
/begin MEASUREMENT ExhMod_flgStrtMeasCat1B1ER_I.buffer "Flag start of measurement storage capability catalyst 1 bank 1 / rising edge detected" UBYTE B_TRUE 1 100 0.00 1.00000000000 BIT_MASK 0x1 FORMAT "%13.11" ECU_ADDRESS 0x60003878 /end MEASUREMENT
/begin MEASUREMENT ExhMod_flgStrtMeasCat1B1ER_I.oldSignal "Flag start of measurement storage capability catalyst 1 bank 1 / flag rising edge" UBYTE B_TRUE 1 100 0.00 1.00000000000 BIT_MASK 0x1 FORMAT "%13.11" ECU_ADDRESS 0x60003879 /end MEASUREMENT
/begin MEASUREMENT ExhMod_flgSucOscMeasmtCat1B1 "Flag successful storage capability measurement catalyst 1 bank 1" UBYTE B_TRUE 1 100 0.00 1.00000000000 BIT_MASK 0x1 FORMAT "%13.11" ECU_ADDRESS 0x6000A18E /end MEASUREMENT
/begin MEASUREMENT ExhMod_flgTCalcnCoolgCrv "Flag temperature calculation from cooling curve" UBYTE B_TRUE 1 100 0.00 1.00000000000 BIT_MASK 0x1 FORMAT "%13.11" ECU_ADDRESS 0x70000210 /end MEASUREMENT
/begin MEASUREMENT ExhMod_flgTiEngOffNotPlausPwrFail "bit time engine off not plausible powerfail" UBYTE B_TRUE 1 100 0.00 1.00000000000 BIT_MASK 0x1 FORMAT "%13.11" ECU_ADDRESS 0x60034986 /end MEASUREMENT
/begin MEASUREMENT ExhMod_flgTiEngOffPlausOld "bit time engine plausible old" UBYTE B_TRUE 1 100 0.00 1.00000000000 BIT_MASK 0x1 FORMAT "%13.11" ECU_ADDRESS 0x7000020F /end MEASUREMENT
/begin MEASUREMENT ExhMod_flgTiEngOffVld "Validity status of the engine off time used in ExhMod" UBYTE B_TRUE 1 100 0.00 1.00000000000 BIT_MASK 0x1 FORMAT "%13.11" ECU_ADDRESS 0x700007A3 /end MEASUREMENT
/begin MEASUREMENT ExhMod_flgTIninCmpl "Statusflag for completion of initialization of modelled temperatures" UBYTE B_TRUE 1 100 0.00 1.00000000000 BIT_MASK 0x1 FORMAT "%13.11" ECU_ADDRESS 0x700007A5 /end MEASUREMENT
/begin MEASUREMENT ExhMod_flgTIninSuc "bit temperature initialisation successful" UBYTE B_TRUE 1 100 0.00 1.00000000000 BIT_MASK 0x1 FORMAT "%13.11" ECU_ADDRESS 0x7000020E /end MEASUREMENT
/begin MEASUREMENT ExhMod_flgTspRelsNoRstS1B1 "flag TSP heat quantity threshold reached this driving cycle S1B1" UBYTE B_TRUE 1 100 0.00 1.00000000000 BIT_MASK 0x1 FORMAT "%13.11" ECU_ADDRESS 0x7000020C /end MEASUREMENT
/begin MEASUREMENT ExhMod_htcWallEnvB1 "Heat transfer coefficient between the wall of the exhaust gas system and the environment bank 1" UWORD fak_q0p00174_JsK 1 100 0.00 113.7760 FORMAT "%8.4" ARRAY_SIZE 13 ECU_ADDRESS 0x500053FE /end MEASUREMENT
/begin MEASUREMENT ExhMod_mfAirB1 "air mass flow" FLOAT32_IEEE AirMassPerTime_float 1 100 0.00 50000.0000 FORMAT "%10.4" ECU_ADDRESS 0x6000D71C /end MEASUREMENT
/begin MEASUREMENT ExhMod_mfExhAryB1 "mass flow array exhaust gas" FLOAT32_IEEE AirMassPerTime_float 1 100 0.00 50000.0000 FORMAT "%10.4" ARRAY_SIZE 13 ECU_ADDRESS 0x50004C90 /end MEASUREMENT
/begin MEASUREMENT ExhMod_mfExhB1 "mass flow exhaust gas" FLOAT32_IEEE AirMassPerTime_float 1 100 0.00 50000.0000 FORMAT "%10.4" ECU_ADDRESS 0x60001DA0 /end MEASUREMENT
/begin MEASUREMENT ExhMod_mfExhCat1B1 "mass flow exhaust gas catalyst 1" FLOAT32_IEEE AirMassPerTime_float 1 100 0.00 50000.0000 FORMAT "%10.4" ECU_ADDRESS 0x60001D9C /end MEASUREMENT
/begin MEASUREMENT ExhMod_mfExhCat2B1 "mass flow exhaust gas catalyst 2" FLOAT32_IEEE AirMassPerTime_float 1 100 0.00 50000.0000 FORMAT "%10.4" ECU_ADDRESS 0x60001D98 /end MEASUREMENT
/begin MEASUREMENT ExhMod_mfExhCatAryB1 "mass flow exhaust gas catalysts" FLOAT32_IEEE AirMassPerTime_float 1 100 -1.00E+037 1.00E+037 FORMAT "%5.2" ARRAY_SIZE 2 ECU_ADDRESS 0x60001D90 /end MEASUREMENT
/begin MEASUREMENT ExhMod_mfExhMnfB1 "mass flow exhaust gas, manifold" FLOAT32_IEEE AirMassPerTime_float 1 100 0.00 50000.0000 FORMAT "%10.4" ECU_ADDRESS 0x60001D8C /end MEASUREMENT
/begin MEASUREMENT ExhMod_mfExhS1B1 "mass flow exhaust gas sensor 1" FLOAT32_IEEE AirMassPerTime_float 1 100 0.00 50000.0000 FORMAT "%10.4" ECU_ADDRESS 0x50004D10 /end MEASUREMENT
/begin MEASUREMENT ExhMod_mfExhS2B1 "mass flow exhaust gas sensor 2" FLOAT32_IEEE AirMassPerTime_float 1 100 0.00 50000.0000 FORMAT "%10.4" ECU_ADDRESS 0x50004D14 /end MEASUREMENT
/begin MEASUREMENT ExhMod_mfExhSnsrAryB1 "mass flow exhaust gas array sensors" FLOAT32_IEEE AirMassPerTime_float 1 100 -1.00E+037 1.00E+037 FORMAT "%5.2" ARRAY_SIZE 2 ECU_ADDRESS 0x60001D84 /end MEASUREMENT
/begin MEASUREMENT ExhMod_mfExhVlvB1 "exhaust gas mass flow at outlet valves" FLOAT32_IEEE AirMassPerTime_float 1 100 0.00 50000.0000 FORMAT "%10.4" ECU_ADDRESS 0x60001D80 /end MEASUREMENT
/begin MEASUREMENT ExhMod_mfExhWoFuUsCat1B1 "Mass flow exhaust gas minus fuel part upstream of catalyst 1" FLOAT32_IEEE AirMassPerTime_float 1 100 0.00 50000.0000 FORMAT "%10.4" ECU_ADDRESS 0x60001D7C /end MEASUREMENT
/begin MEASUREMENT ExhMod_mfExhWoFuUsCat2B1 "Mass flow exhaust gas minus fuel part upstream of catalyst 2" FLOAT32_IEEE AirMassPerTime_float 1 100 0.00 50000.0000 FORMAT "%10.4" ECU_ADDRESS 0x60001D78 /end MEASUREMENT
/begin MEASUREMENT ExhMod_mfExoB1 "Massflow respecitve to exothermy" FLOAT32_IEEE AirMassPerTime_float 1 100 0.00 50000.0000 FORMAT "%10.4" ECU_ADDRESS 0x60001418 /end MEASUREMENT
/begin MEASUREMENT ExhMod_mfFuB1 "fuel mass flow" FLOAT32_IEEE AirMassPerTime_float 1 100 0.00 50000.0000 FORMAT "%10.4" ECU_ADDRESS 0x50004D20 /end MEASUREMENT
/begin MEASUREMENT ExhMod_mfTExhVlvMdlB1 "exhaust gas mass flow at outlet valves" UWORD m_uw_b6553p5 1 100 0.00 6553.500 FORMAT "%8.3" ECU_ADDRESS 0x60003860 /end MEASUREMENT
/begin MEASUREMENT ExhMod_mO2IntglCat1B1 "Oxygen integral for oxygen storage capacity measurement catalyst 1 bank 1" SLONG m_q0p1_mg 1 100 -214748364.800 214748364.700 FORMAT "%13.3" ECU_ADDRESS 0x6000D710 /end MEASUREMENT
/begin MEASUREMENT ExhMod_mO2StrAgedCat1B1 "Oxygen storage capability (aged catalyst) catalyst 1 bank 1" UWORD m_q0p1_mg 1 100 0.00 6553.500 FORMAT "%8.3" ECU_ADDRESS 0x6000E21E /end MEASUREMENT
/begin MEASUREMENT ExhMod_mO2StrAgedCat2B1 "Oxygen storage capability (aged catalyst) catalyst 2 bank 1" UWORD m_q0p1_mg 1 100 0.00 6553.500 FORMAT "%8.3" ECU_ADDRESS 0x6000E220 /end MEASUREMENT
/begin MEASUREMENT ExhMod_mO2StrAgedExtdCat1B1 "Oxygen storage capability (aged catalyst) catalyst 1 bank 1" ULONG m_q0p1_mg 1 100 0.00 131072.000000 FORMAT "%13.6" ECU_ADDRESS 0x50004C78 /end MEASUREMENT
/begin MEASUREMENT ExhMod_mO2StrAgedExtdCat2B1 "Oxygen storage capability (aged catalyst) catalyst 2 bank 1" ULONG m_q0p1_mg 1 100 0.00 131072.000000 FORMAT "%13.6" ECU_ADDRESS 0x6000D714 /end MEASUREMENT
/begin MEASUREMENT ExhMod_mO2StrCat1B1 "Oxygen storage capacity calculated catalyst 1" UWORD m_q0p1_mg 1 100 0.00 6553.500 FORMAT "%8.3" ECU_ADDRESS 0x6000E222 /end MEASUREMENT
/begin MEASUREMENT ExhMod_mO2StrCat2B1 "Oxygen storage capacity calculated catalyst 2" UWORD m_q0p1_mg 1 100 0.00 6553.500 FORMAT "%8.3" ECU_ADDRESS 0x60004CE0 /end MEASUREMENT
/begin MEASUREMENT ExhMod_mO2StrExtdCat1B1 "Oxygen storage capacity calculated catalyst 1" ULONG m_q0p1_mg 1 100 0.00 131072.000000 FORMAT "%13.6" ECU_ADDRESS 0x60001C64 /end MEASUREMENT
/begin MEASUREMENT ExhMod_mO2StrExtdCat2B1 "Oxygen storage capacity calculated catalyst 2" ULONG m_q0p1_mg 1 100 0.00 131072.000000 FORMAT "%13.6" ECU_ADDRESS 0x50004C7C /end MEASUREMENT
/begin MEASUREMENT ExhMod_mO2StrNewCat1B1 "Oxygen storage capacity of a new catalyst 1" UWORD m_q0p1_mg 1 100 0.00 6553.500 FORMAT "%8.3" ECU_ADDRESS 0x6000E224 /end MEASUREMENT
/begin MEASUREMENT ExhMod_mO2StrNewCat2B1 "Oxygen storage capacity of a new catalyst 2" UWORD m_q0p1_mg 1 100 0.00 6553.500 FORMAT "%8.3" ECU_ADDRESS 0x6000E226 /end MEASUREMENT
/begin MEASUREMENT ExhMod_mO2StrNewExtdCat1B1 "Oxygen storage capacity of a new catalyst 1" ULONG m_q0p1_mg 1 100 0.00 131072.000000 FORMAT "%13.6" ECU_ADDRESS 0x50004C84 /end MEASUREMENT
/begin MEASUREMENT ExhMod_mO2StrNewExtdCat2B1 "Oxygen storage capacity of a new catalyst 2" ULONG m_q0p1_mg 1 100 0.00 131072.000000 FORMAT "%13.6" ECU_ADDRESS 0x50004C88 /end MEASUREMENT
/begin MEASUREMENT ExhMod_mOscMeasdCat1B1 "Measured oxygen storage capability catalyst 1 bank 1" UWORD m_q0p1_mg 1 100 0.00 6553.500 FORMAT "%8.3" ECU_ADDRESS 0x6000E228 /end MEASUREMENT
/begin MEASUREMENT ExhMod_mOscMeasdExtdCat1B1 "Measured oxygen storage capability catalyst 1 bank 1" ULONG m_q0p1_mg 1 100 0.00 429496729.500 FORMAT "%13.3" ECU_ADDRESS 0x50004C8C /end MEASUREMENT
/begin MEASUREMENT ExhMod_mRoscMeasdCat1B1 "Measured oxygen storage capacity catalyst 1 bank 1" UWORD m_q0p1_mg 1 100 0.00 6553.500 FORMAT "%8.3" ECU_ADDRESS 0x6000E22A /end MEASUREMENT
/begin MEASUREMENT ExhMod_mRoscMeasdExtdCat1B1 "Measured oxygen storage capacity catalyst 1 bank 1" ULONG m_q0p1_mg 1 100 0.00 429496729.500 FORMAT "%13.3" ECU_ADDRESS 0x6000D718 /end MEASUREMENT
/begin MEASUREMENT ExhMod_offsCorrnTExhVlvIntkAirB1 "Intake air temperature based offset correction for the stationary temperature at exhaust valve bank 1" SWORD temp_q0p0234 1 100 -768.0000 767.9766 FORMAT "%8.4" ECU_ADDRESS 0x6000385E /end MEASUREMENT
/begin MEASUREMENT ExhMod_offsTExhVlvCorrnIgnAgHomB1 "Ignition angle based offset correction for the gas temperature at exhaust valve in homogenous operation bank 1" SWORD temp_q0p0234 1 100 -768.0000 767.9766 FORMAT "%8.4" ECU_ADDRESS 0x6000385C /end MEASUREMENT
/begin MEASUREMENT ExhMod_offsTExhVlvCorrnLamB1 "Lambda based offset correction for the gas temperature at exhaust valve bank 1" SWORD temp_q0p0234 1 100 -768.0000 767.9766 FORMAT "%8.4" ECU_ADDRESS 0x6000385A /end MEASUREMENT
/begin MEASUREMENT ExhMod_pDiffCatMFlowAry "Output array haracteristic map mass flow-dependent factor in press. gradient catalysts" UWORD fak_q16_hPahPa 1 100 0.00 1048560. FORMAT "%8.0" ARRAY_SIZE 2 ECU_ADDRESS 0x60003866 /end MEASUREMENT
/begin MEASUREMENT ExhMod_pDsLstCat "pressure downstream of last catalyst" UWORD p_q0p039 1 100 0.00 2559.961 FORMAT "%8.3" ECU_ADDRESS 0x6000E22C /end MEASUREMENT
/begin MEASUREMENT ExhMod_pEnvAppl "Ambient pressure for the exhaust backpressure model" UWORD p_q0p039 1 100 0.00 2559.961 FORMAT "%8.3" ECU_ADDRESS 0x600048C2 /end MEASUREMENT
/begin MEASUREMENT ExhMod_pEnvTMdl "Ambient pressure for ExhMod_TMdl" UWORD p_uw_q0p039 1 100 0.00 2559.961 FORMAT "%8.3" ECU_ADDRESS 0x6000383C /end MEASUREMENT
/begin MEASUREMENT ExhMod_pExhCat1UsB1 "pressure exhaust gas catalyst 1 upstream" UWORD p_q0p039 1 100 0.00 2559.961 FORMAT "%8.3" ECU_ADDRESS 0x600048C0 /end MEASUREMENT
/begin MEASUREMENT ExhMod_pExhCat2UsB1 "pressure exhaust gas catalyst 2 upstream" UWORD p_q0p039 1 100 0.00 2559.961 FORMAT "%8.3" ECU_ADDRESS 0x600048BE /end MEASUREMENT
/begin MEASUREMENT ExhMod_pExhCatUsAryB1 "pressure exhaust gas upstream catalysts" UWORD p_q0p039 1 100 0.00 2559.961 FORMAT "%8.3" ARRAY_SIZE 3 ECU_ADDRESS 0x50005418 /end MEASUREMENT
/begin MEASUREMENT ExhMod_pwrExoCorrdCatAryB1 "vector of corrected heat released by basic exothermic reaction in each brick of the catalysts bank1" FLOAT32_IEEE HtFlw_Fl 1 100 -5000000.000 5000000.000 FORMAT "%11.3" ARRAY_SIZE 6 ECU_ADDRESS 0x5000156C /end MEASUREMENT
/begin MEASUREMENT ExhMod_pwrExoTranB1 "The heat energy released due to exothermic reactions during rich and lean lambda transitions for bank 1" FLOAT32_IEEE HtFlw_Fl 1 100 -5000000.000 5000000.000 FORMAT "%11.3" ECU_ADDRESS 0x50001584 /end MEASUREMENT
/begin MEASUREMENT ExhMod_ratAfr "Stoichiometrically air fuel ratio" UWORD fak_q4p6875Em4 1 100 0.00 30.71953 FORMAT "%8.5" ECU_ADDRESS 0x60003896 /end MEASUREMENT
/begin MEASUREMENT ExhMod_ratLamAvrgB1 "lambda average bank 1" UWORD fak_uw_b16 1 100 0.00 15.99976 FORMAT "%8.5" ECU_ADDRESS 0x600048BC /end MEASUREMENT
/begin MEASUREMENT ExhMod_ratLamCatUsB1 "lambda upsteam catalyst bank 1" UWORD fak_uw_b16 1 100 0.00 15.99976 FORMAT "%8.5" ECU_ADDRESS 0x6000383A /end MEASUREMENT
/begin MEASUREMENT ExhMod_ratLamCcoB1 "lambda cylinder cut-off bank 1" UWORD fak_uw_b16 1 100 0.00 15.99976 FORMAT "%8.5" ECU_ADDRESS 0x60003838 /end MEASUREMENT
/begin MEASUREMENT ExhMod_ratLamVlvB1 "lambda valve bank 1" UWORD fak_uw_b16 1 100 0.00 15.99976 FORMAT "%8.5" ECU_ADDRESS 0x60003858 /end MEASUREMENT
/begin MEASUREMENT ExhMod_ratMFlowVlvB1 "exhaust gas mass flow ratio at outlet valves" UWORD fak_uw_b2 1 100 0.00 1.000000 FORMAT "%8.6" ECU_ADDRESS 0x60004CD2 /end MEASUREMENT
/begin MEASUREMENT ExhMod_ratO2StorgCalCat1B1 "Ageing factor regarding OSC catalyst 1, bank 1" UBYTE fak_ub_b2 1 100 0.00 1.992188 FORMAT "%8.6" ECU_ADDRESS 0x600365B3 /end MEASUREMENT
/begin MEASUREMENT ExhMod_ratO2StorgCalCat2B1 "Aging factor regarding OSC catalyst 2, bank 1" UBYTE fak_ub_b2 1 100 0.00 1.992188 FORMAT "%8.6" ECU_ADDRESS 0x600365B2 /end MEASUREMENT
/begin MEASUREMENT ExhMod_ratO2StorgCatB1_a "array, which include ageing factors of each catalyst, bank 1" UWORD fak_uw_b2 1 100 0.00 1.999969 FORMAT "%8.6" ARRAY_SIZE 2 ECU_ADDRESS 0x60004CCE /end MEASUREMENT
/begin MEASUREMENT ExhMod_ratO2StrCat1B1 "Catalyst aging factor based on Oxygen Storage Capacity - Catalyst 1 Bank 1" UWORD fak_uw_b2 1 100 0.00 1.999969 FORMAT "%8.6" ECU_ADDRESS 0x60004CCC /end MEASUREMENT
/begin MEASUREMENT ExhMod_ratO2StrCat1MinBnk "Minimum of the Oxygen storage capacity correction factors of the catalyst 1 of bank 1 and bank 2" UWORD fak_uw_b2 1 100 0.00 1.999969 FORMAT "%8.6" ECU_ADDRESS 0x6000E234 /end MEASUREMENT
/begin MEASUREMENT ExhMod_ratO2StrCatAryB1 "oxygen storage capacity correction factor catalysts" UWORD fak_uw_b2 1 100 0.00 1.999969 FORMAT "%8.6" ARRAY_SIZE 2 ECU_ADDRESS 0x60004CC8 /end MEASUREMENT
/begin MEASUREMENT ExhMod_ratRelAirFuFillgB1 "relative air- or fuelfilling bank 1" UWORD rel_uw_b3072 1 100 0.00 3071.953 FORMAT "%8.3" ECU_ADDRESS 0x60003856 /end MEASUREMENT
/begin MEASUREMENT ExhMod_stSubOldTspSnsrRels "SyC_stSub last calculation step TspSnsrRels" UBYTE ExeCon_State_02 1 100 0.00 6.00000000000 FORMAT "%13.11" ECU_ADDRESS 0x60006485 /end MEASUREMENT
/begin MEASUREMENT ExhMod_tCannMplBrickBank1 "temperature array canning multi brick bank 1" ULONG temp_q3p57Em7_om273 1 100 -273.15000000 1262.84999964 FORMAT "%13.8" ARRAY_SIZE 18 ECU_ADDRESS 0x50001588 /end MEASUREMENT
/begin MEASUREMENT ExhMod_tCat1AvrgB1 "average temperature catalyst 1" SWORD Temp_Cels 1 100 -3549.940 3003.560 FORMAT "%8.3" ECU_ADDRESS 0x60004A66 /end MEASUREMENT
/begin MEASUREMENT ExhMod_tCat1B1 "temperature catalyst 1" SWORD Temp_Cels 1 100 -3549.940 3003.560 FORMAT "%8.3" ECU_ADDRESS 0x60004A64 /end MEASUREMENT
/begin MEASUREMENT ExhMod_tCat1EndB1 "Temperature end of catalyst 1" SWORD Temp_Cels 1 100 -3549.940 3003.560 FORMAT "%8.3" ECU_ADDRESS 0x60004A62 /end MEASUREMENT
/begin MEASUREMENT ExhMod_tCat1InB1 "Exhaust gas temperature at the start brick of catalyst1 bank1" SWORD Temp_Cels 1 100 -3549.940 3003.560 FORMAT "%8.3" ECU_ADDRESS 0x60004A60 /end MEASUREMENT
/begin MEASUREMENT ExhMod_tCat1MaxB1 "maximum temperature catalyst 1" SWORD Temp_Cels 1 100 -3549.940 3003.560 FORMAT "%8.3" ECU_ADDRESS 0x60004A5E /end MEASUREMENT
/begin MEASUREMENT ExhMod_tCat1MinB1 "minimum temperature catalyst 1" SWORD Temp_Cels 1 100 -3549.940 3003.560 FORMAT "%8.3" ECU_ADDRESS 0x60004A5C /end MEASUREMENT
/begin MEASUREMENT ExhMod_tCat2AvrgB1 "average temperature catalyst 2" SWORD Temp_Cels 1 100 -3549.940 3003.560 FORMAT "%8.3" ECU_ADDRESS 0x60004A5A /end MEASUREMENT
/begin MEASUREMENT ExhMod_tCat2B1 "Temperature catalyst 2" SWORD Temp_Cels 1 100 -3549.940 3003.560 FORMAT "%8.3" ECU_ADDRESS 0x60004A58 /end MEASUREMENT
/begin MEASUREMENT ExhMod_tCat2EndB1 "Temperature end of catalyst 2" SWORD Temp_Cels 1 100 -3549.940 3003.560 FORMAT "%8.3" ECU_ADDRESS 0x60004A56 /end MEASUREMENT
/begin MEASUREMENT ExhMod_tCat2InB1 "Exhaust gas temperature at the start brick of catalyst2 bank1" SWORD Temp_Cels 1 100 -3549.940 3003.560 FORMAT "%8.3" ECU_ADDRESS 0x60004A54 /end MEASUREMENT
/begin MEASUREMENT ExhMod_tCat2MaxB1 "maximum temperature catalyst 2" SWORD Temp_Cels 1 100 -3549.940 3003.560 FORMAT "%8.3" ECU_ADDRESS 0x60004A52 /end MEASUREMENT
/begin MEASUREMENT ExhMod_tCat2MinB1 "minimum temperature catalyst 2" SWORD Temp_Cels 1 100 -3549.940 3003.560 FORMAT "%8.3" ECU_ADDRESS 0x60004A50 /end MEASUREMENT
/begin MEASUREMENT ExhMod_tCatAryB1 "Array catalyst temperatures" SWORD Temp_Cels 1 100 -3549.940 3003.560 FORMAT "%8.3" ARRAY_SIZE 2 ECU_ADDRESS 0x60004A4C /end MEASUREMENT
/begin MEASUREMENT ExhMod_tCatAvrgAryB1 "Array average catalyst temperatures" SWORD Temp_Cels 1 100 -3549.940 3003.560 FORMAT "%8.3" ARRAY_SIZE 2 ECU_ADDRESS 0x60004A48 /end MEASUREMENT
/begin MEASUREMENT ExhMod_tCatBrickAryB1 "Array of exhaust gas brick temperatures in catalyst - bank 1" SWORD Temp_Cels 1 100 -3549.940 3003.560 FORMAT "%8.3" ARRAY_SIZE 6 ECU_ADDRESS 0x50005A7E /end MEASUREMENT
/begin MEASUREMENT ExhMod_tCatInAryB1 "Exhaust Gas array temeprature of catalyst in Bank1" SWORD Temp_Cels 1 100 -3549.940 3003.560 FORMAT "%8.3" ARRAY_SIZE 2 ECU_ADDRESS 0x60004A44 /end MEASUREMENT
/begin MEASUREMENT ExhMod_tCatNvAryB1 "temperature catalyst (not volatile) bank 1" UWORD temp_q0p0234_o273 1 100 -273.150 1262.827 FORMAT "%8.3" ARRAY_SIZE 6 ECU_ADDRESS 0x600365A2 /end MEASUREMENT
/begin MEASUREMENT ExhMod_tDeltaCatBrAryB1 "temperature difference in catalyst brick bank 1" SWORD temp_sw_q0p125 1 100 -4096.000 4095.875 FORMAT "%8.3" ARRAY_SIZE 6 ECU_ADDRESS 0x5000541E /end MEASUREMENT
/begin MEASUREMENT ExhMod_tDeltaExoCcoB1 "exothermy cylinder cut-off bank 1" SWORD temp_q0p0234 1 100 0.00 767.9766 FORMAT "%8.4" ECU_ADDRESS 0x60003836 /end MEASUREMENT
/begin MEASUREMENT ExhMod_tDeltaExoCcoCatB1 "exothermy cylinder cut-off catalyst bank 1" SWORD temp_q0p0234 1 100 0.00 767.9766 FORMAT "%8.4" ECU_ADDRESS 0x60003834 /end MEASUREMENT
/begin MEASUREMENT ExhMod_tDeltaExoCcoMnfldB1 "exothermy cylinder cut-off manifold bank 1" SWORD temp_q0p0234 1 100 0.00 767.9766 FORMAT "%8.4" ECU_ADDRESS 0x60003832 /end MEASUREMENT
/begin MEASUREMENT ExhMod_tDeltaExoFcoB1 "exothermy fuel cut-off bank 1" UWORD temp_uw_q0p0468 1 100 0.00 3071.953 FORMAT "%8.3" ECU_ADDRESS 0x60003830 /end MEASUREMENT
/begin MEASUREMENT ExhMod_tDeltaExoMnfldB1 "Adiabatic increase of temperature in manifold" SWORD temp_q0p0234 1 100 -768.0000 767.9766 FORMAT "%8.4" ECU_ADDRESS 0x6000382E /end MEASUREMENT
/begin MEASUREMENT ExhMod_tDeltaExoTotB1 "Gesamte exotherme Temperaturerhöhung im Katalysator bank 1" UWORD temp_sw_q0p125 1 100 0.00 8191.875 FORMAT "%8.3" ECU_ADDRESS 0x6000382C /end MEASUREMENT
/begin MEASUREMENT ExhMod_tDeltaExoTranLtrB1 "Exothermicity in catalyst bricks during lean-to-rich lambda transition bank 1" SWORD temp_q0p0234 1 100 -768.0000 767.9766 FORMAT "%8.4" ECU_ADDRESS 0x6000382A /end MEASUREMENT
/begin MEASUREMENT ExhMod_tDeltaExoTranRtlB1 "Exothermicity in catalyst bricks during rich-to-lean lambda transition bank 1" SWORD temp_q0p0234 1 100 -768.0000 767.9766 FORMAT "%8.4" ECU_ADDRESS 0x60003828 /end MEASUREMENT
/begin MEASUREMENT ExhMod_tEng "engine temperature, shown in Celsius, internally in Kelvin" SWORD Temp_Cels 1 100 -3549.940 3003.560 FORMAT "%8.3" ECU_ADDRESS 0x60004A42 /end MEASUREMENT
/begin MEASUREMENT ExhMod_tEnvLoc "Local ambient temperature value for ExhMod_TMdl" UWORD temp_q0p0234_o273 1 100 -273.150 1262.827 FORMAT "%8.3" ECU_ADDRESS 0x60003822 /end MEASUREMENT
/begin MEASUREMENT ExhMod_tExhAryB1 "exhaust gas temperature array" SWORD Temp_Cels 1 100 -3549.940 3003.560 FORMAT "%8.3" ARRAY_SIZE 13 ECU_ADDRESS 0x6000E236 /end MEASUREMENT
/begin MEASUREMENT ExhMod_tExhCat1DsB1 "exhaust gas temperature catalyst 1 downstream" SWORD Temp_Cels 1 100 -3549.940 3003.560 FORMAT "%8.3" ECU_ADDRESS 0x60004A3C /end MEASUREMENT
/begin MEASUREMENT ExhMod_tExhCat1UsAvrgB1 "Average exhaust gas temperature upstream catalyst 1" SWORD Temp_Cels 1 100 -3549.940 3003.560 FORMAT "%8.3" ECU_ADDRESS 0x6000E250 /end MEASUREMENT
/begin MEASUREMENT ExhMod_tExhCat1UsB1 "exhaust gas temperature catalyst 1 upstream" SWORD Temp_Cels 1 100 -3549.940 3003.560 FORMAT "%8.3" ECU_ADDRESS 0x60004A3A /end MEASUREMENT
/begin MEASUREMENT ExhMod_tExhCat2DsB1 "exhaust gas temperature catalyst 2 downstream" SWORD Temp_Cels 1 100 -3549.940 3003.560 FORMAT "%8.3" ECU_ADDRESS 0x6000E252 /end MEASUREMENT
/begin MEASUREMENT ExhMod_tExhCat2UsAvrgB1 "Average exhaust gas temperature upstream catalyst 2" SWORD Temp_Cels 1 100 -3549.940 3003.560 FORMAT "%8.3" ECU_ADDRESS 0x60004A38 /end MEASUREMENT
/begin MEASUREMENT ExhMod_tExhCat2UsB1 "exhaust gas temperature catalyst 2 upstream" SWORD Temp_Cels 1 100 -3549.940 3003.560 FORMAT "%8.3" ECU_ADDRESS 0x60004A36 /end MEASUREMENT
/begin MEASUREMENT ExhMod_tExhCatDsAryB1 "Array exhaustgas temperature downstream catalysts" SWORD Temp_Cels 1 100 -3549.940 3003.560 FORMAT "%8.3" ARRAY_SIZE 2 ECU_ADDRESS 0x60004A32 /end MEASUREMENT
/begin MEASUREMENT ExhMod_tExhCatUsAryB1 "Array exhaustgas temperature upstream catalysts" SWORD Temp_Cels 1 100 -3549.940 3003.560 FORMAT "%8.3" ARRAY_SIZE 2 ECU_ADDRESS 0x60004A2E /end MEASUREMENT
/begin MEASUREMENT ExhMod_tExhDsVlvB1 "Exhaust gas temperature downstream exhaust valve, modelled" SWORD Temp_Cels 1 100 -3549.940 3003.560 FORMAT "%8.3" ECU_ADDRESS 0x60004A2C /end MEASUREMENT
/begin MEASUREMENT ExhMod_tExhFrtPipB1 "Exhaust gas temperature downstream manifold" SWORD Temp_Cels 1 100 -3549.940 3003.560 FORMAT "%8.3" ECU_ADDRESS 0x60004A2A /end MEASUREMENT
/begin MEASUREMENT ExhMod_tExhMnfB1 "Exhaust gas temperature manifold, bank1" SWORD Temp_Cels 1 100 -3549.940 3003.560 FORMAT "%8.3" ECU_ADDRESS 0x60004A28 /end MEASUREMENT
/begin MEASUREMENT ExhMod_tExhMnfQstyB1 "Exhaust gas temperature in exhaust manifold (quasi steady state, high dynamic) - bank 1" SWORD Temp_Cels 1 100 -3549.940 3003.560 FORMAT "%8.3" ECU_ADDRESS 0x60004A26 /end MEASUREMENT
/begin MEASUREMENT ExhMod_tExhS1B1 "exhaust gas temperature sensor 1" SWORD Temp_Cels 1 100 -3549.940 3003.560 FORMAT "%8.3" ECU_ADDRESS 0x60004A24 /end MEASUREMENT
/begin MEASUREMENT ExhMod_tExhS2B1 "exhaust gas temperature sensor 2" SWORD Temp_Cels 1 100 -3549.940 3003.560 FORMAT "%8.3" ECU_ADDRESS 0x60004A22 /end MEASUREMENT
/begin MEASUREMENT ExhMod_tExhSnsrAryB1 "exhaust gas temperature array sensors" SWORD Temp_Cels 1 100 -3549.940 3003.560 FORMAT "%8.3" ARRAY_SIZE 2 ECU_ADDRESS 0x60004A1E /end MEASUREMENT
/begin MEASUREMENT ExhMod_tExhVlvB1 "exhaust temperature valve bank 1" SWORD Temp_Cels 1 100 -3549.940 3003.560 FORMAT "%8.3" ECU_ADDRESS 0x60004A18 /end MEASUREMENT
/begin MEASUREMENT ExhMod_tExhVlvCorrdB1 "Corrected temperature at the exhaust valve bank 1" UWORD temp_q0p0234_o273 1 100 -273.150 1262.827 FORMAT "%8.3" ECU_ADDRESS 0x60003854 /end MEASUREMENT
/begin MEASUREMENT ExhMod_tExhVlvCorrdFildB1 "exhaust temperature valve filtered bank 1" UWORD temp_q0p0234_o273 1 100 -273.150 1262.827 FORMAT "%8.3" ECU_ADDRESS 0x60003852 /end MEASUREMENT
/begin MEASUREMENT ExhMod_tExhVlvCorrdIgnAgB1 "exhaust temperature valve with ignition angle correction bank 1" UWORD temp_q0p0234_o273 1 100 -273.150 1262.827 FORMAT "%8.3" ECU_ADDRESS 0x60003850 /end MEASUREMENT
/begin MEASUREMENT ExhMod_tExhVlvCorrdLamThrB1 "exhaust temperature valve with lambda or throttle correction bank 1" UWORD temp_q0p0234_o273 1 100 -273.150 1262.827 FORMAT "%8.3" ECU_ADDRESS 0x6000384E /end MEASUREMENT
/begin MEASUREMENT ExhMod_tExhVlvHomB1 "exhaust temperature valve homogenous mode bank 1" UWORD temp_q0p0234_o273 1 100 -273.150 1262.827 FORMAT "%8.3" ECU_ADDRESS 0x6000384C /end MEASUREMENT
/begin MEASUREMENT ExhMod_tExhVlvIntkAir "Intake air temperature for the modelling of the temperature at exhaust valve" SWORD Temp_Cels 1 100 -3549.940 3003.560 FORMAT "%8.3" ECU_ADDRESS 0x6000384A /end MEASUREMENT
/begin MEASUREMENT ExhMod_tiEngOff "engine off time" UWORD t_q1 1 100 0.00 65535.00 FORMAT "%8.2" ECU_ADDRESS 0x600048BA /end MEASUREMENT
/begin MEASUREMENT ExhMod_tiEngOffCorrn "correction engine off time" UWORD t_q1 1 100 0.00 65535.00 FORMAT "%8.2" ECU_ADDRESS 0x600365A0 /end MEASUREMENT
/begin MEASUREMENT ExhMod_tiSigHoldEngRunng "Internal timer ExhMod_TiEngOff" UBYTE t_q0p05 1 100 0.00 12.75 FORMAT "%5.2" ECU_ADDRESS 0x6000648D /end MEASUREMENT
/begin MEASUREMENT ExhMod_tiStrtEndOff "." UWORD t_q1 1 100 0.00 65535.00 FORMAT "%8.2" ECU_ADDRESS 0x600365AE /end MEASUREMENT
/begin MEASUREMENT ExhMod_tiStrtEndOffLoc "." UWORD t_q1 1 100 0.00 65535.00 FORMAT "%8.2" ECU_ADDRESS 0x6000383E /end MEASUREMENT
/begin MEASUREMENT ExhMod_tQstyExhVlvB1 "Quasi-stationary gas temperature at the exhaust valve bank 1" UWORD temp_q0p0234_o273 1 100 -273.150 1262.827 FORMAT "%8.3" ECU_ADDRESS 0x60003848 /end MEASUREMENT
/begin MEASUREMENT ExhMod_tWallAryB1 "wall temperature array" SWORD Temp_Cels 1 100 -3549.940 3003.560 FORMAT "%8.3" ARRAY_SIZE 13 ECU_ADDRESS 0x50005AA4 /end MEASUREMENT
/begin MEASUREMENT ExhMod_tWallCat1B1 "Wall temperature at the Middle brick of catalyst1 bank1" SWORD Temp_Cels 1 100 -3549.940 3003.560 FORMAT "%8.3" ECU_ADDRESS 0x60004A16 /end MEASUREMENT
/begin MEASUREMENT ExhMod_tWallCat1EndB1 "Wall temperature at the End brick of catalyst1 bank1" SWORD Temp_Cels 1 100 -3549.940 3003.560 FORMAT "%8.3" ECU_ADDRESS 0x60004A14 /end MEASUREMENT
/begin MEASUREMENT ExhMod_tWallCat1InB1 "Wall temperature at the start brick of catalyst1 bank1" SWORD Temp_Cels 1 100 -3549.940 3003.560 FORMAT "%8.3" ECU_ADDRESS 0x60004A12 /end MEASUREMENT
/begin MEASUREMENT ExhMod_tWallCat2B1 "Wall temperature at the Middle brick of catalyst2 bank1" SWORD Temp_Cels 1 100 -3549.940 3003.560 FORMAT "%8.3" ECU_ADDRESS 0x60004A10 /end MEASUREMENT
/begin MEASUREMENT ExhMod_tWallCat2EndB1 "Wall temperature at the End brick of catalyst2 bank1" SWORD Temp_Cels 1 100 -3549.940 3003.560 FORMAT "%8.3" ECU_ADDRESS 0x60004A0E /end MEASUREMENT
/begin MEASUREMENT ExhMod_tWallCat2InB1 "Wall temperature at the start brick of catalyst2 bank1" SWORD Temp_Cels 1 100 -3549.940 3003.560 FORMAT "%8.3" ECU_ADDRESS 0x60004A0C /end MEASUREMENT
/begin MEASUREMENT ExhMod_tWallMnfB1 "Wall temperature manifold" SWORD Temp_Cels 1 100 -3549.940 3003.560 FORMAT "%8.3" ECU_ADDRESS 0x60004A0A /end MEASUREMENT
/begin MEASUREMENT ExhMod_tWallNvAryB1 "wall temperatures array (not volatile) bank 1" UWORD temp_q0p0234_o273 1 100 -273.150 1262.827 FORMAT "%8.3" ARRAY_SIZE 13 ECU_ADDRESS 0x60036586 /end MEASUREMENT
/begin MEASUREMENT ExhMod_tWallS1B1 "wall temperature sensor 1" SWORD Temp_Cels 1 100 -3549.940 3003.560 FORMAT "%8.3" ECU_ADDRESS 0x60004A08 /end MEASUREMENT
/begin MEASUREMENT ExhMod_tWallS2B1 "wall temperature sensor 2" SWORD Temp_Cels 1 100 -3549.940 3003.560 FORMAT "%8.3" ECU_ADDRESS 0x60004A06 /end MEASUREMENT
/begin MEASUREMENT ExhMod_tWallSnsrAryB1 "wall temperature array sensors" SWORD Temp_Cels 1 100 -3549.940 3003.560 FORMAT "%8.3" ARRAY_SIZE 2 ECU_ADDRESS 0x50005ABE /end MEASUREMENT
/begin MEASUREMENT ExhMod_uCat1DsB1 "Sensor voltage downstream catalyst1 bank1" UWORD spg_q0p00488 1 100 0.00 319.9951 FORMAT "%8.4" ECU_ADDRESS 0x60004CC4 /end MEASUREMENT
/begin MEASUREMENT FanCtl_bTrqResvFan1 "Triggering of Torque Reserve for Fan 1 running" UBYTE B_TRUE 1 100 0.00 1.00000000000 BIT_MASK 0x1 FORMAT "%13.11" ECU_ADDRESS 0x60009F9D /end MEASUREMENT
/begin MEASUREMENT FanCtl_bTrqResvFan2 "Triggering of Torque Reserve for Fan 2 running" UBYTE B_TRUE 1 100 0.00 1.00000000000 BIT_MASK 0x1 FORMAT "%13.11" ECU_ADDRESS 0x60009F9C /end MEASUREMENT
/begin MEASUREMENT FanCtl_cntrReIni "post drive state counter" UBYTE OneToOne 1 100 0.00 255.0 FORMAT "%5.1" ECU_ADDRESS 0x60006484 /end MEASUREMENT
/begin MEASUREMENT FanCtl_flgACGOn "ACG On status flag from Fan module" UBYTE B_TRUE 1 100 0.00 1.00000000000 BIT_MASK 0x1 FORMAT "%13.11" ECU_ADDRESS 0x60009F9B /end MEASUREMENT
/begin MEASUREMENT FanCtl_flgActvCooltTHi "Flag for coolant temperature high status active" UBYTE B_TRUE 1 100 0.00 1.00000000000 BIT_MASK 0x1 FORMAT "%13.11" ECU_ADDRESS 0x60006483 /end MEASUREMENT
/begin MEASUREMENT FanCtl_flgActvCooltTLo "Flag for coolant temperature Low status active" UBYTE B_TRUE 1 100 0.00 1.00000000000 BIT_MASK 0x1 FORMAT "%13.11" ECU_ADDRESS 0x60006482 /end MEASUREMENT
/begin MEASUREMENT FanCtl_flgActvSpdOld "Previous flag of FanCtl demand of vehicle speed" UBYTE B_TRUE 1 100 0.00 1.00000000000 BIT_MASK 0x1 FORMAT "%13.11" ECU_ADDRESS 0x60006481 /end MEASUREMENT
/begin MEASUREMENT FanCtl_flgAftRunActv "fan afterrun active" UBYTE B_TRUE 1 100 0.00 1.00000000000 BIT_MASK 0x1 FORMAT "%13.11" ECU_ADDRESS 0x60009F9A /end MEASUREMENT
/begin MEASUREMENT FanCtl_flgAntiFlickActv "Flag of anti headlight flicker active" UBYTE B_TRUE 1 100 0.00 1.00000000000 BIT_MASK 0x1 FORMAT "%13.11" ECU_ADDRESS 0x60009F99 /end MEASUREMENT
/begin MEASUREMENT FanCtl_flgAntiFlickHiStg "Flag of anti headlight flicker affect to high stage output status" UBYTE B_TRUE 1 100 0.00 1.00000000000 BIT_MASK 0x1 FORMAT "%13.11" ECU_ADDRESS 0x60009F98 /end MEASUREMENT
/begin MEASUREMENT FanCtl_flgFailActn "Failsafe action enable flag" UBYTE B_TRUE 1 100 0.00 1.00000000000 BIT_MASK 0x1 FORMAT "%13.11" ECU_ADDRESS 0x60006480 /end MEASUREMENT
/begin MEASUREMENT FanCtl_flgFanCooltPHiSts "Flag for coolant pressure high status" UBYTE B_TRUE 1 100 0.00 1.00000000000 BIT_MASK 0x1 FORMAT "%13.11" ECU_ADDRESS 0x6000647F /end MEASUREMENT
/begin MEASUREMENT FanCtl_flgFanCooltPLoSts "Flag for Coolant pressure low status" UBYTE B_TRUE 1 100 0.00 1.00000000000 BIT_MASK 0x1 FORMAT "%13.11" ECU_ADDRESS 0x6000647E /end MEASUREMENT
/begin MEASUREMENT FanCtl_flgHiDlyCtrlProhbSts "Flag for High delay prohibition demand status" UBYTE B_TRUE 1 100 0.00 1.00000000000 BIT_MASK 0x1 FORMAT "%13.11" ECU_ADDRESS 0x6000647D /end MEASUREMENT
/begin MEASUREMENT FanCtl_flgHiStgSt "Flag for High stage output status" UBYTE B_TRUE 1 100 0.00 1.00000000000 BIT_MASK 0x1 FORMAT "%13.11" ECU_ADDRESS 0x6000647C /end MEASUREMENT
/begin MEASUREMENT FanCtl_flgIdleStopCdn "Idle stop condition for selection of fan state" UBYTE B_TRUE 1 100 0.00 1.00000000000 BIT_MASK 0x1 FORMAT "%13.11" ECU_ADDRESS 0x6000647B /end MEASUREMENT
/begin MEASUREMENT FanCtl_flgImdtHiStg "Flag for Immediate High stage from OFF stage status" UBYTE B_TRUE 1 100 0.00 1.00000000000 BIT_MASK 0x1 FORMAT "%13.11" ECU_ADDRESS 0x6000647A /end MEASUREMENT
/begin MEASUREMENT FanCtl_flgLowStgSt "Flag for Low stage output status" UBYTE B_TRUE 1 100 0.00 1.00000000000 BIT_MASK 0x1 FORMAT "%13.11" ECU_ADDRESS 0x60006479 /end MEASUREMENT
/begin MEASUREMENT FanCtl_flgXPostDrv_mp "Request for ECU afterrun from fan control" UBYTE B_TRUE 1 100 0.00 1.00000000000 BIT_MASK 0x1 FORMAT "%13.11" ECU_ADDRESS 0x70008D75 /end MEASUREMENT
/begin MEASUREMENT FanCtl_pClnt "Coolant pressure for Fan control." SWORD RBPtCel_p_1p0_3 1 100 -32768.00 32767.00 FORMAT "%8.2" ECU_ADDRESS 0x6000381A /end MEASUREMENT
/begin MEASUREMENT FanCtl_rFan1 "Desired fan 1 speed ratio" SWORD Prc 1 100 -400.0000 399.9878 FORMAT "%8.4" ECU_ADDRESS 0x60003818 /end MEASUREMENT
/begin MEASUREMENT FanCtl_rFan2 "Desired fan 2 speed ratio" SWORD Prc 1 100 -400.0000 399.9878 FORMAT "%8.4" ECU_ADDRESS 0x60003816 /end MEASUREMENT
/begin MEASUREMENT FanCtl_rPDpdtDutyPerd "Fan duty period based on Coolant pressure and temperature" SWORD Prc 1 100 -400.0000 399.9878 FORMAT "%8.4" ECU_ADDRESS 0x60004A04 /end MEASUREMENT
/begin MEASUREMENT FanCtl_rPTDpdtDutyPerd "Fan Duty period value based on coolant pressure and temperature" SWORD Prc 1 100 -400.0000 399.9878 FORMAT "%8.4" ECU_ADDRESS 0x60004A02 /end MEASUREMENT
/begin MEASUREMENT FanCtl_rTDpdtDutyPerd "Fan Duty period based on coolant temperature value" SWORD Prc 1 100 -400.0000 399.9878 FORMAT "%8.4" ECU_ADDRESS 0x60004A00 /end MEASUREMENT
/begin MEASUREMENT FanCtl_st "Status of fan activation" UBYTE OneToOne 1 100 0.00 255.0 FORMAT "%5.1" ECU_ADDRESS 0x6000A04B /end MEASUREMENT
/begin MEASUREMENT FanCtl_stActvHi_MP "Status of Fan High Activation." UBYTE B_TRUE 1 100 0.00 1.00000000000 BIT_MASK 0x1 FORMAT "%13.11" ECU_ADDRESS 0x70008D74 /end MEASUREMENT
/begin MEASUREMENT FanCtl_stActvLo_MP "Status of Fan Low Activation." UBYTE B_TRUE 1 100 0.00 1.00000000000 BIT_MASK 0x1 FORMAT "%13.11" ECU_ADDRESS 0x70008D73 /end MEASUREMENT
/begin MEASUREMENT FanCtl_stCooltPHiCtrlHys "Coolant pressure high control hysteresis output status" UBYTE B_TRUE 1 100 0.00 1.00000000000 BIT_MASK 0x1 FORMAT "%13.11" ECU_ADDRESS 0x60006478 /end MEASUREMENT
/begin MEASUREMENT FanCtl_stCooltPLoCtrlHys "Low Coolant pressure for E-Com hysteresis output status" UBYTE B_TRUE 1 100 0.00 1.00000000000 BIT_MASK 0x1 FORMAT "%13.11" ECU_ADDRESS 0x60006477 /end MEASUREMENT
/begin MEASUREMENT FanCtl_stCooltPProhbHysOutp "Coolant pressure prohibition demand hysteresis output status" UBYTE B_TRUE 1 100 0.00 1.00000000000 BIT_MASK 0x1 FORMAT "%13.11" ECU_ADDRESS 0x60006476 /end MEASUREMENT
/begin MEASUREMENT FanCtl_stFanDecel_MP "Measurement point for fan deceleration status" UBYTE B_TRUE 1 100 0.00 1.00000000000 BIT_MASK 0x1 FORMAT "%13.11" ECU_ADDRESS 0x70008D72 /end MEASUREMENT
/begin MEASUREMENT FanCtl_stFanRlyCtrl_MP "Status for fan relay control" UBYTE B_TRUE 1 100 0.00 1.00000000000 BIT_MASK 0x1 FORMAT "%13.11" ECU_ADDRESS 0x70008D71 /end MEASUREMENT
/begin MEASUREMENT FanCtl_stHiModDutyPred_MP "Status of high mod fan duty period calculation" UBYTE OneToOne 1 100 0.00 255.0 FORMAT "%5.1" ECU_ADDRESS 0x70008D70 /end MEASUREMENT
/begin MEASUREMENT FanCtl_stLoModDutyPred_MP "Status of low mode fan duty period calculation" UBYTE OneToOne 1 100 0.00 255.0 FORMAT "%5.1" ECU_ADDRESS 0x70008D6F /end MEASUREMENT
/begin MEASUREMENT FanCtl_stMidModDutyPred_MP "Status of Mid mode fan duty period calculation" UBYTE OneToOne 1 100 0.00 255.0 FORMAT "%5.1" ECU_ADDRESS 0x70008D6E /end MEASUREMENT
/begin MEASUREMENT FanCtl_stMod "Status of Fan control mode" UBYTE OneToOne 1 100 0.00 255.0 FORMAT "%5.1" ECU_ADDRESS 0x60006475 /end MEASUREMENT
/begin MEASUREMENT FanCtl_stModSelnSpdHi_MP "Status of high speed mode selection" UBYTE B_TRUE 1 100 0.00 1.00000000000 BIT_MASK 0x1 FORMAT "%13.11" ECU_ADDRESS 0x70008D6D /end MEASUREMENT
/begin MEASUREMENT FanCtl_stModSelnSpdLo_MP "Status of low speed mode selection" UBYTE B_TRUE 1 100 0.00 1.00000000000 BIT_MASK 0x1 FORMAT "%13.11" ECU_ADDRESS 0x70008D6C /end MEASUREMENT
/begin MEASUREMENT FanCtl_stPDpdtDutyHiDmd "Status of pressure dependent duty period high demand" UBYTE B_TRUE 1 100 0.00 1.00000000000 BIT_MASK 0x1 FORMAT "%13.11" ECU_ADDRESS 0x60009F96 /end MEASUREMENT
/begin MEASUREMENT FanCtl_stSpd_mp "Measureing point for FanCtl demand of vehicle speed" UBYTE OneToOne 1 100 0.00 255.0 FORMAT "%5.1" ECU_ADDRESS 0x70008D6B /end MEASUREMENT
/begin MEASUREMENT FanCtl_stStg "Fan stage selection status" UBYTE OneToOne 1 100 0.00 255.0 FORMAT "%5.1" ECU_ADDRESS 0x6000A04A /end MEASUREMENT
/begin MEASUREMENT FanCtl_stTDpdtDutyHiDmd "Status of temperature dependent duty period high demand" UBYTE B_TRUE 1 100 0.00 1.00000000000 BIT_MASK 0x1 FORMAT "%13.11" ECU_ADDRESS 0x60009F95 /end MEASUREMENT
/begin MEASUREMENT FanCtl_stTDpdtDutyPerd_MP "Status of temperature dependent duty period." UBYTE OneToOne 1 100 0.00 255.0 FORMAT "%5.1" ECU_ADDRESS 0x70008D6A /end MEASUREMENT
/begin MEASUREMENT FanCtl_stThrIdle "Status of throttle idle" UBYTE B_TRUE 1 100 0.00 1.00000000000 BIT_MASK 0x1 FORMAT "%13.11" ECU_ADDRESS 0x60006474 /end MEASUREMENT
/begin MEASUREMENT FanCtl_swtTW2SnsrAvl "Switch when TW2 sensor available" UBYTE B_TRUE 1 100 0.00 1.00000000000 BIT_MASK 0x1 FORMAT "%13.11" ECU_ADDRESS 0x60009F94 /end MEASUREMENT
/begin MEASUREMENT FanCtl_tClnt "Coolant temperature for fan control" SWORD Temp_Cels 1 100 -3549.940 3003.560 FORMAT "%8.3" ECU_ADDRESS 0x600049FE /end MEASUREMENT
/begin MEASUREMENT FanCtl_tCooltT "Coolant temperature which is used for FanCtl demand of coolant temperature" SWORD Temp_Cels 1 100 -3549.940 3003.560 FORMAT "%8.3" ECU_ADDRESS 0x60003814 /end MEASUREMENT
/begin MEASUREMENT FanCtl_tiAftRunRmn "remaining fan afterrun time" SWORD TimeEngOn 1 100 -32768.00 32767.00 FORMAT "%8.2" ECU_ADDRESS 0x600340C4 /end MEASUREMENT
/begin MEASUREMENT FanCtl_tiAR1S_mp "Timer value to measure 1 sec for AfterRun" SWORD Time_s 1 100 -327.6800 327.6700 FORMAT "%8.4" ECU_ADDRESS 0x70008D68 /end MEASUREMENT
/begin MEASUREMENT FanCtl_tiSpdDiffTmr "SW timer value for FanCtl deman of Speed" SWORD Time_s 1 100 -327.6800 327.6700 FORMAT "%8.4" ECU_ADDRESS 0x60003812 /end MEASUREMENT
/begin MEASUREMENT FanCtl_uBlowrFanU "Blower fan voltage for fan control" SWORD RBPtCel_u_0p05_1 1 100 0.00 1638.350 FORMAT "%8.3" ECU_ADDRESS 0x60003810 /end MEASUREMENT
/begin MEASUREMENT Fans_trqCons "Torque consumed by Fan" SWORD Trq 1 100 -3276.800 3276.700 FORMAT "%8.3" ECU_ADDRESS 0x6000E254 /end MEASUREMENT
/begin MEASUREMENT Fans_trqConsFan1_MP "Filtered Static Torque Consumed for Fan 1" SWORD Trq 1 100 -3276.800 3276.700 FORMAT "%8.3" ECU_ADDRESS 0x70008D66 /end MEASUREMENT
/begin MEASUREMENT Fans_trqConsFan2_MP "Filtered Static Torque Consumed for Fan 2" SWORD Trq 1 100 -3276.800 3276.700 FORMAT "%8.3" ECU_ADDRESS 0x70008D64 /end MEASUREMENT
/begin MEASUREMENT Fans_trqConsUnFltFan1_MP "Unfiltered Static Torque Consumed for Fan 1" SWORD Trq 1 100 -3276.800 3276.700 FORMAT "%8.3" ECU_ADDRESS 0x70008D62 /end MEASUREMENT
/begin MEASUREMENT Fans_trqConsUnFltFan2_MP "Unfiltered Static Torque Consumed for Fan 2" SWORD Trq 1 100 -3276.800 3276.700 FORMAT "%8.3" ECU_ADDRESS 0x70008D60 /end MEASUREMENT
/begin MEASUREMENT Fans_trqResv "Torque reserve for cooling fan" SWORD Trq 1 100 -3276.800 3276.700 FORMAT "%8.3" ECU_ADDRESS 0x600049FA /end MEASUREMENT
/begin MEASUREMENT Fans_trqResvFan1_MP "Filtered Static Torque Reserve for Fan 1" SWORD Trq 1 100 -3276.800 3276.700 FORMAT "%8.3" ECU_ADDRESS 0x70008D5E /end MEASUREMENT
/begin MEASUREMENT Fans_trqResvFan2_MP "Filtered Static Torque Reserve for Fan 2" SWORD Trq 1 100 -3276.800 3276.700 FORMAT "%8.3" ECU_ADDRESS 0x70008D5C /end MEASUREMENT
/begin MEASUREMENT Fans_trqResvUnFltFan1_MP "Unfiltered Static Torque Reserve for Fan 1" SWORD Trq 1 100 -3276.800 3276.700 FORMAT "%8.3" ECU_ADDRESS 0x70008D5A /end MEASUREMENT
/begin MEASUREMENT Fans_trqResvUnFltFan2_MP "Unfiltered Static Torque Reserve for Fan 2" SWORD Trq 1 100 -3276.800 3276.700 FORMAT "%8.3" ECU_ADDRESS 0x70008D58 /end MEASUREMENT
/begin MEASUREMENT lamsbg_wloc "Desired Lambda limitation (word)" UWORD fak_uw_b16 1 100 0.00 15.99976 FORMAT "%8.5" ECU_ADDRESS 0x60003826 /end MEASUREMENT
/begin MEASUREMENT O2St_CalcnOscCorrnCat1B1_I.flgO2StrCalcd "Oxygen Storage Capacity correction for catalyst 1,bank 1 / oxygen storage capacity measured" UBYTE B_TRUE 1 100 0.00 1.00000000000 BIT_MASK 0x1 FORMAT "%13.11" ECU_ADDRESS 0x50001820 /end MEASUREMENT
/begin MEASUREMENT O2St_CalcnOscCorrnCat1B1_I.flgRoscMeasd "Oxygen Storage Capacity correction for catalyst 1,bank 1 / rich gas storage capacity measured" UBYTE B_TRUE 1 100 0.00 1.00000000000 BIT_MASK 0x1 FORMAT "%13.11" ECU_ADDRESS 0x50001821 /end MEASUREMENT
/begin MEASUREMENT O2St_CalcnOscCorrnCat1B1_I.mOscMeasd "Oxygen Storage Capacity correction for catalyst 1,bank 1 / oxygen storage capacity" ULONG m_q0p1_mg 1 100 0.00 429496729.500 FORMAT "%13.3" ECU_ADDRESS 0x50001824 /end MEASUREMENT
/begin MEASUREMENT O2St_CalcnOscCorrnCat1B1_I.mRoscMeasd "Oxygen Storage Capacity correction for catalyst 1,bank 1 / rich gas storage capacity" ULONG m_q0p1_mg 1 100 0.00 429496729.500 FORMAT "%13.3" ECU_ADDRESS 0x50001828 /end MEASUREMENT
/begin MEASUREMENT O2St_CalcnOscCurrExtd_I.mOscCurr "calculation for conversion of ROSCOSC / oxygen storage capacity" ULONG m_q0p1_mg 1 100 0.00 429496729.500 FORMAT "%13.3" ECU_ADDRESS 0x5000182C /end MEASUREMENT
/begin MEASUREMENT O2St_CalcnRichLeanCat1B1_I.flgEmptyO2 "calculation catalyst 1 full or empty / Flag catalyst is exhausted of oxygen" UBYTE B_TRUE 1 100 0.00 1.00000000000 BIT_MASK 0x1 FORMAT "%13.11" ECU_ADDRESS 0x50005488 /end MEASUREMENT
/begin MEASUREMENT O2St_CalcnRichLeanCat1B1_I.flgFullO2 "calculation catalyst 1 full or empty / Flag catalyst is filled with oxygen" UBYTE B_TRUE 1 100 0.00 1.00000000000 BIT_MASK 0x1 FORMAT "%13.11" ECU_ADDRESS 0x50005489 /end MEASUREMENT
/begin MEASUREMENT O2St_CalcnRichLeanCat1B1_I.flgInpMfLean "calculation catalyst 1 full or empty / Flag input mass flow lean catalyst" UBYTE B_TRUE 1 100 0.00 1.00000000000 BIT_MASK 0x1 FORMAT "%13.11" ECU_ADDRESS 0x5000548A /end MEASUREMENT
/begin MEASUREMENT O2St_CalcnRichLeanCat1B1_I.flgInpMfRich "calculation catalyst 1 full or empty / Flag input mass flow rich catalyst" UBYTE B_TRUE 1 100 0.00 1.00000000000 BIT_MASK 0x1 FORMAT "%13.11" ECU_ADDRESS 0x5000548B /end MEASUREMENT
/begin MEASUREMENT O2St_CalcnRichLeanCat1B1_I.flgUMonoAsc "calculation catalyst 1 full or empty / Flag sensor voltage rises monetary downstream catalyst" UBYTE B_TRUE 1 100 0.00 1.00000000000 BIT_MASK 0x1 FORMAT "%13.11" ECU_ADDRESS 0x5000548C /end MEASUREMENT
/begin MEASUREMENT O2St_CalcnRichLeanCat1B1_I.flgUSensHi "calculation catalyst 1 full or empty / Flag sensor voltage is greater than threshold downstream catalyst" UBYTE B_TRUE 1 100 0.00 1.00000000000 BIT_MASK 0x1 FORMAT "%13.11" ECU_ADDRESS 0x5000548D /end MEASUREMENT
/begin MEASUREMENT O2St_CalcnRichLeanCat1B1_I.flgUSensLo "calculation catalyst 1 full or empty / Flag sensor voltage is lower than threshold downstream catalyst" UBYTE B_TRUE 1 100 0.00 1.00000000000 BIT_MASK 0x1 FORMAT "%13.11" ECU_ADDRESS 0x5000548E /end MEASUREMENT
/begin MEASUREMENT O2St_CalcnRichLeanCat1B1_I.uSensMax "calculation catalyst 1 full or empty / Maximum mesured voltage as interim value for evalutation of the slope of sensor voltage downstream of catalyst" UWORD spg_uw_q0p00488 1 100 0.00 319.9951 FORMAT "%8.4" ECU_ADDRESS 0x50005490 /end MEASUREMENT
/begin MEASUREMENT O2St_CalcnRichLeanCat1B1_I.uSensRef "calculation catalyst 1 full or empty / Reference value for evaluation of the sensor voltage downstream catalyst" UWORD spg_uw_q0p00488 1 100 0.00 319.9951 FORMAT "%8.4" ECU_ADDRESS 0x50005492 /end MEASUREMENT
/begin MEASUREMENT O2St_CalcnSensDynCorrn.flgCorrnPlausDsCat "Calculation of sensor dynamic correction of the OSCROSC measurement and plausibility of correction . / Flag sensor dynamic correction of measurement storage capability is plausible for sensor downstream catalyst" UBYTE B_TRUE 1 100 0.00 1.00000000000 BIT_MASK 0x1 FORMAT "%13.11" ECU_ADDRESS 0x50001830 /end MEASUREMENT
/begin MEASUREMENT O2St_CalcnSensDynCorrn.flgCorrnPlausUsCat "Calculation of sensor dynamic correction of the OSCROSC measurement and plausibility of correction . / Flag sensor dynamic correction of measurement storage capability is plausible for sensor upstream catalyst" UBYTE B_TRUE 1 100 0.00 1.00000000000 BIT_MASK 0x1 FORMAT "%13.11" ECU_ADDRESS 0x50001831 /end MEASUREMENT
/begin MEASUREMENT O2St_CalcnSensDynCorrn.mO2CorrnDsCat "Calculation of sensor dynamic correction of the OSCROSC measurement and plausibility of correction . / Correction of OSC-ROSC-measurement for sensor dynamic correction of sensor downstream catalyst" SLONG m_q0p2_mg 1 100 -429496729.600 429496729.400 FORMAT "%13.3" ECU_ADDRESS 0x50001834 /end MEASUREMENT
/begin MEASUREMENT O2St_CalcnSensDynCorrn.mO2CorrnUsCat "Calculation of sensor dynamic correction of the OSCROSC measurement and plausibility of correction . / Correction of OSC-ROSC-measurement for sensor dynamic correction of sensor upstream catalyst" SLONG m_q0p2_mg 1 100 -429496729.600 429496729.400 FORMAT "%13.3" ECU_ADDRESS 0x50001838 /end MEASUREMENT
/begin MEASUREMENT O2St_CalcnSlopOIntglCat1B1_I.mO2IntglSlopDsCat1 "Slope of Oxygen integral for OSC measurement of catalyst 1 bank 1 / Slope of oxygen-integral OSC-ROSC-measurement for sensor dynamic correction of the sensor downstream catalyst 1" SLONG m_q0p2_mg_DIV_s 1 100 -429496729.600 429496729.400 FORMAT "%13.3" ECU_ADDRESS 0x5000183C /end MEASUREMENT
/begin MEASUREMENT O2St_CalcnSlopOIntglCat1B1_I.mO2IntglSlopUsCat1 "Slope of Oxygen integral for OSC measurement of catalyst 1 bank 1 / Slope of oxygen-integral OSC-ROSC-measurement for sensor dynamic correction of the sensor upstream catalyst 1" SLONG m_q0p2_mg_DIV_s 1 100 -429496729.600 429496729.400 FORMAT "%13.3" ECU_ADDRESS 0x50001840 /end MEASUREMENT
/begin MEASUREMENT O2St_CalcnSlopOIntglCat1B1_I.oxsbuf_l "Slope of Oxygen integral for OSC measurement of catalyst 1 bank 1 / buffer" SLONG m_q0p2_mg 1 100 -429496729.600 429496729.400 FORMAT "%13.3" ARRAY_SIZE 6 ECU_ADDRESS 0x50001844 /end MEASUREMENT
/begin MEASUREMENT O2St_CalcnSlopOIntglCat1B1_I.oxscounter "Slope of Oxygen integral for OSC measurement of catalyst 1 bank 1 / counter" UWORD dez 1 100 0.00 65535.00 FORMAT "%8.2" ECU_ADDRESS 0x5000185C /end MEASUREMENT
/begin MEASUREMENT O2St_CalcnSlopOIntglCat1B1_I.pointer "Slope of Oxygen integral for OSC measurement of catalyst 1 bank 1 / pointer" UBYTE dez 1 100 0.00 255.0 FORMAT "%5.1" ECU_ADDRESS 0x5000185E /end MEASUREMENT
/begin MEASUREMENT O2St_CalcnUMaxBefOscCat1B1_I.uCatDsMax "Maximum voltage of downstream sensor before OSC measurement for catalyst 1,bank 1 / max. voltage" UWORD spg_uw_q0p00488 1 100 0.00 319.9951 FORMAT "%8.4" ECU_ADDRESS 0x60003876 /end MEASUREMENT
/begin MEASUREMENT O2St_CatEnaCdnCat1B1_I.ExhMod_flgIntHLR_I.hysterese "condition for readiness for Osc measurement catalyst 1 bank 1 / low pass filter exhaust gas mass flow / Current value of the hysteresis" UBYTE B_TRUE 1 100 0.00 1.00000000000 BIT_MASK 0x1 FORMAT "%13.11" ECU_ADDRESS 0x50001860 /end MEASUREMENT
/begin MEASUREMENT O2St_CatEnaCdnCat1B1_I.ExhMod_flgtempTON_I.buffer "condition for readiness for Osc measurement catalyst 1 bank 1 / approval catalyst temperature is within valid interval / Internal state of TurnOnDelay" UBYTE B_TRUE 1 100 0.00 1.00000000000 BIT_MASK 0x1 FORMAT "%13.11" ECU_ADDRESS 0x50001862 /end MEASUREMENT
/begin MEASUREMENT O2St_CatEnaCdnCat1B1_I.ExhMod_flgtempTON_I.time "condition for readiness for Osc measurement catalyst 1 bank 1 / approval catalyst temperature is within valid interval / Internal time of TurnOnDelay" UWORD t_q0p02 1 100 0.00 1310.700 FORMAT "%8.3" ECU_ADDRESS 0x50001864 /end MEASUREMENT
/begin MEASUREMENT O2St_CatEnaCdnCat1B1_I.ExhMod_msabLT_I.memory "condition for readiness for Osc measurement catalyst 1 bank 1 / approval catalyst temperature is within valid interval / current lowpass value" ULONG mgrad_q1p526Em6_kg_DIV_h 1 100 0.00 6553.59999847 FORMAT "%13.8" ECU_ADDRESS 0x50001868 /end MEASUREMENT
/begin MEASUREMENT O2St_ChkPlausEndMeasCat1B1_I.flgMeasOsc "Plausiblity check for end of OSC measurement catalyst 1,bank 1 / Flag storage capability is measured momentarily catalyst" UBYTE B_TRUE 1 100 0.00 1.00000000000 BIT_MASK 0x1 FORMAT "%13.11" ECU_ADDRESS 0x50005498 /end MEASUREMENT
/begin MEASUREMENT O2St_ChkPlausEndMeasCat1B1_I.flgMeasOscPlaus "Plausiblity check for end of OSC measurement catalyst 1,bank 1 / Flag measurement of storage capability is plausible catalyst" UBYTE B_TRUE 1 100 0.00 1.00000000000 BIT_MASK 0x1 FORMAT "%13.11" ECU_ADDRESS 0x50005499 /end MEASUREMENT
/begin MEASUREMENT O2St_ChkPlausEndMeasCat1B1_I.ExhMod_flgmeasbreakTONV_I.outbit "Plausiblity check for end of OSC measurement catalyst 1,bank 1 / approval start OSC measurement / return value" UBYTE B_TRUE 1 100 0.00 1.00000000000 BIT_MASK 0x1 FORMAT "%13.11" ECU_ADDRESS 0x5000549A /end MEASUREMENT
/begin MEASUREMENT O2St_ChkPlausEndMeasCat1B1_I.ExhMod_flgmeasbreakTONV_I.time "Plausiblity check for end of OSC measurement catalyst 1,bank 1 / approval start OSC measurement / expired delay time" UWORD t_q0p02 1 100 0.00 1310.700 FORMAT "%8.3" ECU_ADDRESS 0x5000549C /end MEASUREMENT
/begin MEASUREMENT O2St_cntrOscCurrUpdCat1B1 "Counter for current OSC measurements since initialisation catalyst 1 bank 1" UBYTE dez 1 100 0.00 255.0 FORMAT "%5.1" ECU_ADDRESS 0x600365B1 /end MEASUREMENT
/begin MEASUREMENT O2St_dmAvrgCurrMeasCat1B1 "Average mass flow of current measurement storage capability catalyst 1 bank 1" UWORD m_uw_b6553p5 1 100 0.00 6553.500 FORMAT "%8.3" ECU_ADDRESS 0x60003894 /end MEASUREMENT
/begin MEASUREMENT O2St_dmAvrgMeasCurrCat1B1 "Average mass flow of current measurement storage capability catalyst 1 bank 1" UWORD m_uw_b6553p5 1 100 0.00 6553.500 FORMAT "%8.3" ECU_ADDRESS 0x6000D93C /end MEASUREMENT
/begin MEASUREMENT O2St_dmIntglUsCat1B1 "integrated mass flow upstream catalyst 1 bank 1" UWORD m_q0p0277_g 1 100 0.00 1820.417 FORMAT "%8.3" ECU_ADDRESS 0x6000D93E /end MEASUREMENT
/begin MEASUREMENT O2St_flgClr "execution of DSM_CLEAR" UBYTE B_TRUE 1 100 0.00 1.00000000000 BIT_MASK 0x1 FORMAT "%13.11" ECU_ADDRESS 0x600064A3 /end MEASUREMENT
/begin MEASUREMENT O2St_flgCorrnPlausDsCat1B1 "Flag sensor dynamic correction of measurement storage capability is plausible for sensor downstream catalyst 1 bank 1" UBYTE B_TRUE 1 100 0.00 1.00000000000 BIT_MASK 0x1 FORMAT "%13.11" ECU_ADDRESS 0x600064A2 /end MEASUREMENT
/begin MEASUREMENT O2St_flgCorrnPlausUsCat1B1 "Flag sensor dynamic correction of measurement storage capability is plausible for sensor upstream catalyst 1 bank 1" UBYTE B_TRUE 1 100 0.00 1.00000000000 BIT_MASK 0x1 FORMAT "%13.11" ECU_ADDRESS 0x600064A1 /end MEASUREMENT
/begin MEASUREMENT O2St_flgEnagMeas "Flag general enabling condition for measurement of oxygen storage capability" UBYTE B_TRUE 1 100 0.00 1.00000000000 BIT_MASK 0x1 FORMAT "%13.11" ECU_ADDRESS 0x70000215 /end MEASUREMENT
/begin MEASUREMENT O2St_flgEndMeasCat1B1 "Flag end of measurement storage capability catalyst 1 bank 1" UBYTE B_TRUE 1 100 0.00 1.00000000000 BIT_MASK 0x1 FORMAT "%13.11" ECU_ADDRESS 0x600064A0 /end MEASUREMENT
/begin MEASUREMENT O2St_flgEndMeasEmptyCat1B1 "Flag end of measurement storage capability with empty catalyst 1 bank 1" UBYTE B_TRUE 1 100 0.00 1.00000000000 BIT_MASK 0x1 FORMAT "%13.11" ECU_ADDRESS 0x6000649F /end MEASUREMENT
/begin MEASUREMENT O2St_flgEndMeasFullCat1B1 "Flag end of measurement storage capability with full catalyst 1 bank 1" UBYTE B_TRUE 1 100 0.00 1.00000000000 BIT_MASK 0x1 FORMAT "%13.11" ECU_ADDRESS 0x6000649E /end MEASUREMENT
/begin MEASUREMENT O2St_flgFcoMeasCat1B1 "Flag fuel cut off during OSC measurement catalyst 1 bank 1" UBYTE B_TRUE 1 100 0.00 1.00000000000 BIT_MASK 0x1 FORMAT "%13.11" ECU_ADDRESS 0x6000649D /end MEASUREMENT
/begin MEASUREMENT O2St_flgIninCat1B1 "Flag initialisation integral storage capability catalyst 1 bank 1" UBYTE B_TRUE 1 100 0.00 1.00000000000 BIT_MASK 0x1 FORMAT "%13.11" ECU_ADDRESS 0x6000649C /end MEASUREMENT
/begin MEASUREMENT O2St_flgMeasOscCat1B1 "Flag storage capability is measured momentarily catalyst 1 bank 1" UBYTE B_TRUE 1 100 0.00 1.00000000000 BIT_MASK 0x1 FORMAT "%13.11" ECU_ADDRESS 0x6000649B /end MEASUREMENT
/begin MEASUREMENT O2St_flgMeasOscPlausCat1B1 "Flag measurement of storage capability is plausible catalyst 1 bank 1" UBYTE B_TRUE 1 100 0.00 1.00000000000 BIT_MASK 0x1 FORMAT "%13.11" ECU_ADDRESS 0x6000649A /end MEASUREMENT
/begin MEASUREMENT O2St_flgMeasOscPlausGlb "Flag measurement of storage capability plausible global" UBYTE B_TRUE 1 100 0.00 1.00000000000 BIT_MASK 0x1 FORMAT "%13.11" ECU_ADDRESS 0x60006499 /end MEASUREMENT
/begin MEASUREMENT O2St_flgOscMeasFavCat1B1 "Flag measurement of storage capability is favourable catalyst 1 bank 1" UBYTE B_TRUE 1 100 0.00 1.00000000000 BIT_MASK 0x1 FORMAT "%13.11" ECU_ADDRESS 0x60006498 /end MEASUREMENT
/begin MEASUREMENT O2St_flgStrtMeasCat1B1 "Flag start of measurement storage capability catalyst 1 bank 1" UBYTE B_TRUE 1 100 0.00 1.00000000000 BIT_MASK 0x1 FORMAT "%13.11" ECU_ADDRESS 0x60006497 /end MEASUREMENT
/begin MEASUREMENT O2St_flgStrtMeasEmptyCat1B1 "Flag start of measurement storage capability with empty catalyst 1 bank 1" UBYTE B_TRUE 1 100 0.00 1.00000000000 BIT_MASK 0x1 FORMAT "%13.11" ECU_ADDRESS 0x60006496 /end MEASUREMENT
/begin MEASUREMENT O2St_flgStrtMeasFullCat1B1 "Flag start of measurement storage capability with full catalyst 1 bank 1" UBYTE B_TRUE 1 100 0.00 1.00000000000 BIT_MASK 0x1 FORMAT "%13.11" ECU_ADDRESS 0x60006495 /end MEASUREMENT
/begin MEASUREMENT O2St_flgUMonoAscCat1B1 "Flag sensor voltage rises monetary downstream catalyst 1 bank 1" UBYTE B_TRUE 1 100 0.00 1.00000000000 BIT_MASK 0x1 FORMAT "%13.11" ECU_ADDRESS 0x60006494 /end MEASUREMENT
/begin MEASUREMENT O2St_flgUSensHiDsCat1B1 "Flag sensor voltage is greater than threshold downstream catalyst 1 bank 1" UBYTE B_TRUE 1 100 0.00 1.00000000000 BIT_MASK 0x1 FORMAT "%13.11" ECU_ADDRESS 0x60006493 /end MEASUREMENT
/begin MEASUREMENT O2St_flgUSensLoDsCat1B1 "Flag sensor voltage is lower than threshold downstream catalyst 1 bank 1" UBYTE B_TRUE 1 100 0.00 1.00000000000 BIT_MASK 0x1 FORMAT "%13.11" ECU_ADDRESS 0x60006492 /end MEASUREMENT
/begin MEASUREMENT O2St_mO2CorrnDsCat1B1 "Correction of OSC-ROSC-measurement for sensor dynamic correction of sensor downstream catalyst 1 bank 1" SLONG m_q0p2_mg 1 100 -429496729.600 429496729.400 FORMAT "%13.3" ECU_ADDRESS 0x500018A4 /end MEASUREMENT
/begin MEASUREMENT O2St_mO2CorrnUsCat1B1 "Correction of OSC-ROSC-measurement for sensor dynamic correction of sensor upstream catalyst 1 bank 1" SLONG m_q0p2_mg 1 100 -429496729.600 429496729.400 FORMAT "%13.3" ECU_ADDRESS 0x500018A8 /end MEASUREMENT
/begin MEASUREMENT O2St_mO2IntglSlopDsCat1B1 "Slope of oxygen-integral OSC-ROSC-measurement for sensor dynamic correction of the sensor downstream catalyst 1 bank 1" SLONG m_q0p2_mg_DIV_s 1 100 -429496729.600 429496729.400 FORMAT "%13.3" ECU_ADDRESS 0x500018AC /end MEASUREMENT
/begin MEASUREMENT O2St_mO2IntglSlopUsCat1B1 "Slope of oxygen-integral OSC-ROSC-measurement for sensor dynamic correction of the sensor upstream catalyst 1 bank 1" SLONG m_q0p2_mg_DIV_s 1 100 -429496729.600 429496729.400 FORMAT "%13.3" ECU_ADDRESS 0x500018B0 /end MEASUREMENT
/begin MEASUREMENT O2St_mO2StrAgedCalcnCat1B1 "OSC (aged catalyst for calculation of the old value for filter) catalyst 1 bank 1" ULONG m_q0p1_mg 1 100 0.00 131072.000000 FORMAT "%13.6" ECU_ADDRESS 0x60001424 /end MEASUREMENT
/begin MEASUREMENT O2St_mO2StrNewCalcnCat1B1 "Oxygen storage capability (new cat for calculation of the old value for filter) catalyst 1 bank 1" ULONG m_q0p1_mg 1 100 0.00 131072.000000 FORMAT "%13.6" ECU_ADDRESS 0x500018B4 /end MEASUREMENT
/begin MEASUREMENT O2St_mOscAgedCat1B1 "Oxygen storage capability (old value) catalyst 1 bank 1" ULONG m_q0p1_mg 1 100 0.00 131072.000000 FORMAT "%13.6" ECU_ADDRESS 0x60001420 /end MEASUREMENT
/begin MEASUREMENT O2St_mOscBefCorrnCat1B1 "Measured Oxygen storage capability before sensor dynamic correction, catalyst 1 bank 1" ULONG m_q0p1_mg 1 100 0.00 131072.000000 FORMAT "%13.6" ECU_ADDRESS 0x6000CDF0 /end MEASUREMENT
/begin MEASUREMENT O2St_mOscCurrCat1B1 "Oxygen storge capability (current value from OSC or Rosc) catalyst 1 bank 1" ULONG m_q0p1_mg 1 100 0.00 429496729.500 FORMAT "%13.3" ECU_ADDRESS 0x500018B8 /end MEASUREMENT
/begin MEASUREMENT O2St_mOscFildCat1B1 "Oxygen storage capability filtered catalyst 1 bank 1" ULONG m_q0p1_mg 1 100 0.00 262144.000000 FORMAT "%13.6" ECU_ADDRESS 0x6000141C /end MEASUREMENT
/begin MEASUREMENT O2St_mRoscBefCorrnCat1B1 "Measured Rosc of catalyst before sensor dynamic correction, catalyst 1 bank 1" ULONG m_q0p1_mg 1 100 0.00 131072.000000 FORMAT "%13.6" ECU_ADDRESS 0x6000CDF4 /end MEASUREMENT
/begin MEASUREMENT O2St_OIntglAndTCalcnCat1B1_I.countt "Oxygen mass flow integral and actual mean temperature calculation for catalyst1 bank1 / time counter" UWORD dez 1 100 0.00 65535.00 FORMAT "%8.2" ECU_ADDRESS 0x5000186C /end MEASUREMENT
/begin MEASUREMENT O2St_OIntglAndTCalcnCat1B1_I.dmAvgCurrMeas "Oxygen mass flow integral and actual mean temperature calculation for catalyst1 bank1 / mass flow reference" UWORD m_uw_b6553p5 1 100 0.00 6553.500 FORMAT "%8.3" ECU_ADDRESS 0x5000186E /end MEASUREMENT
/begin MEASUREMENT O2St_OIntglAndTCalcnCat1B1_I.dmIntglUsCat "Oxygen mass flow integral and actual mean temperature calculation for catalyst1 bank1 / integrated mass flow upstream catalyst" UWORD m_q0p0277_g 1 100 0.00 1820.417 FORMAT "%8.3" ECU_ADDRESS 0x50001870 /end MEASUREMENT
/begin MEASUREMENT O2St_OIntglAndTCalcnCat1B1_I.facLamAvrg "Oxygen mass flow integral and actual mean temperature calculation for catalyst1 bank1 / lambda reference" UWORD fak_q0p000244 1 100 0.00 15.99976 FORMAT "%8.5" ECU_ADDRESS 0x50001872 /end MEASUREMENT
/begin MEASUREMENT O2St_OIntglAndTCalcnCat1B1_I.lavksum_l "Oxygen mass flow integral and actual mean temperature calculation for catalyst1 bank1 / lambda summation" ULONG fak_q0p000244 1 100 0.00 1048575.99976 FORMAT "%13.5" ECU_ADDRESS 0x50001874 /end MEASUREMENT
/begin MEASUREMENT O2St_OIntglAndTCalcnCat1B1_I.mflowsum_l "Oxygen mass flow integral and actual mean temperature calculation for catalyst1 bank1 / mass flow summation" ULONG m_uw_b6553p5 1 100 0.00 429496729.500 FORMAT "%13.3" ECU_ADDRESS 0x50001878 /end MEASUREMENT
/begin MEASUREMENT O2St_OIntglAndTCalcnCat1B1_I.tRef "Oxygen mass flow integral and actual mean temperature calculation for catalyst1 bank1 / temperature reference" UWORD temp_q0p0234_o273 1 100 -273.150 1262.827 FORMAT "%8.3" ECU_ADDRESS 0x5000187C /end MEASUREMENT
/begin MEASUREMENT O2St_OIntglAndTCalcnCat1B1_I.tempsum_l "Oxygen mass flow integral and actual mean temperature calculation for catalyst1 bank1 / temperature summation" ULONG temp_q0p0234 1 100 0.00 100663295.977 FORMAT "%13.3" ECU_ADDRESS 0x50001880 /end MEASUREMENT
/begin MEASUREMENT O2St_OIntglAndTCalcnCat1B1_I.tiMeas "Oxygen mass flow integral and actual mean temperature calculation for catalyst1 bank1 / Measurement duration storage capability catalyst" UWORD t_q0p02 1 100 0.00 1310.700 FORMAT "%8.3" ECU_ADDRESS 0x50001884 /end MEASUREMENT
/begin MEASUREMENT O2St_OIntglAndTCalcnCat1B1_I.ExhMod_msintIK_I.memory "Oxygen mass flow integral and actual mean temperature calculation for catalyst1 bank1 / low pass filter oxygen mass flow / current integrator value" ULONG dez 1 100 0.00 4294967295.00 FORMAT "%13.2" ECU_ADDRESS 0x50001888 /end MEASUREMENT
/begin MEASUREMENT O2St_OIntglAndTCalcnCat1B1_I.ExhMod_oxsIK_I.memory "Oxygen mass flow integral and actual mean temperature calculation for catalyst1 bank1 / low pass filter oxygen mass flow / current integrator value" FLOAT32_IEEE m_q1_mg 1 100 -1.00000000E+037 1.00000000E+037 FORMAT "%13.3" ECU_ADDRESS 0x5000188C /end MEASUREMENT
/begin MEASUREMENT O2St_QryEndMeasCat1B1_I.flgEndMeasCat "Detection of end of oxygen storage capacity measurement in catalyst 1,bank 1 / Flag end of measurement storage capability catalyst" UBYTE B_TRUE 1 100 0.00 1.00000000000 BIT_MASK 0x1 FORMAT "%13.11" ECU_ADDRESS 0x5000549E /end MEASUREMENT
/begin MEASUREMENT O2St_QryEndMeasCat1B1_I.flgEndMeasEmptyCat "Detection of end of oxygen storage capacity measurement in catalyst 1,bank 1 / Flag end of measurement storage capability with empty catalyst" UBYTE B_TRUE 1 100 0.00 1.00000000000 BIT_MASK 0x1 FORMAT "%13.11" ECU_ADDRESS 0x5000549F /end MEASUREMENT
/begin MEASUREMENT O2St_QryEndMeasCat1B1_I.flgEndMeasFullCat "Detection of end of oxygen storage capacity measurement in catalyst 1,bank 1 / Flag end of measurement storage capability with full catalyst" UBYTE B_TRUE 1 100 0.00 1.00000000000 BIT_MASK 0x1 FORMAT "%13.11" ECU_ADDRESS 0x500054A0 /end MEASUREMENT
/begin MEASUREMENT O2St_QryEndMeasCat1B1_I.ExhMod_flgleanincatTOFFV_I.outbit "Detection of end of oxygen storage capacity measurement in catalyst 1,bank 1 / approval lean lambda at lambda sensor / Output Bit" UBYTE B_TRUE 1 100 0.00 1.00000000000 BIT_MASK 0x1 FORMAT "%13.11" ECU_ADDRESS 0x500054A2 /end MEASUREMENT
/begin MEASUREMENT O2St_QryEndMeasCat1B1_I.ExhMod_flgleanincatTOFFV_I.time "Detection of end of oxygen storage capacity measurement in catalyst 1,bank 1 / approval lean lambda at lambda sensor / Occured Time" UWORD t_q0p02 1 100 0.00 1310.700 FORMAT "%8.3" ECU_ADDRESS 0x500054A4 /end MEASUREMENT
/begin MEASUREMENT O2St_QryEndMeasCat1B1_I.ExhMod_flgrichincatTOFFV_I.outbit "Detection of end of oxygen storage capacity measurement in catalyst 1,bank 1 / approval rich lambda at lambda sensor / Output Bit" UBYTE B_TRUE 1 100 0.00 1.00000000000 BIT_MASK 0x1 FORMAT "%13.11" ECU_ADDRESS 0x500054A6 /end MEASUREMENT
/begin MEASUREMENT O2St_QryEndMeasCat1B1_I.ExhMod_flgrichincatTOFFV_I.time "Detection of end of oxygen storage capacity measurement in catalyst 1,bank 1 / approval rich lambda at lambda sensor / Occured Time" UWORD t_q0p02 1 100 0.00 1310.700 FORMAT "%8.3" ECU_ADDRESS 0x500054A8 /end MEASUREMENT
/begin MEASUREMENT O2St_QryEndMeasCat1B1_I.ExhMod_flgsenshighER_I.buffer "Detection of end of oxygen storage capacity measurement in catalyst 1,bank 1 / approval no oxygen content within catalyst / rising edge detected" UBYTE B_TRUE 1 100 0.00 1.00000000000 BIT_MASK 0x1 FORMAT "%13.11" ECU_ADDRESS 0x500054AA /end MEASUREMENT
/begin MEASUREMENT O2St_QryEndMeasCat1B1_I.ExhMod_flgsenshighER_I.oldSignal "Detection of end of oxygen storage capacity measurement in catalyst 1,bank 1 / approval no oxygen content within catalyst / flag rising edge" UBYTE B_TRUE 1 100 0.00 1.00000000000 BIT_MASK 0x1 FORMAT "%13.11" ECU_ADDRESS 0x500054AB /end MEASUREMENT
/begin MEASUREMENT O2St_QryEndMeasCat1B1_I.ExhMod_flgsenslowER_I.buffer "Detection of end of oxygen storage capacity measurement in catalyst 1,bank 1 / approval catalyst completly filled with oxygen / rising edge detected" UBYTE B_TRUE 1 100 0.00 1.00000000000 BIT_MASK 0x1 FORMAT "%13.11" ECU_ADDRESS 0x500054AC /end MEASUREMENT
/begin MEASUREMENT O2St_QryEndMeasCat1B1_I.ExhMod_flgsenslowER_I.oldSignal "Detection of end of oxygen storage capacity measurement in catalyst 1,bank 1 / approval catalyst completly filled with oxygen / flag rising edge" UBYTE B_TRUE 1 100 0.00 1.00000000000 BIT_MASK 0x1 FORMAT "%13.11" ECU_ADDRESS 0x500054AD /end MEASUREMENT
/begin MEASUREMENT O2St_QryStrtMeasCat1B1_I.flgStrtMeas "Check for start of measurement of oxygen storage capacity in catalyst 1,bank 1 / Flag start of measurement storage capability catalyst" UBYTE B_TRUE 1 100 0.00 1.00000000000 BIT_MASK 0x1 FORMAT "%13.11" ECU_ADDRESS 0x6000386E /end MEASUREMENT
/begin MEASUREMENT O2St_QryStrtMeasCat1B1_I.flgStrtMeasEmpty "Check for start of measurement of oxygen storage capacity in catalyst 1,bank 1 / Flag start of measurement storage capability with empty catalyst" UBYTE B_TRUE 1 100 0.00 1.00000000000 BIT_MASK 0x1 FORMAT "%13.11" ECU_ADDRESS 0x6000386F /end MEASUREMENT
/begin MEASUREMENT O2St_QryStrtMeasCat1B1_I.flgStrtMeasFull "Check for start of measurement of oxygen storage capacity in catalyst 1,bank 1 / Flag start of measurement storage capability with full catalyst" UBYTE B_TRUE 1 100 0.00 1.00000000000 BIT_MASK 0x1 FORMAT "%13.11" ECU_ADDRESS 0x60003870 /end MEASUREMENT
/begin MEASUREMENT O2St_QryStrtMeasCat1B1_I.ExhMod_leaninER_I.buffer "Check for start of measurement of oxygen storage capacity in catalyst 1,bank 1 / approval lean lambda at lambda sensor / rising edge detected" UBYTE B_TRUE 1 100 0.00 1.00000000000 BIT_MASK 0x1 FORMAT "%13.11" ECU_ADDRESS 0x60003872 /end MEASUREMENT
/begin MEASUREMENT O2St_QryStrtMeasCat1B1_I.ExhMod_leaninER_I.oldSignal "Check for start of measurement of oxygen storage capacity in catalyst 1,bank 1 / approval lean lambda at lambda sensor / flag rising edge" UBYTE B_TRUE 1 100 0.00 1.00000000000 BIT_MASK 0x1 FORMAT "%13.11" ECU_ADDRESS 0x60003873 /end MEASUREMENT
/begin MEASUREMENT O2St_QryStrtMeasCat1B1_I.ExhMod_richinER_I.buffer "Check for start of measurement of oxygen storage capacity in catalyst 1,bank 1 / approval rich lambda at lambda sensor / rising edge detected" UBYTE B_TRUE 1 100 0.00 1.00000000000 BIT_MASK 0x1 FORMAT "%13.11" ECU_ADDRESS 0x60003874 /end MEASUREMENT
/begin MEASUREMENT O2St_QryStrtMeasCat1B1_I.ExhMod_richinER_I.oldSignal "Check for start of measurement of oxygen storage capacity in catalyst 1,bank 1 / approval rich lambda at lambda sensor / flag rising edge" UBYTE B_TRUE 1 100 0.00 1.00000000000 BIT_MASK 0x1 FORMAT "%13.11" ECU_ADDRESS 0x60003875 /end MEASUREMENT
/begin MEASUREMENT O2St_ratLamAvrgCat1B1 "Average lambda value during current measurement of oxygen storage capability catalyst 1 bank 1" UWORD fak_q0p000244 1 100 0.00 15.99976 FORMAT "%8.5" ECU_ADDRESS 0x60003892 /end MEASUREMENT
/begin MEASUREMENT O2St_ratO2StrLocCat1B1 "OSC correction factor catalyst 1, non volatile" UBYTE fak_ub_b2 1 100 0.00 1.992188 FORMAT "%8.6" ECU_ADDRESS 0x600365B0 /end MEASUREMENT
/begin MEASUREMENT O2St_SetOscRoscExtdCat1B1_I.dmAvrgMeasCurr "Check for end of measurement of oxygen storage capacity detection in catalyst 1,bank 1 / Average mass flow of current measurement storage capability catalyst" UWORD m_uw_b6553p5 1 100 0.00 6553.500 FORMAT "%8.3" ECU_ADDRESS 0x50001890 /end MEASUREMENT
/begin MEASUREMENT O2St_SetOscRoscExtdCat1B1_I.flgOscMeasd "Check for end of measurement of oxygen storage capacity detection in catalyst 1,bank 1 / Flag current oxygen storage capability measured catalyst" UBYTE B_TRUE 1 100 0.00 1.00000000000 BIT_MASK 0x1 FORMAT "%13.11" ECU_ADDRESS 0x50001892 /end MEASUREMENT
/begin MEASUREMENT O2St_SetOscRoscExtdCat1B1_I.flgRoscMeasd "Check for end of measurement of oxygen storage capacity detection in catalyst 1,bank 1 / Flag current oxygen storage capability measured catalyst" UBYTE B_TRUE 1 100 0.00 1.00000000000 BIT_MASK 0x1 FORMAT "%13.11" ECU_ADDRESS 0x50001893 /end MEASUREMENT
/begin MEASUREMENT O2St_SetOscRoscExtdCat1B1_I.mOscBefCorrnCat "Check for end of measurement of oxygen storage capacity detection in catalyst 1,bank 1 / Measured Oxygen storage capability before sensor dynamic correction, catalyst" ULONG m_q0p1_mg 1 100 0.00 131072.000000 FORMAT "%13.6" ECU_ADDRESS 0x50001894 /end MEASUREMENT
/begin MEASUREMENT O2St_SetOscRoscExtdCat1B1_I.mRoscBefCorrnCat "Check for end of measurement of oxygen storage capacity detection in catalyst 1,bank 1 / Measured Rosc of catalyst before sensor dynamic correction, catalyst" ULONG m_q0p1_mg 1 100 0.00 131072.000000 FORMAT "%13.6" ECU_ADDRESS 0x50001898 /end MEASUREMENT
/begin MEASUREMENT O2St_SetOscRoscExtdCat1B1_I.tAvrgMeas "Check for end of measurement of oxygen storage capacity detection in catalyst 1,bank 1 / Average temperature during the last measurement storage capability catalyst" UWORD temp_q0p0234_o273 1 100 -273.150 1262.827 FORMAT "%8.3" ECU_ADDRESS 0x5000189C /end MEASUREMENT
/begin MEASUREMENT O2St_SetOscRoscExtdCat1B1_I.tiMeasCat "Check for end of measurement of oxygen storage capacity detection in catalyst 1,bank 1 / Measurement duration storage capability catalyst" UWORD t_q0p02 1 100 0.00 1310.700 FORMAT "%8.3" ECU_ADDRESS 0x5000189E /end MEASUREMENT
/begin MEASUREMENT O2St_stSycSubOld "ECU state during last calculation" UBYTE dez 1 100 0.00 255.0 FORMAT "%5.1" ECU_ADDRESS 0x60006491 /end MEASUREMENT
/begin MEASUREMENT O2St_tAvrgMeasCat1B1 "Average temperature during the last measurement storage capability catalyst 1 bank 1" UWORD temp_q0p0234_o273 1 100 -273.150 1262.827 FORMAT "%8.3" ECU_ADDRESS 0x6000D940 /end MEASUREMENT
/begin MEASUREMENT O2St_tEndMeasCat1B1 "Temperature at the end of the last measurement of OSC catalyst 1" UWORD temp_q0p0234_o273 1 100 -273.150 1262.827 FORMAT "%8.3" ECU_ADDRESS 0x60003890 /end MEASUREMENT
/begin MEASUREMENT O2St_TestMeasFav.flgOscMeasFav "Class to check successful OSC measurement / Measurement storage capacity succesful" UBYTE B_TRUE 1 100 0.00 1.00000000000 BIT_MASK 0x1 FORMAT "%13.11" ECU_ADDRESS 0x60006490 /end MEASUREMENT
/begin MEASUREMENT O2St_tiCorrnDsCat1B1 "Correction time for measurement of storage capability of catalyst for sensor downstream catalyst 1 bank 1" UWORD t_q0p01 1 100 0.00 655.3500 FORMAT "%8.4" ECU_ADDRESS 0x6000388E /end MEASUREMENT
/begin MEASUREMENT O2St_tiCorrnUsCat1B1 "Correction time for measurement of storage capability of catalyst for sensor upstream catalyst 1 bank 1" UWORD t_q0p01 1 100 0.00 655.3500 FORMAT "%8.4" ECU_ADDRESS 0x6000388C /end MEASUREMENT
/begin MEASUREMENT O2St_tiDlyLeanRichDsCat1B1 "Time delay (transition lean-rich) for measurement of storage capability of sensor downstream catalyst 1 bank 1" UWORD t_q0p01 1 100 0.00 655.3500 FORMAT "%8.4" ECU_ADDRESS 0x6000388A /end MEASUREMENT
/begin MEASUREMENT O2St_tiDlyRichLeanDsCat1B1 "Time delay (transition rich-lean) for measurement of storage capability of sensor downstream catalyst 1 bank 1" UWORD t_q0p01 1 100 0.00 655.3500 FORMAT "%8.4" ECU_ADDRESS 0x60003888 /end MEASUREMENT
/begin MEASUREMENT O2St_tiMeasCat1B1 "Measurement duration storage capability catalyst 1 bank 1" UWORD t_q0p02 1 100 0.00 1310.700 FORMAT "%8.3" ECU_ADDRESS 0x6000D946 /end MEASUREMENT
/begin MEASUREMENT O2St_tiMeasIntCat1B1 "Measurement duration storage capability (internal value) catalyst 1 bank 1" UWORD t_q0p02 1 100 0.00 1310.700 FORMAT "%8.3" ECU_ADDRESS 0x6000D948 /end MEASUREMENT
/begin MEASUREMENT O2St_tIntCat1B1 "internal temperature catalyst 1" UWORD temp_q0p0234_o273 1 100 -273.150 1262.827 FORMAT "%8.3" ECU_ADDRESS 0x60003886 /end MEASUREMENT
/begin MEASUREMENT O2St_tIntCat2B1 "internal temperature catalyst 2" UWORD temp_q0p0234_o273 1 100 -273.150 1262.827 FORMAT "%8.3" ECU_ADDRESS 0x6000D942 /end MEASUREMENT
/begin MEASUREMENT O2St_tiTranLeanRichDsCat1B1 "Transition time (lean-rich) for measurement of storage capability catalyst of sensor downstream catalyst 1 bank 1" UWORD t_q0p01 1 100 0.00 655.3500 FORMAT "%8.4" ECU_ADDRESS 0x60003884 /end MEASUREMENT
/begin MEASUREMENT O2St_tiTranRichLeanDsCat1B1 "Transition time (rich-lean) for measurement of storage capability catalyst of sensor downstream catalyst 1 bank 1" UWORD t_q0p01 1 100 0.00 655.3500 FORMAT "%8.4" ECU_ADDRESS 0x60003882 /end MEASUREMENT
/begin MEASUREMENT O2St_tRefCat1B1 "reference temperature catalyst 1 bank 1" UWORD temp_q0p0234_o273 1 100 -273.150 1262.827 FORMAT "%8.3" ECU_ADDRESS 0x6000D944 /end MEASUREMENT
/begin MEASUREMENT O2St_tStrtMeasCat1B1 "Temperature at the start of the last measurement of OSC catalyst 1" UWORD temp_q0p0234_o273 1 100 -273.150 1262.827 FORMAT "%8.3" ECU_ADDRESS 0x60003880 /end MEASUREMENT
/begin MEASUREMENT O2St_uCat1DsMaxB1 "Maximum measured voltage before start of measurement downstream catalyst 1 bank 1" UWORD spg_uw_q0p00488 1 100 0.00 319.9951 FORMAT "%8.4" ECU_ADDRESS 0x6000387E /end MEASUREMENT
/begin MEASUREMENT O2St_uCat1DsStrtB1 "Measured voltage at start of measurement downstream catalyst 1 bank 1" UWORD spg_uw_q0p00488 1 100 0.00 319.9951 FORMAT "%8.4" ECU_ADDRESS 0x6000387C /end MEASUREMENT
/begin MEASUREMENT O2St_uSensMaxCat1B1 "Maximum mesured voltage as interim value for evalutation of the slope of sensor voltage downstream of catalyst 1 bank 1" UWORD spg_uw_q0p00488 1 100 0.00 319.9951 FORMAT "%8.4" ECU_ADDRESS 0x6000D94A /end MEASUREMENT
/begin MEASUREMENT O2St_uSensRefCat1B1 "Reference value for evaluation of the sensor voltage downstream catalyst 1 bank 1" UWORD spg_uw_q0p00488 1 100 0.00 319.9951 FORMAT "%8.4" ECU_ADDRESS 0x6000D94C /end MEASUREMENT
/begin MEASUREMENT TExhVlv_facCorrnIgnAgB1 "ignition efficiency correction" UWORD fak_uw_b2 1 100 0.00 1.999969 FORMAT "%8.6" ECU_ADDRESS 0x60003846 /end MEASUREMENT
/begin MEASUREMENT TExhVlv_facCorrnLamB1 "lambda correction" UWORD fak_uw_b2 1 100 0.00 1.999969 FORMAT "%8.6" ECU_ADDRESS 0x60003844 /end MEASUREMENT
/begin MEASUREMENT TExhVlv_offsCorrnIgnAgB1 "offset ignition efficiency correction" SWORD temp_q0p0234 1 100 -768.0000 767.9766 FORMAT "%8.4" ECU_ADDRESS 0x60003842 /end MEASUREMENT
/begin MEASUREMENT TExhVlv_offsCorrnLamB1 "offset lambda correction" SWORD temp_q0p0234 1 100 -768.0000 767.9766 FORMAT "%8.4" ECU_ADDRESS 0x60003840 /end MEASUREMENT
/begin MEASUREMENT TiEngOff_ctReIni "Counter for ReIni detection" UBYTE OneToOne 1 100 0.00 255.0 FORMAT "%5.1" ECU_ADDRESS 0x6000648C /end MEASUREMENT
/begin MEASUREMENT TMdl_facInterpnCoolgCrv "Interpolation factor for cooling curves" UBYTE fak_ub_b2 1 100 0.00 1.000000 FORMAT "%8.6" ECU_ADDRESS 0x60006487 /end MEASUREMENT
/begin MEASUREMENT TMdl_tiEngOff "corrected engine off time" UWORD t_q1 1 100 0.00 65535.00 FORMAT "%8.2" ECU_ADDRESS 0x60003820 /end MEASUREMENT
/begin MEASUREMENT vfzg_wloc "vehicle speed" UWORD vfzg_uw_b512 1 100 0.00 511.9922 FORMAT "%8.4" ECU_ADDRESS 0x60003824 /end MEASUREMENT
/begin FUNCTION ExhMod_MfIf "1.9.0     Converter Intern Exhaust Mass Flows To System" /begin REF_CHARACTERISTIC ExhMod_idxSnsrB1_CA /end REF_CHARACTERISTIC
 /begin IN_MEASUREMENT ExhMod_idxFirstBrickCat1B1 ExhMod_idxFirstBrickCat2B1 ExhMod_mfExhAryB1 ExhMod_mfExhVlvB1 ExhMod_mfFuB1 /end IN_MEASUREMENT
 /begin OUT_MEASUREMENT ExhMod_dmExhCat1B1 ExhMod_dmExhCat2B1 ExhMod_dmExhMnfB1 ExhMod_dmExhS1B1 ExhMod_dmExhS2B1 ExhMod_dmExhWoFuUsCat1B1 ExhMod_dmExhWoFuUsCat2B1 ExhMod_mfExhB1 ExhMod_mfExhCat1B1 ExhMod_mfExhCat2B1 ExhMod_mfExhCatAryB1 ExhMod_mfExhMnfB1 ExhMod_mfExhS1B1 ExhMod_mfExhS2B1 ExhMod_mfExhSnsrAryB1 ExhMod_mfExhWoFuUsCat1B1 ExhMod_mfExhWoFuUsCat2B1 /end OUT_MEASUREMENT
 FUNCTION_VERSION "1.9.0" /end FUNCTION
/begin FUNCTION ExhMod_MfMdl "1.10.0    Calculation Of Exhaust Emission Mass Flow - Bank-Dependent"
 /begin IN_MEASUREMENT B_sa_msg Epm_stSpd InjSys_ratFuMTot msfabr_w_msg SyC_stSub umsrln_w_msg /end IN_MEASUREMENT
 /begin OUT_MEASUREMENT ExhMod_dmAirB1 ExhMod_dmExhAryB1 ExhMod_dmExhVlvB1 ExhMod_dmFuB1 ExhMod_mfAirB1 ExhMod_mfExhAryB1 ExhMod_mfExhVlvB1 ExhMod_mfFuB1 ExhMod_ratMFlowVlvB1 /end OUT_MEASUREMENT
 /begin LOC_MEASUREMENT ExhMod_ratAfr /end LOC_MEASUREMENT
 FUNCTION_VERSION "1.10.0" /end FUNCTION
/begin FUNCTION ExhMod_O2StorgIf "1.5.0     Interface to Oxygen Storage capacity of catalyst Estimation"
 /begin IN_MEASUREMENT ExhMod_flgLSNplCat1B1 HEGO_bS2B1Vld HEGO_uS2B1Extd SyC_stSub /end IN_MEASUREMENT
 /begin OUT_MEASUREMENT ExhMod_flgLSEnaCat1B1 ExhMod_uCat1DsB1 /end OUT_MEASUREMENT
 FUNCTION_VERSION "1.5.0" /end FUNCTION
/begin FUNCTION ExhMod_O2StorgMdl "1.19.0    Modelling of Oxygen Storage Capacity"
 /begin DEF_CHARACTERISTIC O2St_mfO2ThdStoi_C O2St_uDeltaDecMaxSensHi_C O2St_uDeltaDecMax_C O2St_uDeltaIncMin_C O2St_tiConMFlowEna_C ExhMod_stOsc_C O2St_dmMaxThdMeasCat1_C O2St_dmMinThdMeasCat1_C O2St_facAgiAgedCat_C O2St_facCorrnDlyLeanRichDsCat1_T O2St_facCorrnDlyRichLeanDsCat1_T O2St_facCorrnMfLamCat1B1_M O2St_facCorrnMissSensDsCat2_T O2St_facCorrnTranLeanRichDsCat1_T O2St_facCorrnTranRichLeanDsCat1_T O2St_facCorrO2StorgUCat1_T O2St_facIninOscCorrnCat1_C O2St_facIninOscCorrnCat2_C O2St_facMaxThdLamCtrl_C O2St_facMinThdLamCtrl_C O2St_facOscFilDiag_C O2St_facOscFilMax_C O2St_facOscFilMin_C O2St_facRoscOscCat1_T O2St_facTiCorrnSnsrAftCat_C O2St_facTiCorrnSnsrBefCat_C O2St_mMaxThdMeasCat1_C O2St_mOscAgedCat1B1_M O2St_mOscAgedCat2B1_M O2St_mOscNewCat1B1_M O2St_mOscNewCat2B1_M O2St_SpareRatO2StrCat1_C O2St_stApplMod_C O2St_stOscCatDiag_C O2St_stOscMeas_C O2St_stOscRosc_C O2St_tDeltaMaxMeasCat1_C O2St_tiDlyEnagOscCat1_C O2St_tiDlyMaxS1_C O2St_tiMaxMeasOscCat1_C O2St_tiThdStrtMeas_C O2St_tiTranDecelCat1_C O2St_tiTranDecelMeas_C O2St_tiTranMaxS1_C O2St_tMaxThdMeasCat1_C O2St_tMaxThdMeasHysCat1_C O2St_tMinThdMeasCat1_C O2St_tMinThdMeasHysCat1_C O2St_uThdCat1DsO2EmptyB1_C O2St_uThdCat1DsO2FullB1_C /end DEF_CHARACTERISTIC
 /begin IN_MEASUREMENT B_ll_msg B_sa_msg B_sbblsu_msg Eep_EnvRamInvld EGSDO2_tiDlyAdpnS1B1 EGSDO2_tiTranAdpnS1B1 EGSDU_tiS2B1LtrDlyEvln EGSDU_tiS2B1LtrTranEvln EGSDU_tiS2B1RtlDlyEvln EGSDU_tiS2B1RtlTranEvln EngStrt_bStrtEnd ExhMod_flgLSEnaCat1B1 ExhMod_mfExhCat1B1 ExhMod_mfExhCat2B1 ExhMod_mfExhWoFuUsCat1B1 ExhMod_mfO2Cat1B1 ExhMod_rLamCat1UsB1 ExhMod_tCat1AvrgB1 ExhMod_tCat1B1 ExhMod_tCat2AvrgB1 ExhMod_tCat2B1 ExhMod_uCat1DsB1 fr_w_msg SyC_stSub tnse_w_msg TWCD_flgPtlMeasOSCFinB1 TWCD_flgPtlMeasRSCFinB1 TWCD_mOscPtlCorrdExtdCat1B1 TWCD_mRscPtlCorrdExtdCat1B1 /end IN_MEASUREMENT
 /begin OUT_MEASUREMENT ExhMod_flgEmptyO2Cat1B1 ExhMod_flgFullO2Cat1B1 ExhMod_flgInhbnCat1B1 ExhMod_flgInhbnCat2B1 ExhMod_flgInpMfLeanCat1B1 ExhMod_flgInpMfRichCat1B1 ExhMod_flgO2MeasRdyCat1B1 ExhMod_flgOscMeasdCat1B1 ExhMod_flgRoscMeasdCat1B1 ExhMod_flgSucOscMeasmtCat1B1 ExhMod_mO2IntglCat1B1 ExhMod_mO2StrAgedCat1B1 ExhMod_mO2StrAgedCat2B1 ExhMod_mO2StrAgedExtdCat1B1 ExhMod_mO2StrAgedExtdCat2B1 ExhMod_mO2StrCat1B1 ExhMod_mO2StrCat2B1 ExhMod_mO2StrExtdCat1B1 ExhMod_mO2StrExtdCat2B1 ExhMod_mO2StrNewCat1B1 ExhMod_mO2StrNewCat2B1 ExhMod_mO2StrNewExtdCat1B1 ExhMod_mO2StrNewExtdCat2B1 ExhMod_mOscMeasdCat1B1 ExhMod_mOscMeasdExtdCat1B1 ExhMod_mRoscMeasdCat1B1 ExhMod_mRoscMeasdExtdCat1B1 ExhMod_ratO2StorgCatB1_a ExhMod_ratO2StrCat1B1 ExhMod_ratO2StrCat1MinBnk ExhMod_ratO2StrCatAryB1 /end OUT_MEASUREMENT
 /begin LOC_MEASUREMENT ExhMod_flgEndMeasCat1B1ER_I.buffer ExhMod_flgEndMeasCat1B1ER_I.oldSignal ExhMod_flgPasOSCMeasmt ExhMod_flgStrtMeasCat1B1ER_I.buffer ExhMod_flgStrtMeasCat1B1ER_I.oldSignal ExhMod_ratO2StorgCalCat1B1 ExhMod_ratO2StorgCalCat2B1 O2St_CalcnOscCorrnCat1B1_I.flgO2StrCalcd O2St_CalcnOscCorrnCat1B1_I.flgRoscMeasd O2St_CalcnOscCorrnCat1B1_I.mOscMeasd O2St_CalcnOscCorrnCat1B1_I.mRoscMeasd O2St_CalcnOscCurrExtd_I.mOscCurr O2St_CalcnRichLeanCat1B1_I.flgEmptyO2 O2St_CalcnRichLeanCat1B1_I.flgFullO2 O2St_CalcnRichLeanCat1B1_I.flgInpMfLean O2St_CalcnRichLeanCat1B1_I.flgInpMfRich O2St_CalcnRichLeanCat1B1_I.flgUMonoAsc O2St_CalcnRichLeanCat1B1_I.flgUSensHi O2St_CalcnRichLeanCat1B1_I.flgUSensLo O2St_CalcnRichLeanCat1B1_I.uSensMax O2St_CalcnRichLeanCat1B1_I.uSensRef O2St_CalcnSensDynCorrn.flgCorrnPlausDsCat O2St_CalcnSensDynCorrn.flgCorrnPlausUsCat O2St_CalcnSensDynCorrn.mO2CorrnDsCat O2St_CalcnSensDynCorrn.mO2CorrnUsCat O2St_CalcnSlopOIntglCat1B1_I.mO2IntglSlopDsCat1 O2St_CalcnSlopOIntglCat1B1_I.mO2IntglSlopUsCat1 O2St_CalcnSlopOIntglCat1B1_I.oxsbuf_l O2St_CalcnSlopOIntglCat1B1_I.oxscounter O2St_CalcnSlopOIntglCat1B1_I.pointer O2St_CalcnUMaxBefOscCat1B1_I.uCatDsMax O2St_CatEnaCdnCat1B1_I.ExhMod_flgIntHLR_I.hysterese O2St_CatEnaCdnCat1B1_I.ExhMod_flgtempTON_I.buffer O2St_CatEnaCdnCat1B1_I.ExhMod_flgtempTON_I.time O2St_CatEnaCdnCat1B1_I.ExhMod_msabLT_I.memory O2St_ChkPlausEndMeasCat1B1_I.flgMeasOsc O2St_ChkPlausEndMeasCat1B1_I.flgMeasOscPlaus O2St_ChkPlausEndMeasCat1B1_I.ExhMod_flgmeasbreakTONV_I.outbit O2St_ChkPlausEndMeasCat1B1_I.ExhMod_flgmeasbreakTONV_I.time O2St_cntrOscCurrUpdCat1B1 O2St_dmAvrgCurrMeasCat1B1 O2St_dmAvrgMeasCurrCat1B1 O2St_dmIntglUsCat1B1 O2St_flgClr O2St_flgCorrnPlausDsCat1B1 O2St_flgCorrnPlausUsCat1B1 O2St_flgEnagMeas O2St_flgEndMeasCat1B1 O2St_flgEndMeasEmptyCat1B1 O2St_flgEndMeasFullCat1B1 O2St_flgFcoMeasCat1B1 O2St_flgIninCat1B1 O2St_flgMeasOscCat1B1 O2St_flgMeasOscPlausCat1B1 O2St_flgMeasOscPlausGlb O2St_flgOscMeasFavCat1B1 O2St_flgStrtMeasCat1B1 O2St_flgStrtMeasEmptyCat1B1 O2St_flgStrtMeasFullCat1B1 O2St_flgUMonoAscCat1B1 O2St_flgUSensHiDsCat1B1 O2St_flgUSensLoDsCat1B1 O2St_mO2CorrnDsCat1B1 O2St_mO2CorrnUsCat1B1 O2St_mO2IntglSlopDsCat1B1 O2St_mO2IntglSlopUsCat1B1 O2St_mO2StrAgedCalcnCat1B1 O2St_mO2StrNewCalcnCat1B1 O2St_mOscAgedCat1B1 O2St_mOscBefCorrnCat1B1 O2St_mOscCurrCat1B1 O2St_mOscFildCat1B1 O2St_mRoscBefCorrnCat1B1 O2St_OIntglAndTCalcnCat1B1_I.countt O2St_OIntglAndTCalcnCat1B1_I.dmAvgCurrMeas O2St_OIntglAndTCalcnCat1B1_I.dmIntglUsCat O2St_OIntglAndTCalcnCat1B1_I.facLamAvrg O2St_OIntglAndTCalcnCat1B1_I.lavksum_l O2St_OIntglAndTCalcnCat1B1_I.mflowsum_l O2St_OIntglAndTCalcnCat1B1_I.tRef O2St_OIntglAndTCalcnCat1B1_I.tempsum_l O2St_OIntglAndTCalcnCat1B1_I.tiMeas O2St_OIntglAndTCalcnCat1B1_I.ExhMod_msintIK_I.memory O2St_OIntglAndTCalcnCat1B1_I.ExhMod_oxsIK_I.memory O2St_QryEndMeasCat1B1_I.flgEndMeasCat O2St_QryEndMeasCat1B1_I.flgEndMeasEmptyCat O2St_QryEndMeasCat1B1_I.flgEndMeasFullCat O2St_QryEndMeasCat1B1_I.ExhMod_flgleanincatTOFFV_I.outbit O2St_QryEndMeasCat1B1_I.ExhMod_flgleanincatTOFFV_I.time O2St_QryEndMeasCat1B1_I.ExhMod_flgrichincatTOFFV_I.outbit O2St_QryEndMeasCat1B1_I.ExhMod_flgrichincatTOFFV_I.time O2St_QryEndMeasCat1B1_I.ExhMod_flgsenshighER_I.buffer O2St_QryEndMeasCat1B1_I.ExhMod_flgsenshighER_I.oldSignal O2St_QryEndMeasCat1B1_I.ExhMod_flgsenslowER_I.buffer O2St_QryEndMeasCat1B1_I.ExhMod_flgsenslowER_I.oldSignal O2St_QryStrtMeasCat1B1_I.flgStrtMeas O2St_QryStrtMeasCat1B1_I.flgStrtMeasEmpty O2St_QryStrtMeasCat1B1_I.flgStrtMeasFull O2St_QryStrtMeasCat1B1_I.ExhMod_leaninER_I.buffer O2St_QryStrtMeasCat1B1_I.ExhMod_leaninER_I.oldSignal O2St_QryStrtMeasCat1B1_I.ExhMod_richinER_I.buffer O2St_QryStrtMeasCat1B1_I.ExhMod_richinER_I.oldSignal O2St_ratLamAvrgCat1B1 O2St_ratO2StrLocCat1B1 O2St_SetOscRoscExtdCat1B1_I.dmAvrgMeasCurr O2St_SetOscRoscExtdCat1B1_I.flgOscMeasd O2St_SetOscRoscExtdCat1B1_I.flgRoscMeasd O2St_SetOscRoscExtdCat1B1_I.mOscBefCorrnCat O2St_SetOscRoscExtdCat1B1_I.mRoscBefCorrnCat O2St_SetOscRoscExtdCat1B1_I.tAvrgMeas O2St_SetOscRoscExtdCat1B1_I.tiMeasCat O2St_stSycSubOld O2St_tAvrgMeasCat1B1 O2St_tEndMeasCat1B1 O2St_TestMeasFav.flgOscMeasFav O2St_tiCorrnDsCat1B1 O2St_tiCorrnUsCat1B1 O2St_tiDlyLeanRichDsCat1B1 O2St_tiDlyRichLeanDsCat1B1 O2St_tiMeasCat1B1 O2St_tiMeasIntCat1B1 O2St_tIntCat1B1 O2St_tIntCat2B1 O2St_tiTranLeanRichDsCat1B1 O2St_tiTranRichLeanDsCat1B1 O2St_tRefCat1B1 O2St_tStrtMeasCat1B1 O2St_uCat1DsMaxB1 O2St_uCat1DsStrtB1 O2St_uSensMaxCat1B1 O2St_uSensRefCat1B1 /end LOC_MEASUREMENT
 FUNCTION_VERSION "1.19.0" /end FUNCTION
/begin FUNCTION ExhMod_PMdl "1.19.2    Calculation Of Pressure In Exhaust System From Ambient To Upstream First Cat"
 /begin DEF_CHARACTERISTIC ExhMod_coeffPDiffCatTB1_M ExhMod_nrIterPDiffCat_C ExhMod_pDiffCatMFlow_M ExhMod_pEnvDiffAppl_C /end DEF_CHARACTERISTIC
 /begin IN_MEASUREMENT ExhMod_mfExhCatAryB1 ExhMod_tCatAvrgAryB1 PEnv_p SyC_stSub /end IN_MEASUREMENT
 /begin OUT_MEASUREMENT ExhMod_pDsLstCat ExhMod_pEnvAppl ExhMod_pExhCat1UsB1 ExhMod_pExhCat2UsB1 /end OUT_MEASUREMENT
 /begin LOC_MEASUREMENT ExhMod_coeffPDiffCatTB1Ary ExhMod_pDiffCatMFlowAry ExhMod_pExhCatUsAryB1 /end LOC_MEASUREMENT
 FUNCTION_VERSION "1.19.2" /end FUNCTION
/begin FUNCTION ExhMod_TExhVlvMdl "1.19.0    Temperature model exhaust valve"
 /begin DEF_CHARACTERISTIC ExhMod_cpAbsltVlvFildB1_C ExhMod_facTExhVlvCorrnIgnAgHomB1_M ExhMod_facTExhVlvCorrnIgnAgHomB1_T ExhMod_facTExhVlvCorrnIntkAir_T ExhMod_facTExhVlvCorrnLamB1_M ExhMod_facTExhVlvCorrnLamB1_T ExhMod_facTExhVlvCorrnRri_T ExhMod_offsTExhVlvCorrnIgnAgHomB1_M ExhMod_offsTExhVlvCorrnIntkAirB1_M ExhMod_offsTExhVlvCorrnLamB1_M ExhMod_stTVlvMdl_C ExhMod_tExhVlvFcoB1_M ExhMod_tExhVlvHomB1_M ExhMod_tExhVlvHomHiVlvLftB1_M ExhMod_tiConTExhVlvFcoB1_T /end DEF_CHARACTERISTIC
 /begin REF_CHARACTERISTIC ExhMod_stTExo_C ExhMod_stTMdl_C /end REF_CHARACTERISTIC
 /begin IN_MEASUREMENT AirMod_ratChrgAirCyl B_bevab_msg B_sa_msg B_vheg_msg CEngDsT_t EngStrt_bStrtEnd Epm_nEng etazwist_w_msg ExhMod_mfExhVlvB1 ExhMod_tWallAryB1 InjSys_ratFuMTot IntkAirT_tIntkMnfld IntkAirT_tThrVlvUs lamsbg_w_msg redistb1_msg rri_w_msg /end IN_MEASUREMENT
 /begin OUT_MEASUREMENT ExhMod_effIgnAgAvrgB1 ExhMod_tExhDsVlvB1 ExhMod_tExhVlvB1 /end OUT_MEASUREMENT
 /begin LOC_MEASUREMENT cntrSumB1 effIgnAgSumB1 ExhMod_facTExhVlvCorrnIgnAgHomB1 ExhMod_facTExhVlvCorrnRri ExhMod_mfTExhVlvMdlB1 ExhMod_offsCorrnTExhVlvIntkAirB1 ExhMod_offsTExhVlvCorrnIgnAgHomB1 ExhMod_offsTExhVlvCorrnLamB1 ExhMod_ratLamVlvB1 ExhMod_ratRelAirFuFillgB1 ExhMod_tExhVlvCorrdB1 ExhMod_tExhVlvCorrdFildB1 ExhMod_tExhVlvCorrdIgnAgB1 ExhMod_tExhVlvCorrdLamThrB1 ExhMod_tExhVlvHomB1 ExhMod_tExhVlvIntkAir ExhMod_tQstyExhVlvB1 TExhVlv_facCorrnIgnAgB1 TExhVlv_facCorrnLamB1 TExhVlv_offsCorrnIgnAgB1 TExhVlv_offsCorrnLamB1 /end LOC_MEASUREMENT
 FUNCTION_VERSION "1.19.0" /end FUNCTION
/begin FUNCTION ExhMod_TiEngOff "1.4.1     Calculation of Engine Off Time for ExhMod" /begin DEF_CHARACTERISTIC ExhMod_tiDlyEngStop_C ExhMod_tiSigHoldEngRunng_C /end DEF_CHARACTERISTIC
 /begin IN_MEASUREMENT SyC_ctPostDrvLeave TiOff_bStrtEndOffActive TiOff_cntrStrtEndOffRst TiOff_stTiStrtEndOff TiOff_tiStrtEndOff /end IN_MEASUREMENT
 /begin OUT_MEASUREMENT ExhMod_flgEngRunngTiEngOff ExhMod_flgTiEngOffVld ExhMod_tiEngOff /end OUT_MEASUREMENT
 /begin LOC_MEASUREMENT ExhMod_bStrtEndOffActiveLst ExhMod_cntrStrtEndOffRstLst ExhMod_flgEngRunngTiEngOffRaw ExhMod_tiSigHoldEngRunng ExhMod_tiStrtEndOff ExhMod_tiStrtEndOffLoc TiEngOff_ctReIni /end LOC_MEASUREMENT
 FUNCTION_VERSION "1.4.1" /end FUNCTION
/begin FUNCTION ExhMod_TIf "1.15.1    Conversion From Intern Temperatures Of The Exhaust Temperature Modell To The Sys"
 /begin DEF_CHARACTERISTIC ExhMod_facTauTExhB1_T ExhMod_idxSnsrB1_CA ExhMod_idxTCat1ExtdB1_CA ExhMod_idxTCat2ExtdB1_CA ExhMod_idxTExhB1_CA ExhMod_stTExhCat1_C ExhMod_stTExhCat2_C ExhMod_stTExhFltd_C ExhMod_stTExhMnfFirstPipY_C ExhMod_stTExhSnsr_C ExhMod_stTWallSnsr_C ExhMod_tauTExhCat1ExtdB1_CA ExhMod_tauTExhCat2ExtdB1_CA ExhMod_tauTExhMnfFirstPipYB1_CA ExhMod_tauTExhSnsrB1_CA ExhMod_tExhCat1ExtdAppl_CA ExhMod_tExhCat2ExtdAppl_CA ExhMod_tExhSnsrAppl_CA ExhMod_tMnfFirstPipYAppl_CA ExhMod_tWallSnsrAppl_CA /end DEF_CHARACTERISTIC
 /begin IN_MEASUREMENT CEngDsT_t EngStrt_bStrtEnd ExhMod_idxFrtBrickCatAryB1 ExhMod_idxLstBrickCatAryB1 ExhMod_mfExhMnfB1 ExhMod_nrBrickCatAryB1 ExhMod_tExhAryB1 ExhMod_tWallAryB1 /end IN_MEASUREMENT
 /begin OUT_MEASUREMENT ExhMod_tCat1AvrgB1 ExhMod_tCat1B1 ExhMod_tCat1EndB1 ExhMod_tCat1InB1 ExhMod_tCat1MaxB1 ExhMod_tCat1MinB1 ExhMod_tCat2AvrgB1 ExhMod_tCat2B1 ExhMod_tCat2EndB1 ExhMod_tCat2InB1 ExhMod_tCat2MaxB1 ExhMod_tCat2MinB1 ExhMod_tCatAryB1 ExhMod_tCatAvrgAryB1 ExhMod_tCatBrickAryB1 ExhMod_tCatInAryB1 ExhMod_tEng ExhMod_tExhCat1DsB1 ExhMod_tExhCat1UsAvrgB1 ExhMod_tExhCat1UsB1 ExhMod_tExhCat2DsB1 ExhMod_tExhCat2UsAvrgB1 ExhMod_tExhCat2UsB1 ExhMod_tExhCatDsAryB1 ExhMod_tExhCatUsAryB1 ExhMod_tExhFrtPipB1 ExhMod_tExhMnfB1 ExhMod_tExhMnfQstyB1 ExhMod_tExhS1B1 ExhMod_tExhS2B1 ExhMod_tExhSnsrAryB1 ExhMod_tWallCat1B1 ExhMod_tWallCat1EndB1 ExhMod_tWallCat1InB1 ExhMod_tWallCat2B1 ExhMod_tWallCat2EndB1 ExhMod_tWallCat2InB1 ExhMod_tWallMnfB1 ExhMod_tWallS1B1 ExhMod_tWallS2B1 ExhMod_tWallSnsrAryB1 /end OUT_MEASUREMENT
 FUNCTION_VERSION "1.15.1" /end FUNCTION
/begin FUNCTION ExhMod_TMdl "2.23.0    Temperature Model Exhaust System"
 /begin DEF_CHARACTERISTIC ExhMod_facIntrpnCoolgCrv_M ExhMod_idxIninSctn_CA ExhMod_cpAbsltCannB1_M ExhMod_cpAbsltPipCatB1_M ExhMod_egyEnthCmbExhGas_C ExhMod_egyEnthCmbHcCco_C ExhMod_egyEnthHcCco_C ExhMod_egyEnthRichExh_C ExhMod_facDistbnTDeltaExo_M ExhMod_facEffFcoReacn_M ExhMod_facEnvPCorrnHtcWallEnv_T ExhMod_facExoCorrnIgnAgHomB1_T ExhMod_facExoCorrnIgnAgHomCatHeatgB1_T ExhMod_facExoCorrnIgnAgHomCatHeatSustB1_T ExhMod_facExoCorrnLamB1_M ExhMod_facWghtMnfldCatExoCcoLam_M ExhMod_facWghtMnfldCatExoCcoTB1_T ExhMod_flgActvtExoCalcnTranLtr_C ExhMod_flgActvtExoCalcnTranRtl_C ExhMod_htcCatCannB1_M ExhMod_htcExhWallB1_M ExhMod_htcWallEnvB1_M ExhMod_ratLamThdLean_C ExhMod_ratLamThdRich_C ExhMod_stCfgExhSysB1_CA ExhMod_stCfgIninB1_CA ExhMod_stExoCalcnActvTransLtr_C ExhMod_stExoCat1Br1_C ExhMod_stSigQlyMskEnvT_C ExhMod_stTExo_C ExhMod_stTMdl1_C ExhMod_stTMdl2_C ExhMod_stTMdl_C ExhMod_tDeltaExoColdCatB1_CA ExhMod_tDeltaExoFco_M ExhMod_tDeltaExoHomB1_M ExhMod_tDeltaExoTotHomB1_M ExhMod_tDeltaExoTotHomCatHeatgB1_M ExhMod_tDeltaExoTotHomCatHeatSustB1_M ExhMod_tDeltaExoTranLtr_M ExhMod_tDeltaExoTranRtl_M ExhMod_tExhIninB1_CA ExhMod_tiConExoFco_T ExhMod_tiConExoTranLtr_T ExhMod_tiConExoTranRtl_T ExhMod_tReplcmtEnvTInvldEepFailr_C ExhMod_tThdIgnCatB1_CA /end DEF_CHARACTERISTIC
 /begin IN_MEASUREMENT AirMod_ratChrgAirCyl B_bevab_msg B_khakt_msg B_khakw_msg B_sa_msg Eep_EnvRamHist Eep_EnvRamInvld EnvT_t EnvT_t_Sq Epm_nEng ExhMod_effIgnAgAvrgB1 ExhMod_flgEngRunngTiEngOff ExhMod_flgTiEngOffVld ExhMod_idxFrtBrickCatAryB1 ExhMod_idxLstBrickCatAryB1 ExhMod_mfExhAryB1 ExhMod_mfExhVlvB1 ExhMod_nrBrickCatAryB1 ExhMod_rLamCatUsAryB1 ExhMod_tExhDsVlvB1 ExhMod_tiEngOff lamsbg_w_msg lamsons_w_msg PEnv_p redistb1_msg UEGO_rLamS1B1 VehV_v /end IN_MEASUREMENT
 /begin OUT_MEASUREMENT ExhMod_flgTIninCmpl ExhMod_ratLamAvrgB1 ExhMod_tEnvLoc ExhMod_tExhAryB1 ExhMod_tWallAryB1 TMdl_tiEngOff /end OUT_MEASUREMENT
 /begin LOC_MEASUREMENT ExhMod_cntrMplBricksB1 ExhMod_egyExoCatB1 ExhMod_facExoCorrnIgnAgHomB1 ExhMod_facExoCorrnLamB1 ExhMod_facWghtMnfldCatExoLamCcoB1 ExhMod_flgEngFrstRunng ExhMod_flgLamLeanB1 ExhMod_flgLamRichB1 ExhMod_flgTCalcnCoolgCrv ExhMod_flgTiEngOffNotPlausPwrFail ExhMod_flgTiEngOffPlausOld ExhMod_flgTIninSuc ExhMod_htcWallEnvB1 ExhMod_mfExoB1 ExhMod_pEnvTMdl ExhMod_pwrExoCorrdCatAryB1 ExhMod_pwrExoTranB1 ExhMod_ratLamCatUsB1 ExhMod_ratLamCcoB1 ExhMod_tCannMplBrickBank1 ExhMod_tCatNvAryB1 ExhMod_tDeltaCatBrAryB1 ExhMod_tDeltaExoCcoB1 ExhMod_tDeltaExoCcoCatB1 ExhMod_tDeltaExoCcoMnfldB1 ExhMod_tDeltaExoFcoB1 ExhMod_tDeltaExoMnfldB1 ExhMod_tDeltaExoTotB1 ExhMod_tDeltaExoTranLtrB1 ExhMod_tDeltaExoTranRtlB1 ExhMod_tiEngOffCorrn ExhMod_tWallNvAryB1 lamsbg_wloc TMdl_facInterpnCoolgCrv vfzg_wloc /end LOC_MEASUREMENT
 FUNCTION_VERSION "2.23.0" /end FUNCTION
/begin FUNCTION ExhMod_TspSnsrRels "1.9.0     TSP sensor heater release condition from ExhMod"
 /begin DEF_CHARACTERISTIC ExhMod_facEgyThdTspNoCatHeatgS1B1_M ExhMod_facEgyThdTspS1B1_M ExhMod_nrMaxColdStrtTspS1_C ExhMod_stTspSnsrRelsB1_CA ExhMod_stTspSnsrRels_C /end DEF_CHARACTERISTIC
 /begin IN_MEASUREMENT B_khakt_msg B_khan_msg CEngDsT_tStrtFrst EngStrt_bFrstStrtEnd ExhMod_cntrCldStrtS1B1 ExhMod_egyDewPntEndS1B1 ExhMod_egyThdDewPntEndS1B1 ExhMod_flgDewPntEndS1B1 ExhMod_tEngStrtDewDet ExhMod_tExhStrtS1B1 SyC_stSub /end IN_MEASUREMENT
 /begin OUT_MEASUREMENT ExhMod_flgDewPntEndRstTspS1B1 ExhMod_flgHeatgTspS1B1 /end OUT_MEASUREMENT
 /begin LOC_MEASUREMENT ExhMod_facEgyThdTspS1B1 ExhMod_flgCatHtgColdStrtTsp ExhMod_flgTspRelsNoRstS1B1 ExhMod_stSubOldTspSnsrRels /end LOC_MEASUREMENT
 FUNCTION_VERSION "1.9.0" /end FUNCTION
/begin FUNCTION FanCtl_Spd "104.5.0   Fan Control"
 /begin DEF_CHARACTERISTIC FanCtl_facAftRunCorrd_CUR FanCtl_flgSwtAntiFlickDeactv_C FanCtl_nAntiFlickThd_C FanCtl_nFanDecelHi_C FanCtl_nFanDecelLo_C FanCtl_nSpdHi_C FanCtl_nSpdLo_C FanCtl_pCooltPDeltaHi_C FanCtl_pCooltPHiHi_T FanCtl_pCooltPLoHi_C FanCtl_pCooltPLoLo_C FanCtl_pCooltPProhbHi_C FanCtl_pCooltPProhbLo_C FanCtl_pDutyPerdP11Hi_C FanCtl_pDutyPerdP11Lo_C FanCtl_pDutyPerdP12Hi_C FanCtl_pDutyPerdP12Lo_C FanCtl_pDutyPerdP13Hi_C FanCtl_pDutyPerdP13Lo_C FanCtl_pDutyPerdP14Hi_C FanCtl_pDutyPerdP14Lo_C FanCtl_pDutyPerdP1Hi_C FanCtl_pDutyPerdP1Lo_C FanCtl_pDutyPerdP21Hi_C FanCtl_pDutyPerdP21Lo_C FanCtl_pDutyPerdP22Hi_C FanCtl_pDutyPerdP22Lo_C FanCtl_pDutyPerdP23Hi_C FanCtl_pDutyPerdP23Lo_C FanCtl_pDutyPerdP24Hi_C FanCtl_pDutyPerdP24Lo_C FanCtl_pDutyPerdP2Hi_C FanCtl_pDutyPerdP2Lo_C FanCtl_pDutyPerdP3HiHi_C FanCtl_pDutyPerdP3HiLo_C FanCtl_pDutyPerdP3Hi_C FanCtl_pDutyPerdP3Lo_C FanCtl_pDutyPerdP4Hi_C FanCtl_pDutyPerdP4Lo_C FanCtl_rAftRunDutyPred_C FanCtl_rAftRunEnd_C FanCtl_rDutyPredHi_C FanCtl_rDutyPredLo_C FanCtl_rDutyPredMid1_C FanCtl_rDutyPredMid2_C FanCtl_rFailSafeDutyPerd_C FanCtl_rFanDutyHi_C FanCtl_rFanDutyLo_C FanCtl_rFanDutyOff_C FanCtl_rPDpdtDutyPerd11_C FanCtl_rPDpdtDutyPerd12_C FanCtl_rPDpdtDutyPerd13_C FanCtl_rPDpdtDutyPerd14_C FanCtl_rPDpdtDutyPerd15_C FanCtl_rPDpdtDutyPerd1_C FanCtl_rPDpdtDutyPerd21_C FanCtl_rPDpdtDutyPerd22_C FanCtl_rPDpdtDutyPerd23_C FanCtl_rPDpdtDutyPerd24_C FanCtl_rPDpdtDutyPerd25_C FanCtl_rPDpdtDutyPerd2_C FanCtl_rPDpdtDutyPerd3_C FanCtl_rPDpdtDutyPerd4_C FanCtl_rPDpdtDutyPerd5_C FanCtl_rRadrFanDutyHi_C FanCtl_rTDpdtDutyPerd1_C FanCtl_rTDpdtDutyPerd2_C FanCtl_rTDpdtDutyPerd3_C FanCtl_rTDpdtDutyPerd4_C FanCtl_stACCooltPSnsr_C FanCtl_swtPWMFanActv_C FanCtl_swtTW2SnsrAvl_C FanCtl_tCooltTHi_C FanCtl_tCooltTLoHi_C FanCtl_tCooltTLoLo_C FanCtl_tCooltTLo_C FanCtl_tCooltT_C FanCtl_tDutyPerdT1Hi_C FanCtl_tDutyPerdT1Lo_C FanCtl_tDutyPerdT2Hi_C FanCtl_tDutyPerdT2Lo_C FanCtl_tDutyPerdT3Hi_C FanCtl_tDutyPerdT3Lo_C FanCtl_tiACGFixdMod_C FanCtl_tiAftRun_C FanCtl_tiAftRun_CUR FanCtl_tiAntiFlickLim_C FanCtl_tiImdtHiStgOnDly_C FanCtl_tiRlyCtrlDly_C FanCtl_tiSpdOffDly_C FanCtl_tiSpdOnDly_C FanCtl_tiTrqResvFan1_C FanCtl_tiTrqResvFan2_C FanCtl_tqThrIdleTqValHi_C FanCtl_tqThrIdleTqValLo_C FanCtl_uAntiFlickThd_C FanCtl_uDutyPerdUHi_C FanCtl_uDutyPerdULo_C FanCtl_uFailSafeBlowrU_C FanCtl_vLoVehSpdHi_C FanCtl_vModSelnSpdHiHi_C FanCtl_vModSelnSpdHiLo_C FanCtl_vModSelnSpdLoHi_C FanCtl_vModSelnSpdLoLo_C FanCtl_vSpdHiHi_C FanCtl_vSpdHiLo_C FanCtl_vSpdLoHi_C FanCtl_vSpdLoLo_C /end DEF_CHARACTERISTIC
 /begin IN_MEASUREMENT ACCtl_stSwtAc AirC_pClnt Alt_stSel Alt_uDes BattU_u Com_stISSRelsPreNotif Com_uFrntBlowrU Com_uMICUTxBlowrU CoVeh_stEngStrtOrd CoVM_trqLead ElecLd_stAutoAC ElecLd_stHdLiInfo Epm_nEng FanCtl_stFanCtrlEnd Fan_r Fan_r2 GlbDa_tEnv HdLi_flgActv PthSet_bOvrRun PT_stTraType SrvCSwt_st Strt_stStaActv SyC_ctPostDrvLeave T15_st Tra_stCrkNotCmpl TSDa_tClntRadOut TS_tClntEngOut VehV_v /end IN_MEASUREMENT
 /begin OUT_MEASUREMENT FanCtl_bTrqResvFan1 FanCtl_bTrqResvFan2 FanCtl_flgACGOn FanCtl_flgAftRunActv FanCtl_flgAntiFlickActv FanCtl_rPDpdtDutyPerd FanCtl_rPTDpdtDutyPerd FanCtl_rTDpdtDutyPerd FanCtl_st FanCtl_stPDpdtDutyHiDmd FanCtl_stStg FanCtl_stTDpdtDutyHiDmd FanCtl_swtTW2SnsrAvl FanCtl_tClnt /end OUT_MEASUREMENT
 /begin LOC_MEASUREMENT FanCtl_cntrReIni FanCtl_flgActvCooltTHi FanCtl_flgActvCooltTLo FanCtl_flgActvSpdOld FanCtl_flgAntiFlickHiStg FanCtl_flgFailActn FanCtl_flgFanCooltPHiSts FanCtl_flgFanCooltPLoSts FanCtl_flgHiDlyCtrlProhbSts FanCtl_flgHiStgSt FanCtl_flgIdleStopCdn FanCtl_flgImdtHiStg FanCtl_flgLowStgSt FanCtl_flgXPostDrv_mp FanCtl_pClnt FanCtl_rFan1 FanCtl_rFan2 FanCtl_stActvHi_MP FanCtl_stActvLo_MP FanCtl_stCooltPHiCtrlHys FanCtl_stCooltPLoCtrlHys FanCtl_stCooltPProhbHysOutp FanCtl_stFanDecel_MP FanCtl_stFanRlyCtrl_MP FanCtl_stHiModDutyPred_MP FanCtl_stLoModDutyPred_MP FanCtl_stMidModDutyPred_MP FanCtl_stMod FanCtl_stModSelnSpdHi_MP FanCtl_stModSelnSpdLo_MP FanCtl_stSpd_mp FanCtl_stTDpdtDutyPerd_MP FanCtl_stThrIdle FanCtl_tCooltT FanCtl_tiAftRunRmn FanCtl_tiAR1S_mp FanCtl_tiSpdDiffTmr FanCtl_uBlowrFanU /end LOC_MEASUREMENT
 FUNCTION_VERSION "104.5.0" /end FUNCTION
/begin FUNCTION Fans_Trq "24.1.0    Fans Torque Request"
 /begin DEF_CHARACTERISTIC Fans_tiTrqConsFltFan1_C Fans_tiTrqConsFltFan2_C Fans_tiTrqResvFan1_C Fans_tiTrqResvFan2_C Fans_tiTrqResvFltFan1_C Fans_tiTrqResvFltFan2_C Fans_trqConsFan1_CUR Fans_trqConsFan2_CUR Fans_trqResvFan1_C Fans_trqResvFan1_CUR Fans_trqResvFan2_C Fans_trqResvFan2_CUR /end DEF_CHARACTERISTIC
 /begin IN_MEASUREMENT Epm_nEng FanCtl_bTrqResvFan1 FanCtl_bTrqResvFan2 Fan_r Fan_r2 T15_st /end IN_MEASUREMENT
 /begin OUT_MEASUREMENT Fans_trqCons Fans_trqResv /end OUT_MEASUREMENT
 /begin LOC_MEASUREMENT Fans_trqConsFan1_MP Fans_trqConsFan2_MP Fans_trqConsUnFltFan1_MP Fans_trqConsUnFltFan2_MP Fans_trqResvFan1_MP Fans_trqResvFan2_MP Fans_trqResvUnFltFan1_MP Fans_trqResvUnFltFan2_MP /end LOC_MEASUREMENT
 FUNCTION_VERSION "24.1.0" /end FUNCTION
/begin COMPU_METHOD AirMassPerTime_float "" RAT_FUNC "%6.2" "Kg/h" COEFFS 0 1 0 0 0 1 /end COMPU_METHOD
/begin COMPU_METHOD B_TRUE "" TAB_VERB "%6.3" "" COMPU_TAB_REF B_TRUE /end COMPU_METHOD
/begin COMPU_VTAB B_TRUE "" TAB_VERB 2 0 "FALSE" 1 "TRUE" /end COMPU_VTAB
/begin COMPU_METHOD dez "" RAT_FUNC "%6.2" "" COEFFS 0 1 0 0 0 1 /end COMPU_METHOD
/begin COMPU_METHOD EngN "" RAT_FUNC "%6.3" "rpm" COEFFS 0 2 0 0 0 1 /end COMPU_METHOD
/begin COMPU_METHOD ExeCon_State_02 "" TAB_VERB "%6.3" "" COMPU_TAB_REF ExeCon_State_02 /end COMPU_METHOD
/begin COMPU_VTAB ExeCon_State_02 "" TAB_VERB 7 0 "SYC_INI" 1 "SYC_INISYN" 2 "SYC_INIEND" 3 "SYC_PREDRIVE" 4 "SYC_DRIVE" 5 "SYC_POSTDRIVE" 6 "SYC_POST_OS_EXIT" /end COMPU_VTAB
/begin COMPU_METHOD Fact1 "" RAT_FUNC "%6.4" "-" COEFFS 0 128 0 0 0 1 /end COMPU_METHOD
/begin COMPU_METHOD fak_q0p000244 "" RAT_FUNC "%6.5" "-" COEFFS 0 65536 0 0 0 16 /end COMPU_METHOD
/begin COMPU_METHOD fak_q0p00174_JsK "" RAT_FUNC "%6.4" "J/sK" COEFFS 0 576 0 0 0 1 /end COMPU_METHOD
/begin COMPU_METHOD fak_q0p2222_JK "" RAT_FUNC "%6.3" "J/K" COEFFS 0 9 0 0 0 2 /end COMPU_METHOD
/begin COMPU_METHOD fak_q16_hPahPa "" RAT_FUNC "%6.1" "hPa*hPa" COEFFS 0 1 0 0 0 16 /end COMPU_METHOD
/begin COMPU_METHOD fak_q3p0518Em5 "" RAT_FUNC "%7.6" "" COEFFS 0 32768 0 0 0 1 /end COMPU_METHOD
/begin COMPU_METHOD fak_q4p6875Em4 "" RAT_FUNC "%6.5" "-" COEFFS 0 6400 0 0 0 3 /end COMPU_METHOD
/begin COMPU_METHOD fak_q4p883Em4 "" RAT_FUNC "%6.5" "-" COEFFS 0 65536 0 0 0 32 /end COMPU_METHOD
/begin COMPU_METHOD fak_q6p1035Em5 "" RAT_FUNC "%7.6" "-" COEFFS 0 65536 0 0 0 4 /end COMPU_METHOD
/begin COMPU_METHOD fak_sb_b2 "" RAT_FUNC "%6.4" "-" COEFFS 0 256 0 0 0 4 /end COMPU_METHOD
/begin COMPU_METHOD fak_ub_b1 "" RAT_FUNC "%6.4" "-" COEFFS 0 256 0 0 0 1 /end COMPU_METHOD
/begin COMPU_METHOD fak_ub_b2 "" RAT_FUNC "%8.5" "-" COEFFS 0 256 0 0 0 2 /end COMPU_METHOD
/begin COMPU_METHOD fak_uw_b1 "" RAT_FUNC "%7.6" "-" COEFFS 0 65536 0 0 0 1 /end COMPU_METHOD
/begin COMPU_METHOD fak_uw_b16 "" RAT_FUNC "%6.5" "-" COEFFS 0 65536 0 0 0 16 /end COMPU_METHOD
/begin COMPU_METHOD fak_uw_b2 "" RAT_FUNC "%7.6" "-" COEFFS 0 65536 0 0 0 2 /end COMPU_METHOD
/begin COMPU_METHOD fak_uw_b64 "" RAT_FUNC "%6.5" "-" COEFFS 0 65536 0 0 0 64 /end COMPU_METHOD
/begin COMPU_METHOD HtFlw_Fl "" RAT_FUNC "%6.2" "J/s" COEFFS 0 1 0 0 0 1 /end COMPU_METHOD
/begin COMPU_METHOD LIGOV_CHGEAR_SY_Compu "" TAB_VERB "%6.3" "" COMPU_TAB_REF LIGOV_CHGEAR_SY_Compu /end COMPU_METHOD
/begin COMPU_VTAB LIGOV_CHGEAR_SY_Compu "" TAB_VERB 2 0 "False" 1 "True" /end COMPU_VTAB
/begin COMPU_METHOD LIGOV_CHSTRT_SY_Compu "" TAB_VERB "%6.3" "" COMPU_TAB_REF LIGOV_CHSTRT_SY_Compu /end COMPU_METHOD
/begin COMPU_VTAB LIGOV_CHSTRT_SY_Compu "" TAB_VERB 2 0 "False" 1 "True" /end COMPU_VTAB
/begin COMPU_METHOD LIGOV_HDC_SY_Compu "" TAB_VERB "%6.3" "" COMPU_TAB_REF LIGOV_HDC_SY_Compu /end COMPU_METHOD
/begin COMPU_VTAB LIGOV_HDC_SY_Compu "" TAB_VERB 2 0 "False" 1 "True" /end COMPU_VTAB
/begin COMPU_METHOD LIGOV_NUMIPAR_SY_Compu "" RAT_FUNC "%6.2" "" COEFFS 0 1 0 0 0 1 /end COMPU_METHOD
/begin COMPU_METHOD LIGOV_NUMPARCNVSIZE_SC_Compu "" RAT_FUNC "%6.2" "" COEFFS 0 1 0 0 0 1 /end COMPU_METHOD
/begin COMPU_METHOD LIGOV_NUMPPAR_SY_Compu "" RAT_FUNC "%6.2" "" COEFFS 0 1 0 0 0 1 /end COMPU_METHOD
/begin COMPU_METHOD LIGOV_PRECTLD_SY_Compu "" TAB_VERB "%6.3" "" COMPU_TAB_REF LIGOV_PRECTLD_SY_Compu /end COMPU_METHOD
/begin COMPU_VTAB LIGOV_PRECTLD_SY_Compu "" TAB_VERB 2 0 "False" 1 "True" /end COMPU_VTAB
/begin COMPU_METHOD LIGOV_SEPPRECTL_SY_Compu "" TAB_VERB "%6.3" "" COMPU_TAB_REF LIGOV_SEPPRECTL_SY_Compu /end COMPU_METHOD
/begin COMPU_VTAB LIGOV_SEPPRECTL_SY_Compu "" TAB_VERB 2 0 "False" 1 "True" /end COMPU_VTAB
/begin COMPU_METHOD LIMENGTEMP_SY_Compu "" TAB_VERB "%6.3" "" COMPU_TAB_REF LIMENGTEMP_SY_Compu /end COMPU_METHOD
/begin COMPU_VTAB LIMENGTEMP_SY_Compu "" TAB_VERB 2 0 "False" 1 "True" /end COMPU_VTAB
/begin COMPU_METHOD LIMEXHTEMP_SY_Compu "" TAB_VERB "%6.3" "" COMPU_TAB_REF LIMEXHTEMP_SY_Compu /end COMPU_METHOD
/begin COMPU_VTAB LIMEXHTEMP_SY_Compu "" TAB_VERB 2 0 "False" 1 "True" /end COMPU_VTAB
/begin COMPU_METHOD LIMNMNFLDT_SC_Compu "" TAB_VERB "%6.3" "" COMPU_TAB_REF LIMNMNFLDT_SC_Compu /end COMPU_METHOD
/begin COMPU_VTAB LIMNMNFLDT_SC_Compu "" TAB_VERB 2 0 "False" 1 "True" /end COMPU_VTAB
/begin COMPU_METHOD LINIPCORETYPE_SC_Compu "" TAB_VERB "%6.3" "" COMPU_TAB_REF LINIPCORETYPE_SC_Compu /end COMPU_METHOD
/begin COMPU_VTAB LINIPCORETYPE_SC_Compu "" TAB_VERB 2 0 "0" 1 "1" /end COMPU_VTAB
/begin COMPU_METHOD LIN_SY_Compu "" TAB_VERB "%6.3" "" COMPU_TAB_REF LIN_SY_Compu /end COMPU_METHOD
/begin COMPU_VTAB LIN_SY_Compu "" TAB_VERB 2 0 "False" 1 "True" /end COMPU_VTAB
/begin COMPU_METHOD LIVC_SC_Compu "" TAB_VERB "%6.3" "" COMPU_TAB_REF LIVC_SC_Compu /end COMPU_METHOD
/begin COMPU_VTAB LIVC_SC_Compu "" TAB_VERB 2 0 "no_LIVC" 1 "LIVC" /end COMPU_VTAB
/begin COMPU_METHOD LLKE_SY_Compu "" TAB_VERB "%6.3" "" COMPU_TAB_REF LLKE_SY_Compu /end COMPU_METHOD
/begin COMPU_VTAB LLKE_SY_Compu "" TAB_VERB 2 0 "0" 1 "1" /end COMPU_VTAB
/begin COMPU_METHOD LLRNSNF_FZNSMGASIZE_SY_Compu "" RAT_FUNC "%6.2" "" COEFFS 0 1 0 0 0 1 /end COMPU_METHOD
/begin COMPU_METHOD LLZWAZ_SY_Compu "" TAB_VERB "%6.3" "" COMPU_TAB_REF LLZWAZ_SY_Compu /end COMPU_METHOD
/begin COMPU_VTAB LLZWAZ_SY_Compu "" TAB_VERB 2 0 "False" 1 "True" /end COMPU_VTAB
/begin COMPU_METHOD LNCHCTRL_SC_Compu "" TAB_VERB "%6.3" "" COMPU_TAB_REF LNCHCTRL_SC_Compu /end COMPU_METHOD
/begin COMPU_VTAB LNCHCTRL_SC_Compu "" TAB_VERB 2 0 "False" 1 "True" /end COMPU_VTAB
/begin COMPU_METHOD LOKINSTRT_SC_Compu "" TAB_VERB "%6.3" "" COMPU_TAB_REF LOKINSTRT_SC_Compu /end COMPU_METHOD
/begin COMPU_VTAB LOKINSTRT_SC_Compu "" TAB_VERB 2 0 "Not_Avl" 1 "Avl" /end COMPU_VTAB
/begin COMPU_METHOD LORNGTYP_SY_Compu "" TAB_VERB "%6.3" "" COMPU_TAB_REF LORNGTYP_SY_Compu /end COMPU_METHOD
/begin COMPU_VTAB LORNGTYP_SY_Compu "" TAB_VERB 2 0 "False" 1 "True" /end COMPU_VTAB
/begin COMPU_METHOD LORNG_SY_Compu "" TAB_VERB "%6.3" "" COMPU_TAB_REF LORNG_SY_Compu /end COMPU_METHOD
/begin COMPU_VTAB LORNG_SY_Compu "" TAB_VERB 2 0 "FALSE" 1 "TRUE" /end COMPU_VTAB
/begin COMPU_METHOD LOWSCAVRATE_SC_Compu "" TAB_VERB "%6.3" "" COMPU_TAB_REF LOWSCAVRATE_SC_Compu /end COMPU_METHOD
/begin COMPU_VTAB LOWSCAVRATE_SC_Compu "" TAB_VERB 2 0 "False" 1 "True" /end COMPU_VTAB
/begin COMPU_METHOD LPSYS_CTLTYP_SY_Compu "" TAB_VERB "%6.3" "" COMPU_TAB_REF LPSYS_CTLTYP_SY_Compu /end COMPU_METHOD
/begin COMPU_VTAB LPSYS_CTLTYP_SY_Compu "" TAB_VERB 3 0 "LPSYS_STD" 1 "LPSYS_CLSDLOP" 2 "LPSYS_OPNLOP" /end COMPU_VTAB
/begin COMPU_METHOD LSFX4_SY_Compu "" TAB_VERB "%6.3" "" COMPU_TAB_REF LSFX4_SY_Compu /end COMPU_METHOD
/begin COMPU_VTAB LSFX4_SY_Compu "" TAB_VERB 2 0 "False" 1 "True" /end COMPU_VTAB
/begin COMPU_METHOD LSM_SY_Compu "" TAB_VERB "%6.3" "" COMPU_TAB_REF LSM_SY_Compu /end COMPU_METHOD
/begin COMPU_VTAB LSM_SY_Compu "" TAB_VERB 2 0 "0" 1 "1" /end COMPU_VTAB
/begin COMPU_METHOD LSUADV_SY_Compu "" TAB_VERB "%6.3" "" COMPU_TAB_REF LSUADV_SY_Compu /end COMPU_METHOD
/begin COMPU_VTAB LSUADV_SY_Compu "" TAB_VERB 2 0 "False" 1 "True" /end COMPU_VTAB
/begin COMPU_METHOD LSUDLYFLT_SY_Compu "" TAB_VERB "%6.3" "" COMPU_TAB_REF LSUDLYFLT_SY_Compu /end COMPU_METHOD
/begin COMPU_VTAB LSUDLYFLT_SY_Compu "" TAB_VERB 2 0 "False" 1 "True" /end COMPU_VTAB
/begin COMPU_METHOD LSUDYNEXCLADP_SY_Compu "" TAB_VERB "%6.3" "" COMPU_TAB_REF LSUDYNEXCLADP_SY_Compu /end COMPU_METHOD
/begin COMPU_VTAB LSUDYNEXCLADP_SY_Compu "" TAB_VERB 2 0 "False" 1 "True" /end COMPU_VTAB
/begin COMPU_METHOD LSUDYNMONINTR_SY_Compu "" TAB_VERB "%6.3" "" COMPU_TAB_REF LSUDYNMONINTR_SY_Compu /end COMPU_METHOD
/begin COMPU_VTAB LSUDYNMONINTR_SY_Compu "" TAB_VERB 2 0 "False" 1 "True" /end COMPU_VTAB
/begin COMPU_METHOD LSUHTRCPLMON_SY_Compu "" TAB_VERB "%6.3" "" COMPU_TAB_REF LSUHTRCPLMON_SY_Compu /end COMPU_METHOD
/begin COMPU_VTAB LSUHTRCPLMON_SY_Compu "" TAB_VERB 2 0 "False" 1 "True" /end COMPU_VTAB
/begin COMPU_METHOD LSU_CT_SENSORS_SY_Compu "" TAB_VERB "%6.3" "" COMPU_TAB_REF LSU_CT_SENSORS_SY_Compu /end COMPU_METHOD
/begin COMPU_VTAB LSU_CT_SENSORS_SY_Compu "" TAB_VERB 5 0 "0" 1 "1" 2 "2" 3 "3" 4 "4" /end COMPU_VTAB
/begin COMPU_METHOD Mass2Temp_q0p000003 "" RAT_FUNC "%8.7" "Kg/K" COEFFS 0 333333.333333333 0 0 0 1 /end COMPU_METHOD
/begin COMPU_METHOD MassPerTimeq0p00001 "" RAT_FUNC "%8.7" "g/s" COEFFS 0 100000 0 0 0 1 /end COMPU_METHOD
/begin COMPU_METHOD MassPerTimeq0p001 "" RAT_FUNC "%6.5" "g/s" COEFFS 0 1000 0 0 0 1 /end COMPU_METHOD
/begin COMPU_METHOD Mass_q1 "" RAT_FUNC "%6.2" "g" COEFFS 0 1 0 0 0 1 /end COMPU_METHOD
/begin COMPU_METHOD MAXPREDMODSWT_SC_Compu "" RAT_FUNC "%6.2" "" COEFFS 0 1 0 0 0 1 /end COMPU_METHOD
/begin COMPU_METHOD MAXRNGREQVEH_SY_Compu "" TAB_VERB "%6.3" "" COMPU_TAB_REF MAXRNGREQVEH_SY_Compu /end COMPU_METHOD
/begin COMPU_VTAB MAXRNGREQVEH_SY_Compu "" TAB_VERB 2 0 "MAXRNGREQVEHOFF" 1 "MAXRNGREQVEHON" /end COMPU_VTAB
/begin COMPU_METHOD MAXTQPRDN_SC_Compu "" TAB_VERB "%6.3" "" COMPU_TAB_REF MAXTQPRDN_SC_Compu /end COMPU_METHOD
/begin COMPU_VTAB MAXTQPRDN_SC_Compu "" TAB_VERB 2 0 "False" 1 "True" /end COMPU_VTAB
/begin COMPU_METHOD mgrad_q1p526Em6_kg_DIV_h "" RAT_FUNC "%8.7" "kg/h" COEFFS 0 65536 0 0 0 0.1 /end COMPU_METHOD
/begin COMPU_METHOD mgrad_q1_mgdivs "" RAT_FUNC "%6.2" "mg/s" COEFFS 0 1 0 0 0 1 /end COMPU_METHOD
/begin COMPU_METHOD m_q0p0277_g "" RAT_FUNC "%6.4" "g" COEFFS 0 36 0 0 0 1 /end COMPU_METHOD
/begin COMPU_METHOD m_q0p1 "" RAT_FUNC "%6.3" "kg/h" COEFFS 0 10 0 0 0 1 /end COMPU_METHOD
/begin COMPU_METHOD m_q0p1_mg "" RAT_FUNC "%6.3" "mg" COEFFS 0 1 0 0 0 0.1 /end COMPU_METHOD
/begin COMPU_METHOD m_q0p2_mg "" RAT_FUNC "%6.3" "mg" COEFFS 0 1 0 0 0 0.2 /end COMPU_METHOD
/begin COMPU_METHOD m_q0p2_mg_DIV_s "" RAT_FUNC "%6.3" "mg/s" COEFFS 0 1 0 0 0 0.2 /end COMPU_METHOD
/begin COMPU_METHOD m_q1_mg "" RAT_FUNC "%6.2" "mg" COEFFS 0 1 0 0 0 1 /end COMPU_METHOD
/begin COMPU_METHOD m_uw_b6553p5 "" RAT_FUNC "%6.3" "kg/h" COEFFS 0 1 0 0 0 0.1 /end COMPU_METHOD
/begin COMPU_METHOD nmot_q0p5 "" RAT_FUNC "%6.3" "1/min" COEFFS 0 2 0 0 0 1 /end COMPU_METHOD
/begin COMPU_METHOD OneToOne "" RAT_FUNC "%6.2" "-" COEFFS 0 1 0 0 0 1 /end COMPU_METHOD
/begin COMPU_METHOD Perc_q0p0234375_COMPU "" RAT_FUNC "%6.4" "%" COEFFS 0 65536 0 0 0 1536 /end COMPU_METHOD
/begin COMPU_METHOD Prc "" RAT_FUNC "%6.4" "%" COEFFS 0 81.92 0 0 0 1 /end COMPU_METHOD
/begin COMPU_METHOD PresAC_hPa "" RAT_FUNC "%6.2" "hPa" COEFFS 0 0.5 0 0 0 1 /end COMPU_METHOD
/begin COMPU_METHOD p_q0p039 "" RAT_FUNC "%6.4" "hPa" COEFFS 0 256 0 0 0 10 /end COMPU_METHOD
/begin COMPU_METHOD p_uw_q0p039 "" RAT_FUNC "%6.4" "hPa" COEFFS 0 256 0 0 0 10 /end COMPU_METHOD
/begin COMPU_METHOD q1024_J_DIV_kg "" RAT_FUNC "%7.0" "J/kg" COEFFS 0 1 0 0 0 1024 /end COMPU_METHOD
/begin COMPU_METHOD q5p922Em2_JK "" RAT_FUNC "%6.4" "J/K" COEFFS 0 2304000 0 0 0 136448 /end COMPU_METHOD
/begin COMPU_METHOD qm_q4p883Em4 "" RAT_FUNC "%6.5" "J/mg" COEFFS 0 2048 0 0 0 1 /end COMPU_METHOD
/begin COMPU_METHOD RBPtCel_m_1p0_5 "" RAT_FUNC "%6.2" "mg" COEFFS 0 1 0 0 0 1 /end COMPU_METHOD
/begin COMPU_METHOD RBPtCel_p_1p0_3 "" RAT_FUNC "%6.2" "kPa" COEFFS 0 1 0 0 0 1 /end COMPU_METHOD
/begin COMPU_METHOD RBPtCel_u_0p05_1 "" RAT_FUNC "%6.4" "V" COEFFS 0 20 0 0 0 1 /end COMPU_METHOD
/begin COMPU_METHOD rel_q0p0234 "" RAT_FUNC "%6.4" "%" COEFFS 0 128 0 0 0 3 /end COMPU_METHOD
/begin COMPU_METHOD rel_q0p5 "" RAT_FUNC "%6.3" "%" COEFFS 0 1 0 0 0 0.5 /end COMPU_METHOD
/begin COMPU_METHOD rel_ub_b127p5 "" RAT_FUNC "%6.3" "%" COEFFS 0 2 0 0 0 1 /end COMPU_METHOD
/begin COMPU_METHOD rel_uw_b100 "" RAT_FUNC "%6.4" "%" COEFFS 0 65536 0 0 0 100 /end COMPU_METHOD
/begin COMPU_METHOD rel_uw_b3072 "" RAT_FUNC "%6.4" "%" COEFFS 0 65536 0 0 0 3072 /end COMPU_METHOD
/begin COMPU_METHOD spg_q0p00488 "" RAT_FUNC "%6.4" "V" COEFFS 0 1024 0 0 0 5 /end COMPU_METHOD
/begin COMPU_METHOD spg_uw_q0p00488 "" RAT_FUNC "%6.4" "V" COEFFS 0 1024 0 0 0 5 /end COMPU_METHOD
/begin COMPU_METHOD t100msxs_uw_b6553p5 "" RAT_FUNC "%6.3" "s" COEFFS 0 1 0 0 0 0.1 /end COMPU_METHOD
/begin COMPU_METHOD t1sxs_uw_q1 "" RAT_FUNC "%6.2" "s" COEFFS 0 1 0 0 0 1 /end COMPU_METHOD
/begin COMPU_METHOD Temp_Cels "" RAT_FUNC "%6.1" "deg C" COEFFS 0 10 2731.4 0 0 1 /end COMPU_METHOD
/begin COMPU_METHOD temp_q0p0234 "" RAT_FUNC "%6.4" "K" COEFFS 0 256 0 0 0 6 /end COMPU_METHOD
/begin COMPU_METHOD temp_q0p0234_o273 "" RAT_FUNC "%6.1" "Grad C" COEFFS 0 1 273.15 0 0 0.0234375 /end COMPU_METHOD
/begin COMPU_METHOD temp_q3p57Em7_om273 "" RAT_FUNC "%6.1" "Grad C" COEFFS 0 8388608 2291348275.2 0 0 3 /end COMPU_METHOD
/begin COMPU_METHOD temp_sw_q0p125 "" RAT_FUNC "%6.3" "K" COEFFS 0 8 0 0 0 1 /end COMPU_METHOD
/begin COMPU_METHOD temp_uw_q0p0468 "" RAT_FUNC "%6.4" "K" COEFFS 0 256 0 0 0 12 /end COMPU_METHOD
/begin COMPU_METHOD TimeDelay_s "" RAT_FUNC "%6.1" "s" COEFFS 0 0 1 0 0.00023283064365387 0 /end COMPU_METHOD
/begin COMPU_METHOD TimeEngOn "" RAT_FUNC "%6.2" "s" COEFFS 0 1 0 0 0 1 /end COMPU_METHOD
/begin COMPU_METHOD Time_ms "" RAT_FUNC "%6.1" "ms" COEFFS 0 0.1 0 0 0 1 /end COMPU_METHOD
/begin COMPU_METHOD Time_s "" RAT_FUNC "%6.4" "s" COEFFS 0 100 0 0 0 1 /end COMPU_METHOD
/begin COMPU_METHOD Trq "" RAT_FUNC "%6.3" "Nm" COEFFS 0 10 0 0 0 1 /end COMPU_METHOD
/begin COMPU_METHOD TrqPrpHigh "" RAT_FUNC "%6.3" "Nm" COEFFS 0 10 0 0 0 1 /end COMPU_METHOD
/begin COMPU_METHOD t_q0p01 "" RAT_FUNC "%6.4" "s" COEFFS 0 100 0 0 0 1 /end COMPU_METHOD
/begin COMPU_METHOD t_q0p02 "" RAT_FUNC "%6.4" "s" COEFFS 0 100 0 0 0 2 /end COMPU_METHOD
/begin COMPU_METHOD t_q0p05 "" RAT_FUNC "%6.4" "s" COEFFS 0 100 0 0 0 5 /end COMPU_METHOD
/begin COMPU_METHOD t_q1 "" RAT_FUNC "%6.2" "s" COEFFS 0 1 0 0 0 1 /end COMPU_METHOD
/begin COMPU_METHOD Vel "" RAT_FUNC "%6.4" "km/h" COEFFS 0 100 0 0 0 1 /end COMPU_METHOD
/begin COMPU_METHOD vfzg_uw_b512 "" RAT_FUNC "%6.4" "km/h" COEFFS 0 65536 0 0 0 512 /end COMPU_METHOD
/begin COMPU_METHOD Volt_Batt "" RAT_FUNC "%6.1" "mV" COEFFS 0 0.05 0 0 0 1 /end COMPU_METHOD
/begin COMPU_METHOD zk50msxs_uw_b3276p8 "" RAT_FUNC "%6.1" "s" COEFFS 0 0 65536 0 20 0 /end COMPU_METHOD
/begin RECORD_LAYOUT RB_Curve_R32_U16_Static NO_AXIS_PTS_X 1 ULONG AXIS_PTS_X 2 FLOAT32_IEEE INDEX_INCR DIRECT FNC_VALUES 3 UWORD COLUMN_DIR DIRECT STATIC_RECORD_LAYOUT /end RECORD_LAYOUT
/begin RECORD_LAYOUT RB_Curve_S16_S16 NO_AXIS_PTS_X 1 SWORD AXIS_PTS_X 2 SWORD INDEX_INCR DIRECT FNC_VALUES 3 SWORD COLUMN_DIR DIRECT /end RECORD_LAYOUT
/begin RECORD_LAYOUT RB_Curve_S16_S8_Static NO_AXIS_PTS_X 1 SWORD AXIS_PTS_X 2 SWORD INDEX_INCR DIRECT FNC_VALUES 3 SBYTE COLUMN_DIR DIRECT STATIC_RECORD_LAYOUT /end RECORD_LAYOUT
/begin RECORD_LAYOUT RB_Curve_U16_U16 NO_AXIS_PTS_X 1 UWORD AXIS_PTS_X 2 UWORD INDEX_INCR DIRECT FNC_VALUES 3 UWORD COLUMN_DIR DIRECT /end RECORD_LAYOUT
/begin RECORD_LAYOUT RB_Curve_U16_U8_Static NO_AXIS_PTS_X 1 UWORD AXIS_PTS_X 2 UWORD INDEX_INCR DIRECT FNC_VALUES 3 UBYTE COLUMN_DIR DIRECT STATIC_RECORD_LAYOUT /end RECORD_LAYOUT
/begin RECORD_LAYOUT RB_Curve_U8_U16_Static NO_AXIS_PTS_X 1 UBYTE AXIS_PTS_X 2 UBYTE INDEX_INCR DIRECT FNC_VALUES 3 UWORD COLUMN_DIR DIRECT STATIC_RECORD_LAYOUT /end RECORD_LAYOUT
/begin RECORD_LAYOUT RB_Curve_U8_U8 NO_AXIS_PTS_X 1 UBYTE AXIS_PTS_X 2 UBYTE INDEX_INCR DIRECT FNC_VALUES 3 UBYTE COLUMN_DIR DIRECT /end RECORD_LAYOUT
/begin RECORD_LAYOUT RB_Map_S16S16_U8 NO_AXIS_PTS_X 1 SWORD NO_AXIS_PTS_Y 2 SWORD AXIS_PTS_X 3 SWORD INDEX_INCR DIRECT AXIS_PTS_Y 4 SWORD INDEX_INCR DIRECT FNC_VALUES 5 UBYTE COLUMN_DIR DIRECT /end RECORD_LAYOUT
/begin RECORD_LAYOUT RB_Map_S16U16_S16 NO_AXIS_PTS_X 1 SWORD NO_AXIS_PTS_Y 2 SWORD AXIS_PTS_X 3 SWORD INDEX_INCR DIRECT AXIS_PTS_Y 4 UWORD INDEX_INCR DIRECT FNC_VALUES 5 SWORD ROW_DIR DIRECT /end RECORD_LAYOUT
/begin RECORD_LAYOUT RB_Map_S16U16_U16 NO_AXIS_PTS_X 1 SWORD NO_AXIS_PTS_Y 2 SWORD AXIS_PTS_X 3 SWORD INDEX_INCR DIRECT AXIS_PTS_Y 4 UWORD INDEX_INCR DIRECT FNC_VALUES 5 UWORD ROW_DIR DIRECT /end RECORD_LAYOUT
/begin RECORD_LAYOUT RB_Map_S16U8_U16 NO_AXIS_PTS_X 1 SWORD NO_AXIS_PTS_Y 2 SWORD AXIS_PTS_X 3 SWORD INDEX_INCR DIRECT AXIS_PTS_Y 4 UBYTE INDEX_INCR DIRECT FNC_VALUES 5 UWORD COLUMN_DIR DIRECT /end RECORD_LAYOUT
/begin RECORD_LAYOUT RB_Map_U16U16_R32 NO_AXIS_PTS_X 1 UWORD NO_AXIS_PTS_Y 2 UWORD AXIS_PTS_X 3 UWORD INDEX_INCR DIRECT AXIS_PTS_Y 4 UWORD INDEX_INCR DIRECT FNC_VALUES 5 FLOAT32_IEEE COLUMN_DIR DIRECT /end RECORD_LAYOUT
/begin RECORD_LAYOUT RB_Map_U16U16_S16 NO_AXIS_PTS_X 1 UWORD NO_AXIS_PTS_Y 2 UWORD AXIS_PTS_X 3 UWORD INDEX_INCR DIRECT AXIS_PTS_Y 4 UWORD INDEX_INCR DIRECT FNC_VALUES 5 SWORD COLUMN_DIR DIRECT /end RECORD_LAYOUT
/begin RECORD_LAYOUT RB_Map_U16U16_U16 NO_AXIS_PTS_X 1 UWORD NO_AXIS_PTS_Y 2 UWORD AXIS_PTS_X 3 UWORD INDEX_INCR DIRECT AXIS_PTS_Y 4 UWORD INDEX_INCR DIRECT FNC_VALUES 5 UWORD COLUMN_DIR DIRECT /end RECORD_LAYOUT
/begin RECORD_LAYOUT RB_Map_U16U8_U8 NO_AXIS_PTS_X 1 UWORD NO_AXIS_PTS_Y 2 UWORD AXIS_PTS_X 3 UWORD INDEX_INCR DIRECT AXIS_PTS_Y 4 UBYTE INDEX_INCR DIRECT FNC_VALUES 5 UBYTE COLUMN_DIR DIRECT /end RECORD_LAYOUT
/begin RECORD_LAYOUT RB_Map_U8U16_U16 NO_AXIS_PTS_X 1 UBYTE NO_AXIS_PTS_Y 2 UBYTE AXIS_PTS_X 3 UBYTE INDEX_INCR DIRECT AXIS_PTS_Y 4 UWORD INDEX_INCR DIRECT FNC_VALUES 5 UWORD ROW_DIR DIRECT /end RECORD_LAYOUT
/begin RECORD_LAYOUT RB_Map_U8U16_U8 NO_AXIS_PTS_X 1 UBYTE NO_AXIS_PTS_Y 2 UBYTE AXIS_PTS_X 3 UBYTE INDEX_INCR DIRECT AXIS_PTS_Y 4 UWORD INDEX_INCR DIRECT FNC_VALUES 5 UBYTE ROW_DIR DIRECT /end RECORD_LAYOUT
/begin RECORD_LAYOUT RB_ValA_Ws16 FNC_VALUES 1 SWORD COLUMN_DIR DIRECT /end RECORD_LAYOUT
/begin RECORD_LAYOUT RB_ValA_Wu16 FNC_VALUES 1 UWORD COLUMN_DIR DIRECT /end RECORD_LAYOUT
/begin RECORD_LAYOUT RB_ValA_Wu8 FNC_VALUES 1 UBYTE COLUMN_DIR DIRECT /end RECORD_LAYOUT
/begin RECORD_LAYOUT RB_Val_Wr32 FNC_VALUES 1 FLOAT32_IEEE COLUMN_DIR DIRECT /end RECORD_LAYOUT
/begin RECORD_LAYOUT RB_Val_Ws16 FNC_VALUES 1 SWORD COLUMN_DIR DIRECT /end RECORD_LAYOUT
/begin RECORD_LAYOUT RB_Val_Ws32 FNC_VALUES 1 SLONG COLUMN_DIR DIRECT /end RECORD_LAYOUT
/begin RECORD_LAYOUT RB_Val_Wu16 FNC_VALUES 1 UWORD COLUMN_DIR DIRECT /end RECORD_LAYOUT
/begin RECORD_LAYOUT RB_Val_Wu8 FNC_VALUES 1 UBYTE COLUMN_DIR DIRECT /end RECORD_LAYOUT
/end MODULE
/end PROJECT
