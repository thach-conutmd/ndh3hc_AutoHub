ASAP2_VERSION 1 60
/begin PROJECT MG1CA020 "MG1CA020"
/begin HEADER "" VERSION "MG1CA020_6SAY_V011_TPROT" PROJECT_NO MG1CA020 /end HEADER
/begin MODULE DIM ""
/begin MOD_COMMON "" BYTE_ORDER MSB_LAST ALIGNMENT_BYTE 1 ALIGNMENT_WORD 2 ALIGNMENT_LONG 4 ALIGNMENT_INT64 4 ALIGNMENT_FLOAT32_IEEE 4 ALIGNMENT_FLOAT64_IEEE 4 DATA_SIZE 32 /end MOD_COMMON
/begin CHARACTERISTIC UEGO_cntrDiagSnsrTstdOkRels_C "counter for release of DFC_UEGOSnsr tested OK" VALUE 0x805376DC RB_Val_Wu8 50.00 OneToOne 0.00 50.00 FORMAT "%5.2" EXTENDED_LIMITS 0.00 255.0 /end CHARACTERISTIC
/begin CHARACTERISTIC UEGO_cntrErrBlackn_C "Number of critical packets with active blackening protection" VALUE 0x805376DD RB_Val_Wu8 15.00 OneToOne 0.00 15.00 FORMAT "%5.2" EXTENDED_LIMITS 0.00 255.0 /end CHARACTERISTIC
/begin CHARACTERISTIC UEGO_cntrErrSpiDiagMax_C "Maximal allowed number of sporadic faults caused by invalid diagnosis register transf" VALUE 0x805376B2 RB_Val_Wu8 9.000 dez 1.00 10.00 FORMAT "%5.2" EXTENDED_LIMITS 0.00 255.0 /end CHARACTERISTIC
/begin CHARACTERISTIC UEGO_cntrErrSpiRamBnkMax_C "Maximal allowed number of sporadic faults caused by invalid data RAM transfer" VALUE 0x805376B3 RB_Val_Wu8 9.000 dez 1.00 10.00 FORMAT "%5.2" EXTENDED_LIMITS 0.00 255.0 /end CHARACTERISTIC
/begin CHARACTERISTIC UEGO_cntrErrSpiRegBnkMax_C "Maximal allowed number of sporadic faults caused by invalid data register transfer" VALUE 0x805376B4 RB_Val_Wu8 9.000 dez 1.00 10.00 FORMAT "%5.2" EXTENDED_LIMITS 0.00 255.0 /end CHARACTERISTIC
/begin CHARACTERISTIC UEGO_cntrIPmpLimdMax_C "Maximum number of measurement of the pump current in limitation" VALUE 0x805376EC RB_Val_Wu8 255.0 dez 0.00 255.0 FORMAT "%5.1" /end CHARACTERISTIC
/begin CHARACTERISTIC UEGO_cntrModIdleReqMax_C "Maximal number of Idle requests" VALUE 0x805376B5 RB_Val_Wu8 9.000 dez 1.00 10.00 FORMAT "%5.2" EXTENDED_LIMITS 0.00 255.0 /end CHARACTERISTIC
/begin CHARACTERISTIC UEGO_cpCapSnsrReplVal_C "replacement value for sensor capacitance of the inner electrode" VALUE 0x80537732 RB_Val_Wu16 0.006553500 c_q1Em7_F 0.00 0.006553500 FORMAT "%11.9" /end CHARACTERISTIC
/begin CHARACTERISTIC UEGO_facFkalFltConst_C "Filter time constant for Fcal measurement" VALUE 0x80537658 RB_Val_Wu16 0.9999847 fak_uw_b1 0.00 0.9999847 FORMAT "%9.7" /end CHARACTERISTIC
/begin CHARACTERISTIC UEGO_facIpDeltaFltConst_C "Filter time constant for delta pump current calculation" VALUE 0x8053770E RB_Val_Wu16 0.9999847 fak_uw_b1 0.00 0.9999847 FORMAT "%9.7" /end CHARACTERISTIC
/begin CHARACTERISTIC UEGO_facIPmpRawFltConst_C "filter time constant" VALUE 0x80537710 RB_Val_Wu16 0.9999847 fak_uw_b1 0.00 0.9999847 FORMAT "%9.7" /end CHARACTERISTIC
/begin CHARACTERISTIC UEGO_facIPmpSegFltConst_C "filter time constant" VALUE 0x80537712 RB_Val_Wu16 0.9999847 fak_uw_b1 0.00 0.9999847 FORMAT "%9.7" /end CHARACTERISTIC
/begin CHARACTERISTIC UEGO_facRCmpFltConst_C "filtering factor for calculation of plug resistor" VALUE 0x80537714 RB_Val_Wu16 0.9999847 fak_uw_b1 0.00 0.9999847 FORMAT "%9.7" /end CHARACTERISTIC
/begin CHARACTERISTIC UEGO_facUcalFltConst_C "filter constant Ucal measurement" VALUE 0x80537660 RB_Val_Wu16 0.9999847 fak_uw_b1 0.00 0.9999847 FORMAT "%9.7" /end CHARACTERISTIC
/begin CHARACTERISTIC UEGO_facUg0FltConst_C "filter constant Ug0 Measurement" VALUE 0x80537662 RB_Val_Wu16 0.9999847 fak_uw_b1 0.00 0.9999847 FORMAT "%9.7" /end CHARACTERISTIC
/begin CHARACTERISTIC UEGO_facUgxFltConst_C "filter time constant" VALUE 0x80537716 RB_Val_Wu16 0.9999847 fak_uw_b1 0.00 0.9999847 FORMAT "%9.7" /end CHARACTERISTIC
/begin CHARACTERISTIC UEGO_facUp0FltConst_C "filter contant for up0 measurement" VALUE 0x80537718 RB_Val_Wu16 0.9999847 fak_uw_b1 0.00 0.9999847 FORMAT "%9.7" /end CHARACTERISTIC
/begin CHARACTERISTIC UEGO_facUp0RawFltConst_C "filter time constant for raw pump voltage." VALUE 0x8053771A RB_Val_Wu16 0.9999847 fak_uw_b1 0.00 0.9999847 FORMAT "%9.7" /end CHARACTERISTIC
/begin CHARACTERISTIC UEGO_idxCyc1371013_T "index allocation cycle CJ135 to the measured value" CURVE 0x80537664 RB_Curve_U8_U8 255.0 dez 0.00 255.0 FORMAT "%5.1" READ_ONLY
 /begin AXIS_DESCR STD_AXIS NO_INPUT_QUANTITY dez 5 0.00 255.0 FORMAT "%5.1" DEPOSIT ABSOLUTE /end AXIS_DESCR
/end CHARACTERISTIC
/begin CHARACTERISTIC UEGO_idxCycUp0Norm1_T "index allocation cycle CJ135 to the measured value" CURVE 0x8053766F RB_Curve_U8_U8 255.0 dez 0.00 255.0 FORMAT "%5.1" READ_ONLY
 /begin AXIS_DESCR STD_AXIS NO_INPUT_QUANTITY dez 15 0.00 255.0 FORMAT "%5.1" DEPOSIT ABSOLUTE /end AXIS_DESCR
/end CHARACTERISTIC
/begin CHARACTERISTIC UEGO_idxUn0Cyc3691215_T "index allocation cycle CJ135 to the measured value" CURVE 0x8053768E RB_Curve_U8_U8 255.0 dez 0.00 255.0 FORMAT "%5.1" READ_ONLY
 /begin AXIS_DESCR STD_AXIS NO_INPUT_QUANTITY dez 5 0.00 255.0 FORMAT "%5.1" DEPOSIT ABSOLUTE /end AXIS_DESCR
/end CHARACTERISTIC
/begin CHARACTERISTIC UEGO_idxUpNorm3_T "index allocation cycle CJ135 to the measured value" CURVE 0x80537699 RB_Curve_U8_U8 14.00 dez 0.00 14.00 FORMAT "%5.2" EXTENDED_LIMITS 0.00 255.0 READ_ONLY
 /begin AXIS_DESCR STD_AXIS NO_INPUT_QUANTITY dez 5 0.00 255.0 FORMAT "%5.1" DEPOSIT ABSOLUTE /end AXIS_DESCR
/end CHARACTERISTIC
/begin CHARACTERISTIC UEGO_numDiagWaitAnly_C "Dwell time for one analysis step" VALUE 0x805376ED RB_Val_Wu8 255.0 dez 0.00 255.0 FORMAT "%5.1" /end CHARACTERISTIC
/begin CHARACTERISTIC UEGO_numDiagWaitIdleSho_C "Minimal dwell time in mode IDLE in diagnosis operation" VALUE 0x805376EE RB_Val_Wu8 255.0 dez 0.00 255.0 FORMAT "%5.1" /end CHARACTERISTIC
/begin CHARACTERISTIC UEGO_numDiagWaitNorm1_C "Dwell time in mode Normal1" VALUE 0x805376EF RB_Val_Wu8 255.0 dez 0.00 255.0 FORMAT "%5.1" /end CHARACTERISTIC
/begin CHARACTERISTIC UEGO_numDlyOkAsic_C "Functional class of UEGO_CJ135Dia" VALUE 0x805376B6 RB_Val_Wu8 254.0 dez 0.00 254.0 FORMAT "%5.1" EXTENDED_LIMITS 0.00 255.0 /end CHARACTERISTIC
/begin CHARACTERISTIC UEGO_numModWaitMax_C "Maximum allowed waiting time until the requested mode is set" VALUE 0x805376B7 RB_Val_Wu8 255.0 dez 0.00 255.0 FORMAT "%5.1" /end CHARACTERISTIC
/begin CHARACTERISTIC UEGO_numRegSetMax_C "Maximum number of rejected requests to the HWE" VALUE 0x805376B8 RB_Val_Wu8 255.0 dez 0.00 255.0 FORMAT "%5.1" /end CHARACTERISTIC
/begin CHARACTERISTIC UEGO_ratCmnModCorrn_C "Common mode correction ratio" VALUE 0x8053765A RB_Val_Wu16 1.999939 q6p104Em5_DIV_V 0.00 1.999939 FORMAT "%8.6" EXTENDED_LIMITS 0.00 3.999939 /end CHARACTERISTIC
/begin CHARACTERISTIC UEGO_ratFkalCorrn_C "Calibration ratio for UEGO" VALUE 0x8053765C RB_Val_Wu16 1.999939 q6p104Em5_DIV_V 0.00 1.999939 FORMAT "%8.6" EXTENDED_LIMITS 0.00 3.999939 /end CHARACTERISTIC
/begin CHARACTERISTIC UEGO_ratIsqDeDesMeasMax_C "" VALUE 0x805376BA RB_Val_Wu16 7.872072 fak_q1p201Em4 0.00 7.872072 FORMAT "%8.6" /end CHARACTERISTIC
/begin CHARACTERISTIC UEGO_ratIsqrDeDesMeasMax_C "" VALUE 0x805376BC RB_Val_Wu16 7.872072 fak_q1p201Em4 0.00 7.872072 FORMAT "%8.6" /end CHARACTERISTIC
/begin CHARACTERISTIC UEGO_resRCal_C "resistor RCAL in ecu" VALUE 0x805376AC RB_Val_Wu16 6553.400 r_q0p1_Ohm 0.100 6553.500 FORMAT "%8.3" EXTENDED_LIMITS 0.00 6553.500 /end CHARACTERISTIC
/begin CHARACTERISTIC UEGO_resRFe_C "Ohmic resistance of the EMC ferrites at the SG-Pins APE IR IPE MES" VALUE 0x80537734 RB_Val_Wu8 25.50 r_q0p1_Ohm 0.00 25.50 FORMAT "%5.2" /end CHARACTERISTIC
/begin CHARACTERISTIC UEGO_resRgndIsqrSnvtyMin_C "Minimum sensitivity of the measurements of Ug0iai and Ug0iei to the resistance RGnd" VALUE 0x805376F0 RB_Val_Wu16 6553.500 r_q0p1_Ohm 0.00 6553.500 FORMAT "%8.3" /end CHARACTERISTIC
/begin CHARACTERISTIC UEGO_resRGnd_C "resistance on pin RG" VALUE 0x805376AE RB_Val_Wu16 6553.400 r_q0p1_Ohm 0.100 6553.500 FORMAT "%8.3" EXTENDED_LIMITS 0.00 6553.500 /end CHARACTERISTIC
/begin CHARACTERISTIC UEGO_resRMeas_C "resistance between pin APE and pin MES" VALUE 0x8053771C RB_Val_Wu16 6553.500 r_q0p1_Ohm 0.00 6553.500 FORMAT "%8.3" /end CHARACTERISTIC
/begin CHARACTERISTIC UEGO_resRsgmspm_C "Switch resistance Rsga and Rspa" VALUE 0x805376A4 RB_Val_Wu16 6553.500 r_q0p1_Ohm 0.00 6553.500 FORMAT "%8.3" /end CHARACTERISTIC
/begin CHARACTERISTIC UEGO_rMeasMax_C "Maximum allowed resistance Rmeas" VALUE 0x805376BE RB_Val_Wu16 6553.500 r_q0p1_Ohm 0.00 6553.500 FORMAT "%8.3" /end CHARACTERISTIC
/begin CHARACTERISTIC UEGO_rParlMax_C "" VALUE 0x805376F2 RB_Val_Wu16 6553.500 r_q0p1_Ohm 0.00 6553.500 FORMAT "%8.3" /end CHARACTERISTIC
/begin CHARACTERISTIC UEGO_rParlMin_C "Minimum allowed parallel resistance" VALUE 0x805376C0 RB_Val_Wu16 6553.500 r_q0p1_Ohm 0.00 6553.500 FORMAT "%8.3" /end CHARACTERISTIC
/begin CHARACTERISTIC UEGO_stCJ135DatEval_C "Code word for Deactivate temperature dependence on reference pump current (isqr) during warm-up phase" VALUE 0x805376A6 RB_Val_Wu16 65535.00 OneToOne 0.00 65535.00 FORMAT "%8.2" /end CHARACTERISTIC
/begin CHARACTERISTIC UEGO_stCj135DiagAsicDi_C "Codeword for deactivation of ASIC diagnosis" VALUE 0x805376C2 RB_Val_Wu16 65535.00 dez 0.00 65535.00 FORMAT "%8.2" /end CHARACTERISTIC
/begin CHARACTERISTIC UEGO_stCj135DiagSnsrEna_C "Codeword for deactivation of sensor diagnostics" VALUE 0x805376DE RB_Val_Wu16 65535.00 OneToOne 0.00 65535.00 FORMAT "%8.2" /end CHARACTERISTIC
/begin CHARACTERISTIC UEGO_stCj135DiagSpiDi_C "Codeword for deactivatioin of SPI diagnosis" VALUE 0x805376C4 RB_Val_Wu16 65535.00 dez 0.00 65535.00 FORMAT "%8.2" /end CHARACTERISTIC
/begin CHARACTERISTIC UEGO_stCj135DiagWire_C "Code word for function UEGO_CJ135DiagWire" VALUE 0x805376F4 RB_Val_Wu8 255.0 dez 0.00 255.0 FORMAT "%5.1" /end CHARACTERISTIC
/begin CHARACTERISTIC UEGO_stCj135Diag_C "Codeword for feature activation of function UEGO_CJ135Dia" VALUE 0x805376DA RB_Val_Wu8 255.0 dez 0.00 255.0 FORMAT "%5.1" /end CHARACTERISTIC
/begin CHARACTERISTIC UEGO_stCJ135IPmpEval_C "enabling of pump current evaluation" VALUE 0x8053771E RB_Val_Wu16 65535.00 dez 0.00 65535.00 FORMAT "%8.2" /end CHARACTERISTIC
/begin CHARACTERISTIC UEGO_stCntrModVrfd_C "Status of mode verified during NORMAL mode" VALUE 0x805376F5 RB_Val_Wu8 255.0 dez 0.00 255.0 FORMAT "%5.1" /end CHARACTERISTIC
/begin CHARACTERISTIC UEGO_stDiagWireChpDi_C "Deactivation of fault patterns of the cable diagnosis at chip shutt-offs" VALUE 0x805376F6 RB_Val_Wu16 65535.00 dez 0.00 65535.00 FORMAT "%8.2" /end CHARACTERISTIC
/begin CHARACTERISTIC UEGO_stDiagWireMeasDi_C "Codeword for deactivation of wire diagnosis" VALUE 0x805376F8 RB_Val_Wu16 65535.00 dez 0.00 65535.00 FORMAT "%8.2" /end CHARACTERISTIC
/begin CHARACTERISTIC UEGO_tiCmnIrqSlowErr_C "Evaluation time of common interrupt handling slow error" VALUE 0x805376C6 RB_Val_Wu8 2.550 t_q0p01 0.00 2.550 FORMAT "%5.3" /end CHARACTERISTIC
/begin CHARACTERISTIC UEGO_tiDlyDiagSnsrRels_C "Release delay time of the UEGO sensor fault" VALUE 0x805376E0 RB_Val_Wu8 2.550 t_q0p01 0.00 2.550 FORMAT "%5.3" /end CHARACTERISTIC
/begin CHARACTERISTIC UEGO_tiDlyDsbcActv_C "Time delay after short time pump control shut off" VALUE 0x80537720 RB_Val_Wu16 327.6750 t_q0p005 0.00 327.6750 FORMAT "%8.4" /end CHARACTERISTIC
/begin CHARACTERISTIC UEGO_tiDlyErrAsic_C "Delay time of ASIC errors" VALUE 0x805376C8 RB_Val_Wu16 655.3500 t_q0p01 0.00 655.3500 FORMAT "%8.4" /end CHARACTERISTIC
/begin CHARACTERISTIC UEGO_tiDlyErrIPmpLimd_C "Delay time of the pump current limitation detection fault" VALUE 0x805376FA RB_Val_Wu8 2.550 t_q0p01 0.00 2.550 FORMAT "%5.3" /end CHARACTERISTIC
/begin CHARACTERISTIC UEGO_tiDlyErrUgx_C "Delay time of Ugx measurement detection fault" VALUE 0x805376FB RB_Val_Wu8 2.550 t_q0p01 0.00 2.550 FORMAT "%5.3" /end CHARACTERISTIC
/begin CHARACTERISTIC UEGO_tiDlyIPmpQlyWrstBattRng_C "delay time for battery voltage out of range" VALUE 0x80537722 RB_Val_Wu16 327.6750 t_q0p005 0.00 327.6750 FORMAT "%8.4" /end CHARACTERISTIC
/begin CHARACTERISTIC UEGO_tiDlyIPmpVld_C "time delay for the validity of pump current" VALUE 0x80537724 RB_Val_Wu16 327.6750 t_q0p005 0.00 327.6750 FORMAT "%8.4" /end CHARACTERISTIC
/begin CHARACTERISTIC UEGO_tiDlyIsqrVld_C "Delay time for a valid reference pump current (isqr) depending on the warm-up phase temperature" VALUE 0x805376A8 RB_Val_Wu16 327.6750 t_q0p005 0.00 327.6750 FORMAT "%8.4" /end CHARACTERISTIC
/begin CHARACTERISTIC UEGO_tiDlyOffDiagBlackn_C "Turn-off delay time of blackening protection detection" VALUE 0x805376E1 RB_Val_Wu8 2.550 t_q0p01 0.00 2.550 FORMAT "%5.3" /end CHARACTERISTIC
/begin CHARACTERISTIC UEGO_tiDlyOnDiagBlackn_C "Turn-on delay time of blackening protection detection" VALUE 0x805376E2 RB_Val_Wu8 2.550 t_q0p01 0.00 2.550 FORMAT "%5.3" /end CHARACTERISTIC
/begin CHARACTERISTIC UEGO_tiDlyPerdDiagOper_C "Cycle time of the periodic diagnosis operation at inhibition of dew point release" VALUE 0x805376FC RB_Val_Wu16 655.3400 t_q0p01 0.0100 655.3500 FORMAT "%8.4" EXTENDED_LIMITS 0.00 655.3500 /end CHARACTERISTIC
/begin CHARACTERISTIC UEGO_tiDlyTM2ROscn_C "delay time for TM2 oscillations" VALUE 0x80537726 RB_Val_Wu8 1.275 t_q0p005 0.00 1.275 FORMAT "%5.3" /end CHARACTERISTIC
/begin CHARACTERISTIC UEGO_tiDlyTOffIPmpCtrlBlckn_C "delay time for blackening protection indication" VALUE 0x80537727 RB_Val_Wu8 1.275 t_q0p005 0.00 1.275 FORMAT "%5.3" /end CHARACTERISTIC
/begin CHARACTERISTIC UEGO_tiDlyTOffIPmpCtrlDeActvd_C "delay time fir ip deactivated indication" VALUE 0x80537728 RB_Val_Wu8 1.275 t_q0p005 0.00 1.275 FORMAT "%5.3" /end CHARACTERISTIC
/begin CHARACTERISTIC UEGO_tiDlyUgxThd_C "Time delay to switch between high threshold to low threshold" VALUE 0x805376FE RB_Val_Wu8 2.550 t_q0p01 0.00 2.550 FORMAT "%5.3" /end CHARACTERISTIC
/begin CHARACTERISTIC UEGO_tiDurnDiagAvail_C "Duration of the time window of the UEGO availability diagnosis" VALUE 0x805376E4 RB_Val_Wu16 655.3400 t_q0p01 0.0100 655.3500 FORMAT "%8.4" EXTENDED_LIMITS 0.00 655.3500 /end CHARACTERISTIC
/begin CHARACTERISTIC UEGO_tiDurnDiagNotAvailHi_C "Maximum allowed integrated time duration of invalid signals during the time window of the UEGO availability diagnosis" VALUE 0x805376E6 RB_Val_Wu16 655.3400 t_q0p01 0.0100 655.3500 FORMAT "%8.4" EXTENDED_LIMITS 0.00 655.3500 /end CHARACTERISTIC
/begin CHARACTERISTIC UEGO_tiMeasRefFltConst_C "Filter constant for Measured Reference voltage" VALUE 0x805376AA RB_Val_Wu16 65.53400 t_q0p001 0.00100 65.53500 FORMAT "%8.5" EXTENDED_LIMITS 0.00 65.53500 /end CHARACTERISTIC
/begin CHARACTERISTIC UEGO_tiRvsChrgMeasActv_C "time for reserve charge activation" VALUE 0x8053772A RB_Val_Wu16 327.6750 t_q0p005 0.00 327.6750 FORMAT "%8.4" /end CHARACTERISTIC
/begin CHARACTERISTIC UEGO_tiSegLngthFilCutOff_C "Segment time cut off threshold for filter of segment averaged pump current values" VALUE 0x8053772C RB_Val_Wu16 43.69000 t_q6p6666Em4 0.00 43.69000 FORMAT "%8.5" /end CHARACTERISTIC
/begin CHARACTERISTIC UEGO_tiSegLngth_C "Parameter for duration of segment" VALUE 0x80537736 RB_Val_Wu16 43.69000 t_q6p6666Em4 0.00 43.69000 FORMAT "%8.5" /end CHARACTERISTIC
/begin CHARACTERISTIC UEGO_tiSmoothIPmp_C "delay time, during which pump current values are smoothened after disturbation" VALUE 0x8053772E RB_Val_Wu16 327.6750 t_q0p005 0.00 327.6750 FORMAT "%8.4" /end CHARACTERISTIC
/begin CHARACTERISTIC UEGO_tiSustIPmpVld_C "minimum time for sustained pump current" VALUE 0x80537730 RB_Val_Wu16 327.6750 t_q0p005 0.00 327.6750 FORMAT "%8.4" /end CHARACTERISTIC
/begin CHARACTERISTIC UEGO_uDeltaPinGndHi_C "Tolerable upper change in the pump current amplidue" VALUE 0x805376E8 RB_Val_Ws16 20.97120 spg_q3p2Em4_V -10.48576 10.48544 FORMAT "%8.5" /end CHARACTERISTIC
/begin CHARACTERISTIC UEGO_uDeltaPinGndLo_C "Tolerable lower change in the pump current amplitude" VALUE 0x805376EA RB_Val_Ws16 20.97120 spg_q3p2Em4_V -10.48576 10.48544 FORMAT "%8.5" /end CHARACTERISTIC
/begin CHARACTERISTIC UEGO_uFkal1Max_C "Maximum allowed value for uFkal1" VALUE 0x805376CA RB_Val_Wu16 0.01562476 spg_q2p3842Em7_V 0.00 0.01562476 FORMAT "%10.8" /end CHARACTERISTIC
/begin CHARACTERISTIC UEGO_uFkal1Min_C "Minimum allowed value for uFkal1" VALUE 0x805376CC RB_Val_Wu16 0.01562476 spg_q2p3842Em7_V 0.00 0.01562476 FORMAT "%10.8" /end CHARACTERISTIC
/begin CHARACTERISTIC UEGO_uFkal2Max_C "Maximum allowed value for uFkal2" VALUE 0x805376CE RB_Val_Wu16 0.01562476 spg_q2p3842Em7_V 0.00 0.01562476 FORMAT "%10.8" /end CHARACTERISTIC
/begin CHARACTERISTIC UEGO_uFkal2Min_C "Minimum allowed value for uFkal2" VALUE 0x805376D0 RB_Val_Wu16 0.01562476 spg_q2p3842Em7_V 0.00 0.01562476 FORMAT "%10.8" /end CHARACTERISTIC
/begin CHARACTERISTIC UEGO_uFkal3Max_C "Maximum allowed value for uFkal3" VALUE 0x805376D2 RB_Val_Wu16 0.01562476 spg_q2p3842Em7_V 0.00 0.01562476 FORMAT "%10.8" /end CHARACTERISTIC
/begin CHARACTERISTIC UEGO_uFkal3Min_C "Minimum allowed value for uFkal3" VALUE 0x805376D4 RB_Val_Wu16 0.01562476 spg_q2p3842Em7_V 0.00 0.01562476 FORMAT "%10.8" /end CHARACTERISTIC
/begin CHARACTERISTIC UEGO_uG0xErr_C "Maximum deviation of the contact measurements" VALUE 0x80537700 RB_Val_Ws16 20.97120 spg_q3p2Em4_V -10.48576 10.48544 FORMAT "%8.5" /end CHARACTERISTIC
/begin CHARACTERISTIC UEGO_uGndOffCorrn_C "Ground voltage offset correctio" VALUE 0x8053765E RB_Val_Ws8 0.08160 spg_q3p2Em4_V -0.04096 0.04064 FORMAT "%7.5" /end CHARACTERISTIC
/begin CHARACTERISTIC UEGO_uGxErrNegIni_C "initial threshold for negative voltage deviation during Delta Ugx check" VALUE 0x80537702 RB_Val_Ws16 20.97120 spg_q3p2Em4_V -10.48576 10.48544 FORMAT "%8.5" /end CHARACTERISTIC
/begin CHARACTERISTIC UEGO_uGxErrNegStep_C "voltage step for negative voltage deviation in delta Ugx check" VALUE 0x80537704 RB_Val_Ws16 20.97120 spg_q3p2Em4_V -10.48576 10.48544 FORMAT "%8.5" /end CHARACTERISTIC
/begin CHARACTERISTIC UEGO_uGxErrPosIni_C "initial threshold for positive voltage deviation during Delta Ugx check" VALUE 0x80537706 RB_Val_Ws16 20.97120 spg_q3p2Em4_V -10.48576 10.48544 FORMAT "%8.5" /end CHARACTERISTIC
/begin CHARACTERISTIC UEGO_uGxErrPosStep_C "voltage step for positive voltage deviation in delta Ugx check" VALUE 0x80537708 RB_Val_Ws16 20.97120 spg_q3p2Em4_V -10.48576 10.48544 FORMAT "%8.5" /end CHARACTERISTIC
/begin CHARACTERISTIC UEGO_uGxErr_C "Maximum deviation of the continuity measurements in mode NORMAL" VALUE 0x8053770A RB_Val_Ws16 20.97120 spg_q3p2Em4_V -10.48576 10.48544 FORMAT "%8.5" /end CHARACTERISTIC
/begin CHARACTERISTIC UEGO_uN0Err_C "Maximum allowed Nernst voltage" VALUE 0x8053770C RB_Val_Ws16 20.97120 spg_q3p2Em4_V -10.48576 10.48544 FORMAT "%8.5" /end CHARACTERISTIC
/begin CHARACTERISTIC UEGO_uVCC3Max_C "" VALUE 0x805376D6 RB_Val_Ws16 20.97120 spg_q3p2Em4_V -10.48576 10.48544 FORMAT "%8.5" /end CHARACTERISTIC
/begin CHARACTERISTIC UEGO_uVCC3Min_C "" VALUE 0x805376D8 RB_Val_Ws16 20.97120 spg_q3p2Em4_V -10.48576 10.48544 FORMAT "%8.5" /end CHARACTERISTIC
/begin CHARACTERISTIC UEGO_uVCC3Ref_C "Reference voltage VCC3" VALUE 0x805376B0 RB_Val_Ws16 20.97120 spg_q3p2Em4_V -10.48576 10.48544 FORMAT "%8.5" /end CHARACTERISTIC
/begin MEASUREMENT UEGO_CJ135CalcElecCorrnS1B1.flgFKal1Strtd "Class instance for ADC conversion of UEGO sensor 1 bank 1 / Display the start of calibration correction in Mode 1" UBYTE B_TRUE 1 100 0.00 1.00000000000 BIT_MASK 0x1 FORMAT "%13.11" ECU_ADDRESS 0x50001E00 /end MEASUREMENT
/begin MEASUREMENT UEGO_CJ135CalcElecCorrnS1B1.flgFKal2Strtd "Class instance for ADC conversion of UEGO sensor 1 bank 1 / Display the start of calibration correction in Mode 2" UBYTE B_TRUE 1 100 0.00 1.00000000000 BIT_MASK 0x2 FORMAT "%13.11" ECU_ADDRESS 0x50001E00 /end MEASUREMENT
/begin MEASUREMENT UEGO_CJ135CalcElecCorrnS1B1.flgFKal3Strtd "Class instance for ADC conversion of UEGO sensor 1 bank 1 / Display the start of calibration correction in Mode 3" UBYTE B_TRUE 1 100 0.00 1.00000000000 BIT_MASK 0x4 FORMAT "%13.11" ECU_ADDRESS 0x50001E00 /end MEASUREMENT
/begin MEASUREMENT UEGO_CJ135CalcElecCorrnS1B1.flgnCmnMod1Strtd "Class instance for ADC conversion of UEGO sensor 1 bank 1 / Display the start of correction in common mode" UBYTE B_TRUE 1 100 0.00 1.00000000000 BIT_MASK 0x10 FORMAT "%13.11" ECU_ADDRESS 0x50001E00 /end MEASUREMENT
/begin MEASUREMENT UEGO_CJ135CalcElecCorrnS1B1.flgnCmnMod2Strtd "Class instance for ADC conversion of UEGO sensor 1 bank 1 / Display the start of correction in common mode" UBYTE B_TRUE 1 100 0.00 1.00000000000 BIT_MASK 0x20 FORMAT "%13.11" ECU_ADDRESS 0x50001E00 /end MEASUREMENT
/begin MEASUREMENT UEGO_CJ135CalcElecCorrnS1B1.flgnumUref22Strtd "Class instance for ADC conversion of UEGO sensor 1 bank 1 / Display the start of correction in common mode" UBYTE B_TRUE 1 100 0.00 1.00000000000 BIT_MASK 0x8 FORMAT "%13.11" ECU_ADDRESS 0x50001E00 /end MEASUREMENT
/begin MEASUREMENT UEGO_CJ135CalcElecCorrnS1B1.numUref1Corrd "Class instance for ADC conversion of UEGO sensor 1 bank 1 / Number of measured reference voltage correction" SWORD dez 1 100 -32768.00 32767.00 FORMAT "%8.2" ECU_ADDRESS 0x50001E02 /end MEASUREMENT
/begin MEASUREMENT UEGO_CJ135CalcElecCorrnS1B1.numUref21Corrd "Class instance for ADC conversion of UEGO sensor 1 bank 1 / Number of measured reference voltage correction" SWORD dez 1 100 -32768.00 32767.00 FORMAT "%8.2" ECU_ADDRESS 0x50001E04 /end MEASUREMENT
/begin MEASUREMENT UEGO_CJ135CalcElecCorrnS1B1.numUref22Corrd "Class instance for ADC conversion of UEGO sensor 1 bank 1 / Number of measured reference voltage correction" SWORD dez 1 100 -32768.00 32767.00 FORMAT "%8.2" ECU_ADDRESS 0x50001E06 /end MEASUREMENT
/begin MEASUREMENT UEGO_CJ135CalcElecCorrnS1B1.numUref3Corrd "Class instance for ADC conversion of UEGO sensor 1 bank 1 / Number of measured reference voltage correction" SWORD dez 1 100 -32768.00 32767.00 FORMAT "%8.2" ECU_ADDRESS 0x50001E08 /end MEASUREMENT
/begin MEASUREMENT UEGO_CJ135CalcElecCorrnS1B1.uCmnMod1 "Class instance for ADC conversion of UEGO sensor 1 bank 1 / Common mode voltage in mode 1" SWORD spg_q3p2Em4_V 1 100 -10.48576 10.48544 FORMAT "%8.5" ECU_ADDRESS 0x50001E0A /end MEASUREMENT
/begin MEASUREMENT UEGO_CJ135CalcElecCorrnS1B1.uCmnMod2 "Class instance for ADC conversion of UEGO sensor 1 bank 1 / Common mode voltage in mode 2" SWORD spg_q3p2Em4_V 1 100 -10.48576 10.48544 FORMAT "%8.5" ECU_ADDRESS 0x50001E0C /end MEASUREMENT
/begin MEASUREMENT UEGO_CJ135CalcElecCorrnS1B1.uVCC1Corrd "Class instance for ADC conversion of UEGO sensor 1 bank 1 / Corrected reference voltage VCC1" SWORD spg_q3p2Em4_V 1 100 -10.48576 10.48544 FORMAT "%8.5" ECU_ADDRESS 0x50001E0E /end MEASUREMENT
/begin MEASUREMENT UEGO_CJ135CalcElecCorrnS1B1.uVCC3MeasRef "Class instance for ADC conversion of UEGO sensor 1 bank 1 / Measured Reference voltage VCC3" SWORD spg_q3p2Em4_V 1 100 -10.48576 10.48544 FORMAT "%8.5" ECU_ADDRESS 0x50001E10 /end MEASUREMENT
/begin MEASUREMENT UEGO_CJ135CalcElecCorrnS1B1.uFkal1Flt_DL_I.memory "Class instance for ADC conversion of UEGO sensor 1 bank 1 / Instance forcalibration filter / current lowpass value" ULONG spg_q3p638Em12_V 1 100 0.00 0.0156249999964 FORMAT "%15.13" ECU_ADDRESS 0x50001E14 /end MEASUREMENT
/begin MEASUREMENT UEGO_CJ135CalcElecCorrnS1B1.uFkal2Flt_DL_I.memory "Class instance for ADC conversion of UEGO sensor 1 bank 1 / Instance forcalibration filter / current lowpass value" ULONG spg_q3p638Em12_V 1 100 0.00 0.0156249999964 FORMAT "%15.13" ECU_ADDRESS 0x50001E18 /end MEASUREMENT
/begin MEASUREMENT UEGO_CJ135CalcElecCorrnS1B1.uFkal3Flt_DL_I.memory "Class instance for ADC conversion of UEGO sensor 1 bank 1 / Instance forcalibration filter / current lowpass value" ULONG spg_q3p638Em12_V 1 100 0.00 0.0156249999964 FORMAT "%15.13" ECU_ADDRESS 0x50001E1C /end MEASUREMENT
/begin MEASUREMENT UEGO_CJ135DatEvalS1B1_I.ctPostDrvLeave1ms "Class instance of the functional class of FC UEGO_CJ135DatEval for Bank 1 Sensor 1 / Local drive cycle counter which is incremented when system state SyC_PostDrive is left in 1ms" UBYTE OneToOne 1 100 0.00 255.0 FORMAT "%5.1" ECU_ADDRESS 0x50000488 /end MEASUREMENT
/begin MEASUREMENT UEGO_CJ135DatEvalS1B1_I.ctPostDrvLeave5ms "Class instance of the functional class of FC UEGO_CJ135DatEval for Bank 1 Sensor 1 / Local drive cycle counter which is incremented when system state SyC_PostDrive is left in 5ms" UBYTE OneToOne 1 100 0.00 255.0 FORMAT "%5.1" ECU_ADDRESS 0x50001E28 /end MEASUREMENT
/begin MEASUREMENT UEGO_CJ135DatEvalS1B1_I.flgIsqrStoreVld "Class instance of the functional class of FC UEGO_CJ135DatEval for Bank 1 Sensor 1 / Display the validity of the stored Isqr value" UBYTE B_TRUE 1 100 0.00 1.00000000000 BIT_MASK 0x1 FORMAT "%13.11" ECU_ADDRESS 0x600362AC /end MEASUREMENT
/begin MEASUREMENT UEGO_CJ135DatEvalS1B1_I.flgIsqrVld "Class instance of the functional class of FC UEGO_CJ135DatEval for Bank 1 Sensor 1 / Display the validity of Isqr" UBYTE B_TRUE 1 100 0.00 1.00000000000 BIT_MASK 0x1 FORMAT "%13.11" ECU_ADDRESS 0x50001E29 /end MEASUREMENT
/begin MEASUREMENT UEGO_CJ135DatEvalS1B1_I.flgNewIPmpPckAry "Class instance of the functional class of FC UEGO_CJ135DatEval for Bank 1 Sensor 1 / Validity condition for new IP pack" UBYTE B_TRUE 1 100 0.00 1.00000000000 BIT_MASK 0x4 FORMAT "%13.11" ECU_ADDRESS 0x50001E27 /end MEASUREMENT
/begin MEASUREMENT UEGO_CJ135DatEvalS1B1_I.flgNewIPmpTM "Class instance of the functional class of FC UEGO_CJ135DatEval for Bank 1 Sensor 1 / Validity condition for new IPTM register" UBYTE B_TRUE 1 100 0.00 1.00000000000 BIT_MASK 0x1 FORMAT "%13.11" ECU_ADDRESS 0x50001E2A /end MEASUREMENT
/begin MEASUREMENT UEGO_CJ135DatEvalS1B1_I.flgNewURiaPck "Class instance of the functional class of FC UEGO_CJ135DatEval for Bank 1 Sensor 1 / Validity condition for new Uria" UBYTE B_TRUE 1 100 0.00 1.00000000000 BIT_MASK 0x1 FORMAT "%13.11" ECU_ADDRESS 0x50001E2B /end MEASUREMENT
/begin MEASUREMENT UEGO_CJ135DatEvalS1B1_I.flgNewUa2Pck "Class instance of the functional class of FC UEGO_CJ135DatEval for Bank 1 Sensor 1 / Validity condition for new Ua2" UBYTE B_TRUE 1 100 0.00 1.00000000000 BIT_MASK 0x10 FORMAT "%13.11" ECU_ADDRESS 0x50001E24 /end MEASUREMENT
/begin MEASUREMENT UEGO_CJ135DatEvalS1B1_I.flgNewUa31Pck "Class instance of the functional class of FC UEGO_CJ135DatEval for Bank 1 Sensor 1 / Validity condition for new U31" UBYTE B_TRUE 1 100 0.00 1.00000000000 BIT_MASK 0x20 FORMAT "%13.11" ECU_ADDRESS 0x50001E24 /end MEASUREMENT
/begin MEASUREMENT UEGO_CJ135DatEvalS1B1_I.flgNewUa32Pck "Class instance of the functional class of FC UEGO_CJ135DatEval for Bank 1 Sensor 1 / Validity condition for new U32" UBYTE B_TRUE 1 100 0.00 1.00000000000 BIT_MASK 0x40 FORMAT "%13.11" ECU_ADDRESS 0x50001E24 /end MEASUREMENT
/begin MEASUREMENT UEGO_CJ135DatEvalS1B1_I.flgNewUa33Pck "Class instance of the functional class of FC UEGO_CJ135DatEval for Bank 1 Sensor 1 / Validity condition for new U33" UBYTE B_TRUE 1 100 0.00 1.00000000000 BIT_MASK 0x80 FORMAT "%13.11" ECU_ADDRESS 0x50001E24 /end MEASUREMENT
/begin MEASUREMENT UEGO_CJ135DatEvalS1B1_I.flgNewUapePck "Class instance of the functional class of FC UEGO_CJ135DatEval for Bank 1 Sensor 1 / Validity condition for new Uape" UBYTE B_TRUE 1 100 0.00 1.00000000000 BIT_MASK 0x1 FORMAT "%13.11" ECU_ADDRESS 0x50001E2C /end MEASUREMENT
/begin MEASUREMENT UEGO_CJ135DatEvalS1B1_I.flgNewUg0Pck "Class instance of the functional class of FC UEGO_CJ135DatEval for Bank 1 Sensor 1 / Validity condition for new Ug0" UBYTE B_TRUE 1 100 0.00 1.00000000000 BIT_MASK 0x1 FORMAT "%13.11" ECU_ADDRESS 0x50001E27 /end MEASUREMENT
/begin MEASUREMENT UEGO_CJ135DatEvalS1B1_I.flgNewUgaPck "Class instance of the functional class of FC UEGO_CJ135DatEval for Bank 1 Sensor 1 / Validity condition for new Uga" UBYTE B_TRUE 1 100 0.00 1.00000000000 BIT_MASK 0x1 FORMAT "%13.11" ECU_ADDRESS 0x50001E2D /end MEASUREMENT
/begin MEASUREMENT UEGO_CJ135DatEvalS1B1_I.flgNewUgiPckAry "Class instance of the functional class of FC UEGO_CJ135DatEval for Bank 1 Sensor 1 / Validity condition for new Ugi" UBYTE B_TRUE 1 100 0.00 1.00000000000 BIT_MASK 0x1 FORMAT "%13.11" ECU_ADDRESS 0x50001E2E /end MEASUREMENT
/begin MEASUREMENT UEGO_CJ135DatEvalS1B1_I.flgNewUgkAvrgPck "Class instance of the functional class of FC UEGO_CJ135DatEval for Bank 1 Sensor 1 / Validity condition for new Ugk" UBYTE B_TRUE 1 100 0.00 1.00000000000 BIT_MASK 0x1 FORMAT "%13.11" ECU_ADDRESS 0x50001E2F /end MEASUREMENT
/begin MEASUREMENT UEGO_CJ135DatEvalS1B1_I.flgNewUguaPck "Class instance of the functional class of FC UEGO_CJ135DatEval for Bank 1 Sensor 1 / Validity condition for new Ugua" UBYTE B_TRUE 1 100 0.00 1.00000000000 BIT_MASK 0x1 FORMAT "%13.11" ECU_ADDRESS 0x50001E30 /end MEASUREMENT
/begin MEASUREMENT UEGO_CJ135DatEvalS1B1_I.flgNewUguaZ2Pck "Class instance of the functional class of FC UEGO_CJ135DatEval for Bank 1 Sensor 1 / Validity condition for new Ugua in z2" UBYTE B_TRUE 1 100 0.00 1.00000000000 BIT_MASK 0x1 FORMAT "%13.11" ECU_ADDRESS 0x50001E31 /end MEASUREMENT
/begin MEASUREMENT UEGO_CJ135DatEvalS1B1_I.flgNewUguiPck "Class instance of the functional class of FC UEGO_CJ135DatEval for Bank 1 Sensor 1 / Validity condition for new Ugui" UBYTE B_TRUE 1 100 0.00 1.00000000000 BIT_MASK 0x1 FORMAT "%13.11" ECU_ADDRESS 0x50001E32 /end MEASUREMENT
/begin MEASUREMENT UEGO_CJ135DatEvalS1B1_I.flgNewUguiZ1Pck "Class instance of the functional class of FC UEGO_CJ135DatEval for Bank 1 Sensor 1 / Validity condition for new Ugui in z1" UBYTE B_TRUE 1 100 0.00 1.00000000000 BIT_MASK 0x1 FORMAT "%13.11" ECU_ADDRESS 0x50001E33 /end MEASUREMENT
/begin MEASUREMENT UEGO_CJ135DatEvalS1B1_I.flgNewUi21PckAry "Class instance of the functional class of FC UEGO_CJ135DatEval for Bank 1 Sensor 1 / Validity condition for new Ui21" UBYTE B_TRUE 1 100 0.00 1.00000000000 BIT_MASK 0x8 FORMAT "%13.11" ECU_ADDRESS 0x50001E26 /end MEASUREMENT
/begin MEASUREMENT UEGO_CJ135DatEvalS1B1_I.flgNewUi22Pck "Class instance of the functional class of FC UEGO_CJ135DatEval for Bank 1 Sensor 1 / Validity condition for new Ui22" UBYTE B_TRUE 1 100 0.00 1.00000000000 BIT_MASK 0x1 FORMAT "%13.11" ECU_ADDRESS 0x50001E26 /end MEASUREMENT
/begin MEASUREMENT UEGO_CJ135DatEvalS1B1_I.flgNewUi23Pck "Class instance of the functional class of FC UEGO_CJ135DatEval for Bank 1 Sensor 1 / Validity condition for new Ui23" UBYTE B_TRUE 1 100 0.00 1.00000000000 BIT_MASK 0x80 FORMAT "%13.11" ECU_ADDRESS 0x50001E26 /end MEASUREMENT
/begin MEASUREMENT UEGO_CJ135DatEvalS1B1_I.flgNewUi24Pck "Class instance of the functional class of FC UEGO_CJ135DatEval for Bank 1 Sensor 1 / Validity condition for new Ui24" UBYTE B_TRUE 1 100 0.00 1.00000000000 BIT_MASK 0x8 FORMAT "%13.11" ECU_ADDRESS 0x50001E27 /end MEASUREMENT
/begin MEASUREMENT UEGO_CJ135DatEvalS1B1_I.flgNewUi4Pck "Class instance of the functional class of FC UEGO_CJ135DatEval for Bank 1 Sensor 1 / Validity condition for new Ui4" UBYTE B_TRUE 1 100 0.00 1.00000000000 BIT_MASK 0x2 FORMAT "%13.11" ECU_ADDRESS 0x50001E27 /end MEASUREMENT
/begin MEASUREMENT UEGO_CJ135DatEvalS1B1_I.flgNewUi4Z2Pck "Class instance of the functional class of FC UEGO_CJ135DatEval for Bank 1 Sensor 1 / Validity condition for new Ui4 in z2" UBYTE B_TRUE 1 100 0.00 1.00000000000 BIT_MASK 0x10 FORMAT "%13.11" ECU_ADDRESS 0x50001E27 /end MEASUREMENT
/begin MEASUREMENT UEGO_CJ135DatEvalS1B1_I.flgNewUlpcalAvrgPck "Class instance of the functional class of FC UEGO_CJ135DatEval for Bank 1 Sensor 1 / Validity condition for new Ulpcal" UBYTE B_TRUE 1 100 0.00 1.00000000000 BIT_MASK 0x1 FORMAT "%13.11" ECU_ADDRESS 0x50001E34 /end MEASUREMENT
/begin MEASUREMENT UEGO_CJ135DatEvalS1B1_I.flgNewUn0PckAry "Class instance of the functional class of FC UEGO_CJ135DatEval for Bank 1 Sensor 1 / Validity condition for new Un0" UBYTE B_TRUE 1 100 0.00 1.00000000000 BIT_MASK 0x8 FORMAT "%13.11" ECU_ADDRESS 0x50001E21 /end MEASUREMENT
/begin MEASUREMENT UEGO_CJ135DatEvalS1B1_I.flgNewUnSetPck "Class instance of the functional class of FC UEGO_CJ135DatEval for Bank 1 Sensor 1 / Validity condition for new UnSet" UBYTE B_TRUE 1 100 0.00 1.00000000000 BIT_MASK 0x2 FORMAT "%13.11" ECU_ADDRESS 0x50001E21 /end MEASUREMENT
/begin MEASUREMENT UEGO_CJ135DatEvalS1B1_I.flgNewUp0PckAry "Class instance of the functional class of FC UEGO_CJ135DatEval for Bank 1 Sensor 1 / Validity condition for new Up0" UBYTE B_TRUE 1 100 0.00 1.00000000000 BIT_MASK 0x2 FORMAT "%13.11" ECU_ADDRESS 0x50001E23 /end MEASUREMENT
/begin MEASUREMENT UEGO_CJ135DatEvalS1B1_I.flgNewUpPckAry "Class instance of the functional class of FC UEGO_CJ135DatEval for Bank 1 Sensor 1 / Validity condition for new Up" UBYTE B_TRUE 1 100 0.00 1.00000000000 BIT_MASK 0x1 FORMAT "%13.11" ECU_ADDRESS 0x50001E23 /end MEASUREMENT
/begin MEASUREMENT UEGO_CJ135DatEvalS1B1_I.flgNewUriePckAry "Class instance of the functional class of FC UEGO_CJ135DatEval for Bank 1 Sensor 1 / Validity condition for new Urie" UBYTE B_TRUE 1 100 0.00 1.00000000000 BIT_MASK 0x1 FORMAT "%13.11" ECU_ADDRESS 0x50001E35 /end MEASUREMENT
/begin MEASUREMENT UEGO_CJ135DatEvalS1B1_I.flgUcalStrtd "Class instance of the functional class of FC UEGO_CJ135DatEval for Bank 1 Sensor 1 / condition data Ucal is available" UBYTE B_TRUE 1 100 0.00 1.00000000000 BIT_MASK 0x2 FORMAT "%13.11" ECU_ADDRESS 0x50001E20 /end MEASUREMENT
/begin MEASUREMENT UEGO_CJ135DatEvalS1B1_I.flgUg0Strtd "Class instance of the functional class of FC UEGO_CJ135DatEval for Bank 1 Sensor 1 / condition data Ug0 is available" UBYTE B_TRUE 1 100 0.00 1.00000000000 BIT_MASK 0x1 FORMAT "%13.11" ECU_ADDRESS 0x50001E20 /end MEASUREMENT
/begin MEASUREMENT UEGO_CJ135DatEvalS1B1_I.flgUoffgnd1Strtd "Class instance of the functional class of FC UEGO_CJ135DatEval for Bank 1 Sensor 1 / condition data Uoffgnd1 is available" UBYTE B_TRUE 1 100 0.00 1.00000000000 BIT_MASK 0x4 FORMAT "%13.11" ECU_ADDRESS 0x50001E20 /end MEASUREMENT
/begin MEASUREMENT UEGO_CJ135DatEvalS1B1_I.flgUoffgnd2Strtd "Class instance of the functional class of FC UEGO_CJ135DatEval for Bank 1 Sensor 1 / condition data Uoffgnd2 is available" UBYTE B_TRUE 1 100 0.00 1.00000000000 BIT_MASK 0x8 FORMAT "%13.11" ECU_ADDRESS 0x50001E20 /end MEASUREMENT
/begin MEASUREMENT UEGO_CJ135DatEvalS1B1_I.flgUoffgnd3Strtd "Class instance of the functional class of FC UEGO_CJ135DatEval for Bank 1 Sensor 1 / condition data Uoffgnd3 is available" UBYTE B_TRUE 1 100 0.00 1.00000000000 BIT_MASK 0x10 FORMAT "%13.11" ECU_ADDRESS 0x50001E20 /end MEASUREMENT
/begin MEASUREMENT UEGO_CJ135DatEvalS1B1_I.flgUoffipe1Z1Strtd "Class instance of the functional class of FC UEGO_CJ135DatEval for Bank 1 Sensor 1 / condition data Uoffipe1 is available" UBYTE B_TRUE 1 100 0.00 1.00000000000 BIT_MASK 0x1 FORMAT "%13.11" ECU_ADDRESS 0x50001E25 /end MEASUREMENT
/begin MEASUREMENT UEGO_CJ135DatEvalS1B1_I.flgUoffipe1Z2Strtd "Class instance of the functional class of FC UEGO_CJ135DatEval for Bank 1 Sensor 1 / condition data Uoffipe1 is available" UBYTE B_TRUE 1 100 0.00 1.00000000000 BIT_MASK 0x2 FORMAT "%13.11" ECU_ADDRESS 0x50001E25 /end MEASUREMENT
/begin MEASUREMENT UEGO_CJ135DatEvalS1B1_I.flgUoffipe2Z1Strtd "Class instance of the functional class of FC UEGO_CJ135DatEval for Bank 1 Sensor 1 / condition data Uoffipe2 is available" UBYTE B_TRUE 1 100 0.00 1.00000000000 BIT_MASK 0x4 FORMAT "%13.11" ECU_ADDRESS 0x50001E25 /end MEASUREMENT
/begin MEASUREMENT UEGO_CJ135DatEvalS1B1_I.flgUoffipe2Z2Strtd "Class instance of the functional class of FC UEGO_CJ135DatEval for Bank 1 Sensor 1 / condition data Uoffipe2 is available" UBYTE B_TRUE 1 100 0.00 1.00000000000 BIT_MASK 0x8 FORMAT "%13.11" ECU_ADDRESS 0x50001E25 /end MEASUREMENT
/begin MEASUREMENT UEGO_CJ135DatEvalS1B1_I.flgUoffvcc1Strtd "Class instance of the functional class of FC UEGO_CJ135DatEval for Bank 1 Sensor 1 / condition data Uoffvcc1 is available" UBYTE B_TRUE 1 100 0.00 1.00000000000 BIT_MASK 0x10 FORMAT "%13.11" ECU_ADDRESS 0x50001E25 /end MEASUREMENT
/begin MEASUREMENT UEGO_CJ135DatEvalS1B1_I.flgUoffvcc2Strtd "Class instance of the functional class of FC UEGO_CJ135DatEval for Bank 1 Sensor 1 / condition data Uoffvcc2 is available" UBYTE B_TRUE 1 100 0.00 1.00000000000 BIT_MASK 0x20 FORMAT "%13.11" ECU_ADDRESS 0x50001E25 /end MEASUREMENT
/begin MEASUREMENT UEGO_CJ135DatEvalS1B1_I.flgUoffvcc3Strtd "Class instance of the functional class of FC UEGO_CJ135DatEval for Bank 1 Sensor 1 / condition data Uoffvcc3 is available" UBYTE B_TRUE 1 100 0.00 1.00000000000 BIT_MASK 0x40 FORMAT "%13.11" ECU_ADDRESS 0x50001E25 /end MEASUREMENT
/begin MEASUREMENT UEGO_CJ135DatEvalS1B1_I.flgUoffvcci1Strtd "Class instance of the functional class of FC UEGO_CJ135DatEval for Bank 1 Sensor 1 / condition data Uoffvcci1 is available" UBYTE B_TRUE 1 100 0.00 1.00000000000 BIT_MASK 0x2 FORMAT "%13.11" ECU_ADDRESS 0x50001E22 /end MEASUREMENT
/begin MEASUREMENT UEGO_CJ135DatEvalS1B1_I.flgUoffvcci2Strtd "Class instance of the functional class of FC UEGO_CJ135DatEval for Bank 1 Sensor 1 / condition data Uoffvcci2 is available" UBYTE B_TRUE 1 100 0.00 1.00000000000 BIT_MASK 0x4 FORMAT "%13.11" ECU_ADDRESS 0x50001E22 /end MEASUREMENT
/begin MEASUREMENT UEGO_CJ135DatEvalS1B1_I.flgVCC3MeasRefStrtd "Class instance of the functional class of FC UEGO_CJ135DatEval for Bank 1 Sensor 1 / status for measurment of reference voltage is started" UBYTE B_TRUE 1 100 0.00 1.00000000000 BIT_MASK 0x1 FORMAT "%13.11" ECU_ADDRESS 0x50000489 /end MEASUREMENT
/begin MEASUREMENT UEGO_CJ135DatEvalS1B1_I.iIsqrMeas "Class instance of the functional class of FC UEGO_CJ135DatEval for Bank 1 Sensor 1 / Measured reference pump current source sensor" SWORD i_q6p667Em8_A 1 100 -0.002184533 0.002184467 FORMAT "%11.9" ECU_ADDRESS 0x600362AE /end MEASUREMENT
/begin MEASUREMENT UEGO_CJ135DatEvalS1B1_I.numIpPckAry "Class instance of the functional class of FC UEGO_CJ135DatEval for Bank 1 Sensor 1 / Number of IP per measurement package" UBYTE dez 1 100 0.00 255.0 FORMAT "%5.1" ECU_ADDRESS 0x50001E36 /end MEASUREMENT
/begin MEASUREMENT UEGO_CJ135DatEvalS1B1_I.numUa2PckAry "Class instance of the functional class of FC UEGO_CJ135DatEval for Bank 1 Sensor 1 / Number of Ua2 per measurement package" UBYTE dez 1 100 0.00 255.0 FORMAT "%5.1" ECU_ADDRESS 0x50001E37 /end MEASUREMENT
/begin MEASUREMENT UEGO_CJ135DatEvalS1B1_I.numUgaPckAry "Class instance of the functional class of FC UEGO_CJ135DatEval for Bank 1 Sensor 1 / Number of Uga per measurement package" UBYTE dez 1 100 0.00 255.0 FORMAT "%5.1" ECU_ADDRESS 0x50001E38 /end MEASUREMENT
/begin MEASUREMENT UEGO_CJ135DatEvalS1B1_I.numUgiPckAry "Class instance of the functional class of FC UEGO_CJ135DatEval for Bank 1 Sensor 1 / Number of Ugi per measurement package" UBYTE dez 1 100 0.00 255.0 FORMAT "%5.1" ECU_ADDRESS 0x50001E39 /end MEASUREMENT
/begin MEASUREMENT UEGO_CJ135DatEvalS1B1_I.numUi21PckAry "Class instance of the functional class of FC UEGO_CJ135DatEval for Bank 1 Sensor 1 / Number of Ui21 per measurement package" UBYTE dez 1 100 0.00 255.0 FORMAT "%5.1" ECU_ADDRESS 0x50001E3A /end MEASUREMENT
/begin MEASUREMENT UEGO_CJ135DatEvalS1B1_I.numUn0PckAry "Class instance of the functional class of FC UEGO_CJ135DatEval for Bank 1 Sensor 1 / Number of Un0 per measurement package" UBYTE dez 1 100 0.00 255.0 FORMAT "%5.1" ECU_ADDRESS 0x50001E3B /end MEASUREMENT
/begin MEASUREMENT UEGO_CJ135DatEvalS1B1_I.numUoffipe1Z1 "Class instance of the functional class of FC UEGO_CJ135DatEval for Bank 1 Sensor 1 / ADC value of the offset measurement of the IPE-pin in the switching state Z1 with amplifier mode 2" SWORD fak_q0p125 1 100 -4096.000 4095.875 FORMAT "%8.3" ECU_ADDRESS 0x50001E3C /end MEASUREMENT
/begin MEASUREMENT UEGO_CJ135DatEvalS1B1_I.numUoffipe1Z2 "Class instance of the functional class of FC UEGO_CJ135DatEval for Bank 1 Sensor 1 / ADC value of the offset measurement of the IPE-pin in the switching state Z2 with amplifier mode 2" SWORD fak_q0p125 1 100 -4096.000 4095.875 FORMAT "%8.3" ECU_ADDRESS 0x50001E3E /end MEASUREMENT
/begin MEASUREMENT UEGO_CJ135DatEvalS1B1_I.numUoffipe2Z1 "Class instance of the functional class of FC UEGO_CJ135DatEval for Bank 1 Sensor 1 / ADC value of the offset measurement of the IPE-pin in the switching state Z1 with amplifier mode 3" SWORD fak_q0p125 1 100 -4096.000 4095.875 FORMAT "%8.3" ECU_ADDRESS 0x50001E40 /end MEASUREMENT
/begin MEASUREMENT UEGO_CJ135DatEvalS1B1_I.numUoffipe2Z2 "Class instance of the functional class of FC UEGO_CJ135DatEval for Bank 1 Sensor 1 / ADC value of the offset measurement of the IPE-pin in the switching state Z2 with amplifier mode 3" SWORD fak_q0p125 1 100 -4096.000 4095.875 FORMAT "%8.3" ECU_ADDRESS 0x50001E42 /end MEASUREMENT
/begin MEASUREMENT UEGO_CJ135DatEvalS1B1_I.numUoffvcc1 "Class instance of the functional class of FC UEGO_CJ135DatEval for Bank 1 Sensor 1 / Data Uoffvcc1" SWORD fak_q0p125 1 100 -4096.000 4095.875 FORMAT "%8.3" ECU_ADDRESS 0x50001E44 /end MEASUREMENT
/begin MEASUREMENT UEGO_CJ135DatEvalS1B1_I.numUoffvcc2 "Class instance of the functional class of FC UEGO_CJ135DatEval for Bank 1 Sensor 1 / Data Uoffvcc2" SWORD fak_q0p125 1 100 -4096.000 4095.875 FORMAT "%8.3" ECU_ADDRESS 0x50001E46 /end MEASUREMENT
/begin MEASUREMENT UEGO_CJ135DatEvalS1B1_I.numUoffvcc3 "Class instance of the functional class of FC UEGO_CJ135DatEval for Bank 1 Sensor 1 / Data Uoffvcc3" SWORD fak_q0p125 1 100 -4096.000 4095.875 FORMAT "%8.3" ECU_ADDRESS 0x50001E48 /end MEASUREMENT
/begin MEASUREMENT UEGO_CJ135DatEvalS1B1_I.numUoffvcci1 "Class instance of the functional class of FC UEGO_CJ135DatEval for Bank 1 Sensor 1 / Data Uoffvcci1" SWORD fak_q0p125 1 100 -4096.000 4095.875 FORMAT "%8.3" ECU_ADDRESS 0x50001E4A /end MEASUREMENT
/begin MEASUREMENT UEGO_CJ135DatEvalS1B1_I.numUoffvcci2 "Class instance of the functional class of FC UEGO_CJ135DatEval for Bank 1 Sensor 1 / Data Uoffvcci2" SWORD fak_q0p125 1 100 -4096.000 4095.875 FORMAT "%8.3" ECU_ADDRESS 0x50001E4C /end MEASUREMENT
/begin MEASUREMENT UEGO_CJ135DatEvalS1B1_I.numUp0PckAry "Class instance of the functional class of FC UEGO_CJ135DatEval for Bank 1 Sensor 1 / Number of Up0 per measurement package" UBYTE dez 1 100 0.00 255.0 FORMAT "%5.1" ECU_ADDRESS 0x50001E4E /end MEASUREMENT
/begin MEASUREMENT UEGO_CJ135DatEvalS1B1_I.numUpPckAry "Class instance of the functional class of FC UEGO_CJ135DatEval for Bank 1 Sensor 1 / Number of Up per measurement package" UBYTE dez 1 100 0.00 255.0 FORMAT "%5.1" ECU_ADDRESS 0x50001E4F /end MEASUREMENT
/begin MEASUREMENT UEGO_CJ135DatEvalS1B1_I.numUriePckAry "Class instance of the functional class of FC UEGO_CJ135DatEval for Bank 1 Sensor 1 / Number of Urie per measurement package" UBYTE dez 1 100 0.00 255.0 FORMAT "%5.1" ECU_ADDRESS 0x50001E50 /end MEASUREMENT
/begin MEASUREMENT UEGO_CJ135DatEvalS1B1_I.ratIPmpRaw "Class instance of the functional class of FC UEGO_CJ135DatEval for Bank 1 Sensor 1 / Pump current duty cycles" UWORD fak_q1p201Em4 1 100 0.00 7.872072 FORMAT "%8.6" ARRAY_SIZE 16 ECU_ADDRESS 0x50001E52 /end MEASUREMENT
/begin MEASUREMENT UEGO_CJ135DatEvalS1B1_I.stIPmpOK "Class instance of the functional class of FC UEGO_CJ135DatEval for Bank 1 Sensor 1 / State of IPOK" UWORD OneToOne 1 100 0.00 65535.00 FORMAT "%8.2" ECU_ADDRESS 0x50001E72 /end MEASUREMENT
/begin MEASUREMENT UEGO_CJ135DatEvalS1B1_I.stIPmpTM "Class instance of the functional class of FC UEGO_CJ135DatEval for Bank 1 Sensor 1 / Status of register IPTM" UWORD OneToOne 1 100 0.00 65535.00 FORMAT "%8.2" ECU_ADDRESS 0x50001E74 /end MEASUREMENT
/begin MEASUREMENT UEGO_CJ135DatEvalS1B1_I.stIPmpTM2L "Class instance of the functional class of FC UEGO_CJ135DatEval for Bank 1 Sensor 1 / Status of TM2L lean pump current" UWORD OneToOne 1 100 0.00 65535.00 FORMAT "%8.2" ECU_ADDRESS 0x50001E76 /end MEASUREMENT
/begin MEASUREMENT UEGO_CJ135DatEvalS1B1_I.stIPmpTM2R "Class instance of the functional class of FC UEGO_CJ135DatEval for Bank 1 Sensor 1 / Status of TM2R rich pump current" UWORD OneToOne 1 100 0.00 65535.00 FORMAT "%8.2" ECU_ADDRESS 0x50001E78 /end MEASUREMENT
/begin MEASUREMENT UEGO_CJ135DatEvalS1B1_I.stLsmGetTime "Class instance of the functional class of FC UEGO_CJ135DatEval for Bank 1 Sensor 1 / Status call LSM_MEAS_TIME" ULONG OneToOne 1 100 0.00 4294967295.00 FORMAT "%13.2" ECU_ADDRESS 0x50001E7C /end MEASUREMENT
/begin MEASUREMENT UEGO_CJ135DatEvalS1B1_I.stUn0PckAry "Class instance of the functional class of FC UEGO_CJ135DatEval for Bank 1 Sensor 1 / Status word to display the validity field for Un0 Array" UWORD OneToOne 1 100 0.00 65535.00 FORMAT "%8.2" ECU_ADDRESS 0x50001E80 /end MEASUREMENT
/begin MEASUREMENT UEGO_CJ135DatEvalS1B1_I.stUn0Z2PckAry "Class instance of the functional class of FC UEGO_CJ135DatEval for Bank 1 Sensor 1 / Status word to display the validity field for Un0 Array in z2" UWORD OneToOne 1 100 0.00 65535.00 FORMAT "%8.2" ECU_ADDRESS 0x50001E82 /end MEASUREMENT
/begin MEASUREMENT UEGO_CJ135DatEvalS1B1_I.stUp0PckAry "Class instance of the functional class of FC UEGO_CJ135DatEval for Bank 1 Sensor 1 / Status word to display the validity field for Up0 Array" UWORD OneToOne 1 100 0.00 65535.00 FORMAT "%8.2" ECU_ADDRESS 0x50001E84 /end MEASUREMENT
/begin MEASUREMENT UEGO_CJ135DatEvalS1B1_I.stUp0Z2PckAry "Class instance of the functional class of FC UEGO_CJ135DatEval for Bank 1 Sensor 1 / Status word to display the validity field for Up0 Array in z2" UWORD OneToOne 1 100 0.00 65535.00 FORMAT "%8.2" ECU_ADDRESS 0x50001E86 /end MEASUREMENT
/begin MEASUREMENT UEGO_CJ135DatEvalS1B1_I.stUpPckAry "Class instance of the functional class of FC UEGO_CJ135DatEval for Bank 1 Sensor 1 / Status word to display the validity field for Up Array" UBYTE OneToOne 1 100 0.00 255.0 FORMAT "%5.1" ECU_ADDRESS 0x50001E88 /end MEASUREMENT
/begin MEASUREMENT UEGO_CJ135DatEvalS1B1_I.stUpZ2PckAry "Class instance of the functional class of FC UEGO_CJ135DatEval for Bank 1 Sensor 1 / Status word to display the validity field for Up Array in z2" UBYTE OneToOne 1 100 0.00 255.0 FORMAT "%5.1" ECU_ADDRESS 0x50001E89 /end MEASUREMENT
/begin MEASUREMENT UEGO_CJ135DatEvalS1B1_I.uGkAvrgPck "Class instance of the functional class of FC UEGO_CJ135DatEval for Bank 1 Sensor 1 / electrically corrected voltage uGk" SWORD spg_q3p2Em4_V 1 100 -10.48576 10.48544 FORMAT "%8.5" ECU_ADDRESS 0x50001E8A /end MEASUREMENT
/begin MEASUREMENT UEGO_CJ135DatEvalS1B1_I.uIpcalAvrgPck "Class instance of the functional class of FC UEGO_CJ135DatEval for Bank 1 Sensor 1 / electrically corrected voltage uIpcal" SWORD spg_q3p2Em4_V 1 100 -10.48576 10.48544 FORMAT "%8.5" ECU_ADDRESS 0x50001E8C /end MEASUREMENT
/begin MEASUREMENT UEGO_CJ135DatEvalS1B1_I.uRegUnset "Class instance of the functional class of FC UEGO_CJ135DatEval for Bank 1 Sensor 1 / Electrically corrected voltage of Unset measured at OPM 1 and reference voltage VCC3" SWORD spg_q3p2Em4_V 1 100 -10.48576 10.48544 FORMAT "%8.5" ECU_ADDRESS 0x50001E8E /end MEASUREMENT
/begin MEASUREMENT UEGO_CJ135DatEvalS1B1_I.uUa31Pck "Class instance of the functional class of FC UEGO_CJ135DatEval for Bank 1 Sensor 1 / electrically corrected voltage Ua31" SWORD spg_q3p2Em4_V 1 100 -10.48576 10.48544 FORMAT "%8.5" ECU_ADDRESS 0x50001E90 /end MEASUREMENT
/begin MEASUREMENT UEGO_CJ135DatEvalS1B1_I.uUa32Pck "Class instance of the functional class of FC UEGO_CJ135DatEval for Bank 1 Sensor 1 / electrically corrected voltage Ua32" SWORD spg_q3p2Em4_V 1 100 -10.48576 10.48544 FORMAT "%8.5" ECU_ADDRESS 0x50001E92 /end MEASUREMENT
/begin MEASUREMENT UEGO_CJ135DatEvalS1B1_I.uUa33Pck "Class instance of the functional class of FC UEGO_CJ135DatEval for Bank 1 Sensor 1 / electrically corrected voltage Ua33" SWORD spg_q3p2Em4_V 1 100 -10.48576 10.48544 FORMAT "%8.5" ECU_ADDRESS 0x50001E94 /end MEASUREMENT
/begin MEASUREMENT UEGO_CJ135DatEvalS1B1_I.uUapePck "Class instance of the functional class of FC UEGO_CJ135DatEval for Bank 1 Sensor 1 / electrically corrected voltage Uape" SWORD spg_q3p2Em4_V 1 100 -10.48576 10.48544 FORMAT "%8.5" ECU_ADDRESS 0x50001E96 /end MEASUREMENT
/begin MEASUREMENT UEGO_CJ135DatEvalS1B1_I.uUg0Pck "Class instance of the functional class of FC UEGO_CJ135DatEval for Bank 1 Sensor 1 / electrically corrected voltage Ug0" SWORD spg_q3p2Em4_V 1 100 -10.48576 10.48544 FORMAT "%8.5" ECU_ADDRESS 0x50001E98 /end MEASUREMENT
/begin MEASUREMENT UEGO_CJ135DatEvalS1B1_I.uUguaPck "Class instance of the functional class of FC UEGO_CJ135DatEval for Bank 1 Sensor 1 / electrically corrected voltage Ugua" SWORD spg_q3p2Em4_V 1 100 -10.48576 10.48544 FORMAT "%8.5" ECU_ADDRESS 0x50001E9A /end MEASUREMENT
/begin MEASUREMENT UEGO_CJ135DatEvalS1B1_I.uUguaZ2Pck "Class instance of the functional class of FC UEGO_CJ135DatEval for Bank 1 Sensor 1 / electrically corrected voltage Ugua in z2" SWORD spg_q3p2Em4_V 1 100 -10.48576 10.48544 FORMAT "%8.5" ECU_ADDRESS 0x50001E9C /end MEASUREMENT
/begin MEASUREMENT UEGO_CJ135DatEvalS1B1_I.uUguiPck "Class instance of the functional class of FC UEGO_CJ135DatEval for Bank 1 Sensor 1 / electrically corrected voltage Ugui" SWORD spg_q3p2Em4_V 1 100 -10.48576 10.48544 FORMAT "%8.5" ECU_ADDRESS 0x50001E9E /end MEASUREMENT
/begin MEASUREMENT UEGO_CJ135DatEvalS1B1_I.uUguiZ1Pck "Class instance of the functional class of FC UEGO_CJ135DatEval for Bank 1 Sensor 1 / electrically corrected voltage Ugui in z1" SWORD spg_q3p2Em4_V 1 100 -10.48576 10.48544 FORMAT "%8.5" ECU_ADDRESS 0x50001EA0 /end MEASUREMENT
/begin MEASUREMENT UEGO_CJ135DatEvalS1B1_I.uUi22Pck "Class instance of the functional class of FC UEGO_CJ135DatEval for Bank 1 Sensor 1 / electrically corrected voltage Ui22" SWORD spg_q3p2Em4_V 1 100 -10.48576 10.48544 FORMAT "%8.5" ECU_ADDRESS 0x50001EA2 /end MEASUREMENT
/begin MEASUREMENT UEGO_CJ135DatEvalS1B1_I.uUi23Pck "Class instance of the functional class of FC UEGO_CJ135DatEval for Bank 1 Sensor 1 / electrically corrected voltage Ui23" SWORD spg_q3p2Em4_V 1 100 -10.48576 10.48544 FORMAT "%8.5" ECU_ADDRESS 0x50001EA4 /end MEASUREMENT
/begin MEASUREMENT UEGO_CJ135DatEvalS1B1_I.uUi24Pck "Class instance of the functional class of FC UEGO_CJ135DatEval for Bank 1 Sensor 1 / electrically corrected voltage Ui24" SWORD spg_q3p2Em4_V 1 100 -10.48576 10.48544 FORMAT "%8.5" ECU_ADDRESS 0x50001EA6 /end MEASUREMENT
/begin MEASUREMENT UEGO_CJ135DatEvalS1B1_I.uUi4Pck "Class instance of the functional class of FC UEGO_CJ135DatEval for Bank 1 Sensor 1 / electrically corrected voltage Ui4" SWORD spg_q3p2Em4_V 1 100 -10.48576 10.48544 FORMAT "%8.5" ECU_ADDRESS 0x50001EA8 /end MEASUREMENT
/begin MEASUREMENT UEGO_CJ135DatEvalS1B1_I.uUi4Z2Pck "Class instance of the functional class of FC UEGO_CJ135DatEval for Bank 1 Sensor 1 / electrically corrected voltage Ui4 in z2" SWORD spg_q3p2Em4_V 1 100 -10.48576 10.48544 FORMAT "%8.5" ECU_ADDRESS 0x50001EAA /end MEASUREMENT
/begin MEASUREMENT UEGO_CJ135DatEvalS1B1_I.uUn0PckAvrg "Class instance of the functional class of FC UEGO_CJ135DatEval for Bank 1 Sensor 1 / electrically corrected averaged Un0 voltage" SWORD spg_q3p2Em4_V 1 100 -10.48576 10.48544 FORMAT "%8.5" ECU_ADDRESS 0x50001EAC /end MEASUREMENT
/begin MEASUREMENT UEGO_CJ135DatEvalS1B1_I.uUn0PckSum "Class instance of the functional class of FC UEGO_CJ135DatEval for Bank 1 Sensor 1 / electrically corrected voltage Un0" SWORD spg_q3p2Em4_V 1 100 -10.48576 10.48544 FORMAT "%8.5" ECU_ADDRESS 0x50001EAE /end MEASUREMENT
/begin MEASUREMENT UEGO_CJ135DatEvalS1B1_I.uUn0RawLst "Class instance of the functional class of FC UEGO_CJ135DatEval for Bank 1 Sensor 1 / electrically corrected voltage Un0" SWORD spg_q3p2Em4_V 1 100 -10.48576 10.48544 FORMAT "%8.5" ECU_ADDRESS 0x50001EB0 /end MEASUREMENT
/begin MEASUREMENT UEGO_CJ135DatEvalS1B1_I.uUnSet "Class instance of the functional class of FC UEGO_CJ135DatEval for Bank 1 Sensor 1 / electrically corrected UnSet voltage" SWORD spg_q3p2Em4_V 1 100 -10.48576 10.48544 FORMAT "%8.5" ECU_ADDRESS 0x50001EB2 /end MEASUREMENT
/begin MEASUREMENT UEGO_CJ135DatEvalS1B1_I.uUriaPck "Class instance of the functional class of FC UEGO_CJ135DatEval for Bank 1 Sensor 1 / electrically corrected voltage Uria" SWORD spg_q3p2Em4_V 1 100 -10.48576 10.48544 FORMAT "%8.5" ECU_ADDRESS 0x50001EB4 /end MEASUREMENT
/begin MEASUREMENT UEGO_CJ135DatEvalS1B1_I.uVCC1aTest "Class instance of the functional class of FC UEGO_CJ135DatEval for Bank 1 Sensor 1 / Electrically corrected voltage of Uref22 at OPM2" SWORD spg_q3p2Em4_V 1 100 -10.48576 10.48544 FORMAT "%8.5" ECU_ADDRESS 0x50001EB6 /end MEASUREMENT
/begin MEASUREMENT UEGO_CJ135DatEvalS1B1_I.uVCC1bTest "Class instance of the functional class of FC UEGO_CJ135DatEval for Bank 1 Sensor 1 / Electrically corrected voltage of Uref1 at OPM 1" SWORD spg_q3p2Em4_V 1 100 -10.48576 10.48544 FORMAT "%8.5" ECU_ADDRESS 0x50001EB8 /end MEASUREMENT
/begin MEASUREMENT UEGO_CJ135DatEvalS1B1_I.uVCC3MeasRef "Class instance of the functional class of FC UEGO_CJ135DatEval for Bank 1 Sensor 1 / Reference voltage VCC3" SWORD spg_q3p2Em4_V 1 100 -10.48576 10.48544 FORMAT "%8.5" ECU_ADDRESS 0x50001EBA /end MEASUREMENT
/begin MEASUREMENT UEGO_CJ135DatEvalS1B1_I.uVCC3MeasRefFild "Class instance of the functional class of FC UEGO_CJ135DatEval for Bank 1 Sensor 1 / Filtered measured Reference voltage in 1ms" SWORD spg_q3p2Em4_V 1 100 -10.48576 10.48544 FORMAT "%8.5" ECU_ADDRESS 0x5000048A /end MEASUREMENT
/begin MEASUREMENT UEGO_CJ135DatEvalS1B1_I.uVCC3MeasRefUnFild "Class instance of the functional class of FC UEGO_CJ135DatEval for Bank 1 Sensor 1 / Unfilterd Measured Reference voltage VCC3" SWORD spg_q3p2Em4_V 1 100 -10.48576 10.48544 FORMAT "%8.5" ECU_ADDRESS 0x5000048C /end MEASUREMENT
/begin MEASUREMENT UEGO_CJ135DatEvalS1B1_I.uVCC3aTest "Class instance of the functional class of FC UEGO_CJ135DatEval for Bank 1 Sensor 1 / Electrically corrected voltage of Uref3 at OPM 3" SWORD spg_q3p2Em4_V 1 100 -10.48576 10.48544 FORMAT "%8.5" ECU_ADDRESS 0x50001EBC /end MEASUREMENT
/begin MEASUREMENT UEGO_CJ135DatEvalS1B1_I.uVCC3bTest "Class instance of the functional class of FC UEGO_CJ135DatEval for Bank 1 Sensor 1 / Electrically corrected voltage of Uref12 at OPM 2" SWORD spg_q3p2Em4_V 1 100 -10.48576 10.48544 FORMAT "%8.5" ECU_ADDRESS 0x50001EBE /end MEASUREMENT
/begin MEASUREMENT UEGO_CJ135DatEvalS1B1_I.IsqrDlyVldTOFFV_I.outbit "Class instance of the functional class of FC UEGO_CJ135DatEval for Bank 1 Sensor 1 / Instance for isqr validity delay / Output Bit" UBYTE B_TRUE 1 100 0.00 1.00000000000 BIT_MASK 0x1 FORMAT "%13.11" ECU_ADDRESS 0x50001EC0 /end MEASUREMENT
/begin MEASUREMENT UEGO_CJ135DatEvalS1B1_I.IsqrDlyVldTOFFV_I.time "Class instance of the functional class of FC UEGO_CJ135DatEval for Bank 1 Sensor 1 / Instance for isqr validity delay / Occured Time" UWORD t_q0p005 1 100 0.00 327.6750 FORMAT "%8.4" ECU_ADDRESS 0x50001EC2 /end MEASUREMENT
/begin MEASUREMENT UEGO_CJ135DatEvalS1B1_I.uUcalFltElecCor_DL_I.memory "Class instance of the functional class of FC UEGO_CJ135DatEval for Bank 1 Sensor 1 / Instance for Ucal low pass filter / current lowpass value" SLONG spg_q4p883Em9_V 1 100 -10.4857600000 10.4857599951 FORMAT "%13.10" ECU_ADDRESS 0x50001EC4 /end MEASUREMENT
/begin MEASUREMENT UEGO_CJ135DatEvalS1B1_I.uUg0FltElecCor_DL_I.memory "Class instance of the functional class of FC UEGO_CJ135DatEval for Bank 1 Sensor 1 / Instance for Ug0 low pass filter / current lowpass value" SLONG spg_q4p883Em9_V 1 100 -10.4857600000 10.4857599951 FORMAT "%13.10" ECU_ADDRESS 0x50001EC8 /end MEASUREMENT
/begin MEASUREMENT UEGO_CJ135DatEvalS1B1_I.uVCC3MeasFltRef_LT_I.memory "Class instance of the functional class of FC UEGO_CJ135DatEval for Bank 1 Sensor 1 / Instance for VCC3 low pass filter / current lowpass value" SLONG spg_q3p2Em4_V 1 100 -687194.767360 687194.767040 FORMAT "%13.6" ECU_ADDRESS 0x50000490 /end MEASUREMENT
/begin MEASUREMENT UEGO_CJ135DiagEcuEvln_I.ErrAry "Class instance for evaluation of ECU quantities of the functional class of FC UEGO_CJ135Dia / Array to collect the diagnosis register" UBYTE OneToOne 1 100 0.00 255.0 FORMAT "%5.1" ARRAY_SIZE 6 ECU_ADDRESS 0x50001ECC /end MEASUREMENT
/begin MEASUREMENT UEGO_CJ135DiagEcuEvln_I.flgChpInIdle "Class instance for evaluation of ECU quantities of the functional class of FC UEGO_CJ135Dia / ASIC is currently in state IDLE" UBYTE B_TRUE 1 100 0.00 1.00000000000 BIT_MASK 0x1 FORMAT "%13.11" ECU_ADDRESS 0x50001ED2 /end MEASUREMENT
/begin MEASUREMENT UEGO_CJ135DiagEcuEvln_I.flgCmnIrqErrVld "Class instance for evaluation of ECU quantities of the functional class of FC UEGO_CJ135Dia / Validity of IRQ diagnosis information" UBYTE B_TRUE 1 100 0.00 1.00000000000 BIT_MASK 0x1 FORMAT "%13.11" ECU_ADDRESS 0x50001ED3 /end MEASUREMENT
/begin MEASUREMENT UEGO_CJ135DiagEcuEvln_I.flgErrInfoAsicVld "Class instance for evaluation of ECU quantities of the functional class of FC UEGO_CJ135Dia / Validity of the diagnosis register of the ASIC" UBYTE B_TRUE 1 100 0.00 1.00000000000 BIT_MASK 0x1 FORMAT "%13.11" ECU_ADDRESS 0x50001ED4 /end MEASUREMENT
/begin MEASUREMENT UEGO_CJ135DiagEcuEvln_I.flgErrInfoMcuVld "Class instance for evaluation of ECU quantities of the functional class of FC UEGO_CJ135Dia / Validity of the diagnostics of the microcontroller for the ASIC" UBYTE B_TRUE 1 100 0.00 1.00000000000 BIT_MASK 0x1 FORMAT "%13.11" ECU_ADDRESS 0x50001ED5 /end MEASUREMENT
/begin MEASUREMENT UEGO_CJ135DiagEcuEvln_I.flgErrSpiDiag "Class instance for evaluation of ECU quantities of the functional class of FC UEGO_CJ135Dia / SPI error during transmitting the diagnosis register" UBYTE B_TRUE 1 100 0.00 1.00000000000 BIT_MASK 0x1 FORMAT "%13.11" ECU_ADDRESS 0x50001ED6 /end MEASUREMENT
/begin MEASUREMENT UEGO_CJ135DiagEcuEvln_I.flgErrSpiRegBnk "Class instance for evaluation of ECU quantities of the functional class of FC UEGO_CJ135Dia / SPI error during transmitting the register information of the ASIC" UBYTE B_TRUE 1 100 0.00 1.00000000000 BIT_MASK 0x1 FORMAT "%13.11" ECU_ADDRESS 0x50001ED7 /end MEASUREMENT
/begin MEASUREMENT UEGO_CJ135DiagEcuEvln_I.numModCurr "Class instance for evaluation of ECU quantities of the functional class of FC UEGO_CJ135Dia / Current mode of the ASIC" UBYTE dez 1 100 0.00 255.0 FORMAT "%5.1" ECU_ADDRESS 0x50001ED8 /end MEASUREMENT
/begin MEASUREMENT UEGO_CJ135DiagEcuEvln_I.stCmnIrqErr "Class instance for evaluation of ECU quantities of the functional class of FC UEGO_CJ135Dia / Faults in the common IRQ wire" UBYTE dez 1 100 0.00 255.0 FORMAT "%5.1" ECU_ADDRESS 0x50001ED9 /end MEASUREMENT
/begin MEASUREMENT UEGO_CJ135DiagEcuEvln_I.stErrInfoAsicChp "Class instance for evaluation of ECU quantities of the functional class of FC UEGO_CJ135Dia / Status of errors of the Chip of the ASIC" UBYTE dez 1 100 0.00 255.0 FORMAT "%5.1" ECU_ADDRESS 0x50001EDA /end MEASUREMENT
/begin MEASUREMENT UEGO_CJ135DiagEcuEvln_I.stErrInfoAsicDiagReg "Class instance for evaluation of ECU quantities of the functional class of FC UEGO_CJ135Dia / Diagnosis register of the ASIC" ULONG dez 1 100 0.00 4294967295.00 FORMAT "%13.2" ECU_ADDRESS 0x50001EDC /end MEASUREMENT
/begin MEASUREMENT UEGO_CJ135DiagS1B1_I.cntrErrSpiDiag "Class instance of the functional class of FC UEGO_CJ135Dia for Bank 1 Sensor 1 / Counter of the events with faulty transmission of the diagnosis registers" UBYTE dez 1 100 0.00 255.0 FORMAT "%5.1" ECU_ADDRESS 0x5000554C /end MEASUREMENT
/begin MEASUREMENT UEGO_CJ135DiagS1B1_I.cntrErrSpiRamBnk "Class instance of the functional class of FC UEGO_CJ135Dia for Bank 1 Sensor 1 / Counter of the events with faulty transmission of the RAM bank" UBYTE dez 1 100 0.00 255.0 FORMAT "%5.1" ECU_ADDRESS 0x5000554D /end MEASUREMENT
/begin MEASUREMENT UEGO_CJ135DiagS1B1_I.cntrErrSpiRegBnk "Class instance of the functional class of FC UEGO_CJ135Dia for Bank 1 Sensor 1 / Counter of the events with faulty SPI sequence" UBYTE dez 1 100 0.00 255.0 FORMAT "%5.1" ECU_ADDRESS 0x5000554E /end MEASUREMENT
/begin MEASUREMENT UEGO_CJ135DiagS1B1_I.cntrModIdleReq "Class instance of the functional class of FC UEGO_CJ135Dia for Bank 1 Sensor 1 / Counter of the number of mode IDLE reqests" UBYTE dez 1 100 0.00 255.0 FORMAT "%5.1" ECU_ADDRESS 0x5000554F /end MEASUREMENT
/begin MEASUREMENT UEGO_CJ135DiagS1B1_I.cntrModVrfd "Class instance of the functional class of FC UEGO_CJ135Dia for Bank 1 Sensor 1 / Counter of verifications of the actual mode of the ASIC" UBYTE dez 1 100 0.00 255.0 FORMAT "%5.1" ECU_ADDRESS 0x50005550 /end MEASUREMENT
/begin MEASUREMENT UEGO_CJ135DiagS1B1_I.cntrModWait "Class instance of the functional class of FC UEGO_CJ135Dia for Bank 1 Sensor 1 / Counter of missed actual modes of the ASIC" UBYTE dez 1 100 0.00 255.0 FORMAT "%5.1" ECU_ADDRESS 0x50005551 /end MEASUREMENT
/begin MEASUREMENT UEGO_CJ135DiagS1B1_I.flgCmnIrqSlow "Class instance of the functional class of FC UEGO_CJ135Dia for Bank 1 Sensor 1 / Flag Interrupt Slow Active" UBYTE B_TRUE 1 100 0.00 1.00000000000 BIT_MASK 0x1 FORMAT "%13.11" ECU_ADDRESS 0x50005552 /end MEASUREMENT
/begin MEASUREMENT UEGO_CJ135DiagS1B1_I.flgDiagEcuErrPnd "Class instance of the functional class of FC UEGO_CJ135Dia for Bank 1 Sensor 1 / Error hint at ECU diagnosis of the ASIC" UBYTE B_TRUE 1 100 0.00 1.00000000000 BIT_MASK 0x1 FORMAT "%13.11" ECU_ADDRESS 0x50005553 /end MEASUREMENT
/begin MEASUREMENT UEGO_CJ135DiagS1B1_I.flgErrAsicPsbl "Class instance of the functional class of FC UEGO_CJ135Dia for Bank 1 Sensor 1 / Abnormality of ASIC operation" UBYTE B_TRUE 1 100 0.00 1.00000000000 BIT_MASK 0x1 FORMAT "%13.11" ECU_ADDRESS 0x50005554 /end MEASUREMENT
/begin MEASUREMENT UEGO_CJ135DiagS1B1_I.flgErrSpiPsbl "Class instance of the functional class of FC UEGO_CJ135Dia for Bank 1 Sensor 1 / Possible SPI error" UBYTE B_TRUE 1 100 0.00 1.00000000000 BIT_MASK 0x1 FORMAT "%13.11" ECU_ADDRESS 0x50005555 /end MEASUREMENT
/begin MEASUREMENT UEGO_CJ135DiagS1B1_I.flgErrSpiRamBnk "Class instance of the functional class of FC UEGO_CJ135Dia for Bank 1 Sensor 1 / SPI error of the RAM bank of the ASIC" UBYTE B_TRUE 1 100 0.00 1.00000000000 BIT_MASK 0x1 FORMAT "%13.11" ECU_ADDRESS 0x50005556 /end MEASUREMENT
/begin MEASUREMENT UEGO_CJ135DiagS1B1_I.flgLockdAsic "Class instance of the functional class of FC UEGO_CJ135Dia for Bank 1 Sensor 1 / Locked state due to the ASIC diagnosis" UBYTE B_TRUE 1 100 0.00 1.00000000000 BIT_MASK 0x1 FORMAT "%13.11" ECU_ADDRESS 0x50005557 /end MEASUREMENT
/begin MEASUREMENT UEGO_CJ135DiagS1B1_I.flgLockdIdleReq "Class instance of the functional class of FC UEGO_CJ135Dia for Bank 1 Sensor 1 / Flag locking the fault report due to currently requested Idle Mode" UBYTE B_TRUE 1 100 0.00 1.00000000000 BIT_MASK 0x1 FORMAT "%13.11" ECU_ADDRESS 0x50005558 /end MEASUREMENT
/begin MEASUREMENT UEGO_CJ135DiagS1B1_I.flgLockdSpi "Class instance of the functional class of FC UEGO_CJ135Dia for Bank 1 Sensor 1 / Locked state due to the SPI diagnosis" UBYTE B_TRUE 1 100 0.00 1.00000000000 BIT_MASK 0x1 FORMAT "%13.11" ECU_ADDRESS 0x50005559 /end MEASUREMENT
/begin MEASUREMENT UEGO_CJ135DiagS1B1_I.flgRstEcuReq "Class instance of the functional class of FC UEGO_CJ135Dia for Bank 1 Sensor 1 / Reset request within UEGO of the data concerning the ECU of the ASIC" UBYTE B_TRUE 1 100 0.00 1.00000000000 BIT_MASK 0x1 FORMAT "%13.11" ECU_ADDRESS 0x5000555A /end MEASUREMENT
/begin MEASUREMENT UEGO_CJ135DiagS1B1_I.flgRstExtReq "Class instance of the functional class of FC UEGO_CJ135Dia for Bank 1 Sensor 1 / External Reset Request" UBYTE B_TRUE 1 100 0.00 1.00000000000 BIT_MASK 0x1 FORMAT "%13.11" ECU_ADDRESS 0x5000555B /end MEASUREMENT
/begin MEASUREMENT UEGO_CJ135DiagS1B1_I.numModCtrl "Class instance of the functional class of FC UEGO_CJ135Dia for Bank 1 Sensor 1 / Requested mode via remote control for the ASIC" UBYTE dez 1 100 0.00 255.0 FORMAT "%5.1" ECU_ADDRESS 0x5000555C /end MEASUREMENT
/begin MEASUREMENT UEGO_CJ135DiagS1B1_I.numModCtrlLst "Class instance of the functional class of FC UEGO_CJ135Dia for Bank 1 Sensor 1 / Last requested mode via remote control for the ASIC" UBYTE dez 1 100 0.00 255.0 FORMAT "%5.1" ECU_ADDRESS 0x5000555D /end MEASUREMENT
/begin MEASUREMENT UEGO_CJ135DiagS1B1_I.stDiagAsicErr "Class instance of the functional class of FC UEGO_CJ135Dia for Bank 1 Sensor 1 / Status of the error evaluation of the ASIC diagnosis" UWORD dez 1 100 0.00 65535.00 FORMAT "%8.2" ECU_ADDRESS 0x5000555E /end MEASUREMENT
/begin MEASUREMENT UEGO_CJ135DiagS1B1_I.stDiagSpiErr "Class instance of the functional class of FC UEGO_CJ135Dia for Bank 1 Sensor 1 / Status of the error evaluation of the SPI diagnosis" UWORD dez 1 100 0.00 65535.00 FORMAT "%8.2" ECU_ADDRESS 0x50005560 /end MEASUREMENT
/begin MEASUREMENT UEGO_CJ135DiagS1B1_I.ErrAsicTONVNM_I.time "Class instance of the functional class of FC UEGO_CJ135Dia for Bank 1 Sensor 1 / Delay in order to evalute ASIC errors / Delay Time" UWORD t_q0p01 1 100 0.00 655.3500 FORMAT "%8.4" ECU_ADDRESS 0x50005562 /end MEASUREMENT
/begin MEASUREMENT UEGO_CJ135DiagS1B1_I.ErrSpiTONVNM_I.time "Class instance of the functional class of FC UEGO_CJ135Dia for Bank 1 Sensor 1 / Delay in order to evalute SPI errors / Delay Time" UWORD t_q0p01 1 100 0.00 655.3500 FORMAT "%8.4" ECU_ADDRESS 0x50005564 /end MEASUREMENT
/begin MEASUREMENT UEGO_CJ135DiagS1B1_I.ModCurrVrfdCTR_I.counter "Class instance of the functional class of FC UEGO_CJ135Dia for Bank 1 Sensor 1 / Counter to verify the actual mode / current counter value" UBYTE dez 1 100 0.00 255.0 FORMAT "%5.1" ECU_ADDRESS 0x50005566 /end MEASUREMENT
/begin MEASUREMENT UEGO_CJ135DiagS1B1_I.ModCurrWaitCTR_I.counter "Class instance of the functional class of FC UEGO_CJ135Dia for Bank 1 Sensor 1 / Counter in order to analysis inconsistent actual modes / current counter value" UBYTE dez 1 100 0.00 255.0 FORMAT "%5.1" ECU_ADDRESS 0x50005567 /end MEASUREMENT
/begin MEASUREMENT UEGO_CJ135DiagS1B1_I.ModDesVrfdCTR_I.counter "Class instance of the functional class of FC UEGO_CJ135Dia for Bank 1 Sensor 1 / Counter to verify the desired mode / current counter value" UBYTE dez 1 100 0.00 255.0 FORMAT "%5.1" ECU_ADDRESS 0x50005568 /end MEASUREMENT
/begin MEASUREMENT UEGO_CJ135DiagS1B1_I.ModDesWaitCTR_I.counter "Class instance of the functional class of FC UEGO_CJ135Dia for Bank 1 Sensor 1 / Counter in order to analysis inconsistent desired modes / current counter value" UBYTE dez 1 100 0.00 255.0 FORMAT "%5.1" ECU_ADDRESS 0x50005569 /end MEASUREMENT
/begin MEASUREMENT UEGO_CJ135DiagS1B1_I.ModMeasVrfdCTR_I.counter "Class instance of the functional class of FC UEGO_CJ135Dia for Bank 1 Sensor 1 / Counter to verify the measured mode / current counter value" UBYTE dez 1 100 0.00 255.0 FORMAT "%5.1" ECU_ADDRESS 0x5000556A /end MEASUREMENT
/begin MEASUREMENT UEGO_CJ135DiagS1B1_I.ModMeasWaitCTR_I.counter "Class instance of the functional class of FC UEGO_CJ135Dia for Bank 1 Sensor 1 / Counter in order to analysis inconsistent measured modes / current counter value" UBYTE dez 1 100 0.00 255.0 FORMAT "%5.1" ECU_ADDRESS 0x5000556B /end MEASUREMENT
/begin MEASUREMENT UEGO_CJ135DiagS1B1_I.tiCmnIrqSlowErrSWE_I.timeCounter "Class instance of the functional class of FC UEGO_CJ135Dia for Bank 1 Sensor 1 / Stop Watch for IRQ Slow / Elapsed time since start" UBYTE t_q0p01 1 100 0.00 2.550 FORMAT "%5.3" ECU_ADDRESS 0x5000556C /end MEASUREMENT
/begin MEASUREMENT UEGO_CJ135DiagSnsrS1B1_I.cntrUPmpLimd "Class lambda-sensor diagnosis sensor 1 bank 1 / Number of limited pump voltage in one pump package" UBYTE OneToOne 1 100 0.00 255.0 FORMAT "%5.1" ECU_ADDRESS 0x5000556E /end MEASUREMENT
/begin MEASUREMENT UEGO_CJ135DiagSnsrS1B1_I.facSigNotAvail "Class lambda-sensor diagnosis sensor 1 bank 1 / UEGO signal not-available ratio" UWORD fak_uw_b1 1 100 0.00 0.9999847 FORMAT "%9.7" ECU_ADDRESS 0x50005570 /end MEASUREMENT
/begin MEASUREMENT UEGO_CJ135DiagSnsrS1B1_I.flgAvailFlt "Class lambda-sensor diagnosis sensor 1 bank 1 / Fault detected by the availability diagnosis" UBYTE B_TRUE 1 100 0.00 1.00000000000 BIT_MASK 0x1 FORMAT "%13.11" ECU_ADDRESS 0x50005572 /end MEASUREMENT
/begin MEASUREMENT UEGO_CJ135DiagSnsrS1B1_I.flgAvailRels "Class lambda-sensor diagnosis sensor 1 bank 1 / Release to Tested-report of the availability diagnosis" UBYTE B_TRUE 1 100 0.00 1.00000000000 BIT_MASK 0x1 FORMAT "%13.11" ECU_ADDRESS 0x50005573 /end MEASUREMENT
/begin MEASUREMENT UEGO_CJ135DiagSnsrS1B1_I.flgAvailWinEnd "Class lambda-sensor diagnosis sensor 1 bank 1 / End of time window of the availability diagnosis" UBYTE B_TRUE 1 100 0.00 1.00000000000 BIT_MASK 0x1 FORMAT "%13.11" ECU_ADDRESS 0x50005574 /end MEASUREMENT
/begin MEASUREMENT UEGO_CJ135DiagSnsrS1B1_I.flgLockdSnsr "Class lambda-sensor diagnosis sensor 1 bank 1 / Locked state due to the sensor diagnosis" UBYTE B_TRUE 1 100 0.00 1.00000000000 BIT_MASK 0x1 FORMAT "%13.11" ECU_ADDRESS 0x50005575 /end MEASUREMENT
/begin MEASUREMENT UEGO_CJ135DiagSnsrS1B1_I.flgRstExtReq "Class lambda-sensor diagnosis sensor 1 bank 1 / External Reset Request" UBYTE B_TRUE 1 100 0.00 1.00000000000 BIT_MASK 0x1 FORMAT "%13.11" ECU_ADDRESS 0x50005576 /end MEASUREMENT
/begin MEASUREMENT UEGO_CJ135DiagSnsrS1B1_I.flgRstSnsrReq "Class lambda-sensor diagnosis sensor 1 bank 1 / Reset request within UEGO of the data concerning the sensor" UBYTE B_TRUE 1 100 0.00 1.00000000000 BIT_MASK 0x1 FORMAT "%13.11" ECU_ADDRESS 0x50005577 /end MEASUREMENT
/begin MEASUREMENT UEGO_CJ135DiagSnsrS1B1_I.flgSnsrErr "Class lambda-sensor diagnosis sensor 1 bank 1 / Fault detection of sensor diagnosis" UBYTE B_TRUE 1 100 0.00 1.00000000000 BIT_MASK 0x1 FORMAT "%13.11" ECU_ADDRESS 0x50005578 /end MEASUREMENT
/begin MEASUREMENT UEGO_CJ135DiagSnsrS1B1_I.stDiagErr "Class lambda-sensor diagnosis sensor 1 bank 1 / Status of the error evaluation of the sensor diagnosis" UBYTE OneToOne 1 100 0.00 255.0 FORMAT "%5.1" ECU_ADDRESS 0x50005579 /end MEASUREMENT
/begin MEASUREMENT UEGO_CJ135DiagSnsrS1B1_I.DiagBlacknTOFFVNM_I.time "Class lambda-sensor diagnosis sensor 1 bank 1 / Turn-off delay in order to evalute blackening protection detection / delay time" UBYTE t_q0p01 1 100 0.00 2.550 FORMAT "%5.3" ECU_ADDRESS 0x5000557A /end MEASUREMENT
/begin MEASUREMENT UEGO_CJ135DiagSnsrS1B1_I.DiagBlacknTONVNM_I.time "Class lambda-sensor diagnosis sensor 1 bank 1 / Turn-on delay in order to evalute blackening protection detection / Delay Time" UBYTE t_q0p01 1 100 0.00 2.550 FORMAT "%5.3" ECU_ADDRESS 0x5000557B /end MEASUREMENT
/begin MEASUREMENT UEGO_CJ135DiagSnsrS1B1_I.SigAvailWinEndTONVNM_I.time "Class lambda-sensor diagnosis sensor 1 bank 1 / Turn-On delay to determine the end of the time window of the availability diagnosis / Delay Time" UWORD t_q0p01 1 100 0.00 655.3500 FORMAT "%8.4" ECU_ADDRESS 0x5000557C /end MEASUREMENT
/begin MEASUREMENT UEGO_CJ135DiagSnsrS1B1_I.SigNotAvailSW_I.timeCounter "Class lambda-sensor diagnosis sensor 1 bank 1 / Integrated time duration of invalid signals during the time window of the UEGO availability diagnosis / expired time since start" UWORD t_q0p01 1 100 0.00 655.3500 FORMAT "%8.4" ECU_ADDRESS 0x5000557E /end MEASUREMENT
/begin MEASUREMENT UEGO_CJ135DiagSnsrS1B1_I.TRelsTONVNM_I.time "Class lambda-sensor diagnosis sensor 1 bank 1 / Turn-on delay for the temperature release / Delay Time" UBYTE t_q0p01 1 100 0.00 2.550 FORMAT "%5.3" ECU_ADDRESS 0x50005580 /end MEASUREMENT
/begin MEASUREMENT UEGO_CJ135DiagWireS1B1_I.cntrErrPndUgxNeg "Class instance of the functional class of FC UEGO_CJ135DiagWire for sensor 1 bank 1 / counter for overshooting of negative voltage threshold during delta Ugx check" UBYTE dez 1 100 0.00 255.0 FORMAT "%5.1" ECU_ADDRESS 0x50005585 /end MEASUREMENT
/begin MEASUREMENT UEGO_CJ135DiagWireS1B1_I.cntrErrPndUgxPos "Class instance of the functional class of FC UEGO_CJ135DiagWire for sensor 1 bank 1 / counter for overshooting of positive voltage threshold during delta Ugx check" UBYTE dez 1 100 0.00 255.0 FORMAT "%5.1" ECU_ADDRESS 0x50005586 /end MEASUREMENT
/begin MEASUREMENT UEGO_CJ135DiagWireS1B1_I.flgAnlyFinshd "Class instance of the functional class of FC UEGO_CJ135DiagWire for sensor 1 bank 1 / Analysis step finsihed" UBYTE B_TRUE 1 100 0.00 1.00000000000 BIT_MASK 0x1 FORMAT "%13.11" ECU_ADDRESS 0x50005583 /end MEASUREMENT
/begin MEASUREMENT UEGO_CJ135DiagWireS1B1_I.flgDchaReqd "Class instance of the functional class of FC UEGO_CJ135DiagWire for sensor 1 bank 1 / Discharge (of capacitors) requested" UBYTE B_TRUE 1 100 0.00 1.00000000000 BIT_MASK 0x2 FORMAT "%13.11" ECU_ADDRESS 0x50005583 /end MEASUREMENT
/begin MEASUREMENT UEGO_CJ135DiagWireS1B1_I.flgDeltaUgxExcddRgl "Class instance of the functional class of FC UEGO_CJ135DiagWire for sensor 1 bank 1 / Delta-Ugx value exceeded threshold in ASIC mode REGULAR NORMAL" UBYTE B_TRUE 1 100 0.00 1.00000000000 BIT_MASK 0x1 FORMAT "%13.11" ECU_ADDRESS 0x50005587 /end MEASUREMENT
/begin MEASUREMENT UEGO_CJ135DiagWireS1B1_I.flgDiagOlEna "Class instance of the functional class of FC UEGO_CJ135DiagWire for sensor 1 bank 1 / Release of open load diagnosis" UBYTE B_TRUE 1 100 0.00 1.00000000000 BIT_MASK 0x20 FORMAT "%13.11" ECU_ADDRESS 0x50005584 /end MEASUREMENT
/begin MEASUREMENT UEGO_CJ135DiagWireS1B1_I.flgDiagRprtRels "Class instance of the functional class of FC UEGO_CJ135DiagWire for sensor 1 bank 1 / Release of diagnosis report" UBYTE B_TRUE 1 100 0.00 1.00000000000 BIT_MASK 0x40 FORMAT "%13.11" ECU_ADDRESS 0x50005584 /end MEASUREMENT
/begin MEASUREMENT UEGO_CJ135DiagWireS1B1_I.flgDrctDebReq "Class instance of the functional class of FC UEGO_CJ135DiagWire for sensor 1 bank 1 / Request for direct debouncing" UBYTE B_TRUE 1 100 0.00 1.00000000000 BIT_MASK 0x1 FORMAT "%13.11" ECU_ADDRESS 0x50005588 /end MEASUREMENT
/begin MEASUREMENT UEGO_CJ135DiagWireS1B1_I.flgDsmClr "Class instance of the functional class of FC UEGO_CJ135DiagWire for sensor 1 bank 1 / Request for clearing the fault path" UBYTE B_TRUE 1 100 0.00 1.00000000000 BIT_MASK 0x1 FORMAT "%13.11" ECU_ADDRESS 0x50005589 /end MEASUREMENT
/begin MEASUREMENT UEGO_CJ135DiagWireS1B1_I.flgErrOlApes "Class instance of the functional class of FC UEGO_CJ135DiagWire for sensor 1 bank 1 / Transfer bit showing that an open load error at APES has occurred" UBYTE B_TRUE 1 100 0.00 1.00000000000 BIT_MASK 0x4 FORMAT "%13.11" ECU_ADDRESS 0x50005582 /end MEASUREMENT
/begin MEASUREMENT UEGO_CJ135DiagWireS1B1_I.flgErrOlIpe "Class instance of the functional class of FC UEGO_CJ135DiagWire for sensor 1 bank 1 / Transfer bit showing that an open load error at IPE has occurred" UBYTE B_TRUE 1 100 0.00 1.00000000000 BIT_MASK 0x8 FORMAT "%13.11" ECU_ADDRESS 0x50005582 /end MEASUREMENT
/begin MEASUREMENT UEGO_CJ135DiagWireS1B1_I.flgErrOlRCmp "Class instance of the functional class of FC UEGO_CJ135DiagWire for sensor 1 bank 1 / Transfer bit showing that an open load error at the compensation resistor has occurred" UBYTE B_TRUE 1 100 0.00 1.00000000000 BIT_MASK 0x20 FORMAT "%13.11" ECU_ADDRESS 0x50005582 /end MEASUREMENT
/begin MEASUREMENT UEGO_CJ135DiagWireS1B1_I.flgErrOlRe "Class instance of the functional class of FC UEGO_CJ135DiagWire for sensor 1 bank 1 / Transfer bit showing that an open load error at RE has occurred" UBYTE B_TRUE 1 100 0.00 1.00000000000 BIT_MASK 0x10 FORMAT "%13.11" ECU_ADDRESS 0x50005582 /end MEASUREMENT
/begin MEASUREMENT UEGO_CJ135DiagWireS1B1_I.flgErrScb "Class instance of the functional class of FC UEGO_CJ135DiagWire for sensor 1 bank 1 / Transfer bit showing that a short circuit error to battery has occurred" UBYTE B_TRUE 1 100 0.00 1.00000000000 BIT_MASK 0x2 FORMAT "%13.11" ECU_ADDRESS 0x50005582 /end MEASUREMENT
/begin MEASUREMENT UEGO_CJ135DiagWireS1B1_I.flgErrScg "Class instance of the functional class of FC UEGO_CJ135DiagWire for sensor 1 bank 1 / Transfer bit showing that a short circuit error to ground has occurred" UBYTE B_TRUE 1 100 0.00 1.00000000000 BIT_MASK 0x1 FORMAT "%13.11" ECU_ADDRESS 0x50005582 /end MEASUREMENT
/begin MEASUREMENT UEGO_CJ135DiagWireS1B1_I.flgErrSuspc "Class instance of the functional class of FC UEGO_CJ135DiagWire for sensor 1 bank 1 / Error hint at cable diagnosis" UBYTE B_TRUE 1 100 0.00 1.00000000000 BIT_MASK 0x1 FORMAT "%13.11" ECU_ADDRESS 0x5000558A /end MEASUREMENT
/begin MEASUREMENT UEGO_CJ135DiagWireS1B1_I.flgErrUg0iaiMin "Class instance of the functional class of FC UEGO_CJ135DiagWire for sensor 1 bank 1 / Abnormality at the last measurement of Ug0iai" UBYTE B_TRUE 1 100 0.00 1.00000000000 BIT_MASK 0x20 FORMAT "%13.11" ECU_ADDRESS 0x50005583 /end MEASUREMENT
/begin MEASUREMENT UEGO_CJ135DiagWireS1B1_I.flgErrUg0ieiMin "Class instance of the functional class of FC UEGO_CJ135DiagWire for sensor 1 bank 1 / Abnormality at the last measurement of Ug0iei" UBYTE B_TRUE 1 100 0.00 1.00000000000 BIT_MASK 0x8 FORMAT "%13.11" ECU_ADDRESS 0x50005583 /end MEASUREMENT
/begin MEASUREMENT UEGO_CJ135DiagWireS1B1_I.flgErrUnique "Class instance of the functional class of FC UEGO_CJ135DiagWire for sensor 1 bank 1 / Transfer bit showing an identified error" UBYTE B_TRUE 1 100 0.00 1.00000000000 BIT_MASK 0x4 FORMAT "%13.11" ECU_ADDRESS 0x50005583 /end MEASUREMENT
/begin MEASUREMENT UEGO_CJ135DiagWireS1B1_I.flgExtRstReq "Class instance of the functional class of FC UEGO_CJ135DiagWire for sensor 1 bank 1 / External reset request" UBYTE B_TRUE 1 100 0.00 1.00000000000 BIT_MASK 0x1 FORMAT "%13.11" ECU_ADDRESS 0x5000558B /end MEASUREMENT
/begin MEASUREMENT UEGO_CJ135DiagWireS1B1_I.flgIni "Class instance of the functional class of FC UEGO_CJ135DiagWire for sensor 1 bank 1 / Initialization request" UBYTE B_TRUE 1 100 0.00 1.00000000000 BIT_MASK 0x1 FORMAT "%13.11" ECU_ADDRESS 0x5000558C /end MEASUREMENT
/begin MEASUREMENT UEGO_CJ135DiagWireS1B1_I.flgPerdDiagOperEna "Class instance of the functional class of FC UEGO_CJ135DiagWire for sensor 1 bank 1 / Release of periodic diagnosis operatoin" UBYTE B_TRUE 1 100 0.00 1.00000000000 BIT_MASK 0x8 FORMAT "%13.11" ECU_ADDRESS 0x50005584 /end MEASUREMENT
/begin MEASUREMENT UEGO_CJ135DiagWireS1B1_I.flgRamAbort "Class instance of the functional class of FC UEGO_CJ135DiagWire for sensor 1 bank 1 / RAM transfer was aborted" UBYTE B_TRUE 1 100 0.00 1.00000000000 BIT_MASK 0x80 FORMAT "%13.11" ECU_ADDRESS 0x50005583 /end MEASUREMENT
/begin MEASUREMENT UEGO_CJ135DiagWireS1B1_I.flgRst "Class instance of the functional class of FC UEGO_CJ135DiagWire for sensor 1 bank 1 / Reset request" UBYTE B_TRUE 1 100 0.00 1.00000000000 BIT_MASK 0x1 FORMAT "%13.11" ECU_ADDRESS 0x5000558D /end MEASUREMENT
/begin MEASUREMENT UEGO_CJ135DiagWireS1B1_I.flgTstdOl "Class instance of the functional class of FC UEGO_CJ135DiagWire for sensor 1 bank 1 / Transfer bit showing that open load errors would have been detected" UBYTE B_TRUE 1 100 0.00 1.00000000000 BIT_MASK 0x4 FORMAT "%13.11" ECU_ADDRESS 0x50005584 /end MEASUREMENT
/begin MEASUREMENT UEGO_CJ135DiagWireS1B1_I.flgTstdRCmp "Class instance of the functional class of FC UEGO_CJ135DiagWire for sensor 1 bank 1 / Transfer bit showing that the compensation resistor was tested" UBYTE B_TRUE 1 100 0.00 1.00000000000 BIT_MASK 0x2 FORMAT "%13.11" ECU_ADDRESS 0x50005584 /end MEASUREMENT
/begin MEASUREMENT UEGO_CJ135DiagWireS1B1_I.flgTstdSc "Class instance of the functional class of FC UEGO_CJ135DiagWire for sensor 1 bank 1 / Transfer bit showing that short circuit errors would have been detected" UBYTE B_TRUE 1 100 0.00 1.00000000000 BIT_MASK 0x1 FORMAT "%13.11" ECU_ADDRESS 0x50005584 /end MEASUREMENT
/begin MEASUREMENT UEGO_CJ135DiagWireS1B1_I.flgUg0iaiResPrsnt "Class instance of the functional class of FC UEGO_CJ135DiagWire for sensor 1 bank 1 / Measurement of Ug0iai was done" UBYTE B_TRUE 1 100 0.00 1.00000000000 BIT_MASK 0x10 FORMAT "%13.11" ECU_ADDRESS 0x50005583 /end MEASUREMENT
/begin MEASUREMENT UEGO_CJ135DiagWireS1B1_I.numModCtrl "Class instance of the functional class of FC UEGO_CJ135DiagWire for sensor 1 bank 1 / Requested mode via remote control" UBYTE dez 1 100 0.00 255.0 FORMAT "%5.1" ECU_ADDRESS 0x5000558E /end MEASUREMENT
/begin MEASUREMENT UEGO_CJ135DiagWireS1B1_I.rParlRprt "Class instance of the functional class of FC UEGO_CJ135DiagWire for sensor 1 bank 1 / Parallel resistance between APE and MES" UWORD r_q0p1_Ohm 1 100 0.00 6553.500 FORMAT "%8.3" ECU_ADDRESS 0x50005590 /end MEASUREMENT
/begin MEASUREMENT UEGO_CJ135DiagWireS1B1_I.sm "Class instance of the functional class of FC UEGO_CJ135DiagWire for sensor 1 bank 1 / Current state in the state machine of the wire diagnosis" UBYTE UEGO_CJ135DiagWireClass_sm_VERB 1 100 0.00 12.0000000000 FORMAT "%13.10" ECU_ADDRESS 0x50005592 /end MEASUREMENT
/begin MEASUREMENT UEGO_CJ135DiagWireS1B1_I.stDiagWireErr "Class instance of the functional class of FC UEGO_CJ135DiagWire for sensor 1 bank 1 / Status of the error evaluation of the wire diagnosis" UWORD dez 1 100 0.00 65535.00 FORMAT "%8.2" ECU_ADDRESS 0x50005594 /end MEASUREMENT
/begin MEASUREMENT UEGO_CJ135DiagWireS1B1_I.stRprtWireErr "Class instance of the functional class of FC UEGO_CJ135DiagWire for sensor 1 bank 1 / Transfer bit showing errors detected by the wire diagnosis" UBYTE dez 1 100 0.00 255.0 FORMAT "%5.1" ECU_ADDRESS 0x50005596 /end MEASUREMENT
/begin MEASUREMENT UEGO_CJ135DiagWireS1B1_I.stRprtWireRes "Class instance of the functional class of FC UEGO_CJ135DiagWire for sensor 1 bank 1 / Transfer bit showing results of the wire diagnosis" UBYTE dez 1 100 0.00 255.0 FORMAT "%5.1" ECU_ADDRESS 0x50005597 /end MEASUREMENT
/begin MEASUREMENT UEGO_CJ135DiagWireS1B1_I.DlyDeltaUgaThdTOFFVNM_I.time "Class instance of the functional class of FC UEGO_CJ135DiagWire for sensor 1 bank 1 / Time delay to switch between high threshold to low threshold based on Uga / delay time" UBYTE t_q0p01 1 100 0.00 2.550 FORMAT "%5.3" ECU_ADDRESS 0x50005598 /end MEASUREMENT
/begin MEASUREMENT UEGO_CJ135DiagWireS1B1_I.DlyDeltaUgiThdTOFFVNM_I.time "Class instance of the functional class of FC UEGO_CJ135DiagWire for sensor 1 bank 1 / Time delay to switch between high threshold to low threshold based on Ugi / delay time" UBYTE t_q0p01 1 100 0.00 2.550 FORMAT "%5.3" ECU_ADDRESS 0x50005599 /end MEASUREMENT
/begin MEASUREMENT UEGO_CJ135DiagWireS1B1_I.IPmpLimdTONVNM_I.time "Class instance of the functional class of FC UEGO_CJ135DiagWire for sensor 1 bank 1 / Delay in order to evaluate a limited pump current / Delay Time" UBYTE t_q0p01 1 100 0.00 2.550 FORMAT "%5.3" ECU_ADDRESS 0x5000559A /end MEASUREMENT
/begin MEASUREMENT UEGO_CJ135DiagWireS1B1_I.PerdDiagOperT_I.timeCounter "Class instance of the functional class of FC UEGO_CJ135DiagWire for sensor 1 bank 1 / Timer to activate periodic diagnosis operation / Remaining time of the timer" UWORD t_q0p01 1 100 0.00 655.3500 FORMAT "%8.4" ECU_ADDRESS 0x5000559C /end MEASUREMENT
/begin MEASUREMENT UEGO_CJ135DiagWireS1B1_I.UgxNegTONVNM_I.time "Class instance of the functional class of FC UEGO_CJ135DiagWire for sensor 1 bank 1 / Turn-on delay for detecting minimal Uga and Ugi measurements / Delay Time" UBYTE t_q0p01 1 100 0.00 2.550 FORMAT "%5.3" ECU_ADDRESS 0x5000559E /end MEASUREMENT
/begin MEASUREMENT UEGO_CJ135DiagWireS1B1_I.UgxPosTONVNM_I.time "Class instance of the functional class of FC UEGO_CJ135DiagWire for sensor 1 bank 1 / Turn-on delay for detecting maximal Uga and Ugi measurements / Delay Time" UBYTE t_q0p01 1 100 0.00 2.550 FORMAT "%5.3" ECU_ADDRESS 0x5000559F /end MEASUREMENT
/begin MEASUREMENT UEGO_CJ135IPmpEvalS1B1_I.UEGO_CJ135IPmpEval_ctReiniProc5msec "Class instance of the functional class of FC UEGO_CJ135IPmpEval for Bank 1 Sensor 1 / local variable for the detection of Reinit in 5ms-task" UBYTE OneToOne 1 100 0.00 255.0 FORMAT "%5.1" ECU_ADDRESS 0x50001EE0 /end MEASUREMENT
/begin MEASUREMENT UEGO_CJ135IPmpEvalS1B1_I.cntrSum "Class instance of the functional class of FC UEGO_CJ135IPmpEval for Bank 1 Sensor 1 / sum counter" UBYTE dez 1 100 0.00 255.0 FORMAT "%5.1" ECU_ADDRESS 0x50001EE7 /end MEASUREMENT
/begin MEASUREMENT UEGO_CJ135IPmpEvalS1B1_I.facCrvCor "Class instance of the functional class of FC UEGO_CJ135IPmpEval for Bank 1 Sensor 1 / pump current correction factor of sensor adjustment" UWORD fak_uw_b2 1 100 0.00 1.999969 FORMAT "%8.6" ECU_ADDRESS 0x50001EE8 /end MEASUREMENT
/begin MEASUREMENT UEGO_CJ135IPmpEvalS1B1_I.flgCurrPck1 "Class instance of the functional class of FC UEGO_CJ135IPmpEval for Bank 1 Sensor 1 / Current state of ring buffer to be filled" UBYTE B_TRUE 1 100 0.00 1.00000000000 BIT_MASK 0x1 FORMAT "%13.11" ECU_ADDRESS 0x50001EEA /end MEASUREMENT
/begin MEASUREMENT UEGO_CJ135IPmpEvalS1B1_I.flgIPLrnAllwd "Class instance of the functional class of FC UEGO_CJ135IPmpEval for Bank 1 Sensor 1 / status of Ip learning" UBYTE B_TRUE 1 100 0.00 1.00000000000 BIT_MASK 0x1 FORMAT "%13.11" ECU_ADDRESS 0x50001EE5 /end MEASUREMENT
/begin MEASUREMENT UEGO_CJ135IPmpEvalS1B1_I.flgIPLrnVld "Class instance of the functional class of FC UEGO_CJ135IPmpEval for Bank 1 Sensor 1 / Indication for validity of the IP-Learning-Filter" UBYTE B_TRUE 1 100 0.00 1.00000000000 BIT_MASK 0x2 FORMAT "%13.11" ECU_ADDRESS 0x50001EE5 /end MEASUREMENT
/begin MEASUREMENT UEGO_CJ135IPmpEvalS1B1_I.flgIPTM2RLst "Class instance of the functional class of FC UEGO_CJ135IPmpEval for Bank 1 Sensor 1 / TM2 Rich last status of Ip" UBYTE B_TRUE 1 100 0.00 1.00000000000 BIT_MASK 0x20 FORMAT "%13.11" ECU_ADDRESS 0x50001EE3 /end MEASUREMENT
/begin MEASUREMENT UEGO_CJ135IPmpEvalS1B1_I.flgIPmpCrclrAvl "Class instance of the functional class of FC UEGO_CJ135IPmpEval for Bank 1 Sensor 1 / Status of the IP ring buffer availabilty" UBYTE B_TRUE 1 100 0.00 1.00000000000 BIT_MASK 0x1 FORMAT "%13.11" ECU_ADDRESS 0x50001EEB /end MEASUREMENT
/begin MEASUREMENT UEGO_CJ135IPmpEvalS1B1_I.flgIPmpCtrlActvd "Class instance of the functional class of FC UEGO_CJ135IPmpEval for Bank 1 Sensor 1 / ip control activated" UBYTE B_TRUE 1 100 0.00 1.00000000000 BIT_MASK 0x40 FORMAT "%13.11" ECU_ADDRESS 0x50001EE2 /end MEASUREMENT
/begin MEASUREMENT UEGO_CJ135IPmpEvalS1B1_I.flgIPmpCtrlActvnDly "Class instance of the functional class of FC UEGO_CJ135IPmpEval for Bank 1 Sensor 1 / delayed flag indicating activation of ip control" UBYTE B_TRUE 1 100 0.00 1.00000000000 BIT_MASK 0x2 FORMAT "%13.11" ECU_ADDRESS 0x50001EE1 /end MEASUREMENT
/begin MEASUREMENT UEGO_CJ135IPmpEvalS1B1_I.flgIPmpCtrlBlckn "Class instance of the functional class of FC UEGO_CJ135IPmpEval for Bank 1 Sensor 1 / flag indicating activation of blackening protection" UBYTE B_TRUE 1 100 0.00 1.00000000000 BIT_MASK 0x10 FORMAT "%13.11" ECU_ADDRESS 0x50001EE1 /end MEASUREMENT
/begin MEASUREMENT UEGO_CJ135IPmpEvalS1B1_I.flgIPmpCtrlBlcknOffDly "Class instance of the functional class of FC UEGO_CJ135IPmpEval for Bank 1 Sensor 1 / delayed flag indicating activation of blackening protection" UBYTE B_TRUE 1 100 0.00 1.00000000000 BIT_MASK 0x1 FORMAT "%13.11" ECU_ADDRESS 0x50001EE1 /end MEASUREMENT
/begin MEASUREMENT UEGO_CJ135IPmpEvalS1B1_I.flgIPmpEvlnVld "Class instance of the functional class of FC UEGO_CJ135IPmpEval for Bank 1 Sensor 1 / flag indicating validity of ip evaluation" UBYTE B_TRUE 1 100 0.00 1.00000000000 BIT_MASK 0x1 FORMAT "%13.11" ECU_ADDRESS 0x50001EEC /end MEASUREMENT
/begin MEASUREMENT UEGO_CJ135IPmpEvalS1B1_I.flgIPmpPacVld "Class instance of the functional class of FC UEGO_CJ135IPmpEval for Bank 1 Sensor 1 / Indication for validity of current pump current package" UBYTE B_TRUE 1 100 0.00 1.00000000000 BIT_MASK 0x80 FORMAT "%13.11" ECU_ADDRESS 0x50001EE5 /end MEASUREMENT
/begin MEASUREMENT UEGO_CJ135IPmpEvalS1B1_I.flgIPmpSegFull "Class instance of the functional class of FC UEGO_CJ135IPmpEval for Bank 1 Sensor 1 / Indication for already filled ring buffer for IP segment calculation" UBYTE B_TRUE 1 100 0.00 1.00000000000 BIT_MASK 0x20 FORMAT "%13.11" ECU_ADDRESS 0x50001EE5 /end MEASUREMENT
/begin MEASUREMENT UEGO_CJ135IPmpEvalS1B1_I.flgIPmpSegStrtd "Class instance of the functional class of FC UEGO_CJ135IPmpEval for Bank 1 Sensor 1 / condition pump current calculation in sync started" UBYTE B_TRUE 1 100 0.00 1.00000000000 BIT_MASK 0x10 FORMAT "%13.11" ECU_ADDRESS 0x50001EE5 /end MEASUREMENT
/begin MEASUREMENT UEGO_CJ135IPmpEvalS1B1_I.flgIPmpSegVld "Class instance of the functional class of FC UEGO_CJ135IPmpEval for Bank 1 Sensor 1 / Indication for validity of current pump current segment" UBYTE B_TRUE 1 100 0.00 1.00000000000 BIT_MASK 0x40 FORMAT "%13.11" ECU_ADDRESS 0x50001EE5 /end MEASUREMENT
/begin MEASUREMENT UEGO_CJ135IPmpEvalS1B1_I.flgIPmpTM2ROscn "Class instance of the functional class of FC UEGO_CJ135IPmpEval for Bank 1 Sensor 1 / TM2 rich oscilation in pump current" UBYTE B_TRUE 1 100 0.00 1.00000000000 BIT_MASK 0x80 FORMAT "%13.11" ECU_ADDRESS 0x50001EE1 /end MEASUREMENT
/begin MEASUREMENT UEGO_CJ135IPmpEvalS1B1_I.flgNewIPmpRefCorrn "Class instance of the functional class of FC UEGO_CJ135IPmpEval for Bank 1 Sensor 1 / Reference pump current for pump current correction status" UBYTE B_TRUE 1 100 0.00 1.00000000000 BIT_MASK 0x4 FORMAT "%13.11" ECU_ADDRESS 0x50001EE5 /end MEASUREMENT
/begin MEASUREMENT UEGO_CJ135IPmpEvalS1B1_I.flgNewUn0 "Class instance of the functional class of FC UEGO_CJ135IPmpEval for Bank 1 Sensor 1 / new Un0" UBYTE B_TRUE 1 100 0.00 1.00000000000 BIT_MASK 0x8 FORMAT "%13.11" ECU_ADDRESS 0x50001EE3 /end MEASUREMENT
/begin MEASUREMENT UEGO_CJ135IPmpEvalS1B1_I.flgNewUp0 "Class instance of the functional class of FC UEGO_CJ135IPmpEval for Bank 1 Sensor 1 / new Up0" UBYTE B_TRUE 1 100 0.00 1.00000000000 BIT_MASK 0x10 FORMAT "%13.11" ECU_ADDRESS 0x50001EE3 /end MEASUREMENT
/begin MEASUREMENT UEGO_CJ135IPmpEvalS1B1_I.flgRCmpStrtd "Class instance of the functional class of FC UEGO_CJ135IPmpEval for Bank 1 Sensor 1 / flag calculation of plug resistor started" UBYTE B_TRUE 1 100 0.00 1.00000000000 BIT_MASK 0x4 FORMAT "%13.11" ECU_ADDRESS 0x50001EE6 /end MEASUREMENT
/begin MEASUREMENT UEGO_CJ135IPmpEvalS1B1_I.flgRCmpVld "Class instance of the functional class of FC UEGO_CJ135IPmpEval for Bank 1 Sensor 1 / calculated plug resistor valid" UBYTE B_TRUE 1 100 0.00 1.00000000000 BIT_MASK 0x1 FORMAT "%13.11" ECU_ADDRESS 0x50001EED /end MEASUREMENT
/begin MEASUREMENT UEGO_CJ135IPmpEvalS1B1_I.flgRParlStrtd "Class instance of the functional class of FC UEGO_CJ135IPmpEval for Bank 1 Sensor 1 / status of parralel resistance calculation" UBYTE B_TRUE 1 100 0.00 1.00000000000 BIT_MASK 0x2 FORMAT "%13.11" ECU_ADDRESS 0x50001EE6 /end MEASUREMENT
/begin MEASUREMENT UEGO_CJ135IPmpEvalS1B1_I.flgRParlVld "Class instance of the functional class of FC UEGO_CJ135IPmpEval for Bank 1 Sensor 1 / valid flag for the calculated parallel resistance" UBYTE B_TRUE 1 100 0.00 1.00000000000 BIT_MASK 0x1 FORMAT "%13.11" ECU_ADDRESS 0x50001EEE /end MEASUREMENT
/begin MEASUREMENT UEGO_CJ135IPmpEvalS1B1_I.flgRParlWoDsbc "Class instance of the functional class of FC UEGO_CJ135IPmpEval for Bank 1 Sensor 1 / flag showing that measuring of parallel resistance was without disturbance" UBYTE B_TRUE 1 100 0.00 1.00000000000 BIT_MASK 0x10 FORMAT "%13.11" ECU_ADDRESS 0x50001EE4 /end MEASUREMENT
/begin MEASUREMENT UEGO_CJ135IPmpEvalS1B1_I.flgRpcActv "Class instance of the functional class of FC UEGO_CJ135IPmpEval for Bank 1 Sensor 1 / Indication for a possible state of an active reverse pump current" UBYTE B_TRUE 1 100 0.00 1.00000000000 BIT_MASK 0x1 FORMAT "%13.11" ECU_ADDRESS 0x50001EEF /end MEASUREMENT
/begin MEASUREMENT UEGO_CJ135IPmpEvalS1B1_I.flgRvsChrgMeasActv "Class instance of the functional class of FC UEGO_CJ135IPmpEval for Bank 1 Sensor 1 / Indication for a possible state of an active reverse charge measurement" UBYTE B_TRUE 1 100 0.00 1.00000000000 BIT_MASK 0x1 FORMAT "%13.11" ECU_ADDRESS 0x50001EF0 /end MEASUREMENT
/begin MEASUREMENT UEGO_CJ135IPmpEvalS1B1_I.flgSteerpatChngdDlyd "Class instance of the functional class of FC UEGO_CJ135IPmpEval for Bank 1 Sensor 1 / Indication for turn-off-delayed change in STEERPAT register" UBYTE B_TRUE 1 100 0.00 1.00000000000 BIT_MASK 0x40 FORMAT "%13.11" ECU_ADDRESS 0x50001EE6 /end MEASUREMENT
/begin MEASUREMENT UEGO_CJ135IPmpEvalS1B1_I.flgUgaZ1Strtd "Class instance of the functional class of FC UEGO_CJ135IPmpEval for Bank 1 Sensor 1 / electrically corrected voltage uga current for switching state Z1" UBYTE B_TRUE 1 100 0.00 1.00000000000 BIT_MASK 0x4 FORMAT "%13.11" ECU_ADDRESS 0x50001EE4 /end MEASUREMENT
/begin MEASUREMENT UEGO_CJ135IPmpEvalS1B1_I.flgUgaZ2Strtd "Class instance of the functional class of FC UEGO_CJ135IPmpEval for Bank 1 Sensor 1 / electrically corrected voltage uga current for switching state Z2" UBYTE B_TRUE 1 100 0.00 1.00000000000 BIT_MASK 0x8 FORMAT "%13.11" ECU_ADDRESS 0x50001EE4 /end MEASUREMENT
/begin MEASUREMENT UEGO_CJ135IPmpEvalS1B1_I.flgUgiZ1Strtd "Class instance of the functional class of FC UEGO_CJ135IPmpEval for Bank 1 Sensor 1 / electrically corrected voltage ugi current flow z1" UBYTE B_TRUE 1 100 0.00 1.00000000000 BIT_MASK 0x1 FORMAT "%13.11" ECU_ADDRESS 0x50001EE4 /end MEASUREMENT
/begin MEASUREMENT UEGO_CJ135IPmpEvalS1B1_I.flgUgiZ2Strtd "Class instance of the functional class of FC UEGO_CJ135IPmpEval for Bank 1 Sensor 1 / electrically corrected voltage ugi current flow z2" UBYTE B_TRUE 1 100 0.00 1.00000000000 BIT_MASK 0x2 FORMAT "%13.11" ECU_ADDRESS 0x50001EE4 /end MEASUREMENT
/begin MEASUREMENT UEGO_CJ135IPmpEvalS1B1_I.flgUp0Z0Strtd "Class instance of the functional class of FC UEGO_CJ135IPmpEval for Bank 1 Sensor 1 / condition pump voltage calculation started" UBYTE B_TRUE 1 100 0.00 1.00000000000 BIT_MASK 0x1 FORMAT "%13.11" ECU_ADDRESS 0x50001EE3 /end MEASUREMENT
/begin MEASUREMENT UEGO_CJ135IPmpEvalS1B1_I.flgUp0Z1Strtd "Class instance of the functional class of FC UEGO_CJ135IPmpEval for Bank 1 Sensor 1 / condition pump voltage calculation started" UBYTE B_TRUE 1 100 0.00 1.00000000000 BIT_MASK 0x2 FORMAT "%13.11" ECU_ADDRESS 0x50001EE3 /end MEASUREMENT
/begin MEASUREMENT UEGO_CJ135IPmpEvalS1B1_I.flgUp0Z2Strtd "Class instance of the functional class of FC UEGO_CJ135IPmpEval for Bank 1 Sensor 1 / condition pump voltage calculation started" UBYTE B_TRUE 1 100 0.00 1.00000000000 BIT_MASK 0x4 FORMAT "%13.11" ECU_ADDRESS 0x50001EE3 /end MEASUREMENT
/begin MEASUREMENT UEGO_CJ135IPmpEvalS1B1_I.flgfacCrvCorrnVld "Class instance of the functional class of FC UEGO_CJ135IPmpEval for Bank 1 Sensor 1 / Valid status of correction." UBYTE B_TRUE 1 100 0.00 1.00000000000 BIT_MASK 0x8 FORMAT "%13.11" ECU_ADDRESS 0x50001EE6 /end MEASUREMENT
/begin MEASUREMENT UEGO_CJ135IPmpEvalS1B1_I.iIPmpBoostd "Class instance of the functional class of FC UEGO_CJ135IPmpEval for Bank 1 Sensor 1 / Boosted pump current (with curve correction)" SWORD i_q6p6667Em7_A 1 100 -0.02184533 0.02184467 FORMAT "%10.8" ECU_ADDRESS 0x50001EF2 /end MEASUREMENT
/begin MEASUREMENT UEGO_CJ135IPmpEvalS1B1_I.iIPmpDeltaPac "Class instance of the functional class of FC UEGO_CJ135IPmpEval for Bank 1 Sensor 1 / pump current package" SWORD i_q6p6667Em7_A 1 100 -0.02184533 0.02184467 FORMAT "%10.8" ECU_ADDRESS 0x50001EF4 /end MEASUREMENT
/begin MEASUREMENT UEGO_CJ135IPmpEvalS1B1_I.iIPmpElecCorrd "Class instance of the functional class of FC UEGO_CJ135IPmpEval for Bank 1 Sensor 1 / electrically corrected pump current" SWORD i_q6p6667Em7_A 1 100 -0.02184533 0.02184467 FORMAT "%10.8" ECU_ADDRESS 0x50001EF6 /end MEASUREMENT
/begin MEASUREMENT UEGO_CJ135IPmpEvalS1B1_I.iIPmpPacAvrg "Class instance of the functional class of FC UEGO_CJ135IPmpEval for Bank 1 Sensor 1 / average pump current package" SWORD i_q6p6667Em7_A 1 100 -0.02184533 0.02184467 FORMAT "%10.8" ECU_ADDRESS 0x50001EF8 /end MEASUREMENT
/begin MEASUREMENT UEGO_CJ135IPmpEvalS1B1_I.iIPmpRawLst "Class instance of the functional class of FC UEGO_CJ135IPmpEval for Bank 1 Sensor 1 / Last pump current value of last pump current package" SWORD i_q6p6667Em7_A 1 100 -0.02184533 0.02184467 FORMAT "%10.8" ECU_ADDRESS 0x50001EFA /end MEASUREMENT
/begin MEASUREMENT UEGO_CJ135IPmpEvalS1B1_I.iIPmpRef "Class instance of the functional class of FC UEGO_CJ135IPmpEval for Bank 1 Sensor 1 / reference pump current" SWORD i_q6p6667Em7_A 1 100 -0.02184533 0.02184467 FORMAT "%10.8" ECU_ADDRESS 0x50001EFC /end MEASUREMENT
/begin MEASUREMENT UEGO_CJ135IPmpEvalS1B1_I.iIPmpRefCorrn "Class instance of the functional class of FC UEGO_CJ135IPmpEval for Bank 1 Sensor 1 / reference pump current correction" SWORD i_q6p6667Em7_A 1 100 -0.02184533 0.02184467 FORMAT "%10.8" ECU_ADDRESS 0x50001EFE /end MEASUREMENT
/begin MEASUREMENT UEGO_CJ135IPmpEvalS1B1_I.iIPmpSegAvrg "Class instance of the functional class of FC UEGO_CJ135IPmpEval for Bank 1 Sensor 1 / mean value pump current segment synchronous" SWORD i_q6p6667Em7_A 1 100 -0.02184533 0.02184467 FORMAT "%10.8" ECU_ADDRESS 0x50001F00 /end MEASUREMENT
/begin MEASUREMENT UEGO_CJ135IPmpEvalS1B1_I.iIPmpSegAvrgWoCrvCorrn "Class instance of the functional class of FC UEGO_CJ135IPmpEval for Bank 1 Sensor 1 / Segment averaged pump current value without curve correction" SWORD i_q6p6667Em7_A 1 100 -0.02184533 0.02184467 FORMAT "%10.8" ECU_ADDRESS 0x50001F02 /end MEASUREMENT
/begin MEASUREMENT UEGO_CJ135IPmpEvalS1B1_I.iIPmpSegPartSumAry "Class instance of the functional class of FC UEGO_CJ135IPmpEval for Bank 1 Sensor 1 / Array for pump current sums of segment parts" SLONG i_q6p6667Em7_A 1 100 -1431.65576533 1431.65576467 FORMAT "%13.8" ARRAY_SIZE 4 ECU_ADDRESS 0x50001F04 /end MEASUREMENT
/begin MEASUREMENT UEGO_CJ135IPmpEvalS1B1_I.iIPmpSegSum "Class instance of the functional class of FC UEGO_CJ135IPmpEval for Bank 1 Sensor 1 / pump current package sum" SLONG i_q6p6667Em7_A 1 100 -1431.65576533 1431.65576467 FORMAT "%13.8" ECU_ADDRESS 0x50001F14 /end MEASUREMENT
/begin MEASUREMENT UEGO_CJ135IPmpEvalS1B1_I.iIPmpSegWoCrvCorrn "Class instance of the functional class of FC UEGO_CJ135IPmpEval for Bank 1 Sensor 1 / segment synchronously averaged pump current value without correction by the plug resistance" SWORD i_q6p6667Em7_A 1 100 -0.02184533 0.02184467 FORMAT "%10.8" ECU_ADDRESS 0x50001F18 /end MEASUREMENT
/begin MEASUREMENT UEGO_CJ135IPmpEvalS1B1_I.iIPmpSmotngBoostd "Class instance of the functional class of FC UEGO_CJ135IPmpEval for Bank 1 Sensor 1 / smoothed boosted pump current (with curve correction)" SWORD i_q6p6667Em7_A 1 100 -0.02184533 0.02184467 FORMAT "%10.8" ECU_ADDRESS 0x50001F1A /end MEASUREMENT
/begin MEASUREMENT UEGO_CJ135IPmpEvalS1B1_I.iIPmpSmotngElecCorrd "Class instance of the functional class of FC UEGO_CJ135IPmpEval for Bank 1 Sensor 1 / smothed electrical corrected pump current" SWORD i_q6p6667Em7_A 1 100 -0.02184533 0.02184467 FORMAT "%10.8" ECU_ADDRESS 0x50001F1C /end MEASUREMENT
/begin MEASUREMENT UEGO_CJ135IPmpEvalS1B1_I.numCntrIPmpLimdPck "Class instance of the functional class of FC UEGO_CJ135IPmpEval for Bank 1 Sensor 1 / number of limited ip values lime in a package" UBYTE dez 1 100 0.00 255.0 FORMAT "%5.1" ECU_ADDRESS 0x50001F1E /end MEASUREMENT
/begin MEASUREMENT UEGO_CJ135IPmpEvalS1B1_I.numCtrSegPartSumAry "Class instance of the functional class of FC UEGO_CJ135IPmpEval for Bank 1 Sensor 1 / Array for counter of segment parts" UBYTE dez 1 100 0.00 255.0 FORMAT "%5.1" ARRAY_SIZE 4 ECU_ADDRESS 0x50001F1F /end MEASUREMENT
/begin MEASUREMENT UEGO_CJ135IPmpEvalS1B1_I.numRefPatSet "Class instance of the functional class of FC UEGO_CJ135IPmpEval for Bank 1 Sensor 1 / refpat register set number" UBYTE dez 1 100 0.00 255.0 FORMAT "%5.1" ECU_ADDRESS 0x50001F23 /end MEASUREMENT
/begin MEASUREMENT UEGO_CJ135IPmpEvalS1B1_I.numSegPartMax "Class instance of the functional class of FC UEGO_CJ135IPmpEval for Bank 1 Sensor 1 / Maximum number of values in current segment part" UBYTE dez 1 100 0.00 255.0 FORMAT "%5.1" ECU_ADDRESS 0x50001F24 /end MEASUREMENT
/begin MEASUREMENT UEGO_CJ135IPmpEvalS1B1_I.numSegPartPosCurr "Class instance of the functional class of FC UEGO_CJ135IPmpEval for Bank 1 Sensor 1 / Current position in the segment array" UBYTE dez 1 100 0.00 255.0 FORMAT "%5.1" ECU_ADDRESS 0x50001F25 /end MEASUREMENT
/begin MEASUREMENT UEGO_CJ135IPmpEvalS1B1_I.ratIPmpAvrg "Class instance of the functional class of FC UEGO_CJ135IPmpEval for Bank 1 Sensor 1 / average of pump current" SWORD fak_q1p201Em4 1 100 -3.936096 3.935976 FORMAT "%8.6" ECU_ADDRESS 0x50001F26 /end MEASUREMENT
/begin MEASUREMENT UEGO_CJ135IPmpEvalS1B1_I.resRCrv "Class instance of the functional class of FC UEGO_CJ135IPmpEval for Bank 1 Sensor 1 / pump current curve resistance on sensor adjustment" UWORD r_q0p1_Ohm 1 100 0.00 6553.500 FORMAT "%8.3" ECU_ADDRESS 0x50000F28 /end MEASUREMENT
/begin MEASUREMENT UEGO_CJ135IPmpEvalS1B1_I.resRRef "Class instance of the functional class of FC UEGO_CJ135IPmpEval for Bank 1 Sensor 1 / resistance for sensor adjustment (used only for NTK ZTAS U2 and U3)" UWORD r_q0p1_Ohm 1 100 0.00 6553.500 FORMAT "%8.3" ECU_ADDRESS 0x50000F2A /end MEASUREMENT
/begin MEASUREMENT UEGO_CJ135IPmpEvalS1B1_I.resRSerl "Class instance of the functional class of FC UEGO_CJ135IPmpEval for Bank 1 Sensor 1 / resistance for sensor adjustment (used only for NTK ZTAS U2 and U3)" UWORD r_q0p1_Ohm 1 100 0.00 6553.500 FORMAT "%8.3" ECU_ADDRESS 0x50000F2C /end MEASUREMENT
/begin MEASUREMENT UEGO_CJ135IPmpEvalS1B1_I.stDSQIPmp "Class instance of the functional class of FC UEGO_CJ135IPmpEval for Bank 1 Sensor 1 / Signal quality of the pump current" UBYTE OneToOne 1 100 0.00 255.0 FORMAT "%5.1" ECU_ADDRESS 0x50001F28 /end MEASUREMENT
/begin MEASUREMENT UEGO_CJ135IPmpEvalS1B1_I.stIPmpOK "Class instance of the functional class of FC UEGO_CJ135IPmpEval for Bank 1 Sensor 1 / state IPOK" UWORD dez 1 100 0.00 65535.00 FORMAT "%8.2" ECU_ADDRESS 0x50001F2A /end MEASUREMENT
/begin MEASUREMENT UEGO_CJ135IPmpEvalS1B1_I.stUPmpCtrlCurr "Class instance of the functional class of FC UEGO_CJ135IPmpEval for Bank 1 Sensor 1 / indication for the current state of the UPmpCtrl request" UWORD dez 1 100 0.00 65535.00 FORMAT "%8.2" ECU_ADDRESS 0x50001F2C /end MEASUREMENT
/begin MEASUREMENT UEGO_CJ135IPmpEvalS1B1_I.tiSegPart "Class instance of the functional class of FC UEGO_CJ135IPmpEval for Bank 1 Sensor 1 / Time duration of quarter-segment" UWORD RBPtCel_ti_8p3333em5_1 1 100 0.00 5.461250 FORMAT "%8.6" ECU_ADDRESS 0x50001F2E /end MEASUREMENT
/begin MEASUREMENT UEGO_CJ135IPmpEvalS1B1_I.uGk "Class instance of the functional class of FC UEGO_CJ135IPmpEval for Bank 1 Sensor 1 / electrically corrected voltage ugk" SWORD spg_q3p2Em4_V 1 100 -10.48576 10.48544 FORMAT "%8.5" ECU_ADDRESS 0x50001F30 /end MEASUREMENT
/begin MEASUREMENT UEGO_CJ135IPmpEvalS1B1_I.uIpcal "Class instance of the functional class of FC UEGO_CJ135IPmpEval for Bank 1 Sensor 1 / electrically corrected voltage uipcal" SWORD spg_q3p2Em4_V 1 100 -10.48576 10.48544 FORMAT "%8.5" ECU_ADDRESS 0x50001F32 /end MEASUREMENT
/begin MEASUREMENT UEGO_CJ135IPmpEvalS1B1_I.uUlsf "Class instance of the functional class of FC UEGO_CJ135IPmpEval for Bank 1 Sensor 1 / Equivalent LSF voltage" SWORD spg_q3p2Em4_V 1 100 -10.48576 10.48544 FORMAT "%8.5" ARRAY_SIZE 15 ECU_ADDRESS 0x50001F34 /end MEASUREMENT
/begin MEASUREMENT UEGO_CJ135IPmpEvalS1B1_I.uUn0PacAvrgLst "Class instance of the functional class of FC UEGO_CJ135IPmpEval for Bank 1 Sensor 1 / nernsr cell voltage package average" SWORD spg_q3p2Em4_V 1 100 -10.48576 10.48544 FORMAT "%8.5" ECU_ADDRESS 0x50001F52 /end MEASUREMENT
/begin MEASUREMENT UEGO_CJ135IPmpEvalS1B1_I.uUn0PacFil "Class instance of the functional class of FC UEGO_CJ135IPmpEval for Bank 1 Sensor 1 / nernst cell voltage package filter" SWORD spg_q3p2Em4_V 1 100 -10.48576 10.48544 FORMAT "%8.5" ECU_ADDRESS 0x50001F54 /end MEASUREMENT
/begin MEASUREMENT UEGO_CJ135IPmpEvalS1B1_I.uUn0PacFilLst "Class instance of the functional class of FC UEGO_CJ135IPmpEval for Bank 1 Sensor 1 / nernst cell package voltage filtered second" SWORD spg_q3p2Em4_V 1 100 -10.48576 10.48544 FORMAT "%8.5" ECU_ADDRESS 0x50001F56 /end MEASUREMENT
/begin MEASUREMENT UEGO_CJ135IPmpEvalS1B1_I.uUp0Fild "Class instance of the functional class of FC UEGO_CJ135IPmpEval for Bank 1 Sensor 1 / Filtered Up0 value" SWORD spg_q3p2Em4_V 1 100 -10.48576 10.48544 FORMAT "%8.5" ARRAY_SIZE 15 ECU_ADDRESS 0x50001F58 /end MEASUREMENT
/begin MEASUREMENT UEGO_CJ135IPmpEvalS1B1_I.uUp0PacAvrg "Class instance of the functional class of FC UEGO_CJ135IPmpEval for Bank 1 Sensor 1 / pump cell voltage package average" SWORD spg_q3p2Em4_V 1 100 -10.48576 10.48544 FORMAT "%8.5" ECU_ADDRESS 0x50001F76 /end MEASUREMENT
/begin MEASUREMENT UEGO_CJ135IPmpEvalS1B1_I.uUp0PacAvrgPrev "Class instance of the functional class of FC UEGO_CJ135IPmpEval for Bank 1 Sensor 1 / pump cell voltage package previous average" SWORD spg_q3p2Em4_V 1 100 -10.48576 10.48544 FORMAT "%8.5" ECU_ADDRESS 0x50001F78 /end MEASUREMENT
/begin MEASUREMENT UEGO_CJ135IPmpEvalS1B1_I.uUp0SegSum "Class instance of the functional class of FC UEGO_CJ135IPmpEval for Bank 1 Sensor 1 / pump cell voltage sum" SLONG spg_q3p2Em4_V 1 100 -687194.767360 687194.767040 FORMAT "%13.6" ECU_ADDRESS 0x50001F7C /end MEASUREMENT
/begin MEASUREMENT UEGO_CJ135IPmpEvalS1B1_I.DsbcActvd1TOFFVNM_I.time "Class instance of the functional class of FC UEGO_CJ135IPmpEval for Bank 1 Sensor 1 / instance of turn off delay class / delay time" UWORD t_q0p005 1 100 0.00 327.6750 FORMAT "%8.4" ECU_ADDRESS 0x50001F80 /end MEASUREMENT
/begin MEASUREMENT UEGO_CJ135IPmpEvalS1B1_I.DsbcActvd4TOFFV_I.outbit "Class instance of the functional class of FC UEGO_CJ135IPmpEval for Bank 1 Sensor 1 / Turn Off delay for freezing the high dynamic pump current when reverse charge is active / Output Bit" UBYTE B_TRUE 1 100 0.00 1.00000000000 BIT_MASK 0x1 FORMAT "%13.11" ECU_ADDRESS 0x50001F82 /end MEASUREMENT
/begin MEASUREMENT UEGO_CJ135IPmpEvalS1B1_I.DsbcActvd4TOFFV_I.time "Class instance of the functional class of FC UEGO_CJ135IPmpEval for Bank 1 Sensor 1 / Turn Off delay for freezing the high dynamic pump current when reverse charge is active / Occured Time" UWORD t_q0p005 1 100 0.00 327.6750 FORMAT "%8.4" ECU_ADDRESS 0x50001F84 /end MEASUREMENT
/begin MEASUREMENT UEGO_CJ135IPmpEvalS1B1_I.FltuUgaZ1ElecCor_DL_I.memory "Class instance of the functional class of FC UEGO_CJ135IPmpEval for Bank 1 Sensor 1 / . / current lowpass value" SLONG spg_q4p883Em9_V 1 100 -10.4857600000 10.4857599951 FORMAT "%13.10" ECU_ADDRESS 0x50001F88 /end MEASUREMENT
/begin MEASUREMENT UEGO_CJ135IPmpEvalS1B1_I.FltuUgaZ2ElecCor_DL_I.memory "Class instance of the functional class of FC UEGO_CJ135IPmpEval for Bank 1 Sensor 1 / . / current lowpass value" SLONG spg_q4p883Em9_V 1 100 -10.4857600000 10.4857599951 FORMAT "%13.10" ECU_ADDRESS 0x50001F8C /end MEASUREMENT
/begin MEASUREMENT UEGO_CJ135IPmpEvalS1B1_I.FltuUgiZ1ElecCor_DL_I.memory "Class instance of the functional class of FC UEGO_CJ135IPmpEval for Bank 1 Sensor 1 / . / current lowpass value" SLONG spg_q4p883Em9_V 1 100 -10.4857600000 10.4857599951 FORMAT "%13.10" ECU_ADDRESS 0x50001F90 /end MEASUREMENT
/begin MEASUREMENT UEGO_CJ135IPmpEvalS1B1_I.FltuUgiZ2ElecCor_DL_I.memory "Class instance of the functional class of FC UEGO_CJ135IPmpEval for Bank 1 Sensor 1 / . / current lowpass value" SLONG spg_q4p883Em9_V 1 100 -10.4857600000 10.4857599951 FORMAT "%13.10" ECU_ADDRESS 0x50001F94 /end MEASUREMENT
/begin MEASUREMENT UEGO_CJ135IPmpEvalS1B1_I.IPmpCtrlActvnTONVNM_I.time "Class instance of the functional class of FC UEGO_CJ135IPmpEval for Bank 1 Sensor 1 / instance of Delay / Delay Time" UBYTE t_q0p005 1 100 0.00 1.275 FORMAT "%5.3" ECU_ADDRESS 0x50001F98 /end MEASUREMENT
/begin MEASUREMENT UEGO_CJ135IPmpEvalS1B1_I.IPmpCtrlBlcknOffTONVNM_I.time "Class instance of the functional class of FC UEGO_CJ135IPmpEval for Bank 1 Sensor 1 / instance of Delay / Delay Time" UBYTE t_q0p005 1 100 0.00 1.275 FORMAT "%5.3" ECU_ADDRESS 0x50001F99 /end MEASUREMENT
/begin MEASUREMENT UEGO_CJ135IPmpEvalS1B1_I.ModNotNormalERNM_I.oldSignal "Class instance of the functional class of FC UEGO_CJ135IPmpEval for Bank 1 Sensor 1 / instance of Delay / value of input signal last calculation" UBYTE B_TRUE 1 100 0.00 1.00000000000 BIT_MASK 0x1 FORMAT "%13.11" ECU_ADDRESS 0x50001F9A /end MEASUREMENT
/begin MEASUREMENT UEGO_CJ135IPmpEvalS1B1_I.RCmpFltDL_I.memory "Class instance of the functional class of FC UEGO_CJ135IPmpEval for Bank 1 Sensor 1 / filteri for calculation of plug resistor / current lowpass value" ULONG r_q1p5259Em6_Ohm 1 100 0.00 6553.59999847 FORMAT "%13.8" ECU_ADDRESS 0x50001F9C /end MEASUREMENT
/begin MEASUREMENT UEGO_CJ135IPmpEvalS1B1_I.RParlFltDL_I.memory "Class instance of the functional class of FC UEGO_CJ135IPmpEval for Bank 1 Sensor 1 / filter factor for calculation of plug resistor and paralel measuring resistor / current lowpass value" ULONG r_q1p5259Em6_Ohm 1 100 0.00 6553.59999847 FORMAT "%13.8" ECU_ADDRESS 0x50001FA0 /end MEASUREMENT
/begin MEASUREMENT UEGO_CJ135IPmpEvalS1B1_I.SteerpatChngdTOFFVNM_I.time "Class instance of the functional class of FC UEGO_CJ135IPmpEval for Bank 1 Sensor 1 / TurnOffDelayVariableNoMem SteerpatChngd / delay time" UWORD t_q0p005 1 100 0.00 327.6750 FORMAT "%8.4" ECU_ADDRESS 0x50001FA4 /end MEASUREMENT
/begin MEASUREMENT UEGO_CJ135IPmpEvalS1B1_I.TM2ROscnTONVNM_I.time "Class instance of the functional class of FC UEGO_CJ135IPmpEval for Bank 1 Sensor 1 / instance of Delay / Delay Time" UBYTE t_q0p005 1 100 0.00 1.275 FORMAT "%5.3" ECU_ADDRESS 0x50001FA6 /end MEASUREMENT
/begin MEASUREMENT UEGO_CJ135IPmpEvalS1B1_I.UBattRngVldTOFFVNM_I.time "Class instance of the functional class of FC UEGO_CJ135IPmpEval for Bank 1 Sensor 1 / Delay in order to account for unsuitable battery voltage / delay time" UWORD t_q0p005 1 100 0.00 327.6750 FORMAT "%8.4" ECU_ADDRESS 0x50001FA8 /end MEASUREMENT
/begin MEASUREMENT UEGO_CJ135IPmpEvalS1B1_I.UEGO_Cj135IPmp15VectDL_I.memory0 "Class instance of the functional class of FC UEGO_CJ135IPmpEval for Bank 1 Sensor 1 / Instance of Vector Filter / memory element of the vector filter" SLONG fak_q1p8329Em9 1 100 -3.93609609610 3.93609609426 FORMAT "%13.11" ECU_ADDRESS 0x50001FAC /end MEASUREMENT
/begin MEASUREMENT UEGO_CJ135IPmpEvalS1B1_I.UEGO_Cj135IPmp15VectDL_I.memory1 "Class instance of the functional class of FC UEGO_CJ135IPmpEval for Bank 1 Sensor 1 / Instance of Vector Filter / memory element of the vector filter" SLONG fak_q1p8329Em9 1 100 -3.93609609610 3.93609609426 FORMAT "%13.11" ECU_ADDRESS 0x50001FB0 /end MEASUREMENT
/begin MEASUREMENT UEGO_CJ135IPmpEvalS1B1_I.UEGO_Cj135IPmp15VectDL_I.memory10 "Class instance of the functional class of FC UEGO_CJ135IPmpEval for Bank 1 Sensor 1 / Instance of Vector Filter / memory element of the vector filter" SLONG fak_q1p8329Em9 1 100 -3.93609609610 3.93609609426 FORMAT "%13.11" ECU_ADDRESS 0x50001FB4 /end MEASUREMENT
/begin MEASUREMENT UEGO_CJ135IPmpEvalS1B1_I.UEGO_Cj135IPmp15VectDL_I.memory11 "Class instance of the functional class of FC UEGO_CJ135IPmpEval for Bank 1 Sensor 1 / Instance of Vector Filter / memory element of the vector filter" SLONG fak_q1p8329Em9 1 100 -3.93609609610 3.93609609426 FORMAT "%13.11" ECU_ADDRESS 0x50001FB8 /end MEASUREMENT
/begin MEASUREMENT UEGO_CJ135IPmpEvalS1B1_I.UEGO_Cj135IPmp15VectDL_I.memory12 "Class instance of the functional class of FC UEGO_CJ135IPmpEval for Bank 1 Sensor 1 / Instance of Vector Filter / memory element of the vector filter" SLONG fak_q1p8329Em9 1 100 -3.93609609610 3.93609609426 FORMAT "%13.11" ECU_ADDRESS 0x50001FBC /end MEASUREMENT
/begin MEASUREMENT UEGO_CJ135IPmpEvalS1B1_I.UEGO_Cj135IPmp15VectDL_I.memory13 "Class instance of the functional class of FC UEGO_CJ135IPmpEval for Bank 1 Sensor 1 / Instance of Vector Filter / memory element of the vector filter" SLONG fak_q1p8329Em9 1 100 -3.93609609610 3.93609609426 FORMAT "%13.11" ECU_ADDRESS 0x50001FC0 /end MEASUREMENT
/begin MEASUREMENT UEGO_CJ135IPmpEvalS1B1_I.UEGO_Cj135IPmp15VectDL_I.memory14 "Class instance of the functional class of FC UEGO_CJ135IPmpEval for Bank 1 Sensor 1 / Instance of Vector Filter / memory element of the vector filter" SLONG fak_q1p8329Em9 1 100 -3.93609609610 3.93609609426 FORMAT "%13.11" ECU_ADDRESS 0x50001FC4 /end MEASUREMENT
/begin MEASUREMENT UEGO_CJ135IPmpEvalS1B1_I.UEGO_Cj135IPmp15VectDL_I.memory2 "Class instance of the functional class of FC UEGO_CJ135IPmpEval for Bank 1 Sensor 1 / Instance of Vector Filter / memory element of the vector filter" SLONG fak_q1p8329Em9 1 100 -3.93609609610 3.93609609426 FORMAT "%13.11" ECU_ADDRESS 0x50001FC8 /end MEASUREMENT
/begin MEASUREMENT UEGO_CJ135IPmpEvalS1B1_I.UEGO_Cj135IPmp15VectDL_I.memory3 "Class instance of the functional class of FC UEGO_CJ135IPmpEval for Bank 1 Sensor 1 / Instance of Vector Filter / memory element of the vector filter" SLONG fak_q1p8329Em9 1 100 -3.93609609610 3.93609609426 FORMAT "%13.11" ECU_ADDRESS 0x50001FCC /end MEASUREMENT
/begin MEASUREMENT UEGO_CJ135IPmpEvalS1B1_I.UEGO_Cj135IPmp15VectDL_I.memory4 "Class instance of the functional class of FC UEGO_CJ135IPmpEval for Bank 1 Sensor 1 / Instance of Vector Filter / memory element of the vector filter" SLONG fak_q1p8329Em9 1 100 -3.93609609610 3.93609609426 FORMAT "%13.11" ECU_ADDRESS 0x50001FD0 /end MEASUREMENT
/begin MEASUREMENT UEGO_CJ135IPmpEvalS1B1_I.UEGO_Cj135IPmp15VectDL_I.memory5 "Class instance of the functional class of FC UEGO_CJ135IPmpEval for Bank 1 Sensor 1 / Instance of Vector Filter / memory element of the vector filter" SLONG fak_q1p8329Em9 1 100 -3.93609609610 3.93609609426 FORMAT "%13.11" ECU_ADDRESS 0x50001FD4 /end MEASUREMENT
/begin MEASUREMENT UEGO_CJ135IPmpEvalS1B1_I.UEGO_Cj135IPmp15VectDL_I.memory6 "Class instance of the functional class of FC UEGO_CJ135IPmpEval for Bank 1 Sensor 1 / Instance of Vector Filter / memory element of the vector filter" SLONG fak_q1p8329Em9 1 100 -3.93609609610 3.93609609426 FORMAT "%13.11" ECU_ADDRESS 0x50001FD8 /end MEASUREMENT
/begin MEASUREMENT UEGO_CJ135IPmpEvalS1B1_I.UEGO_Cj135IPmp15VectDL_I.memory7 "Class instance of the functional class of FC UEGO_CJ135IPmpEval for Bank 1 Sensor 1 / Instance of Vector Filter / memory element of the vector filter" SLONG fak_q1p8329Em9 1 100 -3.93609609610 3.93609609426 FORMAT "%13.11" ECU_ADDRESS 0x50001FDC /end MEASUREMENT
/begin MEASUREMENT UEGO_CJ135IPmpEvalS1B1_I.UEGO_Cj135IPmp15VectDL_I.memory8 "Class instance of the functional class of FC UEGO_CJ135IPmpEval for Bank 1 Sensor 1 / Instance of Vector Filter / memory element of the vector filter" SLONG fak_q1p8329Em9 1 100 -3.93609609610 3.93609609426 FORMAT "%13.11" ECU_ADDRESS 0x50001FE0 /end MEASUREMENT
/begin MEASUREMENT UEGO_CJ135IPmpEvalS1B1_I.UEGO_Cj135IPmp15VectDL_I.memory9 "Class instance of the functional class of FC UEGO_CJ135IPmpEval for Bank 1 Sensor 1 / Instance of Vector Filter / memory element of the vector filter" SLONG fak_q1p8329Em9 1 100 -3.93609609610 3.93609609426 FORMAT "%13.11" ECU_ADDRESS 0x50001FE4 /end MEASUREMENT
/begin MEASUREMENT UEGO_CJ135IPmpEvalS1B1_I.flgIPmpVldTOFFVNM_I.time "Class instance of the functional class of FC UEGO_CJ135IPmpEval for Bank 1 Sensor 1 / . / delay time" UWORD t_q0p005 1 100 0.00 327.6750 FORMAT "%8.4" ECU_ADDRESS 0x50001FE8 /end MEASUREMENT
/begin MEASUREMENT UEGO_CJ135IPmpEvalS1B1_I.flgIPmpVldTONVNM_I.time "Class instance of the functional class of FC UEGO_CJ135IPmpEval for Bank 1 Sensor 1 / . / Delay Time" UWORD t_q0p005 1 100 0.00 327.6750 FORMAT "%8.4" ECU_ADDRESS 0x50001FEA /end MEASUREMENT
/begin MEASUREMENT UEGO_CJ135IPmpEvalS1B1_I.iIPmpRawAvrg_DL_I.memory "Class instance of the functional class of FC UEGO_CJ135IPmpEval for Bank 1 Sensor 1 / . / current lowpass value" SLONG dez 1 100 -2147483648.00 2147483647.00 FORMAT "%13.2" ECU_ADDRESS 0x50001FEC /end MEASUREMENT
/begin MEASUREMENT UEGO_CJ135IPmpEvalS1B1_I.iIPmpSegAvrgWoCrvCorrn_DL_I.memory "Class instance of the functional class of FC UEGO_CJ135IPmpEval for Bank 1 Sensor 1 / . / current lowpass value" SLONG dez 1 100 -2147483648.00 2147483647.00 FORMAT "%13.2" ECU_ADDRESS 0x50001FF0 /end MEASUREMENT
/begin MEASUREMENT UEGO_CJ135IPmpEvalS1B1_I.iIPmpSegAvrg_DL_I.memory "Class instance of the functional class of FC UEGO_CJ135IPmpEval for Bank 1 Sensor 1 / . / current lowpass value" SLONG dez 1 100 -2147483648.00 2147483647.00 FORMAT "%13.2" ECU_ADDRESS 0x50001FF4 /end MEASUREMENT
/begin MEASUREMENT UEGO_CJ135IPmpEvalS1B1_I.uUp0RawFlt_DL_I.memory "Class instance of the functional class of FC UEGO_CJ135IPmpEval for Bank 1 Sensor 1 / . / current lowpass value" SLONG spg_q4p883Em9_V 1 100 -10.4857600000 10.4857599951 FORMAT "%13.10" ECU_ADDRESS 0x50001FF8 /end MEASUREMENT
/begin MEASUREMENT UEGO_CJ135IPmpEvalS1B1_I.uUp0Z0Flt_DL_I.memory "Class instance of the functional class of FC UEGO_CJ135IPmpEval for Bank 1 Sensor 1 / . / current lowpass value" SLONG spg_q4p883Em9_V 1 100 -10.4857600000 10.4857599951 FORMAT "%13.10" ECU_ADDRESS 0x50001FFC /end MEASUREMENT
/begin MEASUREMENT UEGO_CJ135IPmpEvalS1B1_I.uUp0Z1Flt_DL_I.memory "Class instance of the functional class of FC UEGO_CJ135IPmpEval for Bank 1 Sensor 1 / . / current lowpass value" SLONG spg_q4p883Em9_V 1 100 -10.4857600000 10.4857599951 FORMAT "%13.10" ECU_ADDRESS 0x50002000 /end MEASUREMENT
/begin MEASUREMENT UEGO_CJ135IPmpEvalS1B1_I.uUp0Z2Flt_DL_I.memory "Class instance of the functional class of FC UEGO_CJ135IPmpEval for Bank 1 Sensor 1 / . / current lowpass value" SLONG spg_q4p883Em9_V 1 100 -10.4857600000 10.4857599951 FORMAT "%13.10" ECU_ADDRESS 0x50002004 /end MEASUREMENT
/begin MEASUREMENT UEGO_cntrCj135DiagReiniProc10msec "Counter of driving cycles" UBYTE OneToOne 1 100 0.00 255.0 FORMAT "%5.1" ECU_ADDRESS 0x60006229 /end MEASUREMENT
/begin MEASUREMENT UEGO_cntrCj135DiagSnsrReiniProc10msec "Drive cycle counter that increments when system state exits Post-drive" UBYTE dez 1 100 0.00 255.0 FORMAT "%5.1" ECU_ADDRESS 0x60006228 /end MEASUREMENT
/begin MEASUREMENT UEGO_cntrCJ135DiagWireReiniProc10msec "drive cycle counter which is assigned as per SyC_PostDrive is left" UBYTE OneToOne 1 100 0.00 255.0 FORMAT "%5.1" ECU_ADDRESS 0x60006227 /end MEASUREMENT
/begin MEASUREMENT UEGO_cntrIPmpLimdPckS1B1 "number of limited ip values lime in a package of sensor 1 bank 1" UBYTE dez 1 100 0.00 255.0 FORMAT "%5.1" ECU_ADDRESS 0x6000A2CE /end MEASUREMENT
/begin MEASUREMENT UEGO_cntrModVrfdS1B1 "Counter of verifications of the actual mode of the ASIC for sensor 1 bank 1" UBYTE dez 1 100 0.00 255.0 FORMAT "%5.1" ECU_ADDRESS 0x6000A2CD /end MEASUREMENT
/begin MEASUREMENT UEGO_flgChpInIdleS1B1 "Displays the current IDLE-state of the CJ135 of UEGO sensor 1 Bank 1" UBYTE B_TRUE 1 100 0.00 1.00000000000 BIT_MASK 0x1 FORMAT "%13.11" ECU_ADDRESS 0x700000D5 /end MEASUREMENT
/begin MEASUREMENT UEGO_flgCj135DiagEcuErrPndS1B1 "Error hint at ECU diagnosis of the ASIC of sensor 1 bank 1" UBYTE B_TRUE 1 100 0.00 1.00000000000 BIT_MASK 0x1 FORMAT "%13.11" ECU_ADDRESS 0x70000630 /end MEASUREMENT
/begin MEASUREMENT UEGO_flgCj135DiagExtRstReq "External Reset Request" UBYTE B_TRUE 1 100 0.00 1.00000000000 BIT_MASK 0x1 FORMAT "%13.11" ECU_ADDRESS 0x700000D4 /end MEASUREMENT
/begin MEASUREMENT UEGO_flgCJ135DiagSnsrExtRstReq "External reset request flag" UBYTE B_TRUE 1 100 0.00 1.00000000000 BIT_MASK 0x1 FORMAT "%13.11" ECU_ADDRESS 0x700000D2 /end MEASUREMENT
/begin MEASUREMENT UEGO_flgCJ135DiagWireErrPndS1B1 "Error hint at cable diagnosis of sensor 1 bank 1" UBYTE B_TRUE 1 100 0.00 1.00000000000 BIT_MASK 0x1 FORMAT "%13.11" ECU_ADDRESS 0x70000632 /end MEASUREMENT
/begin MEASUREMENT UEGO_flgCJ135DiagWireExtRstReq "External reset request whenever SyC_PostDrive gets incrimented" UBYTE B_TRUE 1 100 0.00 1.00000000000 BIT_MASK 0x1 FORMAT "%13.11" ECU_ADDRESS 0x6000A110 /end MEASUREMENT
/begin MEASUREMENT UEGO_flgCmnIrqErrVld "Validity of IRQ diagnosis information" UBYTE B_TRUE 1 100 0.00 1.00000000000 BIT_MASK 0x1 FORMAT "%13.11" ECU_ADDRESS 0x7000062C /end MEASUREMENT
/begin MEASUREMENT UEGO_flgEcuDataRstReqS1B1 "Reset request within UEGO of the data concerning the ECU of the ASIC of sensor 1 bank 1" UBYTE B_TRUE 1 100 0.00 1.00000000000 BIT_MASK 0x1 FORMAT "%13.11" ECU_ADDRESS 0x70000627 /end MEASUREMENT
/begin MEASUREMENT UEGO_flgErrInfoAsicVldS1B1 "Validity of the diagnosis register of the ASIC of sensor 1 bank 1" UBYTE B_TRUE 1 100 0.00 1.00000000000 BIT_MASK 0x1 FORMAT "%13.11" ECU_ADDRESS 0x7000061E /end MEASUREMENT
/begin MEASUREMENT UEGO_flgErrInfoMcuVldS1B1 "Validity of the BSW diagnostics within the microcontroller for the asic controlling sensor 1 bank 1" UBYTE B_TRUE 1 100 0.00 1.00000000000 BIT_MASK 0x1 FORMAT "%13.11" ECU_ADDRESS 0x7000061D /end MEASUREMENT
/begin MEASUREMENT UEGO_flgErrSpiDiagS1B1 "SPI error during transmitting the diagnosis register of the ASIC of sensor 1 bank 1" UBYTE B_TRUE 1 100 0.00 1.00000000000 BIT_MASK 0x1 FORMAT "%13.11" ECU_ADDRESS 0x7000061C /end MEASUREMENT
/begin MEASUREMENT UEGO_flgErrSpiRamBnk10msS1B1 "SPI error of the RAM bank (detected in 10ms raster) of the ASIC of sensor 1 bank 1" UBYTE B_TRUE 1 100 0.00 1.00000000000 BIT_MASK 0x1 FORMAT "%13.11" ECU_ADDRESS 0x7000061B /end MEASUREMENT
/begin MEASUREMENT UEGO_flgErrSpiRegBnkS1B1 "SPI error during transmitting the register information of the ASIC of sensor 1 bank 1" UBYTE B_TRUE 1 100 0.00 1.00000000000 BIT_MASK 0x1 FORMAT "%13.11" ECU_ADDRESS 0x700000D3 /end MEASUREMENT
/begin MEASUREMENT UEGO_flgIPmpEvlnVldS1B1 "Condition evaluation measured values pump current valid sensor 1 bank 1" UBYTE B_TRUE 1 100 0.00 1.00000000000 BIT_MASK 0x1 FORMAT "%13.11" ECU_ADDRESS 0x70000608 /end MEASUREMENT
/begin MEASUREMENT UEGO_flgIsqrStrtdS1B1 "Display to start the Isqr filtering for UEGO sensor 1 Bank 1" UBYTE B_TRUE 1 100 0.00 1.00000000000 BIT_MASK 0x1 FORMAT "%13.11" ECU_ADDRESS 0x70000604 /end MEASUREMENT
/begin MEASUREMENT UEGO_flgIsqrVldS1B1 "Display for the validity of Isqr for UEGO sensor 1 Bank 1" UBYTE B_TRUE 1 100 0.00 1.00000000000 BIT_MASK 0x1 FORMAT "%13.11" ECU_ADDRESS 0x70000603 /end MEASUREMENT
/begin MEASUREMENT UEGO_flgIsqStrtdS1B1 "Display to start the Isq filtering for UEGO sensor 1 Bank 1" UBYTE B_TRUE 1 100 0.00 1.00000000000 BIT_MASK 0x1 FORMAT "%13.11" ECU_ADDRESS 0x70000605 /end MEASUREMENT
/begin MEASUREMENT UEGO_flgLockdAsicS1B1 "Locked state due to the ASIC diagnosis of sensor 1 bank 1" UBYTE B_TRUE 1 100 0.00 1.00000000000 BIT_MASK 0x1 FORMAT "%13.11" ECU_ADDRESS 0x70000601 /end MEASUREMENT
/begin MEASUREMENT UEGO_flgLockdSnsrS1B1 "UEGO Signal Sensor Lock sensor 1 bank 1" UBYTE B_TRUE 1 100 0.00 1.00000000000 BIT_MASK 0x1 FORMAT "%13.11" ECU_ADDRESS 0x70000600 /end MEASUREMENT
/begin MEASUREMENT UEGO_flgLockdSpiS1B1 "Locked state due to the SPI diagnosis of sensor 1 bank 1" UBYTE B_TRUE 1 100 0.00 1.00000000000 BIT_MASK 0x1 FORMAT "%13.11" ECU_ADDRESS 0x700005FF /end MEASUREMENT
/begin MEASUREMENT UEGO_flgNewIPmpOKS1B1 "Validity condition IPOK sensor 1 bank 1" UBYTE B_TRUE 1 100 0.00 1.00000000000 BIT_MASK 0x1 FORMAT "%13.11" ECU_ADDRESS 0x700005F9 /end MEASUREMENT
/begin MEASUREMENT UEGO_flgNewIPmpPckAryS1B1 "Validity condition for new IP sensor 1 bank 1" UBYTE B_TRUE 1 100 0.00 1.00000000000 BIT_MASK 0x1 FORMAT "%13.11" ECU_ADDRESS 0x700005F8 /end MEASUREMENT
/begin MEASUREMENT UEGO_flgNewIPmpTMS1B1 "Validity condition for register IPTM sensor 1 bank 1" UBYTE B_TRUE 1 100 0.00 1.00000000000 BIT_MASK 0x1 FORMAT "%13.11" ECU_ADDRESS 0x700005F6 /end MEASUREMENT
/begin MEASUREMENT UEGO_flgNewTiPckS1B1 "Validity condition Time stamp UEGO sensor 1 bank 1" UBYTE B_TRUE 1 100 0.00 1.00000000000 BIT_MASK 0x1 FORMAT "%13.11" ECU_ADDRESS 0x700005F1 /end MEASUREMENT
/begin MEASUREMENT UEGO_flgNewUa2PckAryS1B1 "Validity condition for new Ua2 sensor 1 bank 1" UBYTE B_TRUE 1 100 0.00 1.00000000000 BIT_MASK 0x1 FORMAT "%13.11" ECU_ADDRESS 0x700005F0 /end MEASUREMENT
/begin MEASUREMENT UEGO_flgNewUa31PckS1B1 "Validity condition for new Ua31 sensor 1 bank 1" UBYTE B_TRUE 1 100 0.00 1.00000000000 BIT_MASK 0x1 FORMAT "%13.11" ECU_ADDRESS 0x700005EF /end MEASUREMENT
/begin MEASUREMENT UEGO_flgNewUa32PckS1B1 "Validity condition for new Ua32 sensor 1 bank 1" UBYTE B_TRUE 1 100 0.00 1.00000000000 BIT_MASK 0x1 FORMAT "%13.11" ECU_ADDRESS 0x700005EE /end MEASUREMENT
/begin MEASUREMENT UEGO_flgNewUa33PckS1B1 "Validity condition for new Ua33 sensor 1 bank 1" UBYTE B_TRUE 1 100 0.00 1.00000000000 BIT_MASK 0x1 FORMAT "%13.11" ECU_ADDRESS 0x700005ED /end MEASUREMENT
/begin MEASUREMENT UEGO_flgNewUapePckS1B1 "Validity condition for new Uape sensor 1 bank 1" UBYTE B_TRUE 1 100 0.00 1.00000000000 BIT_MASK 0x1 FORMAT "%13.11" ECU_ADDRESS 0x700005EC /end MEASUREMENT
/begin MEASUREMENT UEGO_flgNewUg0PckS1B1 "Validity condition for new Ug0 sensor 1 bank 1" UBYTE B_TRUE 1 100 0.00 1.00000000000 BIT_MASK 0x1 FORMAT "%13.11" ECU_ADDRESS 0x700005EB /end MEASUREMENT
/begin MEASUREMENT UEGO_flgNewUgaPckAryS1B1 "Validity condition for new Uga sensor 1 bank 1" UBYTE B_TRUE 1 100 0.00 1.00000000000 BIT_MASK 0x1 FORMAT "%13.11" ECU_ADDRESS 0x700005EA /end MEASUREMENT
/begin MEASUREMENT UEGO_flgNewUgiPckAryS1B1 "Validity condition for new Ugi sensor 1 bank 1" UBYTE B_TRUE 1 100 0.00 1.00000000000 BIT_MASK 0x1 FORMAT "%13.11" ECU_ADDRESS 0x700005E9 /end MEASUREMENT
/begin MEASUREMENT UEGO_flgNewUgkAvrgPckS1B1 "Validity condition for new Ugk sensor 1 bank 1" UBYTE B_TRUE 1 100 0.00 1.00000000000 BIT_MASK 0x1 FORMAT "%13.11" ECU_ADDRESS 0x700005E8 /end MEASUREMENT
/begin MEASUREMENT UEGO_flgNewUguaPckS1B1 "Validity condition for new Ugua sensor 1 bank 1" UBYTE B_TRUE 1 100 0.00 1.00000000000 BIT_MASK 0x1 FORMAT "%13.11" ECU_ADDRESS 0x700005E7 /end MEASUREMENT
/begin MEASUREMENT UEGO_flgNewUguaZ2PckS1B1 "Validity condition for new Ugua sensor 1 bank 1" UBYTE B_TRUE 1 100 0.00 1.00000000000 BIT_MASK 0x1 FORMAT "%13.11" ECU_ADDRESS 0x700005E6 /end MEASUREMENT
/begin MEASUREMENT UEGO_flgNewUguiPckS1B1 "Validity condition for new Ugui sensor 1 bank 1" UBYTE B_TRUE 1 100 0.00 1.00000000000 BIT_MASK 0x1 FORMAT "%13.11" ECU_ADDRESS 0x700005E5 /end MEASUREMENT
/begin MEASUREMENT UEGO_flgNewUguiZ1PckS1B1 "Validity condition for new Ugui sensor 1 bank 1" UBYTE B_TRUE 1 100 0.00 1.00000000000 BIT_MASK 0x1 FORMAT "%13.11" ECU_ADDRESS 0x700005E4 /end MEASUREMENT
/begin MEASUREMENT UEGO_flgNewUi21PckAryS1B1 "Validity condition for new Ui21 sensor 1 bank 1" UBYTE B_TRUE 1 100 0.00 1.00000000000 BIT_MASK 0x1 FORMAT "%13.11" ECU_ADDRESS 0x700005E3 /end MEASUREMENT
/begin MEASUREMENT UEGO_flgNewUi22PckS1B1 "Validity condition for new Ui22 sensor 1 bank 1" UBYTE B_TRUE 1 100 0.00 1.00000000000 BIT_MASK 0x1 FORMAT "%13.11" ECU_ADDRESS 0x700005E2 /end MEASUREMENT
/begin MEASUREMENT UEGO_flgNewUi23PckS1B1 "Validity condition for new Ui23 sensor 1 bank 1" UBYTE B_TRUE 1 100 0.00 1.00000000000 BIT_MASK 0x1 FORMAT "%13.11" ECU_ADDRESS 0x700005E1 /end MEASUREMENT
/begin MEASUREMENT UEGO_flgNewUi24PckS1B1 "Validity condition for new Ui24 sensor 1 bank 1" UBYTE B_TRUE 1 100 0.00 1.00000000000 BIT_MASK 0x1 FORMAT "%13.11" ECU_ADDRESS 0x700005E0 /end MEASUREMENT
/begin MEASUREMENT UEGO_flgNewUi4PckS1B1 "Validity condition for new Ui4 sensor 1 bank 1" UBYTE B_TRUE 1 100 0.00 1.00000000000 BIT_MASK 0x1 FORMAT "%13.11" ECU_ADDRESS 0x700005DF /end MEASUREMENT
/begin MEASUREMENT UEGO_flgNewUi4Z2PckS1B1 "Validity condition for new Ui4 sensor 1 bank 1" UBYTE B_TRUE 1 100 0.00 1.00000000000 BIT_MASK 0x1 FORMAT "%13.11" ECU_ADDRESS 0x700005DE /end MEASUREMENT
/begin MEASUREMENT UEGO_flgNewUlpcalAvrgPckS1B1 "Validity condition for new UIpcal sensor 1 bank 1" UBYTE B_TRUE 1 100 0.00 1.00000000000 BIT_MASK 0x1 FORMAT "%13.11" ECU_ADDRESS 0x700005DD /end MEASUREMENT
/begin MEASUREMENT UEGO_flgNewUn0PckAryS1B1 "Validity condition for new Un0 sensor 1 bank 1" UBYTE B_TRUE 1 100 0.00 1.00000000000 BIT_MASK 0x1 FORMAT "%13.11" ECU_ADDRESS 0x700005DC /end MEASUREMENT
/begin MEASUREMENT UEGO_flgNewUnSetPckS1B1 "Validity condition for new UnSet sensor 1 bank 1" UBYTE B_TRUE 1 100 0.00 1.00000000000 BIT_MASK 0x1 FORMAT "%13.11" ECU_ADDRESS 0x700005DB /end MEASUREMENT
/begin MEASUREMENT UEGO_flgNewUp0PckAryS1B1 "Validity condition for new Up0 sensor 1 bank 1" UBYTE B_TRUE 1 100 0.00 1.00000000000 BIT_MASK 0x1 FORMAT "%13.11" ECU_ADDRESS 0x700005DA /end MEASUREMENT
/begin MEASUREMENT UEGO_flgNewUpPckAryS1B1 "Validity condition for new Up sensor 1 bank 1" UBYTE B_TRUE 1 100 0.00 1.00000000000 BIT_MASK 0x1 FORMAT "%13.11" ECU_ADDRESS 0x700005D9 /end MEASUREMENT
/begin MEASUREMENT UEGO_flgNewUriaPckS1B1 "Validity condition for new Uria sensor 1 bank 1" UBYTE B_TRUE 1 100 0.00 1.00000000000 BIT_MASK 0x1 FORMAT "%13.11" ECU_ADDRESS 0x700005D8 /end MEASUREMENT
/begin MEASUREMENT UEGO_flgNewUriePckAryS1B1 "Validity condition for new Urie sensor 1 bank 1" UBYTE B_TRUE 1 100 0.00 1.00000000000 BIT_MASK 0x1 FORMAT "%13.11" ECU_ADDRESS 0x700005D7 /end MEASUREMENT
/begin MEASUREMENT UEGO_flgRCmpVldS1B1 "Flag shows that calculated value of Rcmp for Sensor1 Bank1 is valid" UBYTE B_TRUE 1 100 0.00 1.00000000000 BIT_MASK 0x1 FORMAT "%13.11" ECU_ADDRESS 0x700005D1 /end MEASUREMENT
/begin MEASUREMENT UEGO_flgRParlVldS1B1 "Flag shows that calculated value of Rparl for Sensor1 Bank1 is valid" UBYTE B_TRUE 1 100 0.00 1.00000000000 BIT_MASK 0x1 FORMAT "%13.11" ECU_ADDRESS 0x700005D0 /end MEASUREMENT
/begin MEASUREMENT UEGO_flgRvsChrgMeasActvS1B1 "reverse charge measuring active flag for sensor1 bank1" UBYTE B_TRUE 1 100 0.00 1.00000000000 BIT_MASK 0x1 FORMAT "%13.11" ECU_ADDRESS 0x700005C1 /end MEASUREMENT
/begin MEASUREMENT UEGO_flgSnsrDataRstReqS1B1 "Reset request within UEGO of the data concerning the sensor element of sensor 1 bank 1" UBYTE B_TRUE 1 100 0.00 1.00000000000 BIT_MASK 0x1 FORMAT "%13.11" ECU_ADDRESS 0x700005C0 /end MEASUREMENT
/begin MEASUREMENT UEGO_flgUoffipe1Z1StrtdS1B1 "Uoffipe1Z1 condition exists, Bank 1 Sensor 1" UBYTE B_TRUE 1 100 0.00 1.00000000000 BIT_MASK 0x1 FORMAT "%13.11" ECU_ADDRESS 0x700005A7 /end MEASUREMENT
/begin MEASUREMENT UEGO_flgUoffipe1Z2StrtdS1B1 "Uoffipe1Z2 condition exists, Bank 1 Sensor 1" UBYTE B_TRUE 1 100 0.00 1.00000000000 BIT_MASK 0x1 FORMAT "%13.11" ECU_ADDRESS 0x700005A6 /end MEASUREMENT
/begin MEASUREMENT UEGO_flgUoffipe2Z1StrtdS1B1 "Uoffipe2Z1 condition exists, Bank 1 Sensor 1" UBYTE B_TRUE 1 100 0.00 1.00000000000 BIT_MASK 0x1 FORMAT "%13.11" ECU_ADDRESS 0x700005A5 /end MEASUREMENT
/begin MEASUREMENT UEGO_flgUoffipe2Z2StrtdS1B1 "Uoffipe2Z2 condition exists, Bank 1 Sensor 1" UBYTE B_TRUE 1 100 0.00 1.00000000000 BIT_MASK 0x1 FORMAT "%13.11" ECU_ADDRESS 0x700005A4 /end MEASUREMENT
/begin MEASUREMENT UEGO_flgUoffvcc1StrtdS1B1 "condition uoffvcc1 is available sensor 1 bank 1" UBYTE B_TRUE 1 100 0.00 1.00000000000 BIT_MASK 0x1 FORMAT "%13.11" ECU_ADDRESS 0x700005A3 /end MEASUREMENT
/begin MEASUREMENT UEGO_flgUoffvcc2StrtdS1B1 "condition uoffvcc2 is available sensor 1 bank 1" UBYTE B_TRUE 1 100 0.00 1.00000000000 BIT_MASK 0x1 FORMAT "%13.11" ECU_ADDRESS 0x700005A2 /end MEASUREMENT
/begin MEASUREMENT UEGO_flgUoffvcc3StrtdS1B1 "condition uoffvcc3 is available sensor 1 bank 1" UBYTE B_TRUE 1 100 0.00 1.00000000000 BIT_MASK 0x1 FORMAT "%13.11" ECU_ADDRESS 0x700005A1 /end MEASUREMENT
/begin MEASUREMENT UEGO_flgUoffvcci2StrtdS1B1 "condition uoffvcci2 is available sensor 1 bank 1" UBYTE B_TRUE 1 100 0.00 1.00000000000 BIT_MASK 0x1 FORMAT "%13.11" ECU_ADDRESS 0x700005A0 /end MEASUREMENT
/begin MEASUREMENT UEGO_flgWireDataRstReqS1B1 "Request to reset measurement data for wire diagnosis of sensor 1 bank 1" UBYTE B_TRUE 1 100 0.00 1.00000000000 BIT_MASK 0x1 FORMAT "%13.11" ECU_ADDRESS 0x7000059F /end MEASUREMENT
/begin MEASUREMENT UEGO_iIPmpBoostdS1B1 "boosted pump current sensor1 bank1" SWORD i_q6p6667Em7_A 1 100 -0.02184533 0.02184467 FORMAT "%10.8" ECU_ADDRESS 0x70002CA2 /end MEASUREMENT
/begin MEASUREMENT UEGO_iIPmpCircAryS1B1 "Pump current ring buffer sensor 1 bank 1" SWORD i_q6p6667Em7_A 1 100 -0.02184533 0.02184467 FORMAT "%10.8" ARRAY_SIZE 30 ECU_ADDRESS 0x50005B26 /end MEASUREMENT
/begin MEASUREMENT UEGO_iIPmpElecCorrdAryS1B1 "Array electrically corrected pump current sensor 1 bank 1" SWORD i_q6p6667Em7_A 1 100 -0.02184533 0.02184467 FORMAT "%10.8" ARRAY_SIZE 15 ECU_ADDRESS 0x50005B62 /end MEASUREMENT
/begin MEASUREMENT UEGO_iIPmpElecCorrdS1B1 "electrically corrected pump current sensor 1 bank 1" SWORD i_q6p6667Em7_A 1 100 -0.02184533 0.02184467 FORMAT "%10.8" ECU_ADDRESS 0x60004EAA /end MEASUREMENT
/begin MEASUREMENT UEGO_iIPmpPacAryS1B1 "Array for package pump current values of sensor 1 bank 1" SWORD i_q6p6667Em7_A 1 100 -0.02184533 0.02184467 FORMAT "%10.8" ARRAY_SIZE 15 ECU_ADDRESS 0x50005B80 /end MEASUREMENT
/begin MEASUREMENT UEGO_iIPmpPacAvrgS1B1 "UEGO package mean value of pump current for S1B1" SWORD i_q6p6667Em7_A 1 100 -0.02184533 0.02184467 FORMAT "%10.8" ECU_ADDRESS 0x60004EA8 /end MEASUREMENT
/begin MEASUREMENT UEGO_iIPmpRawLstS1B1 "measured Ip-raw value sensor 1 bank1" SWORD i_q6p6667Em7_A 1 100 -0.02184533 0.02184467 FORMAT "%10.8" ECU_ADDRESS 0x70002CA8 /end MEASUREMENT
/begin MEASUREMENT UEGO_iIPmpSegWoCrvS1B1 "segment synchronously averaged pump current value without correction by the plug resistance for UEGO sensor 1 Bank 1" SWORD i_q6p6667Em7_A 1 100 -0.02184533 0.02184467 FORMAT "%10.8" ECU_ADDRESS 0x70002CAA /end MEASUREMENT
/begin MEASUREMENT UEGO_iIPmpSmotngElecCorrdS1B1 "smothed electrical corrected pump current for S1B1" SWORD i_q6p6667Em7_A 1 100 -0.02184533 0.02184467 FORMAT "%10.8" ECU_ADDRESS 0x70002CAC /end MEASUREMENT
/begin MEASUREMENT UEGO_iIsqMeasS1B1 "measured pump current source sensor 1 bank 1" SWORD i_q6p6667Em7_A 1 100 -0.02184533 0.02184467 FORMAT "%10.8" ECU_ADDRESS 0x60004EA4 /end MEASUREMENT
/begin MEASUREMENT UEGO_iIsqrMeasS1B1 "measured reference pump current source sensor 1 bank 1" SWORD i_q6p667Em8_A 1 100 -0.002184533 0.002184467 FORMAT "%11.9" ECU_ADDRESS 0x60004EA0 /end MEASUREMENT
/begin MEASUREMENT UEGO_numIpPckAryS1B1 "Number of IP per measurement package sensor 1 bank 1" UBYTE dez 1 100 0.00 255.0 FORMAT "%5.1" ECU_ADDRESS 0x70002DAA /end MEASUREMENT
/begin MEASUREMENT UEGO_numModCtrlS1B1 "UEGO Signal ASIC mode request of sensor 1 bank 1" UBYTE dez 1 100 0.00 255.0 FORMAT "%5.1" ECU_ADDRESS 0x6000A2C9 /end MEASUREMENT
/begin MEASUREMENT UEGO_numModCurrS1B1 "Current mode of the ASIC of sensor 1 bank 1" UBYTE dez 1 100 0.00 255.0 FORMAT "%5.1" ECU_ADDRESS 0x6000A2C8 /end MEASUREMENT
/begin MEASUREMENT UEGO_numPacBlcknS1B1 "Number of IP-cycles with Blackening protection in a 10ms packet for UEGO sensor 1 Bank 1" UBYTE dez 1 100 0.00 255.0 FORMAT "%5.1" ECU_ADDRESS 0x70002DAB /end MEASUREMENT
/begin MEASUREMENT UEGO_numUa2PckAryS1B1 "Number of Ua2 per measurement package sensor 1 bank 1" UBYTE dez 1 100 0.00 255.0 FORMAT "%5.1" ECU_ADDRESS 0x6000A2C3 /end MEASUREMENT
/begin MEASUREMENT UEGO_numUgaPckAryS1B1 "Number of Uga per measurement package sensor 1 bank 1" UBYTE dez 1 100 0.00 255.0 FORMAT "%5.1" ECU_ADDRESS 0x6000A2C2 /end MEASUREMENT
/begin MEASUREMENT UEGO_numUgiPckAryS1B1 "Number of Ugi per measurement package sensor 1 bank 1" UBYTE dez 1 100 0.00 255.0 FORMAT "%5.1" ECU_ADDRESS 0x6000A2C1 /end MEASUREMENT
/begin MEASUREMENT UEGO_numUi21PckAryS1B1 "Number of Ui21 per measurement package sensor 1 bank 1" UBYTE dez 1 100 0.00 255.0 FORMAT "%5.1" ECU_ADDRESS 0x6000A2C0 /end MEASUREMENT
/begin MEASUREMENT UEGO_numUn0PckAryS1B1 "Number of Un0 per measurement package sensor 1 bank 1" UBYTE dez 1 100 0.00 255.0 FORMAT "%5.1" ECU_ADDRESS 0x6000A2BF /end MEASUREMENT
/begin MEASUREMENT UEGO_numUoffgnd1S1B1 "ADC value of the offset measurement at Ground with amplifier mode 1 for UEGO sensor 1 Bank 1" SWORD fak_q0p125 1 100 -4096.000 4095.875 FORMAT "%8.3" ECU_ADDRESS 0x60004E9C /end MEASUREMENT
/begin MEASUREMENT UEGO_numUoffgnd2S1B1 "ADC value of the offset measurement at Ground with amplifier mode 2 for UEGO sensor 1 Bank 1" SWORD fak_q0p125 1 100 -4096.000 4095.875 FORMAT "%8.3" ECU_ADDRESS 0x60004E9A /end MEASUREMENT
/begin MEASUREMENT UEGO_numUoffgnd3S1B1 "ADC value of the offset measurement at Ground with amplifier mode 3 for UEGO sensor 1 Bank 1" SWORD fak_q0p125 1 100 -4096.000 4095.875 FORMAT "%8.3" ECU_ADDRESS 0x60004E98 /end MEASUREMENT
/begin MEASUREMENT UEGO_numUoffipe1Z1S1B1 "ADC value of the offset measurement of the IPE-pin in the switching state Z1 with amplifier mode 2 for UEGO sensor 1 Bank 1" SWORD fak_q0p125 1 100 -4096.000 4095.875 FORMAT "%8.3" ECU_ADDRESS 0x70002CB2 /end MEASUREMENT
/begin MEASUREMENT UEGO_numUoffipe1Z2S1B1 "ADC value of the offset measurement of the IPE-pin in the switching state Z2 with amplifier mode 2 for UEGO sensor 1 Bank 1" SWORD fak_q0p125 1 100 -4096.000 4095.875 FORMAT "%8.3" ECU_ADDRESS 0x70002CB4 /end MEASUREMENT
/begin MEASUREMENT UEGO_numUoffipe2Z1S1B1 "ADC value of the offset measurement of the IPE-pin in the switching state Z1 with amplifier mode 3 for UEGO sensor 1 Bank 1" SWORD fak_q0p125 1 100 -4096.000 4095.875 FORMAT "%8.3" ECU_ADDRESS 0x70002CB6 /end MEASUREMENT
/begin MEASUREMENT UEGO_numUoffipe2Z2S1B1 "ADC value of the offset measurement of the IPE-pin in the switching state Z2 with amplifier mode 3 for UEGO sensor 1 Bank 1" SWORD fak_q0p125 1 100 -4096.000 4095.875 FORMAT "%8.3" ECU_ADDRESS 0x70002CB8 /end MEASUREMENT
/begin MEASUREMENT UEGO_numUoffvcc1S1B1 "Data Uoffvcc1 sensor 1 bank 1" SWORD fak_q0p125 1 100 -4096.000 4095.875 FORMAT "%8.3" ECU_ADDRESS 0x60004E96 /end MEASUREMENT
/begin MEASUREMENT UEGO_numUoffvcc2S1B1 "Data Uoffvcc2 sensor 1 bank 1" SWORD fak_q0p125 1 100 -4096.000 4095.875 FORMAT "%8.3" ECU_ADDRESS 0x60004E94 /end MEASUREMENT
/begin MEASUREMENT UEGO_numUoffvcc3S1B1 "Data Uoffvcc3 sensor 1 bank 1" SWORD fak_q0p125 1 100 -4096.000 4095.875 FORMAT "%8.3" ECU_ADDRESS 0x60004E92 /end MEASUREMENT
/begin MEASUREMENT UEGO_numUoffvcci2S1B1 "Data Uoffvcci2 sensor 1 bank 1" SWORD fak_q0p125 1 100 -4096.000 4095.875 FORMAT "%8.3" ECU_ADDRESS 0x70002CBA /end MEASUREMENT
/begin MEASUREMENT UEGO_numUp0PckAryS1B1 "Number of Up0 per measurement package sensor 1 bank 1" UBYTE dez 1 100 0.00 255.0 FORMAT "%5.1" ECU_ADDRESS 0x6000A2BE /end MEASUREMENT
/begin MEASUREMENT UEGO_numUpPckAryS1B1 "Number of Up per measurement package sensor 1 bank 1" UBYTE dez 1 100 0.00 255.0 FORMAT "%5.1" ECU_ADDRESS 0x6000A2BD /end MEASUREMENT
/begin MEASUREMENT UEGO_numUrieMeasActS1B1 "current number of Urie measurements" UBYTE dez 1 100 0.00 255.0 FORMAT "%5.1" ECU_ADDRESS 0x70002DAC /end MEASUREMENT
/begin MEASUREMENT UEGO_numUriePckAryS1B1 "Number of Urie per measurement package sensor 1 bank 1" UBYTE dez 1 100 0.00 255.0 FORMAT "%5.1" ECU_ADDRESS 0x6000A2BC /end MEASUREMENT
/begin MEASUREMENT UEGO_ratIPmpRawS1B1 "raw value of the duty cycle of the pumping current sensor1 bank 1" SWORD fak_q1p201Em4 1 100 -3.936096 3.935976 FORMAT "%8.6" ARRAY_SIZE 15 ECU_ADDRESS 0x50005BBE /end MEASUREMENT
/begin MEASUREMENT UEGO_resRCmpS1B1 "calculated plug resistor sensor 1 bank 1" UWORD r_q0p1_Ohm 1 100 0.00 6553.500 FORMAT "%8.3" ECU_ADDRESS 0x60004C30 /end MEASUREMENT
/begin MEASUREMENT UEGO_resRParlS1B1 "Calculated parallel resistance between APE and MES for Bank 1 Sensor 1" UWORD r_q0p1_Ohm 1 100 0.00 6553.500 FORMAT "%8.3" ECU_ADDRESS 0x60004C2E /end MEASUREMENT
/begin MEASUREMENT UEGO_stCmnIrqErr "Faults in the common IRQ wire" UBYTE dez 1 100 0.00 255.0 FORMAT "%5.1" ECU_ADDRESS 0x6000A2BB /end MEASUREMENT
/begin MEASUREMENT UEGO_stDiagSnsrErrS1B1 "Status of the error evaluation of the sensor diagnosis of sensor 1 bank 1" UBYTE OneToOne 1 100 0.00 255.0 FORMAT "%5.1" ECU_ADDRESS 0x70002DAE /end MEASUREMENT
/begin MEASUREMENT UEGO_stDSQIPmpS1B1 "Display of the current status of the UEGO_DSQIPMPS1B1" UBYTE OneToOne 1 100 0.00 255.0 FORMAT "%5.1" ECU_ADDRESS 0x70002DAD /end MEASUREMENT
/begin MEASUREMENT UEGO_stErrInfoAsicChpS1B1 "Status of errors of the Chip of the ASIC of sensor 1 bank 1" UBYTE dez 1 100 0.00 255.0 FORMAT "%5.1" ECU_ADDRESS 0x70002DAF /end MEASUREMENT
/begin MEASUREMENT UEGO_stErrInfoAsicDiagRegS1B1 "Diagnosis register of the ASIC of sensor 1 bank 1" ULONG dez 1 100 0.00 4294967295.00 FORMAT "%13.2" ECU_ADDRESS 0x60001C4C /end MEASUREMENT
/begin MEASUREMENT UEGO_stIPmpOKS1B1 "State of IPOK sensor 1 bank 1" UWORD dez 1 100 0.00 65535.00 FORMAT "%8.2" ECU_ADDRESS 0x60004C2C /end MEASUREMENT
/begin MEASUREMENT UEGO_stIPmpTM2LS1B1 "Bit header on TM2 Lean activation of the 15 individual cycles for UEGO sensor 1 bank 1" UWORD dez 1 100 0.00 65535.00 FORMAT "%8.2" ECU_ADDRESS 0x60004C2A /end MEASUREMENT
/begin MEASUREMENT UEGO_stIPmpTM2RS1B1 "Bit header on TM2 Rich activation of the 15 individual cycles for UEGO sensor 1 Bank 1" UWORD dez 1 100 0.00 65535.00 FORMAT "%8.2" ECU_ADDRESS 0x60004C28 /end MEASUREMENT
/begin MEASUREMENT UEGO_stIPmpTMS1B1 "register IPTM sensor 1 bank 1" UWORD dez 1 100 0.00 65535.00 FORMAT "%8.2" ECU_ADDRESS 0x60004C26 /end MEASUREMENT
/begin MEASUREMENT UEGO_stUn0PckAryS1B1 "Status word to display the validity field for Un0 Array (sensor 1, bank 1)" UWORD dez 1 100 0.00 65535.00 FORMAT "%8.2" ECU_ADDRESS 0x70002CC6 /end MEASUREMENT
/begin MEASUREMENT UEGO_stUn0Z2PckAryS1B1 "Status word to display the validity field for Un0 Array in z2 current flow (sensor 1, bank 1)" UWORD dez 1 100 0.00 65535.00 FORMAT "%8.2" ECU_ADDRESS 0x70002CC8 /end MEASUREMENT
/begin MEASUREMENT UEGO_stUp0PckAryS1B1 "Status word to display the validity field for Up0 Array (sensor 1, bank 1)" UWORD dez 1 100 0.00 65535.00 FORMAT "%8.2" ECU_ADDRESS 0x60004C1E /end MEASUREMENT
/begin MEASUREMENT UEGO_stUp0Z2PckAryS1B1 "Status word to display the validity field for Up0 Array in z2 current flow (sensor 1, bank 1)" UWORD dez 1 100 0.00 65535.00 FORMAT "%8.2" ECU_ADDRESS 0x60004C1C /end MEASUREMENT
/begin MEASUREMENT UEGO_stUpPckAryS1B1 "Status word to display the validity field for Up Array (sensor 1, bank 1)" UBYTE dez 1 100 0.00 255.0 FORMAT "%5.1" ECU_ADDRESS 0x6000A2B9 /end MEASUREMENT
/begin MEASUREMENT UEGO_stUpZ2PckAryS1B1 "Status word to display the validity field for Up Array in z2 current flow (sensor 1, bank 1)" UBYTE dez 1 100 0.00 255.0 FORMAT "%5.1" ECU_ADDRESS 0x6000A2B8 /end MEASUREMENT
/begin MEASUREMENT UEGO_tiPckS1B1 "Time stamp UEGO measurement pack sensor 1 bank 1" ULONG dez 1 100 0.00 4294967295.00 FORMAT "%13.2" ECU_ADDRESS 0x70002B44 /end MEASUREMENT
/begin MEASUREMENT UEGO_tiStmpCircAryS1B1 "ring buffer array time stamp information sensor 1 bank 1" ULONG t_q0p000001_s 1 100 0.00 4294.96729500 FORMAT "%13.8" ARRAY_SIZE 30 ECU_ADDRESS 0x50004D80 /end MEASUREMENT
/begin MEASUREMENT UEGO_TmpArr_10ms "Auxiliary array (10ms) for data collection via Lsm_Get" UWORD dez 1 100 0.00 65535.00 FORMAT "%8.2" ARRAY_SIZE 16 ECU_ADDRESS 0x6000D992 /end MEASUREMENT
/begin MEASUREMENT UEGO_uGkAvrgPckS1B1 "electrically corrected voltage Ugk sensor 1 bank 1" SWORD spg_q3p2Em4_V 1 100 -10.48576 10.48544 FORMAT "%8.5" ECU_ADDRESS 0x60004E7A /end MEASUREMENT
/begin MEASUREMENT UEGO_uIpcalAvrgPckS1B1 "electrically corrected voltage uipcal sensor 1 bank 1" SWORD spg_q3p2Em4_V 1 100 -10.48576 10.48544 FORMAT "%8.5" ECU_ADDRESS 0x60004E78 /end MEASUREMENT
/begin MEASUREMENT UEGO_uUa2PckAryS1B1 "Array for electrically corrected voltage Ua2 sensor 1 bank 1" SWORD spg_q3p2Em4_V 1 100 -10.48576 10.48544 FORMAT "%8.5" ARRAY_SIZE 5 ECU_ADDRESS 0x50005BDC /end MEASUREMENT
/begin MEASUREMENT UEGO_uUa31PckS1B1 "electrically corrected voltage Ua31 sensor 1 bank 1" SWORD spg_q3p2Em4_V 1 100 -10.48576 10.48544 FORMAT "%8.5" ECU_ADDRESS 0x70002CCC /end MEASUREMENT
/begin MEASUREMENT UEGO_uUa32PckS1B1 "electrically corrected voltage Ua32 sensor 1 bank 1" SWORD spg_q3p2Em4_V 1 100 -10.48576 10.48544 FORMAT "%8.5" ECU_ADDRESS 0x70002CCE /end MEASUREMENT
/begin MEASUREMENT UEGO_uUa33PckS1B1 "electrically corrected voltage Ua33 sensor 1 bank 1" SWORD spg_q3p2Em4_V 1 100 -10.48576 10.48544 FORMAT "%8.5" ECU_ADDRESS 0x60004E72 /end MEASUREMENT
/begin MEASUREMENT UEGO_uUapePckS1B1 "electrically corrected voltage Uape sensor 1 bank 1" SWORD spg_q3p2Em4_V 1 100 -10.48576 10.48544 FORMAT "%8.5" ECU_ADDRESS 0x60004E70 /end MEASUREMENT
/begin MEASUREMENT UEGO_uUg0PckS1B1 "electrically corrected voltage Ug0 sensor 1 bank 1" SWORD spg_q3p2Em4_V 1 100 -10.48576 10.48544 FORMAT "%8.5" ECU_ADDRESS 0x60004E6E /end MEASUREMENT
/begin MEASUREMENT UEGO_uUgaPckAryS1B1 "Array for electrically corrected voltage Uga sensor 1 bank 1" SWORD spg_q3p2Em4_V 1 100 -10.48576 10.48544 FORMAT "%8.5" ARRAY_SIZE 5 ECU_ADDRESS 0x50005BE6 /end MEASUREMENT
/begin MEASUREMENT UEGO_uUgiPckAryS1B1 "Array for electrically corrected voltage Ugi sensor 1 bank 1" SWORD spg_q3p2Em4_V 1 100 -10.48576 10.48544 FORMAT "%8.5" ARRAY_SIZE 5 ECU_ADDRESS 0x50005BF0 /end MEASUREMENT
/begin MEASUREMENT UEGO_uUguaPckS1B1 "electrically corrected voltage Ugua sensor 1 bank 1" SWORD spg_q3p2Em4_V 1 100 -10.48576 10.48544 FORMAT "%8.5" ECU_ADDRESS 0x60004E6C /end MEASUREMENT
/begin MEASUREMENT UEGO_uUguaZ2PckS1B1 "electrically corrected voltage Ugua current flow z2 sensor 1 bank 1" SWORD spg_q3p2Em4_V 1 100 -10.48576 10.48544 FORMAT "%8.5" ECU_ADDRESS 0x70002CD0 /end MEASUREMENT
/begin MEASUREMENT UEGO_uUguiPckS1B1 "electrically corrected voltage Ugui sensor 1 bank 1" SWORD spg_q3p2Em4_V 1 100 -10.48576 10.48544 FORMAT "%8.5" ECU_ADDRESS 0x60004E6A /end MEASUREMENT
/begin MEASUREMENT UEGO_uUguiZ1PckS1B1 "electrically corrected voltage Ugui current flow z1 sensor 1 bank 1" SWORD spg_q3p2Em4_V 1 100 -10.48576 10.48544 FORMAT "%8.5" ECU_ADDRESS 0x70002CD2 /end MEASUREMENT
/begin MEASUREMENT UEGO_uUi21PckAryS1B1 "electrically corrected voltage Ui21 sensor 1 bank 1" SWORD spg_q3p2Em4_V 1 100 -10.48576 10.48544 FORMAT "%8.5" ARRAY_SIZE 5 ECU_ADDRESS 0x50005BFA /end MEASUREMENT
/begin MEASUREMENT UEGO_uUi22PckS1B1 "electrically corrected voltage Ui22 sensor 1 bank 1" SWORD spg_q3p2Em4_V 1 100 -10.48576 10.48544 FORMAT "%8.5" ECU_ADDRESS 0x60004E68 /end MEASUREMENT
/begin MEASUREMENT UEGO_uUi23PckS1B1 "electrically corrected voltage Ui23 sensor 1 bank 1" SWORD spg_q3p2Em4_V 1 100 -10.48576 10.48544 FORMAT "%8.5" ECU_ADDRESS 0x60004E66 /end MEASUREMENT
/begin MEASUREMENT UEGO_uUi24PckS1B1 "electrically corrected voltage Ui24 sensor 1 bank 1" SWORD spg_q3p2Em4_V 1 100 -10.48576 10.48544 FORMAT "%8.5" ECU_ADDRESS 0x60004E64 /end MEASUREMENT
/begin MEASUREMENT UEGO_uUi4PckS1B1 "electrically corrected voltage Ui4 sensor 1 bank 1" SWORD spg_q3p2Em4_V 1 100 -10.48576 10.48544 FORMAT "%8.5" ECU_ADDRESS 0x60004E62 /end MEASUREMENT
/begin MEASUREMENT UEGO_uUi4Z2PckS1B1 "electrically corrected voltage Ui4 current flow z2 sensor 1 bank 1" SWORD spg_q3p2Em4_V 1 100 -10.48576 10.48544 FORMAT "%8.5" ECU_ADDRESS 0x60004E60 /end MEASUREMENT
/begin MEASUREMENT UEGO_uUn0ElecCorrdS1B1 "electrically corrected nernst voltage un0 sensor 1 bank 1" SWORD spg_q3p2Em4_V 1 100 -10.48576 10.48544 FORMAT "%8.5" ECU_ADDRESS 0x60004E5E /end MEASUREMENT
/begin MEASUREMENT UEGO_uUn0PacAryS1B1 "Array for package nernst voltages of sensor 1 bank 1" SWORD spg_q3p2Em4_V 1 100 -10.48576 10.48544 FORMAT "%8.5" ARRAY_SIZE 15 ECU_ADDRESS 0x70002CD4 /end MEASUREMENT
/begin MEASUREMENT UEGO_uUn0PckAryS1B1 "Array electrically corrected nernst voltage Un0 sensor 1 bank 1" SWORD spg_q3p2Em4_V 1 100 -10.48576 10.48544 FORMAT "%8.5" ARRAY_SIZE 15 ECU_ADDRESS 0x50005C04 /end MEASUREMENT
/begin MEASUREMENT UEGO_uUn0PckAvrgS1B1 "electrically corrected nernst voltage Un0 sensor 1 bank 1" SWORD spg_q3p2Em4_V 1 100 -10.48576 10.48544 FORMAT "%8.5" ECU_ADDRESS 0x60004E5C /end MEASUREMENT
/begin MEASUREMENT UEGO_uUn0RawLstS1B1 "electrically corrected Un0 voltage sensor 1 bank 1" SWORD spg_q3p2Em4_V 1 100 -10.48576 10.48544 FORMAT "%8.5" ECU_ADDRESS 0x70002CF2 /end MEASUREMENT
/begin MEASUREMENT UEGO_uUnSetPckS1B1 "electrically corrected UnSet sensor 1 bank 1" SWORD spg_q3p2Em4_V 1 100 -10.48576 10.48544 FORMAT "%8.5" ECU_ADDRESS 0x70002CF4 /end MEASUREMENT
/begin MEASUREMENT UEGO_uUp0PacAvrgS1B1 "UEGO package mean value of pump cell voltage for S1B1" SWORD spg_q3p2Em4_V 1 100 -10.48576 10.48544 FORMAT "%8.5" ECU_ADDRESS 0x70002CF6 /end MEASUREMENT
/begin MEASUREMENT UEGO_uUp0PckAryS1B1 "Array for package pump voltages of sensor 1 bank 1" SWORD spg_q3p2Em4_V 1 100 -10.48576 10.48544 FORMAT "%8.5" ARRAY_SIZE 15 ECU_ADDRESS 0x50005C22 /end MEASUREMENT
/begin MEASUREMENT UEGO_uUpPckAryS1B1 "Array for package pump voltages of sensor 1 bank 1" SWORD spg_q3p2Em4_V 1 100 -10.48576 10.48544 FORMAT "%8.5" ARRAY_SIZE 5 ECU_ADDRESS 0x50005C40 /end MEASUREMENT
/begin MEASUREMENT UEGO_uUriaPckS1B1 "electrically corrected voltage Uria sensor 1 bank 1" SWORD spg_q3p2Em4_V 1 100 -10.48576 10.48544 FORMAT "%8.5" ECU_ADDRESS 0x60004E5A /end MEASUREMENT
/begin MEASUREMENT UEGO_uUriePckAryS1B1 "electrically corrected voltage Urie sensor 1 bank 1" SWORD spg_q3p2Em4_V 1 100 -10.48576 10.48544 FORMAT "%8.5" ARRAY_SIZE 5 ECU_ADDRESS 0x50005C4A /end MEASUREMENT
/begin MEASUREMENT UEGO_uVCC3MeasRefS1B1 "Measured Reference voltage VCC3 Sensor 1 Bank 1" SWORD spg_q3p2Em4_V 1 100 -10.48576 10.48544 FORMAT "%8.5" ECU_ADDRESS 0x60004E58 /end MEASUREMENT
/begin FUNCTION UEGO_CJ135DatEval "5.9.0     UEGO CJ135 data acquisition and preprocessing"
 /begin DEF_CHARACTERISTIC UEGO_facFkalFltConst_C UEGO_ratCmnModCorrn_C UEGO_ratFkalCorrn_C UEGO_uGndOffCorrn_C UEGO_facUcalFltConst_C UEGO_facUg0FltConst_C UEGO_idxCyc1371013_T UEGO_idxCycUp0Norm1_T UEGO_idxUn0Cyc3691215_T UEGO_idxUpNorm3_T UEGO_resRsgmspm_C UEGO_stCJ135DatEval_C UEGO_tiDlyIsqrVld_C UEGO_tiMeasRefFltConst_C UEGO_resRCal_C UEGO_resRGnd_C UEGO_uVCC3Ref_C /end DEF_CHARACTERISTIC
 /begin REF_CHARACTERISTIC UEGO_idxHWES1B1_C /end REF_CHARACTERISTIC
 /begin IN_MEASUREMENT SyC_ctPostDrvLeave UEGO_flgEcuDataRstReqS1B1 UEGO_flgIPmpActvdS1B1 UEGO_flgLoupeNS1B1 UEGO_flgLoupePS1B1 UEGO_flgNewPckVldS1B1 UEGO_flgRefPatVldS1B1 UEGO_flgRegUnsetVldS1B1 UEGO_flgTrimSqChngS1B1 UEGO_flgTrimSqrChngS1B1 UEGO_flgTrmSqrVldS1B1 UEGO_flgTrmSqVldS1B1 UEGO_flgURIAS1B1 UEGO_flgWireDataRstReqS1B1 UEGO_idxOPTS1B1 UEGO_idxTypS1B1 UEGO_numModMeasS1B1 UEGO_numRamRegModeS1B1 UEGO_numRegUnsetS1B1 UEGO_stRefPatS1B1 /end IN_MEASUREMENT
 /begin OUT_MEASUREMENT UEGO_CJ135CalcElecCorrnS1B1.flgFKal1Strtd UEGO_CJ135CalcElecCorrnS1B1.flgFKal2Strtd UEGO_CJ135CalcElecCorrnS1B1.flgFKal3Strtd UEGO_CJ135CalcElecCorrnS1B1.flgnCmnMod1Strtd UEGO_CJ135CalcElecCorrnS1B1.flgnCmnMod2Strtd UEGO_CJ135CalcElecCorrnS1B1.flgnumUref22Strtd UEGO_CJ135CalcElecCorrnS1B1.numUref1Corrd UEGO_CJ135CalcElecCorrnS1B1.numUref21Corrd UEGO_CJ135CalcElecCorrnS1B1.numUref22Corrd UEGO_CJ135CalcElecCorrnS1B1.numUref3Corrd UEGO_CJ135CalcElecCorrnS1B1.uCmnMod1 UEGO_CJ135CalcElecCorrnS1B1.uCmnMod2 UEGO_CJ135CalcElecCorrnS1B1.uVCC1Corrd UEGO_CJ135CalcElecCorrnS1B1.uVCC3MeasRef UEGO_CJ135CalcElecCorrnS1B1.uFkal1Flt_DL_I.memory UEGO_CJ135CalcElecCorrnS1B1.uFkal2Flt_DL_I.memory UEGO_CJ135CalcElecCorrnS1B1.uFkal3Flt_DL_I.memory UEGO_flgIsqrStrtdS1B1 UEGO_flgIsqrVldS1B1 UEGO_flgIsqStrtdS1B1 UEGO_flgNewIPmpOKS1B1 UEGO_flgNewIPmpPckAryS1B1 UEGO_flgNewIPmpTMS1B1 UEGO_flgNewTiPckS1B1 UEGO_flgNewUa2PckAryS1B1 UEGO_flgNewUa31PckS1B1 UEGO_flgNewUa32PckS1B1 UEGO_flgNewUa33PckS1B1 UEGO_flgNewUapePckS1B1 UEGO_flgNewUg0PckS1B1 UEGO_flgNewUgaPckAryS1B1 UEGO_flgNewUgiPckAryS1B1 UEGO_flgNewUgkAvrgPckS1B1 UEGO_flgNewUguaPckS1B1 UEGO_flgNewUguaZ2PckS1B1 UEGO_flgNewUguiPckS1B1 UEGO_flgNewUguiZ1PckS1B1 UEGO_flgNewUi21PckAryS1B1 UEGO_flgNewUi22PckS1B1 UEGO_flgNewUi23PckS1B1 UEGO_flgNewUi24PckS1B1 UEGO_flgNewUi4PckS1B1 UEGO_flgNewUi4Z2PckS1B1 UEGO_flgNewUlpcalAvrgPckS1B1 UEGO_flgNewUn0PckAryS1B1 UEGO_flgNewUnSetPckS1B1 UEGO_flgNewUp0PckAryS1B1 UEGO_flgNewUpPckAryS1B1 UEGO_flgNewUriaPckS1B1 UEGO_flgNewUriePckAryS1B1 UEGO_flgUoffipe1Z1StrtdS1B1 UEGO_flgUoffipe1Z2StrtdS1B1 UEGO_flgUoffipe2Z1StrtdS1B1 UEGO_flgUoffipe2Z2StrtdS1B1 UEGO_flgUoffvcc1StrtdS1B1 UEGO_flgUoffvcc2StrtdS1B1 UEGO_flgUoffvcc3StrtdS1B1 UEGO_flgUoffvcci2StrtdS1B1 UEGO_iIsqMeasS1B1 UEGO_iIsqrMeasS1B1 UEGO_numIpPckAryS1B1 UEGO_numUa2PckAryS1B1 UEGO_numUgaPckAryS1B1 UEGO_numUgiPckAryS1B1 UEGO_numUi21PckAryS1B1 UEGO_numUn0PckAryS1B1 UEGO_numUoffgnd1S1B1 UEGO_numUoffgnd2S1B1 UEGO_numUoffgnd3S1B1 UEGO_numUoffipe1Z1S1B1 UEGO_numUoffipe1Z2S1B1 UEGO_numUoffipe2Z1S1B1 UEGO_numUoffipe2Z2S1B1 UEGO_numUoffvcc1S1B1 UEGO_numUoffvcc2S1B1 UEGO_numUoffvcc3S1B1 UEGO_numUoffvcci2S1B1 UEGO_numUp0PckAryS1B1 UEGO_numUpPckAryS1B1 UEGO_numUrieMeasActS1B1 UEGO_numUriePckAryS1B1 UEGO_ratIPmpRawS1B1 UEGO_stIPmpOKS1B1 UEGO_stIPmpTM2LS1B1 UEGO_stIPmpTM2RS1B1 UEGO_stIPmpTMS1B1 UEGO_stUn0PckAryS1B1 UEGO_stUn0Z2PckAryS1B1 UEGO_stUp0PckAryS1B1 UEGO_stUp0Z2PckAryS1B1 UEGO_stUpPckAryS1B1 UEGO_stUpZ2PckAryS1B1 UEGO_tiPckS1B1 UEGO_uGkAvrgPckS1B1 UEGO_uIpcalAvrgPckS1B1 UEGO_uUa2PckAryS1B1 UEGO_uUa31PckS1B1 UEGO_uUa32PckS1B1 UEGO_uUa33PckS1B1 UEGO_uUapePckS1B1 UEGO_uUg0PckS1B1 UEGO_uUgaPckAryS1B1 UEGO_uUgiPckAryS1B1 UEGO_uUguaPckS1B1 UEGO_uUguaZ2PckS1B1 UEGO_uUguiPckS1B1 UEGO_uUguiZ1PckS1B1 UEGO_uUi21PckAryS1B1 UEGO_uUi22PckS1B1 UEGO_uUi23PckS1B1 UEGO_uUi24PckS1B1 UEGO_uUi4PckS1B1 UEGO_uUi4Z2PckS1B1 UEGO_uUn0ElecCorrdS1B1 UEGO_uUn0PacAryS1B1 UEGO_uUn0PckAryS1B1 UEGO_uUn0PckAvrgS1B1 UEGO_uUn0RawLstS1B1 UEGO_uUnSetPckS1B1 UEGO_uUp0PckAryS1B1 UEGO_uUpPckAryS1B1 UEGO_uUriaPckS1B1 UEGO_uUriePckAryS1B1 UEGO_uVCC3MeasRefS1B1 /end OUT_MEASUREMENT
 /begin LOC_MEASUREMENT UEGO_CJ135DatEvalS1B1_I.ctPostDrvLeave1ms UEGO_CJ135DatEvalS1B1_I.ctPostDrvLeave5ms UEGO_CJ135DatEvalS1B1_I.flgIsqrStoreVld UEGO_CJ135DatEvalS1B1_I.flgIsqrVld UEGO_CJ135DatEvalS1B1_I.flgNewIPmpPckAry UEGO_CJ135DatEvalS1B1_I.flgNewIPmpTM UEGO_CJ135DatEvalS1B1_I.flgNewURiaPck UEGO_CJ135DatEvalS1B1_I.flgNewUa2Pck UEGO_CJ135DatEvalS1B1_I.flgNewUa31Pck UEGO_CJ135DatEvalS1B1_I.flgNewUa32Pck UEGO_CJ135DatEvalS1B1_I.flgNewUa33Pck UEGO_CJ135DatEvalS1B1_I.flgNewUapePck UEGO_CJ135DatEvalS1B1_I.flgNewUg0Pck UEGO_CJ135DatEvalS1B1_I.flgNewUgaPck UEGO_CJ135DatEvalS1B1_I.flgNewUgiPckAry UEGO_CJ135DatEvalS1B1_I.flgNewUgkAvrgPck UEGO_CJ135DatEvalS1B1_I.flgNewUguaPck UEGO_CJ135DatEvalS1B1_I.flgNewUguaZ2Pck UEGO_CJ135DatEvalS1B1_I.flgNewUguiPck UEGO_CJ135DatEvalS1B1_I.flgNewUguiZ1Pck UEGO_CJ135DatEvalS1B1_I.flgNewUi21PckAry UEGO_CJ135DatEvalS1B1_I.flgNewUi22Pck UEGO_CJ135DatEvalS1B1_I.flgNewUi23Pck UEGO_CJ135DatEvalS1B1_I.flgNewUi24Pck UEGO_CJ135DatEvalS1B1_I.flgNewUi4Pck UEGO_CJ135DatEvalS1B1_I.flgNewUi4Z2Pck UEGO_CJ135DatEvalS1B1_I.flgNewUlpcalAvrgPck UEGO_CJ135DatEvalS1B1_I.flgNewUn0PckAry UEGO_CJ135DatEvalS1B1_I.flgNewUnSetPck UEGO_CJ135DatEvalS1B1_I.flgNewUp0PckAry UEGO_CJ135DatEvalS1B1_I.flgNewUpPckAry UEGO_CJ135DatEvalS1B1_I.flgNewUriePckAry UEGO_CJ135DatEvalS1B1_I.flgUcalStrtd UEGO_CJ135DatEvalS1B1_I.flgUg0Strtd UEGO_CJ135DatEvalS1B1_I.flgUoffgnd1Strtd UEGO_CJ135DatEvalS1B1_I.flgUoffgnd2Strtd UEGO_CJ135DatEvalS1B1_I.flgUoffgnd3Strtd UEGO_CJ135DatEvalS1B1_I.flgUoffipe1Z1Strtd UEGO_CJ135DatEvalS1B1_I.flgUoffipe1Z2Strtd UEGO_CJ135DatEvalS1B1_I.flgUoffipe2Z1Strtd UEGO_CJ135DatEvalS1B1_I.flgUoffipe2Z2Strtd UEGO_CJ135DatEvalS1B1_I.flgUoffvcc1Strtd UEGO_CJ135DatEvalS1B1_I.flgUoffvcc2Strtd UEGO_CJ135DatEvalS1B1_I.flgUoffvcc3Strtd UEGO_CJ135DatEvalS1B1_I.flgUoffvcci1Strtd UEGO_CJ135DatEvalS1B1_I.flgUoffvcci2Strtd UEGO_CJ135DatEvalS1B1_I.flgVCC3MeasRefStrtd UEGO_CJ135DatEvalS1B1_I.iIsqrMeas UEGO_CJ135DatEvalS1B1_I.numIpPckAry UEGO_CJ135DatEvalS1B1_I.numUa2PckAry UEGO_CJ135DatEvalS1B1_I.numUgaPckAry UEGO_CJ135DatEvalS1B1_I.numUgiPckAry UEGO_CJ135DatEvalS1B1_I.numUi21PckAry UEGO_CJ135DatEvalS1B1_I.numUn0PckAry UEGO_CJ135DatEvalS1B1_I.numUoffipe1Z1 UEGO_CJ135DatEvalS1B1_I.numUoffipe1Z2 UEGO_CJ135DatEvalS1B1_I.numUoffipe2Z1 UEGO_CJ135DatEvalS1B1_I.numUoffipe2Z2 UEGO_CJ135DatEvalS1B1_I.numUoffvcc1 UEGO_CJ135DatEvalS1B1_I.numUoffvcc2 UEGO_CJ135DatEvalS1B1_I.numUoffvcc3 UEGO_CJ135DatEvalS1B1_I.numUoffvcci1 UEGO_CJ135DatEvalS1B1_I.numUoffvcci2 UEGO_CJ135DatEvalS1B1_I.numUp0PckAry UEGO_CJ135DatEvalS1B1_I.numUpPckAry UEGO_CJ135DatEvalS1B1_I.numUriePckAry UEGO_CJ135DatEvalS1B1_I.ratIPmpRaw UEGO_CJ135DatEvalS1B1_I.stIPmpOK UEGO_CJ135DatEvalS1B1_I.stIPmpTM UEGO_CJ135DatEvalS1B1_I.stIPmpTM2L UEGO_CJ135DatEvalS1B1_I.stIPmpTM2R UEGO_CJ135DatEvalS1B1_I.stLsmGetTime UEGO_CJ135DatEvalS1B1_I.stUn0PckAry UEGO_CJ135DatEvalS1B1_I.stUn0Z2PckAry UEGO_CJ135DatEvalS1B1_I.stUp0PckAry UEGO_CJ135DatEvalS1B1_I.stUp0Z2PckAry UEGO_CJ135DatEvalS1B1_I.stUpPckAry UEGO_CJ135DatEvalS1B1_I.stUpZ2PckAry UEGO_CJ135DatEvalS1B1_I.uGkAvrgPck UEGO_CJ135DatEvalS1B1_I.uIpcalAvrgPck UEGO_CJ135DatEvalS1B1_I.uRegUnset UEGO_CJ135DatEvalS1B1_I.uUa31Pck UEGO_CJ135DatEvalS1B1_I.uUa32Pck UEGO_CJ135DatEvalS1B1_I.uUa33Pck UEGO_CJ135DatEvalS1B1_I.uUapePck UEGO_CJ135DatEvalS1B1_I.uUg0Pck UEGO_CJ135DatEvalS1B1_I.uUguaPck UEGO_CJ135DatEvalS1B1_I.uUguaZ2Pck UEGO_CJ135DatEvalS1B1_I.uUguiPck UEGO_CJ135DatEvalS1B1_I.uUguiZ1Pck UEGO_CJ135DatEvalS1B1_I.uUi22Pck UEGO_CJ135DatEvalS1B1_I.uUi23Pck UEGO_CJ135DatEvalS1B1_I.uUi24Pck UEGO_CJ135DatEvalS1B1_I.uUi4Pck UEGO_CJ135DatEvalS1B1_I.uUi4Z2Pck UEGO_CJ135DatEvalS1B1_I.uUn0PckAvrg UEGO_CJ135DatEvalS1B1_I.uUn0PckSum UEGO_CJ135DatEvalS1B1_I.uUn0RawLst UEGO_CJ135DatEvalS1B1_I.uUnSet UEGO_CJ135DatEvalS1B1_I.uUriaPck UEGO_CJ135DatEvalS1B1_I.uVCC1aTest UEGO_CJ135DatEvalS1B1_I.uVCC1bTest UEGO_CJ135DatEvalS1B1_I.uVCC3MeasRef UEGO_CJ135DatEvalS1B1_I.uVCC3MeasRefFild UEGO_CJ135DatEvalS1B1_I.uVCC3MeasRefUnFild UEGO_CJ135DatEvalS1B1_I.uVCC3aTest UEGO_CJ135DatEvalS1B1_I.uVCC3bTest UEGO_CJ135DatEvalS1B1_I.IsqrDlyVldTOFFV_I.outbit UEGO_CJ135DatEvalS1B1_I.IsqrDlyVldTOFFV_I.time UEGO_CJ135DatEvalS1B1_I.uUcalFltElecCor_DL_I.memory UEGO_CJ135DatEvalS1B1_I.uUg0FltElecCor_DL_I.memory UEGO_CJ135DatEvalS1B1_I.uVCC3MeasFltRef_LT_I.memory /end LOC_MEASUREMENT
 FUNCTION_VERSION "5.9.0" /end FUNCTION
/begin FUNCTION UEGO_CJ135Dia "4.8.0     UEGO CJ135 diagnosis"
 /begin DEF_CHARACTERISTIC UEGO_cntrErrSpiDiagMax_C UEGO_cntrErrSpiRamBnkMax_C UEGO_cntrErrSpiRegBnkMax_C UEGO_cntrModIdleReqMax_C UEGO_numDlyOkAsic_C UEGO_numModWaitMax_C UEGO_numRegSetMax_C UEGO_ratIsqDeDesMeasMax_C UEGO_ratIsqrDeDesMeasMax_C UEGO_rMeasMax_C UEGO_rParlMin_C UEGO_stCj135DiagAsicDi_C UEGO_stCj135DiagSpiDi_C UEGO_tiCmnIrqSlowErr_C UEGO_tiDlyErrAsic_C UEGO_uFkal1Max_C UEGO_uFkal1Min_C UEGO_uFkal2Max_C UEGO_uFkal2Min_C UEGO_uFkal3Max_C UEGO_uFkal3Min_C UEGO_uVCC3Max_C UEGO_uVCC3Min_C UEGO_stCj135Diag_C /end DEF_CHARACTERISTIC
 /begin REF_CHARACTERISTIC UEGO_idxHWES1B1_C /end REF_CHARACTERISTIC
 /begin IN_MEASUREMENT UEGO_TmpArr_10ms SyC_ctPostDrvLeave UEGO_CJ135CalcElecCorrnS1B1.flgFKal1Strtd UEGO_CJ135CalcElecCorrnS1B1.flgFKal2Strtd UEGO_CJ135CalcElecCorrnS1B1.flgFKal3Strtd UEGO_CJ135CalcElecCorrnS1B1.flgnCmnMod1Strtd UEGO_CJ135CalcElecCorrnS1B1.flgnCmnMod2Strtd UEGO_CJ135CalcElecCorrnS1B1.flgnumUref22Strtd UEGO_CJ135CalcElecCorrnS1B1.numUref1Corrd UEGO_CJ135CalcElecCorrnS1B1.numUref21Corrd UEGO_CJ135CalcElecCorrnS1B1.numUref22Corrd UEGO_CJ135CalcElecCorrnS1B1.numUref3Corrd UEGO_CJ135CalcElecCorrnS1B1.uCmnMod1 UEGO_CJ135CalcElecCorrnS1B1.uCmnMod2 UEGO_CJ135CalcElecCorrnS1B1.uVCC1Corrd UEGO_CJ135CalcElecCorrnS1B1.uVCC3MeasRef UEGO_CJ135CalcElecCorrnS1B1.uFkal1Flt_DL_I.memory UEGO_CJ135CalcElecCorrnS1B1.uFkal2Flt_DL_I.memory UEGO_CJ135CalcElecCorrnS1B1.uFkal3Flt_DL_I.memory UEGO_flgDiagRprtRelsS1B1 UEGO_flgDsmTripChgFinshd UEGO_flgErrSpiRamBnkS1B1 UEGO_flgLstPckAbortS1B1 UEGO_flgNewPckCstncS1B1 UEGO_flgNewPckMissS1B1 UEGO_flgRParlVldS1B1 UEGO_idxTypS1B1 UEGO_iIsqMeasS1B1 UEGO_iIsqRegDesS1B1 UEGO_iIsqrMeasS1B1 UEGO_iIsqrRegDesS1B1 UEGO_numIsqDesS1B1 UEGO_numIsqrDesS1B1 UEGO_numModDesS1B1 UEGO_numModMeasS1B1 UEGO_numRegSetCntrS1B1 UEGO_numTrmSqrS1B1 UEGO_numTrmSqS1B1 UEGO_resRParlS1B1 UEGO_uVCC3MeasRefS1B1 /end IN_MEASUREMENT
 /begin OUT_MEASUREMENT UEGO_cntrModVrfdS1B1 UEGO_flgCj135DiagEcuErrPndS1B1 UEGO_flgCmnIrqErrVld UEGO_flgEcuDataRstReqS1B1 UEGO_flgErrInfoAsicVldS1B1 UEGO_flgErrInfoMcuVldS1B1 UEGO_flgErrSpiDiagS1B1 UEGO_flgErrSpiRamBnk10msS1B1 UEGO_flgLockdAsicS1B1 UEGO_flgLockdSpiS1B1 UEGO_numModCtrlS1B1 UEGO_numModCurrS1B1 UEGO_stCmnIrqErr UEGO_stErrInfoAsicChpS1B1 UEGO_stErrInfoAsicDiagRegS1B1 UEGO_TmpArr_10ms /end OUT_MEASUREMENT
 /begin LOC_MEASUREMENT UEGO_CJ135DiagEcuEvln_I.ErrAry UEGO_CJ135DiagEcuEvln_I.flgChpInIdle UEGO_CJ135DiagEcuEvln_I.flgCmnIrqErrVld UEGO_CJ135DiagEcuEvln_I.flgErrInfoAsicVld UEGO_CJ135DiagEcuEvln_I.flgErrInfoMcuVld UEGO_CJ135DiagEcuEvln_I.flgErrSpiDiag UEGO_CJ135DiagEcuEvln_I.flgErrSpiRegBnk UEGO_CJ135DiagEcuEvln_I.numModCurr UEGO_CJ135DiagEcuEvln_I.stCmnIrqErr UEGO_CJ135DiagEcuEvln_I.stErrInfoAsicChp UEGO_CJ135DiagEcuEvln_I.stErrInfoAsicDiagReg UEGO_CJ135DiagS1B1_I.cntrErrSpiDiag UEGO_CJ135DiagS1B1_I.cntrErrSpiRamBnk UEGO_CJ135DiagS1B1_I.cntrErrSpiRegBnk UEGO_CJ135DiagS1B1_I.cntrModIdleReq UEGO_CJ135DiagS1B1_I.cntrModVrfd UEGO_CJ135DiagS1B1_I.cntrModWait UEGO_CJ135DiagS1B1_I.flgCmnIrqSlow UEGO_CJ135DiagS1B1_I.flgDiagEcuErrPnd UEGO_CJ135DiagS1B1_I.flgErrAsicPsbl UEGO_CJ135DiagS1B1_I.flgErrSpiPsbl UEGO_CJ135DiagS1B1_I.flgErrSpiRamBnk UEGO_CJ135DiagS1B1_I.flgLockdAsic UEGO_CJ135DiagS1B1_I.flgLockdIdleReq UEGO_CJ135DiagS1B1_I.flgLockdSpi UEGO_CJ135DiagS1B1_I.flgRstEcuReq UEGO_CJ135DiagS1B1_I.flgRstExtReq UEGO_CJ135DiagS1B1_I.numModCtrl UEGO_CJ135DiagS1B1_I.numModCtrlLst UEGO_CJ135DiagS1B1_I.stDiagAsicErr UEGO_CJ135DiagS1B1_I.stDiagSpiErr UEGO_CJ135DiagS1B1_I.ErrAsicTONVNM_I.time UEGO_CJ135DiagS1B1_I.ErrSpiTONVNM_I.time UEGO_CJ135DiagS1B1_I.ModCurrVrfdCTR_I.counter UEGO_CJ135DiagS1B1_I.ModCurrWaitCTR_I.counter UEGO_CJ135DiagS1B1_I.ModDesVrfdCTR_I.counter UEGO_CJ135DiagS1B1_I.ModDesWaitCTR_I.counter UEGO_CJ135DiagS1B1_I.ModMeasVrfdCTR_I.counter UEGO_CJ135DiagS1B1_I.ModMeasWaitCTR_I.counter UEGO_CJ135DiagS1B1_I.tiCmnIrqSlowErrSWE_I.timeCounter UEGO_cntrCj135DiagReiniProc10msec UEGO_flgChpInIdleS1B1 UEGO_flgCj135DiagExtRstReq UEGO_flgErrSpiRegBnkS1B1 /end LOC_MEASUREMENT
 FUNCTION_VERSION "4.8.0" /end FUNCTION
/begin FUNCTION UEGO_CJ135DiagSnsr "1.14.0    UEGO sensor diagnostics with CJ135"
 /begin DEF_CHARACTERISTIC UEGO_cntrDiagSnsrTstdOkRels_C UEGO_cntrErrBlackn_C UEGO_stCj135DiagSnsrEna_C UEGO_tiDlyDiagSnsrRels_C UEGO_tiDlyOffDiagBlackn_C UEGO_tiDlyOnDiagBlackn_C UEGO_tiDurnDiagAvail_C UEGO_tiDurnDiagNotAvailHi_C UEGO_uDeltaPinGndHi_C UEGO_uDeltaPinGndLo_C /end DEF_CHARACTERISTIC
 /begin IN_MEASUREMENT SyC_ctPostDrvLeave UEGO_cntrModVrfdS1B1 UEGO_flgDiagRprtRelsS1B1 UEGO_flgDsmTripChgFinshd UEGO_flgHeatgUpFinshdS1B1 UEGO_flgIPmpActvdS1B1 UEGO_flgNewIPmpOKS1B1 UEGO_flgO2HiPrcsnS1B1 UEGO_flgO2PhyRelsS1B1 UEGO_flgSnsrHotS1B1 UEGO_idxTypS1B1 UEGO_numModCtrlS1B1 UEGO_stIPmpOKS1B1 UEGO_uDeltaUgaS1B1 UEGO_uDeltaUgiS1B1 /end IN_MEASUREMENT
 /begin OUT_MEASUREMENT UEGO_flgLockdSnsrS1B1 UEGO_flgSnsrDataRstReqS1B1 UEGO_stDiagSnsrErrS1B1 /end OUT_MEASUREMENT
 /begin LOC_MEASUREMENT UEGO_CJ135DiagSnsrS1B1_I.cntrUPmpLimd UEGO_CJ135DiagSnsrS1B1_I.facSigNotAvail UEGO_CJ135DiagSnsrS1B1_I.flgAvailFlt UEGO_CJ135DiagSnsrS1B1_I.flgAvailRels UEGO_CJ135DiagSnsrS1B1_I.flgAvailWinEnd UEGO_CJ135DiagSnsrS1B1_I.flgLockdSnsr UEGO_CJ135DiagSnsrS1B1_I.flgRstExtReq UEGO_CJ135DiagSnsrS1B1_I.flgRstSnsrReq UEGO_CJ135DiagSnsrS1B1_I.flgSnsrErr UEGO_CJ135DiagSnsrS1B1_I.stDiagErr UEGO_CJ135DiagSnsrS1B1_I.DiagBlacknTOFFVNM_I.time UEGO_CJ135DiagSnsrS1B1_I.DiagBlacknTONVNM_I.time UEGO_CJ135DiagSnsrS1B1_I.SigAvailWinEndTONVNM_I.time UEGO_CJ135DiagSnsrS1B1_I.SigNotAvailSW_I.timeCounter UEGO_CJ135DiagSnsrS1B1_I.TRelsTONVNM_I.time UEGO_cntrCj135DiagSnsrReiniProc10msec UEGO_flgCJ135DiagSnsrExtRstReq /end LOC_MEASUREMENT
 FUNCTION_VERSION "1.14.0" /end FUNCTION
/begin FUNCTION UEGO_CJ135DiagWire "1.14.0    UEGO wire diagnosis with CJ135"
 /begin DEF_CHARACTERISTIC UEGO_cntrIPmpLimdMax_C UEGO_numDiagWaitAnly_C UEGO_numDiagWaitIdleSho_C UEGO_numDiagWaitNorm1_C UEGO_resRgndIsqrSnvtyMin_C UEGO_rParlMax_C UEGO_stCj135DiagWire_C UEGO_stCntrModVrfd_C UEGO_stDiagWireChpDi_C UEGO_stDiagWireMeasDi_C UEGO_tiDlyErrIPmpLimd_C UEGO_tiDlyErrUgx_C UEGO_tiDlyPerdDiagOper_C UEGO_tiDlyUgxThd_C UEGO_uG0xErr_C UEGO_uGxErrNegIni_C UEGO_uGxErrNegStep_C UEGO_uGxErrPosIni_C UEGO_uGxErrPosStep_C UEGO_uGxErr_C UEGO_uN0Err_C /end DEF_CHARACTERISTIC
 /begin IN_MEASUREMENT SyC_ctPostDrvLeave T15_st UEGO_cntrIPmpLimdPckS1B1 UEGO_cntrModVrfdS1B1 UEGO_flgClmpdNS1B1 UEGO_flgDiagRprtRelsS1B1 UEGO_flgDsmTripChgFinshd UEGO_flgErrInfoAsicVldS1B1 UEGO_flgIsqrVldS1B1 UEGO_flgLockdAsicS1B1 UEGO_flgLockdSnsrS1B1 UEGO_flgLockdSpiS1B1 UEGO_flgLstPckAbortS1B1 UEGO_flgNewPckMissS1B1 UEGO_flgRefPatVldS1B1 UEGO_flgRParlVldS1B1 UEGO_flgSnsrDataRstReqS1B1 UEGO_flgTiEngOffVld UEGO_idxTypS1B1 UEGO_iIsqrMeasS1B1 UEGO_iIsqrRegDesS1B1 UEGO_numModCtrlS1B1 UEGO_numModCurrS1B1 UEGO_numModDesS1B1 UEGO_numModMeasS1B1 UEGO_numRamFailPosnS1B1 UEGO_numRamSts2S1B1 UEGO_numRamSts3S1B1 UEGO_resRParlS1B1 UEGO_stErrInfoAsicDiagRegS1B1 UEGO_stRefPatS1B1 UEGO_tEgMdlS1B1 UEGO_tiEngOff UEGO_uDeltaUg0aS1B1 UEGO_uDeltaUg0eS1B1 UEGO_uDeltaUg0iaiS1B1 UEGO_uDeltaUg0ieiS1B1 UEGO_uDeltaUg0iS1B1 UEGO_uDeltaUgaS1B1 UEGO_uDeltaUgiS1B1 UEGO_uUn0ElecCorrdS1B1 /end IN_MEASUREMENT
 /begin OUT_MEASUREMENT UEGO_flgCJ135DiagWireErrPndS1B1 UEGO_flgWireDataRstReqS1B1 /end OUT_MEASUREMENT
 /begin LOC_MEASUREMENT UEGO_CJ135DiagWireS1B1_I.cntrErrPndUgxNeg UEGO_CJ135DiagWireS1B1_I.cntrErrPndUgxPos UEGO_CJ135DiagWireS1B1_I.flgAnlyFinshd UEGO_CJ135DiagWireS1B1_I.flgDchaReqd UEGO_CJ135DiagWireS1B1_I.flgDeltaUgxExcddRgl UEGO_CJ135DiagWireS1B1_I.flgDiagOlEna UEGO_CJ135DiagWireS1B1_I.flgDiagRprtRels UEGO_CJ135DiagWireS1B1_I.flgDrctDebReq UEGO_CJ135DiagWireS1B1_I.flgDsmClr UEGO_CJ135DiagWireS1B1_I.flgErrOlApes UEGO_CJ135DiagWireS1B1_I.flgErrOlIpe UEGO_CJ135DiagWireS1B1_I.flgErrOlRCmp UEGO_CJ135DiagWireS1B1_I.flgErrOlRe UEGO_CJ135DiagWireS1B1_I.flgErrScb UEGO_CJ135DiagWireS1B1_I.flgErrScg UEGO_CJ135DiagWireS1B1_I.flgErrSuspc UEGO_CJ135DiagWireS1B1_I.flgErrUg0iaiMin UEGO_CJ135DiagWireS1B1_I.flgErrUg0ieiMin UEGO_CJ135DiagWireS1B1_I.flgErrUnique UEGO_CJ135DiagWireS1B1_I.flgExtRstReq UEGO_CJ135DiagWireS1B1_I.flgIni UEGO_CJ135DiagWireS1B1_I.flgPerdDiagOperEna UEGO_CJ135DiagWireS1B1_I.flgRamAbort UEGO_CJ135DiagWireS1B1_I.flgRst UEGO_CJ135DiagWireS1B1_I.flgTstdOl UEGO_CJ135DiagWireS1B1_I.flgTstdRCmp UEGO_CJ135DiagWireS1B1_I.flgTstdSc UEGO_CJ135DiagWireS1B1_I.flgUg0iaiResPrsnt UEGO_CJ135DiagWireS1B1_I.numModCtrl UEGO_CJ135DiagWireS1B1_I.rParlRprt UEGO_CJ135DiagWireS1B1_I.sm UEGO_CJ135DiagWireS1B1_I.stDiagWireErr UEGO_CJ135DiagWireS1B1_I.stRprtWireErr UEGO_CJ135DiagWireS1B1_I.stRprtWireRes UEGO_CJ135DiagWireS1B1_I.DlyDeltaUgaThdTOFFVNM_I.time UEGO_CJ135DiagWireS1B1_I.DlyDeltaUgiThdTOFFVNM_I.time UEGO_CJ135DiagWireS1B1_I.IPmpLimdTONVNM_I.time UEGO_CJ135DiagWireS1B1_I.PerdDiagOperT_I.timeCounter UEGO_CJ135DiagWireS1B1_I.UgxNegTONVNM_I.time UEGO_CJ135DiagWireS1B1_I.UgxPosTONVNM_I.time UEGO_cntrCJ135DiagWireReiniProc10msec UEGO_flgCJ135DiagWireExtRstReq /end LOC_MEASUREMENT
 FUNCTION_VERSION "1.14.0" /end FUNCTION
/begin FUNCTION UEGO_CJ135IPmpEval "4.12.0    UEGO CJ135 pump current data acquisition and preprocessing"
 /begin DEF_CHARACTERISTIC UEGO_facIpDeltaFltConst_C UEGO_facIPmpRawFltConst_C UEGO_facIPmpSegFltConst_C UEGO_facRCmpFltConst_C UEGO_facUgxFltConst_C UEGO_facUp0FltConst_C UEGO_facUp0RawFltConst_C UEGO_resRMeas_C UEGO_stCJ135IPmpEval_C UEGO_tiDlyDsbcActv_C UEGO_tiDlyIPmpQlyWrstBattRng_C UEGO_tiDlyIPmpVld_C UEGO_tiDlyTM2ROscn_C UEGO_tiDlyTOffIPmpCtrlBlckn_C UEGO_tiDlyTOffIPmpCtrlDeActvd_C UEGO_tiRvsChrgMeasActv_C UEGO_tiSegLngthFilCutOff_C UEGO_tiSmoothIPmp_C UEGO_tiSustIPmpVld_C UEGO_cpCapSnsrReplVal_C UEGO_resRFe_C UEGO_tiSegLngth_C /end DEF_CHARACTERISTIC
 /begin REF_CHARACTERISTIC UEGO_resRGnd_C UEGO_stOperLoBatt_C /end REF_CHARACTERISTIC
 /begin IN_MEASUREMENT EpmCrS_tiSeg Epm_nEng Epm_numCyl SyC_ctPostDrvLeave UEGO_flgCj135DiagEcuErrPndS1B1 UEGO_flgCJ135DiagWireErrPndS1B1 UEGO_flgEcuDataRstReqS1B1 UEGO_flgErrInfoAsicVldS1B1 UEGO_flgIPmpActvdS1B1 UEGO_flgIPmpCtrlDsbcS1B1 UEGO_flgIPmpFilSyncActv UEGO_flgIPmpRvsChrgVldS1B1 UEGO_flgLoupeNS1B1 UEGO_flgLoupePS1B1 UEGO_flgN3MeasActvS1B1 UEGO_flgN3MeasActvVldS1B1 UEGO_flgNewIPmpOKS1B1 UEGO_flgNewIPmpPckAryS1B1 UEGO_flgNewIPmpRvsChrgS1B1 UEGO_flgNewIPmpTMS1B1 UEGO_flgNewPckVldS1B1 UEGO_flgNewTiPckS1B1 UEGO_flgNewUgaPckAryS1B1 UEGO_flgNewUgiPckAryS1B1 UEGO_flgNewUgkAvrgPckS1B1 UEGO_flgNewUlpcalAvrgPckS1B1 UEGO_flgNewUn0PckAryS1B1 UEGO_flgNewUp0PckAryS1B1 UEGO_flgRefPatChngS1B1 UEGO_flgRefPatVldS1B1 UEGO_flgRParlWoDsbcS1B1 UEGO_flgRParlWoDsbcVldS1B1 UEGO_flgRpcActvS1B1 UEGO_flgRpcActvVldS1B1 UEGO_flgRpcReqdS1B1 UEGO_flgRTEvlnVldS1B1 UEGO_flgSteerPatChngS1B1 UEGO_flgSteerPatVldS1B1 UEGO_flgUBattMax UEGO_flgUBattMin UEGO_flgUPmpCtrlVldS1B1 UEGO_flgURIAS1B1 UEGO_flgWireDataRstReqS1B1 UEGO_idxTypS1B1 UEGO_iIPmpRvsChrgS1B1 UEGO_iIsqMeasS1B1 UEGO_iIsqrMeasS1B1 UEGO_numModMeasS1B1 UEGO_numUgaPckAryS1B1 UEGO_numUgiPckAryS1B1 UEGO_numUn0PckAryS1B1 UEGO_numUp0PckAryS1B1 UEGO_ratIPmpRawS1B1 UEGO_stErrInfoAsicDiagRegS1B1 UEGO_stIPmpOKS1B1 UEGO_stIPmpTM2LS1B1 UEGO_stIPmpTM2RS1B1 UEGO_stRefPatS1B1 UEGO_stSteerPatS1B1 UEGO_stUPmpCtrlCurrS1B1 UEGO_tiPckS1B1 UEGO_uGkAvrgPckS1B1 UEGO_uIpcalAvrgPckS1B1 UEGO_uUgaPckAryS1B1 UEGO_uUgiPckAryS1B1 UEGO_uUn0ElecCorrdS1B1 UEGO_uUn0PckAryS1B1 UEGO_uUn0PckAvrgS1B1 UEGO_uUnSetPckS1B1 UEGO_uUp0PckAryS1B1 /end IN_MEASUREMENT
 /begin OUT_MEASUREMENT UEGO_cntrIPmpLimdPckS1B1 UEGO_flgIPmpEvlnVldS1B1 UEGO_flgRCmpVldS1B1 UEGO_flgRParlVldS1B1 UEGO_flgRvsChrgMeasActvS1B1 UEGO_iIPmpBoostdS1B1 UEGO_iIPmpCircAryS1B1 UEGO_iIPmpElecCorrdAryS1B1 UEGO_iIPmpElecCorrdS1B1 UEGO_iIPmpPacAryS1B1 UEGO_iIPmpPacAvrgS1B1 UEGO_iIPmpRawLstS1B1 UEGO_iIPmpSegWoCrvS1B1 UEGO_iIPmpSmotngElecCorrdS1B1 UEGO_numPacBlcknS1B1 UEGO_resRCmpS1B1 UEGO_resRParlS1B1 UEGO_stDSQIPmpS1B1 UEGO_tiStmpCircAryS1B1 UEGO_uUp0PacAvrgS1B1 /end OUT_MEASUREMENT
 /begin LOC_MEASUREMENT UEGO_CJ135IPmpEvalS1B1_I.UEGO_CJ135IPmpEval_ctReiniProc5msec UEGO_CJ135IPmpEvalS1B1_I.cntrSum UEGO_CJ135IPmpEvalS1B1_I.facCrvCor UEGO_CJ135IPmpEvalS1B1_I.flgCurrPck1 UEGO_CJ135IPmpEvalS1B1_I.flgIPLrnAllwd UEGO_CJ135IPmpEvalS1B1_I.flgIPLrnVld UEGO_CJ135IPmpEvalS1B1_I.flgIPTM2RLst UEGO_CJ135IPmpEvalS1B1_I.flgIPmpCrclrAvl UEGO_CJ135IPmpEvalS1B1_I.flgIPmpCtrlActvd UEGO_CJ135IPmpEvalS1B1_I.flgIPmpCtrlActvnDly UEGO_CJ135IPmpEvalS1B1_I.flgIPmpCtrlBlckn UEGO_CJ135IPmpEvalS1B1_I.flgIPmpCtrlBlcknOffDly UEGO_CJ135IPmpEvalS1B1_I.flgIPmpEvlnVld UEGO_CJ135IPmpEvalS1B1_I.flgIPmpPacVld UEGO_CJ135IPmpEvalS1B1_I.flgIPmpSegFull UEGO_CJ135IPmpEvalS1B1_I.flgIPmpSegStrtd UEGO_CJ135IPmpEvalS1B1_I.flgIPmpSegVld UEGO_CJ135IPmpEvalS1B1_I.flgIPmpTM2ROscn UEGO_CJ135IPmpEvalS1B1_I.flgNewIPmpRefCorrn UEGO_CJ135IPmpEvalS1B1_I.flgNewUn0 UEGO_CJ135IPmpEvalS1B1_I.flgNewUp0 UEGO_CJ135IPmpEvalS1B1_I.flgRCmpStrtd UEGO_CJ135IPmpEvalS1B1_I.flgRCmpVld UEGO_CJ135IPmpEvalS1B1_I.flgRParlStrtd UEGO_CJ135IPmpEvalS1B1_I.flgRParlVld UEGO_CJ135IPmpEvalS1B1_I.flgRParlWoDsbc UEGO_CJ135IPmpEvalS1B1_I.flgRpcActv UEGO_CJ135IPmpEvalS1B1_I.flgRvsChrgMeasActv UEGO_CJ135IPmpEvalS1B1_I.flgSteerpatChngdDlyd UEGO_CJ135IPmpEvalS1B1_I.flgUgaZ1Strtd UEGO_CJ135IPmpEvalS1B1_I.flgUgaZ2Strtd UEGO_CJ135IPmpEvalS1B1_I.flgUgiZ1Strtd UEGO_CJ135IPmpEvalS1B1_I.flgUgiZ2Strtd UEGO_CJ135IPmpEvalS1B1_I.flgUp0Z0Strtd UEGO_CJ135IPmpEvalS1B1_I.flgUp0Z1Strtd UEGO_CJ135IPmpEvalS1B1_I.flgUp0Z2Strtd UEGO_CJ135IPmpEvalS1B1_I.flgfacCrvCorrnVld UEGO_CJ135IPmpEvalS1B1_I.iIPmpBoostd UEGO_CJ135IPmpEvalS1B1_I.iIPmpDeltaPac UEGO_CJ135IPmpEvalS1B1_I.iIPmpElecCorrd UEGO_CJ135IPmpEvalS1B1_I.iIPmpPacAvrg UEGO_CJ135IPmpEvalS1B1_I.iIPmpRawLst UEGO_CJ135IPmpEvalS1B1_I.iIPmpRef UEGO_CJ135IPmpEvalS1B1_I.iIPmpRefCorrn UEGO_CJ135IPmpEvalS1B1_I.iIPmpSegAvrg UEGO_CJ135IPmpEvalS1B1_I.iIPmpSegAvrgWoCrvCorrn UEGO_CJ135IPmpEvalS1B1_I.iIPmpSegPartSumAry UEGO_CJ135IPmpEvalS1B1_I.iIPmpSegSum UEGO_CJ135IPmpEvalS1B1_I.iIPmpSegWoCrvCorrn UEGO_CJ135IPmpEvalS1B1_I.iIPmpSmotngBoostd UEGO_CJ135IPmpEvalS1B1_I.iIPmpSmotngElecCorrd UEGO_CJ135IPmpEvalS1B1_I.numCntrIPmpLimdPck UEGO_CJ135IPmpEvalS1B1_I.numCtrSegPartSumAry UEGO_CJ135IPmpEvalS1B1_I.numRefPatSet UEGO_CJ135IPmpEvalS1B1_I.numSegPartMax UEGO_CJ135IPmpEvalS1B1_I.numSegPartPosCurr UEGO_CJ135IPmpEvalS1B1_I.ratIPmpAvrg UEGO_CJ135IPmpEvalS1B1_I.resRCrv UEGO_CJ135IPmpEvalS1B1_I.resRRef UEGO_CJ135IPmpEvalS1B1_I.resRSerl UEGO_CJ135IPmpEvalS1B1_I.stDSQIPmp UEGO_CJ135IPmpEvalS1B1_I.stIPmpOK UEGO_CJ135IPmpEvalS1B1_I.stUPmpCtrlCurr UEGO_CJ135IPmpEvalS1B1_I.tiSegPart UEGO_CJ135IPmpEvalS1B1_I.uGk UEGO_CJ135IPmpEvalS1B1_I.uIpcal UEGO_CJ135IPmpEvalS1B1_I.uUlsf UEGO_CJ135IPmpEvalS1B1_I.uUn0PacAvrgLst UEGO_CJ135IPmpEvalS1B1_I.uUn0PacFil UEGO_CJ135IPmpEvalS1B1_I.uUn0PacFilLst UEGO_CJ135IPmpEvalS1B1_I.uUp0Fild UEGO_CJ135IPmpEvalS1B1_I.uUp0PacAvrg UEGO_CJ135IPmpEvalS1B1_I.uUp0PacAvrgPrev UEGO_CJ135IPmpEvalS1B1_I.uUp0SegSum UEGO_CJ135IPmpEvalS1B1_I.DsbcActvd1TOFFVNM_I.time UEGO_CJ135IPmpEvalS1B1_I.DsbcActvd4TOFFV_I.outbit UEGO_CJ135IPmpEvalS1B1_I.DsbcActvd4TOFFV_I.time UEGO_CJ135IPmpEvalS1B1_I.FltuUgaZ1ElecCor_DL_I.memory UEGO_CJ135IPmpEvalS1B1_I.FltuUgaZ2ElecCor_DL_I.memory UEGO_CJ135IPmpEvalS1B1_I.FltuUgiZ1ElecCor_DL_I.memory UEGO_CJ135IPmpEvalS1B1_I.FltuUgiZ2ElecCor_DL_I.memory UEGO_CJ135IPmpEvalS1B1_I.IPmpCtrlActvnTONVNM_I.time UEGO_CJ135IPmpEvalS1B1_I.IPmpCtrlBlcknOffTONVNM_I.time UEGO_CJ135IPmpEvalS1B1_I.ModNotNormalERNM_I.oldSignal UEGO_CJ135IPmpEvalS1B1_I.RCmpFltDL_I.memory UEGO_CJ135IPmpEvalS1B1_I.RParlFltDL_I.memory UEGO_CJ135IPmpEvalS1B1_I.SteerpatChngdTOFFVNM_I.time UEGO_CJ135IPmpEvalS1B1_I.TM2ROscnTONVNM_I.time UEGO_CJ135IPmpEvalS1B1_I.UBattRngVldTOFFVNM_I.time UEGO_CJ135IPmpEvalS1B1_I.UEGO_Cj135IPmp15VectDL_I.memory0 UEGO_CJ135IPmpEvalS1B1_I.UEGO_Cj135IPmp15VectDL_I.memory1 UEGO_CJ135IPmpEvalS1B1_I.UEGO_Cj135IPmp15VectDL_I.memory10 UEGO_CJ135IPmpEvalS1B1_I.UEGO_Cj135IPmp15VectDL_I.memory11 UEGO_CJ135IPmpEvalS1B1_I.UEGO_Cj135IPmp15VectDL_I.memory12 UEGO_CJ135IPmpEvalS1B1_I.UEGO_Cj135IPmp15VectDL_I.memory13 UEGO_CJ135IPmpEvalS1B1_I.UEGO_Cj135IPmp15VectDL_I.memory14 UEGO_CJ135IPmpEvalS1B1_I.UEGO_Cj135IPmp15VectDL_I.memory2 UEGO_CJ135IPmpEvalS1B1_I.UEGO_Cj135IPmp15VectDL_I.memory3 UEGO_CJ135IPmpEvalS1B1_I.UEGO_Cj135IPmp15VectDL_I.memory4 UEGO_CJ135IPmpEvalS1B1_I.UEGO_Cj135IPmp15VectDL_I.memory5 UEGO_CJ135IPmpEvalS1B1_I.UEGO_Cj135IPmp15VectDL_I.memory6 UEGO_CJ135IPmpEvalS1B1_I.UEGO_Cj135IPmp15VectDL_I.memory7 UEGO_CJ135IPmpEvalS1B1_I.UEGO_Cj135IPmp15VectDL_I.memory8 UEGO_CJ135IPmpEvalS1B1_I.UEGO_Cj135IPmp15VectDL_I.memory9 UEGO_CJ135IPmpEvalS1B1_I.flgIPmpVldTOFFVNM_I.time UEGO_CJ135IPmpEvalS1B1_I.flgIPmpVldTONVNM_I.time UEGO_CJ135IPmpEvalS1B1_I.iIPmpRawAvrg_DL_I.memory UEGO_CJ135IPmpEvalS1B1_I.iIPmpSegAvrgWoCrvCorrn_DL_I.memory UEGO_CJ135IPmpEvalS1B1_I.iIPmpSegAvrg_DL_I.memory UEGO_CJ135IPmpEvalS1B1_I.uUp0RawFlt_DL_I.memory UEGO_CJ135IPmpEvalS1B1_I.uUp0Z0Flt_DL_I.memory UEGO_CJ135IPmpEvalS1B1_I.uUp0Z1Flt_DL_I.memory UEGO_CJ135IPmpEvalS1B1_I.uUp0Z2Flt_DL_I.memory /end LOC_MEASUREMENT
 FUNCTION_VERSION "4.12.0" /end FUNCTION
/begin COMPU_METHOD B_TRUE "" TAB_VERB "%6.3" "" COMPU_TAB_REF B_TRUE /end COMPU_METHOD
/begin COMPU_VTAB B_TRUE "" TAB_VERB 2 0 "FALSE" 1 "TRUE" /end COMPU_VTAB
/begin COMPU_METHOD c_q1Em7_F "" RAT_FUNC "%10.9" "F" COEFFS 0 10000000 0 0 0 1 /end COMPU_METHOD
/begin COMPU_METHOD dez "" RAT_FUNC "%6.2" "" COEFFS 0 1 0 0 0 1 /end COMPU_METHOD
/begin COMPU_METHOD fak_q0p125 "" RAT_FUNC "%6.3" "-" COEFFS 0 1 0 0 0 0.125 /end COMPU_METHOD
/begin COMPU_METHOD fak_q1p201Em4 "" RAT_FUNC "%6.5" "-" COEFFS 0 8325 0 0 0 1 /end COMPU_METHOD
/begin COMPU_METHOD fak_q1p8329Em9 "" RAT_FUNC "%11.10" "-" COEFFS 0 545587200 0 0 0 1 /end COMPU_METHOD
/begin COMPU_METHOD fak_uw_b1 "" RAT_FUNC "%7.6" "-" COEFFS 0 65536 0 0 0 1 /end COMPU_METHOD
/begin COMPU_METHOD fak_uw_b2 "" RAT_FUNC "%7.6" "-" COEFFS 0 65536 0 0 0 2 /end COMPU_METHOD
/begin COMPU_METHOD i_q6p6667Em7_A "" RAT_FUNC "%9.8" "A" COEFFS 0 1500000 0 0 0 1 /end COMPU_METHOD
/begin COMPU_METHOD i_q6p667Em8_A "" RAT_FUNC "%10.9" "A" COEFFS 0 15000000 0 0 0 1 /end COMPU_METHOD
/begin COMPU_METHOD OneToOne "" RAT_FUNC "%6.2" "-" COEFFS 0 1 0 0 0 1 /end COMPU_METHOD
/begin COMPU_METHOD q6p104Em5_DIV_V "" RAT_FUNC "%7.6" "1/V" COEFFS 0 65536 0 0 0 4 /end COMPU_METHOD
/begin COMPU_METHOD RBPtCel_ti_8p3333em5_1 "" RAT_FUNC "%7.6" "s" COEFFS 0 12000 0 0 0 1 /end COMPU_METHOD
/begin COMPU_METHOD r_q0p1_Ohm "" RAT_FUNC "%6.3" "Ohm" COEFFS 0 10 0 0 0 1 /end COMPU_METHOD
/begin COMPU_METHOD r_q1p5259Em6_Ohm "" RAT_FUNC "%8.7" "Ohm" COEFFS 0 655360 0 0 0 1 /end COMPU_METHOD
/begin COMPU_METHOD spg_q2p3842Em7_V "" RAT_FUNC "%9.8" "V" COEFFS 0 4194304 0 0 0 1 /end COMPU_METHOD
/begin COMPU_METHOD spg_q3p2Em4_V "" RAT_FUNC "%6.5" "V" COEFFS 0 32768 0 0 0 10.48576 /end COMPU_METHOD
/begin COMPU_METHOD spg_q3p638Em12_V "" RAT_FUNC "%14.13" "V" COEFFS 0 274877906944 0 0 0 1 /end COMPU_METHOD
/begin COMPU_METHOD spg_q4p883Em9_V "" RAT_FUNC "%11.10" "V" COEFFS 0 204800000 0 0 0 1 /end COMPU_METHOD
/begin COMPU_METHOD t_q0p000001_s "" RAT_FUNC "%9.8" "s" COEFFS 0 1000000 0 0 0 1 /end COMPU_METHOD
/begin COMPU_METHOD t_q0p001 "" RAT_FUNC "%6.5" "s" COEFFS 0 1000 0 0 0 1 /end COMPU_METHOD
/begin COMPU_METHOD t_q0p005 "" RAT_FUNC "%6.4" "s" COEFFS 0 1000 0 0 0 5 /end COMPU_METHOD
/begin COMPU_METHOD t_q0p01 "" RAT_FUNC "%6.4" "s" COEFFS 0 100 0 0 0 1 /end COMPU_METHOD
/begin COMPU_METHOD t_q6p6666Em4 "" RAT_FUNC "%6.5" "s" COEFFS 0 1500 0 0 0 1 /end COMPU_METHOD
/begin COMPU_METHOD UART_SY_Compu "" TAB_VERB "%6.3" "" COMPU_TAB_REF UART_SY_Compu /end COMPU_METHOD
/begin COMPU_VTAB UART_SY_Compu "" TAB_VERB 2 0 "UART not used" 1 "UART used" /end COMPU_VTAB
/begin COMPU_METHOD UBFAILSRC_SY_Compu "" TAB_VERB "%6.3" "" COMPU_TAB_REF UBFAILSRC_SY_Compu /end COMPU_METHOD
/begin COMPU_VTAB UBFAILSRC_SY_Compu "" TAB_VERB 2 0 "NONE" 1 "PWRSPLYCHIP" /end COMPU_VTAB
/begin COMPU_METHOD UCATDST2_TYPAVL_SC_Compu "" TAB_VERB "%6.3" "" COMPU_TAB_REF UCATDST2_TYPAVL_SC_Compu /end COMPU_METHOD
/begin COMPU_VTAB UCATDST2_TYPAVL_SC_Compu "" TAB_VERB 2 0 "False" 1 "True" /end COMPU_VTAB
/begin COMPU_METHOD UCATDST_TYPAVL_SC_Compu "" TAB_VERB "%6.3" "" COMPU_TAB_REF UCATDST_TYPAVL_SC_Compu /end COMPU_METHOD
/begin COMPU_VTAB UCATDST_TYPAVL_SC_Compu "" TAB_VERB 2 0 "False" 1 "True" /end COMPU_VTAB
/begin COMPU_METHOD UCATUST2_TYPAVL_SC_Compu "" TAB_VERB "%6.3" "" COMPU_TAB_REF UCATUST2_TYPAVL_SC_Compu /end COMPU_METHOD
/begin COMPU_VTAB UCATUST2_TYPAVL_SC_Compu "" TAB_VERB 2 0 "False" 1 "True" /end COMPU_VTAB
/begin COMPU_METHOD UCATUST_TYPAVL_SC_Compu "" TAB_VERB "%6.3" "" COMPU_TAB_REF UCATUST_TYPAVL_SC_Compu /end COMPU_METHOD
/begin COMPU_VTAB UCATUST_TYPAVL_SC_Compu "" TAB_VERB 2 0 "False" 1 "True" /end COMPU_VTAB
/begin COMPU_METHOD UEGOHEATRTSTRCTRL_SC_Compu "" TAB_VERB "%6.3" "" COMPU_TAB_REF UEGOHEATRTSTRCTRL_SC_Compu /end COMPU_METHOD
/begin COMPU_VTAB UEGOHEATRTSTRCTRL_SC_Compu "" TAB_VERB 2 0 "False" 1 "True" /end COMPU_VTAB
/begin COMPU_METHOD UEGO_ASICSTEP_SC_Compu "" TAB_VERB "%6.3" "" COMPU_TAB_REF UEGO_ASICSTEP_SC_Compu /end COMPU_METHOD
/begin COMPU_VTAB UEGO_ASICSTEP_SC_Compu "" TAB_VERB 5 0 "None" 1 "CJ135BA" 2 "CJ135CA" 3 "CJ135DA" 4 "CJ135EA" /end COMPU_VTAB
/begin COMPU_METHOD UEGO_BNKSPCLAMCORRN_SC_Compu "" TAB_VERB "%6.3" "" COMPU_TAB_REF UEGO_BNKSPCLAMCORRN_SC_Compu /end COMPU_METHOD
/begin COMPU_VTAB UEGO_BNKSPCLAMCORRN_SC_Compu "" TAB_VERB 2 0 "False" 1 "True" /end COMPU_VTAB
/begin COMPU_METHOD UEGO_CALREDN_SC_Compu "" TAB_VERB "%6.3" "" COMPU_TAB_REF UEGO_CALREDN_SC_Compu /end COMPU_METHOD
/begin COMPU_VTAB UEGO_CALREDN_SC_Compu "" TAB_VERB 2 0 "No Reduction" 1 "Reduction" /end COMPU_VTAB
/begin COMPU_METHOD UEGO_CIPEADPNENA_SC_Compu "" TAB_VERB "%6.3" "" COMPU_TAB_REF UEGO_CIPEADPNENA_SC_Compu /end COMPU_METHOD
/begin COMPU_VTAB UEGO_CIPEADPNENA_SC_Compu "" TAB_VERB 2 0 "Deactivate" 1 "Activate" /end COMPU_VTAB
/begin COMPU_METHOD UEGO_CJ135DiagWireClass_sm_VERB "" TAB_VERB "%6.3" "" COMPU_TAB_REF UEGO_CJ135DiagWireClass_sm_VERB /end COMPU_METHOD
/begin COMPU_VTAB UEGO_CJ135DiagWireClass_sm_VERB "" TAB_VERB 13 0 "LOCKED_OPERATION" 1 "DIAGNOSIS_IDLE" 10 "REGULAR_WARMUP" 11 "DIAGNOSIS_OPERATION" 12 "REGULAR_OPERATION" 2 "DIAGNOSIS_IDLE_INTERMEDIATE" 3 "DIAGNOSIS_NORMAL1" 4 "DIAGNOSIS_SWITCHON" 5 "DIAGNOSIS_SWITCHON_SHORT" 6 "DIAGNOSIS_WARMUP" 7 "REGULAR_IDLE" 8 "REGULAR_NORMAL" 9 "REGULAR_SWITCHON" /end COMPU_VTAB
/begin COMPU_METHOD UEGO_CJ135IPMPOFFSIDN_SC_Compu "" TAB_VERB "%6.3" "" COMPU_TAB_REF UEGO_CJ135IPMPOFFSIDN_SC_Compu /end COMPU_METHOD
/begin COMPU_VTAB UEGO_CJ135IPMPOFFSIDN_SC_Compu "" TAB_VERB 2 0 "False" 1 "True" /end COMPU_VTAB
/begin COMPU_METHOD UEGO_DATAVISDENSOPLUS51_SC_Compu "" TAB_VERB "%6.3" "" COMPU_TAB_REF UEGO_DATAVISDENSOPLUS51_SC_Compu /end COMPU_METHOD
/begin COMPU_VTAB UEGO_DATAVISDENSOPLUS51_SC_Compu "" TAB_VERB 2 0 "Invisible" 1 "Visible" /end COMPU_VTAB
/begin COMPU_METHOD UEGO_DATAVISDENSOPLUS61_SC_Compu "" TAB_VERB "%6.3" "" COMPU_TAB_REF UEGO_DATAVISDENSOPLUS61_SC_Compu /end COMPU_METHOD
/begin COMPU_VTAB UEGO_DATAVISDENSOPLUS61_SC_Compu "" TAB_VERB 2 0 "Invisible" 1 "Visible" /end COMPU_VTAB
/begin COMPU_METHOD UEGO_DATAVISLSU49TSP_SC_Compu "" TAB_VERB "%6.3" "" COMPU_TAB_REF UEGO_DATAVISLSU49TSP_SC_Compu /end COMPU_METHOD
/begin COMPU_VTAB UEGO_DATAVISLSU49TSP_SC_Compu "" TAB_VERB 2 0 "Invisible" 1 "Visible" /end COMPU_VTAB
/begin COMPU_METHOD UEGO_DATAVISLSU49_SC_Compu "" TAB_VERB "%6.3" "" COMPU_TAB_REF UEGO_DATAVISLSU49_SC_Compu /end COMPU_METHOD
/begin COMPU_VTAB UEGO_DATAVISLSU49_SC_Compu "" TAB_VERB 2 0 "Invisible" 1 "Visible" /end COMPU_VTAB
/begin RECORD_LAYOUT RB_Curve_U8_U8 NO_AXIS_PTS_X 1 UBYTE AXIS_PTS_X 2 UBYTE INDEX_INCR DIRECT FNC_VALUES 3 UBYTE COLUMN_DIR DIRECT /end RECORD_LAYOUT
/begin RECORD_LAYOUT RB_Val_Ws16 FNC_VALUES 1 SWORD COLUMN_DIR DIRECT /end RECORD_LAYOUT
/begin RECORD_LAYOUT RB_Val_Ws8 FNC_VALUES 1 SBYTE COLUMN_DIR DIRECT /end RECORD_LAYOUT
/begin RECORD_LAYOUT RB_Val_Wu16 FNC_VALUES 1 UWORD COLUMN_DIR DIRECT /end RECORD_LAYOUT
/begin RECORD_LAYOUT RB_Val_Wu8 FNC_VALUES 1 UBYTE COLUMN_DIR DIRECT /end RECORD_LAYOUT
/end MODULE
/end PROJECT
