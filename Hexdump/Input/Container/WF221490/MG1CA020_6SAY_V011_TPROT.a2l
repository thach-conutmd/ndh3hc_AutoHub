ASAP2_VERSION 1 60
/begin PROJECT MG1CA020 "MG1CA020"
/begin HEADER "" VERSION "MG1CA020_6SAY_V011_TPROT" PROJECT_NO MG1CA020 /end HEADER
/begin MODULE DIM ""
/begin MOD_PAR "MG1CA020" VERSION "MG1CA020_6SAY_V011_TPROT" ADDR_EPK 0x804D8228 EPK "51/1/MDG1/159/MG1CA020//MG1CA020_6SAY_V011_TPROT///" CUSTOMER_NO "159" USER "APPLICATOR" PHONE_NO "" ECU "MDG1" CPU_TYPE "IFX"
 SYSTEM_CONSTANT "SY_GDIPFI" "0"
 SYSTEM_CONSTANT "SY_GP" "0"
 SYSTEM_CONSTANT "SY_GRDWOF" "0"
 SYSTEM_CONSTANT "SY_GRDWRT" "120"
 SYSTEM_CONSTANT "SY_H2COHK" "0"
 SYSTEM_CONSTANT "SY_HDP" "0"
 SYSTEM_CONSTANT "SY_HDST" "0"
 SYSTEM_CONSTANT "SY_HEV" "0"
 SYSTEM_CONSTANT "SY_HFM" "0"
 SYSTEM_CONSTANT "SY_HFM2" "0"
 SYSTEM_CONSTANT "SY_HFMFIL" "0"
 SYSTEM_CONSTANT "SY_HFMKOMP" "0"
 SYSTEM_CONSTANT "SY_HFMPANZ" "0"
 SYSTEM_CONSTANT "SY_HFM_ANZKL" "0"
 SYSTEM_CONSTANT "SY_HKS" "0"
 SYSTEM_CONSTANT "SY_HLSHRTP" "0"
 SYSTEM_CONSTANT "SY_HMB" "0"
 SYSTEM_CONSTANT "SY_HMBMBA" "0"
 SYSTEM_CONSTANT "SY_HMM" "0"
 SYSTEM_CONSTANT "SY_HOS" "0"
 SYSTEM_CONSTANT "SY_HSG" "0"
 SYSTEM_CONSTANT "SY_HSP" "0"
 SYSTEM_CONSTANT "SY_HSPMD" "0"
 SYSTEM_CONSTANT "SY_HSPNWS" "0"
 SYSTEM_CONSTANT "SY_IATPS11" "1"
 SYSTEM_CONSTANT "SY_IATPS12" "2"
 SYSTEM_CONSTANT "SY_IATPS13" "0"
 SYSTEM_CONSTANT "SY_IATPS21" "0"
 SYSTEM_CONSTANT "SY_IATPS22" "0"
 SYSTEM_CONSTANT "SY_IATPS23" "0"
 SYSTEM_CONSTANT "SY_IFOTMEN" "0"
 SYSTEM_CONSTANT "SY_IFTCWRP" "0"
 SYSTEM_CONSTANT "SY_IGIFLAG" "0"
 SYSTEM_CONSTANT "SY_INHIBIT" "2"
 SYSTEM_CONSTANT "SY_INI_OBD" "5"
 SYSTEM_CONSTANT "SY_INJADKM" "0"
 SYSTEM_CONSTANT "SY_IPRCRSH" "0"
 SYSTEM_CONSTANT "SY_ISG" "0"
 SYSTEM_CONSTANT "SY_IUMPR" "1"
 SYSTEM_CONSTANT "SY_KDHFM" "0"
 SYSTEM_CONSTANT "SY_KDS" "0"
 SYSTEM_CONSTANT "SY_KFLRA" "0"
 SYSTEM_CONSTANT "SY_KHETA" "1"
 SYSTEM_CONSTANT "SY_KHTMSFH" "0"
 SYSTEM_CONSTANT "SY_KJ" "0"
 SYSTEM_CONSTANT "SY_KOLBSC" "0"
 SYSTEM_CONSTANT "SY_KONWDK" "0"
 SYSTEM_CONSTANT "SY_KOP" "0"
 SYSTEM_CONSTANT "SY_KORRZ" "1"
 SYSTEM_CONSTANT "SY_KRADPZI" "0"
 SYSTEM_CONSTANT "SY_KRK" "0"
 SYSTEM_CONSTANT "SY_KRLZ" "1"
 SYSTEM_CONSTANT "SY_KRSAINT" "0"
 SYSTEM_CONSTANT "SY_KRSASW" "1"
 SYSTEM_CONSTANT "SY_KRZMF" "0"
 SYSTEM_CONSTANT "SY_KS1" "0"
 SYSTEM_CONSTANT "SY_KS2" "1"
 SYSTEM_CONSTANT "SY_KS3" "1"
 SYSTEM_CONSTANT "SY_KS4" "1"
 SYSTEM_CONSTANT "SY_KSENCHN" "1"
 SYSTEM_CONSTANT "SY_KSENFLT" "5"
 SYSTEM_CONSTANT "SY_KSZA" "1"
 SYSTEM_CONSTANT "SY_KT" "0"
 SYSTEM_CONSTANT "SY_KUPOT" "0"
 SYSTEM_CONSTANT "SY_KWFOSC" "0"
 SYSTEM_CONSTANT "SY_LAMKAPP" "0"
 SYSTEM_CONSTANT "SY_LAMNSWLP" "0"
 SYSTEM_CONSTANT "SY_LAYER" "0"
 SYSTEM_CONSTANT "SY_LBK" "0"
 SYSTEM_CONSTANT "SY_LBKMD" "0"
 SYSTEM_CONSTANT "SY_LCSS" "0"
 SYSTEM_CONSTANT "SY_LEITMOD" "0"
 SYSTEM_CONSTANT "SY_LENKH" "0"
 SYSTEM_CONSTANT "SY_LF2B" "0"
 SYSTEM_CONSTANT "SY_LLKEO" "0"
 SYSTEM_CONSTANT "SY_LOWRA" "0"
 SYSTEM_CONSTANT "SY_LPG" "0"
 SYSTEM_CONSTANT "SY_LPI" "0"
 SYSTEM_CONSTANT "SY_LR2PAR" "0"
 SYSTEM_CONSTANT "SY_LRAT" "0"
 SYSTEM_CONSTANT "SY_LRATKG" "0"
 SYSTEM_CONSTANT "SY_LREBPS" "0"
 SYSTEM_CONSTANT "SY_LRFK" "0"
 SYSTEM_CONSTANT "SY_LRFK2" "0"
 SYSTEM_CONSTANT "SY_LRFKEF" "0"
 SYSTEM_CONSTANT "SY_LRSEZ" "0"
 SYSTEM_CONSTANT "SY_LS" "0"
 SYSTEM_CONSTANT "SY_LSAGETR" "0"
 SYSTEM_CONSTANT "SY_LSFIKR" "0"
 SYSTEM_CONSTANT "SY_LSFIKR2" "0"
 SYSTEM_CONSTANT "SY_LSFNHK" "1"
 SYSTEM_CONSTANT "SY_LSFNHK2" "0"
 SYSTEM_CONSTANT "SY_LSFNTL" "0"
 SYSTEM_CONSTANT "SY_LSFNTL2" "0"
 SYSTEM_CONSTANT "SY_LSFNVK" "0"
 SYSTEM_CONSTANT "SY_LSFNVK2" "0"
 SYSTEM_CONSTANT "SY_LSFV" "0"
 SYSTEM_CONSTANT "SY_LSFVHK" "0"
 SYSTEM_CONSTANT "SY_LSFVHK2" "0"
 SYSTEM_CONSTANT "SY_LSFVVK" "0"
 SYSTEM_CONSTANT "SY_LSFVVK2" "0"
 SYSTEM_CONSTANT "SY_LSHV" "0"
 SYSTEM_CONSTANT "SY_LSUIKR" "1"
 SYSTEM_CONSTANT "SY_LSUIKR2" "0"
 SYSTEM_CONSTANT "SY_LSUMRS" "0"
 SYSTEM_CONSTANT "SY_LSUNHK" "0"
 SYSTEM_CONSTANT "SY_LSUNHK2" "0"
 SYSTEM_CONSTANT "SY_LSUNTL" "0"
 SYSTEM_CONSTANT "SY_LSUNTL2" "0"
 SYSTEM_CONSTANT "SY_LSUNVK" "0"
 SYSTEM_CONSTANT "SY_LSUNVK2" "0"
 SYSTEM_CONSTANT "SY_LSUSTA" "0"
 SYSTEM_CONSTANT "SY_LSUVHK" "0"
 SYSTEM_CONSTANT "SY_LSUVHK2" "0"
 SYSTEM_CONSTANT "SY_LSUVVK" "0"
 SYSTEM_CONSTANT "SY_LSUVVK2" "0"
 SYSTEM_CONSTANT "SY_LSVV" "0"
 SYSTEM_CONSTANT "SY_LSZYVER" "0"
 SYSTEM_CONSTANT "SY_LUFAK" "140.7374884"
 SYSTEM_CONSTANT "SY_LUSRKR" "0"
 SYSTEM_CONSTANT "SY_LWMEXT" "0"
 SYSTEM_CONSTANT "SY_M8TE" "0"
 SYSTEM_CONSTANT "SY_MAGER" "0"
 SYSTEM_CONSTANT "SY_MDBGHS" "0"
 SYSTEM_CONSTANT "SY_MDBGTI" "0"
 SYSTEM_CONSTANT "SY_MDI" "0"
 SYSTEM_CONSTANT "SY_MDISTM" "0"
 SYSTEM_CONSTANT "SY_MDMXEXC" "1"
 SYSTEM_CONSTANT "SY_MDSRL" "0"
 SYSTEM_CONSTANT "SY_MEVD172" "0"
 SYSTEM_CONSTANT "SY_MPM" "0"
 SYSTEM_CONSTANT "SY_MSDKN" "0"
 SYSTEM_CONSTANT "SY_MSGRED" "0"
 SYSTEM_CONSTANT "SY_MSVKOMP" "0"
 SYSTEM_CONSTANT "SY_MTRXBLR" "0"
 SYSTEM_CONSTANT "SY_MULCATI" "0"
 SYSTEM_CONSTANT "SY_NG" "0"
 SYSTEM_CONSTANT "SY_NLLKHFH" "0"
 SYSTEM_CONSTANT "SY_NLZOFF" "0"
 SYSTEM_CONSTANT "SY_NOHK" "0"
 SYSTEM_CONSTANT "SY_NOKT" "0"
 SYSTEM_CONSTANT "SY_NOXKAT" "0"
 SYSTEM_CONSTANT "SY_NOXKAT2" "0"
 SYSTEM_CONSTANT "SY_NSAC" "0"
 SYSTEM_CONSTANT "SY_NSAD" "1"
 SYSTEM_CONSTANT "SY_NSALT" "0"
 SYSTEM_CONSTANT "SY_NSASG" "0"
 SYSTEM_CONSTANT "SY_NSBLP" "1"
 SYSTEM_CONSTANT "SY_NSCAM" "0"
 SYSTEM_CONSTANT "SY_NSCAT" "1"
 SYSTEM_CONSTANT "SY_NSCDE" "0"
 SYSTEM_CONSTANT "SY_NSCRP" "0"
 SYSTEM_CONSTANT "SY_NSCVT" "0"
 SYSTEM_CONSTANT "SY_NSFLX" "0"
 SYSTEM_CONSTANT "SY_NSGEN" "0"
 SYSTEM_CONSTANT "SY_NSHTD" "0"
 SYSTEM_CONSTANT "SY_NSHTI" "1"
 SYSTEM_CONSTANT "SY_NSKO" "0"
 SYSTEM_CONSTANT "SY_NSLPH" "2"
 SYSTEM_CONSTANT "SY_NSLWR" "0"
 SYSTEM_CONSTANT "SY_NSP" "0"
 SYSTEM_CONSTANT "SY_NSPST" "0"
 SYSTEM_CONSTANT "SY_NSPTS" "1"
 SYSTEM_CONSTANT "SY_NSPWG" "0"
 SYSTEM_CONSTANT "SY_NSREC" "0"
 SYSTEM_CONSTANT "SY_NSRNG" "0"
 SYSTEM_CONSTANT "SY_NSSTR" "0"
 SYSTEM_CONSTANT "SY_NSTCU" "0"
 SYSTEM_CONSTANT "SY_NSTST" "0"
 SYSTEM_CONSTANT "SY_NSVSP" "0"
 SYSTEM_CONSTANT "SY_NSWIH" "0"
 SYSTEM_CONSTANT "SY_NVLD" "0"
 SYSTEM_CONSTANT "SY_NVRAMBK" "1"
 SYSTEM_CONSTANT "SY_NWFH" "0"
 SYSTEM_CONSTANT "SY_NWGA" "0"
 SYSTEM_CONSTANT "SY_NWGA2" "0"
 SYSTEM_CONSTANT "SY_NWGE" "1"
 SYSTEM_CONSTANT "SY_NWGE2" "0"
 SYSTEM_CONSTANT "SY_NWMSV" "0"
 SYSTEM_CONSTANT "SY_NWS" "0"
 SYSTEM_CONSTANT "SY_NWSA" "0"
 SYSTEM_CONSTANT "SY_NWSHSS" "0"
 SYSTEM_CONSTANT "SY_NWSKR" "0"
 SYSTEM_CONSTANT "SY_NWSV" "0"
 SYSTEM_CONSTANT "SY_OBDBR05" "1"
 SYSTEM_CONSTANT "SY_OBMD" "0"
 SYSTEM_CONSTANT "SY_OSTERST" "1"
 SYSTEM_CONSTANT "SY_OSTNOFF" "0"
 SYSTEM_CONSTANT "SY_OTMERST" "1"
 SYSTEM_CONSTANT "SY_PABMODU" "0"
 SYSTEM_CONSTANT "SY_PAFGBE" "0"
 SYSTEM_CONSTANT "SY_PEMDIA" "0"
 SYSTEM_CONSTANT "SY_PID41" "1"
 SYSTEM_CONSTANT "SY_PLNGFIL" "0"
 SYSTEM_CONSTANT "SY_PSF" "0"
 SYSTEM_CONSTANT "SY_PSMXAPP" "0"
 SYSTEM_CONSTANT "SY_PSR2SYN" "0"
 SYSTEM_CONSTANT "SY_PSTDRST" "0"
 SYSTEM_CONSTANT "SY_PSUV" "0"
 SYSTEM_CONSTANT "SY_PTL" "1"
 SYSTEM_CONSTANT "SY_PTLHC" "1"
 SYSTEM_CONSTANT "SY_PTO" "0"
 SYSTEM_CONSTANT "SY_RDE" "1"
 SYSTEM_CONSTANT "SY_REDEX" "0"
 SYSTEM_CONSTANT "SY_REDMI" "0"
 SYSTEM_CONSTANT "SY_REDSTAR" "0"
 SYSTEM_CONSTANT "SY_RLAPP" "1"
 SYSTEM_CONSTANT "SY_RLMXKV" "0"
 SYSTEM_CONSTANT "SY_RLRK" "1"
 SYSTEM_CONSTANT "SY_RLXDZW" "0"
 SYSTEM_CONSTANT "SY_RLXRED" "0"
 SYSTEM_CONSTANT "SY_RLXVD" "0"
 SYSTEM_CONSTANT "SY_RQMNUGA" "0"
 SYSTEM_CONSTANT "SY_RVS" "0"
 SYSTEM_CONSTANT "SY_RZSZ" "0"
 SYSTEM_CONSTANT "SY_SAGS" "0"
 SYSTEM_CONSTANT "SY_SALSU" "0"
 SYSTEM_CONSTANT "SY_SCG" "0"
 SYSTEM_CONSTANT "SY_SCH" "0"
 SYSTEM_CONSTANT "SY_SCHUMZW" "0"
 SYSTEM_CONSTANT "SY_SGANZ" "1"
 SYSTEM_CONSTANT "SY_SGANZFR" "1"
 SYSTEM_CONSTANT "SY_SKH" "0"
 SYSTEM_CONSTANT "SY_SKR" "0"
 SYSTEM_CONSTANT "SY_SLPANZ" "0"
 SYSTEM_CONSTANT "SY_SLS" "0"
 SYSTEM_CONSTANT "SY_SLVANZ" "0"
 SYSTEM_CONSTANT "SY_SLVEST" "0"
 SYSTEM_CONSTANT "SY_SOTUN" "0"
 SYSTEM_CONSTANT "SY_SPRSTRT" "0"
 SYSTEM_CONSTANT "SY_SSPPSR" "2"
 SYSTEM_CONSTANT "SY_STA" "0"
 SYSTEM_CONSTANT "SY_STADAP" "1"
 SYSTEM_CONSTANT "SY_STAEVAB" "0"
 SYSTEM_CONSTANT "SY_STARTDK" "1"
 SYSTEM_CONSTANT "SY_STASTO" "0"
 SYSTEM_CONSTANT "SY_STATIST" "0"
 SYSTEM_CONSTANT "SY_STELRHE" "0"
 SYSTEM_CONSTANT "SY_STERBTS" "0"
 SYSTEM_CONSTANT "SY_STERHK" "0"
 SYSTEM_CONSTANT "SY_STERSY" "0"
 SYSTEM_CONSTANT "SY_STERVK" "0"
 SYSTEM_CONSTANT "SY_STETLR" "1"
 SYSTEM_CONSTANT "SY_SU" "0"
 SYSTEM_CONSTANT "SY_SUV" "0"
 SYSTEM_CONSTANT "SY_SUVTYP" "0"
 SYSTEM_CONSTANT "SY_SVBB" "0"
 SYSTEM_CONSTANT "SY_TAHEVCH" "0"
 SYSTEM_CONSTANT "SY_TAKH" "0"
 SYSTEM_CONSTANT "SY_TANDK" "1"
 SYSTEM_CONSTANT "SY_TANSPOS" "1"
 SYSTEM_CONSTANT "SY_TASR" "1"
 SYSTEM_CONSTANT "SY_TASR2" "0"
 SYSTEM_CONSTANT "SY_TAVDK" "0"
 SYSTEM_CONSTANT "SY_TAVDK2" "0"
 SYSTEM_CONSTANT "SY_TAVV" "0"
 SYSTEM_CONSTANT "SY_TAVVM" "0"
 SYSTEM_CONSTANT "SY_TCACINT" "0"
 SYSTEM_CONSTANT "SY_TCACOUT" "0"
 SYSTEM_CONSTANT "SY_TCBCINT" "0"
 SYSTEM_CONSTANT "SY_TCBCOUT" "0"
 SYSTEM_CONSTANT "SY_TCNS" "0"
 SYSTEM_CONSTANT "SY_TEBF" "0"
 SYSTEM_CONSTANT "SY_TEETH" "36"
 SYSTEM_CONSTANT "SY_TEV5" "0"
 SYSTEM_CONSTANT "SY_TEVANZ" "1"
 SYSTEM_CONSTANT "SY_TFA1GRD" "0"
 SYSTEM_CONSTANT "SY_TFA1W" "0"
 SYSTEM_CONSTANT "SY_TFA2GRD" "0"
 SYSTEM_CONSTANT "SY_TFA2POS" "0"
 SYSTEM_CONSTANT "SY_TFA2W" "0"
 SYSTEM_CONSTANT "SY_TFA3GRD" "0"
 SYSTEM_CONSTANT "SY_TFA3W" "0"
 SYSTEM_CONSTANT "SY_TFA4GRD" "0"
 SYSTEM_CONSTANT "SY_TFAJEC" "0"
 SYSTEM_CONSTANT "SY_TFAKON" "0"
 SYSTEM_CONSTANT "SY_TFAST" "0"
 SYSTEM_CONSTANT "SY_TFATSTR" "1"
 SYSTEM_CONSTANT "SY_TFBA" "0"
 SYSTEM_CONSTANT "SY_TFLTKCD" "0"
 SYSTEM_CONSTANT "SY_TFLTNK" "0"
 SYSTEM_CONSTANT "SY_TFMO" "0"
 SYSTEM_CONSTANT "SY_TFNS" "0"
 SYSTEM_CONSTANT "SY_TFRK" "0"
 SYSTEM_CONSTANT "SY_TFST" "0"
 SYSTEM_CONSTANT "SY_TFUEL" "0"
 SYSTEM_CONSTANT "SY_TFUELCN" "0"
 SYSTEM_CONSTANT "SY_TFVA" "0"
 SYSTEM_CONSTANT "SY_TFWL" "0"
 SYSTEM_CONSTANT "SY_TKA" "1"
 SYSTEM_CONSTANT "SY_TKAA" "0"
 SYSTEM_CONSTANT "SY_TKACSD" "0"
 SYSTEM_CONSTANT "SY_TLRARES" "0"
 SYSTEM_CONSTANT "SY_TMDR" "0"
 SYSTEM_CONSTANT "SY_TMO2KA" "0"
 SYSTEM_CONSTANT "SY_TMOHKS" "0"
 SYSTEM_CONSTANT "SY_TMOHSST" "0"
 SYSTEM_CONSTANT "SY_TMOLAM" "0"
 SYSTEM_CONSTANT "SY_TMOLAMH" "0"
 SYSTEM_CONSTANT "SY_TMOLB" "0"
 SYSTEM_CONSTANT "SY_TMORRI" "0"
 SYSTEM_CONSTANT "SY_TMOTFIL" "1"
 SYSTEM_CONSTANT "SY_TOCH" "1"
 SYSTEM_CONSTANT "SY_TOSP" "1"
 SYSTEM_CONSTANT "SY_TOSPCN" "0"
 SYSTEM_CONSTANT "SY_TOSPMAI" "0"
 SYSTEM_CONSTANT "SY_TPEACNR" "1"
 SYSTEM_CONSTANT "SY_TREDFCO" "0"
 SYSTEM_CONSTANT "SY_TTEV" "1"
 SYSTEM_CONSTANT "SY_TUMG" "2"
 SYSTEM_CONSTANT "SY_TWDKS" "1"
 SYSTEM_CONSTANT "SY_UBDEDIQ" "70"
 SYSTEM_CONSTANT "SY_UBDEDIS" "65"
 SYSTEM_CONSTANT "SY_UBDEEN" "75"
 SYSTEM_CONSTANT "SY_UBDEENQ" "80"
 SYSTEM_CONSTANT "SY_UBR" "1"
 SYSTEM_CONSTANT "SY_UBSQ_W" "965"
 SYSTEM_CONSTANT "SY_VARCODE" "0"
 SYSTEM_CONSTANT "SY_VD" "0"
 SYSTEM_CONSTANT "SY_VDEO" "0"
 SYSTEM_CONSTANT "SY_VHA" "0"
 SYSTEM_CONSTANT "SY_VHAANZ" "0"
 SYSTEM_CONSTANT "SY_VHE" "1"
 SYSTEM_CONSTANT "SY_VHEANZ" "1"
 SYSTEM_CONSTANT "SY_VS" "0"
 SYSTEM_CONSTANT "SY_VVT" "0"
 SYSTEM_CONSTANT "SY_WFP" "0"
 SYSTEM_CONSTANT "SY_WFS" "3"
 SYSTEM_CONSTANT "SY_WGPS" "0"
 SYSTEM_CONSTANT "SY_WMIN" "-34"
 SYSTEM_CONSTANT "SY_WNBM" "6"
 SYSTEM_CONSTANT "SY_WNWADM" "0"
 SYSTEM_CONSTANT "SY_ZAGPATTERNMX" "10"
 SYSTEM_CONSTANT "SY_ZBLRELS" "0"
 SYSTEM_CONSTANT "SY_ZGST" "0"
 SYSTEM_CONSTANT "SY_ZMS" "0"
 SYSTEM_CONSTANT "SY_ZNDAUS" "1"
 SYSTEM_CONSTANT "SY_ZUESTA" "0"
 SYSTEM_CONSTANT "SY_ZYLOFFH" "0"
 SYSTEM_CONSTANT "SY_ZYLOFFS" "0"
 SYSTEM_CONSTANT "SY_ZYLZA" "4"
 SYSTEM_CONSTANT "SY_ZYLZG" "4"
 SYSTEM_CONSTANT "SY_ZZBANK" "0"
 SYSTEM_CONSTANT "SY_ZZBANKB" "0"
 SYSTEM_CONSTANT "SY_ZZHMB" "0"
 SYSTEM_CONSTANT "SY_ZZLAM" "0"
 SYSTEM_CONSTANT "SY_ZZMBA" "0"
 SYSTEM_CONSTANT "SY_ZZRL" "0"
 SYSTEM_CONSTANT "SY_ZZSG" "0"
 SYSTEM_CONSTANT "SY_ZZYLB1" "4"
 SYSTEM_CONSTANT "SY_ZZYLB2" "0"
 SYSTEM_CONSTANT "T15RAWDSQENA_SC" "0"
 SYSTEM_CONSTANT "T15_DBGMD_VD_SY" "0"
 SYSTEM_CONSTANT "T15_ON_VLDT_COM_SY" "0"
 SYSTEM_CONSTANT "T15_WKDETN_SC" "0"
 SYSTEM_CONSTANT "T50_ATS_SY" "0"
 SYSTEM_CONSTANT "T50_STRTREQRST_BP" "1"
 SYSTEM_CONSTANT "T50_STRTREQ_BP" "0"
 SYSTEM_CONSTANT "T50_T50RET_BP" "0"
 SYSTEM_CONSTANT "T87_MON_SY" "0"
 SYSTEM_CONSTANT "TAIRCMPRDSMDL_SC" "0"
 SYSTEM_CONSTANT "TBLOWBYHEATR_TYPAVL_SC" "0"
 SYSTEM_CONSTANT "TCAT2DMDL_SC" "0"
 SYSTEM_CONSTANT "TCE_FCOEXTD_SC" "0"
 SYSTEM_CONSTANT "TCLNTDSPLSNSRPRSNT_SC" "0"
 SYSTEM_CONSTANT "TCSOVRDSTSCINC_SY" "1"
 SYSTEM_CONSTANT "TDC_ADAP_SY" "0"
 SYSTEM_CONSTANT "TDC_UNEQLGEOM_SY" "0"
 SYSTEM_CONSTANT "TDEV_DSQACTVT_SC" "0"
 SYSTEM_CONSTANT "TDPDTCPVCTRL_SC" "1"
 SYSTEM_CONSTANT "TECU_SMP480SENSPRS_SC" "1"
 SYSTEM_CONSTANT "TECU_TMSGFMT_SC" "1"
 SYSTEM_CONSTANT "TEGMOD_HEATFLOWKW_RES" "100000"
 SYSTEM_CONSTANT "TEGMOD_HEATFLOW_INTER_RES" "360"
 SYSTEM_CONSTANT "TEGMOD_HEATKJ_RES" "100"
 SYSTEM_CONSTANT "TEGMOD_INTER_RES" "1"
 SYSTEM_CONSTANT "TEGRCLR2DS_TYPAVL_SY" "0"
 SYSTEM_CONSTANT "TEGRCLRDS_TYPAVL_SY" "0"
 SYSTEM_CONSTANT "TEGRCLRLPDS_TYPAVL_SC" "1"
 SYSTEM_CONSTANT "TEGRCLRUS_TYPAVL_SY" "0"
 SYSTEM_CONSTANT "TEGRPIPUSSENS_SC" "0"
 SYSTEM_CONSTANT "TEGRVLVHOTDS_TYPAVL_SC" "0"
 SYSTEM_CONSTANT "TEMPCELS_ZERO" "0"
 SYSTEM_CONSTANT "TEMP_20_CELS" "20"
 SYSTEM_CONSTANT "TEMP_CELS_1200" "1200"
 SYSTEM_CONSTANT "TEMP_CELS_150" "150"
 SYSTEM_CONSTANT "TEMP_CELS_1500" "1500"
 SYSTEM_CONSTANT "TEMP_CELS_MAX" "3003.56"
 SYSTEM_CONSTANT "TEMP_CELS_MIN" "-3549.94"
 SYSTEM_CONSTANT "TEMP_CELS_M_100" "-100"
 SYSTEM_CONSTANT "TEMP_CELS_M_200" "-200"
 SYSTEM_CONSTANT "TEMP_DEFECT" "1"
 SYSTEM_CONSTANT "TEMP_KELV_1000" "1000"
 SYSTEM_CONSTANT "TEMP_KELV_1200" "1200"
 SYSTEM_CONSTANT "TEMP_KELV_M_1000" "-1000"
 SYSTEM_CONSTANT "TEMP_KELV_M_200" "-200"
 SYSTEM_CONSTANT "TFFVRES_SC" "0"
 SYSTEM_CONSTANT "THDEV_MAISWTAC_CAN" "1"
 SYSTEM_CONSTANT "THDEV_MAISWTAC_COD" "2"
 SYSTEM_CONSTANT "THDEV_MAISWTAC_DIO" "0"
 SYSTEM_CONSTANT "THDFACOPMODEMAXSIZE" "10"
 SYSTEM_CONSTANT "THERMCOORNENGTQRESVENA_SC" "0"
 SYSTEM_CONSTANT "THROVRHEATGPROTN_SC" "0"
 SYSTEM_CONSTANT "THRVLVAIRACTR_SC" "1"
 SYSTEM_CONSTANT "THRVLVCONTMN_SC" "1"
 SYSTEM_CONSTANT "THRVLVI_TYPAVL_SC" "0"
 SYSTEM_CONSTANT "THRVLVLP_AIRACTR_SC" "0"
 SYSTEM_CONSTANT "THRVLVLP_ATSENA_SC" "0"
 SYSTEM_CONSTANT "THRVLVPROD_SY" "0"
 SYSTEM_CONSTANT "THRVLVSNGSNSR_SC" "0"
 SYSTEM_CONSTANT "THRVLVUST_TYPAVL_SC" "0"
 SYSTEM_CONSTANT "THRVLV_AGLIMDAMON_SC" "0"
 SYSTEM_CONSTANT "THRVLV_ATSENA_SC" "1"
 SYSTEM_CONSTANT "THRVLV_BLDCMOT_SC" "0"
 SYSTEM_CONSTANT "THRVLV_CLNVRFY_SY" "0"
 SYSTEM_CONSTANT "THRVLV_DCMOT_SC" "1"
 SYSTEM_CONSTANT "THRVLV_DEDIA_SC" "0"
 SYSTEM_CONSTANT "THRVLV_ENAHBRDGSPLYCHK_SC" "0"
 SYSTEM_CONSTANT "THRVLV_ENASENTFBSEPSIGLINE_SC" "0"
 SYSTEM_CONSTANT "THRVLV_ENGSPDACTRSPENA_SC" "0"
 SYSTEM_CONSTANT "THRVLV_ENHDICERMVMOD_SC" "0"
 SYSTEM_CONSTANT "THRVLV_ICECHKATENGRUN_SC" "0"
 SYSTEM_CONSTANT "THRVLV_IOSIGHALFBRDG_SC" "0"
 SYSTEM_CONSTANT "THRVLV_LIMPAIRPOSNFCTENA_SC" "1"
 SYSTEM_CONSTANT "THRVLV_OPENPOSNLRN_SC" "0"
 SYSTEM_CONSTANT "THRVLV_PARLCHRGCTRL_SC" "0"
 SYSTEM_CONSTANT "THRVLV_PHYSRNGCHK_SY" "0"
 SYSTEM_CONSTANT "THRVLV_SENTENA_SC" "0"
 SYSTEM_CONSTANT "THRVLV_SNSRDRIFTCMP_SC" "0"
 SYSTEM_CONSTANT "THRVLV_SNSRSPLYB2_SC" "0"
 SYSTEM_CONSTANT "THRVLV_SNSRSPLY_SC" "1"
 SYSTEM_CONSTANT "THRVLV_TWNDESVAL_SC" "0"
 SYSTEM_CONSTANT "THRVLV_TYPTWINFLW_SY" "0"
 SYSTEM_CONSTANT "THS_GBXVLVDIAG_SC" "0"
 SYSTEM_CONSTANT "TIBASDCMB_SC" "0"
 SYSTEM_CONSTANT "TIMEDELAY_S_2_MIN" "0.001"
 SYSTEM_CONSTANT "TIMEDELAY_S_2_NRM" "8"
 SYSTEM_CONSTANT "TIME_5S_NRM_SY" "5"
 SYSTEM_CONSTANT "TIME_DEB_100MS" "100000"
 SYSTEM_CONSTANT "TIME_DEB_10MS" "10000"
 SYSTEM_CONSTANT "TIME_DT_1000MS" "1000000"
 SYSTEM_CONSTANT "TIME_DT_100MS" "100000"
 SYSTEM_CONSTANT "TIME_DT_10MS" "10000"
 SYSTEM_CONSTANT "TIME_DT_1S" "1000000"
 SYSTEM_CONSTANT "TIME_DT_200MS" "200000"
 SYSTEM_CONSTANT "TIME_MS_10MS_RES" "10"
 SYSTEM_CONSTANT "TIME_S_100US_RES" "0.0001"
 SYSTEM_CONSTANT "TIME_S_100US_RES_REV" "10000"
 SYSTEM_CONSTANT "TIME_S_12000" "12000"
 SYSTEM_CONSTANT "TIME_S_LORES_ONE" "1"
 SYSTEM_CONSTANT "Time_s_LORES_RES" "1"
 SYSTEM_CONSTANT "Time_s_LORES_RES_REV" "1"
 SYSTEM_CONSTANT "TIME_S_LORES_ZERO" "0"
 SYSTEM_CONSTANT "TIME_S_NSCRGN_MAX" "327.66"
 SYSTEM_CONSTANT "TIME_TICK_SEC_INV" "100"
 SYSTEM_CONSTANT "TIME_VALID" "2"
 SYSTEM_CONSTANT "TINTKVLVDSDYN_SC" "0"
 SYSTEM_CONSTANT "TINTKVUS_TYPAVL_SY" "0"
 SYSTEM_CONSTANT "TIOFF_DIAGENA_SC" "1"
 SYSTEM_CONSTANT "TIOFF_VDMDLCLKENA_SC" "0"
 SYSTEM_CONSTANT "TIOFF_VDTICMBOFFENA_SC" "0"
 SYSTEM_CONSTANT "TIOFF_VDTIENGOFFENA_SC" "0"
 SYSTEM_CONSTANT "TIOFF_VDTIPRPSYSACTVOFFENA_SC" "0"
 SYSTEM_CONSTANT "TIPIN_SY" "0"
 SYSTEM_CONSTANT "TI_PII_EARL_REL" "13000"
 SYSTEM_CONSTANT "TI_POI2_LATE_REL" "-13000"
 SYSTEM_CONSTANT "TLE7209_SY" "0"
 SYSTEM_CONSTANT "TLE7244_SC" "0"
 SYSTEM_CONSTANT "TLE75602_SC" "0"
 SYSTEM_CONSTANT "TMEOBDACTV_SC" "0"
 SYSTEM_CONSTANT "TME_CCOFADEOUT_SC" "0"
 SYSTEM_CONSTANT "TME_CHRGAIRVLVSWT_SC" "1"
 SYSTEM_CONSTANT "TME_CHRGEXCHLOSSMDLSELN_SC" "0"
 SYSTEM_CONSTANT "TME_CHRGEXCHLOSSPOSNSELN_SC" "1"
 SYSTEM_CONSTANT "TME_CYLBNKSPCIAACTEFF_SC" "0"
 SYSTEM_CONSTANT "TME_CYLSPCAIRSYSIF_SC" "0"
 SYSTEM_CONSTANT "TME_CYLSPCIGNIF_SC" "0"
 SYSTEM_CONSTANT "TME_CYLSPCTQMDLIF_SC" "0"
 SYSTEM_CONSTANT "TME_DRGTQMDLSELN_SC" "0"
 SYSTEM_CONSTANT "TME_FAKETAIA_SC" "5"
 SYSTEM_CONSTANT "TME_STATYLTEIAEFFCALCN_SC" "0"
 SYSTEM_CONSTANT "TME_TCORRETA_SC" "0"
 SYSTEM_CONSTANT "TME_TQINNRMAXGBX_SC" "0"
 SYSTEM_CONSTANT "TME_TQMINACCRPEDL_SC" "1"
 SYSTEM_CONSTANT "TME_VIMMDL_SC" "0"
 SYSTEM_CONSTANT "TME_VIRTAPPSELN_SC" "0"
 SYSTEM_CONSTANT "TME_VIRTIA_SC" "1"
 SYSTEM_CONSTANT "TME_VIRTTQ_SC" "0"
 SYSTEM_CONSTANT "TMFWPRT_SY" "0"
 SYSTEM_CONSTANT "TMOSNMVO_SC" "20"
 SYSTEM_CONSTANT "TMOSNMZO_SC" "16"
 SYSTEM_CONSTANT "TMOSRLVO_SC" "12"
 SYSTEM_CONSTANT "TMOSRLZO_SC" "12"
 SYSTEM_CONSTANT "TNRM" "0"
 SYSTEM_CONSTANT "TOTENGREV_SC" "0"
 SYSTEM_CONSTANT "TOXDCAT_TYPAVL_SC" "0"
 SYSTEM_CONSTANT "TOXICATDS_TYPAVL_SY" "0"
 SYSTEM_CONSTANT "TOXICATUS_TYPAVL_SY" "0"
 SYSTEM_CONSTANT "TPFLTDS_TYPAVL_SY" "0"
 SYSTEM_CONSTANT "TPFLTUS_TYPAVL_SY" "0"
 SYSTEM_CONSTANT "TPS65917_SC" "0"
 SYSTEM_CONSTANT "TQCOORDCEN_SC" "0"
 SYSTEM_CONSTANT "TQCOORD_INHOUSE_SC" "0"
 SYSTEM_CONSTANT "TQFRICADPN_ATS_SC" "0"
 SYSTEM_CONSTANT "TQLIMNHIBOOSTP_SC" "0"
 SYSTEM_CONSTANT "TQLIMNLOCKDTCACTR_SC" "0"
 SYSTEM_CONSTANT "TQRESVLIMNREDNFASTINTV_SC" "0"
 SYSTEM_CONSTANT "TQSTRUCT2W_SC" "0"
 SYSTEM_CONSTANT "TQSTRUCTTYP_SC" "0"
 SYSTEM_CONSTANT "TRANOIPRV_SY" "0"
 SYSTEM_CONSTANT "TRANSPTMODE_SY" "0"
 SYSTEM_CONSTANT "TRATYPE_AST_SY" "2"
 SYSTEM_CONSTANT "TRATYPE_AT_SY" "1"
 SYSTEM_CONSTANT "TRATYPE_CVT_SY" "3"
 SYSTEM_CONSTANT "TRATYPE_DDCT_SY" "4"
 SYSTEM_CONSTANT "TRATYPE_MT_SY" "0"
 SYSTEM_CONSTANT "TRATYPE_NEW1_SY" "4"
 SYSTEM_CONSTANT "TRATYPE_NEW2_SY" "5"
 SYSTEM_CONSTANT "TRATYPE_NEW3_SY" "6"
 SYSTEM_CONSTANT "TRATYPE_NEW4_SY" "7"
 SYSTEM_CONSTANT "TRA_AST" "2"
 SYSTEM_CONSTANT "TRA_ASTINTVACTV_BP" "0"
 SYSTEM_CONSTANT "TRA_ASTNEUTR_BP" "1"
 SYSTEM_CONSTANT "TRA_AST_SY" "0"
 SYSTEM_CONSTANT "TRA_AT" "1"
 SYSTEM_CONSTANT "TRA_AT_SY" "0"
 SYSTEM_CONSTANT "TRA_AUTRKPROTNACTV_SC" "0"
 SYSTEM_CONSTANT "TRA_CVT" "3"
 SYSTEM_CONSTANT "TRA_CVT_SY" "1"
 SYSTEM_CONSTANT "TRA_DCT" "4"
 SYSTEM_CONSTANT "TRA_DCT_SY" "0"
 SYSTEM_CONSTANT "TRA_DDCT" "9"
 SYSTEM_CONSTANT "TRA_FACUPSPDCOR_MAP_X" "8"
 SYSTEM_CONSTANT "TRA_FACUPSPDCOR_MAP_Y" "16"
 SYSTEM_CONSTANT "TRA_FRBASEAFTSHFT_MAP_X" "8"
 SYSTEM_CONSTANT "TRA_FRBASEAFTSHFT_MAP_Y" "16"
 SYSTEM_CONSTANT "TRA_FRNEED2SHFTUP_CUR_X" "7"
 SYSTEM_CONSTANT "TRA_FRNEEDAFTSHFT_MAP_X" "16"
 SYSTEM_CONSTANT "TRA_FRNEEDAFTSHFT_MAP_Y" "16"
 SYSTEM_CONSTANT "TRA_FROUTMAX_MAP_X" "8"
 SYSTEM_CONSTANT "TRA_FROUTMAX_MAP_Y" "16"
 SYSTEM_CONSTANT "TRA_FRSLPEST_MAP_X" "16"
 SYSTEM_CONSTANT "TRA_FRSLPEST_MAP_Y" "16"
 SYSTEM_CONSTANT "TRA_FRSPR2DWN_CUR_X" "16"
 SYSTEM_CONSTANT "TRA_INTERLOCK_SY" "0"
 SYSTEM_CONSTANT "TRA_MANUAL" "3"
 SYSTEM_CONSTANT "TRA_MT" "0"
 SYSTEM_CONSTANT "TRA_MT_SY" "1"
 SYSTEM_CONSTANT "TRA_NCANERRMAX_CUR_X" "8"
 SYSTEM_CONSTANT "TRA_NFRSHFTDWN_CUR_X" "8"
 SYSTEM_CONSTANT "TRA_NINHSHFTDWN_CUR_X" "7"
 SYSTEM_CONSTANT "TRA_NOT_DEFINED" "0"
 SYSTEM_CONSTANT "TRA_NPL_DDCT" "25"
 SYSTEM_CONSTANT "TRA_NPL_SELESPEED" "21"
 SYSTEM_CONSTANT "TRA_NUMBUF" "10"
 SYSTEM_CONSTANT "TRA_PDK_SY" "0"
 SYSTEM_CONSTANT "TRA_RAPPDWNINH_MAP_X" "16"
 SYSTEM_CONSTANT "TRA_RAPPDWNINH_MAP_Y" "9"
 SYSTEM_CONSTANT "TRA_RLOLDAPPTHRES_CUR_X" "8"
 SYSTEM_CONSTANT "TRA_RSLPEST_MAP_X" "16"
 SYSTEM_CONSTANT "TRA_RSLPEST_MAP_Y" "16"
 SYSTEM_CONSTANT "TRA_SELESPEED" "5"
 SYSTEM_CONSTANT "TRA_STNSETP_FLT" "0"
 SYSTEM_CONSTANT "TRA_STNSETP_TIPIN" "2"
 SYSTEM_CONSTANT "TRA_STNSETP_UNFLT" "1"
 SYSTEM_CONSTANT "TRA_TRQDESMAXTRQ_CURX" "10"
 SYSTEM_CONSTANT "TRA_TRQLOLDTRQTHRES_CUR_X" "8"
 SYSTEM_CONSTANT "TRA_TRQMAXGEAR1_CURX" "8"
 SYSTEM_CONSTANT "TRA_TRQMAXGEAR2_CURX" "8"
 SYSTEM_CONSTANT "TRA_TRQMAXGEAR3_CURX" "8"
 SYSTEM_CONSTANT "TRA_TRQMAXGEAR4_CURX" "8"
 SYSTEM_CONSTANT "TRA_TRQMAXGEAR5_CURX" "8"
 SYSTEM_CONSTANT "TRA_TRQMAXGEAR6_CURX" "8"
 SYSTEM_CONSTANT "TRA_TRQMAXGEAR7_CURX" "8"
 SYSTEM_CONSTANT "TRA_TRQMAXGEAR8_CURX" "8"
 SYSTEM_CONSTANT "TRA_TRQMAXGEARR_CURX" "8"
 SYSTEM_CONSTANT "TRA_TSCPTD_BP" "0"
 SYSTEM_CONSTANT "TRA_VBASESHFTUP_MAP_X" "8"
 SYSTEM_CONSTANT "TRA_VBASESHFTUP_MAP_Y" "16"
 SYSTEM_CONSTANT "TRA_VDRBSHFTUP_MAP_X" "8"
 SYSTEM_CONSTANT "TRA_VDRBSHFTUP_MAP_Y" "16"
 SYSTEM_CONSTANT "TRA_VSHFTUPINHTHRES_CUR_X" "8"
 SYSTEM_CONSTANT "TRBCHAIRACTR_SC" "0"
 SYSTEM_CONSTANT "TRBCHINSDT_TYPAVL_SC" "0"
 SYSTEM_CONSTANT "TRBCH_ACTRTYP_SC" "0"
 SYSTEM_CONSTANT "TRBCH_BLDCMOT_SC" "0"
 SYSTEM_CONSTANT "TRBHP2I_TYPAVL_SC" "0"
 SYSTEM_CONSTANT "TRBHPBYPI_TYPAVL_SC" "0"
 SYSTEM_CONSTANT "TRBHPI_TYPAVL_SC" "0"
 SYSTEM_CONSTANT "TRBLPI_TYPAVL_SC" "0"
 SYSTEM_CONSTANT "TRBNBYVLV1INSDT_TYPAVL_SC" "0"
 SYSTEM_CONSTANT "TRBNBYVLV2INSDT_TYPAVL_SC" "0"
 SYSTEM_CONSTANT "TRBNBYVLV_TYPAVL_SY" "0"
 SYSTEM_CONSTANT "TRQBS_WOINTV_SY" "0"
 SYSTEM_CONSTANT "TRQBS_WOTRAINTV_SY" "0"
 SYSTEM_CONSTANT "TRQCONVLDMOD_SY" "1"
 SYSTEM_CONSTANT "TRQCONV_CESSLIP_SC" "1"
 SYSTEM_CONSTANT "TRQCONV_SY" "1"
 SYSTEM_CONSTANT "TRQLIMCOORD2ECU_SY" "0"
 SYSTEM_CONSTANT "TRQRESV_CONST_SY" "0"
 SYSTEM_CONSTANT "TRQRESV_CP_SY" "0"
 SYSTEM_CONSTANT "TRQRESV_ETAREQ_SY" "1"
 SYSTEM_CONSTANT "TRQRESV_EXL_SY" "0"
 SYSTEM_CONSTANT "TRQRNG_EXL_SY" "0"
 SYSTEM_CONSTANT "TRQSEL_SY" "1"
 SYSTEM_CONSTANT "TRQ_ENGINTV_SY" "0"
 SYSTEM_CONSTANT "TRQ_MONLIM_CNT_SY" "0"
 SYSTEM_CONSTANT "TRQ_MONLIM_DIAG_SY" "1"
 SYSTEM_CONSTANT "TRQ_WOTRAINTV_SY" "1"
 SYSTEM_CONSTANT "TRQ_ZERO" "0"
 SYSTEM_CONSTANT "TRSMINCTREQOVRDSAPPERR_SC" "0"
 SYSTEM_CONSTANT "TRSMNEUTCTRLCOASTAVL_SC" "0"
 SYSTEM_CONSTANT "TSTRDMDSTOPCHRGADJMT_SC" "0"
 SYSTEM_CONSTANT "TS_CTTMON_SY" "0"
 SYSTEM_CONSTANT "TTRBNUS_TYPAVL_SY" "0"
 SYSTEM_CONSTANT "TTRBUSASICT_TYPAVL_SC" "0"
 SYSTEM_CONSTANT "TTWCSNSRNR_SC" "0"
 SYSTEM_CONSTANT "TWALLTC_MDLAVL_SC" "0"
 SYSTEM_CONSTANT "TWCCBALUP_SY" "0"
 SYSTEM_CONSTANT "TWCCDCTRL_SC" "0"
 SYSTEM_CONSTANT "TWCCMODLNBAL_SY" "0"
 SYSTEM_CONSTANT "TWCCOBDFUELTRIM_SY" "0"
 SYSTEM_CONSTANT "TWCCPRIB1_SY" "2"
 SYSTEM_CONSTANT "TWCCPRIB2_SY" "0"
 SYSTEM_CONSTANT "TWCCPRINF_SY" "0"
 SYSTEM_CONSTANT "TWCCSCNDB1_SY" "0"
 SYSTEM_CONSTANT "TWCCSCNDB2_SY" "0"
 SYSTEM_CONSTANT "TWCC_CTRLSTRUCT_SC" "0"
 SYSTEM_CONSTANT "TWCC_PRIMENAATS_SC" "0"
 SYSTEM_CONSTANT "TWCDCATHEATGREQ_SY" "0"
 SYSTEM_CONSTANT "TWCDEWMA_SY" "1"
 SYSTEM_CONSTANT "TWCDFIRSTADPNO2STRCAT_SY" "0"
 SYSTEM_CONSTANT "TWCDMODCMPPRIB1_SY" "0"
 SYSTEM_CONSTANT "TWCDMODCMPPRIB2_SY" "0"
 SYSTEM_CONSTANT "TWCDMODCMPSCNDB1_SY" "0"
 SYSTEM_CONSTANT "TWCDMODCMPSCNDB2_SY" "0"
 SYSTEM_CONSTANT "TWCDOSCPAPRIB1_SY" "0"
 SYSTEM_CONSTANT "TWCDOSCPAPRIB2_SY" "0"
 SYSTEM_CONSTANT "TWCDOSCPASCNDB1_SY" "0"
 SYSTEM_CONSTANT "TWCDOSCPASCNDB2_SY" "0"
 SYSTEM_CONSTANT "TWCDOSCPATST_SY" "0"
 SYSTEM_CONSTANT "TWCDOSCPRIB1_SY" "1"
 SYSTEM_CONSTANT "TWCDOSCPRIB2_SY" "0"
 SYSTEM_CONSTANT "TWCDOSCSCNDB1_SY" "0"
 SYSTEM_CONSTANT "TWCDOSCSCNDB2_SY" "0"
 SYSTEM_CONSTANT "TWCDPATST_SY" "0"
 SYSTEM_CONSTANT "TWCDRSCFRTHB1_SC" "0"
 SYSTEM_CONSTANT "TWCDRSCFRTHB2_SC" "0"
 SYSTEM_CONSTANT "TWCDRSCPATST_SY" "0"
 SYSTEM_CONSTANT "TWCDRSCPRIB1_SY" "0"
 SYSTEM_CONSTANT "TWCDRSCPRIB2_SY" "0"
 SYSTEM_CONSTANT "TWCDRSCSCNDB1_SY" "0"
 SYSTEM_CONSTANT "TWCDRSCSCNDB2_SY" "0"
 SYSTEM_CONSTANT "TWCDRSCTHRDB1_SY" "0"
 SYSTEM_CONSTANT "TWCDRSCTHRDB2_SY" "0"
 SYSTEM_CONSTANT "TWCD_OSCCAT2BNK1PARL_SC" "0"
 SYSTEM_CONSTANT "TWCD_OSCCAT2BNK2PARL_SC" "0"
 SYSTEM_CONSTANT "TWCD_PTLMEASMTPARL_SC" "0"
 SYSTEM_CONSTANT "TWCD_STRATIUMPRSIMN_SC" "0"
 SYSTEM_CONSTANT "TWCOR_HIRES_SC" "0"
 SYSTEM_CONSTANT "TWO_POW_NRM_EXP_RES_TRIGO_FUNC" "4096"
 SYSTEM_CONSTANT "TWTRCOOLRDS_TYPAVL_SC" "0"
 SYSTEM_CONSTANT "T_EXHGS_MAX" "1050"
 SYSTEM_CONSTANT "T_EXHGS_MIN" "-45"
 SYSTEM_CONSTANT "UART_SY" "1"
 SYSTEM_CONSTANT "UBFAILSRC_SY" "1"
 SYSTEM_CONSTANT "UCATDST2_TYPAVL_SC" "0"
 SYSTEM_CONSTANT "UCATDST_TYPAVL_SC" "0"
 SYSTEM_CONSTANT "UCATUST2_TYPAVL_SC" "0"
 SYSTEM_CONSTANT "UCATUST_TYPAVL_SC" "0"
 SYSTEM_CONSTANT "UEGOHEATRTSTRCTRL_SC" "1"
 SYSTEM_CONSTANT "UEGO_ASICSTEP_SC" "4"
 SYSTEM_CONSTANT "UEGO_BNKSPCLAMCORRN_SC" "0"
 SYSTEM_CONSTANT "UEGO_CALREDN_SC" "0"
 SYSTEM_CONSTANT "UEGO_CIPEADPNENA_SC" "0"
 SYSTEM_CONSTANT "UEGO_CJ135IPMPOFFSIDN_SC" "0"
 SYSTEM_CONSTANT "UEGO_DATAVISDENSOPLUS51_SC" "0"
 SYSTEM_CONSTANT "UEGO_DATAVISDENSOPLUS61_SC" "0"
 SYSTEM_CONSTANT "UEGO_DATAVISLSU49TSP_SC" "1"
 SYSTEM_CONSTANT "UEGO_DATAVISLSU49_SC" "0"
 SYSTEM_CONSTANT "UEGO_DATAVISLSU51_SC" "0"
 SYSTEM_CONSTANT "UEGO_DATAVISLSU52_SC" "0"
 SYSTEM_CONSTANT "UEGO_DATAVISLSUADV_SC" "0"
 SYSTEM_CONSTANT "UEGO_DATAVISNORCMPPRSNT_SC" "0"
 SYSTEM_CONSTANT "UEGO_DATAVISNTKZFASU2_SC" "0"
 SYSTEM_CONSTANT "UEGO_DATAVISNTKZFASU3_SC" "0"
 SYSTEM_CONSTANT "UEGO_DATAVISRCMPPRSNT_SC" "1"
 SYSTEM_CONSTANT "UEGO_DDYPAR_SY" "0"
 SYSTEM_CONSTANT "UEGO_DGSCMNDRVR_SC" "1"
 SYSTEM_CONSTANT "UEGO_DIAGHTRCPL_SY" "0"
 SYSTEM_CONSTANT "UEGO_DYNERRSIMNENA_SC" "0"
 SYSTEM_CONSTANT "UEGO_DYNOPERPNTREQ_SC" "0"
 SYSTEM_CONSTANT "UEGO_ENALAMPENVCORRD_SC" "0"
 SYSTEM_CONSTANT "UEGO_ENHDSCAVCORRN_SC" "0"
 SYSTEM_CONSTANT "UEGO_HEATGUPEXTD_SC" "0"
 SYSTEM_CONSTANT "UEGO_HEATRFCTENA_SC" "1"
 SYSTEM_CONSTANT "UEGO_HEATRRLY_SC" "1"
 SYSTEM_CONSTANT "UEGO_ICS1B1_SY" "2"
 SYSTEM_CONSTANT "UEGO_ICS1B2_SY" "0"
 SYSTEM_CONSTANT "UEGO_ICS2B1_SY" "0"
 SYSTEM_CONSTANT "UEGO_ICS2B2_SY" "0"
 SYSTEM_CONSTANT "UEGO_ICS3B1_SY" "0"
 SYSTEM_CONSTANT "UEGO_ICS3B2_SY" "0"
 SYSTEM_CONSTANT "UEGO_NREOMMASKSIZE_SC" "1"
 SYSTEM_CONSTANT "UEGO_O2LAMFCTENA_SC" "1"
 SYSTEM_CONSTANT "UEGO_O2MDLENA_SC" "0"
 SYSTEM_CONSTANT "UEGO_OLRCMPDSTCN_SC" "0"
 SYSTEM_CONSTANT "UEGO_OPERELECTCFCT_SC" "0"
 SYSTEM_CONSTANT "UEGO_PLAUSOPERPNTREQ_SC" "0"
 SYSTEM_CONSTANT "UEGO_RCMPPRSNT_SC" "1"
 SYSTEM_CONSTANT "UEGO_RICHCPBYDIAG_SC" "0"
 SYSTEM_CONSTANT "UEGO_RPC_SC" "0"
 SYSTEM_CONSTANT "UEGO_SELCENDATAEVLN_SC" "1"
 SYSTEM_CONSTANT "UEGO_SELTSKIPMPEVLN_SC" "0"
 SYSTEM_CONSTANT "UEGO_SEPUBATTTHDRIDIAG_SC" "0"
 SYSTEM_CONSTANT "UEGO_SIGRELSUN0CTRLDPDT_SC" "0"
 SYSTEM_CONSTANT "UEGO_SNGLCEL_SC" "0"
 SYSTEM_CONSTANT "UEGO_SNSR1INTK1_SC" "0"
 SYSTEM_CONSTANT "UEGO_SNSROPERPREENGSTRT_SC" "0"
 SYSTEM_CONSTANT "UEGO_SNSRTMDLENA_SC" "0"
 SYSTEM_CONSTANT "UEGO_SUMERR_SY" "0"
 SYSTEM_CONSTANT "UEGO_SYSDIAG_SC" "1"
 SYSTEM_CONSTANT "UEGO_UNERNSTSETCTRLENA_SC" "0"
 SYSTEM_CONSTANT "UEGO_VCCMEAS_SC" "1"
 SYSTEM_CONSTANT "UEGO_VRNTSELN_SC" "42"
 SYSTEM_CONSTANT "UEGO_WIRESIGOLDSTCN_SC" "1"
 SYSTEM_CONSTANT "UEGO_WTRELECLYENA_SC" "0"
 SYSTEM_CONSTANT "UNIAIRINTKLIVOMOD_SC" "0"
 SYSTEM_CONSTANT "USESTRTSYNCINTRPTCFG_SC" "0"
 SYSTEM_CONSTANT "USGOFFTIGENNIF_SC" "2"
 SYSTEM_CONSTANT "VARCOD_SY" "0"
 SYSTEM_CONSTANT "VCRTYP_SC" "0"
 SYSTEM_CONSTANT "VEHDEV_APPPIDENA_SC" "1"
 SYSTEM_CONSTANT "VEHDEV_HNDBRKENA_SC" "0"
 SYSTEM_CONSTANT "VEHDEV_HNDBRKLAMPENA_SC" "0"
 SYSTEM_CONSTANT "VEHFDE_NRCNDTRIG_SC" "0"
 SYSTEM_CONSTANT "VEHFDE_NRCNVTNLDISTBN_SC" "0"
 SYSTEM_CONSTANT "VEHFDE_NREXTTRIG_SC" "0"
 SYSTEM_CONSTANT "VEHFDE_NRFREETRIG_SC" "0"
 SYSTEM_CONSTANT "VEHFDE_NRINDCLASS_SC" "0"
 SYSTEM_CONSTANT "VEHFDE_NRMILGTRIG_SC" "0"
 SYSTEM_CONSTANT "VEHFDE_NRSNGVALSTC_SC" "0"
 SYSTEM_CONSTANT "VEHFDE_NRSTC_SC" "0"
 SYSTEM_CONSTANT "VEHFDE_NRVALCHGTRIG_SC" "0"
 SYSTEM_CONSTANT "VEHMOT_DCS_MSK" "2"
 SYSTEM_CONSTANT "VEHMOT_TCS_MSK" "1"
 SYSTEM_CONSTANT "VEHMOT_TITRQDRAGVX_CURX" "2"
 SYSTEM_CONSTANT "VEHMOT_TRQPRP_NRMFAC" "16"
 SYSTEM_CONSTANT "VEHSTC_ECOLAMPACTV_SC" "1"
 SYSTEM_CONSTANT "VEHTYPSELN_SC" "0"
 SYSTEM_CONSTANT "VEHTYP_SC" "2"
 SYSTEM_CONSTANT "VEHVCANSRCSEL_SC" "1"
 SYSTEM_CONSTANT "VEHVPWMOUT_SC" "1"
 SYSTEM_CONSTANT "VEHV_CANSAFE_SC" "1"
 SYSTEM_CONSTANT "VEHV_CAN_SC" "1"
 SYSTEM_CONSTANT "VEHV_COMV_DEF" "327.67"
 SYSTEM_CONSTANT "VEHV_DUALCANSRCACTV_SC" "0"
 SYSTEM_CONSTANT "VEHV_DUALSIG_SC" "1"
 SYSTEM_CONSTANT "VEHV_FCOPLAUS_SY" "0"
 SYSTEM_CONSTANT "VEHV_INHOUSE_SC" "0"
 SYSTEM_CONSTANT "VEHV_NUMTTHWHL_SY" "5"
 SYSTEM_CONSTANT "VEHV_OBDPLAUS_SY" "0"
 SYSTEM_CONSTANT "VEHV_PHYSRNGCHK_SY" "0"
 SYSTEM_CONSTANT "VEHV_PWMSAFE_SC" "1"
 SYSTEM_CONSTANT "VEHV_PWMVLDYCHK_SC" "0"
 SYSTEM_CONSTANT "VEHV_PWM_SC" "1"
 SYSTEM_CONSTANT "VEHV_SC" "1"
 SYSTEM_CONSTANT "VEHV_SELCOMSIG_SC" "0"
 SYSTEM_CONSTANT "VEHV_SGLWHLDIAG_SY" "0"
 SYSTEM_CONSTANT "VEHV_SWTASRC_SC" "1"
 SYSTEM_CONSTANT "VEHV_SWTPLAUSCAN_SC" "1"
 SYSTEM_CONSTANT "VEHV_SWTPLAUSFCO_SC" "1"
 SYSTEM_CONSTANT "VEHV_SWTPLAUSPWR_SC" "1"
 SYSTEM_CONSTANT "VEHV_SWTPLAUSREF_SC" "0"
 SYSTEM_CONSTANT "VEHV_SWTPLAUSV2N_SC" "1"
 SYSTEM_CONSTANT "VEHV_SWTPWRMDL_SC" "1"
 SYSTEM_CONSTANT "VEHV_SWTSIGSELNEEP_SC" "0"
 SYSTEM_CONSTANT "VEHV_TIPER_MAX" "13421772"
 SYSTEM_CONSTANT "VEL_KMH_0" "0"
 SYSTEM_CONSTANT "VEL_KMH_300" "300"
 SYSTEM_CONSTANT "VEL_KMH_M_300" "-300"
 SYSTEM_CONSTANT "VERSSTOPMISFGDETNBYINJ_SY" "0"
 SYSTEM_CONSTANT "VLVI_SY" "1"
 SYSTEM_CONSTANT "VLVLFTI_TYPAVL_SC" "0"
 SYSTEM_CONSTANT "VLVLFT_FBEXHSWT_SC" "0"
 SYSTEM_CONSTANT "VLVLFT_FBINTKSWT_SC" "0"
 SYSTEM_CONSTANT "VLVLFT_FBSWT_HIGHCAM" "1"
 SYSTEM_CONSTANT "VLVLFT_FBSWT_LOWCAM" "0"
 SYSTEM_CONSTANT "VLVLFT_INTK_SC" "1"
 SYSTEM_CONSTANT "VLVLFT_OUTL_SC" "0"
 SYSTEM_CONSTANT "VLVLFT_POSNOFSPCLLFTINTK_SC" "1"
 SYSTEM_CONSTANT "VLVLFT_SIGACTR_HIGHCAM" "1"
 SYSTEM_CONSTANT "VLVLFT_SIGACTR_LOWCAM" "0"
 SYSTEM_CONSTANT "VLVLFT_TYPINTK_SC" "4"
 SYSTEM_CONSTANT "VLVLFT_TYPOUTL_SC" "0"
 SYSTEM_CONSTANT "VLVLFT_UNIAIRINTK_SC" "0"
 SYSTEM_CONSTANT "VMD_DEGCNVN_CURX" "2"
 SYSTEM_CONSTANT "VMD_RENG_MAPX" "14"
 SYSTEM_CONSTANT "VMD_RENG_MAPY" "43"
 SYSTEM_CONSTANT "VMD_RPRP_MAPX" "6"
 SYSTEM_CONSTANT "VMD_RPRP_MAPY" "16"
 SYSTEM_CONSTANT "VMD_TRQTHRESENG_CURX" "6"
 SYSTEM_CONSTANT "VMD_TRQTHRESPRP_CURX" "6"
 SYSTEM_CONSTANT "VMSI_DCSPTD_BP" "0"
 SYSTEM_CONSTANT "VMSI_DCS_BP" "1"
 SYSTEM_CONSTANT "VMSI_RAMPENDINTV_SC" "0"
 SYSTEM_CONSTANT "VMSI_STCFG_DCSSHOFFRMPENA_BP" "0"
 SYSTEM_CONSTANT "VMSI_TCS_BP" "0"
 SYSTEM_CONSTANT "VNQ6040_SC" "0"
 SYSTEM_CONSTANT "VOL_FILGLVL_RES" "1"
 SYSTEM_CONSTANT "VOL_FILGLVL_RES_REV" "1"
 SYSTEM_CONSTANT "VOL_NSC_RES" "0.0001"
 SYSTEM_CONSTANT "VOL_NSC_RES_FL" "0.0001"
 SYSTEM_CONSTANT "VOL_NSC_RES_REV" "10000"
 SYSTEM_CONSTANT "VOL_RES_REV" "100"
 SYSTEM_CONSTANT "VSWVLVI_TYPAVL_SC" "0"
 SYSTEM_CONSTANT "VSWVLV_AIRACTR_SC" "0"
 SYSTEM_CONSTANT "VSWVLV_TYPAVLCONVENTIONAL_SC" "0"
 SYSTEM_CONSTANT "VVTDSLAVL_SC" "0"
 SYSTEM_CONSTANT "VVTIDLEMOD_SC" "0"
 SYSTEM_CONSTANT "V_CAM_RES_REV" "256"
 SYSTEM_CONSTANT "WAHT_SY" "0"
 SYSTEM_CONSTANT "WDGS_CFGADPR_SC" "1"
 SYSTEM_CONSTANT "WESDEM_SY" "0"
 SYSTEM_CONSTANT "WHRCOOLTPDIF_TYPAVL_SC" "0"
 SYSTEM_CONSTANT "WIPRIFTYP_SC" "4"
 SYSTEM_CONSTANT "WNTR_SY" "0"
 SYSTEM_CONSTANT "WRMUPCSERS_SC" "0"
 SYSTEM_CONSTANT "WTRCACT_TYPAVL_SC" "0"
 SYSTEM_CONSTANT "WTRCOOLTP1_TYPAVL_SY" "0"
 SYSTEM_CONSTANT "WTRCOOLTP_TYPAVL_SY" "0"
 SYSTEM_CONSTANT "WTRINJSYS_SC" "0"
 SYSTEM_CONSTANT "WTRPMP1_SC" "0"
 SYSTEM_CONSTANT "WTRPMP2_SC" "0"
 SYSTEM_CONSTANT "WTRPMP_VARNTYP_SC" "0"
 SYSTEM_CONSTANT "XCORECDD_SC" "0"
 SYSTEM_CONSTANT "XCPVERS_SC" "3"
 SYSTEM_CONSTANT "XCP_SY" "1"
 SYSTEM_CONSTANT "XDI_SC" "1"
 SYSTEM_CONSTANT "ZERO" "0"
 SYSTEM_CONSTANT "ZFC_SY" "0"
 SYSTEM_CONSTANT "ZWMIN_ENAG_SC" "1" /end MOD_PAR
/begin MOD_COMMON "" BYTE_ORDER MSB_LAST ALIGNMENT_BYTE 1 ALIGNMENT_WORD 2 ALIGNMENT_LONG 4 ALIGNMENT_INT64 4 ALIGNMENT_FLOAT32_IEEE 4 ALIGNMENT_FLOAT64_IEEE 4 DATA_SIZE 32 /end MOD_COMMON
/begin IF_DATA ASAP1B_Bypass
 /begin TP_BLOB 0x102 /* Bypass version */ 0x102 /* Blob version */ /end TP_BLOB
/end IF_DATA
/begin IF_DATA ETK_XETK
 /begin ETK_XETK_LIST /* version */ ETK_XETK_AML_VERSION_2_2_0
  /begin ETK 1 INTERFACE_SPEED_100MBIT /* Interface */ CONFIG "CpuType" "TC37xED_A" CONFIG "EtkId" "162" CONFIG "EtkSubId" "0" CONFIG "HardwAdvId" "0" CONFIG "TriggerInterface" "reg" CONFIG "PullCalWakeup" "0" CONFIG "WatchdogDisable" "1" CONFIG "RegPollRate" "50" CONFIG "PowerFailDetection" "SBRAM" CONFIG "Startup" "reg" CONFIG "StartupTimeout" "-1" CONFIG "DebArb" "1" CONFIG "WatchdogPolarity" "1" CONFIG "DapClockSpeed" "100" CONFIG "DapBlock" "1" CONFIG "Dap2Pin" "0" DISPLAY_NAME "ETK-S20/21" /end ETK
  /begin XETK 2 /* ETK_XETK_ID BR-XETK-S3 */ CONFIG "CpuType" "TC37xED_A" CONFIG "BaseId" "21" CONFIG "Extension" "2" CONFIG "DapClockSpeed" "100" CONFIG "DapBlock" "1" CONFIG "Dap2Pin" "0" CONFIG "EcuWatchdogPolarity" "1" CONFIG "HandshakeTimeout" "-1" CONFIG "EcuTrigRegPollRate" "50" CONFIG "PowerFailDetection" "SBRAM" CONFIG "TriggerInterface" "reg" CONFIG "EcuWatchdogControlDisabled" "0" CONFIG "EcuWatchdogEnabled" "1" DISPLAY_NAME "BR-XETK-S3" /end XETK
  /begin XETK 3 CONFIG "CpuType" "TC37xED_A" CONFIG "BaseId" "11" CONFIG "Extension" "2" CONFIG "DapClockSpeed" "100" CONFIG "DapBlock" "1" CONFIG "Dap2Pin" "0" CONFIG "EcuWatchdogPolarity" "1" CONFIG "HandshakeTimeout" "-1" CONFIG "EcuTrigRegPollRate" "50" CONFIG "PowerFailDetection" "SBRAM" CONFIG "TriggerInterface" "reg" CONFIG "EcuWatchdogControlDisabled" "0" CONFIG "EcuWatchdogEnabled" "1" DISPLAY_NAME "XETK-S20/21" /end XETK
  /begin XETK 4 CONFIG "CpuType" "TC37xED_A" CONFIG "BaseId" "14" CONFIG "Extension" "2" CONFIG "DapClockSpeed" "100" CONFIG "DapBlock" "1" CONFIG "Dap2Pin" "0" CONFIG "EcuWatchdogPolarity" "1" CONFIG "HandshakeTimeout" "-1" CONFIG "EcuTrigRegPollRate" "50" CONFIG "PowerFailDetection" "SBRAM" CONFIG "TriggerInterface" "reg" CONFIG "EcuWatchdogControlDisabled" "0" CONFIG "EcuWatchdogEnabled" "1" DISPLAY_NAME "XETK-S30/31" /end XETK
  /begin XETK 5 CONFIG "CpuType" "TC37xED_A" CONFIG "BaseId" "16" CONFIG "Extension" "2" CONFIG "DapClockSpeed" "100" CONFIG "DapBlock" "1" CONFIG "Dap2Pin" "0" CONFIG "EcuWatchdogPolarity" "1" CONFIG "HandshakeTimeout" "-1" CONFIG "EcuTrigRegPollRate" "50" CONFIG "PowerFailDetection" "SBRAM" CONFIG "TriggerInterface" "reg" CONFIG "EcuWatchdogControlDisabled" "0" CONFIG "EcuWatchdogEnabled" "1" DISPLAY_NAME "BR-XETK-S1/2" /end XETK
  /begin FETK 7 CONFIG "CpuType" "TC37xED_A" CONFIG "BaseId" "6" CONFIG "Extension" "0" CONFIG "DapClockSpeed" "100" CONFIG "Dap2Pin" "0" CONFIG "WatchdogControlDisabled" "0" CONFIG "WatchdogDisable" "0" CONFIG "WatchdogPolarity" "1" CONFIG "StartupTimeout" "-1" DISPLAY_NAME "FETK-T1/2 (Serial debug interface based data acquisition)" /end FETK
  /begin FETK 8 CONFIG "CpuType" "TC37xED_A" CONFIG "BaseId" "7" CONFIG "Extension" "0" CONFIG "DapClockSpeed" "100" CONFIG "Dap2Pin" "0" CONFIG "WatchdogControlDisabled" "0" CONFIG "WatchdogDisable" "0" CONFIG "WatchdogPolarity" "1" CONFIG "StartupTimeout" "-1" DISPLAY_NAME "FETK-S1/2 " /end FETK
  /begin RASTER_CHECK OFFLINE_DEVICE 1 /* device with id 1 is the default device for offline raster check */ ONLINE_RESPECT_OFFLINE_LIMIT /end RASTER_CHECK
 /end ETK_XETK_LIST
 /begin TP_BLOB /* ByteOrder */ BYTE_ORDER_MSB_LAST /begin DISTAB_CFG /* Distab Type */ 17 /end DISTAB_CFG
  /begin ECU_EVENT_LIST 0xB92F6720 /* start address of ECU event list */ ETK_XETK_REF 1 2 3 4 5 7 8 /end ECU_EVENT_LIST
  TABLE_ALIGNMENT ALIGNMENT_4_BYTE
  /begin EVENT_CONFIG_OUTPUT_AREA 0xB92FB5F0 /* start of event config area */ 12324 /* size in bytes of event config area */ 0xB92FE614 /* start of event output area */ 6144 /* size in bytes of event output area */ ETK_XETK_REF 1 2 3 4 5 7 8 /end EVENT_CONFIG_OUTPUT_AREA
  /begin DATA_ACQUISITION PRIORITY_RANGE 1 4 ETK_XETK_REF 1 2 3 4 5 7 8 /end DATA_ACQUISITION
  /begin ECU_PROPERTY OVERALL_PERFORMANCE 303030 1212120 CORE_PERFORMANCE 3 303030 1212120 CORE_PERFORMANCE 1 454545 1818180 CORE_PERFORMANCE 2 454545 1818180 ETK_XETK_REF 1 2 3 4 5 7 8 /end ECU_PROPERTY
  /begin TRIGGER_CFG TRIGGER 29 DIRECT ECU_ID 29 TRIGGER 30 DIRECT ECU_ID 30 TRIGGER 31 DIRECT ECU_ID 31 TRIGGER 32 DIRECT ECU_ID 32 ETK_XETK_REF 1 2 3 4 5 /end TRIGGER_CFG
  /begin TRIGGER_CFG TRIGGER 93 DIRECT ECU_ID 93 TRIGGER 94 DIRECT ECU_ID 94 TRIGGER 95 DIRECT ECU_ID 95 TRIGGER 96 DIRECT ECU_ID 96 ETK_XETK_REF 7 8 /end TRIGGER_CFG
  /begin CODE_CHK /* Address ECU DATA section */ 0x804D8118 /* Address ECU RAM section */ 0xB92FFFC4 /* Length ECU DATA sections */ 8 PATTERN_REFRESH_TIMEOUT 0x200 ERROR_BEHAVIOR PERMANENT_RESET ETK_XETK_REF 1 2 3 4 5 7 8 /end CODE_CHK
  /begin COLDSTART_HANDSHAKE /* Address of ETKS coldstart pattern */ 0xB92FFFDC WAIT /* Dyn. length for wait pattern */ 0xE5 0xAD 0xEC 0x4D READY /* Dyn. length for ready pattern */ 0xDE 0xC0 0xED 0xFE ETK_XETK_REF 1 2 3 4 5 7 8 /end COLDSTART_HANDSHAKE
  /begin PAGE_SWITCH_METHOD 2 /* version */ MAILBOX 3 /* MBX_Version */ /* Version of mailbox */ 200 /* MBX_PageSetupTime */ /* max time the ECU needs to set up page in ms */ 0xB92FFFF4 /* MBX_StartAddress */ /* Start address of table */ AUTOSTART_BEHAVIOR LAST_ACTIVE_PAGE /* Table to be filled by INCA with info */ /* for the current active page */ OMD 0xB92FFE18 /* OMD_ADDRESS */ 2 /* OMD_CID */ 0 /* OMD_VERSION */ 0x1A8 /* OMD_MAX_LEN */ 23 /* OMD_NUMBER_OF_EMU_HANDLES */ CODE_CHK_PATTERN_WP 0xB92FFFCC /* Start address of WP CodeCheck Pattern */ ETK_XETK_REF 1 2 3 4 5 7 8 /end PAGE_SWITCH_METHOD
  /begin ECU_DEFINED_ERRORCODES ERROR_ENTRY 0x00000001 "OMD error" ERROR_ENTRY 0x45525201 "ECU will be reset - STOP engine!" ERROR_ENTRY 0x45525202 "ECU does not support Programming at T15 OFF" ERROR_ENTRY 0x45525203 "Mail Box Version is invalid" ERROR_ENTRY 0x45525204 "Call Back Function is not configured" /end ECU_DEFINED_ERRORCODES
  /begin DATA_FREEZE CONFIG "SAFETY_MAILBOX_ADDRESS" "0xB92FFFE8" CONFIG "SAFETY_MAILBOX_VERSION" "0x4D310100" CONFIG "SAFETY_MAILBOX_WAITMSG" "Datafreeze is pending" CONFIG "SAFETY_MAILBOX_WAITTOUT" "2000" CONFIG "STARTUP_MAILBOX_ADDRESS" "0x7003BE00" CONFIG "STARTUP_MAILBOX_VERSION" "0x4D320100" CONFIG "VALIDATE_PATTERN" "0x804D8000 0x100" CONFIG "INVALIDATE_PATTERN" "0x804D8120 0x00044408000004009011000208408C0090508808031010614000280812047640" ETK_XETK_REF 1 2 3 4 5 7 8 /end DATA_FREEZE
 /end TP_BLOB
 /begin SOURCE "segment synchronous" 103 1
  /begin QP_BLOB 2 3 2000
   /begin ETK_XETK_SPECIFIC TRG_NBR 0 /begin ECU_PROPERTY PERFORMANCE 2 757575 3030300 /end ECU_PROPERTY ETK_XETK_REF 1 2 3 4 5 7 8 /end ETK_XETK_SPECIFIC
  /end QP_BLOB
 /end SOURCE
 /begin SOURCE "10ms time synchronous" 4 1
  /begin QP_BLOB 3 2 9000
   /begin ETK_XETK_SPECIFIC TRG_NBR 0 /begin ECU_PROPERTY PERFORMANCE 1 151515 606060 /end ECU_PROPERTY ETK_XETK_REF 1 2 3 4 5 7 8 /end ETK_XETK_SPECIFIC
  /end QP_BLOB
 /end SOURCE
 /begin SOURCE "100ms time synchronous" 5 1
  /begin QP_BLOB 4 1 90000
   /begin ETK_XETK_SPECIFIC TRG_NBR 0 /begin ECU_PROPERTY PERFORMANCE 1 15151 60604 /end ECU_PROPERTY ETK_XETK_REF 1 2 3 4 5 7 8 /end ETK_XETK_SPECIFIC
  /end QP_BLOB
 /end SOURCE
 /begin SOURCE "1ms time synchronous" 3 1
  /begin QP_BLOB 1 4 900
   /begin ETK_XETK_SPECIFIC TRG_NBR 0 /begin ECU_PROPERTY PERFORMANCE 1 1515151 6060604 /end ECU_PROPERTY ETK_XETK_REF 1 2 3 4 5 7 8 /end ETK_XETK_SPECIFIC
  /end QP_BLOB
 /end SOURCE
/end IF_DATA
/begin IF_DATA ASAP1B_DIAGNOSTIC_SERVICES /* Definition for KWP2000 on CAN and K-Line */
 /begin SOURCE "10msec" 4 /* Scaling Unit: 4 = 10 ms */ 1 /* Rate in Scaling Unit: 1 */ /* Refresh rate = 10 ms * 1 = 10 */ /* Codes for Scaling units (CSE) look at */ /* ASAP1b Spezifikation */ QP_BLOB /* QP-BLOB includes special info about measure sampling rate */ QP_BLOB_VERSION 0x0300 /* Measurement mode of ECU: Blockmode */ ADDRESSMODE MAX_NO_OF_SIGNALS 56 /* max. number of signals */ MAX_NO_OF_BYTES 56 /* Block mode: local identifier */ AVAILABLE_ON CAN /* availability of this raster : K-line, CAN or both */ /end SOURCE
 /begin SOURCE "100msec" 5 /* Scaling Unit: 5 = 100 ms */ 1 /* Rate in Scaling Unit: 1 */ /* Refresh rate = 10 ms * 1 = 10 */ /* Codes for Scaling units (CSE) look at */ /* ASAP1b Spezifikation */ QP_BLOB /* QP-BLOB includes special info about measure sampling rate */ QP_BLOB_VERSION 0x0300 /* Measurement mode of ECU: Blockmode */ ADDRESSMODE MAX_NO_OF_SIGNALS 56 /* max. number of signals */ MAX_NO_OF_BYTES 56 /* Block mode: local identifier */ AVAILABLE_ON CAN /* availability of this raster : K-line, CAN or both */ /end SOURCE
 /* TP-Blob includes general information for the ASAP1b-driver */
 /begin TP_BLOB /* blob version */ 0x300 /* KWP2000 version */ ISO14229_1_2003 /* byte order in measurements and characteristics */ BYTEORDER_MSB_LAST /begin SESSION "extendedDiagnosticSession" 0x03 /end SESSION /begin SECURITY_ACCESS 0x41 /* accMode */ 1 /* calcmethod */ 0 /* delay */ /end SECURITY_ACCESS /begin ADDRESS_AND_LENGTH_FORMAT_IDENTIFIER 0x44 AALFI_FOR_READ_MEMORY_BY_ADDR 0x14 /end ADDRESS_AND_LENGTH_FORMAT_IDENTIFIER
  /begin CAN /* Baudrate [Hz] */ 500000 /* Sample point [% complete bit time] */ SamplePoint 60 /* 1 or 3 samples per bit */ SamplesPerBit 1 /* BTL_CYCLES [slots/bit time] */ BTL_CYCLES 19 /* SJW length synchr. segm. In BTL_CYCLES */ SJW 3 /* SYNC_EDGE */ SYNC_EDGE 0
   /begin ADDRESS /* CAN_ID ECU (gateway)EINCA */ 0x98DAF110 /* CAN_ID INCA EECU (gateway) */ 0x98DA10F1 /* TGT_ECU 0x10 Extended / remote address ECU */ /* TGT_INCA 0xF1 Extended address INCA */ /end ADDRESS
   /begin TransportProtocolVersion ISO15765_2_2003 /end TransportProtocolVersion
   NETWORK_LIMITS /* WFT_MAX */ 10 /* XDL_MAX */ 0xFFF /* AS BS Cr P2min P2max P3min P3max in ms */ USDTP_TIMING_DEFAULTS 8192 256 256 0 50 3 512 USDTP_TIMING 4096 256 256 25 50 55 5000 /end CAN
 /end TP_BLOB
/end IF_DATA
/begin IF_DATA XCPplus 0x0102
 /begin PAG /* MAX_SEGMENTS */ 20 /end PAG
 /begin PROTOCOL_LAYER 0x0102 1000 1000 0 0 0 0 0 8 8 BYTE_ORDER_MSB_LAST ADDRESS_GRANULARITY_BYTE OPTIONAL_CMD GET_COMM_MODE_INFO OPTIONAL_CMD SET_MTA OPTIONAL_CMD UPLOAD OPTIONAL_CMD SHORT_UPLOAD OPTIONAL_CMD BUILD_CHECKSUM OPTIONAL_CMD DOWNLOAD OPTIONAL_CMD DOWNLOAD_NEXT OPTIONAL_CMD DOWNLOAD_MAX OPTIONAL_CMD SET_CAL_PAGE OPTIONAL_CMD GET_CAL_PAGE OPTIONAL_CMD COPY_CAL_PAGE OPTIONAL_CMD CLEAR_DAQ_LIST OPTIONAL_CMD SET_DAQ_PTR OPTIONAL_CMD WRITE_DAQ OPTIONAL_CMD SET_DAQ_LIST_MODE OPTIONAL_CMD START_STOP_DAQ_LIST OPTIONAL_CMD START_STOP_SYNCH OPTIONAL_CMD FREE_DAQ OPTIONAL_CMD ALLOC_DAQ OPTIONAL_CMD ALLOC_ODT OPTIONAL_CMD ALLOC_ODT_ENTRY COMMUNICATION_MODE_SUPPORTED BLOCK SLAVE MASTER 255 0 /end PROTOCOL_LAYER
 /begin DAQ DYNAMIC 65535 3 0 OPTIMISATION_TYPE_DEFAULT ADDRESS_EXTENSION_FREE IDENTIFICATION_FIELD_TYPE_ABSOLUTE GRANULARITY_ODT_ENTRY_SIZE_DAQ_BYTE 255 OVERLOAD_INDICATION_EVENT PRESCALER_SUPPORTED /begin DAQ_MEMORY_CONSUMPTION 5495 46 6 5 2 0 /end DAQ_MEMORY_CONSUMPTION
  /begin EVENT "segment synchronous" "seg_sync" 0 DAQ 1 0 5 7 CONSISTENCY EVENT /begin MIN_CYCLE_TIME 43 5 /end MIN_CYCLE_TIME /end EVENT
  /begin EVENT "10ms time synchronous" "10_ms" 1 DAQ 1 10 6 6 CONSISTENCY EVENT /end EVENT
  /begin EVENT "100ms time synchronous" "100_ms" 2 DAQ 1 100 6 5 CONSISTENCY EVENT /end EVENT
 /end DAQ
 /begin XCP_ON_CAN 0x0102 CAN_ID_MASTER 0x7F0 CAN_ID_SLAVE 0x7F1 BAUDRATE 500000 SAMPLE_POINT 81 BTL_CYCLES 16 SJW 3 MAX_BUS_LOAD 88
  /begin PROTOCOL_LAYER 0x0102 1000 1000 0 0 0 0 0 8 8 BYTE_ORDER_MSB_LAST ADDRESS_GRANULARITY_BYTE OPTIONAL_CMD GET_COMM_MODE_INFO OPTIONAL_CMD SET_MTA OPTIONAL_CMD UPLOAD OPTIONAL_CMD SHORT_UPLOAD OPTIONAL_CMD BUILD_CHECKSUM OPTIONAL_CMD DOWNLOAD OPTIONAL_CMD DOWNLOAD_NEXT OPTIONAL_CMD DOWNLOAD_MAX OPTIONAL_CMD SET_CAL_PAGE OPTIONAL_CMD GET_CAL_PAGE OPTIONAL_CMD COPY_CAL_PAGE OPTIONAL_CMD CLEAR_DAQ_LIST OPTIONAL_CMD SET_DAQ_PTR OPTIONAL_CMD WRITE_DAQ OPTIONAL_CMD SET_DAQ_LIST_MODE OPTIONAL_CMD START_STOP_DAQ_LIST OPTIONAL_CMD START_STOP_SYNCH OPTIONAL_CMD FREE_DAQ OPTIONAL_CMD ALLOC_DAQ OPTIONAL_CMD ALLOC_ODT OPTIONAL_CMD ALLOC_ODT_ENTRY COMMUNICATION_MODE_SUPPORTED BLOCK SLAVE MASTER 255 0 /end PROTOCOL_LAYER
  /begin DAQ DYNAMIC 65535 3 0 OPTIMISATION_TYPE_DEFAULT ADDRESS_EXTENSION_FREE IDENTIFICATION_FIELD_TYPE_ABSOLUTE GRANULARITY_ODT_ENTRY_SIZE_DAQ_BYTE 255 OVERLOAD_INDICATION_EVENT PRESCALER_SUPPORTED /begin DAQ_MEMORY_CONSUMPTION 5495 46 6 5 2 0 /end DAQ_MEMORY_CONSUMPTION
   /begin EVENT "segment synchronous" "seg_sync" 0 DAQ 1 0 5 7 CONSISTENCY EVENT /begin MIN_CYCLE_TIME 43 5 /end MIN_CYCLE_TIME /end EVENT
   /begin EVENT "10ms time synchronous" "10_ms" 1 DAQ 1 10 6 6 CONSISTENCY EVENT /end EVENT
   /begin EVENT "100ms time synchronous" "100_ms" 2 DAQ 1 100 6 5 CONSISTENCY EVENT /end EVENT
  /end DAQ
  TRANSPORT_LAYER_INSTANCE "Calibration CAN (APPL)" /end XCP_ON_CAN
 /begin XCP_ON_CAN 0x0102 CAN_ID_MASTER 0x7F0 CAN_ID_SLAVE 0x7F1 BAUDRATE 500000 SAMPLE_POINT 81 BTL_CYCLES 16 SJW 3 MAX_BUS_LOAD 88
  /begin PROTOCOL_LAYER 0x0102 1000 1000 0 0 0 0 0 8 8 BYTE_ORDER_MSB_LAST ADDRESS_GRANULARITY_BYTE OPTIONAL_CMD GET_COMM_MODE_INFO OPTIONAL_CMD SET_MTA OPTIONAL_CMD UPLOAD OPTIONAL_CMD SHORT_UPLOAD OPTIONAL_CMD BUILD_CHECKSUM OPTIONAL_CMD DOWNLOAD OPTIONAL_CMD DOWNLOAD_NEXT OPTIONAL_CMD DOWNLOAD_MAX OPTIONAL_CMD SET_CAL_PAGE OPTIONAL_CMD GET_CAL_PAGE OPTIONAL_CMD COPY_CAL_PAGE OPTIONAL_CMD CLEAR_DAQ_LIST OPTIONAL_CMD SET_DAQ_PTR OPTIONAL_CMD WRITE_DAQ OPTIONAL_CMD SET_DAQ_LIST_MODE OPTIONAL_CMD START_STOP_DAQ_LIST OPTIONAL_CMD START_STOP_SYNCH OPTIONAL_CMD FREE_DAQ OPTIONAL_CMD ALLOC_DAQ OPTIONAL_CMD ALLOC_ODT OPTIONAL_CMD ALLOC_ODT_ENTRY COMMUNICATION_MODE_SUPPORTED BLOCK SLAVE MASTER 255 0 /end PROTOCOL_LAYER
  /begin DAQ DYNAMIC 65535 3 0 OPTIMISATION_TYPE_DEFAULT ADDRESS_EXTENSION_FREE IDENTIFICATION_FIELD_TYPE_ABSOLUTE GRANULARITY_ODT_ENTRY_SIZE_DAQ_BYTE 255 OVERLOAD_INDICATION_EVENT PRESCALER_SUPPORTED /begin DAQ_MEMORY_CONSUMPTION 19995 46 6 5 2 0 /end DAQ_MEMORY_CONSUMPTION
   /begin EVENT "segment synchronous" "seg_sync" 0 DAQ 1 0 5 7 CONSISTENCY EVENT /begin MIN_CYCLE_TIME 43 5 /end MIN_CYCLE_TIME /end EVENT
   /begin EVENT "10ms time synchronous" "10_ms" 1 DAQ 1 10 6 6 CONSISTENCY EVENT /end EVENT
   /begin EVENT "100ms time synchronous" "100_ms" 2 DAQ 1 100 6 5 CONSISTENCY EVENT /end EVENT
  /end DAQ
  TRANSPORT_LAYER_INSTANCE "Calibration CAN (APPL) (ED-RAM)" /end XCP_ON_CAN
 /begin XCP_ON_CAN 0x0102 CAN_ID_MASTER 0x7F0 CAN_ID_SLAVE 0x7F1 BAUDRATE 500000 SAMPLE_POINT 81 BTL_CYCLES 16 SJW 3 MAX_BUS_LOAD 55
  /begin PROTOCOL_LAYER 0x0102 1000 1000 0 0 0 0 0 8 8 BYTE_ORDER_MSB_LAST ADDRESS_GRANULARITY_BYTE OPTIONAL_CMD GET_COMM_MODE_INFO OPTIONAL_CMD SET_MTA OPTIONAL_CMD UPLOAD OPTIONAL_CMD SHORT_UPLOAD OPTIONAL_CMD BUILD_CHECKSUM OPTIONAL_CMD DOWNLOAD OPTIONAL_CMD DOWNLOAD_NEXT OPTIONAL_CMD DOWNLOAD_MAX OPTIONAL_CMD SET_CAL_PAGE OPTIONAL_CMD GET_CAL_PAGE OPTIONAL_CMD COPY_CAL_PAGE OPTIONAL_CMD CLEAR_DAQ_LIST OPTIONAL_CMD SET_DAQ_PTR OPTIONAL_CMD WRITE_DAQ OPTIONAL_CMD SET_DAQ_LIST_MODE OPTIONAL_CMD START_STOP_DAQ_LIST OPTIONAL_CMD START_STOP_SYNCH OPTIONAL_CMD FREE_DAQ OPTIONAL_CMD ALLOC_DAQ OPTIONAL_CMD ALLOC_ODT OPTIONAL_CMD ALLOC_ODT_ENTRY COMMUNICATION_MODE_SUPPORTED BLOCK SLAVE MASTER 255 0 /end PROTOCOL_LAYER
  /begin DAQ DYNAMIC 65535 3 0 OPTIMISATION_TYPE_DEFAULT ADDRESS_EXTENSION_FREE IDENTIFICATION_FIELD_TYPE_ABSOLUTE GRANULARITY_ODT_ENTRY_SIZE_DAQ_BYTE 255 OVERLOAD_INDICATION_EVENT PRESCALER_SUPPORTED /begin DAQ_MEMORY_CONSUMPTION 5495 46 6 5 2 0 /end DAQ_MEMORY_CONSUMPTION
   /begin EVENT "segment synchronous" "seg_sync" 0 DAQ 1 0 5 7 CONSISTENCY EVENT /begin MIN_CYCLE_TIME 43 5 /end MIN_CYCLE_TIME /end EVENT
   /begin EVENT "10ms time synchronous" "10_ms" 1 DAQ 1 10 6 6 CONSISTENCY EVENT /end EVENT
   /begin EVENT "100ms time synchronous" "100_ms" 2 DAQ 1 100 6 5 CONSISTENCY EVENT /end EVENT
  /end DAQ
  TRANSPORT_LAYER_INSTANCE "Vehicle CAN (VEHICLE)" /end XCP_ON_CAN
 /begin XCP_ON_CAN 0x0102 CAN_ID_MASTER 0x7F0 CAN_ID_SLAVE 0x7F1 BAUDRATE 500000 SAMPLE_POINT 81 BTL_CYCLES 16 SJW 3 MAX_BUS_LOAD 55
  /begin PROTOCOL_LAYER 0x0102 1000 1000 0 0 0 0 0 8 8 BYTE_ORDER_MSB_LAST ADDRESS_GRANULARITY_BYTE OPTIONAL_CMD GET_COMM_MODE_INFO OPTIONAL_CMD SET_MTA OPTIONAL_CMD UPLOAD OPTIONAL_CMD SHORT_UPLOAD OPTIONAL_CMD BUILD_CHECKSUM OPTIONAL_CMD DOWNLOAD OPTIONAL_CMD DOWNLOAD_NEXT OPTIONAL_CMD DOWNLOAD_MAX OPTIONAL_CMD SET_CAL_PAGE OPTIONAL_CMD GET_CAL_PAGE OPTIONAL_CMD COPY_CAL_PAGE OPTIONAL_CMD CLEAR_DAQ_LIST OPTIONAL_CMD SET_DAQ_PTR OPTIONAL_CMD WRITE_DAQ OPTIONAL_CMD SET_DAQ_LIST_MODE OPTIONAL_CMD START_STOP_DAQ_LIST OPTIONAL_CMD START_STOP_SYNCH OPTIONAL_CMD FREE_DAQ OPTIONAL_CMD ALLOC_DAQ OPTIONAL_CMD ALLOC_ODT OPTIONAL_CMD ALLOC_ODT_ENTRY COMMUNICATION_MODE_SUPPORTED BLOCK SLAVE MASTER 255 0 /end PROTOCOL_LAYER
  /begin DAQ DYNAMIC 65535 3 0 OPTIMISATION_TYPE_DEFAULT ADDRESS_EXTENSION_FREE IDENTIFICATION_FIELD_TYPE_ABSOLUTE GRANULARITY_ODT_ENTRY_SIZE_DAQ_BYTE 255 OVERLOAD_INDICATION_EVENT PRESCALER_SUPPORTED /begin DAQ_MEMORY_CONSUMPTION 19995 46 6 5 2 0 /end DAQ_MEMORY_CONSUMPTION
   /begin EVENT "segment synchronous" "seg_sync" 0 DAQ 1 0 5 7 CONSISTENCY EVENT /begin MIN_CYCLE_TIME 43 5 /end MIN_CYCLE_TIME /end EVENT
   /begin EVENT "10ms time synchronous" "10_ms" 1 DAQ 1 10 6 6 CONSISTENCY EVENT /end EVENT
   /begin EVENT "100ms time synchronous" "100_ms" 2 DAQ 1 100 6 5 CONSISTENCY EVENT /end EVENT
  /end DAQ
  TRANSPORT_LAYER_INSTANCE "Vehicle CAN (VEHICLE) (ED-RAM)" /end XCP_ON_CAN
 /begin XCP_ON_CAN 0x0102 CAN_ID_MASTER 0x7F0 CAN_ID_SLAVE 0x7F1 BAUDRATE 500000 SAMPLE_POINT 81 BTL_CYCLES 16 SJW 3 MAX_BUS_LOAD 88
  /begin PROTOCOL_LAYER 0x0102 1000 1000 0 0 0 0 0 8 8 BYTE_ORDER_MSB_LAST ADDRESS_GRANULARITY_BYTE OPTIONAL_CMD GET_COMM_MODE_INFO OPTIONAL_CMD SET_MTA OPTIONAL_CMD UPLOAD OPTIONAL_CMD SHORT_UPLOAD OPTIONAL_CMD BUILD_CHECKSUM OPTIONAL_CMD DOWNLOAD OPTIONAL_CMD DOWNLOAD_NEXT OPTIONAL_CMD DOWNLOAD_MAX OPTIONAL_CMD SET_CAL_PAGE OPTIONAL_CMD GET_CAL_PAGE OPTIONAL_CMD COPY_CAL_PAGE OPTIONAL_CMD CLEAR_DAQ_LIST OPTIONAL_CMD SET_DAQ_PTR OPTIONAL_CMD WRITE_DAQ OPTIONAL_CMD SET_DAQ_LIST_MODE OPTIONAL_CMD START_STOP_DAQ_LIST OPTIONAL_CMD START_STOP_SYNCH OPTIONAL_CMD FREE_DAQ OPTIONAL_CMD ALLOC_DAQ OPTIONAL_CMD ALLOC_ODT OPTIONAL_CMD ALLOC_ODT_ENTRY COMMUNICATION_MODE_SUPPORTED BLOCK SLAVE MASTER 255 0 /end PROTOCOL_LAYER
  /begin DAQ DYNAMIC 65535 3 0 OPTIMISATION_TYPE_DEFAULT ADDRESS_EXTENSION_FREE IDENTIFICATION_FIELD_TYPE_ABSOLUTE GRANULARITY_ODT_ENTRY_SIZE_DAQ_BYTE 255 OVERLOAD_INDICATION_EVENT PRESCALER_SUPPORTED /begin DAQ_MEMORY_CONSUMPTION 5495 46 6 5 2 0 /end DAQ_MEMORY_CONSUMPTION
   /begin EVENT "segment synchronous" "seg_sync" 0 DAQ 1 0 5 7 CONSISTENCY EVENT /begin MIN_CYCLE_TIME 43 5 /end MIN_CYCLE_TIME /end EVENT
   /begin EVENT "10ms time synchronous" "10_ms" 1 DAQ 1 10 6 6 CONSISTENCY EVENT /end EVENT
   /begin EVENT "100ms time synchronous" "100_ms" 2 DAQ 1 100 6 5 CONSISTENCY EVENT /end EVENT
  /end DAQ
  TRANSPORT_LAYER_INSTANCE "CAN Channel (CAN C)" /end XCP_ON_CAN
 /begin XCP_ON_CAN 0x0102 CAN_ID_MASTER 0x7F0 CAN_ID_SLAVE 0x7F1 BAUDRATE 500000 SAMPLE_POINT 81 BTL_CYCLES 16 SJW 3 MAX_BUS_LOAD 88
  /begin PROTOCOL_LAYER 0x0102 1000 1000 0 0 0 0 0 8 8 BYTE_ORDER_MSB_LAST ADDRESS_GRANULARITY_BYTE OPTIONAL_CMD GET_COMM_MODE_INFO OPTIONAL_CMD SET_MTA OPTIONAL_CMD UPLOAD OPTIONAL_CMD SHORT_UPLOAD OPTIONAL_CMD BUILD_CHECKSUM OPTIONAL_CMD DOWNLOAD OPTIONAL_CMD DOWNLOAD_NEXT OPTIONAL_CMD DOWNLOAD_MAX OPTIONAL_CMD SET_CAL_PAGE OPTIONAL_CMD GET_CAL_PAGE OPTIONAL_CMD COPY_CAL_PAGE OPTIONAL_CMD CLEAR_DAQ_LIST OPTIONAL_CMD SET_DAQ_PTR OPTIONAL_CMD WRITE_DAQ OPTIONAL_CMD SET_DAQ_LIST_MODE OPTIONAL_CMD START_STOP_DAQ_LIST OPTIONAL_CMD START_STOP_SYNCH OPTIONAL_CMD FREE_DAQ OPTIONAL_CMD ALLOC_DAQ OPTIONAL_CMD ALLOC_ODT OPTIONAL_CMD ALLOC_ODT_ENTRY COMMUNICATION_MODE_SUPPORTED BLOCK SLAVE MASTER 255 0 /end PROTOCOL_LAYER
  /begin DAQ DYNAMIC 65535 3 0 OPTIMISATION_TYPE_DEFAULT ADDRESS_EXTENSION_FREE IDENTIFICATION_FIELD_TYPE_ABSOLUTE GRANULARITY_ODT_ENTRY_SIZE_DAQ_BYTE 255 OVERLOAD_INDICATION_EVENT PRESCALER_SUPPORTED /begin DAQ_MEMORY_CONSUMPTION 19995 46 6 5 2 0 /end DAQ_MEMORY_CONSUMPTION
   /begin EVENT "segment synchronous" "seg_sync" 0 DAQ 1 0 5 7 CONSISTENCY EVENT /begin MIN_CYCLE_TIME 43 5 /end MIN_CYCLE_TIME /end EVENT
   /begin EVENT "10ms time synchronous" "10_ms" 1 DAQ 1 10 6 6 CONSISTENCY EVENT /end EVENT
   /begin EVENT "100ms time synchronous" "100_ms" 2 DAQ 1 100 6 5 CONSISTENCY EVENT /end EVENT
  /end DAQ
  TRANSPORT_LAYER_INSTANCE "CAN Channel (CAN C) (ED-RAM)" /end XCP_ON_CAN
/end IF_DATA
/*********** Start of merged CHARACTERISTIC blocks ***********/
/begin CHARACTERISTIC CanIf_CanIfRxPduCfg_EAT10_RXCanDlc_C "Calibration parameter for the Data length of CAN frame CanIfRxPduCfg_EAT10_RX" VALUE 0x804D8645 DefaultValueRecordLayout_AUTOSAR_Platform_BaseTypes_uint8 8.0 RB_RBA_Common_CentralElements_CompuMethods_Identical 0.0 8. FORMAT "%5.0" /end CHARACTERISTIC
/begin CHARACTERISTIC CanIf_CanIfRxPduCfg_EAT11_RXCanDlc_C "Calibration parameter for the Data length of CAN frame CanIfRxPduCfg_EAT11_RX" VALUE 0x804D8644 DefaultValueRecordLayout_AUTOSAR_Platform_BaseTypes_uint8 8.0 RB_RBA_Common_CentralElements_CompuMethods_Identical 0.0 8. FORMAT "%5.0" /end CHARACTERISTIC
/begin CHARACTERISTIC CanIf_CanIfRxPduCfg_EAT12_RXCanDlc_C "Calibration parameter for the Data length of CAN frame CanIfRxPduCfg_EAT12_RX" VALUE 0x804D8643 DefaultValueRecordLayout_AUTOSAR_Platform_BaseTypes_uint8 2.0 RB_RBA_Common_CentralElements_CompuMethods_Identical 0.0 2. FORMAT "%5.0" /end CHARACTERISTIC
/begin CHARACTERISTIC CanIf_CanIfRxPduCfg_EAT13_RXCanDlc_C "Calibration parameter for the Data length of CAN frame CanIfRxPduCfg_EAT13_RX" VALUE 0x804D8642 DefaultValueRecordLayout_AUTOSAR_Platform_BaseTypes_uint8 3.0 RB_RBA_Common_CentralElements_CompuMethods_Identical 0.0 3. FORMAT "%5.0" /end CHARACTERISTIC
/begin CHARACTERISTIC CanIf_CanIfRxPduCfg_EAT4_RXCanDlc_C "Calibration parameter for the Data length of CAN frame CanIfRxPduCfg_EAT4_RX" VALUE 0x804D8641 DefaultValueRecordLayout_AUTOSAR_Platform_BaseTypes_uint8 8.0 RB_RBA_Common_CentralElements_CompuMethods_Identical 0.0 8. FORMAT "%5.0" /end CHARACTERISTIC
/begin CHARACTERISTIC CanIf_CanIfRxPduCfg_EAT6_RXCanDlc_C "Calibration parameter for the Data length of CAN frame CanIfRxPduCfg_EAT6_RX" VALUE 0x804D8640 DefaultValueRecordLayout_AUTOSAR_Platform_BaseTypes_uint8 3.0 RB_RBA_Common_CentralElements_CompuMethods_Identical 0.0 3. FORMAT "%5.0" /end CHARACTERISTIC
/begin CHARACTERISTIC CanIf_CanIfRxPduCfg_EAT7_RXCanDlc_C "Calibration parameter for the Data length of CAN frame CanIfRxPduCfg_EAT7_RX" VALUE 0x804D863F DefaultValueRecordLayout_AUTOSAR_Platform_BaseTypes_uint8 8.0 RB_RBA_Common_CentralElements_CompuMethods_Identical 0.0 8. FORMAT "%5.0" /end CHARACTERISTIC
/begin CHARACTERISTIC CanIf_CanIfRxPduCfg_EAT8_RXCanDlc_C "Calibration parameter for the Data length of CAN frame CanIfRxPduCfg_EAT8_RX" VALUE 0x804D863E DefaultValueRecordLayout_AUTOSAR_Platform_BaseTypes_uint8 8.0 RB_RBA_Common_CentralElements_CompuMethods_Identical 0.0 8. FORMAT "%5.0" /end CHARACTERISTIC
/begin CHARACTERISTIC CanIf_CanIfRxPduCfg_EATA_RXCanDlc_C "Calibration parameter for the Data length of CAN frame CanIfRxPduCfg_EATA_RX" VALUE 0x804D863D DefaultValueRecordLayout_AUTOSAR_Platform_BaseTypes_uint8 8.0 RB_RBA_Common_CentralElements_CompuMethods_Identical 0.0 8. FORMAT "%5.0" /end CHARACTERISTIC
/begin CHARACTERISTIC CanIf_CanIfRxPduCfg_EATB_RXCanDlc_C "Calibration parameter for the Data length of CAN frame CanIfRxPduCfg_EATB_RX" VALUE 0x804D863C DefaultValueRecordLayout_AUTOSAR_Platform_BaseTypes_uint8 8.0 RB_RBA_Common_CentralElements_CompuMethods_Identical 0.0 8. FORMAT "%5.0" /end CHARACTERISTIC
/begin CHARACTERISTIC CanIf_CanIfRxPduCfg_EATC_RXCanDlc_C "Calibration parameter for the Data length of CAN frame CanIfRxPduCfg_EATC_RX" VALUE 0x804D863B DefaultValueRecordLayout_AUTOSAR_Platform_BaseTypes_uint8 8.0 RB_RBA_Common_CentralElements_CompuMethods_Identical 0.0 8. FORMAT "%5.0" /end CHARACTERISTIC
/begin CHARACTERISTIC CanIf_CanIfRxPduCfg_EBBA_RXCanDlc_C "Calibration parameter for the Data length of CAN frame CanIfRxPduCfg_EBBA_RX" VALUE 0x804D863A DefaultValueRecordLayout_AUTOSAR_Platform_BaseTypes_uint8 3.0 RB_RBA_Common_CentralElements_CompuMethods_Identical 0.0 3. FORMAT "%5.0" /end CHARACTERISTIC
/begin CHARACTERISTIC CanIf_CanIfRxPduCfg_EPS1_RXCanDlc_C "Calibration parameter for the Data length of CAN frame CanIfRxPduCfg_EPS1_RX" VALUE 0x804D8639 DefaultValueRecordLayout_AUTOSAR_Platform_BaseTypes_uint8 3.0 RB_RBA_Common_CentralElements_CompuMethods_Identical 0.0 3. FORMAT "%5.0" /end CHARACTERISTIC
/begin CHARACTERISTIC CanIf_CanIfRxPduCfg_META_RXCanDlc_C "Calibration parameter for the Data length of CAN frame CanIfRxPduCfg_META_RX" VALUE 0x804D8638 DefaultValueRecordLayout_AUTOSAR_Platform_BaseTypes_uint8 8.0 RB_RBA_Common_CentralElements_CompuMethods_Identical 0.0 8. FORMAT "%5.0" /end CHARACTERISTIC
/begin CHARACTERISTIC CanIf_CanIfRxPduCfg_METD2_RXCanDlc_C "Calibration parameter for the Data length of CAN frame CanIfRxPduCfg_METD2_RX" VALUE 0x804D8637 DefaultValueRecordLayout_AUTOSAR_Platform_BaseTypes_uint8 6.0 RB_RBA_Common_CentralElements_CompuMethods_Identical 0.0 6. FORMAT "%5.0" /end CHARACTERISTIC
/begin CHARACTERISTIC CanIf_CanIfRxPduCfg_METD_RXCanDlc_C "Calibration parameter for the Data length of CAN frame CanIfRxPduCfg_METD_RX" VALUE 0x804D8636 DefaultValueRecordLayout_AUTOSAR_Platform_BaseTypes_uint8 7.0 RB_RBA_Common_CentralElements_CompuMethods_Identical 0.0 7. FORMAT "%5.0" /end CHARACTERISTIC
/begin CHARACTERISTIC CanIf_CanIfRxPduCfg_METF_RXCanDlc_C "Calibration parameter for the Data length of CAN frame CanIfRxPduCfg_METF_RX" VALUE 0x804D8635 DefaultValueRecordLayout_AUTOSAR_Platform_BaseTypes_uint8 8.0 RB_RBA_Common_CentralElements_CompuMethods_Identical 0.0 8. FORMAT "%5.0" /end CHARACTERISTIC
/begin CHARACTERISTIC CanIf_CanIfRxPduCfg_METG_RXCanDlc_C "Calibration parameter for the Data length of CAN frame CanIfRxPduCfg_METG_RX" VALUE 0x804D8634 DefaultValueRecordLayout_AUTOSAR_Platform_BaseTypes_uint8 4.0 RB_RBA_Common_CentralElements_CompuMethods_Identical 0.0 4. FORMAT "%5.0" /end CHARACTERISTIC
/begin CHARACTERISTIC CanIf_CanIfRxPduCfg_METH2_RXCanDlc_C "Calibration parameter for the Data length of CAN frame CanIfRxPduCfg_METH2_RX" VALUE 0x804D8633 DefaultValueRecordLayout_AUTOSAR_Platform_BaseTypes_uint8 8.0 RB_RBA_Common_CentralElements_CompuMethods_Identical 0.0 8. FORMAT "%5.0" /end CHARACTERISTIC
/begin CHARACTERISTIC CanIf_CanIfRxPduCfg_METH_RXCanDlc_C "Calibration parameter for the Data length of CAN frame CanIfRxPduCfg_METH_RX" VALUE 0x804D8632 DefaultValueRecordLayout_AUTOSAR_Platform_BaseTypes_uint8 8.0 RB_RBA_Common_CentralElements_CompuMethods_Identical 0.0 8. FORMAT "%5.0" /end CHARACTERISTIC
/begin CHARACTERISTIC CanIf_CanIfRxPduCfg_METI_RXCanDlc_C "Calibration parameter for the Data length of CAN frame CanIfRxPduCfg_METI_RX" VALUE 0x804D8631 DefaultValueRecordLayout_AUTOSAR_Platform_BaseTypes_uint8 8.0 RB_RBA_Common_CentralElements_CompuMethods_Identical 0.0 8. FORMAT "%5.0" /end CHARACTERISTIC
/begin CHARACTERISTIC CanIf_CanIfRxPduCfg_METK_RXCanDlc_C "Calibration parameter for the Data length of CAN frame CanIfRxPduCfg_METK_RX" VALUE 0x804D8630 DefaultValueRecordLayout_AUTOSAR_Platform_BaseTypes_uint8 8.0 RB_RBA_Common_CentralElements_CompuMethods_Identical 0.0 8. FORMAT "%5.0" /end CHARACTERISTIC
/begin CHARACTERISTIC CanIf_CanIfRxPduCfg_METL_RXCanDlc_C "Calibration parameter for the Data length of CAN frame CanIfRxPduCfg_METL_RX" VALUE 0x804D862F DefaultValueRecordLayout_AUTOSAR_Platform_BaseTypes_uint8 4.0 RB_RBA_Common_CentralElements_CompuMethods_Identical 0.0 4. FORMAT "%5.0" /end CHARACTERISTIC
/begin CHARACTERISTIC CanIf_CanIfRxPduCfg_METM_RXCanDlc_C "Calibration parameter for the Data length of CAN frame CanIfRxPduCfg_METM_RX" VALUE 0x804D862E DefaultValueRecordLayout_AUTOSAR_Platform_BaseTypes_uint8 8.0 RB_RBA_Common_CentralElements_CompuMethods_Identical 0.0 8. FORMAT "%5.0" /end CHARACTERISTIC
/begin CHARACTERISTIC CanIf_CanIfRxPduCfg_METN_RXCanDlc_C "Calibration parameter for the Data length of CAN frame CanIfRxPduCfg_METN_RX" VALUE 0x804D862D DefaultValueRecordLayout_AUTOSAR_Platform_BaseTypes_uint8 4.0 RB_RBA_Common_CentralElements_CompuMethods_Identical 0.0 4. FORMAT "%5.0" /end CHARACTERISTIC
/begin CHARACTERISTIC CanIf_CanIfRxPduCfg_PCU_RXCanDlc_C "Calibration parameter for the Data length of CAN frame CanIfRxPduCfg_PCU_RX" VALUE 0x804D862C DefaultValueRecordLayout_AUTOSAR_Platform_BaseTypes_uint8 1.0 RB_RBA_Common_CentralElements_CompuMethods_Identical 0.0 1. FORMAT "%5.0" /end CHARACTERISTIC
/begin CHARACTERISTIC CanIf_CanIfRxPduCfg_SRSB_RXCanDlc_C "Calibration parameter for the Data length of CAN frame CanIfRxPduCfg_SRSB_RX" VALUE 0x804D862B DefaultValueRecordLayout_AUTOSAR_Platform_BaseTypes_uint8 3.0 RB_RBA_Common_CentralElements_CompuMethods_Identical 0.0 3. FORMAT "%5.0" /end CHARACTERISTIC
/begin CHARACTERISTIC CanIf_CanIfTxPduCfg_ENG10_TXCanDlc_C "Calibration parameter for the Data length of CAN frame CanIfTxPduCfg_ENG10_TX" VALUE 0x804D862A DefaultValueRecordLayout_AUTOSAR_Platform_BaseTypes_uint8 8.0 RB_RBA_Common_CentralElements_CompuMethods_Identical 0.0 8. FORMAT "%5.0" /end CHARACTERISTIC
/begin CHARACTERISTIC CanIf_CanIfTxPduCfg_ENG10_TXCanId_C "Calibration parameter for the CanId of CAN frame CanIfTxPduCfg_ENG10_TX" VALUE 0x804D849C DefaultValueRecordLayout_AUTOSAR_Platform_BaseTypes_uint32 2047.0 RB_RBA_Common_CentralElements_CompuMethods_Identical 0.0 2047. FORMAT "%5.0" /end CHARACTERISTIC
/begin CHARACTERISTIC CanIf_CanIfTxPduCfg_ENG11_TXCanDlc_C "Calibration parameter for the Data length of CAN frame CanIfTxPduCfg_ENG11_TX" VALUE 0x804D8629 DefaultValueRecordLayout_AUTOSAR_Platform_BaseTypes_uint8 8.0 RB_RBA_Common_CentralElements_CompuMethods_Identical 0.0 8. FORMAT "%5.0" /end CHARACTERISTIC
/begin CHARACTERISTIC CanIf_CanIfTxPduCfg_ENG11_TXCanId_C "Calibration parameter for the CanId of CAN frame CanIfTxPduCfg_ENG11_TX" VALUE 0x804D8498 DefaultValueRecordLayout_AUTOSAR_Platform_BaseTypes_uint32 2047.0 RB_RBA_Common_CentralElements_CompuMethods_Identical 0.0 2047. FORMAT "%5.0" /end CHARACTERISTIC
/begin CHARACTERISTIC CanIf_CanIfTxPduCfg_ENG15_TXCanDlc_C "Calibration parameter for the Data length of CAN frame CanIfTxPduCfg_ENG15_TX" VALUE 0x804D8628 DefaultValueRecordLayout_AUTOSAR_Platform_BaseTypes_uint8 8.0 RB_RBA_Common_CentralElements_CompuMethods_Identical 0.0 8. FORMAT "%5.0" /end CHARACTERISTIC
/begin CHARACTERISTIC CanIf_CanIfTxPduCfg_ENG15_TXCanId_C "Calibration parameter for the CanId of CAN frame CanIfTxPduCfg_ENG15_TX" VALUE 0x804D8494 DefaultValueRecordLayout_AUTOSAR_Platform_BaseTypes_uint32 2047.0 RB_RBA_Common_CentralElements_CompuMethods_Identical 0.0 2047. FORMAT "%5.0" /end CHARACTERISTIC
/begin CHARACTERISTIC CanIf_CanIfTxPduCfg_ENG16_TXCanDlc_C "Calibration parameter for the Data length of CAN frame CanIfTxPduCfg_ENG16_TX" VALUE 0x804D8627 DefaultValueRecordLayout_AUTOSAR_Platform_BaseTypes_uint8 8.0 RB_RBA_Common_CentralElements_CompuMethods_Identical 0.0 8. FORMAT "%5.0" /end CHARACTERISTIC
/begin CHARACTERISTIC CanIf_CanIfTxPduCfg_ENG16_TXCanId_C "Calibration parameter for the CanId of CAN frame CanIfTxPduCfg_ENG16_TX" VALUE 0x804D8490 DefaultValueRecordLayout_AUTOSAR_Platform_BaseTypes_uint32 2047.0 RB_RBA_Common_CentralElements_CompuMethods_Identical 0.0 2047. FORMAT "%5.0" /end CHARACTERISTIC
/begin CHARACTERISTIC CanIf_CanIfTxPduCfg_ENG17_TXCanDlc_C "Calibration parameter for the Data length of CAN frame CanIfTxPduCfg_ENG17_TX" VALUE 0x804D8626 DefaultValueRecordLayout_AUTOSAR_Platform_BaseTypes_uint8 8.0 RB_RBA_Common_CentralElements_CompuMethods_Identical 0.0 8. FORMAT "%5.0" /end CHARACTERISTIC
/begin CHARACTERISTIC CanIf_CanIfTxPduCfg_ENG17_TXCanId_C "Calibration parameter for the CanId of CAN frame CanIfTxPduCfg_ENG17_TX" VALUE 0x804D848C DefaultValueRecordLayout_AUTOSAR_Platform_BaseTypes_uint32 2047.0 RB_RBA_Common_CentralElements_CompuMethods_Identical 0.0 2047. FORMAT "%5.0" /end CHARACTERISTIC
/begin CHARACTERISTIC CanIf_CanIfTxPduCfg_ENG18_TXCanDlc_C "Calibration parameter for the Data length of CAN frame CanIfTxPduCfg_ENG18_TX" VALUE 0x804D8625 DefaultValueRecordLayout_AUTOSAR_Platform_BaseTypes_uint8 8.0 RB_RBA_Common_CentralElements_CompuMethods_Identical 0.0 8. FORMAT "%5.0" /end CHARACTERISTIC
/begin CHARACTERISTIC CanIf_CanIfTxPduCfg_ENG18_TXCanId_C "Calibration parameter for the CanId of CAN frame CanIfTxPduCfg_ENG18_TX" VALUE 0x804D8488 DefaultValueRecordLayout_AUTOSAR_Platform_BaseTypes_uint32 2047.0 RB_RBA_Common_CentralElements_CompuMethods_Identical 0.0 2047. FORMAT "%5.0" /end CHARACTERISTIC
/begin CHARACTERISTIC CanIf_CanIfTxPduCfg_ENG19_TXCanDlc_C "Calibration parameter for the Data length of CAN frame CanIfTxPduCfg_ENG19_TX" VALUE 0x804D8624 DefaultValueRecordLayout_AUTOSAR_Platform_BaseTypes_uint8 8.0 RB_RBA_Common_CentralElements_CompuMethods_Identical 0.0 8. FORMAT "%5.0" /end CHARACTERISTIC
/begin CHARACTERISTIC CanIf_CanIfTxPduCfg_ENG19_TXCanId_C "Calibration parameter for the CanId of CAN frame CanIfTxPduCfg_ENG19_TX" VALUE 0x804D8484 DefaultValueRecordLayout_AUTOSAR_Platform_BaseTypes_uint32 2047.0 RB_RBA_Common_CentralElements_CompuMethods_Identical 0.0 2047. FORMAT "%5.0" /end CHARACTERISTIC
/begin CHARACTERISTIC CanIf_CanIfTxPduCfg_ENG20_TXCanDlc_C "Calibration parameter for the Data length of CAN frame CanIfTxPduCfg_ENG20_TX" VALUE 0x804D8623 DefaultValueRecordLayout_AUTOSAR_Platform_BaseTypes_uint8 8.0 RB_RBA_Common_CentralElements_CompuMethods_Identical 0.0 8. FORMAT "%5.0" /end CHARACTERISTIC
/begin CHARACTERISTIC CanIf_CanIfTxPduCfg_ENG20_TXCanId_C "Calibration parameter for the CanId of CAN frame CanIfTxPduCfg_ENG20_TX" VALUE 0x804D8480 DefaultValueRecordLayout_AUTOSAR_Platform_BaseTypes_uint32 2047.0 RB_RBA_Common_CentralElements_CompuMethods_Identical 0.0 2047. FORMAT "%5.0" /end CHARACTERISTIC
/begin CHARACTERISTIC CanIf_CanIfTxPduCfg_ENG21_TXCanDlc_C "Calibration parameter for the Data length of CAN frame CanIfTxPduCfg_ENG21_TX" VALUE 0x804D8622 DefaultValueRecordLayout_AUTOSAR_Platform_BaseTypes_uint8 8.0 RB_RBA_Common_CentralElements_CompuMethods_Identical 0.0 8. FORMAT "%5.0" /end CHARACTERISTIC
/begin CHARACTERISTIC CanIf_CanIfTxPduCfg_ENG21_TXCanId_C "Calibration parameter for the CanId of CAN frame CanIfTxPduCfg_ENG21_TX" VALUE 0x804D847C DefaultValueRecordLayout_AUTOSAR_Platform_BaseTypes_uint32 2047.0 RB_RBA_Common_CentralElements_CompuMethods_Identical 0.0 2047. FORMAT "%5.0" /end CHARACTERISTIC
/begin CHARACTERISTIC CanIf_CanIfTxPduCfg_ENG22_TXCanDlc_C "Calibration parameter for the Data length of CAN frame CanIfTxPduCfg_ENG22_TX" VALUE 0x804D8621 DefaultValueRecordLayout_AUTOSAR_Platform_BaseTypes_uint8 8.0 RB_RBA_Common_CentralElements_CompuMethods_Identical 0.0 8. FORMAT "%5.0" /end CHARACTERISTIC
/begin CHARACTERISTIC CanIf_CanIfTxPduCfg_ENG22_TXCanId_C "Calibration parameter for the CanId of CAN frame CanIfTxPduCfg_ENG22_TX" VALUE 0x804D8478 DefaultValueRecordLayout_AUTOSAR_Platform_BaseTypes_uint32 2047.0 RB_RBA_Common_CentralElements_CompuMethods_Identical 0.0 2047. FORMAT "%5.0" /end CHARACTERISTIC
/begin CHARACTERISTIC CanIf_CanIfTxPduCfg_ENG23_TXCanDlc_C "Calibration parameter for the Data length of CAN frame CanIfTxPduCfg_ENG23_TX" VALUE 0x804D8620 DefaultValueRecordLayout_AUTOSAR_Platform_BaseTypes_uint8 8.0 RB_RBA_Common_CentralElements_CompuMethods_Identical 0.0 8. FORMAT "%5.0" /end CHARACTERISTIC
/begin CHARACTERISTIC CanIf_CanIfTxPduCfg_ENG23_TXCanId_C "Calibration parameter for the CanId of CAN frame CanIfTxPduCfg_ENG23_TX" VALUE 0x804D8474 DefaultValueRecordLayout_AUTOSAR_Platform_BaseTypes_uint32 2047.0 RB_RBA_Common_CentralElements_CompuMethods_Identical 0.0 2047. FORMAT "%5.0" /end CHARACTERISTIC
/begin CHARACTERISTIC CanIf_CanIfTxPduCfg_ENG24_TXCanDlc_C "Calibration parameter for the Data length of CAN frame CanIfTxPduCfg_ENG24_TX" VALUE 0x804D861F DefaultValueRecordLayout_AUTOSAR_Platform_BaseTypes_uint8 8.0 RB_RBA_Common_CentralElements_CompuMethods_Identical 0.0 8. FORMAT "%5.0" /end CHARACTERISTIC
/begin CHARACTERISTIC CanIf_CanIfTxPduCfg_ENG24_TXCanId_C "Calibration parameter for the CanId of CAN frame CanIfTxPduCfg_ENG24_TX" VALUE 0x804D8470 DefaultValueRecordLayout_AUTOSAR_Platform_BaseTypes_uint32 2047.0 RB_RBA_Common_CentralElements_CompuMethods_Identical 0.0 2047. FORMAT "%5.0" /end CHARACTERISTIC
/begin CHARACTERISTIC CanIf_CanIfTxPduCfg_ENG25_TXCanDlc_C "Calibration parameter for the Data length of CAN frame CanIfTxPduCfg_ENG25_TX" VALUE 0x804D861E DefaultValueRecordLayout_AUTOSAR_Platform_BaseTypes_uint8 8.0 RB_RBA_Common_CentralElements_CompuMethods_Identical 0.0 8. FORMAT "%5.0" /end CHARACTERISTIC
/begin CHARACTERISTIC CanIf_CanIfTxPduCfg_ENG25_TXCanId_C "Calibration parameter for the CanId of CAN frame CanIfTxPduCfg_ENG25_TX" VALUE 0x804D846C DefaultValueRecordLayout_AUTOSAR_Platform_BaseTypes_uint32 2047.0 RB_RBA_Common_CentralElements_CompuMethods_Identical 0.0 2047. FORMAT "%5.0" /end CHARACTERISTIC
/begin CHARACTERISTIC CanIf_CanIfTxPduCfg_ENG2_TXCanDlc_C "Calibration parameter for the Data length of CAN frame CanIfTxPduCfg_ENG2_TX" VALUE 0x804D861D DefaultValueRecordLayout_AUTOSAR_Platform_BaseTypes_uint8 5.0 RB_RBA_Common_CentralElements_CompuMethods_Identical 0.0 5. FORMAT "%5.0" /end CHARACTERISTIC
/begin CHARACTERISTIC CanIf_CanIfTxPduCfg_ENG2_TXCanId_C "Calibration parameter for the CanId of CAN frame CanIfTxPduCfg_ENG2_TX" VALUE 0x804D8468 DefaultValueRecordLayout_AUTOSAR_Platform_BaseTypes_uint32 2047.0 RB_RBA_Common_CentralElements_CompuMethods_Identical 0.0 2047. FORMAT "%5.0" /end CHARACTERISTIC
/begin CHARACTERISTIC CanIf_CanIfTxPduCfg_ENG3_TXCanDlc_C "Calibration parameter for the Data length of CAN frame CanIfTxPduCfg_ENG3_TX" VALUE 0x804D861C DefaultValueRecordLayout_AUTOSAR_Platform_BaseTypes_uint8 8.0 RB_RBA_Common_CentralElements_CompuMethods_Identical 0.0 8. FORMAT "%5.0" /end CHARACTERISTIC
/begin CHARACTERISTIC CanIf_CanIfTxPduCfg_ENG3_TXCanId_C "Calibration parameter for the CanId of CAN frame CanIfTxPduCfg_ENG3_TX" VALUE 0x804D8464 DefaultValueRecordLayout_AUTOSAR_Platform_BaseTypes_uint32 2047.0 RB_RBA_Common_CentralElements_CompuMethods_Identical 0.0 2047. FORMAT "%5.0" /end CHARACTERISTIC
/begin CHARACTERISTIC CanIf_CanIfTxPduCfg_ENG4_TXCanDlc_C "Calibration parameter for the Data length of CAN frame CanIfTxPduCfg_ENG4_TX" VALUE 0x804D861B DefaultValueRecordLayout_AUTOSAR_Platform_BaseTypes_uint8 8.0 RB_RBA_Common_CentralElements_CompuMethods_Identical 0.0 8. FORMAT "%5.0" /end CHARACTERISTIC
/begin CHARACTERISTIC CanIf_CanIfTxPduCfg_ENG4_TXCanId_C "Calibration parameter for the CanId of CAN frame CanIfTxPduCfg_ENG4_TX" VALUE 0x804D8460 DefaultValueRecordLayout_AUTOSAR_Platform_BaseTypes_uint32 2047.0 RB_RBA_Common_CentralElements_CompuMethods_Identical 0.0 2047. FORMAT "%5.0" /end CHARACTERISTIC
/begin CHARACTERISTIC CanIf_CanIfTxPduCfg_ENG5_TXCanDlc_C "Calibration parameter for the Data length of CAN frame CanIfTxPduCfg_ENG5_TX" VALUE 0x804D861A DefaultValueRecordLayout_AUTOSAR_Platform_BaseTypes_uint8 8.0 RB_RBA_Common_CentralElements_CompuMethods_Identical 0.0 8. FORMAT "%5.0" /end CHARACTERISTIC
/begin CHARACTERISTIC CanIf_CanIfTxPduCfg_ENG5_TXCanId_C "Calibration parameter for the CanId of CAN frame CanIfTxPduCfg_ENG5_TX" VALUE 0x804D845C DefaultValueRecordLayout_AUTOSAR_Platform_BaseTypes_uint32 2047.0 RB_RBA_Common_CentralElements_CompuMethods_Identical 0.0 2047. FORMAT "%5.0" /end CHARACTERISTIC
/begin CHARACTERISTIC CanIf_CanIfTxPduCfg_ENG6_TXCanDlc_C "Calibration parameter for the Data length of CAN frame CanIfTxPduCfg_ENG6_TX" VALUE 0x804D8619 DefaultValueRecordLayout_AUTOSAR_Platform_BaseTypes_uint8 8.0 RB_RBA_Common_CentralElements_CompuMethods_Identical 0.0 8. FORMAT "%5.0" /end CHARACTERISTIC
/begin CHARACTERISTIC CanIf_CanIfTxPduCfg_ENG6_TXCanId_C "Calibration parameter for the CanId of CAN frame CanIfTxPduCfg_ENG6_TX" VALUE 0x804D8458 DefaultValueRecordLayout_AUTOSAR_Platform_BaseTypes_uint32 2047.0 RB_RBA_Common_CentralElements_CompuMethods_Identical 0.0 2047. FORMAT "%5.0" /end CHARACTERISTIC
/begin CHARACTERISTIC CanIf_CanIfTxPduCfg_ENGAE_TXCanDlc_C "Calibration parameter for the Data length of CAN frame CanIfTxPduCfg_ENGAE_TX" VALUE 0x804D8618 DefaultValueRecordLayout_AUTOSAR_Platform_BaseTypes_uint8 8.0 RB_RBA_Common_CentralElements_CompuMethods_Identical 0.0 8. FORMAT "%5.0" /end CHARACTERISTIC
/begin CHARACTERISTIC CanIf_CanIfTxPduCfg_ENGAE_TXCanId_C "Calibration parameter for the CanId of CAN frame CanIfTxPduCfg_ENGAE_TX" VALUE 0x804D8454 DefaultValueRecordLayout_AUTOSAR_Platform_BaseTypes_uint32 5.0E8 RB_RBA_Common_CentralElements_CompuMethods_Identical 0.0 5.E8 FORMAT "%5.0" /end CHARACTERISTIC
/begin CHARACTERISTIC CanIf_CanIfTxPduCfg_ENGA_TXCanDlc_C "Calibration parameter for the Data length of CAN frame CanIfTxPduCfg_ENGA_TX" VALUE 0x804D8617 DefaultValueRecordLayout_AUTOSAR_Platform_BaseTypes_uint8 8.0 RB_RBA_Common_CentralElements_CompuMethods_Identical 0.0 8. FORMAT "%5.0" /end CHARACTERISTIC
/begin CHARACTERISTIC CanIf_CanIfTxPduCfg_ENGA_TXCanId_C "Calibration parameter for the CanId of CAN frame CanIfTxPduCfg_ENGA_TX" VALUE 0x804D8450 DefaultValueRecordLayout_AUTOSAR_Platform_BaseTypes_uint32 2047.0 RB_RBA_Common_CentralElements_CompuMethods_Identical 0.0 2047. FORMAT "%5.0" /end CHARACTERISTIC
/begin CHARACTERISTIC CanIf_CanIfTxPduCfg_ENGB_TXCanDlc_C "Calibration parameter for the Data length of CAN frame CanIfTxPduCfg_ENGB_TX" VALUE 0x804D8616 DefaultValueRecordLayout_AUTOSAR_Platform_BaseTypes_uint8 8.0 RB_RBA_Common_CentralElements_CompuMethods_Identical 0.0 8. FORMAT "%5.0" /end CHARACTERISTIC
/begin CHARACTERISTIC CanIf_CanIfTxPduCfg_ENGB_TXCanId_C "Calibration parameter for the CanId of CAN frame CanIfTxPduCfg_ENGB_TX" VALUE 0x804D844C DefaultValueRecordLayout_AUTOSAR_Platform_BaseTypes_uint32 2047.0 RB_RBA_Common_CentralElements_CompuMethods_Identical 0.0 2047. FORMAT "%5.0" /end CHARACTERISTIC
/begin CHARACTERISTIC CanIf_CanIfTxPduCfg_ENGC_TXCanDlc_C "Calibration parameter for the Data length of CAN frame CanIfTxPduCfg_ENGC_TX" VALUE 0x804D8615 DefaultValueRecordLayout_AUTOSAR_Platform_BaseTypes_uint8 8.0 RB_RBA_Common_CentralElements_CompuMethods_Identical 0.0 8. FORMAT "%5.0" /end CHARACTERISTIC
/begin CHARACTERISTIC CanIf_CanIfTxPduCfg_ENGC_TXCanId_C "Calibration parameter for the CanId of CAN frame CanIfTxPduCfg_ENGC_TX" VALUE 0x804D8448 DefaultValueRecordLayout_AUTOSAR_Platform_BaseTypes_uint32 2047.0 RB_RBA_Common_CentralElements_CompuMethods_Identical 0.0 2047. FORMAT "%5.0" /end CHARACTERISTIC
/begin CHARACTERISTIC CanIf_CanIfTxPduCfg_ENGD_TXCanDlc_C "Calibration parameter for the Data length of CAN frame CanIfTxPduCfg_ENGD_TX" VALUE 0x804D8614 DefaultValueRecordLayout_AUTOSAR_Platform_BaseTypes_uint8 6.0 RB_RBA_Common_CentralElements_CompuMethods_Identical 0.0 6. FORMAT "%5.0" /end CHARACTERISTIC
/begin CHARACTERISTIC CanIf_CanIfTxPduCfg_ENGD_TXCanId_C "Calibration parameter for the CanId of CAN frame CanIfTxPduCfg_ENGD_TX" VALUE 0x804D8444 DefaultValueRecordLayout_AUTOSAR_Platform_BaseTypes_uint32 2047.0 RB_RBA_Common_CentralElements_CompuMethods_Identical 0.0 2047. FORMAT "%5.0" /end CHARACTERISTIC
/begin CHARACTERISTIC CanIf_CanIfTxPduCfg_ENGE_TXCanDlc_C "Calibration parameter for the Data length of CAN frame CanIfTxPduCfg_ENGE_TX" VALUE 0x804D8613 DefaultValueRecordLayout_AUTOSAR_Platform_BaseTypes_uint8 8.0 RB_RBA_Common_CentralElements_CompuMethods_Identical 0.0 8. FORMAT "%5.0" /end CHARACTERISTIC
/begin CHARACTERISTIC CanIf_CanIfTxPduCfg_ENGE_TXCanId_C "Calibration parameter for the CanId of CAN frame CanIfTxPduCfg_ENGE_TX" VALUE 0x804D8440 DefaultValueRecordLayout_AUTOSAR_Platform_BaseTypes_uint32 2047.0 RB_RBA_Common_CentralElements_CompuMethods_Identical 0.0 2047. FORMAT "%5.0" /end CHARACTERISTIC
/begin CHARACTERISTIC CanIf_CanIfTxPduCfg_ENGF_TXCanDlc_C "Calibration parameter for the Data length of CAN frame CanIfTxPduCfg_ENGF_TX" VALUE 0x804D8612 DefaultValueRecordLayout_AUTOSAR_Platform_BaseTypes_uint8 2.0 RB_RBA_Common_CentralElements_CompuMethods_Identical 0.0 2. FORMAT "%5.0" /end CHARACTERISTIC
/begin CHARACTERISTIC CanIf_CanIfTxPduCfg_ENGF_TXCanId_C "Calibration parameter for the CanId of CAN frame CanIfTxPduCfg_ENGF_TX" VALUE 0x804D843C DefaultValueRecordLayout_AUTOSAR_Platform_BaseTypes_uint32 2047.0 RB_RBA_Common_CentralElements_CompuMethods_Identical 0.0 2047. FORMAT "%5.0" /end CHARACTERISTIC
/begin CHARACTERISTIC CanIf_CanIfTxPduCfg_ENGHIP1_TXCanDlc_C "Calibration parameter for the Data length of CAN frame CanIfTxPduCfg_ENGHIP1_TX" VALUE 0x804D8611 DefaultValueRecordLayout_AUTOSAR_Platform_BaseTypes_uint8 5.0 RB_RBA_Common_CentralElements_CompuMethods_Identical 0.0 5. FORMAT "%5.0" /end CHARACTERISTIC
/begin CHARACTERISTIC CanIf_CanIfTxPduCfg_ENGHIP1_TXCanId_C "Calibration parameter for the CanId of CAN frame CanIfTxPduCfg_ENGHIP1_TX" VALUE 0x804D8438 DefaultValueRecordLayout_AUTOSAR_Platform_BaseTypes_uint32 2047.0 RB_RBA_Common_CentralElements_CompuMethods_Identical 0.0 2047. FORMAT "%5.0" /end CHARACTERISTIC
/begin CHARACTERISTIC CanIf_CanIfTxPduCfg_ENGIMG1_TXCanDlc_C "Calibration parameter for the Data length of CAN frame CanIfTxPduCfg_ENGIMG1_TX" VALUE 0x804D8610 DefaultValueRecordLayout_AUTOSAR_Platform_BaseTypes_uint8 8.0 RB_RBA_Common_CentralElements_CompuMethods_Identical 0.0 8. FORMAT "%5.0" /end CHARACTERISTIC
/begin CHARACTERISTIC CanIf_CanIfTxPduCfg_ENGIMG1_TXCanId_C "Calibration parameter for the CanId of CAN frame CanIfTxPduCfg_ENGIMG1_TX" VALUE 0x804D8434 DefaultValueRecordLayout_AUTOSAR_Platform_BaseTypes_uint32 2047.0 RB_RBA_Common_CentralElements_CompuMethods_Identical 0.0 2047. FORMAT "%5.0" /end CHARACTERISTIC
/begin CHARACTERISTIC CanIf_CanIfTxPduCfg_ENGJ3_TXCanDlc_C "Calibration parameter for the Data length of CAN frame CanIfTxPduCfg_ENGJ3_TX" VALUE 0x804D860F DefaultValueRecordLayout_AUTOSAR_Platform_BaseTypes_uint8 8.0 RB_RBA_Common_CentralElements_CompuMethods_Identical 0.0 8. FORMAT "%5.0" /end CHARACTERISTIC
/begin CHARACTERISTIC CanIf_CanIfTxPduCfg_ENGJ3_TXCanId_C "Calibration parameter for the CanId of CAN frame CanIfTxPduCfg_ENGJ3_TX" VALUE 0x804D8430 DefaultValueRecordLayout_AUTOSAR_Platform_BaseTypes_uint32 2047.0 RB_RBA_Common_CentralElements_CompuMethods_Identical 0.0 2047. FORMAT "%5.0" /end CHARACTERISTIC
/begin CHARACTERISTIC CanIf_CanIfTxPduCfg_ENGK3_TXCanDlc_C "Calibration parameter for the Data length of CAN frame CanIfTxPduCfg_ENGK3_TX" VALUE 0x804D860E DefaultValueRecordLayout_AUTOSAR_Platform_BaseTypes_uint8 8.0 RB_RBA_Common_CentralElements_CompuMethods_Identical 0.0 8. FORMAT "%5.0" /end CHARACTERISTIC
/begin CHARACTERISTIC CanIf_CanIfTxPduCfg_ENGK3_TXCanId_C "Calibration parameter for the CanId of CAN frame CanIfTxPduCfg_ENGK3_TX" VALUE 0x804D842C DefaultValueRecordLayout_AUTOSAR_Platform_BaseTypes_uint32 2047.0 RB_RBA_Common_CentralElements_CompuMethods_Identical 0.0 2047. FORMAT "%5.0" /end CHARACTERISTIC
/begin CHARACTERISTIC CanIf_CanIfTxPduCfg_ENGL_TXCanDlc_C "Calibration parameter for the Data length of CAN frame CanIfTxPduCfg_ENGL_TX" VALUE 0x804D860D DefaultValueRecordLayout_AUTOSAR_Platform_BaseTypes_uint8 8.0 RB_RBA_Common_CentralElements_CompuMethods_Identical 0.0 8. FORMAT "%5.0" /end CHARACTERISTIC
/begin CHARACTERISTIC CanIf_CanIfTxPduCfg_ENGL_TXCanId_C "Calibration parameter for the CanId of CAN frame CanIfTxPduCfg_ENGL_TX" VALUE 0x804D8428 DefaultValueRecordLayout_AUTOSAR_Platform_BaseTypes_uint32 2047.0 RB_RBA_Common_CentralElements_CompuMethods_Identical 0.0 2047. FORMAT "%5.0" /end CHARACTERISTIC
/begin CHARACTERISTIC CanIf_CanIfTxPduCfg_ENGN_TXCanDlc_C "Calibration parameter for the Data length of CAN frame CanIfTxPduCfg_ENGN_TX" VALUE 0x804D860C DefaultValueRecordLayout_AUTOSAR_Platform_BaseTypes_uint8 8.0 RB_RBA_Common_CentralElements_CompuMethods_Identical 0.0 8. FORMAT "%5.0" /end CHARACTERISTIC
/begin CHARACTERISTIC CanIf_CanIfTxPduCfg_ENGN_TXCanId_C "Calibration parameter for the CanId of CAN frame CanIfTxPduCfg_ENGN_TX" VALUE 0x804D8424 DefaultValueRecordLayout_AUTOSAR_Platform_BaseTypes_uint32 2047.0 RB_RBA_Common_CentralElements_CompuMethods_Identical 0.0 2047. FORMAT "%5.0" /end CHARACTERISTIC
/begin CHARACTERISTIC CanIf_CanIfTxPduCfg_ENGQ_TXCanDlc_C "Calibration parameter for the Data length of CAN frame CanIfTxPduCfg_ENGQ_TX" VALUE 0x804D860B DefaultValueRecordLayout_AUTOSAR_Platform_BaseTypes_uint8 2.0 RB_RBA_Common_CentralElements_CompuMethods_Identical 0.0 2. FORMAT "%5.0" /end CHARACTERISTIC
/begin CHARACTERISTIC CanIf_CanIfTxPduCfg_ENGQ_TXCanId_C "Calibration parameter for the CanId of CAN frame CanIfTxPduCfg_ENGQ_TX" VALUE 0x804D8420 DefaultValueRecordLayout_AUTOSAR_Platform_BaseTypes_uint32 2047.0 RB_RBA_Common_CentralElements_CompuMethods_Identical 0.0 2047. FORMAT "%5.0" /end CHARACTERISTIC
/begin CHARACTERISTIC CanIf_CanIfTxPduCfg_ENGR_TXCanDlc_C "Calibration parameter for the Data length of CAN frame CanIfTxPduCfg_ENGR_TX" VALUE 0x804D860A DefaultValueRecordLayout_AUTOSAR_Platform_BaseTypes_uint8 5.0 RB_RBA_Common_CentralElements_CompuMethods_Identical 0.0 5. FORMAT "%5.0" /end CHARACTERISTIC
/begin CHARACTERISTIC CanIf_CanIfTxPduCfg_ENGR_TXCanId_C "Calibration parameter for the CanId of CAN frame CanIfTxPduCfg_ENGR_TX" VALUE 0x804D841C DefaultValueRecordLayout_AUTOSAR_Platform_BaseTypes_uint32 2047.0 RB_RBA_Common_CentralElements_CompuMethods_Identical 0.0 2047. FORMAT "%5.0" /end CHARACTERISTIC
/begin CHARACTERISTIC CanIf_CanIfTxPduCfg_ENGT1_TXCanDlc_C "Calibration parameter for the Data length of CAN frame CanIfTxPduCfg_ENGT1_TX" VALUE 0x804D8609 DefaultValueRecordLayout_AUTOSAR_Platform_BaseTypes_uint8 8.0 RB_RBA_Common_CentralElements_CompuMethods_Identical 0.0 8. FORMAT "%5.0" /end CHARACTERISTIC
/begin CHARACTERISTIC CanIf_CanIfTxPduCfg_ENGT1_TXCanId_C "Calibration parameter for the CanId of CAN frame CanIfTxPduCfg_ENGT1_TX" VALUE 0x804D8418 DefaultValueRecordLayout_AUTOSAR_Platform_BaseTypes_uint32 2047.0 RB_RBA_Common_CentralElements_CompuMethods_Identical 0.0 2047. FORMAT "%5.0" /end CHARACTERISTIC
/begin CHARACTERISTIC CanIf_CanIfTxPduCfg_ENGT2_TXCanDlc_C "Calibration parameter for the Data length of CAN frame CanIfTxPduCfg_ENGT2_TX" VALUE 0x804D8608 DefaultValueRecordLayout_AUTOSAR_Platform_BaseTypes_uint8 8.0 RB_RBA_Common_CentralElements_CompuMethods_Identical 0.0 8. FORMAT "%5.0" /end CHARACTERISTIC
/begin CHARACTERISTIC CanIf_CanIfTxPduCfg_ENGT2_TXCanId_C "Calibration parameter for the CanId of CAN frame CanIfTxPduCfg_ENGT2_TX" VALUE 0x804D8414 DefaultValueRecordLayout_AUTOSAR_Platform_BaseTypes_uint32 2047.0 RB_RBA_Common_CentralElements_CompuMethods_Identical 0.0 2047. FORMAT "%5.0" /end CHARACTERISTIC
/begin CHARACTERISTIC CanIf_CanIfTxPduCfg_ENGT_TXCanDlc_C "Calibration parameter for the Data length of CAN frame CanIfTxPduCfg_ENGT_TX" VALUE 0x804D8607 DefaultValueRecordLayout_AUTOSAR_Platform_BaseTypes_uint8 8.0 RB_RBA_Common_CentralElements_CompuMethods_Identical 0.0 8. FORMAT "%5.0" /end CHARACTERISTIC
/begin CHARACTERISTIC CanIf_CanIfTxPduCfg_ENGT_TXCanId_C "Calibration parameter for the CanId of CAN frame CanIfTxPduCfg_ENGT_TX" VALUE 0x804D8410 DefaultValueRecordLayout_AUTOSAR_Platform_BaseTypes_uint32 2047.0 RB_RBA_Common_CentralElements_CompuMethods_Identical 0.0 2047. FORMAT "%5.0" /end CHARACTERISTIC
/begin CHARACTERISTIC CanIf_CanIfTxPduCfg_ENGU_TXCanDlc_C "Calibration parameter for the Data length of CAN frame CanIfTxPduCfg_ENGU_TX" VALUE 0x804D8606 DefaultValueRecordLayout_AUTOSAR_Platform_BaseTypes_uint8 8.0 RB_RBA_Common_CentralElements_CompuMethods_Identical 0.0 8. FORMAT "%5.0" /end CHARACTERISTIC
/begin CHARACTERISTIC CanIf_CanIfTxPduCfg_ENGU_TXCanId_C "Calibration parameter for the CanId of CAN frame CanIfTxPduCfg_ENGU_TX" VALUE 0x804D840C DefaultValueRecordLayout_AUTOSAR_Platform_BaseTypes_uint32 2047.0 RB_RBA_Common_CentralElements_CompuMethods_Identical 0.0 2047. FORMAT "%5.0" /end CHARACTERISTIC
/begin CHARACTERISTIC CanIf_CanIfTxPduCfg_ENGV_TXCanDlc_C "Calibration parameter for the Data length of CAN frame CanIfTxPduCfg_ENGV_TX" VALUE 0x804D8605 DefaultValueRecordLayout_AUTOSAR_Platform_BaseTypes_uint8 8.0 RB_RBA_Common_CentralElements_CompuMethods_Identical 0.0 8. FORMAT "%5.0" /end CHARACTERISTIC
/begin CHARACTERISTIC CanIf_CanIfTxPduCfg_ENGV_TXCanId_C "Calibration parameter for the CanId of CAN frame CanIfTxPduCfg_ENGV_TX" VALUE 0x804D8408 DefaultValueRecordLayout_AUTOSAR_Platform_BaseTypes_uint32 2047.0 RB_RBA_Common_CentralElements_CompuMethods_Identical 0.0 2047. FORMAT "%5.0" /end CHARACTERISTIC
/begin CHARACTERISTIC CanIf_CanIfTxPduCfg_ENGW_TXCanDlc_C "Calibration parameter for the Data length of CAN frame CanIfTxPduCfg_ENGW_TX" VALUE 0x804D8604 DefaultValueRecordLayout_AUTOSAR_Platform_BaseTypes_uint8 8.0 RB_RBA_Common_CentralElements_CompuMethods_Identical 0.0 8. FORMAT "%5.0" /end CHARACTERISTIC
/begin CHARACTERISTIC CanIf_CanIfTxPduCfg_ENGW_TXCanId_C "Calibration parameter for the CanId of CAN frame CanIfTxPduCfg_ENGW_TX" VALUE 0x804D8404 DefaultValueRecordLayout_AUTOSAR_Platform_BaseTypes_uint32 2047.0 RB_RBA_Common_CentralElements_CompuMethods_Identical 0.0 2047. FORMAT "%5.0" /end CHARACTERISTIC
/begin CHARACTERISTIC CanIf_CanIfTxPduCfg_ENGX2_TXCanDlc_C "Calibration parameter for the Data length of CAN frame CanIfTxPduCfg_ENGX2_TX" VALUE 0x804D8603 DefaultValueRecordLayout_AUTOSAR_Platform_BaseTypes_uint8 8.0 RB_RBA_Common_CentralElements_CompuMethods_Identical 0.0 8. FORMAT "%5.0" /end CHARACTERISTIC
/begin CHARACTERISTIC CanIf_CanIfTxPduCfg_ENGX2_TXCanId_C "Calibration parameter for the CanId of CAN frame CanIfTxPduCfg_ENGX2_TX" VALUE 0x804D8400 DefaultValueRecordLayout_AUTOSAR_Platform_BaseTypes_uint32 2047.0 RB_RBA_Common_CentralElements_CompuMethods_Identical 0.0 2047. FORMAT "%5.0" /end CHARACTERISTIC
/begin CHARACTERISTIC CanIf_CanIfTxPduCfg_ENGY2_TXCanDlc_C "Calibration parameter for the Data length of CAN frame CanIfTxPduCfg_ENGY2_TX" VALUE 0x804D8602 DefaultValueRecordLayout_AUTOSAR_Platform_BaseTypes_uint8 4.0 RB_RBA_Common_CentralElements_CompuMethods_Identical 0.0 4. FORMAT "%5.0" /end CHARACTERISTIC
/begin CHARACTERISTIC CanIf_CanIfTxPduCfg_ENGY2_TXCanId_C "Calibration parameter for the CanId of CAN frame CanIfTxPduCfg_ENGY2_TX" VALUE 0x804D83FC DefaultValueRecordLayout_AUTOSAR_Platform_BaseTypes_uint32 2047.0 RB_RBA_Common_CentralElements_CompuMethods_Identical 0.0 2047. FORMAT "%5.0" /end CHARACTERISTIC
/begin CHARACTERISTIC CanIf_CanIfTxPduCfg_ENGY_TXCanDlc_C "Calibration parameter for the Data length of CAN frame CanIfTxPduCfg_ENGY_TX" VALUE 0x804D8601 DefaultValueRecordLayout_AUTOSAR_Platform_BaseTypes_uint8 5.0 RB_RBA_Common_CentralElements_CompuMethods_Identical 0.0 5. FORMAT "%5.0" /end CHARACTERISTIC
/begin CHARACTERISTIC CanIf_CanIfTxPduCfg_ENGY_TXCanId_C "Calibration parameter for the CanId of CAN frame CanIfTxPduCfg_ENGY_TX" VALUE 0x804D83F8 DefaultValueRecordLayout_AUTOSAR_Platform_BaseTypes_uint32 2047.0 RB_RBA_Common_CentralElements_CompuMethods_Identical 0.0 2047. FORMAT "%5.0" /end CHARACTERISTIC
/begin CHARACTERISTIC CanIf_CanIfTxPduCfg_ENGZ_TXCanDlc_C "Calibration parameter for the Data length of CAN frame CanIfTxPduCfg_ENGZ_TX" VALUE 0x804D8600 DefaultValueRecordLayout_AUTOSAR_Platform_BaseTypes_uint8 8.0 RB_RBA_Common_CentralElements_CompuMethods_Identical 0.0 8. FORMAT "%5.0" /end CHARACTERISTIC
/begin CHARACTERISTIC CanIf_CanIfTxPduCfg_ENGZ_TXCanId_C "Calibration parameter for the CanId of CAN frame CanIfTxPduCfg_ENGZ_TX" VALUE 0x804D83F4 DefaultValueRecordLayout_AUTOSAR_Platform_BaseTypes_uint32 2047.0 RB_RBA_Common_CentralElements_CompuMethods_Identical 0.0 2047. FORMAT "%5.0" /end CHARACTERISTIC
/begin CHARACTERISTIC CanIf_CanIfTxPduCfg_eng1_TXCanDlc_C "Calibration parameter for the Data length of CAN frame CanIfTxPduCfg_eng1_TX" VALUE 0x804D85FF DefaultValueRecordLayout_AUTOSAR_Platform_BaseTypes_uint8 8.0 RB_RBA_Common_CentralElements_CompuMethods_Identical 0.0 8. FORMAT "%5.0" /end CHARACTERISTIC
/begin CHARACTERISTIC CanIf_CanIfTxPduCfg_eng1_TXCanId_C "Calibration parameter for the CanId of CAN frame CanIfTxPduCfg_eng1_TX" VALUE 0x804D83F0 DefaultValueRecordLayout_AUTOSAR_Platform_BaseTypes_uint32 2047.0 RB_RBA_Common_CentralElements_CompuMethods_Identical 0.0 2047. FORMAT "%5.0" /end CHARACTERISTIC
/begin CHARACTERISTIC CanIf_CanIfTxPduCfg_engo_TXCanDlc_C "Calibration parameter for the Data length of CAN frame CanIfTxPduCfg_engo_TX" VALUE 0x804D85FE DefaultValueRecordLayout_AUTOSAR_Platform_BaseTypes_uint8 8.0 RB_RBA_Common_CentralElements_CompuMethods_Identical 0.0 8. FORMAT "%5.0" /end CHARACTERISTIC
/begin CHARACTERISTIC CanIf_CanIfTxPduCfg_engo_TXCanId_C "Calibration parameter for the CanId of CAN frame CanIfTxPduCfg_engo_TX" VALUE 0x804D83EC DefaultValueRecordLayout_AUTOSAR_Platform_BaseTypes_uint32 2047.0 RB_RBA_Common_CentralElements_CompuMethods_Identical 0.0 2047. FORMAT "%5.0" /end CHARACTERISTIC
/begin CHARACTERISTIC CanIf_OBD_ON_CAN_Rx_0x7DF_VEHICLECanDlc_C "Calibration parameter for the Data length of CAN frame OBD_ON_CAN_Rx_0x7DF_VEHICLE" VALUE 0x804D85FD DefaultValueRecordLayout_AUTOSAR_Platform_BaseTypes_uint8 1.0 RB_RBA_Common_CentralElements_CompuMethods_Identical 0.0 1. FORMAT "%5.0" /end CHARACTERISTIC
/begin CHARACTERISTIC CanIf_OBD_ON_CAN_Rx_0x7E0_VEHICLECanDlc_C "Calibration parameter for the Data length of CAN frame OBD_ON_CAN_Rx_0x7E0_VEHICLE" VALUE 0x804D85FC DefaultValueRecordLayout_AUTOSAR_Platform_BaseTypes_uint8 1.0 RB_RBA_Common_CentralElements_CompuMethods_Identical 0.0 1. FORMAT "%5.0" /end CHARACTERISTIC
/begin CHARACTERISTIC CanIf_T1_RXCanDlc_C "Calibration parameter for the Data length of CAN frame T1_RX" VALUE 0x804D85FB DefaultValueRecordLayout_AUTOSAR_Platform_BaseTypes_uint8 8.0 RB_RBA_Common_CentralElements_CompuMethods_Identical 0.0 8. FORMAT "%5.0" /end CHARACTERISTIC
/begin CHARACTERISTIC CanIf_T1_TXCanId_C "Calibration parameter for the CanId of CAN frame T1_TX" VALUE 0x804D83E8 DefaultValueRecordLayout_AUTOSAR_Platform_BaseTypes_uint32 2047.0 RB_RBA_Common_CentralElements_CompuMethods_Identical 0.0 2047. FORMAT "%5.0" /end CHARACTERISTIC
/begin CHARACTERISTIC CanIf_UDS_ON_CAN_Rx_0x18da10f1_VEHICLECanDlc_C "Calibration parameter for the Data length of CAN frame UDS_ON_CAN_Rx_0x18da10f1_VEHICLE" VALUE 0x804D85FA DefaultValueRecordLayout_AUTOSAR_Platform_BaseTypes_uint8 1.0 RB_RBA_Common_CentralElements_CompuMethods_Identical 0.0 1. FORMAT "%5.0" /end CHARACTERISTIC
/begin CHARACTERISTIC CanIf_UDS_ON_CAN_Rx_0x18da10f2_VEHICLECanDlc_C "Calibration parameter for the Data length of CAN frame UDS_ON_CAN_Rx_0x18da10f2_VEHICLE" VALUE 0x804D85F9 DefaultValueRecordLayout_AUTOSAR_Platform_BaseTypes_uint8 1.0 RB_RBA_Common_CentralElements_CompuMethods_Identical 0.0 1. FORMAT "%5.0" /end CHARACTERISTIC
/begin CHARACTERISTIC CanIf_UDS_ON_CAN_Rx_0x18db2ff1_VEHICLECanDlc_C "Calibration parameter for the Data length of CAN frame UDS_ON_CAN_Rx_0x18db2ff1_VEHICLE" VALUE 0x804D85F8 DefaultValueRecordLayout_AUTOSAR_Platform_BaseTypes_uint8 1.0 RB_RBA_Common_CentralElements_CompuMethods_Identical 0.0 1. FORMAT "%5.0" /end CHARACTERISTIC
/begin CHARACTERISTIC CanIf_UDS_ON_CAN_Rx_0x18db33f1_VEHICLECanDlc_C "Calibration parameter for the Data length of CAN frame UDS_ON_CAN_Rx_0x18db33f1_VEHICLE" VALUE 0x804D85F7 DefaultValueRecordLayout_AUTOSAR_Platform_BaseTypes_uint8 1.0 RB_RBA_Common_CentralElements_CompuMethods_Identical 0.0 1. FORMAT "%5.0" /end CHARACTERISTIC
/begin CHARACTERISTIC CanIf_UDS_ON_CAN_Rx_0x18dbeff1_VEHICLECanDlc_C "Calibration parameter for the Data length of CAN frame UDS_ON_CAN_Rx_0x18dbeff1_VEHICLE" VALUE 0x804D85F6 DefaultValueRecordLayout_AUTOSAR_Platform_BaseTypes_uint8 1.0 RB_RBA_Common_CentralElements_CompuMethods_Identical 0.0 1. FORMAT "%5.0" /end CHARACTERISTIC
/begin CHARACTERISTIC CanIf_UDS_ON_CAN_Tx_0x18daf110_VEHICLECanId_C "Calibration parameter for the CanId of CAN frame UDS_ON_CAN_Tx_0x18daf110_VEHICLE" VALUE 0x804D83E4 DefaultValueRecordLayout_AUTOSAR_Platform_BaseTypes_uint32 5.0E8 RB_RBA_Common_CentralElements_CompuMethods_Identical 0.0 5.E8 FORMAT "%5.0" /end CHARACTERISTIC
/begin CHARACTERISTIC CanIf_UDS_ON_CAN_Tx_0x18daf210_VEHICLECanId_C "Calibration parameter for the CanId of CAN frame UDS_ON_CAN_Tx_0x18daf210_VEHICLE" VALUE 0x804D83E0 DefaultValueRecordLayout_AUTOSAR_Platform_BaseTypes_uint32 5.0E8 RB_RBA_Common_CentralElements_CompuMethods_Identical 0.0 5.E8 FORMAT "%5.0" /end CHARACTERISTIC
/begin CHARACTERISTIC CanIf_UDS_ON_CAN_Tx_0x7E8_VEHICLECanId_C "Calibration parameter for the CanId of CAN frame UDS_ON_CAN_Tx_0x7E8_VEHICLE" VALUE 0x804D83DC DefaultValueRecordLayout_AUTOSAR_Platform_BaseTypes_uint32 2047.0 RB_RBA_Common_CentralElements_CompuMethods_Identical 0.0 2047. FORMAT "%5.0" /end CHARACTERISTIC
/begin CHARACTERISTIC CanIf_XcpRx_Cmd_APPLCanDlc_C "Calibration parameter for the Data length of CAN frame XcpRx_Cmd_APPL" VALUE 0x804D85F5 DefaultValueRecordLayout_AUTOSAR_Platform_BaseTypes_uint8 1.0 RB_RBA_Common_CentralElements_CompuMethods_Identical 0.0 1. FORMAT "%5.0" /end CHARACTERISTIC
/begin CHARACTERISTIC CanIf_XcpRx_Cmd_CAN_CCanDlc_C "Calibration parameter for the Data length of CAN frame XcpRx_Cmd_CAN_C" VALUE 0x804D85F4 DefaultValueRecordLayout_AUTOSAR_Platform_BaseTypes_uint8 1.0 RB_RBA_Common_CentralElements_CompuMethods_Identical 0.0 1. FORMAT "%5.0" /end CHARACTERISTIC
/begin CHARACTERISTIC CanIf_XcpRx_Cmd_VEHICLECanDlc_C "Calibration parameter for the Data length of CAN frame XcpRx_Cmd_VEHICLE" VALUE 0x804D85F3 DefaultValueRecordLayout_AUTOSAR_Platform_BaseTypes_uint8 1.0 RB_RBA_Common_CentralElements_CompuMethods_Identical 0.0 1. FORMAT "%5.0" /end CHARACTERISTIC
/begin CHARACTERISTIC CanIf_XcpTx_Var_APPLCanId_C "Calibration parameter for the CanId of CAN frame XcpTx_Var_APPL" VALUE 0x804D83D8 DefaultValueRecordLayout_AUTOSAR_Platform_BaseTypes_uint32 2047.0 RB_RBA_Common_CentralElements_CompuMethods_Identical 0.0 2047. FORMAT "%5.0" /end CHARACTERISTIC
/begin CHARACTERISTIC CanIf_XcpTx_Var_CAN_CCanId_C "Calibration parameter for the CanId of CAN frame XcpTx_Var_CAN_C" VALUE 0x804D83D4 DefaultValueRecordLayout_AUTOSAR_Platform_BaseTypes_uint32 2047.0 RB_RBA_Common_CentralElements_CompuMethods_Identical 0.0 2047. FORMAT "%5.0" /end CHARACTERISTIC
/begin CHARACTERISTIC CanIf_XcpTx_Var_VEHICLECanId_C "Calibration parameter for the CanId of CAN frame XcpTx_Var_VEHICLE" VALUE 0x804D83D0 DefaultValueRecordLayout_AUTOSAR_Platform_BaseTypes_uint32 2047.0 RB_RBA_Common_CentralElements_CompuMethods_Identical 0.0 2047. FORMAT "%5.0" /end CHARACTERISTIC
/begin CHARACTERISTIC Com_tiAYCA_RxRxTout_C "Calibration parameter to control Rx Ipdu Timeout for AYCA_Rx" VALUE 0x804D8570 DefaultValueRecordLayout_AUTOSAR_Platform_BaseTypes_uint16 65535.0 RB_RBA_Common_CentralElements_CompuMethods_Identical 0.0 65535. FORMAT "%5.0" /end CHARACTERISTIC
/begin CHARACTERISTIC Com_tiAYCD_RxRxTout_C "Calibration parameter to control Rx Ipdu Timeout for AYCD_Rx" VALUE 0x804D856E DefaultValueRecordLayout_AUTOSAR_Platform_BaseTypes_uint16 65535.0 RB_RBA_Common_CentralElements_CompuMethods_Identical 0.0 65535. FORMAT "%5.0" /end CHARACTERISTIC
/begin CHARACTERISTIC Com_tiAYCF_RxRxTout_C "Calibration parameter to control Rx Ipdu Timeout for AYCF_Rx" VALUE 0x804D856C DefaultValueRecordLayout_AUTOSAR_Platform_BaseTypes_uint16 65535.0 RB_RBA_Common_CentralElements_CompuMethods_Identical 0.0 65535. FORMAT "%5.0" /end CHARACTERISTIC
/begin CHARACTERISTIC Com_tiAYCG_RxRxTout_C "Calibration parameter to control Rx Ipdu Timeout for AYCG_Rx" VALUE 0x804D856A DefaultValueRecordLayout_AUTOSAR_Platform_BaseTypes_uint16 65535.0 RB_RBA_Common_CentralElements_CompuMethods_Identical 0.0 65535. FORMAT "%5.0" /end CHARACTERISTIC
/begin CHARACTERISTIC Com_tiAYCI_RxRxTout_C "Calibration parameter to control Rx Ipdu Timeout for AYCI_Rx" VALUE 0x804D8568 DefaultValueRecordLayout_AUTOSAR_Platform_BaseTypes_uint16 65535.0 RB_RBA_Common_CentralElements_CompuMethods_Identical 0.0 65535. FORMAT "%5.0" /end CHARACTERISTIC
/begin CHARACTERISTIC Com_tiBCM1_RxRxTout_C "Calibration parameter to control Rx Ipdu Timeout for BCM1_Rx" VALUE 0x804D8566 DefaultValueRecordLayout_AUTOSAR_Platform_BaseTypes_uint16 65535.0 RB_RBA_Common_CentralElements_CompuMethods_Identical 0.0 65535. FORMAT "%5.0" /end CHARACTERISTIC
/begin CHARACTERISTIC Com_tiCGW1_RxRxTout_C "Calibration parameter to control Rx Ipdu Timeout for CGW1_Rx" VALUE 0x804D8564 DefaultValueRecordLayout_AUTOSAR_Platform_BaseTypes_uint16 65535.0 RB_RBA_Common_CentralElements_CompuMethods_Identical 0.0 65535. FORMAT "%5.0" /end CHARACTERISTIC
/begin CHARACTERISTIC Com_tiEAT10_RxRxTout_C "Calibration parameter to control Rx Ipdu Timeout for EAT10_Rx" VALUE 0x804D8562 DefaultValueRecordLayout_AUTOSAR_Platform_BaseTypes_uint16 65535.0 RB_RBA_Common_CentralElements_CompuMethods_Identical 0.0 65535. FORMAT "%5.0" /end CHARACTERISTIC
/begin CHARACTERISTIC Com_tiEAT11_RxRxTout_C "Calibration parameter to control Rx Ipdu Timeout for EAT11_Rx" VALUE 0x804D8560 DefaultValueRecordLayout_AUTOSAR_Platform_BaseTypes_uint16 65535.0 RB_RBA_Common_CentralElements_CompuMethods_Identical 0.0 65535. FORMAT "%5.0" /end CHARACTERISTIC
/begin CHARACTERISTIC Com_tiEAT12_RxRxTout_C "Calibration parameter to control Rx Ipdu Timeout for EAT12_Rx" VALUE 0x804D855E DefaultValueRecordLayout_AUTOSAR_Platform_BaseTypes_uint16 65535.0 RB_RBA_Common_CentralElements_CompuMethods_Identical 0.0 65535. FORMAT "%5.0" /end CHARACTERISTIC
/begin CHARACTERISTIC Com_tiEAT13_RxRxTout_C "Calibration parameter to control Rx Ipdu Timeout for EAT13_Rx" VALUE 0x804D855C DefaultValueRecordLayout_AUTOSAR_Platform_BaseTypes_uint16 65535.0 RB_RBA_Common_CentralElements_CompuMethods_Identical 0.0 65535. FORMAT "%5.0" /end CHARACTERISTIC
/begin CHARACTERISTIC Com_tiEAT1_RxRxTout_C "Calibration parameter to control Rx Ipdu Timeout for EAT1_Rx" VALUE 0x804D855A DefaultValueRecordLayout_AUTOSAR_Platform_BaseTypes_uint16 65535.0 RB_RBA_Common_CentralElements_CompuMethods_Identical 0.0 65535. FORMAT "%5.0" /end CHARACTERISTIC
/begin CHARACTERISTIC Com_tiEAT2_RxRxTout_C "Calibration parameter to control Rx Ipdu Timeout for EAT2_Rx" VALUE 0x804D8558 DefaultValueRecordLayout_AUTOSAR_Platform_BaseTypes_uint16 65535.0 RB_RBA_Common_CentralElements_CompuMethods_Identical 0.0 65535. FORMAT "%5.0" /end CHARACTERISTIC
/begin CHARACTERISTIC Com_tiEAT4_RxRxTout_C "Calibration parameter to control Rx Ipdu Timeout for EAT4_Rx" VALUE 0x804D8556 DefaultValueRecordLayout_AUTOSAR_Platform_BaseTypes_uint16 65535.0 RB_RBA_Common_CentralElements_CompuMethods_Identical 0.0 65535. FORMAT "%5.0" /end CHARACTERISTIC
/begin CHARACTERISTIC Com_tiEAT6_RxRxTout_C "Calibration parameter to control Rx Ipdu Timeout for EAT6_Rx" VALUE 0x804D8554 DefaultValueRecordLayout_AUTOSAR_Platform_BaseTypes_uint16 65535.0 RB_RBA_Common_CentralElements_CompuMethods_Identical 0.0 65535. FORMAT "%5.0" /end CHARACTERISTIC
/begin CHARACTERISTIC Com_tiEAT7_RxRxTout_C "Calibration parameter to control Rx Ipdu Timeout for EAT7_Rx" VALUE 0x804D8552 DefaultValueRecordLayout_AUTOSAR_Platform_BaseTypes_uint16 65535.0 RB_RBA_Common_CentralElements_CompuMethods_Identical 0.0 65535. FORMAT "%5.0" /end CHARACTERISTIC
/begin CHARACTERISTIC Com_tiEAT8_RxRxTout_C "Calibration parameter to control Rx Ipdu Timeout for EAT8_Rx" VALUE 0x804D8550 DefaultValueRecordLayout_AUTOSAR_Platform_BaseTypes_uint16 65535.0 RB_RBA_Common_CentralElements_CompuMethods_Identical 0.0 65535. FORMAT "%5.0" /end CHARACTERISTIC
/begin CHARACTERISTIC Com_tiEATA_RxRxTout_C "Calibration parameter to control Rx Ipdu Timeout for EATA_Rx" VALUE 0x804D854E DefaultValueRecordLayout_AUTOSAR_Platform_BaseTypes_uint16 65535.0 RB_RBA_Common_CentralElements_CompuMethods_Identical 0.0 65535. FORMAT "%5.0" /end CHARACTERISTIC
/begin CHARACTERISTIC Com_tiEATB_RxRxTout_C "Calibration parameter to control Rx Ipdu Timeout for EATB_Rx" VALUE 0x804D854C DefaultValueRecordLayout_AUTOSAR_Platform_BaseTypes_uint16 65535.0 RB_RBA_Common_CentralElements_CompuMethods_Identical 0.0 65535. FORMAT "%5.0" /end CHARACTERISTIC
/begin CHARACTERISTIC Com_tiEATC_RxRxTout_C "Calibration parameter to control Rx Ipdu Timeout for EATC_Rx" VALUE 0x804D854A DefaultValueRecordLayout_AUTOSAR_Platform_BaseTypes_uint16 65535.0 RB_RBA_Common_CentralElements_CompuMethods_Identical 0.0 65535. FORMAT "%5.0" /end CHARACTERISTIC
/begin CHARACTERISTIC Com_tiEBBA_RxRxTout_C "Calibration parameter to control Rx Ipdu Timeout for EBBA_Rx" VALUE 0x804D8548 DefaultValueRecordLayout_AUTOSAR_Platform_BaseTypes_uint16 65535.0 RB_RBA_Common_CentralElements_CompuMethods_Identical 0.0 65535. FORMAT "%5.0" /end CHARACTERISTIC
/begin CHARACTERISTIC Com_tiENG10_TxTxPerd_C "Calibration parameter to control Tx Ipdu periodic factor for ENG10_Tx" VALUE 0x804D8546 DefaultValueRecordLayout_AUTOSAR_Platform_BaseTypes_uint16 65535.0 RB_RBA_Common_CentralElements_CompuMethods_Identical 0.0 65535. FORMAT "%5.0" /end CHARACTERISTIC
/begin CHARACTERISTIC Com_tiENG11_TxTxPerd_C "Calibration parameter to control Tx Ipdu periodic factor for ENG11_Tx" VALUE 0x804D8544 DefaultValueRecordLayout_AUTOSAR_Platform_BaseTypes_uint16 65535.0 RB_RBA_Common_CentralElements_CompuMethods_Identical 0.0 65535. FORMAT "%5.0" /end CHARACTERISTIC
/begin CHARACTERISTIC Com_tiENG15_TxTxPerd_C "Calibration parameter to control Tx Ipdu periodic factor for ENG15_Tx" VALUE 0x804D8542 DefaultValueRecordLayout_AUTOSAR_Platform_BaseTypes_uint16 65535.0 RB_RBA_Common_CentralElements_CompuMethods_Identical 0.0 65535. FORMAT "%5.0" /end CHARACTERISTIC
/begin CHARACTERISTIC Com_tiENG16_TxTxPerd_C "Calibration parameter to control Tx Ipdu periodic factor for ENG16_Tx" VALUE 0x804D8540 DefaultValueRecordLayout_AUTOSAR_Platform_BaseTypes_uint16 65535.0 RB_RBA_Common_CentralElements_CompuMethods_Identical 0.0 65535. FORMAT "%5.0" /end CHARACTERISTIC
/begin CHARACTERISTIC Com_tiENG17_TxTxPerd_C "Calibration parameter to control Tx Ipdu periodic factor for ENG17_Tx" VALUE 0x804D853E DefaultValueRecordLayout_AUTOSAR_Platform_BaseTypes_uint16 65535.0 RB_RBA_Common_CentralElements_CompuMethods_Identical 0.0 65535. FORMAT "%5.0" /end CHARACTERISTIC
/begin CHARACTERISTIC Com_tiENG18_TxTxPerd_C "Calibration parameter to control Tx Ipdu periodic factor for ENG18_Tx" VALUE 0x804D853C DefaultValueRecordLayout_AUTOSAR_Platform_BaseTypes_uint16 65535.0 RB_RBA_Common_CentralElements_CompuMethods_Identical 0.0 65535. FORMAT "%5.0" /end CHARACTERISTIC
/begin CHARACTERISTIC Com_tiENG19_TxTxPerd_C "Calibration parameter to control Tx Ipdu periodic factor for ENG19_Tx" VALUE 0x804D853A DefaultValueRecordLayout_AUTOSAR_Platform_BaseTypes_uint16 65535.0 RB_RBA_Common_CentralElements_CompuMethods_Identical 0.0 65535. FORMAT "%5.0" /end CHARACTERISTIC
/begin CHARACTERISTIC Com_tiENG20_TxTxPerd_C "Calibration parameter to control Tx Ipdu periodic factor for ENG20_Tx" VALUE 0x804D8538 DefaultValueRecordLayout_AUTOSAR_Platform_BaseTypes_uint16 65535.0 RB_RBA_Common_CentralElements_CompuMethods_Identical 0.0 65535. FORMAT "%5.0" /end CHARACTERISTIC
/begin CHARACTERISTIC Com_tiENG21_TxTxPerd_C "Calibration parameter to control Tx Ipdu periodic factor for ENG21_Tx" VALUE 0x804D8536 DefaultValueRecordLayout_AUTOSAR_Platform_BaseTypes_uint16 65535.0 RB_RBA_Common_CentralElements_CompuMethods_Identical 0.0 65535. FORMAT "%5.0" /end CHARACTERISTIC
/begin CHARACTERISTIC Com_tiENG22_TxTxPerd_C "Calibration parameter to control Tx Ipdu periodic factor for ENG22_Tx" VALUE 0x804D8534 DefaultValueRecordLayout_AUTOSAR_Platform_BaseTypes_uint16 65535.0 RB_RBA_Common_CentralElements_CompuMethods_Identical 0.0 65535. FORMAT "%5.0" /end CHARACTERISTIC
/begin CHARACTERISTIC Com_tiENG23_TxTxPerd_C "Calibration parameter to control Tx Ipdu periodic factor for ENG23_Tx" VALUE 0x804D8532 DefaultValueRecordLayout_AUTOSAR_Platform_BaseTypes_uint16 65535.0 RB_RBA_Common_CentralElements_CompuMethods_Identical 0.0 65535. FORMAT "%5.0" /end CHARACTERISTIC
/begin CHARACTERISTIC Com_tiENG24_TxTxPerd_C "Calibration parameter to control Tx Ipdu periodic factor for ENG24_Tx" VALUE 0x804D8530 DefaultValueRecordLayout_AUTOSAR_Platform_BaseTypes_uint16 65535.0 RB_RBA_Common_CentralElements_CompuMethods_Identical 0.0 65535. FORMAT "%5.0" /end CHARACTERISTIC
/begin CHARACTERISTIC Com_tiENG25_TxTxPerd_C "Calibration parameter to control Tx Ipdu periodic factor for ENG25_Tx" VALUE 0x804D852E DefaultValueRecordLayout_AUTOSAR_Platform_BaseTypes_uint16 65535.0 RB_RBA_Common_CentralElements_CompuMethods_Identical 0.0 65535. FORMAT "%5.0" /end CHARACTERISTIC
/begin CHARACTERISTIC Com_tiENG2_TxTxPerd_C "Calibration parameter to control Tx Ipdu periodic factor for ENG2_Tx" VALUE 0x804D852C DefaultValueRecordLayout_AUTOSAR_Platform_BaseTypes_uint16 65535.0 RB_RBA_Common_CentralElements_CompuMethods_Identical 0.0 65535. FORMAT "%5.0" /end CHARACTERISTIC
/begin CHARACTERISTIC Com_tiENG3_TxTxPerd_C "Calibration parameter to control Tx Ipdu periodic factor for ENG3_Tx" VALUE 0x804D852A DefaultValueRecordLayout_AUTOSAR_Platform_BaseTypes_uint16 65535.0 RB_RBA_Common_CentralElements_CompuMethods_Identical 0.0 65535. FORMAT "%5.0" /end CHARACTERISTIC
/begin CHARACTERISTIC Com_tiENG4_TxTxPerd_C "Calibration parameter to control Tx Ipdu periodic factor for ENG4_Tx" VALUE 0x804D8528 DefaultValueRecordLayout_AUTOSAR_Platform_BaseTypes_uint16 65535.0 RB_RBA_Common_CentralElements_CompuMethods_Identical 0.0 65535. FORMAT "%5.0" /end CHARACTERISTIC
/begin CHARACTERISTIC Com_tiENG5_TxTxPerd_C "Calibration parameter to control Tx Ipdu periodic factor for ENG5_Tx" VALUE 0x804D8526 DefaultValueRecordLayout_AUTOSAR_Platform_BaseTypes_uint16 65535.0 RB_RBA_Common_CentralElements_CompuMethods_Identical 0.0 65535. FORMAT "%5.0" /end CHARACTERISTIC
/begin CHARACTERISTIC Com_tiENG6_TxTxPerd_C "Calibration parameter to control Tx Ipdu periodic factor for ENG6_Tx" VALUE 0x804D8524 DefaultValueRecordLayout_AUTOSAR_Platform_BaseTypes_uint16 65535.0 RB_RBA_Common_CentralElements_CompuMethods_Identical 0.0 65535. FORMAT "%5.0" /end CHARACTERISTIC
/begin CHARACTERISTIC Com_tiENGAE_TxTxPerd_C "Calibration parameter to control Tx Ipdu periodic factor for ENGAE_Tx" VALUE 0x804D8522 DefaultValueRecordLayout_AUTOSAR_Platform_BaseTypes_uint16 65535.0 RB_RBA_Common_CentralElements_CompuMethods_Identical 0.0 65535. FORMAT "%5.0" /end CHARACTERISTIC
/begin CHARACTERISTIC Com_tiENGA_TxTxPerd_C "Calibration parameter to control Tx Ipdu periodic factor for ENGA_Tx" VALUE 0x804D8520 DefaultValueRecordLayout_AUTOSAR_Platform_BaseTypes_uint16 65535.0 RB_RBA_Common_CentralElements_CompuMethods_Identical 0.0 65535. FORMAT "%5.0" /end CHARACTERISTIC
/begin CHARACTERISTIC Com_tiENGB_TxTxPerd_C "Calibration parameter to control Tx Ipdu periodic factor for ENGB_Tx" VALUE 0x804D851E DefaultValueRecordLayout_AUTOSAR_Platform_BaseTypes_uint16 65535.0 RB_RBA_Common_CentralElements_CompuMethods_Identical 0.0 65535. FORMAT "%5.0" /end CHARACTERISTIC
/begin CHARACTERISTIC Com_tiENGC_TxTxPerd_C "Calibration parameter to control Tx Ipdu periodic factor for ENGC_Tx" VALUE 0x804D851C DefaultValueRecordLayout_AUTOSAR_Platform_BaseTypes_uint16 65535.0 RB_RBA_Common_CentralElements_CompuMethods_Identical 0.0 65535. FORMAT "%5.0" /end CHARACTERISTIC
/begin CHARACTERISTIC Com_tiENGD_TxTxPerd_C "Calibration parameter to control Tx Ipdu periodic factor for ENGD_Tx" VALUE 0x804D851A DefaultValueRecordLayout_AUTOSAR_Platform_BaseTypes_uint16 65535.0 RB_RBA_Common_CentralElements_CompuMethods_Identical 0.0 65535. FORMAT "%5.0" /end CHARACTERISTIC
/begin CHARACTERISTIC Com_tiENGE_TxTxPerd_C "Calibration parameter to control Tx Ipdu periodic factor for ENGE_Tx" VALUE 0x804D8518 DefaultValueRecordLayout_AUTOSAR_Platform_BaseTypes_uint16 65535.0 RB_RBA_Common_CentralElements_CompuMethods_Identical 0.0 65535. FORMAT "%5.0" /end CHARACTERISTIC
/begin CHARACTERISTIC Com_tiENGF_TxTxPerd_C "Calibration parameter to control Tx Ipdu periodic factor for ENGF_Tx" VALUE 0x804D8516 DefaultValueRecordLayout_AUTOSAR_Platform_BaseTypes_uint16 65535.0 RB_RBA_Common_CentralElements_CompuMethods_Identical 0.0 65535. FORMAT "%5.0" /end CHARACTERISTIC
/begin CHARACTERISTIC Com_tiENGHIP1_TxTxPerd_C "Calibration parameter to control Tx Ipdu periodic factor for ENGHIP1_Tx" VALUE 0x804D8514 DefaultValueRecordLayout_AUTOSAR_Platform_BaseTypes_uint16 65535.0 RB_RBA_Common_CentralElements_CompuMethods_Identical 0.0 65535. FORMAT "%5.0" /end CHARACTERISTIC
/begin CHARACTERISTIC Com_tiENGIMG1_TxTxPerd_C "Calibration parameter to control Tx Ipdu periodic factor for ENGIMG1_Tx" VALUE 0x804D8512 DefaultValueRecordLayout_AUTOSAR_Platform_BaseTypes_uint16 65535.0 RB_RBA_Common_CentralElements_CompuMethods_Identical 0.0 65535. FORMAT "%5.0" /end CHARACTERISTIC
/begin CHARACTERISTIC Com_tiENGJ3_TxTxPerd_C "Calibration parameter to control Tx Ipdu periodic factor for ENGJ3_Tx" VALUE 0x804D8510 DefaultValueRecordLayout_AUTOSAR_Platform_BaseTypes_uint16 65535.0 RB_RBA_Common_CentralElements_CompuMethods_Identical 0.0 65535. FORMAT "%5.0" /end CHARACTERISTIC
/begin CHARACTERISTIC Com_tiENGK3_TxTxPerd_C "Calibration parameter to control Tx Ipdu periodic factor for ENGK3_Tx" VALUE 0x804D850E DefaultValueRecordLayout_AUTOSAR_Platform_BaseTypes_uint16 65535.0 RB_RBA_Common_CentralElements_CompuMethods_Identical 0.0 65535. FORMAT "%5.0" /end CHARACTERISTIC
/begin CHARACTERISTIC Com_tiENGL_TxTxPerd_C "Calibration parameter to control Tx Ipdu periodic factor for ENGL_Tx" VALUE 0x804D850C DefaultValueRecordLayout_AUTOSAR_Platform_BaseTypes_uint16 65535.0 RB_RBA_Common_CentralElements_CompuMethods_Identical 0.0 65535. FORMAT "%5.0" /end CHARACTERISTIC
/begin CHARACTERISTIC Com_tiENGN_TxTxPerd_C "Calibration parameter to control Tx Ipdu periodic factor for ENGN_Tx" VALUE 0x804D850A DefaultValueRecordLayout_AUTOSAR_Platform_BaseTypes_uint16 65535.0 RB_RBA_Common_CentralElements_CompuMethods_Identical 0.0 65535. FORMAT "%5.0" /end CHARACTERISTIC
/begin CHARACTERISTIC Com_tiENGQ_TxTxPerd_C "Calibration parameter to control Tx Ipdu periodic factor for ENGQ_Tx" VALUE 0x804D8508 DefaultValueRecordLayout_AUTOSAR_Platform_BaseTypes_uint16 65535.0 RB_RBA_Common_CentralElements_CompuMethods_Identical 0.0 65535. FORMAT "%5.0" /end CHARACTERISTIC
/begin CHARACTERISTIC Com_tiENGR_TxTxPerd_C "Calibration parameter to control Tx Ipdu periodic factor for ENGR_Tx" VALUE 0x804D8506 DefaultValueRecordLayout_AUTOSAR_Platform_BaseTypes_uint16 65535.0 RB_RBA_Common_CentralElements_CompuMethods_Identical 0.0 65535. FORMAT "%5.0" /end CHARACTERISTIC
/begin CHARACTERISTIC Com_tiENGT1_TxTxPerd_C "Calibration parameter to control Tx Ipdu periodic factor for ENGT1_Tx" VALUE 0x804D8504 DefaultValueRecordLayout_AUTOSAR_Platform_BaseTypes_uint16 65535.0 RB_RBA_Common_CentralElements_CompuMethods_Identical 0.0 65535. FORMAT "%5.0" /end CHARACTERISTIC
/begin CHARACTERISTIC Com_tiENGT2_TxTxPerd_C "Calibration parameter to control Tx Ipdu periodic factor for ENGT2_Tx" VALUE 0x804D8502 DefaultValueRecordLayout_AUTOSAR_Platform_BaseTypes_uint16 65535.0 RB_RBA_Common_CentralElements_CompuMethods_Identical 0.0 65535. FORMAT "%5.0" /end CHARACTERISTIC
/begin CHARACTERISTIC Com_tiENGT_TxTxPerd_C "Calibration parameter to control Tx Ipdu periodic factor for ENGT_Tx" VALUE 0x804D8500 DefaultValueRecordLayout_AUTOSAR_Platform_BaseTypes_uint16 65535.0 RB_RBA_Common_CentralElements_CompuMethods_Identical 0.0 65535. FORMAT "%5.0" /end CHARACTERISTIC
/begin CHARACTERISTIC Com_tiENGU_TxTxPerd_C "Calibration parameter to control Tx Ipdu periodic factor for ENGU_Tx" VALUE 0x804D84FE DefaultValueRecordLayout_AUTOSAR_Platform_BaseTypes_uint16 65535.0 RB_RBA_Common_CentralElements_CompuMethods_Identical 0.0 65535. FORMAT "%5.0" /end CHARACTERISTIC
/begin CHARACTERISTIC Com_tiENGV_TxTxPerd_C "Calibration parameter to control Tx Ipdu periodic factor for ENGV_Tx" VALUE 0x804D84FC DefaultValueRecordLayout_AUTOSAR_Platform_BaseTypes_uint16 65535.0 RB_RBA_Common_CentralElements_CompuMethods_Identical 0.0 65535. FORMAT "%5.0" /end CHARACTERISTIC
/begin CHARACTERISTIC Com_tiENGW_TxTxPerd_C "Calibration parameter to control Tx Ipdu periodic factor for ENGW_Tx" VALUE 0x804D84FA DefaultValueRecordLayout_AUTOSAR_Platform_BaseTypes_uint16 65535.0 RB_RBA_Common_CentralElements_CompuMethods_Identical 0.0 65535. FORMAT "%5.0" /end CHARACTERISTIC
/begin CHARACTERISTIC Com_tiENGX2_TxTxPerd_C "Calibration parameter to control Tx Ipdu periodic factor for ENGX2_Tx" VALUE 0x804D84F8 DefaultValueRecordLayout_AUTOSAR_Platform_BaseTypes_uint16 65535.0 RB_RBA_Common_CentralElements_CompuMethods_Identical 0.0 65535. FORMAT "%5.0" /end CHARACTERISTIC
/begin CHARACTERISTIC Com_tiENGY2_TxTxPerd_C "Calibration parameter to control Tx Ipdu periodic factor for ENGY2_Tx" VALUE 0x804D84F6 DefaultValueRecordLayout_AUTOSAR_Platform_BaseTypes_uint16 65535.0 RB_RBA_Common_CentralElements_CompuMethods_Identical 0.0 65535. FORMAT "%5.0" /end CHARACTERISTIC
/begin CHARACTERISTIC Com_tiENGY_TxTxPerd_C "Calibration parameter to control Tx Ipdu periodic factor for ENGY_Tx" VALUE 0x804D84F4 DefaultValueRecordLayout_AUTOSAR_Platform_BaseTypes_uint16 65535.0 RB_RBA_Common_CentralElements_CompuMethods_Identical 0.0 65535. FORMAT "%5.0" /end CHARACTERISTIC
/begin CHARACTERISTIC Com_tiENGZ_TxTxPerd_C "Calibration parameter to control Tx Ipdu periodic factor for ENGZ_Tx" VALUE 0x804D84F2 DefaultValueRecordLayout_AUTOSAR_Platform_BaseTypes_uint16 65535.0 RB_RBA_Common_CentralElements_CompuMethods_Identical 0.0 65535. FORMAT "%5.0" /end CHARACTERISTIC
/begin CHARACTERISTIC Com_tiEPS1_RxRxTout_C "Calibration parameter to control Rx Ipdu Timeout for EPS1_Rx" VALUE 0x804D84F0 DefaultValueRecordLayout_AUTOSAR_Platform_BaseTypes_uint16 65535.0 RB_RBA_Common_CentralElements_CompuMethods_Identical 0.0 65535. FORMAT "%5.0" /end CHARACTERISTIC
/begin CHARACTERISTIC Com_tiGWIMG1_RxRxTout_C "Calibration parameter to control Rx Ipdu Timeout for GWIMG1_Rx" VALUE 0x804D84EE DefaultValueRecordLayout_AUTOSAR_Platform_BaseTypes_uint16 65535.0 RB_RBA_Common_CentralElements_CompuMethods_Identical 0.0 65535. FORMAT "%5.0" /end CHARACTERISTIC
/begin CHARACTERISTIC Com_tiGWIMG3_RxRxTout_C "Calibration parameter to control Rx Ipdu Timeout for GWIMG3_Rx" VALUE 0x804D84EC DefaultValueRecordLayout_AUTOSAR_Platform_BaseTypes_uint16 65535.0 RB_RBA_Common_CentralElements_CompuMethods_Identical 0.0 65535. FORMAT "%5.0" /end CHARACTERISTIC
/begin CHARACTERISTIC Com_tiGWIMG4_RxRxTout_C "Calibration parameter to control Rx Ipdu Timeout for GWIMG4_Rx" VALUE 0x804D84EA DefaultValueRecordLayout_AUTOSAR_Platform_BaseTypes_uint16 65535.0 RB_RBA_Common_CentralElements_CompuMethods_Identical 0.0 65535. FORMAT "%5.0" /end CHARACTERISTIC
/begin CHARACTERISTIC Com_tiGWIMG5_RxRxTout_C "Calibration parameter to control Rx Ipdu Timeout for GWIMG5_Rx" VALUE 0x804D84E8 DefaultValueRecordLayout_AUTOSAR_Platform_BaseTypes_uint16 65535.0 RB_RBA_Common_CentralElements_CompuMethods_Identical 0.0 65535. FORMAT "%5.0" /end CHARACTERISTIC
/begin CHARACTERISTIC Com_tiGWIMG6_RxRxTout_C "Calibration parameter to control Rx Ipdu Timeout for GWIMG6_Rx" VALUE 0x804D84E6 DefaultValueRecordLayout_AUTOSAR_Platform_BaseTypes_uint16 65535.0 RB_RBA_Common_CentralElements_CompuMethods_Identical 0.0 65535. FORMAT "%5.0" /end CHARACTERISTIC
/begin CHARACTERISTIC Com_tiIDASB_RxRxTout_C "Calibration parameter to control Rx Ipdu Timeout for IDASB_Rx" VALUE 0x804D84E4 DefaultValueRecordLayout_AUTOSAR_Platform_BaseTypes_uint16 65535.0 RB_RBA_Common_CentralElements_CompuMethods_Identical 0.0 65535. FORMAT "%5.0" /end CHARACTERISTIC
/begin CHARACTERISTIC Com_tiLin_Alt_Rx_ACG_INFO_B_RxRxTout_C "Calibration parameter to control Rx Ipdu Timeout for Lin_Alt_Rx_ACG_INFO_B_Rx" VALUE 0x804D84E2 DefaultValueRecordLayout_AUTOSAR_Platform_BaseTypes_uint16 65535.0 RB_RBA_Common_CentralElements_CompuMethods_Identical 0.0 65535. FORMAT "%5.0" /end CHARACTERISTIC
/begin CHARACTERISTIC Com_tiLin_BS_Rx_EBSA_RxRxTout_C "Calibration parameter to control Rx Ipdu Timeout for Lin_BS_Rx_EBSA_Rx" VALUE 0x804D84E0 DefaultValueRecordLayout_AUTOSAR_Platform_BaseTypes_uint16 65535.0 RB_RBA_Common_CentralElements_CompuMethods_Identical 0.0 65535. FORMAT "%5.0" /end CHARACTERISTIC
/begin CHARACTERISTIC Com_tiLin_BS_Rx_EBSB_RxRxTout_C "Calibration parameter to control Rx Ipdu Timeout for Lin_BS_Rx_EBSB_Rx" VALUE 0x804D84DE DefaultValueRecordLayout_AUTOSAR_Platform_BaseTypes_uint16 65535.0 RB_RBA_Common_CentralElements_CompuMethods_Identical 0.0 65535. FORMAT "%5.0" /end CHARACTERISTIC
/begin CHARACTERISTIC Com_tiLin_BS_Rx_EBSC_RxRxTout_C "Calibration parameter to control Rx Ipdu Timeout for Lin_BS_Rx_EBSC_Rx" VALUE 0x804D84DC DefaultValueRecordLayout_AUTOSAR_Platform_BaseTypes_uint16 65535.0 RB_RBA_Common_CentralElements_CompuMethods_Identical 0.0 65535. FORMAT "%5.0" /end CHARACTERISTIC
/begin CHARACTERISTIC Com_tiLin_BS_Rx_EBSD_RxRxTout_C "Calibration parameter to control Rx Ipdu Timeout for Lin_BS_Rx_EBSD_Rx" VALUE 0x804D84DA DefaultValueRecordLayout_AUTOSAR_Platform_BaseTypes_uint16 65535.0 RB_RBA_Common_CentralElements_CompuMethods_Identical 0.0 65535. FORMAT "%5.0" /end CHARACTERISTIC
/begin CHARACTERISTIC Com_tiLin_BS_Rx_EBSE_RxRxTout_C "Calibration parameter to control Rx Ipdu Timeout for Lin_BS_Rx_EBSE_Rx" VALUE 0x804D84D8 DefaultValueRecordLayout_AUTOSAR_Platform_BaseTypes_uint16 65535.0 RB_RBA_Common_CentralElements_CompuMethods_Identical 0.0 65535. FORMAT "%5.0" /end CHARACTERISTIC
/begin CHARACTERISTIC Com_tiLin_BS_Rx_EBSF_RxRxTout_C "Calibration parameter to control Rx Ipdu Timeout for Lin_BS_Rx_EBSF_Rx" VALUE 0x804D84D6 DefaultValueRecordLayout_AUTOSAR_Platform_BaseTypes_uint16 65535.0 RB_RBA_Common_CentralElements_CompuMethods_Identical 0.0 65535. FORMAT "%5.0" /end CHARACTERISTIC
/begin CHARACTERISTIC Com_tiLin_BS_Rx_EBSG_RxRxTout_C "Calibration parameter to control Rx Ipdu Timeout for Lin_BS_Rx_EBSG_Rx" VALUE 0x804D84D4 DefaultValueRecordLayout_AUTOSAR_Platform_BaseTypes_uint16 65535.0 RB_RBA_Common_CentralElements_CompuMethods_Identical 0.0 65535. FORMAT "%5.0" /end CHARACTERISTIC
/begin CHARACTERISTIC Com_tiLin_BS_Rx_EBSH_RxRxTout_C "Calibration parameter to control Rx Ipdu Timeout for Lin_BS_Rx_EBSH_Rx" VALUE 0x804D84D2 DefaultValueRecordLayout_AUTOSAR_Platform_BaseTypes_uint16 65535.0 RB_RBA_Common_CentralElements_CompuMethods_Identical 0.0 65535. FORMAT "%5.0" /end CHARACTERISTIC
/begin CHARACTERISTIC Com_tiLin_BS_Rx_EBSI_RxRxTout_C "Calibration parameter to control Rx Ipdu Timeout for Lin_BS_Rx_EBSI_Rx" VALUE 0x804D84D0 DefaultValueRecordLayout_AUTOSAR_Platform_BaseTypes_uint16 65535.0 RB_RBA_Common_CentralElements_CompuMethods_Identical 0.0 65535. FORMAT "%5.0" /end CHARACTERISTIC
/begin CHARACTERISTIC Com_tiMETA_RxRxTout_C "Calibration parameter to control Rx Ipdu Timeout for META_Rx" VALUE 0x804D84CE DefaultValueRecordLayout_AUTOSAR_Platform_BaseTypes_uint16 65535.0 RB_RBA_Common_CentralElements_CompuMethods_Identical 0.0 65535. FORMAT "%5.0" /end CHARACTERISTIC
/begin CHARACTERISTIC Com_tiMETC_RxRxTout_C "Calibration parameter to control Rx Ipdu Timeout for METC_Rx" VALUE 0x804D84CC DefaultValueRecordLayout_AUTOSAR_Platform_BaseTypes_uint16 65535.0 RB_RBA_Common_CentralElements_CompuMethods_Identical 0.0 65535. FORMAT "%5.0" /end CHARACTERISTIC
/begin CHARACTERISTIC Com_tiMETD2_RxRxTout_C "Calibration parameter to control Rx Ipdu Timeout for METD2_Rx" VALUE 0x804D84CA DefaultValueRecordLayout_AUTOSAR_Platform_BaseTypes_uint16 65535.0 RB_RBA_Common_CentralElements_CompuMethods_Identical 0.0 65535. FORMAT "%5.0" /end CHARACTERISTIC
/begin CHARACTERISTIC Com_tiMETD_RxRxTout_C "Calibration parameter to control Rx Ipdu Timeout for METD_Rx" VALUE 0x804D84C8 DefaultValueRecordLayout_AUTOSAR_Platform_BaseTypes_uint16 65535.0 RB_RBA_Common_CentralElements_CompuMethods_Identical 0.0 65535. FORMAT "%5.0" /end CHARACTERISTIC
/begin CHARACTERISTIC Com_tiMETE2_RxRxTout_C "Calibration parameter to control Rx Ipdu Timeout for METE2_Rx" VALUE 0x804D84C6 DefaultValueRecordLayout_AUTOSAR_Platform_BaseTypes_uint16 65535.0 RB_RBA_Common_CentralElements_CompuMethods_Identical 0.0 65535. FORMAT "%5.0" /end CHARACTERISTIC
/begin CHARACTERISTIC Com_tiMETF_RxRxTout_C "Calibration parameter to control Rx Ipdu Timeout for METF_Rx" VALUE 0x804D84C4 DefaultValueRecordLayout_AUTOSAR_Platform_BaseTypes_uint16 65535.0 RB_RBA_Common_CentralElements_CompuMethods_Identical 0.0 65535. FORMAT "%5.0" /end CHARACTERISTIC
/begin CHARACTERISTIC Com_tiMETG_RxRxTout_C "Calibration parameter to control Rx Ipdu Timeout for METG_Rx" VALUE 0x804D84C2 DefaultValueRecordLayout_AUTOSAR_Platform_BaseTypes_uint16 65535.0 RB_RBA_Common_CentralElements_CompuMethods_Identical 0.0 65535. FORMAT "%5.0" /end CHARACTERISTIC
/begin CHARACTERISTIC Com_tiMETH2_RxRxTout_C "Calibration parameter to control Rx Ipdu Timeout for METH2_Rx" VALUE 0x804D84C0 DefaultValueRecordLayout_AUTOSAR_Platform_BaseTypes_uint16 65535.0 RB_RBA_Common_CentralElements_CompuMethods_Identical 0.0 65535. FORMAT "%5.0" /end CHARACTERISTIC
/begin CHARACTERISTIC Com_tiMETH_RxRxTout_C "Calibration parameter to control Rx Ipdu Timeout for METH_Rx" VALUE 0x804D84BE DefaultValueRecordLayout_AUTOSAR_Platform_BaseTypes_uint16 65535.0 RB_RBA_Common_CentralElements_CompuMethods_Identical 0.0 65535. FORMAT "%5.0" /end CHARACTERISTIC
/begin CHARACTERISTIC Com_tiMETI_RxRxTout_C "Calibration parameter to control Rx Ipdu Timeout for METI_Rx" VALUE 0x804D84BC DefaultValueRecordLayout_AUTOSAR_Platform_BaseTypes_uint16 65535.0 RB_RBA_Common_CentralElements_CompuMethods_Identical 0.0 65535. FORMAT "%5.0" /end CHARACTERISTIC
/begin CHARACTERISTIC Com_tiMETK_RxRxTout_C "Calibration parameter to control Rx Ipdu Timeout for METK_Rx" VALUE 0x804D84BA DefaultValueRecordLayout_AUTOSAR_Platform_BaseTypes_uint16 65535.0 RB_RBA_Common_CentralElements_CompuMethods_Identical 0.0 65535. FORMAT "%5.0" /end CHARACTERISTIC
/begin CHARACTERISTIC Com_tiMETL_RxRxTout_C "Calibration parameter to control Rx Ipdu Timeout for METL_Rx" VALUE 0x804D84B8 DefaultValueRecordLayout_AUTOSAR_Platform_BaseTypes_uint16 65535.0 RB_RBA_Common_CentralElements_CompuMethods_Identical 0.0 65535. FORMAT "%5.0" /end CHARACTERISTIC
/begin CHARACTERISTIC Com_tiMETM_RxRxTout_C "Calibration parameter to control Rx Ipdu Timeout for METM_Rx" VALUE 0x804D84B6 DefaultValueRecordLayout_AUTOSAR_Platform_BaseTypes_uint16 65535.0 RB_RBA_Common_CentralElements_CompuMethods_Identical 0.0 65535. FORMAT "%5.0" /end CHARACTERISTIC
/begin CHARACTERISTIC Com_tiMETN_RxRxTout_C "Calibration parameter to control Rx Ipdu Timeout for METN_Rx" VALUE 0x804D84B4 DefaultValueRecordLayout_AUTOSAR_Platform_BaseTypes_uint16 65535.0 RB_RBA_Common_CentralElements_CompuMethods_Identical 0.0 65535. FORMAT "%5.0" /end CHARACTERISTIC
/begin CHARACTERISTIC Com_tiPCU_RxRxTout_C "Calibration parameter to control Rx Ipdu Timeout for PCU_Rx" VALUE 0x804D84B2 DefaultValueRecordLayout_AUTOSAR_Platform_BaseTypes_uint16 65535.0 RB_RBA_Common_CentralElements_CompuMethods_Identical 0.0 65535. FORMAT "%5.0" /end CHARACTERISTIC
/begin CHARACTERISTIC Com_tiSRSA_RxRxTout_C "Calibration parameter to control Rx Ipdu Timeout for SRSA_Rx" VALUE 0x804D84B0 DefaultValueRecordLayout_AUTOSAR_Platform_BaseTypes_uint16 65535.0 RB_RBA_Common_CentralElements_CompuMethods_Identical 0.0 65535. FORMAT "%5.0" /end CHARACTERISTIC
/begin CHARACTERISTIC Com_tiSRSB_RxRxTout_C "Calibration parameter to control Rx Ipdu Timeout for SRSB_Rx" VALUE 0x804D84AE DefaultValueRecordLayout_AUTOSAR_Platform_BaseTypes_uint16 65535.0 RB_RBA_Common_CentralElements_CompuMethods_Identical 0.0 65535. FORMAT "%5.0" /end CHARACTERISTIC
/begin CHARACTERISTIC Com_tiSRS_RxRxTout_C "Calibration parameter to control Rx Ipdu Timeout for SRS_Rx" VALUE 0x804D84AC DefaultValueRecordLayout_AUTOSAR_Platform_BaseTypes_uint16 65535.0 RB_RBA_Common_CentralElements_CompuMethods_Identical 0.0 65535. FORMAT "%5.0" /end CHARACTERISTIC
/begin CHARACTERISTIC Com_tieng1_TxTxPerd_C "Calibration parameter to control Tx Ipdu periodic factor for eng1_Tx" VALUE 0x804D84AA DefaultValueRecordLayout_AUTOSAR_Platform_BaseTypes_uint16 65535.0 RB_RBA_Common_CentralElements_CompuMethods_Identical 0.0 65535. FORMAT "%5.0" /end CHARACTERISTIC
/begin CHARACTERISTIC Com_tiengo_TxTxPerd_C "Calibration parameter to control Tx Ipdu periodic factor for engo_Tx" VALUE 0x804D84A8 DefaultValueRecordLayout_AUTOSAR_Platform_BaseTypes_uint16 65535.0 RB_RBA_Common_CentralElements_CompuMethods_Identical 0.0 65535. FORMAT "%5.0" /end CHARACTERISTIC
/*********** Start of merged MEASUREMENT blocks ***********/
/begin MEASUREMENT CanIf_Prv_ControllerState_ast[0].Ctrl_Pdu_mode "Can Interface controller State[0]/" UBYTE RB_RBA_Common_CentralElements_CompuMethods_Identical 1 100 0.0 255. FORMAT "%5.0" ECU_ADDRESS 0x6000C3FC /end MEASUREMENT
/begin MEASUREMENT CanIf_Prv_ControllerState_ast[1].Ctrl_Pdu_mode "Can Interface controller State[1]/" UBYTE RB_RBA_Common_CentralElements_CompuMethods_Identical 1 100 0.0 255. FORMAT "%5.0" ECU_ADDRESS 0x6000C3FE /end MEASUREMENT
/begin MEASUREMENT CanIf_Prv_ControllerState_ast[2].Ctrl_Pdu_mode "Can Interface controller State[2]/" UBYTE RB_RBA_Common_CentralElements_CompuMethods_Identical 1 100 0.0 255. FORMAT "%5.0" ECU_ADDRESS 0x6000C400 /end MEASUREMENT
/begin MEASUREMENT CanIf_Prv_InitStatus_b "Flag to check if CANIF is Initialized(TRUE) or Not Initialized (FALSE)" UBYTE RB_RBA_Common_CentralElements_CompuMethods_Identical 1 100 0.0 1. FORMAT "%5.0" ECU_ADDRESS 0x6000C402 /end MEASUREMENT
/begin MEASUREMENT CanIf_Prv_TxBufferRam_ast[0].last_index "Can Interface Buffer Status[0]/" UBYTE RB_RBA_Common_CentralElements_CompuMethods_Identical 1 100 0.0 255. FORMAT "%5.0" ECU_ADDRESS 0x70002DBE /end MEASUREMENT
/begin MEASUREMENT CanIf_Prv_TxBufferRam_ast[1].last_index "Can Interface Buffer Status[1]/" UBYTE RB_RBA_Common_CentralElements_CompuMethods_Identical 1 100 0.0 255. FORMAT "%5.0" ECU_ADDRESS 0x70002DC0 /end MEASUREMENT
/begin MEASUREMENT CanIf_Prv_TxBufferRam_ast[2].last_index "Can Interface Buffer Status[2]/" UBYTE RB_RBA_Common_CentralElements_CompuMethods_Identical 1 100 0.0 255. FORMAT "%5.0" ECU_ADDRESS 0x70002DC2 /end MEASUREMENT
/begin MEASUREMENT CanIf_Prv_TxBufferRam_ast[3].last_index "Can Interface Buffer Status[3]/" UBYTE RB_RBA_Common_CentralElements_CompuMethods_Identical 1 100 0.0 255. FORMAT "%5.0" ECU_ADDRESS 0x70002DC4 /end MEASUREMENT
/begin MEASUREMENT CanIf_Prv_TxBufferRam_ast[4].last_index "Can Interface Buffer Status[4]/" UBYTE RB_RBA_Common_CentralElements_CompuMethods_Identical 1 100 0.0 255. FORMAT "%5.0" ECU_ADDRESS 0x70002DC6 /end MEASUREMENT
/begin MEASUREMENT CanIf_Prv_TxBufferRam_ast[5].last_index "Can Interface Buffer Status[5]/" UBYTE RB_RBA_Common_CentralElements_CompuMethods_Identical 1 100 0.0 255. FORMAT "%5.0" ECU_ADDRESS 0x70002DC8 /end MEASUREMENT
/begin MEASUREMENT CanIf_Prv_TxBufferRam_ast[6].last_index "Can Interface Buffer Status[6]/" UBYTE RB_RBA_Common_CentralElements_CompuMethods_Identical 1 100 0.0 255. FORMAT "%5.0" ECU_ADDRESS 0x70002DCA /end MEASUREMENT
/begin MEASUREMENT CanIf_Prv_TxBufferRam_ast[7].last_index "Can Interface Buffer Status[7]/" UBYTE RB_RBA_Common_CentralElements_CompuMethods_Identical 1 100 0.0 255. FORMAT "%5.0" ECU_ADDRESS 0x70002DCC /end MEASUREMENT
/begin MEASUREMENT CanIf_Prv_TxBufferRam_ast[8].last_index "Can Interface Buffer Status[8]/" UBYTE RB_RBA_Common_CentralElements_CompuMethods_Identical 1 100 0.0 255. FORMAT "%5.0" ECU_ADDRESS 0x70002DCE /end MEASUREMENT
/begin MEASUREMENT CanIf_Prv_TxBufferRam_ast[9].last_index "Can Interface Buffer Status[9]/" UBYTE RB_RBA_Common_CentralElements_CompuMethods_Identical 1 100 0.0 255. FORMAT "%5.0" ECU_ADDRESS 0x70002DD0 /end MEASUREMENT
/begin MEASUREMENT CanIf_Prv_TxBufferRam_ast[10].last_index "Can Interface Buffer Status[10]/" UBYTE RB_RBA_Common_CentralElements_CompuMethods_Identical 1 100 0.0 255. FORMAT "%5.0" ECU_ADDRESS 0x70002DD2 /end MEASUREMENT
/begin MEASUREMENT CanIf_Prv_TxBufferRam_ast[11].last_index "Can Interface Buffer Status[11]/" UBYTE RB_RBA_Common_CentralElements_CompuMethods_Identical 1 100 0.0 255. FORMAT "%5.0" ECU_ADDRESS 0x70002DD4 /end MEASUREMENT
/begin MEASUREMENT CanIf_Prv_TxBufferRam_ast[12].last_index "Can Interface Buffer Status[12]/" UBYTE RB_RBA_Common_CentralElements_CompuMethods_Identical 1 100 0.0 255. FORMAT "%5.0" ECU_ADDRESS 0x70002DD6 /end MEASUREMENT
/begin MEASUREMENT CanIf_Prv_TxBufferRam_ast[13].last_index "Can Interface Buffer Status[13]/" UBYTE RB_RBA_Common_CentralElements_CompuMethods_Identical 1 100 0.0 255. FORMAT "%5.0" ECU_ADDRESS 0x70002DD8 /end MEASUREMENT
/begin MEASUREMENT CanIf_Prv_TxBufferRam_ast[14].last_index "Can Interface Buffer Status[14]/" UBYTE RB_RBA_Common_CentralElements_CompuMethods_Identical 1 100 0.0 255. FORMAT "%5.0" ECU_ADDRESS 0x70002DDA /end MEASUREMENT
/begin MEASUREMENT CanIf_Prv_TxBufferRam_ast[15].last_index "Can Interface Buffer Status[15]/" UBYTE RB_RBA_Common_CentralElements_CompuMethods_Identical 1 100 0.0 255. FORMAT "%5.0" ECU_ADDRESS 0x70002DDC /end MEASUREMENT
/begin MEASUREMENT CanIf_Prv_TxBufferRam_ast[16].last_index "Can Interface Buffer Status[16]/" UBYTE RB_RBA_Common_CentralElements_CompuMethods_Identical 1 100 0.0 255. FORMAT "%5.0" ECU_ADDRESS 0x70002DDE /end MEASUREMENT
/begin MEASUREMENT CanIf_Prv_TxBufferRam_ast[17].last_index "Can Interface Buffer Status[17]/" UBYTE RB_RBA_Common_CentralElements_CompuMethods_Identical 1 100 0.0 255. FORMAT "%5.0" ECU_ADDRESS 0x70002DE0 /end MEASUREMENT
/begin MEASUREMENT CanIf_Prv_TxBufferRam_ast[18].last_index "Can Interface Buffer Status[18]/" UBYTE RB_RBA_Common_CentralElements_CompuMethods_Identical 1 100 0.0 255. FORMAT "%5.0" ECU_ADDRESS 0x70002DE2 /end MEASUREMENT
/begin MEASUREMENT CanIf_Prv_TxBufferRam_ast[19].last_index "Can Interface Buffer Status[19]/" UBYTE RB_RBA_Common_CentralElements_CompuMethods_Identical 1 100 0.0 255. FORMAT "%5.0" ECU_ADDRESS 0x70002DE4 /end MEASUREMENT
/begin MEASUREMENT CanIf_Prv_TxBufferRam_ast[20].last_index "Can Interface Buffer Status[20]/" UBYTE RB_RBA_Common_CentralElements_CompuMethods_Identical 1 100 0.0 255. FORMAT "%5.0" ECU_ADDRESS 0x70002DE6 /end MEASUREMENT
/begin MEASUREMENT CanIf_Prv_TxBufferRam_ast[21].last_index "Can Interface Buffer Status[21]/" UBYTE RB_RBA_Common_CentralElements_CompuMethods_Identical 1 100 0.0 255. FORMAT "%5.0" ECU_ADDRESS 0x70002DE8 /end MEASUREMENT
/begin MEASUREMENT CanIf_Prv_TxBufferRam_ast[22].last_index "Can Interface Buffer Status[22]/" UBYTE RB_RBA_Common_CentralElements_CompuMethods_Identical 1 100 0.0 255. FORMAT "%5.0" ECU_ADDRESS 0x70002DEA /end MEASUREMENT
/begin MEASUREMENT CanIf_Prv_TxBufferRam_ast[23].last_index "Can Interface Buffer Status[23]/" UBYTE RB_RBA_Common_CentralElements_CompuMethods_Identical 1 100 0.0 255. FORMAT "%5.0" ECU_ADDRESS 0x70002DEC /end MEASUREMENT
/begin MEASUREMENT CanIf_Prv_TxBufferRam_ast[24].last_index "Can Interface Buffer Status[24]/" UBYTE RB_RBA_Common_CentralElements_CompuMethods_Identical 1 100 0.0 255. FORMAT "%5.0" ECU_ADDRESS 0x70002DEE /end MEASUREMENT
/begin MEASUREMENT CanIf_Prv_TxBufferRam_ast[25].last_index "Can Interface Buffer Status[25]/" UBYTE RB_RBA_Common_CentralElements_CompuMethods_Identical 1 100 0.0 255. FORMAT "%5.0" ECU_ADDRESS 0x70002DF0 /end MEASUREMENT
/begin MEASUREMENT CanIf_Prv_TxBufferRam_ast[26].last_index "Can Interface Buffer Status[26]/" UBYTE RB_RBA_Common_CentralElements_CompuMethods_Identical 1 100 0.0 255. FORMAT "%5.0" ECU_ADDRESS 0x70002DF2 /end MEASUREMENT
/begin MEASUREMENT CanIf_Prv_TxBufferRam_ast[27].last_index "Can Interface Buffer Status[27]/" UBYTE RB_RBA_Common_CentralElements_CompuMethods_Identical 1 100 0.0 255. FORMAT "%5.0" ECU_ADDRESS 0x70002DF4 /end MEASUREMENT
/begin MEASUREMENT CanIf_Prv_TxBufferRam_ast[28].last_index "Can Interface Buffer Status[28]/" UBYTE RB_RBA_Common_CentralElements_CompuMethods_Identical 1 100 0.0 255. FORMAT "%5.0" ECU_ADDRESS 0x70002DF6 /end MEASUREMENT
/begin MEASUREMENT CanIf_Prv_TxBufferRam_ast[29].last_index "Can Interface Buffer Status[29]/" UBYTE RB_RBA_Common_CentralElements_CompuMethods_Identical 1 100 0.0 255. FORMAT "%5.0" ECU_ADDRESS 0x70002DF8 /end MEASUREMENT
/begin MEASUREMENT CanIf_Prv_TxBufferRam_ast[30].last_index "Can Interface Buffer Status[30]/" UBYTE RB_RBA_Common_CentralElements_CompuMethods_Identical 1 100 0.0 255. FORMAT "%5.0" ECU_ADDRESS 0x70002DFA /end MEASUREMENT
/begin MEASUREMENT CanIf_Prv_TxBufferRam_ast[31].last_index "Can Interface Buffer Status[31]/" UBYTE RB_RBA_Common_CentralElements_CompuMethods_Identical 1 100 0.0 255. FORMAT "%5.0" ECU_ADDRESS 0x70002DFC /end MEASUREMENT
/begin MEASUREMENT CanIf_Prv_TxBufferRam_ast[32].last_index "Can Interface Buffer Status[32]/" UBYTE RB_RBA_Common_CentralElements_CompuMethods_Identical 1 100 0.0 255. FORMAT "%5.0" ECU_ADDRESS 0x70002DFE /end MEASUREMENT
/begin MEASUREMENT CanIf_Prv_TxBufferRam_ast[33].last_index "Can Interface Buffer Status[33]/" UBYTE RB_RBA_Common_CentralElements_CompuMethods_Identical 1 100 0.0 255. FORMAT "%5.0" ECU_ADDRESS 0x70002E00 /end MEASUREMENT
/begin MEASUREMENT CanIf_Prv_TxBufferRam_ast[34].last_index "Can Interface Buffer Status[34]/" UBYTE RB_RBA_Common_CentralElements_CompuMethods_Identical 1 100 0.0 255. FORMAT "%5.0" ECU_ADDRESS 0x70002E02 /end MEASUREMENT
/begin MEASUREMENT CanIf_Prv_TxBufferRam_ast[35].last_index "Can Interface Buffer Status[35]/" UBYTE RB_RBA_Common_CentralElements_CompuMethods_Identical 1 100 0.0 255. FORMAT "%5.0" ECU_ADDRESS 0x70002E04 /end MEASUREMENT
/begin MEASUREMENT CanIf_Prv_TxBufferRam_ast[36].last_index "Can Interface Buffer Status[36]/" UBYTE RB_RBA_Common_CentralElements_CompuMethods_Identical 1 100 0.0 255. FORMAT "%5.0" ECU_ADDRESS 0x70002E06 /end MEASUREMENT
/begin MEASUREMENT CanIf_Prv_TxBufferRam_ast[37].last_index "Can Interface Buffer Status[37]/" UBYTE RB_RBA_Common_CentralElements_CompuMethods_Identical 1 100 0.0 255. FORMAT "%5.0" ECU_ADDRESS 0x70002E08 /end MEASUREMENT
/begin MEASUREMENT CanIf_Prv_TxBufferRam_ast[38].last_index "Can Interface Buffer Status[38]/" UBYTE RB_RBA_Common_CentralElements_CompuMethods_Identical 1 100 0.0 255. FORMAT "%5.0" ECU_ADDRESS 0x70002E0A /end MEASUREMENT
/begin MEASUREMENT CanIf_Prv_TxBufferRam_ast[39].last_index "Can Interface Buffer Status[39]/" UBYTE RB_RBA_Common_CentralElements_CompuMethods_Identical 1 100 0.0 255. FORMAT "%5.0" ECU_ADDRESS 0x70002E0C /end MEASUREMENT
/begin MEASUREMENT CanIf_Prv_TxBufferRam_ast[40].last_index "Can Interface Buffer Status[40]/" UBYTE RB_RBA_Common_CentralElements_CompuMethods_Identical 1 100 0.0 255. FORMAT "%5.0" ECU_ADDRESS 0x70002E0E /end MEASUREMENT
/begin MEASUREMENT CanIf_Prv_TxBufferRam_ast[41].last_index "Can Interface Buffer Status[41]/" UBYTE RB_RBA_Common_CentralElements_CompuMethods_Identical 1 100 0.0 255. FORMAT "%5.0" ECU_ADDRESS 0x70002E10 /end MEASUREMENT
/begin MEASUREMENT CanIf_Prv_TxBufferRam_ast[42].last_index "Can Interface Buffer Status[42]/" UBYTE RB_RBA_Common_CentralElements_CompuMethods_Identical 1 100 0.0 255. FORMAT "%5.0" ECU_ADDRESS 0x70002E12 /end MEASUREMENT
/begin MEASUREMENT CanIf_Prv_TxBufferRam_ast[43].last_index "Can Interface Buffer Status[43]/" UBYTE RB_RBA_Common_CentralElements_CompuMethods_Identical 1 100 0.0 255. FORMAT "%5.0" ECU_ADDRESS 0x70002E14 /end MEASUREMENT
/begin MEASUREMENT CanIf_Prv_TxBufferRam_ast[44].last_index "Can Interface Buffer Status[44]/" UBYTE RB_RBA_Common_CentralElements_CompuMethods_Identical 1 100 0.0 255. FORMAT "%5.0" ECU_ADDRESS 0x70002E16 /end MEASUREMENT
/begin MEASUREMENT CanIf_Prv_TxBufferRam_ast[45].last_index "Can Interface Buffer Status[45]/" UBYTE RB_RBA_Common_CentralElements_CompuMethods_Identical 1 100 0.0 255. FORMAT "%5.0" ECU_ADDRESS 0x70002E18 /end MEASUREMENT
/begin MEASUREMENT CanIf_Prv_TxBufferRam_ast[46].last_index "Can Interface Buffer Status[46]/" UBYTE RB_RBA_Common_CentralElements_CompuMethods_Identical 1 100 0.0 255. FORMAT "%5.0" ECU_ADDRESS 0x70002E1A /end MEASUREMENT
/begin MEASUREMENT CanIf_Prv_TxBufferRam_ast[47].last_index "Can Interface Buffer Status[47]/" UBYTE RB_RBA_Common_CentralElements_CompuMethods_Identical 1 100 0.0 255. FORMAT "%5.0" ECU_ADDRESS 0x70002E1C /end MEASUREMENT
/begin MEASUREMENT CanIf_Prv_TxBufferRam_ast[48].last_index "Can Interface Buffer Status[48]/" UBYTE RB_RBA_Common_CentralElements_CompuMethods_Identical 1 100 0.0 255. FORMAT "%5.0" ECU_ADDRESS 0x70002E1E /end MEASUREMENT
/begin MEASUREMENT CanIf_Prv_TxBufferRam_ast[49].last_index "Can Interface Buffer Status[49]/" UBYTE RB_RBA_Common_CentralElements_CompuMethods_Identical 1 100 0.0 255. FORMAT "%5.0" ECU_ADDRESS 0x70002E20 /end MEASUREMENT
/begin MEASUREMENT CanIf_Prv_TxBufferRam_ast[50].last_index "Can Interface Buffer Status[50]/" UBYTE RB_RBA_Common_CentralElements_CompuMethods_Identical 1 100 0.0 255. FORMAT "%5.0" ECU_ADDRESS 0x70002E22 /end MEASUREMENT
/begin MEASUREMENT CanIf_Prv_TxBufferRam_ast[51].last_index "Can Interface Buffer Status[51]/" UBYTE RB_RBA_Common_CentralElements_CompuMethods_Identical 1 100 0.0 255. FORMAT "%5.0" ECU_ADDRESS 0x70002E24 /end MEASUREMENT
/begin MEASUREMENT CanIf_Prv_TxBufferRam_ast[0].bufferstatus "Can Interface Buffer Status[0]/" UBYTE RB_RBA_Common_CentralElements_CompuMethods_Identical 1 100 0.0 255. FORMAT "%5.0" ECU_ADDRESS 0x70002DBF /end MEASUREMENT
/begin MEASUREMENT CanIf_Prv_TxBufferRam_ast[1].bufferstatus "Can Interface Buffer Status[1]/" UBYTE RB_RBA_Common_CentralElements_CompuMethods_Identical 1 100 0.0 255. FORMAT "%5.0" ECU_ADDRESS 0x70002DC1 /end MEASUREMENT
/begin MEASUREMENT CanIf_Prv_TxBufferRam_ast[2].bufferstatus "Can Interface Buffer Status[2]/" UBYTE RB_RBA_Common_CentralElements_CompuMethods_Identical 1 100 0.0 255. FORMAT "%5.0" ECU_ADDRESS 0x70002DC3 /end MEASUREMENT
/begin MEASUREMENT CanIf_Prv_TxBufferRam_ast[3].bufferstatus "Can Interface Buffer Status[3]/" UBYTE RB_RBA_Common_CentralElements_CompuMethods_Identical 1 100 0.0 255. FORMAT "%5.0" ECU_ADDRESS 0x70002DC5 /end MEASUREMENT
/begin MEASUREMENT CanIf_Prv_TxBufferRam_ast[4].bufferstatus "Can Interface Buffer Status[4]/" UBYTE RB_RBA_Common_CentralElements_CompuMethods_Identical 1 100 0.0 255. FORMAT "%5.0" ECU_ADDRESS 0x70002DC7 /end MEASUREMENT
/begin MEASUREMENT CanIf_Prv_TxBufferRam_ast[5].bufferstatus "Can Interface Buffer Status[5]/" UBYTE RB_RBA_Common_CentralElements_CompuMethods_Identical 1 100 0.0 255. FORMAT "%5.0" ECU_ADDRESS 0x70002DC9 /end MEASUREMENT
/begin MEASUREMENT CanIf_Prv_TxBufferRam_ast[6].bufferstatus "Can Interface Buffer Status[6]/" UBYTE RB_RBA_Common_CentralElements_CompuMethods_Identical 1 100 0.0 255. FORMAT "%5.0" ECU_ADDRESS 0x70002DCB /end MEASUREMENT
/begin MEASUREMENT CanIf_Prv_TxBufferRam_ast[7].bufferstatus "Can Interface Buffer Status[7]/" UBYTE RB_RBA_Common_CentralElements_CompuMethods_Identical 1 100 0.0 255. FORMAT "%5.0" ECU_ADDRESS 0x70002DCD /end MEASUREMENT
/begin MEASUREMENT CanIf_Prv_TxBufferRam_ast[8].bufferstatus "Can Interface Buffer Status[8]/" UBYTE RB_RBA_Common_CentralElements_CompuMethods_Identical 1 100 0.0 255. FORMAT "%5.0" ECU_ADDRESS 0x70002DCF /end MEASUREMENT
/begin MEASUREMENT CanIf_Prv_TxBufferRam_ast[9].bufferstatus "Can Interface Buffer Status[9]/" UBYTE RB_RBA_Common_CentralElements_CompuMethods_Identical 1 100 0.0 255. FORMAT "%5.0" ECU_ADDRESS 0x70002DD1 /end MEASUREMENT
/begin MEASUREMENT CanIf_Prv_TxBufferRam_ast[10].bufferstatus "Can Interface Buffer Status[10]/" UBYTE RB_RBA_Common_CentralElements_CompuMethods_Identical 1 100 0.0 255. FORMAT "%5.0" ECU_ADDRESS 0x70002DD3 /end MEASUREMENT
/begin MEASUREMENT CanIf_Prv_TxBufferRam_ast[11].bufferstatus "Can Interface Buffer Status[11]/" UBYTE RB_RBA_Common_CentralElements_CompuMethods_Identical 1 100 0.0 255. FORMAT "%5.0" ECU_ADDRESS 0x70002DD5 /end MEASUREMENT
/begin MEASUREMENT CanIf_Prv_TxBufferRam_ast[12].bufferstatus "Can Interface Buffer Status[12]/" UBYTE RB_RBA_Common_CentralElements_CompuMethods_Identical 1 100 0.0 255. FORMAT "%5.0" ECU_ADDRESS 0x70002DD7 /end MEASUREMENT
/begin MEASUREMENT CanIf_Prv_TxBufferRam_ast[13].bufferstatus "Can Interface Buffer Status[13]/" UBYTE RB_RBA_Common_CentralElements_CompuMethods_Identical 1 100 0.0 255. FORMAT "%5.0" ECU_ADDRESS 0x70002DD9 /end MEASUREMENT
/begin MEASUREMENT CanIf_Prv_TxBufferRam_ast[14].bufferstatus "Can Interface Buffer Status[14]/" UBYTE RB_RBA_Common_CentralElements_CompuMethods_Identical 1 100 0.0 255. FORMAT "%5.0" ECU_ADDRESS 0x70002DDB /end MEASUREMENT
/begin MEASUREMENT CanIf_Prv_TxBufferRam_ast[15].bufferstatus "Can Interface Buffer Status[15]/" UBYTE RB_RBA_Common_CentralElements_CompuMethods_Identical 1 100 0.0 255. FORMAT "%5.0" ECU_ADDRESS 0x70002DDD /end MEASUREMENT
/begin MEASUREMENT CanIf_Prv_TxBufferRam_ast[16].bufferstatus "Can Interface Buffer Status[16]/" UBYTE RB_RBA_Common_CentralElements_CompuMethods_Identical 1 100 0.0 255. FORMAT "%5.0" ECU_ADDRESS 0x70002DDF /end MEASUREMENT
/begin MEASUREMENT CanIf_Prv_TxBufferRam_ast[17].bufferstatus "Can Interface Buffer Status[17]/" UBYTE RB_RBA_Common_CentralElements_CompuMethods_Identical 1 100 0.0 255. FORMAT "%5.0" ECU_ADDRESS 0x70002DE1 /end MEASUREMENT
/begin MEASUREMENT CanIf_Prv_TxBufferRam_ast[18].bufferstatus "Can Interface Buffer Status[18]/" UBYTE RB_RBA_Common_CentralElements_CompuMethods_Identical 1 100 0.0 255. FORMAT "%5.0" ECU_ADDRESS 0x70002DE3 /end MEASUREMENT
/begin MEASUREMENT CanIf_Prv_TxBufferRam_ast[19].bufferstatus "Can Interface Buffer Status[19]/" UBYTE RB_RBA_Common_CentralElements_CompuMethods_Identical 1 100 0.0 255. FORMAT "%5.0" ECU_ADDRESS 0x70002DE5 /end MEASUREMENT
/begin MEASUREMENT CanIf_Prv_TxBufferRam_ast[20].bufferstatus "Can Interface Buffer Status[20]/" UBYTE RB_RBA_Common_CentralElements_CompuMethods_Identical 1 100 0.0 255. FORMAT "%5.0" ECU_ADDRESS 0x70002DE7 /end MEASUREMENT
/begin MEASUREMENT CanIf_Prv_TxBufferRam_ast[21].bufferstatus "Can Interface Buffer Status[21]/" UBYTE RB_RBA_Common_CentralElements_CompuMethods_Identical 1 100 0.0 255. FORMAT "%5.0" ECU_ADDRESS 0x70002DE9 /end MEASUREMENT
/begin MEASUREMENT CanIf_Prv_TxBufferRam_ast[22].bufferstatus "Can Interface Buffer Status[22]/" UBYTE RB_RBA_Common_CentralElements_CompuMethods_Identical 1 100 0.0 255. FORMAT "%5.0" ECU_ADDRESS 0x70002DEB /end MEASUREMENT
/begin MEASUREMENT CanIf_Prv_TxBufferRam_ast[23].bufferstatus "Can Interface Buffer Status[23]/" UBYTE RB_RBA_Common_CentralElements_CompuMethods_Identical 1 100 0.0 255. FORMAT "%5.0" ECU_ADDRESS 0x70002DED /end MEASUREMENT
/begin MEASUREMENT CanIf_Prv_TxBufferRam_ast[24].bufferstatus "Can Interface Buffer Status[24]/" UBYTE RB_RBA_Common_CentralElements_CompuMethods_Identical 1 100 0.0 255. FORMAT "%5.0" ECU_ADDRESS 0x70002DEF /end MEASUREMENT
/begin MEASUREMENT CanIf_Prv_TxBufferRam_ast[25].bufferstatus "Can Interface Buffer Status[25]/" UBYTE RB_RBA_Common_CentralElements_CompuMethods_Identical 1 100 0.0 255. FORMAT "%5.0" ECU_ADDRESS 0x70002DF1 /end MEASUREMENT
/begin MEASUREMENT CanIf_Prv_TxBufferRam_ast[26].bufferstatus "Can Interface Buffer Status[26]/" UBYTE RB_RBA_Common_CentralElements_CompuMethods_Identical 1 100 0.0 255. FORMAT "%5.0" ECU_ADDRESS 0x70002DF3 /end MEASUREMENT
/begin MEASUREMENT CanIf_Prv_TxBufferRam_ast[27].bufferstatus "Can Interface Buffer Status[27]/" UBYTE RB_RBA_Common_CentralElements_CompuMethods_Identical 1 100 0.0 255. FORMAT "%5.0" ECU_ADDRESS 0x70002DF5 /end MEASUREMENT
/begin MEASUREMENT CanIf_Prv_TxBufferRam_ast[28].bufferstatus "Can Interface Buffer Status[28]/" UBYTE RB_RBA_Common_CentralElements_CompuMethods_Identical 1 100 0.0 255. FORMAT "%5.0" ECU_ADDRESS 0x70002DF7 /end MEASUREMENT
/begin MEASUREMENT CanIf_Prv_TxBufferRam_ast[29].bufferstatus "Can Interface Buffer Status[29]/" UBYTE RB_RBA_Common_CentralElements_CompuMethods_Identical 1 100 0.0 255. FORMAT "%5.0" ECU_ADDRESS 0x70002DF9 /end MEASUREMENT
/begin MEASUREMENT CanIf_Prv_TxBufferRam_ast[30].bufferstatus "Can Interface Buffer Status[30]/" UBYTE RB_RBA_Common_CentralElements_CompuMethods_Identical 1 100 0.0 255. FORMAT "%5.0" ECU_ADDRESS 0x70002DFB /end MEASUREMENT
/begin MEASUREMENT CanIf_Prv_TxBufferRam_ast[31].bufferstatus "Can Interface Buffer Status[31]/" UBYTE RB_RBA_Common_CentralElements_CompuMethods_Identical 1 100 0.0 255. FORMAT "%5.0" ECU_ADDRESS 0x70002DFD /end MEASUREMENT
/begin MEASUREMENT CanIf_Prv_TxBufferRam_ast[32].bufferstatus "Can Interface Buffer Status[32]/" UBYTE RB_RBA_Common_CentralElements_CompuMethods_Identical 1 100 0.0 255. FORMAT "%5.0" ECU_ADDRESS 0x70002DFF /end MEASUREMENT
/begin MEASUREMENT CanIf_Prv_TxBufferRam_ast[33].bufferstatus "Can Interface Buffer Status[33]/" UBYTE RB_RBA_Common_CentralElements_CompuMethods_Identical 1 100 0.0 255. FORMAT "%5.0" ECU_ADDRESS 0x70002E01 /end MEASUREMENT
/begin MEASUREMENT CanIf_Prv_TxBufferRam_ast[34].bufferstatus "Can Interface Buffer Status[34]/" UBYTE RB_RBA_Common_CentralElements_CompuMethods_Identical 1 100 0.0 255. FORMAT "%5.0" ECU_ADDRESS 0x70002E03 /end MEASUREMENT
/begin MEASUREMENT CanIf_Prv_TxBufferRam_ast[35].bufferstatus "Can Interface Buffer Status[35]/" UBYTE RB_RBA_Common_CentralElements_CompuMethods_Identical 1 100 0.0 255. FORMAT "%5.0" ECU_ADDRESS 0x70002E05 /end MEASUREMENT
/begin MEASUREMENT CanIf_Prv_TxBufferRam_ast[36].bufferstatus "Can Interface Buffer Status[36]/" UBYTE RB_RBA_Common_CentralElements_CompuMethods_Identical 1 100 0.0 255. FORMAT "%5.0" ECU_ADDRESS 0x70002E07 /end MEASUREMENT
/begin MEASUREMENT CanIf_Prv_TxBufferRam_ast[37].bufferstatus "Can Interface Buffer Status[37]/" UBYTE RB_RBA_Common_CentralElements_CompuMethods_Identical 1 100 0.0 255. FORMAT "%5.0" ECU_ADDRESS 0x70002E09 /end MEASUREMENT
/begin MEASUREMENT CanIf_Prv_TxBufferRam_ast[38].bufferstatus "Can Interface Buffer Status[38]/" UBYTE RB_RBA_Common_CentralElements_CompuMethods_Identical 1 100 0.0 255. FORMAT "%5.0" ECU_ADDRESS 0x70002E0B /end MEASUREMENT
/begin MEASUREMENT CanIf_Prv_TxBufferRam_ast[39].bufferstatus "Can Interface Buffer Status[39]/" UBYTE RB_RBA_Common_CentralElements_CompuMethods_Identical 1 100 0.0 255. FORMAT "%5.0" ECU_ADDRESS 0x70002E0D /end MEASUREMENT
/begin MEASUREMENT CanIf_Prv_TxBufferRam_ast[40].bufferstatus "Can Interface Buffer Status[40]/" UBYTE RB_RBA_Common_CentralElements_CompuMethods_Identical 1 100 0.0 255. FORMAT "%5.0" ECU_ADDRESS 0x70002E0F /end MEASUREMENT
/begin MEASUREMENT CanIf_Prv_TxBufferRam_ast[41].bufferstatus "Can Interface Buffer Status[41]/" UBYTE RB_RBA_Common_CentralElements_CompuMethods_Identical 1 100 0.0 255. FORMAT "%5.0" ECU_ADDRESS 0x70002E11 /end MEASUREMENT
/begin MEASUREMENT CanIf_Prv_TxBufferRam_ast[42].bufferstatus "Can Interface Buffer Status[42]/" UBYTE RB_RBA_Common_CentralElements_CompuMethods_Identical 1 100 0.0 255. FORMAT "%5.0" ECU_ADDRESS 0x70002E13 /end MEASUREMENT
/begin MEASUREMENT CanIf_Prv_TxBufferRam_ast[43].bufferstatus "Can Interface Buffer Status[43]/" UBYTE RB_RBA_Common_CentralElements_CompuMethods_Identical 1 100 0.0 255. FORMAT "%5.0" ECU_ADDRESS 0x70002E15 /end MEASUREMENT
/begin MEASUREMENT CanIf_Prv_TxBufferRam_ast[44].bufferstatus "Can Interface Buffer Status[44]/" UBYTE RB_RBA_Common_CentralElements_CompuMethods_Identical 1 100 0.0 255. FORMAT "%5.0" ECU_ADDRESS 0x70002E17 /end MEASUREMENT
/begin MEASUREMENT CanIf_Prv_TxBufferRam_ast[45].bufferstatus "Can Interface Buffer Status[45]/" UBYTE RB_RBA_Common_CentralElements_CompuMethods_Identical 1 100 0.0 255. FORMAT "%5.0" ECU_ADDRESS 0x70002E19 /end MEASUREMENT
/begin MEASUREMENT CanIf_Prv_TxBufferRam_ast[46].bufferstatus "Can Interface Buffer Status[46]/" UBYTE RB_RBA_Common_CentralElements_CompuMethods_Identical 1 100 0.0 255. FORMAT "%5.0" ECU_ADDRESS 0x70002E1B /end MEASUREMENT
/begin MEASUREMENT CanIf_Prv_TxBufferRam_ast[47].bufferstatus "Can Interface Buffer Status[47]/" UBYTE RB_RBA_Common_CentralElements_CompuMethods_Identical 1 100 0.0 255. FORMAT "%5.0" ECU_ADDRESS 0x70002E1D /end MEASUREMENT
/begin MEASUREMENT CanIf_Prv_TxBufferRam_ast[48].bufferstatus "Can Interface Buffer Status[48]/" UBYTE RB_RBA_Common_CentralElements_CompuMethods_Identical 1 100 0.0 255. FORMAT "%5.0" ECU_ADDRESS 0x70002E1F /end MEASUREMENT
/begin MEASUREMENT CanIf_Prv_TxBufferRam_ast[49].bufferstatus "Can Interface Buffer Status[49]/" UBYTE RB_RBA_Common_CentralElements_CompuMethods_Identical 1 100 0.0 255. FORMAT "%5.0" ECU_ADDRESS 0x70002E21 /end MEASUREMENT
/begin MEASUREMENT CanIf_Prv_TxBufferRam_ast[50].bufferstatus "Can Interface Buffer Status[50]/" UBYTE RB_RBA_Common_CentralElements_CompuMethods_Identical 1 100 0.0 255. FORMAT "%5.0" ECU_ADDRESS 0x70002E23 /end MEASUREMENT
/begin MEASUREMENT CanIf_Prv_TxBufferRam_ast[51].bufferstatus "Can Interface Buffer Status[51]/" UBYTE RB_RBA_Common_CentralElements_CompuMethods_Identical 1 100 0.0 255. FORMAT "%5.0" ECU_ADDRESS 0x70002E25 /end MEASUREMENT
/begin MEASUREMENT Com_IpduBuf_ENG10_Tx "Tx Ipdu buffer of IPdu -ENG10_Tx- as a Measurement parameter" UBYTE RB_RBA_Common_CentralElements_CompuMethods_Identical 1 100 0.0 255. FORMAT "%5.0" ARRAY_SIZE 8 ECU_ADDRESS 0x6000B14B /end MEASUREMENT
/begin MEASUREMENT Com_IpduBuf_ENG11_Tx "Tx Ipdu buffer of IPdu -ENG11_Tx- as a Measurement parameter" UBYTE RB_RBA_Common_CentralElements_CompuMethods_Identical 1 100 0.0 255. FORMAT "%5.0" ARRAY_SIZE 8 ECU_ADDRESS 0x6000B143 /end MEASUREMENT
/begin MEASUREMENT Com_IpduBuf_ENG15_Tx "Tx Ipdu buffer of IPdu -ENG15_Tx- as a Measurement parameter" UBYTE RB_RBA_Common_CentralElements_CompuMethods_Identical 1 100 0.0 255. FORMAT "%5.0" ARRAY_SIZE 8 ECU_ADDRESS 0x6000B13B /end MEASUREMENT
/begin MEASUREMENT Com_IpduBuf_ENG16_Tx "Tx Ipdu buffer of IPdu -ENG16_Tx- as a Measurement parameter" UBYTE RB_RBA_Common_CentralElements_CompuMethods_Identical 1 100 0.0 255. FORMAT "%5.0" ARRAY_SIZE 8 ECU_ADDRESS 0x6000B133 /end MEASUREMENT
/begin MEASUREMENT Com_IpduBuf_ENG17_Tx "Tx Ipdu buffer of IPdu -ENG17_Tx- as a Measurement parameter" UBYTE RB_RBA_Common_CentralElements_CompuMethods_Identical 1 100 0.0 255. FORMAT "%5.0" ARRAY_SIZE 8 ECU_ADDRESS 0x6000B12B /end MEASUREMENT
/begin MEASUREMENT Com_IpduBuf_ENG18_Tx "Tx Ipdu buffer of IPdu -ENG18_Tx- as a Measurement parameter" UBYTE RB_RBA_Common_CentralElements_CompuMethods_Identical 1 100 0.0 255. FORMAT "%5.0" ARRAY_SIZE 8 ECU_ADDRESS 0x6000B123 /end MEASUREMENT
/begin MEASUREMENT Com_IpduBuf_ENG19_Tx "Tx Ipdu buffer of IPdu -ENG19_Tx- as a Measurement parameter" UBYTE RB_RBA_Common_CentralElements_CompuMethods_Identical 1 100 0.0 255. FORMAT "%5.0" ARRAY_SIZE 8 ECU_ADDRESS 0x6000B11B /end MEASUREMENT
/begin MEASUREMENT Com_IpduBuf_ENG20_Tx "Tx Ipdu buffer of IPdu -ENG20_Tx- as a Measurement parameter" UBYTE RB_RBA_Common_CentralElements_CompuMethods_Identical 1 100 0.0 255. FORMAT "%5.0" ARRAY_SIZE 8 ECU_ADDRESS 0x6000B113 /end MEASUREMENT
/begin MEASUREMENT Com_IpduBuf_ENG21_Tx "Tx Ipdu buffer of IPdu -ENG21_Tx- as a Measurement parameter" UBYTE RB_RBA_Common_CentralElements_CompuMethods_Identical 1 100 0.0 255. FORMAT "%5.0" ARRAY_SIZE 8 ECU_ADDRESS 0x6000B10B /end MEASUREMENT
/begin MEASUREMENT Com_IpduBuf_ENG22_Tx "Tx Ipdu buffer of IPdu -ENG22_Tx- as a Measurement parameter" UBYTE RB_RBA_Common_CentralElements_CompuMethods_Identical 1 100 0.0 255. FORMAT "%5.0" ARRAY_SIZE 8 ECU_ADDRESS 0x6000B103 /end MEASUREMENT
/begin MEASUREMENT Com_IpduBuf_ENG23_Tx "Tx Ipdu buffer of IPdu -ENG23_Tx- as a Measurement parameter" UBYTE RB_RBA_Common_CentralElements_CompuMethods_Identical 1 100 0.0 255. FORMAT "%5.0" ARRAY_SIZE 8 ECU_ADDRESS 0x6000B0FB /end MEASUREMENT
/begin MEASUREMENT Com_IpduBuf_ENG24_Tx "Tx Ipdu buffer of IPdu -ENG24_Tx- as a Measurement parameter" UBYTE RB_RBA_Common_CentralElements_CompuMethods_Identical 1 100 0.0 255. FORMAT "%5.0" ARRAY_SIZE 8 ECU_ADDRESS 0x6000B0F3 /end MEASUREMENT
/begin MEASUREMENT Com_IpduBuf_ENG25_Tx "Tx Ipdu buffer of IPdu -ENG25_Tx- as a Measurement parameter" UBYTE RB_RBA_Common_CentralElements_CompuMethods_Identical 1 100 0.0 255. FORMAT "%5.0" ARRAY_SIZE 8 ECU_ADDRESS 0x6000B0EB /end MEASUREMENT
/begin MEASUREMENT Com_IpduBuf_ENG2_Tx "Tx Ipdu buffer of IPdu -ENG2_Tx- as a Measurement parameter" UBYTE RB_RBA_Common_CentralElements_CompuMethods_Identical 1 100 0.0 255. FORMAT "%5.0" ARRAY_SIZE 5 ECU_ADDRESS 0x6000B0E6 /end MEASUREMENT
/begin MEASUREMENT Com_IpduBuf_ENG3_Tx "Tx Ipdu buffer of IPdu -ENG3_Tx- as a Measurement parameter" UBYTE RB_RBA_Common_CentralElements_CompuMethods_Identical 1 100 0.0 255. FORMAT "%5.0" ARRAY_SIZE 8 ECU_ADDRESS 0x6000B0DE /end MEASUREMENT
/begin MEASUREMENT Com_IpduBuf_ENG4_Tx "Tx Ipdu buffer of IPdu -ENG4_Tx- as a Measurement parameter" UBYTE RB_RBA_Common_CentralElements_CompuMethods_Identical 1 100 0.0 255. FORMAT "%5.0" ARRAY_SIZE 8 ECU_ADDRESS 0x6000B0D6 /end MEASUREMENT
/begin MEASUREMENT Com_IpduBuf_ENG5_Tx "Tx Ipdu buffer of IPdu -ENG5_Tx- as a Measurement parameter" UBYTE RB_RBA_Common_CentralElements_CompuMethods_Identical 1 100 0.0 255. FORMAT "%5.0" ARRAY_SIZE 8 ECU_ADDRESS 0x6000B0CE /end MEASUREMENT
/begin MEASUREMENT Com_IpduBuf_ENG6_Tx "Tx Ipdu buffer of IPdu -ENG6_Tx- as a Measurement parameter" UBYTE RB_RBA_Common_CentralElements_CompuMethods_Identical 1 100 0.0 255. FORMAT "%5.0" ARRAY_SIZE 8 ECU_ADDRESS 0x6000B0C6 /end MEASUREMENT
/begin MEASUREMENT Com_IpduBuf_ENGAE_Tx "Tx Ipdu buffer of IPdu -ENGAE_Tx- as a Measurement parameter" UBYTE RB_RBA_Common_CentralElements_CompuMethods_Identical 1 100 0.0 255. FORMAT "%5.0" ARRAY_SIZE 8 ECU_ADDRESS 0x6000B0BE /end MEASUREMENT
/begin MEASUREMENT Com_IpduBuf_ENGA_Tx "Tx Ipdu buffer of IPdu -ENGA_Tx- as a Measurement parameter" UBYTE RB_RBA_Common_CentralElements_CompuMethods_Identical 1 100 0.0 255. FORMAT "%5.0" ARRAY_SIZE 8 ECU_ADDRESS 0x6000B0B6 /end MEASUREMENT
/begin MEASUREMENT Com_IpduBuf_ENGB_Tx "Tx Ipdu buffer of IPdu -ENGB_Tx- as a Measurement parameter" UBYTE RB_RBA_Common_CentralElements_CompuMethods_Identical 1 100 0.0 255. FORMAT "%5.0" ARRAY_SIZE 8 ECU_ADDRESS 0x6000B0AE /end MEASUREMENT
/begin MEASUREMENT Com_IpduBuf_ENGC_Tx "Tx Ipdu buffer of IPdu -ENGC_Tx- as a Measurement parameter" UBYTE RB_RBA_Common_CentralElements_CompuMethods_Identical 1 100 0.0 255. FORMAT "%5.0" ARRAY_SIZE 8 ECU_ADDRESS 0x6000B0A6 /end MEASUREMENT
/begin MEASUREMENT Com_IpduBuf_ENGD_Tx "Tx Ipdu buffer of IPdu -ENGD_Tx- as a Measurement parameter" UBYTE RB_RBA_Common_CentralElements_CompuMethods_Identical 1 100 0.0 255. FORMAT "%5.0" ARRAY_SIZE 6 ECU_ADDRESS 0x6000B0A0 /end MEASUREMENT
/begin MEASUREMENT Com_IpduBuf_ENGE_Tx "Tx Ipdu buffer of IPdu -ENGE_Tx- as a Measurement parameter" UBYTE RB_RBA_Common_CentralElements_CompuMethods_Identical 1 100 0.0 255. FORMAT "%5.0" ARRAY_SIZE 8 ECU_ADDRESS 0x6000B098 /end MEASUREMENT
/begin MEASUREMENT Com_IpduBuf_ENGF_Tx "Tx Ipdu buffer of IPdu -ENGF_Tx- as a Measurement parameter" UBYTE RB_RBA_Common_CentralElements_CompuMethods_Identical 1 100 0.0 255. FORMAT "%5.0" ARRAY_SIZE 2 ECU_ADDRESS 0x6000B096 /end MEASUREMENT
/begin MEASUREMENT Com_IpduBuf_ENGHIP1_Tx "Tx Ipdu buffer of IPdu -ENGHIP1_Tx- as a Measurement parameter" UBYTE RB_RBA_Common_CentralElements_CompuMethods_Identical 1 100 0.0 255. FORMAT "%5.0" ARRAY_SIZE 5 ECU_ADDRESS 0x6000B091 /end MEASUREMENT
/begin MEASUREMENT Com_IpduBuf_ENGIMG1_Tx "Tx Ipdu buffer of IPdu -ENGIMG1_Tx- as a Measurement parameter" UBYTE RB_RBA_Common_CentralElements_CompuMethods_Identical 1 100 0.0 255. FORMAT "%5.0" ARRAY_SIZE 8 ECU_ADDRESS 0x6000B089 /end MEASUREMENT
/begin MEASUREMENT Com_IpduBuf_ENGJ3_Tx "Tx Ipdu buffer of IPdu -ENGJ3_Tx- as a Measurement parameter" UBYTE RB_RBA_Common_CentralElements_CompuMethods_Identical 1 100 0.0 255. FORMAT "%5.0" ARRAY_SIZE 8 ECU_ADDRESS 0x6000B081 /end MEASUREMENT
/begin MEASUREMENT Com_IpduBuf_ENGK3_Tx "Tx Ipdu buffer of IPdu -ENGK3_Tx- as a Measurement parameter" UBYTE RB_RBA_Common_CentralElements_CompuMethods_Identical 1 100 0.0 255. FORMAT "%5.0" ARRAY_SIZE 8 ECU_ADDRESS 0x6000B079 /end MEASUREMENT
/begin MEASUREMENT Com_IpduBuf_ENGL_Tx "Tx Ipdu buffer of IPdu -ENGL_Tx- as a Measurement parameter" UBYTE RB_RBA_Common_CentralElements_CompuMethods_Identical 1 100 0.0 255. FORMAT "%5.0" ARRAY_SIZE 8 ECU_ADDRESS 0x6000B071 /end MEASUREMENT
/begin MEASUREMENT Com_IpduBuf_ENGN_Tx "Tx Ipdu buffer of IPdu -ENGN_Tx- as a Measurement parameter" UBYTE RB_RBA_Common_CentralElements_CompuMethods_Identical 1 100 0.0 255. FORMAT "%5.0" ARRAY_SIZE 8 ECU_ADDRESS 0x6000B069 /end MEASUREMENT
/begin MEASUREMENT Com_IpduBuf_ENGQ_Tx "Tx Ipdu buffer of IPdu -ENGQ_Tx- as a Measurement parameter" UBYTE RB_RBA_Common_CentralElements_CompuMethods_Identical 1 100 0.0 255. FORMAT "%5.0" ARRAY_SIZE 2 ECU_ADDRESS 0x6000B067 /end MEASUREMENT
/begin MEASUREMENT Com_IpduBuf_ENGR_Tx "Tx Ipdu buffer of IPdu -ENGR_Tx- as a Measurement parameter" UBYTE RB_RBA_Common_CentralElements_CompuMethods_Identical 1 100 0.0 255. FORMAT "%5.0" ARRAY_SIZE 5 ECU_ADDRESS 0x6000B062 /end MEASUREMENT
/begin MEASUREMENT Com_IpduBuf_ENGT1_Tx "Tx Ipdu buffer of IPdu -ENGT1_Tx- as a Measurement parameter" UBYTE RB_RBA_Common_CentralElements_CompuMethods_Identical 1 100 0.0 255. FORMAT "%5.0" ARRAY_SIZE 8 ECU_ADDRESS 0x6000B05A /end MEASUREMENT
/begin MEASUREMENT Com_IpduBuf_ENGT2_Tx "Tx Ipdu buffer of IPdu -ENGT2_Tx- as a Measurement parameter" UBYTE RB_RBA_Common_CentralElements_CompuMethods_Identical 1 100 0.0 255. FORMAT "%5.0" ARRAY_SIZE 8 ECU_ADDRESS 0x6000B052 /end MEASUREMENT
/begin MEASUREMENT Com_IpduBuf_ENGT_Tx "Tx Ipdu buffer of IPdu -ENGT_Tx- as a Measurement parameter" UBYTE RB_RBA_Common_CentralElements_CompuMethods_Identical 1 100 0.0 255. FORMAT "%5.0" ARRAY_SIZE 8 ECU_ADDRESS 0x6000B04A /end MEASUREMENT
/begin MEASUREMENT Com_IpduBuf_ENGU_Tx "Tx Ipdu buffer of IPdu -ENGU_Tx- as a Measurement parameter" UBYTE RB_RBA_Common_CentralElements_CompuMethods_Identical 1 100 0.0 255. FORMAT "%5.0" ARRAY_SIZE 8 ECU_ADDRESS 0x6000B042 /end MEASUREMENT
/begin MEASUREMENT Com_IpduBuf_ENGV_Tx "Tx Ipdu buffer of IPdu -ENGV_Tx- as a Measurement parameter" UBYTE RB_RBA_Common_CentralElements_CompuMethods_Identical 1 100 0.0 255. FORMAT "%5.0" ARRAY_SIZE 8 ECU_ADDRESS 0x6000B03A /end MEASUREMENT
/begin MEASUREMENT Com_IpduBuf_ENGW_Tx "Tx Ipdu buffer of IPdu -ENGW_Tx- as a Measurement parameter" UBYTE RB_RBA_Common_CentralElements_CompuMethods_Identical 1 100 0.0 255. FORMAT "%5.0" ARRAY_SIZE 8 ECU_ADDRESS 0x6000B032 /end MEASUREMENT
/begin MEASUREMENT Com_IpduBuf_ENGX2_Tx "Tx Ipdu buffer of IPdu -ENGX2_Tx- as a Measurement parameter" UBYTE RB_RBA_Common_CentralElements_CompuMethods_Identical 1 100 0.0 255. FORMAT "%5.0" ARRAY_SIZE 8 ECU_ADDRESS 0x6000B02A /end MEASUREMENT
/begin MEASUREMENT Com_IpduBuf_ENGY2_Tx "Tx Ipdu buffer of IPdu -ENGY2_Tx- as a Measurement parameter" UBYTE RB_RBA_Common_CentralElements_CompuMethods_Identical 1 100 0.0 255. FORMAT "%5.0" ARRAY_SIZE 4 ECU_ADDRESS 0x6000B026 /end MEASUREMENT
/begin MEASUREMENT Com_IpduBuf_ENGY_Tx "Tx Ipdu buffer of IPdu -ENGY_Tx- as a Measurement parameter" UBYTE RB_RBA_Common_CentralElements_CompuMethods_Identical 1 100 0.0 255. FORMAT "%5.0" ARRAY_SIZE 5 ECU_ADDRESS 0x6000B021 /end MEASUREMENT
/begin MEASUREMENT Com_IpduBuf_ENGZ_Tx "Tx Ipdu buffer of IPdu -ENGZ_Tx- as a Measurement parameter" UBYTE RB_RBA_Common_CentralElements_CompuMethods_Identical 1 100 0.0 255. FORMAT "%5.0" ARRAY_SIZE 8 ECU_ADDRESS 0x6000B019 /end MEASUREMENT
/begin MEASUREMENT Com_IpduBuf_Lin_Alt_Tx_ACG_CTL_Tx "Tx Ipdu buffer of IPdu -Lin_Alt_Tx_ACG_CTL_Tx- as a Measurement parameter" UBYTE RB_RBA_Common_CentralElements_CompuMethods_Identical 1 100 0.0 255. FORMAT "%5.0" ARRAY_SIZE 4 ECU_ADDRESS 0x6000B015 /end MEASUREMENT
/begin MEASUREMENT Com_IpduBuf_Lin_BS_Tx_EBSA_Tx "Tx Ipdu buffer of IPdu -Lin_BS_Tx_EBSA_Tx- as a Measurement parameter" UBYTE RB_RBA_Common_CentralElements_CompuMethods_Identical 1 100 0.0 255. FORMAT "%5.0" ARRAY_SIZE 8 ECU_ADDRESS 0x6000B00D /end MEASUREMENT
/begin MEASUREMENT Com_IpduBuf_eng1_Tx "Tx Ipdu buffer of IPdu -eng1_Tx- as a Measurement parameter" UBYTE RB_RBA_Common_CentralElements_CompuMethods_Identical 1 100 0.0 255. FORMAT "%5.0" ARRAY_SIZE 8 ECU_ADDRESS 0x6000B005 /end MEASUREMENT
/begin MEASUREMENT Com_IpduBuf_engo_Tx "Tx Ipdu buffer of IPdu -engo_Tx- as a Measurement parameter" UBYTE RB_RBA_Common_CentralElements_CompuMethods_Identical 1 100 0.0 255. FORMAT "%5.0" ARRAY_SIZE 8 ECU_ADDRESS 0x6000AFFD /end MEASUREMENT
/begin MEASUREMENT Com_LocalBuf_AYCA_Rx "Rx Local Ipdu buffer of IPdu -AYCA_Rx- as a Measurement parameter" UBYTE RB_RBA_Common_CentralElements_CompuMethods_Identical 1 100 0.0 255. FORMAT "%5.0" ARRAY_SIZE 8 ECU_ADDRESS 0x6000AFF5 /end MEASUREMENT
/begin MEASUREMENT Com_LocalBuf_AYCD_Rx "Rx Local Ipdu buffer of IPdu -AYCD_Rx- as a Measurement parameter" UBYTE RB_RBA_Common_CentralElements_CompuMethods_Identical 1 100 0.0 255. FORMAT "%5.0" ARRAY_SIZE 8 ECU_ADDRESS 0x6000AFED /end MEASUREMENT
/begin MEASUREMENT Com_LocalBuf_AYCF_Rx "Rx Local Ipdu buffer of IPdu -AYCF_Rx- as a Measurement parameter" UBYTE RB_RBA_Common_CentralElements_CompuMethods_Identical 1 100 0.0 255. FORMAT "%5.0" ARRAY_SIZE 8 ECU_ADDRESS 0x6000AFE5 /end MEASUREMENT
/begin MEASUREMENT Com_LocalBuf_AYCG_Rx "Rx Local Ipdu buffer of IPdu -AYCG_Rx- as a Measurement parameter" UBYTE RB_RBA_Common_CentralElements_CompuMethods_Identical 1 100 0.0 255. FORMAT "%5.0" ARRAY_SIZE 7 ECU_ADDRESS 0x6000AFDE /end MEASUREMENT
/begin MEASUREMENT Com_LocalBuf_AYCI_Rx "Rx Local Ipdu buffer of IPdu -AYCI_Rx- as a Measurement parameter" UBYTE RB_RBA_Common_CentralElements_CompuMethods_Identical 1 100 0.0 255. FORMAT "%5.0" ARRAY_SIZE 8 ECU_ADDRESS 0x6000AFD6 /end MEASUREMENT
/begin MEASUREMENT Com_LocalBuf_BCM1_Rx "Rx Local Ipdu buffer of IPdu -BCM1_Rx- as a Measurement parameter" UBYTE RB_RBA_Common_CentralElements_CompuMethods_Identical 1 100 0.0 255. FORMAT "%5.0" ARRAY_SIZE 2 ECU_ADDRESS 0x6000AFD4 /end MEASUREMENT
/begin MEASUREMENT Com_LocalBuf_CGW1_Rx "Rx Local Ipdu buffer of IPdu -CGW1_Rx- as a Measurement parameter" UBYTE RB_RBA_Common_CentralElements_CompuMethods_Identical 1 100 0.0 255. FORMAT "%5.0" ARRAY_SIZE 1 ECU_ADDRESS 0x6000AFD3 /end MEASUREMENT
/begin MEASUREMENT Com_LocalBuf_EAT10_Rx "Rx Local Ipdu buffer of IPdu -EAT10_Rx- as a Measurement parameter" UBYTE RB_RBA_Common_CentralElements_CompuMethods_Identical 1 100 0.0 255. FORMAT "%5.0" ARRAY_SIZE 8 ECU_ADDRESS 0x6000AFCB /end MEASUREMENT
/begin MEASUREMENT Com_LocalBuf_EAT11_Rx "Rx Local Ipdu buffer of IPdu -EAT11_Rx- as a Measurement parameter" UBYTE RB_RBA_Common_CentralElements_CompuMethods_Identical 1 100 0.0 255. FORMAT "%5.0" ARRAY_SIZE 8 ECU_ADDRESS 0x6000AFC3 /end MEASUREMENT
/begin MEASUREMENT Com_LocalBuf_EAT12_Rx "Rx Local Ipdu buffer of IPdu -EAT12_Rx- as a Measurement parameter" UBYTE RB_RBA_Common_CentralElements_CompuMethods_Identical 1 100 0.0 255. FORMAT "%5.0" ARRAY_SIZE 2 ECU_ADDRESS 0x6000AFC1 /end MEASUREMENT
/begin MEASUREMENT Com_LocalBuf_EAT13_Rx "Rx Local Ipdu buffer of IPdu -EAT13_Rx- as a Measurement parameter" UBYTE RB_RBA_Common_CentralElements_CompuMethods_Identical 1 100 0.0 255. FORMAT "%5.0" ARRAY_SIZE 3 ECU_ADDRESS 0x6000AFBE /end MEASUREMENT
/begin MEASUREMENT Com_LocalBuf_EAT1_Rx "Rx Local Ipdu buffer of IPdu -EAT1_Rx- as a Measurement parameter" UBYTE RB_RBA_Common_CentralElements_CompuMethods_Identical 1 100 0.0 255. FORMAT "%5.0" ARRAY_SIZE 8 ECU_ADDRESS 0x6000AFB6 /end MEASUREMENT
/begin MEASUREMENT Com_LocalBuf_EAT2_Rx "Rx Local Ipdu buffer of IPdu -EAT2_Rx- as a Measurement parameter" UBYTE RB_RBA_Common_CentralElements_CompuMethods_Identical 1 100 0.0 255. FORMAT "%5.0" ARRAY_SIZE 8 ECU_ADDRESS 0x6000AFAE /end MEASUREMENT
/begin MEASUREMENT Com_LocalBuf_EAT4_Rx "Rx Local Ipdu buffer of IPdu -EAT4_Rx- as a Measurement parameter" UBYTE RB_RBA_Common_CentralElements_CompuMethods_Identical 1 100 0.0 255. FORMAT "%5.0" ARRAY_SIZE 8 ECU_ADDRESS 0x6000AFA6 /end MEASUREMENT
/begin MEASUREMENT Com_LocalBuf_EAT6_Rx "Rx Local Ipdu buffer of IPdu -EAT6_Rx- as a Measurement parameter" UBYTE RB_RBA_Common_CentralElements_CompuMethods_Identical 1 100 0.0 255. FORMAT "%5.0" ARRAY_SIZE 3 ECU_ADDRESS 0x6000AFA3 /end MEASUREMENT
/begin MEASUREMENT Com_LocalBuf_EAT7_Rx "Rx Local Ipdu buffer of IPdu -EAT7_Rx- as a Measurement parameter" UBYTE RB_RBA_Common_CentralElements_CompuMethods_Identical 1 100 0.0 255. FORMAT "%5.0" ARRAY_SIZE 8 ECU_ADDRESS 0x6000AF9B /end MEASUREMENT
/begin MEASUREMENT Com_LocalBuf_EAT8_Rx "Rx Local Ipdu buffer of IPdu -EAT8_Rx- as a Measurement parameter" UBYTE RB_RBA_Common_CentralElements_CompuMethods_Identical 1 100 0.0 255. FORMAT "%5.0" ARRAY_SIZE 8 ECU_ADDRESS 0x6000AF93 /end MEASUREMENT
/begin MEASUREMENT Com_LocalBuf_EATA_Rx "Rx Local Ipdu buffer of IPdu -EATA_Rx- as a Measurement parameter" UBYTE RB_RBA_Common_CentralElements_CompuMethods_Identical 1 100 0.0 255. FORMAT "%5.0" ARRAY_SIZE 8 ECU_ADDRESS 0x6000AF8B /end MEASUREMENT
/begin MEASUREMENT Com_LocalBuf_EATB_Rx "Rx Local Ipdu buffer of IPdu -EATB_Rx- as a Measurement parameter" UBYTE RB_RBA_Common_CentralElements_CompuMethods_Identical 1 100 0.0 255. FORMAT "%5.0" ARRAY_SIZE 8 ECU_ADDRESS 0x6000AF83 /end MEASUREMENT
/begin MEASUREMENT Com_LocalBuf_EATC_Rx "Rx Local Ipdu buffer of IPdu -EATC_Rx- as a Measurement parameter" UBYTE RB_RBA_Common_CentralElements_CompuMethods_Identical 1 100 0.0 255. FORMAT "%5.0" ARRAY_SIZE 8 ECU_ADDRESS 0x6000AF7B /end MEASUREMENT
/begin MEASUREMENT Com_LocalBuf_EBBA_Rx "Rx Local Ipdu buffer of IPdu -EBBA_Rx- as a Measurement parameter" UBYTE RB_RBA_Common_CentralElements_CompuMethods_Identical 1 100 0.0 255. FORMAT "%5.0" ARRAY_SIZE 3 ECU_ADDRESS 0x6000AF78 /end MEASUREMENT
/begin MEASUREMENT Com_LocalBuf_EPS1_Rx "Rx Local Ipdu buffer of IPdu -EPS1_Rx- as a Measurement parameter" UBYTE RB_RBA_Common_CentralElements_CompuMethods_Identical 1 100 0.0 255. FORMAT "%5.0" ARRAY_SIZE 3 ECU_ADDRESS 0x6000AF75 /end MEASUREMENT
/begin MEASUREMENT Com_LocalBuf_GWIMG1_Rx "Rx Local Ipdu buffer of IPdu -GWIMG1_Rx- as a Measurement parameter" UBYTE RB_RBA_Common_CentralElements_CompuMethods_Identical 1 100 0.0 255. FORMAT "%5.0" ARRAY_SIZE 8 ECU_ADDRESS 0x6000AF6D /end MEASUREMENT
/begin MEASUREMENT Com_LocalBuf_GWIMG3_Rx "Rx Local Ipdu buffer of IPdu -GWIMG3_Rx- as a Measurement parameter" UBYTE RB_RBA_Common_CentralElements_CompuMethods_Identical 1 100 0.0 255. FORMAT "%5.0" ARRAY_SIZE 8 ECU_ADDRESS 0x6000AF65 /end MEASUREMENT
/begin MEASUREMENT Com_LocalBuf_GWIMG4_Rx "Rx Local Ipdu buffer of IPdu -GWIMG4_Rx- as a Measurement parameter" UBYTE RB_RBA_Common_CentralElements_CompuMethods_Identical 1 100 0.0 255. FORMAT "%5.0" ARRAY_SIZE 8 ECU_ADDRESS 0x6000AF5D /end MEASUREMENT
/begin MEASUREMENT Com_LocalBuf_GWIMG5_Rx "Rx Local Ipdu buffer of IPdu -GWIMG5_Rx- as a Measurement parameter" UBYTE RB_RBA_Common_CentralElements_CompuMethods_Identical 1 100 0.0 255. FORMAT "%5.0" ARRAY_SIZE 8 ECU_ADDRESS 0x6000AF55 /end MEASUREMENT
/begin MEASUREMENT Com_LocalBuf_GWIMG6_Rx "Rx Local Ipdu buffer of IPdu -GWIMG6_Rx- as a Measurement parameter" UBYTE RB_RBA_Common_CentralElements_CompuMethods_Identical 1 100 0.0 255. FORMAT "%5.0" ARRAY_SIZE 8 ECU_ADDRESS 0x6000AF4D /end MEASUREMENT
/begin MEASUREMENT Com_LocalBuf_IDASB_Rx "Rx Local Ipdu buffer of IPdu -IDASB_Rx- as a Measurement parameter" UBYTE RB_RBA_Common_CentralElements_CompuMethods_Identical 1 100 0.0 255. FORMAT "%5.0" ARRAY_SIZE 8 ECU_ADDRESS 0x6000AF45 /end MEASUREMENT
/begin MEASUREMENT Com_LocalBuf_Lin_Alt_Rx_ACG_INFO_B_Rx "Rx Local Ipdu buffer of IPdu -Lin_Alt_Rx_ACG_INFO_B_Rx- as a Measurement parameter" UBYTE RB_RBA_Common_CentralElements_CompuMethods_Identical 1 100 0.0 255. FORMAT "%5.0" ARRAY_SIZE 4 ECU_ADDRESS 0x6000AF41 /end MEASUREMENT
/begin MEASUREMENT Com_LocalBuf_Lin_BS_Rx_EBSA_Rx "Rx Local Ipdu buffer of IPdu -Lin_BS_Rx_EBSA_Rx- as a Measurement parameter" UBYTE RB_RBA_Common_CentralElements_CompuMethods_Identical 1 100 0.0 255. FORMAT "%5.0" ARRAY_SIZE 8 ECU_ADDRESS 0x6000AF39 /end MEASUREMENT
/begin MEASUREMENT Com_LocalBuf_Lin_BS_Rx_EBSB_Rx "Rx Local Ipdu buffer of IPdu -Lin_BS_Rx_EBSB_Rx- as a Measurement parameter" UBYTE RB_RBA_Common_CentralElements_CompuMethods_Identical 1 100 0.0 255. FORMAT "%5.0" ARRAY_SIZE 8 ECU_ADDRESS 0x6000AF31 /end MEASUREMENT
/begin MEASUREMENT Com_LocalBuf_Lin_BS_Rx_EBSC_Rx "Rx Local Ipdu buffer of IPdu -Lin_BS_Rx_EBSC_Rx- as a Measurement parameter" UBYTE RB_RBA_Common_CentralElements_CompuMethods_Identical 1 100 0.0 255. FORMAT "%5.0" ARRAY_SIZE 8 ECU_ADDRESS 0x6000AF29 /end MEASUREMENT
/begin MEASUREMENT Com_LocalBuf_Lin_BS_Rx_EBSD_Rx "Rx Local Ipdu buffer of IPdu -Lin_BS_Rx_EBSD_Rx- as a Measurement parameter" UBYTE RB_RBA_Common_CentralElements_CompuMethods_Identical 1 100 0.0 255. FORMAT "%5.0" ARRAY_SIZE 8 ECU_ADDRESS 0x6000AF21 /end MEASUREMENT
/begin MEASUREMENT Com_LocalBuf_Lin_BS_Rx_EBSE_Rx "Rx Local Ipdu buffer of IPdu -Lin_BS_Rx_EBSE_Rx- as a Measurement parameter" UBYTE RB_RBA_Common_CentralElements_CompuMethods_Identical 1 100 0.0 255. FORMAT "%5.0" ARRAY_SIZE 8 ECU_ADDRESS 0x6000AF19 /end MEASUREMENT
/begin MEASUREMENT Com_LocalBuf_Lin_BS_Rx_EBSF_Rx "Rx Local Ipdu buffer of IPdu -Lin_BS_Rx_EBSF_Rx- as a Measurement parameter" UBYTE RB_RBA_Common_CentralElements_CompuMethods_Identical 1 100 0.0 255. FORMAT "%5.0" ARRAY_SIZE 8 ECU_ADDRESS 0x6000AF11 /end MEASUREMENT
/begin MEASUREMENT Com_LocalBuf_Lin_BS_Rx_EBSG_Rx "Rx Local Ipdu buffer of IPdu -Lin_BS_Rx_EBSG_Rx- as a Measurement parameter" UBYTE RB_RBA_Common_CentralElements_CompuMethods_Identical 1 100 0.0 255. FORMAT "%5.0" ARRAY_SIZE 8 ECU_ADDRESS 0x6000AF09 /end MEASUREMENT
/begin MEASUREMENT Com_LocalBuf_Lin_BS_Rx_EBSH_Rx "Rx Local Ipdu buffer of IPdu -Lin_BS_Rx_EBSH_Rx- as a Measurement parameter" UBYTE RB_RBA_Common_CentralElements_CompuMethods_Identical 1 100 0.0 255. FORMAT "%5.0" ARRAY_SIZE 8 ECU_ADDRESS 0x6000AF01 /end MEASUREMENT
/begin MEASUREMENT Com_LocalBuf_Lin_BS_Rx_EBSI_Rx "Rx Local Ipdu buffer of IPdu -Lin_BS_Rx_EBSI_Rx- as a Measurement parameter" UBYTE RB_RBA_Common_CentralElements_CompuMethods_Identical 1 100 0.0 255. FORMAT "%5.0" ARRAY_SIZE 8 ECU_ADDRESS 0x6000AEF9 /end MEASUREMENT
/begin MEASUREMENT Com_LocalBuf_META_Rx "Rx Local Ipdu buffer of IPdu -META_Rx- as a Measurement parameter" UBYTE RB_RBA_Common_CentralElements_CompuMethods_Identical 1 100 0.0 255. FORMAT "%5.0" ARRAY_SIZE 8 ECU_ADDRESS 0x6000AEF1 /end MEASUREMENT
/begin MEASUREMENT Com_LocalBuf_METC_Rx "Rx Local Ipdu buffer of IPdu -METC_Rx- as a Measurement parameter" UBYTE RB_RBA_Common_CentralElements_CompuMethods_Identical 1 100 0.0 255. FORMAT "%5.0" ARRAY_SIZE 8 ECU_ADDRESS 0x6000AEE9 /end MEASUREMENT
/begin MEASUREMENT Com_LocalBuf_METD2_Rx "Rx Local Ipdu buffer of IPdu -METD2_Rx- as a Measurement parameter" UBYTE RB_RBA_Common_CentralElements_CompuMethods_Identical 1 100 0.0 255. FORMAT "%5.0" ARRAY_SIZE 6 ECU_ADDRESS 0x6000AEE3 /end MEASUREMENT
/begin MEASUREMENT Com_LocalBuf_METD_Rx "Rx Local Ipdu buffer of IPdu -METD_Rx- as a Measurement parameter" UBYTE RB_RBA_Common_CentralElements_CompuMethods_Identical 1 100 0.0 255. FORMAT "%5.0" ARRAY_SIZE 7 ECU_ADDRESS 0x6000AEDC /end MEASUREMENT
/begin MEASUREMENT Com_LocalBuf_METE2_Rx "Rx Local Ipdu buffer of IPdu -METE2_Rx- as a Measurement parameter" UBYTE RB_RBA_Common_CentralElements_CompuMethods_Identical 1 100 0.0 255. FORMAT "%5.0" ARRAY_SIZE 7 ECU_ADDRESS 0x6000AED5 /end MEASUREMENT
/begin MEASUREMENT Com_LocalBuf_METF_Rx "Rx Local Ipdu buffer of IPdu -METF_Rx- as a Measurement parameter" UBYTE RB_RBA_Common_CentralElements_CompuMethods_Identical 1 100 0.0 255. FORMAT "%5.0" ARRAY_SIZE 8 ECU_ADDRESS 0x6000AECD /end MEASUREMENT
/begin MEASUREMENT Com_LocalBuf_METG_Rx "Rx Local Ipdu buffer of IPdu -METG_Rx- as a Measurement parameter" UBYTE RB_RBA_Common_CentralElements_CompuMethods_Identical 1 100 0.0 255. FORMAT "%5.0" ARRAY_SIZE 4 ECU_ADDRESS 0x6000AEC9 /end MEASUREMENT
/begin MEASUREMENT Com_LocalBuf_METH2_Rx "Rx Local Ipdu buffer of IPdu -METH2_Rx- as a Measurement parameter" UBYTE RB_RBA_Common_CentralElements_CompuMethods_Identical 1 100 0.0 255. FORMAT "%5.0" ARRAY_SIZE 8 ECU_ADDRESS 0x6000AEC1 /end MEASUREMENT
/begin MEASUREMENT Com_LocalBuf_METH_Rx "Rx Local Ipdu buffer of IPdu -METH_Rx- as a Measurement parameter" UBYTE RB_RBA_Common_CentralElements_CompuMethods_Identical 1 100 0.0 255. FORMAT "%5.0" ARRAY_SIZE 8 ECU_ADDRESS 0x6000AEB9 /end MEASUREMENT
/begin MEASUREMENT Com_LocalBuf_METI_Rx "Rx Local Ipdu buffer of IPdu -METI_Rx- as a Measurement parameter" UBYTE RB_RBA_Common_CentralElements_CompuMethods_Identical 1 100 0.0 255. FORMAT "%5.0" ARRAY_SIZE 8 ECU_ADDRESS 0x6000AEB1 /end MEASUREMENT
/begin MEASUREMENT Com_LocalBuf_METK_Rx "Rx Local Ipdu buffer of IPdu -METK_Rx- as a Measurement parameter" UBYTE RB_RBA_Common_CentralElements_CompuMethods_Identical 1 100 0.0 255. FORMAT "%5.0" ARRAY_SIZE 8 ECU_ADDRESS 0x6000AEA9 /end MEASUREMENT
/begin MEASUREMENT Com_LocalBuf_METL_Rx "Rx Local Ipdu buffer of IPdu -METL_Rx- as a Measurement parameter" UBYTE RB_RBA_Common_CentralElements_CompuMethods_Identical 1 100 0.0 255. FORMAT "%5.0" ARRAY_SIZE 4 ECU_ADDRESS 0x6000AEA5 /end MEASUREMENT
/begin MEASUREMENT Com_LocalBuf_METM_Rx "Rx Local Ipdu buffer of IPdu -METM_Rx- as a Measurement parameter" UBYTE RB_RBA_Common_CentralElements_CompuMethods_Identical 1 100 0.0 255. FORMAT "%5.0" ARRAY_SIZE 8 ECU_ADDRESS 0x6000AE9D /end MEASUREMENT
/begin MEASUREMENT Com_LocalBuf_METN_Rx "Rx Local Ipdu buffer of IPdu -METN_Rx- as a Measurement parameter" UBYTE RB_RBA_Common_CentralElements_CompuMethods_Identical 1 100 0.0 255. FORMAT "%5.0" ARRAY_SIZE 4 ECU_ADDRESS 0x6000AE99 /end MEASUREMENT
/begin MEASUREMENT Com_LocalBuf_PCU_Rx "Rx Local Ipdu buffer of IPdu -PCU_Rx- as a Measurement parameter" UBYTE RB_RBA_Common_CentralElements_CompuMethods_Identical 1 100 0.0 255. FORMAT "%5.0" ARRAY_SIZE 1 ECU_ADDRESS 0x6000AE98 /end MEASUREMENT
/begin MEASUREMENT Com_LocalBuf_SRSA_Rx "Rx Local Ipdu buffer of IPdu -SRSA_Rx- as a Measurement parameter" UBYTE RB_RBA_Common_CentralElements_CompuMethods_Identical 1 100 0.0 255. FORMAT "%5.0" ARRAY_SIZE 8 ECU_ADDRESS 0x6000AE90 /end MEASUREMENT
/begin MEASUREMENT Com_LocalBuf_SRSB_Rx "Rx Local Ipdu buffer of IPdu -SRSB_Rx- as a Measurement parameter" UBYTE RB_RBA_Common_CentralElements_CompuMethods_Identical 1 100 0.0 255. FORMAT "%5.0" ARRAY_SIZE 3 ECU_ADDRESS 0x6000AE8D /end MEASUREMENT
/begin MEASUREMENT Com_LocalBuf_SRS_Rx "Rx Local Ipdu buffer of IPdu -SRS_Rx- as a Measurement parameter" UBYTE RB_RBA_Common_CentralElements_CompuMethods_Identical 1 100 0.0 255. FORMAT "%5.0" ARRAY_SIZE 7 ECU_ADDRESS 0x6000AE86 /end MEASUREMENT
/begin MEASUREMENT Com_SigType_au16 "Measurement variable for Signals of type - uint16,sint16. To refer Individual element in the Buffer array, Fetch Buffer Index from Com_PBcfg.c for each signal." UWORD RB_RBA_Common_CentralElements_CompuMethods_Identical 1 100 0.0 65535. FORMAT "%5.0" ARRAY_SIZE 53 ECU_ADDRESS 0x60005624 /end MEASUREMENT
/begin MEASUREMENT Com_SigType_au32 "Measurement variable for Signals of type - uint32,sint32. To refer Individual element in the Buffer array, Fetch Buffer Index from Com_PBcfg.c for each signal." ULONG RB_RBA_Common_CentralElements_CompuMethods_Identical 1 100 0.0 4.E9 FORMAT "%5.0" ARRAY_SIZE 1 ECU_ADDRESS 0x60002A10 /end MEASUREMENT
/begin MEASUREMENT Com_SigType_au8 "Measurement variable for Signals of type - uint8,sint8,boolean,uint8_n. To refer Individual element in the Buffer array, Fetch Buffer Index from Com_PBcfg.c for each signal." UBYTE RB_RBA_Common_CentralElements_CompuMethods_Identical 1 100 0.0 255. FORMAT "%5.0" ARRAY_SIZE 317 ECU_ADDRESS 0x6000ACAA /end MEASUREMENT
/*********** Start of merged FUNCTION blocks ***********/
/begin FUNCTION CanIf "15.16.4  McFunction CanIf Created by MCFunctionUpdater"
 /begin DEF_CHARACTERISTIC CanIf_CanIfRxPduCfg_EAT10_RXCanDlc_C CanIf_CanIfRxPduCfg_EAT11_RXCanDlc_C CanIf_CanIfRxPduCfg_EAT12_RXCanDlc_C CanIf_CanIfRxPduCfg_EAT13_RXCanDlc_C CanIf_CanIfRxPduCfg_EAT4_RXCanDlc_C CanIf_CanIfRxPduCfg_EAT6_RXCanDlc_C CanIf_CanIfRxPduCfg_EAT7_RXCanDlc_C CanIf_CanIfRxPduCfg_EAT8_RXCanDlc_C CanIf_CanIfRxPduCfg_EATA_RXCanDlc_C CanIf_CanIfRxPduCfg_EATB_RXCanDlc_C CanIf_CanIfRxPduCfg_EATC_RXCanDlc_C CanIf_CanIfRxPduCfg_EBBA_RXCanDlc_C CanIf_CanIfRxPduCfg_EPS1_RXCanDlc_C CanIf_CanIfRxPduCfg_META_RXCanDlc_C CanIf_CanIfRxPduCfg_METD2_RXCanDlc_C CanIf_CanIfRxPduCfg_METD_RXCanDlc_C CanIf_CanIfRxPduCfg_METF_RXCanDlc_C CanIf_CanIfRxPduCfg_METG_RXCanDlc_C CanIf_CanIfRxPduCfg_METH2_RXCanDlc_C CanIf_CanIfRxPduCfg_METH_RXCanDlc_C CanIf_CanIfRxPduCfg_METI_RXCanDlc_C CanIf_CanIfRxPduCfg_METK_RXCanDlc_C CanIf_CanIfRxPduCfg_METL_RXCanDlc_C CanIf_CanIfRxPduCfg_METM_RXCanDlc_C CanIf_CanIfRxPduCfg_METN_RXCanDlc_C CanIf_CanIfRxPduCfg_PCU_RXCanDlc_C CanIf_CanIfRxPduCfg_SRSB_RXCanDlc_C CanIf_CanIfTxPduCfg_ENG10_TXCanDlc_C CanIf_CanIfTxPduCfg_ENG10_TXCanId_C CanIf_CanIfTxPduCfg_ENG11_TXCanDlc_C CanIf_CanIfTxPduCfg_ENG11_TXCanId_C CanIf_CanIfTxPduCfg_ENG15_TXCanDlc_C CanIf_CanIfTxPduCfg_ENG15_TXCanId_C CanIf_CanIfTxPduCfg_ENG16_TXCanDlc_C CanIf_CanIfTxPduCfg_ENG16_TXCanId_C CanIf_CanIfTxPduCfg_ENG17_TXCanDlc_C CanIf_CanIfTxPduCfg_ENG17_TXCanId_C CanIf_CanIfTxPduCfg_ENG18_TXCanDlc_C CanIf_CanIfTxPduCfg_ENG18_TXCanId_C CanIf_CanIfTxPduCfg_ENG19_TXCanDlc_C CanIf_CanIfTxPduCfg_ENG19_TXCanId_C CanIf_CanIfTxPduCfg_ENG20_TXCanDlc_C CanIf_CanIfTxPduCfg_ENG20_TXCanId_C CanIf_CanIfTxPduCfg_ENG21_TXCanDlc_C CanIf_CanIfTxPduCfg_ENG21_TXCanId_C CanIf_CanIfTxPduCfg_ENG22_TXCanDlc_C CanIf_CanIfTxPduCfg_ENG22_TXCanId_C CanIf_CanIfTxPduCfg_ENG23_TXCanDlc_C CanIf_CanIfTxPduCfg_ENG23_TXCanId_C CanIf_CanIfTxPduCfg_ENG24_TXCanDlc_C CanIf_CanIfTxPduCfg_ENG24_TXCanId_C CanIf_CanIfTxPduCfg_ENG25_TXCanDlc_C CanIf_CanIfTxPduCfg_ENG25_TXCanId_C CanIf_CanIfTxPduCfg_ENG2_TXCanDlc_C CanIf_CanIfTxPduCfg_ENG2_TXCanId_C CanIf_CanIfTxPduCfg_ENG3_TXCanDlc_C CanIf_CanIfTxPduCfg_ENG3_TXCanId_C CanIf_CanIfTxPduCfg_ENG4_TXCanDlc_C CanIf_CanIfTxPduCfg_ENG4_TXCanId_C CanIf_CanIfTxPduCfg_ENG5_TXCanDlc_C CanIf_CanIfTxPduCfg_ENG5_TXCanId_C CanIf_CanIfTxPduCfg_ENG6_TXCanDlc_C CanIf_CanIfTxPduCfg_ENG6_TXCanId_C CanIf_CanIfTxPduCfg_ENGAE_TXCanDlc_C CanIf_CanIfTxPduCfg_ENGAE_TXCanId_C CanIf_CanIfTxPduCfg_ENGA_TXCanDlc_C CanIf_CanIfTxPduCfg_ENGA_TXCanId_C CanIf_CanIfTxPduCfg_ENGB_TXCanDlc_C CanIf_CanIfTxPduCfg_ENGB_TXCanId_C CanIf_CanIfTxPduCfg_ENGC_TXCanDlc_C CanIf_CanIfTxPduCfg_ENGC_TXCanId_C CanIf_CanIfTxPduCfg_ENGD_TXCanDlc_C CanIf_CanIfTxPduCfg_ENGD_TXCanId_C CanIf_CanIfTxPduCfg_ENGE_TXCanDlc_C CanIf_CanIfTxPduCfg_ENGE_TXCanId_C CanIf_CanIfTxPduCfg_ENGF_TXCanDlc_C CanIf_CanIfTxPduCfg_ENGF_TXCanId_C CanIf_CanIfTxPduCfg_ENGHIP1_TXCanDlc_C CanIf_CanIfTxPduCfg_ENGHIP1_TXCanId_C CanIf_CanIfTxPduCfg_ENGIMG1_TXCanDlc_C CanIf_CanIfTxPduCfg_ENGIMG1_TXCanId_C CanIf_CanIfTxPduCfg_ENGJ3_TXCanDlc_C CanIf_CanIfTxPduCfg_ENGJ3_TXCanId_C CanIf_CanIfTxPduCfg_ENGK3_TXCanDlc_C CanIf_CanIfTxPduCfg_ENGK3_TXCanId_C CanIf_CanIfTxPduCfg_ENGL_TXCanDlc_C CanIf_CanIfTxPduCfg_ENGL_TXCanId_C CanIf_CanIfTxPduCfg_ENGN_TXCanDlc_C CanIf_CanIfTxPduCfg_ENGN_TXCanId_C CanIf_CanIfTxPduCfg_ENGQ_TXCanDlc_C CanIf_CanIfTxPduCfg_ENGQ_TXCanId_C CanIf_CanIfTxPduCfg_ENGR_TXCanDlc_C CanIf_CanIfTxPduCfg_ENGR_TXCanId_C CanIf_CanIfTxPduCfg_ENGT1_TXCanDlc_C CanIf_CanIfTxPduCfg_ENGT1_TXCanId_C CanIf_CanIfTxPduCfg_ENGT2_TXCanDlc_C CanIf_CanIfTxPduCfg_ENGT2_TXCanId_C CanIf_CanIfTxPduCfg_ENGT_TXCanDlc_C CanIf_CanIfTxPduCfg_ENGT_TXCanId_C CanIf_CanIfTxPduCfg_ENGU_TXCanDlc_C CanIf_CanIfTxPduCfg_ENGU_TXCanId_C CanIf_CanIfTxPduCfg_ENGV_TXCanDlc_C CanIf_CanIfTxPduCfg_ENGV_TXCanId_C CanIf_CanIfTxPduCfg_ENGW_TXCanDlc_C CanIf_CanIfTxPduCfg_ENGW_TXCanId_C CanIf_CanIfTxPduCfg_ENGX2_TXCanDlc_C CanIf_CanIfTxPduCfg_ENGX2_TXCanId_C CanIf_CanIfTxPduCfg_ENGY2_TXCanDlc_C CanIf_CanIfTxPduCfg_ENGY2_TXCanId_C CanIf_CanIfTxPduCfg_ENGY_TXCanDlc_C CanIf_CanIfTxPduCfg_ENGY_TXCanId_C CanIf_CanIfTxPduCfg_ENGZ_TXCanDlc_C CanIf_CanIfTxPduCfg_ENGZ_TXCanId_C CanIf_CanIfTxPduCfg_eng1_TXCanDlc_C CanIf_CanIfTxPduCfg_eng1_TXCanId_C CanIf_CanIfTxPduCfg_engo_TXCanDlc_C CanIf_CanIfTxPduCfg_engo_TXCanId_C CanIf_OBD_ON_CAN_Rx_0x7DF_VEHICLECanDlc_C CanIf_OBD_ON_CAN_Rx_0x7E0_VEHICLECanDlc_C CanIf_T1_RXCanDlc_C CanIf_T1_TXCanId_C CanIf_UDS_ON_CAN_Rx_0x18da10f1_VEHICLECanDlc_C CanIf_UDS_ON_CAN_Rx_0x18da10f2_VEHICLECanDlc_C CanIf_UDS_ON_CAN_Rx_0x18db2ff1_VEHICLECanDlc_C CanIf_UDS_ON_CAN_Rx_0x18db33f1_VEHICLECanDlc_C CanIf_UDS_ON_CAN_Rx_0x18dbeff1_VEHICLECanDlc_C CanIf_UDS_ON_CAN_Tx_0x18daf110_VEHICLECanId_C CanIf_UDS_ON_CAN_Tx_0x18daf210_VEHICLECanId_C CanIf_UDS_ON_CAN_Tx_0x7E8_VEHICLECanId_C CanIf_XcpRx_Cmd_APPLCanDlc_C CanIf_XcpRx_Cmd_CAN_CCanDlc_C CanIf_XcpRx_Cmd_VEHICLECanDlc_C CanIf_XcpTx_Var_APPLCanId_C CanIf_XcpTx_Var_CAN_CCanId_C CanIf_XcpTx_Var_VEHICLECanId_C /end DEF_CHARACTERISTIC
 /begin LOC_MEASUREMENT CanIf_Prv_ControllerState_ast[0].Ctrl_Pdu_mode CanIf_Prv_ControllerState_ast[1].Ctrl_Pdu_mode CanIf_Prv_ControllerState_ast[2].Ctrl_Pdu_mode CanIf_Prv_InitStatus_b CanIf_Prv_TxBufferRam_ast[0].bufferstatus CanIf_Prv_TxBufferRam_ast[0].last_index CanIf_Prv_TxBufferRam_ast[10].bufferstatus CanIf_Prv_TxBufferRam_ast[10].last_index CanIf_Prv_TxBufferRam_ast[11].bufferstatus CanIf_Prv_TxBufferRam_ast[11].last_index CanIf_Prv_TxBufferRam_ast[12].bufferstatus CanIf_Prv_TxBufferRam_ast[12].last_index CanIf_Prv_TxBufferRam_ast[13].bufferstatus CanIf_Prv_TxBufferRam_ast[13].last_index CanIf_Prv_TxBufferRam_ast[14].bufferstatus CanIf_Prv_TxBufferRam_ast[14].last_index CanIf_Prv_TxBufferRam_ast[15].bufferstatus CanIf_Prv_TxBufferRam_ast[15].last_index CanIf_Prv_TxBufferRam_ast[16].bufferstatus CanIf_Prv_TxBufferRam_ast[16].last_index CanIf_Prv_TxBufferRam_ast[17].bufferstatus CanIf_Prv_TxBufferRam_ast[17].last_index CanIf_Prv_TxBufferRam_ast[18].bufferstatus CanIf_Prv_TxBufferRam_ast[18].last_index CanIf_Prv_TxBufferRam_ast[19].bufferstatus CanIf_Prv_TxBufferRam_ast[19].last_index CanIf_Prv_TxBufferRam_ast[1].bufferstatus CanIf_Prv_TxBufferRam_ast[1].last_index CanIf_Prv_TxBufferRam_ast[20].bufferstatus CanIf_Prv_TxBufferRam_ast[20].last_index CanIf_Prv_TxBufferRam_ast[21].bufferstatus CanIf_Prv_TxBufferRam_ast[21].last_index CanIf_Prv_TxBufferRam_ast[22].bufferstatus CanIf_Prv_TxBufferRam_ast[22].last_index CanIf_Prv_TxBufferRam_ast[23].bufferstatus CanIf_Prv_TxBufferRam_ast[23].last_index CanIf_Prv_TxBufferRam_ast[24].bufferstatus CanIf_Prv_TxBufferRam_ast[24].last_index CanIf_Prv_TxBufferRam_ast[25].bufferstatus CanIf_Prv_TxBufferRam_ast[25].last_index CanIf_Prv_TxBufferRam_ast[26].bufferstatus CanIf_Prv_TxBufferRam_ast[26].last_index CanIf_Prv_TxBufferRam_ast[27].bufferstatus CanIf_Prv_TxBufferRam_ast[27].last_index CanIf_Prv_TxBufferRam_ast[28].bufferstatus CanIf_Prv_TxBufferRam_ast[28].last_index CanIf_Prv_TxBufferRam_ast[29].bufferstatus CanIf_Prv_TxBufferRam_ast[29].last_index CanIf_Prv_TxBufferRam_ast[2].bufferstatus CanIf_Prv_TxBufferRam_ast[2].last_index CanIf_Prv_TxBufferRam_ast[30].bufferstatus CanIf_Prv_TxBufferRam_ast[30].last_index CanIf_Prv_TxBufferRam_ast[31].bufferstatus CanIf_Prv_TxBufferRam_ast[31].last_index CanIf_Prv_TxBufferRam_ast[32].bufferstatus CanIf_Prv_TxBufferRam_ast[32].last_index CanIf_Prv_TxBufferRam_ast[33].bufferstatus CanIf_Prv_TxBufferRam_ast[33].last_index CanIf_Prv_TxBufferRam_ast[34].bufferstatus CanIf_Prv_TxBufferRam_ast[34].last_index CanIf_Prv_TxBufferRam_ast[35].bufferstatus CanIf_Prv_TxBufferRam_ast[35].last_index CanIf_Prv_TxBufferRam_ast[36].bufferstatus CanIf_Prv_TxBufferRam_ast[36].last_index CanIf_Prv_TxBufferRam_ast[37].bufferstatus CanIf_Prv_TxBufferRam_ast[37].last_index CanIf_Prv_TxBufferRam_ast[38].bufferstatus CanIf_Prv_TxBufferRam_ast[38].last_index CanIf_Prv_TxBufferRam_ast[39].bufferstatus CanIf_Prv_TxBufferRam_ast[39].last_index CanIf_Prv_TxBufferRam_ast[3].bufferstatus CanIf_Prv_TxBufferRam_ast[3].last_index CanIf_Prv_TxBufferRam_ast[40].bufferstatus CanIf_Prv_TxBufferRam_ast[40].last_index CanIf_Prv_TxBufferRam_ast[41].bufferstatus CanIf_Prv_TxBufferRam_ast[41].last_index CanIf_Prv_TxBufferRam_ast[42].bufferstatus CanIf_Prv_TxBufferRam_ast[42].last_index CanIf_Prv_TxBufferRam_ast[43].bufferstatus CanIf_Prv_TxBufferRam_ast[43].last_index CanIf_Prv_TxBufferRam_ast[44].bufferstatus CanIf_Prv_TxBufferRam_ast[44].last_index CanIf_Prv_TxBufferRam_ast[45].bufferstatus CanIf_Prv_TxBufferRam_ast[45].last_index CanIf_Prv_TxBufferRam_ast[46].bufferstatus CanIf_Prv_TxBufferRam_ast[46].last_index CanIf_Prv_TxBufferRam_ast[47].bufferstatus CanIf_Prv_TxBufferRam_ast[47].last_index CanIf_Prv_TxBufferRam_ast[48].bufferstatus CanIf_Prv_TxBufferRam_ast[48].last_index CanIf_Prv_TxBufferRam_ast[49].bufferstatus CanIf_Prv_TxBufferRam_ast[49].last_index CanIf_Prv_TxBufferRam_ast[4].bufferstatus CanIf_Prv_TxBufferRam_ast[4].last_index CanIf_Prv_TxBufferRam_ast[50].bufferstatus CanIf_Prv_TxBufferRam_ast[50].last_index CanIf_Prv_TxBufferRam_ast[51].bufferstatus CanIf_Prv_TxBufferRam_ast[51].last_index CanIf_Prv_TxBufferRam_ast[5].bufferstatus CanIf_Prv_TxBufferRam_ast[5].last_index CanIf_Prv_TxBufferRam_ast[6].bufferstatus CanIf_Prv_TxBufferRam_ast[6].last_index CanIf_Prv_TxBufferRam_ast[7].bufferstatus CanIf_Prv_TxBufferRam_ast[7].last_index CanIf_Prv_TxBufferRam_ast[8].bufferstatus CanIf_Prv_TxBufferRam_ast[8].last_index CanIf_Prv_TxBufferRam_ast[9].bufferstatus CanIf_Prv_TxBufferRam_ast[9].last_index /end LOC_MEASUREMENT
 FUNCTION_VERSION "15.16.4" /end FUNCTION
/begin FUNCTION Com "13.16.4_6.0.0  McFunction Com Created by MCFunctionUpdater"
 /begin DEF_CHARACTERISTIC Com_tiAYCA_RxRxTout_C Com_tiAYCD_RxRxTout_C Com_tiAYCF_RxRxTout_C Com_tiAYCG_RxRxTout_C Com_tiAYCI_RxRxTout_C Com_tiBCM1_RxRxTout_C Com_tiCGW1_RxRxTout_C Com_tiEAT10_RxRxTout_C Com_tiEAT11_RxRxTout_C Com_tiEAT12_RxRxTout_C Com_tiEAT13_RxRxTout_C Com_tiEAT1_RxRxTout_C Com_tiEAT2_RxRxTout_C Com_tiEAT4_RxRxTout_C Com_tiEAT6_RxRxTout_C Com_tiEAT7_RxRxTout_C Com_tiEAT8_RxRxTout_C Com_tiEATA_RxRxTout_C Com_tiEATB_RxRxTout_C Com_tiEATC_RxRxTout_C Com_tiEBBA_RxRxTout_C Com_tiENG10_TxTxPerd_C Com_tiENG11_TxTxPerd_C Com_tiENG15_TxTxPerd_C Com_tiENG16_TxTxPerd_C Com_tiENG17_TxTxPerd_C Com_tiENG18_TxTxPerd_C Com_tiENG19_TxTxPerd_C Com_tiENG20_TxTxPerd_C Com_tiENG21_TxTxPerd_C Com_tiENG22_TxTxPerd_C Com_tiENG23_TxTxPerd_C Com_tiENG24_TxTxPerd_C Com_tiENG25_TxTxPerd_C Com_tiENG2_TxTxPerd_C Com_tiENG3_TxTxPerd_C Com_tiENG4_TxTxPerd_C Com_tiENG5_TxTxPerd_C Com_tiENG6_TxTxPerd_C Com_tiENGAE_TxTxPerd_C Com_tiENGA_TxTxPerd_C Com_tiENGB_TxTxPerd_C Com_tiENGC_TxTxPerd_C Com_tiENGD_TxTxPerd_C Com_tiENGE_TxTxPerd_C Com_tiENGF_TxTxPerd_C Com_tiENGHIP1_TxTxPerd_C Com_tiENGIMG1_TxTxPerd_C Com_tiENGJ3_TxTxPerd_C Com_tiENGK3_TxTxPerd_C Com_tiENGL_TxTxPerd_C Com_tiENGN_TxTxPerd_C Com_tiENGQ_TxTxPerd_C Com_tiENGR_TxTxPerd_C Com_tiENGT1_TxTxPerd_C Com_tiENGT2_TxTxPerd_C Com_tiENGT_TxTxPerd_C Com_tiENGU_TxTxPerd_C Com_tiENGV_TxTxPerd_C Com_tiENGW_TxTxPerd_C Com_tiENGX2_TxTxPerd_C Com_tiENGY2_TxTxPerd_C Com_tiENGY_TxTxPerd_C Com_tiENGZ_TxTxPerd_C Com_tiEPS1_RxRxTout_C Com_tiGWIMG1_RxRxTout_C Com_tiGWIMG3_RxRxTout_C Com_tiGWIMG4_RxRxTout_C Com_tiGWIMG5_RxRxTout_C Com_tiGWIMG6_RxRxTout_C Com_tiIDASB_RxRxTout_C Com_tiLin_Alt_Rx_ACG_INFO_B_RxRxTout_C Com_tiLin_BS_Rx_EBSA_RxRxTout_C Com_tiLin_BS_Rx_EBSB_RxRxTout_C Com_tiLin_BS_Rx_EBSC_RxRxTout_C Com_tiLin_BS_Rx_EBSD_RxRxTout_C Com_tiLin_BS_Rx_EBSE_RxRxTout_C Com_tiLin_BS_Rx_EBSF_RxRxTout_C Com_tiLin_BS_Rx_EBSG_RxRxTout_C Com_tiLin_BS_Rx_EBSH_RxRxTout_C Com_tiLin_BS_Rx_EBSI_RxRxTout_C Com_tiMETA_RxRxTout_C Com_tiMETC_RxRxTout_C Com_tiMETD2_RxRxTout_C Com_tiMETD_RxRxTout_C Com_tiMETE2_RxRxTout_C Com_tiMETF_RxRxTout_C Com_tiMETG_RxRxTout_C Com_tiMETH2_RxRxTout_C Com_tiMETH_RxRxTout_C Com_tiMETI_RxRxTout_C Com_tiMETK_RxRxTout_C Com_tiMETL_RxRxTout_C Com_tiMETM_RxRxTout_C Com_tiMETN_RxRxTout_C Com_tiPCU_RxRxTout_C Com_tiSRSA_RxRxTout_C Com_tiSRSB_RxRxTout_C Com_tiSRS_RxRxTout_C Com_tieng1_TxTxPerd_C Com_tiengo_TxTxPerd_C /end DEF_CHARACTERISTIC
 /begin LOC_MEASUREMENT Com_IpduBuf_ENG10_Tx Com_IpduBuf_ENG11_Tx Com_IpduBuf_ENG15_Tx Com_IpduBuf_ENG16_Tx Com_IpduBuf_ENG17_Tx Com_IpduBuf_ENG18_Tx Com_IpduBuf_ENG19_Tx Com_IpduBuf_ENG20_Tx Com_IpduBuf_ENG21_Tx Com_IpduBuf_ENG22_Tx Com_IpduBuf_ENG23_Tx Com_IpduBuf_ENG24_Tx Com_IpduBuf_ENG25_Tx Com_IpduBuf_ENG2_Tx Com_IpduBuf_ENG3_Tx Com_IpduBuf_ENG4_Tx Com_IpduBuf_ENG5_Tx Com_IpduBuf_ENG6_Tx Com_IpduBuf_ENGAE_Tx Com_IpduBuf_ENGA_Tx Com_IpduBuf_ENGB_Tx Com_IpduBuf_ENGC_Tx Com_IpduBuf_ENGD_Tx Com_IpduBuf_ENGE_Tx Com_IpduBuf_ENGF_Tx Com_IpduBuf_ENGHIP1_Tx Com_IpduBuf_ENGIMG1_Tx Com_IpduBuf_ENGJ3_Tx Com_IpduBuf_ENGK3_Tx Com_IpduBuf_ENGL_Tx Com_IpduBuf_ENGN_Tx Com_IpduBuf_ENGQ_Tx Com_IpduBuf_ENGR_Tx Com_IpduBuf_ENGT1_Tx Com_IpduBuf_ENGT2_Tx Com_IpduBuf_ENGT_Tx Com_IpduBuf_ENGU_Tx Com_IpduBuf_ENGV_Tx Com_IpduBuf_ENGW_Tx Com_IpduBuf_ENGX2_Tx Com_IpduBuf_ENGY2_Tx Com_IpduBuf_ENGY_Tx Com_IpduBuf_ENGZ_Tx Com_IpduBuf_Lin_Alt_Tx_ACG_CTL_Tx Com_IpduBuf_Lin_BS_Tx_EBSA_Tx Com_IpduBuf_eng1_Tx Com_IpduBuf_engo_Tx Com_LocalBuf_AYCA_Rx Com_LocalBuf_AYCD_Rx Com_LocalBuf_AYCF_Rx Com_LocalBuf_AYCG_Rx Com_LocalBuf_AYCI_Rx Com_LocalBuf_BCM1_Rx Com_LocalBuf_CGW1_Rx Com_LocalBuf_EAT10_Rx Com_LocalBuf_EAT11_Rx Com_LocalBuf_EAT12_Rx Com_LocalBuf_EAT13_Rx Com_LocalBuf_EAT1_Rx Com_LocalBuf_EAT2_Rx Com_LocalBuf_EAT4_Rx Com_LocalBuf_EAT6_Rx Com_LocalBuf_EAT7_Rx Com_LocalBuf_EAT8_Rx Com_LocalBuf_EATA_Rx Com_LocalBuf_EATB_Rx Com_LocalBuf_EATC_Rx Com_LocalBuf_EBBA_Rx Com_LocalBuf_EPS1_Rx Com_LocalBuf_GWIMG1_Rx Com_LocalBuf_GWIMG3_Rx Com_LocalBuf_GWIMG4_Rx Com_LocalBuf_GWIMG5_Rx Com_LocalBuf_GWIMG6_Rx Com_LocalBuf_IDASB_Rx Com_LocalBuf_Lin_Alt_Rx_ACG_INFO_B_Rx Com_LocalBuf_Lin_BS_Rx_EBSA_Rx Com_LocalBuf_Lin_BS_Rx_EBSB_Rx Com_LocalBuf_Lin_BS_Rx_EBSC_Rx Com_LocalBuf_Lin_BS_Rx_EBSD_Rx Com_LocalBuf_Lin_BS_Rx_EBSE_Rx Com_LocalBuf_Lin_BS_Rx_EBSF_Rx Com_LocalBuf_Lin_BS_Rx_EBSG_Rx Com_LocalBuf_Lin_BS_Rx_EBSH_Rx Com_LocalBuf_Lin_BS_Rx_EBSI_Rx Com_LocalBuf_META_Rx Com_LocalBuf_METC_Rx Com_LocalBuf_METD2_Rx Com_LocalBuf_METD_Rx Com_LocalBuf_METE2_Rx Com_LocalBuf_METF_Rx Com_LocalBuf_METG_Rx Com_LocalBuf_METH2_Rx Com_LocalBuf_METH_Rx Com_LocalBuf_METI_Rx Com_LocalBuf_METK_Rx Com_LocalBuf_METL_Rx Com_LocalBuf_METM_Rx Com_LocalBuf_METN_Rx Com_LocalBuf_PCU_Rx Com_LocalBuf_SRSA_Rx Com_LocalBuf_SRSB_Rx Com_LocalBuf_SRS_Rx Com_SigType_au16 Com_SigType_au32 Com_SigType_au8 /end LOC_MEASUREMENT
 FUNCTION_VERSION "13.16.4_6.0.0" /end FUNCTION
/*********** Start of merged COMPU_METHOD blocks ***********/
/begin COMPU_METHOD RB_RBA_Common_CentralElements_CompuMethods_Identical "The internal value and the physical one are identical. No physical unit available" RAT_FUNC "%10.5" "noUnit" COEFFS 0.0 1.0 0.0 0.0 0.0 1.0 REF_UNIT RB_RBA_Common_CentralElements_Units_NoUnit /end COMPU_METHOD
/*********** End of merged COMPU_METHOD blocks ***********/
/begin COMPU_METHOD ABMMNM_SY_Compu "" TAB_VERB "%6.3" "" COMPU_TAB_REF ABMMNM_SY_Compu /end COMPU_METHOD
/*********** End of merged COMPU_VTAB blocks ***********/
/begin COMPU_VTAB ABMMNM_SY_Compu "" TAB_VERB 2 0 "False" 1 "True" /end COMPU_VTAB
/begin COMPU_METHOD ACCHRGRINTKT_TYPAVL_SC_Compu "" TAB_VERB "%6.3" "" COMPU_TAB_REF ACCHRGRINTKT_TYPAVL_SC_Compu /end COMPU_METHOD
/begin COMPU_VTAB ACCHRGRINTKT_TYPAVL_SC_Compu "" TAB_VERB 2 0 "False" 1 "True" /end COMPU_VTAB
/begin COMPU_METHOD ACCI_INHOUSE_SY_Compu "" TAB_VERB "%6.3" "" COMPU_TAB_REF ACCI_INHOUSE_SY_Compu /end COMPU_METHOD
/begin COMPU_VTAB ACCI_INHOUSE_SY_Compu "" TAB_VERB 2 0 "False" 1 "True" /end COMPU_VTAB
/begin COMPU_METHOD ACCLMON_SY_Compu "" TAB_VERB "%6.3" "" COMPU_TAB_REF ACCLMON_SY_Compu /end COMPU_METHOD
/begin COMPU_VTAB ACCLMON_SY_Compu "" TAB_VERB 3 0 "NOAMO" 1 "AMO_OVR" 2 "AMO_NO_OVR" /end COMPU_VTAB
/begin COMPU_METHOD ACCLNTP_ATS_SY_Compu "" TAB_VERB "%6.3" "" COMPU_TAB_REF ACCLNTP_ATS_SY_Compu /end COMPU_METHOD
/begin COMPU_VTAB ACCLNTP_ATS_SY_Compu "" TAB_VERB 2 0 "False" 1 "True" /end COMPU_VTAB
/begin COMPU_METHOD ACCLNTP_CODAVL_SC_Compu "" TAB_VERB "%6.3" "" COMPU_TAB_REF ACCLNTP_CODAVL_SC_Compu /end COMPU_METHOD
/begin COMPU_VTAB ACCLNTP_CODAVL_SC_Compu "" TAB_VERB 2 0 "False" 1 "True" /end COMPU_VTAB
/*********** Start of merged RECORD_LAYOUT blocks ***********/
/begin RECORD_LAYOUT DefaultValueRecordLayout_AUTOSAR_Platform_BaseTypes_uint8 FNC_VALUES 1 UBYTE COLUMN_DIR DIRECT STATIC_RECORD_LAYOUT /end RECORD_LAYOUT
/begin RECORD_LAYOUT DefaultValueRecordLayout_AUTOSAR_Platform_BaseTypes_uint32 FNC_VALUES 1 ULONG COLUMN_DIR DIRECT STATIC_RECORD_LAYOUT /end RECORD_LAYOUT
/begin RECORD_LAYOUT DefaultValueRecordLayout_AUTOSAR_Platform_BaseTypes_uint16 FNC_VALUES 1 UWORD COLUMN_DIR DIRECT STATIC_RECORD_LAYOUT /end RECORD_LAYOUT
/*********** Start of merged UNIT blocks ***********/
/begin UNIT RB_RBA_Common_CentralElements_Units_NoUnit "No Unit" "noUnit" EXTENDED_SI SI_EXPONENTS 0 0 0 0 0 0 0 /end UNIT
/end MODULE
/end PROJECT
