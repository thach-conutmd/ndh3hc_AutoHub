ASAP2_VERSION 1 60
/begin PROJECT MG1CA020 "MG1CA020"
/begin HEADER "" VERSION "MG1CA020_6SAY_V011_TPROT" PROJECT_NO MG1CA020 /end HEADER
/begin MODULE DIM ""
/begin MOD_COMMON "" BYTE_ORDER MSB_LAST ALIGNMENT_BYTE 1 ALIGNMENT_WORD 2 ALIGNMENT_LONG 4 ALIGNMENT_INT64 4 ALIGNMENT_FLOAT32_IEEE 4 ALIGNMENT_FLOAT64_IEEE 4 DATA_SIZE 32 /end MOD_COMMON
/begin CHARACTERISTIC ACCmpr_numTstMax_C "Maximum number of test-impulses that could be sent in case of permanent error during one driving cycle" VALUE 0x804FA8B4 RB_Val_Wu16 65535.00 OneToOne 0.00 65535.00 FORMAT "%8.2" /end CHARACTERISTIC
/begin CHARACTERISTIC ACCmpr_tiBtwTstOT_C "Time between test impulses in case of OT error" VALUE 0x804FA8B6 RB_Val_Ws16 655.3500 Time_s -327.6800 327.6700 FORMAT "%8.4" /end CHARACTERISTIC
/begin CHARACTERISTIC ACCmpr_tiBtwTstSCB_C "Time between test impulses in case of permanent error for SCB" VALUE 0x804FA8B8 RB_Val_Ws16 655350.0 Time_ms -327680.0 327670.0 FORMAT "%8.1" /end CHARACTERISTIC
/begin CHARACTERISTIC AirCCmpr_ATS.LimitTypeMsk_C "Actuator test AirCCmpr_ATS / Tester demand monitoring enable mask for actuators" VALUE 0x8053A574 Val_Wu8 255.0 OneToOne 0.00 255.0 FORMAT "%5.1" /end CHARACTERISTIC
/begin CHARACTERISTIC AirCCmpr_ATS.CnvNorm_C "Actuator test AirCCmpr_ATS / Conversion norm used for conversion to/from internal scaling" VALUE 0x8053A575 Val_Wu8 255.0 OneToOne 0.00 255.0 FORMAT "%5.1" /end CHARACTERISTIC
/begin CHARACTERISTIC AirCCmpr_ATS.LowLim_C "Actuator test AirCCmpr_ATS / Lower limit for monitoring" VALUE 0x8053A576 Val_Ws16 65535.00 OneToOne -32768.00 32767.00 FORMAT "%8.2" /end CHARACTERISTIC
/begin CHARACTERISTIC AirCCmpr_ATS.UpLim_C "Actuator test AirCCmpr_ATS / Upper limit for monitoring" VALUE 0x8053A578 Val_Ws16 65535.00 OneToOne -32768.00 32767.00 FORMAT "%8.2" /end CHARACTERISTIC
/begin CHARACTERISTIC AirCCmpr_ATS.CnvFac_C "Actuator test AirCCmpr_ATS / Factor used for conversion to/from internal scaling" VALUE 0x8053A57C Val_Ws32 4294967295.00 OneToOne -2147483648.00 2147483647.00 FORMAT "%13.2" /end CHARACTERISTIC
/begin CHARACTERISTIC AirCCmpr_ATS.CnvOfs_C "Actuator test AirCCmpr_ATS / Offset used for conversion to/from internal scaling" VALUE 0x8053A580 Val_Ws16 65535.00 OneToOne -32768.00 32767.00 FORMAT "%8.2" /end CHARACTERISTIC
/begin CHARACTERISTIC AirCCmpr_ATS.DfltVal_C "Actuator test AirCCmpr_ATS / Default value for standbytest" VALUE 0x8053A582 Val_Ws16 65535.00 OneToOne -32768.00 32767.00 FORMAT "%8.2" /end CHARACTERISTIC
/begin CHARACTERISTIC AirC_nEngLoLim_C "Lower limit for the engine speed above which a plausibility check for AC coolant pressure is valid" VALUE 0x804FA868 RB_Val_Ws16 32767.50 EngN -16384.00 16383.50 FORMAT "%8.2" /end CHARACTERISTIC
/begin CHARACTERISTIC AirC_pClntTransfAna_CUR "Curve for transformation of ADC voltage to sensed value of AC coolant pressure" CURVE 0x804FA86A RB_Curve_S16_S16 131070.0 PresAC_hPa -65536.00 65534.00 FORMAT "%8.2"
 /begin AXIS_DESCR STD_AXIS AirC_uAnaRawClnt Volt 16 -6553.600 6553.400 FORMAT "%8.3" DEPOSIT ABSOLUTE /end AXIS_DESCR
/end CHARACTERISTIC
/begin CHARACTERISTIC AirC_pDfl_C "Default substitute value for the AC coolant pressure in case of errors" VALUE 0x8053A500 Kw_Ws16 131070.0 PresAC_hPa -65536.00 65534.00 FORMAT "%8.2" /end CHARACTERISTIC
/begin CHARACTERISTIC AirC_RmpSlpClntP.Pos_C "Slope of transition ramp to default value in case of an error / Slope if the ramp has to be increased" VALUE 0x8053A504 Kw_Ws32 65535999.9695 RmpPresAC_hPa 0.00 65535999.9695 FORMAT "%13.4" EXTENDED_LIMITS -65536000.0000 65535999.9695 /end CHARACTERISTIC
/begin CHARACTERISTIC AirC_RmpSlpClntP.Neg_C "Slope of transition ramp to default value in case of an error / negative ramp slope" VALUE 0x8053A508 Kw_Ws32 131071999.969 RmpPresAC_hPa -65536000.0000 65535999.9695 FORMAT "%13.4" /end CHARACTERISTIC
/begin CHARACTERISTIC AirC_stCmprPsDiaDisbl_C "Status for deactivation of the power stage diagnostics" VALUE 0x804FA8BA RB_Val_Wu16 65535.00 OneToOne 0.00 65535.00 FORMAT "%8.2" /end CHARACTERISTIC
/begin CHARACTERISTIC AirC_stCmprPsDisbl_C "Status for activation of the power stage" VALUE 0x804FA8BC RB_Val_Wu16 65535.00 OneToOne 0.00 65535.00 FORMAT "%8.2" /end CHARACTERISTIC
/begin CHARACTERISTIC AirC_stCmprTyp_CW "Code word for the selection of compressor type" VALUE 0x804FA8BE RB_Val_Wu8 255.0 OneToOne 0.00 255.0 FORMAT "%5.1" /end CHARACTERISTIC
/begin CHARACTERISTIC AirC_swtAnaClntPres_C "Selection switch for AC pressure error diagnosis" VALUE 0x804FA8AC RB_Val_Wu8 255.0 OneToOne 0.00 255.0 FORMAT "%5.1" /end CHARACTERISTIC
/begin CHARACTERISTIC AirC_tAirLoLim_C "Lower limit for the environment temperature above which a plausibility check for AC coolant pressure is valid" VALUE 0x804FA8AE RB_Val_Ws16 6553.500 Temp_Cels -3549.940 3003.560 FORMAT "%8.3" /end CHARACTERISTIC
/begin CHARACTERISTIC AirC_tiPT1_C "AC coolant pressure PT1 filter constant" VALUE 0x8053A50C Val_Ws32 4294.9672940000000 TimeDelay_s 0.0000020000000 4294.9672959999998 FORMAT "%19.14" EXTENDED_LIMITS 0.000002000000001 4294.9672959999998 /end CHARACTERISTIC
/begin CHARACTERISTIC AirC_TransStgClntP.Dfl_C "Transstage structure for AC coolant pressure / Fixed replacement value" VALUE 0x8053A510 Kw_Ws16 131070.0 PresAC_hPa -65536.00 65534.00 FORMAT "%8.2" /end CHARACTERISTIC
/begin CHARACTERISTIC AirC_TransStgClntP.stSensId_C "Transstage structure for AC coolant pressure / Sensor Id word" VALUE 0x8053A512 Kw_Wu8 255.0 OneToOne 0.00 255.0 FORMAT "%5.1" /end CHARACTERISTIC
/begin CHARACTERISTIC AirC_trqCmprMin_C "Minimum value of the compressor torque." VALUE 0x804FA8C0 RB_Val_Ws16 6553.500 Trq -3276.800 3276.700 FORMAT "%8.3" /end CHARACTERISTIC
/begin CHARACTERISTIC AirC_uSRCMaxClntPres_C "Threshold for the SRC Max error in AC coolant pressure sensor" VALUE 0x804FA8B0 RB_Val_Ws16 13107.00 Volt -6553.600 6553.400 FORMAT "%8.3" /end CHARACTERISTIC
/begin CHARACTERISTIC AirC_uSRCMinClntPres_C "Threshold for SRC Min error in AC coolant pressure sensor" VALUE 0x804FA8B2 RB_Val_Ws16 13107.00 Volt -6553.600 6553.400 FORMAT "%8.3" /end CHARACTERISTIC
/begin MEASUREMENT ComScl_Bdy_RawSignal_PCU_ALIVE_COUNTER_45B_u8 "NetworkSignal ComScl_Bdy_RawSignal_PCU_ALIVE_COUNTER_45B_u8" UBYTE RB_RBA_Common_CentralElements_CompuMethods_Identical 1 100 0.0 255. FORMAT "%10.0" ECU_ADDRESS 0x6000B67E /end MEASUREMENT
/begin MEASUREMENT ComScl_Bdy_RawSignal_PCU_CHECKSUM_45B_u8 "NetworkSignal ComScl_Bdy_RawSignal_PCU_CHECKSUM_45B_u8" UBYTE RB_RBA_Common_CentralElements_CompuMethods_Identical 1 100 0.0 255. FORMAT "%10.0" ECU_ADDRESS 0x6000B67D /end MEASUREMENT
/begin MEASUREMENT ComScl_Bdy_RawSignal_PCU_REM_ENG_START_b "NetworkSignal ComScl_Bdy_RawSignal_PCU_REM_ENG_START_b" UBYTE RB_RBA_Common_CentralElements_CompuMethods_Identical 1 100 0.0 255. FORMAT "%10.0" ECU_ADDRESS 0x6000B67C /end MEASUREMENT
/begin MEASUREMENT ComScl_Bdy_RawSignal_SRS_ALIVE_COUNTER_039_u8 "NetworkSignal ComScl_Bdy_RawSignal_SRS_ALIVE_COUNTER_039_u8" UBYTE RB_RBA_Common_CentralElements_CompuMethods_Identical 1 100 0.0 255. FORMAT "%10.0" ECU_ADDRESS 0x6000B66B /end MEASUREMENT
/begin MEASUREMENT ComScl_Bdy_RawSignal_SRS_ALIVE_COUNTER_094_u8 "NetworkSignal ComScl_Bdy_RawSignal_SRS_ALIVE_COUNTER_094_u8" UBYTE RB_RBA_Common_CentralElements_CompuMethods_Identical 1 100 0.0 255. FORMAT "%10.0" ECU_ADDRESS 0x6000B678 /end MEASUREMENT
/begin MEASUREMENT ComScl_Bdy_RawSignal_SRS_ALIVE_COUNTER_305_u8 "NetworkSignal ComScl_Bdy_RawSignal_SRS_ALIVE_COUNTER_305_u8" UBYTE RB_RBA_Common_CentralElements_CompuMethods_Identical 1 100 0.0 255. FORMAT "%10.0" ECU_ADDRESS 0x6000B67B /end MEASUREMENT
/begin MEASUREMENT ComScl_Bdy_RawSignal_SRS_CAL_LAT_G_b "NetworkSignal ComScl_Bdy_RawSignal_SRS_CAL_LAT_G_b" UBYTE RB_RBA_Common_CentralElements_CompuMethods_Identical 1 100 0.0 255. FORMAT "%10.0" ECU_ADDRESS 0x6000B677 /end MEASUREMENT
/begin MEASUREMENT ComScl_Bdy_RawSignal_SRS_CAL_LON_G_b "NetworkSignal ComScl_Bdy_RawSignal_SRS_CAL_LON_G_b" UBYTE RB_RBA_Common_CentralElements_CompuMethods_Identical 1 100 0.0 255. FORMAT "%10.0" ECU_ADDRESS 0x6000B676 /end MEASUREMENT
/begin MEASUREMENT ComScl_Bdy_RawSignal_SRS_CHECKSUM_039_u8 "NetworkSignal ComScl_Bdy_RawSignal_SRS_CHECKSUM_039_u8" UBYTE RB_RBA_Common_CentralElements_CompuMethods_Identical 1 100 0.0 255. FORMAT "%10.0" ECU_ADDRESS 0x6000B66A /end MEASUREMENT
/begin MEASUREMENT ComScl_Bdy_RawSignal_SRS_CHECKSUM_094_u8 "NetworkSignal ComScl_Bdy_RawSignal_SRS_CHECKSUM_094_u8" UBYTE RB_RBA_Common_CentralElements_CompuMethods_Identical 1 100 0.0 255. FORMAT "%10.0" ECU_ADDRESS 0x6000B675 /end MEASUREMENT
/begin MEASUREMENT ComScl_Bdy_RawSignal_SRS_CHECKSUM_305_u8 "NetworkSignal ComScl_Bdy_RawSignal_SRS_CHECKSUM_305_u8" UBYTE RB_RBA_Common_CentralElements_CompuMethods_Identical 1 100 0.0 255. FORMAT "%10.0" ECU_ADDRESS 0x6000B67A /end MEASUREMENT
/begin MEASUREMENT ComScl_Bdy_RawSignal_SRS_DR_BELT_STATUS_u8 "NetworkSignal ComScl_Bdy_RawSignal_SRS_DR_BELT_STATUS_u8" UBYTE RB_RBA_Common_CentralElements_CompuMethods_Identical 1 100 0.0 255. FORMAT "%10.0" ECU_ADDRESS 0x6000B679 /end MEASUREMENT
/begin MEASUREMENT ComScl_Bdy_RawSignal_SRS_HI_CDS_b "NetworkSignal ComScl_Bdy_RawSignal_SRS_HI_CDS_b" UBYTE RB_RBA_Common_CentralElements_CompuMethods_Identical 1 100 0.0 255. FORMAT "%10.0" ECU_ADDRESS 0x6000B669 /end MEASUREMENT
/begin MEASUREMENT ComScl_Bdy_RawSignal_SRS_LAT_G_u16 "NetworkSignal ComScl_Bdy_RawSignal_SRS_LAT_G_u16" UWORD RB_RBA_Common_CentralElements_CompuMethods_Identical 1 100 0.0 65535. FORMAT "%10.0" ECU_ADDRESS 0x600058EE /end MEASUREMENT
/begin MEASUREMENT ComScl_Bdy_RawSignal_SRS_LON_G_u16 "NetworkSignal ComScl_Bdy_RawSignal_SRS_LON_G_u16" UWORD RB_RBA_Common_CentralElements_CompuMethods_Identical 1 100 0.0 65535. FORMAT "%10.0" ECU_ADDRESS 0x600058EC /end MEASUREMENT
/begin MEASUREMENT ComScl_Bdy_RawSignal_SRS_P_ERR_LAT_G_b "NetworkSignal ComScl_Bdy_RawSignal_SRS_P_ERR_LAT_G_b" UBYTE RB_RBA_Common_CentralElements_CompuMethods_Identical 1 100 0.0 255. FORMAT "%10.0" ECU_ADDRESS 0x6000B674 /end MEASUREMENT
/begin MEASUREMENT ComScl_Bdy_RawSignal_SRS_P_ERR_LON_G_b "NetworkSignal ComScl_Bdy_RawSignal_SRS_P_ERR_LON_G_b" UBYTE RB_RBA_Common_CentralElements_CompuMethods_Identical 1 100 0.0 255. FORMAT "%10.0" ECU_ADDRESS 0x6000B673 /end MEASUREMENT
/begin MEASUREMENT ComScl_Bdy_RawSignal_SRS_P_ERR_YAW1_b "NetworkSignal ComScl_Bdy_RawSignal_SRS_P_ERR_YAW1_b" UBYTE RB_RBA_Common_CentralElements_CompuMethods_Identical 1 100 0.0 255. FORMAT "%10.0" ECU_ADDRESS 0x6000B672 /end MEASUREMENT
/begin MEASUREMENT ComScl_Bdy_RawSignal_SRS_SENSOR_ERR_MC_b "NetworkSignal ComScl_Bdy_RawSignal_SRS_SENSOR_ERR_MC_b" UBYTE RB_RBA_Common_CentralElements_CompuMethods_Identical 1 100 0.0 255. FORMAT "%10.0" ECU_ADDRESS 0x6000B671 /end MEASUREMENT
/begin MEASUREMENT ComScl_Bdy_RawSignal_SRS_SENSOR_START_UP_b "NetworkSignal ComScl_Bdy_RawSignal_SRS_SENSOR_START_UP_b" UBYTE RB_RBA_Common_CentralElements_CompuMethods_Identical 1 100 0.0 255. FORMAT "%10.0" ECU_ADDRESS 0x6000B670 /end MEASUREMENT
/begin MEASUREMENT ComScl_Bdy_RawSignal_SRS_SENSOR_STATE_IG_b "NetworkSignal ComScl_Bdy_RawSignal_SRS_SENSOR_STATE_IG_b" UBYTE RB_RBA_Common_CentralElements_CompuMethods_Identical 1 100 0.0 255. FORMAT "%10.0" ECU_ADDRESS 0x6000B66F /end MEASUREMENT
/begin MEASUREMENT ComScl_Bdy_RawSignal_SRS_T_ERR_LAT_G_b "NetworkSignal ComScl_Bdy_RawSignal_SRS_T_ERR_LAT_G_b" UBYTE RB_RBA_Common_CentralElements_CompuMethods_Identical 1 100 0.0 255. FORMAT "%10.0" ECU_ADDRESS 0x6000B66E /end MEASUREMENT
/begin MEASUREMENT ComScl_Bdy_RawSignal_SRS_T_ERR_LON_G_b "NetworkSignal ComScl_Bdy_RawSignal_SRS_T_ERR_LON_G_b" UBYTE RB_RBA_Common_CentralElements_CompuMethods_Identical 1 100 0.0 255. FORMAT "%10.0" ECU_ADDRESS 0x6000B66D /end MEASUREMENT
/begin MEASUREMENT ComScl_Bdy_RawSignal_SRS_T_ERR_YAW1_b "NetworkSignal ComScl_Bdy_RawSignal_SRS_T_ERR_YAW1_b" UBYTE RB_RBA_Common_CentralElements_CompuMethods_Identical 1 100 0.0 255. FORMAT "%10.0" ECU_ADDRESS 0x6000B66C /end MEASUREMENT
/begin MEASUREMENT ComScl_Bdy_RawSignal_SRS_YAW_1_u16 "NetworkSignal ComScl_Bdy_RawSignal_SRS_YAW_1_u16" UWORD RB_RBA_Common_CentralElements_CompuMethods_Identical 1 100 0.0 65535. FORMAT "%10.0" ECU_ADDRESS 0x600058EA /end MEASUREMENT
/begin MEASUREMENT ComScl_Dspl_RawSignal_METER_AC_ACGUP_REQ_b "NetworkSignal ComScl_Dspl_RawSignal_METER_AC_ACGUP_REQ_b" UBYTE RB_RBA_Common_CentralElements_CompuMethods_Identical 1 100 0.0 255. FORMAT "%10.0" ECU_ADDRESS 0x6000BB21 /end MEASUREMENT
/begin MEASUREMENT ComScl_Dspl_RawSignal_METER_AC_FR_BLW_VF_u8 "NetworkSignal ComScl_Dspl_RawSignal_METER_AC_FR_BLW_VF_u8" UBYTE RB_RBA_Common_CentralElements_CompuMethods_Identical 1 100 0.0 255. FORMAT "%10.0" ECU_ADDRESS 0x6000BB1B /end MEASUREMENT
/begin MEASUREMENT ComScl_Dspl_RawSignal_METER_AC_HACCUT_NG_u8 "NetworkSignal ComScl_Dspl_RawSignal_METER_AC_HACCUT_NG_u8" UBYTE RB_RBA_Common_CentralElements_CompuMethods_Identical 1 100 0.0 255. FORMAT "%10.0" ECU_ADDRESS 0x6000BB2B /end MEASUREMENT
/begin MEASUREMENT ComScl_Dspl_RawSignal_METER_AC_OUTAIRTEMP01_u8 "NetworkSignal ComScl_Dspl_RawSignal_METER_AC_OUTAIRTEMP01_u8" UBYTE RB_RBA_Common_CentralElements_CompuMethods_Identical 1 100 0.0 255. FORMAT "%10.0" ECU_ADDRESS 0x6000BB20 /end MEASUREMENT
/begin MEASUREMENT ComScl_Dspl_RawSignal_METER_AC_PTC_STATUS_u8 "NetworkSignal ComScl_Dspl_RawSignal_METER_AC_PTC_STATUS_u8" UBYTE RB_RBA_Common_CentralElements_CompuMethods_Identical 1 100 0.0 255. FORMAT "%10.0" ECU_ADDRESS 0x6000BB1F /end MEASUREMENT
/begin MEASUREMENT ComScl_Dspl_RawSignal_METER_AC_RRDEF_b "NetworkSignal ComScl_Dspl_RawSignal_METER_AC_RRDEF_b" UBYTE RB_RBA_Common_CentralElements_CompuMethods_Identical 1 100 0.0 255. FORMAT "%10.0" ECU_ADDRESS 0x6000BB1A /end MEASUREMENT
/begin MEASUREMENT ComScl_Dspl_RawSignal_METER_AC_RR_BLW_VF_u8 "NetworkSignal ComScl_Dspl_RawSignal_METER_AC_RR_BLW_VF_u8" UBYTE RB_RBA_Common_CentralElements_CompuMethods_Identical 1 100 0.0 255. FORMAT "%10.0" ECU_ADDRESS 0x6000BB19 /end MEASUREMENT
/begin MEASUREMENT ComScl_Dspl_RawSignal_METER_AC_TEVATEMP05_u8 "NetworkSignal ComScl_Dspl_RawSignal_METER_AC_TEVATEMP05_u8" UBYTE RB_RBA_Common_CentralElements_CompuMethods_Identical 1 100 0.0 255. FORMAT "%10.0" ECU_ADDRESS 0x6000BAFB /end MEASUREMENT
/begin MEASUREMENT ComScl_Dspl_RawSignal_METER_AC_TYPE_ECON_b "NetworkSignal ComScl_Dspl_RawSignal_METER_AC_TYPE_ECON_b" UBYTE RB_RBA_Common_CentralElements_CompuMethods_Identical 1 100 0.0 255. FORMAT "%10.0" ECU_ADDRESS 0x6000BB37 /end MEASUREMENT
/begin MEASUREMENT ComScl_Dspl_RawSignal_METER_AC_VARI_u8 "NetworkSignal ComScl_Dspl_RawSignal_METER_AC_VARI_u8" UBYTE RB_RBA_Common_CentralElements_CompuMethods_Identical 1 100 0.0 255. FORMAT "%10.0" ECU_ADDRESS 0x6000BB18 /end MEASUREMENT
/begin MEASUREMENT ComScl_Dspl_RawSignal_METER_ALIVE_COUNTER_221_2_u8 "NetworkSignal ComScl_Dspl_RawSignal_METER_ALIVE_COUNTER_221_2_u8" UBYTE RB_RBA_Common_CentralElements_CompuMethods_Identical 1 100 0.0 255. FORMAT "%10.0" ECU_ADDRESS 0x6000BB3D /end MEASUREMENT
/begin MEASUREMENT ComScl_Dspl_RawSignal_METER_ALIVE_COUNTER_221_u8 "NetworkSignal ComScl_Dspl_RawSignal_METER_ALIVE_COUNTER_221_u8" UBYTE RB_RBA_Common_CentralElements_CompuMethods_Identical 1 100 0.0 255. FORMAT "%10.0" ECU_ADDRESS 0x6000BB44 /end MEASUREMENT
/begin MEASUREMENT ComScl_Dspl_RawSignal_METER_ALIVE_COUNTER_296_u8 "NetworkSignal ComScl_Dspl_RawSignal_METER_ALIVE_COUNTER_296_u8" UBYTE RB_RBA_Common_CentralElements_CompuMethods_Identical 1 100 0.0 255. FORMAT "%10.0" ECU_ADDRESS 0x6000BB03 /end MEASUREMENT
/begin MEASUREMENT ComScl_Dspl_RawSignal_METER_ALIVE_COUNTER_309_u8 "NetworkSignal ComScl_Dspl_RawSignal_METER_ALIVE_COUNTER_309_u8" UBYTE RB_RBA_Common_CentralElements_CompuMethods_Identical 1 100 0.0 255. FORMAT "%10.0" ECU_ADDRESS 0x6000BB30 /end MEASUREMENT
/begin MEASUREMENT ComScl_Dspl_RawSignal_METER_ALIVE_COUNTER_326_u8 "NetworkSignal ComScl_Dspl_RawSignal_METER_ALIVE_COUNTER_326_u8" UBYTE RB_RBA_Common_CentralElements_CompuMethods_Identical 1 100 0.0 255. FORMAT "%10.0" ECU_ADDRESS 0x6000BB50 /end MEASUREMENT
/begin MEASUREMENT ComScl_Dspl_RawSignal_METER_ALIVE_COUNTER_331_u8 "NetworkSignal ComScl_Dspl_RawSignal_METER_ALIVE_COUNTER_331_u8" UBYTE RB_RBA_Common_CentralElements_CompuMethods_Identical 1 100 0.0 255. FORMAT "%10.0" ECU_ADDRESS 0x6000BAFA /end MEASUREMENT
/begin MEASUREMENT ComScl_Dspl_RawSignal_METER_ALIVE_COUNTER_371_u8 "NetworkSignal ComScl_Dspl_RawSignal_METER_ALIVE_COUNTER_371_u8" UBYTE RB_RBA_Common_CentralElements_CompuMethods_Identical 1 100 0.0 255. FORMAT "%10.0" ECU_ADDRESS 0x6000BB25 /end MEASUREMENT
/begin MEASUREMENT ComScl_Dspl_RawSignal_METER_ALIVE_COUNTER_372_u8 "NetworkSignal ComScl_Dspl_RawSignal_METER_ALIVE_COUNTER_372_u8" UBYTE RB_RBA_Common_CentralElements_CompuMethods_Identical 1 100 0.0 255. FORMAT "%10.0" ECU_ADDRESS 0x6000BB2A /end MEASUREMENT
/begin MEASUREMENT ComScl_Dspl_RawSignal_METER_ALIVE_COUNTER_374_u8 "NetworkSignal ComScl_Dspl_RawSignal_METER_ALIVE_COUNTER_374_u8" UBYTE RB_RBA_Common_CentralElements_CompuMethods_Identical 1 100 0.0 255. FORMAT "%10.0" ECU_ADDRESS 0x6000BB4A /end MEASUREMENT
/begin MEASUREMENT ComScl_Dspl_RawSignal_METER_ALIVE_COUNTER_37B_u8 "NetworkSignal ComScl_Dspl_RawSignal_METER_ALIVE_COUNTER_37B_u8" UBYTE RB_RBA_Common_CentralElements_CompuMethods_Identical 1 100 0.0 255. FORMAT "%10.0" ECU_ADDRESS 0x6000BB17 /end MEASUREMENT
/begin MEASUREMENT ComScl_Dspl_RawSignal_METER_ALIVE_COUNTER_396_u8 "NetworkSignal ComScl_Dspl_RawSignal_METER_ALIVE_COUNTER_396_u8" UBYTE RB_RBA_Common_CentralElements_CompuMethods_Identical 1 100 0.0 255. FORMAT "%10.0" ECU_ADDRESS 0x6000BB36 /end MEASUREMENT
/begin MEASUREMENT ComScl_Dspl_RawSignal_METER_ALIVE_COUNTER_3A1_u8 "NetworkSignal ComScl_Dspl_RawSignal_METER_ALIVE_COUNTER_3A1_u8" UBYTE RB_RBA_Common_CentralElements_CompuMethods_Identical 1 100 0.0 255. FORMAT "%10.0" ECU_ADDRESS 0x6000BAFF /end MEASUREMENT
/begin MEASUREMENT ComScl_Dspl_RawSignal_METER_ALIVE_COUNTER_510_u8 "NetworkSignal ComScl_Dspl_RawSignal_METER_ALIVE_COUNTER_510_u8" UBYTE RB_RBA_Common_CentralElements_CompuMethods_Identical 1 100 0.0 255. FORMAT "%10.0" ECU_ADDRESS 0x6000BB1E /end MEASUREMENT
/begin MEASUREMENT ComScl_Dspl_RawSignal_METER_ALIVE_COUNTER_516_u8 "NetworkSignal ComScl_Dspl_RawSignal_METER_ALIVE_COUNTER_516_u8" UBYTE RB_RBA_Common_CentralElements_CompuMethods_Identical 1 100 0.0 255. FORMAT "%10.0" ECU_ADDRESS 0x6000BB0C /end MEASUREMENT
/begin MEASUREMENT ComScl_Dspl_RawSignal_METER_ASL_CAN_ERROR_b "NetworkSignal ComScl_Dspl_RawSignal_METER_ASL_CAN_ERROR_b" UBYTE RB_RBA_Common_CentralElements_CompuMethods_Identical 1 100 0.0 255. FORMAT "%10.0" ECU_ADDRESS 0x6000BB0B /end MEASUREMENT
/begin MEASUREMENT ComScl_Dspl_RawSignal_METER_BATT_IGOFF_OTA_REQUEST_b "NetworkSignal ComScl_Dspl_RawSignal_METER_BATT_IGOFF_OTA_REQUEST_b" UBYTE RB_RBA_Common_CentralElements_CompuMethods_Identical 1 100 0.0 255. FORMAT "%10.0" ECU_ADDRESS 0x6000BB1D /end MEASUREMENT
/begin MEASUREMENT ComScl_Dspl_RawSignal_METER_BCAN_FAILCODE_BCAN_b "NetworkSignal ComScl_Dspl_RawSignal_METER_BCAN_FAILCODE_BCAN_b" UBYTE RB_RBA_Common_CentralElements_CompuMethods_Identical 1 100 0.0 255. FORMAT "%10.0" ECU_ADDRESS 0x6000BB0A /end MEASUREMENT
/begin MEASUREMENT ComScl_Dspl_RawSignal_METER_BCAN_FAILCODE_COMB_UNIT_b "NetworkSignal ComScl_Dspl_RawSignal_METER_BCAN_FAILCODE_COMB_UNIT_b" UBYTE RB_RBA_Common_CentralElements_CompuMethods_Identical 1 100 0.0 255. FORMAT "%10.0" ECU_ADDRESS 0x6000BB09 /end MEASUREMENT
/begin MEASUREMENT ComScl_Dspl_RawSignal_METER_BCAN_FAILCODE_HAC_b "NetworkSignal ComScl_Dspl_RawSignal_METER_BCAN_FAILCODE_HAC_b" UBYTE RB_RBA_Common_CentralElements_CompuMethods_Identical 1 100 0.0 255. FORMAT "%10.0" ECU_ADDRESS 0x6000BB08 /end MEASUREMENT
/begin MEASUREMENT ComScl_Dspl_RawSignal_METER_BCAN_FAILCODE_MCU_UNIT_b "NetworkSignal ComScl_Dspl_RawSignal_METER_BCAN_FAILCODE_MCU_UNIT_b" UBYTE RB_RBA_Common_CentralElements_CompuMethods_Identical 1 100 0.0 255. FORMAT "%10.0" ECU_ADDRESS 0x6000BB07 /end MEASUREMENT
/begin MEASUREMENT ComScl_Dspl_RawSignal_METER_BCAN_REPRO_b "NetworkSignal ComScl_Dspl_RawSignal_METER_BCAN_REPRO_b" UBYTE RB_RBA_Common_CentralElements_CompuMethods_Identical 1 100 0.0 255. FORMAT "%10.0" ECU_ADDRESS 0x6000BB4F /end MEASUREMENT
/begin MEASUREMENT ComScl_Dspl_RawSignal_METER_CC_MAIN_STATUS_b "NetworkSignal ComScl_Dspl_RawSignal_METER_CC_MAIN_STATUS_b" UBYTE RB_RBA_Common_CentralElements_CompuMethods_Identical 1 100 0.0 255. FORMAT "%10.0" ECU_ADDRESS 0x6000BB4E /end MEASUREMENT
/begin MEASUREMENT ComScl_Dspl_RawSignal_METER_CC_TARGETSP_DISP_b "NetworkSignal ComScl_Dspl_RawSignal_METER_CC_TARGETSP_DISP_b" UBYTE RB_RBA_Common_CentralElements_CompuMethods_Identical 1 100 0.0 255. FORMAT "%10.0" ECU_ADDRESS 0x6000BB2F /end MEASUREMENT
/begin MEASUREMENT ComScl_Dspl_RawSignal_METER_CHECKSUM_221_2_u8 "NetworkSignal ComScl_Dspl_RawSignal_METER_CHECKSUM_221_2_u8" UBYTE RB_RBA_Common_CentralElements_CompuMethods_Identical 1 100 0.0 255. FORMAT "%10.0" ECU_ADDRESS 0x6000BB3C /end MEASUREMENT
/begin MEASUREMENT ComScl_Dspl_RawSignal_METER_CHECKSUM_221_u8 "NetworkSignal ComScl_Dspl_RawSignal_METER_CHECKSUM_221_u8" UBYTE RB_RBA_Common_CentralElements_CompuMethods_Identical 1 100 0.0 255. FORMAT "%10.0" ECU_ADDRESS 0x6000BB43 /end MEASUREMENT
/begin MEASUREMENT ComScl_Dspl_RawSignal_METER_CHECKSUM_296_u8 "NetworkSignal ComScl_Dspl_RawSignal_METER_CHECKSUM_296_u8" UBYTE RB_RBA_Common_CentralElements_CompuMethods_Identical 1 100 0.0 255. FORMAT "%10.0" ECU_ADDRESS 0x6000BB02 /end MEASUREMENT
/begin MEASUREMENT ComScl_Dspl_RawSignal_METER_CHECKSUM_309_u8 "NetworkSignal ComScl_Dspl_RawSignal_METER_CHECKSUM_309_u8" UBYTE RB_RBA_Common_CentralElements_CompuMethods_Identical 1 100 0.0 255. FORMAT "%10.0" ECU_ADDRESS 0x6000BB2E /end MEASUREMENT
/begin MEASUREMENT ComScl_Dspl_RawSignal_METER_CHECKSUM_326_u8 "NetworkSignal ComScl_Dspl_RawSignal_METER_CHECKSUM_326_u8" UBYTE RB_RBA_Common_CentralElements_CompuMethods_Identical 1 100 0.0 255. FORMAT "%10.0" ECU_ADDRESS 0x6000BB4D /end MEASUREMENT
/begin MEASUREMENT ComScl_Dspl_RawSignal_METER_CHECKSUM_331_u8 "NetworkSignal ComScl_Dspl_RawSignal_METER_CHECKSUM_331_u8" UBYTE RB_RBA_Common_CentralElements_CompuMethods_Identical 1 100 0.0 255. FORMAT "%10.0" ECU_ADDRESS 0x6000BAF9 /end MEASUREMENT
/begin MEASUREMENT ComScl_Dspl_RawSignal_METER_CHECKSUM_371_u8 "NetworkSignal ComScl_Dspl_RawSignal_METER_CHECKSUM_371_u8" UBYTE RB_RBA_Common_CentralElements_CompuMethods_Identical 1 100 0.0 255. FORMAT "%10.0" ECU_ADDRESS 0x6000BB24 /end MEASUREMENT
/begin MEASUREMENT ComScl_Dspl_RawSignal_METER_CHECKSUM_372_u8 "NetworkSignal ComScl_Dspl_RawSignal_METER_CHECKSUM_372_u8" UBYTE RB_RBA_Common_CentralElements_CompuMethods_Identical 1 100 0.0 255. FORMAT "%10.0" ECU_ADDRESS 0x6000BB29 /end MEASUREMENT
/begin MEASUREMENT ComScl_Dspl_RawSignal_METER_CHECKSUM_374_u8 "NetworkSignal ComScl_Dspl_RawSignal_METER_CHECKSUM_374_u8" UBYTE RB_RBA_Common_CentralElements_CompuMethods_Identical 1 100 0.0 255. FORMAT "%10.0" ECU_ADDRESS 0x6000BB49 /end MEASUREMENT
/begin MEASUREMENT ComScl_Dspl_RawSignal_METER_CHECKSUM_37B_u8 "NetworkSignal ComScl_Dspl_RawSignal_METER_CHECKSUM_37B_u8" UBYTE RB_RBA_Common_CentralElements_CompuMethods_Identical 1 100 0.0 255. FORMAT "%10.0" ECU_ADDRESS 0x6000BB16 /end MEASUREMENT
/begin MEASUREMENT ComScl_Dspl_RawSignal_METER_CHECKSUM_396_u8 "NetworkSignal ComScl_Dspl_RawSignal_METER_CHECKSUM_396_u8" UBYTE RB_RBA_Common_CentralElements_CompuMethods_Identical 1 100 0.0 255. FORMAT "%10.0" ECU_ADDRESS 0x6000BB35 /end MEASUREMENT
/begin MEASUREMENT ComScl_Dspl_RawSignal_METER_CHECKSUM_3A1_u8 "NetworkSignal ComScl_Dspl_RawSignal_METER_CHECKSUM_3A1_u8" UBYTE RB_RBA_Common_CentralElements_CompuMethods_Identical 1 100 0.0 255. FORMAT "%10.0" ECU_ADDRESS 0x6000BAFE /end MEASUREMENT
/begin MEASUREMENT ComScl_Dspl_RawSignal_METER_CHECKSUM_510_u8 "NetworkSignal ComScl_Dspl_RawSignal_METER_CHECKSUM_510_u8" UBYTE RB_RBA_Common_CentralElements_CompuMethods_Identical 1 100 0.0 255. FORMAT "%10.0" ECU_ADDRESS 0x6000BB1C /end MEASUREMENT
/begin MEASUREMENT ComScl_Dspl_RawSignal_METER_CHECKSUM_516_u8 "NetworkSignal ComScl_Dspl_RawSignal_METER_CHECKSUM_516_u8" UBYTE RB_RBA_Common_CentralElements_CompuMethods_Identical 1 100 0.0 255. FORMAT "%10.0" ECU_ADDRESS 0x6000BB06 /end MEASUREMENT
/begin MEASUREMENT ComScl_Dspl_RawSignal_METER_COMPCURRENT_HIBYTE_u8 "NetworkSignal ComScl_Dspl_RawSignal_METER_COMPCURRENT_HIBYTE_u8" UBYTE RB_RBA_Common_CentralElements_CompuMethods_Identical 1 100 0.0 255. FORMAT "%10.0" ECU_ADDRESS 0x6000BB23 /end MEASUREMENT
/begin MEASUREMENT ComScl_Dspl_RawSignal_METER_COMPCURRENT_LOWBYTE_u8 "NetworkSignal ComScl_Dspl_RawSignal_METER_COMPCURRENT_LOWBYTE_u8" UBYTE RB_RBA_Common_CentralElements_CompuMethods_Identical 1 100 0.0 255. FORMAT "%10.0" ECU_ADDRESS 0x6000BB22 /end MEASUREMENT
/begin MEASUREMENT ComScl_Dspl_RawSignal_METER_CUSTOM_DEFAULT_b "NetworkSignal ComScl_Dspl_RawSignal_METER_CUSTOM_DEFAULT_b" UBYTE RB_RBA_Common_CentralElements_CompuMethods_Identical 1 100 0.0 255. FORMAT "%10.0" ECU_ADDRESS 0x6000BAFD /end MEASUREMENT
/begin MEASUREMENT ComScl_Dspl_RawSignal_METER_CUSTOM_STATUS_b "NetworkSignal ComScl_Dspl_RawSignal_METER_CUSTOM_STATUS_b" UBYTE RB_RBA_Common_CentralElements_CompuMethods_Identical 1 100 0.0 255. FORMAT "%10.0" ECU_ADDRESS 0x6000BAFC /end MEASUREMENT
/begin MEASUREMENT ComScl_Dspl_RawSignal_METER_DIGITAL_SPEED_DISPLAY_u8 "NetworkSignal ComScl_Dspl_RawSignal_METER_DIGITAL_SPEED_DISPLAY_u8" UBYTE RB_RBA_Common_CentralElements_CompuMethods_Identical 1 100 0.0 255. FORMAT "%10.0" ECU_ADDRESS 0x6000BB2D /end MEASUREMENT
/begin MEASUREMENT ComScl_Dspl_RawSignal_METER_DIGITAL_SPEED_TARGET_u16 "NetworkSignal ComScl_Dspl_RawSignal_METER_DIGITAL_SPEED_TARGET_u16" UWORD RB_RBA_Common_CentralElements_CompuMethods_Identical 1 100 0.0 65535. FORMAT "%10.0" ECU_ADDRESS 0x60006176 /end MEASUREMENT
/begin MEASUREMENT ComScl_Dspl_RawSignal_METER_DISPLAY_SPEED_u16 "NetworkSignal ComScl_Dspl_RawSignal_METER_DISPLAY_SPEED_u16" UWORD RB_RBA_Common_CentralElements_CompuMethods_Identical 1 100 0.0 65535. FORMAT "%10.0" ECU_ADDRESS 0x60006174 /end MEASUREMENT
/begin MEASUREMENT ComScl_Dspl_RawSignal_METER_ECONSW_ON_2_b "NetworkSignal ComScl_Dspl_RawSignal_METER_ECONSW_ON_2_b" UBYTE RB_RBA_Common_CentralElements_CompuMethods_Identical 1 100 0.0 255. FORMAT "%10.0" ECU_ADDRESS 0x6000BB3B /end MEASUREMENT
/begin MEASUREMENT ComScl_Dspl_RawSignal_METER_ECONSW_ON_b "NetworkSignal ComScl_Dspl_RawSignal_METER_ECONSW_ON_b" UBYTE RB_RBA_Common_CentralElements_CompuMethods_Identical 1 100 0.0 255. FORMAT "%10.0" ECU_ADDRESS 0x6000BB42 /end MEASUREMENT
/begin MEASUREMENT ComScl_Dspl_RawSignal_METER_EVA_TEMP_2_u8 "NetworkSignal ComScl_Dspl_RawSignal_METER_EVA_TEMP_2_u8" UBYTE RB_RBA_Common_CentralElements_CompuMethods_Identical 1 100 0.0 255. FORMAT "%10.0" ECU_ADDRESS 0x6000BB3A /end MEASUREMENT
/begin MEASUREMENT ComScl_Dspl_RawSignal_METER_EVA_TEMP_u8 "NetworkSignal ComScl_Dspl_RawSignal_METER_EVA_TEMP_u8" UBYTE RB_RBA_Common_CentralElements_CompuMethods_Identical 1 100 0.0 255. FORMAT "%10.0" ECU_ADDRESS 0x6000BB41 /end MEASUREMENT
/begin MEASUREMENT ComScl_Dspl_RawSignal_METER_FRDEF_b "NetworkSignal ComScl_Dspl_RawSignal_METER_FRDEF_b" UBYTE RB_RBA_Common_CentralElements_CompuMethods_Identical 1 100 0.0 255. FORMAT "%10.0" ECU_ADDRESS 0x6000BB34 /end MEASUREMENT
/begin MEASUREMENT ComScl_Dspl_RawSignal_METER_FRFOGRLY_b "NetworkSignal ComScl_Dspl_RawSignal_METER_FRFOGRLY_b" UBYTE RB_RBA_Common_CentralElements_CompuMethods_Identical 1 100 0.0 255. FORMAT "%10.0" ECU_ADDRESS 0x6000BB48 /end MEASUREMENT
/begin MEASUREMENT ComScl_Dspl_RawSignal_METER_FUEL_LEVEL_RAW_u8 "NetworkSignal ComScl_Dspl_RawSignal_METER_FUEL_LEVEL_RAW_u8" UBYTE RB_RBA_Common_CentralElements_CompuMethods_Identical 1 100 0.0 255. FORMAT "%10.0" ECU_ADDRESS 0x6000BB4C /end MEASUREMENT
/begin MEASUREMENT ComScl_Dspl_RawSignal_METER_ICU_ACBLW_VD_u8 "NetworkSignal ComScl_Dspl_RawSignal_METER_ICU_ACBLW_VD_u8" UBYTE RB_RBA_Common_CentralElements_CompuMethods_Identical 1 100 0.0 255. FORMAT "%10.0" ECU_ADDRESS 0x6000BB15 /end MEASUREMENT
/begin MEASUREMENT ComScl_Dspl_RawSignal_METER_ICU_HOOD_ERR_b "NetworkSignal ComScl_Dspl_RawSignal_METER_ICU_HOOD_ERR_b" UBYTE RB_RBA_Common_CentralElements_CompuMethods_Identical 1 100 0.0 255. FORMAT "%10.0" ECU_ADDRESS 0x6000BB27 /end MEASUREMENT
/begin MEASUREMENT ComScl_Dspl_RawSignal_METER_ICU_HOOD_b "NetworkSignal ComScl_Dspl_RawSignal_METER_ICU_HOOD_b" UBYTE RB_RBA_Common_CentralElements_CompuMethods_Identical 1 100 0.0 255. FORMAT "%10.0" ECU_ADDRESS 0x6000BB28 /end MEASUREMENT
/begin MEASUREMENT ComScl_Dspl_RawSignal_METER_IN_AIR_TEMP_u8 "NetworkSignal ComScl_Dspl_RawSignal_METER_IN_AIR_TEMP_u8" UBYTE RB_RBA_Common_CentralElements_CompuMethods_Identical 1 100 0.0 255. FORMAT "%10.0" ECU_ADDRESS 0x6000BB33 /end MEASUREMENT
/begin MEASUREMENT ComScl_Dspl_RawSignal_METER_IS_INHIBITSW_ON_2_b "NetworkSignal ComScl_Dspl_RawSignal_METER_IS_INHIBITSW_ON_2_b" UBYTE RB_RBA_Common_CentralElements_CompuMethods_Identical 1 100 0.0 255. FORMAT "%10.0" ECU_ADDRESS 0x6000BB39 /end MEASUREMENT
/begin MEASUREMENT ComScl_Dspl_RawSignal_METER_IS_INHIBITSW_ON_b "NetworkSignal ComScl_Dspl_RawSignal_METER_IS_INHIBITSW_ON_b" UBYTE RB_RBA_Common_CentralElements_CompuMethods_Identical 1 100 0.0 255. FORMAT "%10.0" ECU_ADDRESS 0x6000BB40 /end MEASUREMENT
/begin MEASUREMENT ComScl_Dspl_RawSignal_METER_IS_PERMIT_b "NetworkSignal ComScl_Dspl_RawSignal_METER_IS_PERMIT_b" UBYTE RB_RBA_Common_CentralElements_CompuMethods_Identical 1 100 0.0 255. FORMAT "%10.0" ECU_ADDRESS 0x6000BB32 /end MEASUREMENT
/begin MEASUREMENT ComScl_Dspl_RawSignal_METER_IS_TIME_2_u8 "NetworkSignal ComScl_Dspl_RawSignal_METER_IS_TIME_2_u8" UBYTE RB_RBA_Common_CentralElements_CompuMethods_Identical 1 100 0.0 255. FORMAT "%10.0" ECU_ADDRESS 0x6000BB38 /end MEASUREMENT
/begin MEASUREMENT ComScl_Dspl_RawSignal_METER_IS_TIME_u8 "NetworkSignal ComScl_Dspl_RawSignal_METER_IS_TIME_u8" UBYTE RB_RBA_Common_CentralElements_CompuMethods_Identical 1 100 0.0 255. FORMAT "%10.0" ECU_ADDRESS 0x6000BB3F /end MEASUREMENT
/begin MEASUREMENT ComScl_Dspl_RawSignal_METER_MICU_FRDEICERRLY_b "NetworkSignal ComScl_Dspl_RawSignal_METER_MICU_FRDEICERRLY_b" UBYTE RB_RBA_Common_CentralElements_CompuMethods_Identical 1 100 0.0 255. FORMAT "%10.0" ECU_ADDRESS 0x6000BB14 /end MEASUREMENT
/begin MEASUREMENT ComScl_Dspl_RawSignal_METER_MICU_FRWIPMTR_u8 "NetworkSignal ComScl_Dspl_RawSignal_METER_MICU_FRWIPMTR_u8" UBYTE RB_RBA_Common_CentralElements_CompuMethods_Identical 1 100 0.0 255. FORMAT "%10.0" ECU_ADDRESS 0x6000BB13 /end MEASUREMENT
/begin MEASUREMENT ComScl_Dspl_RawSignal_METER_MICU_RRDEFSW_b "NetworkSignal ComScl_Dspl_RawSignal_METER_MICU_RRDEFSW_b" UBYTE RB_RBA_Common_CentralElements_CompuMethods_Identical 1 100 0.0 255. FORMAT "%10.0" ECU_ADDRESS 0x6000BB12 /end MEASUREMENT
/begin MEASUREMENT ComScl_Dspl_RawSignal_METER_MICU_TYPE_b "NetworkSignal ComScl_Dspl_RawSignal_METER_MICU_TYPE_b" UBYTE RB_RBA_Common_CentralElements_CompuMethods_Identical 1 100 0.0 255. FORMAT "%10.0" ECU_ADDRESS 0x6000BB11 /end MEASUREMENT
/begin MEASUREMENT ComScl_Dspl_RawSignal_METER_ODODATA_STATE_b "NetworkSignal ComScl_Dspl_RawSignal_METER_ODODATA_STATE_b" UBYTE RB_RBA_Common_CentralElements_CompuMethods_Identical 1 100 0.0 255. FORMAT "%10.0" ECU_ADDRESS 0x6000BB05 /end MEASUREMENT
/begin MEASUREMENT ComScl_Dspl_RawSignal_METER_ODO_DATA_u32 "NetworkSignal ComScl_Dspl_RawSignal_METER_ODO_DATA_u32" ULONG RB_RBA_Common_CentralElements_CompuMethods_Identical 1 100 0.0 4.E9 FORMAT "%10.0" ECU_ADDRESS 0x500025A0 /end MEASUREMENT
/begin MEASUREMENT ComScl_Dspl_RawSignal_METER_OIL_LIFE_RESSW_b "NetworkSignal ComScl_Dspl_RawSignal_METER_OIL_LIFE_RESSW_b" UBYTE RB_RBA_Common_CentralElements_CompuMethods_Identical 1 100 0.0 255. FORMAT "%10.0" ECU_ADDRESS 0x6000BB04 /end MEASUREMENT
/begin MEASUREMENT ComScl_Dspl_RawSignal_METER_OUTTEMP_u8 "NetworkSignal ComScl_Dspl_RawSignal_METER_OUTTEMP_u8" UBYTE RB_RBA_Common_CentralElements_CompuMethods_Identical 1 100 0.0 255. FORMAT "%10.0" ECU_ADDRESS 0x6000BB47 /end MEASUREMENT
/begin MEASUREMENT ComScl_Dspl_RawSignal_METER_OUT_AIR_TEMP_u8 "NetworkSignal ComScl_Dspl_RawSignal_METER_OUT_AIR_TEMP_u8" UBYTE RB_RBA_Common_CentralElements_CompuMethods_Identical 1 100 0.0 255. FORMAT "%10.0" ECU_ADDRESS 0x6000BB31 /end MEASUREMENT
/begin MEASUREMENT ComScl_Dspl_RawSignal_METER_RM_DRLKC_b "NetworkSignal ComScl_Dspl_RawSignal_METER_RM_DRLKC_b" UBYTE RB_RBA_Common_CentralElements_CompuMethods_Identical 1 100 0.0 255. FORMAT "%10.0" ECU_ADDRESS 0x6000BB10 /end MEASUREMENT
/begin MEASUREMENT ComScl_Dspl_RawSignal_METER_RM_HLHIRLY_b "NetworkSignal ComScl_Dspl_RawSignal_METER_RM_HLHIRLY_b" UBYTE RB_RBA_Common_CentralElements_CompuMethods_Identical 1 100 0.0 255. FORMAT "%10.0" ECU_ADDRESS 0x6000BB0F /end MEASUREMENT
/begin MEASUREMENT ComScl_Dspl_RawSignal_METER_RM_HLLORLY_b "NetworkSignal ComScl_Dspl_RawSignal_METER_RM_HLLORLY_b" UBYTE RB_RBA_Common_CentralElements_CompuMethods_Identical 1 100 0.0 255. FORMAT "%10.0" ECU_ADDRESS 0x6000BB0E /end MEASUREMENT
/begin MEASUREMENT ComScl_Dspl_RawSignal_METER_RM_ILL_SML_b "NetworkSignal ComScl_Dspl_RawSignal_METER_RM_ILL_SML_b" UBYTE RB_RBA_Common_CentralElements_CompuMethods_Identical 1 100 0.0 255. FORMAT "%10.0" ECU_ADDRESS 0x6000BB0D /end MEASUREMENT
/begin MEASUREMENT ComScl_Dspl_RawSignal_METER_RRFOGRLY_b "NetworkSignal ComScl_Dspl_RawSignal_METER_RRFOGRLY_b" UBYTE RB_RBA_Common_CentralElements_CompuMethods_Identical 1 100 0.0 255. FORMAT "%10.0" ECU_ADDRESS 0x6000BB46 /end MEASUREMENT
/begin MEASUREMENT ComScl_Dspl_RawSignal_METER_SPEED_UNIT_b "NetworkSignal ComScl_Dspl_RawSignal_METER_SPEED_UNIT_b" UBYTE RB_RBA_Common_CentralElements_CompuMethods_Identical 1 100 0.0 255. FORMAT "%10.0" ECU_ADDRESS 0x6000BB2C /end MEASUREMENT
/begin MEASUREMENT ComScl_Dspl_RawSignal_METER_SW_STATUS_CC_STANDARD_u8 "NetworkSignal ComScl_Dspl_RawSignal_METER_SW_STATUS_CC_STANDARD_u8" UBYTE RB_RBA_Common_CentralElements_CompuMethods_Identical 1 100 0.0 255. FORMAT "%10.0" ECU_ADDRESS 0x6000BB01 /end MEASUREMENT
/begin MEASUREMENT ComScl_Dspl_RawSignal_METER_SW_STATUS_HAC_b "NetworkSignal ComScl_Dspl_RawSignal_METER_SW_STATUS_HAC_b" UBYTE RB_RBA_Common_CentralElements_CompuMethods_Identical 1 100 0.0 255. FORMAT "%10.0" ECU_ADDRESS 0x6000BB26 /end MEASUREMENT
/begin MEASUREMENT ComScl_Dspl_RawSignal_METER_SW_STATUS_IS_INH_b "NetworkSignal ComScl_Dspl_RawSignal_METER_SW_STATUS_IS_INH_b" UBYTE RB_RBA_Common_CentralElements_CompuMethods_Identical 1 100 0.0 255. FORMAT "%10.0" ECU_ADDRESS 0x6000BB3E /end MEASUREMENT
/begin MEASUREMENT ComScl_Dspl_RawSignal_METER_SW_STATUS_LKAS_CCLIM_DIST_u8 "NetworkSignal ComScl_Dspl_RawSignal_METER_SW_STATUS_LKAS_CCLIM_DIST_u8" UBYTE RB_RBA_Common_CentralElements_CompuMethods_Identical 1 100 0.0 255. FORMAT "%10.0" ECU_ADDRESS 0x6000BB00 /end MEASUREMENT
/begin MEASUREMENT ComScl_Dspl_RawSignal_METER_SW_STATUS_PARK_BRAKE_b "NetworkSignal ComScl_Dspl_RawSignal_METER_SW_STATUS_PARK_BRAKE_b" UBYTE RB_RBA_Common_CentralElements_CompuMethods_Identical 1 100 0.0 255. FORMAT "%10.0" ECU_ADDRESS 0x6000BB4B /end MEASUREMENT
/begin MEASUREMENT ComScl_Dspl_RawSignal_METER_WIPER_STATUS_u8 "NetworkSignal ComScl_Dspl_RawSignal_METER_WIPER_STATUS_u8" UBYTE RB_RBA_Common_CentralElements_CompuMethods_Identical 1 100 0.0 255. FORMAT "%10.0" ECU_ADDRESS 0x6000BB45 /end MEASUREMENT
/begin MEASUREMENT ComScl_EngLin_RawSignal_Lin_Alt_B_Signal_ACG_Temp_8_r_msg_u8 "NetworkSignal ComScl_EngLin_RawSignal_Lin_Alt_B_Signal_ACG_Temp_8_r_msg_u8" UBYTE RB_RBA_Common_CentralElements_CompuMethods_Identical 1 100 0.0 255. FORMAT "%10.0" ECU_ADDRESS 0x6000BB77 /end MEASUREMENT
/begin MEASUREMENT ComScl_EngLin_RawSignal_Lin_Alt_B_Signal_ComTOut_1_r_msg_b "NetworkSignal ComScl_EngLin_RawSignal_Lin_Alt_B_Signal_ComTOut_1_r_msg_b" UBYTE RB_RBA_Common_CentralElements_CompuMethods_Identical 1 100 0.0 255. FORMAT "%10.0" ECU_ADDRESS 0x6000BB76 /end MEASUREMENT
/begin MEASUREMENT ComScl_EngLin_RawSignal_Lin_Alt_B_Signal_Com_1_r_msg_b "NetworkSignal ComScl_EngLin_RawSignal_Lin_Alt_B_Signal_Com_1_r_msg_b" UBYTE RB_RBA_Common_CentralElements_CompuMethods_Identical 1 100 0.0 255. FORMAT "%10.0" ECU_ADDRESS 0x6000BB75 /end MEASUREMENT
/begin MEASUREMENT ComScl_EngLin_RawSignal_Lin_Alt_B_Signal_Dyc_5_r_msg_u8 "NetworkSignal ComScl_EngLin_RawSignal_Lin_Alt_B_Signal_Dyc_5_r_msg_u8" UBYTE RB_RBA_Common_CentralElements_CompuMethods_Identical 1 100 0.0 255. FORMAT "%10.0" ECU_ADDRESS 0x6000BB74 /end MEASUREMENT
/begin MEASUREMENT ComScl_EngLin_RawSignal_Lin_Alt_B_Signal_Elec_1_r_msg_b "NetworkSignal ComScl_EngLin_RawSignal_Lin_Alt_B_Signal_Elec_1_r_msg_b" UBYTE RB_RBA_Common_CentralElements_CompuMethods_Identical 1 100 0.0 255. FORMAT "%10.0" ECU_ADDRESS 0x6000BB73 /end MEASUREMENT
/begin MEASUREMENT ComScl_EngLin_RawSignal_Lin_Alt_B_Signal_ExctCrnt_8_r_msg_u8 "NetworkSignal ComScl_EngLin_RawSignal_Lin_Alt_B_Signal_ExctCrnt_8_r_msg_u8" UBYTE RB_RBA_Common_CentralElements_CompuMethods_Identical 1 100 0.0 255. FORMAT "%10.0" ECU_ADDRESS 0x6000BB72 /end MEASUREMENT
/begin MEASUREMENT ComScl_EngLin_RawSignal_Lin_Alt_B_Signal_HiTemp_1_r_msg_b "NetworkSignal ComScl_EngLin_RawSignal_Lin_Alt_B_Signal_HiTemp_1_r_msg_b" UBYTE RB_RBA_Common_CentralElements_CompuMethods_Identical 1 100 0.0 255. FORMAT "%10.0" ECU_ADDRESS 0x6000BB71 /end MEASUREMENT
/begin MEASUREMENT ComScl_EngLin_RawSignal_Lin_Alt_B_Signal_Mchn_1_r_msg_b "NetworkSignal ComScl_EngLin_RawSignal_Lin_Alt_B_Signal_Mchn_1_r_msg_b" UBYTE RB_RBA_Common_CentralElements_CompuMethods_Identical 1 100 0.0 255. FORMAT "%10.0" ECU_ADDRESS 0x6000BB70 /end MEASUREMENT
/begin MEASUREMENT ComScl_EngLin_RawSignal_Lin_BS_B_Signal_OCV_8_r_msg_u8 "NetworkSignal ComScl_EngLin_RawSignal_Lin_BS_B_Signal_OCV_8_r_msg_u8" UBYTE RB_RBA_Common_CentralElements_CompuMethods_Identical 1 100 0.0 255. FORMAT "%10.0" ECU_ADDRESS 0x6000BB56 /end MEASUREMENT
/begin MEASUREMENT ComScl_EngLin_RawSignal_Lin_BS_B_Signal_STBATTSENRST_1_r_msg_b "NetworkSignal ComScl_EngLin_RawSignal_Lin_BS_B_Signal_STBATTSENRST_1_r_msg_b" UBYTE RB_RBA_Common_CentralElements_CompuMethods_Identical 1 100 0.0 255. FORMAT "%10.0" ECU_ADDRESS 0x6000BB55 /end MEASUREMENT
/begin MEASUREMENT ComScl_EngLin_RawSignal_Lin_BS_B_Signal_TASIC_8_r_msg_u8 "NetworkSignal ComScl_EngLin_RawSignal_Lin_BS_B_Signal_TASIC_8_r_msg_u8" UBYTE RB_RBA_Common_CentralElements_CompuMethods_Identical 1 100 0.0 255. FORMAT "%10.0" ECU_ADDRESS 0x6000BB5A /end MEASUREMENT
/begin MEASUREMENT ComScl_EngLin_RawSignal_Lin_BS_B_Signal_tiDurAftIgnOff_16_r_msg_u16 "NetworkSignal ComScl_EngLin_RawSignal_Lin_BS_B_Signal_tiDurAftIgnOff_16_r_msg_u16" UWORD RB_RBA_Common_CentralElements_CompuMethods_Identical 1 100 0.0 65535. FORMAT "%10.0" ECU_ADDRESS 0x60006180 /end MEASUREMENT
/begin MEASUREMENT ComScl_EngLin_RawSignal_Lin_BS_Signal_B_BATTCH_16_r_msg_u16 "NetworkSignal ComScl_EngLin_RawSignal_Lin_BS_Signal_B_BATTCH_16_r_msg_u16" UWORD RB_RBA_Common_CentralElements_CompuMethods_Identical 1 100 0.0 65535. FORMAT "%10.0" ECU_ADDRESS 0x60006192 /end MEASUREMENT
/begin MEASUREMENT ComScl_EngLin_RawSignal_Lin_BS_Signal_B_BATTDCHA_16_r_msg_u16 "NetworkSignal ComScl_EngLin_RawSignal_Lin_BS_Signal_B_BATTDCHA_16_r_msg_u16" UWORD RB_RBA_Common_CentralElements_CompuMethods_Identical 1 100 0.0 65535. FORMAT "%10.0" ECU_ADDRESS 0x60006190 /end MEASUREMENT
/begin MEASUREMENT ComScl_EngLin_RawSignal_Lin_BS_Signal_B_BATT_WARM_LEVEL_3_r_msg_u8 "NetworkSignal ComScl_EngLin_RawSignal_Lin_BS_Signal_B_BATT_WARM_LEVEL_3_r_msg_u8" UBYTE RB_RBA_Common_CentralElements_CompuMethods_Identical 1 100 0.0 255. FORMAT "%10.0" ECU_ADDRESS 0x6000BB6D /end MEASUREMENT
/begin MEASUREMENT ComScl_EngLin_RawSignal_Lin_BS_Signal_B_BCF_1_r_msg_b "NetworkSignal ComScl_EngLin_RawSignal_Lin_BS_Signal_B_BCF_1_r_msg_b" UBYTE RB_RBA_Common_CentralElements_CompuMethods_Identical 1 100 0.0 255. FORMAT "%10.0" ECU_ADDRESS 0x6000BB54 /end MEASUREMENT
/begin MEASUREMENT ComScl_EngLin_RawSignal_Lin_BS_Signal_B_BattChg_2_r_msg_u8 "NetworkSignal ComScl_EngLin_RawSignal_Lin_BS_Signal_B_BattChg_2_r_msg_u8" UBYTE RB_RBA_Common_CentralElements_CompuMethods_Identical 1 100 0.0 255. FORMAT "%10.0" ECU_ADDRESS 0x6000BB6C /end MEASUREMENT
/begin MEASUREMENT ComScl_EngLin_RawSignal_Lin_BS_Signal_B_CHARERR_1_r_msg_b "NetworkSignal ComScl_EngLin_RawSignal_Lin_BS_Signal_B_CHARERR_1_r_msg_b" UBYTE RB_RBA_Common_CentralElements_CompuMethods_Identical 1 100 0.0 255. FORMAT "%10.0" ECU_ADDRESS 0x6000BB65 /end MEASUREMENT
/begin MEASUREMENT ComScl_EngLin_RawSignal_Lin_BS_Signal_B_CTINTRESUPD_2_r_msg_u8 "NetworkSignal ComScl_EngLin_RawSignal_Lin_BS_Signal_B_CTINTRESUPD_2_r_msg_u8" UBYTE RB_RBA_Common_CentralElements_CompuMethods_Identical 1 100 0.0 255. FORMAT "%10.0" ECU_ADDRESS 0x6000BB64 /end MEASUREMENT
/begin MEASUREMENT ComScl_EngLin_RawSignal_Lin_BS_Signal_B_CtResRpl_5_r_msg_u8 "NetworkSignal ComScl_EngLin_RawSignal_Lin_BS_Signal_B_CtResRpl_5_r_msg_u8" UBYTE RB_RBA_Common_CentralElements_CompuMethods_Identical 1 100 0.0 255. FORMAT "%10.0" ECU_ADDRESS 0x6000BB6F /end MEASUREMENT
/begin MEASUREMENT ComScl_EngLin_RawSignal_Lin_BS_Signal_B_ERROR_RES_1_r_msg_b "NetworkSignal ComScl_EngLin_RawSignal_Lin_BS_Signal_B_ERROR_RES_1_r_msg_b" UBYTE RB_RBA_Common_CentralElements_CompuMethods_Identical 1 100 0.0 255. FORMAT "%10.0" ECU_ADDRESS 0x6000BB53 /end MEASUREMENT
/begin MEASUREMENT ComScl_EngLin_RawSignal_Lin_BS_Signal_B_IBAT_16_r_msg_u16 "NetworkSignal ComScl_EngLin_RawSignal_Lin_BS_Signal_B_IBAT_16_r_msg_u16" UWORD RB_RBA_Common_CentralElements_CompuMethods_Identical 1 100 0.0 65535. FORMAT "%10.0" ECU_ADDRESS 0x600061A0 /end MEASUREMENT
/begin MEASUREMENT ComScl_EngLin_RawSignal_Lin_BS_Signal_B_IBAT_8_r_msg_u8 "NetworkSignal ComScl_EngLin_RawSignal_Lin_BS_Signal_B_IBAT_8_r_msg_u8" UBYTE RB_RBA_Common_CentralElements_CompuMethods_Identical 1 100 0.0 255. FORMAT "%10.0" ECU_ADDRESS 0x6000BB6E /end MEASUREMENT
/begin MEASUREMENT ComScl_EngLin_RawSignal_Lin_BS_Signal_B_LIN_TYPE_RX_4_r_msg_u8 "NetworkSignal ComScl_EngLin_RawSignal_Lin_BS_Signal_B_LIN_TYPE_RX_4_r_msg_u8" UBYTE RB_RBA_Common_CentralElements_CompuMethods_Identical 1 100 0.0 255. FORMAT "%10.0" ECU_ADDRESS 0x6000BB6B /end MEASUREMENT
/begin MEASUREMENT ComScl_EngLin_RawSignal_Lin_BS_Signal_B_PulResUpd_2_r_msg_u8 "NetworkSignal ComScl_EngLin_RawSignal_Lin_BS_Signal_B_PulResUpd_2_r_msg_u8" UBYTE RB_RBA_Common_CentralElements_CompuMethods_Identical 1 100 0.0 255. FORMAT "%10.0" ECU_ADDRESS 0x6000BB63 /end MEASUREMENT
/begin MEASUREMENT ComScl_EngLin_RawSignal_Lin_BS_Signal_B_RESMEASDBATT_16_r_msg_u16 "NetworkSignal ComScl_EngLin_RawSignal_Lin_BS_Signal_B_RESMEASDBATT_16_r_msg_u16" UWORD RB_RBA_Common_CentralElements_CompuMethods_Identical 1 100 0.0 65535. FORMAT "%10.0" ECU_ADDRESS 0x60006196 /end MEASUREMENT
/begin MEASUREMENT ComScl_EngLin_RawSignal_Lin_BS_Signal_B_ResRpl_11_r_msg_u16 "NetworkSignal ComScl_EngLin_RawSignal_Lin_BS_Signal_B_ResRpl_11_r_msg_u16" UWORD RB_RBA_Common_CentralElements_CompuMethods_Identical 1 100 0.0 65535. FORMAT "%10.0" ECU_ADDRESS 0x6000619E /end MEASUREMENT
/begin MEASUREMENT ComScl_EngLin_RawSignal_Lin_BS_Signal_B_SOC_10_r_msg_u16 "NetworkSignal ComScl_EngLin_RawSignal_Lin_BS_Signal_B_SOC_10_r_msg_u16" UWORD RB_RBA_Common_CentralElements_CompuMethods_Identical 1 100 0.0 65535. FORMAT "%10.0" ECU_ADDRESS 0x6000619A /end MEASUREMENT
/begin MEASUREMENT ComScl_EngLin_RawSignal_Lin_BS_Signal_B_SOC_STATE_3_r_msg_u8 "NetworkSignal ComScl_EngLin_RawSignal_Lin_BS_Signal_B_SOC_STATE_3_r_msg_u8" UBYTE RB_RBA_Common_CentralElements_CompuMethods_Identical 1 100 0.0 255. FORMAT "%10.0" ECU_ADDRESS 0x6000BB6A /end MEASUREMENT
/begin MEASUREMENT ComScl_EngLin_RawSignal_Lin_BS_Signal_B_SOHSOFLrng_2_r_msg_u8 "NetworkSignal ComScl_EngLin_RawSignal_Lin_BS_Signal_B_SOHSOFLrng_2_r_msg_u8" UBYTE RB_RBA_Common_CentralElements_CompuMethods_Identical 1 100 0.0 255. FORMAT "%10.0" ECU_ADDRESS 0x6000BB69 /end MEASUREMENT
/begin MEASUREMENT ComScl_EngLin_RawSignal_Lin_BS_Signal_B_SOH_10_r_msg_u16 "NetworkSignal ComScl_EngLin_RawSignal_Lin_BS_Signal_B_SOH_10_r_msg_u16" UWORD RB_RBA_Common_CentralElements_CompuMethods_Identical 1 100 0.0 65535. FORMAT "%10.0" ECU_ADDRESS 0x60006198 /end MEASUREMENT
/begin MEASUREMENT ComScl_EngLin_RawSignal_Lin_BS_Signal_B_SUPPLIER_CODE_8_r_msg_u8 "NetworkSignal ComScl_EngLin_RawSignal_Lin_BS_Signal_B_SUPPLIER_CODE_8_r_msg_u8" UBYTE RB_RBA_Common_CentralElements_CompuMethods_Identical 1 100 0.0 255. FORMAT "%10.0" ECU_ADDRESS 0x6000BB59 /end MEASUREMENT
/begin MEASUREMENT ComScl_EngLin_RawSignal_Lin_BS_Signal_B_TBAT_8_r_msg_u8 "NetworkSignal ComScl_EngLin_RawSignal_Lin_BS_Signal_B_TBAT_8_r_msg_u8" UBYTE RB_RBA_Common_CentralElements_CompuMethods_Identical 1 100 0.0 255. FORMAT "%10.0" ECU_ADDRESS 0x6000BB5F /end MEASUREMENT
/begin MEASUREMENT ComScl_EngLin_RawSignal_Lin_BS_Signal_B_TBattResPul_8_r_msg_u8 "NetworkSignal ComScl_EngLin_RawSignal_Lin_BS_Signal_B_TBattResPul_8_r_msg_u8" UBYTE RB_RBA_Common_CentralElements_CompuMethods_Identical 1 100 0.0 255. FORMAT "%10.0" ECU_ADDRESS 0x6000BB62 /end MEASUREMENT
/begin MEASUREMENT ComScl_EngLin_RawSignal_Lin_BS_Signal_B_TerminalOFFDetn_2_r_msg_u8 "NetworkSignal ComScl_EngLin_RawSignal_Lin_BS_Signal_B_TerminalOFFDetn_2_r_msg_u8" UBYTE RB_RBA_Common_CentralElements_CompuMethods_Identical 1 100 0.0 255. FORMAT "%10.0" ECU_ADDRESS 0x6000BB68 /end MEASUREMENT
/begin MEASUREMENT ComScl_EngLin_RawSignal_Lin_BS_Signal_B_UBAT_16_r_msg_u16 "NetworkSignal ComScl_EngLin_RawSignal_Lin_BS_Signal_B_UBAT_16_r_msg_u16" UWORD RB_RBA_Common_CentralElements_CompuMethods_Identical 1 100 0.0 65535. FORMAT "%10.0" ECU_ADDRESS 0x6000619C /end MEASUREMENT
/begin MEASUREMENT ComScl_EngLin_RawSignal_Lin_BS_Signal_B_ctCrkngDetn_16_r_msg_u16 "NetworkSignal ComScl_EngLin_RawSignal_Lin_BS_Signal_B_ctCrkngDetn_16_r_msg_u16" UWORD RB_RBA_Common_CentralElements_CompuMethods_Identical 1 100 0.0 65535. FORMAT "%10.0" ECU_ADDRESS 0x6000617E /end MEASUREMENT
/begin MEASUREMENT ComScl_EngLin_RawSignal_Lin_BS_Signal_B_ctMeasmtCrk_2_r_msg_u8 "NetworkSignal ComScl_EngLin_RawSignal_Lin_BS_Signal_B_ctMeasmtCrk_2_r_msg_u8" UBYTE RB_RBA_Common_CentralElements_CompuMethods_Identical 1 100 0.0 255. FORMAT "%10.0" ECU_ADDRESS 0x6000BB51 /end MEASUREMENT
/begin MEASUREMENT ComScl_EngLin_RawSignal_Lin_BS_Signal_B_iBattStrtCrn_14_r_msg_u16 "NetworkSignal ComScl_EngLin_RawSignal_Lin_BS_Signal_B_iBattStrtCrn_14_r_msg_u16" UWORD RB_RBA_Common_CentralElements_CompuMethods_Identical 1 100 0.0 65535. FORMAT "%10.0" ECU_ADDRESS 0x6000617C /end MEASUREMENT
/begin MEASUREMENT ComScl_EngLin_RawSignal_Lin_BS_Signal_B_iMaxBattDcha_16_r_msg_u16 "NetworkSignal ComScl_EngLin_RawSignal_Lin_BS_Signal_B_iMaxBattDcha_16_r_msg_u16" UWORD RB_RBA_Common_CentralElements_CompuMethods_Identical 1 100 0.0 65535. FORMAT "%10.0" ECU_ADDRESS 0x6000617A /end MEASUREMENT
/begin MEASUREMENT ComScl_EngLin_RawSignal_Lin_BS_Signal_B_iStByCurrAft0h_10_r_msg_u16 "NetworkSignal ComScl_EngLin_RawSignal_Lin_BS_Signal_B_iStByCurrAft0h_10_r_msg_u16" UWORD RB_RBA_Common_CentralElements_CompuMethods_Identical 1 100 0.0 65535. FORMAT "%10.0" ECU_ADDRESS 0x6000618A /end MEASUREMENT
/begin MEASUREMENT ComScl_EngLin_RawSignal_Lin_BS_Signal_B_iStByCurrAft1h_10_r_msg_u16 "NetworkSignal ComScl_EngLin_RawSignal_Lin_BS_Signal_B_iStByCurrAft1h_10_r_msg_u16" UWORD RB_RBA_Common_CentralElements_CompuMethods_Identical 1 100 0.0 65535. FORMAT "%10.0" ECU_ADDRESS 0x60006188 /end MEASUREMENT
/begin MEASUREMENT ComScl_EngLin_RawSignal_Lin_BS_Signal_B_iStByCurrAft2h_10_r_msg_u16 "NetworkSignal ComScl_EngLin_RawSignal_Lin_BS_Signal_B_iStByCurrAft2h_10_r_msg_u16" UWORD RB_RBA_Common_CentralElements_CompuMethods_Identical 1 100 0.0 65535. FORMAT "%10.0" ECU_ADDRESS 0x60006186 /end MEASUREMENT
/begin MEASUREMENT ComScl_EngLin_RawSignal_Lin_BS_Signal_B_iStByCurrLst_10_r_msg_u16 "NetworkSignal ComScl_EngLin_RawSignal_Lin_BS_Signal_B_iStByCurrLst_10_r_msg_u16" UWORD RB_RBA_Common_CentralElements_CompuMethods_Identical 1 100 0.0 65535. FORMAT "%10.0" ECU_ADDRESS 0x60006184 /end MEASUREMENT
/begin MEASUREMENT ComScl_EngLin_RawSignal_Lin_BS_Signal_B_idBattData_8_r_msg_u8 "NetworkSignal ComScl_EngLin_RawSignal_Lin_BS_Signal_B_idBattData_8_r_msg_u8" UBYTE RB_RBA_Common_CentralElements_CompuMethods_Identical 1 100 0.0 255. FORMAT "%10.0" ECU_ADDRESS 0x6000BB58 /end MEASUREMENT
/begin MEASUREMENT ComScl_EngLin_RawSignal_Lin_BS_Signal_B_numBattPart_8_r_msg_u8 "NetworkSignal ComScl_EngLin_RawSignal_Lin_BS_Signal_B_numBattPart_8_r_msg_u8" UBYTE RB_RBA_Common_CentralElements_CompuMethods_Identical 1 100 0.0 255. FORMAT "%10.0" ECU_ADDRESS 0x6000BB57 /end MEASUREMENT
/begin MEASUREMENT ComScl_EngLin_RawSignal_Lin_BS_Signal_B_numLowSOCDetn_8_r_msg_u8 "NetworkSignal ComScl_EngLin_RawSignal_Lin_BS_Signal_B_numLowSOCDetn_8_r_msg_u8" UBYTE RB_RBA_Common_CentralElements_CompuMethods_Identical 1 100 0.0 255. FORMAT "%10.0" ECU_ADDRESS 0x6000BB5B /end MEASUREMENT
/begin MEASUREMENT ComScl_EngLin_RawSignal_Lin_BS_Signal_B_resPul_16_r_msg_u16 "NetworkSignal ComScl_EngLin_RawSignal_Lin_BS_Signal_B_resPul_16_r_msg_u16" UWORD RB_RBA_Common_CentralElements_CompuMethods_Identical 1 100 0.0 65535. FORMAT "%10.0" ECU_ADDRESS 0x60006194 /end MEASUREMENT
/begin MEASUREMENT ComScl_EngLin_RawSignal_Lin_BS_Signal_B_stChrgReq_3_r_msg_u8 "NetworkSignal ComScl_EngLin_RawSignal_Lin_BS_Signal_B_stChrgReq_3_r_msg_u8" UBYTE RB_RBA_Common_CentralElements_CompuMethods_Identical 1 100 0.0 255. FORMAT "%10.0" ECU_ADDRESS 0x6000BB67 /end MEASUREMENT
/begin MEASUREMENT ComScl_EngLin_RawSignal_Lin_BS_Signal_B_stFitng_1_r_msg_b "NetworkSignal ComScl_EngLin_RawSignal_Lin_BS_Signal_B_stFitng_1_r_msg_b" UBYTE RB_RBA_Common_CentralElements_CompuMethods_Identical 1 100 0.0 255. FORMAT "%10.0" ECU_ADDRESS 0x6000BB66 /end MEASUREMENT
/begin MEASUREMENT ComScl_EngLin_RawSignal_Lin_BS_Signal_B_stHarnR_2_r_msg_u8 "NetworkSignal ComScl_EngLin_RawSignal_Lin_BS_Signal_B_stHarnR_2_r_msg_u8" UBYTE RB_RBA_Common_CentralElements_CompuMethods_Identical 1 100 0.0 255. FORMAT "%10.0" ECU_ADDRESS 0x6000BB61 /end MEASUREMENT
/begin MEASUREMENT ComScl_EngLin_RawSignal_Lin_BS_Signal_B_tMaxBatt_8_r_msg_u8 "NetworkSignal ComScl_EngLin_RawSignal_Lin_BS_Signal_B_tMaxBatt_8_r_msg_u8" UBYTE RB_RBA_Common_CentralElements_CompuMethods_Identical 1 100 0.0 255. FORMAT "%10.0" ECU_ADDRESS 0x6000BB5D /end MEASUREMENT
/begin MEASUREMENT ComScl_EngLin_RawSignal_Lin_BS_Signal_B_tMinBatt_8_r_msg_u8 "NetworkSignal ComScl_EngLin_RawSignal_Lin_BS_Signal_B_tMinBatt_8_r_msg_u8" UBYTE RB_RBA_Common_CentralElements_CompuMethods_Identical 1 100 0.0 255. FORMAT "%10.0" ECU_ADDRESS 0x6000BB5C /end MEASUREMENT
/begin MEASUREMENT ComScl_EngLin_RawSignal_Lin_BS_Signal_B_tiBattON_16_r_msg_u16 "NetworkSignal ComScl_EngLin_RawSignal_Lin_BS_Signal_B_tiBattON_16_r_msg_u16" UWORD RB_RBA_Common_CentralElements_CompuMethods_Identical 1 100 0.0 65535. FORMAT "%10.0" ECU_ADDRESS 0x6000618E /end MEASUREMENT
/begin MEASUREMENT ComScl_EngLin_RawSignal_Lin_BS_Signal_B_tiT15ON_11_r_msg_u16 "NetworkSignal ComScl_EngLin_RawSignal_Lin_BS_Signal_B_tiT15ON_11_r_msg_u16" UWORD RB_RBA_Common_CentralElements_CompuMethods_Identical 1 100 0.0 65535. FORMAT "%10.0" ECU_ADDRESS 0x6000618C /end MEASUREMENT
/begin MEASUREMENT ComScl_EngLin_RawSignal_Lin_BS_Signal_B_uBattSOFV_8_r_msg_u8 "NetworkSignal ComScl_EngLin_RawSignal_Lin_BS_Signal_B_uBattSOFV_8_r_msg_u8" UBYTE RB_RBA_Common_CentralElements_CompuMethods_Identical 1 100 0.0 255. FORMAT "%10.0" ECU_ADDRESS 0x6000BB5E /end MEASUREMENT
/begin MEASUREMENT ComScl_EngLin_RawSignal_Lin_BS_Signal_B_uPeak_16_r_msg_u16 "NetworkSignal ComScl_EngLin_RawSignal_Lin_BS_Signal_B_uPeak_16_r_msg_u16" UWORD RB_RBA_Common_CentralElements_CompuMethods_Identical 1 100 0.0 65535. FORMAT "%10.0" ECU_ADDRESS 0x60006178 /end MEASUREMENT
/begin MEASUREMENT ComScl_EngLin_RawSignal_Lin_BS_Signal_B_xMnfcDate_16_r_msg_u16 "NetworkSignal ComScl_EngLin_RawSignal_Lin_BS_Signal_B_xMnfcDate_16_r_msg_u16" UWORD RB_RBA_Common_CentralElements_CompuMethods_Identical 1 100 0.0 65535. FORMAT "%10.0" ECU_ADDRESS 0x60006182 /end MEASUREMENT
/begin MEASUREMENT ComScl_EngLin_RawSignal_Lin_BS_Signal_ERRCMN_1_r_msg_b "NetworkSignal ComScl_EngLin_RawSignal_Lin_BS_Signal_ERRCMN_1_r_msg_b" UBYTE RB_RBA_Common_CentralElements_CompuMethods_Identical 1 100 0.0 255. FORMAT "%10.0" ECU_ADDRESS 0x6000BB60 /end MEASUREMENT
/begin MEASUREMENT ComScl_EngLin_RawSignal_Lin_BS_Signal_ERRST_1_r_msg_b "NetworkSignal ComScl_EngLin_RawSignal_Lin_BS_Signal_ERRST_1_r_msg_b" UBYTE RB_RBA_Common_CentralElements_CompuMethods_Identical 1 100 0.0 255. FORMAT "%10.0" ECU_ADDRESS 0x6000BB52 /end MEASUREMENT
/begin MEASUREMENT ComScl_Gbx_RawSignal_CVT_DISPLAYED_GEAR_u8 "NetworkSignal ComScl_Gbx_RawSignal_CVT_DISPLAYED_GEAR_u8" UBYTE RB_RBA_Common_CentralElements_CompuMethods_Identical 1 100 0.0 255. FORMAT "%10.0" ECU_ADDRESS 0x6000BB90 /end MEASUREMENT
/begin MEASUREMENT ComScl_Gbx_RawSignal_CVT_GEAR_POSITION_IND_CVT_u8 "NetworkSignal ComScl_Gbx_RawSignal_CVT_GEAR_POSITION_IND_CVT_u8" UBYTE RB_RBA_Common_CentralElements_CompuMethods_Identical 1 100 0.0 255. FORMAT "%10.0" ECU_ADDRESS 0x6000BB8F /end MEASUREMENT
/begin MEASUREMENT ComScl_Gbx_RawSignal_CVT_MISS_MILON_REQ_FLAG_b "NetworkSignal ComScl_Gbx_RawSignal_CVT_MISS_MILON_REQ_FLAG_b" UBYTE RB_RBA_Common_CentralElements_CompuMethods_Identical 1 100 0.0 255. FORMAT "%10.0" ECU_ADDRESS 0x6000BB8E /end MEASUREMENT
/begin MEASUREMENT ComScl_Gbx_RawSignal_CVT_MISS_VSENS_FAIL_FLAG_b "NetworkSignal ComScl_Gbx_RawSignal_CVT_MISS_VSENS_FAIL_FLAG_b" UBYTE RB_RBA_Common_CentralElements_CompuMethods_Identical 1 100 0.0 255. FORMAT "%10.0" ECU_ADDRESS 0x6000BB8D /end MEASUREMENT
/begin MEASUREMENT ComScl_Gbx_RawSignal_CVT_MISS_VSENS_OK_FLAG_b "NetworkSignal ComScl_Gbx_RawSignal_CVT_MISS_VSENS_OK_FLAG_b" UBYTE RB_RBA_Common_CentralElements_CompuMethods_Identical 1 100 0.0 255. FORMAT "%10.0" ECU_ADDRESS 0x6000BB8C /end MEASUREMENT
/begin MEASUREMENT ComScl_Gbx_RawSignal_CVT_MISS_VSENS_TFCD_FLAG_b "NetworkSignal ComScl_Gbx_RawSignal_CVT_MISS_VSENS_TFCD_FLAG_b" UBYTE RB_RBA_Common_CentralElements_CompuMethods_Identical 1 100 0.0 255. FORMAT "%10.0" ECU_ADDRESS 0x6000BB8B /end MEASUREMENT
/begin MEASUREMENT ComScl_Gbx_RawSignal_CVT_RATIO_INFO_191_u8 "NetworkSignal ComScl_Gbx_RawSignal_CVT_RATIO_INFO_191_u8" UBYTE RB_RBA_Common_CentralElements_CompuMethods_Identical 1 100 0.0 255. FORMAT "%10.0" ECU_ADDRESS 0x6000BB8A /end MEASUREMENT
/begin MEASUREMENT ComScl_Gbx_RawSignal_CVT_RATIO_TARGET_u8 "NetworkSignal ComScl_Gbx_RawSignal_CVT_RATIO_TARGET_u8" UBYTE RB_RBA_Common_CentralElements_CompuMethods_Identical 1 100 0.0 255. FORMAT "%10.0" ECU_ADDRESS 0x6000BB89 /end MEASUREMENT
/begin MEASUREMENT ComScl_Gbx_RawSignal_CVT_REFUSE_VSA_CONTROL_b "NetworkSignal ComScl_Gbx_RawSignal_CVT_REFUSE_VSA_CONTROL_b" UBYTE RB_RBA_Common_CentralElements_CompuMethods_Identical 1 100 0.0 255. FORMAT "%10.0" ECU_ADDRESS 0x6000BB88 /end MEASUREMENT
/begin MEASUREMENT ComScl_Gbx_RawSignal_CVT_SHFT_IN_D_b "NetworkSignal ComScl_Gbx_RawSignal_CVT_SHFT_IN_D_b" UBYTE RB_RBA_Common_CentralElements_CompuMethods_Identical 1 100 0.0 255. FORMAT "%10.0" ECU_ADDRESS 0x6000BB87 /end MEASUREMENT
/begin MEASUREMENT ComScl_Gbx_RawSignal_CVT_SHFT_IN_L_b "NetworkSignal ComScl_Gbx_RawSignal_CVT_SHFT_IN_L_b" UBYTE RB_RBA_Common_CentralElements_CompuMethods_Identical 1 100 0.0 255. FORMAT "%10.0" ECU_ADDRESS 0x6000BB86 /end MEASUREMENT
/begin MEASUREMENT ComScl_Gbx_RawSignal_CVT_SHFT_IN_NEUTRAL_b "NetworkSignal ComScl_Gbx_RawSignal_CVT_SHFT_IN_NEUTRAL_b" UBYTE RB_RBA_Common_CentralElements_CompuMethods_Identical 1 100 0.0 255. FORMAT "%10.0" ECU_ADDRESS 0x6000BB85 /end MEASUREMENT
/begin MEASUREMENT ComScl_Gbx_RawSignal_CVT_SHFT_IN_PARKING_b "NetworkSignal ComScl_Gbx_RawSignal_CVT_SHFT_IN_PARKING_b" UBYTE RB_RBA_Common_CentralElements_CompuMethods_Identical 1 100 0.0 255. FORMAT "%10.0" ECU_ADDRESS 0x6000BB84 /end MEASUREMENT
/begin MEASUREMENT ComScl_Gbx_RawSignal_CVT_SHFT_IN_REVERSE_b "NetworkSignal ComScl_Gbx_RawSignal_CVT_SHFT_IN_REVERSE_b" UBYTE RB_RBA_Common_CentralElements_CompuMethods_Identical 1 100 0.0 255. FORMAT "%10.0" ECU_ADDRESS 0x6000BB83 /end MEASUREMENT
/begin MEASUREMENT ComScl_Gbx_RawSignal_CVT_SHFT_IN_S_b "NetworkSignal ComScl_Gbx_RawSignal_CVT_SHFT_IN_S_b" UBYTE RB_RBA_Common_CentralElements_CompuMethods_Identical 1 100 0.0 255. FORMAT "%10.0" ECU_ADDRESS 0x6000BB82 /end MEASUREMENT
/begin MEASUREMENT ComScl_Gbx_RawSignal_CVT_SHIFT_SURE_b "NetworkSignal ComScl_Gbx_RawSignal_CVT_SHIFT_SURE_b" UBYTE RB_RBA_Common_CentralElements_CompuMethods_Identical 1 100 0.0 255. FORMAT "%10.0" ECU_ADDRESS 0x6000BB81 /end MEASUREMENT
/begin MEASUREMENT ComScl_Gbx_RawSignal_CVT_SW_STATUS_SMODE_b "NetworkSignal ComScl_Gbx_RawSignal_CVT_SW_STATUS_SMODE_b" UBYTE RB_RBA_Common_CentralElements_CompuMethods_Identical 1 100 0.0 255. FORMAT "%10.0" ECU_ADDRESS 0x6000BB80 /end MEASUREMENT
/begin MEASUREMENT ComScl_Gbx_RawSignal_CVT_TRANS_FAULT_D_IND_CVT_b "NetworkSignal ComScl_Gbx_RawSignal_CVT_TRANS_FAULT_D_IND_CVT_b" UBYTE RB_RBA_Common_CentralElements_CompuMethods_Identical 1 100 0.0 255. FORMAT "%10.0" ECU_ADDRESS 0x6000BB7F /end MEASUREMENT
/begin MEASUREMENT ComScl_Gbx_RawSignal_CVT_TRANS_MIL_ACC_b "NetworkSignal ComScl_Gbx_RawSignal_CVT_TRANS_MIL_ACC_b" UBYTE RB_RBA_Common_CentralElements_CompuMethods_Identical 1 100 0.0 255. FORMAT "%10.0" ECU_ADDRESS 0x6000BB7D /end MEASUREMENT
/begin MEASUREMENT ComScl_Gbx_RawSignal_CVT_TRANS_MIL_b "NetworkSignal ComScl_Gbx_RawSignal_CVT_TRANS_MIL_b" UBYTE RB_RBA_Common_CentralElements_CompuMethods_Identical 1 100 0.0 255. FORMAT "%10.0" ECU_ADDRESS 0x6000BB7E /end MEASUREMENT
/begin MEASUREMENT ComScl_Gbx_RawSignal_EAT_ALIVE_COUNTER_158_u8 "NetworkSignal ComScl_Gbx_RawSignal_EAT_ALIVE_COUNTER_158_u8" UBYTE RB_RBA_Common_CentralElements_CompuMethods_Identical 1 100 0.0 255. FORMAT "%10.0" ECU_ADDRESS 0x6000BB93 /end MEASUREMENT
/begin MEASUREMENT ComScl_Gbx_RawSignal_EAT_ALIVE_COUNTER_191_u8 "NetworkSignal ComScl_Gbx_RawSignal_EAT_ALIVE_COUNTER_191_u8" UBYTE RB_RBA_Common_CentralElements_CompuMethods_Identical 1 100 0.0 255. FORMAT "%10.0" ECU_ADDRESS 0x6000BB7C /end MEASUREMENT
/begin MEASUREMENT ComScl_Gbx_RawSignal_EAT_ALIVE_COUNTER_41B_u8 "NetworkSignal ComScl_Gbx_RawSignal_EAT_ALIVE_COUNTER_41B_u8" UBYTE RB_RBA_Common_CentralElements_CompuMethods_Identical 1 100 0.0 255. FORMAT "%10.0" ECU_ADDRESS 0x6000BBAD /end MEASUREMENT
/begin MEASUREMENT ComScl_Gbx_RawSignal_EAT_ATF_TEMP_INVALID_b "NetworkSignal ComScl_Gbx_RawSignal_EAT_ATF_TEMP_INVALID_b" UBYTE RB_RBA_Common_CentralElements_CompuMethods_Identical 1 100 0.0 255. FORMAT "%10.0" ECU_ADDRESS 0x6000BBAC /end MEASUREMENT
/begin MEASUREMENT ComScl_Gbx_RawSignal_EAT_CHECKSUM_158_u8 "NetworkSignal ComScl_Gbx_RawSignal_EAT_CHECKSUM_158_u8" UBYTE RB_RBA_Common_CentralElements_CompuMethods_Identical 1 100 0.0 255. FORMAT "%10.0" ECU_ADDRESS 0x6000BB92 /end MEASUREMENT
/begin MEASUREMENT ComScl_Gbx_RawSignal_EAT_CHECKSUM_191_u8 "NetworkSignal ComScl_Gbx_RawSignal_EAT_CHECKSUM_191_u8" UBYTE RB_RBA_Common_CentralElements_CompuMethods_Identical 1 100 0.0 255. FORMAT "%10.0" ECU_ADDRESS 0x6000BB7B /end MEASUREMENT
/begin MEASUREMENT ComScl_Gbx_RawSignal_EAT_CHECKSUM_41B_u8 "NetworkSignal ComScl_Gbx_RawSignal_EAT_CHECKSUM_41B_u8" UBYTE RB_RBA_Common_CentralElements_CompuMethods_Identical 1 100 0.0 255. FORMAT "%10.0" ECU_ADDRESS 0x6000BBAB /end MEASUREMENT
/begin MEASUREMENT ComScl_Gbx_RawSignal_EAT_REF_DISTANCE_TRAVELLED_u8 "NetworkSignal ComScl_Gbx_RawSignal_EAT_REF_DISTANCE_TRAVELLED_u8" UBYTE RB_RBA_Common_CentralElements_CompuMethods_Identical 1 100 0.0 255. FORMAT "%10.0" ECU_ADDRESS 0x6000BB91 /end MEASUREMENT
/begin MEASUREMENT ComScl_Gbx_RawSignal_EAT_TRANS_MAIN_SHAFT_SPEED_u16 "NetworkSignal ComScl_Gbx_RawSignal_EAT_TRANS_MAIN_SHAFT_SPEED_u16" UWORD RB_RBA_Common_CentralElements_CompuMethods_Identical 1 100 0.0 65535. FORMAT "%10.0" ECU_ADDRESS 0x600061AA /end MEASUREMENT
/begin MEASUREMENT ComScl_Gbx_RawSignal_EAT_TRANS_SPEED_VNC_u16 "NetworkSignal ComScl_Gbx_RawSignal_EAT_TRANS_SPEED_VNC_u16" UWORD RB_RBA_Common_CentralElements_CompuMethods_Identical 1 100 0.0 65535. FORMAT "%10.0" ECU_ADDRESS 0x600061A6 /end MEASUREMENT
/begin MEASUREMENT ComScl_Gbx_RawSignal_EAT_TRANS_SPEED_u16 "NetworkSignal ComScl_Gbx_RawSignal_EAT_TRANS_SPEED_u16" UWORD RB_RBA_Common_CentralElements_CompuMethods_Identical 1 100 0.0 65535. FORMAT "%10.0" ECU_ADDRESS 0x600061A8 /end MEASUREMENT
/begin MEASUREMENT ComScl_Gbx_RawSignal_TM_ALCZONE_u8 "NetworkSignal ComScl_Gbx_RawSignal_TM_ALCZONE_u8" UBYTE RB_RBA_Common_CentralElements_CompuMethods_Identical 1 100 0.0 255. FORMAT "%10.0" ECU_ADDRESS 0x6000BBB7 /end MEASUREMENT
/begin MEASUREMENT ComScl_Gbx_RawSignal_TM_ALIVE_COUNTER_071_u8 "NetworkSignal ComScl_Gbx_RawSignal_TM_ALIVE_COUNTER_071_u8" UBYTE RB_RBA_Common_CentralElements_CompuMethods_Identical 1 100 0.0 255. FORMAT "%10.0" ECU_ADDRESS 0x6000BBA9 /end MEASUREMENT
/begin MEASUREMENT ComScl_Gbx_RawSignal_TM_ALIVE_COUNTER_072_u8 "NetworkSignal ComScl_Gbx_RawSignal_TM_ALIVE_COUNTER_072_u8" UBYTE RB_RBA_Common_CentralElements_CompuMethods_Identical 1 100 0.0 255. FORMAT "%10.0" ECU_ADDRESS 0x6000BB9D /end MEASUREMENT
/begin MEASUREMENT ComScl_Gbx_RawSignal_TM_ALIVE_COUNTER_07B_u8 "NetworkSignal ComScl_Gbx_RawSignal_TM_ALIVE_COUNTER_07B_u8" UBYTE RB_RBA_Common_CentralElements_CompuMethods_Identical 1 100 0.0 255. FORMAT "%10.0" ECU_ADDRESS 0x6000BBC3 /end MEASUREMENT
/begin MEASUREMENT ComScl_Gbx_RawSignal_TM_ALIVE_COUNTER_07C_u8 "NetworkSignal ComScl_Gbx_RawSignal_TM_ALIVE_COUNTER_07C_u8" UBYTE RB_RBA_Common_CentralElements_CompuMethods_Identical 1 100 0.0 255. FORMAT "%10.0" ECU_ADDRESS 0x6000BBC5 /end MEASUREMENT
/begin MEASUREMENT ComScl_Gbx_RawSignal_TM_ALIVE_COUNTER_07E_u8 "NetworkSignal ComScl_Gbx_RawSignal_TM_ALIVE_COUNTER_07E_u8" UBYTE RB_RBA_Common_CentralElements_CompuMethods_Identical 1 100 0.0 255. FORMAT "%10.0" ECU_ADDRESS 0x6000BBB6 /end MEASUREMENT
/begin MEASUREMENT ComScl_Gbx_RawSignal_TM_ALIVE_COUNTER_19D_u8 "NetworkSignal ComScl_Gbx_RawSignal_TM_ALIVE_COUNTER_19D_u8" UBYTE RB_RBA_Common_CentralElements_CompuMethods_Identical 1 100 0.0 255. FORMAT "%10.0" ECU_ADDRESS 0x6000BBB2 /end MEASUREMENT
/begin MEASUREMENT ComScl_Gbx_RawSignal_TM_ALIVE_COUNTER_1BF_u8 "NetworkSignal ComScl_Gbx_RawSignal_TM_ALIVE_COUNTER_1BF_u8" UBYTE RB_RBA_Common_CentralElements_CompuMethods_Identical 1 100 0.0 255. FORMAT "%10.0" ECU_ADDRESS 0x6000BBC1 /end MEASUREMENT
/begin MEASUREMENT ComScl_Gbx_RawSignal_TM_ALIVE_COUNTER_1F0_u8 "NetworkSignal ComScl_Gbx_RawSignal_TM_ALIVE_COUNTER_1F0_u8" UBYTE RB_RBA_Common_CentralElements_CompuMethods_Identical 1 100 0.0 255. FORMAT "%10.0" ECU_ADDRESS 0x6000BBCB /end MEASUREMENT
/begin MEASUREMENT ComScl_Gbx_RawSignal_TM_ALIVE_COUNTER_351_u8 "NetworkSignal ComScl_Gbx_RawSignal_TM_ALIVE_COUNTER_351_u8" UBYTE RB_RBA_Common_CentralElements_CompuMethods_Identical 1 100 0.0 255. FORMAT "%10.0" ECU_ADDRESS 0x6000BBBC /end MEASUREMENT
/begin MEASUREMENT ComScl_Gbx_RawSignal_TM_ALIVE_COUNTER_40B_u8 "NetworkSignal ComScl_Gbx_RawSignal_TM_ALIVE_COUNTER_40B_u8" UBYTE RB_RBA_Common_CentralElements_CompuMethods_Identical 1 100 0.0 255. FORMAT "%10.0" ECU_ADDRESS 0x6000BB7A /end MEASUREMENT
/begin MEASUREMENT ComScl_Gbx_RawSignal_TM_ATF_TEMP_u8 "NetworkSignal ComScl_Gbx_RawSignal_TM_ATF_TEMP_u8" UBYTE RB_RBA_Common_CentralElements_CompuMethods_Identical 1 100 0.0 255. FORMAT "%10.0" ECU_ADDRESS 0x6000BBAA /end MEASUREMENT
/begin MEASUREMENT ComScl_Gbx_RawSignal_TM_AT_CC_FWD_b "NetworkSignal ComScl_Gbx_RawSignal_TM_AT_CC_FWD_b" UBYTE RB_RBA_Common_CentralElements_CompuMethods_Identical 1 100 0.0 255. FORMAT "%10.0" ECU_ADDRESS 0x6000BB9C /end MEASUREMENT
/begin MEASUREMENT ComScl_Gbx_RawSignal_TM_CHECKSUM_071_u8 "NetworkSignal ComScl_Gbx_RawSignal_TM_CHECKSUM_071_u8" UBYTE RB_RBA_Common_CentralElements_CompuMethods_Identical 1 100 0.0 255. FORMAT "%10.0" ECU_ADDRESS 0x6000BBA8 /end MEASUREMENT
/begin MEASUREMENT ComScl_Gbx_RawSignal_TM_CHECKSUM_072_u8 "NetworkSignal ComScl_Gbx_RawSignal_TM_CHECKSUM_072_u8" UBYTE RB_RBA_Common_CentralElements_CompuMethods_Identical 1 100 0.0 255. FORMAT "%10.0" ECU_ADDRESS 0x6000BB9B /end MEASUREMENT
/begin MEASUREMENT ComScl_Gbx_RawSignal_TM_CHECKSUM_07B_u8 "NetworkSignal ComScl_Gbx_RawSignal_TM_CHECKSUM_07B_u8" UBYTE RB_RBA_Common_CentralElements_CompuMethods_Identical 1 100 0.0 255. FORMAT "%10.0" ECU_ADDRESS 0x6000BBC2 /end MEASUREMENT
/begin MEASUREMENT ComScl_Gbx_RawSignal_TM_CHECKSUM_07C_u8 "NetworkSignal ComScl_Gbx_RawSignal_TM_CHECKSUM_07C_u8" UBYTE RB_RBA_Common_CentralElements_CompuMethods_Identical 1 100 0.0 255. FORMAT "%10.0" ECU_ADDRESS 0x6000BBC4 /end MEASUREMENT
/begin MEASUREMENT ComScl_Gbx_RawSignal_TM_CHECKSUM_07E_u8 "NetworkSignal ComScl_Gbx_RawSignal_TM_CHECKSUM_07E_u8" UBYTE RB_RBA_Common_CentralElements_CompuMethods_Identical 1 100 0.0 255. FORMAT "%10.0" ECU_ADDRESS 0x6000BBB5 /end MEASUREMENT
/begin MEASUREMENT ComScl_Gbx_RawSignal_TM_CHECKSUM_19D_u8 "NetworkSignal ComScl_Gbx_RawSignal_TM_CHECKSUM_19D_u8" UBYTE RB_RBA_Common_CentralElements_CompuMethods_Identical 1 100 0.0 255. FORMAT "%10.0" ECU_ADDRESS 0x6000BBB1 /end MEASUREMENT
/begin MEASUREMENT ComScl_Gbx_RawSignal_TM_CHECKSUM_1BF_u8 "NetworkSignal ComScl_Gbx_RawSignal_TM_CHECKSUM_1BF_u8" UBYTE RB_RBA_Common_CentralElements_CompuMethods_Identical 1 100 0.0 255. FORMAT "%10.0" ECU_ADDRESS 0x6000BBC0 /end MEASUREMENT
/begin MEASUREMENT ComScl_Gbx_RawSignal_TM_CHECKSUM_1F0_u8 "NetworkSignal ComScl_Gbx_RawSignal_TM_CHECKSUM_1F0_u8" UBYTE RB_RBA_Common_CentralElements_CompuMethods_Identical 1 100 0.0 255. FORMAT "%10.0" ECU_ADDRESS 0x6000BBCA /end MEASUREMENT
/begin MEASUREMENT ComScl_Gbx_RawSignal_TM_CHECKSUM_351_u8 "NetworkSignal ComScl_Gbx_RawSignal_TM_CHECKSUM_351_u8" UBYTE RB_RBA_Common_CentralElements_CompuMethods_Identical 1 100 0.0 255. FORMAT "%10.0" ECU_ADDRESS 0x6000BBBB /end MEASUREMENT
/begin MEASUREMENT ComScl_Gbx_RawSignal_TM_CHECKSUM_40B_u8 "NetworkSignal ComScl_Gbx_RawSignal_TM_CHECKSUM_40B_u8" UBYTE RB_RBA_Common_CentralElements_CompuMethods_Identical 1 100 0.0 255. FORMAT "%10.0" ECU_ADDRESS 0x6000BB79 /end MEASUREMENT
/begin MEASUREMENT ComScl_Gbx_RawSignal_TM_CVTNP_FLAG_b "NetworkSignal ComScl_Gbx_RawSignal_TM_CVTNP_FLAG_b" UBYTE RB_RBA_Common_CentralElements_CompuMethods_Identical 1 100 0.0 255. FORMAT "%10.0" ECU_ADDRESS 0x6000BB9A /end MEASUREMENT
/begin MEASUREMENT ComScl_Gbx_RawSignal_TM_DEC_FC_LC_OK_b "NetworkSignal ComScl_Gbx_RawSignal_TM_DEC_FC_LC_OK_b" UBYTE RB_RBA_Common_CentralElements_CompuMethods_Identical 1 100 0.0 255. FORMAT "%10.0" ECU_ADDRESS 0x6000BB99 /end MEASUREMENT
/begin MEASUREMENT ComScl_Gbx_RawSignal_TM_ECON_POS_FAIL_OK_b "NetworkSignal ComScl_Gbx_RawSignal_TM_ECON_POS_FAIL_OK_b" UBYTE RB_RBA_Common_CentralElements_CompuMethods_Identical 1 100 0.0 255. FORMAT "%10.0" ECU_ADDRESS 0x6000BBA7 /end MEASUREMENT
/begin MEASUREMENT ComScl_Gbx_RawSignal_TM_FAULT_ACTION_STATUS_VSP_FAIL_b "NetworkSignal ComScl_Gbx_RawSignal_TM_FAULT_ACTION_STATUS_VSP_FAIL_b" UBYTE RB_RBA_Common_CentralElements_CompuMethods_Identical 1 100 0.0 255. FORMAT "%10.0" ECU_ADDRESS 0x6000BB98 /end MEASUREMENT
/begin MEASUREMENT ComScl_Gbx_RawSignal_TM_F_DFTRFENTM_b "NetworkSignal ComScl_Gbx_RawSignal_TM_F_DFTRFENTM_b" UBYTE RB_RBA_Common_CentralElements_CompuMethods_Identical 1 100 0.0 255. FORMAT "%10.0" ECU_ADDRESS 0x6000BBC9 /end MEASUREMENT
/begin MEASUREMENT ComScl_Gbx_RawSignal_TM_GEARPOS_N_DET_b "NetworkSignal ComScl_Gbx_RawSignal_TM_GEARPOS_N_DET_b" UBYTE RB_RBA_Common_CentralElements_CompuMethods_Identical 1 100 0.0 255. FORMAT "%10.0" ECU_ADDRESS 0x6000BBBF /end MEASUREMENT
/begin MEASUREMENT ComScl_Gbx_RawSignal_TM_GEARPOS_P_DETSUB_b "NetworkSignal ComScl_Gbx_RawSignal_TM_GEARPOS_P_DETSUB_b" UBYTE RB_RBA_Common_CentralElements_CompuMethods_Identical 1 100 0.0 255. FORMAT "%10.0" ECU_ADDRESS 0x6000BBBA /end MEASUREMENT
/begin MEASUREMENT ComScl_Gbx_RawSignal_TM_GEARPOS_P_DET_b "NetworkSignal ComScl_Gbx_RawSignal_TM_GEARPOS_P_DET_b" UBYTE RB_RBA_Common_CentralElements_CompuMethods_Identical 1 100 0.0 255. FORMAT "%10.0" ECU_ADDRESS 0x6000BBBE /end MEASUREMENT
/begin MEASUREMENT ComScl_Gbx_RawSignal_TM_GEARPOS_P_REQSUB_b "NetworkSignal ComScl_Gbx_RawSignal_TM_GEARPOS_P_REQSUB_b" UBYTE RB_RBA_Common_CentralElements_CompuMethods_Identical 1 100 0.0 255. FORMAT "%10.0" ECU_ADDRESS 0x6000BBB9 /end MEASUREMENT
/begin MEASUREMENT ComScl_Gbx_RawSignal_TM_HACCUT_REQ_b "NetworkSignal ComScl_Gbx_RawSignal_TM_HACCUT_REQ_b" UBYTE RB_RBA_Common_CentralElements_CompuMethods_Identical 1 100 0.0 255. FORMAT "%10.0" ECU_ADDRESS 0x6000BBA6 /end MEASUREMENT
/begin MEASUREMENT ComScl_Gbx_RawSignal_TM_HEAVY_DEC_FLAG_b "NetworkSignal ComScl_Gbx_RawSignal_TM_HEAVY_DEC_FLAG_b" UBYTE RB_RBA_Common_CentralElements_CompuMethods_Identical 1 100 0.0 255. FORMAT "%10.0" ECU_ADDRESS 0x6000BBA5 /end MEASUREMENT
/begin MEASUREMENT ComScl_Gbx_RawSignal_TM_IDLE_STOP_CONDITION_b "NetworkSignal ComScl_Gbx_RawSignal_TM_IDLE_STOP_CONDITION_b" UBYTE RB_RBA_Common_CentralElements_CompuMethods_Identical 1 100 0.0 255. FORMAT "%10.0" ECU_ADDRESS 0x6000BBC8 /end MEASUREMENT
/begin MEASUREMENT ComScl_Gbx_RawSignal_TM_IDLE_STOP_OK_b "NetworkSignal ComScl_Gbx_RawSignal_TM_IDLE_STOP_OK_b" UBYTE RB_RBA_Common_CentralElements_CompuMethods_Identical 1 100 0.0 255. FORMAT "%10.0" ECU_ADDRESS 0x6000BBC7 /end MEASUREMENT
/begin MEASUREMENT ComScl_Gbx_RawSignal_TM_IDLE_STOP_TRIGGER_b "NetworkSignal ComScl_Gbx_RawSignal_TM_IDLE_STOP_TRIGGER_b" UBYTE RB_RBA_Common_CentralElements_CompuMethods_Identical 1 100 0.0 255. FORMAT "%10.0" ECU_ADDRESS 0x6000BBC6 /end MEASUREMENT
/begin MEASUREMENT ComScl_Gbx_RawSignal_TM_IG1_STATE_b "NetworkSignal ComScl_Gbx_RawSignal_TM_IG1_STATE_b" UBYTE RB_RBA_Common_CentralElements_CompuMethods_Identical 1 100 0.0 255. FORMAT "%10.0" ECU_ADDRESS 0x6000BB78 /end MEASUREMENT
/begin MEASUREMENT ComScl_Gbx_RawSignal_TM_IG1_VOLTAGE_u16 "NetworkSignal ComScl_Gbx_RawSignal_TM_IG1_VOLTAGE_u16" UWORD RB_RBA_Common_CentralElements_CompuMethods_Identical 1 100 0.0 65535. FORMAT "%10.0" ECU_ADDRESS 0x600061A4 /end MEASUREMENT
/begin MEASUREMENT ComScl_Gbx_RawSignal_TM_LC_INFORMATION_u8 "NetworkSignal ComScl_Gbx_RawSignal_TM_LC_INFORMATION_u8" UBYTE RB_RBA_Common_CentralElements_CompuMethods_Identical 1 100 0.0 255. FORMAT "%10.0" ECU_ADDRESS 0x6000BB97 /end MEASUREMENT
/begin MEASUREMENT ComScl_Gbx_RawSignal_TM_LIMP_HOME_MODE_b "NetworkSignal ComScl_Gbx_RawSignal_TM_LIMP_HOME_MODE_b" UBYTE RB_RBA_Common_CentralElements_CompuMethods_Identical 1 100 0.0 255. FORMAT "%10.0" ECU_ADDRESS 0x6000BBB0 /end MEASUREMENT
/begin MEASUREMENT ComScl_Gbx_RawSignal_TM_MAP_CC_u8 "NetworkSignal ComScl_Gbx_RawSignal_TM_MAP_CC_u8" UBYTE RB_RBA_Common_CentralElements_CompuMethods_Identical 1 100 0.0 255. FORMAT "%10.0" ECU_ADDRESS 0x6000BB96 /end MEASUREMENT
/begin MEASUREMENT ComScl_Gbx_RawSignal_TM_MIL_REQUEST_b "NetworkSignal ComScl_Gbx_RawSignal_TM_MIL_REQUEST_b" UBYTE RB_RBA_Common_CentralElements_CompuMethods_Identical 1 100 0.0 255. FORMAT "%10.0" ECU_ADDRESS 0x6000BB95 /end MEASUREMENT
/begin MEASUREMENT ComScl_Gbx_RawSignal_TM_M_MODE_RUN_b "NetworkSignal ComScl_Gbx_RawSignal_TM_M_MODE_RUN_b" UBYTE RB_RBA_Common_CentralElements_CompuMethods_Identical 1 100 0.0 255. FORMAT "%10.0" ECU_ADDRESS 0x6000BBB4 /end MEASUREMENT
/begin MEASUREMENT ComScl_Gbx_RawSignal_TM_N_TC_u16 "NetworkSignal ComScl_Gbx_RawSignal_TM_N_TC_u16" UWORD RB_RBA_Common_CentralElements_CompuMethods_Identical 1 100 0.0 65535. FORMAT "%10.0" ECU_ADDRESS 0x600061AE /end MEASUREMENT
/begin MEASUREMENT ComScl_Gbx_RawSignal_TM_OVERALL_FILTERED_RATIO_u16 "NetworkSignal ComScl_Gbx_RawSignal_TM_OVERALL_FILTERED_RATIO_u16" UWORD RB_RBA_Common_CentralElements_CompuMethods_Identical 1 100 0.0 65535. FORMAT "%10.0" ECU_ADDRESS 0x600061BA /end MEASUREMENT
/begin MEASUREMENT ComScl_Gbx_RawSignal_TM_RECOGNITION_VOLTAGE_u16 "NetworkSignal ComScl_Gbx_RawSignal_TM_RECOGNITION_VOLTAGE_u16" UWORD RB_RBA_Common_CentralElements_CompuMethods_Identical 1 100 0.0 65535. FORMAT "%10.0" ECU_ADDRESS 0x600061A2 /end MEASUREMENT
/begin MEASUREMENT ComScl_Gbx_RawSignal_TM_REQ_ENG_TORQUE_FAST_s16 "NetworkSignal ComScl_Gbx_RawSignal_TM_REQ_ENG_TORQUE_FAST_s16" SWORD RB_RBA_Common_CentralElements_CompuMethods_Identical 1 100 -32768. 32767. FORMAT "%10.0" ECU_ADDRESS 0x600061B4 /end MEASUREMENT
/begin MEASUREMENT ComScl_Gbx_RawSignal_TM_REQ_ENG_TORQUE_SLOW_s16 "NetworkSignal ComScl_Gbx_RawSignal_TM_REQ_ENG_TORQUE_SLOW_s16" SWORD RB_RBA_Common_CentralElements_CompuMethods_Identical 1 100 -32768. 32767. FORMAT "%10.0" ECU_ADDRESS 0x600061B2 /end MEASUREMENT
/begin MEASUREMENT ComScl_Gbx_RawSignal_TM_REQ_MAX_FC_LIMT_ENG_SPEED_u8 "NetworkSignal ComScl_Gbx_RawSignal_TM_REQ_MAX_FC_LIMT_ENG_SPEED_u8" UBYTE RB_RBA_Common_CentralElements_CompuMethods_Identical 1 100 0.0 255. FORMAT "%10.0" ECU_ADDRESS 0x6000BBA4 /end MEASUREMENT
/begin MEASUREMENT ComScl_Gbx_RawSignal_TM_REQ_MAX_TQ_LIMT_ENG_SPEED_u8 "NetworkSignal ComScl_Gbx_RawSignal_TM_REQ_MAX_TQ_LIMT_ENG_SPEED_u8" UBYTE RB_RBA_Common_CentralElements_CompuMethods_Identical 1 100 0.0 255. FORMAT "%10.0" ECU_ADDRESS 0x6000BBA3 /end MEASUREMENT
/begin MEASUREMENT ComScl_Gbx_RawSignal_TM_REQ_MIN_IDLE_ENG_SPEED_u8 "NetworkSignal ComScl_Gbx_RawSignal_TM_REQ_MIN_IDLE_ENG_SPEED_u8" UBYTE RB_RBA_Common_CentralElements_CompuMethods_Identical 1 100 0.0 255. FORMAT "%10.0" ECU_ADDRESS 0x6000BBA2 /end MEASUREMENT
/begin MEASUREMENT ComScl_Gbx_RawSignal_TM_SHFT_IND_RECOM_DOWN_b "NetworkSignal ComScl_Gbx_RawSignal_TM_SHFT_IND_RECOM_DOWN_b" UBYTE RB_RBA_Common_CentralElements_CompuMethods_Identical 1 100 0.0 255. FORMAT "%10.0" ECU_ADDRESS 0x6000BBA1 /end MEASUREMENT
/begin MEASUREMENT ComScl_Gbx_RawSignal_TM_SHFT_IND_RECOM_UP_b "NetworkSignal ComScl_Gbx_RawSignal_TM_SHFT_IND_RECOM_UP_b" UBYTE RB_RBA_Common_CentralElements_CompuMethods_Identical 1 100 0.0 255. FORMAT "%10.0" ECU_ADDRESS 0x6000BBA0 /end MEASUREMENT
/begin MEASUREMENT ComScl_Gbx_RawSignal_TM_SHIFT_CONTROL_MODE_u8 "NetworkSignal ComScl_Gbx_RawSignal_TM_SHIFT_CONTROL_MODE_u8" UBYTE RB_RBA_Common_CentralElements_CompuMethods_Identical 1 100 0.0 255. FORMAT "%10.0" ECU_ADDRESS 0x6000BB94 /end MEASUREMENT
/begin MEASUREMENT ComScl_Gbx_RawSignal_TM_START_ENABLESUB_b "NetworkSignal ComScl_Gbx_RawSignal_TM_START_ENABLESUB_b" UBYTE RB_RBA_Common_CentralElements_CompuMethods_Identical 1 100 0.0 255. FORMAT "%10.0" ECU_ADDRESS 0x6000BBB8 /end MEASUREMENT
/begin MEASUREMENT ComScl_Gbx_RawSignal_TM_START_ENABLE_b "NetworkSignal ComScl_Gbx_RawSignal_TM_START_ENABLE_b" UBYTE RB_RBA_Common_CentralElements_CompuMethods_Identical 1 100 0.0 255. FORMAT "%10.0" ECU_ADDRESS 0x6000BBBD /end MEASUREMENT
/begin MEASUREMENT ComScl_Gbx_RawSignal_TM_TORQUE_CONVERTER_SLIP_u16 "NetworkSignal ComScl_Gbx_RawSignal_TM_TORQUE_CONVERTER_SLIP_u16" UWORD RB_RBA_Common_CentralElements_CompuMethods_Identical 1 100 0.0 65535. FORMAT "%10.0" ECU_ADDRESS 0x600061AC /end MEASUREMENT
/begin MEASUREMENT ComScl_Gbx_RawSignal_TM_TORQUE_CONV_TORQUE_RATIO_u16 "NetworkSignal ComScl_Gbx_RawSignal_TM_TORQUE_CONV_TORQUE_RATIO_u16" UWORD RB_RBA_Common_CentralElements_CompuMethods_Identical 1 100 0.0 65535. FORMAT "%10.0" ECU_ADDRESS 0x600061BC /end MEASUREMENT
/begin MEASUREMENT ComScl_Gbx_RawSignal_TM_TORQUE_LOSSES_s16 "NetworkSignal ComScl_Gbx_RawSignal_TM_TORQUE_LOSSES_s16" SWORD RB_RBA_Common_CentralElements_CompuMethods_Identical 1 100 -32768. 32767. FORMAT "%10.0" ECU_ADDRESS 0x600061B0 /end MEASUREMENT
/begin MEASUREMENT ComScl_Gbx_RawSignal_TM_TRQ_CONTROL_MODE_FAST_DNREQ_b "NetworkSignal ComScl_Gbx_RawSignal_TM_TRQ_CONTROL_MODE_FAST_DNREQ_b" UBYTE RB_RBA_Common_CentralElements_CompuMethods_Identical 1 100 0.0 255. FORMAT "%10.0" ECU_ADDRESS 0x6000BBAF /end MEASUREMENT
/begin MEASUREMENT ComScl_Gbx_RawSignal_TM_TRQ_CONTROL_MODE_SLOW_DNREQ_b "NetworkSignal ComScl_Gbx_RawSignal_TM_TRQ_CONTROL_MODE_SLOW_DNREQ_b" UBYTE RB_RBA_Common_CentralElements_CompuMethods_Identical 1 100 0.0 255. FORMAT "%10.0" ECU_ADDRESS 0x6000BBAE /end MEASUREMENT
/begin MEASUREMENT ComScl_Gbx_RawSignal_TM_TRS_DRV_RATIO_u8 "NetworkSignal ComScl_Gbx_RawSignal_TM_TRS_DRV_RATIO_u8" UBYTE RB_RBA_Common_CentralElements_CompuMethods_Identical 1 100 0.0 255. FORMAT "%10.0" ECU_ADDRESS 0x6000BB9F /end MEASUREMENT
/begin MEASUREMENT ComScl_Gbx_RawSignal_TM_VEHICLE_SPEED_u16 "NetworkSignal ComScl_Gbx_RawSignal_TM_VEHICLE_SPEED_u16" UWORD RB_RBA_Common_CentralElements_CompuMethods_Identical 1 100 0.0 65535. FORMAT "%10.0" ECU_ADDRESS 0x600061B8 /end MEASUREMENT
/begin MEASUREMENT ComScl_Gbx_RawSignal_TM_VLVW_u16 "NetworkSignal ComScl_Gbx_RawSignal_TM_VLVW_u16" UWORD RB_RBA_Common_CentralElements_CompuMethods_Identical 1 100 0.0 65535. FORMAT "%10.0" ECU_ADDRESS 0x600061B6 /end MEASUREMENT
/begin MEASUREMENT ComScl_Gbx_RawSignal_TM_VSA_INH_b "NetworkSignal ComScl_Gbx_RawSignal_TM_VSA_INH_b" UBYTE RB_RBA_Common_CentralElements_CompuMethods_Identical 1 100 0.0 255. FORMAT "%10.0" ECU_ADDRESS 0x6000BBB3 /end MEASUREMENT
/begin MEASUREMENT ComScl_Gbx_RawSignal_TM_WRITE_VIN_CLEAR_DONE_b "NetworkSignal ComScl_Gbx_RawSignal_TM_WRITE_VIN_CLEAR_DONE_b" UBYTE RB_RBA_Common_CentralElements_CompuMethods_Identical 1 100 0.0 255. FORMAT "%10.0" ECU_ADDRESS 0x6000BB9E /end MEASUREMENT
/begin MEASUREMENT ComScl_Gw_RawSignal_GW_ALIVE_COUNTER_40E_u8 "NetworkSignal ComScl_Gw_RawSignal_GW_ALIVE_COUNTER_40E_u8" UBYTE RB_RBA_Common_CentralElements_CompuMethods_Identical 1 100 0.0 255. FORMAT "%10.0" ECU_ADDRESS 0x6000BBCE /end MEASUREMENT
/begin MEASUREMENT ComScl_Gw_RawSignal_GW_ALIVE_COUNTER_444_u8 "NetworkSignal ComScl_Gw_RawSignal_GW_ALIVE_COUNTER_444_u8" UBYTE RB_RBA_Common_CentralElements_CompuMethods_Identical 1 100 0.0 255. FORMAT "%10.0" ECU_ADDRESS 0x6000BBE8 /end MEASUREMENT
/begin MEASUREMENT ComScl_Gw_RawSignal_GW_CHECKSUM_40E_u8 "NetworkSignal ComScl_Gw_RawSignal_GW_CHECKSUM_40E_u8" UBYTE RB_RBA_Common_CentralElements_CompuMethods_Identical 1 100 0.0 255. FORMAT "%10.0" ECU_ADDRESS 0x6000BBCD /end MEASUREMENT
/begin MEASUREMENT ComScl_Gw_RawSignal_GW_CHECKSUM_444_u8 "NetworkSignal ComScl_Gw_RawSignal_GW_CHECKSUM_444_u8" UBYTE RB_RBA_Common_CentralElements_CompuMethods_Identical 1 100 0.0 255. FORMAT "%10.0" ECU_ADDRESS 0x6000BBE7 /end MEASUREMENT
/begin MEASUREMENT ComScl_Gw_RawSignal_GW_IG1_STATE_b "NetworkSignal ComScl_Gw_RawSignal_GW_IG1_STATE_b" UBYTE RB_RBA_Common_CentralElements_CompuMethods_Identical 1 100 0.0 255. FORMAT "%10.0" ECU_ADDRESS 0x6000BBCC /end MEASUREMENT
/begin MEASUREMENT ComScl_Gw_RawSignal_GW_IG1_VOLTAGE_u16 "NetworkSignal ComScl_Gw_RawSignal_GW_IG1_VOLTAGE_u16" UWORD RB_RBA_Common_CentralElements_CompuMethods_Identical 1 100 0.0 65535. FORMAT "%10.0" ECU_ADDRESS 0x600061C0 /end MEASUREMENT
/begin MEASUREMENT ComScl_Gw_RawSignal_GW_RECOGNITION_VOLTAGE_u16 "NetworkSignal ComScl_Gw_RawSignal_GW_RECOGNITION_VOLTAGE_u16" UWORD RB_RBA_Common_CentralElements_CompuMethods_Identical 1 100 0.0 65535. FORMAT "%10.0" ECU_ADDRESS 0x600061BE /end MEASUREMENT
/begin MEASUREMENT ComScl_Gw_RawSignal_IMG_ALIVE_COUNTER_082_u8 "NetworkSignal ComScl_Gw_RawSignal_IMG_ALIVE_COUNTER_082_u8" UBYTE RB_RBA_Common_CentralElements_CompuMethods_Identical 1 100 0.0 255. FORMAT "%10.0" ECU_ADDRESS 0x6000BBE2 /end MEASUREMENT
/begin MEASUREMENT ComScl_Gw_RawSignal_IMG_ALIVE_COUNTER_084_u8 "NetworkSignal ComScl_Gw_RawSignal_IMG_ALIVE_COUNTER_084_u8" UBYTE RB_RBA_Common_CentralElements_CompuMethods_Identical 1 100 0.0 255. FORMAT "%10.0" ECU_ADDRESS 0x6000BBDA /end MEASUREMENT
/begin MEASUREMENT ComScl_Gw_RawSignal_IMG_ALIVE_COUNTER_22B_u8 "NetworkSignal ComScl_Gw_RawSignal_IMG_ALIVE_COUNTER_22B_u8" UBYTE RB_RBA_Common_CentralElements_CompuMethods_Identical 1 100 0.0 255. FORMAT "%10.0" ECU_ADDRESS 0x6000BBE5 /end MEASUREMENT
/begin MEASUREMENT ComScl_Gw_RawSignal_IMG_ALIVE_COUNTER_2F1_u8 "NetworkSignal ComScl_Gw_RawSignal_IMG_ALIVE_COUNTER_2F1_u8" UBYTE RB_RBA_Common_CentralElements_CompuMethods_Identical 1 100 0.0 255. FORMAT "%10.0" ECU_ADDRESS 0x6000BBD1 /end MEASUREMENT
/begin MEASUREMENT ComScl_Gw_RawSignal_IMG_CHECKSUM_082_u8 "NetworkSignal ComScl_Gw_RawSignal_IMG_CHECKSUM_082_u8" UBYTE RB_RBA_Common_CentralElements_CompuMethods_Identical 1 100 0.0 255. FORMAT "%10.0" ECU_ADDRESS 0x6000BBE1 /end MEASUREMENT
/begin MEASUREMENT ComScl_Gw_RawSignal_IMG_CHECKSUM_084_u8 "NetworkSignal ComScl_Gw_RawSignal_IMG_CHECKSUM_084_u8" UBYTE RB_RBA_Common_CentralElements_CompuMethods_Identical 1 100 0.0 255. FORMAT "%10.0" ECU_ADDRESS 0x6000BBD9 /end MEASUREMENT
/begin MEASUREMENT ComScl_Gw_RawSignal_IMG_CHECKSUM_22B_u8 "NetworkSignal ComScl_Gw_RawSignal_IMG_CHECKSUM_22B_u8" UBYTE RB_RBA_Common_CentralElements_CompuMethods_Identical 1 100 0.0 255. FORMAT "%10.0" ECU_ADDRESS 0x6000BBE4 /end MEASUREMENT
/begin MEASUREMENT ComScl_Gw_RawSignal_IMG_CHECKSUM_2F1_u8 "NetworkSignal ComScl_Gw_RawSignal_IMG_CHECKSUM_2F1_u8" UBYTE RB_RBA_Common_CentralElements_CompuMethods_Identical 1 100 0.0 255. FORMAT "%10.0" ECU_ADDRESS 0x6000BBD0 /end MEASUREMENT
/begin MEASUREMENT ComScl_Gw_RawSignal_IMG_DRVTRQ_STATUS_u8 "NetworkSignal ComScl_Gw_RawSignal_IMG_DRVTRQ_STATUS_u8" UBYTE RB_RBA_Common_CentralElements_CompuMethods_Identical 1 100 0.0 255. FORMAT "%10.0" ECU_ADDRESS 0x6000BBE0 /end MEASUREMENT
/begin MEASUREMENT ComScl_Gw_RawSignal_IMG_ENG_CAN_RECIEVE_ERROR_b "NetworkSignal ComScl_Gw_RawSignal_IMG_ENG_CAN_RECIEVE_ERROR_b" UBYTE RB_RBA_Common_CentralElements_CompuMethods_Identical 1 100 0.0 255. FORMAT "%10.0" ECU_ADDRESS 0x6000BBD8 /end MEASUREMENT
/begin MEASUREMENT ComScl_Gw_RawSignal_IMG_F_WVINCLDN_b "NetworkSignal ComScl_Gw_RawSignal_IMG_F_WVINCLDN_b" UBYTE RB_RBA_Common_CentralElements_CompuMethods_Identical 1 100 0.0 255. FORMAT "%10.0" ECU_ADDRESS 0x6000BBCF /end MEASUREMENT
/begin MEASUREMENT ComScl_Gw_RawSignal_IMG_IDS_GRP_A5_MODE_u8 "NetworkSignal ComScl_Gw_RawSignal_IMG_IDS_GRP_A5_MODE_u8" UBYTE RB_RBA_Common_CentralElements_CompuMethods_Identical 1 100 0.0 255. FORMAT "%10.0" ECU_ADDRESS 0x6000BBE3 /end MEASUREMENT
/begin MEASUREMENT ComScl_Gw_RawSignal_IMG_IS_BHOLD_ACT_b "NetworkSignal ComScl_Gw_RawSignal_IMG_IS_BHOLD_ACT_b" UBYTE RB_RBA_Common_CentralElements_CompuMethods_Identical 1 100 0.0 255. FORMAT "%10.0" ECU_ADDRESS 0x6000BBD7 /end MEASUREMENT
/begin MEASUREMENT ComScl_Gw_RawSignal_IMG_IS_BHOLD_STANBY_b "NetworkSignal ComScl_Gw_RawSignal_IMG_IS_BHOLD_STANBY_b" UBYTE RB_RBA_Common_CentralElements_CompuMethods_Identical 1 100 0.0 255. FORMAT "%10.0" ECU_ADDRESS 0x6000BBD6 /end MEASUREMENT
/begin MEASUREMENT ComScl_Gw_RawSignal_IMG_IS_BRKCNT_ADAS_b "NetworkSignal ComScl_Gw_RawSignal_IMG_IS_BRKCNT_ADAS_b" UBYTE RB_RBA_Common_CentralElements_CompuMethods_Identical 1 100 0.0 255. FORMAT "%10.0" ECU_ADDRESS 0x6000BBDF /end MEASUREMENT
/begin MEASUREMENT ComScl_Gw_RawSignal_IMG_IS_INHIBITBRK_b "NetworkSignal ComScl_Gw_RawSignal_IMG_IS_INHIBITBRK_b" UBYTE RB_RBA_Common_CentralElements_CompuMethods_Identical 1 100 0.0 255. FORMAT "%10.0" ECU_ADDRESS 0x6000BBD5 /end MEASUREMENT
/begin MEASUREMENT ComScl_Gw_RawSignal_IMG_IS_RELEASE_REQUEST_b "NetworkSignal ComScl_Gw_RawSignal_IMG_IS_RELEASE_REQUEST_b" UBYTE RB_RBA_Common_CentralElements_CompuMethods_Identical 1 100 0.0 255. FORMAT "%10.0" ECU_ADDRESS 0x6000BBDE /end MEASUREMENT
/begin MEASUREMENT ComScl_Gw_RawSignal_IMG_IS_RESTART_INHIBITBRK_b "NetworkSignal ComScl_Gw_RawSignal_IMG_IS_RESTART_INHIBITBRK_b" UBYTE RB_RBA_Common_CentralElements_CompuMethods_Identical 1 100 0.0 255. FORMAT "%10.0" ECU_ADDRESS 0x6000BBD4 /end MEASUREMENT
/begin MEASUREMENT ComScl_Gw_RawSignal_IMG_IS_SHIFT_INHBITBRK_b "NetworkSignal ComScl_Gw_RawSignal_IMG_IS_SHIFT_INHBITBRK_b" UBYTE RB_RBA_Common_CentralElements_CompuMethods_Identical 1 100 0.0 255. FORMAT "%10.0" ECU_ADDRESS 0x6000BBD3 /end MEASUREMENT
/begin MEASUREMENT ComScl_Gw_RawSignal_IMG_IS_SYSOFFBRK_b "NetworkSignal ComScl_Gw_RawSignal_IMG_IS_SYSOFFBRK_b" UBYTE RB_RBA_Common_CentralElements_CompuMethods_Identical 1 100 0.0 255. FORMAT "%10.0" ECU_ADDRESS 0x6000BBD2 /end MEASUREMENT
/begin MEASUREMENT ComScl_Gw_RawSignal_IMG_LIMTRQ_STATUS_u8 "NetworkSignal ComScl_Gw_RawSignal_IMG_LIMTRQ_STATUS_u8" UBYTE RB_RBA_Common_CentralElements_CompuMethods_Identical 1 100 0.0 255. FORMAT "%10.0" ECU_ADDRESS 0x6000BBDD /end MEASUREMENT
/begin MEASUREMENT ComScl_Gw_RawSignal_IMG_MIL_REQ_b "NetworkSignal ComScl_Gw_RawSignal_IMG_MIL_REQ_b" UBYTE RB_RBA_Common_CentralElements_CompuMethods_Identical 1 100 0.0 255. FORMAT "%10.0" ECU_ADDRESS 0x6000BBE6 /end MEASUREMENT
/begin MEASUREMENT ComScl_Gw_RawSignal_IMG_REQ_BRK_CTRL_b "NetworkSignal ComScl_Gw_RawSignal_IMG_REQ_BRK_CTRL_b" UBYTE RB_RBA_Common_CentralElements_CompuMethods_Identical 1 100 0.0 255. FORMAT "%10.0" ECU_ADDRESS 0x6000BBDC /end MEASUREMENT
/begin MEASUREMENT ComScl_Gw_RawSignal_IMG_REQ_DRVTRQ_s16 "NetworkSignal ComScl_Gw_RawSignal_IMG_REQ_DRVTRQ_s16" SWORD RB_RBA_Common_CentralElements_CompuMethods_Identical 1 100 -32768. 32767. FORMAT "%10.0" ECU_ADDRESS 0x600061C4 /end MEASUREMENT
/begin MEASUREMENT ComScl_Gw_RawSignal_IMG_REQ_LIMTRQ_s16 "NetworkSignal ComScl_Gw_RawSignal_IMG_REQ_LIMTRQ_s16" SWORD RB_RBA_Common_CentralElements_CompuMethods_Identical 1 100 -32768. 32767. FORMAT "%10.0" ECU_ADDRESS 0x600061C2 /end MEASUREMENT
/begin MEASUREMENT ComScl_Gw_RawSignal_IMG_SHIFT_REQUEST_u8 "NetworkSignal ComScl_Gw_RawSignal_IMG_SHIFT_REQUEST_u8" UBYTE RB_RBA_Common_CentralElements_CompuMethods_Identical 1 100 0.0 255. FORMAT "%10.0" ECU_ADDRESS 0x6000BBDB /end MEASUREMENT
/begin MEASUREMENT ComScl_IDAS_RawSignal_IDAS_ALIVE_COUNTER_1EF_u8 "NetworkSignal ComScl_IDAS_RawSignal_IDAS_ALIVE_COUNTER_1EF_u8" UBYTE RB_RBA_Common_CentralElements_CompuMethods_Identical 1 100 0.0 255. FORMAT "%10.0" ECU_ADDRESS 0x6000BBEB /end MEASUREMENT
/begin MEASUREMENT ComScl_IDAS_RawSignal_IDAS_CHECKSUM_1EF_u8 "NetworkSignal ComScl_IDAS_RawSignal_IDAS_CHECKSUM_1EF_u8" UBYTE RB_RBA_Common_CentralElements_CompuMethods_Identical 1 100 0.0 255. FORMAT "%10.0" ECU_ADDRESS 0x6000BBEA /end MEASUREMENT
/begin MEASUREMENT ComScl_IDAS_RawSignal_IDAS_ISA_BASE_SPEED_u8 "NetworkSignal ComScl_IDAS_RawSignal_IDAS_ISA_BASE_SPEED_u8" UBYTE RB_RBA_Common_CentralElements_CompuMethods_Identical 1 100 0.0 255. FORMAT "%10.0" ECU_ADDRESS 0x6000BBE9 /end MEASUREMENT
/begin MEASUREMENT ComScl_PCU_RawSignal_PCU_ALIVE_COUNTER_1FB_u8 "NetworkSignal ComScl_PCU_RawSignal_PCU_ALIVE_COUNTER_1FB_u8" UBYTE RB_RBA_Common_CentralElements_CompuMethods_Identical 1 100 0.0 255. FORMAT "%10.0" ECU_ADDRESS 0x6000BBEE /end MEASUREMENT
/begin MEASUREMENT ComScl_PCU_RawSignal_PCU_CHECKSUM_1FB_u8 "NetworkSignal ComScl_PCU_RawSignal_PCU_CHECKSUM_1FB_u8" UBYTE RB_RBA_Common_CentralElements_CompuMethods_Identical 1 100 0.0 255. FORMAT "%10.0" ECU_ADDRESS 0x6000BBED /end MEASUREMENT
/begin MEASUREMENT ComScl_PCU_RawSignal_PCU_INHBIT_START_ENG_b "NetworkSignal ComScl_PCU_RawSignal_PCU_INHBIT_START_ENG_b" UBYTE RB_RBA_Common_CentralElements_CompuMethods_Identical 1 100 0.0 255. FORMAT "%10.0" ECU_ADDRESS 0x6000BBEC /end MEASUREMENT
/begin MEASUREMENT ComScl_StbIntv_RawSignal_EBB_ALIVE_COUNTER_1D5_u8 "NetworkSignal ComScl_StbIntv_RawSignal_EBB_ALIVE_COUNTER_1D5_u8" UBYTE RB_RBA_Common_CentralElements_CompuMethods_Identical 1 100 0.0 255. FORMAT "%10.0" ECU_ADDRESS 0x6000BBF3 /end MEASUREMENT
/begin MEASUREMENT ComScl_StbIntv_RawSignal_EBB_BRAKE_PEDAL_ON_STATUS_u8 "NetworkSignal ComScl_StbIntv_RawSignal_EBB_BRAKE_PEDAL_ON_STATUS_u8" UBYTE RB_RBA_Common_CentralElements_CompuMethods_Identical 1 100 0.0 255. FORMAT "%10.0" ECU_ADDRESS 0x6000BBF1 /end MEASUREMENT
/begin MEASUREMENT ComScl_StbIntv_RawSignal_EBB_BRAKE_PEDAL_ON_b "NetworkSignal ComScl_StbIntv_RawSignal_EBB_BRAKE_PEDAL_ON_b" UBYTE RB_RBA_Common_CentralElements_CompuMethods_Identical 1 100 0.0 255. FORMAT "%10.0" ECU_ADDRESS 0x6000BBF2 /end MEASUREMENT
/begin MEASUREMENT ComScl_StbIntv_RawSignal_EBB_CHECKSUM_1D5_u8 "NetworkSignal ComScl_StbIntv_RawSignal_EBB_CHECKSUM_1D5_u8" UBYTE RB_RBA_Common_CentralElements_CompuMethods_Identical 1 100 0.0 255. FORMAT "%10.0" ECU_ADDRESS 0x6000BBF0 /end MEASUREMENT
/begin MEASUREMENT ComScl_StbIntv_RawSignal_EBB_STATUS_1D5_u8 "NetworkSignal ComScl_StbIntv_RawSignal_EBB_STATUS_1D5_u8" UBYTE RB_RBA_Common_CentralElements_CompuMethods_Identical 1 100 0.0 255. FORMAT "%10.0" ECU_ADDRESS 0x6000BBEF /end MEASUREMENT
/begin MEASUREMENT ComScl_StbIntv_RawSignal_VSA_ABS_CHECKSUM_1D0_u8 "NetworkSignal ComScl_StbIntv_RawSignal_VSA_ABS_CHECKSUM_1D0_u8" UBYTE RB_RBA_Common_CentralElements_CompuMethods_Identical 1 100 0.0 255. FORMAT "%10.0" ECU_ADDRESS 0x6000BC0A /end MEASUREMENT
/begin MEASUREMENT ComScl_StbIntv_RawSignal_VSA_ABS_CTRL_b "NetworkSignal ComScl_StbIntv_RawSignal_VSA_ABS_CTRL_b" UBYTE RB_RBA_Common_CentralElements_CompuMethods_Identical 1 100 0.0 255. FORMAT "%10.0" ECU_ADDRESS 0x6000BC1A /end MEASUREMENT
/begin MEASUREMENT ComScl_StbIntv_RawSignal_VSA_ABS_EBD_ACT_b "NetworkSignal ComScl_StbIntv_RawSignal_VSA_ABS_EBD_ACT_b" UBYTE RB_RBA_Common_CentralElements_CompuMethods_Identical 1 100 0.0 255. FORMAT "%10.0" ECU_ADDRESS 0x6000BC19 /end MEASUREMENT
/begin MEASUREMENT ComScl_StbIntv_RawSignal_VSA_ABS_EBD_MIL_b "NetworkSignal ComScl_StbIntv_RawSignal_VSA_ABS_EBD_MIL_b" UBYTE RB_RBA_Common_CentralElements_CompuMethods_Identical 1 100 0.0 255. FORMAT "%10.0" ECU_ADDRESS 0x6000BC18 /end MEASUREMENT
/begin MEASUREMENT ComScl_StbIntv_RawSignal_VSA_ABS_FAIL_FL_VW_SENSOR_b "NetworkSignal ComScl_StbIntv_RawSignal_VSA_ABS_FAIL_FL_VW_SENSOR_b" UBYTE RB_RBA_Common_CentralElements_CompuMethods_Identical 1 100 0.0 255. FORMAT "%10.0" ECU_ADDRESS 0x6000BC03 /end MEASUREMENT
/begin MEASUREMENT ComScl_StbIntv_RawSignal_VSA_ABS_FAIL_FR_VW_SENSOR_b "NetworkSignal ComScl_StbIntv_RawSignal_VSA_ABS_FAIL_FR_VW_SENSOR_b" UBYTE RB_RBA_Common_CentralElements_CompuMethods_Identical 1 100 0.0 255. FORMAT "%10.0" ECU_ADDRESS 0x6000BC02 /end MEASUREMENT
/begin MEASUREMENT ComScl_StbIntv_RawSignal_VSA_ABS_FAIL_RL_VW_SENSOR_b "NetworkSignal ComScl_StbIntv_RawSignal_VSA_ABS_FAIL_RL_VW_SENSOR_b" UBYTE RB_RBA_Common_CentralElements_CompuMethods_Identical 1 100 0.0 255. FORMAT "%10.0" ECU_ADDRESS 0x6000BC01 /end MEASUREMENT
/begin MEASUREMENT ComScl_StbIntv_RawSignal_VSA_ABS_FAIL_RR_VW_SENSOR_b "NetworkSignal ComScl_StbIntv_RawSignal_VSA_ABS_FAIL_RR_VW_SENSOR_b" UBYTE RB_RBA_Common_CentralElements_CompuMethods_Identical 1 100 0.0 255. FORMAT "%10.0" ECU_ADDRESS 0x6000BC00 /end MEASUREMENT
/begin MEASUREMENT ComScl_StbIntv_RawSignal_VSA_ABS_FL_WHEEL_SPEED_u16 "NetworkSignal ComScl_StbIntv_RawSignal_VSA_ABS_FL_WHEEL_SPEED_u16" UWORD RB_RBA_Common_CentralElements_CompuMethods_Identical 1 100 0.0 65535. FORMAT "%10.0" ECU_ADDRESS 0x600061D2 /end MEASUREMENT
/begin MEASUREMENT ComScl_StbIntv_RawSignal_VSA_ABS_FR_WHEEL_SPEED_u16 "NetworkSignal ComScl_StbIntv_RawSignal_VSA_ABS_FR_WHEEL_SPEED_u16" UWORD RB_RBA_Common_CentralElements_CompuMethods_Identical 1 100 0.0 65535. FORMAT "%10.0" ECU_ADDRESS 0x600061D0 /end MEASUREMENT
/begin MEASUREMENT ComScl_StbIntv_RawSignal_VSA_ABS_RL_WHEEL_SPEED_u16 "NetworkSignal ComScl_StbIntv_RawSignal_VSA_ABS_RL_WHEEL_SPEED_u16" UWORD RB_RBA_Common_CentralElements_CompuMethods_Identical 1 100 0.0 65535. FORMAT "%10.0" ECU_ADDRESS 0x600061CE /end MEASUREMENT
/begin MEASUREMENT ComScl_StbIntv_RawSignal_VSA_ABS_RR_WHEEL_SPEED_u16 "NetworkSignal ComScl_StbIntv_RawSignal_VSA_ABS_RR_WHEEL_SPEED_u16" UWORD RB_RBA_Common_CentralElements_CompuMethods_Identical 1 100 0.0 65535. FORMAT "%10.0" ECU_ADDRESS 0x600061CC /end MEASUREMENT
/begin MEASUREMENT ComScl_StbIntv_RawSignal_VSA_ACC_BRAKE_ACT_b "NetworkSignal ComScl_StbIntv_RawSignal_VSA_ACC_BRAKE_ACT_b" UBYTE RB_RBA_Common_CentralElements_CompuMethods_Identical 1 100 0.0 255. FORMAT "%10.0" ECU_ADDRESS 0x6000BC17 /end MEASUREMENT
/begin MEASUREMENT ComScl_StbIntv_RawSignal_VSA_ALIVECOUNTER_1AC_u8 "NetworkSignal ComScl_StbIntv_RawSignal_VSA_ALIVECOUNTER_1AC_u8" UBYTE RB_RBA_Common_CentralElements_CompuMethods_Identical 1 100 0.0 255. FORMAT "%10.0" ECU_ADDRESS 0x6000BC09 /end MEASUREMENT
/begin MEASUREMENT ComScl_StbIntv_RawSignal_VSA_ALIVE_COUNTER_12E_u8 "NetworkSignal ComScl_StbIntv_RawSignal_VSA_ALIVE_COUNTER_12E_u8" UBYTE RB_RBA_Common_CentralElements_CompuMethods_Identical 1 100 0.0 255. FORMAT "%10.0" ECU_ADDRESS 0x6000BBF7 /end MEASUREMENT
/begin MEASUREMENT ComScl_StbIntv_RawSignal_VSA_ALIVE_COUNTER_1A4_u8 "NetworkSignal ComScl_StbIntv_RawSignal_VSA_ALIVE_COUNTER_1A4_u8" UBYTE RB_RBA_Common_CentralElements_CompuMethods_Identical 1 100 0.0 255. FORMAT "%10.0" ECU_ADDRESS 0x6000BC16 /end MEASUREMENT
/begin MEASUREMENT ComScl_StbIntv_RawSignal_VSA_ALIVE_COUNTER_1B0_u8 "NetworkSignal ComScl_StbIntv_RawSignal_VSA_ALIVE_COUNTER_1B0_u8" UBYTE RB_RBA_Common_CentralElements_CompuMethods_Identical 1 100 0.0 255. FORMAT "%10.0" ECU_ADDRESS 0x6000BBFF /end MEASUREMENT
/begin MEASUREMENT ComScl_StbIntv_RawSignal_VSA_CASEN_b "NetworkSignal ComScl_StbIntv_RawSignal_VSA_CASEN_b" UBYTE RB_RBA_Common_CentralElements_CompuMethods_Identical 1 100 0.0 255. FORMAT "%10.0" ECU_ADDRESS 0x6000BC15 /end MEASUREMENT
/begin MEASUREMENT ComScl_StbIntv_RawSignal_VSA_CAS_ACT_b "NetworkSignal ComScl_StbIntv_RawSignal_VSA_CAS_ACT_b" UBYTE RB_RBA_Common_CentralElements_CompuMethods_Identical 1 100 0.0 255. FORMAT "%10.0" ECU_ADDRESS 0x6000BC14 /end MEASUREMENT
/begin MEASUREMENT ComScl_StbIntv_RawSignal_VSA_CHECKSUM_12E_u8 "NetworkSignal ComScl_StbIntv_RawSignal_VSA_CHECKSUM_12E_u8" UBYTE RB_RBA_Common_CentralElements_CompuMethods_Identical 1 100 0.0 255. FORMAT "%10.0" ECU_ADDRESS 0x6000BBF6 /end MEASUREMENT
/begin MEASUREMENT ComScl_StbIntv_RawSignal_VSA_CHECKSUM_1A4_u8 "NetworkSignal ComScl_StbIntv_RawSignal_VSA_CHECKSUM_1A4_u8" UBYTE RB_RBA_Common_CentralElements_CompuMethods_Identical 1 100 0.0 255. FORMAT "%10.0" ECU_ADDRESS 0x6000BC13 /end MEASUREMENT
/begin MEASUREMENT ComScl_StbIntv_RawSignal_VSA_CHECKSUM_1AC_u8 "NetworkSignal ComScl_StbIntv_RawSignal_VSA_CHECKSUM_1AC_u8" UBYTE RB_RBA_Common_CentralElements_CompuMethods_Identical 1 100 0.0 255. FORMAT "%10.0" ECU_ADDRESS 0x6000BC08 /end MEASUREMENT
/begin MEASUREMENT ComScl_StbIntv_RawSignal_VSA_CHECKSUM_1B0_u8 "NetworkSignal ComScl_StbIntv_RawSignal_VSA_CHECKSUM_1B0_u8" UBYTE RB_RBA_Common_CentralElements_CompuMethods_Identical 1 100 0.0 255. FORMAT "%10.0" ECU_ADDRESS 0x6000BBFE /end MEASUREMENT
/begin MEASUREMENT ComScl_StbIntv_RawSignal_VSA_DRV_BRKTRQ_AYCI_u16 "NetworkSignal ComScl_StbIntv_RawSignal_VSA_DRV_BRKTRQ_AYCI_u16" UWORD RB_RBA_Common_CentralElements_CompuMethods_Identical 1 100 0.0 65535. FORMAT "%10.0" ECU_ADDRESS 0x600061C6 /end MEASUREMENT
/begin MEASUREMENT ComScl_StbIntv_RawSignal_VSA_DRV_BRKTRQ_u16 "NetworkSignal ComScl_StbIntv_RawSignal_VSA_DRV_BRKTRQ_u16" UWORD RB_RBA_Common_CentralElements_CompuMethods_Identical 1 100 0.0 65535. FORMAT "%10.0" ECU_ADDRESS 0x600061C8 /end MEASUREMENT
/begin MEASUREMENT ComScl_StbIntv_RawSignal_VSA_FAIL_LONG_G_SENSOR_b "NetworkSignal ComScl_StbIntv_RawSignal_VSA_FAIL_LONG_G_SENSOR_b" UBYTE RB_RBA_Common_CentralElements_CompuMethods_Identical 1 100 0.0 255. FORMAT "%10.0" ECU_ADDRESS 0x6000BBFD /end MEASUREMENT
/begin MEASUREMENT ComScl_StbIntv_RawSignal_VSA_FAIL_MC_PRESSURE_SENSOR_b "NetworkSignal ComScl_StbIntv_RawSignal_VSA_FAIL_MC_PRESSURE_SENSOR_b" UBYTE RB_RBA_Common_CentralElements_CompuMethods_Identical 1 100 0.0 255. FORMAT "%10.0" ECU_ADDRESS 0x6000BC12 /end MEASUREMENT
/begin MEASUREMENT ComScl_StbIntv_RawSignal_VSA_FAIL_YAW_RATE_SENSOR_b "NetworkSignal ComScl_StbIntv_RawSignal_VSA_FAIL_YAW_RATE_SENSOR_b" UBYTE RB_RBA_Common_CentralElements_CompuMethods_Identical 1 100 0.0 255. FORMAT "%10.0" ECU_ADDRESS 0x6000BBFC /end MEASUREMENT
/begin MEASUREMENT ComScl_StbIntv_RawSignal_VSA_INHBIT_LAT_G_SENSOR_b "NetworkSignal ComScl_StbIntv_RawSignal_VSA_INHBIT_LAT_G_SENSOR_b" UBYTE RB_RBA_Common_CentralElements_CompuMethods_Identical 1 100 0.0 255. FORMAT "%10.0" ECU_ADDRESS 0x6000BBFB /end MEASUREMENT
/begin MEASUREMENT ComScl_StbIntv_RawSignal_VSA_INHBIT_LONG_G_SENSOR_b "NetworkSignal ComScl_StbIntv_RawSignal_VSA_INHBIT_LONG_G_SENSOR_b" UBYTE RB_RBA_Common_CentralElements_CompuMethods_Identical 1 100 0.0 255. FORMAT "%10.0" ECU_ADDRESS 0x6000BBFA /end MEASUREMENT
/begin MEASUREMENT ComScl_StbIntv_RawSignal_VSA_INHBIT_MC_PRESSURE_SENSOR_b "NetworkSignal ComScl_StbIntv_RawSignal_VSA_INHBIT_MC_PRESSURE_SENSOR_b" UBYTE RB_RBA_Common_CentralElements_CompuMethods_Identical 1 100 0.0 255. FORMAT "%10.0" ECU_ADDRESS 0x6000BC11 /end MEASUREMENT
/begin MEASUREMENT ComScl_StbIntv_RawSignal_VSA_INHBIT_STEERING_SENSOR_b "NetworkSignal ComScl_StbIntv_RawSignal_VSA_INHBIT_STEERING_SENSOR_b" UBYTE RB_RBA_Common_CentralElements_CompuMethods_Identical 1 100 0.0 255. FORMAT "%10.0" ECU_ADDRESS 0x6000BBF9 /end MEASUREMENT
/begin MEASUREMENT ComScl_StbIntv_RawSignal_VSA_INHBIT_YAW_RATE_SENSOR_b "NetworkSignal ComScl_StbIntv_RawSignal_VSA_INHBIT_YAW_RATE_SENSOR_b" UBYTE RB_RBA_Common_CentralElements_CompuMethods_Identical 1 100 0.0 255. FORMAT "%10.0" ECU_ADDRESS 0x6000BBF8 /end MEASUREMENT
/begin MEASUREMENT ComScl_StbIntv_RawSignal_VSA_ISAB_ACT_b "NetworkSignal ComScl_StbIntv_RawSignal_VSA_ISAB_ACT_b" UBYTE RB_RBA_Common_CentralElements_CompuMethods_Identical 1 100 0.0 255. FORMAT "%10.0" ECU_ADDRESS 0x6000BBF5 /end MEASUREMENT
/begin MEASUREMENT ComScl_StbIntv_RawSignal_VSA_ISAB_ENABLE_b "NetworkSignal ComScl_StbIntv_RawSignal_VSA_ISAB_ENABLE_b" UBYTE RB_RBA_Common_CentralElements_CompuMethods_Identical 1 100 0.0 255. FORMAT "%10.0" ECU_ADDRESS 0x6000BBF4 /end MEASUREMENT
/begin MEASUREMENT ComScl_StbIntv_RawSignal_VSA_LAMP_STATUS_VSA_OFF_b "NetworkSignal ComScl_StbIntv_RawSignal_VSA_LAMP_STATUS_VSA_OFF_b" UBYTE RB_RBA_Common_CentralElements_CompuMethods_Identical 1 100 0.0 255. FORMAT "%10.0" ECU_ADDRESS 0x6000BC10 /end MEASUREMENT
/begin MEASUREMENT ComScl_StbIntv_RawSignal_VSA_MASTER_CYLINDER_PRESSURE_u16 "NetworkSignal ComScl_StbIntv_RawSignal_VSA_MASTER_CYLINDER_PRESSURE_u16" UWORD RB_RBA_Common_CentralElements_CompuMethods_Identical 1 100 0.0 65535. FORMAT "%10.0" ECU_ADDRESS 0x600061D4 /end MEASUREMENT
/begin MEASUREMENT ComScl_StbIntv_RawSignal_VSA_REQ_MSR_PLUS_TRQ_b "NetworkSignal ComScl_StbIntv_RawSignal_VSA_REQ_MSR_PLUS_TRQ_b" UBYTE RB_RBA_Common_CentralElements_CompuMethods_Identical 1 100 0.0 255. FORMAT "%10.0" ECU_ADDRESS 0x6000BC07 /end MEASUREMENT
/begin MEASUREMENT ComScl_StbIntv_RawSignal_VSA_REQ_TRQ_1AC_s16 "NetworkSignal ComScl_StbIntv_RawSignal_VSA_REQ_TRQ_1AC_s16" SWORD RB_RBA_Common_CentralElements_CompuMethods_Identical 1 100 -32768. 32767. FORMAT "%10.0" ECU_ADDRESS 0x600061CA /end MEASUREMENT
/begin MEASUREMENT ComScl_StbIntv_RawSignal_VSA_REWRITE_START_b "NetworkSignal ComScl_StbIntv_RawSignal_VSA_REWRITE_START_b" UBYTE RB_RBA_Common_CentralElements_CompuMethods_Identical 1 100 0.0 255. FORMAT "%10.0" ECU_ADDRESS 0x6000BC0F /end MEASUREMENT
/begin MEASUREMENT ComScl_StbIntv_RawSignal_VSA_SHIFT_REQ_1AC_u8 "NetworkSignal ComScl_StbIntv_RawSignal_VSA_SHIFT_REQ_1AC_u8" UBYTE RB_RBA_Common_CentralElements_CompuMethods_Identical 1 100 0.0 255. FORMAT "%10.0" ECU_ADDRESS 0x6000BC06 /end MEASUREMENT
/begin MEASUREMENT ComScl_StbIntv_RawSignal_VSA_TRQ_CONTROL_MODE_u8 "NetworkSignal ComScl_StbIntv_RawSignal_VSA_TRQ_CONTROL_MODE_u8" UBYTE RB_RBA_Common_CentralElements_CompuMethods_Identical 1 100 0.0 255. FORMAT "%10.0" ECU_ADDRESS 0x6000BC05 /end MEASUREMENT
/begin MEASUREMENT ComScl_StbIntv_RawSignal_VSA_TRQ_DOWN_REQ_FUEL_CUT_u8 "NetworkSignal ComScl_StbIntv_RawSignal_VSA_TRQ_DOWN_REQ_FUEL_CUT_u8" UBYTE RB_RBA_Common_CentralElements_CompuMethods_Identical 1 100 0.0 255. FORMAT "%10.0" ECU_ADDRESS 0x6000BC04 /end MEASUREMENT
/begin MEASUREMENT ComScl_StbIntv_RawSignal_VSA_VSA_CTRL_b "NetworkSignal ComScl_StbIntv_RawSignal_VSA_VSA_CTRL_b" UBYTE RB_RBA_Common_CentralElements_CompuMethods_Identical 1 100 0.0 255. FORMAT "%10.0" ECU_ADDRESS 0x6000BC0E /end MEASUREMENT
/begin MEASUREMENT ComScl_StbIntv_RawSignal_VSA_VSA_TCS_ACT_b "NetworkSignal ComScl_StbIntv_RawSignal_VSA_VSA_TCS_ACT_b" UBYTE RB_RBA_Common_CentralElements_CompuMethods_Identical 1 100 0.0 255. FORMAT "%10.0" ECU_ADDRESS 0x6000BC0D /end MEASUREMENT
/begin MEASUREMENT ComScl_StbIntv_RawSignal_VSA_VSA_TCS_MIL_b "NetworkSignal ComScl_StbIntv_RawSignal_VSA_VSA_TCS_MIL_b" UBYTE RB_RBA_Common_CentralElements_CompuMethods_Identical 1 100 0.0 255. FORMAT "%10.0" ECU_ADDRESS 0x6000BC0C /end MEASUREMENT
/begin MEASUREMENT ComScl_StbIntv_RawSignal_VSA_WARN_STATUS_ABS_b "NetworkSignal ComScl_StbIntv_RawSignal_VSA_WARN_STATUS_ABS_b" UBYTE RB_RBA_Common_CentralElements_CompuMethods_Identical 1 100 0.0 255. FORMAT "%10.0" ECU_ADDRESS 0x6000BC0B /end MEASUREMENT
/begin MEASUREMENT ComScl_Strg_RawSignal_EPS_ALIVE_COUNTER_1AB_u8 "NetworkSignal ComScl_Strg_RawSignal_EPS_ALIVE_COUNTER_1AB_u8" UBYTE RB_RBA_Common_CentralElements_CompuMethods_Identical 1 100 0.0 255. FORMAT "%10.0" ECU_ADDRESS 0x6000BC1F /end MEASUREMENT
/begin MEASUREMENT ComScl_Strg_RawSignal_EPS_CHECKSUM_1AB_u8 "NetworkSignal ComScl_Strg_RawSignal_EPS_CHECKSUM_1AB_u8" UBYTE RB_RBA_Common_CentralElements_CompuMethods_Identical 1 100 0.0 255. FORMAT "%10.0" ECU_ADDRESS 0x6000BC1E /end MEASUREMENT
/begin MEASUREMENT ComScl_Strg_RawSignal_EPS_IS_RELEASE_REQUEST_b "NetworkSignal ComScl_Strg_RawSignal_EPS_IS_RELEASE_REQUEST_b" UBYTE RB_RBA_Common_CentralElements_CompuMethods_Identical 1 100 0.0 255. FORMAT "%10.0" ECU_ADDRESS 0x6000BC1D /end MEASUREMENT
/begin MEASUREMENT ComScl_Strg_RawSignal_EPS_IS_SHIFT_INHIBIT_REQUEST_b "NetworkSignal ComScl_Strg_RawSignal_EPS_IS_SHIFT_INHIBIT_REQUEST_b" UBYTE RB_RBA_Common_CentralElements_CompuMethods_Identical 1 100 0.0 255. FORMAT "%10.0" ECU_ADDRESS 0x6000BC1C /end MEASUREMENT
/begin MEASUREMENT ComScl_Strg_RawSignal_EPS_LOAD_u16 "NetworkSignal ComScl_Strg_RawSignal_EPS_LOAD_u16" UWORD RB_RBA_Common_CentralElements_CompuMethods_Identical 1 100 0.0 65535. FORMAT "%10.0" ECU_ADDRESS 0x600061D6 /end MEASUREMENT
/begin MEASUREMENT ComScl_Strg_RawSignal_EPS_MID_REQ_b "NetworkSignal ComScl_Strg_RawSignal_EPS_MID_REQ_b" UBYTE RB_RBA_Common_CentralElements_CompuMethods_Identical 1 100 0.0 255. FORMAT "%10.0" ECU_ADDRESS 0x6000BC1B /end MEASUREMENT
/begin MEASUREMENT rba_Dme_Ovl_stEnable "Overlay state" UBYTE RB_RBA_Common_CentralElements_CompuMethods_Identical 1 100 0.0 255. FORMAT "%5.0" ECU_ADDRESS 0x6000E45F /end MEASUREMENT
/begin MEASUREMENT rba_Dme_adrError "address of vector causing error" ULONG RB_RBA_Common_CentralElements_CompuMethods_Identical 1 100 0.0 4.E9 FORMAT "%10.0" ECU_ADDRESS 0x60001DE4 /end MEASUREMENT
/begin MEASUREMENT rba_Dme_numBytesAvailable "number of bytes available for calibration" ULONG RB_RBA_Common_CentralElements_CompuMethods_Identical 1 100 0.0 4.E9 FORMAT "%10.0" ECU_ADDRESS 0x60001DEC /end MEASUREMENT
/begin MEASUREMENT rba_Dme_numBytesAvailableOvl "number of bytes available for calibration" ULONG RB_RBA_Common_CentralElements_CompuMethods_Identical 1 100 0.0 4.E9 FORMAT "%10.0" ECU_ADDRESS 0x60001DE8 /end MEASUREMENT
/begin MEASUREMENT rba_IoExtLib_KeepAliveDrvErrCyc_u32 "KeepAlive measurement variable" ULONG RB_RBA_Common_CentralElements_CompuMethods_Identical 1 100 0.0 4.E9 FORMAT "%9.0" ECU_ADDRESS 0x600340C0 /end MEASUREMENT
/begin MEASUREMENT rba_IoExtLib_KeepAliveDrvErrPerm_u32 "KeepAlive measurement variable" ULONG RB_RBA_Common_CentralElements_CompuMethods_Identical 1 100 0.0 4.E9 FORMAT "%9.0" ECU_ADDRESS 0x60034244 /end MEASUREMENT
/begin MEASUREMENT rba_IoExtLib_KeepAliveIniErrCyc_u32 "KeepAlive measurement variable" ULONG RB_RBA_Common_CentralElements_CompuMethods_Identical 1 100 0.0 4.E9 FORMAT "%9.0" ECU_ADDRESS 0x600340BC /end MEASUREMENT
/begin MEASUREMENT rba_IoExtLib_KeepAliveIniErrPerm_u32 "KeepAlive measurement variable" ULONG RB_RBA_Common_CentralElements_CompuMethods_Identical 1 100 0.0 4.E9 FORMAT "%9.0" ECU_ADDRESS 0x60034240 /end MEASUREMENT
/begin MEASUREMENT rba_OsShell_Cntr1000msTask "OS task counter for the OS_1000ms_Task" UWORD RB_RBA_Common_CentralElements_CompuMethods_Identical 1 100 0.0 65535. FORMAT "%5.0" ECU_ADDRESS 0x6000F33C /end MEASUREMENT
/begin MEASUREMENT rba_OsShell_Cntr100msTask "OS task counter for the OS_100ms_Task" UWORD RB_RBA_Common_CentralElements_CompuMethods_Identical 1 100 0.0 65535. FORMAT "%5.0" ECU_ADDRESS 0x6000F332 /end MEASUREMENT
/begin MEASUREMENT rba_OsShell_Cntr10msTask "OS task counter for the OS_10ms_Task" UWORD RB_RBA_Common_CentralElements_CompuMethods_Identical 1 100 0.0 65535. FORMAT "%5.0" ECU_ADDRESS 0x6000F32C /end MEASUREMENT
/begin MEASUREMENT rba_OsShell_Cntr1msTask "OS task counter for the OS_1ms_Task" UWORD RB_RBA_Common_CentralElements_CompuMethods_Identical 1 100 0.0 65535. FORMAT "%5.0" ECU_ADDRESS 0x6000F310 /end MEASUREMENT
/begin MEASUREMENT rba_OsShell_Cntr200msTask "OS task counter for the OS_200ms_Task" UWORD RB_RBA_Common_CentralElements_CompuMethods_Identical 1 100 0.0 65535. FORMAT "%5.0" ECU_ADDRESS 0x6000F334 /end MEASUREMENT
/begin MEASUREMENT rba_OsShell_Cntr20msTask "OS task counter for the OS_20ms_Task" UWORD RB_RBA_Common_CentralElements_CompuMethods_Identical 1 100 0.0 65535. FORMAT "%5.0" ECU_ADDRESS 0x6000F32E /end MEASUREMENT
/begin MEASUREMENT rba_OsShell_Cntr2msTask "OS task counter for the OS_2ms_Task" UWORD RB_RBA_Common_CentralElements_CompuMethods_Identical 1 100 0.0 65535. FORMAT "%5.0" ECU_ADDRESS 0x6000F320 /end MEASUREMENT
/begin MEASUREMENT rba_OsShell_Cntr50msTask "OS task counter for the OS_50ms_Task" UWORD RB_RBA_Common_CentralElements_CompuMethods_Identical 1 100 0.0 65535. FORMAT "%5.0" ECU_ADDRESS 0x6000F330 /end MEASUREMENT
/begin MEASUREMENT rba_OsShell_Cntr5msTask "OS task counter for the OS_5ms_Task" UWORD RB_RBA_Common_CentralElements_CompuMethods_Identical 1 100 0.0 65535. FORMAT "%5.0" ECU_ADDRESS 0x7000473E /end MEASUREMENT
/begin MEASUREMENT rba_OsShell_CntrAsw1BgTask "OS task counter for the OS_Asw1Bg_Task" UWORD RB_RBA_Common_CentralElements_CompuMethods_Identical 1 100 0.0 65535. FORMAT "%5.0" ECU_ADDRESS 0x6000F34E /end MEASUREMENT
/begin MEASUREMENT rba_OsShell_CntrAsw2BgTask "OS task counter for the OS_Asw2Bg_Task" UWORD RB_RBA_Common_CentralElements_CompuMethods_Identical 1 100 0.0 65535. FORMAT "%5.0" ECU_ADDRESS 0x50007D70 /end MEASUREMENT
/begin MEASUREMENT rba_OsShell_CntrBswBgTask "OS task counter for the OS_BswBg_Task" UWORD RB_RBA_Common_CentralElements_CompuMethods_Identical 1 100 0.0 65535. FORMAT "%5.0" ECU_ADDRESS 0x7000474E /end MEASUREMENT
/begin MEASUREMENT rba_OsShell_CntrCalWup100msTask "OS task counter for the OS_CalWup_100ms_Task" UWORD RB_RBA_Common_CentralElements_CompuMethods_Identical 1 100 0.0 65535. FORMAT "%5.0" ECU_ADDRESS 0x70004746 /end MEASUREMENT
/begin MEASUREMENT rba_OsShell_CntrCalWup10msTask "OS task counter for the OS_CalWup_10ms_Task" UWORD RB_RBA_Common_CentralElements_CompuMethods_Identical 1 100 0.0 65535. FORMAT "%5.0" ECU_ADDRESS 0x70004742 /end MEASUREMENT
/begin MEASUREMENT rba_OsShell_CntrCalWup20msTask "OS task counter for the OS_CalWup_20ms_Task" UWORD RB_RBA_Common_CentralElements_CompuMethods_Identical 1 100 0.0 65535. FORMAT "%5.0" ECU_ADDRESS 0x70004744 /end MEASUREMENT
/begin MEASUREMENT rba_OsShell_CntrCalWup2msTask "OS task counter for the OS_CalWup_2ms_Task" UWORD RB_RBA_Common_CentralElements_CompuMethods_Identical 1 100 0.0 65535. FORMAT "%5.0" ECU_ADDRESS 0x7000473C /end MEASUREMENT
/begin MEASUREMENT rba_OsShell_CntrCalWupAsw110msTask "OS task counter for the OS_CalWupAsw1_10ms_Task" UWORD RB_RBA_Common_CentralElements_CompuMethods_Identical 1 100 0.0 65535. FORMAT "%5.0" ECU_ADDRESS 0x6000F32A /end MEASUREMENT
/begin MEASUREMENT rba_OsShell_CntrCalWupAsw210msTask "OS task counter for the OS_CalWupAsw2_10ms_Task" UWORD RB_RBA_Common_CentralElements_CompuMethods_Identical 1 100 0.0 65535. FORMAT "%5.0" ECU_ADDRESS 0x50007D6A /end MEASUREMENT
/begin MEASUREMENT rba_OsShell_CntrCalWupBgTask "OS task counter for the OS_CalWup_Bg_Task" UWORD RB_RBA_Common_CentralElements_CompuMethods_Identical 1 100 0.0 65535. FORMAT "%5.0" ECU_ADDRESS 0x7000474C /end MEASUREMENT
/begin MEASUREMENT rba_OsShell_CntrCalWupIniEndTask "OS task counter for the OS_CalWup_IniEnd_Task" UWORD RB_RBA_Common_CentralElements_CompuMethods_Identical 1 100 0.0 65535. FORMAT "%5.0" ECU_ADDRESS 0x7000474A /end MEASUREMENT
/begin MEASUREMENT rba_OsShell_CntrCalWupIniTask "OS task counter for the OS_CalWup_Ini_Task" UWORD RB_RBA_Common_CentralElements_CompuMethods_Identical 1 100 0.0 65535. FORMAT "%5.0" ECU_ADDRESS 0x70004748 /end MEASUREMENT
/begin MEASUREMENT rba_OsShell_CntrDSMClearTask "OS task counter for the OS_DSM_Clear_Task" UWORD RB_RBA_Common_CentralElements_CompuMethods_Identical 1 100 0.0 65535. FORMAT "%5.0" ECU_ADDRESS 0x6000F33A /end MEASUREMENT
/begin MEASUREMENT rba_OsShell_CntrDSMReiniTask "OS task counter for the OS_DSM_Reini_Task" UWORD RB_RBA_Common_CentralElements_CompuMethods_Identical 1 100 0.0 65535. FORMAT "%5.0" ECU_ADDRESS 0x6000F34C /end MEASUREMENT
/begin MEASUREMENT rba_OsShell_CntrEngReStrtDummyTask "OS task counter for the OS_EngReStrt_Dummy_Task" UWORD RB_RBA_Common_CentralElements_CompuMethods_Identical 1 100 0.0 65535. FORMAT "%5.0" ECU_ADDRESS 0x6000F31C /end MEASUREMENT
/begin MEASUREMENT rba_OsShell_CntrEngReStrtModeMTask "OS task counter for the OS_EngReStrtModeM_Task" UWORD RB_RBA_Common_CentralElements_CompuMethods_Identical 1 100 0.0 65535. FORMAT "%5.0" ECU_ADDRESS 0x6000F34A /end MEASUREMENT
/begin MEASUREMENT rba_OsShell_CntrEngReStrtTask "OS task counter for the OS_EngReStrt_Task" UWORD RB_RBA_Common_CentralElements_CompuMethods_Identical 1 100 0.0 65535. FORMAT "%5.0" ECU_ADDRESS 0x50007D64 /end MEASUREMENT
/begin MEASUREMENT rba_OsShell_CntrEpmNoSyncTask "OS task counter for the OS_EpmNoSync_Task" UWORD RB_RBA_Common_CentralElements_CompuMethods_Identical 1 100 0.0 65535. FORMAT "%5.0" ECU_ADDRESS 0x50007D62 /end MEASUREMENT
/begin MEASUREMENT rba_OsShell_CntrErrLimit1000msTask "Limit error counter for OS_1000ms_Task" UBYTE RB_RBA_Common_CentralElements_CompuMethods_Identical 1 100 0.0 255. FORMAT "%5.0" ECU_ADDRESS 0x6000B549 /end MEASUREMENT
/begin MEASUREMENT rba_OsShell_CntrErrLimit100msTask "Limit error counter for OS_100ms_Task" UBYTE RB_RBA_Common_CentralElements_CompuMethods_Identical 1 100 0.0 255. FORMAT "%5.0" ECU_ADDRESS 0x6000B544 /end MEASUREMENT
/begin MEASUREMENT rba_OsShell_CntrErrLimit10msTask "Limit error counter for OS_10ms_Task" UBYTE RB_RBA_Common_CentralElements_CompuMethods_Identical 1 100 0.0 255. FORMAT "%5.0" ECU_ADDRESS 0x6000B53E /end MEASUREMENT
/begin MEASUREMENT rba_OsShell_CntrErrLimit1msTask "Limit error counter for OS_1ms_Task" UBYTE RB_RBA_Common_CentralElements_CompuMethods_Identical 1 100 0.0 255. FORMAT "%5.0" ECU_ADDRESS 0x6000B521 /end MEASUREMENT
/begin MEASUREMENT rba_OsShell_CntrErrLimit200msTask "Limit error counter for OS_200ms_Task" UBYTE RB_RBA_Common_CentralElements_CompuMethods_Identical 1 100 0.0 255. FORMAT "%5.0" ECU_ADDRESS 0x6000B545 /end MEASUREMENT
/begin MEASUREMENT rba_OsShell_CntrErrLimit20msTask "Limit error counter for OS_20ms_Task" UBYTE RB_RBA_Common_CentralElements_CompuMethods_Identical 1 100 0.0 255. FORMAT "%5.0" ECU_ADDRESS 0x6000B540 /end MEASUREMENT
/begin MEASUREMENT rba_OsShell_CntrErrLimit2msTask "Limit error counter for OS_2ms_Task" UBYTE RB_RBA_Common_CentralElements_CompuMethods_Identical 1 100 0.0 255. FORMAT "%5.0" ECU_ADDRESS 0x6000B532 /end MEASUREMENT
/begin MEASUREMENT rba_OsShell_CntrErrLimit50msTask "Limit error counter for OS_50ms_Task" UBYTE RB_RBA_Common_CentralElements_CompuMethods_Identical 1 100 0.0 255. FORMAT "%5.0" ECU_ADDRESS 0x6000B541 /end MEASUREMENT
/begin MEASUREMENT rba_OsShell_CntrErrLimit5msTask "Limit error counter for OS_5ms_Task" UBYTE RB_RBA_Common_CentralElements_CompuMethods_Identical 1 100 0.0 255. FORMAT "%5.0" ECU_ADDRESS 0x6000B534 /end MEASUREMENT
/begin MEASUREMENT rba_OsShell_CntrErrLimitAsw1BgTask "Limit error counter for OS_Asw1Bg_Task" UBYTE RB_RBA_Common_CentralElements_CompuMethods_Identical 1 100 0.0 255. FORMAT "%5.0" ECU_ADDRESS 0x6000B558 /end MEASUREMENT
/begin MEASUREMENT rba_OsShell_CntrErrLimitAsw2BgTask "Limit error counter for OS_Asw2Bg_Task" UBYTE RB_RBA_Common_CentralElements_CompuMethods_Identical 1 100 0.0 255. FORMAT "%5.0" ECU_ADDRESS 0x6000B557 /end MEASUREMENT
/begin MEASUREMENT rba_OsShell_CntrErrLimitBswBgTask "Limit error counter for OS_BswBg_Task" UBYTE RB_RBA_Common_CentralElements_CompuMethods_Identical 1 100 0.0 255. FORMAT "%5.0" ECU_ADDRESS 0x6000B556 /end MEASUREMENT
/begin MEASUREMENT rba_OsShell_CntrErrLimitCalWup100msTask "Limit error counter for OS_CalWup_100ms_Task" UBYTE RB_RBA_Common_CentralElements_CompuMethods_Identical 1 100 0.0 255. FORMAT "%5.0" ECU_ADDRESS 0x6000B543 /end MEASUREMENT
/begin MEASUREMENT rba_OsShell_CntrErrLimitCalWup10msTask "Limit error counter for OS_CalWup_10ms_Task" UBYTE RB_RBA_Common_CentralElements_CompuMethods_Identical 1 100 0.0 255. FORMAT "%5.0" ECU_ADDRESS 0x6000B53B /end MEASUREMENT
/begin MEASUREMENT rba_OsShell_CntrErrLimitCalWup20msTask "Limit error counter for OS_CalWup_20ms_Task" UBYTE RB_RBA_Common_CentralElements_CompuMethods_Identical 1 100 0.0 255. FORMAT "%5.0" ECU_ADDRESS 0x6000B53F /end MEASUREMENT
/begin MEASUREMENT rba_OsShell_CntrErrLimitCalWup2msTask "Limit error counter for OS_CalWup_2ms_Task" UBYTE RB_RBA_Common_CentralElements_CompuMethods_Identical 1 100 0.0 255. FORMAT "%5.0" ECU_ADDRESS 0x6000B531 /end MEASUREMENT
/begin MEASUREMENT rba_OsShell_CntrErrLimitCalWupAsw110msTask "Limit error counter for OS_CalWupAsw1_10ms_Task" UBYTE RB_RBA_Common_CentralElements_CompuMethods_Identical 1 100 0.0 255. FORMAT "%5.0" ECU_ADDRESS 0x6000B53D /end MEASUREMENT
/begin MEASUREMENT rba_OsShell_CntrErrLimitCalWupAsw210msTask "Limit error counter for OS_CalWupAsw2_10ms_Task" UBYTE RB_RBA_Common_CentralElements_CompuMethods_Identical 1 100 0.0 255. FORMAT "%5.0" ECU_ADDRESS 0x6000B53C /end MEASUREMENT
/begin MEASUREMENT rba_OsShell_CntrErrLimitCalWupBgTask "Limit error counter for OS_CalWup_Bg_Task" UBYTE RB_RBA_Common_CentralElements_CompuMethods_Identical 1 100 0.0 255. FORMAT "%5.0" ECU_ADDRESS 0x6000B555 /end MEASUREMENT
/begin MEASUREMENT rba_OsShell_CntrErrLimitCalWupIniEndTask "Limit error counter for OS_CalWup_IniEnd_Task" UBYTE RB_RBA_Common_CentralElements_CompuMethods_Identical 1 100 0.0 255. FORMAT "%5.0" ECU_ADDRESS 0x6000B554 /end MEASUREMENT
/begin MEASUREMENT rba_OsShell_CntrErrLimitCalWupIniTask "Limit error counter for OS_CalWup_Ini_Task" UBYTE RB_RBA_Common_CentralElements_CompuMethods_Identical 1 100 0.0 255. FORMAT "%5.0" ECU_ADDRESS 0x6000B553 /end MEASUREMENT
/begin MEASUREMENT rba_OsShell_CntrErrLimitDSMClearTask "Limit error counter for OS_DSM_Clear_Task" UBYTE RB_RBA_Common_CentralElements_CompuMethods_Identical 1 100 0.0 255. FORMAT "%5.0" ECU_ADDRESS 0x6000B548 /end MEASUREMENT
/begin MEASUREMENT rba_OsShell_CntrErrLimitDSMReiniTask "Limit error counter for OS_DSM_Reini_Task" UBYTE RB_RBA_Common_CentralElements_CompuMethods_Identical 1 100 0.0 255. FORMAT "%5.0" ECU_ADDRESS 0x6000B552 /end MEASUREMENT
/begin MEASUREMENT rba_OsShell_CntrErrLimitEngReStrtDummyTask "Limit error counter for OS_EngReStrt_Dummy_Task" UBYTE RB_RBA_Common_CentralElements_CompuMethods_Identical 1 100 0.0 255. FORMAT "%5.0" ECU_ADDRESS 0x6000B52F /end MEASUREMENT
/begin MEASUREMENT rba_OsShell_CntrErrLimitEngReStrtModeMTask "Limit error counter for OS_EngReStrtModeM_Task" UBYTE RB_RBA_Common_CentralElements_CompuMethods_Identical 1 100 0.0 255. FORMAT "%5.0" ECU_ADDRESS 0x6000B551 /end MEASUREMENT
/begin MEASUREMENT rba_OsShell_CntrErrLimitEngReStrtTask "Limit error counter for OS_EngReStrt_Task" UBYTE RB_RBA_Common_CentralElements_CompuMethods_Identical 1 100 0.0 255. FORMAT "%5.0" ECU_ADDRESS 0x6000B52E /end MEASUREMENT
/begin MEASUREMENT rba_OsShell_CntrErrLimitEpmNoSyncTask "Limit error counter for OS_EpmNoSync_Task" UBYTE RB_RBA_Common_CentralElements_CompuMethods_Identical 1 100 0.0 255. FORMAT "%5.0" ECU_ADDRESS 0x6000B52D /end MEASUREMENT
/begin MEASUREMENT rba_OsShell_CntrErrLimitInfraAsw1App10msTask "Limit error counter for OS_InfraAsw1App_10ms_Task" UBYTE RB_RBA_Common_CentralElements_CompuMethods_Identical 1 100 0.0 255. FORMAT "%5.0" ECU_ADDRESS 0x6000B53A /end MEASUREMENT
/begin MEASUREMENT rba_OsShell_CntrErrLimitInfraAsw2App10msTask "Limit error counter for OS_InfraAsw2App_10ms_Task" UBYTE RB_RBA_Common_CentralElements_CompuMethods_Identical 1 100 0.0 255. FORMAT "%5.0" ECU_ADDRESS 0x6000B539 /end MEASUREMENT
/begin MEASUREMENT rba_OsShell_CntrErrLimitInfraBswApp10msTask "Limit error counter for OS_InfraBswApp_10ms_Task" UBYTE RB_RBA_Common_CentralElements_CompuMethods_Identical 1 100 0.0 255. FORMAT "%5.0" ECU_ADDRESS 0x6000B538 /end MEASUREMENT
/begin MEASUREMENT rba_OsShell_CntrErrLimitIniDrvTask "Limit error counter for OS_IniDrv_Task" UBYTE RB_RBA_Common_CentralElements_CompuMethods_Identical 1 100 0.0 255. FORMAT "%5.0" ECU_ADDRESS 0x6000B547 /end MEASUREMENT
/begin MEASUREMENT rba_OsShell_CntrErrLimitIniEndTask "Limit error counter for OS_IniEnd_Task" UBYTE RB_RBA_Common_CentralElements_CompuMethods_Identical 1 100 0.0 255. FORMAT "%5.0" ECU_ADDRESS 0x6000B550 /end MEASUREMENT
/begin MEASUREMENT rba_OsShell_CntrErrLimitIniTask "Limit error counter for OS_Ini_Task" UBYTE RB_RBA_Common_CentralElements_CompuMethods_Identical 1 100 0.0 255. FORMAT "%5.0" ECU_ADDRESS 0x6000B54F /end MEASUREMENT
/begin MEASUREMENT rba_OsShell_CntrErrLimitMoSyncFirstTask "Limit error counter for OS_Mo_SyncFirst_Task" UBYTE RB_RBA_Common_CentralElements_CompuMethods_Identical 1 100 0.0 255. FORMAT "%5.0" ECU_ADDRESS 0x6000B52C /end MEASUREMENT
/begin MEASUREMENT rba_OsShell_CntrErrLimitMoSyncIniTask "Limit error counter for OS_Mo_SyncIni_Task" UBYTE RB_RBA_Common_CentralElements_CompuMethods_Identical 1 100 0.0 255. FORMAT "%5.0" ECU_ADDRESS 0x6000B52B /end MEASUREMENT
/begin MEASUREMENT rba_OsShell_CntrErrLimitMoSyncS0Task "Limit error counter for OS_Mo_SyncS0_Task" UBYTE RB_RBA_Common_CentralElements_CompuMethods_Identical 1 100 0.0 255. FORMAT "%5.0" ECU_ADDRESS 0x6000B52A /end MEASUREMENT
/begin MEASUREMENT rba_OsShell_CntrErrLimitMoSyncS1Task "Limit error counter for OS_Mo_SyncS1_Task" UBYTE RB_RBA_Common_CentralElements_CompuMethods_Identical 1 100 0.0 255. FORMAT "%5.0" ECU_ADDRESS 0x6000B529 /end MEASUREMENT
/begin MEASUREMENT rba_OsShell_CntrErrLimitMoTask "Limit error counter for OS_Mo_Task" UBYTE RB_RBA_Common_CentralElements_CompuMethods_Identical 1 100 0.0 255. FORMAT "%5.0" ECU_ADDRESS 0x6000B522 /end MEASUREMENT
/begin MEASUREMENT rba_OsShell_CntrErrLimitReIniModeMTask "Limit error counter for OS_ReIniModeM_Task" UBYTE RB_RBA_Common_CentralElements_CompuMethods_Identical 1 100 0.0 255. FORMAT "%5.0" ECU_ADDRESS 0x6000B54E /end MEASUREMENT
/begin MEASUREMENT rba_OsShell_CntrErrLimitReIniTask "Limit error counter for OS_ReIni_Task" UBYTE RB_RBA_Common_CentralElements_CompuMethods_Identical 1 100 0.0 255. FORMAT "%5.0" ECU_ADDRESS 0x6000B546 /end MEASUREMENT
/begin MEASUREMENT rba_OsShell_CntrErrLimitShutdown10msTask "Limit error counter for OS_Shutdown_10ms_Task" UBYTE RB_RBA_Common_CentralElements_CompuMethods_Identical 1 100 0.0 255. FORMAT "%5.0" ECU_ADDRESS 0x6000B51B /end MEASUREMENT
/begin MEASUREMENT rba_OsShell_CntrErrLimitShutdownAsw1Task "Limit error counter for OS_Shutdown_Asw1_Task" UBYTE RB_RBA_Common_CentralElements_CompuMethods_Identical 1 100 0.0 255. FORMAT "%5.0" ECU_ADDRESS 0x6000B51F /end MEASUREMENT
/begin MEASUREMENT rba_OsShell_CntrErrLimitShutdownAsw2Task "Limit error counter for OS_Shutdown_Asw2_Task" UBYTE RB_RBA_Common_CentralElements_CompuMethods_Identical 1 100 0.0 255. FORMAT "%5.0" ECU_ADDRESS 0x6000B51E /end MEASUREMENT
/begin MEASUREMENT rba_OsShell_CntrErrLimitShutdownBswTask "Limit error counter for OS_Shutdown_Bsw_Task" UBYTE RB_RBA_Common_CentralElements_CompuMethods_Identical 1 100 0.0 255. FORMAT "%5.0" ECU_ADDRESS 0x6000B51D /end MEASUREMENT
/begin MEASUREMENT rba_OsShell_CntrErrLimitShutdownSeqTask "Limit error counter for OS_Shutdown_Seq_Task" UBYTE RB_RBA_Common_CentralElements_CompuMethods_Identical 1 100 0.0 255. FORMAT "%5.0" ECU_ADDRESS 0x6000B51C /end MEASUREMENT
/begin MEASUREMENT rba_OsShell_CntrErrLimitStopCntrWakeup100msTask "Limit error counter for OS_StopCntrWakeup_100ms_Task" UBYTE RB_RBA_Common_CentralElements_CompuMethods_Identical 1 100 0.0 255. FORMAT "%5.0" ECU_ADDRESS 0x6000B542 /end MEASUREMENT
/begin MEASUREMENT rba_OsShell_CntrErrLimitStopCntrWakeup10msTask "Limit error counter for OS_StopCntrWakeup_10ms_Task" UBYTE RB_RBA_Common_CentralElements_CompuMethods_Identical 1 100 0.0 255. FORMAT "%5.0" ECU_ADDRESS 0x6000B535 /end MEASUREMENT
/begin MEASUREMENT rba_OsShell_CntrErrLimitStopCntrWakeup1msTask "Limit error counter for OS_StopCntrWakeup_1ms_Task" UBYTE RB_RBA_Common_CentralElements_CompuMethods_Identical 1 100 0.0 255. FORMAT "%5.0" ECU_ADDRESS 0x6000B520 /end MEASUREMENT
/begin MEASUREMENT rba_OsShell_CntrErrLimitStopCntrWakeup20msTask "Limit error counter for OS_StopCntrWakeup_20ms_Task" UBYTE RB_RBA_Common_CentralElements_CompuMethods_Identical 1 100 0.0 255. FORMAT "%5.0" ECU_ADDRESS 0x6000B528 /end MEASUREMENT
/begin MEASUREMENT rba_OsShell_CntrErrLimitStopCntrWakeup2msTask "Limit error counter for OS_StopCntrWakeup_2ms_Task" UBYTE RB_RBA_Common_CentralElements_CompuMethods_Identical 1 100 0.0 255. FORMAT "%5.0" ECU_ADDRESS 0x6000B530 /end MEASUREMENT
/begin MEASUREMENT rba_OsShell_CntrErrLimitStopCntrWakeup5msTask "Limit error counter for OS_StopCntrWakeup_5ms_Task" UBYTE RB_RBA_Common_CentralElements_CompuMethods_Identical 1 100 0.0 255. FORMAT "%5.0" ECU_ADDRESS 0x6000B533 /end MEASUREMENT
/begin MEASUREMENT rba_OsShell_CntrErrLimitStopCntrWakeupAsw110msTask "Limit error counter for OS_StopCntrWakeupAsw1_10ms_Task" UBYTE RB_RBA_Common_CentralElements_CompuMethods_Identical 1 100 0.0 255. FORMAT "%5.0" ECU_ADDRESS 0x6000B537 /end MEASUREMENT
/begin MEASUREMENT rba_OsShell_CntrErrLimitStopCntrWakeupAsw1BgTask "Limit error counter for OS_StopCntrWakeup_Asw1Bg_Task" UBYTE RB_RBA_Common_CentralElements_CompuMethods_Identical 1 100 0.0 255. FORMAT "%5.0" ECU_ADDRESS 0x6000B54D /end MEASUREMENT
/begin MEASUREMENT rba_OsShell_CntrErrLimitStopCntrWakeupAsw210msTask "Limit error counter for OS_StopCntrWakeupAsw2_10ms_Task" UBYTE RB_RBA_Common_CentralElements_CompuMethods_Identical 1 100 0.0 255. FORMAT "%5.0" ECU_ADDRESS 0x6000B536 /end MEASUREMENT
/begin MEASUREMENT rba_OsShell_CntrErrLimitStopCntrWakeupAsw2BgTask "Limit error counter for OS_StopCntrWakeup_Asw2Bg_Task" UBYTE RB_RBA_Common_CentralElements_CompuMethods_Identical 1 100 0.0 255. FORMAT "%5.0" ECU_ADDRESS 0x6000B54C /end MEASUREMENT
/begin MEASUREMENT rba_OsShell_CntrErrLimitStopCntrWakeupIniEndTask "Limit error counter for OS_StopCntrWakeup_IniEnd_Task" UBYTE RB_RBA_Common_CentralElements_CompuMethods_Identical 1 100 0.0 255. FORMAT "%5.0" ECU_ADDRESS 0x6000B54B /end MEASUREMENT
/begin MEASUREMENT rba_OsShell_CntrErrLimitStopCntrWakeupIniTask "Limit error counter for OS_StopCntrWakeup_Ini_Task" UBYTE RB_RBA_Common_CentralElements_CompuMethods_Identical 1 100 0.0 255. FORMAT "%5.0" ECU_ADDRESS 0x6000B54A /end MEASUREMENT
/begin MEASUREMENT rba_OsShell_CntrErrLimitSyncFirstTask "Limit error counter for OS_SyncFirst_Task" UBYTE RB_RBA_Common_CentralElements_CompuMethods_Identical 1 100 0.0 255. FORMAT "%5.0" ECU_ADDRESS 0x6000B527 /end MEASUREMENT
/begin MEASUREMENT rba_OsShell_CntrErrLimitSyncIniTask "Limit error counter for OS_SyncIni_Task" UBYTE RB_RBA_Common_CentralElements_CompuMethods_Identical 1 100 0.0 255. FORMAT "%5.0" ECU_ADDRESS 0x6000B526 /end MEASUREMENT
/begin MEASUREMENT rba_OsShell_CntrErrLimitSyncPreTask "Limit error counter for OS_SyncPre_Task" UBYTE RB_RBA_Common_CentralElements_CompuMethods_Identical 1 100 0.0 255. FORMAT "%5.0" ECU_ADDRESS 0x6000B525 /end MEASUREMENT
/begin MEASUREMENT rba_OsShell_CntrErrLimitSyncS0Task "Limit error counter for OS_SyncS0_Task" UBYTE RB_RBA_Common_CentralElements_CompuMethods_Identical 1 100 0.0 255. FORMAT "%5.0" ECU_ADDRESS 0x6000B524 /end MEASUREMENT
/begin MEASUREMENT rba_OsShell_CntrErrLimitSyncS1Task "Limit error counter for OS_SyncS1_Task" UBYTE RB_RBA_Common_CentralElements_CompuMethods_Identical 1 100 0.0 255. FORMAT "%5.0" ECU_ADDRESS 0x6000B523 /end MEASUREMENT
/begin MEASUREMENT rba_OsShell_CntrInfraAsw1App10msTask "OS task counter for the OS_InfraAsw1App_10ms_Task" UWORD RB_RBA_Common_CentralElements_CompuMethods_Identical 1 100 0.0 65535. FORMAT "%5.0" ECU_ADDRESS 0x6000F328 /end MEASUREMENT
/begin MEASUREMENT rba_OsShell_CntrInfraAsw2App10msTask "OS task counter for the OS_InfraAsw2App_10ms_Task" UWORD RB_RBA_Common_CentralElements_CompuMethods_Identical 1 100 0.0 65535. FORMAT "%5.0" ECU_ADDRESS 0x50007D68 /end MEASUREMENT
/begin MEASUREMENT rba_OsShell_CntrInfraBswApp10msTask "OS task counter for the OS_InfraBswApp_10ms_Task" UWORD RB_RBA_Common_CentralElements_CompuMethods_Identical 1 100 0.0 65535. FORMAT "%5.0" ECU_ADDRESS 0x70004740 /end MEASUREMENT
/begin MEASUREMENT rba_OsShell_CntrIniDrvTask "OS task counter for the OS_IniDrv_Task" UWORD RB_RBA_Common_CentralElements_CompuMethods_Identical 1 100 0.0 65535. FORMAT "%5.0" ECU_ADDRESS 0x6000F338 /end MEASUREMENT
/begin MEASUREMENT rba_OsShell_CntrIniEndTask "OS task counter for the OS_IniEnd_Task" UWORD RB_RBA_Common_CentralElements_CompuMethods_Identical 1 100 0.0 65535. FORMAT "%5.0" ECU_ADDRESS 0x6000F348 /end MEASUREMENT
/begin MEASUREMENT rba_OsShell_CntrIniTask "OS task counter for the OS_Ini_Task" UWORD RB_RBA_Common_CentralElements_CompuMethods_Identical 1 100 0.0 65535. FORMAT "%5.0" ECU_ADDRESS 0x6000F346 /end MEASUREMENT
/begin MEASUREMENT rba_OsShell_CntrMoSyncFirstTask "OS task counter for the OS_Mo_SyncFirst_Task" UWORD RB_RBA_Common_CentralElements_CompuMethods_Identical 1 100 0.0 65535. FORMAT "%5.0" ECU_ADDRESS 0x6000F31A /end MEASUREMENT
/begin MEASUREMENT rba_OsShell_CntrMoSyncIniTask "OS task counter for the OS_Mo_SyncIni_Task" UWORD RB_RBA_Common_CentralElements_CompuMethods_Identical 1 100 0.0 65535. FORMAT "%5.0" ECU_ADDRESS 0x6000F318 /end MEASUREMENT
/begin MEASUREMENT rba_OsShell_CntrMoSyncS0Task "OS task counter for the OS_Mo_SyncS0_Task" UWORD RB_RBA_Common_CentralElements_CompuMethods_Identical 1 100 0.0 65535. FORMAT "%5.0" ECU_ADDRESS 0x6000F316 /end MEASUREMENT
/begin MEASUREMENT rba_OsShell_CntrMoSyncS1Task "OS task counter for the OS_Mo_SyncS1_Task" UWORD RB_RBA_Common_CentralElements_CompuMethods_Identical 1 100 0.0 65535. FORMAT "%5.0" ECU_ADDRESS 0x6000F314 /end MEASUREMENT
/begin MEASUREMENT rba_OsShell_CntrMoTask "OS task counter for the OS_Mo_Task" UWORD RB_RBA_Common_CentralElements_CompuMethods_Identical 1 100 0.0 65535. FORMAT "%5.0" ECU_ADDRESS 0x6000F312 /end MEASUREMENT
/begin MEASUREMENT rba_OsShell_CntrReIniModeMTask "OS task counter for the OS_ReIniModeM_Task" UWORD RB_RBA_Common_CentralElements_CompuMethods_Identical 1 100 0.0 65535. FORMAT "%5.0" ECU_ADDRESS 0x6000F344 /end MEASUREMENT
/begin MEASUREMENT rba_OsShell_CntrReIniTask "OS task counter for the OS_ReIni_Task" UWORD RB_RBA_Common_CentralElements_CompuMethods_Identical 1 100 0.0 65535. FORMAT "%5.0" ECU_ADDRESS 0x6000F336 /end MEASUREMENT
/begin MEASUREMENT rba_OsShell_CntrShutdown10msTask "OS task counter for the OS_Shutdown_10ms_Task" UWORD RB_RBA_Common_CentralElements_CompuMethods_Identical 1 100 0.0 65535. FORMAT "%5.0" ECU_ADDRESS 0x70004736 /end MEASUREMENT
/begin MEASUREMENT rba_OsShell_CntrShutdownAsw1Task "OS task counter for the OS_Shutdown_Asw1_Task" UWORD RB_RBA_Common_CentralElements_CompuMethods_Identical 1 100 0.0 65535. FORMAT "%5.0" ECU_ADDRESS 0x6000F30C /end MEASUREMENT
/begin MEASUREMENT rba_OsShell_CntrShutdownAsw2Task "OS task counter for the OS_Shutdown_Asw2_Task" UWORD RB_RBA_Common_CentralElements_CompuMethods_Identical 1 100 0.0 65535. FORMAT "%5.0" ECU_ADDRESS 0x50007D54 /end MEASUREMENT
/begin MEASUREMENT rba_OsShell_CntrShutdownBswTask "OS task counter for the OS_Shutdown_Bsw_Task" UWORD RB_RBA_Common_CentralElements_CompuMethods_Identical 1 100 0.0 65535. FORMAT "%5.0" ECU_ADDRESS 0x7000473A /end MEASUREMENT
/begin MEASUREMENT rba_OsShell_CntrShutdownSeqTask "OS task counter for the OS_Shutdown_Seq_Task" UWORD RB_RBA_Common_CentralElements_CompuMethods_Identical 1 100 0.0 65535. FORMAT "%5.0" ECU_ADDRESS 0x70004738 /end MEASUREMENT
/begin MEASUREMENT rba_OsShell_CntrStopCntrWakeup100msTask "OS task counter for the OS_StopCntrWakeup_100ms_Task" UWORD RB_RBA_Common_CentralElements_CompuMethods_Identical 1 100 0.0 65535. FORMAT "%5.0" ECU_ADDRESS 0x50007D6C /end MEASUREMENT
/begin MEASUREMENT rba_OsShell_CntrStopCntrWakeup10msTask "OS task counter for the OS_StopCntrWakeup_10ms_Task" UWORD RB_RBA_Common_CentralElements_CompuMethods_Identical 1 100 0.0 65535. FORMAT "%5.0" ECU_ADDRESS 0x6000F324 /end MEASUREMENT
/begin MEASUREMENT rba_OsShell_CntrStopCntrWakeup1msTask "OS task counter for the OS_StopCntrWakeup_1ms_Task" UWORD RB_RBA_Common_CentralElements_CompuMethods_Identical 1 100 0.0 65535. FORMAT "%5.0" ECU_ADDRESS 0x6000F30E /end MEASUREMENT
/begin MEASUREMENT rba_OsShell_CntrStopCntrWakeup20msTask "OS task counter for the OS_StopCntrWakeup_20ms_Task" UWORD RB_RBA_Common_CentralElements_CompuMethods_Identical 1 100 0.0 65535. FORMAT "%5.0" ECU_ADDRESS 0x50007D60 /end MEASUREMENT
/begin MEASUREMENT rba_OsShell_CntrStopCntrWakeup2msTask "OS task counter for the OS_StopCntrWakeup_2ms_Task" UWORD RB_RBA_Common_CentralElements_CompuMethods_Identical 1 100 0.0 65535. FORMAT "%5.0" ECU_ADDRESS 0x6000F31E /end MEASUREMENT
/begin MEASUREMENT rba_OsShell_CntrStopCntrWakeup5msTask "OS task counter for the OS_StopCntrWakeup_5ms_Task" UWORD RB_RBA_Common_CentralElements_CompuMethods_Identical 1 100 0.0 65535. FORMAT "%5.0" ECU_ADDRESS 0x6000F322 /end MEASUREMENT
/begin MEASUREMENT rba_OsShell_CntrStopCntrWakeupAsw110msTask "OS task counter for the OS_StopCntrWakeupAsw1_10ms_Task" UWORD RB_RBA_Common_CentralElements_CompuMethods_Identical 1 100 0.0 65535. FORMAT "%5.0" ECU_ADDRESS 0x6000F326 /end MEASUREMENT
/begin MEASUREMENT rba_OsShell_CntrStopCntrWakeupAsw1BgTask "OS task counter for the OS_StopCntrWakeup_Asw1Bg_Task" UWORD RB_RBA_Common_CentralElements_CompuMethods_Identical 1 100 0.0 65535. FORMAT "%5.0" ECU_ADDRESS 0x6000F342 /end MEASUREMENT
/begin MEASUREMENT rba_OsShell_CntrStopCntrWakeupAsw210msTask "OS task counter for the OS_StopCntrWakeupAsw2_10ms_Task" UWORD RB_RBA_Common_CentralElements_CompuMethods_Identical 1 100 0.0 65535. FORMAT "%5.0" ECU_ADDRESS 0x50007D66 /end MEASUREMENT
/begin MEASUREMENT rba_OsShell_CntrStopCntrWakeupAsw2BgTask "OS task counter for the OS_StopCntrWakeup_Asw2Bg_Task" UWORD RB_RBA_Common_CentralElements_CompuMethods_Identical 1 100 0.0 65535. FORMAT "%5.0" ECU_ADDRESS 0x50007D6E /end MEASUREMENT
/begin MEASUREMENT rba_OsShell_CntrStopCntrWakeupIniEndTask "OS task counter for the OS_StopCntrWakeup_IniEnd_Task" UWORD RB_RBA_Common_CentralElements_CompuMethods_Identical 1 100 0.0 65535. FORMAT "%5.0" ECU_ADDRESS 0x6000F340 /end MEASUREMENT
/begin MEASUREMENT rba_OsShell_CntrStopCntrWakeupIniTask "OS task counter for the OS_StopCntrWakeup_Ini_Task" UWORD RB_RBA_Common_CentralElements_CompuMethods_Identical 1 100 0.0 65535. FORMAT "%5.0" ECU_ADDRESS 0x6000F33E /end MEASUREMENT
/begin MEASUREMENT rba_OsShell_CntrSyncFirstTask "OS task counter for the OS_SyncFirst_Task" UWORD RB_RBA_Common_CentralElements_CompuMethods_Identical 1 100 0.0 65535. FORMAT "%5.0" ECU_ADDRESS 0x50007D5E /end MEASUREMENT
/begin MEASUREMENT rba_OsShell_CntrSyncIniTask "OS task counter for the OS_SyncIni_Task" UWORD RB_RBA_Common_CentralElements_CompuMethods_Identical 1 100 0.0 65535. FORMAT "%5.0" ECU_ADDRESS 0x50007D5C /end MEASUREMENT
/begin MEASUREMENT rba_OsShell_CntrSyncPreTask "OS task counter for the OS_SyncPre_Task" UWORD RB_RBA_Common_CentralElements_CompuMethods_Identical 1 100 0.0 65535. FORMAT "%5.0" ECU_ADDRESS 0x50007D5A /end MEASUREMENT
/begin MEASUREMENT rba_OsShell_CntrSyncS0Task "OS task counter for the OS_SyncS0_Task" UWORD RB_RBA_Common_CentralElements_CompuMethods_Identical 1 100 0.0 65535. FORMAT "%5.0" ECU_ADDRESS 0x50007D58 /end MEASUREMENT
/begin MEASUREMENT rba_OsShell_CntrSyncS1Task "OS task counter for the OS_SyncS1_Task" UWORD RB_RBA_Common_CentralElements_CompuMethods_Identical 1 100 0.0 65535. FORMAT "%5.0" ECU_ADDRESS 0x50007D56 /end MEASUREMENT
/begin MEASUREMENT rba_OsShell_cntrErrAccess "OS E_OS_ACCESS error counter" UBYTE RB_RBA_Common_CentralElements_CompuMethods_Identical 1 100 0.0 255. FORMAT "%5.0" ECU_ADDRESS 0x6000B519 /end MEASUREMENT
/begin MEASUREMENT rba_OsShell_cntrErrCallevel "OS E_OS_CALLEVEL error counter" UBYTE RB_RBA_Common_CentralElements_CompuMethods_Identical 1 100 0.0 255. FORMAT "%5.0" ECU_ADDRESS 0x6000B518 /end MEASUREMENT
/begin MEASUREMENT rba_OsShell_cntrErrId "OS E_OS_ID error counter" UBYTE RB_RBA_Common_CentralElements_CompuMethods_Identical 1 100 0.0 255. FORMAT "%5.0" ECU_ADDRESS 0x6000B517 /end MEASUREMENT
/begin MEASUREMENT rba_OsShell_cntrErrLimitSum "OS E_OS_LIMIT error counter" UBYTE RB_RBA_Common_CentralElements_CompuMethods_Identical 1 100 0.0 255. FORMAT "%5.0" ECU_ADDRESS 0x6000B516 /end MEASUREMENT
/begin MEASUREMENT rba_OsShell_cntrErrNoFunc "OS E_OS_NOFUNC error counter" UBYTE RB_RBA_Common_CentralElements_CompuMethods_Identical 1 100 0.0 255. FORMAT "%5.0" ECU_ADDRESS 0x6000B515 /end MEASUREMENT
/begin MEASUREMENT rba_OsShell_cntrErrResource "OS E_OS_RESOURCE error counter" UBYTE RB_RBA_Common_CentralElements_CompuMethods_Identical 1 100 0.0 255. FORMAT "%5.0" ECU_ADDRESS 0x6000B514 /end MEASUREMENT
/begin MEASUREMENT rba_OsShell_cntrErrState "OS E_OS_STATE error counter" UBYTE RB_RBA_Common_CentralElements_CompuMethods_Identical 1 100 0.0 255. FORMAT "%5.0" ECU_ADDRESS 0x6000B513 /end MEASUREMENT
/begin MEASUREMENT rba_OsShell_cntrErrSum "OS overall error counter" UBYTE RB_RBA_Common_CentralElements_CompuMethods_Identical 1 100 0.0 255. FORMAT "%5.0" ECU_ADDRESS 0x6000B4FE /end MEASUREMENT
/begin MEASUREMENT rba_OsShell_cntrErrValue "OS E_OS_VALUE error counter" UBYTE RB_RBA_Common_CentralElements_CompuMethods_Identical 1 100 0.0 255. FORMAT "%5.0" ECU_ADDRESS 0x6000B512 /end MEASUREMENT
/begin MEASUREMENT rba_OsShell_tiPowerOnFrst10ms "Time from last Power on Reset to first 10ms-Raster" UWORD RB_RBA_Common_CentralElements_CompuMethods_Identical 1 100 0.0 65535. FORMAT "%5.0" ECU_ADDRESS 0x6000572A /end MEASUREMENT
/begin MEASUREMENT rba_OsShell_tiResetFrst10ms "Time from last Reset to first 10ms-Raster" UWORD RB_RBA_Common_CentralElements_CompuMethods_Identical 1 100 0.0 65535. FORMAT "%5.0" ECU_ADDRESS 0x6000572C /end MEASUREMENT
/begin MEASUREMENT rba_SyC_ObservationCounters_IrrSwOffTrigEngRun_Value_MP "ObservationCounter: Irregular Switch Off Counter Triggered by Engine Running" UBYTE DefaultIdenticalCompu 1 100 0.0 255.0 ECU_ADDRESS 0x70009394
 /begin ANNOTATION ANNOTATION_LABEL "Description (coming from AUTOSAR DESC field)"
  /begin ANNOTATION_TEXT "ObservationCounter: Irregular Switch Off Counter Triggered by Engine Running\r\n" /end ANNOTATION_TEXT
 /end ANNOTATION
/end MEASUREMENT
/begin MEASUREMENT rba_SyC_ObservationCounters_IrrSwOff_Value_MP "ObservationCounter: Irregular SwitchOff Counter" UBYTE DefaultIdenticalCompu 1 100 0.0 255.0 ECU_ADDRESS 0x70009395
 /begin ANNOTATION ANNOTATION_LABEL "Description (coming from AUTOSAR DESC field)" /begin ANNOTATION_TEXT "ObservationCounter: Irregular SwitchOff Counter\r\n" /end ANNOTATION_TEXT /end ANNOTATION
/end MEASUREMENT
/begin MEASUREMENT rba_SyC_PowerOn_Reasons_MP "Switch on reasons of the ECU" UBYTE DefaultIdenticalCompu 1 100 0.0 255.0 ECU_ADDRESS 0x700093B8
 /begin ANNOTATION ANNOTATION_LABEL "Description (coming from AUTOSAR DESC field)" /begin ANNOTATION_TEXT "Switch on reasons of the ECU\r\n" /end ANNOTATION_TEXT /end ANNOTATION
/end MEASUREMENT
/begin MEASUREMENT rba_SyC_Rtc_EcuOffTime_Validity_MP "Indicate the validity of the ECU Off Time" UBYTE RB_RBA_rba_SyC_Rtc_BswModuleDescriptions_rba_SyC_Rtc_EcuOffTime_CompuMethod 1 100 0.0 11.000 FORMAT "%8.3" ECU_ADDRESS 0x700093B9
 /begin ANNOTATION ANNOTATION_LABEL "Description (coming from AUTOSAR DESC field)" /begin ANNOTATION_TEXT "Indicate the validity of the ECU Off Time\r\n" /end ANNOTATION_TEXT /end ANNOTATION
/end MEASUREMENT
/begin MEASUREMENT rba_SyC_Rtc_EcuOffTime_Value_MP "ECU Off Time in seconds" ULONG DefaultIdenticalCompu 1 100 0.0 4.294967295E9 ECU_ADDRESS 0x70009390
 /begin ANNOTATION ANNOTATION_LABEL "Description (coming from AUTOSAR DESC field)" /begin ANNOTATION_TEXT "ECU Off Time in seconds\r\n" /end ANNOTATION_TEXT /end ANNOTATION
/end MEASUREMENT
/begin MEASUREMENT ACClntP_bCodAvl "Codinginformation" UBYTE B_TRUE 1 100 0.00 1.00000000000 BIT_MASK 0x1 FORMAT "%13.11" ECU_ADDRESS 0x6000A27E /end MEASUREMENT
/begin MEASUREMENT ACCmpr_flgPsCmprDes "Desired compressor state" UBYTE B_TRUE 1 100 0.00 1.00000000000 BIT_MASK 0x1 FORMAT "%13.11" ECU_ADDRESS 0x70000385 /end MEASUREMENT
/begin MEASUREMENT AirC_pAnaClnt "The sensed value of the AC coolant pressure over ADC" SWORD PresAC_hPa 1 100 -65536.00 65534.00 FORMAT "%8.2" ECU_ADDRESS 0x6000527E /end MEASUREMENT
/begin MEASUREMENT AirC_pClnt "Air Condition coolant pressure" SWORD PresAC_hPa 1 100 -65536.00 65534.00 FORMAT "%8.2" ECU_ADDRESS 0x600053B6 /end MEASUREMENT
/begin MEASUREMENT AirC_stCmprAct "Actual Air compressor state" UBYTE OneToOne 1 100 0.00 255.0 FORMAT "%5.1" ECU_ADDRESS 0x6000A6B1 /end MEASUREMENT
/begin MEASUREMENT AirC_stPsCmpr "Final digital output to the power stage of AC compressor actuator" UBYTE OneToOne 1 100 0.00 255.0 FORMAT "%5.1" ECU_ADDRESS 0x6000A6B0 /end MEASUREMENT
/begin MEASUREMENT AirC_trqCmprMax "Maximum torque consumable by the AC compressor" SWORD Trq 1 100 -3276.800 3276.700 FORMAT "%8.3" ECU_ADDRESS 0x6000527C /end MEASUREMENT
/begin MEASUREMENT AirC_trqDes "Torque demanded by the AC compressor on CAN" SWORD Trq 1 100 -3276.800 3276.700 FORMAT "%8.3" ECU_ADDRESS 0x6000E126 /end MEASUREMENT
/begin MEASUREMENT AirC_uAnaRawClnt "The raw voltage value from the ADC for AC coolant pressure" SWORD Volt 1 100 -6553.600 6553.400 FORMAT "%8.3" ECU_ADDRESS 0x6000E128 /end MEASUREMENT
/begin FUNCTION rba_ComScl "4.17.3_6.0.0  McFunction rba_ComScl Created by MCFunctionUpdater"
 /begin LOC_MEASUREMENT ComScl_Bdy_RawSignal_PCU_ALIVE_COUNTER_45B_u8 ComScl_Bdy_RawSignal_PCU_CHECKSUM_45B_u8 ComScl_Bdy_RawSignal_PCU_REM_ENG_START_b ComScl_Bdy_RawSignal_SRS_ALIVE_COUNTER_039_u8 ComScl_Bdy_RawSignal_SRS_ALIVE_COUNTER_094_u8 ComScl_Bdy_RawSignal_SRS_ALIVE_COUNTER_305_u8 ComScl_Bdy_RawSignal_SRS_CAL_LAT_G_b ComScl_Bdy_RawSignal_SRS_CAL_LON_G_b ComScl_Bdy_RawSignal_SRS_CHECKSUM_039_u8 ComScl_Bdy_RawSignal_SRS_CHECKSUM_094_u8 ComScl_Bdy_RawSignal_SRS_CHECKSUM_305_u8 ComScl_Bdy_RawSignal_SRS_DR_BELT_STATUS_u8 ComScl_Bdy_RawSignal_SRS_HI_CDS_b ComScl_Bdy_RawSignal_SRS_LAT_G_u16 ComScl_Bdy_RawSignal_SRS_LON_G_u16 ComScl_Bdy_RawSignal_SRS_P_ERR_LAT_G_b ComScl_Bdy_RawSignal_SRS_P_ERR_LON_G_b ComScl_Bdy_RawSignal_SRS_P_ERR_YAW1_b ComScl_Bdy_RawSignal_SRS_SENSOR_ERR_MC_b ComScl_Bdy_RawSignal_SRS_SENSOR_START_UP_b ComScl_Bdy_RawSignal_SRS_SENSOR_STATE_IG_b ComScl_Bdy_RawSignal_SRS_T_ERR_LAT_G_b ComScl_Bdy_RawSignal_SRS_T_ERR_LON_G_b ComScl_Bdy_RawSignal_SRS_T_ERR_YAW1_b ComScl_Bdy_RawSignal_SRS_YAW_1_u16 ComScl_Dspl_RawSignal_METER_AC_ACGUP_REQ_b ComScl_Dspl_RawSignal_METER_AC_FR_BLW_VF_u8 ComScl_Dspl_RawSignal_METER_AC_HACCUT_NG_u8 ComScl_Dspl_RawSignal_METER_AC_OUTAIRTEMP01_u8 ComScl_Dspl_RawSignal_METER_AC_PTC_STATUS_u8 ComScl_Dspl_RawSignal_METER_AC_RRDEF_b ComScl_Dspl_RawSignal_METER_AC_RR_BLW_VF_u8 ComScl_Dspl_RawSignal_METER_AC_TEVATEMP05_u8 ComScl_Dspl_RawSignal_METER_AC_TYPE_ECON_b ComScl_Dspl_RawSignal_METER_AC_VARI_u8 ComScl_Dspl_RawSignal_METER_ALIVE_COUNTER_221_2_u8 ComScl_Dspl_RawSignal_METER_ALIVE_COUNTER_221_u8 ComScl_Dspl_RawSignal_METER_ALIVE_COUNTER_296_u8 ComScl_Dspl_RawSignal_METER_ALIVE_COUNTER_309_u8 ComScl_Dspl_RawSignal_METER_ALIVE_COUNTER_326_u8 ComScl_Dspl_RawSignal_METER_ALIVE_COUNTER_331_u8 ComScl_Dspl_RawSignal_METER_ALIVE_COUNTER_371_u8 ComScl_Dspl_RawSignal_METER_ALIVE_COUNTER_372_u8 ComScl_Dspl_RawSignal_METER_ALIVE_COUNTER_374_u8 ComScl_Dspl_RawSignal_METER_ALIVE_COUNTER_37B_u8 ComScl_Dspl_RawSignal_METER_ALIVE_COUNTER_396_u8 ComScl_Dspl_RawSignal_METER_ALIVE_COUNTER_3A1_u8 ComScl_Dspl_RawSignal_METER_ALIVE_COUNTER_510_u8 ComScl_Dspl_RawSignal_METER_ALIVE_COUNTER_516_u8 ComScl_Dspl_RawSignal_METER_ASL_CAN_ERROR_b ComScl_Dspl_RawSignal_METER_BATT_IGOFF_OTA_REQUEST_b ComScl_Dspl_RawSignal_METER_BCAN_FAILCODE_BCAN_b ComScl_Dspl_RawSignal_METER_BCAN_FAILCODE_COMB_UNIT_b ComScl_Dspl_RawSignal_METER_BCAN_FAILCODE_HAC_b ComScl_Dspl_RawSignal_METER_BCAN_FAILCODE_MCU_UNIT_b ComScl_Dspl_RawSignal_METER_BCAN_REPRO_b ComScl_Dspl_RawSignal_METER_CC_MAIN_STATUS_b ComScl_Dspl_RawSignal_METER_CC_TARGETSP_DISP_b ComScl_Dspl_RawSignal_METER_CHECKSUM_221_2_u8 ComScl_Dspl_RawSignal_METER_CHECKSUM_221_u8 ComScl_Dspl_RawSignal_METER_CHECKSUM_296_u8 ComScl_Dspl_RawSignal_METER_CHECKSUM_309_u8 ComScl_Dspl_RawSignal_METER_CHECKSUM_326_u8 ComScl_Dspl_RawSignal_METER_CHECKSUM_331_u8 ComScl_Dspl_RawSignal_METER_CHECKSUM_371_u8 ComScl_Dspl_RawSignal_METER_CHECKSUM_372_u8 ComScl_Dspl_RawSignal_METER_CHECKSUM_374_u8 ComScl_Dspl_RawSignal_METER_CHECKSUM_37B_u8 ComScl_Dspl_RawSignal_METER_CHECKSUM_396_u8 ComScl_Dspl_RawSignal_METER_CHECKSUM_3A1_u8 ComScl_Dspl_RawSignal_METER_CHECKSUM_510_u8 ComScl_Dspl_RawSignal_METER_CHECKSUM_516_u8 ComScl_Dspl_RawSignal_METER_COMPCURRENT_HIBYTE_u8 ComScl_Dspl_RawSignal_METER_COMPCURRENT_LOWBYTE_u8 ComScl_Dspl_RawSignal_METER_CUSTOM_DEFAULT_b ComScl_Dspl_RawSignal_METER_CUSTOM_STATUS_b ComScl_Dspl_RawSignal_METER_DIGITAL_SPEED_DISPLAY_u8 ComScl_Dspl_RawSignal_METER_DIGITAL_SPEED_TARGET_u16 ComScl_Dspl_RawSignal_METER_DISPLAY_SPEED_u16 ComScl_Dspl_RawSignal_METER_ECONSW_ON_2_b ComScl_Dspl_RawSignal_METER_ECONSW_ON_b ComScl_Dspl_RawSignal_METER_EVA_TEMP_2_u8 ComScl_Dspl_RawSignal_METER_EVA_TEMP_u8 ComScl_Dspl_RawSignal_METER_FRDEF_b ComScl_Dspl_RawSignal_METER_FRFOGRLY_b ComScl_Dspl_RawSignal_METER_FUEL_LEVEL_RAW_u8 ComScl_Dspl_RawSignal_METER_ICU_ACBLW_VD_u8 ComScl_Dspl_RawSignal_METER_ICU_HOOD_ERR_b ComScl_Dspl_RawSignal_METER_ICU_HOOD_b ComScl_Dspl_RawSignal_METER_IN_AIR_TEMP_u8 ComScl_Dspl_RawSignal_METER_IS_INHIBITSW_ON_2_b ComScl_Dspl_RawSignal_METER_IS_INHIBITSW_ON_b ComScl_Dspl_RawSignal_METER_IS_PERMIT_b ComScl_Dspl_RawSignal_METER_IS_TIME_2_u8 ComScl_Dspl_RawSignal_METER_IS_TIME_u8 ComScl_Dspl_RawSignal_METER_MICU_FRDEICERRLY_b ComScl_Dspl_RawSignal_METER_MICU_FRWIPMTR_u8 ComScl_Dspl_RawSignal_METER_MICU_RRDEFSW_b ComScl_Dspl_RawSignal_METER_MICU_TYPE_b ComScl_Dspl_RawSignal_METER_ODODATA_STATE_b ComScl_Dspl_RawSignal_METER_ODO_DATA_u32 ComScl_Dspl_RawSignal_METER_OIL_LIFE_RESSW_b ComScl_Dspl_RawSignal_METER_OUTTEMP_u8 ComScl_Dspl_RawSignal_METER_OUT_AIR_TEMP_u8 ComScl_Dspl_RawSignal_METER_RM_DRLKC_b ComScl_Dspl_RawSignal_METER_RM_HLHIRLY_b ComScl_Dspl_RawSignal_METER_RM_HLLORLY_b ComScl_Dspl_RawSignal_METER_RM_ILL_SML_b ComScl_Dspl_RawSignal_METER_RRFOGRLY_b ComScl_Dspl_RawSignal_METER_SPEED_UNIT_b ComScl_Dspl_RawSignal_METER_SW_STATUS_CC_STANDARD_u8 ComScl_Dspl_RawSignal_METER_SW_STATUS_HAC_b ComScl_Dspl_RawSignal_METER_SW_STATUS_IS_INH_b ComScl_Dspl_RawSignal_METER_SW_STATUS_LKAS_CCLIM_DIST_u8 ComScl_Dspl_RawSignal_METER_SW_STATUS_PARK_BRAKE_b ComScl_Dspl_RawSignal_METER_WIPER_STATUS_u8 ComScl_EngLin_RawSignal_Lin_Alt_B_Signal_ACG_Temp_8_r_msg_u8 ComScl_EngLin_RawSignal_Lin_Alt_B_Signal_ComTOut_1_r_msg_b ComScl_EngLin_RawSignal_Lin_Alt_B_Signal_Com_1_r_msg_b ComScl_EngLin_RawSignal_Lin_Alt_B_Signal_Dyc_5_r_msg_u8 ComScl_EngLin_RawSignal_Lin_Alt_B_Signal_Elec_1_r_msg_b ComScl_EngLin_RawSignal_Lin_Alt_B_Signal_ExctCrnt_8_r_msg_u8 ComScl_EngLin_RawSignal_Lin_Alt_B_Signal_HiTemp_1_r_msg_b ComScl_EngLin_RawSignal_Lin_Alt_B_Signal_Mchn_1_r_msg_b ComScl_EngLin_RawSignal_Lin_BS_B_Signal_OCV_8_r_msg_u8 ComScl_EngLin_RawSignal_Lin_BS_B_Signal_STBATTSENRST_1_r_msg_b ComScl_EngLin_RawSignal_Lin_BS_B_Signal_TASIC_8_r_msg_u8 ComScl_EngLin_RawSignal_Lin_BS_B_Signal_tiDurAftIgnOff_16_r_msg_u16 ComScl_EngLin_RawSignal_Lin_BS_Signal_B_BATTCH_16_r_msg_u16 ComScl_EngLin_RawSignal_Lin_BS_Signal_B_BATTDCHA_16_r_msg_u16 ComScl_EngLin_RawSignal_Lin_BS_Signal_B_BATT_WARM_LEVEL_3_r_msg_u8 ComScl_EngLin_RawSignal_Lin_BS_Signal_B_BCF_1_r_msg_b ComScl_EngLin_RawSignal_Lin_BS_Signal_B_BattChg_2_r_msg_u8 ComScl_EngLin_RawSignal_Lin_BS_Signal_B_CHARERR_1_r_msg_b ComScl_EngLin_RawSignal_Lin_BS_Signal_B_CTINTRESUPD_2_r_msg_u8 ComScl_EngLin_RawSignal_Lin_BS_Signal_B_CtResRpl_5_r_msg_u8 ComScl_EngLin_RawSignal_Lin_BS_Signal_B_ERROR_RES_1_r_msg_b ComScl_EngLin_RawSignal_Lin_BS_Signal_B_IBAT_16_r_msg_u16 ComScl_EngLin_RawSignal_Lin_BS_Signal_B_IBAT_8_r_msg_u8 ComScl_EngLin_RawSignal_Lin_BS_Signal_B_LIN_TYPE_RX_4_r_msg_u8 ComScl_EngLin_RawSignal_Lin_BS_Signal_B_PulResUpd_2_r_msg_u8 ComScl_EngLin_RawSignal_Lin_BS_Signal_B_RESMEASDBATT_16_r_msg_u16 ComScl_EngLin_RawSignal_Lin_BS_Signal_B_ResRpl_11_r_msg_u16 ComScl_EngLin_RawSignal_Lin_BS_Signal_B_SOC_10_r_msg_u16 ComScl_EngLin_RawSignal_Lin_BS_Signal_B_SOC_STATE_3_r_msg_u8 ComScl_EngLin_RawSignal_Lin_BS_Signal_B_SOHSOFLrng_2_r_msg_u8 ComScl_EngLin_RawSignal_Lin_BS_Signal_B_SOH_10_r_msg_u16 ComScl_EngLin_RawSignal_Lin_BS_Signal_B_SUPPLIER_CODE_8_r_msg_u8 ComScl_EngLin_RawSignal_Lin_BS_Signal_B_TBAT_8_r_msg_u8 ComScl_EngLin_RawSignal_Lin_BS_Signal_B_TBattResPul_8_r_msg_u8 ComScl_EngLin_RawSignal_Lin_BS_Signal_B_TerminalOFFDetn_2_r_msg_u8 ComScl_EngLin_RawSignal_Lin_BS_Signal_B_UBAT_16_r_msg_u16 ComScl_EngLin_RawSignal_Lin_BS_Signal_B_ctCrkngDetn_16_r_msg_u16 ComScl_EngLin_RawSignal_Lin_BS_Signal_B_ctMeasmtCrk_2_r_msg_u8 ComScl_EngLin_RawSignal_Lin_BS_Signal_B_iBattStrtCrn_14_r_msg_u16 ComScl_EngLin_RawSignal_Lin_BS_Signal_B_iMaxBattDcha_16_r_msg_u16 ComScl_EngLin_RawSignal_Lin_BS_Signal_B_iStByCurrAft0h_10_r_msg_u16 ComScl_EngLin_RawSignal_Lin_BS_Signal_B_iStByCurrAft1h_10_r_msg_u16 ComScl_EngLin_RawSignal_Lin_BS_Signal_B_iStByCurrAft2h_10_r_msg_u16 ComScl_EngLin_RawSignal_Lin_BS_Signal_B_iStByCurrLst_10_r_msg_u16 ComScl_EngLin_RawSignal_Lin_BS_Signal_B_idBattData_8_r_msg_u8 ComScl_EngLin_RawSignal_Lin_BS_Signal_B_numBattPart_8_r_msg_u8 ComScl_EngLin_RawSignal_Lin_BS_Signal_B_numLowSOCDetn_8_r_msg_u8 ComScl_EngLin_RawSignal_Lin_BS_Signal_B_resPul_16_r_msg_u16 ComScl_EngLin_RawSignal_Lin_BS_Signal_B_stChrgReq_3_r_msg_u8 ComScl_EngLin_RawSignal_Lin_BS_Signal_B_stFitng_1_r_msg_b ComScl_EngLin_RawSignal_Lin_BS_Signal_B_stHarnR_2_r_msg_u8 ComScl_EngLin_RawSignal_Lin_BS_Signal_B_tMaxBatt_8_r_msg_u8 ComScl_EngLin_RawSignal_Lin_BS_Signal_B_tMinBatt_8_r_msg_u8 ComScl_EngLin_RawSignal_Lin_BS_Signal_B_tiBattON_16_r_msg_u16 ComScl_EngLin_RawSignal_Lin_BS_Signal_B_tiT15ON_11_r_msg_u16 ComScl_EngLin_RawSignal_Lin_BS_Signal_B_uBattSOFV_8_r_msg_u8 ComScl_EngLin_RawSignal_Lin_BS_Signal_B_uPeak_16_r_msg_u16 ComScl_EngLin_RawSignal_Lin_BS_Signal_B_xMnfcDate_16_r_msg_u16 ComScl_EngLin_RawSignal_Lin_BS_Signal_ERRCMN_1_r_msg_b ComScl_EngLin_RawSignal_Lin_BS_Signal_ERRST_1_r_msg_b ComScl_Gbx_RawSignal_CVT_DISPLAYED_GEAR_u8 ComScl_Gbx_RawSignal_CVT_GEAR_POSITION_IND_CVT_u8 ComScl_Gbx_RawSignal_CVT_MISS_MILON_REQ_FLAG_b ComScl_Gbx_RawSignal_CVT_MISS_VSENS_FAIL_FLAG_b ComScl_Gbx_RawSignal_CVT_MISS_VSENS_OK_FLAG_b ComScl_Gbx_RawSignal_CVT_MISS_VSENS_TFCD_FLAG_b ComScl_Gbx_RawSignal_CVT_RATIO_INFO_191_u8 ComScl_Gbx_RawSignal_CVT_RATIO_TARGET_u8 ComScl_Gbx_RawSignal_CVT_REFUSE_VSA_CONTROL_b ComScl_Gbx_RawSignal_CVT_SHFT_IN_D_b ComScl_Gbx_RawSignal_CVT_SHFT_IN_L_b ComScl_Gbx_RawSignal_CVT_SHFT_IN_NEUTRAL_b ComScl_Gbx_RawSignal_CVT_SHFT_IN_PARKING_b ComScl_Gbx_RawSignal_CVT_SHFT_IN_REVERSE_b ComScl_Gbx_RawSignal_CVT_SHFT_IN_S_b ComScl_Gbx_RawSignal_CVT_SHIFT_SURE_b ComScl_Gbx_RawSignal_CVT_SW_STATUS_SMODE_b ComScl_Gbx_RawSignal_CVT_TRANS_FAULT_D_IND_CVT_b ComScl_Gbx_RawSignal_CVT_TRANS_MIL_ACC_b ComScl_Gbx_RawSignal_CVT_TRANS_MIL_b ComScl_Gbx_RawSignal_EAT_ALIVE_COUNTER_158_u8 ComScl_Gbx_RawSignal_EAT_ALIVE_COUNTER_191_u8 ComScl_Gbx_RawSignal_EAT_ALIVE_COUNTER_41B_u8 ComScl_Gbx_RawSignal_EAT_ATF_TEMP_INVALID_b ComScl_Gbx_RawSignal_EAT_CHECKSUM_158_u8 ComScl_Gbx_RawSignal_EAT_CHECKSUM_191_u8 ComScl_Gbx_RawSignal_EAT_CHECKSUM_41B_u8 ComScl_Gbx_RawSignal_EAT_REF_DISTANCE_TRAVELLED_u8 ComScl_Gbx_RawSignal_EAT_TRANS_MAIN_SHAFT_SPEED_u16 ComScl_Gbx_RawSignal_EAT_TRANS_SPEED_VNC_u16 ComScl_Gbx_RawSignal_EAT_TRANS_SPEED_u16 ComScl_Gbx_RawSignal_TM_ALCZONE_u8 ComScl_Gbx_RawSignal_TM_ALIVE_COUNTER_071_u8 ComScl_Gbx_RawSignal_TM_ALIVE_COUNTER_072_u8 ComScl_Gbx_RawSignal_TM_ALIVE_COUNTER_07B_u8 ComScl_Gbx_RawSignal_TM_ALIVE_COUNTER_07C_u8 ComScl_Gbx_RawSignal_TM_ALIVE_COUNTER_07E_u8 ComScl_Gbx_RawSignal_TM_ALIVE_COUNTER_19D_u8 ComScl_Gbx_RawSignal_TM_ALIVE_COUNTER_1BF_u8 ComScl_Gbx_RawSignal_TM_ALIVE_COUNTER_1F0_u8 ComScl_Gbx_RawSignal_TM_ALIVE_COUNTER_351_u8 ComScl_Gbx_RawSignal_TM_ALIVE_COUNTER_40B_u8 ComScl_Gbx_RawSignal_TM_ATF_TEMP_u8 ComScl_Gbx_RawSignal_TM_AT_CC_FWD_b ComScl_Gbx_RawSignal_TM_CHECKSUM_071_u8 ComScl_Gbx_RawSignal_TM_CHECKSUM_072_u8 ComScl_Gbx_RawSignal_TM_CHECKSUM_07B_u8 ComScl_Gbx_RawSignal_TM_CHECKSUM_07C_u8 ComScl_Gbx_RawSignal_TM_CHECKSUM_07E_u8 ComScl_Gbx_RawSignal_TM_CHECKSUM_19D_u8 ComScl_Gbx_RawSignal_TM_CHECKSUM_1BF_u8 ComScl_Gbx_RawSignal_TM_CHECKSUM_1F0_u8 ComScl_Gbx_RawSignal_TM_CHECKSUM_351_u8 ComScl_Gbx_RawSignal_TM_CHECKSUM_40B_u8 ComScl_Gbx_RawSignal_TM_CVTNP_FLAG_b ComScl_Gbx_RawSignal_TM_DEC_FC_LC_OK_b ComScl_Gbx_RawSignal_TM_ECON_POS_FAIL_OK_b ComScl_Gbx_RawSignal_TM_FAULT_ACTION_STATUS_VSP_FAIL_b ComScl_Gbx_RawSignal_TM_F_DFTRFENTM_b ComScl_Gbx_RawSignal_TM_GEARPOS_N_DET_b ComScl_Gbx_RawSignal_TM_GEARPOS_P_DETSUB_b ComScl_Gbx_RawSignal_TM_GEARPOS_P_DET_b ComScl_Gbx_RawSignal_TM_GEARPOS_P_REQSUB_b ComScl_Gbx_RawSignal_TM_HACCUT_REQ_b ComScl_Gbx_RawSignal_TM_HEAVY_DEC_FLAG_b ComScl_Gbx_RawSignal_TM_IDLE_STOP_CONDITION_b ComScl_Gbx_RawSignal_TM_IDLE_STOP_OK_b ComScl_Gbx_RawSignal_TM_IDLE_STOP_TRIGGER_b ComScl_Gbx_RawSignal_TM_IG1_STATE_b ComScl_Gbx_RawSignal_TM_IG1_VOLTAGE_u16 ComScl_Gbx_RawSignal_TM_LC_INFORMATION_u8 ComScl_Gbx_RawSignal_TM_LIMP_HOME_MODE_b ComScl_Gbx_RawSignal_TM_MAP_CC_u8 ComScl_Gbx_RawSignal_TM_MIL_REQUEST_b ComScl_Gbx_RawSignal_TM_M_MODE_RUN_b ComScl_Gbx_RawSignal_TM_N_TC_u16 ComScl_Gbx_RawSignal_TM_OVERALL_FILTERED_RATIO_u16 ComScl_Gbx_RawSignal_TM_RECOGNITION_VOLTAGE_u16 ComScl_Gbx_RawSignal_TM_REQ_ENG_TORQUE_FAST_s16 ComScl_Gbx_RawSignal_TM_REQ_ENG_TORQUE_SLOW_s16 ComScl_Gbx_RawSignal_TM_REQ_MAX_FC_LIMT_ENG_SPEED_u8 ComScl_Gbx_RawSignal_TM_REQ_MAX_TQ_LIMT_ENG_SPEED_u8 ComScl_Gbx_RawSignal_TM_REQ_MIN_IDLE_ENG_SPEED_u8 ComScl_Gbx_RawSignal_TM_SHFT_IND_RECOM_DOWN_b ComScl_Gbx_RawSignal_TM_SHFT_IND_RECOM_UP_b ComScl_Gbx_RawSignal_TM_SHIFT_CONTROL_MODE_u8 ComScl_Gbx_RawSignal_TM_START_ENABLESUB_b ComScl_Gbx_RawSignal_TM_START_ENABLE_b ComScl_Gbx_RawSignal_TM_TORQUE_CONVERTER_SLIP_u16 ComScl_Gbx_RawSignal_TM_TORQUE_CONV_TORQUE_RATIO_u16 ComScl_Gbx_RawSignal_TM_TORQUE_LOSSES_s16 ComScl_Gbx_RawSignal_TM_TRQ_CONTROL_MODE_FAST_DNREQ_b ComScl_Gbx_RawSignal_TM_TRQ_CONTROL_MODE_SLOW_DNREQ_b ComScl_Gbx_RawSignal_TM_TRS_DRV_RATIO_u8 ComScl_Gbx_RawSignal_TM_VEHICLE_SPEED_u16 ComScl_Gbx_RawSignal_TM_VLVW_u16 ComScl_Gbx_RawSignal_TM_VSA_INH_b ComScl_Gbx_RawSignal_TM_WRITE_VIN_CLEAR_DONE_b ComScl_Gw_RawSignal_GW_ALIVE_COUNTER_40E_u8 ComScl_Gw_RawSignal_GW_ALIVE_COUNTER_444_u8 ComScl_Gw_RawSignal_GW_CHECKSUM_40E_u8 ComScl_Gw_RawSignal_GW_CHECKSUM_444_u8 ComScl_Gw_RawSignal_GW_IG1_STATE_b ComScl_Gw_RawSignal_GW_IG1_VOLTAGE_u16 ComScl_Gw_RawSignal_GW_RECOGNITION_VOLTAGE_u16 ComScl_Gw_RawSignal_IMG_ALIVE_COUNTER_082_u8 ComScl_Gw_RawSignal_IMG_ALIVE_COUNTER_084_u8 ComScl_Gw_RawSignal_IMG_ALIVE_COUNTER_22B_u8 ComScl_Gw_RawSignal_IMG_ALIVE_COUNTER_2F1_u8 ComScl_Gw_RawSignal_IMG_CHECKSUM_082_u8 ComScl_Gw_RawSignal_IMG_CHECKSUM_084_u8 ComScl_Gw_RawSignal_IMG_CHECKSUM_22B_u8 ComScl_Gw_RawSignal_IMG_CHECKSUM_2F1_u8 ComScl_Gw_RawSignal_IMG_DRVTRQ_STATUS_u8 ComScl_Gw_RawSignal_IMG_ENG_CAN_RECIEVE_ERROR_b ComScl_Gw_RawSignal_IMG_F_WVINCLDN_b ComScl_Gw_RawSignal_IMG_IDS_GRP_A5_MODE_u8 ComScl_Gw_RawSignal_IMG_IS_BHOLD_ACT_b ComScl_Gw_RawSignal_IMG_IS_BHOLD_STANBY_b ComScl_Gw_RawSignal_IMG_IS_BRKCNT_ADAS_b ComScl_Gw_RawSignal_IMG_IS_INHIBITBRK_b ComScl_Gw_RawSignal_IMG_IS_RELEASE_REQUEST_b ComScl_Gw_RawSignal_IMG_IS_RESTART_INHIBITBRK_b ComScl_Gw_RawSignal_IMG_IS_SHIFT_INHBITBRK_b ComScl_Gw_RawSignal_IMG_IS_SYSOFFBRK_b ComScl_Gw_RawSignal_IMG_LIMTRQ_STATUS_u8 ComScl_Gw_RawSignal_IMG_MIL_REQ_b ComScl_Gw_RawSignal_IMG_REQ_BRK_CTRL_b ComScl_Gw_RawSignal_IMG_REQ_DRVTRQ_s16 ComScl_Gw_RawSignal_IMG_REQ_LIMTRQ_s16 ComScl_Gw_RawSignal_IMG_SHIFT_REQUEST_u8 ComScl_IDAS_RawSignal_IDAS_ALIVE_COUNTER_1EF_u8 ComScl_IDAS_RawSignal_IDAS_CHECKSUM_1EF_u8 ComScl_IDAS_RawSignal_IDAS_ISA_BASE_SPEED_u8 ComScl_PCU_RawSignal_PCU_ALIVE_COUNTER_1FB_u8 ComScl_PCU_RawSignal_PCU_CHECKSUM_1FB_u8 ComScl_PCU_RawSignal_PCU_INHBIT_START_ENG_b ComScl_StbIntv_RawSignal_EBB_ALIVE_COUNTER_1D5_u8 ComScl_StbIntv_RawSignal_EBB_BRAKE_PEDAL_ON_STATUS_u8 ComScl_StbIntv_RawSignal_EBB_BRAKE_PEDAL_ON_b ComScl_StbIntv_RawSignal_EBB_CHECKSUM_1D5_u8 ComScl_StbIntv_RawSignal_EBB_STATUS_1D5_u8 ComScl_StbIntv_RawSignal_VSA_ABS_CHECKSUM_1D0_u8 ComScl_StbIntv_RawSignal_VSA_ABS_CTRL_b ComScl_StbIntv_RawSignal_VSA_ABS_EBD_ACT_b ComScl_StbIntv_RawSignal_VSA_ABS_EBD_MIL_b ComScl_StbIntv_RawSignal_VSA_ABS_FAIL_FL_VW_SENSOR_b ComScl_StbIntv_RawSignal_VSA_ABS_FAIL_FR_VW_SENSOR_b ComScl_StbIntv_RawSignal_VSA_ABS_FAIL_RL_VW_SENSOR_b ComScl_StbIntv_RawSignal_VSA_ABS_FAIL_RR_VW_SENSOR_b ComScl_StbIntv_RawSignal_VSA_ABS_FL_WHEEL_SPEED_u16 ComScl_StbIntv_RawSignal_VSA_ABS_FR_WHEEL_SPEED_u16 ComScl_StbIntv_RawSignal_VSA_ABS_RL_WHEEL_SPEED_u16 ComScl_StbIntv_RawSignal_VSA_ABS_RR_WHEEL_SPEED_u16 ComScl_StbIntv_RawSignal_VSA_ACC_BRAKE_ACT_b ComScl_StbIntv_RawSignal_VSA_ALIVECOUNTER_1AC_u8 ComScl_StbIntv_RawSignal_VSA_ALIVE_COUNTER_12E_u8 ComScl_StbIntv_RawSignal_VSA_ALIVE_COUNTER_1A4_u8 ComScl_StbIntv_RawSignal_VSA_ALIVE_COUNTER_1B0_u8 ComScl_StbIntv_RawSignal_VSA_CASEN_b ComScl_StbIntv_RawSignal_VSA_CAS_ACT_b ComScl_StbIntv_RawSignal_VSA_CHECKSUM_12E_u8 ComScl_StbIntv_RawSignal_VSA_CHECKSUM_1A4_u8 ComScl_StbIntv_RawSignal_VSA_CHECKSUM_1AC_u8 ComScl_StbIntv_RawSignal_VSA_CHECKSUM_1B0_u8 ComScl_StbIntv_RawSignal_VSA_DRV_BRKTRQ_AYCI_u16 ComScl_StbIntv_RawSignal_VSA_DRV_BRKTRQ_u16 ComScl_StbIntv_RawSignal_VSA_FAIL_LONG_G_SENSOR_b ComScl_StbIntv_RawSignal_VSA_FAIL_MC_PRESSURE_SENSOR_b ComScl_StbIntv_RawSignal_VSA_FAIL_YAW_RATE_SENSOR_b ComScl_StbIntv_RawSignal_VSA_INHBIT_LAT_G_SENSOR_b ComScl_StbIntv_RawSignal_VSA_INHBIT_LONG_G_SENSOR_b ComScl_StbIntv_RawSignal_VSA_INHBIT_MC_PRESSURE_SENSOR_b ComScl_StbIntv_RawSignal_VSA_INHBIT_STEERING_SENSOR_b ComScl_StbIntv_RawSignal_VSA_INHBIT_YAW_RATE_SENSOR_b ComScl_StbIntv_RawSignal_VSA_ISAB_ACT_b ComScl_StbIntv_RawSignal_VSA_ISAB_ENABLE_b ComScl_StbIntv_RawSignal_VSA_LAMP_STATUS_VSA_OFF_b ComScl_StbIntv_RawSignal_VSA_MASTER_CYLINDER_PRESSURE_u16 ComScl_StbIntv_RawSignal_VSA_REQ_MSR_PLUS_TRQ_b ComScl_StbIntv_RawSignal_VSA_REQ_TRQ_1AC_s16 ComScl_StbIntv_RawSignal_VSA_REWRITE_START_b ComScl_StbIntv_RawSignal_VSA_SHIFT_REQ_1AC_u8 ComScl_StbIntv_RawSignal_VSA_TRQ_CONTROL_MODE_u8 ComScl_StbIntv_RawSignal_VSA_TRQ_DOWN_REQ_FUEL_CUT_u8 ComScl_StbIntv_RawSignal_VSA_VSA_CTRL_b ComScl_StbIntv_RawSignal_VSA_VSA_TCS_ACT_b ComScl_StbIntv_RawSignal_VSA_VSA_TCS_MIL_b ComScl_StbIntv_RawSignal_VSA_WARN_STATUS_ABS_b ComScl_Strg_RawSignal_EPS_ALIVE_COUNTER_1AB_u8 ComScl_Strg_RawSignal_EPS_CHECKSUM_1AB_u8 ComScl_Strg_RawSignal_EPS_IS_RELEASE_REQUEST_b ComScl_Strg_RawSignal_EPS_IS_SHIFT_INHIBIT_REQUEST_b ComScl_Strg_RawSignal_EPS_LOAD_u16 ComScl_Strg_RawSignal_EPS_MID_REQ_b /end LOC_MEASUREMENT
 FUNCTION_VERSION "4.17.3_6.0.0" /end FUNCTION
/begin FUNCTION rba_Dme "1.45.0  McFunction rba_Dme Created by MCFunctionUpdater"
 /begin LOC_MEASUREMENT rba_Dme_Ovl_stEnable rba_Dme_adrError rba_Dme_numBytesAvailable rba_Dme_numBytesAvailableOvl /end LOC_MEASUREMENT
 FUNCTION_VERSION "1.45.0" /end FUNCTION
/begin FUNCTION rba_IoExtLib "1.24.1    Library for external devices"
 /begin LOC_MEASUREMENT rba_IoExtLib_KeepAliveDrvErrCyc_u32 rba_IoExtLib_KeepAliveDrvErrPerm_u32 rba_IoExtLib_KeepAliveIniErrCyc_u32 rba_IoExtLib_KeepAliveIniErrPerm_u32 /end LOC_MEASUREMENT
 FUNCTION_VERSION "1.24.1" /end FUNCTION
/begin FUNCTION rba_OsShell "1.42.0  McFunction rba_OsShell Created by MCFunctionUpdater"
 /begin LOC_MEASUREMENT rba_OsShell_Cntr1000msTask rba_OsShell_Cntr100msTask rba_OsShell_Cntr10msTask rba_OsShell_Cntr1msTask rba_OsShell_Cntr200msTask rba_OsShell_Cntr20msTask rba_OsShell_Cntr2msTask rba_OsShell_Cntr50msTask rba_OsShell_Cntr5msTask rba_OsShell_CntrAsw1BgTask rba_OsShell_CntrAsw2BgTask rba_OsShell_CntrBswBgTask rba_OsShell_CntrCalWup100msTask rba_OsShell_CntrCalWup10msTask rba_OsShell_CntrCalWup20msTask rba_OsShell_CntrCalWup2msTask rba_OsShell_CntrCalWupAsw110msTask rba_OsShell_CntrCalWupAsw210msTask rba_OsShell_CntrCalWupBgTask rba_OsShell_CntrCalWupIniEndTask rba_OsShell_CntrCalWupIniTask rba_OsShell_CntrDSMClearTask rba_OsShell_CntrDSMReiniTask rba_OsShell_CntrEngReStrtDummyTask rba_OsShell_CntrEngReStrtModeMTask rba_OsShell_CntrEngReStrtTask rba_OsShell_CntrEpmNoSyncTask rba_OsShell_CntrErrLimit1000msTask rba_OsShell_CntrErrLimit100msTask rba_OsShell_CntrErrLimit10msTask rba_OsShell_CntrErrLimit1msTask rba_OsShell_CntrErrLimit200msTask rba_OsShell_CntrErrLimit20msTask rba_OsShell_CntrErrLimit2msTask rba_OsShell_CntrErrLimit50msTask rba_OsShell_CntrErrLimit5msTask rba_OsShell_CntrErrLimitAsw1BgTask rba_OsShell_CntrErrLimitAsw2BgTask rba_OsShell_CntrErrLimitBswBgTask rba_OsShell_CntrErrLimitCalWup100msTask rba_OsShell_CntrErrLimitCalWup10msTask rba_OsShell_CntrErrLimitCalWup20msTask rba_OsShell_CntrErrLimitCalWup2msTask rba_OsShell_CntrErrLimitCalWupAsw110msTask rba_OsShell_CntrErrLimitCalWupAsw210msTask rba_OsShell_CntrErrLimitCalWupBgTask rba_OsShell_CntrErrLimitCalWupIniEndTask rba_OsShell_CntrErrLimitCalWupIniTask rba_OsShell_CntrErrLimitDSMClearTask rba_OsShell_CntrErrLimitDSMReiniTask rba_OsShell_CntrErrLimitEngReStrtDummyTask rba_OsShell_CntrErrLimitEngReStrtModeMTask rba_OsShell_CntrErrLimitEngReStrtTask rba_OsShell_CntrErrLimitEpmNoSyncTask rba_OsShell_CntrErrLimitInfraAsw1App10msTask rba_OsShell_CntrErrLimitInfraAsw2App10msTask rba_OsShell_CntrErrLimitInfraBswApp10msTask rba_OsShell_CntrErrLimitIniDrvTask rba_OsShell_CntrErrLimitIniEndTask rba_OsShell_CntrErrLimitIniTask rba_OsShell_CntrErrLimitMoSyncFirstTask rba_OsShell_CntrErrLimitMoSyncIniTask rba_OsShell_CntrErrLimitMoSyncS0Task rba_OsShell_CntrErrLimitMoSyncS1Task rba_OsShell_CntrErrLimitMoTask rba_OsShell_CntrErrLimitReIniModeMTask rba_OsShell_CntrErrLimitReIniTask rba_OsShell_CntrErrLimitShutdown10msTask rba_OsShell_CntrErrLimitShutdownAsw1Task rba_OsShell_CntrErrLimitShutdownAsw2Task rba_OsShell_CntrErrLimitShutdownBswTask rba_OsShell_CntrErrLimitShutdownSeqTask rba_OsShell_CntrErrLimitStopCntrWakeup100msTask rba_OsShell_CntrErrLimitStopCntrWakeup10msTask rba_OsShell_CntrErrLimitStopCntrWakeup1msTask rba_OsShell_CntrErrLimitStopCntrWakeup20msTask rba_OsShell_CntrErrLimitStopCntrWakeup2msTask rba_OsShell_CntrErrLimitStopCntrWakeup5msTask rba_OsShell_CntrErrLimitStopCntrWakeupAsw110msTask rba_OsShell_CntrErrLimitStopCntrWakeupAsw1BgTask rba_OsShell_CntrErrLimitStopCntrWakeupAsw210msTask rba_OsShell_CntrErrLimitStopCntrWakeupAsw2BgTask rba_OsShell_CntrErrLimitStopCntrWakeupIniEndTask rba_OsShell_CntrErrLimitStopCntrWakeupIniTask rba_OsShell_CntrErrLimitSyncFirstTask rba_OsShell_CntrErrLimitSyncIniTask rba_OsShell_CntrErrLimitSyncPreTask rba_OsShell_CntrErrLimitSyncS0Task rba_OsShell_CntrErrLimitSyncS1Task rba_OsShell_CntrInfraAsw1App10msTask rba_OsShell_CntrInfraAsw2App10msTask rba_OsShell_CntrInfraBswApp10msTask rba_OsShell_CntrIniDrvTask rba_OsShell_CntrIniEndTask rba_OsShell_CntrIniTask rba_OsShell_CntrMoSyncFirstTask rba_OsShell_CntrMoSyncIniTask rba_OsShell_CntrMoSyncS0Task rba_OsShell_CntrMoSyncS1Task rba_OsShell_CntrMoTask rba_OsShell_CntrReIniModeMTask rba_OsShell_CntrReIniTask rba_OsShell_CntrShutdown10msTask rba_OsShell_CntrShutdownAsw1Task rba_OsShell_CntrShutdownAsw2Task rba_OsShell_CntrShutdownBswTask rba_OsShell_CntrShutdownSeqTask rba_OsShell_CntrStopCntrWakeup100msTask rba_OsShell_CntrStopCntrWakeup10msTask rba_OsShell_CntrStopCntrWakeup1msTask rba_OsShell_CntrStopCntrWakeup20msTask rba_OsShell_CntrStopCntrWakeup2msTask rba_OsShell_CntrStopCntrWakeup5msTask rba_OsShell_CntrStopCntrWakeupAsw110msTask rba_OsShell_CntrStopCntrWakeupAsw1BgTask rba_OsShell_CntrStopCntrWakeupAsw210msTask rba_OsShell_CntrStopCntrWakeupAsw2BgTask rba_OsShell_CntrStopCntrWakeupIniEndTask rba_OsShell_CntrStopCntrWakeupIniTask rba_OsShell_CntrSyncFirstTask rba_OsShell_CntrSyncIniTask rba_OsShell_CntrSyncPreTask rba_OsShell_CntrSyncS0Task rba_OsShell_CntrSyncS1Task rba_OsShell_cntrErrAccess rba_OsShell_cntrErrCallevel rba_OsShell_cntrErrId rba_OsShell_cntrErrLimitSum rba_OsShell_cntrErrNoFunc rba_OsShell_cntrErrResource rba_OsShell_cntrErrState rba_OsShell_cntrErrSum rba_OsShell_cntrErrValue rba_OsShell_tiPowerOnFrst10ms rba_OsShell_tiResetFrst10ms /end LOC_MEASUREMENT
 FUNCTION_VERSION "1.42.0" /end FUNCTION
/begin FUNCTION rba_SyC_ObservationCounter "1.8.0     System Control Observation Counter"
 /begin LOC_MEASUREMENT rba_SyC_ObservationCounters_IrrSwOffTrigEngRun_Value_MP rba_SyC_ObservationCounters_IrrSwOff_Value_MP /end LOC_MEASUREMENT
 FUNCTION_VERSION "1.8.0" /end FUNCTION
/begin FUNCTION rba_SyC_Power "1.6.0  McFunction rba_SyC_Power Created by MCFunctionUpdater" /begin LOC_MEASUREMENT rba_SyC_PowerOn_Reasons_MP /end LOC_MEASUREMENT FUNCTION_VERSION "1.6.0" /end FUNCTION
/begin FUNCTION rba_SyC_Rtc "1.5.0  McFunction rba_SyC_Rtc Created by MCFunctionUpdater"
 /begin LOC_MEASUREMENT rba_SyC_Rtc_EcuOffTime_Validity_MP rba_SyC_Rtc_EcuOffTime_Value_MP /end LOC_MEASUREMENT
 FUNCTION_VERSION "1.5.0" /end FUNCTION
/*********** End of merged FUNCTION blocks ***********/
/begin FUNCTION ACClntP_DD "199.0.0   AC Coolant Pressure Device Driver"
 /begin DEF_CHARACTERISTIC AirC_nEngLoLim_C AirC_pClntTransfAna_CUR AirC_swtAnaClntPres_C AirC_tAirLoLim_C AirC_uSRCMaxClntPres_C AirC_uSRCMinClntPres_C /end DEF_CHARACTERISTIC
 /begin IN_MEASUREMENT AirC_stSwt AirC_stSwtPrs EnvT_t Epm_nEng /end IN_MEASUREMENT
 /begin OUT_MEASUREMENT ACClntP_bCodAvl AirC_pAnaClnt AirC_uAnaRawClnt /end OUT_MEASUREMENT
 FUNCTION_VERSION "199.0.0" /end FUNCTION
/begin FUNCTION ACClntP_VD "199.0.0   AC Coolant Pressure Virtual Device"
 /begin DEF_CHARACTERISTIC AirC_pDfl_C AirC_RmpSlpClntP.Pos_C AirC_RmpSlpClntP.Neg_C AirC_tiPT1_C AirC_TransStgClntP.Dfl_C AirC_TransStgClntP.stSensId_C /end DEF_CHARACTERISTIC
 /begin IN_MEASUREMENT AirC_pAnaClnt /end IN_MEASUREMENT
 /begin OUT_MEASUREMENT AirC_pClnt /end OUT_MEASUREMENT
 FUNCTION_VERSION "199.0.0" /end FUNCTION
/begin FUNCTION ACCmpr_DD "35.0.0    AC Compressor Device Driver"
 /begin DEF_CHARACTERISTIC ACCmpr_numTstMax_C ACCmpr_tiBtwTstOT_C ACCmpr_tiBtwTstSCB_C AirCCmpr_ATS.LimitTypeMsk_C AirCCmpr_ATS.CnvNorm_C AirCCmpr_ATS.LowLim_C AirCCmpr_ATS.UpLim_C AirCCmpr_ATS.CnvFac_C AirCCmpr_ATS.CnvOfs_C AirCCmpr_ATS.DfltVal_C AirC_stCmprPsDiaDisbl_C AirC_stCmprPsDisbl_C AirC_stCmprTyp_CW AirC_trqCmprMin_C /end DEF_CHARACTERISTIC
 /begin IN_MEASUREMENT AC_trqMaxAC DevLib_stPwrStgEnaCond /end IN_MEASUREMENT
 /begin OUT_MEASUREMENT AirC_stCmprAct AirC_stPsCmpr AirC_trqCmprMax AirC_trqDes /end OUT_MEASUREMENT
 /begin LOC_MEASUREMENT ACCmpr_flgPsCmprDes /end LOC_MEASUREMENT
 FUNCTION_VERSION "35.0.0" /end FUNCTION
/*********** Start of merged COMPU_METHOD blocks ***********/
/begin COMPU_METHOD RB_RBA_Common_CentralElements_CompuMethods_Identical "The internal value and the physical one are identical. No physical unit available" RAT_FUNC "%10.5" "noUnit" COEFFS 0.0 1.0 0.0 0.0 0.0 1.0 REF_UNIT RB_RBA_Common_CentralElements_Units_NoUnit /end COMPU_METHOD
/begin COMPU_METHOD RB_RBA_rba_SyC_Rtc_BswModuleDescriptions_rba_SyC_Rtc_EcuOffTime_CompuMethod "CompuMethod for EcuOffTime in System Control" TAB_VERB "%10.5" "nounit" COMPU_TAB_REF RB_RBA_rba_SyC_Rtc_BswModuleDescriptions_rba_SyC_Rtc_EcuOffTime_CompuMethod REF_UNIT RB_RBA_rba_SyC_Rtc_Units_NoUnit /end COMPU_METHOD
/begin COMPU_METHOD DefaultIdenticalCompu "" RAT_FUNC "%10.5" "" COEFFS 0.0 1.0 0.0 0.0 0.0 1.0 /end COMPU_METHOD
/begin COMPU_VTAB RB_RBA_rba_SyC_Rtc_BswModuleDescriptions_rba_SyC_Rtc_EcuOffTime_CompuMethod "CompuMethod for EcuOffTime in System Control" TAB_VERB 12 0 "RBA_SYC_RTC_ECUOFFTIME_VALIDITY_UNKNOWN" 1 "RBA_SYC_RTC_ECUOFFTIME_VALIDITY_VALID" 2 "RBA_SYC_RTC_ECUOFFTIME_VALIDITY_INVALID_DISABLED" 3 "RBA_SYC_RTC_ECUOFFTIME_VALIDITY_INVALID_READ_ERROR" 4 "RBA_SYC_RTC_ECUOFFTIME_VALIDITY_INVALID_IRRSWOFF" 5 "RBA_SYC_RTC_ECUOFFTIME_VALIDITY_INVALID_POWERFAIL" 6 "RBA_SYC_RTC_ECUOFFTIME_VALIDITY_INVALID_WRONG_MODE" 7 "RBA_SYC_RTC_ECUOFFTIME_VALIDITY_INVALID_NOT_RUNNING" 8 "RBA_SYC_RTC_ECUOFFTIME_VALIDITY_INVALID_STORAGE_ERROR" 9 "RBA_SYC_RTC_ECUOFFTIME_VALIDITY_INVALID_EXTERNAL" 10 "RBA_SYC_RTC_ECUOFFTIME_VALIDITY_VALID_EXPIRED" 11 "RBA_SYC_RTC_ECUOFFTIME_VALIDITY_INVALID_DATA" /end COMPU_VTAB
/begin COMPU_METHOD AIRMOD_BASCONLY_SC_Compu "" TAB_VERB "%6.3" "" COMPU_TAB_REF AIRMOD_BASCONLY_SC_Compu /end COMPU_METHOD
/begin COMPU_VTAB AIRMOD_BASCONLY_SC_Compu "" TAB_VERB 2 0 "False" 1 "True" /end COMPU_VTAB
/begin COMPU_METHOD AIRMOD_VAR_SY_Compu "" TAB_VERB "%6.3" "" COMPU_TAB_REF AIRMOD_VAR_SY_Compu /end COMPU_METHOD
/begin COMPU_VTAB AIRMOD_VAR_SY_Compu "" TAB_VERB 50 0 "kein Kundenbezug" 1 "DAI" 3 "VWW" 4 "POR" 5 "AUD" 6 "OPE" 9 "FIA" 11 "BMW" 14 "PSA" 15 "REN" 17 "ALF" 18 "SAB" 19 "VOL" 20 "NIS" 21 "GMU" 22 "FOR" 26 "IMJ" 36 "MAN" 51 "SEA" 53 "CHR" 54 "JAG" 55 "ROL" 69 "FER" 72 "TOY" 123 "MIT" 147 "HYU" 159 "HON" 160 "MAZ" 183 "CU" 190 "LRG" 204 "VVW" 214 "AVT" 242 "Iveco" 243 "DMC" 248 "SUZ" 267 "SSANGYONG" 270 "KEF" 289 "AMG" 308 "TAT" 319 "MVM" 385 "UAES" 578 "AL" 590 "Scania" 760 "WEICHAI" 828 "RBCD" 966 "International" 998 "S1" 999 "ALL" 2887 "NONOX" 9454 "Fuso" /end COMPU_VTAB
/begin COMPU_METHOD AirMsPrTime_q0p0003_COMPU "" RAT_FUNC "%6.5" "g/s" COEFFS 0 3333.33333333333 0 0 0 1 /end COMPU_METHOD
/begin COMPU_METHOD AirMs_q0p1_COMPU "" RAT_FUNC "%6.3" "g" COEFFS 0 10 0 0 0 1 /end COMPU_METHOD
/begin COMPU_METHOD AIRPIN_TYPAVL_SY_Compu "" TAB_VERB "%6.3" "" COMPU_TAB_REF AIRPIN_TYPAVL_SY_Compu /end COMPU_METHOD
/begin COMPU_VTAB AIRPIN_TYPAVL_SY_Compu "" TAB_VERB 2 0 "False" 1 "True" /end COMPU_VTAB
/begin COMPU_METHOD AIRPOUT_TYPAVL_SC_Compu "" TAB_VERB "%6.3" "" COMPU_TAB_REF AIRPOUT_TYPAVL_SC_Compu /end COMPU_METHOD
/begin COMPU_VTAB AIRPOUT_TYPAVL_SC_Compu "" TAB_VERB 2 0 "False" 1 "True" /end COMPU_VTAB
/begin COMPU_METHOD AIRSNSR_DSQACTVT_SC_Compu "" TAB_VERB "%6.3" "" COMPU_TAB_REF AIRSNSR_DSQACTVT_SC_Compu /end COMPU_METHOD
/begin COMPU_VTAB AIRSNSR_DSQACTVT_SC_Compu "" TAB_VERB 2 0 "False" 1 "True" /end COMPU_VTAB
/begin COMPU_METHOD AIRSNSR_PSCCENGSTRT_SC_Compu "" TAB_VERB "%6.3" "" COMPU_TAB_REF AIRSNSR_PSCCENGSTRT_SC_Compu /end COMPU_METHOD
/begin COMPU_VTAB AIRSNSR_PSCCENGSTRT_SC_Compu "" TAB_VERB 2 0 "False" 1 "True" /end COMPU_VTAB
/begin COMPU_METHOD AirSysDdT_ms "" RAT_FUNC "%13.3" "ms" COEFFS 0 0 1 0 9.31322574615479e-006 0 /end COMPU_METHOD
/begin COMPU_METHOD AirSysSwt "" RAT_FUNC "%10.9" "-" COEFFS 0 16384000 0 0 0 1 /end COMPU_METHOD
/begin COMPU_METHOD AirSysSwt_S16 "" RAT_FUNC "%7.6" "-" COEFFS 0 16384 0 0 0 1 /end COMPU_METHOD
/begin COMPU_METHOD AIRSYS_ASYMC_SC_Compu "" TAB_VERB "%6.3" "" COMPU_TAB_REF AIRSYS_ASYMC_SC_Compu /end COMPU_METHOD
/begin COMPU_VTAB AIRSYS_ASYMC_SC_Compu "" TAB_VERB 2 0 "False" 1 "True" /end COMPU_VTAB
/begin COMPU_METHOD AIRTIN_TYPAVL_SC_Compu "" TAB_VERB "%6.3" "" COMPU_TAB_REF AIRTIN_TYPAVL_SC_Compu /end COMPU_METHOD
/begin COMPU_VTAB AIRTIN_TYPAVL_SC_Compu "" TAB_VERB 2 0 "False" 1 "True" /end COMPU_VTAB
/begin COMPU_METHOD AIRTOUT_TYPAVL_SY_Compu "" TAB_VERB "%6.3" "" COMPU_TAB_REF AIRTOUT_TYPAVL_SY_Compu /end COMPU_METHOD
/begin COMPU_VTAB AIRTOUT_TYPAVL_SY_Compu "" TAB_VERB 2 0 "False" 1 "True" /end COMPU_VTAB
/begin COMPU_METHOD AirVolPerTime "" RAT_FUNC "%6.3" "m^3/h" COEFFS 0 10 0 0 0 1 /end COMPU_METHOD
/begin COMPU_METHOD AIR_PCMPR2USPRES_SY_Compu "" TAB_VERB "%6.3" "" COMPU_TAB_REF AIR_PCMPR2USPRES_SY_Compu /end COMPU_METHOD
/begin COMPU_VTAB AIR_PCMPR2USPRES_SY_Compu "" TAB_VERB 2 0 "False" 1 "True" /end COMPU_VTAB
/begin COMPU_METHOD AltChpTemp_q8p0_COMPU "" RAT_FUNC "%6.2" "deg C" COEFFS 0 0.125 4 0 0 1 /end COMPU_METHOD
/begin COMPU_METHOD AltCrntLim_A_q0p25_COMPU "" RAT_FUNC "%6.3" "A" COEFFS 0 4 0 0 0 1 /end COMPU_METHOD
/begin COMPU_METHOD AltCrntOut_A_q0p125_COMPU "" RAT_FUNC "%6.3" "A" COEFFS 0 8 0 0 0 1 /end COMPU_METHOD
/begin COMPU_METHOD ALTCTRLTYP_SC_Compu "" TAB_VERB "%6.3" "" COMPU_TAB_REF ALTCTRLTYP_SC_Compu /end COMPU_METHOD
/begin COMPU_VTAB ALTCTRLTYP_SC_Compu "" TAB_VERB 7 0 "0" 1 "1" 2 "2" 3 "3" 4 "4" 5 "5" 6 "6" /end COMPU_VTAB
/begin COMPU_METHOD ALTIFTYP_SC_Compu "" TAB_VERB "%6.3" "" COMPU_TAB_REF ALTIFTYP_SC_Compu /end COMPU_METHOD
/begin COMPU_VTAB ALTIFTYP_SC_Compu "" TAB_VERB 2 0 "ALTIFTYP_0" 1 "ALTIFTYP_LOAD" /end COMPU_VTAB
/begin COMPU_METHOD ALTIOENA_SC_Compu "" TAB_VERB "%6.3" "" COMPU_TAB_REF ALTIOENA_SC_Compu /end COMPU_METHOD
/begin COMPU_VTAB ALTIOENA_SC_Compu "" TAB_VERB 2 0 "False" 1 "True" /end COMPU_VTAB
/begin COMPU_METHOD AltLd_q3p125_COMPU "" RAT_FUNC "%6.2" "%" COEFFS 0 0.32 0 0 0 1 /end COMPU_METHOD
/begin COMPU_METHOD AltVltg_V_q0p1_COMPU "" RAT_FUNC "%6.2" "V" COEFFS 0 10 -106 0 0 1 /end COMPU_METHOD
/begin COMPU_METHOD Ampere "" RAT_FUNC "%6.3" "mA" COEFFS 0 5 0 0 0 1 /end COMPU_METHOD
/begin COMPU_METHOD Ampere_q0p1_COMPU "" RAT_FUNC "%6.3" "uA" COEFFS 0 10 0 0 0 1 /end COMPU_METHOD
/begin COMPU_METHOD AMPT2NOxMPT_COMPU "" RAT_FUNC "%6.5" "(mg/s)/(Kg/h)" COEFFS 0 1000 0 0 0 1 /end COMPU_METHOD
/begin COMPU_METHOD AMPTDer_COMPU "" RAT_FUNC "%6.4" "(Kg/h)/s" COEFFS 0 100 0 0 0 1 /end COMPU_METHOD
/begin COMPU_METHOD AMPTgPerSec "" RAT_FUNC "%6.4" "g/s" COEFFS 0 20 0 0 0 1 /end COMPU_METHOD
/begin COMPU_METHOD AMPT_NOx "" RAT_FUNC "%8.7" "g/s" COEFFS 0 100000 0 0 0 1 /end COMPU_METHOD
/begin COMPU_METHOD AMPT_NOxLdUnld "" RAT_FUNC "%7.6" "g/s" COEFFS 0 10000 0 0 0 1 /end COMPU_METHOD
/begin COMPU_METHOD AMPT_NOxRgn "" RAT_FUNC "%6.5" "g/s" COEFFS 0 2000 0 0 0 1 /end COMPU_METHOD
/begin COMPU_METHOD B_TRUE "" TAB_VERB "%6.3" "" COMPU_TAB_REF B_TRUE /end COMPU_METHOD
/begin COMPU_VTAB B_TRUE "" TAB_VERB 2 0 "FALSE" 1 "TRUE" /end COMPU_VTAB
/begin COMPU_METHOD EngN "" RAT_FUNC "%6.3" "rpm" COEFFS 0 2 0 0 0 1 /end COMPU_METHOD
/begin COMPU_METHOD OneToOne "" RAT_FUNC "%6.2" "-" COEFFS 0 1 0 0 0 1 /end COMPU_METHOD
/begin COMPU_METHOD PresAC_hPa "" RAT_FUNC "%6.2" "hPa" COEFFS 0 0.5 0 0 0 1 /end COMPU_METHOD
/begin COMPU_METHOD RmpPresAC_hPa "" RAT_FUNC "%6.4" "hPa/s" COEFFS 0 32.768 0 0 0 1 /end COMPU_METHOD
/begin COMPU_METHOD Temp_Cels "" RAT_FUNC "%6.1" "deg C" COEFFS 0 10 2731.4 0 0 1 /end COMPU_METHOD
/begin COMPU_METHOD TimeDelay_s "" RAT_FUNC "%6.1" "s" COEFFS 0 0 1 0 0.00023283064365387 0 /end COMPU_METHOD
/begin COMPU_METHOD Time_ms "" RAT_FUNC "%6.1" "ms" COEFFS 0 0.1 0 0 0 1 /end COMPU_METHOD
/begin COMPU_METHOD Time_s "" RAT_FUNC "%6.4" "s" COEFFS 0 100 0 0 0 1 /end COMPU_METHOD
/begin COMPU_METHOD Trq "" RAT_FUNC "%6.3" "Nm" COEFFS 0 10 0 0 0 1 /end COMPU_METHOD
/begin COMPU_METHOD Volt "" RAT_FUNC "%6.3" "mV" COEFFS 0 5 0 0 0 1 /end COMPU_METHOD
/begin RECORD_LAYOUT Kw_Ws16 FNC_VALUES 1 SWORD COLUMN_DIR DIRECT /end RECORD_LAYOUT
/begin RECORD_LAYOUT Kw_Ws32 FNC_VALUES 1 SLONG COLUMN_DIR DIRECT /end RECORD_LAYOUT
/begin RECORD_LAYOUT Kw_Wu8 FNC_VALUES 1 UBYTE COLUMN_DIR DIRECT /end RECORD_LAYOUT
/begin RECORD_LAYOUT RB_Curve_S16_S16 NO_AXIS_PTS_X 1 SWORD AXIS_PTS_X 2 SWORD INDEX_INCR DIRECT FNC_VALUES 3 SWORD COLUMN_DIR DIRECT /end RECORD_LAYOUT
/begin RECORD_LAYOUT RB_Val_Ws16 FNC_VALUES 1 SWORD COLUMN_DIR DIRECT /end RECORD_LAYOUT
/begin RECORD_LAYOUT RB_Val_Wu16 FNC_VALUES 1 UWORD COLUMN_DIR DIRECT /end RECORD_LAYOUT
/begin RECORD_LAYOUT RB_Val_Wu8 FNC_VALUES 1 UBYTE COLUMN_DIR DIRECT /end RECORD_LAYOUT
/begin RECORD_LAYOUT Val_Ws16 FNC_VALUES 1 SWORD COLUMN_DIR DIRECT /end RECORD_LAYOUT
/begin RECORD_LAYOUT Val_Ws32 FNC_VALUES 1 SLONG COLUMN_DIR DIRECT /end RECORD_LAYOUT
/begin RECORD_LAYOUT Val_Wu8 FNC_VALUES 1 UBYTE COLUMN_DIR DIRECT /end RECORD_LAYOUT
/*********** Start of merged UNIT blocks ***********/
/begin UNIT RB_RBA_Common_CentralElements_Units_NoUnit "No Unit" "noUnit" EXTENDED_SI SI_EXPONENTS 0 0 0 0 0 0 0 /end UNIT
/begin UNIT RB_RBA_rba_SyC_Rtc_Units_NoUnit "No Unit" "nounit" EXTENDED_SI SI_EXPONENTS 0 0 0 0 0 0 0 /end UNIT
/end MODULE
/end PROJECT
