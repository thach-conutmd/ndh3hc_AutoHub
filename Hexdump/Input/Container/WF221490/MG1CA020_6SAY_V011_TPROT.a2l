ASAP2_VERSION 1 60
/begin PROJECT MG1CA020 "MG1CA020"
/begin HEADER "" VERSION "MG1CA020_6SAY_V011_TPROT" PROJECT_NO MG1CA020 /end HEADER
/begin MODULE DIM ""
/begin MOD_COMMON "" BYTE_ORDER MSB_LAST ALIGNMENT_BYTE 1 ALIGNMENT_WORD 2 ALIGNMENT_LONG 4 ALIGNMENT_INT64 4 ALIGNMENT_FLOAT32_IEEE 4 ALIGNMENT_FLOAT64_IEEE 4 DATA_SIZE 32 /end MOD_COMMON
/begin CHARACTERISTIC CWRKAKAP "Additive error Codeword" VALUE 0x8051CA50 RB_Val_Wu8 255.0 dez 0.00 255.0 FORMAT "%5.1" /end CHARACTERISTIC
/begin CHARACTERISTIC DSDLUTSIMN "Min-limit integrator delta standard deviation engine roughness" VALUE 0x8051CA54 RB_Val_Ws16 465.6542 lu_MEx -232.8306 232.8235 FORMAT "%8.4" /end CHARACTERISTIC
/begin CHARACTERISTIC DSDLUTSIMX "Max-limit integrator delta standard deviation engine roughness" VALUE 0x8051CA56 RB_Val_Ws16 465.6542 lu_MEx -232.8306 232.8235 FORMAT "%8.4" /end CHARACTERISTIC
/begin CHARACTERISTIC EngStrt_stStdDeEngRoughns_C "Codeword configuration for standard deviation of engine roughness function." VALUE 0x8051C980 RB_Val_Wu8 255.0 dez 0.00 255.0 FORMAT "%5.1" /end CHARACTERISTIC
/begin CHARACTERISTIC EpmCrS_facGapCrit1_C "factor for gap criteria one" VALUE 0x8053B000 Val_Wu8 15.94 EPM_FAC_PLAUS 0.00 15.94 FORMAT "%5.2" /end CHARACTERISTIC
/begin CHARACTERISTIC EpmCrS_facGapCrit2_C "factor for gap criteria two" VALUE 0x8053B001 Val_Wu8 15.94 EPM_FAC_PLAUS 0.00 15.94 FORMAT "%5.2" /end CHARACTERISTIC
/begin CHARACTERISTIC EpmCrS_facGapPlausHigh_CA "ratio to calculate the upper limit of the gap plausibility check of increment signal" VAL_BLK 0x8053B002 ValA_Wu8 15.94 EPM_FAC_PLAUS 0.00 15.94 FORMAT "%5.2" NUMBER 4 /end CHARACTERISTIC
/begin CHARACTERISTIC EpmCrS_facIncPlausHigh_CA "factor crankshaft signal plausibility check high" VAL_BLK 0x8053B006 ValA_Wu8 15.94 EPM_FAC_PLAUS 0.00 15.94 FORMAT "%5.2" NUMBER 4 /end CHARACTERISTIC
/begin CHARACTERISTIC EpmCrS_facIncPlausLow_CA "factor crankshaft signal plausibility check low" VAL_BLK 0x8053B00A ValA_Wu8 15.94 EPM_FAC_PLAUS 0.00 15.94 FORMAT "%5.2" NUMBER 4 /end CHARACTERISTIC
/begin CHARACTERISTIC EpmCrS_nMaxInc_C "max speed for one increment period" VALUE 0x8053B00E Val_Ws16 9980.000 EngN 20.00 10000.00 FORMAT "%8.2" EXTENDED_LIMITS -16384.00 16383.50 /end CHARACTERISTIC
/begin CHARACTERISTIC EpmCrS_nThreshRange_CA "array of speed thresholds for dynamic plaus" VAL_BLK 0x8053B010 ValA_Ws32 16384.198623855635 EngN2tiIncPer 20.000031000050 16404.198654855685 FORMAT "%19.13" EXTENDED_LIMITS 0.001940255267673 4166666.4583333433 NUMBER 3 /end CHARACTERISTIC
/begin CHARACTERISTIC EpmCrS_nTiIncPerAvrg_CA "engine speed thresholds to set the number of crankshaft teeth to calculate the average for one tooth time" VAL_BLK 0x8053B01C ValA_Ws16 16363.00 EngN 20.00 16383.00 FORMAT "%8.2" EXTENDED_LIMITS -16384.00 16383.50 NUMBER 4 /end CHARACTERISTIC
/begin CHARACTERISTIC EpmCrS_numAgClkDeltaCrsvMax_C "Permitted maximum number of angle differences which are above the maximum angle" VALUE 0x8053B024 Val_Wu8 26.00 OneToOne 6.00 32.00 FORMAT "%5.2" EXTENDED_LIMITS 0.00 255.0 /end CHARACTERISTIC
/begin CHARACTERISTIC EpmCrS_numIgnInc_C "number of teeth to supress crankshaft signal" VALUE 0x8053B025 Val_Wu8 254.0 OneToOne 1.0 255.0 FORMAT "%5.1" EXTENDED_LIMITS 0.00 255.0 /end CHARACTERISTIC
/begin CHARACTERISTIC EpmCrS_numIncTiAvrgPlaus_C "Number of increments for averaging increment duration as base for selection of plausibility parameters" VALUE 0x8053B026 Val_Wu16 50.00000 OneToOne 0.00 50.00000 FORMAT "%8.5" EXTENDED_LIMITS 0.00 65535.00 /end CHARACTERISTIC
/begin CHARACTERISTIC EpmCrS_numTiIncPerAvrg_CA "number of crankshaft teeth to calculate average of tooth time" VAL_BLK 0x8053B028 ValA_Wu8 50.00 OneToOne 0.00 50.00 FORMAT "%5.2" EXTENDED_LIMITS 0.00 255.0 NUMBER 4 /end CHARACTERISTIC
/begin CHARACTERISTIC EpmCrS_phiAgClkDeltaMax_C "Permitted maximum angle difference between the relative angle of the angle clock and the relative angle provided by the tooth counter" VALUE 0x8053B02C Val_Ws16 6.503906 AngleCrS 0.505371 7.009277 FORMAT "%8.6" EXTENDED_LIMITS -720.0000 719.9780 /end CHARACTERISTIC
/begin CHARACTERISTIC EpmCrS_stClrCntReSyncAgClkDeltaTot_C "Calibration value to reset the number of released re-synchronizations over all driving cycles" VALUE 0x8053B02E Val_Wu8 255.0 OneToOne 0.00 255.0 FORMAT "%5.1" /end CHARACTERISTIC
/begin CHARACTERISTIC EpmCrS_stTTMeasure_C "activate tooth time measurement" VALUE 0x8053B054 Val_Wu8 255.0 OneToOne 0.00 255.0 FORMAT "%5.1" /end CHARACTERISTIC
/begin CHARACTERISTIC EpmCrS_swtMeasActvnS1_C "Measurement of the crank-shaft tooth-times in S1-interrupt is activated (==1)" VALUE 0x8053B055 Val_Wu8 255.0 OneToOne 0.00 255.0 FORMAT "%5.1" /end CHARACTERISTIC
/begin CHARACTERISTIC EpmCrS_swtSnsrTyp_C "Type of Crankshaft Hybrid sensor" VALUE 0x8053B02F Val_Wu8 2.00000000000 EpmCrS_swtSnsrTyp_State_t 0.00 2.00000000000 FORMAT "%13.11" /end CHARACTERISTIC
/begin CHARACTERISTIC EpmCrS_tiGlitchFilterActv_CA "glitch filter time for active edge of crankshaft signal" VAL_BLK 0x8053B030 ValA_Ws32 20.0000000000 OneToOne_us 0.00 20.0000000000 FORMAT "%13.10" EXTENDED_LIMITS -2147483648.00 2147483647.00 NUMBER 4 /end CHARACTERISTIC
/begin CHARACTERISTIC EpmCrS_tiGlitchFilterInActv_CA "glitch filter time for inactive edge of crankshaft signal" VAL_BLK 0x8053B040 ValA_Ws32 20.0000000000 OneToOne_us 0.00 20.0000000000 FORMAT "%13.10" EXTENDED_LIMITS -2147483648.00 2147483647.00 NUMBER 4 /end CHARACTERISTIC
/begin CHARACTERISTIC EpmCrS_tiIgnSig_C "time to supress the crankshaft signal" VALUE 0x8053B050 Val_Ws32 100000.000000 OneToOne_ms 0.00 100000.000000 FORMAT "%13.6" EXTENDED_LIMITS -2147483648.00 2147483647.00 /end CHARACTERISTIC
/begin CHARACTERISTIC EpmHAgClk_numAddTick_CA "Increment distribution of additional ticks of angle clock" VAL_BLK 0x8053B056 ValA_Wu8 255.0 OneToOne 0.00 255.0 FORMAT "%5.1" NUMBER 5 /end CHARACTERISTIC
/begin CHARACTERISTIC EpmHCrS_nGapVldn_C "Lower engine speed threshold for verification of gap position" VALUE 0x8053B078 Val_Ws32 1666.6646430780697 EngN2tiIncPer 0.0019402552677 1666.6665833333375 FORMAT "%19.14" EXTENDED_LIMITS 0.001940255267673 4166666.4583333433 /end CHARACTERISTIC
/begin CHARACTERISTIC EpmHCrS_phiThdFBC_C "Angle threshold for distinction between future-past (function EpmHCrS_GetBufSegFBC)" VALUE 0x8053B06C Val_Ws16 719.9780 AngleCrS 0.00 719.9780 FORMAT "%8.4" EXTENDED_LIMITS -720.0000 719.9780 /end CHARACTERISTIC
/begin CHARACTERISTIC EpmHCrS_phiThdHi_C "Angle threshold for distinction between future-past (function EpmHCrS_GetBufSegHi)" VALUE 0x8053B06E Val_Ws16 719.9780 AngleCrS 0.00 719.9780 FORMAT "%8.4" EXTENDED_LIMITS -720.0000 719.9780 /end CHARACTERISTIC
/begin CHARACTERISTIC EpmHCrS_phiThdPer_C "Angle threshold for distinction between future-past (function EpmHCrS_GetBufPer)" VALUE 0x8053B074 Val_Ws16 1439.978 AngleCrS -720.0000 719.9780 FORMAT "%8.4" /end CHARACTERISTIC
/begin CHARACTERISTIC EpmHCrS_phiThdRaw_C "Angle threshold for distinction between future-past (function EpmHCrS_GetBufSegRaw)" VALUE 0x8053B070 Val_Ws16 719.9780 AngleCrS 0.00 719.9780 FORMAT "%8.4" EXTENDED_LIMITS -720.0000 719.9780 /end CHARACTERISTIC
/begin CHARACTERISTIC EpmHCrS_phiThd_C "Angle threshold for distinction between future-past (function EpmHCrS_GetBufSeg)" VALUE 0x8053B072 Val_Ws16 719.9780 AngleCrS 0.00 719.9780 FORMAT "%8.4" EXTENDED_LIMITS -720.0000 719.9780 /end CHARACTERISTIC
/begin CHARACTERISTIC EpmHCrS_tiEvlnOffsActv_C "Time distance from active edge where the signal processing to be done for Hybrid crankshaft sensor" VALUE 0x8053B060 Val_Wu32 499.000000000 InjTimeHiRes_us 1.000000000 500.000000000 FORMAT "%13.9" EXTENDED_LIMITS 0.00 214748364.750 /end CHARACTERISTIC
/begin CHARACTERISTIC EpmHCrS_tiSyncIniTout_C "Delay time for resynchronisation of crankshaft driver" VALUE 0x8053B064 Val_Wu32 800000.000000 InjTimeHiRes_us 0.00 800000.000000 FORMAT "%13.6" EXTENDED_LIMITS 0.00 214748364.750 /end CHARACTERISTIC
/begin CHARACTERISTIC EpmHCrS_tiSyncIniWait_C "Timeout time for execution of syncIni interrupt" VALUE 0x8053B068 Val_Wu32 100000.000000 InjTimeHiRes_us 0.00 100000.000000 FORMAT "%13.6" EXTENDED_LIMITS 0.00 214748364.750 /end CHARACTERISTIC
/begin CHARACTERISTIC EpmHCrS_tiToutEngStop_C "Timeout duration for engine stop state detection" VALUE 0x8053B05C Val_Wu32 3000000.00000 InjTimeHiRes_us 0.00 3000000.00000 FORMAT "%13.5" EXTENDED_LIMITS 0.00 214748364.750 /end CHARACTERISTIC
/begin CHARACTERISTIC EpmRRS_EnaIgnInj_CW "codeword of reverse rotation detection (engine shut off and starter active detection)" VALUE 0x8053B07C Val_Wu8 3.000 OneToOne 0.00 3.000 FORMAT "%5.3" EXTENDED_LIMITS 0.00 255.0 /end CHARACTERISTIC
/begin CHARACTERISTIC EpmRRS_nEngMaxCaS_C "Engine speed above which reverse rotation detection based on camshaft signal is disabled" VALUE 0x8053B07E Val_Ws16 3000.000 EngN 0.00 3000.000 FORMAT "%8.3" EXTENDED_LIMITS -16384.00 16383.50 /end CHARACTERISTIC
/begin CHARACTERISTIC EpmRRS_nEngMax_C "engine speed maximum for reverse rotation detection" VALUE 0x8053B080 Val_Ws16 1000.000 EngN 0.00 1000.000 FORMAT "%8.3" EXTENDED_LIMITS -16384.00 16383.50 /end CHARACTERISTIC
/begin CHARACTERISTIC EpmRRS_phiUndef_C "angle before TDC where reverse rotation detection is undefined" VALUE 0x8053B082 Val_Ws16 90.00000 AngleCrS 0.00 90.00000 FORMAT "%8.5" EXTENDED_LIMITS -720.0000 719.9780 /end CHARACTERISTIC
/begin CHARACTERISTIC EpmRRS_tiMaxToothTime_C "Upper limit for tooth timeout of engine stop detection" VALUE 0x8053B084 Val_Wu8 970.0 t_q10_ms 30. 1000. FORMAT "%5.0" EXTENDED_LIMITS 0.00 2550. /end CHARACTERISTIC
/begin CHARACTERISTIC EpmRRS_tiTemp_CUR "max tooth periods with reverse rotation depending on temperature" CURVE 0x8053B086 Cur_Xs16Ws16 32767.00 OneToOne_us 0.00 32767.00 FORMAT "%8.2" EXTENDED_LIMITS -32768.00 32767.00
 /begin AXIS_DESCR STD_AXIS EpmIf_tCoolant Temp_Cels 3 -3549.940 3003.560 FORMAT "%8.3" DEPOSIT ABSOLUTE /end AXIS_DESCR
/end CHARACTERISTIC
/begin CHARACTERISTIC EpmRRS_vVehMax_C "Engine speed theshold, below that reverse rotation detection is active" VALUE 0x8053B094 Val_Ws16 250.0000 vel_q0p01 0.00 250.0000 FORMAT "%8.4" EXTENDED_LIMITS -327.6800 327.6700 /end CHARACTERISTIC
/begin CHARACTERISTIC EpmSeq_nMaxStrtInt_C "max engine speed to perform a start interrupt" VALUE 0x8053B096 Val_Ws16 10000.00 EngN 0.00 10000.00 FORMAT "%8.2" EXTENDED_LIMITS -16384.00 16383.50 /end CHARACTERISTIC
/begin CHARACTERISTIC EpmSeq_phiIntBCr_CA "interrupt position before TDC during backup crankshaft" VAL_BLK 0x8053B098 ValA_Ws16 719.9780 AngleCrS 0.00 719.9780 FORMAT "%8.4" EXTENDED_LIMITS -720.0000 719.9780 NUMBER 2 /end CHARACTERISTIC
/begin CHARACTERISTIC EpmSeq_phiInt_CA "interrupt position related to TDC" VAL_BLK 0x8053B09C ValA_Ws16 719.9780 AngleCrS 0.00 719.9780 FORMAT "%8.4" EXTENDED_LIMITS -720.0000 719.9780 NUMBER 2 /end CHARACTERISTIC
/begin CHARACTERISTIC EpmSeq_phiStrtInt_CA "interrupt position related to TDC during start" VAL_BLK 0x8053B0A0 ValA_Ws16 719.9780 AngleCrS 0.00 719.9780 FORMAT "%8.4" EXTENDED_LIMITS -720.0000 719.9780 NUMBER 2 /end CHARACTERISTIC
/begin CHARACTERISTIC EpmSeq_swtInt_C "switch to activate/deactivate functionality of the sequence-manager" VALUE 0x8053B0A4 Val_Wu8 18.0000000000 EpmSeq_swtInt_Compu 0.00 18.0000000000 FORMAT "%13.10" /end CHARACTERISTIC
/begin CHARACTERISTIC EpmSyn_dCaSSegMsk_C "mask valid information in Calibration array for the Encoded series of camshaft segments." VALUE 0x8053B0A6 Val_Wu8 255.0 OneToOne 0.00 255.0 FORMAT "%5.1" /end CHARACTERISTIC
/begin CHARACTERISTIC EpmSyn_nrIgrCaSEdge_C "The number of Camshaft edges to be ignore to enable the synchronization at first Gap." VALUE 0x8053B0A7 Val_Wu8 255.0 OneToOne 0.00 255.0 FORMAT "%5.1" /end CHARACTERISTIC
/begin CHARACTERISTIC EpmSyn_phiIncCor_CUR "Engine speed depending angle error of crankshaft signal" CURVE 0x8053B0AA Cur_Xs16Ws16 39.99023 AngleCrS -19.99512 19.99512 FORMAT "%8.5" EXTENDED_LIMITS -720.0000 719.9780
 /begin AXIS_DESCR STD_AXIS Epm_nEng EngN 4 -16384.00 16383.50 FORMAT "%8.2" DEPOSIT ABSOLUTE /end AXIS_DESCR
/end CHARACTERISTIC
/begin CHARACTERISTIC EpmSyn_swtDiFirstGapSyncn_C "Switch to disable the synchronization at first Gap." VALUE 0x8053B0A8 Val_Wu8 1.000 OneToOne 0.00 1.000 FORMAT "%5.3" EXTENDED_LIMITS 0.00 255.0 /end CHARACTERISTIC
/begin CHARACTERISTIC Epm_nMaxSpdReSync_C "Speed threshold for ignoring teeth during initial speed calculation after resync" VALUE 0x8053B0D0 Val_Ws16 16383.50 EngN 0.00 16383.50 FORMAT "%8.2" EXTENDED_LIMITS -16384.00 16383.50 /end CHARACTERISTIC
/begin CHARACTERISTIC Epm_nNoSyncVerify_C "In state EPM_MODE_VERIFY above this speed threshold no syncronisation until EPM_MODE_OK is reached." VALUE 0x8053B0C8 Val_Ws16 10000.00 EngN 0.00 10000.00 FORMAT "%8.2" EXTENDED_LIMITS -16384.00 16383.50 /end CHARACTERISTIC
/begin CHARACTERISTIC Epm_nSpd2Zero_C "Engine speed threshold for the transition of HOLD2ZERO through the run-out detection" VALUE 0x8053B0D2 Val_Ws16 32767.50 EngN -16384.00 16383.50 FORMAT "%8.2" /end CHARACTERISTIC
/begin CHARACTERISTIC Epm_numCyl_C "Actual number of cylinder" VALUE 0x8053B0BC Val_Wu8 3.000 OneToOne 1.000 4.000 FORMAT "%5.3" EXTENDED_LIMITS 0.00 255.0 /end CHARACTERISTIC
/begin CHARACTERISTIC Epm_numFireSeg_C "physical firing sequence" VAL_BLK 0x8053B0BD ValA_Wu8 3.000 OneToOne 1.000 4.000 FORMAT "%5.3" EXTENDED_LIMITS 0.00 255.0 NUMBER 4 /end CHARACTERISTIC
/begin CHARACTERISTIC Epm_numIgrTeethReSync_C "Parameter to number of teeth to be ignored from the engine speed calculations after a crank error" VALUE 0x8053B0D4 Val_Ws16 132.0000 OneToOne 0.00 132.0000 FORMAT "%8.4" EXTENDED_LIMITS -32768.00 32767.00 /end CHARACTERISTIC
/begin CHARACTERISTIC Epm_numReSync_C "number of the permissible re-synchronizations" VALUE 0x8053B0CA Val_Wu8 255.0 OneToOne 0.00 255.0 FORMAT "%5.1" /end CHARACTERISTIC
/begin CHARACTERISTIC Epm_phiGap2Zero_C "angle between crankshaft signal gap and zero of angle system in ECU" VALUE 0x8053B0C2 Val_Ws16 719.9780 AngleCrS 0.00 719.9780 FORMAT "%8.4" EXTENDED_LIMITS -720.0000 719.9780 /end CHARACTERISTIC
/begin CHARACTERISTIC Epm_phiTdc1_C "position of first TDC related to zero of angle system" VALUE 0x8053B0C4 Val_Ws16 719.9780 AngleCrS 0.00 719.9780 FORMAT "%8.4" EXTENDED_LIMITS -720.0000 719.9780 /end CHARACTERISTIC
/begin CHARACTERISTIC Epm_swtBlkInjCaSSync_C "no synchronization before detection of crankshaft gap" VALUE 0x8053B0CB Val_Wu8 1.000 OneToOne 0.00 1.000 FORMAT "%5.3" EXTENDED_LIMITS 0.00 255.0 /end CHARACTERISTIC
/begin CHARACTERISTIC Epm_swtOpModeStgy_C "Bit coded switch to select features in Epm_OpMode" VALUE 0x8053B0CC Val_Wu8 255.0 OneToOne 0.00 255.0 FORMAT "%5.1" /end CHARACTERISTIC
/begin CHARACTERISTIC Epm_tiLockReSync_C "Time in state EPM_MODE_LOCKRESYNC without any crankshaft signal" VALUE 0x8053B0CE Val_Ws16 5000.000 Time_ms 0.00 5000.000 FORMAT "%8.3" EXTENDED_LIMITS -327680.0 327670.0 /end CHARACTERISTIC
/begin CHARACTERISTIC Epm_tiSpd2Zero_C "Timeout until engine speed will be set to zero" VALUE 0x8053B0D6 Val_Wu16 1000.000 Time_ms 0.00 1000.000 FORMAT "%8.3" EXTENDED_LIMITS 0.00 655350.0 /end CHARACTERISTIC
/begin CHARACTERISTIC Epm_tiSpdGrdAvgFlt_C "Filtertime for PT1-Filtermodule to calculatethe average filtered enginespeed-gradient" VALUE 0x8053B0D8 Val_Ws32 999.0 TimeDelay_ms 1.0 1000.0 FORMAT "%12.1" EXTENDED_LIMITS 0.0 4294967.3 /end CHARACTERISTIC
/begin CHARACTERISTIC Epm_tiSpdGrdFlt_C "Filtertime for PT1-Filtermodule to calculate filtered enginespeed-gradient" VALUE 0x8053B0DC Val_Ws32 999.0 TimeDelay_ms 1.0 1000.0 FORMAT "%12.1" EXTENDED_LIMITS 0.0 4294967.3 /end CHARACTERISTIC
/begin CHARACTERISTIC ESC_stS1FrstSched_C "angle synchronous scheduling starts always with a S1 Task (calculation of PILOT injections)" VALUE 0x8053AD42 Val_Wu8 3.00000000000 ESC_stS1FrstSched_t 0.00 3.00000000000 FORMAT "%13.11" /end CHARACTERISTIC
/begin CHARACTERISTIC ESC_stSyncS0MaxRst_C "Calibration label to enablereset maximum runtime, maximum lifetime runtime, maximum current cycle task load and maximum lifetime task load of Sync S0 task" VALUE 0x8053AD43 Val_Wu8 1.00000000000 ESC_MaxRtTskLoad_Rst_t 0.00 1.00000000000 FORMAT "%13.11" /end CHARACTERISTIC
/begin CHARACTERISTIC ESC_stSyncS1MaxRst_C "Calibration label to enablereset maximum runtime, maximum lifetime runtime, maximum current cycle task load and maximum lifetime task load of Sync S1 task" VALUE 0x8053AD44 Val_Wu8 1.00000000000 ESC_MaxRtTskLoad_Rst_t 0.00 1.00000000000 FORMAT "%13.11" /end CHARACTERISTIC
/begin CHARACTERISTIC FRKAP "factor, relative fuel mass for application" VALUE 0x8051CA51 RB_Val_Wu8 1.992188 fak_ub_b2 0.00 1.992188 FORMAT "%8.6" /end CHARACTERISTIC
/begin CHARACTERISTIC KFFNSAMX "Map maximal value afterstart adaptation" MAP 0x8051CA58 RB_Map_U8U16_U16 1.999969 fak_uw_b2 0.00 1.999969 FORMAT "%8.6"
 /begin AXIS_DESCR STD_AXIS tmotnsad temp_ub_q0p75_o48 6 -48.0 143.3 FORMAT "%5.1" DEPOSIT ABSOLUTE /end AXIS_DESCR
 /begin AXIS_DESCR STD_AXIS EngStrt_facDesLamLimLoc fak_uw_b16 3 0.00 15.99976 FORMAT "%8.5" DEPOSIT ABSOLUTE /end AXIS_DESCR
/end CHARACTERISTIC
/begin CHARACTERISTIC KFSDLUSDMR "Map offset desired value standard deviation engine roughness" MAP 0x8051C982 RB_Map_U8U16_U8 14.50 lu_MEx_div_8 0.00 14.50 FORMAT "%5.2"
 /begin AXIS_DESCR STD_AXIS tmsdluts temp_ub_q0p75_o48 6 -48.0 143.3 FORMAT "%5.1" DEPOSIT ABSOLUTE /end AXIS_DESCR
 /begin AXIS_DESCR STD_AXIS dmrmx_w_msg rel_uw_b100 4 0.00 99.99847 FORMAT "%8.5" DEPOSIT ABSOLUTE /end AXIS_DESCR
/end CHARACTERISTIC
/begin CHARACTERISTIC KFSDLUSOL "Map desired value standard deviation engine roughness" MAP 0x8051C9AA RB_Map_U8U16_U8 14.50 lu_MEx_div_8 0.00 14.50 FORMAT "%5.2"
 /begin AXIS_DESCR STD_AXIS tmsdluts temp_ub_q0p75_o48 6 -48.0 143.3 FORMAT "%5.1" DEPOSIT ABSOLUTE /end AXIS_DESCR
 /begin AXIS_DESCR STD_AXIS anztib_w_msg dez 12 0.00 65535.00 FORMAT "%8.2" DEPOSIT ABSOLUTE /end AXIS_DESCR
/end CHARACTERISTIC
/begin CHARACTERISTIC KFSDLUSRRI "Map desired value standard deviation engine roughness with inert gas" MAP 0x8051CA12 RB_Map_U8U16_U8 14.50 lu_MEx_div_8 0.00 14.50 FORMAT "%5.2"
 /begin AXIS_DESCR STD_AXIS tmsdluts temp_ub_q0p75_o48 6 -48.0 143.3 FORMAT "%5.1" DEPOSIT ABSOLUTE /end AXIS_DESCR
 /begin AXIS_DESCR STD_AXIS rri_w_msg rel_uw_b100 4 0.00 99.99847 FORMAT "%8.5" DEPOSIT ABSOLUTE /end AXIS_DESCR
/end CHARACTERISTIC
/begin CHARACTERISTIC KLFNSAMX "Characteristic line maximal value afterstart adaptation" CURVE 0x8051CA8A RB_Curve_U8_U16_Static 1.999969 fak_uw_b2 0.00 1.999969 FORMAT "%8.6"
 /begin AXIS_DESCR STD_AXIS ESNSAD_tEng temp_ub_q0p75_o48 6 -48.0 143.3 FORMAT "%5.1" DEPOSIT ABSOLUTE /end AXIS_DESCR
/end CHARACTERISTIC
/begin CHARACTERISTIC KLLUTS "Amplification factor engine roughness" CURVE 0x8051CA3A RB_Curve_S16_U16_Static 3.999939 fak_uw_b4 0.00 3.999939 FORMAT "%8.6"
 /begin AXIS_DESCR STD_AXIS luts_w_msg lu_MEx 4 -232.8306 232.8235 FORMAT "%8.4" DEPOSIT ABSOLUTE /end AXIS_DESCR
/end CHARACTERISTIC
/begin CHARACTERISTIC KLNSADI "Characteristic line integrator part of afterstart adaptation" CURVE 0x8051CA9E RB_Curve_S16_S16 1.999969 fak_sw_b1 -1.000000 0.999969 FORMAT "%8.6" EXTENDED_LIMITS -1.000000 0.9999695
 /begin AXIS_DESCR STD_AXIS dsdlutsi_w lu_MEx 6 -232.8306 232.8235 FORMAT "%8.4" DEPOSIT ABSOLUTE /end AXIS_DESCR
/end CHARACTERISTIC
/begin CHARACTERISTIC KLNSADP "Characteristic line proportional part afterstart adaptation" CURVE 0x8051CAB8 RB_Curve_S16_U16_Static 1.999969 fak_uw_b2 0.00 1.999969 FORMAT "%8.6"
 /begin AXIS_DESCR STD_AXIS EngStrt_ratStdDeEngRoughnsLoc lu_MEx 6 -232.8306 232.8235 FORMAT "%8.4" DEPOSIT ABSOLUTE /end AXIS_DESCR
/end CHARACTERISTIC
/begin CHARACTERISTIC KLZKNSADI "Characteristic line integrator time constant afterstart adaptation" CURVE 0x8051CAD2 RB_Curve_S16_U16_Static 0.9999847 fak_uw_b1 0.00 0.9999847 FORMAT "%9.7"
 /begin AXIS_DESCR STD_AXIS EngStrt_ratStdDeEngRoughnsLoc lu_MEx 6 -232.8306 232.8235 FORMAT "%8.4" DEPOSIT ABSOLUTE /end AXIS_DESCR
/end CHARACTERISTIC
/begin CHARACTERISTIC RKAKAP "Additive factor, relative fuel mass for application" VALUE 0x8051CA52 RB_Val_Ws16 48.00000 rel_q0p09375 -24.00000 24.00000 FORMAT "%8.5" EXTENDED_LIMITS -3072.000 3071.906 /end CHARACTERISTIC
/begin CHARACTERISTIC TFNSADOFF "Time constant deactivation afterstart adaptation factor" VALUE 0x8051CAEC RB_Val_Wu16 6553.500 t100msxs_uw_b6553p5 0.00 6553.500 FORMAT "%8.3" /end CHARACTERISTIC
/begin CHARACTERISTIC TNSADHMX "Maximal hold time for afterstart adaptation factor at high engine speed" VALUE 0x8051CAEE RB_Val_Wu16 6553.500 t100msxs_uw_b6553p5 0.00 6553.500 FORMAT "%8.3" /end CHARACTERISTIC
/begin CHARACTERISTIC TNSEMX "maximum time after end of start for limitation of post-start-factor to 1" VALUE 0x8051CAF0 RB_Val_Wu16 6553.500 t100msxs_uw_b6553p5 0.00 6553.500 FORMAT "%8.3" /end CHARACTERISTIC
/begin CHARACTERISTIC ZKASDLUTS "Time constant deviation from mean value engine roughness" VALUE 0x8051CA4C RB_Val_Wu16 0.9999847 fak_uw_b1 0.00 0.9999847 FORMAT "%9.7" /end CHARACTERISTIC
/begin CHARACTERISTIC ZKMSDLUTS "Time constant mean value engine roughness" VALUE 0x8051CA4E RB_Val_Wu16 0.9999847 fak_uw_b1 0.00 0.9999847 FORMAT "%9.7" /end CHARACTERISTIC
/begin MEASUREMENT CAS_BKUP "Camshaft BackUp mode" UBYTE OneToOne 1 100 0.00 255.0 FORMAT "%5.1" ECU_ADDRESS 0x600006CF /end MEASUREMENT
/begin MEASUREMENT dsdliold_w "Integrator delta standard deviation engine roughness old value" SWORD lu_MEx 1 100 -232.8306 232.8235 FORMAT "%8.4" ECU_ADDRESS 0x60000472 /end MEASUREMENT
/begin MEASUREMENT dsdlutsi_w "Integrator delta standard deviation engine roughness" SWORD lu_MEx 1 100 -232.8306 232.8235 FORMAT "%8.4" ECU_ADDRESS 0x60000474 /end MEASUREMENT
/begin MEASUREMENT dsdluts_w_msg "Delta standard deviation engine roughness" SWORD lu_MEx 1 100 -232.8306 232.8235 FORMAT "%8.4" ECU_ADDRESS 0x600005D6 /end MEASUREMENT
/begin MEASUREMENT EngStrt_ctESNSADReIni100ms "Local variable to store the global post-drive leave counter(SyC_ctPostDrvLeave)" UBYTE OneToOne 1 100 0.00 255.0 FORMAT "%5.1" ECU_ADDRESS 0x6000E3A0 /end MEASUREMENT
/begin MEASUREMENT EngStrt_ctESNSADReIniSyncS0 "Local variable to store the global post-drive leave counter(SyC_ctPostDrvLeave)" UBYTE OneToOne 1 100 0.00 255.0 FORMAT "%5.1" ECU_ADDRESS 0x5000084B /end MEASUREMENT
/begin MEASUREMENT EngStrt_facDesLamLimLoc "Local Variable factor for deired lambda limitation" UWORD fak_uw_b16 1 100 0.00 15.99976 FORMAT "%8.5" ECU_ADDRESS 0x6000D8BE /end MEASUREMENT
/begin MEASUREMENT EngStrt_ratStdDeEngRoughnsLoc "Local Variable for standard deviation of engine roughness" SWORD lu_MEx 1 100 -232.8306 232.8235 FORMAT "%8.4" ECU_ADDRESS 0x60000414 /end MEASUREMENT
/begin MEASUREMENT EpmCaS_stSnsrDeActvnPBVar "Camshaft sensor deactivation status" UBYTE OneToOne 1 100 0.00 255.0 FORMAT "%5.1" ARRAY_SIZE 1 ECU_ADDRESS 0x600064E0 /end MEASUREMENT
/begin MEASUREMENT EpmCrS_ctAgClkDeltaCrsv_mp "Number of angle differences above the permitted maximum angle" UBYTE OneToOne 1 100 0.00 255.0 FORMAT "%5.1" ECU_ADDRESS 0x70008A81 /end MEASUREMENT
/begin MEASUREMENT EpmCrS_ctInc "crankshaft teeth counter" UBYTE OneToOne 1 100 0.00 255.0 FORMAT "%5.1" ECU_ADDRESS 0x50005D78 /end MEASUREMENT
/begin MEASUREMENT EpmCrS_ctRange "counter for selecting speed limits in dynamic plausibilisation" UBYTE OneToOne 1 100 0.00 255.0 FORMAT "%5.1" ECU_ADDRESS 0x6000651A /end MEASUREMENT
/begin MEASUREMENT EpmCrS_ctReSyncAgClkDeltaTot "counter for the total number of re-synchronisations" UBYTE OneToOne 1 100 0.00 255.0 FORMAT "%5.1" ECU_ADDRESS 0x60036149 /end MEASUREMENT
/begin MEASUREMENT EpmCrS_ctReSyncAgClkDeltaTot_mp "Number of released re-synchronizations over all driving cycles" UBYTE OneToOne 1 100 0.00 255.0 FORMAT "%5.1" ECU_ADDRESS 0x70008A80 /end MEASUREMENT
/begin MEASUREMENT EpmCrS_ctReSyncAgClkDelta_mp "Number of released re-synchronizations in the current driving cycle" UBYTE OneToOne 1 100 0.00 255.0 FORMAT "%5.1" ECU_ADDRESS 0x70008A7F /end MEASUREMENT
/begin MEASUREMENT EpmCrS_ctRevCnt "crankshaft revolution counter" UWORD RevCnt 1 100 0.00 4095.938 FORMAT "%8.3" ECU_ADDRESS 0x5000535E /end MEASUREMENT
/begin MEASUREMENT EpmCrS_ctRevIni "crankshaft revolutions since synchronisation" SWORD OneToOne 1 100 -32768.00 32767.00 FORMAT "%8.2" ECU_ADDRESS 0x6000539C /end MEASUREMENT
/begin MEASUREMENT EpmCrS_ctRevStrt "crankshaft revolution since switch off start BIT" SWORD OneToOne 1 100 -32768.00 32767.00 FORMAT "%8.2" ECU_ADDRESS 0x6000E1E2 /end MEASUREMENT
/begin MEASUREMENT EpmCrS_ctRevStrtExtd "crankshaft revolution since switch off start BIT" SLONG OneToOne 1 100 -2147483648.00 2147483647.00 FORMAT "%13.2" ECU_ADDRESS 0x50004C58 /end MEASUREMENT
/begin MEASUREMENT EpmCrS_idxBuf_mp "Bufferindex of the crank edge elemets, at which the synchro was triggered" SWORD OneToOne 1 100 -32768.00 32767.00 FORMAT "%8.2" ECU_ADDRESS 0x70008868 /end MEASUREMENT
/begin MEASUREMENT EpmCrS_numIncPerSeg "The number of crankshaft teeth in the cylinder-segment EpmCrS_phiSeg" UWORD OneToOne 1 100 0.00 65535.00 FORMAT "%8.2" ECU_ADDRESS 0x6000E1E4 /end MEASUREMENT
/begin MEASUREMENT EpmCrS_numNewInc_mp "TTMeasure - number of new tooth times since last interrupt" UBYTE OneToOne 1 100 0.00 255.0 FORMAT "%5.1" ECU_ADDRESS 0x70008A7E /end MEASUREMENT
/begin MEASUREMENT EpmCrS_numSeg "counter of part segments" UBYTE OneToOne 1 100 0.00 255.0 FORMAT "%5.1" ECU_ADDRESS 0x50005D79 /end MEASUREMENT
/begin MEASUREMENT EpmCrS_numTiIncPerAvrg "Number of teeth for average tooth time calculation" UBYTE OneToOne 1 100 0.00 255.0 FORMAT "%5.1" ECU_ADDRESS 0x50005D21 /end MEASUREMENT
/begin MEASUREMENT EpmCrS_numTiIncPerAvrg_mp "current number of crankshaft teeth to calculate average of tooth time" ULONG OneToOne 1 100 0.00 4294967295.00 FORMAT "%13.2" ECU_ADDRESS 0x7000869C /end MEASUREMENT
/begin MEASUREMENT EpmCrS_phiAgClk "Relative angle of the engine position provided by the angle clock" SWORD AngleCrS 1 100 -720.0000 719.9780 FORMAT "%8.4" ECU_ADDRESS 0x50005A40 /end MEASUREMENT
/begin MEASUREMENT EpmCrS_phiAgClkDelta_mp "Angle difference between the relative angle of the angle clock and the relative angle provided by the tooth counter" SWORD AngleCrS 1 100 -720.0000 719.9780 FORMAT "%8.4" ECU_ADDRESS 0x7000886A /end MEASUREMENT
/begin MEASUREMENT EpmCrS_phiIgnInc "crankshaft angle faded out due to debouncing, during start" SWORD AngleCrS 1 100 -720.0000 719.9780 FORMAT "%8.4" ECU_ADDRESS 0x600039E6 /end MEASUREMENT
/begin MEASUREMENT EpmCrS_phiInc "Relative angle of the engine position provided by the tooth counter" SWORD AngleCrS 1 100 -720.0000 719.9780 FORMAT "%8.4" ECU_ADDRESS 0x50005A42 /end MEASUREMENT
/begin MEASUREMENT EpmCrS_phiIntSeg "endposition of the current halfsegment" SWORD AngleCrS 1 100 -720.0000 719.9780 FORMAT "%8.4" ECU_ADDRESS 0x70002C40 /end MEASUREMENT
/begin MEASUREMENT EpmCrS_phiSeg "Cylinder segment length" SWORD AngleCrS 1 100 -720.0000 719.9780 FORMAT "%8.4" ECU_ADDRESS 0x6000E1E8 /end MEASUREMENT
/begin MEASUREMENT EpmCrS_phiSegHiRes "Segment for calculating EpmCrS_tiSegHiRes" SLONG RBPtCel_ag_1p373291em3_1 1 100 -2949120.00000 2949119.99863 FORMAT "%13.5" ECU_ADDRESS 0x50004C5C /end MEASUREMENT
/begin MEASUREMENT EpmCrS_stEnaAgClkPlausChk "Indicates the status of angle plausibility check, enableddisabled TRUE = Angle plausibility check enabled from next Syncpre task, FALSE = Angle plausibility check disabled from next Syncpre task." UBYTE OneToOne 1 100 0.00 255.0 BIT_MASK 0x1 FORMAT "%5.1" ECU_ADDRESS 0x50005D22 /end MEASUREMENT
/begin MEASUREMENT EpmCrS_stHiEngSpd "Status of Crankshaft Hybrid sensor in DG operating speed range" UBYTE OneToOne 1 100 0.00 255.0 BIT_MASK 0x1 FORMAT "%5.1" ECU_ADDRESS 0x60006519 /end MEASUREMENT
/begin MEASUREMENT EpmCrS_stRotDir "Rotation direction based on DGI sensor (0 - Forward, 1- Reverse)" UBYTE EpmHCrS_stRotDir_t 1 100 0.00 3.00000000000 FORMAT "%13.11" ECU_ADDRESS 0x50005D7A /end MEASUREMENT
/begin MEASUREMENT EpmCrS_stSigMode "state of crankshaft signal evaluation" UBYTE EpmHCrS_stSigMode_State_t 1 100 0.00 9.00000000000 FORMAT "%13.11" ECU_ADDRESS 0x50005D7B /end MEASUREMENT
/begin MEASUREMENT EpmCrS_swtSnsrTyp "Type of Crankshaft Hybrid sensor" UBYTE EpmCrS_swtSnsrTyp_State_t 1 100 0.00 2.00000000000 FORMAT "%13.11" ECU_ADDRESS 0x60006518 /end MEASUREMENT
/begin MEASUREMENT EpmCrS_tiIncPer "current tooth-time on crankshaft" SLONG GptaClc6_ti_COMPU 1 100 -858993459.200 858993458.800 FORMAT "%13.3" ECU_ADDRESS 0x70002B20 /end MEASUREMENT
/begin MEASUREMENT EpmCrS_tiInc_mp "TTMeasure - CrS-tooth times since last interrupt" SLONG Time_ns_to_us 1 100 -2147483.64800 2147483.64700 FORMAT "%13.5" ARRAY_SIZE 18 ECU_ADDRESS 0x70008654 /end MEASUREMENT
/begin MEASUREMENT EpmCrS_tiSeg "cylinder segment time" SLONG Per_Dur 1 100 -2147483648.00 2147483647.00 FORMAT "%13.2" ECU_ADDRESS 0x70002B24 /end MEASUREMENT
/begin MEASUREMENT EpmCrS_tiSegCurr "half cylinder segment time" SLONG Per_Dur 1 100 -2147483648.00 2147483647.00 FORMAT "%13.2" ECU_ADDRESS 0x50004C60 /end MEASUREMENT
/begin MEASUREMENT EpmCrS_tiSegHiRes "Crank segment time calculation with resolution with 50 ns" SLONG RBPtCel_ti_50p0_1 1 100 -107374182400. 107374182350. FORMAT "%13.0" ECU_ADDRESS 0x50004C64 /end MEASUREMENT
/begin MEASUREMENT EpmErr_ctErrInfoAryFree "Index of next, free entry in control buffer structure" UWORD OneToOne 1 100 0.00 65535.00 FORMAT "%8.2" ECU_ADDRESS 0x600039E4 /end MEASUREMENT
/begin MEASUREMENT EpmErr_TraceCoreId "Core-Id on which the error was seen" ULONG OneToOne 1 100 0.00 4294967295.00 FORMAT "%13.2" ARRAY_SIZE 5 ECU_ADDRESS 0x500014A0 /end MEASUREMENT
/begin MEASUREMENT EpmErr_TraceErrClass "Error-class of error" UBYTE EpmErr_ErrClass_t 1 100 0.00 4.00000000000 FORMAT "%13.11" ARRAY_SIZE 5 ECU_ADDRESS 0x60006513 /end MEASUREMENT
/begin MEASUREMENT EpmErr_TraceErrId "Error number" UBYTE OneToOne 1 100 0.00 255.0 FORMAT "%5.1" ARRAY_SIZE 5 ECU_ADDRESS 0x6000650E /end MEASUREMENT
/begin MEASUREMENT EpmErr_TraceErrInfo1 "additional information part 1" ULONG OneToOne 1 100 0.00 4294967295.00 FORMAT "%13.2" ARRAY_SIZE 5 ECU_ADDRESS 0x500014B4 /end MEASUREMENT
/begin MEASUREMENT EpmErr_TraceErrInfo2 "additional information part 2" ULONG OneToOne 1 100 0.00 4294967295.00 FORMAT "%13.2" ARRAY_SIZE 5 ECU_ADDRESS 0x500014C8 /end MEASUREMENT
/begin MEASUREMENT EpmErr_TraceErrInfo3 "additional information part 3" ULONG OneToOne 1 100 0.00 4294967295.00 FORMAT "%13.2" ARRAY_SIZE 5 ECU_ADDRESS 0x500014DC /end MEASUREMENT
/begin MEASUREMENT EpmErr_TraceErrInfo4 "additional information part 4" ULONG OneToOne 1 100 0.00 4294967295.00 FORMAT "%13.2" ARRAY_SIZE 5 ECU_ADDRESS 0x500014F0 /end MEASUREMENT
/begin MEASUREMENT EpmErr_TraceErrorReaction "Error Reaction" ULONG EpmErr_ErrClass_t 1 100 0.00 4.00000000000 FORMAT "%13.11" ARRAY_SIZE 5 ECU_ADDRESS 0x50001504 /end MEASUREMENT
/begin MEASUREMENT EpmErr_TraceModId "Module-Id of the error handler calling software part" UBYTE Epm_ModId_t 1 100 0.00 80.0000000000 FORMAT "%13.10" ARRAY_SIZE 5 ECU_ADDRESS 0x60006509 /end MEASUREMENT
/begin MEASUREMENT EpmErr_TraceStatus "error status information byte" UBYTE OneToOne 1 100 0.00 255.0 FORMAT "%5.1" ARRAY_SIZE 5 ECU_ADDRESS 0x60006504 /end MEASUREMENT
/begin MEASUREMENT EpmErr_TraceTimeStamp "error occurence time stamp" ULONG t_q0p01_us 1 100 0.00 42949672.9500 FORMAT "%13.4" ARRAY_SIZE 5 ECU_ADDRESS 0x50001518 /end MEASUREMENT
/begin MEASUREMENT EpmHAgClk_AddTick "Increment distribution of additional ticks of angle clock" UBYTE OneToOne 1 100 0.00 255.0 FORMAT "%5.1" ARRAY_SIZE 5 ECU_ADDRESS 0x600064FF /end MEASUREMENT
/begin MEASUREMENT EpmHAgClk_agPosnTrigEve "Angle stamp of the current activiation event" SWORD AngleCrS 1 100 -720.0000 719.9780 FORMAT "%8.4" ECU_ADDRESS 0x60000416 /end MEASUREMENT
/begin MEASUREMENT EpmHAgClk_Gen_AgCntRaw_mp "Current angle clock value in 24-bit, read in 1ms task" ULONG AngleCrS 1 100 0.00 94371839.9781 FORMAT "%13.4" ECU_ADDRESS 0x70008650 /end MEASUREMENT
/begin MEASUREMENT EpmHAgClk_Gen_AgCnt_mp "Current angle clock value limited to one working cycle (720), read in 1ms task" SWORD AngleCrS 1 100 -720.0000 719.9780 FORMAT "%8.4" ECU_ADDRESS 0x70008866 /end MEASUREMENT
/begin MEASUREMENT EpmHAgClk_numAgClkFrq "Control parameter for extremal values of angle clock speed" UBYTE EpmHAgClk_AgClkFrq_t 1 100 0.00 3.00000000000 FORMAT "%13.11" ECU_ADDRESS 0x70002D54 /end MEASUREMENT
/begin MEASUREMENT EpmHAgClk_numAgClkMode "Actual correction mode of angle clock" UBYTE EpmHAgClk_AgClkMode_t 1 100 0.00 3.00000000000 FORMAT "%13.11" ECU_ADDRESS 0x6000E3A4 /end MEASUREMENT
/begin MEASUREMENT EpmHAgClk_numAgClkState "Actual activation state of angle clock" UBYTE EpmHAgClk_AgClkState_t 1 100 0.00 1.00000000000 FORMAT "%13.11" ECU_ADDRESS 0x50005D24 /end MEASUREMENT
/begin MEASUREMENT EpmHAgClk_numAgTicksPerInc "Nominal tick number of angle clock per increment" UWORD OneToOne 1 100 0.00 65535.00 FORMAT "%8.2" ECU_ADDRESS 0x6000D8C8 /end MEASUREMENT
/begin MEASUREMENT EpmHAgClk_numMissTick "Number of missing micro ticks not generated until synchronisation gap" SWORD OneToOne 1 100 -32768.00 32767.00 FORMAT "%8.2" ECU_ADDRESS 0x600039E2 /end MEASUREMENT
/begin MEASUREMENT EpmHAgClk_stAPTSyn "Status: DPLL synchronous at hardware profile (ADT_T)" UBYTE OneToOne 1 100 0.00 255.0 BIT_MASK 0x1 FORMAT "%5.1" ECU_ADDRESS 0x600064FE /end MEASUREMENT
/begin MEASUREMENT EpmHAgClk_tiIncPerBas "Nominal increment duration for setting of angle clock speed" SLONG OneToOne 1 100 -2147483648.00 2147483647.00 FORMAT "%13.2" ECU_ADDRESS 0x70002A44 /end MEASUREMENT
/begin MEASUREMENT EpmHAgClk_tiMinPer "Minimum increment duration (according to maximum engine speed)" SLONG OneToOne 1 100 -2147483648.00 2147483647.00 FORMAT "%13.2" ECU_ADDRESS 0x5000152C /end MEASUREMENT
/begin MEASUREMENT EpmHCaS_ctEdgeCaSI1 "Absolute edge number of the inlet cam-shaft bank1" UBYTE OneToOne 1 100 0.00 255.0 FORMAT "%5.1" ECU_ADDRESS 0x6000E3A5 /end MEASUREMENT
/begin MEASUREMENT EpmHCaS_DataI1.agFallEdgeCorrn "signal buffer for the camshaft inlet bank 1 / engine speed and temperature depending correction of the angle for falling edges" SLONG AngleCrS 1 100 -47185920.0000 47185919.9780 FORMAT "%13.4" ECU_ADDRESS 0x70001408 /end MEASUREMENT
/begin MEASUREMENT EpmHCaS_DataI1.agRisngEdgeCorrn "signal buffer for the camshaft inlet bank 1 / engine speed and temperature depending correction of the angle for rising edges" SLONG AngleCrS 1 100 -47185920.0000 47185919.9780 FORMAT "%13.4" ECU_ADDRESS 0x7000140C /end MEASUREMENT
/begin MEASUREMENT EpmHCaS_DataI1.ctEdge "signal buffer for the camshaft inlet bank 1 / total number auf measured edges since ECU init" SLONG OneToOne 1 100 -2147483648.00 2147483647.00 FORMAT "%13.2" ECU_ADDRESS 0x70001410 /end MEASUREMENT
/begin MEASUREMENT EpmHCaS_DataI1.tiGlitch "signal buffer for the camshaft inlet bank 1 / glitch filter value for each rising and falling edge" ULONG RBPtCel_ti_50p0_1 1 100 0.00 214748364750. FORMAT "%13.0" ECU_ADDRESS 0x70001414 /end MEASUREMENT
/begin MEASUREMENT EpmHCaS_DataI1.tiDiffEdge "signal buffer for the camshaft inlet bank 1 / time distance between the measured edge to the edge measured once before" ULONG RBPtCel_ti_50p0_1 1 100 0.00 214748364750. FORMAT "%13.0" ARRAY_SIZE 16 ECU_ADDRESS 0x70001418 /end MEASUREMENT
/begin MEASUREMENT EpmHCaS_DataI1.tiDiffLstEdge "signal buffer for the camshaft inlet bank 1 / distance between the last measured edge to the edge measured once before" ULONG RBPtCel_ti_50p0_1 1 100 0.00 214748364750. FORMAT "%13.0" ECU_ADDRESS 0x70001458 /end MEASUREMENT
/begin MEASUREMENT EpmHCaS_DataI1.tiStampEdge "signal buffer for the camshaft inlet bank 1 / point of time of the measured edge" ULONG RBPtCel_ti_50p0_1 1 100 0.00 214748364750. FORMAT "%13.0" ARRAY_SIZE 16 ECU_ADDRESS 0x7000145C /end MEASUREMENT
/begin MEASUREMENT EpmHCaS_DataI1.agDiffEdge "signal buffer for the camshaft inlet bank 1 / angle distance between the measured edge to the edge measured once before" SWORD AngleCrS 1 100 -720.0000 719.9780 FORMAT "%8.4" ARRAY_SIZE 16 ECU_ADDRESS 0x7000149C /end MEASUREMENT
/begin MEASUREMENT EpmHCaS_DataI1.agDiffLstEdge "signal buffer for the camshaft inlet bank 1 / angle distance between the last measured edge to the edge measured once before" SWORD AngleCrS 1 100 -720.0000 719.9780 FORMAT "%8.4" ECU_ADDRESS 0x700014BC /end MEASUREMENT
/begin MEASUREMENT EpmHCaS_DataI1.agEdgeAbslt "signal buffer for the camshaft inlet bank 1 / absolute angle of the measured edge (-720 deg, if not valid)" SWORD AngleCrS 1 100 -720.0000 719.9780 FORMAT "%8.4" ARRAY_SIZE 16 ECU_ADDRESS 0x700014BE /end MEASUREMENT
/begin MEASUREMENT EpmHCaS_DataI1.agEdgeCorrn "signal buffer for the camshaft inlet bank 1 / engine speed and temperature depending correction of the angle" SWORD AngleCrS 1 100 -720.0000 719.9780 FORMAT "%8.4" ARRAY_SIZE 16 ECU_ADDRESS 0x700014DE /end MEASUREMENT
/begin MEASUREMENT EpmHCaS_DataI1.agEdgeRel "signal buffer for the camshaft inlet bank 1 / relative angle of the measured edge" SWORD AngleCrS 1 100 -720.0000 719.9780 FORMAT "%8.4" ARRAY_SIZE 16 ECU_ADDRESS 0x700014FE /end MEASUREMENT
/begin MEASUREMENT EpmHCaS_DataI1.agPhaShiftRel "signal buffer for the camshaft inlet bank 1 / current phasing (deflection of the reference position) of the camshaft for the measured edge" SWORD AngleCrS 1 100 -720.0000 719.9780 FORMAT "%8.4" ARRAY_SIZE 16 ECU_ADDRESS 0x7000151E /end MEASUREMENT
/begin MEASUREMENT EpmHCaS_DataI1.agRefPosCorrd "signal buffer for the camshaft inlet bank 1 / by the adaption corrected reference position of the edges" SWORD AngleCrS 1 100 -720.0000 719.9780 FORMAT "%8.4" ARRAY_SIZE 8 ECU_ADDRESS 0x7000153E /end MEASUREMENT
/begin MEASUREMENT EpmHCaS_DataI1.ctBufIdx "signal buffer for the camshaft inlet bank 1 / Points to the next element in the buffer, which will be written (ctBufIdx - 1 contains the last measured edge)" SBYTE OneToOne 1 100 -128.0 127.0 FORMAT "%5.1" ECU_ADDRESS 0x7000154E /end MEASUREMENT
/begin MEASUREMENT EpmHCaS_DataI1.ctValidEdge "signal buffer for the camshaft inlet bank 1 / number of measured edges with a valid angle stamp" SBYTE OneToOne 1 100 -128.0 127.0 FORMAT "%5.1" ECU_ADDRESS 0x7000154F /end MEASUREMENT
/begin MEASUREMENT EpmHCaS_DataI1.ctValidTime "signal buffer for the camshaft inlet bank 1 / number of measured edges with a valid time stamp" SBYTE OneToOne 1 100 -128.0 127.0 FORMAT "%5.1" ECU_ADDRESS 0x70001550 /end MEASUREMENT
/begin MEASUREMENT EpmHCaS_DataI1.numBufUsed "signal buffer for the camshaft inlet bank 1 / number of elements which are used for the edge data in the buffer (depends on EpmCaS_numSegSerLst)" UBYTE OneToOne 1 100 0.00 255.0 FORMAT "%5.1" ECU_ADDRESS 0x70001551 /end MEASUREMENT
/begin MEASUREMENT EpmHCaS_DataI1.numLstEdgeAbslt "signal buffer for the camshaft inlet bank 1 / absolute edge position of the last measured edge (-1, if not vaild)" SBYTE OneToOne 1 100 -128.0 127.0 FORMAT "%5.1" ECU_ADDRESS 0x70001572 /end MEASUREMENT
/begin MEASUREMENT EpmHCaS_DataI1.numLstEdgeWcy "signal buffer for the camshaft inlet bank 1 / relative edge position of the last measured edge" SBYTE OneToOne 1 100 -128.0 127.0 FORMAT "%5.1" ECU_ADDRESS 0x70001573 /end MEASUREMENT
/begin MEASUREMENT EpmHCaS_DataI1.numEdgeAbslt "signal buffer for the camshaft inlet bank 1 / absolute edge position of the measured edge (-1, if not vaild)" SBYTE OneToOne 1 100 -128.0 127.0 FORMAT "%5.1" ARRAY_SIZE 16 ECU_ADDRESS 0x70001552 /end MEASUREMENT
/begin MEASUREMENT EpmHCaS_DataI1.numEdgeWcy "signal buffer for the camshaft inlet bank 1 / relative edge position of the measured edge" SBYTE OneToOne 1 100 -128.0 127.0 FORMAT "%5.1" ARRAY_SIZE 16 ECU_ADDRESS 0x70001562 /end MEASUREMENT
/begin MEASUREMENT EpmHCaS_DataI1.stCurLev "signal buffer for the camshaft inlet bank 1 / electrical level of the camshaft signal after the last measured edge" UBYTE OneToOne 1 100 0.00 255.0 FORMAT "%5.1" ECU_ADDRESS 0x70001574 /end MEASUREMENT
/begin MEASUREMENT EpmHCaS_DataI1.stLevBeforeEdge "signal buffer for the camshaft inlet bank 1 / electrical level of the camshaft signal before the measured edge" UBYTE OneToOne 1 100 0.00 255.0 FORMAT "%5.1" ARRAY_SIZE 16 ECU_ADDRESS 0x70001575 /end MEASUREMENT
/begin MEASUREMENT EpmHCaS_DataI1.stSig "signal buffer for the camshaft inlet bank 1 / state if a disturbance by the glitch filter was detected and faded out" UBYTE OneToOne 1 100 0.00 255.0 FORMAT "%5.1" ECU_ADDRESS 0x70001585 /end MEASUREMENT
/begin MEASUREMENT EpmHCaS_stCaSSig "stores the cas level for that cas segment" UBYTE OneToOne 1 100 0.00 255.0 FORMAT "%5.1" ARRAY_SIZE 1 ECU_ADDRESS 0x600064FD /end MEASUREMENT
/begin MEASUREMENT EpmHCrS_agActvEdge "Angle stamp of active edge of crankshaft signal" ULONG OneToOne 1 100 0.00 4294967295.00 FORMAT "%13.2" ECU_ADDRESS 0x70002A48 /end MEASUREMENT
/begin MEASUREMENT EpmHCrS_cntrDrvErrRst "Overall counter for crankshaft errors during driving operation" UWORD OneToOne 1 100 0.00 65535.00 FORMAT "%8.2" ECU_ADDRESS 0x600039C4 /end MEASUREMENT
/begin MEASUREMENT EpmHCrS_cntrEdge "crankshaft edge counter which increased by the active and the inactive edges" ULONG OneToOne 1 100 0.00 4294967295.00 FORMAT "%13.2" ECU_ADDRESS 0x70002A4C /end MEASUREMENT
/begin MEASUREMENT EpmHCrS_cntrErr "Counter array for single error reasons at crankshaft driver" UWORD OneToOne 1 100 0.00 65535.00 FORMAT "%8.2" ARRAY_SIZE 12 ECU_ADDRESS 0x6000D8CA /end MEASUREMENT
/begin MEASUREMENT EpmHCrS_cntrErrRst "Overall counter for crankshaft errors with reset of crankshaft driver" UWORD OneToOne 1 100 0.00 65535.00 FORMAT "%8.2" ECU_ADDRESS 0x600039C2 /end MEASUREMENT
/begin MEASUREMENT EpmHCrS_cntrErrSum "Overall counter for all crankshaft errors" UWORD OneToOne 1 100 0.00 65535.00 FORMAT "%8.2" ECU_ADDRESS 0x6000D8E2 /end MEASUREMENT
/begin MEASUREMENT EpmHCrS_cntrInct "crankshaft teeth counter" SWORD OneToOne 1 100 -32768.00 32767.00 FORMAT "%8.2" ECU_ADDRESS 0x70002B72 /end MEASUREMENT
/begin MEASUREMENT EpmHCrS_cntrInctDcyc "Free running crankshaft teeth counter incremented at every active edge including missing teeth." ULONG OneToOne 1 100 0.00 4294967295.00 FORMAT "%13.2" ECU_ADDRESS 0x70002A50 /end MEASUREMENT
/begin MEASUREMENT EpmHCrS_cntrInctDcycOld "The variable to hold previous value of EpmHCrS_cntrInctDcyc" ULONG OneToOne 1 100 0.00 4294967295.00 FORMAT "%13.2" ECU_ADDRESS 0x50001530 /end MEASUREMENT
/begin MEASUREMENT EpmHCrS_ctAPTDiff "Synchronisation shift as number of real increments (gap corresponds to one real increment)" SWORD OneToOne 1 100 -32768.00 32767.00 FORMAT "%8.2" ECU_ADDRESS 0x600039E0 /end MEASUREMENT
/begin MEASUREMENT EpmHCrS_ctAPTPos "Calculation of Counter Values for Crankshaft Increments" SWORD OneToOne 1 100 -32768.00 32767.00 FORMAT "%8.2" ECU_ADDRESS 0x70002B74 /end MEASUREMENT
/begin MEASUREMENT EpmHCrS_ctDebEdge "Edge counter at crankshaft driver state DEBEDGE" SWORD OneToOne 1 100 -32768.00 32767.00 FORMAT "%8.2" ECU_ADDRESS 0x600039DA /end MEASUREMENT
/begin MEASUREMENT EpmHCrS_ctEdgeStrt "Start edge counter for DMA initialisation" UBYTE OneToOne 1 100 0.00 255.0 FORMAT "%5.1" ECU_ADDRESS 0x600064F4 /end MEASUREMENT
/begin MEASUREMENT EpmHCrS_ctGapDetn "Counter for measurement of stay duration inside crankshaft driver state with active gap search" SWORD OneToOne 1 100 -32768.00 32767.00 FORMAT "%8.2" ECU_ADDRESS 0x600039D8 /end MEASUREMENT
/begin MEASUREMENT EpmHCrS_ctGapPos "Internal - Migrated to SDOM from Old CMT" SWORD OneToOne 1 100 -32768.00 32767.00 FORMAT "%8.2" ECU_ADDRESS 0x70002B76 /end MEASUREMENT
/begin MEASUREMENT EpmHCrS_ctGapRef "Position of crankshaft relatively to current gap" SWORD OneToOne 1 100 -32768.00 32767.00 FORMAT "%8.2" ECU_ADDRESS 0x70002B78 /end MEASUREMENT
/begin MEASUREMENT EpmHCrS_ctIncActivate "Increment counter of the increment where the next synchro shall be activated" SWORD OneToOne 1 100 -32768.00 32767.00 FORMAT "%8.2" ECU_ADDRESS 0x70001A04 /end MEASUREMENT
/begin MEASUREMENT EpmHCrS_ctIncEngPos "Tooth counter current engine position" UWORD OneToOne 1 100 0.00 65535.00 FORMAT "%8.2" ECU_ADDRESS 0x6000050C /end MEASUREMENT
/begin MEASUREMENT EpmHCrS_ctIncGap "Value of increment counter EpmHCrS_ctIncStrt at last gap" SWORD OneToOne 1 100 -32768.00 32767.00 FORMAT "%8.2" ECU_ADDRESS 0x50005364 /end MEASUREMENT
/begin MEASUREMENT EpmHCrS_ctIncGapDly "Auxiliary information for calculation of reference counter EpmHCrS_ctGapRef" SWORD OneToOne 1 100 -32768.00 32767.00 FORMAT "%8.2" ARRAY_SIZE 2 ECU_ADDRESS 0x6000D8E4 /end MEASUREMENT
/begin MEASUREMENT EpmHCrS_ctIncPos "Increment counter with reference to zero mark" SWORD OneToOne 1 100 -32768.00 32767.00 FORMAT "%8.2" ECU_ADDRESS 0x6000D8E8 /end MEASUREMENT
/begin MEASUREMENT EpmHCrS_ctIncRvs "Counter for crankshaft increments with reverse engine rotation direction" UWORD OneToOne 1 100 0.00 65535.00 FORMAT "%8.2" ECU_ADDRESS 0x600039D6 /end MEASUREMENT
/begin MEASUREMENT EpmHCrS_ctIncStrt "Increment counter with reference to engine start" SWORD OneToOne 1 100 -32768.00 32767.00 FORMAT "%8.2" ECU_ADDRESS 0x70002B7A /end MEASUREMENT
/begin MEASUREMENT EpmHCrS_ctIncStrtOld "Value of increment counter EpmHCrS_ctIncStrt at preceding crankshaft tooth" SWORD OneToOne 1 100 -32768.00 32767.00 FORMAT "%8.2" ECU_ADDRESS 0x70002B7C /end MEASUREMENT
/begin MEASUREMENT EpmHCrS_ctOffsPos2Strt "Counter offset between EpmHCrS_ctIncPos and EpmHCrS_ctIncStrt" SWORD OneToOne 1 100 -32768.00 32767.00 FORMAT "%8.2" ECU_ADDRESS 0x6000D8EA /end MEASUREMENT
/begin MEASUREMENT EpmHCrS_ctOffsRel2APT "Counter offset between EpmHCrS_ctRel and EpmHCrS_ctAPTPos" SWORD OneToOne 1 100 -32768.00 32767.00 FORMAT "%8.2" ECU_ADDRESS 0x6000D8EC /end MEASUREMENT
/begin MEASUREMENT EpmHCrS_ctOffsRel2Strt "Counter offset between EpmHCrS_ctRel and EpmHCrS_ctIncStrt" SWORD OneToOne 1 100 -32768.00 32767.00 FORMAT "%8.2" ECU_ADDRESS 0x600039DE /end MEASUREMENT
/begin MEASUREMENT EpmHCrS_ctPosAry "Transformation array between hardware counter EpmHCrS_ctAPTPos and EpmHCrS_ctIncPos resp. EpmHCrS_ctGapPos" UWORD OneToOne 1 100 0.00 65535.00 FORMAT "%8.2" ARRAY_SIZE 68 ECU_ADDRESS 0x50005366 /end MEASUREMENT
/begin MEASUREMENT EpmHCrS_ctRealGapPos "Array with values of hardware counter EpmHCrS_ctAPTPos at gap positions" SWORD OneToOne 1 100 -32768.00 32767.00 FORMAT "%8.2" ARRAY_SIZE 2 ECU_ADDRESS 0x600039D2 /end MEASUREMENT
/begin MEASUREMENT EpmHCrS_ctRel "Free running internal edge counter" SWORD OneToOne 1 100 -32768.00 32767.00 FORMAT "%8.2" ECU_ADDRESS 0x70002B7E /end MEASUREMENT
/begin MEASUREMENT EpmHCrS_ctResyncUpperLvl "counter for the number of function calls" UWORD OneToOne 1 100 0.00 65535.00 FORMAT "%8.2" ECU_ADDRESS 0x600039C8 /end MEASUREMENT
/begin MEASUREMENT EpmHCrS_ctSynGapPos "Value of gap counter EpmHCrS_ctGapPos at synchronisation gap" SWORD OneToOne 1 100 -32768.00 32767.00 FORMAT "%8.2" ECU_ADDRESS 0x600039DC /end MEASUREMENT
/begin MEASUREMENT EpmHCrS_ctSynInc "Value of increment counter EpmHCrS_ctIncStrt at synchronisation gap" SWORD OneToOne 1 100 -32768.00 32767.00 FORMAT "%8.2" ECU_ADDRESS 0x600039D0 /end MEASUREMENT
/begin MEASUREMENT EpmHCrS_facGapCrit1 "Factor for adjustment of first gap criterion" UBYTE OneToOne 1 100 0.00 255.0 FORMAT "%5.1" ECU_ADDRESS 0x600064EF /end MEASUREMENT
/begin MEASUREMENT EpmHCrS_facGapCrit2 "Factor for adjustment of second gap criterion" UBYTE OneToOne 1 100 0.00 255.0 FORMAT "%5.1" ECU_ADDRESS 0x6000E3A6 /end MEASUREMENT
/begin MEASUREMENT EpmHCrS_facGapPlausHigh "Timeout factor of crankshaft sensor signal at gap of wheel" ULONG FactLow 1 100 0.00 4194303.99902 FORMAT "%13.5" ECU_ADDRESS 0x50001534 /end MEASUREMENT
/begin MEASUREMENT EpmHCrS_facIncPlausHigh "Timeout factor of crankshaft sensor signal at increment of wheel" ULONG FactLow 1 100 0.00 4194303.99902 FORMAT "%13.5" ECU_ADDRESS 0x50001538 /end MEASUREMENT
/begin MEASUREMENT EpmHCrS_facIncPlausLow "Factor for lower threshold of plausibility window of crankshaft signal" ULONG FactLow 1 100 0.00 4194303.99902 FORMAT "%13.5" ECU_ADDRESS 0x6000CD60 /end MEASUREMENT
/begin MEASUREMENT EpmHCrS_facPlausHigh "Timeout factor for increment signal of crankshaft sensor" ULONG FactLow 1 100 0.00 4194303.99902 FORMAT "%13.5" ECU_ADDRESS 0x70002A54 /end MEASUREMENT
/begin MEASUREMENT EpmHCrS_facPlausHighOld "Timeout factor for increment signal of crankshaft sensor (old value)" ULONG FactLow 1 100 0.00 4194303.99902 FORMAT "%13.5" ECU_ADDRESS 0x6000CD64 /end MEASUREMENT
/begin MEASUREMENT EpmHCrS_facPVTOld "Factor for lower threshold of plausibility window of crankshaft signal (old value)" ULONG OneToOne 1 100 0.00 4294967295.00 FORMAT "%13.2" ECU_ADDRESS 0x5000153C /end MEASUREMENT
/begin MEASUREMENT EpmHCrS_numDebInc "Number of crankshaft edges to debounce at crankshaft driver state DEBEDGE" UBYTE OneToOne 1 100 0.00 255.0 FORMAT "%5.1" ECU_ADDRESS 0x600064EE /end MEASUREMENT
/begin MEASUREMENT EpmHCrS_numGapWcy "Number of gaps of crankshaft wheel within one working cycle" SWORD OneToOne 1 100 -32768.00 32767.00 FORMAT "%8.2" ECU_ADDRESS 0x600039CE /end MEASUREMENT
/begin MEASUREMENT EpmHCrS_numGap_Var "Number of gaps on crankshaft wheel" UBYTE OneToOne 1 100 0.00 255.0 FORMAT "%5.1" ECU_ADDRESS 0x600006E3 /end MEASUREMENT
/begin MEASUREMENT EpmHCrS_numIncGap2GapMax "Maximum number of increments between two gaps of crankshaft wheel" SWORD OneToOne 1 100 -32768.00 32767.00 FORMAT "%8.2" ECU_ADDRESS 0x600039CC /end MEASUREMENT
/begin MEASUREMENT EpmHCrS_numIncGap2Gap_Var "Gap distance expressed by increments" UBYTE OneToOne 1 100 0.00 255.0 FORMAT "%5.1" ARRAY_SIZE 2 ECU_ADDRESS 0x60000418 /end MEASUREMENT
/begin MEASUREMENT EpmHCrS_numIncGapMiss "Evaluation of Rotation Direction Information from Engine Speed Sensor" SWORD OneToOne 1 100 -32768.00 32767.00 FORMAT "%8.2" ECU_ADDRESS 0x6000D8EE /end MEASUREMENT
/begin MEASUREMENT EpmHCrS_numIncGap_Var "Evaluation of Rotation Direction Information from Engine Speed Sensor" UBYTE OneToOne 1 100 0.00 255.0 FORMAT "%5.1" ECU_ADDRESS 0x600006E4 /end MEASUREMENT
/begin MEASUREMENT EpmHCrS_numIncReal "Number of real increments of crankshaft wheel (without gap increments) within one crankshaft rotation" SWORD OneToOne 1 100 -32768.00 32767.00 FORMAT "%8.2" ECU_ADDRESS 0x600039CA /end MEASUREMENT
/begin MEASUREMENT EpmHCrS_numIncRealWcy "Number of real increments of crankshaft wheel (without gap increments) within one working cycle" SWORD OneToOne 1 100 -32768.00 32767.00 FORMAT "%8.2" ECU_ADDRESS 0x6000D8F0 /end MEASUREMENT
/begin MEASUREMENT EpmHCrS_numIncRealWcyLast "Value of EpmHCrS_numIncRealWcy minus one" SWORD OneToOne 1 100 -32768.00 32767.00 FORMAT "%8.2" ECU_ADDRESS 0x6000D8F2 /end MEASUREMENT
/begin MEASUREMENT EpmHCrS_numIncWcy "Number of increments of crankshaft wheel (including gap increments) within one working cycle" SWORD OneToOne 1 100 -32768.00 32767.00 FORMAT "%8.2" ECU_ADDRESS 0x500053EE /end MEASUREMENT
/begin MEASUREMENT EpmHCrS_numInc_Var "Number of increments on crankshaft wheel" UBYTE OneToOne 1 100 0.00 255.0 FORMAT "%5.1" ECU_ADDRESS 0x600006E5 /end MEASUREMENT
/begin MEASUREMENT EpmHCrS_stActEdge "Status for definition of type of active edge" UBYTE OneToOne 1 100 0.00 255.0 FORMAT "%5.1" ECU_ADDRESS 0x600006E6 /end MEASUREMENT
/begin MEASUREMENT EpmHCrS_stBufFillUpd "Status: crankshaft signal buffer not filled completely" UBYTE OneToOne 1 100 0.00 255.0 BIT_MASK 0x1 FORMAT "%5.1" ECU_ADDRESS 0x6000E3A7 /end MEASUREMENT
/begin MEASUREMENT EpmHCrS_stBufGapCor "Release state for increment duration separation of gap (at 1. tooth after gap)" UBYTE OneToOne 1 100 0.00 255.0 BIT_MASK 0x1 FORMAT "%5.1" ECU_ADDRESS 0x6000E3A8 /end MEASUREMENT
/begin MEASUREMENT EpmHCrS_stDirChg "Status: engine rotation direction of last DGI pulse changed in relation to preceding pulse" UBYTE OneToOne 1 100 0.00 255.0 FORMAT "%5.1" ECU_ADDRESS 0x70002D55 /end MEASUREMENT
/begin MEASUREMENT EpmHCrS_stDirEvln "Status of direction evaluation for DGI pulses" UBYTE OneToOne 1 100 0.00 255.0 FORMAT "%5.1" ECU_ADDRESS 0x70002D56 /end MEASUREMENT
/begin MEASUREMENT EpmHCrS_stDisblNewSync "Status variable: request for change of crankshaft driver to state DISABLENEWSYNC is active" UBYTE OneToOne 1 100 0.00 255.0 FORMAT "%5.1" ECU_ADDRESS 0x600064F1 /end MEASUREMENT
/begin MEASUREMENT EpmHCrS_stEdgeISRActv "Dynamical Plausibility Check of Crankshaft Increment Duration" UBYTE OneToOne 1 100 0.00 255.0 BIT_MASK 0x1 FORMAT "%5.1" ECU_ADDRESS 0x70002D57 /end MEASUREMENT
/begin MEASUREMENT EpmHCrS_stEngStrt "Engine start information for the calculation of start behavior" UBYTE OneToOne 1 100 0.00 255.0 FORMAT "%5.1" ECU_ADDRESS 0x50005D25 /end MEASUREMENT
/begin MEASUREMENT EpmHCrS_stFirstValTooth "Status: first valid crankshaft tooth after reset of crankshaft driver" UBYTE OneToOne 1 100 0.00 255.0 BIT_MASK 0x1 FORMAT "%5.1" ECU_ADDRESS 0x6000E3A9 /end MEASUREMENT
/begin MEASUREMENT EpmHCrS_stGapSubState "Sub state of crankshaft driver for gap search" UBYTE OneToOne 1 100 0.00 255.0 FORMAT "%5.1" ECU_ADDRESS 0x600064ED /end MEASUREMENT
/begin MEASUREMENT EpmHCrS_stMainIntrptEdge "Comparison mask for check of DMA phase within main functionality of crankshaft driver" ULONG OneToOne 1 100 0.00 4294967295.00 FORMAT "%13.2" ECU_ADDRESS 0x6000CD68 /end MEASUREMENT
/begin MEASUREMENT EpmHCrS_stOneAftGap "Status: actual engine position is at first tooth after gap" UBYTE OneToOne 1 100 0.00 255.0 FORMAT "%5.1" ECU_ADDRESS 0x70002D58 /end MEASUREMENT
/begin MEASUREMENT EpmHCrS_stPlsMod "Status variable to indicate pulse mode or edge mode for Crankshaft Hybrid Sensor" UBYTE OneToOne 1 100 0.00 255.0 BIT_MASK 0x1 FORMAT "%5.1" ECU_ADDRESS 0x70002D59 /end MEASUREMENT
/begin MEASUREMENT EpmHCrS_stRdGTMReg "Status for direct read from GTM registers" UBYTE OneToOne 1 100 0.00 255.0 BIT_MASK 0x1 FORMAT "%5.1" ECU_ADDRESS 0x70002D5A /end MEASUREMENT
/begin MEASUREMENT EpmHCrS_stReqDrvrRstrt "State of crankshaft driver restart request" UBYTE OneToOne 1 100 0.00 255.0 BIT_MASK 0x1 FORMAT "%5.1" ECU_ADDRESS 0x600064EC /end MEASUREMENT
/begin MEASUREMENT EpmHCrS_stReqDrvRst "Status: reset of crankshaft driver is requested" UBYTE OneToOne 1 100 0.00 255.0 BIT_MASK 0x1 FORMAT "%5.1" ECU_ADDRESS 0x6000E3AA /end MEASUREMENT
/begin MEASUREMENT EpmHCrS_stRotDir "DGI information: rotation direction of engine" UBYTE EpmHCrS_stRotDir_t 1 100 0.00 3.00000000000 FORMAT "%13.11" ECU_ADDRESS 0x6000E3AB /end MEASUREMENT
/begin MEASUREMENT EpmHCrS_stRotDirRaw "DGI information: raw value of engine rotation direction" UBYTE EpmHCrS_stRotDir_t 1 100 0.00 3.00000000000 FORMAT "%13.11" ECU_ADDRESS 0x70002D5B /end MEASUREMENT
/begin MEASUREMENT EpmHCrS_stSigErr "Bit coded error state of the crankshaft signal evaluation" UWORD OneToOne 1 100 0.00 65535.00 FORMAT "%8.2" ECU_ADDRESS 0x600039C6 /end MEASUREMENT
/begin MEASUREMENT EpmHCrS_stSigMode "State of HW driver of crankshaft signal evaluation" UBYTE EpmHCrS_stSigMode_State_t 1 100 0.00 9.00000000000 FORMAT "%13.11" ECU_ADDRESS 0x50005D26 /end MEASUREMENT
/begin MEASUREMENT EpmHCrS_stStrtSigMode "Request for resynchronisation of crankshaft driver" UBYTE OneToOne 1 100 0.00 255.0 BIT_MASK 0x1 FORMAT "%5.1" ECU_ADDRESS 0x6000E3AC /end MEASUREMENT
/begin MEASUREMENT EpmHCrS_stSymGap "Status: symmetrical distribution of gaps of crankshaft wheel" UBYTE OneToOne 1 100 0.00 255.0 FORMAT "%5.1" ECU_ADDRESS 0x600064F6 /end MEASUREMENT
/begin MEASUREMENT EpmHCrS_stSyncIniExe "Status: syncIni processes of application software are executed" UBYTE OneToOne 1 100 0.00 255.0 BIT_MASK 0x1 FORMAT "%5.1" ECU_ADDRESS 0x600064F0 /end MEASUREMENT
/begin MEASUREMENT EpmHCrS_stTmrActv "Status: timer for resynchronisation of crankshaft driver is active" UBYTE OneToOne 1 100 0.00 255.0 BIT_MASK 0x1 FORMAT "%5.1" ECU_ADDRESS 0x600064F5 /end MEASUREMENT
/begin MEASUREMENT EpmHCrS_stTwoAftGap "Status: actual engine position is at second tooth after gap" UBYTE OneToOne 1 100 0.00 255.0 FORMAT "%5.1" ECU_ADDRESS 0x70002D5C /end MEASUREMENT
/begin MEASUREMENT EpmHCrS_swtCntrPosRst "Request for reset of counter system with reference to engine position" UBYTE OneToOne 1 100 0.00 255.0 BIT_MASK 0x1 FORMAT "%5.1" ECU_ADDRESS 0x600064F3 /end MEASUREMENT
/begin MEASUREMENT EpmHCrS_swtDirChgRawOld "Status: rotation direction change occurred at last crankshaft increment" UBYTE OneToOne 1 100 0.00 255.0 BIT_MASK 0x1 FORMAT "%5.1" ECU_ADDRESS 0x600064FC /end MEASUREMENT
/begin MEASUREMENT EpmHCrS_swtDirChgRawOld2 "Status: rotation direction change occurred at second to last crankshaft increment" UBYTE OneToOne 1 100 0.00 255.0 BIT_MASK 0x1 FORMAT "%5.1" ECU_ADDRESS 0x600064FB /end MEASUREMENT
/begin MEASUREMENT EpmHCrS_swtDirInfoOn "Status: rotation direction is switched on" UBYTE OneToOne 1 100 0.00 255.0 BIT_MASK 0x1 FORMAT "%5.1" ECU_ADDRESS 0x600064F9 /end MEASUREMENT
/begin MEASUREMENT EpmHCrS_swtEdgeOcc "Indication for edge occurred since last crankshaft timeout" UBYTE OneToOne 1 100 0.00 255.0 FORMAT "%5.1" ECU_ADDRESS 0x70002D5D /end MEASUREMENT
/begin MEASUREMENT EpmHCrS_swtEnaDirPlaus "Release state for dynamical direction evaluation" UBYTE OneToOne 1 100 0.00 255.0 BIT_MASK 0x1 FORMAT "%5.1" ECU_ADDRESS 0x600064FA /end MEASUREMENT
/begin MEASUREMENT EpmHCrS_swtGapShft "Status: Request for synchronisation shift to new gap is active" UBYTE OneToOne 1 100 0.00 255.0 FORMAT "%5.1" ECU_ADDRESS 0x6000E3AD /end MEASUREMENT
/begin MEASUREMENT EpmHCrS_swtGapTout "Switch to set timeout factor for gap or normal tooth" UBYTE OneToOne 1 100 0.00 255.0 FORMAT "%5.1" ECU_ADDRESS 0x6000E3AE /end MEASUREMENT
/begin MEASUREMENT EpmHCrS_swtIntrptSetUp "Request for reset of interrupt system" UBYTE OneToOne 1 100 0.00 255.0 BIT_MASK 0x1 FORMAT "%5.1" ECU_ADDRESS 0x600064F2 /end MEASUREMENT
/begin MEASUREMENT EpmHCrS_swtNoPVTDly "Control variable for delayed activation of edge suppress range (PVT check)" UBYTE OneToOne 1 100 0.00 255.0 FORMAT "%5.1" ECU_ADDRESS 0x600064F8 /end MEASUREMENT
/begin MEASUREMENT EpmHCrS_swtToutActv "Switch for activation of timeout at crankshaft signal" UBYTE OneToOne 1 100 0.00 255.0 FORMAT "%5.1" ECU_ADDRESS 0x600064F7 /end MEASUREMENT
/begin MEASUREMENT EpmHCrS_tiActv2ActvEdge "Time distance between two successive active edges" ULONG OneToOne 1 100 0.00 4294967295.00 FORMAT "%13.2" ECU_ADDRESS 0x70002A58 /end MEASUREMENT
/begin MEASUREMENT EpmHCrS_tiActv2PasEdge "Time distance between active and successive passive edge" ULONG OneToOne 1 100 0.00 4294967295.00 FORMAT "%13.2" ECU_ADDRESS 0x70002A5C /end MEASUREMENT
/begin MEASUREMENT EpmHCrS_tiActvEdge "Time stamp of active edge of crankshaft signal" ULONG OneToOne 1 100 0.00 4294967295.00 FORMAT "%13.2" ECU_ADDRESS 0x70002A60 /end MEASUREMENT
/begin MEASUREMENT EpmHCrS_tiFilDlyActvEdge "Delay time of time stamp of active edge because of hardware filtering" ULONG OneToOne 1 100 0.00 4294967295.00 FORMAT "%13.2" ECU_ADDRESS 0x50001540 /end MEASUREMENT
/begin MEASUREMENT EpmHCrS_tiFilDlyInActvEdge "Delay time of time stamp of inactive edge because of hardware filtering" ULONG OneToOne 1 100 0.00 4294967295.00 FORMAT "%13.2" ECU_ADDRESS 0x6000CD6C /end MEASUREMENT
/begin MEASUREMENT EpmHCrS_tiIgnSig "Retention time at crankshaft driver state IGNTIME (target value)" SLONG OneToOne 1 100 -2147483648.00 2147483647.00 FORMAT "%13.2" ECU_ADDRESS 0x600014E4 /end MEASUREMENT
/begin MEASUREMENT EpmHCrS_tiLstActvEdge "Active edge time stamp of last tooth" ULONG OneToOne 1 100 0.00 4294967295.00 FORMAT "%13.2" ECU_ADDRESS 0x600014E8 /end MEASUREMENT
/begin MEASUREMENT EpmHCrS_tiLstEdge "Time stamp of the last Crankshaft Edge occurred" ULONG OneToOne 1 100 0.00 4294967295.00 FORMAT "%13.2" ECU_ADDRESS 0x50001544 /end MEASUREMENT
/begin MEASUREMENT EpmHCrS_tiPasEdge "Time stamp of passive edge of crankshaft signal" ULONG OneToOne 1 100 0.00 4294967295.00 FORMAT "%13.2" ECU_ADDRESS 0x70002A64 /end MEASUREMENT
/begin MEASUREMENT EpmHCrS_tiPerTn "Time duration of actual increment" SLONG OneToOne 1 100 -2147483648.00 2147483647.00 FORMAT "%13.2" ECU_ADDRESS 0x70002A68 /end MEASUREMENT
/begin MEASUREMENT EpmHCrS_tiPerTnACC "Retention time at crankshaft driver state IGNTIME (actual value)" SLONG OneToOne 1 100 -2147483648.00 2147483647.00 FORMAT "%13.2" ECU_ADDRESS 0x50001548 /end MEASUREMENT
/begin MEASUREMENT EpmHCrS_tiPerTn_1 "Time duration of last increment" SLONG OneToOne 1 100 -2147483648.00 2147483647.00 FORMAT "%13.2" ECU_ADDRESS 0x70002A6C /end MEASUREMENT
/begin MEASUREMENT EpmHCrS_tiPerTn_2 "Time duration of last but one increment" SLONG OneToOne 1 100 -2147483648.00 2147483647.00 FORMAT "%13.2" ECU_ADDRESS 0x70002A70 /end MEASUREMENT
/begin MEASUREMENT EpmHCrS_tiPlsFwd "forward pulse width of DGI crankshaft sensor" SLONG OneToOne 1 100 -2147483648.00 2147483647.00 FORMAT "%13.2" ECU_ADDRESS 0x60000250 /end MEASUREMENT
/begin MEASUREMENT EpmHCrS_tiPlsRvs "reverse pulse width of DGI crankshaft sensor" SLONG OneToOne 1 100 -2147483648.00 2147483647.00 FORMAT "%13.2" ECU_ADDRESS 0x60000254 /end MEASUREMENT
/begin MEASUREMENT EpmHCrS_tiStampExt "Extended bit range of crankshaft edge time stamp" ULONG OneToOne 1 100 0.00 4294967295.00 FORMAT "%13.2" ECU_ADDRESS 0x6000CD70 /end MEASUREMENT
/begin MEASUREMENT EpmHCrS_tiTmrStrt "Reference time for delay of resynchronisation of crankshaft driver" ULONG InjTimeHiRes_us 1 100 0.00 214748364.750 FORMAT "%13.3" ECU_ADDRESS 0x5000154C /end MEASUREMENT
/begin MEASUREMENT EpmHCrS_tiToutEngStop "Timeout duration for engine stop state detection" ULONG InjTimeHiRes_us 1 100 0.00 214748364.750 FORMAT "%13.3" ECU_ADDRESS 0x50001550 /end MEASUREMENT
/begin MEASUREMENT EpmHwE_DMARam "Ram Array to store GTM register values in DMA Transfer" ULONG OneToOne 1 100 0.00 4294967295.00 FORMAT "%13.2" ARRAY_SIZE 6 ECU_ADDRESS 0x50001000 /end MEASUREMENT
/begin MEASUREMENT EpmIf_RngMod_trqMax "Epm maximum torque" SWORD Trq 1 100 -3276.800 3276.700 FORMAT "%8.3" ECU_ADDRESS 0x6000539A /end MEASUREMENT
/begin MEASUREMENT EpmIf_tCoolant "Epm engine temperature" SWORD Temp_Cels 1 100 -3549.940 3003.560 FORMAT "%8.3" ECU_ADDRESS 0x6000050E /end MEASUREMENT
/begin MEASUREMENT EpmIf_tOil "Epm oil temperature" SWORD RBPtCel_t_0p1om273p14_1 1 100 -3549.940 3003.560 FORMAT "%8.3" ECU_ADDRESS 0x60000514 /end MEASUREMENT
/begin MEASUREMENT EpmRRS_actIncAr_mp "Array of current CrS tooth counters in 10ms task" UWORD OneToOne 1 100 0.00 65535.00 FORMAT "%8.2" ARRAY_SIZE 16 ECU_ADDRESS 0x70008846 /end MEASUREMENT
/begin MEASUREMENT EpmRRS_actIncBuf_mp "CrS increment counter directly from from EpmHWE buffer" SWORD OneToOne 1 100 -32768.00 32767.00 FORMAT "%8.2" ECU_ADDRESS 0x70008844 /end MEASUREMENT
/begin MEASUREMENT EpmRRS_actIncOrig_mp "current increment counter, related to EpmHWE" UWORD OneToOne 1 100 0.00 65535.00 FORMAT "%8.2" ECU_ADDRESS 0x70008842 /end MEASUREMENT
/begin MEASUREMENT EpmRRS_actInc_mp "current increment counter, related to 0°CrS" UWORD OneToOne 1 100 0.00 65535.00 FORMAT "%8.2" ECU_ADDRESS 0x70008840 /end MEASUREMENT
/begin MEASUREMENT EpmRRS_bEngSwOff "Emergency switch off due to reverse running engine" UBYTE EpmRRS_bEngSwOff_t 1 100 0.00 1.00000000000 FORMAT "%13.11" ECU_ADDRESS 0x6000E417 /end MEASUREMENT
/begin MEASUREMENT EpmRRS_ctGapInBuffer_mp "Number of gaps in the actual section of the tooth time buffer" UBYTE OneToOne 1 100 0.00 255.0 FORMAT "%5.1" ECU_ADDRESS 0x70008A7D /end MEASUREMENT
/begin MEASUREMENT EpmRRS_ctNewTeethOrig_mp "Number of new teeth in the signal buffer since last call of function" UBYTE OneToOne 1 100 0.00 255.0 FORMAT "%5.1" ARRAY_SIZE 2 ECU_ADDRESS 0x70008A7B /end MEASUREMENT
/begin MEASUREMENT EpmRRS_ctNewTeeth_mp "Number of new teeth in the signal buffer since last call of function, corrected by gap teeth" UBYTE OneToOne 1 100 0.00 255.0 FORMAT "%5.1" ECU_ADDRESS 0x70008A7A /end MEASUREMENT
/begin MEASUREMENT EpmRRS_ctToothTimeout_mp "Timeout counter: EpmRRS calls without new CrS tooth (10ms)" UWORD OneToOne 1 100 0.00 65535.00 FORMAT "%8.2" ECU_ADDRESS 0x7000883E /end MEASUREMENT
/begin MEASUREMENT EpmRRS_GapDetected_mp "Function EpmRRS_agDetect has found a gap" UBYTE OneToOne 1 100 0.00 255.0 FORMAT "%5.1" ECU_ADDRESS 0x70008A79 /end MEASUREMENT
/begin MEASUREMENT EpmRRS_idxWrAct_mp "Index of currecnt tooth in tooth time buffer" SWORD OneToOne 1 100 -32768.00 32767.00 FORMAT "%8.2" ECU_ADDRESS 0x7000883C /end MEASUREMENT
/begin MEASUREMENT EpmRRS_incGapTest_mp "Increment at gap test" SWORD OneToOne 1 100 -32768.00 32767.00 FORMAT "%8.2" ECU_ADDRESS 0x7000883A /end MEASUREMENT
/begin MEASUREMENT EpmRRS_incSynOffs_mp "Increment for angle offset: EpmSyn_phiOffs at first call of EpmRRS" SWORD OneToOne 1 100 -32768.00 32767.00 FORMAT "%8.2" ECU_ADDRESS 0x70008838 /end MEASUREMENT
/begin MEASUREMENT EpmRRS_maxToothCondAr_mp "Array of results of the function EpmRRS_MaxToothCondition" UWORD OneToOne 1 100 0.00 65535.00 FORMAT "%8.2" ARRAY_SIZE 16 ECU_ADDRESS 0x70008818 /end MEASUREMENT
/begin MEASUREMENT EpmRRS_phiEngRR "Angle of first engine direction change" SWORD AngleCrS 1 100 -720.0000 719.9780 FORMAT "%8.4" ECU_ADDRESS 0x600039C0 /end MEASUREMENT
/begin MEASUREMENT EpmRRS_phiGapPos "Gap positions based on the calibrated zero position" SWORD AngleCrS 1 100 -720.0000 719.9780 FORMAT "%8.4" ARRAY_SIZE 2 ECU_ADDRESS 0x500053F0 /end MEASUREMENT
/begin MEASUREMENT EpmRRS_phiRelTDC_mp "angle relative to the TDC" SWORD AngleCrS 1 100 -720.0000 719.9780 FORMAT "%8.4" ECU_ADDRESS 0x70008816 /end MEASUREMENT
/begin MEASUREMENT EpmRRS_stAgDetect "State of reverse rotation detection" UBYTE EpmRRS_stAgDetect_t 1 100 0.00 2.00000000000 FORMAT "%13.11" ECU_ADDRESS 0x600064EB /end MEASUREMENT
/begin MEASUREMENT EpmRRS_stEnable "State of switch-on conditions of reverse rotation detection" UBYTE OneToOne 1 100 0.00 255.0 BIT_MASK 0x1 FORMAT "%5.1" ECU_ADDRESS 0x600064EA /end MEASUREMENT
/begin MEASUREMENT EpmRRS_stEngStop "Engine has stopped after tooth timeout" UBYTE OneToOne 1 100 0.00 255.0 FORMAT "%5.1" ECU_ADDRESS 0x600064E9 /end MEASUREMENT
/begin MEASUREMENT EpmRRS_stEngStopOld "The variable to hold previous value of EpmRRS_stEngStop" UBYTE OneToOne 1 100 0.00 255.0 FORMAT "%5.1" ECU_ADDRESS 0x70002D5E /end MEASUREMENT
/begin MEASUREMENT EpmRRS_stGetBufNumPer_mp "State of request to EpmHCrS CrS signal buffer" UBYTE OneToOne 1 100 0.00 255.0 FORMAT "%5.1" ECU_ADDRESS 0x70008A78 /end MEASUREMENT
/begin MEASUREMENT EpmRRS_stReason_mp "Methode which has detected a reverse running engine" UBYTE OneToOne 1 100 0.00 255.0 FORMAT "%5.1" ECU_ADDRESS 0x70008A77 /end MEASUREMENT
/begin MEASUREMENT EpmRRS_stRotDir "Rotation direction of engine" UBYTE EpmRRS_stRotDir_t 1 100 0.00 3.00000000000 FORMAT "%13.11" ECU_ADDRESS 0x6000A757 /end MEASUREMENT
/begin MEASUREMENT EpmRRS_stToothPerBuf_mp "State of request to read CrS buffer" UBYTE OneToOne 1 100 0.00 255.0 FORMAT "%5.1" ECU_ADDRESS 0x70008A76 /end MEASUREMENT
/begin MEASUREMENT EpmRRS_tiToothPer "Array of tooth periods" SLONG OneToOne_us 1 100 -2147483648.00 2147483647.00 FORMAT "%13.2" ARRAY_SIZE 16 ECU_ADDRESS 0x600014A4 /end MEASUREMENT
/begin MEASUREMENT EpmRRS_tiToothPerOrg "Tooth time buffer without gap correction" SLONG OneToOne_us 1 100 -2147483648.00 2147483647.00 FORMAT "%13.2" ARRAY_SIZE 16 ECU_ADDRESS 0x60001464 /end MEASUREMENT
/begin MEASUREMENT EpmSeq_ctActivateSyncPre "Counter to track SyncPre task activation" UWORD OneToOne 1 100 0.00 65535.00 FORMAT "%8.2" ECU_ADDRESS 0x6000D8F4 /end MEASUREMENT
/begin MEASUREMENT EpmSeq_ctForceResync "Counter to track resynchronization trigger" UWORD OneToOne 1 100 0.00 65535.00 FORMAT "%8.2" ECU_ADDRESS 0x600039BE /end MEASUREMENT
/begin MEASUREMENT EpmSeq_ctIncNextEvent_mp "event count at time of next interrupt activation" UWORD OneToOne 1 100 0.00 65535.00 FORMAT "%8.2" ECU_ADDRESS 0x70008814 /end MEASUREMENT
/begin MEASUREMENT EpmSeq_currentEveId_mp "Event identifier of current activation" UBYTE EpmSeq_EveId_t 1 100 0.00 17.0000000000 FORMAT "%13.10" ECU_ADDRESS 0x70008A75 /end MEASUREMENT
/begin MEASUREMENT EpmSeq_eveCount "Counter to track the requested trigger events" UWORD OneToOne 1 100 0.00 65535.00 FORMAT "%8.2" ECU_ADDRESS 0x70008812 /end MEASUREMENT
/begin MEASUREMENT EpmSeq_EveHndlr_stErr "Error information of the current activation" ULONG OneToOne 1 100 0.00 4294967295.00 FORMAT "%13.2" ECU_ADDRESS 0x60001460 /end MEASUREMENT
/begin MEASUREMENT EpmSeq_eveId "Id of the event which activated the OS_SyncPre_Task" UBYTE EpmSeq_EveId_t 1 100 0.00 17.0000000000 FORMAT "%13.10" ECU_ADDRESS 0x50005D7E /end MEASUREMENT
/begin MEASUREMENT EpmSeq_idxIntrptData "Index of the interrupt data at the moment of active static interrupt" SWORD OneToOne 1 100 -32768.00 32767.00 FORMAT "%8.2" ECU_ADDRESS 0x50005A46 /end MEASUREMENT
/begin MEASUREMENT EpmSeq_idxIntrptDataNxt "Index of the interrupt data at the moment of next active static interrupt" SWORD OneToOne 1 100 -32768.00 32767.00 FORMAT "%8.2" ECU_ADDRESS 0x50005A48 /end MEASUREMENT
/begin MEASUREMENT EpmSeq_numActvIntrpt "Number of the released static interrupts" SWORD OneToOne 1 100 -32768.00 32767.00 FORMAT "%8.2" ECU_ADDRESS 0x50005A4A /end MEASUREMENT
/begin MEASUREMENT EpmSeq_numIncDiffInt "Difference between 2 synchro-interrupts in crankshafttooth" SWORD OneToOne 1 100 -32768.00 32767.00 FORMAT "%8.2" ARRAY_SIZE 2 ECU_ADDRESS 0x70002C42 /end MEASUREMENT
/begin MEASUREMENT EpmSeq_numInt "type of current interrupt" UBYTE EpmSeq_numInt_Compu 1 100 0.00 38.0000000000 FORMAT "%13.10" ECU_ADDRESS 0x50005D7F /end MEASUREMENT
/begin MEASUREMENT EpmSeq_numIntPrev "Type of Previous Interrupt" UBYTE EpmSeq_numInt_Compu 1 100 0.00 38.0000000000 FORMAT "%13.10" ECU_ADDRESS 0x70002D88 /end MEASUREMENT
/begin MEASUREMENT EpmSeq_phiEve "Angle stamp of the current activiation event" ULONG AngleCrS 1 100 0.00 94371839.9781 FORMAT "%13.4" ECU_ADDRESS 0x500004E8 /end MEASUREMENT
/begin MEASUREMENT EpmSeq_phiIntrpt "Absolute interrupt position of the active static interrupt" SWORD AngleCrS 1 100 -720.0000 719.9780 FORMAT "%8.4" ECU_ADDRESS 0x50005A4C /end MEASUREMENT
/begin MEASUREMENT EpmSeq_phiNxtInt "angle of the next syncrointerrupt" SWORD AngleCrS 1 100 0.00 719.9780 FORMAT "%8.4" ECU_ADDRESS 0x50005956 /end MEASUREMENT
/begin MEASUREMENT EpmSeq_phiNxtInt_msg "Angle of the next syncrointerrupt" SWORD AngleCrS 1 100 0.00 719.9780 FORMAT "%8.4" ECU_ADDRESS 0x50005A4E /end MEASUREMENT
/begin MEASUREMENT EpmSeq_stCurrInt "Currently executed angle synchronous interrupt" UBYTE EpmSeq_stInt_Compu 1 100 0.00 36.0000000000 FORMAT "%13.10" ECU_ADDRESS 0x70002D89 /end MEASUREMENT
/begin MEASUREMENT EpmSeq_stInt "status of sequencemanager" UBYTE EpmSeq_stInt_Compu 1 100 0.00 36.0000000000 FORMAT "%13.10" ECU_ADDRESS 0x70002D5F /end MEASUREMENT
/begin MEASUREMENT EpmSeq_stIntrptGen "Information which kinds of static interrupts have to be generated" UBYTE EpmSeq_stIntrptGen_Compu 1 100 0.00 4.00000000000 FORMAT "%13.11" ECU_ADDRESS 0x50005D80 /end MEASUREMENT
/begin MEASUREMENT EpmSeq_stReqIntrptGen "Information which kinds of static interrupts are requested externally" UBYTE EpmSeq_stReqIntrptGen_Compu 1 100 0.00 1.00000000000 FORMAT "%13.11" ECU_ADDRESS 0x600064E8 /end MEASUREMENT
/begin MEASUREMENT EpmSeq_stSyncPrev "Previous synchronization state" UBYTE Epm_stSync_State_t 1 100 0.00 30.0000000000 FORMAT "%13.10" ECU_ADDRESS 0x50005D27 /end MEASUREMENT
/begin MEASUREMENT EpmSeq_stSyncPrev_mp "Previous synchronization state" UBYTE Epm_stSync_State_t 1 100 0.00 30.0000000000 FORMAT "%13.10" ECU_ADDRESS 0x70008A74 /end MEASUREMENT
/begin MEASUREMENT EpmSeq_SyncPreEnaMask_mp "Enable mask for SyncPre task activation" ULONG OneToOne 1 100 0.00 4294967295.00 FORMAT "%13.2" ECU_ADDRESS 0x7000864C /end MEASUREMENT
/begin MEASUREMENT EpmSeq_tiEve "Time stamp of the current activiation event" ULONG OneToOne 1 100 0.00 4294967295.00 FORMAT "%13.2" ECU_ADDRESS 0x500004EC /end MEASUREMENT
/begin MEASUREMENT EpmSrv_stCnvAgT2Ag_mp "Internal state of the function EpmSrv_CnvAgT2Ag" UBYTE EpmSrv_stCnvAgT2Ag_t 1 100 0.00 255.000000000 FORMAT "%13.9" ECU_ADDRESS 0x70008A73 /end MEASUREMENT
/begin MEASUREMENT EpmSyn_CaSDataI1.SigTab "Signal table with the detected camshaft segments inlet bank 1 / Signal table (Bit0..3 - Seg, Bit4 - Level, Bit5 - Gap)" UBYTE OneToOne 1 100 0.00 255.0 FORMAT "%5.1" ARRAY_SIZE 8 ECU_ADDRESS 0x50000170 /end MEASUREMENT
/begin MEASUREMENT EpmSyn_CaSDataI1.stSearch "Signal table with the detected camshaft segments inlet bank 1 / Search state (Bit0..3 - Seg, Bit4 - Level, Bit5 - Gap)" UBYTE OneToOne 1 100 0.00 255.0 FORMAT "%5.1" ARRAY_SIZE 8 ECU_ADDRESS 0x50000178 /end MEASUREMENT
/begin MEASUREMENT EpmSyn_CaSDataI1.ctLstEdge "Signal table with the detected camshaft segments inlet bank 1 / Number of measured edges from the driver" SWORD OneToOne 1 100 -32768.00 32767.00 FORMAT "%8.2" ECU_ADDRESS 0x50000180 /end MEASUREMENT
/begin MEASUREMENT EpmSyn_CaSDataI1.phiIniCaSPos "Signal table with the detected camshaft segments inlet bank 1 / Starting angle of the evaluation of the camshaft" SWORD AngleCrS 1 100 -720.0000 719.9780 FORMAT "%8.4" ECU_ADDRESS 0x50000182 /end MEASUREMENT
/begin MEASUREMENT EpmSyn_CaSDataI1.phiLstEdge "Signal table with the detected camshaft segments inlet bank 1 / Angle of the last measured edge" SWORD AngleCrS 1 100 -720.0000 719.9780 FORMAT "%8.4" ECU_ADDRESS 0x50000184 /end MEASUREMENT
/begin MEASUREMENT EpmSyn_CaSDataI1.phiSegPos "Signal table with the detected camshaft segments inlet bank 1 / Sum of the angles of the segments in the reference table to the index of correlation in the signal table" SWORD AngleCrS 1 100 -720.0000 719.9780 FORMAT "%8.4" ECU_ADDRESS 0x50000186 /end MEASUREMENT
/begin MEASUREMENT EpmSyn_CaSDataI1.numSegInSigTab "Signal table with the detected camshaft segments inlet bank 1 / Number of detected segments in the signal table" UBYTE OneToOne 1 100 0.00 255.0 FORMAT "%5.1" ECU_ADDRESS 0x50000188 /end MEASUREMENT
/begin MEASUREMENT EpmSyn_CaSDataI1.ctSigTabLstEntr "Signal table with the detected camshaft segments inlet bank 1 / points to the last entry in the signal table (-1, table is reseted and contains no valid entries)" SBYTE OneToOne 1 100 -128.0 127.0 FORMAT "%5.1" ECU_ADDRESS 0x50000189 /end MEASUREMENT
/begin MEASUREMENT EpmSyn_CaSDataI1.ctWcycle "Signal table with the detected camshaft segments inlet bank 1 / Segment counter during the working cycle" SBYTE OneToOne 1 100 -128.0 127.0 FORMAT "%5.1" ECU_ADDRESS 0x5000018A /end MEASUREMENT
/begin MEASUREMENT EpmSyn_CaSDataI1.stPreSeg "Signal table with the detected camshaft segments inlet bank 1 / Last entry in the signals table is a temporarily entry" UBYTE OneToOne 1 100 0.00 255.0 FORMAT "%5.1" ECU_ADDRESS 0x5000018B /end MEASUREMENT
/begin MEASUREMENT EpmSyn_CaSDataI1.numNewEdges "Signal table with the detected camshaft segments inlet bank 1 / Number of new edges since the last call" UBYTE OneToOne 1 100 0.00 255.0 FORMAT "%5.1" ECU_ADDRESS 0x5000018C /end MEASUREMENT
/begin MEASUREMENT EpmSyn_CaSDataI1.numMatches "Signal table with the detected camshaft segments inlet bank 1 / Number of detected correlation between signal table and reference table" SBYTE OneToOne 1 100 -128.0 127.0 FORMAT "%5.1" ECU_ADDRESS 0x5000018D /end MEASUREMENT
/begin MEASUREMENT EpmSyn_CaSDataI1.numMatchPos "Signal table with the detected camshaft segments inlet bank 1 / Index of compliance with the signal table" SBYTE OneToOne 1 100 -128.0 127.0 FORMAT "%5.1" ECU_ADDRESS 0x5000018E /end MEASUREMENT
/begin MEASUREMENT EpmSyn_ctBackwards "Number of activations of pattern matching algorithm for backwards direction" UBYTE OneToOne 1 100 0.00 255.0 FORMAT "%5.1" ECU_ADDRESS 0x600064E7 /end MEASUREMENT
/begin MEASUREMENT EpmSyn_ctEdgeWcyOfs "offset between camshaft buffer and Calibration array for the Encoded series of camshaft segments." SBYTE OneToOne 1 100 -128.0 127.0 FORMAT "%5.1" ARRAY_SIZE 1 ECU_ADDRESS 0x600064E4 /end MEASUREMENT
/begin MEASUREMENT EpmSyn_GetAngleCnt_mp "angle clock value without offset correction" SWORD AngleCrS 1 100 -720.0000 719.9780 FORMAT "%8.4" ECU_ADDRESS 0x7000880C /end MEASUREMENT
/begin MEASUREMENT EpmSyn_numCaSSync "camshaft used for phase position detection" UBYTE OneToOne 1 100 0.00 255.0 FORMAT "%5.1" ECU_ADDRESS 0x600064E3 /end MEASUREMENT
/begin MEASUREMENT EpmSyn_phiAgClk_mp "angle clock value with offset correction" SWORD AngleCrS 1 100 -720.0000 719.9780 FORMAT "%8.4" ECU_ADDRESS 0x7000880A /end MEASUREMENT
/begin MEASUREMENT EpmSyn_phiCaSPos "angle of camshaft position after pattern matching" SWORD AngleCrS 1 100 -720.0000 719.9780 FORMAT "%8.4" ARRAY_SIZE 1 ECU_ADDRESS 0x600039BA /end MEASUREMENT
/begin MEASUREMENT EpmSyn_phiCaSPosCorrAdap "angledifference between applicated and adapted camshaftedge during synchronisation" SWORD AngleCrS 1 100 -720.0000 719.9780 FORMAT "%8.4" ARRAY_SIZE 1 ECU_ADDRESS 0x600039BC /end MEASUREMENT
/begin MEASUREMENT EpmSyn_phiDiff "difference between camshaft and crankshaft during synchronization" SWORD AngleCrS 1 100 -720.0000 719.9780 FORMAT "%8.4" ECU_ADDRESS 0x50005A50 /end MEASUREMENT
/begin MEASUREMENT EpmSyn_phiIncCor_mp "Correction value to transform the ECU-internal angle base into the physical angle base of the engine" SWORD AngleCrS 1 100 -720.0000 719.9780 FORMAT "%8.4" ECU_ADDRESS 0x70008810 /end MEASUREMENT
/begin MEASUREMENT EpmSyn_phiInt "Position of syncro interrupt" SWORD AngleCrS 1 100 -720.0000 719.9780 FORMAT "%8.4" ECU_ADDRESS 0x50005A52 /end MEASUREMENT
/begin MEASUREMENT EpmSyn_phiOffs "Synchronisation offset" SWORD AngleCrS 1 100 -720.0000 719.9780 FORMAT "%8.4" ECU_ADDRESS 0x6000E074 /end MEASUREMENT
/begin MEASUREMENT EpmSyn_phiOffsCor "correction of the synchronisation offset EpmSyn_phiOffsCor" SWORD AngleCrS 1 100 -720.0000 719.9780 FORMAT "%8.4" ECU_ADDRESS 0x50005958 /end MEASUREMENT
/begin MEASUREMENT EpmSyn_phiSetPos_mp "Absolute engine position based on cam-shaft or stop position information" SWORD AngleCrS 1 100 -720.0000 719.9780 FORMAT "%8.4" ECU_ADDRESS 0x7000880E /end MEASUREMENT
/begin MEASUREMENT EpmSyn_stCaSEval "state of camshaft evaluation" UBYTE EpmSyn_stCaSEvalComp 1 100 0.00 4.00000000000 FORMAT "%13.11" ECU_ADDRESS 0x50005D28 /end MEASUREMENT
/begin MEASUREMENT EpmSyn_stCaSPos "state of camshaft position" UBYTE EpmSyn_stCaSPosComp 1 100 0.00 20.0000000000 FORMAT "%13.10" ARRAY_SIZE 1 ECU_ADDRESS 0x600064E2 /end MEASUREMENT
/begin MEASUREMENT EpmSyn_stCaSPosReset "Camshaft evaluation is resetted" UBYTE OneToOne 1 100 0.00 255.0 FORMAT "%5.1" ARRAY_SIZE 1 ECU_ADDRESS 0x600064E6 /end MEASUREMENT
/begin MEASUREMENT EpmSyn_stCaSPosValid "EpmSyn_stCaSPos is valid" UBYTE OneToOne 1 100 0.00 255.0 FORMAT "%5.1" ARRAY_SIZE 1 ECU_ADDRESS 0x600064E1 /end MEASUREMENT
/begin MEASUREMENT EpmSyn_stCrSPos "state of crankshaft position" UBYTE EpmSyn_stCrSPos_State_t 1 100 0.00 3.00000000000 FORMAT "%13.11" ECU_ADDRESS 0x50005D81 /end MEASUREMENT
/begin MEASUREMENT EpmSyn_stCrSPosErr "error of crankshaft position" UWORD OneToOne 1 100 0.00 65535.00 FORMAT "%8.2" ECU_ADDRESS 0x600054F8 /end MEASUREMENT
/begin MEASUREMENT EpmSyn_stDiFirstGapSyncn "Status of synchronization at first Gap is disabled or not" UBYTE OneToOne 1 100 0.00 255.0 FORMAT "%5.1" ARRAY_SIZE 1 ECU_ADDRESS 0x600064E5 /end MEASUREMENT
/begin MEASUREMENT EpmSyn_stGapPos "1=use of gap position for phase verification" UBYTE OneToOne 1 100 0.00 255.0 FORMAT "%5.1" ECU_ADDRESS 0x50005D29 /end MEASUREMENT
/begin MEASUREMENT EpmSyn_stPostDrvMemd "Status variable to indicate whether the camshaft level information is to be used for synchronization during idle start" UBYTE OneToOne 1 100 0.00 255.0 BIT_MASK 0x1 FORMAT "%5.1" ECU_ADDRESS 0x600340E5 /end MEASUREMENT
/begin MEASUREMENT EpmSyn_stRR "state of reverse running detection with camshaft pattern matching" UBYTE EpmSyn_stRRComp 1 100 0.00 1.00000000000 FORMAT "%13.11" ARRAY_SIZE 1 ECU_ADDRESS 0x6000A756 /end MEASUREMENT
/begin MEASUREMENT EpmTDC_agCylCorrd "corrected TDC position" SWORD AngleCrS 1 100 -720.0000 719.9780 FORMAT "%8.4" ARRAY_SIZE 4 ECU_ADDRESS 0x50000190 /end MEASUREMENT
/begin MEASUREMENT EpmTDC_agCylCorrn "corrections (static and dynamic) of the TDCs in relation to the calibrated reference position of the TDCs (Epm_phiTdc_C)" SWORD AngleCrS 1 100 -720.0000 719.9780 FORMAT "%8.4" ARRAY_SIZE 4 ECU_ADDRESS 0x50000198 /end MEASUREMENT
/begin MEASUREMENT EpmTDC_agOffsCorrn "corrections (static and dynamic) of the TDCs in relation to the calibrated reference position of the TDCs (Epm_phiTdc_C) with influence for the acquisition of the camshaft position" SWORD AngleCrS 1 100 -720.0000 719.9780 FORMAT "%8.4" ECU_ADDRESS 0x500006E4 /end MEASUREMENT
/begin MEASUREMENT Epm_agAbsltFirstSyncn "The absolute engine position at the point of synchronization." SWORD AngleCrS 1 100 -720.0000 719.9780 FORMAT "%8.4" ECU_ADDRESS 0x60005398 /end MEASUREMENT
/begin MEASUREMENT Epm_bDnEngHiResAllw_mp "environmental conditions allow High resolution gradient calculation" UBYTE OneToOne 1 100 0.00 255.0 BIT_MASK 0x1 FORMAT "%5.1" ECU_ADDRESS 0x70008D8C /end MEASUREMENT
/begin MEASUREMENT Epm_bReSyncHiResGrd "freeze of gradient calculation after SyncIni and engine speed calculation is prevented" UBYTE OneToOne 1 100 0.00 255.0 BIT_MASK 0x1 FORMAT "%5.1" ECU_ADDRESS 0x50005D82 /end MEASUREMENT
/begin MEASUREMENT Epm_bTrans2Wait_mp "status flag to indicate transition back to WAIT state" UBYTE OneToOne 1 100 0.00 255.0 FORMAT "%5.1" ECU_ADDRESS 0x70008A72 /end MEASUREMENT
/begin MEASUREMENT Epm_ctCyl "EPM (Engine Position Management) software cylinder counter" UBYTE OneToOne 1 100 0.00 255.0 FORMAT "%5.1" ECU_ADDRESS 0x6000E418 /end MEASUREMENT
/begin MEASUREMENT Epm_ctReSync "counter of re-synchronisations" UBYTE OneToOne 1 100 0.00 255.0 FORMAT "%5.1" ECU_ADDRESS 0x600064DE /end MEASUREMENT
/begin MEASUREMENT Epm_dnEng "Enginespeed-gradient calculated over current crankshaft-segment (S0-S0 oder S1-S1)" SWORD EngNGrd 1 100 -16384.00 16383.50 FORMAT "%8.2" ECU_ADDRESS 0x70002C46 /end MEASUREMENT
/begin MEASUREMENT Epm_dnEngAvg "Engine speed gradient calculated over one working cycle" SWORD EngNGrd 1 100 -16384.00 16383.50 FORMAT "%8.2" ECU_ADDRESS 0x6000E1EC /end MEASUREMENT
/begin MEASUREMENT Epm_dnEngAvgFlt "filtered engine speed gradient averaged over one cycle" SWORD EngNGrd 1 100 -16384.00 16383.50 FORMAT "%8.2" ECU_ADDRESS 0x6000E1EE /end MEASUREMENT
/begin MEASUREMENT Epm_dnEngFlt "Filtered engine speed gradient calculated over current crankshaft-segment (S0-S0 oder S1-S1)" SWORD EngNGrd 1 100 -16384.00 16383.50 FORMAT "%8.2" ECU_ADDRESS 0x6000E1F2 /end MEASUREMENT
/begin MEASUREMENT Epm_dnEngHiRes "Engine speed gradient with resolution of 0.125 rpm per bit" SLONG RBPtCel_dn_0p125_1 1 100 -268435456.000 268435455.875 FORMAT "%13.3" ECU_ADDRESS 0x70002B28 /end MEASUREMENT
/begin MEASUREMENT Epm_Ini_stFinalInit "Final release of the EPM-Interrupts after ECU Init" UBYTE OneToOne 1 100 0.00 255.0 FORMAT "%5.1" ECU_ADDRESS 0x600064DF /end MEASUREMENT
/begin MEASUREMENT Epm_nEng "Average engine speed of one cylinder segment" SWORD EngN 1 100 -16384.00 16383.50 FORMAT "%8.2" ECU_ADDRESS 0x6000E1F6 /end MEASUREMENT
/begin MEASUREMENT Epm_nEng10ms "engine speed calculated in 10ms" SWORD EngN 1 100 -16384.00 16383.50 FORMAT "%8.2" ECU_ADDRESS 0x6000E1F8 /end MEASUREMENT
/begin MEASUREMENT Epm_nEng10msInt "engine speed calculated in 10ms" SWORD EngN 1 100 -16384.00 16383.50 FORMAT "%8.2" ECU_ADDRESS 0x70002B80 /end MEASUREMENT
/begin MEASUREMENT Epm_nEngCurr "engine speed for half cylinder segment" SWORD EngN 1 100 -16384.00 16383.50 FORMAT "%8.2" ECU_ADDRESS 0x70002C48 /end MEASUREMENT
/begin MEASUREMENT Epm_nEngDiff "Difference fo enginespeeds calculated over current crankshaft-segment (S0-S0 oder S1-S1)" SWORD EngN 1 100 -16384.00 16383.50 FORMAT "%8.2" ECU_ADDRESS 0x50005A5C /end MEASUREMENT
/begin MEASUREMENT Epm_nEngDiffAvg "Difference of enginespeeds calculated over one working cycle for the same cylinder number" SWORD EngN 1 100 -16384.00 16383.50 FORMAT "%8.2" ECU_ADDRESS 0x70002C4A /end MEASUREMENT
/begin MEASUREMENT Epm_nEngHiRes "New Engine speed calculation with resolution of 0.125 rpm per bit" SLONG RBPtCel_n_0p125_1 1 100 -268435456.000 268435455.875 FORMAT "%13.3" ECU_ADDRESS 0x50004C6C /end MEASUREMENT
/begin MEASUREMENT Epm_nEngHiResPrev_mp "calculated high-resolution speed for the preceeding segment" SLONG RBPtCel_n_0p125_1 1 100 -268435456.000 268435455.875 FORMAT "%13.3" ECU_ADDRESS 0x70008D88 /end MEASUREMENT
/begin MEASUREMENT Epm_nEngInc10ms "One tooth engine speed" SWORD EngN 1 100 -16384.00 16383.50 FORMAT "%8.2" ECU_ADDRESS 0x6000E1FA /end MEASUREMENT
/begin MEASUREMENT Epm_nEngLRes "engine speed with low resolution" UBYTE EngN_LRes 1 100 0.00 10200. FORMAT "%5.0" ECU_ADDRESS 0x6000E419 /end MEASUREMENT
/begin MEASUREMENT Epm_nEngOldS0_mp "Engine speed of last S0-Synchro" SWORD EngN 1 100 -16384.00 16383.50 FORMAT "%8.2" ECU_ADDRESS 0x70008804 /end MEASUREMENT
/begin MEASUREMENT Epm_nEngOldS1_mp "Engine speed of last S1-Synchro" SWORD EngN 1 100 -16384.00 16383.50 FORMAT "%8.2" ECU_ADDRESS 0x70008802 /end MEASUREMENT
/begin MEASUREMENT Epm_nEngRaw "Raw engine speed for OBD" SWORD EngN 1 100 -16384.00 16383.50 FORMAT "%8.2" ECU_ADDRESS 0x6000E1FC /end MEASUREMENT
/begin MEASUREMENT Epm_nEngSeg_mp "engine speed calculated with EpmSpd_GetSegNEng" SWORD EngN 1 100 -16384.00 16383.50 FORMAT "%8.2" ECU_ADDRESS 0x70008806 /end MEASUREMENT
/begin MEASUREMENT Epm_nEngTooth10ms "engine speed from 6 tooth periods, calculated all 10ms" SWORD EngN 1 100 -16384.00 16383.50 FORMAT "%8.2" ECU_ADDRESS 0x6000E1FE /end MEASUREMENT
/begin MEASUREMENT Epm_nEngVerify "Engine speed at transition to verification state: EPM_MODE_VERIFY" SWORD EngN 1 100 -16384.00 16383.50 FORMAT "%8.2" ECU_ADDRESS 0x500053F4 /end MEASUREMENT
/begin MEASUREMENT Epm_nrInctFirstSyncn "The number of crankshaft teeth from engine start till synchronization" ULONG OneToOne 1 100 0.00 4294967295.00 FORMAT "%13.2" ECU_ADDRESS 0x50004C70 /end MEASUREMENT
/begin MEASUREMENT Epm_numCyl "Actual number of cylinders" UBYTE OneToOne 1 100 0.00 255.0 FORMAT "%5.1" ECU_ADDRESS 0x70002D8A /end MEASUREMENT
/begin MEASUREMENT Epm_numValidTeeth_mp "Measurement point of number of valid CrS teeth in buffer" SWORD OneToOne 1 100 -32768.00 32767.00 FORMAT "%8.2" ECU_ADDRESS 0x70008808 /end MEASUREMENT
/begin MEASUREMENT Epm_phiAbsPrev_mp "calculated absolut position of the preceeding segment" SWORD AngleCrS 1 100 -720.0000 719.9780 FORMAT "%8.4" ECU_ADDRESS 0x70008D86 /end MEASUREMENT
/begin MEASUREMENT Epm_phiBufLenMin_mp "minimum needed segment length in CrS-buffer" SWORD AngleCrS 1 100 -720.0000 719.9780 FORMAT "%8.4" ECU_ADDRESS 0x70008D84 /end MEASUREMENT
/begin MEASUREMENT Epm_phiBufLen_mp "current available segement length in CrS-Buffer" SWORD AngleCrS 1 100 -720.0000 719.9780 FORMAT "%8.4" ECU_ADDRESS 0x70008D82 /end MEASUREMENT
/begin MEASUREMENT Epm_phiCurrPos "Synchro-current CrS angle" SWORD AngleCrS 1 100 -720.0000 719.9780 FORMAT "%8.4" ECU_ADDRESS 0x70002B82 /end MEASUREMENT
/begin MEASUREMENT Epm_phiCyl "Absolut angle of the combustion TDCs" SWORD AngleCrS 1 100 -720.0000 719.9780 FORMAT "%8.4" ARRAY_SIZE 4 ECU_ADDRESS 0x500053F6 /end MEASUREMENT
/begin MEASUREMENT Epm_phiDiffTDC "distance between two cylinders" SWORD AngleCrS 1 100 -720.0000 719.9780 FORMAT "%8.4" ECU_ADDRESS 0x60005396 /end MEASUREMENT
/begin MEASUREMENT Epm_phiIgrTeethReSync "angle equivalent for number of teeth to be ignored from the engine speed calculations after a crank error" SWORD AngleCrS 1 100 -720.0000 719.9780 FORMAT "%8.4" ECU_ADDRESS 0x500006E6 /end MEASUREMENT
/begin MEASUREMENT Epm_Reset_RSTDetected_u32 "marker for power on detected" ULONG OneToOne 1 100 0.00 4294967295.00 FORMAT "%13.2" ECU_ADDRESS 0x600340B0 /end MEASUREMENT
/begin MEASUREMENT Epm_SensTypCrS "Type of crankshaft sensor" UBYTE Epm_SensTypCrS_t 1 100 0.00 2.00000000000 FORMAT "%13.11" ECU_ADDRESS 0x6000E3AF /end MEASUREMENT
/begin MEASUREMENT Epm_stCaSNoErr_mp "Result of check for no CaS errors" UBYTE OneToOne 1 100 0.00 255.0 FORMAT "%5.1" ECU_ADDRESS 0x70008A71 /end MEASUREMENT
/begin MEASUREMENT Epm_stCmbTestReq "state for request a combustion test" UBYTE Epm_stCmbTestReq_State_t 1 100 0.00 10.0000000000 FORMAT "%13.10" ECU_ADDRESS 0x6000A755 /end MEASUREMENT
/begin MEASUREMENT Epm_stDirstaleReady "ready status of direct start" UBYTE Epm_stDirstaleReady_State_t 1 100 0.00 10.0000000000 FORMAT "%13.10" ECU_ADDRESS 0x70002D8B /end MEASUREMENT
/begin MEASUREMENT Epm_stDSMRdyOpMode "DSM init state used by the FC" UBYTE OneToOne 1 100 0.00 255.0 BIT_MASK 0x1 FORMAT "%5.1" ECU_ADDRESS 0x50005D2A /end MEASUREMENT
/begin MEASUREMENT Epm_stHiResGrdMsk_mp "state mask of the high-resolution gredient calculation" UBYTE OneToOne 1 100 0.00 255.0 FORMAT "%5.1" ECU_ADDRESS 0x70008D80 /end MEASUREMENT
/begin MEASUREMENT Epm_stOpMode "state of EPM (Engine Position Management) operation mode" UBYTE Epm_stOpMode_State_t 1 100 1.0000000000 60.0000000000 FORMAT "%13.10" ECU_ADDRESS 0x6000E41B /end MEASUREMENT
/begin MEASUREMENT Epm_stPBVarInit "Status of the PB initialisation" UBYTE OneToOne 1 100 0.00 255.0 FORMAT "%5.1" ECU_ADDRESS 0x600006E8 /end MEASUREMENT
/begin MEASUREMENT Epm_stReSync "State to indicate the SynIni ocurrance due to crank error to avoid Engine speed calculations upto calibrated number of teeth" UBYTE OneToOne 1 100 0.00 255.0 BIT_MASK 0x1 FORMAT "%5.1" ECU_ADDRESS 0x6000E41C /end MEASUREMENT
/begin MEASUREMENT Epm_stReSyncReasonInt "Reason of re-synchronisation loss of synchronisation" UBYTE Epm_stReSyncReason_State_t 1 100 0.00 17.0000000000 FORMAT "%13.10" ECU_ADDRESS 0x50005D2B /end MEASUREMENT
/begin MEASUREMENT Epm_stReSyncReason_mp "Reason of re-synchronisation / loss of synchronisation" UBYTE Epm_stReSyncReason_State_t 1 100 0.00 17.0000000000 FORMAT "%13.10" ECU_ADDRESS 0x70008A70 /end MEASUREMENT
/begin MEASUREMENT Epm_stSigModeLst_mp "measurement point for copy of HCrS state in Last 10ms raster" UBYTE OneToOne 1 100 0.00 255.0 FORMAT "%5.1" ECU_ADDRESS 0x70008A6F /end MEASUREMENT
/begin MEASUREMENT Epm_stSpd "Selection of the engine speed" UBYTE Epm_stSpd_t 1 100 0.00 4.00000000000 FORMAT "%13.11" ECU_ADDRESS 0x6000E41D /end MEASUREMENT
/begin MEASUREMENT Epm_stSupressIni "Status is set to prevent initialization of EPM-functions in case of forced synchronization loss" UBYTE default 1 100 0.00 255.0 BIT_MASK 0x1 FORMAT "%5.1" ECU_ADDRESS 0x70001BF2 /end MEASUREMENT
/begin MEASUREMENT Epm_stSync "state of synchronization" UBYTE Epm_stSync_State_t 1 100 0.00 30.0000000000 FORMAT "%13.10" ECU_ADDRESS 0x70002D8C /end MEASUREMENT
/begin MEASUREMENT Epm_tiFirstSyncn "The time taken for synchronization, i.e. time interval from the engine start to synchronization" ULONG OneToOne_ms 1 100 0.00 4294967295.00 FORMAT "%13.2" ECU_ADDRESS 0x50004C74 /end MEASUREMENT
/begin MEASUREMENT Epm_tiLockReSync_mp "Value of timer to stay in Mode EPM_MODE_LOCKRESYNC" SWORD Time_ms 1 100 -327680.0 327670.0 FORMAT "%8.1" ECU_ADDRESS 0x600039B8 /end MEASUREMENT
/begin MEASUREMENT Epm_tiSegNTEETH_mp "Measurement point of segment time for angle NTEETH (6) teeth" SLONG OneToOne_us 1 100 -2147483648.00 2147483647.00 FORMAT "%13.2" ECU_ADDRESS 0x70008648 /end MEASUREMENT
/begin MEASUREMENT Epm_tiSegOfs_mp "calculated duration betwenn angular center points of two associated high-resolution speed segments" SLONG RBPtCel_ti_50p0_1 1 100 -107374182400. 107374182350. FORMAT "%13.0" ECU_ADDRESS 0x70008D7C /end MEASUREMENT
/begin MEASUREMENT Epm_tiSegONETOOTH_mp "Measurement point of segment time for single CrS tooth" SLONG OneToOne_us 1 100 -2147483648.00 2147483647.00 FORMAT "%13.2" ECU_ADDRESS 0x70008644 /end MEASUREMENT
/begin MEASUREMENT Epm_tiSegPARTSEG_mp "Measurement point of segment time for a cylinder segment: PARTSEG" SLONG OneToOne_us 1 100 -2147483648.00 2147483647.00 FORMAT "%13.2" ECU_ADDRESS 0x70008640 /end MEASUREMENT
/begin MEASUREMENT Epm_tiSegPrev_mp "calculated duration for the preceeding segment" SLONG RBPtCel_ti_50p0_1 1 100 -107374182400. 107374182350. FORMAT "%13.0" ECU_ADDRESS 0x70008D78 /end MEASUREMENT
/begin MEASUREMENT Epm_tiSegRaw_mp "raw value segment time of one CrS revolution for OBD" SLONG OneToOne_us 1 100 -2147483648.00 2147483647.00 FORMAT "%13.2" ECU_ADDRESS 0x7000863C /end MEASUREMENT
/begin MEASUREMENT Epm_tiSpd2Zero "Timeout timer until engine speed will set to zero" UWORD Time_ms 1 100 0.00 655350.0 FORMAT "%8.1" ECU_ADDRESS 0x600039B6 /end MEASUREMENT
/begin MEASUREMENT ESC_agSyncPreActvn "Angle position at activation of SyncPre task" SWORD AngleCrS 1 100 -720.0000 719.9780 FORMAT "%8.4" ECU_ADDRESS 0x600039B4 /end MEASUREMENT
/begin MEASUREMENT ESC_cntStrtSyncPre "Counter for the to be activated OS_BswStart_SyncPre tasks to control the multiple activation of syncpre tasks" UBYTE OneToOne 1 100 0.00 255.0 FORMAT "%5.1" ECU_ADDRESS 0x50005D62 /end MEASUREMENT
/begin MEASUREMENT ESC_dataMaxTskLoadS0Envram "Lifetime Maximum task loading of Sync S0 task chain in" ULONG Prc_q0p01_COMPU 1 100 0.00 42949672.9500 FORMAT "%13.4" ECU_ADDRESS 0x600365DC /end MEASUREMENT
/begin MEASUREMENT ESC_dataMaxTskLoadS1Envram "Lifetime maximum task loading of Sync S1 task chain in" ULONG Prc_q0p01_COMPU 1 100 0.00 42949672.9500 FORMAT "%13.4" ECU_ADDRESS 0x600365D8 /end MEASUREMENT
/begin MEASUREMENT ESC_dataSyncS0MaxTskLoad "Maximum task load of Sync S0 task chain in" UWORD Prc_q0p01_COMPU 1 100 0.00 655.3500 FORMAT "%8.4" ECU_ADDRESS 0x600039B2 /end MEASUREMENT
/begin MEASUREMENT ESC_dataSyncS0TskLoad "Task loading of SyncS0 task chain" UWORD Prc_q0p01_COMPU 1 100 0.00 655.3500 FORMAT "%8.4" ECU_ADDRESS 0x600039B0 /end MEASUREMENT
/begin MEASUREMENT ESC_dataSyncS1MaxTskLoad "Maximum task load of Sync S1 task chain in" UWORD Prc_q0p01_COMPU 1 100 0.00 655.3500 FORMAT "%8.4" ECU_ADDRESS 0x600039AE /end MEASUREMENT
/begin MEASUREMENT ESC_dataSyncS1TskLoad "Task loading of SyncS1 task chain" UWORD Prc_q0p01_COMPU 1 100 0.00 655.3500 FORMAT "%8.4" ECU_ADDRESS 0x600039AC /end MEASUREMENT
/begin MEASUREMENT ESC_stActivateSyncPre "Status of activation of SyncPre task" SBYTE OneToOne 1 100 -128.0 127.0 FORMAT "%5.1" ECU_ADDRESS 0x70002D71 /end MEASUREMENT
/begin MEASUREMENT ESC_stActnSyncPre "Status to activate of SyncPre task" UBYTE OneToOne 1 100 0.00 255.0 BIT_MASK 0x1 FORMAT "%5.1" ECU_ADDRESS 0x50005D63 /end MEASUREMENT
/begin MEASUREMENT ESC_stFrstSyncPreTsk "Status flag to indicate first SyncPre task after synchronizationresynchronization" UBYTE OneToOne 1 100 0.00 255.0 BIT_MASK 0x1 FORMAT "%5.1" ECU_ADDRESS 0x50000848 /end MEASUREMENT
/begin MEASUREMENT ESC_stmnSyncPre "Synchro chain state machine for ESC" UBYTE OneToOne 1 100 0.00 255.0 FORMAT "%5.1" ECU_ADDRESS 0x70002D73 /end MEASUREMENT
/begin MEASUREMENT ESC_stStackErr "Sampling time stack overflow or underflow error status" UBYTE OneToOne 1 100 0.00 255.0 BIT_MASK 0x1 FORMAT "%5.1" ECU_ADDRESS 0x600064DD /end MEASUREMENT
/begin MEASUREMENT ESC_tiLftiMaxRtS0Envram "Lifetime max runtime of Sync S0 task" ULONG OneToOne_us 1 100 0.00 4294967295.00 FORMAT "%13.2" ECU_ADDRESS 0x600365D4 /end MEASUREMENT
/begin MEASUREMENT ESC_tiLftiMaxRtS1Envram "Lifetime max runtime of Sync S1 task" ULONG OneToOne_us 1 100 0.00 4294967295.00 FORMAT "%13.2" ECU_ADDRESS 0x600365D0 /end MEASUREMENT
/begin MEASUREMENT ESC_tiSampleSyncPreTsk "Sampling time calculated for SyncPre task" ULONG OneToOne_us 1 100 0.00 4294967295.00 FORMAT "%13.2" ECU_ADDRESS 0x70001A00 /end MEASUREMENT
/begin MEASUREMENT ESC_tiSyncPreDiff "Difference in time between configured position of current and last SyncPre task" SLONG OneToOne_us 1 100 -2147483648.00 2147483647.00 FORMAT "%13.2" ECU_ADDRESS 0x6000145C /end MEASUREMENT
/begin MEASUREMENT ESC_tiSyncPreTrigLtcy "Latency for trigger of SyncPre task" SLONG OneToOne_us 1 100 -2147483648.00 2147483647.00 FORMAT "%13.2" ECU_ADDRESS 0x60001458 /end MEASUREMENT
/begin MEASUREMENT ESC_tiSyncPreTskStrt "Start time of SyncPre task in us" ULONG OneToOne_us 1 100 0.00 4294967295.00 FORMAT "%13.2" ECU_ADDRESS 0x50000150 /end MEASUREMENT
/begin MEASUREMENT ESC_tiSyncS0TskRt "Total runtime of SyncS0 task chain" ULONG OneToOne_us 1 100 0.00 4294967295.00 FORMAT "%13.2" ECU_ADDRESS 0x60001454 /end MEASUREMENT
/begin MEASUREMENT ESC_tiSyncS0TskRtMax "Maximum of all recorded runtime of SyncS0 task chain" ULONG OneToOne_us 1 100 0.00 4294967295.00 FORMAT "%13.2" ECU_ADDRESS 0x60001450 /end MEASUREMENT
/begin MEASUREMENT ESC_tiSyncS1TskRt "Total runtime of SyncS1 task chain" ULONG OneToOne_us 1 100 0.00 4294967295.00 FORMAT "%13.2" ECU_ADDRESS 0x6000144C /end MEASUREMENT
/begin MEASUREMENT ESC_tiSyncS1TskRtMax "Maximum of all recorded runtime of SyncS1 task chain" ULONG OneToOne_us 1 100 0.00 4294967295.00 FORMAT "%13.2" ECU_ADDRESS 0x60001448 /end MEASUREMENT
/begin MEASUREMENT ESNSAD_tEng "Engine temperature" UBYTE temp_ub_q0p75_o48 1 100 -48.0 143.3 FORMAT "%5.1" ECU_ADDRESS 0x6000E39E /end MEASUREMENT
/begin MEASUREMENT fgru_msg "factor: basic pilot control" UBYTE fak_ub_b2 1 100 0.00 1.992188 FORMAT "%8.6" ECU_ADDRESS 0x6000E44A /end MEASUREMENT
/begin MEASUREMENT flimit_w "Limit for afterstart adaptation factor" UWORD fak_uw_b2 1 100 0.00 1.999969 FORMAT "%8.6" ECU_ADDRESS 0x6000D9BA /end MEASUREMENT
/begin MEASUREMENT flimuebw_w "Limit afterstart adaptation factor" UWORD fak_uw_b2 1 100 0.00 1.999969 FORMAT "%8.6" ECU_ADDRESS 0x6000D9BC /end MEASUREMENT
/begin MEASUREMENT fnsadi_w "Factor afterstart adaptation integrator part" SWORD fak_sw_b1 1 100 -1.000000 0.999969 FORMAT "%8.6" ECU_ADDRESS 0x6000047E /end MEASUREMENT
/begin MEASUREMENT fnsadlim_w "Limiter for factor afterstart adaptation" UWORD fak_uw_b2 1 100 0.00 1.999969 FORMAT "%8.6" ECU_ADDRESS 0x600039AA /end MEASUREMENT
/begin MEASUREMENT fnsadp_w "Factor afterstart adaptation proportional part" UWORD fak_uw_b2 1 100 0.00 1.999969 FORMAT "%8.6" ECU_ADDRESS 0x60000480 /end MEASUREMENT
/begin MEASUREMENT fnsad_w_msg "Factor afterstart adaptation" UWORD fak_uw_b2 1 100 0.00 1.999969 FORMAT "%8.6" ECU_ADDRESS 0x500007D4 /end MEASUREMENT
/begin MEASUREMENT lutsnorm_w "Standardized engine roughness" SWORD lu_MEx 1 100 -232.8306 232.8235 FORMAT "%8.4" ECU_ADDRESS 0x500006A6 /end MEASUREMENT
/begin MEASUREMENT rkakapb_w_msg "Additive factor, relative fuel mass for application" SWORD rel_q0p09375 1 100 -24.00000 24.00000 FORMAT "%8.5" ECU_ADDRESS 0x60004DD0 /end MEASUREMENT
/begin MEASUREMENT sdlutsol_w_msg "Desired value standard deviation engine roughness" SWORD lu_MEx 1 100 -232.8306 232.8235 FORMAT "%8.4" ECU_ADDRESS 0x50000834 /end MEASUREMENT
/begin MEASUREMENT sdluts_w_msg "Standard deviation engine roughness" SWORD lu_MEx 1 100 -232.8306 232.8235 FORMAT "%8.4" ECU_ADDRESS 0x70001D08 /end MEASUREMENT
/begin MEASUREMENT tmotnsad "engine temperature used in ESNSAD" UBYTE temp_ub_q0p75_o48 1 100 -48.0 143.3 FORMAT "%5.1" ECU_ADDRESS 0x600064DB /end MEASUREMENT
/begin MEASUREMENT tmsdluts "engine temperature at start used in ESDSDLUT" UBYTE temp_ub_q0p75_o48 1 100 -48.0 143.3 FORMAT "%5.1" ECU_ADDRESS 0x600064DC /end MEASUREMENT
/begin FUNCTION EpmCrS_Plaus "101.11.0  dynamic plausibility of crankshaft-signal"
 /begin DEF_CHARACTERISTIC EpmCrS_facGapCrit1_C EpmCrS_facGapCrit2_C EpmCrS_facGapPlausHigh_CA EpmCrS_facIncPlausHigh_CA EpmCrS_facIncPlausLow_CA EpmCrS_nMaxInc_C EpmCrS_nThreshRange_CA EpmCrS_nTiIncPerAvrg_CA EpmCrS_numAgClkDeltaCrsvMax_C EpmCrS_numIgnInc_C EpmCrS_numIncTiAvrgPlaus_C EpmCrS_numTiIncPerAvrg_CA EpmCrS_phiAgClkDeltaMax_C EpmCrS_stClrCntReSyncAgClkDeltaTot_C EpmCrS_swtSnsrTyp_C EpmCrS_tiGlitchFilterActv_CA EpmCrS_tiGlitchFilterInActv_CA EpmCrS_tiIgnSig_C /end DEF_CHARACTERISTIC
 /begin IN_MEASUREMENT BattU_u EpmCrS_phiAgClk EpmCrS_phiInc EpmCrS_stRotDir EpmCrS_stSigMode EpmHCrS_stSigMode Epm_nEng Epm_stOpMode /end IN_MEASUREMENT
 /begin OUT_MEASUREMENT EpmCrS_numTiIncPerAvrg EpmCrS_phiIgnInc EpmCrS_stHiEngSpd EpmCrS_swtSnsrTyp EpmCrS_tiIncPer /end OUT_MEASUREMENT
 /begin LOC_MEASUREMENT EpmCrS_ctAgClkDeltaCrsv_mp EpmCrS_ctRange EpmCrS_ctReSyncAgClkDeltaTot EpmCrS_ctReSyncAgClkDeltaTot_mp EpmCrS_ctReSyncAgClkDelta_mp EpmCrS_numTiIncPerAvrg_mp EpmCrS_phiAgClkDelta_mp EpmCrS_stEnaAgClkPlausChk /end LOC_MEASUREMENT
 FUNCTION_VERSION "101.11.0" /end FUNCTION
/begin FUNCTION EpmCrS_RevCnt "101.4.3   calculation of the crankshaft-revolutioncounter"
 /begin IN_MEASUREMENT CoEng_stMai EpmCrS_numSeg EpmCrS_stSigMode EpmSeq_numInt Epm_nEng Epm_stOpMode Epm_stSync /end IN_MEASUREMENT
 /begin OUT_MEASUREMENT EpmCrS_ctRevIni EpmCrS_ctRevStrt EpmCrS_ctRevStrtExtd /end OUT_MEASUREMENT
 /begin LOC_MEASUREMENT EpmCrS_ctRevCnt /end LOC_MEASUREMENT
 FUNCTION_VERSION "101.4.3" /end FUNCTION
/begin FUNCTION EpmCrS_Seg "101.17.0  calculation of crankshaft-segmenttimes" /begin DEF_CHARACTERISTIC EpmCrS_stTTMeasure_C EpmCrS_swtMeasActvnS1_C /end DEF_CHARACTERISTIC /begin REF_CHARACTERISTIC EpmSeq_phiInt_CA EpmSeq_swtInt_C /end REF_CHARACTERISTIC
 /begin IN_MEASUREMENT EpmHCrS_ctGapRef EpmHCrS_numIncGap_Var EpmHCrS_stRotDir EpmHCrS_stSigMode EpmHCrS_tiPerTn EpmHCrS_tiPerTn_1 EpmSeq_eveId EpmSeq_numInt EpmSeq_tiEve EpmSyn_phiInt Epm_ctCyl Epm_numCyl Epm_stOpMode Epm_stSupressIni /end IN_MEASUREMENT
 /begin OUT_MEASUREMENT EpmCrS_ctInc EpmCrS_numIncPerSeg EpmCrS_numSeg EpmCrS_phiAgClk EpmCrS_phiInc EpmCrS_phiIntSeg EpmCrS_phiSeg EpmCrS_phiSegHiRes EpmCrS_stRotDir EpmCrS_stSigMode EpmCrS_tiSeg EpmCrS_tiSegCurr EpmCrS_tiSegHiRes /end OUT_MEASUREMENT
 /begin LOC_MEASUREMENT EpmCrS_idxBuf_mp EpmCrS_numNewInc_mp EpmCrS_tiInc_mp /end LOC_MEASUREMENT
 FUNCTION_VERSION "101.17.0" /end FUNCTION
/begin FUNCTION EpmErr_Trace "101.3.1   Error Tracing"
 /begin LOC_MEASUREMENT EpmErr_ctErrInfoAryFree EpmErr_TraceCoreId EpmErr_TraceErrClass EpmErr_TraceErrId EpmErr_TraceErrInfo1 EpmErr_TraceErrInfo2 EpmErr_TraceErrInfo3 EpmErr_TraceErrInfo4 EpmErr_TraceErrorReaction EpmErr_TraceModId EpmErr_TraceStatus EpmErr_TraceTimeStamp Epm_Reset_RSTDetected_u32 /end LOC_MEASUREMENT
 FUNCTION_VERSION "101.3.1" /end FUNCTION
/begin FUNCTION EpmHAgClk_Gen "101.25.0  Controls the Digital Phase Locked Loop (DPLL) and generates the Angle Clock for the System" /begin DEF_CHARACTERISTIC EpmHAgClk_numAddTick_CA /end DEF_CHARACTERISTIC
 /begin IN_MEASUREMENT EpmCaS_numPriCamShft EpmHCrS_agActvEdge EpmHCrS_ctIncStrt EpmHCrS_ctRealGapPos EpmHCrS_numGapWcy EpmHCrS_numGap_Var EpmHCrS_numIncGapMiss EpmHCrS_numIncGap_Var EpmHCrS_numIncReal EpmHCrS_numIncRealWcy EpmHCrS_numInc_Var EpmHCrS_stActEdge EpmHCrS_stGapSubState EpmHCrS_stOneAftGap EpmHCrS_stRotDir EpmHCrS_tiActv2ActvEdge Epm_SensTypCrS /end IN_MEASUREMENT
 /begin OUT_MEASUREMENT EpmHAgClk_numAgTicksPerInc EpmHAgClk_tiIncPerBas EpmHAgClk_tiMinPer /end OUT_MEASUREMENT
 /begin LOC_MEASUREMENT EpmHAgClk_AddTick EpmHAgClk_Gen_AgCntRaw_mp EpmHAgClk_Gen_AgCnt_mp EpmHAgClk_numAgClkFrq EpmHAgClk_numAgClkMode EpmHAgClk_numAgClkState EpmHAgClk_numMissTick EpmHAgClk_stAPTSyn /end LOC_MEASUREMENT
 FUNCTION_VERSION "101.25.0" /end FUNCTION
/begin FUNCTION EpmHAgClk_TrigEve "101.2.3   Handles the Triggering of Events for the system based on the Angle clock" /begin LOC_MEASUREMENT EpmHAgClk_agPosnTrigEve /end LOC_MEASUREMENT FUNCTION_VERSION "101.2.3" /end FUNCTION
/begin FUNCTION EpmHCaS_auto "" /end FUNCTION
/begin FUNCTION EpmHCaS_SigBuf "101.9.5   signal buffer of camshaft" /begin IN_MEASUREMENT EpmCaS_numSegSerLst /end IN_MEASUREMENT
 /begin OUT_MEASUREMENT EpmHCaS_DataI1.agFallEdgeCorrn EpmHCaS_DataI1.agRisngEdgeCorrn EpmHCaS_DataI1.ctEdge EpmHCaS_DataI1.tiGlitch EpmHCaS_DataI1.tiDiffEdge EpmHCaS_DataI1.tiDiffLstEdge EpmHCaS_DataI1.tiStampEdge EpmHCaS_DataI1.agDiffEdge EpmHCaS_DataI1.agDiffLstEdge EpmHCaS_DataI1.agEdgeAbslt EpmHCaS_DataI1.agEdgeCorrn EpmHCaS_DataI1.agEdgeRel EpmHCaS_DataI1.agPhaShiftRel EpmHCaS_DataI1.agRefPosCorrd EpmHCaS_DataI1.ctBufIdx EpmHCaS_DataI1.ctValidEdge EpmHCaS_DataI1.ctValidTime EpmHCaS_DataI1.numBufUsed EpmHCaS_DataI1.numLstEdgeAbslt EpmHCaS_DataI1.numLstEdgeWcy EpmHCaS_DataI1.numEdgeAbslt EpmHCaS_DataI1.numEdgeWcy EpmHCaS_DataI1.stCurLev EpmHCaS_DataI1.stLevBeforeEdge EpmHCaS_DataI1.stSig /end OUT_MEASUREMENT
 FUNCTION_VERSION "101.9.5" /end FUNCTION
/begin FUNCTION EpmHCaS_SigEval "101.16.5  Camshaft Signal Evaluation" /begin REF_CHARACTERISTIC EpmCaS_stActEdge_C EpmCaS_tiGlitchFilter_C /end REF_CHARACTERISTIC
 /begin IN_MEASUREMENT EpmBCr_ctEdgeRefTabIdx EpmBCr_phiNxtCaSEdge EpmBCr_stPos EpmCaS_agCorrnStat EpmCaS_numPriCamShft EpmCaS_numSegSerLst EpmCaS_phiAdapRefPos EpmCaS_phiDiffCal2AdapEqAvg EpmCaS_stSnsrDeActvn EpmHCaS_DataI1.agFallEdgeCorrn EpmHCaS_DataI1.agRisngEdgeCorrn EpmHCaS_DataI1.ctEdge EpmHCaS_DataI1.tiGlitch EpmHCaS_DataI1.tiDiffEdge EpmHCaS_DataI1.tiDiffLstEdge EpmHCaS_DataI1.tiStampEdge EpmHCaS_DataI1.agDiffEdge EpmHCaS_DataI1.agDiffLstEdge EpmHCaS_DataI1.agEdgeAbslt EpmHCaS_DataI1.agEdgeCorrn EpmHCaS_DataI1.agEdgeRel EpmHCaS_DataI1.agPhaShiftRel EpmHCaS_DataI1.agRefPosCorrd EpmHCaS_DataI1.ctBufIdx EpmHCaS_DataI1.ctValidEdge EpmHCaS_DataI1.ctValidTime EpmHCaS_DataI1.numBufUsed EpmHCaS_DataI1.numLstEdgeAbslt EpmHCaS_DataI1.numLstEdgeWcy EpmHCaS_DataI1.numEdgeAbslt EpmHCaS_DataI1.numEdgeWcy EpmHCaS_DataI1.stCurLev EpmHCaS_DataI1.stLevBeforeEdge EpmHCaS_DataI1.stSig EpmHCrS_stTwoAftGap EpmSyn_ctEdgeWcyOfs EpmSyn_phiOffsCor EpmSyn_stCaSPosValid Epm_stSync /end IN_MEASUREMENT
 /begin OUT_MEASUREMENT EpmHCaS_ctEdgeCaSI1 EpmHCaS_stCaSSig /end OUT_MEASUREMENT
 FUNCTION_VERSION "101.16.5" /end FUNCTION
/begin FUNCTION EpmHCrS_DirEvln "101.16.0  Evaluation of Rotation Direction Information from Engine Speed Sensor"
 /begin IN_MEASUREMENT EpmCrS_swtSnsrTyp EpmHCrS_stPlsMod EpmHCrS_tiActv2PasEdge Epm_SensTypCrS /end IN_MEASUREMENT
 /begin OUT_MEASUREMENT EpmHCrS_stDirChg EpmHCrS_stDirEvln EpmHCrS_stRotDir EpmHCrS_stRotDirRaw EpmHCrS_swtDirInfoOn /end OUT_MEASUREMENT
 /begin LOC_MEASUREMENT EpmHCrS_swtDirChgRawOld EpmHCrS_swtDirChgRawOld2 EpmHCrS_swtEnaDirPlaus /end LOC_MEASUREMENT
 FUNCTION_VERSION "101.16.0" /end FUNCTION
/begin FUNCTION EpmHCrS_DynPlaus "101.13.2  Dynamical Plausibility Check of Crankshaft Increment Duration" /begin DEF_CHARACTERISTIC EpmHCrS_tiToutEngStop_C /end DEF_CHARACTERISTIC
 /begin IN_MEASUREMENT EpmHCrS_stEdgeISRActv EpmHCrS_stRotDir EpmHCrS_stSigErr EpmHCrS_tiActvEdge Epm_stOpMode /end IN_MEASUREMENT
 /begin OUT_MEASUREMENT EpmHCrS_facGapPlausHigh EpmHCrS_facIncPlausHigh EpmHCrS_facIncPlausLow /end OUT_MEASUREMENT
 /begin LOC_MEASUREMENT EpmHCrS_facPlausHigh EpmHCrS_facPlausHighOld EpmHCrS_facPVTOld EpmHCrS_swtEdgeOcc EpmHCrS_swtGapTout EpmHCrS_swtNoPVTDly EpmHCrS_swtToutActv EpmHCrS_tiToutEngStop /end LOC_MEASUREMENT
 FUNCTION_VERSION "101.13.2" /end FUNCTION
/begin FUNCTION EpmHCrS_InctCntr "101.13.0  Calculation of Counter Values for Crankshaft Increments"
 /begin IN_MEASUREMENT EpmHCrS_numGap_Var EpmHCrS_numIncGap2Gap_Var EpmHCrS_numIncGap_Var EpmHCrS_numInc_Var EpmHCrS_stRotDir EpmHCrS_stRotDirRaw Strt_stStaActv /end IN_MEASUREMENT
 /begin OUT_MEASUREMENT EpmHCrS_cntrInctDcyc EpmHCrS_cntrInctDcycOld EpmHCrS_ctAPTPos EpmHCrS_ctDebEdge EpmHCrS_ctGapDetn EpmHCrS_ctGapPos EpmHCrS_ctGapRef EpmHCrS_ctIncGap EpmHCrS_ctIncPos EpmHCrS_ctIncRvs EpmHCrS_ctIncStrt EpmHCrS_ctIncStrtOld EpmHCrS_ctRealGapPos EpmHCrS_ctSynInc EpmHCrS_numGapWcy EpmHCrS_numIncGap2GapMax EpmHCrS_numIncGapMiss EpmHCrS_numIncReal EpmHCrS_numIncRealWcy EpmHCrS_numIncRealWcyLast EpmHCrS_numIncWcy EpmHCrS_stEngStrt EpmHCrS_stSymGap /end OUT_MEASUREMENT
 /begin LOC_MEASUREMENT EpmHCrS_ctAPTDiff EpmHCrS_ctIncGapDly EpmHCrS_ctOffsPos2Strt EpmHCrS_ctOffsRel2APT EpmHCrS_ctOffsRel2Strt EpmHCrS_ctPosAry EpmHCrS_ctRel EpmHCrS_ctSynGapPos EpmHCrS_swtGapShft /end LOC_MEASUREMENT
 FUNCTION_VERSION "101.13.0" /end FUNCTION
/begin FUNCTION EpmHCrS_Interface "101.15.0  Interface for EpmHCrS"
 /begin DEF_CHARACTERISTIC EpmHCrS_phiThdFBC_C EpmHCrS_phiThdHi_C EpmHCrS_phiThdRaw_C EpmHCrS_phiThd_C /end DEF_CHARACTERISTIC
 /begin IN_MEASUREMENT EpmBCr_tiIncPer EpmCrS_numTiIncPerAvrg EpmHAgClk_tiMinPer EpmHCrS_cntrErr EpmHCrS_cntrErrSum EpmHCrS_facGapCrit1 EpmHCrS_facGapCrit2 EpmHCrS_facGapPlausHigh EpmHCrS_facIncPlausHigh EpmHCrS_facIncPlausLow EpmHCrS_numDebInc EpmHCrS_numInc_Var EpmHCrS_stRotDir EpmHCrS_stSigMode EpmHCrS_tiIgnSig EpmHCrS_tiPerTn EpmSyn_phiOffs EpmSyn_phiOffsCor /end IN_MEASUREMENT
 /begin OUT_MEASUREMENT EpmHCrS_ctIncEngPos EpmHCrS_stSigErr /end OUT_MEASUREMENT
 /begin LOC_MEASUREMENT EpmHCrS_ctResyncUpperLvl /end LOC_MEASUREMENT
 FUNCTION_VERSION "101.15.0" /end FUNCTION
/begin FUNCTION EpmHCrS_IntHndlr "101.22.0  Interrupt Service Routine Coordinator of the Crank Shaft Driver"
 /begin DEF_CHARACTERISTIC EpmHCrS_tiEvlnOffsActv_C EpmHCrS_tiSyncIniTout_C EpmHCrS_tiSyncIniWait_C /end DEF_CHARACTERISTIC
 /begin IN_MEASUREMENT EpmCrS_stHiEngSpd EpmCrS_swtSnsrTyp EpmHCrS_ctGapRef EpmHCrS_ctIncStrt EpmHCrS_facIncPlausLow EpmHCrS_stActEdge EpmHCrS_stFirstValTooth EpmHCrS_stReqDrvrRstrt EpmHCrS_stSigMode EpmHCrS_swtDirInfoOn EpmHCrS_tiActvEdge Epm_SensTypCrS Epm_stOpMode /end IN_MEASUREMENT
 /begin OUT_MEASUREMENT EpmHCrS_cntrDrvErrRst EpmHCrS_cntrEdge EpmHCrS_cntrErr EpmHCrS_cntrErrRst EpmHCrS_cntrErrSum EpmHCrS_ctEdgeStrt EpmHCrS_stEdgeISRActv EpmHCrS_stPlsMod EpmHCrS_stStrtSigMode EpmHCrS_swtCntrPosRst EpmHCrS_swtIntrptSetUp EpmHCrS_tiLstEdge /end OUT_MEASUREMENT
 /begin LOC_MEASUREMENT EpmHCrS_ctIncActivate EpmHCrS_stMainIntrptEdge EpmHCrS_stReqDrvRst EpmHCrS_stTmrActv EpmHCrS_tiTmrStrt /end LOC_MEASUREMENT
 FUNCTION_VERSION "101.22.0" /end FUNCTION
/begin FUNCTION EpmHCrS_Sampling "1.13.0    Capturing of Time and Angle Stamps of Active Edges of Crankshaft Signal"
 /begin IN_MEASUREMENT EpmHCrS_tiFilDlyActvEdge EpmHCrS_tiFilDlyInActvEdge Epm_SensTypCrS /end IN_MEASUREMENT
 /begin OUT_MEASUREMENT EpmHCrS_agActvEdge EpmHCrS_tiActv2ActvEdge EpmHCrS_tiActv2PasEdge EpmHCrS_tiActvEdge EpmHCrS_tiPasEdge /end OUT_MEASUREMENT
 /begin LOC_MEASUREMENT EpmHCrS_stRdGTMReg EpmHCrS_tiLstActvEdge EpmHCrS_tiStampExt /end LOC_MEASUREMENT
 FUNCTION_VERSION "1.13.0" /end FUNCTION
/begin FUNCTION EpmHCrS_SigBuf "101.37.0  signalbuffer crankshaft" /begin DEF_CHARACTERISTIC EpmHCrS_phiThdPer_C /end DEF_CHARACTERISTIC
 /begin IN_MEASUREMENT EpmHCrS_agActvEdge EpmHCrS_ctAPTPos EpmHCrS_ctGapPos EpmHCrS_ctGapRef EpmHCrS_ctIncStrt EpmHCrS_numGap_Var EpmHCrS_numIncGapMiss EpmHCrS_numIncGap_Var EpmHCrS_numIncWcy EpmHCrS_stDirEvln EpmHCrS_stRotDir EpmHCrS_stSigMode EpmHCrS_tiActv2ActvEdge EpmHCrS_tiActvEdge EpmHCrS_tiPasEdge EpmSeq_tiEve Epm_SensTypCrS /end IN_MEASUREMENT
 /begin LOC_MEASUREMENT EpmHCrS_cntrInct EpmHCrS_stBufFillUpd EpmHCrS_stBufGapCor /end LOC_MEASUREMENT
 FUNCTION_VERSION "101.37.0" /end FUNCTION
/begin FUNCTION EpmHCrS_SigEval_auto "" /end FUNCTION
/begin FUNCTION EpmHCrS_StMac "101.26.0  State machine of Crankshaft signal evaluation" /begin DEF_CHARACTERISTIC EpmHCrS_nGapVldn_C /end DEF_CHARACTERISTIC /begin REF_CHARACTERISTIC EpmHCrS_tiSyncIniTout_C EpmHCrS_tiSyncIniWait_C /end REF_CHARACTERISTIC
 /begin IN_MEASUREMENT EpmCrS_swtSnsrTyp EpmHCrS_ctAPTPos EpmHCrS_ctDebEdge EpmHCrS_ctGapDetn EpmHCrS_ctGapRef EpmHCrS_ctIncStrt EpmHCrS_numIncGap2GapMax EpmHCrS_numIncGap_Var EpmHCrS_stRotDir EpmHCrS_stSymGap EpmHCrS_tiActv2ActvEdge Epm_SensTypCrS Epm_stSync /end IN_MEASUREMENT
 /begin OUT_MEASUREMENT EpmHCrS_facGapCrit1 EpmHCrS_facGapCrit2 EpmHCrS_numDebInc EpmHCrS_stFirstValTooth EpmHCrS_stGapSubState EpmHCrS_stOneAftGap EpmHCrS_stReqDrvrRstrt EpmHCrS_stSigMode EpmHCrS_stTwoAftGap EpmHCrS_tiIgnSig EpmHCrS_tiPerTn EpmHCrS_tiPerTn_1 EpmHCrS_tiPerTn_2 /end OUT_MEASUREMENT
 /begin LOC_MEASUREMENT EpmHCrS_stDisblNewSync EpmHCrS_stSyncIniExe EpmHCrS_tiPerTnACC /end LOC_MEASUREMENT
 FUNCTION_VERSION "101.26.0" /end FUNCTION
/begin FUNCTION EpmHwE_Fil "1.5.3     Debounce Filter for Signal Edges of Crankshaft and Camshaft Sensor" /begin IN_MEASUREMENT EpmHCrS_stActEdge /end IN_MEASUREMENT /begin OUT_MEASUREMENT EpmHCrS_tiFilDlyActvEdge EpmHCrS_tiFilDlyInActvEdge /end OUT_MEASUREMENT FUNCTION_VERSION "1.5.3" /end FUNCTION
/begin FUNCTION EpmHwe_Ini "101.15.0  Hardware encapsulation init" /begin IN_MEASUREMENT Epm_SensTypCrS /end IN_MEASUREMENT /begin LOC_MEASUREMENT EpmHwE_DMARam /end LOC_MEASUREMENT FUNCTION_VERSION "101.15.0" /end FUNCTION
/begin FUNCTION EpmHwe_Srv "101.4.6   Service Library" /begin IN_MEASUREMENT EpmBCr_tiIncPer /end IN_MEASUREMENT FUNCTION_VERSION "101.4.6" /end FUNCTION
/begin FUNCTION EpmIf_Imprt "1.2.0     Epm Interface Import" /begin IN_MEASUREMENT EngDa_tEng Oil_tSwmp /end IN_MEASUREMENT /begin OUT_MEASUREMENT EpmIf_tCoolant EpmIf_tOil /end OUT_MEASUREMENT /begin LOC_MEASUREMENT EpmIf_RngMod_trqMax /end LOC_MEASUREMENT FUNCTION_VERSION "1.2.0" /end FUNCTION
/begin FUNCTION EpmRRS_AgDetect "101.15.2  Engine Position Management Reverse Rotation and Stop Angle Detection"
 /begin DEF_CHARACTERISTIC EpmRRS_EnaIgnInj_CW EpmRRS_nEngMaxCaS_C EpmRRS_nEngMax_C EpmRRS_phiUndef_C EpmRRS_tiMaxToothTime_C EpmRRS_tiTemp_CUR EpmRRS_vVehMax_C /end DEF_CHARACTERISTIC
 /begin REF_CHARACTERISTIC Epm_phiGap2Zero_C /end REF_CHARACTERISTIC
 /begin IN_MEASUREMENT EpmHCrS_stEngStrt EpmIf_tCoolant EpmSyn_phiOffs EpmSyn_stRR Epm_nEng10ms Epm_phiDiffTDC Epm_stOpMode Epm_stSync Strt_stStaActv VehV_v /end IN_MEASUREMENT
 /begin OUT_MEASUREMENT EpmRRS_bEngSwOff EpmRRS_stEnable EpmRRS_stEngStop EpmRRS_stEngStopOld EpmRRS_stRotDir /end OUT_MEASUREMENT
 /begin LOC_MEASUREMENT EpmRRS_actIncAr_mp EpmRRS_actIncBuf_mp EpmRRS_actIncOrig_mp EpmRRS_actInc_mp EpmRRS_ctGapInBuffer_mp EpmRRS_ctNewTeethOrig_mp EpmRRS_ctNewTeeth_mp EpmRRS_ctToothTimeout_mp EpmRRS_GapDetected_mp EpmRRS_idxWrAct_mp EpmRRS_incGapTest_mp EpmRRS_incSynOffs_mp EpmRRS_maxToothCondAr_mp EpmRRS_phiEngRR EpmRRS_phiGapPos EpmRRS_phiRelTDC_mp EpmRRS_stAgDetect EpmRRS_stGetBufNumPer_mp EpmRRS_stReason_mp EpmRRS_stToothPerBuf_mp EpmRRS_tiToothPer EpmRRS_tiToothPerOrg /end LOC_MEASUREMENT
 FUNCTION_VERSION "101.15.2" /end FUNCTION
/begin FUNCTION EpmSeq_EveHndlr "101.13.9  EPM Event Handler of incoming trigger events"
 /begin IN_MEASUREMENT EpmSeq_phiNxtInt EpmSyn_phiInt Epm_nEng Epm_stOpMode Epm_stSync /end IN_MEASUREMENT
 /begin OUT_MEASUREMENT EpmSeq_EveHndlr_stErr EpmSeq_eveId EpmSeq_phiEve EpmSeq_tiEve /end OUT_MEASUREMENT
 /begin LOC_MEASUREMENT EpmSeq_ctActivateSyncPre EpmSeq_ctForceResync EpmSeq_ctIncNextEvent_mp EpmSeq_currentEveId_mp EpmSeq_eveCount EpmSeq_SyncPreEnaMask_mp /end LOC_MEASUREMENT
 FUNCTION_VERSION "101.13.9" /end FUNCTION
/begin FUNCTION EpmSeq_StateMn "1.39.0    statemachine of interrupt control"
 /begin DEF_CHARACTERISTIC EpmSeq_nMaxStrtInt_C EpmSeq_phiIntBCr_CA EpmSeq_phiInt_CA EpmSeq_phiStrtInt_CA EpmSeq_swtInt_C /end DEF_CHARACTERISTIC
 /begin IN_MEASUREMENT EpmSeq_eveId EpmSyn_phiInt Epm_nEng Epm_numCyl Epm_phiCyl Epm_stOpMode Epm_stSync /end IN_MEASUREMENT
 /begin OUT_MEASUREMENT EpmSeq_numIncDiffInt EpmSeq_numInt EpmSeq_numIntPrev EpmSeq_phiNxtInt EpmSeq_phiNxtInt_msg EpmSeq_stCurrInt EpmSeq_stInt Epm_ctCyl /end OUT_MEASUREMENT
 /begin LOC_MEASUREMENT EpmSeq_idxIntrptData EpmSeq_idxIntrptDataNxt EpmSeq_numActvIntrpt EpmSeq_phiIntrpt EpmSeq_stIntrptGen EpmSeq_stReqIntrptGen EpmSeq_stSyncPrev EpmSeq_stSyncPrev_mp /end LOC_MEASUREMENT
 FUNCTION_VERSION "1.39.0" /end FUNCTION
/begin FUNCTION EpmSrv_Lib "101.10.0  service library for EPM" /begin REF_CHARACTERISTIC Epm_numFireSeg_C /end REF_CHARACTERISTIC /begin IN_MEASUREMENT EpmSyn_phiOffs EpmTDC_agCylCorrd Epm_numCyl /end IN_MEASUREMENT /begin LOC_MEASUREMENT EpmSrv_stCnvAgT2Ag_mp /end LOC_MEASUREMENT FUNCTION_VERSION "101.10.0" /end FUNCTION
/begin FUNCTION EpmSyn_CaSPos "1.43.12   phasesynchronisation about camshaft"
 /begin DEF_CHARACTERISTIC EpmSyn_dCaSSegMsk_C EpmSyn_nrIgrCaSEdge_C EpmSyn_swtDiFirstGapSyncn_C /end DEF_CHARACTERISTIC
 /begin REF_CHARACTERISTIC EpmCaS_phiSegOfs_CA EpmRRS_nEngMaxCaS_C Epm_phiGap2Zero_C /end REF_CHARACTERISTIC
 /begin IN_MEASUREMENT EpmCaS_numSegSerLst EpmCaS_phiRefPos EpmCaS_stAdap EpmCaS_stDiag EpmCaS_stDiagErr EpmCaS_stSnsrDeActvn EpmCrS_ctInc EpmCrS_stSigMode EpmHCaS_stCaSSig EpmHCrS_ctIncGap EpmSyn_stCrSPosErr Epm_nEng10ms Epm_stOpMode Epm_stSupressIni Epm_stSync /end IN_MEASUREMENT
 /begin OUT_MEASUREMENT EpmSyn_ctEdgeWcyOfs EpmSyn_numCaSSync EpmSyn_phiCaSPos EpmSyn_stCaSEval EpmSyn_stCaSPos EpmSyn_stCaSPosValid EpmSyn_stGapPos EpmSyn_stRR /end OUT_MEASUREMENT
 /begin LOC_MEASUREMENT EpmSyn_CaSDataI1.SigTab EpmSyn_CaSDataI1.stSearch EpmSyn_CaSDataI1.ctLstEdge EpmSyn_CaSDataI1.phiIniCaSPos EpmSyn_CaSDataI1.phiLstEdge EpmSyn_CaSDataI1.phiSegPos EpmSyn_CaSDataI1.numSegInSigTab EpmSyn_CaSDataI1.ctSigTabLstEntr EpmSyn_CaSDataI1.ctWcycle EpmSyn_CaSDataI1.stPreSeg EpmSyn_CaSDataI1.numNewEdges EpmSyn_CaSDataI1.numMatches EpmSyn_CaSDataI1.numMatchPos EpmSyn_ctBackwards EpmSyn_phiCaSPosCorrAdap EpmSyn_stCaSPosReset EpmSyn_stDiFirstGapSyncn EpmSyn_stPostDrvMemd /end LOC_MEASUREMENT
 FUNCTION_VERSION "1.43.12" /end FUNCTION
/begin FUNCTION EpmSyn_CrSPos "101.9.2   synchronisation of crankshaftposition" /begin DEF_CHARACTERISTIC EpmSyn_phiIncCor_CUR /end DEF_CHARACTERISTIC /begin REF_CHARACTERISTIC Epm_phiGap2Zero_C /end REF_CHARACTERISTIC
 /begin IN_MEASUREMENT EpmCrS_ctInc EpmCrS_stSigMode EpmHCrS_ctSynInc EpmHCrS_numGapWcy EpmHCrS_numGap_Var EpmHCrS_numIncGap2Gap_Var EpmHCrS_numIncWcy EpmSeq_phiEve EpmTDC_agOffsCorrn Epm_nEng Epm_stOpMode Epm_stSupressIni /end IN_MEASUREMENT
 /begin OUT_MEASUREMENT EpmSyn_phiDiff EpmSyn_phiInt EpmSyn_phiOffs EpmSyn_phiOffsCor EpmSyn_stCrSPos EpmSyn_stCrSPosErr /end OUT_MEASUREMENT
 /begin LOC_MEASUREMENT EpmSyn_GetAngleCnt_mp EpmSyn_phiAgClk_mp EpmSyn_phiIncCor_mp EpmSyn_phiSetPos_mp /end LOC_MEASUREMENT
 FUNCTION_VERSION "101.9.2" /end FUNCTION
/begin FUNCTION EpmTDC_Corrn "1.2.4     Correction of the TopDeadCenter (TDC)" /begin IN_MEASUREMENT Epm_numCyl Epm_phiCyl /end IN_MEASUREMENT /begin OUT_MEASUREMENT EpmTDC_agCylCorrd EpmTDC_agCylCorrn EpmTDC_agOffsCorrn /end OUT_MEASUREMENT FUNCTION_VERSION "1.2.4" /end FUNCTION
/begin FUNCTION EPM_Conf "101.6.1_1.0.0EPM Configuration with legacy mechanisms"
 /begin OUT_MEASUREMENT CAS_BKUP EpmCaS_stSnsrDeActvnPBVar EpmHCrS_numGap_Var EpmHCrS_numIncGap2Gap_Var EpmHCrS_numIncGap_Var EpmHCrS_numInc_Var EpmHCrS_stActEdge EpmHCrS_tiPlsFwd EpmHCrS_tiPlsRvs Epm_stPBVarInit /end OUT_MEASUREMENT
 FUNCTION_VERSION "101.6.1_1.0.0" /end FUNCTION
/begin FUNCTION Epm_Ini "101.11.0  Initialisation of EPM"
 /begin DEF_CHARACTERISTIC Epm_numCyl_C Epm_numFireSeg_C Epm_phiGap2Zero_C Epm_phiTdc1_C /end DEF_CHARACTERISTIC
 /begin OUT_MEASUREMENT Epm_numCyl Epm_phiCyl Epm_phiDiffTDC Epm_SensTypCrS /end OUT_MEASUREMENT
 /begin LOC_MEASUREMENT Epm_Ini_stFinalInit /end LOC_MEASUREMENT
 FUNCTION_VERSION "101.11.0" /end FUNCTION
/begin FUNCTION Epm_OpMode "101.33.0  Operation Modes of EPM"
 /begin DEF_CHARACTERISTIC Epm_nNoSyncVerify_C Epm_numReSync_C Epm_swtBlkInjCaSSync_C Epm_swtOpModeStgy_C Epm_tiLockReSync_C /end DEF_CHARACTERISTIC
 /begin REF_CHARACTERISTIC EpmCaS_stActEdge_C EpmCaS_tiGlitchFilter_C /end REF_CHARACTERISTIC
 /begin IN_MEASUREMENT DSM_TripChgFinshd EpmBCr_flgStrtDirectAllwd EpmBCr_phiPos EpmBCr_stPos EpmCaS_nEng EpmCaS_stOfsErr EpmCrS_stRotDir EpmCrS_stSigMode EpmHCrS_cntrInctDcyc EpmHCrS_cntrInctDcycOld EpmHCrS_stEngStrt EpmRRS_bEngSwOff EpmSeq_eveId EpmSyn_numCaSSync EpmSyn_phiCaSPos EpmSyn_phiInt EpmSyn_stCaSPos EpmSyn_stCrSPos EpmSyn_stCrSPosErr EpmSyn_stGapPos EpmSyn_stRR Epm_nEng Strt_stStaActv SyC_stSub /end IN_MEASUREMENT
 /begin OUT_MEASUREMENT Epm_agAbsltFirstSyncn Epm_ctReSync Epm_nrInctFirstSyncn Epm_stCmbTestReq Epm_stDirstaleReady Epm_stOpMode Epm_stSupressIni Epm_stSync Epm_tiFirstSyncn /end OUT_MEASUREMENT
 /begin LOC_MEASUREMENT Epm_bTrans2Wait_mp Epm_nEngVerify Epm_phiCurrPos Epm_stCaSNoErr_mp Epm_stDSMRdyOpMode Epm_stReSyncReasonInt Epm_stReSyncReason_mp Epm_tiLockReSync_mp /end LOC_MEASUREMENT
 FUNCTION_VERSION "101.33.0" /end FUNCTION
/begin FUNCTION Epm_Spd "101.17.0_1.0.1Calculation of Engine Speed"
 /begin DEF_CHARACTERISTIC Epm_nMaxSpdReSync_C Epm_nSpd2Zero_C Epm_numIgrTeethReSync_C Epm_tiSpd2Zero_C /end DEF_CHARACTERISTIC
 /begin IN_MEASUREMENT EpmBCr_nEng EpmBCr_stPos EpmCaS_nEng EpmCaS_numPriCamShft EpmCaS_numSegSerLst EpmCaS_stNEng EpmCrS_numIncPerSeg EpmCrS_phiSeg EpmCrS_stSigMode EpmCrS_tiSeg EpmCrS_tiSegCurr EpmHCrS_stSigMode EpmRRS_stEnable EpmRRS_stEngStop Epm_stOpMode Epm_stSupressIni /end IN_MEASUREMENT
 /begin OUT_MEASUREMENT Epm_nEng Epm_nEng10ms Epm_nEngCurr Epm_nEngInc10ms Epm_nEngRaw Epm_nEngTooth10ms Epm_phiIgrTeethReSync Epm_stReSync Epm_stSpd Epm_tiSpd2Zero /end OUT_MEASUREMENT
 /begin LOC_MEASUREMENT Epm_numValidTeeth_mp Epm_stSigModeLst_mp Epm_tiSegNTEETH_mp Epm_tiSegONETOOTH_mp Epm_tiSegPARTSEG_mp Epm_tiSegRaw_mp /end LOC_MEASUREMENT
 FUNCTION_VERSION "101.17.0_1.0.1" /end FUNCTION
/begin FUNCTION Epm_SpdFeat "1.8.0_1.0.1Feature specific engine speed calculation"
 /begin IN_MEASUREMENT EpmBCr_nEng EpmCaS_nEng EpmCrS_numIncPerSeg EpmCrS_phiSeg EpmCrS_phiSegHiRes EpmCrS_stHiEngSpd EpmCrS_stSigMode EpmCrS_tiSeg EpmCrS_tiSegHiRes Epm_nEng Epm_nEng10ms Epm_stReSync Epm_stSpd /end IN_MEASUREMENT
 /begin OUT_MEASUREMENT Epm_nEngHiRes Epm_nEngLRes /end OUT_MEASUREMENT
 /begin LOC_MEASUREMENT Epm_nEng10msInt Epm_nEngSeg_mp /end LOC_MEASUREMENT
 FUNCTION_VERSION "1.8.0_1.0.1" /end FUNCTION
/begin FUNCTION Epm_SpdGrd "1.30.5_1.0.2Calculation of enginespeed gradient" /begin DEF_CHARACTERISTIC Epm_tiSpdGrdAvgFlt_C Epm_tiSpdGrdFlt_C /end DEF_CHARACTERISTIC
 /begin IN_MEASUREMENT EpmCrS_phiSeg EpmCrS_phiSegHiRes EpmCrS_tiSeg EpmHCrS_numIncWcy EpmSeq_numInt EpmSyn_phiInt Epm_ctCyl Epm_nEng Epm_nEngHiRes Epm_numCyl Epm_phiIgrTeethReSync Epm_stOpMode Epm_stReSync Epm_stSpd Epm_stSupressIni Epm_stSync /end IN_MEASUREMENT
 /begin OUT_MEASUREMENT Epm_bReSyncHiResGrd Epm_dnEng Epm_dnEngAvg Epm_dnEngAvgFlt Epm_dnEngFlt Epm_dnEngHiRes Epm_nEngDiff Epm_nEngDiffAvg /end OUT_MEASUREMENT
 /begin LOC_MEASUREMENT Epm_bDnEngHiResAllw_mp Epm_nEngHiResPrev_mp Epm_nEngOldS0_mp Epm_nEngOldS1_mp Epm_phiAbsPrev_mp Epm_phiBufLenMin_mp Epm_phiBufLen_mp Epm_stHiResGrdMsk_mp Epm_tiSegOfs_mp Epm_tiSegPrev_mp /end LOC_MEASUREMENT
 FUNCTION_VERSION "1.30.5_1.0.2" /end FUNCTION
/begin FUNCTION ESC_Stack "30000.15.0Functional component to provide sampling time for both time and angle synchronous rasters" /begin IN_MEASUREMENT EpmCrS_tiSeg EpmCrS_tiSegCurr /end IN_MEASUREMENT
 /begin LOC_MEASUREMENT ESC_stFrstSyncPreTsk ESC_stStackErr ESC_tiSampleSyncPreTsk ESC_tiSyncPreTskStrt /end LOC_MEASUREMENT
 FUNCTION_VERSION "30000.15.0" /end FUNCTION
/begin FUNCTION ESC_TaskLink "30000.13.0activation of engine speed synchronous tasks"
 /begin DEF_CHARACTERISTIC ESC_stS1FrstSched_C ESC_stSyncS0MaxRst_C ESC_stSyncS1MaxRst_C /end DEF_CHARACTERISTIC
 /begin IN_MEASUREMENT Eep_EnvRamInvld EpmSeq_numInt SyC_stSub SyC_tiDrv /end IN_MEASUREMENT
 /begin LOC_MEASUREMENT ESC_agSyncPreActvn ESC_cntStrtSyncPre ESC_dataMaxTskLoadS0Envram ESC_dataMaxTskLoadS1Envram ESC_dataSyncS0MaxTskLoad ESC_dataSyncS0TskLoad ESC_dataSyncS1MaxTskLoad ESC_dataSyncS1TskLoad ESC_stActivateSyncPre ESC_stActnSyncPre ESC_stmnSyncPre ESC_tiLftiMaxRtS0Envram ESC_tiLftiMaxRtS1Envram ESC_tiSyncPreDiff ESC_tiSyncPreTrigLtcy ESC_tiSyncS0TskRt ESC_tiSyncS0TskRtMax ESC_tiSyncS1TskRt ESC_tiSyncS1TskRtMax /end LOC_MEASUREMENT
 FUNCTION_VERSION "30000.13.0" /end FUNCTION
/begin FUNCTION ESDSDLUT "4.1.0     Determination delta standard deviation of engine roughness"
 /begin DEF_CHARACTERISTIC EngStrt_stStdDeEngRoughns_C KFSDLUSDMR KFSDLUSOL KFSDLUSRRI KLLUTS ZKASDLUTS ZKMSDLUTS /end DEF_CHARACTERISTIC
 /begin IN_MEASUREMENT anztib_w_msg B_sdluts_msg CEngDsT_tStrt dmrmx_w_msg Epm_stSpd luts_w_msg rri_w_msg SyC_stSub /end IN_MEASUREMENT
 /begin OUT_MEASUREMENT dsdluts_w_msg sdlutsol_w_msg sdluts_w_msg /end OUT_MEASUREMENT
 /begin LOC_MEASUREMENT lutsnorm_w tmsdluts /end LOC_MEASUREMENT
 FUNCTION_VERSION "4.1.0" /end FUNCTION
/begin FUNCTION ESGRU "7.3.0     Basic function injection" /begin DEF_CHARACTERISTIC CWRKAKAP FRKAP RKAKAP /end DEF_CHARACTERISTIC /begin REF_CHARACTERISTIC N0 NRKAB /end REF_CHARACTERISTIC /begin IN_MEASUREMENT Epm_nEngLRes /end IN_MEASUREMENT /begin OUT_MEASUREMENT fgru_msg rkakapb_w_msg /end OUT_MEASUREMENT FUNCTION_VERSION "7.3.0" /end FUNCTION
/begin FUNCTION ESNSAD "3.3.0     Afterstart fuel adaptation"
 /begin DEF_CHARACTERISTIC DSDLUTSIMN DSDLUTSIMX KFFNSAMX KLFNSAMX KLNSADI KLNSADP KLZKNSADI TFNSADOFF TNSADHMX TNSEMX /end DEF_CHARACTERISTIC
 /begin IN_MEASUREMENT B_nsadh_msg B_nsad_msg CEngDsT_t dsdluts_w_msg lamsbg_w_msg SyC_ctPostDrvLeave tnse_w_msg /end IN_MEASUREMENT
 /begin OUT_MEASUREMENT fnsad_w_msg /end OUT_MEASUREMENT
 /begin LOC_MEASUREMENT dsdliold_w dsdlutsi_w EngStrt_ctESNSADReIni100ms EngStrt_ctESNSADReIniSyncS0 EngStrt_facDesLamLimLoc EngStrt_ratStdDeEngRoughnsLoc ESNSAD_tEng flimit_w flimuebw_w fnsadi_w fnsadlim_w fnsadp_w tmotnsad /end LOC_MEASUREMENT
 FUNCTION_VERSION "3.3.0" /end FUNCTION
/begin COMPU_METHOD AngleCrS "" RAT_FUNC "%6.4" "deg CrS" COEFFS 0 45.5111111111 0 0 0 1 /end COMPU_METHOD
/begin COMPU_METHOD dez "" RAT_FUNC "%6.2" "" COEFFS 0 1 0 0 0 1 /end COMPU_METHOD
/begin COMPU_METHOD EngN "" RAT_FUNC "%6.3" "rpm" COEFFS 0 2 0 0 0 1 /end COMPU_METHOD
/begin COMPU_METHOD EngN2tiIncPer "" RAT_FUNC "%8.0" "rpm" COEFFS 0 0 1 0 2.40000012e-007 0 /end COMPU_METHOD
/begin COMPU_METHOD EngNGrd "" RAT_FUNC "%6.3" "rpm/s" COEFFS 0 2 0 0 0 1 /end COMPU_METHOD
/begin COMPU_METHOD EngN_LRes "" RAT_FUNC "%6.1" "rpm" COEFFS 0 0.025 0 0 0 1 /end COMPU_METHOD
/begin COMPU_METHOD EpmCrS_swtSnsrTyp_State_t "" TAB_VERB "%6.3" "" COMPU_TAB_REF EpmCrS_swtSnsrTyp_State_t /end COMPU_METHOD
/begin COMPU_VTAB EpmCrS_swtSnsrTyp_State_t "" TAB_VERB 3 0 "DG_DGI_TYPEA" 1 "DG_DGI_TYPEB" 2 "DG_TYPEC" /end COMPU_VTAB
/begin COMPU_METHOD EpmErr_ErrClass_t "" TAB_VERB "%6.3" "" COMPU_TAB_REF EpmErr_ErrClass_t /end COMPU_METHOD
/begin COMPU_VTAB EpmErr_ErrClass_t "" TAB_VERB 5 0 "EPMERR_NO_ERR_E" 1 "EPMERR_RPRT_E" 2 "EPMERR_RESYNC_E" 3 "EPMERR_INTERR_E" 4 "EPMERR_RSTRT_E" /end COMPU_VTAB
/begin COMPU_METHOD EpmHAgClk_AgClkFrq_t "" TAB_VERB "%6.3" "" COMPU_TAB_REF EpmHAgClk_AgClkFrq_t /end COMPU_METHOD
/begin COMPU_VTAB EpmHAgClk_AgClkFrq_t "" TAB_VERB 4 0 "AGCLK_FRQ_NORMAL" 1 "AGCLK_FRQ_HIGH" 2 "AGCLK_FRQ_LOW" 3 "AGCLK_FRQ_ZERO" /end COMPU_VTAB
/begin COMPU_METHOD EpmHAgClk_AgClkMode_t "" TAB_VERB "%6.3" "" COMPU_TAB_REF EpmHAgClk_AgClkMode_t /end COMPU_METHOD
/begin COMPU_VTAB EpmHAgClk_AgClkMode_t "" TAB_VERB 4 0 "AUTOMATICEND_MODE" 1 "CONTINUOUS_MODE" 2 "MIXED_MODE" 3 "EMERGENCY_MODE" /end COMPU_VTAB
/begin COMPU_METHOD EpmHAgClk_AgClkState_t "" TAB_VERB "%6.3" "" COMPU_TAB_REF EpmHAgClk_AgClkState_t /end COMPU_METHOD
/begin COMPU_VTAB EpmHAgClk_AgClkState_t "" TAB_VERB 2 0 "AGCLK_STOPPED" 1 "AGCLK_RUNNING" /end COMPU_VTAB
/begin COMPU_METHOD EpmHCrS_stRotDir_t "" TAB_VERB "%6.3" "" COMPU_TAB_REF EpmHCrS_stRotDir_t /end COMPU_METHOD
/begin COMPU_VTAB EpmHCrS_stRotDir_t "" TAB_VERB 4 0 "EPMHCRS_ROT_AMB" 1 "EPMHCRS_ROT_FWD" 2 "EPMHCRS_ROT_RVS" 3 "EPMHCRS_ROT_STOP" /end COMPU_VTAB
/begin COMPU_METHOD EpmHCrS_stSigMode_State_t "" TAB_VERB "%6.3" "" COMPU_TAB_REF EpmHCrS_stSigMode_State_t /end COMPU_METHOD
/begin COMPU_VTAB EpmHCrS_stSigMode_State_t "" TAB_VERB 10 0 "EPMHCRS_HALT" 1 "EPMHCRS_WAITSIG" 2 "EPMHCRS_IGNTIME" 3 "EPMHCRS_DEBEDGE" 4 "EPMHCRS_WAITGAP" 5 "EPMHCRS_VERIFYGAP" 6 "EPMHCRS_AMBIGAP_E" 7 "EPMHCRS_KEEPDGISYNC" 8 "EPMHCRS_GAPFOUND" 9 "EPMHCRS_DISABLNEWSYNC" /end COMPU_VTAB
/begin COMPU_METHOD EpmRRS_bEngSwOff_t "" TAB_VERB "%6.3" "" COMPU_TAB_REF EpmRRS_bEngSwOff_t /end COMPU_METHOD
/begin COMPU_VTAB EpmRRS_bEngSwOff_t "" TAB_VERB 2 0 "EPMRRS_ENGSWTOFF_INACTV" 1 "EPMRRS_ENGSWTOFF_ACTV" /end COMPU_VTAB
/begin COMPU_METHOD EpmRRS_stAgDetect_t "" TAB_VERB "%6.3" "" COMPU_TAB_REF EpmRRS_stAgDetect_t /end COMPU_METHOD
/begin COMPU_VTAB EpmRRS_stAgDetect_t "" TAB_VERB 3 0 "EPMRRS_DISABLE" 1 "EPMRRS_ENABLE" 2 "EPMRRS_CONFIRM" /end COMPU_VTAB
/begin COMPU_METHOD EpmRRS_stRotDir_t "" TAB_VERB "%6.3" "" COMPU_TAB_REF EpmRRS_stRotDir_t /end COMPU_METHOD
/begin COMPU_VTAB EpmRRS_stRotDir_t "" TAB_VERB 4 0 "AMBI" 1 "FORWARD" 2 "BACKWARD" 3 "STOPPED" /end COMPU_VTAB
/begin COMPU_METHOD EpmSeq_EveId_t "" TAB_VERB "%6.3" "" COMPU_TAB_REF EpmSeq_EveId_t /end COMPU_METHOD
/begin COMPU_VTAB EpmSeq_EveId_t "" TAB_VERB 18 0 "EVEHNDLR_ERROR" 1 "CRS_EDGE" 2 "CRS_DYNTIMEOUT" 3 "CRS_TIMEOUT" 4 "CAS_1_EDGE" 5 "CAS_1_TIMEOUT" 6 "CAS_2_EDGE" 7 "CAS_2_TIMEOUT" 8 "CAS_3_EDGE" 9 "CAS_3_TIMEOUT" 10 "CAS_4_EDGE" 11 "CAS_4_TIMEOUT" 12 "STOPBACKUP" 13 "STARTBACKUP" 14 "AG_CLOCK" 15 "FORCE_RESYNC" 16 "EPMRRS_DIRECTION" 17 "LAST_EVENT" /end COMPU_VTAB
/begin COMPU_METHOD EpmSeq_numInt_Compu "" TAB_VERB "%6.3" "" COMPU_TAB_REF EpmSeq_numInt_Compu /end COMPU_METHOD
/begin COMPU_VTAB EpmSeq_numInt_Compu "" TAB_VERB 11 0 "EPMSEQ_S_0" 1 "EPMSEQ_S_1" 2 "EPMSEQ_S_0_FIRST" 3 "EPMSEQ_S_1_FIRST" 6 "EPMSEQ_S_0_FIRST_START" 7 "EPMSEQ_S_1_FIRST_START" 8 "EPMSEQ_S_EPM" 16 "EPMSEQ_S_INI" 32 "EPMSEQ_S_0_H" 34 "EPMSEQ_S_0_H_FIRST" 38 "EPMSEQ_S_0_H_FIRST_START" /end COMPU_VTAB
/begin COMPU_METHOD EpmSeq_stIntrptGen_Compu "" TAB_VERB "%6.3" "" COMPU_TAB_REF EpmSeq_stIntrptGen_Compu /end COMPU_METHOD
/begin COMPU_VTAB EpmSeq_stIntrptGen_Compu "" TAB_VERB 4 0 "EPMSEQ_NO_INTRPTGEN" 1 "EPMSEQ_INTRPTGEN_STRT" 2 "EPMSEQ_INTRPTGEN_RGL" 4 "EPMSEQ_INTRPTGEN_BCR" /end COMPU_VTAB
/begin COMPU_METHOD EpmSeq_stInt_Compu "" TAB_VERB "%6.3" "" COMPU_TAB_REF EpmSeq_stInt_Compu /end COMPU_METHOD
/begin COMPU_VTAB EpmSeq_stInt_Compu "" TAB_VERB 8 0 "EPMSEQ_ST_S_0" 1 "EPMSEQ_ST_S_1" 4 "EPMSEQ_ST_S_0_START" 5 "EPMSEQ_ST_S_1_START" 8 "EPMSEQ_ST_EPM" 16 "EPMSEQ_ST_INI" 32 "EPMSEQ_ST_S_0_H" 36 "EPMSEQ_ST_S_0_H_START" /end COMPU_VTAB
/begin COMPU_METHOD EpmSeq_stReqIntrptGen_Compu "" TAB_VERB "%6.3" "" COMPU_TAB_REF EpmSeq_stReqIntrptGen_Compu /end COMPU_METHOD
/begin COMPU_VTAB EpmSeq_stReqIntrptGen_Compu "" TAB_VERB 2 0 "EPMSEQ_NO_INTRPT_REQ" 1 "EPMSEQ_GEN_STRT_INTRPT" /end COMPU_VTAB
/begin COMPU_METHOD EpmSeq_swtInt_Compu "" TAB_VERB "%6.3" "" COMPU_TAB_REF EpmSeq_swtInt_Compu /end COMPU_METHOD
/begin COMPU_VTAB EpmSeq_swtInt_Compu "" TAB_VERB 9 0 "STRTIR_S1CLB" 1 "STRTIR_S1AUT" 2 "STRTIR_NOS1IR" 4 "NOSTRTIR_S1CLB" 5 "NOSTRTIR_S1AUT" 6 "NOSTRTIR_NOS1IR" 16 "EXTINTRPTREQ_S1CLB" 17 "EXTINTRPTREQ_S1AUT" 18 "EXTINTRPTREQ_NOS1IR" /end COMPU_VTAB
/begin COMPU_METHOD EpmSrv_stCnvAgT2Ag_t "" TAB_VERB "%6.3" "" COMPU_TAB_REF EpmSrv_stCnvAgT2Ag_t /end COMPU_METHOD
/begin COMPU_VTAB EpmSrv_stCnvAgT2Ag_t "" TAB_VERB 31 0 "0" 1 "1" 2 "2" 3 "3" 4 "4" 5 "5" 6 "6" 7 "7" 8 "8" 9 "9" 10 "10" 11 "11" 12 "12" 13 "13" 14 "14" 15 "15" 16 "16" 17 "17" 18 "18" 19 "19" 20 "20" 21 "21" 22 "22" 23 "23" 24 "24" 25 "AVRGSPD" 26 "EXTRAPOLATION" 252 "EPMSRV_EXTPOL_MIAPFLT" 253 "ERRORSTGY" 254 "ERRORCRS" 255 "ERRORMIAP" /end COMPU_VTAB
/begin COMPU_METHOD EpmSyn_stCaSEvalComp "" TAB_VERB "%6.3" "" COMPU_TAB_REF EpmSyn_stCaSEvalComp /end COMPU_METHOD
/begin COMPU_VTAB EpmSyn_stCaSEvalComp "" TAB_VERB 5 0 "NO_CASPOS" 1 "SEARCH_CASPOS" 2 "VERIFY_CASPOS" 3 "SWTOFF_CASPOS" 4 "EVAL_CASPOS" /end COMPU_VTAB
/begin COMPU_METHOD EpmSyn_stCaSPosComp "" TAB_VERB "%6.3" "" COMPU_TAB_REF EpmSyn_stCaSPosComp /end COMPU_METHOD
/begin COMPU_VTAB EpmSyn_stCaSPosComp "" TAB_VERB 9 0 "EPMSYN_CASPOS_NOTVALID" 1 "EPMSYN_SIGTAB_NOUPDATE" 2 "EPMSYN_SIGTAB_AMBI" 5 "EPMSYN_CASPOS_VALID" 10 "EPMSYN_WRONG_SEG_LEN" 11 "EPMSYN_SIGTAB_END" 12 "EPMSYN_SIGTAB_SEQ" 13 "EPMSYN_EXCEED_TOLC" 20 "EPMSYN_CASPOS_SWTOFF" /end COMPU_VTAB
/begin COMPU_METHOD EpmSyn_stCrSPos_State_t "" TAB_VERB "%6.3" "" COMPU_TAB_REF EpmSyn_stCrSPos_State_t /end COMPU_METHOD
/begin COMPU_VTAB EpmSyn_stCrSPos_State_t "" TAB_VERB 4 0 "EPMSYN_NO_SYNC" 1 "EPMSYN_CRS_SYNC" 2 "EPMSYN_CAS_SYNC" 3 "EPMSYN_FULL_SYNC" /end COMPU_VTAB
/begin COMPU_METHOD EpmSyn_stRRComp "" TAB_VERB "%6.3" "" COMPU_TAB_REF EpmSyn_stRRComp /end COMPU_METHOD
/begin COMPU_VTAB EpmSyn_stRRComp "" TAB_VERB 2 0 "EPMSYN_FORWARDS" 1 "EPMSYN_BACKWARDS" /end COMPU_VTAB
/begin COMPU_METHOD EPM_FAC_PLAUS "" RAT_FUNC "%6.4" "-" COEFFS 0 16 0 0 0 1 /end COMPU_METHOD
/begin COMPU_METHOD Epm_ModId_t "" TAB_VERB "%6.3" "" COMPU_TAB_REF Epm_ModId_t /end COMPU_METHOD
/begin COMPU_VTAB Epm_ModId_t "" TAB_VERB 81 0 "EMPTY_ID" 1 "EPM_INI_ID" 2 "EPM_OPMODE_ID" 3 "EPM_SPD_ID" 4 "ENGDA_NENGREV_ID" 5 "EPM_AXISPOINTS_ID" 6 "EPM_HE_ID" 7 "EPM_OUT_ID" 8 "EPM_SPDGRD_ID" 9 "EPM_SPDOUT_ID" 10 "EPM_SPDPLAUS_ID" 11 "EPM_SWADP_ID" 12 "EPM_TRACE_ID" 13 "ENGSPD_DD_ID" 14 "HT2KTTD_ID" 15 "EPMBCA_TSTINJ_ID" 16 "EPMBCR_DYN_ID" 17 "EPMBCR_INTRCO_ID" 18 "EPMBCR_PLAUS_ID" 19 "EPMBCR_POS_ID" 20 "EPMCAS_ADAP_ID" 21 "EPMCAS_DIAG_ID" 22 "EPMCAS_MEAS_ID" 23 "EPMCAS_MON_ID" 24 "EPMCAS_OFSDIAG_ID" 25 "EPMCAS_OUT_ID" 26 "EPMCAS_SEG_ID" 27 "EPMCRS_DIAG_ID" 28 "EPMCRS_DIAGSYNCLOST_ID" 29 "EPMCRS_DIAGSYNCINJLOST_ID" 30 "EPMCRS_MON_ID" 31 "EPMCRS_PLAUS_ID" 32 "EPMCRS_REVCNT_ID" 33 "EPMCRS_SEG_ID" 34 "EPM_CUSTADP_ID" 35 "EPMERR_TRACE_ID" 36 "EPMERT_SEG_ID" 37 "EPMRRS_AGDETECT_ID" 38 "EPMRRS_PREDICT_ID" 39 "EPMRRS_STALLDETECT_ID" 40 "EPMRRS_STOPDETECT_ID" 41 "EPMSEQ_EVEHNDLR_ID" 42 "EPMSEQ_STATEMN_ID" 43 "EPMSPC_DIAGCAS_ID" 44 "EPMSPC_DIAGCRS_ID" 45 "EPMSRV_LIB_ID" 46 "EPMSYN_CAMSFTPST_ID" 47 "EPMSYN_CASPOS_ID" 48 "EPMSYN_CO_ID" 49 "EPMSYN_CPP_ID" 50 "EPMSYN_CRKSFTPAT_ID" 51 "EPMSYN_CRKSFTTOOTHT_ID" 52 "EPMSYN_CRSPOS_ID" 53 "EPMSYN_DBLLGN_ID" 54 "EPMSYN_INJRLS_ID" 55 "EPMSYN_INTKMNFLDP_ID" 56 "EPMSYN_TESTINJ_ID" 57 "EPMTDC_ADAP_ID" 58 "EPMTDC_CTL_ID" 59 "EPMHWE_FIL_ID" 60 "EPMHWE_INI_ID" 61 "EPMHWE_SRV_ID" 62 "EPMHAGCLK_GEN_ID" 63 "EPMHAGCLK_TRIGEVE_ID" 64 "EPMHCAS_DELAY_ID" 65 "EPMHCAS_INTERFACE_ID" 66 "EPMHCAS_SIGBUF_ID" 67 "EPMHCAS_SIGEVAL_ID" 68 "EPMHCRS_DIREVLN_ID" 69 "EPMHCRS_DYNPLAUS_ID" 70 "EPMHCRS_INTERFACE_ID" 71 "EPMHCRS_SAMPLING_ID" 72 "EPMHCRS_SIGBUF_ID" 73 "EPMHCRS_SIGEVAL_ID" 74 "EPMHCRS_STMAC_ID" 75 "EPMHERT_SIGBUF_ID" 76 "EPMHERT_SIGEVAL_ID" 77 "EPMHINT_INTGEN_ID" 78 "EPMHSPC_CHECK_ID" 79 "EPMHAGCLK_TRIG_ID" 80 "EPMHCRS_INTHNDLR_ID" /end COMPU_VTAB
/begin COMPU_METHOD Epm_SensTypCrS_t "" TAB_VERB "%6.3" "" COMPU_TAB_REF Epm_SensTypCrS_t /end COMPU_METHOD
/begin COMPU_VTAB Epm_SensTypCrS_t "" TAB_VERB 3 0 "STD" 1 "DGI" 2 "DG_DGI" /end COMPU_VTAB
/begin COMPU_METHOD Epm_stCmbTestReq_State_t "" TAB_VERB "%6.3" "" COMPU_TAB_REF Epm_stCmbTestReq_State_t /end COMPU_METHOD
/begin COMPU_VTAB Epm_stCmbTestReq_State_t "" TAB_VERB 2 0 "EPM_NO_CMBTEST" 10 "EPM_CMBTEST" /end COMPU_VTAB
/begin COMPU_METHOD Epm_stDirstaleReady_State_t "" TAB_VERB "%6.3" "" COMPU_TAB_REF Epm_stDirstaleReady_State_t /end COMPU_METHOD
/begin COMPU_VTAB Epm_stDirstaleReady_State_t "" TAB_VERB 2 0 "EPM_DIRST_NOT_READY" 10 "EPM_DIRST_READY" /end COMPU_VTAB
/begin COMPU_METHOD Epm_stOpMode_State_t "" TAB_VERB "%6.3" "" COMPU_TAB_REF Epm_stOpMode_State_t /end COMPU_METHOD
/begin COMPU_VTAB Epm_stOpMode_State_t "" TAB_VERB 8 1 "EPM_MODE_WAIT" 5 "EPM_MODE_LOCKRESYNC" 20 "EPM_MODE_ALE" 33 "EPM_MODE_VERIFY" 36 "EPM_MODE_VERIFY_EXT" 38 "EPM_MODE_BACKUP_CAS" 48 "EPM_MODE_OK" 60 "EPM_MODE_BACKUP_CRS" /end COMPU_VTAB
/begin COMPU_METHOD Epm_stReSyncReason_State_t "" TAB_VERB "%6.3" "" COMPU_TAB_REF Epm_stReSyncReason_State_t /end COMPU_METHOD
/begin COMPU_VTAB Epm_stReSyncReason_State_t "" TAB_VERB 18 0 "EPM_RESYNC_NORESYNC" 1 "EPM_RESYNC_CRS_ERR_OR_STOP" 2 "EPM_RESYNC_SHIFT" 3 "EPM_RESYNC_CAS_ERROR" 4 "EPM_RESYNC_REVERSE_CRS" 5 "EPM_RESYNC_OFSERR" 6 "EPM_RESYNC_CANERR" 7 "EPM_RESYNC_UPPERLVL" 8 "EPM_RESYNC_REVERSE_CAS" 9 "EPM_RESYNC_START_BCR" 10 "EPM_RESYNC_RRS_SHIFT" 11 "EPM_RESYNC_LOCK_END" 12 "EPM_RESYNC_BCR_POS_NOT_PLAUS" 13 "EPM_RESYNC_BCR_RESTART" 14 "EPM_RESYNC_CRS_MIN_SPEED" 15 "EPM_RESYNC_BCR_NO_CAS_SPEED" 16 "EPM_RESYNC_BCR_NORESYNC" 17 "EPM_RESYNC_AGCLK_NOT_PLAUS" /end COMPU_VTAB
/begin COMPU_METHOD Epm_stSpd_t "" TAB_VERB "%6.3" "" COMPU_TAB_REF Epm_stSpd_t /end COMPU_METHOD
/begin COMPU_VTAB Epm_stSpd_t "" TAB_VERB 5 0 "EPM_SPD_CRS" 1 "EPM_SPD_HOLD" 2 "EPM_SPD_ZERO" 3 "EPM_SPD_CAS" 4 "EPM_SPD_BACKUP" /end COMPU_VTAB
/begin COMPU_METHOD Epm_stSync_State_t "" TAB_VERB "%6.3" "" COMPU_TAB_REF Epm_stSync_State_t /end COMPU_METHOD
/begin COMPU_VTAB Epm_stSync_State_t "" TAB_VERB 5 0 "EPM_NO_SYNC" 10 "EPM_ALE_SYNC" 20 "EPM_CAS_SYNC" 21 "EPM_DIRSTALE_SYNC" 30 "EPM_FULL_SYNC" /end COMPU_VTAB
/begin COMPU_METHOD ESC_MaxRtTskLoad_Rst_t "" TAB_VERB "%6.3" "" COMPU_TAB_REF ESC_MaxRtTskLoad_Rst_t /end COMPU_METHOD
/begin COMPU_VTAB ESC_MaxRtTskLoad_Rst_t "" TAB_VERB 2 0 "ESC_ENABLE_MAX_MEASMT" 1 "ESC_RESET_MAX_MEASMT" /end COMPU_VTAB
/begin COMPU_METHOD ESC_stS1FrstSched_t "" TAB_VERB "%6.3" "" COMPU_TAB_REF ESC_stS1FrstSched_t /end COMPU_METHOD
/begin COMPU_VTAB ESC_stS1FrstSched_t "" TAB_VERB 4 0 "ESC_SX_SCHEDSTRT" 1 "ESC_S1_SCHEDSTRT" 2 "ESC_S0_SCHEDSTRT" 3 "ESC_S1FORCED_SCHEDSTRT" /end COMPU_VTAB
/begin COMPU_METHOD FactLow "" RAT_FUNC "%6.5" "-" COEFFS 0 1024 0 0 0 1 /end COMPU_METHOD
/begin COMPU_METHOD fak_sw_b1 "" RAT_FUNC "%7.6" "-" COEFFS 0 65536 0 0 0 2 /end COMPU_METHOD
/begin COMPU_METHOD fak_ub_b2 "" RAT_FUNC "%8.5" "-" COEFFS 0 256 0 0 0 2 /end COMPU_METHOD
/begin COMPU_METHOD fak_uw_b1 "" RAT_FUNC "%7.6" "-" COEFFS 0 65536 0 0 0 1 /end COMPU_METHOD
/begin COMPU_METHOD fak_uw_b16 "" RAT_FUNC "%6.5" "-" COEFFS 0 65536 0 0 0 16 /end COMPU_METHOD
/begin COMPU_METHOD fak_uw_b2 "" RAT_FUNC "%7.6" "-" COEFFS 0 65536 0 0 0 2 /end COMPU_METHOD
/begin COMPU_METHOD fak_uw_b4 "" RAT_FUNC "%7.6" "-" COEFFS 0 65536 0 0 0 4 /end COMPU_METHOD
/begin COMPU_METHOD GptaClc6_ti_COMPU "" RAT_FUNC "%6.3" "us" COEFFS 0 2.5 0 0 0 1 /end COMPU_METHOD
/begin COMPU_METHOD IATPS12SLAVE_SC_Compu "" TAB_VERB "%6.3" "" COMPU_TAB_REF IATPS12SLAVE_SC_Compu /end COMPU_METHOD
/begin COMPU_VTAB IATPS12SLAVE_SC_Compu "" TAB_VERB 7 0 "no_sensor" 1 "TFA1" 2 "TFA2" 3 "TFA3" 4 "TFA4" 5 "TFA5" 6 "TFA6" /end COMPU_VTAB
/begin COMPU_METHOD IATPS13SLAVE_SC_Compu "" TAB_VERB "%6.3" "" COMPU_TAB_REF IATPS13SLAVE_SC_Compu /end COMPU_METHOD
/begin COMPU_VTAB IATPS13SLAVE_SC_Compu "" TAB_VERB 7 0 "no_sensor" 1 "TFA1" 2 "TFA2" 3 "TFA3" 4 "TFA4" 5 "TFA5" 6 "TFA6" /end COMPU_VTAB
/begin COMPU_METHOD IATPS21SLAVE_SC_Compu "" TAB_VERB "%6.3" "" COMPU_TAB_REF IATPS21SLAVE_SC_Compu /end COMPU_METHOD
/begin COMPU_VTAB IATPS21SLAVE_SC_Compu "" TAB_VERB 7 0 "no_sensor" 1 "TFA1" 2 "TFA2" 3 "TFA3" 4 "TFA4" 5 "TFA5" 6 "TFA6" /end COMPU_VTAB
/begin COMPU_METHOD IATPS22SLAVE_SC_Compu "" TAB_VERB "%6.3" "" COMPU_TAB_REF IATPS22SLAVE_SC_Compu /end COMPU_METHOD
/begin COMPU_VTAB IATPS22SLAVE_SC_Compu "" TAB_VERB 7 0 "no_sensor" 1 "TFA1" 2 "TFA2" 3 "TFA3" 4 "TFA4" 5 "TFA5" 6 "TFA6" /end COMPU_VTAB
/begin COMPU_METHOD IATPS23SLAVE_SC_Compu "" TAB_VERB "%6.3" "" COMPU_TAB_REF IATPS23SLAVE_SC_Compu /end COMPU_METHOD
/begin COMPU_VTAB IATPS23SLAVE_SC_Compu "" TAB_VERB 7 0 "no_sensor" 1 "TFA1" 2 "TFA2" 3 "TFA3" 4 "TFA4" 5 "TFA5" 6 "TFA6" /end COMPU_VTAB
/begin COMPU_METHOD IDLESPDADJMTDRVPROG_SC_Compu "" TAB_VERB "%6.3" "" COMPU_TAB_REF IDLESPDADJMTDRVPROG_SC_Compu /end COMPU_METHOD
/begin COMPU_VTAB IDLESPDADJMTDRVPROG_SC_Compu "" TAB_VERB 3 0 "No_adjmnt" 1 "Drvgmode" 2 "DrvgFildgAdjmnt" /end COMPU_VTAB
/begin COMPU_METHOD IDLSHTDWN_SY_Compu "" TAB_VERB "%6.3" "" COMPU_TAB_REF IDLSHTDWN_SY_Compu /end COMPU_METHOD
/begin COMPU_VTAB IDLSHTDWN_SY_Compu "" TAB_VERB 2 0 "False" 1 "True" /end COMPU_VTAB
/begin COMPU_METHOD IGCSELN_SC_Compu "" TAB_VERB "%6.3" "" COMPU_TAB_REF IGCSELN_SC_Compu /end COMPU_METHOD
/begin COMPU_VTAB IGCSELN_SC_Compu "" TAB_VERB 4 0 "Not_Avl" 1 "FirstGenn_BOSCH" 2 "SecondGenn_BOSCH" 3 "ThirdGenn_BOSCH" /end COMPU_VTAB
/begin COMPU_METHOD IGCTL_DFCIAKNKPROTN_SC_Compu "" TAB_VERB "%6.3" "" COMPU_TAB_REF IGCTL_DFCIAKNKPROTN_SC_Compu /end COMPU_METHOD
/begin COMPU_VTAB IGCTL_DFCIAKNKPROTN_SC_Compu "" TAB_VERB 2 0 "0" 1 "1" /end COMPU_VTAB
/begin COMPU_METHOD IGCTL_IAATS_SC_Compu "" TAB_VERB "%6.3" "" COMPU_TAB_REF IGCTL_IAATS_SC_Compu /end COMPU_METHOD
/begin COMPU_VTAB IGCTL_IAATS_SC_Compu "" TAB_VERB 2 0 "False" 1 "True" /end COMPU_VTAB
/begin COMPU_METHOD IGCTL_VAR_SY_Compu "" TAB_VERB "%6.3" "" COMPU_TAB_REF IGCTL_VAR_SY_Compu /end COMPU_METHOD
/begin COMPU_VTAB IGCTL_VAR_SY_Compu "" TAB_VERB 44 1 "DAI" 3 "VWW" 4 "POR" 5 "AUD" 6 "OPE" 9 "FIA" 11 "BMW" 14 "PSA" 15 "REN" 17 "ALF" 18 "SAB" 19 "VOL" 20 "NIS" 21 "GMU" 22 "FOR" 26 "IMJ" 51 "SEA" 53 "CHR" 54 "JAG" 55 "ROL" 69 "FER" 72 "TOY" 123 "MIT" 147 "HYU" 159 "HON" 160 "MAZ" 183 "CU" 190 "LRG" 204 "VVW" 214 "AVT" 242 "Iveco" 243 "DMC" 248 "SUZ" 267 "SSANGYONG" 270 "KEF" 289 "AMG" 308 "TAT" 319 "MVM" 385 "UAES" 590 "Scania" 828 "RBCD" 999 "ALL" 2887 "Nonox" 9454 "Fuso" /end COMPU_VTAB
/begin COMPU_METHOD IGNARCDURMONI_SY_Compu "" TAB_VERB "%6.3" "" COMPU_TAB_REF IGNARCDURMONI_SY_Compu /end COMPU_METHOD
/begin COMPU_VTAB IGNARCDURMONI_SY_Compu "" TAB_VERB 2 0 "Spark Duration Diagnosis Ignition Output inactive" 1 "Spark Duration Diagnosis Ignition Output active" /end COMPU_VTAB
/begin COMPU_METHOD IGNCLMPVLTGDURMON_SC_Compu "" TAB_VERB "%6.3" "" COMPU_TAB_REF IGNCLMPVLTGDURMON_SC_Compu /end COMPU_METHOD
/begin COMPU_VTAB IGNCLMPVLTGDURMON_SC_Compu "" TAB_VERB 2 0 "False" 1 "True" /end COMPU_VTAB
/begin COMPU_METHOD IGNCLPS_BENCHERR_SC_Compu "" TAB_VERB "%6.3" "" COMPU_TAB_REF IGNCLPS_BENCHERR_SC_Compu /end COMPU_METHOD
/begin COMPU_VTAB IGNCLPS_BENCHERR_SC_Compu "" TAB_VERB 3 0 "No bench error (default)" 1 "One bench" 2 "Two benches" /end COMPU_VTAB
/begin COMPU_METHOD IGNCLPS_STADIAENBL_SY_Compu "" TAB_VERB "%6.3" "" COMPU_TAB_REF IGNCLPS_STADIAENBL_SY_Compu /end COMPU_METHOD
/begin COMPU_VTAB IGNCLPS_STADIAENBL_SY_Compu "" TAB_VERB 2 0 "Disable" 1 "Enable" /end COMPU_VTAB
/begin COMPU_METHOD IGNCL_CLCRNTMON_SY_Compu "" TAB_VERB "%6.3" "" COMPU_TAB_REF IGNCL_CLCRNTMON_SY_Compu /end COMPU_METHOD
/begin COMPU_VTAB IGNCL_CLCRNTMON_SY_Compu "" TAB_VERB 4 0 "Inactive(default)" 1 "Active_ADC" 2 "Active_DSADC" 3 "Active_DSADC_cont" /end COMPU_VTAB
/begin COMPU_METHOD IGNCL_INTTEST_SC_Compu "" RAT_FUNC "%6.2" "" COEFFS 0 1 0 0 0 1 /end COMPU_METHOD
/begin COMPU_METHOD IGNCL_QAG_SY_Compu "" TAB_VERB "%6.3" "" COMPU_TAB_REF IGNCL_QAG_SY_Compu /end COMPU_METHOD
/begin COMPU_VTAB IGNCL_QAG_SY_Compu "" TAB_VERB 2 1 "0.75 GradKW" 2 "0.10 GradKW" /end COMPU_VTAB
/begin COMPU_METHOD IGNCL_SPCLCOILDIAG_SC_Compu "" TAB_VERB "%6.3" "" COMPU_TAB_REF IGNCL_SPCLCOILDIAG_SC_Compu /end COMPU_METHOD
/begin COMPU_VTAB IGNCL_SPCLCOILDIAG_SC_Compu "" TAB_VERB 2 0 "COILDIAG_DISABLED" 1 "SPCLFBCKT_ENABLED" /end COMPU_VTAB
/begin COMPU_METHOD IGNCL_SYNCSDL_SC_Compu "" TAB_VERB "%6.3" "" COMPU_TAB_REF IGNCL_SYNCSDL_SC_Compu /end COMPU_METHOD
/begin COMPU_VTAB IGNCL_SYNCSDL_SC_Compu "" TAB_VERB 4 0 "0" 1 "1" 2 "2" 3 "3" /end COMPU_VTAB
/begin COMPU_METHOD IGNCL_VAR_SY_Compu "" TAB_VERB "%6.3" "" COMPU_TAB_REF IGNCL_VAR_SY_Compu /end COMPU_METHOD
/begin COMPU_VTAB IGNCL_VAR_SY_Compu "" TAB_VERB 46 1 "DAI" 3 "VWW" 4 "POR" 5 "AUD" 6 "OPE" 9 "FIA" 11 "BMW" 14 "PSA" 15 "REN" 17 "ALF" 18 "SAB" 19 "VOL" 20 "NIS" 21 "GMU" 22 "FOR" 26 "IMJ" 51 "SEA" 53 "CHR" 54 "JAG" 55 "ROL" 69 "FER" 72 "TOY" 123 "MIT" 147 "HYU" 159 "HON" 160 "MAZ" 183 "CU" 190 "LRG" 204 "VVW" 214 "AVT" 242 "Iveco" 243 "DMC" 248 "SUZ" 267 "SSANGYONG" 268 "BRP-Rotax" 270 "KEF" 289 "AMG" 308 "TAT" 319 "MVM" 385 "UAES" 590 "Scania" 828 "RBCD" 999 "ALL" 2887 "Nonox" 9364 "Enfield" 9454 "Fuso" /end COMPU_VTAB
/begin COMPU_METHOD IGNMDLRRI_SC_Compu "" TAB_VERB "%6.3" "" COMPU_TAB_REF IGNMDLRRI_SC_Compu /end COMPU_METHOD
/begin COMPU_VTAB IGNMDLRRI_SC_Compu "" TAB_VERB 3 0 "NONE" 1 "STANDARD" 2 "ENHANCED" /end COMPU_VTAB
/begin COMPU_METHOD IKCTL_CONTNSADPN_SC_Compu "" TAB_VERB "%6.3" "" COMPU_TAB_REF IKCTL_CONTNSADPN_SC_Compu /end COMPU_METHOD
/begin COMPU_VTAB IKCTL_CONTNSADPN_SC_Compu "" TAB_VERB 2 0 "False" 1 "True" /end COMPU_VTAB
/begin COMPU_METHOD IKCTL_DIDYNDETN_SC_Compu "" TAB_VERB "%6.3" "" COMPU_TAB_REF IKCTL_DIDYNDETN_SC_Compu /end COMPU_METHOD
/begin COMPU_VTAB IKCTL_DIDYNDETN_SC_Compu "" TAB_VERB 2 0 "disable_not_active" 1 "disable_active" /end COMPU_VTAB
/begin COMPU_METHOD IKCTL_IACORRMEASWINBEGIN_SC_Compu "" TAB_VERB "%6.3" "" COMPU_TAB_REF IKCTL_IACORRMEASWINBEGIN_SC_Compu /end COMPU_METHOD
/begin COMPU_VTAB IKCTL_IACORRMEASWINBEGIN_SC_Compu "" TAB_VERB 4 0 "default_calculation" 1 "calculation_with_basis_ignition_angle" 2 "calculation_with_preventive_offset" 3 "calculation_with_dzwwl" /end COMPU_VTAB
/begin COMPU_METHOD IKCTL_IAERLY_SC_Compu "" TAB_VERB "%6.3" "" COMPU_TAB_REF IKCTL_IAERLY_SC_Compu /end COMPU_METHOD
/begin COMPU_VTAB IKCTL_IAERLY_SC_Compu "" TAB_VERB 2 0 "DISABLED" 1 "ENABLED" /end COMPU_VTAB
/begin COMPU_METHOD IKCTL_SECPRMRECACTV_SC_Compu "" TAB_VERB "%6.3" "" COMPU_TAB_REF IKCTL_SECPRMRECACTV_SC_Compu /end COMPU_METHOD
/begin COMPU_VTAB IKCTL_SECPRMRECACTV_SC_Compu "" TAB_VERB 2 0 "False" 1 "True" /end COMPU_VTAB
/begin COMPU_METHOD IKCTL_SFTYIGNRTD_SC_Compu "" TAB_VERB "%6.3" "" COMPU_TAB_REF IKCTL_SFTYIGNRTD_SC_Compu /end COMPU_METHOD
/begin COMPU_VTAB IKCTL_SFTYIGNRTD_SC_Compu "" TAB_VERB 2 0 "False" 1 "True" /end COMPU_VTAB
/begin COMPU_METHOD IKCTL_TSNSR_SC_Compu "" TAB_VERB "%6.3" "" COMPU_TAB_REF IKCTL_TSNSR_SC_Compu /end COMPU_METHOD
/begin COMPU_VTAB IKCTL_TSNSR_SC_Compu "" TAB_VERB 2 0 "CEngDsT_t" 1 "CHdT_t" /end COMPU_VTAB
/begin COMPU_METHOD IKCTL_VAR_SY_Compu "" TAB_VERB "%6.3" "" COMPU_TAB_REF IKCTL_VAR_SY_Compu /end COMPU_METHOD
/begin COMPU_VTAB IKCTL_VAR_SY_Compu "" TAB_VERB 44 1 "DAI" 3 "VWW" 4 "POR" 5 "AUD" 6 "OPE" 9 "FIA" 11 "BMW" 14 "PSA" 15 "REN" 17 "ALF" 18 "SAB" 19 "VOL" 20 "NIS" 21 "GMU" 22 "FOR" 26 "IMJ" 51 "SEA" 53 "CHR" 54 "JAG" 55 "ROL" 69 "FER" 72 "TOY" 123 "MIT" 147 "HYU" 159 "HON" 160 "MAZ" 183 "CU" 190 "LRG" 204 "VVW" 214 "AVT" 242 "Iveco" 243 "DMC" 248 "SUZ" 267 "SSANGYONG" 270 "KEF" 289 "AMG" 308 "TAT" 319 "MVM" 385 "UAES" 590 "Scania" 828 "RBCD" 999 "ALL" 2887 "Nonox" 9454 "Fuso" /end COMPU_VTAB
/begin COMPU_METHOD INDPDTSMALLQNTYADPN_SC_Compu "" TAB_VERB "%6.3" "" COMPU_TAB_REF INDPDTSMALLQNTYADPN_SC_Compu /end COMPU_METHOD
/begin COMPU_VTAB INDPDTSMALLQNTYADPN_SC_Compu "" TAB_VERB 2 0 "False" 1 "True" /end COMPU_VTAB
/begin COMPU_METHOD INHBFPCAFTPROGM_SC_Compu "" TAB_VERB "%6.3" "" COMPU_TAB_REF INHBFPCAFTPROGM_SC_Compu /end COMPU_METHOD
/begin COMPU_VTAB INHBFPCAFTPROGM_SC_Compu "" TAB_VERB 2 0 "False" 1 "True" /end COMPU_VTAB
/begin COMPU_METHOD INHBFPCOILLVLMEAS_SC_Compu "" TAB_VERB "%6.3" "" COMPU_TAB_REF INHBFPCOILLVLMEAS_SC_Compu /end COMPU_METHOD
/begin COMPU_VTAB INHBFPCOILLVLMEAS_SC_Compu "" TAB_VERB 2 0 "False" 1 "True" /end COMPU_VTAB
/begin COMPU_METHOD INJCRV_INJMASSPIIFACT_SY_Compu "" RAT_FUNC "%6.2" "" COEFFS 0 1 0 0 0 1 /end COMPU_METHOD
/begin COMPU_METHOD INJGDI_NUMPRESCIR_SY_Compu "" TAB_VERB "%6.3" "" COMPU_TAB_REF INJGDI_NUMPRESCIR_SY_Compu /end COMPU_METHOD
/begin COMPU_VTAB INJGDI_NUMPRESCIR_SY_Compu "" TAB_VERB 3 0 "No_Pres_Cir" 1 "One_Pres_Cir" 2 "Two_Pres_Cir" /end COMPU_VTAB
/begin COMPU_METHOD INJLIMNHEV_SC_Compu "" TAB_VERB "%6.3" "" COMPU_TAB_REF INJLIMNHEV_SC_Compu /end COMPU_METHOD
/begin COMPU_VTAB INJLIMNHEV_SC_Compu "" TAB_VERB 2 0 "False" 1 "True" /end COMPU_VTAB
/begin COMPU_METHOD InjMass "" RAT_FUNC "%6.4" "mg/hub" COEFFS 0 100 0 0 0 1 /end COMPU_METHOD
/begin COMPU_METHOD InjMassCyc "" RAT_FUNC "%6.4" "mg/cyc" COEFFS 0 100 0 0 0 1 /end COMPU_METHOD
/begin COMPU_METHOD InjMassInj "" RAT_FUNC "%6.4" "mg/inj" COEFFS 0 100 0 0 0 1 /end COMPU_METHOD
/begin COMPU_METHOD InjMassPerTimeHi "" RAT_FUNC "%7.6" "Kg/h" COEFFS 0 10000 0 0 0 1 /end COMPU_METHOD
/begin COMPU_METHOD InjMs_q0p1_COMPU "" RAT_FUNC "%6.3" "mg/hub" COEFFS 0 10 0 0 0 1 /end COMPU_METHOD
/begin COMPU_METHOD InjMs_q0p2_COMPU "" RAT_FUNC "%6.3" "mg/hub" COEFFS 0 5 0 0 0 1 /end COMPU_METHOD
/begin COMPU_METHOD INJNGT_MODE_SC_Compu "" TAB_VERB "%6.3" "" COMPU_TAB_REF INJNGT_MODE_SC_Compu /end COMPU_METHOD
/begin COMPU_VTAB INJNGT_MODE_SC_Compu "" TAB_VERB 3 0 "INJNGT_0_DEG" 1 "INJNGT_360_DEG" 2 "INJNGT_720_DEG" /end COMPU_VTAB
/begin COMPU_METHOD InjQnt "" RAT_FUNC "%6.3" "mm^3/hub" COEFFS 0 10 0 0 0 1 /end COMPU_METHOD
/begin COMPU_METHOD InjQntInj "" RAT_FUNC "%6.4" "mm^3/inj" COEFFS 0 100 0 0 0 1 /end COMPU_METHOD
/begin COMPU_METHOD INJSYG_CYLINDCORRNTSTR_SC_Compu "" TAB_VERB "%6.3" "" COMPU_TAB_REF INJSYG_CYLINDCORRNTSTR_SC_Compu /end COMPU_METHOD
/begin COMPU_VTAB INJSYG_CYLINDCORRNTSTR_SC_Compu "" TAB_VERB 2 0 "False" 1 "True" /end COMPU_VTAB
/begin COMPU_METHOD INJSYG_GDIPFITICONGDI_SC_Compu "" TAB_VERB "%6.3" "" COMPU_TAB_REF INJSYG_GDIPFITICONGDI_SC_Compu /end COMPU_METHOD
/begin COMPU_VTAB INJSYG_GDIPFITICONGDI_SC_Compu "" TAB_VERB 2 0 "False" 1 "True" /end COMPU_VTAB
/begin COMPU_METHOD INJSYG_INJRFLOWADPN_SC_Compu "" TAB_VERB "%6.3" "" COMPU_TAB_REF INJSYG_INJRFLOWADPN_SC_Compu /end COMPU_METHOD
/begin COMPU_VTAB INJSYG_INJRFLOWADPN_SC_Compu "" TAB_VERB 3 0 "NO_ADPN" 1 "BASC_ADPN" 2 "DIAG_BASC_ADPN" /end COMPU_VTAB
/begin COMPU_METHOD INJSYG_INJTMNGSTB_SC_Compu "" TAB_VERB "%6.3" "" COMPU_TAB_REF INJSYG_INJTMNGSTB_SC_Compu /end COMPU_METHOD
/begin COMPU_VTAB INJSYG_INJTMNGSTB_SC_Compu "" TAB_VERB 2 0 "False" 1 "True" /end COMPU_VTAB
/begin COMPU_METHOD INJSYG_INTKTINJRDLYTICORRN_SC_Compu "" TAB_VERB "%6.3" "" COMPU_TAB_REF INJSYG_INTKTINJRDLYTICORRN_SC_Compu /end COMPU_METHOD
/begin COMPU_VTAB INJSYG_INTKTINJRDLYTICORRN_SC_Compu "" TAB_VERB 2 0 "False" 1 "True" /end COMPU_VTAB
/begin COMPU_METHOD INJSYG_TFRKATS_SC_Compu "" TAB_VERB "%6.3" "" COMPU_TAB_REF INJSYG_TFRKATS_SC_Compu /end COMPU_METHOD
/begin COMPU_VTAB INJSYG_TFRKATS_SC_Compu "" TAB_VERB 2 0 "0" 1 "1" /end COMPU_VTAB
/begin COMPU_METHOD INJSYG_VAR_SY_Compu "" TAB_VERB "%6.3" "" COMPU_TAB_REF INJSYG_VAR_SY_Compu /end COMPU_METHOD
/begin COMPU_VTAB INJSYG_VAR_SY_Compu "" TAB_VERB 46 1 "DAI" 3 "VWW" 4 "POR" 5 "AUD" 6 "OPE" 9 "FIA" 11 "BMW" 14 "PSA" 15 "REN" 17 "ALF" 18 "SAB" 19 "VOL" 20 "NIS" 21 "GMU" 22 "FOR" 26 "IMJ" 51 "SEA" 53 "CHR" 54 "JAG" 55 "ROL" 69 "FER" 72 "TOY" 123 "MIT" 147 "HYU" 159 "HON" 160 "MAZ" 183 "CU" 190 "LRG" 204 "VVW" 214 "AVT" 242 "Iveco" 243 "DMC" 248 "SUZ" 267 "SSANGYONG" 270 "KEF" 289 "AMG" 308 "TAT" 319 "MVM" 385 "UAES" 425 "Polaris" 590 "Scania" 828 "RBCD" 999 "ALL" 2887 "Nonox" 9397 "KHI" 9454 "Fuso" /end COMPU_VTAB
/begin COMPU_METHOD INJSYS_AGENDINJCOOLTTSWT_SC_Compu "" TAB_VERB "%6.3" "" COMPU_TAB_REF INJSYS_AGENDINJCOOLTTSWT_SC_Compu /end COMPU_METHOD
/begin COMPU_VTAB INJSYS_AGENDINJCOOLTTSWT_SC_Compu "" TAB_VERB 2 0 "False" 1 "True" /end COMPU_VTAB
/begin COMPU_METHOD INJSYS_COORRINJMODVRNT_SC_Compu "" TAB_VERB "%6.3" "" COMPU_TAB_REF INJSYS_COORRINJMODVRNT_SC_Compu /end COMPU_METHOD
/begin COMPU_VTAB INJSYS_COORRINJMODVRNT_SC_Compu "" TAB_VERB 3 0 "No_CoorrInjMod" 1 "CoorrInjMod_Variant_1" 2 "CoorrInjMod_Variant_2" /end COMPU_VTAB
/begin COMPU_METHOD INJSYS_ESVWDWNSIZED_SC_Compu "" TAB_VERB "%6.3" "" COMPU_TAB_REF INJSYS_ESVWDWNSIZED_SC_Compu /end COMPU_METHOD
/begin COMPU_VTAB INJSYS_ESVWDWNSIZED_SC_Compu "" TAB_VERB 2 0 "False" 1 "True" /end COMPU_VTAB
/begin COMPU_METHOD INJSYS_FUFILLGINJTICALCN_SC_Compu "" TAB_VERB "%6.3" "" COMPU_TAB_REF INJSYS_FUFILLGINJTICALCN_SC_Compu /end COMPU_METHOD
/begin COMPU_VTAB INJSYS_FUFILLGINJTICALCN_SC_Compu "" TAB_VERB 3 0 "0" 1 "1" 2 "2" /end COMPU_VTAB
/begin COMPU_METHOD INJSYS_INJAGADPN_SC_Compu "" TAB_VERB "%6.3" "" COMPU_TAB_REF INJSYS_INJAGADPN_SC_Compu /end COMPU_METHOD
/begin COMPU_VTAB INJSYS_INJAGADPN_SC_Compu "" TAB_VERB 2 0 "0" 1 "1" /end COMPU_VTAB
/begin COMPU_METHOD INJSYS_INJRLEAKFCO_SC_Compu "" TAB_VERB "%6.3" "" COMPU_TAB_REF INJSYS_INJRLEAKFCO_SC_Compu /end COMPU_METHOD
/begin COMPU_VTAB INJSYS_INJRLEAKFCO_SC_Compu "" TAB_VERB 2 0 "False" 1 "True" /end COMPU_VTAB
/begin COMPU_METHOD INJSYS_INJTMNGVRNT_SC_Compu "" TAB_VERB "%6.3" "" COMPU_TAB_REF INJSYS_INJTMNGVRNT_SC_Compu /end COMPU_METHOD
/begin COMPU_VTAB INJSYS_INJTMNGVRNT_SC_Compu "" TAB_VERB 2 0 "InjTiming_Variant_1" 1 "InjTiming_Variant_2" /end COMPU_VTAB
/begin COMPU_METHOD INJSYS_MIXFACAGINJCHG_SC_Compu "" TAB_VERB "%6.3" "" COMPU_TAB_REF INJSYS_MIXFACAGINJCHG_SC_Compu /end COMPU_METHOD
/begin COMPU_VTAB INJSYS_MIXFACAGINJCHG_SC_Compu "" TAB_VERB 2 0 "False" 1 "True" /end COMPU_VTAB
/begin COMPU_METHOD INJSYS_POI1SETPOINT_SY_Compu "" RAT_FUNC "%6.2" "" COEFFS 0 1 0 0 0 1 /end COMPU_METHOD
/begin COMPU_METHOD INJSYS_POI2SETPOINT_SY_Compu "" RAT_FUNC "%6.2" "" COEFFS 0 1 0 0 0 1 /end COMPU_METHOD
/begin COMPU_METHOD INJSYS_POI3SETPOINT_SY_Compu "" RAT_FUNC "%6.2" "" COEFFS 0 1 0 0 0 1 /end COMPU_METHOD
/begin COMPU_METHOD INJSYS_RAILLEAKTST_SY_Compu "" TAB_VERB "%6.3" "" COMPU_TAB_REF INJSYS_RAILLEAKTST_SY_Compu /end COMPU_METHOD
/begin COMPU_VTAB INJSYS_RAILLEAKTST_SY_Compu "" TAB_VERB 2 0 "False" 1 "True" /end COMPU_VTAB
/begin COMPU_METHOD INJSYS_SPCLMIXFAC_SC_Compu "" TAB_VERB "%6.3" "" COMPU_TAB_REF INJSYS_SPCLMIXFAC_SC_Compu /end COMPU_METHOD
/begin COMPU_VTAB INJSYS_SPCLMIXFAC_SC_Compu "" TAB_VERB 2 0 "False" 1 "True" /end COMPU_VTAB
/begin COMPU_METHOD INJSYS_TWNINJR_SC_Compu "" TAB_VERB "%6.3" "" COMPU_TAB_REF INJSYS_TWNINJR_SC_Compu /end COMPU_METHOD
/begin COMPU_VTAB INJSYS_TWNINJR_SC_Compu "" TAB_VERB 2 0 "False" 1 "True" /end COMPU_VTAB
/begin COMPU_METHOD INJSYS_TWOSTEPINJ_SC_Compu "" TAB_VERB "%6.3" "" COMPU_TAB_REF INJSYS_TWOSTEPINJ_SC_Compu /end COMPU_METHOD
/begin COMPU_VTAB INJSYS_TWOSTEPINJ_SC_Compu "" TAB_VERB 2 0 "False" 1 "True" /end COMPU_VTAB
/begin COMPU_METHOD INJSYS_VAR_SY_Compu "" TAB_VERB "%6.3" "" COMPU_TAB_REF INJSYS_VAR_SY_Compu /end COMPU_METHOD
/begin COMPU_VTAB INJSYS_VAR_SY_Compu "" TAB_VERB 47 1 "DAI" 3 "VWW" 4 "POR" 5 "AUD" 6 "OPE" 9 "FIA" 11 "BMW" 14 "PSA" 15 "REN" 16 "Maserati" 17 "ALF" 18 "SAB" 19 "VOL" 20 "NIS" 21 "GMU" 22 "FOR" 26 "IMJ" 35 "CV-OHW PLATFORM DIESEL" 36 "MAN" 51 "SEA" 53 "CHR" 54 "JAG" 55 "ROL" 69 "FER" 72 "TOY" 123 "MIT" 147 "HYU" 159 "HON" 160 "MAZ" 183 "CU" 190 "LRG" 204 "VVW" 214 "AVT" 242 "Iveco" 243 "DMC" 248 "SUZ" 267 "SSANGYONG" 270 "KEF" 289 "AMG" 308 "TAT" 319 "MVM" 328 "MM" 385 "UAES" 828 "RBCD" 898 "MFTBC" 999 "ALL" 9454 "Fuso" /end COMPU_VTAB
/begin COMPU_METHOD InjTimeHiRes_us "" RAT_FUNC "%6.4" "us" COEFFS 0 20 0 0 0 1 /end COMPU_METHOD
/begin COMPU_METHOD InjTime_us "" RAT_FUNC "%6.3" "us" COEFFS 0 2.5 0 0 0 1 /end COMPU_METHOD
/begin COMPU_METHOD INJTMNGDIAGPRS_SC_Compu "" TAB_VERB "%6.3" "" COMPU_TAB_REF INJTMNGDIAGPRS_SC_Compu /end COMPU_METHOD
/begin COMPU_VTAB INJTMNGDIAGPRS_SC_Compu "" TAB_VERB 3 0 "NO_CSERS" 1 "LEVEL1_CSERS" 2 "LEVEL2_CSERS" /end COMPU_VTAB
/begin COMPU_METHOD INJVLVPS_DIASMALLTI_SY_Compu "" TAB_VERB "%6.3" "" COMPU_TAB_REF INJVLVPS_DIASMALLTI_SY_Compu /end COMPU_METHOD
/begin COMPU_VTAB INJVLVPS_DIASMALLTI_SY_Compu "" TAB_VERB 3 0 "NO_DIA_SMALL_TI" 1 "DIA_SMALL_TI" 2 "DIA_SMALL_TI_AND_PIN_POINTING" /end COMPU_VTAB
/begin COMPU_METHOD INJVLV_ATS_SY_Compu "" TAB_VERB "%6.3" "" COMPU_TAB_REF INJVLV_ATS_SY_Compu /end COMPU_METHOD
/begin COMPU_VTAB INJVLV_ATS_SY_Compu "" TAB_VERB 2 0 "False" 1 "True" /end COMPU_VTAB
/begin COMPU_METHOD INJVLV_FSTRCVAFTFCO_SY_Compu "" TAB_VERB "%6.3" "" COMPU_TAB_REF INJVLV_FSTRCVAFTFCO_SY_Compu /end COMPU_METHOD
/begin COMPU_VTAB INJVLV_FSTRCVAFTFCO_SY_Compu "" TAB_VERB 2 0 "OFF" 1 "ON" /end COMPU_VTAB
/begin COMPU_METHOD INJVLV_ONOFF_ATS_SC_Compu "" TAB_VERB "%6.3" "" COMPU_TAB_REF INJVLV_ONOFF_ATS_SC_Compu /end COMPU_METHOD
/begin COMPU_VTAB INJVLV_ONOFF_ATS_SC_Compu "" TAB_VERB 2 0 "False" 1 "True" /end COMPU_VTAB
/begin COMPU_METHOD INJVLV_PSIC_SC_Compu "" TAB_VERB "%6.3" "" COMPU_TAB_REF INJVLV_PSIC_SC_Compu /end COMPU_METHOD
/begin COMPU_VTAB INJVLV_PSIC_SC_Compu "" TAB_VERB 8 0 "CJ841" 1 "CJ870" 2 "CY335" 3 "CY372" 4 "CY375" 5 "SC900685" 6 "CY373" 7 "CY374" /end COMPU_VTAB
/begin COMPU_METHOD INJVLV_PSNR_SC_Compu "" RAT_FUNC "%6.2" "" COEFFS 0 1 0 0 0 1 /end COMPU_METHOD
/begin COMPU_METHOD INJVLV_VLVTYPE_SY_Compu "" TAB_VERB "%6.3" "" COMPU_TAB_REF INJVLV_VLVTYPE_SY_Compu /end COMPU_METHOD
/begin COMPU_VTAB INJVLV_VLVTYPE_SY_Compu "" TAB_VERB 2 1 "SOLENOID" 2 "PIEZO" /end COMPU_VTAB
/begin COMPU_METHOD INJVVG_VAR_SY_Compu "" TAB_VERB "%6.3" "" COMPU_TAB_REF INJVVG_VAR_SY_Compu /end COMPU_METHOD
/begin COMPU_VTAB INJVVG_VAR_SY_Compu "" TAB_VERB 43 1 "DAI" 3 "VWW" 4 "POR" 5 "AUD" 6 "OPE" 9 "FIA" 11 "BMW" 14 "PSA" 15 "REN" 17 "ALF" 18 "SAB" 19 "VOL" 20 "NIS" 21 "GMU" 22 "FOR" 26 "IMJ" 51 "SEA" 53 "CHR" 54 "JAG" 55 "ROL" 69 "FER" 72 "TOY" 123 "MIT" 147 "HYU" 159 "HON" 160 "MAZ" 183 "CU" 190 "LRG" 204 "VVW" 214 "AVT" 242 "Iveco" 243 "DMC" 248 "SUZ" 267 "SSANGYONG" 270 "KEF" 289 "AMG" 308 "TAT" 319 "MVM" 385 "UAES" 828 "RBCD" 898 "MFTBC" 999 "ALL" 9454 "Fuso" /end COMPU_VTAB
/begin COMPU_METHOD InrtTrq_COMPU "" RAT_FUNC "%6.5" "kg*s^2" COEFFS 0 1024 0 0 0 1 /end COMPU_METHOD
/begin COMPU_METHOD INTGMGMT_SC_Compu "" TAB_VERB "%6.3" "" COMPU_TAB_REF INTGMGMT_SC_Compu /end COMPU_METHOD
/begin COMPU_VTAB INTGMGMT_SC_Compu "" TAB_VERB 2 0 "False" 1 "True" /end COMPU_VTAB
/begin COMPU_METHOD INTKAIRTSNSR1TYP_SC_Compu "" TAB_VERB "%6.3" "" COMPU_TAB_REF INTKAIRTSNSR1TYP_SC_Compu /end COMPU_METHOD
/begin COMPU_VTAB INTKAIRTSNSR1TYP_SC_Compu "" TAB_VERB 7 0 "no_snsr" 1 "ADC" 2 "ADC_CrssSwt" 3 "FAS" 4 "SENT" 5 "LIN" 255 "Switch" /end COMPU_VTAB
/begin COMPU_METHOD INTKAIRTSNSR2TYP_SC_Compu "" TAB_VERB "%6.3" "" COMPU_TAB_REF INTKAIRTSNSR2TYP_SC_Compu /end COMPU_METHOD
/begin COMPU_VTAB INTKAIRTSNSR2TYP_SC_Compu "" TAB_VERB 6 0 "no_snsr" 1 "ADC" 2 "ADC_CrssSwt" 3 "FAS" 4 "SENT" 255 "Switch" /end COMPU_VTAB
/begin COMPU_METHOD INTKAIRTSNSR3TYP_SC_Compu "" TAB_VERB "%6.3" "" COMPU_TAB_REF INTKAIRTSNSR3TYP_SC_Compu /end COMPU_METHOD
/begin COMPU_VTAB INTKAIRTSNSR3TYP_SC_Compu "" TAB_VERB 7 0 "no_snsr" 1 "ADC" 2 "ADC_CrssSwt" 3 "FAS" 4 "SENT" 5 "LIN" 255 "Switch" /end COMPU_VTAB
/begin COMPU_METHOD INTKAIRTSNSR4TYP_SC_Compu "" TAB_VERB "%6.3" "" COMPU_TAB_REF INTKAIRTSNSR4TYP_SC_Compu /end COMPU_METHOD
/begin COMPU_VTAB INTKAIRTSNSR4TYP_SC_Compu "" TAB_VERB 6 0 "no_snsr" 1 "ADC" 2 "ADC_CrssSwt" 3 "FAS" 4 "SENT" 255 "Switch" /end COMPU_VTAB
/begin COMPU_METHOD INTKAIRTSNSR5TYP_SC_Compu "" TAB_VERB "%6.3" "" COMPU_TAB_REF INTKAIRTSNSR5TYP_SC_Compu /end COMPU_METHOD
/begin COMPU_VTAB INTKAIRTSNSR5TYP_SC_Compu "" TAB_VERB 6 0 "no_sensor" 1 "ADC" 2 "ADC_CrssSwt" 3 "FAS" 4 "SENT" 255 "Switch" /end COMPU_VTAB
/begin COMPU_METHOD INTKAIRTSNSR6TYP_SC_Compu "" TAB_VERB "%6.3" "" COMPU_TAB_REF INTKAIRTSNSR6TYP_SC_Compu /end COMPU_METHOD
/begin COMPU_VTAB INTKAIRTSNSR6TYP_SC_Compu "" TAB_VERB 6 0 "no_sensor" 1 "ADC" 2 "ADC_CrssSwt" 3 "FAS" 4 "SENT" 255 "Switch" /end COMPU_VTAB
/begin COMPU_METHOD INTKAIRT_AIRFILDSB2_SC_Compu "" TAB_VERB "%6.3" "" COMPU_TAB_REF INTKAIRT_AIRFILDSB2_SC_Compu /end COMPU_METHOD
/begin COMPU_VTAB INTKAIRT_AIRFILDSB2_SC_Compu "" TAB_VERB 3 0 "no_signal" 1 "sensor" 2 "model" /end COMPU_VTAB
/begin COMPU_METHOD INTKAIRT_AIRFILDS_SC_Compu "" TAB_VERB "%6.3" "" COMPU_TAB_REF INTKAIRT_AIRFILDS_SC_Compu /end COMPU_METHOD
/begin COMPU_VTAB INTKAIRT_AIRFILDS_SC_Compu "" TAB_VERB 3 0 "no_signal" 1 "sensor" 2 "model" /end COMPU_VTAB
/begin COMPU_METHOD INTKAIRT_CMPR2USB2_SC_Compu "" TAB_VERB "%6.3" "" COMPU_TAB_REF INTKAIRT_CMPR2USB2_SC_Compu /end COMPU_METHOD
/begin COMPU_VTAB INTKAIRT_CMPR2USB2_SC_Compu "" TAB_VERB 3 0 "no_signal" 1 "sensor" 2 "model" /end COMPU_VTAB
/begin COMPU_METHOD INTKAIRT_CMPR2US_SC_Compu "" TAB_VERB "%6.3" "" COMPU_TAB_REF INTKAIRT_CMPR2US_SC_Compu /end COMPU_METHOD
/begin COMPU_VTAB INTKAIRT_CMPR2US_SC_Compu "" TAB_VERB 3 0 "no_signal" 1 "sensor" 2 "model" /end COMPU_VTAB
/begin COMPU_METHOD INTKAIRT_CMPRDSB2_SC_Compu "" TAB_VERB "%6.3" "" COMPU_TAB_REF INTKAIRT_CMPRDSB2_SC_Compu /end COMPU_METHOD
/begin COMPU_VTAB INTKAIRT_CMPRDSB2_SC_Compu "" TAB_VERB 3 0 "no_signal" 1 "sensor" 2 "model" /end COMPU_VTAB
/begin COMPU_METHOD INTKAIRT_CMPRDS_SC_Compu "" TAB_VERB "%6.3" "" COMPU_TAB_REF INTKAIRT_CMPRDS_SC_Compu /end COMPU_METHOD
/begin COMPU_VTAB INTKAIRT_CMPRDS_SC_Compu "" TAB_VERB 3 0 "no_signal" 1 "sensor" 2 "model" /end COMPU_VTAB
/begin COMPU_METHOD INTKAIRT_INTKMNFLDB2_SC_Compu "" TAB_VERB "%6.3" "" COMPU_TAB_REF INTKAIRT_INTKMNFLDB2_SC_Compu /end COMPU_METHOD
/begin COMPU_VTAB INTKAIRT_INTKMNFLDB2_SC_Compu "" TAB_VERB 3 0 "no_signal" 1 "sensor" 2 "model" /end COMPU_VTAB
/begin COMPU_METHOD INTKAIRT_INTKMNFLDSNSRMDL_SC_Compu "" TAB_VERB "%6.3" "" COMPU_TAB_REF INTKAIRT_INTKMNFLDSNSRMDL_SC_Compu /end COMPU_METHOD
/begin COMPU_VTAB INTKAIRT_INTKMNFLDSNSRMDL_SC_Compu "" TAB_VERB 2 0 "False" 1 "True" /end COMPU_VTAB
/begin COMPU_METHOD INTKAIRT_INTKMNFLD_SC_Compu "" TAB_VERB "%6.3" "" COMPU_TAB_REF INTKAIRT_INTKMNFLD_SC_Compu /end COMPU_METHOD
/begin COMPU_VTAB INTKAIRT_INTKMNFLD_SC_Compu "" TAB_VERB 3 0 "no_signal" 1 "sensor" 2 "model" /end COMPU_VTAB
/begin COMPU_METHOD INTKAIRT_MNFLDICODSB2_SC_Compu "" TAB_VERB "%6.3" "" COMPU_TAB_REF INTKAIRT_MNFLDICODSB2_SC_Compu /end COMPU_METHOD
/begin COMPU_VTAB INTKAIRT_MNFLDICODSB2_SC_Compu "" TAB_VERB 3 0 "no_signal" 1 "sensor" 2 "model" /end COMPU_VTAB
/begin COMPU_METHOD INTKAIRT_MNFLDICODS_SC_Compu "" TAB_VERB "%6.3" "" COMPU_TAB_REF INTKAIRT_MNFLDICODS_SC_Compu /end COMPU_METHOD
/begin COMPU_VTAB INTKAIRT_MNFLDICODS_SC_Compu "" TAB_VERB 3 0 "no_signal" 1 "sensor" 2 "model" /end COMPU_VTAB
/begin COMPU_METHOD INTKAIRT_PID68H_SC_Compu "" TAB_VERB "%6.3" "" COMPU_TAB_REF INTKAIRT_PID68H_SC_Compu /end COMPU_METHOD
/begin COMPU_VTAB INTKAIRT_PID68H_SC_Compu "" TAB_VERB 2 0 "not_part_of_intake_air" 1 "part_of_intake_air" /end COMPU_VTAB
/begin COMPU_METHOD INTKAIRT_PID75H_SC_Compu "" TAB_VERB "%6.3" "" COMPU_TAB_REF INTKAIRT_PID75H_SC_Compu /end COMPU_METHOD
/begin COMPU_VTAB INTKAIRT_PID75H_SC_Compu "" TAB_VERB 2 0 "not_part_of_intake_air" 1 "part_of_intake_air" /end COMPU_VTAB
/begin COMPU_METHOD INTKAIRT_PID76H_SC_Compu "" TAB_VERB "%6.3" "" COMPU_TAB_REF INTKAIRT_PID76H_SC_Compu /end COMPU_METHOD
/begin COMPU_VTAB INTKAIRT_PID76H_SC_Compu "" TAB_VERB 2 0 "not_part_of_intake_air" 1 "part_of_intake_air" /end COMPU_VTAB
/begin COMPU_METHOD INTKAIRT_PID77H_SC_Compu "" TAB_VERB "%6.3" "" COMPU_TAB_REF INTKAIRT_PID77H_SC_Compu /end COMPU_METHOD
/begin COMPU_VTAB INTKAIRT_PID77H_SC_Compu "" TAB_VERB 2 0 "not_part_of_intake_air" 1 "part_of_intake_air" /end COMPU_VTAB
/begin COMPU_METHOD INTKAIRT_SNSR1BNK_SC_Compu "" TAB_VERB "%6.3" "" COMPU_TAB_REF INTKAIRT_SNSR1BNK_SC_Compu /end COMPU_METHOD
/begin COMPU_VTAB INTKAIRT_SNSR1BNK_SC_Compu "" TAB_VERB 3 0 "no_sensor" 1 "Bank_1" 2 "Bank_2" /end COMPU_VTAB
/begin COMPU_METHOD INTKAIRT_SNSR1COLDCRSSCHK_SC_Compu "" TAB_VERB "%6.3" "" COMPU_TAB_REF INTKAIRT_SNSR1COLDCRSSCHK_SC_Compu /end COMPU_METHOD
/begin COMPU_VTAB INTKAIRT_SNSR1COLDCRSSCHK_SC_Compu "" TAB_VERB 2 0 "Disabled" 1 "Enabled" /end COMPU_VTAB
/begin COMPU_METHOD INTKAIRT_SNSR1PLAUSCHK_SC_Compu "" TAB_VERB "%6.3" "" COMPU_TAB_REF INTKAIRT_SNSR1PLAUSCHK_SC_Compu /end COMPU_METHOD
/begin COMPU_VTAB INTKAIRT_SNSR1PLAUSCHK_SC_Compu "" TAB_VERB 2 0 "Disable" 1 "Enable" /end COMPU_VTAB
/begin COMPU_METHOD INTKAIRT_SNSR1PLAUSHSC_SC_Compu "" TAB_VERB "%6.3" "" COMPU_TAB_REF INTKAIRT_SNSR1PLAUSHSC_SC_Compu /end COMPU_METHOD
/begin COMPU_VTAB INTKAIRT_SNSR1PLAUSHSC_SC_Compu "" TAB_VERB 2 0 "False" 1 "True" /end COMPU_VTAB
/begin COMPU_METHOD INTKAIRT_SNSR1PLAUSPRC_SC_Compu "" TAB_VERB "%6.3" "" COMPU_TAB_REF INTKAIRT_SNSR1PLAUSPRC_SC_Compu /end COMPU_METHOD
/begin COMPU_VTAB INTKAIRT_SNSR1PLAUSPRC_SC_Compu "" TAB_VERB 3 0 "Disabled" 1 "Sensor_Voltage" 2 "Sensor_Temperature" /end COMPU_VTAB
/begin COMPU_METHOD INTKAIRT_SNSR1PLAUSSTUCKCHK_SC_Compu "" TAB_VERB "%6.3" "" COMPU_TAB_REF INTKAIRT_SNSR1PLAUSSTUCKCHK_SC_Compu /end COMPU_METHOD
/begin COMPU_VTAB INTKAIRT_SNSR1PLAUSSTUCKCHK_SC_Compu "" TAB_VERB 2 0 "Disabled" 1 "Enabled" /end COMPU_VTAB
/begin COMPU_METHOD INTKAIRT_SNSR1POS_SC_Compu "" TAB_VERB "%6.3" "" COMPU_TAB_REF INTKAIRT_SNSR1POS_SC_Compu /end COMPU_METHOD
/begin COMPU_VTAB INTKAIRT_SNSR1POS_SC_Compu "" TAB_VERB 7 0 "no_sensor" 1 "IntkMnfld" 2 "MnfldIcoDs" 3 "ThrVlvUs" 4 "CmprDs" 5 "AirFltDs" 6 "Cmpr2Us" /end COMPU_VTAB
/begin COMPU_METHOD INTKAIRT_SNSR1PWRSPLY_SC_Compu "" TAB_VERB "%6.3" "" COMPU_TAB_REF INTKAIRT_SNSR1PWRSPLY_SC_Compu /end COMPU_METHOD
/begin COMPU_VTAB INTKAIRT_SNSR1PWRSPLY_SC_Compu "" TAB_VERB 4 0 "PWRSPLY_DEACTIVATE" 1 "PWRSPLY1" 2 "PWRSPLY2" 3 "PWRSPLY3" /end COMPU_VTAB
/begin COMPU_METHOD INTKAIRT_SNSR1SENTTYP_SC_Compu "" TAB_VERB "%6.3" "" COMPU_TAB_REF INTKAIRT_SNSR1SENTTYP_SC_Compu /end COMPU_METHOD
/begin COMPU_VTAB INTKAIRT_SNSR1SENTTYP_SC_Compu "" TAB_VERB 6 0 "no_SENT" 1 "Fast_Channel_HFM" 2 "Slow_Channel_HFM_T_CMF" 3 "Slow_Channel_HFM_T_NTC" 4 "Fast_Channel_TMAP" 5 "Fast_Channel_PFM" /end COMPU_VTAB
/begin COMPU_METHOD INTKAIRT_SNSR2BNK_SC_Compu "" TAB_VERB "%6.3" "" COMPU_TAB_REF INTKAIRT_SNSR2BNK_SC_Compu /end COMPU_METHOD
/begin COMPU_VTAB INTKAIRT_SNSR2BNK_SC_Compu "" TAB_VERB 3 0 "no_Sensor" 1 "Bank_1" 2 "Bank_2" /end COMPU_VTAB
/begin COMPU_METHOD INTKAIRT_SNSR2COLDCRSSCHK_SC_Compu "" TAB_VERB "%6.3" "" COMPU_TAB_REF INTKAIRT_SNSR2COLDCRSSCHK_SC_Compu /end COMPU_METHOD
/begin COMPU_VTAB INTKAIRT_SNSR2COLDCRSSCHK_SC_Compu "" TAB_VERB 2 0 "Disabled" 1 "Enabled" /end COMPU_VTAB
/begin COMPU_METHOD INTKAIRT_SNSR2PLAUSCHK_SC_Compu "" TAB_VERB "%6.3" "" COMPU_TAB_REF INTKAIRT_SNSR2PLAUSCHK_SC_Compu /end COMPU_METHOD
/begin COMPU_VTAB INTKAIRT_SNSR2PLAUSCHK_SC_Compu "" TAB_VERB 2 0 "Disabled" 1 "Enabled" /end COMPU_VTAB
/begin COMPU_METHOD INTKAIRT_SNSR2PLAUSHSC_SC_Compu "" TAB_VERB "%6.3" "" COMPU_TAB_REF INTKAIRT_SNSR2PLAUSHSC_SC_Compu /end COMPU_METHOD
/begin COMPU_VTAB INTKAIRT_SNSR2PLAUSHSC_SC_Compu "" TAB_VERB 2 0 "False" 1 "True" /end COMPU_VTAB
/begin COMPU_METHOD INTKAIRT_SNSR2PLAUSPRC_SC_Compu "" TAB_VERB "%6.3" "" COMPU_TAB_REF INTKAIRT_SNSR2PLAUSPRC_SC_Compu /end COMPU_METHOD
/begin COMPU_VTAB INTKAIRT_SNSR2PLAUSPRC_SC_Compu "" TAB_VERB 3 0 "Disabled" 1 "Sensor_Voltage" 2 "Sensor_Temperature" /end COMPU_VTAB
/begin COMPU_METHOD INTKAIRT_SNSR2PLAUSSTUCKCHK_SC_Compu "" TAB_VERB "%6.3" "" COMPU_TAB_REF INTKAIRT_SNSR2PLAUSSTUCKCHK_SC_Compu /end COMPU_METHOD
/begin COMPU_VTAB INTKAIRT_SNSR2PLAUSSTUCKCHK_SC_Compu "" TAB_VERB 2 0 "Disabled" 1 "Enabled" /end COMPU_VTAB
/begin COMPU_METHOD INTKAIRT_SNSR2POS_SC_Compu "" TAB_VERB "%6.3" "" COMPU_TAB_REF INTKAIRT_SNSR2POS_SC_Compu /end COMPU_METHOD
/begin COMPU_VTAB INTKAIRT_SNSR2POS_SC_Compu "" TAB_VERB 7 0 "no_sensor" 1 "IntkMnfld" 2 "MnfldIcoDs" 3 "ThrVlvUs" 4 "CmprDs" 5 "AirFltDs" 6 "Cmpr2Us" /end COMPU_VTAB
/begin COMPU_METHOD INTKAIRT_SNSR2PWRSPLY_SC_Compu "" TAB_VERB "%6.3" "" COMPU_TAB_REF INTKAIRT_SNSR2PWRSPLY_SC_Compu /end COMPU_METHOD
/begin COMPU_VTAB INTKAIRT_SNSR2PWRSPLY_SC_Compu "" TAB_VERB 4 0 "PWRSPLY_DEACTIVATE" 1 "PWRSPLY1" 2 "PWRSPLY2" 3 "PWRSPLY3" /end COMPU_VTAB
/begin COMPU_METHOD INTKAIRT_SNSR2SENTTYP_SC_Compu "" TAB_VERB "%6.3" "" COMPU_TAB_REF INTKAIRT_SNSR2SENTTYP_SC_Compu /end COMPU_METHOD
/begin COMPU_VTAB INTKAIRT_SNSR2SENTTYP_SC_Compu "" TAB_VERB 5 0 "no_SENT" 1 "Fast_Channel_HFM" 2 "Slow_Channel_HFM_T_CMF" 3 "Slow_Channel_HFM_T_NTC" 4 "Fast_Channel_TMAP" /end COMPU_VTAB
/begin COMPU_METHOD INTKAIRT_SNSR3BNK_SC_Compu "" TAB_VERB "%6.3" "" COMPU_TAB_REF INTKAIRT_SNSR3BNK_SC_Compu /end COMPU_METHOD
/begin COMPU_VTAB INTKAIRT_SNSR3BNK_SC_Compu "" TAB_VERB 3 0 "no_Sensor" 1 "Bank_1" 2 "Bank_2" /end COMPU_VTAB
/begin COMPU_METHOD INTKAIRT_SNSR3COLDCRSSCHK_SC_Compu "" TAB_VERB "%6.3" "" COMPU_TAB_REF INTKAIRT_SNSR3COLDCRSSCHK_SC_Compu /end COMPU_METHOD
/begin COMPU_VTAB INTKAIRT_SNSR3COLDCRSSCHK_SC_Compu "" TAB_VERB 2 0 "Disabled" 1 "Enabled" /end COMPU_VTAB
/begin COMPU_METHOD INTKAIRT_SNSR3PLAUSCHK_SC_Compu "" TAB_VERB "%6.3" "" COMPU_TAB_REF INTKAIRT_SNSR3PLAUSCHK_SC_Compu /end COMPU_METHOD
/begin COMPU_VTAB INTKAIRT_SNSR3PLAUSCHK_SC_Compu "" TAB_VERB 2 0 "Disabled" 1 "Enabled" /end COMPU_VTAB
/begin COMPU_METHOD INTKAIRT_SNSR3PLAUSHSC_SC_Compu "" TAB_VERB "%6.3" "" COMPU_TAB_REF INTKAIRT_SNSR3PLAUSHSC_SC_Compu /end COMPU_METHOD
/begin COMPU_VTAB INTKAIRT_SNSR3PLAUSHSC_SC_Compu "" TAB_VERB 2 0 "False" 1 "True" /end COMPU_VTAB
/begin COMPU_METHOD INTKAIRT_SNSR3PLAUSPRC_SC_Compu "" TAB_VERB "%6.3" "" COMPU_TAB_REF INTKAIRT_SNSR3PLAUSPRC_SC_Compu /end COMPU_METHOD
/begin COMPU_VTAB INTKAIRT_SNSR3PLAUSPRC_SC_Compu "" TAB_VERB 3 0 "Disabled" 1 "Sensor_Voltage" 2 "Sensor_Temperature" /end COMPU_VTAB
/begin COMPU_METHOD INTKAIRT_SNSR3PLAUSSTUCKCHK_SC_Compu "" TAB_VERB "%6.3" "" COMPU_TAB_REF INTKAIRT_SNSR3PLAUSSTUCKCHK_SC_Compu /end COMPU_METHOD
/begin COMPU_VTAB INTKAIRT_SNSR3PLAUSSTUCKCHK_SC_Compu "" TAB_VERB 2 0 "Disabled" 1 "Enabled" /end COMPU_VTAB
/begin COMPU_METHOD INTKAIRT_SNSR3POS_SC_Compu "" TAB_VERB "%6.3" "" COMPU_TAB_REF INTKAIRT_SNSR3POS_SC_Compu /end COMPU_METHOD
/begin COMPU_VTAB INTKAIRT_SNSR3POS_SC_Compu "" TAB_VERB 7 0 "no_sensor" 1 "IntkMnfld" 2 "MnfldIcoDs" 3 "ThrVlvUs" 4 "CmprDs" 5 "AirFltDs" 6 "Cmpr2Us" /end COMPU_VTAB
/begin COMPU_METHOD INTKAIRT_SNSR3PWRSPLY_SC_Compu "" TAB_VERB "%6.3" "" COMPU_TAB_REF INTKAIRT_SNSR3PWRSPLY_SC_Compu /end COMPU_METHOD
/begin COMPU_VTAB INTKAIRT_SNSR3PWRSPLY_SC_Compu "" TAB_VERB 4 0 "PWRSPLY_DEACTIVATE" 1 "PWRSPLY1" 2 "PWRSPLY2" 3 "PWRSPLY3" /end COMPU_VTAB
/begin COMPU_METHOD INTKAIRT_SNSR4BNK_SC_Compu "" TAB_VERB "%6.3" "" COMPU_TAB_REF INTKAIRT_SNSR4BNK_SC_Compu /end COMPU_METHOD
/begin COMPU_VTAB INTKAIRT_SNSR4BNK_SC_Compu "" TAB_VERB 3 0 "no_Sensor" 1 "Bank_1" 2 "Bank_2" /end COMPU_VTAB
/begin COMPU_METHOD lu_MEx "" RAT_FUNC "%6.4" "(Umdr./sec)^2" COEFFS 0 140.7374884 0 0 0 1 /end COMPU_METHOD
/begin COMPU_METHOD lu_MEx_div_8 "" RAT_FUNC "%6.4" "(Umdr./sec)^2" COEFFS 0 17.592186044416 0 0 0 1 /end COMPU_METHOD
/begin COMPU_METHOD OneToOne "" RAT_FUNC "%6.2" "-" COEFFS 0 1 0 0 0 1 /end COMPU_METHOD
/begin COMPU_METHOD OneToOne_ms "" RAT_FUNC "%6.2" "ms" COEFFS 0 1 0 0 0 1 /end COMPU_METHOD
/begin COMPU_METHOD OneToOne_us "" RAT_FUNC "%6.2" "us" COEFFS 0 1 0 0 0 1 /end COMPU_METHOD
/begin COMPU_METHOD Per_Dur "" RAT_FUNC "%6.2" "usec" COEFFS 0 1 0 0 0 1 /end COMPU_METHOD
/begin COMPU_METHOD Prc_q0p01_COMPU "" RAT_FUNC "%6.4" "%" COEFFS 0 100 0 0 0 1 /end COMPU_METHOD
/begin COMPU_METHOD RBPtCel_ag_1p373291em3_1 "" RAT_FUNC "%6.4" "degCrS" COEFFS 0 7281777777776 0 0 0 10000000000 /end COMPU_METHOD
/begin COMPU_METHOD RBPtCel_dn_0p125_1 "" RAT_FUNC "%6.3" "rpm/s" COEFFS 0 8 0 0 0 1 /end COMPU_METHOD
/begin COMPU_METHOD RBPtCel_n_0p125_1 "" RAT_FUNC "%6.3" "rpm" COEFFS 0 8 0 0 0 1 /end COMPU_METHOD
/begin COMPU_METHOD RBPtCel_ti_50p0_1 "" RAT_FUNC "%6.1" "ns" COEFFS 0 1 0 0 0 50 /end COMPU_METHOD
/begin COMPU_METHOD RBPtCel_t_0p1om273p14_1 "" RAT_FUNC "%6.1" "Deg C" COEFFS 0 10 2731.4 0 0 1 /end COMPU_METHOD
/begin COMPU_METHOD rel_q0p09375 "" RAT_FUNC "%6.3" "%" COEFFS 0 1 0 0 0 0.09375 /end COMPU_METHOD
/begin COMPU_METHOD rel_uw_b100 "" RAT_FUNC "%6.4" "%" COEFFS 0 65536 0 0 0 100 /end COMPU_METHOD
/begin COMPU_METHOD RevCnt "" RAT_FUNC "%6.4" "-" COEFFS 0 16 0 0 0 1 /end COMPU_METHOD
/begin COMPU_METHOD t100msxs_uw_b6553p5 "" RAT_FUNC "%6.3" "s" COEFFS 0 1 0 0 0 0.1 /end COMPU_METHOD
/begin COMPU_METHOD Temp_Cels "" RAT_FUNC "%6.1" "deg C" COEFFS 0 10 2731.4 0 0 1 /end COMPU_METHOD
/begin COMPU_METHOD temp_ub_q0p75_o48 "" RAT_FUNC "%6.2" "Grad C" COEFFS 0 1 48 0 0 0.75 /end COMPU_METHOD
/begin COMPU_METHOD TimeDelay_ms "" RAT_FUNC "%13.2" "ms" COEFFS 0 0 1 0 2.3283064365387e-007 0 /end COMPU_METHOD
/begin COMPU_METHOD Time_ms "" RAT_FUNC "%6.1" "ms" COEFFS 0 0.1 0 0 0 1 /end COMPU_METHOD
/begin COMPU_METHOD Time_ns_to_us "" RAT_FUNC "%6.5" "us" COEFFS 0 1000 0 0 0 1 /end COMPU_METHOD
/begin COMPU_METHOD Trq "" RAT_FUNC "%6.3" "Nm" COEFFS 0 10 0 0 0 1 /end COMPU_METHOD
/begin COMPU_METHOD t_q0p01_us "" RAT_FUNC "%6.4" "us" COEFFS 0 100 0 0 0 1 /end COMPU_METHOD
/begin COMPU_METHOD t_q10_ms "" RAT_FUNC "%6.1" "ms" COEFFS 0 1 0 0 0 10 /end COMPU_METHOD
/begin COMPU_METHOD vel_q0p01 "" RAT_FUNC "%6.4" "km/h" COEFFS 0 100 0 0 0 1 /end COMPU_METHOD
/begin COMPU_METHOD default "" RAT_FUNC "%6.2" "" COEFFS 0 1 0 0 0 1 /end COMPU_METHOD
/begin RECORD_LAYOUT Cur_Xs16Ws16 NO_AXIS_PTS_X 1 SWORD AXIS_PTS_X 2 SWORD INDEX_INCR DIRECT FNC_VALUES 3 SWORD COLUMN_DIR DIRECT /end RECORD_LAYOUT
/begin RECORD_LAYOUT RB_Curve_S16_S16 NO_AXIS_PTS_X 1 SWORD AXIS_PTS_X 2 SWORD INDEX_INCR DIRECT FNC_VALUES 3 SWORD COLUMN_DIR DIRECT /end RECORD_LAYOUT
/begin RECORD_LAYOUT RB_Curve_S16_U16_Static NO_AXIS_PTS_X 1 SWORD AXIS_PTS_X 2 SWORD INDEX_INCR DIRECT FNC_VALUES 3 UWORD COLUMN_DIR DIRECT STATIC_RECORD_LAYOUT /end RECORD_LAYOUT
/begin RECORD_LAYOUT RB_Curve_U8_U16_Static NO_AXIS_PTS_X 1 UBYTE AXIS_PTS_X 2 UBYTE INDEX_INCR DIRECT FNC_VALUES 3 UWORD COLUMN_DIR DIRECT STATIC_RECORD_LAYOUT /end RECORD_LAYOUT
/begin RECORD_LAYOUT RB_Map_U8U16_U16 NO_AXIS_PTS_X 1 UBYTE NO_AXIS_PTS_Y 2 UBYTE AXIS_PTS_X 3 UBYTE INDEX_INCR DIRECT AXIS_PTS_Y 4 UWORD INDEX_INCR DIRECT FNC_VALUES 5 UWORD ROW_DIR DIRECT /end RECORD_LAYOUT
/begin RECORD_LAYOUT RB_Map_U8U16_U8 NO_AXIS_PTS_X 1 UBYTE NO_AXIS_PTS_Y 2 UBYTE AXIS_PTS_X 3 UBYTE INDEX_INCR DIRECT AXIS_PTS_Y 4 UWORD INDEX_INCR DIRECT FNC_VALUES 5 UBYTE ROW_DIR DIRECT /end RECORD_LAYOUT
/begin RECORD_LAYOUT RB_Val_Ws16 FNC_VALUES 1 SWORD COLUMN_DIR DIRECT /end RECORD_LAYOUT
/begin RECORD_LAYOUT RB_Val_Wu16 FNC_VALUES 1 UWORD COLUMN_DIR DIRECT /end RECORD_LAYOUT
/begin RECORD_LAYOUT RB_Val_Wu8 FNC_VALUES 1 UBYTE COLUMN_DIR DIRECT /end RECORD_LAYOUT
/begin RECORD_LAYOUT ValA_Ws16 FNC_VALUES 1 SWORD COLUMN_DIR DIRECT /end RECORD_LAYOUT
/begin RECORD_LAYOUT ValA_Ws32 FNC_VALUES 1 SLONG COLUMN_DIR DIRECT /end RECORD_LAYOUT
/begin RECORD_LAYOUT ValA_Wu8 FNC_VALUES 1 UBYTE COLUMN_DIR DIRECT /end RECORD_LAYOUT
/begin RECORD_LAYOUT Val_Ws16 FNC_VALUES 1 SWORD COLUMN_DIR DIRECT /end RECORD_LAYOUT
/begin RECORD_LAYOUT Val_Ws32 FNC_VALUES 1 SLONG COLUMN_DIR DIRECT /end RECORD_LAYOUT
/begin RECORD_LAYOUT Val_Wu16 FNC_VALUES 1 UWORD COLUMN_DIR DIRECT /end RECORD_LAYOUT
/begin RECORD_LAYOUT Val_Wu32 FNC_VALUES 1 ULONG COLUMN_DIR DIRECT /end RECORD_LAYOUT
/begin RECORD_LAYOUT Val_Wu8 FNC_VALUES 1 UBYTE COLUMN_DIR DIRECT /end RECORD_LAYOUT
/end MODULE
/end PROJECT
