ASAP2_VERSION 1 60
/begin PROJECT MG1CA020 "MG1CA020"
/begin HEADER "" VERSION "MG1CA020_6SAY_V011_TPROT" PROJECT_NO MG1CA020 /end HEADER
/begin MODULE DIM ""
/begin MOD_COMMON "" BYTE_ORDER MSB_LAST ALIGNMENT_BYTE 1 ALIGNMENT_WORD 2 ALIGNMENT_LONG 4 ALIGNMENT_INT64 4 ALIGNMENT_FLOAT32_IEEE 4 ALIGNMENT_FLOAT64_IEEE 4 DATA_SIZE 32 /end MOD_COMMON
/begin CHARACTERISTIC DFES_EnvRef.DFC_ComEAT8TOut_C "used environment signals / Reference to used environment condition set for check DFC_ComEAT8TOut" VALUE 0x804F98D6 Val_Wu8 1.00000000000 DFES_EnvTabVerb 0.00 1.00000000000 FORMAT "%13.11" /end CHARACTERISTIC
/begin CHARACTERISTIC DFES_EnvRef.DFC_ComEATAChksum_C "used environment signals / Reference to used environment condition set for check DFC_ComEATAChksum" VALUE 0x804F98D7 Val_Wu8 1.00000000000 DFES_EnvTabVerb 0.00 1.00000000000 FORMAT "%13.11" /end CHARACTERISTIC
/begin CHARACTERISTIC DFES_EnvRef.DFC_ComEATARingCnt_C "used environment signals / Reference to used environment condition set for check DFC_ComEATARingCnt" VALUE 0x804F98D8 Val_Wu8 1.00000000000 DFES_EnvTabVerb 0.00 1.00000000000 FORMAT "%13.11" /end CHARACTERISTIC
/begin CHARACTERISTIC DFES_EnvRef.DFC_ComEATATOut_C "used environment signals / Reference to used environment condition set for check DFC_ComEATATOut" VALUE 0x804F98D9 Val_Wu8 1.00000000000 DFES_EnvTabVerb 0.00 1.00000000000 FORMAT "%13.11" /end CHARACTERISTIC
/begin CHARACTERISTIC DFES_EnvRef.DFC_ComEATBChkSum_C "used environment signals / Reference to used environment condition set for check DFC_ComEATBChkSum" VALUE 0x804F98DA Val_Wu8 1.00000000000 DFES_EnvTabVerb 0.00 1.00000000000 FORMAT "%13.11" /end CHARACTERISTIC
/begin CHARACTERISTIC DFES_EnvRef.DFC_ComEATBRingCnt_C "used environment signals / Reference to used environment condition set for check DFC_ComEATBRingCnt" VALUE 0x804F98DB Val_Wu8 1.00000000000 DFES_EnvTabVerb 0.00 1.00000000000 FORMAT "%13.11" /end CHARACTERISTIC
/begin CHARACTERISTIC DFES_EnvRef.DFC_ComEATBTOut_C "used environment signals / Reference to used environment condition set for check DFC_ComEATBTOut" VALUE 0x804F98DC Val_Wu8 1.00000000000 DFES_EnvTabVerb 0.00 1.00000000000 FORMAT "%13.11" /end CHARACTERISTIC
/begin CHARACTERISTIC DFES_EnvRef.DFC_ComEATCChksum_C "used environment signals / Reference to used environment condition set for check DFC_ComEATCChksum" VALUE 0x804F98DD Val_Wu8 1.00000000000 DFES_EnvTabVerb 0.00 1.00000000000 FORMAT "%13.11" /end CHARACTERISTIC
/begin CHARACTERISTIC DFES_EnvRef.DFC_ComEATCRingCnt_C "used environment signals / Reference to used environment condition set for check DFC_ComEATCRingCnt" VALUE 0x804F98DE Val_Wu8 1.00000000000 DFES_EnvTabVerb 0.00 1.00000000000 FORMAT "%13.11" /end CHARACTERISTIC
/begin CHARACTERISTIC DFES_EnvRef.DFC_ComEATCTOut_C "used environment signals / Reference to used environment condition set for check DFC_ComEATCTOut" VALUE 0x804F98DF Val_Wu8 1.00000000000 DFES_EnvTabVerb 0.00 1.00000000000 FORMAT "%13.11" /end CHARACTERISTIC
/begin CHARACTERISTIC DFES_EnvRef.DFC_ComEBBAChksum_C "used environment signals / Reference to used environment condition set for check DFC_ComEBBAChksum" VALUE 0x804F98E0 Val_Wu8 1.00000000000 DFES_EnvTabVerb 0.00 1.00000000000 FORMAT "%13.11" /end CHARACTERISTIC
/begin CHARACTERISTIC DFES_EnvRef.DFC_ComEBBARingCnt_C "used environment signals / Reference to used environment condition set for check DFC_ComEBBARingCnt" VALUE 0x804F98E1 Val_Wu8 1.00000000000 DFES_EnvTabVerb 0.00 1.00000000000 FORMAT "%13.11" /end CHARACTERISTIC
/begin CHARACTERISTIC DFES_EnvRef.DFC_ComEBBATOut_C "used environment signals / Reference to used environment condition set for check DFC_ComEBBATOut" VALUE 0x804F98E2 Val_Wu8 1.00000000000 DFES_EnvTabVerb 0.00 1.00000000000 FORMAT "%13.11" /end CHARACTERISTIC
/begin CHARACTERISTIC DFES_EnvRef.DFC_ComEPS1Chksum_C "used environment signals / Reference to used environment condition set for check DFC_ComEPS1Chksum" VALUE 0x804F98E3 Val_Wu8 1.00000000000 DFES_EnvTabVerb 0.00 1.00000000000 FORMAT "%13.11" /end CHARACTERISTIC
/begin CHARACTERISTIC DFES_EnvRef.DFC_ComEPS1RingCnt_C "used environment signals / Reference to used environment condition set for check DFC_ComEPS1RingCnt" VALUE 0x804F98E4 Val_Wu8 1.00000000000 DFES_EnvTabVerb 0.00 1.00000000000 FORMAT "%13.11" /end CHARACTERISTIC
/begin CHARACTERISTIC DFES_EnvRef.DFC_ComEPS1TOut_C "used environment signals / Reference to used environment condition set for check DFC_ComEPS1TOut" VALUE 0x804F98E5 Val_Wu8 1.00000000000 DFES_EnvTabVerb 0.00 1.00000000000 FORMAT "%13.11" /end CHARACTERISTIC
/begin CHARACTERISTIC DFES_EnvRef.DFC_ComEngCanRxErr_C "used environment signals / Reference to used environment condition set for check DFC_ComEngCanRxErr" VALUE 0x804F98E6 Val_Wu8 1.00000000000 DFES_EnvTabVerb 0.00 1.00000000000 FORMAT "%13.11" /end CHARACTERISTIC
/begin CHARACTERISTIC DFES_EnvRef.DFC_ComGrvySnsrErr_C "used environment signals / Reference to used environment condition set for check DFC_ComGrvySnsrErr" VALUE 0x804F98E7 Val_Wu8 1.00000000000 DFES_EnvTabVerb 0.00 1.00000000000 FORMAT "%13.11" /end CHARACTERISTIC
/begin CHARACTERISTIC DFES_EnvRef.DFC_ComGwIMG1ChkSum_C "used environment signals / Reference to used environment condition set for check DFC_ComGwIMG1ChkSum" VALUE 0x804F98E8 Val_Wu8 1.00000000000 DFES_EnvTabVerb 0.00 1.00000000000 FORMAT "%13.11" /end CHARACTERISTIC
/begin CHARACTERISTIC DFES_EnvRef.DFC_ComGwIMG1RingCnt_C "used environment signals / Reference to used environment condition set for check DFC_ComGwIMG1RingCnt" VALUE 0x804F98E9 Val_Wu8 1.00000000000 DFES_EnvTabVerb 0.00 1.00000000000 FORMAT "%13.11" /end CHARACTERISTIC
/begin CHARACTERISTIC DFES_EnvRef.DFC_ComGwIMG1TOut_C "used environment signals / Reference to used environment condition set for check DFC_ComGwIMG1TOut" VALUE 0x804F98EA Val_Wu8 1.00000000000 DFES_EnvTabVerb 0.00 1.00000000000 FORMAT "%13.11" /end CHARACTERISTIC
/begin CHARACTERISTIC DFES_EnvRef.DFC_ComGwIMG3ChkSum_C "used environment signals / Reference to used environment condition set for check DFC_ComGwIMG3ChkSum" VALUE 0x804F98EB Val_Wu8 1.00000000000 DFES_EnvTabVerb 0.00 1.00000000000 FORMAT "%13.11" /end CHARACTERISTIC
/begin CHARACTERISTIC DFES_EnvRef.DFC_ComGwIMG3RingCnt_C "used environment signals / Reference to used environment condition set for check DFC_ComGwIMG3RingCnt" VALUE 0x804F98EC Val_Wu8 1.00000000000 DFES_EnvTabVerb 0.00 1.00000000000 FORMAT "%13.11" /end CHARACTERISTIC
/begin CHARACTERISTIC DFES_EnvRef.DFC_ComGwIMG3TOut_C "used environment signals / Reference to used environment condition set for check DFC_ComGwIMG3TOut" VALUE 0x804F98ED Val_Wu8 1.00000000000 DFES_EnvTabVerb 0.00 1.00000000000 FORMAT "%13.11" /end CHARACTERISTIC
/begin CHARACTERISTIC DFES_EnvRef.DFC_ComGwIMG4ChkSum_C "used environment signals / Reference to used environment condition set for check DFC_ComGwIMG4ChkSum" VALUE 0x804F98EE Val_Wu8 1.00000000000 DFES_EnvTabVerb 0.00 1.00000000000 FORMAT "%13.11" /end CHARACTERISTIC
/begin CHARACTERISTIC DFES_EnvRef.DFC_ComGwIMG4RingCnt_C "used environment signals / Reference to used environment condition set for check DFC_ComGwIMG4RingCnt" VALUE 0x804F98EF Val_Wu8 1.00000000000 DFES_EnvTabVerb 0.00 1.00000000000 FORMAT "%13.11" /end CHARACTERISTIC
/begin CHARACTERISTIC DFES_EnvRef.DFC_ComGwIMG4TOut_C "used environment signals / Reference to used environment condition set for check DFC_ComGwIMG4TOut" VALUE 0x804F98F0 Val_Wu8 1.00000000000 DFES_EnvTabVerb 0.00 1.00000000000 FORMAT "%13.11" /end CHARACTERISTIC
/begin CHARACTERISTIC DFES_EnvRef.DFC_ComGwIMG5ChkSum_C "used environment signals / Reference to used environment condition set for check DFC_ComGwIMG5ChkSum" VALUE 0x804F98F1 Val_Wu8 1.00000000000 DFES_EnvTabVerb 0.00 1.00000000000 FORMAT "%13.11" /end CHARACTERISTIC
/begin CHARACTERISTIC DFES_EnvRef.DFC_ComGwIMG5RingCnt_C "used environment signals / Reference to used environment condition set for check DFC_ComGwIMG5RingCnt" VALUE 0x804F98F2 Val_Wu8 1.00000000000 DFES_EnvTabVerb 0.00 1.00000000000 FORMAT "%13.11" /end CHARACTERISTIC
/begin CHARACTERISTIC DFES_EnvRef.DFC_ComGwIMG5TOut_C "used environment signals / Reference to used environment condition set for check DFC_ComGwIMG5TOut" VALUE 0x804F98F3 Val_Wu8 1.00000000000 DFES_EnvTabVerb 0.00 1.00000000000 FORMAT "%13.11" /end CHARACTERISTIC
/begin CHARACTERISTIC DFES_EnvRef.DFC_ComGwIMG6ChkSum_C "used environment signals / Reference to used environment condition set for check DFC_ComGwIMG6ChkSum" VALUE 0x804F98F4 Val_Wu8 1.00000000000 DFES_EnvTabVerb 0.00 1.00000000000 FORMAT "%13.11" /end CHARACTERISTIC
/begin CHARACTERISTIC DFES_EnvRef.DFC_ComGwIMG6RingCnt_C "used environment signals / Reference to used environment condition set for check DFC_ComGwIMG6RingCnt" VALUE 0x804F98F5 Val_Wu8 1.00000000000 DFES_EnvTabVerb 0.00 1.00000000000 FORMAT "%13.11" /end CHARACTERISTIC
/begin CHARACTERISTIC DFES_EnvRef.DFC_ComGwIMG6TOut_C "used environment signals / Reference to used environment condition set for check DFC_ComGwIMG6TOut" VALUE 0x804F98F6 Val_Wu8 1.00000000000 DFES_EnvTabVerb 0.00 1.00000000000 FORMAT "%13.11" /end CHARACTERISTIC
/begin CHARACTERISTIC DFES_EnvRef.DFC_ComIDASBChksum_C "used environment signals / Reference to used environment condition set for check DFC_ComIDASBChksum" VALUE 0x804F98F7 Val_Wu8 1.00000000000 DFES_EnvTabVerb 0.00 1.00000000000 FORMAT "%13.11" /end CHARACTERISTIC
/begin CHARACTERISTIC DFES_EnvRef.DFC_ComIDASBRingCnt_C "used environment signals / Reference to used environment condition set for check DFC_ComIDASBRingCnt" VALUE 0x804F98F8 Val_Wu8 1.00000000000 DFES_EnvTabVerb 0.00 1.00000000000 FORMAT "%13.11" /end CHARACTERISTIC
/begin CHARACTERISTIC DFES_EnvRef.DFC_ComIDASBTOut_C "used environment signals / Reference to used environment condition set for check DFC_ComIDASBTOut" VALUE 0x804F98F9 Val_Wu8 1.00000000000 DFES_EnvTabVerb 0.00 1.00000000000 FORMAT "%13.11" /end CHARACTERISTIC
/begin CHARACTERISTIC DFES_EnvRef.DFC_ComIMGMILReq_C "used environment signals / Reference to used environment condition set for check DFC_ComIMGMILReq" VALUE 0x804F98FA Val_Wu8 1.00000000000 DFES_EnvTabVerb 0.00 1.00000000000 FORMAT "%13.11" /end CHARACTERISTIC
/begin CHARACTERISTIC DFES_EnvRef.DFC_ComISSPrms_C "used environment signals / Reference to used environment condition set for check DFC_ComISSPrms" VALUE 0x804F98FB Val_Wu8 1.00000000000 DFES_EnvTabVerb 0.00 1.00000000000 FORMAT "%13.11" /end CHARACTERISTIC
/begin CHARACTERISTIC DFES_EnvRef.DFC_ComMETAChksum_C "used environment signals / Reference to used environment condition set for check DFC_ComMETAChksum" VALUE 0x804F98FC Val_Wu8 1.00000000000 DFES_EnvTabVerb 0.00 1.00000000000 FORMAT "%13.11" /end CHARACTERISTIC
/begin CHARACTERISTIC DFES_EnvRef.DFC_ComMETARingCnt_C "used environment signals / Reference to used environment condition set for check DFC_ComMETARingCnt" VALUE 0x804F98FD Val_Wu8 1.00000000000 DFES_EnvTabVerb 0.00 1.00000000000 FORMAT "%13.11" /end CHARACTERISTIC
/begin CHARACTERISTIC DFES_EnvRef.DFC_ComMETATOut_C "used environment signals / Reference to used environment condition set for check DFC_ComMETATOut" VALUE 0x804F98FE Val_Wu8 1.00000000000 DFES_EnvTabVerb 0.00 1.00000000000 FORMAT "%13.11" /end CHARACTERISTIC
/begin CHARACTERISTIC DFES_EnvRef.DFC_ComMETCChksum_C "used environment signals / Reference to used environment condition set for check DFC_ComMETCChksum" VALUE 0x804F98FF Val_Wu8 1.00000000000 DFES_EnvTabVerb 0.00 1.00000000000 FORMAT "%13.11" /end CHARACTERISTIC
/begin CHARACTERISTIC DFES_EnvRef.DFC_ComMETCRingCnt_C "used environment signals / Reference to used environment condition set for check DFC_ComMETCRingCnt" VALUE 0x804F9900 Val_Wu8 1.00000000000 DFES_EnvTabVerb 0.00 1.00000000000 FORMAT "%13.11" /end CHARACTERISTIC
/begin CHARACTERISTIC DFES_EnvRef.DFC_ComMETCTOut_C "used environment signals / Reference to used environment condition set for check DFC_ComMETCTOut" VALUE 0x804F9901 Val_Wu8 1.00000000000 DFES_EnvTabVerb 0.00 1.00000000000 FORMAT "%13.11" /end CHARACTERISTIC
/begin CHARACTERISTIC DFES_EnvRef.DFC_ComMETDChksum_C "used environment signals / Reference to used environment condition set for check DFC_ComMETDChksum" VALUE 0x804F9902 Val_Wu8 1.00000000000 DFES_EnvTabVerb 0.00 1.00000000000 FORMAT "%13.11" /end CHARACTERISTIC
/begin CHARACTERISTIC DFES_EnvRef.DFC_ComMETDRingCnt_C "used environment signals / Reference to used environment condition set for check DFC_ComMETDRingCnt" VALUE 0x804F9903 Val_Wu8 1.00000000000 DFES_EnvTabVerb 0.00 1.00000000000 FORMAT "%13.11" /end CHARACTERISTIC
/begin CHARACTERISTIC DFES_EnvRef.DFC_ComMETDTOut_C "used environment signals / Reference to used environment condition set for check DFC_ComMETDTOut" VALUE 0x804F9904 Val_Wu8 1.00000000000 DFES_EnvTabVerb 0.00 1.00000000000 FORMAT "%13.11" /end CHARACTERISTIC
/begin CHARACTERISTIC DFES_EnvRef.DFC_ComMETE2Chksum_C "used environment signals / Reference to used environment condition set for check DFC_ComMETE2Chksum" VALUE 0x804F9905 Val_Wu8 1.00000000000 DFES_EnvTabVerb 0.00 1.00000000000 FORMAT "%13.11" /end CHARACTERISTIC
/begin CHARACTERISTIC DFES_EnvRef.DFC_ComMETE2RingCnt_C "used environment signals / Reference to used environment condition set for check DFC_ComMETE2RingCnt" VALUE 0x804F9906 Val_Wu8 1.00000000000 DFES_EnvTabVerb 0.00 1.00000000000 FORMAT "%13.11" /end CHARACTERISTIC
/begin CHARACTERISTIC DFES_EnvRef.DFC_ComMETE2TOut_C "used environment signals / Reference to used environment condition set for check DFC_ComMETE2TOut" VALUE 0x804F9907 Val_Wu8 1.00000000000 DFES_EnvTabVerb 0.00 1.00000000000 FORMAT "%13.11" /end CHARACTERISTIC
/begin CHARACTERISTIC DFES_EnvRef.DFC_ComMETFChksum_C "used environment signals / Reference to used environment condition set for check DFC_ComMETFChksum" VALUE 0x804F9908 Val_Wu8 1.00000000000 DFES_EnvTabVerb 0.00 1.00000000000 FORMAT "%13.11" /end CHARACTERISTIC
/begin CHARACTERISTIC DFES_EnvRef.DFC_ComMETFRingCnt_C "used environment signals / Reference to used environment condition set for check DFC_ComMETFRingCnt" VALUE 0x804F9909 Val_Wu8 1.00000000000 DFES_EnvTabVerb 0.00 1.00000000000 FORMAT "%13.11" /end CHARACTERISTIC
/begin CHARACTERISTIC DFES_EnvRef.DFC_ComMETFTOut_C "used environment signals / Reference to used environment condition set for check DFC_ComMETFTOut" VALUE 0x804F990A Val_Wu8 1.00000000000 DFES_EnvTabVerb 0.00 1.00000000000 FORMAT "%13.11" /end CHARACTERISTIC
/begin CHARACTERISTIC DFES_EnvRef.DFC_ComMETGChksum_C "used environment signals / Reference to used environment condition set for check DFC_ComMETGChksum" VALUE 0x804F990B Val_Wu8 1.00000000000 DFES_EnvTabVerb 0.00 1.00000000000 FORMAT "%13.11" /end CHARACTERISTIC
/begin CHARACTERISTIC DFES_EnvRef.DFC_ComMETGRingCnt_C "used environment signals / Reference to used environment condition set for check DFC_ComMETGRingCnt" VALUE 0x804F990C Val_Wu8 1.00000000000 DFES_EnvTabVerb 0.00 1.00000000000 FORMAT "%13.11" /end CHARACTERISTIC
/begin CHARACTERISTIC DFES_EnvRef.DFC_ComMETGTOut_C "used environment signals / Reference to used environment condition set for check DFC_ComMETGTOut" VALUE 0x804F990D Val_Wu8 1.00000000000 DFES_EnvTabVerb 0.00 1.00000000000 FORMAT "%13.11" /end CHARACTERISTIC
/begin CHARACTERISTIC DFES_EnvRef.DFC_ComMETH2Chksum_C "used environment signals / Reference to used environment condition set for check DFC_ComMETH2Chksum" VALUE 0x804F990E Val_Wu8 1.00000000000 DFES_EnvTabVerb 0.00 1.00000000000 FORMAT "%13.11" /end CHARACTERISTIC
/begin CHARACTERISTIC DFES_EnvRef.DFC_ComMETH2RingCnt_C "used environment signals / Reference to used environment condition set for check DFC_ComMETH2RingCnt" VALUE 0x804F990F Val_Wu8 1.00000000000 DFES_EnvTabVerb 0.00 1.00000000000 FORMAT "%13.11" /end CHARACTERISTIC
/begin CHARACTERISTIC DFES_EnvRef.DFC_ComMETH2TOut_C "used environment signals / Reference to used environment condition set for check DFC_ComMETH2TOut" VALUE 0x804F9910 Val_Wu8 1.00000000000 DFES_EnvTabVerb 0.00 1.00000000000 FORMAT "%13.11" /end CHARACTERISTIC
/begin CHARACTERISTIC DFES_EnvRef.DFC_ComMETHChksum_C "used environment signals / Reference to used environment condition set for check DFC_ComMETHChksum" VALUE 0x804F9911 Val_Wu8 1.00000000000 DFES_EnvTabVerb 0.00 1.00000000000 FORMAT "%13.11" /end CHARACTERISTIC
/begin CHARACTERISTIC DFES_EnvRef.DFC_ComMETHRingCnt_C "used environment signals / Reference to used environment condition set for check DFC_ComMETHRingCnt" VALUE 0x804F9912 Val_Wu8 1.00000000000 DFES_EnvTabVerb 0.00 1.00000000000 FORMAT "%13.11" /end CHARACTERISTIC
/begin CHARACTERISTIC DFES_EnvRef.DFC_ComMETHTOut_C "used environment signals / Reference to used environment condition set for check DFC_ComMETHTOut" VALUE 0x804F9913 Val_Wu8 1.00000000000 DFES_EnvTabVerb 0.00 1.00000000000 FORMAT "%13.11" /end CHARACTERISTIC
/begin CHARACTERISTIC DFES_EnvRef.DFC_ComMETIChksum_C "used environment signals / Reference to used environment condition set for check DFC_ComMETIChksum" VALUE 0x804F9914 Val_Wu8 1.00000000000 DFES_EnvTabVerb 0.00 1.00000000000 FORMAT "%13.11" /end CHARACTERISTIC
/begin CHARACTERISTIC DFES_EnvRef.DFC_ComMETIRingCnt_C "used environment signals / Reference to used environment condition set for check DFC_ComMETIRingCnt" VALUE 0x804F9915 Val_Wu8 1.00000000000 DFES_EnvTabVerb 0.00 1.00000000000 FORMAT "%13.11" /end CHARACTERISTIC
/begin CHARACTERISTIC DFES_EnvRef.DFC_ComMETITOut_C "used environment signals / Reference to used environment condition set for check DFC_ComMETITOut" VALUE 0x804F9916 Val_Wu8 1.00000000000 DFES_EnvTabVerb 0.00 1.00000000000 FORMAT "%13.11" /end CHARACTERISTIC
/begin CHARACTERISTIC DFES_EnvRef.DFC_ComMETKChksum_C "used environment signals / Reference to used environment condition set for check DFC_ComMETKChksum" VALUE 0x804F9917 Val_Wu8 1.00000000000 DFES_EnvTabVerb 0.00 1.00000000000 FORMAT "%13.11" /end CHARACTERISTIC
/begin CHARACTERISTIC DFES_EnvRef.DFC_ComMETKRingCnt_C "used environment signals / Reference to used environment condition set for check DFC_ComMETKRingCnt" VALUE 0x804F9918 Val_Wu8 1.00000000000 DFES_EnvTabVerb 0.00 1.00000000000 FORMAT "%13.11" /end CHARACTERISTIC
/begin CHARACTERISTIC DFES_EnvRef.DFC_ComMETKTOut_C "used environment signals / Reference to used environment condition set for check DFC_ComMETKTOut" VALUE 0x804F9919 Val_Wu8 1.00000000000 DFES_EnvTabVerb 0.00 1.00000000000 FORMAT "%13.11" /end CHARACTERISTIC
/begin CHARACTERISTIC DFES_EnvRef.DFC_ComMETLChksum_C "used environment signals / Reference to used environment condition set for check DFC_ComMETLChksum" VALUE 0x804F991A Val_Wu8 1.00000000000 DFES_EnvTabVerb 0.00 1.00000000000 FORMAT "%13.11" /end CHARACTERISTIC
/begin CHARACTERISTIC DFES_EnvRef.DFC_ComMETLRingCnt_C "used environment signals / Reference to used environment condition set for check DFC_ComMETLRingCnt" VALUE 0x804F991B Val_Wu8 1.00000000000 DFES_EnvTabVerb 0.00 1.00000000000 FORMAT "%13.11" /end CHARACTERISTIC
/begin CHARACTERISTIC DFES_EnvRef.DFC_ComMETLTOut_C "used environment signals / Reference to used environment condition set for check DFC_ComMETLTOut" VALUE 0x804F991C Val_Wu8 1.00000000000 DFES_EnvTabVerb 0.00 1.00000000000 FORMAT "%13.11" /end CHARACTERISTIC
/begin CHARACTERISTIC DFES_EnvRef.DFC_ComMETMChksum_C "used environment signals / Reference to used environment condition set for check DFC_ComMETMChksum" VALUE 0x804F991D Val_Wu8 1.00000000000 DFES_EnvTabVerb 0.00 1.00000000000 FORMAT "%13.11" /end CHARACTERISTIC
/begin CHARACTERISTIC DFES_EnvRef.DFC_ComMETMRingCnt_C "used environment signals / Reference to used environment condition set for check DFC_ComMETMRingCnt" VALUE 0x804F991E Val_Wu8 1.00000000000 DFES_EnvTabVerb 0.00 1.00000000000 FORMAT "%13.11" /end CHARACTERISTIC
/begin CHARACTERISTIC DFES_EnvRef.DFC_ComMETMTOut_C "used environment signals / Reference to used environment condition set for check DFC_ComMETMTOut" VALUE 0x804F991F Val_Wu8 1.00000000000 DFES_EnvTabVerb 0.00 1.00000000000 FORMAT "%13.11" /end CHARACTERISTIC
/begin CHARACTERISTIC DFES_EnvRef.DFC_ComMETNChksum_C "used environment signals / Reference to used environment condition set for check DFC_ComMETNChksum" VALUE 0x804F9920 Val_Wu8 1.00000000000 DFES_EnvTabVerb 0.00 1.00000000000 FORMAT "%13.11" /end CHARACTERISTIC
/begin CHARACTERISTIC DFES_EnvRef.DFC_ComMETNRingCnt_C "used environment signals / Reference to used environment condition set for check DFC_ComMETNRingCnt" VALUE 0x804F9921 Val_Wu8 1.00000000000 DFES_EnvTabVerb 0.00 1.00000000000 FORMAT "%13.11" /end CHARACTERISTIC
/begin CHARACTERISTIC DFES_EnvRef.DFC_ComMETNTOut_C "used environment signals / Reference to used environment condition set for check DFC_ComMETNTOut" VALUE 0x804F9922 Val_Wu8 1.00000000000 DFES_EnvTabVerb 0.00 1.00000000000 FORMAT "%13.11" /end CHARACTERISTIC
/begin CHARACTERISTIC DFES_EnvRef.DFC_ComMtrCom_C "used environment signals / Reference to used environment condition set for check DFC_ComMtrCom" VALUE 0x804F9923 Val_Wu8 1.00000000000 DFES_EnvTabVerb 0.00 1.00000000000 FORMAT "%13.11" /end CHARACTERISTIC
/begin CHARACTERISTIC DFES_EnvRef.DFC_ComPCUChkSum_C "used environment signals / Reference to used environment condition set for check DFC_ComPCUChkSum" VALUE 0x804F9924 Val_Wu8 1.00000000000 DFES_EnvTabVerb 0.00 1.00000000000 FORMAT "%13.11" /end CHARACTERISTIC
/begin CHARACTERISTIC DFES_EnvRef.DFC_ComPCURingCnt_C "used environment signals / Reference to used environment condition set for check DFC_ComPCURingCnt" VALUE 0x804F9925 Val_Wu8 1.00000000000 DFES_EnvTabVerb 0.00 1.00000000000 FORMAT "%13.11" /end CHARACTERISTIC
/begin CHARACTERISTIC DFES_EnvRef.DFC_ComPCUTOut_C "used environment signals / Reference to used environment condition set for check DFC_ComPCUTOut" VALUE 0x804F9926 Val_Wu8 1.00000000000 DFES_EnvTabVerb 0.00 1.00000000000 FORMAT "%13.11" /end CHARACTERISTIC
/begin CHARACTERISTIC DFES_EnvRef.DFC_ComSRSAChksum_C "used environment signals / Reference to used environment condition set for check DFC_ComSRSAChksum" VALUE 0x804F9927 Val_Wu8 1.00000000000 DFES_EnvTabVerb 0.00 1.00000000000 FORMAT "%13.11" /end CHARACTERISTIC
/begin CHARACTERISTIC DFES_EnvRef.DFC_ComSRSARingCnt_C "used environment signals / Reference to used environment condition set for check DFC_ComSRSARingCnt" VALUE 0x804F9928 Val_Wu8 1.00000000000 DFES_EnvTabVerb 0.00 1.00000000000 FORMAT "%13.11" /end CHARACTERISTIC
/begin CHARACTERISTIC DFES_EnvRef.DFC_ComSRSATOut_C "used environment signals / Reference to used environment condition set for check DFC_ComSRSATOut" VALUE 0x804F9929 Val_Wu8 1.00000000000 DFES_EnvTabVerb 0.00 1.00000000000 FORMAT "%13.11" /end CHARACTERISTIC
/begin CHARACTERISTIC DFES_EnvRef.DFC_ComSRSBChksum_C "used environment signals / Reference to used environment condition set for check DFC_ComSRSBChksum" VALUE 0x804F992A Val_Wu8 1.00000000000 DFES_EnvTabVerb 0.00 1.00000000000 FORMAT "%13.11" /end CHARACTERISTIC
/begin CHARACTERISTIC DFES_EnvRef.DFC_ComSRSBRingCnt_C "used environment signals / Reference to used environment condition set for check DFC_ComSRSBRingCnt" VALUE 0x804F992B Val_Wu8 1.00000000000 DFES_EnvTabVerb 0.00 1.00000000000 FORMAT "%13.11" /end CHARACTERISTIC
/begin CHARACTERISTIC DFES_EnvRef.DFC_ComSRSBTOut_C "used environment signals / Reference to used environment condition set for check DFC_ComSRSBTOut" VALUE 0x804F992C Val_Wu8 1.00000000000 DFES_EnvTabVerb 0.00 1.00000000000 FORMAT "%13.11" /end CHARACTERISTIC
/begin CHARACTERISTIC DFES_EnvRef.DFC_ComSRSChksum_C "used environment signals / Reference to used environment condition set for check DFC_ComSRSChksum" VALUE 0x804F992D Val_Wu8 1.00000000000 DFES_EnvTabVerb 0.00 1.00000000000 FORMAT "%13.11" /end CHARACTERISTIC
/begin CHARACTERISTIC DFES_EnvRef.DFC_ComSRSErr_C "used environment signals / Reference to used environment condition set for check DFC_ComSRSErr" VALUE 0x804F992E Val_Wu8 1.00000000000 DFES_EnvTabVerb 0.00 1.00000000000 FORMAT "%13.11" /end CHARACTERISTIC
/begin CHARACTERISTIC DFES_EnvRef.DFC_ComSRSRingCnt_C "used environment signals / Reference to used environment condition set for check DFC_ComSRSRingCnt" VALUE 0x804F992F Val_Wu8 1.00000000000 DFES_EnvTabVerb 0.00 1.00000000000 FORMAT "%13.11" /end CHARACTERISTIC
/begin CHARACTERISTIC DFES_EnvRef.DFC_ComSRSTOut_C "used environment signals / Reference to used environment condition set for check DFC_ComSRSTOut" VALUE 0x804F9930 Val_Wu8 1.00000000000 DFES_EnvTabVerb 0.00 1.00000000000 FORMAT "%13.11" /end CHARACTERISTIC
/begin CHARACTERISTIC DFES_EnvRef.DFC_ComVehSpdPndFltTCU_C "used environment signals / Reference to used environment condition set for check DFC_ComVehSpdPndFltTCU" VALUE 0x804F9931 Val_Wu8 1.00000000000 DFES_EnvTabVerb 0.00 1.00000000000 FORMAT "%13.11" /end CHARACTERISTIC
/begin CHARACTERISTIC DFES_EnvRef.DFC_EbsChartcCurrErr_C "used environment signals / Reference to used environment condition set for check DFC_EbsChartcCurrErr" VALUE 0x804F9932 Val_Wu8 1.00000000000 DFES_EnvTabVerb 0.00 1.00000000000 FORMAT "%13.11" /end CHARACTERISTIC
/begin CHARACTERISTIC DFES_EnvRef.DFC_EbsSelfDiagErr_C "used environment signals / Reference to used environment condition set for check DFC_EbsSelfDiagErr" VALUE 0x804F9933 Val_Wu8 1.00000000000 DFES_EnvTabVerb 0.00 1.00000000000 FORMAT "%13.11" /end CHARACTERISTIC
/begin CHARACTERISTIC DFES_EnvRef.DFC_GbxCANDigPlausErr_C "used environment signals / Reference to used environment condition set for check DFC_GbxCANDigPlausErr" VALUE 0x804F9934 Val_Wu8 1.00000000000 DFES_EnvTabVerb 0.00 1.00000000000 FORMAT "%13.11" /end CHARACTERISTIC
/begin CHARACTERISTIC DFES_EnvRef.DFC_GbxNPos1SRCMax_C "used environment signals / Reference to used environment condition set for check DFC_GbxNPos1SRCMax" VALUE 0x804F9935 Val_Wu8 1.00000000000 DFES_EnvTabVerb 0.00 1.00000000000 FORMAT "%13.11" /end CHARACTERISTIC
/begin CHARACTERISTIC DFES_EnvRef.DFC_GbxNPos1SRCMin_C "used environment signals / Reference to used environment condition set for check DFC_GbxNPos1SRCMin" VALUE 0x804F9936 Val_Wu8 1.00000000000 DFES_EnvTabVerb 0.00 1.00000000000 FORMAT "%13.11" /end CHARACTERISTIC
/begin CHARACTERISTIC DFES_EnvRef.DFC_GbxNPos2SRCMax_C "used environment signals / Reference to used environment condition set for check DFC_GbxNPos2SRCMax" VALUE 0x804F9937 Val_Wu8 1.00000000000 DFES_EnvTabVerb 0.00 1.00000000000 FORMAT "%13.11" /end CHARACTERISTIC
/begin CHARACTERISTIC DFES_EnvRef.DFC_GbxNPos2SRCMin_C "used environment signals / Reference to used environment condition set for check DFC_GbxNPos2SRCMin" VALUE 0x804F9938 Val_Wu8 1.00000000000 DFES_EnvTabVerb 0.00 1.00000000000 FORMAT "%13.11" /end CHARACTERISTIC
/begin CHARACTERISTIC DFES_EnvRef.DFC_GbxNPosAlvChk_C "used environment signals / Reference to used environment condition set for check DFC_GbxNPosAlvChk" VALUE 0x804F9939 Val_Wu8 1.00000000000 DFES_EnvTabVerb 0.00 1.00000000000 FORMAT "%13.11" /end CHARACTERISTIC
/begin CHARACTERISTIC DFES_EnvRef.DFC_GbxNPosSyncErr_C "used environment signals / Reference to used environment condition set for check DFC_GbxNPosSyncErr" VALUE 0x804F993A Val_Wu8 1.00000000000 DFES_EnvTabVerb 0.00 1.00000000000 FORMAT "%13.11" /end CHARACTERISTIC
/begin CHARACTERISTIC DFES_EnvRef.DFC_HEGOS2B1HtrPsMax_C "used environment signals / Reference to used environment condition set for check DFC_HEGOS2B1HtrPsMax" VALUE 0x804F993B Val_Wu8 1.00000000000 DFES_EnvTabVerb 0.00 1.00000000000 FORMAT "%13.11" /end CHARACTERISTIC
/begin CHARACTERISTIC DFES_EnvRef.DFC_HEGOS2B1HtrPsMin_C "used environment signals / Reference to used environment condition set for check DFC_HEGOS2B1HtrPsMin" VALUE 0x804F993C Val_Wu8 1.00000000000 DFES_EnvTabVerb 0.00 1.00000000000 FORMAT "%13.11" /end CHARACTERISTIC
/begin CHARACTERISTIC DFES_EnvRef.DFC_HEGOS2B1HtrPsSig_C "used environment signals / Reference to used environment condition set for check DFC_HEGOS2B1HtrPsSig" VALUE 0x804F993D Val_Wu8 1.00000000000 DFES_EnvTabVerb 0.00 1.00000000000 FORMAT "%13.11" /end CHARACTERISTIC
/begin CHARACTERISTIC DFES_EnvRef.DFC_LinCSErrACG_C "used environment signals / Reference to used environment condition set for check DFC_LinCSErrACG" VALUE 0x804F993E Val_Wu8 1.00000000000 DFES_EnvTabVerb 0.00 1.00000000000 FORMAT "%13.11" /end CHARACTERISTIC
/begin CHARACTERISTIC DFES_EnvRef.DFC_LinCSErrEBS_C "used environment signals / Reference to used environment condition set for check DFC_LinCSErrEBS" VALUE 0x804F993F Val_Wu8 1.00000000000 DFES_EnvTabVerb 0.00 1.00000000000 FORMAT "%13.11" /end CHARACTERISTIC
/begin CHARACTERISTIC DFES_EnvRef.DFC_LinHdrTimeoutErrACG_C "used environment signals / Reference to used environment condition set for check DFC_LinHdrTimeoutErrACG" VALUE 0x804F9940 Val_Wu8 1.00000000000 DFES_EnvTabVerb 0.00 1.00000000000 FORMAT "%13.11" /end CHARACTERISTIC
/begin CHARACTERISTIC DFES_EnvRef.DFC_LinHdrTimeoutErrEBS_C "used environment signals / Reference to used environment condition set for check DFC_LinHdrTimeoutErrEBS" VALUE 0x804F9941 Val_Wu8 1.00000000000 DFES_EnvTabVerb 0.00 1.00000000000 FORMAT "%13.11" /end CHARACTERISTIC
/begin CHARACTERISTIC DFES_EnvRef.DFC_LinMsgTimeoutErrACG_C "used environment signals / Reference to used environment condition set for check DFC_LinMsgTimeoutErrACG" VALUE 0x804F9942 Val_Wu8 1.00000000000 DFES_EnvTabVerb 0.00 1.00000000000 FORMAT "%13.11" /end CHARACTERISTIC
/begin CHARACTERISTIC DFES_EnvRef.DFC_LinMsgTimeoutErrEBS_C "used environment signals / Reference to used environment condition set for check DFC_LinMsgTimeoutErrEBS" VALUE 0x804F9943 Val_Wu8 1.00000000000 DFES_EnvTabVerb 0.00 1.00000000000 FORMAT "%13.11" /end CHARACTERISTIC
/begin CHARACTERISTIC DFES_EnvRef.DFC_LinNoStrtComErr_C "used environment signals / Reference to used environment condition set for check DFC_LinNoStrtComErr" VALUE 0x804F9944 Val_Wu8 1.00000000000 DFES_EnvTabVerb 0.00 1.00000000000 FORMAT "%13.11" /end CHARACTERISTIC
/begin CHARACTERISTIC DFES_EnvRef.DFC_MisfDetVWhlFrntLeOORHi_C "used environment signals / Reference to used environment condition set for check DFC_MisfDetVWhlFrntLeOORHi" VALUE 0x804F9945 Val_Wu8 1.00000000000 DFES_EnvTabVerb 0.00 1.00000000000 FORMAT "%13.11" /end CHARACTERISTIC
/begin CHARACTERISTIC DFES_EnvRef.DFC_MisfDetVWhlFrntLeRatyHi_C "used environment signals / Reference to used environment condition set for check DFC_MisfDetVWhlFrntLeRatyHi" VALUE 0x804F9946 Val_Wu8 1.00000000000 DFES_EnvTabVerb 0.00 1.00000000000 FORMAT "%13.11" /end CHARACTERISTIC
/begin CHARACTERISTIC DFES_EnvRef.DFC_MisfDetVWhlFrntLeRatyLo_C "used environment signals / Reference to used environment condition set for check DFC_MisfDetVWhlFrntLeRatyLo" VALUE 0x804F9947 Val_Wu8 1.00000000000 DFES_EnvTabVerb 0.00 1.00000000000 FORMAT "%13.11" /end CHARACTERISTIC
/begin CHARACTERISTIC DFES_EnvRef.DFC_MisfDetVWhlFrntLeStuck_C "used environment signals / Reference to used environment condition set for check DFC_MisfDetVWhlFrntLeStuck" VALUE 0x804F9948 Val_Wu8 1.00000000000 DFES_EnvTabVerb 0.00 1.00000000000 FORMAT "%13.11" /end CHARACTERISTIC
/begin CHARACTERISTIC DFES_EnvRef.DFC_MisfDetVWhlFrntRiOORHi_C "used environment signals / Reference to used environment condition set for check DFC_MisfDetVWhlFrntRiOORHi" VALUE 0x804F9949 Val_Wu8 1.00000000000 DFES_EnvTabVerb 0.00 1.00000000000 FORMAT "%13.11" /end CHARACTERISTIC
/begin CHARACTERISTIC DFES_EnvRef.DFC_MisfDetVWhlFrntRiRatyHi_C "used environment signals / Reference to used environment condition set for check DFC_MisfDetVWhlFrntRiRatyHi" VALUE 0x804F994A Val_Wu8 1.00000000000 DFES_EnvTabVerb 0.00 1.00000000000 FORMAT "%13.11" /end CHARACTERISTIC
/begin CHARACTERISTIC DFES_EnvRef.DFC_MisfDetVWhlFrntRiRatyLo_C "used environment signals / Reference to used environment condition set for check DFC_MisfDetVWhlFrntRiRatyLo" VALUE 0x804F994B Val_Wu8 1.00000000000 DFES_EnvTabVerb 0.00 1.00000000000 FORMAT "%13.11" /end CHARACTERISTIC
/begin CHARACTERISTIC DFES_EnvRef.DFC_MisfDetVWhlFrntRiStuck_C "used environment signals / Reference to used environment condition set for check DFC_MisfDetVWhlFrntRiStuck" VALUE 0x804F994C Val_Wu8 1.00000000000 DFES_EnvTabVerb 0.00 1.00000000000 FORMAT "%13.11" /end CHARACTERISTIC
/begin CHARACTERISTIC DFES_EnvRef.DFC_MisfDetVWhlReLeOORHi_C "used environment signals / Reference to used environment condition set for check DFC_MisfDetVWhlReLeOORHi" VALUE 0x804F994D Val_Wu8 1.00000000000 DFES_EnvTabVerb 0.00 1.00000000000 FORMAT "%13.11" /end CHARACTERISTIC
/begin CHARACTERISTIC DFES_EnvRef.DFC_MisfDetVWhlReLeRatyHi_C "used environment signals / Reference to used environment condition set for check DFC_MisfDetVWhlReLeRatyHi" VALUE 0x804F994E Val_Wu8 1.00000000000 DFES_EnvTabVerb 0.00 1.00000000000 FORMAT "%13.11" /end CHARACTERISTIC
/begin CHARACTERISTIC DFES_EnvRef.DFC_MisfDetVWhlReLeRatyLo_C "used environment signals / Reference to used environment condition set for check DFC_MisfDetVWhlReLeRatyLo" VALUE 0x804F994F Val_Wu8 1.00000000000 DFES_EnvTabVerb 0.00 1.00000000000 FORMAT "%13.11" /end CHARACTERISTIC
/begin CHARACTERISTIC DFES_EnvRef.DFC_MisfDetVWhlReLeStuck_C "used environment signals / Reference to used environment condition set for check DFC_MisfDetVWhlReLeStuck" VALUE 0x804F9950 Val_Wu8 1.00000000000 DFES_EnvTabVerb 0.00 1.00000000000 FORMAT "%13.11" /end CHARACTERISTIC
/begin CHARACTERISTIC DFES_EnvRef.DFC_MisfDetVWhlReRiOORHi_C "used environment signals / Reference to used environment condition set for check DFC_MisfDetVWhlReRiOORHi" VALUE 0x804F9951 Val_Wu8 1.00000000000 DFES_EnvTabVerb 0.00 1.00000000000 FORMAT "%13.11" /end CHARACTERISTIC
/begin CHARACTERISTIC DFES_EnvRef.DFC_MisfDetVWhlReRiRatyHi_C "used environment signals / Reference to used environment condition set for check DFC_MisfDetVWhlReRiRatyHi" VALUE 0x804F9952 Val_Wu8 1.00000000000 DFES_EnvTabVerb 0.00 1.00000000000 FORMAT "%13.11" /end CHARACTERISTIC
/begin CHARACTERISTIC DFES_EnvRef.DFC_MisfDetVWhlReRiRatyLo_C "used environment signals / Reference to used environment condition set for check DFC_MisfDetVWhlReRiRatyLo" VALUE 0x804F9953 Val_Wu8 1.00000000000 DFES_EnvTabVerb 0.00 1.00000000000 FORMAT "%13.11" /end CHARACTERISTIC
/begin CHARACTERISTIC DFES_EnvRef.DFC_MisfDetVWhlReRiStuck_C "used environment signals / Reference to used environment condition set for check DFC_MisfDetVWhlReRiStuck" VALUE 0x804F9954 Val_Wu8 1.00000000000 DFES_EnvTabVerb 0.00 1.00000000000 FORMAT "%13.11" /end CHARACTERISTIC
/begin CHARACTERISTIC DFES_EnvRef.DFC_MisfDetdVWhlFrntLePlaus_C "used environment signals / Reference to used environment condition set for check DFC_MisfDetdVWhlFrntLePlaus" VALUE 0x804F9955 Val_Wu8 1.00000000000 DFES_EnvTabVerb 0.00 1.00000000000 FORMAT "%13.11" /end CHARACTERISTIC
/begin CHARACTERISTIC DFES_EnvRef.DFC_MisfDetdVWhlFrntRiPlaus_C "used environment signals / Reference to used environment condition set for check DFC_MisfDetdVWhlFrntRiPlaus" VALUE 0x804F9956 Val_Wu8 1.00000000000 DFES_EnvTabVerb 0.00 1.00000000000 FORMAT "%13.11" /end CHARACTERISTIC
/begin CHARACTERISTIC DFES_EnvRef.DFC_MisfDetdVWhlReLePlaus_C "used environment signals / Reference to used environment condition set for check DFC_MisfDetdVWhlReLePlaus" VALUE 0x804F9957 Val_Wu8 1.00000000000 DFES_EnvTabVerb 0.00 1.00000000000 FORMAT "%13.11" /end CHARACTERISTIC
/begin CHARACTERISTIC DFES_EnvRef.DFC_MisfDetdVWhlReRiPlaus_C "used environment signals / Reference to used environment condition set for check DFC_MisfDetdVWhlReRiPlaus" VALUE 0x804F9958 Val_Wu8 1.00000000000 DFES_EnvTabVerb 0.00 1.00000000000 FORMAT "%13.11" /end CHARACTERISTIC
/begin CHARACTERISTIC DFES_EnvRef.DFC_PEnvSigRngMax_C "used environment signals / Reference to used environment condition set for check DFC_PEnvSigRngMax" VALUE 0x804F9959 Val_Wu8 1.00000000000 DFES_EnvTabVerb 0.00 1.00000000000 FORMAT "%13.11" /end CHARACTERISTIC
/begin CHARACTERISTIC DFES_EnvRef.DFC_PEnvSigRngMin_C "used environment signals / Reference to used environment condition set for check DFC_PEnvSigRngMin" VALUE 0x804F995A Val_Wu8 1.00000000000 DFES_EnvTabVerb 0.00 1.00000000000 FORMAT "%13.11" /end CHARACTERISTIC
/begin CHARACTERISTIC DFES_EnvRef.DFC_StmFault_C "used environment signals / Reference to used environment condition set for check DFC_StmFault" VALUE 0x804F995B Val_Wu8 1.00000000000 DFES_EnvTabVerb 0.00 1.00000000000 FORMAT "%13.11" /end CHARACTERISTIC
/begin CHARACTERISTIC DFES_EnvRef.DFC_StrtCtOffPth_C "used environment signals / Reference to used environment condition set for check DFC_StrtCtOffPth" VALUE 0x804F995C Val_Wu8 1.00000000000 DFES_EnvTabVerb 0.00 1.00000000000 FORMAT "%13.11" /end CHARACTERISTIC
/begin CHARACTERISTIC DFES_EnvRef.DFC_StrtCtlErr_C "used environment signals / Reference to used environment condition set for check DFC_StrtCtlErr" VALUE 0x804F995D Val_Wu8 1.00000000000 DFES_EnvTabVerb 0.00 1.00000000000 FORMAT "%13.11" /end CHARACTERISTIC
/begin CHARACTERISTIC DFES_EnvRef.DFC_StrtFault_C "used environment signals / Reference to used environment condition set for check DFC_StrtFault" VALUE 0x804F995E Val_Wu8 1.00000000000 DFES_EnvTabVerb 0.00 1.00000000000 FORMAT "%13.11" /end CHARACTERISTIC
/begin CHARACTERISTIC DFES_EnvRef.DFC_StrtLckJudg1_C "used environment signals / Reference to used environment condition set for check DFC_StrtLckJudg1" VALUE 0x804F995F Val_Wu8 1.00000000000 DFES_EnvTabVerb 0.00 1.00000000000 FORMAT "%13.11" /end CHARACTERISTIC
/begin CHARACTERISTIC DFES_EnvRef.DFC_StrtLckJudg2_C "used environment signals / Reference to used environment condition set for check DFC_StrtLckJudg2" VALUE 0x804F9960 Val_Wu8 1.00000000000 DFES_EnvTabVerb 0.00 1.00000000000 FORMAT "%13.11" /end CHARACTERISTIC
/begin CHARACTERISTIC DFES_EnvRef.DFC_StrtOL_C "used environment signals / Reference to used environment condition set for check DFC_StrtOL" VALUE 0x804F9961 Val_Wu8 1.00000000000 DFES_EnvTabVerb 0.00 1.00000000000 FORMAT "%13.11" /end CHARACTERISTIC
/begin CHARACTERISTIC DFES_EnvRef.DFC_StrtOL2_C "used environment signals / Reference to used environment condition set for check DFC_StrtOL2" VALUE 0x804F9962 Val_Wu8 1.00000000000 DFES_EnvTabVerb 0.00 1.00000000000 FORMAT "%13.11" /end CHARACTERISTIC
/begin CHARACTERISTIC DFES_EnvRef.DFC_StrtSCB_C "used environment signals / Reference to used environment condition set for check DFC_StrtSCB" VALUE 0x804F9963 Val_Wu8 1.00000000000 DFES_EnvTabVerb 0.00 1.00000000000 FORMAT "%13.11" /end CHARACTERISTIC
/begin CHARACTERISTIC DFES_EnvRef.DFC_StrtSCB2_C "used environment signals / Reference to used environment condition set for check DFC_StrtSCB2" VALUE 0x804F9964 Val_Wu8 1.00000000000 DFES_EnvTabVerb 0.00 1.00000000000 FORMAT "%13.11" /end CHARACTERISTIC
/begin CHARACTERISTIC DFES_EnvRef.DFC_StrtSCG_C "used environment signals / Reference to used environment condition set for check DFC_StrtSCG" VALUE 0x804F9965 Val_Wu8 1.00000000000 DFES_EnvTabVerb 0.00 1.00000000000 FORMAT "%13.11" /end CHARACTERISTIC
/begin CHARACTERISTIC DFES_EnvRef.DFC_StrtSCG2_C "used environment signals / Reference to used environment condition set for check DFC_StrtSCG2" VALUE 0x804F9966 Val_Wu8 1.00000000000 DFES_EnvTabVerb 0.00 1.00000000000 FORMAT "%13.11" /end CHARACTERISTIC
/begin CHARACTERISTIC DFES_EnvRef.DFC_StrtStkRly1_C "used environment signals / Reference to used environment condition set for check DFC_StrtStkRly1" VALUE 0x804F9967 Val_Wu8 1.00000000000 DFES_EnvTabVerb 0.00 1.00000000000 FORMAT "%13.11" /end CHARACTERISTIC
/begin CHARACTERISTIC DFES_EnvRef.DFC_StrtStkRly2_C "used environment signals / Reference to used environment condition set for check DFC_StrtStkRly2" VALUE 0x804F9968 Val_Wu8 1.00000000000 DFES_EnvTabVerb 0.00 1.00000000000 FORMAT "%13.11" /end CHARACTERISTIC
/begin CHARACTERISTIC DFES_EnvRef.DFC_TEVEmax_C "used environment signals / Reference to used environment condition set for check DFC_TEVEmax" VALUE 0x804F9969 Val_Wu8 1.00000000000 DFES_EnvTabVerb 0.00 1.00000000000 FORMAT "%13.11" /end CHARACTERISTIC
/begin CHARACTERISTIC DFES_EnvRef.DFC_TEVEmin_C "used environment signals / Reference to used environment condition set for check DFC_TEVEmin" VALUE 0x804F996A Val_Wu8 1.00000000000 DFES_EnvTabVerb 0.00 1.00000000000 FORMAT "%13.11" /end CHARACTERISTIC
/begin CHARACTERISTIC DFES_EnvRef.DFC_TEVEsig_C "used environment signals / Reference to used environment condition set for check DFC_TEVEsig" VALUE 0x804F996B Val_Wu8 1.00000000000 DFES_EnvTabVerb 0.00 1.00000000000 FORMAT "%13.11" /end CHARACTERISTIC
/begin CHARACTERISTIC DFES_EnvRef.DFC_VehVAllPlaus_C "used environment signals / Reference to used environment condition set for check DFC_VehVAllPlaus" VALUE 0x804F996C Val_Wu8 1.00000000000 DFES_EnvTabVerb 0.00 1.00000000000 FORMAT "%13.11" /end CHARACTERISTIC
/begin CHARACTERISTIC DFES_EnvRef.DFC_VehVNCSnsrElecFailr_C "used environment signals / Reference to used environment condition set for check DFC_VehVNCSnsrElecFailr" VALUE 0x804F996D Val_Wu8 1.00000000000 DFES_EnvTabVerb 0.00 1.00000000000 FORMAT "%13.11" /end CHARACTERISTIC
/begin CHARACTERISTIC DFES_EnvRef.DFC_VehVPlausCan_C "used environment signals / Reference to used environment condition set for check DFC_VehVPlausCan" VALUE 0x804F996E Val_Wu8 1.00000000000 DFES_EnvTabVerb 0.00 1.00000000000 FORMAT "%13.11" /end CHARACTERISTIC
/begin CHARACTERISTIC DFES_EnvRef.DFC_VehVPlausFco_C "used environment signals / Reference to used environment condition set for check DFC_VehVPlausFco" VALUE 0x804F996F Val_Wu8 1.00000000000 DFES_EnvTabVerb 0.00 1.00000000000 FORMAT "%13.11" /end CHARACTERISTIC
/begin CHARACTERISTIC DFES_EnvRef.DFC_VehVPlausPwr_C "used environment signals / Reference to used environment condition set for check DFC_VehVPlausPwr" VALUE 0x804F9970 Val_Wu8 1.00000000000 DFES_EnvTabVerb 0.00 1.00000000000 FORMAT "%13.11" /end CHARACTERISTIC
/begin CHARACTERISTIC DFES_EnvRef.DFC_VehVPlausV2N_C "used environment signals / Reference to used environment condition set for check DFC_VehVPlausV2N" VALUE 0x804F9971 Val_Wu8 1.00000000000 DFES_EnvTabVerb 0.00 1.00000000000 FORMAT "%13.11" /end CHARACTERISTIC
/begin CHARACTERISTIC DFES_EnvRef.DFC_VehVSpdSnsrAElecFailr_C "used environment signals / Reference to used environment condition set for check DFC_VehVSpdSnsrAElecFailr" VALUE 0x804F9972 Val_Wu8 1.00000000000 DFES_EnvTabVerb 0.00 1.00000000000 FORMAT "%13.11" /end CHARACTERISTIC
/begin CHARACTERISTIC DFES_EnvRef.DFC_VehVSpdSnsrBElecFailr_C "used environment signals / Reference to used environment condition set for check DFC_VehVSpdSnsrBElecFailr" VALUE 0x804F9973 Val_Wu8 1.00000000000 DFES_EnvTabVerb 0.00 1.00000000000 FORMAT "%13.11" /end CHARACTERISTIC
/begin CHARACTERISTIC DFES_EnvRef.DFC_ClthMax_C "used environment signals / Reference to used environment condition set for check DFC_ClthMax" VALUE 0x804F9974 Val_Wu8 1.00000000000 DFES_EnvTabVerb 0.00 1.00000000000 FORMAT "%13.11" /end CHARACTERISTIC
/begin CHARACTERISTIC DFES_EnvRef.DFC_IgnClPs_DevComErr_C "used environment signals / Reference to used environment condition set for check DFC_IgnClPs_DevComErr" VALUE 0x804F9975 Val_Wu8 1.00000000000 DFES_EnvTabVerb 0.00 1.00000000000 FORMAT "%13.11" /end CHARACTERISTIC
/begin CHARACTERISTIC DFES_EnvRef.DFC_IgnClPs_LineOl_0_C "used environment signals / Reference to used environment condition set for check DFC_IgnClPs_LineOl_0" VALUE 0x804F9976 Val_Wu8 1.00000000000 DFES_EnvTabVerb 0.00 1.00000000000 FORMAT "%13.11" /end CHARACTERISTIC
/begin CHARACTERISTIC DFES_EnvRef.DFC_IgnClPs_LineOl_1_C "used environment signals / Reference to used environment condition set for check DFC_IgnClPs_LineOl_1" VALUE 0x804F9977 Val_Wu8 1.00000000000 DFES_EnvTabVerb 0.00 1.00000000000 FORMAT "%13.11" /end CHARACTERISTIC
/begin CHARACTERISTIC DFES_EnvRef.DFC_IgnClPs_LineOl_2_C "used environment signals / Reference to used environment condition set for check DFC_IgnClPs_LineOl_2" VALUE 0x804F9978 Val_Wu8 1.00000000000 DFES_EnvTabVerb 0.00 1.00000000000 FORMAT "%13.11" /end CHARACTERISTIC
/begin CHARACTERISTIC DFES_EnvRef.DFC_IgnClPs_LineOl_3_C "used environment signals / Reference to used environment condition set for check DFC_IgnClPs_LineOl_3" VALUE 0x804F9979 Val_Wu8 1.00000000000 DFES_EnvTabVerb 0.00 1.00000000000 FORMAT "%13.11" /end CHARACTERISTIC
/begin CHARACTERISTIC DFES_EnvRef.DFC_IgnClPs_LineScb_0_C "used environment signals / Reference to used environment condition set for check DFC_IgnClPs_LineScb_0" VALUE 0x804F997A Val_Wu8 1.00000000000 DFES_EnvTabVerb 0.00 1.00000000000 FORMAT "%13.11" /end CHARACTERISTIC
/begin CHARACTERISTIC DFES_EnvRef.DFC_IgnClPs_LineScb_1_C "used environment signals / Reference to used environment condition set for check DFC_IgnClPs_LineScb_1" VALUE 0x804F997B Val_Wu8 1.00000000000 DFES_EnvTabVerb 0.00 1.00000000000 FORMAT "%13.11" /end CHARACTERISTIC
/begin CHARACTERISTIC DFES_EnvRef.DFC_IgnClPs_LineScb_2_C "used environment signals / Reference to used environment condition set for check DFC_IgnClPs_LineScb_2" VALUE 0x804F997C Val_Wu8 1.00000000000 DFES_EnvTabVerb 0.00 1.00000000000 FORMAT "%13.11" /end CHARACTERISTIC
/begin CHARACTERISTIC DFES_EnvRef.DFC_IgnClPs_LineScb_3_C "used environment signals / Reference to used environment condition set for check DFC_IgnClPs_LineScb_3" VALUE 0x804F997D Val_Wu8 1.00000000000 DFES_EnvTabVerb 0.00 1.00000000000 FORMAT "%13.11" /end CHARACTERISTIC
/begin CHARACTERISTIC DFES_EnvRef.DFC_IgnClPs_LineScg_0_C "used environment signals / Reference to used environment condition set for check DFC_IgnClPs_LineScg_0" VALUE 0x804F997E Val_Wu8 1.00000000000 DFES_EnvTabVerb 0.00 1.00000000000 FORMAT "%13.11" /end CHARACTERISTIC
/begin CHARACTERISTIC DFES_EnvRef.DFC_IgnClPs_LineScg_1_C "used environment signals / Reference to used environment condition set for check DFC_IgnClPs_LineScg_1" VALUE 0x804F997F Val_Wu8 1.00000000000 DFES_EnvTabVerb 0.00 1.00000000000 FORMAT "%13.11" /end CHARACTERISTIC
/begin CHARACTERISTIC DFES_EnvRef.DFC_IgnClPs_LineScg_2_C "used environment signals / Reference to used environment condition set for check DFC_IgnClPs_LineScg_2" VALUE 0x804F9980 Val_Wu8 1.00000000000 DFES_EnvTabVerb 0.00 1.00000000000 FORMAT "%13.11" /end CHARACTERISTIC
/begin CHARACTERISTIC DFES_EnvRef.DFC_IgnClPs_LineScg_3_C "used environment signals / Reference to used environment condition set for check DFC_IgnClPs_LineScg_3" VALUE 0x804F9981 Val_Wu8 1.00000000000 DFES_EnvTabVerb 0.00 1.00000000000 FORMAT "%13.11" /end CHARACTERISTIC
/begin CHARACTERISTIC DFES_EnvRef.DFC_UEGOASICS1B1_C "used environment signals / Reference to used environment condition set for check DFC_UEGOASICS1B1" VALUE 0x804F9982 Val_Wu8 1.00000000000 DFES_EnvTabVerb 0.00 1.00000000000 FORMAT "%13.11" /end CHARACTERISTIC
/begin CHARACTERISTIC DFES_EnvRef.DFC_UEGOOLIPES1B1_C "used environment signals / Reference to used environment condition set for check DFC_UEGOOLIPES1B1" VALUE 0x804F9983 Val_Wu8 1.00000000000 DFES_EnvTabVerb 0.00 1.00000000000 FORMAT "%13.11" /end CHARACTERISTIC
/begin CHARACTERISTIC DFES_EnvRef.DFC_UEGOOLRES1B1_C "used environment signals / Reference to used environment condition set for check DFC_UEGOOLRES1B1" VALUE 0x804F9984 Val_Wu8 1.00000000000 DFES_EnvTabVerb 0.00 1.00000000000 FORMAT "%13.11" /end CHARACTERISTIC
/begin CHARACTERISTIC DFES_EnvRef.DFC_UEGOSCBS1B1_C "used environment signals / Reference to used environment condition set for check DFC_UEGOSCBS1B1" VALUE 0x804F9985 Val_Wu8 1.00000000000 DFES_EnvTabVerb 0.00 1.00000000000 FORMAT "%13.11" /end CHARACTERISTIC
/begin CHARACTERISTIC DFES_EnvRef.DFC_UEGOSCGS1B1_C "used environment signals / Reference to used environment condition set for check DFC_UEGOSCGS1B1" VALUE 0x804F9986 Val_Wu8 1.00000000000 DFES_EnvTabVerb 0.00 1.00000000000 FORMAT "%13.11" /end CHARACTERISTIC
/begin CHARACTERISTIC DFES_EnvRef.DFC_UEGOSPIS1B1_C "used environment signals / Reference to used environment condition set for check DFC_UEGOSPIS1B1" VALUE 0x804F9987 Val_Wu8 1.00000000000 DFES_EnvTabVerb 0.00 1.00000000000 FORMAT "%13.11" /end CHARACTERISTIC
/begin CHARACTERISTIC DFES_EnvRef.DFC_UEGOSnsrS1B1_C "used environment signals / Reference to used environment condition set for check DFC_UEGOSnsrS1B1" VALUE 0x804F9988 Val_Wu8 1.00000000000 DFES_EnvTabVerb 0.00 1.00000000000 FORMAT "%13.11" /end CHARACTERISTIC
/begin CHARACTERISTIC DFES_EnvRef.DFC_UegoOlApesS1B1_C "used environment signals / Reference to used environment condition set for check DFC_UegoOlApesS1B1" VALUE 0x804F9989 Val_Wu8 1.00000000000 DFES_EnvTabVerb 0.00 1.00000000000 FORMAT "%13.11" /end CHARACTERISTIC
/begin CHARACTERISTIC DFES_EnvRef.DFC_UegoOlRCmpS1B1_C "used environment signals / Reference to used environment condition set for check DFC_UegoOlRCmpS1B1" VALUE 0x804F998A Val_Wu8 1.00000000000 DFES_EnvTabVerb 0.00 1.00000000000 FORMAT "%13.11" /end CHARACTERISTIC
/begin CHARACTERISTIC DFES_EnvRef.DFC_AirCCmprOL_C "used environment signals / Reference to used environment condition set for check DFC_AirCCmprOL" VALUE 0x804F998B Val_Wu8 1.00000000000 DFES_EnvTabVerb 0.00 1.00000000000 FORMAT "%13.11" /end CHARACTERISTIC
/begin CHARACTERISTIC DFES_EnvRef.DFC_AirCCmprOvrTemp_C "used environment signals / Reference to used environment condition set for check DFC_AirCCmprOvrTemp" VALUE 0x804F998C Val_Wu8 1.00000000000 DFES_EnvTabVerb 0.00 1.00000000000 FORMAT "%13.11" /end CHARACTERISTIC
/begin CHARACTERISTIC DFES_EnvRef.DFC_AirCCmprSCB_C "used environment signals / Reference to used environment condition set for check DFC_AirCCmprSCB" VALUE 0x804F998D Val_Wu8 1.00000000000 DFES_EnvTabVerb 0.00 1.00000000000 FORMAT "%13.11" /end CHARACTERISTIC
/begin CHARACTERISTIC DFES_EnvRef.DFC_AirCCmprSCG_C "used environment signals / Reference to used environment condition set for check DFC_AirCCmprSCG" VALUE 0x804F998E Val_Wu8 1.00000000000 DFES_EnvTabVerb 0.00 1.00000000000 FORMAT "%13.11" /end CHARACTERISTIC
/begin CHARACTERISTIC DFES_EnvRef.DFC_AltErr_C "used environment signals / Reference to used environment condition set for check DFC_AltErr" VALUE 0x804F998F Val_Wu8 1.00000000000 DFES_EnvTabVerb 0.00 1.00000000000 FORMAT "%13.11" /end CHARACTERISTIC
/begin CHARACTERISTIC DFES_EnvRef.DFC_BattUSRCMax_C "used environment signals / Reference to used environment condition set for check DFC_BattUSRCMax" VALUE 0x804F9990 Val_Wu8 1.00000000000 DFES_EnvTabVerb 0.00 1.00000000000 FORMAT "%13.11" /end CHARACTERISTIC
/begin CHARACTERISTIC DFES_EnvRef.DFC_BattUSRCMin_C "used environment signals / Reference to used environment condition set for check DFC_BattUSRCMin" VALUE 0x804F9991 Val_Wu8 1.00000000000 DFES_EnvTabVerb 0.00 1.00000000000 FORMAT "%13.11" /end CHARACTERISTIC
/begin CHARACTERISTIC DFES_EnvRef.DFC_ComChksTCU1_C "used environment signals / Reference to used environment condition set for check DFC_ComChksTCU1" VALUE 0x804F9992 Val_Wu8 1.00000000000 DFES_EnvTabVerb 0.00 1.00000000000 FORMAT "%13.11" /end CHARACTERISTIC
/begin CHARACTERISTIC DFES_EnvRef.DFC_ComChksTCU11_C "used environment signals / Reference to used environment condition set for check DFC_ComChksTCU11" VALUE 0x804F9993 Val_Wu8 1.00000000000 DFES_EnvTabVerb 0.00 1.00000000000 FORMAT "%13.11" /end CHARACTERISTIC
/begin CHARACTERISTIC DFES_EnvRef.DFC_ComChksTCU12_C "used environment signals / Reference to used environment condition set for check DFC_ComChksTCU12" VALUE 0x804F9994 Val_Wu8 1.00000000000 DFES_EnvTabVerb 0.00 1.00000000000 FORMAT "%13.11" /end CHARACTERISTIC
/begin CHARACTERISTIC DFES_EnvRef.DFC_ComChksTCU13_C "used environment signals / Reference to used environment condition set for check DFC_ComChksTCU13" VALUE 0x804F9995 Val_Wu8 1.00000000000 DFES_EnvTabVerb 0.00 1.00000000000 FORMAT "%13.11" /end CHARACTERISTIC
/begin CHARACTERISTIC DFES_EnvRef.DFC_ComChksTCU2_C "used environment signals / Reference to used environment condition set for check DFC_ComChksTCU2" VALUE 0x804F9996 Val_Wu8 1.00000000000 DFES_EnvTabVerb 0.00 1.00000000000 FORMAT "%13.11" /end CHARACTERISTIC
/begin CHARACTERISTIC DFES_EnvRef.DFC_ComChksTCU3_C "used environment signals / Reference to used environment condition set for check DFC_ComChksTCU3" VALUE 0x804F9997 Val_Wu8 1.00000000000 DFES_EnvTabVerb 0.00 1.00000000000 FORMAT "%13.11" /end CHARACTERISTIC
/begin CHARACTERISTIC DFES_EnvRef.DFC_ComChksTCU4_C "used environment signals / Reference to used environment condition set for check DFC_ComChksTCU4" VALUE 0x804F9998 Val_Wu8 1.00000000000 DFES_EnvTabVerb 0.00 1.00000000000 FORMAT "%13.11" /end CHARACTERISTIC
/begin CHARACTERISTIC DFES_EnvRef.DFC_ComCntTCU1_C "used environment signals / Reference to used environment condition set for check DFC_ComCntTCU1" VALUE 0x804F9999 Val_Wu8 1.00000000000 DFES_EnvTabVerb 0.00 1.00000000000 FORMAT "%13.11" /end CHARACTERISTIC
/begin CHARACTERISTIC DFES_EnvRef.DFC_ComCntTCU11_C "used environment signals / Reference to used environment condition set for check DFC_ComCntTCU11" VALUE 0x804F999A Val_Wu8 1.00000000000 DFES_EnvTabVerb 0.00 1.00000000000 FORMAT "%13.11" /end CHARACTERISTIC
/begin CHARACTERISTIC DFES_EnvRef.DFC_ComCntTCU12_C "used environment signals / Reference to used environment condition set for check DFC_ComCntTCU12" VALUE 0x804F999B Val_Wu8 1.00000000000 DFES_EnvTabVerb 0.00 1.00000000000 FORMAT "%13.11" /end CHARACTERISTIC
/begin CHARACTERISTIC DFES_EnvRef.DFC_ComCntTCU13_C "used environment signals / Reference to used environment condition set for check DFC_ComCntTCU13" VALUE 0x804F999C Val_Wu8 1.00000000000 DFES_EnvTabVerb 0.00 1.00000000000 FORMAT "%13.11" /end CHARACTERISTIC
/begin CHARACTERISTIC DFES_EnvRef.DFC_ComCntTCU2_C "used environment signals / Reference to used environment condition set for check DFC_ComCntTCU2" VALUE 0x804F999D Val_Wu8 1.00000000000 DFES_EnvTabVerb 0.00 1.00000000000 FORMAT "%13.11" /end CHARACTERISTIC
/begin CHARACTERISTIC DFES_EnvRef.DFC_ComCntTCU3_C "used environment signals / Reference to used environment condition set for check DFC_ComCntTCU3" VALUE 0x804F999E Val_Wu8 1.00000000000 DFES_EnvTabVerb 0.00 1.00000000000 FORMAT "%13.11" /end CHARACTERISTIC
/begin CHARACTERISTIC DFES_EnvRef.DFC_ComCntTCU4_C "used environment signals / Reference to used environment condition set for check DFC_ComCntTCU4" VALUE 0x804F999F Val_Wu8 1.00000000000 DFES_EnvTabVerb 0.00 1.00000000000 FORMAT "%13.11" /end CHARACTERISTIC
/begin CHARACTERISTIC DFES_EnvRef.DFC_ComTOutTCU01_C "used environment signals / Reference to used environment condition set for check DFC_ComTOutTCU01" VALUE 0x804F99A0 Val_Wu8 1.00000000000 DFES_EnvTabVerb 0.00 1.00000000000 FORMAT "%13.11" /end CHARACTERISTIC
/begin CHARACTERISTIC DFES_EnvRef.DFC_ComTOutTCU02_C "used environment signals / Reference to used environment condition set for check DFC_ComTOutTCU02" VALUE 0x804F99A1 Val_Wu8 1.00000000000 DFES_EnvTabVerb 0.00 1.00000000000 FORMAT "%13.11" /end CHARACTERISTIC
/begin CHARACTERISTIC DFES_EnvRef.DFC_ComTOutTCU1_C "used environment signals / Reference to used environment condition set for check DFC_ComTOutTCU1" VALUE 0x804F99A2 Val_Wu8 1.00000000000 DFES_EnvTabVerb 0.00 1.00000000000 FORMAT "%13.11" /end CHARACTERISTIC
/begin CHARACTERISTIC DFES_EnvRef.DFC_ComTOutTCU11_C "used environment signals / Reference to used environment condition set for check DFC_ComTOutTCU11" VALUE 0x804F99A3 Val_Wu8 1.00000000000 DFES_EnvTabVerb 0.00 1.00000000000 FORMAT "%13.11" /end CHARACTERISTIC
/begin CHARACTERISTIC DFES_EnvRef.DFC_ComTOutTCU12_C "used environment signals / Reference to used environment condition set for check DFC_ComTOutTCU12" VALUE 0x804F99A4 Val_Wu8 1.00000000000 DFES_EnvTabVerb 0.00 1.00000000000 FORMAT "%13.11" /end CHARACTERISTIC
/begin CHARACTERISTIC DFES_EnvRef.DFC_ComTOutTCU13_C "used environment signals / Reference to used environment condition set for check DFC_ComTOutTCU13" VALUE 0x804F99A5 Val_Wu8 1.00000000000 DFES_EnvTabVerb 0.00 1.00000000000 FORMAT "%13.11" /end CHARACTERISTIC
/begin CHARACTERISTIC DFES_EnvRef.DFC_ComTOutTCU14_C "used environment signals / Reference to used environment condition set for check DFC_ComTOutTCU14" VALUE 0x804F99A6 Val_Wu8 1.00000000000 DFES_EnvTabVerb 0.00 1.00000000000 FORMAT "%13.11" /end CHARACTERISTIC
/begin CHARACTERISTIC DFES_EnvRef.DFC_ComTOutTCU2_C "used environment signals / Reference to used environment condition set for check DFC_ComTOutTCU2" VALUE 0x804F99A7 Val_Wu8 1.00000000000 DFES_EnvTabVerb 0.00 1.00000000000 FORMAT "%13.11" /end CHARACTERISTIC
/begin CHARACTERISTIC DFES_EnvRef.DFC_ComTOutTCU3_C "used environment signals / Reference to used environment condition set for check DFC_ComTOutTCU3" VALUE 0x804F99A8 Val_Wu8 1.00000000000 DFES_EnvTabVerb 0.00 1.00000000000 FORMAT "%13.11" /end CHARACTERISTIC
/begin CHARACTERISTIC DFES_EnvRef.DFC_ComTOutTCU4_C "used environment signals / Reference to used environment condition set for check DFC_ComTOutTCU4" VALUE 0x804F99A9 Val_Wu8 1.00000000000 DFES_EnvTabVerb 0.00 1.00000000000 FORMAT "%13.11" /end CHARACTERISTIC
/begin CHARACTERISTIC DFES_EnvRef.DFC_DevLibBattUHi_C "used environment signals / Reference to used environment condition set for check DFC_DevLibBattUHi" VALUE 0x804F99AA Val_Wu8 1.00000000000 DFES_EnvTabVerb 0.00 1.00000000000 FORMAT "%13.11" /end CHARACTERISTIC
/begin CHARACTERISTIC DFES_EnvRef.DFC_DevLibBattULo_C "used environment signals / Reference to used environment condition set for check DFC_DevLibBattULo" VALUE 0x804F99AB Val_Wu8 1.00000000000 DFES_EnvTabVerb 0.00 1.00000000000 FORMAT "%13.11" /end CHARACTERISTIC
/begin CHARACTERISTIC DFES_EnvRef.DFC_FanDIOOL_0_C "used environment signals / Reference to used environment condition set for check DFC_FanDIOOL_0" VALUE 0x804F99AC Val_Wu8 1.00000000000 DFES_EnvTabVerb 0.00 1.00000000000 FORMAT "%13.11" /end CHARACTERISTIC
/begin CHARACTERISTIC DFES_EnvRef.DFC_FanDIOOL_1_C "used environment signals / Reference to used environment condition set for check DFC_FanDIOOL_1" VALUE 0x804F99AD Val_Wu8 1.00000000000 DFES_EnvTabVerb 0.00 1.00000000000 FORMAT "%13.11" /end CHARACTERISTIC
/begin CHARACTERISTIC DFES_EnvRef.DFC_FanDIOOvrTemp_0_C "used environment signals / Reference to used environment condition set for check DFC_FanDIOOvrTemp_0" VALUE 0x804F99AE Val_Wu8 1.00000000000 DFES_EnvTabVerb 0.00 1.00000000000 FORMAT "%13.11" /end CHARACTERISTIC
/begin CHARACTERISTIC DFES_EnvRef.DFC_FanDIOOvrTemp_1_C "used environment signals / Reference to used environment condition set for check DFC_FanDIOOvrTemp_1" VALUE 0x804F99AF Val_Wu8 1.00000000000 DFES_EnvTabVerb 0.00 1.00000000000 FORMAT "%13.11" /end CHARACTERISTIC
/begin CHARACTERISTIC DFES_EnvRef.DFC_FanDIOSCB_0_C "used environment signals / Reference to used environment condition set for check DFC_FanDIOSCB_0" VALUE 0x804F99B0 Val_Wu8 1.00000000000 DFES_EnvTabVerb 0.00 1.00000000000 FORMAT "%13.11" /end CHARACTERISTIC
/begin CHARACTERISTIC DFES_EnvRef.DFC_FanDIOSCB_1_C "used environment signals / Reference to used environment condition set for check DFC_FanDIOSCB_1" VALUE 0x804F99B1 Val_Wu8 1.00000000000 DFES_EnvTabVerb 0.00 1.00000000000 FORMAT "%13.11" /end CHARACTERISTIC
/begin CHARACTERISTIC DFES_EnvRef.DFC_FanDIOSCG_0_C "used environment signals / Reference to used environment condition set for check DFC_FanDIOSCG_0" VALUE 0x804F99B2 Val_Wu8 1.00000000000 DFES_EnvTabVerb 0.00 1.00000000000 FORMAT "%13.11" /end CHARACTERISTIC
/begin CHARACTERISTIC DFES_EnvRef.DFC_FanDIOSCG_1_C "used environment signals / Reference to used environment condition set for check DFC_FanDIOSCG_1" VALUE 0x804F99B3 Val_Wu8 1.00000000000 DFES_EnvTabVerb 0.00 1.00000000000 FORMAT "%13.11" /end CHARACTERISTIC
/begin CHARACTERISTIC DFES_EnvRef.DFC_MRlyDcOL_C "used environment signals / Reference to used environment condition set for check DFC_MRlyDcOL" VALUE 0x804F99B4 Val_Wu8 1.00000000000 DFES_EnvTabVerb 0.00 1.00000000000 FORMAT "%13.11" /end CHARACTERISTIC
/begin CHARACTERISTIC DFES_EnvRef.DFC_MRlyDcSCB_C "used environment signals / Reference to used environment condition set for check DFC_MRlyDcSCB" VALUE 0x804F99B5 Val_Wu8 1.00000000000 DFES_EnvTabVerb 0.00 1.00000000000 FORMAT "%13.11" /end CHARACTERISTIC
/begin CHARACTERISTIC DFES_EnvRef.DFC_MRlyDcSCG_C "used environment signals / Reference to used environment condition set for check DFC_MRlyDcSCG" VALUE 0x804F99B6 Val_Wu8 1.00000000000 DFES_EnvTabVerb 0.00 1.00000000000 FORMAT "%13.11" /end CHARACTERISTIC
/begin CHARACTERISTIC DFES_EnvRef.DFC_PSPOL_C "used environment signals / Reference to used environment condition set for check DFC_PSPOL" VALUE 0x804F99B7 Val_Wu8 1.00000000000 DFES_EnvTabVerb 0.00 1.00000000000 FORMAT "%13.11" /end CHARACTERISTIC
/begin CHARACTERISTIC DFES_EnvRef.DFC_PSPOvrTemp_C "used environment signals / Reference to used environment condition set for check DFC_PSPOvrTemp" VALUE 0x804F99B8 Val_Wu8 1.00000000000 DFES_EnvTabVerb 0.00 1.00000000000 FORMAT "%13.11" /end CHARACTERISTIC
/begin CHARACTERISTIC DFES_EnvRef.DFC_PSPSCB_C "used environment signals / Reference to used environment condition set for check DFC_PSPSCB" VALUE 0x804F99B9 Val_Wu8 1.00000000000 DFES_EnvTabVerb 0.00 1.00000000000 FORMAT "%13.11" /end CHARACTERISTIC
/begin CHARACTERISTIC DFES_EnvRef.DFC_PSPSCG_C "used environment signals / Reference to used environment condition set for check DFC_PSPSCG" VALUE 0x804F99BA Val_Wu8 1.00000000000 DFES_EnvTabVerb 0.00 1.00000000000 FORMAT "%13.11" /end CHARACTERISTIC
/begin CHARACTERISTIC DFES_EnvRef.DFC_T50Err_C "used environment signals / Reference to used environment condition set for check DFC_T50Err" VALUE 0x804F99BB Val_Wu8 1.00000000000 DFES_EnvTabVerb 0.00 1.00000000000 FORMAT "%13.11" /end CHARACTERISTIC
/begin CHARACTERISTIC DFES_EnvRef.DFC_ThrVlvLoBattB1_C "used environment signals / Reference to used environment condition set for check DFC_ThrVlvLoBattB1" VALUE 0x804F99BC Val_Wu8 1.00000000000 DFES_EnvTabVerb 0.00 1.00000000000 FORMAT "%13.11" /end CHARACTERISTIC
/begin CHARACTERISTIC DFES_EnvRef.DFC_VehVPhysRngHi_C "used environment signals / Reference to used environment condition set for check DFC_VehVPhysRngHi" VALUE 0x804F99BD Val_Wu8 1.00000000000 DFES_EnvTabVerb 0.00 1.00000000000 FORMAT "%13.11" /end CHARACTERISTIC
/begin CHARACTERISTIC DFES_EnvRef.DFC_VehVSclOutOL_C "used environment signals / Reference to used environment condition set for check DFC_VehVSclOutOL" VALUE 0x804F99BE Val_Wu8 1.00000000000 DFES_EnvTabVerb 0.00 1.00000000000 FORMAT "%13.11" /end CHARACTERISTIC
/begin CHARACTERISTIC DFES_EnvRef.DFC_VehVSclOutOT_C "used environment signals / Reference to used environment condition set for check DFC_VehVSclOutOT" VALUE 0x804F99BF Val_Wu8 1.00000000000 DFES_EnvTabVerb 0.00 1.00000000000 FORMAT "%13.11" /end CHARACTERISTIC
/begin CHARACTERISTIC DFES_EnvRef.DFC_VehVSclOutSCB_C "used environment signals / Reference to used environment condition set for check DFC_VehVSclOutSCB" VALUE 0x804F99C0 Val_Wu8 1.00000000000 DFES_EnvTabVerb 0.00 1.00000000000 FORMAT "%13.11" /end CHARACTERISTIC
/begin CHARACTERISTIC DFES_EnvRef.DFC_VehVSclOutSCG_C "used environment signals / Reference to used environment condition set for check DFC_VehVSclOutSCG" VALUE 0x804F99C1 Val_Wu8 1.00000000000 DFES_EnvTabVerb 0.00 1.00000000000 FORMAT "%13.11" /end CHARACTERISTIC
/begin CHARACTERISTIC DFES_EnvRef.DFC_VehVSnsrARngHi_C "used environment signals / Reference to used environment condition set for check DFC_VehVSnsrARngHi" VALUE 0x804F99C2 Val_Wu8 1.00000000000 DFES_EnvTabVerb 0.00 1.00000000000 FORMAT "%13.11" /end CHARACTERISTIC
/begin CHARACTERISTIC DFES_EnvRef.DFC_VehVSnsrBRngHi_C "used environment signals / Reference to used environment condition set for check DFC_VehVSnsrBRngHi" VALUE 0x804F99C3 Val_Wu8 1.00000000000 DFES_EnvTabVerb 0.00 1.00000000000 FORMAT "%13.11" /end CHARACTERISTIC
/begin CHARACTERISTIC DFES_EnvRef.DFC_VehVSpdRtyDiag_C "used environment signals / Reference to used environment condition set for check DFC_VehVSpdRtyDiag" VALUE 0x804F99C4 Val_Wu8 1.00000000000 DFES_EnvTabVerb 0.00 1.00000000000 FORMAT "%13.11" /end CHARACTERISTIC
/begin CHARACTERISTIC DFES_EnvRef.DFC_VehVWhlErr_C "used environment signals / Reference to used environment condition set for check DFC_VehVWhlErr" VALUE 0x804F99C5 Val_Wu8 1.00000000000 DFES_EnvTabVerb 0.00 1.00000000000 FORMAT "%13.11" /end CHARACTERISTIC
/begin CHARACTERISTIC DFES_EnvRef.DFC_ACEvpTSRCMax_C "used environment signals / Reference to used environment condition set for check DFC_ACEvpTSRCMax" VALUE 0x804F99C6 Val_Wu8 1.00000000000 DFES_EnvTabVerb 0.00 1.00000000000 FORMAT "%13.11" /end CHARACTERISTIC
/begin CHARACTERISTIC DFES_EnvRef.DFC_ACEvpTSRCMin_C "used environment signals / Reference to used environment condition set for check DFC_ACEvpTSRCMin" VALUE 0x804F99C7 Val_Wu8 1.00000000000 DFES_EnvTabVerb 0.00 1.00000000000 FORMAT "%13.11" /end CHARACTERISTIC
/begin CHARACTERISTIC DFES_EnvRef.DFC_AirCClntPAnaSRCMax_C "used environment signals / Reference to used environment condition set for check DFC_AirCClntPAnaSRCMax" VALUE 0x804F99C8 Val_Wu8 1.00000000000 DFES_EnvTabVerb 0.00 1.00000000000 FORMAT "%13.11" /end CHARACTERISTIC
/begin CHARACTERISTIC DFES_EnvRef.DFC_AirCClntPAnaSRCMin_C "used environment signals / Reference to used environment condition set for check DFC_AirCClntPAnaSRCMin" VALUE 0x804F99C9 Val_Wu8 1.00000000000 DFES_EnvTabVerb 0.00 1.00000000000 FORMAT "%13.11" /end CHARACTERISTIC
/begin CHARACTERISTIC DFES_EnvRef.DFC_AirCSwtNpl_C "used environment signals / Reference to used environment condition set for check DFC_AirCSwtNpl" VALUE 0x804F99CA Val_Wu8 1.00000000000 DFES_EnvTabVerb 0.00 1.00000000000 FORMAT "%13.11" /end CHARACTERISTIC
/begin CHARACTERISTIC DFES_EnvRef.DFC_AirCSwtSig_C "used environment signals / Reference to used environment condition set for check DFC_AirCSwtSig" VALUE 0x804F99CB Val_Wu8 1.00000000000 DFES_EnvTabVerb 0.00 1.00000000000 FORMAT "%13.11" /end CHARACTERISTIC
/begin CHARACTERISTIC DFES_EnvRef.DFC_Brk_C "used environment signals / Reference to used environment condition set for check DFC_Brk" VALUE 0x804F99CC Val_Wu8 1.00000000000 DFES_EnvTabVerb 0.00 1.00000000000 FORMAT "%13.11" /end CHARACTERISTIC
/begin CHARACTERISTIC DFES_EnvRef.DFC_BrkSig_C "used environment signals / Reference to used environment condition set for check DFC_BrkSig" VALUE 0x804F99CD Val_Wu8 1.00000000000 DFES_EnvTabVerb 0.00 1.00000000000 FORMAT "%13.11" /end CHARACTERISTIC
/begin CHARACTERISTIC DFES_EnvRef.DFC_ClthSig_C "used environment signals / Reference to used environment condition set for check DFC_ClthSig" VALUE 0x804F99CE Val_Wu8 1.00000000000 DFES_EnvTabVerb 0.00 1.00000000000 FORMAT "%13.11" /end CHARACTERISTIC
/begin CHARACTERISTIC DFES_EnvRef.DFC_HLSDemOvhtEngLim_C "used environment signals / Reference to used environment condition set for check DFC_HLSDemOvhtEngLim" VALUE 0x804F99CF Val_Wu8 1.00000000000 DFES_EnvTabVerb 0.00 1.00000000000 FORMAT "%13.11" /end CHARACTERISTIC
/begin CHARACTERISTIC DFES_EnvRef.DFC_OilPNpl_C "used environment signals / Reference to used environment condition set for check DFC_OilPNpl" VALUE 0x804F99D0 Val_Wu8 1.00000000000 DFES_EnvTabVerb 0.00 1.00000000000 FORMAT "%13.11" /end CHARACTERISTIC
/begin CHARACTERISTIC DFES_EnvRef.DFC_PIntkVUsLineHiB1_C "used environment signals / Reference to used environment condition set for check DFC_PIntkVUsLineHiB1" VALUE 0x804F99D1 Val_Wu8 1.00000000000 DFES_EnvTabVerb 0.00 1.00000000000 FORMAT "%13.11" /end CHARACTERISTIC
/begin CHARACTERISTIC DFES_EnvRef.DFC_PIntkVUsLineLoB1_C "used environment signals / Reference to used environment condition set for check DFC_PIntkVUsLineLoB1" VALUE 0x804F99D2 Val_Wu8 1.00000000000 DFES_EnvTabVerb 0.00 1.00000000000 FORMAT "%13.11" /end CHARACTERISTIC
/begin CHARACTERISTIC DFES_EnvRef.DFC_VehVPhysRngLo_C "used environment signals / Reference to used environment condition set for check DFC_VehVPhysRngLo" VALUE 0x804F99D3 Val_Wu8 1.00000000000 DFES_EnvTabVerb 0.00 1.00000000000 FORMAT "%13.11" /end CHARACTERISTIC
/begin CHARACTERISTIC DFES_EnvRef.DFC_VehVSigCan_C "used environment signals / Reference to used environment condition set for check DFC_VehVSigCan" VALUE 0x804F99D4 Val_Wu8 1.00000000000 DFES_EnvTabVerb 0.00 1.00000000000 FORMAT "%13.11" /end CHARACTERISTIC
/begin CHARACTERISTIC DFES_EnvRef.DFC_VehVSigCanSafe_C "used environment signals / Reference to used environment condition set for check DFC_VehVSigCanSafe" VALUE 0x804F99D5 Val_Wu8 1.00000000000 DFES_EnvTabVerb 0.00 1.00000000000 FORMAT "%13.11" /end CHARACTERISTIC
/begin CHARACTERISTIC DFES_EnvRef.DFC_VlvLftFbOilPSnsrIntk11SRCMax_C "used environment signals / Reference to used environment condition set for check DFC_VlvLftFbOilPSnsrIntk11SRCMax" VALUE 0x804F99D6 Val_Wu8 1.00000000000 DFES_EnvTabVerb 0.00 1.00000000000 FORMAT "%13.11" /end CHARACTERISTIC
/begin CHARACTERISTIC DFES_EnvRef.DFC_VlvLftFbOilPSnsrIntk11SRCMin_C "used environment signals / Reference to used environment condition set for check DFC_VlvLftFbOilPSnsrIntk11SRCMin" VALUE 0x804F99D7 Val_Wu8 1.00000000000 DFES_EnvTabVerb 0.00 1.00000000000 FORMAT "%13.11" /end CHARACTERISTIC
/begin CHARACTERISTIC DFES_EnvRef.DFC_ClthNpl_C "used environment signals / Reference to used environment condition set for check DFC_ClthNpl" VALUE 0x804F99D8 Val_Wu8 1.00000000000 DFES_EnvTabVerb 0.00 1.00000000000 FORMAT "%13.11" /end CHARACTERISTIC
/begin CHARACTERISTIC DFES_EnvRef.DFC_EV1max_C "used environment signals / Reference to used environment condition set for check DFC_EV1max" VALUE 0x804F99D9 Val_Wu8 1.00000000000 DFES_EnvTabVerb 0.00 1.00000000000 FORMAT "%13.11" /end CHARACTERISTIC
/begin CHARACTERISTIC DFES_EnvRef.DFC_EV1min_C "used environment signals / Reference to used environment condition set for check DFC_EV1min" VALUE 0x804F99DA Val_Wu8 1.00000000000 DFES_EnvTabVerb 0.00 1.00000000000 FORMAT "%13.11" /end CHARACTERISTIC
/begin CHARACTERISTIC DFES_EnvRef.DFC_EV1sig_C "used environment signals / Reference to used environment condition set for check DFC_EV1sig" VALUE 0x804F99DB Val_Wu8 1.00000000000 DFES_EnvTabVerb 0.00 1.00000000000 FORMAT "%13.11" /end CHARACTERISTIC
/begin CHARACTERISTIC DFES_EnvRef.DFC_EV2max_C "used environment signals / Reference to used environment condition set for check DFC_EV2max" VALUE 0x804F99DC Val_Wu8 1.00000000000 DFES_EnvTabVerb 0.00 1.00000000000 FORMAT "%13.11" /end CHARACTERISTIC
/begin CHARACTERISTIC DFES_EnvRef.DFC_EV2min_C "used environment signals / Reference to used environment condition set for check DFC_EV2min" VALUE 0x804F99DD Val_Wu8 1.00000000000 DFES_EnvTabVerb 0.00 1.00000000000 FORMAT "%13.11" /end CHARACTERISTIC
/begin CHARACTERISTIC DFES_EnvRef.DFC_EV2sig_C "used environment signals / Reference to used environment condition set for check DFC_EV2sig" VALUE 0x804F99DE Val_Wu8 1.00000000000 DFES_EnvTabVerb 0.00 1.00000000000 FORMAT "%13.11" /end CHARACTERISTIC
/begin CHARACTERISTIC DFES_EnvRef.DFC_EV3max_C "used environment signals / Reference to used environment condition set for check DFC_EV3max" VALUE 0x804F99DF Val_Wu8 1.00000000000 DFES_EnvTabVerb 0.00 1.00000000000 FORMAT "%13.11" /end CHARACTERISTIC
/begin CHARACTERISTIC DFES_EnvRef.DFC_EV3min_C "used environment signals / Reference to used environment condition set for check DFC_EV3min" VALUE 0x804F99E0 Val_Wu8 1.00000000000 DFES_EnvTabVerb 0.00 1.00000000000 FORMAT "%13.11" /end CHARACTERISTIC
/begin CHARACTERISTIC DFES_EnvRef.DFC_EV3sig_C "used environment signals / Reference to used environment condition set for check DFC_EV3sig" VALUE 0x804F99E1 Val_Wu8 1.00000000000 DFES_EnvTabVerb 0.00 1.00000000000 FORMAT "%13.11" /end CHARACTERISTIC
/begin CHARACTERISTIC DFES_EnvRef.DFC_EV4max_C "used environment signals / Reference to used environment condition set for check DFC_EV4max" VALUE 0x804F99E2 Val_Wu8 1.00000000000 DFES_EnvTabVerb 0.00 1.00000000000 FORMAT "%13.11" /end CHARACTERISTIC
/begin CHARACTERISTIC DFES_EnvRef.DFC_EV4min_C "used environment signals / Reference to used environment condition set for check DFC_EV4min" VALUE 0x804F99E3 Val_Wu8 1.00000000000 DFES_EnvTabVerb 0.00 1.00000000000 FORMAT "%13.11" /end CHARACTERISTIC
/begin CHARACTERISTIC DFES_EnvRef.DFC_EV4sig_C "used environment signals / Reference to used environment condition set for check DFC_EV4sig" VALUE 0x804F99E4 Val_Wu8 1.00000000000 DFES_EnvTabVerb 0.00 1.00000000000 FORMAT "%13.11" /end CHARACTERISTIC
/begin CHARACTERISTIC DFES_EnvRef.DFC_GbxPNPosnDrvCdn_C "used environment signals / Reference to used environment condition set for check DFC_GbxPNPosnDrvCdn" VALUE 0x804F99E5 Val_Wu8 1.00000000000 DFES_EnvTabVerb 0.00 1.00000000000 FORMAT "%13.11" /end CHARACTERISTIC
/begin CHARACTERISTIC DFES_EnvRef.DFC_GbxPNPosnPlausy_C "used environment signals / Reference to used environment condition set for check DFC_GbxPNPosnPlausy" VALUE 0x804F99E6 Val_Wu8 1.00000000000 DFES_EnvTabVerb 0.00 1.00000000000 FORMAT "%13.11" /end CHARACTERISTIC
/begin CHARACTERISTIC DFES_EnvRef.DFC_PEnvCcMax_C "used environment signals / Reference to used environment condition set for check DFC_PEnvCcMax" VALUE 0x804F99E7 Val_Wu8 1.00000000000 DFES_EnvTabVerb 0.00 1.00000000000 FORMAT "%13.11" /end CHARACTERISTIC
/begin CHARACTERISTIC DFES_EnvRef.DFC_PEnvCcMin_C "used environment signals / Reference to used environment condition set for check DFC_PEnvCcMin" VALUE 0x804F99E8 Val_Wu8 1.00000000000 DFES_EnvTabVerb 0.00 1.00000000000 FORMAT "%13.11" /end CHARACTERISTIC
/begin CHARACTERISTIC DFES_EnvRef.DFC_PEnvRngChkMax_C "used environment signals / Reference to used environment condition set for check DFC_PEnvRngChkMax" VALUE 0x804F99E9 Val_Wu8 1.00000000000 DFES_EnvTabVerb 0.00 1.00000000000 FORMAT "%13.11" /end CHARACTERISTIC
/begin CHARACTERISTIC DFES_EnvRef.DFC_PEnvRngChkMin_C "used environment signals / Reference to used environment condition set for check DFC_PEnvRngChkMin" VALUE 0x804F99EA Val_Wu8 1.00000000000 DFES_EnvTabVerb 0.00 1.00000000000 FORMAT "%13.11" /end CHARACTERISTIC
/begin CHARACTERISTIC DFES_EnvRef.DFC_PEnvSnsrPlaus_C "used environment signals / Reference to used environment condition set for check DFC_PEnvSnsrPlaus" VALUE 0x804F99EB Val_Wu8 1.00000000000 DFES_EnvTabVerb 0.00 1.00000000000 FORMAT "%13.11" /end CHARACTERISTIC
/begin CHARACTERISTIC DFES_EnvRef.DFC_UEGOHeatrPsS1B1Max_C "used environment signals / Reference to used environment condition set for check DFC_UEGOHeatrPsS1B1Max" VALUE 0x804F99EC Val_Wu8 1.00000000000 DFES_EnvTabVerb 0.00 1.00000000000 FORMAT "%13.11" /end CHARACTERISTIC
/begin CHARACTERISTIC DFES_EnvRef.DFC_UEGOHeatrPsS1B1Min_C "used environment signals / Reference to used environment condition set for check DFC_UEGOHeatrPsS1B1Min" VALUE 0x804F99ED Val_Wu8 1.00000000000 DFES_EnvTabVerb 0.00 1.00000000000 FORMAT "%13.11" /end CHARACTERISTIC
/begin CHARACTERISTIC DFES_EnvRef.DFC_UEGOHeatrPsS1B1Sig_C "used environment signals / Reference to used environment condition set for check DFC_UEGOHeatrPsS1B1Sig" VALUE 0x804F99EE Val_Wu8 1.00000000000 DFES_EnvTabVerb 0.00 1.00000000000 FORMAT "%13.11" /end CHARACTERISTIC
/begin CHARACTERISTIC DFES_EnvRef.DFC_UEGOHeatrRlyPsOLS1B1_C "used environment signals / Reference to used environment condition set for check DFC_UEGOHeatrRlyPsOLS1B1" VALUE 0x804F99EF Val_Wu8 1.00000000000 DFES_EnvTabVerb 0.00 1.00000000000 FORMAT "%13.11" /end CHARACTERISTIC
/begin CHARACTERISTIC DFES_EnvRef.DFC_UEGOHeatrRlyPsSCBS1B1_C "used environment signals / Reference to used environment condition set for check DFC_UEGOHeatrRlyPsSCBS1B1" VALUE 0x804F99F0 Val_Wu8 1.00000000000 DFES_EnvTabVerb 0.00 1.00000000000 FORMAT "%13.11" /end CHARACTERISTIC
/begin CHARACTERISTIC DFES_EnvRef.DFC_UEGOHeatrRlyPsSCGS1B1_C "used environment signals / Reference to used environment condition set for check DFC_UEGOHeatrRlyPsSCGS1B1" VALUE 0x804F99F1 Val_Wu8 1.00000000000 DFES_EnvTabVerb 0.00 1.00000000000 FORMAT "%13.11" /end CHARACTERISTIC
/begin CHARACTERISTIC DFES_EnvRef.DFC_KnDetSens1PortAMax_C "used environment signals / Reference to used environment condition set for check DFC_KnDetSens1PortAMax" VALUE 0x804F99F2 Val_Wu8 1.00000000000 DFES_EnvTabVerb 0.00 1.00000000000 FORMAT "%13.11" /end CHARACTERISTIC
/begin CHARACTERISTIC DFES_EnvRef.DFC_KnDetSens1PortAMin_C "used environment signals / Reference to used environment condition set for check DFC_KnDetSens1PortAMin" VALUE 0x804F99F3 Val_Wu8 1.00000000000 DFES_EnvTabVerb 0.00 1.00000000000 FORMAT "%13.11" /end CHARACTERISTIC
/begin CHARACTERISTIC DFES_EnvRef.DFC_KnDetSens1PortBMax_C "used environment signals / Reference to used environment condition set for check DFC_KnDetSens1PortBMax" VALUE 0x804F99F4 Val_Wu8 1.00000000000 DFES_EnvTabVerb 0.00 1.00000000000 FORMAT "%13.11" /end CHARACTERISTIC
/begin CHARACTERISTIC DFES_EnvRef.DFC_KnDetSens1PortBMin_C "used environment signals / Reference to used environment condition set for check DFC_KnDetSens1PortBMin" VALUE 0x804F99F5 Val_Wu8 1.00000000000 DFES_EnvTabVerb 0.00 1.00000000000 FORMAT "%13.11" /end CHARACTERISTIC
/begin CHARACTERISTIC DFES_EnvRef.DFC_Clth2ONStuck_C "used environment signals / Reference to used environment condition set for check DFC_Clth2ONStuck" VALUE 0x804F99F6 Val_Wu8 1.00000000000 DFES_EnvTabVerb 0.00 1.00000000000 FORMAT "%13.11" /end CHARACTERISTIC
/begin CHARACTERISTIC DFES_EnvRef.DFC_Clth2ONStuckLdc_C "used environment signals / Reference to used environment condition set for check DFC_Clth2ONStuckLdc" VALUE 0x804F99F7 Val_Wu8 1.00000000000 DFES_EnvTabVerb 0.00 1.00000000000 FORMAT "%13.11" /end CHARACTERISTIC
/begin CHARACTERISTIC DFES_EnvRef.DFC_Clth3ONStuckLdc_C "used environment signals / Reference to used environment condition set for check DFC_Clth3ONStuckLdc" VALUE 0x804F99F8 Val_Wu8 1.00000000000 DFES_EnvTabVerb 0.00 1.00000000000 FORMAT "%13.11" /end CHARACTERISTIC
/begin CHARACTERISTIC DFES_EnvRef.DFC_Clth3ONStuckPostDrv_C "used environment signals / Reference to used environment condition set for check DFC_Clth3ONStuckPostDrv" VALUE 0x804F99F9 Val_Wu8 1.00000000000 DFES_EnvTabVerb 0.00 1.00000000000 FORMAT "%13.11" /end CHARACTERISTIC
/begin CHARACTERISTIC DFES_EnvRef.DFC_Clth4ONStuck_C "used environment signals / Reference to used environment condition set for check DFC_Clth4ONStuck" VALUE 0x804F99FA Val_Wu8 1.00000000000 DFES_EnvTabVerb 0.00 1.00000000000 FORMAT "%13.11" /end CHARACTERISTIC
/begin CHARACTERISTIC DFES_EnvRef.DFC_Clth4ONStuckLdc_C "used environment signals / Reference to used environment condition set for check DFC_Clth4ONStuckLdc" VALUE 0x804F99FB Val_Wu8 1.00000000000 DFES_EnvTabVerb 0.00 1.00000000000 FORMAT "%13.11" /end CHARACTERISTIC
/begin CHARACTERISTIC DFES_EnvRef.DFC_ComDLCTCU01_C "used environment signals / Reference to used environment condition set for check DFC_ComDLCTCU01" VALUE 0x804F99FC Val_Wu8 1.00000000000 DFES_EnvTabVerb 0.00 1.00000000000 FORMAT "%13.11" /end CHARACTERISTIC
/begin CHARACTERISTIC DFES_EnvRef.DFC_ComDLCTCU02_C "used environment signals / Reference to used environment condition set for check DFC_ComDLCTCU02" VALUE 0x804F99FD Val_Wu8 1.00000000000 DFES_EnvTabVerb 0.00 1.00000000000 FORMAT "%13.11" /end CHARACTERISTIC
/begin CHARACTERISTIC DFES_EnvRef.DFC_ComDLCTCU1_C "used environment signals / Reference to used environment condition set for check DFC_ComDLCTCU1" VALUE 0x804F99FE Val_Wu8 1.00000000000 DFES_EnvTabVerb 0.00 1.00000000000 FORMAT "%13.11" /end CHARACTERISTIC
/begin CHARACTERISTIC DFES_EnvRef.DFC_ComDLCTCU11_C "used environment signals / Reference to used environment condition set for check DFC_ComDLCTCU11" VALUE 0x804F99FF Val_Wu8 1.00000000000 DFES_EnvTabVerb 0.00 1.00000000000 FORMAT "%13.11" /end CHARACTERISTIC
/begin CHARACTERISTIC DFES_EnvRef.DFC_ComDLCTCU12_C "used environment signals / Reference to used environment condition set for check DFC_ComDLCTCU12" VALUE 0x804F9A00 Val_Wu8 1.00000000000 DFES_EnvTabVerb 0.00 1.00000000000 FORMAT "%13.11" /end CHARACTERISTIC
/begin CHARACTERISTIC DFES_EnvRef.DFC_ComDLCTCU13_C "used environment signals / Reference to used environment condition set for check DFC_ComDLCTCU13" VALUE 0x804F9A01 Val_Wu8 1.00000000000 DFES_EnvTabVerb 0.00 1.00000000000 FORMAT "%13.11" /end CHARACTERISTIC
/begin CHARACTERISTIC DFES_EnvRef.DFC_ComDLCTCU14_C "used environment signals / Reference to used environment condition set for check DFC_ComDLCTCU14" VALUE 0x804F9A02 Val_Wu8 1.00000000000 DFES_EnvTabVerb 0.00 1.00000000000 FORMAT "%13.11" /end CHARACTERISTIC
/begin CHARACTERISTIC DFES_EnvRef.DFC_ComDLCTCU2_C "used environment signals / Reference to used environment condition set for check DFC_ComDLCTCU2" VALUE 0x804F9A03 Val_Wu8 1.00000000000 DFES_EnvTabVerb 0.00 1.00000000000 FORMAT "%13.11" /end CHARACTERISTIC
/begin CHARACTERISTIC DFES_EnvRef.DFC_ComDLCTCU3_C "used environment signals / Reference to used environment condition set for check DFC_ComDLCTCU3" VALUE 0x804F9A04 Val_Wu8 1.00000000000 DFES_EnvTabVerb 0.00 1.00000000000 FORMAT "%13.11" /end CHARACTERISTIC
/begin CHARACTERISTIC DFES_EnvRef.DFC_ComDLCTCU4_C "used environment signals / Reference to used environment condition set for check DFC_ComDLCTCU4" VALUE 0x804F9A05 Val_Wu8 1.00000000000 DFES_EnvTabVerb 0.00 1.00000000000 FORMAT "%13.11" /end CHARACTERISTIC
/begin CHARACTERISTIC DFES_EnvRef.DFC_EVX_C "used environment signals / Reference to used environment condition set for check DFC_EVX" VALUE 0x804F9A06 Val_Wu8 1.00000000000 DFES_EnvTabVerb 0.00 1.00000000000 FORMAT "%13.11" /end CHARACTERISTIC
/begin CHARACTERISTIC DFES_EnvRef.DFC_EbsSocFlt_C "used environment signals / Reference to used environment condition set for check DFC_EbsSocFlt" VALUE 0x804F9A07 Val_Wu8 1.00000000000 DFES_EnvTabVerb 0.00 1.00000000000 FORMAT "%13.11" /end CHARACTERISTIC
/begin CHARACTERISTIC DFES_EnvRef.DFC_I14229VINErr_C "used environment signals / Reference to used environment condition set for check DFC_I14229VINErr" VALUE 0x804F9A08 Val_Wu8 1.00000000000 DFES_EnvTabVerb 0.00 1.00000000000 FORMAT "%13.11" /end CHARACTERISTIC
/begin CHARACTERISTIC DFES_EnvRef.DFC_LLRKHmax_C "used environment signals / Reference to used environment condition set for check DFC_LLRKHmax" VALUE 0x804F9A09 Val_Wu8 1.00000000000 DFES_EnvTabVerb 0.00 1.00000000000 FORMAT "%13.11" /end CHARACTERISTIC
/begin CHARACTERISTIC DFES_EnvRef.DFC_LLRKHmin_C "used environment signals / Reference to used environment condition set for check DFC_LLRKHmin" VALUE 0x804F9A0A Val_Wu8 1.00000000000 DFES_EnvTabVerb 0.00 1.00000000000 FORMAT "%13.11" /end CHARACTERISTIC
/begin CHARACTERISTIC DFES_EnvRef.DFC_LLRmax_C "used environment signals / Reference to used environment condition set for check DFC_LLRmax" VALUE 0x804F9A0B Val_Wu8 1.00000000000 DFES_EnvTabVerb 0.00 1.00000000000 FORMAT "%13.11" /end CHARACTERISTIC
/begin CHARACTERISTIC DFES_EnvRef.DFC_LLRmin_C "used environment signals / Reference to used environment condition set for check DFC_LLRmin" VALUE 0x804F9A0C Val_Wu8 1.00000000000 DFES_EnvTabVerb 0.00 1.00000000000 FORMAT "%13.11" /end CHARACTERISTIC
/begin CHARACTERISTIC DFES_EnvRef.DFC_RoughRoad_C "used environment signals / Reference to used environment condition set for check DFC_RoughRoad" VALUE 0x804F9A0D Val_Wu8 1.00000000000 DFES_EnvTabVerb 0.00 1.00000000000 FORMAT "%13.11" /end CHARACTERISTIC
/begin CHARACTERISTIC DFES_EnvRef.DFC_SiaEEPRdErr_C "used environment signals / Reference to used environment condition set for check DFC_SiaEEPRdErr" VALUE 0x804F9A0E Val_Wu8 1.00000000000 DFES_EnvTabVerb 0.00 1.00000000000 FORMAT "%13.11" /end CHARACTERISTIC
/begin CHARACTERISTIC DFES_EnvRef.DFC_SiaEEPWrngCod_C "used environment signals / Reference to used environment condition set for check DFC_SiaEEPWrngCod" VALUE 0x804F9A0F Val_Wu8 1.00000000000 DFES_EnvTabVerb 0.00 1.00000000000 FORMAT "%13.11" /end CHARACTERISTIC
/begin CHARACTERISTIC DFES_EnvRef.DFC_UegoDummy_C "used environment signals / Reference to used environment condition set for check DFC_UegoDummy" VALUE 0x804F9A10 Val_Wu8 1.00000000000 DFES_EnvTabVerb 0.00 1.00000000000 FORMAT "%13.11" /end CHARACTERISTIC
/begin CHARACTERISTIC DFES_EnvRef.DFC_BusDiagCANAPPLBusOff_C "used environment signals / Reference to used environment condition set for check DFC_BusDiagCANAPPLBusOff" VALUE 0x804F9A11 Val_Wu8 1.00000000000 DFES_EnvTabVerb 0.00 1.00000000000 FORMAT "%13.11" /end CHARACTERISTIC
/begin CHARACTERISTIC DFES_EnvRef.DFC_BusDiagCANCANCBusOff_C "used environment signals / Reference to used environment condition set for check DFC_BusDiagCANCANCBusOff" VALUE 0x804F9A12 Val_Wu8 1.00000000000 DFES_EnvTabVerb 0.00 1.00000000000 FORMAT "%13.11" /end CHARACTERISTIC
/begin CHARACTERISTIC DFES_EnvRef.DFC_BusDiagCANVEHICLEBusOff_C "used environment signals / Reference to used environment condition set for check DFC_BusDiagCANVEHICLEBusOff" VALUE 0x804F9A13 Val_Wu8 1.00000000000 DFES_EnvTabVerb 0.00 1.00000000000 FORMAT "%13.11" /end CHARACTERISTIC
/begin CHARACTERISTIC DFES_EnvRef.DFC_RBA_IODIAGPWR_rba_IoExtCy329_SignalVltSply_0_C "used environment signals / Reference to used environment condition set for check DFC_RBA_IODIAGPWR_rba_IoExtCy329_SignalVltSply_0" VALUE 0x804F9A14 Val_Wu8 1.00000000000 DFES_EnvTabVerb 0.00 1.00000000000 FORMAT "%13.11" /end CHARACTERISTIC
/begin CHARACTERISTIC DFES_EnvRef.DFC_RBA_IODIAGPWR_rba_IoExtCy329_SignalVltSply_0OT_C "used environment signals / Reference to used environment condition set for check DFC_RBA_IODIAGPWR_rba_IoExtCy329_SignalVltSply_0OT" VALUE 0x804F9A15 Val_Wu8 1.00000000000 DFES_EnvTabVerb 0.00 1.00000000000 FORMAT "%13.11" /end CHARACTERISTIC
/begin CHARACTERISTIC DFES_EnvRef.DFC_RBA_IODIAGPWR_rba_IoExtCy329_SignalVltSply_0OV_C "used environment signals / Reference to used environment condition set for check DFC_RBA_IODIAGPWR_rba_IoExtCy329_SignalVltSply_0OV" VALUE 0x804F9A16 Val_Wu8 1.00000000000 DFES_EnvTabVerb 0.00 1.00000000000 FORMAT "%13.11" /end CHARACTERISTIC
/begin CHARACTERISTIC DFES_EnvRef.DFC_RBA_IODIAGPWR_rba_IoExtCy329_SignalVltSply_0SCG_C "used environment signals / Reference to used environment condition set for check DFC_RBA_IODIAGPWR_rba_IoExtCy329_SignalVltSply_0SCG" VALUE 0x804F9A17 Val_Wu8 1.00000000000 DFES_EnvTabVerb 0.00 1.00000000000 FORMAT "%13.11" /end CHARACTERISTIC
/begin CHARACTERISTIC DFES_EnvRef.DFC_RBA_IODIAGPWR_rba_IoExtCy329_SignalVltSply_0UV_C "used environment signals / Reference to used environment condition set for check DFC_RBA_IODIAGPWR_rba_IoExtCy329_SignalVltSply_0UV" VALUE 0x804F9A18 Val_Wu8 1.00000000000 DFES_EnvTabVerb 0.00 1.00000000000 FORMAT "%13.11" /end CHARACTERISTIC
/begin CHARACTERISTIC DFES_EnvRef.DFC_RBA_IODIAGPWR_rba_IoExtCy329_SignalVltSply_1_C "used environment signals / Reference to used environment condition set for check DFC_RBA_IODIAGPWR_rba_IoExtCy329_SignalVltSply_1" VALUE 0x804F9A19 Val_Wu8 1.00000000000 DFES_EnvTabVerb 0.00 1.00000000000 FORMAT "%13.11" /end CHARACTERISTIC
/begin CHARACTERISTIC DFES_EnvRef.DFC_RBA_IODIAGPWR_rba_IoExtCy329_SignalVltSply_1OT_C "used environment signals / Reference to used environment condition set for check DFC_RBA_IODIAGPWR_rba_IoExtCy329_SignalVltSply_1OT" VALUE 0x804F9A1A Val_Wu8 1.00000000000 DFES_EnvTabVerb 0.00 1.00000000000 FORMAT "%13.11" /end CHARACTERISTIC
/begin CHARACTERISTIC DFES_EnvRef.DFC_RBA_IODIAGPWR_rba_IoExtCy329_SignalVltSply_1OV_C "used environment signals / Reference to used environment condition set for check DFC_RBA_IODIAGPWR_rba_IoExtCy329_SignalVltSply_1OV" VALUE 0x804F9A1B Val_Wu8 1.00000000000 DFES_EnvTabVerb 0.00 1.00000000000 FORMAT "%13.11" /end CHARACTERISTIC
/begin CHARACTERISTIC DFES_EnvRef.DFC_RBA_IODIAGPWR_rba_IoExtCy329_SignalVltSply_1SCG_C "used environment signals / Reference to used environment condition set for check DFC_RBA_IODIAGPWR_rba_IoExtCy329_SignalVltSply_1SCG" VALUE 0x804F9A1C Val_Wu8 1.00000000000 DFES_EnvTabVerb 0.00 1.00000000000 FORMAT "%13.11" /end CHARACTERISTIC
/begin CHARACTERISTIC DFES_EnvRef.DFC_RBA_IODIAGPWR_rba_IoExtCy329_SignalVltSply_1UV_C "used environment signals / Reference to used environment condition set for check DFC_RBA_IODIAGPWR_rba_IoExtCy329_SignalVltSply_1UV" VALUE 0x804F9A1D Val_Wu8 1.00000000000 DFES_EnvTabVerb 0.00 1.00000000000 FORMAT "%13.11" /end CHARACTERISTIC
/begin CHARACTERISTIC DFES_EnvRef.DFC_RBA_IODIAGPWR_rba_IoExtCy329_SignalVltSply_2_C "used environment signals / Reference to used environment condition set for check DFC_RBA_IODIAGPWR_rba_IoExtCy329_SignalVltSply_2" VALUE 0x804F9A1E Val_Wu8 1.00000000000 DFES_EnvTabVerb 0.00 1.00000000000 FORMAT "%13.11" /end CHARACTERISTIC
/begin CHARACTERISTIC DFES_EnvRef.DFC_RBA_IODIAGPWR_rba_IoExtCy329_SignalVltSply_2OT_C "used environment signals / Reference to used environment condition set for check DFC_RBA_IODIAGPWR_rba_IoExtCy329_SignalVltSply_2OT" VALUE 0x804F9A1F Val_Wu8 1.00000000000 DFES_EnvTabVerb 0.00 1.00000000000 FORMAT "%13.11" /end CHARACTERISTIC
/begin CHARACTERISTIC DFES_EnvRef.DFC_RBA_IODIAGPWR_rba_IoExtCy329_SignalVltSply_2OV_C "used environment signals / Reference to used environment condition set for check DFC_RBA_IODIAGPWR_rba_IoExtCy329_SignalVltSply_2OV" VALUE 0x804F9A20 Val_Wu8 1.00000000000 DFES_EnvTabVerb 0.00 1.00000000000 FORMAT "%13.11" /end CHARACTERISTIC
/begin CHARACTERISTIC DFES_EnvRef.DFC_RBA_IODIAGPWR_rba_IoExtCy329_SignalVltSply_2SCG_C "used environment signals / Reference to used environment condition set for check DFC_RBA_IODIAGPWR_rba_IoExtCy329_SignalVltSply_2SCG" VALUE 0x804F9A21 Val_Wu8 1.00000000000 DFES_EnvTabVerb 0.00 1.00000000000 FORMAT "%13.11" /end CHARACTERISTIC
/begin CHARACTERISTIC DFES_EnvRef.DFC_RBA_IODIAGPWR_rba_IoExtCy329_SignalVltSply_2UV_C "used environment signals / Reference to used environment condition set for check DFC_RBA_IODIAGPWR_rba_IoExtCy329_SignalVltSply_2UV" VALUE 0x804F9A22 Val_Wu8 1.00000000000 DFES_EnvTabVerb 0.00 1.00000000000 FORMAT "%13.11" /end CHARACTERISTIC
/begin CHARACTERISTIC DFES_EnvRef.DFC_CAN_E_TIMEOUT_C "used environment signals / Reference to used environment condition set for check DFC_CAN_E_TIMEOUT" VALUE 0x804F9A23 Val_Wu8 1.00000000000 DFES_EnvTabVerb 0.00 1.00000000000 FORMAT "%13.11" /end CHARACTERISTIC
/begin CHARACTERISTIC DFES_EnvRef.DFC_LIN_E_TIMEOUT_C "used environment signals / Reference to used environment condition set for check DFC_LIN_E_TIMEOUT" VALUE 0x804F9A24 Val_Wu8 1.00000000000 DFES_EnvTabVerb 0.00 1.00000000000 FORMAT "%13.11" /end CHARACTERISTIC
/begin CHARACTERISTIC DFES_EnvRef.DFC_MRlyOL_C "used environment signals / Reference to used environment condition set for check DFC_MRlyOL" VALUE 0x804F9A25 Val_Wu8 1.00000000000 DFES_EnvTabVerb 0.00 1.00000000000 FORMAT "%13.11" /end CHARACTERISTIC
/begin CHARACTERISTIC DFES_EnvRef.DFC_MRlySCB_C "used environment signals / Reference to used environment condition set for check DFC_MRlySCB" VALUE 0x804F9A26 Val_Wu8 1.00000000000 DFES_EnvTabVerb 0.00 1.00000000000 FORMAT "%13.11" /end CHARACTERISTIC
/begin CHARACTERISTIC DFES_EnvRef.DFC_MRlySCG_C "used environment signals / Reference to used environment condition set for check DFC_MRlySCG" VALUE 0x804F9A27 Val_Wu8 1.00000000000 DFES_EnvTabVerb 0.00 1.00000000000 FORMAT "%13.11" /end CHARACTERISTIC
/begin CHARACTERISTIC DFES_EnvRef.DFC_rba_MultiStackTrace_Threshold_C "used environment signals / Reference to used environment condition set for check DFC_rba_MultiStackTrace_Threshold" VALUE 0x804F9A28 Val_Wu8 1.00000000000 DFES_EnvTabVerb 0.00 1.00000000000 FORMAT "%13.11" /end CHARACTERISTIC
/begin CHARACTERISTIC DFES_EnvRef.DFC_BSWM_E_ACTION_FAILED_C "used environment signals / Reference to used environment condition set for check DFC_BSWM_E_ACTION_FAILED" VALUE 0x804F9A29 Val_Wu8 1.00000000000 DFES_EnvTabVerb 0.00 1.00000000000 FORMAT "%13.11" /end CHARACTERISTIC
/begin CHARACTERISTIC DFES_EnvRef.DFC_BSWM_E_INTRPTQUEUE_FULL_C "used environment signals / Reference to used environment condition set for check DFC_BSWM_E_INTRPTQUEUE_FULL" VALUE 0x804F9A2A Val_Wu8 1.00000000000 DFES_EnvTabVerb 0.00 1.00000000000 FORMAT "%13.11" /end CHARACTERISTIC
/begin CHARACTERISTIC DFES_EnvRef.DFC_RBA_IOEXTLIB_KEEPALIVE_DRV_C "used environment signals / Reference to used environment condition set for check DFC_RBA_IOEXTLIB_KEEPALIVE_DRV" VALUE 0x804F9A2B Val_Wu8 1.00000000000 DFES_EnvTabVerb 0.00 1.00000000000 FORMAT "%13.11" /end CHARACTERISTIC
/begin CHARACTERISTIC DFES_EnvRef.DFC_RBA_IOEXTLIB_KEEPALIVE_INI_C "used environment signals / Reference to used environment condition set for check DFC_RBA_IOEXTLIB_KEEPALIVE_INI" VALUE 0x804F9A2C Val_Wu8 1.00000000000 DFES_EnvTabVerb 0.00 1.00000000000 FORMAT "%13.11" /end CHARACTERISTIC
/begin CHARACTERISTIC DFES_EnvRef.DFC_rba_IoSigRtc_StopCounter_C "used environment signals / Reference to used environment condition set for check DFC_rba_IoSigRtc_StopCounter" VALUE 0x804F9A2D Val_Wu8 1.00000000000 DFES_EnvTabVerb 0.00 1.00000000000 FORMAT "%13.11" /end CHARACTERISTIC
/begin CHARACTERISTIC DFES_EnvRef.DFC_rba_MRly_Diag_Stk_Event_C "used environment signals / Reference to used environment condition set for check DFC_rba_MRly_Diag_Stk_Event" VALUE 0x804F9A2E Val_Wu8 1.00000000000 DFES_EnvTabVerb 0.00 1.00000000000 FORMAT "%13.11" /end CHARACTERISTIC
/begin CHARACTERISTIC DFES_EnvRef.DFC_rba_MemDiag_MemReadErr_C "used environment signals / Reference to used environment condition set for check DFC_rba_MemDiag_MemReadErr" VALUE 0x804F9A2F Val_Wu8 1.00000000000 DFES_EnvTabVerb 0.00 1.00000000000 FORMAT "%13.11" /end CHARACTERISTIC
/begin CHARACTERISTIC DFES_EnvRef.DFC_rba_MemDiag_MemWrErr_C "used environment signals / Reference to used environment condition set for check DFC_rba_MemDiag_MemWrErr" VALUE 0x804F9A30 Val_Wu8 1.00000000000 DFES_EnvTabVerb 0.00 1.00000000000 FORMAT "%13.11" /end CHARACTERISTIC
/begin CHARACTERISTIC DFES_EnvRef.DFC_rba_SyC_IrrSwOffTrigEngRun_Event_C "used environment signals / Reference to used environment condition set for check DFC_rba_SyC_IrrSwOffTrigEngRun_Event" VALUE 0x804F9A31 Val_Wu8 1.00000000000 DFES_EnvTabVerb 0.00 1.00000000000 FORMAT "%13.11" /end CHARACTERISTIC
/begin CHARACTERISTIC DFES_EnvRef.DFC_rba_T15_Diag_ComInVld_Event_C "used environment signals / Reference to used environment condition set for check DFC_rba_T15_Diag_ComInVld_Event" VALUE 0x804F9A32 Val_Wu8 1.00000000000 DFES_EnvTabVerb 0.00 1.00000000000 FORMAT "%13.11" /end CHARACTERISTIC
/begin CHARACTERISTIC DFES_EnvRef.DFC_rba_T15_Diag_ComOff_HwOn_Event_C "used environment signals / Reference to used environment condition set for check DFC_rba_T15_Diag_ComOff_HwOn_Event" VALUE 0x804F9A33 Val_Wu8 1.00000000000 DFES_EnvTabVerb 0.00 1.00000000000 FORMAT "%13.11" /end CHARACTERISTIC
/begin CHARACTERISTIC DFES_EnvRef.DFC_rba_T15_Diag_ComOn_HwOff_Event_C "used environment signals / Reference to used environment condition set for check DFC_rba_T15_Diag_ComOn_HwOff_Event" VALUE 0x804F9A34 Val_Wu8 1.00000000000 DFES_EnvTabVerb 0.00 1.00000000000 FORMAT "%13.11" /end CHARACTERISTIC
/begin CHARACTERISTIC DFES_EnvRef.DFC_AppAllSnsrDfct_C "used environment signals / Reference to used environment condition set for check DFC_AppAllSnsrDfct" VALUE 0x804F9A35 Val_Wu8 1.00000000000 DFES_EnvTabVerb 0.00 1.00000000000 FORMAT "%13.11" /end CHARACTERISTIC
/begin CHARACTERISTIC DFES_EnvRef.DFC_BattUStdbyDiaOL_C "used environment signals / Reference to used environment condition set for check DFC_BattUStdbyDiaOL" VALUE 0x804F9A36 Val_Wu8 1.00000000000 DFES_EnvTabVerb 0.00 1.00000000000 FORMAT "%13.11" /end CHARACTERISTIC
/begin CHARACTERISTIC DFES_EnvRef.DFC_BigLeakIntkMnfldEmiInfl_C "used environment signals / Reference to used environment condition set for check DFC_BigLeakIntkMnfldEmiInfl" VALUE 0x804F9A37 Val_Wu8 1.00000000000 DFES_EnvTabVerb 0.00 1.00000000000 FORMAT "%13.11" /end CHARACTERISTIC
/begin CHARACTERISTIC DFES_EnvRef.DFC_BrkMnSwtContOnWarnLmp_C "used environment signals / Reference to used environment condition set for check DFC_BrkMnSwtContOnWarnLmp" VALUE 0x804F9A38 Val_Wu8 1.00000000000 DFES_EnvTabVerb 0.00 1.00000000000 FORMAT "%13.11" /end CHARACTERISTIC
/begin CHARACTERISTIC DFES_EnvRef.DFC_BrkMnSwtNotStpWarnLmp_C "used environment signals / Reference to used environment condition set for check DFC_BrkMnSwtNotStpWarnLmp" VALUE 0x804F9A39 Val_Wu8 1.00000000000 DFES_EnvTabVerb 0.00 1.00000000000 FORMAT "%13.11" /end CHARACTERISTIC
/begin CHARACTERISTIC DFES_EnvRef.DFC_BrkRdntSwtContOnWarnLmp_C "used environment signals / Reference to used environment condition set for check DFC_BrkRdntSwtContOnWarnLmp" VALUE 0x804F9A3A Val_Wu8 1.00000000000 DFES_EnvTabVerb 0.00 1.00000000000 FORMAT "%13.11" /end CHARACTERISTIC
/begin CHARACTERISTIC DFES_EnvRef.DFC_BrkRdntSwtNotStpWarnLmp_C "used environment signals / Reference to used environment condition set for check DFC_BrkRdntSwtNotStpWarnLmp" VALUE 0x804F9A3B Val_Wu8 1.00000000000 DFES_EnvTabVerb 0.00 1.00000000000 FORMAT "%13.11" /end CHARACTERISTIC
/begin CHARACTERISTIC DFES_EnvRef.DFC_CEngDsTColdStrtMax_C "used environment signals / Reference to used environment condition set for check DFC_CEngDsTColdStrtMax" VALUE 0x804F9A3C Val_Wu8 1.00000000000 DFES_EnvTabVerb 0.00 1.00000000000 FORMAT "%13.11" /end CHARACTERISTIC
/begin CHARACTERISTIC DFES_EnvRef.DFC_CEngDsTColdStrtMin_C "used environment signals / Reference to used environment condition set for check DFC_CEngDsTColdStrtMin" VALUE 0x804F9A3D Val_Wu8 1.00000000000 DFES_EnvTabVerb 0.00 1.00000000000 FORMAT "%13.11" /end CHARACTERISTIC
/begin CHARACTERISTIC DFES_EnvRef.DFC_CEngDsTImps_C "used environment signals / Reference to used environment condition set for check DFC_CEngDsTImps" VALUE 0x804F9A3E Val_Wu8 1.00000000000 DFES_EnvTabVerb 0.00 1.00000000000 FORMAT "%13.11" /end CHARACTERISTIC
/begin CHARACTERISTIC DFES_EnvRef.DFC_CEngDsTPlausLSC_C "used environment signals / Reference to used environment condition set for check DFC_CEngDsTPlausLSC" VALUE 0x804F9A3F Val_Wu8 1.00000000000 DFES_EnvTabVerb 0.00 1.00000000000 FORMAT "%13.11" /end CHARACTERISTIC
/begin CHARACTERISTIC DFES_EnvRef.DFC_CEngDsTPlausSTC_C "used environment signals / Reference to used environment condition set for check DFC_CEngDsTPlausSTC" VALUE 0x804F9A40 Val_Wu8 1.00000000000 DFES_EnvTabVerb 0.00 1.00000000000 FORMAT "%13.11" /end CHARACTERISTIC
/begin CHARACTERISTIC DFES_EnvRef.DFC_CEngDsTSRCMax_C "used environment signals / Reference to used environment condition set for check DFC_CEngDsTSRCMax" VALUE 0x804F9A41 Val_Wu8 1.00000000000 DFES_EnvTabVerb 0.00 1.00000000000 FORMAT "%13.11" /end CHARACTERISTIC
/begin CHARACTERISTIC DFES_EnvRef.DFC_CEngDsTSRCMin_C "used environment signals / Reference to used environment condition set for check DFC_CEngDsTSRCMin" VALUE 0x804F9A42 Val_Wu8 1.00000000000 DFES_EnvTabVerb 0.00 1.00000000000 FORMAT "%13.11" /end CHARACTERISTIC
/begin CHARACTERISTIC DFES_EnvRef.DFC_CEngDsTSig_C "used environment signals / Reference to used environment condition set for check DFC_CEngDsTSig" VALUE 0x804F9A43 Val_Wu8 1.00000000000 DFES_EnvTabVerb 0.00 1.00000000000 FORMAT "%13.11" /end CHARACTERISTIC
/begin CHARACTERISTIC DFES_EnvRef.DFC_CEngUsTSRCMax_C "used environment signals / Reference to used environment condition set for check DFC_CEngUsTSRCMax" VALUE 0x804F9A44 Val_Wu8 1.00000000000 DFES_EnvTabVerb 0.00 1.00000000000 FORMAT "%13.11" /end CHARACTERISTIC
/begin CHARACTERISTIC DFES_EnvRef.DFC_CEngUsTSRCMin_C "used environment signals / Reference to used environment condition set for check DFC_CEngUsTSRCMin" VALUE 0x804F9A45 Val_Wu8 1.00000000000 DFES_EnvTabVerb 0.00 1.00000000000 FORMAT "%13.11" /end CHARACTERISTIC
/begin CHARACTERISTIC DFES_EnvRef.DFC_DCDCFltDet_C "used environment signals / Reference to used environment condition set for check DFC_DCDCFltDet" VALUE 0x804F9A46 Val_Wu8 1.00000000000 DFES_EnvTabVerb 0.00 1.00000000000 FORMAT "%13.11" /end CHARACTERISTIC
/begin CHARACTERISTIC DFES_EnvRef.DFC_DKRSA_C "used environment signals / Reference to used environment condition set for check DFC_DKRSA" VALUE 0x804F9A47 Val_Wu8 1.00000000000 DFES_EnvTabVerb 0.00 1.00000000000 FORMAT "%13.11" /end CHARACTERISTIC
/begin CHARACTERISTIC DFES_EnvRef.DFC_DKVSmax_C "used environment signals / Reference to used environment condition set for check DFC_DKVSmax" VALUE 0x804F9A48 Val_Wu8 1.00000000000 DFES_EnvTabVerb 0.00 1.00000000000 FORMAT "%13.11" /end CHARACTERISTIC
/begin CHARACTERISTIC DFES_EnvRef.DFC_DKnpl_C "used environment signals / Reference to used environment condition set for check DFC_DKnpl" VALUE 0x804F9A49 Val_Wu8 1.00000000000 DFES_EnvTabVerb 0.00 1.00000000000 FORMAT "%13.11" /end CHARACTERISTIC
/begin CHARACTERISTIC DFES_EnvRef.DFC_DSSmax_C "used environment signals / Reference to used environment condition set for check DFC_DSSmax" VALUE 0x804F9A4A Val_Wu8 1.00000000000 DFES_EnvTabVerb 0.00 1.00000000000 FORMAT "%13.11" /end CHARACTERISTIC
/begin CHARACTERISTIC DFES_EnvRef.DFC_DSTTI_C "used environment signals / Reference to used environment condition set for check DFC_DSTTI" VALUE 0x804F9A4B Val_Wu8 1.00000000000 DFES_EnvTabVerb 0.00 1.00000000000 FORMAT "%13.11" /end CHARACTERISTIC
/begin CHARACTERISTIC DFES_EnvRef.DFC_DSUmax_C "used environment signals / Reference to used environment condition set for check DFC_DSUmax" VALUE 0x804F9A4C Val_Wu8 1.00000000000 DFES_EnvTabVerb 0.00 1.00000000000 FORMAT "%13.11" /end CHARACTERISTIC
/begin CHARACTERISTIC DFES_EnvRef.DFC_EGRVlvOL_C "used environment signals / Reference to used environment condition set for check DFC_EGRVlvOL" VALUE 0x804F9A4D Val_Wu8 1.00000000000 DFES_EnvTabVerb 0.00 1.00000000000 FORMAT "%13.11" /end CHARACTERISTIC
/begin CHARACTERISTIC DFES_EnvRef.DFC_EGRVlvSCB_C "used environment signals / Reference to used environment condition set for check DFC_EGRVlvSCB" VALUE 0x804F9A4E Val_Wu8 1.00000000000 DFES_EnvTabVerb 0.00 1.00000000000 FORMAT "%13.11" /end CHARACTERISTIC
/begin CHARACTERISTIC DFES_EnvRef.DFC_EGRVlvSCG_C "used environment signals / Reference to used environment condition set for check DFC_EGRVlvSCG" VALUE 0x804F9A4F Val_Wu8 1.00000000000 DFES_EnvTabVerb 0.00 1.00000000000 FORMAT "%13.11" /end CHARACTERISTIC
/begin CHARACTERISTIC DFES_EnvRef.DFC_EGSDUS2B1LtrDly_C "used environment signals / Reference to used environment condition set for check DFC_EGSDUS2B1LtrDly" VALUE 0x804F9A50 Val_Wu8 1.00000000000 DFES_EnvTabVerb 0.00 1.00000000000 FORMAT "%13.11" /end CHARACTERISTIC
/begin CHARACTERISTIC DFES_EnvRef.DFC_EGSDUS2B1LtrPT1_C "used environment signals / Reference to used environment condition set for check DFC_EGSDUS2B1LtrPT1" VALUE 0x804F9A51 Val_Wu8 1.00000000000 DFES_EnvTabVerb 0.00 1.00000000000 FORMAT "%13.11" /end CHARACTERISTIC
/begin CHARACTERISTIC DFES_EnvRef.DFC_EGSDUS2B1RtlDly_C "used environment signals / Reference to used environment condition set for check DFC_EGSDUS2B1RtlDly" VALUE 0x804F9A52 Val_Wu8 1.00000000000 DFES_EnvTabVerb 0.00 1.00000000000 FORMAT "%13.11" /end CHARACTERISTIC
/begin CHARACTERISTIC DFES_EnvRef.DFC_EGSDUS2B1RtlPT1_C "used environment signals / Reference to used environment condition set for check DFC_EGSDUS2B1RtlPT1" VALUE 0x804F9A53 Val_Wu8 1.00000000000 DFES_EnvTabVerb 0.00 1.00000000000 FORMAT "%13.11" /end CHARACTERISTIC
/begin CHARACTERISTIC DFES_EnvRef.DFC_EGSDUS2B1TarLean_C "used environment signals / Reference to used environment condition set for check DFC_EGSDUS2B1TarLean" VALUE 0x804F9A54 Val_Wu8 1.00000000000 DFES_EnvTabVerb 0.00 1.00000000000 FORMAT "%13.11" /end CHARACTERISTIC
/begin CHARACTERISTIC DFES_EnvRef.DFC_EGSDUS2B1TarRich_C "used environment signals / Reference to used environment condition set for check DFC_EGSDUS2B1TarRich" VALUE 0x804F9A55 Val_Wu8 1.00000000000 DFES_EnvTabVerb 0.00 1.00000000000 FORMAT "%13.11" /end CHARACTERISTIC
/begin CHARACTERISTIC DFES_EnvRef.DFC_ETAKHLmax_C "used environment signals / Reference to used environment condition set for check DFC_ETAKHLmax" VALUE 0x804F9A56 Val_Wu8 1.00000000000 DFES_EnvTabVerb 0.00 1.00000000000 FORMAT "%13.11" /end CHARACTERISTIC
/begin CHARACTERISTIC DFES_EnvRef.DFC_ETAKHTmax_C "used environment signals / Reference to used environment condition set for check DFC_ETAKHTmax" VALUE 0x804F9A57 Val_Wu8 1.00000000000 DFES_EnvTabVerb 0.00 1.00000000000 FORMAT "%13.11" /end CHARACTERISTIC
/begin CHARACTERISTIC DFES_EnvRef.DFC_EngICO_C "used environment signals / Reference to used environment condition set for check DFC_EngICO" VALUE 0x804F9A58 Val_Wu8 1.00000000000 DFES_EnvTabVerb 0.00 1.00000000000 FORMAT "%13.11" /end CHARACTERISTIC
/begin CHARACTERISTIC DFES_EnvRef.DFC_EngPrtOvrSpdMon_C "used environment signals / Reference to used environment condition set for check DFC_EngPrtOvrSpdMon" VALUE 0x804F9A59 Val_Wu8 1.00000000000 DFES_EnvTabVerb 0.00 1.00000000000 FORMAT "%13.11" /end CHARACTERISTIC
/begin CHARACTERISTIC DFES_EnvRef.DFC_EpmCaSI1ErrSig_C "used environment signals / Reference to used environment condition set for check DFC_EpmCaSI1ErrSig" VALUE 0x804F9A5A Val_Wu8 1.00000000000 DFES_EnvTabVerb 0.00 1.00000000000 FORMAT "%13.11" /end CHARACTERISTIC
/begin CHARACTERISTIC DFES_EnvRef.DFC_EpmCaSI1NoSig_C "used environment signals / Reference to used environment condition set for check DFC_EpmCaSI1NoSig" VALUE 0x804F9A5B Val_Wu8 1.00000000000 DFES_EnvTabVerb 0.00 1.00000000000 FORMAT "%13.11" /end CHARACTERISTIC
/begin CHARACTERISTIC DFES_EnvRef.DFC_EpmCaSI1OfsErr_C "used environment signals / Reference to used environment condition set for check DFC_EpmCaSI1OfsErr" VALUE 0x804F9A5C Val_Wu8 1.00000000000 DFES_EnvTabVerb 0.00 1.00000000000 FORMAT "%13.11" /end CHARACTERISTIC
/begin CHARACTERISTIC DFES_EnvRef.DFC_EpmCrSErrSig_C "used environment signals / Reference to used environment condition set for check DFC_EpmCrSErrSig" VALUE 0x804F9A5D Val_Wu8 1.00000000000 DFES_EnvTabVerb 0.00 1.00000000000 FORMAT "%13.11" /end CHARACTERISTIC
/begin CHARACTERISTIC DFES_EnvRef.DFC_EpmCrSNoSig_C "used environment signals / Reference to used environment condition set for check DFC_EpmCrSNoSig" VALUE 0x804F9A5E Val_Wu8 1.00000000000 DFES_EnvTabVerb 0.00 1.00000000000 FORMAT "%13.11" /end CHARACTERISTIC
/begin CHARACTERISTIC DFES_EnvRef.DFC_EtaEngIdleNonCsers_C "used environment signals / Reference to used environment condition set for check DFC_EtaEngIdleNonCsers" VALUE 0x804F9A5F Val_Wu8 1.00000000000 DFES_EnvTabVerb 0.00 1.00000000000 FORMAT "%13.11" /end CHARACTERISTIC
/begin CHARACTERISTIC DFES_EnvRef.DFC_EtaEngPtlNonCsers_C "used environment signals / Reference to used environment condition set for check DFC_EtaEngPtlNonCsers" VALUE 0x804F9A60 Val_Wu8 1.00000000000 DFES_EnvTabVerb 0.00 1.00000000000 FORMAT "%13.11" /end CHARACTERISTIC
/begin CHARACTERISTIC DFES_EnvRef.DFC_FRAmax_C "used environment signals / Reference to used environment condition set for check DFC_FRAmax" VALUE 0x804F9A61 Val_Wu8 1.00000000000 DFES_EnvTabVerb 0.00 1.00000000000 FORMAT "%13.11" /end CHARACTERISTIC
/begin CHARACTERISTIC DFES_EnvRef.DFC_FRAmin_C "used environment signals / Reference to used environment condition set for check DFC_FRAmin" VALUE 0x804F9A62 Val_Wu8 1.00000000000 DFES_EnvTabVerb 0.00 1.00000000000 FORMAT "%13.11" /end CHARACTERISTIC
/begin CHARACTERISTIC DFES_EnvRef.DFC_GbxRvsSwtStk_C "used environment signals / Reference to used environment condition set for check DFC_GbxRvsSwtStk" VALUE 0x804F9A63 Val_Wu8 1.00000000000 DFES_EnvTabVerb 0.00 1.00000000000 FORMAT "%13.11" /end CHARACTERISTIC
/begin CHARACTERISTIC DFES_EnvRef.DFC_HDRmax_C "used environment signals / Reference to used environment condition set for check DFC_HDRmax" VALUE 0x804F9A64 Val_Wu8 1.00000000000 DFES_EnvTabVerb 0.00 1.00000000000 FORMAT "%13.11" /end CHARACTERISTIC
/begin CHARACTERISTIC DFES_EnvRef.DFC_HEGOS2B1ElecMax_C "used environment signals / Reference to used environment condition set for check DFC_HEGOS2B1ElecMax" VALUE 0x804F9A65 Val_Wu8 1.00000000000 DFES_EnvTabVerb 0.00 1.00000000000 FORMAT "%13.11" /end CHARACTERISTIC
/begin CHARACTERISTIC DFES_EnvRef.DFC_HEGOS2B1ElecMin_C "used environment signals / Reference to used environment condition set for check DFC_HEGOS2B1ElecMin" VALUE 0x804F9A66 Val_Wu8 1.00000000000 DFES_EnvTabVerb 0.00 1.00000000000 FORMAT "%13.11" /end CHARACTERISTIC
/begin CHARACTERISTIC DFES_EnvRef.DFC_HEGOS2B1ElecSig_C "used environment signals / Reference to used environment condition set for check DFC_HEGOS2B1ElecSig" VALUE 0x804F9A67 Val_Wu8 1.00000000000 DFES_EnvTabVerb 0.00 1.00000000000 FORMAT "%13.11" /end CHARACTERISTIC
/begin CHARACTERISTIC DFES_EnvRef.DFC_HEGOS2B1HtgNpl_C "used environment signals / Reference to used environment condition set for check DFC_HEGOS2B1HtgNpl" VALUE 0x804F9A68 Val_Wu8 1.00000000000 DFES_EnvTabVerb 0.00 1.00000000000 FORMAT "%13.11" /end CHARACTERISTIC
/begin CHARACTERISTIC DFES_EnvRef.DFC_IntkAirTIntkMnfldCrssMax_C "used environment signals / Reference to used environment condition set for check DFC_IntkAirTIntkMnfldCrssMax" VALUE 0x804F9A69 Val_Wu8 1.00000000000 DFES_EnvTabVerb 0.00 1.00000000000 FORMAT "%13.11" /end CHARACTERISTIC
/begin CHARACTERISTIC DFES_EnvRef.DFC_IntkAirTIntkMnfldCrssMin_C "used environment signals / Reference to used environment condition set for check DFC_IntkAirTIntkMnfldCrssMin" VALUE 0x804F9A6A Val_Wu8 1.00000000000 DFES_EnvTabVerb 0.00 1.00000000000 FORMAT "%13.11" /end CHARACTERISTIC
/begin CHARACTERISTIC DFES_EnvRef.DFC_IntkAirTIntkMnfldHSCMax_C "used environment signals / Reference to used environment condition set for check DFC_IntkAirTIntkMnfldHSCMax" VALUE 0x804F9A6B Val_Wu8 1.00000000000 DFES_EnvTabVerb 0.00 1.00000000000 FORMAT "%13.11" /end CHARACTERISTIC
/begin CHARACTERISTIC DFES_EnvRef.DFC_IntkAirTIntkMnfldImps_C "used environment signals / Reference to used environment condition set for check DFC_IntkAirTIntkMnfldImps" VALUE 0x804F9A6C Val_Wu8 1.00000000000 DFES_EnvTabVerb 0.00 1.00000000000 FORMAT "%13.11" /end CHARACTERISTIC
/begin CHARACTERISTIC DFES_EnvRef.DFC_IntkAirTIntkMnfldPRCMax_C "used environment signals / Reference to used environment condition set for check DFC_IntkAirTIntkMnfldPRCMax" VALUE 0x804F9A6D Val_Wu8 1.00000000000 DFES_EnvTabVerb 0.00 1.00000000000 FORMAT "%13.11" /end CHARACTERISTIC
/begin CHARACTERISTIC DFES_EnvRef.DFC_IntkAirTIntkMnfldPRCMin_C "used environment signals / Reference to used environment condition set for check DFC_IntkAirTIntkMnfldPRCMin" VALUE 0x804F9A6E Val_Wu8 1.00000000000 DFES_EnvTabVerb 0.00 1.00000000000 FORMAT "%13.11" /end CHARACTERISTIC
/begin CHARACTERISTIC DFES_EnvRef.DFC_IntkAirTIntkMnfldSRCMax_C "used environment signals / Reference to used environment condition set for check DFC_IntkAirTIntkMnfldSRCMax" VALUE 0x804F9A6F Val_Wu8 1.00000000000 DFES_EnvTabVerb 0.00 1.00000000000 FORMAT "%13.11" /end CHARACTERISTIC
/begin CHARACTERISTIC DFES_EnvRef.DFC_IntkAirTIntkMnfldSRCMin_C "used environment signals / Reference to used environment condition set for check DFC_IntkAirTIntkMnfldSRCMin" VALUE 0x804F9A70 Val_Wu8 1.00000000000 DFES_EnvTabVerb 0.00 1.00000000000 FORMAT "%13.11" /end CHARACTERISTIC
/begin CHARACTERISTIC DFES_EnvRef.DFC_IntkAirTIntkMnfldSTC_C "used environment signals / Reference to used environment condition set for check DFC_IntkAirTIntkMnfldSTC" VALUE 0x804F9A71 Val_Wu8 1.00000000000 DFES_EnvTabVerb 0.00 1.00000000000 FORMAT "%13.11" /end CHARACTERISTIC
/begin CHARACTERISTIC DFES_EnvRef.DFC_KS1max_C "used environment signals / Reference to used environment condition set for check DFC_KS1max" VALUE 0x804F9A72 Val_Wu8 1.00000000000 DFES_EnvTabVerb 0.00 1.00000000000 FORMAT "%13.11" /end CHARACTERISTIC
/begin CHARACTERISTIC DFES_EnvRef.DFC_KS1min_C "used environment signals / Reference to used environment condition set for check DFC_KS1min" VALUE 0x804F9A73 Val_Wu8 1.00000000000 DFES_EnvTabVerb 0.00 1.00000000000 FORMAT "%13.11" /end CHARACTERISTIC
/begin CHARACTERISTIC DFES_EnvRef.DFC_LMmax_C "used environment signals / Reference to used environment condition set for check DFC_LMmax" VALUE 0x804F9A74 Val_Wu8 1.00000000000 DFES_EnvTabVerb 0.00 1.00000000000 FORMAT "%13.11" /end CHARACTERISTIC
/begin CHARACTERISTIC DFES_EnvRef.DFC_LZSRnpl_C "used environment signals / Reference to used environment condition set for check DFC_LZSRnpl" VALUE 0x804F9A75 Val_Wu8 1.00000000000 DFES_EnvTabVerb 0.00 1.00000000000 FORMAT "%13.11" /end CHARACTERISTIC
/begin CHARACTERISTIC DFES_EnvRef.DFC_LamDynDiagS1B1_C "used environment signals / Reference to used environment condition set for check DFC_LamDynDiagS1B1" VALUE 0x804F9A76 Val_Wu8 1.00000000000 DFES_EnvTabVerb 0.00 1.00000000000 FORMAT "%13.11" /end CHARACTERISTIC
/begin CHARACTERISTIC DFES_EnvRef.DFC_LeakIntkMnfldEmiInfl_C "used environment signals / Reference to used environment condition set for check DFC_LeakIntkMnfldEmiInfl" VALUE 0x804F9A77 Val_Wu8 1.00000000000 DFES_EnvTabVerb 0.00 1.00000000000 FORMAT "%13.11" /end CHARACTERISTIC
/begin CHARACTERISTIC DFES_EnvRef.DFC_MD00max_C "used environment signals / Reference to used environment condition set for check DFC_MD00max" VALUE 0x804F9A78 Val_Wu8 1.00000000000 DFES_EnvTabVerb 0.00 1.00000000000 FORMAT "%13.11" /end CHARACTERISTIC
/begin CHARACTERISTIC DFES_EnvRef.DFC_MDBmax_C "used environment signals / Reference to used environment condition set for check DFC_MDBmax" VALUE 0x804F9A79 Val_Wu8 1.00000000000 DFES_EnvTabVerb 0.00 1.00000000000 FORMAT "%13.11" /end CHARACTERISTIC
/begin CHARACTERISTIC DFES_EnvRef.DFC_MDCat_C "used environment signals / Reference to used environment condition set for check DFC_MDCat" VALUE 0x804F9A7A Val_Wu8 1.00000000000 DFES_EnvTabVerb 0.00 1.00000000000 FORMAT "%13.11" /end CHARACTERISTIC
/begin CHARACTERISTIC DFES_EnvRef.DFC_MDCatCrit_C "used environment signals / Reference to used environment condition set for check DFC_MDCatCrit" VALUE 0x804F9A7B Val_Wu8 1.00000000000 DFES_EnvTabVerb 0.00 1.00000000000 FORMAT "%13.11" /end CHARACTERISTIC
/begin CHARACTERISTIC DFES_EnvRef.DFC_MDCatCurr_C "used environment signals / Reference to used environment condition set for check DFC_MDCatCurr" VALUE 0x804F9A7C Val_Wu8 1.00000000000 DFES_EnvTabVerb 0.00 1.00000000000 FORMAT "%13.11" /end CHARACTERISTIC
/begin CHARACTERISTIC DFES_EnvRef.DFC_MDCyl_0_C "used environment signals / Reference to used environment condition set for check DFC_MDCyl_0" VALUE 0x804F9A7D Val_Wu8 1.00000000000 DFES_EnvTabVerb 0.00 1.00000000000 FORMAT "%13.11" /end CHARACTERISTIC
/begin CHARACTERISTIC DFES_EnvRef.DFC_MDCyl_1_C "used environment signals / Reference to used environment condition set for check DFC_MDCyl_1" VALUE 0x804F9A7E Val_Wu8 1.00000000000 DFES_EnvTabVerb 0.00 1.00000000000 FORMAT "%13.11" /end CHARACTERISTIC
/begin CHARACTERISTIC DFES_EnvRef.DFC_MDCyl_2_C "used environment signals / Reference to used environment condition set for check DFC_MDCyl_2" VALUE 0x804F9A7F Val_Wu8 1.00000000000 DFES_EnvTabVerb 0.00 1.00000000000 FORMAT "%13.11" /end CHARACTERISTIC
/begin CHARACTERISTIC DFES_EnvRef.DFC_MDCyl_3_C "used environment signals / Reference to used environment condition set for check DFC_MDCyl_3" VALUE 0x804F9A80 Val_Wu8 1.00000000000 DFES_EnvTabVerb 0.00 1.00000000000 FORMAT "%13.11" /end CHARACTERISTIC
/begin CHARACTERISTIC DFES_EnvRef.DFC_MDEmi_C "used environment signals / Reference to used environment condition set for check DFC_MDEmi" VALUE 0x804F9A81 Val_Wu8 1.00000000000 DFES_EnvTabVerb 0.00 1.00000000000 FORMAT "%13.11" /end CHARACTERISTIC
/begin CHARACTERISTIC DFES_EnvRef.DFC_MDEmiStrt_C "used environment signals / Reference to used environment condition set for check DFC_MDEmiStrt" VALUE 0x804F9A82 Val_Wu8 1.00000000000 DFES_EnvTabVerb 0.00 1.00000000000 FORMAT "%13.11" /end CHARACTERISTIC
/begin CHARACTERISTIC DFES_EnvRef.DFC_MDFco_C "used environment signals / Reference to used environment condition set for check DFC_MDFco" VALUE 0x804F9A83 Val_Wu8 1.00000000000 DFES_EnvTabVerb 0.00 1.00000000000 FORMAT "%13.11" /end CHARACTERISTIC
/begin CHARACTERISTIC DFES_EnvRef.DFC_MDMpl_C "used environment signals / Reference to used environment condition set for check DFC_MDMpl" VALUE 0x804F9A84 Val_Wu8 1.00000000000 DFES_EnvTabVerb 0.00 1.00000000000 FORMAT "%13.11" /end CHARACTERISTIC
/begin CHARACTERISTIC DFES_EnvRef.DFC_MDSegTiAdpn_C "used environment signals / Reference to used environment condition set for check DFC_MDSegTiAdpn" VALUE 0x804F9A85 Val_Wu8 1.00000000000 DFES_EnvTabVerb 0.00 1.00000000000 FORMAT "%13.11" /end CHARACTERISTIC
/begin CHARACTERISTIC DFES_EnvRef.DFC_MDmax_C "used environment signals / Reference to used environment condition set for check DFC_MDmax" VALUE 0x804F9A86 Val_Wu8 1.00000000000 DFES_EnvTabVerb 0.00 1.00000000000 FORMAT "%13.11" /end CHARACTERISTIC
/begin CHARACTERISTIC DFES_EnvRef.DFC_MOXEMM_SMU_ALM0_0_C "used environment signals / Reference to used environment condition set for check DFC_MOXEMM_SMU_ALM0_0" VALUE 0x804F9A87 Val_Wu8 1.00000000000 DFES_EnvTabVerb 0.00 1.00000000000 FORMAT "%13.11" /end CHARACTERISTIC
/begin CHARACTERISTIC DFES_EnvRef.DFC_MOXEMM_SMU_ALM0_1_C "used environment signals / Reference to used environment condition set for check DFC_MOXEMM_SMU_ALM0_1" VALUE 0x804F9A88 Val_Wu8 1.00000000000 DFES_EnvTabVerb 0.00 1.00000000000 FORMAT "%13.11" /end CHARACTERISTIC
/begin CHARACTERISTIC DFES_EnvRef.DFC_MOXEMM_SMU_ALM0_10_C "used environment signals / Reference to used environment condition set for check DFC_MOXEMM_SMU_ALM0_10" VALUE 0x804F9A89 Val_Wu8 1.00000000000 DFES_EnvTabVerb 0.00 1.00000000000 FORMAT "%13.11" /end CHARACTERISTIC
/begin CHARACTERISTIC DFES_EnvRef.DFC_MOXEMM_SMU_ALM0_11_C "used environment signals / Reference to used environment condition set for check DFC_MOXEMM_SMU_ALM0_11" VALUE 0x804F9A8A Val_Wu8 1.00000000000 DFES_EnvTabVerb 0.00 1.00000000000 FORMAT "%13.11" /end CHARACTERISTIC
/begin CHARACTERISTIC DFES_EnvRef.DFC_MOXEMM_SMU_ALM0_13_C "used environment signals / Reference to used environment condition set for check DFC_MOXEMM_SMU_ALM0_13" VALUE 0x804F9A8B Val_Wu8 1.00000000000 DFES_EnvTabVerb 0.00 1.00000000000 FORMAT "%13.11" /end CHARACTERISTIC
/begin CHARACTERISTIC DFES_EnvRef.DFC_MOXEMM_SMU_ALM0_14_C "used environment signals / Reference to used environment condition set for check DFC_MOXEMM_SMU_ALM0_14" VALUE 0x804F9A8C Val_Wu8 1.00000000000 DFES_EnvTabVerb 0.00 1.00000000000 FORMAT "%13.11" /end CHARACTERISTIC
/begin CHARACTERISTIC DFES_EnvRef.DFC_MOXEMM_SMU_ALM0_2_C "used environment signals / Reference to used environment condition set for check DFC_MOXEMM_SMU_ALM0_2" VALUE 0x804F9A8D Val_Wu8 1.00000000000 DFES_EnvTabVerb 0.00 1.00000000000 FORMAT "%13.11" /end CHARACTERISTIC
/begin CHARACTERISTIC DFES_EnvRef.DFC_MOXEMM_SMU_ALM0_22_C "used environment signals / Reference to used environment condition set for check DFC_MOXEMM_SMU_ALM0_22" VALUE 0x804F9A8E Val_Wu8 1.00000000000 DFES_EnvTabVerb 0.00 1.00000000000 FORMAT "%13.11" /end CHARACTERISTIC
/begin CHARACTERISTIC DFES_EnvRef.DFC_MOXEMM_SMU_ALM0_23_C "used environment signals / Reference to used environment condition set for check DFC_MOXEMM_SMU_ALM0_23" VALUE 0x804F9A8F Val_Wu8 1.00000000000 DFES_EnvTabVerb 0.00 1.00000000000 FORMAT "%13.11" /end CHARACTERISTIC
/begin CHARACTERISTIC DFES_EnvRef.DFC_MOXEMM_SMU_ALM0_4_C "used environment signals / Reference to used environment condition set for check DFC_MOXEMM_SMU_ALM0_4" VALUE 0x804F9A90 Val_Wu8 1.00000000000 DFES_EnvTabVerb 0.00 1.00000000000 FORMAT "%13.11" /end CHARACTERISTIC
/begin CHARACTERISTIC DFES_EnvRef.DFC_MOXEMM_SMU_ALM0_5_C "used environment signals / Reference to used environment condition set for check DFC_MOXEMM_SMU_ALM0_5" VALUE 0x804F9A91 Val_Wu8 1.00000000000 DFES_EnvTabVerb 0.00 1.00000000000 FORMAT "%13.11" /end CHARACTERISTIC
/begin CHARACTERISTIC DFES_EnvRef.DFC_MOXEMM_SMU_ALM0_7_C "used environment signals / Reference to used environment condition set for check DFC_MOXEMM_SMU_ALM0_7" VALUE 0x804F9A92 Val_Wu8 1.00000000000 DFES_EnvTabVerb 0.00 1.00000000000 FORMAT "%13.11" /end CHARACTERISTIC
/begin CHARACTERISTIC DFES_EnvRef.DFC_MOXEMM_SMU_ALM0_8_C "used environment signals / Reference to used environment condition set for check DFC_MOXEMM_SMU_ALM0_8" VALUE 0x804F9A93 Val_Wu8 1.00000000000 DFES_EnvTabVerb 0.00 1.00000000000 FORMAT "%13.11" /end CHARACTERISTIC
/begin CHARACTERISTIC DFES_EnvRef.DFC_MOXEMM_SMU_ALM10_16_C "used environment signals / Reference to used environment condition set for check DFC_MOXEMM_SMU_ALM10_16" VALUE 0x804F9A94 Val_Wu8 1.00000000000 DFES_EnvTabVerb 0.00 1.00000000000 FORMAT "%13.11" /end CHARACTERISTIC
/begin CHARACTERISTIC DFES_EnvRef.DFC_MOXEMM_SMU_ALM10_17_C "used environment signals / Reference to used environment condition set for check DFC_MOXEMM_SMU_ALM10_17" VALUE 0x804F9A95 Val_Wu8 1.00000000000 DFES_EnvTabVerb 0.00 1.00000000000 FORMAT "%13.11" /end CHARACTERISTIC
/begin CHARACTERISTIC DFES_EnvRef.DFC_MOXEMM_SMU_ALM10_21_C "used environment signals / Reference to used environment condition set for check DFC_MOXEMM_SMU_ALM10_21" VALUE 0x804F9A96 Val_Wu8 1.00000000000 DFES_EnvTabVerb 0.00 1.00000000000 FORMAT "%13.11" /end CHARACTERISTIC
/begin CHARACTERISTIC DFES_EnvRef.DFC_MOXEMM_SMU_ALM11_0_C "used environment signals / Reference to used environment condition set for check DFC_MOXEMM_SMU_ALM11_0" VALUE 0x804F9A97 Val_Wu8 1.00000000000 DFES_EnvTabVerb 0.00 1.00000000000 FORMAT "%13.11" /end CHARACTERISTIC
/begin CHARACTERISTIC DFES_EnvRef.DFC_MOXEMM_SMU_ALM11_1_C "used environment signals / Reference to used environment condition set for check DFC_MOXEMM_SMU_ALM11_1" VALUE 0x804F9A98 Val_Wu8 1.00000000000 DFES_EnvTabVerb 0.00 1.00000000000 FORMAT "%13.11" /end CHARACTERISTIC
/begin CHARACTERISTIC DFES_EnvRef.DFC_MOXEMM_SMU_ALM11_2_C "used environment signals / Reference to used environment condition set for check DFC_MOXEMM_SMU_ALM11_2" VALUE 0x804F9A99 Val_Wu8 1.00000000000 DFES_EnvTabVerb 0.00 1.00000000000 FORMAT "%13.11" /end CHARACTERISTIC
/begin CHARACTERISTIC DFES_EnvRef.DFC_MOXEMM_SMU_ALM11_3_C "used environment signals / Reference to used environment condition set for check DFC_MOXEMM_SMU_ALM11_3" VALUE 0x804F9A9A Val_Wu8 1.00000000000 DFES_EnvTabVerb 0.00 1.00000000000 FORMAT "%13.11" /end CHARACTERISTIC
/begin CHARACTERISTIC DFES_EnvRef.DFC_MOXEMM_SMU_ALM11_4_C "used environment signals / Reference to used environment condition set for check DFC_MOXEMM_SMU_ALM11_4" VALUE 0x804F9A9B Val_Wu8 1.00000000000 DFES_EnvTabVerb 0.00 1.00000000000 FORMAT "%13.11" /end CHARACTERISTIC
/begin CHARACTERISTIC DFES_EnvRef.DFC_MOXEMM_SMU_ALM11_5_C "used environment signals / Reference to used environment condition set for check DFC_MOXEMM_SMU_ALM11_5" VALUE 0x804F9A9C Val_Wu8 1.00000000000 DFES_EnvTabVerb 0.00 1.00000000000 FORMAT "%13.11" /end CHARACTERISTIC
/begin CHARACTERISTIC DFES_EnvRef.DFC_MOXEMM_SMU_ALM11_8_C "used environment signals / Reference to used environment condition set for check DFC_MOXEMM_SMU_ALM11_8" VALUE 0x804F9A9D Val_Wu8 1.00000000000 DFES_EnvTabVerb 0.00 1.00000000000 FORMAT "%13.11" /end CHARACTERISTIC
/begin CHARACTERISTIC DFES_EnvRef.DFC_MOXEMM_SMU_ALM11_9_C "used environment signals / Reference to used environment condition set for check DFC_MOXEMM_SMU_ALM11_9" VALUE 0x804F9A9E Val_Wu8 1.00000000000 DFES_EnvTabVerb 0.00 1.00000000000 FORMAT "%13.11" /end CHARACTERISTIC
/begin CHARACTERISTIC DFES_EnvRef.DFC_MOXEMM_SMU_ALM1_0_C "used environment signals / Reference to used environment condition set for check DFC_MOXEMM_SMU_ALM1_0" VALUE 0x804F9A9F Val_Wu8 1.00000000000 DFES_EnvTabVerb 0.00 1.00000000000 FORMAT "%13.11" /end CHARACTERISTIC
/begin CHARACTERISTIC DFES_EnvRef.DFC_MOXEMM_SMU_ALM1_1_C "used environment signals / Reference to used environment condition set for check DFC_MOXEMM_SMU_ALM1_1" VALUE 0x804F9AA0 Val_Wu8 1.00000000000 DFES_EnvTabVerb 0.00 1.00000000000 FORMAT "%13.11" /end CHARACTERISTIC
/begin CHARACTERISTIC DFES_EnvRef.DFC_MOXEMM_SMU_ALM1_10_C "used environment signals / Reference to used environment condition set for check DFC_MOXEMM_SMU_ALM1_10" VALUE 0x804F9AA1 Val_Wu8 1.00000000000 DFES_EnvTabVerb 0.00 1.00000000000 FORMAT "%13.11" /end CHARACTERISTIC
/begin CHARACTERISTIC DFES_EnvRef.DFC_MOXEMM_SMU_ALM1_11_C "used environment signals / Reference to used environment condition set for check DFC_MOXEMM_SMU_ALM1_11" VALUE 0x804F9AA2 Val_Wu8 1.00000000000 DFES_EnvTabVerb 0.00 1.00000000000 FORMAT "%13.11" /end CHARACTERISTIC
/begin CHARACTERISTIC DFES_EnvRef.DFC_MOXEMM_SMU_ALM1_13_C "used environment signals / Reference to used environment condition set for check DFC_MOXEMM_SMU_ALM1_13" VALUE 0x804F9AA3 Val_Wu8 1.00000000000 DFES_EnvTabVerb 0.00 1.00000000000 FORMAT "%13.11" /end CHARACTERISTIC
/begin CHARACTERISTIC DFES_EnvRef.DFC_MOXEMM_SMU_ALM1_14_C "used environment signals / Reference to used environment condition set for check DFC_MOXEMM_SMU_ALM1_14" VALUE 0x804F9AA4 Val_Wu8 1.00000000000 DFES_EnvTabVerb 0.00 1.00000000000 FORMAT "%13.11" /end CHARACTERISTIC
/begin CHARACTERISTIC DFES_EnvRef.DFC_MOXEMM_SMU_ALM1_2_C "used environment signals / Reference to used environment condition set for check DFC_MOXEMM_SMU_ALM1_2" VALUE 0x804F9AA5 Val_Wu8 1.00000000000 DFES_EnvTabVerb 0.00 1.00000000000 FORMAT "%13.11" /end CHARACTERISTIC
/begin CHARACTERISTIC DFES_EnvRef.DFC_MOXEMM_SMU_ALM1_22_C "used environment signals / Reference to used environment condition set for check DFC_MOXEMM_SMU_ALM1_22" VALUE 0x804F9AA6 Val_Wu8 1.00000000000 DFES_EnvTabVerb 0.00 1.00000000000 FORMAT "%13.11" /end CHARACTERISTIC
/begin CHARACTERISTIC DFES_EnvRef.DFC_MOXEMM_SMU_ALM1_23_C "used environment signals / Reference to used environment condition set for check DFC_MOXEMM_SMU_ALM1_23" VALUE 0x804F9AA7 Val_Wu8 1.00000000000 DFES_EnvTabVerb 0.00 1.00000000000 FORMAT "%13.11" /end CHARACTERISTIC
/begin CHARACTERISTIC DFES_EnvRef.DFC_MOXEMM_SMU_ALM1_4_C "used environment signals / Reference to used environment condition set for check DFC_MOXEMM_SMU_ALM1_4" VALUE 0x804F9AA8 Val_Wu8 1.00000000000 DFES_EnvTabVerb 0.00 1.00000000000 FORMAT "%13.11" /end CHARACTERISTIC
/begin CHARACTERISTIC DFES_EnvRef.DFC_MOXEMM_SMU_ALM1_5_C "used environment signals / Reference to used environment condition set for check DFC_MOXEMM_SMU_ALM1_5" VALUE 0x804F9AA9 Val_Wu8 1.00000000000 DFES_EnvTabVerb 0.00 1.00000000000 FORMAT "%13.11" /end CHARACTERISTIC
/begin CHARACTERISTIC DFES_EnvRef.DFC_MOXEMM_SMU_ALM1_7_C "used environment signals / Reference to used environment condition set for check DFC_MOXEMM_SMU_ALM1_7" VALUE 0x804F9AAA Val_Wu8 1.00000000000 DFES_EnvTabVerb 0.00 1.00000000000 FORMAT "%13.11" /end CHARACTERISTIC
/begin CHARACTERISTIC DFES_EnvRef.DFC_MOXEMM_SMU_ALM1_8_C "used environment signals / Reference to used environment condition set for check DFC_MOXEMM_SMU_ALM1_8" VALUE 0x804F9AAB Val_Wu8 1.00000000000 DFES_EnvTabVerb 0.00 1.00000000000 FORMAT "%13.11" /end CHARACTERISTIC
/begin CHARACTERISTIC DFES_EnvRef.DFC_MOXEMM_SMU_ALM21_0_C "used environment signals / Reference to used environment condition set for check DFC_MOXEMM_SMU_ALM21_0" VALUE 0x804F9AAC Val_Wu8 1.00000000000 DFES_EnvTabVerb 0.00 1.00000000000 FORMAT "%13.11" /end CHARACTERISTIC
/begin CHARACTERISTIC DFES_EnvRef.DFC_MOXEMM_SMU_ALM21_16_C "used environment signals / Reference to used environment condition set for check DFC_MOXEMM_SMU_ALM21_16" VALUE 0x804F9AAD Val_Wu8 1.00000000000 DFES_EnvTabVerb 0.00 1.00000000000 FORMAT "%13.11" /end CHARACTERISTIC
/begin CHARACTERISTIC DFES_EnvRef.DFC_MOXEMM_SMU_ALM21_3_C "used environment signals / Reference to used environment condition set for check DFC_MOXEMM_SMU_ALM21_3" VALUE 0x804F9AAE Val_Wu8 1.00000000000 DFES_EnvTabVerb 0.00 1.00000000000 FORMAT "%13.11" /end CHARACTERISTIC
/begin CHARACTERISTIC DFES_EnvRef.DFC_MOXEMM_SMU_ALM2_1_C "used environment signals / Reference to used environment condition set for check DFC_MOXEMM_SMU_ALM2_1" VALUE 0x804F9AAF Val_Wu8 1.00000000000 DFES_EnvTabVerb 0.00 1.00000000000 FORMAT "%13.11" /end CHARACTERISTIC
/begin CHARACTERISTIC DFES_EnvRef.DFC_MOXEMM_SMU_ALM2_10_C "used environment signals / Reference to used environment condition set for check DFC_MOXEMM_SMU_ALM2_10" VALUE 0x804F9AB0 Val_Wu8 1.00000000000 DFES_EnvTabVerb 0.00 1.00000000000 FORMAT "%13.11" /end CHARACTERISTIC
/begin CHARACTERISTIC DFES_EnvRef.DFC_MOXEMM_SMU_ALM2_11_C "used environment signals / Reference to used environment condition set for check DFC_MOXEMM_SMU_ALM2_11" VALUE 0x804F9AB1 Val_Wu8 1.00000000000 DFES_EnvTabVerb 0.00 1.00000000000 FORMAT "%13.11" /end CHARACTERISTIC
/begin CHARACTERISTIC DFES_EnvRef.DFC_MOXEMM_SMU_ALM2_13_C "used environment signals / Reference to used environment condition set for check DFC_MOXEMM_SMU_ALM2_13" VALUE 0x804F9AB2 Val_Wu8 1.00000000000 DFES_EnvTabVerb 0.00 1.00000000000 FORMAT "%13.11" /end CHARACTERISTIC
/begin CHARACTERISTIC DFES_EnvRef.DFC_MOXEMM_SMU_ALM2_14_C "used environment signals / Reference to used environment condition set for check DFC_MOXEMM_SMU_ALM2_14" VALUE 0x804F9AB3 Val_Wu8 1.00000000000 DFES_EnvTabVerb 0.00 1.00000000000 FORMAT "%13.11" /end CHARACTERISTIC
/begin CHARACTERISTIC DFES_EnvRef.DFC_MOXEMM_SMU_ALM2_22_C "used environment signals / Reference to used environment condition set for check DFC_MOXEMM_SMU_ALM2_22" VALUE 0x804F9AB4 Val_Wu8 1.00000000000 DFES_EnvTabVerb 0.00 1.00000000000 FORMAT "%13.11" /end CHARACTERISTIC
/begin CHARACTERISTIC DFES_EnvRef.DFC_MOXEMM_SMU_ALM2_23_C "used environment signals / Reference to used environment condition set for check DFC_MOXEMM_SMU_ALM2_23" VALUE 0x804F9AB5 Val_Wu8 1.00000000000 DFES_EnvTabVerb 0.00 1.00000000000 FORMAT "%13.11" /end CHARACTERISTIC
/begin CHARACTERISTIC DFES_EnvRef.DFC_MOXEMM_SMU_ALM2_4_C "used environment signals / Reference to used environment condition set for check DFC_MOXEMM_SMU_ALM2_4" VALUE 0x804F9AB6 Val_Wu8 1.00000000000 DFES_EnvTabVerb 0.00 1.00000000000 FORMAT "%13.11" /end CHARACTERISTIC
/begin CHARACTERISTIC DFES_EnvRef.DFC_MOXEMM_SMU_ALM2_5_C "used environment signals / Reference to used environment condition set for check DFC_MOXEMM_SMU_ALM2_5" VALUE 0x804F9AB7 Val_Wu8 1.00000000000 DFES_EnvTabVerb 0.00 1.00000000000 FORMAT "%13.11" /end CHARACTERISTIC
/begin CHARACTERISTIC DFES_EnvRef.DFC_MOXEMM_SMU_ALM2_7_C "used environment signals / Reference to used environment condition set for check DFC_MOXEMM_SMU_ALM2_7" VALUE 0x804F9AB8 Val_Wu8 1.00000000000 DFES_EnvTabVerb 0.00 1.00000000000 FORMAT "%13.11" /end CHARACTERISTIC
/begin CHARACTERISTIC DFES_EnvRef.DFC_MOXEMM_SMU_ALM2_8_C "used environment signals / Reference to used environment condition set for check DFC_MOXEMM_SMU_ALM2_8" VALUE 0x804F9AB9 Val_Wu8 1.00000000000 DFES_EnvTabVerb 0.00 1.00000000000 FORMAT "%13.11" /end CHARACTERISTIC
/begin CHARACTERISTIC DFES_EnvRef.DFC_MOXEMM_SMU_ALM6_0_C "used environment signals / Reference to used environment condition set for check DFC_MOXEMM_SMU_ALM6_0" VALUE 0x804F9ABA Val_Wu8 1.00000000000 DFES_EnvTabVerb 0.00 1.00000000000 FORMAT "%13.11" /end CHARACTERISTIC
/begin CHARACTERISTIC DFES_EnvRef.DFC_MOXEMM_SMU_ALM6_11_C "used environment signals / Reference to used environment condition set for check DFC_MOXEMM_SMU_ALM6_11" VALUE 0x804F9ABB Val_Wu8 1.00000000000 DFES_EnvTabVerb 0.00 1.00000000000 FORMAT "%13.11" /end CHARACTERISTIC
/begin CHARACTERISTIC DFES_EnvRef.DFC_MOXEMM_SMU_ALM6_12_C "used environment signals / Reference to used environment condition set for check DFC_MOXEMM_SMU_ALM6_12" VALUE 0x804F9ABC Val_Wu8 1.00000000000 DFES_EnvTabVerb 0.00 1.00000000000 FORMAT "%13.11" /end CHARACTERISTIC
/begin CHARACTERISTIC DFES_EnvRef.DFC_MOXEMM_SMU_ALM6_14_C "used environment signals / Reference to used environment condition set for check DFC_MOXEMM_SMU_ALM6_14" VALUE 0x804F9ABD Val_Wu8 1.00000000000 DFES_EnvTabVerb 0.00 1.00000000000 FORMAT "%13.11" /end CHARACTERISTIC
/begin CHARACTERISTIC DFES_EnvRef.DFC_MOXEMM_SMU_ALM6_15_C "used environment signals / Reference to used environment condition set for check DFC_MOXEMM_SMU_ALM6_15" VALUE 0x804F9ABE Val_Wu8 1.00000000000 DFES_EnvTabVerb 0.00 1.00000000000 FORMAT "%13.11" /end CHARACTERISTIC
/begin CHARACTERISTIC DFES_EnvRef.DFC_MOXEMM_SMU_ALM6_17_C "used environment signals / Reference to used environment condition set for check DFC_MOXEMM_SMU_ALM6_17" VALUE 0x804F9ABF Val_Wu8 1.00000000000 DFES_EnvTabVerb 0.00 1.00000000000 FORMAT "%13.11" /end CHARACTERISTIC
/begin CHARACTERISTIC DFES_EnvRef.DFC_MOXEMM_SMU_ALM6_18_C "used environment signals / Reference to used environment condition set for check DFC_MOXEMM_SMU_ALM6_18" VALUE 0x804F9AC0 Val_Wu8 1.00000000000 DFES_EnvTabVerb 0.00 1.00000000000 FORMAT "%13.11" /end CHARACTERISTIC
/begin CHARACTERISTIC DFES_EnvRef.DFC_MOXEMM_SMU_ALM6_20_C "used environment signals / Reference to used environment condition set for check DFC_MOXEMM_SMU_ALM6_20" VALUE 0x804F9AC1 Val_Wu8 1.00000000000 DFES_EnvTabVerb 0.00 1.00000000000 FORMAT "%13.11" /end CHARACTERISTIC
/begin CHARACTERISTIC DFES_EnvRef.DFC_MOXEMM_SMU_ALM6_21_C "used environment signals / Reference to used environment condition set for check DFC_MOXEMM_SMU_ALM6_21" VALUE 0x804F9AC2 Val_Wu8 1.00000000000 DFES_EnvTabVerb 0.00 1.00000000000 FORMAT "%13.11" /end CHARACTERISTIC
/begin CHARACTERISTIC DFES_EnvRef.DFC_MOXEMM_SMU_ALM6_25_C "used environment signals / Reference to used environment condition set for check DFC_MOXEMM_SMU_ALM6_25" VALUE 0x804F9AC3 Val_Wu8 1.00000000000 DFES_EnvTabVerb 0.00 1.00000000000 FORMAT "%13.11" /end CHARACTERISTIC
/begin CHARACTERISTIC DFES_EnvRef.DFC_MOXEMM_SMU_ALM6_4_C "used environment signals / Reference to used environment condition set for check DFC_MOXEMM_SMU_ALM6_4" VALUE 0x804F9AC4 Val_Wu8 1.00000000000 DFES_EnvTabVerb 0.00 1.00000000000 FORMAT "%13.11" /end CHARACTERISTIC
/begin CHARACTERISTIC DFES_EnvRef.DFC_MOXEMM_SMU_ALM6_5_C "used environment signals / Reference to used environment condition set for check DFC_MOXEMM_SMU_ALM6_5" VALUE 0x804F9AC5 Val_Wu8 1.00000000000 DFES_EnvTabVerb 0.00 1.00000000000 FORMAT "%13.11" /end CHARACTERISTIC
/begin CHARACTERISTIC DFES_EnvRef.DFC_MOXEMM_SMU_ALM6_7_C "used environment signals / Reference to used environment condition set for check DFC_MOXEMM_SMU_ALM6_7" VALUE 0x804F9AC6 Val_Wu8 1.00000000000 DFES_EnvTabVerb 0.00 1.00000000000 FORMAT "%13.11" /end CHARACTERISTIC
/begin CHARACTERISTIC DFES_EnvRef.DFC_MOXEMM_SMU_ALM6_8_C "used environment signals / Reference to used environment condition set for check DFC_MOXEMM_SMU_ALM6_8" VALUE 0x804F9AC7 Val_Wu8 1.00000000000 DFES_EnvTabVerb 0.00 1.00000000000 FORMAT "%13.11" /end CHARACTERISTIC
/begin CHARACTERISTIC DFES_EnvRef.DFC_MOXEMM_SMU_ALM7_1_C "used environment signals / Reference to used environment condition set for check DFC_MOXEMM_SMU_ALM7_1" VALUE 0x804F9AC8 Val_Wu8 1.00000000000 DFES_EnvTabVerb 0.00 1.00000000000 FORMAT "%13.11" /end CHARACTERISTIC
/begin CHARACTERISTIC DFES_EnvRef.DFC_MOXEMM_SMU_ALM7_12_C "used environment signals / Reference to used environment condition set for check DFC_MOXEMM_SMU_ALM7_12" VALUE 0x804F9AC9 Val_Wu8 1.00000000000 DFES_EnvTabVerb 0.00 1.00000000000 FORMAT "%13.11" /end CHARACTERISTIC
/begin CHARACTERISTIC DFES_EnvRef.DFC_MOXEMM_SMU_ALM7_13_C "used environment signals / Reference to used environment condition set for check DFC_MOXEMM_SMU_ALM7_13" VALUE 0x804F9ACA Val_Wu8 1.00000000000 DFES_EnvTabVerb 0.00 1.00000000000 FORMAT "%13.11" /end CHARACTERISTIC
/begin CHARACTERISTIC DFES_EnvRef.DFC_MOXEMM_SMU_ALM7_14_C "used environment signals / Reference to used environment condition set for check DFC_MOXEMM_SMU_ALM7_14" VALUE 0x804F9ACB Val_Wu8 1.00000000000 DFES_EnvTabVerb 0.00 1.00000000000 FORMAT "%13.11" /end CHARACTERISTIC
/begin CHARACTERISTIC DFES_EnvRef.DFC_MOXEMM_SMU_ALM7_15_C "used environment signals / Reference to used environment condition set for check DFC_MOXEMM_SMU_ALM7_15" VALUE 0x804F9ACC Val_Wu8 1.00000000000 DFES_EnvTabVerb 0.00 1.00000000000 FORMAT "%13.11" /end CHARACTERISTIC
/begin CHARACTERISTIC DFES_EnvRef.DFC_MOXEMM_SMU_ALM7_16_C "used environment signals / Reference to used environment condition set for check DFC_MOXEMM_SMU_ALM7_16" VALUE 0x804F9ACD Val_Wu8 1.00000000000 DFES_EnvTabVerb 0.00 1.00000000000 FORMAT "%13.11" /end CHARACTERISTIC
/begin CHARACTERISTIC DFES_EnvRef.DFC_MOXEMM_SMU_ALM7_17_C "used environment signals / Reference to used environment condition set for check DFC_MOXEMM_SMU_ALM7_17" VALUE 0x804F9ACE Val_Wu8 1.00000000000 DFES_EnvTabVerb 0.00 1.00000000000 FORMAT "%13.11" /end CHARACTERISTIC
/begin CHARACTERISTIC DFES_EnvRef.DFC_MOXEMM_SMU_ALM7_2_C "used environment signals / Reference to used environment condition set for check DFC_MOXEMM_SMU_ALM7_2" VALUE 0x804F9ACF Val_Wu8 1.00000000000 DFES_EnvTabVerb 0.00 1.00000000000 FORMAT "%13.11" /end CHARACTERISTIC
/begin CHARACTERISTIC DFES_EnvRef.DFC_MOXEMM_SMU_ALM7_20_C "used environment signals / Reference to used environment condition set for check DFC_MOXEMM_SMU_ALM7_20" VALUE 0x804F9AD0 Val_Wu8 1.00000000000 DFES_EnvTabVerb 0.00 1.00000000000 FORMAT "%13.11" /end CHARACTERISTIC
/begin CHARACTERISTIC DFES_EnvRef.DFC_MOXEMM_SMU_ALM7_25_C "used environment signals / Reference to used environment condition set for check DFC_MOXEMM_SMU_ALM7_25" VALUE 0x804F9AD1 Val_Wu8 1.00000000000 DFES_EnvTabVerb 0.00 1.00000000000 FORMAT "%13.11" /end CHARACTERISTIC
/begin CHARACTERISTIC DFES_EnvRef.DFC_MOXEMM_SMU_ALM7_26_C "used environment signals / Reference to used environment condition set for check DFC_MOXEMM_SMU_ALM7_26" VALUE 0x804F9AD2 Val_Wu8 1.00000000000 DFES_EnvTabVerb 0.00 1.00000000000 FORMAT "%13.11" /end CHARACTERISTIC
/begin CHARACTERISTIC DFES_EnvRef.DFC_MOXEMM_SMU_ALM7_28_C "used environment signals / Reference to used environment condition set for check DFC_MOXEMM_SMU_ALM7_28" VALUE 0x804F9AD3 Val_Wu8 1.00000000000 DFES_EnvTabVerb 0.00 1.00000000000 FORMAT "%13.11" /end CHARACTERISTIC
/begin CHARACTERISTIC DFES_EnvRef.DFC_MOXEMM_SMU_ALM7_29_C "used environment signals / Reference to used environment condition set for check DFC_MOXEMM_SMU_ALM7_29" VALUE 0x804F9AD4 Val_Wu8 1.00000000000 DFES_EnvTabVerb 0.00 1.00000000000 FORMAT "%13.11" /end CHARACTERISTIC
/begin CHARACTERISTIC DFES_EnvRef.DFC_MOXEMM_SMU_ALM7_30_C "used environment signals / Reference to used environment condition set for check DFC_MOXEMM_SMU_ALM7_30" VALUE 0x804F9AD5 Val_Wu8 1.00000000000 DFES_EnvTabVerb 0.00 1.00000000000 FORMAT "%13.11" /end CHARACTERISTIC
/begin CHARACTERISTIC DFES_EnvRef.DFC_MOXEMM_SMU_ALM7_31_C "used environment signals / Reference to used environment condition set for check DFC_MOXEMM_SMU_ALM7_31" VALUE 0x804F9AD6 Val_Wu8 1.00000000000 DFES_EnvTabVerb 0.00 1.00000000000 FORMAT "%13.11" /end CHARACTERISTIC
/begin CHARACTERISTIC DFES_EnvRef.DFC_MOXEMM_SMU_ALM8_0_C "used environment signals / Reference to used environment condition set for check DFC_MOXEMM_SMU_ALM8_0" VALUE 0x804F9AD7 Val_Wu8 1.00000000000 DFES_EnvTabVerb 0.00 1.00000000000 FORMAT "%13.11" /end CHARACTERISTIC
/begin CHARACTERISTIC DFES_EnvRef.DFC_MOXEMM_SMU_ALM8_1_C "used environment signals / Reference to used environment condition set for check DFC_MOXEMM_SMU_ALM8_1" VALUE 0x804F9AD8 Val_Wu8 1.00000000000 DFES_EnvTabVerb 0.00 1.00000000000 FORMAT "%13.11" /end CHARACTERISTIC
/begin CHARACTERISTIC DFES_EnvRef.DFC_MOXEMM_SMU_ALM8_10_C "used environment signals / Reference to used environment condition set for check DFC_MOXEMM_SMU_ALM8_10" VALUE 0x804F9AD9 Val_Wu8 1.00000000000 DFES_EnvTabVerb 0.00 1.00000000000 FORMAT "%13.11" /end CHARACTERISTIC
/begin CHARACTERISTIC DFES_EnvRef.DFC_MOXEMM_SMU_ALM8_11_C "used environment signals / Reference to used environment condition set for check DFC_MOXEMM_SMU_ALM8_11" VALUE 0x804F9ADA Val_Wu8 1.00000000000 DFES_EnvTabVerb 0.00 1.00000000000 FORMAT "%13.11" /end CHARACTERISTIC
/begin CHARACTERISTIC DFES_EnvRef.DFC_MOXEMM_SMU_ALM8_12_C "used environment signals / Reference to used environment condition set for check DFC_MOXEMM_SMU_ALM8_12" VALUE 0x804F9ADB Val_Wu8 1.00000000000 DFES_EnvTabVerb 0.00 1.00000000000 FORMAT "%13.11" /end CHARACTERISTIC
/begin CHARACTERISTIC DFES_EnvRef.DFC_MOXEMM_SMU_ALM8_16_C "used environment signals / Reference to used environment condition set for check DFC_MOXEMM_SMU_ALM8_16" VALUE 0x804F9ADC Val_Wu8 1.00000000000 DFES_EnvTabVerb 0.00 1.00000000000 FORMAT "%13.11" /end CHARACTERISTIC
/begin CHARACTERISTIC DFES_EnvRef.DFC_MOXEMM_SMU_ALM8_18_C "used environment signals / Reference to used environment condition set for check DFC_MOXEMM_SMU_ALM8_18" VALUE 0x804F9ADD Val_Wu8 1.00000000000 DFES_EnvTabVerb 0.00 1.00000000000 FORMAT "%13.11" /end CHARACTERISTIC
/begin CHARACTERISTIC DFES_EnvRef.DFC_MOXEMM_SMU_ALM8_2_C "used environment signals / Reference to used environment condition set for check DFC_MOXEMM_SMU_ALM8_2" VALUE 0x804F9ADE Val_Wu8 1.00000000000 DFES_EnvTabVerb 0.00 1.00000000000 FORMAT "%13.11" /end CHARACTERISTIC
/begin CHARACTERISTIC DFES_EnvRef.DFC_MOXEMM_SMU_ALM8_3_C "used environment signals / Reference to used environment condition set for check DFC_MOXEMM_SMU_ALM8_3" VALUE 0x804F9ADF Val_Wu8 1.00000000000 DFES_EnvTabVerb 0.00 1.00000000000 FORMAT "%13.11" /end CHARACTERISTIC
/begin CHARACTERISTIC DFES_EnvRef.DFC_MOXEMM_SMU_ALM8_31_C "used environment signals / Reference to used environment condition set for check DFC_MOXEMM_SMU_ALM8_31" VALUE 0x804F9AE0 Val_Wu8 1.00000000000 DFES_EnvTabVerb 0.00 1.00000000000 FORMAT "%13.11" /end CHARACTERISTIC
/begin CHARACTERISTIC DFES_EnvRef.DFC_MOXEMM_SMU_ALM8_4_C "used environment signals / Reference to used environment condition set for check DFC_MOXEMM_SMU_ALM8_4" VALUE 0x804F9AE1 Val_Wu8 1.00000000000 DFES_EnvTabVerb 0.00 1.00000000000 FORMAT "%13.11" /end CHARACTERISTIC
/begin CHARACTERISTIC DFES_EnvRef.DFC_MOXEMM_SMU_ALM9_0_C "used environment signals / Reference to used environment condition set for check DFC_MOXEMM_SMU_ALM9_0" VALUE 0x804F9AE2 Val_Wu8 1.00000000000 DFES_EnvTabVerb 0.00 1.00000000000 FORMAT "%13.11" /end CHARACTERISTIC
/begin CHARACTERISTIC DFES_EnvRef.DFC_MOXEMM_SMU_ALM9_15_C "used environment signals / Reference to used environment condition set for check DFC_MOXEMM_SMU_ALM9_15" VALUE 0x804F9AE3 Val_Wu8 1.00000000000 DFES_EnvTabVerb 0.00 1.00000000000 FORMAT "%13.11" /end CHARACTERISTIC
/begin CHARACTERISTIC DFES_EnvRef.DFC_MOXEMM_SMU_ALM9_3_C "used environment signals / Reference to used environment condition set for check DFC_MOXEMM_SMU_ALM9_3" VALUE 0x804F9AE4 Val_Wu8 1.00000000000 DFES_EnvTabVerb 0.00 1.00000000000 FORMAT "%13.11" /end CHARACTERISTIC
/begin CHARACTERISTIC DFES_EnvRef.DFC_MoCADCNTP_C "used environment signals / Reference to used environment condition set for check DFC_MoCADCNTP" VALUE 0x804F9AE5 Val_Wu8 1.00000000000 DFES_EnvTabVerb 0.00 1.00000000000 FORMAT "%13.11" /end CHARACTERISTIC
/begin CHARACTERISTIC DFES_EnvRef.DFC_MoCADCTst_C "used environment signals / Reference to used environment condition set for check DFC_MoCADCTst" VALUE 0x804F9AE6 Val_Wu8 1.00000000000 DFES_EnvTabVerb 0.00 1.00000000000 FORMAT "%13.11" /end CHARACTERISTIC
/begin CHARACTERISTIC DFES_EnvRef.DFC_MoCSOPICO_C "used environment signals / Reference to used environment condition set for check DFC_MoCSOPICO" VALUE 0x804F9AE7 Val_Wu8 1.00000000000 DFES_EnvTabVerb 0.00 1.00000000000 FORMAT "%13.11" /end CHARACTERISTIC
/begin CHARACTERISTIC DFES_EnvRef.DFC_MoFAPP_C "used environment signals / Reference to used environment condition set for check DFC_MoFAPP" VALUE 0x804F9AE8 Val_Wu8 1.00000000000 DFES_EnvTabVerb 0.00 1.00000000000 FORMAT "%13.11" /end CHARACTERISTIC
/begin CHARACTERISTIC DFES_EnvRef.DFC_MoFAirFilgPrdc_C "used environment signals / Reference to used environment condition set for check DFC_MoFAirFilgPrdc" VALUE 0x804F9AE9 Val_Wu8 1.00000000000 DFES_EnvTabVerb 0.00 1.00000000000 FORMAT "%13.11" /end CHARACTERISTIC
/begin CHARACTERISTIC DFES_EnvRef.DFC_MoFAirFlCtOffPfi_C "used environment signals / Reference to used environment condition set for check DFC_MoFAirFlCtOffPfi" VALUE 0x804F9AEA Val_Wu8 1.00000000000 DFES_EnvTabVerb 0.00 1.00000000000 FORMAT "%13.11" /end CHARACTERISTIC
/begin CHARACTERISTIC DFES_EnvRef.DFC_MoFAirFlCylPfi_C "used environment signals / Reference to used environment condition set for check DFC_MoFAirFlCylPfi" VALUE 0x804F9AEB Val_Wu8 1.00000000000 DFES_EnvTabVerb 0.00 1.00000000000 FORMAT "%13.11" /end CHARACTERISTIC
/begin CHARACTERISTIC DFES_EnvRef.DFC_MoFAirFlIn_C "used environment signals / Reference to used environment condition set for check DFC_MoFAirFlIn" VALUE 0x804F9AEC Val_Wu8 1.00000000000 DFES_EnvTabVerb 0.00 1.00000000000 FORMAT "%13.11" /end CHARACTERISTIC
/begin CHARACTERISTIC DFES_EnvRef.DFC_MoFAirFlMixCtlPfiChkAirFl_C "used environment signals / Reference to used environment condition set for check DFC_MoFAirFlMixCtlPfiChkAirFl" VALUE 0x804F9AED Val_Wu8 1.00000000000 DFES_EnvTabVerb 0.00 1.00000000000 FORMAT "%13.11" /end CHARACTERISTIC
/begin CHARACTERISTIC DFES_EnvRef.DFC_MoFAirFlMixCtlPfiChkCtrl_C "used environment signals / Reference to used environment condition set for check DFC_MoFAirFlMixCtlPfiChkCtrl" VALUE 0x804F9AEE Val_Wu8 1.00000000000 DFES_EnvTabVerb 0.00 1.00000000000 FORMAT "%13.11" /end CHARACTERISTIC
/begin CHARACTERISTIC DFES_EnvRef.DFC_MoFAirFlMode_C "used environment signals / Reference to used environment condition set for check DFC_MoFAirFlMode" VALUE 0x804F9AEF Val_Wu8 1.00000000000 DFES_EnvTabVerb 0.00 1.00000000000 FORMAT "%13.11" /end CHARACTERISTIC
/begin CHARACTERISTIC DFES_EnvRef.DFC_MoFESpd_C "used environment signals / Reference to used environment condition set for check DFC_MoFESpd" VALUE 0x804F9AF0 Val_Wu8 1.00000000000 DFES_EnvTabVerb 0.00 1.00000000000 FORMAT "%13.11" /end CHARACTERISTIC
/begin CHARACTERISTIC DFES_EnvRef.DFC_MoFIACo_C "used environment signals / Reference to used environment condition set for check DFC_MoFIACo" VALUE 0x804F9AF1 Val_Wu8 1.00000000000 DFES_EnvTabVerb 0.00 1.00000000000 FORMAT "%13.11" /end CHARACTERISTIC
/begin CHARACTERISTIC DFES_EnvRef.DFC_MoFICOL1_C "used environment signals / Reference to used environment condition set for check DFC_MoFICOL1" VALUE 0x804F9AF2 Val_Wu8 1.00000000000 DFES_EnvTabVerb 0.00 1.00000000000 FORMAT "%13.11" /end CHARACTERISTIC
/begin CHARACTERISTIC DFES_EnvRef.DFC_MoFICOL2_C "used environment signals / Reference to used environment condition set for check DFC_MoFICOL2" VALUE 0x804F9AF3 Val_Wu8 1.00000000000 DFES_EnvTabVerb 0.00 1.00000000000 FORMAT "%13.11" /end CHARACTERISTIC
/begin CHARACTERISTIC DFES_EnvRef.DFC_MoFStrt_C "used environment signals / Reference to used environment condition set for check DFC_MoFStrt" VALUE 0x804F9AF4 Val_Wu8 1.00000000000 DFES_EnvTabVerb 0.00 1.00000000000 FORMAT "%13.11" /end CHARACTERISTIC
/begin CHARACTERISTIC DFES_EnvRef.DFC_MoFTrqCmp_C "used environment signals / Reference to used environment condition set for check DFC_MoFTrqCmp" VALUE 0x804F9AF5 Val_Wu8 1.00000000000 DFES_EnvTabVerb 0.00 1.00000000000 FORMAT "%13.11" /end CHARACTERISTIC
/begin CHARACTERISTIC DFES_EnvRef.DFC_MoFTrqCmpMax_C "used environment signals / Reference to used environment condition set for check DFC_MoFTrqCmpMax" VALUE 0x804F9AF6 Val_Wu8 1.00000000000 DFES_EnvTabVerb 0.00 1.00000000000 FORMAT "%13.11" /end CHARACTERISTIC
/begin CHARACTERISTIC DFES_EnvRef.DFC_MoFTrqCmpMin_C "used environment signals / Reference to used environment condition set for check DFC_MoFTrqCmpMin" VALUE 0x804F9AF7 Val_Wu8 1.00000000000 DFES_EnvTabVerb 0.00 1.00000000000 FORMAT "%13.11" /end CHARACTERISTIC
/begin CHARACTERISTIC DFES_EnvRef.DFC_MoFVarPostBldSel_C "used environment signals / Reference to used environment condition set for check DFC_MoFVarPostBldSel" VALUE 0x804F9AF8 Val_Wu8 1.00000000000 DFES_EnvTabVerb 0.00 1.00000000000 FORMAT "%13.11" /end CHARACTERISTIC
/begin CHARACTERISTIC DFES_EnvRef.DFC_MoXEMMHwLTMCUFW_C "used environment signals / Reference to used environment condition set for check DFC_MoXEMMHwLTMCUFW" VALUE 0x804F9AF9 Val_Wu8 1.00000000000 DFES_EnvTabVerb 0.00 1.00000000000 FORMAT "%13.11" /end CHARACTERISTIC
/begin CHARACTERISTIC DFES_EnvRef.DFC_MoXEMMHwLTMonBIST_C "used environment signals / Reference to used environment condition set for check DFC_MoXEMMHwLTMonBIST" VALUE 0x804F9AFA Val_Wu8 1.00000000000 DFES_EnvTabVerb 0.00 1.00000000000 FORMAT "%13.11" /end CHARACTERISTIC
/begin CHARACTERISTIC DFES_EnvRef.DFC_MoXEMMHwLTRegMonTest_C "used environment signals / Reference to used environment condition set for check DFC_MoXEMMHwLTRegMonTest" VALUE 0x804F9AFB Val_Wu8 1.00000000000 DFES_EnvTabVerb 0.00 1.00000000000 FORMAT "%13.11" /end CHARACTERISTIC
/begin CHARACTERISTIC DFES_EnvRef.DFC_MoXEMMHwLTStbySMUAlvTest_C "used environment signals / Reference to used environment condition set for check DFC_MoXEMMHwLTStbySMUAlvTest" VALUE 0x804F9AFC Val_Wu8 1.00000000000 DFES_EnvTabVerb 0.00 1.00000000000 FORMAT "%13.11" /end CHARACTERISTIC
/begin CHARACTERISTIC DFES_EnvRef.DFC_MoXEMMHwLTTempSens_C "used environment signals / Reference to used environment condition set for check DFC_MoXEMMHwLTTempSens" VALUE 0x804F9AFD Val_Wu8 1.00000000000 DFES_EnvTabVerb 0.00 1.00000000000 FORMAT "%13.11" /end CHARACTERISTIC
/begin CHARACTERISTIC DFES_EnvRef.DFC_MoXEMMHwLTUCBCfg_C "used environment signals / Reference to used environment condition set for check DFC_MoXEMMHwLTUCBCfg" VALUE 0x804F9AFE Val_Wu8 1.00000000000 DFES_EnvTabVerb 0.00 1.00000000000 FORMAT "%13.11" /end CHARACTERISTIC
/begin CHARACTERISTIC DFES_EnvRef.DFC_OCWDAABEActv_C "used environment signals / Reference to used environment condition set for check DFC_OCWDAABEActv" VALUE 0x804F9AFF Val_Wu8 1.00000000000 DFES_EnvTabVerb 0.00 1.00000000000 FORMAT "%13.11" /end CHARACTERISTIC
/begin CHARACTERISTIC DFES_EnvRef.DFC_OCWDACom_C "used environment signals / Reference to used environment condition set for check DFC_OCWDACom" VALUE 0x804F9B00 Val_Wu8 1.00000000000 DFES_EnvTabVerb 0.00 1.00000000000 FORMAT "%13.11" /end CHARACTERISTIC
/begin CHARACTERISTIC DFES_EnvRef.DFC_OCWDAErrPin_C "used environment signals / Reference to used environment condition set for check DFC_OCWDAErrPin" VALUE 0x804F9B01 Val_Wu8 1.00000000000 DFES_EnvTabVerb 0.00 1.00000000000 FORMAT "%13.11" /end CHARACTERISTIC
/begin CHARACTERISTIC DFES_EnvRef.DFC_OCWDAOvrVltg_C "used environment signals / Reference to used environment condition set for check DFC_OCWDAOvrVltg" VALUE 0x804F9B02 Val_Wu8 1.00000000000 DFES_EnvTabVerb 0.00 1.00000000000 FORMAT "%13.11" /end CHARACTERISTIC
/begin CHARACTERISTIC DFES_EnvRef.DFC_ORAmax_C "used environment signals / Reference to used environment condition set for check DFC_ORAmax" VALUE 0x804F9B03 Val_Wu8 1.00000000000 DFES_EnvTabVerb 0.00 1.00000000000 FORMAT "%13.11" /end CHARACTERISTIC
/begin CHARACTERISTIC DFES_EnvRef.DFC_ORAmin_C "used environment signals / Reference to used environment condition set for check DFC_ORAmin" VALUE 0x804F9B04 Val_Wu8 1.00000000000 DFES_EnvTabVerb 0.00 1.00000000000 FORMAT "%13.11" /end CHARACTERISTIC
/begin CHARACTERISTIC DFES_EnvRef.DFC_PLLSUmax_C "used environment signals / Reference to used environment condition set for check DFC_PLLSUmax" VALUE 0x804F9B05 Val_Wu8 1.00000000000 DFES_EnvTabVerb 0.00 1.00000000000 FORMAT "%13.11" /end CHARACTERISTIC
/begin CHARACTERISTIC DFES_EnvRef.DFC_PLLSUmin_C "used environment signals / Reference to used environment condition set for check DFC_PLLSUmin" VALUE 0x804F9B06 Val_Wu8 1.00000000000 DFES_EnvTabVerb 0.00 1.00000000000 FORMAT "%13.11" /end CHARACTERISTIC
/begin CHARACTERISTIC DFES_EnvRef.DFC_PSR1max_C "used environment signals / Reference to used environment condition set for check DFC_PSR1max" VALUE 0x804F9B07 Val_Wu8 1.00000000000 DFES_EnvTabVerb 0.00 1.00000000000 FORMAT "%13.11" /end CHARACTERISTIC
/begin CHARACTERISTIC DFES_EnvRef.DFC_PSRBmax_C "used environment signals / Reference to used environment condition set for check DFC_PSRBmax" VALUE 0x804F9B08 Val_Wu8 1.00000000000 DFES_EnvTabVerb 0.00 1.00000000000 FORMAT "%13.11" /end CHARACTERISTIC
/begin CHARACTERISTIC DFES_EnvRef.DFC_PSRBmin_C "used environment signals / Reference to used environment condition set for check DFC_PSRBmin" VALUE 0x804F9B09 Val_Wu8 1.00000000000 DFES_EnvTabVerb 0.00 1.00000000000 FORMAT "%13.11" /end CHARACTERISTIC
/begin CHARACTERISTIC DFES_EnvRef.DFC_PSRPmax_C "used environment signals / Reference to used environment condition set for check DFC_PSRPmax" VALUE 0x804F9B0A Val_Wu8 1.00000000000 DFES_EnvTabVerb 0.00 1.00000000000 FORMAT "%13.11" /end CHARACTERISTIC
/begin CHARACTERISTIC DFES_EnvRef.DFC_PSRPmin_C "used environment signals / Reference to used environment condition set for check DFC_PSRPmin" VALUE 0x804F9B0B Val_Wu8 1.00000000000 DFES_EnvTabVerb 0.00 1.00000000000 FORMAT "%13.11" /end CHARACTERISTIC
/begin CHARACTERISTIC DFES_EnvRef.DFC_PSRPsig_C "used environment signals / Reference to used environment condition set for check DFC_PSRPsig" VALUE 0x804F9B0C Val_Wu8 1.00000000000 DFES_EnvTabVerb 0.00 1.00000000000 FORMAT "%13.11" /end CHARACTERISTIC
/begin CHARACTERISTIC DFES_EnvRef.DFC_PSRmax_C "used environment signals / Reference to used environment condition set for check DFC_PSRmax" VALUE 0x804F9B0D Val_Wu8 1.00000000000 DFES_EnvTabVerb 0.00 1.00000000000 FORMAT "%13.11" /end CHARACTERISTIC
/begin CHARACTERISTIC DFES_EnvRef.DFC_PUmax_C "used environment signals / Reference to used environment condition set for check DFC_PUmax" VALUE 0x804F9B0E Val_Wu8 1.00000000000 DFES_EnvTabVerb 0.00 1.00000000000 FORMAT "%13.11" /end CHARACTERISTIC
/begin CHARACTERISTIC DFES_EnvRef.DFC_P_VSE11_OL_C "used environment signals / Reference to used environment condition set for check DFC_P_VSE11_OL" VALUE 0x804F9B0F Val_Wu8 1.00000000000 DFES_EnvTabVerb 0.00 1.00000000000 FORMAT "%13.11" /end CHARACTERISTIC
/begin CHARACTERISTIC DFES_EnvRef.DFC_P_VSE11_SCB_C "used environment signals / Reference to used environment condition set for check DFC_P_VSE11_SCB" VALUE 0x804F9B10 Val_Wu8 1.00000000000 DFES_EnvTabVerb 0.00 1.00000000000 FORMAT "%13.11" /end CHARACTERISTIC
/begin CHARACTERISTIC DFES_EnvRef.DFC_P_VSE11_SCG_C "used environment signals / Reference to used environment condition set for check DFC_P_VSE11_SCG" VALUE 0x804F9B11 Val_Wu8 1.00000000000 DFES_EnvTabVerb 0.00 1.00000000000 FORMAT "%13.11" /end CHARACTERISTIC
/begin CHARACTERISTIC DFES_EnvRef.DFC_PhyHighAPP1_C "used environment signals / Reference to used environment condition set for check DFC_PhyHighAPP1" VALUE 0x804F9B12 Val_Wu8 1.00000000000 DFES_EnvTabVerb 0.00 1.00000000000 FORMAT "%13.11" /end CHARACTERISTIC
/begin CHARACTERISTIC DFES_EnvRef.DFC_PhyHighAPP2_C "used environment signals / Reference to used environment condition set for check DFC_PhyHighAPP2" VALUE 0x804F9B13 Val_Wu8 1.00000000000 DFES_EnvTabVerb 0.00 1.00000000000 FORMAT "%13.11" /end CHARACTERISTIC
/begin CHARACTERISTIC DFES_EnvRef.DFC_PhyLowAPP1_C "used environment signals / Reference to used environment condition set for check DFC_PhyLowAPP1" VALUE 0x804F9B14 Val_Wu8 1.00000000000 DFES_EnvTabVerb 0.00 1.00000000000 FORMAT "%13.11" /end CHARACTERISTIC
/begin CHARACTERISTIC DFES_EnvRef.DFC_PhyLowAPP2_C "used environment signals / Reference to used environment condition set for check DFC_PhyLowAPP2" VALUE 0x804F9B15 Val_Wu8 1.00000000000 DFES_EnvTabVerb 0.00 1.00000000000 FORMAT "%13.11" /end CHARACTERISTIC
/begin CHARACTERISTIC DFES_EnvRef.DFC_SRCHighAPP1_C "used environment signals / Reference to used environment condition set for check DFC_SRCHighAPP1" VALUE 0x804F9B16 Val_Wu8 1.00000000000 DFES_EnvTabVerb 0.00 1.00000000000 FORMAT "%13.11" /end CHARACTERISTIC
/begin CHARACTERISTIC DFES_EnvRef.DFC_SRCHighAPP2_C "used environment signals / Reference to used environment condition set for check DFC_SRCHighAPP2" VALUE 0x804F9B17 Val_Wu8 1.00000000000 DFES_EnvTabVerb 0.00 1.00000000000 FORMAT "%13.11" /end CHARACTERISTIC
/begin CHARACTERISTIC DFES_EnvRef.DFC_SRCLowAPP1_C "used environment signals / Reference to used environment condition set for check DFC_SRCLowAPP1" VALUE 0x804F9B18 Val_Wu8 1.00000000000 DFES_EnvTabVerb 0.00 1.00000000000 FORMAT "%13.11" /end CHARACTERISTIC
/begin CHARACTERISTIC DFES_EnvRef.DFC_SRCLowAPP2_C "used environment signals / Reference to used environment condition set for check DFC_SRCLowAPP2" VALUE 0x804F9B19 Val_Wu8 1.00000000000 DFES_EnvTabVerb 0.00 1.00000000000 FORMAT "%13.11" /end CHARACTERISTIC
/begin CHARACTERISTIC DFES_EnvRef.DFC_SSpMon2_C "used environment signals / Reference to used environment condition set for check DFC_SSpMon2" VALUE 0x804F9B1A Val_Wu8 1.00000000000 DFES_EnvTabVerb 0.00 1.00000000000 FORMAT "%13.11" /end CHARACTERISTIC
/begin CHARACTERISTIC DFES_EnvRef.DFC_SWReset_0_C "used environment signals / Reference to used environment condition set for check DFC_SWReset_0" VALUE 0x804F9B1B Val_Wu8 1.00000000000 DFES_EnvTabVerb 0.00 1.00000000000 FORMAT "%13.11" /end CHARACTERISTIC
/begin CHARACTERISTIC DFES_EnvRef.DFC_SWReset_1_C "used environment signals / Reference to used environment condition set for check DFC_SWReset_1" VALUE 0x804F9B1C Val_Wu8 1.00000000000 DFES_EnvTabVerb 0.00 1.00000000000 FORMAT "%13.11" /end CHARACTERISTIC
/begin CHARACTERISTIC DFES_EnvRef.DFC_SWReset_2_C "used environment signals / Reference to used environment condition set for check DFC_SWReset_2" VALUE 0x804F9B1D Val_Wu8 1.00000000000 DFES_EnvTabVerb 0.00 1.00000000000 FORMAT "%13.11" /end CHARACTERISTIC
/begin CHARACTERISTIC DFES_EnvRef.DFC_SyncAPP_C "used environment signals / Reference to used environment condition set for check DFC_SyncAPP" VALUE 0x804F9B1E Val_Wu8 1.00000000000 DFES_EnvTabVerb 0.00 1.00000000000 FORMAT "%13.11" /end CHARACTERISTIC
/begin CHARACTERISTIC DFES_EnvRef.DFC_TAmax_Dummy_C "used environment signals / Reference to used environment condition set for check DFC_TAmax_Dummy" VALUE 0x804F9B1F Val_Wu8 1.00000000000 DFES_EnvTabVerb 0.00 1.00000000000 FORMAT "%13.11" /end CHARACTERISTIC
/begin CHARACTERISTIC DFES_EnvRef.DFC_TKAEmax_C "used environment signals / Reference to used environment condition set for check DFC_TKAEmax" VALUE 0x804F9B20 Val_Wu8 1.00000000000 DFES_EnvTabVerb 0.00 1.00000000000 FORMAT "%13.11" /end CHARACTERISTIC
/begin CHARACTERISTIC DFES_EnvRef.DFC_TKAEmin_C "used environment signals / Reference to used environment condition set for check DFC_TKAEmin" VALUE 0x804F9B21 Val_Wu8 1.00000000000 DFES_EnvTabVerb 0.00 1.00000000000 FORMAT "%13.11" /end CHARACTERISTIC
/begin CHARACTERISTIC DFES_EnvRef.DFC_TKARmax_C "used environment signals / Reference to used environment condition set for check DFC_TKARmax" VALUE 0x804F9B22 Val_Wu8 1.00000000000 DFES_EnvTabVerb 0.00 1.00000000000 FORMAT "%13.11" /end CHARACTERISTIC
/begin CHARACTERISTIC DFES_EnvRef.DFC_TKARnpl_C "used environment signals / Reference to used environment condition set for check DFC_TKARnpl" VALUE 0x804F9B23 Val_Wu8 1.00000000000 DFES_EnvTabVerb 0.00 1.00000000000 FORMAT "%13.11" /end CHARACTERISTIC
/begin CHARACTERISTIC DFES_EnvRef.DFC_TMmax_Dummy_C "used environment signals / Reference to used environment condition set for check DFC_TMmax_Dummy" VALUE 0x804F9B24 Val_Wu8 1.00000000000 DFES_EnvTabVerb 0.00 1.00000000000 FORMAT "%13.11" /end CHARACTERISTIC
/begin CHARACTERISTIC DFES_EnvRef.DFC_TUMmax_Dummy_C "used environment signals / Reference to used environment condition set for check DFC_TUMmax_Dummy" VALUE 0x804F9B25 Val_Wu8 1.00000000000 DFES_EnvTabVerb 0.00 1.00000000000 FORMAT "%13.11" /end CHARACTERISTIC
/begin CHARACTERISTIC DFES_EnvRef.DFC_TWCDPriCatB1_C "used environment signals / Reference to used environment condition set for check DFC_TWCDPriCatB1" VALUE 0x804F9B26 Val_Wu8 1.00000000000 DFES_EnvTabVerb 0.00 1.00000000000 FORMAT "%13.11" /end CHARACTERISTIC
/begin CHARACTERISTIC DFES_EnvRef.DFC_ThrVlvClsdPosnFirstOffsLrnImpoB1_C "used environment signals / Reference to used environment condition set for check DFC_ThrVlvClsdPosnFirstOffsLrnImpoB1" VALUE 0x804F9B27 Val_Wu8 1.00000000000 DFES_EnvTabVerb 0.00 1.00000000000 FORMAT "%13.11" /end CHARACTERISTIC
/begin CHARACTERISTIC DFES_EnvRef.DFC_ThrVlvClsdPosnOffsLrnImpoB1_C "used environment signals / Reference to used environment condition set for check DFC_ThrVlvClsdPosnOffsLrnImpoB1" VALUE 0x804F9B28 Val_Wu8 1.00000000000 DFES_EnvTabVerb 0.00 1.00000000000 FORMAT "%13.11" /end CHARACTERISTIC
/begin CHARACTERISTIC DFES_EnvRef.DFC_ThrVlvClsdPosnOffsLrnMaxB1_C "used environment signals / Reference to used environment condition set for check DFC_ThrVlvClsdPosnOffsLrnMaxB1" VALUE 0x804F9B29 Val_Wu8 1.00000000000 DFES_EnvTabVerb 0.00 1.00000000000 FORMAT "%13.11" /end CHARACTERISTIC
/begin CHARACTERISTIC DFES_EnvRef.DFC_ThrVlvClsdPosnOffsLrnMinB1_C "used environment signals / Reference to used environment condition set for check DFC_ThrVlvClsdPosnOffsLrnMinB1" VALUE 0x804F9B2A Val_Wu8 1.00000000000 DFES_EnvTabVerb 0.00 1.00000000000 FORMAT "%13.11" /end CHARACTERISTIC
/begin CHARACTERISTIC DFES_EnvRef.DFC_ThrVlvCtrlDeB1_C "used environment signals / Reference to used environment condition set for check DFC_ThrVlvCtrlDeB1" VALUE 0x804F9B2B Val_Wu8 1.00000000000 DFES_EnvTabVerb 0.00 1.00000000000 FORMAT "%13.11" /end CHARACTERISTIC
/begin CHARACTERISTIC DFES_EnvRef.DFC_ThrVlvDycB1_C "used environment signals / Reference to used environment condition set for check DFC_ThrVlvDycB1" VALUE 0x804F9B2C Val_Wu8 1.00000000000 DFES_EnvTabVerb 0.00 1.00000000000 FORMAT "%13.11" /end CHARACTERISTIC
/begin CHARACTERISTIC DFES_EnvRef.DFC_ThrVlvLimpAirPosnMaxAbsltDriftB1_C "used environment signals / Reference to used environment condition set for check DFC_ThrVlvLimpAirPosnMaxAbsltDriftB1" VALUE 0x804F9B2D Val_Wu8 1.00000000000 DFES_EnvTabVerb 0.00 1.00000000000 FORMAT "%13.11" /end CHARACTERISTIC
/begin CHARACTERISTIC DFES_EnvRef.DFC_ThrVlvLimpAirPosnMaxB1_C "used environment signals / Reference to used environment condition set for check DFC_ThrVlvLimpAirPosnMaxB1" VALUE 0x804F9B2E Val_Wu8 1.00000000000 DFES_EnvTabVerb 0.00 1.00000000000 FORMAT "%13.11" /end CHARACTERISTIC
/begin CHARACTERISTIC DFES_EnvRef.DFC_ThrVlvLimpAirPosnMaxRelDriftB1_C "used environment signals / Reference to used environment condition set for check DFC_ThrVlvLimpAirPosnMaxRelDriftB1" VALUE 0x804F9B2F Val_Wu8 1.00000000000 DFES_EnvTabVerb 0.00 1.00000000000 FORMAT "%13.11" /end CHARACTERISTIC
/begin CHARACTERISTIC DFES_EnvRef.DFC_ThrVlvLimpAirPosnMinB1_C "used environment signals / Reference to used environment condition set for check DFC_ThrVlvLimpAirPosnMinB1" VALUE 0x804F9B30 Val_Wu8 1.00000000000 DFES_EnvTabVerb 0.00 1.00000000000 FORMAT "%13.11" /end CHARACTERISTIC
/begin CHARACTERISTIC DFES_EnvRef.DFC_ThrVlvOpenLoadB1_C "used environment signals / Reference to used environment condition set for check DFC_ThrVlvOpenLoadB1" VALUE 0x804F9B31 Val_Wu8 1.00000000000 DFES_EnvTabVerb 0.00 1.00000000000 FORMAT "%13.11" /end CHARACTERISTIC
/begin CHARACTERISTIC DFES_EnvRef.DFC_ThrVlvOpenSprgB1_C "used environment signals / Reference to used environment condition set for check DFC_ThrVlvOpenSprgB1" VALUE 0x804F9B32 Val_Wu8 1.00000000000 DFES_EnvTabVerb 0.00 1.00000000000 FORMAT "%13.11" /end CHARACTERISTIC
/begin CHARACTERISTIC DFES_EnvRef.DFC_ThrVlvOpenSprgSprdB1_C "used environment signals / Reference to used environment condition set for check DFC_ThrVlvOpenSprgSprdB1" VALUE 0x804F9B33 Val_Wu8 1.00000000000 DFES_EnvTabVerb 0.00 1.00000000000 FORMAT "%13.11" /end CHARACTERISTIC
/begin CHARACTERISTIC DFES_EnvRef.DFC_ThrVlvOpenSprgTwnB1_C "used environment signals / Reference to used environment condition set for check DFC_ThrVlvOpenSprgTwnB1" VALUE 0x804F9B34 Val_Wu8 1.00000000000 DFES_EnvTabVerb 0.00 1.00000000000 FORMAT "%13.11" /end CHARACTERISTIC
/begin CHARACTERISTIC DFES_EnvRef.DFC_ThrVlvOverTB1_C "used environment signals / Reference to used environment condition set for check DFC_ThrVlvOverTB1" VALUE 0x804F9B35 Val_Wu8 1.00000000000 DFES_EnvTabVerb 0.00 1.00000000000 FORMAT "%13.11" /end CHARACTERISTIC
/begin CHARACTERISTIC DFES_EnvRef.DFC_ThrVlvRetSprgB1_C "used environment signals / Reference to used environment condition set for check DFC_ThrVlvRetSprgB1" VALUE 0x804F9B36 Val_Wu8 1.00000000000 DFES_EnvTabVerb 0.00 1.00000000000 FORMAT "%13.11" /end CHARACTERISTIC
/begin CHARACTERISTIC DFES_EnvRef.DFC_ThrVlvRetSprgSprdB1_C "used environment signals / Reference to used environment condition set for check DFC_ThrVlvRetSprgSprdB1" VALUE 0x804F9B37 Val_Wu8 1.00000000000 DFES_EnvTabVerb 0.00 1.00000000000 FORMAT "%13.11" /end CHARACTERISTIC
/begin CHARACTERISTIC DFES_EnvRef.DFC_ThrVlvRetSprgTwnB1_C "used environment signals / Reference to used environment condition set for check DFC_ThrVlvRetSprgTwnB1" VALUE 0x804F9B38 Val_Wu8 1.00000000000 DFES_EnvTabVerb 0.00 1.00000000000 FORMAT "%13.11" /end CHARACTERISTIC
/begin CHARACTERISTIC DFES_EnvRef.DFC_ThrVlvSens1MaxB1_C "used environment signals / Reference to used environment condition set for check DFC_ThrVlvSens1MaxB1" VALUE 0x804F9B39 Val_Wu8 1.00000000000 DFES_EnvTabVerb 0.00 1.00000000000 FORMAT "%13.11" /end CHARACTERISTIC
/begin CHARACTERISTIC DFES_EnvRef.DFC_ThrVlvSens1NplB1_C "used environment signals / Reference to used environment condition set for check DFC_ThrVlvSens1NplB1" VALUE 0x804F9B3A Val_Wu8 1.00000000000 DFES_EnvTabVerb 0.00 1.00000000000 FORMAT "%13.11" /end CHARACTERISTIC
/begin CHARACTERISTIC DFES_EnvRef.DFC_ThrVlvSens2MaxB1_C "used environment signals / Reference to used environment condition set for check DFC_ThrVlvSens2MaxB1" VALUE 0x804F9B3B Val_Wu8 1.00000000000 DFES_EnvTabVerb 0.00 1.00000000000 FORMAT "%13.11" /end CHARACTERISTIC
/begin CHARACTERISTIC DFES_EnvRef.DFC_ThrVlvSens2MinB1_C "used environment signals / Reference to used environment condition set for check DFC_ThrVlvSens2MinB1" VALUE 0x804F9B3C Val_Wu8 1.00000000000 DFES_EnvTabVerb 0.00 1.00000000000 FORMAT "%13.11" /end CHARACTERISTIC
/begin CHARACTERISTIC DFES_EnvRef.DFC_ThrVlvSens2NplB1_C "used environment signals / Reference to used environment condition set for check DFC_ThrVlvSens2NplB1" VALUE 0x804F9B3D Val_Wu8 1.00000000000 DFES_EnvTabVerb 0.00 1.00000000000 FORMAT "%13.11" /end CHARACTERISTIC
/begin CHARACTERISTIC DFES_EnvRef.DFC_ThrVlvShoCircB1_C "used environment signals / Reference to used environment condition set for check DFC_ThrVlvShoCircB1" VALUE 0x804F9B3E Val_Wu8 1.00000000000 DFES_EnvTabVerb 0.00 1.00000000000 FORMAT "%13.11" /end CHARACTERISTIC
/begin CHARACTERISTIC DFES_EnvRef.DFC_ThrVlvSpiErrB1_C "used environment signals / Reference to used environment condition set for check DFC_ThrVlvSpiErrB1" VALUE 0x804F9B3F Val_Wu8 1.00000000000 DFES_EnvTabVerb 0.00 1.00000000000 FORMAT "%13.11" /end CHARACTERISTIC
/begin CHARACTERISTIC DFES_EnvRef.DFC_ThrvlvSens1MinB1_C "used environment signals / Reference to used environment condition set for check DFC_ThrvlvSens1MinB1" VALUE 0x804F9B40 Val_Wu8 1.00000000000 DFES_EnvTabVerb 0.00 1.00000000000 FORMAT "%13.11" /end CHARACTERISTIC
/begin CHARACTERISTIC DFES_EnvRef.DFC_TiOffTBasdChkFast_C "used environment signals / Reference to used environment condition set for check DFC_TiOffTBasdChkFast" VALUE 0x804F9B41 Val_Wu8 1.00000000000 DFES_EnvTabVerb 0.00 1.00000000000 FORMAT "%13.11" /end CHARACTERISTIC
/begin CHARACTERISTIC DFES_EnvRef.DFC_TiOffTBasdChkSlow_C "used environment signals / Reference to used environment condition set for check DFC_TiOffTBasdChkSlow" VALUE 0x804F9B42 Val_Wu8 1.00000000000 DFES_EnvTabVerb 0.00 1.00000000000 FORMAT "%13.11" /end CHARACTERISTIC
/begin CHARACTERISTIC DFES_EnvRef.DFC_UEGOHeatrCtlS1B1_C "used environment signals / Reference to used environment condition set for check DFC_UEGOHeatrCtlS1B1" VALUE 0x804F9B43 Val_Wu8 1.00000000000 DFES_EnvTabVerb 0.00 1.00000000000 FORMAT "%13.11" /end CHARACTERISTIC
/begin CHARACTERISTIC DFES_EnvRef.DFC_UEGOSnsrMntdS1B1_C "used environment signals / Reference to used environment condition set for check DFC_UEGOSnsrMntdS1B1" VALUE 0x804F9B44 Val_Wu8 1.00000000000 DFES_EnvTabVerb 0.00 1.00000000000 FORMAT "%13.11" /end CHARACTERISTIC
/begin CHARACTERISTIC DFES_EnvRef.DFC_VehVSig_C "used environment signals / Reference to used environment condition set for check DFC_VehVSig" VALUE 0x804F9B45 Val_Wu8 1.00000000000 DFES_EnvTabVerb 0.00 1.00000000000 FORMAT "%13.11" /end CHARACTERISTIC
/begin CHARACTERISTIC DFES_EnvRef.DFC_VlvLftFbSwtIntk11SpclFail_C "used environment signals / Reference to used environment condition set for check DFC_VlvLftFbSwtIntk11SpclFail" VALUE 0x804F9B46 Val_Wu8 1.00000000000 DFES_EnvTabVerb 0.00 1.00000000000 FORMAT "%13.11" /end CHARACTERISTIC
/begin CHARACTERISTIC DFES_EnvRef.DFC_VlvLftFbSwtIntk11StdFail_C "used environment signals / Reference to used environment condition set for check DFC_VlvLftFbSwtIntk11StdFail" VALUE 0x804F9B47 Val_Wu8 1.00000000000 DFES_EnvTabVerb 0.00 1.00000000000 FORMAT "%13.11" /end CHARACTERISTIC
/begin CHARACTERISTIC DFES_FaultTyp.DFC_Unused_C "assigned fault type / " VALUE 0x804F9B48 Val_Wu8 255.0 DFES_OneToOne 0.00 255.0 FORMAT "%5.1" READ_ONLY /end CHARACTERISTIC
/begin CHARACTERISTIC DFES_FaultTyp.DFC_AltIOACGFailr_C "assigned fault type / Fault type assignment for check DFC_AltIOACGFailr" VALUE 0x804F9B49 Val_Wu8 255.0 DFES_OneToOne 0.00 255.0 FORMAT "%5.1" /end CHARACTERISTIC
/begin CHARACTERISTIC DFES_FaultTyp.DFC_AltIOACGHiVltg_C "assigned fault type / Fault type assignment for check DFC_AltIOACGHiVltg" VALUE 0x804F9B4A Val_Wu8 255.0 DFES_OneToOne 0.00 255.0 FORMAT "%5.1" /end CHARACTERISTIC
/begin CHARACTERISTIC DFES_FaultTyp.DFC_AltIOACGLoVltg_C "assigned fault type / Fault type assignment for check DFC_AltIOACGLoVltg" VALUE 0x804F9B4B Val_Wu8 255.0 DFES_OneToOne 0.00 255.0 FORMAT "%5.1" /end CHARACTERISTIC
/begin CHARACTERISTIC DFES_FaultTyp.DFC_AltIOACGTHi_C "assigned fault type / Fault type assignment for check DFC_AltIOACGTHi" VALUE 0x804F9B4C Val_Wu8 255.0 DFES_OneToOne 0.00 255.0 FORMAT "%5.1" /end CHARACTERISTIC
/begin CHARACTERISTIC DFES_FaultTyp.DFC_AltIODConnACG_C "assigned fault type / Fault type assignment for check DFC_AltIODConnACG" VALUE 0x804F9B4D Val_Wu8 255.0 DFES_OneToOne 0.00 255.0 FORMAT "%5.1" /end CHARACTERISTIC
/begin CHARACTERISTIC DFES_FaultTyp.DFC_BattUHiFailr_C "assigned fault type / Fault type assignment for check DFC_BattUHiFailr" VALUE 0x804F9B4E Val_Wu8 255.0 DFES_OneToOne 0.00 255.0 FORMAT "%5.1" /end CHARACTERISTIC
/begin CHARACTERISTIC DFES_FaultTyp.DFC_BattULoFailr_C "assigned fault type / Fault type assignment for check DFC_BattULoFailr" VALUE 0x804F9B4F Val_Wu8 255.0 DFES_OneToOne 0.00 255.0 FORMAT "%5.1" /end CHARACTERISTIC
/begin CHARACTERISTIC DFES_FaultTyp.DFC_BrkBstPDriftHiErr_C "assigned fault type / Fault type assignment for check DFC_BrkBstPDriftHiErr" VALUE 0x804F9B50 Val_Wu8 255.0 DFES_OneToOne 0.00 255.0 FORMAT "%5.1" /end CHARACTERISTIC
/begin CHARACTERISTIC DFES_FaultTyp.DFC_BrkBstPDriftLoErr_C "assigned fault type / Fault type assignment for check DFC_BrkBstPDriftLoErr" VALUE 0x804F9B51 Val_Wu8 255.0 DFES_OneToOne 0.00 255.0 FORMAT "%5.1" /end CHARACTERISTIC
/begin CHARACTERISTIC DFES_FaultTyp.DFC_BrkBstPSnsrStuck_C "assigned fault type / Fault type assignment for check DFC_BrkBstPSnsrStuck" VALUE 0x804F9B52 Val_Wu8 255.0 DFES_OneToOne 0.00 255.0 FORMAT "%5.1" /end CHARACTERISTIC
/begin CHARACTERISTIC DFES_FaultTyp.DFC_BrkMnSwtContOn_C "assigned fault type / Fault type assignment for check DFC_BrkMnSwtContOn" VALUE 0x804F9B53 Val_Wu8 255.0 DFES_OneToOne 0.00 255.0 FORMAT "%5.1" /end CHARACTERISTIC
/begin CHARACTERISTIC DFES_FaultTyp.DFC_BrkMnSwtNotStp_C "assigned fault type / Fault type assignment for check DFC_BrkMnSwtNotStp" VALUE 0x804F9B54 Val_Wu8 255.0 DFES_OneToOne 0.00 255.0 FORMAT "%5.1" /end CHARACTERISTIC
/begin CHARACTERISTIC DFES_FaultTyp.DFC_BrkNpl_C "assigned fault type / Fault type assignment for check DFC_BrkNpl" VALUE 0x804F9B55 Val_Wu8 255.0 DFES_OneToOne 0.00 255.0 FORMAT "%5.1" /end CHARACTERISTIC
/begin CHARACTERISTIC DFES_FaultTyp.DFC_BrkRdntSwtContOn_C "assigned fault type / Fault type assignment for check DFC_BrkRdntSwtContOn" VALUE 0x804F9B56 Val_Wu8 255.0 DFES_OneToOne 0.00 255.0 FORMAT "%5.1" /end CHARACTERISTIC
/begin CHARACTERISTIC DFES_FaultTyp.DFC_BrkRdntSwtNotStp_C "assigned fault type / Fault type assignment for check DFC_BrkRdntSwtNotStp" VALUE 0x804F9B57 Val_Wu8 255.0 DFES_OneToOne 0.00 255.0 FORMAT "%5.1" /end CHARACTERISTIC
/begin CHARACTERISTIC DFES_FaultTyp.DFC_Clth3ONStuck_C "assigned fault type / Fault type assignment for check DFC_Clth3ONStuck" VALUE 0x804F9B58 Val_Wu8 255.0 DFES_OneToOne 0.00 255.0 FORMAT "%5.1" /end CHARACTERISTIC
/begin CHARACTERISTIC DFES_FaultTyp.DFC_Clth4OFFStuck_C "assigned fault type / Fault type assignment for check DFC_Clth4OFFStuck" VALUE 0x804F9B59 Val_Wu8 255.0 DFES_OneToOne 0.00 255.0 FORMAT "%5.1" /end CHARACTERISTIC
/begin CHARACTERISTIC DFES_FaultTyp.DFC_ClthOFFStuck_C "assigned fault type / Fault type assignment for check DFC_ClthOFFStuck" VALUE 0x804F9B5A Val_Wu8 255.0 DFES_OneToOne 0.00 255.0 FORMAT "%5.1" /end CHARACTERISTIC
/begin CHARACTERISTIC DFES_FaultTyp.DFC_ClthONStuck_C "assigned fault type / Fault type assignment for check DFC_ClthONStuck" VALUE 0x804F9B5B Val_Wu8 255.0 DFES_OneToOne 0.00 255.0 FORMAT "%5.1" /end CHARACTERISTIC
/begin CHARACTERISTIC DFES_FaultTyp.DFC_ClthStkFailInfo_C "assigned fault type / Fault type assignment for check DFC_ClthStkFailInfo" VALUE 0x804F9B5C Val_Wu8 255.0 DFES_OneToOne 0.00 255.0 FORMAT "%5.1" /end CHARACTERISTIC
/begin CHARACTERISTIC DFES_FaultTyp.DFC_ComACFailInfo_C "assigned fault type / Fault type assignment for check DFC_ComACFailInfo" VALUE 0x804F9B5D Val_Wu8 255.0 DFES_OneToOne 0.00 255.0 FORMAT "%5.1" /end CHARACTERISTIC
/begin CHARACTERISTIC DFES_FaultTyp.DFC_ComATFTValErr_C "assigned fault type / Fault type assignment for check DFC_ComATFTValErr" VALUE 0x804F9B5E Val_Wu8 255.0 DFES_OneToOne 0.00 255.0 FORMAT "%5.1" /end CHARACTERISTIC
/begin CHARACTERISTIC DFES_FaultTyp.DFC_ComATMILReq_C "assigned fault type / Fault type assignment for check DFC_ComATMILReq" VALUE 0x804F9B5F Val_Wu8 255.0 DFES_OneToOne 0.00 255.0 FORMAT "%5.1" /end CHARACTERISTIC
/begin CHARACTERISTIC DFES_FaultTyp.DFC_ComAYCAChksum_C "assigned fault type / Fault type assignment for check DFC_ComAYCAChksum" VALUE 0x804F9B60 Val_Wu8 255.0 DFES_OneToOne 0.00 255.0 FORMAT "%5.1" /end CHARACTERISTIC
/begin CHARACTERISTIC DFES_FaultTyp.DFC_ComAYCARingCnt_C "assigned fault type / Fault type assignment for check DFC_ComAYCARingCnt" VALUE 0x804F9B61 Val_Wu8 255.0 DFES_OneToOne 0.00 255.0 FORMAT "%5.1" /end CHARACTERISTIC
/begin CHARACTERISTIC DFES_FaultTyp.DFC_ComAYCATOut_C "assigned fault type / Fault type assignment for check DFC_ComAYCATOut" VALUE 0x804F9B62 Val_Wu8 255.0 DFES_OneToOne 0.00 255.0 FORMAT "%5.1" /end CHARACTERISTIC
/begin FUNCTION DFES "30000.73.0_2.0.0Diagnostic Fault Event Storage"
 /begin DEF_CHARACTERISTIC DFES_EnvRef.DFC_ComEAT8TOut_C DFES_EnvRef.DFC_ComEATAChksum_C DFES_EnvRef.DFC_ComEATARingCnt_C DFES_EnvRef.DFC_ComEATATOut_C DFES_EnvRef.DFC_ComEATBChkSum_C DFES_EnvRef.DFC_ComEATBRingCnt_C DFES_EnvRef.DFC_ComEATBTOut_C DFES_EnvRef.DFC_ComEATCChksum_C DFES_EnvRef.DFC_ComEATCRingCnt_C DFES_EnvRef.DFC_ComEATCTOut_C DFES_EnvRef.DFC_ComEBBAChksum_C DFES_EnvRef.DFC_ComEBBARingCnt_C DFES_EnvRef.DFC_ComEBBATOut_C DFES_EnvRef.DFC_ComEPS1Chksum_C DFES_EnvRef.DFC_ComEPS1RingCnt_C DFES_EnvRef.DFC_ComEPS1TOut_C DFES_EnvRef.DFC_ComEngCanRxErr_C DFES_EnvRef.DFC_ComGrvySnsrErr_C DFES_EnvRef.DFC_ComGwIMG1ChkSum_C DFES_EnvRef.DFC_ComGwIMG1RingCnt_C DFES_EnvRef.DFC_ComGwIMG1TOut_C DFES_EnvRef.DFC_ComGwIMG3ChkSum_C DFES_EnvRef.DFC_ComGwIMG3RingCnt_C DFES_EnvRef.DFC_ComGwIMG3TOut_C DFES_EnvRef.DFC_ComGwIMG4ChkSum_C DFES_EnvRef.DFC_ComGwIMG4RingCnt_C DFES_EnvRef.DFC_ComGwIMG4TOut_C DFES_EnvRef.DFC_ComGwIMG5ChkSum_C DFES_EnvRef.DFC_ComGwIMG5RingCnt_C DFES_EnvRef.DFC_ComGwIMG5TOut_C DFES_EnvRef.DFC_ComGwIMG6ChkSum_C DFES_EnvRef.DFC_ComGwIMG6RingCnt_C DFES_EnvRef.DFC_ComGwIMG6TOut_C DFES_EnvRef.DFC_ComIDASBChksum_C DFES_EnvRef.DFC_ComIDASBRingCnt_C DFES_EnvRef.DFC_ComIDASBTOut_C DFES_EnvRef.DFC_ComIMGMILReq_C DFES_EnvRef.DFC_ComISSPrms_C DFES_EnvRef.DFC_ComMETAChksum_C DFES_EnvRef.DFC_ComMETARingCnt_C DFES_EnvRef.DFC_ComMETATOut_C DFES_EnvRef.DFC_ComMETCChksum_C DFES_EnvRef.DFC_ComMETCRingCnt_C DFES_EnvRef.DFC_ComMETCTOut_C DFES_EnvRef.DFC_ComMETDChksum_C DFES_EnvRef.DFC_ComMETDRingCnt_C DFES_EnvRef.DFC_ComMETDTOut_C DFES_EnvRef.DFC_ComMETE2Chksum_C DFES_EnvRef.DFC_ComMETE2RingCnt_C DFES_EnvRef.DFC_ComMETE2TOut_C DFES_EnvRef.DFC_ComMETFChksum_C DFES_EnvRef.DFC_ComMETFRingCnt_C DFES_EnvRef.DFC_ComMETFTOut_C DFES_EnvRef.DFC_ComMETGChksum_C DFES_EnvRef.DFC_ComMETGRingCnt_C DFES_EnvRef.DFC_ComMETGTOut_C DFES_EnvRef.DFC_ComMETH2Chksum_C DFES_EnvRef.DFC_ComMETH2RingCnt_C DFES_EnvRef.DFC_ComMETH2TOut_C DFES_EnvRef.DFC_ComMETHChksum_C DFES_EnvRef.DFC_ComMETHRingCnt_C DFES_EnvRef.DFC_ComMETHTOut_C DFES_EnvRef.DFC_ComMETIChksum_C DFES_EnvRef.DFC_ComMETIRingCnt_C DFES_EnvRef.DFC_ComMETITOut_C DFES_EnvRef.DFC_ComMETKChksum_C DFES_EnvRef.DFC_ComMETKRingCnt_C DFES_EnvRef.DFC_ComMETKTOut_C DFES_EnvRef.DFC_ComMETLChksum_C DFES_EnvRef.DFC_ComMETLRingCnt_C DFES_EnvRef.DFC_ComMETLTOut_C DFES_EnvRef.DFC_ComMETMChksum_C DFES_EnvRef.DFC_ComMETMRingCnt_C DFES_EnvRef.DFC_ComMETMTOut_C DFES_EnvRef.DFC_ComMETNChksum_C DFES_EnvRef.DFC_ComMETNRingCnt_C DFES_EnvRef.DFC_ComMETNTOut_C DFES_EnvRef.DFC_ComMtrCom_C DFES_EnvRef.DFC_ComPCUChkSum_C DFES_EnvRef.DFC_ComPCURingCnt_C DFES_EnvRef.DFC_ComPCUTOut_C DFES_EnvRef.DFC_ComSRSAChksum_C DFES_EnvRef.DFC_ComSRSARingCnt_C DFES_EnvRef.DFC_ComSRSATOut_C DFES_EnvRef.DFC_ComSRSBChksum_C DFES_EnvRef.DFC_ComSRSBRingCnt_C DFES_EnvRef.DFC_ComSRSBTOut_C DFES_EnvRef.DFC_ComSRSChksum_C DFES_EnvRef.DFC_ComSRSErr_C DFES_EnvRef.DFC_ComSRSRingCnt_C DFES_EnvRef.DFC_ComSRSTOut_C DFES_EnvRef.DFC_ComVehSpdPndFltTCU_C DFES_EnvRef.DFC_EbsChartcCurrErr_C DFES_EnvRef.DFC_EbsSelfDiagErr_C DFES_EnvRef.DFC_GbxCANDigPlausErr_C DFES_EnvRef.DFC_GbxNPos1SRCMax_C DFES_EnvRef.DFC_GbxNPos1SRCMin_C DFES_EnvRef.DFC_GbxNPos2SRCMax_C DFES_EnvRef.DFC_GbxNPos2SRCMin_C DFES_EnvRef.DFC_GbxNPosAlvChk_C DFES_EnvRef.DFC_GbxNPosSyncErr_C DFES_EnvRef.DFC_HEGOS2B1HtrPsMax_C DFES_EnvRef.DFC_HEGOS2B1HtrPsMin_C DFES_EnvRef.DFC_HEGOS2B1HtrPsSig_C DFES_EnvRef.DFC_LinCSErrACG_C DFES_EnvRef.DFC_LinCSErrEBS_C DFES_EnvRef.DFC_LinHdrTimeoutErrACG_C DFES_EnvRef.DFC_LinHdrTimeoutErrEBS_C DFES_EnvRef.DFC_LinMsgTimeoutErrACG_C DFES_EnvRef.DFC_LinMsgTimeoutErrEBS_C DFES_EnvRef.DFC_LinNoStrtComErr_C DFES_EnvRef.DFC_MisfDetVWhlFrntLeOORHi_C DFES_EnvRef.DFC_MisfDetVWhlFrntLeRatyHi_C DFES_EnvRef.DFC_MisfDetVWhlFrntLeRatyLo_C DFES_EnvRef.DFC_MisfDetVWhlFrntLeStuck_C DFES_EnvRef.DFC_MisfDetVWhlFrntRiOORHi_C DFES_EnvRef.DFC_MisfDetVWhlFrntRiRatyHi_C DFES_EnvRef.DFC_MisfDetVWhlFrntRiRatyLo_C DFES_EnvRef.DFC_MisfDetVWhlFrntRiStuck_C DFES_EnvRef.DFC_MisfDetVWhlReLeOORHi_C DFES_EnvRef.DFC_MisfDetVWhlReLeRatyHi_C DFES_EnvRef.DFC_MisfDetVWhlReLeRatyLo_C DFES_EnvRef.DFC_MisfDetVWhlReLeStuck_C DFES_EnvRef.DFC_MisfDetVWhlReRiOORHi_C DFES_EnvRef.DFC_MisfDetVWhlReRiRatyHi_C DFES_EnvRef.DFC_MisfDetVWhlReRiRatyLo_C DFES_EnvRef.DFC_MisfDetVWhlReRiStuck_C DFES_EnvRef.DFC_MisfDetdVWhlFrntLePlaus_C DFES_EnvRef.DFC_MisfDetdVWhlFrntRiPlaus_C DFES_EnvRef.DFC_MisfDetdVWhlReLePlaus_C DFES_EnvRef.DFC_MisfDetdVWhlReRiPlaus_C DFES_EnvRef.DFC_PEnvSigRngMax_C DFES_EnvRef.DFC_PEnvSigRngMin_C DFES_EnvRef.DFC_StmFault_C DFES_EnvRef.DFC_StrtCtOffPth_C DFES_EnvRef.DFC_StrtCtlErr_C DFES_EnvRef.DFC_StrtFault_C DFES_EnvRef.DFC_StrtLckJudg1_C DFES_EnvRef.DFC_StrtLckJudg2_C DFES_EnvRef.DFC_StrtOL_C DFES_EnvRef.DFC_StrtOL2_C DFES_EnvRef.DFC_StrtSCB_C DFES_EnvRef.DFC_StrtSCB2_C DFES_EnvRef.DFC_StrtSCG_C DFES_EnvRef.DFC_StrtSCG2_C DFES_EnvRef.DFC_StrtStkRly1_C DFES_EnvRef.DFC_StrtStkRly2_C DFES_EnvRef.DFC_TEVEmax_C DFES_EnvRef.DFC_TEVEmin_C DFES_EnvRef.DFC_TEVEsig_C DFES_EnvRef.DFC_VehVAllPlaus_C DFES_EnvRef.DFC_VehVNCSnsrElecFailr_C DFES_EnvRef.DFC_VehVPlausCan_C DFES_EnvRef.DFC_VehVPlausFco_C DFES_EnvRef.DFC_VehVPlausPwr_C DFES_EnvRef.DFC_VehVPlausV2N_C DFES_EnvRef.DFC_VehVSpdSnsrAElecFailr_C DFES_EnvRef.DFC_VehVSpdSnsrBElecFailr_C DFES_EnvRef.DFC_ClthMax_C DFES_EnvRef.DFC_IgnClPs_DevComErr_C DFES_EnvRef.DFC_IgnClPs_LineOl_0_C DFES_EnvRef.DFC_IgnClPs_LineOl_1_C DFES_EnvRef.DFC_IgnClPs_LineOl_2_C DFES_EnvRef.DFC_IgnClPs_LineOl_3_C DFES_EnvRef.DFC_IgnClPs_LineScb_0_C DFES_EnvRef.DFC_IgnClPs_LineScb_1_C DFES_EnvRef.DFC_IgnClPs_LineScb_2_C DFES_EnvRef.DFC_IgnClPs_LineScb_3_C DFES_EnvRef.DFC_IgnClPs_LineScg_0_C DFES_EnvRef.DFC_IgnClPs_LineScg_1_C DFES_EnvRef.DFC_IgnClPs_LineScg_2_C DFES_EnvRef.DFC_IgnClPs_LineScg_3_C DFES_EnvRef.DFC_UEGOASICS1B1_C DFES_EnvRef.DFC_UEGOOLIPES1B1_C DFES_EnvRef.DFC_UEGOOLRES1B1_C DFES_EnvRef.DFC_UEGOSCBS1B1_C DFES_EnvRef.DFC_UEGOSCGS1B1_C DFES_EnvRef.DFC_UEGOSPIS1B1_C DFES_EnvRef.DFC_UEGOSnsrS1B1_C DFES_EnvRef.DFC_UegoOlApesS1B1_C DFES_EnvRef.DFC_UegoOlRCmpS1B1_C DFES_EnvRef.DFC_AirCCmprOL_C DFES_EnvRef.DFC_AirCCmprOvrTemp_C DFES_EnvRef.DFC_AirCCmprSCB_C DFES_EnvRef.DFC_AirCCmprSCG_C DFES_EnvRef.DFC_AltErr_C DFES_EnvRef.DFC_BattUSRCMax_C DFES_EnvRef.DFC_BattUSRCMin_C DFES_EnvRef.DFC_ComChksTCU1_C DFES_EnvRef.DFC_ComChksTCU11_C DFES_EnvRef.DFC_ComChksTCU12_C DFES_EnvRef.DFC_ComChksTCU13_C DFES_EnvRef.DFC_ComChksTCU2_C DFES_EnvRef.DFC_ComChksTCU3_C DFES_EnvRef.DFC_ComChksTCU4_C DFES_EnvRef.DFC_ComCntTCU1_C DFES_EnvRef.DFC_ComCntTCU11_C DFES_EnvRef.DFC_ComCntTCU12_C DFES_EnvRef.DFC_ComCntTCU13_C DFES_EnvRef.DFC_ComCntTCU2_C DFES_EnvRef.DFC_ComCntTCU3_C DFES_EnvRef.DFC_ComCntTCU4_C DFES_EnvRef.DFC_ComTOutTCU01_C DFES_EnvRef.DFC_ComTOutTCU02_C DFES_EnvRef.DFC_ComTOutTCU1_C DFES_EnvRef.DFC_ComTOutTCU11_C DFES_EnvRef.DFC_ComTOutTCU12_C DFES_EnvRef.DFC_ComTOutTCU13_C DFES_EnvRef.DFC_ComTOutTCU14_C DFES_EnvRef.DFC_ComTOutTCU2_C DFES_EnvRef.DFC_ComTOutTCU3_C DFES_EnvRef.DFC_ComTOutTCU4_C DFES_EnvRef.DFC_DevLibBattUHi_C DFES_EnvRef.DFC_DevLibBattULo_C DFES_EnvRef.DFC_FanDIOOL_0_C DFES_EnvRef.DFC_FanDIOOL_1_C DFES_EnvRef.DFC_FanDIOOvrTemp_0_C DFES_EnvRef.DFC_FanDIOOvrTemp_1_C DFES_EnvRef.DFC_FanDIOSCB_0_C DFES_EnvRef.DFC_FanDIOSCB_1_C DFES_EnvRef.DFC_FanDIOSCG_0_C DFES_EnvRef.DFC_FanDIOSCG_1_C DFES_EnvRef.DFC_MRlyDcOL_C DFES_EnvRef.DFC_MRlyDcSCB_C DFES_EnvRef.DFC_MRlyDcSCG_C DFES_EnvRef.DFC_PSPOL_C DFES_EnvRef.DFC_PSPOvrTemp_C DFES_EnvRef.DFC_PSPSCB_C DFES_EnvRef.DFC_PSPSCG_C DFES_EnvRef.DFC_T50Err_C DFES_EnvRef.DFC_ThrVlvLoBattB1_C DFES_EnvRef.DFC_VehVPhysRngHi_C DFES_EnvRef.DFC_VehVSclOutOL_C DFES_EnvRef.DFC_VehVSclOutOT_C DFES_EnvRef.DFC_VehVSclOutSCB_C DFES_EnvRef.DFC_VehVSclOutSCG_C DFES_EnvRef.DFC_VehVSnsrARngHi_C DFES_EnvRef.DFC_VehVSnsrBRngHi_C DFES_EnvRef.DFC_VehVSpdRtyDiag_C DFES_EnvRef.DFC_VehVWhlErr_C DFES_EnvRef.DFC_ACEvpTSRCMax_C DFES_EnvRef.DFC_ACEvpTSRCMin_C DFES_EnvRef.DFC_AirCClntPAnaSRCMax_C DFES_EnvRef.DFC_AirCClntPAnaSRCMin_C DFES_EnvRef.DFC_AirCSwtNpl_C DFES_EnvRef.DFC_AirCSwtSig_C DFES_EnvRef.DFC_Brk_C DFES_EnvRef.DFC_BrkSig_C DFES_EnvRef.DFC_ClthSig_C DFES_EnvRef.DFC_HLSDemOvhtEngLim_C DFES_EnvRef.DFC_OilPNpl_C DFES_EnvRef.DFC_PIntkVUsLineHiB1_C DFES_EnvRef.DFC_PIntkVUsLineLoB1_C DFES_EnvRef.DFC_VehVPhysRngLo_C DFES_EnvRef.DFC_VehVSigCan_C DFES_EnvRef.DFC_VehVSigCanSafe_C DFES_EnvRef.DFC_VlvLftFbOilPSnsrIntk11SRCMax_C DFES_EnvRef.DFC_VlvLftFbOilPSnsrIntk11SRCMin_C DFES_EnvRef.DFC_ClthNpl_C DFES_EnvRef.DFC_EV1max_C DFES_EnvRef.DFC_EV1min_C DFES_EnvRef.DFC_EV1sig_C DFES_EnvRef.DFC_EV2max_C DFES_EnvRef.DFC_EV2min_C DFES_EnvRef.DFC_EV2sig_C DFES_EnvRef.DFC_EV3max_C DFES_EnvRef.DFC_EV3min_C DFES_EnvRef.DFC_EV3sig_C DFES_EnvRef.DFC_EV4max_C DFES_EnvRef.DFC_EV4min_C DFES_EnvRef.DFC_EV4sig_C DFES_EnvRef.DFC_GbxPNPosnDrvCdn_C DFES_EnvRef.DFC_GbxPNPosnPlausy_C DFES_EnvRef.DFC_PEnvCcMax_C DFES_EnvRef.DFC_PEnvCcMin_C DFES_EnvRef.DFC_PEnvRngChkMax_C DFES_EnvRef.DFC_PEnvRngChkMin_C DFES_EnvRef.DFC_PEnvSnsrPlaus_C DFES_EnvRef.DFC_UEGOHeatrPsS1B1Max_C DFES_EnvRef.DFC_UEGOHeatrPsS1B1Min_C DFES_EnvRef.DFC_UEGOHeatrPsS1B1Sig_C DFES_EnvRef.DFC_UEGOHeatrRlyPsOLS1B1_C DFES_EnvRef.DFC_UEGOHeatrRlyPsSCBS1B1_C DFES_EnvRef.DFC_UEGOHeatrRlyPsSCGS1B1_C DFES_EnvRef.DFC_KnDetSens1PortAMax_C DFES_EnvRef.DFC_KnDetSens1PortAMin_C DFES_EnvRef.DFC_KnDetSens1PortBMax_C DFES_EnvRef.DFC_KnDetSens1PortBMin_C DFES_EnvRef.DFC_Clth2ONStuck_C DFES_EnvRef.DFC_Clth2ONStuckLdc_C DFES_EnvRef.DFC_Clth3ONStuckLdc_C DFES_EnvRef.DFC_Clth3ONStuckPostDrv_C DFES_EnvRef.DFC_Clth4ONStuck_C DFES_EnvRef.DFC_Clth4ONStuckLdc_C DFES_EnvRef.DFC_ComDLCTCU01_C DFES_EnvRef.DFC_ComDLCTCU02_C DFES_EnvRef.DFC_ComDLCTCU1_C DFES_EnvRef.DFC_ComDLCTCU11_C DFES_EnvRef.DFC_ComDLCTCU12_C DFES_EnvRef.DFC_ComDLCTCU13_C DFES_EnvRef.DFC_ComDLCTCU14_C DFES_EnvRef.DFC_ComDLCTCU2_C DFES_EnvRef.DFC_ComDLCTCU3_C DFES_EnvRef.DFC_ComDLCTCU4_C DFES_EnvRef.DFC_EVX_C DFES_EnvRef.DFC_EbsSocFlt_C DFES_EnvRef.DFC_I14229VINErr_C DFES_EnvRef.DFC_LLRKHmax_C DFES_EnvRef.DFC_LLRKHmin_C DFES_EnvRef.DFC_LLRmax_C DFES_EnvRef.DFC_LLRmin_C DFES_EnvRef.DFC_RoughRoad_C DFES_EnvRef.DFC_SiaEEPRdErr_C DFES_EnvRef.DFC_SiaEEPWrngCod_C DFES_EnvRef.DFC_UegoDummy_C DFES_EnvRef.DFC_BusDiagCANAPPLBusOff_C DFES_EnvRef.DFC_BusDiagCANCANCBusOff_C DFES_EnvRef.DFC_BusDiagCANVEHICLEBusOff_C DFES_EnvRef.DFC_RBA_IODIAGPWR_rba_IoExtCy329_SignalVltSply_0_C DFES_EnvRef.DFC_RBA_IODIAGPWR_rba_IoExtCy329_SignalVltSply_0OT_C DFES_EnvRef.DFC_RBA_IODIAGPWR_rba_IoExtCy329_SignalVltSply_0OV_C DFES_EnvRef.DFC_RBA_IODIAGPWR_rba_IoExtCy329_SignalVltSply_0SCG_C DFES_EnvRef.DFC_RBA_IODIAGPWR_rba_IoExtCy329_SignalVltSply_0UV_C DFES_EnvRef.DFC_RBA_IODIAGPWR_rba_IoExtCy329_SignalVltSply_1_C DFES_EnvRef.DFC_RBA_IODIAGPWR_rba_IoExtCy329_SignalVltSply_1OT_C DFES_EnvRef.DFC_RBA_IODIAGPWR_rba_IoExtCy329_SignalVltSply_1OV_C DFES_EnvRef.DFC_RBA_IODIAGPWR_rba_IoExtCy329_SignalVltSply_1SCG_C DFES_EnvRef.DFC_RBA_IODIAGPWR_rba_IoExtCy329_SignalVltSply_1UV_C DFES_EnvRef.DFC_RBA_IODIAGPWR_rba_IoExtCy329_SignalVltSply_2_C DFES_EnvRef.DFC_RBA_IODIAGPWR_rba_IoExtCy329_SignalVltSply_2OT_C DFES_EnvRef.DFC_RBA_IODIAGPWR_rba_IoExtCy329_SignalVltSply_2OV_C DFES_EnvRef.DFC_RBA_IODIAGPWR_rba_IoExtCy329_SignalVltSply_2SCG_C DFES_EnvRef.DFC_RBA_IODIAGPWR_rba_IoExtCy329_SignalVltSply_2UV_C DFES_EnvRef.DFC_CAN_E_TIMEOUT_C DFES_EnvRef.DFC_LIN_E_TIMEOUT_C DFES_EnvRef.DFC_MRlyOL_C DFES_EnvRef.DFC_MRlySCB_C DFES_EnvRef.DFC_MRlySCG_C DFES_EnvRef.DFC_rba_MultiStackTrace_Threshold_C DFES_EnvRef.DFC_BSWM_E_ACTION_FAILED_C DFES_EnvRef.DFC_BSWM_E_INTRPTQUEUE_FULL_C DFES_EnvRef.DFC_RBA_IOEXTLIB_KEEPALIVE_DRV_C DFES_EnvRef.DFC_RBA_IOEXTLIB_KEEPALIVE_INI_C DFES_EnvRef.DFC_rba_IoSigRtc_StopCounter_C DFES_EnvRef.DFC_rba_MRly_Diag_Stk_Event_C DFES_EnvRef.DFC_rba_MemDiag_MemReadErr_C DFES_EnvRef.DFC_rba_MemDiag_MemWrErr_C DFES_EnvRef.DFC_rba_SyC_IrrSwOffTrigEngRun_Event_C DFES_EnvRef.DFC_rba_T15_Diag_ComInVld_Event_C DFES_EnvRef.DFC_rba_T15_Diag_ComOff_HwOn_Event_C DFES_EnvRef.DFC_rba_T15_Diag_ComOn_HwOff_Event_C DFES_EnvRef.DFC_AppAllSnsrDfct_C DFES_EnvRef.DFC_BattUStdbyDiaOL_C DFES_EnvRef.DFC_BigLeakIntkMnfldEmiInfl_C DFES_EnvRef.DFC_BrkMnSwtContOnWarnLmp_C DFES_EnvRef.DFC_BrkMnSwtNotStpWarnLmp_C DFES_EnvRef.DFC_BrkRdntSwtContOnWarnLmp_C DFES_EnvRef.DFC_BrkRdntSwtNotStpWarnLmp_C DFES_EnvRef.DFC_CEngDsTColdStrtMax_C DFES_EnvRef.DFC_CEngDsTColdStrtMin_C DFES_EnvRef.DFC_CEngDsTImps_C DFES_EnvRef.DFC_CEngDsTPlausLSC_C DFES_EnvRef.DFC_CEngDsTPlausSTC_C DFES_EnvRef.DFC_CEngDsTSRCMax_C DFES_EnvRef.DFC_CEngDsTSRCMin_C DFES_EnvRef.DFC_CEngDsTSig_C DFES_EnvRef.DFC_CEngUsTSRCMax_C DFES_EnvRef.DFC_CEngUsTSRCMin_C DFES_EnvRef.DFC_DCDCFltDet_C DFES_EnvRef.DFC_DKRSA_C DFES_EnvRef.DFC_DKVSmax_C DFES_EnvRef.DFC_DKnpl_C DFES_EnvRef.DFC_DSSmax_C DFES_EnvRef.DFC_DSTTI_C DFES_EnvRef.DFC_DSUmax_C DFES_EnvRef.DFC_EGRVlvOL_C DFES_EnvRef.DFC_EGRVlvSCB_C DFES_EnvRef.DFC_EGRVlvSCG_C DFES_EnvRef.DFC_EGSDUS2B1LtrDly_C DFES_EnvRef.DFC_EGSDUS2B1LtrPT1_C DFES_EnvRef.DFC_EGSDUS2B1RtlDly_C DFES_EnvRef.DFC_EGSDUS2B1RtlPT1_C DFES_EnvRef.DFC_EGSDUS2B1TarLean_C DFES_EnvRef.DFC_EGSDUS2B1TarRich_C DFES_EnvRef.DFC_ETAKHLmax_C DFES_EnvRef.DFC_ETAKHTmax_C DFES_EnvRef.DFC_EngICO_C DFES_EnvRef.DFC_EngPrtOvrSpdMon_C DFES_EnvRef.DFC_EpmCaSI1ErrSig_C DFES_EnvRef.DFC_EpmCaSI1NoSig_C DFES_EnvRef.DFC_EpmCaSI1OfsErr_C DFES_EnvRef.DFC_EpmCrSErrSig_C DFES_EnvRef.DFC_EpmCrSNoSig_C DFES_EnvRef.DFC_EtaEngIdleNonCsers_C DFES_EnvRef.DFC_EtaEngPtlNonCsers_C DFES_EnvRef.DFC_FRAmax_C DFES_EnvRef.DFC_FRAmin_C DFES_EnvRef.DFC_GbxRvsSwtStk_C DFES_EnvRef.DFC_HDRmax_C DFES_EnvRef.DFC_HEGOS2B1ElecMax_C DFES_EnvRef.DFC_HEGOS2B1ElecMin_C DFES_EnvRef.DFC_HEGOS2B1ElecSig_C DFES_EnvRef.DFC_HEGOS2B1HtgNpl_C DFES_EnvRef.DFC_IntkAirTIntkMnfldCrssMax_C DFES_EnvRef.DFC_IntkAirTIntkMnfldCrssMin_C DFES_EnvRef.DFC_IntkAirTIntkMnfldHSCMax_C DFES_EnvRef.DFC_IntkAirTIntkMnfldImps_C DFES_EnvRef.DFC_IntkAirTIntkMnfldPRCMax_C DFES_EnvRef.DFC_IntkAirTIntkMnfldPRCMin_C DFES_EnvRef.DFC_IntkAirTIntkMnfldSRCMax_C DFES_EnvRef.DFC_IntkAirTIntkMnfldSRCMin_C DFES_EnvRef.DFC_IntkAirTIntkMnfldSTC_C DFES_EnvRef.DFC_KS1max_C DFES_EnvRef.DFC_KS1min_C DFES_EnvRef.DFC_LMmax_C DFES_EnvRef.DFC_LZSRnpl_C DFES_EnvRef.DFC_LamDynDiagS1B1_C DFES_EnvRef.DFC_LeakIntkMnfldEmiInfl_C DFES_EnvRef.DFC_MD00max_C DFES_EnvRef.DFC_MDBmax_C DFES_EnvRef.DFC_MDCat_C DFES_EnvRef.DFC_MDCatCrit_C DFES_EnvRef.DFC_MDCatCurr_C DFES_EnvRef.DFC_MDCyl_0_C DFES_EnvRef.DFC_MDCyl_1_C DFES_EnvRef.DFC_MDCyl_2_C DFES_EnvRef.DFC_MDCyl_3_C DFES_EnvRef.DFC_MDEmi_C DFES_EnvRef.DFC_MDEmiStrt_C DFES_EnvRef.DFC_MDFco_C DFES_EnvRef.DFC_MDMpl_C DFES_EnvRef.DFC_MDSegTiAdpn_C DFES_EnvRef.DFC_MDmax_C DFES_EnvRef.DFC_MOXEMM_SMU_ALM0_0_C DFES_EnvRef.DFC_MOXEMM_SMU_ALM0_1_C DFES_EnvRef.DFC_MOXEMM_SMU_ALM0_10_C DFES_EnvRef.DFC_MOXEMM_SMU_ALM0_11_C DFES_EnvRef.DFC_MOXEMM_SMU_ALM0_13_C DFES_EnvRef.DFC_MOXEMM_SMU_ALM0_14_C DFES_EnvRef.DFC_MOXEMM_SMU_ALM0_2_C DFES_EnvRef.DFC_MOXEMM_SMU_ALM0_22_C DFES_EnvRef.DFC_MOXEMM_SMU_ALM0_23_C DFES_EnvRef.DFC_MOXEMM_SMU_ALM0_4_C DFES_EnvRef.DFC_MOXEMM_SMU_ALM0_5_C DFES_EnvRef.DFC_MOXEMM_SMU_ALM0_7_C DFES_EnvRef.DFC_MOXEMM_SMU_ALM0_8_C DFES_EnvRef.DFC_MOXEMM_SMU_ALM10_16_C DFES_EnvRef.DFC_MOXEMM_SMU_ALM10_17_C DFES_EnvRef.DFC_MOXEMM_SMU_ALM10_21_C DFES_EnvRef.DFC_MOXEMM_SMU_ALM11_0_C DFES_EnvRef.DFC_MOXEMM_SMU_ALM11_1_C DFES_EnvRef.DFC_MOXEMM_SMU_ALM11_2_C DFES_EnvRef.DFC_MOXEMM_SMU_ALM11_3_C DFES_EnvRef.DFC_MOXEMM_SMU_ALM11_4_C DFES_EnvRef.DFC_MOXEMM_SMU_ALM11_5_C DFES_EnvRef.DFC_MOXEMM_SMU_ALM11_8_C DFES_EnvRef.DFC_MOXEMM_SMU_ALM11_9_C DFES_EnvRef.DFC_MOXEMM_SMU_ALM1_0_C DFES_EnvRef.DFC_MOXEMM_SMU_ALM1_1_C DFES_EnvRef.DFC_MOXEMM_SMU_ALM1_10_C DFES_EnvRef.DFC_MOXEMM_SMU_ALM1_11_C DFES_EnvRef.DFC_MOXEMM_SMU_ALM1_13_C DFES_EnvRef.DFC_MOXEMM_SMU_ALM1_14_C DFES_EnvRef.DFC_MOXEMM_SMU_ALM1_2_C DFES_EnvRef.DFC_MOXEMM_SMU_ALM1_22_C DFES_EnvRef.DFC_MOXEMM_SMU_ALM1_23_C DFES_EnvRef.DFC_MOXEMM_SMU_ALM1_4_C DFES_EnvRef.DFC_MOXEMM_SMU_ALM1_5_C DFES_EnvRef.DFC_MOXEMM_SMU_ALM1_7_C DFES_EnvRef.DFC_MOXEMM_SMU_ALM1_8_C DFES_EnvRef.DFC_MOXEMM_SMU_ALM21_0_C DFES_EnvRef.DFC_MOXEMM_SMU_ALM21_16_C DFES_EnvRef.DFC_MOXEMM_SMU_ALM21_3_C DFES_EnvRef.DFC_MOXEMM_SMU_ALM2_1_C DFES_EnvRef.DFC_MOXEMM_SMU_ALM2_10_C DFES_EnvRef.DFC_MOXEMM_SMU_ALM2_11_C DFES_EnvRef.DFC_MOXEMM_SMU_ALM2_13_C DFES_EnvRef.DFC_MOXEMM_SMU_ALM2_14_C DFES_EnvRef.DFC_MOXEMM_SMU_ALM2_22_C DFES_EnvRef.DFC_MOXEMM_SMU_ALM2_23_C DFES_EnvRef.DFC_MOXEMM_SMU_ALM2_4_C DFES_EnvRef.DFC_MOXEMM_SMU_ALM2_5_C DFES_EnvRef.DFC_MOXEMM_SMU_ALM2_7_C DFES_EnvRef.DFC_MOXEMM_SMU_ALM2_8_C DFES_EnvRef.DFC_MOXEMM_SMU_ALM6_0_C DFES_EnvRef.DFC_MOXEMM_SMU_ALM6_11_C DFES_EnvRef.DFC_MOXEMM_SMU_ALM6_12_C DFES_EnvRef.DFC_MOXEMM_SMU_ALM6_14_C DFES_EnvRef.DFC_MOXEMM_SMU_ALM6_15_C DFES_EnvRef.DFC_MOXEMM_SMU_ALM6_17_C DFES_EnvRef.DFC_MOXEMM_SMU_ALM6_18_C DFES_EnvRef.DFC_MOXEMM_SMU_ALM6_20_C DFES_EnvRef.DFC_MOXEMM_SMU_ALM6_21_C DFES_EnvRef.DFC_MOXEMM_SMU_ALM6_25_C DFES_EnvRef.DFC_MOXEMM_SMU_ALM6_4_C DFES_EnvRef.DFC_MOXEMM_SMU_ALM6_5_C DFES_EnvRef.DFC_MOXEMM_SMU_ALM6_7_C DFES_EnvRef.DFC_MOXEMM_SMU_ALM6_8_C DFES_EnvRef.DFC_MOXEMM_SMU_ALM7_1_C DFES_EnvRef.DFC_MOXEMM_SMU_ALM7_12_C DFES_EnvRef.DFC_MOXEMM_SMU_ALM7_13_C DFES_EnvRef.DFC_MOXEMM_SMU_ALM7_14_C DFES_EnvRef.DFC_MOXEMM_SMU_ALM7_15_C DFES_EnvRef.DFC_MOXEMM_SMU_ALM7_16_C DFES_EnvRef.DFC_MOXEMM_SMU_ALM7_17_C DFES_EnvRef.DFC_MOXEMM_SMU_ALM7_2_C DFES_EnvRef.DFC_MOXEMM_SMU_ALM7_20_C DFES_EnvRef.DFC_MOXEMM_SMU_ALM7_25_C DFES_EnvRef.DFC_MOXEMM_SMU_ALM7_26_C DFES_EnvRef.DFC_MOXEMM_SMU_ALM7_28_C DFES_EnvRef.DFC_MOXEMM_SMU_ALM7_29_C DFES_EnvRef.DFC_MOXEMM_SMU_ALM7_30_C DFES_EnvRef.DFC_MOXEMM_SMU_ALM7_31_C DFES_EnvRef.DFC_MOXEMM_SMU_ALM8_0_C DFES_EnvRef.DFC_MOXEMM_SMU_ALM8_1_C DFES_EnvRef.DFC_MOXEMM_SMU_ALM8_10_C DFES_EnvRef.DFC_MOXEMM_SMU_ALM8_11_C DFES_EnvRef.DFC_MOXEMM_SMU_ALM8_12_C DFES_EnvRef.DFC_MOXEMM_SMU_ALM8_16_C DFES_EnvRef.DFC_MOXEMM_SMU_ALM8_18_C DFES_EnvRef.DFC_MOXEMM_SMU_ALM8_2_C DFES_EnvRef.DFC_MOXEMM_SMU_ALM8_3_C DFES_EnvRef.DFC_MOXEMM_SMU_ALM8_31_C DFES_EnvRef.DFC_MOXEMM_SMU_ALM8_4_C DFES_EnvRef.DFC_MOXEMM_SMU_ALM9_0_C DFES_EnvRef.DFC_MOXEMM_SMU_ALM9_15_C DFES_EnvRef.DFC_MOXEMM_SMU_ALM9_3_C DFES_EnvRef.DFC_MoCADCNTP_C DFES_EnvRef.DFC_MoCADCTst_C DFES_EnvRef.DFC_MoCSOPICO_C DFES_EnvRef.DFC_MoFAPP_C DFES_EnvRef.DFC_MoFAirFilgPrdc_C DFES_EnvRef.DFC_MoFAirFlCtOffPfi_C DFES_EnvRef.DFC_MoFAirFlCylPfi_C DFES_EnvRef.DFC_MoFAirFlIn_C DFES_EnvRef.DFC_MoFAirFlMixCtlPfiChkAirFl_C DFES_EnvRef.DFC_MoFAirFlMixCtlPfiChkCtrl_C DFES_EnvRef.DFC_MoFAirFlMode_C DFES_EnvRef.DFC_MoFESpd_C DFES_EnvRef.DFC_MoFIACo_C DFES_EnvRef.DFC_MoFICOL1_C DFES_EnvRef.DFC_MoFICOL2_C DFES_EnvRef.DFC_MoFStrt_C DFES_EnvRef.DFC_MoFTrqCmp_C DFES_EnvRef.DFC_MoFTrqCmpMax_C DFES_EnvRef.DFC_MoFTrqCmpMin_C DFES_EnvRef.DFC_MoFVarPostBldSel_C DFES_EnvRef.DFC_MoXEMMHwLTMCUFW_C DFES_EnvRef.DFC_MoXEMMHwLTMonBIST_C DFES_EnvRef.DFC_MoXEMMHwLTRegMonTest_C DFES_EnvRef.DFC_MoXEMMHwLTStbySMUAlvTest_C DFES_EnvRef.DFC_MoXEMMHwLTTempSens_C DFES_EnvRef.DFC_MoXEMMHwLTUCBCfg_C DFES_EnvRef.DFC_OCWDAABEActv_C DFES_EnvRef.DFC_OCWDACom_C DFES_EnvRef.DFC_OCWDAErrPin_C DFES_EnvRef.DFC_OCWDAOvrVltg_C DFES_EnvRef.DFC_ORAmax_C DFES_EnvRef.DFC_ORAmin_C DFES_EnvRef.DFC_PLLSUmax_C DFES_EnvRef.DFC_PLLSUmin_C DFES_EnvRef.DFC_PSR1max_C DFES_EnvRef.DFC_PSRBmax_C DFES_EnvRef.DFC_PSRBmin_C DFES_EnvRef.DFC_PSRPmax_C DFES_EnvRef.DFC_PSRPmin_C DFES_EnvRef.DFC_PSRPsig_C DFES_EnvRef.DFC_PSRmax_C DFES_EnvRef.DFC_PUmax_C DFES_EnvRef.DFC_P_VSE11_OL_C DFES_EnvRef.DFC_P_VSE11_SCB_C DFES_EnvRef.DFC_P_VSE11_SCG_C DFES_EnvRef.DFC_PhyHighAPP1_C DFES_EnvRef.DFC_PhyHighAPP2_C DFES_EnvRef.DFC_PhyLowAPP1_C DFES_EnvRef.DFC_PhyLowAPP2_C DFES_EnvRef.DFC_SRCHighAPP1_C DFES_EnvRef.DFC_SRCHighAPP2_C DFES_EnvRef.DFC_SRCLowAPP1_C DFES_EnvRef.DFC_SRCLowAPP2_C DFES_EnvRef.DFC_SSpMon2_C DFES_EnvRef.DFC_SWReset_0_C DFES_EnvRef.DFC_SWReset_1_C DFES_EnvRef.DFC_SWReset_2_C DFES_EnvRef.DFC_SyncAPP_C DFES_EnvRef.DFC_TAmax_Dummy_C DFES_EnvRef.DFC_TKAEmax_C DFES_EnvRef.DFC_TKAEmin_C DFES_EnvRef.DFC_TKARmax_C DFES_EnvRef.DFC_TKARnpl_C DFES_EnvRef.DFC_TMmax_Dummy_C DFES_EnvRef.DFC_TUMmax_Dummy_C DFES_EnvRef.DFC_TWCDPriCatB1_C DFES_EnvRef.DFC_ThrVlvClsdPosnFirstOffsLrnImpoB1_C DFES_EnvRef.DFC_ThrVlvClsdPosnOffsLrnImpoB1_C DFES_EnvRef.DFC_ThrVlvClsdPosnOffsLrnMaxB1_C DFES_EnvRef.DFC_ThrVlvClsdPosnOffsLrnMinB1_C DFES_EnvRef.DFC_ThrVlvCtrlDeB1_C DFES_EnvRef.DFC_ThrVlvDycB1_C DFES_EnvRef.DFC_ThrVlvLimpAirPosnMaxAbsltDriftB1_C DFES_EnvRef.DFC_ThrVlvLimpAirPosnMaxB1_C DFES_EnvRef.DFC_ThrVlvLimpAirPosnMaxRelDriftB1_C DFES_EnvRef.DFC_ThrVlvLimpAirPosnMinB1_C DFES_EnvRef.DFC_ThrVlvOpenLoadB1_C DFES_EnvRef.DFC_ThrVlvOpenSprgB1_C DFES_EnvRef.DFC_ThrVlvOpenSprgSprdB1_C DFES_EnvRef.DFC_ThrVlvOpenSprgTwnB1_C DFES_EnvRef.DFC_ThrVlvOverTB1_C DFES_EnvRef.DFC_ThrVlvRetSprgB1_C DFES_EnvRef.DFC_ThrVlvRetSprgSprdB1_C DFES_EnvRef.DFC_ThrVlvRetSprgTwnB1_C DFES_EnvRef.DFC_ThrVlvSens1MaxB1_C DFES_EnvRef.DFC_ThrVlvSens1NplB1_C DFES_EnvRef.DFC_ThrVlvSens2MaxB1_C DFES_EnvRef.DFC_ThrVlvSens2MinB1_C DFES_EnvRef.DFC_ThrVlvSens2NplB1_C DFES_EnvRef.DFC_ThrVlvShoCircB1_C DFES_EnvRef.DFC_ThrVlvSpiErrB1_C DFES_EnvRef.DFC_ThrvlvSens1MinB1_C DFES_EnvRef.DFC_TiOffTBasdChkFast_C DFES_EnvRef.DFC_TiOffTBasdChkSlow_C DFES_EnvRef.DFC_UEGOHeatrCtlS1B1_C DFES_EnvRef.DFC_UEGOSnsrMntdS1B1_C DFES_EnvRef.DFC_VehVSig_C DFES_EnvRef.DFC_VlvLftFbSwtIntk11SpclFail_C DFES_EnvRef.DFC_VlvLftFbSwtIntk11StdFail_C DFES_FaultTyp.DFC_Unused_C DFES_FaultTyp.DFC_AltIOACGFailr_C DFES_FaultTyp.DFC_AltIOACGHiVltg_C DFES_FaultTyp.DFC_AltIOACGLoVltg_C DFES_FaultTyp.DFC_AltIOACGTHi_C DFES_FaultTyp.DFC_AltIODConnACG_C DFES_FaultTyp.DFC_BattUHiFailr_C DFES_FaultTyp.DFC_BattULoFailr_C DFES_FaultTyp.DFC_BrkBstPDriftHiErr_C DFES_FaultTyp.DFC_BrkBstPDriftLoErr_C DFES_FaultTyp.DFC_BrkBstPSnsrStuck_C DFES_FaultTyp.DFC_BrkMnSwtContOn_C DFES_FaultTyp.DFC_BrkMnSwtNotStp_C DFES_FaultTyp.DFC_BrkNpl_C DFES_FaultTyp.DFC_BrkRdntSwtContOn_C DFES_FaultTyp.DFC_BrkRdntSwtNotStp_C DFES_FaultTyp.DFC_Clth3ONStuck_C DFES_FaultTyp.DFC_Clth4OFFStuck_C DFES_FaultTyp.DFC_ClthOFFStuck_C DFES_FaultTyp.DFC_ClthONStuck_C DFES_FaultTyp.DFC_ClthStkFailInfo_C DFES_FaultTyp.DFC_ComACFailInfo_C DFES_FaultTyp.DFC_ComATFTValErr_C DFES_FaultTyp.DFC_ComATMILReq_C DFES_FaultTyp.DFC_ComAYCAChksum_C DFES_FaultTyp.DFC_ComAYCARingCnt_C DFES_FaultTyp.DFC_ComAYCATOut_C /end DEF_CHARACTERISTIC
 FUNCTION_VERSION "30000.73.0_2.0.0" /end FUNCTION
/begin COMPU_METHOD DFES_EnvTabVerb "" TAB_VERB "%6.3" "-" COMPU_TAB_REF DFES_EnvTabVerb /end COMPU_METHOD
/begin COMPU_VTAB DFES_EnvTabVerb "" TAB_VERB 2 0 "xSet1" 1 "xSet2" DEFAULT_VALUE "---" /end COMPU_VTAB
/begin COMPU_METHOD DFES_OneToOne "" RAT_FUNC "%6.2" "-" COEFFS 0 1 0 0 0 1 /end COMPU_METHOD
/begin RECORD_LAYOUT Val_Wu8 FNC_VALUES 1 UBYTE COLUMN_DIR DIRECT /end RECORD_LAYOUT
/end MODULE
/end PROJECT
