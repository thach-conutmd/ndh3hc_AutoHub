ASAP2_VERSION 1 60
/begin PROJECT MG1CA020 "MG1CA020"
/begin HEADER "" VERSION "MG1CA020_6SAY_V011_TPROT" PROJECT_NO MG1CA020 /end HEADER
/begin MODULE DIM ""
/begin MOD_COMMON "" BYTE_ORDER MSB_LAST ALIGNMENT_BYTE 1 ALIGNMENT_WORD 2 ALIGNMENT_LONG 4 ALIGNMENT_INT64 4 ALIGNMENT_FLOAT32_IEEE 4 ALIGNMENT_FLOAT64_IEEE 4 DATA_SIZE 32 /end MOD_COMMON
/begin CHARACTERISTIC Com_bAYCCond_C "Default value of AYC active condition status" VALUE 0x80534428 RB_Val_Wu8 1.000 OneToOne 0.00 1.000 FORMAT "%5.3" EXTENDED_LIMITS 0.00 255.0 /end CHARACTERISTIC
/begin CHARACTERISTIC Com_bAYCReWr_C "Default value for VSA unit re-writing status" VALUE 0x80534429 RB_Val_Wu8 1.000 OneToOne 0.00 1.000 FORMAT "%5.3" EXTENDED_LIMITS 0.00 255.0 /end CHARACTERISTIC
/begin CHARACTERISTIC Com_ctAYCMonCond_C "Counter for monitoring condition for AYC frame for VSA unit is re-writing" VALUE 0x8053442A RB_Val_Wu8 255.0 OneToOne 0.00 255.0 FORMAT "%5.1" /end CHARACTERISTIC
/begin CHARACTERISTIC Com_ctCRingAYCA_C "Default value for Ring counter for AYCA frame" VALUE 0x8053442B RB_Val_Wu8 3.000 OneToOne 0.00 3.000 FORMAT "%5.3" EXTENDED_LIMITS 0.00 255.0 /end CHARACTERISTIC
/begin CHARACTERISTIC Com_ctCRingAYCF_C "AYCF Ring counter Calibration" VALUE 0x80534444 RB_Val_Wu8 3.000 OneToOne 0.00 3.000 FORMAT "%5.3" EXTENDED_LIMITS 0.00 255.0 /end CHARACTERISTIC
/begin CHARACTERISTIC Com_ctCRingAYCG_C "AYCG Ring counter Calibration" VALUE 0x80534460 RB_Val_Wu8 3.000 OneToOne 0.00 3.000 FORMAT "%5.3" EXTENDED_LIMITS 0.00 255.0 /end CHARACTERISTIC
/begin CHARACTERISTIC Com_dAYCAMaxDiff_C "Application constant for Maximum difference for AYCA frame" VALUE 0x8053442C RB_Val_Wu32 4294967295.00 OneToOne 0.00 4294967295.00 FORMAT "%13.2" /end CHARACTERISTIC
/begin CHARACTERISTIC Com_dAYCAMaxPer_C "Period for AYCA frame" VALUE 0x80534430 RB_Val_Wu32 4294967295.00 OneToOne 0.00 4294967295.00 FORMAT "%13.2" /end CHARACTERISTIC
/begin CHARACTERISTIC Com_dAYCASigSel_C "Signal selection data for AYCA frame" VALUE 0x80534434 RB_Val_Wu8 255.0 OneToOne 0.00 255.0 FORMAT "%5.1" /end CHARACTERISTIC
/begin CHARACTERISTIC Com_dAYCFMaxDiff_C "Application constant for Maximum difference for AYCF frame" VALUE 0x80534448 RB_Val_Wu32 4294967295.00 OneToOne 0.00 4294967295.00 FORMAT "%13.2" /end CHARACTERISTIC
/begin CHARACTERISTIC Com_dAYCFMaxPer_C "Period for AYCF frame" VALUE 0x8053444C RB_Val_Wu32 4294967295.00 OneToOne 0.00 4294967295.00 FORMAT "%13.2" /end CHARACTERISTIC
/begin CHARACTERISTIC Com_dAYCGMaxDiff_C "Application constant for Maximum difference for ring counter in AYCG frame" VALUE 0x80534461 RB_Val_Wu8 255.0 OneToOne 0.00 255.0 FORMAT "%5.1" /end CHARACTERISTIC
/begin CHARACTERISTIC Com_dAYCGMaxPer_C "Application constant for Maximum period for same ring counter in AYCG frame" VALUE 0x80534462 RB_Val_Wu8 255.0 OneToOne 0.00 255.0 FORMAT "%5.1" /end CHARACTERISTIC
/begin CHARACTERISTIC Com_dAYCIMaxDiff_C "Maximum difference for AYCI frame" VALUE 0x80534470 RB_Val_Wu8 255.0 OneToOne 0.00 255.0 FORMAT "%5.1" /end CHARACTERISTIC
/begin CHARACTERISTIC Com_dAYCIMaxPer_C "Maximum period for AYCI frame" VALUE 0x80534471 RB_Val_Wu8 255.0 OneToOne 0.00 255.0 FORMAT "%5.1" /end CHARACTERISTIC
/begin CHARACTERISTIC Com_dEPS1MaxDiff_C "Application constant for Maximum difference for ring counter in EPS1 frame" VALUE 0x80534474 RB_Val_Wu32 4294967295.00 OneToOne 0.00 4294967295.00 FORMAT "%13.2" /end CHARACTERISTIC
/begin CHARACTERISTIC Com_dEPS1MaxPer_C "Application constant for Maximum period for same ring counter in EPS1 frame" VALUE 0x80534478 RB_Val_Wu32 4294967295.00 OneToOne 0.00 4294967295.00 FORMAT "%13.2" /end CHARACTERISTIC
/begin CHARACTERISTIC Com_numCsumAYCA_C "Default value for Checksum message for AYCA frame in case of defective reception." VALUE 0x80534435 RB_Val_Wu8 15.00 OneToOne 0.00 15.00 FORMAT "%5.2" EXTENDED_LIMITS 0.00 255.0 /end CHARACTERISTIC
/begin CHARACTERISTIC Com_numCsumAYCD_C "Check sum for AYCD frame" VALUE 0x80534440 RB_Val_Wu8 15.00 OneToOne 0.00 15.00 FORMAT "%5.2" EXTENDED_LIMITS 0.00 255.0 /end CHARACTERISTIC
/begin CHARACTERISTIC Com_numCsumAYCF_C "AYCF Checksum Calibration" VALUE 0x80534450 RB_Val_Wu8 15.00 OneToOne 0.00 15.00 FORMAT "%5.2" EXTENDED_LIMITS 0.00 255.0 /end CHARACTERISTIC
/begin CHARACTERISTIC Com_numCsumAYCG_C "AYCG Checksum Calibration" VALUE 0x80534463 RB_Val_Wu8 15.00 OneToOne 0.00 15.00 FORMAT "%5.2" EXTENDED_LIMITS 0.00 255.0 /end CHARACTERISTIC
/begin CHARACTERISTIC Com_pMstCyl_C "pressure of the brake master cylinder" VALUE 0x80534436 RB_Val_Ws16 98116.20 Pres_kPa_VSA 0.00 98116.20 FORMAT "%8.2" EXTENDED_LIMITS -785121.3 785097.3 /end CHARACTERISTIC
/begin CHARACTERISTIC Com_stABSEBDFailr_C "ABS, EBD failure status" VALUE 0x80534438 RB_Val_Wu8 1.000 OneToOne 0.00 1.000 FORMAT "%5.3" EXTENDED_LIMITS 0.00 255.0 /end CHARACTERISTIC
/begin CHARACTERISTIC Com_stABSWrn_C "status of ABS warning" VALUE 0x80534439 RB_Val_Wu8 1.000 OneToOne 0.00 1.000 FORMAT "%5.3" EXTENDED_LIMITS 0.00 255.0 /end CHARACTERISTIC
/begin CHARACTERISTIC Com_stActABSEBD_C "status of ABS+EBD activation" VALUE 0x8053443A RB_Val_Wu8 1.000 OneToOne 0.00 1.000 FORMAT "%5.3" EXTENDED_LIMITS 0.00 255.0 /end CHARACTERISTIC
/begin CHARACTERISTIC Com_stAYCFShiftReq_C "Initial value of VSA shift control request" VALUE 0x80534451 RB_Val_Wu8 255.0 OneToOne 0.00 255.0 FORMAT "%5.1" /end CHARACTERISTIC
/begin CHARACTERISTIC Com_stAYCF_C "VSA shift control request" VALUE 0x80534452 RB_Val_Wu8 3.000 OneToOne 0.00 3.000 FORMAT "%5.3" EXTENDED_LIMITS 0.00 255.0 /end CHARACTERISTIC
/begin CHARACTERISTIC Com_stDCSPlusAYCF_C "Positive/Negative torque request" VALUE 0x80534453 RB_Val_Wu8 1.000 OneToOne 0.00 1.000 FORMAT "%5.3" EXTENDED_LIMITS 0.00 255.0 /end CHARACTERISTIC
/begin CHARACTERISTIC Com_stFailMstCylPSnsr_C "Status of the brake master cylinder pressure sensor fail" VALUE 0x8053443B RB_Val_Wu8 1.000 OneToOne 0.00 1.000 FORMAT "%5.3" EXTENDED_LIMITS 0.00 255.0 /end CHARACTERISTIC
/begin CHARACTERISTIC Com_stFrntLeWhlSpdSnsrErr_C "Calibration for Front Left wheel speed sensor error status" VALUE 0x80534464 RB_Val_Wu8 1.00000000000 B_TRUE 0.00 1.00000000000 FORMAT "%13.11" /end CHARACTERISTIC
/begin CHARACTERISTIC Com_stFrntRiWhlSpdSnsrErr_C "Calibration for Front right wheel speed sensor error status" VALUE 0x80534465 RB_Val_Wu8 1.00000000000 B_TRUE 0.00 1.00000000000 FORMAT "%13.11" /end CHARACTERISTIC
/begin CHARACTERISTIC Com_stFuCtrlReq_C "Fuel control request signal" VALUE 0x80534454 RB_Val_Wu8 255.0 OneToOne 0.00 255.0 FORMAT "%5.1" /end CHARACTERISTIC
/begin CHARACTERISTIC Com_stInhbMstCylPSnsr_C "Status of the brake master cylinder pressure sensor inhibition" VALUE 0x8053443C RB_Val_Wu8 1.000 OneToOne 0.00 1.000 FORMAT "%5.3" EXTENDED_LIMITS 0.00 255.0 /end CHARACTERISTIC
/begin CHARACTERISTIC Com_stLatGASensInh_C "Application constant for lateral G sensor" VALUE 0x80534466 RB_Val_Wu8 1.000 OneToOne 0.00 1.000 FORMAT "%5.3" EXTENDED_LIMITS 0.00 255.0 /end CHARACTERISTIC
/begin CHARACTERISTIC Com_stLgtGASensErr_C "Application constant for longitudinal acceleration sensor error ." VALUE 0x80534467 RB_Val_Wu8 1.000 OneToOne 0.00 1.000 FORMAT "%5.3" EXTENDED_LIMITS 0.00 255.0 /end CHARACTERISTIC
/begin CHARACTERISTIC Com_stLgtGASensInh_C "Application constant for Longitudinal G sensor ." VALUE 0x80534468 RB_Val_Wu8 1.000 OneToOne 0.00 1.000 FORMAT "%5.3" EXTENDED_LIMITS 0.00 255.0 /end CHARACTERISTIC
/begin CHARACTERISTIC Com_stReLeWhlSpdSnsrErr_C "Calibration for Rear Left wheel speed sensor error status" VALUE 0x80534469 RB_Val_Wu8 1.00000000000 B_TRUE 0.00 1.00000000000 FORMAT "%13.11" /end CHARACTERISTIC
/begin CHARACTERISTIC Com_stReRiWhlSpdSnsrErr_C "Calibration for Rear Right wheel speed sensor error status" VALUE 0x8053446A RB_Val_Wu8 1.00000000000 B_TRUE 0.00 1.00000000000 FORMAT "%13.11" /end CHARACTERISTIC
/begin CHARACTERISTIC Com_stSteerSnsrInhb_C "default value for Steering angle sensor temporary inhibition incase of frame error" VALUE 0x8053446B RB_Val_Wu8 1.000 OneToOne 0.00 1.000 FORMAT "%5.3" EXTENDED_LIMITS 0.00 255.0 /end CHARACTERISTIC
/begin CHARACTERISTIC Com_stSwtCrpTqCorrn_C "Calibration represents status of switch onoff of creep torque correction" VALUE 0x80534455 RB_Kw_Wu8 1.00000000000 B_TRUE 0.00 1.00000000000 FORMAT "%13.11" /end CHARACTERISTIC
/begin CHARACTERISTIC Com_stYawRateSnsrErr_C "Calibration for yaw rate sensor error status" VALUE 0x8053446C RB_Val_Wu8 1.00000000000 B_TRUE 0.00 1.00000000000 FORMAT "%13.11" /end CHARACTERISTIC
/begin CHARACTERISTIC Com_stYawRateSnsrInhb_C "default value for Yaw late sensor temporary inhibition incase of frame error" VALUE 0x8053446D RB_Val_Wu8 1.000 OneToOne 0.00 1.000 FORMAT "%5.3" EXTENDED_LIMITS 0.00 255.0 /end CHARACTERISTIC
/begin CHARACTERISTIC Com_tqBrkOper_C "Calibration for Brake Operation torque (Driver Input)" VALUE 0x8053446E RB_Val_Wu16 65535.00 TrqPerSec 0.00 65535.00 FORMAT "%8.2" /end CHARACTERISTIC
/begin CHARACTERISTIC Com_trqAYCFDes_C "Crankshaft torque" VALUE 0x80534458 RB_Val_Ws32 429496729.500 trq_q0p1 -214748364.800 214748364.700 FORMAT "%13.3" /end CHARACTERISTIC
/begin CHARACTERISTIC Com_vWhlSpd_C "Calibration Parameter for Wheel Speed" VALUE 0x80534442 RB_Val_Ws16 327.6700 Vel 0.00 327.6700 FORMAT "%8.4" EXTENDED_LIMITS -327.6800 327.6700 /end CHARACTERISTIC
/begin CHARACTERISTIC CWPKAPP "code word application of reference pressure for fuel-pressure controller" VALUE 0x80533948 RB_Val_Wu8 255.0 dez 0.00 255.0 FORMAT "%5.1" /end CHARACTERISTIC
/begin CHARACTERISTIC CWSPDGOV "Code word SpdGov" VALUE 0x805341B8 RB_Val_Wu8 255.0 dez 0.00 255.0 FORMAT "%5.1" /end CHARACTERISTIC
/begin CHARACTERISTIC CWSTADAP "Code word: start adaptation" VALUE 0x80533D10 RB_Val_Wu8 255.0 dez 0.00 255.0 FORMAT "%5.1" /end CHARACTERISTIC
/begin CHARACTERISTIC DNSOZW "delta engine speed without ignition angle intervention" CURVE 0x805341BC RB_Curve_S8_S16_Static 32767.50 nmot_sw_q0p5 -16384.00 16383.50 FORMAT "%8.2"
 /begin AXIS_DESCR STD_AXIS Tra_numGear OneToOne 8 -128.0 127.0 FORMAT "%5.1" DEPOSIT ABSOLUTE /end AXIS_DESCR
/end CHARACTERISTIC
/begin CHARACTERISTIC DTEMN "Min-threshold for delta effective injection period" VALUE 0x8053394A RB_Val_Wu16 65.53500 t1p0usxms 0.00 65.53500 FORMAT "%8.5" /end CHARACTERISTIC
/begin CHARACTERISTIC EngStrt_ActvFuAdpn_C "Codeword for Active Fuel Adaptation" VALUE 0x80533D11 RB_Val_Wu8 255.0 dez 0.00 255.0 FORMAT "%5.1" /end CHARACTERISTIC
/begin CHARACTERISTIC FKKVS "Factor to correct fuel delivery system" MAP 0x8053394C RB_Map_U16U16_U16 1.999969 fak_uw_b2 0.00 1.999969 FORMAT "%8.6"
 /begin AXIS_DESCR STD_AXIS InjSys_nEngRKTE nmot_uw_q0p25 16 0.00 16383.75 FORMAT "%8.2" DEPOSIT ABSOLUTE /end AXIS_DESCR
 /begin AXIS_DESCR STD_AXIS tevfak_w_msg t1p0usxms 16 0.00 65.53500 FORMAT "%8.5" DEPOSIT ABSOLUTE /end AXIS_DESCR
/end CHARACTERISTIC
/begin CHARACTERISTIC FRKEZAP "Array cylinder individual factor, relative fuel mass for appli" VAL_BLK 0x80533B90 RB_ValA_Wu16 1.999969 fak_uw_b2 0.00 1.999969 FORMAT "%8.6" NUMBER 4 /end CHARACTERISTIC
/begin CHARACTERISTIC FRLFSDP "injection correction for RLFS" CURVE 0x80533B98 RB_Curve_S16_U16_Static 1.999969 fak_uw_b2 0.00 1.999969 FORMAT "%8.6"
 /begin AXIS_DESCR STD_AXIS dppk_w_msg p_sw_q0p312 12 -10240.00 10239.69 FORMAT "%8.2" DEPOSIT ABSOLUTE /end AXIS_DESCR
/end CHARACTERISTIC
/begin CHARACTERISTIC FSTAIFRES "Factor for adaptation- increments after refuelling reset (learning speed)" VALUE 0x80533D12 RB_Val_Wu8 16.26 fak_ub_q0p064 0.00 16.26 FORMAT "%5.2" /end CHARACTERISTIC
/begin CHARACTERISTIC Injsys_facFuMPCorrn "correction factor for rail pressure decreasing at high fuelmass consumption" CURVE 0x80533BCA RB_Curve_U16_U16 1.999969 fak_uw_b2 0.00 1.999969 FORMAT "%8.6"
 /begin AXIS_DESCR STD_AXIS InjSys_dvolFuInjr q1p1921Em6_L_DIV_s 6 0.00 0.07812381 FORMAT "%10.8" DEPOSIT ABSOLUTE /end AXIS_DESCR
/end CHARACTERISTIC
/begin CHARACTERISTIC KFADASTEP "steps of adaptation" MAP 0x80533D14 RB_Map_S16U8_S16 63.99902 fak_q0p0009766 -32.00000 31.99902 FORMAT "%8.5"
 /begin AXIS_DESCR STD_AXIS qdnmot_w fak_q0p015625 6 -512.0000 511.9844 FORMAT "%8.4" DEPOSIT ABSOLUTE /end AXIS_DESCR
 /begin AXIS_DESCR STD_AXIS tststadap temp_ub_q0p75_o48 7 -48.0 143.3 FORMAT "%5.1" DEPOSIT ABSOLUTE /end AXIS_DESCR
/end CHARACTERISTIC
/begin CHARACTERISTIC KFDNBNSKH "set point for rpm change at catalyst heating" MAP 0x80533D80 RB_Map_U16U16_S16 1020.000 nmot_q4 -512.0000 508.0000 FORMAT "%8.4" EXTENDED_LIMITS -131072.0 131068.0
 /begin AXIS_DESCR STD_AXIS nmot_stadap nmot_uw_q0p25 8 0.00 16383.75 FORMAT "%8.2" DEPOSIT ABSOLUTE /end AXIS_DESCR
 /begin AXIS_DESCR STD_AXIS tststa_loc_stadap temp_ub_q0p75_o48 7 -48.0000 143.2500 FORMAT "%8.4" EXTENDED_LIMITS -48.00000 49103.25 DEPOSIT ABSOLUTE /end AXIS_DESCR
/end CHARACTERISTIC
/begin CHARACTERISTIC KFDNBURNS "set point for rpm change" MAP 0x80533E12 RB_Map_U16U16_S16 1020.000 nmot_q4 -512.0000 508.0000 FORMAT "%8.4" EXTENDED_LIMITS -131072.0 131068.0
 /begin AXIS_DESCR STD_AXIS nmot_stadap nmot_uw_q0p25 8 0.00 16383.75 FORMAT "%8.2" DEPOSIT ABSOLUTE /end AXIS_DESCR
 /begin AXIS_DESCR STD_AXIS tststa_loc_stadap temp_ub_q0p75_o48 7 -48.0000 143.2500 FORMAT "%8.4" EXTENDED_LIMITS -48.00000 49103.25 DEPOSIT ABSOLUTE /end AXIS_DESCR
/end CHARACTERISTIC
/begin CHARACTERISTIC KFNSTAMX "engine speed limit until STADAP is active" MAP 0x80533EA4 RB_Map_U16U16_U16 16383.75 nmot_uw_q0p25 0.00 16383.75 FORMAT "%8.2"
 /begin AXIS_DESCR STD_AXIS nstat_loc_stadap nmot_ub_q10 4 0.00 2550.000 FORMAT "%8.3" EXTENDED_LIMITS 0.00 655350.0 DEPOSIT ABSOLUTE /end AXIS_DESCR
 /begin AXIS_DESCR STD_AXIS fho_loc_stadap fak_ub_b4 4 0.00 3.984375 FORMAT "%8.6" EXTENDED_LIMITS 0.00 1023.984 DEPOSIT ABSOLUTE /end AXIS_DESCR
/end CHARACTERISTIC
/begin CHARACTERISTIC KLADAPSRES "limit sum of adaptation steps for reset at bad start" CURVE 0x80533ED8 RB_Curve_U8_U8 1.992188 fak_ub_b2 0.00 1.992188 FORMAT "%8.6"
 /begin AXIS_DESCR STD_AXIS tststadap temp_ub_q0p75_o48 7 -48.0 143.3 FORMAT "%5.1" DEPOSIT ABSOLUTE /end AXIS_DESCR
/end CHARACTERISTIC
/begin CHARACTERISTIC KLDNFHO "Weighting minimum difference in engine-speed for detected combustion" CURVE 0x80533EE7 RB_Curve_U8_U8 1.992188 fak_ub_b2 0.00 1.992188 FORMAT "%8.6"
 /begin AXIS_DESCR STD_AXIS fho_msg fak_ub_b4 4 0.00 3.984 FORMAT "%5.3" DEPOSIT ABSOLUTE /end AXIS_DESCR
/end CHARACTERISTIC
/begin CHARACTERISTIC KLDNMAXH "Overrunning engine speed for injection cutoff" CURVE 0x805341D6 RB_Curve_S16_S16 32767.50 nmot_sw_q0p5 -16384.00 16383.50 FORMAT "%8.2"
 /begin AXIS_DESCR STD_AXIS PT_nClth nmot_sw_q0p5 4 -16384.00 16383.50 FORMAT "%8.2" DEPOSIT ABSOLUTE /end AXIS_DESCR
/end CHARACTERISTIC
/begin CHARACTERISTIC KLFTVTEV "Map: Delay time of injection valves, dependant on air temperature at inlet valve" CURVE 0x80533BE4 RB_Curve_U16_U8_Static 1.992188 fak_ub_b2 0.00 1.992188 FORMAT "%8.6"
 /begin AXIS_DESCR STD_AXIS taevfout_w temp_q0p0234_o273 5 -273.150 1262.827 FORMAT "%8.3" DEPOSIT ABSOLUTE /end AXIS_DESCR
/end CHARACTERISTIC
/begin CHARACTERISTIC KLKSTAAINI "initial value for kstaa in/ out of adaptation range" CURVE 0x80533EF0 RB_Curve_U8_U8 1.992188 fak_ub_b2 0.00 1.992188 FORMAT "%8.6"
 /begin AXIS_DESCR STD_AXIS tmstsst temp_ub_q0p75_o48 4 -48.0 143.3 FORMAT "%5.1" DEPOSIT ABSOLUTE /end AXIS_DESCR
/end CHARACTERISTIC
/begin CHARACTERISTIC KLKSTAMN "lowest limit for kstaa dependent on tmst" CURVE 0x80533EF9 RB_Curve_U8_U8 1.992188 fak_ub_b2 0.00 1.992188 FORMAT "%8.6"
 /begin AXIS_DESCR STD_AXIS tmstsst temp_ub_q0p75_o48 5 -48.0 143.3 FORMAT "%5.1" DEPOSIT ABSOLUTE /end AXIS_DESCR
/end CHARACTERISTIC
/begin CHARACTERISTIC KLKSTAMX "maximum value for kstaa dependent on tmst" CURVE 0x80533F04 RB_Curve_U8_U8 1.992188 fak_ub_b2 0.00 1.992188 FORMAT "%8.6"
 /begin AXIS_DESCR STD_AXIS tmstsst temp_ub_q0p75_o48 5 -48.0 143.3 FORMAT "%5.1" DEPOSIT ABSOLUTE /end AXIS_DESCR
/end CHARACTERISTIC
/begin CHARACTERISTIC KLSSTTMST "tmst basepoint for adaptation factor (kstatmst) array" CURVE 0x80533F0F RB_Curve_U8_U8 191.3 temp_ub_q0p75_o48 -48.0 143.3 FORMAT "%5.1"
 /begin AXIS_DESCR STD_AXIS sststadap dez 7 0.00 255.0 FORMAT "%5.1" DEPOSIT ABSOLUTE /end AXIS_DESCR
/end CHARACTERISTIC
/begin CHARACTERISTIC KLWSTADAP "weighting of adaptation factor to other temperatures" CURVE 0x80533F1E RB_Curve_S8_U8_Static 0.996093750 fak_sb_b0p5 0.00 0.996093750 FORMAT "%11.9"
 /begin AXIS_DESCR STD_AXIS dssttmst temp_sb_q0p75 5 -96.00 95.25 FORMAT "%5.2" DEPOSIT ABSOLUTE /end AXIS_DESCR
/end CHARACTERISTIC
/begin CHARACTERISTIC KRKATE "conversion from relative fuel mass rk into effective injection time te" VALUE 0x80533BF6 RB_Val_Wu16 0.6826562 rkti_q0p10416Em4 0.00 0.6826562 FORMAT "%9.7" /end CHARACTERISTIC
/begin CHARACTERISTIC KSTAOLDMN "lower limit for kstaold" VALUE 0x80533F2A RB_Val_Wu8 1.992188 fak_ub_b2 0.00 1.992188 FORMAT "%8.6" /end CHARACTERISTIC
/begin CHARACTERISTIC KSTATMSTI "initial value for array kstatmst" VALUE 0x80533F2B RB_Val_Wu8 1.992188 fak_ub_b2 0.00 1.992188 FORMAT "%8.6" /end CHARACTERISTIC
/begin CHARACTERISTIC KSTTOPMN "minimum operating time since PWF for starting fuel adaptation" VALUE 0x80533F2C RB_Val_Wu16 393210.0 t6minxmin_q6 0.00 393210.0 FORMAT "%8.1" /end CHARACTERISTIC
/begin CHARACTERISTIC LINCAUSW "limit for faster analyse of increment" VALUE 0x80533F2E RB_Val_Wu8 1.992188 fak_ub_b2 0.00 1.992188 FORMAT "%8.6" /end CHARACTERISTIC
/begin CHARACTERISTIC NSTAK "threshold cranking engine speed for rewing-up detection" VALUE 0x80533F30 RB_Val_Wu16 16383.75 nmot_uw_q0p25 0.00 16383.75 FORMAT "%8.2" /end CHARACTERISTIC
/begin CHARACTERISTIC PSAPES "intake manifold pressure to applicate injection" VALUE 0x80533BF8 RB_Val_Wu16 2559.961 p_uw_q0p039 0.00 2559.961 FORMAT "%8.3" /end CHARACTERISTIC
/begin CHARACTERISTIC QDNBURNOK "limit (qdnmot) to detect OK combustion" VALUE 0x80533F32 RB_Val_Ws8 3.984 fak_q0p015625 -2.000 1.984 FORMAT "%5.3" /end CHARACTERISTIC
/begin CHARACTERISTIC rba_StopCntrWakeup_Debug_C "" VALUE 0x8053B62C RB_Val_Wu8 1.00000000000 B_TRUE 0.00 1.00000000000 FORMAT "%13.11" /end CHARACTERISTIC
/begin CHARACTERISTIC rba_StopCntrWakeup_MaxProlongCntr_C "" VALUE 0x8053B630 RB_Val_Wu32 4294967295.00 OneToOne 0.00 4294967295.00 FORMAT "%13.2" /end CHARACTERISTIC
/begin CHARACTERISTIC rba_StopCntrWakeup_stActv_C "Calibration feture to deactivate stop counter wake up feature for HMC" VALUE 0x8053B634 Val_Wu8 255.0 OneToOne 0.00 255.0 FORMAT "%5.1" /end CHARACTERISTIC
/begin CHARACTERISTIC RngMod_bClth_C "state powertrain for torque adaption" VALUE 0x80533C18 RB_Val_Wu8 1.00000000000 B_TRUE 0.00 1.00000000000 FORMAT "%13.11" /end CHARACTERISTIC
/begin CHARACTERISTIC RngMod_facPwrDpdtFricLoss_M "Power dependent weighting factor of torque loss adaption" MAP 0x80533C1A RB_Map_S16S16_U8 2.000 fak_ub_q0p01 0.00 2.000 FORMAT "%5.3" EXTENDED_LIMITS 0.00 2.550
 /begin AXIS_DESCR STD_AXIS Epm_nEng nmot_q0p5 6 -16384.00 16383.50 FORMAT "%8.2" DEPOSIT ABSOLUTE /end AXIS_DESCR
 /begin AXIS_DESCR STD_AXIS ActMod_trqInr md_sw_q0p1 6 -3276.800 3276.700 FORMAT "%8.3" DEPOSIT ABSOLUTE /end AXIS_DESCR
/end CHARACTERISTIC
/begin CHARACTERISTIC RngMod_facSpd_CUR "interpolation factor base torque depending on engine speed" CURVE 0x80533CA8 RB_Curve_U16_U8_Static 0.9961 fak_ub_b1 0.00 0.9961
 /begin AXIS_DESCR STD_AXIS RngMod_nEng_LOC nmot_q0p5 6 0.00 32767.50 FORMAT "%8.2" DEPOSIT ABSOLUTE /end AXIS_DESCR
/end CHARACTERISTIC
/begin CHARACTERISTIC RngMod_facTraRat_CUR "interpolation factor base torque depending on transmission ratio" CURVE 0x80533CBC RB_Curve_U16_U8_Static 0.9961 fak_ub_b1 0.00 0.9961
 /begin AXIS_DESCR STD_AXIS RngMod_rTrq_LOC fak_q0p01 7 0.00 655.3500 FORMAT "%8.4" DEPOSIT ABSOLUTE /end AXIS_DESCR
/end CHARACTERISTIC
/begin CHARACTERISTIC RngMod_nLIDvtMax_C "Speed threshold for adaption-stop" VALUE 0x80533C5A RB_Val_Wu16 32767.50 nmot_q0p5 0.00 32767.50 FORMAT "%8.2" /end CHARACTERISTIC
/begin CHARACTERISTIC RngMod_nMaxDes_C "requested operating conditions: max. engine speed for torque adaption" VALUE 0x80533C5C RB_Val_Wu16 16383.50 nmot_q0p5 0.00 16383.50 FORMAT "%8.2" EXTENDED_LIMITS 0.00 32767.50 /end CHARACTERISTIC
/begin CHARACTERISTIC RngMod_nMinDes_C "requested operating conditions: min. engine speed for torque adaption" VALUE 0x80533C5E RB_Val_Wu16 16383.50 nmot_q0p5 0.00 16383.50 FORMAT "%8.2" EXTENDED_LIMITS 0.00 32767.50 /end CHARACTERISTIC
/begin CHARACTERISTIC RngMod_phiThrVlvThres_C "throttle value threshold for torque adaption" VALUE 0x80533C60 RB_Val_Ws16 1599.976 rel_sw_q0p02441 -800.0000 799.9756 FORMAT "%8.4" /end CHARACTERISTIC
/begin CHARACTERISTIC RngMod_stPrio_CUR "priority of requested operating point for torque adaption" CURVE 0x80533C62 RB_Curve_U8_U8 255.0 dez 0.00 255.0 FORMAT "%5.1"
 /begin AXIS_DESCR STD_AXIS RngMod_NumCycl dez 5 0.00 255.0 FORMAT "%5.1" DEPOSIT ABSOLUTE /end AXIS_DESCR
/end CHARACTERISTIC
/begin CHARACTERISTIC RngMod_swtTqDmdAcsy_CW "Codeword for selectively activation of torque demands from accessories" VALUE 0x80533C70 RB_Val_Wu32 65535.0000000 OneToOne 0.00 65535.0000000 FORMAT "%13.7" EXTENDED_LIMITS 0.00 4294967295.00 /end CHARACTERISTIC
/begin CHARACTERISTIC RngMod_swtTqResv_C "Torque reserve taken into consideration when calculating engine limits" VALUE 0x80533C12 RB_Val_Wu8 1.00000000000 B_TRUE 0.00 1.00000000000 FORMAT "%13.11" /end CHARACTERISTIC
/begin CHARACTERISTIC RngMod_tAdapMin_C "minimum engine temperature for loss torque adaption" VALUE 0x80533C74 RB_Val_Ws16 6553.500 temp_q0p1_o273 -3549.940 3003.560 FORMAT "%8.3" /end CHARACTERISTIC
/begin CHARACTERISTIC RngMod_tiDetnQly_C "threshold for quality information of torque adaption" VALUE 0x80533C76 RB_Val_Wu16 655.3500 t_q0p01 0.00 655.3500 FORMAT "%8.4" /end CHARACTERISTIC
/begin CHARACTERISTIC RngMod_tiDmdAdpn_C "time for demand torque-adaption" VALUE 0x80533C78 RB_Val_Wu16 655.3500 t_q0p01 0.00 655.3500 FORMAT "%8.4" /end CHARACTERISTIC
/begin CHARACTERISTIC RngMod_tiFltEtaIgnMin_C "time constant for filtering minimum spark efficiency" VALUE 0x80533C14 RB_Val_Wu16 655.34999985 zk10msxs_uw_b655p36 0.01000015 655.36000000 FORMAT "%12.8" EXTENDED_LIMITS 0.010000152590 655.36000000 /end CHARACTERISTIC
/begin CHARACTERISTIC RngMod_tiOffsRelsAdpn_C "Offset for time delay of release torque adaption" VALUE 0x80533C7A RB_Val_Wu16 655.3500 t_q0p01 0.00 655.3500 FORMAT "%8.4" /end CHARACTERISTIC
/begin CHARACTERISTIC RngMod_tiRelsAdpn_C "debounce for adaption release" VALUE 0x80533C7C RB_Val_Wu16 655.3500 t_q0p01 0.00 655.3500 FORMAT "%8.4" /end CHARACTERISTIC
/begin CHARACTERISTIC RngMod_tiTqAdpn_C "time constant for filtered torque adaption" VALUE 0x80533C7E RB_Val_Wu16 655.34999985 zk10msxs_uw_b655p36 0.01000015 655.36000000 FORMAT "%12.8" EXTENDED_LIMITS 0.010000152590 655.36000000 /end CHARACTERISTIC
/begin CHARACTERISTIC RngMod_tiTqDifAdpn_C "time constant for filtered torque adaption" VALUE 0x80533C80 RB_Val_Wu16 655.34999985 zk10msxs_uw_b655p36 0.01000015 655.36000000 FORMAT "%12.8" EXTENDED_LIMITS 0.010000152590 655.36000000 /end CHARACTERISTIC
/begin CHARACTERISTIC RngMod_TrqCalc_CW "Codeword RngMod_TrqCalc" VALUE 0x80533C16 RB_Val_Wu8 255.0 dez 0.00 255.0 FORMAT "%5.1" /end CHARACTERISTIC
/begin CHARACTERISTIC RngMod_trqDef_C "default valur for nv - values of torque adaption" VALUE 0x80533C82 RB_Val_Ws16 6553.500 md_sw_q0p1 -3276.800 3276.700 FORMAT "%8.3" /end CHARACTERISTIC
/begin CHARACTERISTIC RngMod_TrqFrcAdap_CW "Codeword torque adaption" VALUE 0x80533C84 RB_Val_Wu16 65535.00 OneToOne 0.00 65535.00 FORMAT "%8.2" /end CHARACTERISTIC
/begin CHARACTERISTIC RngMod_trqLimMax_C "upper limit for torque adaption" VALUE 0x80533C86 RB_Val_Ws16 6553.500 md_sw_q0p1 -3276.800 3276.700 FORMAT "%8.3" /end CHARACTERISTIC
/begin CHARACTERISTIC RngMod_trqLimMin_C "lower limit for torque adaption" VALUE 0x80533C88 RB_Val_Ws16 6553.500 md_sw_q0p1 -3276.800 3276.700 FORMAT "%8.3" /end CHARACTERISTIC
/begin CHARACTERISTIC RngMod_trqMaxDes_C "requested operating conditions: max. torque for torque adaptation" VALUE 0x80533C8A RB_Val_Ws16 3276.700 md_sw_q0p1 0.00 3276.700 FORMAT "%8.3" EXTENDED_LIMITS -3276.800 3276.700 /end CHARACTERISTIC
/begin CHARACTERISTIC RngMod_trqMinDes_C "requested operating conditions: min. torque for torque adaptation" VALUE 0x80533C8C RB_Val_Ws16 3276.700 md_sw_q0p1 0.00 3276.700 FORMAT "%8.3" EXTENDED_LIMITS -3276.800 3276.700 /end CHARACTERISTIC
/begin CHARACTERISTIC RngMod_trqOfsLim_C "permitted offset for adapted torque per adaption period" VALUE 0x80533C8E RB_Val_Ws16 6553.500 md_sw_q0p1 -3276.800 3276.700 FORMAT "%8.3" /end CHARACTERISTIC
/begin CHARACTERISTIC RngMod_trqOfsQl_C "threshold for quality information of torque adaption" VALUE 0x80533C90 RB_Val_Ws16 6553.500 md_sw_q0p1 -3276.800 3276.700 FORMAT "%8.3" /end CHARACTERISTIC
/begin CHARACTERISTIC RngMod_vLimTrans_C "Speed threshold for reactivate the adaption" VALUE 0x80533C92 RB_Val_Ws16 655.3500 vel_q0p01 -327.6800 327.6700 FORMAT "%8.4" /end CHARACTERISTIC
/begin CHARACTERISTIC RngMod_vLim_C "Speed threshold for demand adaption" VALUE 0x80533C94 RB_Val_Ws16 655.3500 vel_q0p01 -327.6800 327.6700 FORMAT "%8.4" /end CHARACTERISTIC
/begin CHARACTERISTIC Sia_EnGen6Support_C "To enable or disable the Gen6 functionality." VALUE 0x80533CD6 RB_Val_Wu8 1.000 OneToOne 0.00 1.000 FORMAT "%5.3" EXTENDED_LIMITS 0.00 255.0 /end CHARACTERISTIC
/begin CHARACTERISTIC Sia_numCODE1_C "Immobilizer Code Byte 1 to be stored in EEPROM" VALUE 0x80533CD7 RB_Val_Wu8 253.0 OneToOne 1.0 254.0 FORMAT "%5.1" EXTENDED_LIMITS 0.00 255.0 /end CHARACTERISTIC
/begin CHARACTERISTIC Sia_numCODE2_C "Immobilizer Code Byte 2 to be stored in EEPROM" VALUE 0x80533CD8 RB_Val_Wu8 253.0 OneToOne 1.0 254.0 FORMAT "%5.1" EXTENDED_LIMITS 0.00 255.0 /end CHARACTERISTIC
/begin CHARACTERISTIC Sia_numCODE3_C "Immobilizer Code Byte 3 to be stored in EEPROM" VALUE 0x80533CD9 RB_Val_Wu8 253.0 OneToOne 1.0 254.0 FORMAT "%5.1" EXTENDED_LIMITS 0.00 255.0 /end CHARACTERISTIC
/begin CHARACTERISTIC Sia_numExcCod_C "Used to give direct Exc value without ICU." VALUE 0x80533CDA RB_Val_Wu8 127.0 OneToOne 0.00 127.0 FORMAT "%5.1" EXTENDED_LIMITS 0.00 255.0 /end CHARACTERISTIC
/begin CHARACTERISTIC Sia_numExdCod_C "To give direct Exd value without ICU." VALUE 0x80533CDB RB_Val_Wu8 127.0 OneToOne 0.00 127.0 FORMAT "%5.1" EXTENDED_LIMITS 0.00 255.0 /end CHARACTERISTIC
/begin CHARACTERISTIC Sia_numfARCal_C "Immobilizer fAR key calculation parameter" VALUE 0x80533CD4 RB_Val_Wu16 65535.00 OneToOne 0.00 65535.00 FORMAT "%8.2" /end CHARACTERISTIC
/begin CHARACTERISTIC Sia_swtCodEepUpd_C "Switch to store Calibration data in to EEPROM" VALUE 0x80533CDC RB_Val_Wu8 1.000 OneToOne 0.00 1.000 FORMAT "%5.3" EXTENDED_LIMITS 0.00 255.0 /end CHARACTERISTIC
/begin CHARACTERISTIC Sia_swtExCodUpdt_C "To enable or disable direct Excode writing in Gen6." VALUE 0x80533CDD RB_Val_Wu8 1.000 OneToOne 0.00 1.000 FORMAT "%5.3" EXTENDED_LIMITS 0.00 255.0 /end CHARACTERISTIC
/begin CHARACTERISTIC Sia_swtIgnLckEep_C "Immobiliser switch to determine whether to use previous learnt value of ignition status" VALUE 0x80533CDE RB_Val_Wu8 1.000 OneToOne 0.00 1.000 FORMAT "%5.3" EXTENDED_LIMITS 0.00 255.0 /end CHARACTERISTIC
/begin CHARACTERISTIC Sia_swtImsVal_C "Switch to select type of immobilizer system" VALUE 0x80533CDF RB_Val_Wu8 1.000 OneToOne 0.00 1.000 FORMAT "%5.3" EXTENDED_LIMITS 0.00 255.0 /end CHARACTERISTIC
/begin CHARACTERISTIC Sia_tiExRegTmrBMax_C "Max Timer to check the Excode Registration process in Gen6." VALUE 0x80533CE0 RB_Val_Ws16 32770.00 Time_ms 0.00 32770.00 FORMAT "%8.2" EXTENDED_LIMITS -327680.0 327670.0 /end CHARACTERISTIC
/begin CHARACTERISTIC Sia_tiTmrBMax_C "Timer to determine the maximum time for communication between Immobilizer and ECU" VALUE 0x80533CE2 RB_Val_Ws16 32770.00 Time_ms 0.00 32770.00 FORMAT "%8.2" EXTENDED_LIMITS -327680.0 327670.0 /end CHARACTERISTIC
/begin CHARACTERISTIC Signals_Mode1Pid_CA "Array welches alle konfigurierten PID Nummer für Signals beinhaltet (read-only für GS)." VAL_BLK 0x8053B168 ValA_Wu8 255.0 OneToOne 0.00 255.0 FORMAT "%5.1" READ_ONLY NUMBER 243 /end CHARACTERISTIC
/begin CHARACTERISTIC Signals_Mode1SigNum_CA "Array welches die zu Signals_Mode1Pid_CA gehörenden Signalnummern beinhaltet (read-only für GS)." VAL_BLK 0x8053B25C ValA_Wu16 782.000000000 Signals_IntSigNumVerb 0.00 782.000000000 FORMAT "%13.9" READ_ONLY NUMBER 243 /end CHARACTERISTIC
/begin CHARACTERISTIC Signals_stSrv01SuppPid_CA "Array welches alle konfigurierten PID Nummer für Signals beinhaltet (nur GS)." VAL_BLK 0x8053B442 ValA_Wu16 172.000000000 Signals_PidVerbSupp 0.00 172.000000000 FORMAT "%13.9" NUMBER 243 /end CHARACTERISTIC
/begin CHARACTERISTIC SpdGov_dfacDistCtOff_C "gradient for dynamic distribution factor at fuel cut off" VALUE 0x805343FC RB_Val_Ws32 499.500000849 Rmp_Fact 0.499999151 500.000000000 FORMAT "%13.9" EXTENDED_LIMITS -4000.00000000 3999.99999814 /end CHARACTERISTIC
/begin CHARACTERISTIC SpdGov_dtrqMax_C "maximum gradient for stationary part of speed controller torque" VALUE 0x80534400 RB_Val_Ws32 3276799.99847 RmpTrq 0.00 3276799.99847 FORMAT "%13.5" EXTENDED_LIMITS -3276800.00000 3276799.99847 /end CHARACTERISTIC
/begin CHARACTERISTIC SpdGov_facCompRmpDwn_C "step width of the ramp for accessory compensation during idling when ramping downwards" VALUE 0x805343CC RB_Val_Wu8 0.9922 fak_ub_b1 0.0039 0.9961 EXTENDED_LIMITS 0.00 0.9961 /end CHARACTERISTIC
/begin CHARACTERISTIC SpdGov_facCompRmpGrip_C "Step width of the ramp for accessory compensation during idling with closed power train" VALUE 0x805343CD RB_Val_Wu8 0.9922 fak_ub_b1 0.0039 0.9961 EXTENDED_LIMITS 0.00 0.9961 /end CHARACTERISTIC
/begin CHARACTERISTIC SpdGov_facCompRmpNoGrip_C "Step width of the ramp for accessory compensation during idling with open power train" VALUE 0x805343CE RB_Val_Wu8 0.9922 fak_ub_b1 0.0039 0.9961 EXTENDED_LIMITS 0.00 0.9961 /end CHARACTERISTIC
/begin CHARACTERISTIC SpdGov_facComp_CUR "compensation factor during idling" CURVE 0x805343D0 RB_Curve_S16_U16_Static 1.000000 fak_uw_b2 0.00 1.000000 FORMAT "%8.6" EXTENDED_LIMITS 0.00 1.999969
 /begin AXIS_DESCR STD_AXIS SpdGov_facThrStabComp fak_sw_b4 9 -4.000000 3.999878 FORMAT "%8.6" DEPOSIT ABSOLUTE /end AXIS_DESCR
/end CHARACTERISTIC
/begin CHARACTERISTIC SpdGov_facCorIniINLim_CUR "delta-correction for install of I-Part" CURVE 0x805341E8 RB_Curve_S16_U16_Static 1.999969 fak_uw_b2 0.00 1.999969 FORMAT "%8.6"
 /begin AXIS_DESCR STD_AXIS SpdGov_dnFlt EngNGrd 4 -16384.00 16383.50 FORMAT "%8.2" DEPOSIT ABSOLUTE /end AXIS_DESCR
/end CHARACTERISTIC
/begin CHARACTERISTIC SpdGov_facTrqDynDist_C "factor for distribution of dynamic speed controller torque between engine and electric motor" VALUE 0x80534404 RB_Val_Ws16 1.000000 Fact 0.00 1.000000 FORMAT "%8.6" EXTENDED_LIMITS -4.000000 3.999878 /end CHARACTERISTIC
/begin CHARACTERISTIC SpdGov_flgSwtNGrdt_C "flag for filtered engine speed gradient selection switch" VALUE 0x805341FA RB_Val_Wboolean 1.00000000000 B_TRUE 0.00 1.00000000000 FORMAT "%13.11" /end CHARACTERISTIC
/begin CHARACTERISTIC SpdGov_KiNMaxLimTipp_MAP "Integral gain of maximum rpm control for gear lever in TIPP position" MAP 0x805341FC RB_MapGroup_U16 19.99939 q3p052Em4_min_Nm_DIV_s 0.00031 19.99969 FORMAT "%8.5" EXTENDED_LIMITS 0.00 19.99969
 /begin AXIS_DESCR COM_AXIS HLSDem_nSetPHi nmot_sw_q0p5 4 -16384.00 16383.50 FORMAT "%8.2" AXIS_PTS_REF SpdGov_nSetPHi_DST /end AXIS_DESCR
 /begin AXIS_DESCR COM_AXIS Tra_numGear OneToOne 9 -128.0 127.0 FORMAT "%5.1" AXIS_PTS_REF SpdGov_numGear_DST /end AXIS_DESCR
/end CHARACTERISTIC
/begin CHARACTERISTIC SpdGov_KiNMaxLim_MAP "Integral gain of maximum rpm control" MAP 0x80534244 RB_MapGroup_U16 19.99939 q3p052Em4_min_Nm_DIV_s 0.00031 19.99969 FORMAT "%8.5" EXTENDED_LIMITS 0.00 19.99969
 /begin AXIS_DESCR COM_AXIS HLSDem_nSetPHi nmot_sw_q0p5 4 -16384.00 16383.50 FORMAT "%8.2" AXIS_PTS_REF SpdGov_nSetPHi_DST /end AXIS_DESCR
 /begin AXIS_DESCR COM_AXIS Tra_numGear OneToOne 9 -128.0 127.0 FORMAT "%5.1" AXIS_PTS_REF SpdGov_numGear_DST /end AXIS_DESCR
/end CHARACTERISTIC
/begin CHARACTERISTIC SpdGov_KpNMaxLimTipp_MAP "Proportionall gain of maximum rpm control for gear lever in TIPP position" MAP 0x8053428C RB_MapGroup_U16 199.9969 q3p05175Em3_min_Nm 0.00 199.9969 FORMAT "%8.4"
 /begin AXIS_DESCR COM_AXIS HLSDem_nSetPHi nmot_sw_q0p5 4 -16384.00 16383.50 FORMAT "%8.2" AXIS_PTS_REF SpdGov_nSetPHi_DST /end AXIS_DESCR
 /begin AXIS_DESCR COM_AXIS Tra_numGear OneToOne 9 -128.0 127.0 FORMAT "%5.1" AXIS_PTS_REF SpdGov_numGear_DST /end AXIS_DESCR
/end CHARACTERISTIC
/begin CHARACTERISTIC SpdGov_KpNMaxLim_MAP "Proportional gain of maximum rpm control" MAP 0x805342D4 RB_MapGroup_U16 199.9969 q3p05175Em3_min_Nm 0.00 199.9969 FORMAT "%8.4"
 /begin AXIS_DESCR COM_AXIS HLSDem_nSetPHi nmot_sw_q0p5 4 -16384.00 16383.50 FORMAT "%8.2" AXIS_PTS_REF SpdGov_nSetPHi_DST /end AXIS_DESCR
 /begin AXIS_DESCR COM_AXIS Tra_numGear OneToOne 9 -128.0 127.0 FORMAT "%5.1" AXIS_PTS_REF SpdGov_numGear_DST /end AXIS_DESCR
/end CHARACTERISTIC
/begin CHARACTERISTIC SpdGov_MaskTstrLimCutOff_C "Mask for cut off limitation by tester" VALUE 0x8053431C RB_Val_Wu8 255.0 OneToOne 0.00 255.0 FORMAT "%5.1" /end CHARACTERISTIC
/begin CHARACTERISTIC SpdGov_nDeltaFstTrqRed_C "Deviation of engine speed, when faster reduction of torque is started" VALUE 0x8053431E RB_Val_Ws16 16384.00 nmot_sw_q0p5 -16384.00 0.00 FORMAT "%8.2" EXTENDED_LIMITS -16384.00 16383.50 /end CHARACTERISTIC
/begin CHARACTERISTIC SpdGov_nDeltaMinTrq_C "Deviation of engine speed, when min. torque is demanded" VALUE 0x80534320 RB_Val_Ws16 16384.00 nmot_sw_q0p5 -16384.00 0.00 FORMAT "%8.2" EXTENDED_LIMITS -16384.00 16383.50 /end CHARACTERISTIC
/begin CHARACTERISTIC SpdGov_nDeltaStopNLim_C "Deviation of maximum and actual engine speed for switch-off rpm control" VALUE 0x80534322 RB_Val_Ws16 32767.50 nmot_sw_q0p5 -16384.00 16383.50 FORMAT "%8.2" /end CHARACTERISTIC
/begin CHARACTERISTIC SpdGov_nDiffASDPrioStal_C "difference engine speed for idle detection" VALUE 0x80534406 RB_Val_Ws16 16383.50 EngN 0.00 16383.50 FORMAT "%8.2" EXTENDED_LIMITS -16384.00 16383.50 /end CHARACTERISTIC
/begin CHARACTERISTIC SpdGov_nDiffASDPrio_C "difference speed for ASD-priority" VALUE 0x80534408 RB_Val_Ws16 16383.50 EngN 0.00 16383.50 FORMAT "%8.2" EXTENDED_LIMITS -16384.00 16383.50 /end CHARACTERISTIC
/begin CHARACTERISTIC SpdGov_nLowrThdIncTqAirPah_C "Lower threshold of the predicted engine-speed for the increase of permissible torque on lead-path" VALUE 0x80534324 RB_Val_Ws16 32767.50 nmot_sw_q0p5 -16384.00 16383.50 FORMAT "%8.2" /end CHARACTERISTIC
/begin CHARACTERISTIC SpdGov_NMaxLim_CW "code word for limitation od engine speed" VALUE 0x80534326 RB_Val_Wu8 255.0 dez 0.00 255.0 FORMAT "%5.1" /end CHARACTERISTIC
/begin CHARACTERISTIC SpdGov_nMax_C "engine-speed limitation, transient limit" VALUE 0x80534328 RB_Val_Ws16 32767.50 nmot_sw_q0p5 -16384.00 16383.50 FORMAT "%8.2" /end CHARACTERISTIC
/begin CHARACTERISTIC SpdGov_nMinASDPrio_C "Minimum engine speed for ASD-priority" VALUE 0x8053440A RB_Val_Ws16 32767.50 EngN -16384.00 16383.50 FORMAT "%8.2" /end CHARACTERISTIC
/begin AXIS_PTS SpdGov_nSetPHi_DST "dase point distribution desired engine speed" 0x8053432A HLSDem_nSetPHi RB_Axis_S16 32767.50 nmot_sw_q0p5 4 -16384.00 16383.50 FORMAT "%8.2" DEPOSIT ABSOLUTE /end AXIS_PTS
/begin AXIS_PTS SpdGov_numGear_DST "dase point distribution gear" 0x80534334 Tra_numGear RB_Axis_S8 255.0 OneToOne 9 -128.0 127.0 FORMAT "%5.1" DEPOSIT ABSOLUTE /end AXIS_PTS
/begin CHARACTERISTIC SpdGov_nUpprThdIncTqAirPah_C "Upper threshold of the predicted engine-speed for the increase of permissible torque on lead-path" VALUE 0x8053433E RB_Val_Ws16 32767.50 nmot_sw_q0p5 -16384.00 16383.50 FORMAT "%8.2" /end CHARACTERISTIC
/begin CHARACTERISTIC SpdGov_rAppThdTqAirPah_C "Threshold of the accelerator pedal position for the increase of permissible torque on lead-path" VALUE 0x80534340 RB_Val_Ws16 799.9878 Prc -400.0000 399.9878 FORMAT "%8.4" /end CHARACTERISTIC
/begin CHARACTERISTIC SpdGov_rASDPrio_C "acceleration pedal position for ASD priority" VALUE 0x8053440C RB_Val_Ws16 100.0000 Prc 0.00 100.0000 FORMAT "%8.4" EXTENDED_LIMITS -400.0000 399.9878 /end CHARACTERISTIC
/begin CHARACTERISTIC SpdGov_swtASDPrio_CW "Code word for the activation conditions for ASD prioritization" VALUE 0x8053440E RB_Val_Wu8 255.0 OneToOne 0.00 255.0 FORMAT "%5.1" /end CHARACTERISTIC
/begin CHARACTERISTIC SpdGov_tiDlyNeutGear_C "Delay time for detection of neutral gear" VALUE 0x80534342 RB_Val_Wu8 2.550 t_q0p01 0.00 2.550 FORMAT "%5.3" /end CHARACTERISTIC
/begin CHARACTERISTIC SpdGov_tiFltASDPrio_C "Time constant of PT1 filter for obtaining the torque of the idle speed controller at the driveaway clutch when ASDPrio is activated" VALUE 0x80534410 RB_Val_Ws32 4294.9672940000000 TimeDelay_s 0.0000020000000 4294.9672959999998 FORMAT "%19.14" EXTENDED_LIMITS 0.000002000000001 4294.9672959999998 /end CHARACTERISTIC
/begin CHARACTERISTIC SpdGov_tiFlt_C "time constant PT1-filter for stationary part of speed controller torque" VALUE 0x80534414 RB_Val_Ws32 4294.9672940000000 TimeDelay_s 0.0000020000000 4294.9672959999998 FORMAT "%19.14" EXTENDED_LIMITS 0.000002000000001 4294.9672959999998 /end CHARACTERISTIC
/begin CHARACTERISTIC SpdGov_tiHldIncTqAirPah_C "Maximum time, in which increase of permissible torque on lead-path is active" VALUE 0x80534343 RB_Val_Wu8 2.550 t_q0p01 0.00 2.550 FORMAT "%5.3" /end CHARACTERISTIC
/begin CHARACTERISTIC SpdGov_tiNMaxPrdcTipp_CUR "Time for engine speed prediction of rpm control for gear lever position TIPP" CURVE 0x80534344 RB_Curve_S8_S16_Static 5.100000 t20msxs_ub_b5p1 0.00 5.100000 FORMAT "%8.6" EXTENDED_LIMITS -655.3600 655.3400
 /begin AXIS_DESCR STD_AXIS Tra_numGear OneToOne 9 -128.0 127.0 FORMAT "%5.1" DEPOSIT ABSOLUTE /end AXIS_DESCR
/end CHARACTERISTIC
/begin CHARACTERISTIC SpdGov_tiNMaxPrdc_CUR "Time for engine speed prediction of rpm control" CURVE 0x80534360 RB_Curve_S8_S16_Static 5.100000 t20msxs_ub_b5p1 0.00 5.100000 FORMAT "%8.6" EXTENDED_LIMITS -655.3600 655.3400
 /begin AXIS_DESCR STD_AXIS Tra_numGear OneToOne 9 -128.0 127.0 FORMAT "%5.1" DEPOSIT ABSOLUTE /end AXIS_DESCR
/end CHARACTERISTIC
/begin CHARACTERISTIC SpdGov_tiStrtEnd_C "Time after end of engine start for the suppression of the P-part in SpdGov_trqFlt during poststart" VALUE 0x805343F6 RB_Val_Ws8 40.80 TimeRed -20.48 20.32 FORMAT "%5.2" /end CHARACTERISTIC
/begin CHARACTERISTIC SpdGov_tiTrqFlt_C "time constant for filtered engine speed control torque" VALUE 0x805343F8 RB_Val_Wu16 7.999756 t_q0p000122 0.000122 7.999878 FORMAT "%8.6" EXTENDED_LIMITS 0.00 7.999878 /end CHARACTERISTIC
/begin CHARACTERISTIC SpdGov_trqASDPrio_C "driver torque for ASD-priority" VALUE 0x80534418 RB_Val_Ws16 6553.500 Trq -3276.800 3276.700 FORMAT "%8.3" /end CHARACTERISTIC
/begin CHARACTERISTIC SpdGov_TrqDist_CW "codeword: configuration speed governor torque distribution" VALUE 0x8053441A RB_Val_Wu8 255.0 OneToOne 0.00 255.0 FORMAT "%5.1" /end CHARACTERISTIC
/begin CHARACTERISTIC SpdGov_trqIniINMaxLimTipp_MAP "Map for max. initialization value of I-part for gear lever position TIPP" MAP 0x8053437C RB_MapGroup_U8 816.0 md_ub_q3p2 0.00 816.0 FORMAT "%5.1"
 /begin AXIS_DESCR COM_AXIS HLSDem_nSetPHi nmot_sw_q0p5 4 -16384.00 16383.50 FORMAT "%8.2" AXIS_PTS_REF SpdGov_nSetPHi_DST /end AXIS_DESCR
 /begin AXIS_DESCR COM_AXIS Tra_numGear OneToOne 9 -128.0 127.0 FORMAT "%5.1" AXIS_PTS_REF SpdGov_numGear_DST /end AXIS_DESCR
/end CHARACTERISTIC
/begin CHARACTERISTIC SpdGov_trqIniINMaxLim_MAP "Map for max. initialization value of I-part" MAP 0x805343A0 RB_MapGroup_U8 816.0 md_ub_q3p2 0.00 816.0 FORMAT "%5.1"
 /begin AXIS_DESCR COM_AXIS HLSDem_nSetPHi nmot_sw_q0p5 4 -16384.00 16383.50 FORMAT "%8.2" AXIS_PTS_REF SpdGov_nSetPHi_DST /end AXIS_DESCR
 /begin AXIS_DESCR COM_AXIS Tra_numGear OneToOne 9 -128.0 127.0 FORMAT "%5.1" AXIS_PTS_REF SpdGov_numGear_DST /end AXIS_DESCR
/end CHARACTERISTIC
/begin CHARACTERISTIC SpdGov_trqMaxLimInteg_C "maximum value for I-Anteil" VALUE 0x805343C4 RB_Val_Ws16 3276.700 md_sw_q0p1 0.00 3276.700 FORMAT "%8.3" EXTENDED_LIMITS -3276.800 3276.700 /end CHARACTERISTIC
/begin CHARACTERISTIC SpdGov_trqMinLimInteg_C "minimum value for I-Anteil" VALUE 0x805343C6 RB_Val_Ws16 6553.500 md_sw_q0p1 -3276.800 3276.700 FORMAT "%8.3" /end CHARACTERISTIC
/begin CHARACTERISTIC SpdGov_trqOfsMin_C "offset for SpdGov minimal torque" VALUE 0x8053441C RB_Val_Ws16 3276.700 Trq 0.00 3276.700 FORMAT "%8.3" EXTENDED_LIMITS -3276.800 3276.700 /end CHARACTERISTIC
/begin CHARACTERISTIC SpdGov_vThdTqAirPah_C "Threshold of the vehicle speed for the increase of permissible torque on lead-path" VALUE 0x805343C8 RB_Val_Ws16 655.3500 Vel -327.6800 327.6700 FORMAT "%8.4" /end CHARACTERISTIC
/begin CHARACTERISTIC SrvCSwt_tiSwtDebHiLo_C "High to Low debounce time for switch input status." VALUE 0x80534420 RB_Val_Ws16 655350.0 TimeDeb -327680.0 327670.0 FORMAT "%8.1" /end CHARACTERISTIC
/begin CHARACTERISTIC SrvCSwt_tiSwtDebLoHi_C "Low to High debounce time for switch input status." VALUE 0x80534422 RB_Val_Ws16 655350.0 TimeDeb -327680.0 327670.0 FORMAT "%8.1" /end CHARACTERISTIC
/begin CHARACTERISTIC SSEUI_stFirstEngStrtSeln_C "First engine start selection parameter for display" VALUE 0x80533CE4 RB_Val_Wu8 1.00000000000 B_TRUE 0.00 1.00000000000 FORMAT "%13.11" /end CHARACTERISTIC
/begin CHARACTERISTIC SSEUI_stMktSelnSwt_C "Market selection switch for MT variant(for EU market and non EU market)" VALUE 0x80533CE5 RB_Val_Wu8 1.00000000000 B_TRUE 0.00 1.00000000000 FORMAT "%13.11" /end CHARACTERISTIC
/begin CHARACTERISTIC SSEUI_stMode05FlgRstMsk_C "Mask for EPS and brake booster request" VALUE 0x80533CE8 RB_Val_Wu32 4294967295.00 OneToOne 0.00 4294967295.00 FORMAT "%13.2" /end CHARACTERISTIC
/begin CHARACTERISTIC SSEUI_stMsk1_C "calibration to mask the stop Release Display message" VALUE 0x80533CEC RB_Val_Wu32 4294967295.00 OneToOne 0.00 4294967295.00 FORMAT "%13.2" /end CHARACTERISTIC
/begin CHARACTERISTIC SSEUI_stSwtACCdnByp_C "Calibration to bypass AC condition for mode12h" VALUE 0x80533CF0 RB_Val_Wu8 1.00000000000 B_TRUE 0.00 1.00000000000 FORMAT "%13.11" /end CHARACTERISTIC
/begin CHARACTERISTIC SSEUI_stSwtMIDDsbl_C "CAlibration switch to disable MID" VALUE 0x80533CF1 RB_Val_Wu8 1.00000000000 B_TRUE 0.00 1.00000000000 FORMAT "%13.11" /end CHARACTERISTIC
/begin CHARACTERISTIC SSEUI_swtSTSReq_C "Calibration to select Starter ON instruction by STS starting request" VALUE 0x80533CF2 RB_Val_Wu8 1.00000000000 B_TRUE 0.00 1.00000000000 FORMAT "%13.11" /end CHARACTERISTIC
/begin CHARACTERISTIC SSEUI_tiACDly120s_C "Calibration for AC delay 120s" VALUE 0x80533CF4 RB_Val_Ws16 32767.00 Time_Second 0.00 32767.00 FORMAT "%8.2" EXTENDED_LIMITS -32768.00 32767.00 /end CHARACTERISTIC
/begin CHARACTERISTIC SSEUI_tiACDly6s_C "Calibration for AC delay 6s" VALUE 0x80533CF6 RB_Val_Ws16 32767.00 Time_Second 0.00 32767.00 FORMAT "%8.2" EXTENDED_LIMITS -32768.00 32767.00 /end CHARACTERISTIC
/begin CHARACTERISTIC SSEUI_tiBrkPedStrtReqDly_C "Delay for start request by reduction of brake negative pressure." VALUE 0x80533CF8 RB_Val_Ws16 655.3500 Time_s -327.6800 327.6700 FORMAT "%8.4" /end CHARACTERISTIC
/begin CHARACTERISTIC SSEUI_tiCANErrMask_C "Reset value for the IG2 mask during engine cranking." VALUE 0x80533CFA RB_Val_Ws16 655.3500 Time_s -327.6800 327.6700 FORMAT "%8.4" /end CHARACTERISTIC
/begin CHARACTERISTIC SSEUI_tiCluChkDly_C "Delay time for checking clutch display information conditions" VALUE 0x80533CFC RB_Val_Wu8 2.550 Time_s 0.00 2.550 FORMAT "%5.3" /end CHARACTERISTIC
/begin CHARACTERISTIC SSEUI_tiDispEndDly_C "Calibration threshold for pre indication delay" VALUE 0x80533CFE RB_Val_Ws16 327.6700 Time_s 0.00 327.6700 FORMAT "%8.4" EXTENDED_LIMITS -327.6800 327.6700 /end CHARACTERISTIC
/begin CHARACTERISTIC SSEUI_tiDispTime_C "Display time duration for MID" VALUE 0x80533D00 RB_Val_Ws16 327.6700 Time_s 0.00 327.6700 FORMAT "%8.4" EXTENDED_LIMITS -327.6800 327.6700 /end CHARACTERISTIC
/begin CHARACTERISTIC SSEUI_tiDlySeatBlt_C "Delay after seat belt unlathc and before clutch press indication on MID" VALUE 0x80533D02 RB_Val_Ws16 327.6700 Time_s 0.00 327.6700 FORMAT "%8.4" EXTENDED_LIMITS -327.6800 327.6700 /end CHARACTERISTIC
/begin CHARACTERISTIC SSEUI_tiInGearDly_C "Delay before the display change to neutral gear" VALUE 0x80533D04 RB_Val_Ws16 327.6700 Time_s 0.00 327.6700 FORMAT "%8.4" EXTENDED_LIMITS -327.6800 327.6700 /end CHARACTERISTIC
/begin CHARACTERISTIC SSEUI_tiInitChkDly_C "Initial bulb check delay" VALUE 0x80533D06 RB_Val_Ws16 327.6700 Time_s 0.00 327.6700 FORMAT "%8.4" EXTENDED_LIMITS -327.6800 327.6700 /end CHARACTERISTIC
/begin CHARACTERISTIC SSEUI_tiISGoJudDly_C "Time delay to check Idle stop release conditions once trigger conditions are available for AT or CVT" VALUE 0x80533D08 RB_Val_Ws16 327.6700 Time_s 0.00 327.6700 FORMAT "%8.4" EXTENDED_LIMITS -327.6800 327.6700 /end CHARACTERISTIC
/begin CHARACTERISTIC SSEUI_tiRstrtReqVehCdnDly_C "calibratable time delay for debouncing restart request by vehicle condition" VALUE 0x80533D0A RB_Val_Ws16 327.6700 Time_s 0.00 327.6700 FORMAT "%8.4" EXTENDED_LIMITS -327.6800 327.6700 /end CHARACTERISTIC
/begin CHARACTERISTIC SSEUI_tiVehCdnStopTrigDly_C "Time delay to check Idle stop release conditions once trigger conditions are available" VALUE 0x80533D0C RB_Val_Ws16 327.6700 Time_s 0.00 327.6700 FORMAT "%8.4" EXTENDED_LIMITS -327.6800 327.6700 /end CHARACTERISTIC
/begin CHARACTERISTIC StatyCoorn_flgEnaBypCmpdTq_C "Calibration for flag to enable bypass compensated torque for ASD filter" VALUE 0x80534425 RB_Val_Wboolean 1.00000000000 B_TRUE 0.00 1.00000000000 FORMAT "%13.11" /end CHARACTERISTIC
/begin CHARACTERISTIC StbIntv_stAYCFISSInhbReq_C "VSA Inhibit Request" VALUE 0x8053445C RB_Val_Wu8 1.000 OneToOne 0.00 1.000 FORMAT "%5.3" EXTENDED_LIMITS 0.00 255.0 /end CHARACTERISTIC
/begin CHARACTERISTIC TEMN "minimum effective injection time" VALUE 0x80533BFA RB_Val_Wu16 65.53500 t1p0usxms 0.00 65.53500 FORMAT "%8.5" /end CHARACTERISTIC
/begin CHARACTERISTIC TEMNVA "minimum effective injection time at VA (deceleration enleanment)" VALUE 0x80533BFC RB_Val_Wu16 65.53500 t1p0usxms 0.00 65.53500 FORMAT "%8.5" /end CHARACTERISTIC
/begin CHARACTERISTIC TMEAdpn_tGbxOilAdpnMin_T "Converter oil temperature threshold for torque loss adaptation release" CURVE 0x80533C96 RB_Curve_S16_S16 6553.500 Temp_Cels -3549.940 3003.560 FORMAT "%8.3"
 /begin AXIS_DESCR STD_AXIS EnvT_t Temp_Cels 4 -3549.940 3003.560 FORMAT "%8.3" DEPOSIT ABSOLUTE /end AXIS_DESCR
/end CHARACTERISTIC
/begin CHARACTERISTIC TMLIM "TMOT threshold for KSTAA active at after start" VALUE 0x80533F33 RB_Val_Wu8 191.3 temp_ub_q0p75_o48 -48.0 143.3 FORMAT "%5.1" /end CHARACTERISTIC
/begin CHARACTERISTIC TVDK "delay time after closing of the throttle" VALUE 0x805341B9 RB_Val_Wu8 5.100 t_q0p02 0.00 5.100 FORMAT "%5.3" /end CHARACTERISTIC
/begin CHARACTERISTIC TVDNOZW "time for delta engine speed without ignition angle intervention" VALUE 0x805343CA RB_Val_Wu16 655.3500 t_q0p01 0.00 655.3500 FORMAT "%8.4" /end CHARACTERISTIC
/begin CHARACTERISTIC TVLLRPST "delay to disable proportional parameter in start" VALUE 0x805341BA RB_Val_Wu8 5.100 t_q0p02 0.00 5.100 FORMAT "%5.3" /end CHARACTERISTIC
/begin CHARACTERISTIC TVUBAT "Delay time of injection valves, dependant on battery voltage" CURVE 0x80533BFE RB_Curve_U8_U16_Static 65.53500 t1p0usxms 0.00 65.53500 FORMAT "%8.5"
 /begin AXIS_DESCR STD_AXIS InjSys_uBatLoc spg_q0p1 5 0.00 25.50 FORMAT "%5.2" DEPOSIT ABSOLUTE /end AXIS_DESCR
/end CHARACTERISTIC
/begin CHARACTERISTIC ZBURNABR "number of combustions for decision adaptation stop" VALUE 0x80533F34 RB_Val_Wu8 255.0 dez 0.00 255.0 FORMAT "%5.1" /end CHARACTERISTIC
/begin CHARACTERISTIC ZRKTAEV "Time constant Filtered air temperature at inlet valve" VALUE 0x80533C0E RB_Val_Wu16 6553.400 t_q0p1 0.100 6553.500 FORMAT "%8.3" EXTENDED_LIMITS 0.00 6553.500 /end CHARACTERISTIC
/begin CHARACTERISTIC ZSYAUSWINC "number of ignitions for faster analyse during increment" VALUE 0x80533F35 RB_Val_Wu8 255.0 dez 0.00 255.0 FORMAT "%5.1" /end CHARACTERISTIC
/begin CHARACTERISTIC ZSYNAUSW "number of ignitions until evaluation" VALUE 0x80533F36 RB_Val_Wu8 255.0 dez 0.00 255.0 FORMAT "%5.1" /end CHARACTERISTIC
/begin CHARACTERISTIC ZSYNCHECKN "number of ignitions until check start success with nmot" VALUE 0x80533F37 RB_Val_Wu8 255.0 dez 0.00 255.0 FORMAT "%5.1" /end CHARACTERISTIC
/begin CHARACTERISTIC ZSYNDEL "Number of unused combustions for combustion detection" VALUE 0x80533F38 RB_Val_Wu8 255.0 dez 0.00 255.0 FORMAT "%5.1" /end CHARACTERISTIC
/begin CHARACTERISTIC ZYLCRKMN "lower limit rk-correction" VALUE 0x80533C10 RB_Val_Wu8 1.992188 fak_ub_b2 0.00 1.992188 FORMAT "%8.6" /end CHARACTERISTIC
/begin CHARACTERISTIC ZYLCRKMX "upper limit rk-correction" VALUE 0x80533C11 RB_Val_Wu8 1.992188 fak_ub_b2 0.00 1.992188 FORMAT "%8.6" /end CHARACTERISTIC
/begin MEASUREMENT adapdec_w "decrement adaptation steps" SWORD fak_q0p0009766 1 100 -32.00000 31.99902 FORMAT "%8.5" ECU_ADDRESS 0x70001720 /end MEASUREMENT
/begin MEASUREMENT adapinc_w "increment adaptation steps" SWORD fak_q0p0009766 1 100 -32.00000 31.99902 FORMAT "%8.5" ECU_ADDRESS 0x7000171E /end MEASUREMENT
/begin MEASUREMENT adastepc_w "configured adaptation steps of STADAP" SWORD fak_q0p0009766 1 100 -32.00000 31.99902 FORMAT "%8.5" ECU_ADDRESS 0x7000171C /end MEASUREMENT
/begin MEASUREMENT adasteps "sum of adaptation steps of STADAP" SBYTE fak_sb_b2 1 100 -2.000 1.984 FORMAT "%5.3" ECU_ADDRESS 0x7000171A /end MEASUREMENT
/begin MEASUREMENT adastep_w "adaptation steps of STADAP" SWORD fak_q0p0009766 1 100 -32.00000 31.99902 FORMAT "%8.5" ECU_ADDRESS 0x70001718 /end MEASUREMENT
/begin MEASUREMENT B_adapend "end of starting fuel adaptation" UBYTE B_TRUE 1 100 0.00 1.00000000000 BIT_MASK 0x1 FORMAT "%13.11" ECU_ADDRESS 0x70000136 /end MEASUREMENT
/begin MEASUREMENT B_ad_msg "Condition adaptation permitted" UBYTE B_TRUE 1 100 0.00 1.00000000000 BIT_MASK 0x1 FORMAT "%13.11" ECU_ADDRESS 0x70000AC2 /end MEASUREMENT
/begin MEASUREMENT B_ausw "Condition evaluation of combustions" UBYTE B_TRUE 1 100 0.00 1.00000000000 BIT_MASK 0x1 FORMAT "%13.11" ECU_ADDRESS 0x70000135 /end MEASUREMENT
/begin MEASUREMENT B_badburn "detection of bad combustion" UBYTE B_TRUE 1 100 0.00 1.00000000000 BIT_MASK 0x1 FORMAT "%13.11" ECU_ADDRESS 0x70000134 /end MEASUREMENT
/begin MEASUREMENT B_enllri_msg "enable integrator: idle speed controller" UBYTE B_TRUE 1 100 0.00 1.00000000000 BIT_MASK 0x1 FORMAT "%13.11" ECU_ADDRESS 0x70000A78 /end MEASUREMENT
/begin MEASUREMENT B_incmxres_msg "reset at max-increment stop of adaptation" UBYTE B_TRUE 1 100 0.00 1.00000000000 BIT_MASK 0x1 FORMAT "%13.11" ECU_ADDRESS 0x70000A2B /end MEASUREMENT
/begin MEASUREMENT B_kstaue "adaption value of start quantity valid at next start" UBYTE B_TRUE 1 100 0.00 1.00000000000 BIT_MASK 0x1 FORMAT "%13.11" ECU_ADDRESS 0x70000133 /end MEASUREMENT
/begin MEASUREMENT B_llrein_msg "Idle speed ready to be put into operation after start" UBYTE B_TRUE 1 100 0.00 1.00000000000 BIT_MASK 0x1 FORMAT "%13.11" ECU_ADDRESS 0x70000A04 /end MEASUREMENT
/begin MEASUREMENT B_llri_msg "Condition activation of I-part of idle speed control" UBYTE B_TRUE 1 100 0.00 1.00000000000 BIT_MASK 0x1 FORMAT "%13.11" ECU_ADDRESS 0x70000A02 /end MEASUREMENT
/begin MEASUREMENT B_llrst_msg "speed reaches nstat first time after start" UBYTE B_TRUE 1 100 0.00 1.00000000000 BIT_MASK 0x1 FORMAT "%13.11" ECU_ADDRESS 0x70000A01 /end MEASUREMENT
/begin MEASUREMENT B_llr_msg "condition idle speed control" UBYTE B_TRUE 1 100 0.00 1.00000000000 BIT_MASK 0x1 FORMAT "%13.11" ECU_ADDRESS 0x70000A05 /end MEASUREMENT
/begin MEASUREMENT B_nmax_msg "Condition engine speed limitation active" UBYTE B_TRUE 1 100 0.00 1.00000000000 BIT_MASK 0x1 FORMAT "%13.11" ECU_ADDRESS 0x6000A235 /end MEASUREMENT
/begin MEASUREMENT B_nodec "Condition no decrementation of STADAP factor during current start" UBYTE B_TRUE 1 100 0.00 1.00000000000 BIT_MASK 0x1 FORMAT "%13.11" ECU_ADDRESS 0x70000132 /end MEASUREMENT
/begin MEASUREMENT B_noinc "Condition no incrementation of STADAP factor during current start" UBYTE B_TRUE 1 100 0.00 1.00000000000 BIT_MASK 0x1 FORMAT "%13.11" ECU_ADDRESS 0x70000131 /end MEASUREMENT
/begin MEASUREMENT B_staaLoc "starting fuel adaptation active at afterstart" UBYTE B_TRUE 1 100 0.00 1.00000000000 BIT_MASK 0x1 FORMAT "%13.11" ECU_ADDRESS 0x70000130 /end MEASUREMENT
/begin MEASUREMENT B_staa_msg "starting fuel adaptation active at afterstart" UBYTE B_TRUE 1 100 0.00 1.00000000000 BIT_MASK 0x1 FORMAT "%13.11" ECU_ADDRESS 0x700009AA /end MEASUREMENT
/begin MEASUREMENT B_stadapon "condition to activate the starting fuel adaptation" UBYTE B_TRUE 1 100 0.00 1.00000000000 BIT_MASK 0x1 FORMAT "%13.11" ECU_ADDRESS 0x7000012F /end MEASUREMENT
/begin MEASUREMENT B_stano "Condition start adaptation locked" UBYTE B_TRUE 1 100 0.00 1.00000000000 BIT_MASK 0x1 FORMAT "%13.11" ECU_ADDRESS 0x7000012E /end MEASUREMENT
/begin MEASUREMENT B_vllr_msg "Condition vehicle is moving with engaged gear" UBYTE B_TRUE 1 100 0.00 1.00000000000 BIT_MASK 0x1 FORMAT "%13.11" ECU_ADDRESS 0x7000095C /end MEASUREMENT
/begin MEASUREMENT Com_flgFLWhlSpdInvld "Wheel Speed(Front Left) Validity" UBYTE B_TRUE 1 100 0.00 1.00000000000 BIT_MASK 0x1 FORMAT "%13.11" ECU_ADDRESS 0x6000A1B7 /end MEASUREMENT
/begin MEASUREMENT Com_flgFRWhlSpdInvld "Wheel Speed(Front Right) Validity" UBYTE B_TRUE 1 100 0.00 1.00000000000 BIT_MASK 0x1 FORMAT "%13.11" ECU_ADDRESS 0x6000A1B6 /end MEASUREMENT
/begin MEASUREMENT Com_flgRLWhlSpdInvld "Wheel Speed(Rear Left) Validity" UBYTE B_TRUE 1 100 0.00 1.00000000000 BIT_MASK 0x1 FORMAT "%13.11" ECU_ADDRESS 0x6000A1B3 /end MEASUREMENT
/begin MEASUREMENT Com_flgRRWhlSpdInvld "Wheel Speed(Rear Right) Validity" UBYTE B_TRUE 1 100 0.00 1.00000000000 BIT_MASK 0x1 FORMAT "%13.11" ECU_ADDRESS 0x6000A1B2 /end MEASUREMENT
/begin MEASUREMENT Com_pBrkP "Braking Pressure" SWORD p_q0p5_bar 1 100 -16384.00 16383.50 FORMAT "%8.2" ECU_ADDRESS 0x600051AC /end MEASUREMENT
/begin MEASUREMENT Com_pMstCylBrk "Master Cylinder Pressure" SLONG PresAC_hPa 1 100 -4294967296.00 4294967294.00 FORMAT "%13.2" ECU_ADDRESS 0x50004C04 /end MEASUREMENT
/begin MEASUREMENT Com_pMstCylTstr "Pressure of the brake master cylinder considering VSA CAN error" SWORD Pres_kPa_VSA 1 100 -785121.3 785097.3 FORMAT "%8.1" ECU_ADDRESS 0x600051A8 /end MEASUREMENT
/begin MEASUREMENT Com_rMulVehMotPT_MP "Measuring point for Vehicle Motor Ratio" SLONG TransR 1 100 -21474836.4800 21474836.4700 FORMAT "%13.4" ECU_ADDRESS 0x70008BB0 /end MEASUREMENT
/begin MEASUREMENT Com_stAYCFFuCtrlReq "Fuel control request signal" UBYTE OneToOne 1 100 0.00 255.0 FORMAT "%5.1" ECU_ADDRESS 0x6000A57B /end MEASUREMENT
/begin MEASUREMENT Com_stAYCFRaw "Raw value of VSA shift control request" UBYTE OneToOne 1 100 0.00 255.0 FORMAT "%5.1" ECU_ADDRESS 0x6000A57A /end MEASUREMENT
/begin MEASUREMENT Com_stAYCMonCond "Status of monitoring condition for AYC frames" UBYTE OneToOne 1 100 0.00 255.0 FORMAT "%5.1" ECU_ADDRESS 0x6000A579 /end MEASUREMENT
/begin MEASUREMENT Com_stAYCMonEna "Status of monitoring Enabling" UBYTE OneToOne 1 100 0.00 255.0 FORMAT "%5.1" ECU_ADDRESS 0x6000A578 /end MEASUREMENT
/begin MEASUREMENT Com_stEPSISSRstrtReq "ISS Restart request from EPS" UBYTE OneToOne 1 100 0.00 255.0 FORMAT "%5.1" ECU_ADDRESS 0x6000A52D /end MEASUREMENT
/begin MEASUREMENT Com_stRxAYCD "Status of AYCD Frame Reception" UBYTE OneToOne 1 100 0.00 255.0 FORMAT "%5.1" ECU_ADDRESS 0x6000A4BF /end MEASUREMENT
/begin MEASUREMENT Com_stRxAYCDChkSumOk "Status of Checksum Error in AYCD frame" UBYTE OneToOne 1 100 0.00 255.0 FORMAT "%5.1" ECU_ADDRESS 0x6000A4BE /end MEASUREMENT
/begin MEASUREMENT Com_stRxAYCDDeb "Debounced Status of AYCD Frame Reception" UBYTE OneToOne 1 100 0.00 255.0 FORMAT "%5.1" ECU_ADDRESS 0x6000A4BD /end MEASUREMENT
/begin MEASUREMENT Com_stRxAYCDOk "Error Status of AYCD Frame Reception" UBYTE OneToOne 1 100 0.00 255.0 FORMAT "%5.1" ECU_ADDRESS 0x6000A4BC /end MEASUREMENT
/begin MEASUREMENT Com_stRxAYCG "AYCG frame status" UBYTE OneToOne 1 100 0.00 255.0 FORMAT "%5.1" ECU_ADDRESS 0x6000A4BB /end MEASUREMENT
/begin MEASUREMENT Com_stRxAYCGChkSumOk "AYCG Checksum status" UBYTE OneToOne 1 100 0.00 255.0 FORMAT "%5.1" ECU_ADDRESS 0x6000A4BA /end MEASUREMENT
/begin MEASUREMENT Com_stRxAYCGDeb "AYCG Timeout status" UBYTE OneToOne 1 100 0.00 255.0 FORMAT "%5.1" ECU_ADDRESS 0x6000A4B9 /end MEASUREMENT
/begin MEASUREMENT Com_stRxAYCGOk "Error Status of AYCG Frame Reception" UBYTE OneToOne 1 100 0.00 255.0 FORMAT "%5.1" ECU_ADDRESS 0x6000A4B8 /end MEASUREMENT
/begin MEASUREMENT Com_stRxAYCGRingCntOk "AYCG Ring counter status" UBYTE OneToOne 1 100 0.00 255.0 FORMAT "%5.1" ECU_ADDRESS 0x6000A4B7 /end MEASUREMENT
/begin MEASUREMENT Com_tqCrpTqDif_MP "measurement point" SLONG TrqHigh_q0p01 1 100 -21474836.4800 21474836.4700 FORMAT "%13.4" ECU_ADDRESS 0x70008BAC /end MEASUREMENT
/begin MEASUREMENT Com_trqAYCCnvBoost_MP "Measuring point for torque AYC Boost" SLONG TrqHigh 1 100 -2147483.64800 2147483.64700 FORMAT "%13.5" ECU_ADDRESS 0x70008BA8 /end MEASUREMENT
/begin MEASUREMENT Com_trqAYCFDesRaw "Raw value of Crankshaft torque" SWORD OneToOne 1 100 -32768.00 32767.00 FORMAT "%8.2" ECU_ADDRESS 0x60005166 /end MEASUREMENT
/begin MEASUREMENT Com_trqCrpTqAxleLvl_MP "Measuring point for Torque Axle Level" SLONG TrqHigh_q0p01 1 100 -21474836.4800 21474836.4700 FORMAT "%13.4" ECU_ADDRESS 0x70008BA4 /end MEASUREMENT
/begin MEASUREMENT Com_vWhlFrntLe "Front Left Wheel Speed" UWORD vfzg_uw_b325 1 100 0.00 324.9950 FORMAT "%8.4" ECU_ADDRESS 0x60004D48 /end MEASUREMENT
/begin MEASUREMENT Com_vWhlFrntRi "Front Right Wheel Speed" UWORD vfzg_uw_b325 1 100 0.00 324.9950 FORMAT "%8.4" ECU_ADDRESS 0x60004D46 /end MEASUREMENT
/begin MEASUREMENT Com_vWhlReLe "Rear Left Wheel Speed" UWORD vfzg_uw_b325 1 100 0.00 324.9950 FORMAT "%8.4" ECU_ADDRESS 0x60004D44 /end MEASUREMENT
/begin MEASUREMENT Com_vWhlReRi "Rear Right Wheel Speed" UWORD vfzg_uw_b325 1 100 0.00 324.9950 FORMAT "%8.4" ECU_ADDRESS 0x60004D42 /end MEASUREMENT
/begin MEASUREMENT Com_vWhlSpd "Physical value of front axle speed" SWORD Vel 1 100 -327.6800 327.6700 FORMAT "%8.4" ARRAY_SIZE 4 ECU_ADDRESS 0x50005A1C /end MEASUREMENT
/begin MEASUREMENT dkstaamn_w "lower limit of current kstaa change" SWORD fak_q0p0009766 1 100 -32.00000 31.99902 FORMAT "%8.5" ECU_ADDRESS 0x70001716 /end MEASUREMENT
/begin MEASUREMENT dkstaamx_w "upper limit of current kstaa change" SWORD fak_q0p0009766 1 100 -32.00000 31.99902 FORMAT "%8.5" ECU_ADDRESS 0x70001714 /end MEASUREMENT
/begin MEASUREMENT dkstaa_w "Delta of fuel adaptation factor at current start" SWORD fak_q0p0009766 1 100 -32.00000 31.99902 FORMAT "%8.5" ECU_ADDRESS 0x70001712 /end MEASUREMENT
/begin MEASUREMENT dmllri_w_msg "desired torque change from the idle speed control (I-)" SWORD rel_sw_b100 1 100 -100.0000 99.9969 FORMAT "%8.4" ECU_ADDRESS 0x60004DE0 /end MEASUREMENT
/begin MEASUREMENT dnburns_w "Minimum difference in engine-speed for detection of combustion" SWORD nmot_sw_q0p25 1 100 -8192.000 8191.750 FORMAT "%8.3" ECU_ADDRESS 0x70001710 /end MEASUREMENT
/begin MEASUREMENT dn_w_msg "speed deviation at idle speed control" SWORD nmot_sw_q0p25 1 100 -8192.000 8191.750 FORMAT "%8.3" ECU_ADDRESS 0x70001D2A /end MEASUREMENT
/begin MEASUREMENT dppk_w_msg "Differential pressure for pressure correction of frkate_w" SWORD p_sw_q0p312 1 100 -10240.00 10239.69 FORMAT "%8.2" ECU_ADDRESS 0x60000E8A /end MEASUREMENT
/begin MEASUREMENT dpus_w_msg "delta between ambient and intake manifold pressure" SWORD p_sw_q0p078 1 100 -2560.000 2559.922 FORMAT "%8.3" ECU_ADDRESS 0x60000E86 /end MEASUREMENT
/begin MEASUREMENT dssttmst "delta of temperature to tmst base point" SBYTE temp_sb_q0p75 1 100 -96.00 95.25 FORMAT "%5.2" ECU_ADDRESS 0x7000170F /end MEASUREMENT
/begin MEASUREMENT dtemnkt_w_msg "Min-threshold for delta effective injection period" UWORD t1p0usxms 1 100 0.00 65.53500 FORMAT "%8.5" ECU_ADDRESS 0x60000DD4 /end MEASUREMENT
/begin MEASUREMENT fho_loc_stadap "Input element of KFNSTAMX" UWORD fak_ub_b4 1 100 0.00 3.984375 FORMAT "%8.6" ECU_ADDRESS 0x600035B0 /end MEASUREMENT
/begin MEASUREMENT fkrk_w_msg "Correction Factor tolerance-compensation HDEV (rk), array over all cylinders" UWORD fak_uw_b2 1 100 0.00 1.999969 FORMAT "%8.6" ARRAY_SIZE 4 ECU_ADDRESS 0x500005CC /end MEASUREMENT
/begin MEASUREMENT frkate_w_msg "Factor for conversion of rel. fuel mass rk into effective injection time te" UWORD rkti_q0p4166Em4 1 100 0.00 2.730625 FORMAT "%8.6" ECU_ADDRESS 0x50000F42 /end MEASUREMENT
/begin MEASUREMENT frlfs_w_msg "factor for ti correction at RLFS" UWORD fak_uw_b2 1 100 0.00 1.999969 FORMAT "%8.6" ECU_ADDRESS 0x60000E6E /end MEASUREMENT
/begin MEASUREMENT ftek_w_msg "factor to correct effectiv injection time" UWORD fak_uw_b2 1 100 0.00 1.999969 FORMAT "%8.6" ECU_ADDRESS 0x50000F4A /end MEASUREMENT
/begin MEASUREMENT InjSys_bMinPtdInjDurActv "Condition: TEMIN(minimal injection time) limitation active, bank 1" UBYTE B_TRUE 1 100 0.00 1.00000000000 BIT_MASK 0x1 FORMAT "%13.11" ECU_ADDRESS 0x70000733 /end MEASUREMENT
/begin MEASUREMENT InjSys_nEngRKTE "Local engine speed in RKTE" UWORD nmot_uw_q0p25 1 100 0.00 16383.75 FORMAT "%8.2" ECU_ADDRESS 0x60000B92 /end MEASUREMENT
/begin MEASUREMENT InjSys_uBatLoc "Local Battery voltage in RKTE" UBYTE spg_q0p1 1 100 0.00 25.50 FORMAT "%5.2" ECU_ADDRESS 0x60000B90 /end MEASUREMENT
/begin MEASUREMENT kstaaLoc "currently used start mixture adaptation factor" UBYTE fak_ub_b2 1 100 0.00 1.992188 FORMAT "%8.6" ECU_ADDRESS 0x7000170E /end MEASUREMENT
/begin MEASUREMENT kstaa_msg "currently used start mixture adaptation factor" UBYTE fak_ub_b2 1 100 0.00 1.992188 FORMAT "%8.6" ECU_ADDRESS 0x70001C07 /end MEASUREMENT
/begin MEASUREMENT kstaold "fuel start adaptation factor from previous starts" UBYTE fak_ub_b2 1 100 0.00 1.992188 FORMAT "%8.6" ECU_ADDRESS 0x7000170D /end MEASUREMENT
/begin MEASUREMENT kstaoldon "fuel start adaptation factor temperature dependent from previous starts" UBYTE fak_ub_b2 1 100 0.00 1.992188 FORMAT "%8.6" ECU_ADDRESS 0x7000170C /end MEASUREMENT
/begin MEASUREMENT kstatmst_msg "array of fuel adaptation factor over start temperature" UBYTE fak_ub_b2 1 100 0.00 1.992188 FORMAT "%8.6" ARRAY_SIZE 7 ECU_ADDRESS 0x60037EFA /end MEASUREMENT
/begin MEASUREMENT nmot_stadap "Engine speed local copy for STADAP" UWORD nmot_uw_q0p25 1 100 0.00 16383.75 FORMAT "%8.2" ECU_ADDRESS 0x7000170A /end MEASUREMENT
/begin MEASUREMENT nstat_loc_stadap "local copy of Stationary reference speed for STADAP" UWORD nmot_ub_q10 1 100 0.00 2550.000 FORMAT "%8.3" ECU_ADDRESS 0x600035AE /end MEASUREMENT
/begin MEASUREMENT qdnmot_w "quotient delta nmot (current/ set point)" SWORD fak_q0p015625 1 100 -512.0000 511.9844 FORMAT "%8.4" ECU_ADDRESS 0x70001708 /end MEASUREMENT
/begin MEASUREMENT rba_StopCntrWakeup_ProlongCntr "" ULONG OneToOne 1 100 0.00 4294967295.00 FORMAT "%13.2" ECU_ADDRESS 0x60001DCC /end MEASUREMENT
/begin MEASUREMENT rba_StopCntrWakeup_stIsWakeUp_u8 "Status if the ECU is in Stop Counter Wakeup Mode" UBYTE OneToOne 1 100 0.00 255.0 FORMAT "%5.1" ECU_ADDRESS 0x6000A7FE /end MEASUREMENT
/begin MEASUREMENT RngMod_bClth "state powertrain for torque adaption" UBYTE B_TRUE 1 100 0.00 1.00000000000 BIT_MASK 0x1 FORMAT "%13.11" ECU_ADDRESS 0x70000689 /end MEASUREMENT
/begin MEASUREMENT RngMod_bGenRls "release of torque adaption (generel release)" UBYTE B_TRUE 1 100 0.00 1.00000000000 BIT_MASK 0x1 FORMAT "%13.11" ECU_ADDRESS 0x70000687 /end MEASUREMENT
/begin MEASUREMENT RngMod_bRlsAdap "Switch-on condition for the torque adaption" UBYTE B_TRUE 1 100 0.00 1.00000000000 BIT_MASK 0x1 FORMAT "%13.11" ECU_ADDRESS 0x7000013A /end MEASUREMENT
/begin MEASUREMENT RngMod_flgClrAdptFlt "release flag: erase adaption values" UBYTE B_TRUE 1 100 0.00 1.00000000000 BIT_MASK 0x1 FORMAT "%13.11" ECU_ADDRESS 0x70000686 /end MEASUREMENT
/begin MEASUREMENT RngMod_flgDrvStChg "Detection of vehicle operation mode change" UBYTE B_TRUE 1 100 0.00 1.00000000000 BIT_MASK 0x1 FORMAT "%13.11" ECU_ADDRESS 0x70000139 /end MEASUREMENT
/begin MEASUREMENT RngMod_nEng_LOC "engine speed" UWORD nmot_q0p5 1 100 0.00 16383.50 FORMAT "%8.2" ECU_ADDRESS 0x70002B88 /end MEASUREMENT
/begin MEASUREMENT RngMod_nMaxDes "requested operating conditions: max. engine speed for torque adaption" SWORD nmot_q0p5 1 100 0.00 16383.50 FORMAT "%8.2" ECU_ADDRESS 0x70002C76 /end MEASUREMENT
/begin MEASUREMENT RngMod_nMinDes "requested operating conditions: min. engine speed for torque adaption" SWORD nmot_q0p5 1 100 0.00 16383.50 FORMAT "%8.2" ECU_ADDRESS 0x70002C78 /end MEASUREMENT
/begin MEASUREMENT RngMod_NumCycl "number of driving cycles without torque adaption" UBYTE dez 1 100 0.00 255.0 FORMAT "%5.1" ECU_ADDRESS 0x60036326 /end MEASUREMENT
/begin MEASUREMENT RngMod_rTrq_LOC "speed ratio" UWORD fak_q0p01 1 100 0.00 327.6700 FORMAT "%8.4" ECU_ADDRESS 0x600035D2 /end MEASUREMENT
/begin MEASUREMENT RngMod_stAdap "Status torque loss adaptation" UBYTE dez 1 100 0.00 255.0 FORMAT "%5.1" ECU_ADDRESS 0x6000A30A /end MEASUREMENT
/begin MEASUREMENT RngMod_stAddRls "additional release conditions for the adaption of friction torque" UBYTE B_TRUE 1 100 0.00 1.00000000000 BIT_MASK 0x1 FORMAT "%13.11" ECU_ADDRESS 0x70000138 /end MEASUREMENT
/begin MEASUREMENT RngMod_stDrvState "Definition of torque adaption field" UBYTE dez 1 100 0.00 255.0 FORMAT "%5.1" ECU_ADDRESS 0x6000A309 /end MEASUREMENT
/begin MEASUREMENT RngMod_stPrio "priority of requested operating point for torque adaption" UBYTE dez 1 100 0.00 255.0 FORMAT "%5.1" ECU_ADDRESS 0x70002D90 /end MEASUREMENT
/begin MEASUREMENT RngMod_tqAdpnLoss_a "Array of torque loss adaption values for several drive states in homogeneous operation mode" SWORD md_sw_q0p1 1 100 -3276.800 3276.700 FORMAT "%8.3" ARRAY_SIZE 6 ECU_ADDRESS 0x60037F2C /end MEASUREMENT
/begin MEASUREMENT RngMod_tqDmdAcsy "Sum of torque demand from accessories" SWORD md_sw_q0p1 1 100 -3276.800 3276.700 FORMAT "%8.3" ECU_ADDRESS 0x70002B8A /end MEASUREMENT
/begin MEASUREMENT RngMod_tqLossDif "unfiltered value of torque adaption" SWORD md_sw_q0p1 1 100 -3276.800 3276.700 FORMAT "%8.3" ECU_ADDRESS 0x70002B8C /end MEASUREMENT
/begin MEASUREMENT RngMod_trqAdapFlt "filtered value of torque adaption" SWORD md_sw_q0p1 1 100 -3276.800 3276.700 FORMAT "%8.3" ECU_ADDRESS 0x600035D8 /end MEASUREMENT
/begin MEASUREMENT RngMod_trqClthMin "minimum clutch torque" SWORD md_q0p1 1 100 -3276.800 0.00 FORMAT "%8.3" ECU_ADDRESS 0x6000E2BC /end MEASUREMENT
/begin MEASUREMENT RngMod_trqClthMinWoCtOff "minimum accessible torque (base torque) on clutch level" SWORD md_q0p1 1 100 -3276.800 3276.700 FORMAT "%8.3" ECU_ADDRESS 0x60004F56 /end MEASUREMENT
/begin MEASUREMENT RngMod_trqCrSLeadMax "Maximum engine torque at the crankshaft level on the lead path" SWORD md_q0p1 1 100 -3276.800 3276.700 FORMAT "%8.3" ECU_ADDRESS 0x60004F54 /end MEASUREMENT
/begin MEASUREMENT RngMod_trqCrSLeadMaxAvl "maximum engine torque - lead path (soft limit)" SWORD md_q0p1 1 100 -3276.800 3276.700 FORMAT "%8.3" ECU_ADDRESS 0x60004F52 /end MEASUREMENT
/begin MEASUREMENT RngMod_trqCrSLimLead "limiting engine torque - lead path" SWORD md_q0p1 1 100 -3276.800 3276.700 FORMAT "%8.3" ECU_ADDRESS 0x60004F4C /end MEASUREMENT
/begin MEASUREMENT RngMod_trqCrSMin "Minimum engine torque at the crankshaft level" SWORD md_q0p1 1 100 -3276.800 0.00 FORMAT "%8.3" ECU_ADDRESS 0x6000E2C0 /end MEASUREMENT
/begin MEASUREMENT RngMod_trqCrSMinWoCtOff "minimum accessible engine torque (base point)" SWORD md_q0p1 1 100 -3276.800 3276.700 FORMAT "%8.3" ECU_ADDRESS 0x60004F4A /end MEASUREMENT
/begin MEASUREMENT RngMod_trqCrSSetMax "Maximum engine torque at the crankshaft level on the set path" SWORD md_q0p1 1 100 -3276.800 3276.700 FORMAT "%8.3" ECU_ADDRESS 0x60004F48 /end MEASUREMENT
/begin MEASUREMENT RngMod_trqCrSSetMaxAvl "maximum engine torque - set path (soft limit)" SWORD md_q0p1 1 100 -3276.800 3276.700 FORMAT "%8.3" ECU_ADDRESS 0x60004F46 /end MEASUREMENT
/begin MEASUREMENT RngMod_trqCrSSetMin "minimum engine torque - set path" SWORD md_q0p1 1 100 -3276.800 3276.700 FORMAT "%8.3" ECU_ADDRESS 0x60004F44 /end MEASUREMENT
/begin MEASUREMENT RngMod_trqCrSSetMinAvl "minimum engine torque - set path (soft limit)" SWORD md_q0p1 1 100 -3276.800 3276.700 FORMAT "%8.3" ECU_ADDRESS 0x60004F42 /end MEASUREMENT
/begin MEASUREMENT RngMod_trqCrSSetMinCylFCO "Minimum engine torque considering desired value for cylinder cut-off - Set path" SWORD md_q0p1 1 100 -3276.800 3276.700 FORMAT "%8.3" ECU_ADDRESS 0x60004F40 /end MEASUREMENT
/begin MEASUREMENT RngMod_trqCrSSetMinCylFCOTraIntv "Minimum engine torque considering maximum cylinder cutoff during gearshifts" SWORD md_q0p1 1 100 -3276.800 3276.700 FORMAT "%8.3" ECU_ADDRESS 0x60004F3E /end MEASUREMENT
/begin MEASUREMENT RngMod_trqDiffAdap "Adapted difference torque loss" SWORD md_sw_q0p1 1 100 -3276.800 3276.700 FORMAT "%8.3" ECU_ADDRESS 0x6000058E /end MEASUREMENT
/begin MEASUREMENT RngMod_trqDiffAdapCalc "Adapted difference torque loss, preliminary value" SWORD md_sw_q0p1 1 100 -3276.800 3276.700 FORMAT "%8.3" ECU_ADDRESS 0x50000786 /end MEASUREMENT
/begin MEASUREMENT RngMod_trqFltACGear "filtered torque for engaged gear and AC ON (HOM)" SWORD md_sw_q0p1 1 100 -3276.800 3276.700 FORMAT "%8.3" ECU_ADDRESS 0x60004F3C /end MEASUREMENT
/begin MEASUREMENT RngMod_trqFltACNoGear "filtered torque for disengaged gear and AC ON (HOM)" SWORD md_sw_q0p1 1 100 -3276.800 3276.700 FORMAT "%8.3" ECU_ADDRESS 0x60004F3A /end MEASUREMENT
/begin MEASUREMENT RngMod_trqFltHom "filtered torque for homogeneous mode" SWORD md_sw_q0p1 1 100 -3276.800 3276.700 FORMAT "%8.3" ECU_ADDRESS 0x70001D44 /end MEASUREMENT
/begin MEASUREMENT RngMod_trqFltNoACGear "filtered torque for engaged gear and AC OFF (HOM)" SWORD md_sw_q0p1 1 100 -3276.800 3276.700 FORMAT "%8.3" ECU_ADDRESS 0x60004F38 /end MEASUREMENT
/begin MEASUREMENT RngMod_trqFltNoACNoGear "filtered torque for disengaged gear and AC OFF (HOM)" SWORD md_sw_q0p1 1 100 -3276.800 3276.700 FORMAT "%8.3" ECU_ADDRESS 0x60004F36 /end MEASUREMENT
/begin MEASUREMENT RngMod_trqInrMinWoCtOff "min. combustion torque" SWORD md_q0p1 1 100 0.00 3276.700 FORMAT "%8.3" ECU_ADDRESS 0x6000E2C4 /end MEASUREMENT
/begin MEASUREMENT RngMod_trqLimMax "upper limit for torque adaption" SWORD md_sw_q0p1 1 100 -3276.800 3276.700 FORMAT "%8.3" ECU_ADDRESS 0x600035D6 /end MEASUREMENT
/begin MEASUREMENT RngMod_trqLimMin "lower limit for torque adaption" SWORD md_sw_q0p1 1 100 -3276.800 3276.700 FORMAT "%8.3" ECU_ADDRESS 0x600035D4 /end MEASUREMENT
/begin MEASUREMENT RngMod_trqLos "sum of all engine losses including frictional torque adaption" SWORD md_q0p1 1 100 0.00 3276.700 FORMAT "%8.3" ECU_ADDRESS 0x60004F34 /end MEASUREMENT
/begin MEASUREMENT RngMod_trqLosTot "sum of modelled torque" SWORD md_sw_q0p1 1 100 -3276.800 3276.700 FORMAT "%8.3" ECU_ADDRESS 0x6000E2C8 /end MEASUREMENT
/begin MEASUREMENT RngMod_trqMaxDes "requested operating conditions: max. torque for torque adaptation" SWORD md_sw_q0p1 1 100 0.00 3276.700 FORMAT "%8.3" ECU_ADDRESS 0x70002C7E /end MEASUREMENT
/begin MEASUREMENT RngMod_trqMinDes "requested operating conditions: min. torque for torque adaptation" SWORD md_sw_q0p1 1 100 0.00 3276.700 FORMAT "%8.3" ECU_ADDRESS 0x70002C80 /end MEASUREMENT
/begin MEASUREMENT Sia_bFirstRxn "First Reception after T15 is ON" UBYTE B_TRUE 1 100 0.00 1.00000000000 BIT_MASK 0x1 FORMAT "%13.11" ECU_ADDRESS 0x70000AE1 /end MEASUREMENT
/begin MEASUREMENT Sia_cntrCurrRxdByt "Number of currently recieved bytes" ULONG OneToOne 1 100 0.00 4294967295.00 FORMAT "%13.2" ECU_ADDRESS 0x70001728 /end MEASUREMENT
/begin MEASUREMENT Sia_stfARAck_mp "Bit wise status used to generate state byte sent in response to command" UBYTE OneToOne 1 100 0.00 255.0 FORMAT "%5.1" ECU_ADDRESS 0x70008BB7 /end MEASUREMENT
/begin MEASUREMENT Sia_stHdShk "Status to represent the handshake between data acquisition proc and communication proc" UBYTE OneToOne 1 100 0.00 255.0 FORMAT "%5.1" ECU_ADDRESS 0x70001C14 /end MEASUREMENT
/begin MEASUREMENT Sia_stIgnLck "Variable for status of Injection Lock from Immo Module" UBYTE B_TRUE 1 100 0.00 1.00000000000 BIT_MASK 0x1 FORMAT "%13.11" ECU_ADDRESS 0x70000685 /end MEASUREMENT
/begin MEASUREMENT Sia_stImsState_mp "Bit wise status to represent the current immobilizer and ECU communication status" UBYTE OneToOne 1 100 0.00 255.0 FORMAT "%5.1" ECU_ADDRESS 0x70008BB6 /end MEASUREMENT
/begin MEASUREMENT Sia_stOK "Status to represent the validity of communication so far" UBYTE OneToOne 1 100 0.00 255.0 FORMAT "%5.1" ECU_ADDRESS 0x6000A2FE /end MEASUREMENT
/begin MEASUREMENT Sia_stTimeMon "Status to represent the state of state machine for time monitoring" UBYTE OneToOne 1 100 0.00 255.0 FORMAT "%5.1" ECU_ADDRESS 0x70001C13 /end MEASUREMENT
/begin MEASUREMENT SpdGov_bASDPrio_mp "active surge damping (ASD) has priority before low idle governor" UBYTE B_TRUE 1 100 0.00 1.00000000000 BIT_MASK 0x1 FORMAT "%13.11" ECU_ADDRESS 0x70008BB5 /end MEASUREMENT
/begin MEASUREMENT SpdGov_bEngPrtLimOvrSpd "Condition for engine speed limitition during over speed" UBYTE B_TRUE 1 100 0.00 1.00000000000 BIT_MASK 0x1 FORMAT "%13.11" ECU_ADDRESS 0x6000A147 /end MEASUREMENT
/begin MEASUREMENT SpdGov_bNLimActv "Condition engine speed limitation active" UBYTE B_TRUE 1 100 0.00 1.00000000000 BIT_MASK 0x1 FORMAT "%13.11" ECU_ADDRESS 0x6000A146 /end MEASUREMENT
/begin MEASUREMENT SpdGov_bNMaxTqLim "Cylinder cut-off by maximum engine speed limitation" UBYTE B_TRUE 1 100 0.00 1.00000000000 BIT_MASK 0x1 FORMAT "%13.11" ECU_ADDRESS 0x6000A144 /end MEASUREMENT
/begin MEASUREMENT SpdGov_dnFlt "filtered engine-speed gradient" SWORD EngNGrd 1 100 -16384.00 16383.50 FORMAT "%8.2" ECU_ADDRESS 0x600035D0 /end MEASUREMENT
/begin MEASUREMENT SpdGov_facComp "Weighting factor for torque loss compensation" SWORD fak_sw_b4 1 100 0.00 1.000000 FORMAT "%8.6" ECU_ADDRESS 0x70001D42 /end MEASUREMENT
/begin MEASUREMENT SpdGov_facCompRmp "ramp factor for accessory compensation during idling" UBYTE fak_ub_b1 1 100 0.00 0.9961 ECU_ADDRESS 0x70001C12 /end MEASUREMENT
/begin MEASUREMENT SpdGov_facThrStabComp "stabilization factor for compensation factor due to power steering etc. during idling" SWORD fak_sw_b4 1 100 -4.000000 3.999878 FORMAT "%8.6" ECU_ADDRESS 0x60000B8C /end MEASUREMENT
/begin MEASUREMENT SpdGov_facTrqDynDist "factor for distribution of dynamic speed controller torque between engine and electric motor" SWORD Fact 1 100 -4.000000 3.999878 FORMAT "%8.6" ECU_ADDRESS 0x600035BE /end MEASUREMENT
/begin MEASUREMENT SpdGov_fakLimMech "Factor for modification of Set-path during active NMAX-limitation" UWORD fak_uw_b2 1 100 0.00 1.000000 FORMAT "%8.6" ECU_ADDRESS 0x600035CE /end MEASUREMENT
/begin MEASUREMENT SpdGov_flgEnaCondIncTqAirPah "Release condition for increase of permissible torque on lead-path" UBYTE B_TRUE 1 100 0.00 1.00000000000 BIT_MASK 0x1 FORMAT "%13.11" ECU_ADDRESS 0x600062EB /end MEASUREMENT
/begin MEASUREMENT SpdGov_flgFflpAirPah "Flag to indicate that re-activation of increase of permissible torque on lead-path is allowed" UBYTE B_TRUE 1 100 0.00 1.00000000000 BIT_MASK 0x1 FORMAT "%13.11" ECU_ADDRESS 0x600062EA /end MEASUREMENT
/begin MEASUREMENT SpdGov_flgIncTqAirPah "Increase of permissible torque on lead-path is active" UBYTE B_TRUE 1 100 0.00 1.00000000000 BIT_MASK 0x1 FORMAT "%13.11" ECU_ADDRESS 0x600062E9 /end MEASUREMENT
/begin MEASUREMENT SpdGov_flgIniCond "Release condition for the initialization of the filter and the ramp" UBYTE B_TRUE 1 100 0.00 1.00000000000 BIT_MASK 0x1 FORMAT "%13.11" ECU_ADDRESS 0x70000137 /end MEASUREMENT
/begin MEASUREMENT SpdGov_flgNHysIncTqAirPah "Flag of engine speed hysteresis for release of increase of permissible torque on lead-path" UBYTE B_TRUE 1 100 0.00 1.00000000000 BIT_MASK 0x1 FORMAT "%13.11" ECU_ADDRESS 0x600062E8 /end MEASUREMENT
/begin MEASUREMENT SpdGov_flgnoIAi "flag indication Ignition angle intervention" UBYTE B_TRUE 1 100 0.00 1.00000000000 BIT_MASK 0x1 FORMAT "%13.11" ECU_ADDRESS 0x600062E7 /end MEASUREMENT
/begin MEASUREMENT SpdGov_flgTstrLimCutOff "Flag to indicate the cut off limitation due to tester" UBYTE B_TRUE 1 100 0.00 1.00000000000 BIT_MASK 0x1 FORMAT "%13.11" ECU_ADDRESS 0x6000A143 /end MEASUREMENT
/begin MEASUREMENT SpdGov_KiNMaxLim "Integral gain of maximum rpm control" UWORD q3p052Em4_min_Nm_DIV_s 1 100 0.00 19.99969 FORMAT "%8.5" ECU_ADDRESS 0x600035CC /end MEASUREMENT
/begin MEASUREMENT SpdGov_KpNMaxLim "Gain of proportional component rpm control" UWORD q3p05175Em3_min_Nm 1 100 0.00 199.9969 FORMAT "%8.4" ECU_ADDRESS 0x600035CA /end MEASUREMENT
/begin MEASUREMENT SpdGov_nDiffNMax "Difference between engine speed limit and actual engine speed" SWORD nmot_sw_q0p5 1 100 -16384.00 16383.50 FORMAT "%8.2" ECU_ADDRESS 0x600035C8 /end MEASUREMENT
/begin MEASUREMENT SpdGov_NMaxLim_ctReIni "Local drive cycle counter for ReIni" UWORD OneToOne 1 100 0.00 65535.00 FORMAT "%8.2" ECU_ADDRESS 0x600035C6 /end MEASUREMENT
/begin MEASUREMENT SpdGov_nMaxPrdc "Predicted engine speed for rpm control" SWORD nmot_sw_q0p5 1 100 -16384.00 16383.50 FORMAT "%8.2" ECU_ADDRESS 0x60004F32 /end MEASUREMENT
/begin MEASUREMENT SpdGov_nSetPLo "Speed array for lower limits of engine speed" SWORD nmot_sw_q0p5 1 100 -16384.00 16383.50 FORMAT "%8.2" ARRAY_SIZE 2 ECU_ADDRESS 0x60000E90 /end MEASUREMENT
/begin MEASUREMENT SpdGov_st "Status information of the Speed governor" UWORD dez 1 100 0.00 65535.00 FORMAT "%8.2" ECU_ADDRESS 0x600005A8 /end MEASUREMENT
/begin MEASUREMENT SpdGov_stTstrLimCutOff "Status of cut off limitation by tester" UBYTE OneToOne 1 100 0.00 255.0 FORMAT "%5.1" ECU_ADDRESS 0x6000A2FD /end MEASUREMENT
/begin MEASUREMENT SpdGov_tqCluLimnMeclDesTemp "Temporary Torque request by engine speed limitation" SWORD md_sw_q0p1 1 100 -3276.800 3276.700 FORMAT "%8.3" ECU_ADDRESS 0x600035C4 /end MEASUREMENT
/begin MEASUREMENT SpdGov_tqCluLimnMeclFco "High speed governor's output torque for cut-off path on clutch torque level" SWORD md_sw_q0p1 1 100 -3276.800 3276.700 FORMAT "%8.3" ECU_ADDRESS 0x60004F30 /end MEASUREMENT
/begin MEASUREMENT SpdGov_trqClth "Torque of the idle speed controller at the driveaway clutch" SWORD Trq 1 100 -3276.800 3276.700 FORMAT "%8.3" ECU_ADDRESS 0x60004F2E /end MEASUREMENT
/begin MEASUREMENT SpdGov_trqClthCurr "Torque requested from the speed controller at the clutch level on current path" SWORD Trq 1 100 -3276.800 3276.700 FORMAT "%8.3" ECU_ADDRESS 0x60004F2C /end MEASUREMENT
/begin MEASUREMENT SpdGov_trqClthLead "Torque of the idle speed controller (lead-path) )at the driveaway clutch" SWORD Trq 1 100 -3276.800 3276.700 FORMAT "%8.3" ECU_ADDRESS 0x60004F2A /end MEASUREMENT
/begin MEASUREMENT SpdGov_trqClthLimMechDes "Torque request by engine speed limitation" SWORD md_sw_q0p1 1 100 -3276.800 3276.700 FORMAT "%8.3" ECU_ADDRESS 0x60004F28 /end MEASUREMENT
/begin MEASUREMENT SpdGov_trqClthLimMechLead "indicated nominal torque for NMAX limiting (air)" SWORD md_sw_q0p1 1 100 -3276.800 3276.700 FORMAT "%8.3" ECU_ADDRESS 0x60004F26 /end MEASUREMENT
/begin MEASUREMENT SpdGov_trqDyn "dynamic part of speed controller torque" SWORD Trq 1 100 -3276.800 3276.700 FORMAT "%8.3" ECU_ADDRESS 0x60004F24 /end MEASUREMENT
/begin MEASUREMENT SpdGov_trqDynElM "dynamic part of speed controller torque for electrical machine" SWORD Trq 1 100 -3276.800 3276.700 FORMAT "%8.3" ECU_ADDRESS 0x60004F22 /end MEASUREMENT
/begin MEASUREMENT SpdGov_trqDynEng "dynamic part of speed controller torque for engine" SWORD Trq 1 100 -3276.800 3276.700 FORMAT "%8.3" ECU_ADDRESS 0x60004F20 /end MEASUREMENT
/begin MEASUREMENT SpdGov_trqDynEngLtd "dynamic limited part of speed controller torque for engine" SWORD Trq 1 100 -3276.800 3276.700 FORMAT "%8.3" ECU_ADDRESS 0x60004F1E /end MEASUREMENT
/begin MEASUREMENT SpdGov_trqDynLead "dynamic part of speed controller torque for lead-path" SWORD Trq 1 100 -3276.800 3276.700 FORMAT "%8.3" ECU_ADDRESS 0x60004F1C /end MEASUREMENT
/begin MEASUREMENT SpdGov_trqFlt "Filtered setpoint torque of the speed governor" SWORD md_q0p1 1 100 -3276.800 3276.700 FORMAT "%8.3" ECU_ADDRESS 0x600005AC /end MEASUREMENT
/begin MEASUREMENT SpdGov_trqFltDiag "For diagnosis filter speed governor torque" SWORD md_q0p1 1 100 -3276.800 3276.700 FORMAT "%8.3" ECU_ADDRESS 0x50000796 /end MEASUREMENT
/begin MEASUREMENT SpdGov_trqINMaxLim "Torque by integral component of rpm control" SWORD md_sw_q0p1 1 100 -3276.800 3276.700 FORMAT "%8.3" ECU_ADDRESS 0x600035C2 /end MEASUREMENT
/begin MEASUREMENT SpdGov_trqLead "Setpoint torque of the SpdGov on the air path" SWORD md_q0p1 1 100 -3276.800 3276.700 FORMAT "%8.3" ECU_ADDRESS 0x60000E8E /end MEASUREMENT
/begin MEASUREMENT SpdGov_trqMax "maximum allowed torque for speed governor" SWORD md_q0p1 1 100 -3276.800 3276.700 FORMAT "%8.3" ECU_ADDRESS 0x600005B0 /end MEASUREMENT
/begin MEASUREMENT SpdGov_trqPNMaxLim "Torque by proportional component of rpm control" SWORD md_sw_q0p1 1 100 -3276.800 3276.700 FORMAT "%8.3" ECU_ADDRESS 0x600035C0 /end MEASUREMENT
/begin MEASUREMENT SpdGov_trqSet "Setpoint torque of the speed governor on the fuel path" SWORD md_q0p1 1 100 -3276.800 3276.700 FORMAT "%8.3" ECU_ADDRESS 0x600005B2 /end MEASUREMENT
/begin MEASUREMENT SpdGov_trqSty "stationary part of speed controller torque" SWORD Trq 1 100 -3276.800 3276.700 FORMAT "%8.3" ECU_ADDRESS 0x60004F16 /end MEASUREMENT
/begin MEASUREMENT SrvCSwt_st "Debounced value of Service check switch" UBYTE OneToOne 1 100 0.00 255.0 FORMAT "%5.1" ECU_ADDRESS 0x50005DC0 /end MEASUREMENT
/begin MEASUREMENT SrvCSwt_stRaw "Raw value of Service check switch" UBYTE OneToOne 1 100 0.00 255.0 FORMAT "%5.1" ECU_ADDRESS 0x6000A2FC /end MEASUREMENT
/begin MEASUREMENT SSEUI_bBrkPedlStrtReq "Start Request by reduction of brake negative pressure" UBYTE B_TRUE 1 100 0.00 1.00000000000 BIT_MASK 0x1 FORMAT "%13.11" ECU_ADDRESS 0x600062E6 /end MEASUREMENT
/begin MEASUREMENT SSEUI_cntrReIni "ReIni counter" UBYTE OneToOne 1 100 0.00 255.0 FORMAT "%5.1" ECU_ADDRESS 0x600062E5 /end MEASUREMENT
/begin MEASUREMENT SSEUI_flgACForIS "The status of enable condition from AC system for IS" UBYTE B_TRUE 1 100 0.00 1.00000000000 BIT_MASK 0x1 FORMAT "%13.11" ECU_ADDRESS 0x600062E4 /end MEASUREMENT
/begin MEASUREMENT SSEUI_flgEngStrtReq "Restart request by battery conditions" UBYTE B_TRUE 1 100 0.00 1.00000000000 BIT_MASK 0x1 FORMAT "%13.11" ECU_ADDRESS 0x600062E3 /end MEASUREMENT
/begin MEASUREMENT SSEUI_flgSysFail "System failure conditions" UBYTE B_TRUE 1 100 0.00 1.00000000000 BIT_MASK 0x1 FORMAT "%13.11" ECU_ADDRESS 0x600062E2 /end MEASUREMENT
/begin MEASUREMENT SSEUI_flgVehCdnHist "Flag for Vehicle Speed History" UBYTE B_TRUE 1 100 0.00 1.00000000000 BIT_MASK 0x1 FORMAT "%13.11" ECU_ADDRESS 0x600062E1 /end MEASUREMENT
/begin MEASUREMENT SSEUI_st2DCSysFailr "Status of FId_SSEUI2DCSysFailr" UBYTE B_TRUE 1 100 0.00 1.00000000000 BIT_MASK 0x1 FORMAT "%13.11" ECU_ADDRESS 0x60036325 /end MEASUREMENT
/begin MEASUREMENT SSEUI_st2DCSysFailrOld "Status of FId_SSEUI2DCSysFailr in previous driving cycle." UBYTE B_TRUE 1 100 0.00 1.00000000000 BIT_MASK 0x1 FORMAT "%13.11" ECU_ADDRESS 0x600062E0 /end MEASUREMENT
/begin MEASUREMENT SSEUI_stActionCVTMode05Old "Old value of CVT action 5 for LAmp display" UBYTE OneToOne 1 100 0.00 255.0 FORMAT "%5.1" ECU_ADDRESS 0x600062DF /end MEASUREMENT
/begin MEASUREMENT SSEUI_stActionMode5Old "Old status of Action in Mode 05h" UBYTE OneToOne 1 100 0.00 255.0 FORMAT "%5.1" ECU_ADDRESS 0x600062DE /end MEASUREMENT
/begin MEASUREMENT SSEUI_stActionOld "Variable to keep the old state value" UBYTE OneToOne 1 100 0.00 255.0 FORMAT "%5.1" ECU_ADDRESS 0x600062DD /end MEASUREMENT
/begin MEASUREMENT SSEUI_stActionOldMode40 "Old value of action in Mode 40h" UBYTE OneToOne 1 100 0.00 255.0 FORMAT "%5.1" ECU_ADDRESS 0x600062DC /end MEASUREMENT
/begin MEASUREMENT SSEUI_stActn8Trig "Action 8 trigger in Display Mode 5" UBYTE B_TRUE 1 100 0.00 1.00000000000 BIT_MASK 0x1 FORMAT "%13.11" ECU_ADDRESS 0x600062DB /end MEASUREMENT
/begin MEASUREMENT SSEUI_stAutEngRstrtIndInitEndCVT "Finished initializing for auto engine start timer(Preindication delay), CVT" UBYTE B_TRUE 1 100 0.00 1.00000000000 BIT_MASK 0x1 FORMAT "%13.11" ECU_ADDRESS 0x600062DA /end MEASUREMENT
/begin MEASUREMENT SSEUI_stBatt "Suitable battery voltage for IS" UBYTE B_TRUE 1 100 0.00 1.00000000000 BIT_MASK 0x1 FORMAT "%13.11" ECU_ADDRESS 0x600062D9 /end MEASUREMENT
/begin MEASUREMENT SSEUI_stCANErrMask "Mask to determine CAN commumication reliability." UBYTE B_TRUE 1 100 0.00 1.00000000000 BIT_MASK 0x1 FORMAT "%13.11" ECU_ADDRESS 0x6000A14B /end MEASUREMENT
/begin MEASUREMENT SSEUI_stDispAutEngStrtHist "Indication of auto engine start history" UBYTE B_TRUE 1 100 0.00 1.00000000000 BIT_MASK 0x1 FORMAT "%13.11" ECU_ADDRESS 0x600062D8 /end MEASUREMENT
/begin MEASUREMENT SSEUI_stDispOffReq "Display Off Request in Mode 4." UBYTE B_TRUE 1 100 0.00 1.00000000000 BIT_MASK 0x1 FORMAT "%13.11" ECU_ADDRESS 0x6000A14A /end MEASUREMENT
/begin MEASUREMENT SSEUI_stDispReasAutoRcv "Display reason for automatic recovery, MT" UBYTE B_TRUE 1 100 0.00 1.00000000000 BIT_MASK 0x1 FORMAT "%13.11" ECU_ADDRESS 0x600062D7 /end MEASUREMENT
/begin MEASUREMENT SSEUI_stDispReasAutoRstrt "Display reason for auto engine start." UBYTE B_TRUE 1 100 0.00 1.00000000000 BIT_MASK 0x1 FORMAT "%13.11" ECU_ADDRESS 0x600062D6 /end MEASUREMENT
/begin MEASUREMENT SSEUI_stDrvrGuidInhb "Driver guidance inhibition information" UBYTE OneToOne 1 100 0.00 1.000 FORMAT "%5.3" ECU_ADDRESS 0x6000A308 /end MEASUREMENT
/begin MEASUREMENT SSEUI_stFlgPreIndcnNotOvr "Pre indication Delay not over" UBYTE B_TRUE 1 100 0.00 1.00000000000 BIT_MASK 0x1 FORMAT "%13.11" ECU_ADDRESS 0x6000A149 /end MEASUREMENT
/begin MEASUREMENT SSEUI_stHoodAndBlt "Engine Hood , Seat Belt and system conditions in Display Mode 1" UBYTE B_TRUE 1 100 0.00 1.00000000000 BIT_MASK 0x1 FORMAT "%13.11" ECU_ADDRESS 0x600062D5 /end MEASUREMENT
/begin MEASUREMENT SSEUI_stIdlStpOk "Idle stop permission ok" UBYTE B_TRUE 1 100 0.00 1.00000000000 BIT_MASK 0x1 FORMAT "%13.11" ECU_ADDRESS 0x6000A148 /end MEASUREMENT
/begin MEASUREMENT SSEUI_stInIdleStop "Idle Stop Status" UBYTE B_TRUE 1 100 0.00 1.00000000000 BIT_MASK 0x1 FORMAT "%13.11" ECU_ADDRESS 0x600062D4 /end MEASUREMENT
/begin MEASUREMENT SSEUI_stISDispMode "Meter Display Mode" UBYTE OneToOne 1 100 0.00 255.0 FORMAT "%5.1" ECU_ADDRESS 0x6000A307 /end MEASUREMENT
/begin MEASUREMENT SSEUI_stISSInhbReas "The status of idle stop inhibition reason for MID" UBYTE OneToOne 1 100 0.00 255.0 FORMAT "%5.1" ECU_ADDRESS 0x6000A306 /end MEASUREMENT
/begin MEASUREMENT SSEUI_stISSLampReq "The status of ISS lamp-on request for MID" UBYTE OneToOne 1 100 0.00 255.0 FORMAT "%5.1" ECU_ADDRESS 0x6000A305 /end MEASUREMENT
/begin MEASUREMENT SSEUI_stISSLampReqInfo "The status of ISS lamp-on request information for MID" UBYTE OneToOne 1 100 0.00 255.0 FORMAT "%5.1" ECU_ADDRESS 0x6000A304 /end MEASUREMENT
/begin MEASUREMENT SSEUI_stISSWarnReq "The status of ISS warning request for MID" UBYTE OneToOne 1 100 0.00 255.0 FORMAT "%5.1" ECU_ADDRESS 0x6000A303 /end MEASUREMENT
/begin MEASUREMENT SSEUI_stLampOff "Lamp Off conditions in Mode 5(AT\CVT)" UBYTE B_TRUE 1 100 0.00 1.00000000000 BIT_MASK 0x1 FORMAT "%13.11" ECU_ADDRESS 0x600062D3 /end MEASUREMENT
/begin MEASUREMENT SSEUI_stLoBattT "Battery temperature in Display Mode 1" UBYTE B_TRUE 1 100 0.00 1.00000000000 BIT_MASK 0x1 FORMAT "%13.11" ECU_ADDRESS 0x600062D2 /end MEASUREMENT
/begin MEASUREMENT SSEUI_stLoEngT "Engine Temperature in Display Mode 1" UBYTE B_TRUE 1 100 0.00 1.00000000000 BIT_MASK 0x1 FORMAT "%13.11" ECU_ADDRESS 0x600062D1 /end MEASUREMENT
/begin MEASUREMENT SSEUI_stLoSpdCVT "CVT Low Speed Vehicle Presence history" UBYTE B_TRUE 1 100 0.00 1.00000000000 BIT_MASK 0x1 FORMAT "%13.11" ECU_ADDRESS 0x600062D0 /end MEASUREMENT
/begin MEASUREMENT SSEUI_stMod01Trig "Mode 1 trigger conditions" UBYTE B_TRUE 1 100 0.00 1.00000000000 BIT_MASK 0x1 FORMAT "%13.11" ECU_ADDRESS 0x600062CF /end MEASUREMENT
/begin MEASUREMENT SSEUI_stMod05StChg "State change conditions in Mode 5" UBYTE B_TRUE 1 100 0.00 1.00000000000 BIT_MASK 0x1 FORMAT "%13.11" ECU_ADDRESS 0x600062CE /end MEASUREMENT
/begin MEASUREMENT SSEUI_stMod05Trig "Mode 5 trigger conditions" UBYTE B_TRUE 1 100 0.00 1.00000000000 BIT_MASK 0x1 FORMAT "%13.11" ECU_ADDRESS 0x600062CD /end MEASUREMENT
/begin MEASUREMENT SSEUI_stMod5Actn1 "Mode 5 Action 1 conditions (MT)" UBYTE B_TRUE 1 100 0.00 1.00000000000 BIT_MASK 0x1 FORMAT "%13.11" ECU_ADDRESS 0x600062CC /end MEASUREMENT
/begin MEASUREMENT SSEUI_stMod5Actn2 "Mode 5 ACtion 2 conditions (MT)" UBYTE B_TRUE 1 100 0.00 1.00000000000 BIT_MASK 0x1 FORMAT "%13.11" ECU_ADDRESS 0x600062CB /end MEASUREMENT
/begin MEASUREMENT SSEUI_stMod5Chg "The Mode Change status in Mode 5" UBYTE OneToOne 1 100 0.00 255.0 FORMAT "%5.1" ECU_ADDRESS 0x600062CA /end MEASUREMENT
/begin MEASUREMENT SSEUI_stModeChg "Mode change information" UBYTE OneToOne 1 100 0.00 255.0 FORMAT "%5.1" ECU_ADDRESS 0x6000A302 /end MEASUREMENT
/begin MEASUREMENT SSEUI_stSmrySysFailrFlag "Summary system failure flag" UBYTE OneToOne 1 100 0.00 1.000 FORMAT "%5.3" ECU_ADDRESS 0x6000A301 /end MEASUREMENT
/begin MEASUREMENT SSEUI_stSpstInhbFct "I\S Inhibitor Function" UBYTE B_TRUE 1 100 0.00 1.00000000000 BIT_MASK 0x1 FORMAT "%13.11" ECU_ADDRESS 0x600062C9 /end MEASUREMENT
/begin MEASUREMENT SSEUI_stStrtClthReq "The status of ISS Start clutch request" UBYTE OneToOne 1 100 0.00 255.0 FORMAT "%5.1" ECU_ADDRESS 0x6000A300 /end MEASUREMENT
/begin MEASUREMENT SSEUI_stStrtrOff "Starter Off status" UBYTE B_TRUE 1 100 0.00 1.00000000000 BIT_MASK 0x1 FORMAT "%13.11" ECU_ADDRESS 0x600062C8 /end MEASUREMENT
/begin MEASUREMENT SSEUI_stStrtrOnBySTSReq "Starter ON instruction by STS starting request" UBYTE B_TRUE 1 100 0.00 1.00000000000 BIT_MASK 0x1 FORMAT "%13.11" ECU_ADDRESS 0x600062C7 /end MEASUREMENT
/begin MEASUREMENT SSEUI_stTrigMod00to11 "Mode 0 to Mode 11 trigger conditions" UBYTE B_TRUE 1 100 0.00 1.00000000000 BIT_MASK 0x1 FORMAT "%13.11" ECU_ADDRESS 0x600062C6 /end MEASUREMENT
/begin MEASUREMENT SSEUI_stTrigMod11to00 "Mode 11 to Mode 0 Trigger conditions" UBYTE B_TRUE 1 100 0.00 1.00000000000 BIT_MASK 0x1 FORMAT "%13.11" ECU_ADDRESS 0x600062C5 /end MEASUREMENT
/begin MEASUREMENT SSEUI_tiACDlyCVT "Timer for AC delay CVT" UBYTE Time_Second 1 100 0.00 255.0 FORMAT "%5.1" ECU_ADDRESS 0x600062C4 /end MEASUREMENT
/begin MEASUREMENT SSEUI_tiCANErrMask "Down Timer for IG2 mask" SWORD Time_s 1 100 -327.6800 327.6700 FORMAT "%8.4" ECU_ADDRESS 0x600035BC /end MEASUREMENT
/begin MEASUREMENT SSEUI_tiDispEndDly "Timer for preindication delay" SWORD Time_s 1 100 0.00 327.6700 FORMAT "%8.4" ECU_ADDRESS 0x600035BA /end MEASUREMENT
/begin MEASUREMENT SSEUI_tiDlySeatBlt "Timer variable to update time after seat belt unlatch" SWORD Time_s 1 100 0.00 327.6700 FORMAT "%8.4" ECU_ADDRESS 0x600035B8 /end MEASUREMENT
/begin MEASUREMENT SSEUI_tiInGearDly "Timer variable to update time before in gear display is provided" SWORD Time_s 1 100 0.00 327.6700 FORMAT "%8.4" ECU_ADDRESS 0x600035B6 /end MEASUREMENT
/begin MEASUREMENT SSEUI_tiIniChk "Timer variable for initial check" SWORD Time_s 1 100 0.00 327.6700 FORMAT "%8.4" ECU_ADDRESS 0x600035B4 /end MEASUREMENT
/begin MEASUREMENT SSEUI_tiISSDisp "Timer varialbe for ISS display delay." SWORD Time_s 1 100 0.00 327.6700 FORMAT "%8.4" ECU_ADDRESS 0x600035B2 /end MEASUREMENT
/begin MEASUREMENT sststadap "pointer for array kstatmst" UBYTE dez 1 100 0.00 255.0 FORMAT "%5.1" ECU_ADDRESS 0x70001706 /end MEASUREMENT
/begin MEASUREMENT STADAP_save_FF.status "RS-FlipFlop: saving of start adaption value enabled / current value of RS-FF" UBYTE B_TRUE 1 100 0.00 1.00000000000 BIT_MASK 0x1 FORMAT "%13.11" ECU_ADDRESS 0x700016FE /end MEASUREMENT
/begin MEASUREMENT StatyCoorn_flgEnaBypCmpdTq "Flag to enable bypass the compensated torque for ASD filter" UBYTE B_TRUE 1 100 0.00 1.00000000000 BIT_MASK 0x1 FORMAT "%13.11" ECU_ADDRESS 0x6000A142 /end MEASUREMENT
/begin MEASUREMENT StatyCoorn_tqCluDesBefLimn "Propulsion torque before limitation by stationary limits" SWORD Trq 1 100 -3276.800 3276.700 FORMAT "%8.3" ECU_ADDRESS 0x60004F14 /end MEASUREMENT
/begin MEASUREMENT StatyCoorn_tqCluDesLimd "Propulsion torque limited by stationary limits" SWORD Trq 1 100 -3276.800 3276.700 FORMAT "%8.3" ECU_ADDRESS 0x60004F12 /end MEASUREMENT
/begin MEASUREMENT StatyCoorn_tqCluDrvDmdDes "Propulsion torque limited by differential and transmission protection" SWORD Trq 1 100 -3276.800 3276.700 FORMAT "%8.3" ECU_ADDRESS 0x60004F10 /end MEASUREMENT
/begin MEASUREMENT StatyCoorn_tqCluDrvrDmdGenericLimn "Propulsion torque limited by generic component protection" SWORD Trq 1 100 -3276.800 3276.700 FORMAT "%8.3" ECU_ADDRESS 0x60004F0E /end MEASUREMENT
/begin MEASUREMENT StatyCoorn_tqCluLeadEngMax "maximum torque of the combustion engine at clutch level on lead path" SWORD Trq 1 100 -3276.800 3276.700 FORMAT "%8.3" ECU_ADDRESS 0x600035AC /end MEASUREMENT
/begin MEASUREMENT StatyCoorn_tqCluLeadEngMin "minimum torque of the combustion engine at clutch level on lead path" SWORD Trq 1 100 -3276.800 3276.700 FORMAT "%8.3" ECU_ADDRESS 0x600035AA /end MEASUREMENT
/begin MEASUREMENT StatyCoorn_tqCluLeadLimd "Limited propulsion torque after stationary torque distribution on lead path at clutch level" SWORD Trq 1 100 -3276.800 3276.700 FORMAT "%8.3" ECU_ADDRESS 0x60004F0C /end MEASUREMENT
/begin MEASUREMENT StatyCoorn_tqCluMax "Maximum stationary allowed torque at clutch level" SWORD Trq 1 100 -3276.800 3276.700 FORMAT "%8.3" ECU_ADDRESS 0x60004F0A /end MEASUREMENT
/begin MEASUREMENT StatyCoorn_tqCluMin "Minimum stationary allowed torque at clutch level" SWORD Trq 1 100 -3276.800 3276.700 FORMAT "%8.3" ECU_ADDRESS 0x60004F08 /end MEASUREMENT
/begin MEASUREMENT StatyCoorn_tqCluTotLeadMax "Maximum torque limitation on total lead torque path at clutch level" SWORD Trq 1 100 -3276.800 3276.700 FORMAT "%8.3" ECU_ADDRESS 0x600035A8 /end MEASUREMENT
/begin MEASUREMENT StatyCoorn_tqCluTotLeadMin "Minimum torque limitation on total lead torque path at clutch level" SWORD Trq 1 100 -3276.800 3276.700 FORMAT "%8.3" ECU_ADDRESS 0x600035A6 /end MEASUREMENT
/begin MEASUREMENT StbIntvECU_ctAYCARngCnt_MP "Ring counter message of AYCA frame" UBYTE OneToOne 1 100 0.00 255.0 FORMAT "%5.1" ECU_ADDRESS 0x70008BB4 /end MEASUREMENT
/begin MEASUREMENT StbIntvECU_ctAYCFRngCnt_MP "Measuring point for AYCF Ring Counter" UBYTE OneToOne 1 100 0.00 255.0 FORMAT "%5.1" ECU_ADDRESS 0x70008BA1 /end MEASUREMENT
/begin MEASUREMENT StbIntvECU_ctAYCGRngCnt_MP "AYCG Ring Counter Measuring Point" UBYTE OneToOne 1 100 0.00 255.0 FORMAT "%5.1" ECU_ADDRESS 0x70008BA0 /end MEASUREMENT
/begin MEASUREMENT StbIntvECU_ctAYCIRngCnt_MP "AYCI Ring counter Measuring Point" UBYTE OneToOne 1 100 0.00 3.000 FORMAT "%5.3" ECU_ADDRESS 0x70008B9F /end MEASUREMENT
/begin MEASUREMENT StbIntv_bAYCIntvActv "AYC active condition status" UBYTE OneToOne 1 100 0.00 255.0 FORMAT "%5.1" ECU_ADDRESS 0x6000A2F7 /end MEASUREMENT
/begin MEASUREMENT StbIntv_bDCSIntv "DCS(Drag control system) intervention active status" UBYTE B_TRUE 1 100 0.00 1.00000000000 BIT_MASK 0x1 FORMAT "%13.11" ECU_ADDRESS 0x6000A141 /end MEASUREMENT
/begin MEASUREMENT StbIntv_bDCSNeutr "Neutral value received for DCS intervention" UBYTE B_TRUE 1 100 0.00 1.00000000000 BIT_MASK 0x1 FORMAT "%13.11" ECU_ADDRESS 0x6000A140 /end MEASUREMENT
/begin MEASUREMENT StbIntv_bTCSIntv "TCS(Traction Control System) intervention active status" UBYTE B_TRUE 1 100 0.00 1.00000000000 BIT_MASK 0x1 FORMAT "%13.11" ECU_ADDRESS 0x6000A13F /end MEASUREMENT
/begin MEASUREMENT StbIntv_bTCSNeutr "Neutral value received for TCS intervention" UBYTE B_TRUE 1 100 0.00 1.00000000000 BIT_MASK 0x1 FORMAT "%13.11" ECU_ADDRESS 0x6000A13E /end MEASUREMENT
/begin MEASUREMENT StbIntv_flgDCSPlusTrqReqd "Plus torque requested during DCS operation" UBYTE B_TRUE 1 100 0.00 1.00000000000 BIT_MASK 0x1 FORMAT "%13.11" ECU_ADDRESS 0x6000A13D /end MEASUREMENT
/begin MEASUREMENT StbIntv_trqDCSDes "DCS intervention torque at wheel level" SLONG trq_q0p1 1 100 -214748364.800 214748364.700 FORMAT "%13.3" ECU_ADDRESS 0x70002B38 /end MEASUREMENT
/begin MEASUREMENT StbIntv_trqTCSDes "Desired TCS intervention torque at wheel level" SLONG trq_q0p1 1 100 -214748364.800 214748364.700 FORMAT "%13.3" ECU_ADDRESS 0x70002B3C /end MEASUREMENT
/begin MEASUREMENT StbIntv_trqTCSLead "TCS lead torque value." SLONG trq_q0p1 1 100 -214748364.800 214748364.700 FORMAT "%13.3" ECU_ADDRESS 0x70002B40 /end MEASUREMENT
/begin MEASUREMENT StbIntv_vWhlSpd "Array of wheel speed value for each wheel" SWORD Vel 1 100 -327.6800 327.6700 FORMAT "%8.4" ARRAY_SIZE 4 ECU_ADDRESS 0x50005B16 /end MEASUREMENT
/begin MEASUREMENT StrgECU_ctRngCntEPS1_MP "EPS Ring Counter Measuring Point" UBYTE OneToOne 1 100 0.00 255.0 FORMAT "%5.1" ECU_ADDRESS 0x70008B9E /end MEASUREMENT
/begin MEASUREMENT taevfout_w "Filtered air temperature at inlet valve" UWORD temp_q0p0234_o273 1 100 -273.150 1262.827 FORMAT "%8.3" ECU_ADDRESS 0x60000B8E /end MEASUREMENT
/begin MEASUREMENT tef_w_msg "effective injection time" UWORD t100msxs_q16Em6 1 100 0.00 1.048560 FORMAT "%8.6" ECU_ADDRESS 0x600006AC /end MEASUREMENT
/begin MEASUREMENT tevfak_w_msg "effective injection time before fine adjust (word); input for map" UWORD t1p0usxms 1 100 0.00 65.53500 FORMAT "%8.5" ECU_ADDRESS 0x60000E00 /end MEASUREMENT
/begin MEASUREMENT tevfa_l "effectiv injection time before fine adjust (longword)" ULONG t1p0usxms 1 100 0.00 4294967.29500 FORMAT "%13.5" ECU_ADDRESS 0x7000172C /end MEASUREMENT
/begin MEASUREMENT tez_l_msg "effectiv injection time (long) cylinderindividuell" ULONG t1p0usxms 1 100 0.00 4294967.29500 FORMAT "%13.5" ARRAY_SIZE 4 ECU_ADDRESS 0x600003E0 /end MEASUREMENT
/begin MEASUREMENT te_l_msg "effectiv injection time (long)" ULONG t1p0usxms 1 100 0.00 4294967.29500 FORMAT "%13.5" ECU_ADDRESS 0x500005E8 /end MEASUREMENT
/begin MEASUREMENT TMEAdpn_AdpnReldERNM_I.oldSignal "Edge rising for adaptation release condition / value of input signal last calculation" UBYTE B_TRUE 1 100 0.00 1.00000000000 BIT_MASK 0x1 FORMAT "%13.11" ECU_ADDRESS 0x600062EC /end MEASUREMENT
/begin MEASUREMENT TMERng_etaCcoCurr "cylinder cutoff efficiency for current reduction stage" UWORD fak_uw_b2 1 100 0.00 1.999969 FORMAT "%8.6" ECU_ADDRESS 0x600035DA /end MEASUREMENT
/begin MEASUREMENT TMERng_tqCrksftLeadMaxStabCdn "Maximum engine torque at the crankshaft level on the lead path with stable conditions" SWORD md_q0p1 1 100 -3276.800 3276.700 FORMAT "%8.3" ECU_ADDRESS 0x60004F02 /end MEASUREMENT
/begin MEASUREMENT tmstsst "starting temperature used as base point of kstatmst" UBYTE temp_ub_q0p75_o48 1 100 -48.0 143.3 FORMAT "%5.1" ECU_ADDRESS 0x70001705 /end MEASUREMENT
/begin MEASUREMENT tqBrkOperAYCGOld "Old value of Driver Input torque" UWORD TrqPerSec 1 100 0.00 65535.00 FORMAT "%8.2" ECU_ADDRESS 0x600035A4 /end MEASUREMENT
/begin MEASUREMENT tststadap "engine temperature at start for STADAP" UBYTE temp_ub_q0p75_o48 1 100 -48.0 143.3 FORMAT "%5.1" ECU_ADDRESS 0x70001704 /end MEASUREMENT
/begin MEASUREMENT tststa_loc_stadap "Input element of KFDNBURNS" UWORD temp_ub_q0p75_o48 1 100 -48.0000 143.2500 FORMAT "%8.4" ECU_ADDRESS 0x70001702 /end MEASUREMENT
/begin MEASUREMENT tvub_w_msg "Delay time of injection valves, dependant on battery voltage" UWORD t1p0usxms 1 100 0.00 65.53500 FORMAT "%8.5" ECU_ADDRESS 0x50000F74 /end MEASUREMENT
/begin MEASUREMENT zvbausw "number of combustions in analyse range" UBYTE dez 1 100 0.00 255.0 FORMAT "%5.1" ECU_ADDRESS 0x70001700 /end MEASUREMENT
/begin MEASUREMENT zvbmg "number of possible combustions" UBYTE dez 1 100 0.00 255.0 FORMAT "%5.1" ECU_ADDRESS 0x700016FF /end MEASUREMENT
/begin FUNCTION RKTE "16.0.0_1.1.0Calculation of effective injection time from relative fuel mass"
 /begin DEF_CHARACTERISTIC CWPKAPP DTEMN FKKVS FRKEZAP FRLFSDP Injsys_facFuMPCorrn KLFTVTEV KRKATE PSAPES TEMN TEMNVA TVUBAT ZRKTAEV ZYLCRKMN ZYLCRKMX /end DEF_CHARACTERISTIC
 /begin IN_MEASUREMENT BattU_u B_stendes_msg B_va_msg Epm_nEng evz_austot_msg InjSys_dvolFuInjr InjSys_ratFuM PEnv_p ps_w_msg rk_l_msg SyC_stSub taev_w_msg /end IN_MEASUREMENT
 /begin OUT_MEASUREMENT dppk_w_msg dpus_w_msg dtemnkt_w_msg fkrk_w_msg frkate_w_msg frlfs_w_msg ftek_w_msg InjSys_bMinPtdInjDurActv tef_w_msg tevfak_w_msg tez_l_msg te_l_msg tvub_w_msg /end OUT_MEASUREMENT
 /begin LOC_MEASUREMENT InjSys_nEngRKTE InjSys_uBatLoc taevfout_w tevfa_l /end LOC_MEASUREMENT
 FUNCTION_VERSION "16.0.0_1.1.0" /end FUNCTION
/begin FUNCTION RngMod_TrqCalc "1.16.0    Calculation of Torque Ranges"
 /begin DEF_CHARACTERISTIC RngMod_swtTqResv_C RngMod_tiFltEtaIgnMin_C RngMod_TrqCalc_CW /end DEF_CHARACTERISTIC
 /begin IN_MEASUREMENT CoVeh_trqAcs EngDem_trqInrLim EngDem_trqInrLimLead InjSys_bInjVlvActv InjSys_nrRedStgEnf PhyMod_etaIgnMin PthLead_trqResvRel RngMod_bEngActv RngMod_trqDiffAdap RngMod_trqInrBs RngMod_trqInrBsMin RngMod_trqInrBsMinAvrg RngMod_trqInrLeadMinAvl RngMod_trqInrMax RngMod_trqInrMaxAvl RngMod_trqInrOpt RngMod_trqLosEng TrqCnv_numRedStgDem /end IN_MEASUREMENT
 /begin OUT_MEASUREMENT RngMod_trqClthMin RngMod_trqCrSLeadMax RngMod_trqCrSLeadMaxAvl RngMod_trqCrSLimLead RngMod_trqCrSMin RngMod_trqCrSSetMax RngMod_trqCrSSetMaxAvl RngMod_trqCrSSetMin RngMod_trqCrSSetMinAvl RngMod_trqCrSSetMinCylFCO RngMod_trqCrSSetMinCylFCOTraIntv RngMod_trqLos TMERng_tqCrksftLeadMaxStabCdn /end OUT_MEASUREMENT
 /begin LOC_MEASUREMENT TMERng_etaCcoCurr /end LOC_MEASUREMENT
 FUNCTION_VERSION "1.16.0" /end FUNCTION
/begin FUNCTION RngMod_TrqFrcAdpt "2.27.0    Adaption friction torque"
 /begin DEF_CHARACTERISTIC RngMod_bClth_C RngMod_facPwrDpdtFricLoss_M RngMod_nLIDvtMax_C RngMod_nMaxDes_C RngMod_nMinDes_C RngMod_phiThrVlvThres_C RngMod_stPrio_CUR RngMod_swtTqDmdAcsy_CW RngMod_tAdapMin_C RngMod_tiDetnQly_C RngMod_tiDmdAdpn_C RngMod_tiOffsRelsAdpn_C RngMod_tiRelsAdpn_C RngMod_tiTqAdpn_C RngMod_tiTqDifAdpn_C RngMod_trqDef_C RngMod_TrqFrcAdap_CW RngMod_trqLimMax_C RngMod_trqLimMin_C RngMod_trqMaxDes_C RngMod_trqMinDes_C RngMod_trqOfsLim_C RngMod_trqOfsQl_C RngMod_vLimTrans_C RngMod_vLim_C TMEAdpn_tGbxOilAdpnMin_T /end DEF_CHARACTERISTIC
 /begin IN_MEASUREMENT ACCtl_stOut ActMod_trqInr AirSys_bMinPsblIdcTrqRea AirSys_bThrVlvUnthr AirSys_rPhiThrVlv B_dtes_msg CEngDsT_t CoEng_bFrstStrtEnd CoEng_st Conv_tOil Conv_trqLd CoVeh_stEngStopOrd CoVeh_trqAcs EnvT_t Epm_nEng Gbx_stPNPos HLSDem_nSetPTrck InjSys_bMinPtdInjDurActv PT_stTraType PT_trqLos RngMod_trqLosEng SpdGov_st SyC_stSub VehV_v /end IN_MEASUREMENT
 /begin OUT_MEASUREMENT RngMod_bClth RngMod_bGenRls RngMod_nMaxDes RngMod_nMinDes RngMod_stAdap RngMod_stDrvState RngMod_stPrio RngMod_trqDiffAdap RngMod_trqFltACGear RngMod_trqFltACNoGear RngMod_trqFltNoACGear RngMod_trqFltNoACNoGear RngMod_trqLosTot RngMod_trqMaxDes RngMod_trqMinDes /end OUT_MEASUREMENT
 /begin LOC_MEASUREMENT RngMod_bRlsAdap RngMod_flgClrAdptFlt RngMod_flgDrvStChg RngMod_NumCycl RngMod_stAddRls RngMod_tqAdpnLoss_a RngMod_tqDmdAcsy RngMod_tqLossDif RngMod_trqAdapFlt RngMod_trqDiffAdapCalc RngMod_trqFltHom RngMod_trqLimMax RngMod_trqLimMin TMEAdpn_AdpnReldERNM_I.oldSignal /end LOC_MEASUREMENT
 FUNCTION_VERSION "2.27.0" /end FUNCTION
/begin FUNCTION RngMod_TrqMinCmb "1.6.0     Calculation of minimum torque with fired engine" /begin DEF_CHARACTERISTIC RngMod_facSpd_CUR RngMod_facTraRat_CUR /end DEF_CHARACTERISTIC
 /begin IN_MEASUREMENT Epm_nEng PT_rTrq RngMod_trqClthMin RngMod_trqCrSLeadMin RngMod_trqCrSLeadMinAvl RngMod_trqCrSMin /end IN_MEASUREMENT
 /begin OUT_MEASUREMENT RngMod_trqClthMinWoCtOff RngMod_trqCrSMinWoCtOff RngMod_trqInrMinWoCtOff /end OUT_MEASUREMENT
 /begin LOC_MEASUREMENT RngMod_nEng_LOC RngMod_rTrq_LOC /end LOC_MEASUREMENT
 FUNCTION_VERSION "1.6.0" /end FUNCTION
/begin FUNCTION RSSO_DySched "159.4.0_1.0.0RSSO Dysched file for MDG1 BSW" FUNCTION_VERSION "159.4.0_1.0.0" /end FUNCTION
/begin FUNCTION Rte "3.8.0     AUTOSAR Run Time Environment (RTE)" FUNCTION_VERSION "3.8.0" /end FUNCTION
/begin FUNCTION SIA_COMIFC "187.1.0   Immobilizer communication" /begin IN_MEASUREMENT Sia_bFirstRxn Sia_stHdShk /end IN_MEASUREMENT /begin OUT_MEASUREMENT Sia_stTimeMon /end OUT_MEASUREMENT /begin LOC_MEASUREMENT Sia_cntrCurrRxdByt /end LOC_MEASUREMENT FUNCTION_VERSION "187.1.0" /end FUNCTION
/begin FUNCTION SIA_Core "187.1.0   Immobilizer main module" /begin DEF_CHARACTERISTIC Sia_numfARCal_C /end DEF_CHARACTERISTIC FUNCTION_VERSION "187.1.0" /end FUNCTION
/begin FUNCTION SIA_EMSIFC "187.1.0   Immobilizer Interface"
 /begin DEF_CHARACTERISTIC Sia_EnGen6Support_C Sia_numCODE1_C Sia_numCODE2_C Sia_numCODE3_C Sia_numExcCod_C Sia_numExdCod_C Sia_swtCodEepUpd_C Sia_swtExCodUpdt_C Sia_swtIgnLckEep_C Sia_swtImsVal_C Sia_tiExRegTmrBMax_C Sia_tiTmrBMax_C /end DEF_CHARACTERISTIC
 /begin IN_MEASUREMENT CoEng_st Sia_stTimeMon SyC_stSub T15_st /end IN_MEASUREMENT
 /begin OUT_MEASUREMENT Sia_bFirstRxn Sia_stHdShk Sia_stIgnLck Sia_stOK /end OUT_MEASUREMENT
 /begin LOC_MEASUREMENT Sia_stfARAck_mp Sia_stImsState_mp /end LOC_MEASUREMENT
 FUNCTION_VERSION "187.1.0" /end FUNCTION
/begin FUNCTION SignalsExtd_Std "30000.1.0 Interface for readout of ECU internal measurement values extended" FUNCTION_VERSION "30000.1.0" /end FUNCTION
/begin FUNCTION Signals_Std "30000.65.0Interface for readout of ECU internal measurement values"
 /begin DEF_CHARACTERISTIC Signals_Mode1Pid_CA Signals_Mode1SigNum_CA Signals_stSrv01SuppPid_CA /end DEF_CHARACTERISTIC
 /begin IN_MEASUREMENT I15031_PID83A I15031_PID9BA I15031_PIDA1A I15031_PIDA7A I15031_PIDA8A /end IN_MEASUREMENT
 FUNCTION_VERSION "30000.65.0" /end FUNCTION
/begin FUNCTION SigQly_GlbDefn "1.1.0     Signal Quality Global Definition" FUNCTION_VERSION "1.1.0" /end FUNCTION
/begin FUNCTION SigQly_Srv "1.2.0     Signal Quality Services" FUNCTION_VERSION "1.2.0" /end FUNCTION
/begin FUNCTION SpdGov2ME "1.12.0    ETS Adapter SpdGov to ME" /begin DEF_CHARACTERISTIC CWSPDGOV TVDK TVLLRPST /end DEF_CHARACTERISTIC
 /begin IN_MEASUREMENT B_ll_msg B_stendmd_msg CoEng_flgRelsFco EngStrt_bStrtEnd ftrq2mi_w_msg LIGov_bEnblI LIGov_bFrzI LIGov_bInactv LIGov_bNoGrip LIGov_nDiff LIGov_trqI RngMod_trqComp RngMod_trqInrMinWoCtOff RngMod_trqLosEng /end IN_MEASUREMENT
 /begin OUT_MEASUREMENT B_enllri_msg B_llrein_msg B_llri_msg B_llrst_msg B_llr_msg B_vllr_msg dmllri_w_msg dn_w_msg /end OUT_MEASUREMENT
 FUNCTION_VERSION "1.12.0" /end FUNCTION
/begin FUNCTION SpdGov_NMaxLim "28.1.0    Limitation of engine speed"
 /begin DEF_CHARACTERISTIC DNSOZW KLDNMAXH SpdGov_facCorIniINLim_CUR SpdGov_flgSwtNGrdt_C SpdGov_KiNMaxLimTipp_MAP SpdGov_KiNMaxLim_MAP SpdGov_KpNMaxLimTipp_MAP SpdGov_KpNMaxLim_MAP SpdGov_MaskTstrLimCutOff_C SpdGov_nDeltaFstTrqRed_C SpdGov_nDeltaMinTrq_C SpdGov_nDeltaStopNLim_C SpdGov_nLowrThdIncTqAirPah_C SpdGov_NMaxLim_CW SpdGov_nMax_C SpdGov_nSetPHi_DST SpdGov_numGear_DST SpdGov_nUpprThdIncTqAirPah_C SpdGov_rAppThdTqAirPah_C SpdGov_tiDlyNeutGear_C SpdGov_tiHldIncTqAirPah_C SpdGov_tiNMaxPrdcTipp_CUR SpdGov_tiNMaxPrdc_CUR SpdGov_trqIniINMaxLimTipp_MAP SpdGov_trqIniINMaxLim_MAP SpdGov_trqMaxLimInteg_C SpdGov_trqMinLimInteg_C SpdGov_vThdTqAirPah_C TVDNOZW /end DEF_CHARACTERISTIC
 /begin REF_CHARACTERISTIC DNMAXH /end REF_CHARACTERISTIC
 /begin IN_MEASUREMENT ActMod_trqCrSWoDstC APP_r CoVeh_trqAcs ECT_bFCOEnaCmpnPrt ElM_tqActWoAcsyCmp EngPrt_bNLimRed Epm_dnEngAvgFlt Epm_dnEngFlt Gbx_stGearLvr Gbx_stNPos Gbx_stRvsPos HLSDem_bNMaxRed HLSDem_nSetPHi HLSDem_nSetPLo I14229_stABSFailCnclActv LLRNSNF_nOffsSpLoTrckEna PT_bGrip PT_nClth PT_stTraType StatyCoorn_tqCluDesLimd SyC_ctDrvEnter Tra_nMax Tra_nReqEngFco Tra_numGear VehV_v /end IN_MEASUREMENT
 /begin OUT_MEASUREMENT B_nmax_msg SpdGov_bEngPrtLimOvrSpd SpdGov_bNLimActv SpdGov_bNMaxTqLim SpdGov_flgTstrLimCutOff SpdGov_nMaxPrdc SpdGov_stTstrLimCutOff SpdGov_tqCluLimnMeclFco SpdGov_trqClthLimMechDes SpdGov_trqClthLimMechLead /end OUT_MEASUREMENT
 /begin LOC_MEASUREMENT SpdGov_dnFlt SpdGov_fakLimMech SpdGov_flgEnaCondIncTqAirPah SpdGov_flgFflpAirPah SpdGov_flgIncTqAirPah SpdGov_flgNHysIncTqAirPah SpdGov_flgnoIAi SpdGov_KiNMaxLim SpdGov_KpNMaxLim SpdGov_nDiffNMax SpdGov_NMaxLim_ctReIni SpdGov_tqCluLimnMeclDesTemp SpdGov_trqINMaxLim SpdGov_trqPNMaxLim /end LOC_MEASUREMENT
 FUNCTION_VERSION "28.1.0" /end FUNCTION
/begin FUNCTION SpdGov_TrqCalc "32.3.0    Distribution of low-idle governor torque demand on lead and set path."
 /begin DEF_CHARACTERISTIC SpdGov_facCompRmpDwn_C SpdGov_facCompRmpGrip_C SpdGov_facCompRmpNoGrip_C SpdGov_facComp_CUR SpdGov_tiStrtEnd_C SpdGov_tiTrqFlt_C /end DEF_CHARACTERISTIC
 /begin IN_MEASUREMENT CoEng_tiNormalRed DOGov_trqLead DOGov_trqSet HLSDem_nSetPLo HLSDem_nSetPTrck LIGov_bExtTrqDem LIGov_bInactv LIGov_bNoGrip LIGov_bRmpDwn LIGov_facPreCtlRmpMax LIGov_facThrStabAc LIGov_stOvrRun LIGov_tiSync LIGov_trq LIGov_trqI LIGov_trqLead LIGov_trqMax LIGov_trqMin LIGov_trqPreCtl SpdGov_bNLimActv SyC_stSub /end IN_MEASUREMENT
 /begin OUT_MEASUREMENT SpdGov_facComp SpdGov_facCompRmp SpdGov_nSetPLo SpdGov_st SpdGov_trqFlt SpdGov_trqFltDiag SpdGov_trqLead SpdGov_trqMax SpdGov_trqSet /end OUT_MEASUREMENT
 /begin LOC_MEASUREMENT SpdGov_facThrStabComp /end LOC_MEASUREMENT
 FUNCTION_VERSION "32.3.0" /end FUNCTION
/begin FUNCTION SpdGov_TrqDist "200.1.0   Torque Distribution f. Speed Governor (stat.-dynamic, combustion-electric motor)"
 /begin DEF_CHARACTERISTIC SpdGov_dfacDistCtOff_C SpdGov_dtrqMax_C SpdGov_facTrqDynDist_C SpdGov_nDiffASDPrioStal_C SpdGov_nDiffASDPrio_C SpdGov_nMinASDPrio_C SpdGov_rASDPrio_C SpdGov_swtASDPrio_CW SpdGov_tiFltASDPrio_C SpdGov_tiFlt_C SpdGov_trqASDPrio_C SpdGov_TrqDist_CW SpdGov_trqOfsMin_C /end DEF_CHARACTERISTIC
 /begin IN_MEASUREMENT APP_r CoEng_stMai CoPOM_bCtOffDem CoPOM_facTrqDynDist CoPOM_stM CoPOM_stMnSt Epm_nEng HLSDem_nSetPLo PthSet_stOvrRun PT_nClth SpdGov_trqLead SpdGov_trqSet StatyCoorn_tqCluDesLimd /end IN_MEASUREMENT
 /begin OUT_MEASUREMENT SpdGov_trqClth SpdGov_trqClthCurr SpdGov_trqClthLead SpdGov_trqDyn SpdGov_trqDynElM SpdGov_trqDynEng SpdGov_trqDynEngLtd SpdGov_trqDynLead SpdGov_trqSty /end OUT_MEASUREMENT
 /begin LOC_MEASUREMENT SpdGov_bASDPrio_mp SpdGov_facTrqDynDist SpdGov_flgIniCond /end LOC_MEASUREMENT
 FUNCTION_VERSION "200.1.0" /end FUNCTION
/begin FUNCTION SrvB "220.13.0  Basic Services" FUNCTION_VERSION "220.13.0" /end FUNCTION
/begin FUNCTION SrvCSwt_DD "2.0.0     Service check switch input" /begin DEF_CHARACTERISTIC SrvCSwt_tiSwtDebHiLo_C SrvCSwt_tiSwtDebLoHi_C /end DEF_CHARACTERISTIC /begin IN_MEASUREMENT T15_st /end IN_MEASUREMENT /begin OUT_MEASUREMENT SrvCSwt_st /end OUT_MEASUREMENT /begin LOC_MEASUREMENT SrvCSwt_stRaw /end LOC_MEASUREMENT FUNCTION_VERSION "2.0.0" /end FUNCTION
/begin FUNCTION SrvF "220.8.0   Float Services" FUNCTION_VERSION "220.8.0" /end FUNCTION
/begin FUNCTION SrvX "220.11.0  Extended Services" FUNCTION_VERSION "220.11.0" /end FUNCTION
/begin FUNCTION SSEUI_SetData "35.3.0    Stop Start Engine User Interface"
 /begin DEF_CHARACTERISTIC SSEUI_stFirstEngStrtSeln_C SSEUI_stMktSelnSwt_C SSEUI_stMode05FlgRstMsk_C SSEUI_stMsk1_C SSEUI_stSwtACCdnByp_C SSEUI_stSwtMIDDsbl_C SSEUI_swtSTSReq_C SSEUI_tiACDly120s_C SSEUI_tiACDly6s_C SSEUI_tiBrkPedStrtReqDly_C SSEUI_tiCANErrMask_C SSEUI_tiCluChkDly_C SSEUI_tiDispEndDly_C SSEUI_tiDispTime_C SSEUI_tiDlySeatBlt_C SSEUI_tiInGearDly_C SSEUI_tiInitChkDly_C SSEUI_tiISGoJudDly_C SSEUI_tiRstrtReqVehCdnDly_C SSEUI_tiVehCdnStopTrigDly_C /end DEF_CHARACTERISTIC
 /begin REF_CHARACTERISTIC CoVOM_stDrvMod1_C CoVOM_stDrvMod2_C CoVOM_stDrvMod3_C CoVOM_stStopRelsMask_C CoVOM_stStrtReqMask_C CoVOM_swtDrvModSeln_C /end REF_CHARACTERISTIC
 /begin IN_MEASUREMENT ACC_bBrkReq Batt_stEngStopInhbn BrkPed_bEngStrtReq BrkPed_flgISABBrkPSuffVehStill BrkPed_flgVehStandStill Brk_st CoEng_st CoEng_stMai Com_stATISS Com_stATPrkgProc Com_stBCANInfo Com_stDrvModSwt Com_stEAT8Mon Com_stEATBMon Com_stEBB Com_stEngHoodOpn Com_stIdleStrtStopDispFct Com_stIMGISBrkHldActv Com_stPreStop Com_stSeatBltInfo Com_stSptSwtDeb Com_tiISSPrms CoVOM_bACStopReqTimeout CoVOM_bAutoRstrtReq CoVOM_bEngFrstStrtPassed CoVOM_bEngPreStrtOrd CoVOM_bNeutBasdRstrt CoVOM_bRvsHist CoVOM_bSSEEna CoVOM_bSSEEngStopPassed CoVOM_bStopEna CoVOM_bStrtEna CoVOM_bStrtReq CoVOM_bSysOff CoVOM_bVehCdnStopTrig CoVOM_bVXSinceStrtDeb CoVOM_flgEngStallAftDly CoVOM_stISGoJud CoVOM_stISGoStb CoVOM_stMaxNrStrtOperExcdd CoVOM_stRstrtReqByVehCdn CoVOM_stSSE CoVOM_stStopEnaDspl CoVOM_stStrtReqDspl Eep_EnvRamInvld ESS_bEngStopEna ESS_bEngStrtReq Gbx_stGearLvr Gbx_stNPos I14229_stABSFailCnclActv I14229_stIdlStopCdn MoF_stStrtStopEnaMsg PT_bEngStopEna PT_bEngStrtReq PT_stTraType StrtCtl_stStrtRls Strt_st Strt_stPs StSpSwt_st SyC_ctPostDrvLeave SysDiag_flgCModJdg T15_st T50_st TS_bEngStopEna /end IN_MEASUREMENT
 /begin OUT_MEASUREMENT SSEUI_stCANErrMask SSEUI_stDispOffReq SSEUI_stDrvrGuidInhb SSEUI_stIdlStpOk SSEUI_stISDispMode SSEUI_stISSInhbReas SSEUI_stISSLampReq SSEUI_stISSLampReqInfo SSEUI_stISSWarnReq SSEUI_stModeChg SSEUI_stSmrySysFailrFlag SSEUI_stStrtClthReq /end OUT_MEASUREMENT
 /begin LOC_MEASUREMENT SSEUI_bBrkPedlStrtReq SSEUI_cntrReIni SSEUI_flgACForIS SSEUI_flgEngStrtReq SSEUI_flgSysFail SSEUI_flgVehCdnHist SSEUI_st2DCSysFailr SSEUI_st2DCSysFailrOld SSEUI_stActionCVTMode05Old SSEUI_stActionMode5Old SSEUI_stActionOld SSEUI_stActionOldMode40 SSEUI_stActn8Trig SSEUI_stAutEngRstrtIndInitEndCVT SSEUI_stBatt SSEUI_stDispAutEngStrtHist SSEUI_stDispReasAutoRcv SSEUI_stDispReasAutoRstrt SSEUI_stFlgPreIndcnNotOvr SSEUI_stHoodAndBlt SSEUI_stInIdleStop SSEUI_stLampOff SSEUI_stLoBattT SSEUI_stLoEngT SSEUI_stLoSpdCVT SSEUI_stMod01Trig SSEUI_stMod05StChg SSEUI_stMod05Trig SSEUI_stMod5Actn1 SSEUI_stMod5Actn2 SSEUI_stMod5Chg SSEUI_stSpstInhbFct SSEUI_stStrtrOff SSEUI_stStrtrOnBySTSReq SSEUI_stTrigMod00to11 SSEUI_stTrigMod11to00 SSEUI_tiACDlyCVT SSEUI_tiCANErrMask SSEUI_tiDispEndDly SSEUI_tiDlySeatBlt SSEUI_tiInGearDly SSEUI_tiIniChk SSEUI_tiISSDisp /end LOC_MEASUREMENT
 FUNCTION_VERSION "35.3.0" /end FUNCTION
/begin FUNCTION STADAP "3.7.0     Starting fuel adaptation"
 /begin DEF_CHARACTERISTIC CWSTADAP EngStrt_ActvFuAdpn_C FSTAIFRES KFADASTEP KFDNBNSKH KFDNBURNS KFNSTAMX KLADAPSRES KLDNFHO KLKSTAAINI KLKSTAMN KLKSTAMX KLSSTTMST KLWSTADAP KSTAOLDMN KSTATMSTI KSTTOPMN LINCAUSW NSTAK QDNBURNOK TMLIM ZBURNABR ZSYAUSWINC ZSYNAUSW ZSYNCHECKN ZSYNDEL /end DEF_CHARACTERISTIC
 /begin IN_MEASUREMENT B_adrsta_msg B_kha_msg B_staclr_msg B_staneut_msg B_stanodec_msg B_stanoinc_msg B_stanosav_msg B_stareset_msg B_vbmg_msg CEngDsT_tStrt EngStrt_stRstrtRsn Epm_nEng Epm_nEngDiff Epm_stSpd fho_msg HLSDem_nSetPLo SyC_stSub top_w_msg /end IN_MEASUREMENT
 /begin OUT_MEASUREMENT B_ad_msg B_incmxres_msg B_staa_msg kstaa_msg kstatmst_msg /end OUT_MEASUREMENT
 /begin LOC_MEASUREMENT adapdec_w adapinc_w adastepc_w adasteps adastep_w B_adapend B_ausw B_badburn B_kstaue B_nodec B_noinc B_staaLoc B_stadapon B_stano dkstaamn_w dkstaamx_w dkstaa_w dnburns_w dssttmst fho_loc_stadap kstaaLoc kstaold kstaoldon nmot_stadap nstat_loc_stadap qdnmot_w sststadap STADAP_save_FF.status tmstsst tststadap tststa_loc_stadap zvbausw zvbmg /end LOC_MEASUREMENT
 FUNCTION_VERSION "3.7.0" /end FUNCTION
/begin FUNCTION StatyCoorn_TqLimn "139.0.0   Stationary total torque limitation" /begin DEF_CHARACTERISTIC StatyCoorn_flgEnaBypCmpdTq_C /end DEF_CHARACTERISTIC
 /begin IN_MEASUREMENT CoEng_bCtOffConDel CoVeh_trqAcs LsComp_tqSwilLossNotFild PT_tqCluTrsmProtn RngMod_trqCrSMin RngMod_trqCrSMinWoCtOff TMERng_tqCrksftLeadMaxStabCdn VehMot_tqCluGenericLim VMD_tqCluDes /end IN_MEASUREMENT
 /begin OUT_MEASUREMENT StatyCoorn_flgEnaBypCmpdTq StatyCoorn_tqCluDesBefLimn StatyCoorn_tqCluDesLimd StatyCoorn_tqCluDrvDmdDes StatyCoorn_tqCluDrvrDmdGenericLimn StatyCoorn_tqCluLeadLimd StatyCoorn_tqCluMax StatyCoorn_tqCluMin /end OUT_MEASUREMENT
 /begin LOC_MEASUREMENT StatyCoorn_tqCluLeadEngMax StatyCoorn_tqCluLeadEngMin StatyCoorn_tqCluTotLeadMax StatyCoorn_tqCluTotLeadMin /end LOC_MEASUREMENT
 FUNCTION_VERSION "139.0.0" /end FUNCTION
/begin FUNCTION StbIntvECU_AYCA "11.3.0_6SAAReception process for the CAN frame AYCA"
 /begin DEF_CHARACTERISTIC Com_bAYCCond_C Com_bAYCReWr_C Com_ctAYCMonCond_C Com_ctCRingAYCA_C Com_dAYCAMaxDiff_C Com_dAYCAMaxPer_C Com_dAYCASigSel_C Com_numCsumAYCA_C Com_pMstCyl_C Com_stABSEBDFailr_C Com_stABSWrn_C Com_stActABSEBD_C Com_stFailMstCylPSnsr_C Com_stInhbMstCylPSnsr_C /end DEF_CHARACTERISTIC
 /begin IN_MEASUREMENT Com_bAYCCond Com_bAYCReWr Com_ctCRingAYCA Com_numCsumAYCA Com_pMstCyl Com_stABSCtrl Com_stABSEBDFailr Com_stABSWrn Com_stACCBrk Com_stActABSEBD Com_stCarAcsSysActv Com_stCarAcsSysPtdOper Com_stFailMstCylPSnsr Com_stFrmRxEna Com_stInhbMstCylPSnsr Com_stMon Com_stVSACtrl Com_stVSALampOff Com_stVSATCSFailr I14229_stABSFailCnclActv T15_st /end IN_MEASUREMENT
 /begin OUT_MEASUREMENT Com_pBrkP Com_pMstCylBrk Com_pMstCylTstr Com_stAYCMonEna StbIntv_bAYCIntvActv /end OUT_MEASUREMENT
 /begin LOC_MEASUREMENT Com_stAYCMonCond StbIntvECU_ctAYCARngCnt_MP /end LOC_MEASUREMENT
 FUNCTION_VERSION "11.3.0_6SAA" /end FUNCTION
/begin FUNCTION StbIntvECU_AYCD "8.3.0_6SAACAN messages of the Stability Intevention ECU (AYCD)" /begin DEF_CHARACTERISTIC Com_numCsumAYCD_C Com_vWhlSpd_C /end DEF_CHARACTERISTIC
 /begin IN_MEASUREMENT Com_numCsumAYCD Com_stAYCMonEna Com_stCANANoBusOff Com_stFrmRxEna Com_stMon Com_vFLWhlSpd Com_vFRWhlSpd Com_vRLWhlSpd Com_vRRWhlSpd T15_st /end IN_MEASUREMENT
 /begin OUT_MEASUREMENT Com_flgFLWhlSpdInvld Com_flgFRWhlSpdInvld Com_flgRLWhlSpdInvld Com_flgRRWhlSpdInvld Com_stRxAYCD Com_stRxAYCDChkSumOk Com_stRxAYCDDeb Com_stRxAYCDOk Com_vWhlFrntLe Com_vWhlFrntRi Com_vWhlReLe Com_vWhlReRi Com_vWhlSpd StbIntv_vWhlSpd /end OUT_MEASUREMENT
 FUNCTION_VERSION "8.3.0_6SAA" /end FUNCTION
/begin FUNCTION StbIntvECU_AYCF "9.3.0_6SAAReception process for the CAN frame AYCF"
 /begin DEF_CHARACTERISTIC Com_ctCRingAYCF_C Com_dAYCFMaxDiff_C Com_dAYCFMaxPer_C Com_numCsumAYCF_C Com_stAYCFShiftReq_C Com_stAYCF_C Com_stDCSPlusAYCF_C Com_stFuCtrlReq_C Com_stSwtCrpTqCorrn_C Com_trqAYCFDes_C StbIntv_stAYCFISSInhbReq_C /end DEF_CHARACTERISTIC
 /begin IN_MEASUREMENT Com_ctCRingAYCF Com_numCsumAYCF Com_rTrqCnvBoost Com_stAYCF Com_stAYCFShiftReq Com_stAYCMonEna Com_stDCSPlusAYCF Com_stFrmRxEna Com_stFuCtrlReqRaw Com_stMon Com_trqAYCFDes Conv_trqOilPmpLoss PT_rTrq PT_trqLos VehMot_rTrqDfftl /end IN_MEASUREMENT
 /begin OUT_MEASUREMENT Com_stAYCFFuCtrlReq Com_stAYCFRaw Com_trqAYCFDesRaw StbIntv_bDCSIntv StbIntv_bDCSNeutr StbIntv_bTCSIntv StbIntv_bTCSNeutr StbIntv_flgDCSPlusTrqReqd StbIntv_trqDCSDes StbIntv_trqTCSDes StbIntv_trqTCSLead /end OUT_MEASUREMENT
 /begin LOC_MEASUREMENT Com_rMulVehMotPT_MP Com_tqCrpTqDif_MP Com_trqAYCCnvBoost_MP Com_trqCrpTqAxleLvl_MP StbIntvECU_ctAYCFRngCnt_MP /end LOC_MEASUREMENT
 FUNCTION_VERSION "9.3.0_6SAA" /end FUNCTION
/begin FUNCTION StbIntvECU_AYCG "14.2.0_6SAAReception Process for the CAN frame AYCG"
 /begin DEF_CHARACTERISTIC Com_ctCRingAYCG_C Com_dAYCGMaxDiff_C Com_dAYCGMaxPer_C Com_numCsumAYCG_C Com_stFrntLeWhlSpdSnsrErr_C Com_stFrntRiWhlSpdSnsrErr_C Com_stLatGASensInh_C Com_stLgtGASensErr_C Com_stLgtGASensInh_C Com_stReLeWhlSpdSnsrErr_C Com_stReRiWhlSpdSnsrErr_C Com_stSteerSnsrInhb_C Com_stYawRateSnsrErr_C Com_stYawRateSnsrInhb_C Com_tqBrkOper_C /end DEF_CHARACTERISTIC
 /begin IN_MEASUREMENT Com_ctCRingAYCG Com_numCsumAYCG Com_stAYCMonEna Com_stCANANoBusOff Com_stFrmRxEna Com_stFrntLeWhlSpdSnsrErr Com_stFrntRiWhlSpdSnsrErr Com_stLatGASensInh Com_stLgtGASensErr Com_stLgtGASensInh Com_stMon Com_stReLeWhlSpdSnsrErr Com_stReRiWhlSpdSnsrErr Com_stSteerSnsrInhb Com_stYawRateSnsrErr Com_stYawRateSnsrInhb Com_tqBrkOperAYCG /end IN_MEASUREMENT
 /begin OUT_MEASUREMENT Com_stRxAYCG Com_stRxAYCGChkSumOk Com_stRxAYCGDeb Com_stRxAYCGOk Com_stRxAYCGRingCntOk /end OUT_MEASUREMENT
 /begin LOC_MEASUREMENT StbIntvECU_ctAYCGRngCnt_MP tqBrkOperAYCGOld /end LOC_MEASUREMENT
 FUNCTION_VERSION "14.2.0_6SAA" /end FUNCTION
/begin FUNCTION StbIntvECU_AYCI "2.2.0_6SAAReception process for the CAN frame AYCI" /begin DEF_CHARACTERISTIC Com_dAYCIMaxDiff_C Com_dAYCIMaxPer_C /end DEF_CHARACTERISTIC
 /begin IN_MEASUREMENT Com_ctCRingAYCI Com_numCsumAYCI Com_stFrmRxEna Com_stISABActAYCI Com_stISABEnaAYCI Com_stMon Com_tqBrkOperAYCI /end IN_MEASUREMENT
 /begin LOC_MEASUREMENT StbIntvECU_ctAYCIRngCnt_MP /end LOC_MEASUREMENT
 FUNCTION_VERSION "2.2.0_6SAA" /end FUNCTION
/begin FUNCTION StopCntrWakeup_Conf "147000.0.0_1.0.0Stop Counter Wakeup Mode Handling"
 /begin DEF_CHARACTERISTIC rba_StopCntrWakeup_Debug_C rba_StopCntrWakeup_MaxProlongCntr_C rba_StopCntrWakeup_stActv_C /end DEF_CHARACTERISTIC
 /begin OUT_MEASUREMENT rba_StopCntrWakeup_ProlongCntr rba_StopCntrWakeup_stIsWakeUp_u8 /end OUT_MEASUREMENT
 FUNCTION_VERSION "147000.0.0_1.0.0" /end FUNCTION
/begin FUNCTION StrgECU_EPS1 "5.2.0_6SAAReception process for the CAN frame EPS1" /begin DEF_CHARACTERISTIC Com_dEPS1MaxDiff_C Com_dEPS1MaxPer_C /end DEF_CHARACTERISTIC
 /begin IN_MEASUREMENT Com_ctCRingEPS1 Com_iElecLd Com_numCsumEPS1 Com_stEPS1ISSRelsReq Com_stEPSISSInhbReq Com_stEPSMidReq Com_stFrmRxEna Com_stMon /end IN_MEASUREMENT
 /begin OUT_MEASUREMENT Com_stEPSISSRstrtReq /end OUT_MEASUREMENT
 /begin LOC_MEASUREMENT StrgECU_ctRngCntEPS1_MP /end LOC_MEASUREMENT
 FUNCTION_VERSION "5.2.0_6SAA" /end FUNCTION
/begin COMPU_METHOD B_TRUE "" TAB_VERB "%6.3" "" COMPU_TAB_REF B_TRUE /end COMPU_METHOD
/begin COMPU_VTAB B_TRUE "" TAB_VERB 2 0 "FALSE" 1 "TRUE" /end COMPU_VTAB
/begin COMPU_METHOD dez "" RAT_FUNC "%6.2" "" COEFFS 0 1 0 0 0 1 /end COMPU_METHOD
/begin COMPU_METHOD EngN "" RAT_FUNC "%6.3" "rpm" COEFFS 0 2 0 0 0 1 /end COMPU_METHOD
/begin COMPU_METHOD EngNGrd "" RAT_FUNC "%6.3" "rpm/s" COEFFS 0 2 0 0 0 1 /end COMPU_METHOD
/begin COMPU_METHOD Fact "" RAT_FUNC "%6.5" "-" COEFFS 0 8192 0 0 0 1 /end COMPU_METHOD
/begin COMPU_METHOD fak_q0p0009766 "" RAT_FUNC "%6.5" "-" COEFFS 0 65536 0 0 0 64 /end COMPU_METHOD
/begin COMPU_METHOD fak_q0p01 "" RAT_FUNC "%6.4" "" COEFFS 0 100 0 0 0 1 /end COMPU_METHOD
/begin COMPU_METHOD fak_q0p015625 "" RAT_FUNC "%6.4" "-" COEFFS 0 64 0 0 0 1 /end COMPU_METHOD
/begin COMPU_METHOD fak_sb_b0p5 "" RAT_FUNC "%10.6" "" COEFFS 0 256 0 0 0 1 /end COMPU_METHOD
/begin COMPU_METHOD fak_sb_b2 "" RAT_FUNC "%6.4" "-" COEFFS 0 256 0 0 0 4 /end COMPU_METHOD
/begin COMPU_METHOD fak_sw_b4 "" RAT_FUNC "%6.5" "-" COEFFS 0 65536 0 0 0 8 /end COMPU_METHOD
/begin COMPU_METHOD fak_ub_b1 "" RAT_FUNC "%6.4" "-" COEFFS 0 256 0 0 0 1 /end COMPU_METHOD
/begin COMPU_METHOD fak_ub_b2 "" RAT_FUNC "%8.5" "-" COEFFS 0 256 0 0 0 2 /end COMPU_METHOD
/begin COMPU_METHOD fak_ub_b4 "" RAT_FUNC "%6.4" "-" COEFFS 0 256 0 0 0 4 /end COMPU_METHOD
/begin COMPU_METHOD fak_ub_q0p01 "" RAT_FUNC "%6.4" "-" COEFFS 0 1 0 0 0 0.01 /end COMPU_METHOD
/begin COMPU_METHOD fak_ub_q0p064 "" RAT_FUNC "%6.4" "" COEFFS 0 25600 0 0 0 1632 /end COMPU_METHOD
/begin COMPU_METHOD fak_uw_b2 "" RAT_FUNC "%7.6" "-" COEFFS 0 65536 0 0 0 2 /end COMPU_METHOD
/begin COMPU_METHOD md_q0p1 "" RAT_FUNC "%6.3" "Nm" COEFFS 0 10 0 0 0 1 /end COMPU_METHOD
/begin COMPU_METHOD md_sw_q0p1 "" RAT_FUNC "%6.3" "Nm" COEFFS 0 10 0 0 0 1 /end COMPU_METHOD
/begin COMPU_METHOD md_ub_q3p2 "" RAT_FUNC "%6.2" "Nm" COEFFS 0 10 0 0 0 32 /end COMPU_METHOD
/begin COMPU_METHOD nmot_q0p5 "" RAT_FUNC "%6.3" "1/min" COEFFS 0 2 0 0 0 1 /end COMPU_METHOD
/begin COMPU_METHOD nmot_q4 "" RAT_FUNC "%6.2" "U/min" COEFFS 0 1 0 0 0 4 /end COMPU_METHOD
/begin COMPU_METHOD nmot_sw_q0p25 "" RAT_FUNC "%6.3" "1/min" COEFFS 0 1 0 0 0 0.25 /end COMPU_METHOD
/begin COMPU_METHOD nmot_sw_q0p5 "" RAT_FUNC "%6.3" "1/min" COEFFS 0 2 0 0 0 1 /end COMPU_METHOD
/begin COMPU_METHOD nmot_ub_q10 "" RAT_FUNC "%6.1" "1/min" COEFFS 0 1 0 0 0 10 /end COMPU_METHOD
/begin COMPU_METHOD nmot_uw_q0p25 "" RAT_FUNC "%6.3" "1/min" COEFFS 0 1 0 0 0 0.25 /end COMPU_METHOD
/begin COMPU_METHOD OneToOne "" RAT_FUNC "%6.2" "-" COEFFS 0 1 0 0 0 1 /end COMPU_METHOD
/begin COMPU_METHOD Prc "" RAT_FUNC "%6.4" "%" COEFFS 0 81.92 0 0 0 1 /end COMPU_METHOD
/begin COMPU_METHOD PresAC_hPa "" RAT_FUNC "%6.2" "hPa" COEFFS 0 0.5 0 0 0 1 /end COMPU_METHOD
/begin COMPU_METHOD Pres_kPa_VSA "" RAT_FUNC "%6.1" "kPa" COEFFS 0 0.0417362270450751 0 0 0 1 /end COMPU_METHOD
/begin COMPU_METHOD p_q0p5_bar "" RAT_FUNC "%6.3" "bar" COEFFS 0 10 0 0 0 5 /end COMPU_METHOD
/begin COMPU_METHOD p_sw_q0p078 "" RAT_FUNC "%6.4" "hPa" COEFFS 0 65536 0 0 0 5120 /end COMPU_METHOD
/begin COMPU_METHOD p_sw_q0p312 "" RAT_FUNC "%6.3" "hPa" COEFFS 0 256 0 0 0 80 /end COMPU_METHOD
/begin COMPU_METHOD p_uw_q0p039 "" RAT_FUNC "%6.4" "hPa" COEFFS 0 256 0 0 0 10 /end COMPU_METHOD
/begin COMPU_METHOD q1p1921Em6_L_DIV_s "" RAT_FUNC "%8.7" "l/s" COEFFS 0 65536 0 0 0 0.078125 /end COMPU_METHOD
/begin COMPU_METHOD q3p05175Em3_min_Nm "" RAT_FUNC "%6.4" "minNm" COEFFS 0 8192 0 0 0 25 /end COMPU_METHOD
/begin COMPU_METHOD q3p052Em4_min_Nm_DIV_s "" RAT_FUNC "%6.5" "minNm/s" COEFFS 0 65536 0 0 0 20 /end COMPU_METHOD
/begin COMPU_METHOD rel_sw_b100 "" RAT_FUNC "%6.4" "%" COEFFS 0 32768 0 0 0 100 /end COMPU_METHOD
/begin COMPU_METHOD rel_sw_q0p02441 "" RAT_FUNC "%6.4" "%" COEFFS 0 65536 0 0 0 1600 /end COMPU_METHOD
/begin COMPU_METHOD rkti_q0p10416Em4 "" RAT_FUNC "%7.6" "ms/%" COEFFS 0 96000 0 0 0 1 /end COMPU_METHOD
/begin COMPU_METHOD rkti_q0p4166Em4 "" RAT_FUNC "%7.6" "ms/%" COEFFS 0 24000 0 0 0 1 /end COMPU_METHOD
/begin COMPU_METHOD RmpTrq "" RAT_FUNC "%6.4" "Nm/s" COEFFS 0 655.36 0 0 0 1 /end COMPU_METHOD
/begin COMPU_METHOD Rmp_Fact "" RAT_FUNC "%8.7" "1/s" COEFFS 0 536870.912 0 0 0 1 /end COMPU_METHOD
/begin COMPU_METHOD Signals_IntSigNumVerb "" TAB_VERB "%6.3" "" COMPU_TAB_REF Signals_IntSigNumVerb /end COMPU_METHOD
/begin COMPU_VTAB Signals_IntSigNumVerb "" TAB_VERB 783 0 "SIGNALS_Signals_Default" 1 "SIGNALS_APP_rUnFlt" 2 "SIGNALS_APP_r_sig" 3 "SIGNALS_APP_r_signal" 4 "SIGNALS_APP_uRaw1_signal" 5 "SIGNALS_APP_uRaw2_signal" 6 "SIGNALS_AbsLdCom8Bit_PID43h" 7 "SIGNALS_AccPed_tqMapBasd_BENG_signal" 8 "SIGNALS_AccPed_tqMapBasd_TRQB_signal" 9 "SIGNALS_ActMod_trqInr_signal" 10 "SIGNALS_AirC_uAnaRawClnt_signal" 11 "SIGNALS_Alt_iExctLim_signal" 12 "SIGNALS_Alt_rAltExct_signal" 13 "SIGNALS_Alt_uFinalDes_signal" 14 "SIGNALS_BattU_u" 15 "SIGNALS_BattU_uSens1_signal" 16 "SIGNALS_BattU_uSens2_s" 17 "SIGNALS_BattU_uSens_signal" 18 "SIGNALS_Batt_lMaxCnsChk_signal" 19 "SIGNALS_Batt_lMinCnsChk_signal" 20 "SIGNALS_Batt_qCnsChkAH_signal" 21 "SIGNALS_Brk_st" 22 "SIGNALS_Brk_stRed" 23 "SIGNALS_CEngDsT_uRaw_s" 24 "SIGNALS_CoEng_tiCranking_signal" 25 "SIGNALS_CoEng_tiScneEngStrtPrmIdH1F_signal" 26 "SIGNALS_CoVeh_trqAcs_s" 27 "SIGNALS_ComEBS_BattID_signal" 28 "SIGNALS_ComEBS_rBattSensCh_signal" 29 "SIGNALS_ComEBS_uBattSens_signal" 30 "SIGNALS_ComEBS_uBattUCO_signal" 31 "SIGNALS_Com_iBattEBS_signal" 32 "SIGNALS_Com_lDst_signal" 33 "SIGNALS_Com_rMeasdBattREbs_signal" 34 "SIGNALS_Com_tBattEBS_signal" 35 "SIGNALS_Com_trqAYCFDes_signal" 36 "SIGNALS_Com_uPeak_signal" 37 "SIGNALS_CrCtl_stShutOffCode0_signal" 38 "SIGNALS_CrCtl_stShutOffCode1_signal" 39 "SIGNALS_CrCtl_stShutOffCode2_signal" 40 "SIGNALS_CrCtl_stShutOffCode3_signal" 41 "SIGNALS_CrCtl_stShutOffCode4_signal" 42 "SIGNALS_CrCtl_stShutOffCode5_signal" 43 "SIGNALS_CrCtl_stShutOffCode6_signal" 44 "SIGNALS_CrCtl_stShutOffCode7_signal" 45 "SIGNALS_CrCtl_stShutOffCode8_signal" 46 "SIGNALS_CrCtl_stShutOffCode9_signal" 47 "SIGNALS_DIUMPR_ctGenDenom_signal" 48 "SIGNALS_DIUMPR_ctIgn_signal" 49 "SIGNALS_DRIVE_numDTCFrz_s" 50 "SIGNALS_DRIVE_stCurTrgMode_signal" 51 "SIGNALS_DRIVE_stHardToStrt_s" 52 "SIGNALS_DSMDur_ctPID21h_signal" 53 "SIGNALS_DSMDur_ctPID31h_signal" 54 "SIGNALS_DcmDspUDS_rdbi_2612Byte10_signal" 55 "SIGNALS_DcmDspUDS_rdbi_2612Byte11_signal" 56 "SIGNALS_DcmDspUDS_rdbi_fixed_signal" 57 "SIGNALS_DcmDspUDS_rdbi_reserved0_signal_s" 58 "SIGNALS_DcmDspUDS_rdbi_reserved0_signal_w_s" 59 "SIGNALS_DcmDspUDS_rdbi_reserved1_signal" 60 "SIGNALS_Dspl_stCrsSwtInfo_signal" 61 "SIGNALS_Ebs_qBliChrg_signal" 62 "SIGNALS_Ebs_qBliDchaTotDcyc_0_signal" 63 "SIGNALS_Ebs_qBliDchaTotDcyc_1_signal" 64 "SIGNALS_Ebs_qBliDchaTotDcyc_2_signal" 65 "SIGNALS_Ebs_qBliDchaTotDcyc_3_signal" 66 "SIGNALS_Ebs_qBliDchaTotDcyc_4_signal" 67 "SIGNALS_Ebs_qBliDcha_signal" 68 "SIGNALS_Ebs_stStbIEBSByt0_0_signal" 69 "SIGNALS_Ebs_stStbIEBSByt0_1_signal" 70 "SIGNALS_Ebs_stStbIEBSByt0_2_signal" 71 "SIGNALS_Ebs_stStbIEBSByt0_3_signal" 72 "SIGNALS_Ebs_stStbIEBSByt0_4_signal" 73 "SIGNALS_Ebs_stStbIEBSByt1_0_signal" 74 "SIGNALS_Ebs_stStbIEBSByt1_1_signal" 75 "SIGNALS_Ebs_stStbIEBSByt1_2_signal" 76 "SIGNALS_Ebs_stStbIEBSByt1_3_signal" 77 "SIGNALS_Ebs_stStbIEBSByt1_4_signal" 78 "SIGNALS_Ebs_stStbIEBSByt2_0_signal" 79 "SIGNALS_Ebs_stStbIEBSByt2_1_signal" 80 "SIGNALS_Ebs_stStbIEBSByt2_2_signal" 81 "SIGNALS_Ebs_stStbIEBSByt2_3_signal" 82 "SIGNALS_Ebs_stStbIEBSByt2_4_signal" 83 "SIGNALS_Ebs_stStbIEBSByt3_0_signal" 84 "SIGNALS_Ebs_stStbIEBSByt3_1_signal" 85 "SIGNALS_Ebs_stStbIEBSByt3_2_signal" 86 "SIGNALS_Ebs_stStbIEBSByt3_3_signal" 87 "SIGNALS_Ebs_stStbIEBSByt3_4_signal" 88 "SIGNALS_Ebs_stStbIEBSByt4_0_signal" 89 "SIGNALS_Ebs_stStbIEBSByt4_1_signal" 90 "SIGNALS_Ebs_stStbIEBSByt4_2_signal" 91 "SIGNALS_Ebs_stStbIEBSByt4_3_signal" 92 "SIGNALS_Ebs_stStbIEBSByt4_4_signal" 93 "SIGNALS_EngTrqPtd_trqLead_s" 94 "SIGNALS_EngTrqPtd_trqLead_signal" 95 "SIGNALS_EngTrqPtd_trqSet_s" 96 "SIGNALS_EngTrqPtd_trqSet_signal" 97 "SIGNALS_EpmCaS_ctErrSig_signal" 98 "SIGNALS_EpmCaS_ctNoSig_signal" 99 "SIGNALS_EpmCaS_phiDiffCal2AdapEqAvg_0" 100 "SIGNALS_EpmCaS_phiOfsCorr" 101 "SIGNALS_EpmCrS_ctCaSRev_mp_signal" 102 "SIGNALS_EpmCrS_ctErrSig_signal" 103 "SIGNALS_Epm_nEngAct" 104 "SIGNALS_Epm_nEngRaw_s" 105 "SIGNALS_Epm_nEngRaw_signal" 106 "SIGNALS_Epm_stOpMode" 107 "SIGNALS_Epm_stSync" 108 "SIGNALS_ExhMod_tCat1B1_signal" 109 "SIGNALS_GlbDa_lenTotDstDcycHiResl_signal" 110 "SIGNALS_HEGO_uS2B1Extd_s" 111 "SIGNALS_HEGO_uS2B1HiRes_signal" 112 "SIGNALS_I14229CoEng_tiNormalOBDPrevDcyc_s" 113 "SIGNALS_I14229GlbDa_lTotDstDCHiReslPrevDcyc_s" 114 "SIGNALS_I14229IntkAirT_tSnsrTstrMax_s" 115 "SIGNALS_I14229IntkAirT_tSnsrTstrMin_s" 116 "SIGNALS_I14229RDBI_nOvrSpd_signal" 117 "SIGNALS_I14229RDBI_tiOvrSpd_signal" 118 "SIGNALS_I14229_ElecLd_iEPSLoadOnly_signal" 119 "SIGNALS_I14229_EpmCrS_ctErrSig_signal" 120 "SIGNALS_I14229_ivzabg_w_signal" 121 "SIGNALS_I14229_lDst_signal" 122 "SIGNALS_I14229_ml_w_msg_signal" 123 "SIGNALS_I14229_nstat_signal" 124 "SIGNALS_I14229_numDTCFrzFrmHi_signal" 125 "SIGNALS_I14229_numDTCFrzFrmLo_signal" 126 "SIGNALS_I14229_numDTCFrzFrmMid_signal" 127 "SIGNALS_I14229_ps_w_signal" 128 "SIGNALS_I14229_rTrqPT_signal" 129 "SIGNALS_I14229_tSnsrFild1_signal" 130 "SIGNALS_I14229_tiInj1On_signal" 131 "SIGNALS_I14229_tiOilFlowCompl_signal" 132 "SIGNALS_I14229_tiSia_signal" 133 "SIGNALS_I14229_tkaMax_s" 134 "SIGNALS_I14229_tkaMin_s" 135 "SIGNALS_I14229_tka_signal" 136 "SIGNALS_I14229_tmotMaxCurrDcyc_s" 137 "SIGNALS_I14229_tmotMaxPrevDcyc_s" 138 "SIGNALS_I14229_tmotMinCurrDcyc_s" 139 "SIGNALS_I14229_tmotMinPrevDcyc_s" 140 "SIGNALS_I14229_ubsq_signal" 141 "SIGNALS_I14229_umsrln_w_signal" 142 "SIGNALS_I14229_wdks_w_signal" 143 "SIGNALS_I14229_wped1_signal" 144 "SIGNALS_I14229_wped2_signal" 145 "SIGNALS_I14229_zwist_signal" 146 "SIGNALS_I14229iocpMDA_numACGC_signal" 147 "SIGNALS_I14229iocpMDA_numAPS_signal" 148 "SIGNALS_I14229iocpMDA_numPSC_signal" 149 "SIGNALS_I14229iocpMDA_numRFAN_signal" 150 "SIGNALS_I14229iocpMDA_numVTEC_signal" 151 "SIGNALS_I14229iocp_numCtlSt_s" 152 "SIGNALS_I14229iocp_numEXE_signal" 153 "SIGNALS_I14229iocp_numREQ_s" 154 "SIGNALS_I14229iocp_stSFTRJC_s" 155 "SIGNALS_I15031_PID1Dh" 156 "SIGNALS_I15031_PID65Ah" 157 "SIGNALS_I15031_PID66Ah" 158 "SIGNALS_I15031_PID68Ah" 159 "SIGNALS_I15031_PID69Ah" 160 "SIGNALS_I15031_PID6AAh" 161 "SIGNALS_I15031_PID6BAh" 162 "SIGNALS_I15031_PID6CAh" 163 "SIGNALS_I15031_PID6DAh" 164 "SIGNALS_I15031_PID6EAh" 165 "SIGNALS_I15031_PID6FAh" 166 "SIGNALS_I15031_PID70Ah" 167 "SIGNALS_I15031_PID71Ah" 168 "SIGNALS_I15031_PID72Ah" 169 "SIGNALS_I15031_PID73Ah" 170 "SIGNALS_I15031_PID74Ah" 171 "SIGNALS_I15031_PID75Ah" 172 "SIGNALS_I15031_PID76Ah" 173 "SIGNALS_I15031_PID77Ah" 174 "SIGNALS_I15031_PID78Ah" 175 "SIGNALS_I15031_PID79Ah" 176 "SIGNALS_I15031_PID7AAh" 177 "SIGNALS_I15031_PID7BAh" 178 "SIGNALS_I15031_PID7CAh" 179 "SIGNALS_I15031_PID7FAh" 180 "SIGNALS_I15031_PID81Ah" 181 "SIGNALS_I15031_PID82Ah" 182 "SIGNALS_I15031_PID85Ah" 183 "SIGNALS_I15031_PID86Ah" 184 "SIGNALS_I15031_PID87Ah" 185 "SIGNALS_I15031_PID89Ah" 186 "SIGNALS_I15031_PID8AAh" 187 "SIGNALS_I15031_PID8FAh" 188 "SIGNALS_I15031_PID92Ah" 189 "SIGNALS_I15031_PID93Ah" 190 "SIGNALS_I15031_PID94Ah" 191 "SIGNALS_I15031_PID98Ah" 192 "SIGNALS_I15031_PID99Ah" 193 "SIGNALS_I15031_PID9CAh" 194 "SIGNALS_I15031_PIDA3Ah" 195 "SIGNALS_I15031_PIDA4Ah" 196 "SIGNALS_I15031_PIDA5Ah" 197 "SIGNALS_I15031_PIDA9Ah" 198 "SIGNALS_I15031_PIDACAh" 199 "SIGNALS_IKCtl_agAdpnCurr_s16_signal" 200 "SIGNALS_IKCtl_agKnkAvrg_s8_signal" 201 "SIGNALS_InjSys_volFuConsDrvCycCAN_s" 202 "SIGNALS_IntkAirT_uSnsr1Exprt_signal" 203 "SIGNALS_IntkAirT_uSnsr3CrssSwtLoc_s" 204 "SIGNALS_MoF_rTrqInrAct_s" 205 "SIGNALS_MoF_rTrqPtdFlt_s" 206 "SIGNALS_OilLfT_degOilDetern_signal" 207 "SIGNALS_OilSwmpT_uSnsrRaw_s" 208 "SIGNALS_PID01h" 209 "SIGNALS_PID03h_0" 210 "SIGNALS_PID03h_1" 211 "SIGNALS_PID04h" 212 "SIGNALS_PID05h" 213 "SIGNALS_PID06h_0" 214 "SIGNALS_PID07h_0" 215 "SIGNALS_PID0Ch_Epm_nEng" 216 "SIGNALS_PID0D_VehV_vSens" 217 "SIGNALS_PID0Eh" 218 "SIGNALS_PID0Fh" 219 "SIGNALS_PID0Fh_s" 220 "SIGNALS_PID0bh" 221 "SIGNALS_PID0bh_PIntkVUs_pRawObd" 222 "SIGNALS_PID11h_ThrVlv_ratActSens1AbsltB1_u8" 223 "SIGNALS_PID13h" 224 "SIGNALS_PID15h_0" 225 "SIGNALS_PID15h_1" 226 "SIGNALS_PID1Ch" 227 "SIGNALS_PID1Fh_TiScneEngStrt" 228 "SIGNALS_PID21h" 229 "SIGNALS_PID2Eh" 230 "SIGNALS_PID30h" 231 "SIGNALS_PID31h" 232 "SIGNALS_PID33h_PEnv_pRaw" 233 "SIGNALS_PID34h_0" 234 "SIGNALS_PID34h_1" 235 "SIGNALS_PID3Ch" 236 "SIGNALS_PID42_BattU_uSens" 237 "SIGNALS_PID43h" 238 "SIGNALS_PID44h" 239 "SIGNALS_PID45h_ThrVlv_ratActSens1RelB1_u8" 240 "SIGNALS_PID46h" 241 "SIGNALS_PID47h_ThrVlv_ratActSens2AbsltB1_u8" 242 "SIGNALS_PID49_APP_uRaw1unLim" 243 "SIGNALS_PID4A_APP_uRaw2unLim" 244 "SIGNALS_PID4Ch_wdks_msg" 245 "SIGNALS_PID4FAh" 246 "SIGNALS_PID4FBh" 247 "SIGNALS_PID4FCh" 248 "SIGNALS_PID4FDh" 249 "SIGNALS_PID50Ah" 250 "SIGNALS_PID50Bh" 251 "SIGNALS_PID50Ch" 252 "SIGNALS_PID50Dh" 253 "SIGNALS_PID51h_PID51_stFuTyp" 254 "SIGNALS_PID56h_0" 255 "SIGNALS_PID5A_APP_rOBDPID5A" 256 "SIGNALS_PID5Fh" 257 "SIGNALS_PID62h_TME_ratActEngPercTqPrmIdH62" 258 "SIGNALS_IntFloat_PID63h_TqEngRef" 259 "SIGNALS_PID67h_ects2sva_msg" 260 "SIGNALS_PID67h_ects2svb_msg" 261 "SIGNALS_PID67h_ects2svc_msg" 262 "SIGNALS_PID68h_iats2svb" 263 "SIGNALS_PID68h_iats2svc" 264 "SIGNALS_PID68h_iats2svd" 265 "SIGNALS_PID68h_iats2sve" 266 "SIGNALS_PID68h_iats2svf" 267 "SIGNALS_PID68h_iats2svg" 268 "SIGNALS_PID7Fh_RTId_TotRt" 269 "SIGNALS_PID7Fh_RtId_TotIdleRt" 270 "SIGNALS_PID7Fh_RtId_TotPtoRt" 271 "SIGNALS_PID87h_PIntkVUs_pRawObd" 272 "SIGNALS_PID8BAh" 273 "SIGNALS_PID8CAh" 274 "SIGNALS_PID8Eh_TME_ratEngFricPercTqPrmIdH8E" 275 "SIGNALS_PID9AAh" 276 "SIGNALS_PID9Dh_InjSys_mfEngFuRate" 277 "SIGNALS_PID9Dh_InjSys_mfVehFuRate" 278 "SIGNALS_PID9FAh" 279 "SIGNALS_PIDA6h_lTotDst" 280 "SIGNALS_PID_FILLSIG_1BIT" 281 "SIGNALS_PID_FILLSIG_1BITNZ" 282 "SIGNALS_PID_FILLSIG_1BYTE" 283 "SIGNALS_PID_FILLSIG_1BYTENZ" 284 "SIGNALS_PID_FILLSIG_2BIT" 285 "SIGNALS_PID_FILLSIG_2BITNZ" 286 "SIGNALS_PID_FILLSIG_2BYTE" 287 "SIGNALS_PID_FILLSIG_2BYTENZ" 288 "SIGNALS_PID_FILLSIG_3BIT" 289 "SIGNALS_PID_FILLSIG_3BITNZ" 290 "SIGNALS_PID_FILLSIG_4BIT" 291 "SIGNALS_PID_FILLSIG_4BITNZ" 292 "SIGNALS_PID_FILLSIG_4BYTE" 293 "SIGNALS_PID_FILLSIG_4BYTENZ" 294 "SIGNALS_PID_FILLSIG_5BIT" 295 "SIGNALS_PID_FILLSIG_5BITNZ" 296 "SIGNALS_PID_FILLSIG_6BIT" 297 "SIGNALS_PID_FILLSIG_6BITNZ" 298 "SIGNALS_PID_FILLSIG_7BIT" 299 "SIGNALS_PID_FILLSIG_7BITNZ" 300 "SIGNALS_PIntkVUs_uRawUnFlt_signal" 301 "SIGNALS_PT_rGrip_signal" 302 "SIGNALS_PT_trqLos_signal" 303 "SIGNALS_PtCoornDyn_tqCluDes_signal" 304 "SIGNALS_PtCoornDyn_tqCluLeadTrsmIntv_signal" 305 "SIGNALS_PthLead_trqInrNoMon_s" 306 "SIGNALS_PthLead_trqInrNoMon_signal" 307 "SIGNALS_PthSet_trqInrIABef_s" 308 "SIGNALS_PthSet_trqInrLtd_s" 309 "SIGNALS_RngMod_trqDiffAdap_signal" 310 "SIGNALS_RngMod_trqInrBs_s" 311 "SIGNALS_TWCD_numMeasB1_s" 312 "SIGNALS_TWCD_rOSCAvrgPriB1_s" 313 "SIGNALS_ThrVlv_uRawSens1B1_signal" 314 "SIGNALS_ThrVlv_uRawSens2B1_signal" 315 "SIGNALS_TiEngOff_ti_signal" 316 "SIGNALS_UEGO_ratLamSrv1S1B1_signal" 317 "SIGNALS_VehStc_numFuDiagRecA_0_s" 318 "SIGNALS_VehStc_numFuDiagRecA_10_s" 319 "SIGNALS_VehStc_numFuDiagRecA_11_s" 320 "SIGNALS_VehStc_numFuDiagRecA_12_s" 321 "SIGNALS_VehStc_numFuDiagRecA_13_s" 322 "SIGNALS_VehStc_numFuDiagRecA_14_s" 323 "SIGNALS_VehStc_numFuDiagRecA_15_s" 324 "SIGNALS_VehStc_numFuDiagRecA_16_s" 325 "SIGNALS_VehStc_numFuDiagRecA_17_s" 326 "SIGNALS_VehStc_numFuDiagRecA_18_s" 327 "SIGNALS_VehStc_numFuDiagRecA_19_s" 328 "SIGNALS_VehStc_numFuDiagRecA_1_s" 329 "SIGNALS_VehStc_numFuDiagRecA_20_s" 330 "SIGNALS_VehStc_numFuDiagRecA_2_s" 331 "SIGNALS_VehStc_numFuDiagRecA_3_s" 332 "SIGNALS_VehStc_numFuDiagRecA_4_s" 333 "SIGNALS_VehStc_numFuDiagRecA_5_s" 334 "SIGNALS_VehStc_numFuDiagRecA_6_s" 335 "SIGNALS_VehStc_numFuDiagRecA_7_s" 336 "SIGNALS_VehStc_numFuDiagRecA_8_s" 337 "SIGNALS_VehStc_numFuDiagRecA_9_s" 338 "SIGNALS_VehStc_numMisfDetnHiEctA_0_s" 339 "SIGNALS_VehStc_numMisfDetnHiEctA_10_s" 340 "SIGNALS_VehStc_numMisfDetnHiEctA_11_s" 341 "SIGNALS_VehStc_numMisfDetnHiEctA_12_s" 342 "SIGNALS_VehStc_numMisfDetnHiEctA_13_s" 343 "SIGNALS_VehStc_numMisfDetnHiEctA_14_s" 344 "SIGNALS_VehStc_numMisfDetnHiEctA_15_s" 345 "SIGNALS_VehStc_numMisfDetnHiEctA_16_s" 346 "SIGNALS_VehStc_numMisfDetnHiEctA_17_s" 347 "SIGNALS_VehStc_numMisfDetnHiEctA_18_s" 348 "SIGNALS_VehStc_numMisfDetnHiEctA_19_s" 349 "SIGNALS_VehStc_numMisfDetnHiEctA_1_s" 350 "SIGNALS_VehStc_numMisfDetnHiEctA_20_s" 351 "SIGNALS_VehStc_numMisfDetnHiEctA_2_s" 352 "SIGNALS_VehStc_numMisfDetnHiEctA_3_s" 353 "SIGNALS_VehStc_numMisfDetnHiEctA_4_s" 354 "SIGNALS_VehStc_numMisfDetnHiEctA_5_s" 355 "SIGNALS_VehStc_numMisfDetnHiEctA_6_s" 356 "SIGNALS_VehStc_numMisfDetnHiEctA_7_s" 357 "SIGNALS_VehStc_numMisfDetnHiEctA_8_s" 358 "SIGNALS_VehStc_numMisfDetnHiEctA_9_s" 359 "SIGNALS_VehStc_numMisfDetnLoEctA_0_s" 360 "SIGNALS_VehStc_numMisfDetnLoEctA_10_s" 361 "SIGNALS_VehStc_numMisfDetnLoEctA_11_s" 362 "SIGNALS_VehStc_numMisfDetnLoEctA_12_s" 363 "SIGNALS_VehStc_numMisfDetnLoEctA_13_s" 364 "SIGNALS_VehStc_numMisfDetnLoEctA_14_s" 365 "SIGNALS_VehStc_numMisfDetnLoEctA_15_s" 366 "SIGNALS_VehStc_numMisfDetnLoEctA_16_s" 367 "SIGNALS_VehStc_numMisfDetnLoEctA_17_s" 368 "SIGNALS_VehStc_numMisfDetnLoEctA_18_s" 369 "SIGNALS_VehStc_numMisfDetnLoEctA_19_s" 370 "SIGNALS_VehStc_numMisfDetnLoEctA_1_s" 371 "SIGNALS_VehStc_numMisfDetnLoEctA_20_s" 372 "SIGNALS_VehStc_numMisfDetnLoEctA_2_s" 373 "SIGNALS_VehStc_numMisfDetnLoEctA_3_s" 374 "SIGNALS_VehStc_numMisfDetnLoEctA_4_s" 375 "SIGNALS_VehStc_numMisfDetnLoEctA_5_s" 376 "SIGNALS_VehStc_numMisfDetnLoEctA_6_s" 377 "SIGNALS_VehStc_numMisfDetnLoEctA_7_s" 378 "SIGNALS_VehStc_numMisfDetnLoEctA_8_s" 379 "SIGNALS_VehStc_numMisfDetnLoEctA_9_s" 380 "SIGNALS_VehStc_numMisfDetnNormA_0_s" 381 "SIGNALS_VehStc_numMisfDetnNormA_10_s" 382 "SIGNALS_VehStc_numMisfDetnNormA_11_s" 383 "SIGNALS_VehStc_numMisfDetnNormA_12_s" 384 "SIGNALS_VehStc_numMisfDetnNormA_13_s" 385 "SIGNALS_VehStc_numMisfDetnNormA_14_s" 386 "SIGNALS_VehStc_numMisfDetnNormA_15_s" 387 "SIGNALS_VehStc_numMisfDetnNormA_16_s" 388 "SIGNALS_VehStc_numMisfDetnNormA_17_s" 389 "SIGNALS_VehStc_numMisfDetnNormA_18_s" 390 "SIGNALS_VehStc_numMisfDetnNormA_19_s" 391 "SIGNALS_VehStc_numMisfDetnNormA_1_s" 392 "SIGNALS_VehStc_numMisfDetnNormA_20_s" 393 "SIGNALS_VehStc_numMisfDetnNormA_2_s" 394 "SIGNALS_VehStc_numMisfDetnNormA_3_s" 395 "SIGNALS_VehStc_numMisfDetnNormA_4_s" 396 "SIGNALS_VehStc_numMisfDetnNormA_5_s" 397 "SIGNALS_VehStc_numMisfDetnNormA_6_s" 398 "SIGNALS_VehStc_numMisfDetnNormA_7_s" 399 "SIGNALS_VehStc_numMisfDetnNormA_8_s" 400 "SIGNALS_VehStc_numMisfDetnNormA_9_s" 401 "SIGNALS_VehStc_rDiagRsltB1A_0_s" 402 "SIGNALS_VehStc_rDiagRsltB1A_1_s" 403 "SIGNALS_VehStc_rDiagRsltB1A_2_s" 404 "SIGNALS_VehStc_rDiagRsltB1A_3_s" 405 "SIGNALS_VehStc_rDiagRsltB1A_4_s" 406 "SIGNALS_VehV_a" 407 "SIGNALS_VehV_v" 408 "SIGNALS_VehV_vSens_signal" 409 "SIGNALS_flglrs_msg_s" 410 "SIGNALS_fra_w_msg_signal" 411 "SIGNALS_fra_w_s" 412 "SIGNALS_ftead_w_msg_s" 413 "SIGNALS_ftead_w_si" 414 "SIGNALS_ftead_w_signal" 415 "SIGNALS_lamsobd_w_msg_s" 416 "SIGNALS_lutskzyl_w_0_signal" 417 "SIGNALS_lutskzyl_w_1_signal" 418 "SIGNALS_lutskzyl_w_2_signal" 419 "SIGNALS_lutskzyl_w_3_signal" 420 "SIGNALS_lutskzyl_w_msg_0_signal" 421 "SIGNALS_lutskzyl_w_msg_1_signal" 422 "SIGNALS_lutskzyl_w_msg_2_signal" 423 "SIGNALS_lutskzyl_w_msg_3_signal" 424 "SIGNALS_ofmsndkh1_w_msg_signal" 425 "SIGNALS_ofmsndkh2_w_msg_signal" 426 "SIGNALS_ora_w_msg_signal" 427 "SIGNALS_tateout_w_msg_signal" 428 "SIGNALS_tateout_w_signal" 429 "SIGNALS_tatesoll_w_msg_signal" 430 "SIGNALS_tmst_signal" 431 "SIGNALS_wkratst_signal" 432 "SIGNALS_PID83h_A_BitCombineSignal" 433 "SIGNALS_PID9Bh_A_BitCombineSignal" 434 "SIGNALS_PIDA1h_A_BitCombineSignal" 435 "SIGNALS_PIDA7h_A_BitCombineSignal" 436 "SIGNALS_PIDA8h_A_BitCombineSignal" 437 "SIGNALS_Virtual_CEngDsT_uRaw_signal" 438 "SIGNALS_Virtual_DcmDspUDS_2600Byte06_signal" 439 "SIGNALS_Virtual_DcmDspUDS_2610Byte00_signal" 440 "SIGNALS_Virtual_DcmDspUDS_2610Byte01_signal" 441 "SIGNALS_Virtual_DcmDspUDS_2610Byte02_signal" 442 "SIGNALS_Virtual_DcmDspUDS_2610Byte03_signal" 443 "SIGNALS_Virtual_DcmDspUDS_2610Byte04_signal" 444 "SIGNALS_Virtual_DcmDspUDS_2610Byte05_signal" 445 "SIGNALS_Virtual_DcmDspUDS_2610Byte10_signal" 446 "SIGNALS_Virtual_DcmDspUDS_2610Byte1F_signal" 447 "SIGNALS_Virtual_DcmDspUDS_2610Byte20_signal" 448 "SIGNALS_Virtual_DcmDspUDS_2610Byte25_signal" 449 "SIGNALS_Virtual_DcmDspUDS_2610Byte26_signal" 450 "SIGNALS_Virtual_DcmDspUDS_2611Byte00_signal" 451 "SIGNALS_Virtual_DcmDspUDS_2611Byte01_signal" 452 "SIGNALS_Virtual_DcmDspUDS_2611Byte02_signal" 453 "SIGNALS_Virtual_DcmDspUDS_2611Byte03_signal" 454 "SIGNALS_Virtual_DcmDspUDS_2611Byte04_signal" 455 "SIGNALS_Virtual_DcmDspUDS_2611Byte05_signal" 456 "SIGNALS_Virtual_DcmDspUDS_2611Byte06_07_signal" 457 "SIGNALS_Virtual_DcmDspUDS_2611Byte2A_signal" 458 "SIGNALS_Virtual_DcmDspUDS_2611Byte2B_signal" 459 "SIGNALS_Virtual_DcmDspUDS_2612Byte00_signal" 460 "SIGNALS_Virtual_DcmDspUDS_2612Byte01_signal" 461 "SIGNALS_Virtual_DcmDspUDS_2612Byte02_signal" 462 "SIGNALS_Virtual_DcmDspUDS_2612Byte03_signal" 463 "SIGNALS_Virtual_DcmDspUDS_2612Byte04_signal" 464 "SIGNALS_Virtual_DcmDspUDS_2612Byte05_signal" 465 "SIGNALS_Virtual_DcmDspUDS_2612Byte14_signal" 466 "SIGNALS_Virtual_DcmDspUDS_2612Byte15_signal" 467 "SIGNALS_Virtual_DcmDspUDS_2612Byte16_signal" 468 "SIGNALS_Virtual_DcmDspUDS_2612Byte17_signal" 469 "SIGNALS_Virtual_DcmDspUDS_2612Byte29_signal" 470 "SIGNALS_Virtual_DcmDspUDS_2612Byte2A_signal" 471 "SIGNALS_Virtual_DcmDspUDS_2612Byte2B_signal" 472 "SIGNALS_Virtual_DcmDspUDS_2613Byte00_signal" 473 "SIGNALS_Virtual_DcmDspUDS_2613Byte01_signal" 474 "SIGNALS_Virtual_DcmDspUDS_2613Byte02_signal" 475 "SIGNALS_Virtual_DcmDspUDS_2613Byte03_signal" 476 "SIGNALS_Virtual_DcmDspUDS_2613Byte04_signal" 477 "SIGNALS_Virtual_DcmDspUDS_2613Byte05_signal" 478 "SIGNALS_Virtual_DcmDspUDS_2620Byte00_signal" 479 "SIGNALS_Virtual_DcmDspUDS_2620Byte01_signal" 480 "SIGNALS_Virtual_DcmDspUDS_2620Byte02_signal" 481 "SIGNALS_Virtual_DcmDspUDS_2620Byte03_signal" 482 "SIGNALS_Virtual_DcmDspUDS_2620Byte04_signal" 483 "SIGNALS_Virtual_DcmDspUDS_2620Byte05_signal" 484 "SIGNALS_Virtual_DcmDspUDS_2621Byte00_signal" 485 "SIGNALS_Virtual_DcmDspUDS_2621Byte01_signal" 486 "SIGNALS_Virtual_DcmDspUDS_2621Byte02_signal" 487 "SIGNALS_Virtual_DcmDspUDS_2621Byte03_signal" 488 "SIGNALS_Virtual_DcmDspUDS_2621Byte04_signal" 489 "SIGNALS_Virtual_DcmDspUDS_2621Byte05_signal" 490 "SIGNALS_Virtual_DcmDspUDS_2622Byte00_signal" 491 "SIGNALS_Virtual_DcmDspUDS_2622Byte01_signal" 492 "SIGNALS_Virtual_DcmDspUDS_2622Byte02_signal" 493 "SIGNALS_Virtual_DcmDspUDS_2622Byte03_signal" 494 "SIGNALS_Virtual_DcmDspUDS_2622Byte04_signal" 495 "SIGNALS_Virtual_DcmDspUDS_2622Byte05_signal" 496 "SIGNALS_Virtual_DcmDspUDS_2623Byte00_signal" 497 "SIGNALS_Virtual_DcmDspUDS_2623Byte01_signal" 498 "SIGNALS_Virtual_DcmDspUDS_2623Byte02_signal" 499 "SIGNALS_Virtual_DcmDspUDS_2623Byte03_signal" 500 "SIGNALS_Virtual_DcmDspUDS_2623Byte04_signal" 501 "SIGNALS_Virtual_DcmDspUDS_2623Byte05_signal" 502 "SIGNALS_Virtual_DcmDspUDS_2660Byte0_signal" 503 "SIGNALS_Virtual_DcmDspUDS_2660Byte15_signal" 504 "SIGNALS_Virtual_DcmDspUDS_2660Byte16_signal" 505 "SIGNALS_Virtual_DcmDspUDS_2660Byte17_signal" 506 "SIGNALS_Virtual_DcmDspUDS_2660Byte18_signal" 507 "SIGNALS_Virtual_DcmDspUDS_2660Byte19_signal" 508 "SIGNALS_Virtual_DcmDspUDS_2660Byte1A_signal" 509 "SIGNALS_Virtual_DcmDspUDS_2660Byte1B_signal" 510 "SIGNALS_Virtual_DcmDspUDS_2660Byte1C_signal" 511 "SIGNALS_Virtual_DcmDspUDS_2660Byte1D_signal" 512 "SIGNALS_Virtual_DcmDspUDS_2660Byte1E_signal" 513 "SIGNALS_Virtual_DcmDspUDS_2660Byte1_signal" 514 "SIGNALS_Virtual_DcmDspUDS_2660Byte2_signal" 515 "SIGNALS_Virtual_DcmDspUDS_2660Byte3_signal" 516 "SIGNALS_Virtual_DcmDspUDS_2660Byte4_signal" 517 "SIGNALS_Virtual_DcmDspUDS_2660Byte5_signal" 518 "SIGNALS_Virtual_DcmDspUDS_2660Byte6_signal" 519 "SIGNALS_Virtual_DcmDspUDS_2661Byte0A_signal" 520 "SIGNALS_Virtual_DcmDspUDS_2661Byte0B_signal" 521 "SIGNALS_Virtual_DcmDspUDS_2661Byte0C_signal" 522 "SIGNALS_Virtual_DcmDspUDS_2661Byte0D_signal" 523 "SIGNALS_Virtual_DcmDspUDS_2661Byte0E_signal" 524 "SIGNALS_Virtual_DcmDspUDS_2661Byte0F_signal" 525 "SIGNALS_Virtual_DcmDspUDS_2661Byte0_signal" 526 "SIGNALS_Virtual_DcmDspUDS_2661Byte1_signal" 527 "SIGNALS_Virtual_DcmDspUDS_2661Byte27_signal" 528 "SIGNALS_Virtual_DcmDspUDS_2661Byte2A_signal" 529 "SIGNALS_Virtual_DcmDspUDS_2661Byte2D_signal" 530 "SIGNALS_Virtual_DcmDspUDS_2661Byte2E_signal" 531 "SIGNALS_Virtual_DcmDspUDS_2661Byte2F_signal" 532 "SIGNALS_Virtual_DcmDspUDS_2661Byte2_signal" 533 "SIGNALS_Virtual_DcmDspUDS_2661Byte30_signal" 534 "SIGNALS_Virtual_DcmDspUDS_2661Byte31_signal" 535 "SIGNALS_Virtual_DcmDspUDS_2661Byte32_signal" 536 "SIGNALS_Virtual_DcmDspUDS_2661Byte35_signal" 537 "SIGNALS_Virtual_DcmDspUDS_2661Byte3_signal" 538 "SIGNALS_Virtual_DcmDspUDS_2661Byte4_signal" 539 "SIGNALS_Virtual_DcmDspUDS_2661Byte5_signal" 540 "SIGNALS_Virtual_DcmDspUDS_2661Byte6_signal" 541 "SIGNALS_Virtual_DcmDspUDS_2661Byte7_signal" 542 "SIGNALS_Virtual_DcmDspUDS_2661Byte8_signal" 543 "SIGNALS_Virtual_DcmDspUDS_2661Byte9_signal" 544 "SIGNALS_Virtual_DcmDspUDS_2662Byte0_signal" 545 "SIGNALS_Virtual_DcmDspUDS_2662Byte18_signal" 546 "SIGNALS_Virtual_DcmDspUDS_2662Byte19_signal" 547 "SIGNALS_Virtual_DcmDspUDS_2662Byte1_signal" 548 "SIGNALS_Virtual_DcmDspUDS_2662Byte2_signal" 549 "SIGNALS_Virtual_DcmDspUDS_2662Byte3_signal" 550 "SIGNALS_Virtual_DcmDspUDS_2662Byte4_signal" 551 "SIGNALS_Virtual_DcmDspUDS_2662Byte5_signal" 552 "SIGNALS_Virtual_DcmDspUDS_2663Byte0_signal" 553 "SIGNALS_Virtual_DcmDspUDS_2663Byte1_signal" 554 "SIGNALS_Virtual_DcmDspUDS_2663Byte2_signal" 555 "SIGNALS_Virtual_DcmDspUDS_2663Byte3_signal" 556 "SIGNALS_Virtual_DcmDspUDS_2663Byte4_signal" 557 "SIGNALS_Virtual_DcmDspUDS_2663Byte5_signal" 558 "SIGNALS_Virtual_DcmDspUDS_2664Byte0_signal" 559 "SIGNALS_Virtual_DcmDspUDS_2664Byte1_signal" 560 "SIGNALS_Virtual_DcmDspUDS_2664Byte25_signal" 561 "SIGNALS_Virtual_DcmDspUDS_2664Byte26_signal" 562 "SIGNALS_Virtual_DcmDspUDS_2664Byte2_signal" 563 "SIGNALS_Virtual_DcmDspUDS_2664Byte3_signal" 564 "SIGNALS_Virtual_DcmDspUDS_2664Byte4_signal" 565 "SIGNALS_Virtual_DcmDspUDS_2664Byte5_signal" 566 "SIGNALS_Virtual_DcmDspUDS_2664Byte6_signal" 567 "SIGNALS_Virtual_DcmDspUDS_2664Byte7_signal" 568 "SIGNALS_Virtual_DcmDspUDS_2665Byte0_signal" 569 "SIGNALS_Virtual_DcmDspUDS_2665Byte1_signal" 570 "SIGNALS_Virtual_DcmDspUDS_2665Byte2_signal" 571 "SIGNALS_Virtual_DcmDspUDS_2665Byte3_signal" 572 "SIGNALS_Virtual_DcmDspUDS_2665Byte4_signal" 573 "SIGNALS_Virtual_DcmDspUDS_2665Byte5_signal" 574 "SIGNALS_Virtual_DcmDspUDS_2668Byte0_signal" 575 "SIGNALS_Virtual_DcmDspUDS_2668Byte1B_signal" 576 "SIGNALS_Virtual_DcmDspUDS_2668Byte1_signal" 577 "SIGNALS_Virtual_DcmDspUDS_2668Byte2_signal" 578 "SIGNALS_Virtual_DcmDspUDS_2668Byte3_signal" 579 "SIGNALS_Virtual_DcmDspUDS_2668Byte4_signal" 580 "SIGNALS_Virtual_DcmDspUDS_2668Byte5_signal" 581 "SIGNALS_Virtual_DcmDspUDS_266CByte0_signal" 582 "SIGNALS_Virtual_DcmDspUDS_266CByte1_signal" 583 "SIGNALS_Virtual_DcmDspUDS_266CByte26_signal" 584 "SIGNALS_Virtual_DcmDspUDS_266CByte27_signal" 585 "SIGNALS_Virtual_DcmDspUDS_266CByte2_signal" 586 "SIGNALS_Virtual_DcmDspUDS_266CByte3_signal" 587 "SIGNALS_Virtual_DcmDspUDS_266CByte4_signal" 588 "SIGNALS_Virtual_DcmDspUDS_266CByte5_signal" 589 "SIGNALS_Virtual_DcmDspUDS_266DByte0_signal" 590 "SIGNALS_Virtual_DcmDspUDS_266DByte1_signal" 591 "SIGNALS_Virtual_DcmDspUDS_266DByte2_signal" 592 "SIGNALS_Virtual_DcmDspUDS_266DByte3_signal" 593 "SIGNALS_Virtual_DcmDspUDS_266DByte4_signal" 594 "SIGNALS_Virtual_DcmDspUDS_266DByte5_signal" 595 "SIGNALS_Virtual_DcmDspUDS_266FByte0_signal" 596 "SIGNALS_Virtual_DcmDspUDS_266FByte1_signal" 597 "SIGNALS_Virtual_DcmDspUDS_266FByte2_signal" 598 "SIGNALS_Virtual_DcmDspUDS_266FByte3_signal" 599 "SIGNALS_Virtual_DcmDspUDS_2673Byte0A_signal" 600 "SIGNALS_Virtual_DcmDspUDS_2673Byte0B_signal" 601 "SIGNALS_Virtual_DcmDspUDS_2673Byte0_signal" 602 "SIGNALS_Virtual_DcmDspUDS_2673Byte12_signal" 603 "SIGNALS_Virtual_DcmDspUDS_2673Byte13_signal" 604 "SIGNALS_Virtual_DcmDspUDS_2673Byte16_signal" 605 "SIGNALS_Virtual_DcmDspUDS_2673Byte17_signal" 606 "SIGNALS_Virtual_DcmDspUDS_2673Byte1E_signal" 607 "SIGNALS_Virtual_DcmDspUDS_2673Byte1F_signal" 608 "SIGNALS_Virtual_DcmDspUDS_2673Byte1_signal" 609 "SIGNALS_Virtual_DcmDspUDS_2673Byte2_signal" 610 "SIGNALS_Virtual_DcmDspUDS_2673Byte3_signal" 611 "SIGNALS_Virtual_DcmDspUDS_2673Byte4_signal" 612 "SIGNALS_Virtual_DcmDspUDS_2673Byte5_signal" 613 "SIGNALS_Virtual_DcmDspUDS_2673Byte6_signal" 614 "SIGNALS_Virtual_DcmDspUDS_2673Byte7_signal" 615 "SIGNALS_Virtual_DcmDspUDS_2676Byte0_signal" 616 "SIGNALS_Virtual_DcmDspUDS_2676Byte1_signal" 617 "SIGNALS_Virtual_DcmDspUDS_2676Byte2E_signal" 618 "SIGNALS_Virtual_DcmDspUDS_2676Byte2F_signal" 619 "SIGNALS_Virtual_DcmDspUDS_2676Byte2_signal" 620 "SIGNALS_Virtual_DcmDspUDS_2676Byte3_signal" 621 "SIGNALS_Virtual_DcmDspUDS_2676Byte4_signal" 622 "SIGNALS_Virtual_DcmDspUDS_2676Byte5_signal" 623 "SIGNALS_Virtual_DcmDspUDS_2676Byte6_signal" 624 "SIGNALS_Virtual_DcmDspUDS_2676Byte7_signal" 625 "SIGNALS_Virtual_DcmDspUDS_2676Byte8_signal" 626 "SIGNALS_Virtual_DcmDspUDS_2676Byte9_signal" 627 "SIGNALS_Virtual_DcmDspUDS_267BByte0_signal" 628 "SIGNALS_Virtual_DcmDspUDS_267BByte1_signal" 629 "SIGNALS_Virtual_DcmDspUDS_267BByte2_signal" 630 "SIGNALS_Virtual_DcmDspUDS_267BByte3_signal" 631 "SIGNALS_Virtual_DcmDspUDS_267BByte4_signal" 632 "SIGNALS_Virtual_DcmDspUDS_267BByte5_signal" 633 "SIGNALS_Virtual_DcmDspUDS_267EByte0_signal" 634 "SIGNALS_Virtual_DcmDspUDS_267EByte1_signal" 635 "SIGNALS_Virtual_DcmDspUDS_267EByte22_signal" 636 "SIGNALS_Virtual_DcmDspUDS_2680Byte00_signal" 637 "SIGNALS_Virtual_DcmDspUDS_2680Byte01_signal" 638 "SIGNALS_Virtual_DcmDspUDS_2680Byte02_signal" 639 "SIGNALS_Virtual_DcmDspUDS_2680Byte03_signal" 640 "SIGNALS_Virtual_DcmDspUDS_2680Byte04_signal" 641 "SIGNALS_Virtual_DcmDspUDS_2680Byte05_signal" 642 "SIGNALS_Virtual_DcmDspUDS_2680Byte08_signal" 643 "SIGNALS_Virtual_DcmDspUDS_2680Byte09_signal" 644 "SIGNALS_Virtual_DcmDspUDS_2680Byte0E_signal" 645 "SIGNALS_Virtual_DcmDspUDS_2680Byte0F_signal" 646 "SIGNALS_Virtual_DcmDspUDS_2681Byte00_signal" 647 "SIGNALS_Virtual_DcmDspUDS_2681Byte01_signal" 648 "SIGNALS_Virtual_DcmDspUDS_2681Byte02_signal" 649 "SIGNALS_Virtual_DcmDspUDS_2681Byte03_signal" 650 "SIGNALS_Virtual_DcmDspUDS_2681Byte04_signal" 651 "SIGNALS_Virtual_DcmDspUDS_2681Byte05_signal" 652 "SIGNALS_Virtual_DcmDspUDS_2681Byte0F_signal" 653 "SIGNALS_Virtual_DcmDspUDS_2681Byte10_signal" 654 "SIGNALS_Virtual_DcmDspUDS_2681Byte13_signal" 655 "SIGNALS_Virtual_DcmDspUDS_2681Byte14_signal" 656 "SIGNALS_Virtual_DcmDspUDS_2681Byte1D_signal" 657 "SIGNALS_Virtual_DcmDspUDS_2681Byte1E_signal" 658 "SIGNALS_Virtual_DcmDspUDS_2682Byte00_signal" 659 "SIGNALS_Virtual_DcmDspUDS_2682Byte01_signal" 660 "SIGNALS_Virtual_DcmDspUDS_2682Byte02_signal" 661 "SIGNALS_Virtual_DcmDspUDS_2682Byte03_signal" 662 "SIGNALS_Virtual_DcmDspUDS_2682Byte04_signal" 663 "SIGNALS_Virtual_DcmDspUDS_2682Byte05_signal" 664 "SIGNALS_Virtual_DcmDspUDS_2682Byte06_07_signal" 665 "SIGNALS_Virtual_DcmDspUDS_2682Byte08_09_signal" 666 "SIGNALS_Virtual_DcmDspUDS_2682Byte0E_signal" 667 "SIGNALS_Virtual_DcmDspUDS_2682Byte11_12_signal" 668 "SIGNALS_Virtual_DcmDspUDS_2682Byte13_14_signal" 669 "SIGNALS_Virtual_DcmDspUDS_2682Byte15_16_signal" 670 "SIGNALS_Virtual_DcmDspUDS_2682Byte18_19_signal" 671 "SIGNALS_Virtual_DcmDspUDS_2682Byte1B_signal" 672 "SIGNALS_Virtual_DcmDspUDS_2682Byte1C_signal" 673 "SIGNALS_Virtual_DcmDspUDS_268FByte00_signal" 674 "SIGNALS_Virtual_DcmDspUDS_268FByte01_signal" 675 "SIGNALS_Virtual_DcmDspUDS_268FByte02_signal" 676 "SIGNALS_Virtual_DcmDspUDS_268FByte03_signal" 677 "SIGNALS_Virtual_DcmDspUDS_268FByte04_signal" 678 "SIGNALS_Virtual_DcmDspUDS_268FByte05_signal" 679 "SIGNALS_Virtual_DcmDspUDS_268FByte0A_signal" 680 "SIGNALS_Virtual_DcmDspUDS_268FByte0B_signal" 681 "SIGNALS_Virtual_DcmDspUDS_268FByte0C_signal" 682 "SIGNALS_Virtual_DcmDspUDS_269AByte00_signal" 683 "SIGNALS_Virtual_DcmDspUDS_269AByte01_signal" 684 "SIGNALS_Virtual_DcmDspUDS_269AByte02_signal" 685 "SIGNALS_Virtual_DcmDspUDS_269AByte03_signal" 686 "SIGNALS_Virtual_DcmDspUDS_269AByte04_signal" 687 "SIGNALS_Virtual_DcmDspUDS_269AByte05_signal" 688 "SIGNALS_Virtual_DcmDspUDS_26A2Byte00_signal" 689 "SIGNALS_Virtual_DcmDspUDS_26A2Byte01_signal" 690 "SIGNALS_Virtual_DcmDspUDS_26A2Byte02_signal" 691 "SIGNALS_Virtual_DcmDspUDS_26A2Byte03_signal" 692 "SIGNALS_Virtual_DcmDspUDS_26A2Byte04_signal" 693 "SIGNALS_Virtual_DcmDspUDS_26A2Byte05_signal" 694 "SIGNALS_Virtual_DcmDspUDS_26A2Byte12_13_signal" 695 "SIGNALS_Virtual_DcmDspUDS_Acm_fzabgs_w_signal" 696 "SIGNALS_Virtual_DcmDspUDS_Acm_fzabgzyl_w_0_signal" 697 "SIGNALS_Virtual_DcmDspUDS_Acm_fzabgzyl_w_1_signal" 698 "SIGNALS_Virtual_DcmDspUDS_Acm_fzabgzyl_w_2_signal" 699 "SIGNALS_Virtual_DcmDspUDS_Acm_fzabgzyl_w_3_signal" 700 "SIGNALS_Virtual_DcmDspUDS_DID_E402Byte00_signal" 701 "SIGNALS_Virtual_DcmDspUDS_DID_E402Byte01_signal" 702 "SIGNALS_Virtual_DcmDspUDS_DID_E402Byte07to08_signal" 703 "SIGNALS_Virtual_DcmDspUDS_DID_E402Byte10to11_signal" 704 "SIGNALS_Virtual_DcmDspUDS_DID_E402Byte19to1A_signal" 705 "SIGNALS_Virtual_DcmDspUDS_DID_E402Byte22to23_signal" 706 "SIGNALS_Virtual_DcmDspUDS_DID_E402Byte2Bto2C_signal" 707 "SIGNALS_Virtual_DcmDspUDS_DID_F110Byte0_3_signal" 708 "SIGNALS_Virtual_DcmDspUDS_DID_F110Byte12_15_signal" 709 "SIGNALS_Virtual_DcmDspUDS_DID_F110Byte16_signal" 710 "SIGNALS_Virtual_DcmDspUDS_DID_F110Byte4_7_signal" 711 "SIGNALS_Virtual_DcmDspUDS_DID_F110Byte8_11_signal" 712 "SIGNALS_Virtual_DcmDspUDS_DID_F112Byte0_3_signal" 713 "SIGNALS_Virtual_DcmDspUDS_DID_F112Byte12_15_signal" 714 "SIGNALS_Virtual_DcmDspUDS_DID_F112Byte16_19_signal" 715 "SIGNALS_Virtual_DcmDspUDS_DID_F112Byte20_23_signal" 716 "SIGNALS_Virtual_DcmDspUDS_DID_F112Byte24_27_signal" 717 "SIGNALS_Virtual_DcmDspUDS_DID_F112Byte28_29_signal" 718 "SIGNALS_Virtual_DcmDspUDS_DID_F112Byte30_signal" 719 "SIGNALS_Virtual_DcmDspUDS_DID_F112Byte4_7_signal" 720 "SIGNALS_Virtual_DcmDspUDS_DID_F112Byte8_11_signal" 721 "SIGNALS_Virtual_DcmDspUDS_E602Byte2_signal" 722 "SIGNALS_Virtual_DcmDspUDS_F181Byte0_3_signal" 723 "SIGNALS_Virtual_DcmDspUDS_F181Byte12_15_signal" 724 "SIGNALS_Virtual_DcmDspUDS_F181Byte4_7_signal" 725 "SIGNALS_Virtual_DcmDspUDS_F181Byte8_11_signal" 726 "SIGNALS_Virtual_DcmDspUDS_fzabgs_w_signal" 727 "SIGNALS_Virtual_DcmDspUDS_fzabgzyl_w_0_signal" 728 "SIGNALS_Virtual_DcmDspUDS_fzabgzyl_w_1_signal" 729 "SIGNALS_Virtual_DcmDspUDS_fzabgzyl_w_2_signal" 730 "SIGNALS_Virtual_DcmDspUDS_fzabgzyl_w_3_signal" 731 "SIGNALS_Virtual_DcmDspUDS_numReWrECUID1_signal" 732 "SIGNALS_Virtual_DcmDspUDS_numReWrECUID2_signal" 733 "SIGNALS_Virtual_I14229B9_0490_FrNo09_signal" 734 "SIGNALS_Virtual_I14229B9_0490_FrNo10_signal" 735 "SIGNALS_Virtual_I14229B9_04B1_FrNo16_signal" 736 "SIGNALS_Virtual_I14229B9_04B1_FrNo17_signal" 737 "SIGNALS_Virtual_I14229B9_04B1_FrNo20_signal" 738 "SIGNALS_Virtual_I14229B9_04B1_FrNo21_signal" 739 "SIGNALS_Virtual_I14229B9_04B1_FrNo22_signal" 740 "SIGNALS_Virtual_I14229B9_04B1_FrNo23_signal" 741 "SIGNALS_Virtual_I14229B9_04C2_FrNo2021_signal" 742 "SIGNALS_Virtual_I14229B9_04D2_FrNo24_signal" 743 "SIGNALS_Virtual_I14229B9_04D2_FrNo25_signal" 744 "SIGNALS_Virtual_I14229B9_0520_FrNo15_signal" 745 "SIGNALS_Virtual_I14229B9_0520_FrNo16_signal" 746 "SIGNALS_Virtual_I14229B9_0523_FrNo42_signal" 747 "SIGNALS_Virtual_I14229B9_0523_FrNo43_signal" 748 "SIGNALS_Virtual_I14229B9_0524_FrNo09_signal" 749 "SIGNALS_Virtual_I14229B9_0524_FrNo10_signal" 750 "SIGNALS_Virtual_I14229B9_0550_FrNo09_signal" 751 "SIGNALS_Virtual_I14229B9_0550_FrNo10_signal" 752 "SIGNALS_Virtual_I14229B9_0553_FrNo13_signal" 753 "SIGNALS_Virtual_I14229B9_0553_FrNo14_signal" 754 "SIGNALS_Virtual_I14229B9_056A_FrNo8_signal" 755 "SIGNALS_Virtual_I14229B9_056A_FrNo9_signal" 756 "SIGNALS_Virtual_I14229B9_0588_FrNo15_signal" 757 "SIGNALS_Virtual_I14229B9_0588_FrNo16_signal" 758 "SIGNALS_Virtual_I14229B9_05A0_FrNo40_signal" 759 "SIGNALS_Virtual_I14229B9_05A0_FrNo41_signal" 760 "SIGNALS_Virtual_I14229B9_05B0_FrNo13_signal" 761 "SIGNALS_Virtual_I14229B9_05B0_FrNo14_signal" 762 "SIGNALS_Virtual_I14229B9_05C0_FrNo12_signal" 763 "SIGNALS_Virtual_I14229B9_05C0_FrNo13_signal" 764 "SIGNALS_Virtual_I14229B9_05E0_FrNo19_signal" 765 "SIGNALS_Virtual_I14229B9_05E0_FrNo20_signal" 766 "SIGNALS_Virtual_I14229B9_05E0_FrNo21_signal" 767 "SIGNALS_Virtual_I14229B9_05E0_FrNo22_signal" 768 "SIGNALS_Virtual_I14229B9_05E0_FrNo23_signal" 769 "SIGNALS_Virtual_I14229B9_05E0_FrNo24_signal" 770 "SIGNALS_Virtual_I14229B9_1208_FrNo34_signal" 771 "SIGNALS_Virtual_I14229B9_1208_FrNo35_signal" 772 "SIGNALS_Virtual_I14229B9_1208_FrNo36_signal" 773 "SIGNALS_Virtual_I14229B9_1208_FrNo37_signal" 774 "SIGNALS_Virtual_I14229B9_120A_FrNo09_signal" 775 "SIGNALS_Virtual_I14229B9_120A_FrNo10_signal" 776 "SIGNALS_Virtual_I14229B9_120B_FrNo09_signal" 777 "SIGNALS_Virtual_I14229B9_120B_FrNo10_signal" 778 "SIGNALS_Virtual_I14229_AirC_pAnaClnt_signal" 779 "SIGNALS_Virtual_I14229_EpmCaS_ctErrSig2_signal" 780 "SIGNALS_Virtual_I14229_pEngSrtMin_signal" 781 "SIGNALS_Virtual_I14229_wdkba_w_signal" 782 "SIGNALS_Virtual_Tra_numGear_signal" /end COMPU_VTAB
/begin COMPU_METHOD Signals_PidVerbSupp "" TAB_VERB "%6.3" "" COMPU_TAB_REF Signals_PidVerbSupp /end COMPU_METHOD
/begin COMPU_VTAB Signals_PidVerbSupp "" TAB_VERB 96 0 "PID_NOT_SUPPORTED" 1 "PID_0x01" 3 "PID_0x03" 4 "PID_0x04" 5 "PID_0x05" 6 "PID_0x06" 7 "PID_0x07" 11 "PID_0x0B" 12 "PID_0x0C" 13 "PID_0x0D" 14 "PID_0x0E" 15 "PID_0x0F" 17 "PID_0x11" 19 "PID_0x13" 21 "PID_0x15" 28 "PID_0x1C" 31 "PID_0x1F" 33 "PID_0x21" 46 "PID_0x2E" 48 "PID_0x30" 49 "PID_0x31" 51 "PID_0x33" 52 "PID_0x34" 60 "PID_0x3C" 66 "PID_0x42" 67 "PID_0x43" 68 "PID_0x44" 69 "PID_0x45" 70 "PID_0x46" 71 "PID_0x47" 73 "PID_0x49" 74 "PID_0x4A" 76 "PID_0x4C" 79 "PID_0x4F" 80 "PID_0x50" 81 "PID_0x51" 86 "PID_0x56" 90 "PID_0x5A" 98 "PID_0x62" 99 "PID_0x63" 101 "PID_0x65" 102 "PID_0x66" 103 "PID_0x67" 104 "PID_0x68" 105 "PID_0x69" 106 "PID_0x6A" 107 "PID_0x6B" 108 "PID_0x6C" 109 "PID_0x6D" 110 "PID_0x6E" 111 "PID_0x6F" 112 "PID_0x70" 113 "PID_0x71" 114 "PID_0x72" 115 "PID_0x73" 116 "PID_0x74" 117 "PID_0x75" 118 "PID_0x76" 119 "PID_0x77" 120 "PID_0x78" 121 "PID_0x79" 122 "PID_0x7A" 123 "PID_0x7B" 124 "PID_0x7C" 127 "PID_0x7F" 129 "PID_0x81" 130 "PID_0x82" 131 "PID_0x83" 133 "PID_0x85" 134 "PID_0x86" 135 "PID_0x87" 137 "PID_0x89" 138 "PID_0x8A" 139 "PID_0x8B" 140 "PID_0x8C" 142 "PID_0x8E" 143 "PID_0x8F" 146 "PID_0x92" 147 "PID_0x93" 148 "PID_0x94" 152 "PID_0x98" 153 "PID_0x99" 154 "PID_0x9A" 155 "PID_0x9B" 156 "PID_0x9C" 157 "PID_0x9D" 159 "PID_0x9F" 161 "PID_0xA1" 163 "PID_0xA3" 164 "PID_0xA4" 165 "PID_0xA5" 166 "PID_0xA6" 167 "PID_0xA7" 168 "PID_0xA8" 169 "PID_0xA9" 172 "PID_0xAC" /end COMPU_VTAB
/begin COMPU_METHOD spg_q0p1 "" RAT_FUNC "%6.3" "V" COEFFS 0 1 0 0 0 0.1 /end COMPU_METHOD
/begin COMPU_METHOD SY_TEBF_Compu "" TAB_VERB "%6.3" "" COMPU_TAB_REF SY_TEBF_Compu /end COMPU_METHOD
/begin COMPU_VTAB SY_TEBF_Compu "" TAB_VERB 3 0 "kein Erstbefüllung" 1 "Erstbefüllung ein über Tester" 2 "Erstbefüllung ein/aus über Tester" /end COMPU_VTAB
/begin COMPU_METHOD SY_TEETH_Compu "" TAB_VERB "%6.3" "" COMPU_TAB_REF SY_TEETH_Compu /end COMPU_METHOD
/begin COMPU_VTAB SY_TEETH_Compu "" TAB_VERB 5 12 "number_of_crankshaft_wheel_teeth_is_12_minus_x" 24 "number_of_crankshaft_wheel_teeth_is_24_minus_x" 30 "number_of_crankshaft_wheel_teeth_is_30_minus_x" 36 "number of crankshaft wheel teeth is 36 minus x" 60 "number of crankshaft wheel teeth is 60 minus x" /end COMPU_VTAB
/begin COMPU_METHOD SY_TEV5_Compu "" TAB_VERB "%6.3" "" COMPU_TAB_REF SY_TEV5_Compu /end COMPU_METHOD
/begin COMPU_VTAB SY_TEV5_Compu "" TAB_VERB 2 0 "TEV5 nicht verbaut" 1 "TEV5 verbaut" /end COMPU_VTAB
/begin COMPU_METHOD SY_TEVANZ_Compu "" TAB_VERB "%6.3" "" COMPU_TAB_REF SY_TEVANZ_Compu /end COMPU_METHOD
/begin COMPU_VTAB SY_TEVANZ_Compu "" TAB_VERB 2 1 "number of canister purge valves (TEVs) is 1" 2 "number of canister purge valves (TEVs) is 2" /end COMPU_VTAB
/begin COMPU_METHOD SY_TFA1GRD_Compu "" TAB_VERB "%6.3" "" COMPU_TAB_REF SY_TFA1GRD_Compu /end COMPU_METHOD
/begin COMPU_VTAB SY_TFA1GRD_Compu "" TAB_VERB 2 0 "Gradientenüberwachung nicht vorhanden" 1 "Gradientenüberwachung vorhanden" /end COMPU_VTAB
/begin COMPU_METHOD SY_TFA1W_Compu "" TAB_VERB "%6.3" "" COMPU_TAB_REF SY_TFA1W_Compu /end COMPU_METHOD
/begin COMPU_VTAB SY_TFA1W_Compu "" TAB_VERB 2 0 "byte-range" 1 "word-range" /end COMPU_VTAB
/begin COMPU_METHOD SY_TFA2GRD_Compu "" TAB_VERB "%6.3" "" COMPU_TAB_REF SY_TFA2GRD_Compu /end COMPU_METHOD
/begin COMPU_VTAB SY_TFA2GRD_Compu "" TAB_VERB 2 0 "False" 1 "True" /end COMPU_VTAB
/begin COMPU_METHOD SY_TFA2POS_Compu "" TAB_VERB "%6.3" "" COMPU_TAB_REF SY_TFA2POS_Compu /end COMPU_METHOD
/begin COMPU_VTAB SY_TFA2POS_Compu "" TAB_VERB 7 0 "no tfa2-sensor" 1 "TASR" 2 "TAVDK" 3 "TAVLLK" 4 "TAV2V" 5 "TAVV" 6 "TANLF" /end COMPU_VTAB
/begin COMPU_METHOD SY_TFA2W_Compu "" TAB_VERB "%6.3" "" COMPU_TAB_REF SY_TFA2W_Compu /end COMPU_METHOD
/begin COMPU_VTAB SY_TFA2W_Compu "" TAB_VERB 2 0 "byte range (TFA2)" 1 "word range (TFA2)" /end COMPU_VTAB
/begin COMPU_METHOD SY_TFA3GRD_Compu "" TAB_VERB "%6.3" "" COMPU_TAB_REF SY_TFA3GRD_Compu /end COMPU_METHOD
/begin COMPU_VTAB SY_TFA3GRD_Compu "" TAB_VERB 2 0 "False" 1 "True" /end COMPU_VTAB
/begin COMPU_METHOD SY_TFA3W_Compu "" TAB_VERB "%6.3" "" COMPU_TAB_REF SY_TFA3W_Compu /end COMPU_METHOD
/begin COMPU_VTAB SY_TFA3W_Compu "" TAB_VERB 2 0 "byte-range" 1 "word-range" /end COMPU_VTAB
/begin COMPU_METHOD SY_TFA4GRD_Compu "" TAB_VERB "%6.3" "" COMPU_TAB_REF SY_TFA4GRD_Compu /end COMPU_METHOD
/begin COMPU_VTAB SY_TFA4GRD_Compu "" TAB_VERB 2 0 "False" 1 "True" /end COMPU_VTAB
/begin COMPU_METHOD SY_TFAJEC_Compu "" TAB_VERB "%6.3" "" COMPU_TAB_REF SY_TFAJEC_Compu /end COMPU_METHOD
/begin COMPU_VTAB SY_TFAJEC_Compu "" TAB_VERB 2 0 "no Jump-Check" 1 "Jump-Check" /end COMPU_VTAB
/begin COMPU_METHOD SY_TFAKON_Compu "" TAB_VERB "%6.3" "" COMPU_TAB_REF SY_TFAKON_Compu /end COMPU_METHOD
/begin COMPU_VTAB SY_TFAKON_Compu "" TAB_VERB 2 0 "1 Sensor" 1 "2 Sensoren moeglich" /end COMPU_VTAB
/begin COMPU_METHOD SY_TFAST_Compu "" TAB_VERB "%6.3" "" COMPU_TAB_REF SY_TFAST_Compu /end COMPU_METHOD
/begin COMPU_VTAB SY_TFAST_Compu "" TAB_VERB 2 0 "False" 1 "True" /end COMPU_VTAB
/begin COMPU_METHOD SY_TFATSTR_Compu "" TAB_VERB "%6.3" "" COMPU_TAB_REF SY_TFATSTR_Compu /end COMPU_METHOD
/begin COMPU_VTAB SY_TFATSTR_Compu "" TAB_VERB 7 0 "NO SENSOR" 1 "TFA1_SCAN" 2 "TFA2_SCAN" 3 "TFA3_SCAN" 4 "TFA4_SCAN" 5 "TFA5_SCAN" 6 "TFA6_SCAN" /end COMPU_VTAB
/begin COMPU_METHOD SY_TFBA_Compu "" TAB_VERB "%6.3" "" COMPU_TAB_REF SY_TFBA_Compu /end COMPU_METHOD
/begin COMPU_VTAB SY_TFBA_Compu "" TAB_VERB 2 0 "kein Testereingriff Beschleunigungsanreicherung" 1 "Testereingriff Beschleunigungsanreicherung" /end COMPU_VTAB
/begin COMPU_METHOD SY_TFLTKCD_Compu "" TAB_VERB "%6.3" "" COMPU_TAB_REF SY_TFLTKCD_Compu /end COMPU_METHOD
/begin COMPU_VTAB SY_TFLTKCD_Compu "" TAB_VERB 2 0 "DISABL" 1 "ENABL" /end COMPU_VTAB
/begin COMPU_METHOD SY_TFLTNK_Compu "" TAB_VERB "%6.3" "" COMPU_TAB_REF SY_TFLTNK_Compu /end COMPU_METHOD
/begin COMPU_VTAB SY_TFLTNK_Compu "" TAB_VERB 6 0 "NO_TEMP" 1 "MODEL" 2 "SENS" 3 "SENS_CAN" 4 "SENS_SENT" 255 "Customer_Object_Code" /end COMPU_VTAB
/begin COMPU_METHOD SY_TFMO_Compu "" TAB_VERB "%6.3" "" COMPU_TAB_REF SY_TFMO_Compu /end COMPU_METHOD
/begin COMPU_VTAB SY_TFMO_Compu "" TAB_VERB 2 0 "TMOT Sensor nicht als GGTFM Erstzwert" 1 "TMOT Sensor als GGTFM Erstzwert" /end COMPU_VTAB
/begin COMPU_METHOD SY_TFNS_Compu "" TAB_VERB "%6.3" "" COMPU_TAB_REF SY_TFNS_Compu /end COMPU_METHOD
/begin COMPU_VTAB SY_TFNS_Compu "" TAB_VERB 2 0 "kein Testereingriff Nachstartfaktor aktiv" 1 "Testereingriff Nachstartfaktor aktiv" /end COMPU_VTAB
/begin COMPU_METHOD SY_TFRK_Compu "" TAB_VERB "%6.3" "" COMPU_TAB_REF SY_TFRK_Compu /end COMPU_METHOD
/begin COMPU_VTAB SY_TFRK_Compu "" TAB_VERB 2 0 "kein Testereingriff Korrekturfaktor relative Kraft" 1 "Testereingriff Korrekturfaktor relative Kraftstoff" /end COMPU_VTAB
/begin COMPU_METHOD SY_TFST_Compu "" TAB_VERB "%6.3" "" COMPU_TAB_REF SY_TFST_Compu /end COMPU_METHOD
/begin COMPU_VTAB SY_TFST_Compu "" TAB_VERB 2 0 "kein Testereingriff Startfaktor" 1 "Testereingriff Startfaktor" /end COMPU_VTAB
/begin COMPU_METHOD SY_TFUELCN_Compu "" TAB_VERB "%6.3" "" COMPU_TAB_REF SY_TFUELCN_Compu /end COMPU_METHOD
/begin COMPU_VTAB SY_TFUELCN_Compu "" TAB_VERB 8 0 "SY_TFUELCN = 0" 1 "SY_TFUELCN = 1" 2 "SY_TFUELCN = 2" 3 "SY_TFUELCN = 3" 4 "SY_TFUELCN = 4" 5 "SY_TFUELCN = 5" 6 "SY_TFUELCN = 6" 7 "SY_TFUELCN = 7" /end COMPU_VTAB
/begin COMPU_METHOD SY_TFUEL_Compu "" TAB_VERB "%6.3" "" COMPU_TAB_REF SY_TFUEL_Compu /end COMPU_METHOD
/begin COMPU_VTAB SY_TFUEL_Compu "" TAB_VERB 3 0 "NOTAVL" 1 "TFUELLP" 2 "TFUELLPHP" /end COMPU_VTAB
/begin COMPU_METHOD SY_TFVA_Compu "" TAB_VERB "%6.3" "" COMPU_TAB_REF SY_TFVA_Compu /end COMPU_METHOD
/begin COMPU_VTAB SY_TFVA_Compu "" TAB_VERB 2 0 "kein Testereingriff Verzögerungsabmagerung" 1 "Testereingriff Verzögerungsabmagerung" /end COMPU_VTAB
/begin COMPU_METHOD SY_TFWL_Compu "" TAB_VERB "%6.3" "" COMPU_TAB_REF SY_TFWL_Compu /end COMPU_METHOD
/begin COMPU_VTAB SY_TFWL_Compu "" TAB_VERB 2 0 "kein Testereingriff Warmlauffaktor aktiv" 1 "Testereingriff Warmlauffaktor aktiv" /end COMPU_VTAB
/begin COMPU_METHOD SY_TKAA_Compu "" TAB_VERB "%6.3" "" COMPU_TAB_REF SY_TKAA_Compu /end COMPU_METHOD
/begin COMPU_VTAB SY_TKAA_Compu "" TAB_VERB 2 0 "False" 1 "True" /end COMPU_VTAB
/begin COMPU_METHOD SY_TKACSD_Compu "" TAB_VERB "%6.3" "" COMPU_TAB_REF SY_TKACSD_Compu /end COMPU_METHOD
/begin COMPU_VTAB SY_TKACSD_Compu "" TAB_VERB 2 0 "False" 1 "True" /end COMPU_VTAB
/begin COMPU_METHOD SY_TKA_Compu "" TAB_VERB "%6.3" "" COMPU_TAB_REF SY_TKA_Compu /end COMPU_METHOD
/begin COMPU_VTAB SY_TKA_Compu "" TAB_VERB 2 0 "kein Kühlwassertemperatursensor am Kühleraustritt" 1 "Kühlwassertemperatursensor am Kühleraustritt" /end COMPU_VTAB
/begin COMPU_METHOD SY_TLRARES_Compu "" TAB_VERB "%6.3" "" COMPU_TAB_REF SY_TLRARES_Compu /end COMPU_METHOD
/begin COMPU_VTAB SY_TLRARES_Compu "" TAB_VERB 2 0 "FALSE" 1 "TRUE" /end COMPU_VTAB
/begin COMPU_METHOD SY_TMDR_Compu "" TAB_VERB "%6.3" "" COMPU_TAB_REF SY_TMDR_Compu /end COMPU_METHOD
/begin COMPU_VTAB SY_TMDR_Compu "" TAB_VERB 2 0 "kein Testereingriff Momentenreserve LL" 1 "Testereingriff Momentenreserve LL" /end COMPU_VTAB
/begin COMPU_METHOD SY_TMO2KA_Compu "" TAB_VERB "%6.3" "" COMPU_TAB_REF SY_TMO2KA_Compu /end COMPU_METHOD
/begin COMPU_VTAB SY_TMO2KA_Compu "" TAB_VERB 3 0 "no influence modelled" 1 "add-on calibration" 2 "independent calibration" /end COMPU_VTAB
/begin COMPU_METHOD SY_TMOHKS_Compu "" TAB_VERB "%6.3" "" COMPU_TAB_REF SY_TMOHKS_Compu /end COMPU_METHOD
/begin COMPU_VTAB SY_TMOHKS_Compu "" TAB_VERB 2 0 "no influence of HKS in torque model" 1 "consideration of HKS in torque model" /end COMPU_VTAB
/begin COMPU_METHOD SY_TMOHSST_Compu "" TAB_VERB "%6.3" "" COMPU_TAB_REF SY_TMOHSST_Compu /end COMPU_METHOD
/begin COMPU_VTAB SY_TMOHSST_Compu "" TAB_VERB 2 0 "0" 1 "1" /end COMPU_VTAB
/begin COMPU_METHOD SY_TMOLAMH_Compu "" TAB_VERB "%6.3" "" COMPU_TAB_REF SY_TMOLAMH_Compu /end COMPU_METHOD
/begin COMPU_VTAB SY_TMOLAMH_Compu "" TAB_VERB 2 0 "NO" 1 "STG1" /end COMPU_VTAB
/begin COMPU_METHOD SY_TMOLAM_Compu "" TAB_VERB "%6.3" "" COMPU_TAB_REF SY_TMOLAM_Compu /end COMPU_METHOD
/begin COMPU_VTAB SY_TMOLAM_Compu "" TAB_VERB 3 0 "no lambda influence in torque model" 1 "basic modelling" 2 "enhanced modelling" /end COMPU_VTAB
/begin COMPU_METHOD SY_TMOLB_Compu "" TAB_VERB "%6.3" "" COMPU_TAB_REF SY_TMOLB_Compu /end COMPU_METHOD
/begin COMPU_VTAB SY_TMOLB_Compu "" TAB_VERB 3 0 "torque model without charge motion" 1 "torque model with charge motion (basic)" 2 "torque model with charge motion (enhanced)" /end COMPU_VTAB
/begin COMPU_METHOD SY_TMORRI_Compu "" TAB_VERB "%6.3" "" COMPU_TAB_REF SY_TMORRI_Compu /end COMPU_METHOD
/begin COMPU_VTAB SY_TMORRI_Compu "" TAB_VERB 3 0 "torque model without residual gas rate" 1 "torque model with residual gas rate (basic)" 2 "torque model with residual gas rate (enhanced)" /end COMPU_VTAB
/begin COMPU_METHOD SY_TMOTFIL_Compu "" TAB_VERB "%6.3" "" COMPU_TAB_REF SY_TMOTFIL_Compu /end COMPU_METHOD
/begin COMPU_VTAB SY_TMOTFIL_Compu "" TAB_VERB 2 0 "SY_TMOTFIL==0" 1 "SY_TMOTFIL>0" /end COMPU_VTAB
/begin COMPU_METHOD SY_TOCH_Compu "" TAB_VERB "%6.3" "" COMPU_TAB_REF SY_TOCH_Compu /end COMPU_METHOD
/begin COMPU_VTAB SY_TOCH_Compu "" TAB_VERB 3 0 "deaktivierte FG OTMTOCH" 1 "aktivierte FG OTMTOCH" 2 "aktivierte (16bit) FG OTMTOCH" /end COMPU_VTAB
/begin COMPU_METHOD SY_TOSPCN_Compu "" TAB_VERB "%6.3" "" COMPU_TAB_REF SY_TOSPCN_Compu /end COMPU_METHOD
/begin COMPU_VTAB SY_TOSPCN_Compu "" TAB_VERB 5 0 "NO_SENS" 1 "SG" 2 "CAN_VOLT" 3 "CAN_TEMP" 4 "LIN_TEMP" /end COMPU_VTAB
/begin COMPU_METHOD SY_TOSPMAI_Compu "" TAB_VERB "%6.3" "" COMPU_TAB_REF SY_TOSPMAI_Compu /end COMPU_METHOD
/begin COMPU_VTAB SY_TOSPMAI_Compu "" TAB_VERB 2 0 "DISABL" 1 "ENABL" /end COMPU_VTAB
/begin COMPU_METHOD SY_TOSP_Compu "" TAB_VERB "%6.3" "" COMPU_TAB_REF SY_TOSP_Compu /end COMPU_METHOD
/begin COMPU_VTAB SY_TOSP_Compu "" TAB_VERB 3 0 "deaktivierte FG OTMTOSPCP" 1 "aktivierte FG OTMTOSPCP" 2 "aktivierte (16bit-Wert) FG OTMTOSPCP" /end COMPU_VTAB
/begin COMPU_METHOD SY_TPEACNR_Compu "" TAB_VERB "%6.3" "" COMPU_TAB_REF SY_TPEACNR_Compu /end COMPU_METHOD
/begin COMPU_VTAB SY_TPEACNR_Compu "" TAB_VERB 2 0 "False" 1 "True" /end COMPU_VTAB
/begin COMPU_METHOD SY_TREDFCO_Compu "" TAB_VERB "%6.3" "" COMPU_TAB_REF SY_TREDFCO_Compu /end COMPU_METHOD
/begin COMPU_VTAB SY_TREDFCO_Compu "" TAB_VERB 2 0 "False" 1 "True" /end COMPU_VTAB
/begin COMPU_METHOD SY_TTEV_Compu "" TAB_VERB "%6.3" "" COMPU_TAB_REF SY_TTEV_Compu /end COMPU_METHOD
/begin COMPU_VTAB SY_TTEV_Compu "" TAB_VERB 2 0 "keine Stellglieddiagnose TEV möglich" 1 "Stellglieddiagnose TEV möglich" /end COMPU_VTAB
/begin COMPU_METHOD SY_TUMG_Compu "" TAB_VERB "%6.3" "" COMPU_TAB_REF SY_TUMG_Compu /end COMPU_METHOD
/begin COMPU_VTAB SY_TUMG_Compu "" TAB_VERB 4 0 "no source, signal not available" 1 "Sensor" 2 "tans" 3 "CAN" /end COMPU_VTAB
/begin COMPU_METHOD SY_TWDKS_Compu "" TAB_VERB "%6.3" "" COMPU_TAB_REF SY_TWDKS_Compu /end COMPU_METHOD
/begin COMPU_VTAB SY_TWDKS_Compu "" TAB_VERB 2 0 "kein Testereingriff Sollwinkel DVE aktiv" 1 "Testereingriff Sollwinkel DVE aktiv" /end COMPU_VTAB
/begin COMPU_METHOD SY_UBDEDIQ_Compu "" RAT_FUNC "%6.2" "" COEFFS 0 1 0 0 0 1 /end COMPU_METHOD
/begin COMPU_METHOD SY_UBDEDIS_Compu "" RAT_FUNC "%6.2" "" COEFFS 0 1 0 0 0 1 /end COMPU_METHOD
/begin COMPU_METHOD SY_UBDEENQ_Compu "" RAT_FUNC "%6.2" "" COEFFS 0 1 0 0 0 1 /end COMPU_METHOD
/begin COMPU_METHOD SY_UBDEEN_Compu "" RAT_FUNC "%6.2" "" COEFFS 0 1 0 0 0 1 /end COMPU_METHOD
/begin COMPU_METHOD SY_UBR_Compu "" TAB_VERB "%6.3" "" COMPU_TAB_REF SY_UBR_Compu /end COMPU_METHOD
/begin COMPU_VTAB SY_UBR_Compu "" TAB_VERB 2 0 "Signal Hauptrelaisspannung nicht vorhanden" 1 "Signal Hauptrelaisspannung vorhanden" /end COMPU_VTAB
/begin COMPU_METHOD SY_UBSQ_W_Compu "" RAT_FUNC "%6.2" "" COEFFS 0 1 0 0 0 1 /end COMPU_METHOD
/begin COMPU_METHOD SY_VARCODE_Compu "" TAB_VERB "%6.3" "" COMPU_TAB_REF SY_VARCODE_Compu /end COMPU_METHOD
/begin COMPU_VTAB SY_VARCODE_Compu "" TAB_VERB 2 0 "Variantencodierung-Schnittstelle nicht freigegeben" 1 "Variantencodierung-Schnittstelle freigegeben" /end COMPU_VTAB
/begin COMPU_METHOD SY_VDEO_Compu "" TAB_VERB "%6.3" "" COMPU_TAB_REF SY_VDEO_Compu /end COMPU_METHOD
/begin COMPU_VTAB SY_VDEO_Compu "" TAB_VERB 3 0 "kein Verdichter verbaut" 1 "Verdichter vor Drosselklappe verbaut Verdichter v" 2 "Verdichter nach Drosselklappe verbaut" /end COMPU_VTAB
/begin COMPU_METHOD SY_VD_Compu "" TAB_VERB "%6.3" "" COMPU_TAB_REF SY_VD_Compu /end COMPU_METHOD
/begin COMPU_VTAB SY_VD_Compu "" TAB_VERB 4 0 "no booster" 1 "TC (ATL)" 2 "compressor" 3 "SC-E (EZV)" /end COMPU_VTAB
/begin COMPU_METHOD SY_VHAANZ_Compu "" TAB_VERB "%6.3" "" COMPU_TAB_REF SY_VHAANZ_Compu /end COMPU_METHOD
/begin COMPU_VTAB SY_VHAANZ_Compu "" TAB_VERB 5 0 "0" 1 "1" 2 "2" 3 "3" 4 "4" /end COMPU_VTAB
/begin COMPU_METHOD SY_VHA_Compu "" TAB_VERB "%6.3" "" COMPU_TAB_REF SY_VHA_Compu /end COMPU_METHOD
/begin COMPU_VTAB SY_VHA_Compu "" TAB_VERB 3 0 "0" 1 "1" 2 "2" /end COMPU_VTAB
/begin COMPU_METHOD SY_VHEANZ_Compu "" TAB_VERB "%6.3" "" COMPU_TAB_REF SY_VHEANZ_Compu /end COMPU_METHOD
/begin COMPU_VTAB SY_VHEANZ_Compu "" TAB_VERB 5 0 "0" 1 "1" 2 "2" 3 "3" 4 "4" /end COMPU_VTAB
/begin COMPU_METHOD SY_VHE_Compu "" TAB_VERB "%6.3" "" COMPU_TAB_REF SY_VHE_Compu /end COMPU_METHOD
/begin COMPU_VTAB SY_VHE_Compu "" TAB_VERB 3 0 "0" 1 "1" 2 "2" /end COMPU_VTAB
/begin COMPU_METHOD SY_VS_Compu "" TAB_VERB "%6.3" "" COMPU_TAB_REF SY_VS_Compu /end COMPU_METHOD
/begin COMPU_VTAB SY_VS_Compu "" TAB_VERB 2 0 "keine Ventilhubsteuerung vorhanden" 1 "Ventilhubsteuerung vorhanden" /end COMPU_VTAB
/begin COMPU_METHOD SY_VVT_Compu "" RAT_FUNC "%6.2" "" COEFFS 0 1 0 0 0 1 /end COMPU_METHOD
/begin COMPU_METHOD SY_WFP_Compu "" TAB_VERB "%6.3" "" COMPU_TAB_REF SY_WFP_Compu /end COMPU_METHOD
/begin COMPU_VTAB SY_WFP_Compu "" TAB_VERB 2 0 "no winter program" 1 "winter program, by trigger switch" /end COMPU_VTAB
/begin COMPU_METHOD SY_WFS_Compu "" RAT_FUNC "%6.2" "" COEFFS 0 1 0 0 0 1 /end COMPU_METHOD
/begin COMPU_METHOD SY_WGPS_Compu "" TAB_VERB "%6.3" "" COMPU_TAB_REF SY_WGPS_Compu /end COMPU_METHOD
/begin COMPU_VTAB SY_WGPS_Compu "" TAB_VERB 2 0 "False" 1 "True" /end COMPU_VTAB
/begin COMPU_METHOD SY_WMIN_Compu "" RAT_FUNC "%6.2" "" COEFFS 0 1 0 0 0 1 /end COMPU_METHOD
/begin COMPU_METHOD SY_WNBM_Compu "" RAT_FUNC "%6.2" "" COEFFS 0 1 0 0 0 1 /end COMPU_METHOD
/begin COMPU_METHOD SY_WNWADM_Compu "" TAB_VERB "%6.3" "" COMPU_TAB_REF SY_WNWADM_Compu /end COMPU_METHOD
/begin COMPU_VTAB SY_WNWADM_Compu "" TAB_VERB 2 0 "Correction of camshaft angles by cam adaptation" 1 "No correction of cam angles by cam adapdaptation" /end COMPU_VTAB
/begin COMPU_METHOD SY_ZAGPATTERNMX_Compu "" RAT_FUNC "%6.2" "" COEFFS 0 1 0 0 0 1 /end COMPU_METHOD
/begin COMPU_METHOD SY_ZBLRELS_Compu "" TAB_VERB "%6.3" "" COMPU_TAB_REF SY_ZBLRELS_Compu /end COMPU_METHOD
/begin COMPU_VTAB SY_ZBLRELS_Compu "" TAB_VERB 3 0 "SY_ZBLRELS_0" 1 "SY_ZBLRELS_1" 2 "SY_ZBLRELS_2" /end COMPU_VTAB
/begin COMPU_METHOD SY_ZGST_Compu "" TAB_VERB "%6.3" "" COMPU_TAB_REF SY_ZGST_Compu /end COMPU_METHOD
/begin COMPU_VTAB SY_ZGST_Compu "" TAB_VERB 3 0 "SY_ZGST_0" 1 "SY_ZGST_1" 2 "SY_ZGST_2" /end COMPU_VTAB
/begin COMPU_METHOD SY_ZMS_Compu "" TAB_VERB "%6.3" "" COMPU_TAB_REF SY_ZMS_Compu /end COMPU_METHOD
/begin COMPU_VTAB SY_ZMS_Compu "" TAB_VERB 2 0 "kein Zweimassenschwungrad Schutz ist aktiv" 1 "Zweimassenschwungrad Schutz ist aktiv" /end COMPU_VTAB
/begin COMPU_METHOD SY_ZNDAUS_Compu "" TAB_VERB "%6.3" "" COMPU_TAB_REF SY_ZNDAUS_Compu /end COMPU_METHOD
/begin COMPU_VTAB SY_ZNDAUS_Compu "" TAB_VERB 4 1 "Single_ended_ignition coil" 2 "Double_ended_ignition coil" 3 "single_ended_ignition_coil_with_twinspark_ignition" 4 "calibratable_ignition_coil" /end COMPU_VTAB
/begin COMPU_METHOD SY_ZUESTA_Compu "" TAB_VERB "%6.3" "" COMPU_TAB_REF SY_ZUESTA_Compu /end COMPU_METHOD
/begin COMPU_VTAB SY_ZUESTA_Compu "" TAB_VERB 2 0 "False" 1 "True" /end COMPU_VTAB
/begin COMPU_METHOD SY_ZYLOFFH_Compu "" RAT_FUNC "%6.2" "" COEFFS 0 1 0 0 0 1 /end COMPU_METHOD
/begin COMPU_METHOD SY_ZYLOFFS_Compu "" RAT_FUNC "%6.2" "" COEFFS 0 1 0 0 0 1 /end COMPU_METHOD
/begin COMPU_METHOD SY_ZYLZA_Compu "" TAB_VERB "%6.3" "" COMPU_TAB_REF SY_ZYLZA_Compu /end COMPU_METHOD
/begin COMPU_VTAB SY_ZYLZA_Compu "" TAB_VERB 11 1 "1" 2 "2" 3 "3" 4 "4" 5 "5" 6 "6" 8 "8" 10 "10" 12 "12" 16 "16" 18 "18" /end COMPU_VTAB
/begin COMPU_METHOD SY_ZYLZG_Compu "" RAT_FUNC "%6.2" "" COEFFS 0 1 0 0 0 1 /end COMPU_METHOD
/begin COMPU_METHOD SY_ZZBANKB_Compu "" RAT_FUNC "%6.2" "" COEFFS 0 1 0 0 0 1 /end COMPU_METHOD
/begin COMPU_METHOD SY_ZZBANK_Compu "" RAT_FUNC "%6.2" "" COEFFS 0 1 0 0 0 1 /end COMPU_METHOD
/begin COMPU_METHOD SY_ZZHMB_Compu "" RAT_FUNC "%6.2" "" COEFFS 0 1 0 0 0 1 /end COMPU_METHOD
/begin COMPU_METHOD SY_ZZLAM_Compu "" TAB_VERB "%6.3" "" COMPU_TAB_REF SY_ZZLAM_Compu /end COMPU_METHOD
/begin COMPU_VTAB SY_ZZLAM_Compu "" TAB_VERB 2 0 "keine zylinderindividuelle Lambdaregelung" 1 "zylinderindividuelle Lambdaregelung vorhanden" /end COMPU_VTAB
/begin COMPU_METHOD SY_ZZMBA_Compu "" RAT_FUNC "%6.2" "" COEFFS 0 1 0 0 0 1 /end COMPU_METHOD
/begin COMPU_METHOD SY_ZZRL_Compu "" RAT_FUNC "%6.2" "" COEFFS 0 1 0 0 0 1 /end COMPU_METHOD
/begin COMPU_METHOD SY_ZZSG_Compu "" RAT_FUNC "%6.2" "" COEFFS 0 1 0 0 0 1 /end COMPU_METHOD
/begin COMPU_METHOD SY_ZZYLB1_Compu "" RAT_FUNC "%6.2" "" COEFFS 0 1 0 0 0 1 /end COMPU_METHOD
/begin COMPU_METHOD SY_ZZYLB2_Compu "" RAT_FUNC "%6.2" "" COEFFS 0 1 0 0 0 1 /end COMPU_METHOD
/begin COMPU_METHOD t100msxs_q16Em6 "" RAT_FUNC "%7.6" "s" COEFFS 0 1 0 0 0 1.6e-005 /end COMPU_METHOD
/begin COMPU_METHOD T15RAWDSQENA_SC_Compu "" TAB_VERB "%6.3" "" COMPU_TAB_REF T15RAWDSQENA_SC_Compu /end COMPU_METHOD
/begin COMPU_VTAB T15RAWDSQENA_SC_Compu "" TAB_VERB 2 0 "Disabled" 1 "Enabled" /end COMPU_VTAB
/begin COMPU_METHOD T15_DBGMD_VD_SY_Compu "" TAB_VERB "%6.3" "" COMPU_TAB_REF T15_DBGMD_VD_SY_Compu /end COMPU_METHOD
/begin COMPU_VTAB T15_DBGMD_VD_SY_Compu "" TAB_VERB 2 0 "False" 1 "True" /end COMPU_VTAB
/begin COMPU_METHOD T15_ON_VLDT_COM_SY_Compu "" TAB_VERB "%6.3" "" COMPU_TAB_REF T15_ON_VLDT_COM_SY_Compu /end COMPU_METHOD
/begin COMPU_VTAB T15_ON_VLDT_COM_SY_Compu "" TAB_VERB 2 0 "False" 1 "True" /end COMPU_VTAB
/begin COMPU_METHOD T15_WKDETN_SC_Compu "" TAB_VERB "%6.3" "" COMPU_TAB_REF T15_WKDETN_SC_Compu /end COMPU_METHOD
/begin COMPU_VTAB T15_WKDETN_SC_Compu "" TAB_VERB 2 0 "False" 1 "True" /end COMPU_VTAB
/begin COMPU_METHOD t1p0usxms "" RAT_FUNC "%6.5" "ms" COEFFS 0 1000 0 0 0 1 /end COMPU_METHOD
/begin COMPU_METHOD t20msxs_ub_b5p1 "" RAT_FUNC "%6.4" "s" COEFFS 0 1 0 0 0 0.02 /end COMPU_METHOD
/begin COMPU_METHOD T50_ATS_SY_Compu "" TAB_VERB "%6.3" "" COMPU_TAB_REF T50_ATS_SY_Compu /end COMPU_METHOD
/begin COMPU_VTAB T50_ATS_SY_Compu "" TAB_VERB 2 0 "T50_ATS_DISABLED" 1 "T50_ATS_ENABLED" /end COMPU_VTAB
/begin COMPU_METHOD t6minxmin_q6 "" RAT_FUNC "%6.2" "min" COEFFS 0 1 0 0 0 6 /end COMPU_METHOD
/begin COMPU_METHOD T87_MON_SY_Compu "" TAB_VERB "%6.3" "" COMPU_TAB_REF T87_MON_SY_Compu /end COMPU_METHOD
/begin COMPU_VTAB T87_MON_SY_Compu "" TAB_VERB 2 0 "No Diag for Open Load" 1 "Open Load Diag active" /end COMPU_VTAB
/begin COMPU_METHOD TAIRCMPRDSMDL_SC_Compu "" TAB_VERB "%6.3" "" COMPU_TAB_REF TAIRCMPRDSMDL_SC_Compu /end COMPU_METHOD
/begin COMPU_VTAB TAIRCMPRDSMDL_SC_Compu "" TAB_VERB 2 0 "MDL_NO" 1 "MDL_OVER_CMPR" /end COMPU_VTAB
/begin COMPU_METHOD TBLOWBYHEATR_TYPAVL_SC_Compu "" TAB_VERB "%6.3" "" COMPU_TAB_REF TBLOWBYHEATR_TYPAVL_SC_Compu /end COMPU_METHOD
/begin COMPU_VTAB TBLOWBYHEATR_TYPAVL_SC_Compu "" TAB_VERB 2 0 "False" 1 "True" /end COMPU_VTAB
/begin COMPU_METHOD TCAT2DMDL_SC_Compu "" TAB_VERB "%6.3" "" COMPU_TAB_REF TCAT2DMDL_SC_Compu /end COMPU_METHOD
/begin COMPU_VTAB TCAT2DMDL_SC_Compu "" TAB_VERB 2 0 "0" 1 "1" /end COMPU_VTAB
/begin COMPU_METHOD TCE_FCOEXTD_SC_Compu "" TAB_VERB "%6.3" "" COMPU_TAB_REF TCE_FCOEXTD_SC_Compu /end COMPU_METHOD
/begin COMPU_VTAB TCE_FCOEXTD_SC_Compu "" TAB_VERB 2 0 "False" 1 "True" /end COMPU_VTAB
/begin COMPU_METHOD Temp_Cels "" RAT_FUNC "%6.1" "deg C" COEFFS 0 10 2731.4 0 0 1 /end COMPU_METHOD
/begin COMPU_METHOD temp_q0p0234_o273 "" RAT_FUNC "%6.1" "Grad C" COEFFS 0 1 273.15 0 0 0.0234375 /end COMPU_METHOD
/begin COMPU_METHOD temp_q0p1_o273 "" RAT_FUNC "%6.1" "Grad C" COEFFS 0 10 2731.4 0 0 1 /end COMPU_METHOD
/begin COMPU_METHOD temp_sb_q0p75 "" RAT_FUNC "%6.3" "Grad C" COEFFS 0 1 0 0 0 0.75 /end COMPU_METHOD
/begin COMPU_METHOD temp_ub_q0p75_o48 "" RAT_FUNC "%6.2" "Grad C" COEFFS 0 1 48 0 0 0.75 /end COMPU_METHOD
/begin COMPU_METHOD TimeDeb "" RAT_FUNC "%6.1" "ms" COEFFS 0 0.1 0 0 0 1 /end COMPU_METHOD
/begin COMPU_METHOD TimeDelay_s "" RAT_FUNC "%6.1" "s" COEFFS 0 0 1 0 0.00023283064365387 0 /end COMPU_METHOD
/begin COMPU_METHOD TimeRed "" RAT_FUNC "%6.3" "s" COEFFS 0 6.25 0 0 0 1 /end COMPU_METHOD
/begin COMPU_METHOD Time_ms "" RAT_FUNC "%6.1" "ms" COEFFS 0 0.1 0 0 0 1 /end COMPU_METHOD
/begin COMPU_METHOD Time_s "" RAT_FUNC "%6.4" "s" COEFFS 0 100 0 0 0 1 /end COMPU_METHOD
/begin COMPU_METHOD Time_Second "" RAT_FUNC "%6.2" "s" COEFFS 0 1 0 0 0 1 /end COMPU_METHOD
/begin COMPU_METHOD TransR "" RAT_FUNC "%6.4" "-" COEFFS 0 100 0 0 0 1 /end COMPU_METHOD
/begin COMPU_METHOD Trq "" RAT_FUNC "%6.3" "Nm" COEFFS 0 10 0 0 0 1 /end COMPU_METHOD
/begin COMPU_METHOD TrqHigh "" RAT_FUNC "%6.5" "Nm" COEFFS 0 1000 0 0 0 1 /end COMPU_METHOD
/begin COMPU_METHOD TrqHigh_q0p01 "" RAT_FUNC "%6.4" "Nm" COEFFS 0 100 0 0 0 1 /end COMPU_METHOD
/begin COMPU_METHOD TrqPerSec "" RAT_FUNC "%6.2" "Nm/s" COEFFS 0 1 0 0 0 1 /end COMPU_METHOD
/begin COMPU_METHOD trq_q0p1 "" RAT_FUNC "%6.3" "Nm" COEFFS 0 10 0 0 0 1 /end COMPU_METHOD
/begin COMPU_METHOD t_q0p000122 "" RAT_FUNC "%6.5" "s" COEFFS 0 65536 0 0 0 8 /end COMPU_METHOD
/begin COMPU_METHOD t_q0p01 "" RAT_FUNC "%6.4" "s" COEFFS 0 100 0 0 0 1 /end COMPU_METHOD
/begin COMPU_METHOD t_q0p02 "" RAT_FUNC "%6.4" "s" COEFFS 0 100 0 0 0 2 /end COMPU_METHOD
/begin COMPU_METHOD t_q0p1 "" RAT_FUNC "%6.3" "s" COEFFS 0 10 0 0 0 1 /end COMPU_METHOD
/begin COMPU_METHOD Vel "" RAT_FUNC "%6.4" "km/h" COEFFS 0 100 0 0 0 1 /end COMPU_METHOD
/begin COMPU_METHOD vel_q0p01 "" RAT_FUNC "%6.4" "km/h" COEFFS 0 100 0 0 0 1 /end COMPU_METHOD
/begin COMPU_METHOD vfzg_uw_b325 "" RAT_FUNC "%6.4" "km/h" COEFFS 0 65536 0 0 0 325 /end COMPU_METHOD
/begin COMPU_METHOD zk10msxs_uw_b655p36 "" RAT_FUNC "%6.2" "s" COEFFS 0 0 65536 0 100 0 /end COMPU_METHOD
/begin RECORD_LAYOUT RB_Axis_S16 NO_AXIS_PTS_X 1 SWORD AXIS_PTS_X 2 SWORD INDEX_INCR DIRECT /end RECORD_LAYOUT
/begin RECORD_LAYOUT RB_Axis_S8 NO_AXIS_PTS_X 1 SBYTE AXIS_PTS_X 2 SBYTE INDEX_INCR DIRECT /end RECORD_LAYOUT
/begin RECORD_LAYOUT RB_Curve_S16_S16 NO_AXIS_PTS_X 1 SWORD AXIS_PTS_X 2 SWORD INDEX_INCR DIRECT FNC_VALUES 3 SWORD COLUMN_DIR DIRECT /end RECORD_LAYOUT
/begin RECORD_LAYOUT RB_Curve_S16_U16_Static NO_AXIS_PTS_X 1 SWORD AXIS_PTS_X 2 SWORD INDEX_INCR DIRECT FNC_VALUES 3 UWORD COLUMN_DIR DIRECT STATIC_RECORD_LAYOUT /end RECORD_LAYOUT
/begin RECORD_LAYOUT RB_Curve_S8_S16_Static NO_AXIS_PTS_X 1 SBYTE AXIS_PTS_X 2 SBYTE INDEX_INCR DIRECT FNC_VALUES 3 SWORD COLUMN_DIR DIRECT STATIC_RECORD_LAYOUT /end RECORD_LAYOUT
/begin RECORD_LAYOUT RB_Curve_S8_U8_Static NO_AXIS_PTS_X 1 SBYTE AXIS_PTS_X 2 SBYTE INDEX_INCR DIRECT FNC_VALUES 3 UBYTE COLUMN_DIR DIRECT STATIC_RECORD_LAYOUT /end RECORD_LAYOUT
/begin RECORD_LAYOUT RB_Curve_U16_U16 NO_AXIS_PTS_X 1 UWORD AXIS_PTS_X 2 UWORD INDEX_INCR DIRECT FNC_VALUES 3 UWORD COLUMN_DIR DIRECT /end RECORD_LAYOUT
/begin RECORD_LAYOUT RB_Curve_U16_U8_Static NO_AXIS_PTS_X 1 UWORD AXIS_PTS_X 2 UWORD INDEX_INCR DIRECT FNC_VALUES 3 UBYTE COLUMN_DIR DIRECT STATIC_RECORD_LAYOUT /end RECORD_LAYOUT
/begin RECORD_LAYOUT RB_Curve_U8_U16_Static NO_AXIS_PTS_X 1 UBYTE AXIS_PTS_X 2 UBYTE INDEX_INCR DIRECT FNC_VALUES 3 UWORD COLUMN_DIR DIRECT STATIC_RECORD_LAYOUT /end RECORD_LAYOUT
/begin RECORD_LAYOUT RB_Curve_U8_U8 NO_AXIS_PTS_X 1 UBYTE AXIS_PTS_X 2 UBYTE INDEX_INCR DIRECT FNC_VALUES 3 UBYTE COLUMN_DIR DIRECT /end RECORD_LAYOUT
/begin RECORD_LAYOUT RB_Kw_Wu8 FNC_VALUES 1 UBYTE COLUMN_DIR DIRECT /end RECORD_LAYOUT
/begin RECORD_LAYOUT RB_MapGroup_U16 FNC_VALUES 1 UWORD COLUMN_DIR DIRECT /end RECORD_LAYOUT
/begin RECORD_LAYOUT RB_MapGroup_U8 FNC_VALUES 1 UBYTE COLUMN_DIR DIRECT /end RECORD_LAYOUT
/begin RECORD_LAYOUT RB_Map_S16S16_U8 NO_AXIS_PTS_X 1 SWORD NO_AXIS_PTS_Y 2 SWORD AXIS_PTS_X 3 SWORD INDEX_INCR DIRECT AXIS_PTS_Y 4 SWORD INDEX_INCR DIRECT FNC_VALUES 5 UBYTE COLUMN_DIR DIRECT /end RECORD_LAYOUT
/begin RECORD_LAYOUT RB_Map_S16U8_S16 NO_AXIS_PTS_X 1 SWORD NO_AXIS_PTS_Y 2 SWORD AXIS_PTS_X 3 SWORD INDEX_INCR DIRECT AXIS_PTS_Y 4 UBYTE INDEX_INCR DIRECT FNC_VALUES 5 SWORD COLUMN_DIR DIRECT /end RECORD_LAYOUT
/begin RECORD_LAYOUT RB_Map_U16U16_S16 NO_AXIS_PTS_X 1 UWORD NO_AXIS_PTS_Y 2 UWORD AXIS_PTS_X 3 UWORD INDEX_INCR DIRECT AXIS_PTS_Y 4 UWORD INDEX_INCR DIRECT FNC_VALUES 5 SWORD COLUMN_DIR DIRECT /end RECORD_LAYOUT
/begin RECORD_LAYOUT RB_Map_U16U16_U16 NO_AXIS_PTS_X 1 UWORD NO_AXIS_PTS_Y 2 UWORD AXIS_PTS_X 3 UWORD INDEX_INCR DIRECT AXIS_PTS_Y 4 UWORD INDEX_INCR DIRECT FNC_VALUES 5 UWORD COLUMN_DIR DIRECT /end RECORD_LAYOUT
/begin RECORD_LAYOUT RB_ValA_Wu16 FNC_VALUES 1 UWORD COLUMN_DIR DIRECT /end RECORD_LAYOUT
/begin RECORD_LAYOUT RB_Val_Wboolean FNC_VALUES 1 UBYTE COLUMN_DIR DIRECT /end RECORD_LAYOUT
/begin RECORD_LAYOUT RB_Val_Ws16 FNC_VALUES 1 SWORD COLUMN_DIR DIRECT /end RECORD_LAYOUT
/begin RECORD_LAYOUT RB_Val_Ws32 FNC_VALUES 1 SLONG COLUMN_DIR DIRECT /end RECORD_LAYOUT
/begin RECORD_LAYOUT RB_Val_Ws8 FNC_VALUES 1 SBYTE COLUMN_DIR DIRECT /end RECORD_LAYOUT
/begin RECORD_LAYOUT RB_Val_Wu16 FNC_VALUES 1 UWORD COLUMN_DIR DIRECT /end RECORD_LAYOUT
/begin RECORD_LAYOUT RB_Val_Wu32 FNC_VALUES 1 ULONG COLUMN_DIR DIRECT /end RECORD_LAYOUT
/begin RECORD_LAYOUT RB_Val_Wu8 FNC_VALUES 1 UBYTE COLUMN_DIR DIRECT /end RECORD_LAYOUT
/begin RECORD_LAYOUT ValA_Wu16 FNC_VALUES 1 UWORD COLUMN_DIR DIRECT /end RECORD_LAYOUT
/begin RECORD_LAYOUT ValA_Wu8 FNC_VALUES 1 UBYTE COLUMN_DIR DIRECT /end RECORD_LAYOUT
/begin RECORD_LAYOUT Val_Wu8 FNC_VALUES 1 UBYTE COLUMN_DIR DIRECT /end RECORD_LAYOUT
/end MODULE
/end PROJECT
