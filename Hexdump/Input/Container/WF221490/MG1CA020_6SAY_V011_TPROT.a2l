ASAP2_VERSION 1 60
/begin PROJECT MG1CA020 "MG1CA020"
/begin HEADER "" VERSION "MG1CA020_6SAY_V011_TPROT" PROJECT_NO MG1CA020 /end HEADER
/begin MODULE DIM ""
/begin MOD_COMMON "" BYTE_ORDER MSB_LAST ALIGNMENT_BYTE 1 ALIGNMENT_WORD 2 ALIGNMENT_LONG 4 ALIGNMENT_INT64 4 ALIGNMENT_FLOAT32_IEEE 4 ALIGNMENT_FLOAT64_IEEE 4 DATA_SIZE 32 /end MOD_COMMON
/*********** End of merged CHARACTERISTIC blocks ***********/
/begin CHARACTERISTIC ABMM4 "Injection Cutoff Pattern for Torque Reduction (4 Cylinde Engine)" VAL_BLK 0x804FB3B8 RB_ValA_Wu8 255.0 dez 0.00 255.0 FORMAT "%5.1" NUMBER 4 /end CHARACTERISTIC
/begin CHARACTERISTIC ACComp_CalcDem_CW "codeword: configuartion of torque calculation" VALUE 0x804FA8C4 RB_Val_Wu8 255.0 OneToOne 0.00 255.0 FORMAT "%5.1" /end CHARACTERISTIC
/begin CHARACTERISTIC ACComp_facACCmprOnResv_M "MAP of AC HW off torque reserve factor when AC compressor on" MAP 0x804FA8C6 RB_Map_S16S16_S16 327.6700 fak_q0p01 0.00 327.6700 FORMAT "%8.4" EXTENDED_LIMITS -327.6800 327.6700
 /begin AXIS_DESCR STD_AXIS AirC_pClnt PresAC_hPa 6 -65536.00 65534.00 FORMAT "%8.2" DEPOSIT ABSOLUTE /end AXIS_DESCR
 /begin AXIS_DESCR STD_AXIS ACEvpT_t Temp_Cels 6 -3549.940 3003.560 FORMAT "%8.3" DEPOSIT ABSOLUTE /end AXIS_DESCR
/end CHARACTERISTIC
/begin CHARACTERISTIC ACComp_facCmprEnthCorrnA_C "Correction coefficient for calculating compressor ?enthalpy at A/C ideal adiabatic(A term)" VALUE 0x804FA92C RB_Val_Ws32 429496.729500 Fact_10000 -214748.364800 214748.364700 FORMAT "%13.6" /end CHARACTERISTIC
/begin CHARACTERISTIC ACComp_facCmprEnthCorrnB_C "Correction coefficient for calculating compressor ?enthalpy at A/C ideal adiabatic(B term)" VALUE 0x804FA930 RB_Val_Ws32 429496.729500 Fact_10000 -214748.364800 214748.364700 FORMAT "%13.6" /end CHARACTERISTIC
/begin CHARACTERISTIC ACComp_facCmprPlly_C "COMPR PR Compressor pulley ratio" VALUE 0x804FA934 RB_Val_Ws16 655.3500 Fact100 -327.6800 327.6700 FORMAT "%8.4" /end CHARACTERISTIC
/begin CHARACTERISTIC ACComp_facCmprTqExtInp_C "Conversion coefficient of AC compressor torque external input" VALUE 0x804FA936 RB_Val_Wu16 32.76700 Fact1000 0.00 32.76700 FORMAT "%8.5" EXTENDED_LIMITS 0.00 65.53500 /end CHARACTERISTIC
/begin CHARACTERISTIC ACComp_facCooltFlowQnty_M "MAP for calculating Coefficient for A/C refrigerant flow quantity" MAP 0x804FA938 RB_Map_S16S16_S16 65.53500 Fact1000 -32.76800 32.76700 FORMAT "%8.5"
 /begin AXIS_DESCR STD_AXIS ACComp_rWindVWghtAvrg Prc_Fact100 3 -327.6800 327.6700 FORMAT "%8.4" DEPOSIT ABSOLUTE /end AXIS_DESCR
 /begin AXIS_DESCR STD_AXIS VehV_v Vel 8 -327.6800 327.6700 FORMAT "%8.4" DEPOSIT ABSOLUTE /end AXIS_DESCR
/end CHARACTERISTIC
/begin CHARACTERISTIC ACComp_facCurrCtrlVal_C "Coefficient of AC control value current chatacteristic" VALUE 0x804FA984 RB_Val_Ws32 429496.729500 Fact_10000 -214748.364800 214748.364700 FORMAT "%13.6" /end CHARACTERISTIC
/begin CHARACTERISTIC ACComp_facEnthpyCorrnA_C "AC variable capacity COMPR delta Correction term A for enthalpy calculation A" VALUE 0x804FA988 RB_Val_Ws32 429496.729500 Fact_10000 -214748.364800 214748.364700 FORMAT "%13.6" /end CHARACTERISTIC
/begin CHARACTERISTIC ACComp_facEnthpyCorrnB_C "AC variable capacity COMPR delta Correction term B for calculation of enthalpy B" VALUE 0x804FA98C RB_Val_Ws32 429496.729500 Fact_10000 -214748.364800 214748.364700 FORMAT "%13.6" /end CHARACTERISTIC
/begin CHARACTERISTIC ACComp_facFanStVal_C "Coefficient for calculating Fan status value." VALUE 0x804FA990 RB_Val_Ws32 429496.729500 Fact_10000 -214748.364800 214748.364700 FORMAT "%13.6" /end CHARACTERISTIC
/begin CHARACTERISTIC ACComp_facFullCpTqCoeffA_C "Coefficient for torque calculation in the time of compressor MAX capacity (A term)" VALUE 0x804FA994 RB_Val_Ws32 429496.729500 Fact_10000 -214748.364800 214748.364700 FORMAT "%13.6" /end CHARACTERISTIC
/begin CHARACTERISTIC ACComp_facFullCpTqCoeffB_C "Coefficient for torque calculation in the time of compressor MAX capacity (B term)" VALUE 0x804FA998 RB_Val_Ws32 429496.729500 Fact_10000 -214748.364800 214748.364700 FORMAT "%13.6" /end CHARACTERISTIC
/begin CHARACTERISTIC ACComp_facFullCpTqCorrn_C "correction term of torque calculation in the time of compressor MAX capacity" VALUE 0x804FA99C RB_Val_Ws32 429496.729500 Fact_10000 -214748.364800 214748.364700 FORMAT "%13.6" /end CHARACTERISTIC
/begin CHARACTERISTIC ACComp_facGearACCmprOnResv_M "MAP of AC HW off torque reserve factor in driving state and AC compressor on" MAP 0x804FA9A0 RB_Map_S16S16_S16 327.6700 fak_q0p01 0.00 327.6700 FORMAT "%8.4" EXTENDED_LIMITS -327.6800 327.6700
 /begin AXIS_DESCR STD_AXIS AirC_pClnt PresAC_hPa 6 -65536.00 65534.00 FORMAT "%8.2" DEPOSIT ABSOLUTE /end AXIS_DESCR
 /begin AXIS_DESCR STD_AXIS ACEvpT_t Temp_Cels 6 -3549.940 3003.560 FORMAT "%8.3" DEPOSIT ABSOLUTE /end AXIS_DESCR
/end CHARACTERISTIC
/begin CHARACTERISTIC ACComp_facHwGearOffResv_T "AC HW off torque reserve factor Curve in driving state" CURVE 0x804FAA04 RB_Curve_S16_S16 327.6700 fak_q0p01 0.00 327.6700 FORMAT "%8.4" EXTENDED_LIMITS -327.6800 327.6700
 /begin AXIS_DESCR STD_AXIS CEngDsT_t Temp_Cels 8 -3549.940 3003.560 FORMAT "%8.3" DEPOSIT ABSOLUTE /end AXIS_DESCR
/end CHARACTERISTIC
/begin CHARACTERISTIC ACComp_facHwOffResv_T "AC HW off torque reserve factor Curve" CURVE 0x804FAA26 RB_Curve_S16_S16 327.6700 fak_q0p01 0.00 327.6700 FORMAT "%8.4" EXTENDED_LIMITS -327.6800 327.6700
 /begin AXIS_DESCR STD_AXIS CEngDsT_t Temp_Cels 8 -3549.940 3003.560 FORMAT "%8.3" DEPOSIT ABSOLUTE /end AXIS_DESCR
/end CHARACTERISTIC
/begin CHARACTERISTIC ACComp_facOutdTCorrnA_C "Correction term of outside temperature in the time of idle (A term)" VALUE 0x804FAA48 RB_Val_Ws32 429496.729500 Fact_10000 -214748.364800 214748.364700 FORMAT "%13.6" /end CHARACTERISTIC
/begin CHARACTERISTIC ACComp_facOutdTCorrnB_C "Correction term of outside temperature in the time of idle (B term)" VALUE 0x804FAA4C RB_Val_Ws32 429496.729500 Fact_10000 -214748.364800 214748.364700 FORMAT "%13.6" /end CHARACTERISTIC
/begin CHARACTERISTIC ACComp_facOutdTDurgIdleA_C "Correction coefficient for outside temperature in the time of idle (A term)" VALUE 0x804FAA50 RB_Val_Ws32 429496.729500 Fact_10000 -214748.364800 214748.364700 FORMAT "%13.6" /end CHARACTERISTIC
/begin CHARACTERISTIC ACComp_facOutdTDurgIdleB_C "Correction coefficient for outside temperature in the time of idle (B term)" VALUE 0x804FAA54 RB_Val_Ws32 429496.729500 Fact_10000 -214748.364800 214748.364700 FORMAT "%13.6" /end CHARACTERISTIC
/begin CHARACTERISTIC ACComp_facTqEvaprSnsrValB_C "Coefficient for calculating Evaporator torque at Ps control valve(B term)" VALUE 0x804FAA58 RB_Val_Ws32 429496.729500 Fact_10000 -214748.364800 214748.364700 FORMAT "%13.6" /end CHARACTERISTIC
/begin CHARACTERISTIC ACComp_facTqEvaprSnsrValC_C "Coefficient for calculating Evaporator torque in the time of compressor MAX capacity (C term)" VALUE 0x804FAA5C RB_Val_Ws32 429496.729500 Fact_10000 -214748.364800 214748.364700 FORMAT "%13.6" /end CHARACTERISTIC
/begin CHARACTERISTIC ACComp_facTqPSnsrCtrlVal_C "Coefficient for calculating torque at Pressure sensor control value" VALUE 0x804FAA60 RB_Val_Ws32 429496.729500 Fact_10000 -214748.364800 214748.364700 FORMAT "%13.6" /end CHARACTERISTIC
/begin CHARACTERISTIC ACCOMP_FALSE "FALSE value" VALUE 0x804FAA64 RB_Val_Wu8 1.00000000000 B_TRUE 0.00 1.00000000000 FORMAT "%13.11" /end CHARACTERISTIC
/begin CHARACTERISTIC ACComp_flgSwtACCmprSeln_C "AC compressor selection switch" VALUE 0x804FAA65 RB_Val_Wu8 1.00000000000 B_TRUE 0.00 1.00000000000 FORMAT "%13.11" /end CHARACTERISTIC
/begin CHARACTERISTIC ACComp_iMaxACCmpr_C "Calibration for Maximum AC compressor current" VALUE 0x804FAA66 RB_Val_Wu16 65535.00 i_q1_mA 0.00 65535.00 FORMAT "%8.2" /end CHARACTERISTIC
/begin CHARACTERISTIC ACComp_mMinCooltFlowQnty_T "Table for Minimum refrigerant flow quantity" CURVE 0x804FAA68 RB_Curve_S16_S16 655.3500 O2MassPerTime -327.6800 327.6700 FORMAT "%8.4"
 /begin AXIS_DESCR STD_AXIS ACComp_tActOutdT Temp_Cels 5 -3549.940 3003.560 FORMAT "%8.3" DEPOSIT ABSOLUTE /end AXIS_DESCR
/end CHARACTERISTIC
/begin CHARACTERISTIC ACComp_nOutdTCalcnPrmsSpd_C "Outside temperature calculation permission enable value" VALUE 0x804FAA7E RB_Val_Ws16 32767.50 EngN -16384.00 16383.50 FORMAT "%8.2" /end CHARACTERISTIC
/begin CHARACTERISTIC ACCOMP_PCOEFF "AC compressor pressure coefficient" VALUE 0x804FAA80 RB_Val_Wu16 65535.00 OneToOne 0.00 65535.00 FORMAT "%8.2" READ_ONLY /end CHARACTERISTIC
/begin CHARACTERISTIC ACComp_pCurrCorrnCtrlVal_C "Correction term of AC control value current chatacteristic" VALUE 0x804FAA84 RB_Val_Ws32 429496.729500 RBPtCel_p_0p0001_2 -214748.364800 214748.364700 FORMAT "%13.6" /end CHARACTERISTIC
/begin CHARACTERISTIC ACComp_rFan2_C "Coefficient value of Fan 2." VALUE 0x804FAA88 RB_Val_Ws16 799.9878 Prc -400.0000 399.9878 FORMAT "%8.4" /end CHARACTERISTIC
/begin CHARACTERISTIC ACComp_rFanHi_C "Higher Fan Threshold" VALUE 0x804FAA8A RB_Val_Ws16 799.9878 Prc -400.0000 399.9878 FORMAT "%8.4" /end CHARACTERISTIC
/begin CHARACTERISTIC ACComp_rFanLo_C "Lower Fan Threshold" VALUE 0x804FAA8C RB_Val_Ws16 799.9878 Prc -400.0000 399.9878 FORMAT "%8.4" /end CHARACTERISTIC
/begin CHARACTERISTIC ACComp_rFan_C "Coefficient value of Fan." VALUE 0x804FAA8E RB_Val_Ws16 799.9878 Prc -400.0000 399.9878 FORMAT "%8.4" /end CHARACTERISTIC
/begin CHARACTERISTIC ACComp_swtCmprExtInpTest_C "TEST switch for AC compressor torque external input" VALUE 0x804FAA90 RB_Val_Wu8 1.00000000000 B_TRUE 0.00 1.00000000000 FORMAT "%13.11" /end CHARACTERISTIC
/begin CHARACTERISTIC ACComp_swtComMsgSeln_C "Switch to select the Com message" VALUE 0x804FAA91 RB_Val_Wu8 255.0 OneToOne 0.00 255.0 FORMAT "%5.1" /end CHARACTERISTIC
/begin CHARACTERISTIC ACComp_swtLdCAN_C "switch AC torque via CAN" VALUE 0x804FAA92 RB_Val_Ws8 1.00000000000 B_TRUE 0.00 1.00000000000 FORMAT "%13.11" /end CHARACTERISTIC
/begin CHARACTERISTIC ACComp_swtLd_C "Codeword: Hard / soft load switch on of AC compressor" VALUE 0x804FAA93 RB_Val_Wu8 1.00000000000 B_TRUE 0.00 1.00000000000 FORMAT "%13.11" /end CHARACTERISTIC
/begin CHARACTERISTIC ACComp_swtStrtUpJdgCondByp_C "Bypass condition of Static torque calculation for Start Up Judgment" VALUE 0x804FAA94 RB_Val_Wu8 1.00000000000 B_TRUE 0.00 1.00000000000 FORMAT "%13.11" /end CHARACTERISTIC
/begin CHARACTERISTIC ACComp_swtTrqOffsBhv_C "Selecatable conditions for torque offset functionality" VALUE 0x804FAA95 RB_Val_Wu8 255.0 OneToOne 0.00 255.0 FORMAT "%5.1" /end CHARACTERISTIC
/begin CHARACTERISTIC ACComp_swtTSel_C "Switch to select different temparatures" VALUE 0x804FAA96 RB_Val_Wu8 255.0 OneToOne 0.00 255.0 FORMAT "%5.1" /end CHARACTERISTIC
/begin CHARACTERISTIC ACComp_swtVehVCondByp_C "Bypass vehicle speed condition of Static torque calculation for Start Up Judgment" VALUE 0x804FAA97 RB_Val_Wu8 1.00000000000 B_TRUE 0.00 1.00000000000 FORMAT "%13.11" /end CHARACTERISTIC
/begin CHARACTERISTIC ACComp_tCmprEnthIdealAdbt_M "Map for calculating compressor enthalpy at AC ideal adiabatic" MAP 0x804FAA98 RB_Map_S16S16_S16 655.3500 RBPtCel_t_0p01_2 -327.6800 327.6700 FORMAT "%8.4"
 /begin AXIS_DESCR STD_AXIS ACComp_pClntCtrlVal RBPtCel_p_1p0_3 9 -32768.00 32767.00 FORMAT "%8.2" DEPOSIT ABSOLUTE /end AXIS_DESCR
 /begin AXIS_DESCR STD_AXIS ACComp_pLoPVal RBPtCel_p_1p0_3 9 -32768.00 32767.00 FORMAT "%8.2" DEPOSIT ABSOLUTE /end AXIS_DESCR
/end CHARACTERISTIC
/begin CHARACTERISTIC ACComp_tCooltSatnT_T "AC coolant saturation temperature table" CURVE 0x804FAB62 RB_Curve_S16_S16 6553.500 Temp_Cels -3549.940 3003.560 FORMAT "%8.3"
 /begin AXIS_DESCR STD_AXIS ACComp_pClntCtrlVal RBPtCel_p_1p0_3 9 -32768.00 32767.00 FORMAT "%8.2" DEPOSIT ABSOLUTE /end AXIS_DESCR
/end CHARACTERISTIC
/begin CHARACTERISTIC ACComp_tiACOffTimeInit_C "Init calibration for AC off time" VALUE 0x804FAB88 RB_Val_Ws16 1310.700 t_q0p02 -655.3600 655.3400 FORMAT "%8.4" /end CHARACTERISTIC
/begin CHARACTERISTIC ACComp_tiCmprStrtPClnt_T "AC variable capacity COMPR start time table" CURVE 0x804FAB8A RB_Curve_S16_S16 655350.0 Time_ms -327680.0 327670.0 FORMAT "%8.1"
 /begin AXIS_DESCR STD_AXIS AirC_pClnt PresAC_hPa 5 -65536.00 65534.00 FORMAT "%8.2" DEPOSIT ABSOLUTE /end AXIS_DESCR
/end CHARACTERISTIC
/begin CHARACTERISTIC ACComp_tiOnDlyT1DP_M "Map to determine Ramp up time depending on AC evaporator temparature and difference in pressure" MAP 0x804FABA0 RB_Map_S16S16_S16 1310.700 t_q0p02 -655.3600 655.3400 FORMAT "%8.4"
 /begin AXIS_DESCR STD_AXIS ACEvpT_t Temp_Cels 7 -3549.940 3003.560 FORMAT "%8.3" DEPOSIT ABSOLUTE /end AXIS_DESCR
 /begin AXIS_DESCR STD_AXIS ACComp_pACClntpDiff_MP PresAC_hPa 7 -65536.00 65534.00 FORMAT "%8.2" DEPOSIT ABSOLUTE /end AXIS_DESCR
/end CHARACTERISTIC
/begin CHARACTERISTIC ACComp_tiOnDlyT1Ti_M "Map to determine Ramp up time depending on AC evaporator temparature and AC off time" MAP 0x804FAC22 RB_Map_S16S16_S16 1310.700 t_q0p02 -655.3600 655.3400 FORMAT "%8.4"
 /begin AXIS_DESCR STD_AXIS ACEvpT_t Temp_Cels 7 -3549.940 3003.560 FORMAT "%8.3" DEPOSIT ABSOLUTE /end AXIS_DESCR
 /begin AXIS_DESCR STD_AXIS ACComp_tiACOffTime t_q0p02 7 -655.3600 655.3400 FORMAT "%8.4" DEPOSIT ABSOLUTE /end AXIS_DESCR
/end CHARACTERISTIC
/begin CHARACTERISTIC ACComp_tiOnDlyT2DP_M "Map to determine Ramp down time depending on AC evaporator temparature and difference in pressure" MAP 0x804FACA4 RB_Map_S16S16_S16 1310.700 t_q0p02 -655.3600 655.3400 FORMAT "%8.4"
 /begin AXIS_DESCR STD_AXIS ACEvpT_t Temp_Cels 7 -3549.940 3003.560 FORMAT "%8.3" DEPOSIT ABSOLUTE /end AXIS_DESCR
 /begin AXIS_DESCR STD_AXIS ACComp_pACClntpDiff_MP PresAC_hPa 7 -65536.00 65534.00 FORMAT "%8.2" DEPOSIT ABSOLUTE /end AXIS_DESCR
/end CHARACTERISTIC
/begin CHARACTERISTIC ACComp_tiOnDlyT2Ti_M "Map to determine Ramp down time depending on AC evaporator temparature and AC off time" MAP 0x804FAD26 RB_Map_S16S16_S16 1310.700 t_q0p02 -655.3600 655.3400 FORMAT "%8.4"
 /begin AXIS_DESCR STD_AXIS ACEvpT_t Temp_Cels 7 -3549.940 3003.560 FORMAT "%8.3" DEPOSIT ABSOLUTE /end AXIS_DESCR
 /begin AXIS_DESCR STD_AXIS ACComp_tiACOffTime t_q0p02 7 -655.3600 655.3400 FORMAT "%8.4" DEPOSIT ABSOLUTE /end AXIS_DESCR
/end CHARACTERISTIC
/begin CHARACTERISTIC ACComp_tiOnDlyT3Ti_M "Map to determine Ramp up time depending on AC evaporator temparature and AC off time" MAP 0x804FADA8 RB_Map_S16S16_S16 1310.700 t_q0p02 -655.3600 655.3400 FORMAT "%8.4"
 /begin AXIS_DESCR STD_AXIS ACEvpT_t Temp_Cels 7 -3549.940 3003.560 FORMAT "%8.3" DEPOSIT ABSOLUTE /end AXIS_DESCR
 /begin AXIS_DESCR STD_AXIS ACComp_tiACOffTime t_q0p02 7 -655.3600 655.3400 FORMAT "%8.4" DEPOSIT ABSOLUTE /end AXIS_DESCR
/end CHARACTERISTIC
/begin CHARACTERISTIC ACComp_tiOnDlyT4Ti_M "Map to determine Ramp up time depending on AC evaporator temparature and AC off time" MAP 0x804FAE2A RB_Map_S16S16_S16 1310.700 t_q0p02 -655.3600 655.3400 FORMAT "%8.4"
 /begin AXIS_DESCR STD_AXIS ACEvpT_t Temp_Cels 7 -3549.940 3003.560 FORMAT "%8.3" DEPOSIT ABSOLUTE /end AXIS_DESCR
 /begin AXIS_DESCR STD_AXIS ACComp_tiACOffTime t_q0p02 7 -655.3600 655.3400 FORMAT "%8.4" DEPOSIT ABSOLUTE /end AXIS_DESCR
/end CHARACTERISTIC
/begin CHARACTERISTIC ACComp_tiOutdTCalcnPrms_C "Coefficient for outside temperature calculation permission" VALUE 0x804FAEAC RB_Val_Ws16 655.3500 t_q0p01 -327.6800 327.6700 FORMAT "%8.4" /end CHARACTERISTIC
/begin CHARACTERISTIC ACComp_tiTCalcnPrepnPrms_C "Coefficient for outside temperature calculation preperation permission" VALUE 0x804FAEAE RB_Val_Ws16 6553.500 t_q0p1 -3276.800 3276.700 FORMAT "%8.3" /end CHARACTERISTIC
/begin CHARACTERISTIC ACComp_tiTrqDes_C "Turn Off Delay Time for Filtering AC reserve Torque when shutting of AC compressor" VALUE 0x804FAEB0 RB_Val_Ws32 42949672.9500 Time_s -21474836.4800 21474836.4700 FORMAT "%13.4" /end CHARACTERISTIC
/begin CHARACTERISTIC ACComp_tiTrqDyn_C "filter time for desired torque" VALUE 0x804FAEB4 RB_Val_Wu32 4294.9672949999995 TimeDelay_s 0.0000010000000 4294.9672959999998 FORMAT "%19.14" /end CHARACTERISTIC
/begin CHARACTERISTIC ACComp_tiTrqOffRmpDwnone_C "accomp_time trouqeoffs ramp down one" VALUE 0x804FAEB8 RB_Val_Ws32 4294.9672940000000 TimeDelay_s 0.0000020000000 4294.9672959999998 FORMAT "%19.14" EXTENDED_LIMITS 0.000002000000001 4294.9672959999998 /end CHARACTERISTIC
/begin CHARACTERISTIC ACComp_tiTrqOffsRmpDwn_C "filter time constant for downward ramping" VALUE 0x804FAEBC RB_Val_Ws32 4294.9672940000000 TimeDelay_s 0.0000020000000 4294.9672959999998 FORMAT "%19.14" EXTENDED_LIMITS 0.000002000000001 4294.9672959999998 /end CHARACTERISTIC
/begin CHARACTERISTIC ACComp_tiTrqOffsRmpUpone_C "accomp_time trouqe offs ramp up one" VALUE 0x804FAEC0 RB_Val_Ws32 4294.9672940000000 TimeDelay_s 0.0000020000000 4294.9672959999998 FORMAT "%19.14" EXTENDED_LIMITS 0.000002000000001 4294.9672959999998 /end CHARACTERISTIC
/begin CHARACTERISTIC ACComp_tiTrqOffsRmpUp_C "filter time constant for UPward ramping" VALUE 0x804FAEC4 RB_Val_Ws32 4294.9672940000000 TimeDelay_s 0.0000020000000 4294.9672959999998 FORMAT "%19.14" EXTENDED_LIMITS 0.000002000000001 4294.9672959999998 /end CHARACTERISTIC
/begin CHARACTERISTIC ACComp_tiTrqResv_C "time for torque reserve active at soft AC load switch" VALUE 0x804FAEC8 RB_Val_Ws32 42949672.9500 Time_s -21474836.4800 21474836.4700 FORMAT "%13.4" /end CHARACTERISTIC
/begin CHARACTERISTIC ACComp_tOutAirLoThd_C "Low threshold for outside air temperature" VALUE 0x804FAECC RB_Val_Ws16 6553.500 Temp_Cels -3549.940 3003.560 FORMAT "%8.3" /end CHARACTERISTIC
/begin CHARACTERISTIC ACComp_tOutAirThres_C "Threshold Outside air temparature above which replacement value is used" VALUE 0x804FAECE RB_Val_Ws16 6553.500 Temp_Cels -3549.940 3003.560 FORMAT "%8.3" /end CHARACTERISTIC
/begin CHARACTERISTIC ACComp_tqACOffs1_M "accomp trouqe a coffs" MAP 0x804FAED0 RB_Map_S16S16_S16 6553.500 Trq -3276.800 3276.700 FORMAT "%8.3"
 /begin AXIS_DESCR STD_AXIS AirC_pClnt PresAC_hPa 7 -65536.00 65534.00 FORMAT "%8.2" DEPOSIT ABSOLUTE /end AXIS_DESCR
 /begin AXIS_DESCR STD_AXIS ACComp_tSeldTrqOffs Temp_Cels 7 -3549.940 3003.560 FORMAT "%8.3" DEPOSIT ABSOLUTE /end AXIS_DESCR
/end CHARACTERISTIC
/begin CHARACTERISTIC ACComp_tqACOffs_M "Map to determine offset torque" MAP 0x804FAF52 RB_Map_S16S16_S16 6553.500 Trq -3276.800 3276.700 FORMAT "%8.3"
 /begin AXIS_DESCR STD_AXIS AirC_pClnt PresAC_hPa 7 -65536.00 65534.00 FORMAT "%8.2" DEPOSIT ABSOLUTE /end AXIS_DESCR
 /begin AXIS_DESCR STD_AXIS ACComp_tSeldTrqOffs Temp_Cels 7 -3549.940 3003.560 FORMAT "%8.3" DEPOSIT ABSOLUTE /end AXIS_DESCR
/end CHARACTERISTIC
/begin CHARACTERISTIC ACComp_tqCorrnMax_C "Torque calculation correction term at Ps control valve (at MAX capacity)" VALUE 0x804FAFD4 RB_Val_Ws32 429496729.500 Trq -214748364.800 214748364.700 FORMAT "%13.3" /end CHARACTERISTIC
/begin CHARACTERISTIC ACComp_tqEstimd1TqStrt_T "AC variable capacity COMPR start time table" CURVE 0x804FAFD8 RB_Curve_S16_S16 6553.500 Trq -3276.800 3276.700 FORMAT "%8.3"
 /begin AXIS_DESCR STD_AXIS ACComp_tiCmprVolCtrlStrt Time_ms 5 -327680.0 327670.0 FORMAT "%8.1" DEPOSIT ABSOLUTE /end AXIS_DESCR
/end CHARACTERISTIC
/begin CHARACTERISTIC ACComp_tqEstimd2TqStrt_T "AC variable capacity COMPR torque estimated value table at startup" CURVE 0x804FAFEE RB_Curve_S16_S16 6553.500 Trq -3276.800 3276.700 FORMAT "%8.3"
 /begin AXIS_DESCR STD_AXIS ACComp_tiCmprStrtUp1 Time_ms 5 -327680.0 327670.0 FORMAT "%8.1" DEPOSIT ABSOLUTE /end AXIS_DESCR
/end CHARACTERISTIC
/begin CHARACTERISTIC ACComp_tqEvaprTCorrnTq_C "EVA temperature torque calculation correction term in Ps control valve" VALUE 0x804FB004 RB_Val_Ws32 429496729.500 Trq -214748364.800 214748364.700 FORMAT "%13.3" /end CHARACTERISTIC
/begin CHARACTERISTIC ACComp_tqHardDwnStep_C "AC off hard torque reserve reduce" VALUE 0x804FB008 RB_Val_Ws16 6553.500 Trq -3276.800 3276.700 FORMAT "%8.3" /end CHARACTERISTIC
/begin CHARACTERISTIC ACComp_tqHwGearOffResv_M "AC HW off torque reserve Map in driving state" MAP 0x804FB00A RB_Map_S16S16_S16 6553.500 Trq -3276.800 3276.700 FORMAT "%8.3"
 /begin AXIS_DESCR STD_AXIS Epm_nEng EngN 6 -16384.00 16383.50 FORMAT "%8.2" DEPOSIT ABSOLUTE /end AXIS_DESCR
 /begin AXIS_DESCR STD_AXIS NO_INPUT_QUANTITY rel_uw_b200 4 0.00 99.99695 FORMAT "%8.5" EXTENDED_LIMITS -100.0000 99.99695 DEPOSIT ABSOLUTE /end AXIS_DESCR
/end CHARACTERISTIC
/begin CHARACTERISTIC ACComp_tqHwOffResv_M "AC HW off torque reserve Map" MAP 0x804FB052 RB_Map_S16S16_S16 6553.500 Trq -3276.800 3276.700 FORMAT "%8.3"
 /begin AXIS_DESCR STD_AXIS Epm_nEng EngN 6 -16384.00 16383.50 FORMAT "%8.2" DEPOSIT ABSOLUTE /end AXIS_DESCR
 /begin AXIS_DESCR STD_AXIS NO_INPUT_QUANTITY rel_uw_b200 4 0.00 99.99695 FORMAT "%8.5" EXTENDED_LIMITS -100.0000 99.99695 DEPOSIT ABSOLUTE /end AXIS_DESCR
/end CHARACTERISTIC
/begin CHARACTERISTIC ACComp_tqPSnsrCorrnTq_C "Correstion term for calculating torque estimated by Ps control value" VALUE 0x804FB09C RB_Val_Ws32 429496.729500 RBPtCel_tq_0p0001_1 -214748.364800 214748.364700 FORMAT "%13.6" /end CHARACTERISTIC
/begin CHARACTERISTIC ACComp_tqSwOffResv_M "AC Off torque reserve map" MAP 0x804FB0A0 RB_Map_S16S16_S16 6553.500 Trq -3276.800 3276.700 FORMAT "%8.3"
 /begin AXIS_DESCR STD_AXIS Epm_nEng EngN 6 -16384.00 16383.50 FORMAT "%8.2" DEPOSIT ABSOLUTE /end AXIS_DESCR
 /begin AXIS_DESCR STD_AXIS AirC_pClnt PresAC_hPa 4 -65536.00 65534.00 FORMAT "%8.2" DEPOSIT ABSOLUTE /end AXIS_DESCR
/end CHARACTERISTIC
/begin CHARACTERISTIC ACComp_trqDyn_MAP "dynamic torque" MAP 0x804FB0E8 RB_Map_S16S16_S16 6553.500 Trq -3276.800 3276.700 FORMAT "%8.3"
 /begin AXIS_DESCR STD_AXIS Epm_nEng EngN 4 -16384.00 16383.50 FORMAT "%8.2" DEPOSIT ABSOLUTE /end AXIS_DESCR
 /begin AXIS_DESCR STD_AXIS AirC_pClnt PresAC_hPa 4 -65536.00 65534.00 FORMAT "%8.2" DEPOSIT ABSOLUTE /end AXIS_DESCR
/end CHARACTERISTIC
/begin CHARACTERISTIC ACComp_trqLimMax_MAP "Limit maximum AC torque value" MAP 0x804FB11C RB_Map_S16S16_S16 6553.500 Trq -3276.800 3276.700 FORMAT "%8.3"
 /begin AXIS_DESCR STD_AXIS Epm_nEng EngN 4 -16384.00 16383.50 FORMAT "%8.2" DEPOSIT ABSOLUTE /end AXIS_DESCR
 /begin AXIS_DESCR STD_AXIS AirC_pClnt PresAC_hPa 4 -65536.00 65534.00 FORMAT "%8.2" DEPOSIT ABSOLUTE /end AXIS_DESCR
/end CHARACTERISTIC
/begin CHARACTERISTIC ACComp_trqOffsFlt_C "offset for start value for filter" VALUE 0x804FB150 RB_Val_Ws16 6553.500 Trq -3276.800 3276.700 FORMAT "%8.3" /end CHARACTERISTIC
/begin CHARACTERISTIC ACComp_trqStat_MAP "static torque" MAP 0x804FB152 RB_Map_S16S16_S16 6553.500 Trq -3276.800 3276.700 FORMAT "%8.3"
 /begin AXIS_DESCR STD_AXIS Epm_nEng EngN 4 -16384.00 16383.50 FORMAT "%8.2" DEPOSIT ABSOLUTE /end AXIS_DESCR
 /begin AXIS_DESCR STD_AXIS AirC_pClnt PresAC_hPa 4 -65536.00 65534.00 FORMAT "%8.2" DEPOSIT ABSOLUTE /end AXIS_DESCR
/end CHARACTERISTIC
/begin CHARACTERISTIC ACComp_tTCalcnRednVal_C "Outside temperature calculation reduction value" VALUE 0x804FB186 RB_Val_Ws16 6553.500 Temp_Cels -3549.940 3003.560 FORMAT "%8.3" /end CHARACTERISTIC
/begin CHARACTERISTIC ACComp_tTCalcnRiseVal_C "Outside temperature calculation raise value" VALUE 0x804FB188 RB_Val_Ws16 6553.500 Temp_Cels -3549.940 3003.560 FORMAT "%8.3" /end CHARACTERISTIC
/begin CHARACTERISTIC ACComp_tValDurgSnsrFailr_C "Alternative value at the time of outside temperature sensor failure." VALUE 0x804FB18A RB_Val_Ws16 6553.500 Temp_Cels -3549.940 3003.560 FORMAT "%8.3" /end CHARACTERISTIC
/begin CHARACTERISTIC ACComp_tWtrTOutdTSnsr_C "Water temperature for outside temperature sensor judgment at the time of IGON." VALUE 0x804FB18C RB_Val_Ws16 6553.500 Temp_Cels -3549.940 3003.560 FORMAT "%8.3" /end CHARACTERISTIC
/begin CHARACTERISTIC ACComp_vOutdTCtrlStrtPrms_C "Vehicle speed for ECONTAM control start permission" VALUE 0x804FB18E RB_Val_Ws16 655.3500 Vel -327.6800 327.6700 FORMAT "%8.4" /end CHARACTERISTIC
/begin CHARACTERISTIC ACComp_vTqOffsRmpDelta_C "calibrateable delta for vehicle speed hysteresis" VALUE 0x804FB190 RB_Val_Ws16 655.3500 Vel -327.6800 327.6700 FORMAT "%8.4" /end CHARACTERISTIC
/begin CHARACTERISTIC ACComp_vTqOffsRmp_C "calibrateable median for vehicle speed hysteresis" VALUE 0x804FB192 RB_Val_Ws16 655.3500 Vel -327.6800 327.6700 FORMAT "%8.4" /end CHARACTERISTIC
/begin CHARACTERISTIC ACComp_vVehSpdChgOutdT_C "Vehicle speed for change outside temperature" VALUE 0x804FB194 RB_Val_Ws16 655.3500 Vel -327.6800 327.6700 FORMAT "%8.4" /end CHARACTERISTIC
/begin CHARACTERISTIC AccPed_flgNotSwilLossCmp_C "Activate the compensation of non switchable losses" VALUE 0x804FF568 RB_Val_Wboolean 1.00000000000 B_TRUE 0.00 1.00000000000 FORMAT "%13.11" /end CHARACTERISTIC
/begin CHARACTERISTIC AccPed_flgSelFacCmpAcs_C "Flag used to consider compensation from speed governor also for non-switchable losses." VALUE 0x804FF569 RB_Val_Wboolean 1.00000000000 B_TRUE 0.00 1.00000000000 FORMAT "%13.11" /end CHARACTERISTIC
/begin CHARACTERISTIC AccPed_nMax_C "Maximum engine speed in case of accelerator pedal error" VALUE 0x804FF55C RB_Val_Ws16 32767.50 EngN -16384.00 16383.50 FORMAT "%8.2" /end CHARACTERISTIC
/begin CHARACTERISTIC AccPed_nMinBrkApp_C "Minimum engine speed in case of accelerator pedal brake implausibility" VALUE 0x804FF55E RB_Val_Ws16 32767.50 EngN -16384.00 16383.50 FORMAT "%8.2" /end CHARACTERISTIC
/begin CHARACTERISTIC AccPed_nMinBrk_C "Minimum engine speed in case of accelerator pedal error and trodden brake" VALUE 0x804FF560 RB_Val_Ws16 32767.50 EngN -16384.00 16383.50 FORMAT "%8.2" /end CHARACTERISTIC
/begin CHARACTERISTIC AccPed_nMinNoBrk_C "Minimum engine speed in case of accelerator pedal error and brake not applied" VALUE 0x804FF562 RB_Val_Ws16 32767.50 EngN -16384.00 16383.50 FORMAT "%8.2" /end CHARACTERISTIC
/begin CHARACTERISTIC AccPed_rAPPHysHi_C "upper hysteresis threshold for accelerator pedal debouncing" VALUE 0x804FF56A RB_Val_Ws16 399.9756 Prc 0.0122 399.9878 FORMAT "%8.4" EXTENDED_LIMITS -400.0000 399.9878 /end CHARACTERISTIC
/begin CHARACTERISTIC AccPed_rAPPHysLo_C "lower hysteresis threshold for accelerator pedal debouncing" VALUE 0x804FF56C RB_Val_Ws16 399.9756 Prc 0.0122 399.9878 FORMAT "%8.4" EXTENDED_LIMITS -400.0000 399.9878 /end CHARACTERISTIC
/begin CHARACTERISTIC AccPed_rThdMaxCmp_C "used for calculating the overrun transition factor." VALUE 0x804FF56E RB_Val_Ws16 799.9878 Prc -400.0000 399.9878 FORMAT "%8.4" /end CHARACTERISTIC
/begin CHARACTERISTIC AccPed_rThdNoCmp_C "With this calibration lable it is possible to set the minimum threshold value for compenstion" VALUE 0x804FF570 RB_Val_Ws16 799.9878 Prc -400.0000 399.9878 FORMAT "%8.4" /end CHARACTERISTIC
/begin CHARACTERISTIC AccPed_swtFilActvn_C "Switch to active PT1 filter" VALUE 0x804FF57C RB_Val_Wboolean 1.00000000000 B_TRUE 0.00 1.00000000000 FORMAT "%13.11" /end CHARACTERISTIC
/begin CHARACTERISTIC AccPed_tiGearFildFil_CA "Filter time constant, gear depending" VAL_BLK 0x804FF580 RB_ValA_Ws32 4294.9672940000000 TimeDelay_s 0.0000020000000 4294.9672959999998 FORMAT "%19.14" EXTENDED_LIMITS 0.000002000000001 4294.9672959999998 NUMBER 11 /end CHARACTERISTIC
/begin CHARACTERISTIC AccPed_tiGearFildRmp_CA "Time in which the ramping between the drive modes shall happen, gear depending" VAL_BLK 0x804FF5AC RB_ValA_Ws16 655.3500 Time_s -327.6800 327.6700 FORMAT "%8.4" NUMBER 11 /end CHARACTERISTIC
/begin CHARACTERISTIC AccPed_tiIDSDrvModTmpInhb_C "Threshold time to detect IDS temporary inhibit" VALUE 0x804FF578 RB_Val_Wu16 655350.0 Time_ms 0.00 655350.0 FORMAT "%8.1" /end CHARACTERISTIC
/begin CHARACTERISTIC AccPed_tqCvtEcoEng0_M "Driver demanded torque map for drive off torque for Eco mode of CVT transmission" MAP 0x804FF5C2 RB_Map_S16S16_S16 6553.500 Trq -3276.800 3276.700 FORMAT "%8.3"
 /begin AXIS_DESCR STD_AXIS PT_nClth EngN 16 -16384.00 16383.50 FORMAT "%8.2" DEPOSIT ABSOLUTE /end AXIS_DESCR
 /begin AXIS_DESCR STD_AXIS APP_r Prc 16 -400.0000 399.9878 FORMAT "%8.4" DEPOSIT ABSOLUTE /end AXIS_DESCR
/end CHARACTERISTIC
/begin CHARACTERISTIC AccPed_tqCvtEcoEng1_M "Driver demanded torque map for gear1 for Eco mode of CVT transmission" MAP 0x804FF806 RB_Map_S16S16_S16 6553.500 Trq -3276.800 3276.700 FORMAT "%8.3"
 /begin AXIS_DESCR STD_AXIS PT_nClth EngN 16 -16384.00 16383.50 FORMAT "%8.2" DEPOSIT ABSOLUTE /end AXIS_DESCR
 /begin AXIS_DESCR STD_AXIS APP_r Prc 16 -400.0000 399.9878 FORMAT "%8.4" DEPOSIT ABSOLUTE /end AXIS_DESCR
/end CHARACTERISTIC
/begin CHARACTERISTIC AccPed_tqCvtEcoEng2_M "Driver demanded torque map for gear2 for Eco mode of CVT transmission" MAP 0x804FFA4A RB_Map_S16S16_S16 6553.500 Trq -3276.800 3276.700 FORMAT "%8.3"
 /begin AXIS_DESCR STD_AXIS PT_nClth EngN 16 -16384.00 16383.50 FORMAT "%8.2" DEPOSIT ABSOLUTE /end AXIS_DESCR
 /begin AXIS_DESCR STD_AXIS APP_r Prc 16 -400.0000 399.9878 FORMAT "%8.4" DEPOSIT ABSOLUTE /end AXIS_DESCR
/end CHARACTERISTIC
/begin CHARACTERISTIC AccPed_tqCvtEcoEng3_M "Driver demanded torque map for gear3 for Eco mode of CVT transmission" MAP 0x804FFC8E RB_Map_S16S16_S16 6553.500 Trq -3276.800 3276.700 FORMAT "%8.3"
 /begin AXIS_DESCR STD_AXIS PT_nClth EngN 16 -16384.00 16383.50 FORMAT "%8.2" DEPOSIT ABSOLUTE /end AXIS_DESCR
 /begin AXIS_DESCR STD_AXIS APP_r Prc 16 -400.0000 399.9878 FORMAT "%8.4" DEPOSIT ABSOLUTE /end AXIS_DESCR
/end CHARACTERISTIC
/begin CHARACTERISTIC AccPed_tqCvtEcoEng4_M "Driver demanded torque map for gear4 for Eco mode of CVT transmission" MAP 0x804FFED2 RB_Map_S16S16_S16 6553.500 Trq -3276.800 3276.700 FORMAT "%8.3"
 /begin AXIS_DESCR STD_AXIS PT_nClth EngN 16 -16384.00 16383.50 FORMAT "%8.2" DEPOSIT ABSOLUTE /end AXIS_DESCR
 /begin AXIS_DESCR STD_AXIS APP_r Prc 16 -400.0000 399.9878 FORMAT "%8.4" DEPOSIT ABSOLUTE /end AXIS_DESCR
/end CHARACTERISTIC
/begin CHARACTERISTIC AccPed_tqCvtEcoEng5_M "Driver demanded torque map for gear5 for Eco mode of CVT transmission" MAP 0x80500116 RB_Map_S16S16_S16 6553.500 Trq -3276.800 3276.700 FORMAT "%8.3"
 /begin AXIS_DESCR STD_AXIS PT_nClth EngN 16 -16384.00 16383.50 FORMAT "%8.2" DEPOSIT ABSOLUTE /end AXIS_DESCR
 /begin AXIS_DESCR STD_AXIS APP_r Prc 16 -400.0000 399.9878 FORMAT "%8.4" DEPOSIT ABSOLUTE /end AXIS_DESCR
/end CHARACTERISTIC
/begin CHARACTERISTIC AccPed_tqCvtEcoEng6_M "Driver demanded torque map for gear6 for Eco mode of CVT transmission" MAP 0x8050035A RB_Map_S16S16_S16 6553.500 Trq -3276.800 3276.700 FORMAT "%8.3"
 /begin AXIS_DESCR STD_AXIS PT_nClth EngN 16 -16384.00 16383.50 FORMAT "%8.2" DEPOSIT ABSOLUTE /end AXIS_DESCR
 /begin AXIS_DESCR STD_AXIS APP_r Prc 16 -400.0000 399.9878 FORMAT "%8.4" DEPOSIT ABSOLUTE /end AXIS_DESCR
/end CHARACTERISTIC
/begin CHARACTERISTIC AccPed_tqCvtEcoEng7_M "Driver demanded torque map for gear7 for Eco mode of CVT transmission" MAP 0x8050059E RB_Map_S16S16_S16 6553.500 Trq -3276.800 3276.700 FORMAT "%8.3"
 /begin AXIS_DESCR STD_AXIS PT_nClth EngN 16 -16384.00 16383.50 FORMAT "%8.2" DEPOSIT ABSOLUTE /end AXIS_DESCR
 /begin AXIS_DESCR STD_AXIS APP_r Prc 16 -400.0000 399.9878 FORMAT "%8.4" DEPOSIT ABSOLUTE /end AXIS_DESCR
/end CHARACTERISTIC
/begin CHARACTERISTIC AccPed_tqCvtEcoEng8_M "Driver demanded torque map for gear8 for Eco mode of CVT transmission" MAP 0x805007E2 RB_Map_S16S16_S16 6553.500 Trq -3276.800 3276.700 FORMAT "%8.3"
 /begin AXIS_DESCR STD_AXIS PT_nClth EngN 16 -16384.00 16383.50 FORMAT "%8.2" DEPOSIT ABSOLUTE /end AXIS_DESCR
 /begin AXIS_DESCR STD_AXIS APP_r Prc 16 -400.0000 399.9878 FORMAT "%8.4" DEPOSIT ABSOLUTE /end AXIS_DESCR
/end CHARACTERISTIC
/begin CHARACTERISTIC AccPed_tqCvtEng0_M "Driver demanded torque map for gear0 for CVT transmission" MAP 0x80500A26 RB_Map_S16S16_S16 6553.500 Trq -3276.800 3276.700 FORMAT "%8.3"
 /begin AXIS_DESCR STD_AXIS PT_nClth EngN 16 -16384.00 16383.50 FORMAT "%8.2" DEPOSIT ABSOLUTE /end AXIS_DESCR
 /begin AXIS_DESCR STD_AXIS APP_r Prc 16 -400.0000 399.9878 FORMAT "%8.4" DEPOSIT ABSOLUTE /end AXIS_DESCR
/end CHARACTERISTIC
/begin CHARACTERISTIC AccPed_tqCvtEng1_M "Driver demanded torque map for gear1 for CVT transmission" MAP 0x80500C6A RB_Map_S16S16_S16 6553.500 Trq -3276.800 3276.700 FORMAT "%8.3"
 /begin AXIS_DESCR STD_AXIS PT_nClth EngN 16 -16384.00 16383.50 FORMAT "%8.2" DEPOSIT ABSOLUTE /end AXIS_DESCR
 /begin AXIS_DESCR STD_AXIS APP_r Prc 16 -400.0000 399.9878 FORMAT "%8.4" DEPOSIT ABSOLUTE /end AXIS_DESCR
/end CHARACTERISTIC
/begin CHARACTERISTIC AccPed_tqCvtEng2_M "Driver demanded torque map for gear2 for CVT transmission" MAP 0x80500EAE RB_Map_S16S16_S16 6553.500 Trq -3276.800 3276.700 FORMAT "%8.3"
 /begin AXIS_DESCR STD_AXIS PT_nClth EngN 16 -16384.00 16383.50 FORMAT "%8.2" DEPOSIT ABSOLUTE /end AXIS_DESCR
 /begin AXIS_DESCR STD_AXIS APP_r Prc 16 -400.0000 399.9878 FORMAT "%8.4" DEPOSIT ABSOLUTE /end AXIS_DESCR
/end CHARACTERISTIC
/begin CHARACTERISTIC AccPed_tqCvtEng3_M "Driver demanded torque map for gear3 for CVT transmission" MAP 0x805010F2 RB_Map_S16S16_S16 6553.500 Trq -3276.800 3276.700 FORMAT "%8.3"
 /begin AXIS_DESCR STD_AXIS PT_nClth EngN 16 -16384.00 16383.50 FORMAT "%8.2" DEPOSIT ABSOLUTE /end AXIS_DESCR
 /begin AXIS_DESCR STD_AXIS APP_r Prc 16 -400.0000 399.9878 FORMAT "%8.4" DEPOSIT ABSOLUTE /end AXIS_DESCR
/end CHARACTERISTIC
/begin CHARACTERISTIC AccPed_tqCvtEng4_M "Driver demanded torque map for gear4 for CVT transmission" MAP 0x80501336 RB_Map_S16S16_S16 6553.500 Trq -3276.800 3276.700 FORMAT "%8.3"
 /begin AXIS_DESCR STD_AXIS PT_nClth EngN 16 -16384.00 16383.50 FORMAT "%8.2" DEPOSIT ABSOLUTE /end AXIS_DESCR
 /begin AXIS_DESCR STD_AXIS APP_r Prc 16 -400.0000 399.9878 FORMAT "%8.4" DEPOSIT ABSOLUTE /end AXIS_DESCR
/end CHARACTERISTIC
/begin CHARACTERISTIC AccPed_tqCvtEng5_M "Driver demanded torque map for gear5 for CVT transmission" MAP 0x8050157A RB_Map_S16S16_S16 6553.500 Trq -3276.800 3276.700 FORMAT "%8.3"
 /begin AXIS_DESCR STD_AXIS PT_nClth EngN 16 -16384.00 16383.50 FORMAT "%8.2" DEPOSIT ABSOLUTE /end AXIS_DESCR
 /begin AXIS_DESCR STD_AXIS APP_r Prc 16 -400.0000 399.9878 FORMAT "%8.4" DEPOSIT ABSOLUTE /end AXIS_DESCR
/end CHARACTERISTIC
/begin CHARACTERISTIC AccPed_tqCvtEng6_M "Driver demanded torque map for gear6 for CVT transmission" MAP 0x805017BE RB_Map_S16S16_S16 6553.500 Trq -3276.800 3276.700 FORMAT "%8.3"
 /begin AXIS_DESCR STD_AXIS PT_nClth EngN 16 -16384.00 16383.50 FORMAT "%8.2" DEPOSIT ABSOLUTE /end AXIS_DESCR
 /begin AXIS_DESCR STD_AXIS APP_r Prc 16 -400.0000 399.9878 FORMAT "%8.4" DEPOSIT ABSOLUTE /end AXIS_DESCR
/end CHARACTERISTIC
/begin CHARACTERISTIC AccPed_tqCvtEng7_M "Driver demanded torque map for gear7 for CVT transmission" MAP 0x80501A02 RB_Map_S16S16_S16 6553.500 Trq -3276.800 3276.700 FORMAT "%8.3"
 /begin AXIS_DESCR STD_AXIS PT_nClth EngN 16 -16384.00 16383.50 FORMAT "%8.2" DEPOSIT ABSOLUTE /end AXIS_DESCR
 /begin AXIS_DESCR STD_AXIS APP_r Prc 16 -400.0000 399.9878 FORMAT "%8.4" DEPOSIT ABSOLUTE /end AXIS_DESCR
/end CHARACTERISTIC
/begin CHARACTERISTIC AccPed_tqCvtEng8_M "Driver demanded torque map for gear8 for CVT transmission" MAP 0x80501C46 RB_Map_S16S16_S16 6553.500 Trq -3276.800 3276.700 FORMAT "%8.3"
 /begin AXIS_DESCR STD_AXIS PT_nClth EngN 16 -16384.00 16383.50 FORMAT "%8.2" DEPOSIT ABSOLUTE /end AXIS_DESCR
 /begin AXIS_DESCR STD_AXIS APP_r Prc 16 -400.0000 399.9878 FORMAT "%8.4" DEPOSIT ABSOLUTE /end AXIS_DESCR
/end CHARACTERISTIC
/begin CHARACTERISTIC AccPed_tqFilSwtOffLim_C "Threshold for detect the output reaches the input of the PT1 filter" VALUE 0x80501E8A RB_Val_Ws16 6553.500 Trq -3276.800 3276.700 FORMAT "%8.3" /end CHARACTERISTIC
/begin CHARACTERISTIC AccPed_tqHiIdleCVT_T "High Idle for Continuously Variable Transmission." CURVE 0x80501E8C RB_Curve_S16_S16 6553.500 Trq -3276.800 3276.700 FORMAT "%8.3"
 /begin AXIS_DESCR STD_AXIS APP_r Prc 16 -400.0000 399.9878 FORMAT "%8.4" DEPOSIT ABSOLUTE /end AXIS_DESCR
/end CHARACTERISTIC
/begin CHARACTERISTIC AccPed_tqHiIdleMT_T "High Idle for Manual Transmission." CURVE 0x80501ECE RB_Curve_S16_S16 6553.500 Trq -3276.800 3276.700 FORMAT "%8.3"
 /begin AXIS_DESCR STD_AXIS APP_r Prc 16 -400.0000 399.9878 FORMAT "%8.4" DEPOSIT ABSOLUTE /end AXIS_DESCR
/end CHARACTERISTIC
/begin CHARACTERISTIC AccPed_tqMinWoRamp_C "Minimum torque difference for ramping of torque during drive mode change to be activated" VALUE 0x80501F10 RB_Val_Ws16 6553.500 Trq -3276.800 3276.700 FORMAT "%8.3" /end CHARACTERISTIC
/begin CHARACTERISTIC AccPed_tqMTGear1_M "Driver demanded torque map for gear1 for MT transmission" MAP 0x80501F12 RB_Map_S16S16_S16 6553.500 Trq -3276.800 3276.700 FORMAT "%8.3"
 /begin AXIS_DESCR STD_AXIS PT_nClth EngN 16 -16384.00 16383.50 FORMAT "%8.2" DEPOSIT ABSOLUTE /end AXIS_DESCR
 /begin AXIS_DESCR STD_AXIS APP_r Prc 16 -400.0000 399.9878 FORMAT "%8.4" DEPOSIT ABSOLUTE /end AXIS_DESCR
/end CHARACTERISTIC
/begin CHARACTERISTIC AccPed_tqMTGear2_M "Driver demanded torque map for gear2 for MT transmission" MAP 0x80502156 RB_Map_S16S16_S16 6553.500 Trq -3276.800 3276.700 FORMAT "%8.3"
 /begin AXIS_DESCR STD_AXIS PT_nClth EngN 16 -16384.00 16383.50 FORMAT "%8.2" DEPOSIT ABSOLUTE /end AXIS_DESCR
 /begin AXIS_DESCR STD_AXIS APP_r Prc 16 -400.0000 399.9878 FORMAT "%8.4" DEPOSIT ABSOLUTE /end AXIS_DESCR
/end CHARACTERISTIC
/begin CHARACTERISTIC AccPed_tqMTGear3_M "Driver demanded torque map for gear3 for MT transmission" MAP 0x8050239A RB_Map_S16S16_S16 6553.500 Trq -3276.800 3276.700 FORMAT "%8.3"
 /begin AXIS_DESCR STD_AXIS PT_nClth EngN 16 -16384.00 16383.50 FORMAT "%8.2" DEPOSIT ABSOLUTE /end AXIS_DESCR
 /begin AXIS_DESCR STD_AXIS APP_r Prc 16 -400.0000 399.9878 FORMAT "%8.4" DEPOSIT ABSOLUTE /end AXIS_DESCR
/end CHARACTERISTIC
/begin CHARACTERISTIC AccPed_tqMTGear4_M "Driver demanded torque map for gear4 for MT transmission" MAP 0x805025DE RB_Map_S16S16_S16 6553.500 Trq -3276.800 3276.700 FORMAT "%8.3"
 /begin AXIS_DESCR STD_AXIS PT_nClth EngN 16 -16384.00 16383.50 FORMAT "%8.2" DEPOSIT ABSOLUTE /end AXIS_DESCR
 /begin AXIS_DESCR STD_AXIS APP_r Prc 16 -400.0000 399.9878 FORMAT "%8.4" DEPOSIT ABSOLUTE /end AXIS_DESCR
/end CHARACTERISTIC
/begin CHARACTERISTIC AccPed_tqMTGear5_M "Driver demanded torque map for gear5 for MT transmission" MAP 0x80502822 RB_Map_S16S16_S16 6553.500 Trq -3276.800 3276.700 FORMAT "%8.3"
 /begin AXIS_DESCR STD_AXIS PT_nClth EngN 16 -16384.00 16383.50 FORMAT "%8.2" DEPOSIT ABSOLUTE /end AXIS_DESCR
 /begin AXIS_DESCR STD_AXIS APP_r Prc 16 -400.0000 399.9878 FORMAT "%8.4" DEPOSIT ABSOLUTE /end AXIS_DESCR
/end CHARACTERISTIC
/begin CHARACTERISTIC AccPed_tqMTGear6_M "Driver demanded torque map for gear6 for MT transmission" MAP 0x80502A66 RB_Map_S16S16_S16 6553.500 Trq -3276.800 3276.700 FORMAT "%8.3"
 /begin AXIS_DESCR STD_AXIS PT_nClth EngN 16 -16384.00 16383.50 FORMAT "%8.2" DEPOSIT ABSOLUTE /end AXIS_DESCR
 /begin AXIS_DESCR STD_AXIS APP_r Prc 16 -400.0000 399.9878 FORMAT "%8.4" DEPOSIT ABSOLUTE /end AXIS_DESCR
/end CHARACTERISTIC
/begin CHARACTERISTIC AccPed_tqPullThd_C "Threshold for the propulsion state detection" VALUE 0x804FF574 RB_Val_Ws32 429496729.500 TrqPrpHigh -214748364.800 214748364.700 FORMAT "%13.3" /end CHARACTERISTIC
/begin CHARACTERISTIC AccPed_trqLimMax_C "Maximum wheel torque in case of accelerator pedal error" VALUE 0x804FF564 RB_Val_Ws32 429496729.500 TrqPrpHigh -214748364.800 214748364.700 FORMAT "%13.3" /end CHARACTERISTIC
/begin CHARACTERISTIC AccPed_trqMod1Gear1_M "Mode 1 gear1 engine demand map" MAP 0x80502CAA RB_Map_S16S16_S16 6553.500 Trq -3276.800 3276.700 FORMAT "%8.3"
 /begin AXIS_DESCR STD_AXIS PT_nClth EngN 16 -16384.00 16383.50 FORMAT "%8.2" DEPOSIT ABSOLUTE /end AXIS_DESCR
 /begin AXIS_DESCR STD_AXIS APP_r Prc 16 -400.0000 399.9878 FORMAT "%8.4" DEPOSIT ABSOLUTE /end AXIS_DESCR
/end CHARACTERISTIC
/begin CHARACTERISTIC AccPed_trqMod1Gear2_M "Mode 1 gear2 engine demand map" MAP 0x80502EEE RB_Map_S16S16_S16 6553.500 Trq -3276.800 3276.700 FORMAT "%8.3"
 /begin AXIS_DESCR STD_AXIS PT_nClth EngN 16 -16384.00 16383.50 FORMAT "%8.2" DEPOSIT ABSOLUTE /end AXIS_DESCR
 /begin AXIS_DESCR STD_AXIS APP_r Prc 16 -400.0000 399.9878 FORMAT "%8.4" DEPOSIT ABSOLUTE /end AXIS_DESCR
/end CHARACTERISTIC
/begin CHARACTERISTIC AccPed_trqMod1Gear3_M "Mode 1 gear3 engine demand map" MAP 0x80503132 RB_Map_S16S16_S16 6553.500 Trq -3276.800 3276.700 FORMAT "%8.3"
 /begin AXIS_DESCR STD_AXIS PT_nClth EngN 16 -16384.00 16383.50 FORMAT "%8.2" DEPOSIT ABSOLUTE /end AXIS_DESCR
 /begin AXIS_DESCR STD_AXIS APP_r Prc 16 -400.0000 399.9878 FORMAT "%8.4" DEPOSIT ABSOLUTE /end AXIS_DESCR
/end CHARACTERISTIC
/begin CHARACTERISTIC AccPed_trqMod1Gear4_M "Mode 1 gear4 engine demand map" MAP 0x80503376 RB_Map_S16S16_S16 6553.500 Trq -3276.800 3276.700 FORMAT "%8.3"
 /begin AXIS_DESCR STD_AXIS PT_nClth EngN 16 -16384.00 16383.50 FORMAT "%8.2" DEPOSIT ABSOLUTE /end AXIS_DESCR
 /begin AXIS_DESCR STD_AXIS APP_r Prc 16 -400.0000 399.9878 FORMAT "%8.4" DEPOSIT ABSOLUTE /end AXIS_DESCR
/end CHARACTERISTIC
/begin CHARACTERISTIC AccPed_trqMod1Gear5_M "Mode 1 gear5 engine demand map" MAP 0x805035BA RB_Map_S16S16_S16 6553.500 Trq -3276.800 3276.700 FORMAT "%8.3"
 /begin AXIS_DESCR STD_AXIS PT_nClth EngN 16 -16384.00 16383.50 FORMAT "%8.2" DEPOSIT ABSOLUTE /end AXIS_DESCR
 /begin AXIS_DESCR STD_AXIS APP_r Prc 16 -400.0000 399.9878 FORMAT "%8.4" DEPOSIT ABSOLUTE /end AXIS_DESCR
/end CHARACTERISTIC
/begin CHARACTERISTIC AccPed_trqMod1Gear6_M "Mode 1 gear6 engine demand map" MAP 0x805037FE RB_Map_S16S16_S16 6553.500 Trq -3276.800 3276.700 FORMAT "%8.3"
 /begin AXIS_DESCR STD_AXIS PT_nClth EngN 16 -16384.00 16383.50 FORMAT "%8.2" DEPOSIT ABSOLUTE /end AXIS_DESCR
 /begin AXIS_DESCR STD_AXIS APP_r Prc 16 -400.0000 399.9878 FORMAT "%8.4" DEPOSIT ABSOLUTE /end AXIS_DESCR
/end CHARACTERISTIC
/begin CHARACTERISTIC ACCtl_facACCtrlCurrCorrVal_C "AC compressor control current correction value" VALUE 0x804FB198 RB_Val_Ws32 429496.729500 Fact_10000 -214748.364800 214748.364700 FORMAT "%13.6" /end CHARACTERISTIC
/begin CHARACTERISTIC ACCtl_facACtrDwnCtrlVal_C "AC torque down control value correction factor" VALUE 0x804FB19C RB_Val_Ws32 4294967.29500 Fact1000 -2147483.64800 2147483.64700 FORMAT "%13.5" /end CHARACTERISTIC
/begin CHARACTERISTIC ACCtl_flgACTqDwnReqDisad_C "AC Torque down request logic disable" VALUE 0x804FB1A0 RB_Val_Wboolean 1.00000000000 B_TRUE 0.00 1.00000000000 FORMAT "%13.11" /end CHARACTERISTIC
/begin CHARACTERISTIC ACCtl_flgEngSpdCdnSel_C "Enabling engine speed condition for AC cut condition" VALUE 0x804FB1A1 RB_Val_Wboolean 1.00000000000 B_TRUE 0.00 1.00000000000 FORMAT "%13.11" /end CHARACTERISTIC
/begin CHARACTERISTIC ACCtl_flgSwtAcAndCutCdn_C "AC switch status and AC shut off condition for AC control mask" VALUE 0x804FB1A2 RB_Val_Wu16 65535.00 OneToOne 0.00 65535.00 FORMAT "%8.2" /end CHARACTERISTIC
/begin CHARACTERISTIC ACCtl_flgSwtAcTq_C "Calibration for switch AC torque" VALUE 0x804FB1A4 RB_Val_Wboolean 1.00000000000 B_TRUE 0.00 1.00000000000 FORMAT "%13.11" /end CHARACTERISTIC
/begin CHARACTERISTIC ACCtl_iACCtrlCurrUpprVal_C "AC Compressor control current upper value" VALUE 0x804FB1A6 RB_Val_Ws16 6553.500 RBPtCel_Curr_mA_q0p01 -3276.800 3276.700 FORMAT "%8.3" /end CHARACTERISTIC
/begin CHARACTERISTIC ACCtl_nCmprMax_C "Max speed of AC compressor" VALUE 0x804FB1A8 RB_Val_Ws16 32767.50 EngN -16384.00 16383.50 FORMAT "%8.2" /end CHARACTERISTIC
/begin CHARACTERISTIC ACCtl_nEngACCutThd_C "High Engine speed AC cut threshold" VALUE 0x804FB1AA RB_Val_Ws16 32767.50 EngN -16384.00 16383.50 FORMAT "%8.2" /end CHARACTERISTIC
/begin CHARACTERISTIC ACCtl_nEngHiCoolgPrf_C "Engine speed threshold high for high engine temperature AC shut off" VALUE 0x804FB1AC RB_Val_Ws16 32767.50 EngN -16384.00 16383.50 FORMAT "%8.2" /end CHARACTERISTIC
/begin CHARACTERISTIC ACCtl_nEngHiShtOff_T "Low engine speed AC shut off deactivation threshold" CURVE 0x804FB1AE RB_Curve_S16_S16 32767.50 EngN -16384.00 16383.50 FORMAT "%8.2"
 /begin AXIS_DESCR STD_AXIS HLSDem_nSetPLo nmot_sw_q0p5 5 -16384.00 16383.50 FORMAT "%8.2" DEPOSIT ABSOLUTE /end AXIS_DESCR
/end CHARACTERISTIC
/begin CHARACTERISTIC ACCtl_nEngHiTow_C "Engine speed threshold high for towing AC shut off" VALUE 0x804FB1C4 RB_Val_Ws16 32767.50 EngN -16384.00 16383.50 FORMAT "%8.2" /end CHARACTERISTIC
/begin CHARACTERISTIC ACCtl_nEngLoCoolgPrf_C "Engine speed threshold low for high engine temperature AC shut off" VALUE 0x804FB1C6 RB_Val_Ws16 32767.50 EngN -16384.00 16383.50 FORMAT "%8.2" /end CHARACTERISTIC
/begin CHARACTERISTIC ACCtl_nEngLoShtOff_T "Low engine speed AC shut off activation threshold" CURVE 0x804FB1C8 RB_Curve_S16_S16 32767.50 EngN -16384.00 16383.50 FORMAT "%8.2"
 /begin AXIS_DESCR STD_AXIS HLSDem_nSetPLo nmot_sw_q0p5 5 -16384.00 16383.50 FORMAT "%8.2" DEPOSIT ABSOLUTE /end AXIS_DESCR
/end CHARACTERISTIC
/begin CHARACTERISTIC ACCtl_nEngLoTow_C "Engine speed threshold low for towing AC shut off" VALUE 0x804FB1DE RB_Val_Ws16 32767.50 EngN -16384.00 16383.50 FORMAT "%8.2" /end CHARACTERISTIC
/begin CHARACTERISTIC ACCtl_nMin_C "Idle speed request" VALUE 0x804FB1E0 RB_Val_Ws16 32767.50 EngN -16384.00 16383.50 FORMAT "%8.2" /end CHARACTERISTIC
/begin CHARACTERISTIC ACCtl_nrACCutPrmsECONOff_T "Curve for converting the status of AC cut to AC cut permission count at the time of ECON OFF" CURVE 0x804FB1E2 RB_Curve_S16_S16 65535.00 OneToOne -32768.00 32767.00 FORMAT "%8.2"
 /begin AXIS_DESCR STD_AXIS ACCtl_stACCut OneToOne 9 -32768.00 32767.00 FORMAT "%8.2" DEPOSIT ABSOLUTE /end AXIS_DESCR
/end CHARACTERISTIC
/begin CHARACTERISTIC ACCtl_nrACCutPrmsECONOn_T "Curve for converting the status of AC cut to AC cut permission count at the time of ECON ON" CURVE 0x804FB208 RB_Curve_S16_S16 65535.00 OneToOne -32768.00 32767.00 FORMAT "%8.2"
 /begin AXIS_DESCR STD_AXIS ACCtl_stACCut OneToOne 9 -32768.00 32767.00 FORMAT "%8.2" DEPOSIT ABSOLUTE /end AXIS_DESCR
/end CHARACTERISTIC
/begin CHARACTERISTIC ACCtl_pACMaxHi_C "upper threshold for maximum AC coolant pressure to disengage immediately" VALUE 0x804FB22E RB_Val_Ws16 131070.0 PresAC_hPa -65536.00 65534.00 FORMAT "%8.2" /end CHARACTERISTIC
/begin CHARACTERISTIC ACCtl_pACMaxLo_C "lower threshold for maximum AC coolant pressure to disengage immediately" VALUE 0x804FB230 RB_Val_Ws16 131070.0 PresAC_hPa -65536.00 65534.00 FORMAT "%8.2" /end CHARACTERISTIC
/begin CHARACTERISTIC ACCtl_pACMinHi_C "upper threshold for minimum AC coolant pressure to disengage immediately" VALUE 0x804FB232 RB_Val_Ws16 131070.0 PresAC_hPa -65536.00 65534.00 FORMAT "%8.2" /end CHARACTERISTIC
/begin CHARACTERISTIC ACCtl_pACMinLo_C "lower threshold for minimum AC coolant pressure to disengage immediately the AC compressor" VALUE 0x804FB234 RB_Val_Ws16 131070.0 PresAC_hPa -65536.00 65534.00 FORMAT "%8.2" /end CHARACTERISTIC
/begin CHARACTERISTIC ACCtl_pACPDwnCorrVal_C "AC torque down pressure correction value" VALUE 0x804FB238 RB_Val_Ws32 4294967295.00 RBPtCel_p_1p0_1 -2147483648.00 2147483647.00 FORMAT "%13.2" /end CHARACTERISTIC
/begin CHARACTERISTIC ACCtl_pACTqDwnPCorrVal_C "AC pressure down correction value" VALUE 0x804FB23C RB_Val_Ws32 4294967295.00 RBPtCel_p_1p0_1 -2147483648.00 2147483647.00 FORMAT "%13.2" /end CHARACTERISTIC
/begin CHARACTERISTIC ACCtl_pClntTmr_CUR "AC shut off time threshold calculated by AC pressure" CURVE 0x804FB240 RB_Curve_S16_S16 655.3500 t_q0p01 -327.6800 327.6700 FORMAT "%8.4"
 /begin AXIS_DESCR STD_AXIS AirC_pClnt PresAC_hPa 3 -65536.00 65534.00 FORMAT "%8.2" DEPOSIT ABSOLUTE /end AXIS_DESCR
/end CHARACTERISTIC
/begin CHARACTERISTIC ACCtl_rACCpAccrPedlOpngDetrm_C "Ratio to determain AC capacity druing the Accelerator pedel opening" VALUE 0x804FB24E RB_Val_Ws16 799.9878 Prc -400.0000 399.9878 FORMAT "%8.4" /end CHARACTERISTIC
/begin CHARACTERISTIC ACCtl_rACCpDwnAccrPedlThd_C "Ratio Accelerator pedel down threshold for AC capactiy" VALUE 0x804FB250 RB_Val_Ws16 799.9878 Prc -400.0000 399.9878 FORMAT "%8.4" /end CHARACTERISTIC
/begin CHARACTERISTIC ACCtl_rAccPedClmbHi_C "Acceleration pedal position threshold high for hill climbing AC shut off condition" VALUE 0x804FB252 RB_Val_Ws16 799.9878 Prc -400.0000 399.9878 FORMAT "%8.4" /end CHARACTERISTIC
/begin CHARACTERISTIC ACCtl_rAccPedClmbLo_C "Acceleration pedal position threshold low for hill climbing AC shut off condition" VALUE 0x804FB254 RB_Val_Ws16 799.9878 Prc -400.0000 399.9878 FORMAT "%8.4" /end CHARACTERISTIC
/begin CHARACTERISTIC ACCtl_rAccPedHi_CUR "Acceleration pedal threshold high for Vehicle start AC shut off" CURVE 0x804FB256 RB_Curve_S16_S16 799.9878 Prc -400.0000 399.9878 FORMAT "%8.4"
 /begin AXIS_DESCR STD_AXIS ACCtl_drAccPedStrtCut Prc 3 -400.0000 399.9878 FORMAT "%8.4" DEPOSIT ABSOLUTE /end AXIS_DESCR
/end CHARACTERISTIC
/begin CHARACTERISTIC ACCtl_rAccPedLo_C "lower threshold pedal position" VALUE 0x804FB264 RB_Val_Ws16 799.9878 Prc -400.0000 399.9878 FORMAT "%8.4" /end CHARACTERISTIC
/begin CHARACTERISTIC ACCtl_rAccPedMid_CUR "Acceleration pedal threshold middle for Vehicle start AC shut off" CURVE 0x804FB266 RB_Curve_S16_S16 799.9878 Prc -400.0000 399.9878 FORMAT "%8.4"
 /begin AXIS_DESCR STD_AXIS ACCtl_drAccPedStrtCut Prc 3 -400.0000 399.9878 FORMAT "%8.4" DEPOSIT ABSOLUTE /end AXIS_DESCR
/end CHARACTERISTIC
/begin CHARACTERISTIC ACCtl_rACCpTmrRstAccrPedlThd_C "Ratio of Accelerator pedel threshold to reset the timer" VALUE 0x804FB274 RB_Val_Ws16 799.9878 Prc -400.0000 399.9878 FORMAT "%8.4" /end CHARACTERISTIC
/begin CHARACTERISTIC ACCtl_rCmprPlly_C "Ratio of Crank pulley diameter to compressor pulley diameter" VALUE 0x804FB276 RB_Val_Wu8 2.540 Fact100 0.010 2.550 FORMAT "%5.3" EXTENDED_LIMITS 0.00 2.550 /end CHARACTERISTIC
/begin CHARACTERISTIC ACCtl_stAcShOffCdn_C "AC cut off condition mask" VALUE 0x804FB278 RB_Val_Wu16 65535.00 OneToOne 0.00 65535.00 FORMAT "%8.2" /end CHARACTERISTIC
/begin CHARACTERISTIC ACCtl_stDecelACCtrlSwt_C "Deceleration AC control changeover switch" VALUE 0x804FB27A RB_Val_Wboolean 1.00000000000 B_TRUE 0.00 1.00000000000 FORMAT "%13.11" /end CHARACTERISTIC
/begin CHARACTERISTIC ACCtl_stSwtAcCdn_C "AC switch state for AC control mask" VALUE 0x804FB27C RB_Val_Wu16 65535.00 OneToOne 0.00 65535.00 FORMAT "%8.2" /end CHARACTERISTIC
/begin CHARACTERISTIC ACCtl_stSwtTrqResvSec_C "Acctl state switch trouqereseverdsection" VALUE 0x804FB27E RB_Val_Wboolean 1.00000000000 B_TRUE 0.00 1.00000000000 FORMAT "%13.11" /end CHARACTERISTIC
/begin CHARACTERISTIC ACCtl_swtAcECU_C "Codeword: Compressor without ECU / Compressor with ECU" VALUE 0x804FB27F RB_Val_Wboolean 1.00000000000 B_TRUE 0.00 1.00000000000 FORMAT "%13.11" /end CHARACTERISTIC
/begin CHARACTERISTIC ACCtl_swtHeatrCorePrsnt_C "HTRCORE software switch." VALUE 0x804FB280 RB_Val_Wboolean 1.00000000000 B_TRUE 0.00 1.00000000000 FORMAT "%13.11" /end CHARACTERISTIC
/begin CHARACTERISTIC ACCtl_swtResv_C "Switch: Activation of AC torque reserve" VALUE 0x804FB281 RB_Val_Wboolean 1.00000000000 B_TRUE 0.00 1.00000000000 FORMAT "%13.11" /end CHARACTERISTIC
/begin CHARACTERISTIC ACCtl_tEngHiCoolgPrf_C "Engine temperature threshold high for high engine temperature AC shut off" VALUE 0x804FB282 RB_Val_Ws16 6553.500 Temp_Cels -3549.940 3003.560 FORMAT "%8.3" /end CHARACTERISTIC
/begin CHARACTERISTIC ACCtl_tEngHiTow_C "Engine temperature threshold high for towing AC shut off" VALUE 0x804FB284 RB_Val_Ws16 6553.500 Temp_Cels -3549.940 3003.560 FORMAT "%8.3" /end CHARACTERISTIC
/begin CHARACTERISTIC ACCtl_tEngLoCoolgPrf_C "Engine temperature threshold high for low engine temperature AC shut off" VALUE 0x804FB286 RB_Val_Ws16 6553.500 Temp_Cels -3549.940 3003.560 FORMAT "%8.3" /end CHARACTERISTIC
/begin CHARACTERISTIC ACCtl_tEngLoTow_C "Engine temperature threshold low for towing AC shut off" VALUE 0x804FB288 RB_Val_Ws16 6553.500 Temp_Cels -3549.940 3003.560 FORMAT "%8.3" /end CHARACTERISTIC
/begin CHARACTERISTIC ACCtl_tEvapACCutHi_T "curve for converting the AC dial input to high side AC temperature." CURVE 0x804FB28A RB_Curve_S16_S16 6553.500 Temp_Cels -3549.940 3003.560 FORMAT "%8.3"
 /begin AXIS_DESCR STD_AXIS wtacvol_w spg_uw_q0p00488 13 -160.0000 159.9951 FORMAT "%8.4" DEPOSIT ABSOLUTE /end AXIS_DESCR
/end CHARACTERISTIC
/begin CHARACTERISTIC ACCtl_tEvapACCutLo_T "curve for converting the AC dial input to low side AC temperature." CURVE 0x804FB2C0 RB_Curve_S16_S16 6553.500 Temp_Cels -3549.940 3003.560 FORMAT "%8.3"
 /begin AXIS_DESCR STD_AXIS wtacvol_w spg_uw_q0p00488 13 -160.0000 159.9951 FORMAT "%8.4" DEPOSIT ABSOLUTE /end AXIS_DESCR
/end CHARACTERISTIC
/begin CHARACTERISTIC ACCtl_tEvapMinHi_C "Evaporator temperature threshold high for AC shut off" VALUE 0x804FB2F6 RB_Val_Ws16 6553.500 Temp_Cels -3549.940 3003.560 FORMAT "%8.3" /end CHARACTERISTIC
/begin CHARACTERISTIC ACCtl_tEvapMinLo_C "Evaporator temperature threshold low for AC shut off" VALUE 0x804FB2F8 RB_Val_Ws16 6553.500 Temp_Cels -3549.940 3003.560 FORMAT "%8.3" /end CHARACTERISTIC
/begin CHARACTERISTIC ACCtl_tEvaSnsrErr_C "Evaporator sensor short temperature" VALUE 0x804FB2FA RB_Val_Ws16 6553.500 Temp_Cels -3549.940 3003.560 FORMAT "%8.3" /end CHARACTERISTIC
/begin CHARACTERISTIC ACCtl_tiACCmprTqReqTi_T "AC compressor Torque Request time" CURVE 0x804FB2FC RB_Curve_S16_S16 655.3500 Time_s -327.6800 327.6700 FORMAT "%8.4"
 /begin AXIS_DESCR STD_AXIS Com_stACCut OneToOne 8 0.00 255.0000 FORMAT "%8.4" EXTENDED_LIMITS -32768.00 32767.00 DEPOSIT ABSOLUTE /end AXIS_DESCR
/end CHARACTERISTIC
/begin CHARACTERISTIC ACCtl_tiACCpDwnImplTi_C "AC capacity down implemetion timer" VALUE 0x804FB31E RB_Val_Ws16 655.3500 Time_s -327.6800 327.6700 FORMAT "%8.4" /end CHARACTERISTIC
/begin CHARACTERISTIC ACCtl_tiAccPedBuf_C "Buffer time for acceleration pedal position calculation" VALUE 0x804FB320 RB_Val_Wu16 655.3500 t_q0p01 0.00 655.3500 FORMAT "%8.4" /end CHARACTERISTIC
/begin CHARACTERISTIC ACCtl_tiACCpTqReqTmrMax_C "Maximum AC torque reduction time for Engine torque down request torque" VALUE 0x804FB324 RB_Val_Ws32 42949672.9500 Time_s -21474836.4800 21474836.4700 FORMAT "%13.4" /end CHARACTERISTIC
/begin CHARACTERISTIC ACCtl_tiAcCutDebThdHiLo_C "Uphill AC CUT non-operating time" VALUE 0x804FB328 RB_Val_Ws16 327.6700 t_q0p01 0.00 327.6700 FORMAT "%8.4" EXTENDED_LIMITS -327.6800 327.6700 /end CHARACTERISTIC
/begin CHARACTERISTIC ACCtl_tiAcCutDebThdLoHi_C "Uphill AC CUT operating time" VALUE 0x804FB32A RB_Val_Ws16 327.6700 t_q0p01 0.00 327.6700 FORMAT "%8.4" EXTENDED_LIMITS -327.6800 327.6700 /end CHARACTERISTIC
/begin CHARACTERISTIC ACCtl_tiAcCutOperRepDly_C "Uphill AC cut then operatrepeating delay time threshold" VALUE 0x804FB32C RB_Val_Ws16 327.6700 t_q0p01 0.00 327.6700 FORMAT "%8.4" EXTENDED_LIMITS -327.6800 327.6700 /end CHARACTERISTIC
/begin CHARACTERISTIC ACCtl_tiACPOffDly_C "AC pressure off delay" VALUE 0x804FB32E RB_Val_Wu16 655.3500 t_q0p01 0.00 655.3500 FORMAT "%8.4" /end CHARACTERISTIC
/begin CHARACTERISTIC ACCtl_tiACTond_C "AC turn On delay time for AC turn Off torque reserve" VALUE 0x804FB330 RB_Val_Wu16 655.3500 t_q0p01 0.00 655.3500 FORMAT "%8.4" /end CHARACTERISTIC
/begin CHARACTERISTIC ACCtl_tiACTrqDlyImdt_C "Delay time for AC torque when the immediately AC shut off" VALUE 0x804FB332 RB_Val_Wu16 655.3500 t_q0p01 0.00 655.3500 FORMAT "%8.4" /end CHARACTERISTIC
/begin CHARACTERISTIC ACCtl_tiACTrqDly_C "AC off for setting the delay time for ACCtl_trqMaxAC used application" VALUE 0x804FB334 RB_Val_Wu16 655.3500 t_q0p01 0.00 655.3500 FORMAT "%8.4" /end CHARACTERISTIC
/begin CHARACTERISTIC ACCtl_tiClmbSpdThdDly_C "Uphill AC cut base on vehicle speed delay time threshold" VALUE 0x804FB336 RB_Val_Ws16 327.6700 t_q0p01 0.00 327.6700 FORMAT "%8.4" EXTENDED_LIMITS -327.6800 327.6700 /end CHARACTERISTIC
/begin CHARACTERISTIC ACCtl_tiDebIdlSpdOnDly_C "Delay time for idle up start" VALUE 0x804FB338 RB_Val_Wu16 655.3500 t_q0p01 0.00 655.3500 FORMAT "%8.4" /end CHARACTERISTIC
/begin CHARACTERISTIC ACCtl_tiDebIdlSpdSec_C "debounce time for idle speed request" VALUE 0x804FB33A RB_Val_Wu16 655.3500 t_q0p01 0.00 655.3500 FORMAT "%8.4" /end CHARACTERISTIC
/begin CHARACTERISTIC ACCtl_tiDlyAcOn_C "Time delay for AC ON" VALUE 0x804FB33C RB_Val_Wu16 655.3500 t_q0p01 0.00 655.3500 FORMAT "%8.4" /end CHARACTERISTIC
/begin CHARACTERISTIC ACCtl_tiDlyClmbOn_C "Hill climbing AC shut off activation delay time" VALUE 0x804FB33E RB_Val_Wu16 655.3500 t_q0p01 0.00 655.3500 FORMAT "%8.4" /end CHARACTERISTIC
/begin CHARACTERISTIC ACCtl_tiDlyCrkNotCmpl_C "AC shut off time after engine start" VALUE 0x804FB340 RB_Val_Wu16 655.3500 t_q0p01 0.00 655.3500 FORMAT "%8.4" /end CHARACTERISTIC
/begin CHARACTERISTIC ACCtl_tiDlyEngNOn_C "Low engine speed AC shut off recovery delay time" VALUE 0x804FB342 RB_Val_Wu16 655.3500 t_q0p01 0.00 655.3500 FORMAT "%8.4" /end CHARACTERISTIC
/begin CHARACTERISTIC ACCtl_tiDlyEvaErrOff_C "AC clutch on delay time at evaporator sensor short" VALUE 0x804FB344 RB_Val_Wu8 25.50 t_q0p1 0.00 25.50 FORMAT "%5.2" /end CHARACTERISTIC
/begin CHARACTERISTIC ACCtl_tiDlyEvaErrOn_C "AC clutch off delay time at evaporator sensor short" VALUE 0x804FB345 RB_Val_Wu8 25.50 t_q0p1 0.00 25.50 FORMAT "%5.2" /end CHARACTERISTIC
/begin CHARACTERISTIC ACCtl_tiInhbACCutPrmsACOn_C "AC cut permission inhibit time at the time of AC ON." VALUE 0x804FB346 RB_Val_Wu16 655.3500 t_q0p01 0.00 655.3500 FORMAT "%8.4" /end CHARACTERISTIC
/begin CHARACTERISTIC ACCtl_tiInhbACCutPrms_C "AC cut permission inhibit time" VALUE 0x804FB348 RB_Val_Wu16 655.3500 t_q0p01 0.00 655.3500 FORMAT "%8.4" /end CHARACTERISTIC
/begin CHARACTERISTIC ACCtl_tiOutDlyImdt_C "Delay time for ACCtl_bOut when the immediately AC shut off" VALUE 0x804FB34A RB_Val_Wu16 655.3500 t_q0p01 0.00 655.3500 FORMAT "%8.4" /end CHARACTERISTIC
/begin CHARACTERISTIC ACCtl_tiOutDly_C "Delay time for ACCtl_bOut" VALUE 0x804FB34C RB_Val_Wu16 655.3500 t_q0p01 0.00 655.3500 FORMAT "%8.4" /end CHARACTERISTIC
/begin CHARACTERISTIC ACCtl_tiStrtCutTmrCdn_C "AC On delay time for vehicle start AC cut off condition" VALUE 0x804FB34E RB_Val_Ws16 655.3500 t_q0p01 -327.6800 327.6700 FORMAT "%8.4" /end CHARACTERISTIC
/begin CHARACTERISTIC ACCtl_tiStrtCutTmrHi_C "Vehicle start AC shut off time for high acceleration" VALUE 0x804FB350 RB_Val_Ws16 655.3500 t_q0p01 -327.6800 327.6700 FORMAT "%8.4" /end CHARACTERISTIC
/begin CHARACTERISTIC ACCtl_tiStrtCutTmrMid_C "Vehicle start AC shut off time for middle acceleration" VALUE 0x804FB352 RB_Val_Ws16 655.3500 t_q0p01 -327.6800 327.6700 FORMAT "%8.4" /end CHARACTERISTIC
/begin CHARACTERISTIC ACCtl_tiSwOffResv_C "AC Off torque reserve time" VALUE 0x804FB354 RB_Val_Wu16 655.3500 t_q0p01 0.00 655.3500 FORMAT "%8.4" /end CHARACTERISTIC
/begin CHARACTERISTIC ACCtl_tiTrqResvSec_C "delay time for torque reserve build up before AC compressor engagement" VALUE 0x804FB356 RB_Val_Wu16 655.3500 t_q0p01 0.00 655.3500 FORMAT "%8.4" /end CHARACTERISTIC
/begin CHARACTERISTIC ACCtl_tqACCmprTqReqDurgAPOpng_T "AC compressor request torque during Accelerator pedel opening" CURVE 0x804FB358 RB_Curve_S16_S16 6553.500 Trq -3276.800 3276.700 FORMAT "%8.3"
 /begin AXIS_DESCR STD_AXIS ACCtl_rAppSig Prc 10 -400.0000 399.9878 FORMAT "%8.4" DEPOSIT ABSOLUTE /end AXIS_DESCR
/end CHARACTERISTIC
/begin CHARACTERISTIC ACCtl_tqDwnDurgDecel_C "AC torque down value during deceleration" VALUE 0x804FB382 RB_Val_Ws16 6553.500 Trq -3276.800 3276.700 FORMAT "%8.3" /end CHARACTERISTIC
/begin CHARACTERISTIC ACCtl_tqMaxAcLim_C "AC torque limit for shutoff condition" VALUE 0x804FB384 RB_Val_Ws16 6553.500 Trq -3276.800 3276.700 FORMAT "%8.3" /end CHARACTERISTIC
/begin CHARACTERISTIC ACCtl_tqMaxTqCrksftEngSpdEnd_C "AC Maximum torque cranshaft during engine speed end" VALUE 0x804FB386 RB_Val_Ws16 6553.500 Trq -3276.800 3276.700 FORMAT "%8.3" /end CHARACTERISTIC
/begin CHARACTERISTIC ACCtl_trqMaxAC_C "maximal torque default for AC disposition" VALUE 0x804FB388 RB_Val_Ws16 6553.500 Trq -3276.800 3276.700 FORMAT "%8.3" /end CHARACTERISTIC
/begin CHARACTERISTIC ACCtl_vACCpLowrVehSpdThd_C "Lower vehicle speed theshold for AC capactiy" VALUE 0x804FB38A RB_Val_Ws16 655.3500 Vel -327.6800 327.6700 FORMAT "%8.4" /end CHARACTERISTIC
/begin CHARACTERISTIC ACCtl_vACCpUpprVehSpdThd_C "Upper vehicle speed theshold for AC capactiy" VALUE 0x804FB38C RB_Val_Ws16 655.3500 Vel -327.6800 327.6700 FORMAT "%8.4" /end CHARACTERISTIC
/begin CHARACTERISTIC ACCtl_vACTrqDecHiThd_C "Higher threshold for vehicle speed for AC cut condition" VALUE 0x804FB38E RB_Val_Ws16 655.3500 Vel -327.6800 327.6700 FORMAT "%8.4" /end CHARACTERISTIC
/begin CHARACTERISTIC ACCtl_vACTrqDecLoThd_C "Lower threshold for vehicle speed for AC cut condition" VALUE 0x804FB390 RB_Val_Ws16 655.3500 Vel -327.6800 327.6700 FORMAT "%8.4" /end CHARACTERISTIC
/begin CHARACTERISTIC ACCtl_vVehAcCutOnThd_C "Vehicle speed possible threshold for AC on" VALUE 0x804FB392 RB_Val_Ws16 655.3500 Vel -327.6800 327.6700 FORMAT "%8.4" /end CHARACTERISTIC
/begin CHARACTERISTIC ACCtl_vVehChkHiThd_C "Vehicle speed low threshold checking uphill for AC cut" VALUE 0x804FB394 RB_Val_Ws16 655.3500 Vel -327.6800 327.6700 FORMAT "%8.4" /end CHARACTERISTIC
/begin CHARACTERISTIC ACCtl_vVehChkLoThd_C "Vehicle speed high threshold checking uphill for AC on" VALUE 0x804FB396 RB_Val_Ws16 655.3500 Vel -327.6800 327.6700 FORMAT "%8.4" /end CHARACTERISTIC
/begin CHARACTERISTIC ACCtl_vVehClmbHi_C "Vehicle speed threshold high for hill climbing AC shut off condition" VALUE 0x804FB398 RB_Val_Ws16 655.3500 Vel -327.6800 327.6700 FORMAT "%8.4" /end CHARACTERISTIC
/begin CHARACTERISTIC ACCtl_vVehClmbLo_C "Vehicle speed threshold low for hill climbing AC shut off condition" VALUE 0x804FB39A RB_Val_Ws16 655.3500 Vel -327.6800 327.6700 FORMAT "%8.4" /end CHARACTERISTIC
/begin CHARACTERISTIC ACCtl_vVehHiCoolgPrf_C "Vehicle speed threshold high for high engine temperature AC shut off" VALUE 0x804FB39C RB_Val_Ws16 655.3500 Vel -327.6800 327.6700 FORMAT "%8.4" /end CHARACTERISTIC
/begin CHARACTERISTIC ACCtl_vVehLoCoolgPrf_C "Vehicle speed threshold low for high engine temperature AC shut off" VALUE 0x804FB39E RB_Val_Ws16 655.3500 Vel -327.6800 327.6700 FORMAT "%8.4" /end CHARACTERISTIC
/begin CHARACTERISTIC ACCtl_vVehStrtCutInhbHi_C "Vehicle speed threshold high for vehicle start AC shut off inhibit condition" VALUE 0x804FB3A0 RB_Val_Ws16 655.3500 Vel -327.6800 327.6700 FORMAT "%8.4" /end CHARACTERISTIC
/begin CHARACTERISTIC ACCtl_vVehStrtCutInhbLo_C "Vehicle speed threshold low for vehicle start AC shut off inhibit condition" VALUE 0x804FB3A2 RB_Val_Ws16 655.3500 Vel -327.6800 327.6700 FORMAT "%8.4" /end CHARACTERISTIC
/begin CHARACTERISTIC ACEvpT_SRC.uMin_C "Structure to hold the SRC thresholds / Threshold for SRC -Min detection" VALUE 0x8053A514 Kw_Ws16 5200.000 Volt 0.00 5200.000 FORMAT "%8.3" EXTENDED_LIMITS -6553.600 6553.400 /end CHARACTERISTIC
/begin CHARACTERISTIC ACEvpT_SRC.uMax_C "Structure to hold the SRC thresholds / Threshold for SRC -Max detection" VALUE 0x8053A516 Kw_Ws16 5200.000 Volt 0.00 5200.000 FORMAT "%8.3" EXTENDED_LIMITS -6553.600 6553.400 /end CHARACTERISTIC
/begin CHARACTERISTIC ACEvpT_stCodMsk_C "Calibration variable:To get the particular bit position value of the BasSvrAppl_swtCodAC variable" VALUE 0x8053A518 Val_Wu8 255.0 OneToOne 0.00 255.0 FORMAT "%5.1" /end CHARACTERISTIC
/begin CHARACTERISTIC ACEvpT_swtSensPres_C "Switch to check whether the ac Evaporator temperature sensor is present or not" VALUE 0x8053A519 Val_Wu8 1.000 OneToOne 0.00 1.000 FORMAT "%5.3" EXTENDED_LIMITS 0.00 255.0 /end CHARACTERISTIC
/begin CHARACTERISTIC ACEvpT_swtSig_C "Signal Selection (ADC or CAN) in the presence of the sensor" VALUE 0x8053A51A Val_Wu8 255.0 OneToOne 0.00 255.0 FORMAT "%5.1" /end CHARACTERISTIC
/begin CHARACTERISTIC ACEvpT_tBCANErr_C "Calibration to check BCAN errors" VALUE 0x8053A51C Val_Ws16 6553.500 Temp_Cels -3549.940 3003.560 FORMAT "%8.3" /end CHARACTERISTIC
/begin CHARACTERISTIC ACEvpT_tCANErrDftVal_C "Default Calibration in case of CAN errors" VALUE 0x8053A51E Val_Ws16 6553.500 Temp_Cels -3549.940 3003.560 FORMAT "%8.3" /end CHARACTERISTIC
/begin CHARACTERISTIC ACEvpT_tDfl_C "Default ac Evaporator temperature when there is sensor error" VALUE 0x8053A520 Val_Ws16 250.0000 Temp_Cels -50.0400 199.9600 FORMAT "%8.4" EXTENDED_LIMITS -3549.940 3003.560 /end CHARACTERISTIC
/begin CHARACTERISTIC ACEvpT_tFCANErr_C "Calibration to check FCAN errors" VALUE 0x8053A522 Val_Ws16 6553.500 Temp_Cels -3549.940 3003.560 FORMAT "%8.3" /end CHARACTERISTIC
/begin CHARACTERISTIC ACEvpT_tiCANDly_C "Turn on Delay time to receive CAN signal" VALUE 0x8053A524 Val_Ws32 42949672950.0 Time_ms -21474836480.0 21474836470.0 FORMAT "%13.1" /end CHARACTERISTIC
/begin CHARACTERISTIC ACEvpT_tTransf_CUR "Transformation curve for AC evaporator sensor voltage to temperature" CURVE 0x8053A528 Cur_Xs16Ws16 250.0000 Temp_Cels -50.0400 199.9600 FORMAT "%8.4" EXTENDED_LIMITS -3549.940 3003.560
 /begin AXIS_DESCR STD_AXIS ACEvpT_uRaw Volt 10 0.00 5200.000 FORMAT "%8.3" EXTENDED_LIMITS -6553.600 6553.400 DEPOSIT ABSOLUTE /end AXIS_DESCR
/end CHARACTERISTIC
/begin CHARACTERISTIC ACEvpT_uRawDfl_C "Default value for the raw voltage of ACEvpT when the sensor is not present" VALUE 0x8053A552 Val_Ws16 5200.000 Volt 0.00 5200.000 FORMAT "%8.3" EXTENDED_LIMITS -6553.600 6553.400 /end CHARACTERISTIC
/begin CHARACTERISTIC ACSwt_stMnSwtDebEna_C "AC switch debounce enable parameter" VALUE 0x804FB3A4 RB_Val_Wu8 255.0 OneToOne 0.00 255.0 FORMAT "%5.1" /end CHARACTERISTIC
/begin CHARACTERISTIC ACSwt_tiSwtDebHiLo_C "High to low debounce time for AC switch status" VALUE 0x804FB3A6 RB_Val_Ws16 655350.0 TimeDeb -327680.0 327670.0 FORMAT "%8.1" /end CHARACTERISTIC
/begin CHARACTERISTIC ACSwt_tiSwtDebLoHi_C "Low to high debounce time for AC switch status" VALUE 0x804FB3A8 RB_Val_Ws16 655350.0 TimeDeb -327680.0 327670.0 FORMAT "%8.1" /end CHARACTERISTIC
/begin CHARACTERISTIC AirC_stSwtDfl_C "Default value for AC switch in case of errors" VALUE 0x804FB3AA RB_Val_Wu8 255.0 OneToOne 0.00 255.0 FORMAT "%5.1" /end CHARACTERISTIC
/begin CHARACTERISTIC AirDvP_flgAddEnaDly_C "Switch for delay of enableing condition engine stopped" VALUE 0x80503A44 RB_Val_Wu8 1.00000000000 B_TRUE 0.00 1.00000000000 FORMAT "%13.11" /end CHARACTERISTIC
/begin CHARACTERISTIC AirDvP_pEngStrtMax_C "Max pressure for diagnosis of pressure sensors during startup" VALUE 0x80503A46 RB_Val_Wu16 5119.922 p_q0p078 0.00 5119.922 FORMAT "%8.3" /end CHARACTERISTIC
/begin CHARACTERISTIC AirDvP_pEnvSpcSnsrTolr_C "One side tolerance ambient air pressure sensor" VALUE 0x80503A48 RB_Val_Ws16 1279.961 p_q0p039 0.00 1279.961 FORMAT "%8.3" EXTENDED_LIMITS -1280.000 1279.961 /end CHARACTERISTIC
/begin CHARACTERISTIC AirDvP_pIntkVUsSpcSnsrTolr_C "One side tolerance manifold pressure sensor" VALUE 0x80503A4A RB_Val_Ws16 1279.961 p_q0p039 0.00 1279.961 FORMAT "%8.3" EXTENDED_LIMITS -1280.000 1279.961 /end CHARACTERISTIC
/begin CHARACTERISTIC AirDvP_tiDlyAftEngStop_C "time after engine stop for pressure balance in the air system" VALUE 0x80503A4C RB_Val_Wu16 6553.500 t_q0p1 0.00 6553.500 FORMAT "%8.3" /end CHARACTERISTIC
/begin CHARACTERISTIC AirDvP_tiFilDifPEnv_C "Time constant of filter of difference between ambient air pressure and other air pressures" VALUE 0x80503A4E RB_Val_Wu16 6553.400 t_q0p1 0.100 6553.500 FORMAT "%8.3" EXTENDED_LIMITS 0.00 6553.500 /end CHARACTERISTIC
/begin CHARACTERISTIC AirDvP_tiMaxSnsrAdpn_C "maximum time duration for the pressure sensor offset adaptation" VALUE 0x80503A50 RB_Val_Wu16 6553.500 t_q0p1 0.00 6553.500 FORMAT "%8.3" /end CHARACTERISTIC
/begin CHARACTERISTIC AirMod_agWidthCamProfIntk_C "Width of the intake valve cam profile referred to 0.5mm lift for BC AirMod" VALUE 0x80503A52 RB_Val_Ws16 1023.984 kw_q0p0156 -512.0000 511.9844 FORMAT "%8.4" READ_ONLY /end CHARACTERISTIC
/begin CHARACTERISTIC AirMod_agWidthCamProfLoLftIntk_C "Width of the intake valve cam profile (low cam profile) referred to 0.5mm lift for BC AirMod" VALUE 0x80503A54 RB_Val_Ws16 1023.984 kw_q0p0156 -512.0000 511.9844 FORMAT "%8.4" READ_ONLY /end CHARACTERISTIC
/begin CHARACTERISTIC AirMod_cntrDlyVlvLftLftIntk_C "Parameter for counter to delay the flag B_vhefeps" VALUE 0x80503A56 RB_Val_Wu8 255.0 OneToOne 0.00 255.0 FORMAT "%5.1" /end CHARACTERISTIC
/begin CHARACTERISTIC AirMod_flgVlvLftIntkStrt_C "Init value for B_vhegabgn" VALUE 0x80503A57 RB_Val_Wboolean 1.00000000000 B_TRUE 0.00 1.00000000000 FORMAT "%13.11" /end CHARACTERISTIC
/begin CHARACTERISTIC AirMod_ratChrgDeltaVlvLftIntkThres_C "Threshold for the charge delta to delay the B_vhefeps" VALUE 0x80503A58 RB_Val_Ws16 1535.977 rel_q0p0234 -768.0000 767.9766 FORMAT "%8.4" /end CHARACTERISTIC
/begin CHARACTERISTIC AltIO_ATS.LimitTypeMsk_C "Actuator test AltIO_ATS / Tester demand monitoring enable mask for actuators" VALUE 0x8053A584 Val_Wu8 255.0 OneToOne 0.00 255.0 FORMAT "%5.1" /end CHARACTERISTIC
/begin CHARACTERISTIC AltIO_ATS.CnvNorm_C "Actuator test AltIO_ATS / Conversion norm used for conversion to/from internal scaling" VALUE 0x8053A585 Val_Wu8 255.0 OneToOne 0.00 255.0 FORMAT "%5.1" /end CHARACTERISTIC
/begin CHARACTERISTIC AltIO_ATS.LowLim_C "Actuator test AltIO_ATS / Lower limit for monitoring" VALUE 0x8053A586 Val_Ws16 65535.00 OneToOne -32768.00 32767.00 FORMAT "%8.2" /end CHARACTERISTIC
/begin CHARACTERISTIC AltIO_ATS.UpLim_C "Actuator test AltIO_ATS / Upper limit for monitoring" VALUE 0x8053A588 Val_Ws16 65535.00 OneToOne -32768.00 32767.00 FORMAT "%8.2" /end CHARACTERISTIC
/begin CHARACTERISTIC AltIO_ATS.CnvFac_C "Actuator test AltIO_ATS / Factor used for conversion to/from internal scaling" VALUE 0x8053A58C Val_Ws32 4294967295.00 OneToOne -2147483648.00 2147483647.00 FORMAT "%13.2" /end CHARACTERISTIC
/begin CHARACTERISTIC AltIO_ATS.CnvOfs_C "Actuator test AltIO_ATS / Offset used for conversion to/from internal scaling" VALUE 0x8053A590 Val_Ws16 65535.00 OneToOne -32768.00 32767.00 FORMAT "%8.2" /end CHARACTERISTIC
/begin CHARACTERISTIC AltIO_ATS.DfltVal_C "Actuator test AltIO_ATS / Default value for standbytest" VALUE 0x8053A592 Val_Ws16 65535.00 OneToOne -32768.00 32767.00 FORMAT "%8.2" /end CHARACTERISTIC
/begin CHARACTERISTIC AltIO_nEngACGVltg_C "Threshold for engine speed for diagnosis for ACG system voltage Low,High" VALUE 0x80503A6C RB_Val_Ws16 32767.50 EngN -16384.00 16383.50 FORMAT "%8.2" /end CHARACTERISTIC
/begin CHARACTERISTIC AltIO_nEngHiThdACGDiscnct_C "Higher Threshold value for engine speed in detecting ACG disconnection." VALUE 0x80503A6E RB_Val_Ws16 32767.50 EngN -16384.00 16383.50 FORMAT "%8.2" /end CHARACTERISTIC
/begin CHARACTERISTIC AltIO_nEngThdACGDConn_C "Threshold value for engine speed in detecting ACG disconnection" VALUE 0x80503A70 RB_Val_Ws16 32767.50 EngN -16384.00 16383.50 FORMAT "%8.2" /end CHARACTERISTIC
/begin CHARACTERISTIC AltIO_nEngThdACGFailrLo_C "Engine thresold ACG failure for LSP Hysteresis" VALUE 0x80503A72 RB_Val_Ws16 32767.50 EngN -16384.00 16383.50 FORMAT "%8.2" READ_ONLY /end CHARACTERISTIC
/begin CHARACTERISTIC AltIO_nEngThdACGFailr_C "Threshold value for engine speed in detecting ACG electric or mechanical fault" VALUE 0x80503A74 RB_Val_Ws16 32767.50 EngN -16384.00 16383.50 FORMAT "%8.2" /end CHARACTERISTIC
/begin CHARACTERISTIC AltIO_nEngThdACGTHi_C "Threshold value for engine speed in detecting ACG high temperature fault" VALUE 0x80503A76 RB_Val_Ws16 32767.50 EngN -16384.00 16383.50 FORMAT "%8.2" /end CHARACTERISTIC
/begin CHARACTERISTIC AltIO_rACGFieDutyHi_C "Higher threshold for filtered value of ACG field duty cycle" VALUE 0x80503A78 RB_Val_Ws16 655.3500 DtyCyc -327.6800 327.6700 FORMAT "%8.4" /end CHARACTERISTIC
/begin CHARACTERISTIC AltIO_rACGFieDutyLo_C "Lower threshold for filtered value of ACG field duty cycle" VALUE 0x80503A7A RB_Val_Ws16 655.3500 DtyCyc -327.6800 327.6700 FORMAT "%8.4" /end CHARACTERISTIC
/begin CHARACTERISTIC AltIO_rAltMdl_CUR "Model of alternator load" CURVE 0x804FA38C Cur_Xs16Ws16 799.9878 Prc -400.0000 399.9878 FORMAT "%8.4"
 /begin AXIS_DESCR STD_AXIS Epm_nEng EngN 4 -16384.00 16383.50 FORMAT "%8.2" DEPOSIT ABSOLUTE /end AXIS_DESCR
/end CHARACTERISTIC
/begin CHARACTERISTIC AltIO_rErrSgn_C "Error sign of communication channel" VALUE 0x804FA39E Val_Ws16 799.9878 Prc -400.0000 399.9878 FORMAT "%8.4" READ_ONLY /end CHARACTERISTIC
/begin CHARACTERISTIC AltIO_tiACGFieDuty_C "Filter time constant for Alternator Duty cycle ACG generation" VALUE 0x80503A7C RB_Val_Ws32 4294.9672940000000 TimeDelay_s 0.0000020000000 4294.9672959999998 FORMAT "%19.14" EXTENDED_LIMITS 0.000002000000001 4294.9672959999998 /end CHARACTERISTIC
/begin CHARACTERISTIC AltIO_tiBattChrgLampOff_C "Delay time to turn off battery charge lamp after no error in ACG." VALUE 0x80503A80 RB_Val_Wu16 655.3500 Time_s 0.00 655.3500 FORMAT "%8.4" /end CHARACTERISTIC
/begin CHARACTERISTIC AltIO_tiISLampOffDly_C "Caliberation for IS lamp turn off delay" VALUE 0x80503A82 RB_Val_Wu16 655.3500 Time_s 0.00 655.3500 FORMAT "%8.4" /end CHARACTERISTIC
/begin CHARACTERISTIC AltIO_tThdACGTHi_C "Threshold temperature for detecting ACG High Temperature." VALUE 0x80503A84 RB_Val_Ws16 6553.500 Temp_Cels -3549.940 3003.560 FORMAT "%8.3" /end CHARACTERISTIC
/begin CHARACTERISTIC AltIO_uACGHealHiU_C "Threshold voltage for Healing System voltage High detection fault ." VALUE 0x80503A86 RB_Val_Ws16 1310700. Volt_Batt -655360.0 655340.0 FORMAT "%8.1" /end CHARACTERISTIC
/begin CHARACTERISTIC AltIO_uACGHealLoU_C "Threshold voltage for healing System voltage Low detection fault" VALUE 0x80503A88 RB_Val_Ws16 1310700. Volt_Batt -655360.0 655340.0 FORMAT "%8.1" /end CHARACTERISTIC
/begin CHARACTERISTIC AltIO_uACGHiVltg_C "Threshold voltage for System voltage High detection" VALUE 0x80503A8A RB_Val_Ws16 1310700. Volt_Batt -655360.0 655340.0 FORMAT "%8.1" /end CHARACTERISTIC
/begin CHARACTERISTIC AltIO_uACGLoVltg_C "Threshold voltage for System voltage Low detection" VALUE 0x80503A8C RB_Val_Ws16 1310700. Volt_Batt -655360.0 655340.0 FORMAT "%8.1" /end CHARACTERISTIC
/begin CHARACTERISTIC AltIO_uDconnACGThdLo_C "Lower threshold for ECU Voltage in detecting ACG disconnection" VALUE 0x80503A8E RB_Val_Ws16 1310700. Volt_Batt -655360.0 655340.0 FORMAT "%8.1" /end CHARACTERISTIC
/begin CHARACTERISTIC AltIO_uDesDconnACGThd_C "Threshold for ACG Output control request voltage in detecting ACG disconnection" VALUE 0x80503A90 RB_Val_Ws16 1310700. Volt_Batt -655360.0 655340.0 FORMAT "%8.1" /end CHARACTERISTIC
/begin CHARACTERISTIC AltIO_uDiscnctACGThdOk_C "Threshold value for battery voltage in healing ACG disconnection fault." VALUE 0x80503A92 RB_Val_Ws16 1310700. Volt_Batt -655360.0 655340.0 FORMAT "%8.1" /end CHARACTERISTIC
/begin CHARACTERISTIC ComAlt_iExctCrntOfs_C "Alternator excitation current offset" VALUE 0x80503A5A RB_Val_Ws16 65535.00 Curr -32768.00 32767.00 FORMAT "%8.2" /end CHARACTERISTIC
/begin CHARACTERISTIC ComAlt_iExctCrntSlp_C "Alternator Excitation current slope" VALUE 0x80503A5C RB_Val_Ws16 65535.00 OneToOne -32768.00 32767.00 FORMAT "%8.2" /end CHARACTERISTIC
/begin CHARACTERISTIC ComAlt_rAltDycOfs_C "Alternator Duty cycle offset" VALUE 0x80503A5E RB_Val_Ws16 799.9878 Prc -400.0000 399.9878 FORMAT "%8.4" /end CHARACTERISTIC
/begin CHARACTERISTIC ComAlt_rAltDycSlp_C "Alternator Duty cycle slope" VALUE 0x80503A60 RB_Val_Ws16 65535.00 OneToOne -32768.00 32767.00 FORMAT "%8.2" /end CHARACTERISTIC
/begin CHARACTERISTIC ComAlt_tACGTempOfs_C "ACG temperature offset" VALUE 0x80503A62 RB_Val_Ws16 6553.500 TempDiff_Cels -3276.800 3276.700 FORMAT "%8.3" /end CHARACTERISTIC
/begin CHARACTERISTIC ComAlt_tACGTempSlp_C "ACG temperature slope" VALUE 0x80503A64 RB_Val_Ws16 65535.00 OneToOne -32768.00 32767.00 FORMAT "%8.2" /end CHARACTERISTIC
/begin CHARACTERISTIC ComAlt_tACGTempTypBMax_C "Maximum ACG temperature type B" VALUE 0x80503A66 RB_Val_Ws16 6553.500 Temp_Cels -3549.940 3003.560 FORMAT "%8.3" /end CHARACTERISTIC
/begin CHARACTERISTIC ComAlt_tACGTempTypBMin_C "Minimum ACG temperature type B" VALUE 0x80503A68 RB_Val_Ws16 6553.500 Temp_Cels -3549.940 3003.560 FORMAT "%8.3" /end CHARACTERISTIC
/begin CHARACTERISTIC CWEVAB "codeword injection valve cutoff" VALUE 0x804FB3BC RB_Val_Wu8 255.0 dez 0.00 255.0 FORMAT "%5.1" /end CHARACTERISTIC
/begin CHARACTERISTIC InjSys_agCalcIncGap "Angle offset to widen the gap to the injection begin angle" VALUE 0x804FB3BE RB_Val_Wu8 1530. kw_q6 0.00 1530. FORMAT "%5.0" /end CHARACTERISTIC
/begin CHARACTERISTIC InjSys_FcoCylInd_ATS_ATS.LimitTypeMsk_C "Actuator test InjSys_FcoCylInd_ATS_ATS / Tester demand monitoring enable mask for actuators" VALUE 0x8053A620 Val_Wu8 255.0 OneToOne 0.00 255.0 FORMAT "%5.1" /end CHARACTERISTIC
/begin CHARACTERISTIC InjSys_FcoCylInd_ATS_ATS.CnvNorm_C "Actuator test InjSys_FcoCylInd_ATS_ATS / Conversion norm used for conversion to/from internal scaling" VALUE 0x8053A621 Val_Wu8 255.0 OneToOne 0.00 255.0 FORMAT "%5.1" /end CHARACTERISTIC
/begin CHARACTERISTIC InjSys_FcoCylInd_ATS_ATS.LowLim_C "Actuator test InjSys_FcoCylInd_ATS_ATS / Lower limit for monitoring" VALUE 0x8053A622 Val_Ws16 65535.00 dez -32768.00 32767.00 FORMAT "%8.2" /end CHARACTERISTIC
/begin CHARACTERISTIC InjSys_FcoCylInd_ATS_ATS.UpLim_C "Actuator test InjSys_FcoCylInd_ATS_ATS / Upper limit for monitoring" VALUE 0x8053A624 Val_Ws16 65535.00 dez -32768.00 32767.00 FORMAT "%8.2" /end CHARACTERISTIC
/begin CHARACTERISTIC InjSys_FcoCylInd_ATS_ATS.CnvFac_C "Actuator test InjSys_FcoCylInd_ATS_ATS / Factor used for conversion to/from internal scaling" VALUE 0x8053A628 Val_Ws32 4294967295.00 OneToOne -2147483648.00 2147483647.00 FORMAT "%13.2" /end CHARACTERISTIC
/begin CHARACTERISTIC InjSys_FcoCylInd_ATS_ATS.CnvOfs_C "Actuator test InjSys_FcoCylInd_ATS_ATS / Offset used for conversion to/from internal scaling" VALUE 0x8053A62C Val_Ws16 65535.00 OneToOne -32768.00 32767.00 FORMAT "%8.2" /end CHARACTERISTIC
/begin CHARACTERISTIC InjSys_FcoCylInd_ATS_ATS.DfltVal_C "Actuator test InjSys_FcoCylInd_ATS_ATS / Default value for standbytest" VALUE 0x8053A62E Val_Ws16 65535.00 OneToOne -32768.00 32767.00 FORMAT "%8.2" /end CHARACTERISTIC
/begin CHARACTERISTIC SF_DSS "Sum Fault DSS" VAL_BLK 0x804FB3AC RB_ValA_Wu16 58.0000000000 dfp_verbal 0.00 58.0000000000 FORMAT "%13.10" READ_ONLY NUMBER 3 /end CHARACTERISTIC
/begin CHARACTERISTIC SF_DSU "Sum Fault ambient pressure sensor (DSU)" VAL_BLK 0x804FB3B2 RB_ValA_Wu16 58.0000000000 dfp_verbal 0.00 58.0000000000 FORMAT "%13.10" READ_ONLY NUMBER 3 /end CHARACTERISTIC
/begin MEASUREMENT abmf_msg "injection cut off pattern at fixed position" UBYTE dez 1 100 0.00 255.0 FORMAT "%5.1" ECU_ADDRESS 0x70001C0F /end MEASUREMENT
/begin MEASUREMENT abmm "Injection Cutoff pattern for Torque Reduction" UBYTE dez 1 100 0.00 255.0 FORMAT "%5.1" ECU_ADDRESS 0x70001AAE /end MEASUREMENT
/begin MEASUREMENT ACComp_facCmprPCorrn "Enthalpy correction using coolant pressure" SLONG Fact_10000 1 100 -214748.364800 214748.364700 FORMAT "%13.6" ECU_ADDRESS 0x600019D0 /end MEASUREMENT
/begin MEASUREMENT ACComp_facCmprSpdCorrn_MP "AC compressor speed correction" SLONG Fact_10000 1 100 -214748.364800 214748.364700 FORMAT "%13.6" ECU_ADDRESS 0x7000936C /end MEASUREMENT
/begin MEASUREMENT ACComp_facCooltFlowQnty "Coefficient for calculating A/C refrigerant flow quantity" SWORD Fact1000 1 100 -32.76800 32.76700 FORMAT "%8.5" ECU_ADDRESS 0x600041DE /end MEASUREMENT
/begin MEASUREMENT ACComp_facEnthpyCorrnA "Enthalpy Correction factor A" SLONG Fact_10000 1 100 -214748.364800 214748.364700 FORMAT "%13.6" ECU_ADDRESS 0x50001018 /end MEASUREMENT
/begin MEASUREMENT ACComp_facEnthpyCorrnB "Enthalpy Correction Factor" SLONG Fact_10000 1 100 -214748.364800 214748.364700 FORMAT "%13.6" ECU_ADDRESS 0x5000101C /end MEASUREMENT
/begin MEASUREMENT ACComp_facHwOffResv "AC HW off torque reserve factor" SWORD fak_q0p01 1 100 0.00 327.6700 FORMAT "%8.4" ECU_ADDRESS 0x600041DC /end MEASUREMENT
/begin MEASUREMENT ACComp_facOutdTAftCorrnA_MP "Calculated outside temperature after correction (A value)" SLONG Fact_10000 1 100 -214748.364800 214748.364700 FORMAT "%13.6" ECU_ADDRESS 0x70009368 /end MEASUREMENT
/begin MEASUREMENT ACComp_facOutdTAftCorrn_MP "Correction term for outside temperature sensor value" SLONG Fact_10000 1 100 -214748.364800 214748.364700 FORMAT "%13.6" ECU_ADDRESS 0x70009364 /end MEASUREMENT
/begin MEASUREMENT ACComp_facPWithCoeffB_MP "AC coolant pressure with Coefficient B" SLONG Fact_10000 1 100 -214748.364800 214748.364700 FORMAT "%13.6" ECU_ADDRESS 0x70009360 /end MEASUREMENT
/begin MEASUREMENT ACComp_facSolCurrCorrn_MP "AC solinoid current correction" SLONG Fact_10000 1 100 -214748.364800 214748.364700 FORMAT "%13.6" ECU_ADDRESS 0x7000935C /end MEASUREMENT
/begin MEASUREMENT ACComp_facSpdWithCoeffA_MP "Engine speed with Coefficient A" SLONG Fact_10000 1 100 -214748.364800 214748.364700 FORMAT "%13.6" ECU_ADDRESS 0x70009358 /end MEASUREMENT
/begin MEASUREMENT ACComp_facTCorrnWithP_MP "Outside temperature correction with pressure" SLONG Fact_10000 1 100 -214748.364800 214748.364700 FORMAT "%13.6" ECU_ADDRESS 0x70009354 /end MEASUREMENT
/begin MEASUREMENT ACComp_facTemp18 "Correction term for enthalpy calculation for variable compressor" SLONG Fact_10000 1 100 -214748.364800 214748.364700 FORMAT "%13.6" ECU_ADDRESS 0x600019CC /end MEASUREMENT
/begin MEASUREMENT ACComp_facTemp21 "Correction term for enthalpy calculation for variable compressor" SLONG Fact_10000 1 100 -214748.364800 214748.364700 FORMAT "%13.6" ECU_ADDRESS 0x600019C8 /end MEASUREMENT
/begin MEASUREMENT ACComp_facTemp25 "Correction term for outside temperature sensor value calculation" SLONG Fact_10000 1 100 -214748.364800 214748.364700 FORMAT "%13.6" ECU_ADDRESS 0x600019C4 /end MEASUREMENT
/begin MEASUREMENT ACComp_facTemp30 "Correction term for outside temperature sensor value calculation" SLONG Fact_10000 1 100 -214748.364800 214748.364700 FORMAT "%13.6" ECU_ADDRESS 0x600019C0 /end MEASUREMENT
/begin MEASUREMENT ACComp_facTrq_MP "AC compressor torque" SLONG Fact_10000 1 100 -214748.364800 214748.364700 FORMAT "%13.6" ECU_ADDRESS 0x70009350 /end MEASUREMENT
/begin MEASUREMENT ACComp_flgACOn_MP "Flag to indicate AC on." UBYTE B_TRUE 1 100 0.00 1.00000000000 BIT_MASK 0x1 FORMAT "%13.11" ECU_ADDRESS 0x7000934C /end MEASUREMENT
/begin MEASUREMENT ACComp_flgFirstStrtUpEnd "Judgement of first starting-up is end" UBYTE B_TRUE 1 100 0.00 1.00000000000 BIT_MASK 0x1 FORMAT "%13.11" ECU_ADDRESS 0x60009CD5 /end MEASUREMENT
/begin MEASUREMENT ACComp_flgFirstStrtUpStart "Judgement of first starting-up is start" UBYTE B_TRUE 1 100 0.00 1.00000000000 BIT_MASK 0x1 FORMAT "%13.11" ECU_ADDRESS 0x60009CD4 /end MEASUREMENT
/begin MEASUREMENT ACComp_flgOutdTFrstCalc "Status of outside temperature first calculation" UBYTE B_TRUE 1 100 0.00 1.00000000000 BIT_MASK 0x1 FORMAT "%13.11" ECU_ADDRESS 0x60009CD3 /end MEASUREMENT
/begin MEASUREMENT ACComp_flgRampDwnActv "downwards torque ramping active" UBYTE B_TRUE 1 100 0.00 1.00000000000 BIT_MASK 0x1 FORMAT "%13.11" ECU_ADDRESS 0x60009CD2 /end MEASUREMENT
/begin MEASUREMENT ACComp_flgRampDwnActv1 "downwards torque ramping active" UBYTE B_TRUE 1 100 0.00 1.00000000000 BIT_MASK 0x1 FORMAT "%13.11" ECU_ADDRESS 0x60009CD1 /end MEASUREMENT
/begin MEASUREMENT ACComp_flgRampUpActv "upwards torque ramping active" UBYTE B_TRUE 1 100 0.00 1.00000000000 BIT_MASK 0x1 FORMAT "%13.11" ECU_ADDRESS 0x60009CD0 /end MEASUREMENT
/begin MEASUREMENT ACComp_flgRampUpActv1 "upwards torque ramping active" UBYTE B_TRUE 1 100 0.00 1.00000000000 BIT_MASK 0x1 FORMAT "%13.11" ECU_ADDRESS 0x60009CCF /end MEASUREMENT
/begin MEASUREMENT ACComp_flgTqOffsVehV "aircondation compressor flag trouqe offset vechical speed" UBYTE B_TRUE 1 100 0.00 1.00000000000 BIT_MASK 0x1 FORMAT "%13.11" ECU_ADDRESS 0x60009CCE /end MEASUREMENT
/begin MEASUREMENT ACComp_flgVblDplCmprJdg "Variable displacement compressor enable flag" UBYTE B_TRUE 1 100 0.00 1.00000000000 BIT_MASK 0x1 FORMAT "%13.11" ECU_ADDRESS 0x6000A27D /end MEASUREMENT
/begin MEASUREMENT ACComp_iCmprSol "Compressor volume control current value" UWORD i_q1_mA 1 100 0.00 65535.00 FORMAT "%8.2" ECU_ADDRESS 0x60004DB6 /end MEASUREMENT
/begin MEASUREMENT ACComp_mCalcdFlowQnty_MP "AC coolant calculated flow quantity" SLONG InjMsPrTime_q0p001_COMPU 1 100 -2147483.64800 2147483.64700 FORMAT "%13.5" ECU_ADDRESS 0x70009348 /end MEASUREMENT
/begin MEASUREMENT ACComp_mCooltFlowQnty "AC refrigerant flow quantity calculated value" SLONG InjMsPrTime_q0p001_COMPU 1 100 -2147483.64800 2147483.64700 FORMAT "%13.5" ECU_ADDRESS 0x50001020 /end MEASUREMENT
/begin MEASUREMENT ACComp_mMinCooltFlowQnty "Minimum refrigerant flow quantity" SWORD O2MassPerTime 1 100 -327.6800 327.6700 FORMAT "%8.4" ECU_ADDRESS 0x600041DA /end MEASUREMENT
/begin MEASUREMENT ACComp_nEngCor_mp "measurement point for corrected engine speed" SWORD EngN 1 100 -16384.00 16383.50 FORMAT "%8.2" ECU_ADDRESS 0x70009346 /end MEASUREMENT
/begin MEASUREMENT ACComp_pACClntpDiff_MP "Difference between pressure at previous AC engagement and current pressure" SWORD PresAC_hPa 1 100 -65536.00 65534.00 FORMAT "%8.2" ECU_ADDRESS 0x70009344 /end MEASUREMENT
/begin MEASUREMENT ACComp_pClnt "AC compressor collant pressure" SWORD RBPtCel_p_1p0_3 1 100 -32768.00 32767.00 FORMAT "%8.2" ECU_ADDRESS 0x600041D8 /end MEASUREMENT
/begin MEASUREMENT ACComp_pClntClthOff "AC coolant pressure when clutch is opened" SWORD PresAC_hPa 1 100 -65536.00 65534.00 FORMAT "%8.2" ECU_ADDRESS 0x600041D6 /end MEASUREMENT
/begin MEASUREMENT ACComp_pClntCtrlVal "PD pressure value for control(absolute pressure)" SWORD RBPtCel_p_1p0_3 1 100 -32768.00 32767.00 FORMAT "%8.2" ECU_ADDRESS 0x600041D4 /end MEASUREMENT
/begin MEASUREMENT ACComp_pLoPVal "Low Pressure value" SWORD RBPtCel_p_1p0_3 1 100 -32768.00 32767.00 FORMAT "%8.2" ECU_ADDRESS 0x60005300 /end MEASUREMENT
/begin MEASUREMENT ACComp_rFanSt "Radiator fan driving mode" SLONG q0p0001_Perc 1 100 -214748.364800 214748.364700 FORMAT "%13.6" ECU_ADDRESS 0x600019BC /end MEASUREMENT
/begin MEASUREMENT ACComp_rFanStCalcdVal "The operating state calculated value of RADCOND FAN" SLONG q0p0001_Perc 1 100 -214748.364800 214748.364700 FORMAT "%13.6" ECU_ADDRESS 0x600019B8 /end MEASUREMENT
/begin MEASUREMENT ACComp_rFanStCorrnVal_MP "Fan state correction value." SLONG q0p0001_Perc 1 100 -214748.364800 214748.364700 FORMAT "%13.6" ECU_ADDRESS 0x70009340 /end MEASUREMENT
/begin MEASUREMENT ACComp_rPrevFanStCalcdVal "The operating state calculated value of RADCOND FAN (last time value)" SLONG q0p0001_Perc 1 100 -214748.364800 214748.364700 FORMAT "%13.6" ECU_ADDRESS 0x600019B4 /end MEASUREMENT
/begin MEASUREMENT ACComp_rPrevStCorrnVal_MP "Fan previous state correction value" SLONG q0p0001_Perc 1 100 -214748.364800 214748.364700 FORMAT "%13.6" ECU_ADDRESS 0x7000933C /end MEASUREMENT
/begin MEASUREMENT ACComp_rWindVWghtAvrg "calculated the wind velocity by weighted average throughout condenser." SWORD Prc_Fact100 1 100 -327.6800 327.6700 FORMAT "%8.4" ECU_ADDRESS 0x600041D2 /end MEASUREMENT
/begin MEASUREMENT ACComp_stFanStInitCalcn "Finishing of the initial calculation of a RAD/COND FAN operating state by 1." UBYTE B_TRUE 1 100 0.00 1.00000000000 BIT_MASK 0x1 FORMAT "%13.11" ECU_ADDRESS 0x60009CCD /end MEASUREMENT
/begin MEASUREMENT ACCOmp_stOutdTActvCdn_MP "Status for enabling outside temperature calculation preparation" UBYTE B_TRUE 1 100 0.00 1.00000000000 BIT_MASK 0x1 FORMAT "%13.11" ECU_ADDRESS 0x70009339 /end MEASUREMENT
/begin MEASUREMENT ACComp_stOutdTCalcnPrms "Status for enabling outside temperature calculation permission" UBYTE B_TRUE 1 100 0.00 1.00000000000 BIT_MASK 0x1 FORMAT "%13.11" ECU_ADDRESS 0x60009CCC /end MEASUREMENT
/begin MEASUREMENT ACComp_stTrqCalcnEna_MP "Status of AC compressor torque calculation enable" UBYTE B_TRUE 1 100 0.00 1.00000000000 BIT_MASK 0x1 FORMAT "%13.11" ECU_ADDRESS 0x70009338 /end MEASUREMENT
/begin MEASUREMENT ACComp_stVehSpdTmrRst "Status of Vehicle speed timer reset at 0." UBYTE B_TRUE 1 100 0.00 1.00000000000 BIT_MASK 0x1 FORMAT "%13.11" ECU_ADDRESS 0x60009CCB /end MEASUREMENT
/begin MEASUREMENT ACComp_tActOutdT "Outside temperature(actual value)" SWORD Temp_Cels 1 100 -3549.940 3003.560 FORMAT "%8.3" ECU_ADDRESS 0x600041D0 /end MEASUREMENT
/begin MEASUREMENT ACComp_tCalcdIdleOutdT "Outside temperature (Correction term of RAD/COND FAN, ACPDABS)" SWORD Temp_Cels 1 100 -3549.940 3003.560 FORMAT "%8.3" ECU_ADDRESS 0x600041CE /end MEASUREMENT
/begin MEASUREMENT ACComp_tCalcdOutdT "Outside temperature(Finishing of processing)" SWORD Temp_Cels 1 100 -3549.940 3003.560 FORMAT "%8.3" ECU_ADDRESS 0x60037EB8 /end MEASUREMENT
/begin MEASUREMENT ACComp_tCmprEnthIdealAdbt "Compressor enthalpy at AC ideal adiabatic" SWORD RBPtCel_t_0p01_2 1 100 -327.6800 327.6700 FORMAT "%8.4" ECU_ADDRESS 0x600041CC /end MEASUREMENT
/begin MEASUREMENT ACComp_tCooltSatnT "AC coolant saturation temperature" SWORD Temp_Cels 1 100 -3549.940 3003.560 FORMAT "%8.3" ECU_ADDRESS 0x600041CA /end MEASUREMENT
/begin MEASUREMENT ACComp_tiACOffTime "duration since last AC off detected" SWORD t_q0p02 1 100 -655.3600 655.3400 FORMAT "%8.4" ECU_ADDRESS 0x600041C8 /end MEASUREMENT
/begin MEASUREMENT ACComp_tiCmprStrtPClnt "AC variable volume compressor start-up time based on coolant pressure" SWORD Time_ms 1 100 -327680.0 327670.0 FORMAT "%8.1" ECU_ADDRESS 0x600041C6 /end MEASUREMENT
/begin MEASUREMENT ACComp_tiCmprStrtUp1 "AC variable volume compressor start-up time." SWORD Time_ms 1 100 -327680.0 327670.0 FORMAT "%8.1" ECU_ADDRESS 0x600041C4 /end MEASUREMENT
/begin MEASUREMENT ACComp_tiCmprVolCtrlStrt "The time of a compressor volume control is start" SWORD Time_ms 1 100 -327680.0 327670.0 FORMAT "%8.1" ECU_ADDRESS 0x600041C2 /end MEASUREMENT
/begin MEASUREMENT ACComp_tiOnDlyT1 "Delay time after AC ON from which torque offset starts ramping up" SWORD t_q0p02 1 100 -655.3600 655.3400 FORMAT "%8.4" ECU_ADDRESS 0x600041C0 /end MEASUREMENT
/begin MEASUREMENT ACComp_tiOnDlyT2 "Delay time after AC ON from which torque offset starts ramping down" SWORD t_q0p02 1 100 -655.3600 655.3400 FORMAT "%8.4" ECU_ADDRESS 0x600041BE /end MEASUREMENT
/begin MEASUREMENT ACComp_tiOnDlyT3 "Delay time after AC ON from which torque offset starts ramping up" SWORD t_q0p02 1 100 -655.3600 655.3400 FORMAT "%8.4" ECU_ADDRESS 0x600041BC /end MEASUREMENT
/begin MEASUREMENT ACComp_tiOnDlyT4 "Delay time after AC ON from which torque offset starts ramping up" SWORD t_q0p02 1 100 -655.3600 655.3400 FORMAT "%8.4" ECU_ADDRESS 0x600041BA /end MEASUREMENT
/begin MEASUREMENT ACComp_tOutdT "Outside temperature" SWORD Temp_Cels 1 100 -3549.940 3003.560 FORMAT "%8.3" ECU_ADDRESS 0x600041B8 /end MEASUREMENT
/begin MEASUREMENT ACComp_tqACModel_MP "measurement point for modelled torque without additional offset" SWORD Trq 1 100 -3276.800 3276.700 FORMAT "%8.3" ECU_ADDRESS 0x70009336 /end MEASUREMENT
/begin MEASUREMENT ACComp_tqCmprFullCpTq "The value which presumed AC compressor torque(at 100% volume)" SWORD Trq 1 100 -3276.800 3276.700 FORMAT "%8.3" ECU_ADDRESS 0x600041B6 /end MEASUREMENT
/begin MEASUREMENT ACComp_tqCorrnMax "Interface for torque calculation correction term at Ps control valve (at MAX capacity)" SLONG Trq 1 100 -214748364.800 214748364.700 FORMAT "%13.3" ECU_ADDRESS 0x600019B0 /end MEASUREMENT
/begin MEASUREMENT ACComp_tqEstimd1TqStat "Estimated AC compressor torque. (stagnation term)" SWORD Trq 1 100 -3276.800 3276.700 FORMAT "%8.3" ECU_ADDRESS 0x600041B4 /end MEASUREMENT
/begin MEASUREMENT ACComp_tqEstimd2TqStrt "Estimated AC compressor torque. (start-up term)" SWORD Trq 1 100 -3276.800 3276.700 FORMAT "%8.3" ECU_ADDRESS 0x600041B2 /end MEASUREMENT
/begin MEASUREMENT ACComp_tqEstimdACCmpr "Estimated AC compressor torque" SWORD Trq 1 100 -3276.800 3276.700 FORMAT "%8.3" ECU_ADDRESS 0x600041B0 /end MEASUREMENT
/begin MEASUREMENT ACComp_tqEvaprSnsrValB "Interface for calculating Evaporator torque at Ps control valve(B term)" SWORD Trq 1 100 -3276.800 3276.700 FORMAT "%8.3" ECU_ADDRESS 0x600041AE /end MEASUREMENT
/begin MEASUREMENT ACComp_tqEvaprSnsrValC "Interface for calculating Evaporator torque in the time of compressor MAX capacity (C term)" SWORD Trq 1 100 -3276.800 3276.700 FORMAT "%8.3" ECU_ADDRESS 0x600041AC /end MEASUREMENT
/begin MEASUREMENT ACComp_tqEvaprTCorrn "Interface for EVA temperature torque calculation correction term in Ps control valve" SLONG Trq 1 100 -214748364.800 214748364.700 FORMAT "%13.3" ECU_ADDRESS 0x600019AC /end MEASUREMENT
/begin MEASUREMENT ACComp_tqHardTmp "AC off hard temporary torque reserve" SWORD Trq 1 100 -3276.800 3276.700 FORMAT "%8.3" ECU_ADDRESS 0x600041AA /end MEASUREMENT
/begin MEASUREMENT ACComp_tqHwOffResv "AC HW off torque reserve" SWORD Trq 1 100 -3276.800 3276.700 FORMAT "%8.3" ECU_ADDRESS 0x600041A8 /end MEASUREMENT
/begin MEASUREMENT ACComp_tqOffsFinal "final calculated torque" SWORD Trq 1 100 -3276.800 3276.700 FORMAT "%8.3" ECU_ADDRESS 0x600041A6 /end MEASUREMENT
/begin MEASUREMENT ACComp_tqOffsFinal1 "final calculated torque" SWORD Trq 1 100 -3276.800 3276.700 FORMAT "%8.3" ECU_ADDRESS 0x600041A4 /end MEASUREMENT
/begin MEASUREMENT ACComp_tqOffsReqd "Offset torque pre ramped value" SWORD Trq 1 100 -3276.800 3276.700 FORMAT "%8.3" ECU_ADDRESS 0x600041A2 /end MEASUREMENT
/begin MEASUREMENT ACComp_tqOffsReqd1 "final calculated torque" SWORD Trq 1 100 -3276.800 3276.700 FORMAT "%8.3" ECU_ADDRESS 0x600041A0 /end MEASUREMENT
/begin MEASUREMENT ACComp_tqPSnsrCtrlValTq "Torque calculated value by Ps control value" SWORD Trq 1 100 -3276.800 3276.700 FORMAT "%8.3" ECU_ADDRESS 0x6000419E /end MEASUREMENT
/begin MEASUREMENT ACComp_tqStrtgCtrlCmprTq "The value which presumed AC compressor torque(at starting control)" SWORD Trq 1 100 -3276.800 3276.700 FORMAT "%8.3" ECU_ADDRESS 0x6000419C /end MEASUREMENT
/begin MEASUREMENT ACComp_tqSwOffResv "AC Off torque reserve" SWORD Trq 1 100 -3276.800 3276.700 FORMAT "%8.3" ECU_ADDRESS 0x6000419A /end MEASUREMENT
/begin MEASUREMENT ACComp_trqDesFltAbv_mp "desired torque filtered" SWORD Trq 1 100 -3276.800 3276.700 FORMAT "%8.3" ECU_ADDRESS 0x70009334 /end MEASUREMENT
/begin MEASUREMENT ACComp_trqDesFlt_mp "desired torque filtered" SWORD Trq 1 100 -3276.800 3276.700 FORMAT "%8.3" ECU_ADDRESS 0x70009332 /end MEASUREMENT
/begin MEASUREMENT ACComp_trqDyn_mp "dynamic torque" SWORD Trq 1 100 -3276.800 3276.700 FORMAT "%8.3" ECU_ADDRESS 0x70009330 /end MEASUREMENT
/begin MEASUREMENT ACComp_trqOffsRamped "Offset torque after ramping" SWORD Trq 1 100 -3276.800 3276.700 FORMAT "%8.3" ECU_ADDRESS 0x60004198 /end MEASUREMENT
/begin MEASUREMENT ACComp_trqOffsRamped1 "Offset torque after ramping" SWORD Trq 1 100 -3276.800 3276.700 FORMAT "%8.3" ECU_ADDRESS 0x60004196 /end MEASUREMENT
/begin MEASUREMENT ACComp_trqStat "Static AC compressor torque" SWORD Trq 1 100 -3276.800 3276.700 FORMAT "%8.3" ECU_ADDRESS 0x600052FE /end MEASUREMENT
/begin MEASUREMENT ACComp_tSeldTrqOffs "Air Condation compressor time selected troque off set" SWORD Temp_Cels 1 100 -3549.940 3003.560 FORMAT "%8.3" ECU_ADDRESS 0x60004194 /end MEASUREMENT
/begin MEASUREMENT ACComp_tVblCpCmprEnth "AC variable capacity Compressor enthalpy" SLONG RBPtCel_t_0p0001_1 1 100 -214748.364800 214748.364700 FORMAT "%13.6" ECU_ADDRESS 0x50001024 /end MEASUREMENT
/begin MEASUREMENT AccPed_cntrPostDrvLve "AccPed counter post drive leave" UBYTE OneToOne 1 100 0.00 255.0 FORMAT "%5.1" ECU_ADDRESS 0x60009CC9 /end MEASUREMENT
/begin MEASUREMENT AccPed_facAppMaxCmp "Compensation factor based on the driver demand" SWORD Fact 1 100 -4.000000 3.999878 FORMAT "%8.6" ECU_ADDRESS 0x60004192 /end MEASUREMENT
/begin MEASUREMENT AccPed_facCompAcs "Compensation factor for loss compensation" SWORD Fact 1 100 -4.000000 3.999878 FORMAT "%8.6" ECU_ADDRESS 0x600052A2 /end MEASUREMENT
/begin MEASUREMENT AccPed_facModSwt "Factor for ramping of torque value during change in drive mode" SLONG Fact 1 100 -262144.000000 262143.999878 FORMAT "%13.6" ECU_ADDRESS 0x60001D6C /end MEASUREMENT
/begin MEASUREMENT AccPed_facModSwtStep "Factor for step change in slope used for ramping of torque during change in drive mode" SLONG Fact 1 100 -262144.000000 262143.999878 FORMAT "%13.6" ECU_ADDRESS 0x6000199C /end MEASUREMENT
/begin MEASUREMENT AccPed_flgChgGearDetn "Flag of gear change detection" UBYTE B_TRUE 1 100 0.00 1.00000000000 BIT_MASK 0x1 FORMAT "%13.11" ECU_ADDRESS 0x6000A24E /end MEASUREMENT
/begin MEASUREMENT AccPed_flgDrvModChg "Flag indicating driver mode change" UBYTE B_TRUE 1 100 0.00 1.00000000000 BIT_MASK 0x1 FORMAT "%13.11" ECU_ADDRESS 0x6000A24D /end MEASUREMENT
/begin MEASUREMENT AccPed_flgIDSDrvModFailr "Status of system failure detection for IDS inhibition" UBYTE B_TRUE 1 100 0.00 1.00000000000 BIT_MASK 0x1 FORMAT "%13.11" ECU_ADDRESS 0x6000A24C /end MEASUREMENT
/begin MEASUREMENT AccPed_flgIDSDrvModTmpInhb "IDS temporary inhibit flag" UBYTE B_TRUE 1 100 0.00 1.00000000000 BIT_MASK 0x1 FORMAT "%13.11" ECU_ADDRESS 0x6000A24B /end MEASUREMENT
/begin MEASUREMENT AccPed_nMax "Maximum engine speed in case of an accelerator pedal error" SWORD EngN 1 100 -16384.00 16383.50 FORMAT "%8.2" ECU_ADDRESS 0x600052A0 /end MEASUREMENT
/begin MEASUREMENT AccPed_nMin "Low idle setpoint on acceleration pedal error" SWORD EngN 1 100 -16384.00 16383.50 FORMAT "%8.2" ECU_ADDRESS 0x6000529E /end MEASUREMENT
/begin MEASUREMENT AccPed_nrGearFildTmp "Filtered current gear information" UBYTE OneToOne 1 100 0.00 255.0 FORMAT "%5.1" ECU_ADDRESS 0x6000A6B7 /end MEASUREMENT
/begin MEASUREMENT AccPed_nrGearFildTmpPrev "Previous value of Filtered current gear information" UBYTE OneToOne 1 100 0.00 255.0 FORMAT "%5.1" ECU_ADDRESS 0x6000A6B6 /end MEASUREMENT
/begin MEASUREMENT AccPed_rTrq "Total drive train ratio of engine - wheel" SWORD TransR 1 100 -327.6800 327.6700 FORMAT "%8.4" ECU_ADDRESS 0x6000529C /end MEASUREMENT
/begin MEASUREMENT AccPed_stDrvModPrev "Previous drive mode information used as reference to calculate old torque and to ramp to new torque based on new driving mode" UBYTE OneToOne 1 100 0.00 255.0 FORMAT "%5.1" ECU_ADDRESS 0x6000A6B5 /end MEASUREMENT
/begin MEASUREMENT AccPed_stNSetP "Status of engine speed demand of driver demand interpretation" UBYTE OneToOne 1 100 0.00 255.0 FORMAT "%5.1" ECU_ADDRESS 0x6000A6B4 /end MEASUREMENT
/begin MEASUREMENT AccPed_stRampActv "Ramping active" UBYTE B_TRUE 1 100 0.00 1.00000000000 BIT_MASK 0x1 FORMAT "%13.11" ECU_ADDRESS 0x60009CC8 /end MEASUREMENT
/begin MEASUREMENT AccPed_stVirtAppUsg "Condition to select input of Dynamic factor for driver demand" UBYTE B_TRUE 1 100 0.00 1.00000000000 BIT_MASK 0x1 FORMAT "%13.11" ECU_ADDRESS 0x60009CCA /end MEASUREMENT
/begin MEASUREMENT AccPed_swtDrvMod "Drive mode selection switch" UBYTE OneToOne 1 100 0.00 255.0 FORMAT "%5.1" ECU_ADDRESS 0x60037F05 /end MEASUREMENT
/begin MEASUREMENT AccPed_swtDrvModCpl "DriveMode cpl for monitoring" UBYTE OneToOne 1 100 0.00 255.0 FORMAT "%5.1" ECU_ADDRESS 0x6000A6B3 /end MEASUREMENT
/begin MEASUREMENT AccPed_swtDrvModPrev "Previous drive mode selection switch information" UBYTE OneToOne 1 100 0.00 255.0 FORMAT "%5.1" ECU_ADDRESS 0x6000A6B2 /end MEASUREMENT
/begin MEASUREMENT AccPed_tqBasDif "Torque base difference" SWORD Trq 1 100 -3276.800 3276.700 FORMAT "%8.3" ECU_ADDRESS 0x6000418C /end MEASUREMENT
/begin MEASUREMENT AccPed_tqBasFild "Torque base filtered" SWORD Trq 1 100 -3276.800 3276.700 FORMAT "%8.3" ECU_ADDRESS 0x6000418A /end MEASUREMENT
/begin MEASUREMENT AccPed_tqBasMod1 "Torque base mode 1" SWORD Trq 1 100 -3276.800 3276.700 FORMAT "%8.3" ECU_ADDRESS 0x60004188 /end MEASUREMENT
/begin MEASUREMENT AccPed_tqBasMod1MT "Torque base mode 1 MT" SWORD Trq 1 100 -3276.800 3276.700 FORMAT "%8.3" ECU_ADDRESS 0x60004186 /end MEASUREMENT
/begin MEASUREMENT AccPed_tqBasMod2 "Torque base mode 2" SWORD Trq 1 100 -3276.800 3276.700 FORMAT "%8.3" ECU_ADDRESS 0x60004184 /end MEASUREMENT
/begin MEASUREMENT AccPed_tqBasModNew "New base mode torque" SWORD Trq 1 100 -3276.800 3276.700 FORMAT "%8.3" ECU_ADDRESS 0x60004182 /end MEASUREMENT
/begin MEASUREMENT AccPed_tqBasModOld "Old base mode torque" SWORD Trq 1 100 -3276.800 3276.700 FORMAT "%8.3" ECU_ADDRESS 0x60004180 /end MEASUREMENT
/begin MEASUREMENT AccPed_tqBasUnfild "Torque base unfiltered" SWORD Trq 1 100 -3276.800 3276.700 FORMAT "%8.3" ECU_ADDRESS 0x6000417E /end MEASUREMENT
/begin MEASUREMENT AccPed_tqCmpLossSum "Total losses (Inclusive of switchable and non-switchable losses) after compensation" SWORD Trq 1 100 -3276.800 3276.700 FORMAT "%8.3" ECU_ADDRESS 0x60004190 /end MEASUREMENT
/begin MEASUREMENT AccPed_tqCmpNotSwilLoss "Loss compensated non-switchable losses" SLONG TrqPrpHigh 1 100 -214748364.800 214748364.700 FORMAT "%13.3" ECU_ADDRESS 0x600019A8 /end MEASUREMENT
/begin MEASUREMENT AccPed_tqCmpSwilLoss "Switchable losses" SLONG Trq 1 100 -214748364.800 214748364.700 FORMAT "%13.3" ECU_ADDRESS 0x600019A4 /end MEASUREMENT
/begin MEASUREMENT AccPed_tqCvtEcoEng0 "CVT eco mode torque 0" SWORD Trq 1 100 -3276.800 3276.700 FORMAT "%8.3" ECU_ADDRESS 0x6000417C /end MEASUREMENT
/begin MEASUREMENT AccPed_tqCvtEcoEng1 "CVT eco mode torque 1" SWORD Trq 1 100 -3276.800 3276.700 FORMAT "%8.3" ECU_ADDRESS 0x6000417A /end MEASUREMENT
/begin MEASUREMENT AccPed_tqCvtEcoEng12 "CVT eco mode torque 12" SWORD Trq 1 100 -3276.800 3276.700 FORMAT "%8.3" ECU_ADDRESS 0x60004178 /end MEASUREMENT
/begin MEASUREMENT AccPed_tqCvtEcoEng2 "CVT eco mode torque 2" SWORD Trq 1 100 -3276.800 3276.700 FORMAT "%8.3" ECU_ADDRESS 0x60004176 /end MEASUREMENT
/begin MEASUREMENT AccPed_tqCvtEcoEng23 "CVT eco mode torque 23" SWORD Trq 1 100 -3276.800 3276.700 FORMAT "%8.3" ECU_ADDRESS 0x60004174 /end MEASUREMENT
/begin MEASUREMENT AccPed_tqCvtEcoEng3 "CVT eco mode torque 3" SWORD Trq 1 100 -3276.800 3276.700 FORMAT "%8.3" ECU_ADDRESS 0x60004172 /end MEASUREMENT
/begin MEASUREMENT AccPed_tqCvtEcoEng34 "CVT eco mode torque 34" SWORD Trq 1 100 -3276.800 3276.700 FORMAT "%8.3" ECU_ADDRESS 0x60004170 /end MEASUREMENT
/begin MEASUREMENT AccPed_tqCvtEcoEng4 "CVT eco mode torque 4" SWORD Trq 1 100 -3276.800 3276.700 FORMAT "%8.3" ECU_ADDRESS 0x6000416E /end MEASUREMENT
/begin MEASUREMENT AccPed_tqCvtEcoEng45 "CVT eco mode torque 45" SWORD Trq 1 100 -3276.800 3276.700 FORMAT "%8.3" ECU_ADDRESS 0x6000416C /end MEASUREMENT
/begin MEASUREMENT AccPed_tqCvtEcoEng5 "CVT eco mode torque 5" SWORD Trq 1 100 -3276.800 3276.700 FORMAT "%8.3" ECU_ADDRESS 0x6000416A /end MEASUREMENT
/begin MEASUREMENT AccPed_tqCvtEcoEng56 "CVT eco mode torque 56" SWORD Trq 1 100 -3276.800 3276.700 FORMAT "%8.3" ECU_ADDRESS 0x60004168 /end MEASUREMENT
/begin MEASUREMENT AccPed_tqCvtEcoEng6 "CVT eco mode torque 6" SWORD Trq 1 100 -3276.800 3276.700 FORMAT "%8.3" ECU_ADDRESS 0x60004166 /end MEASUREMENT
/begin MEASUREMENT AccPed_tqCvtEcoEng67 "CVT eco mode torque 67" SWORD Trq 1 100 -3276.800 3276.700 FORMAT "%8.3" ECU_ADDRESS 0x60004164 /end MEASUREMENT
/begin MEASUREMENT AccPed_tqCvtEcoEng7 "CVT eco mode torque 7" SWORD Trq 1 100 -3276.800 3276.700 FORMAT "%8.3" ECU_ADDRESS 0x60004162 /end MEASUREMENT
/begin MEASUREMENT AccPed_tqCvtEcoEng78 "CVT eco mode torque 78" SWORD Trq 1 100 -3276.800 3276.700 FORMAT "%8.3" ECU_ADDRESS 0x60004160 /end MEASUREMENT
/begin MEASUREMENT AccPed_tqCvtEcoEng8 "CVT eco mode torque 8" SWORD Trq 1 100 -3276.800 3276.700 FORMAT "%8.3" ECU_ADDRESS 0x6000415E /end MEASUREMENT
/begin MEASUREMENT AccPed_tqCVTEng0 "Driver demanded torque for gear0 for CVT transmission" SWORD Trq 1 100 -3276.800 3276.700 FORMAT "%8.3" ECU_ADDRESS 0x6000529A /end MEASUREMENT
/begin MEASUREMENT AccPed_tqCVTEng1 "Driver demanded torque for gear1 for CVT transmission" SWORD Trq 1 100 -3276.800 3276.700 FORMAT "%8.3" ECU_ADDRESS 0x60005298 /end MEASUREMENT
/begin MEASUREMENT AccPed_tqCVTEng12 "Driver demanded torque for gear1 for CVT transmission" SWORD Trq 1 100 -3276.800 3276.700 FORMAT "%8.3" ECU_ADDRESS 0x6000415C /end MEASUREMENT
/begin MEASUREMENT AccPed_tqCVTEng2 "Driver demanded torque for gear2 for CVT transmission" SWORD Trq 1 100 -3276.800 3276.700 FORMAT "%8.3" ECU_ADDRESS 0x60005296 /end MEASUREMENT
/begin MEASUREMENT AccPed_tqCVTEng23 "Driver demanded torque for gear2 for CVT transmission" SWORD Trq 1 100 -3276.800 3276.700 FORMAT "%8.3" ECU_ADDRESS 0x6000415A /end MEASUREMENT
/begin MEASUREMENT AccPed_tqCVTEng3 "Driver demanded torque for gear3 for CVT transmission" SWORD Trq 1 100 -3276.800 3276.700 FORMAT "%8.3" ECU_ADDRESS 0x60005294 /end MEASUREMENT
/begin MEASUREMENT AccPed_tqCVTEng34 "Driver demanded torque for gear3 for CVT transmission" SWORD Trq 1 100 -3276.800 3276.700 FORMAT "%8.3" ECU_ADDRESS 0x60004158 /end MEASUREMENT
/begin MEASUREMENT AccPed_tqCVTEng4 "Driver demanded torque for gear4 for CVT transmission" SWORD Trq 1 100 -3276.800 3276.700 FORMAT "%8.3" ECU_ADDRESS 0x60005292 /end MEASUREMENT
/begin MEASUREMENT AccPed_tqCVTEng45 "Driver demanded torque for gear4 for CVT transmission" SWORD Trq 1 100 -3276.800 3276.700 FORMAT "%8.3" ECU_ADDRESS 0x60004156 /end MEASUREMENT
/begin MEASUREMENT AccPed_tqCVTEng5 "Driver demanded torque for gear5 for CVT transmission" SWORD Trq 1 100 -3276.800 3276.700 FORMAT "%8.3" ECU_ADDRESS 0x60005290 /end MEASUREMENT
/begin MEASUREMENT AccPed_tqCVTEng56 "Driver demanded torque for gear5 for CVT transmission" SWORD Trq 1 100 -3276.800 3276.700 FORMAT "%8.3" ECU_ADDRESS 0x60004154 /end MEASUREMENT
/begin MEASUREMENT AccPed_tqCVTEng6 "Driver demanded torque for gear6 for CVT transmission" SWORD Trq 1 100 -3276.800 3276.700 FORMAT "%8.3" ECU_ADDRESS 0x6000528E /end MEASUREMENT
/begin MEASUREMENT AccPed_tqCVTEng67 "Driver demanded torque for gear6 for CVT transmission" SWORD Trq 1 100 -3276.800 3276.700 FORMAT "%8.3" ECU_ADDRESS 0x60004152 /end MEASUREMENT
/begin MEASUREMENT AccPed_tqCVTEng7 "Driver demanded torque for gear7 for CVT transmission" SWORD Trq 1 100 -3276.800 3276.700 FORMAT "%8.3" ECU_ADDRESS 0x6000528C /end MEASUREMENT
/begin MEASUREMENT AccPed_tqCVTEng78 "Driver demanded torque for gear7 for CVT transmission" SWORD Trq 1 100 -3276.800 3276.700 FORMAT "%8.3" ECU_ADDRESS 0x60004150 /end MEASUREMENT
/begin MEASUREMENT AccPed_tqCVTEng8 "Driver demanded torque for gear8 for CVT transmission" SWORD Trq 1 100 -3276.800 3276.700 FORMAT "%8.3" ECU_ADDRESS 0x6000528A /end MEASUREMENT
/begin MEASUREMENT AccPed_tqDesTmp "Desired driver demand (after loss compensation and E-Motor drag if applicable)" SLONG TrqPrpHigh 1 100 -214748364.800 214748364.700 FORMAT "%13.3" ECU_ADDRESS 0x50001030 /end MEASUREMENT
/begin MEASUREMENT AccPed_tqGearDesCVT "Driver demanded torque for CVT transmission" SWORD Trq 1 100 -3276.800 3276.700 FORMAT "%8.3" ECU_ADDRESS 0x6000414E /end MEASUREMENT
/begin MEASUREMENT AccPed_tqGearDesMT "Driver demanded torque for MT transmission" SWORD Trq 1 100 -3276.800 3276.700 FORMAT "%8.3" ECU_ADDRESS 0x6000414C /end MEASUREMENT
/begin MEASUREMENT AccPed_tqGearMod1CVT "CVT gear mode 1 torque" SWORD Trq 1 100 -3276.800 3276.700 FORMAT "%8.3" ECU_ADDRESS 0x6000414A /end MEASUREMENT
/begin MEASUREMENT AccPed_tqLossSum "Total losses (Inclusive of switchable and non-switchable losses) before compensation" SLONG TrqPrpHigh 1 100 -214748364.800 214748364.700 FORMAT "%13.3" ECU_ADDRESS 0x600019A0 /end MEASUREMENT
/begin MEASUREMENT AccPed_tqMapBasd "Map-based driver demanded torque" SWORD Trq 1 100 -3276.800 3276.700 FORMAT "%8.3" ECU_ADDRESS 0x60005288 /end MEASUREMENT
/begin MEASUREMENT AccPed_tqNewTmp "Temporary value of torque based on current drive mode" SWORD Trq 1 100 -3276.800 3276.700 FORMAT "%8.3" ECU_ADDRESS 0x60004148 /end MEASUREMENT
/begin MEASUREMENT AccPed_tqNotSwilLoss "Non-switchable losses" SLONG TrqPrpHigh 1 100 -214748364.800 214748364.700 FORMAT "%13.3" ECU_ADDRESS 0x50001034 /end MEASUREMENT
/begin MEASUREMENT AccPed_tqOldTmp "Temporary value of torque based on previous drive mode" SWORD Trq 1 100 -3276.800 3276.700 FORMAT "%8.3" ECU_ADDRESS 0x60004146 /end MEASUREMENT
/begin MEASUREMENT AccPed_tqPullInrCmp "Loss compensated Driver demanded pull torque at inner level" SLONG TrqPrpHigh 1 100 -214748364.800 214748364.700 FORMAT "%13.3" ECU_ADDRESS 0x50001038 /end MEASUREMENT
/begin MEASUREMENT AccPed_tqWoCtOff "Accped based offset torque when there is no fuel cut-off for stable combustion" SWORD Trq 1 100 -3276.800 3276.700 FORMAT "%8.3" ECU_ADDRESS 0x6000418E /end MEASUREMENT
/begin MEASUREMENT AccPed_trqBasPrev "Previous calculation of basic request desired torque for iMT" SWORD Trq 1 100 -3276.800 3276.700 FORMAT "%8.3" ECU_ADDRESS 0x60004144 /end MEASUREMENT
/begin MEASUREMENT AccPed_trqDes "driver torque value of propulsion after step limitation" SLONG TrqPrpHigh 1 100 -214748364.800 214748364.700 FORMAT "%13.3" ECU_ADDRESS 0x50004BBC /end MEASUREMENT
/begin MEASUREMENT AccPed_trqDesPull "Drivers demand in pull mode for desired value" SLONG TrqPrpHigh 1 100 -214748364.800 214748364.700 FORMAT "%13.3" ECU_ADDRESS 0x50004BC0 /end MEASUREMENT
/begin MEASUREMENT AccPed_trqLimMax "Maximum wheel torque in case of accelerator pedal error" SLONG TrqPrpHigh 1 100 -214748364.800 214748364.700 FORMAT "%13.3" ECU_ADDRESS 0x50004BC4 /end MEASUREMENT
/begin MEASUREMENT ACCtl_drAccPedStrtCut "Acceleration pedal position deviation for AC shut off at vehicle start condition" SWORD Prc 1 100 -400.0000 399.9878 FORMAT "%8.4" ECU_ADDRESS 0x60004142 /end MEASUREMENT
/begin MEASUREMENT ACCtl_facACLoPDwnCorrVal_MP "AC compressor control current correction value" SLONG Fact1000 1 100 -2147483.64800 2147483.64700 FORMAT "%13.5" ECU_ADDRESS 0x7000932C /end MEASUREMENT
/begin MEASUREMENT ACCtl_facACTqDwnCorrVal_MP "AC torque down control value correction factor" SLONG RBPtCel_Tq2Fact_q0p001 1 100 -2147483.64800 2147483.64700 FORMAT "%13.5" ECU_ADDRESS 0x70009328 /end MEASUREMENT
/begin MEASUREMENT ACCtl_flgACCutEnaCdn "AC cut Enable condition flag" UBYTE B_TRUE 1 100 0.00 1.00000000000 BIT_MASK 0x1 FORMAT "%13.11" ECU_ADDRESS 0x60009CC7 /end MEASUREMENT
/begin MEASUREMENT Acctl_flgACCutEnaSts "flag for AC cut enable status" UBYTE B_TRUE 1 100 0.00 1.00000000000 BIT_MASK 0x1 FORMAT "%13.11" ECU_ADDRESS 0x60009CC6 /end MEASUREMENT
/begin MEASUREMENT ACCtl_flgACCutExe "AC cut execution flag" UBYTE B_TRUE 1 100 0.00 1.00000000000 BIT_MASK 0x1 FORMAT "%13.11" ECU_ADDRESS 0x60009CC5 /end MEASUREMENT
/begin MEASUREMENT ACCtl_flgAcCutOperRep "Flag indicate AC cut and operate repeat during uphill" UBYTE B_TRUE 1 100 0.00 1.00000000000 BIT_MASK 0x1 FORMAT "%13.11" ECU_ADDRESS 0x60009CC4 /end MEASUREMENT
/begin MEASUREMENT ACCtl_flgACCutPrms "AC cut permission judgement flag" UBYTE B_TRUE 1 100 0.00 1.00000000000 BIT_MASK 0x1 FORMAT "%13.11" ECU_ADDRESS 0x6000A27C /end MEASUREMENT
/begin MEASUREMENT ACCtl_flgAcCutStep2Prfm "AC cut during hill climbing step 2 aquisition" UBYTE B_TRUE 1 100 0.00 1.00000000000 BIT_MASK 0x1 FORMAT "%13.11" ECU_ADDRESS 0x60009CC3 /end MEASUREMENT
/begin MEASUREMENT ACCtl_flgACDwnExe "AC Torque down execution flag" UBYTE B_TRUE 1 100 0.00 1.00000000000 BIT_MASK 0x1 FORMAT "%13.11" ECU_ADDRESS 0x6000A27B /end MEASUREMENT
/begin MEASUREMENT ACCtl_flgACOnCdnTCU "AC On Condition to TCU" UBYTE B_TRUE 1 100 0.00 1.00000000000 BIT_MASK 0x1 FORMAT "%13.11" ECU_ADDRESS 0x6000A27A /end MEASUREMENT
/begin MEASUREMENT ACCtl_flgACReq "Status flag for AC Request." UBYTE B_TRUE 1 100 0.00 1.00000000000 BIT_MASK 0x1 FORMAT "%13.11" ECU_ADDRESS 0x70000AD3 /end MEASUREMENT
/begin MEASUREMENT ACCtl_flgAcShOffImdt "AC forcibly shut off condition" UBYTE B_TRUE 1 100 0.00 1.00000000000 BIT_MASK 0x1 FORMAT "%13.11" ECU_ADDRESS 0x60009CC2 /end MEASUREMENT
/begin MEASUREMENT ACCtl_flgClmbAcCut "Hill climbing AC shut off condition" UBYTE B_TRUE 1 100 0.00 1.00000000000 BIT_MASK 0x1 FORMAT "%13.11" ECU_ADDRESS 0x60009CC1 /end MEASUREMENT
/begin MEASUREMENT ACCtl_flgClr "FCM clear flag for acctl_demand" UBYTE B_TRUE 1 100 0.00 1.00000000000 BIT_MASK 0x1 FORMAT "%13.11" ECU_ADDRESS 0x60009FDA /end MEASUREMENT
/begin MEASUREMENT ACCtl_flgDecelACCut "Deceleration AC CUT enforcement" UBYTE B_TRUE 1 100 0.00 1.00000000000 BIT_MASK 0x1 FORMAT "%13.11" ECU_ADDRESS 0x6000A279 /end MEASUREMENT
/begin MEASUREMENT ACCtl_flgEngTqDwnReq "Enigne Torque Down request flag" UBYTE B_TRUE 1 100 0.00 1.00000000000 BIT_MASK 0x1 FORMAT "%13.11" ECU_ADDRESS 0x6000A278 /end MEASUREMENT
/begin MEASUREMENT ACCtl_flgEngTqDwnReqEna "Engine Torque down request enable flag" UBYTE B_TRUE 1 100 0.00 1.00000000000 BIT_MASK 0x1 FORMAT "%13.11" ECU_ADDRESS 0x60009CC0 /end MEASUREMENT
/begin MEASUREMENT ACCtl_flgGearShiftDetd "AC ON delay requirement flag when detect gear shifting" UBYTE B_TRUE 1 100 0.00 1.00000000000 BIT_MASK 0x1 FORMAT "%13.11" ECU_ADDRESS 0x60009CBF /end MEASUREMENT
/begin MEASUREMENT ACCtl_flgGearShiftDetdLst "The last value of ACCtl_flgGearShiftDetd" UBYTE B_TRUE 1 100 0.00 1.00000000000 BIT_MASK 0x1 FORMAT "%13.11" ECU_ADDRESS 0x6000A277 /end MEASUREMENT
/begin MEASUREMENT ACCtl_flgHillClmbDet "AC cut during hill climbing step 1 aquisition" UBYTE B_TRUE 1 100 0.00 1.00000000000 BIT_MASK 0x1 FORMAT "%13.11" ECU_ADDRESS 0x60009CBE /end MEASUREMENT
/begin MEASUREMENT ACCtl_flgLoEngNShOff "AC shut off condition at low engine speed" UBYTE B_TRUE 1 100 0.00 1.00000000000 BIT_MASK 0x1 FORMAT "%13.11" ECU_ADDRESS 0x60009CBD /end MEASUREMENT
/begin MEASUREMENT ACCtl_flgMgcOn "Magnet clutch relay on request flag" UBYTE B_TRUE 1 100 0.00 1.00000000000 BIT_MASK 0x1 FORMAT "%13.11" ECU_ADDRESS 0x6000A276 /end MEASUREMENT
/begin MEASUREMENT ACCtl_flgMgcOnDly "Magnet clutch relay delay on request flag" UBYTE B_TRUE 1 100 0.00 1.00000000000 BIT_MASK 0x1 FORMAT "%13.11" ECU_ADDRESS 0x60009CBC /end MEASUREMENT
/begin MEASUREMENT ACCtl_flgSnsrErrStrtCut "AC shut off at vehicle start inhibit condition at sensor defect" UBYTE B_TRUE 1 100 0.00 1.00000000000 BIT_MASK 0x1 FORMAT "%13.11" ECU_ADDRESS 0x6000A275 /end MEASUREMENT
/begin MEASUREMENT ACCtl_flgStrtCut "AC shut off condition at vehicle start" UBYTE B_TRUE 1 100 0.00 1.00000000000 BIT_MASK 0x1 FORMAT "%13.11" ECU_ADDRESS 0x60009CBB /end MEASUREMENT
/begin MEASUREMENT ACCtl_flgStrtCutHi "AC shut off at vehicle start condition activation state in the case of large acceleration pedal position" UBYTE B_TRUE 1 100 0.00 1.00000000000 BIT_MASK 0x1 FORMAT "%13.11" ECU_ADDRESS 0x60009CBA /end MEASUREMENT
/begin MEASUREMENT ACCtl_flgStrtCutInhb "AC shut off at vehicle start inhibit condition by vehicle speed condition" UBYTE B_TRUE 1 100 0.00 1.00000000000 BIT_MASK 0x1 FORMAT "%13.11" ECU_ADDRESS 0x60009CB9 /end MEASUREMENT
/begin MEASUREMENT ACCtl_flgStrtgCpDwnAccrPedl "Accelerator pedel Starting capacity down flag" UBYTE B_TRUE 1 100 0.00 1.00000000000 BIT_MASK 0x1 FORMAT "%13.11" ECU_ADDRESS 0x60009CB8 /end MEASUREMENT
/begin MEASUREMENT ACCtl_flgSwOffResv "Flag of AC off torque reserve" UBYTE B_TRUE 1 100 0.00 1.00000000000 BIT_MASK 0x1 FORMAT "%13.11" ECU_ADDRESS 0x6000A274 /end MEASUREMENT
/begin MEASUREMENT ACCtl_flgSwtAcAndCutCdn "AC switch status and AC shut off condition for AC control" UBYTE B_TRUE 1 100 0.00 1.00000000000 BIT_MASK 0x1 FORMAT "%13.11" ECU_ADDRESS 0x6000A273 /end MEASUREMENT
/begin MEASUREMENT ACCtl_flgVehSpdAcCut "Driving conditions for hill climbing AC cut" UBYTE B_TRUE 1 100 0.00 1.00000000000 BIT_MASK 0x1 FORMAT "%13.11" ECU_ADDRESS 0x60009CB7 /end MEASUREMENT
/begin MEASUREMENT ACCtl_flgVehSpdDetClmb "Detection of hill climb base on vehicle speed." UBYTE B_TRUE 1 100 0.00 1.00000000000 BIT_MASK 0x1 FORMAT "%13.11" ECU_ADDRESS 0x60009CB6 /end MEASUREMENT
/begin MEASUREMENT ACCtl_iCmprDwnIReq "AC compressor down current request" UBYTE RBPtCel_Curr_A_q0p005 1 100 0.00 1.275 FORMAT "%5.3" ECU_ADDRESS 0x6000A6BE /end MEASUREMENT
/begin MEASUREMENT ACCtl_iCmprDwnIReqVal "AC compressor down current request value" SWORD RBPtCel_Curr_mA_q0p01 1 100 -3276.800 3276.700 FORMAT "%8.3" ECU_ADDRESS 0x60004140 /end MEASUREMENT
/begin MEASUREMENT ACCtl_nrAccPedSt "Acceleration pedal state for vehicle start AC shut off condition" UBYTE OneToOne 1 100 0.00 255.0 FORMAT "%5.1" ECU_ADDRESS 0x60009CB5 /end MEASUREMENT
/begin MEASUREMENT ACCtl_nrACCutPrms "AC cut permission count" SWORD OneToOne 1 100 -32768.00 32767.00 FORMAT "%8.2" ECU_ADDRESS 0x600052FC /end MEASUREMENT
/begin MEASUREMENT ACCtl_pACLoPDwnCorrVal_MP "AC low pressure down correction value" SLONG RBPtCel_p_1p0_1 1 100 -2147483648.00 2147483647.00 FORMAT "%13.2" ECU_ADDRESS 0x70009324 /end MEASUREMENT
/begin MEASUREMENT ACCtl_pACLoPFinalVal_MP "AC low pressure final value" SLONG RBPtCel_p_1p0_1 1 100 -2147483648.00 2147483647.00 FORMAT "%13.2" ECU_ADDRESS 0x70009320 /end MEASUREMENT
/begin MEASUREMENT ACCtl_pTqDwnLoPVal "AC low pressure value during torque down" SWORD RBPtCel_p_1p0_1 1 100 -32768.00 32767.00 FORMAT "%8.2" ECU_ADDRESS 0x6000413E /end MEASUREMENT
/begin MEASUREMENT ACCtl_rAppSig "accelerator pedal value after switch" SWORD Prc 1 100 -400.0000 399.9878 FORMAT "%8.4" ECU_ADDRESS 0x600052FA /end MEASUREMENT
/begin MEASUREMENT ACCtl_stACCut "Status of Air Conditioner Cut." SWORD OneToOne 1 100 -32768.00 32767.00 FORMAT "%8.2" ECU_ADDRESS 0x600052F8 /end MEASUREMENT
/begin MEASUREMENT ACCtl_stDecelACCutDmdRst "Deceleration AC CUT demand reset value" UBYTE B_TRUE 1 100 0.00 1.00000000000 BIT_MASK 0x1 FORMAT "%13.11" ECU_ADDRESS 0x60009CB4 /end MEASUREMENT
/begin MEASUREMENT ACCtl_stDecelACCutPrms "Deceleration AC CUT permission time" UBYTE B_TRUE 1 100 0.00 1.00000000000 BIT_MASK 0x1 FORMAT "%13.11" ECU_ADDRESS 0x60009CB3 /end MEASUREMENT
/begin MEASUREMENT ACCtl_stEngFullOpenSts "Engine full open status" UBYTE B_TRUE 1 100 0.00 1.00000000000 BIT_MASK 0x1 FORMAT "%13.11" ECU_ADDRESS 0x60009CB2 /end MEASUREMENT
/begin MEASUREMENT ACCtl_stEvapTACShOff_mp "Measuring point indicating the status of Evaporator Temperature AC shut off condition" UBYTE B_TRUE 1 100 0.00 1.00000000000 BIT_MASK 0x1 FORMAT "%13.11" ECU_ADDRESS 0x7000931E /end MEASUREMENT
/begin MEASUREMENT ACCtl_stFinshdACCutEnf "Finishing status of the Deceleration AC CUT enforcement" UBYTE B_TRUE 1 100 0.00 1.00000000000 BIT_MASK 0x1 FORMAT "%13.11" ECU_ADDRESS 0x60009CB1 /end MEASUREMENT
/begin MEASUREMENT ACCtl_stInhbACCutPrms "AC cut premission inhibit status" UBYTE B_TRUE 1 100 0.00 1.00000000000 BIT_MASK 0x1 FORMAT "%13.11" ECU_ADDRESS 0x60009CB0 /end MEASUREMENT
/begin MEASUREMENT ACCtl_stInhbACCutPrmsACOn "AC cut premission on inhibit status" UBYTE B_TRUE 1 100 0.00 1.00000000000 BIT_MASK 0x1 FORMAT "%13.11" ECU_ADDRESS 0x60009CAF /end MEASUREMENT
/begin MEASUREMENT ACCtl_stMagCluFall "Magnet clutch falling edge status" UBYTE B_TRUE 1 100 0.00 1.00000000000 BIT_MASK 0x1 FORMAT "%13.11" ECU_ADDRESS 0x60009CAE /end MEASUREMENT
/begin MEASUREMENT ACCtl_stOut "Air condition Compressor status" UBYTE OneToOne 1 100 0.00 255.0 FORMAT "%5.1" ECU_ADDRESS 0x50005D6A /end MEASUREMENT
/begin MEASUREMENT ACCtl_stOut_tmp "Temporary bit of application parameter for Air condition status" UBYTE B_TRUE 1 100 0.00 1.00000000000 BIT_MASK 0x1 FORMAT "%13.11" ECU_ADDRESS 0x60009CAD /end MEASUREMENT
/begin MEASUREMENT ACCtl_stShOffCdn "AC cut off condition" UWORD OneToOne 1 100 0.00 65535.00 FORMAT "%8.2" ECU_ADDRESS 0x6000413C /end MEASUREMENT
/begin MEASUREMENT ACCtl_stShOffCdnSlow "AC cut off condition 100ms task" UWORD OneToOne 1 100 0.00 65535.00 FORMAT "%8.2" ECU_ADDRESS 0x6000492C /end MEASUREMENT
/begin MEASUREMENT ACCtl_stSwtAc "AC switch state for AC control" UBYTE OneToOne 1 100 0.00 255.0 FORMAT "%5.1" ECU_ADDRESS 0x6000A6BD /end MEASUREMENT
/begin MEASUREMENT ACCtl_stSwtACRisng "AC switch rising edge status" UBYTE B_TRUE 1 100 0.00 1.00000000000 BIT_MASK 0x1 FORMAT "%13.11" ECU_ADDRESS 0x60009CAC /end MEASUREMENT
/begin MEASUREMENT ACCtl_stTrqResv "Status of Air Condition reserve torque calculation request" UBYTE OneToOne 1 100 0.00 255.0 FORMAT "%5.1" ECU_ADDRESS 0x6000A6BC /end MEASUREMENT
/begin MEASUREMENT ACCtl_stTrqResv_tmp "Temporary bit for status of AC reserve torque calculation request" UBYTE B_TRUE 1 100 0.00 1.00000000000 BIT_MASK 0x1 FORMAT "%13.11" ECU_ADDRESS 0x60009CAB /end MEASUREMENT
/begin MEASUREMENT ACCtl_tEvapACCutHi_MP "Measurement Point to check the high side AC temperature." SWORD Temp_Cels 1 100 -3549.940 3003.560 FORMAT "%8.3" ECU_ADDRESS 0x7000931C /end MEASUREMENT
/begin MEASUREMENT ACCtl_tEvapACCutLo_MP "Measurement Point to check the low side AC temperature." SWORD Temp_Cels 1 100 -3549.940 3003.560 FORMAT "%8.3" ECU_ADDRESS 0x7000931A /end MEASUREMENT
/begin MEASUREMENT ACCtl_tiACCmprTqReqTi "AC compressor Torque Request time" SWORD Time_s 1 100 -327.6800 327.6700 FORMAT "%8.4" ECU_ADDRESS 0x6000413A /end MEASUREMENT
/begin MEASUREMENT ACCtl_tiACCpTqReqTmr "AC capactiy torque request timer" SLONG Time_s 1 100 -21474836.4800 21474836.4700 FORMAT "%13.4" ECU_ADDRESS 0x60001998 /end MEASUREMENT
/begin MEASUREMENT ACCtl_tiAcCutOperRepDly "Uphill AC cut then operate repeating delay time" SWORD t_q0p01 1 100 0.00 327.6700 FORMAT "%8.4" ECU_ADDRESS 0x60004138 /end MEASUREMENT
/begin MEASUREMENT ACCtl_tiClmbSpdThdDly "Uphill AC cut base on vehicle speed delay time" SWORD t_q0p01 1 100 0.00 327.6700 FORMAT "%8.4" ECU_ADDRESS 0x60004136 /end MEASUREMENT
/begin MEASUREMENT ACCtl_tiClntTmr "Vehicle start AC shut off time threshold calculated by AC pressure" SWORD t_q0p01 1 100 -327.6800 327.6700 FORMAT "%8.4" ECU_ADDRESS 0x60004134 /end MEASUREMENT
/begin MEASUREMENT ACCtl_tiDecelACCutEnf "time for Deceleration AC cut Enforcement" UWORD t_q0p01 1 100 0.00 655.3500 FORMAT "%8.4" ECU_ADDRESS 0x60004132 /end MEASUREMENT
/begin MEASUREMENT ACCtl_tiStrtCutTmr "ACCtl_tiStrtCutTmr" UWORD t_q0p01 1 100 0.00 655.3500 FORMAT "%8.4" ECU_ADDRESS 0x60004130 /end MEASUREMENT
/begin MEASUREMENT ACCtl_tiStrtCutTmrCdn "Vehicle start AC shut off time threshold" SWORD t_q0p01 1 100 -327.6800 327.6700 FORMAT "%8.4" ECU_ADDRESS 0x6000412E /end MEASUREMENT
/begin MEASUREMENT ACCtl_tiStrtCutTmrCdnTmp "Temporary variable for Vehicle start AC shut off time threshold" SWORD t_q0p01 1 100 -327.6800 327.6700 FORMAT "%8.4" ECU_ADDRESS 0x6000412C /end MEASUREMENT
/begin MEASUREMENT ACCtl_tqACCmprReqTqAPOpng "AC compressor request torque during Accelerator pedel opening" SWORD Trq 1 100 -3276.800 3276.700 FORMAT "%8.3" ECU_ADDRESS 0x6000412A /end MEASUREMENT
/begin MEASUREMENT ACCtl_tqACDecelReq "AC torque request during deceleration" SWORD Trq 1 100 -3276.800 3276.700 FORMAT "%8.3" ECU_ADDRESS 0x60004128 /end MEASUREMENT
/begin MEASUREMENT ACCtl_tqACDecelReqVal "AC torque request value during deceleration" SWORD Trq 1 100 -3276.800 3276.700 FORMAT "%8.3" ECU_ADDRESS 0x600052F6 /end MEASUREMENT
/begin MEASUREMENT ACCtl_tqACDwnDurgStrt "AC torque down during engine start" SWORD Trq 1 100 -3276.800 3276.700 FORMAT "%8.3" ECU_ADDRESS 0x600052F4 /end MEASUREMENT
/begin MEASUREMENT ACCtl_tqDwnDurgDecel "AC torque down during deceleration" SWORD Trq 1 100 -3276.800 3276.700 FORMAT "%8.3" ECU_ADDRESS 0x600052F2 /end MEASUREMENT
/begin MEASUREMENT ACEvpT_t "AC Evaporator temperature" SWORD Temp_Cels 1 100 -3549.940 3003.560 FORMAT "%8.3" ECU_ADDRESS 0x600053BC /end MEASUREMENT
/begin MEASUREMENT ACEvpT_tAvg "Average AC Evaporator tem-perature" SWORD Temp_Cels 1 100 -3549.940 3003.560 FORMAT "%8.3" ECU_ADDRESS 0x600053BA /end MEASUREMENT
/begin MEASUREMENT ACEvpT_uRaw "Raw ADC value of AC Evaporator temperature sensor signal" SWORD Volt 1 100 -6553.600 6553.400 FORMAT "%8.3" ECU_ADDRESS 0x600053B8 /end MEASUREMENT
/begin MEASUREMENT ACSwt_ValSwtflg_MP "Val switch flag measuring point" UBYTE OneToOne 1 100 0.00 255.0 FORMAT "%5.1" ECU_ADDRESS 0x70009319 /end MEASUREMENT
/begin MEASUREMENT ActMod_pwrCrksft "Actual engine power at crankshaft level" SWORD Pwr2 1 100 -617662.2 617643.4 FORMAT "%8.1" ECU_ADDRESS 0x6000E11A /end MEASUREMENT
/begin MEASUREMENT ActMod_pwrInr "Actual internal engine power" SWORD Pwr2 1 100 -617662.2 617643.4 FORMAT "%8.1" ECU_ADDRESS 0x6000E11C /end MEASUREMENT
/begin MEASUREMENT ActMod_stTrgFCO10_2 "Statusword to trigger the cylinder individual cut-off" UWORD OneToOne 1 100 0.00 65535.00 FORMAT "%8.2" ECU_ADDRESS 0x500059E6 /end MEASUREMENT
/begin MEASUREMENT ActMod_stTrgFCO10_3 "Statusword to trigger the cylinder individual cut-off" UWORD OneToOne 1 100 0.00 65535.00 FORMAT "%8.2" ECU_ADDRESS 0x6000E11E /end MEASUREMENT
/begin MEASUREMENT ActMod_stTrgFCOsyn "Statusword to trigger the cylinder individual cut-off" UWORD OneToOne 1 100 0.00 65535.00 FORMAT "%8.2" ECU_ADDRESS 0x600004AE /end MEASUREMENT
/begin MEASUREMENT ActMod_stTrgFCOsyns "Statusword to trigger the cylinder individual cut-off" UWORD OneToOne 1 100 0.00 65535.00 FORMAT "%8.2" ECU_ADDRESS 0x600004B0 /end MEASUREMENT
/begin MEASUREMENT ActMod_trqClthWoDstC "actual engine torque without anti-jerk intervention - clutch torque" SWORD md_q0p1 1 100 -3276.800 3276.700 FORMAT "%8.3" ECU_ADDRESS 0x500059E8 /end MEASUREMENT
/begin MEASUREMENT ActMod_trqClthWoIntv "actual engine torque without interventions - clutch torque level" SWORD md_q0p1 1 100 -3276.800 3276.700 FORMAT "%8.3" ECU_ADDRESS 0x70002C1E /end MEASUREMENT
/begin MEASUREMENT ActMod_trqClthWoTraIntv "actual engine torque without transmission interventions - clutch torque" SWORD md_q0p1 1 100 -3276.800 3276.700 FORMAT "%8.3" ECU_ADDRESS 0x60005286 /end MEASUREMENT
/begin MEASUREMENT ActMod_trqCrSWoDstC "actual engine torque without anti-jerk intervention - crankshaft torque" SWORD md_q0p1 1 100 -3276.800 3276.700 FORMAT "%8.3" ECU_ADDRESS 0x60005284 /end MEASUREMENT
/begin MEASUREMENT ActMod_trqCrSWoIntv "Crankshaft torque without interventions" SWORD md_q0p1 1 100 -3276.800 3276.700 FORMAT "%8.3" ECU_ADDRESS 0x6000E120 /end MEASUREMENT
/begin MEASUREMENT ActMod_trqCrSWoTraIntv "actual engine torque without transmission interventions - crankshaft torque" SWORD md_q0p1 1 100 -3276.800 3276.700 FORMAT "%8.3" ECU_ADDRESS 0x6000E122 /end MEASUREMENT
/begin MEASUREMENT ActMod_trqInrWoDstC "actual engine torque without anti-jerk Intervention - inner torque" SWORD md_q0p1 1 100 0.00 3276.700 FORMAT "%8.3" ECU_ADDRESS 0x6000E124 /end MEASUREMENT
/begin MEASUREMENT ActMod_trqInrWoIntv "actual engine torque without external interventions - inner torque" SWORD md_q0p1 1 100 0.00 3276.700 FORMAT "%8.3" ECU_ADDRESS 0x60005282 /end MEASUREMENT
/begin MEASUREMENT ActMod_trqInrWoTraIntv "Engine torque without torque intervention - inner torque" SWORD md_q0p1 1 100 0.00 3276.700 FORMAT "%8.3" ECU_ADDRESS 0x60005280 /end MEASUREMENT
/begin MEASUREMENT AC_trqDes "Application parametr for Desired AC compressor torque" SWORD Trq 1 100 -3276.800 3276.700 FORMAT "%8.3" ECU_ADDRESS 0x6000E110 /end MEASUREMENT
/begin MEASUREMENT AC_trqMaxAC "Application parameter for Allowed compressor torque load" SWORD Trq 1 100 -3276.800 3276.700 FORMAT "%8.3" ECU_ADDRESS 0x600052F0 /end MEASUREMENT
/begin MEASUREMENT AC_trqResv "AC reserve torque" SWORD Trq 1 100 -3276.800 3276.700 FORMAT "%8.3" ECU_ADDRESS 0x6000E112 /end MEASUREMENT
/begin MEASUREMENT AirC_stCmprAct_tmp "Temporary bit of actual AC compressor state" UBYTE B_TRUE 1 100 0.00 1.00000000000 BIT_MASK 0x1 FORMAT "%13.11" ECU_ADDRESS 0x60009CAA /end MEASUREMENT
/begin MEASUREMENT AirC_stSwt "Status of Air Condition switch" UBYTE OneToOne 1 100 0.00 255.0 FORMAT "%5.1" ECU_ADDRESS 0x6000A6AF /end MEASUREMENT
/begin MEASUREMENT AirC_stSwtDeb "Debounced status of AC switch" UBYTE OneToOne 1 100 0.00 255.0 FORMAT "%5.1" ECU_ADDRESS 0x6000A6AE /end MEASUREMENT
/begin MEASUREMENT AirC_stSwtPrsnt "AC switch Present status" UBYTE B_TRUE 1 100 0.00 1.00000000000 BIT_MASK 0x1 FORMAT "%13.11" ECU_ADDRESS 0x6000A24A /end MEASUREMENT
/begin MEASUREMENT AirC_stSwtRaw "Raw value of AC-switch read from the sensor" UBYTE OneToOne 1 100 0.00 255.0 FORMAT "%5.1" ECU_ADDRESS 0x6000A6AC /end MEASUREMENT
/begin MEASUREMENT AirDvP_flgEnaPMod "P-mode active" UBYTE B_TRUE 1 100 0.00 1.00000000000 BIT_MASK 0x1 FORMAT "%13.11" ECU_ADDRESS 0x7000037F /end MEASUREMENT
/begin MEASUREMENT AirDvP_flgEnaScc "Condition enable pressure sensor coparison during start" UBYTE B_TRUE 1 100 0.00 1.00000000000 BIT_MASK 0x1 FORMAT "%13.11" ECU_ADDRESS 0x70000ACD /end MEASUREMENT
/begin MEASUREMENT AirDvP_flgEnaSccPEnv "Condition Intake manifold pressure at nmot=0 equal to ambient pressure" UBYTE B_TRUE 1 100 0.00 1.00000000000 BIT_MASK 0x1 FORMAT "%13.11" ECU_ADDRESS 0x60037EB6 /end MEASUREMENT
/begin MEASUREMENT AirDvP_flgPIntkVUsStrtRngErrB1 "Condition failure map lost grounding bank 1" UBYTE B_TRUE 1 100 0.00 1.00000000000 BIT_MASK 0x1 FORMAT "%13.11" ECU_ADDRESS 0x70000ACC /end MEASUREMENT
/begin MEASUREMENT AirDvP_flgPIntkVUsStrtRngHealB1 "Condition healing failure map lost grounding bank 1" UBYTE B_TRUE 1 100 0.00 1.00000000000 BIT_MASK 0x1 FORMAT "%13.11" ECU_ADDRESS 0x70000ACB /end MEASUREMENT
/begin MEASUREMENT AirDvP_PEnvMax "max. pos ambient air pressure correction" SWORD p_q0p039 1 100 -1280.000 1279.961 FORMAT "%8.3" ECU_ADDRESS 0x60004126 /end MEASUREMENT
/begin MEASUREMENT AirDvP_PEnvMin "max. neg. ambient air pressure correction" SWORD p_q0p039 1 100 -1280.000 1279.961 FORMAT "%8.3" ECU_ADDRESS 0x60004124 /end MEASUREMENT
/begin MEASUREMENT AirDvP_pEnvOffs "Calculated pressure offset of the ambient pressure sensor" SWORD p_q0p039 1 100 -1280.000 1279.961 FORMAT "%8.3" ECU_ADDRESS 0x60004B86 /end MEASUREMENT
/begin MEASUREMENT AirDvP_pIntkVUsLdcB1 "Manifold air pressure last DC bank 1" UWORD p_q0p078 1 100 0.00 5119.922 FORMAT "%8.3" ECU_ADDRESS 0x6000492A /end MEASUREMENT
/begin MEASUREMENT AirDvP_pIntkVUsOffsB1 "Offset pressure sensor manifold pressure bank 1" SWORD p_q0p039 1 100 -1280.000 1279.961 FORMAT "%8.3" ECU_ADDRESS 0x60004B84 /end MEASUREMENT
/begin MEASUREMENT AirDvP_pIntkVUsOffsBndlsB1 "Offset pressure sensor manifold pressure, unlimited bank 1" SWORD p_q0p039 1 100 -1280.000 1279.961 FORMAT "%8.3" ECU_ADDRESS 0x60037EB4 /end MEASUREMENT
/begin MEASUREMENT AirMod_cntrDlyPredVlvLftIntk "Counter for delay of the flag B_vhefeps" UBYTE OneToOne 1 100 0.00 255.0 FORMAT "%5.1" ECU_ADDRESS 0x70001AA8 /end MEASUREMENT
/begin MEASUREMENT AirMod_flgCoVlvLft "Air modelling coordiniert valve lift swith" UBYTE B_TRUE 1 100 0.00 1.00000000000 BIT_MASK 0x1 FORMAT "%13.11" ECU_ADDRESS 0x70001BFC /end MEASUREMENT
/begin MEASUREMENT AltIO_flgACGHiU "System Voltage High status flag" UBYTE B_TRUE 1 100 0.00 1.00000000000 BIT_MASK 0x1 FORMAT "%13.11" ECU_ADDRESS 0x60009CA8 /end MEASUREMENT
/begin MEASUREMENT AltIO_flgACGLoU "System voltage Low status flag" UBYTE B_TRUE 1 100 0.00 1.00000000000 BIT_MASK 0x1 FORMAT "%13.11" ECU_ADDRESS 0x60009CA7 /end MEASUREMENT
/begin MEASUREMENT AltIO_nEngThdACGFailr "Threshold value for engine speed in detecting ACG electric or mechanical fault" SWORD EngN 1 100 -16384.00 16383.50 FORMAT "%8.2" ECU_ADDRESS 0x60005278 /end MEASUREMENT
/begin MEASUREMENT AltIO_rACGFieDuty "Filtered value of ACG field duty cycle" SWORD DtyCyc 1 100 -327.6800 327.6700 FORMAT "%8.4" ECU_ADDRESS 0x600003F0 /end MEASUREMENT
/begin MEASUREMENT AltIO_rAlt "Raw load on the Alternator" SWORD Prc 1 100 -400.0000 399.9878 FORMAT "%8.4" ECU_ADDRESS 0x600053B4 /end MEASUREMENT
/begin MEASUREMENT AltIO_rAltLoad "Raw load on the Alternator" SWORD DtyCyc 1 100 -327.6800 327.6700 FORMAT "%8.4" ECU_ADDRESS 0x60005276 /end MEASUREMENT
/begin MEASUREMENT AltIO_stCon "Debounced value of the alternator condition input" UBYTE OneToOne 1 100 0.00 255.0 FORMAT "%5.1" ECU_ADDRESS 0x6000A6AB /end MEASUREMENT
/begin MEASUREMENT AltIO_stQ "Quality of input signal" UBYTE OneToOne 1 100 0.00 255.0 FORMAT "%5.1" ECU_ADDRESS 0x6000A793 /end MEASUREMENT
/begin MEASUREMENT AltIO_tiLRAlt "Load Response time" SWORD Time_s 1 100 -327.6800 327.6700 FORMAT "%8.4" ECU_ADDRESS 0x60005274 /end MEASUREMENT
/begin MEASUREMENT AltIO_uAltDes "Alternator setpoint voltage" SWORD Volt_Batt 1 100 -655360.0 655340.0 FORMAT "%8.1" ECU_ADDRESS 0x60005272 /end MEASUREMENT
/begin MEASUREMENT Alt_uFinalDes "Desired voltage for alternator operation" SWORD Volt_Batt 1 100 -655360.0 655340.0 FORMAT "%8.1" ECU_ADDRESS 0x6000526C /end MEASUREMENT
/begin MEASUREMENT anzsyn "No. of remaing synchro's in the wait state" UBYTE dez 1 100 0.00 255.0 FORMAT "%5.1" ECU_ADDRESS 0x70001AAD /end MEASUREMENT
/begin MEASUREMENT asegvsyn "No.of segments delay of the faster correcting element at valve lift switch-over" UBYTE OneToOne 1 100 0.00 255.0 FORMAT "%5.1" ECU_ADDRESS 0x6000073A /end MEASUREMENT
/begin MEASUREMENT B_dmdevab "Condition Injection Cutoff pattern for Misfire Detection" UBYTE B_TRUE 1 100 0.00 1.00000000000 BIT_MASK 0x1 FORMAT "%13.11" ECU_ADDRESS 0x70000384 /end MEASUREMENT
/begin MEASUREMENT B_dmdstop_msg "injection valve cutoff active --> diagnosis misfire detecction stopped" UBYTE B_TRUE 1 100 0.00 1.00000000000 BIT_MASK 0x1 FORMAT "%13.11" ECU_ADDRESS 0x70000A94 /end MEASUREMENT
/begin MEASUREMENT B_dssakt_msg "condition MAPS is main sensor in the air charge determination" UBYTE B_TRUE 1 100 0.00 1.00000000000 BIT_MASK 0x1 FORMAT "%13.11" ECU_ADDRESS 0x70000A93 /end MEASUREMENT
/begin MEASUREMENT B_epsrsg_msg "Condition failure map lost grounding" UBYTE B_TRUE 1 100 0.00 1.00000000000 BIT_MASK 0x1 FORMAT "%13.11" ECU_ADDRESS 0x70000A73 /end MEASUREMENT
/begin MEASUREMENT B_evasel_msg "Status:all local injector relevant to DASE are switched on" UBYTE B_TRUE 1 100 0.00 1.00000000000 BIT_MASK 0x1 FORMAT "%13.11" ECU_ADDRESS 0x70000A6D /end MEASUREMENT
/begin MEASUREMENT B_fevab "Condition Injection valves or Ignition Coil Error" UBYTE B_TRUE 1 100 0.00 1.00000000000 BIT_MASK 0x1 FORMAT "%13.11" ECU_ADDRESS 0x70000383 /end MEASUREMENT
/begin MEASUREMENT B_fgfnpps_msg "Condition enable pressure sensor coparison during start" UBYTE B_TRUE 1 100 0.00 1.00000000000 BIT_MASK 0x1 FORMAT "%13.11" ECU_ADDRESS 0x70000A64 /end MEASUREMENT
/begin MEASUREMENT B_hepsrsg_msg "Condition healing failure map lost grounding" UBYTE B_TRUE 1 100 0.00 1.00000000000 BIT_MASK 0x1 FORMAT "%13.11" ECU_ADDRESS 0x70000A4C /end MEASUREMENT
/begin MEASUREMENT B_redsol "Condition Torque Reduction request" UBYTE B_TRUE 1 100 0.00 1.00000000000 BIT_MASK 0x1 FORMAT "%13.11" ECU_ADDRESS 0x70000382 /end MEASUREMENT
/begin MEASUREMENT B_vhefepsloc "TempFlag Charge Prediction Desired Valve Lift" UBYTE B_TRUE 1 100 0.00 1.00000000000 BIT_MASK 0x1 FORMAT "%13.11" ECU_ADDRESS 0x70001AA7 /end MEASUREMENT
/begin MEASUREMENT B_vhefeps_msg "Calculation of predicted air charge with desired valve lift" UBYTE B_TRUE 1 100 0.00 1.00000000000 BIT_MASK 0x1 FORMAT "%13.11" ECU_ADDRESS 0x70001BF7 /end MEASUREMENT
/begin MEASUREMENT B_vhegabgn_msg "Condition begin of switching variable cam lift inlet to high cam profile" UBYTE B_TRUE 1 100 0.00 1.00000000000 BIT_MASK 0x1 FORMAT "%13.11" ECU_ADDRESS 0x70001BF6 /end MEASUREMENT
/begin MEASUREMENT B_vhesynon "Synchronization variable valve lift, predicted air charge active" UBYTE B_TRUE 1 100 0.00 1.00000000000 BIT_MASK 0x1 FORMAT "%13.11" ECU_ADDRESS 0x70001AA6 /end MEASUREMENT
/begin MEASUREMENT ComAlt_iExctCrnt "Alternator Excitation current" SWORD Curr 1 100 -32768.00 32767.00 FORMAT "%8.2" ECU_ADDRESS 0x600051D0 /end MEASUREMENT
/begin MEASUREMENT ComAlt_iExctCrntTypB "Excitation current for ACG regulator type B frame" SWORD Curr 1 100 -32768.00 32767.00 FORMAT "%8.2" ECU_ADDRESS 0x600051CE /end MEASUREMENT
/begin MEASUREMENT ComAlt_rAltDyc "Alternator duty cycle" SWORD Prc 1 100 -400.0000 399.9878 FORMAT "%8.4" ECU_ADDRESS 0x600051CC /end MEASUREMENT
/begin MEASUREMENT ComAlt_rAltDycTypB "Alternator duty cycle for ACG regulator type B frame" SWORD Prc 1 100 -400.0000 399.9878 FORMAT "%8.4" ECU_ADDRESS 0x600051CA /end MEASUREMENT
/begin MEASUREMENT ComAlt_stCom "Communication status for ACG" UBYTE OneToOne 1 100 0.00 255.0 FORMAT "%5.1" ECU_ADDRESS 0x6000A65E /end MEASUREMENT
/begin MEASUREMENT ComAlt_stComTOut "Communication timeout for ACG" UBYTE OneToOne 1 100 0.00 255.0 FORMAT "%5.1" ECU_ADDRESS 0x6000A65D /end MEASUREMENT
/begin MEASUREMENT ComAlt_stComTOutTypB "Communication time out status for ACG regulator type B frame" UBYTE OneToOne 1 100 0.00 255.0 FORMAT "%5.1" ECU_ADDRESS 0x6000A65C /end MEASUREMENT
/begin MEASUREMENT ComAlt_stComTypB "Communication error status for ACG regulator type B frame" UBYTE OneToOne 1 100 0.00 255.0 FORMAT "%5.1" ECU_ADDRESS 0x6000A65B /end MEASUREMENT
/begin MEASUREMENT ComAlt_stElec "Electrical status for ACG" UBYTE OneToOne 1 100 0.00 255.0 FORMAT "%5.1" ECU_ADDRESS 0x6000A65A /end MEASUREMENT
/begin MEASUREMENT ComAlt_stElecTypB "Electrical fault status for ACG regulator type B frame" UBYTE OneToOne 1 100 0.00 255.0 FORMAT "%5.1" ECU_ADDRESS 0x6000A659 /end MEASUREMENT
/begin MEASUREMENT ComAlt_stHiTemp "High Temperature for ACG" UBYTE OneToOne 1 100 0.00 255.0 FORMAT "%5.1" ECU_ADDRESS 0x6000A658 /end MEASUREMENT
/begin MEASUREMENT ComAlt_stHiTempTypB "High temperature fault status for ACG regulator type B frame" UBYTE OneToOne 1 100 0.00 255.0 FORMAT "%5.1" ECU_ADDRESS 0x6000A657 /end MEASUREMENT
/begin MEASUREMENT ComAlt_stMchn "Machine status for ACG" UBYTE OneToOne 1 100 0.00 255.0 FORMAT "%5.1" ECU_ADDRESS 0x6000A656 /end MEASUREMENT
/begin MEASUREMENT ComAlt_stMchnTypB "Machine fault status for ACG regulator type B frame" UBYTE OneToOne 1 100 0.00 255.0 FORMAT "%5.1" ECU_ADDRESS 0x6000A655 /end MEASUREMENT
/begin MEASUREMENT ComAlt_tACGTemp "ACG temperature for ACG regulator" SWORD Temp_Cels 1 100 -3549.940 3003.560 FORMAT "%8.3" ECU_ADDRESS 0x600051C8 /end MEASUREMENT
/begin MEASUREMENT ComAlt_tACGTempTypB "ACG temperature for ACG regulator type B frame" SWORD Temp_Cels 1 100 -3549.940 3003.560 FORMAT "%8.3" ECU_ADDRESS 0x600051C6 /end MEASUREMENT
/begin MEASUREMENT Com_bALTErr "Communication status with alternator regulator (Flag Communication error)" UBYTE B_TRUE 1 100 0.00 1.00000000000 BIT_MASK 0x1 FORMAT "%13.11" ECU_ADDRESS 0x6000A1C3 /end MEASUREMENT
/begin MEASUREMENT Com_bDern "Generator High temperature cut-off" UBYTE B_TRUE 1 100 0.00 1.00000000000 BIT_MASK 0x1 FORMAT "%13.11" ECU_ADDRESS 0x6000A1C0 /end MEASUREMENT
/begin MEASUREMENT Com_bElec "Electrical status (Flag Electrical error)" UBYTE B_TRUE 1 100 0.00 1.00000000000 BIT_MASK 0x1 FORMAT "%13.11" ECU_ADDRESS 0x6000A1BF /end MEASUREMENT
/begin MEASUREMENT Com_bMec "Machine status (Flag Mechanical status)" UBYTE B_TRUE 1 100 0.00 1.00000000000 BIT_MASK 0x1 FORMAT "%13.11" ECU_ADDRESS 0x6000A1BE /end MEASUREMENT
/begin MEASUREMENT Com_bTO "Communication timeout status (Flag Timeout)" UBYTE B_TRUE 1 100 0.00 1.00000000000 BIT_MASK 0x1 FORMAT "%13.11" ECU_ADDRESS 0x6000A1BD /end MEASUREMENT
/begin MEASUREMENT Com_ratDyc "Alternator duty cycle" SWORD DtyCyc 1 100 -327.6800 327.6700 FORMAT "%8.4" ECU_ADDRESS 0x6000518A /end MEASUREMENT
/begin MEASUREMENT dmdevab "inject. valve cutoff pattern of misfire detection for the aktual ecu" UBYTE dez 1 100 0.00 255.0 FORMAT "%5.1" ECU_ADDRESS 0x70001AAC /end MEASUREMENT
/begin MEASUREMENT dpsfg_w_msg "delta fresh air partial pressure in manifold" SWORD p_sw_q0p039 1 100 -1280.000 1279.961 FORMAT "%8.3" ECU_ADDRESS 0x70001D28 /end MEASUREMENT
/begin MEASUREMENT eevx_msg "Injection valve Errorbyte" UBYTE dez 1 100 0.00 255.0 FORMAT "%5.1" ECU_ADDRESS 0x50005DCC /end MEASUREMENT
/begin MEASUREMENT evrbgn_one_msg "ev.nr. -1 at begin of cylinder cut-off for REDABM" UBYTE dez 1 100 0.00 255.0 FORMAT "%5.1" ECU_ADDRESS 0x70001C0C /end MEASUREMENT
/begin MEASUREMENT evz_auscpl_msg "complement of injection cut off pattern total" UBYTE dez 1 100 0.00 255.0 FORMAT "%5.1" ECU_ADDRESS 0x70001C0B /end MEASUREMENT
/begin MEASUREMENT evz_austot_msg "injection cut off pattern total" UBYTE dez 1 100 0.00 255.0 FORMAT "%5.1" ECU_ADDRESS 0x600007B3 /end MEASUREMENT
/begin MEASUREMENT evz_aus_msg "injection cut off pattern" UBYTE dez 1 100 0.00 255.0 FORMAT "%5.1" ECU_ADDRESS 0x500008B8 /end MEASUREMENT
/begin MEASUREMENT fevab_msg "fixed pattern injection-valve cutoff" UBYTE dez 1 100 0.00 255.0 FORMAT "%5.1" ECU_ADDRESS 0x70001C0A /end MEASUREMENT
/begin MEASUREMENT ftvdk_msg "correction factor for temperature upstream of throttle valve" UBYTE fak_ub_b2 1 100 0.00 1.992188 FORMAT "%8.6" ECU_ADDRESS 0x60000DAE /end MEASUREMENT
/begin MEASUREMENT fvisrm_w_msg "integrator amplifier factor intake manifold modell" UWORD p_uw_b32 1 100 0.00 31.99951 FORMAT "%8.5" ECU_ADDRESS 0x60000ADA /end MEASUREMENT
/begin MEASUREMENT InjSys_agInjBgn "begin angle of injection" UWORD kw_q0p0234 1 100 0.00 1535.977 FORMAT "%8.3" ECU_ADDRESS 0x6000041E /end MEASUREMENT
/begin MEASUREMENT InjSys_agSynToLstSyn "angle actual syn to last syn before ignition" UBYTE kw_q6 1 100 0.00 1530. FORMAT "%5.0" ECU_ADDRESS 0x600006FF /end MEASUREMENT
/begin MEASUREMENT InjSys_bFcoCylIndTstr "condition cylinder individual cut-off is active by tester" UBYTE B_TRUE 1 100 0.00 1.00000000000 BIT_MASK 0x1 FORMAT "%13.11" ECU_ADDRESS 0x70000381 /end MEASUREMENT
/begin MEASUREMENT InjSys_ctCylOld "Former value of cylider counter Epm_ctCyl" UBYTE OneToOne 1 100 0.00 255.0 FORMAT "%5.1" ECU_ADDRESS 0x70001AAB /end MEASUREMENT
/begin MEASUREMENT InjSys_DeltaAgSyn "Angle between synchro" UBYTE kw_q6 1 100 0.00 1530. FORMAT "%5.0" ECU_ADDRESS 0x600006FE /end MEASUREMENT
/begin MEASUREMENT InjSys_FcoCylIndTstr "cylinder individual cut-off pattern by ATS" UBYTE dez 1 100 0.00 255.0 FORMAT "%5.1" ECU_ADDRESS 0x70001AAA /end MEASUREMENT
/begin MEASUREMENT InjSys_flgCutOffReqTyp2 "Condition full cutoff request type 2" UBYTE B_TRUE 1 100 0.00 1.00000000000 BIT_MASK 0x1 FORMAT "%13.11" ECU_ADDRESS 0x70000731 /end MEASUREMENT
/begin MEASUREMENT InjSys_flgNoInjReq "condition: injection cutoff active for next cylinder in ZOT" UBYTE B_TRUE 1 100 0.00 1.00000000000 BIT_MASK 0x1 FORMAT "%13.11" ECU_ADDRESS 0x7000072E /end MEASUREMENT
/begin MEASUREMENT InjSys_flgNoInjReq_PFI "condition: injection cutoff active for next cylinder in ZOT for PFI" UBYTE B_TRUE 1 100 0.00 1.00000000000 BIT_MASK 0x1 FORMAT "%13.11" ECU_ADDRESS 0x70000380 /end MEASUREMENT
/begin MEASUREMENT InjSys_stInjActv "state injection activated" UWORD OneToOne 1 100 0.00 65535.00 FORMAT "%8.2" ECU_ADDRESS 0x50000628 /end MEASUREMENT
/begin MEASUREMENT InjSys_stNxtInjActv "state injection activated for next cycle" UWORD OneToOne 1 100 0.00 65535.00 FORMAT "%8.2" ECU_ADDRESS 0x5000062A /end MEASUREMENT
/begin MEASUREMENT kldfpwm "generator signale as PWM-signale filtrated" UBYTE rel_ub_b100 1 100 0.00 99.61 FORMAT "%5.2" ECU_ADDRESS 0x60009CA9 /end MEASUREMENT
/begin MEASUREMENT ofpsr_w_msg "Offset Voltage pressure sensor manifold pressure (word)" SWORD p_q0p039 1 100 -1280.000 1279.961 FORMAT "%8.3" ECU_ADDRESS 0x50005C6C /end MEASUREMENT
/begin MEASUREMENT ofpu_w "Offset-voltage for ambient pressure sensor" SWORD p_q0p039 1 100 -1280.000 1279.961 FORMAT "%8.3" ECU_ADDRESS 0x6000493E /end MEASUREMENT
/begin MEASUREMENT ofpu_w_msg "Offset-voltage for ambient pressure sensor" SWORD p_q0p039 1 100 -1280.000 1279.961 FORMAT "%8.3" ECU_ADDRESS 0x6000493C /end MEASUREMENT
/begin MEASUREMENT psfglm_w_msg "Fresh-air partial pressure in intake manifold), HFM-based + int. residual gas" UWORD p_uw_q0p039 1 100 0.00 2559.961 FORMAT "%8.3" ECU_ADDRESS 0x70001C66 /end MEASUREMENT
/begin MEASUREMENT psrrldc_w_msg "Manifold air pressure last DC" UWORD p_q0p078 1 100 0.00 5119.922 FORMAT "%8.3" ECU_ADDRESS 0x60004806 /end MEASUREMENT
/begin MEASUREMENT ps_w_msg "intake manifold pressure (absolute) (Word)" UWORD p_uw_q0p039 1 100 0.00 2559.961 FORMAT "%8.3" ECU_ADDRESS 0x60000654 /end MEASUREMENT
/begin MEASUREMENT pus_w_msg "Ambient pressure without substitution on sensor error" UWORD p_uw_q0p039 1 100 0.00 2559.961 FORMAT "%8.3" ECU_ADDRESS 0x60000DC2 /end MEASUREMENT
/begin MEASUREMENT pvdkds_w_msg "Pressure in front of throttle valve of pressure sensor (word)" UWORD p_uw_q0p039 1 100 0.00 2559.961 FORMAT "%8.3" ECU_ADDRESS 0x70001C5C /end MEASUREMENT
/begin MEASUREMENT stateaevab_msg "No. of the active state in AEVAB" UBYTE dez 1 100 0.00 255.0 FORMAT "%5.1" ECU_ADDRESS 0x600007BC /end MEASUREMENT
/begin MEASUREMENT TS_nMinAC "idle speed request" SWORD EngN 1 100 -16384.00 16383.50 FORMAT "%8.2" ECU_ADDRESS 0x60004EFC /end MEASUREMENT
/begin MEASUREMENT VehMot_drAccPedUnFlt "accelerator pedal angle slope, unfiltered" SWORD PrcPerSec 1 100 -20000.00 19999.39 FORMAT "%8.2" ECU_ADDRESS 0x60004E10 /end MEASUREMENT
/begin MEASUREMENT VehMot_facDesDyn "Dynamic factor for driver demand" SWORD Fact 1 100 -4.000000 3.999878 FORMAT "%8.6" ECU_ADDRESS 0x60004E0C /end MEASUREMENT
/begin MEASUREMENT VehMot_rAccPedFlt "Filtered accelerator pedal value" SWORD Prc 1 100 -400.0000 399.9878 FORMAT "%8.4" ECU_ADDRESS 0x60004E0A /end MEASUREMENT
/begin MEASUREMENT VehMot_stPrpAccPed "Status of propulsion demand by driver demand" UBYTE B_TRUE 1 100 0.00 1.00000000000 BIT_MASK 0x1 FORMAT "%13.11" ECU_ADDRESS 0x6000A10E /end MEASUREMENT
/begin MEASUREMENT zzyl_prev "Previous zzyl" UBYTE OneToOne 1 100 0.00 15.00 FORMAT "%5.2" ECU_ADDRESS 0x70001AA9 /end MEASUREMENT
/begin FUNCTION ACComp_Demand "180.1.0   Air conditioning compressor demand"
 /begin DEF_CHARACTERISTIC ACComp_CalcDem_CW ACComp_facACCmprOnResv_M ACComp_facCmprEnthCorrnA_C ACComp_facCmprEnthCorrnB_C ACComp_facCmprPlly_C ACComp_facCmprTqExtInp_C ACComp_facCooltFlowQnty_M ACComp_facCurrCtrlVal_C ACComp_facEnthpyCorrnA_C ACComp_facEnthpyCorrnB_C ACComp_facFanStVal_C ACComp_facFullCpTqCoeffA_C ACComp_facFullCpTqCoeffB_C ACComp_facFullCpTqCorrn_C ACComp_facGearACCmprOnResv_M ACComp_facHwGearOffResv_T ACComp_facHwOffResv_T ACComp_facOutdTCorrnA_C ACComp_facOutdTCorrnB_C ACComp_facOutdTDurgIdleA_C ACComp_facOutdTDurgIdleB_C ACComp_facTqEvaprSnsrValB_C ACComp_facTqEvaprSnsrValC_C ACComp_facTqPSnsrCtrlVal_C ACCOMP_FALSE ACComp_flgSwtACCmprSeln_C ACComp_iMaxACCmpr_C ACComp_mMinCooltFlowQnty_T ACComp_nOutdTCalcnPrmsSpd_C ACCOMP_PCOEFF ACComp_pCurrCorrnCtrlVal_C ACComp_rFan2_C ACComp_rFanHi_C ACComp_rFanLo_C ACComp_rFan_C ACComp_swtCmprExtInpTest_C ACComp_swtComMsgSeln_C ACComp_swtLdCAN_C ACComp_swtLd_C ACComp_swtStrtUpJdgCondByp_C ACComp_swtTrqOffsBhv_C ACComp_swtTSel_C ACComp_swtVehVCondByp_C ACComp_tCmprEnthIdealAdbt_M ACComp_tCooltSatnT_T ACComp_tiACOffTimeInit_C ACComp_tiCmprStrtPClnt_T ACComp_tiOnDlyT1DP_M ACComp_tiOnDlyT1Ti_M ACComp_tiOnDlyT2DP_M ACComp_tiOnDlyT2Ti_M ACComp_tiOnDlyT3Ti_M ACComp_tiOnDlyT4Ti_M ACComp_tiOutdTCalcnPrms_C ACComp_tiTCalcnPrepnPrms_C ACComp_tiTrqDes_C ACComp_tiTrqDyn_C ACComp_tiTrqOffRmpDwnone_C ACComp_tiTrqOffsRmpDwn_C ACComp_tiTrqOffsRmpUpone_C ACComp_tiTrqOffsRmpUp_C ACComp_tiTrqResv_C ACComp_tOutAirLoThd_C ACComp_tOutAirThres_C ACComp_tqACOffs1_M ACComp_tqACOffs_M ACComp_tqCorrnMax_C ACComp_tqEstimd1TqStrt_T ACComp_tqEstimd2TqStrt_T ACComp_tqEvaprTCorrnTq_C ACComp_tqHardDwnStep_C ACComp_tqHwGearOffResv_M ACComp_tqHwOffResv_M ACComp_tqPSnsrCorrnTq_C ACComp_tqSwOffResv_M ACComp_trqDyn_MAP ACComp_trqLimMax_MAP ACComp_trqOffsFlt_C ACComp_trqStat_MAP ACComp_tTCalcnRednVal_C ACComp_tTCalcnRiseVal_C ACComp_tValDurgSnsrFailr_C ACComp_tWtrTOutdTSnsr_C ACComp_vOutdTCtrlStrtPrms_C ACComp_vTqOffsRmpDelta_C ACComp_vTqOffsRmp_C ACComp_vVehSpdChgOutdT_C /end DEF_CHARACTERISTIC
 /begin REF_CHARACTERISTIC FanCtl_swtPWMFanActv_C /end REF_CHARACTERISTIC
 /begin IN_MEASUREMENT ACCtl_flgMgcOn ACCtl_flgSwOffResv ACCtl_stOut ACCtl_stTrqResv ACEvpT_t AirC_pClnt B_fs_msg B_ll_msg CEngDsT_t Com_iACCmpr Com_tACAirTOut Com_tAirOutside Com_tEnvT Eep_EnvRamInvld EnvT_t Epm_nEng Fan_r Fan_r2 mifa_w_msg T15_st tans_msg VehV_v /end IN_MEASUREMENT
 /begin OUT_MEASUREMENT ACComp_flgVblDplCmprJdg ACComp_iCmprSol ACComp_pLoPVal ACComp_trqStat AC_trqDes AC_trqResv /end OUT_MEASUREMENT
 /begin LOC_MEASUREMENT ACComp_facCmprPCorrn ACComp_facCmprSpdCorrn_MP ACComp_facCooltFlowQnty ACComp_facEnthpyCorrnA ACComp_facEnthpyCorrnB ACComp_facHwOffResv ACComp_facOutdTAftCorrnA_MP ACComp_facOutdTAftCorrn_MP ACComp_facPWithCoeffB_MP ACComp_facSolCurrCorrn_MP ACComp_facSpdWithCoeffA_MP ACComp_facTCorrnWithP_MP ACComp_facTemp18 ACComp_facTemp21 ACComp_facTemp25 ACComp_facTemp30 ACComp_facTrq_MP ACComp_flgACOn_MP ACComp_flgFirstStrtUpEnd ACComp_flgFirstStrtUpStart ACComp_flgOutdTFrstCalc ACComp_flgRampDwnActv ACComp_flgRampDwnActv1 ACComp_flgRampUpActv ACComp_flgRampUpActv1 ACComp_flgTqOffsVehV ACComp_mCalcdFlowQnty_MP ACComp_mCooltFlowQnty ACComp_mMinCooltFlowQnty ACComp_nEngCor_mp ACComp_pACClntpDiff_MP ACComp_pClnt ACComp_pClntClthOff ACComp_pClntCtrlVal ACComp_rFanSt ACComp_rFanStCalcdVal ACComp_rFanStCorrnVal_MP ACComp_rPrevFanStCalcdVal ACComp_rPrevStCorrnVal_MP ACComp_rWindVWghtAvrg ACComp_stFanStInitCalcn ACCOmp_stOutdTActvCdn_MP ACComp_stOutdTCalcnPrms ACComp_stTrqCalcnEna_MP ACComp_stVehSpdTmrRst ACComp_tActOutdT ACComp_tCalcdIdleOutdT ACComp_tCalcdOutdT ACComp_tCmprEnthIdealAdbt ACComp_tCooltSatnT ACComp_tiACOffTime ACComp_tiCmprStrtPClnt ACComp_tiCmprStrtUp1 ACComp_tiCmprVolCtrlStrt ACComp_tiOnDlyT1 ACComp_tiOnDlyT2 ACComp_tiOnDlyT3 ACComp_tiOnDlyT4 ACComp_tOutdT ACComp_tqACModel_MP ACComp_tqCmprFullCpTq ACComp_tqCorrnMax ACComp_tqEstimd1TqStat ACComp_tqEstimd2TqStrt ACComp_tqEstimdACCmpr ACComp_tqEvaprSnsrValB ACComp_tqEvaprSnsrValC ACComp_tqEvaprTCorrn ACComp_tqHardTmp ACComp_tqHwOffResv ACComp_tqOffsFinal ACComp_tqOffsFinal1 ACComp_tqOffsReqd ACComp_tqOffsReqd1 ACComp_tqPSnsrCtrlValTq ACComp_tqStrtgCtrlCmprTq ACComp_tqSwOffResv ACComp_trqDesFltAbv_mp ACComp_trqDesFlt_mp ACComp_trqDyn_mp ACComp_trqOffsRamped ACComp_trqOffsRamped1 ACComp_tSeldTrqOffs ACComp_tVblCpCmprEnth /end LOC_MEASUREMENT
 FUNCTION_VERSION "180.1.0" /end FUNCTION
/begin FUNCTION AccPed_DoCoordOut "139.1.0   Accelerator pedal torque coordination"
 /begin DEF_CHARACTERISTIC AccPed_nMax_C AccPed_nMinBrkApp_C AccPed_nMinBrk_C AccPed_nMinNoBrk_C AccPed_trqLimMax_C /end DEF_CHARACTERISTIC
 /begin IN_MEASUREMENT APP_drUnFlt APP_r CrCtl_stACCCond CrCtl_stActive LLim_stActive PT_rTrq VehMot_rTrqDfftl VehMot_stBrkPed VMD_rASLCC /end IN_MEASUREMENT
 /begin OUT_MEASUREMENT AccPed_nMax AccPed_nMin AccPed_rTrq AccPed_stNSetP AccPed_trqLimMax VehMot_drAccPedUnFlt VehMot_facDesDyn VehMot_rAccPedFlt /end OUT_MEASUREMENT
 /begin LOC_MEASUREMENT AccPed_stVirtAppUsg /end LOC_MEASUREMENT
 FUNCTION_VERSION "139.1.0" /end FUNCTION
/begin FUNCTION AccPed_DrvDemDes "69.13.2   Calculation of driver command torque set path"
 /begin DEF_CHARACTERISTIC AccPed_flgNotSwilLossCmp_C AccPed_flgSelFacCmpAcs_C AccPed_rAPPHysHi_C AccPed_rAPPHysLo_C AccPed_rThdMaxCmp_C AccPed_rThdNoCmp_C AccPed_tqPullThd_C /end DEF_CHARACTERISTIC
 /begin IN_MEASUREMENT AccPed_rTrq AccPed_tqMapBasd AccPed_trqLimMax APP_r CoME_trqDesComp CoVeh_trqAcs LsComp_bLossCmpActvd PT_rTrq PT_trqLos RngMod_trqComp RngMod_trqCrSMin RngMod_trqDiffAdap RngMod_trqInrMinWoCtOff RngMod_trqLosEng SpdGov_facComp Tra_trqLos VehMot_rTrqDfftl /end IN_MEASUREMENT
 /begin OUT_MEASUREMENT AccPed_facCompAcs AccPed_trqDes AccPed_trqDesPull VehMot_stPrpAccPed /end OUT_MEASUREMENT
 /begin LOC_MEASUREMENT AccPed_facAppMaxCmp AccPed_tqCmpLossSum AccPed_tqCmpNotSwilLoss AccPed_tqCmpSwilLoss AccPed_tqDesTmp AccPed_tqLossSum AccPed_tqNotSwilLoss AccPed_tqPullInrCmp AccPed_tqWoCtOff /end LOC_MEASUREMENT
 FUNCTION_VERSION "69.13.2" /end FUNCTION
/begin FUNCTION AccPed_DrvModSeln "2.2.0     Calculation of Drive Mode Selection Condition" /begin DEF_CHARACTERISTIC AccPed_tiIDSDrvModTmpInhb_C /end DEF_CHARACTERISTIC /begin REF_CHARACTERISTIC AccPed_swtDrvModSeln_C /end REF_CHARACTERISTIC
 /begin IN_MEASUREMENT AccPed_facModSwt Com_stAmbLmpPrms Com_stDrvModSwt Com_stIMGIDSDrvMod Com_stVSAInhbInfo PT_stTraType /end IN_MEASUREMENT
 /begin OUT_MEASUREMENT AccPed_flgDrvModChg AccPed_flgIDSDrvModFailr AccPed_flgIDSDrvModTmpInhb AccPed_stDrvModPrev AccPed_swtDrvMod AccPed_swtDrvModCpl AccPed_swtDrvModPrev /end OUT_MEASUREMENT
 FUNCTION_VERSION "2.2.0" /end FUNCTION
/begin FUNCTION AccPed_TqCalcn "8.3.0     Map based calculation of driver demand"
 /begin DEF_CHARACTERISTIC AccPed_swtFilActvn_C AccPed_tiGearFildFil_CA AccPed_tiGearFildRmp_CA AccPed_tqCvtEcoEng0_M AccPed_tqCvtEcoEng1_M AccPed_tqCvtEcoEng2_M AccPed_tqCvtEcoEng3_M AccPed_tqCvtEcoEng4_M AccPed_tqCvtEcoEng5_M AccPed_tqCvtEcoEng6_M AccPed_tqCvtEcoEng7_M AccPed_tqCvtEcoEng8_M AccPed_tqCvtEng0_M AccPed_tqCvtEng1_M AccPed_tqCvtEng2_M AccPed_tqCvtEng3_M AccPed_tqCvtEng4_M AccPed_tqCvtEng5_M AccPed_tqCvtEng6_M AccPed_tqCvtEng7_M AccPed_tqCvtEng8_M AccPed_tqFilSwtOffLim_C AccPed_tqHiIdleCVT_T AccPed_tqHiIdleMT_T AccPed_tqMinWoRamp_C AccPed_tqMTGear1_M AccPed_tqMTGear2_M AccPed_tqMTGear3_M AccPed_tqMTGear4_M AccPed_tqMTGear5_M AccPed_tqMTGear6_M AccPed_trqMod1Gear1_M AccPed_trqMod1Gear2_M AccPed_trqMod1Gear3_M AccPed_trqMod1Gear4_M AccPed_trqMod1Gear5_M AccPed_trqMod1Gear6_M /end DEF_CHARACTERISTIC
 /begin IN_MEASUREMENT AccPed_flgDrvModChg AccPed_swtDrvMod APP_r I14229iocpMDA_stAPS PT_nClth PT_rTrq PT_stTraType SyC_ctPostDrvLeave Tra_numGear Tra_rGearCVT1Hi Tra_rGearCVT1Lo Tra_rGearCVT2Hi Tra_rGearCVT2Lo Tra_rGearCVT3Hi Tra_rGearCVT3Lo Tra_rGearCVT4Hi Tra_rGearCVT4Lo Tra_rGearCVT5Hi Tra_rGearCVT5Lo Tra_rGearCVT6Hi Tra_rGearCVT6Lo Tra_rGearCVT7Hi Tra_rGearCVT7Lo /end IN_MEASUREMENT
 /begin OUT_MEASUREMENT AccPed_facModSwt AccPed_flgChgGearDetn AccPed_nrGearFildTmp AccPed_nrGearFildTmpPrev AccPed_tqCVTEng0 AccPed_tqCVTEng1 AccPed_tqCVTEng2 AccPed_tqCVTEng3 AccPed_tqCVTEng4 AccPed_tqCVTEng5 AccPed_tqCVTEng6 AccPed_tqCVTEng7 AccPed_tqCVTEng8 AccPed_tqMapBasd /end OUT_MEASUREMENT
 /begin LOC_MEASUREMENT AccPed_cntrPostDrvLve AccPed_facModSwtStep AccPed_stRampActv AccPed_tqBasDif AccPed_tqBasFild AccPed_tqBasMod1 AccPed_tqBasMod1MT AccPed_tqBasMod2 AccPed_tqBasModNew AccPed_tqBasModOld AccPed_tqBasUnfild AccPed_tqCvtEcoEng0 AccPed_tqCvtEcoEng1 AccPed_tqCvtEcoEng12 AccPed_tqCvtEcoEng2 AccPed_tqCvtEcoEng23 AccPed_tqCvtEcoEng3 AccPed_tqCvtEcoEng34 AccPed_tqCvtEcoEng4 AccPed_tqCvtEcoEng45 AccPed_tqCvtEcoEng5 AccPed_tqCvtEcoEng56 AccPed_tqCvtEcoEng6 AccPed_tqCvtEcoEng67 AccPed_tqCvtEcoEng7 AccPed_tqCvtEcoEng78 AccPed_tqCvtEcoEng8 AccPed_tqCVTEng12 AccPed_tqCVTEng23 AccPed_tqCVTEng34 AccPed_tqCVTEng45 AccPed_tqCVTEng56 AccPed_tqCVTEng67 AccPed_tqCVTEng78 AccPed_tqGearDesCVT AccPed_tqGearDesMT AccPed_tqGearMod1CVT AccPed_tqNewTmp AccPed_tqOldTmp AccPed_trqBasPrev /end LOC_MEASUREMENT
 FUNCTION_VERSION "8.3.0" /end FUNCTION
/begin FUNCTION AccPr "67.2.0    Access Protection" FUNCTION_VERSION "67.2.0" /end FUNCTION
/begin FUNCTION AccPrAppl "67.1.0    Access Protection Application" FUNCTION_VERSION "67.1.0" /end FUNCTION
/begin FUNCTION ACCtl_Demand "71.4.0    Air Condition Compressor Control"
 /begin DEF_CHARACTERISTIC ACCtl_facACCtrlCurrCorrVal_C ACCtl_facACtrDwnCtrlVal_C ACCtl_flgACTqDwnReqDisad_C ACCtl_flgEngSpdCdnSel_C ACCtl_flgSwtAcAndCutCdn_C ACCtl_flgSwtAcTq_C ACCtl_iACCtrlCurrUpprVal_C ACCtl_nCmprMax_C ACCtl_nEngACCutThd_C ACCtl_nEngHiCoolgPrf_C ACCtl_nEngHiShtOff_T ACCtl_nEngHiTow_C ACCtl_nEngLoCoolgPrf_C ACCtl_nEngLoShtOff_T ACCtl_nEngLoTow_C ACCtl_nMin_C ACCtl_nrACCutPrmsECONOff_T ACCtl_nrACCutPrmsECONOn_T ACCtl_pACMaxHi_C ACCtl_pACMaxLo_C ACCtl_pACMinHi_C ACCtl_pACMinLo_C ACCtl_pACPDwnCorrVal_C ACCtl_pACTqDwnPCorrVal_C ACCtl_pClntTmr_CUR ACCtl_rACCpAccrPedlOpngDetrm_C ACCtl_rACCpDwnAccrPedlThd_C ACCtl_rAccPedClmbHi_C ACCtl_rAccPedClmbLo_C ACCtl_rAccPedHi_CUR ACCtl_rAccPedLo_C ACCtl_rAccPedMid_CUR ACCtl_rACCpTmrRstAccrPedlThd_C ACCtl_rCmprPlly_C ACCtl_stAcShOffCdn_C ACCtl_stDecelACCtrlSwt_C ACCtl_stSwtAcCdn_C ACCtl_stSwtTrqResvSec_C ACCtl_swtAcECU_C ACCtl_swtHeatrCorePrsnt_C ACCtl_swtResv_C ACCtl_tEngHiCoolgPrf_C ACCtl_tEngHiTow_C ACCtl_tEngLoCoolgPrf_C ACCtl_tEngLoTow_C ACCtl_tEvapACCutHi_T ACCtl_tEvapACCutLo_T ACCtl_tEvapMinHi_C ACCtl_tEvapMinLo_C ACCtl_tEvaSnsrErr_C ACCtl_tiACCmprTqReqTi_T ACCtl_tiACCpDwnImplTi_C ACCtl_tiAccPedBuf_C ACCtl_tiACCpTqReqTmrMax_C ACCtl_tiAcCutDebThdHiLo_C ACCtl_tiAcCutDebThdLoHi_C ACCtl_tiAcCutOperRepDly_C ACCtl_tiACPOffDly_C ACCtl_tiACTond_C ACCtl_tiACTrqDlyImdt_C ACCtl_tiACTrqDly_C ACCtl_tiClmbSpdThdDly_C ACCtl_tiDebIdlSpdOnDly_C ACCtl_tiDebIdlSpdSec_C ACCtl_tiDlyAcOn_C ACCtl_tiDlyClmbOn_C ACCtl_tiDlyCrkNotCmpl_C ACCtl_tiDlyEngNOn_C ACCtl_tiDlyEvaErrOff_C ACCtl_tiDlyEvaErrOn_C ACCtl_tiInhbACCutPrmsACOn_C ACCtl_tiInhbACCutPrms_C ACCtl_tiOutDlyImdt_C ACCtl_tiOutDly_C ACCtl_tiStrtCutTmrCdn_C ACCtl_tiStrtCutTmrHi_C ACCtl_tiStrtCutTmrMid_C ACCtl_tiSwOffResv_C ACCtl_tiTrqResvSec_C ACCtl_tqACCmprTqReqDurgAPOpng_T ACCtl_tqDwnDurgDecel_C ACCtl_tqMaxAcLim_C ACCtl_tqMaxTqCrksftEngSpdEnd_C ACCtl_trqMaxAC_C ACCtl_vACCpLowrVehSpdThd_C ACCtl_vACCpUpprVehSpdThd_C ACCtl_vACTrqDecHiThd_C ACCtl_vACTrqDecLoThd_C ACCtl_vVehAcCutOnThd_C ACCtl_vVehChkHiThd_C ACCtl_vVehChkLoThd_C ACCtl_vVehClmbHi_C ACCtl_vVehClmbLo_C ACCtl_vVehHiCoolgPrf_C ACCtl_vVehLoCoolgPrf_C ACCtl_vVehStrtCutInhbHi_C ACCtl_vVehStrtCutInhbLo_C /end DEF_CHARACTERISTIC
 /begin IN_MEASUREMENT ACComp_pLoPVal ACComp_trqStat AccPed_flgIDSFctAvl AccPed_swtDrvMod ACCtl_stDecelACCutDmd ACEvpT_t AirC_pClnt AirC_stCmprAct APP_r B_dknotb B_ll CoEng_nFco Com_flgACCutDurgAtCvt Com_iACCmpr Com_stACCut Com_stIMGIDSDrvMod CoTS_trqMaxAC CoVeh_tqDrvOff2MaxAC CoVeh_tqIdleMaxAC EngDa_tEng EngPrt_bOvhtEngLim Epm_nEng Epm_nEng10ms HLSDem_nSetPLo I14229_stACCompDeActvOn PthSet_trqInrCtOff PT_stTraType RngMod_trqInrBs T15_st Tra_numGear Tra_stCrkNotCmpl Tra_stEngStop TS_stMnSwtAC VehMot_rAccPedFlt VehV_v wtacvol_w /end IN_MEASUREMENT
 /begin OUT_MEASUREMENT ACCtl_flgACCutPrms ACCtl_flgACDwnExe ACCtl_flgACOnCdnTCU ACCtl_flgACReq ACCtl_flgClr ACCtl_flgDecelACCut ACCtl_flgEngTqDwnReq ACCtl_flgGearShiftDetdLst ACCtl_flgMgcOn ACCtl_flgSnsrErrStrtCut ACCtl_flgSwOffResv ACCtl_flgSwtAcAndCutCdn ACCtl_iCmprDwnIReq ACCtl_nrACCutPrms ACCtl_stACCut ACCtl_stOut ACCtl_stShOffCdnSlow ACCtl_stSwtAc ACCtl_stTrqResv ACCtl_tqACDecelReqVal ACCtl_tqACDwnDurgStrt ACCtl_tqDwnDurgDecel AC_trqMaxAC TS_nMinAC /end OUT_MEASUREMENT
 /begin LOC_MEASUREMENT ACCtl_drAccPedStrtCut ACCtl_facACLoPDwnCorrVal_MP ACCtl_facACTqDwnCorrVal_MP ACCtl_flgACCutEnaCdn Acctl_flgACCutEnaSts ACCtl_flgACCutExe ACCtl_flgAcCutOperRep ACCtl_flgAcCutStep2Prfm ACCtl_flgAcShOffImdt ACCtl_flgClmbAcCut ACCtl_flgEngTqDwnReqEna ACCtl_flgGearShiftDetd ACCtl_flgHillClmbDet ACCtl_flgLoEngNShOff ACCtl_flgMgcOnDly ACCtl_flgStrtCut ACCtl_flgStrtCutHi ACCtl_flgStrtCutInhb ACCtl_flgStrtgCpDwnAccrPedl ACCtl_flgVehSpdAcCut ACCtl_flgVehSpdDetClmb ACCtl_iCmprDwnIReqVal ACCtl_nrAccPedSt ACCtl_pACLoPDwnCorrVal_MP ACCtl_pACLoPFinalVal_MP ACCtl_pTqDwnLoPVal ACCtl_rAppSig ACCtl_stDecelACCutDmdRst ACCtl_stDecelACCutPrms ACCtl_stEngFullOpenSts ACCtl_stEvapTACShOff_mp ACCtl_stFinshdACCutEnf ACCtl_stInhbACCutPrms ACCtl_stInhbACCutPrmsACOn ACCtl_stMagCluFall ACCtl_stOut_tmp ACCtl_stShOffCdn ACCtl_stSwtACRisng ACCtl_stTrqResv_tmp ACCtl_tEvapACCutHi_MP ACCtl_tEvapACCutLo_MP ACCtl_tiACCmprTqReqTi ACCtl_tiACCpTqReqTmr ACCtl_tiAcCutOperRepDly ACCtl_tiClmbSpdThdDly ACCtl_tiClntTmr ACCtl_tiDecelACCutEnf ACCtl_tiStrtCutTmr ACCtl_tiStrtCutTmrCdn ACCtl_tiStrtCutTmrCdnTmp ACCtl_tqACCmprReqTqAPOpng ACCtl_tqACDecelReq AirC_stCmprAct_tmp /end LOC_MEASUREMENT
 FUNCTION_VERSION "71.4.0" /end FUNCTION
/begin FUNCTION ACEvpT_DD "5.1.0     AC Evaporator Temperature Sensor"
 /begin DEF_CHARACTERISTIC ACEvpT_SRC.uMin_C ACEvpT_SRC.uMax_C ACEvpT_stCodMsk_C ACEvpT_swtSensPres_C ACEvpT_swtSig_C ACEvpT_tBCANErr_C ACEvpT_tCANErrDftVal_C ACEvpT_tDfl_C ACEvpT_tFCANErr_C ACEvpT_tiCANDly_C ACEvpT_tTransf_CUR ACEvpT_uRawDfl_C /end DEF_CHARACTERISTIC
 /begin IN_MEASUREMENT Com_tMtrEva /end IN_MEASUREMENT
 /begin OUT_MEASUREMENT ACEvpT_t ACEvpT_tAvg ACEvpT_uRaw /end OUT_MEASUREMENT
 FUNCTION_VERSION "5.1.0" /end FUNCTION
/begin FUNCTION ACSwt_DD "2.4.0     AC Switch Device Driver" /begin IN_MEASUREMENT Com_stAC ThDev_flgACMaiSwtCodVal ThDev_stMaiSwtACSig /end IN_MEASUREMENT /begin OUT_MEASUREMENT AirC_stSwtRaw /end OUT_MEASUREMENT FUNCTION_VERSION "2.4.0" /end FUNCTION
/begin FUNCTION ACSwt_VD "29.0.0    AC Switch Virtual Device"
 /begin DEF_CHARACTERISTIC ACSwt_stMnSwtDebEna_C ACSwt_tiSwtDebHiLo_C ACSwt_tiSwtDebLoHi_C AirC_stSwtDfl_C /end DEF_CHARACTERISTIC
 /begin IN_MEASUREMENT ACClntP_bCodAvl AirC_stSwtRaw Com_stAC T15_st ThDev_stMaiSwtACSig /end IN_MEASUREMENT
 /begin OUT_MEASUREMENT AirC_stSwt AirC_stSwtDeb AirC_stSwtPrsnt /end OUT_MEASUREMENT
 /begin LOC_MEASUREMENT ACSwt_ValSwtflg_MP /end LOC_MEASUREMENT
 FUNCTION_VERSION "29.0.0" /end FUNCTION
/begin FUNCTION ActMod_PwrCalc "1.2.0     Calculation of current engine power" /begin IN_MEASUREMENT ActMod_trqCrS ActMod_trqInr Epm_nEng /end IN_MEASUREMENT /begin OUT_MEASUREMENT ActMod_pwrCrksft ActMod_pwrInr /end OUT_MEASUREMENT FUNCTION_VERSION "1.2.0" /end FUNCTION
/begin FUNCTION ActMod_TrqCalc "2.9.0     Computation of actual engine torques"
 /begin IN_MEASUREMENT ActMod_bEngActv InjSys_stActRedStg PthSet_stTrgFCO PthSet_trqInrWoDstC PT_tqCrksftSetWoIntv PT_tqCrksftSetWoTrsmIntv RngMod_trqClthMin RngMod_trqCrSMin RngMod_trqInrBs /end IN_MEASUREMENT
 /begin OUT_MEASUREMENT ActMod_trqClthWoDstC ActMod_trqClthWoIntv ActMod_trqClthWoTraIntv ActMod_trqCrSWoDstC ActMod_trqCrSWoIntv ActMod_trqCrSWoTraIntv ActMod_trqInrWoDstC ActMod_trqInrWoIntv ActMod_trqInrWoTraIntv /end OUT_MEASUREMENT
 /begin LOC_MEASUREMENT ActMod_stTrgFCO10_2 ActMod_stTrgFCO10_3 ActMod_stTrgFCOsyn ActMod_stTrgFCOsyns /end LOC_MEASUREMENT
 FUNCTION_VERSION "2.9.0" /end FUNCTION
/begin FUNCTION ADCADAP "4.3.0     software adapter of MF ADC" /begin DEF_CHARACTERISTIC SF_DSS SF_DSU /end DEF_CHARACTERISTIC
 /begin IN_MEASUREMENT B_fedssb_msg ChrCtl_flgChrgCalcnTiBasd dpsrfg_w_msg fisrm_w_msg ftvdk_w_msg PEnv_pRaw psrfgmh_w_msg psr_w_msg pvd_w_msg SyC_stSub /end IN_MEASUREMENT
 /begin OUT_MEASUREMENT B_dssakt_msg dpsfg_w_msg ftvdk_msg fvisrm_w_msg psfglm_w_msg ps_w_msg pus_w_msg pvdkds_w_msg /end OUT_MEASUREMENT
 FUNCTION_VERSION "4.3.0" /end FUNCTION
/begin FUNCTION AEVAB "17.8.0    Output injection valve cut off"
 /begin DEF_CHARACTERISTIC ABMM4 CWEVAB InjSys_FcoCylInd_ATS_ATS.LimitTypeMsk_C InjSys_FcoCylInd_ATS_ATS.CnvNorm_C InjSys_FcoCylInd_ATS_ATS.LowLim_C InjSys_FcoCylInd_ATS_ATS.UpLim_C InjSys_FcoCylInd_ATS_ATS.CnvFac_C InjSys_FcoCylInd_ATS_ATS.CnvOfs_C InjSys_FcoCylInd_ATS_ATS.DfltVal_C /end DEF_CHARACTERISTIC
 /begin IN_MEASUREMENT B_faevz_msg devoff_msg eevbz_msg Epm_ctCyl MisfDet_stCatDmgFcoCyl TrqCnv_numRedStgDem /end IN_MEASUREMENT
 /begin OUT_MEASUREMENT abmf_msg B_dmdstop_msg eevx_msg evrbgn_one_msg evz_aus_msg fevab_msg stateaevab_msg /end OUT_MEASUREMENT
 /begin LOC_MEASUREMENT abmm anzsyn B_dmdevab B_fevab B_redsol dmdevab InjSys_bFcoCylIndTstr InjSys_ctCylOld InjSys_FcoCylIndTstr /end LOC_MEASUREMENT
 FUNCTION_VERSION "17.8.0" /end FUNCTION
/begin FUNCTION AEVABZK "7.11.0    Output injection-valve cut-off %MDRED + total shutdown by monitioring functions" /begin DEF_CHARACTERISTIC InjSys_agCalcIncGap /end DEF_CHARACTERISTIC
 /begin IN_MEASUREMENT B_dmdstop_msg B_evabu_msg B_koevab_msg B_stendes_msg Epm_ctCyl Epm_nEng Epm_numCyl evz_aus_msg InjDDPfi_injEnadCylMsk_msg MoCSOP_stActvMsg OCWDA_stErrMonPtt SyC_stSub tez_l_msg ThrVlv_flgLimpModeB1 ThrVlv_flgReqFuCutOffB1 weea_msg /end IN_MEASUREMENT
 /begin OUT_MEASUREMENT B_evasel_msg evz_auscpl_msg evz_austot_msg InjSys_flgCutOffReqTyp2 InjSys_flgNoInjReq /end OUT_MEASUREMENT
 /begin LOC_MEASUREMENT InjSys_agInjBgn InjSys_agSynToLstSyn InjSys_DeltaAgSyn InjSys_flgNoInjReq_PFI InjSys_stInjActv InjSys_stNxtInjActv zzyl_prev /end LOC_MEASUREMENT
 FUNCTION_VERSION "7.11.0" /end FUNCTION
/begin FUNCTION AirActr_OffsLrn "1.39.1    Adaptation of mechanical characteristic values" FUNCTION_VERSION "1.39.1" /end FUNCTION
/begin FUNCTION AirActr_PosnCtrl "1.36.0    Position Controller" FUNCTION_VERSION "1.36.0" /end FUNCTION
/begin FUNCTION AirActr_Sens "1.18.0    Position Sensor Evaluation" FUNCTION_VERSION "1.18.0" /end FUNCTION
/begin FUNCTION AirDvP_PSnsrAdpn "2.4.1     Calculation of offset values for pressure sensors"
 /begin DEF_CHARACTERISTIC AirDvP_flgAddEnaDly_C AirDvP_pEngStrtMax_C AirDvP_pEnvSpcSnsrTolr_C AirDvP_pIntkVUsSpcSnsrTolr_C AirDvP_tiDlyAftEngStop_C AirDvP_tiFilDifPEnv_C AirDvP_tiMaxSnsrAdpn_C /end DEF_CHARACTERISTIC
 /begin IN_MEASUREMENT B_psrgg_msg B_pugg_msg B_purg_msg Eep_EnvRamInvld Epm_stSpd PEnv_pRaw PIntkVUs_flgPRawVldB1 PIntkVUs_pRaw PIntkVUs_pRawIni PIntkVUs_stPresIniVld SyC_ctPostDrvLeave SyC_stSub /end IN_MEASUREMENT
 /begin OUT_MEASUREMENT AirDvP_flgEnaScc AirDvP_flgPIntkVUsStrtRngErrB1 AirDvP_flgPIntkVUsStrtRngHealB1 AirDvP_pEnvOffs AirDvP_pIntkVUsLdcB1 AirDvP_pIntkVUsOffsB1 B_epsrsg_msg B_fgfnpps_msg B_hepsrsg_msg ofpsr_w_msg ofpu_w ofpu_w_msg psrrldc_w_msg /end OUT_MEASUREMENT
 /begin LOC_MEASUREMENT AirDvP_flgEnaPMod AirDvP_flgEnaSccPEnv AirDvP_PEnvMax AirDvP_PEnvMin AirDvP_pIntkVUsOffsBndlsB1 /end LOC_MEASUREMENT
 FUNCTION_VERSION "2.4.1" /end FUNCTION
/begin FUNCTION AirMod_VlvLftCoorn "4.2.0     Coordination timing predicted aircharge and switching variable valve"
 /begin DEF_CHARACTERISTIC AirMod_agWidthCamProfIntk_C AirMod_agWidthCamProfLoLftIntk_C AirMod_cntrDlyVlvLftLftIntk_C AirMod_flgVlvLftIntkStrt_C AirMod_ratChrgDeltaVlvLftIntkThres_C /end DEF_CHARACTERISTIC
 /begin IN_MEASUREMENT B_fupivheg_msg B_rlvheg_msg B_vhegvss_msg drldvls_w_msg wpr_msg wvhesd_w_msg /end IN_MEASUREMENT
 /begin OUT_MEASUREMENT AirMod_flgCoVlvLft B_vhefeps_msg B_vhegabgn_msg /end OUT_MEASUREMENT
 /begin LOC_MEASUREMENT AirMod_cntrDlyPredVlvLftIntk asegvsyn B_vhefepsloc B_vhesynon /end LOC_MEASUREMENT
 FUNCTION_VERSION "4.2.0" /end FUNCTION
/begin FUNCTION AltECU_Lin "49.0.0_6SAALIN-Communikation for GEN-ECU"
 /begin DEF_CHARACTERISTIC ComAlt_iExctCrntOfs_C ComAlt_iExctCrntSlp_C ComAlt_rAltDycOfs_C ComAlt_rAltDycSlp_C ComAlt_tACGTempOfs_C ComAlt_tACGTempSlp_C ComAlt_tACGTempTypBMax_C ComAlt_tACGTempTypBMin_C /end DEF_CHARACTERISTIC
 /begin IN_MEASUREMENT Lin_Alt_B_Signal_ACG_Temp_8_r_msg Lin_Alt_B_Signal_ComTOut_1_r_msg Lin_Alt_B_Signal_Com_1_r_msg Lin_Alt_B_Signal_Dyc_5_r_msg Lin_Alt_B_Signal_Elec_1_r_msg Lin_Alt_B_Signal_ExctCrnt_8_r_msg Lin_Alt_B_Signal_HiTemp_1_r_msg Lin_Alt_B_Signal_Mchn_1_r_msg /end IN_MEASUREMENT
 /begin OUT_MEASUREMENT ComAlt_iExctCrnt ComAlt_iExctCrntTypB ComAlt_rAltDyc ComAlt_rAltDycTypB ComAlt_stCom ComAlt_stComTOut ComAlt_stComTOutTypB ComAlt_stComTypB ComAlt_stElec ComAlt_stElecTypB ComAlt_stHiTemp ComAlt_stHiTempTypB ComAlt_stMchn ComAlt_stMchnTypB ComAlt_tACGTemp ComAlt_tACGTempTypB Com_bALTErr Com_bDern Com_bElec Com_bMec Com_bTO Com_ratDyc /end OUT_MEASUREMENT
 FUNCTION_VERSION "49.0.0_6SAA" /end FUNCTION
/begin FUNCTION AltIO2MED "1.2.0     adapter for %AltIO_VD to map DE-variables to MED-world" /begin IN_MEASUREMENT AltIO_rAltLoad SyC_stSub /end IN_MEASUREMENT /begin OUT_MEASUREMENT kldfpwm /end OUT_MEASUREMENT FUNCTION_VERSION "1.2.0" /end FUNCTION
/begin FUNCTION AltIO_DD "9.1.2     Alternator Device Driver" /begin DEF_CHARACTERISTIC AltIO_rAltMdl_CUR AltIO_rErrSgn_C /end DEF_CHARACTERISTIC /begin IN_MEASUREMENT Com_rAltLoad Epm_nEng /end IN_MEASUREMENT /begin OUT_MEASUREMENT AltIO_rAlt AltIO_stQ /end OUT_MEASUREMENT FUNCTION_VERSION "9.1.2" /end FUNCTION
/begin FUNCTION AltIO_VD "17.12.0   Alternator Virtual Device"
 /begin DEF_CHARACTERISTIC AltIO_ATS.LimitTypeMsk_C AltIO_ATS.CnvNorm_C AltIO_ATS.LowLim_C AltIO_ATS.UpLim_C AltIO_ATS.CnvFac_C AltIO_ATS.CnvOfs_C AltIO_ATS.DfltVal_C AltIO_nEngACGVltg_C AltIO_nEngHiThdACGDiscnct_C AltIO_nEngThdACGDConn_C AltIO_nEngThdACGFailrLo_C AltIO_nEngThdACGFailr_C AltIO_nEngThdACGTHi_C AltIO_rACGFieDutyHi_C AltIO_rACGFieDutyLo_C AltIO_tiACGFieDuty_C AltIO_tiBattChrgLampOff_C AltIO_tiISLampOffDly_C AltIO_tThdACGTHi_C AltIO_uACGHealHiU_C AltIO_uACGHealLoU_C AltIO_uACGHiVltg_C AltIO_uACGLoVltg_C AltIO_uDconnACGThdLo_C AltIO_uDesDconnACGThd_C AltIO_uDiscnctACGThdOk_C /end DEF_CHARACTERISTIC
 /begin IN_MEASUREMENT Alt_uDes BattU_u ComAlt_rAltDyc ComAlt_tACGTempTypB Com_bElec Com_bMec Com_ratDyc CoVOM_bSSEEngStopPassed CoVOM_bSysOff CoVOM_stSSE Epm_nEng T15_st /end IN_MEASUREMENT
 /begin OUT_MEASUREMENT AltIO_nEngThdACGFailr AltIO_rAltLoad AltIO_stCon AltIO_tiLRAlt AltIO_uAltDes Alt_uFinalDes /end OUT_MEASUREMENT
 /begin LOC_MEASUREMENT AltIO_flgACGHiU AltIO_flgACGLoU AltIO_rACGFieDuty /end LOC_MEASUREMENT
 FUNCTION_VERSION "17.12.0" /end FUNCTION
/begin COMPU_METHOD AMPT_SOx1 "" RAT_FUNC "%6.4" "mg/s" COEFFS 0 333.333333333333 0 0 0 1 /end COMPU_METHOD
/begin COMPU_METHOD AngleIndexCpp "" RAT_FUNC "%6.2" "AgCA" COEFFS 0 -1 180 0 0 1 /end COMPU_METHOD
/begin COMPU_METHOD AngleStWhl "" RAT_FUNC "%6.4" "deg StWhl" COEFFS 0 32 0 0 0 1 /end COMPU_METHOD
/begin COMPU_METHOD AngleVelStWhl "" RAT_FUNC "%6.4" "deg StWhl/s" COEFFS 0 32 0 0 0 1 /end COMPU_METHOD
/begin COMPU_METHOD APPSWTECU_SY_Compu "" TAB_VERB "%6.3" "" COMPU_TAB_REF APPSWTECU_SY_Compu /end COMPU_METHOD
/begin COMPU_VTAB APPSWTECU_SY_Compu "" TAB_VERB 2 0 "FALSE" 1 "TRUE" /end COMPU_VTAB
/begin COMPU_METHOD APP_ATSENA_SC_Compu "" TAB_VERB "%6.3" "" COMPU_TAB_REF APP_ATSENA_SC_Compu /end COMPU_METHOD
/begin COMPU_VTAB APP_ATSENA_SC_Compu "" TAB_VERB 2 0 "False" 1 "True" /end COMPU_VTAB
/begin COMPU_METHOD APP_CHN1_SSPMONNUM_SY_Compu "" TAB_VERB "%6.3" "" COMPU_TAB_REF APP_CHN1_SSPMONNUM_SY_Compu /end COMPU_METHOD
/begin COMPU_VTAB APP_CHN1_SSPMONNUM_SY_Compu "" TAB_VERB 4 0 "NOTUSED" 1 "SSpMon1" 2 "SSpMon2" 3 "SSpMon3" /end COMPU_VTAB
/begin COMPU_METHOD APP_CHN2_SSPMONNUM_SY_Compu "" TAB_VERB "%6.3" "" COMPU_TAB_REF APP_CHN2_SSPMONNUM_SY_Compu /end COMPU_METHOD
/begin COMPU_VTAB APP_CHN2_SSPMONNUM_SY_Compu "" TAB_VERB 4 0 "NOTUSED" 1 "SSpMon1" 2 "SSpMon2" 3 "SSpMon3" /end COMPU_VTAB
/begin COMPU_METHOD APP_ENADFCPLAUSBRK_SY_Compu "" TAB_VERB "%6.3" "" COMPU_TAB_REF APP_ENADFCPLAUSBRK_SY_Compu /end COMPU_METHOD
/begin COMPU_VTAB APP_ENADFCPLAUSBRK_SY_Compu "" TAB_VERB 2 0 "0" 1 "1" /end COMPU_VTAB
/begin COMPU_METHOD APP_ENAFLT_SY_Compu "" TAB_VERB "%6.3" "" COMPU_TAB_REF APP_ENAFLT_SY_Compu /end COMPU_METHOD
/begin COMPU_VTAB APP_ENAFLT_SY_Compu "" TAB_VERB 2 0 "0" 1 "1" /end COMPU_VTAB
/begin COMPU_METHOD APP_ENAOSCNDETN_SC_Compu "" TAB_VERB "%6.3" "" COMPU_TAB_REF APP_ENAOSCNDETN_SC_Compu /end COMPU_METHOD
/begin COMPU_VTAB APP_ENAOSCNDETN_SC_Compu "" TAB_VERB 2 0 "False" 1 "True" /end COMPU_VTAB
/begin COMPU_METHOD APP_ENAUNJIT_SY_Compu "" TAB_VERB "%6.3" "" COMPU_TAB_REF APP_ENAUNJIT_SY_Compu /end COMPU_METHOD
/begin COMPU_VTAB APP_ENAUNJIT_SY_Compu "" TAB_VERB 2 0 "0" 1 "1" /end COMPU_VTAB
/begin COMPU_METHOD APP_LEARNFULLLD_SY_Compu "" TAB_VERB "%6.3" "" COMPU_TAB_REF APP_LEARNFULLLD_SY_Compu /end COMPU_METHOD
/begin COMPU_VTAB APP_LEARNFULLLD_SY_Compu "" TAB_VERB 2 0 "0" 1 "1" /end COMPU_VTAB
/begin COMPU_METHOD APP_PLAUSBRKMONAVL_SC_Compu "" TAB_VERB "%6.3" "" COMPU_TAB_REF APP_PLAUSBRKMONAVL_SC_Compu /end COMPU_METHOD
/begin COMPU_VTAB APP_PLAUSBRKMONAVL_SC_Compu "" TAB_VERB 2 0 "False" 1 "True" /end COMPU_VTAB
/begin COMPU_METHOD APP_PWMOUT_SC_Compu "" TAB_VERB "%6.3" "" COMPU_TAB_REF APP_PWMOUT_SC_Compu /end COMPU_METHOD
/begin COMPU_VTAB APP_PWMOUT_SC_Compu "" TAB_VERB 2 0 "False" 1 "True" /end COMPU_VTAB
/begin COMPU_METHOD APP_SC_Compu "" RAT_FUNC "%6.2" "" COEFFS 0 1 0 0 0 1 /end COMPU_METHOD
/begin COMPU_METHOD APP_SIGREADINGSRC_SC_Compu "" TAB_VERB "%6.3" "" COMPU_TAB_REF APP_SIGREADINGSRC_SC_Compu /end COMPU_METHOD
/begin COMPU_VTAB APP_SIGREADINGSRC_SC_Compu "" TAB_VERB 3 0 "ADC" 1 "SENT" 2 "ADC_SENT" /end COMPU_VTAB
/begin COMPU_METHOD APP_SWTPLAUSBRKSRC_SC_Compu "" TAB_VERB "%6.3" "" COMPU_TAB_REF APP_SWTPLAUSBRKSRC_SC_Compu /end COMPU_METHOD
/begin COMPU_VTAB APP_SWTPLAUSBRKSRC_SC_Compu "" TAB_VERB 2 0 "0" 1 "1" /end COMPU_VTAB
/begin COMPU_METHOD ARBLD_SC_Compu "" TAB_VERB "%6.3" "" COMPU_TAB_REF ARBLD_SC_Compu /end COMPU_METHOD
/begin COMPU_VTAB ARBLD_SC_Compu "" TAB_VERB 4 0 "NonAR" 1 "PCLT" 2 "PBL" 3 "PBS" /end COMPU_VTAB
/begin COMPU_METHOD Area2EffGrad "" RAT_FUNC "%6.4" "1/(cm^2*s)" COEFFS 0 100 0 0 0 1 /end COMPU_METHOD
/begin COMPU_METHOD Area_cm2 "" RAT_FUNC "%6.5" "cm*cm" COEFFS 0 1000 0 0 0 1 /end COMPU_METHOD
/begin COMPU_METHOD Area_cm2_float "" RAT_FUNC "%6.2" "cm*cm" COEFFS 0 1 0 0 0 1 /end COMPU_METHOD
/begin COMPU_METHOD Area_cm2_Low "" RAT_FUNC "%6.4" "cm*cm" COEFFS 0 250 0 0 0 1 /end COMPU_METHOD
/begin COMPU_METHOD ARVERS_SC_Compu "" TAB_VERB "%6.3" "" COMPU_TAB_REF ARVERS_SC_Compu /end COMPU_METHOD
/begin COMPU_VTAB ARVERS_SC_Compu "" TAB_VERB 3 0 "0" 1 "1" 2 "2" /end COMPU_VTAB
/begin COMPU_METHOD ASCET_mem_Integ "" RAT_FUNC "%12.11" "" COEFFS 0 2147483648 0 0 0 1 /end COMPU_METHOD
/begin COMPU_METHOD ASDCTL_NRGEARTRSM_SC_Compu "" TAB_VERB "%6.3" "" COMPU_TAB_REF ASDCTL_NRGEARTRSM_SC_Compu /end COMPU_METHOD
/begin COMPU_VTAB ASDCTL_NRGEARTRSM_SC_Compu "" TAB_VERB 2 0 "False" 1 "True" /end COMPU_VTAB
/begin COMPU_METHOD ASDCTL_TQLVL_SC_Compu "" TAB_VERB "%6.3" "" COMPU_TAB_REF ASDCTL_TQLVL_SC_Compu /end COMPU_METHOD
/begin COMPU_VTAB ASDCTL_TQLVL_SC_Compu "" TAB_VERB 2 0 "0" 1 "1" /end COMPU_VTAB
/begin COMPU_METHOD ASDCTL_VAR_SY_Compu "" TAB_VERB "%6.3" "" COMPU_TAB_REF ASDCTL_VAR_SY_Compu /end COMPU_METHOD
/begin COMPU_VTAB ASDCTL_VAR_SY_Compu "" TAB_VERB 47 1 "DAI" 3 "VWW" 4 "POR" 5 "AUD" 6 "OPE" 9 "FIA" 11 "BMW" 14 "PSA" 15 "REN" 17 "ALF" 18 "SAB" 19 "VOL" 20 "NIS" 21 "GMU" 22 "FOR" 26 "ISZ" 51 "SEA" 53 "CHR" 54 "JAG" 55 "ROL" 69 "FER" 72 "TOY" 123 "MIT" 147 "HYU" 159 "HON" 160 "MAZ" 183 "CU" 190 "LRG" 204 "VVW" 214 "AVT" 242 "Iveco" 243 "DMC" 248 "SUZ" 267 "SSANGYONG" 270 "KEF" 289 "AMG" 308 "TAT" 319 "MVM" 328 "MM" 385 "UAES" 590 "Scania" 828 "RBCD" 898 "MFTBC" 999 "ALL" 2887 "Nonox" 9454 "Fuso" 9744 "McLaren" /end COMPU_VTAB
/begin COMPU_METHOD ASDDC_CONTTRQINC_SY_Compu "" TAB_VERB "%6.3" "" COMPU_TAB_REF ASDDC_CONTTRQINC_SY_Compu /end COMPU_METHOD
/begin COMPU_VTAB ASDDC_CONTTRQINC_SY_Compu "" TAB_VERB 2 0 "0" 1 "1" /end COMPU_VTAB
/begin COMPU_METHOD ASDDC_GEARNRMAXSIZE_SC_Compu "" RAT_FUNC "%6.2" "" COEFFS 0 1 0 0 0 1 /end COMPU_METHOD
/begin COMPU_METHOD ASDDC_NENGSIZE_SY_Compu "" RAT_FUNC "%6.2" "" COEFFS 0 1 0 0 0 1 /end COMPU_METHOD
/begin COMPU_METHOD ASDDC_NRNG_SY_Compu "" TAB_VERB "%6.3" "" COMPU_TAB_REF ASDDC_NRNG_SY_Compu /end COMPU_METHOD
/begin COMPU_VTAB ASDDC_NRNG_SY_Compu "" TAB_VERB 2 0 "0" 1 "1" /end COMPU_VTAB
/begin COMPU_METHOD ASDDC_STY_SY_Compu "" TAB_VERB "%6.3" "" COMPU_TAB_REF ASDDC_STY_SY_Compu /end COMPU_METHOD
/begin COMPU_VTAB ASDDC_STY_SY_Compu "" TAB_VERB 2 0 "0" 1 "1" /end COMPU_VTAB
/begin COMPU_METHOD ASDRF_ENA_SC_Compu "" TAB_VERB "%6.3" "" COMPU_TAB_REF ASDRF_ENA_SC_Compu /end COMPU_METHOD
/begin COMPU_VTAB ASDRF_ENA_SC_Compu "" TAB_VERB 2 0 "0" 1 "1" /end COMPU_VTAB
/begin COMPU_METHOD ASDRF_FACDESDYNSIZE_SY_Compu "" RAT_FUNC "%6.2" "" COEFFS 0 1 0 0 0 1 /end COMPU_METHOD
/begin COMPU_METHOD ASDRF_FCOPAR_SY_Compu "" TAB_VERB "%6.3" "" COMPU_TAB_REF ASDRF_FCOPAR_SY_Compu /end COMPU_METHOD
/begin COMPU_VTAB ASDRF_FCOPAR_SY_Compu "" TAB_VERB 2 0 "False" 1 "True" /end COMPU_VTAB
/begin COMPU_METHOD ASDRF_GEARNRMAXSIZE_SC_Compu "" RAT_FUNC "%6.2" "" COEFFS 0 1 0 0 0 1 /end COMPU_METHOD
/begin COMPU_METHOD ASDRF_GRDTLIM_SC_Compu "" TAB_VERB "%6.3" "" COMPU_TAB_REF ASDRF_GRDTLIM_SC_Compu /end COMPU_METHOD
/begin COMPU_VTAB ASDRF_GRDTLIM_SC_Compu "" TAB_VERB 2 0 "False" 1 "True" /end COMPU_VTAB
/begin COMPU_METHOD ASDRF_NENGSIZE_SY_Compu "" RAT_FUNC "%6.2" "" COEFFS 0 1 0 0 0 1 /end COMPU_METHOD
/begin COMPU_METHOD ASDRF_NOGRIPPAR_SY_Compu "" TAB_VERB "%6.3" "" COMPU_TAB_REF ASDRF_NOGRIPPAR_SY_Compu /end COMPU_METHOD
/begin COMPU_VTAB ASDRF_NOGRIPPAR_SY_Compu "" TAB_VERB 2 0 "False" 1 "True" /end COMPU_VTAB
/begin COMPU_METHOD ASDRF_RGRIP_SY_Compu "" TAB_VERB "%6.3" "" COMPU_TAB_REF ASDRF_RGRIP_SY_Compu /end COMPU_METHOD
/begin COMPU_VTAB ASDRF_RGRIP_SY_Compu "" TAB_VERB 2 0 "False" 1 "True" /end COMPU_VTAB
/begin COMPU_METHOD ASDRF_RTRQSIZE_SY_Compu "" RAT_FUNC "%6.2" "" COEFFS 0 1 0 0 0 1 /end COMPU_METHOD
/begin COMPU_METHOD ASDRF_STDCALPRMRECHEV_SC_Compu "" TAB_VERB "%6.3" "" COMPU_TAB_REF ASDRF_STDCALPRMRECHEV_SC_Compu /end COMPU_METHOD
/begin COMPU_VTAB ASDRF_STDCALPRMRECHEV_SC_Compu "" TAB_VERB 2 0 "False" 1 "True" /end COMPU_VTAB
/begin COMPU_METHOD ASD_INHOUSE_SC_Compu "" TAB_VERB "%6.3" "" COMPU_TAB_REF ASD_INHOUSE_SC_Compu /end COMPU_METHOD
/begin COMPU_VTAB ASD_INHOUSE_SC_Compu "" TAB_VERB 2 0 "False" 1 "True" /end COMPU_VTAB
/begin COMPU_METHOD AshEGMassPerTime "" RAT_FUNC "%6.5" "mg/s" COEFFS 0 2000 0 0 0 1 /end COMPU_METHOD
/begin COMPU_METHOD AshMassPerTime "" RAT_FUNC "%6.4" "mg/s" COEFFS 0 100 0 0 0 1 /end COMPU_METHOD
/begin COMPU_METHOD AshMs_g_p0q1_COMPU "" RAT_FUNC "%6.3" "g" COEFFS 0 10 0 0 0 1 /end COMPU_METHOD
/begin COMPU_METHOD AshMs_mg_p0q0016_COMPU "" RAT_FUNC "%6.4" "mg" COEFFS 0 625 0 0 0 1 /end COMPU_METHOD
/begin COMPU_METHOD ASModPrcPerSec_COMPU "" RAT_FUNC "%6.3" "%/s" COEFFS 0 1.6384 0 0 0 1 /end COMPU_METHOD
/begin COMPU_METHOD ATSENA_SC_Compu "" TAB_VERB "%6.3" "" COMPU_TAB_REF ATSENA_SC_Compu /end COMPU_METHOD
/begin COMPU_VTAB ATSENA_SC_Compu "" TAB_VERB 2 0 "False" 1 "True" /end COMPU_VTAB
/begin COMPU_METHOD ATS_BRK_APP_SC_Compu "" TAB_VERB "%6.3" "" COMPU_TAB_REF ATS_BRK_APP_SC_Compu /end COMPU_METHOD
/begin COMPU_VTAB ATS_BRK_APP_SC_Compu "" TAB_VERB 2 0 "False" 1 "True" /end COMPU_VTAB
/begin COMPU_METHOD AUTOSTRT_SY_Compu "" TAB_VERB "%6.3" "" COMPU_TAB_REF AUTOSTRT_SY_Compu /end COMPU_METHOD
/begin COMPU_VTAB AUTOSTRT_SY_Compu "" TAB_VERB 2 0 "no automatic start functionality" 1 "with automatic start functionality" /end COMPU_VTAB
/begin COMPU_METHOD AUTSHRTTRP_SY_Compu "" TAB_VERB "%6.3" "" COMPU_TAB_REF AUTSHRTTRP_SY_Compu /end COMPU_METHOD
/begin COMPU_VTAB AUTSHRTTRP_SY_Compu "" TAB_VERB 2 0 "False" 1 "True" /end COMPU_VTAB
/begin COMPU_METHOD AUXPWRRLY_TYPAVL_SC_Compu "" TAB_VERB "%6.3" "" COMPU_TAB_REF AUXPWRRLY_TYPAVL_SC_Compu /end COMPU_METHOD
/begin COMPU_VTAB AUXPWRRLY_TYPAVL_SC_Compu "" TAB_VERB 2 0 "False" 1 "True" /end COMPU_VTAB
/begin COMPU_METHOD AVSVLEX_SY_Compu "" TAB_VERB "%6.3" "" COMPU_TAB_REF AVSVLEX_SY_Compu /end COMPU_METHOD
/begin COMPU_VTAB AVSVLEX_SY_Compu "" TAB_VERB 2 0 "False" 1 "True" /end COMPU_VTAB
/begin COMPU_METHOD AVSVLIN_SY_Compu "" TAB_VERB "%6.3" "" COMPU_TAB_REF AVSVLIN_SY_Compu /end COMPU_METHOD
/begin COMPU_VTAB AVSVLIN_SY_Compu "" TAB_VERB 2 0 "False" 1 "True" /end COMPU_VTAB
/begin COMPU_METHOD AVSVL_INHOUSE_SC_Compu "" TAB_VERB "%6.3" "" COMPU_TAB_REF AVSVL_INHOUSE_SC_Compu /end COMPU_METHOD
/begin COMPU_VTAB AVSVL_INHOUSE_SC_Compu "" TAB_VERB 2 0 "False" 1 "True" /end COMPU_VTAB
/begin COMPU_METHOD AWD_SY_Compu "" TAB_VERB "%6.3" "" COMPU_TAB_REF AWD_SY_Compu /end COMPU_METHOD
/begin COMPU_VTAB AWD_SY_Compu "" TAB_VERB 3 0 "0" 1 "1" 2 "2" /end COMPU_VTAB
/begin COMPU_METHOD BASSVRAPPL_EXTSTIIFENA_SC_Compu "" TAB_VERB "%6.3" "" COMPU_TAB_REF BASSVRAPPL_EXTSTIIFENA_SC_Compu /end COMPU_METHOD
/begin COMPU_VTAB BASSVRAPPL_EXTSTIIFENA_SC_Compu "" TAB_VERB 2 0 "EXTSTIIF_DISABLE" 1 "EXTSTIIF_ENABLEV1" /end COMPU_VTAB
/begin COMPU_METHOD BATTDETERNDETNTYP_SC_Compu "" TAB_VERB "%6.3" "" COMPU_TAB_REF BATTDETERNDETNTYP_SC_Compu /end COMPU_METHOD
/begin COMPU_VTAB BATTDETERNDETNTYP_SC_Compu "" TAB_VERB 2 0 "NO_AGING_0" 1 "DETERN_1" /end COMPU_VTAB
/begin COMPU_METHOD BATTSENS_SY_Compu "" TAB_VERB "%6.3" "" COMPU_TAB_REF BATTSENS_SY_Compu /end COMPU_METHOD
/begin COMPU_VTAB BATTSENS_SY_Compu "" TAB_VERB 2 0 "False" 1 "True" /end COMPU_VTAB
/begin COMPU_METHOD BATTUDIAGRIPPLEACTV_SC_Compu "" TAB_VERB "%6.3" "" COMPU_TAB_REF BATTUDIAGRIPPLEACTV_SC_Compu /end COMPU_METHOD
/begin COMPU_VTAB BATTUDIAGRIPPLEACTV_SC_Compu "" TAB_VERB 2 0 "False" 1 "True" /end COMPU_VTAB
/begin COMPU_METHOD BBCC_SC_Compu "" TAB_VERB "%6.3" "" COMPU_TAB_REF BBCC_SC_Compu /end COMPU_METHOD
/begin COMPU_VTAB BBCC_SC_Compu "" TAB_VERB 2 0 "False" 1 "True" /end COMPU_VTAB
/begin COMPU_METHOD BBSAFG_SUPRTATS_SC_Compu "" TAB_VERB "%6.3" "" COMPU_TAB_REF BBSAFG_SUPRTATS_SC_Compu /end COMPU_METHOD
/begin COMPU_VTAB BBSAFG_SUPRTATS_SC_Compu "" TAB_VERB 2 0 "False" 1 "True" /end COMPU_VTAB
/begin COMPU_METHOD BBSTVE_SY_Compu "" TAB_VERB "%6.3" "" COMPU_TAB_REF BBSTVE_SY_Compu /end COMPU_METHOD
/begin COMPU_VTAB BBSTVE_SY_Compu "" TAB_VERB 2 0 "False" 1 "True" /end COMPU_VTAB
/begin COMPU_METHOD BGBVG_SY_Compu "" TAB_VERB "%6.3" "" COMPU_TAB_REF BGBVG_SY_Compu /end COMPU_METHOD
/begin COMPU_VTAB BGBVG_SY_Compu "" TAB_VERB 4 0 "0" 1 "1" 2 "2" 3 "3" /end COMPU_VTAB
/begin COMPU_METHOD BLOWRIFTYP_SC_Compu "" TAB_VERB "%6.3" "" COMPU_TAB_REF BLOWRIFTYP_SC_Compu /end COMPU_METHOD
/begin COMPU_VTAB BLOWRIFTYP_SC_Compu "" TAB_VERB 7 0 "BLOWRIFTYP_NON" 1 "BLOWRIFTYP_DIG" 2 "BLOWRIFTYP_ADC" 3 "BLOWRIFTYP_MISC" 4 "BLOWRIFTYP_BUS" 5 "BLOWRIFTYP_BUS_DIG" 6 "BLOWRIFTYP_BUS_ADC" /end COMPU_VTAB
/begin COMPU_METHOD BMW_PRODUCTLINE_SY_Compu "" TAB_VERB "%6.3" "" COMPU_TAB_REF BMW_PRODUCTLINE_SY_Compu /end COMPU_METHOD
/begin COMPU_VTAB BMW_PRODUCTLINE_SY_Compu "" TAB_VERB 11 0 "no BMW productline" 1 "L1" 2 "L2" 3 "L3" 4 "L4" 5 "L5" 6 "L6" 7 "L7" 8 "L8" 9 "L9" 10 "L10" /end COMPU_VTAB
/begin COMPU_METHOD BRKBOOSTTQLIMN_SC_Compu "" TAB_VERB "%6.3" "" COMPU_TAB_REF BRKBOOSTTQLIMN_SC_Compu /end COMPU_METHOD
/begin COMPU_VTAB BRKBOOSTTQLIMN_SC_Compu "" TAB_VERB 2 0 "False" 1 "True" /end COMPU_VTAB
/begin COMPU_METHOD BRKBOOST_INHOUSE_SC_Compu "" TAB_VERB "%6.3" "" COMPU_TAB_REF BRKBOOST_INHOUSE_SC_Compu /end COMPU_METHOD
/begin COMPU_VTAB BRKBOOST_INHOUSE_SC_Compu "" TAB_VERB 2 0 "False" 1 "True" /end COMPU_VTAB
/begin COMPU_METHOD BRKBSTMVP_SY_Compu "" TAB_VERB "%6.3" "" COMPU_TAB_REF BRKBSTMVP_SY_Compu /end COMPU_METHOD
/begin COMPU_VTAB BRKBSTMVP_SY_Compu "" TAB_VERB 2 0 "NO_BRKBSTMVP" 1 "BRKBSTMVP_MECH" /end COMPU_VTAB
/begin COMPU_METHOD BRKBSTP2_TYPAVL_SC_Compu "" TAB_VERB "%6.3" "" COMPU_TAB_REF BRKBSTP2_TYPAVL_SC_Compu /end COMPU_METHOD
/begin COMPU_VTAB BRKBSTP2_TYPAVL_SC_Compu "" TAB_VERB 2 0 "False" 1 "True" /end COMPU_VTAB
/begin COMPU_METHOD BRKBSTPMDLENA_SC_Compu "" TAB_VERB "%6.3" "" COMPU_TAB_REF BRKBSTPMDLENA_SC_Compu /end COMPU_METHOD
/begin COMPU_VTAB BRKBSTPMDLENA_SC_Compu "" TAB_VERB 2 0 "No brake booster pressure model" 1 "Brake booster pressure Model" /end COMPU_VTAB
/begin COMPU_METHOD BRKBSTPMP_SC_Compu "" TAB_VERB "%6.3" "" COMPU_TAB_REF BRKBSTPMP_SC_Compu /end COMPU_METHOD
/begin COMPU_VTAB BRKBSTPMP_SC_Compu "" TAB_VERB 2 0 "False" 1 "True" /end COMPU_VTAB
/begin COMPU_METHOD BRKBSTP_OFFSPLAUSCHKENA_SC_Compu "" TAB_VERB "%6.3" "" COMPU_TAB_REF BRKBSTP_OFFSPLAUSCHKENA_SC_Compu /end COMPU_METHOD
/begin COMPU_VTAB BRKBSTP_OFFSPLAUSCHKENA_SC_Compu "" TAB_VERB 2 0 "False" 1 "True" /end COMPU_VTAB
/begin COMPU_METHOD BRKBSTP_SNSRCANMSGERRENA_SC_Compu "" TAB_VERB "%6.3" "" COMPU_TAB_REF BRKBSTP_SNSRCANMSGERRENA_SC_Compu /end COMPU_METHOD
/begin COMPU_VTAB BRKBSTP_SNSRCANMSGERRENA_SC_Compu "" TAB_VERB 2 0 "False" 1 "True" /end COMPU_VTAB
/begin COMPU_METHOD BRKBSTP_SWTADC_SC_Compu "" TAB_VERB "%6.3" "" COMPU_TAB_REF BRKBSTP_SWTADC_SC_Compu /end COMPU_METHOD
/begin COMPU_VTAB BRKBSTP_SWTADC_SC_Compu "" TAB_VERB 2 0 "False" 1 "True" /end COMPU_VTAB
/begin COMPU_METHOD BRKBSTP_SWTCAN_SC_Compu "" TAB_VERB "%6.3" "" COMPU_TAB_REF BRKBSTP_SWTCAN_SC_Compu /end COMPU_METHOD
/begin COMPU_VTAB BRKBSTP_SWTCAN_SC_Compu "" TAB_VERB 2 0 "False" 1 "True" /end COMPU_VTAB
/begin COMPU_METHOD BRKBSTP_SWTPLAUSCNS_SC_Compu "" TAB_VERB "%6.3" "" COMPU_TAB_REF BRKBSTP_SWTPLAUSCNS_SC_Compu /end COMPU_METHOD
/begin COMPU_VTAB BRKBSTP_SWTPLAUSCNS_SC_Compu "" TAB_VERB 2 0 "False" 1 "True" /end COMPU_VTAB
/begin COMPU_METHOD BRKBSTP_TYPAVL_SC_Compu "" TAB_VERB "%6.3" "" COMPU_TAB_REF BRKBSTP_TYPAVL_SC_Compu /end COMPU_METHOD
/begin COMPU_VTAB BRKBSTP_TYPAVL_SC_Compu "" TAB_VERB 2 0 "False" 1 "True" /end COMPU_VTAB
/begin COMPU_METHOD B_TRUE "" TAB_VERB "%6.3" "" COMPU_TAB_REF B_TRUE /end COMPU_METHOD
/begin COMPU_VTAB B_TRUE "" TAB_VERB 2 0 "FALSE" 1 "TRUE" /end COMPU_VTAB
/begin COMPU_METHOD Curr "" RAT_FUNC "%6.2" "mA" COEFFS 0 1 0 0 0 1 /end COMPU_METHOD
/begin COMPU_METHOD dez "" RAT_FUNC "%6.2" "" COEFFS 0 1 0 0 0 1 /end COMPU_METHOD
/begin COMPU_METHOD dfp_verbal "" TAB_VERB "%6.3" "-" COMPU_TAB_REF dfp_verbal /end COMPU_METHOD
/begin COMPU_VTAB dfp_verbal "" TAB_VERB 59 0 "DFP_AAA" 1 "DFP_AGRE" 2 "DFP_AGRL" 3 "DFP_DK" 4 "DFP_DK1P" 5 "DFP_DK2P" 6 "DFP_DKVS" 7 "DFP_DSS" 8 "DFP_DSU" 9 "DFP_DVEE" 10 "DFP_DVEF" 11 "DFP_DVEFO" 12 "DFP_DVEL" 13 "DFP_DVEN" 14 "DFP_DVER" 15 "DFP_DVEU" 16 "DFP_DVEUB" 17 "DFP_DVEUW" 18 "DFP_DYLSU" 19 "DFP_FP1P" 20 "DFP_FP2P" 21 "DFP_FRA" 22 "DFP_HSH" 23 "DFP_HSHE" 24 "DFP_KAT" 25 "DFP_KPE" 26 "DFP_KS1" 27 "DFP_LASH" 28 "DFP_LLR" 29 "DFP_LLRKH" 30 "DFP_LM" 31 "DFP_LSH" 32 "DFP_LZSR" 33 "DFP_MD" 34 "DFP_ORA" 35 "DFP_PLLSU" 36 "DFP_PS2E" 37 "DFP_PSR" 38 "DFP_PSR1" 39 "DFP_PSRB" 40 "DFP_PSRE" 41 "DFP_PSRP" 42 "DFP_PU" 43 "DFP_PUE" 44 "DFP_PUPL" 45 "DFP_PUR" 46 "DFP_TA" 47 "DFP_TASRCS" 48 "DFP_TASRE" 49 "DFP_TASRPRC" 50 "DFP_TASRR" 51 "DFP_TEVE" 52 "DFP_TM" 53 "DFP_TMCS" 54 "DFP_TME" 55 "DFP_TMP" 56 "DFP_UB" 57 "DFP_VFZ" 58 "DFP_ZZZ" DEFAULT_VALUE "---" /end COMPU_VTAB
/begin COMPU_METHOD DtyCyc "" RAT_FUNC "%6.4" "%" COEFFS 0 100 0 0 0 1 /end COMPU_METHOD
/begin COMPU_METHOD EngN "" RAT_FUNC "%6.3" "rpm" COEFFS 0 2 0 0 0 1 /end COMPU_METHOD
/begin COMPU_METHOD Fact "" RAT_FUNC "%6.5" "-" COEFFS 0 8192 0 0 0 1 /end COMPU_METHOD
/begin COMPU_METHOD Fact100 "" RAT_FUNC "%6.4" "-" COEFFS 0 100 0 0 0 1 /end COMPU_METHOD
/begin COMPU_METHOD Fact1000 "" RAT_FUNC "%6.5" "-" COEFFS 0 1000 0 0 0 1 /end COMPU_METHOD
/begin COMPU_METHOD Fact_10000 "" RAT_FUNC "%7.6" "-" COEFFS 0 10000 0 0 0 1 /end COMPU_METHOD
/begin COMPU_METHOD fak_q0p01 "" RAT_FUNC "%6.4" "" COEFFS 0 100 0 0 0 1 /end COMPU_METHOD
/begin COMPU_METHOD fak_ub_b2 "" RAT_FUNC "%8.5" "-" COEFFS 0 256 0 0 0 2 /end COMPU_METHOD
/begin COMPU_METHOD InjMsPrTime_q0p001_COMPU "" RAT_FUNC "%6.5" "Kg/h" COEFFS 0 1000 0 0 0 1 /end COMPU_METHOD
/begin COMPU_METHOD i_q1_mA "" RAT_FUNC "%6.2" "mA" COEFFS 0 1 0 0 0 1 /end COMPU_METHOD
/begin COMPU_METHOD kw_q0p0156 "" RAT_FUNC "%6.4" "Grad KW" COEFFS 0 64 0 0 0 1 /end COMPU_METHOD
/begin COMPU_METHOD kw_q0p0234 "" RAT_FUNC "%6.4" "Grad KW" COEFFS 0 32768 0 0 0 768 /end COMPU_METHOD
/begin COMPU_METHOD kw_q6 "" RAT_FUNC "%6.2" "Grad KW" COEFFS 0 1 0 0 0 6 /end COMPU_METHOD
/begin COMPU_METHOD md_q0p1 "" RAT_FUNC "%6.3" "Nm" COEFFS 0 10 0 0 0 1 /end COMPU_METHOD
/begin COMPU_METHOD nmot_sw_q0p5 "" RAT_FUNC "%6.3" "1/min" COEFFS 0 2 0 0 0 1 /end COMPU_METHOD
/begin COMPU_METHOD O2MassPerTime "" RAT_FUNC "%6.4" "Kg/h" COEFFS 0 100 0 0 0 1 /end COMPU_METHOD
/begin COMPU_METHOD OneToOne "" RAT_FUNC "%6.2" "-" COEFFS 0 1 0 0 0 1 /end COMPU_METHOD
/begin COMPU_METHOD Prc "" RAT_FUNC "%6.4" "%" COEFFS 0 81.92 0 0 0 1 /end COMPU_METHOD
/begin COMPU_METHOD PrcPerSec "" RAT_FUNC "%6.3" "%/s" COEFFS 0 1.6384 0 0 0 1 /end COMPU_METHOD
/begin COMPU_METHOD Prc_Fact100 "" RAT_FUNC "%6.4" "%" COEFFS 0 100 0 0 0 1 /end COMPU_METHOD
/begin COMPU_METHOD PresAC_hPa "" RAT_FUNC "%6.2" "hPa" COEFFS 0 0.5 0 0 0 1 /end COMPU_METHOD
/begin COMPU_METHOD Pwr2 "" RAT_FUNC "%6.1" "W" COEFFS 0 0.0530516476972949 0 0 0 1 /end COMPU_METHOD
/begin COMPU_METHOD p_q0p039 "" RAT_FUNC "%6.4" "hPa" COEFFS 0 256 0 0 0 10 /end COMPU_METHOD
/begin COMPU_METHOD p_q0p078 "" RAT_FUNC "%6.4" "hPa" COEFFS 0 64 0 0 0 5 /end COMPU_METHOD
/begin COMPU_METHOD p_sw_q0p039 "" RAT_FUNC "%6.4" "hPa" COEFFS 0 256 0 0 0 10 /end COMPU_METHOD
/begin COMPU_METHOD p_uw_b32 "" RAT_FUNC "%6.5" "hPa/%" COEFFS 0 65536 0 0 0 32 /end COMPU_METHOD
/begin COMPU_METHOD p_uw_q0p039 "" RAT_FUNC "%6.4" "hPa" COEFFS 0 256 0 0 0 10 /end COMPU_METHOD
/begin COMPU_METHOD q0p0001_Perc "" RAT_FUNC "%7.6" "%" COEFFS 0 10000 0 0 0 1 /end COMPU_METHOD
/begin COMPU_METHOD RBPtCel_Curr_A_q0p005 "" RAT_FUNC "%6.4" "A" COEFFS 0 200 0 0 0 1 /end COMPU_METHOD
/begin COMPU_METHOD RBPtCel_Curr_mA_q0p01 "" RAT_FUNC "%6.3" "mA" COEFFS 0 10 0 0 0 1 /end COMPU_METHOD
/begin COMPU_METHOD RBPtCel_p_0p0001_2 "" RAT_FUNC "%7.6" "kPa" COEFFS 0 10000 0 0 0 1 /end COMPU_METHOD
/begin COMPU_METHOD RBPtCel_p_1p0_1 "" RAT_FUNC "%6.2" "hPa" COEFFS 0 1 0 0 0 1 /end COMPU_METHOD
/begin COMPU_METHOD RBPtCel_p_1p0_3 "" RAT_FUNC "%6.2" "kPa" COEFFS 0 1 0 0 0 1 /end COMPU_METHOD
/begin COMPU_METHOD RBPtCel_Tq2Fact_q0p001 "" RAT_FUNC "%6.5" "1/Nm" COEFFS 0 1000 0 0 0 1 /end COMPU_METHOD
/begin COMPU_METHOD RBPtCel_tq_0p0001_1 "" RAT_FUNC "%7.6" "Nm" COEFFS 0 10000 0 0 0 1 /end COMPU_METHOD
/begin COMPU_METHOD RBPtCel_t_0p0001_1 "" RAT_FUNC "%7.6" "kJ/kg" COEFFS 0 10000 0 0 0 1 /end COMPU_METHOD
/begin COMPU_METHOD RBPtCel_t_0p01_2 "" RAT_FUNC "%6.4" "kJ/kg" COEFFS 0 100 0 0 0 1 /end COMPU_METHOD
/begin COMPU_METHOD rel_q0p0234 "" RAT_FUNC "%6.4" "%" COEFFS 0 128 0 0 0 3 /end COMPU_METHOD
/begin COMPU_METHOD rel_ub_b100 "" RAT_FUNC "%6.3" "%" COEFFS 0 256 0 0 0 100 /end COMPU_METHOD
/begin COMPU_METHOD rel_uw_b200 "" RAT_FUNC "%6.4" "%" COEFFS 0 65536 0 0 0 200 /end COMPU_METHOD
/begin COMPU_METHOD spg_uw_q0p00488 "" RAT_FUNC "%6.4" "V" COEFFS 0 1024 0 0 0 5 /end COMPU_METHOD
/begin COMPU_METHOD TempDiff_Cels "" RAT_FUNC "%6.3" "deg C" COEFFS 0 10 0 0 0 1 /end COMPU_METHOD
/begin COMPU_METHOD Temp_Cels "" RAT_FUNC "%6.1" "deg C" COEFFS 0 10 2731.4 0 0 1 /end COMPU_METHOD
/begin COMPU_METHOD TimeDeb "" RAT_FUNC "%6.1" "ms" COEFFS 0 0.1 0 0 0 1 /end COMPU_METHOD
/begin COMPU_METHOD TimeDelay_s "" RAT_FUNC "%6.1" "s" COEFFS 0 0 1 0 0.00023283064365387 0 /end COMPU_METHOD
/begin COMPU_METHOD Time_ms "" RAT_FUNC "%6.1" "ms" COEFFS 0 0.1 0 0 0 1 /end COMPU_METHOD
/begin COMPU_METHOD Time_s "" RAT_FUNC "%6.4" "s" COEFFS 0 100 0 0 0 1 /end COMPU_METHOD
/begin COMPU_METHOD TransR "" RAT_FUNC "%6.4" "-" COEFFS 0 100 0 0 0 1 /end COMPU_METHOD
/begin COMPU_METHOD Trq "" RAT_FUNC "%6.3" "Nm" COEFFS 0 10 0 0 0 1 /end COMPU_METHOD
/begin COMPU_METHOD TrqPrpHigh "" RAT_FUNC "%6.3" "Nm" COEFFS 0 10 0 0 0 1 /end COMPU_METHOD
/begin COMPU_METHOD t_q0p01 "" RAT_FUNC "%6.4" "s" COEFFS 0 100 0 0 0 1 /end COMPU_METHOD
/begin COMPU_METHOD t_q0p02 "" RAT_FUNC "%6.4" "s" COEFFS 0 100 0 0 0 2 /end COMPU_METHOD
/begin COMPU_METHOD t_q0p1 "" RAT_FUNC "%6.3" "s" COEFFS 0 10 0 0 0 1 /end COMPU_METHOD
/begin COMPU_METHOD Vel "" RAT_FUNC "%6.4" "km/h" COEFFS 0 100 0 0 0 1 /end COMPU_METHOD
/begin COMPU_METHOD Volt "" RAT_FUNC "%6.3" "mV" COEFFS 0 5 0 0 0 1 /end COMPU_METHOD
/begin COMPU_METHOD Volt_Batt "" RAT_FUNC "%6.1" "mV" COEFFS 0 0.05 0 0 0 1 /end COMPU_METHOD
/begin RECORD_LAYOUT Cur_Xs16Ws16 NO_AXIS_PTS_X 1 SWORD AXIS_PTS_X 2 SWORD INDEX_INCR DIRECT FNC_VALUES 3 SWORD COLUMN_DIR DIRECT /end RECORD_LAYOUT
/begin RECORD_LAYOUT Kw_Ws16 FNC_VALUES 1 SWORD COLUMN_DIR DIRECT /end RECORD_LAYOUT
/begin RECORD_LAYOUT RB_Curve_S16_S16 NO_AXIS_PTS_X 1 SWORD AXIS_PTS_X 2 SWORD INDEX_INCR DIRECT FNC_VALUES 3 SWORD COLUMN_DIR DIRECT /end RECORD_LAYOUT
/begin RECORD_LAYOUT RB_Map_S16S16_S16 NO_AXIS_PTS_X 1 SWORD NO_AXIS_PTS_Y 2 SWORD AXIS_PTS_X 3 SWORD INDEX_INCR DIRECT AXIS_PTS_Y 4 SWORD INDEX_INCR DIRECT FNC_VALUES 5 SWORD COLUMN_DIR DIRECT /end RECORD_LAYOUT
/begin RECORD_LAYOUT RB_ValA_Ws16 FNC_VALUES 1 SWORD COLUMN_DIR DIRECT /end RECORD_LAYOUT
/begin RECORD_LAYOUT RB_ValA_Ws32 FNC_VALUES 1 SLONG COLUMN_DIR DIRECT /end RECORD_LAYOUT
/begin RECORD_LAYOUT RB_ValA_Wu16 FNC_VALUES 1 UWORD COLUMN_DIR DIRECT /end RECORD_LAYOUT
/begin RECORD_LAYOUT RB_ValA_Wu8 FNC_VALUES 1 UBYTE COLUMN_DIR DIRECT /end RECORD_LAYOUT
/begin RECORD_LAYOUT RB_Val_Wboolean FNC_VALUES 1 UBYTE COLUMN_DIR DIRECT /end RECORD_LAYOUT
/begin RECORD_LAYOUT RB_Val_Ws16 FNC_VALUES 1 SWORD COLUMN_DIR DIRECT /end RECORD_LAYOUT
/begin RECORD_LAYOUT RB_Val_Ws32 FNC_VALUES 1 SLONG COLUMN_DIR DIRECT /end RECORD_LAYOUT
/begin RECORD_LAYOUT RB_Val_Ws8 FNC_VALUES 1 SBYTE COLUMN_DIR DIRECT /end RECORD_LAYOUT
/begin RECORD_LAYOUT RB_Val_Wu16 FNC_VALUES 1 UWORD COLUMN_DIR DIRECT /end RECORD_LAYOUT
/begin RECORD_LAYOUT RB_Val_Wu32 FNC_VALUES 1 ULONG COLUMN_DIR DIRECT /end RECORD_LAYOUT
/begin RECORD_LAYOUT RB_Val_Wu8 FNC_VALUES 1 UBYTE COLUMN_DIR DIRECT /end RECORD_LAYOUT
/begin RECORD_LAYOUT Val_Ws16 FNC_VALUES 1 SWORD COLUMN_DIR DIRECT /end RECORD_LAYOUT
/begin RECORD_LAYOUT Val_Ws32 FNC_VALUES 1 SLONG COLUMN_DIR DIRECT /end RECORD_LAYOUT
/begin RECORD_LAYOUT Val_Wu8 FNC_VALUES 1 UBYTE COLUMN_DIR DIRECT /end RECORD_LAYOUT
/end MODULE
/end PROJECT
