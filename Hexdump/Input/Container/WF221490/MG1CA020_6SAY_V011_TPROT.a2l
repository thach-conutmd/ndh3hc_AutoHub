ASAP2_VERSION 1 60
/begin PROJECT MG1CA020 "MG1CA020"
/begin HEADER "" VERSION "MG1CA020_6SAY_V011_TPROT" PROJECT_NO MG1CA020 /end HEADER
/begin MODULE DIM ""
/begin MOD_COMMON "" BYTE_ORDER MSB_LAST ALIGNMENT_BYTE 1 ALIGNMENT_WORD 2 ALIGNMENT_LONG 4 ALIGNMENT_INT64 4 ALIGNMENT_FLOAT32_IEEE 4 ALIGNMENT_FLOAT64_IEEE 4 DATA_SIZE 32 /end MOD_COMMON
/begin CHARACTERISTIC CEngUsT_stSwtCfg_C "Configuration switch for engine coolant upstrem temperature sensor aquisition" VALUE 0x80508274 RB_Val_Wu8 255.0 OneToOne 0.00 255.0 FORMAT "%5.1" /end CHARACTERISTIC
/begin CHARACTERISTIC CEngUsT_tDftValReplMdl_C "Default value of replacement model of engine coolant upstream temperature" VALUE 0x805082D8 RB_Val_Ws16 6553.500 Temp_Cels -3549.940 3003.560 FORMAT "%8.3" /end CHARACTERISTIC
/begin CHARACTERISTIC CEngUsT_tiDebSRCErr_C "Debounce Time for signal range check diagnosis of engine coolant upstream temperature" VALUE 0x80508275 RB_Val_Wu8 25.50 t_q0p1 0.00 25.50 FORMAT "%5.2" /end CHARACTERISTIC
/begin CHARACTERISTIC CEngUsT_tiDebSRCHeal_C "Debounce time for healing of signal range check of engine coolant upstream temperature" VALUE 0x80508276 RB_Val_Wu8 25.50 t_q0p1 0.00 25.50 FORMAT "%5.2" /end CHARACTERISTIC
/begin CHARACTERISTIC CEngUsT_tiFil_C "Time constant for signal filter of engine coolant upstream temperature" VALUE 0x805082D2 RB_Val_Wu16 655.3400 t_q0p01 0.0100 655.3500 FORMAT "%8.4" EXTENDED_LIMITS 0.00 655.3500 /end CHARACTERISTIC
/begin CHARACTERISTIC CEngUsT_tiTempPT1_C "Filter constant for filtering of temperature signal of engine coolant upstream temperature" VALUE 0x80508277 RB_Val_Wu8 25.40 t_q0p1 0.10 25.50 FORMAT "%5.2" EXTENDED_LIMITS 0.00 25.50 /end CHARACTERISTIC
/begin CHARACTERISTIC CEngUsT_tiVltgPT1_C "Filter constant for filtering of voltage signal of engine coolant upstream temperature" VALUE 0x80508278 RB_Val_Wu16 6553.400 t_q0p1 0.100 6553.500 FORMAT "%8.3" EXTENDED_LIMITS 0.00 6553.500 /end CHARACTERISTIC
/begin CHARACTERISTIC CEngUsT_tStopIni_C "Initial value of Engine coolant upstream temperature at engine stop event" VALUE 0x805082D4 RB_Val_Wu8 191.3 temp_ub_q0p75_o48 -48.0 143.3 FORMAT "%5.1" /end CHARACTERISTIC
/begin CHARACTERISTIC CEngUsT_tStrtThd_C "Temperature threshold for correction of engine coolant upstream temerature at engine start with temperature drop" VALUE 0x805082D6 RB_Val_Ws16 6553.500 Temp_Cels -3549.940 3003.560 FORMAT "%8.3" /end CHARACTERISTIC
/begin CHARACTERISTIC CEngUsT_u2t_T "Curve for calculation from voltage signal to temperature signal of engine coolant upstream temperature" CURVE 0x8050827A RB_Curve_U16_S16_Static 6553.500 Temp_Cels -3549.940 3003.560 FORMAT "%8.3"
 /begin AXIS_DESCR STD_AXIS CEngUsT_uSnsr Volt 20 0.00 13107.00 FORMAT "%8.2" DEPOSIT ABSOLUTE /end AXIS_DESCR
/end CHARACTERISTIC
/begin CHARACTERISTIC CEngUsT_uRawDft_C "Default sensor voltage value at deactivated SDC Port of egine coolant upstream temperature" VALUE 0x805082CC RB_Val_Ws16 13107.00 Volt -6553.600 6553.400 FORMAT "%8.3" /end CHARACTERISTIC
/begin CHARACTERISTIC CEngUsT_uThdSRCMaxErr_C "Signal voltage threshold of max signal range check of engine coolant upstream temperature" VALUE 0x805082CE RB_Val_Wu16 13107.00 Volt 0.00 13107.00 FORMAT "%8.2" /end CHARACTERISTIC
/begin CHARACTERISTIC CEngUsT_uThdSRCMinErr_C "Signal voltage threshold of min signal range check of engine coolant upstream temperature" VALUE 0x805082D0 RB_Val_Wu16 13107.00 Volt 0.00 13107.00 FORMAT "%8.2" /end CHARACTERISTIC
/begin CHARACTERISTIC Clth2_Deb.tiHiLo_C "Structure containing debounce time parameters for Clth2/Time for a high to low transition / Time for a High to Low transition" VALUE 0x8053A722 Kw_Ws16 655350.0 TimeDeb -327680.0 327670.0 FORMAT "%8.1" /end CHARACTERISTIC
/begin CHARACTERISTIC Clth2_Deb.tiLoHi_C "Structure containing debounce time parameters for Clth2/Time for a high to low transition / Time for a Low to High transition" VALUE 0x8053A724 Kw_Ws16 655350.0 TimeDeb -327680.0 327670.0 FORMAT "%8.1" /end CHARACTERISTIC
/begin CHARACTERISTIC Clth3_Deb.tiHiLo_C "Structure containing debounce time parameters for Clth3 / Time for a High to Low transition" VALUE 0x8053A726 Kw_Ws16 655350.0 TimeDeb -327680.0 327670.0 FORMAT "%8.1" /end CHARACTERISTIC
/begin CHARACTERISTIC Clth3_Deb.tiLoHi_C "Structure containing debounce time parameters for Clth3 / Time for a Low to High transition" VALUE 0x8053A728 Kw_Ws16 655350.0 TimeDeb -327680.0 327670.0 FORMAT "%8.1" /end CHARACTERISTIC
/begin CHARACTERISTIC Clth4_Deb.tiHiLo_C "Structure containing debounce time parameters for Clth4 / Time for a High to Low transition" VALUE 0x8053A72A Kw_Ws16 655350.0 TimeDeb -327680.0 327670.0 FORMAT "%8.1" /end CHARACTERISTIC
/begin CHARACTERISTIC Clth4_Deb.tiLoHi_C "Structure containing debounce time parameters for Clth4 / Time for a Low to High transition" VALUE 0x8053A72C Kw_Ws16 655350.0 TimeDeb -327680.0 327670.0 FORMAT "%8.1" /end CHARACTERISTIC
/begin CHARACTERISTIC ClthEPBTout_Deb.tiHiLo_C "Structure containing debounce time parameters for EPB Received Time Out / Time for a High to Low transition" VALUE 0x8053A72E Kw_Ws16 655350.0 TimeDeb -327680.0 327670.0 FORMAT "%8.1" /end CHARACTERISTIC
/begin CHARACTERISTIC ClthEPBTout_Deb.tiLoHi_C "Structure containing debounce time parameters for EPB Received Time Out / Time for a Low to High transition" VALUE 0x8053A730 Kw_Ws16 655350.0 TimeDeb -327680.0 327670.0 FORMAT "%8.1" /end CHARACTERISTIC
/begin CHARACTERISTIC Clth_Deb.tiHiLo_C "Debounce structure for clutch signal / Time for a High to Low transition" VALUE 0x8053A732 Kw_Ws16 655350.0 TimeDeb -327680.0 327670.0 FORMAT "%8.1" /end CHARACTERISTIC
/begin CHARACTERISTIC Clth_Deb.tiLoHi_C "Debounce structure for clutch signal / Time for a Low to High transition" VALUE 0x8053A734 Kw_Ws16 655350.0 TimeDeb -327680.0 327670.0 FORMAT "%8.1" /end CHARACTERISTIC
/begin CHARACTERISTIC Clth_flgStkSensClthSwtPrs_C "Stroke sensor and deepest clutch switch is present" VALUE 0x805082F2 RB_Val_Wu8 255.0 OneToOne 0.00 255.0 FORMAT "%5.1" /end CHARACTERISTIC
/begin CHARACTERISTIC Clth_nEngThd_C "Threshold for Engine speed to detect Clutch 2 or Clutch 4 ON stuck error" VALUE 0x805082F4 RB_Val_Ws16 32767.50 EngN -16384.00 16383.50 FORMAT "%8.2" /end CHARACTERISTIC
/begin CHARACTERISTIC Clth_nNoGearShftDet_C "Minimal engine speed for gear shift detection" VALUE 0x805082F6 RB_Val_Ws16 32767.50 EngN -16384.00 16383.50 FORMAT "%8.2" /end CHARACTERISTIC
/begin CHARACTERISTIC Clth_numGearSlip_C "Gear in which slipping clutch will be detected" VALUE 0x805082DA RB_Val_Wu8 9.000 OneToOne 0.00 9.000 FORMAT "%5.3" EXTENDED_LIMITS 0.00 255.0 /end CHARACTERISTIC
/begin CHARACTERISTIC Clth_rClthStkMaxThres_C "Max threshold of stroke sensor above which error is detected if deepest clutch switch is not pressed" VALUE 0x805082F8 RB_Val_Wu8 100.0 Prc_EGR 0.00 100.0 FORMAT "%5.1" /end CHARACTERISTIC
/begin CHARACTERISTIC Clth_rClthStkMinThres_C "Min threshold of stroke sensor below which error is detected if deepest clutch switch is pressed" VALUE 0x805082F9 RB_Val_Wu8 100.0 Prc_EGR 0.00 100.0 FORMAT "%5.1" /end CHARACTERISTIC
/begin CHARACTERISTIC Clth_rCluStkThd_C "Clutch stroke sensor CAN input Threshold for clutch pressed status calculation." VALUE 0x805082DC RB_Val_Ws16 255.9961 Prc_Fact256 -128.0000 127.9961 FORMAT "%8.4" /end CHARACTERISTIC
/begin CHARACTERISTIC Clth_rStkHiCC_C "Calibration for clutch stroke upper value for cruise control cut off" VALUE 0x805082DE RB_Val_Wu8 100.0 Prc_EGR 0.00 100.0 FORMAT "%5.1" /end CHARACTERISTIC
/begin CHARACTERISTIC Clth_rStkHiIS_C "Calibration for clutch stroke higher value for Idle Stop" VALUE 0x805082DF RB_Val_Wu8 100.0 Prc_EGR 0.00 100.0 FORMAT "%5.1" /end CHARACTERISTIC
/begin CHARACTERISTIC Clth_rStkHiSIL_C "Calibration for clutch stroke upper value for shift indication" VALUE 0x805082E0 RB_Val_Wu8 100.0 Prc_EGR 0.00 100.0 FORMAT "%5.1" /end CHARACTERISTIC
/begin CHARACTERISTIC Clth_rStkLoCC_C "Calibration for clutch stroke lower value for cruise control cut off" VALUE 0x805082E1 RB_Val_Wu8 100.0 Prc_EGR 0.00 100.0 FORMAT "%5.1" /end CHARACTERISTIC
/begin CHARACTERISTIC Clth_rStkLoIS_C "Calibration for clutch stroke lower value for Idle Stop" VALUE 0x805082E2 RB_Val_Wu8 100.0 Prc_EGR 0.00 100.0 FORMAT "%5.1" /end CHARACTERISTIC
/begin CHARACTERISTIC Clth_rStkLoSIL_C "Calibration for clutch stroke lower value for shift indication" VALUE 0x805082E3 RB_Val_Wu8 100.0 Prc_EGR 0.00 100.0 FORMAT "%5.1" /end CHARACTERISTIC
/begin CHARACTERISTIC Clth_rThd1_C "Lower threshold for clutch position evaluation" VALUE 0x805082FA RB_Val_Ws16 255.9961 Prc_Fact256 -128.0000 127.9961 FORMAT "%8.4" /end CHARACTERISTIC
/begin CHARACTERISTIC Clth_rThd2_C "Middle threshold for clutch position evaluation" VALUE 0x805082FC RB_Val_Ws16 255.9961 Prc_Fact256 -128.0000 127.9961 FORMAT "%8.4" /end CHARACTERISTIC
/begin CHARACTERISTIC Clth_rThd3_C "Upper threshold for clutch position evaluation" VALUE 0x805082FE RB_Val_Ws16 255.9961 Prc_Fact256 -128.0000 127.9961 FORMAT "%8.4" /end CHARACTERISTIC
/begin CHARACTERISTIC Clth_stClthONEEPRepl_C "Replacement value for Clutch 2 or Clutch 4 stuck error" VALUE 0x80508300 RB_Val_Wu8 255.0 OneToOne 0.00 255.0 FORMAT "%5.1" /end CHARACTERISTIC
/begin CHARACTERISTIC Clth_stDflVal_C "Default value of clutch state" VALUE 0x80508301 RB_Val_Wu8 255.0 OneToOne 0.00 255.0 FORMAT "%5.1" /end CHARACTERISTIC
/begin CHARACTERISTIC Clth_stOpn_C "Bit mask to detect the open clutch status" VALUE 0x805082E4 RB_Val_Wu8 255.0 OneToOne 0.00 255.0 FORMAT "%5.1" /end CHARACTERISTIC
/begin CHARACTERISTIC Clth_stSetClu_C "Calibration switch to select the clutch input for clutch pressed status." VALUE 0x805082E5 RB_Val_Wu8 255.0 OneToOne 0.00 255.0 FORMAT "%5.1" /end CHARACTERISTIC
/begin CHARACTERISTIC Clth_stSlipClsd_C "Clutch state: clutch is slipping closed" VALUE 0x805082E6 RB_Val_Wu8 255.0 OneToOne 0.00 255.0 FORMAT "%5.1" /end CHARACTERISTIC
/begin CHARACTERISTIC Clth_stSlipOpn_C "Clutch state: clutch is slipping open" VALUE 0x805082E7 RB_Val_Wu8 255.0 OneToOne 0.00 255.0 FORMAT "%5.1" /end CHARACTERISTIC
/begin CHARACTERISTIC Clth_stSlip_C "Clutch state: clutch is slipping" VALUE 0x805082E8 RB_Val_Wu8 255.0 OneToOne 0.00 255.0 FORMAT "%5.1" /end CHARACTERISTIC
/begin CHARACTERISTIC Clth_stStkActvn_C "calibration for activation of clutch stroke sensor" VALUE 0x805082E9 RB_Val_Wu8 255.0 OneToOne 0.00 255.0 FORMAT "%5.1" /end CHARACTERISTIC
/begin CHARACTERISTIC Clth_swtCond_C "Switch for cluth condition" VALUE 0x80508302 RB_Val_Wu16 511.0000 OneToOne 0.00 511.0000 FORMAT "%8.4" EXTENDED_LIMITS 0.00 65535.00 /end CHARACTERISTIC
/begin CHARACTERISTIC Clth_swtSig_C "Switch for signal source of clutch state" VALUE 0x805082EA RB_Val_Wu8 255.0 OneToOne 0.00 255.0 FORMAT "%5.1" /end CHARACTERISTIC
/begin CHARACTERISTIC Clth_tiCANDlyClthOff_C "Debouncing time to detect error Clth_stPlausErr0" VALUE 0x80508304 RB_Val_Ws16 655.3500 Time_s -327.6800 327.6700 FORMAT "%8.4" /end CHARACTERISTIC
/begin CHARACTERISTIC Clth_tiCANDlyClthOn_C "Debouncing time to detect error Clth_stPlausErr1" VALUE 0x80508306 RB_Val_Ws16 655.3500 Time_s -327.6800 327.6700 FORMAT "%8.4" /end CHARACTERISTIC
/begin CHARACTERISTIC Clth_tiClth2NrmDet_C "Threshold for timer to detect release status of clutch 2" VALUE 0x80508308 RB_Val_Ws16 327670.0 Time_ms 0.00 327670.0 FORMAT "%8.1" EXTENDED_LIMITS -327680.0 327670.0 /end CHARACTERISTIC
/begin CHARACTERISTIC Clth_tiClth3NrmDet_C "Threshold for timer to detect release status of clutch 3" VALUE 0x8050830A RB_Val_Ws16 327670.0 Time_ms 0.00 327670.0 FORMAT "%8.1" EXTENDED_LIMITS -327680.0 327670.0 /end CHARACTERISTIC
/begin CHARACTERISTIC Clth_tiClth4NrmDet_C "Threshold for timer to detect release status of clutch 4" VALUE 0x8050830C RB_Val_Ws16 327670.0 Time_ms 0.00 327670.0 FORMAT "%8.1" EXTENDED_LIMITS -327680.0 327670.0 /end CHARACTERISTIC
/begin CHARACTERISTIC Clth_tiCluSwtImpsOffDeb_C "Off debouncing time for 2 clutch pedal plausibility test" VALUE 0x8050830E RB_Val_Ws16 655350.0 TimeDeb -327680.0 327670.0 FORMAT "%8.1" /end CHARACTERISTIC
/begin CHARACTERISTIC Clth_tiCluSwtImpsOnDeb_C "On debouncing time for 2 clutch pedal plausibility test" VALUE 0x80508310 RB_Val_Ws16 655350.0 TimeDeb -327680.0 327670.0 FORMAT "%8.1" /end CHARACTERISTIC
/begin CHARACTERISTIC Clth_tiEPBComDeb_C "Debounce time after which EPB communication is declared" VALUE 0x805082EC RB_Val_Ws16 327670.0 Time_ms 0.00 327670.0 FORMAT "%8.1" EXTENDED_LIMITS -327680.0 327670.0 /end CHARACTERISTIC
/begin CHARACTERISTIC Clth_tiGearShft_C "Debounce time for gear shift detection" VALUE 0x80508312 RB_Val_Ws16 655350.0 Time_ms -327680.0 327670.0 FORMAT "%8.1" /end CHARACTERISTIC
/begin CHARACTERISTIC Clth_tiReOpenDly_C "time threshold to confirm clutch reopening status" VALUE 0x80508314 RB_Val_Ws16 655350.0 Time_ms -327680.0 327670.0 FORMAT "%8.1" /end CHARACTERISTIC
/begin CHARACTERISTIC Clth_tiRxEPBDeb_C "Debounce time after which EPB communication is declared" VALUE 0x805082EE RB_Val_Ws16 327670.0 Time_ms 0.00 327670.0 FORMAT "%8.1" EXTENDED_LIMITS -327680.0 327670.0 /end CHARACTERISTIC
/begin CHARACTERISTIC Clth_tiUnderURstStrtReqOff_C "Delay time for start request off after under voltage reset" VALUE 0x805082F0 RB_Val_Ws16 327670.0 Time_ms 0.00 327670.0 FORMAT "%8.1" EXTENDED_LIMITS -327680.0 327670.0 /end CHARACTERISTIC
/begin CHARACTERISTIC Clth_vNoGearShftDet_C "Minimal vehicle speed for gear shift detection" VALUE 0x80508316 RB_Val_Ws16 655.3500 Vel -327.6800 327.6700 FORMAT "%8.4" /end CHARACTERISTIC
/begin CHARACTERISTIC Clth_vVehSpdThd_C "Threshold for Vehicle speed to detect Clutch 2 or Clutch 4 ON stuck error" VALUE 0x80508318 RB_Val_Ws16 655.3500 Vel -327.6800 327.6700 FORMAT "%8.4" /end CHARACTERISTIC
/begin CHARACTERISTIC CoDsplCtl_nJdgMIDThd_C "engine rpm threshold for MID judgement" VALUE 0x8053A736 Val_Ws16 16383.50 EngN 0.00 16383.50 FORMAT "%8.2" EXTENDED_LIMITS -16384.00 16383.50 /end CHARACTERISTIC
/begin CHARACTERISTIC CoDsplCtl_nOilPres1Low_C "Lower hysteresis 1 for oil pressure warning lamp control change point for engine speed" VALUE 0x8053A738 Val_Ws16 6000.000 EngN 0.00 6000.000 FORMAT "%8.3" EXTENDED_LIMITS -16384.00 16383.50 /end CHARACTERISTIC
/begin CHARACTERISTIC CoDsplCtl_nOilPres2High_C "Upper hysteresis 2 for oil pressure warning lamp control change point for engine speed" VALUE 0x8053A73A Val_Ws16 5960.000 EngN 40.000 6000.000 FORMAT "%8.3" EXTENDED_LIMITS -16384.00 16383.50 /end CHARACTERISTIC
/begin CHARACTERISTIC CoDsplCtl_nOilPres2Low_C "Lower hysteresis 2 for oil pressure warning lamp control change point for engine speed" VALUE 0x8053A73C Val_Ws16 5960.000 EngN 40.000 6000.000 FORMAT "%8.3" EXTENDED_LIMITS -16384.00 16383.50 /end CHARACTERISTIC
/begin CHARACTERISTIC CoDsplCtl_tiDlyStOilP_C "turn on delay time for oil pressure low to high transistion" VALUE 0x8053A73E Val_Ws16 327.6700 Time_s 0.00 327.6700 FORMAT "%8.4" EXTENDED_LIMITS -327.6800 327.6700 /end CHARACTERISTIC
/begin CHARACTERISTIC CoDsplCtl_tiOilPresBrkAwayDly_C "Delay time for oil pressure warning lamp control in case of Idle stop brake away" VALUE 0x8053A740 Val_Ws16 327460.0 Time_ms 0.00 327460.0 FORMAT "%8.1" EXTENDED_LIMITS -327680.0 327670.0 /end CHARACTERISTIC
/begin CHARACTERISTIC CoDsplCtl_tiOilPresDly_C "Delay time for oil pressure warning lamp control" VALUE 0x8053A742 Val_Ws16 327460.0 Time_ms 0.00 327460.0 FORMAT "%8.1" EXTENDED_LIMITS -327680.0 327670.0 /end CHARACTERISTIC
/begin CHARACTERISTIC CoDsplCtl_tiOilPresEngRunDly_C "Delay time for oil pressure warning lamp control in case of direct engine run from idle stop" VALUE 0x8053A744 Val_Ws16 327460.0 Time_ms 0.00 327460.0 FORMAT "%8.1" EXTENDED_LIMITS -327680.0 327670.0 /end CHARACTERISTIC
/begin CHARACTERISTIC CoDsplCtl_tiOilPresRetDly_C "Delay time for oil pressure warning lamp control in Idle start-stop condition" VALUE 0x8053A746 Val_Ws16 327460.0 Time_ms 0.00 327460.0 FORMAT "%8.1" EXTENDED_LIMITS -327680.0 327670.0 /end CHARACTERISTIC
/begin CHARACTERISTIC CodsplCtl_tiPLampActtnEna_C "Turn on delay time for pressure lamp acttuation enable" VALUE 0x8053A748 Val_Ws16 327.6700 Time_s 0.00 327.6700 FORMAT "%8.4" EXTENDED_LIMITS -327.6800 327.6700 /end CHARACTERISTIC
/begin CHARACTERISTIC CoDsplCtl_tiSuspndMid_C "time period for suspend the MID update" VALUE 0x8053A74A Val_Ws16 327460.0 Time_ms 0.00 327460.0 FORMAT "%8.1" EXTENDED_LIMITS -327680.0 327670.0 /end CHARACTERISTIC
/begin CHARACTERISTIC CoEng_bEnaStrt2AutoStop_C "Enable the transition from STARTING to AUTOSTOPPING" VALUE 0x80508E58 RB_Val_Wu8 1.00000000000 B_TRUE 0.00 1.00000000000 FORMAT "%13.11" /end CHARACTERISTIC
/begin CHARACTERISTIC CoEng_facThdAirmCatHeatg_C "Threshold for relative amount of integrated airmass at catalyst heating to release VTEC." VALUE 0x80508FD0 RB_Val_Wu16 0.9999847 fak_uw_b1 0.00 0.9999847 FORMAT "%9.7" /end CHARACTERISTIC
/begin CHARACTERISTIC CoEng_fakCorrnAltiCvlci_T "Map for altitude and temperature correction of intake valve lift shift" CURVE 0x80508FD2 RB_Curve_U16_U16 1.999969 fak_uw_b2 0.00 1.999969 FORMAT "%8.6"
 /begin AXIS_DESCR STD_AXIS CoEng_fakCorrnAltiCvlciXVal fak_uw_b2 5 0.00 1.999969 FORMAT "%8.6" DEPOSIT ABSOLUTE /end AXIS_DESCR
/end CHARACTERISTIC
/begin CHARACTERISTIC CoEng_flgEngStrtT50Use_C "Parameter for selection whether T50 will be considered at Start-Stop Start or not." VALUE 0x80508E56 RB_Val_Wu8 255.0 OneToOne 0.00 255.0 FORMAT "%5.1" /end CHARACTERISTIC
/begin CHARACTERISTIC CoEng_idxEngTSelStSpStopEna_C "Index to choose an engine temperture for the stop release." VALUE 0x80508E5C RB_Val_Wu8 255.0 OneToOne 0.00 255.0 FORMAT "%5.1" /end CHARACTERISTIC
/begin CHARACTERISTIC CoEng_idxExhModTSelVlvLftIntk_C "Index to select modelled exhaust temperature for inhibition of the FC CoEng_VlvLftSpIntk" VALUE 0x80508FE8 RB_Val_Wu8 12.00 OneToOne 0.00 12.00 FORMAT "%5.2" EXTENDED_LIMITS 0.00 255.0 /end CHARACTERISTIC
/begin CHARACTERISTIC CoEng_nCorrnGearCvlci_T "Map for gear dependent correction of intake valve lift shift" CURVE 0x80508FE9 RB_Curve_S8_S8 12750. EngN_short -6400. 6350. FORMAT "%5.0"
 /begin AXIS_DESCR STD_AXIS Tra_numGear OneToOne 10 -128.0 127.0 FORMAT "%5.1" DEPOSIT ABSOLUTE /end AXIS_DESCR
/end CHARACTERISTIC
/begin CHARACTERISTIC CoEng_nEngShiftLimCvlci_T "Gear dependent engine speed limit for intake valve lift shift" CURVE 0x80508FFE RB_Curve_S16_S16 16383.50 EngN 0.00 16383.50 FORMAT "%8.2" EXTENDED_LIMITS -16384.00 16383.50
 /begin AXIS_DESCR STD_AXIS Tra_numGear OneToOne 10 -128.0000 127.0000 FORMAT "%8.4" EXTENDED_LIMITS -32768.00 32767.00 DEPOSIT ABSOLUTE /end AXIS_DESCR
/end CHARACTERISTIC
/begin CHARACTERISTIC CoEng_nEngStrtCdnMin_C "Minimal engine speed threshold which desribes a running engine for OBD" VALUE 0x80508E52 RB_Val_Ws16 16383.50 EngN 0.00 16383.50 FORMAT "%8.2" EXTENDED_LIMITS -16384.00 16383.50 /end CHARACTERISTIC
/begin CHARACTERISTIC CoEng_nOffsLimMaxCvlci_C "Upper offset limit for engine speed" VALUE 0x80509028 RB_Val_Ws16 32767.50 EngN -16384.00 16383.50 FORMAT "%8.2" /end CHARACTERISTIC
/begin CHARACTERISTIC CoEng_nOffsLimMaxFCOCvlci_C "Upper offset limit for engine speed at FCO" VALUE 0x8050902A RB_Val_Ws16 32767.50 EngN -16384.00 16383.50 FORMAT "%8.2" /end CHARACTERISTIC
/begin CHARACTERISTIC CoEng_nOffsLimMinCvlci_C "Lower offset limit for engine speed" VALUE 0x8050902C RB_Val_Ws16 32767.50 EngN -16384.00 16383.50 FORMAT "%8.2" /end CHARACTERISTIC
/begin CHARACTERISTIC CoEng_nOffsLimMinFCOCvlci_C "Lower offset limit for engine speed at FCO" VALUE 0x8050902E RB_Val_Ws16 32767.50 EngN -16384.00 16383.50 FORMAT "%8.2" /end CHARACTERISTIC
/begin CHARACTERISTIC CoEng_nrCamsftRotShiftCvlci_C "Number of needed camshaft rotations for a complete valve lift shift on intake side" VALUE 0x80509030 RB_Val_Wu8 255.0 OneToOne 0.00 255.0 FORMAT "%5.1" /end CHARACTERISTIC
/begin CHARACTERISTIC CoEng_numGearLo_CA "Low gears in the context of valve lift" VAL_BLK 0x80509031 RB_ValA_Wu8 1.00000000000 B_TRUE 0.00 1.00000000000 FORMAT "%13.11" NUMBER 10 /end CHARACTERISTIC
/begin CHARACTERISTIC CoEng_numNoUrgStopPhd_C "No urgent stop prohibition" VALUE 0x80508E5D RB_Val_Wu8 36.0000000000 CoEng_EngOnDmd_VERB 0.00 36.0000000000 FORMAT "%13.10" READ_ONLY /end CHARACTERISTIC
/begin CHARACTERISTIC CoEng_numNoUrgStrtDmd_C "No urgent start demand" VALUE 0x80508F74 RB_Val_Wu8 36.0000000000 CoEng_EngOnDmd_VERB 0.00 36.0000000000 FORMAT "%13.10" READ_ONLY /end CHARACTERISTIC
/begin CHARACTERISTIC CoEng_ratEngLoadTest_C "Test value for the map input" VALUE 0x8050903C RB_Val_Ws16 399.9878 Prc 0.00 399.9878 FORMAT "%8.4" EXTENDED_LIMITS -400.0000 399.9878 /end CHARACTERISTIC
/begin CHARACTERISTIC CoEng_ratLoadFCORstrtCvlci_C "Minimum engine load to activate valve lift shift after fuel cut off" VALUE 0x8050903E RB_Val_Ws16 399.9878 Prc 0.00 399.9878 FORMAT "%8.4" EXTENDED_LIMITS -400.0000 399.9878 /end CHARACTERISTIC
/begin CHARACTERISTIC CoEng_stActvtStopEnblCdn_CA "Status to deactivate the stop enable condtitions for Start-Stop" VAL_BLK 0x80508E5E RB_ValA_Wu16 65535.00 OneToOne 0.00 65535.00 FORMAT "%8.2" NUMBER 3 /end CHARACTERISTIC
/begin CHARACTERISTIC CoEng_stActvtStrtDmdCdn_CA "Status to deactivate the start demand conditions for Start-Stop" VAL_BLK 0x80508F76 RB_ValA_Wu16 65535.00 OneToOne 0.00 65535.00 FORMAT "%8.2" NUMBER 3 /end CHARACTERISTIC
/begin CHARACTERISTIC CoEng_stCaseCvlci_CA "Choise of the use cases for the valve lift strategy on intake side" VAL_BLK 0x80509040 RB_ValA_Wu8 254.000000000 CoEng_CaseCvlci_COMPU_VERB 1.000000000 255.000000000 FORMAT "%13.9" NUMBER 29 /end CHARACTERISTIC
/begin CHARACTERISTIC CoEng_stCaseStgyDftCvlci_C "Default intake valve lift strategy" VALUE 0x8050905D RB_Val_Wu8 255.000000000 CoEng_VlvLftStgyCvlci_COMPU_VERB 0.00 255.000000000 FORMAT "%13.9" /end CHARACTERISTIC
/begin CHARACTERISTIC CoEng_stEngRunDmd_CUR "Status of the demand for a running engine (stop prohibition or start demand)." CURVE 0x80508E64 RB_Curve_S16_S16 32768.00 OneToOne -1.00 32767.00 FORMAT "%8.2" EXTENDED_LIMITS -32768.00 32767.00
 /begin AXIS_DESCR STD_AXIS NO_INPUT_QUANTITY CoEng_EngOnDmd_VERB 37 0.00 36.0000000000 FORMAT "%13.10" DEPOSIT ABSOLUTE /end AXIS_DESCR
/end CHARACTERISTIC
/begin CHARACTERISTIC CoEng_stEomCvlciAllwd1ModVlvLft0_C "Inhibit mode at CoEng_stSpVlvLftIntk == 0" VALUE 0x80509060 RB_Val_Wu32 4294967295.00 OneToOne 0.00 4294967295.00 FORMAT "%13.2" /end CHARACTERISTIC
/begin CHARACTERISTIC CoEng_stEomCvlciAllwd1ModVlvLft1_C "Inhibit mode at CoEng_stSpVlvLftIntk == 1" VALUE 0x80509064 RB_Val_Wu32 4294967295.00 OneToOne 0.00 4294967295.00 FORMAT "%13.2" /end CHARACTERISTIC
/begin CHARACTERISTIC CoEng_stEomCvlciAllwd1ModVlvLft2_C "Inhibit mode at CoEng_stSpVlvLftIntk == 2" VALUE 0x80509068 RB_Val_Wu32 4294967295.00 OneToOne 0.00 4294967295.00 FORMAT "%13.2" /end CHARACTERISTIC
/begin CHARACTERISTIC CoEng_stEomCvlciAllwd1ModVlvLft3_C "Inhibit mode at CoEng_stSpVlvLftIntk == 3" VALUE 0x8050906C RB_Val_Wu32 4294967295.00 OneToOne 0.00 4294967295.00 FORMAT "%13.2" /end CHARACTERISTIC
/begin CHARACTERISTIC CoEng_stEomCvlciAllwd1ModVlvLft4_C "Inhibit mode at CoEng_stSpVlvLftIntk == 4" VALUE 0x80509070 RB_Val_Wu32 4294967295.00 OneToOne 0.00 4294967295.00 FORMAT "%13.2" /end CHARACTERISTIC
/begin CHARACTERISTIC CoEng_stEomCvlciAllwd1ModVlvLft5_C "Inhibit mode at CoEng_stSpVlvLftIntk == 5" VALUE 0x80509074 RB_Val_Wu32 4294967295.00 OneToOne 0.00 4294967295.00 FORMAT "%13.2" /end CHARACTERISTIC
/begin CHARACTERISTIC CoEng_stEomCvlciAllwd1ModVlvLft6_C "Inhibit mode at CoEng_stSpVlvLftIntk == 6" VALUE 0x80509078 RB_Val_Wu32 4294967295.00 OneToOne 0.00 4294967295.00 FORMAT "%13.2" /end CHARACTERISTIC
/begin CHARACTERISTIC CoEng_stEomCvlciAllwd1ModVlvLft7_C "Inhibit mode at CoEng_stSpVlvLftIntk == 7" VALUE 0x8050907C RB_Val_Wu32 4294967295.00 OneToOne 0.00 4294967295.00 FORMAT "%13.2" /end CHARACTERISTIC
/begin CHARACTERISTIC CoEng_stEomCvlciAllwd1ModVlvLft8_C "Inhibit mode at CoEng_stSpVlvLftIntk == 8" VALUE 0x80509080 RB_Val_Wu32 4294967295.00 OneToOne 0.00 4294967295.00 FORMAT "%13.2" /end CHARACTERISTIC
/begin CHARACTERISTIC CoEng_stEomCvlciAllwd1ModVlvLft9_C "Inhibit mode at CoEng_stSpVlvLftIntk == 9" VALUE 0x80509084 RB_Val_Wu32 4294967295.00 OneToOne 0.00 4294967295.00 FORMAT "%13.2" /end CHARACTERISTIC
/begin CHARACTERISTIC CoEng_stEomCvlciAllwd1Prio_T "Curve to map the former values of CoEng_stSpVlvLftIntk to the priority of the CoEOM inhibit interface 1" CURVE 0x80509088 RB_Curve_U8_U8 255.0 OneToOne 0.00 255.0 FORMAT "%5.1"
 /begin AXIS_DESCR STD_AXIS CoEng_stSpVlvLftIntkLoc OneToOne 10 0.00 255.0 FORMAT "%5.1" DEPOSIT ABSOLUTE /end AXIS_DESCR
/end CHARACTERISTIC
/begin CHARACTERISTIC CoEng_stEomCvlciAllwd1Stg_T "Curve to map the former values of CoEng_stSpVlvLftIntk to the stage of the CoEOM inhibit interface 1" CURVE 0x8050909E RB_Curve_U8_U16_Static 65535.00 OneToOne 0.00 65535.00 FORMAT "%8.2"
 /begin AXIS_DESCR STD_AXIS CoEng_stSpVlvLftIntkLoc OneToOne 10 0.00 255.0 FORMAT "%5.1" DEPOSIT ABSOLUTE /end AXIS_DESCR
/end CHARACTERISTIC
/begin CHARACTERISTIC CoEng_stEomCvlciAllwd2ModVlvLft0_C "Inhibit mode at CoEng_stSpVlvLftIntk == 0" VALUE 0x805090C0 RB_Val_Wu32 4294967295.00 OneToOne 0.00 4294967295.00 FORMAT "%13.2" /end CHARACTERISTIC
/begin CHARACTERISTIC CoEng_stEomCvlciAllwd2ModVlvLft1_C "Inhibit mode at CoEng_stSpVlvLftIntk == 1" VALUE 0x805090C4 RB_Val_Wu32 4294967295.00 OneToOne 0.00 4294967295.00 FORMAT "%13.2" /end CHARACTERISTIC
/begin CHARACTERISTIC CoEng_stEomCvlciAllwd2ModVlvLft2_C "Inhibit mode at CoEng_stSpVlvLftIntk == 2" VALUE 0x805090C8 RB_Val_Wu32 4294967295.00 OneToOne 0.00 4294967295.00 FORMAT "%13.2" /end CHARACTERISTIC
/begin CHARACTERISTIC CoEng_stEomCvlciAllwd2ModVlvLft3_C "Inhibit mode at CoEng_stSpVlvLftIntk == 3" VALUE 0x805090CC RB_Val_Wu32 4294967295.00 OneToOne 0.00 4294967295.00 FORMAT "%13.2" /end CHARACTERISTIC
/begin CHARACTERISTIC CoEng_stEomCvlciAllwd2ModVlvLft4_C "Inhibit mode at CoEng_stSpVlvLftIntk == 4" VALUE 0x805090D0 RB_Val_Wu32 4294967295.00 OneToOne 0.00 4294967295.00 FORMAT "%13.2" /end CHARACTERISTIC
/begin CHARACTERISTIC CoEng_stEomCvlciAllwd2ModVlvLft5_C "Inhibit mode at CoEng_stSpVlvLftIntk == 5" VALUE 0x805090D4 RB_Val_Wu32 4294967295.00 OneToOne 0.00 4294967295.00 FORMAT "%13.2" /end CHARACTERISTIC
/begin CHARACTERISTIC CoEng_stEomCvlciAllwd2ModVlvLft6_C "Inhibit mode at CoEng_stSpVlvLftIntk == 6" VALUE 0x805090D8 RB_Val_Wu32 4294967295.00 OneToOne 0.00 4294967295.00 FORMAT "%13.2" /end CHARACTERISTIC
/begin CHARACTERISTIC CoEng_stEomCvlciAllwd2ModVlvLft7_C "Inhibit mode at CoEng_stSpVlvLftIntk == 7" VALUE 0x805090DC RB_Val_Wu32 4294967295.00 OneToOne 0.00 4294967295.00 FORMAT "%13.2" /end CHARACTERISTIC
/begin CHARACTERISTIC CoEng_stEomCvlciAllwd2ModVlvLft8_C "Inhibit mode at CoEng_stSpVlvLftIntk == 8" VALUE 0x805090E0 RB_Val_Wu32 4294967295.00 OneToOne 0.00 4294967295.00 FORMAT "%13.2" /end CHARACTERISTIC
/begin CHARACTERISTIC CoEng_stEomCvlciAllwd2ModVlvLft9_C "Inhibit mode at CoEng_stSpVlvLftIntk == 9" VALUE 0x805090E4 RB_Val_Wu32 4294967295.00 OneToOne 0.00 4294967295.00 FORMAT "%13.2" /end CHARACTERISTIC
/begin CHARACTERISTIC CoEng_stEomCvlciAllwd2Prio_T "Curve to map the former values of CoEng_stSpVlvLftIntk to the priority of the CoEOM inhibit interface 2" CURVE 0x805090E8 RB_Curve_U8_U8 255.0 OneToOne 0.00 255.0 FORMAT "%5.1"
 /begin AXIS_DESCR STD_AXIS CoEng_stSpVlvLftIntkLoc OneToOne 10 0.00 255.0 FORMAT "%5.1" DEPOSIT ABSOLUTE /end AXIS_DESCR
/end CHARACTERISTIC
/begin CHARACTERISTIC CoEng_stEomCvlciAllwd2Stg_T "Curve to map the former values of CoEng_stSpVlvLftIntk to the stage of the CoEOM inhibit interface 2" CURVE 0x805090FE RB_Curve_U8_U16_Static 65535.00 OneToOne 0.00 65535.00 FORMAT "%8.2"
 /begin AXIS_DESCR STD_AXIS CoEng_stSpVlvLftIntkLoc OneToOne 10 0.00 255.0 FORMAT "%5.1" DEPOSIT ABSOLUTE /end AXIS_DESCR
/end CHARACTERISTIC
/begin CHARACTERISTIC CoEng_stEomCvlciDmdModVlvLft0_C "Mode demand at CoEng_stSpVlvLftIntk == 0" VALUE 0x80509120 RB_Val_Wu32 4294967295.00 OneToOne 0.00 4294967295.00 FORMAT "%13.2" /end CHARACTERISTIC
/begin CHARACTERISTIC CoEng_stEomCvlciDmdModVlvLft1_C "Mode demand at CoEng_stSpVlvLftIntk == 1" VALUE 0x80509124 RB_Val_Wu32 4294967295.00 OneToOne 0.00 4294967295.00 FORMAT "%13.2" /end CHARACTERISTIC
/begin CHARACTERISTIC CoEng_stEomCvlciDmdModVlvLft2_C "Mode demand at CoEng_stSpVlvLftIntk == 2" VALUE 0x80509128 RB_Val_Wu32 4294967295.00 OneToOne 0.00 4294967295.00 FORMAT "%13.2" /end CHARACTERISTIC
/begin CHARACTERISTIC CoEng_stEomCvlciDmdModVlvLft3_C "Mode demand at CoEng_stSpVlvLftIntk == 3" VALUE 0x8050912C RB_Val_Wu32 4294967295.00 OneToOne 0.00 4294967295.00 FORMAT "%13.2" /end CHARACTERISTIC
/begin CHARACTERISTIC CoEng_stEomCvlciDmdModVlvLft4_C "Mode demand at CoEng_stSpVlvLftIntk == 4" VALUE 0x80509130 RB_Val_Wu32 4294967295.00 OneToOne 0.00 4294967295.00 FORMAT "%13.2" /end CHARACTERISTIC
/begin CHARACTERISTIC CoEng_stEomCvlciDmdModVlvLft5_C "Mode demand at CoEng_stSpVlvLftIntk == 5" VALUE 0x80509134 RB_Val_Wu32 4294967295.00 OneToOne 0.00 4294967295.00 FORMAT "%13.2" /end CHARACTERISTIC
/begin CHARACTERISTIC CoEng_stEomCvlciDmdModVlvLft6_C "Mode demand at CoEng_stSpVlvLftIntk == 6" VALUE 0x80509138 RB_Val_Wu32 4294967295.00 OneToOne 0.00 4294967295.00 FORMAT "%13.2" /end CHARACTERISTIC
/begin CHARACTERISTIC CoEng_stEomCvlciDmdModVlvLft7_C "Mode demand at CoEng_stSpVlvLftIntk == 7" VALUE 0x8050913C RB_Val_Wu32 4294967295.00 OneToOne 0.00 4294967295.00 FORMAT "%13.2" /end CHARACTERISTIC
/begin CHARACTERISTIC CoEng_stEomCvlciDmdModVlvLft8_C "Mode demand at CoEng_stSpVlvLftIntk == 8" VALUE 0x80509140 RB_Val_Wu32 4294967295.00 OneToOne 0.00 4294967295.00 FORMAT "%13.2" /end CHARACTERISTIC
/begin CHARACTERISTIC CoEng_stEomCvlciDmdModVlvLft9_C "Mode demand at CoEng_stSpVlvLftIntk == 9" VALUE 0x80509144 RB_Val_Wu32 4294967295.00 OneToOne 0.00 4294967295.00 FORMAT "%13.2" /end CHARACTERISTIC
/begin CHARACTERISTIC CoEng_stEomCvlciDmdPrio_T "Curve to map the former values of CoEng_stSpVlvLftIntk to the priority of the CoEOM demand interface" CURVE 0x80509148 RB_Curve_U8_U8 255.0 OneToOne 0.00 255.0 FORMAT "%5.1"
 /begin AXIS_DESCR STD_AXIS CoEng_stSpVlvLftIntkLoc OneToOne 10 0.00 255.0 FORMAT "%5.1" DEPOSIT ABSOLUTE /end AXIS_DESCR
/end CHARACTERISTIC
/begin CHARACTERISTIC CoEng_stEomCvlciDmdStg_T "Curve to map the former values of CoEng_stSpVlvLftIntk to the new CoEOM demand" CURVE 0x8050915E RB_Curve_U8_U16_Static 65535.00 OneToOne 0.00 65535.00 FORMAT "%8.2"
 /begin AXIS_DESCR STD_AXIS CoEng_stSpVlvLftIntkLoc OneToOne 10 0.00 255.0 FORMAT "%5.1" DEPOSIT ABSOLUTE /end AXIS_DESCR
/end CHARACTERISTIC
/begin CHARACTERISTIC CoEng_stExtVlvLftDmdDftCvlci_C "Default for external valve lift demand on intake side" VALUE 0x8050917E RB_Val_Wu8 255.0 OneToOne 0.00 255.0 FORMAT "%5.1" /end CHARACTERISTIC
/begin CHARACTERISTIC CoEng_stMapInpSel_C "Input selector for the valve lift setpoint map" VALUE 0x8050917F RB_Val_Wu8 255.0 OneToOne 0.00 255.0 FORMAT "%5.1" /end CHARACTERISTIC
/begin CHARACTERISTIC CoEng_stMpgLimpVlvLftDmd_T "Curve to map the limp home valve lift demand to the definition of the function CoEng_VlvLftSpIntk" CURVE 0x80509180 RB_Curve_U16_U8_Static 255.000000000 CoEng_VlvLftStgyFixCvlci_COMPU_VERB 0.00 255.000000000 FORMAT "%13.9"
 /begin AXIS_DESCR STD_AXIS CoEng_stMpgLimpVlvLftDmdXVal OneToOne 10 0.00 65535.00 FORMAT "%8.2" DEPOSIT ABSOLUTE /end AXIS_DESCR
/end CHARACTERISTIC
/begin CHARACTERISTIC CoEng_stMpgStdLftHwIntk_T "Curve to map the valve lift demand from GevCtl to the definition of the function CoEng_VlvLftSpIntk" CURVE 0x805091A0 RB_Curve_U8_U8 255.000000000 CoEng_VlvLftStgyFixCvlci_COMPU_VERB 0.00 255.000000000 FORMAT "%13.9"
 /begin AXIS_DESCR STD_AXIS CoEng_stMpgStdLftHwIntkXVal OneToOne 2 0.00 255.0 FORMAT "%5.1" DEPOSIT ABSOLUTE /end AXIS_DESCR
/end CHARACTERISTIC
/begin CHARACTERISTIC CoEng_stNoStspStop16ExhMgT_C "Bitcoded codeword for stop inhibitors from exhaust temperature and catalyst heating" VALUE 0x80508EFA RB_Val_Wu16 65535.00 OneToOne 0.00 65535.00 FORMAT "%8.2" /end CHARACTERISTIC
/begin CHARACTERISTIC CoEng_stPrioMinNoStopExhMgT_C "Minimum priority of ExhMgT_stPrioWpDmdHyb for a stop inhibition" VALUE 0x80508EFC RB_Val_Wu8 255.0 OneToOne 0.00 255.0 FORMAT "%5.1" /end CHARACTERISTIC
/begin CHARACTERISTIC CoEng_stRstrtTran_C "Parameter to decide, which transitions in CoEng_stMai have to be made via the restart-task (value of the corresponding bit position: true)" VALUE 0x80508E59 RB_Val_Wu8 255.0 OneToOne 0.00 255.0 FORMAT "%5.1" /end CHARACTERISTIC
/begin CHARACTERISTIC CoEng_stShiftDlyCvlci_CA "Choise of the shift delay strategy according to the calibrated use cases" VAL_BLK 0x805091A5 RB_ValA_Wu8 1.00000000000 CoEng_ShiftDlyCvlci_COMPU_VERB 0.00 1.00000000000 FORMAT "%13.11" NUMBER 29 /end CHARACTERISTIC
/begin CHARACTERISTIC CoEng_stShiftDlyDftCvlci_C "Choise of the shift delay for default strategy" VALUE 0x805091C2 RB_Val_Wu8 1.00000000000 CoEng_ShiftDlyCvlci_COMPU_VERB 0.00 1.00000000000 FORMAT "%13.11" /end CHARACTERISTIC
/begin CHARACTERISTIC CoEng_stSpVlvLftIntkMax_C "Highest permitted value for state setpoint of intake valve lift" VALUE 0x805091C3 RB_Val_Wu8 255.0 OneToOne 0.00 255.0 FORMAT "%5.1" /end CHARACTERISTIC
/begin CHARACTERISTIC CoEng_stStopPhdUrgThd_C "Threshold for the classification of a stop prohibition as urgent" VALUE 0x80508EFD RB_Val_Wu8 14.00 OneToOne 1.00 15.00 FORMAT "%5.2" EXTENDED_LIMITS 0.00 255.0 /end CHARACTERISTIC
/begin CHARACTERISTIC CoEng_stStopPhdUrg_CUR "Urgency of the stop prohibitions" CURVE 0x80508EFE RB_Curve_S8_S8 16.00 OneToOne -1.00 15.00 FORMAT "%5.2" EXTENDED_LIMITS -128.0 127.0
 /begin AXIS_DESCR STD_AXIS NO_INPUT_QUANTITY CoEng_EngOnDmd_VERB 37 0.00 36.0000000000 FORMAT "%13.10" DEPOSIT ABSOLUTE /end AXIS_DESCR
/end CHARACTERISTIC
/begin CHARACTERISTIC CoEng_stStrtDmdUrgThd_C "Threshold for the classification of a start demand as urgent" VALUE 0x80508F7C RB_Val_Wu8 254.0 OneToOne 1.0 255.0 FORMAT "%5.1" EXTENDED_LIMITS 0.00 255.0 /end CHARACTERISTIC
/begin CHARACTERISTIC CoEng_stStrtDmdUrg_CUR "Urgency of the start demands" CURVE 0x80508F7D RB_Curve_S8_S8 16.00 OneToOne -1.00 15.00 FORMAT "%5.2" EXTENDED_LIMITS -128.0 127.0
 /begin AXIS_DESCR STD_AXIS NO_INPUT_QUANTITY CoEng_EngOnDmd_VERB 37 0.00 36.0000000000 FORMAT "%13.10" DEPOSIT ABSOLUTE /end AXIS_DESCR
/end CHARACTERISTIC
/begin CHARACTERISTIC CoEng_stTestStopEnbl_CA "Status to inhibit the stop enable condtitions of start-stop for test purposes." VAL_BLK 0x80508F4A RB_ValA_Wu16 65535.00 OneToOne 0.00 65535.00 FORMAT "%8.2" NUMBER 3 /end CHARACTERISTIC
/begin CHARACTERISTIC CoEng_stTestStrtDmd_CA "Status of simulation of start demanders of start-stop for test purposes." VAL_BLK 0x80508FC8 RB_ValA_Wu16 65535.00 OneToOne 0.00 65535.00 FORMAT "%8.2" NUMBER 3 /end CHARACTERISTIC
/begin CHARACTERISTIC CoEng_stTestStrtEnbl_C "Status to inhibit the start enable condtitions of start-stop for test purposes." VALUE 0x804FA3A0 Val_Wu16 65535.00 OneToOne 0.00 65535.00 FORMAT "%8.2" /end CHARACTERISTIC
/begin CHARACTERISTIC CoEng_stTrqDemMaskCvlci_C "Bit mask for shift-lock of intake valve lift shift during torque demand intervention" VALUE 0x805091C4 RB_Val_Wu16 65535.00 OneToOne 0.00 65535.00 FORMAT "%8.2" /end CHARACTERISTIC
/begin CHARACTERISTIC CoEng_stVlvLftDmdAppl1Cvlci_C "Calibration parameter 1 for manual valve lift demand" VALUE 0x805091C6 RB_Val_Wu8 255.000000000 CoEng_VlvLftStgyFixCvlci_COMPU_VERB 0.00 255.000000000 FORMAT "%13.9" /end CHARACTERISTIC
/begin CHARACTERISTIC CoEng_stVlvLftDmdAppl2Cvlci_C "Calibration parameter 2 for manual valve lift demand" VALUE 0x805091C7 RB_Val_Wu8 255.000000000 CoEng_VlvLftStgyFixCvlci_COMPU_VERB 0.00 255.000000000 FORMAT "%13.9" /end CHARACTERISTIC
/begin CHARACTERISTIC CoEng_stVlvLftStgyCvlci_CA "Choise of the intake valve lift strategy according to the calibrated use cases" VAL_BLK 0x805091C8 RB_ValA_Wu8 255.000000000 CoEng_VlvLftStgyCvlci_COMPU_VERB 0.00 255.000000000 FORMAT "%13.9" NUMBER 29 /end CHARACTERISTIC
/begin CHARACTERISTIC CoEng_swtThdAirmCatHeatg_C "Threshold for relative amount of integrated airmass at catalyst heating to release VTEC." VALUE 0x805091E5 RB_Val_Wu8 255.0 OneToOne 0.00 255.0 FORMAT "%5.1" /end CHARACTERISTIC
/begin CHARACTERISTIC CoEng_tCooltUsMaxStopEnbl_C "Maximum coolant temperature at engine out for stop release of start-stop" VALUE 0x80508F50 RB_Val_Ws16 6553.500 Temp_Cels -3549.940 3003.560 FORMAT "%8.3" /end CHARACTERISTIC
/begin CHARACTERISTIC CoEng_tCooltUsMinStopEnbl_C "Minimal coolant temperature at engine out for stop release of start-stop" VALUE 0x80508F52 RB_Val_Ws16 6553.500 Temp_Cels -3549.940 3003.560 FORMAT "%8.3" /end CHARACTERISTIC
/begin CHARACTERISTIC CoEng_tEngMaxStopEnblDelta_C "Hysteresis delta for CoEng_tEngMaxStopEnbl_C" VALUE 0x80508F54 RB_Val_Ws16 6553.500 Temp_Cels_Diff -3276.800 3276.700 FORMAT "%8.3" /end CHARACTERISTIC
/begin CHARACTERISTIC CoEng_tEngMaxStopEnbl_C "Maximal engine temperature for stop permission of start-stop" VALUE 0x80508F56 RB_Val_Ws16 6553.500 Temp_Cels -3549.940 3003.560 FORMAT "%8.3" /end CHARACTERISTIC
/begin CHARACTERISTIC CoEng_tEngMinStopEnblDelta_C "Hysteresis delta for CoEng_tEngMinStopEnbl_C" VALUE 0x80508F58 RB_Val_Ws16 6553.500 Temp_Cels_Diff -3276.800 3276.700 FORMAT "%8.3" /end CHARACTERISTIC
/begin CHARACTERISTIC CoEng_tEngMinStopEnbl_C "Minimal engine temperature for stop permission of start-stop" VALUE 0x80508F5A RB_Val_Ws16 6553.500 Temp_Cels -3549.940 3003.560 FORMAT "%8.3" /end CHARACTERISTIC
/begin CHARACTERISTIC CoEng_tEngVlvLftIntkHi_C "Maximum engine temperature for the intake valve lift" VALUE 0x805091E6 RB_Val_Ws16 6553.500 Temp_Cels -3549.940 3003.560 FORMAT "%8.3" /end CHARACTERISTIC
/begin CHARACTERISTIC CoEng_tEngVlvLftIntkLo_C "Minimum engine temperature for the intake valve lift" VALUE 0x805091E8 RB_Val_Ws16 6553.500 Temp_Cels -3549.940 3003.560 FORMAT "%8.3" /end CHARACTERISTIC
/begin CHARACTERISTIC CoEng_tExhVlvLftIntkHi_C "Maximum exhaust temperature for the intake valve lift" VALUE 0x805091EA RB_Val_Ws16 6553.500 Temp_Cels -3549.940 3003.560 FORMAT "%8.3" /end CHARACTERISTIC
/begin CHARACTERISTIC CoEng_tExhVlvLftIntkLo_C "Minimum exhaust temperature for the intake valve lift" VALUE 0x805091EC RB_Val_Ws16 6553.500 Temp_Cels -3549.940 3003.560 FORMAT "%8.3" /end CHARACTERISTIC
/begin CHARACTERISTIC CoEng_tiDiStopAftEngOff_C "Minimal engine run time after a long stop period for stop permission of start-stop" VALUE 0x80508F5C RB_Val_Wu16 655.3500 Time_s 0.00 655.3500 FORMAT "%8.4" /end CHARACTERISTIC
/begin CHARACTERISTIC CoEng_tiDlyFrzAftChgCvlci_M "Map to calibrate the delay of the different intake valve lift switches" MAP 0x805091EE RB_Map_U8U8_U8 2.550 Time_s 0.00 2.550 FORMAT "%5.3"
 /begin AXIS_DESCR STD_AXIS NO_INPUT_QUANTITY OneToOne 10 0.00 255.0 FORMAT "%5.1" DEPOSIT ABSOLUTE /end AXIS_DESCR
 /begin AXIS_DESCR STD_AXIS CoEng_stSpVlvLftIntkLoc OneToOne 10 0.00 255.0 FORMAT "%5.1" DEPOSIT ABSOLUTE /end AXIS_DESCR
/end CHARACTERISTIC
/begin CHARACTERISTIC CoEng_tiEngOffThdOil_C "Time threshold for stop period to activate CoEng_tiDiStopAftEngOff_C" VALUE 0x80508F60 RB_Val_Ws32 4294967295.00 Time_sec_q1_COMPU -2147483648.00 2147483647.00 FORMAT "%13.2" /end CHARACTERISTIC
/begin CHARACTERISTIC CoEng_tiNEngHiHysCvlci_C "Time delay to release the Valve lift shift after high engine speed" VALUE 0x80509268 RB_Val_Ws32 4294.96729500 Time_Dt -2147.48364800 2147.48364700 FORMAT "%13.8" /end CHARACTERISTIC
/begin CHARACTERISTIC CoEng_tIntkAirMax_C "Upper limit for intake air temperature" VALUE 0x8050926C RB_Val_Ws16 6553.500 Temp_Cels -3549.940 3003.560 FORMAT "%8.3" /end CHARACTERISTIC
/begin CHARACTERISTIC CoEng_tiPwrStgDiaRdy_C "delay time to diagnose turned off actuators while engine state afterrun is active" VALUE 0x80508E5A RB_Val_Ws16 327670.0 Time_ms 0.00 327670.0 FORMAT "%8.1" EXTENDED_LIMITS -327680.0 327670.0 /end CHARACTERISTIC
/begin CHARACTERISTIC CoEng_tiScneEngStrtStM.CoEng_tiScneEngStrtWait_C "The State machine which controls the behaviour of the PID 1F / Minimal time threshold which declares together with CoEng_nEngMinObd_C the OBD definition of a running engine" VALUE 0x80508E54 RB_Val_Ws16 327.6700 Time_s 0.00 327.6700 FORMAT "%8.4" EXTENDED_LIMITS -327.6800 327.6700 /end CHARACTERISTIC
/begin CHARACTERISTIC CoEng_tiShiftOffsCvlci_C "Offset for calculation of shift time of a valve lift shift" VALUE 0x8050926E RB_Val_Ws8 2.550 Time_s -1.280 1.270 FORMAT "%5.3" /end CHARACTERISTIC
/begin CHARACTERISTIC CoEng_tiSpChgAftStrt_C "Minimum time after start end before changing the valve lift setpoint" VALUE 0x80509270 RB_Val_Wu16 10.00000 Time_s 0.00 10.00000 FORMAT "%8.5" EXTENDED_LIMITS 0.00 655.3500 /end CHARACTERISTIC
/begin CHARACTERISTIC CoEng_tiSpdGrdFlt_C "Filtertime for PT1-Filtermodule to calculate additional filtered enginespeed-gradient" VALUE 0x80509274 RB_Val_Ws32 4294.9672940000000 TimeDelay_s 0.0000020000000 4294.9672959999998 FORMAT "%19.14" EXTENDED_LIMITS 0.000002000000001 4294.9672959999998 /end CHARACTERISTIC
/begin CHARACTERISTIC CoEng_tiTTcDeltaMaxDly_CUR "Duration of tolerated exceeding of the exhaust temperature range without stop inhibition" CURVE 0x80508F64 RB_Curve_S16_S16 655.3500 Time_s -327.6800 327.6700 FORMAT "%8.4"
 /begin AXIS_DESCR STD_AXIS CoEng_tTrbUsCompu Temp_Cels 2 -3549.940 3003.560 FORMAT "%8.3" DEPOSIT ABSOLUTE /end AXIS_DESCR
/end CHARACTERISTIC
/begin CHARACTERISTIC CoEng_tiTTcMinDly_C "Duration of tolerated undercut of the minimum turbo charger temperature without stop inhibition" VALUE 0x80508F6E RB_Val_Wu16 655.3500 Time_s 0.00 655.3500 FORMAT "%8.4" /end CHARACTERISTIC
/begin CHARACTERISTIC CoEng_tiVlvLftDmdAppl1Tog_C "Time using parameter 1 on manual valve lift demand on toggle mode" VALUE 0x80509278 RB_Val_Ws16 327.6700 Time_s 0.00 327.6700 FORMAT "%8.4" EXTENDED_LIMITS -327.6800 327.6700 /end CHARACTERISTIC
/begin CHARACTERISTIC CoEng_tiVlvLftDmdAppl2Tog_C "Time using parameter 2 on manual valve lift demand on toggle mode" VALUE 0x8050927A RB_Val_Ws16 327.6700 Time_s 0.00 327.6700 FORMAT "%8.4" EXTENDED_LIMITS -327.6800 327.6700 /end CHARACTERISTIC
/begin CHARACTERISTIC CoEng_tTcMaxStopEnbl_C "Maximum turbo charger temperature without stop inhibition of start-stop" VALUE 0x80508F70 RB_Val_Ws16 6553.500 Temp_Cels -3549.940 3003.560 FORMAT "%8.3" /end CHARACTERISTIC
/begin CHARACTERISTIC CoEng_tTcMinStopEnbl_C "Minimum turbo charger temperature without stop inhibition of start-stop" VALUE 0x80508F72 RB_Val_Ws16 6553.500 Temp_Cels -3549.940 3003.560 FORMAT "%8.3" /end CHARACTERISTIC
/begin CHARACTERISTIC CoEng_VlvLftMapCvlci_I.stLoadNRngCvlci_M "Class for valve lift setpoint maps / Map to define load engine speed range fior intake valve lift" MAP 0x80509280 RB_Map_S16S16_S16 20.0000000000 CoEng_EngWpCvlci_COMPU_VERB 0.00 20.0000000000 FORMAT "%13.10"
 /begin AXIS_DESCR STD_AXIS NO_INPUT_QUANTITY EngN 20 -16384.00 16383.50 FORMAT "%8.2" DEPOSIT ABSOLUTE /end AXIS_DESCR
 /begin AXIS_DESCR STD_AXIS NO_INPUT_QUANTITY Prc 21 -400.0000 399.9878 FORMAT "%8.4" DEPOSIT ABSOLUTE /end AXIS_DESCR
/end CHARACTERISTIC
/begin CHARACTERISTIC CoEng_VlvLftMapCvlci_I.stSpCvlci_M "Class for valve lift setpoint maps / Map to define intake valve lift set point" MAP 0x8050961E RB_Map_S16S16_S16 255.000000000 CoEng_VlvLftStgyFixCvlci_COMPU_VERB 0.00 255.000000000 FORMAT "%13.9"
 /begin AXIS_DESCR STD_AXIS NO_INPUT_QUANTITY CoEng_EngWpCvlci_COMPU_VERB 20 0.00 20.0000000000 FORMAT "%13.10" DEPOSIT ABSOLUTE /end AXIS_DESCR
 /begin AXIS_DESCR STD_AXIS NO_INPUT_QUANTITY CoEng_VlvLftStgyMapCvlci_COMPU_VERB 15 100.000000000 114.000000000 FORMAT "%13.9" DEPOSIT ABSOLUTE /end AXIS_DESCR
/end CHARACTERISTIC
/begin CHARACTERISTIC CoEng_vVehMinCvlciDeltaHys_C "Delta hysteresis value for use-case: Low vehicle speed" VALUE 0x8050927C RB_Val_Ws16 327.6700 Vel 0.00 327.6700 FORMAT "%8.4" EXTENDED_LIMITS -327.6800 327.6700 /end CHARACTERISTIC
/begin CHARACTERISTIC CoEng_vVehMinCvlci_C "Minimum vehicle velocity for activation of inlet valve lift" VALUE 0x8050927E RB_Val_Ws16 655.3500 Vel -327.6800 327.6700 FORMAT "%8.4" /end CHARACTERISTIC
/begin CHARACTERISTIC CoEOM_DmdLstSort.CoEOM_ThdConsdrPrio_C "the sort algorithm off the requests according to their priority / Threshold of priority, up to which the engine operation mode will be considered as no request" VALUE 0x805083AA RB_Val_Wu16 65535.00 OneToOne 0.00 65535.00 FORMAT "%8.2" /end CHARACTERISTIC
/begin CHARACTERISTIC CoEOM_EomBas1Hys_I.idxSt_MAP "hysteresis to select the first unique engine operating mode request / Look-Up-Table of the Two-D Hystereses-Look-Up-Table (Uint16)" MAP 0x805084C4 RB_Map_U16U16_U16 65535.00 OneToOne 0.00 65535.00 FORMAT "%8.2"
 /begin AXIS_DESCR STD_AXIS NO_INPUT_QUANTITY EngN 16 0.00 32767.50 FORMAT "%8.2" DEPOSIT ABSOLUTE /end AXIS_DESCR
 /begin AXIS_DESCR STD_AXIS NO_INPUT_QUANTITY rel_uw_q0p0234 16 0.00 1535.977 FORMAT "%8.3" DEPOSIT ABSOLUTE /end AXIS_DESCR
/end CHARACTERISTIC
/begin CHARACTERISTIC CoEOM_EomBas2Hys_I.idxSt_MAP "hysteresis to select the second unique engine operating mode request / Look-Up-Table of the Two-D Hystereses-Look-Up-Table (Uint16)" MAP 0x8050870C RB_Map_U16U16_U16 65535.00 OneToOne 0.00 65535.00 FORMAT "%8.2"
 /begin AXIS_DESCR STD_AXIS NO_INPUT_QUANTITY EngN 16 0.00 32767.50 FORMAT "%8.2" DEPOSIT ABSOLUTE /end AXIS_DESCR
 /begin AXIS_DESCR STD_AXIS NO_INPUT_QUANTITY rel_uw_q0p0234 16 0.00 1535.977 FORMAT "%8.3" DEPOSIT ABSOLUTE /end AXIS_DESCR
/end CHARACTERISTIC
/begin CHARACTERISTIC CoEOM_EomBasAllwdHys_I.idxSt_MAP "EOM characteristic field with all allowed modes of operation / Look-Up-Table of the Two-D Hystereses-Look-Up-Table (Uint16)" MAP 0x80508954 RB_Map_U16U16_U16 65535.00 OneToOne 0.00 65535.00 FORMAT "%8.2"
 /begin AXIS_DESCR STD_AXIS NO_INPUT_QUANTITY EngN 16 0.00 32767.50 FORMAT "%8.2" DEPOSIT ABSOLUTE /end AXIS_DESCR
 /begin AXIS_DESCR STD_AXIS NO_INPUT_QUANTITY rel_uw_q0p0234 16 0.00 1535.977 FORMAT "%8.3" DEPOSIT ABSOLUTE /end AXIS_DESCR
/end CHARACTERISTIC
/begin CHARACTERISTIC CoEOM_EomInhbd_I.stOperModPrio_C "Inhibition-Startbitmask to suppress some eninge operating modes from the selection. / Priority-parameter of the operation mode-parameter structs" VALUE 0x805083AC RB_Val_Wu8 255.0 OneToOne 0.00 255.0 FORMAT "%5.1" /end CHARACTERISTIC
/begin CHARACTERISTIC CoEOM_EomInhbd_I.stOperModStg_C "Inhibition-Startbitmask to suppress some eninge operating modes from the selection. / Stage-parameter of the operation mode-parameter structs" VALUE 0x805083AE RB_Val_Wu16 65535.00 OneToOne 0.00 65535.00 FORMAT "%8.2" /end CHARACTERISTIC
/begin CHARACTERISTIC CoEOM_EomInhbd_I.stOperMod_C "Inhibition-Startbitmask to suppress some eninge operating modes from the selection. / Operation-mode-parameter of the operation mode-parameter structs" VALUE 0x805083B0 RB_Val_Wu32 4294967295.00 OneToOne 0.00 4294967295.00 FORMAT "%13.2" /end CHARACTERISTIC
/begin CHARACTERISTIC CoEOM_EomMtrx_M "" MAP 0x8053A74C Map_Xu8Yu8Ws16 7951.00000000 CoEOM_stEomStgTot_VERB 0.00 7951.00000000 FORMAT "%13.8" READ_ONLY
 /begin AXIS_DESCR STD_AXIS CoEOM_idxEomAct CoEOM_idxOperModTot_VERB 4 0.00 31.0000000000 FORMAT "%13.10" DEPOSIT ABSOLUTE /end AXIS_DESCR
 /begin AXIS_DESCR STD_AXIS CoEOM_idxEomStgAct CoEOM_idxOperModStgTot_VERB 5 0.00 15.0000000000 FORMAT "%13.10" DEPOSIT ABSOLUTE /end AXIS_DESCR
/end CHARACTERISTIC
/begin CHARACTERISTIC CoEOM_EomTest2_I.stOperModPrio_C "Second test interface to realize toggeling between two test labels in CoEOM / Priority-parameter of the operation mode-parameter structs" VALUE 0x805083B4 RB_Val_Wu8 255.0 OneToOne 0.00 255.0 FORMAT "%5.1" /end CHARACTERISTIC
/begin CHARACTERISTIC CoEOM_EomTest2_I.stOperModStg_C "Second test interface to realize toggeling between two test labels in CoEOM / Stage-parameter of the operation mode-parameter structs" VALUE 0x805083B6 RB_Val_Wu16 65535.00 OneToOne 0.00 65535.00 FORMAT "%8.2" /end CHARACTERISTIC
/begin CHARACTERISTIC CoEOM_EomTest2_I.stOperMod_C "Second test interface to realize toggeling between two test labels in CoEOM / Operation-mode-parameter of the operation mode-parameter structs" VALUE 0x805083B8 RB_Val_Wu32 4294967295.00 OneToOne 0.00 4294967295.00 FORMAT "%13.2" /end CHARACTERISTIC
/begin CHARACTERISTIC CoEOM_EOMTestSpl_C "simple test interface in engine operation mode coordination" VALUE 0x8050831C RB_Val_Wu16 772.000000000 CoEOM_stEomStgCfgdExtn_VERB 0.00 772.000000000 FORMAT "%13.9" /end CHARACTERISTIC
/begin CHARACTERISTIC CoEOM_EomTest_I.stOperModPrio_C "Manual selection of an engine operation mode for testing. / Priority-parameter of the operation mode-parameter structs" VALUE 0x805083BC RB_Val_Wu8 255.0 OneToOne 0.00 255.0 FORMAT "%5.1" /end CHARACTERISTIC
/begin CHARACTERISTIC CoEOM_EomTest_I.stOperModStg_C "Manual selection of an engine operation mode for testing. / Stage-parameter of the operation mode-parameter structs" VALUE 0x805083BE RB_Val_Wu16 65535.00 OneToOne 0.00 65535.00 FORMAT "%8.2" /end CHARACTERISTIC
/begin CHARACTERISTIC CoEOM_EomTest_I.stOperMod_C "Manual selection of an engine operation mode for testing. / Operation-mode-parameter of the operation mode-parameter structs" VALUE 0x805083C0 RB_Val_Wu32 4294967295.00 OneToOne 0.00 4294967295.00 FORMAT "%13.2" /end CHARACTERISTIC
/begin CHARACTERISTIC CoEOM_flgEGSDCmnEnaParl_C "Parameter to determin, if the parallel coordination is necessary for EGSDCmn" VALUE 0x8050831E RB_Val_Wu8 1.00000000000 B_TRUE 0.00 1.00000000000 FORMAT "%13.11" /end CHARACTERISTIC
/begin CHARACTERISTIC CoEOM_flgSwtOnEomDmdCSERS_FT "Switch-List for activating or deactivation of some operation mode requestors in parallel coordiation (for CSERS)" CURVE 0x8050831F RB_FixCurve_U8_U8 1.000 OneToOne 0.00 1.000 FORMAT "%5.3" EXTENDED_LIMITS 0.00 255.0
 /begin AXIS_DESCR FIX_AXIS NO_INPUT_QUANTITY CoEOM_OperMod_Set_COMPU_VERB 8 0.00 7.00000000000 FORMAT "%13.11" FIX_AXIS_PAR 0 0 8 /end AXIS_DESCR
/end CHARACTERISTIC
/begin CHARACTERISTIC CoEOM_flgSwtOnEomDmdParlDiagPsbl_FT "Switch list to activate or deactivate operating mode requestor in parallel coordination" CURVE 0x80508327 RB_FixCurve_U8_U8 1.000 OneToOne 0.00 1.000 FORMAT "%5.3" EXTENDED_LIMITS 0.00 255.0
 /begin AXIS_DESCR FIX_AXIS NO_INPUT_QUANTITY CoEOM_OperMod_Set_COMPU_VERB 8 0.00 7.00000000000 FORMAT "%13.11" FIX_AXIS_PAR 0 0 8 /end AXIS_DESCR
/end CHARACTERISTIC
/begin CHARACTERISTIC CoEOM_flgSwtOnEomDmd_FT "Switch-List for activatingdeactivation of some Operation modes." CURVE 0x8050832F RB_FixCurve_U8_U8 1.000 OneToOne 0.00 1.000 FORMAT "%5.3" EXTENDED_LIMITS 0.00 255.0
 /begin AXIS_DESCR FIX_AXIS NO_INPUT_QUANTITY CoEOM_OperMod_Set_COMPU_VERB 8 0.00 7.00000000000 FORMAT "%13.11" FIX_AXIS_PAR 0 0 8 /end AXIS_DESCR
/end CHARACTERISTIC
/begin CHARACTERISTIC CoEOM_idxEGSDCmnVirtDmd_C "Index of virtual operating mode requestor of EGSDCmn_CoorParlAssc" VALUE 0x80508337 RB_Val_Wu8 7.00000000000 CoEOM_OperMod_Set_COMPU_VERB 0.00 7.00000000000 FORMAT "%13.11" /end CHARACTERISTIC
/begin CHARACTERISTIC CoEOM_NegExclsnAlg.CoEOM_ThdHardInhbnPrio_C "selection of the desired engine operation mode / Threshold of priority, from which the inhibition of engine operation mode will be considered as hard inhibition" VALUE 0x805083C8 RB_Val_Wu8 255.0 OneToOne 0.00 255.0 FORMAT "%5.1" /end CHARACTERISTIC
/begin CHARACTERISTIC CoEOM_NegExclsnAlgParDiagPsbl.CoEOM_ThdHardInhbnPrio_C "Coordination for ParDiagPsb / Threshold of priority, from which the inhibition of engine operation mode will be considered as hard inhibition" VALUE 0x805083D0 RB_Val_Wu8 255.0 OneToOne 0.00 255.0 FORMAT "%5.1" /end CHARACTERISTIC
/begin CHARACTERISTIC CoEOM_nHysDeltaEomBasis_C "Speed Hysterese for the EOM characteristic field." VALUE 0x805084A4 RB_Val_Ws16 32767.50 EngN -16384.00 16383.50 FORMAT "%8.2" /end CHARACTERISTIC
/begin CHARACTERISTIC CoEOM_nrFlg2TypMpg_M "Priorty 2-map to get a unique Priortiy-order" MAP 0x80508338 RB_Map_U8U8_U8 255.0 OneToOne 0.00 255.0 FORMAT "%5.1" READ_ONLY
 /begin AXIS_DESCR STD_AXIS NO_INPUT_QUANTITY OneToOne 5 0.00 255.0 FORMAT "%5.1" DEPOSIT ABSOLUTE /end AXIS_DESCR
 /begin AXIS_DESCR STD_AXIS NO_INPUT_QUANTITY OneToOne 5 0.00 255.0 FORMAT "%5.1" DEPOSIT ABSOLUTE /end AXIS_DESCR
/end CHARACTERISTIC
/begin CHARACTERISTIC CoEOM_OperMod2DftEOM_M "Mapping matrix for default engine operation mode" MAP 0x8050835E RB_Map_U8U8_U16 772.000000000 CoEOM_stEomStgCfgd_VERB 0.00 772.000000000 FORMAT "%13.9"
 /begin AXIS_DESCR STD_AXIS NO_INPUT_QUANTITY CoEOM_idxOperModCfgd_VERB 4 0.00 3.00000000000 FORMAT "%13.11" DEPOSIT ABSOLUTE /end AXIS_DESCR
 /begin AXIS_DESCR STD_AXIS NO_INPUT_QUANTITY CoEOM_idxOperModStgTot_VERB 5 0.00 15.0000000000 FORMAT "%13.10" DEPOSIT ABSOLUTE /end AXIS_DESCR
/end CHARACTERISTIC
/begin CHARACTERISTIC CoEOM_ratEngLoadReqTest_C "Fixed default value of the troque for EOM characteristic field, choice by CoEOM_stOperModInpSel_C = 3." VALUE 0x805084A6 RB_Val_Wu16 99.99847 rel_uw_b100 0.00 99.99847 FORMAT "%8.5" /end CHARACTERISTIC
/begin CHARACTERISTIC CoEOM_ratHysDelta_C "Hysteresis of the desirable torque for the EOM characteristic field." VALUE 0x805084A8 RB_Val_Wu16 1535.977 rel_uw_q0p0234 0.00 1535.977 FORMAT "%8.3" /end CHARACTERISTIC
/begin CHARACTERISTIC CoEOM_stBasis3_C "Default homogeneous engine operation mode" VALUE 0x805084AA RB_Val_Wu16 65535.00 OneToOne 0.00 65535.00 FORMAT "%8.2" /end CHARACTERISTIC
/begin CHARACTERISTIC CoEOM_stDftOperModPrio_C "Priority of defalut engine operation mode" VALUE 0x80508392 RB_Val_Wu8 255.0 OneToOne 0.00 255.0 FORMAT "%5.1" /end CHARACTERISTIC
/begin CHARACTERISTIC CoEOM_stEomAllwdPrio_C "Calibrated priority for inhibiting certain engine operation mode" VALUE 0x805084AC RB_Val_Wu8 255.0 OneToOne 0.00 255.0 FORMAT "%5.1" /end CHARACTERISTIC
/begin CHARACTERISTIC CoEOM_stEomAllwd_C "Allowed engine operating mode" VALUE 0x805084B0 RB_Val_Wu32 4294967295.00 OneToOne 0.00 4294967295.00 FORMAT "%13.2" /end CHARACTERISTIC
/begin CHARACTERISTIC CoEOM_stEomBasis1Prio_C "first calibrated priority for homogeneous engine operation mode" VALUE 0x805084B4 RB_Val_Wu8 255.0 OneToOne 0.00 255.0 FORMAT "%5.1" /end CHARACTERISTIC
/begin CHARACTERISTIC CoEOM_stEomBasis2Prio_C "second calibrated priority for homogeneous engine operation mode" VALUE 0x805084B5 RB_Val_Wu8 255.0 OneToOne 0.00 255.0 FORMAT "%5.1" /end CHARACTERISTIC
/begin CHARACTERISTIC CoEOM_stEomBasis3Prio_C "third calibrated priority for homogeneous engine operation mode" VALUE 0x805084B6 RB_Val_Wu8 255.0 OneToOne 0.00 255.0 FORMAT "%5.1" /end CHARACTERISTIC
/begin CHARACTERISTIC CoEOM_stEomBasis_C "Base mode of operation warm engine." VALUE 0x805084B8 RB_Val_Wu32 4294967295.00 OneToOne 0.00 4294967295.00 FORMAT "%13.2" /end CHARACTERISTIC
/begin CHARACTERISTIC CoEOM_stOperModInpSel_C "Switch for the choice of the desired troque for the EOM characteristic fields." VALUE 0x805084BC RB_Val_Wu8 3.000 OneToOne 0.00 3.000 FORMAT "%5.3" EXTENDED_LIMITS 0.00 255.0 /end CHARACTERISTIC
/begin CHARACTERISTIC CoEOM_stPrioEomDmd_T "Static priorities of operating mode requests" CURVE 0x80508393 RB_Curve_U8_U8 7.00000000000 CoEOM_OperMod_Set_COMPU_VERB 0.00 7.00000000000 FORMAT "%13.11"
 /begin AXIS_DESCR STD_AXIS NO_INPUT_QUANTITY OneToOne 8 0.00 255.0 FORMAT "%5.1" DEPOSIT ABSOLUTE /end AXIS_DESCR
/end CHARACTERISTIC
/begin CHARACTERISTIC CoEOM_stStatPrio_C "If the sorting of engine operating mode request is to be executed based on the static priority" VALUE 0x805083A4 RB_Val_Wu8 255.0 OneToOne 0.00 255.0 FORMAT "%5.1" /end CHARACTERISTIC
/begin CHARACTERISTIC CoEOM_stTestSplOperModPrio_C "Priority of simple test interface in engine operation mode coordination" VALUE 0x805083A5 RB_Val_Wu8 255.0 OneToOne 0.00 255.0 FORMAT "%5.1" /end CHARACTERISTIC
/begin CHARACTERISTIC CoEOM_tiTogTest1_C "Toggle time parameter to calibrate the delay time between CoEOM_EomTest1_I and CoEOM_EomTest2_I" VALUE 0x805083A6 RB_Val_Ws16 327670.0 Time_ms 0.00 327670.0 FORMAT "%8.1" EXTENDED_LIMITS -327680.0 327670.0 /end CHARACTERISTIC
/begin CHARACTERISTIC CoEOM_tiTogTest2_C "Toggle time parameter to calibrate the delay time between CoEOM_EomTest2_I and CoEOM_EomTest1_I" VALUE 0x805083A8 RB_Val_Ws16 327670.0 Time_ms 0.00 327670.0 FORMAT "%8.1" EXTENDED_LIMITS -327680.0 327670.0 /end CHARACTERISTIC
/begin CHARACTERISTIC VLVLFT_SPINTK_ATS.LimitTypeMsk_C "Actuator test VLVLFT_SPINTK_ATS / Tester demand monitoring enable mask for actuators" VALUE 0x8053A670 Val_Wu8 255.0 OneToOne 0.00 255.0 FORMAT "%5.1" /end CHARACTERISTIC
/begin CHARACTERISTIC VLVLFT_SPINTK_ATS.CnvNorm_C "Actuator test VLVLFT_SPINTK_ATS / Conversion norm used for conversion to/from internal scaling" VALUE 0x8053A671 Val_Wu8 255.0 OneToOne 0.00 255.0 FORMAT "%5.1" /end CHARACTERISTIC
/begin CHARACTERISTIC VLVLFT_SPINTK_ATS.LowLim_C "Actuator test VLVLFT_SPINTK_ATS / Lower limit for monitoring" VALUE 0x8053A672 Val_Wu16 65535.00 OneToOne 0.00 65535.00 FORMAT "%8.2" /end CHARACTERISTIC
/begin CHARACTERISTIC VLVLFT_SPINTK_ATS.UpLim_C "Actuator test VLVLFT_SPINTK_ATS / Upper limit for monitoring" VALUE 0x8053A674 Val_Wu16 65535.00 OneToOne 0.00 65535.00 FORMAT "%8.2" /end CHARACTERISTIC
/begin CHARACTERISTIC VLVLFT_SPINTK_ATS.CnvFac_C "Actuator test VLVLFT_SPINTK_ATS / Factor used for conversion to/from internal scaling" VALUE 0x8053A678 Val_Ws32 4294967295.00 OneToOne -2147483648.00 2147483647.00 FORMAT "%13.2" /end CHARACTERISTIC
/begin CHARACTERISTIC VLVLFT_SPINTK_ATS.CnvOfs_C "Actuator test VLVLFT_SPINTK_ATS / Offset used for conversion to/from internal scaling" VALUE 0x8053A67C Val_Ws16 65535.00 OneToOne -32768.00 32767.00 FORMAT "%8.2" /end CHARACTERISTIC
/begin CHARACTERISTIC VLVLFT_SPINTK_ATS.DfltVal_C "Actuator test VLVLFT_SPINTK_ATS / Default value for standbytest" VALUE 0x8053A67E Val_Wu16 65535.00 OneToOne 0.00 65535.00 FORMAT "%8.2" /end CHARACTERISTIC
/begin MEASUREMENT B_kuppl "Condition clutch pedal pressed" UBYTE B_TRUE 1 100 0.00 1.00000000000 BIT_MASK 0x1 FORMAT "%13.11" ECU_ADDRESS 0x70000A1B /end MEASUREMENT
/begin MEASUREMENT CEngUsT_flgDSMClrReq "Clear request from DSM Clear Task" UBYTE B_TRUE 1 100 0.00 1.00000000000 BIT_MASK 0x1 FORMAT "%13.11" ECU_ADDRESS 0x60009FC0 /end MEASUREMENT
/begin MEASUREMENT CEngUsT_flgEngStopdThisCyc "Engine Stop event in current driving cycle detected" UBYTE B_TRUE 1 100 0.00 1.00000000000 BIT_MASK 0x1 FORMAT "%13.11" ECU_ADDRESS 0x70000911 /end MEASUREMENT
/begin MEASUREMENT CEngUsT_flgFilInitER "Edge Rising Event for filter initialisation" UBYTE B_TRUE 1 100 0.00 1.00000000000 BIT_MASK 0x1 FORMAT "%13.11" ECU_ADDRESS 0x70000910 /end MEASUREMENT
/begin MEASUREMENT CEngUsT_flgIniSRCErr "Signal range check error while initialisation" UBYTE B_TRUE 1 100 0.00 1.00000000000 BIT_MASK 0x1 FORMAT "%13.11" ECU_ADDRESS 0x7000090F /end MEASUREMENT
/begin MEASUREMENT CEngUsT_flgLooseCnctnErr "Error of Loose Connection Check diagnosis" UBYTE B_TRUE 1 100 0.00 1.00000000000 BIT_MASK 0x1 FORMAT "%13.11" ECU_ADDRESS 0x7000090E /end MEASUREMENT
/begin MEASUREMENT CEngUsT_flgLooseCnctnFflp "Error of Loose Connection Check diagnosis in current driving cycle" UBYTE B_TRUE 1 100 0.00 1.00000000000 BIT_MASK 0x1 FORMAT "%13.11" ECU_ADDRESS 0x7000090D /end MEASUREMENT
/begin MEASUREMENT CEngUsT_flgLooseCnctnStr "Error of Loose Connection Check idiagnosis n last driving cycle" UBYTE B_TRUE 1 100 0.00 1.00000000000 BIT_MASK 0x1 FORMAT "%13.11" ECU_ADDRESS 0x6003499D /end MEASUREMENT
/begin MEASUREMENT CEngUsT_flgSnsrClr "Clear request Engine Coolant Temperature Sensor" UBYTE B_TRUE 1 100 0.00 1.00000000000 BIT_MASK 0x1 FORMAT "%13.11" ECU_ADDRESS 0x70000901 /end MEASUREMENT
/begin MEASUREMENT CEngUsT_flgSnsrColdChkClr "Diagnosis clear request from coldstart diagnosis of engine coolant upstream temperature" UBYTE B_TRUE 1 100 0.00 1.00000000000 BIT_MASK 0x1 FORMAT "%13.11" ECU_ADDRESS 0x70000900 /end MEASUREMENT
/begin MEASUREMENT CEngUsT_flgSnsrElecClr "Clear request of electrical diagnosis of engine coolant upstream temperature" UBYTE B_TRUE 1 100 0.00 1.00000000000 BIT_MASK 0x1 FORMAT "%13.11" ECU_ADDRESS 0x700008FF /end MEASUREMENT
/begin MEASUREMENT CEngUsT_flgSnsrPlausClr "Condition: Clear-Request Plausibility diagnosis Engine Coolant Temperature Sensor" UBYTE B_TRUE 1 100 0.00 1.00000000000 BIT_MASK 0x1 FORMAT "%13.11" ECU_ADDRESS 0x700008FE /end MEASUREMENT
/begin MEASUREMENT CEngUsT_flgSnsrSigAvl "Coolant Upstream Temperature Sensor(Radiator Outlet) Signal Availability" UBYTE B_TRUE 1 100 0.00 1.00000000000 BIT_MASK 0x1 FORMAT "%13.11" ECU_ADDRESS 0x700008FD /end MEASUREMENT
/begin MEASUREMENT CEngUsT_flgSnsrVldStop "Evaluated Stop Temperature is valid" UBYTE B_TRUE 1 100 0.00 1.00000000000 BIT_MASK 0x1 FORMAT "%13.11" ECU_ADDRESS 0x700008FC /end MEASUREMENT
/begin MEASUREMENT CEngUsT_flgSnsrVldStopLstCyc "Evaluated Stop Temperature in previous driving cycle is valid" UBYTE B_TRUE 1 100 0.00 1.00000000000 BIT_MASK 0x1 FORMAT "%13.11" ECU_ADDRESS 0x700008FB /end MEASUREMENT
/begin MEASUREMENT CEngUsT_flgSnsrVldStopStr "Evaluated Stop Temperature is valid. (internal storage)" UBYTE B_TRUE 1 100 0.00 1.00000000000 BIT_MASK 0x1 FORMAT "%13.11" ECU_ADDRESS 0x6003498F /end MEASUREMENT
/begin MEASUREMENT CEngUsT_flgSnsrVldStrt "Evaluated Start Temperature is valid" UBYTE B_TRUE 1 100 0.00 1.00000000000 BIT_MASK 0x1 FORMAT "%13.11" ECU_ADDRESS 0x700008FA /end MEASUREMENT
/begin MEASUREMENT CEngUsT_flgSRCClr "Diagnosis clear request from signal range check diagnosis of engine coolant upstream temperature" UBYTE B_TRUE 1 100 0.00 1.00000000000 BIT_MASK 0x1 FORMAT "%13.11" ECU_ADDRESS 0x7000090C /end MEASUREMENT
/begin MEASUREMENT CEngUsT_flgSRCErr "Error in Signal Range Check diagnosis" UBYTE B_TRUE 1 100 0.00 1.00000000000 BIT_MASK 0x1 FORMAT "%13.11" ECU_ADDRESS 0x7000090B /end MEASUREMENT
/begin MEASUREMENT CEngUsT_flgSRCHeal "Healing in Signal Range Check diagnosis" UBYTE B_TRUE 1 100 0.00 1.00000000000 BIT_MASK 0x1 FORMAT "%13.11" ECU_ADDRESS 0x7000090A /end MEASUREMENT
/begin MEASUREMENT CEngUsT_flgSRCMaxErr "Max Error in Signal Range Check diagnosis" UBYTE B_TRUE 1 100 0.00 1.00000000000 BIT_MASK 0x1 FORMAT "%13.11" ECU_ADDRESS 0x70000909 /end MEASUREMENT
/begin MEASUREMENT CEngUsT_flgSRCMaxHeal "Max Healing in Signal Range Check diagnosis" UBYTE B_TRUE 1 100 0.00 1.00000000000 BIT_MASK 0x1 FORMAT "%13.11" ECU_ADDRESS 0x70000908 /end MEASUREMENT
/begin MEASUREMENT CEngUsT_flgSRCMinErr "Min Error in Signal Range Check diagnosis" UBYTE B_TRUE 1 100 0.00 1.00000000000 BIT_MASK 0x1 FORMAT "%13.11" ECU_ADDRESS 0x70000907 /end MEASUREMENT
/begin MEASUREMENT CEngUsT_flgSRCMinHeal "Min Healing in Signal Range Check diagnosis" UBYTE B_TRUE 1 100 0.00 1.00000000000 BIT_MASK 0x1 FORMAT "%13.11" ECU_ADDRESS 0x70000906 /end MEASUREMENT
/begin MEASUREMENT CEngUsT_flgSRCTmpErr "Temporary error in Signal Range Check diagnosis" UBYTE B_TRUE 1 100 0.00 1.00000000000 BIT_MASK 0x1 FORMAT "%13.11" ECU_ADDRESS 0x70000905 /end MEASUREMENT
/begin MEASUREMENT CEngUsT_flgSRCTmpHeal "Temporary healing in Signal Range Check diagnosis" UBYTE B_TRUE 1 100 0.00 1.00000000000 BIT_MASK 0x1 FORMAT "%13.11" ECU_ADDRESS 0x70000904 /end MEASUREMENT
/begin MEASUREMENT CEngUsT_flgSRCTmpMaxErr "Temporary Max error in Signal Range Check diagnosis" UBYTE B_TRUE 1 100 0.00 1.00000000000 BIT_MASK 0x1 FORMAT "%13.11" ECU_ADDRESS 0x70000903 /end MEASUREMENT
/begin MEASUREMENT CEngUsT_flgSRCTmpMinErr "Temporary Min error in Signal Range Check diagnosis" UBYTE B_TRUE 1 100 0.00 1.00000000000 BIT_MASK 0x1 FORMAT "%13.11" ECU_ADDRESS 0x70000902 /end MEASUREMENT
/begin MEASUREMENT CEngUsT_flgStopFirst "First engine stop during actual driving cycle has taken place" UBYTE B_TRUE 1 100 0.00 1.00000000000 BIT_MASK 0x1 FORMAT "%13.11" ECU_ADDRESS 0x70000315 /end MEASUREMENT
/begin MEASUREMENT CEngUsT_flgSwtReplMdl "Condition to switch the input signal to the replacement model" UBYTE B_TRUE 1 100 0.00 1.00000000000 BIT_MASK 0x1 FORMAT "%13.11" ECU_ADDRESS 0x700008F9 /end MEASUREMENT
/begin MEASUREMENT CEngUsT_flgSwtReplMdlStrt "Start condition to switch the input signal to the replacement model until first valid sensor signal" UBYTE B_TRUE 1 100 0.00 1.00000000000 BIT_MASK 0x1 FORMAT "%13.11" ECU_ADDRESS 0x70000314 /end MEASUREMENT
/begin MEASUREMENT CEngUsT_flgSwtReplMdlStrtEdgeFall "Reset condition to switch the input signal to the replacement model" UBYTE B_TRUE 1 100 0.00 1.00000000000 BIT_MASK 0x1 FORMAT "%13.11" ECU_ADDRESS 0x70000313 /end MEASUREMENT
/begin MEASUREMENT CEngUsT_stDiag "Status information of diagnosis of engine coolant upstream sensor" UBYTE OneToOne 1 100 0.00 255.0 FORMAT "%5.1" ECU_ADDRESS 0x6000A0F7 /end MEASUREMENT
/begin MEASUREMENT CEngUsT_stSigT "Status to indicate signal quality of sensor value" UBYTE OneToOne 1 100 0.00 255.0 FORMAT "%5.1" ECU_ADDRESS 0x6000A69E /end MEASUREMENT
/begin MEASUREMENT CEngUsT_stSnsr "Status information of engine coolant upstream sensor" UBYTE OneToOne 1 100 0.00 255.0 FORMAT "%5.1" ECU_ADDRESS 0x6000A0F6 /end MEASUREMENT
/begin MEASUREMENT CEngUsT_t "Coolant Engine Upstream Temperature" SWORD Temp_Cels 1 100 -3549.940 3003.560 FORMAT "%8.3" ECU_ADDRESS 0x60005232 /end MEASUREMENT
/begin MEASUREMENT CEngUsT_tInpFild "Engine coolant upstream temperature before filter" SWORD Temp_Cels 1 100 -3549.940 3003.560 FORMAT "%8.3" ECU_ADDRESS 0x60005230 /end MEASUREMENT
/begin MEASUREMENT CEngUsT_tReplMdl "Replacement Model of Engine coolant upstream temperature" SWORD Temp_Cels 1 100 -3549.940 3003.560 FORMAT "%8.3" ECU_ADDRESS 0x60004B56 /end MEASUREMENT
/begin MEASUREMENT CEngUsT_tSens "Sensed value of upstream engine coolant temperature" SWORD Temp_Cels 1 100 -3549.940 3003.560 FORMAT "%8.3" ECU_ADDRESS 0x6000522E /end MEASUREMENT
/begin MEASUREMENT CEngUsT_tSnsr "temperature of engine coolant Up Stream sensor" SWORD Temp_Cels 1 100 -3549.940 3003.560 FORMAT "%8.3" ECU_ADDRESS 0x60004B54 /end MEASUREMENT
/begin MEASUREMENT CEngUsT_tSnsrFild "Filtered the raw sensor value of coolant upstream temperature" SWORD Temp_Cels 1 100 -3549.940 3003.560 FORMAT "%8.3" ECU_ADDRESS 0x60004B52 /end MEASUREMENT
/begin MEASUREMENT CEngUsT_tSnsrFildLstVld "Last valid filtered sensor signal of engine coolant upstream temperature" SWORD Temp_Cels 1 100 -3549.940 3003.560 FORMAT "%8.3" ECU_ADDRESS 0x60003E90 /end MEASUREMENT
/begin MEASUREMENT CEngUsT_tSnsrFildStrt "Filtered Sensor signal at engine start of engine coolant upstream temperature" SWORD Temp_Cels 1 100 -3549.940 3003.560 FORMAT "%8.3" ECU_ADDRESS 0x6000522C /end MEASUREMENT
/begin MEASUREMENT CEngUsT_tStop "Engine coolant upstream temperature at engine stop event" SWORD Temp_Cels 1 100 -3549.940 3003.560 FORMAT "%8.3" ECU_ADDRESS 0x6000522A /end MEASUREMENT
/begin MEASUREMENT CEngUsT_tStopLstCyc "Engine coolant upstream temperature at stop of engine of last driving cycle" SWORD Temp_Cels 1 100 -3549.940 3003.560 FORMAT "%8.3" ECU_ADDRESS 0x60005228 /end MEASUREMENT
/begin MEASUREMENT CEngUsT_tStopStr "Engine coolant upstream temperature at engine stop event (internal storage)" SWORD Temp_Cels 1 100 -3549.940 3003.560 FORMAT "%8.3" ECU_ADDRESS 0x60037E72 /end MEASUREMENT
/begin MEASUREMENT CEngUsT_tStrt "Starting value of upstream engine coolant temperature" SWORD Temp_Cels 1 100 -3549.940 3003.560 FORMAT "%8.3" ECU_ADDRESS 0x60005226 /end MEASUREMENT
/begin MEASUREMENT CEngUsT_t_Sq "Signal Quality of Engine coolant upstream temperature" UBYTE SigQly_COMPU_VERB 1 100 0.00 15.0000000000 FORMAT "%13.10" ECU_ADDRESS 0x6000A69D /end MEASUREMENT
/begin MEASUREMENT CEngUsT_uSnsr "Sensor voltage value of engine coolant upstream temperature" UWORD Volt 1 100 0.00 13107.00 FORMAT "%8.2" ECU_ADDRESS 0x6000491E /end MEASUREMENT
/begin MEASUREMENT CEngUsT_uSnsrFild "Filtered sensor voltage value of engine coolant upstream temperature" UWORD Volt 1 100 0.00 13107.00 FORMAT "%8.2" ECU_ADDRESS 0x6000491C /end MEASUREMENT
/begin MEASUREMENT Clth2_st "Clutch switch signal 2" UBYTE OneToOne 1 100 0.00 255.0 FORMAT "%5.1" ECU_ADDRESS 0x6000A69C /end MEASUREMENT
/begin MEASUREMENT Clth2_stRaw "Raw input for the Clutch switch signal 2" UBYTE OneToOne 1 100 0.00 255.0 FORMAT "%5.1" ECU_ADDRESS 0x6000A69B /end MEASUREMENT
/begin MEASUREMENT Clth3_st "Clutch switch signal 3" UBYTE OneToOne 1 100 0.00 255.0 FORMAT "%5.1" ECU_ADDRESS 0x6000A69A /end MEASUREMENT
/begin MEASUREMENT Clth3_stRaw "Raw input for the Clutch switch signal 3" UBYTE OneToOne 1 100 0.00 255.0 FORMAT "%5.1" ECU_ADDRESS 0x6000A699 /end MEASUREMENT
/begin MEASUREMENT Clth4_st "clutch switch signal 4" UBYTE OneToOne 1 100 0.00 255.0 FORMAT "%5.1" ECU_ADDRESS 0x6000A698 /end MEASUREMENT
/begin MEASUREMENT Clth4_stRaw "Clutch 4 raw signal status" UBYTE OneToOne 1 100 0.00 255.0 FORMAT "%5.1" ECU_ADDRESS 0x6000A697 /end MEASUREMENT
/begin MEASUREMENT Clth_bClth2ONStuckFlt_mp "Measuring point used in calculation of Clutch 2 ON stuck fault detection" UWORD OneToOne 1 100 0.00 65535.00 FORMAT "%8.2" ECU_ADDRESS 0x70009260 /end MEASUREMENT
/begin MEASUREMENT Clth_bClth3ONStuckFlt_mp "Measuring point used in calculation of Clutch 3 ON stuck fault detection" UWORD OneToOne 1 100 0.00 65535.00 FORMAT "%8.2" ECU_ADDRESS 0x7000925E /end MEASUREMENT
/begin MEASUREMENT Clth_bClth4ONStuckFlt_mp "Measuring point used in calculation of Clutch 4 ON stuck fault detection" UWORD OneToOne 1 100 0.00 65535.00 FORMAT "%8.2" ECU_ADDRESS 0x7000925C /end MEASUREMENT
/begin MEASUREMENT Clth_flgCluSwtImps "Error status for 2 clutch switch plausibility test" UBYTE OneToOne 1 100 0.00 255.0 FORMAT "%5.1" ECU_ADDRESS 0x6000A696 /end MEASUREMENT
/begin MEASUREMENT Clth_flgFailr "Cluth failure" UBYTE B_TRUE 1 100 0.00 1.00000000000 BIT_MASK 0x1 FORMAT "%13.11" ECU_ADDRESS 0x70000312 /end MEASUREMENT
/begin MEASUREMENT Clth_flgFullDePsd "Cluth full depressed" UBYTE B_TRUE 1 100 0.00 1.00000000000 BIT_MASK 0x1 FORMAT "%13.11" ECU_ADDRESS 0x70000311 /end MEASUREMENT
/begin MEASUREMENT Clth_flgFullPsd "Cluth full pressed" UBYTE B_TRUE 1 100 0.00 1.00000000000 BIT_MASK 0x1 FORMAT "%13.11" ECU_ADDRESS 0x70000310 /end MEASUREMENT
/begin MEASUREMENT Clth_flgFullReld "Cluth full released" UBYTE B_TRUE 1 100 0.00 1.00000000000 BIT_MASK 0x1 FORMAT "%13.11" ECU_ADDRESS 0x7000030F /end MEASUREMENT
/begin MEASUREMENT Clth_flgPtlPsd "Cluth partial pressed" UBYTE B_TRUE 1 100 0.00 1.00000000000 BIT_MASK 0x1 FORMAT "%13.11" ECU_ADDRESS 0x7000030E /end MEASUREMENT
/begin MEASUREMENT Clth_flgPtlReld "Cluth partial released" UBYTE B_TRUE 1 100 0.00 1.00000000000 BIT_MASK 0x1 FORMAT "%13.11" ECU_ADDRESS 0x7000030D /end MEASUREMENT
/begin MEASUREMENT Clth_flgPtlReldDebd "Cluth partial released debounced" UBYTE B_TRUE 1 100 0.00 1.00000000000 BIT_MASK 0x1 FORMAT "%13.11" ECU_ADDRESS 0x7000030C /end MEASUREMENT
/begin MEASUREMENT Clth_flgRxEPBErr "flag for Rx Electric Parking Brake Error" UBYTE OneToOne 1 100 0.00 1.000 BIT_MASK 0x1 FORMAT "%5.3" ECU_ADDRESS 0x6000A695 /end MEASUREMENT
/begin MEASUREMENT Clth_flgRxEPBTout "flag for Rx Electric Parking Brake Tout" UBYTE OneToOne 1 100 0.00 1.000 BIT_MASK 0x1 FORMAT "%5.3" ECU_ADDRESS 0x6000A694 /end MEASUREMENT
/begin MEASUREMENT Clth_rClthStk "Clutch Stroke sensor ratio" UBYTE Prc_EGR 1 100 0.00 100.0 FORMAT "%5.1" ECU_ADDRESS 0x60009BD5 /end MEASUREMENT
/begin MEASUREMENT Clth_st "Debounced status of Clutch" UBYTE OneToOne 1 100 0.00 255.0 FORMAT "%5.1" ECU_ADDRESS 0x50005D74 /end MEASUREMENT
/begin MEASUREMENT Clth_stClth2ErrXPostDrv_mp "Status to indicate that the post drive has been delayed by Clutch 2" UBYTE OneToOne 1 100 0.00 255.0 FORMAT "%5.1" ECU_ADDRESS 0x7000925B /end MEASUREMENT
/begin MEASUREMENT Clth_stClth2ONErrEEP_mp "Measuring point used to update the EEPROM status for clutch 2" UBYTE OneToOne 1 100 0.00 255.0 FORMAT "%5.1" ECU_ADDRESS 0x7000925A /end MEASUREMENT
/begin MEASUREMENT Clth_stClth3ErrXPostDrv_mp "Status to indicate that the post drive has been delayed by Clutch 3" UBYTE OneToOne 1 100 0.00 255.0 FORMAT "%5.1" ECU_ADDRESS 0x70009259 /end MEASUREMENT
/begin MEASUREMENT Clth_stClth3ONErrEEP_mp "Measuring point used to update the EEPROM status for clutch 3" UBYTE OneToOne 1 100 0.00 255.0 FORMAT "%5.1" ECU_ADDRESS 0x70009258 /end MEASUREMENT
/begin MEASUREMENT Clth_stClth3ONStuckFlt_mp "Measuring point used in calculation of Clutch 3 ON stuck fault detection" UBYTE OneToOne 1 100 0.00 255.0 FORMAT "%5.1" ECU_ADDRESS 0x70009257 /end MEASUREMENT
/begin MEASUREMENT Clth_stClth4ErrXPostDrv_mp "Status to indicate that the post drive has been delayed by Clutch 4." UBYTE OneToOne 1 100 0.00 255.0 FORMAT "%5.1" ECU_ADDRESS 0x70009256 /end MEASUREMENT
/begin MEASUREMENT Clth_stClth4OFFStuckFlt_mp "Measuring point used in calculation of Clutch 4 OFF stuck fault detection" UBYTE OneToOne 1 100 0.00 255.0 FORMAT "%5.1" ECU_ADDRESS 0x70009255 /end MEASUREMENT
/begin MEASUREMENT Clth_stClth4ONErrEEP_mp "Measuring point used to update the EEPROM status for clutch 4" UBYTE OneToOne 1 100 0.00 255.0 FORMAT "%5.1" ECU_ADDRESS 0x70009254 /end MEASUREMENT
/begin MEASUREMENT Clth_stClthOFFStuckFlt_mp "Measuring point used in calculation of Clutch OFF stuck fault detection" UBYTE OneToOne 1 100 0.00 255.0 FORMAT "%5.1" ECU_ADDRESS 0x70009253 /end MEASUREMENT
/begin MEASUREMENT Clth_stClthONStuckFlt_mp "Measuring point used in calculation of Clutch ON stuck fault detection" UBYTE OneToOne 1 100 0.00 255.0 FORMAT "%5.1" ECU_ADDRESS 0x70009252 /end MEASUREMENT
/begin MEASUREMENT Clth_stGSH "clutch status information for gear shift harmonization" UBYTE OneToOne 1 100 0.00 255.0 FORMAT "%5.1" ECU_ADDRESS 0x6000A692 /end MEASUREMENT
/begin MEASUREMENT Clth_stIntDebVal "Internal debounced Clutch sensor value" UBYTE OneToOne 1 100 0.00 255.0 FORMAT "%5.1" ECU_ADDRESS 0x6000A691 /end MEASUREMENT
/begin MEASUREMENT Clth_stLastGear "Gear information from last calculation cycle" SBYTE OneToOne 1 100 -128.0 127.0 FORMAT "%5.1" ECU_ADDRESS 0x6000E3FC /end MEASUREMENT
/begin MEASUREMENT Clth_stOldGear "Last valid gear information" SBYTE OneToOne 1 100 -128.0 127.0 FORMAT "%5.1" ECU_ADDRESS 0x6000A6D4 /end MEASUREMENT
/begin MEASUREMENT Clth_stOpnMark "marker of clutch state: clutch is open" UBYTE OneToOne 1 100 0.00 255.0 FORMAT "%5.1" ECU_ADDRESS 0x6000A690 /end MEASUREMENT
/begin MEASUREMENT Clth_stPlausErr0 "Status of error when stroke sensor still lies above max. threshold even after deepest clutch switch is not pressed" UBYTE OneToOne 1 100 0.00 255.0 FORMAT "%5.1" ECU_ADDRESS 0x6000A68F /end MEASUREMENT
/begin MEASUREMENT Clth_stPlausErr1 "Status of error when stroke sensor still lies below min. threshold even after deepest clutch switch is pressed" UBYTE OneToOne 1 100 0.00 255.0 FORMAT "%5.1" ECU_ADDRESS 0x6000A68E /end MEASUREMENT
/begin MEASUREMENT Clth_stRaw "Raw signal of clutch state" UBYTE OneToOne 1 100 0.00 255.0 FORMAT "%5.1" ECU_ADDRESS 0x6000E3FD /end MEASUREMENT
/begin MEASUREMENT Clth_tiClth2NrmDetPostDrv_mp "Timer used to check the release time of clutch 2 in post drive" SWORD Time_ms 1 100 -327680.0 327670.0 FORMAT "%8.1" ECU_ADDRESS 0x70009250 /end MEASUREMENT
/begin MEASUREMENT Clth_tiClth2NrmDet_mp "Timer used to check the release time of clutch 2 in normal Driving cycle" SWORD Time_ms 1 100 -327680.0 327670.0 FORMAT "%8.1" ECU_ADDRESS 0x7000924E /end MEASUREMENT
/begin MEASUREMENT Clth_tiClth3NrmDetPostDrv_mp "Timer used to check the release time of clutch 3 in post drive" SWORD Time_ms 1 100 -327680.0 327670.0 FORMAT "%8.1" ECU_ADDRESS 0x7000924C /end MEASUREMENT
/begin MEASUREMENT Clth_tiClth3NrmDet_mp "Timer used to check the release time of clutch 3 in normal Driving cycle" SWORD Time_ms 1 100 -327680.0 327670.0 FORMAT "%8.1" ECU_ADDRESS 0x7000924A /end MEASUREMENT
/begin MEASUREMENT Clth_tiClth4NrmDetPostDrv_mp "Timer used to check the release time of clutch 4 in post drive" SWORD Time_ms 1 100 -327680.0 327670.0 FORMAT "%8.1" ECU_ADDRESS 0x70009248 /end MEASUREMENT
/begin MEASUREMENT Clth_tiClth4NrmDet_mp "Timer used to check the release time of clutch 4 in normal Driving cycle" SWORD Time_ms 1 100 -327680.0 327670.0 FORMAT "%8.1" ECU_ADDRESS 0x70009246 /end MEASUREMENT
/begin MEASUREMENT CoDsplCtl_stJdgMID "status of MID judgement enable" UBYTE OneToOne 1 100 0.00 255.0 BIT_MASK 0x1 FORMAT "%5.1" ECU_ADDRESS 0x60009BD4 /end MEASUREMENT
/begin MEASUREMENT CoDsplCtl_stMIDPrev "Previous Status of MID Lamp" UBYTE OneToOne 1 100 0.00 255.0 FORMAT "%5.1" ECU_ADDRESS 0x60009BD3 /end MEASUREMENT
/begin MEASUREMENT CoDsplCtl_stOilLmp "Oil pressure warning lamp" UBYTE OneToOne 1 100 0.00 255.0 FORMAT "%5.1" ECU_ADDRESS 0x6000A77D /end MEASUREMENT
/begin MEASUREMENT CoDsplCtl_stOilLmpInfo "Oil pressure warning lamp for multi information" UBYTE OneToOne 1 100 0.00 255.0 FORMAT "%5.1" ECU_ADDRESS 0x6000A77C /end MEASUREMENT
/begin MEASUREMENT CoDsplCtl_stOilLmpOut_mp "Oil pressure warning lamp contrl status" UBYTE OneToOne 1 100 0.00 255.0 FORMAT "%5.1" ECU_ADDRESS 0x70008AB5 /end MEASUREMENT
/begin MEASUREMENT CoDsplCtl_stOilPDlyTmr "status of oil pressure delay timer" UBYTE OneToOne 1 100 0.00 255.0 FORMAT "%5.1" ECU_ADDRESS 0x60009BD2 /end MEASUREMENT
/begin MEASUREMENT CoDsplCtl_stPLmpActEna "oil pressure lamp acttuation enable status" UBYTE OneToOne 1 100 0.00 255.0 FORMAT "%5.1" ECU_ADDRESS 0x60009BD1 /end MEASUREMENT
/begin MEASUREMENT CoEngStopEnbl_TExhMax_TOFFDLY_I.time "Delay time for deactivation of start-stopp after exhaust manifold temperature above threshold / Pointer to internal timer value" SLONG TimeDT 1 100 -2147483648.00 2147483647.00 FORMAT "%13.2" ECU_ADDRESS 0x60001920 /end MEASUREMENT
/begin MEASUREMENT CoEngStopEnbl_TExhMin_TOFFDLY_I.time "Delay time for deactivation of start-stopp after exhaust manifold temperature below threshold / Pointer to internal timer value" SLONG TimeDT 1 100 -2147483648.00 2147483647.00 FORMAT "%13.2" ECU_ADDRESS 0x6000191C /end MEASUREMENT
/begin MEASUREMENT CoEng_bObdTmrInctg "On Board Diagnostic timer is incrementing" UBYTE B_TRUE 1 100 0.00 1.00000000000 BIT_MASK 0x1 FORMAT "%13.11" ECU_ADDRESS 0x6000A206 /end MEASUREMENT
/begin MEASUREMENT CoEng_bStalEng "Engine stall" UBYTE B_TRUE 1 100 0.00 1.00000000000 BIT_MASK 0x1 FORMAT "%13.11" ECU_ADDRESS 0x700008D8 /end MEASUREMENT
/begin MEASUREMENT CoEng_bStopEna "Engine STOP order enabled" UBYTE B_TRUE 1 100 0.00 1.00000000000 BIT_MASK 0x1 FORMAT "%13.11" ECU_ADDRESS 0x700008D7 /end MEASUREMENT
/begin MEASUREMENT CoEng_bStopEnblStSp "Enablesdisables the possible engine Stop order from StartStop" UBYTE B_TRUE 1 100 0.00 1.00000000000 BIT_MASK 0x1 FORMAT "%13.11" ECU_ADDRESS 0x700008D6 /end MEASUREMENT
/begin MEASUREMENT CoEng_bStrtDes "Engine START order desired" UBYTE B_TRUE 1 100 0.00 1.00000000000 BIT_MASK 0x1 FORMAT "%13.11" ECU_ADDRESS 0x700008D5 /end MEASUREMENT
/begin MEASUREMENT CoEng_bStrtEnbl "Engine START order enabled" UBYTE OneToOne 1 100 0.00 1.000 BIT_MASK 0x1 FORMAT "%5.3" ECU_ADDRESS 0x70002D7E /end MEASUREMENT
/begin MEASUREMENT CoEng_bXPostDrv "Measurement point indicating whether an extension of afterrun (PostDrive) is requested" UBYTE B_TRUE 1 100 0.00 1.00000000000 BIT_MASK 0x1 FORMAT "%13.11" ECU_ADDRESS 0x7000030B /end MEASUREMENT
/begin MEASUREMENT CoEng_dnEngFltLoc "Measurement point for filtered engine speed gradient in CoEng_VlvLftSpIntk" SWORD EngN 1 100 -16384.00 16383.50 FORMAT "%8.2" ECU_ADDRESS 0x60003E8A /end MEASUREMENT
/begin MEASUREMENT CoEng_EomCvlciAllwd1_I.stOperMod "CoEom inhibit interface 1 for intake valve lift / Priority-element of the operation mode structure" ULONG OneToOne 1 100 0.00 4294967295.00 FORMAT "%13.2" ECU_ADDRESS 0x600001E0 /end MEASUREMENT
/begin MEASUREMENT CoEng_EomCvlciAllwd1_I.stOperModPrio "CoEom inhibit interface 1 for intake valve lift / Stage-element of the operation mode structure" UBYTE OneToOne 1 100 0.00 255.0 FORMAT "%5.1" ECU_ADDRESS 0x600001E4 /end MEASUREMENT
/begin MEASUREMENT CoEng_EomCvlciAllwd1_I.stOperModStg "CoEom inhibit interface 1 for intake valve lift / Operation-mode element of the operation mode structure" UWORD OneToOne 1 100 0.00 65535.00 FORMAT "%8.2" ECU_ADDRESS 0x600001E6 /end MEASUREMENT
/begin MEASUREMENT CoEng_EomCvlciAllwd2_I.stOperMod "CoEom inhibit interface 2 for intake valve lift / Priority-element of the operation mode structure" ULONG OneToOne 1 100 0.00 4294967295.00 FORMAT "%13.2" ECU_ADDRESS 0x600001E8 /end MEASUREMENT
/begin MEASUREMENT CoEng_EomCvlciAllwd2_I.stOperModPrio "CoEom inhibit interface 2 for intake valve lift / Stage-element of the operation mode structure" UBYTE OneToOne 1 100 0.00 255.0 FORMAT "%5.1" ECU_ADDRESS 0x600001EC /end MEASUREMENT
/begin MEASUREMENT CoEng_EomCvlciAllwd2_I.stOperModStg "CoEom inhibit interface 2 for intake valve lift / Operation-mode element of the operation mode structure" UWORD OneToOne 1 100 0.00 65535.00 FORMAT "%8.2" ECU_ADDRESS 0x600001EE /end MEASUREMENT
/begin MEASUREMENT CoEng_EomCvlciDmd_I.stOperMod "CoEom interface for intake valve lift demand / Priority-element of the operation mode structure" ULONG OneToOne 1 100 0.00 4294967295.00 FORMAT "%13.2" ECU_ADDRESS 0x600001F0 /end MEASUREMENT
/begin MEASUREMENT CoEng_EomCvlciDmd_I.stOperModPrio "CoEom interface for intake valve lift demand / Stage-element of the operation mode structure" UBYTE OneToOne 1 100 0.00 255.0 FORMAT "%5.1" ECU_ADDRESS 0x600001F4 /end MEASUREMENT
/begin MEASUREMENT CoEng_EomCvlciDmd_I.stOperModStg "CoEom interface for intake valve lift demand / Operation-mode element of the operation mode structure" UWORD OneToOne 1 100 0.00 65535.00 FORMAT "%8.2" ECU_ADDRESS 0x600001F6 /end MEASUREMENT
/begin MEASUREMENT CoEng_facTq2Perc "Identically with ftrq2mi_w." UWORD fak_q2p384Em4_pc_DIV_Nm 1 100 0.00 15.62476 FORMAT "%8.5" ECU_ADDRESS 0x60000412 /end MEASUREMENT
/begin MEASUREMENT CoEng_fakCorrnAltiCvlciXVal "X value for CoEng_fakCorrnAltiCvlci_T" UWORD fak_uw_b2 1 100 0.00 1.999969 FORMAT "%8.6" ECU_ADDRESS 0x60003E88 /end MEASUREMENT
/begin MEASUREMENT CoEng_flgEngStrtCdn "The conditions for a detected OBD-relevant Engine-Start is given" UBYTE B_TRUE 1 100 0.00 1.00000000000 BIT_MASK 0x1 FORMAT "%13.11" ECU_ADDRESS 0x70002D48 /end MEASUREMENT
/begin MEASUREMENT CoEng_flgEngTempHi "Measurement point: high engine temperature" UBYTE B_TRUE 1 100 0.00 1.00000000000 BIT_MASK 0x1 FORMAT "%13.11" ECU_ADDRESS 0x60009BCF /end MEASUREMENT
/begin MEASUREMENT CoEng_flgErrCvlci "Valve lift for error case active" UBYTE B_TRUE 1 100 0.00 1.00000000000 BIT_MASK 0x1 FORMAT "%13.11" ECU_ADDRESS 0x60009BCE /end MEASUREMENT
/begin MEASUREMENT CoEng_flgFrzSpVlvLftIntk "Condition for freezing the last valve lift setpoint" UBYTE B_TRUE 1 100 0.00 1.00000000000 BIT_MASK 0x1 FORMAT "%13.11" ECU_ADDRESS 0x60009BCD /end MEASUREMENT
/begin MEASUREMENT CoEng_flgGearLoCvlci "Measurement point: low gear is used" UBYTE B_TRUE 1 100 0.00 1.00000000000 BIT_MASK 0x1 FORMAT "%13.11" ECU_ADDRESS 0x60009BCC /end MEASUREMENT
/begin MEASUREMENT CoEng_flgGevCtlDisadCvlci "Disabled valve lift shift by GevCtl" UBYTE B_TRUE 1 100 0.00 1.00000000000 BIT_MASK 0x1 FORMAT "%13.11" ECU_ADDRESS 0x60009BCB /end MEASUREMENT
/begin MEASUREMENT CoEng_flgIntkAirTempHiCvlci "Measurement point: intake air temperature high" UBYTE B_TRUE 1 100 0.00 1.00000000000 BIT_MASK 0x1 FORMAT "%13.11" ECU_ADDRESS 0x60009BCA /end MEASUREMENT
/begin MEASUREMENT CoEng_flgLimpCvlci "Measurement point: Limp home mode active" UBYTE B_TRUE 1 100 0.00 1.00000000000 BIT_MASK 0x1 FORMAT "%13.11" ECU_ADDRESS 0x60009BC9 /end MEASUREMENT
/begin MEASUREMENT CoEng_flgManVlvLftDmdCvlci "Manual valve lift demand active" UBYTE B_TRUE 1 100 0.00 1.00000000000 BIT_MASK 0x1 FORMAT "%13.11" ECU_ADDRESS 0x60009BC8 /end MEASUREMENT
/begin MEASUREMENT CoEng_flgNEngHiCvlci "Valve lift for high engine speed acitive" UBYTE B_TRUE 1 100 0.00 1.00000000000 BIT_MASK 0x1 FORMAT "%13.11" ECU_ADDRESS 0x60009BC7 /end MEASUREMENT
/begin MEASUREMENT CoEng_flgObdPreCdn "Flag: Precondition for the start of the PID1F." UBYTE B_TRUE 1 100 0.00 1.00000000000 BIT_MASK 0x1 FORMAT "%13.11" ECU_ADDRESS 0x70002D7F /end MEASUREMENT
/begin MEASUREMENT CoEng_flgStopPhdUrg "Indicates an urgent stop prohibition" UBYTE B_TRUE 1 100 0.00 1.00000000000 BIT_MASK 0x1 FORMAT "%13.11" ECU_ADDRESS 0x700008D0 /end MEASUREMENT
/begin MEASUREMENT CoEng_flgStrtDmdUrg "The start demand is urgent." UBYTE B_TRUE 1 100 0.00 1.00000000000 BIT_MASK 0x1 FORMAT "%13.11" ECU_ADDRESS 0x700008CF /end MEASUREMENT
/begin MEASUREMENT CoEng_flgSyCDriveERNM_I.oldSignal "System sub-state of the ECU changed to SYC_DRIVE. / value of input signal last calculation" UBYTE B_TRUE 1 100 0.00 1.00000000000 BIT_MASK 0x1 FORMAT "%13.11" ECU_ADDRESS 0x60009BD0 /end MEASUREMENT
/begin MEASUREMENT CoEng_flgThrVlvPotiDfctCvlci "Measurement point for defect throttle valve poti" UBYTE B_TRUE 1 100 0.00 1.00000000000 BIT_MASK 0x1 FORMAT "%13.11" ECU_ADDRESS 0x60009BC6 /end MEASUREMENT
/begin MEASUREMENT CoEng_flgTrqDemCvlci "Measurement point: torque intervention active" UBYTE B_TRUE 1 100 0.00 1.00000000000 BIT_MASK 0x1 FORMAT "%13.11" ECU_ADDRESS 0x60009BC5 /end MEASUREMENT
/begin MEASUREMENT CoEng_flgVehVMinCvlciHLD_I.hysterese "Hysteresis for use-case: Low vehicle speed / Current value of the hysteresis" UBYTE B_TRUE 1 100 0.00 1.00000000000 BIT_MASK 0x1 FORMAT "%13.11" ECU_ADDRESS 0x60009BBA /end MEASUREMENT
/begin MEASUREMENT CoEng_idxCaseActvCvlci "Index of the array CoEng_stCaseCvlci_CA with the currently activated use case on intake side" UBYTE OneToOne 1 100 0.00 255.0 FORMAT "%5.1" ECU_ADDRESS 0x60009BC4 /end MEASUREMENT
/begin MEASUREMENT CoEng_nEngCorrdCvlci "Measurement point for corrected engine speed signal" SWORD EngN 1 100 -16384.00 16383.50 FORMAT "%8.2" ECU_ADDRESS 0x60003E86 /end MEASUREMENT
/begin MEASUREMENT CoEng_nEngDelta "Predicted delta of the engine speed during a valve lift shift" SWORD EngN 1 100 -16384.00 16383.50 FORMAT "%8.2" ECU_ADDRESS 0x60003E84 /end MEASUREMENT
/begin MEASUREMENT CoEng_nEngOffsCvlci "Measurement point for engine speed offset" SWORD EngN 1 100 0.00 16383.50 FORMAT "%8.2" ECU_ADDRESS 0x60003E82 /end MEASUREMENT
/begin MEASUREMENT CoEng_nEngShiftLimCvlci "Measurement point for maximum engine speed to switch valve lift" SWORD EngN 1 100 -16384.00 16383.50 FORMAT "%8.2" ECU_ADDRESS 0x60003E80 /end MEASUREMENT
/begin MEASUREMENT CoEng_numStopPhdUrgMax "Demander with the most urgent stop prohibition" UBYTE CoEng_EngOnDmd_VERB 1 100 0.00 36.0000000000 FORMAT "%13.10" ECU_ADDRESS 0x70002D4A /end MEASUREMENT
/begin MEASUREMENT CoEng_numStrtDmdUrgMax "Demander with the most urgent start demand" UBYTE CoEng_EngOnDmd_VERB 1 100 0.00 36.0000000000 FORMAT "%13.10" ECU_ADDRESS 0x70002D4B /end MEASUREMENT
/begin MEASUREMENT CoEng_ratEngLoad "Basis for the engine map (selectable)" SWORD Prc 1 100 0.00 399.9878 FORMAT "%8.4" ECU_ADDRESS 0x60003E7E /end MEASUREMENT
/begin MEASUREMENT CoEng_ratEngLoadCorrdCvlci "Measurement point for correted engine load signal" SWORD Prc 1 100 0.00 399.9878 FORMAT "%8.4" ECU_ADDRESS 0x60003E7C /end MEASUREMENT
/begin MEASUREMENT CoEng_st "Engine operation status" UBYTE CoEng_st_COMPU_VERB 1 100 0.00 5.00000000000 FORMAT "%13.11" ECU_ADDRESS 0x6000A677 /end MEASUREMENT
/begin MEASUREMENT CoEng_stCaseCvlci "Current use cases for valve lift strategy on intake side" UBYTE CoEng_CaseCvlci_COMPU_VERB 1 100 1.000000000 255.000000000 FORMAT "%13.9" ECU_ADDRESS 0x60009BC3 /end MEASUREMENT
/begin MEASUREMENT CoEng_stDmdStrtStSp_a "Message array with the start demanders for Start-Stop" UWORD OneToOne 1 100 0.00 65535.00 FORMAT "%8.2" ARRAY_SIZE 3 ECU_ADDRESS 0x6000E154 /end MEASUREMENT
/begin MEASUREMENT CoEng_stEngRunDmd "Status of the demand for a running engine (stop prohibition or start demand)" UWORD OneToOne 1 100 0.00 65535.00 FORMAT "%8.2" ECU_ADDRESS 0x70002C20 /end MEASUREMENT
/begin MEASUREMENT CoEng_stEngStopOrdLoc "Local copy of values unequal 0 of CoVeh_stEngStopOrd." UBYTE OneToOne 1 100 0.00 255.0 FORMAT "%5.1" ECU_ADDRESS 0x70002D4C /end MEASUREMENT
/begin MEASUREMENT CoEng_stEngStrtOrdExtd "Internal continuation of the message CoVeh_stEngStrtOrd." UBYTE OneToOne 1 100 0.00 255.0 FORMAT "%5.1" ECU_ADDRESS 0x70002D4D /end MEASUREMENT
/begin MEASUREMENT CoEng_stEngStrtOrdOldStEng "The latter value of CoVeh_stEngStrtOrd in the function CoEng_StEng." UBYTE B_TRUE 1 100 0.00 1.00000000000 BIT_MASK 0x1 FORMAT "%13.11" ECU_ADDRESS 0x7000030A /end MEASUREMENT
/begin MEASUREMENT CoEng_stExtVlvLftDmdCvlci "Current intake valve lift on external demand" UBYTE OneToOne 1 100 0.00 255.0 FORMAT "%5.1" ECU_ADDRESS 0x60009BC2 /end MEASUREMENT
/begin MEASUREMENT CoEng_stInhbStopStSp_a "Message array with the stop inhibitors for Start-Stop" UWORD OneToOne 1 100 0.00 65535.00 FORMAT "%8.2" ARRAY_SIZE 3 ECU_ADDRESS 0x6000E15A /end MEASUREMENT
/begin MEASUREMENT CoEng_stInhbStrt_mp "Measurementpoint to indicate start inhibitors for start-stop" UWORD OneToOne 1 100 0.00 65535.00 FORMAT "%8.2" ECU_ADDRESS 0x700089C6 /end MEASUREMENT
/begin MEASUREMENT CoEng_stMai "Variable for engine states" UWORD CoEng_stMai_VERB 1 100 0.00 16384.0000000 FORMAT "%13.7" ECU_ADDRESS 0x500059FC /end MEASUREMENT
/begin MEASUREMENT CoEng_stMaiOld "Predecessor state of the current CoEng_stMai value" UWORD CoEng_stMai_VERB 1 100 0.00 16384.0000000 FORMAT "%13.7" ECU_ADDRESS 0x6000E160 /end MEASUREMENT
/begin MEASUREMENT CoEng_stMpgLimpVlvLftDmdXVal "X values for table CoEng_stMpgLimpVlvLftDmd_T" UWORD OneToOne 1 100 0.00 65535.00 FORMAT "%8.2" ECU_ADDRESS 0x60003E7A /end MEASUREMENT
/begin MEASUREMENT CoEng_stMpgStdLftHwIntkXVal "X values for table CoEng_stMpgStdLftHwIntk_T" UBYTE OneToOne 1 100 0.00 255.0 FORMAT "%5.1" ECU_ADDRESS 0x60009BC1 /end MEASUREMENT
/begin MEASUREMENT CoEng_stOld "engine state before current state was reached" UBYTE CoEng_st_COMPU_VERB 1 100 0.00 5.00000000000 FORMAT "%13.11" ECU_ADDRESS 0x6000A676 /end MEASUREMENT
/begin MEASUREMENT CoEng_stShftDlyCvlci "Current shift delay strategy on intake side" UBYTE CoEng_ShiftDlyCvlci_COMPU_VERB 1 100 0.00 1.00000000000 FORMAT "%13.11" ECU_ADDRESS 0x60009BC0 /end MEASUREMENT
/begin MEASUREMENT CoEng_stSpVlvLftIntk "Setpoint for status of lift position for inlet valve lift" UBYTE OneToOne 1 100 0.00 255.0 FORMAT "%5.1" ECU_ADDRESS 0x6000A675 /end MEASUREMENT
/begin MEASUREMENT CoEng_stSpVlvLftIntkBefRels "Setpoint valve lift intake before release" UBYTE OneToOne 1 100 0.00 255.0 FORMAT "%5.1" ECU_ADDRESS 0x60009BBF /end MEASUREMENT
/begin MEASUREMENT CoEng_stSpVlvLftIntkBefTstr "Setpoint valve lift intake before tester intervention" UBYTE OneToOne 1 100 0.00 255.0 FORMAT "%5.1" ECU_ADDRESS 0x60009BBE /end MEASUREMENT
/begin MEASUREMENT CoEng_stSpVlvLftIntkLoc "Setpoint for status of lift position for inlet valve lift (local variable)" UBYTE OneToOne 1 100 0.00 255.0 FORMAT "%5.1" ECU_ADDRESS 0x60009BBD /end MEASUREMENT
/begin MEASUREMENT CoEng_stStalEngReas "Status to indicate the reason of engine stall" UBYTE OneToOne 1 100 0.00 255.0 FORMAT "%5.1" ECU_ADDRESS 0x6000A674 /end MEASUREMENT
/begin MEASUREMENT CoEng_stStopEng "Engine STOP order from CoEng" UBYTE OneToOne 1 100 0.00 255.0 FORMAT "%5.1" ECU_ADDRESS 0x6000A673 /end MEASUREMENT
/begin MEASUREMENT CoEng_stStopPhdUrgMax "Urgency of the stop prohibition" UBYTE OneToOne 1 100 0.00 255.0 FORMAT "%5.1" ECU_ADDRESS 0x70002D4E /end MEASUREMENT
/begin MEASUREMENT CoEng_stStrtDmdUrgMax "Urgency of the start demand" UBYTE OneToOne 1 100 0.00 255.0 FORMAT "%5.1" ECU_ADDRESS 0x70002D4F /end MEASUREMENT
/begin MEASUREMENT CoEng_stVlvLftDmdApplCvlci "Manual valve lift demand" UBYTE CoEng_VlvLftStgyFixCvlci_COMPU_VERB 1 100 0.00 255.000000000 FORMAT "%13.9" ECU_ADDRESS 0x60009BBC /end MEASUREMENT
/begin MEASUREMENT CoEng_stVlvLftStgyActvCvlci "Current valve lift strategy on intake side" UBYTE CoEng_VlvLftStgyCvlci_COMPU_VERB 1 100 0.00 255.000000000 FORMAT "%13.9" ECU_ADDRESS 0x60009BBB /end MEASUREMENT
/begin MEASUREMENT CoEng_tEngStopEnbl "Engine temperature for release of automatic stop" SWORD Temp_Cels 1 100 -3549.940 3003.560 FORMAT "%8.3" ECU_ADDRESS 0x60003E8E /end MEASUREMENT
/begin MEASUREMENT CoEng_tExhFldVlvLftIntk "Exhaust temperature from temperature field" SWORD Temp_Cels 1 100 -3549.940 3003.560 FORMAT "%8.3" ECU_ADDRESS 0x60003E78 /end MEASUREMENT
/begin MEASUREMENT CoEng_tiAfterrun "Time since reaching engine state afterrun (COENG_STOPPING & COENG_FINISH)" ULONG Time_ms 1 100 0.00 42949672950.0 FORMAT "%13.1" ECU_ADDRESS 0x70002B0C /end MEASUREMENT
/begin MEASUREMENT CoEng_tiAfterrunBuf "Buffer for time since reaching engine state afterrun (COENG_STOPPING COENG_FINISH)" ULONG Time_ms 1 100 0.00 42949672950.0 FORMAT "%13.1" ECU_ADDRESS 0x5000115C /end MEASUREMENT
/begin MEASUREMENT CoEng_tiAfterrunRed "time since reaching engine state afterrun (COENG_STOPPING & COENG_FINISH) with reduced resolution for curve/map input" SWORD TimeRed 1 100 -5242.880 5242.720 FORMAT "%8.3" ECU_ADDRESS 0x70002C22 /end MEASUREMENT
/begin MEASUREMENT CoEng_tiCranking "Time elapsed in CRANKING state" ULONG Time_ms 1 100 0.00 42949672950.0 FORMAT "%13.1" ECU_ADDRESS 0x70002B10 /end MEASUREMENT
/begin MEASUREMENT CoEng_tiCrankingRed "Time elapsed in CRANKING state with reduced resolution for curvemap input" SWORD TimeRed 1 100 -5242.880 5242.720 FORMAT "%8.3" ECU_ADDRESS 0x70002C24 /end MEASUREMENT
/begin MEASUREMENT CoEng_tiNormal "time since running state was reached" ULONG Time_ms 1 100 0.00 42949672950.0 FORMAT "%13.1" ECU_ADDRESS 0x60001C88 /end MEASUREMENT
/begin MEASUREMENT CoEng_tiNormalBuf "Buffer for time since reaching normal engine (COENG_ST_RUNNING, COENG_ST_AUTOSTOPPING)" ULONG Time_ms 1 100 0.00 42949672950.0 FORMAT "%13.1" ECU_ADDRESS 0x6000CCC4 /end MEASUREMENT
/begin MEASUREMENT CoEng_tiNormalRed "time since engine state COENG_RUNNING was reached, with reduced resolution for curve/map input" SWORD TimeRed 1 100 -5242.880 5242.720 FORMAT "%8.3" ECU_ADDRESS 0x60005212 /end MEASUREMENT
/begin MEASUREMENT CoEng_tiRunngSumBuf "How long engine is RUNNING." ULONG Time_ms 1 100 0.00 42949672950.0 FORMAT "%13.1" ECU_ADDRESS 0x6000CCC8 /end MEASUREMENT
/begin MEASUREMENT CoEng_tiScneEngStrtPrmIdH1F "PID 1F Time elapsed since engine start" ULONG Time_sec_q1_COMPU 1 100 0.00 65535.0000000 FORMAT "%13.7" ECU_ADDRESS 0x6000D6D0 /end MEASUREMENT
/begin MEASUREMENT CoEng_tiScneEngStrtStM.CoEng_bObdTmrInctg "The State machine which controls the behaviour of the PID 1F / OBD timer is incrementing" UBYTE B_TRUE 1 100 0.00 1.00000000000 BIT_MASK 0x1 FORMAT "%13.11" ECU_ADDRESS 0x6000CCCC /end MEASUREMENT
/begin MEASUREMENT CoEng_tiScneEngStrtStM.CoEng_flgEngStrtCdn "The State machine which controls the behaviour of the PID 1F / The conditions for a detected OBD-relevant Engine-Start is given" UBYTE B_TRUE 1 100 0.00 1.00000000000 BIT_MASK 0x1 FORMAT "%13.11" ECU_ADDRESS 0x6000CCCD /end MEASUREMENT
/begin MEASUREMENT CoEng_tiScneEngStrtStM.CoEng_flgObdPreCdn "The State machine which controls the behaviour of the PID 1F / Flag: Precondition for the start of the PID1F" UBYTE B_TRUE 1 100 0.00 1.00000000000 BIT_MASK 0x1 FORMAT "%13.11" ECU_ADDRESS 0x6000CCCE /end MEASUREMENT
/begin MEASUREMENT CoEng_tiScneEngStrtStM.CoEng_stStMPrmID1F "The State machine which controls the behaviour of the PID 1F / Pointing-Variable to point out the actual state of the PID1F-State machine" UBYTE CoEng_PID1F_States_COMPU_VERB 1 100 0.00 4.00000000000 FORMAT "%13.11" ECU_ADDRESS 0x60034788 /end MEASUREMENT
/begin MEASUREMENT CoEng_tiScneEngStrtStM.CoEng_tiEngRunDcyc "The State machine which controls the behaviour of the PID 1F / CoEng time since engine start for OBD calculations in higher resolution" SLONG Time_ms 1 100 0.00 21474836470.0 FORMAT "%13.1" ECU_ADDRESS 0x6000CCD0 /end MEASUREMENT
/begin MEASUREMENT CoEng_tiScneEngStrtStM.CoEng_tiEngRunDcycLoc "The State machine which controls the behaviour of the PID 1F / Local CoEng time since engine start for OBD calculations in higher resolution" SLONG Time_ms 1 100 0.00 21474836470.0 FORMAT "%13.1" ECU_ADDRESS 0x6003478C /end MEASUREMENT
/begin MEASUREMENT CoEng_tiScneEngStrtStM.CoEng_tiEngRunPreDcycLoc "The State machine which controls the behaviour of the PID 1F / Actual counted CoEng time since engine start for OBD calculations in Dase of a SW-Reset" SLONG Time_ms 1 100 0.00 21474836470.0 FORMAT "%13.1" ECU_ADDRESS 0x6000CCD4 /end MEASUREMENT
/begin MEASUREMENT CoEng_tiScneEngStrtStM.CoEng_tiScneEngStrtWaitLoc "The State machine which controls the behaviour of the PID 1F / Local waiting time since engine start conditions for OBD related calulations are given" SWORD Time_ms 1 100 0.00 327670.0 FORMAT "%8.1" ECU_ADDRESS 0x6000CCD8 /end MEASUREMENT
/begin MEASUREMENT CoEng_tiScneEngStrtStM.CoPOM_bHybDrvCycl "The State machine which controls the behaviour of the PID 1F / Signal inside the CoEng_tiScneEngStrt.StM for Readynes for Driving" UBYTE B_TRUE 1 100 0.00 1.00000000000 BIT_MASK 0x1 FORMAT "%13.11" ECU_ADDRESS 0x6000CCDA /end MEASUREMENT
/begin MEASUREMENT CoEng_tiScneEngStrtStM.SyC_stSub "The State machine which controls the behaviour of the PID 1F / Current systemECU sub-state" UBYTE OneToOne 1 100 0.00 255.0 FORMAT "%5.1" ECU_ADDRESS 0x6000CCDB /end MEASUREMENT
/begin MEASUREMENT CoEng_tiScneEngStrtStM.sm "The State machine which controls the behaviour of the PID 1F / Internal state variable of the PID 1F-State Machine" UBYTE CoEng_tiScneEngStrtStM_sm_VERB 1 100 0.00 4.00000000000 FORMAT "%13.11" ECU_ADDRESS 0x6000CCDC /end MEASUREMENT
/begin MEASUREMENT CoEng_tiScneEngStrtStM.CoEng_tiScneEngStrtSWT_I.tiStrd "The State machine which controls the behaviour of the PID 1F / timer for PID1F / Sum value" SLONG Time_ms 1 100 -21474836480.0 21474836470.0 FORMAT "%13.1" ECU_ADDRESS 0x6000CCE0 /end MEASUREMENT
/begin MEASUREMENT CoEng_tiScneEngStrtStM.CoEng_tiScneEngStrtWaitSWT_I.tiStrd "The State machine which controls the behaviour of the PID 1F / timer for the start detection delaytime / Sum value" SWORD Time_ms 1 100 -327680.0 327670.0 FORMAT "%8.1" ECU_ADDRESS 0x6000CCE4 /end MEASUREMENT
/begin MEASUREMENT CoEng_tiShiftCvlci "Predicted time for one valve lift shift" SWORD Time_s 1 100 -327.6800 327.6700 FORMAT "%8.4" ECU_ADDRESS 0x60003E76 /end MEASUREMENT
/begin MEASUREMENT CoEng_tiStandby "time since engine state COENG_STANDBY was reached" ULONG Time_ms 1 100 0.00 42949672950.0 FORMAT "%13.1" ECU_ADDRESS 0x70002B14 /end MEASUREMENT
/begin MEASUREMENT CoEng_tiStandbyRed "Time elapsed since reaching standby state, reduced resolution" SWORD TimeRed 1 100 -5242.880 5242.720 FORMAT "%8.3" ECU_ADDRESS 0x70002C26 /end MEASUREMENT
/begin MEASUREMENT CoEng_tiStart "time since engine state (COENG_READY & COENG_CRANKING) was reached" ULONG Time_ms 1 100 0.00 42949672950.0 FORMAT "%13.1" ECU_ADDRESS 0x70002B18 /end MEASUREMENT
/begin MEASUREMENT CoEng_tiStartBuf "Buffer for time since engine state (COENG_READY COENG_CRANKING) was reached" ULONG Time_ms 1 100 0.00 42949672950.0 FORMAT "%13.1" ECU_ADDRESS 0x50001160 /end MEASUREMENT
/begin MEASUREMENT CoEng_tiStartRed "Time elapsed since reaching start state, reduced resolution" SWORD TimeRed 1 100 -5242.880 5242.720 FORMAT "%8.3" ECU_ADDRESS 0x70002C28 /end MEASUREMENT
/begin MEASUREMENT CoEng_tiStMaiRed_a "times of main engine states with reduced resolution" SWORD TimeRed 1 100 -5242.880 5242.720 FORMAT "%8.3" ARRAY_SIZE 11 ECU_ADDRESS 0x6000E162 /end MEASUREMENT
/begin MEASUREMENT CoEng_tiStMai_a "times of main engine states" ULONG Time_ms 1 100 0.00 42949672950.0 FORMAT "%13.1" ARRAY_SIZE 11 ECU_ADDRESS 0x6000D6D4 /end MEASUREMENT
/begin MEASUREMENT CoEng_tiVlvLftSpApplTog "Time counter for periodical switch-over via application interface (VHE)" SWORD Time_s 1 100 -0.0100 327.6700 FORMAT "%8.4" ECU_ADDRESS 0x60003E74 /end MEASUREMENT
/begin MEASUREMENT CoEng_tqEngRefPrmIdH63 "PID 63 Indicated Engine Reference Torque" SLONG Trq 1 100 0.00 65535.0000000 FORMAT "%13.7" ECU_ADDRESS 0x6000D700 /end MEASUREMENT
/begin MEASUREMENT CoEng_tqEngRefPrmIdH63_f "PID 63 Indicated Engine Reference Torque in floating point calculation." FLOAT32_IEEE RBPtCel_tq_1p0_1 1 100 0.00 65535.0000 FORMAT "%10.4" ECU_ADDRESS 0x60001DB0 /end MEASUREMENT
/begin MEASUREMENT CoEng_tTrbUsCompu "Turbine upstream temperature" SWORD Temp_Cels 1 100 -3549.940 3003.560 FORMAT "%8.3" ECU_ADDRESS 0x60003E8C /end MEASUREMENT
/begin MEASUREMENT CoEOM_EomBas1Hys_I.idxDistbnXOld "hysteresis to select the first unique engine operating mode request / Old X-Axis-position-index of the Two-D Hystereses-Look-Up-Table (Uint16)" UBYTE OneToOne 1 100 0.00 255.0 FORMAT "%5.1" ECU_ADDRESS 0x600003F4 /end MEASUREMENT
/begin MEASUREMENT CoEOM_EomBas1Hys_I.idxDistbnYOld "hysteresis to select the first unique engine operating mode request / Old Y-Axis-position-index of the Two-D Hystereses-Look-Up-Table (Uint16)" UBYTE OneToOne 1 100 0.00 255.0 FORMAT "%5.1" ECU_ADDRESS 0x600003F5 /end MEASUREMENT
/begin MEASUREMENT CoEOM_EomBas2Hys_I.idxDistbnXOld "hysteresis to select the second unique engine operating mode request / Old X-Axis-position-index of the Two-D Hystereses-Look-Up-Table (Uint16)" UBYTE OneToOne 1 100 0.00 255.0 FORMAT "%5.1" ECU_ADDRESS 0x600003F6 /end MEASUREMENT
/begin MEASUREMENT CoEOM_EomBas2Hys_I.idxDistbnYOld "hysteresis to select the second unique engine operating mode request / Old Y-Axis-position-index of the Two-D Hystereses-Look-Up-Table (Uint16)" UBYTE OneToOne 1 100 0.00 255.0 FORMAT "%5.1" ECU_ADDRESS 0x600003F7 /end MEASUREMENT
/begin MEASUREMENT CoEOM_EomBasAllwdHys_I.idxDistbnXOld "EOM characteristic field with all allowed modes of operation / Old X-Axis-position-index of the Two-D Hystereses-Look-Up-Table (Uint16)" UBYTE OneToOne 1 100 0.00 255.0 FORMAT "%5.1" ECU_ADDRESS 0x600003F8 /end MEASUREMENT
/begin MEASUREMENT CoEOM_EomBasAllwdHys_I.idxDistbnYOld "EOM characteristic field with all allowed modes of operation / Old Y-Axis-position-index of the Two-D Hystereses-Look-Up-Table (Uint16)" UBYTE OneToOne 1 100 0.00 255.0 FORMAT "%5.1" ECU_ADDRESS 0x600003F9 /end MEASUREMENT
/begin MEASUREMENT CoEOM_EomBasis1_I.stOperMod "class to send the result of the first unique engine operating mode request to CoEOM_Co / Priority-element of the operation mode structure" ULONG OneToOne 1 100 0.00 4294967295.00 FORMAT "%13.2" ECU_ADDRESS 0x50000114 /end MEASUREMENT
/begin MEASUREMENT CoEOM_EomBasis1_I.stOperModPrio "class to send the result of the first unique engine operating mode request to CoEOM_Co / Stage-element of the operation mode structure" UBYTE OneToOne 1 100 0.00 255.0 FORMAT "%5.1" ECU_ADDRESS 0x50000118 /end MEASUREMENT
/begin MEASUREMENT CoEOM_EomBasis1_I.stOperModStg "class to send the result of the first unique engine operating mode request to CoEOM_Co / Operation-mode element of the operation mode structure" UWORD OneToOne 1 100 0.00 65535.00 FORMAT "%8.2" ECU_ADDRESS 0x5000011A /end MEASUREMENT
/begin MEASUREMENT CoEOM_EomBasis2_I.stOperMod "class to send the result of the second unique engine operating mode request to CoEOM_Co / Priority-element of the operation mode structure" ULONG OneToOne 1 100 0.00 4294967295.00 FORMAT "%13.2" ECU_ADDRESS 0x70001A5C /end MEASUREMENT
/begin MEASUREMENT CoEOM_EomBasis2_I.stOperModPrio "class to send the result of the second unique engine operating mode request to CoEOM_Co / Stage-element of the operation mode structure" UBYTE OneToOne 1 100 0.00 255.0 FORMAT "%5.1" ECU_ADDRESS 0x70001A60 /end MEASUREMENT
/begin MEASUREMENT CoEOM_EomBasis2_I.stOperModStg "class to send the result of the second unique engine operating mode request to CoEOM_Co / Operation-mode element of the operation mode structure" UWORD OneToOne 1 100 0.00 65535.00 FORMAT "%8.2" ECU_ADDRESS 0x70001A62 /end MEASUREMENT
/begin MEASUREMENT CoEOM_EomBasis3_I.stOperMod "class to send the result of the third unique engine operating mode request to CoEOM_Co / Priority-element of the operation mode structure" ULONG OneToOne 1 100 0.00 4294967295.00 FORMAT "%13.2" ECU_ADDRESS 0x70001A54 /end MEASUREMENT
/begin MEASUREMENT CoEOM_EomBasis3_I.stOperModPrio "class to send the result of the third unique engine operating mode request to CoEOM_Co / Stage-element of the operation mode structure" UBYTE OneToOne 1 100 0.00 255.0 FORMAT "%5.1" ECU_ADDRESS 0x70001A58 /end MEASUREMENT
/begin MEASUREMENT CoEOM_EomBasis3_I.stOperModStg "class to send the result of the third unique engine operating mode request to CoEOM_Co / Operation-mode element of the operation mode structure" UWORD OneToOne 1 100 0.00 65535.00 FORMAT "%8.2" ECU_ADDRESS 0x70001A5A /end MEASUREMENT
/begin MEASUREMENT CoEOM_EomBasisAllwd_I.stOperMod "class to send the result of the allowed engine operating mode to CoEOM_Co / Priority-element of the operation mode structure" ULONG OneToOne 1 100 0.00 4294967295.00 FORMAT "%13.2" ECU_ADDRESS 0x70001A4C /end MEASUREMENT
/begin MEASUREMENT CoEOM_EomBasisAllwd_I.stOperModPrio "class to send the result of the allowed engine operating mode to CoEOM_Co / Stage-element of the operation mode structure" UBYTE OneToOne 1 100 0.00 255.0 FORMAT "%5.1" ECU_ADDRESS 0x70001A50 /end MEASUREMENT
/begin MEASUREMENT CoEOM_EomBasisAllwd_I.stOperModStg "class to send the result of the allowed engine operating mode to CoEOM_Co / Operation-mode element of the operation mode structure" UWORD OneToOne 1 100 0.00 65535.00 FORMAT "%8.2" ECU_ADDRESS 0x70001A52 /end MEASUREMENT
/begin MEASUREMENT CoEOM_EomDmdLstSortCSERS_I.idx_a "Sorted list of EOM requestors with deactivated catheating / Index of the Operation-modes-requester in the sorted Operation-modes-requester-list." UBYTE CoEOM_OperMod_Set_COMPU_VERB 1 100 0.00 7.00000000000 FORMAT "%13.11" ARRAY_SIZE 8 ECU_ADDRESS 0x5000106C /end MEASUREMENT
/begin MEASUREMENT CoEOM_EomDmdLstSortCSERS_I.nrPrio_a "Sorted list of EOM requestors with deactivated catheating / Calculated Priority of the Operation-modes-requester in the sorted Operation-modes-requester-list." UWORD OneToOne 1 100 0.00 65535.00 FORMAT "%8.2" ARRAY_SIZE 8 ECU_ADDRESS 0x50001074 /end MEASUREMENT
/begin MEASUREMENT CoEOM_EomDmdLstSortCSERS_I.stEom_a "Sorted list of EOM requestors with deactivated catheating / Requested Operation-mode of the Operation-modes-requester in the sorted Operation-modes-requester-list." ULONG OneToOne 1 100 0.00 4294967295.00 FORMAT "%13.2" ARRAY_SIZE 8 ECU_ADDRESS 0x50001084 /end MEASUREMENT
/begin MEASUREMENT CoEOM_EomDmdLstSortCSERS_I.stStg_a "Sorted list of EOM requestors with deactivated catheating / Requested Stage of the Operation-modes-requester in the sorted Operation-modes-requester-list." UWORD OneToOne 1 100 0.00 65535.00 FORMAT "%8.2" ARRAY_SIZE 8 ECU_ADDRESS 0x500010A4 /end MEASUREMENT
/begin MEASUREMENT CoEOM_EomDmdLstSortCSERS_I.typDescr_a "Sorted list of EOM requestors with deactivated catheating / Typ of the request of the Operation-modes-requester in the sorted Operation-modes-requester-list." UBYTE CoEOM_TypDescr_VERB 1 100 0.00 48.0000000000 FORMAT "%13.10" ARRAY_SIZE 8 ECU_ADDRESS 0x500010B4 /end MEASUREMENT
/begin MEASUREMENT CoEOM_EomDmdLstSortParDiagPsbl_I.idx_a "Sorted list of operating mode requestors in parallel coordination / Index of the Operation-modes-requester in the sorted Operation-modes-requester-list." UBYTE CoEOM_OperMod_Set_COMPU_VERB 1 100 0.00 7.00000000000 FORMAT "%13.11" ARRAY_SIZE 8 ECU_ADDRESS 0x500010BC /end MEASUREMENT
/begin MEASUREMENT CoEOM_EomDmdLstSortParDiagPsbl_I.nrPrio_a "Sorted list of operating mode requestors in parallel coordination / Calculated Priority of the Operation-modes-requester in the sorted Operation-modes-requester-list." UWORD OneToOne 1 100 0.00 65535.00 FORMAT "%8.2" ARRAY_SIZE 8 ECU_ADDRESS 0x500010C4 /end MEASUREMENT
/begin MEASUREMENT CoEOM_EomDmdLstSortParDiagPsbl_I.stEom_a "Sorted list of operating mode requestors in parallel coordination / Requested Operation-mode of the Operation-modes-requester in the sorted Operation-modes-requester-list." ULONG OneToOne 1 100 0.00 4294967295.00 FORMAT "%13.2" ARRAY_SIZE 8 ECU_ADDRESS 0x500010D4 /end MEASUREMENT
/begin MEASUREMENT CoEOM_EomDmdLstSortParDiagPsbl_I.stStg_a "Sorted list of operating mode requestors in parallel coordination / Requested Stage of the Operation-modes-requester in the sorted Operation-modes-requester-list." UWORD OneToOne 1 100 0.00 65535.00 FORMAT "%8.2" ARRAY_SIZE 8 ECU_ADDRESS 0x500010F4 /end MEASUREMENT
/begin MEASUREMENT CoEOM_EomDmdLstSortParDiagPsbl_I.typDescr_a "Sorted list of operating mode requestors in parallel coordination / Typ of the request of the Operation-modes-requester in the sorted Operation-modes-requester-list." UBYTE CoEOM_TypDescr_VERB 1 100 0.00 48.0000000000 FORMAT "%13.10" ARRAY_SIZE 8 ECU_ADDRESS 0x50001104 /end MEASUREMENT
/begin MEASUREMENT CoEOM_EomDmdLstSort_I.idx_a "Requester-list sorted by the priority. The requesters are verbal coded. / Index of the Operation-modes-requester in the sorted Operation-modes-requester-list." UBYTE CoEOM_OperMod_Set_COMPU_VERB 1 100 0.00 7.00000000000 FORMAT "%13.11" ARRAY_SIZE 8 ECU_ADDRESS 0x5000110C /end MEASUREMENT
/begin MEASUREMENT CoEOM_EomDmdLstSort_I.nrPrio_a "Requester-list sorted by the priority. The requesters are verbal coded. / Calculated Priority of the Operation-modes-requester in the sorted Operation-modes-requester-list." UWORD OneToOne 1 100 0.00 65535.00 FORMAT "%8.2" ARRAY_SIZE 8 ECU_ADDRESS 0x50001114 /end MEASUREMENT
/begin MEASUREMENT CoEOM_EomDmdLstSort_I.stEom_a "Requester-list sorted by the priority. The requesters are verbal coded. / Requested Operation-mode of the Operation-modes-requester in the sorted Operation-modes-requester-list." ULONG OneToOne 1 100 0.00 4294967295.00 FORMAT "%13.2" ARRAY_SIZE 8 ECU_ADDRESS 0x50001124 /end MEASUREMENT
/begin MEASUREMENT CoEOM_EomDmdLstSort_I.stStg_a "Requester-list sorted by the priority. The requesters are verbal coded. / Requested Stage of the Operation-modes-requester in the sorted Operation-modes-requester-list." UWORD OneToOne 1 100 0.00 65535.00 FORMAT "%8.2" ARRAY_SIZE 8 ECU_ADDRESS 0x50001144 /end MEASUREMENT
/begin MEASUREMENT CoEOM_EomDmdLstSort_I.typDescr_a "Requester-list sorted by the priority. The requesters are verbal coded. / Typ of the request of the Operation-modes-requester in the sorted Operation-modes-requester-list." UBYTE CoEOM_TypDescr_VERB 1 100 0.00 48.0000000000 FORMAT "%13.10" ARRAY_SIZE 8 ECU_ADDRESS 0x50001154 /end MEASUREMENT
/begin MEASUREMENT CoEOM_flgCsersActv "CSERS measures are active" UBYTE B_TRUE 1 100 0.00 1.00000000000 BIT_MASK 0x1 FORMAT "%13.11" ECU_ADDRESS 0x60009BB9 /end MEASUREMENT
/begin MEASUREMENT CoEOM_flgEGSDCmnVirtDmdActv "Virtual request from system diagnosis of exhaust gas sensors selected in parallel coordination" UBYTE B_TRUE 1 100 0.00 1.00000000000 BIT_MASK 0x1 FORMAT "%13.11" ECU_ADDRESS 0x6000E3FE /end MEASUREMENT
/begin MEASUREMENT CoEOM_flgEomActvInhb "The current mode of operation is not allowed any longer and must be left quickest possible." UBYTE B_TRUE 1 100 0.00 1.00000000000 BIT_MASK 0x1 FORMAT "%13.11" ECU_ADDRESS 0x700008EF /end MEASUREMENT
/begin MEASUREMENT CoEOM_flgRelAirStatyEomChg "After a change of the mode of operation the charge is settled stationarily." UBYTE B_TRUE 1 100 0.00 1.00000000000 BIT_MASK 0x1 FORMAT "%13.11" ECU_ADDRESS 0x700008E3 /end MEASUREMENT
/begin MEASUREMENT CoEOM_flgTogValLoc "Flag that indicates that toggeling between two calibration inputs in CoEOM is activ" UBYTE B_TRUE 1 100 0.00 1.00000000000 BIT_MASK 0x1 FORMAT "%13.11" ECU_ADDRESS 0x70000309 /end MEASUREMENT
/begin MEASUREMENT CoEOM_idxEomAct "Index of the actual EOM." UBYTE CoEOM_idxOperModTot_VERB 1 100 0.00 31.0000000000 FORMAT "%13.10" ECU_ADDRESS 0x6000E3FF /end MEASUREMENT
/begin MEASUREMENT CoEOM_idxEomDmdSeld "Index of winner of operating mode coordinator" UBYTE OneToOne 1 100 0.00 255.0 FORMAT "%5.1" ECU_ADDRESS 0x6000A68A /end MEASUREMENT
/begin MEASUREMENT CoEOM_idxEomDmdSeldLoc "Index of selected EOM-requester" UBYTE OneToOne 1 100 0.00 255.0 FORMAT "%5.1" ECU_ADDRESS 0x60009BB8 /end MEASUREMENT
/begin MEASUREMENT CoEOM_idxEomSeldLoc "Index of selected EOM" UBYTE OneToOne 1 100 0.00 255.0 FORMAT "%5.1" ECU_ADDRESS 0x60009BB7 /end MEASUREMENT
/begin MEASUREMENT CoEOM_idxEomStgAct "Index of the actual stage of the EOM." UBYTE CoEOM_idxOperModStgTot_VERB 1 100 0.00 15.0000000000 FORMAT "%13.10" ECU_ADDRESS 0x6000E400 /end MEASUREMENT
/begin MEASUREMENT CoEOM_idxEomStgSeldLoc "Index of the selected stage of a EOM" UBYTE OneToOne 1 100 0.00 255.0 FORMAT "%5.1" ECU_ADDRESS 0x60009BB6 /end MEASUREMENT
/begin MEASUREMENT CoEOM_nrPrioSeldLoc "Priority of the selected EOM" UWORD OneToOne 1 100 0.00 65535.00 FORMAT "%8.2" ECU_ADDRESS 0x60003E72 /end MEASUREMENT
/begin MEASUREMENT CoEOM_percEngLoad "Desired torque, selected by the switch for the choice of the desired torque for the Engine Operating Mode characteristic curves" UWORD rel_uw_b100 1 100 0.00 99.99847 FORMAT "%8.5" ECU_ADDRESS 0x600004D4 /end MEASUREMENT
/begin MEASUREMENT CoEOM_ratInpHyst "Torque input for the Hysterese" UWORD rel_uw_q0p0234 1 100 0.00 1535.977 FORMAT "%8.3" ECU_ADDRESS 0x600003FA /end MEASUREMENT
/begin MEASUREMENT CoEOM_stDeadlck "Status that a deadlock has happend during the operation mode selection" UBYTE OneToOne 1 100 0.00 255.0 FORMAT "%5.1" ECU_ADDRESS 0x6000A689 /end MEASUREMENT
/begin MEASUREMENT CoEOM_stEomBasis1 "first selected unique engine operating mode at a definite speed and torque" UWORD OneToOne 1 100 0.00 65535.00 FORMAT "%8.2" ECU_ADDRESS 0x60000400 /end MEASUREMENT
/begin MEASUREMENT CoEOM_stEomBasis2 "Second selected unique engine operating mode at a definite speed and torque" UWORD OneToOne 1 100 0.00 65535.00 FORMAT "%8.2" ECU_ADDRESS 0x60000402 /end MEASUREMENT
/begin MEASUREMENT CoEOM_stEomBasisAllwd "Allowed engine operating modes at a definite speed and torque" ULONG OneToOne 1 100 0.00 4294967295.00 FORMAT "%13.2" ECU_ADDRESS 0x50000140 /end MEASUREMENT
/begin MEASUREMENT CoEOM_stEomDes "Desired engine operation mode." UWORD CoEOM_stEomStgTot_VERB 1 100 0.00 7951.00000000 FORMAT "%13.8" ECU_ADDRESS 0x6000E13C /end MEASUREMENT
/begin MEASUREMENT CoEOM_stEOMDesNonCsers "Engine Operation Mode in case CSERS would not have been requested" UWORD CoEOM_stEomStgTot_VERB 1 100 0.00 7951.00000000 FORMAT "%13.8" ECU_ADDRESS 0x60004DA4 /end MEASUREMENT
/begin MEASUREMENT CoEOM_stEomDest "Target engine operation mode" UWORD CoEOM_stEomStgTot_VERB 1 100 0.00 7951.00000000 FORMAT "%13.8" ECU_ADDRESS 0x6000E13E /end MEASUREMENT
/begin MEASUREMENT CoEOM_stInhbnSeldLoc "Inhibited EOMs" UWORD OneToOne 1 100 0.00 65535.00 FORMAT "%8.2" ECU_ADDRESS 0x60003E70 /end MEASUREMENT
/begin MEASUREMENT CoEOM_stOperModDft "Operating mode (column) info for the defalut engine operating mode" ULONG OneToOne 1 100 0.00 4294967295.00 FORMAT "%13.2" ECU_ADDRESS 0x60001918 /end MEASUREMENT
/begin MEASUREMENT CoEOM_stTrigAckd "Receipts of the systems by appropriate demand because of a mode of operation change." UWORD OneToOne 1 100 0.00 65535.00 FORMAT "%8.2" ECU_ADDRESS 0x600004F4 /end MEASUREMENT
/begin MEASUREMENT CoEOM_typCoornCSERS_a "Coordination results for CSERS" UBYTE CoEOM_TypCoorn_VERB 1 100 0.00 5.00000000000 FORMAT "%13.11" ARRAY_SIZE 8 ECU_ADDRESS 0x6000A680 /end MEASUREMENT
/begin MEASUREMENT CoEOM_typCoornParDiagPsbl_a "ParDiagPsbl-coordination results" UBYTE CoEOM_TypCoorn_VERB 1 100 0.00 5.00000000000 FORMAT "%13.11" ARRAY_SIZE 8 ECU_ADDRESS 0x6000A0EE /end MEASUREMENT
/begin MEASUREMENT CoEOM_typCoorn_a "Coordination results for main coordination" UBYTE CoEOM_TypCoorn_VERB 1 100 0.00 5.00000000000 FORMAT "%13.11" ARRAY_SIZE 8 ECU_ADDRESS 0x6000A678 /end MEASUREMENT
/begin MEASUREMENT CTM_nMin "minimal engine speed for CTM" SWORD EngN 1 100 -16384.00 16383.50 FORMAT "%8.2" ECU_ADDRESS 0x6000E136 /end MEASUREMENT
/begin MEASUREMENT CTM_trqDes "desired engine torque for CTM" SWORD Trq 1 100 -3276.800 3276.700 FORMAT "%8.3" ECU_ADDRESS 0x6000E138 /end MEASUREMENT
/begin MEASUREMENT CTM_trqResv "desired engine torque reserve for CTM" SWORD Trq 1 100 -3276.800 3276.700 FORMAT "%8.3" ECU_ADDRESS 0x6000E13A /end MEASUREMENT
/begin MEASUREMENT tka_msg "Temperature engine radiator outlet (coolant)" UBYTE temp_ub_q0p75_o48 1 100 -48.0 143.3 FORMAT "%5.1" ECU_ADDRESS 0x6000A283 /end MEASUREMENT
/begin FUNCTION CEngUsT_DD "32.0.0    Coolant temperature (at engine inle / radiator outlet) - device driver"
 /begin DEF_CHARACTERISTIC CEngUsT_stSwtCfg_C CEngUsT_tiDebSRCErr_C CEngUsT_tiDebSRCHeal_C CEngUsT_tiTempPT1_C CEngUsT_tiVltgPT1_C CEngUsT_u2t_T CEngUsT_uRawDft_C CEngUsT_uThdSRCMaxErr_C CEngUsT_uThdSRCMinErr_C /end DEF_CHARACTERISTIC
 /begin IN_MEASUREMENT CEngUsT_flgSnsrElecClr TDev_flgDSMRprt100ms /end IN_MEASUREMENT
 /begin OUT_MEASUREMENT CEngUsT_flgLooseCnctnErr CEngUsT_flgSnsrSigAvl CEngUsT_flgSRCMaxErr CEngUsT_flgSRCMaxHeal CEngUsT_flgSRCMinErr CEngUsT_flgSRCMinHeal CEngUsT_stSnsr CEngUsT_tSnsr CEngUsT_tSnsrFild CEngUsT_uSnsr CEngUsT_uSnsrFild /end OUT_MEASUREMENT
 /begin LOC_MEASUREMENT CEngUsT_flgDSMClrReq CEngUsT_flgFilInitER CEngUsT_flgIniSRCErr CEngUsT_flgLooseCnctnFflp CEngUsT_flgLooseCnctnStr CEngUsT_flgSRCErr CEngUsT_flgSRCHeal CEngUsT_flgSRCTmpErr CEngUsT_flgSRCTmpHeal CEngUsT_flgSRCTmpMaxErr CEngUsT_flgSRCTmpMinErr /end LOC_MEASUREMENT
 FUNCTION_VERSION "32.0.0" /end FUNCTION
/begin FUNCTION CEngUsT_VD "32.0.0    Coolant temperature (at engine inle / radiator outlet) - virtual device" /begin DEF_CHARACTERISTIC CEngUsT_tiFil_C CEngUsT_tStopIni_C CEngUsT_tStrtThd_C /end DEF_CHARACTERISTIC
 /begin IN_MEASUREMENT CEngUsT_stDiag CEngUsT_tReplMdl CEngUsT_tSnsrFild Eep_EnvRamHist Eep_EnvRamInvld TiEngOff_bEngRot TiEngOff_bRst /end IN_MEASUREMENT
 /begin OUT_MEASUREMENT CEngUsT_flgSnsrVldStop CEngUsT_flgSnsrVldStopLstCyc CEngUsT_flgSnsrVldStrt CEngUsT_stSigT CEngUsT_t CEngUsT_tSens CEngUsT_tSnsrFildStrt CEngUsT_tStop CEngUsT_tStopLstCyc CEngUsT_tStrt CEngUsT_t_Sq tka_msg /end OUT_MEASUREMENT
 /begin LOC_MEASUREMENT CEngUsT_flgEngStopdThisCyc CEngUsT_flgSnsrVldStopStr CEngUsT_flgStopFirst CEngUsT_flgSwtReplMdl CEngUsT_flgSwtReplMdlStrt CEngUsT_flgSwtReplMdlStrtEdgeFall CEngUsT_tInpFild CEngUsT_tSnsrFildLstVld CEngUsT_tStopStr /end LOC_MEASUREMENT
 FUNCTION_VERSION "32.0.0" /end FUNCTION
/begin FUNCTION CEngUsT_VDDiagCoorr "32.2.0    Diagnosis Coordinator of Coolant Engine Upstream Temperature Sensor"
 /begin IN_MEASUREMENT CEngUsT_flgSRCMaxErr CEngUsT_flgSRCMaxHeal CEngUsT_flgSRCMinErr CEngUsT_flgSRCMinHeal CEngUsT_stSnsr TDev_flgDSMRprt100ms /end IN_MEASUREMENT
 /begin OUT_MEASUREMENT CEngUsT_flgSnsrColdChkClr CEngUsT_flgSnsrElecClr CEngUsT_flgSnsrPlausClr CEngUsT_stDiag /end OUT_MEASUREMENT
 /begin LOC_MEASUREMENT CEngUsT_flgSnsrClr CEngUsT_flgSRCClr /end LOC_MEASUREMENT
 FUNCTION_VERSION "32.2.0" /end FUNCTION
/begin FUNCTION CEngUsT_VDReplMdl "10.0.0    Replacement Temperature Model of Engine Upstream Coolant Temerature" /begin DEF_CHARACTERISTIC CEngUsT_tDftValReplMdl_C /end DEF_CHARACTERISTIC /begin OUT_MEASUREMENT CEngUsT_tReplMdl /end OUT_MEASUREMENT FUNCTION_VERSION "10.0.0" /end FUNCTION
/begin FUNCTION Clth_DD "70.2.0    Clutch Device Driver"
 /begin DEF_CHARACTERISTIC Clth2_Deb.tiHiLo_C Clth2_Deb.tiLoHi_C Clth3_Deb.tiHiLo_C Clth3_Deb.tiLoHi_C Clth4_Deb.tiHiLo_C Clth4_Deb.tiLoHi_C ClthEPBTout_Deb.tiHiLo_C ClthEPBTout_Deb.tiLoHi_C Clth_Deb.tiHiLo_C Clth_Deb.tiLoHi_C Clth_numGearSlip_C Clth_rCluStkThd_C Clth_rStkHiCC_C Clth_rStkHiIS_C Clth_rStkHiSIL_C Clth_rStkLoCC_C Clth_rStkLoIS_C Clth_rStkLoSIL_C Clth_stOpn_C Clth_stSetClu_C Clth_stSlipClsd_C Clth_stSlipOpn_C Clth_stSlip_C Clth_stStkActvn_C Clth_swtSig_C Clth_tiEPBComDeb_C Clth_tiRxEPBDeb_C Clth_tiUnderURstStrtReqOff_C /end DEF_CHARACTERISTIC
 /begin IN_MEASUREMENT Clth4_st Clth_st CoEng_st Com_rClthStk Com_stClth Com_stClthPedlFailDet Com_stClthStkFailInfo Com_stRxEPB Gbx_numGear Gbx_stPNPos Strt_stPs T15_st T50_st Tra_numGear Tra_swtCVTSig /end IN_MEASUREMENT
 /begin OUT_MEASUREMENT Clth2_st Clth2_stRaw Clth3_st Clth3_stRaw Clth4_stRaw Clth_flgRxEPBErr Clth_flgRxEPBTout Clth_stIntDebVal Clth_stRaw /end OUT_MEASUREMENT
 /begin LOC_MEASUREMENT B_kuppl Clth_rClthStk /end LOC_MEASUREMENT
 FUNCTION_VERSION "70.2.0" /end FUNCTION
/begin FUNCTION Clth_VD "70.3.0    Clutch Position Sensor Virtual Device"
 /begin DEF_CHARACTERISTIC Clth_flgStkSensClthSwtPrs_C Clth_nEngThd_C Clth_nNoGearShftDet_C Clth_rClthStkMaxThres_C Clth_rClthStkMinThres_C Clth_rThd1_C Clth_rThd2_C Clth_rThd3_C Clth_stClthONEEPRepl_C Clth_stDflVal_C Clth_swtCond_C Clth_tiCANDlyClthOff_C Clth_tiCANDlyClthOn_C Clth_tiClth2NrmDet_C Clth_tiClth3NrmDet_C Clth_tiClth4NrmDet_C Clth_tiCluSwtImpsOffDeb_C Clth_tiCluSwtImpsOnDeb_C Clth_tiGearShft_C Clth_tiReOpenDly_C Clth_vNoGearShftDet_C Clth_vVehSpdThd_C /end DEF_CHARACTERISTIC
 /begin REF_CHARACTERISTIC Clth_stStkActvn_C /end REF_CHARACTERISTIC
 /begin IN_MEASUREMENT Clth2_st Clth2_stRaw Clth3_st Clth_flgRxEPBTout Clth_r Clth_stIntDebVal Clth_stRaw Com_rClthStk Com_stClth Com_stClthPedlFailDet Com_stClthStkFailInfo Com_stRxEPB Epm_nEng Gbx_stPNPos SyC_stHistTiPostDrvMax SyC_stSub T15_st Tra_numGear VehV_v /end IN_MEASUREMENT
 /begin OUT_MEASUREMENT Clth4_st Clth_flgCluSwtImps Clth_st Clth_stGSH Clth_stLastGear Clth_stOldGear Clth_stOpnMark Clth_stPlausErr0 Clth_stPlausErr1 /end OUT_MEASUREMENT
 /begin LOC_MEASUREMENT Clth_bClth2ONStuckFlt_mp Clth_bClth3ONStuckFlt_mp Clth_bClth4ONStuckFlt_mp Clth_flgFailr Clth_flgFullDePsd Clth_flgFullPsd Clth_flgFullReld Clth_flgPtlPsd Clth_flgPtlReld Clth_flgPtlReldDebd Clth_stClth2ErrXPostDrv_mp Clth_stClth2ONErrEEP_mp Clth_stClth3ErrXPostDrv_mp Clth_stClth3ONErrEEP_mp Clth_stClth3ONStuckFlt_mp Clth_stClth4ErrXPostDrv_mp Clth_stClth4OFFStuckFlt_mp Clth_stClth4ONErrEEP_mp Clth_stClthOFFStuckFlt_mp Clth_stClthONStuckFlt_mp Clth_tiClth2NrmDetPostDrv_mp Clth_tiClth2NrmDet_mp Clth_tiClth3NrmDetPostDrv_mp Clth_tiClth3NrmDet_mp Clth_tiClth4NrmDetPostDrv_mp Clth_tiClth4NrmDet_mp /end LOC_MEASUREMENT
 FUNCTION_VERSION "70.3.0" /end FUNCTION
/begin FUNCTION CoCTM_Demand "17.0.0    Coordinator of the demands of the Cabin Thermal Management" /begin IN_MEASUREMENT AC_trqDes AC_trqResv /end IN_MEASUREMENT /begin OUT_MEASUREMENT CTM_nMin CTM_trqDes CTM_trqResv /end OUT_MEASUREMENT FUNCTION_VERSION "17.0.0" /end FUNCTION
/begin FUNCTION CodeGen "17.12.0   ASCET Automotive System Library Interface" FUNCTION_VERSION "17.12.0" /end FUNCTION
/begin FUNCTION CodeGen_Simulink "1.18.0    Code generator component for Simulink Coder" FUNCTION_VERSION "1.18.0" /end FUNCTION
/begin FUNCTION CoDsplCtl_OilPresLmp "1.15.0_1.0.0Oil pressure warning lamp control"
 /begin DEF_CHARACTERISTIC CoDsplCtl_nJdgMIDThd_C CoDsplCtl_nOilPres1Low_C CoDsplCtl_nOilPres2High_C CoDsplCtl_nOilPres2Low_C CoDsplCtl_tiDlyStOilP_C CoDsplCtl_tiOilPresBrkAwayDly_C CoDsplCtl_tiOilPresDly_C CoDsplCtl_tiOilPresEngRunDly_C CoDsplCtl_tiOilPresRetDly_C CodsplCtl_tiPLampActtnEna_C CoDsplCtl_tiSuspndMid_C /end DEF_CHARACTERISTIC
 /begin IN_MEASUREMENT CoEng_st CoEng_stMai CoVOM_stRstrtNoPtd Epm_nEng Oil_stPSwmp T15_st /end IN_MEASUREMENT
 /begin OUT_MEASUREMENT CoDsplCtl_stOilLmp CoDsplCtl_stOilLmpInfo /end OUT_MEASUREMENT
 /begin LOC_MEASUREMENT CoDsplCtl_stJdgMID CoDsplCtl_stMIDPrev CoDsplCtl_stOilLmpOut_mp CoDsplCtl_stOilPDlyTmr CoDsplCtl_stPLmpActEna /end LOC_MEASUREMENT
 FUNCTION_VERSION "1.15.0_1.0.0" /end FUNCTION
/begin FUNCTION CoEng_GlbDef "1.51.0    Global definitions in CoEng" FUNCTION_VERSION "1.51.0" /end FUNCTION
/begin FUNCTION CoEng_ObdSig "1.6.0     Calculate and Provides all OBD-Relevant signals from BC:CoEng"
 /begin DEF_CHARACTERISTIC CoEng_nEngStrtCdnMin_C CoEng_tiScneEngStrtStM.CoEng_tiScneEngStrtWait_C /end DEF_CHARACTERISTIC
 /begin IN_MEASUREMENT EngDa_tqInnrMax_f Epm_nEng SyC_stSub /end IN_MEASUREMENT
 /begin OUT_MEASUREMENT CoEng_bObdTmrInctg CoEng_flgObdPreCdn CoEng_tiScneEngStrtPrmIdH1F CoEng_tqEngRefPrmIdH63 CoEng_tqEngRefPrmIdH63_f /end OUT_MEASUREMENT
 /begin LOC_MEASUREMENT CoEng_flgEngStrtCdn CoEng_tiScneEngStrtStM.CoEng_bObdTmrInctg CoEng_tiScneEngStrtStM.CoEng_flgEngStrtCdn CoEng_tiScneEngStrtStM.CoEng_flgObdPreCdn CoEng_tiScneEngStrtStM.CoEng_stStMPrmID1F CoEng_tiScneEngStrtStM.CoEng_tiEngRunDcyc CoEng_tiScneEngStrtStM.CoEng_tiEngRunDcycLoc CoEng_tiScneEngStrtStM.CoEng_tiEngRunPreDcycLoc CoEng_tiScneEngStrtStM.CoEng_tiScneEngStrtWaitLoc CoEng_tiScneEngStrtStM.CoPOM_bHybDrvCycl CoEng_tiScneEngStrtStM.SyC_stSub CoEng_tiScneEngStrtStM.sm CoEng_tiScneEngStrtStM.CoEng_tiScneEngStrtSWT_I.tiStrd CoEng_tiScneEngStrtStM.CoEng_tiScneEngStrtWaitSWT_I.tiStrd /end LOC_MEASUREMENT
 FUNCTION_VERSION "1.6.0" /end FUNCTION
/begin FUNCTION CoEng_StAdpr "1.7.0     Adapter for additional informations about CoEng status" /begin DEF_CHARACTERISTIC CoEng_flgEngStrtT50Use_C /end DEF_CHARACTERISTIC
 /begin IN_MEASUREMENT CoEng_stMai CoEng_stMaiOld CoEng_tiStMaiRed_a CoEng_tiStMai_a CoVeh_stEngStrtOrd EngStrt_stRstrtRsn T50_st /end IN_MEASUREMENT
 /begin OUT_MEASUREMENT CoEng_st CoEng_stOld CoEng_stStopEng CoEng_tiAfterrun CoEng_tiAfterrunRed CoEng_tiCranking CoEng_tiCrankingRed CoEng_tiNormal CoEng_tiNormalRed CoEng_tiStandby CoEng_tiStandbyRed CoEng_tiStart CoEng_tiStartRed /end OUT_MEASUREMENT
 FUNCTION_VERSION "1.7.0" /end FUNCTION
/begin FUNCTION CoEng_StEng "10.12.0   Coordinator Engine - Engine States"
 /begin DEF_CHARACTERISTIC CoEng_bEnaStrt2AutoStop_C CoEng_stRstrtTran_C CoEng_tiPwrStgDiaRdy_C /end DEF_CHARACTERISTIC
 /begin IN_MEASUREMENT CoVeh_stEngStopOrd CoVeh_stEngStrtOrd EngStrt_bStrt EngStrt_bStrtEnd EngStrt_stRstrtRsn EngStrt_stRstrtStgy Epm_stSpd Strt_stStaActv SyC_stSub /end IN_MEASUREMENT
 /begin OUT_MEASUREMENT CoEng_bStalEng CoEng_stMai CoEng_stMaiOld CoEng_stStalEngReas CoEng_tiStMaiRed_a CoEng_tiStMai_a /end OUT_MEASUREMENT
 /begin LOC_MEASUREMENT CoEng_bXPostDrv CoEng_flgSyCDriveERNM_I.oldSignal CoEng_stEngStopOrdLoc CoEng_stEngStrtOrdExtd CoEng_stEngStrtOrdOldStEng CoEng_tiAfterrunBuf CoEng_tiNormalBuf CoEng_tiRunngSumBuf CoEng_tiStartBuf /end LOC_MEASUREMENT
 FUNCTION_VERSION "10.12.0" /end FUNCTION
/begin FUNCTION CoEng_StopEnbl "1.38.0    Enable conditions for engine stops"
 /begin DEF_CHARACTERISTIC CoEng_idxEngTSelStSpStopEna_C CoEng_numNoUrgStopPhd_C CoEng_stActvtStopEnblCdn_CA CoEng_stEngRunDmd_CUR CoEng_stNoStspStop16ExhMgT_C CoEng_stPrioMinNoStopExhMgT_C CoEng_stStopPhdUrgThd_C CoEng_stStopPhdUrg_CUR CoEng_stTestStopEnbl_CA CoEng_tCooltUsMaxStopEnbl_C CoEng_tCooltUsMinStopEnbl_C CoEng_tEngMaxStopEnblDelta_C CoEng_tEngMaxStopEnbl_C CoEng_tEngMinStopEnblDelta_C CoEng_tEngMinStopEnbl_C CoEng_tiDiStopAftEngOff_C CoEng_tiEngOffThdOil_C CoEng_tiTTcDeltaMaxDly_CUR CoEng_tiTTcMinDly_C CoEng_tTcMaxStopEnbl_C CoEng_tTcMinStopEnbl_C /end DEF_CHARACTERISTIC
 /begin IN_MEASUREMENT B_bkvsta_msg B_khakt_msg B_khakw_msg CEngDsT_t CEngUsT_t CoEng_stMai CoEng_stMaiOld CoEng_tiStMai_a ExhMgT_flgNoStopEngCatHeatg ExhMgT_stPrioWpDmdHyb ExhMod_tExhMnfB1 priobbora_msg priobbteh_msg TiEngOff_stTi TiEngOff_ti /end IN_MEASUREMENT
 /begin OUT_MEASUREMENT CoEng_bStopEna CoEng_bStopEnblStSp CoEng_flgStopPhdUrg CoEng_stEngRunDmd CoEng_stInhbStopStSp_a /end OUT_MEASUREMENT
 /begin LOC_MEASUREMENT CoEngStopEnbl_TExhMax_TOFFDLY_I.time CoEngStopEnbl_TExhMin_TOFFDLY_I.time CoEng_numStopPhdUrgMax CoEng_stStopPhdUrgMax CoEng_tEngStopEnbl CoEng_tTrbUsCompu /end LOC_MEASUREMENT
 FUNCTION_VERSION "1.38.0" /end FUNCTION
/begin FUNCTION CoEng_StrtDes "1.24.0    Desire conditions for engine starts"
 /begin DEF_CHARACTERISTIC CoEng_numNoUrgStrtDmd_C CoEng_stActvtStrtDmdCdn_CA CoEng_stStrtDmdUrgThd_C CoEng_stStrtDmdUrg_CUR CoEng_stTestStrtDmd_CA /end DEF_CHARACTERISTIC
 /begin IN_MEASUREMENT B_bkvsta_msg /end IN_MEASUREMENT
 /begin OUT_MEASUREMENT CoEng_bStrtDes CoEng_flgStrtDmdUrg CoEng_stDmdStrtStSp_a /end OUT_MEASUREMENT
 /begin LOC_MEASUREMENT CoEng_numStrtDmdUrgMax CoEng_stStrtDmdUrgMax /end LOC_MEASUREMENT
 FUNCTION_VERSION "1.24.0" /end FUNCTION
/begin FUNCTION CoEng_StrtEnbl "1.5.0     Enable conditions for engine starts" /begin DEF_CHARACTERISTIC CoEng_stTestStrtEnbl_C /end DEF_CHARACTERISTIC /begin OUT_MEASUREMENT CoEng_bStrtEnbl /end OUT_MEASUREMENT /begin LOC_MEASUREMENT CoEng_stInhbStrt_mp /end LOC_MEASUREMENT FUNCTION_VERSION "1.5.0" /end FUNCTION
/begin FUNCTION CoEng_VlvLftSpIntk "2.31.0_1.4.0Setpoint Valve Lift Intake"
 /begin DEF_CHARACTERISTIC CoEng_facThdAirmCatHeatg_C CoEng_fakCorrnAltiCvlci_T CoEng_idxExhModTSelVlvLftIntk_C CoEng_nCorrnGearCvlci_T CoEng_nEngShiftLimCvlci_T CoEng_nOffsLimMaxCvlci_C CoEng_nOffsLimMaxFCOCvlci_C CoEng_nOffsLimMinCvlci_C CoEng_nOffsLimMinFCOCvlci_C CoEng_nrCamsftRotShiftCvlci_C CoEng_numGearLo_CA CoEng_ratEngLoadTest_C CoEng_ratLoadFCORstrtCvlci_C CoEng_stCaseCvlci_CA CoEng_stCaseStgyDftCvlci_C CoEng_stEomCvlciAllwd1ModVlvLft0_C CoEng_stEomCvlciAllwd1ModVlvLft1_C CoEng_stEomCvlciAllwd1ModVlvLft2_C CoEng_stEomCvlciAllwd1ModVlvLft3_C CoEng_stEomCvlciAllwd1ModVlvLft4_C CoEng_stEomCvlciAllwd1ModVlvLft5_C CoEng_stEomCvlciAllwd1ModVlvLft6_C CoEng_stEomCvlciAllwd1ModVlvLft7_C CoEng_stEomCvlciAllwd1ModVlvLft8_C CoEng_stEomCvlciAllwd1ModVlvLft9_C CoEng_stEomCvlciAllwd1Prio_T CoEng_stEomCvlciAllwd1Stg_T CoEng_stEomCvlciAllwd2ModVlvLft0_C CoEng_stEomCvlciAllwd2ModVlvLft1_C CoEng_stEomCvlciAllwd2ModVlvLft2_C CoEng_stEomCvlciAllwd2ModVlvLft3_C CoEng_stEomCvlciAllwd2ModVlvLft4_C CoEng_stEomCvlciAllwd2ModVlvLft5_C CoEng_stEomCvlciAllwd2ModVlvLft6_C CoEng_stEomCvlciAllwd2ModVlvLft7_C CoEng_stEomCvlciAllwd2ModVlvLft8_C CoEng_stEomCvlciAllwd2ModVlvLft9_C CoEng_stEomCvlciAllwd2Prio_T CoEng_stEomCvlciAllwd2Stg_T CoEng_stEomCvlciDmdModVlvLft0_C CoEng_stEomCvlciDmdModVlvLft1_C CoEng_stEomCvlciDmdModVlvLft2_C CoEng_stEomCvlciDmdModVlvLft3_C CoEng_stEomCvlciDmdModVlvLft4_C CoEng_stEomCvlciDmdModVlvLft5_C CoEng_stEomCvlciDmdModVlvLft6_C CoEng_stEomCvlciDmdModVlvLft7_C CoEng_stEomCvlciDmdModVlvLft8_C CoEng_stEomCvlciDmdModVlvLft9_C CoEng_stEomCvlciDmdPrio_T CoEng_stEomCvlciDmdStg_T CoEng_stExtVlvLftDmdDftCvlci_C CoEng_stMapInpSel_C CoEng_stMpgLimpVlvLftDmd_T CoEng_stMpgStdLftHwIntk_T CoEng_stShiftDlyCvlci_CA CoEng_stShiftDlyDftCvlci_C CoEng_stSpVlvLftIntkMax_C CoEng_stTrqDemMaskCvlci_C CoEng_stVlvLftDmdAppl1Cvlci_C CoEng_stVlvLftDmdAppl2Cvlci_C CoEng_stVlvLftStgyCvlci_CA CoEng_swtThdAirmCatHeatg_C CoEng_tEngVlvLftIntkHi_C CoEng_tEngVlvLftIntkLo_C CoEng_tExhVlvLftIntkHi_C CoEng_tExhVlvLftIntkLo_C CoEng_tiDlyFrzAftChgCvlci_M CoEng_tiNEngHiHysCvlci_C CoEng_tIntkAirMax_C CoEng_tiShiftOffsCvlci_C CoEng_tiSpChgAftStrt_C CoEng_tiSpdGrdFlt_C CoEng_tiVlvLftDmdAppl1Tog_C CoEng_tiVlvLftDmdAppl2Tog_C CoEng_VlvLftMapCvlci_I.stLoadNRngCvlci_M CoEng_VlvLftMapCvlci_I.stSpCvlci_M CoEng_vVehMinCvlciDeltaHys_C CoEng_vVehMinCvlci_C VLVLFT_SPINTK_ATS.LimitTypeMsk_C VLVLFT_SPINTK_ATS.CnvNorm_C VLVLFT_SPINTK_ATS.LowLim_C VLVLFT_SPINTK_ATS.UpLim_C VLVLFT_SPINTK_ATS.CnvFac_C VLVLFT_SPINTK_ATS.CnvOfs_C VLVLFT_SPINTK_ATS.DfltVal_C /end DEF_CHARACTERISTIC
 /begin REF_CHARACTERISTIC MDNORM /end REF_CHARACTERISTIC
 /begin IN_MEASUREMENT AirMod_ratChrgAirCyl B_fnsoff_msg B_fwloff_msg B_kh_msg B_ldsua_msg CEngDsT_t CoEng_nRstrt CoEng_stMai CoEng_tiStMai_a CoETS_trqInrDetMode DrvPrgSwt_bSprt Epm_dnEngAvgFlt Epm_nEng ExhMgT_facCatHeatgProgs ExhMod_tExhAryB1 frhol_w_msg FuPurg_flgReqVlvFullLftIntk GEVCtl_flgIntkVlvLftEna GEVCtl_flgStdLftHwIntk GlbDa_stTrqDem IntkAirT_tIntkMnfld rlsol_w_msg ThrVlv_flgSngSensErrB1 Tra_nPrdcInpN Tra_numGear VehV_v /end IN_MEASUREMENT
 /begin OUT_MEASUREMENT CoEng_EomCvlciAllwd1_I.stOperMod CoEng_EomCvlciAllwd1_I.stOperModPrio CoEng_EomCvlciAllwd1_I.stOperModStg CoEng_EomCvlciAllwd2_I.stOperMod CoEng_EomCvlciAllwd2_I.stOperModPrio CoEng_EomCvlciAllwd2_I.stOperModStg CoEng_EomCvlciDmd_I.stOperMod CoEng_EomCvlciDmd_I.stOperModPrio CoEng_EomCvlciDmd_I.stOperModStg CoEng_stSpVlvLftIntk /end OUT_MEASUREMENT
 /begin LOC_MEASUREMENT CoEng_dnEngFltLoc CoEng_fakCorrnAltiCvlciXVal CoEng_flgEngTempHi CoEng_flgErrCvlci CoEng_flgFrzSpVlvLftIntk CoEng_flgGearLoCvlci CoEng_flgGevCtlDisadCvlci CoEng_flgIntkAirTempHiCvlci CoEng_flgLimpCvlci CoEng_flgManVlvLftDmdCvlci CoEng_flgNEngHiCvlci CoEng_flgThrVlvPotiDfctCvlci CoEng_flgTrqDemCvlci CoEng_flgVehVMinCvlciHLD_I.hysterese CoEng_idxCaseActvCvlci CoEng_nEngCorrdCvlci CoEng_nEngDelta CoEng_nEngOffsCvlci CoEng_nEngShiftLimCvlci CoEng_ratEngLoad CoEng_ratEngLoadCorrdCvlci CoEng_stCaseCvlci CoEng_stExtVlvLftDmdCvlci CoEng_stMpgLimpVlvLftDmdXVal CoEng_stMpgStdLftHwIntkXVal CoEng_stShftDlyCvlci CoEng_stSpVlvLftIntkBefRels CoEng_stSpVlvLftIntkBefTstr CoEng_stSpVlvLftIntkLoc CoEng_stVlvLftDmdApplCvlci CoEng_stVlvLftStgyActvCvlci CoEng_tExhFldVlvLftIntk CoEng_tiShiftCvlci CoEng_tiVlvLftSpApplTog /end LOC_MEASUREMENT
 FUNCTION_VERSION "2.31.0_1.4.0" /end FUNCTION
/begin FUNCTION CoEOM_Co "100.18.0  Coordinator Engine Operating Modes"
 /begin DEF_CHARACTERISTIC CoEOM_DmdLstSort.CoEOM_ThdConsdrPrio_C CoEOM_EomInhbd_I.stOperModPrio_C CoEOM_EomInhbd_I.stOperModStg_C CoEOM_EomInhbd_I.stOperMod_C CoEOM_EomTest2_I.stOperModPrio_C CoEOM_EomTest2_I.stOperModStg_C CoEOM_EomTest2_I.stOperMod_C CoEOM_EOMTestSpl_C CoEOM_EomTest_I.stOperModPrio_C CoEOM_EomTest_I.stOperModStg_C CoEOM_EomTest_I.stOperMod_C CoEOM_flgEGSDCmnEnaParl_C CoEOM_flgSwtOnEomDmdCSERS_FT CoEOM_flgSwtOnEomDmdParlDiagPsbl_FT CoEOM_flgSwtOnEomDmd_FT CoEOM_idxEGSDCmnVirtDmd_C CoEOM_NegExclsnAlg.CoEOM_ThdHardInhbnPrio_C CoEOM_NegExclsnAlgParDiagPsbl.CoEOM_ThdHardInhbnPrio_C CoEOM_nrFlg2TypMpg_M CoEOM_OperMod2DftEOM_M CoEOM_stDftOperModPrio_C CoEOM_stPrioEomDmd_T CoEOM_stStatPrio_C CoEOM_stTestSplOperModPrio_C CoEOM_tiTogTest1_C CoEOM_tiTogTest2_C /end DEF_CHARACTERISTIC
 /begin REF_CHARACTERISTIC CoEOM_InbnMatModi_a /end REF_CHARACTERISTIC
 /begin IN_MEASUREMENT CoEng_EomCvlciAllwd1_I.stOperMod CoEng_EomCvlciAllwd1_I.stOperModPrio CoEng_EomCvlciAllwd1_I.stOperModStg CoEng_EomCvlciAllwd2_I.stOperMod CoEng_EomCvlciAllwd2_I.stOperModPrio CoEng_EomCvlciAllwd2_I.stOperModStg CoEng_EomCvlciDmd_I.stOperMod CoEng_EomCvlciDmd_I.stOperModPrio CoEng_EomCvlciDmd_I.stOperModStg CoEOM_stEomActvTmng EGSDCmn_flgVirtReqEomParl EngStrt_EomStrt_I.stOperMod EngStrt_EomStrt_I.stOperModPrio EngStrt_EomStrt_I.stOperModStg ExhMgT_flgCatHeatgCsers /end IN_MEASUREMENT
 /begin OUT_MEASUREMENT CoEOM_flgEGSDCmnVirtDmdActv CoEOM_flgEomActvInhb CoEOM_idxEomAct CoEOM_idxEomDmdSeld CoEOM_idxEomStgAct CoEOM_stDeadlck CoEOM_stEomDes CoEOM_stEOMDesNonCsers CoEOM_stEomDest CoEOM_typCoornCSERS_a CoEOM_typCoornParDiagPsbl_a CoEOM_typCoorn_a /end OUT_MEASUREMENT
 /begin LOC_MEASUREMENT CoEOM_EomDmdLstSortCSERS_I.idx_a CoEOM_EomDmdLstSortCSERS_I.nrPrio_a CoEOM_EomDmdLstSortCSERS_I.stEom_a CoEOM_EomDmdLstSortCSERS_I.stStg_a CoEOM_EomDmdLstSortCSERS_I.typDescr_a CoEOM_EomDmdLstSortParDiagPsbl_I.idx_a CoEOM_EomDmdLstSortParDiagPsbl_I.nrPrio_a CoEOM_EomDmdLstSortParDiagPsbl_I.stEom_a CoEOM_EomDmdLstSortParDiagPsbl_I.stStg_a CoEOM_EomDmdLstSortParDiagPsbl_I.typDescr_a CoEOM_EomDmdLstSort_I.idx_a CoEOM_EomDmdLstSort_I.nrPrio_a CoEOM_EomDmdLstSort_I.stEom_a CoEOM_EomDmdLstSort_I.stStg_a CoEOM_EomDmdLstSort_I.typDescr_a CoEOM_flgCsersActv CoEOM_flgTogValLoc CoEOM_idxEomDmdSeldLoc CoEOM_idxEomSeldLoc CoEOM_idxEomStgSeldLoc CoEOM_nrPrioSeldLoc CoEOM_stInhbnSeldLoc CoEOM_stOperModDft /end LOC_MEASUREMENT
 FUNCTION_VERSION "100.18.0" /end FUNCTION
/begin FUNCTION CoEOM_Conf "103.2.0_1.3.0Configuration CoEOM" /begin DEF_CHARACTERISTIC CoEOM_EomMtrx_M /end DEF_CHARACTERISTIC /begin IN_MEASUREMENT CoEOM_idxEomAct CoEOM_idxEomStgAct /end IN_MEASUREMENT FUNCTION_VERSION "103.2.0_1.3.0" /end FUNCTION
/begin FUNCTION CoEOM_Lcy2Vld "1.20.0    SW Adapter Coordinator Engine Operating Modes : Mapping Legacy to Valid Interface Elements" /begin IN_MEASUREMENT B_mwrlsta_msg /end IN_MEASUREMENT /begin OUT_MEASUREMENT CoEOM_flgRelAirStatyEomChg CoEOM_stTrigAckd /end OUT_MEASUREMENT FUNCTION_VERSION "1.20.0" /end FUNCTION
/begin FUNCTION CoEOM_OperModReq "100.18.0  Function for requesting Engine Operating Modes"
 /begin DEF_CHARACTERISTIC CoEOM_EomBas1Hys_I.idxSt_MAP CoEOM_EomBas2Hys_I.idxSt_MAP CoEOM_EomBasAllwdHys_I.idxSt_MAP CoEOM_nHysDeltaEomBasis_C CoEOM_ratEngLoadReqTest_C CoEOM_ratHysDelta_C CoEOM_stBasis3_C CoEOM_stEomAllwdPrio_C CoEOM_stEomAllwd_C CoEOM_stEomBasis1Prio_C CoEOM_stEomBasis2Prio_C CoEOM_stEomBasis3Prio_C CoEOM_stEomBasis_C CoEOM_stOperModInpSel_C /end DEF_CHARACTERISTIC
 /begin REF_CHARACTERISTIC MDNORM /end REF_CHARACTERISTIC
 /begin IN_MEASUREMENT CoETS_trqInrDetMode CoETS_trqInrDetModeFild Epm_nEng /end IN_MEASUREMENT
 /begin OUT_MEASUREMENT CoEOM_EomBasis1_I.stOperMod CoEOM_EomBasis1_I.stOperModPrio CoEOM_EomBasis1_I.stOperModStg CoEOM_EomBasis2_I.stOperMod CoEOM_EomBasis2_I.stOperModPrio CoEOM_EomBasis2_I.stOperModStg CoEOM_EomBasis3_I.stOperMod CoEOM_EomBasis3_I.stOperModPrio CoEOM_EomBasis3_I.stOperModStg CoEOM_EomBasisAllwd_I.stOperMod CoEOM_EomBasisAllwd_I.stOperModPrio CoEOM_EomBasisAllwd_I.stOperModStg CoEOM_percEngLoad /end OUT_MEASUREMENT
 /begin LOC_MEASUREMENT CoEng_facTq2Perc CoEOM_EomBas1Hys_I.idxDistbnXOld CoEOM_EomBas1Hys_I.idxDistbnYOld CoEOM_EomBas2Hys_I.idxDistbnXOld CoEOM_EomBas2Hys_I.idxDistbnYOld CoEOM_EomBasAllwdHys_I.idxDistbnXOld CoEOM_EomBasAllwdHys_I.idxDistbnYOld CoEOM_ratInpHyst CoEOM_stEomBasis1 CoEOM_stEomBasis2 CoEOM_stEomBasisAllwd /end LOC_MEASUREMENT
 FUNCTION_VERSION "100.18.0" /end FUNCTION
/begin FUNCTION CoEOM_Srv "1.12.0    Services and Library elements for the new EOM structure" /begin REF_CHARACTERISTIC CoEOM_stEomDesReqd_AX /end REF_CHARACTERISTIC FUNCTION_VERSION "1.12.0" /end FUNCTION
/begin COMPU_METHOD B_TRUE "" TAB_VERB "%6.3" "" COMPU_TAB_REF B_TRUE /end COMPU_METHOD
/begin COMPU_VTAB B_TRUE "" TAB_VERB 2 0 "FALSE" 1 "TRUE" /end COMPU_VTAB
/begin COMPU_METHOD CoEng_CaseCvlci_COMPU_VERB "" TAB_VERB "%6.3" "" COMPU_TAB_REF CoEng_CaseCvlci_COMPU_VERB /end COMPU_METHOD
/begin COMPU_VTAB CoEng_CaseCvlci_COMPU_VERB "" TAB_VERB 30 1 "FId_CoEngVlvLftSpIntk" 2 "LimpHome" 3 "VlvLftDisad" 4 "EngStrtCold" 5 "EngSpdHi" 6 "EngStop" 7 "CmshftAdpn" 8 "OperMode" 9 "Scavenging" 10 "ExhTempHi" 11 "EngTempHi" 12 "WarmUp" 13 "CatHeat" 14 "SportMode" 15 "EcoMode" 16 "EngFuelCutOff" 17 "VehSpdLo" 18 "n/a" 19 "FuelPurge" 20 "TrqDem" 21 "EngStrt" 255 "Unused" 22 "EngOff" 23 "ManVlvLft" 24 "GearLo" 25 "IntkAirTempHi" 26 "GearShiftActv" 27 "GpfRgn" 28 "ThrVlvPotiDfct" 29 "NVH" /end COMPU_VTAB
/begin COMPU_METHOD CoEng_EngOnDmd_VERB "" TAB_VERB "%6.3" "" COMPU_TAB_REF CoEng_EngOnDmd_VERB /end COMPU_METHOD
/begin COMPU_VTAB CoEng_EngOnDmd_VERB "" TAB_VERB 37 0 "OpMode" 1 "TcT" 2 "EngT" 3 "BrkBst" 4 "EngRunTi" 5 "SCR" 6 "EnvP" 7 "ExhT" 8 "SysErr" 9 "HFMCmp" 10 "FuT" 11 "LSU" 12 "PFlt" 13 "CustReq" 14 "AirSys" 15 "HEV" 16 "CatHeatgActv" 17 "CatHeatgDmd" 18 "TqAdpn" 19 "FuMixAdpn" 20 "FuPurgLoad" 21 "FuPurgDiag" 22 "SecAirSysDiag" 23 "FuAged" 24 "EthRatUkwn" 25 "SecFuAdpn" 26 "EvapOil" 27 "NSCDiag" 28 "OscMeas" 29 "BadStrt" 30 "HotStrt" 31 "Dummy" 32 "Camsft" 33 "HalfEngMod" 34 "NSC" 35 "AirT" 36 "NoUrgentDemand" /end COMPU_VTAB
/begin COMPU_METHOD CoEng_EngWpCvlci_COMPU_VERB "" TAB_VERB "%6.3" "" COMPU_TAB_REF CoEng_EngWpCvlci_COMPU_VERB /end COMPU_METHOD
/begin COMPU_VTAB CoEng_EngWpCvlci_COMPU_VERB "" TAB_VERB 21 0 "Rng_0" 1 "Rng_1" 2 "Rng_2" 3 "Rng_3" 4 "Rng_4" 5 "Rng_5" 6 "Rng_6" 7 "Rng_7" 8 "Rng_8" 9 "Rng_9" 10 "Rng_10" 11 "Rng_11" 12 "Rng_12" 13 "Rng_13" 14 "Rng_14" 15 "Rng_15" 16 "Rng_16" 17 "Rng_17" 18 "Rng_18" 19 "Rng_19" 20 "Rng_20" /end COMPU_VTAB
/begin COMPU_METHOD CoEng_PID1F_States_COMPU_VERB "" TAB_VERB "%6.3" "" COMPU_TAB_REF CoEng_PID1F_States_COMPU_VERB /end COMPU_METHOD
/begin COMPU_VTAB CoEng_PID1F_States_COMPU_VERB "" TAB_VERB 5 0 "PID1F_ST_INIT" 1 "PID1F_ST_READY" 2 "PID1F_ST_WAITING" 3 "PID1F_ST_COUNTING" 4 "PID1F_ST_END" /end COMPU_VTAB
/begin COMPU_METHOD CoEng_ShiftDlyCvlci_COMPU_VERB "" TAB_VERB "%6.3" "" COMPU_TAB_REF CoEng_ShiftDlyCvlci_COMPU_VERB /end COMPU_METHOD
/begin COMPU_VTAB CoEng_ShiftDlyCvlci_COMPU_VERB "" TAB_VERB 2 0 "NoShiftDly" 1 "ShiftDly" /end COMPU_VTAB
/begin COMPU_METHOD CoEng_stMai_VERB "" TAB_VERB "%6.3" "" COMPU_TAB_REF CoEng_stMai_VERB /end COMPU_METHOD
/begin COMPU_VTAB CoEng_stMai_VERB "" TAB_VERB 7 0 "COENG_ST_STANDBY" 4 "COENG_ST_READY" 16 "COENG_ST_STARTING" 64 "COENG_ST_AUTOSTOPPING" 1024 "COENG_ST_RUNNING" 4096 "COENG_ST_STOPPING" 16384 "COENG_ST_FINISH" /end COMPU_VTAB
/begin COMPU_METHOD CoEng_st_COMPU_VERB "" TAB_VERB "%6.3" "" COMPU_TAB_REF CoEng_st_COMPU_VERB /end COMPU_METHOD
/begin COMPU_VTAB CoEng_st_COMPU_VERB "" TAB_VERB 6 0 "COENG_STANDBY" 1 "COENG_READY" 2 "COENG_CRANKING" 3 "COENG_RUNNING" 4 "COENG_STOPPING" 5 "COENG_FINISH" /end COMPU_VTAB
/begin COMPU_METHOD CoEng_tiScneEngStrtStM_sm_VERB "" TAB_VERB "%6.3" "" COMPU_TAB_REF CoEng_tiScneEngStrtStM_sm_VERB /end COMPU_METHOD
/begin COMPU_VTAB CoEng_tiScneEngStrtStM_sm_VERB "" TAB_VERB 5 0 "PID1F_INIT" 1 "PID1F_COUNTING" 2 "PID1F_END" 3 "PID1F_READY" 4 "PID1F_WAITING" /end COMPU_VTAB
/begin COMPU_METHOD CoEng_VlvLftStgyCvlci_COMPU_VERB "" TAB_VERB "%6.3" "" COMPU_TAB_REF CoEng_VlvLftStgyCvlci_COMPU_VERB /end COMPU_METHOD
/begin COMPU_VTAB CoEng_VlvLftStgyCvlci_COMPU_VERB "" TAB_VERB 27 100 "MapStgy_0" 101 "MapStgy_1" 102 "MapStgy_2" 103 "MapStgy_3" 104 "MapStgy_4" 105 "MapStgy_5" 106 "MapStgy_6" 107 "MapStgy_7" 108 "MapStgy_8" 109 "MapStgy_9" 110 "MapStgy_10" 111 "MapStgy_11" 112 "MapStgy_12" 113 "MapStgy_13" 114 "MapStgy_14" 0 "FixLft_0" 1 "FixLft_1" 2 "FixLft_2" 3 "FixLft_3" 4 "FixLft_4" 5 "FixLft_5" 6 "FixLft_6" 7 "FixLft_7" 8 "FixLft_8" 9 "FixLft_9" 254 "ExtDmd" 255 "NoShift" /end COMPU_VTAB
/begin COMPU_METHOD CoEng_VlvLftStgyFixCvlci_COMPU_VERB "" TAB_VERB "%6.3" "" COMPU_TAB_REF CoEng_VlvLftStgyFixCvlci_COMPU_VERB /end COMPU_METHOD
/begin COMPU_VTAB CoEng_VlvLftStgyFixCvlci_COMPU_VERB "" TAB_VERB 11 0 "FixLft_0" 1 "FixLft_1" 2 "FixLft_2" 3 "FixLft_3" 4 "FixLft_4" 5 "FixLft_5" 6 "FixLft_6" 7 "FixLft_7" 8 "FixLft_8" 9 "FixLft_9" 255 "NoShift" /end COMPU_VTAB
/begin COMPU_METHOD CoEng_VlvLftStgyMapCvlci_COMPU_VERB "" TAB_VERB "%6.3" "" COMPU_TAB_REF CoEng_VlvLftStgyMapCvlci_COMPU_VERB /end COMPU_METHOD
/begin COMPU_VTAB CoEng_VlvLftStgyMapCvlci_COMPU_VERB "" TAB_VERB 15 100 "MapStgy_0" 101 "MapStgy_1" 102 "MapStgy_2" 103 "MapStgy_3" 104 "MapStgy_4" 105 "MapStgy_5" 106 "MapStgy_6" 107 "MapStgy_7" 108 "MapStgy_8" 109 "MapStgy_9" 110 "MapStgy_10" 111 "MapStgy_11" 112 "MapStgy_12" 113 "MapStgy_13" 114 "MapStgy_14" /end COMPU_VTAB
/begin COMPU_METHOD CoEOM_idxOperModCfgd_VERB "" TAB_VERB "%6.3" "-" COMPU_TAB_REF CoEOM_idxOperModCfgd_VERB /end COMPU_METHOD
/begin COMPU_VTAB CoEOM_idxOperModCfgd_VERB "" TAB_VERB 4 0 "Base" 1 "WarmUp" 2 "CatHtg" 3 "Start" /end COMPU_VTAB
/begin COMPU_METHOD CoEOM_idxOperModStgTot_VERB "" TAB_VERB "%6.3" "-" COMPU_TAB_REF CoEOM_idxOperModStgTot_VERB /end COMPU_METHOD
/begin COMPU_VTAB CoEOM_idxOperModStgTot_VERB "" TAB_VERB 16 0 "HOM_FullLft" 1 "Stage 1" 2 "Stage 2" 3 "Stage 3" 4 "HOM_EIVC" 5 "Stage 5" 6 "Stage 6" 7 "Stage 7" 8 "Stage 8" 9 "Stage 9" 10 "Stage 10" 11 "Stage 11" 12 "Stage 12" 13 "Stage 13" 14 "Stage 14" 15 "Stage 15" /end COMPU_VTAB
/begin COMPU_METHOD CoEOM_idxOperModTot_VERB "" TAB_VERB "%6.3" "-" COMPU_TAB_REF CoEOM_idxOperModTot_VERB /end COMPU_METHOD
/begin COMPU_VTAB CoEOM_idxOperModTot_VERB "" TAB_VERB 32 0 "Base" 1 "WarmUp" 2 "CatHtg" 3 "Start" 4 "n/a (4)" 5 "n/a (5)" 6 "n/a (6)" 7 "n/a (7)" 8 "n/a (8)" 9 "n/a (9)" 10 "n/a (10)" 11 "n/a (11)" 12 "n/a (12)" 13 "n/a (13)" 14 "n/a (14)" 15 "n/a (15)" 16 "n/a (16)" 17 "n/a (17)" 18 "n/a (18)" 19 "n/a (19)" 20 "n/a (20)" 21 "n/a (21)" 22 "n/a (22)" 23 "n/a (23)" 24 "n/a (24)" 25 "n/a (25)" 26 "n/a (26)" 27 "n/a (27)" 28 "n/a (28)" 29 "n/a (29)" 30 "n/a (30)" 31 "n/a (31)" /end COMPU_VTAB
/begin COMPU_METHOD CoEOM_OperMod_Set_COMPU_VERB "" TAB_VERB "%6.3" "-" COMPU_TAB_REF CoEOM_OperMod_Set_COMPU_VERB /end COMPU_METHOD
/begin COMPU_VTAB CoEOM_OperMod_Set_COMPU_VERB "" TAB_VERB 8 0 "CoEOM_EomDft_I" 1 "CoEng_EomCvlciDmd_I" 2 "CoEng_EomCvlciAllwd2_I" 3 "CoEng_EomCvlciAllwd1_I" 4 "CoEOM_EomTestSpl_I" 5 "CoEOM_EomTest_I" 6 "EngStrt_EomStrt_I" 7 "CoEOM_EomInhbd_I" /end COMPU_VTAB
/begin COMPU_METHOD CoEOM_stEomStgCfgdExtn_VERB "" TAB_VERB "%6.3" "-" COMPU_TAB_REF CoEOM_stEomStgCfgdExtn_VERB /end COMPU_METHOD
/begin COMPU_VTAB CoEOM_stEomStgCfgdExtn_VERB "" TAB_VERB 5 0 "Base_HOM_FullLft" 4 "Base_HOM_EIVC" 255 "No_Demand" 768 "Start_FullLft" 772 "Start_EIVC" /end COMPU_VTAB
/begin COMPU_METHOD CoEOM_stEomStgCfgd_VERB "" TAB_VERB "%6.3" "-" COMPU_TAB_REF CoEOM_stEomStgCfgd_VERB /end COMPU_METHOD
/begin COMPU_VTAB CoEOM_stEomStgCfgd_VERB "" TAB_VERB 4 0 "Base_HOM_FullLft" 4 "Base_HOM_EIVC" 768 "Start_FullLft" 772 "Start_EIVC" /end COMPU_VTAB
/begin COMPU_METHOD CoEOM_stEomStgTot_VERB "" TAB_VERB "%6.3" "-" COMPU_TAB_REF CoEOM_stEomStgTot_VERB /end COMPU_METHOD
/begin COMPU_VTAB CoEOM_stEomStgTot_VERB "" TAB_VERB 513 0 "Base_HOM_FullLft" 1 "n/a [00;01]" 2 "n/a [00;02]" 3 "n/a [00;03]" 4 "Base_HOM_EIVC" 5 "n/a [00;05]" 6 "n/a [00;06]" 7 "n/a [00;07]" 8 "n/a [00;08]" 9 "n/a [00;09]" 10 "n/a [00;10]" 11 "n/a [00;11]" 12 "n/a [00;12]" 13 "n/a [00;13]" 14 "n/a [00;14]" 15 "n/a [00;15]" 255 "No_Demand" 256 "n/a [01;00]" 257 "n/a [01;01]" 258 "n/a [01;02]" 259 "n/a [01;03]" 260 "n/a [01;04]" 261 "n/a [01;05]" 262 "n/a [01;06]" 263 "n/a [01;07]" 264 "n/a [01;08]" 265 "n/a [01;09]" 266 "n/a [01;10]" 267 "n/a [01;11]" 268 "n/a [01;12]" 269 "n/a [01;13]" 270 "n/a [01;14]" 271 "n/a [01;15]" 512 "n/a [02;00]" 513 "n/a [02;01]" 514 "n/a [02;02]" 515 "n/a [02;03]" 516 "n/a [02;04]" 517 "n/a [02;05]" 518 "n/a [02;06]" 519 "n/a [02;07]" 520 "n/a [02;08]" 521 "n/a [02;09]" 522 "n/a [02;10]" 523 "n/a [02;11]" 524 "n/a [02;12]" 525 "n/a [02;13]" 526 "n/a [02;14]" 527 "n/a [02;15]" 768 "Start_FullLft" 769 "n/a [03;01]" 770 "n/a [03;02]" 771 "n/a [03;03]" 772 "Start_EIVC" 773 "n/a [03;05]" 774 "n/a [03;06]" 775 "n/a [03;07]" 776 "n/a [03;08]" 777 "n/a [03;09]" 778 "n/a [03;10]" 779 "n/a [03;11]" 780 "n/a [03;12]" 781 "n/a [03;13]" 782 "n/a [03;14]" 783 "n/a [03;15]" 1024 "n/a [04;00]" 1025 "n/a [04;01]" 1026 "n/a [04;02]" 1027 "n/a [04;03]" 1028 "n/a [04;04]" 1029 "n/a [04;05]" 1030 "n/a [04;06]" 1031 "n/a [04;07]" 1032 "n/a [04;08]" 1033 "n/a [04;09]" 1034 "n/a [04;10]" 1035 "n/a [04;11]" 1036 "n/a [04;12]" 1037 "n/a [04;13]" 1038 "n/a [04;14]" 1039 "n/a [04;15]" 1280 "n/a [05;00]" 1281 "n/a [05;01]" 1282 "n/a [05;02]" 1283 "n/a [05;03]" 1284 "n/a [05;04]" 1285 "n/a [05;05]" 1286 "n/a [05;06]" 1287 "n/a [05;07]" 1288 "n/a [05;08]" 1289 "n/a [05;09]" 1290 "n/a [05;10]" 1291 "n/a [05;11]" 1292 "n/a [05;12]" 1293 "n/a [05;13]" 1294 "n/a [05;14]" 1295 "n/a [05;15]" 1536 "n/a [06;00]" 1537 "n/a [06;01]" 1538 "n/a [06;02]" 1539 "n/a [06;03]" 1540 "n/a [06;04]" 1541 "n/a [06;05]" 1542 "n/a [06;06]" 1543 "n/a [06;07]" 1544 "n/a [06;08]" 1545 "n/a [06;09]" 1546 "n/a [06;10]" 1547 "n/a [06;11]" 1548 "n/a [06;12]" 1549 "n/a [06;13]" 1550 "n/a [06;14]" 1551 "n/a [06;15]" 1792 "n/a [07;00]" 1793 "n/a [07;01]" 1794 "n/a [07;02]" 1795 "n/a [07;03]" 1796 "n/a [07;04]" 1797 "n/a [07;05]" 1798 "n/a [07;06]" 1799 "n/a [07;07]" 1800 "n/a [07;08]" 1801 "n/a [07;09]" 1802 "n/a [07;10]" 1803 "n/a [07;11]" 1804 "n/a [07;12]" 1805 "n/a [07;13]" 1806 "n/a [07;14]" 1807 "n/a [07;15]" 2048 "n/a [08;00]" 2049 "n/a [08;01]" 2050 "n/a [08;02]" 2051 "n/a [08;03]" 2052 "n/a [08;04]" 2053 "n/a [08;05]" 2054 "n/a [08;06]" 2055 "n/a [08;07]" 2056 "n/a [08;08]" 2057 "n/a [08;09]" 2058 "n/a [08;10]" 2059 "n/a [08;11]" 2060 "n/a [08;12]" 2061 "n/a [08;13]" 2062 "n/a [08;14]" 2063 "n/a [08;15]" 2304 "n/a [09;00]" 2305 "n/a [09;01]" 2306 "n/a [09;02]" 2307 "n/a [09;03]" 2308 "n/a [09;04]" 2309 "n/a [09;05]" 2310 "n/a [09;06]" 2311 "n/a [09;07]" 2312 "n/a [09;08]" 2313 "n/a [09;09]" 2314 "n/a [09;10]" 2315 "n/a [09;11]" 2316 "n/a [09;12]" 2317 "n/a [09;13]" 2318 "n/a [09;14]" 2319 "n/a [09;15]" 2560 "n/a [10;00]" 2561 "n/a [10;01]" 2562 "n/a [10;02]" 2563 "n/a [10;03]" 2564 "n/a [10;04]" 2565 "n/a [10;05]" 2566 "n/a [10;06]" 2567 "n/a [10;07]" 2568 "n/a [10;08]" 2569 "n/a [10;09]" 2570 "n/a [10;10]" 2571 "n/a [10;11]" 2572 "n/a [10;12]" 2573 "n/a [10;13]" 2574 "n/a [10;14]" 2575 "n/a [10;15]" 2816 "n/a [11;00]" 2817 "n/a [11;01]" 2818 "n/a [11;02]" 2819 "n/a [11;03]" 2820 "n/a [11;04]" 2821 "n/a [11;05]" 2822 "n/a [11;06]" 2823 "n/a [11;07]" 2824 "n/a [11;08]" 2825 "n/a [11;09]" 2826 "n/a [11;10]" 2827 "n/a [11;11]" 2828 "n/a [11;12]" 2829 "n/a [11;13]" 2830 "n/a [11;14]" 2831 "n/a [11;15]" 3072 "n/a [12;00]" 3073 "n/a [12;01]" 3074 "n/a [12;02]" 3075 "n/a [12;03]" 3076 "n/a [12;04]" 3077 "n/a [12;05]" 3078 "n/a [12;06]" 3079 "n/a [12;07]" 3080 "n/a [12;08]" 3081 "n/a [12;09]" 3082 "n/a [12;10]" 3083 "n/a [12;11]" 3084 "n/a [12;12]" 3085 "n/a [12;13]" 3086 "n/a [12;14]" 3087 "n/a [12;15]" 3328 "n/a [13;00]" 3329 "n/a [13;01]" 3330 "n/a [13;02]" 3331 "n/a [13;03]" 3332 "n/a [13;04]" 3333 "n/a [13;05]" 3334 "n/a [13;06]" 3335 "n/a [13;07]" 3336 "n/a [13;08]" 3337 "n/a [13;09]" 3338 "n/a [13;10]" 3339 "n/a [13;11]" 3340 "n/a [13;12]" 3341 "n/a [13;13]" 3342 "n/a [13;14]" 3343 "n/a [13;15]" 3584 "n/a [14;00]" 3585 "n/a [14;01]" 3586 "n/a [14;02]" 3587 "n/a [14;03]" 3588 "n/a [14;04]" 3589 "n/a [14;05]" 3590 "n/a [14;06]" 3591 "n/a [14;07]" 3592 "n/a [14;08]" 3593 "n/a [14;09]" 3594 "n/a [14;10]" 3595 "n/a [14;11]" 3596 "n/a [14;12]" 3597 "n/a [14;13]" 3598 "n/a [14;14]" 3599 "n/a [14;15]" 3840 "n/a [15;00]" 3841 "n/a [15;01]" 3842 "n/a [15;02]" 3843 "n/a [15;03]" 3844 "n/a [15;04]" 3845 "n/a [15;05]" 3846 "n/a [15;06]" 3847 "n/a [15;07]" 3848 "n/a [15;08]" 3849 "n/a [15;09]" 3850 "n/a [15;10]" 3851 "n/a [15;11]" 3852 "n/a [15;12]" 3853 "n/a [15;13]" 3854 "n/a [15;14]" 3855 "n/a [15;15]" 4096 "n/a [16;00]" 4097 "n/a [16;01]" 4098 "n/a [16;02]" 4099 "n/a [16;03]" 4100 "n/a [16;04]" 4101 "n/a [16;05]" 4102 "n/a [16;06]" 4103 "n/a [16;07]" 4104 "n/a [16;08]" 4105 "n/a [16;09]" 4106 "n/a [16;10]" 4107 "n/a [16;11]" 4108 "n/a [16;12]" 4109 "n/a [16;13]" 4110 "n/a [16;14]" 4111 "n/a [16;15]" 4352 "n/a [17;00]" 4353 "n/a [17;01]" 4354 "n/a [17;02]" 4355 "n/a [17;03]" 4356 "n/a [17;04]" 4357 "n/a [17;05]" 4358 "n/a [17;06]" 4359 "n/a [17;07]" 4360 "n/a [17;08]" 4361 "n/a [17;09]" 4362 "n/a [17;10]" 4363 "n/a [17;11]" 4364 "n/a [17;12]" 4365 "n/a [17;13]" 4366 "n/a [17;14]" 4367 "n/a [17;15]" 4608 "n/a [18;00]" 4609 "n/a [18;01]" 4610 "n/a [18;02]" 4611 "n/a [18;03]" 4612 "n/a [18;04]" 4613 "n/a [18;05]" 4614 "n/a [18;06]" 4615 "n/a [18;07]" 4616 "n/a [18;08]" 4617 "n/a [18;09]" 4618 "n/a [18;10]" 4619 "n/a [18;11]" 4620 "n/a [18;12]" 4621 "n/a [18;13]" 4622 "n/a [18;14]" 4623 "n/a [18;15]" 4864 "n/a [19;00]" 4865 "n/a [19;01]" 4866 "n/a [19;02]" 4867 "n/a [19;03]" 4868 "n/a [19;04]" 4869 "n/a [19;05]" 4870 "n/a [19;06]" 4871 "n/a [19;07]" 4872 "n/a [19;08]" 4873 "n/a [19;09]" 4874 "n/a [19;10]" 4875 "n/a [19;11]" 4876 "n/a [19;12]" 4877 "n/a [19;13]" 4878 "n/a [19;14]" 4879 "n/a [19;15]" 5120 "n/a [20;00]" 5121 "n/a [20;01]" 5122 "n/a [20;02]" 5123 "n/a [20;03]" 5124 "n/a [20;04]" 5125 "n/a [20;05]" 5126 "n/a [20;06]" 5127 "n/a [20;07]" 5128 "n/a [20;08]" 5129 "n/a [20;09]" 5130 "n/a [20;10]" 5131 "n/a [20;11]" 5132 "n/a [20;12]" 5133 "n/a [20;13]" 5134 "n/a [20;14]" 5135 "n/a [20;15]" 5376 "n/a [21;00]" 5377 "n/a [21;01]" 5378 "n/a [21;02]" 5379 "n/a [21;03]" 5380 "n/a [21;04]" 5381 "n/a [21;05]" 5382 "n/a [21;06]" 5383 "n/a [21;07]" 5384 "n/a [21;08]" 5385 "n/a [21;09]" 5386 "n/a [21;10]" 5387 "n/a [21;11]" 5388 "n/a [21;12]" 5389 "n/a [21;13]" 5390 "n/a [21;14]" 5391 "n/a [21;15]" 5632 "n/a [22;00]" 5633 "n/a [22;01]" 5634 "n/a [22;02]" 5635 "n/a [22;03]" 5636 "n/a [22;04]" 5637 "n/a [22;05]" 5638 "n/a [22;06]" 5639 "n/a [22;07]" 5640 "n/a [22;08]" 5641 "n/a [22;09]" 5642 "n/a [22;10]" 5643 "n/a [22;11]" 5644 "n/a [22;12]" 5645 "n/a [22;13]" 5646 "n/a [22;14]" 5647 "n/a [22;15]" 5888 "n/a [23;00]" 5889 "n/a [23;01]" 5890 "n/a [23;02]" 5891 "n/a [23;03]" 5892 "n/a [23;04]" 5893 "n/a [23;05]" 5894 "n/a [23;06]" 5895 "n/a [23;07]" 5896 "n/a [23;08]" 5897 "n/a [23;09]" 5898 "n/a [23;10]" 5899 "n/a [23;11]" 5900 "n/a [23;12]" 5901 "n/a [23;13]" 5902 "n/a [23;14]" 5903 "n/a [23;15]" 6144 "n/a [24;00]" 6145 "n/a [24;01]" 6146 "n/a [24;02]" 6147 "n/a [24;03]" 6148 "n/a [24;04]" 6149 "n/a [24;05]" 6150 "n/a [24;06]" 6151 "n/a [24;07]" 6152 "n/a [24;08]" 6153 "n/a [24;09]" 6154 "n/a [24;10]" 6155 "n/a [24;11]" 6156 "n/a [24;12]" 6157 "n/a [24;13]" 6158 "n/a [24;14]" 6159 "n/a [24;15]" 6400 "n/a [25;00]" 6401 "n/a [25;01]" 6402 "n/a [25;02]" 6403 "n/a [25;03]" 6404 "n/a [25;04]" 6405 "n/a [25;05]" 6406 "n/a [25;06]" 6407 "n/a [25;07]" 6408 "n/a [25;08]" 6409 "n/a [25;09]" 6410 "n/a [25;10]" 6411 "n/a [25;11]" 6412 "n/a [25;12]" 6413 "n/a [25;13]" 6414 "n/a [25;14]" 6415 "n/a [25;15]" 6656 "n/a [26;00]" 6657 "n/a [26;01]" 6658 "n/a [26;02]" 6659 "n/a [26;03]" 6660 "n/a [26;04]" 6661 "n/a [26;05]" 6662 "n/a [26;06]" 6663 "n/a [26;07]" 6664 "n/a [26;08]" 6665 "n/a [26;09]" 6666 "n/a [26;10]" 6667 "n/a [26;11]" 6668 "n/a [26;12]" 6669 "n/a [26;13]" 6670 "n/a [26;14]" 6671 "n/a [26;15]" 6912 "n/a [27;00]" 6913 "n/a [27;01]" 6914 "n/a [27;02]" 6915 "n/a [27;03]" 6916 "n/a [27;04]" 6917 "n/a [27;05]" 6918 "n/a [27;06]" 6919 "n/a [27;07]" 6920 "n/a [27;08]" 6921 "n/a [27;09]" 6922 "n/a [27;10]" 6923 "n/a [27;11]" 6924 "n/a [27;12]" 6925 "n/a [27;13]" 6926 "n/a [27;14]" 6927 "n/a [27;15]" 7168 "n/a [28;00]" 7169 "n/a [28;01]" 7170 "n/a [28;02]" 7171 "n/a [28;03]" 7172 "n/a [28;04]" 7173 "n/a [28;05]" 7174 "n/a [28;06]" 7175 "n/a [28;07]" 7176 "n/a [28;08]" 7177 "n/a [28;09]" 7178 "n/a [28;10]" 7179 "n/a [28;11]" 7180 "n/a [28;12]" 7181 "n/a [28;13]" 7182 "n/a [28;14]" 7183 "n/a [28;15]" 7424 "n/a [29;00]" 7425 "n/a [29;01]" 7426 "n/a [29;02]" 7427 "n/a [29;03]" 7428 "n/a [29;04]" 7429 "n/a [29;05]" 7430 "n/a [29;06]" 7431 "n/a [29;07]" 7432 "n/a [29;08]" 7433 "n/a [29;09]" 7434 "n/a [29;10]" 7435 "n/a [29;11]" 7436 "n/a [29;12]" 7437 "n/a [29;13]" 7438 "n/a [29;14]" 7439 "n/a [29;15]" 7680 "n/a [30;00]" 7681 "n/a [30;01]" 7682 "n/a [30;02]" 7683 "n/a [30;03]" 7684 "n/a [30;04]" 7685 "n/a [30;05]" 7686 "n/a [30;06]" 7687 "n/a [30;07]" 7688 "n/a [30;08]" 7689 "n/a [30;09]" 7690 "n/a [30;10]" 7691 "n/a [30;11]" 7692 "n/a [30;12]" 7693 "n/a [30;13]" 7694 "n/a [30;14]" 7695 "n/a [30;15]" 7936 "n/a [31;00]" 7937 "n/a [31;01]" 7938 "n/a [31;02]" 7939 "n/a [31;03]" 7940 "n/a [31;04]" 7941 "n/a [31;05]" 7942 "n/a [31;06]" 7943 "n/a [31;07]" 7944 "n/a [31;08]" 7945 "n/a [31;09]" 7946 "n/a [31;10]" 7947 "n/a [31;11]" 7948 "n/a [31;12]" 7949 "n/a [31;13]" 7950 "n/a [31;14]" 7951 "n/a [31;15]" /end COMPU_VTAB
/begin COMPU_METHOD CoEOM_TypCoorn_VERB "" TAB_VERB "%6.3" "" COMPU_TAB_REF CoEOM_TypCoorn_VERB /end COMPU_METHOD
/begin COMPU_VTAB CoEOM_TypCoorn_VERB "" TAB_VERB 6 0 "UNUSED" 1 "HARD_INHBN_CONSDR" 2 "WEAK_INHBN_IGNORED" 3 "WEAK_INHBN_CONSDR" 4 "DMD_CONSDR" 5 "DMD_NOT_POSSIBLE" /end COMPU_VTAB
/begin COMPU_METHOD CoEOM_TypDescr_VERB "" TAB_VERB "%6.3" "" COMPU_TAB_REF CoEOM_TypDescr_VERB /end COMPU_METHOD
/begin COMPU_VTAB CoEOM_TypDescr_VERB "" TAB_VERB 8 0 "NO_REQ" 15 "INACTV_CAL" 16 "COMPL_INHIBIT" 17 "PART_INHIBIT" 18 "COMPL_ROW_INHIBIT" 32 "SINGLE_DEMAND" 33 "MULT_DEMAND" 48 "INVALID" /end COMPU_VTAB
/begin COMPU_METHOD DELIB_ENGDATENG_TYPAVL_SC_Compu "" TAB_VERB "%6.3" "" COMPU_TAB_REF DELIB_ENGDATENG_TYPAVL_SC_Compu /end COMPU_METHOD
/begin COMPU_VTAB DELIB_ENGDATENG_TYPAVL_SC_Compu "" TAB_VERB 2 0 "False" 1 "True" /end COMPU_VTAB
/begin COMPU_METHOD DELIB_FACPRECTLDWNTEMPCORRSIZECUR_SC_Compu "" RAT_FUNC "%6.2" "" COEFFS 0 1 0 0 0 1 /end COMPU_METHOD
/begin COMPU_METHOD DELIB_FACPRECTLUPTEMPCORRSIZECUR_SC_Compu "" RAT_FUNC "%6.2" "" COEFFS 0 1 0 0 0 1 /end COMPU_METHOD
/begin COMPU_METHOD DELIB_FACTQLOSSCMPSIZECUR_SC_Compu "" RAT_FUNC "%6.2" "" COEFFS 0 1 0 0 0 1 /end COMPU_METHOD
/begin COMPU_METHOD DELIB_HVDDC_TYPAVL_SC_Compu "" TAB_VERB "%6.3" "" COMPU_TAB_REF DELIB_HVDDC_TYPAVL_SC_Compu /end COMPU_METHOD
/begin COMPU_VTAB DELIB_HVDDC_TYPAVL_SC_Compu "" TAB_VERB 2 0 "False" 1 "True" /end COMPU_VTAB
/begin COMPU_METHOD DELIB_MDLEXHSNSRAVL_SC_Compu "" TAB_VERB "%6.3" "" COMPU_TAB_REF DELIB_MDLEXHSNSRAVL_SC_Compu /end COMPU_METHOD
/begin COMPU_VTAB DELIB_MDLEXHSNSRAVL_SC_Compu "" TAB_VERB 2 0 "False" 1 "True" /end COMPU_VTAB
/begin COMPU_METHOD DELIB_PMINLRNSIZECUR_SC_Compu "" RAT_FUNC "%6.2" "" COEFFS 0 1 0 0 0 1 /end COMPU_METHOD
/begin COMPU_METHOD DELIB_RACTRLIM2SIZECUR_SC_Compu "" RAT_FUNC "%6.2" "" COEFFS 0 1 0 0 0 1 /end COMPU_METHOD
/begin COMPU_METHOD DELIB_RACTRLIMSIZECUR_SC_Compu "" RAT_FUNC "%6.2" "" COEFFS 0 1 0 0 0 1 /end COMPU_METHOD
/begin COMPU_METHOD DELIB_RDIAVALMINSIZECUR_SC_Compu "" RAT_FUNC "%6.2" "" COEFFS 0 1 0 0 0 1 /end COMPU_METHOD
/begin COMPU_METHOD DELIB_RPRECTLDWNMAINMAPSIZEX_SC_Compu "" RAT_FUNC "%6.2" "" COEFFS 0 1 0 0 0 1 /end COMPU_METHOD
/begin COMPU_METHOD DELIB_RPRECTLDWNMAINMAPSIZEY_SC_Compu "" RAT_FUNC "%6.2" "" COEFFS 0 1 0 0 0 1 /end COMPU_METHOD
/begin COMPU_METHOD DELIB_RPRECTLDWNMAPSIZEX_SC_Compu "" RAT_FUNC "%6.2" "" COEFFS 0 1 0 0 0 1 /end COMPU_METHOD
/begin COMPU_METHOD DELIB_RPRECTLDWNMAPSIZEY_SC_Compu "" RAT_FUNC "%6.2" "" COEFFS 0 1 0 0 0 1 /end COMPU_METHOD
/begin COMPU_METHOD DELIB_RPRECTLUPMAINMAPSIZEX_SC_Compu "" RAT_FUNC "%6.2" "" COEFFS 0 1 0 0 0 1 /end COMPU_METHOD
/begin COMPU_METHOD DELIB_RPRECTLUPMAINMAPSIZEY_SC_Compu "" RAT_FUNC "%6.2" "" COEFFS 0 1 0 0 0 1 /end COMPU_METHOD
/begin COMPU_METHOD DELIB_RPRECTLUPMAPSIZEX_SC_Compu "" RAT_FUNC "%6.2" "" COEFFS 0 1 0 0 0 1 /end COMPU_METHOD
/begin COMPU_METHOD DELIB_RPRECTLUPMAPSIZEY_SC_Compu "" RAT_FUNC "%6.2" "" COEFFS 0 1 0 0 0 1 /end COMPU_METHOD
/begin COMPU_METHOD DELIB_RPSMAXMAPSIZEX_SC_Compu "" RAT_FUNC "%6.2" "" COEFFS 0 1 0 0 0 1 /end COMPU_METHOD
/begin COMPU_METHOD DELIB_RPSMAXMAPSIZEY_SC_Compu "" RAT_FUNC "%6.2" "" COEFFS 0 1 0 0 0 1 /end COMPU_METHOD
/begin COMPU_METHOD DELIB_SENTCALULINSIZECUR_SC_Compu "" RAT_FUNC "%6.2" "" COEFFS 0 1 0 0 0 1 /end COMPU_METHOD
/begin COMPU_METHOD DELIB_SIMPLESWTAVL_SC_Compu "" TAB_VERB "%6.3" "" COMPU_TAB_REF DELIB_SIMPLESWTAVL_SC_Compu /end COMPU_METHOD
/begin COMPU_VTAB DELIB_SIMPLESWTAVL_SC_Compu "" TAB_VERB 2 0 "deactivated" 1 "activated" /end COMPU_VTAB
/begin COMPU_METHOD DELIB_STDACTRTYPAVL_SC_Compu "" TAB_VERB "%6.3" "" COMPU_TAB_REF DELIB_STDACTRTYPAVL_SC_Compu /end COMPU_METHOD
/begin COMPU_VTAB DELIB_STDACTRTYPAVL_SC_Compu "" TAB_VERB 2 0 "False" 1 "True" /end COMPU_VTAB
/begin COMPU_METHOD DELIB_STDSENSTYPAVL_SC_Compu "" TAB_VERB "%6.3" "" COMPU_TAB_REF DELIB_STDSENSTYPAVL_SC_Compu /end COMPU_METHOD
/begin COMPU_VTAB DELIB_STDSENSTYPAVL_SC_Compu "" TAB_VERB 2 0 "False" 1 "True" /end COMPU_VTAB
/begin COMPU_METHOD DELIB_TIDIAGDISSIZECUR_SC_Compu "" RAT_FUNC "%6.2" "" COEFFS 0 1 0 0 0 1 /end COMPU_METHOD
/begin COMPU_METHOD DELIB_UTOFFSADJCLSDSIZECRV_SC_Compu "" RAT_FUNC "%6.2" "" COEFFS 0 1 0 0 0 1 /end COMPU_METHOD
/begin COMPU_METHOD DELIB_UTOFFSADJOPENDSIZECRV_SC_Compu "" RAT_FUNC "%6.2" "" COEFFS 0 1 0 0 0 1 /end COMPU_METHOD
/begin COMPU_METHOD Dens "" RAT_FUNC "%6.3" "Kg/m^3" COEFFS 0 10 0 0 0 1 /end COMPU_METHOD
/begin COMPU_METHOD DensFine "" RAT_FUNC "%6.4" "Kg/m^3" COEFFS 0 500 0 0 0 1 /end COMPU_METHOD
/begin COMPU_METHOD DerPresRl_COMPU "" RAT_FUNC "%6.0" "hPa/s" COEFFS 0 0.01 0 0 0 1 /end COMPU_METHOD
/begin COMPU_METHOD DETNBADSTRT_SC_Compu "" TAB_VERB "%6.3" "" COMPU_TAB_REF DETNBADSTRT_SC_Compu /end COMPU_METHOD
/begin COMPU_VTAB DETNBADSTRT_SC_Compu "" TAB_VERB 2 0 "False" 1 "True" /end COMPU_VTAB
/begin COMPU_METHOD DEVLIB_4WINDIACMPNENA_SY_Compu "" TAB_VERB "%6.3" "" COMPU_TAB_REF DEVLIB_4WINDIACMPNENA_SY_Compu /end COMPU_METHOD
/begin COMPU_VTAB DEVLIB_4WINDIACMPNENA_SY_Compu "" TAB_VERB 2 0 "False" 1 "True" /end COMPU_VTAB
/begin COMPU_METHOD DEVLIB_ACTRPRTCMPNENA_SY_Compu "" TAB_VERB "%6.3" "" COMPU_TAB_REF DEVLIB_ACTRPRTCMPNENA_SY_Compu /end COMPU_METHOD
/begin COMPU_VTAB DEVLIB_ACTRPRTCMPNENA_SY_Compu "" TAB_VERB 2 0 "False" 1 "True" /end COMPU_VTAB
/begin COMPU_METHOD DEVLIB_DBG_SY_Compu "" TAB_VERB "%6.3" "" COMPU_TAB_REF DEVLIB_DBG_SY_Compu /end COMPU_METHOD
/begin COMPU_VTAB DEVLIB_DBG_SY_Compu "" TAB_VERB 2 0 "False" 1 "True" /end COMPU_VTAB
/begin COMPU_METHOD DEVLIB_DIACTLLINECMPNENA_SY_Compu "" TAB_VERB "%6.3" "" COMPU_TAB_REF DEVLIB_DIACTLLINECMPNENA_SY_Compu /end COMPU_METHOD
/begin COMPU_VTAB DEVLIB_DIACTLLINECMPNENA_SY_Compu "" TAB_VERB 2 0 "False" 1 "True" /end COMPU_VTAB
/begin COMPU_METHOD DEVLIB_HBRGENA_SY_Compu "" TAB_VERB "%6.3" "" COMPU_TAB_REF DEVLIB_HBRGENA_SY_Compu /end COMPU_METHOD
/begin COMPU_VTAB DEVLIB_HBRGENA_SY_Compu "" TAB_VERB 2 0 "0" 1 "1" /end COMPU_VTAB
/begin COMPU_METHOD DEVLIB_PHYSRNGCHK_SY_Compu "" TAB_VERB "%6.3" "" COMPU_TAB_REF DEVLIB_PHYSRNGCHK_SY_Compu /end COMPU_METHOD
/begin COMPU_VTAB DEVLIB_PHYSRNGCHK_SY_Compu "" TAB_VERB 2 0 "FALSE" 1 "TRUE" /end COMPU_VTAB
/begin COMPU_METHOD DEVLIB_PSOFFOPNLD_SY_Compu "" TAB_VERB "%6.3" "" COMPU_TAB_REF DEVLIB_PSOFFOPNLD_SY_Compu /end COMPU_METHOD
/begin COMPU_VTAB DEVLIB_PSOFFOPNLD_SY_Compu "" TAB_VERB 2 0 "FALSE" 1 "TRUE" /end COMPU_VTAB
/begin COMPU_METHOD DEVLIB_PSSTATEMOCSOPINI_SY_Compu "" TAB_VERB "%6.3" "" COMPU_TAB_REF DEVLIB_PSSTATEMOCSOPINI_SY_Compu /end COMPU_METHOD
/begin COMPU_VTAB DEVLIB_PSSTATEMOCSOPINI_SY_Compu "" TAB_VERB 2 0 "False" 1 "True" /end COMPU_VTAB
/begin COMPU_METHOD DEVLIB_PWRSTGSTATEMOCSOPCHK_SY_Compu "" TAB_VERB "%6.3" "" COMPU_TAB_REF DEVLIB_PWRSTGSTATEMOCSOPCHK_SY_Compu /end COMPU_METHOD
/begin COMPU_VTAB DEVLIB_PWRSTGSTATEMOCSOPCHK_SY_Compu "" TAB_VERB 2 0 "False" 1 "True" /end COMPU_VTAB
/begin COMPU_METHOD DFCOBSVRNRBYT_SC_Compu "" RAT_FUNC "%6.2" "" COEFFS 0 1 0 0 0 1 /end COMPU_METHOD
/begin COMPU_METHOD DFCOBSVRNRFLT_SC_Compu "" RAT_FUNC "%6.2" "" COEFFS 0 1 0 0 0 1 /end COMPU_METHOD
/begin COMPU_METHOD DFCOBSVRNRSIG_SC_Compu "" RAT_FUNC "%6.2" "" COEFFS 0 1 0 0 0 1 /end COMPU_METHOD
/begin COMPU_METHOD DFC_CALPRMSTATDISBLMSK_SC_Compu "" TAB_VERB "%6.3" "" COMPU_TAB_REF DFC_CALPRMSTATDISBLMSK_SC_Compu /end COMPU_METHOD
/begin COMPU_VTAB DFC_CALPRMSTATDISBLMSK_SC_Compu "" TAB_VERB 2 0 "Disabled" 1 "Enabled" /end COMPU_VTAB
/begin COMPU_METHOD DFC_CTLDISBLLAYOUT_SY_Compu "" RAT_FUNC "%6.2" "" COEFFS 0 1 0 0 0 1 /end COMPU_METHOD
/begin COMPU_METHOD DFC_CTLMSKBYTES_SY_Compu "" TAB_VERB "%6.3" "" COMPU_TAB_REF DFC_CTLMSKBYTES_SY_Compu /end COMPU_METHOD
/begin COMPU_VTAB DFC_CTLMSKBYTES_SY_Compu "" TAB_VERB 2 1 "SIZE_1_BYTE" 2 "SIZE_2_BYTES" /end COMPU_VTAB
/begin COMPU_METHOD DFC_DISBLMSKBYTES_SY_Compu "" TAB_VERB "%6.3" "" COMPU_TAB_REF DFC_DISBLMSKBYTES_SY_Compu /end COMPU_METHOD
/begin COMPU_VTAB DFC_DISBLMSKBYTES_SY_Compu "" TAB_VERB 3 1 "SIZE_1_BYTE" 2 "SIZE_2_BYTES" 4 "SIZE_4_BYTES" /end COMPU_VTAB
/begin COMPU_METHOD DFC_SETSTATDITHOAPI_SC_Compu "" TAB_VERB "%6.3" "" COMPU_TAB_REF DFC_SETSTATDITHOAPI_SC_Compu /end COMPU_METHOD
/begin COMPU_VTAB DFC_SETSTATDITHOAPI_SC_Compu "" TAB_VERB 2 0 "False" 1 "True" /end COMPU_VTAB
/begin COMPU_METHOD DFES_ACTVENHMTSIMCONDPID9F_SC_Compu "" TAB_VERB "%6.3" "" COMPU_TAB_REF DFES_ACTVENHMTSIMCONDPID9F_SC_Compu /end COMPU_METHOD
/begin COMPU_VTAB DFES_ACTVENHMTSIMCONDPID9F_SC_Compu "" TAB_VERB 2 0 "False" 1 "True" /end COMPU_VTAB
/begin COMPU_METHOD DFES_ACTVSIMRCDNPID03_SC_Compu "" TAB_VERB "%6.3" "" COMPU_TAB_REF DFES_ACTVSIMRCDNPID03_SC_Compu /end COMPU_METHOD
/begin COMPU_VTAB DFES_ACTVSIMRCDNPID03_SC_Compu "" TAB_VERB 2 0 "False" 1 "True" /end COMPU_VTAB
/begin COMPU_METHOD DFES_ADDLMILMOD_SC_Compu "" TAB_VERB "%6.3" "" COMPU_TAB_REF DFES_ADDLMILMOD_SC_Compu /end COMPU_METHOD
/begin COMPU_VTAB DFES_ADDLMILMOD_SC_Compu "" TAB_VERB 2 0 "NO_ADDLMILMOD" 1 "ADDLMILMOD_SET1" /end COMPU_VTAB
/begin COMPU_METHOD DFES_BLKENTRY_SY_Compu "" TAB_VERB "%6.3" "" COMPU_TAB_REF DFES_BLKENTRY_SY_Compu /end COMPU_METHOD
/begin COMPU_VTAB DFES_BLKENTRY_SY_Compu "" TAB_VERB 2 0 "False" 1 "True" /end COMPU_VTAB
/begin COMPU_METHOD DFES_COMMILDEB_SY_Compu "" TAB_VERB "%6.3" "" COMPU_TAB_REF DFES_COMMILDEB_SY_Compu /end COMPU_METHOD
/begin COMPU_VTAB DFES_COMMILDEB_SY_Compu "" TAB_VERB 2 0 "DISABLED" 1 "ENABLED" /end COMPU_VTAB
/begin COMPU_METHOD DFES_DTC_TSTFAIL_SY_Compu "" TAB_VERB "%6.3" "" COMPU_TAB_REF DFES_DTC_TSTFAIL_SY_Compu /end COMPU_METHOD
/begin COMPU_VTAB DFES_DTC_TSTFAIL_SY_Compu "" TAB_VERB 2 0 "0" 1 "1" /end COMPU_VTAB
/begin COMPU_METHOD DFES_EOBDCV_SY_Compu "" TAB_VERB "%6.3" "" COMPU_TAB_REF DFES_EOBDCV_SY_Compu /end COMPU_METHOD
/begin COMPU_VTAB DFES_EOBDCV_SY_Compu "" TAB_VERB 2 0 "FALSE" 1 "TRUE" /end COMPU_VTAB
/begin COMPU_METHOD DFES_EOLCLR_SY_Compu "" TAB_VERB "%6.3" "" COMPU_TAB_REF DFES_EOLCLR_SY_Compu /end COMPU_METHOD
/begin COMPU_VTAB DFES_EOLCLR_SY_Compu "" TAB_VERB 2 0 "False" 1 "True" /end COMPU_VTAB
/begin COMPU_METHOD DFES_EXTDFLT_SY_Compu "" TAB_VERB "%6.3" "" COMPU_TAB_REF DFES_EXTDFLT_SY_Compu /end COMPU_METHOD
/begin COMPU_VTAB DFES_EXTDFLT_SY_Compu "" TAB_VERB 2 0 "DISABLED" 1 "ENABLED" /end COMPU_VTAB
/begin COMPU_METHOD DFES_IMDTNVSTORG_SC_Compu "" TAB_VERB "%6.3" "" COMPU_TAB_REF DFES_IMDTNVSTORG_SC_Compu /end COMPU_METHOD
/begin COMPU_VTAB DFES_IMDTNVSTORG_SC_Compu "" TAB_VERB 2 0 "False" 1 "True" /end COMPU_VTAB
/begin COMPU_METHOD DFES_IRV_SY_Compu "" TAB_VERB "%6.3" "" COMPU_TAB_REF DFES_IRV_SY_Compu /end COMPU_METHOD
/begin COMPU_VTAB DFES_IRV_SY_Compu "" TAB_VERB 2 0 "DFES_IRV_DISBL" 1 "DFES_IRV_ENA" /end COMPU_VTAB
/begin COMPU_METHOD DFES_PDTC_SY_Compu "" TAB_VERB "%6.3" "" COMPU_TAB_REF DFES_PDTC_SY_Compu /end COMPU_METHOD
/begin COMPU_VTAB DFES_PDTC_SY_Compu "" TAB_VERB 2 0 "False" 1 "True" /end COMPU_VTAB
/begin COMPU_METHOD DFES_VIS_BUF_SY_Compu "" TAB_VERB "%6.3" "" COMPU_TAB_REF DFES_VIS_BUF_SY_Compu /end COMPU_METHOD
/begin COMPU_VTAB DFES_VIS_BUF_SY_Compu "" TAB_VERB 2 0 "0" 1 "1" /end COMPU_VTAB
/begin COMPU_METHOD DFFTLPRTOVRDSTSCINC_SY_Compu "" TAB_VERB "%6.3" "" COMPU_TAB_REF DFFTLPRTOVRDSTSCINC_SY_Compu /end COMPU_METHOD
/begin COMPU_VTAB DFFTLPRTOVRDSTSCINC_SY_Compu "" TAB_VERB 2 0 "FALSE" 1 "TRUE" /end COMPU_VTAB
/begin COMPU_METHOD DFFV_SY_Compu "" TAB_VERB "%6.3" "" COMPU_TAB_REF DFFV_SY_Compu /end COMPU_METHOD
/begin COMPU_VTAB DFFV_SY_Compu "" TAB_VERB 2 0 "False" 1 "True" /end COMPU_VTAB
/begin COMPU_METHOD dFlConsum "" RAT_FUNC "%6.4" "l/h/s" COEFFS 0 100 0 0 0 1 /end COMPU_METHOD
/begin COMPU_METHOD DFSTT_SY_Compu "" TAB_VERB "%6.3" "" COMPU_TAB_REF DFSTT_SY_Compu /end COMPU_METHOD
/begin COMPU_VTAB DFSTT_SY_Compu "" TAB_VERB 2 0 "False" 1 "True" /end COMPU_VTAB
/begin COMPU_METHOD DIAACTR_ELECCTRLLINEDIAGCPTENA_SC_Compu "" TAB_VERB "%6.3" "" COMPU_TAB_REF DIAACTR_ELECCTRLLINEDIAGCPTENA_SC_Compu /end COMPU_METHOD
/begin COMPU_VTAB DIAACTR_ELECCTRLLINEDIAGCPTENA_SC_Compu "" TAB_VERB 2 0 "False" 1 "True" /end COMPU_VTAB
/begin COMPU_METHOD DIAACTR_ELECHBRDGDIAGENA_SC_Compu "" TAB_VERB "%6.3" "" COMPU_TAB_REF DIAACTR_ELECHBRDGDIAGENA_SC_Compu /end COMPU_METHOD
/begin COMPU_VTAB DIAACTR_ELECHBRDGDIAGENA_SC_Compu "" TAB_VERB 2 0 "False" 1 "True" /end COMPU_VTAB
/begin COMPU_METHOD DIAACTR_ELECPSDIAGCMPNENA_SC_Compu "" TAB_VERB "%6.3" "" COMPU_TAB_REF DIAACTR_ELECPSDIAGCMPNENA_SC_Compu /end COMPU_METHOD
/begin COMPU_VTAB DIAACTR_ELECPSDIAGCMPNENA_SC_Compu "" TAB_VERB 2 0 "False" 1 "True" /end COMPU_VTAB
/begin COMPU_METHOD DIAACTR_ELECPSDIAGERRINFO_SC_Compu "" TAB_VERB "%6.3" "" COMPU_TAB_REF DIAACTR_ELECPSDIAGERRINFO_SC_Compu /end COMPU_METHOD
/begin COMPU_VTAB DIAACTR_ELECPSDIAGERRINFO_SC_Compu "" TAB_VERB 2 0 "LSTRAWINFO" 1 "LSTTESTRSLT" /end COMPU_VTAB
/begin COMPU_METHOD DIABAS_ATSLRGIDSUPRT_SC_Compu "" TAB_VERB "%6.3" "" COMPU_TAB_REF DIABAS_ATSLRGIDSUPRT_SC_Compu /end COMPU_METHOD
/begin COMPU_VTAB DIABAS_ATSLRGIDSUPRT_SC_Compu "" TAB_VERB 2 0 "DISABLE" 1 "ENABLE" /end COMPU_VTAB
/begin COMPU_METHOD DIABAS_ATSSUSP_SC_Compu "" TAB_VERB "%6.3" "" COMPU_TAB_REF DIABAS_ATSSUSP_SC_Compu /end COMPU_METHOD
/begin COMPU_VTAB DIABAS_ATSSUSP_SC_Compu "" TAB_VERB 2 1 "Temporary" 2 "Permanent" /end COMPU_VTAB
/begin COMPU_METHOD DIABAS_ATS_SC_Compu "" TAB_VERB "%6.3" "" COMPU_TAB_REF DIABAS_ATS_SC_Compu /end COMPU_METHOD
/begin COMPU_VTAB DIABAS_ATS_SC_Compu "" TAB_VERB 2 0 "ATS inactive" 1 "ATS active" /end COMPU_VTAB
/begin COMPU_METHOD DIABAS_AVS_SY_Compu "" TAB_VERB "%6.3" "" COMPU_TAB_REF DIABAS_AVS_SY_Compu /end COMPU_METHOD
/begin COMPU_VTAB DIABAS_AVS_SY_Compu "" TAB_VERB 2 0 "False" 1 "True" /end COMPU_VTAB
/begin COMPU_METHOD DIABAS_BSWVERS_SC_Compu "" TAB_VERB "%6.3" "" COMPU_TAB_REF DIABAS_BSWVERS_SC_Compu /end COMPU_METHOD
/begin COMPU_VTAB DIABAS_BSWVERS_SC_Compu "" TAB_VERB 20 10 "BSW_1703" 11 "BSW_1706" 12 "BSW_1709" 13 "BSW_1712" 20 "BSW_1803" 21 "BSW_1806" 22 "BSW_1809" 23 "BSW_1812" 30 "BSW_1903" 31 "BSW_1906" 32 "BSW_1909" 33 "BSW_1912" 40 "BSW_2003" 41 "BSW_2006" 42 "BSW_2009" 43 "BSW_2012" 50 "BSW_2103" 51 "BSW_2106" 52 "BSW_2109" 53 "BSW_2112" /end COMPU_VTAB
/begin COMPU_METHOD EngN "" RAT_FUNC "%6.3" "rpm" COEFFS 0 2 0 0 0 1 /end COMPU_METHOD
/begin COMPU_METHOD EngN_short "" RAT_FUNC "%6.1" "rpm" COEFFS 0 1 0 0 0 50 /end COMPU_METHOD
/begin COMPU_METHOD fak_q2p384Em4_pc_DIV_Nm "" RAT_FUNC "%6.5" "%/Nm" COEFFS 0 1048576 0 0 0 250 /end COMPU_METHOD
/begin COMPU_METHOD fak_uw_b1 "" RAT_FUNC "%7.6" "-" COEFFS 0 65536 0 0 0 1 /end COMPU_METHOD
/begin COMPU_METHOD fak_uw_b2 "" RAT_FUNC "%7.6" "-" COEFFS 0 65536 0 0 0 2 /end COMPU_METHOD
/begin COMPU_METHOD OneToOne "" RAT_FUNC "%6.2" "-" COEFFS 0 1 0 0 0 1 /end COMPU_METHOD
/begin COMPU_METHOD Prc "" RAT_FUNC "%6.4" "%" COEFFS 0 81.92 0 0 0 1 /end COMPU_METHOD
/begin COMPU_METHOD Prc_EGR "" RAT_FUNC "%6.3" "%" COEFFS 0 2.55 0 0 0 1 /end COMPU_METHOD
/begin COMPU_METHOD Prc_Fact256 "" RAT_FUNC "%6.4" "%" COEFFS 0 256 0 0 0 1 /end COMPU_METHOD
/begin COMPU_METHOD RBPtCel_tq_1p0_1 "" RAT_FUNC "%6.2" "Nm" COEFFS 0 1 0 0 0 1 /end COMPU_METHOD
/begin COMPU_METHOD rel_uw_b100 "" RAT_FUNC "%6.4" "%" COEFFS 0 65536 0 0 0 100 /end COMPU_METHOD
/begin COMPU_METHOD rel_uw_q0p0234 "" RAT_FUNC "%6.4" "%" COEFFS 0 32 0 0 0 0.75 /end COMPU_METHOD
/begin COMPU_METHOD SigQly_COMPU_VERB "" TAB_VERB "%6.3" "" COMPU_TAB_REF SigQly_COMPU_VERB /end COMPU_METHOD
/begin COMPU_VTAB SigQly_COMPU_VERB "" TAB_VERB 16 0 "SIGQLY_NOTCALC" 1 "SIGQLY_INIT" 2 "SIGQLY_OK" 3 "SIGQLY_MODEL" 4 "SIGQLY_REPLACEMENT" 5 "SIGQLY_FROZEN" 6 "SIGQLY_INVALID" 7 "SIGQLY_RESERVED_7" 8 "SIGQLY_RESERVED_8" 9 "SIGQLY_RESERVED_9" 10 "SIGQLY_RESERVED_10" 11 "SIGQLY_RESERVED_11" 12 "SIGQLY_RESERVED_12" 13 "SIGQLY_RESERVED_13" 14 "SIGQLY_RESERVED_14" 15 "SIGQLY_RESERVED_15" /end COMPU_VTAB
/begin COMPU_METHOD Temp_Cels "" RAT_FUNC "%6.1" "deg C" COEFFS 0 10 2731.4 0 0 1 /end COMPU_METHOD
/begin COMPU_METHOD Temp_Cels_Diff "" RAT_FUNC "%6.3" "deg C" COEFFS 0 10 0 0 0 1 /end COMPU_METHOD
/begin COMPU_METHOD temp_ub_q0p75_o48 "" RAT_FUNC "%6.2" "Grad C" COEFFS 0 1 48 0 0 0.75 /end COMPU_METHOD
/begin COMPU_METHOD TimeDeb "" RAT_FUNC "%6.1" "ms" COEFFS 0 0.1 0 0 0 1 /end COMPU_METHOD
/begin COMPU_METHOD TimeDelay_s "" RAT_FUNC "%6.1" "s" COEFFS 0 0 1 0 0.00023283064365387 0 /end COMPU_METHOD
/begin COMPU_METHOD TimeDT "" RAT_FUNC "%6.2" "us" COEFFS 0 1 0 0 0 1 /end COMPU_METHOD
/begin COMPU_METHOD TimeRed "" RAT_FUNC "%6.3" "s" COEFFS 0 6.25 0 0 0 1 /end COMPU_METHOD
/begin COMPU_METHOD Time_Dt "" RAT_FUNC "%9.8" "s" COEFFS 0 1000000 0 0 0 1 /end COMPU_METHOD
/begin COMPU_METHOD Time_ms "" RAT_FUNC "%6.1" "ms" COEFFS 0 0.1 0 0 0 1 /end COMPU_METHOD
/begin COMPU_METHOD Time_s "" RAT_FUNC "%6.4" "s" COEFFS 0 100 0 0 0 1 /end COMPU_METHOD
/begin COMPU_METHOD Time_sec_q1_COMPU "" RAT_FUNC "%6.2" "s" COEFFS 0 1 0 0 0 1 /end COMPU_METHOD
/begin COMPU_METHOD Trq "" RAT_FUNC "%6.3" "Nm" COEFFS 0 10 0 0 0 1 /end COMPU_METHOD
/begin COMPU_METHOD t_q0p01 "" RAT_FUNC "%6.4" "s" COEFFS 0 100 0 0 0 1 /end COMPU_METHOD
/begin COMPU_METHOD t_q0p1 "" RAT_FUNC "%6.3" "s" COEFFS 0 10 0 0 0 1 /end COMPU_METHOD
/begin COMPU_METHOD Vel "" RAT_FUNC "%6.4" "km/h" COEFFS 0 100 0 0 0 1 /end COMPU_METHOD
/begin COMPU_METHOD Volt "" RAT_FUNC "%6.3" "mV" COEFFS 0 5 0 0 0 1 /end COMPU_METHOD
/begin RECORD_LAYOUT Kw_Ws16 FNC_VALUES 1 SWORD COLUMN_DIR DIRECT /end RECORD_LAYOUT
/begin RECORD_LAYOUT Map_Xu8Yu8Ws16 NO_AXIS_PTS_X 1 UBYTE NO_AXIS_PTS_Y 2 UBYTE AXIS_PTS_X 3 UBYTE INDEX_INCR DIRECT AXIS_PTS_Y 4 UBYTE INDEX_INCR DIRECT FNC_VALUES 5 SWORD COLUMN_DIR DIRECT /end RECORD_LAYOUT
/begin RECORD_LAYOUT RB_Curve_S16_S16 NO_AXIS_PTS_X 1 SWORD AXIS_PTS_X 2 SWORD INDEX_INCR DIRECT FNC_VALUES 3 SWORD COLUMN_DIR DIRECT /end RECORD_LAYOUT
/begin RECORD_LAYOUT RB_Curve_S8_S8 NO_AXIS_PTS_X 1 SBYTE AXIS_PTS_X 2 SBYTE INDEX_INCR DIRECT FNC_VALUES 3 SBYTE COLUMN_DIR DIRECT /end RECORD_LAYOUT
/begin RECORD_LAYOUT RB_Curve_U16_S16_Static NO_AXIS_PTS_X 1 UWORD AXIS_PTS_X 2 UWORD INDEX_INCR DIRECT FNC_VALUES 3 SWORD COLUMN_DIR DIRECT STATIC_RECORD_LAYOUT /end RECORD_LAYOUT
/begin RECORD_LAYOUT RB_Curve_U16_U16 NO_AXIS_PTS_X 1 UWORD AXIS_PTS_X 2 UWORD INDEX_INCR DIRECT FNC_VALUES 3 UWORD COLUMN_DIR DIRECT /end RECORD_LAYOUT
/begin RECORD_LAYOUT RB_Curve_U16_U8_Static NO_AXIS_PTS_X 1 UWORD AXIS_PTS_X 2 UWORD INDEX_INCR DIRECT FNC_VALUES 3 UBYTE COLUMN_DIR DIRECT STATIC_RECORD_LAYOUT /end RECORD_LAYOUT
/begin RECORD_LAYOUT RB_Curve_U8_U16_Static NO_AXIS_PTS_X 1 UBYTE AXIS_PTS_X 2 UBYTE INDEX_INCR DIRECT FNC_VALUES 3 UWORD COLUMN_DIR DIRECT STATIC_RECORD_LAYOUT /end RECORD_LAYOUT
/begin RECORD_LAYOUT RB_Curve_U8_U8 NO_AXIS_PTS_X 1 UBYTE AXIS_PTS_X 2 UBYTE INDEX_INCR DIRECT FNC_VALUES 3 UBYTE COLUMN_DIR DIRECT /end RECORD_LAYOUT
/begin RECORD_LAYOUT RB_FixCurve_U8_U8 FNC_VALUES 1 UBYTE COLUMN_DIR DIRECT /end RECORD_LAYOUT
/begin RECORD_LAYOUT RB_Map_S16S16_S16 NO_AXIS_PTS_X 1 SWORD NO_AXIS_PTS_Y 2 SWORD AXIS_PTS_X 3 SWORD INDEX_INCR DIRECT AXIS_PTS_Y 4 SWORD INDEX_INCR DIRECT FNC_VALUES 5 SWORD COLUMN_DIR DIRECT /end RECORD_LAYOUT
/begin RECORD_LAYOUT RB_Map_U16U16_U16 NO_AXIS_PTS_X 1 UWORD NO_AXIS_PTS_Y 2 UWORD AXIS_PTS_X 3 UWORD INDEX_INCR DIRECT AXIS_PTS_Y 4 UWORD INDEX_INCR DIRECT FNC_VALUES 5 UWORD COLUMN_DIR DIRECT /end RECORD_LAYOUT
/begin RECORD_LAYOUT RB_Map_U8U8_U16 NO_AXIS_PTS_X 1 UBYTE NO_AXIS_PTS_Y 2 UBYTE AXIS_PTS_X 3 UBYTE INDEX_INCR DIRECT AXIS_PTS_Y 4 UBYTE INDEX_INCR DIRECT FNC_VALUES 5 UWORD COLUMN_DIR DIRECT /end RECORD_LAYOUT
/begin RECORD_LAYOUT RB_Map_U8U8_U8 NO_AXIS_PTS_X 1 UBYTE NO_AXIS_PTS_Y 2 UBYTE AXIS_PTS_X 3 UBYTE INDEX_INCR DIRECT AXIS_PTS_Y 4 UBYTE INDEX_INCR DIRECT FNC_VALUES 5 UBYTE COLUMN_DIR DIRECT /end RECORD_LAYOUT
/begin RECORD_LAYOUT RB_ValA_Wu16 FNC_VALUES 1 UWORD COLUMN_DIR DIRECT /end RECORD_LAYOUT
/begin RECORD_LAYOUT RB_ValA_Wu8 FNC_VALUES 1 UBYTE COLUMN_DIR DIRECT /end RECORD_LAYOUT
/begin RECORD_LAYOUT RB_Val_Ws16 FNC_VALUES 1 SWORD COLUMN_DIR DIRECT /end RECORD_LAYOUT
/begin RECORD_LAYOUT RB_Val_Ws32 FNC_VALUES 1 SLONG COLUMN_DIR DIRECT /end RECORD_LAYOUT
/begin RECORD_LAYOUT RB_Val_Ws8 FNC_VALUES 1 SBYTE COLUMN_DIR DIRECT /end RECORD_LAYOUT
/begin RECORD_LAYOUT RB_Val_Wu16 FNC_VALUES 1 UWORD COLUMN_DIR DIRECT /end RECORD_LAYOUT
/begin RECORD_LAYOUT RB_Val_Wu32 FNC_VALUES 1 ULONG COLUMN_DIR DIRECT /end RECORD_LAYOUT
/begin RECORD_LAYOUT RB_Val_Wu8 FNC_VALUES 1 UBYTE COLUMN_DIR DIRECT /end RECORD_LAYOUT
/begin RECORD_LAYOUT Val_Ws16 FNC_VALUES 1 SWORD COLUMN_DIR DIRECT /end RECORD_LAYOUT
/begin RECORD_LAYOUT Val_Ws32 FNC_VALUES 1 SLONG COLUMN_DIR DIRECT /end RECORD_LAYOUT
/begin RECORD_LAYOUT Val_Wu16 FNC_VALUES 1 UWORD COLUMN_DIR DIRECT /end RECORD_LAYOUT
/begin RECORD_LAYOUT Val_Wu8 FNC_VALUES 1 UBYTE COLUMN_DIR DIRECT /end RECORD_LAYOUT
/end MODULE
/end PROJECT
