ASAP2_VERSION 1 60
/begin PROJECT MG1CA020 "MG1CA020"
/begin HEADER "" VERSION "MG1CA020_6SAY_V011_TPROT" PROJECT_NO MG1CA020 /end HEADER
/begin MODULE DIM ""
/begin MOD_COMMON "" BYTE_ORDER MSB_LAST ALIGNMENT_BYTE 1 ALIGNMENT_WORD 2 ALIGNMENT_LONG 4 ALIGNMENT_INT64 4 ALIGNMENT_FLOAT32_IEEE 4 ALIGNMENT_FLOAT64_IEEE 4 DATA_SIZE 32 /end MOD_COMMON
/begin CHARACTERISTIC Conv_BrkDebP.tiHiLo_C "BrkPed Active debounce time for converter oil temperature calculation / Time for a High to Low transition" VALUE 0x8053A794 Kw_Ws16 655350.0 TimeDeb -327680.0 327670.0 FORMAT "%8.1" /end CHARACTERISTIC
/begin CHARACTERISTIC Conv_BrkDebP.tiLoHi_C "BrkPed Active debounce time for converter oil temperature calculation / Time for a Low to High transition" VALUE 0x8053A796 Kw_Ws16 655350.0 TimeDeb -327680.0 327670.0 FORMAT "%8.1" /end CHARACTERISTIC
/begin CHARACTERISTIC Conv_facClthClsd_GCUR "Oil temperature dependant factor closed for clutch." CURVE 0x805148A0 RB_CurveGroup_S16 0.006553500 TrqToNSqr -0.003276800 0.003276700 FORMAT "%11.9"
 /begin AXIS_DESCR COM_AXIS Conv_tOilBuf Temp_Cels 14 -3549.940 3003.560 FORMAT "%8.3" AXIS_PTS_REF Conv_tPntDST_AXIS /end AXIS_DESCR
/end CHARACTERISTIC
/begin CHARACTERISTIC Conv_facClthOpnd_GCUR "Oil temperature dependant factor opened for clutch." CURVE 0x805148BC RB_CurveGroup_S16 0.006553500 TrqToNSqr -0.003276800 0.003276700 FORMAT "%11.9"
 /begin AXIS_DESCR COM_AXIS Conv_tOilBuf Temp_Cels 14 -3549.940 3003.560 FORMAT "%8.3" AXIS_PTS_REF Conv_tPntDST_AXIS /end AXIS_DESCR
/end CHARACTERISTIC
/begin CHARACTERISTIC Conv_facDepNTrbnNStat_CUR "Factor dependant of the turbine speed and the stationary engine speed." CURVE 0x80514524 RB_Curve_S16_S16 7.999878 Fact -4.000000 3.999878 FORMAT "%8.6"
 /begin AXIS_DESCR STD_AXIS Conv_rNTrbnNStat_mp TransR 6 -327.6800 327.6700 FORMAT "%8.4" DEPOSIT ABSOLUTE /end AXIS_DESCR
/end CHARACTERISTIC
/begin CHARACTERISTIC Conv_facDeptNTrbnNStat_M "Factor dependant of the turbine speed, stationary engine speed and Oil Temperature." MAP 0x8051453E RB_Map_S16S16_S16 7.999878 Fact -4.000000 3.999878 FORMAT "%8.6"
 /begin AXIS_DESCR STD_AXIS Conv_tOil Temp_Cels 10 -3549.940 3003.560 FORMAT "%8.3" DEPOSIT ABSOLUTE /end AXIS_DESCR
 /begin AXIS_DESCR STD_AXIS Conv_rNTrbnNStat_mp TransR 10 -327.6800 327.6700 FORMAT "%8.4" DEPOSIT ABSOLUTE /end AXIS_DESCR
/end CHARACTERISTIC
/begin CHARACTERISTIC Conv_facDfl_C "Factor for oil pump." VALUE 0x805148D8 RB_Val_Ws16 0.006553500 TrqToNSqr -0.003276800 0.003276700 FORMAT "%11.9" /end CHARACTERISTIC
/begin CHARACTERISTIC Conv_facGnTrqHiInc_C "Calibration factor for large torque increase" VALUE 0x80514632 Val_Ws16 511.9922 Fact1 -256.0000 255.9922 FORMAT "%8.4" /end CHARACTERISTIC
/begin CHARACTERISTIC Conv_facGnTrqResv_C "Intensity factor for the calculation of the torque reserve" VALUE 0x80514634 Val_Ws16 7.999878 Fact -4.000000 3.999878 FORMAT "%8.6" /end CHARACTERISTIC
/begin CHARACTERISTIC Conv_facNTrbnCorr_C "Correction factor for turbine speed" VALUE 0x80514636 Val_Ws16 511.9922 Fact1 -256.0000 255.9922 FORMAT "%8.4" /end CHARACTERISTIC
/begin CHARACTERISTIC Conv_facRedCnvrLoad_C "The base factor to convert torque" VALUE 0x80514638 Val_Ws16 1.000000 RBPtCel_fac_0p01_1 0.00 1.000000 FORMAT "%8.6" EXTENDED_LIMITS -327.6800 327.6700 /end CHARACTERISTIC
/begin CHARACTERISTIC Conv_facVelErr_C "Calibration factor for vehicle speed error" VALUE 0x8051463A Val_Ws16 7.999878 Fact -4.000000 3.999878 FORMAT "%8.6" /end CHARACTERISTIC
/begin CHARACTERISTIC Conv_facVelNoErr_C "Calibration factor for no vehicle speed error" VALUE 0x8051463C Val_Ws16 7.999878 Fact -4.000000 3.999878 FORMAT "%8.6" /end CHARACTERISTIC
/begin CHARACTERISTIC Conv_flgDecelTqAPSeln_C "Flag of AP status selection of torque deceleration offset" VALUE 0x8051463E Val_Wu8 1.000 OneToOne 0.00 1.000 FORMAT "%5.3" EXTENDED_LIMITS 0.00 255.0 /end CHARACTERISTIC
/begin CHARACTERISTIC Conv_flgEnaTqResvShiftLvr_C "Flag for enabling reserve torque depending on shift lever status" VALUE 0x8051463F Val_Wu8 1.000 OneToOne 0.00 1.000 FORMAT "%5.3" EXTENDED_LIMITS 0.00 255.0 /end CHARACTERISTIC
/begin CHARACTERISTIC Conv_flgSwtGearLvrNoGrip_C "Flag for enabling reserve torque depending on shift lever status" VALUE 0x80514640 Val_Wu8 1.000 OneToOne 0.00 1.000 FORMAT "%5.3" EXTENDED_LIMITS 0.00 255.0 /end CHARACTERISTIC
/begin CHARACTERISTIC Conv_flgSwtInGearSeln_C "Flag for selecting in gear information to control torque reserve end timing." VALUE 0x80514641 Val_Wu8 1.000 OneToOne 0.00 1.000 FORMAT "%5.3" EXTENDED_LIMITS 0.00 255.0 /end CHARACTERISTIC
/begin CHARACTERISTIC Conv_flgSwtOutGearSeln_C "Flag for selecting out gear information to control torque reserve end timing." VALUE 0x80514642 Val_Wu8 1.000 OneToOne 0.00 1.000 FORMAT "%5.3" EXTENDED_LIMITS 0.00 255.0 /end CHARACTERISTIC
/begin CHARACTERISTIC Conv_flgSwtSelnCURM_C "Flag for selecting Curve or Map in the calculation of converter load torque." VALUE 0x80514643 Val_Wu8 1.000 OneToOne 0.00 1.000 FORMAT "%5.3" EXTENDED_LIMITS 0.00 255.0 /end CHARACTERISTIC
/begin CHARACTERISTIC Conv_flgTrbnSpdDifSeln_C "Flag of turbine speed change (difference) selection of torque deceleration offset" VALUE 0x80514644 Val_Wu8 1.000 OneToOne 0.00 1.000 FORMAT "%5.3" EXTENDED_LIMITS 0.00 255.0 /end CHARACTERISTIC
/begin CHARACTERISTIC Conv_LvrOffDebP.tiHiLo_C "Debounce time of lever in D or R with a standing vehicle (Tra_numGear ==0) / Time for a High to Low transition" VALUE 0x8053A780 Kw_Ws16 65535.00 OneToOne -32768.00 32767.00 FORMAT "%8.2" /end CHARACTERISTIC
/begin CHARACTERISTIC Conv_LvrOffDebP.tiLoHi_C "Debounce time of lever in D or R with a standing vehicle (Tra_numGear ==0) / Time for a Low to High transition" VALUE 0x8053A782 Kw_Ws16 65535.00 OneToOne -32768.00 32767.00 FORMAT "%8.2" /end CHARACTERISTIC
/begin CHARACTERISTIC Conv_LvrPosChgDRDebT.tiHiLo_C "Structure pointing to the debounce parameter of gear lever shift from drive to reverse / Time for a High to Low transition" VALUE 0x8053A784 Kw_Ws16 65535.00 OneToOne -32768.00 32767.00 FORMAT "%8.2" /end CHARACTERISTIC
/begin CHARACTERISTIC Conv_LvrPosChgDRDebT.tiLoHi_C "Structure pointing to the debounce parameter of gear lever shift from drive to reverse / Time for a Low to High transition" VALUE 0x8053A786 Kw_Ws16 65535.00 OneToOne -32768.00 32767.00 FORMAT "%8.2" /end CHARACTERISTIC
/begin CHARACTERISTIC Conv_LvrPosChgRDDebT.tiHiLo_C "Structure pointing to the debounce parameter of gear lever shift from reverse to drive / Time for a High to Low transition" VALUE 0x8053A788 Kw_Ws16 65535.00 OneToOne -32768.00 32767.00 FORMAT "%8.2" /end CHARACTERISTIC
/begin CHARACTERISTIC Conv_LvrPosChgRDDebT.tiLoHi_C "Structure pointing to the debounce parameter of gear lever shift from reverse to drive / Time for a Low to High transition" VALUE 0x8053A78A Kw_Ws16 65535.00 OneToOne -32768.00 32767.00 FORMAT "%8.2" /end CHARACTERISTIC
/begin CHARACTERISTIC Conv_LvrPosOffDebP.tiHiLo_C "Structure pointing to the debounce parameter / Time for a High to Low transition" VALUE 0x8053A78C Kw_Ws16 65535.00 OneToOne -32768.00 32767.00 FORMAT "%8.2" /end CHARACTERISTIC
/begin CHARACTERISTIC Conv_LvrPosOffDebP.tiLoHi_C "Structure pointing to the debounce parameter / Time for a Low to High transition" VALUE 0x8053A78E Kw_Ws16 65535.00 OneToOne -32768.00 32767.00 FORMAT "%8.2" /end CHARACTERISTIC
/begin CHARACTERISTIC Conv_nDecelTqDifThdHi_C "Turbine speed change (difference) high threshold between turbine speed and engine speed of torque deceleration offset" VALUE 0x80514646 RB_Val_Ws16 32767.50 EngN -16384.00 16383.50 FORMAT "%8.2" /end CHARACTERISTIC
/begin CHARACTERISTIC Conv_nDecelTqDifThdLo_C "Turbine speed change (difference) low threshold between turbine speed and engine speed of torque deceleration offset" VALUE 0x80514648 RB_Val_Ws16 32767.50 EngN -16384.00 16383.50 FORMAT "%8.2" /end CHARACTERISTIC
/begin CHARACTERISTIC Conv_nDecelTqThdHi_C "High difference threshold between turbine speed and engine speed of torque deceleration offset" VALUE 0x8051464A RB_Val_Ws16 32767.50 EngN -16384.00 16383.50 FORMAT "%8.2" /end CHARACTERISTIC
/begin CHARACTERISTIC Conv_nDecelTqThdLo_C "Low difference threshold between turbine speed and engine speed of torque deceleration offset" VALUE 0x8051464C RB_Val_Ws16 32767.50 EngN -16384.00 16383.50 FORMAT "%8.2" /end CHARACTERISTIC
/begin CHARACTERISTIC Conv_nrTrbAvrg_C "The number of raster turbine speed Average change is calculated from (1-16)" VALUE 0x8051464E RB_Val_Wu8 255.0 OneToOne 0.00 255.0 FORMAT "%5.1" /end CHARACTERISTIC
/begin CHARACTERISTIC Conv_nTrbnLoLim_C "Lower limit turbine speed" VALUE 0x80514650 Val_Ws16 32767.50 EngN -16384.00 16383.50 FORMAT "%8.2" /end CHARACTERISTIC
/begin CHARACTERISTIC Conv_nTrbnMinCorrVal_C "minimum correction factor for turbine speed" VALUE 0x80514652 Val_Ws16 32767.50 EngN -16384.00 16383.50 FORMAT "%8.2" /end CHARACTERISTIC
/begin CHARACTERISTIC Conv_nTrbn_C "Turbine speed" VALUE 0x80514654 Val_Ws16 32767.50 EngN -16384.00 16383.50 FORMAT "%8.2" /end CHARACTERISTIC
/begin CHARACTERISTIC Conv_numLvrPosFwdGear_C "Lever position number of the drive gear" VALUE 0x80514656 Val_Wu8 255.0 OneToOne 0.00 255.0 FORMAT "%5.1" /end CHARACTERISTIC
/begin CHARACTERISTIC Conv_numLvrPosNeut_C "Lever position of the Neutral gear (dependent on the allocation of the gear lever information TT TYPE=VARIABLEGbx_stGearLvrTT)" VALUE 0x80514657 Val_Wu8 255.0 OneToOne 0.00 255.0 FORMAT "%5.1" /end CHARACTERISTIC
/begin CHARACTERISTIC Conv_numLvrPosPark_C "Lever position of the Parking (dependent on the allocation of the gear lever information TT TYPE=VARIABLEGbx_stGearLvrTT)" VALUE 0x80514658 Val_Wu8 255.0 OneToOne 0.00 255.0 FORMAT "%5.1" /end CHARACTERISTIC
/begin CHARACTERISTIC Conv_numLvrPosRevGear_C "Lever position number of the reverse gear" VALUE 0x80514659 Val_Wu8 255.0 OneToOne 0.00 255.0 FORMAT "%5.1" /end CHARACTERISTIC
/begin CHARACTERISTIC Conv_rDecelTqThd_C "Transmission ratio threshold of torque deceleration offset" VALUE 0x8051465A RB_Val_Ws16 655.3500 TransR -327.6800 327.6700 FORMAT "%8.4" /end CHARACTERISTIC
/begin CHARACTERISTIC Conv_rTrq_C "Parameter for converter transmission ratio." VALUE 0x80514B82 RB_Val_Ws16 655.3500 TransR -327.6800 327.6700 FORMAT "%8.4" /end CHARACTERISTIC
/begin CHARACTERISTIC Conv_stCalcNTrbnNStat_C "status of static turbine" VALUE 0x8051465C Val_Wu8 255.0 OneToOne 0.00 255.0 FORMAT "%5.1" /end CHARACTERISTIC
/begin CHARACTERISTIC Conv_stCylVrnt_C "Calibration to indicate the number of cyllinders configured in the project" VALUE 0x805148DA Val_Wu8 255.0 OneToOne 0.00 255.0 FORMAT "%5.1" /end CHARACTERISTIC
/begin CHARACTERISTIC Conv_stDecelTqBrk_C "Brake status of torque deceleration offset" VALUE 0x8051465D RB_Val_Wu8 255.0 OneToOne 0.00 255.0 FORMAT "%5.1" /end CHARACTERISTIC
/begin CHARACTERISTIC Conv_stSwtRedCnvrLoad_C "The switch to choose the velocity factor" VALUE 0x8051465E Val_Wu8 1.000 OneToOne 0.00 1.000 FORMAT "%5.3" EXTENDED_LIMITS 0.00 255.0 /end CHARACTERISTIC
/begin CHARACTERISTIC Conv_stTqResvDrvRevEna_C "Enable status of gear lever shift from Drive to Reverse and vice versa" VALUE 0x8051465F Val_Wu8 1.000 OneToOne 0.00 1.000 FORMAT "%5.3" EXTENDED_LIMITS 0.00 255.0 /end CHARACTERISTIC
/begin CHARACTERISTIC Conv_swtOilCoolrOfsSel_C "Converter oil cooler offset select switch" VALUE 0x80514660 Val_Wu8 255.0 OneToOne 0.00 255.0 FORMAT "%5.1" /end CHARACTERISTIC
/begin CHARACTERISTIC Conv_swtOilPmpLoss_C "Oil pump loss torque selection switch" VALUE 0x80514661 Val_Wu8 1.000 OneToOne 0.00 1.000 FORMAT "%5.3" EXTENDED_LIMITS 0.00 255.0 /end CHARACTERISTIC
/begin CHARACTERISTIC Conv_tiDecelTqMax_C "Maximum time of torque deceleration offset" VALUE 0x80514662 RB_Val_Ws16 655350.0 Time_ms -327680.0 327670.0 FORMAT "%8.1" /end CHARACTERISTIC
/begin CHARACTERISTIC Conv_tiDecelTqToffd_C "Turn off delay time of torque deceleration offset" VALUE 0x80514664 RB_Val_Ws16 655350.0 Time_ms -327680.0 327670.0 FORMAT "%8.1" /end CHARACTERISTIC
/begin CHARACTERISTIC Conv_tiDfl_C "Initial time value." VALUE 0x805148DC RB_Val_Ws16 655350.0 TimeDeb -327680.0 327670.0 FORMAT "%8.1" /end CHARACTERISTIC
/begin CHARACTERISTIC Conv_tiDwnRglPT1_GCUR "Filter time during the transistion of the gear selector lever from D to NP" CURVE 0x80514666 RB_CurveGroup_S16 10.00015 TimeDelay_s_Lin_16 -5.000153 5.000000 FORMAT "%8.6"
 /begin AXIS_DESCR COM_AXIS Conv_tOil Temp_Cels 10 -3549.940 3003.560 FORMAT "%8.3" AXIS_PTS_REF Conv_tOil_DST /end AXIS_DESCR
/end CHARACTERISTIC
/begin CHARACTERISTIC Conv_tiGearChgDRPT1_GCUR "Filter time during the transistion of the gear selector lever from D to R and vice versa" CURVE 0x8051467A RB_CurveGroup_S16 5.000000 TimeDelay_s_Lin_16 0.00 5.000000 FORMAT "%8.6" EXTENDED_LIMITS -5.000153 5.000000
 /begin AXIS_DESCR COM_AXIS Conv_tOil Temp_Cels 10 -3549.940 3003.560 FORMAT "%8.3" AXIS_PTS_REF Conv_tOil_DST /end AXIS_DESCR
/end CHARACTERISTIC
/begin CHARACTERISTIC Conv_tiGearChgDR_C "Turn on delay time when gear lever shift from drive to reverse" VALUE 0x8051468E Val_Ws16 655350.0 Time_ms -327680.0 327670.0 FORMAT "%8.1" /end CHARACTERISTIC
/begin CHARACTERISTIC Conv_tiGearChgRD_C "Turn on delay time when gear lever shift from reverse to drive" VALUE 0x80514690 Val_Ws16 655350.0 Time_ms -327680.0 327670.0 FORMAT "%8.1" /end CHARACTERISTIC
/begin CHARACTERISTIC Conv_tiLvrChgDrvRvs_GCUR "Temperature dependant debounce time of gear lever shift from drive to reverse" CURVE 0x805148DE RB_CurveGroup_S16 655350.0 TimeDeb -327680.0 327670.0 FORMAT "%8.1"
 /begin AXIS_DESCR COM_AXIS Conv_tOilBuf Temp_Cels 14 -3549.940 3003.560 FORMAT "%8.3" AXIS_PTS_REF Conv_tPntDST_AXIS /end AXIS_DESCR
/end CHARACTERISTIC
/begin CHARACTERISTIC Conv_tiLvrChgRvsDrv_GCUR "Temperature dependant debounce time of gear lever shift from reverse to drive" CURVE 0x805148FA RB_CurveGroup_S16 655350.0 TimeDeb -327680.0 327670.0 FORMAT "%8.1"
 /begin AXIS_DESCR COM_AXIS Conv_tOilBuf Temp_Cels 14 -3549.940 3003.560 FORMAT "%8.3" AXIS_PTS_REF Conv_tPntDST_AXIS /end AXIS_DESCR
/end CHARACTERISTIC
/begin CHARACTERISTIC Conv_tiNCtrlPT1_GCUR "Filter time for N Control Curve" CURVE 0x80514692 RB_CurveGroup_S16 10.00015 TimeDelay_s_Lin_16 -5.000153 5.000000 FORMAT "%8.6"
 /begin AXIS_DESCR COM_AXIS Conv_tOil Temp_Cels 10 -3549.940 3003.560 FORMAT "%8.3" AXIS_PTS_REF Conv_tOil_DST /end AXIS_DESCR
/end CHARACTERISTIC
/begin CHARACTERISTIC Conv_tiRevLvrOffNeut_GT "Debounce time vs temperature curve when transition from reverse gear to Neutral." CURVE 0x80514916 RB_CurveGroup_S16 655350.0 TimeDeb -327680.0 327670.0 FORMAT "%8.1"
 /begin AXIS_DESCR COM_AXIS Conv_tOilBuf Temp_Cels 14 -3549.940 3003.560 FORMAT "%8.3" AXIS_PTS_REF Conv_tPntDST_AXIS /end AXIS_DESCR
/end CHARACTERISTIC
/begin CHARACTERISTIC Conv_tiRevLvrOffPark_GT "Debounce time vs temperature curve when transition from reverse gear to Park." CURVE 0x80514932 RB_CurveGroup_S16 655350.0 TimeDeb -327680.0 327670.0 FORMAT "%8.1"
 /begin AXIS_DESCR COM_AXIS Conv_tOilBuf Temp_Cels 14 -3549.940 3003.560 FORMAT "%8.3" AXIS_PTS_REF Conv_tPntDST_AXIS /end AXIS_DESCR
/end CHARACTERISTIC
/begin CHARACTERISTIC Conv_tiRevLvrOn_GCUR "Debounce time temperature for reverse gear." CURVE 0x8051494E RB_CurveGroup_S16 655350.0 TimeDeb -327680.0 327670.0 FORMAT "%8.1"
 /begin AXIS_DESCR COM_AXIS Conv_tOilBuf Temp_Cels 14 -3549.940 3003.560 FORMAT "%8.3" AXIS_PTS_REF Conv_tPntDST_AXIS /end AXIS_DESCR
/end CHARACTERISTIC
/begin CHARACTERISTIC Conv_tiRTraGearPT1_C "Filter time constants for turbine speed" VALUE 0x805146A8 Val_Ws32 4294.9672940000000 TimeDelay_s 0.0000020000000 4294.9672959999998 FORMAT "%19.14" EXTENDED_LIMITS 0.000002000000001 4294.9672959999998 /end CHARACTERISTIC
/begin CHARACTERISTIC Conv_tiTempDepLvrOff_GCUR "Debounce time temperature for no gear engaged." CURVE 0x8051496A RB_CurveGroup_S16 655350.0 TimeDeb -327680.0 327670.0 FORMAT "%8.1"
 /begin AXIS_DESCR COM_AXIS Conv_tOilBuf Temp_Cels 14 -3549.940 3003.560 FORMAT "%8.3" AXIS_PTS_REF Conv_tPntDST_AXIS /end AXIS_DESCR
/end CHARACTERISTIC
/begin CHARACTERISTIC Conv_tiTempDepLvrOn2_GT "Debounce temperature gear engaged based on new gear engagement strategy" CURVE 0x80514986 RB_CurveGroup_S16 655350.0 TimeDeb -327680.0 327670.0 FORMAT "%8.1"
 /begin AXIS_DESCR COM_AXIS Conv_tOilBuf Temp_Cels 14 -3549.940 3003.560 FORMAT "%8.3" AXIS_PTS_REF Conv_tPntDST_AXIS /end AXIS_DESCR
/end CHARACTERISTIC
/begin CHARACTERISTIC Conv_tiTempDepLvrOn_GT "Debounce temperature gear engaged." CURVE 0x805149A2 RB_CurveGroup_S16 655350.0 TimeDeb -327680.0 327670.0 FORMAT "%8.1"
 /begin AXIS_DESCR COM_AXIS Conv_tOilBuf Temp_Cels 14 -3549.940 3003.560 FORMAT "%8.3" AXIS_PTS_REF Conv_tPntDST_AXIS /end AXIS_DESCR
/end CHARACTERISTIC
/begin CHARACTERISTIC Conv_tiTrqLdPT1_C "Filter time constants for torque load" VALUE 0x805146AC Val_Ws32 4294.9672940000000 TimeDelay_s 0.0000020000000 4294.9672959999998 FORMAT "%19.14" EXTENDED_LIMITS 0.000002000000001 4294.9672959999998 /end CHARACTERISTIC
/begin CHARACTERISTIC Conv_tiTrqResvPT1_GCUR "Filter time constants for torque reserve" CURVE 0x805146B0 RB_CurveGroup_S16 10.00015 TimeDelay_s_Lin_16 -5.000153 5.000000 FORMAT "%8.6"
 /begin AXIS_DESCR COM_AXIS Conv_tOil Temp_Cels 10 -3549.940 3003.560 FORMAT "%8.3" AXIS_PTS_REF Conv_tOil_DST /end AXIS_DESCR
/end CHARACTERISTIC
/begin CHARACTERISTIC Conv_tiUpRglPT1_GCUR "Filter time during the transistion of the gear selector lever from NP to D" CURVE 0x805146C4 RB_CurveGroup_S16 10.00015 TimeDelay_s_Lin_16 -5.000153 5.000000 FORMAT "%8.6"
 /begin AXIS_DESCR COM_AXIS Conv_tOil Temp_Cels 10 -3549.940 3003.560 FORMAT "%8.3" AXIS_PTS_REF Conv_tOil_DST /end AXIS_DESCR
/end CHARACTERISTIC
/begin AXIS_PTS Conv_tOil_DST "group axis points converter oil temperature" 0x805146D8 Conv_tOil RB_Axis_S16 6553.500 Temp_Cels 10 -3549.940 3003.560 FORMAT "%8.3" DEPOSIT ABSOLUTE /end AXIS_PTS
/begin AXIS_PTS Conv_tPntDST_AXIS "Temperature distribution converter" 0x805149BE Conv_tOilBuf RB_Axis_S16 6553.500 Temp_Cels 14 -3549.940 3003.560 FORMAT "%8.3" DEPOSIT ABSOLUTE /end AXIS_PTS
/begin CHARACTERISTIC Conv_tqDecelOffsRedn_C "Reduction amount of torque deceleration offset" VALUE 0x805146EE RB_Val_Ws16 6553.500 Trq -3276.800 3276.700 FORMAT "%8.3" /end CHARACTERISTIC
/begin CHARACTERISTIC Conv_tqDecelOffs_M "Torque map for deceleration offset" MAP 0x805146F0 RB_Map_S16S16_S16 6553.500 Trq -3276.800 3276.700 FORMAT "%8.3"
 /begin AXIS_DESCR STD_AXIS NO_INPUT_QUANTITY EngN 10 -16384.00 16383.50 FORMAT "%8.2" DEPOSIT ABSOLUTE /end AXIS_DESCR
 /begin AXIS_DESCR STD_AXIS Conv_tOil Temp_Cels 6 -3549.940 3003.560 FORMAT "%8.3" DEPOSIT ABSOLUTE /end AXIS_DESCR
/end CHARACTERISTIC
/begin CHARACTERISTIC Conv_tqResvTDpdtDRACOn_GCUR "Group cur of temperature dependant reserve torque during AC on for gear lever shift from drive to reverse and vice versa" CURVE 0x805149DC RB_CurveGroup_S16 6553.500 Trq -3276.800 3276.700 FORMAT "%8.3"
 /begin AXIS_DESCR COM_AXIS Conv_tOilBuf Temp_Cels 14 -3549.940 3003.560 FORMAT "%8.3" AXIS_PTS_REF Conv_tPntDST_AXIS /end AXIS_DESCR
/end CHARACTERISTIC
/begin CHARACTERISTIC Conv_tqResvTDpdtDR_GCUR "Group cur of temperature dependant reserve torque for gear lever shift from drive to reverse and vice versa" CURVE 0x805149F8 RB_CurveGroup_S16 6553.500 Trq -3276.800 3276.700 FORMAT "%8.3"
 /begin AXIS_DESCR COM_AXIS Conv_tOilBuf Temp_Cels 14 -3549.940 3003.560 FORMAT "%8.3" AXIS_PTS_REF Conv_tPntDST_AXIS /end AXIS_DESCR
/end CHARACTERISTIC
/begin CHARACTERISTIC Conv_trqDfl_C "Load torque parameter" VALUE 0x80514A14 RB_Val_Ws16 6553.500 Trq -3276.800 3276.700 FORMAT "%8.3" /end CHARACTERISTIC
/begin CHARACTERISTIC Conv_trqLdActv_CW "Code word for activation of the converter." VALUE 0x80514A16 RB_Val_Wu8 255.0 OneToOne 0.00 255.0 FORMAT "%5.1" /end CHARACTERISTIC
/begin CHARACTERISTIC Conv_trqLdGnFacHysDec_C "Offset for the reduction of the torque load" VALUE 0x8051478C Val_Ws16 6553.500 Trq -3276.800 3276.700 FORMAT "%8.3" /end CHARACTERISTIC
/begin CHARACTERISTIC Conv_trqLdLvrPosNeutr_GCUR "Load torque for low-idle." CURVE 0x80514A18 RB_CurveGroup_S16 6553.500 Trq -3276.800 3276.700 FORMAT "%8.3"
 /begin AXIS_DESCR COM_AXIS Conv_tOilBuf Temp_Cels 14 -3549.940 3003.560 FORMAT "%8.3" AXIS_PTS_REF Conv_tPntDST_AXIS /end AXIS_DESCR
/end CHARACTERISTIC
/begin CHARACTERISTIC Conv_trqLdMaxLim_MAP "Limitation of the torque load by CAN" MAP 0x8051478E RB_Map_S16S16_S16 6553.500 Trq -3276.800 3276.700 FORMAT "%8.3"
 /begin AXIS_DESCR STD_AXIS GlbDa_vXFlt Vel 10 -327.6800 327.6700 FORMAT "%8.4" DEPOSIT ABSOLUTE /end AXIS_DESCR
 /begin AXIS_DESCR STD_AXIS TS_tClntEngOut Temp_Cels 10 -3549.940 3003.560 FORMAT "%8.3" DEPOSIT ABSOLUTE /end AXIS_DESCR
/end CHARACTERISTIC
/begin CHARACTERISTIC Conv_trqLdReplCan_C "Substitution of the torque load in case of an error" VALUE 0x80514882 Val_Ws16 6553.500 Trq -3276.800 3276.700 FORMAT "%8.3" /end CHARACTERISTIC
/begin CHARACTERISTIC Conv_trqLdRevLvrPos_GCUR "Load torque for reverse gear." CURVE 0x80514A34 RB_CurveGroup_S16 6553.500 Trq -3276.800 3276.700 FORMAT "%8.3"
 /begin AXIS_DESCR COM_AXIS Conv_tOilBuf Temp_Cels 14 -3549.940 3003.560 FORMAT "%8.3" AXIS_PTS_REF Conv_tPntDST_AXIS /end AXIS_DESCR
/end CHARACTERISTIC
/begin CHARACTERISTIC Conv_trqLdTempDepLim_GCUR "Temperature dependant value for the limitation of the load torque." CURVE 0x80514A50 RB_CurveGroup_S16 6553.500 Trq -3276.800 3276.700 FORMAT "%8.3"
 /begin AXIS_DESCR COM_AXIS Conv_tOilBuf Temp_Cels 14 -3549.940 3003.560 FORMAT "%8.3" AXIS_PTS_REF Conv_tPntDST_AXIS /end AXIS_DESCR
/end CHARACTERISTIC
/begin CHARACTERISTIC Conv_trqLd_CW "Code word for load torque calculation" VALUE 0x80514A6C RB_Val_Wu8 255.0 OneToOne 0.00 255.0 FORMAT "%5.1" /end CHARACTERISTIC
/begin CHARACTERISTIC Conv_trqLosDfftl_map "map for Differential torque losses" MAP 0x80514A6E RB_Map_S16S16_S16 6553.500 TrqPrpHigh -3276.800 3276.700 FORMAT "%8.3"
 /begin AXIS_DESCR STD_AXIS GlbDa_vXFlt Vel 8 -327.6800 327.6700 FORMAT "%8.4" DEPOSIT ABSOLUTE /end AXIS_DESCR
 /begin AXIS_DESCR STD_AXIS Conv_tOil Temp_Cels 8 -3549.940 3003.560 FORMAT "%8.3" DEPOSIT ABSOLUTE /end AXIS_DESCR
/end CHARACTERISTIC
/begin CHARACTERISTIC Conv_TrqResvDebP.tiHiLo_C "Timer für CAN-Zulässigkeit / Time for a High to Low transition" VALUE 0x8053A790 Kw_Ws16 65535.00 OneToOne -32768.00 32767.00 FORMAT "%8.2" /end CHARACTERISTIC
/begin CHARACTERISTIC Conv_TrqResvDebP.tiLoHi_C "Timer für CAN-Zulässigkeit / Time for a Low to High transition" VALUE 0x8053A792 Kw_Ws16 65535.00 OneToOne -32768.00 32767.00 FORMAT "%8.2" /end CHARACTERISTIC
/begin CHARACTERISTIC Conv_trqResvLoLim_C "minimum value of the torque reserve" VALUE 0x80514884 Val_Ws16 6553.500 Trq -3276.800 3276.700 FORMAT "%8.3" /end CHARACTERISTIC
/begin CHARACTERISTIC Conv_trqResvMaxLim_C "Limitation of the torque reserve" VALUE 0x80514886 Val_Ws16 6553.500 Trq -3276.800 3276.700 FORMAT "%8.3" /end CHARACTERISTIC
/begin CHARACTERISTIC Conv_trqResvMinLim_C "Limitation of the torque reserve" VALUE 0x80514888 Val_Ws16 6553.500 Trq -3276.800 3276.700 FORMAT "%8.3" /end CHARACTERISTIC
/begin CHARACTERISTIC Conv_trqResvNeutrLvrPos_C "minimum value of the moment reserve if the selector level position is neutral" VALUE 0x8051488A Val_Ws16 6553.500 Trq -3276.800 3276.700 FORMAT "%8.3" /end CHARACTERISTIC
/begin CHARACTERISTIC Conv_trqResvPreFlt_C "pre-filtered value of the torque load for additional torque reserve" VALUE 0x8051488C Val_Ws16 6553.500 Trq -3276.800 3276.700 FORMAT "%8.3" /end CHARACTERISTIC
/begin CHARACTERISTIC Conv_trqResvRepl_C "Subsitution of the torque reserve" VALUE 0x8051488E Val_Ws16 6553.500 Trq -3276.800 3276.700 FORMAT "%8.3" /end CHARACTERISTIC
/begin CHARACTERISTIC Conv_trqResvTempDep2_GT "Temperature dependant reserve torque based on new gear engagement strategy" CURVE 0x80514B12 RB_CurveGroup_S16 6553.500 Trq -3276.800 3276.700 FORMAT "%8.3"
 /begin AXIS_DESCR COM_AXIS Conv_tOilBuf Temp_Cels 14 -3549.940 3003.560 FORMAT "%8.3" AXIS_PTS_REF Conv_tPntDST_AXIS /end AXIS_DESCR
/end CHARACTERISTIC
/begin CHARACTERISTIC Conv_trqResvTempDepACOn2_GT "Temperature dependant reserve torque during AC on based on new gear engagement strategy" CURVE 0x80514B2E RB_CurveGroup_S16 6553.500 Trq -3276.800 3276.700 FORMAT "%8.3"
 /begin AXIS_DESCR COM_AXIS Conv_tOilBuf Temp_Cels 14 -3549.940 3003.560 FORMAT "%8.3" AXIS_PTS_REF Conv_tPntDST_AXIS /end AXIS_DESCR
/end CHARACTERISTIC
/begin CHARACTERISTIC Conv_trqResvTempDepACOn_GT "Temperature dependant reserve torque during AC on" CURVE 0x80514B4A RB_CurveGroup_S16 6553.500 Trq -3276.800 3276.700 FORMAT "%8.3"
 /begin AXIS_DESCR COM_AXIS Conv_tOilBuf Temp_Cels 14 -3549.940 3003.560 FORMAT "%8.3" AXIS_PTS_REF Conv_tPntDST_AXIS /end AXIS_DESCR
/end CHARACTERISTIC
/begin CHARACTERISTIC Conv_trqResvTempDep_GT "Temperature dependant reserve torque." CURVE 0x80514B66 RB_CurveGroup_S16 6553.500 Trq -3276.800 3276.700 FORMAT "%8.3"
 /begin AXIS_DESCR COM_AXIS Conv_tOilBuf Temp_Cels 14 -3549.940 3003.560 FORMAT "%8.3" AXIS_PTS_REF Conv_tPntDST_AXIS /end AXIS_DESCR
/end CHARACTERISTIC
/begin CHARACTERISTIC Conv_trqStatSqLvrPosNeutr_C "Pump torque if the selector level position is neutral" VALUE 0x80514890 Val_Ws16 6553.500 Trq -3276.800 3276.700 FORMAT "%8.3" /end CHARACTERISTIC
/begin CHARACTERISTIC Conv_vDecelTqThdHi_C "Vehicle velocity high threshold of torque deceleration offset" VALUE 0x80514892 RB_Val_Ws16 655.3500 Vel -327.6800 327.6700 FORMAT "%8.4" /end CHARACTERISTIC
/begin CHARACTERISTIC Conv_vDecelTqThdLo_C "Vehicle velocity low threshold of torque deceleration offset" VALUE 0x80514894 RB_Val_Ws16 655.3500 Vel -327.6800 327.6700 FORMAT "%8.4" /end CHARACTERISTIC
/begin CHARACTERISTIC CoPOM_cntAbortStrtrLim_C "Fault start count threshold for the conventional starter, above which a different start behaviour is set based on how the driverdoes the cranking." VALUE 0x8050994C RB_Val_Wu8 255.0 OneToOne 0.00 255.0 FORMAT "%5.1" /end CHARACTERISTIC
/begin CHARACTERISTIC CoPOM_flgPsdBrkPedlRqrdForT50Strt_C "Pressed brake pedal is required for starting the engine with T50" VALUE 0x80509944 RB_Val_Wu8 1.00000000000 B_TRUE 0.00 1.00000000000 FORMAT "%13.11" /end CHARACTERISTIC
/begin CHARACTERISTIC CoPOM_flgStrtRelsDurgT50_C "Flag to enforce drivetrain is open when T50 is requested from driver for a successful start request." VALUE 0x80509945 RB_Val_Wu8 1.00000000000 B_TRUE 0.00 1.00000000000 FORMAT "%13.11" /end CHARACTERISTIC
/begin CHARACTERISTIC CoPOM_tiDlyNxtStrtAftAbort_C "Minimum delay which needs to be elapsed before starter will be available again after an abort." VALUE 0x8050994E RB_Val_Ws16 655.3500 t_q0p01 -327.6800 327.6700 FORMAT "%8.4" /end CHARACTERISTIC
/begin CHARACTERISTIC CoPOM_tiPanicStrtReq_C "Time threshold to indicate the that the driver is requesting a Panic start" VALUE 0x80509946 RB_Val_Ws16 655.3500 Time_s -327.6800 327.6700 FORMAT "%8.4" /end CHARACTERISTIC
/begin CHARACTERISTIC CoPOM_tiStrtrOperMaxFault_C "Maximum duration (based on Engine temperature) for which the starter can be operated, above which the start will be aborted when the number of aborted engine starts have reached a threshold," VALUE 0x80509950 RB_Val_Ws16 655.3500 t_q0p01 -327.6800 327.6700 FORMAT "%8.4" /end CHARACTERISTIC
/begin CHARACTERISTIC CoPOM_tiStrtrOperMax_T "Maximum duration (based on Engine temperature) for which the starter can be operated, above which the start will be aborted" CURVE 0x80509952 RB_Curve_S16_S16 655.3500 t_q0p01 -327.6800 327.6700 FORMAT "%8.4"
 /begin AXIS_DESCR STD_AXIS CEngDsT_t Temp_Cels 6 -3549.940 3003.560 FORMAT "%8.3" DEPOSIT ABSOLUTE /end AXIS_DESCR
/end CHARACTERISTIC
/begin CHARACTERISTIC CoPOM_tiT50ReqCnclDly_C "Delay time for enabling the cancellation of the memorized T50 request, based on the PT closed status." VALUE 0x80509948 RB_Val_Ws16 655.3500 Time_s -327.6800 327.6700 FORMAT "%8.4" /end CHARACTERISTIC
/begin CHARACTERISTIC CoPOM_tiT50ReqPreDrvCnclDly_C "Waiting time before a T50 request is canceled when Pre-Drive to Drive transition is delayed" VALUE 0x8050994A RB_Val_Ws16 655.3500 Time_s -327.6800 327.6700 FORMAT "%8.4" /end CHARACTERISTIC
/begin CHARACTERISTIC CoPOM_tqStrtDevStrtr_C "Available starting torque starter" VALUE 0x8050996C RB_Val_Ws16 6553.500 Trq -3276.800 3276.700 FORMAT "%8.3" /end CHARACTERISTIC
/begin CHARACTERISTIC CoTemp_rClgDes_CUR "Curve for cooling requirement of the combustion, input engine temperature" CURVE 0x805099AC RB_Curve_S16_S16 799.9878 Prc -400.0000 399.9878 FORMAT "%8.4"
 /begin AXIS_DESCR STD_AXIS EngDa_tEng Temp_Cels 5 -3549.940 3003.560 FORMAT "%8.3" DEPOSIT ABSOLUTE /end AXIS_DESCR
/end CHARACTERISTIC
/begin CHARACTERISTIC CoTemp_tEngClntAftRunDes_C "Coolant temperature of combustion engine during afterrun" VALUE 0x805099C2 RB_Val_Ws16 6553.500 Temp_Cels -3549.940 3003.560 FORMAT "%8.3" /end CHARACTERISTIC
/begin CHARACTERISTIC CoTemp_tEngClntIniDes_C "Initialisation value of Coolant temperature of combustion engine" VALUE 0x805099C4 RB_Val_Ws16 6553.500 Temp_Cels -3549.940 3003.560 FORMAT "%8.3" /end CHARACTERISTIC
/begin CHARACTERISTIC CoTemp_tEngDesBaseNTrq_MAP "MAP for coolant temperature of combustion engine, based on engine speed and set torque" MAP 0x805099C6 RB_Map_S16S16_S16 6553.500 Temp_Cels -3549.940 3003.560 FORMAT "%8.3"
 /begin AXIS_DESCR STD_AXIS Epm_nEng EngN 10 -16384.00 16383.50 FORMAT "%8.2" DEPOSIT ABSOLUTE /end AXIS_DESCR
 /begin AXIS_DESCR STD_AXIS PthSet_trqInrSet Trq 10 -3276.800 3276.700 FORMAT "%8.3" DEPOSIT ABSOLUTE /end AXIS_DESCR
/end CHARACTERISTIC
/begin CHARACTERISTIC CoTemp_tEngDesBaseTempVel_MAP "MAP for coolant temperature of combustion engine, based on engine temperature and vehicle speed" MAP 0x80509ABA RB_Map_S16S16_S16 6553.500 Temp_Cels -3549.940 3003.560 FORMAT "%8.3"
 /begin AXIS_DESCR STD_AXIS EnvT_t Temp_Cels 6 -3549.940 3003.560 FORMAT "%8.3" DEPOSIT ABSOLUTE /end AXIS_DESCR
 /begin AXIS_DESCR STD_AXIS VehV_v Vel 8 -327.6800 327.6700 FORMAT "%8.4" DEPOSIT ABSOLUTE /end AXIS_DESCR
/end CHARACTERISTIC
/begin CHARACTERISTIC CoTS_rhoEnvAirThresDelta_C "Air density delta treshold: Debouncing of Stop-Enable" VALUE 0x8050996E RB_Val_Ws16 65.53500 Dens_q0p001_COMPU -32.76800 32.76700 FORMAT "%8.5" /end CHARACTERISTIC
/begin CHARACTERISTIC CoTS_rhoEnvAirThresLo_C "Air Density: Lower treshold for Stop Enable" VALUE 0x80509970 RB_Val_Ws16 65.53500 Dens_q0p001_COMPU -32.76800 32.76700 FORMAT "%8.5" /end CHARACTERISTIC
/begin CHARACTERISTIC CoTS_rhoStopEna_MAP "Map: Calculation of air density to calculate Stop Enable" MAP 0x80509972 RB_Map_S16S16_S16 65.53500 Dens_q0p001_COMPU -32.76800 32.76700 FORMAT "%8.5"
 /begin AXIS_DESCR STD_AXIS EnvP_p Pres_hPa 2 -32768.00 32767.00 FORMAT "%8.2" DEPOSIT ABSOLUTE /end AXIS_DESCR
 /begin AXIS_DESCR STD_AXIS EnvT_t Temp_Cels 4 -3549.940 3003.560 FORMAT "%8.3" DEPOSIT ABSOLUTE /end AXIS_DESCR
/end CHARACTERISTIC
/begin CHARACTERISTIC CoTS_tClntEngOutDes_C "Substituete value of tClntEngOutDes in case of error." VALUE 0x805099A0 RB_Val_Ws16 6553.500 Temp_Cels -3549.940 3003.560 FORMAT "%8.3" /end CHARACTERISTIC
/begin CHARACTERISTIC CoTS_tClntStopThresDelta_C "Engine temperature delta treshold: Debouncing of Stopp Enable" VALUE 0x80509992 RB_Val_Ws16 3276.700 Temp_Cels -273.140 3003.560 FORMAT "%8.3" EXTENDED_LIMITS -3549.940 3003.560 /end CHARACTERISTIC
/begin CHARACTERISTIC CoTS_tClntStopThresHi_C "Engine temperature treshold: Upper treshold of Stop Enable" VALUE 0x80509994 RB_Val_Ws16 3276.700 Temp_Cels -273.140 3003.560 FORMAT "%8.3" EXTENDED_LIMITS -3549.940 3003.560 /end CHARACTERISTIC
/begin CHARACTERISTIC CoTS_tClntStopThresLo_C "Engine temperature treshold: Lower treshold of Stop Enable" VALUE 0x80509996 RB_Val_Ws16 3276.700 Temp_Cels -273.140 3003.560 FORMAT "%8.3" EXTENDED_LIMITS -3549.940 3003.560 /end CHARACTERISTIC
/begin CHARACTERISTIC CoTS_tClntStrtThresDelta_C "Engine temperature delta treshold: Debouncing of Start Request" VALUE 0x80509998 RB_Val_Ws16 3276.700 Temp_Cels -273.140 3003.560 FORMAT "%8.3" EXTENDED_LIMITS -3549.940 3003.560 /end CHARACTERISTIC
/begin CHARACTERISTIC CoTS_tClntStrtThresHi_C "Engine temperature treshold: Upper treshold of Start Request" VALUE 0x8050999A RB_Val_Ws16 3276.700 Temp_Cels -273.140 3003.560 FORMAT "%8.3" EXTENDED_LIMITS -3549.940 3003.560 /end CHARACTERISTIC
/begin CHARACTERISTIC CoTS_tClntStrtThresLo_C "Engine temperature treshold: Lower treshold of Start Request" VALUE 0x8050999C RB_Val_Ws16 3276.700 Temp_Cels -273.140 3003.560 FORMAT "%8.3" EXTENDED_LIMITS -3549.940 3003.560 /end CHARACTERISTIC
/begin CHARACTERISTIC CoTS_tiPT1Neg_C "Time constant for negative gradients of CoVeh_tClntDes." VALUE 0x805099A4 RB_Val_Ws32 4294.9672940000000 TimeDelay_s 0.0000020000000 4294.9672959999998 FORMAT "%19.14" EXTENDED_LIMITS 0.000002000000001 4294.9672959999998 /end CHARACTERISTIC
/begin CHARACTERISTIC CoTS_tiPT1Pos_C "Time constant for positive gradients of CoVeh_tClntDes." VALUE 0x805099A8 RB_Val_Ws32 4294.9672940000000 TimeDelay_s 0.0000020000000 4294.9672959999998 FORMAT "%19.14" EXTENDED_LIMITS 0.000002000000001 4294.9672959999998 /end CHARACTERISTIC
/begin CHARACTERISTIC Gbx_stNCtrl_CW "Gearbox N Control selection parameter" VALUE 0x80514896 Val_Wu8 255.0 OneToOne 0.00 255.0 FORMAT "%5.1" /end CHARACTERISTIC
/begin CHARACTERISTIC Gbx_stOilPmpFlt_CW "Oil pump load filter selection parameter" VALUE 0x80514897 Val_Wu8 255.0 OneToOne 0.00 255.0 FORMAT "%5.1" /end CHARACTERISTIC
/begin CHARACTERISTIC Gbx_stOilPmp_CW "Oil pump load selection parameter" VALUE 0x80514898 Val_Wu8 255.0 OneToOne 0.00 255.0 FORMAT "%5.1" /end CHARACTERISTIC
/begin CHARACTERISTIC Gbx_tiOilPmpTrq_C "Oil pump load filter timing parameter" VALUE 0x8051489C Val_Ws32 4294.9672940000000 TimeDelay_s 0.0000020000000 4294.9672959999998 FORMAT "%19.14" EXTENDED_LIMITS 0.000002000000001 4294.9672959999998 /end CHARACTERISTIC
/begin MEASUREMENT B_staanf_msg "Condition Start Request (StartStop)" UBYTE B_TRUE 1 100 0.00 1.00000000000 BIT_MASK 0x1 FORMAT "%13.11" ECU_ADDRESS 0x6000A22F /end MEASUREMENT
/begin MEASUREMENT B_stoanf_msg "Condition Start-Stop stop request" UBYTE B_TRUE 1 100 0.00 1.00000000000 BIT_MASK 0x1 FORMAT "%13.11" ECU_ADDRESS 0x6000A22E /end MEASUREMENT
/begin MEASUREMENT Com_bAYCCond "Received AYC active condition status" UBYTE OneToOne 1 100 0.00 255.0 FORMAT "%5.1" ECU_ADDRESS 0x6000A63D /end MEASUREMENT
/begin MEASUREMENT Com_bAYCReWr "VSA unit re-writing status" UBYTE OneToOne 1 100 0.00 255.0 FORMAT "%5.1" ECU_ADDRESS 0x6000A63C /end MEASUREMENT
/begin MEASUREMENT Com_bBrkPedON "EBB brake pedal ON" UBYTE OneToOne 1 100 0.00 255.0 FORMAT "%5.1" ECU_ADDRESS 0x6000A63A /end MEASUREMENT
/begin MEASUREMENT Com_bTSCIntvSlow "Transmission requested torque down - Control Mode for Air" UBYTE OneToOne 1 100 0.00 255.0 FORMAT "%5.1" ECU_ADDRESS 0x6000A637 /end MEASUREMENT
/begin MEASUREMENT Com_ctCRingAYCA "Ring counter for frame AYCA" UBYTE OneToOne 1 100 0.00 255.0 FORMAT "%5.1" ECU_ADDRESS 0x6000A635 /end MEASUREMENT
/begin MEASUREMENT Com_ctCRingAYCF "AYCF frame Ring counter message" UBYTE OneToOne 1 100 0.00 255.0 FORMAT "%5.1" ECU_ADDRESS 0x70001C3A /end MEASUREMENT
/begin MEASUREMENT Com_ctCRingAYCG "Ring counter for AYCG frame" UBYTE OneToOne 1 100 0.00 255.0 FORMAT "%5.1" ECU_ADDRESS 0x6000075E /end MEASUREMENT
/begin MEASUREMENT Com_ctCRingAYCI "Ring counter for AYCI frame" UBYTE OneToOne 1 100 0.00 255.0 FORMAT "%5.1" ECU_ADDRESS 0x70001C39 /end MEASUREMENT
/begin MEASUREMENT Com_ctCRingCGW1 "CGW1 Ring Counter" UBYTE OneToOne 1 100 0.00 255.0 FORMAT "%5.1" ECU_ADDRESS 0x6000A634 /end MEASUREMENT
/begin MEASUREMENT Com_ctCRingEAT1 "Can Ring counter for EAT1 frame" UBYTE OneToOne 1 100 0.00 255.0 FORMAT "%5.1" ECU_ADDRESS 0x70001C38 /end MEASUREMENT
/begin MEASUREMENT Com_ctCRingEAT10 "CAN Ring counter for EAT10 frame" UBYTE OneToOne 1 100 0.00 255.0 FORMAT "%5.1" ECU_ADDRESS 0x6000A633 /end MEASUREMENT
/begin MEASUREMENT Com_ctCRingEAT11 "Can Ring counter for EAT11 frame" UBYTE OneToOne 1 100 0.00 255.0 FORMAT "%5.1" ECU_ADDRESS 0x6000A632 /end MEASUREMENT
/begin MEASUREMENT Com_ctCRingEAT12 "EAT12 Ring counter" UBYTE OneToOne 1 100 0.00 255.0 FORMAT "%5.1" ECU_ADDRESS 0x6000A631 /end MEASUREMENT
/begin MEASUREMENT Com_ctCRingEAT13 "EAT13 Ring counter" UBYTE OneToOne 1 100 0.00 255.0 FORMAT "%5.1" ECU_ADDRESS 0x6000A630 /end MEASUREMENT
/begin MEASUREMENT Com_ctCRingEAT2 "Ring Counter for frame EAT2" UBYTE OneToOne 1 100 0.00 255.0 FORMAT "%5.1" ECU_ADDRESS 0x70001C37 /end MEASUREMENT
/begin MEASUREMENT Com_ctCRingEAT4 "Ring counter for EAT4 frame" UBYTE OneToOne 1 100 0.00 255.0 FORMAT "%5.1" ECU_ADDRESS 0x6000A62F /end MEASUREMENT
/begin MEASUREMENT Com_ctCRingEAT6 "Can Ring counter for EAT6 frame" UBYTE OneToOne 1 100 0.00 255.0 FORMAT "%5.1" ECU_ADDRESS 0x6000A62E /end MEASUREMENT
/begin MEASUREMENT Com_ctCRingEAT7 "Can Ring counter for EAT7 frame" UBYTE OneToOne 1 100 0.00 255.0 FORMAT "%5.1" ECU_ADDRESS 0x6000A62D /end MEASUREMENT
/begin MEASUREMENT Com_ctCRingEAT8 "Can Ring counter for EAT8 frame" UBYTE OneToOne 1 100 0.00 255.0 FORMAT "%5.1" ECU_ADDRESS 0x6000A62C /end MEASUREMENT
/begin MEASUREMENT Com_ctCRingEATA "Ring counter for frame EATA" UBYTE OneToOne 1 100 0.00 255.0 FORMAT "%5.1" ECU_ADDRESS 0x6000A62B /end MEASUREMENT
/begin MEASUREMENT Com_ctCRingEATB "ring counter for EATB frame" UBYTE OneToOne 1 100 0.00 255.0 FORMAT "%5.1" ECU_ADDRESS 0x6000A62A /end MEASUREMENT
/begin MEASUREMENT Com_ctCRingEATC "Ring Counter for EATC" UBYTE OneToOne 1 100 0.00 255.0 FORMAT "%5.1" ECU_ADDRESS 0x6000A629 /end MEASUREMENT
/begin MEASUREMENT Com_ctCRingEBBA "Ring counter of frame EBBA" UBYTE OneToOne 1 100 0.00 255.0 FORMAT "%5.1" ECU_ADDRESS 0x6000A628 /end MEASUREMENT
/begin MEASUREMENT Com_ctCRingEPS1 "Ring counter for EPS1 frame" UBYTE OneToOne 1 100 0.00 255.0 FORMAT "%5.1" ECU_ADDRESS 0x6000A60C /end MEASUREMENT
/begin MEASUREMENT Com_ctCRingGwIMG1 "Ring Counter for GWIMG1 frame" UBYTE OneToOne 1 100 0.00 255.0 FORMAT "%5.1" ECU_ADDRESS 0x60000760 /end MEASUREMENT
/begin MEASUREMENT Com_ctCRingGwIMG3 "Ring Counter for GWIMG3 frame" UBYTE OneToOne 1 100 0.00 3.000 FORMAT "%5.3" ECU_ADDRESS 0x6000A60B /end MEASUREMENT
/begin MEASUREMENT Com_ctCRingGwIMG4 "Ring Counter for GWIMG4 frame" UBYTE OneToOne 1 100 0.00 255.0 FORMAT "%5.1" ECU_ADDRESS 0x70001C36 /end MEASUREMENT
/begin MEASUREMENT Com_ctCRingGwIMG5 "Ring counter for IMG5 frame" UBYTE OneToOne 1 100 0.00 255.0 FORMAT "%5.1" ECU_ADDRESS 0x6000A60A /end MEASUREMENT
/begin MEASUREMENT Com_ctCRingGwIMG6 "Ring counter for frame GwIMG6" UBYTE OneToOne 1 100 0.00 255.0 FORMAT "%5.1" ECU_ADDRESS 0x6000A609 /end MEASUREMENT
/begin MEASUREMENT Com_ctCRingIDASB "Ringcounter value of IDASB frame" UBYTE OneToOne 1 100 0.00 255.0 FORMAT "%5.1" ECU_ADDRESS 0x6000A608 /end MEASUREMENT
/begin MEASUREMENT Com_ctCRingPCU "Ring counter for PCU frame" UBYTE OneToOne 1 100 0.00 255.0 FORMAT "%5.1" ECU_ADDRESS 0x6000A5FC /end MEASUREMENT
/begin MEASUREMENT Com_flgACCutDurgAtCvt "AC cut demand" UBYTE B_TRUE 1 100 0.00 1.00000000000 BIT_MASK 0x1 FORMAT "%13.11" ECU_ADDRESS 0x6000A5EE /end MEASUREMENT
/begin MEASUREMENT Com_flgCvtFcoPrms "Transmission deceleration fuel cutoff approved" UBYTE OneToOne 1 100 0.00 255.0 FORMAT "%5.1" ECU_ADDRESS 0x6000A5EA /end MEASUREMENT
/begin MEASUREMENT Com_flgExecdManMod "Manual mode execution flag" UBYTE OneToOne 1 100 0.00 255.0 FORMAT "%5.1" ECU_ADDRESS 0x6000A5E8 /end MEASUREMENT
/begin MEASUREMENT Com_iElecLd "EPS load current" SWORD Curr_A 1 100 -327.6800 327.6700 FORMAT "%8.4" ECU_ADDRESS 0x600051BA /end MEASUREMENT
/begin MEASUREMENT Com_lTotRingEATA "Travelled distance" ULONG Length 1 100 0.00 4294967295.00 FORMAT "%13.2" ECU_ADDRESS 0x50004C00 /end MEASUREMENT
/begin MEASUREMENT Com_nIdlDes "Engine Speed Request" SWORD EngN 1 100 -16384.00 16383.50 FORMAT "%8.2" ECU_ADDRESS 0x600051B0 /end MEASUREMENT
/begin MEASUREMENT Com_nTrbn "CAN message for Turbine Speed" UWORD DFES_nPID0C 1 100 0.00 16383.75 FORMAT "%8.2" ECU_ADDRESS 0x60004D74 /end MEASUREMENT
/begin MEASUREMENT Com_nTrsmMaiShaft "Transmission main shaft speed" SLONG EngN 1 100 -1073741824.00 1073741823.50 FORMAT "%13.2" ECU_ADDRESS 0x60001D2C /end MEASUREMENT
/begin MEASUREMENT Com_numCsumAYCA "Checksum message for frame AYCA" UBYTE OneToOne 1 100 0.00 255.0 FORMAT "%5.1" ECU_ADDRESS 0x6000A5D8 /end MEASUREMENT
/begin MEASUREMENT Com_numCsumAYCD "Checksum for AYCD frame" UBYTE OneToOne 1 100 0.00 255.0 FORMAT "%5.1" ECU_ADDRESS 0x70001C34 /end MEASUREMENT
/begin MEASUREMENT Com_numCsumAYCF "Checksum message for frame AYCF" UBYTE OneToOne 1 100 0.00 255.0 FORMAT "%5.1" ECU_ADDRESS 0x60000761 /end MEASUREMENT
/begin MEASUREMENT Com_numCsumAYCG "Checksum message for AYCG frame" UBYTE OneToOne 1 100 0.00 255.0 FORMAT "%5.1" ECU_ADDRESS 0x70001C33 /end MEASUREMENT
/begin MEASUREMENT Com_numCsumAYCI "Checksum for AYCI frame" UBYTE OneToOne 1 100 0.00 255.0 FORMAT "%5.1" ECU_ADDRESS 0x60000762 /end MEASUREMENT
/begin MEASUREMENT Com_numCsumCGW1 "CGW1 Checksum" UBYTE OneToOne 1 100 0.00 255.0 FORMAT "%5.1" ECU_ADDRESS 0x6000A5D7 /end MEASUREMENT
/begin MEASUREMENT Com_numCsumEAT1 "Checksum message for frame EAT1" UBYTE OneToOne 1 100 0.00 255.0 FORMAT "%5.1" ECU_ADDRESS 0x70001C32 /end MEASUREMENT
/begin MEASUREMENT Com_numCsumEAT10 "Check sum for EAT10 frame" UBYTE OneToOne 1 100 0.00 255.0 FORMAT "%5.1" ECU_ADDRESS 0x6000A5D6 /end MEASUREMENT
/begin MEASUREMENT Com_numCsumEAT11 "Check sum for EAT11 frame" UBYTE OneToOne 1 100 0.00 255.0 FORMAT "%5.1" ECU_ADDRESS 0x6000A5D5 /end MEASUREMENT
/begin MEASUREMENT Com_numCsumEAT12 "EAT12 checksum" UBYTE OneToOne 1 100 0.00 255.0 FORMAT "%5.1" ECU_ADDRESS 0x6000A5D4 /end MEASUREMENT
/begin MEASUREMENT Com_numCsumEAT13 "EAT13 Checksum" UBYTE OneToOne 1 100 0.00 255.0 FORMAT "%5.1" ECU_ADDRESS 0x6000A5D3 /end MEASUREMENT
/begin MEASUREMENT Com_numCsumEAT2 "Checksum message for frame EAT2" UBYTE OneToOne 1 100 0.00 255.0 FORMAT "%5.1" ECU_ADDRESS 0x70001C31 /end MEASUREMENT
/begin MEASUREMENT Com_numCsumEAT4 "Checksum message for EAT4 frame" UBYTE OneToOne 1 100 0.00 255.0 FORMAT "%5.1" ECU_ADDRESS 0x6000A5D2 /end MEASUREMENT
/begin MEASUREMENT Com_numCsumEAT6 "Check sum for EAT6 frame" UBYTE OneToOne 1 100 0.00 255.0 FORMAT "%5.1" ECU_ADDRESS 0x6000A5D1 /end MEASUREMENT
/begin MEASUREMENT Com_numCsumEAT7 "Check sum for EAT7 frame" UBYTE OneToOne 1 100 0.00 255.0 FORMAT "%5.1" ECU_ADDRESS 0x6000A5D0 /end MEASUREMENT
/begin MEASUREMENT Com_numCsumEAT8 "Check sum for EAT8 frame" UBYTE OneToOne 1 100 0.00 255.0 FORMAT "%5.1" ECU_ADDRESS 0x6000A5CF /end MEASUREMENT
/begin MEASUREMENT Com_numCsumEATA "Checksum message for frame EATA" UBYTE OneToOne 1 100 0.00 255.0 FORMAT "%5.1" ECU_ADDRESS 0x6000A5CE /end MEASUREMENT
/begin MEASUREMENT Com_numCsumEATB "checksum for EATB frame" UBYTE OneToOne 1 100 0.00 255.0 FORMAT "%5.1" ECU_ADDRESS 0x6000A5CD /end MEASUREMENT
/begin MEASUREMENT Com_numCsumEATC "Checksum for EATC" UBYTE OneToOne 1 100 0.00 255.0 FORMAT "%5.1" ECU_ADDRESS 0x6000A5CC /end MEASUREMENT
/begin MEASUREMENT Com_numCsumEBBA "Check sum of frame EBBA" UBYTE OneToOne 1 100 0.00 255.0 FORMAT "%5.1" ECU_ADDRESS 0x6000A5CB /end MEASUREMENT
/begin MEASUREMENT Com_numCsumEPS1 "Checksum message for EPS1 frame" UBYTE OneToOne 1 100 0.00 255.0 FORMAT "%5.1" ECU_ADDRESS 0x6000A5B0 /end MEASUREMENT
/begin MEASUREMENT Com_numCsumGwIMG1 "Message for Checksum of GWIMG1 frame" UBYTE OneToOne 1 100 0.00 255.0 FORMAT "%5.1" ECU_ADDRESS 0x60000764 /end MEASUREMENT
/begin MEASUREMENT Com_numCsumGwIMG3 "Message for checksum of GWIMG3 frame" UBYTE OneToOne 1 100 0.00 15.00 FORMAT "%5.2" ECU_ADDRESS 0x6000A5AF /end MEASUREMENT
/begin MEASUREMENT Com_numCsumGwIMG4 "Message for checksum of GWIMG4 frame" UBYTE OneToOne 1 100 0.00 255.0 FORMAT "%5.1" ECU_ADDRESS 0x60000765 /end MEASUREMENT
/begin MEASUREMENT Com_numCsumGwIMG5 "IMG5 checksum message" UBYTE OneToOne 1 100 0.00 255.0 FORMAT "%5.1" ECU_ADDRESS 0x6000A5AE /end MEASUREMENT
/begin MEASUREMENT Com_numCsumGwIMG6 "Checksum message for frame GwIMG6" UBYTE OneToOne 1 100 0.00 255.0 FORMAT "%5.1" ECU_ADDRESS 0x6000A5AD /end MEASUREMENT
/begin MEASUREMENT Com_numCsumIDASB "Checksum value of IDASB frame" UBYTE OneToOne 1 100 0.00 255.0 FORMAT "%5.1" ECU_ADDRESS 0x6000A5AC /end MEASUREMENT
/begin MEASUREMENT Com_numCsumPCU "" UBYTE OneToOne 1 100 0.00 255.0 FORMAT "%5.1" ECU_ADDRESS 0x6000A5A0 /end MEASUREMENT
/begin MEASUREMENT Com_numCvtGearShiftMap "CVT cruise gear shift MAP No" UBYTE OneToOne 1 100 0.00 255.0 FORMAT "%5.1" ECU_ADDRESS 0x6000A59D /end MEASUREMENT
/begin MEASUREMENT Com_pMstCyl "VSA master cylinder pressure" SWORD Pres_kPa_VSA 1 100 -785121.3 785097.3 FORMAT "%8.1" ECU_ADDRESS 0x600051AA /end MEASUREMENT
/begin MEASUREMENT Com_rConvBoostRaw "raw message for torque converter boost information" UWORD Com_Fact_b0p00006 1 100 0.00 3.999939 FORMAT "%8.6" ECU_ADDRESS 0x70001CFE /end MEASUREMENT
/begin MEASUREMENT Com_rConvSlip "Torque convertor slip ratio information recievend oner CAN" UWORD CrCtlSlipRat 1 100 0.00 327.6750 FORMAT "%8.4" ECU_ADDRESS 0x60004D6A /end MEASUREMENT
/begin MEASUREMENT Com_rCVTAct "Current CVT ratio" SWORD TransR_COMPU 1 100 -512.0000 511.9844 FORMAT "%8.4" ECU_ADDRESS 0x60005196 /end MEASUREMENT
/begin MEASUREMENT Com_rTarInfo "Target ratio information" UBYTE TransR_COMPU 1 100 0.00 3.984 FORMAT "%5.3" ECU_ADDRESS 0x6000A597 /end MEASUREMENT
/begin MEASUREMENT Com_rTarPllyEAT7 "Target pulley ratio" UBYTE TransR_COMPU 1 100 0.00 3.984 FORMAT "%5.3" ECU_ADDRESS 0x6000A596 /end MEASUREMENT
/begin MEASUREMENT Com_rTrsmTotFild "Filtered T/M overall ratio" UWORD Fact_2pwr11 1 100 0.00 31.99951 FORMAT "%8.5" ECU_ADDRESS 0x60004D66 /end MEASUREMENT
/begin MEASUREMENT Com_stABSCtrl "ABS control" UBYTE OneToOne 1 100 0.00 255.0 FORMAT "%5.1" ECU_ADDRESS 0x6000A594 /end MEASUREMENT
/begin MEASUREMENT Com_stABSEBDFailr "ABS, EBD failure status" UBYTE OneToOne 1 100 0.00 255.0 FORMAT "%5.1" ECU_ADDRESS 0x6000A593 /end MEASUREMENT
/begin MEASUREMENT Com_stABSWrn "ABS warning status from VSA" UBYTE OneToOne 1 100 0.00 255.0 FORMAT "%5.1" ECU_ADDRESS 0x6000A592 /end MEASUREMENT
/begin MEASUREMENT Com_stACCBrk "Automatic brake actuated by VSA" UBYTE OneToOne 1 100 0.00 255.0 FORMAT "%5.1" ECU_ADDRESS 0x6000A58D /end MEASUREMENT
/begin MEASUREMENT Com_stActABSEBD "VSA ABS plus EBD activation status" UBYTE OneToOne 1 100 0.00 255.0 FORMAT "%5.1" ECU_ADDRESS 0x6000A575 /end MEASUREMENT
/begin MEASUREMENT Com_stAmbLmpPrms "Ambient display: ECON OK signal via CAN" UBYTE OneToOne 1 100 0.00 255.0 FORMAT "%5.1" ECU_ADDRESS 0x6000A571 /end MEASUREMENT
/begin MEASUREMENT Com_stATFailr "AT Failure" UBYTE OneToOne 1 100 0.00 255.0 FORMAT "%5.1" ECU_ADDRESS 0x6000A57F /end MEASUREMENT
/begin MEASUREMENT Com_stATFTVal "Status for ATF Temperature value" UBYTE OneToOne 1 100 0.00 255.0 FORMAT "%5.1" ECU_ADDRESS 0x6000A580 /end MEASUREMENT
/begin MEASUREMENT Com_stATMILReqEAT8 "Status of MIL request from AT unit for EAT8" UBYTE OneToOne 1 100 0.00 1.000 BIT_MASK 0x1 FORMAT "%5.3" ECU_ADDRESS 0x70000AE0 /end MEASUREMENT
/begin MEASUREMENT Com_stAYCF "VSA shift control request" UBYTE OneToOne 1 100 0.00 255.0 FORMAT "%5.1" ECU_ADDRESS 0x60000766 /end MEASUREMENT
/begin MEASUREMENT Com_stAYCFShiftReq "VSA shift control request" UBYTE OneToOne 1 100 0.00 255.0 FORMAT "%5.1" ECU_ADDRESS 0x60000767 /end MEASUREMENT
/begin MEASUREMENT Com_stBrkPedON "EBB brake Pedal ON status" UBYTE OneToOne 1 100 0.00 255.0 FORMAT "%5.1" ECU_ADDRESS 0x6000A567 /end MEASUREMENT
/begin MEASUREMENT Com_stCarAcsSysActv "Car acess sysytem active" UBYTE OneToOne 1 100 0.00 255.0 FORMAT "%5.1" ECU_ADDRESS 0x6000A55A /end MEASUREMENT
/begin MEASUREMENT Com_stCarAcsSysPtdOper "Car acess system operation" UBYTE OneToOne 1 100 0.00 255.0 FORMAT "%5.1" ECU_ADDRESS 0x6000A559 /end MEASUREMENT
/begin MEASUREMENT Com_stCfmdNPosn "Confirmed N Position" UBYTE OneToOne 1 100 0.00 255.0 FORMAT "%5.1" ECU_ADDRESS 0x6000A558 /end MEASUREMENT
/begin MEASUREMENT Com_stCfmdPPosnFCAN "F-CAN confirmed P position" UBYTE OneToOne 1 100 0.00 255.0 FORMAT "%5.1" ECU_ADDRESS 0x6000A556 /end MEASUREMENT
/begin MEASUREMENT Com_stCfmdPPosnPTCAN "PT-CAN Parking postion" UBYTE OneToOne 1 100 0.00 255.0 FORMAT "%5.1" ECU_ADDRESS 0x6000A555 /end MEASUREMENT
/begin MEASUREMENT Com_stClrCmplInfoVINRegst "IMG request clear status" UBYTE OneToOne 1 100 0.00 255.0 FORMAT "%5.1" ECU_ADDRESS 0x6000A552 /end MEASUREMENT
/begin MEASUREMENT Com_stCVTDsplGear "CVT lever position information" UBYTE OneToOne 1 100 0.00 255.0 FORMAT "%5.1" ECU_ADDRESS 0x6000A562 /end MEASUREMENT
/begin MEASUREMENT Com_stCVTEngmtInfo "Drive train engagement information for ISAB ( CVT PT engagement information )" UBYTE OneToOne 1 100 0.00 255.0 FORMAT "%5.1" ECU_ADDRESS 0x70001C2F /end MEASUREMENT
/begin MEASUREMENT Com_stCVTFailr "CVT failure" UBYTE OneToOne 1 100 0.00 255.0 FORMAT "%5.1" ECU_ADDRESS 0x6000A561 /end MEASUREMENT
/begin MEASUREMENT Com_stCVTFailrInfo "CVT failure information" UBYTE OneToOne 1 100 0.00 255.0 FORMAT "%5.1" ECU_ADDRESS 0x6000A560 /end MEASUREMENT
/begin MEASUREMENT Com_stCvtPosnPrms "Select lever position for CC for CVT" UBYTE OneToOne 1 100 0.00 255.0 FORMAT "%5.1" ECU_ADDRESS 0x6000A54C /end MEASUREMENT
/begin MEASUREMENT Com_stCVTShiftActv "CVT Shift Active status" UBYTE OneToOne 1 100 0.00 255.0 FORMAT "%5.1" ECU_ADDRESS 0x6000A55F /end MEASUREMENT
/begin MEASUREMENT Com_stDCSPlusAYCF "Positive torque request" UBYTE OneToOne 1 100 0.00 255.0 FORMAT "%5.1" ECU_ADDRESS 0x60000768 /end MEASUREMENT
/begin MEASUREMENT Com_stDFailrIndcn "blinking D for failure code indication" UBYTE OneToOne 1 100 0.00 255.0 FORMAT "%5.1" ECU_ADDRESS 0x6000A549 /end MEASUREMENT
/begin MEASUREMENT Com_stEBB "EBB Status" UBYTE OneToOne 1 100 0.00 255.0 FORMAT "%5.1" ECU_ADDRESS 0x6000A538 /end MEASUREMENT
/begin MEASUREMENT Com_stEngCanRxErr "Information of CAN recieve error status" UBYTE OneToOne 1 100 0.00 255.0 BIT_MASK 0x1 FORMAT "%5.1" ECU_ADDRESS 0x60000769 /end MEASUREMENT
/begin MEASUREMENT Com_stEPS1ISSRelsReq "Idle Stop Release Request" UBYTE OneToOne 1 100 0.00 255.0 FORMAT "%5.1" ECU_ADDRESS 0x6000A52F /end MEASUREMENT
/begin MEASUREMENT Com_stEPSISSInhbReq "ISS inhibit Request from EPS" UBYTE OneToOne 1 100 0.00 255.0 FORMAT "%5.1" ECU_ADDRESS 0x6000A52E /end MEASUREMENT
/begin MEASUREMENT Com_stEPSMidReq "Grow lights WLP status" UBYTE OneToOne 1 100 0.00 255.0 FORMAT "%5.1" ECU_ADDRESS 0x6000A52C /end MEASUREMENT
/begin MEASUREMENT Com_stFailMstCylPSnsr "VSA brake master cylinder pressure sensor fail status" UBYTE OneToOne 1 100 0.00 255.0 FORMAT "%5.1" ECU_ADDRESS 0x6000A518 /end MEASUREMENT
/begin MEASUREMENT Com_stFrntLeWhlSpdSnsrErr "Front Left wheel speed sensor error status" UBYTE OneToOne 1 100 0.00 1.000 BIT_MASK 0x1 FORMAT "%5.3" ECU_ADDRESS 0x70000ADF /end MEASUREMENT
/begin MEASUREMENT Com_stFrntRiWhlSpdSnsrErr "Front right wheel speed sensor error status" UBYTE OneToOne 1 100 0.00 1.000 BIT_MASK 0x1 FORMAT "%5.3" ECU_ADDRESS 0x70000ADE /end MEASUREMENT
/begin MEASUREMENT Com_stFuCtrlReqRaw "Raw value of Fuel control request signal" UBYTE OneToOne 1 100 0.00 255.0 FORMAT "%5.1" ECU_ADDRESS 0x6000076A /end MEASUREMENT
/begin MEASUREMENT Com_stFwdRvsCluInfo "Status of forward/reverse clutch fastened" UBYTE OneToOne 1 100 0.00 255.0 FORMAT "%5.1" ECU_ADDRESS 0x6000A505 /end MEASUREMENT
/begin MEASUREMENT Com_stGearChgCtrlMod "Value of Gear Change Control mode status" UBYTE OneToOne 1 100 0.00 255.0 FORMAT "%5.1" ECU_ADDRESS 0x6000A502 /end MEASUREMENT
/begin MEASUREMENT Com_stGearPPosnReqPTCAN "Request for Gear Position P" UBYTE OneToOne 1 100 0.00 255.0 FORMAT "%5.1" ECU_ADDRESS 0x6000A501 /end MEASUREMENT
/begin MEASUREMENT Com_stHvyDecelFlg "Judgement flag for rapid fastened" UBYTE OneToOne 1 100 0.00 255.0 FORMAT "%5.1" ECU_ADDRESS 0x6000A4FF /end MEASUREMENT
/begin MEASUREMENT Com_stIdleStrtStopDispFct "Idle startstop display function" UBYTE OneToOne 1 100 0.00 255.0 FORMAT "%5.1" ECU_ADDRESS 0x70001C2E /end MEASUREMENT
/begin MEASUREMENT Com_stIMGACCBrkReq "IMG ACC Brake Request" UBYTE OneToOne 1 100 0.00 255.0 FORMAT "%5.1" ECU_ADDRESS 0x6000A4F8 /end MEASUREMENT
/begin MEASUREMENT Com_stIMGDrvTq "IMG drive arbiration status" UBYTE OneToOne 1 100 0.00 3.000 FORMAT "%5.3" ECU_ADDRESS 0x6000A4F7 /end MEASUREMENT
/begin MEASUREMENT Com_stIMGECUIG1 "IMG-ECU IG1 status" UBYTE OneToOne 1 100 0.00 255.0 FORMAT "%5.1" ECU_ADDRESS 0x6000A4F6 /end MEASUREMENT
/begin MEASUREMENT Com_stIMGIDSDrvMod "Group A5 Drive Mode Status" UBYTE OneToOne 1 100 0.00 255.0 FORMAT "%5.1" ECU_ADDRESS 0x6000076B /end MEASUREMENT
/begin MEASUREMENT Com_stIMGISBrkCntrADAS "IMG Idle Stop Brake Counter status" UBYTE OneToOne 1 100 0.00 1.000 FORMAT "%5.3" ECU_ADDRESS 0x6000A4F5 /end MEASUREMENT
/begin MEASUREMENT Com_stIMGISBrkHldActv "Message holds the Brake hold operation in progress information" UBYTE OneToOne 1 100 0.00 255.0 FORMAT "%5.1" ECU_ADDRESS 0x6000076C /end MEASUREMENT
/begin MEASUREMENT Com_stIMGISBrkHldStb "Message for Brake hold system standby information" UBYTE OneToOne 1 100 0.00 255.0 FORMAT "%5.1" ECU_ADDRESS 0x6000076D /end MEASUREMENT
/begin MEASUREMENT Com_stIMGISInhbBrk "Message for Idle stop control prohibition request by brake information" UBYTE OneToOne 1 100 0.00 255.0 FORMAT "%5.1" ECU_ADDRESS 0x6000076E /end MEASUREMENT
/begin MEASUREMENT Com_stIMGISRlsReq "Message fro IMG Idle stop Release Request status" UBYTE OneToOne 1 100 0.00 1.000 FORMAT "%5.3" ECU_ADDRESS 0x6000A4F4 /end MEASUREMENT
/begin MEASUREMENT Com_stIMGISRstrtInhbBrk "Message for Idle stop return control prohibition request by brake" UBYTE OneToOne 1 100 0.00 255.0 FORMAT "%5.1" ECU_ADDRESS 0x6000076F /end MEASUREMENT
/begin MEASUREMENT Com_stIMGISShiftInhbBrk "Message for Idle stop shift control prohibition request by brake" UBYTE OneToOne 1 100 0.00 255.0 FORMAT "%5.1" ECU_ADDRESS 0x60000770 /end MEASUREMENT
/begin MEASUREMENT Com_stIMGISSysOffBrk "Message for Idle stop system off request by brake information" UBYTE OneToOne 1 100 0.00 255.0 FORMAT "%5.1" ECU_ADDRESS 0x60000771 /end MEASUREMENT
/begin MEASUREMENT Com_stIMGLimTq "IMG suppression Torque Status" UBYTE OneToOne 1 100 0.00 7.000 FORMAT "%5.3" ECU_ADDRESS 0x6000A4F3 /end MEASUREMENT
/begin MEASUREMENT Com_stIMGMILReq "Status of MIL request from IMG unit" UBYTE B_TRUE 1 100 0.00 1.00000000000 BIT_MASK 0x1 FORMAT "%13.11" ECU_ADDRESS 0x6000A4F2 /end MEASUREMENT
/begin MEASUREMENT Com_stIMGShiftReq "IMG Shift Request" UBYTE OneToOne 1 100 0.00 255.0 FORMAT "%5.1" ECU_ADDRESS 0x6000A4F1 /end MEASUREMENT
/begin MEASUREMENT Com_stInhbMstCylPSnsr "VSA brake master cylinder pressure sensor inhibition status" UBYTE OneToOne 1 100 0.00 255.0 FORMAT "%5.1" ECU_ADDRESS 0x6000A4E8 /end MEASUREMENT
/begin MEASUREMENT Com_stISABActAYCI "ISAB operation status from AYCI" UBYTE OneToOne 1 100 0.00 255.0 FORMAT "%5.1" ECU_ADDRESS 0x60000772 /end MEASUREMENT
/begin MEASUREMENT Com_stISABasSpd "ISA Base Speed Status" UBYTE OneToOne 1 100 0.00 255.0 FORMAT "%5.1" ECU_ADDRESS 0x6000A4EE /end MEASUREMENT
/begin MEASUREMENT Com_stISABEnaAYCI "ISAB permission status from AYCI" UBYTE OneToOne 1 100 0.00 255.0 FORMAT "%5.1" ECU_ADDRESS 0x60000773 /end MEASUREMENT
/begin MEASUREMENT Com_stLatGASensInh "Inhibition status of Lateral G sensor ." UBYTE OneToOne 1 100 0.00 1.000 FORMAT "%5.3" ECU_ADDRESS 0x6000A4E5 /end MEASUREMENT
/begin MEASUREMENT Com_stLCInfo "L/C information recieved over CAN" UBYTE OneToOne 1 100 0.00 255.0 FORMAT "%5.1" ECU_ADDRESS 0x6000A4E7 /end MEASUREMENT
/begin MEASUREMENT Com_stLCZone "Lock up clutch Zone status" UBYTE OneToOne 1 100 0.00 255.0 FORMAT "%5.1" ECU_ADDRESS 0x60000774 /end MEASUREMENT
/begin MEASUREMENT Com_stLgtGASensErr "Longitudinal G Sensor error status" UBYTE OneToOne 1 100 0.00 255.0 FORMAT "%5.1" ECU_ADDRESS 0x70000ADD /end MEASUREMENT
/begin MEASUREMENT Com_stLgtGASensInh "Inhibition status of Longitudinal G sensor" UBYTE OneToOne 1 100 0.00 255.0 FORMAT "%5.1" ECU_ADDRESS 0x70000ADC /end MEASUREMENT
/begin MEASUREMENT Com_stMilLtgReq "MIL lighting request from transmission" UBYTE OneToOne 1 100 0.00 255.0 FORMAT "%5.1" ECU_ADDRESS 0x6000A4DA /end MEASUREMENT
/begin MEASUREMENT Com_stMissSnsrFlg "Missing Sensor Flag" UBYTE OneToOne 1 100 0.00 255.0 FORMAT "%5.1" ECU_ADDRESS 0x6000A4D8 /end MEASUREMENT
/begin MEASUREMENT Com_stMLtgInfo "M lighting information for S-MATIC vehicle/meter indication" UBYTE OneToOne 1 100 0.00 255.0 FORMAT "%5.1" ECU_ADDRESS 0x60000775 /end MEASUREMENT
/begin MEASUREMENT Com_stNotTxDrvgFFCAN "F-CAN Driving force" UBYTE OneToOne 1 100 0.00 255.0 FORMAT "%5.1" ECU_ADDRESS 0x6000A4CB /end MEASUREMENT
/begin MEASUREMENT Com_stNotTxDrvgFPTCAN "PT-CAN driving force information" UBYTE OneToOne 1 100 0.00 255.0 FORMAT "%5.1" ECU_ADDRESS 0x6000A4CA /end MEASUREMENT
/begin MEASUREMENT Com_stPCUEngStrtInhb "The status of engine start inhibition flag" UBYTE OneToOne 1 100 0.00 255.0 FORMAT "%5.1" ECU_ADDRESS 0x6000A4C4 /end MEASUREMENT
/begin MEASUREMENT Com_stPreStop "Precondition for start-stop approved by CVT" UBYTE OneToOne 1 100 0.00 255.0 FORMAT "%5.1" ECU_ADDRESS 0x70001C2D /end MEASUREMENT
/begin MEASUREMENT Com_stReLeWhlSpdSnsrErr "Rear Left wheel speed sensor error status" UBYTE OneToOne 1 100 0.00 1.000 BIT_MASK 0x1 FORMAT "%5.3" ECU_ADDRESS 0x70000ADB /end MEASUREMENT
/begin MEASUREMENT Com_stReRiWhlSpdSnsrErr "Rear Right wheel speed sensor error status" UBYTE OneToOne 1 100 0.00 1.000 BIT_MASK 0x1 FORMAT "%5.3" ECU_ADDRESS 0x70000ADA /end MEASUREMENT
/begin MEASUREMENT Com_stShftInD "Actual transmission position for D-range" UBYTE OneToOne 1 100 0.00 255.0 FORMAT "%5.1" ECU_ADDRESS 0x6000A4A5 /end MEASUREMENT
/begin MEASUREMENT Com_stShftInL "Status of position L for shifting" UBYTE OneToOne 1 100 0.00 255.0 FORMAT "%5.1" ECU_ADDRESS 0x6000A4A4 /end MEASUREMENT
/begin MEASUREMENT Com_stShftInNeutr "Actual transmission position for N-range" UBYTE OneToOne 1 100 0.00 255.0 FORMAT "%5.1" ECU_ADDRESS 0x6000A4A3 /end MEASUREMENT
/begin MEASUREMENT Com_stShftInPark "Actual transmission position for P-range" UBYTE OneToOne 1 100 0.00 255.0 FORMAT "%5.1" ECU_ADDRESS 0x6000A4A2 /end MEASUREMENT
/begin MEASUREMENT Com_stShftInRev "Actual transmission position for R-range" UBYTE OneToOne 1 100 0.00 255.0 FORMAT "%5.1" ECU_ADDRESS 0x6000A4A1 /end MEASUREMENT
/begin MEASUREMENT Com_stShftInS "Actual transmission position for S-range" UBYTE OneToOne 1 100 0.00 255.0 FORMAT "%5.1" ECU_ADDRESS 0x6000A4A0 /end MEASUREMENT
/begin MEASUREMENT Com_stShiftDwnReco "Shift down recommendation for GSI" UBYTE OneToOne 1 100 0.00 255.0 FORMAT "%5.1" ECU_ADDRESS 0x6000A49D /end MEASUREMENT
/begin MEASUREMENT Com_stShiftPosnIndcnRaw "CAN Raw value for Shift position indication for S-Matic" UBYTE OneToOne 1 100 0.00 255.0 FORMAT "%5.1" ECU_ADDRESS 0x6000A49B /end MEASUREMENT
/begin MEASUREMENT Com_stShiftUpReco "Shift up recommendation for GSI" UBYTE OneToOne 1 100 0.00 255.0 FORMAT "%5.1" ECU_ADDRESS 0x6000A49A /end MEASUREMENT
/begin MEASUREMENT Com_stSpdSnsrFailr "Speed Sensor Failure" UBYTE OneToOne 1 100 0.00 255.0 FORMAT "%5.1" ECU_ADDRESS 0x6000A495 /end MEASUREMENT
/begin MEASUREMENT Com_stSteerSnsrInhb "Steering angle sensor temporary inhibition" UBYTE OneToOne 1 100 0.00 1.000 FORMAT "%5.3" ECU_ADDRESS 0x6000A492 /end MEASUREMENT
/begin MEASUREMENT Com_stTCUECUIG1 "TCU-ECU IG1 status" UBYTE OneToOne 1 100 0.00 255.0 FORMAT "%5.1" ECU_ADDRESS 0x6000A48C /end MEASUREMENT
/begin MEASUREMENT Com_stTMTqDwnReq "TM torque down request" UBYTE OneToOne 1 100 0.00 255.0 FORMAT "%5.1" ECU_ADDRESS 0x6000A48A /end MEASUREMENT
/begin MEASUREMENT Com_stTranStop "Transition condition for start-stop approved by CVT" UBYTE OneToOne 1 100 0.00 255.0 FORMAT "%5.1" ECU_ADDRESS 0x70001C2C /end MEASUREMENT
/begin MEASUREMENT Com_stTrsmFailMod "The status of transmission failure mode" UBYTE OneToOne 1 100 0.00 255.0 FORMAT "%5.1" ECU_ADDRESS 0x6000A47F /end MEASUREMENT
/begin MEASUREMENT Com_stVehSpdSensErr "Unplausibility condition from vehicle velocity sensor over CAN" UBYTE OneToOne 1 100 0.00 255.0 FORMAT "%5.1" ECU_ADDRESS 0x6000A462 /end MEASUREMENT
/begin MEASUREMENT Com_stVehSpdSnsr "CVT vehicle speed sensor" UBYTE OneToOne 1 100 0.00 255.0 FORMAT "%5.1" ECU_ADDRESS 0x6000A461 /end MEASUREMENT
/begin MEASUREMENT Com_stVINWrClrDone "VIN write clear done status" UBYTE OneToOne 1 100 0.00 255.0 BIT_MASK 0x1 FORMAT "%5.1" ECU_ADDRESS 0x6000A47C /end MEASUREMENT
/begin MEASUREMENT Com_stVSACtrl "VSA control" UBYTE OneToOne 1 100 0.00 255.0 FORMAT "%5.1" ECU_ADDRESS 0x6000A477 /end MEASUREMENT
/begin MEASUREMENT Com_stVSAInh "VSA inhibit from TM request status" UBYTE OneToOne 1 100 0.00 255.0 FORMAT "%5.1" ECU_ADDRESS 0x70000AD8 /end MEASUREMENT
/begin MEASUREMENT Com_stVSALampOff "VSA lamp off status" UBYTE OneToOne 1 100 0.00 255.0 FORMAT "%5.1" ECU_ADDRESS 0x6000A46A /end MEASUREMENT
/begin MEASUREMENT Com_stVSATCSFailr "VSA tcs failure information" UBYTE OneToOne 1 100 0.00 255.0 FORMAT "%5.1" ECU_ADDRESS 0x6000A467 /end MEASUREMENT
/begin MEASUREMENT Com_stYawRateSnsrErr "Status of yaw rate sensor error" UBYTE OneToOne 1 100 0.00 1.000 BIT_MASK 0x1 FORMAT "%5.3" ECU_ADDRESS 0x70000AD7 /end MEASUREMENT
/begin MEASUREMENT Com_stYawRateSnsrInhb "Yaw rate sensor temporary inhibition" UBYTE OneToOne 1 100 0.00 255.0 FORMAT "%5.1" ECU_ADDRESS 0x70000AD6 /end MEASUREMENT
/begin MEASUREMENT Com_tqBrkOperAYCG "Driver Input torque from AYCG frame" UWORD RBPtCel_tq_1p0_1 1 100 0.00 65535.00 FORMAT "%8.2" ECU_ADDRESS 0x70001CFC /end MEASUREMENT
/begin MEASUREMENT Com_tqBrkOperAYCI "Driver Input torque from AYCI Frame" UWORD RBPtCel_tq_1p0_1 1 100 0.00 65535.00 FORMAT "%8.2" ECU_ADDRESS 0x600004F8 /end MEASUREMENT
/begin MEASUREMENT Com_tqIMGReqDrv "Message for IMG drive request torque" SWORD TrqPerSec 1 100 -32768.00 32767.00 FORMAT "%8.2" ECU_ADDRESS 0x60005170 /end MEASUREMENT
/begin MEASUREMENT Com_tqIMGSuppReq "IMG Request Suppression Torque" SWORD Trq_float 1 100 -32768.00 32767.00 FORMAT "%8.2" ECU_ADDRESS 0x6000516E /end MEASUREMENT
/begin MEASUREMENT Com_trqAYCFDes "Crankshaft torque" SLONG trq_q0p1 1 100 -214748364.800 214748364.700 FORMAT "%13.3" ECU_ADDRESS 0x60000334 /end MEASUREMENT
/begin MEASUREMENT Com_trqEATReq "EAT request torque" SWORD Trq 1 100 -3276.800 3276.700 FORMAT "%8.3" ECU_ADDRESS 0x60005164 /end MEASUREMENT
/begin MEASUREMENT Com_uBattDetnIMGECU "Battery detection voltage of IMG ECU" UWORD q0p01_V 1 100 0.00 655.3500 FORMAT "%8.4" ECU_ADDRESS 0x60004D58 /end MEASUREMENT
/begin MEASUREMENT Com_uBattDetnTCUECU "Battery detection voltage of TCU ECU" UWORD q0p01_V 1 100 0.00 655.3500 FORMAT "%8.4" ECU_ADDRESS 0x60004D56 /end MEASUREMENT
/begin MEASUREMENT Com_uIG1DetnIMGECU "IG1 detection voltage value of IMG-ECU" UWORD q0p01_V 1 100 0.00 655.3500 FORMAT "%8.4" ECU_ADDRESS 0x60004D52 /end MEASUREMENT
/begin MEASUREMENT Com_uIG1DetnTCUECU "IG1 detection voltage value of TCU-ECU" UWORD q0p01_V 1 100 0.00 655.3500 FORMAT "%8.4" ECU_ADDRESS 0x60004D50 /end MEASUREMENT
/begin MEASUREMENT Com_vFLWhlSpd "Front Left Wheel Speed value" UWORD OneToOne 1 100 0.00 65535.00 FORMAT "%8.2" ECU_ADDRESS 0x70001CFA /end MEASUREMENT
/begin MEASUREMENT Com_vFRWhlSpd "Front Right Wheel Speed value" UWORD OneToOne 1 100 0.00 65535.00 FORMAT "%8.2" ECU_ADDRESS 0x70001CF8 /end MEASUREMENT
/begin MEASUREMENT Com_vRLWhlSpd "Rear Left Wheel Speed value" UWORD OneToOne 1 100 0.00 65535.00 FORMAT "%8.2" ECU_ADDRESS 0x70001CF6 /end MEASUREMENT
/begin MEASUREMENT Com_vRRWhlSpd "Rear Right Wheel Speed value" UWORD OneToOne 1 100 0.00 65535.00 FORMAT "%8.2" ECU_ADDRESS 0x70001CF4 /end MEASUREMENT
/begin MEASUREMENT Com_vVehCtl "Vehicle speed for control" SWORD Vel 1 100 -327.6800 327.6700 FORMAT "%8.4" ECU_ADDRESS 0x60005150 /end MEASUREMENT
/begin MEASUREMENT Com_vVehInstPnl "Vehicle speed for instrument panel" SWORD Vel 1 100 -327.6800 327.6700 FORMAT "%8.4" ECU_ADDRESS 0x6000514E /end MEASUREMENT
/begin MEASUREMENT Com_vVehSpdCVTCtrl "CVT control used vehicle speed" UWORD Vel_CrCtl 1 100 0.00 255.9961 FORMAT "%8.4" ECU_ADDRESS 0x600004FC /end MEASUREMENT
/begin MEASUREMENT Com_vVehTcu "vehicle speed from TCU2" UWORD Vel_CrCtl 1 100 0.00 255.9961 FORMAT "%8.4" ECU_ADDRESS 0x60004D4A /end MEASUREMENT
/begin MEASUREMENT Conv_bCalc "flag for torque reserve and torque load calculation" UBYTE OneToOne 1 100 0.00 255.0 FORMAT "%5.1" ECU_ADDRESS 0x6000A081 /end MEASUREMENT
/begin MEASUREMENT Conv_bCalcActv_mp "Flag for calculation active" UBYTE OneToOne 1 100 0.00 255.0 FORMAT "%5.1" ECU_ADDRESS 0x7000922C /end MEASUREMENT
/begin MEASUREMENT Conv_bConvActv "Flag for converter active/inactive." UBYTE OneToOne 1 100 0.00 255.0 FORMAT "%5.1" ECU_ADDRESS 0x6000E405 /end MEASUREMENT
/begin MEASUREMENT Conv_bGearOff "Flag for load torque." UBYTE OneToOne 1 100 0.00 255.0 FORMAT "%5.1" ECU_ADDRESS 0x6000A080 /end MEASUREMENT
/begin MEASUREMENT Conv_bLvrPosDebRD_mp "Flag for debounced selector lever position (in R or D)" UBYTE OneToOne 1 100 0.00 255.0 FORMAT "%5.1" ECU_ADDRESS 0x7000922B /end MEASUREMENT
/begin MEASUREMENT Conv_bLvrPosRD_mp "Flag for selector lever position (in R or D)" UBYTE OneToOne 1 100 0.00 255.0 FORMAT "%5.1" ECU_ADDRESS 0x7000922A /end MEASUREMENT
/begin MEASUREMENT Conv_bRevLvrPos "Flag for reverse gear status" UBYTE OneToOne 1 100 0.00 255.0 FORMAT "%5.1" ECU_ADDRESS 0x6000A452 /end MEASUREMENT
/begin MEASUREMENT Conv_bTrbnSpdCan "Flag for turbine speed using CAN." UBYTE OneToOne 1 100 0.00 255.0 FORMAT "%5.1" ECU_ADDRESS 0x6000A07F /end MEASUREMENT
/begin MEASUREMENT Conv_bTrqLdCan "Flag for load torque using CAN." UBYTE OneToOne 1 100 0.00 255.0 FORMAT "%5.1" ECU_ADDRESS 0x6000A07E /end MEASUREMENT
/begin MEASUREMENT Conv_bTrqLdFlt "Flag for filtered load torque." UBYTE OneToOne 1 100 0.00 255.0 FORMAT "%5.1" ECU_ADDRESS 0x6000E406 /end MEASUREMENT
/begin MEASUREMENT Conv_bTrqResv "Flag for ""building"" torque reserve" UBYTE OneToOne 1 100 0.00 255.0 FORMAT "%5.1" ECU_ADDRESS 0x6000A451 /end MEASUREMENT
/begin MEASUREMENT Conv_bTrqResvBrkEnd "Flag for load reserve after braking." UBYTE OneToOne 1 100 0.00 255.0 FORMAT "%5.1" ECU_ADDRESS 0x6000E407 /end MEASUREMENT
/begin MEASUREMENT Conv_bTrqResvLvrOff "Flag for load reserve in low idle." UBYTE OneToOne 1 100 0.00 255.0 FORMAT "%5.1" ECU_ADDRESS 0x6000E408 /end MEASUREMENT
/begin MEASUREMENT Conv_cntrPostDrvLve "Postdrive leave counter" UBYTE OneToOne 1 100 0.00 255.0 FORMAT "%5.1" ECU_ADDRESS 0x60009BAB /end MEASUREMENT
/begin MEASUREMENT Conv_cntrPostLve "Counter checking for Post Drive Leave" UBYTE OneToOne 1 100 0.00 255.0 FORMAT "%5.1" ECU_ADDRESS 0x60009BA5 /end MEASUREMENT
/begin MEASUREMENT Conv_facDepNTrbnNStat_mp "Factor for the conversion of turbine speed to stationary engine speed." SWORD Fact 1 100 -4.000000 3.999878 FORMAT "%8.6" ECU_ADDRESS 0x70009228 /end MEASUREMENT
/begin MEASUREMENT Conv_facIntrpn "The interpolation factor in case low speed" SLONG RBPtCel_fac_0p01_1 1 100 -21474836.4800 21474836.4700 FORMAT "%13.4" ECU_ADDRESS 0x60001914 /end MEASUREMENT
/begin MEASUREMENT Conv_facOilTempDepTrqPmp "Oil temperature dependant factor." SWORD TrqToNSqr 1 100 -0.003276800 0.003276700 FORMAT "%11.9" ECU_ADDRESS 0x60004B32 /end MEASUREMENT
/begin MEASUREMENT Conv_facRedCnvrLoad "The velocity factor during driver off" SWORD Fact 1 100 -4.000000 3.999878 FORMAT "%8.6" ECU_ADDRESS 0x60003E60 /end MEASUREMENT
/begin MEASUREMENT Conv_flgDecelTq "Flag of Torque reserve offset in slow deceleration" UBYTE B_TRUE 1 100 0.00 1.00000000000 BIT_MASK 0x1 FORMAT "%13.11" ECU_ADDRESS 0x60009BAA /end MEASUREMENT
/begin MEASUREMENT Conv_flgDecelTqCdn "Flag of Torque reserve offset in slow deceleration condition satisfied" UBYTE B_TRUE 1 100 0.00 1.00000000000 BIT_MASK 0x1 FORMAT "%13.11" ECU_ADDRESS 0x60009BA9 /end MEASUREMENT
/begin MEASUREMENT Conv_flgDRGearShift "The status of gear lever shift from drive to reverse" UBYTE B_TRUE 1 100 0.00 1.00000000000 BIT_MASK 0x1 FORMAT "%13.11" ECU_ADDRESS 0x6000A1A0 /end MEASUREMENT
/begin MEASUREMENT Conv_flgDRGearShiftDeb "The status of gear lever shift from drive to reverse after debouncing" UBYTE B_TRUE 1 100 0.00 1.00000000000 BIT_MASK 0x1 FORMAT "%13.11" ECU_ADDRESS 0x6000A19F /end MEASUREMENT
/begin MEASUREMENT Conv_flgRDGearShift "The status of gear lever shift from reverse to drive" UBYTE B_TRUE 1 100 0.00 1.00000000000 BIT_MASK 0x1 FORMAT "%13.11" ECU_ADDRESS 0x6000A19E /end MEASUREMENT
/begin MEASUREMENT Conv_flgRDGearShiftDeb "The status of gear lever shift from reverse to drive after debouncing" UBYTE B_TRUE 1 100 0.00 1.00000000000 BIT_MASK 0x1 FORMAT "%13.11" ECU_ADDRESS 0x6000A19D /end MEASUREMENT
/begin MEASUREMENT Conv_flgTqOffsTiMax "Flag of Torque reserve offset reaches maximum time" UBYTE B_TRUE 1 100 0.00 1.00000000000 BIT_MASK 0x1 FORMAT "%13.11" ECU_ADDRESS 0x60009BA8 /end MEASUREMENT
/begin MEASUREMENT Conv_idxCurPosn "The current bit position in the array" UBYTE OneToOne 1 100 0.00 255.0 FORMAT "%5.1" ECU_ADDRESS 0x60009BA7 /end MEASUREMENT
/begin MEASUREMENT Conv_nDifAvrg "The average Turbine speed change (difference)" SWORD EngN 1 100 -16384.00 16383.50 FORMAT "%8.2" ECU_ADDRESS 0x70001E94 /end MEASUREMENT
/begin MEASUREMENT Conv_nrPrevGear "The gear lever of previous driving cycle" UBYTE OneToOne 1 100 0.00 255.0 FORMAT "%5.1" ECU_ADDRESS 0x6000A450 /end MEASUREMENT
/begin MEASUREMENT Conv_nrTrbAvrg "The number of raster turbine speed Average change is calculated from (1-16)" UBYTE OneToOne 1 100 0.00 255.0 FORMAT "%5.1" ECU_ADDRESS 0x60009BA6 /end MEASUREMENT
/begin MEASUREMENT Conv_nTrbDifAry "Array of the Turbine speed change (difference) in the past" SWORD EngN 1 100 -16384.00 16383.50 FORMAT "%8.2" ARRAY_SIZE 16 ECU_ADDRESS 0x60003E40 /end MEASUREMENT
/begin MEASUREMENT Conv_nTrbn "Turbine speed" SWORD EngN 1 100 -16384.00 16383.50 FORMAT "%8.2" ECU_ADDRESS 0x6000514C /end MEASUREMENT
/begin MEASUREMENT Conv_nTrbnCorrVal_mp "Value for the correction of the turbine speed" SWORD EngN 1 100 -16384.00 16383.50 FORMAT "%8.2" ECU_ADDRESS 0x70009226 /end MEASUREMENT
/begin MEASUREMENT Conv_nTrbnDiff_mp "Turbine speed difference" SWORD EngN 1 100 -16384.00 16383.50 FORMAT "%8.2" ECU_ADDRESS 0x70009224 /end MEASUREMENT
/begin MEASUREMENT Conv_nTrbnExp_mp "expected turbine speed" SWORD EngN 1 100 -16384.00 16383.50 FORMAT "%8.2" ECU_ADDRESS 0x70009222 /end MEASUREMENT
/begin MEASUREMENT Conv_nTrbnMod "modelled turbine speed." SWORD EngN 1 100 -16384.00 16383.50 FORMAT "%8.2" ECU_ADDRESS 0x6000E188 /end MEASUREMENT
/begin MEASUREMENT Conv_nTrbnOld "old turbine speed" SWORD EngN 1 100 -16384.00 16383.50 FORMAT "%8.2" ECU_ADDRESS 0x6000E18A /end MEASUREMENT
/begin MEASUREMENT Conv_rNTrbnNStat_mp "Ratio of Turbine speed to stationary speed" SWORD TransR 1 100 -327.6800 327.6700 FORMAT "%8.4" ECU_ADDRESS 0x70009220 /end MEASUREMENT
/begin MEASUREMENT Conv_rTrq "Converter transmission ratio." SWORD TransR 1 100 -327.6800 327.6700 FORMAT "%8.4" ECU_ADDRESS 0x6000E18C /end MEASUREMENT
/begin MEASUREMENT Conv_tiDepLvrDeb "debounce time for gear lever position" SWORD TimeDeb 1 100 -327680.0 327670.0 FORMAT "%8.1" ECU_ADDRESS 0x6000514A /end MEASUREMENT
/begin MEASUREMENT Conv_tiTDeptRevLvrDebNegNeut "Debounce time when transition from reverse gear to Neutral." SWORD TimeDeb 1 100 -327680.0 327670.0 FORMAT "%8.1" ECU_ADDRESS 0x60004B30 /end MEASUREMENT
/begin MEASUREMENT Conv_tiTDeptRevLvrDebNegPark "Debounce time when transition from reverse gear to Park." SWORD TimeDeb 1 100 -327680.0 327670.0 FORMAT "%8.1" ECU_ADDRESS 0x60004B2E /end MEASUREMENT
/begin MEASUREMENT Conv_tiTDpdtLvrDrvRevDebPos "Time debound of gear lever shift from drive to reverse" SWORD TimeDeb 1 100 -327680.0 327670.0 FORMAT "%8.1" ECU_ADDRESS 0x60004B2C /end MEASUREMENT
/begin MEASUREMENT Conv_tiTDpdtLvrRevDrvDebPos "Time debound of gear lever shift from reverse to drive" SWORD TimeDeb 1 100 -327680.0 327670.0 FORMAT "%8.1" ECU_ADDRESS 0x60004B2A /end MEASUREMENT
/begin MEASUREMENT Conv_tiTempDepLvrDebNeg "Debounce time temperature no gear." SWORD TimeDeb 1 100 -327680.0 327670.0 FORMAT "%8.1" ECU_ADDRESS 0x60004B28 /end MEASUREMENT
/begin MEASUREMENT Conv_tiTempDepLvrDebPos "Debounce temperature gear engaged." SWORD TimeDeb 1 100 -327680.0 327670.0 FORMAT "%8.1" ECU_ADDRESS 0x60004B26 /end MEASUREMENT
/begin MEASUREMENT Conv_tiTempDepRevLvrDebPos "Debounce time temperature reverse gear." SWORD TimeDeb 1 100 -327680.0 327670.0 FORMAT "%8.1" ECU_ADDRESS 0x6000E190 /end MEASUREMENT
/begin MEASUREMENT Conv_tOil "Converter Oil temperature" SWORD Temp_Cels 1 100 -3549.940 3003.560 FORMAT "%8.3" ECU_ADDRESS 0x6000E18E /end MEASUREMENT
/begin MEASUREMENT Conv_tOilBuf "Buffer for oil temperature" SWORD Temp_Cels 1 100 -3549.940 3003.560 FORMAT "%8.3" ECU_ADDRESS 0x60003E3A /end MEASUREMENT
/begin MEASUREMENT Conv_tqDecelOffs "Torque reserve offset from converter for lost in slow deceleration" SWORD Trq 1 100 -3276.800 3276.700 FORMAT "%8.3" ECU_ADDRESS 0x60003E3E /end MEASUREMENT
/begin MEASUREMENT Conv_tqEngTqDe "The base engine torque" SLONG Trq 1 100 -214748364.800 214748364.700 FORMAT "%13.3" ECU_ADDRESS 0x60001910 /end MEASUREMENT
/begin MEASUREMENT Conv_tqPmpDrvOff "The pump torque during driver off" SLONG Trq 1 100 -214748364.800 214748364.700 FORMAT "%13.3" ECU_ADDRESS 0x6000190C /end MEASUREMENT
/begin MEASUREMENT Conv_tqPmpHiSpd "The pump torque in case high speed" SLONG Trq 1 100 -214748364.800 214748364.700 FORMAT "%13.3" ECU_ADDRESS 0x60001908 /end MEASUREMENT
/begin MEASUREMENT Conv_tqPmpHiSpdTmp "The temporary torque pump in case high speed" SLONG Trq 1 100 -214748364.800 214748364.700 FORMAT "%13.3" ECU_ADDRESS 0x60001904 /end MEASUREMENT
/begin MEASUREMENT Conv_tqPmpLoSpd "The torque pump in case low speed" SLONG Trq 1 100 -214748364.800 214748364.700 FORMAT "%13.3" ECU_ADDRESS 0x60001900 /end MEASUREMENT
/begin MEASUREMENT Conv_tqPmpLoSpdTmp "The temporary torque pump in case low speed" SLONG Trq 1 100 -214748364.800 214748364.700 FORMAT "%13.3" ECU_ADDRESS 0x600018FC /end MEASUREMENT
/begin MEASUREMENT Conv_tqPmpStat "The static torque pump" SLONG Trq 1 100 -214748364.800 214748364.700 FORMAT "%13.3" ECU_ADDRESS 0x600018F8 /end MEASUREMENT
/begin MEASUREMENT Conv_tqPmpStd "The standard for pump torque" SLONG Trq 1 100 -214748364.800 214748364.700 FORMAT "%13.3" ECU_ADDRESS 0x600018F4 /end MEASUREMENT
/begin MEASUREMENT Conv_tqResvTDeptDrvRev "Temperature dependant reserve torque of gear lever shift from drive to reverse and vice versa" SWORD Trq 1 100 -3276.800 3276.700 FORMAT "%8.3" ECU_ADDRESS 0x60004B24 /end MEASUREMENT
/begin MEASUREMENT Conv_trqLd "Application parameter for Torque load from the converter" SWORD Trq 1 100 -3276.800 3276.700 FORMAT "%8.3" ECU_ADDRESS 0x60005148 /end MEASUREMENT
/begin MEASUREMENT Conv_trqLdBefLim_mp "Torque load before torque limitation" SWORD Trq 1 100 -3276.800 3276.700 FORMAT "%8.3" ECU_ADDRESS 0x7000921E /end MEASUREMENT
/begin MEASUREMENT Conv_trqLdDiff_mp "Torque load difference" SWORD Trq 1 100 -3276.800 3276.700 FORMAT "%8.3" ECU_ADDRESS 0x7000921C /end MEASUREMENT
/begin MEASUREMENT Conv_trqLdFlt "filtered torque load" SWORD Trq 1 100 -3276.800 3276.700 FORMAT "%8.3" ECU_ADDRESS 0x6000E192 /end MEASUREMENT
/begin MEASUREMENT Conv_trqLdFltRslt_mp "filtered torque load for the calculation of the torque reserve." SWORD Trq 1 100 -3276.800 3276.700 FORMAT "%8.3" ECU_ADDRESS 0x7000921A /end MEASUREMENT
/begin MEASUREMENT Conv_trqLdLvrPosNeutr "Load torque for no gear engaged." SWORD Trq 1 100 -3276.800 3276.700 FORMAT "%8.3" ECU_ADDRESS 0x60004B22 /end MEASUREMENT
/begin MEASUREMENT Conv_trqLdMaxLim_mp "current limitation for the torque load by CAN." SWORD Trq 1 100 -3276.800 3276.700 FORMAT "%8.3" ECU_ADDRESS 0x70009218 /end MEASUREMENT
/begin MEASUREMENT Conv_trqLdMod "modelled calculation of the torque load" SWORD Trq 1 100 -3276.800 3276.700 FORMAT "%8.3" ECU_ADDRESS 0x6000E194 /end MEASUREMENT
/begin MEASUREMENT Conv_trqLdOfs "Offset of the torque load" SWORD Trq 1 100 -3276.800 3276.700 FORMAT "%8.3" ECU_ADDRESS 0x60003E3C /end MEASUREMENT
/begin MEASUREMENT Conv_trqLdOfs_mp "Offset of the torque load" SWORD Trq 1 100 -3276.800 3276.700 FORMAT "%8.3" ECU_ADDRESS 0x70009216 /end MEASUREMENT
/begin MEASUREMENT Conv_trqLdPreFlt "Pre-filtered torque load" SWORD Trq 1 100 -3276.800 3276.700 FORMAT "%8.3" ECU_ADDRESS 0x6000E196 /end MEASUREMENT
/begin MEASUREMENT Conv_trqLdResvAdd_mp "additional torque reserve for engaged gear" SWORD Trq 1 100 -3276.800 3276.700 FORMAT "%8.3" ECU_ADDRESS 0x70009214 /end MEASUREMENT
/begin MEASUREMENT Conv_trqLdResvFlt_mp "filtered additional torque reserve" SWORD Trq 1 100 -3276.800 3276.700 FORMAT "%8.3" ECU_ADDRESS 0x70009212 /end MEASUREMENT
/begin MEASUREMENT Conv_trqLdRevLvrPos "Load torque for gear engaged." SWORD Trq 1 100 -3276.800 3276.700 FORMAT "%8.3" ECU_ADDRESS 0x6000E198 /end MEASUREMENT
/begin MEASUREMENT Conv_trqLdTempDepLim "Temperature dependant value for limitation of load torque." SWORD Trq 1 100 -3276.800 3276.700 FORMAT "%8.3" ECU_ADDRESS 0x60004B20 /end MEASUREMENT
/begin MEASUREMENT Conv_trqLdTrqResvTotBuf_mp "Torque load buffer for the total of torque load and torque reserve" SWORD Trq 1 100 -3276.800 3276.700 FORMAT "%8.3" ECU_ADDRESS 0x70009210 /end MEASUREMENT
/begin MEASUREMENT Conv_trqLosDfftl "Differential torque losses" SWORD TrqPrpHigh 1 100 -3276.800 3276.700 FORMAT "%8.3" ECU_ADDRESS 0x60004B1E /end MEASUREMENT
/begin MEASUREMENT Conv_trqLosDfftl_mp "Differential torque losses" SWORD TrqPrpHigh 1 100 -3276.800 3276.700 FORMAT "%8.3" ECU_ADDRESS 0x7000920E /end MEASUREMENT
/begin MEASUREMENT Conv_trqOilPmpLoss "Oil Pump Loss Torque" SWORD Trq 1 100 -3276.800 3276.700 FORMAT "%8.3" ECU_ADDRESS 0x60005142 /end MEASUREMENT
/begin MEASUREMENT Conv_trqPmpBuf_mp "Pump torque" SWORD Trq 1 100 -3276.800 3276.700 FORMAT "%8.3" ECU_ADDRESS 0x7000920C /end MEASUREMENT
/begin MEASUREMENT Conv_trqResv "Torque reserve from the converter" SWORD Trq 1 100 -3276.800 3276.700 FORMAT "%8.3" ECU_ADDRESS 0x6000E19A /end MEASUREMENT
/begin MEASUREMENT Conv_trqResvHiInc_mp "Factor for additional torque reserve" SWORD Trq 1 100 -3276.800 3276.700 FORMAT "%8.3" ECU_ADDRESS 0x7000920A /end MEASUREMENT
/begin MEASUREMENT Conv_trqResvTempDep "Temperature dependant reserve torque." SWORD Trq 1 100 -3276.800 3276.700 FORMAT "%8.3" ECU_ADDRESS 0x6000E19C /end MEASUREMENT
/begin MEASUREMENT Conv_trqStatSqBuf_mp "Buffer for pump torque" SWORD Trq 1 100 -3276.800 3276.700 FORMAT "%8.3" ECU_ADDRESS 0x70009208 /end MEASUREMENT
/begin MEASUREMENT CoPOM_AbortStrtrER_I "Class instance to detect the aborted start event" UBYTE uint8 1 100 0.00 255.0 FORMAT "%5.1" ECU_ADDRESS 0x60009B9D /end MEASUREMENT
/begin MEASUREMENT CoPOM_CnclStrtReqTON_I.XOld "Delay for cancellation of first start request when no new start type is present / Delay for cancellation of first start request when no new start type is present" UBYTE OneToOne 1 100 0.00 255.0 FORMAT "%5.1" ECU_ADDRESS 0x50001164 /end MEASUREMENT
/begin MEASUREMENT CoPOM_CnclStrtReqTON_I.Timer "Delay for cancellation of first start request when no new start type is present / Delay for cancellation of first start request when no new start type is present" SLONG OneToOne 1 100 -2147483648.00 2147483647.00 FORMAT "%13.2" ECU_ADDRESS 0x50001168 /end MEASUREMENT
/begin MEASUREMENT CoPOM_cntAbortStrtr "Count of aborted start for the conventional starter." UBYTE OneToOne 1 100 0.00 255.0 FORMAT "%5.1" ECU_ADDRESS 0x6003477E /end MEASUREMENT
/begin MEASUREMENT CoPOM_cntAbortStrtrOld "Protected Count of aborted start for the conventional starter, when the driver does a quick T15 offon." UBYTE OneToOne 1 100 0.00 255.0 FORMAT "%5.1" ECU_ADDRESS 0x6003477D /end MEASUREMENT
/begin MEASUREMENT CoPOM_DrvrStrtReqRSFF_I "Class instance to memorise the driver demand" UBYTE uint8 1 100 0.00 255.0 FORMAT "%5.1" ECU_ADDRESS 0x60009BA4 /end MEASUREMENT
/begin MEASUREMENT CoPOM_FirstStrtRelsEF_I "Class instance to detect the Closure of drivetrain" UBYTE uint8 1 100 0.00 255.0 FORMAT "%5.1" ECU_ADDRESS 0x60009BA3 /end MEASUREMENT
/begin MEASUREMENT CoPOM_flgAbortStrtr "Flag indicating the abort conditions for the conventional starter." UBYTE B_TRUE 1 100 0.00 1.00000000000 BIT_MASK 0x1 FORMAT "%13.11" ECU_ADDRESS 0x700002FD /end MEASUREMENT
/begin MEASUREMENT CoPOM_flgAbortStrtrLimReachd "Flag to indicate the fault starts count threshold has reached, so a different start behaviour needs to be triggered." UBYTE B_TRUE 1 100 0.00 1.00000000000 BIT_MASK 0x1 FORMAT "%13.11" ECU_ADDRESS 0x700002FC /end MEASUREMENT
/begin MEASUREMENT CoPOM_flgCnclStrtReq "Flag to indicate cancellation of first start request when no new start type is present" UBYTE B_TRUE 1 100 0.00 1.00000000000 BIT_MASK 0x1 FORMAT "%13.11" ECU_ADDRESS 0x70000302 /end MEASUREMENT
/begin MEASUREMENT CoPOM_flgMemdDrvrStrtReq "Flag to indicate the memorised driver start request" UBYTE B_TRUE 1 100 0.00 1.00000000000 BIT_MASK 0x1 FORMAT "%13.11" ECU_ADDRESS 0x70000301 /end MEASUREMENT
/begin MEASUREMENT CoPOM_flgMemdDrvrStrtReqCncl "Flag to indicate cancellation of the memorised driver start request" UBYTE B_TRUE 1 100 0.00 1.00000000000 BIT_MASK 0x1 FORMAT "%13.11" ECU_ADDRESS 0x70000300 /end MEASUREMENT
/begin MEASUREMENT CoPOM_flgMemdRstStrtReq "Flag to indicate automatic restart request when there is an undervoltage reset" UBYTE B_TRUE 1 100 0.00 1.00000000000 BIT_MASK 0x1 FORMAT "%13.11" ECU_ADDRESS 0x700002FF /end MEASUREMENT
/begin MEASUREMENT CoPOM_flgPtStrtRels "Release from powertrain for starting the combustion engine" UBYTE B_TRUE 1 100 0.00 1.00000000000 BIT_MASK 0x1 FORMAT "%13.11" ECU_ADDRESS 0x700002FE /end MEASUREMENT
/begin MEASUREMENT CoPOM_flgStrtPrms "Permission for starting the combustion engine" UBYTE B_TRUE 1 100 0.00 1.00000000000 BIT_MASK 0x1 FORMAT "%13.11" ECU_ADDRESS 0x700002FB /end MEASUREMENT
/begin MEASUREMENT CoPOM_flgStrtrStrtRels "Release from the conventional starter for starting the combustion engine" UBYTE B_TRUE 1 100 0.00 1.00000000000 BIT_MASK 0x1 FORMAT "%13.11" ECU_ADDRESS 0x700002FA /end MEASUREMENT
/begin MEASUREMENT CoPOM_NxtStrtAftAbortTOFF_I.XOld "Ensuring a certain delay for allowing next start after an abort / class variable" UBYTE OneToOne 1 100 0.00 255.0 FORMAT "%5.1" ECU_ADDRESS 0x5000116C /end MEASUREMENT
/begin MEASUREMENT CoPOM_NxtStrtAftAbortTOFF_I.Timer "Ensuring a certain delay for allowing next start after an abort / class variable" SLONG OneToOne 1 100 -2147483648.00 2147483647.00 FORMAT "%13.2" ECU_ADDRESS 0x50001170 /end MEASUREMENT
/begin MEASUREMENT CoPOM_PanicStrtTON_I.XOld "Delay timer to debounce the crank request from driver for indicating Panic start / Delay timer to debounce the crank request from driver for indicating Panic start" UBYTE OneToOne 1 100 0.00 255.0 FORMAT "%5.1" ECU_ADDRESS 0x50001174 /end MEASUREMENT
/begin MEASUREMENT CoPOM_PanicStrtTON_I.Timer "Delay timer to debounce the crank request from driver for indicating Panic start / Delay timer to debounce the crank request from driver for indicating Panic start" SLONG OneToOne 1 100 -2147483648.00 2147483647.00 FORMAT "%13.2" ECU_ADDRESS 0x50001178 /end MEASUREMENT
/begin MEASUREMENT CoPOM_RstStrtReqRSFF_I "Class to latch the undervoltage reset event, to trigger an automated restart." UBYTE uint8 1 100 0.00 255.0 FORMAT "%5.1" ECU_ADDRESS 0x60009BA2 /end MEASUREMENT
/begin MEASUREMENT CoPOM_stEngFirstStrtReq "Engine First start request (via T50)" UBYTE RBPtPwrTrn_stEngReq_VERB 1 100 0.00 4.00000000000 FORMAT "%13.11" ECU_ADDRESS 0x6000A670 /end MEASUREMENT
/begin MEASUREMENT CoPOM_stEngFirstStrtReqOld "Previous Engine First start request (via T50)" UBYTE RBPtPwrTrn_stEngReq_VERB 1 100 0.00 4.00000000000 FORMAT "%13.11" ECU_ADDRESS 0x60009BA1 /end MEASUREMENT
/begin MEASUREMENT CoPOM_stEngSpstReq "Request to start or stop the combustion engine" UBYTE RBPtPwrTrn_stEngReq_VERB 1 100 0.00 4.00000000000 FORMAT "%13.11" ECU_ADDRESS 0x6000A66F /end MEASUREMENT
/begin MEASUREMENT CoPOM_StrtReqCnclTOFF_I.XOld "Class for cancellation of memorized start request if start releaseis not given within specified time of T50 edge rising. / Class for cancellation of memorized start request if start release is not given within specified time of T50 edge rising." UBYTE OneToOne 1 100 0.00 255.0 FORMAT "%5.1" ECU_ADDRESS 0x5000117C /end MEASUREMENT
/begin MEASUREMENT CoPOM_StrtReqCnclTOFF_I.Timer "Class for cancellation of memorized start request if start releaseis not given within specified time of T50 edge rising. / Class for cancellation of memorized start request if start release is not given within specified time of T50 edge rising." SLONG OneToOne 1 100 -2147483648.00 2147483647.00 FORMAT "%13.2" ECU_ADDRESS 0x50001180 /end MEASUREMENT
/begin MEASUREMENT CoPOM_StrtReqPreDrvCnclTOFF_I.XOld "Class for cancellation of memorized start request if transition from Pre-Drive to Drive takes more than threshold duration during T50 request. / Class for cancellation of memorized start request if transition from Pre-Drive to Drive takes more than threshold duration during T50 request." UBYTE OneToOne 1 100 0.00 255.0 FORMAT "%5.1" ECU_ADDRESS 0x50001184 /end MEASUREMENT
/begin MEASUREMENT CoPOM_StrtReqPreDrvCnclTOFF_I.Timer "Class for cancellation of memorized start request if transition from Pre-Drive to Drive takes more than threshold duration during T50 request. / Class for cancellation of memorized start request if transition from Pre-Drive to Drive takes more than threshold duration during T50 request." SLONG OneToOne 1 100 -2147483648.00 2147483647.00 FORMAT "%13.2" ECU_ADDRESS 0x50001188 /end MEASUREMENT
/begin MEASUREMENT CoPOM_StrtrMaxAbortTON_I.XOld "Delay for checking how long the starter is enabled / class variable" UBYTE OneToOne 1 100 0.00 255.0 FORMAT "%5.1" ECU_ADDRESS 0x5000118C /end MEASUREMENT
/begin MEASUREMENT CoPOM_StrtrMaxAbortTON_I.Timer "Delay for checking how long the starter is enabled / class variable" SLONG OneToOne 1 100 -2147483648.00 2147483647.00 FORMAT "%13.2" ECU_ADDRESS 0x50001190 /end MEASUREMENT
/begin MEASUREMENT CoPOM_T50RstER_I "Class to identify the undervoltage reset (T50.Bit1)" UBYTE uint8 1 100 0.00 255.0 FORMAT "%5.1" ECU_ADDRESS 0x60009BA0 /end MEASUREMENT
/begin MEASUREMENT CoPOM_T50St0EF_I "Class to identify the release of cranking request (T50.Bit0 = 0) from driver" UBYTE uint8 1 100 0.00 255.0 FORMAT "%5.1" ECU_ADDRESS 0x60009B9F /end MEASUREMENT
/begin MEASUREMENT CoPOM_T50St0ER_I "Class to identify the cranking request (T50.Bit0 = 1) from driver" UBYTE uint8 1 100 0.00 255.0 FORMAT "%5.1" ECU_ADDRESS 0x60009B9E /end MEASUREMENT
/begin MEASUREMENT CoPOM_tqStrtDevStrtr "Available starting torque starter" SWORD Trq 1 100 -3276.800 3276.700 FORMAT "%8.3" ECU_ADDRESS 0x600051F8 /end MEASUREMENT
/begin MEASUREMENT CoPT_rClgDes "Whole cool demand of the impulse rope for the ventilator" SWORD Prc 1 100 -400.0000 399.9878 FORMAT "%8.4" ECU_ADDRESS 0x60004B46 /end MEASUREMENT
/begin MEASUREMENT CoPT_tClntDes "Desired coolant temperature of power train" SWORD Temp_Cels 1 100 -3549.940 3003.560 FORMAT "%8.3" ECU_ADDRESS 0x60004B44 /end MEASUREMENT
/begin MEASUREMENT CoTemp_rClgDes "Cooling requirement of the combustion" SWORD Prc 1 100 -400.0000 399.9878 FORMAT "%8.4" ECU_ADDRESS 0x60004B3E /end MEASUREMENT
/begin MEASUREMENT CoTemp_tEngDes "Coolant temperature of combustion engine" SWORD Temp_Cels 1 100 -3549.940 3003.560 FORMAT "%8.3" ECU_ADDRESS 0x60004B3C /end MEASUREMENT
/begin MEASUREMENT CoTS_rClgDem "requested relative cooling performance" SWORD Prc 1 100 -400.0000 399.9878 FORMAT "%8.4" ECU_ADDRESS 0x60004B42 /end MEASUREMENT
/begin MEASUREMENT CoTS_rhoAir "Air Density" SWORD Dens_q0p001_COMPU 1 100 -32.76800 32.76700 FORMAT "%8.5" ECU_ADDRESS 0x600051EE /end MEASUREMENT
/begin MEASUREMENT CoTS_stSSEStopInhb "single bit coded 8 bit shut-off information message to provide Auto-stop inhibition information from thermal system coordinator" UBYTE OneToOne 1 100 0.00 255.0 FORMAT "%5.1" ECU_ADDRESS 0x6000A669 /end MEASUREMENT
/begin MEASUREMENT CoTS_tClntDesFlt "Filtered value of CoVeh_tClntDes" SWORD Temp_Cels 1 100 -3549.940 3003.560 FORMAT "%8.3" ECU_ADDRESS 0x60003E38 /end MEASUREMENT
/begin MEASUREMENT CoTS_tClntEngOutDes "desired coolant temperature" SWORD Temp_Cels 1 100 -3549.940 3003.560 FORMAT "%8.3" ECU_ADDRESS 0x60004B40 /end MEASUREMENT
/begin MEASUREMENT CoTS_trqMaxAC "Switch off condition for AC" SWORD Trq 1 100 -3276.800 3276.700 FORMAT "%8.3" ECU_ADDRESS 0x6000E182 /end MEASUREMENT
/begin MEASUREMENT CoVeh_rClgDes "Desired relative air mass flow" SWORD Prc 1 100 -400.0000 399.9878 FORMAT "%8.4" ECU_ADDRESS 0x60004B3A /end MEASUREMENT
/begin MEASUREMENT CoVeh_tClntDes "Desired coolant temperature" SWORD Temp_Cels 1 100 -3549.940 3003.560 FORMAT "%8.3" ECU_ADDRESS 0x60004B38 /end MEASUREMENT
/begin MEASUREMENT Gbx_nMaxEngFco "Maximum engine speed limitation request(FuelCut Control)" SWORD EngN 1 100 -16384.00 16383.50 FORMAT "%8.2" ECU_ADDRESS 0x60005070 /end MEASUREMENT
/begin MEASUREMENT Gbx_nMaxEngTrqLim "Maximum engine speed limitation request(Torque Control)" SWORD EngN 1 100 -16384.00 16383.50 FORMAT "%8.2" ECU_ADDRESS 0x6000506E /end MEASUREMENT
/begin MEASUREMENT Gbx_tOilConv "Message for Oil Conversion temparature" SWORD Temp_Cels 1 100 -3549.940 3003.560 FORMAT "%8.3" ECU_ADDRESS 0x60005062 /end MEASUREMENT
/begin MEASUREMENT Gbx_trqOilPmpLos "Oil pump load torque" SWORD Trq 1 100 -3276.800 3276.700 FORMAT "%8.3" ECU_ADDRESS 0x6000505C /end MEASUREMENT
/begin MEASUREMENT Gbx_trqTSCIntvSlow "Engine torque amount (by Air)" SWORD Trq 1 100 -3276.800 3276.700 FORMAT "%8.3" ECU_ADDRESS 0x60005058 /end MEASUREMENT
/begin MEASUREMENT Lin_Alt_B_Signal_ACG_Temp_8_r_msg "" UBYTE OneToOne 1 100 0.00 255.0 FORMAT "%5.1" ECU_ADDRESS 0x6000A369 /end MEASUREMENT
/begin MEASUREMENT Lin_Alt_B_Signal_ComTOut_1_r_msg "" UBYTE OneToOne 1 100 0.00 255.0 FORMAT "%5.1" ECU_ADDRESS 0x6000A368 /end MEASUREMENT
/begin MEASUREMENT Lin_Alt_B_Signal_Com_1_r_msg "" UBYTE OneToOne 1 100 0.00 255.0 FORMAT "%5.1" ECU_ADDRESS 0x6000A367 /end MEASUREMENT
/begin MEASUREMENT Lin_Alt_B_Signal_Dyc_5_r_msg "" UBYTE OneToOne 1 100 0.00 255.0 FORMAT "%5.1" ECU_ADDRESS 0x6000A366 /end MEASUREMENT
/begin MEASUREMENT Lin_Alt_B_Signal_Elec_1_r_msg "" UBYTE OneToOne 1 100 0.00 255.0 FORMAT "%5.1" ECU_ADDRESS 0x6000A365 /end MEASUREMENT
/begin MEASUREMENT Lin_Alt_B_Signal_ExctCrnt_8_r_msg "" UBYTE OneToOne 1 100 0.00 255.0 FORMAT "%5.1" ECU_ADDRESS 0x6000A364 /end MEASUREMENT
/begin MEASUREMENT Lin_Alt_B_Signal_HiTemp_1_r_msg "" UBYTE OneToOne 1 100 0.00 255.0 FORMAT "%5.1" ECU_ADDRESS 0x6000A363 /end MEASUREMENT
/begin MEASUREMENT Lin_Alt_B_Signal_Mchn_1_r_msg "" UBYTE OneToOne 1 100 0.00 255.0 FORMAT "%5.1" ECU_ADDRESS 0x6000A362 /end MEASUREMENT
/begin MEASUREMENT Lin_BS_B_Signal_OCV_8_r_msg "Battery quiescent voltage receive from LIN raw value" UBYTE OneToOne 1 100 0.00 255.0 FORMAT "%5.1" ECU_ADDRESS 0x6000A35B /end MEASUREMENT
/begin MEASUREMENT Lin_BS_B_Signal_STBATTSENRST_1_r_msg "Status of battery sensor reset detection receive from LIN raw value" UBYTE OneToOne 1 100 0.00 255.0 FORMAT "%5.1" ECU_ADDRESS 0x6000A35A /end MEASUREMENT
/begin MEASUREMENT Lin_BS_B_Signal_TASIC_8_r_msg "Temperature of ASIC receive from LIN raw value" UBYTE OneToOne 1 100 0.00 255.0 FORMAT "%5.1" ECU_ADDRESS 0x6000A359 /end MEASUREMENT
/begin MEASUREMENT Lin_BS_B_Signal_tiDurAftIgnOff_16_r_msg "Duration in hours of the last LIN inactive phase receive from LIN raw value" UWORD OneToOne 1 100 0.00 65535.00 FORMAT "%8.2" ECU_ADDRESS 0x60004C9E /end MEASUREMENT
/begin MEASUREMENT Lin_BS_Signal_B_BattChg_2_r_msg "Battery Change Judgement receive from LIN raw value" UBYTE OneToOne 1 100 0.00 255.0 FORMAT "%5.1" ECU_ADDRESS 0x6000A356 /end MEASUREMENT
/begin MEASUREMENT Lin_BS_Signal_B_BATTCH_16_r_msg "Accumulated battery charge receive from LIN raw value" UWORD OneToOne 1 100 0.00 65535.00 FORMAT "%8.2" ECU_ADDRESS 0x60004C9C /end MEASUREMENT
/begin MEASUREMENT Lin_BS_Signal_B_BATTDCHA_16_r_msg "Accumulated battery discharge receive from LIN raw value" UWORD OneToOne 1 100 0.00 65535.00 FORMAT "%8.2" ECU_ADDRESS 0x60004C9A /end MEASUREMENT
/begin MEASUREMENT Lin_BS_Signal_B_BATT_WARM_LEVEL_3_r_msg "Level of Low Charge State receive from LIN raw value" UBYTE OneToOne 1 100 0.00 255.0 FORMAT "%5.1" ECU_ADDRESS 0x6000A358 /end MEASUREMENT
/begin MEASUREMENT Lin_BS_Signal_B_BCF_1_r_msg "BCBD detection flag receive from LIN raw value" UBYTE OneToOne 1 100 0.00 255.0 FORMAT "%5.1" ECU_ADDRESS 0x6000A357 /end MEASUREMENT
/begin MEASUREMENT Lin_BS_Signal_B_CHARERR_1_r_msg "Current characteristic failure flag receive from LIN raw value" UBYTE OneToOne 1 100 0.00 255.0 FORMAT "%5.1" ECU_ADDRESS 0x6000A355 /end MEASUREMENT
/begin MEASUREMENT Lin_BS_Signal_B_ctCrkngDetn_16_r_msg "Number of times of cranking detection receive from LIN raw value" UWORD OneToOne 1 100 0.00 65535.00 FORMAT "%8.2" ECU_ADDRESS 0x60004C8C /end MEASUREMENT
/begin MEASUREMENT Lin_BS_Signal_B_CTINTRESUPD_2_r_msg "Cranking Ri counter receive from LIN raw value" UBYTE OneToOne 1 100 0.00 255.0 FORMAT "%5.1" ECU_ADDRESS 0x6000A354 /end MEASUREMENT
/begin MEASUREMENT Lin_BS_Signal_B_ctMeasmtCrk_2_r_msg "Cranking Measurement counter receive from LIN rawvalue" UBYTE OneToOne 1 100 0.00 255.0 FORMAT "%5.1" ECU_ADDRESS 0x6000A347 /end MEASUREMENT
/begin MEASUREMENT Lin_BS_Signal_B_CtResRpl_5_r_msg "Ri Ripple Counter receive from LIN raw value" UBYTE OneToOne 1 100 0.00 255.0 FORMAT "%5.1" ECU_ADDRESS 0x6000A353 /end MEASUREMENT
/begin MEASUREMENT Lin_BS_Signal_B_ERROR_RES_1_r_msg "Sensor recognition and communication conformity flag receive from LIN raw value" UBYTE OneToOne 1 100 0.00 255.0 FORMAT "%5.1" ECU_ADDRESS 0x6000A352 /end MEASUREMENT
/begin MEASUREMENT Lin_BS_Signal_B_iBattStrtCrn_14_r_msg "Starting current at cranking receive from LIN raw value" UWORD OneToOne 1 100 0.00 65535.00 FORMAT "%8.2" ECU_ADDRESS 0x60004C8A /end MEASUREMENT
/begin MEASUREMENT Lin_BS_Signal_B_IBAT_16_r_msg "Battery Current receive from LIN raw value" UWORD OneToOne 1 100 0.00 65535.00 FORMAT "%8.2" ECU_ADDRESS 0x60004C98 /end MEASUREMENT
/begin MEASUREMENT Lin_BS_Signal_B_IBAT_8_r_msg "Battery Current receive from LIN raw value" UBYTE OneToOne 1 100 0.00 255.0 FORMAT "%5.1" ECU_ADDRESS 0x6000A351 /end MEASUREMENT
/begin MEASUREMENT Lin_BS_Signal_B_idBattData_8_r_msg "Data Identification receive from LIN raw value" UBYTE OneToOne 1 100 0.00 255.0 FORMAT "%5.1" ECU_ADDRESS 0x6000A346 /end MEASUREMENT
/begin MEASUREMENT Lin_BS_Signal_B_iMaxBattDcha_16_r_msg "Max Discharge at cranking receive from LIN raw value" UWORD OneToOne 1 100 0.00 65535.00 FORMAT "%8.2" ECU_ADDRESS 0x60004C88 /end MEASUREMENT
/begin MEASUREMENT Lin_BS_Signal_B_iStByCurrAft0h_10_r_msg "Battery current at transition to LIN off receive from LIN raw value" UWORD OneToOne 1 100 0.00 65535.00 FORMAT "%8.2" ECU_ADDRESS 0x60004C86 /end MEASUREMENT
/begin MEASUREMENT Lin_BS_Signal_B_iStByCurrAft1h_10_r_msg "Battery current 1h after transition to LIN off receive from LIN raw value" UWORD OneToOne 1 100 0.00 65535.00 FORMAT "%8.2" ECU_ADDRESS 0x60004C84 /end MEASUREMENT
/begin MEASUREMENT Lin_BS_Signal_B_iStByCurrAft2h_10_r_msg "Battery current 2h after transition to LIN off receive from LIN raw value" UWORD OneToOne 1 100 0.00 65535.00 FORMAT "%8.2" ECU_ADDRESS 0x60004C82 /end MEASUREMENT
/begin MEASUREMENT Lin_BS_Signal_B_iStByCurrLst_10_r_msg "Battery current during the last hour before transition to LIN on receive from LIN raw value" UWORD OneToOne 1 100 0.00 65535.00 FORMAT "%8.2" ECU_ADDRESS 0x60004C80 /end MEASUREMENT
/begin MEASUREMENT Lin_BS_Signal_B_LIN_TYPE_RX_4_r_msg "LIN format reception state from LIN raw value" UBYTE OneToOne 1 100 0.00 255.0 FORMAT "%5.1" ECU_ADDRESS 0x6000A34F /end MEASUREMENT
/begin MEASUREMENT Lin_BS_Signal_B_numBattPart_8_r_msg "Part Number receive from LIN raw value" UBYTE OneToOne 1 100 0.00 255.0 FORMAT "%5.1" ECU_ADDRESS 0x6000A345 /end MEASUREMENT
/begin MEASUREMENT Lin_BS_Signal_B_numLowSOCDetn_8_r_msg "Number of times of SOC 30 detection receive from LIN raw value" UBYTE OneToOne 1 100 0.00 255.0 FORMAT "%5.1" ECU_ADDRESS 0x6000A344 /end MEASUREMENT
/begin MEASUREMENT Lin_BS_Signal_B_PulResUpd_2_r_msg "Pulse Ri update state receive from LIN raw value" UBYTE OneToOne 1 100 0.00 255.0 FORMAT "%5.1" ECU_ADDRESS 0x6000A34E /end MEASUREMENT
/begin MEASUREMENT Lin_BS_Signal_B_RESMEASDBATT_16_r_msg "Simplified actual battery resistance receive from LIN raw value" UWORD OneToOne 1 100 0.00 65535.00 FORMAT "%8.2" ECU_ADDRESS 0x60004C96 /end MEASUREMENT
/begin MEASUREMENT Lin_BS_Signal_B_resPul_16_r_msg "Pulse Ri receive from LIN raw value" UWORD OneToOne 1 100 0.00 65535.00 FORMAT "%8.2" ECU_ADDRESS 0x60004C7E /end MEASUREMENT
/begin MEASUREMENT Lin_BS_Signal_B_ResRpl_11_r_msg "Ri Ripple receive from LIN raw value" UWORD OneToOne 1 100 0.00 65535.00 FORMAT "%8.2" ECU_ADDRESS 0x60004C94 /end MEASUREMENT
/begin MEASUREMENT Lin_BS_Signal_B_SOC_10_r_msg "Status of charge receive from LIN raw value" UWORD OneToOne 1 100 0.00 65535.00 FORMAT "%8.2" ECU_ADDRESS 0x60004C92 /end MEASUREMENT
/begin MEASUREMENT Lin_BS_Signal_B_SOC_STATE_3_r_msg "Status of charge status receive from LIN raw value" UBYTE OneToOne 1 100 0.00 255.0 FORMAT "%5.1" ECU_ADDRESS 0x6000A34D /end MEASUREMENT
/begin MEASUREMENT Lin_BS_Signal_B_SOHSOFLrng_2_r_msg "" UBYTE OneToOne 1 100 0.00 255.0 FORMAT "%5.1" ECU_ADDRESS 0x6000A34C /end MEASUREMENT
/begin MEASUREMENT Lin_BS_Signal_B_SOH_10_r_msg "State of Health receive from LIN raw value" UWORD OneToOne 1 100 0.00 65535.00 FORMAT "%8.2" ECU_ADDRESS 0x60004C90 /end MEASUREMENT
/begin MEASUREMENT Lin_BS_Signal_B_stChrgReq_3_r_msg "Charge Request State receive from LIN raw value" UBYTE OneToOne 1 100 0.00 255.0 FORMAT "%5.1" ECU_ADDRESS 0x6000A343 /end MEASUREMENT
/begin MEASUREMENT Lin_BS_Signal_B_stFitng_1_r_msg "Fitting State receive from LIN raw value" UBYTE OneToOne 1 100 0.00 255.0 FORMAT "%5.1" ECU_ADDRESS 0x6000A342 /end MEASUREMENT
/begin MEASUREMENT Lin_BS_Signal_B_stHarnR_2_r_msg "Harness resistance correction state receive from LIN raw value" UBYTE OneToOne 1 100 0.00 255.0 FORMAT "%5.1" ECU_ADDRESS 0x6000A341 /end MEASUREMENT
/begin MEASUREMENT Lin_BS_Signal_B_SUPPLIER_CODE_8_r_msg "Sensor Supplier Identification receive from LIN raw value" UBYTE OneToOne 1 100 0.00 255.0 FORMAT "%5.1" ECU_ADDRESS 0x6000A34B /end MEASUREMENT
/begin MEASUREMENT Lin_BS_Signal_B_TBattResPul_8_r_msg "Battery Fluid temperature at measuring pulse Ri receive from LIN raw value" UBYTE OneToOne 1 100 0.00 255.0 FORMAT "%5.1" ECU_ADDRESS 0x6000A349 /end MEASUREMENT
/begin MEASUREMENT Lin_BS_Signal_B_TBAT_8_r_msg "Battery Temperature from LIN raw value" UBYTE OneToOne 1 100 0.00 255.0 FORMAT "%5.1" ECU_ADDRESS 0x6000A34A /end MEASUREMENT
/begin MEASUREMENT Lin_BS_Signal_B_TerminalOFFDetn_2_r_msg "Terminal OFF Detection State receive from LIN raw value" UBYTE OneToOne 1 100 0.00 255.0 FORMAT "%5.1" ECU_ADDRESS 0x6000A348 /end MEASUREMENT
/begin MEASUREMENT Lin_BS_Signal_B_tiBattON_16_r_msg "Battery operating time receive from LIN raw value" UWORD OneToOne 1 100 0.00 65535.00 FORMAT "%8.2" ECU_ADDRESS 0x60004C7C /end MEASUREMENT
/begin MEASUREMENT Lin_BS_Signal_B_tiT15ON_11_r_msg "IG-ON Elapsed time receive from LIN raw value" UWORD OneToOne 1 100 0.00 65535.00 FORMAT "%8.2" ECU_ADDRESS 0x60004C7A /end MEASUREMENT
/begin MEASUREMENT Lin_BS_Signal_B_tMaxBatt_8_r_msg "Max T_BATT during soak receive from LIN raw value" UBYTE OneToOne 1 100 0.00 255.0 FORMAT "%5.1" ECU_ADDRESS 0x6000A340 /end MEASUREMENT
/begin MEASUREMENT Lin_BS_Signal_B_tMinBatt_8_r_msg "Min T_BATT during soak receive from LIN raw value" UBYTE OneToOne 1 100 0.00 255.0 FORMAT "%5.1" ECU_ADDRESS 0x6000A33F /end MEASUREMENT
/begin MEASUREMENT Lin_BS_Signal_B_uBattSOFV_8_r_msg "State of Function receive from LIN raw value" UBYTE OneToOne 1 100 0.00 255.0 FORMAT "%5.1" ECU_ADDRESS 0x6000A33E /end MEASUREMENT
/begin MEASUREMENT Lin_BS_Signal_B_UBAT_16_r_msg "Battery Voltage receive from LIN raw value" UWORD OneToOne 1 100 0.00 65535.00 FORMAT "%8.2" ECU_ADDRESS 0x60004C8E /end MEASUREMENT
/begin MEASUREMENT Lin_BS_Signal_B_uPeak_16_r_msg "Min Voltage at cranking receive from LIN raw value" UWORD OneToOne 1 100 0.00 65535.00 FORMAT "%8.2" ECU_ADDRESS 0x60004C78 /end MEASUREMENT
/begin MEASUREMENT Lin_BS_Signal_B_xMnfcDate_16_r_msg "Manufacure Date receive from LIN raw value" UWORD OneToOne 1 100 0.00 65535.00 FORMAT "%8.2" ECU_ADDRESS 0x60004C76 /end MEASUREMENT
/begin MEASUREMENT Lin_BS_Signal_ERRCMN_1_r_msg "Sensor error flag receive from LIN raw value" UBYTE OneToOne 1 100 0.00 255.0 FORMAT "%5.1" ECU_ADDRESS 0x6000A33D /end MEASUREMENT
/begin MEASUREMENT Lin_BS_Signal_ERRST_1_r_msg "The status of Sensor error after ignition off receive from LIN raw value" UBYTE OneToOne 1 100 0.00 255.0 FORMAT "%5.1" ECU_ADDRESS 0x6000A33C /end MEASUREMENT
/begin MEASUREMENT PT_stConvGrip "Grip status Clutch" UBYTE OneToOne 1 100 0.00 255.0 FORMAT "%5.1" ECU_ADDRESS 0x70002D8E /end MEASUREMENT
/begin MEASUREMENT TS_bEngStopEna "stop release thermal system" UBYTE B_TRUE 1 100 0.00 1.00000000000 BIT_MASK 0x1 FORMAT "%13.11" ECU_ADDRESS 0x7000065C /end MEASUREMENT
/begin MEASUREMENT TS_bEngStrtReq "start request thermal system" UBYTE B_TRUE 1 100 0.00 1.00000000000 BIT_MASK 0x1 FORMAT "%13.11" ECU_ADDRESS 0x7000065B /end MEASUREMENT
/begin MEASUREMENT TS_nMax "Highest engine speed requested by the thermal system" SWORD EngN 1 100 -16384.00 16383.50 FORMAT "%8.2" ECU_ADDRESS 0x60004F00 /end MEASUREMENT
/begin MEASUREMENT TS_nMin "Lowest engine speed requested by the thermal system" SWORD EngN 1 100 -16384.00 16383.50 FORMAT "%8.2" ECU_ADDRESS 0x60004EFE /end MEASUREMENT
/begin MEASUREMENT TS_trqDesAcs "Desired Torque demand of the thermal system" SWORD Trq 1 100 -3276.800 3276.700 FORMAT "%8.3" ECU_ADDRESS 0x60004EFA /end MEASUREMENT
/begin MEASUREMENT TS_trqResvAcs "Torque reserve of the thermal system" SWORD Trq 1 100 -3276.800 3276.700 FORMAT "%8.3" ECU_ADDRESS 0x60004EF8 /end MEASUREMENT
/begin FUNCTION ComScl_EngLin "15.5.0_6SAASignal processing of frames from Engine ECU over Lin"
 /begin IN_MEASUREMENT Lin_Alt_Signal_AdjVltgDem_6_w_msg Lin_Alt_Signal_DbgInfoTx_3_w_msg Lin_Alt_Signal_DeMagCnclSpd_4_w_msg Lin_Alt_Signal_DeMagTime_4_w_msg Lin_Alt_Signal_MagCrntLim_8_w_msg Lin_BS_B_Signal_BattID_8_w_msg Lin_BS_B_Signal_T15_st_1_w_msg Lin_BS_Signal_B_BitEna_1_w_msg Lin_BS_Signal_B_LINTypTx_4_w_msg Lin_BS_Signal_B_ReLrngReq_st_1_w_msg /end IN_MEASUREMENT
 /begin OUT_MEASUREMENT Lin_Alt_B_Signal_ACG_Temp_8_r_msg Lin_Alt_B_Signal_ComTOut_1_r_msg Lin_Alt_B_Signal_Com_1_r_msg Lin_Alt_B_Signal_Dyc_5_r_msg Lin_Alt_B_Signal_Elec_1_r_msg Lin_Alt_B_Signal_ExctCrnt_8_r_msg Lin_Alt_B_Signal_HiTemp_1_r_msg Lin_Alt_B_Signal_Mchn_1_r_msg Lin_BS_B_Signal_OCV_8_r_msg Lin_BS_B_Signal_STBATTSENRST_1_r_msg Lin_BS_B_Signal_TASIC_8_r_msg Lin_BS_B_Signal_tiDurAftIgnOff_16_r_msg Lin_BS_Signal_B_BattChg_2_r_msg Lin_BS_Signal_B_BATTCH_16_r_msg Lin_BS_Signal_B_BATTDCHA_16_r_msg Lin_BS_Signal_B_BATT_WARM_LEVEL_3_r_msg Lin_BS_Signal_B_BCF_1_r_msg Lin_BS_Signal_B_CHARERR_1_r_msg Lin_BS_Signal_B_ctCrkngDetn_16_r_msg Lin_BS_Signal_B_CTINTRESUPD_2_r_msg Lin_BS_Signal_B_ctMeasmtCrk_2_r_msg Lin_BS_Signal_B_CtResRpl_5_r_msg Lin_BS_Signal_B_ERROR_RES_1_r_msg Lin_BS_Signal_B_iBattStrtCrn_14_r_msg Lin_BS_Signal_B_IBAT_16_r_msg Lin_BS_Signal_B_IBAT_8_r_msg Lin_BS_Signal_B_idBattData_8_r_msg Lin_BS_Signal_B_iMaxBattDcha_16_r_msg Lin_BS_Signal_B_iStByCurrAft0h_10_r_msg Lin_BS_Signal_B_iStByCurrAft1h_10_r_msg Lin_BS_Signal_B_iStByCurrAft2h_10_r_msg Lin_BS_Signal_B_iStByCurrLst_10_r_msg Lin_BS_Signal_B_LIN_TYPE_RX_4_r_msg Lin_BS_Signal_B_numBattPart_8_r_msg Lin_BS_Signal_B_numLowSOCDetn_8_r_msg Lin_BS_Signal_B_PulResUpd_2_r_msg Lin_BS_Signal_B_RESMEASDBATT_16_r_msg Lin_BS_Signal_B_resPul_16_r_msg Lin_BS_Signal_B_ResRpl_11_r_msg Lin_BS_Signal_B_SOC_10_r_msg Lin_BS_Signal_B_SOC_STATE_3_r_msg Lin_BS_Signal_B_SOHSOFLrng_2_r_msg Lin_BS_Signal_B_SOH_10_r_msg Lin_BS_Signal_B_stChrgReq_3_r_msg Lin_BS_Signal_B_stFitng_1_r_msg Lin_BS_Signal_B_stHarnR_2_r_msg Lin_BS_Signal_B_SUPPLIER_CODE_8_r_msg Lin_BS_Signal_B_TBattResPul_8_r_msg Lin_BS_Signal_B_TBAT_8_r_msg Lin_BS_Signal_B_TerminalOFFDetn_2_r_msg Lin_BS_Signal_B_tiBattON_16_r_msg Lin_BS_Signal_B_tiT15ON_11_r_msg Lin_BS_Signal_B_tMaxBatt_8_r_msg Lin_BS_Signal_B_tMinBatt_8_r_msg Lin_BS_Signal_B_uBattSOFV_8_r_msg Lin_BS_Signal_B_UBAT_16_r_msg Lin_BS_Signal_B_uPeak_16_r_msg Lin_BS_Signal_B_xMnfcDate_16_r_msg Lin_BS_Signal_ERRCMN_1_r_msg Lin_BS_Signal_ERRST_1_r_msg /end OUT_MEASUREMENT
 FUNCTION_VERSION "15.5.0_6SAA" /end FUNCTION
/begin FUNCTION ComScl_Gbx "33.3.0_1.0.0Signal processing of frames from Gearbox ECU"
 /begin OUT_MEASUREMENT Com_bTSCIntvSlow Com_ctCRingEAT1 Com_ctCRingEAT10 Com_ctCRingEAT11 Com_ctCRingEAT12 Com_ctCRingEAT13 Com_ctCRingEAT2 Com_ctCRingEAT4 Com_ctCRingEAT6 Com_ctCRingEAT7 Com_ctCRingEAT8 Com_ctCRingEATA Com_ctCRingEATB Com_ctCRingEATC Com_flgACCutDurgAtCvt Com_flgCvtFcoPrms Com_flgExecdManMod Com_lTotRingEATA Com_nIdlDes Com_nTrbn Com_nTrsmMaiShaft Com_numCsumEAT1 Com_numCsumEAT10 Com_numCsumEAT11 Com_numCsumEAT12 Com_numCsumEAT13 Com_numCsumEAT2 Com_numCsumEAT4 Com_numCsumEAT6 Com_numCsumEAT7 Com_numCsumEAT8 Com_numCsumEATA Com_numCsumEATB Com_numCsumEATC Com_numCvtGearShiftMap Com_rConvBoostRaw Com_rConvSlip Com_rCVTAct Com_rTarInfo Com_rTarPllyEAT7 Com_rTrsmTotFild Com_stAmbLmpPrms Com_stATFailr Com_stATFTVal Com_stATMILReqEAT8 Com_stCfmdNPosn Com_stCfmdPPosnFCAN Com_stCfmdPPosnPTCAN Com_stCVTDsplGear Com_stCVTEngmtInfo Com_stCVTFailr Com_stCVTFailrInfo Com_stCvtPosnPrms Com_stCVTShiftActv Com_stDFailrIndcn Com_stFwdRvsCluInfo Com_stGearChgCtrlMod Com_stGearPPosnReqPTCAN Com_stHvyDecelFlg Com_stIdleStrtStopDispFct Com_stLCInfo Com_stLCZone Com_stMilLtgReq Com_stMissSnsrFlg Com_stMLtgInfo Com_stNotTxDrvgFFCAN Com_stNotTxDrvgFPTCAN Com_stPreStop Com_stShftInD Com_stShftInL Com_stShftInNeutr Com_stShftInPark Com_stShftInRev Com_stShftInS Com_stShiftDwnReco Com_stShiftPosnIndcnRaw Com_stShiftUpReco Com_stSpdSnsrFailr Com_stTCUECUIG1 Com_stTMTqDwnReq Com_stTranStop Com_stTrsmFailMod Com_stVehSpdSensErr Com_stVehSpdSnsr Com_stVINWrClrDone Com_stVSAInh Com_trqEATReq Com_uBattDetnTCUECU Com_uIG1DetnTCUECU Com_vVehCtl Com_vVehInstPnl Com_vVehSpdCVTCtrl Com_vVehTcu Gbx_nMaxEngFco Gbx_nMaxEngTrqLim Gbx_tOilConv Gbx_trqOilPmpLos Gbx_trqTSCIntvSlow /end OUT_MEASUREMENT
 FUNCTION_VERSION "33.3.0_1.0.0" /end FUNCTION
/begin FUNCTION ComScl_Gw "17.2.0_1.0.0Signal processing of frames from Gateway"
 /begin OUT_MEASUREMENT Com_ctCRingCGW1 Com_ctCRingGwIMG1 Com_ctCRingGwIMG3 Com_ctCRingGwIMG4 Com_ctCRingGwIMG5 Com_ctCRingGwIMG6 Com_numCsumCGW1 Com_numCsumGwIMG1 Com_numCsumGwIMG3 Com_numCsumGwIMG4 Com_numCsumGwIMG5 Com_numCsumGwIMG6 Com_stClrCmplInfoVINRegst Com_stEngCanRxErr Com_stIMGACCBrkReq Com_stIMGDrvTq Com_stIMGECUIG1 Com_stIMGIDSDrvMod Com_stIMGISBrkCntrADAS Com_stIMGISBrkHldActv Com_stIMGISBrkHldStb Com_stIMGISInhbBrk Com_stIMGISRlsReq Com_stIMGISRstrtInhbBrk Com_stIMGISShiftInhbBrk Com_stIMGISSysOffBrk Com_stIMGLimTq Com_stIMGMILReq Com_stIMGShiftReq Com_tqIMGReqDrv Com_tqIMGSuppReq Com_uBattDetnIMGECU Com_uIG1DetnIMGECU /end OUT_MEASUREMENT
 FUNCTION_VERSION "17.2.0_1.0.0" /end FUNCTION
/begin FUNCTION ComScl_IDAS "1.0.0_6SAASignal processing of frames from IDAS (Intelligent Driver Assistance System)" /begin OUT_MEASUREMENT Com_ctCRingIDASB Com_numCsumIDASB Com_stISABasSpd /end OUT_MEASUREMENT FUNCTION_VERSION "1.0.0_6SAA" /end FUNCTION
/begin FUNCTION ComScl_PCU "5.1.0_6SAASignal processing of frames from Powermanagement ECU" /begin OUT_MEASUREMENT Com_ctCRingPCU Com_numCsumPCU Com_stPCUEngStrtInhb /end OUT_MEASUREMENT FUNCTION_VERSION "5.1.0_6SAA" /end FUNCTION
/begin FUNCTION ComScl_StbIntv "7.1.0_6SAASignal processing of frames from Stability Intervention ECU"
 /begin OUT_MEASUREMENT Com_bAYCCond Com_bAYCReWr Com_bBrkPedON Com_ctCRingAYCA Com_ctCRingAYCF Com_ctCRingAYCG Com_ctCRingAYCI Com_ctCRingEBBA Com_numCsumAYCA Com_numCsumAYCD Com_numCsumAYCF Com_numCsumAYCG Com_numCsumAYCI Com_numCsumEBBA Com_pMstCyl Com_stABSCtrl Com_stABSEBDFailr Com_stABSWrn Com_stACCBrk Com_stActABSEBD Com_stAYCF Com_stAYCFShiftReq Com_stBrkPedON Com_stCarAcsSysActv Com_stCarAcsSysPtdOper Com_stDCSPlusAYCF Com_stEBB Com_stFailMstCylPSnsr Com_stFrntLeWhlSpdSnsrErr Com_stFrntRiWhlSpdSnsrErr Com_stFuCtrlReqRaw Com_stInhbMstCylPSnsr Com_stISABActAYCI Com_stISABEnaAYCI Com_stLatGASensInh Com_stLgtGASensErr Com_stLgtGASensInh Com_stReLeWhlSpdSnsrErr Com_stReRiWhlSpdSnsrErr Com_stSteerSnsrInhb Com_stVSACtrl Com_stVSALampOff Com_stVSATCSFailr Com_stYawRateSnsrErr Com_stYawRateSnsrInhb Com_tqBrkOperAYCG Com_tqBrkOperAYCI Com_trqAYCFDes Com_vFLWhlSpd Com_vFRWhlSpd Com_vRLWhlSpd Com_vRRWhlSpd /end OUT_MEASUREMENT
 FUNCTION_VERSION "7.1.0_6SAA" /end FUNCTION
/begin FUNCTION ComScl_Strg "13.1.0_6SAASignal processing of frames from Steering Angle ECU"
 /begin OUT_MEASUREMENT Com_ctCRingEPS1 Com_iElecLd Com_numCsumEPS1 Com_stEPS1ISSRelsReq Com_stEPSISSInhbReq Com_stEPSMidReq /end OUT_MEASUREMENT
 FUNCTION_VERSION "13.1.0_6SAA" /end FUNCTION
/begin FUNCTION ConversionSpecial_CELPrj "30059.0.0 Conversion Formulas Special, which are migrated from GS" FUNCTION_VERSION "30059.0.0" /end FUNCTION
/begin FUNCTION Conversion_CELPrj "30059.0.0 Conversion Formulas, which are migrated from GS classic" FUNCTION_VERSION "30059.0.0" /end FUNCTION
/begin FUNCTION Conv_GripIntrlck "8.0.0     Converter Grip Interlock" /begin IN_MEASUREMENT Clth_st /end IN_MEASUREMENT /begin OUT_MEASUREMENT PT_stConvGrip /end OUT_MEASUREMENT FUNCTION_VERSION "8.0.0" /end FUNCTION
/begin FUNCTION Conv_LdCalc "41.3.0    Torque load converter calculation"
 /begin DEF_CHARACTERISTIC Conv_facDepNTrbnNStat_CUR Conv_facDeptNTrbnNStat_M Conv_facGnTrqHiInc_C Conv_facGnTrqResv_C Conv_facNTrbnCorr_C Conv_facRedCnvrLoad_C Conv_facVelErr_C Conv_facVelNoErr_C Conv_flgDecelTqAPSeln_C Conv_flgEnaTqResvShiftLvr_C Conv_flgSwtGearLvrNoGrip_C Conv_flgSwtInGearSeln_C Conv_flgSwtOutGearSeln_C Conv_flgSwtSelnCURM_C Conv_flgTrbnSpdDifSeln_C Conv_LvrOffDebP.tiHiLo_C Conv_LvrOffDebP.tiLoHi_C Conv_LvrPosChgDRDebT.tiHiLo_C Conv_LvrPosChgDRDebT.tiLoHi_C Conv_LvrPosChgRDDebT.tiHiLo_C Conv_LvrPosChgRDDebT.tiLoHi_C Conv_LvrPosOffDebP.tiHiLo_C Conv_LvrPosOffDebP.tiLoHi_C Conv_nDecelTqDifThdHi_C Conv_nDecelTqDifThdLo_C Conv_nDecelTqThdHi_C Conv_nDecelTqThdLo_C Conv_nrTrbAvrg_C Conv_nTrbnLoLim_C Conv_nTrbnMinCorrVal_C Conv_nTrbn_C Conv_numLvrPosFwdGear_C Conv_numLvrPosNeut_C Conv_numLvrPosPark_C Conv_numLvrPosRevGear_C Conv_rDecelTqThd_C Conv_stCalcNTrbnNStat_C Conv_stDecelTqBrk_C Conv_stSwtRedCnvrLoad_C Conv_stTqResvDrvRevEna_C Conv_swtOilCoolrOfsSel_C Conv_swtOilPmpLoss_C Conv_tiDecelTqMax_C Conv_tiDecelTqToffd_C Conv_tiDwnRglPT1_GCUR Conv_tiGearChgDRPT1_GCUR Conv_tiGearChgDR_C Conv_tiGearChgRD_C Conv_tiNCtrlPT1_GCUR Conv_tiRTraGearPT1_C Conv_tiTrqLdPT1_C Conv_tiTrqResvPT1_GCUR Conv_tiUpRglPT1_GCUR Conv_tOil_DST Conv_tqDecelOffsRedn_C Conv_tqDecelOffs_M Conv_trqLdGnFacHysDec_C Conv_trqLdMaxLim_MAP Conv_trqLdReplCan_C Conv_TrqResvDebP.tiHiLo_C Conv_TrqResvDebP.tiLoHi_C Conv_trqResvLoLim_C Conv_trqResvMaxLim_C Conv_trqResvMinLim_C Conv_trqResvNeutrLvrPos_C Conv_trqResvPreFlt_C Conv_trqResvRepl_C Conv_trqStatSqLvrPosNeutr_C Conv_vDecelTqThdHi_C Conv_vDecelTqThdLo_C Gbx_stNCtrl_CW Gbx_stOilPmpFlt_CW Gbx_stOilPmp_CW Gbx_tiOilPmpTrq_C /end DEF_CHARACTERISTIC
 /begin REF_CHARACTERISTIC Conv_trqDfl_C /end REF_CHARACTERISTIC
 /begin IN_MEASUREMENT AccPed_tqMapBasd Brk_st B_ll_msg Conv_bCalc Conv_bConvActv Conv_bGearOff Conv_bTrbnSpdCan Conv_bTrqLdCan Conv_bTrqLdFlt Conv_bTrqResvBrkEnd Conv_bTrqResvLvrOff Conv_facOilTempDepTrqPmp Conv_tiTDeptRevLvrDebNegNeut Conv_tiTDeptRevLvrDebNegPark Conv_tiTDpdtLvrDrvRevDebPos Conv_tiTDpdtLvrRevDrvDebPos Conv_tiTempDepLvrDebNeg Conv_tiTempDepLvrDebPos Conv_tiTempDepRevLvrDebPos Conv_tOil Conv_tqResvTDeptDrvRev Conv_trqLdLvrPosNeutr Conv_trqLdRevLvrPos Conv_trqLdTempDepLim Conv_trqLosDfftl Conv_trqOilCoolrPmp Conv_trqOilCoolrPmpRepl Conv_trqResvTempDep Epm_nEng Gbx_flgNCtrlImp Gbx_flgNCtrlRetStrt Gbx_nTrbn Gbx_ratOilCoolrPmp Gbx_stGearLvr Gbx_stPNPos Gbx_trqConvLos Gbx_trqOilPmpLos GlbDa_lWhlCirc GlbDa_vXFlt HLSDem_nSetPTrck PT_bConvSlipOpn PT_bNoGrip PT_rTraGear PT_rTrq PT_stTraType RngMod_trqCrSMinWoCtOff SpdGov_nSetPLo SyC_ctPostDrvLeave Tra_flgNeutPrkg Tra_numGear TS_tClntEngOut VehMot_rTrqDfftl VehMot_stBrkPed /end IN_MEASUREMENT
 /begin OUT_MEASUREMENT Conv_bRevLvrPos Conv_bTrqResv Conv_nTrbn Conv_nTrbnMod Conv_nTrbnOld Conv_trqLd Conv_trqLdFlt Conv_trqLdMod Conv_trqLdPreFlt Conv_trqOilPmpLoss Conv_trqResv /end OUT_MEASUREMENT
 /begin LOC_MEASUREMENT Conv_bCalcActv_mp Conv_bLvrPosDebRD_mp Conv_bLvrPosRD_mp Conv_cntrPostDrvLve Conv_facDepNTrbnNStat_mp Conv_facIntrpn Conv_facRedCnvrLoad Conv_flgDecelTq Conv_flgDecelTqCdn Conv_flgDRGearShift Conv_flgDRGearShiftDeb Conv_flgRDGearShift Conv_flgRDGearShiftDeb Conv_flgTqOffsTiMax Conv_idxCurPosn Conv_nDifAvrg Conv_nrPrevGear Conv_nrTrbAvrg Conv_nTrbDifAry Conv_nTrbnCorrVal_mp Conv_nTrbnDiff_mp Conv_nTrbnExp_mp Conv_rNTrbnNStat_mp Conv_tiDepLvrDeb Conv_tqDecelOffs Conv_tqEngTqDe Conv_tqPmpDrvOff Conv_tqPmpHiSpd Conv_tqPmpHiSpdTmp Conv_tqPmpLoSpd Conv_tqPmpLoSpdTmp Conv_tqPmpStat Conv_tqPmpStd Conv_trqLdBefLim_mp Conv_trqLdDiff_mp Conv_trqLdFltRslt_mp Conv_trqLdMaxLim_mp Conv_trqLdOfs Conv_trqLdOfs_mp Conv_trqLdResvAdd_mp Conv_trqLdResvFlt_mp Conv_trqLdTrqResvTotBuf_mp Conv_trqLosDfftl_mp Conv_trqPmpBuf_mp Conv_trqResvHiInc_mp Conv_trqStatSqBuf_mp /end LOC_MEASUREMENT
 FUNCTION_VERSION "41.3.0" /end FUNCTION
/begin FUNCTION Conv_LdData "27.3.0    Torque converter load data"
 /begin DEF_CHARACTERISTIC Conv_BrkDebP.tiHiLo_C Conv_BrkDebP.tiLoHi_C Conv_facClthClsd_GCUR Conv_facClthOpnd_GCUR Conv_facDfl_C Conv_stCylVrnt_C Conv_tiDfl_C Conv_tiLvrChgDrvRvs_GCUR Conv_tiLvrChgRvsDrv_GCUR Conv_tiRevLvrOffNeut_GT Conv_tiRevLvrOffPark_GT Conv_tiRevLvrOn_GCUR Conv_tiTempDepLvrOff_GCUR Conv_tiTempDepLvrOn2_GT Conv_tiTempDepLvrOn_GT Conv_tPntDST_AXIS Conv_tqResvTDpdtDRACOn_GCUR Conv_tqResvTDpdtDR_GCUR Conv_trqDfl_C Conv_trqLdActv_CW Conv_trqLdLvrPosNeutr_GCUR Conv_trqLdRevLvrPos_GCUR Conv_trqLdTempDepLim_GCUR Conv_trqLd_CW Conv_trqLosDfftl_map Conv_trqResvTempDep2_GT Conv_trqResvTempDepACOn2_GT Conv_trqResvTempDepACOn_GT Conv_trqResvTempDep_GT /end DEF_CHARACTERISTIC
 /begin IN_MEASUREMENT ACCtl_stOut Com_stBCDGearEngmt Gbx_tOilConv GlbDa_vXFlt SyC_ctPostDrvLeave TS_tClntEngOut VehMot_stBrkPed /end IN_MEASUREMENT
 /begin OUT_MEASUREMENT Conv_bCalc Conv_bConvActv Conv_bGearOff Conv_bTrbnSpdCan Conv_bTrqLdCan Conv_bTrqLdFlt Conv_bTrqResvBrkEnd Conv_bTrqResvLvrOff Conv_facOilTempDepTrqPmp Conv_tiTDeptRevLvrDebNegNeut Conv_tiTDeptRevLvrDebNegPark Conv_tiTDpdtLvrDrvRevDebPos Conv_tiTDpdtLvrRevDrvDebPos Conv_tiTempDepLvrDebNeg Conv_tiTempDepLvrDebPos Conv_tiTempDepRevLvrDebPos Conv_tOil Conv_tqResvTDeptDrvRev Conv_trqLdLvrPosNeutr Conv_trqLdRevLvrPos Conv_trqLdTempDepLim Conv_trqLosDfftl Conv_trqResvTempDep /end OUT_MEASUREMENT
 /begin LOC_MEASUREMENT Conv_cntrPostLve Conv_tOilBuf /end LOC_MEASUREMENT
 FUNCTION_VERSION "27.3.0" /end FUNCTION
/begin FUNCTION Conv_TrqRat "2.11.0    Torque load converter" /begin DEF_CHARACTERISTIC Conv_rTrq_C /end DEF_CHARACTERISTIC /begin OUT_MEASUREMENT Conv_rTrq /end OUT_MEASUREMENT FUNCTION_VERSION "2.11.0" /end FUNCTION
/begin FUNCTION CoPOM_FirstStrtReq "135.3.0   Evaluation of request for first start"
 /begin DEF_CHARACTERISTIC CoPOM_flgPsdBrkPedlRqrdForT50Strt_C CoPOM_flgStrtRelsDurgT50_C CoPOM_tiPanicStrtReq_C CoPOM_tiT50ReqCnclDly_C CoPOM_tiT50ReqPreDrvCnclDly_C /end DEF_CHARACTERISTIC
 /begin IN_MEASUREMENT Brk_st CoEng_stMai EngStrt_stStrtReq PT_bAutoStrtRls PT_stTraType T50_st /end IN_MEASUREMENT
 /begin OUT_MEASUREMENT CoPOM_stEngFirstStrtReq /end OUT_MEASUREMENT
 /begin LOC_MEASUREMENT CoPOM_CnclStrtReqTON_I.XOld CoPOM_CnclStrtReqTON_I.Timer CoPOM_DrvrStrtReqRSFF_I CoPOM_FirstStrtRelsEF_I CoPOM_flgCnclStrtReq CoPOM_flgMemdDrvrStrtReq CoPOM_flgMemdDrvrStrtReqCncl CoPOM_flgMemdRstStrtReq CoPOM_flgPtStrtRels CoPOM_PanicStrtTON_I.XOld CoPOM_PanicStrtTON_I.Timer CoPOM_RstStrtReqRSFF_I CoPOM_stEngFirstStrtReqOld CoPOM_StrtReqCnclTOFF_I.XOld CoPOM_StrtReqCnclTOFF_I.Timer CoPOM_StrtReqPreDrvCnclTOFF_I.XOld CoPOM_StrtReqPreDrvCnclTOFF_I.Timer CoPOM_T50RstER_I CoPOM_T50St0EF_I CoPOM_T50St0ER_I /end LOC_MEASUREMENT
 FUNCTION_VERSION "135.3.0" /end FUNCTION
/begin FUNCTION CoPOM_StM "12.4.0    Statemachine for Hybrid Operation Mode Coordination"
 /begin IN_MEASUREMENT CoPOM_stEngFirstStrtReq CoVeh_stEngStopOrd CoVeh_stEngStrtOrd MoF_stStrtMsg /end IN_MEASUREMENT
 /begin OUT_MEASUREMENT CoPOM_stEngSpstReq /end OUT_MEASUREMENT
 FUNCTION_VERSION "12.4.0" /end FUNCTION
/begin FUNCTION CoPOM_StrtgDevCdn "2.6.0     Starting Devices Conditions"
 /begin DEF_CHARACTERISTIC CoPOM_cntAbortStrtrLim_C CoPOM_tiDlyNxtStrtAftAbort_C CoPOM_tiStrtrOperMaxFault_C CoPOM_tiStrtrOperMax_T CoPOM_tqStrtDevStrtr_C /end DEF_CHARACTERISTIC
 /begin IN_MEASUREMENT CEngDsT_t CoEng_stMai MoF_stStrtMsg Strt_st T50_st /end IN_MEASUREMENT
 /begin OUT_MEASUREMENT CoPOM_tqStrtDevStrtr /end OUT_MEASUREMENT
 /begin LOC_MEASUREMENT CoPOM_AbortStrtrER_I CoPOM_cntAbortStrtr CoPOM_cntAbortStrtrOld CoPOM_flgAbortStrtr CoPOM_flgAbortStrtrLimReachd CoPOM_flgStrtPrms CoPOM_flgStrtrStrtRels CoPOM_NxtStrtAftAbortTOFF_I.XOld CoPOM_NxtStrtAftAbortTOFF_I.Timer CoPOM_StrtrMaxAbortTON_I.XOld CoPOM_StrtrMaxAbortTON_I.Timer /end LOC_MEASUREMENT
 FUNCTION_VERSION "2.6.0" /end FUNCTION
/begin FUNCTION CoPT_ThermDem "3.9.0     Driver train co-ordinator - Co-ordination of thermal requirements" /begin IN_MEASUREMENT CoTemp_rClgDes CoTemp_tEngDes Tra_rClgDem Tra_tClntDes /end IN_MEASUREMENT /begin OUT_MEASUREMENT CoPT_rClgDes CoPT_tClntDes /end OUT_MEASUREMENT FUNCTION_VERSION "3.9.0" /end FUNCTION
/begin FUNCTION CoTemp_DmAirDesVal "2.3.0     Coordinator Temperature - calculation of air mass flow desired value for cooling" /begin DEF_CHARACTERISTIC CoTemp_rClgDes_CUR /end DEF_CHARACTERISTIC /begin IN_MEASUREMENT EngDa_tEng /end IN_MEASUREMENT /begin OUT_MEASUREMENT CoTemp_rClgDes /end OUT_MEASUREMENT FUNCTION_VERSION "2.3.0" /end FUNCTION
/begin FUNCTION CoTemp_TEngDesVal "2.2.0     Coordinator Temperature -calculation of engine coolant temperature desired value"
 /begin DEF_CHARACTERISTIC CoTemp_tEngClntAftRunDes_C CoTemp_tEngClntIniDes_C CoTemp_tEngDesBaseNTrq_MAP CoTemp_tEngDesBaseTempVel_MAP /end DEF_CHARACTERISTIC
 /begin IN_MEASUREMENT EnvT_t Epm_nEng PthSet_trqInrSet SyC_stSub VehV_v /end IN_MEASUREMENT
 /begin OUT_MEASUREMENT CoTemp_tEngDes /end OUT_MEASUREMENT
 FUNCTION_VERSION "2.2.0" /end FUNCTION
/begin FUNCTION CoTE_ThermDem "2.2.0     Coordinator Thermal Energy" /begin IN_MEASUREMENT CoPT_rClgDes CoPT_tClntDes /end IN_MEASUREMENT /begin OUT_MEASUREMENT CoVeh_rClgDes CoVeh_tClntDes /end OUT_MEASUREMENT FUNCTION_VERSION "2.2.0" /end FUNCTION
/begin FUNCTION CoTS_EnaSSE "18.0.0    Thermal System Coordinator Enable Engine Start Stop"
 /begin DEF_CHARACTERISTIC CoTS_rhoEnvAirThresDelta_C CoTS_rhoEnvAirThresLo_C CoTS_rhoStopEna_MAP CoTS_tClntStopThresDelta_C CoTS_tClntStopThresHi_C CoTS_tClntStopThresLo_C CoTS_tClntStrtThresDelta_C CoTS_tClntStrtThresHi_C CoTS_tClntStrtThresLo_C /end DEF_CHARACTERISTIC
 /begin IN_MEASUREMENT EnvP_p EnvT_t T15_st TS_tClntEngOut /end IN_MEASUREMENT
 /begin OUT_MEASUREMENT CoTS_rhoAir CoTS_stSSEStopInhb TS_bEngStopEna TS_bEngStrtReq /end OUT_MEASUREMENT
 FUNCTION_VERSION "18.0.0" /end FUNCTION
/begin FUNCTION CoTS_MechDem "2.14.0    Thermal System Coordinator Mechanical Demand" /begin IN_MEASUREMENT CTM_nMin CTM_trqDes CTM_trqResv Fans_trqCons Fans_trqResv /end IN_MEASUREMENT /begin OUT_MEASUREMENT TS_nMax TS_nMin TS_trqDesAcs TS_trqResvAcs /end OUT_MEASUREMENT FUNCTION_VERSION "2.14.0" /end FUNCTION
/begin FUNCTION CoTS_ShutOffAcs "2.12.0    Thermal System Coordinator Accessories Shut Off" /begin IN_MEASUREMENT CoVeh_trqMaxAC /end IN_MEASUREMENT /begin OUT_MEASUREMENT CoTS_trqMaxAC /end OUT_MEASUREMENT FUNCTION_VERSION "2.12.0" /end FUNCTION
/begin FUNCTION CoTS_ThermDem "1.15.0    Thermal System Coordinator Demand - Thermal demand" /begin DEF_CHARACTERISTIC CoTS_tClntEngOutDes_C CoTS_tiPT1Neg_C CoTS_tiPT1Pos_C /end DEF_CHARACTERISTIC /begin IN_MEASUREMENT CoVeh_rClgDes CoVeh_tClntDes /end IN_MEASUREMENT /begin OUT_MEASUREMENT CoTS_rClgDem CoTS_tClntEngOutDes /end OUT_MEASUREMENT /begin LOC_MEASUREMENT CoTS_tClntDesFlt /end LOC_MEASUREMENT FUNCTION_VERSION "1.15.0" /end FUNCTION
/begin FUNCTION COVEH2ME "135.1.0   Interface adapter CoVeh to MED 7/9" /begin IN_MEASUREMENT CoVeh_stEngStopOrd CoVeh_stEngStrtOrd /end IN_MEASUREMENT /begin OUT_MEASUREMENT B_staanf_msg B_stoanf_msg /end OUT_MEASUREMENT FUNCTION_VERSION "135.1.0" /end FUNCTION
/begin COMPU_METHOD B_TRUE "" TAB_VERB "%6.3" "" COMPU_TAB_REF B_TRUE /end COMPU_METHOD
/begin COMPU_VTAB B_TRUE "" TAB_VERB 2 0 "FALSE" 1 "TRUE" /end COMPU_VTAB
/begin COMPU_METHOD Com_Fact_b0p00006 "" RAT_FUNC "%7.6" "-" COEFFS 0 16384 0 0 0 1 /end COMPU_METHOD
/begin COMPU_METHOD CrCtlSlipRat "" RAT_FUNC "%6.4" "%" COEFFS 0 200 0 0 0 1 /end COMPU_METHOD
/begin COMPU_METHOD Curr_A "" RAT_FUNC "%6.4" "A" COEFFS 0 100 0 0 0 1 /end COMPU_METHOD
/begin COMPU_METHOD Dens_q0p001_COMPU "" RAT_FUNC "%6.5" "kg/m^3" COEFFS 0 1000 0 0 0 1 /end COMPU_METHOD
/begin COMPU_METHOD DFES_nPID0C "" RAT_FUNC "%6.3" "rpm" COEFFS 0 4 0 0 0 1 /end COMPU_METHOD
/begin COMPU_METHOD DPF_TYPTWNFLW_SY_Compu "" TAB_VERB "%6.3" "" COMPU_TAB_REF DPF_TYPTWNFLW_SY_Compu /end COMPU_METHOD
/begin COMPU_VTAB DPF_TYPTWNFLW_SY_Compu "" TAB_VERB 2 0 "False" 1 "True" /end COMPU_VTAB
/begin COMPU_METHOD DPLLSUSV06_SY_Compu "" TAB_VERB "%6.3" "" COMPU_TAB_REF DPLLSUSV06_SY_Compu /end COMPU_METHOD
/begin COMPU_VTAB DPLLSUSV06_SY_Compu "" TAB_VERB 2 0 "False" 1 "True" /end COMPU_VTAB
/begin COMPU_METHOD dPres_hPa_p_s "" RAT_FUNC "%6.2" "hPa/s" COEFFS 0 1 0 0 0 1 /end COMPU_METHOD
/begin COMPU_METHOD DRCTSTRT_SY_Compu "" TAB_VERB "%6.3" "" COMPU_TAB_REF DRCTSTRT_SY_Compu /end COMPU_METHOD
/begin COMPU_VTAB DRCTSTRT_SY_Compu "" TAB_VERB 4 0 "DRCTSTRT_DISBL" 1 "DRCTSTRT_STASUPRT" 2 "DRCTSTRT_NOSTASUPRT" 3 "DRCTSTRT_STASPFI" /end COMPU_VTAB
/begin COMPU_METHOD DREQSWT_CLRSWTSIG_SY_Compu "" TAB_VERB "%6.3" "" COMPU_TAB_REF DREQSWT_CLRSWTSIG_SY_Compu /end COMPU_METHOD
/begin COMPU_VTAB DREQSWT_CLRSWTSIG_SY_Compu "" TAB_VERB 3 0 "NOT_CONFIGURED" 1 "CONNECT_DIO" 2 "CONNECT_CAN" /end COMPU_VTAB
/begin COMPU_METHOD drLamRec_Persec "" RAT_FUNC "%6.4" "1/s" COEFFS 0 100 0 0 0 1 /end COMPU_METHOD
/begin COMPU_METHOD DRVMOD_SC_Compu "" TAB_VERB "%6.3" "" COMPU_TAB_REF DRVMOD_SC_Compu /end COMPU_METHOD
/begin COMPU_VTAB DRVMOD_SC_Compu "" TAB_VERB 2 0 "False" 1 "True" /end COMPU_VTAB
/begin COMPU_METHOD DRVPRGLMP_ECOLAMP_SC_Compu "" TAB_VERB "%6.3" "" COMPU_TAB_REF DRVPRGLMP_ECOLAMP_SC_Compu /end COMPU_METHOD
/begin COMPU_VTAB DRVPRGLMP_ECOLAMP_SC_Compu "" TAB_VERB 2 0 "False" 1 "True" /end COMPU_VTAB
/begin COMPU_METHOD DRVPRGLMP_NORMLAMP_SC_Compu "" TAB_VERB "%6.3" "" COMPU_TAB_REF DRVPRGLMP_NORMLAMP_SC_Compu /end COMPU_METHOD
/begin COMPU_VTAB DRVPRGLMP_NORMLAMP_SC_Compu "" TAB_VERB 2 0 "False" 1 "True" /end COMPU_VTAB
/begin COMPU_METHOD DRVPRGLMP_SPTLAMP_SC_Compu "" TAB_VERB "%6.3" "" COMPU_TAB_REF DRVPRGLMP_SPTLAMP_SC_Compu /end COMPU_METHOD
/begin COMPU_VTAB DRVPRGLMP_SPTLAMP_SC_Compu "" TAB_VERB 2 0 "False" 1 "True" /end COMPU_VTAB
/begin COMPU_METHOD DRVPRGSWT_ECOSWT_SC_Compu "" TAB_VERB "%6.3" "" COMPU_TAB_REF DRVPRGSWT_ECOSWT_SC_Compu /end COMPU_METHOD
/begin COMPU_VTAB DRVPRGSWT_ECOSWT_SC_Compu "" TAB_VERB 4 0 "ECO_mode_not_available" 1 "ECO_mode_available_via_ADC" 2 "ECO_mode_available_via_DIO" 3 "ECO_mode_available_via_CAN" /end COMPU_VTAB
/begin COMPU_METHOD DRVPRGSWT_NORMSWT_SC_Compu "" TAB_VERB "%6.3" "" COMPU_TAB_REF DRVPRGSWT_NORMSWT_SC_Compu /end COMPU_METHOD
/begin COMPU_VTAB DRVPRGSWT_NORMSWT_SC_Compu "" TAB_VERB 4 0 "Normal_mode_not_available" 1 "Normal_mode_available_via_ADC" 2 "Normal_mode_available_via_DIO" 3 "Normal_mode_available_via_CAN" /end COMPU_VTAB
/begin COMPU_METHOD DRVPRGSWT_NUMSPRT_Compu "" RAT_FUNC "%6.2" "" COEFFS 0 1 0 0 0 1 /end COMPU_METHOD
/begin COMPU_METHOD DRVPRGSWT_NUMWNTR_Compu "" RAT_FUNC "%6.2" "" COEFFS 0 1 0 0 0 1 /end COMPU_METHOD
/begin COMPU_METHOD DRVPRGSWT_RCPTSWT_SC_Compu "" TAB_VERB "%6.3" "" COMPU_TAB_REF DRVPRGSWT_RCPTSWT_SC_Compu /end COMPU_METHOD
/begin COMPU_VTAB DRVPRGSWT_RCPTSWT_SC_Compu "" TAB_VERB 4 0 "Recuperation_switch_not_available" 1 "Recuperation_switch_information_available_via_ADC" 2 "Recuperation_switch_information_available_via_DIO" 3 "Recuperation_switch_information_available_via_CAN" /end COMPU_VTAB
/begin COMPU_METHOD DRVPRGSWT_SPTSWT_SC_Compu "" TAB_VERB "%6.3" "" COMPU_TAB_REF DRVPRGSWT_SPTSWT_SC_Compu /end COMPU_METHOD
/begin COMPU_VTAB DRVPRGSWT_SPTSWT_SC_Compu "" TAB_VERB 4 0 "Sport_mode_not_available" 1 "Sport_mode_available_via_ADC" 2 "Sport_mode_available_via_DIO" 3 "Sport_mode_available_via_CAN" /end COMPU_VTAB
/begin COMPU_METHOD DRVPRG_SC_Compu "" TAB_VERB "%6.3" "" COMPU_TAB_REF DRVPRG_SC_Compu /end COMPU_METHOD
/begin COMPU_VTAB DRVPRG_SC_Compu "" TAB_VERB 2 0 "False" 1 "True" /end COMPU_VTAB
/begin COMPU_METHOD DSCHED_COEOMEXT_SC_Compu "" TAB_VERB "%6.3" "" COMPU_TAB_REF DSCHED_COEOMEXT_SC_Compu /end COMPU_METHOD
/begin COMPU_VTAB DSCHED_COEOMEXT_SC_Compu "" TAB_VERB 10 0 "Standard_Only" 1 "Extended_SubModes" 2 "Extended_Modes2" 3 "Extended_Modes3" 4 "Extended_Modes4" 5 "Extended_Modes5" 6 "Extended_Modes6" 7 "Extended_Modes7" 8 "Extended_Modes8" 9 "Extended_Modes9" /end COMPU_VTAB
/begin COMPU_METHOD DSCHED_COEOM_SY_Compu "" TAB_VERB "%6.3" "" COMPU_TAB_REF DSCHED_COEOM_SY_Compu /end COMPU_METHOD
/begin COMPU_VTAB DSCHED_COEOM_SY_Compu "" TAB_VERB 2 0 "False" 1 "True" /end COMPU_VTAB
/begin COMPU_METHOD DSCHED_FIDMAXPRIOLST_SY_Compu "" RAT_FUNC "%6.2" "" COEFFS 0 1 0 0 0 1 /end COMPU_METHOD
/begin COMPU_METHOD DSCHED_FTI_SY_Compu "" TAB_VERB "%6.3" "" COMPU_TAB_REF DSCHED_FTI_SY_Compu /end COMPU_METHOD
/begin COMPU_VTAB DSCHED_FTI_SY_Compu "" TAB_VERB 2 0 "DSCHED_FTI_DISBL" 1 "DSCHED_FTI_ENA" /end COMPU_VTAB
/begin COMPU_METHOD DSCHED_PRIOACTVJMP_SY_Compu "" TAB_VERB "%6.3" "" COMPU_TAB_REF DSCHED_PRIOACTVJMP_SY_Compu /end COMPU_METHOD
/begin COMPU_VTAB DSCHED_PRIOACTVJMP_SY_Compu "" TAB_VERB 2 0 "DSCHED_PRIOACTVJMP_DISBL" 1 "DSCHED_PRIOACTVJMP_ENA" /end COMPU_VTAB
/begin COMPU_METHOD DSCHED_PRIODFCSTLDF_SY_Compu "" TAB_VERB "%6.3" "" COMPU_TAB_REF DSCHED_PRIODFCSTLDF_SY_Compu /end COMPU_METHOD
/begin COMPU_VTAB DSCHED_PRIODFCSTLDF_SY_Compu "" TAB_VERB 3 0 "DSCHED_DFCSTLDF_DISBL" 1 "DSCHED_DFCSTLDF_ENA_UNIF" 2 "DSCHED_DFCSTLDF_ENA_INDIV" /end COMPU_VTAB
/begin COMPU_METHOD DSCHED_PRIODFCSTTST_SY_Compu "" TAB_VERB "%6.3" "" COMPU_TAB_REF DSCHED_PRIODFCSTTST_SY_Compu /end COMPU_METHOD
/begin COMPU_VTAB DSCHED_PRIODFCSTTST_SY_Compu "" TAB_VERB 3 0 "DSCHED_DFCSTTST_DISBL" 1 "DSCHED_DFCSTTST_ENA_UNIF" 2 "DSCHED_DFCSTTST_ENA_INDIV" /end COMPU_VTAB
/begin COMPU_METHOD DSCHED_PRIOPHYSURGENCY_SY_Compu "" TAB_VERB "%6.3" "" COMPU_TAB_REF DSCHED_PRIOPHYSURGENCY_SY_Compu /end COMPU_METHOD
/begin COMPU_VTAB DSCHED_PRIOPHYSURGENCY_SY_Compu "" TAB_VERB 2 0 "DSCHED_PHYSURGENCY_DISBL" 1 "DSCHED_PHYSURGENCY_ENA" /end COMPU_VTAB
/begin COMPU_METHOD DSCHED_PRIORMPCALC_SY_Compu "" TAB_VERB "%6.3" "" COMPU_TAB_REF DSCHED_PRIORMPCALC_SY_Compu /end COMPU_METHOD
/begin COMPU_VTAB DSCHED_PRIORMPCALC_SY_Compu "" TAB_VERB 2 0 "DSCHED_PRIORMPCALC_DISBL" 1 "DSCHED_PRIORMPCALC_ENA" /end COMPU_VTAB
/begin COMPU_METHOD DSCHED_RATECALC_SY_Compu "" TAB_VERB "%6.3" "" COMPU_TAB_REF DSCHED_RATECALC_SY_Compu /end COMPU_METHOD
/begin COMPU_VTAB DSCHED_RATECALC_SY_Compu "" TAB_VERB 2 0 "DSCHED_RATECALC_DISBL" 1 "DSCHED_RATECALC_ENA" /end COMPU_VTAB
/begin COMPU_METHOD DSCHED_WTT_SY_Compu "" TAB_VERB "%6.3" "" COMPU_TAB_REF DSCHED_WTT_SY_Compu /end COMPU_METHOD
/begin COMPU_VTAB DSCHED_WTT_SY_Compu "" TAB_VERB 2 0 "DSCHED_WTT_DISBL" 1 "DSCHED_WTT_ENA" /end COMPU_VTAB
/begin COMPU_METHOD DSM2AUTOSAR_ASWPF_SC_Compu "" TAB_VERB "%6.3" "" COMPU_TAB_REF DSM2AUTOSAR_ASWPF_SC_Compu /end COMPU_METHOD
/begin COMPU_VTAB DSM2AUTOSAR_ASWPF_SC_Compu "" TAB_VERB 2 0 "No_Support" 1 "Support_BAC" /end COMPU_VTAB
/begin COMPU_METHOD DSM2AUTOSAR_DCMIF_SC_Compu "" TAB_VERB "%6.3" "" COMPU_TAB_REF DSM2AUTOSAR_DCMIF_SC_Compu /end COMPU_METHOD
/begin COMPU_VTAB DSM2AUTOSAR_DCMIF_SC_Compu "" TAB_VERB 8 0 "Platform" 1 "Volvo" 2 "BMW" 3 "VW" 4 "FORD" 5 "DAI" 6 "FPT" 425 "Polaris" /end COMPU_VTAB
/begin COMPU_METHOD DSM2AUTOSAR_SC_Compu "" TAB_VERB "%6.3" "" COMPU_TAB_REF DSM2AUTOSAR_SC_Compu /end COMPU_METHOD
/begin COMPU_VTAB DSM2AUTOSAR_SC_Compu "" TAB_VERB 2 0 "False" 1 "True" /end COMPU_VTAB
/begin COMPU_METHOD DSM2AUTOSAR_SECFCM_SC_Compu "" TAB_VERB "%6.3" "" COMPU_TAB_REF DSM2AUTOSAR_SECFCM_SC_Compu /end COMPU_METHOD
/begin COMPU_VTAB DSM2AUTOSAR_SECFCM_SC_Compu "" TAB_VERB 2 0 "No_Support" 1 "Support_3_Cond" /end COMPU_VTAB
/begin COMPU_METHOD DSM2SG_DFC_SY_Compu "" TAB_VERB "%6.3" "" COMPU_TAB_REF DSM2SG_DFC_SY_Compu /end COMPU_METHOD
/begin COMPU_VTAB DSM2SG_DFC_SY_Compu "" TAB_VERB 2 0 "False" 1 "True" /end COMPU_VTAB
/begin COMPU_METHOD DSM2SG_DSQ_SY_Compu "" TAB_VERB "%6.3" "" COMPU_TAB_REF DSM2SG_DSQ_SY_Compu /end COMPU_METHOD
/begin COMPU_VTAB DSM2SG_DSQ_SY_Compu "" TAB_VERB 2 0 "False" 1 "True" /end COMPU_VTAB
/begin COMPU_METHOD DSM2SG_EXCH_SC_Compu "" TAB_VERB "%6.3" "" COMPU_TAB_REF DSM2SG_EXCH_SC_Compu /end COMPU_METHOD
/begin COMPU_VTAB DSM2SG_EXCH_SC_Compu "" TAB_VERB 2 0 "FALSE" 1 "TRUE" /end COMPU_VTAB
/begin COMPU_METHOD DSM2SG_FID_SY_Compu "" TAB_VERB "%6.3" "" COMPU_TAB_REF DSM2SG_FID_SY_Compu /end COMPU_METHOD
/begin COMPU_VTAB DSM2SG_FID_SY_Compu "" TAB_VERB 2 0 "False" 1 "True" /end COMPU_VTAB
/begin COMPU_METHOD DSMAUX_TCSORT_SY_Compu "" TAB_VERB "%6.3" "" COMPU_TAB_REF DSMAUX_TCSORT_SY_Compu /end COMPU_METHOD
/begin COMPU_VTAB DSMAUX_TCSORT_SY_Compu "" TAB_VERB 2 0 "TCSORT_disabled" 1 "TCSORT_enabled" /end COMPU_VTAB
/begin COMPU_METHOD DSMBAS_CENSUPPDIUMPR_SC_Compu "" TAB_VERB "%6.3" "" COMPU_TAB_REF DSMBAS_CENSUPPDIUMPR_SC_Compu /end COMPU_METHOD
/begin COMPU_VTAB DSMBAS_CENSUPPDIUMPR_SC_Compu "" TAB_VERB 2 0 "Disabled" 1 "Enabled" /end COMPU_VTAB
/begin COMPU_METHOD DSMBAS_CENSUPPDTR_SC_Compu "" TAB_VERB "%6.3" "" COMPU_TAB_REF DSMBAS_CENSUPPDTR_SC_Compu /end COMPU_METHOD
/begin COMPU_VTAB DSMBAS_CENSUPPDTR_SC_Compu "" TAB_VERB 2 0 "Disabled" 1 "Enabled" /end COMPU_VTAB
/begin COMPU_METHOD DSMBAS_DARCORDARYLEN_SC_Compu "" RAT_FUNC "%6.2" "" COEFFS 0 1 0 0 0 1 /end COMPU_METHOD
/begin COMPU_METHOD DSMBAS_DARCORDENA_SC_Compu "" TAB_VERB "%6.3" "" COMPU_TAB_REF DSMBAS_DARCORDENA_SC_Compu /end COMPU_METHOD
/begin COMPU_VTAB DSMBAS_DARCORDENA_SC_Compu "" TAB_VERB 2 0 "False" 1 "True" /end COMPU_VTAB
/begin COMPU_METHOD DSMBAS_ENACFMDFLTCNTR_SC_Compu "" TAB_VERB "%6.3" "" COMPU_TAB_REF DSMBAS_ENACFMDFLTCNTR_SC_Compu /end COMPU_METHOD
/begin COMPU_VTAB DSMBAS_ENACFMDFLTCNTR_SC_Compu "" TAB_VERB 2 0 "DISABLE" 1 "ENABLE" /end COMPU_VTAB
/begin COMPU_METHOD DSMBAS_ENAFRQCNTRNOTRSTSRVPND_SC_Compu "" TAB_VERB "%6.3" "" COMPU_TAB_REF DSMBAS_ENAFRQCNTRNOTRSTSRVPND_SC_Compu /end COMPU_METHOD
/begin COMPU_VTAB DSMBAS_ENAFRQCNTRNOTRSTSRVPND_SC_Compu "" TAB_VERB 2 0 "False" 1 "True" /end COMPU_VTAB
/begin COMPU_METHOD DSMBAS_ENAOPTMZDRDNFORCMPHCPT_SC_Compu "" TAB_VERB "%6.3" "" COMPU_TAB_REF DSMBAS_ENAOPTMZDRDNFORCMPHCPT_SC_Compu /end COMPU_METHOD
/begin COMPU_VTAB DSMBAS_ENAOPTMZDRDNFORCMPHCPT_SC_Compu "" TAB_VERB 2 0 "DSMRDN_STDRDN" 1 "DSMRDN_OPTMZDRDN" /end COMPU_VTAB
/begin COMPU_METHOD DSMBAS_ENAPRIOSRVHIPLUS_SC_Compu "" TAB_VERB "%6.3" "" COMPU_TAB_REF DSMBAS_ENAPRIOSRVHIPLUS_SC_Compu /end COMPU_METHOD
/begin COMPU_VTAB DSMBAS_ENAPRIOSRVHIPLUS_SC_Compu "" TAB_VERB 2 0 "False" 1 "True" /end COMPU_VTAB
/begin COMPU_METHOD DSMBAS_ENASIMRCDN_SC_Compu "" TAB_VERB "%6.3" "" COMPU_TAB_REF DSMBAS_ENASIMRCDN_SC_Compu /end COMPU_METHOD
/begin COMPU_VTAB DSMBAS_ENASIMRCDN_SC_Compu "" TAB_VERB 2 0 "False" 1 "True" /end COMPU_VTAB
/begin COMPU_METHOD DSMBAS_ENVTLBLKUPD_SC_Compu "" TAB_VERB "%6.3" "" COMPU_TAB_REF DSMBAS_ENVTLBLKUPD_SC_Compu /end COMPU_METHOD
/begin COMPU_VTAB DSMBAS_ENVTLBLKUPD_SC_Compu "" TAB_VERB 2 0 "Frequency_Count" 1 "Fail_Count" /end COMPU_VTAB
/begin COMPU_METHOD DSMBAS_IRRVFLTINHB_SC_Compu "" TAB_VERB "%6.3" "" COMPU_TAB_REF DSMBAS_IRRVFLTINHB_SC_Compu /end COMPU_METHOD
/begin COMPU_VTAB DSMBAS_IRRVFLTINHB_SC_Compu "" TAB_VERB 2 0 "False" 1 "True" /end COMPU_VTAB
/begin COMPU_METHOD DSMBAS_KEYONCYCFLCTRIG_SC_Compu "" TAB_VERB "%6.3" "" COMPU_TAB_REF DSMBAS_KEYONCYCFLCTRIG_SC_Compu /end COMPU_METHOD
/begin COMPU_VTAB DSMBAS_KEYONCYCFLCTRIG_SC_Compu "" TAB_VERB 2 0 "False" 1 "True" /end COMPU_VTAB
/begin COMPU_METHOD DSMBAS_NEWDCYCWITHFCMCLR_SC_Compu "" TAB_VERB "%6.3" "" COMPU_TAB_REF DSMBAS_NEWDCYCWITHFCMCLR_SC_Compu /end COMPU_METHOD
/begin COMPU_VTAB DSMBAS_NEWDCYCWITHFCMCLR_SC_Compu "" TAB_VERB 2 0 "False" 1 "True" /end COMPU_VTAB
/begin COMPU_METHOD DSMBAS_NODFP_SC_Compu "" TAB_VERB "%6.3" "" COMPU_TAB_REF DSMBAS_NODFP_SC_Compu /end COMPU_METHOD
/begin COMPU_VTAB DSMBAS_NODFP_SC_Compu "" TAB_VERB 2 0 "False" 1 "True" /end COMPU_VTAB
/begin COMPU_METHOD DSMBAS_NODIAGCSDL_SC_Compu "" TAB_VERB "%6.3" "" COMPU_TAB_REF DSMBAS_NODIAGCSDL_SC_Compu /end COMPU_METHOD
/begin COMPU_VTAB DSMBAS_NODIAGCSDL_SC_Compu "" TAB_VERB 2 0 "False" 1 "True" /end COMPU_VTAB
/begin COMPU_METHOD DSMBAS_NODTR_SC_Compu "" TAB_VERB "%6.3" "" COMPU_TAB_REF DSMBAS_NODTR_SC_Compu /end COMPU_METHOD
/begin COMPU_VTAB DSMBAS_NODTR_SC_Compu "" TAB_VERB 2 0 "False" 1 "True" /end COMPU_VTAB
/begin COMPU_METHOD DSMBAS_PNDRPRTMOD2_SC_Compu "" TAB_VERB "%6.3" "" COMPU_TAB_REF DSMBAS_PNDRPRTMOD2_SC_Compu /end COMPU_METHOD
/begin COMPU_VTAB DSMBAS_PNDRPRTMOD2_SC_Compu "" TAB_VERB 2 0 "CONFIRMED" 1 "PENDING" /end COMPU_VTAB
/begin COMPU_METHOD DSMBAS_PREFAILDINTDEB_SC_Compu "" TAB_VERB "%6.3" "" COMPU_TAB_REF DSMBAS_PREFAILDINTDEB_SC_Compu /end COMPU_METHOD
/begin COMPU_VTAB DSMBAS_PREFAILDINTDEB_SC_Compu "" TAB_VERB 2 0 "Disable" 1 "Enable" /end COMPU_VTAB
/begin COMPU_METHOD DSMBAS_REINIMETHSELN_SC_Compu "" TAB_VERB "%6.3" "" COMPU_TAB_REF DSMBAS_REINIMETHSELN_SC_Compu /end COMPU_METHOD
/begin COMPU_VTAB DSMBAS_REINIMETHSELN_SC_Compu "" TAB_VERB 2 0 "CYCLIC_TASK" 1 "INIDRV_TASK" /end COMPU_VTAB
/begin COMPU_METHOD DSMBAS_SELNPID93BHVR_SC_Compu "" TAB_VERB "%6.3" "" COMPU_TAB_REF DSMBAS_SELNPID93BHVR_SC_Compu /end COMPU_METHOD
/begin COMPU_VTAB DSMBAS_SELNPID93BHVR_SC_Compu "" TAB_VERB 3 0 "DISABLE" 1 "READY_TO_DRIVE" 2 "ENGINE_RUNNING" /end COMPU_VTAB
/begin COMPU_METHOD DSMBAS_SELPID41BHVR_SC_Compu "" TAB_VERB "%6.3" "" COMPU_TAB_REF DSMBAS_SELPID41BHVR_SC_Compu /end COMPU_METHOD
/begin COMPU_VTAB DSMBAS_SELPID41BHVR_SC_Compu "" TAB_VERB 2 0 "PID41_DCYBASED" 1 "PID41_KEYONBASED" /end COMPU_VTAB
/begin COMPU_METHOD DSMBAS_TESTFAILDSNCELSTCLR_SC_Compu "" TAB_VERB "%6.3" "" COMPU_TAB_REF DSMBAS_TESTFAILDSNCELSTCLR_SC_Compu /end COMPU_METHOD
/begin COMPU_VTAB DSMBAS_TESTFAILDSNCELSTCLR_SC_Compu "" TAB_VERB 2 0 "False" 1 "True" /end COMPU_VTAB
/begin COMPU_METHOD DSMBAS_VAR_SY_Compu "" TAB_VERB "%6.3" "" COMPU_TAB_REF DSMBAS_VAR_SY_Compu /end COMPU_METHOD
/begin COMPU_VTAB DSMBAS_VAR_SY_Compu "" TAB_VERB 55 0 "kein Kundenbezug" 1 "DAI" 3 "VWW" 4 "POR" 5 "AUD" 6 "OPE" 9 "FIA" 11 "BMW" 14 "PSA" 15 "REN" 17 "ALF" 18 "SAB" 19 "VOL" 20 "NIS" 21 "GMU" 22 "FOR" 26 "IMJ" 36 "MAN" 51 "SEA" 53 "CHR" 54 "JAG" 55 "ROL" 69 "FER" 72 "TOY" 123 "MIT" 147 "HYU" 159 "HON" 160 "MAZ" 183 "CU" 190 "LRG" 204 "VVW" 214 "AVT" 242 "Iveco" 243 "DMC" 248 "SUZ" 267 "SSANGYONG" 270 "KEF" 289 "AMG" 308 "TAT" 319 "MVM" 328 "MM" 385 "UAES" 578 "AL" 590 "SCANIA" 609 "Deutz" 760 "WEICHAI" 828 "RBCD" 898 "MFTBC" 973 "YANMARJP" 984 "FAW" 999 "ALL" 2887 "Nonox" 9407 "DHC" 9454 "Fuso" 9740 "Navistar" /end COMPU_VTAB
/begin COMPU_METHOD DSMBDEP_SY_Compu "" TAB_VERB "%6.3" "" COMPU_TAB_REF DSMBDEP_SY_Compu /end COMPU_METHOD
/begin COMPU_VTAB DSMBDEP_SY_Compu "" TAB_VERB 2 0 "False" 1 "True" /end COMPU_VTAB
/begin COMPU_METHOD DSMCONF_DEBMULDCY_SC_Compu "" TAB_VERB "%6.3" "" COMPU_TAB_REF DSMCONF_DEBMULDCY_SC_Compu /end COMPU_METHOD
/begin COMPU_VTAB DSMCONF_DEBMULDCY_SC_Compu "" TAB_VERB 2 0 "False" 1 "True" /end COMPU_VTAB
/begin COMPU_METHOD DSMDUR_MIL_GLB_SY_Compu "" TAB_VERB "%6.3" "" COMPU_TAB_REF DSMDUR_MIL_GLB_SY_Compu /end COMPU_METHOD
/begin COMPU_VTAB DSMDUR_MIL_GLB_SY_Compu "" TAB_VERB 2 0 "FALSE" 1 "TRUE" /end COMPU_VTAB
/begin COMPU_METHOD DSMDUR_SUPPID4D_SC_Compu "" TAB_VERB "%6.3" "" COMPU_TAB_REF DSMDUR_SUPPID4D_SC_Compu /end COMPU_METHOD
/begin COMPU_VTAB DSMDUR_SUPPID4D_SC_Compu "" TAB_VERB 2 0 "False" 1 "True" /end COMPU_VTAB
/begin COMPU_METHOD DSMDUR_SUPPID4E_SC_Compu "" TAB_VERB "%6.3" "" COMPU_TAB_REF DSMDUR_SUPPID4E_SC_Compu /end COMPU_METHOD
/begin COMPU_VTAB DSMDUR_SUPPID4E_SC_Compu "" TAB_VERB 2 0 "False" 1 "True" /end COMPU_VTAB
/begin COMPU_METHOD DSMRDY_ENA_FLSYSFORCELABEL_SC_Compu "" TAB_VERB "%6.3" "" COMPU_TAB_REF DSMRDY_ENA_FLSYSFORCELABEL_SC_Compu /end COMPU_METHOD
/begin COMPU_VTAB DSMRDY_ENA_FLSYSFORCELABEL_SC_Compu "" TAB_VERB 2 0 "False" 1 "True" /end COMPU_VTAB
/begin COMPU_METHOD DSMRDY_ENGSPEC_SY_Compu "" TAB_VERB "%6.3" "" COMPU_TAB_REF DSMRDY_ENGSPEC_SY_Compu /end COMPU_METHOD
/begin COMPU_VTAB DSMRDY_ENGSPEC_SY_Compu "" TAB_VERB 2 0 "FALSE" 1 "TRUE" /end COMPU_VTAB
/begin COMPU_METHOD DSMRDY_INHP41_SY_Compu "" RAT_FUNC "%6.2" "" COEFFS 0 1 0 0 0 1 /end COMPU_METHOD
/begin COMPU_METHOD DSMRDY_SUPPID41_SY_Compu "" TAB_VERB "%6.3" "" COMPU_TAB_REF DSMRDY_SUPPID41_SY_Compu /end COMPU_METHOD
/begin COMPU_VTAB DSMRDY_SUPPID41_SY_Compu "" TAB_VERB 2 0 "FALSE" 1 "TRUE" /end COMPU_VTAB
/begin COMPU_METHOD DSMRDY_VERS_SC_Compu "" TAB_VERB "%6.3" "" COMPU_TAB_REF DSMRDY_VERS_SC_Compu /end COMPU_METHOD
/begin COMPU_VTAB DSMRDY_VERS_SC_Compu "" TAB_VERB 2 0 "DSMRDY_PRE_2009" 1 "DSMRDY_2009" /end COMPU_VTAB
/begin COMPU_METHOD DSM_DISBLGRPSIZE_SY_Compu "" RAT_FUNC "%6.2" "" COEFFS 0 1 0 0 0 1 /end COMPU_METHOD
/begin COMPU_METHOD DSM_DOBD_SC_Compu "" TAB_VERB "%6.3" "" COMPU_TAB_REF DSM_DOBD_SC_Compu /end COMPU_METHOD
/begin COMPU_VTAB DSM_DOBD_SC_Compu "" TAB_VERB 2 0 "False" 1 "True" /end COMPU_VTAB
/begin COMPU_METHOD DSM_DSM2SG_SY_Compu "" TAB_VERB "%6.3" "" COMPU_TAB_REF DSM_DSM2SG_SY_Compu /end COMPU_METHOD
/begin COMPU_VTAB DSM_DSM2SG_SY_Compu "" TAB_VERB 2 0 "False" 1 "True" /end COMPU_VTAB
/begin COMPU_METHOD DSM_DSMAPLCTRLDDIAGCYC_SC_Compu "" TAB_VERB "%6.3" "" COMPU_TAB_REF DSM_DSMAPLCTRLDDIAGCYC_SC_Compu /end COMPU_METHOD
/begin COMPU_VTAB DSM_DSMAPLCTRLDDIAGCYC_SC_Compu "" TAB_VERB 2 0 "False" 1 "True" /end COMPU_VTAB
/begin COMPU_METHOD DSM_DTRINTCOMPUVLDN_SC_Compu "" TAB_VERB "%6.3" "" COMPU_TAB_REF DSM_DTRINTCOMPUVLDN_SC_Compu /end COMPU_METHOD
/begin COMPU_VTAB DSM_DTRINTCOMPUVLDN_SC_Compu "" TAB_VERB 2 0 "False" 1 "True" /end COMPU_VTAB
/begin COMPU_METHOD DSM_FAILCNT_SY_Compu "" TAB_VERB "%6.3" "" COMPU_TAB_REF DSM_FAILCNT_SY_Compu /end COMPU_METHOD
/begin COMPU_VTAB DSM_FAILCNT_SY_Compu "" TAB_VERB 2 0 "False" 1 "True" /end COMPU_VTAB
/begin COMPU_METHOD DSM_FAULTSEQ_SY_Compu "" TAB_VERB "%6.3" "" COMPU_TAB_REF DSM_FAULTSEQ_SY_Compu /end COMPU_METHOD
/begin COMPU_VTAB DSM_FAULTSEQ_SY_Compu "" TAB_VERB 2 0 "False" 1 "True" /end COMPU_VTAB
/begin COMPU_METHOD DSM_HDOBD_SY_Compu "" TAB_VERB "%6.3" "" COMPU_TAB_REF DSM_HDOBD_SY_Compu /end COMPU_METHOD
/begin COMPU_VTAB DSM_HDOBD_SY_Compu "" TAB_VERB 2 0 "False" 1 "True" /end COMPU_VTAB
/begin COMPU_METHOD DSM_INHRLS_SY_Compu "" TAB_VERB "%6.3" "" COMPU_TAB_REF DSM_INHRLS_SY_Compu /end COMPU_METHOD
/begin COMPU_VTAB DSM_INHRLS_SY_Compu "" TAB_VERB 2 0 "0" 1 "1" /end COMPU_VTAB
/begin COMPU_METHOD DSM_MDOBD_SY_Compu "" TAB_VERB "%6.3" "" COMPU_TAB_REF DSM_MDOBD_SY_Compu /end COMPU_METHOD
/begin COMPU_VTAB DSM_MDOBD_SY_Compu "" TAB_VERB 2 0 "False" 1 "True" /end COMPU_VTAB
/begin COMPU_METHOD EngN "" RAT_FUNC "%6.3" "rpm" COEFFS 0 2 0 0 0 1 /end COMPU_METHOD
/begin COMPU_METHOD Fact "" RAT_FUNC "%6.5" "-" COEFFS 0 8192 0 0 0 1 /end COMPU_METHOD
/begin COMPU_METHOD Fact1 "" RAT_FUNC "%6.4" "-" COEFFS 0 128 0 0 0 1 /end COMPU_METHOD
/begin COMPU_METHOD Fact_2pwr11 "" RAT_FUNC "%6.5" "-" COEFFS 0 2048 0 0 0 1 /end COMPU_METHOD
/begin COMPU_METHOD Length "" RAT_FUNC "%6.2" "m" COEFFS 0 1 0 0 0 1 /end COMPU_METHOD
/begin COMPU_METHOD OneToOne "" RAT_FUNC "%6.2" "-" COEFFS 0 1 0 0 0 1 /end COMPU_METHOD
/begin COMPU_METHOD Prc "" RAT_FUNC "%6.4" "%" COEFFS 0 81.92 0 0 0 1 /end COMPU_METHOD
/begin COMPU_METHOD Pres_hPa "" RAT_FUNC "%6.2" "hPa" COEFFS 0 1 0 0 0 1 /end COMPU_METHOD
/begin COMPU_METHOD Pres_kPa_VSA "" RAT_FUNC "%6.1" "kPa" COEFFS 0 0.0417362270450751 0 0 0 1 /end COMPU_METHOD
/begin COMPU_METHOD q0p01_V "" RAT_FUNC "%6.4" "V" COEFFS 0 100 0 0 0 1 /end COMPU_METHOD
/begin COMPU_METHOD RBPtCel_fac_0p01_1 "" RAT_FUNC "%6.4" "-" COEFFS 0 100 0 0 0 1 /end COMPU_METHOD
/begin COMPU_METHOD RBPtCel_tq_1p0_1 "" RAT_FUNC "%6.2" "Nm" COEFFS 0 1 0 0 0 1 /end COMPU_METHOD
/begin COMPU_METHOD RBPtPwrTrn_stEngReq_VERB "" TAB_VERB "%6.3" "" COMPU_TAB_REF RBPtPwrTrn_stEngReq_VERB /end COMPU_METHOD
/begin COMPU_VTAB RBPtPwrTrn_stEngReq_VERB "" TAB_VERB 5 0 "NO_REQUEST" 1 "START" 2 "STOP" 3 "PANIC_START" 4 "RESET_START" /end COMPU_VTAB
/begin COMPU_METHOD Temp_Cels "" RAT_FUNC "%6.1" "deg C" COEFFS 0 10 2731.4 0 0 1 /end COMPU_METHOD
/begin COMPU_METHOD TimeDeb "" RAT_FUNC "%6.1" "ms" COEFFS 0 0.1 0 0 0 1 /end COMPU_METHOD
/begin COMPU_METHOD TimeDelay_s "" RAT_FUNC "%6.1" "s" COEFFS 0 0 1 0 0.00023283064365387 0 /end COMPU_METHOD
/begin COMPU_METHOD TimeDelay_s_Lin_16 "" RAT_FUNC "%6.5" "s" COEFFS 0 6553.4 0 0 0 1 /end COMPU_METHOD
/begin COMPU_METHOD Time_ms "" RAT_FUNC "%6.1" "ms" COEFFS 0 0.1 0 0 0 1 /end COMPU_METHOD
/begin COMPU_METHOD Time_s "" RAT_FUNC "%6.4" "s" COEFFS 0 100 0 0 0 1 /end COMPU_METHOD
/begin COMPU_METHOD TransR "" RAT_FUNC "%6.4" "-" COEFFS 0 100 0 0 0 1 /end COMPU_METHOD
/begin COMPU_METHOD TransR_COMPU "" RAT_FUNC "%6.4" "" COEFFS 0 64 0 0 0 1 /end COMPU_METHOD
/begin COMPU_METHOD Trq "" RAT_FUNC "%6.3" "Nm" COEFFS 0 10 0 0 0 1 /end COMPU_METHOD
/begin COMPU_METHOD TrqPerSec "" RAT_FUNC "%6.2" "Nm/s" COEFFS 0 1 0 0 0 1 /end COMPU_METHOD
/begin COMPU_METHOD TrqPrpHigh "" RAT_FUNC "%6.3" "Nm" COEFFS 0 10 0 0 0 1 /end COMPU_METHOD
/begin COMPU_METHOD TrqToNSqr "" RAT_FUNC "%10.9" "-" COEFFS 0 10000000 0 0 0 1 /end COMPU_METHOD
/begin COMPU_METHOD Trq_float "" RAT_FUNC "%6.2" "Nm" COEFFS 0 1 0 0 0 1 /end COMPU_METHOD
/begin COMPU_METHOD trq_q0p1 "" RAT_FUNC "%6.3" "Nm" COEFFS 0 10 0 0 0 1 /end COMPU_METHOD
/begin COMPU_METHOD t_q0p01 "" RAT_FUNC "%6.4" "s" COEFFS 0 100 0 0 0 1 /end COMPU_METHOD
/begin COMPU_METHOD uint8 "" RAT_FUNC "%6.2" "-" COEFFS 0 1 0 0 0 1 /end COMPU_METHOD
/begin COMPU_METHOD Vel "" RAT_FUNC "%6.4" "km/h" COEFFS 0 100 0 0 0 1 /end COMPU_METHOD
/begin COMPU_METHOD Vel_CrCtl "" RAT_FUNC "%6.4" "km/h" COEFFS 0 256 0 0 0 1 /end COMPU_METHOD
/begin RECORD_LAYOUT Kw_Ws16 FNC_VALUES 1 SWORD COLUMN_DIR DIRECT /end RECORD_LAYOUT
/begin RECORD_LAYOUT RB_Axis_S16 NO_AXIS_PTS_X 1 SWORD AXIS_PTS_X 2 SWORD INDEX_INCR DIRECT /end RECORD_LAYOUT
/begin RECORD_LAYOUT RB_CurveGroup_S16 FNC_VALUES 1 SWORD COLUMN_DIR DIRECT /end RECORD_LAYOUT
/begin RECORD_LAYOUT RB_Curve_S16_S16 NO_AXIS_PTS_X 1 SWORD AXIS_PTS_X 2 SWORD INDEX_INCR DIRECT FNC_VALUES 3 SWORD COLUMN_DIR DIRECT /end RECORD_LAYOUT
/begin RECORD_LAYOUT RB_Map_S16S16_S16 NO_AXIS_PTS_X 1 SWORD NO_AXIS_PTS_Y 2 SWORD AXIS_PTS_X 3 SWORD INDEX_INCR DIRECT AXIS_PTS_Y 4 SWORD INDEX_INCR DIRECT FNC_VALUES 5 SWORD COLUMN_DIR DIRECT /end RECORD_LAYOUT
/begin RECORD_LAYOUT RB_Val_Ws16 FNC_VALUES 1 SWORD COLUMN_DIR DIRECT /end RECORD_LAYOUT
/begin RECORD_LAYOUT RB_Val_Ws32 FNC_VALUES 1 SLONG COLUMN_DIR DIRECT /end RECORD_LAYOUT
/begin RECORD_LAYOUT RB_Val_Wu8 FNC_VALUES 1 UBYTE COLUMN_DIR DIRECT /end RECORD_LAYOUT
/begin RECORD_LAYOUT Val_Ws16 FNC_VALUES 1 SWORD COLUMN_DIR DIRECT /end RECORD_LAYOUT
/begin RECORD_LAYOUT Val_Ws32 FNC_VALUES 1 SLONG COLUMN_DIR DIRECT /end RECORD_LAYOUT
/begin RECORD_LAYOUT Val_Wu8 FNC_VALUES 1 UBYTE COLUMN_DIR DIRECT /end RECORD_LAYOUT
/end MODULE
/end PROJECT
