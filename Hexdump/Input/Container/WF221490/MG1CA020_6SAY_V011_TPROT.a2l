ASAP2_VERSION 1 60
/begin PROJECT MG1CA020 "MG1CA020"
/begin HEADER "" VERSION "MG1CA020_6SAY_V011_TPROT" PROJECT_NO MG1CA020 /end HEADER
/begin MODULE DIM ""
/begin MOD_COMMON "" BYTE_ORDER MSB_LAST ALIGNMENT_BYTE 1 ALIGNMENT_WORD 2 ALIGNMENT_LONG 4 ALIGNMENT_INT64 4 ALIGNMENT_FLOAT32_IEEE 4 ALIGNMENT_FLOAT64_IEEE 4 DATA_SIZE 32 /end MOD_COMMON
/begin CHARACTERISTIC DFES_FaultTyp.DFC_ComAYCDChkSum_C "assigned fault type / Fault type assignment for check DFC_ComAYCDChkSum" VALUE 0x804F9B63 Val_Wu8 255.0 DFES_OneToOne 0.00 255.0 FORMAT "%5.1" /end CHARACTERISTIC
/begin CHARACTERISTIC DFES_FaultTyp.DFC_ComAYCDTOut_C "assigned fault type / Fault type assignment for check DFC_ComAYCDTOut" VALUE 0x804F9B64 Val_Wu8 255.0 DFES_OneToOne 0.00 255.0 FORMAT "%5.1" /end CHARACTERISTIC
/begin CHARACTERISTIC DFES_FaultTyp.DFC_ComAYCFChksum_C "assigned fault type / Fault type assignment for check DFC_ComAYCFChksum" VALUE 0x804F9B65 Val_Wu8 255.0 DFES_OneToOne 0.00 255.0 FORMAT "%5.1" /end CHARACTERISTIC
/begin CHARACTERISTIC DFES_FaultTyp.DFC_ComAYCFRingCnt_C "assigned fault type / Fault type assignment for check DFC_ComAYCFRingCnt" VALUE 0x804F9B66 Val_Wu8 255.0 DFES_OneToOne 0.00 255.0 FORMAT "%5.1" /end CHARACTERISTIC
/begin CHARACTERISTIC DFES_FaultTyp.DFC_ComAYCFTOut_C "assigned fault type / Fault type assignment for check DFC_ComAYCFTOut" VALUE 0x804F9B67 Val_Wu8 255.0 DFES_OneToOne 0.00 255.0 FORMAT "%5.1" /end CHARACTERISTIC
/begin CHARACTERISTIC DFES_FaultTyp.DFC_ComAYCGChksum_C "assigned fault type / Fault type assignment for check DFC_ComAYCGChksum" VALUE 0x804F9B68 Val_Wu8 255.0 DFES_OneToOne 0.00 255.0 FORMAT "%5.1" /end CHARACTERISTIC
/begin CHARACTERISTIC DFES_FaultTyp.DFC_ComAYCGRingCnt_C "assigned fault type / Fault type assignment for check DFC_ComAYCGRingCnt" VALUE 0x804F9B69 Val_Wu8 255.0 DFES_OneToOne 0.00 255.0 FORMAT "%5.1" /end CHARACTERISTIC
/begin CHARACTERISTIC DFES_FaultTyp.DFC_ComAYCGTOut_C "assigned fault type / Fault type assignment for check DFC_ComAYCGTOut" VALUE 0x804F9B6A Val_Wu8 255.0 DFES_OneToOne 0.00 255.0 FORMAT "%5.1" /end CHARACTERISTIC
/begin CHARACTERISTIC DFES_FaultTyp.DFC_ComAYCIChkSum_C "assigned fault type / Fault type assignment for check DFC_ComAYCIChkSum" VALUE 0x804F9B6B Val_Wu8 255.0 DFES_OneToOne 0.00 255.0 FORMAT "%5.1" /end CHARACTERISTIC
/begin CHARACTERISTIC DFES_FaultTyp.DFC_ComAYCIRingCnt_C "assigned fault type / Fault type assignment for check DFC_ComAYCIRingCnt" VALUE 0x804F9B6C Val_Wu8 255.0 DFES_OneToOne 0.00 255.0 FORMAT "%5.1" /end CHARACTERISTIC
/begin CHARACTERISTIC DFES_FaultTyp.DFC_ComAYCITOut_C "assigned fault type / Fault type assignment for check DFC_ComAYCITOut" VALUE 0x804F9B6D Val_Wu8 255.0 DFES_OneToOne 0.00 255.0 FORMAT "%5.1" /end CHARACTERISTIC
/begin CHARACTERISTIC DFES_FaultTyp.DFC_ComBCM1ChkSum_C "assigned fault type / Fault type assignment for check DFC_ComBCM1ChkSum" VALUE 0x804F9B6E Val_Wu8 255.0 DFES_OneToOne 0.00 255.0 FORMAT "%5.1" /end CHARACTERISTIC
/begin CHARACTERISTIC DFES_FaultTyp.DFC_ComBCM1RingCnt_C "assigned fault type / Fault type assignment for check DFC_ComBCM1RingCnt" VALUE 0x804F9B6F Val_Wu8 255.0 DFES_OneToOne 0.00 255.0 FORMAT "%5.1" /end CHARACTERISTIC
/begin CHARACTERISTIC DFES_FaultTyp.DFC_ComBCM1TOut_C "assigned fault type / Fault type assignment for check DFC_ComBCM1TOut" VALUE 0x804F9B70 Val_Wu8 255.0 DFES_OneToOne 0.00 255.0 FORMAT "%5.1" /end CHARACTERISTIC
/begin CHARACTERISTIC DFES_FaultTyp.DFC_ComCANABusOffErr_C "assigned fault type / Fault type assignment for check DFC_ComCANABusOffErr" VALUE 0x804F9B71 Val_Wu8 255.0 DFES_OneToOne 0.00 255.0 FORMAT "%5.1" /end CHARACTERISTIC
/begin CHARACTERISTIC DFES_FaultTyp.DFC_ComCANBBusOffErr_C "assigned fault type / Fault type assignment for check DFC_ComCANBBusOffErr" VALUE 0x804F9B72 Val_Wu8 255.0 DFES_OneToOne 0.00 255.0 FORMAT "%5.1" /end CHARACTERISTIC
/begin CHARACTERISTIC DFES_FaultTyp.DFC_ComCANCBusOffErr_C "assigned fault type / Fault type assignment for check DFC_ComCANCBusOffErr" VALUE 0x804F9B73 Val_Wu8 255.0 DFES_OneToOne 0.00 255.0 FORMAT "%5.1" /end CHARACTERISTIC
/begin CHARACTERISTIC DFES_FaultTyp.DFC_ComCGW1ChkSum_C "assigned fault type / Fault type assignment for check DFC_ComCGW1ChkSum" VALUE 0x804F9B74 Val_Wu8 255.0 DFES_OneToOne 0.00 255.0 FORMAT "%5.1" /end CHARACTERISTIC
/begin CHARACTERISTIC DFES_FaultTyp.DFC_ComCGW1RingCnt_C "assigned fault type / Fault type assignment for check DFC_ComCGW1RingCnt" VALUE 0x804F9B75 Val_Wu8 255.0 DFES_OneToOne 0.00 255.0 FORMAT "%5.1" /end CHARACTERISTIC
/begin CHARACTERISTIC DFES_FaultTyp.DFC_ComCGW1TOut_C "assigned fault type / Fault type assignment for check DFC_ComCGW1TOut" VALUE 0x804F9B76 Val_Wu8 255.0 DFES_OneToOne 0.00 255.0 FORMAT "%5.1" /end CHARACTERISTIC
/begin CHARACTERISTIC DFES_FaultTyp.DFC_ComConvBoostErr_C "assigned fault type / Fault type assignment for check DFC_ComConvBoostErr" VALUE 0x804F9B77 Val_Wu8 255.0 DFES_OneToOne 0.00 255.0 FORMAT "%5.1" /end CHARACTERISTIC
/begin CHARACTERISTIC DFES_FaultTyp.DFC_ComConvSlipErr_C "assigned fault type / Fault type assignment for check DFC_ComConvSlipErr" VALUE 0x804F9B78 Val_Wu8 255.0 DFES_OneToOne 0.00 255.0 FORMAT "%5.1" /end CHARACTERISTIC
/begin CHARACTERISTIC DFES_FaultTyp.DFC_ComEAT10Chksum_C "assigned fault type / Fault type assignment for check DFC_ComEAT10Chksum" VALUE 0x804F9B79 Val_Wu8 255.0 DFES_OneToOne 0.00 255.0 FORMAT "%5.1" /end CHARACTERISTIC
/begin CHARACTERISTIC DFES_FaultTyp.DFC_ComEAT10RingCnt_C "assigned fault type / Fault type assignment for check DFC_ComEAT10RingCnt" VALUE 0x804F9B7A Val_Wu8 255.0 DFES_OneToOne 0.00 255.0 FORMAT "%5.1" /end CHARACTERISTIC
/begin CHARACTERISTIC DFES_FaultTyp.DFC_ComEAT10TOut_C "assigned fault type / Fault type assignment for check DFC_ComEAT10TOut" VALUE 0x804F9B7B Val_Wu8 255.0 DFES_OneToOne 0.00 255.0 FORMAT "%5.1" /end CHARACTERISTIC
/begin CHARACTERISTIC DFES_FaultTyp.DFC_ComEAT11ChkSum_C "assigned fault type / Fault type assignment for check DFC_ComEAT11ChkSum" VALUE 0x804F9B7C Val_Wu8 255.0 DFES_OneToOne 0.00 255.0 FORMAT "%5.1" /end CHARACTERISTIC
/begin CHARACTERISTIC DFES_FaultTyp.DFC_ComEAT11RingCnt_C "assigned fault type / Fault type assignment for check DFC_ComEAT11RingCnt" VALUE 0x804F9B7D Val_Wu8 255.0 DFES_OneToOne 0.00 255.0 FORMAT "%5.1" /end CHARACTERISTIC
/begin CHARACTERISTIC DFES_FaultTyp.DFC_ComEAT11TOut_C "assigned fault type / Fault type assignment for check DFC_ComEAT11TOut" VALUE 0x804F9B7E Val_Wu8 255.0 DFES_OneToOne 0.00 255.0 FORMAT "%5.1" /end CHARACTERISTIC
/begin CHARACTERISTIC DFES_FaultTyp.DFC_ComEAT12ChkSum_C "assigned fault type / Fault type assignment for check DFC_ComEAT12ChkSum" VALUE 0x804F9B7F Val_Wu8 255.0 DFES_OneToOne 0.00 255.0 FORMAT "%5.1" /end CHARACTERISTIC
/begin CHARACTERISTIC DFES_FaultTyp.DFC_ComEAT12RingCnt_C "assigned fault type / Fault type assignment for check DFC_ComEAT12RingCnt" VALUE 0x804F9B80 Val_Wu8 255.0 DFES_OneToOne 0.00 255.0 FORMAT "%5.1" /end CHARACTERISTIC
/begin CHARACTERISTIC DFES_FaultTyp.DFC_ComEAT12TOut_C "assigned fault type / Fault type assignment for check DFC_ComEAT12TOut" VALUE 0x804F9B81 Val_Wu8 255.0 DFES_OneToOne 0.00 255.0 FORMAT "%5.1" /end CHARACTERISTIC
/begin CHARACTERISTIC DFES_FaultTyp.DFC_ComEAT13ChkSum_C "assigned fault type / Fault type assignment for check DFC_ComEAT13ChkSum" VALUE 0x804F9B82 Val_Wu8 255.0 DFES_OneToOne 0.00 255.0 FORMAT "%5.1" /end CHARACTERISTIC
/begin CHARACTERISTIC DFES_FaultTyp.DFC_ComEAT13RingCnt_C "assigned fault type / Fault type assignment for check DFC_ComEAT13RingCnt" VALUE 0x804F9B83 Val_Wu8 255.0 DFES_OneToOne 0.00 255.0 FORMAT "%5.1" /end CHARACTERISTIC
/begin CHARACTERISTIC DFES_FaultTyp.DFC_ComEAT13TOut_C "assigned fault type / Fault type assignment for check DFC_ComEAT13TOut" VALUE 0x804F9B84 Val_Wu8 255.0 DFES_OneToOne 0.00 255.0 FORMAT "%5.1" /end CHARACTERISTIC
/begin CHARACTERISTIC DFES_FaultTyp.DFC_ComEAT1Chksum_C "assigned fault type / Fault type assignment for check DFC_ComEAT1Chksum" VALUE 0x804F9B85 Val_Wu8 255.0 DFES_OneToOne 0.00 255.0 FORMAT "%5.1" /end CHARACTERISTIC
/begin CHARACTERISTIC DFES_FaultTyp.DFC_ComEAT1RingCnt_C "assigned fault type / Fault type assignment for check DFC_ComEAT1RingCnt" VALUE 0x804F9B86 Val_Wu8 255.0 DFES_OneToOne 0.00 255.0 FORMAT "%5.1" /end CHARACTERISTIC
/begin CHARACTERISTIC DFES_FaultTyp.DFC_ComEAT1TOut_C "assigned fault type / Fault type assignment for check DFC_ComEAT1TOut" VALUE 0x804F9B87 Val_Wu8 255.0 DFES_OneToOne 0.00 255.0 FORMAT "%5.1" /end CHARACTERISTIC
/begin CHARACTERISTIC DFES_FaultTyp.DFC_ComEAT2ChkSum_C "assigned fault type / Fault type assignment for check DFC_ComEAT2ChkSum" VALUE 0x804F9B88 Val_Wu8 255.0 DFES_OneToOne 0.00 255.0 FORMAT "%5.1" /end CHARACTERISTIC
/begin CHARACTERISTIC DFES_FaultTyp.DFC_ComEAT2RingCnt_C "assigned fault type / Fault type assignment for check DFC_ComEAT2RingCnt" VALUE 0x804F9B89 Val_Wu8 255.0 DFES_OneToOne 0.00 255.0 FORMAT "%5.1" /end CHARACTERISTIC
/begin CHARACTERISTIC DFES_FaultTyp.DFC_ComEAT2TOut_C "assigned fault type / Fault type assignment for check DFC_ComEAT2TOut" VALUE 0x804F9B8A Val_Wu8 255.0 DFES_OneToOne 0.00 255.0 FORMAT "%5.1" /end CHARACTERISTIC
/begin CHARACTERISTIC DFES_FaultTyp.DFC_ComEAT4ChkSum_C "assigned fault type / Fault type assignment for check DFC_ComEAT4ChkSum" VALUE 0x804F9B8B Val_Wu8 255.0 DFES_OneToOne 0.00 255.0 FORMAT "%5.1" /end CHARACTERISTIC
/begin CHARACTERISTIC DFES_FaultTyp.DFC_ComEAT4RingCnt_C "assigned fault type / Fault type assignment for check DFC_ComEAT4RingCnt" VALUE 0x804F9B8C Val_Wu8 255.0 DFES_OneToOne 0.00 255.0 FORMAT "%5.1" /end CHARACTERISTIC
/begin CHARACTERISTIC DFES_FaultTyp.DFC_ComEAT4TOut_C "assigned fault type / Fault type assignment for check DFC_ComEAT4TOut" VALUE 0x804F9B8D Val_Wu8 255.0 DFES_OneToOne 0.00 255.0 FORMAT "%5.1" /end CHARACTERISTIC
/begin CHARACTERISTIC DFES_FaultTyp.DFC_ComEAT6Chksum_C "assigned fault type / Fault type assignment for check DFC_ComEAT6Chksum" VALUE 0x804F9B8E Val_Wu8 255.0 DFES_OneToOne 0.00 255.0 FORMAT "%5.1" /end CHARACTERISTIC
/begin CHARACTERISTIC DFES_FaultTyp.DFC_ComEAT6RingCnt_C "assigned fault type / Fault type assignment for check DFC_ComEAT6RingCnt" VALUE 0x804F9B8F Val_Wu8 255.0 DFES_OneToOne 0.00 255.0 FORMAT "%5.1" /end CHARACTERISTIC
/begin CHARACTERISTIC DFES_FaultTyp.DFC_ComEAT6TOut_C "assigned fault type / Fault type assignment for check DFC_ComEAT6TOut" VALUE 0x804F9B90 Val_Wu8 255.0 DFES_OneToOne 0.00 255.0 FORMAT "%5.1" /end CHARACTERISTIC
/begin CHARACTERISTIC DFES_FaultTyp.DFC_ComEAT7Chksum_C "assigned fault type / Fault type assignment for check DFC_ComEAT7Chksum" VALUE 0x804F9B91 Val_Wu8 255.0 DFES_OneToOne 0.00 255.0 FORMAT "%5.1" /end CHARACTERISTIC
/begin CHARACTERISTIC DFES_FaultTyp.DFC_ComEAT7RingCnt_C "assigned fault type / Fault type assignment for check DFC_ComEAT7RingCnt" VALUE 0x804F9B92 Val_Wu8 255.0 DFES_OneToOne 0.00 255.0 FORMAT "%5.1" /end CHARACTERISTIC
/begin CHARACTERISTIC DFES_FaultTyp.DFC_ComEAT7TOut_C "assigned fault type / Fault type assignment for check DFC_ComEAT7TOut" VALUE 0x804F9B93 Val_Wu8 255.0 DFES_OneToOne 0.00 255.0 FORMAT "%5.1" /end CHARACTERISTIC
/begin CHARACTERISTIC DFES_FaultTyp.DFC_ComEAT8Chksum_C "assigned fault type / Fault type assignment for check DFC_ComEAT8Chksum" VALUE 0x804F9B94 Val_Wu8 255.0 DFES_OneToOne 0.00 255.0 FORMAT "%5.1" /end CHARACTERISTIC
/begin CHARACTERISTIC DFES_FaultTyp.DFC_ComEAT8RingCnt_C "assigned fault type / Fault type assignment for check DFC_ComEAT8RingCnt" VALUE 0x804F9B95 Val_Wu8 255.0 DFES_OneToOne 0.00 255.0 FORMAT "%5.1" /end CHARACTERISTIC
/begin CHARACTERISTIC DFES_FaultTyp.DFC_ComEAT8TOut_C "assigned fault type / Fault type assignment for check DFC_ComEAT8TOut" VALUE 0x804F9B96 Val_Wu8 255.0 DFES_OneToOne 0.00 255.0 FORMAT "%5.1" /end CHARACTERISTIC
/begin CHARACTERISTIC DFES_FaultTyp.DFC_ComEATAChksum_C "assigned fault type / Fault type assignment for check DFC_ComEATAChksum" VALUE 0x804F9B97 Val_Wu8 255.0 DFES_OneToOne 0.00 255.0 FORMAT "%5.1" /end CHARACTERISTIC
/begin CHARACTERISTIC DFES_FaultTyp.DFC_ComEATARingCnt_C "assigned fault type / Fault type assignment for check DFC_ComEATARingCnt" VALUE 0x804F9B98 Val_Wu8 255.0 DFES_OneToOne 0.00 255.0 FORMAT "%5.1" /end CHARACTERISTIC
/begin CHARACTERISTIC DFES_FaultTyp.DFC_ComEATATOut_C "assigned fault type / Fault type assignment for check DFC_ComEATATOut" VALUE 0x804F9B99 Val_Wu8 255.0 DFES_OneToOne 0.00 255.0 FORMAT "%5.1" /end CHARACTERISTIC
/begin CHARACTERISTIC DFES_FaultTyp.DFC_ComEATBChkSum_C "assigned fault type / Fault type assignment for check DFC_ComEATBChkSum" VALUE 0x804F9B9A Val_Wu8 255.0 DFES_OneToOne 0.00 255.0 FORMAT "%5.1" /end CHARACTERISTIC
/begin CHARACTERISTIC DFES_FaultTyp.DFC_ComEATBRingCnt_C "assigned fault type / Fault type assignment for check DFC_ComEATBRingCnt" VALUE 0x804F9B9B Val_Wu8 255.0 DFES_OneToOne 0.00 255.0 FORMAT "%5.1" /end CHARACTERISTIC
/begin CHARACTERISTIC DFES_FaultTyp.DFC_ComEATBTOut_C "assigned fault type / Fault type assignment for check DFC_ComEATBTOut" VALUE 0x804F9B9C Val_Wu8 255.0 DFES_OneToOne 0.00 255.0 FORMAT "%5.1" /end CHARACTERISTIC
/begin CHARACTERISTIC DFES_FaultTyp.DFC_ComEATCChksum_C "assigned fault type / Fault type assignment for check DFC_ComEATCChksum" VALUE 0x804F9B9D Val_Wu8 255.0 DFES_OneToOne 0.00 255.0 FORMAT "%5.1" /end CHARACTERISTIC
/begin CHARACTERISTIC DFES_FaultTyp.DFC_ComEATCRingCnt_C "assigned fault type / Fault type assignment for check DFC_ComEATCRingCnt" VALUE 0x804F9B9E Val_Wu8 255.0 DFES_OneToOne 0.00 255.0 FORMAT "%5.1" /end CHARACTERISTIC
/begin CHARACTERISTIC DFES_FaultTyp.DFC_ComEATCTOut_C "assigned fault type / Fault type assignment for check DFC_ComEATCTOut" VALUE 0x804F9B9F Val_Wu8 255.0 DFES_OneToOne 0.00 255.0 FORMAT "%5.1" /end CHARACTERISTIC
/begin CHARACTERISTIC DFES_FaultTyp.DFC_ComEBBAChksum_C "assigned fault type / Fault type assignment for check DFC_ComEBBAChksum" VALUE 0x804F9BA0 Val_Wu8 255.0 DFES_OneToOne 0.00 255.0 FORMAT "%5.1" /end CHARACTERISTIC
/begin CHARACTERISTIC DFES_FaultTyp.DFC_ComEBBARingCnt_C "assigned fault type / Fault type assignment for check DFC_ComEBBARingCnt" VALUE 0x804F9BA1 Val_Wu8 255.0 DFES_OneToOne 0.00 255.0 FORMAT "%5.1" /end CHARACTERISTIC
/begin CHARACTERISTIC DFES_FaultTyp.DFC_ComEBBATOut_C "assigned fault type / Fault type assignment for check DFC_ComEBBATOut" VALUE 0x804F9BA2 Val_Wu8 255.0 DFES_OneToOne 0.00 255.0 FORMAT "%5.1" /end CHARACTERISTIC
/begin CHARACTERISTIC DFES_FaultTyp.DFC_ComEPS1Chksum_C "assigned fault type / Fault type assignment for check DFC_ComEPS1Chksum" VALUE 0x804F9BA3 Val_Wu8 255.0 DFES_OneToOne 0.00 255.0 FORMAT "%5.1" /end CHARACTERISTIC
/begin CHARACTERISTIC DFES_FaultTyp.DFC_ComEPS1RingCnt_C "assigned fault type / Fault type assignment for check DFC_ComEPS1RingCnt" VALUE 0x804F9BA4 Val_Wu8 255.0 DFES_OneToOne 0.00 255.0 FORMAT "%5.1" /end CHARACTERISTIC
/begin CHARACTERISTIC DFES_FaultTyp.DFC_ComEPS1TOut_C "assigned fault type / Fault type assignment for check DFC_ComEPS1TOut" VALUE 0x804F9BA5 Val_Wu8 255.0 DFES_OneToOne 0.00 255.0 FORMAT "%5.1" /end CHARACTERISTIC
/begin CHARACTERISTIC DFES_FaultTyp.DFC_ComEngCanRxErr_C "assigned fault type / Fault type assignment for check DFC_ComEngCanRxErr" VALUE 0x804F9BA6 Val_Wu8 255.0 DFES_OneToOne 0.00 255.0 FORMAT "%5.1" /end CHARACTERISTIC
/begin CHARACTERISTIC DFES_FaultTyp.DFC_ComGrvySnsrErr_C "assigned fault type / Fault type assignment for check DFC_ComGrvySnsrErr" VALUE 0x804F9BA7 Val_Wu8 255.0 DFES_OneToOne 0.00 255.0 FORMAT "%5.1" /end CHARACTERISTIC
/begin CHARACTERISTIC DFES_FaultTyp.DFC_ComGwIMG1ChkSum_C "assigned fault type / Fault type assignment for check DFC_ComGwIMG1ChkSum" VALUE 0x804F9BA8 Val_Wu8 255.0 DFES_OneToOne 0.00 255.0 FORMAT "%5.1" /end CHARACTERISTIC
/begin CHARACTERISTIC DFES_FaultTyp.DFC_ComGwIMG1RingCnt_C "assigned fault type / Fault type assignment for check DFC_ComGwIMG1RingCnt" VALUE 0x804F9BA9 Val_Wu8 255.0 DFES_OneToOne 0.00 255.0 FORMAT "%5.1" /end CHARACTERISTIC
/begin CHARACTERISTIC DFES_FaultTyp.DFC_ComGwIMG1TOut_C "assigned fault type / Fault type assignment for check DFC_ComGwIMG1TOut" VALUE 0x804F9BAA Val_Wu8 255.0 DFES_OneToOne 0.00 255.0 FORMAT "%5.1" /end CHARACTERISTIC
/begin CHARACTERISTIC DFES_FaultTyp.DFC_ComGwIMG3ChkSum_C "assigned fault type / Fault type assignment for check DFC_ComGwIMG3ChkSum" VALUE 0x804F9BAB Val_Wu8 255.0 DFES_OneToOne 0.00 255.0 FORMAT "%5.1" /end CHARACTERISTIC
/begin CHARACTERISTIC DFES_FaultTyp.DFC_ComGwIMG3RingCnt_C "assigned fault type / Fault type assignment for check DFC_ComGwIMG3RingCnt" VALUE 0x804F9BAC Val_Wu8 255.0 DFES_OneToOne 0.00 255.0 FORMAT "%5.1" /end CHARACTERISTIC
/begin CHARACTERISTIC DFES_FaultTyp.DFC_ComGwIMG3TOut_C "assigned fault type / Fault type assignment for check DFC_ComGwIMG3TOut" VALUE 0x804F9BAD Val_Wu8 255.0 DFES_OneToOne 0.00 255.0 FORMAT "%5.1" /end CHARACTERISTIC
/begin CHARACTERISTIC DFES_FaultTyp.DFC_ComGwIMG4ChkSum_C "assigned fault type / Fault type assignment for check DFC_ComGwIMG4ChkSum" VALUE 0x804F9BAE Val_Wu8 255.0 DFES_OneToOne 0.00 255.0 FORMAT "%5.1" /end CHARACTERISTIC
/begin CHARACTERISTIC DFES_FaultTyp.DFC_ComGwIMG4RingCnt_C "assigned fault type / Fault type assignment for check DFC_ComGwIMG4RingCnt" VALUE 0x804F9BAF Val_Wu8 255.0 DFES_OneToOne 0.00 255.0 FORMAT "%5.1" /end CHARACTERISTIC
/begin CHARACTERISTIC DFES_FaultTyp.DFC_ComGwIMG4TOut_C "assigned fault type / Fault type assignment for check DFC_ComGwIMG4TOut" VALUE 0x804F9BB0 Val_Wu8 255.0 DFES_OneToOne 0.00 255.0 FORMAT "%5.1" /end CHARACTERISTIC
/begin CHARACTERISTIC DFES_FaultTyp.DFC_ComGwIMG5ChkSum_C "assigned fault type / Fault type assignment for check DFC_ComGwIMG5ChkSum" VALUE 0x804F9BB1 Val_Wu8 255.0 DFES_OneToOne 0.00 255.0 FORMAT "%5.1" /end CHARACTERISTIC
/begin CHARACTERISTIC DFES_FaultTyp.DFC_ComGwIMG5RingCnt_C "assigned fault type / Fault type assignment for check DFC_ComGwIMG5RingCnt" VALUE 0x804F9BB2 Val_Wu8 255.0 DFES_OneToOne 0.00 255.0 FORMAT "%5.1" /end CHARACTERISTIC
/begin CHARACTERISTIC DFES_FaultTyp.DFC_ComGwIMG5TOut_C "assigned fault type / Fault type assignment for check DFC_ComGwIMG5TOut" VALUE 0x804F9BB3 Val_Wu8 255.0 DFES_OneToOne 0.00 255.0 FORMAT "%5.1" /end CHARACTERISTIC
/begin CHARACTERISTIC DFES_FaultTyp.DFC_ComGwIMG6ChkSum_C "assigned fault type / Fault type assignment for check DFC_ComGwIMG6ChkSum" VALUE 0x804F9BB4 Val_Wu8 255.0 DFES_OneToOne 0.00 255.0 FORMAT "%5.1" /end CHARACTERISTIC
/begin CHARACTERISTIC DFES_FaultTyp.DFC_ComGwIMG6RingCnt_C "assigned fault type / Fault type assignment for check DFC_ComGwIMG6RingCnt" VALUE 0x804F9BB5 Val_Wu8 255.0 DFES_OneToOne 0.00 255.0 FORMAT "%5.1" /end CHARACTERISTIC
/begin CHARACTERISTIC DFES_FaultTyp.DFC_ComGwIMG6TOut_C "assigned fault type / Fault type assignment for check DFC_ComGwIMG6TOut" VALUE 0x804F9BB6 Val_Wu8 255.0 DFES_OneToOne 0.00 255.0 FORMAT "%5.1" /end CHARACTERISTIC
/begin CHARACTERISTIC DFES_FaultTyp.DFC_ComIDASBChksum_C "assigned fault type / Fault type assignment for check DFC_ComIDASBChksum" VALUE 0x804F9BB7 Val_Wu8 255.0 DFES_OneToOne 0.00 255.0 FORMAT "%5.1" /end CHARACTERISTIC
/begin CHARACTERISTIC DFES_FaultTyp.DFC_ComIDASBRingCnt_C "assigned fault type / Fault type assignment for check DFC_ComIDASBRingCnt" VALUE 0x804F9BB8 Val_Wu8 255.0 DFES_OneToOne 0.00 255.0 FORMAT "%5.1" /end CHARACTERISTIC
/begin CHARACTERISTIC DFES_FaultTyp.DFC_ComIDASBTOut_C "assigned fault type / Fault type assignment for check DFC_ComIDASBTOut" VALUE 0x804F9BB9 Val_Wu8 255.0 DFES_OneToOne 0.00 255.0 FORMAT "%5.1" /end CHARACTERISTIC
/begin CHARACTERISTIC DFES_FaultTyp.DFC_ComIMGMILReq_C "assigned fault type / Fault type assignment for check DFC_ComIMGMILReq" VALUE 0x804F9BBA Val_Wu8 255.0 DFES_OneToOne 0.00 255.0 FORMAT "%5.1" /end CHARACTERISTIC
/begin CHARACTERISTIC DFES_FaultTyp.DFC_ComISSPrms_C "assigned fault type / Fault type assignment for check DFC_ComISSPrms" VALUE 0x804F9BBB Val_Wu8 255.0 DFES_OneToOne 0.00 255.0 FORMAT "%5.1" /end CHARACTERISTIC
/begin CHARACTERISTIC DFES_FaultTyp.DFC_ComMETAChksum_C "assigned fault type / Fault type assignment for check DFC_ComMETAChksum" VALUE 0x804F9BBC Val_Wu8 255.0 DFES_OneToOne 0.00 255.0 FORMAT "%5.1" /end CHARACTERISTIC
/begin CHARACTERISTIC DFES_FaultTyp.DFC_ComMETARingCnt_C "assigned fault type / Fault type assignment for check DFC_ComMETARingCnt" VALUE 0x804F9BBD Val_Wu8 255.0 DFES_OneToOne 0.00 255.0 FORMAT "%5.1" /end CHARACTERISTIC
/begin CHARACTERISTIC DFES_FaultTyp.DFC_ComMETATOut_C "assigned fault type / Fault type assignment for check DFC_ComMETATOut" VALUE 0x804F9BBE Val_Wu8 255.0 DFES_OneToOne 0.00 255.0 FORMAT "%5.1" /end CHARACTERISTIC
/begin CHARACTERISTIC DFES_FaultTyp.DFC_ComMETCChksum_C "assigned fault type / Fault type assignment for check DFC_ComMETCChksum" VALUE 0x804F9BBF Val_Wu8 255.0 DFES_OneToOne 0.00 255.0 FORMAT "%5.1" /end CHARACTERISTIC
/begin CHARACTERISTIC DFES_FaultTyp.DFC_ComMETCRingCnt_C "assigned fault type / Fault type assignment for check DFC_ComMETCRingCnt" VALUE 0x804F9BC0 Val_Wu8 255.0 DFES_OneToOne 0.00 255.0 FORMAT "%5.1" /end CHARACTERISTIC
/begin CHARACTERISTIC DFES_FaultTyp.DFC_ComMETCTOut_C "assigned fault type / Fault type assignment for check DFC_ComMETCTOut" VALUE 0x804F9BC1 Val_Wu8 255.0 DFES_OneToOne 0.00 255.0 FORMAT "%5.1" /end CHARACTERISTIC
/begin CHARACTERISTIC DFES_FaultTyp.DFC_ComMETDChksum_C "assigned fault type / Fault type assignment for check DFC_ComMETDChksum" VALUE 0x804F9BC2 Val_Wu8 255.0 DFES_OneToOne 0.00 255.0 FORMAT "%5.1" /end CHARACTERISTIC
/begin CHARACTERISTIC DFES_FaultTyp.DFC_ComMETDRingCnt_C "assigned fault type / Fault type assignment for check DFC_ComMETDRingCnt" VALUE 0x804F9BC3 Val_Wu8 255.0 DFES_OneToOne 0.00 255.0 FORMAT "%5.1" /end CHARACTERISTIC
/begin CHARACTERISTIC DFES_FaultTyp.DFC_ComMETDTOut_C "assigned fault type / Fault type assignment for check DFC_ComMETDTOut" VALUE 0x804F9BC4 Val_Wu8 255.0 DFES_OneToOne 0.00 255.0 FORMAT "%5.1" /end CHARACTERISTIC
/begin CHARACTERISTIC DFES_FaultTyp.DFC_ComMETE2Chksum_C "assigned fault type / Fault type assignment for check DFC_ComMETE2Chksum" VALUE 0x804F9BC5 Val_Wu8 255.0 DFES_OneToOne 0.00 255.0 FORMAT "%5.1" /end CHARACTERISTIC
/begin CHARACTERISTIC DFES_FaultTyp.DFC_ComMETE2RingCnt_C "assigned fault type / Fault type assignment for check DFC_ComMETE2RingCnt" VALUE 0x804F9BC6 Val_Wu8 255.0 DFES_OneToOne 0.00 255.0 FORMAT "%5.1" /end CHARACTERISTIC
/begin CHARACTERISTIC DFES_FaultTyp.DFC_ComMETE2TOut_C "assigned fault type / Fault type assignment for check DFC_ComMETE2TOut" VALUE 0x804F9BC7 Val_Wu8 255.0 DFES_OneToOne 0.00 255.0 FORMAT "%5.1" /end CHARACTERISTIC
/begin CHARACTERISTIC DFES_FaultTyp.DFC_ComMETFChksum_C "assigned fault type / Fault type assignment for check DFC_ComMETFChksum" VALUE 0x804F9BC8 Val_Wu8 255.0 DFES_OneToOne 0.00 255.0 FORMAT "%5.1" /end CHARACTERISTIC
/begin CHARACTERISTIC DFES_FaultTyp.DFC_ComMETFRingCnt_C "assigned fault type / Fault type assignment for check DFC_ComMETFRingCnt" VALUE 0x804F9BC9 Val_Wu8 255.0 DFES_OneToOne 0.00 255.0 FORMAT "%5.1" /end CHARACTERISTIC
/begin CHARACTERISTIC DFES_FaultTyp.DFC_ComMETFTOut_C "assigned fault type / Fault type assignment for check DFC_ComMETFTOut" VALUE 0x804F9BCA Val_Wu8 255.0 DFES_OneToOne 0.00 255.0 FORMAT "%5.1" /end CHARACTERISTIC
/begin CHARACTERISTIC DFES_FaultTyp.DFC_ComMETGChksum_C "assigned fault type / Fault type assignment for check DFC_ComMETGChksum" VALUE 0x804F9BCB Val_Wu8 255.0 DFES_OneToOne 0.00 255.0 FORMAT "%5.1" /end CHARACTERISTIC
/begin CHARACTERISTIC DFES_FaultTyp.DFC_ComMETGRingCnt_C "assigned fault type / Fault type assignment for check DFC_ComMETGRingCnt" VALUE 0x804F9BCC Val_Wu8 255.0 DFES_OneToOne 0.00 255.0 FORMAT "%5.1" /end CHARACTERISTIC
/begin CHARACTERISTIC DFES_FaultTyp.DFC_ComMETGTOut_C "assigned fault type / Fault type assignment for check DFC_ComMETGTOut" VALUE 0x804F9BCD Val_Wu8 255.0 DFES_OneToOne 0.00 255.0 FORMAT "%5.1" /end CHARACTERISTIC
/begin CHARACTERISTIC DFES_FaultTyp.DFC_ComMETH2Chksum_C "assigned fault type / Fault type assignment for check DFC_ComMETH2Chksum" VALUE 0x804F9BCE Val_Wu8 255.0 DFES_OneToOne 0.00 255.0 FORMAT "%5.1" /end CHARACTERISTIC
/begin CHARACTERISTIC DFES_FaultTyp.DFC_ComMETH2RingCnt_C "assigned fault type / Fault type assignment for check DFC_ComMETH2RingCnt" VALUE 0x804F9BCF Val_Wu8 255.0 DFES_OneToOne 0.00 255.0 FORMAT "%5.1" /end CHARACTERISTIC
/begin CHARACTERISTIC DFES_FaultTyp.DFC_ComMETH2TOut_C "assigned fault type / Fault type assignment for check DFC_ComMETH2TOut" VALUE 0x804F9BD0 Val_Wu8 255.0 DFES_OneToOne 0.00 255.0 FORMAT "%5.1" /end CHARACTERISTIC
/begin CHARACTERISTIC DFES_FaultTyp.DFC_ComMETHChksum_C "assigned fault type / Fault type assignment for check DFC_ComMETHChksum" VALUE 0x804F9BD1 Val_Wu8 255.0 DFES_OneToOne 0.00 255.0 FORMAT "%5.1" /end CHARACTERISTIC
/begin CHARACTERISTIC DFES_FaultTyp.DFC_ComMETHRingCnt_C "assigned fault type / Fault type assignment for check DFC_ComMETHRingCnt" VALUE 0x804F9BD2 Val_Wu8 255.0 DFES_OneToOne 0.00 255.0 FORMAT "%5.1" /end CHARACTERISTIC
/begin CHARACTERISTIC DFES_FaultTyp.DFC_ComMETHTOut_C "assigned fault type / Fault type assignment for check DFC_ComMETHTOut" VALUE 0x804F9BD3 Val_Wu8 255.0 DFES_OneToOne 0.00 255.0 FORMAT "%5.1" /end CHARACTERISTIC
/begin CHARACTERISTIC DFES_FaultTyp.DFC_ComMETIChksum_C "assigned fault type / Fault type assignment for check DFC_ComMETIChksum" VALUE 0x804F9BD4 Val_Wu8 255.0 DFES_OneToOne 0.00 255.0 FORMAT "%5.1" /end CHARACTERISTIC
/begin CHARACTERISTIC DFES_FaultTyp.DFC_ComMETIRingCnt_C "assigned fault type / Fault type assignment for check DFC_ComMETIRingCnt" VALUE 0x804F9BD5 Val_Wu8 255.0 DFES_OneToOne 0.00 255.0 FORMAT "%5.1" /end CHARACTERISTIC
/begin CHARACTERISTIC DFES_FaultTyp.DFC_ComMETITOut_C "assigned fault type / Fault type assignment for check DFC_ComMETITOut" VALUE 0x804F9BD6 Val_Wu8 255.0 DFES_OneToOne 0.00 255.0 FORMAT "%5.1" /end CHARACTERISTIC
/begin CHARACTERISTIC DFES_FaultTyp.DFC_ComMETKChksum_C "assigned fault type / Fault type assignment for check DFC_ComMETKChksum" VALUE 0x804F9BD7 Val_Wu8 255.0 DFES_OneToOne 0.00 255.0 FORMAT "%5.1" /end CHARACTERISTIC
/begin CHARACTERISTIC DFES_FaultTyp.DFC_ComMETKRingCnt_C "assigned fault type / Fault type assignment for check DFC_ComMETKRingCnt" VALUE 0x804F9BD8 Val_Wu8 255.0 DFES_OneToOne 0.00 255.0 FORMAT "%5.1" /end CHARACTERISTIC
/begin CHARACTERISTIC DFES_FaultTyp.DFC_ComMETKTOut_C "assigned fault type / Fault type assignment for check DFC_ComMETKTOut" VALUE 0x804F9BD9 Val_Wu8 255.0 DFES_OneToOne 0.00 255.0 FORMAT "%5.1" /end CHARACTERISTIC
/begin CHARACTERISTIC DFES_FaultTyp.DFC_ComMETLChksum_C "assigned fault type / Fault type assignment for check DFC_ComMETLChksum" VALUE 0x804F9BDA Val_Wu8 255.0 DFES_OneToOne 0.00 255.0 FORMAT "%5.1" /end CHARACTERISTIC
/begin CHARACTERISTIC DFES_FaultTyp.DFC_ComMETLRingCnt_C "assigned fault type / Fault type assignment for check DFC_ComMETLRingCnt" VALUE 0x804F9BDB Val_Wu8 255.0 DFES_OneToOne 0.00 255.0 FORMAT "%5.1" /end CHARACTERISTIC
/begin CHARACTERISTIC DFES_FaultTyp.DFC_ComMETLTOut_C "assigned fault type / Fault type assignment for check DFC_ComMETLTOut" VALUE 0x804F9BDC Val_Wu8 255.0 DFES_OneToOne 0.00 255.0 FORMAT "%5.1" /end CHARACTERISTIC
/begin CHARACTERISTIC DFES_FaultTyp.DFC_ComMETMChksum_C "assigned fault type / Fault type assignment for check DFC_ComMETMChksum" VALUE 0x804F9BDD Val_Wu8 255.0 DFES_OneToOne 0.00 255.0 FORMAT "%5.1" /end CHARACTERISTIC
/begin CHARACTERISTIC DFES_FaultTyp.DFC_ComMETMRingCnt_C "assigned fault type / Fault type assignment for check DFC_ComMETMRingCnt" VALUE 0x804F9BDE Val_Wu8 255.0 DFES_OneToOne 0.00 255.0 FORMAT "%5.1" /end CHARACTERISTIC
/begin CHARACTERISTIC DFES_FaultTyp.DFC_ComMETMTOut_C "assigned fault type / Fault type assignment for check DFC_ComMETMTOut" VALUE 0x804F9BDF Val_Wu8 255.0 DFES_OneToOne 0.00 255.0 FORMAT "%5.1" /end CHARACTERISTIC
/begin CHARACTERISTIC DFES_FaultTyp.DFC_ComMETNChksum_C "assigned fault type / Fault type assignment for check DFC_ComMETNChksum" VALUE 0x804F9BE0 Val_Wu8 255.0 DFES_OneToOne 0.00 255.0 FORMAT "%5.1" /end CHARACTERISTIC
/begin CHARACTERISTIC DFES_FaultTyp.DFC_ComMETNRingCnt_C "assigned fault type / Fault type assignment for check DFC_ComMETNRingCnt" VALUE 0x804F9BE1 Val_Wu8 255.0 DFES_OneToOne 0.00 255.0 FORMAT "%5.1" /end CHARACTERISTIC
/begin CHARACTERISTIC DFES_FaultTyp.DFC_ComMETNTOut_C "assigned fault type / Fault type assignment for check DFC_ComMETNTOut" VALUE 0x804F9BE2 Val_Wu8 255.0 DFES_OneToOne 0.00 255.0 FORMAT "%5.1" /end CHARACTERISTIC
/begin CHARACTERISTIC DFES_FaultTyp.DFC_ComMtrCom_C "assigned fault type / Fault type assignment for check DFC_ComMtrCom" VALUE 0x804F9BE3 Val_Wu8 255.0 DFES_OneToOne 0.00 255.0 FORMAT "%5.1" /end CHARACTERISTIC
/begin CHARACTERISTIC DFES_FaultTyp.DFC_ComPCUChkSum_C "assigned fault type / Fault type assignment for check DFC_ComPCUChkSum" VALUE 0x804F9BE4 Val_Wu8 255.0 DFES_OneToOne 0.00 255.0 FORMAT "%5.1" /end CHARACTERISTIC
/begin CHARACTERISTIC DFES_FaultTyp.DFC_ComPCURingCnt_C "assigned fault type / Fault type assignment for check DFC_ComPCURingCnt" VALUE 0x804F9BE5 Val_Wu8 255.0 DFES_OneToOne 0.00 255.0 FORMAT "%5.1" /end CHARACTERISTIC
/begin CHARACTERISTIC DFES_FaultTyp.DFC_ComPCUTOut_C "assigned fault type / Fault type assignment for check DFC_ComPCUTOut" VALUE 0x804F9BE6 Val_Wu8 255.0 DFES_OneToOne 0.00 255.0 FORMAT "%5.1" /end CHARACTERISTIC
/begin CHARACTERISTIC DFES_FaultTyp.DFC_ComSRSAChksum_C "assigned fault type / Fault type assignment for check DFC_ComSRSAChksum" VALUE 0x804F9BE7 Val_Wu8 255.0 DFES_OneToOne 0.00 255.0 FORMAT "%5.1" /end CHARACTERISTIC
/begin CHARACTERISTIC DFES_FaultTyp.DFC_ComSRSARingCnt_C "assigned fault type / Fault type assignment for check DFC_ComSRSARingCnt" VALUE 0x804F9BE8 Val_Wu8 255.0 DFES_OneToOne 0.00 255.0 FORMAT "%5.1" /end CHARACTERISTIC
/begin CHARACTERISTIC DFES_FaultTyp.DFC_ComSRSATOut_C "assigned fault type / Fault type assignment for check DFC_ComSRSATOut" VALUE 0x804F9BE9 Val_Wu8 255.0 DFES_OneToOne 0.00 255.0 FORMAT "%5.1" /end CHARACTERISTIC
/begin CHARACTERISTIC DFES_FaultTyp.DFC_ComSRSBChksum_C "assigned fault type / Fault type assignment for check DFC_ComSRSBChksum" VALUE 0x804F9BEA Val_Wu8 255.0 DFES_OneToOne 0.00 255.0 FORMAT "%5.1" /end CHARACTERISTIC
/begin CHARACTERISTIC DFES_FaultTyp.DFC_ComSRSBRingCnt_C "assigned fault type / Fault type assignment for check DFC_ComSRSBRingCnt" VALUE 0x804F9BEB Val_Wu8 255.0 DFES_OneToOne 0.00 255.0 FORMAT "%5.1" /end CHARACTERISTIC
/begin CHARACTERISTIC DFES_FaultTyp.DFC_ComSRSBTOut_C "assigned fault type / Fault type assignment for check DFC_ComSRSBTOut" VALUE 0x804F9BEC Val_Wu8 255.0 DFES_OneToOne 0.00 255.0 FORMAT "%5.1" /end CHARACTERISTIC
/begin CHARACTERISTIC DFES_FaultTyp.DFC_ComSRSChksum_C "assigned fault type / Fault type assignment for check DFC_ComSRSChksum" VALUE 0x804F9BED Val_Wu8 255.0 DFES_OneToOne 0.00 255.0 FORMAT "%5.1" /end CHARACTERISTIC
/begin CHARACTERISTIC DFES_FaultTyp.DFC_ComSRSErr_C "assigned fault type / Fault type assignment for check DFC_ComSRSErr" VALUE 0x804F9BEE Val_Wu8 255.0 DFES_OneToOne 0.00 255.0 FORMAT "%5.1" /end CHARACTERISTIC
/begin CHARACTERISTIC DFES_FaultTyp.DFC_ComSRSRingCnt_C "assigned fault type / Fault type assignment for check DFC_ComSRSRingCnt" VALUE 0x804F9BEF Val_Wu8 255.0 DFES_OneToOne 0.00 255.0 FORMAT "%5.1" /end CHARACTERISTIC
/begin CHARACTERISTIC DFES_FaultTyp.DFC_ComSRSTOut_C "assigned fault type / Fault type assignment for check DFC_ComSRSTOut" VALUE 0x804F9BF0 Val_Wu8 255.0 DFES_OneToOne 0.00 255.0 FORMAT "%5.1" /end CHARACTERISTIC
/begin CHARACTERISTIC DFES_FaultTyp.DFC_ComVehSpdPndFltTCU_C "assigned fault type / Fault type assignment for check DFC_ComVehSpdPndFltTCU" VALUE 0x804F9BF1 Val_Wu8 255.0 DFES_OneToOne 0.00 255.0 FORMAT "%5.1" /end CHARACTERISTIC
/begin CHARACTERISTIC DFES_FaultTyp.DFC_EbsChartcCurrErr_C "assigned fault type / Fault type assignment for check DFC_EbsChartcCurrErr" VALUE 0x804F9BF2 Val_Wu8 255.0 DFES_OneToOne 0.00 255.0 FORMAT "%5.1" /end CHARACTERISTIC
/begin CHARACTERISTIC DFES_FaultTyp.DFC_EbsSelfDiagErr_C "assigned fault type / Fault type assignment for check DFC_EbsSelfDiagErr" VALUE 0x804F9BF3 Val_Wu8 255.0 DFES_OneToOne 0.00 255.0 FORMAT "%5.1" /end CHARACTERISTIC
/begin CHARACTERISTIC DFES_FaultTyp.DFC_GbxCANDigPlausErr_C "assigned fault type / Fault type assignment for check DFC_GbxCANDigPlausErr" VALUE 0x804F9BF4 Val_Wu8 255.0 DFES_OneToOne 0.00 255.0 FORMAT "%5.1" /end CHARACTERISTIC
/begin CHARACTERISTIC DFES_FaultTyp.DFC_GbxNPos1SRCMax_C "assigned fault type / Fault type assignment for check DFC_GbxNPos1SRCMax" VALUE 0x804F9BF5 Val_Wu8 255.0 DFES_OneToOne 0.00 255.0 FORMAT "%5.1" /end CHARACTERISTIC
/begin CHARACTERISTIC DFES_FaultTyp.DFC_GbxNPos1SRCMin_C "assigned fault type / Fault type assignment for check DFC_GbxNPos1SRCMin" VALUE 0x804F9BF6 Val_Wu8 255.0 DFES_OneToOne 0.00 255.0 FORMAT "%5.1" /end CHARACTERISTIC
/begin CHARACTERISTIC DFES_FaultTyp.DFC_GbxNPos2SRCMax_C "assigned fault type / Fault type assignment for check DFC_GbxNPos2SRCMax" VALUE 0x804F9BF7 Val_Wu8 255.0 DFES_OneToOne 0.00 255.0 FORMAT "%5.1" /end CHARACTERISTIC
/begin CHARACTERISTIC DFES_FaultTyp.DFC_GbxNPos2SRCMin_C "assigned fault type / Fault type assignment for check DFC_GbxNPos2SRCMin" VALUE 0x804F9BF8 Val_Wu8 255.0 DFES_OneToOne 0.00 255.0 FORMAT "%5.1" /end CHARACTERISTIC
/begin CHARACTERISTIC DFES_FaultTyp.DFC_GbxNPosAlvChk_C "assigned fault type / Fault type assignment for check DFC_GbxNPosAlvChk" VALUE 0x804F9BF9 Val_Wu8 255.0 DFES_OneToOne 0.00 255.0 FORMAT "%5.1" /end CHARACTERISTIC
/begin CHARACTERISTIC DFES_FaultTyp.DFC_GbxNPosSyncErr_C "assigned fault type / Fault type assignment for check DFC_GbxNPosSyncErr" VALUE 0x804F9BFA Val_Wu8 255.0 DFES_OneToOne 0.00 255.0 FORMAT "%5.1" /end CHARACTERISTIC
/begin CHARACTERISTIC DFES_FaultTyp.DFC_HEGOS2B1HtrPsMax_C "assigned fault type / Fault type assignment for check DFC_HEGOS2B1HtrPsMax" VALUE 0x804F9BFB Val_Wu8 255.0 DFES_OneToOne 0.00 255.0 FORMAT "%5.1" /end CHARACTERISTIC
/begin CHARACTERISTIC DFES_FaultTyp.DFC_HEGOS2B1HtrPsMin_C "assigned fault type / Fault type assignment for check DFC_HEGOS2B1HtrPsMin" VALUE 0x804F9BFC Val_Wu8 255.0 DFES_OneToOne 0.00 255.0 FORMAT "%5.1" /end CHARACTERISTIC
/begin CHARACTERISTIC DFES_FaultTyp.DFC_HEGOS2B1HtrPsSig_C "assigned fault type / Fault type assignment for check DFC_HEGOS2B1HtrPsSig" VALUE 0x804F9BFD Val_Wu8 255.0 DFES_OneToOne 0.00 255.0 FORMAT "%5.1" /end CHARACTERISTIC
/begin CHARACTERISTIC DFES_FaultTyp.DFC_LinCSErrACG_C "assigned fault type / Fault type assignment for check DFC_LinCSErrACG" VALUE 0x804F9BFE Val_Wu8 255.0 DFES_OneToOne 0.00 255.0 FORMAT "%5.1" /end CHARACTERISTIC
/begin CHARACTERISTIC DFES_FaultTyp.DFC_LinCSErrEBS_C "assigned fault type / Fault type assignment for check DFC_LinCSErrEBS" VALUE 0x804F9BFF Val_Wu8 255.0 DFES_OneToOne 0.00 255.0 FORMAT "%5.1" /end CHARACTERISTIC
/begin CHARACTERISTIC DFES_FaultTyp.DFC_LinHdrTimeoutErrACG_C "assigned fault type / Fault type assignment for check DFC_LinHdrTimeoutErrACG" VALUE 0x804F9C00 Val_Wu8 255.0 DFES_OneToOne 0.00 255.0 FORMAT "%5.1" /end CHARACTERISTIC
/begin CHARACTERISTIC DFES_FaultTyp.DFC_LinHdrTimeoutErrEBS_C "assigned fault type / Fault type assignment for check DFC_LinHdrTimeoutErrEBS" VALUE 0x804F9C01 Val_Wu8 255.0 DFES_OneToOne 0.00 255.0 FORMAT "%5.1" /end CHARACTERISTIC
/begin CHARACTERISTIC DFES_FaultTyp.DFC_LinMsgTimeoutErrACG_C "assigned fault type / Fault type assignment for check DFC_LinMsgTimeoutErrACG" VALUE 0x804F9C02 Val_Wu8 255.0 DFES_OneToOne 0.00 255.0 FORMAT "%5.1" /end CHARACTERISTIC
/begin CHARACTERISTIC DFES_FaultTyp.DFC_LinMsgTimeoutErrEBS_C "assigned fault type / Fault type assignment for check DFC_LinMsgTimeoutErrEBS" VALUE 0x804F9C03 Val_Wu8 255.0 DFES_OneToOne 0.00 255.0 FORMAT "%5.1" /end CHARACTERISTIC
/begin CHARACTERISTIC DFES_FaultTyp.DFC_LinNoStrtComErr_C "assigned fault type / Fault type assignment for check DFC_LinNoStrtComErr" VALUE 0x804F9C04 Val_Wu8 255.0 DFES_OneToOne 0.00 255.0 FORMAT "%5.1" /end CHARACTERISTIC
/begin CHARACTERISTIC DFES_FaultTyp.DFC_MisfDetVWhlFrntLeOORHi_C "assigned fault type / Fault type assignment for check DFC_MisfDetVWhlFrntLeOORHi" VALUE 0x804F9C05 Val_Wu8 255.0 DFES_OneToOne 0.00 255.0 FORMAT "%5.1" /end CHARACTERISTIC
/begin CHARACTERISTIC DFES_FaultTyp.DFC_MisfDetVWhlFrntLeRatyHi_C "assigned fault type / Fault type assignment for check DFC_MisfDetVWhlFrntLeRatyHi" VALUE 0x804F9C06 Val_Wu8 255.0 DFES_OneToOne 0.00 255.0 FORMAT "%5.1" /end CHARACTERISTIC
/begin CHARACTERISTIC DFES_FaultTyp.DFC_MisfDetVWhlFrntLeRatyLo_C "assigned fault type / Fault type assignment for check DFC_MisfDetVWhlFrntLeRatyLo" VALUE 0x804F9C07 Val_Wu8 255.0 DFES_OneToOne 0.00 255.0 FORMAT "%5.1" /end CHARACTERISTIC
/begin CHARACTERISTIC DFES_FaultTyp.DFC_MisfDetVWhlFrntLeStuck_C "assigned fault type / Fault type assignment for check DFC_MisfDetVWhlFrntLeStuck" VALUE 0x804F9C08 Val_Wu8 255.0 DFES_OneToOne 0.00 255.0 FORMAT "%5.1" /end CHARACTERISTIC
/begin CHARACTERISTIC DFES_FaultTyp.DFC_MisfDetVWhlFrntRiOORHi_C "assigned fault type / Fault type assignment for check DFC_MisfDetVWhlFrntRiOORHi" VALUE 0x804F9C09 Val_Wu8 255.0 DFES_OneToOne 0.00 255.0 FORMAT "%5.1" /end CHARACTERISTIC
/begin CHARACTERISTIC DFES_FaultTyp.DFC_MisfDetVWhlFrntRiRatyHi_C "assigned fault type / Fault type assignment for check DFC_MisfDetVWhlFrntRiRatyHi" VALUE 0x804F9C0A Val_Wu8 255.0 DFES_OneToOne 0.00 255.0 FORMAT "%5.1" /end CHARACTERISTIC
/begin CHARACTERISTIC DFES_FaultTyp.DFC_MisfDetVWhlFrntRiRatyLo_C "assigned fault type / Fault type assignment for check DFC_MisfDetVWhlFrntRiRatyLo" VALUE 0x804F9C0B Val_Wu8 255.0 DFES_OneToOne 0.00 255.0 FORMAT "%5.1" /end CHARACTERISTIC
/begin CHARACTERISTIC DFES_FaultTyp.DFC_MisfDetVWhlFrntRiStuck_C "assigned fault type / Fault type assignment for check DFC_MisfDetVWhlFrntRiStuck" VALUE 0x804F9C0C Val_Wu8 255.0 DFES_OneToOne 0.00 255.0 FORMAT "%5.1" /end CHARACTERISTIC
/begin CHARACTERISTIC DFES_FaultTyp.DFC_MisfDetVWhlReLeOORHi_C "assigned fault type / Fault type assignment for check DFC_MisfDetVWhlReLeOORHi" VALUE 0x804F9C0D Val_Wu8 255.0 DFES_OneToOne 0.00 255.0 FORMAT "%5.1" /end CHARACTERISTIC
/begin CHARACTERISTIC DFES_FaultTyp.DFC_MisfDetVWhlReLeRatyHi_C "assigned fault type / Fault type assignment for check DFC_MisfDetVWhlReLeRatyHi" VALUE 0x804F9C0E Val_Wu8 255.0 DFES_OneToOne 0.00 255.0 FORMAT "%5.1" /end CHARACTERISTIC
/begin CHARACTERISTIC DFES_FaultTyp.DFC_MisfDetVWhlReLeRatyLo_C "assigned fault type / Fault type assignment for check DFC_MisfDetVWhlReLeRatyLo" VALUE 0x804F9C0F Val_Wu8 255.0 DFES_OneToOne 0.00 255.0 FORMAT "%5.1" /end CHARACTERISTIC
/begin CHARACTERISTIC DFES_FaultTyp.DFC_MisfDetVWhlReLeStuck_C "assigned fault type / Fault type assignment for check DFC_MisfDetVWhlReLeStuck" VALUE 0x804F9C10 Val_Wu8 255.0 DFES_OneToOne 0.00 255.0 FORMAT "%5.1" /end CHARACTERISTIC
/begin CHARACTERISTIC DFES_FaultTyp.DFC_MisfDetVWhlReRiOORHi_C "assigned fault type / Fault type assignment for check DFC_MisfDetVWhlReRiOORHi" VALUE 0x804F9C11 Val_Wu8 255.0 DFES_OneToOne 0.00 255.0 FORMAT "%5.1" /end CHARACTERISTIC
/begin CHARACTERISTIC DFES_FaultTyp.DFC_MisfDetVWhlReRiRatyHi_C "assigned fault type / Fault type assignment for check DFC_MisfDetVWhlReRiRatyHi" VALUE 0x804F9C12 Val_Wu8 255.0 DFES_OneToOne 0.00 255.0 FORMAT "%5.1" /end CHARACTERISTIC
/begin CHARACTERISTIC DFES_FaultTyp.DFC_MisfDetVWhlReRiRatyLo_C "assigned fault type / Fault type assignment for check DFC_MisfDetVWhlReRiRatyLo" VALUE 0x804F9C13 Val_Wu8 255.0 DFES_OneToOne 0.00 255.0 FORMAT "%5.1" /end CHARACTERISTIC
/begin CHARACTERISTIC DFES_FaultTyp.DFC_MisfDetVWhlReRiStuck_C "assigned fault type / Fault type assignment for check DFC_MisfDetVWhlReRiStuck" VALUE 0x804F9C14 Val_Wu8 255.0 DFES_OneToOne 0.00 255.0 FORMAT "%5.1" /end CHARACTERISTIC
/begin CHARACTERISTIC DFES_FaultTyp.DFC_MisfDetdVWhlFrntLePlaus_C "assigned fault type / Fault type assignment for check DFC_MisfDetdVWhlFrntLePlaus" VALUE 0x804F9C15 Val_Wu8 255.0 DFES_OneToOne 0.00 255.0 FORMAT "%5.1" /end CHARACTERISTIC
/begin CHARACTERISTIC DFES_FaultTyp.DFC_MisfDetdVWhlFrntRiPlaus_C "assigned fault type / Fault type assignment for check DFC_MisfDetdVWhlFrntRiPlaus" VALUE 0x804F9C16 Val_Wu8 255.0 DFES_OneToOne 0.00 255.0 FORMAT "%5.1" /end CHARACTERISTIC
/begin CHARACTERISTIC DFES_FaultTyp.DFC_MisfDetdVWhlReLePlaus_C "assigned fault type / Fault type assignment for check DFC_MisfDetdVWhlReLePlaus" VALUE 0x804F9C17 Val_Wu8 255.0 DFES_OneToOne 0.00 255.0 FORMAT "%5.1" /end CHARACTERISTIC
/begin CHARACTERISTIC DFES_FaultTyp.DFC_MisfDetdVWhlReRiPlaus_C "assigned fault type / Fault type assignment for check DFC_MisfDetdVWhlReRiPlaus" VALUE 0x804F9C18 Val_Wu8 255.0 DFES_OneToOne 0.00 255.0 FORMAT "%5.1" /end CHARACTERISTIC
/begin CHARACTERISTIC DFES_FaultTyp.DFC_PEnvSigRngMax_C "assigned fault type / Fault type assignment for check DFC_PEnvSigRngMax" VALUE 0x804F9C19 Val_Wu8 255.0 DFES_OneToOne 0.00 255.0 FORMAT "%5.1" /end CHARACTERISTIC
/begin CHARACTERISTIC DFES_FaultTyp.DFC_PEnvSigRngMin_C "assigned fault type / Fault type assignment for check DFC_PEnvSigRngMin" VALUE 0x804F9C1A Val_Wu8 255.0 DFES_OneToOne 0.00 255.0 FORMAT "%5.1" /end CHARACTERISTIC
/begin CHARACTERISTIC DFES_FaultTyp.DFC_StmFault_C "assigned fault type / Fault type assignment for check DFC_StmFault" VALUE 0x804F9C1B Val_Wu8 255.0 DFES_OneToOne 0.00 255.0 FORMAT "%5.1" /end CHARACTERISTIC
/begin CHARACTERISTIC DFES_FaultTyp.DFC_StrtCtOffPth_C "assigned fault type / Fault type assignment for check DFC_StrtCtOffPth" VALUE 0x804F9C1C Val_Wu8 255.0 DFES_OneToOne 0.00 255.0 FORMAT "%5.1" /end CHARACTERISTIC
/begin CHARACTERISTIC DFES_FaultTyp.DFC_StrtCtlErr_C "assigned fault type / Fault type assignment for check DFC_StrtCtlErr" VALUE 0x804F9C1D Val_Wu8 255.0 DFES_OneToOne 0.00 255.0 FORMAT "%5.1" /end CHARACTERISTIC
/begin CHARACTERISTIC DFES_FaultTyp.DFC_StrtFault_C "assigned fault type / Fault type assignment for check DFC_StrtFault" VALUE 0x804F9C1E Val_Wu8 255.0 DFES_OneToOne 0.00 255.0 FORMAT "%5.1" /end CHARACTERISTIC
/begin CHARACTERISTIC DFES_FaultTyp.DFC_StrtLckJudg1_C "assigned fault type / Fault type assignment for check DFC_StrtLckJudg1" VALUE 0x804F9C1F Val_Wu8 255.0 DFES_OneToOne 0.00 255.0 FORMAT "%5.1" /end CHARACTERISTIC
/begin CHARACTERISTIC DFES_FaultTyp.DFC_StrtLckJudg2_C "assigned fault type / Fault type assignment for check DFC_StrtLckJudg2" VALUE 0x804F9C20 Val_Wu8 255.0 DFES_OneToOne 0.00 255.0 FORMAT "%5.1" /end CHARACTERISTIC
/begin CHARACTERISTIC DFES_FaultTyp.DFC_StrtOL_C "assigned fault type / Fault type assignment for check DFC_StrtOL" VALUE 0x804F9C21 Val_Wu8 255.0 DFES_OneToOne 0.00 255.0 FORMAT "%5.1" /end CHARACTERISTIC
/begin CHARACTERISTIC DFES_FaultTyp.DFC_StrtOL2_C "assigned fault type / Fault type assignment for check DFC_StrtOL2" VALUE 0x804F9C22 Val_Wu8 255.0 DFES_OneToOne 0.00 255.0 FORMAT "%5.1" /end CHARACTERISTIC
/begin CHARACTERISTIC DFES_FaultTyp.DFC_StrtSCB_C "assigned fault type / Fault type assignment for check DFC_StrtSCB" VALUE 0x804F9C23 Val_Wu8 255.0 DFES_OneToOne 0.00 255.0 FORMAT "%5.1" /end CHARACTERISTIC
/begin CHARACTERISTIC DFES_FaultTyp.DFC_StrtSCB2_C "assigned fault type / Fault type assignment for check DFC_StrtSCB2" VALUE 0x804F9C24 Val_Wu8 255.0 DFES_OneToOne 0.00 255.0 FORMAT "%5.1" /end CHARACTERISTIC
/begin CHARACTERISTIC DFES_FaultTyp.DFC_StrtSCG_C "assigned fault type / Fault type assignment for check DFC_StrtSCG" VALUE 0x804F9C25 Val_Wu8 255.0 DFES_OneToOne 0.00 255.0 FORMAT "%5.1" /end CHARACTERISTIC
/begin CHARACTERISTIC DFES_FaultTyp.DFC_StrtSCG2_C "assigned fault type / Fault type assignment for check DFC_StrtSCG2" VALUE 0x804F9C26 Val_Wu8 255.0 DFES_OneToOne 0.00 255.0 FORMAT "%5.1" /end CHARACTERISTIC
/begin CHARACTERISTIC DFES_FaultTyp.DFC_StrtStkRly1_C "assigned fault type / Fault type assignment for check DFC_StrtStkRly1" VALUE 0x804F9C27 Val_Wu8 255.0 DFES_OneToOne 0.00 255.0 FORMAT "%5.1" /end CHARACTERISTIC
/begin CHARACTERISTIC DFES_FaultTyp.DFC_StrtStkRly2_C "assigned fault type / Fault type assignment for check DFC_StrtStkRly2" VALUE 0x804F9C28 Val_Wu8 255.0 DFES_OneToOne 0.00 255.0 FORMAT "%5.1" /end CHARACTERISTIC
/begin CHARACTERISTIC DFES_FaultTyp.DFC_TEVEmax_C "assigned fault type / Fault type assignment for check DFC_TEVEmax" VALUE 0x804F9C29 Val_Wu8 255.0 DFES_OneToOne 0.00 255.0 FORMAT "%5.1" /end CHARACTERISTIC
/begin CHARACTERISTIC DFES_FaultTyp.DFC_TEVEmin_C "assigned fault type / Fault type assignment for check DFC_TEVEmin" VALUE 0x804F9C2A Val_Wu8 255.0 DFES_OneToOne 0.00 255.0 FORMAT "%5.1" /end CHARACTERISTIC
/begin CHARACTERISTIC DFES_FaultTyp.DFC_TEVEsig_C "assigned fault type / Fault type assignment for check DFC_TEVEsig" VALUE 0x804F9C2B Val_Wu8 255.0 DFES_OneToOne 0.00 255.0 FORMAT "%5.1" /end CHARACTERISTIC
/begin CHARACTERISTIC DFES_FaultTyp.DFC_VehVAllPlaus_C "assigned fault type / Fault type assignment for check DFC_VehVAllPlaus" VALUE 0x804F9C2C Val_Wu8 255.0 DFES_OneToOne 0.00 255.0 FORMAT "%5.1" /end CHARACTERISTIC
/begin CHARACTERISTIC DFES_FaultTyp.DFC_VehVNCSnsrElecFailr_C "assigned fault type / Fault type assignment for check DFC_VehVNCSnsrElecFailr" VALUE 0x804F9C2D Val_Wu8 255.0 DFES_OneToOne 0.00 255.0 FORMAT "%5.1" /end CHARACTERISTIC
/begin CHARACTERISTIC DFES_FaultTyp.DFC_VehVPlausCan_C "assigned fault type / Fault type assignment for check DFC_VehVPlausCan" VALUE 0x804F9C2E Val_Wu8 255.0 DFES_OneToOne 0.00 255.0 FORMAT "%5.1" /end CHARACTERISTIC
/begin CHARACTERISTIC DFES_FaultTyp.DFC_VehVPlausFco_C "assigned fault type / Fault type assignment for check DFC_VehVPlausFco" VALUE 0x804F9C2F Val_Wu8 255.0 DFES_OneToOne 0.00 255.0 FORMAT "%5.1" /end CHARACTERISTIC
/begin CHARACTERISTIC DFES_FaultTyp.DFC_VehVPlausPwr_C "assigned fault type / Fault type assignment for check DFC_VehVPlausPwr" VALUE 0x804F9C30 Val_Wu8 255.0 DFES_OneToOne 0.00 255.0 FORMAT "%5.1" /end CHARACTERISTIC
/begin CHARACTERISTIC DFES_FaultTyp.DFC_VehVPlausV2N_C "assigned fault type / Fault type assignment for check DFC_VehVPlausV2N" VALUE 0x804F9C31 Val_Wu8 255.0 DFES_OneToOne 0.00 255.0 FORMAT "%5.1" /end CHARACTERISTIC
/begin CHARACTERISTIC DFES_FaultTyp.DFC_VehVSpdSnsrAElecFailr_C "assigned fault type / Fault type assignment for check DFC_VehVSpdSnsrAElecFailr" VALUE 0x804F9C32 Val_Wu8 255.0 DFES_OneToOne 0.00 255.0 FORMAT "%5.1" /end CHARACTERISTIC
/begin CHARACTERISTIC DFES_FaultTyp.DFC_VehVSpdSnsrBElecFailr_C "assigned fault type / Fault type assignment for check DFC_VehVSpdSnsrBElecFailr" VALUE 0x804F9C33 Val_Wu8 255.0 DFES_OneToOne 0.00 255.0 FORMAT "%5.1" /end CHARACTERISTIC
/begin CHARACTERISTIC DFES_FaultTyp.DFC_ClthMax_C "assigned fault type / Fault type assignment for check DFC_ClthMax" VALUE 0x804F9C34 Val_Wu8 255.0 DFES_OneToOne 0.00 255.0 FORMAT "%5.1" /end CHARACTERISTIC
/begin CHARACTERISTIC DFES_FaultTyp.DFC_IgnClPs_DevComErr_C "assigned fault type / Fault type assignment for check DFC_IgnClPs_DevComErr" VALUE 0x804F9C35 Val_Wu8 255.0 DFES_OneToOne 0.00 255.0 FORMAT "%5.1" /end CHARACTERISTIC
/begin CHARACTERISTIC DFES_FaultTyp.DFC_IgnClPs_LineOl_0_C "assigned fault type / Fault type assignment for check DFC_IgnClPs_LineOl_0" VALUE 0x804F9C36 Val_Wu8 255.0 DFES_OneToOne 0.00 255.0 FORMAT "%5.1" /end CHARACTERISTIC
/begin CHARACTERISTIC DFES_FaultTyp.DFC_IgnClPs_LineOl_1_C "assigned fault type / Fault type assignment for check DFC_IgnClPs_LineOl_1" VALUE 0x804F9C37 Val_Wu8 255.0 DFES_OneToOne 0.00 255.0 FORMAT "%5.1" /end CHARACTERISTIC
/begin CHARACTERISTIC DFES_FaultTyp.DFC_IgnClPs_LineOl_2_C "assigned fault type / Fault type assignment for check DFC_IgnClPs_LineOl_2" VALUE 0x804F9C38 Val_Wu8 255.0 DFES_OneToOne 0.00 255.0 FORMAT "%5.1" /end CHARACTERISTIC
/begin CHARACTERISTIC DFES_FaultTyp.DFC_IgnClPs_LineOl_3_C "assigned fault type / Fault type assignment for check DFC_IgnClPs_LineOl_3" VALUE 0x804F9C39 Val_Wu8 255.0 DFES_OneToOne 0.00 255.0 FORMAT "%5.1" /end CHARACTERISTIC
/begin CHARACTERISTIC DFES_FaultTyp.DFC_IgnClPs_LineScb_0_C "assigned fault type / Fault type assignment for check DFC_IgnClPs_LineScb_0" VALUE 0x804F9C3A Val_Wu8 255.0 DFES_OneToOne 0.00 255.0 FORMAT "%5.1" /end CHARACTERISTIC
/begin CHARACTERISTIC DFES_FaultTyp.DFC_IgnClPs_LineScb_1_C "assigned fault type / Fault type assignment for check DFC_IgnClPs_LineScb_1" VALUE 0x804F9C3B Val_Wu8 255.0 DFES_OneToOne 0.00 255.0 FORMAT "%5.1" /end CHARACTERISTIC
/begin CHARACTERISTIC DFES_FaultTyp.DFC_IgnClPs_LineScb_2_C "assigned fault type / Fault type assignment for check DFC_IgnClPs_LineScb_2" VALUE 0x804F9C3C Val_Wu8 255.0 DFES_OneToOne 0.00 255.0 FORMAT "%5.1" /end CHARACTERISTIC
/begin CHARACTERISTIC DFES_FaultTyp.DFC_IgnClPs_LineScb_3_C "assigned fault type / Fault type assignment for check DFC_IgnClPs_LineScb_3" VALUE 0x804F9C3D Val_Wu8 255.0 DFES_OneToOne 0.00 255.0 FORMAT "%5.1" /end CHARACTERISTIC
/begin CHARACTERISTIC DFES_FaultTyp.DFC_IgnClPs_LineScg_0_C "assigned fault type / Fault type assignment for check DFC_IgnClPs_LineScg_0" VALUE 0x804F9C3E Val_Wu8 255.0 DFES_OneToOne 0.00 255.0 FORMAT "%5.1" /end CHARACTERISTIC
/begin CHARACTERISTIC DFES_FaultTyp.DFC_IgnClPs_LineScg_1_C "assigned fault type / Fault type assignment for check DFC_IgnClPs_LineScg_1" VALUE 0x804F9C3F Val_Wu8 255.0 DFES_OneToOne 0.00 255.0 FORMAT "%5.1" /end CHARACTERISTIC
/begin CHARACTERISTIC DFES_FaultTyp.DFC_IgnClPs_LineScg_2_C "assigned fault type / Fault type assignment for check DFC_IgnClPs_LineScg_2" VALUE 0x804F9C40 Val_Wu8 255.0 DFES_OneToOne 0.00 255.0 FORMAT "%5.1" /end CHARACTERISTIC
/begin CHARACTERISTIC DFES_FaultTyp.DFC_IgnClPs_LineScg_3_C "assigned fault type / Fault type assignment for check DFC_IgnClPs_LineScg_3" VALUE 0x804F9C41 Val_Wu8 255.0 DFES_OneToOne 0.00 255.0 FORMAT "%5.1" /end CHARACTERISTIC
/begin CHARACTERISTIC DFES_FaultTyp.DFC_UEGOASICS1B1_C "assigned fault type / Fault type assignment for check DFC_UEGOASICS1B1" VALUE 0x804F9C42 Val_Wu8 255.0 DFES_OneToOne 0.00 255.0 FORMAT "%5.1" /end CHARACTERISTIC
/begin CHARACTERISTIC DFES_FaultTyp.DFC_UEGOOLIPES1B1_C "assigned fault type / Fault type assignment for check DFC_UEGOOLIPES1B1" VALUE 0x804F9C43 Val_Wu8 255.0 DFES_OneToOne 0.00 255.0 FORMAT "%5.1" /end CHARACTERISTIC
/begin CHARACTERISTIC DFES_FaultTyp.DFC_UEGOOLRES1B1_C "assigned fault type / Fault type assignment for check DFC_UEGOOLRES1B1" VALUE 0x804F9C44 Val_Wu8 255.0 DFES_OneToOne 0.00 255.0 FORMAT "%5.1" /end CHARACTERISTIC
/begin CHARACTERISTIC DFES_FaultTyp.DFC_UEGOSCBS1B1_C "assigned fault type / Fault type assignment for check DFC_UEGOSCBS1B1" VALUE 0x804F9C45 Val_Wu8 255.0 DFES_OneToOne 0.00 255.0 FORMAT "%5.1" /end CHARACTERISTIC
/begin CHARACTERISTIC DFES_FaultTyp.DFC_UEGOSCGS1B1_C "assigned fault type / Fault type assignment for check DFC_UEGOSCGS1B1" VALUE 0x804F9C46 Val_Wu8 255.0 DFES_OneToOne 0.00 255.0 FORMAT "%5.1" /end CHARACTERISTIC
/begin CHARACTERISTIC DFES_FaultTyp.DFC_UEGOSPIS1B1_C "assigned fault type / Fault type assignment for check DFC_UEGOSPIS1B1" VALUE 0x804F9C47 Val_Wu8 255.0 DFES_OneToOne 0.00 255.0 FORMAT "%5.1" /end CHARACTERISTIC
/begin CHARACTERISTIC DFES_FaultTyp.DFC_UEGOSnsrS1B1_C "assigned fault type / Fault type assignment for check DFC_UEGOSnsrS1B1" VALUE 0x804F9C48 Val_Wu8 255.0 DFES_OneToOne 0.00 255.0 FORMAT "%5.1" /end CHARACTERISTIC
/begin CHARACTERISTIC DFES_FaultTyp.DFC_UegoOlApesS1B1_C "assigned fault type / Fault type assignment for check DFC_UegoOlApesS1B1" VALUE 0x804F9C49 Val_Wu8 255.0 DFES_OneToOne 0.00 255.0 FORMAT "%5.1" /end CHARACTERISTIC
/begin CHARACTERISTIC DFES_FaultTyp.DFC_UegoOlRCmpS1B1_C "assigned fault type / Fault type assignment for check DFC_UegoOlRCmpS1B1" VALUE 0x804F9C4A Val_Wu8 255.0 DFES_OneToOne 0.00 255.0 FORMAT "%5.1" /end CHARACTERISTIC
/begin CHARACTERISTIC DFES_FaultTyp.DFC_AirCCmprOL_C "assigned fault type / Fault type assignment for check DFC_AirCCmprOL" VALUE 0x804F9C4B Val_Wu8 255.0 DFES_OneToOne 0.00 255.0 FORMAT "%5.1" /end CHARACTERISTIC
/begin CHARACTERISTIC DFES_FaultTyp.DFC_AirCCmprOvrTemp_C "assigned fault type / Fault type assignment for check DFC_AirCCmprOvrTemp" VALUE 0x804F9C4C Val_Wu8 255.0 DFES_OneToOne 0.00 255.0 FORMAT "%5.1" /end CHARACTERISTIC
/begin CHARACTERISTIC DFES_FaultTyp.DFC_AirCCmprSCB_C "assigned fault type / Fault type assignment for check DFC_AirCCmprSCB" VALUE 0x804F9C4D Val_Wu8 255.0 DFES_OneToOne 0.00 255.0 FORMAT "%5.1" /end CHARACTERISTIC
/begin CHARACTERISTIC DFES_FaultTyp.DFC_AirCCmprSCG_C "assigned fault type / Fault type assignment for check DFC_AirCCmprSCG" VALUE 0x804F9C4E Val_Wu8 255.0 DFES_OneToOne 0.00 255.0 FORMAT "%5.1" /end CHARACTERISTIC
/begin CHARACTERISTIC DFES_FaultTyp.DFC_AltErr_C "assigned fault type / Fault type assignment for check DFC_AltErr" VALUE 0x804F9C4F Val_Wu8 255.0 DFES_OneToOne 0.00 255.0 FORMAT "%5.1" /end CHARACTERISTIC
/begin CHARACTERISTIC DFES_FaultTyp.DFC_BattUSRCMax_C "assigned fault type / Fault type assignment for check DFC_BattUSRCMax" VALUE 0x804F9C50 Val_Wu8 255.0 DFES_OneToOne 0.00 255.0 FORMAT "%5.1" /end CHARACTERISTIC
/begin CHARACTERISTIC DFES_FaultTyp.DFC_BattUSRCMin_C "assigned fault type / Fault type assignment for check DFC_BattUSRCMin" VALUE 0x804F9C51 Val_Wu8 255.0 DFES_OneToOne 0.00 255.0 FORMAT "%5.1" /end CHARACTERISTIC
/begin CHARACTERISTIC DFES_FaultTyp.DFC_ComChksTCU1_C "assigned fault type / Fault type assignment for check DFC_ComChksTCU1" VALUE 0x804F9C52 Val_Wu8 255.0 DFES_OneToOne 0.00 255.0 FORMAT "%5.1" /end CHARACTERISTIC
/begin CHARACTERISTIC DFES_FaultTyp.DFC_ComChksTCU11_C "assigned fault type / Fault type assignment for check DFC_ComChksTCU11" VALUE 0x804F9C53 Val_Wu8 255.0 DFES_OneToOne 0.00 255.0 FORMAT "%5.1" /end CHARACTERISTIC
/begin CHARACTERISTIC DFES_FaultTyp.DFC_ComChksTCU12_C "assigned fault type / Fault type assignment for check DFC_ComChksTCU12" VALUE 0x804F9C54 Val_Wu8 255.0 DFES_OneToOne 0.00 255.0 FORMAT "%5.1" /end CHARACTERISTIC
/begin CHARACTERISTIC DFES_FaultTyp.DFC_ComChksTCU13_C "assigned fault type / Fault type assignment for check DFC_ComChksTCU13" VALUE 0x804F9C55 Val_Wu8 255.0 DFES_OneToOne 0.00 255.0 FORMAT "%5.1" /end CHARACTERISTIC
/begin CHARACTERISTIC DFES_FaultTyp.DFC_ComChksTCU2_C "assigned fault type / Fault type assignment for check DFC_ComChksTCU2" VALUE 0x804F9C56 Val_Wu8 255.0 DFES_OneToOne 0.00 255.0 FORMAT "%5.1" /end CHARACTERISTIC
/begin CHARACTERISTIC DFES_FaultTyp.DFC_ComChksTCU3_C "assigned fault type / Fault type assignment for check DFC_ComChksTCU3" VALUE 0x804F9C57 Val_Wu8 255.0 DFES_OneToOne 0.00 255.0 FORMAT "%5.1" /end CHARACTERISTIC
/begin CHARACTERISTIC DFES_FaultTyp.DFC_ComChksTCU4_C "assigned fault type / Fault type assignment for check DFC_ComChksTCU4" VALUE 0x804F9C58 Val_Wu8 255.0 DFES_OneToOne 0.00 255.0 FORMAT "%5.1" /end CHARACTERISTIC
/begin CHARACTERISTIC DFES_FaultTyp.DFC_ComCntTCU1_C "assigned fault type / Fault type assignment for check DFC_ComCntTCU1" VALUE 0x804F9C59 Val_Wu8 255.0 DFES_OneToOne 0.00 255.0 FORMAT "%5.1" /end CHARACTERISTIC
/begin CHARACTERISTIC DFES_FaultTyp.DFC_ComCntTCU11_C "assigned fault type / Fault type assignment for check DFC_ComCntTCU11" VALUE 0x804F9C5A Val_Wu8 255.0 DFES_OneToOne 0.00 255.0 FORMAT "%5.1" /end CHARACTERISTIC
/begin CHARACTERISTIC DFES_FaultTyp.DFC_ComCntTCU12_C "assigned fault type / Fault type assignment for check DFC_ComCntTCU12" VALUE 0x804F9C5B Val_Wu8 255.0 DFES_OneToOne 0.00 255.0 FORMAT "%5.1" /end CHARACTERISTIC
/begin CHARACTERISTIC DFES_FaultTyp.DFC_ComCntTCU13_C "assigned fault type / Fault type assignment for check DFC_ComCntTCU13" VALUE 0x804F9C5C Val_Wu8 255.0 DFES_OneToOne 0.00 255.0 FORMAT "%5.1" /end CHARACTERISTIC
/begin CHARACTERISTIC DFES_FaultTyp.DFC_ComCntTCU2_C "assigned fault type / Fault type assignment for check DFC_ComCntTCU2" VALUE 0x804F9C5D Val_Wu8 255.0 DFES_OneToOne 0.00 255.0 FORMAT "%5.1" /end CHARACTERISTIC
/begin CHARACTERISTIC DFES_FaultTyp.DFC_ComCntTCU3_C "assigned fault type / Fault type assignment for check DFC_ComCntTCU3" VALUE 0x804F9C5E Val_Wu8 255.0 DFES_OneToOne 0.00 255.0 FORMAT "%5.1" /end CHARACTERISTIC
/begin CHARACTERISTIC DFES_FaultTyp.DFC_ComCntTCU4_C "assigned fault type / Fault type assignment for check DFC_ComCntTCU4" VALUE 0x804F9C5F Val_Wu8 255.0 DFES_OneToOne 0.00 255.0 FORMAT "%5.1" /end CHARACTERISTIC
/begin CHARACTERISTIC DFES_FaultTyp.DFC_ComTOutTCU01_C "assigned fault type / Fault type assignment for check DFC_ComTOutTCU01" VALUE 0x804F9C60 Val_Wu8 255.0 DFES_OneToOne 0.00 255.0 FORMAT "%5.1" /end CHARACTERISTIC
/begin CHARACTERISTIC DFES_FaultTyp.DFC_ComTOutTCU02_C "assigned fault type / Fault type assignment for check DFC_ComTOutTCU02" VALUE 0x804F9C61 Val_Wu8 255.0 DFES_OneToOne 0.00 255.0 FORMAT "%5.1" /end CHARACTERISTIC
/begin CHARACTERISTIC DFES_FaultTyp.DFC_ComTOutTCU1_C "assigned fault type / Fault type assignment for check DFC_ComTOutTCU1" VALUE 0x804F9C62 Val_Wu8 255.0 DFES_OneToOne 0.00 255.0 FORMAT "%5.1" /end CHARACTERISTIC
/begin CHARACTERISTIC DFES_FaultTyp.DFC_ComTOutTCU11_C "assigned fault type / Fault type assignment for check DFC_ComTOutTCU11" VALUE 0x804F9C63 Val_Wu8 255.0 DFES_OneToOne 0.00 255.0 FORMAT "%5.1" /end CHARACTERISTIC
/begin CHARACTERISTIC DFES_FaultTyp.DFC_ComTOutTCU12_C "assigned fault type / Fault type assignment for check DFC_ComTOutTCU12" VALUE 0x804F9C64 Val_Wu8 255.0 DFES_OneToOne 0.00 255.0 FORMAT "%5.1" /end CHARACTERISTIC
/begin CHARACTERISTIC DFES_FaultTyp.DFC_ComTOutTCU13_C "assigned fault type / Fault type assignment for check DFC_ComTOutTCU13" VALUE 0x804F9C65 Val_Wu8 255.0 DFES_OneToOne 0.00 255.0 FORMAT "%5.1" /end CHARACTERISTIC
/begin CHARACTERISTIC DFES_FaultTyp.DFC_ComTOutTCU14_C "assigned fault type / Fault type assignment for check DFC_ComTOutTCU14" VALUE 0x804F9C66 Val_Wu8 255.0 DFES_OneToOne 0.00 255.0 FORMAT "%5.1" /end CHARACTERISTIC
/begin CHARACTERISTIC DFES_FaultTyp.DFC_ComTOutTCU2_C "assigned fault type / Fault type assignment for check DFC_ComTOutTCU2" VALUE 0x804F9C67 Val_Wu8 255.0 DFES_OneToOne 0.00 255.0 FORMAT "%5.1" /end CHARACTERISTIC
/begin CHARACTERISTIC DFES_FaultTyp.DFC_ComTOutTCU3_C "assigned fault type / Fault type assignment for check DFC_ComTOutTCU3" VALUE 0x804F9C68 Val_Wu8 255.0 DFES_OneToOne 0.00 255.0 FORMAT "%5.1" /end CHARACTERISTIC
/begin CHARACTERISTIC DFES_FaultTyp.DFC_ComTOutTCU4_C "assigned fault type / Fault type assignment for check DFC_ComTOutTCU4" VALUE 0x804F9C69 Val_Wu8 255.0 DFES_OneToOne 0.00 255.0 FORMAT "%5.1" /end CHARACTERISTIC
/begin CHARACTERISTIC DFES_FaultTyp.DFC_DevLibBattUHi_C "assigned fault type / Fault type assignment for check DFC_DevLibBattUHi" VALUE 0x804F9C6A Val_Wu8 255.0 DFES_OneToOne 0.00 255.0 FORMAT "%5.1" /end CHARACTERISTIC
/begin CHARACTERISTIC DFES_FaultTyp.DFC_DevLibBattULo_C "assigned fault type / Fault type assignment for check DFC_DevLibBattULo" VALUE 0x804F9C6B Val_Wu8 255.0 DFES_OneToOne 0.00 255.0 FORMAT "%5.1" /end CHARACTERISTIC
/begin CHARACTERISTIC DFES_FaultTyp.DFC_FanDIOOL_0_C "assigned fault type / Fault type assignment for check DFC_FanDIOOL_0" VALUE 0x804F9C6C Val_Wu8 255.0 DFES_OneToOne 0.00 255.0 FORMAT "%5.1" /end CHARACTERISTIC
/begin CHARACTERISTIC DFES_FaultTyp.DFC_FanDIOOL_1_C "assigned fault type / Fault type assignment for check DFC_FanDIOOL_1" VALUE 0x804F9C6D Val_Wu8 255.0 DFES_OneToOne 0.00 255.0 FORMAT "%5.1" /end CHARACTERISTIC
/begin CHARACTERISTIC DFES_FaultTyp.DFC_FanDIOOvrTemp_0_C "assigned fault type / Fault type assignment for check DFC_FanDIOOvrTemp_0" VALUE 0x804F9C6E Val_Wu8 255.0 DFES_OneToOne 0.00 255.0 FORMAT "%5.1" /end CHARACTERISTIC
/begin CHARACTERISTIC DFES_FaultTyp.DFC_FanDIOOvrTemp_1_C "assigned fault type / Fault type assignment for check DFC_FanDIOOvrTemp_1" VALUE 0x804F9C6F Val_Wu8 255.0 DFES_OneToOne 0.00 255.0 FORMAT "%5.1" /end CHARACTERISTIC
/begin CHARACTERISTIC DFES_FaultTyp.DFC_FanDIOSCB_0_C "assigned fault type / Fault type assignment for check DFC_FanDIOSCB_0" VALUE 0x804F9C70 Val_Wu8 255.0 DFES_OneToOne 0.00 255.0 FORMAT "%5.1" /end CHARACTERISTIC
/begin CHARACTERISTIC DFES_FaultTyp.DFC_FanDIOSCB_1_C "assigned fault type / Fault type assignment for check DFC_FanDIOSCB_1" VALUE 0x804F9C71 Val_Wu8 255.0 DFES_OneToOne 0.00 255.0 FORMAT "%5.1" /end CHARACTERISTIC
/begin CHARACTERISTIC DFES_FaultTyp.DFC_FanDIOSCG_0_C "assigned fault type / Fault type assignment for check DFC_FanDIOSCG_0" VALUE 0x804F9C72 Val_Wu8 255.0 DFES_OneToOne 0.00 255.0 FORMAT "%5.1" /end CHARACTERISTIC
/begin CHARACTERISTIC DFES_FaultTyp.DFC_FanDIOSCG_1_C "assigned fault type / Fault type assignment for check DFC_FanDIOSCG_1" VALUE 0x804F9C73 Val_Wu8 255.0 DFES_OneToOne 0.00 255.0 FORMAT "%5.1" /end CHARACTERISTIC
/begin CHARACTERISTIC DFES_FaultTyp.DFC_MRlyDcOL_C "assigned fault type / Fault type assignment for check DFC_MRlyDcOL" VALUE 0x804F9C74 Val_Wu8 255.0 DFES_OneToOne 0.00 255.0 FORMAT "%5.1" /end CHARACTERISTIC
/begin CHARACTERISTIC DFES_FaultTyp.DFC_MRlyDcSCB_C "assigned fault type / Fault type assignment for check DFC_MRlyDcSCB" VALUE 0x804F9C75 Val_Wu8 255.0 DFES_OneToOne 0.00 255.0 FORMAT "%5.1" /end CHARACTERISTIC
/begin CHARACTERISTIC DFES_FaultTyp.DFC_MRlyDcSCG_C "assigned fault type / Fault type assignment for check DFC_MRlyDcSCG" VALUE 0x804F9C76 Val_Wu8 255.0 DFES_OneToOne 0.00 255.0 FORMAT "%5.1" /end CHARACTERISTIC
/begin CHARACTERISTIC DFES_FaultTyp.DFC_PSPOL_C "assigned fault type / Fault type assignment for check DFC_PSPOL" VALUE 0x804F9C77 Val_Wu8 255.0 DFES_OneToOne 0.00 255.0 FORMAT "%5.1" /end CHARACTERISTIC
/begin CHARACTERISTIC DFES_FaultTyp.DFC_PSPOvrTemp_C "assigned fault type / Fault type assignment for check DFC_PSPOvrTemp" VALUE 0x804F9C78 Val_Wu8 255.0 DFES_OneToOne 0.00 255.0 FORMAT "%5.1" /end CHARACTERISTIC
/begin CHARACTERISTIC DFES_FaultTyp.DFC_PSPSCB_C "assigned fault type / Fault type assignment for check DFC_PSPSCB" VALUE 0x804F9C79 Val_Wu8 255.0 DFES_OneToOne 0.00 255.0 FORMAT "%5.1" /end CHARACTERISTIC
/begin CHARACTERISTIC DFES_FaultTyp.DFC_PSPSCG_C "assigned fault type / Fault type assignment for check DFC_PSPSCG" VALUE 0x804F9C7A Val_Wu8 255.0 DFES_OneToOne 0.00 255.0 FORMAT "%5.1" /end CHARACTERISTIC
/begin CHARACTERISTIC DFES_FaultTyp.DFC_T50Err_C "assigned fault type / Fault type assignment for check DFC_T50Err" VALUE 0x804F9C7B Val_Wu8 255.0 DFES_OneToOne 0.00 255.0 FORMAT "%5.1" /end CHARACTERISTIC
/begin CHARACTERISTIC DFES_FaultTyp.DFC_ThrVlvLoBattB1_C "assigned fault type / Fault type assignment for check DFC_ThrVlvLoBattB1" VALUE 0x804F9C7C Val_Wu8 255.0 DFES_OneToOne 0.00 255.0 FORMAT "%5.1" /end CHARACTERISTIC
/begin CHARACTERISTIC DFES_FaultTyp.DFC_VehVPhysRngHi_C "assigned fault type / Fault type assignment for check DFC_VehVPhysRngHi" VALUE 0x804F9C7D Val_Wu8 255.0 DFES_OneToOne 0.00 255.0 FORMAT "%5.1" /end CHARACTERISTIC
/begin CHARACTERISTIC DFES_FaultTyp.DFC_VehVSclOutOL_C "assigned fault type / Fault type assignment for check DFC_VehVSclOutOL" VALUE 0x804F9C7E Val_Wu8 255.0 DFES_OneToOne 0.00 255.0 FORMAT "%5.1" /end CHARACTERISTIC
/begin CHARACTERISTIC DFES_FaultTyp.DFC_VehVSclOutOT_C "assigned fault type / Fault type assignment for check DFC_VehVSclOutOT" VALUE 0x804F9C7F Val_Wu8 255.0 DFES_OneToOne 0.00 255.0 FORMAT "%5.1" /end CHARACTERISTIC
/begin CHARACTERISTIC DFES_FaultTyp.DFC_VehVSclOutSCB_C "assigned fault type / Fault type assignment for check DFC_VehVSclOutSCB" VALUE 0x804F9C80 Val_Wu8 255.0 DFES_OneToOne 0.00 255.0 FORMAT "%5.1" /end CHARACTERISTIC
/begin CHARACTERISTIC DFES_FaultTyp.DFC_VehVSclOutSCG_C "assigned fault type / Fault type assignment for check DFC_VehVSclOutSCG" VALUE 0x804F9C81 Val_Wu8 255.0 DFES_OneToOne 0.00 255.0 FORMAT "%5.1" /end CHARACTERISTIC
/begin CHARACTERISTIC DFES_FaultTyp.DFC_VehVSnsrARngHi_C "assigned fault type / Fault type assignment for check DFC_VehVSnsrARngHi" VALUE 0x804F9C82 Val_Wu8 255.0 DFES_OneToOne 0.00 255.0 FORMAT "%5.1" /end CHARACTERISTIC
/begin CHARACTERISTIC DFES_FaultTyp.DFC_VehVSnsrBRngHi_C "assigned fault type / Fault type assignment for check DFC_VehVSnsrBRngHi" VALUE 0x804F9C83 Val_Wu8 255.0 DFES_OneToOne 0.00 255.0 FORMAT "%5.1" /end CHARACTERISTIC
/begin CHARACTERISTIC DFES_FaultTyp.DFC_VehVSpdRtyDiag_C "assigned fault type / Fault type assignment for check DFC_VehVSpdRtyDiag" VALUE 0x804F9C84 Val_Wu8 255.0 DFES_OneToOne 0.00 255.0 FORMAT "%5.1" /end CHARACTERISTIC
/begin CHARACTERISTIC DFES_FaultTyp.DFC_VehVWhlErr_C "assigned fault type / Fault type assignment for check DFC_VehVWhlErr" VALUE 0x804F9C85 Val_Wu8 255.0 DFES_OneToOne 0.00 255.0 FORMAT "%5.1" /end CHARACTERISTIC
/begin CHARACTERISTIC DFES_FaultTyp.DFC_ACEvpTSRCMax_C "assigned fault type / Fault type assignment for check DFC_ACEvpTSRCMax" VALUE 0x804F9C86 Val_Wu8 255.0 DFES_OneToOne 0.00 255.0 FORMAT "%5.1" /end CHARACTERISTIC
/begin CHARACTERISTIC DFES_FaultTyp.DFC_ACEvpTSRCMin_C "assigned fault type / Fault type assignment for check DFC_ACEvpTSRCMin" VALUE 0x804F9C87 Val_Wu8 255.0 DFES_OneToOne 0.00 255.0 FORMAT "%5.1" /end CHARACTERISTIC
/begin CHARACTERISTIC DFES_FaultTyp.DFC_AirCClntPAnaSRCMax_C "assigned fault type / Fault type assignment for check DFC_AirCClntPAnaSRCMax" VALUE 0x804F9C88 Val_Wu8 255.0 DFES_OneToOne 0.00 255.0 FORMAT "%5.1" /end CHARACTERISTIC
/begin CHARACTERISTIC DFES_FaultTyp.DFC_AirCClntPAnaSRCMin_C "assigned fault type / Fault type assignment for check DFC_AirCClntPAnaSRCMin" VALUE 0x804F9C89 Val_Wu8 255.0 DFES_OneToOne 0.00 255.0 FORMAT "%5.1" /end CHARACTERISTIC
/begin CHARACTERISTIC DFES_FaultTyp.DFC_AirCSwtNpl_C "assigned fault type / Fault type assignment for check DFC_AirCSwtNpl" VALUE 0x804F9C8A Val_Wu8 255.0 DFES_OneToOne 0.00 255.0 FORMAT "%5.1" /end CHARACTERISTIC
/begin CHARACTERISTIC DFES_FaultTyp.DFC_AirCSwtSig_C "assigned fault type / Fault type assignment for check DFC_AirCSwtSig" VALUE 0x804F9C8B Val_Wu8 255.0 DFES_OneToOne 0.00 255.0 FORMAT "%5.1" /end CHARACTERISTIC
/begin CHARACTERISTIC DFES_FaultTyp.DFC_Brk_C "assigned fault type / Fault type assignment for check DFC_Brk" VALUE 0x804F9C8C Val_Wu8 255.0 DFES_OneToOne 0.00 255.0 FORMAT "%5.1" /end CHARACTERISTIC
/begin CHARACTERISTIC DFES_FaultTyp.DFC_BrkSig_C "assigned fault type / Fault type assignment for check DFC_BrkSig" VALUE 0x804F9C8D Val_Wu8 255.0 DFES_OneToOne 0.00 255.0 FORMAT "%5.1" /end CHARACTERISTIC
/begin CHARACTERISTIC DFES_FaultTyp.DFC_ClthSig_C "assigned fault type / Fault type assignment for check DFC_ClthSig" VALUE 0x804F9C8E Val_Wu8 255.0 DFES_OneToOne 0.00 255.0 FORMAT "%5.1" /end CHARACTERISTIC
/begin CHARACTERISTIC DFES_FaultTyp.DFC_HLSDemOvhtEngLim_C "assigned fault type / Fault type assignment for check DFC_HLSDemOvhtEngLim" VALUE 0x804F9C8F Val_Wu8 255.0 DFES_OneToOne 0.00 255.0 FORMAT "%5.1" /end CHARACTERISTIC
/begin CHARACTERISTIC DFES_FaultTyp.DFC_OilPNpl_C "assigned fault type / Fault type assignment for check DFC_OilPNpl" VALUE 0x804F9C90 Val_Wu8 255.0 DFES_OneToOne 0.00 255.0 FORMAT "%5.1" /end CHARACTERISTIC
/begin CHARACTERISTIC DFES_FaultTyp.DFC_PIntkVUsLineHiB1_C "assigned fault type / Fault type assignment for check DFC_PIntkVUsLineHiB1" VALUE 0x804F9C91 Val_Wu8 255.0 DFES_OneToOne 0.00 255.0 FORMAT "%5.1" /end CHARACTERISTIC
/begin CHARACTERISTIC DFES_FaultTyp.DFC_PIntkVUsLineLoB1_C "assigned fault type / Fault type assignment for check DFC_PIntkVUsLineLoB1" VALUE 0x804F9C92 Val_Wu8 255.0 DFES_OneToOne 0.00 255.0 FORMAT "%5.1" /end CHARACTERISTIC
/begin CHARACTERISTIC DFES_FaultTyp.DFC_VehVPhysRngLo_C "assigned fault type / Fault type assignment for check DFC_VehVPhysRngLo" VALUE 0x804F9C93 Val_Wu8 255.0 DFES_OneToOne 0.00 255.0 FORMAT "%5.1" /end CHARACTERISTIC
/begin CHARACTERISTIC DFES_FaultTyp.DFC_VehVSigCan_C "assigned fault type / Fault type assignment for check DFC_VehVSigCan" VALUE 0x804F9C94 Val_Wu8 255.0 DFES_OneToOne 0.00 255.0 FORMAT "%5.1" /end CHARACTERISTIC
/begin CHARACTERISTIC DFES_FaultTyp.DFC_VehVSigCanSafe_C "assigned fault type / Fault type assignment for check DFC_VehVSigCanSafe" VALUE 0x804F9C95 Val_Wu8 255.0 DFES_OneToOne 0.00 255.0 FORMAT "%5.1" /end CHARACTERISTIC
/begin CHARACTERISTIC DFES_FaultTyp.DFC_VlvLftFbOilPSnsrIntk11SRCMax_C "assigned fault type / Fault type assignment for check DFC_VlvLftFbOilPSnsrIntk11SRCMax" VALUE 0x804F9C96 Val_Wu8 255.0 DFES_OneToOne 0.00 255.0 FORMAT "%5.1" /end CHARACTERISTIC
/begin CHARACTERISTIC DFES_FaultTyp.DFC_VlvLftFbOilPSnsrIntk11SRCMin_C "assigned fault type / Fault type assignment for check DFC_VlvLftFbOilPSnsrIntk11SRCMin" VALUE 0x804F9C97 Val_Wu8 255.0 DFES_OneToOne 0.00 255.0 FORMAT "%5.1" /end CHARACTERISTIC
/begin CHARACTERISTIC DFES_FaultTyp.DFC_ClthNpl_C "assigned fault type / Fault type assignment for check DFC_ClthNpl" VALUE 0x804F9C98 Val_Wu8 255.0 DFES_OneToOne 0.00 255.0 FORMAT "%5.1" /end CHARACTERISTIC
/begin CHARACTERISTIC DFES_FaultTyp.DFC_EV1max_C "assigned fault type / Fault type assignment for check DFC_EV1max" VALUE 0x804F9C99 Val_Wu8 255.0 DFES_OneToOne 0.00 255.0 FORMAT "%5.1" /end CHARACTERISTIC
/begin CHARACTERISTIC DFES_FaultTyp.DFC_EV1min_C "assigned fault type / Fault type assignment for check DFC_EV1min" VALUE 0x804F9C9A Val_Wu8 255.0 DFES_OneToOne 0.00 255.0 FORMAT "%5.1" /end CHARACTERISTIC
/begin CHARACTERISTIC DFES_FaultTyp.DFC_EV1sig_C "assigned fault type / Fault type assignment for check DFC_EV1sig" VALUE 0x804F9C9B Val_Wu8 255.0 DFES_OneToOne 0.00 255.0 FORMAT "%5.1" /end CHARACTERISTIC
/begin CHARACTERISTIC DFES_FaultTyp.DFC_EV2max_C "assigned fault type / Fault type assignment for check DFC_EV2max" VALUE 0x804F9C9C Val_Wu8 255.0 DFES_OneToOne 0.00 255.0 FORMAT "%5.1" /end CHARACTERISTIC
/begin CHARACTERISTIC DFES_FaultTyp.DFC_EV2min_C "assigned fault type / Fault type assignment for check DFC_EV2min" VALUE 0x804F9C9D Val_Wu8 255.0 DFES_OneToOne 0.00 255.0 FORMAT "%5.1" /end CHARACTERISTIC
/begin CHARACTERISTIC DFES_FaultTyp.DFC_EV2sig_C "assigned fault type / Fault type assignment for check DFC_EV2sig" VALUE 0x804F9C9E Val_Wu8 255.0 DFES_OneToOne 0.00 255.0 FORMAT "%5.1" /end CHARACTERISTIC
/begin CHARACTERISTIC DFES_FaultTyp.DFC_EV3max_C "assigned fault type / Fault type assignment for check DFC_EV3max" VALUE 0x804F9C9F Val_Wu8 255.0 DFES_OneToOne 0.00 255.0 FORMAT "%5.1" /end CHARACTERISTIC
/begin CHARACTERISTIC DFES_FaultTyp.DFC_EV3min_C "assigned fault type / Fault type assignment for check DFC_EV3min" VALUE 0x804F9CA0 Val_Wu8 255.0 DFES_OneToOne 0.00 255.0 FORMAT "%5.1" /end CHARACTERISTIC
/begin CHARACTERISTIC DFES_FaultTyp.DFC_EV3sig_C "assigned fault type / Fault type assignment for check DFC_EV3sig" VALUE 0x804F9CA1 Val_Wu8 255.0 DFES_OneToOne 0.00 255.0 FORMAT "%5.1" /end CHARACTERISTIC
/begin CHARACTERISTIC DFES_FaultTyp.DFC_EV4max_C "assigned fault type / Fault type assignment for check DFC_EV4max" VALUE 0x804F9CA2 Val_Wu8 255.0 DFES_OneToOne 0.00 255.0 FORMAT "%5.1" /end CHARACTERISTIC
/begin CHARACTERISTIC DFES_FaultTyp.DFC_EV4min_C "assigned fault type / Fault type assignment for check DFC_EV4min" VALUE 0x804F9CA3 Val_Wu8 255.0 DFES_OneToOne 0.00 255.0 FORMAT "%5.1" /end CHARACTERISTIC
/begin CHARACTERISTIC DFES_FaultTyp.DFC_EV4sig_C "assigned fault type / Fault type assignment for check DFC_EV4sig" VALUE 0x804F9CA4 Val_Wu8 255.0 DFES_OneToOne 0.00 255.0 FORMAT "%5.1" /end CHARACTERISTIC
/begin CHARACTERISTIC DFES_FaultTyp.DFC_GbxPNPosnDrvCdn_C "assigned fault type / Fault type assignment for check DFC_GbxPNPosnDrvCdn" VALUE 0x804F9CA5 Val_Wu8 255.0 DFES_OneToOne 0.00 255.0 FORMAT "%5.1" /end CHARACTERISTIC
/begin CHARACTERISTIC DFES_FaultTyp.DFC_GbxPNPosnPlausy_C "assigned fault type / Fault type assignment for check DFC_GbxPNPosnPlausy" VALUE 0x804F9CA6 Val_Wu8 255.0 DFES_OneToOne 0.00 255.0 FORMAT "%5.1" /end CHARACTERISTIC
/begin CHARACTERISTIC DFES_FaultTyp.DFC_PEnvCcMax_C "assigned fault type / Fault type assignment for check DFC_PEnvCcMax" VALUE 0x804F9CA7 Val_Wu8 255.0 DFES_OneToOne 0.00 255.0 FORMAT "%5.1" /end CHARACTERISTIC
/begin CHARACTERISTIC DFES_FaultTyp.DFC_PEnvCcMin_C "assigned fault type / Fault type assignment for check DFC_PEnvCcMin" VALUE 0x804F9CA8 Val_Wu8 255.0 DFES_OneToOne 0.00 255.0 FORMAT "%5.1" /end CHARACTERISTIC
/begin CHARACTERISTIC DFES_FaultTyp.DFC_PEnvRngChkMax_C "assigned fault type / Fault type assignment for check DFC_PEnvRngChkMax" VALUE 0x804F9CA9 Val_Wu8 255.0 DFES_OneToOne 0.00 255.0 FORMAT "%5.1" /end CHARACTERISTIC
/begin CHARACTERISTIC DFES_FaultTyp.DFC_PEnvRngChkMin_C "assigned fault type / Fault type assignment for check DFC_PEnvRngChkMin" VALUE 0x804F9CAA Val_Wu8 255.0 DFES_OneToOne 0.00 255.0 FORMAT "%5.1" /end CHARACTERISTIC
/begin CHARACTERISTIC DFES_FaultTyp.DFC_PEnvSnsrPlaus_C "assigned fault type / Fault type assignment for check DFC_PEnvSnsrPlaus" VALUE 0x804F9CAB Val_Wu8 255.0 DFES_OneToOne 0.00 255.0 FORMAT "%5.1" /end CHARACTERISTIC
/begin CHARACTERISTIC DFES_FaultTyp.DFC_UEGOHeatrPsS1B1Max_C "assigned fault type / Fault type assignment for check DFC_UEGOHeatrPsS1B1Max" VALUE 0x804F9CAC Val_Wu8 255.0 DFES_OneToOne 0.00 255.0 FORMAT "%5.1" /end CHARACTERISTIC
/begin CHARACTERISTIC DFES_FaultTyp.DFC_UEGOHeatrPsS1B1Min_C "assigned fault type / Fault type assignment for check DFC_UEGOHeatrPsS1B1Min" VALUE 0x804F9CAD Val_Wu8 255.0 DFES_OneToOne 0.00 255.0 FORMAT "%5.1" /end CHARACTERISTIC
/begin CHARACTERISTIC DFES_FaultTyp.DFC_UEGOHeatrPsS1B1Sig_C "assigned fault type / Fault type assignment for check DFC_UEGOHeatrPsS1B1Sig" VALUE 0x804F9CAE Val_Wu8 255.0 DFES_OneToOne 0.00 255.0 FORMAT "%5.1" /end CHARACTERISTIC
/begin CHARACTERISTIC DFES_FaultTyp.DFC_UEGOHeatrRlyPsOLS1B1_C "assigned fault type / Fault type assignment for check DFC_UEGOHeatrRlyPsOLS1B1" VALUE 0x804F9CAF Val_Wu8 255.0 DFES_OneToOne 0.00 255.0 FORMAT "%5.1" /end CHARACTERISTIC
/begin CHARACTERISTIC DFES_FaultTyp.DFC_UEGOHeatrRlyPsSCBS1B1_C "assigned fault type / Fault type assignment for check DFC_UEGOHeatrRlyPsSCBS1B1" VALUE 0x804F9CB0 Val_Wu8 255.0 DFES_OneToOne 0.00 255.0 FORMAT "%5.1" /end CHARACTERISTIC
/begin CHARACTERISTIC DFES_FaultTyp.DFC_UEGOHeatrRlyPsSCGS1B1_C "assigned fault type / Fault type assignment for check DFC_UEGOHeatrRlyPsSCGS1B1" VALUE 0x804F9CB1 Val_Wu8 255.0 DFES_OneToOne 0.00 255.0 FORMAT "%5.1" /end CHARACTERISTIC
/begin CHARACTERISTIC DFES_FaultTyp.DFC_KnDetSens1PortAMax_C "assigned fault type / Fault type assignment for check DFC_KnDetSens1PortAMax" VALUE 0x804F9CB2 Val_Wu8 255.0 DFES_OneToOne 0.00 255.0 FORMAT "%5.1" /end CHARACTERISTIC
/begin CHARACTERISTIC DFES_FaultTyp.DFC_KnDetSens1PortAMin_C "assigned fault type / Fault type assignment for check DFC_KnDetSens1PortAMin" VALUE 0x804F9CB3 Val_Wu8 255.0 DFES_OneToOne 0.00 255.0 FORMAT "%5.1" /end CHARACTERISTIC
/begin CHARACTERISTIC DFES_FaultTyp.DFC_KnDetSens1PortBMax_C "assigned fault type / Fault type assignment for check DFC_KnDetSens1PortBMax" VALUE 0x804F9CB4 Val_Wu8 255.0 DFES_OneToOne 0.00 255.0 FORMAT "%5.1" /end CHARACTERISTIC
/begin CHARACTERISTIC DFES_FaultTyp.DFC_KnDetSens1PortBMin_C "assigned fault type / Fault type assignment for check DFC_KnDetSens1PortBMin" VALUE 0x804F9CB5 Val_Wu8 255.0 DFES_OneToOne 0.00 255.0 FORMAT "%5.1" /end CHARACTERISTIC
/begin CHARACTERISTIC DFES_FaultTyp.DFC_Clth2ONStuck_C "assigned fault type / Fault type assignment for check DFC_Clth2ONStuck" VALUE 0x804F9CB6 Val_Wu8 255.0 DFES_OneToOne 0.00 255.0 FORMAT "%5.1" /end CHARACTERISTIC
/begin CHARACTERISTIC DFES_FaultTyp.DFC_Clth2ONStuckLdc_C "assigned fault type / Fault type assignment for check DFC_Clth2ONStuckLdc" VALUE 0x804F9CB7 Val_Wu8 255.0 DFES_OneToOne 0.00 255.0 FORMAT "%5.1" /end CHARACTERISTIC
/begin CHARACTERISTIC DFES_FaultTyp.DFC_Clth3ONStuckLdc_C "assigned fault type / Fault type assignment for check DFC_Clth3ONStuckLdc" VALUE 0x804F9CB8 Val_Wu8 255.0 DFES_OneToOne 0.00 255.0 FORMAT "%5.1" /end CHARACTERISTIC
/begin CHARACTERISTIC DFES_FaultTyp.DFC_Clth3ONStuckPostDrv_C "assigned fault type / Fault type assignment for check DFC_Clth3ONStuckPostDrv" VALUE 0x804F9CB9 Val_Wu8 255.0 DFES_OneToOne 0.00 255.0 FORMAT "%5.1" /end CHARACTERISTIC
/begin CHARACTERISTIC DFES_FaultTyp.DFC_Clth4ONStuck_C "assigned fault type / Fault type assignment for check DFC_Clth4ONStuck" VALUE 0x804F9CBA Val_Wu8 255.0 DFES_OneToOne 0.00 255.0 FORMAT "%5.1" /end CHARACTERISTIC
/begin CHARACTERISTIC DFES_FaultTyp.DFC_Clth4ONStuckLdc_C "assigned fault type / Fault type assignment for check DFC_Clth4ONStuckLdc" VALUE 0x804F9CBB Val_Wu8 255.0 DFES_OneToOne 0.00 255.0 FORMAT "%5.1" /end CHARACTERISTIC
/begin CHARACTERISTIC DFES_FaultTyp.DFC_ComDLCTCU01_C "assigned fault type / Fault type assignment for check DFC_ComDLCTCU01" VALUE 0x804F9CBC Val_Wu8 255.0 DFES_OneToOne 0.00 255.0 FORMAT "%5.1" /end CHARACTERISTIC
/begin CHARACTERISTIC DFES_FaultTyp.DFC_ComDLCTCU02_C "assigned fault type / Fault type assignment for check DFC_ComDLCTCU02" VALUE 0x804F9CBD Val_Wu8 255.0 DFES_OneToOne 0.00 255.0 FORMAT "%5.1" /end CHARACTERISTIC
/begin CHARACTERISTIC DFES_FaultTyp.DFC_ComDLCTCU1_C "assigned fault type / Fault type assignment for check DFC_ComDLCTCU1" VALUE 0x804F9CBE Val_Wu8 255.0 DFES_OneToOne 0.00 255.0 FORMAT "%5.1" /end CHARACTERISTIC
/begin CHARACTERISTIC DFES_FaultTyp.DFC_ComDLCTCU11_C "assigned fault type / Fault type assignment for check DFC_ComDLCTCU11" VALUE 0x804F9CBF Val_Wu8 255.0 DFES_OneToOne 0.00 255.0 FORMAT "%5.1" /end CHARACTERISTIC
/begin CHARACTERISTIC DFES_FaultTyp.DFC_ComDLCTCU12_C "assigned fault type / Fault type assignment for check DFC_ComDLCTCU12" VALUE 0x804F9CC0 Val_Wu8 255.0 DFES_OneToOne 0.00 255.0 FORMAT "%5.1" /end CHARACTERISTIC
/begin CHARACTERISTIC DFES_FaultTyp.DFC_ComDLCTCU13_C "assigned fault type / Fault type assignment for check DFC_ComDLCTCU13" VALUE 0x804F9CC1 Val_Wu8 255.0 DFES_OneToOne 0.00 255.0 FORMAT "%5.1" /end CHARACTERISTIC
/begin CHARACTERISTIC DFES_FaultTyp.DFC_ComDLCTCU14_C "assigned fault type / Fault type assignment for check DFC_ComDLCTCU14" VALUE 0x804F9CC2 Val_Wu8 255.0 DFES_OneToOne 0.00 255.0 FORMAT "%5.1" /end CHARACTERISTIC
/begin CHARACTERISTIC DFES_FaultTyp.DFC_ComDLCTCU2_C "assigned fault type / Fault type assignment for check DFC_ComDLCTCU2" VALUE 0x804F9CC3 Val_Wu8 255.0 DFES_OneToOne 0.00 255.0 FORMAT "%5.1" /end CHARACTERISTIC
/begin CHARACTERISTIC DFES_FaultTyp.DFC_ComDLCTCU3_C "assigned fault type / Fault type assignment for check DFC_ComDLCTCU3" VALUE 0x804F9CC4 Val_Wu8 255.0 DFES_OneToOne 0.00 255.0 FORMAT "%5.1" /end CHARACTERISTIC
/begin CHARACTERISTIC DFES_FaultTyp.DFC_ComDLCTCU4_C "assigned fault type / Fault type assignment for check DFC_ComDLCTCU4" VALUE 0x804F9CC5 Val_Wu8 255.0 DFES_OneToOne 0.00 255.0 FORMAT "%5.1" /end CHARACTERISTIC
/begin CHARACTERISTIC DFES_FaultTyp.DFC_EVX_C "assigned fault type / Fault type assignment for check DFC_EVX" VALUE 0x804F9CC6 Val_Wu8 255.0 DFES_OneToOne 0.00 255.0 FORMAT "%5.1" /end CHARACTERISTIC
/begin CHARACTERISTIC DFES_FaultTyp.DFC_EbsSocFlt_C "assigned fault type / Fault type assignment for check DFC_EbsSocFlt" VALUE 0x804F9CC7 Val_Wu8 255.0 DFES_OneToOne 0.00 255.0 FORMAT "%5.1" /end CHARACTERISTIC
/begin CHARACTERISTIC DFES_FaultTyp.DFC_I14229VINErr_C "assigned fault type / Fault type assignment for check DFC_I14229VINErr" VALUE 0x804F9CC8 Val_Wu8 255.0 DFES_OneToOne 0.00 255.0 FORMAT "%5.1" /end CHARACTERISTIC
/begin CHARACTERISTIC DFES_FaultTyp.DFC_LLRKHmax_C "assigned fault type / Fault type assignment for check DFC_LLRKHmax" VALUE 0x804F9CC9 Val_Wu8 255.0 DFES_OneToOne 0.00 255.0 FORMAT "%5.1" /end CHARACTERISTIC
/begin CHARACTERISTIC DFES_FaultTyp.DFC_LLRKHmin_C "assigned fault type / Fault type assignment for check DFC_LLRKHmin" VALUE 0x804F9CCA Val_Wu8 255.0 DFES_OneToOne 0.00 255.0 FORMAT "%5.1" /end CHARACTERISTIC
/begin CHARACTERISTIC DFES_FaultTyp.DFC_LLRmax_C "assigned fault type / Fault type assignment for check DFC_LLRmax" VALUE 0x804F9CCB Val_Wu8 255.0 DFES_OneToOne 0.00 255.0 FORMAT "%5.1" /end CHARACTERISTIC
/begin CHARACTERISTIC DFES_FaultTyp.DFC_LLRmin_C "assigned fault type / Fault type assignment for check DFC_LLRmin" VALUE 0x804F9CCC Val_Wu8 255.0 DFES_OneToOne 0.00 255.0 FORMAT "%5.1" /end CHARACTERISTIC
/begin CHARACTERISTIC DFES_FaultTyp.DFC_RoughRoad_C "assigned fault type / Fault type assignment for check DFC_RoughRoad" VALUE 0x804F9CCD Val_Wu8 255.0 DFES_OneToOne 0.00 255.0 FORMAT "%5.1" /end CHARACTERISTIC
/begin CHARACTERISTIC DFES_FaultTyp.DFC_SiaEEPRdErr_C "assigned fault type / Fault type assignment for check DFC_SiaEEPRdErr" VALUE 0x804F9CCE Val_Wu8 255.0 DFES_OneToOne 0.00 255.0 FORMAT "%5.1" /end CHARACTERISTIC
/begin CHARACTERISTIC DFES_FaultTyp.DFC_SiaEEPWrngCod_C "assigned fault type / Fault type assignment for check DFC_SiaEEPWrngCod" VALUE 0x804F9CCF Val_Wu8 255.0 DFES_OneToOne 0.00 255.0 FORMAT "%5.1" /end CHARACTERISTIC
/begin CHARACTERISTIC DFES_FaultTyp.DFC_UegoDummy_C "assigned fault type / Fault type assignment for check DFC_UegoDummy" VALUE 0x804F9CD0 Val_Wu8 255.0 DFES_OneToOne 0.00 255.0 FORMAT "%5.1" /end CHARACTERISTIC
/begin CHARACTERISTIC DFES_FaultTyp.DFC_BusDiagCANAPPLBusOff_C "assigned fault type / Fault type assignment for check DFC_BusDiagCANAPPLBusOff" VALUE 0x804F9CD1 Val_Wu8 255.0 DFES_OneToOne 0.00 255.0 FORMAT "%5.1" /end CHARACTERISTIC
/begin CHARACTERISTIC DFES_FaultTyp.DFC_BusDiagCANCANCBusOff_C "assigned fault type / Fault type assignment for check DFC_BusDiagCANCANCBusOff" VALUE 0x804F9CD2 Val_Wu8 255.0 DFES_OneToOne 0.00 255.0 FORMAT "%5.1" /end CHARACTERISTIC
/begin CHARACTERISTIC DFES_FaultTyp.DFC_BusDiagCANVEHICLEBusOff_C "assigned fault type / Fault type assignment for check DFC_BusDiagCANVEHICLEBusOff" VALUE 0x804F9CD3 Val_Wu8 255.0 DFES_OneToOne 0.00 255.0 FORMAT "%5.1" /end CHARACTERISTIC
/begin CHARACTERISTIC DFES_FaultTyp.DFC_RBA_IODIAGPWR_rba_IoExtCy329_SignalVltSply_0_C "assigned fault type / Fault type assignment for check DFC_RBA_IODIAGPWR_rba_IoExtCy329_SignalVltSply_0" VALUE 0x804F9CD4 Val_Wu8 255.0 DFES_OneToOne 0.00 255.0 FORMAT "%5.1" /end CHARACTERISTIC
/begin CHARACTERISTIC DFES_FaultTyp.DFC_RBA_IODIAGPWR_rba_IoExtCy329_SignalVltSply_0OT_C "assigned fault type / Fault type assignment for check DFC_RBA_IODIAGPWR_rba_IoExtCy329_SignalVltSply_0OT" VALUE 0x804F9CD5 Val_Wu8 255.0 DFES_OneToOne 0.00 255.0 FORMAT "%5.1" /end CHARACTERISTIC
/begin CHARACTERISTIC DFES_FaultTyp.DFC_RBA_IODIAGPWR_rba_IoExtCy329_SignalVltSply_0OV_C "assigned fault type / Fault type assignment for check DFC_RBA_IODIAGPWR_rba_IoExtCy329_SignalVltSply_0OV" VALUE 0x804F9CD6 Val_Wu8 255.0 DFES_OneToOne 0.00 255.0 FORMAT "%5.1" /end CHARACTERISTIC
/begin CHARACTERISTIC DFES_FaultTyp.DFC_RBA_IODIAGPWR_rba_IoExtCy329_SignalVltSply_0SCG_C "assigned fault type / Fault type assignment for check DFC_RBA_IODIAGPWR_rba_IoExtCy329_SignalVltSply_0SCG" VALUE 0x804F9CD7 Val_Wu8 255.0 DFES_OneToOne 0.00 255.0 FORMAT "%5.1" /end CHARACTERISTIC
/begin CHARACTERISTIC DFES_FaultTyp.DFC_RBA_IODIAGPWR_rba_IoExtCy329_SignalVltSply_0UV_C "assigned fault type / Fault type assignment for check DFC_RBA_IODIAGPWR_rba_IoExtCy329_SignalVltSply_0UV" VALUE 0x804F9CD8 Val_Wu8 255.0 DFES_OneToOne 0.00 255.0 FORMAT "%5.1" /end CHARACTERISTIC
/begin CHARACTERISTIC DFES_FaultTyp.DFC_RBA_IODIAGPWR_rba_IoExtCy329_SignalVltSply_1_C "assigned fault type / Fault type assignment for check DFC_RBA_IODIAGPWR_rba_IoExtCy329_SignalVltSply_1" VALUE 0x804F9CD9 Val_Wu8 255.0 DFES_OneToOne 0.00 255.0 FORMAT "%5.1" /end CHARACTERISTIC
/begin CHARACTERISTIC DFES_FaultTyp.DFC_RBA_IODIAGPWR_rba_IoExtCy329_SignalVltSply_1OT_C "assigned fault type / Fault type assignment for check DFC_RBA_IODIAGPWR_rba_IoExtCy329_SignalVltSply_1OT" VALUE 0x804F9CDA Val_Wu8 255.0 DFES_OneToOne 0.00 255.0 FORMAT "%5.1" /end CHARACTERISTIC
/begin CHARACTERISTIC DFES_FaultTyp.DFC_RBA_IODIAGPWR_rba_IoExtCy329_SignalVltSply_1OV_C "assigned fault type / Fault type assignment for check DFC_RBA_IODIAGPWR_rba_IoExtCy329_SignalVltSply_1OV" VALUE 0x804F9CDB Val_Wu8 255.0 DFES_OneToOne 0.00 255.0 FORMAT "%5.1" /end CHARACTERISTIC
/begin CHARACTERISTIC DFES_FaultTyp.DFC_RBA_IODIAGPWR_rba_IoExtCy329_SignalVltSply_1SCG_C "assigned fault type / Fault type assignment for check DFC_RBA_IODIAGPWR_rba_IoExtCy329_SignalVltSply_1SCG" VALUE 0x804F9CDC Val_Wu8 255.0 DFES_OneToOne 0.00 255.0 FORMAT "%5.1" /end CHARACTERISTIC
/begin CHARACTERISTIC DFES_FaultTyp.DFC_RBA_IODIAGPWR_rba_IoExtCy329_SignalVltSply_1UV_C "assigned fault type / Fault type assignment for check DFC_RBA_IODIAGPWR_rba_IoExtCy329_SignalVltSply_1UV" VALUE 0x804F9CDD Val_Wu8 255.0 DFES_OneToOne 0.00 255.0 FORMAT "%5.1" /end CHARACTERISTIC
/begin CHARACTERISTIC DFES_FaultTyp.DFC_RBA_IODIAGPWR_rba_IoExtCy329_SignalVltSply_2_C "assigned fault type / Fault type assignment for check DFC_RBA_IODIAGPWR_rba_IoExtCy329_SignalVltSply_2" VALUE 0x804F9CDE Val_Wu8 255.0 DFES_OneToOne 0.00 255.0 FORMAT "%5.1" /end CHARACTERISTIC
/begin CHARACTERISTIC DFES_FaultTyp.DFC_RBA_IODIAGPWR_rba_IoExtCy329_SignalVltSply_2OT_C "assigned fault type / Fault type assignment for check DFC_RBA_IODIAGPWR_rba_IoExtCy329_SignalVltSply_2OT" VALUE 0x804F9CDF Val_Wu8 255.0 DFES_OneToOne 0.00 255.0 FORMAT "%5.1" /end CHARACTERISTIC
/begin CHARACTERISTIC DFES_FaultTyp.DFC_RBA_IODIAGPWR_rba_IoExtCy329_SignalVltSply_2OV_C "assigned fault type / Fault type assignment for check DFC_RBA_IODIAGPWR_rba_IoExtCy329_SignalVltSply_2OV" VALUE 0x804F9CE0 Val_Wu8 255.0 DFES_OneToOne 0.00 255.0 FORMAT "%5.1" /end CHARACTERISTIC
/begin CHARACTERISTIC DFES_FaultTyp.DFC_RBA_IODIAGPWR_rba_IoExtCy329_SignalVltSply_2SCG_C "assigned fault type / Fault type assignment for check DFC_RBA_IODIAGPWR_rba_IoExtCy329_SignalVltSply_2SCG" VALUE 0x804F9CE1 Val_Wu8 255.0 DFES_OneToOne 0.00 255.0 FORMAT "%5.1" /end CHARACTERISTIC
/begin CHARACTERISTIC DFES_FaultTyp.DFC_RBA_IODIAGPWR_rba_IoExtCy329_SignalVltSply_2UV_C "assigned fault type / Fault type assignment for check DFC_RBA_IODIAGPWR_rba_IoExtCy329_SignalVltSply_2UV" VALUE 0x804F9CE2 Val_Wu8 255.0 DFES_OneToOne 0.00 255.0 FORMAT "%5.1" /end CHARACTERISTIC
/begin CHARACTERISTIC DFES_FaultTyp.DFC_CAN_E_TIMEOUT_C "assigned fault type / Fault type assignment for check DFC_CAN_E_TIMEOUT" VALUE 0x804F9CE3 Val_Wu8 255.0 DFES_OneToOne 0.00 255.0 FORMAT "%5.1" /end CHARACTERISTIC
/begin CHARACTERISTIC DFES_FaultTyp.DFC_LIN_E_TIMEOUT_C "assigned fault type / Fault type assignment for check DFC_LIN_E_TIMEOUT" VALUE 0x804F9CE4 Val_Wu8 255.0 DFES_OneToOne 0.00 255.0 FORMAT "%5.1" /end CHARACTERISTIC
/begin CHARACTERISTIC DFES_FaultTyp.DFC_MRlyOL_C "assigned fault type / Fault type assignment for check DFC_MRlyOL" VALUE 0x804F9CE5 Val_Wu8 255.0 DFES_OneToOne 0.00 255.0 FORMAT "%5.1" /end CHARACTERISTIC
/begin CHARACTERISTIC DFES_FaultTyp.DFC_MRlySCB_C "assigned fault type / Fault type assignment for check DFC_MRlySCB" VALUE 0x804F9CE6 Val_Wu8 255.0 DFES_OneToOne 0.00 255.0 FORMAT "%5.1" /end CHARACTERISTIC
/begin CHARACTERISTIC DFES_FaultTyp.DFC_MRlySCG_C "assigned fault type / Fault type assignment for check DFC_MRlySCG" VALUE 0x804F9CE7 Val_Wu8 255.0 DFES_OneToOne 0.00 255.0 FORMAT "%5.1" /end CHARACTERISTIC
/begin CHARACTERISTIC DFES_FaultTyp.DFC_rba_MultiStackTrace_Threshold_C "assigned fault type / Fault type assignment for check DFC_rba_MultiStackTrace_Threshold" VALUE 0x804F9CE8 Val_Wu8 255.0 DFES_OneToOne 0.00 255.0 FORMAT "%5.1" /end CHARACTERISTIC
/begin CHARACTERISTIC DFES_FaultTyp.DFC_BSWM_E_ACTION_FAILED_C "assigned fault type / Fault type assignment for check DFC_BSWM_E_ACTION_FAILED" VALUE 0x804F9CE9 Val_Wu8 255.0 DFES_OneToOne 0.00 255.0 FORMAT "%5.1" /end CHARACTERISTIC
/begin CHARACTERISTIC DFES_FaultTyp.DFC_BSWM_E_INTRPTQUEUE_FULL_C "assigned fault type / Fault type assignment for check DFC_BSWM_E_INTRPTQUEUE_FULL" VALUE 0x804F9CEA Val_Wu8 255.0 DFES_OneToOne 0.00 255.0 FORMAT "%5.1" /end CHARACTERISTIC
/begin CHARACTERISTIC DFES_FaultTyp.DFC_RBA_IOEXTLIB_KEEPALIVE_DRV_C "assigned fault type / Fault type assignment for check DFC_RBA_IOEXTLIB_KEEPALIVE_DRV" VALUE 0x804F9CEB Val_Wu8 255.0 DFES_OneToOne 0.00 255.0 FORMAT "%5.1" /end CHARACTERISTIC
/begin CHARACTERISTIC DFES_FaultTyp.DFC_RBA_IOEXTLIB_KEEPALIVE_INI_C "assigned fault type / Fault type assignment for check DFC_RBA_IOEXTLIB_KEEPALIVE_INI" VALUE 0x804F9CEC Val_Wu8 255.0 DFES_OneToOne 0.00 255.0 FORMAT "%5.1" /end CHARACTERISTIC
/begin CHARACTERISTIC DFES_FaultTyp.DFC_rba_IoSigRtc_StopCounter_C "assigned fault type / Fault type assignment for check DFC_rba_IoSigRtc_StopCounter" VALUE 0x804F9CED Val_Wu8 255.0 DFES_OneToOne 0.00 255.0 FORMAT "%5.1" /end CHARACTERISTIC
/begin CHARACTERISTIC DFES_FaultTyp.DFC_rba_MRly_Diag_Stk_Event_C "assigned fault type / Fault type assignment for check DFC_rba_MRly_Diag_Stk_Event" VALUE 0x804F9CEE Val_Wu8 255.0 DFES_OneToOne 0.00 255.0 FORMAT "%5.1" /end CHARACTERISTIC
/begin CHARACTERISTIC DFES_FaultTyp.DFC_rba_MemDiag_MemReadErr_C "assigned fault type / Fault type assignment for check DFC_rba_MemDiag_MemReadErr" VALUE 0x804F9CEF Val_Wu8 255.0 DFES_OneToOne 0.00 255.0 FORMAT "%5.1" /end CHARACTERISTIC
/begin CHARACTERISTIC DFES_FaultTyp.DFC_rba_MemDiag_MemWrErr_C "assigned fault type / Fault type assignment for check DFC_rba_MemDiag_MemWrErr" VALUE 0x804F9CF0 Val_Wu8 255.0 DFES_OneToOne 0.00 255.0 FORMAT "%5.1" /end CHARACTERISTIC
/begin CHARACTERISTIC DFES_FaultTyp.DFC_rba_SyC_IrrSwOffTrigEngRun_Event_C "assigned fault type / Fault type assignment for check DFC_rba_SyC_IrrSwOffTrigEngRun_Event" VALUE 0x804F9CF1 Val_Wu8 255.0 DFES_OneToOne 0.00 255.0 FORMAT "%5.1" /end CHARACTERISTIC
/begin CHARACTERISTIC DFES_FaultTyp.DFC_rba_T15_Diag_ComInVld_Event_C "assigned fault type / Fault type assignment for check DFC_rba_T15_Diag_ComInVld_Event" VALUE 0x804F9CF2 Val_Wu8 255.0 DFES_OneToOne 0.00 255.0 FORMAT "%5.1" /end CHARACTERISTIC
/begin CHARACTERISTIC DFES_FaultTyp.DFC_rba_T15_Diag_ComOff_HwOn_Event_C "assigned fault type / Fault type assignment for check DFC_rba_T15_Diag_ComOff_HwOn_Event" VALUE 0x804F9CF3 Val_Wu8 255.0 DFES_OneToOne 0.00 255.0 FORMAT "%5.1" /end CHARACTERISTIC
/begin CHARACTERISTIC DFES_FaultTyp.DFC_rba_T15_Diag_ComOn_HwOff_Event_C "assigned fault type / Fault type assignment for check DFC_rba_T15_Diag_ComOn_HwOff_Event" VALUE 0x804F9CF4 Val_Wu8 255.0 DFES_OneToOne 0.00 255.0 FORMAT "%5.1" /end CHARACTERISTIC
/begin CHARACTERISTIC DFES_FaultTyp.DFC_AppAllSnsrDfct_C "assigned fault type / Fault type assignment for check DFC_AppAllSnsrDfct" VALUE 0x804F9CF5 Val_Wu8 255.0 DFES_OneToOne 0.00 255.0 FORMAT "%5.1" /end CHARACTERISTIC
/begin CHARACTERISTIC DFES_FaultTyp.DFC_BattUStdbyDiaOL_C "assigned fault type / Fault type assignment for check DFC_BattUStdbyDiaOL" VALUE 0x804F9CF6 Val_Wu8 255.0 DFES_OneToOne 0.00 255.0 FORMAT "%5.1" /end CHARACTERISTIC
/begin CHARACTERISTIC DFES_FaultTyp.DFC_BigLeakIntkMnfldEmiInfl_C "assigned fault type / Fault type assignment for check DFC_BigLeakIntkMnfldEmiInfl" VALUE 0x804F9CF7 Val_Wu8 255.0 DFES_OneToOne 0.00 255.0 FORMAT "%5.1" /end CHARACTERISTIC
/begin CHARACTERISTIC DFES_FaultTyp.DFC_BrkMnSwtContOnWarnLmp_C "assigned fault type / Fault type assignment for check DFC_BrkMnSwtContOnWarnLmp" VALUE 0x804F9CF8 Val_Wu8 255.0 DFES_OneToOne 0.00 255.0 FORMAT "%5.1" /end CHARACTERISTIC
/begin CHARACTERISTIC DFES_FaultTyp.DFC_BrkMnSwtNotStpWarnLmp_C "assigned fault type / Fault type assignment for check DFC_BrkMnSwtNotStpWarnLmp" VALUE 0x804F9CF9 Val_Wu8 255.0 DFES_OneToOne 0.00 255.0 FORMAT "%5.1" /end CHARACTERISTIC
/begin CHARACTERISTIC DFES_FaultTyp.DFC_BrkRdntSwtContOnWarnLmp_C "assigned fault type / Fault type assignment for check DFC_BrkRdntSwtContOnWarnLmp" VALUE 0x804F9CFA Val_Wu8 255.0 DFES_OneToOne 0.00 255.0 FORMAT "%5.1" /end CHARACTERISTIC
/begin CHARACTERISTIC DFES_FaultTyp.DFC_BrkRdntSwtNotStpWarnLmp_C "assigned fault type / Fault type assignment for check DFC_BrkRdntSwtNotStpWarnLmp" VALUE 0x804F9CFB Val_Wu8 255.0 DFES_OneToOne 0.00 255.0 FORMAT "%5.1" /end CHARACTERISTIC
/begin CHARACTERISTIC DFES_FaultTyp.DFC_CEngDsTColdStrtMax_C "assigned fault type / Fault type assignment for check DFC_CEngDsTColdStrtMax" VALUE 0x804F9CFC Val_Wu8 255.0 DFES_OneToOne 0.00 255.0 FORMAT "%5.1" /end CHARACTERISTIC
/begin CHARACTERISTIC DFES_FaultTyp.DFC_CEngDsTColdStrtMin_C "assigned fault type / Fault type assignment for check DFC_CEngDsTColdStrtMin" VALUE 0x804F9CFD Val_Wu8 255.0 DFES_OneToOne 0.00 255.0 FORMAT "%5.1" /end CHARACTERISTIC
/begin CHARACTERISTIC DFES_FaultTyp.DFC_CEngDsTImps_C "assigned fault type / Fault type assignment for check DFC_CEngDsTImps" VALUE 0x804F9CFE Val_Wu8 255.0 DFES_OneToOne 0.00 255.0 FORMAT "%5.1" /end CHARACTERISTIC
/begin CHARACTERISTIC DFES_FaultTyp.DFC_CEngDsTPlausLSC_C "assigned fault type / Fault type assignment for check DFC_CEngDsTPlausLSC" VALUE 0x804F9CFF Val_Wu8 255.0 DFES_OneToOne 0.00 255.0 FORMAT "%5.1" /end CHARACTERISTIC
/begin CHARACTERISTIC DFES_FaultTyp.DFC_CEngDsTPlausSTC_C "assigned fault type / Fault type assignment for check DFC_CEngDsTPlausSTC" VALUE 0x804F9D00 Val_Wu8 255.0 DFES_OneToOne 0.00 255.0 FORMAT "%5.1" /end CHARACTERISTIC
/begin CHARACTERISTIC DFES_FaultTyp.DFC_CEngDsTSRCMax_C "assigned fault type / Fault type assignment for check DFC_CEngDsTSRCMax" VALUE 0x804F9D01 Val_Wu8 255.0 DFES_OneToOne 0.00 255.0 FORMAT "%5.1" /end CHARACTERISTIC
/begin CHARACTERISTIC DFES_FaultTyp.DFC_CEngDsTSRCMin_C "assigned fault type / Fault type assignment for check DFC_CEngDsTSRCMin" VALUE 0x804F9D02 Val_Wu8 255.0 DFES_OneToOne 0.00 255.0 FORMAT "%5.1" /end CHARACTERISTIC
/begin CHARACTERISTIC DFES_FaultTyp.DFC_CEngDsTSig_C "assigned fault type / Fault type assignment for check DFC_CEngDsTSig" VALUE 0x804F9D03 Val_Wu8 255.0 DFES_OneToOne 0.00 255.0 FORMAT "%5.1" /end CHARACTERISTIC
/begin CHARACTERISTIC DFES_FaultTyp.DFC_CEngUsTSRCMax_C "assigned fault type / Fault type assignment for check DFC_CEngUsTSRCMax" VALUE 0x804F9D04 Val_Wu8 255.0 DFES_OneToOne 0.00 255.0 FORMAT "%5.1" /end CHARACTERISTIC
/begin CHARACTERISTIC DFES_FaultTyp.DFC_CEngUsTSRCMin_C "assigned fault type / Fault type assignment for check DFC_CEngUsTSRCMin" VALUE 0x804F9D05 Val_Wu8 255.0 DFES_OneToOne 0.00 255.0 FORMAT "%5.1" /end CHARACTERISTIC
/begin CHARACTERISTIC DFES_FaultTyp.DFC_DCDCFltDet_C "assigned fault type / Fault type assignment for check DFC_DCDCFltDet" VALUE 0x804F9D06 Val_Wu8 255.0 DFES_OneToOne 0.00 255.0 FORMAT "%5.1" /end CHARACTERISTIC
/begin CHARACTERISTIC DFES_FaultTyp.DFC_DKRSA_C "assigned fault type / Fault type assignment for check DFC_DKRSA" VALUE 0x804F9D07 Val_Wu8 255.0 DFES_OneToOne 0.00 255.0 FORMAT "%5.1" /end CHARACTERISTIC
/begin CHARACTERISTIC DFES_FaultTyp.DFC_DKVSmax_C "assigned fault type / Fault type assignment for check DFC_DKVSmax" VALUE 0x804F9D08 Val_Wu8 255.0 DFES_OneToOne 0.00 255.0 FORMAT "%5.1" /end CHARACTERISTIC
/begin CHARACTERISTIC DFES_FaultTyp.DFC_DKnpl_C "assigned fault type / Fault type assignment for check DFC_DKnpl" VALUE 0x804F9D09 Val_Wu8 255.0 DFES_OneToOne 0.00 255.0 FORMAT "%5.1" /end CHARACTERISTIC
/begin CHARACTERISTIC DFES_FaultTyp.DFC_DSSmax_C "assigned fault type / Fault type assignment for check DFC_DSSmax" VALUE 0x804F9D0A Val_Wu8 255.0 DFES_OneToOne 0.00 255.0 FORMAT "%5.1" /end CHARACTERISTIC
/begin CHARACTERISTIC DFES_FaultTyp.DFC_DSTTI_C "assigned fault type / Fault type assignment for check DFC_DSTTI" VALUE 0x804F9D0B Val_Wu8 255.0 DFES_OneToOne 0.00 255.0 FORMAT "%5.1" /end CHARACTERISTIC
/begin CHARACTERISTIC DFES_FaultTyp.DFC_DSUmax_C "assigned fault type / Fault type assignment for check DFC_DSUmax" VALUE 0x804F9D0C Val_Wu8 255.0 DFES_OneToOne 0.00 255.0 FORMAT "%5.1" /end CHARACTERISTIC
/begin CHARACTERISTIC DFES_FaultTyp.DFC_EGRVlvOL_C "assigned fault type / Fault type assignment for check DFC_EGRVlvOL" VALUE 0x804F9D0D Val_Wu8 255.0 DFES_OneToOne 0.00 255.0 FORMAT "%5.1" /end CHARACTERISTIC
/begin CHARACTERISTIC DFES_FaultTyp.DFC_EGRVlvSCB_C "assigned fault type / Fault type assignment for check DFC_EGRVlvSCB" VALUE 0x804F9D0E Val_Wu8 255.0 DFES_OneToOne 0.00 255.0 FORMAT "%5.1" /end CHARACTERISTIC
/begin CHARACTERISTIC DFES_FaultTyp.DFC_EGRVlvSCG_C "assigned fault type / Fault type assignment for check DFC_EGRVlvSCG" VALUE 0x804F9D0F Val_Wu8 255.0 DFES_OneToOne 0.00 255.0 FORMAT "%5.1" /end CHARACTERISTIC
/begin CHARACTERISTIC DFES_FaultTyp.DFC_EGSDUS2B1LtrDly_C "assigned fault type / Fault type assignment for check DFC_EGSDUS2B1LtrDly" VALUE 0x804F9D10 Val_Wu8 255.0 DFES_OneToOne 0.00 255.0 FORMAT "%5.1" /end CHARACTERISTIC
/begin CHARACTERISTIC DFES_FaultTyp.DFC_EGSDUS2B1LtrPT1_C "assigned fault type / Fault type assignment for check DFC_EGSDUS2B1LtrPT1" VALUE 0x804F9D11 Val_Wu8 255.0 DFES_OneToOne 0.00 255.0 FORMAT "%5.1" /end CHARACTERISTIC
/begin CHARACTERISTIC DFES_FaultTyp.DFC_EGSDUS2B1RtlDly_C "assigned fault type / Fault type assignment for check DFC_EGSDUS2B1RtlDly" VALUE 0x804F9D12 Val_Wu8 255.0 DFES_OneToOne 0.00 255.0 FORMAT "%5.1" /end CHARACTERISTIC
/begin CHARACTERISTIC DFES_FaultTyp.DFC_EGSDUS2B1RtlPT1_C "assigned fault type / Fault type assignment for check DFC_EGSDUS2B1RtlPT1" VALUE 0x804F9D13 Val_Wu8 255.0 DFES_OneToOne 0.00 255.0 FORMAT "%5.1" /end CHARACTERISTIC
/begin CHARACTERISTIC DFES_FaultTyp.DFC_EGSDUS2B1TarLean_C "assigned fault type / Fault type assignment for check DFC_EGSDUS2B1TarLean" VALUE 0x804F9D14 Val_Wu8 255.0 DFES_OneToOne 0.00 255.0 FORMAT "%5.1" /end CHARACTERISTIC
/begin CHARACTERISTIC DFES_FaultTyp.DFC_EGSDUS2B1TarRich_C "assigned fault type / Fault type assignment for check DFC_EGSDUS2B1TarRich" VALUE 0x804F9D15 Val_Wu8 255.0 DFES_OneToOne 0.00 255.0 FORMAT "%5.1" /end CHARACTERISTIC
/begin CHARACTERISTIC DFES_FaultTyp.DFC_ETAKHLmax_C "assigned fault type / Fault type assignment for check DFC_ETAKHLmax" VALUE 0x804F9D16 Val_Wu8 255.0 DFES_OneToOne 0.00 255.0 FORMAT "%5.1" /end CHARACTERISTIC
/begin CHARACTERISTIC DFES_FaultTyp.DFC_ETAKHTmax_C "assigned fault type / Fault type assignment for check DFC_ETAKHTmax" VALUE 0x804F9D17 Val_Wu8 255.0 DFES_OneToOne 0.00 255.0 FORMAT "%5.1" /end CHARACTERISTIC
/begin CHARACTERISTIC DFES_FaultTyp.DFC_EngICO_C "assigned fault type / Fault type assignment for check DFC_EngICO" VALUE 0x804F9D18 Val_Wu8 255.0 DFES_OneToOne 0.00 255.0 FORMAT "%5.1" /end CHARACTERISTIC
/begin CHARACTERISTIC DFES_FaultTyp.DFC_EngPrtOvrSpdMon_C "assigned fault type / Fault type assignment for check DFC_EngPrtOvrSpdMon" VALUE 0x804F9D19 Val_Wu8 255.0 DFES_OneToOne 0.00 255.0 FORMAT "%5.1" /end CHARACTERISTIC
/begin CHARACTERISTIC DFES_FaultTyp.DFC_EpmCaSI1ErrSig_C "assigned fault type / Fault type assignment for check DFC_EpmCaSI1ErrSig" VALUE 0x804F9D1A Val_Wu8 255.0 DFES_OneToOne 0.00 255.0 FORMAT "%5.1" /end CHARACTERISTIC
/begin CHARACTERISTIC DFES_FaultTyp.DFC_EpmCaSI1NoSig_C "assigned fault type / Fault type assignment for check DFC_EpmCaSI1NoSig" VALUE 0x804F9D1B Val_Wu8 255.0 DFES_OneToOne 0.00 255.0 FORMAT "%5.1" /end CHARACTERISTIC
/begin CHARACTERISTIC DFES_FaultTyp.DFC_EpmCaSI1OfsErr_C "assigned fault type / Fault type assignment for check DFC_EpmCaSI1OfsErr" VALUE 0x804F9D1C Val_Wu8 255.0 DFES_OneToOne 0.00 255.0 FORMAT "%5.1" /end CHARACTERISTIC
/begin CHARACTERISTIC DFES_FaultTyp.DFC_EpmCrSErrSig_C "assigned fault type / Fault type assignment for check DFC_EpmCrSErrSig" VALUE 0x804F9D1D Val_Wu8 255.0 DFES_OneToOne 0.00 255.0 FORMAT "%5.1" /end CHARACTERISTIC
/begin CHARACTERISTIC DFES_FaultTyp.DFC_EpmCrSNoSig_C "assigned fault type / Fault type assignment for check DFC_EpmCrSNoSig" VALUE 0x804F9D1E Val_Wu8 255.0 DFES_OneToOne 0.00 255.0 FORMAT "%5.1" /end CHARACTERISTIC
/begin CHARACTERISTIC DFES_FaultTyp.DFC_EtaEngIdleNonCsers_C "assigned fault type / Fault type assignment for check DFC_EtaEngIdleNonCsers" VALUE 0x804F9D1F Val_Wu8 255.0 DFES_OneToOne 0.00 255.0 FORMAT "%5.1" /end CHARACTERISTIC
/begin CHARACTERISTIC DFES_FaultTyp.DFC_EtaEngPtlNonCsers_C "assigned fault type / Fault type assignment for check DFC_EtaEngPtlNonCsers" VALUE 0x804F9D20 Val_Wu8 255.0 DFES_OneToOne 0.00 255.0 FORMAT "%5.1" /end CHARACTERISTIC
/begin CHARACTERISTIC DFES_FaultTyp.DFC_FRAmax_C "assigned fault type / Fault type assignment for check DFC_FRAmax" VALUE 0x804F9D21 Val_Wu8 255.0 DFES_OneToOne 0.00 255.0 FORMAT "%5.1" /end CHARACTERISTIC
/begin CHARACTERISTIC DFES_FaultTyp.DFC_FRAmin_C "assigned fault type / Fault type assignment for check DFC_FRAmin" VALUE 0x804F9D22 Val_Wu8 255.0 DFES_OneToOne 0.00 255.0 FORMAT "%5.1" /end CHARACTERISTIC
/begin CHARACTERISTIC DFES_FaultTyp.DFC_GbxRvsSwtStk_C "assigned fault type / Fault type assignment for check DFC_GbxRvsSwtStk" VALUE 0x804F9D23 Val_Wu8 255.0 DFES_OneToOne 0.00 255.0 FORMAT "%5.1" /end CHARACTERISTIC
/begin CHARACTERISTIC DFES_FaultTyp.DFC_HDRmax_C "assigned fault type / Fault type assignment for check DFC_HDRmax" VALUE 0x804F9D24 Val_Wu8 255.0 DFES_OneToOne 0.00 255.0 FORMAT "%5.1" /end CHARACTERISTIC
/begin CHARACTERISTIC DFES_FaultTyp.DFC_HEGOS2B1ElecMax_C "assigned fault type / Fault type assignment for check DFC_HEGOS2B1ElecMax" VALUE 0x804F9D25 Val_Wu8 255.0 DFES_OneToOne 0.00 255.0 FORMAT "%5.1" /end CHARACTERISTIC
/begin CHARACTERISTIC DFES_FaultTyp.DFC_HEGOS2B1ElecMin_C "assigned fault type / Fault type assignment for check DFC_HEGOS2B1ElecMin" VALUE 0x804F9D26 Val_Wu8 255.0 DFES_OneToOne 0.00 255.0 FORMAT "%5.1" /end CHARACTERISTIC
/begin CHARACTERISTIC DFES_FaultTyp.DFC_HEGOS2B1ElecSig_C "assigned fault type / Fault type assignment for check DFC_HEGOS2B1ElecSig" VALUE 0x804F9D27 Val_Wu8 255.0 DFES_OneToOne 0.00 255.0 FORMAT "%5.1" /end CHARACTERISTIC
/begin CHARACTERISTIC DFES_FaultTyp.DFC_HEGOS2B1HtgNpl_C "assigned fault type / Fault type assignment for check DFC_HEGOS2B1HtgNpl" VALUE 0x804F9D28 Val_Wu8 255.0 DFES_OneToOne 0.00 255.0 FORMAT "%5.1" /end CHARACTERISTIC
/begin CHARACTERISTIC DFES_FaultTyp.DFC_IntkAirTIntkMnfldCrssMax_C "assigned fault type / Fault type assignment for check DFC_IntkAirTIntkMnfldCrssMax" VALUE 0x804F9D29 Val_Wu8 255.0 DFES_OneToOne 0.00 255.0 FORMAT "%5.1" /end CHARACTERISTIC
/begin CHARACTERISTIC DFES_FaultTyp.DFC_IntkAirTIntkMnfldCrssMin_C "assigned fault type / Fault type assignment for check DFC_IntkAirTIntkMnfldCrssMin" VALUE 0x804F9D2A Val_Wu8 255.0 DFES_OneToOne 0.00 255.0 FORMAT "%5.1" /end CHARACTERISTIC
/begin CHARACTERISTIC DFES_FaultTyp.DFC_IntkAirTIntkMnfldHSCMax_C "assigned fault type / Fault type assignment for check DFC_IntkAirTIntkMnfldHSCMax" VALUE 0x804F9D2B Val_Wu8 255.0 DFES_OneToOne 0.00 255.0 FORMAT "%5.1" /end CHARACTERISTIC
/begin CHARACTERISTIC DFES_FaultTyp.DFC_IntkAirTIntkMnfldImps_C "assigned fault type / Fault type assignment for check DFC_IntkAirTIntkMnfldImps" VALUE 0x804F9D2C Val_Wu8 255.0 DFES_OneToOne 0.00 255.0 FORMAT "%5.1" /end CHARACTERISTIC
/begin CHARACTERISTIC DFES_FaultTyp.DFC_IntkAirTIntkMnfldPRCMax_C "assigned fault type / Fault type assignment for check DFC_IntkAirTIntkMnfldPRCMax" VALUE 0x804F9D2D Val_Wu8 255.0 DFES_OneToOne 0.00 255.0 FORMAT "%5.1" /end CHARACTERISTIC
/begin CHARACTERISTIC DFES_FaultTyp.DFC_IntkAirTIntkMnfldPRCMin_C "assigned fault type / Fault type assignment for check DFC_IntkAirTIntkMnfldPRCMin" VALUE 0x804F9D2E Val_Wu8 255.0 DFES_OneToOne 0.00 255.0 FORMAT "%5.1" /end CHARACTERISTIC
/begin CHARACTERISTIC DFES_FaultTyp.DFC_IntkAirTIntkMnfldSRCMax_C "assigned fault type / Fault type assignment for check DFC_IntkAirTIntkMnfldSRCMax" VALUE 0x804F9D2F Val_Wu8 255.0 DFES_OneToOne 0.00 255.0 FORMAT "%5.1" /end CHARACTERISTIC
/begin CHARACTERISTIC DFES_FaultTyp.DFC_IntkAirTIntkMnfldSRCMin_C "assigned fault type / Fault type assignment for check DFC_IntkAirTIntkMnfldSRCMin" VALUE 0x804F9D30 Val_Wu8 255.0 DFES_OneToOne 0.00 255.0 FORMAT "%5.1" /end CHARACTERISTIC
/begin CHARACTERISTIC DFES_FaultTyp.DFC_IntkAirTIntkMnfldSTC_C "assigned fault type / Fault type assignment for check DFC_IntkAirTIntkMnfldSTC" VALUE 0x804F9D31 Val_Wu8 255.0 DFES_OneToOne 0.00 255.0 FORMAT "%5.1" /end CHARACTERISTIC
/begin CHARACTERISTIC DFES_FaultTyp.DFC_KS1max_C "assigned fault type / Fault type assignment for check DFC_KS1max" VALUE 0x804F9D32 Val_Wu8 255.0 DFES_OneToOne 0.00 255.0 FORMAT "%5.1" /end CHARACTERISTIC
/begin CHARACTERISTIC DFES_FaultTyp.DFC_KS1min_C "assigned fault type / Fault type assignment for check DFC_KS1min" VALUE 0x804F9D33 Val_Wu8 255.0 DFES_OneToOne 0.00 255.0 FORMAT "%5.1" /end CHARACTERISTIC
/begin CHARACTERISTIC DFES_FaultTyp.DFC_LMmax_C "assigned fault type / Fault type assignment for check DFC_LMmax" VALUE 0x804F9D34 Val_Wu8 255.0 DFES_OneToOne 0.00 255.0 FORMAT "%5.1" /end CHARACTERISTIC
/begin CHARACTERISTIC DFES_FaultTyp.DFC_LZSRnpl_C "assigned fault type / Fault type assignment for check DFC_LZSRnpl" VALUE 0x804F9D35 Val_Wu8 255.0 DFES_OneToOne 0.00 255.0 FORMAT "%5.1" /end CHARACTERISTIC
/begin CHARACTERISTIC DFES_FaultTyp.DFC_LamDynDiagS1B1_C "assigned fault type / Fault type assignment for check DFC_LamDynDiagS1B1" VALUE 0x804F9D36 Val_Wu8 255.0 DFES_OneToOne 0.00 255.0 FORMAT "%5.1" /end CHARACTERISTIC
/begin CHARACTERISTIC DFES_FaultTyp.DFC_LeakIntkMnfldEmiInfl_C "assigned fault type / Fault type assignment for check DFC_LeakIntkMnfldEmiInfl" VALUE 0x804F9D37 Val_Wu8 255.0 DFES_OneToOne 0.00 255.0 FORMAT "%5.1" /end CHARACTERISTIC
/begin CHARACTERISTIC DFES_FaultTyp.DFC_MD00max_C "assigned fault type / Fault type assignment for check DFC_MD00max" VALUE 0x804F9D38 Val_Wu8 255.0 DFES_OneToOne 0.00 255.0 FORMAT "%5.1" /end CHARACTERISTIC
/begin CHARACTERISTIC DFES_FaultTyp.DFC_MDBmax_C "assigned fault type / Fault type assignment for check DFC_MDBmax" VALUE 0x804F9D39 Val_Wu8 255.0 DFES_OneToOne 0.00 255.0 FORMAT "%5.1" /end CHARACTERISTIC
/begin CHARACTERISTIC DFES_FaultTyp.DFC_MDCat_C "assigned fault type / Fault type assignment for check DFC_MDCat" VALUE 0x804F9D3A Val_Wu8 255.0 DFES_OneToOne 0.00 255.0 FORMAT "%5.1" /end CHARACTERISTIC
/begin CHARACTERISTIC DFES_FaultTyp.DFC_MDCatCrit_C "assigned fault type / Fault type assignment for check DFC_MDCatCrit" VALUE 0x804F9D3B Val_Wu8 255.0 DFES_OneToOne 0.00 255.0 FORMAT "%5.1" /end CHARACTERISTIC
/begin CHARACTERISTIC DFES_FaultTyp.DFC_MDCatCurr_C "assigned fault type / Fault type assignment for check DFC_MDCatCurr" VALUE 0x804F9D3C Val_Wu8 255.0 DFES_OneToOne 0.00 255.0 FORMAT "%5.1" /end CHARACTERISTIC
/begin CHARACTERISTIC DFES_FaultTyp.DFC_MDCyl_0_C "assigned fault type / Fault type assignment for check DFC_MDCyl_0" VALUE 0x804F9D3D Val_Wu8 255.0 DFES_OneToOne 0.00 255.0 FORMAT "%5.1" /end CHARACTERISTIC
/begin CHARACTERISTIC DFES_FaultTyp.DFC_MDCyl_1_C "assigned fault type / Fault type assignment for check DFC_MDCyl_1" VALUE 0x804F9D3E Val_Wu8 255.0 DFES_OneToOne 0.00 255.0 FORMAT "%5.1" /end CHARACTERISTIC
/begin CHARACTERISTIC DFES_FaultTyp.DFC_MDCyl_2_C "assigned fault type / Fault type assignment for check DFC_MDCyl_2" VALUE 0x804F9D3F Val_Wu8 255.0 DFES_OneToOne 0.00 255.0 FORMAT "%5.1" /end CHARACTERISTIC
/begin CHARACTERISTIC DFES_FaultTyp.DFC_MDCyl_3_C "assigned fault type / Fault type assignment for check DFC_MDCyl_3" VALUE 0x804F9D40 Val_Wu8 255.0 DFES_OneToOne 0.00 255.0 FORMAT "%5.1" /end CHARACTERISTIC
/begin CHARACTERISTIC DFES_FaultTyp.DFC_MDEmi_C "assigned fault type / Fault type assignment for check DFC_MDEmi" VALUE 0x804F9D41 Val_Wu8 255.0 DFES_OneToOne 0.00 255.0 FORMAT "%5.1" /end CHARACTERISTIC
/begin CHARACTERISTIC DFES_FaultTyp.DFC_MDEmiStrt_C "assigned fault type / Fault type assignment for check DFC_MDEmiStrt" VALUE 0x804F9D42 Val_Wu8 255.0 DFES_OneToOne 0.00 255.0 FORMAT "%5.1" /end CHARACTERISTIC
/begin CHARACTERISTIC DFES_FaultTyp.DFC_MDFco_C "assigned fault type / Fault type assignment for check DFC_MDFco" VALUE 0x804F9D43 Val_Wu8 255.0 DFES_OneToOne 0.00 255.0 FORMAT "%5.1" /end CHARACTERISTIC
/begin CHARACTERISTIC DFES_FaultTyp.DFC_MDMpl_C "assigned fault type / Fault type assignment for check DFC_MDMpl" VALUE 0x804F9D44 Val_Wu8 255.0 DFES_OneToOne 0.00 255.0 FORMAT "%5.1" /end CHARACTERISTIC
/begin CHARACTERISTIC DFES_FaultTyp.DFC_MDSegTiAdpn_C "assigned fault type / Fault type assignment for check DFC_MDSegTiAdpn" VALUE 0x804F9D45 Val_Wu8 255.0 DFES_OneToOne 0.00 255.0 FORMAT "%5.1" /end CHARACTERISTIC
/begin CHARACTERISTIC DFES_FaultTyp.DFC_MDmax_C "assigned fault type / Fault type assignment for check DFC_MDmax" VALUE 0x804F9D46 Val_Wu8 255.0 DFES_OneToOne 0.00 255.0 FORMAT "%5.1" /end CHARACTERISTIC
/begin CHARACTERISTIC DFES_FaultTyp.DFC_MOXEMM_SMU_ALM0_0_C "assigned fault type / Fault type assignment for check DFC_MOXEMM_SMU_ALM0_0" VALUE 0x804F9D47 Val_Wu8 255.0 DFES_OneToOne 0.00 255.0 FORMAT "%5.1" /end CHARACTERISTIC
/begin CHARACTERISTIC DFES_FaultTyp.DFC_MOXEMM_SMU_ALM0_1_C "assigned fault type / Fault type assignment for check DFC_MOXEMM_SMU_ALM0_1" VALUE 0x804F9D48 Val_Wu8 255.0 DFES_OneToOne 0.00 255.0 FORMAT "%5.1" /end CHARACTERISTIC
/begin CHARACTERISTIC DFES_FaultTyp.DFC_MOXEMM_SMU_ALM0_10_C "assigned fault type / Fault type assignment for check DFC_MOXEMM_SMU_ALM0_10" VALUE 0x804F9D49 Val_Wu8 255.0 DFES_OneToOne 0.00 255.0 FORMAT "%5.1" /end CHARACTERISTIC
/begin CHARACTERISTIC DFES_FaultTyp.DFC_MOXEMM_SMU_ALM0_11_C "assigned fault type / Fault type assignment for check DFC_MOXEMM_SMU_ALM0_11" VALUE 0x804F9D4A Val_Wu8 255.0 DFES_OneToOne 0.00 255.0 FORMAT "%5.1" /end CHARACTERISTIC
/begin CHARACTERISTIC DFES_FaultTyp.DFC_MOXEMM_SMU_ALM0_13_C "assigned fault type / Fault type assignment for check DFC_MOXEMM_SMU_ALM0_13" VALUE 0x804F9D4B Val_Wu8 255.0 DFES_OneToOne 0.00 255.0 FORMAT "%5.1" /end CHARACTERISTIC
/begin CHARACTERISTIC DFES_FaultTyp.DFC_MOXEMM_SMU_ALM0_14_C "assigned fault type / Fault type assignment for check DFC_MOXEMM_SMU_ALM0_14" VALUE 0x804F9D4C Val_Wu8 255.0 DFES_OneToOne 0.00 255.0 FORMAT "%5.1" /end CHARACTERISTIC
/begin CHARACTERISTIC DFES_FaultTyp.DFC_MOXEMM_SMU_ALM0_2_C "assigned fault type / Fault type assignment for check DFC_MOXEMM_SMU_ALM0_2" VALUE 0x804F9D4D Val_Wu8 255.0 DFES_OneToOne 0.00 255.0 FORMAT "%5.1" /end CHARACTERISTIC
/begin CHARACTERISTIC DFES_FaultTyp.DFC_MOXEMM_SMU_ALM0_22_C "assigned fault type / Fault type assignment for check DFC_MOXEMM_SMU_ALM0_22" VALUE 0x804F9D4E Val_Wu8 255.0 DFES_OneToOne 0.00 255.0 FORMAT "%5.1" /end CHARACTERISTIC
/begin CHARACTERISTIC DFES_FaultTyp.DFC_MOXEMM_SMU_ALM0_23_C "assigned fault type / Fault type assignment for check DFC_MOXEMM_SMU_ALM0_23" VALUE 0x804F9D4F Val_Wu8 255.0 DFES_OneToOne 0.00 255.0 FORMAT "%5.1" /end CHARACTERISTIC
/begin CHARACTERISTIC DFES_FaultTyp.DFC_MOXEMM_SMU_ALM0_4_C "assigned fault type / Fault type assignment for check DFC_MOXEMM_SMU_ALM0_4" VALUE 0x804F9D50 Val_Wu8 255.0 DFES_OneToOne 0.00 255.0 FORMAT "%5.1" /end CHARACTERISTIC
/begin CHARACTERISTIC DFES_FaultTyp.DFC_MOXEMM_SMU_ALM0_5_C "assigned fault type / Fault type assignment for check DFC_MOXEMM_SMU_ALM0_5" VALUE 0x804F9D51 Val_Wu8 255.0 DFES_OneToOne 0.00 255.0 FORMAT "%5.1" /end CHARACTERISTIC
/begin CHARACTERISTIC DFES_FaultTyp.DFC_MOXEMM_SMU_ALM0_7_C "assigned fault type / Fault type assignment for check DFC_MOXEMM_SMU_ALM0_7" VALUE 0x804F9D52 Val_Wu8 255.0 DFES_OneToOne 0.00 255.0 FORMAT "%5.1" /end CHARACTERISTIC
/begin CHARACTERISTIC DFES_FaultTyp.DFC_MOXEMM_SMU_ALM0_8_C "assigned fault type / Fault type assignment for check DFC_MOXEMM_SMU_ALM0_8" VALUE 0x804F9D53 Val_Wu8 255.0 DFES_OneToOne 0.00 255.0 FORMAT "%5.1" /end CHARACTERISTIC
/begin CHARACTERISTIC DFES_FaultTyp.DFC_MOXEMM_SMU_ALM10_16_C "assigned fault type / Fault type assignment for check DFC_MOXEMM_SMU_ALM10_16" VALUE 0x804F9D54 Val_Wu8 255.0 DFES_OneToOne 0.00 255.0 FORMAT "%5.1" /end CHARACTERISTIC
/begin CHARACTERISTIC DFES_FaultTyp.DFC_MOXEMM_SMU_ALM10_17_C "assigned fault type / Fault type assignment for check DFC_MOXEMM_SMU_ALM10_17" VALUE 0x804F9D55 Val_Wu8 255.0 DFES_OneToOne 0.00 255.0 FORMAT "%5.1" /end CHARACTERISTIC
/begin CHARACTERISTIC DFES_FaultTyp.DFC_MOXEMM_SMU_ALM10_21_C "assigned fault type / Fault type assignment for check DFC_MOXEMM_SMU_ALM10_21" VALUE 0x804F9D56 Val_Wu8 255.0 DFES_OneToOne 0.00 255.0 FORMAT "%5.1" /end CHARACTERISTIC
/begin CHARACTERISTIC DFES_FaultTyp.DFC_MOXEMM_SMU_ALM11_0_C "assigned fault type / Fault type assignment for check DFC_MOXEMM_SMU_ALM11_0" VALUE 0x804F9D57 Val_Wu8 255.0 DFES_OneToOne 0.00 255.0 FORMAT "%5.1" /end CHARACTERISTIC
/begin CHARACTERISTIC DFES_FaultTyp.DFC_MOXEMM_SMU_ALM11_1_C "assigned fault type / Fault type assignment for check DFC_MOXEMM_SMU_ALM11_1" VALUE 0x804F9D58 Val_Wu8 255.0 DFES_OneToOne 0.00 255.0 FORMAT "%5.1" /end CHARACTERISTIC
/begin CHARACTERISTIC DFES_FaultTyp.DFC_MOXEMM_SMU_ALM11_2_C "assigned fault type / Fault type assignment for check DFC_MOXEMM_SMU_ALM11_2" VALUE 0x804F9D59 Val_Wu8 255.0 DFES_OneToOne 0.00 255.0 FORMAT "%5.1" /end CHARACTERISTIC
/begin CHARACTERISTIC DFES_FaultTyp.DFC_MOXEMM_SMU_ALM11_3_C "assigned fault type / Fault type assignment for check DFC_MOXEMM_SMU_ALM11_3" VALUE 0x804F9D5A Val_Wu8 255.0 DFES_OneToOne 0.00 255.0 FORMAT "%5.1" /end CHARACTERISTIC
/begin CHARACTERISTIC DFES_FaultTyp.DFC_MOXEMM_SMU_ALM11_4_C "assigned fault type / Fault type assignment for check DFC_MOXEMM_SMU_ALM11_4" VALUE 0x804F9D5B Val_Wu8 255.0 DFES_OneToOne 0.00 255.0 FORMAT "%5.1" /end CHARACTERISTIC
/begin CHARACTERISTIC DFES_FaultTyp.DFC_MOXEMM_SMU_ALM11_5_C "assigned fault type / Fault type assignment for check DFC_MOXEMM_SMU_ALM11_5" VALUE 0x804F9D5C Val_Wu8 255.0 DFES_OneToOne 0.00 255.0 FORMAT "%5.1" /end CHARACTERISTIC
/begin CHARACTERISTIC DFES_FaultTyp.DFC_MOXEMM_SMU_ALM11_8_C "assigned fault type / Fault type assignment for check DFC_MOXEMM_SMU_ALM11_8" VALUE 0x804F9D5D Val_Wu8 255.0 DFES_OneToOne 0.00 255.0 FORMAT "%5.1" /end CHARACTERISTIC
/begin CHARACTERISTIC DFES_FaultTyp.DFC_MOXEMM_SMU_ALM11_9_C "assigned fault type / Fault type assignment for check DFC_MOXEMM_SMU_ALM11_9" VALUE 0x804F9D5E Val_Wu8 255.0 DFES_OneToOne 0.00 255.0 FORMAT "%5.1" /end CHARACTERISTIC
/begin CHARACTERISTIC DFES_FaultTyp.DFC_MOXEMM_SMU_ALM1_0_C "assigned fault type / Fault type assignment for check DFC_MOXEMM_SMU_ALM1_0" VALUE 0x804F9D5F Val_Wu8 255.0 DFES_OneToOne 0.00 255.0 FORMAT "%5.1" /end CHARACTERISTIC
/begin CHARACTERISTIC DFES_FaultTyp.DFC_MOXEMM_SMU_ALM1_1_C "assigned fault type / Fault type assignment for check DFC_MOXEMM_SMU_ALM1_1" VALUE 0x804F9D60 Val_Wu8 255.0 DFES_OneToOne 0.00 255.0 FORMAT "%5.1" /end CHARACTERISTIC
/begin CHARACTERISTIC DFES_FaultTyp.DFC_MOXEMM_SMU_ALM1_10_C "assigned fault type / Fault type assignment for check DFC_MOXEMM_SMU_ALM1_10" VALUE 0x804F9D61 Val_Wu8 255.0 DFES_OneToOne 0.00 255.0 FORMAT "%5.1" /end CHARACTERISTIC
/begin CHARACTERISTIC DFES_FaultTyp.DFC_MOXEMM_SMU_ALM1_11_C "assigned fault type / Fault type assignment for check DFC_MOXEMM_SMU_ALM1_11" VALUE 0x804F9D62 Val_Wu8 255.0 DFES_OneToOne 0.00 255.0 FORMAT "%5.1" /end CHARACTERISTIC
/begin CHARACTERISTIC DFES_FaultTyp.DFC_MOXEMM_SMU_ALM1_13_C "assigned fault type / Fault type assignment for check DFC_MOXEMM_SMU_ALM1_13" VALUE 0x804F9D63 Val_Wu8 255.0 DFES_OneToOne 0.00 255.0 FORMAT "%5.1" /end CHARACTERISTIC
/begin CHARACTERISTIC DFES_FaultTyp.DFC_MOXEMM_SMU_ALM1_14_C "assigned fault type / Fault type assignment for check DFC_MOXEMM_SMU_ALM1_14" VALUE 0x804F9D64 Val_Wu8 255.0 DFES_OneToOne 0.00 255.0 FORMAT "%5.1" /end CHARACTERISTIC
/begin CHARACTERISTIC DFES_FaultTyp.DFC_MOXEMM_SMU_ALM1_2_C "assigned fault type / Fault type assignment for check DFC_MOXEMM_SMU_ALM1_2" VALUE 0x804F9D65 Val_Wu8 255.0 DFES_OneToOne 0.00 255.0 FORMAT "%5.1" /end CHARACTERISTIC
/begin CHARACTERISTIC DFES_FaultTyp.DFC_MOXEMM_SMU_ALM1_22_C "assigned fault type / Fault type assignment for check DFC_MOXEMM_SMU_ALM1_22" VALUE 0x804F9D66 Val_Wu8 255.0 DFES_OneToOne 0.00 255.0 FORMAT "%5.1" /end CHARACTERISTIC
/begin CHARACTERISTIC DFES_FaultTyp.DFC_MOXEMM_SMU_ALM1_23_C "assigned fault type / Fault type assignment for check DFC_MOXEMM_SMU_ALM1_23" VALUE 0x804F9D67 Val_Wu8 255.0 DFES_OneToOne 0.00 255.0 FORMAT "%5.1" /end CHARACTERISTIC
/begin CHARACTERISTIC DFES_FaultTyp.DFC_MOXEMM_SMU_ALM1_4_C "assigned fault type / Fault type assignment for check DFC_MOXEMM_SMU_ALM1_4" VALUE 0x804F9D68 Val_Wu8 255.0 DFES_OneToOne 0.00 255.0 FORMAT "%5.1" /end CHARACTERISTIC
/begin CHARACTERISTIC DFES_FaultTyp.DFC_MOXEMM_SMU_ALM1_5_C "assigned fault type / Fault type assignment for check DFC_MOXEMM_SMU_ALM1_5" VALUE 0x804F9D69 Val_Wu8 255.0 DFES_OneToOne 0.00 255.0 FORMAT "%5.1" /end CHARACTERISTIC
/begin CHARACTERISTIC DFES_FaultTyp.DFC_MOXEMM_SMU_ALM1_7_C "assigned fault type / Fault type assignment for check DFC_MOXEMM_SMU_ALM1_7" VALUE 0x804F9D6A Val_Wu8 255.0 DFES_OneToOne 0.00 255.0 FORMAT "%5.1" /end CHARACTERISTIC
/begin CHARACTERISTIC DFES_FaultTyp.DFC_MOXEMM_SMU_ALM1_8_C "assigned fault type / Fault type assignment for check DFC_MOXEMM_SMU_ALM1_8" VALUE 0x804F9D6B Val_Wu8 255.0 DFES_OneToOne 0.00 255.0 FORMAT "%5.1" /end CHARACTERISTIC
/begin CHARACTERISTIC DFES_FaultTyp.DFC_MOXEMM_SMU_ALM21_0_C "assigned fault type / Fault type assignment for check DFC_MOXEMM_SMU_ALM21_0" VALUE 0x804F9D6C Val_Wu8 255.0 DFES_OneToOne 0.00 255.0 FORMAT "%5.1" /end CHARACTERISTIC
/begin CHARACTERISTIC DFES_FaultTyp.DFC_MOXEMM_SMU_ALM21_16_C "assigned fault type / Fault type assignment for check DFC_MOXEMM_SMU_ALM21_16" VALUE 0x804F9D6D Val_Wu8 255.0 DFES_OneToOne 0.00 255.0 FORMAT "%5.1" /end CHARACTERISTIC
/begin CHARACTERISTIC DFES_FaultTyp.DFC_MOXEMM_SMU_ALM21_3_C "assigned fault type / Fault type assignment for check DFC_MOXEMM_SMU_ALM21_3" VALUE 0x804F9D6E Val_Wu8 255.0 DFES_OneToOne 0.00 255.0 FORMAT "%5.1" /end CHARACTERISTIC
/begin CHARACTERISTIC DFES_FaultTyp.DFC_MOXEMM_SMU_ALM2_1_C "assigned fault type / Fault type assignment for check DFC_MOXEMM_SMU_ALM2_1" VALUE 0x804F9D6F Val_Wu8 255.0 DFES_OneToOne 0.00 255.0 FORMAT "%5.1" /end CHARACTERISTIC
/begin CHARACTERISTIC DFES_FaultTyp.DFC_MOXEMM_SMU_ALM2_10_C "assigned fault type / Fault type assignment for check DFC_MOXEMM_SMU_ALM2_10" VALUE 0x804F9D70 Val_Wu8 255.0 DFES_OneToOne 0.00 255.0 FORMAT "%5.1" /end CHARACTERISTIC
/begin CHARACTERISTIC DFES_FaultTyp.DFC_MOXEMM_SMU_ALM2_11_C "assigned fault type / Fault type assignment for check DFC_MOXEMM_SMU_ALM2_11" VALUE 0x804F9D71 Val_Wu8 255.0 DFES_OneToOne 0.00 255.0 FORMAT "%5.1" /end CHARACTERISTIC
/begin CHARACTERISTIC DFES_FaultTyp.DFC_MOXEMM_SMU_ALM2_13_C "assigned fault type / Fault type assignment for check DFC_MOXEMM_SMU_ALM2_13" VALUE 0x804F9D72 Val_Wu8 255.0 DFES_OneToOne 0.00 255.0 FORMAT "%5.1" /end CHARACTERISTIC
/begin CHARACTERISTIC DFES_FaultTyp.DFC_MOXEMM_SMU_ALM2_14_C "assigned fault type / Fault type assignment for check DFC_MOXEMM_SMU_ALM2_14" VALUE 0x804F9D73 Val_Wu8 255.0 DFES_OneToOne 0.00 255.0 FORMAT "%5.1" /end CHARACTERISTIC
/begin CHARACTERISTIC DFES_FaultTyp.DFC_MOXEMM_SMU_ALM2_22_C "assigned fault type / Fault type assignment for check DFC_MOXEMM_SMU_ALM2_22" VALUE 0x804F9D74 Val_Wu8 255.0 DFES_OneToOne 0.00 255.0 FORMAT "%5.1" /end CHARACTERISTIC
/begin CHARACTERISTIC DFES_FaultTyp.DFC_MOXEMM_SMU_ALM2_23_C "assigned fault type / Fault type assignment for check DFC_MOXEMM_SMU_ALM2_23" VALUE 0x804F9D75 Val_Wu8 255.0 DFES_OneToOne 0.00 255.0 FORMAT "%5.1" /end CHARACTERISTIC
/begin CHARACTERISTIC DFES_FaultTyp.DFC_MOXEMM_SMU_ALM2_4_C "assigned fault type / Fault type assignment for check DFC_MOXEMM_SMU_ALM2_4" VALUE 0x804F9D76 Val_Wu8 255.0 DFES_OneToOne 0.00 255.0 FORMAT "%5.1" /end CHARACTERISTIC
/begin CHARACTERISTIC DFES_FaultTyp.DFC_MOXEMM_SMU_ALM2_5_C "assigned fault type / Fault type assignment for check DFC_MOXEMM_SMU_ALM2_5" VALUE 0x804F9D77 Val_Wu8 255.0 DFES_OneToOne 0.00 255.0 FORMAT "%5.1" /end CHARACTERISTIC
/begin CHARACTERISTIC DFES_FaultTyp.DFC_MOXEMM_SMU_ALM2_7_C "assigned fault type / Fault type assignment for check DFC_MOXEMM_SMU_ALM2_7" VALUE 0x804F9D78 Val_Wu8 255.0 DFES_OneToOne 0.00 255.0 FORMAT "%5.1" /end CHARACTERISTIC
/begin CHARACTERISTIC DFES_FaultTyp.DFC_MOXEMM_SMU_ALM2_8_C "assigned fault type / Fault type assignment for check DFC_MOXEMM_SMU_ALM2_8" VALUE 0x804F9D79 Val_Wu8 255.0 DFES_OneToOne 0.00 255.0 FORMAT "%5.1" /end CHARACTERISTIC
/begin CHARACTERISTIC DFES_FaultTyp.DFC_MOXEMM_SMU_ALM6_0_C "assigned fault type / Fault type assignment for check DFC_MOXEMM_SMU_ALM6_0" VALUE 0x804F9D7A Val_Wu8 255.0 DFES_OneToOne 0.00 255.0 FORMAT "%5.1" /end CHARACTERISTIC
/begin CHARACTERISTIC DFES_FaultTyp.DFC_MOXEMM_SMU_ALM6_11_C "assigned fault type / Fault type assignment for check DFC_MOXEMM_SMU_ALM6_11" VALUE 0x804F9D7B Val_Wu8 255.0 DFES_OneToOne 0.00 255.0 FORMAT "%5.1" /end CHARACTERISTIC
/begin CHARACTERISTIC DFES_FaultTyp.DFC_MOXEMM_SMU_ALM6_12_C "assigned fault type / Fault type assignment for check DFC_MOXEMM_SMU_ALM6_12" VALUE 0x804F9D7C Val_Wu8 255.0 DFES_OneToOne 0.00 255.0 FORMAT "%5.1" /end CHARACTERISTIC
/begin CHARACTERISTIC DFES_FaultTyp.DFC_MOXEMM_SMU_ALM6_14_C "assigned fault type / Fault type assignment for check DFC_MOXEMM_SMU_ALM6_14" VALUE 0x804F9D7D Val_Wu8 255.0 DFES_OneToOne 0.00 255.0 FORMAT "%5.1" /end CHARACTERISTIC
/begin CHARACTERISTIC DFES_FaultTyp.DFC_MOXEMM_SMU_ALM6_15_C "assigned fault type / Fault type assignment for check DFC_MOXEMM_SMU_ALM6_15" VALUE 0x804F9D7E Val_Wu8 255.0 DFES_OneToOne 0.00 255.0 FORMAT "%5.1" /end CHARACTERISTIC
/begin CHARACTERISTIC DFES_FaultTyp.DFC_MOXEMM_SMU_ALM6_17_C "assigned fault type / Fault type assignment for check DFC_MOXEMM_SMU_ALM6_17" VALUE 0x804F9D7F Val_Wu8 255.0 DFES_OneToOne 0.00 255.0 FORMAT "%5.1" /end CHARACTERISTIC
/begin CHARACTERISTIC DFES_FaultTyp.DFC_MOXEMM_SMU_ALM6_18_C "assigned fault type / Fault type assignment for check DFC_MOXEMM_SMU_ALM6_18" VALUE 0x804F9D80 Val_Wu8 255.0 DFES_OneToOne 0.00 255.0 FORMAT "%5.1" /end CHARACTERISTIC
/begin CHARACTERISTIC DFES_FaultTyp.DFC_MOXEMM_SMU_ALM6_20_C "assigned fault type / Fault type assignment for check DFC_MOXEMM_SMU_ALM6_20" VALUE 0x804F9D81 Val_Wu8 255.0 DFES_OneToOne 0.00 255.0 FORMAT "%5.1" /end CHARACTERISTIC
/begin CHARACTERISTIC DFES_FaultTyp.DFC_MOXEMM_SMU_ALM6_21_C "assigned fault type / Fault type assignment for check DFC_MOXEMM_SMU_ALM6_21" VALUE 0x804F9D82 Val_Wu8 255.0 DFES_OneToOne 0.00 255.0 FORMAT "%5.1" /end CHARACTERISTIC
/begin CHARACTERISTIC DFES_FaultTyp.DFC_MOXEMM_SMU_ALM6_25_C "assigned fault type / Fault type assignment for check DFC_MOXEMM_SMU_ALM6_25" VALUE 0x804F9D83 Val_Wu8 255.0 DFES_OneToOne 0.00 255.0 FORMAT "%5.1" /end CHARACTERISTIC
/begin CHARACTERISTIC DFES_FaultTyp.DFC_MOXEMM_SMU_ALM6_4_C "assigned fault type / Fault type assignment for check DFC_MOXEMM_SMU_ALM6_4" VALUE 0x804F9D84 Val_Wu8 255.0 DFES_OneToOne 0.00 255.0 FORMAT "%5.1" /end CHARACTERISTIC
/begin CHARACTERISTIC DFES_FaultTyp.DFC_MOXEMM_SMU_ALM6_5_C "assigned fault type / Fault type assignment for check DFC_MOXEMM_SMU_ALM6_5" VALUE 0x804F9D85 Val_Wu8 255.0 DFES_OneToOne 0.00 255.0 FORMAT "%5.1" /end CHARACTERISTIC
/begin CHARACTERISTIC DFES_FaultTyp.DFC_MOXEMM_SMU_ALM6_7_C "assigned fault type / Fault type assignment for check DFC_MOXEMM_SMU_ALM6_7" VALUE 0x804F9D86 Val_Wu8 255.0 DFES_OneToOne 0.00 255.0 FORMAT "%5.1" /end CHARACTERISTIC
/begin CHARACTERISTIC DFES_FaultTyp.DFC_MOXEMM_SMU_ALM6_8_C "assigned fault type / Fault type assignment for check DFC_MOXEMM_SMU_ALM6_8" VALUE 0x804F9D87 Val_Wu8 255.0 DFES_OneToOne 0.00 255.0 FORMAT "%5.1" /end CHARACTERISTIC
/begin CHARACTERISTIC DFES_FaultTyp.DFC_MOXEMM_SMU_ALM7_1_C "assigned fault type / Fault type assignment for check DFC_MOXEMM_SMU_ALM7_1" VALUE 0x804F9D88 Val_Wu8 255.0 DFES_OneToOne 0.00 255.0 FORMAT "%5.1" /end CHARACTERISTIC
/begin CHARACTERISTIC DFES_FaultTyp.DFC_MOXEMM_SMU_ALM7_12_C "assigned fault type / Fault type assignment for check DFC_MOXEMM_SMU_ALM7_12" VALUE 0x804F9D89 Val_Wu8 255.0 DFES_OneToOne 0.00 255.0 FORMAT "%5.1" /end CHARACTERISTIC
/begin CHARACTERISTIC DFES_FaultTyp.DFC_MOXEMM_SMU_ALM7_13_C "assigned fault type / Fault type assignment for check DFC_MOXEMM_SMU_ALM7_13" VALUE 0x804F9D8A Val_Wu8 255.0 DFES_OneToOne 0.00 255.0 FORMAT "%5.1" /end CHARACTERISTIC
/begin CHARACTERISTIC DFES_FaultTyp.DFC_MOXEMM_SMU_ALM7_14_C "assigned fault type / Fault type assignment for check DFC_MOXEMM_SMU_ALM7_14" VALUE 0x804F9D8B Val_Wu8 255.0 DFES_OneToOne 0.00 255.0 FORMAT "%5.1" /end CHARACTERISTIC
/begin CHARACTERISTIC DFES_FaultTyp.DFC_MOXEMM_SMU_ALM7_15_C "assigned fault type / Fault type assignment for check DFC_MOXEMM_SMU_ALM7_15" VALUE 0x804F9D8C Val_Wu8 255.0 DFES_OneToOne 0.00 255.0 FORMAT "%5.1" /end CHARACTERISTIC
/begin CHARACTERISTIC DFES_FaultTyp.DFC_MOXEMM_SMU_ALM7_16_C "assigned fault type / Fault type assignment for check DFC_MOXEMM_SMU_ALM7_16" VALUE 0x804F9D8D Val_Wu8 255.0 DFES_OneToOne 0.00 255.0 FORMAT "%5.1" /end CHARACTERISTIC
/begin CHARACTERISTIC DFES_FaultTyp.DFC_MOXEMM_SMU_ALM7_17_C "assigned fault type / Fault type assignment for check DFC_MOXEMM_SMU_ALM7_17" VALUE 0x804F9D8E Val_Wu8 255.0 DFES_OneToOne 0.00 255.0 FORMAT "%5.1" /end CHARACTERISTIC
/begin CHARACTERISTIC DFES_FaultTyp.DFC_MOXEMM_SMU_ALM7_2_C "assigned fault type / Fault type assignment for check DFC_MOXEMM_SMU_ALM7_2" VALUE 0x804F9D8F Val_Wu8 255.0 DFES_OneToOne 0.00 255.0 FORMAT "%5.1" /end CHARACTERISTIC
/begin CHARACTERISTIC DFES_FaultTyp.DFC_MOXEMM_SMU_ALM7_20_C "assigned fault type / Fault type assignment for check DFC_MOXEMM_SMU_ALM7_20" VALUE 0x804F9D90 Val_Wu8 255.0 DFES_OneToOne 0.00 255.0 FORMAT "%5.1" /end CHARACTERISTIC
/begin CHARACTERISTIC DFES_FaultTyp.DFC_MOXEMM_SMU_ALM7_25_C "assigned fault type / Fault type assignment for check DFC_MOXEMM_SMU_ALM7_25" VALUE 0x804F9D91 Val_Wu8 255.0 DFES_OneToOne 0.00 255.0 FORMAT "%5.1" /end CHARACTERISTIC
/begin CHARACTERISTIC DFES_FaultTyp.DFC_MOXEMM_SMU_ALM7_26_C "assigned fault type / Fault type assignment for check DFC_MOXEMM_SMU_ALM7_26" VALUE 0x804F9D92 Val_Wu8 255.0 DFES_OneToOne 0.00 255.0 FORMAT "%5.1" /end CHARACTERISTIC
/begin CHARACTERISTIC DFES_FaultTyp.DFC_MOXEMM_SMU_ALM7_28_C "assigned fault type / Fault type assignment for check DFC_MOXEMM_SMU_ALM7_28" VALUE 0x804F9D93 Val_Wu8 255.0 DFES_OneToOne 0.00 255.0 FORMAT "%5.1" /end CHARACTERISTIC
/begin CHARACTERISTIC DFES_FaultTyp.DFC_MOXEMM_SMU_ALM7_29_C "assigned fault type / Fault type assignment for check DFC_MOXEMM_SMU_ALM7_29" VALUE 0x804F9D94 Val_Wu8 255.0 DFES_OneToOne 0.00 255.0 FORMAT "%5.1" /end CHARACTERISTIC
/begin CHARACTERISTIC DFES_FaultTyp.DFC_MOXEMM_SMU_ALM7_30_C "assigned fault type / Fault type assignment for check DFC_MOXEMM_SMU_ALM7_30" VALUE 0x804F9D95 Val_Wu8 255.0 DFES_OneToOne 0.00 255.0 FORMAT "%5.1" /end CHARACTERISTIC
/begin CHARACTERISTIC DFES_FaultTyp.DFC_MOXEMM_SMU_ALM7_31_C "assigned fault type / Fault type assignment for check DFC_MOXEMM_SMU_ALM7_31" VALUE 0x804F9D96 Val_Wu8 255.0 DFES_OneToOne 0.00 255.0 FORMAT "%5.1" /end CHARACTERISTIC
/begin CHARACTERISTIC DFES_FaultTyp.DFC_MOXEMM_SMU_ALM8_0_C "assigned fault type / Fault type assignment for check DFC_MOXEMM_SMU_ALM8_0" VALUE 0x804F9D97 Val_Wu8 255.0 DFES_OneToOne 0.00 255.0 FORMAT "%5.1" /end CHARACTERISTIC
/begin CHARACTERISTIC DFES_FaultTyp.DFC_MOXEMM_SMU_ALM8_1_C "assigned fault type / Fault type assignment for check DFC_MOXEMM_SMU_ALM8_1" VALUE 0x804F9D98 Val_Wu8 255.0 DFES_OneToOne 0.00 255.0 FORMAT "%5.1" /end CHARACTERISTIC
/begin CHARACTERISTIC DFES_FaultTyp.DFC_MOXEMM_SMU_ALM8_10_C "assigned fault type / Fault type assignment for check DFC_MOXEMM_SMU_ALM8_10" VALUE 0x804F9D99 Val_Wu8 255.0 DFES_OneToOne 0.00 255.0 FORMAT "%5.1" /end CHARACTERISTIC
/begin CHARACTERISTIC DFES_FaultTyp.DFC_MOXEMM_SMU_ALM8_11_C "assigned fault type / Fault type assignment for check DFC_MOXEMM_SMU_ALM8_11" VALUE 0x804F9D9A Val_Wu8 255.0 DFES_OneToOne 0.00 255.0 FORMAT "%5.1" /end CHARACTERISTIC
/begin CHARACTERISTIC DFES_FaultTyp.DFC_MOXEMM_SMU_ALM8_12_C "assigned fault type / Fault type assignment for check DFC_MOXEMM_SMU_ALM8_12" VALUE 0x804F9D9B Val_Wu8 255.0 DFES_OneToOne 0.00 255.0 FORMAT "%5.1" /end CHARACTERISTIC
/begin CHARACTERISTIC DFES_FaultTyp.DFC_MOXEMM_SMU_ALM8_16_C "assigned fault type / Fault type assignment for check DFC_MOXEMM_SMU_ALM8_16" VALUE 0x804F9D9C Val_Wu8 255.0 DFES_OneToOne 0.00 255.0 FORMAT "%5.1" /end CHARACTERISTIC
/begin CHARACTERISTIC DFES_FaultTyp.DFC_MOXEMM_SMU_ALM8_18_C "assigned fault type / Fault type assignment for check DFC_MOXEMM_SMU_ALM8_18" VALUE 0x804F9D9D Val_Wu8 255.0 DFES_OneToOne 0.00 255.0 FORMAT "%5.1" /end CHARACTERISTIC
/begin CHARACTERISTIC DFES_FaultTyp.DFC_MOXEMM_SMU_ALM8_2_C "assigned fault type / Fault type assignment for check DFC_MOXEMM_SMU_ALM8_2" VALUE 0x804F9D9E Val_Wu8 255.0 DFES_OneToOne 0.00 255.0 FORMAT "%5.1" /end CHARACTERISTIC
/begin CHARACTERISTIC DFES_FaultTyp.DFC_MOXEMM_SMU_ALM8_3_C "assigned fault type / Fault type assignment for check DFC_MOXEMM_SMU_ALM8_3" VALUE 0x804F9D9F Val_Wu8 255.0 DFES_OneToOne 0.00 255.0 FORMAT "%5.1" /end CHARACTERISTIC
/begin CHARACTERISTIC DFES_FaultTyp.DFC_MOXEMM_SMU_ALM8_31_C "assigned fault type / Fault type assignment for check DFC_MOXEMM_SMU_ALM8_31" VALUE 0x804F9DA0 Val_Wu8 255.0 DFES_OneToOne 0.00 255.0 FORMAT "%5.1" /end CHARACTERISTIC
/begin CHARACTERISTIC DFES_FaultTyp.DFC_MOXEMM_SMU_ALM8_4_C "assigned fault type / Fault type assignment for check DFC_MOXEMM_SMU_ALM8_4" VALUE 0x804F9DA1 Val_Wu8 255.0 DFES_OneToOne 0.00 255.0 FORMAT "%5.1" /end CHARACTERISTIC
/begin CHARACTERISTIC DFES_FaultTyp.DFC_MOXEMM_SMU_ALM9_0_C "assigned fault type / Fault type assignment for check DFC_MOXEMM_SMU_ALM9_0" VALUE 0x804F9DA2 Val_Wu8 255.0 DFES_OneToOne 0.00 255.0 FORMAT "%5.1" /end CHARACTERISTIC
/begin CHARACTERISTIC DFES_FaultTyp.DFC_MOXEMM_SMU_ALM9_15_C "assigned fault type / Fault type assignment for check DFC_MOXEMM_SMU_ALM9_15" VALUE 0x804F9DA3 Val_Wu8 255.0 DFES_OneToOne 0.00 255.0 FORMAT "%5.1" /end CHARACTERISTIC
/begin CHARACTERISTIC DFES_FaultTyp.DFC_MOXEMM_SMU_ALM9_3_C "assigned fault type / Fault type assignment for check DFC_MOXEMM_SMU_ALM9_3" VALUE 0x804F9DA4 Val_Wu8 255.0 DFES_OneToOne 0.00 255.0 FORMAT "%5.1" /end CHARACTERISTIC
/begin CHARACTERISTIC DFES_FaultTyp.DFC_MoCADCNTP_C "assigned fault type / Fault type assignment for check DFC_MoCADCNTP" VALUE 0x804F9DA5 Val_Wu8 255.0 DFES_OneToOne 0.00 255.0 FORMAT "%5.1" /end CHARACTERISTIC
/begin CHARACTERISTIC DFES_FaultTyp.DFC_MoCADCTst_C "assigned fault type / Fault type assignment for check DFC_MoCADCTst" VALUE 0x804F9DA6 Val_Wu8 255.0 DFES_OneToOne 0.00 255.0 FORMAT "%5.1" /end CHARACTERISTIC
/begin CHARACTERISTIC DFES_FaultTyp.DFC_MoCSOPICO_C "assigned fault type / Fault type assignment for check DFC_MoCSOPICO" VALUE 0x804F9DA7 Val_Wu8 255.0 DFES_OneToOne 0.00 255.0 FORMAT "%5.1" /end CHARACTERISTIC
/begin CHARACTERISTIC DFES_FaultTyp.DFC_MoFAPP_C "assigned fault type / Fault type assignment for check DFC_MoFAPP" VALUE 0x804F9DA8 Val_Wu8 255.0 DFES_OneToOne 0.00 255.0 FORMAT "%5.1" /end CHARACTERISTIC
/begin CHARACTERISTIC DFES_FaultTyp.DFC_MoFAirFilgPrdc_C "assigned fault type / Fault type assignment for check DFC_MoFAirFilgPrdc" VALUE 0x804F9DA9 Val_Wu8 255.0 DFES_OneToOne 0.00 255.0 FORMAT "%5.1" /end CHARACTERISTIC
/begin CHARACTERISTIC DFES_FaultTyp.DFC_MoFAirFlCtOffPfi_C "assigned fault type / Fault type assignment for check DFC_MoFAirFlCtOffPfi" VALUE 0x804F9DAA Val_Wu8 255.0 DFES_OneToOne 0.00 255.0 FORMAT "%5.1" /end CHARACTERISTIC
/begin CHARACTERISTIC DFES_FaultTyp.DFC_MoFAirFlCylPfi_C "assigned fault type / Fault type assignment for check DFC_MoFAirFlCylPfi" VALUE 0x804F9DAB Val_Wu8 255.0 DFES_OneToOne 0.00 255.0 FORMAT "%5.1" /end CHARACTERISTIC
/begin CHARACTERISTIC DFES_FaultTyp.DFC_MoFAirFlIn_C "assigned fault type / Fault type assignment for check DFC_MoFAirFlIn" VALUE 0x804F9DAC Val_Wu8 255.0 DFES_OneToOne 0.00 255.0 FORMAT "%5.1" /end CHARACTERISTIC
/begin CHARACTERISTIC DFES_FaultTyp.DFC_MoFAirFlMixCtlPfiChkAirFl_C "assigned fault type / Fault type assignment for check DFC_MoFAirFlMixCtlPfiChkAirFl" VALUE 0x804F9DAD Val_Wu8 255.0 DFES_OneToOne 0.00 255.0 FORMAT "%5.1" /end CHARACTERISTIC
/begin CHARACTERISTIC DFES_FaultTyp.DFC_MoFAirFlMixCtlPfiChkCtrl_C "assigned fault type / Fault type assignment for check DFC_MoFAirFlMixCtlPfiChkCtrl" VALUE 0x804F9DAE Val_Wu8 255.0 DFES_OneToOne 0.00 255.0 FORMAT "%5.1" /end CHARACTERISTIC
/begin CHARACTERISTIC DFES_FaultTyp.DFC_MoFAirFlMode_C "assigned fault type / Fault type assignment for check DFC_MoFAirFlMode" VALUE 0x804F9DAF Val_Wu8 255.0 DFES_OneToOne 0.00 255.0 FORMAT "%5.1" /end CHARACTERISTIC
/begin CHARACTERISTIC DFES_FaultTyp.DFC_MoFESpd_C "assigned fault type / Fault type assignment for check DFC_MoFESpd" VALUE 0x804F9DB0 Val_Wu8 255.0 DFES_OneToOne 0.00 255.0 FORMAT "%5.1" /end CHARACTERISTIC
/begin CHARACTERISTIC DFES_FaultTyp.DFC_MoFIACo_C "assigned fault type / Fault type assignment for check DFC_MoFIACo" VALUE 0x804F9DB1 Val_Wu8 255.0 DFES_OneToOne 0.00 255.0 FORMAT "%5.1" /end CHARACTERISTIC
/begin CHARACTERISTIC DFES_FaultTyp.DFC_MoFICOL1_C "assigned fault type / Fault type assignment for check DFC_MoFICOL1" VALUE 0x804F9DB2 Val_Wu8 255.0 DFES_OneToOne 0.00 255.0 FORMAT "%5.1" /end CHARACTERISTIC
/begin CHARACTERISTIC DFES_FaultTyp.DFC_MoFICOL2_C "assigned fault type / Fault type assignment for check DFC_MoFICOL2" VALUE 0x804F9DB3 Val_Wu8 255.0 DFES_OneToOne 0.00 255.0 FORMAT "%5.1" /end CHARACTERISTIC
/begin CHARACTERISTIC DFES_FaultTyp.DFC_MoFStrt_C "assigned fault type / Fault type assignment for check DFC_MoFStrt" VALUE 0x804F9DB4 Val_Wu8 255.0 DFES_OneToOne 0.00 255.0 FORMAT "%5.1" /end CHARACTERISTIC
/begin CHARACTERISTIC DFES_FaultTyp.DFC_MoFTrqCmp_C "assigned fault type / Fault type assignment for check DFC_MoFTrqCmp" VALUE 0x804F9DB5 Val_Wu8 255.0 DFES_OneToOne 0.00 255.0 FORMAT "%5.1" /end CHARACTERISTIC
/begin CHARACTERISTIC DFES_FaultTyp.DFC_MoFTrqCmpMax_C "assigned fault type / Fault type assignment for check DFC_MoFTrqCmpMax" VALUE 0x804F9DB6 Val_Wu8 255.0 DFES_OneToOne 0.00 255.0 FORMAT "%5.1" /end CHARACTERISTIC
/begin CHARACTERISTIC DFES_FaultTyp.DFC_MoFTrqCmpMin_C "assigned fault type / Fault type assignment for check DFC_MoFTrqCmpMin" VALUE 0x804F9DB7 Val_Wu8 255.0 DFES_OneToOne 0.00 255.0 FORMAT "%5.1" /end CHARACTERISTIC
/begin CHARACTERISTIC DFES_FaultTyp.DFC_MoFVarPostBldSel_C "assigned fault type / Fault type assignment for check DFC_MoFVarPostBldSel" VALUE 0x804F9DB8 Val_Wu8 255.0 DFES_OneToOne 0.00 255.0 FORMAT "%5.1" /end CHARACTERISTIC
/begin CHARACTERISTIC DFES_FaultTyp.DFC_MoXEMMHwLTMCUFW_C "assigned fault type / Fault type assignment for check DFC_MoXEMMHwLTMCUFW" VALUE 0x804F9DB9 Val_Wu8 255.0 DFES_OneToOne 0.00 255.0 FORMAT "%5.1" /end CHARACTERISTIC
/begin CHARACTERISTIC DFES_FaultTyp.DFC_MoXEMMHwLTMonBIST_C "assigned fault type / Fault type assignment for check DFC_MoXEMMHwLTMonBIST" VALUE 0x804F9DBA Val_Wu8 255.0 DFES_OneToOne 0.00 255.0 FORMAT "%5.1" /end CHARACTERISTIC
/begin CHARACTERISTIC DFES_FaultTyp.DFC_MoXEMMHwLTRegMonTest_C "assigned fault type / Fault type assignment for check DFC_MoXEMMHwLTRegMonTest" VALUE 0x804F9DBB Val_Wu8 255.0 DFES_OneToOne 0.00 255.0 FORMAT "%5.1" /end CHARACTERISTIC
/begin CHARACTERISTIC DFES_FaultTyp.DFC_MoXEMMHwLTStbySMUAlvTest_C "assigned fault type / Fault type assignment for check DFC_MoXEMMHwLTStbySMUAlvTest" VALUE 0x804F9DBC Val_Wu8 255.0 DFES_OneToOne 0.00 255.0 FORMAT "%5.1" /end CHARACTERISTIC
/begin CHARACTERISTIC DFES_FaultTyp.DFC_MoXEMMHwLTTempSens_C "assigned fault type / Fault type assignment for check DFC_MoXEMMHwLTTempSens" VALUE 0x804F9DBD Val_Wu8 255.0 DFES_OneToOne 0.00 255.0 FORMAT "%5.1" /end CHARACTERISTIC
/begin CHARACTERISTIC DFES_FaultTyp.DFC_MoXEMMHwLTUCBCfg_C "assigned fault type / Fault type assignment for check DFC_MoXEMMHwLTUCBCfg" VALUE 0x804F9DBE Val_Wu8 255.0 DFES_OneToOne 0.00 255.0 FORMAT "%5.1" /end CHARACTERISTIC
/begin CHARACTERISTIC DFES_FaultTyp.DFC_OCWDAABEActv_C "assigned fault type / Fault type assignment for check DFC_OCWDAABEActv" VALUE 0x804F9DBF Val_Wu8 255.0 DFES_OneToOne 0.00 255.0 FORMAT "%5.1" /end CHARACTERISTIC
/begin CHARACTERISTIC DFES_FaultTyp.DFC_OCWDACom_C "assigned fault type / Fault type assignment for check DFC_OCWDACom" VALUE 0x804F9DC0 Val_Wu8 255.0 DFES_OneToOne 0.00 255.0 FORMAT "%5.1" /end CHARACTERISTIC
/begin CHARACTERISTIC DFES_FaultTyp.DFC_OCWDAErrPin_C "assigned fault type / Fault type assignment for check DFC_OCWDAErrPin" VALUE 0x804F9DC1 Val_Wu8 255.0 DFES_OneToOne 0.00 255.0 FORMAT "%5.1" /end CHARACTERISTIC
/begin CHARACTERISTIC DFES_FaultTyp.DFC_OCWDAOvrVltg_C "assigned fault type / Fault type assignment for check DFC_OCWDAOvrVltg" VALUE 0x804F9DC2 Val_Wu8 255.0 DFES_OneToOne 0.00 255.0 FORMAT "%5.1" /end CHARACTERISTIC
/begin CHARACTERISTIC DFES_FaultTyp.DFC_ORAmax_C "assigned fault type / Fault type assignment for check DFC_ORAmax" VALUE 0x804F9DC3 Val_Wu8 255.0 DFES_OneToOne 0.00 255.0 FORMAT "%5.1" /end CHARACTERISTIC
/begin CHARACTERISTIC DFES_FaultTyp.DFC_ORAmin_C "assigned fault type / Fault type assignment for check DFC_ORAmin" VALUE 0x804F9DC4 Val_Wu8 255.0 DFES_OneToOne 0.00 255.0 FORMAT "%5.1" /end CHARACTERISTIC
/begin CHARACTERISTIC DFES_FaultTyp.DFC_PLLSUmax_C "assigned fault type / Fault type assignment for check DFC_PLLSUmax" VALUE 0x804F9DC5 Val_Wu8 255.0 DFES_OneToOne 0.00 255.0 FORMAT "%5.1" /end CHARACTERISTIC
/begin CHARACTERISTIC DFES_FaultTyp.DFC_PLLSUmin_C "assigned fault type / Fault type assignment for check DFC_PLLSUmin" VALUE 0x804F9DC6 Val_Wu8 255.0 DFES_OneToOne 0.00 255.0 FORMAT "%5.1" /end CHARACTERISTIC
/begin CHARACTERISTIC DFES_FaultTyp.DFC_PSR1max_C "assigned fault type / Fault type assignment for check DFC_PSR1max" VALUE 0x804F9DC7 Val_Wu8 255.0 DFES_OneToOne 0.00 255.0 FORMAT "%5.1" /end CHARACTERISTIC
/begin CHARACTERISTIC DFES_FaultTyp.DFC_PSRBmax_C "assigned fault type / Fault type assignment for check DFC_PSRBmax" VALUE 0x804F9DC8 Val_Wu8 255.0 DFES_OneToOne 0.00 255.0 FORMAT "%5.1" /end CHARACTERISTIC
/begin CHARACTERISTIC DFES_FaultTyp.DFC_PSRBmin_C "assigned fault type / Fault type assignment for check DFC_PSRBmin" VALUE 0x804F9DC9 Val_Wu8 255.0 DFES_OneToOne 0.00 255.0 FORMAT "%5.1" /end CHARACTERISTIC
/begin CHARACTERISTIC DFES_FaultTyp.DFC_PSRPmax_C "assigned fault type / Fault type assignment for check DFC_PSRPmax" VALUE 0x804F9DCA Val_Wu8 255.0 DFES_OneToOne 0.00 255.0 FORMAT "%5.1" /end CHARACTERISTIC
/begin CHARACTERISTIC DFES_FaultTyp.DFC_PSRPmin_C "assigned fault type / Fault type assignment for check DFC_PSRPmin" VALUE 0x804F9DCB Val_Wu8 255.0 DFES_OneToOne 0.00 255.0 FORMAT "%5.1" /end CHARACTERISTIC
/begin CHARACTERISTIC DFES_FaultTyp.DFC_PSRPsig_C "assigned fault type / Fault type assignment for check DFC_PSRPsig" VALUE 0x804F9DCC Val_Wu8 255.0 DFES_OneToOne 0.00 255.0 FORMAT "%5.1" /end CHARACTERISTIC
/begin CHARACTERISTIC DFES_FaultTyp.DFC_PSRmax_C "assigned fault type / Fault type assignment for check DFC_PSRmax" VALUE 0x804F9DCD Val_Wu8 255.0 DFES_OneToOne 0.00 255.0 FORMAT "%5.1" /end CHARACTERISTIC
/begin CHARACTERISTIC DFES_FaultTyp.DFC_PUmax_C "assigned fault type / Fault type assignment for check DFC_PUmax" VALUE 0x804F9DCE Val_Wu8 255.0 DFES_OneToOne 0.00 255.0 FORMAT "%5.1" /end CHARACTERISTIC
/begin CHARACTERISTIC DFES_FaultTyp.DFC_P_VSE11_OL_C "assigned fault type / Fault type assignment for check DFC_P_VSE11_OL" VALUE 0x804F9DCF Val_Wu8 255.0 DFES_OneToOne 0.00 255.0 FORMAT "%5.1" /end CHARACTERISTIC
/begin CHARACTERISTIC DFES_FaultTyp.DFC_P_VSE11_SCB_C "assigned fault type / Fault type assignment for check DFC_P_VSE11_SCB" VALUE 0x804F9DD0 Val_Wu8 255.0 DFES_OneToOne 0.00 255.0 FORMAT "%5.1" /end CHARACTERISTIC
/begin CHARACTERISTIC DFES_FaultTyp.DFC_P_VSE11_SCG_C "assigned fault type / Fault type assignment for check DFC_P_VSE11_SCG" VALUE 0x804F9DD1 Val_Wu8 255.0 DFES_OneToOne 0.00 255.0 FORMAT "%5.1" /end CHARACTERISTIC
/begin CHARACTERISTIC DFES_FaultTyp.DFC_PhyHighAPP1_C "assigned fault type / Fault type assignment for check DFC_PhyHighAPP1" VALUE 0x804F9DD2 Val_Wu8 255.0 DFES_OneToOne 0.00 255.0 FORMAT "%5.1" /end CHARACTERISTIC
/begin CHARACTERISTIC DFES_FaultTyp.DFC_PhyHighAPP2_C "assigned fault type / Fault type assignment for check DFC_PhyHighAPP2" VALUE 0x804F9DD3 Val_Wu8 255.0 DFES_OneToOne 0.00 255.0 FORMAT "%5.1" /end CHARACTERISTIC
/begin CHARACTERISTIC DFES_FaultTyp.DFC_PhyLowAPP1_C "assigned fault type / Fault type assignment for check DFC_PhyLowAPP1" VALUE 0x804F9DD4 Val_Wu8 255.0 DFES_OneToOne 0.00 255.0 FORMAT "%5.1" /end CHARACTERISTIC
/begin CHARACTERISTIC DFES_FaultTyp.DFC_PhyLowAPP2_C "assigned fault type / Fault type assignment for check DFC_PhyLowAPP2" VALUE 0x804F9DD5 Val_Wu8 255.0 DFES_OneToOne 0.00 255.0 FORMAT "%5.1" /end CHARACTERISTIC
/begin CHARACTERISTIC DFES_FaultTyp.DFC_SRCHighAPP1_C "assigned fault type / Fault type assignment for check DFC_SRCHighAPP1" VALUE 0x804F9DD6 Val_Wu8 255.0 DFES_OneToOne 0.00 255.0 FORMAT "%5.1" /end CHARACTERISTIC
/begin CHARACTERISTIC DFES_FaultTyp.DFC_SRCHighAPP2_C "assigned fault type / Fault type assignment for check DFC_SRCHighAPP2" VALUE 0x804F9DD7 Val_Wu8 255.0 DFES_OneToOne 0.00 255.0 FORMAT "%5.1" /end CHARACTERISTIC
/begin CHARACTERISTIC DFES_FaultTyp.DFC_SRCLowAPP1_C "assigned fault type / Fault type assignment for check DFC_SRCLowAPP1" VALUE 0x804F9DD8 Val_Wu8 255.0 DFES_OneToOne 0.00 255.0 FORMAT "%5.1" /end CHARACTERISTIC
/begin CHARACTERISTIC DFES_FaultTyp.DFC_SRCLowAPP2_C "assigned fault type / Fault type assignment for check DFC_SRCLowAPP2" VALUE 0x804F9DD9 Val_Wu8 255.0 DFES_OneToOne 0.00 255.0 FORMAT "%5.1" /end CHARACTERISTIC
/begin CHARACTERISTIC DFES_FaultTyp.DFC_SSpMon2_C "assigned fault type / Fault type assignment for check DFC_SSpMon2" VALUE 0x804F9DDA Val_Wu8 255.0 DFES_OneToOne 0.00 255.0 FORMAT "%5.1" /end CHARACTERISTIC
/begin CHARACTERISTIC DFES_FaultTyp.DFC_SWReset_0_C "assigned fault type / Fault type assignment for check DFC_SWReset_0" VALUE 0x804F9DDB Val_Wu8 255.0 DFES_OneToOne 0.00 255.0 FORMAT "%5.1" /end CHARACTERISTIC
/begin CHARACTERISTIC DFES_FaultTyp.DFC_SWReset_1_C "assigned fault type / Fault type assignment for check DFC_SWReset_1" VALUE 0x804F9DDC Val_Wu8 255.0 DFES_OneToOne 0.00 255.0 FORMAT "%5.1" /end CHARACTERISTIC
/begin CHARACTERISTIC DFES_FaultTyp.DFC_SWReset_2_C "assigned fault type / Fault type assignment for check DFC_SWReset_2" VALUE 0x804F9DDD Val_Wu8 255.0 DFES_OneToOne 0.00 255.0 FORMAT "%5.1" /end CHARACTERISTIC
/begin CHARACTERISTIC DFES_FaultTyp.DFC_SyncAPP_C "assigned fault type / Fault type assignment for check DFC_SyncAPP" VALUE 0x804F9DDE Val_Wu8 255.0 DFES_OneToOne 0.00 255.0 FORMAT "%5.1" /end CHARACTERISTIC
/begin CHARACTERISTIC DFES_FaultTyp.DFC_TAmax_Dummy_C "assigned fault type / Fault type assignment for check DFC_TAmax_Dummy" VALUE 0x804F9DDF Val_Wu8 255.0 DFES_OneToOne 0.00 255.0 FORMAT "%5.1" /end CHARACTERISTIC
/begin CHARACTERISTIC DFES_FaultTyp.DFC_TKAEmax_C "assigned fault type / Fault type assignment for check DFC_TKAEmax" VALUE 0x804F9DE0 Val_Wu8 255.0 DFES_OneToOne 0.00 255.0 FORMAT "%5.1" /end CHARACTERISTIC
/begin CHARACTERISTIC DFES_FaultTyp.DFC_TKAEmin_C "assigned fault type / Fault type assignment for check DFC_TKAEmin" VALUE 0x804F9DE1 Val_Wu8 255.0 DFES_OneToOne 0.00 255.0 FORMAT "%5.1" /end CHARACTERISTIC
/begin CHARACTERISTIC DFES_FaultTyp.DFC_TKARmax_C "assigned fault type / Fault type assignment for check DFC_TKARmax" VALUE 0x804F9DE2 Val_Wu8 255.0 DFES_OneToOne 0.00 255.0 FORMAT "%5.1" /end CHARACTERISTIC
/begin CHARACTERISTIC DFES_FaultTyp.DFC_TKARnpl_C "assigned fault type / Fault type assignment for check DFC_TKARnpl" VALUE 0x804F9DE3 Val_Wu8 255.0 DFES_OneToOne 0.00 255.0 FORMAT "%5.1" /end CHARACTERISTIC
/begin CHARACTERISTIC DFES_FaultTyp.DFC_TMmax_Dummy_C "assigned fault type / Fault type assignment for check DFC_TMmax_Dummy" VALUE 0x804F9DE4 Val_Wu8 255.0 DFES_OneToOne 0.00 255.0 FORMAT "%5.1" /end CHARACTERISTIC
/begin CHARACTERISTIC DFES_FaultTyp.DFC_TUMmax_Dummy_C "assigned fault type / Fault type assignment for check DFC_TUMmax_Dummy" VALUE 0x804F9DE5 Val_Wu8 255.0 DFES_OneToOne 0.00 255.0 FORMAT "%5.1" /end CHARACTERISTIC
/begin CHARACTERISTIC DFES_FaultTyp.DFC_TWCDPriCatB1_C "assigned fault type / Fault type assignment for check DFC_TWCDPriCatB1" VALUE 0x804F9DE6 Val_Wu8 255.0 DFES_OneToOne 0.00 255.0 FORMAT "%5.1" /end CHARACTERISTIC
/begin CHARACTERISTIC DFES_FaultTyp.DFC_ThrVlvClsdPosnFirstOffsLrnImpoB1_C "assigned fault type / Fault type assignment for check DFC_ThrVlvClsdPosnFirstOffsLrnImpoB1" VALUE 0x804F9DE7 Val_Wu8 255.0 DFES_OneToOne 0.00 255.0 FORMAT "%5.1" /end CHARACTERISTIC
/begin CHARACTERISTIC DFES_FaultTyp.DFC_ThrVlvClsdPosnOffsLrnImpoB1_C "assigned fault type / Fault type assignment for check DFC_ThrVlvClsdPosnOffsLrnImpoB1" VALUE 0x804F9DE8 Val_Wu8 255.0 DFES_OneToOne 0.00 255.0 FORMAT "%5.1" /end CHARACTERISTIC
/begin CHARACTERISTIC DFES_FaultTyp.DFC_ThrVlvClsdPosnOffsLrnMaxB1_C "assigned fault type / Fault type assignment for check DFC_ThrVlvClsdPosnOffsLrnMaxB1" VALUE 0x804F9DE9 Val_Wu8 255.0 DFES_OneToOne 0.00 255.0 FORMAT "%5.1" /end CHARACTERISTIC
/begin CHARACTERISTIC DFES_FaultTyp.DFC_ThrVlvClsdPosnOffsLrnMinB1_C "assigned fault type / Fault type assignment for check DFC_ThrVlvClsdPosnOffsLrnMinB1" VALUE 0x804F9DEA Val_Wu8 255.0 DFES_OneToOne 0.00 255.0 FORMAT "%5.1" /end CHARACTERISTIC
/begin CHARACTERISTIC DFES_FaultTyp.DFC_ThrVlvCtrlDeB1_C "assigned fault type / Fault type assignment for check DFC_ThrVlvCtrlDeB1" VALUE 0x804F9DEB Val_Wu8 255.0 DFES_OneToOne 0.00 255.0 FORMAT "%5.1" /end CHARACTERISTIC
/begin CHARACTERISTIC DFES_FaultTyp.DFC_ThrVlvDycB1_C "assigned fault type / Fault type assignment for check DFC_ThrVlvDycB1" VALUE 0x804F9DEC Val_Wu8 255.0 DFES_OneToOne 0.00 255.0 FORMAT "%5.1" /end CHARACTERISTIC
/begin CHARACTERISTIC DFES_FaultTyp.DFC_ThrVlvLimpAirPosnMaxAbsltDriftB1_C "assigned fault type / Fault type assignment for check DFC_ThrVlvLimpAirPosnMaxAbsltDriftB1" VALUE 0x804F9DED Val_Wu8 255.0 DFES_OneToOne 0.00 255.0 FORMAT "%5.1" /end CHARACTERISTIC
/begin CHARACTERISTIC DFES_FaultTyp.DFC_ThrVlvLimpAirPosnMaxB1_C "assigned fault type / Fault type assignment for check DFC_ThrVlvLimpAirPosnMaxB1" VALUE 0x804F9DEE Val_Wu8 255.0 DFES_OneToOne 0.00 255.0 FORMAT "%5.1" /end CHARACTERISTIC
/begin CHARACTERISTIC DFES_FaultTyp.DFC_ThrVlvLimpAirPosnMaxRelDriftB1_C "assigned fault type / Fault type assignment for check DFC_ThrVlvLimpAirPosnMaxRelDriftB1" VALUE 0x804F9DEF Val_Wu8 255.0 DFES_OneToOne 0.00 255.0 FORMAT "%5.1" /end CHARACTERISTIC
/begin CHARACTERISTIC DFES_FaultTyp.DFC_ThrVlvLimpAirPosnMinB1_C "assigned fault type / Fault type assignment for check DFC_ThrVlvLimpAirPosnMinB1" VALUE 0x804F9DF0 Val_Wu8 255.0 DFES_OneToOne 0.00 255.0 FORMAT "%5.1" /end CHARACTERISTIC
/begin CHARACTERISTIC DFES_FaultTyp.DFC_ThrVlvOpenLoadB1_C "assigned fault type / Fault type assignment for check DFC_ThrVlvOpenLoadB1" VALUE 0x804F9DF1 Val_Wu8 255.0 DFES_OneToOne 0.00 255.0 FORMAT "%5.1" /end CHARACTERISTIC
/begin CHARACTERISTIC DFES_FaultTyp.DFC_ThrVlvOpenSprgB1_C "assigned fault type / Fault type assignment for check DFC_ThrVlvOpenSprgB1" VALUE 0x804F9DF2 Val_Wu8 255.0 DFES_OneToOne 0.00 255.0 FORMAT "%5.1" /end CHARACTERISTIC
/begin CHARACTERISTIC DFES_FaultTyp.DFC_ThrVlvOpenSprgSprdB1_C "assigned fault type / Fault type assignment for check DFC_ThrVlvOpenSprgSprdB1" VALUE 0x804F9DF3 Val_Wu8 255.0 DFES_OneToOne 0.00 255.0 FORMAT "%5.1" /end CHARACTERISTIC
/begin CHARACTERISTIC DFES_FaultTyp.DFC_ThrVlvOpenSprgTwnB1_C "assigned fault type / Fault type assignment for check DFC_ThrVlvOpenSprgTwnB1" VALUE 0x804F9DF4 Val_Wu8 255.0 DFES_OneToOne 0.00 255.0 FORMAT "%5.1" /end CHARACTERISTIC
/begin CHARACTERISTIC DFES_FaultTyp.DFC_ThrVlvOverTB1_C "assigned fault type / Fault type assignment for check DFC_ThrVlvOverTB1" VALUE 0x804F9DF5 Val_Wu8 255.0 DFES_OneToOne 0.00 255.0 FORMAT "%5.1" /end CHARACTERISTIC
/begin CHARACTERISTIC DFES_FaultTyp.DFC_ThrVlvRetSprgB1_C "assigned fault type / Fault type assignment for check DFC_ThrVlvRetSprgB1" VALUE 0x804F9DF6 Val_Wu8 255.0 DFES_OneToOne 0.00 255.0 FORMAT "%5.1" /end CHARACTERISTIC
/begin CHARACTERISTIC DFES_FaultTyp.DFC_ThrVlvRetSprgSprdB1_C "assigned fault type / Fault type assignment for check DFC_ThrVlvRetSprgSprdB1" VALUE 0x804F9DF7 Val_Wu8 255.0 DFES_OneToOne 0.00 255.0 FORMAT "%5.1" /end CHARACTERISTIC
/begin CHARACTERISTIC DFES_FaultTyp.DFC_ThrVlvRetSprgTwnB1_C "assigned fault type / Fault type assignment for check DFC_ThrVlvRetSprgTwnB1" VALUE 0x804F9DF8 Val_Wu8 255.0 DFES_OneToOne 0.00 255.0 FORMAT "%5.1" /end CHARACTERISTIC
/begin CHARACTERISTIC DFES_FaultTyp.DFC_ThrVlvSens1MaxB1_C "assigned fault type / Fault type assignment for check DFC_ThrVlvSens1MaxB1" VALUE 0x804F9DF9 Val_Wu8 255.0 DFES_OneToOne 0.00 255.0 FORMAT "%5.1" /end CHARACTERISTIC
/begin CHARACTERISTIC DFES_FaultTyp.DFC_ThrVlvSens1NplB1_C "assigned fault type / Fault type assignment for check DFC_ThrVlvSens1NplB1" VALUE 0x804F9DFA Val_Wu8 255.0 DFES_OneToOne 0.00 255.0 FORMAT "%5.1" /end CHARACTERISTIC
/begin CHARACTERISTIC DFES_FaultTyp.DFC_ThrVlvSens2MaxB1_C "assigned fault type / Fault type assignment for check DFC_ThrVlvSens2MaxB1" VALUE 0x804F9DFB Val_Wu8 255.0 DFES_OneToOne 0.00 255.0 FORMAT "%5.1" /end CHARACTERISTIC
/begin CHARACTERISTIC DFES_FaultTyp.DFC_ThrVlvSens2MinB1_C "assigned fault type / Fault type assignment for check DFC_ThrVlvSens2MinB1" VALUE 0x804F9DFC Val_Wu8 255.0 DFES_OneToOne 0.00 255.0 FORMAT "%5.1" /end CHARACTERISTIC
/begin CHARACTERISTIC DFES_FaultTyp.DFC_ThrVlvSens2NplB1_C "assigned fault type / Fault type assignment for check DFC_ThrVlvSens2NplB1" VALUE 0x804F9DFD Val_Wu8 255.0 DFES_OneToOne 0.00 255.0 FORMAT "%5.1" /end CHARACTERISTIC
/begin CHARACTERISTIC DFES_FaultTyp.DFC_ThrVlvShoCircB1_C "assigned fault type / Fault type assignment for check DFC_ThrVlvShoCircB1" VALUE 0x804F9DFE Val_Wu8 255.0 DFES_OneToOne 0.00 255.0 FORMAT "%5.1" /end CHARACTERISTIC
/begin CHARACTERISTIC DFES_FaultTyp.DFC_ThrVlvSpiErrB1_C "assigned fault type / Fault type assignment for check DFC_ThrVlvSpiErrB1" VALUE 0x804F9DFF Val_Wu8 255.0 DFES_OneToOne 0.00 255.0 FORMAT "%5.1" /end CHARACTERISTIC
/begin CHARACTERISTIC DFES_FaultTyp.DFC_ThrvlvSens1MinB1_C "assigned fault type / Fault type assignment for check DFC_ThrvlvSens1MinB1" VALUE 0x804F9E00 Val_Wu8 255.0 DFES_OneToOne 0.00 255.0 FORMAT "%5.1" /end CHARACTERISTIC
/begin CHARACTERISTIC DFES_FaultTyp.DFC_TiOffTBasdChkFast_C "assigned fault type / Fault type assignment for check DFC_TiOffTBasdChkFast" VALUE 0x804F9E01 Val_Wu8 255.0 DFES_OneToOne 0.00 255.0 FORMAT "%5.1" /end CHARACTERISTIC
/begin CHARACTERISTIC DFES_FaultTyp.DFC_TiOffTBasdChkSlow_C "assigned fault type / Fault type assignment for check DFC_TiOffTBasdChkSlow" VALUE 0x804F9E02 Val_Wu8 255.0 DFES_OneToOne 0.00 255.0 FORMAT "%5.1" /end CHARACTERISTIC
/begin CHARACTERISTIC DFES_FaultTyp.DFC_UEGOHeatrCtlS1B1_C "assigned fault type / Fault type assignment for check DFC_UEGOHeatrCtlS1B1" VALUE 0x804F9E03 Val_Wu8 255.0 DFES_OneToOne 0.00 255.0 FORMAT "%5.1" /end CHARACTERISTIC
/begin CHARACTERISTIC DFES_FaultTyp.DFC_UEGOSnsrMntdS1B1_C "assigned fault type / Fault type assignment for check DFC_UEGOSnsrMntdS1B1" VALUE 0x804F9E04 Val_Wu8 255.0 DFES_OneToOne 0.00 255.0 FORMAT "%5.1" /end CHARACTERISTIC
/begin CHARACTERISTIC DFES_FaultTyp.DFC_VehVSig_C "assigned fault type / Fault type assignment for check DFC_VehVSig" VALUE 0x804F9E05 Val_Wu8 255.0 DFES_OneToOne 0.00 255.0 FORMAT "%5.1" /end CHARACTERISTIC
/begin CHARACTERISTIC DFES_FaultTyp.DFC_VlvLftFbSwtIntk11SpclFail_C "assigned fault type / Fault type assignment for check DFC_VlvLftFbSwtIntk11SpclFail" VALUE 0x804F9E06 Val_Wu8 255.0 DFES_OneToOne 0.00 255.0 FORMAT "%5.1" /end CHARACTERISTIC
/begin CHARACTERISTIC DFES_FaultTyp.DFC_VlvLftFbSwtIntk11StdFail_C "assigned fault type / Fault type assignment for check DFC_VlvLftFbSwtIntk11StdFail" VALUE 0x804F9E07 Val_Wu8 255.0 DFES_OneToOne 0.00 255.0 FORMAT "%5.1" /end CHARACTERISTIC
/begin CHARACTERISTIC DFES_GrpRpr.DFC_Unused_C "common MIL debouncing / " VALUE 0x804F9E0C Val_Wu16 703.000000000 DFC_Verb 0.00 703.000000000 FORMAT "%13.9" READ_ONLY /end CHARACTERISTIC
/begin CHARACTERISTIC DFES_GrpRpr.DFC_AltIOACGFailr_C "common MIL debouncing / group representative for common MIL debouncing of DFC_AltIOACGFailr" VALUE 0x804F9E0E Val_Wu16 703.000000000 DFC_Verb 0.00 703.000000000 FORMAT "%13.9" /end CHARACTERISTIC
/begin CHARACTERISTIC DFES_GrpRpr.DFC_AltIOACGHiVltg_C "common MIL debouncing / group representative for common MIL debouncing of DFC_AltIOACGHiVltg" VALUE 0x804F9E10 Val_Wu16 703.000000000 DFC_Verb 0.00 703.000000000 FORMAT "%13.9" /end CHARACTERISTIC
/begin CHARACTERISTIC DFES_GrpRpr.DFC_AltIOACGLoVltg_C "common MIL debouncing / group representative for common MIL debouncing of DFC_AltIOACGLoVltg" VALUE 0x804F9E12 Val_Wu16 703.000000000 DFC_Verb 0.00 703.000000000 FORMAT "%13.9" /end CHARACTERISTIC
/begin CHARACTERISTIC DFES_GrpRpr.DFC_AltIOACGTHi_C "common MIL debouncing / group representative for common MIL debouncing of DFC_AltIOACGTHi" VALUE 0x804F9E14 Val_Wu16 703.000000000 DFC_Verb 0.00 703.000000000 FORMAT "%13.9" /end CHARACTERISTIC
/begin CHARACTERISTIC DFES_GrpRpr.DFC_AltIODConnACG_C "common MIL debouncing / group representative for common MIL debouncing of DFC_AltIODConnACG" VALUE 0x804F9E16 Val_Wu16 703.000000000 DFC_Verb 0.00 703.000000000 FORMAT "%13.9" /end CHARACTERISTIC
/begin CHARACTERISTIC DFES_GrpRpr.DFC_BattUHiFailr_C "common MIL debouncing / group representative for common MIL debouncing of DFC_BattUHiFailr" VALUE 0x804F9E18 Val_Wu16 703.000000000 DFC_Verb 0.00 703.000000000 FORMAT "%13.9" /end CHARACTERISTIC
/begin CHARACTERISTIC DFES_GrpRpr.DFC_BattULoFailr_C "common MIL debouncing / group representative for common MIL debouncing of DFC_BattULoFailr" VALUE 0x804F9E1A Val_Wu16 703.000000000 DFC_Verb 0.00 703.000000000 FORMAT "%13.9" /end CHARACTERISTIC
/begin CHARACTERISTIC DFES_GrpRpr.DFC_BrkBstPDriftHiErr_C "common MIL debouncing / group representative for common MIL debouncing of DFC_BrkBstPDriftHiErr" VALUE 0x804F9E1C Val_Wu16 703.000000000 DFC_Verb 0.00 703.000000000 FORMAT "%13.9" /end CHARACTERISTIC
/begin CHARACTERISTIC DFES_GrpRpr.DFC_BrkBstPDriftLoErr_C "common MIL debouncing / group representative for common MIL debouncing of DFC_BrkBstPDriftLoErr" VALUE 0x804F9E1E Val_Wu16 703.000000000 DFC_Verb 0.00 703.000000000 FORMAT "%13.9" /end CHARACTERISTIC
/begin FUNCTION DFES "30000.73.0_2.0.0Diagnostic Fault Event Storage"
 /begin DEF_CHARACTERISTIC DFES_FaultTyp.DFC_ComAYCDChkSum_C DFES_FaultTyp.DFC_ComAYCDTOut_C DFES_FaultTyp.DFC_ComAYCFChksum_C DFES_FaultTyp.DFC_ComAYCFRingCnt_C DFES_FaultTyp.DFC_ComAYCFTOut_C DFES_FaultTyp.DFC_ComAYCGChksum_C DFES_FaultTyp.DFC_ComAYCGRingCnt_C DFES_FaultTyp.DFC_ComAYCGTOut_C DFES_FaultTyp.DFC_ComAYCIChkSum_C DFES_FaultTyp.DFC_ComAYCIRingCnt_C DFES_FaultTyp.DFC_ComAYCITOut_C DFES_FaultTyp.DFC_ComBCM1ChkSum_C DFES_FaultTyp.DFC_ComBCM1RingCnt_C DFES_FaultTyp.DFC_ComBCM1TOut_C DFES_FaultTyp.DFC_ComCANABusOffErr_C DFES_FaultTyp.DFC_ComCANBBusOffErr_C DFES_FaultTyp.DFC_ComCANCBusOffErr_C DFES_FaultTyp.DFC_ComCGW1ChkSum_C DFES_FaultTyp.DFC_ComCGW1RingCnt_C DFES_FaultTyp.DFC_ComCGW1TOut_C DFES_FaultTyp.DFC_ComConvBoostErr_C DFES_FaultTyp.DFC_ComConvSlipErr_C DFES_FaultTyp.DFC_ComEAT10Chksum_C DFES_FaultTyp.DFC_ComEAT10RingCnt_C DFES_FaultTyp.DFC_ComEAT10TOut_C DFES_FaultTyp.DFC_ComEAT11ChkSum_C DFES_FaultTyp.DFC_ComEAT11RingCnt_C DFES_FaultTyp.DFC_ComEAT11TOut_C DFES_FaultTyp.DFC_ComEAT12ChkSum_C DFES_FaultTyp.DFC_ComEAT12RingCnt_C DFES_FaultTyp.DFC_ComEAT12TOut_C DFES_FaultTyp.DFC_ComEAT13ChkSum_C DFES_FaultTyp.DFC_ComEAT13RingCnt_C DFES_FaultTyp.DFC_ComEAT13TOut_C DFES_FaultTyp.DFC_ComEAT1Chksum_C DFES_FaultTyp.DFC_ComEAT1RingCnt_C DFES_FaultTyp.DFC_ComEAT1TOut_C DFES_FaultTyp.DFC_ComEAT2ChkSum_C DFES_FaultTyp.DFC_ComEAT2RingCnt_C DFES_FaultTyp.DFC_ComEAT2TOut_C DFES_FaultTyp.DFC_ComEAT4ChkSum_C DFES_FaultTyp.DFC_ComEAT4RingCnt_C DFES_FaultTyp.DFC_ComEAT4TOut_C DFES_FaultTyp.DFC_ComEAT6Chksum_C DFES_FaultTyp.DFC_ComEAT6RingCnt_C DFES_FaultTyp.DFC_ComEAT6TOut_C DFES_FaultTyp.DFC_ComEAT7Chksum_C DFES_FaultTyp.DFC_ComEAT7RingCnt_C DFES_FaultTyp.DFC_ComEAT7TOut_C DFES_FaultTyp.DFC_ComEAT8Chksum_C DFES_FaultTyp.DFC_ComEAT8RingCnt_C DFES_FaultTyp.DFC_ComEAT8TOut_C DFES_FaultTyp.DFC_ComEATAChksum_C DFES_FaultTyp.DFC_ComEATARingCnt_C DFES_FaultTyp.DFC_ComEATATOut_C DFES_FaultTyp.DFC_ComEATBChkSum_C DFES_FaultTyp.DFC_ComEATBRingCnt_C DFES_FaultTyp.DFC_ComEATBTOut_C DFES_FaultTyp.DFC_ComEATCChksum_C DFES_FaultTyp.DFC_ComEATCRingCnt_C DFES_FaultTyp.DFC_ComEATCTOut_C DFES_FaultTyp.DFC_ComEBBAChksum_C DFES_FaultTyp.DFC_ComEBBARingCnt_C DFES_FaultTyp.DFC_ComEBBATOut_C DFES_FaultTyp.DFC_ComEPS1Chksum_C DFES_FaultTyp.DFC_ComEPS1RingCnt_C DFES_FaultTyp.DFC_ComEPS1TOut_C DFES_FaultTyp.DFC_ComEngCanRxErr_C DFES_FaultTyp.DFC_ComGrvySnsrErr_C DFES_FaultTyp.DFC_ComGwIMG1ChkSum_C DFES_FaultTyp.DFC_ComGwIMG1RingCnt_C DFES_FaultTyp.DFC_ComGwIMG1TOut_C DFES_FaultTyp.DFC_ComGwIMG3ChkSum_C DFES_FaultTyp.DFC_ComGwIMG3RingCnt_C DFES_FaultTyp.DFC_ComGwIMG3TOut_C DFES_FaultTyp.DFC_ComGwIMG4ChkSum_C DFES_FaultTyp.DFC_ComGwIMG4RingCnt_C DFES_FaultTyp.DFC_ComGwIMG4TOut_C DFES_FaultTyp.DFC_ComGwIMG5ChkSum_C DFES_FaultTyp.DFC_ComGwIMG5RingCnt_C DFES_FaultTyp.DFC_ComGwIMG5TOut_C DFES_FaultTyp.DFC_ComGwIMG6ChkSum_C DFES_FaultTyp.DFC_ComGwIMG6RingCnt_C DFES_FaultTyp.DFC_ComGwIMG6TOut_C DFES_FaultTyp.DFC_ComIDASBChksum_C DFES_FaultTyp.DFC_ComIDASBRingCnt_C DFES_FaultTyp.DFC_ComIDASBTOut_C DFES_FaultTyp.DFC_ComIMGMILReq_C DFES_FaultTyp.DFC_ComISSPrms_C DFES_FaultTyp.DFC_ComMETAChksum_C DFES_FaultTyp.DFC_ComMETARingCnt_C DFES_FaultTyp.DFC_ComMETATOut_C DFES_FaultTyp.DFC_ComMETCChksum_C DFES_FaultTyp.DFC_ComMETCRingCnt_C DFES_FaultTyp.DFC_ComMETCTOut_C DFES_FaultTyp.DFC_ComMETDChksum_C DFES_FaultTyp.DFC_ComMETDRingCnt_C DFES_FaultTyp.DFC_ComMETDTOut_C DFES_FaultTyp.DFC_ComMETE2Chksum_C DFES_FaultTyp.DFC_ComMETE2RingCnt_C DFES_FaultTyp.DFC_ComMETE2TOut_C DFES_FaultTyp.DFC_ComMETFChksum_C DFES_FaultTyp.DFC_ComMETFRingCnt_C DFES_FaultTyp.DFC_ComMETFTOut_C DFES_FaultTyp.DFC_ComMETGChksum_C DFES_FaultTyp.DFC_ComMETGRingCnt_C DFES_FaultTyp.DFC_ComMETGTOut_C DFES_FaultTyp.DFC_ComMETH2Chksum_C DFES_FaultTyp.DFC_ComMETH2RingCnt_C DFES_FaultTyp.DFC_ComMETH2TOut_C DFES_FaultTyp.DFC_ComMETHChksum_C DFES_FaultTyp.DFC_ComMETHRingCnt_C DFES_FaultTyp.DFC_ComMETHTOut_C DFES_FaultTyp.DFC_ComMETIChksum_C DFES_FaultTyp.DFC_ComMETIRingCnt_C DFES_FaultTyp.DFC_ComMETITOut_C DFES_FaultTyp.DFC_ComMETKChksum_C DFES_FaultTyp.DFC_ComMETKRingCnt_C DFES_FaultTyp.DFC_ComMETKTOut_C DFES_FaultTyp.DFC_ComMETLChksum_C DFES_FaultTyp.DFC_ComMETLRingCnt_C DFES_FaultTyp.DFC_ComMETLTOut_C DFES_FaultTyp.DFC_ComMETMChksum_C DFES_FaultTyp.DFC_ComMETMRingCnt_C DFES_FaultTyp.DFC_ComMETMTOut_C DFES_FaultTyp.DFC_ComMETNChksum_C DFES_FaultTyp.DFC_ComMETNRingCnt_C DFES_FaultTyp.DFC_ComMETNTOut_C DFES_FaultTyp.DFC_ComMtrCom_C DFES_FaultTyp.DFC_ComPCUChkSum_C DFES_FaultTyp.DFC_ComPCURingCnt_C DFES_FaultTyp.DFC_ComPCUTOut_C DFES_FaultTyp.DFC_ComSRSAChksum_C DFES_FaultTyp.DFC_ComSRSARingCnt_C DFES_FaultTyp.DFC_ComSRSATOut_C DFES_FaultTyp.DFC_ComSRSBChksum_C DFES_FaultTyp.DFC_ComSRSBRingCnt_C DFES_FaultTyp.DFC_ComSRSBTOut_C DFES_FaultTyp.DFC_ComSRSChksum_C DFES_FaultTyp.DFC_ComSRSErr_C DFES_FaultTyp.DFC_ComSRSRingCnt_C DFES_FaultTyp.DFC_ComSRSTOut_C DFES_FaultTyp.DFC_ComVehSpdPndFltTCU_C DFES_FaultTyp.DFC_EbsChartcCurrErr_C DFES_FaultTyp.DFC_EbsSelfDiagErr_C DFES_FaultTyp.DFC_GbxCANDigPlausErr_C DFES_FaultTyp.DFC_GbxNPos1SRCMax_C DFES_FaultTyp.DFC_GbxNPos1SRCMin_C DFES_FaultTyp.DFC_GbxNPos2SRCMax_C DFES_FaultTyp.DFC_GbxNPos2SRCMin_C DFES_FaultTyp.DFC_GbxNPosAlvChk_C DFES_FaultTyp.DFC_GbxNPosSyncErr_C DFES_FaultTyp.DFC_HEGOS2B1HtrPsMax_C DFES_FaultTyp.DFC_HEGOS2B1HtrPsMin_C DFES_FaultTyp.DFC_HEGOS2B1HtrPsSig_C DFES_FaultTyp.DFC_LinCSErrACG_C DFES_FaultTyp.DFC_LinCSErrEBS_C DFES_FaultTyp.DFC_LinHdrTimeoutErrACG_C DFES_FaultTyp.DFC_LinHdrTimeoutErrEBS_C DFES_FaultTyp.DFC_LinMsgTimeoutErrACG_C DFES_FaultTyp.DFC_LinMsgTimeoutErrEBS_C DFES_FaultTyp.DFC_LinNoStrtComErr_C DFES_FaultTyp.DFC_MisfDetVWhlFrntLeOORHi_C DFES_FaultTyp.DFC_MisfDetVWhlFrntLeRatyHi_C DFES_FaultTyp.DFC_MisfDetVWhlFrntLeRatyLo_C DFES_FaultTyp.DFC_MisfDetVWhlFrntLeStuck_C DFES_FaultTyp.DFC_MisfDetVWhlFrntRiOORHi_C DFES_FaultTyp.DFC_MisfDetVWhlFrntRiRatyHi_C DFES_FaultTyp.DFC_MisfDetVWhlFrntRiRatyLo_C DFES_FaultTyp.DFC_MisfDetVWhlFrntRiStuck_C DFES_FaultTyp.DFC_MisfDetVWhlReLeOORHi_C DFES_FaultTyp.DFC_MisfDetVWhlReLeRatyHi_C DFES_FaultTyp.DFC_MisfDetVWhlReLeRatyLo_C DFES_FaultTyp.DFC_MisfDetVWhlReLeStuck_C DFES_FaultTyp.DFC_MisfDetVWhlReRiOORHi_C DFES_FaultTyp.DFC_MisfDetVWhlReRiRatyHi_C DFES_FaultTyp.DFC_MisfDetVWhlReRiRatyLo_C DFES_FaultTyp.DFC_MisfDetVWhlReRiStuck_C DFES_FaultTyp.DFC_MisfDetdVWhlFrntLePlaus_C DFES_FaultTyp.DFC_MisfDetdVWhlFrntRiPlaus_C DFES_FaultTyp.DFC_MisfDetdVWhlReLePlaus_C DFES_FaultTyp.DFC_MisfDetdVWhlReRiPlaus_C DFES_FaultTyp.DFC_PEnvSigRngMax_C DFES_FaultTyp.DFC_PEnvSigRngMin_C DFES_FaultTyp.DFC_StmFault_C DFES_FaultTyp.DFC_StrtCtOffPth_C DFES_FaultTyp.DFC_StrtCtlErr_C DFES_FaultTyp.DFC_StrtFault_C DFES_FaultTyp.DFC_StrtLckJudg1_C DFES_FaultTyp.DFC_StrtLckJudg2_C DFES_FaultTyp.DFC_StrtOL_C DFES_FaultTyp.DFC_StrtOL2_C DFES_FaultTyp.DFC_StrtSCB_C DFES_FaultTyp.DFC_StrtSCB2_C DFES_FaultTyp.DFC_StrtSCG_C DFES_FaultTyp.DFC_StrtSCG2_C DFES_FaultTyp.DFC_StrtStkRly1_C DFES_FaultTyp.DFC_StrtStkRly2_C DFES_FaultTyp.DFC_TEVEmax_C DFES_FaultTyp.DFC_TEVEmin_C DFES_FaultTyp.DFC_TEVEsig_C DFES_FaultTyp.DFC_VehVAllPlaus_C DFES_FaultTyp.DFC_VehVNCSnsrElecFailr_C DFES_FaultTyp.DFC_VehVPlausCan_C DFES_FaultTyp.DFC_VehVPlausFco_C DFES_FaultTyp.DFC_VehVPlausPwr_C DFES_FaultTyp.DFC_VehVPlausV2N_C DFES_FaultTyp.DFC_VehVSpdSnsrAElecFailr_C DFES_FaultTyp.DFC_VehVSpdSnsrBElecFailr_C DFES_FaultTyp.DFC_ClthMax_C DFES_FaultTyp.DFC_IgnClPs_DevComErr_C DFES_FaultTyp.DFC_IgnClPs_LineOl_0_C DFES_FaultTyp.DFC_IgnClPs_LineOl_1_C DFES_FaultTyp.DFC_IgnClPs_LineOl_2_C DFES_FaultTyp.DFC_IgnClPs_LineOl_3_C DFES_FaultTyp.DFC_IgnClPs_LineScb_0_C DFES_FaultTyp.DFC_IgnClPs_LineScb_1_C DFES_FaultTyp.DFC_IgnClPs_LineScb_2_C DFES_FaultTyp.DFC_IgnClPs_LineScb_3_C DFES_FaultTyp.DFC_IgnClPs_LineScg_0_C DFES_FaultTyp.DFC_IgnClPs_LineScg_1_C DFES_FaultTyp.DFC_IgnClPs_LineScg_2_C DFES_FaultTyp.DFC_IgnClPs_LineScg_3_C DFES_FaultTyp.DFC_UEGOASICS1B1_C DFES_FaultTyp.DFC_UEGOOLIPES1B1_C DFES_FaultTyp.DFC_UEGOOLRES1B1_C DFES_FaultTyp.DFC_UEGOSCBS1B1_C DFES_FaultTyp.DFC_UEGOSCGS1B1_C DFES_FaultTyp.DFC_UEGOSPIS1B1_C DFES_FaultTyp.DFC_UEGOSnsrS1B1_C DFES_FaultTyp.DFC_UegoOlApesS1B1_C DFES_FaultTyp.DFC_UegoOlRCmpS1B1_C DFES_FaultTyp.DFC_AirCCmprOL_C DFES_FaultTyp.DFC_AirCCmprOvrTemp_C DFES_FaultTyp.DFC_AirCCmprSCB_C DFES_FaultTyp.DFC_AirCCmprSCG_C DFES_FaultTyp.DFC_AltErr_C DFES_FaultTyp.DFC_BattUSRCMax_C DFES_FaultTyp.DFC_BattUSRCMin_C DFES_FaultTyp.DFC_ComChksTCU1_C DFES_FaultTyp.DFC_ComChksTCU11_C DFES_FaultTyp.DFC_ComChksTCU12_C DFES_FaultTyp.DFC_ComChksTCU13_C DFES_FaultTyp.DFC_ComChksTCU2_C DFES_FaultTyp.DFC_ComChksTCU3_C DFES_FaultTyp.DFC_ComChksTCU4_C DFES_FaultTyp.DFC_ComCntTCU1_C DFES_FaultTyp.DFC_ComCntTCU11_C DFES_FaultTyp.DFC_ComCntTCU12_C DFES_FaultTyp.DFC_ComCntTCU13_C DFES_FaultTyp.DFC_ComCntTCU2_C DFES_FaultTyp.DFC_ComCntTCU3_C DFES_FaultTyp.DFC_ComCntTCU4_C DFES_FaultTyp.DFC_ComTOutTCU01_C DFES_FaultTyp.DFC_ComTOutTCU02_C DFES_FaultTyp.DFC_ComTOutTCU1_C DFES_FaultTyp.DFC_ComTOutTCU11_C DFES_FaultTyp.DFC_ComTOutTCU12_C DFES_FaultTyp.DFC_ComTOutTCU13_C DFES_FaultTyp.DFC_ComTOutTCU14_C DFES_FaultTyp.DFC_ComTOutTCU2_C DFES_FaultTyp.DFC_ComTOutTCU3_C DFES_FaultTyp.DFC_ComTOutTCU4_C DFES_FaultTyp.DFC_DevLibBattUHi_C DFES_FaultTyp.DFC_DevLibBattULo_C DFES_FaultTyp.DFC_FanDIOOL_0_C DFES_FaultTyp.DFC_FanDIOOL_1_C DFES_FaultTyp.DFC_FanDIOOvrTemp_0_C DFES_FaultTyp.DFC_FanDIOOvrTemp_1_C DFES_FaultTyp.DFC_FanDIOSCB_0_C DFES_FaultTyp.DFC_FanDIOSCB_1_C DFES_FaultTyp.DFC_FanDIOSCG_0_C DFES_FaultTyp.DFC_FanDIOSCG_1_C DFES_FaultTyp.DFC_MRlyDcOL_C DFES_FaultTyp.DFC_MRlyDcSCB_C DFES_FaultTyp.DFC_MRlyDcSCG_C DFES_FaultTyp.DFC_PSPOL_C DFES_FaultTyp.DFC_PSPOvrTemp_C DFES_FaultTyp.DFC_PSPSCB_C DFES_FaultTyp.DFC_PSPSCG_C DFES_FaultTyp.DFC_T50Err_C DFES_FaultTyp.DFC_ThrVlvLoBattB1_C DFES_FaultTyp.DFC_VehVPhysRngHi_C DFES_FaultTyp.DFC_VehVSclOutOL_C DFES_FaultTyp.DFC_VehVSclOutOT_C DFES_FaultTyp.DFC_VehVSclOutSCB_C DFES_FaultTyp.DFC_VehVSclOutSCG_C DFES_FaultTyp.DFC_VehVSnsrARngHi_C DFES_FaultTyp.DFC_VehVSnsrBRngHi_C DFES_FaultTyp.DFC_VehVSpdRtyDiag_C DFES_FaultTyp.DFC_VehVWhlErr_C DFES_FaultTyp.DFC_ACEvpTSRCMax_C DFES_FaultTyp.DFC_ACEvpTSRCMin_C DFES_FaultTyp.DFC_AirCClntPAnaSRCMax_C DFES_FaultTyp.DFC_AirCClntPAnaSRCMin_C DFES_FaultTyp.DFC_AirCSwtNpl_C DFES_FaultTyp.DFC_AirCSwtSig_C DFES_FaultTyp.DFC_Brk_C DFES_FaultTyp.DFC_BrkSig_C DFES_FaultTyp.DFC_ClthSig_C DFES_FaultTyp.DFC_HLSDemOvhtEngLim_C DFES_FaultTyp.DFC_OilPNpl_C DFES_FaultTyp.DFC_PIntkVUsLineHiB1_C DFES_FaultTyp.DFC_PIntkVUsLineLoB1_C DFES_FaultTyp.DFC_VehVPhysRngLo_C DFES_FaultTyp.DFC_VehVSigCan_C DFES_FaultTyp.DFC_VehVSigCanSafe_C DFES_FaultTyp.DFC_VlvLftFbOilPSnsrIntk11SRCMax_C DFES_FaultTyp.DFC_VlvLftFbOilPSnsrIntk11SRCMin_C DFES_FaultTyp.DFC_ClthNpl_C DFES_FaultTyp.DFC_EV1max_C DFES_FaultTyp.DFC_EV1min_C DFES_FaultTyp.DFC_EV1sig_C DFES_FaultTyp.DFC_EV2max_C DFES_FaultTyp.DFC_EV2min_C DFES_FaultTyp.DFC_EV2sig_C DFES_FaultTyp.DFC_EV3max_C DFES_FaultTyp.DFC_EV3min_C DFES_FaultTyp.DFC_EV3sig_C DFES_FaultTyp.DFC_EV4max_C DFES_FaultTyp.DFC_EV4min_C DFES_FaultTyp.DFC_EV4sig_C DFES_FaultTyp.DFC_GbxPNPosnDrvCdn_C DFES_FaultTyp.DFC_GbxPNPosnPlausy_C DFES_FaultTyp.DFC_PEnvCcMax_C DFES_FaultTyp.DFC_PEnvCcMin_C DFES_FaultTyp.DFC_PEnvRngChkMax_C DFES_FaultTyp.DFC_PEnvRngChkMin_C DFES_FaultTyp.DFC_PEnvSnsrPlaus_C DFES_FaultTyp.DFC_UEGOHeatrPsS1B1Max_C DFES_FaultTyp.DFC_UEGOHeatrPsS1B1Min_C DFES_FaultTyp.DFC_UEGOHeatrPsS1B1Sig_C DFES_FaultTyp.DFC_UEGOHeatrRlyPsOLS1B1_C DFES_FaultTyp.DFC_UEGOHeatrRlyPsSCBS1B1_C DFES_FaultTyp.DFC_UEGOHeatrRlyPsSCGS1B1_C DFES_FaultTyp.DFC_KnDetSens1PortAMax_C DFES_FaultTyp.DFC_KnDetSens1PortAMin_C DFES_FaultTyp.DFC_KnDetSens1PortBMax_C DFES_FaultTyp.DFC_KnDetSens1PortBMin_C DFES_FaultTyp.DFC_Clth2ONStuck_C DFES_FaultTyp.DFC_Clth2ONStuckLdc_C DFES_FaultTyp.DFC_Clth3ONStuckLdc_C DFES_FaultTyp.DFC_Clth3ONStuckPostDrv_C DFES_FaultTyp.DFC_Clth4ONStuck_C DFES_FaultTyp.DFC_Clth4ONStuckLdc_C DFES_FaultTyp.DFC_ComDLCTCU01_C DFES_FaultTyp.DFC_ComDLCTCU02_C DFES_FaultTyp.DFC_ComDLCTCU1_C DFES_FaultTyp.DFC_ComDLCTCU11_C DFES_FaultTyp.DFC_ComDLCTCU12_C DFES_FaultTyp.DFC_ComDLCTCU13_C DFES_FaultTyp.DFC_ComDLCTCU14_C DFES_FaultTyp.DFC_ComDLCTCU2_C DFES_FaultTyp.DFC_ComDLCTCU3_C DFES_FaultTyp.DFC_ComDLCTCU4_C DFES_FaultTyp.DFC_EVX_C DFES_FaultTyp.DFC_EbsSocFlt_C DFES_FaultTyp.DFC_I14229VINErr_C DFES_FaultTyp.DFC_LLRKHmax_C DFES_FaultTyp.DFC_LLRKHmin_C DFES_FaultTyp.DFC_LLRmax_C DFES_FaultTyp.DFC_LLRmin_C DFES_FaultTyp.DFC_RoughRoad_C DFES_FaultTyp.DFC_SiaEEPRdErr_C DFES_FaultTyp.DFC_SiaEEPWrngCod_C DFES_FaultTyp.DFC_UegoDummy_C DFES_FaultTyp.DFC_BusDiagCANAPPLBusOff_C DFES_FaultTyp.DFC_BusDiagCANCANCBusOff_C DFES_FaultTyp.DFC_BusDiagCANVEHICLEBusOff_C DFES_FaultTyp.DFC_RBA_IODIAGPWR_rba_IoExtCy329_SignalVltSply_0_C DFES_FaultTyp.DFC_RBA_IODIAGPWR_rba_IoExtCy329_SignalVltSply_0OT_C DFES_FaultTyp.DFC_RBA_IODIAGPWR_rba_IoExtCy329_SignalVltSply_0OV_C DFES_FaultTyp.DFC_RBA_IODIAGPWR_rba_IoExtCy329_SignalVltSply_0SCG_C DFES_FaultTyp.DFC_RBA_IODIAGPWR_rba_IoExtCy329_SignalVltSply_0UV_C DFES_FaultTyp.DFC_RBA_IODIAGPWR_rba_IoExtCy329_SignalVltSply_1_C DFES_FaultTyp.DFC_RBA_IODIAGPWR_rba_IoExtCy329_SignalVltSply_1OT_C DFES_FaultTyp.DFC_RBA_IODIAGPWR_rba_IoExtCy329_SignalVltSply_1OV_C DFES_FaultTyp.DFC_RBA_IODIAGPWR_rba_IoExtCy329_SignalVltSply_1SCG_C DFES_FaultTyp.DFC_RBA_IODIAGPWR_rba_IoExtCy329_SignalVltSply_1UV_C DFES_FaultTyp.DFC_RBA_IODIAGPWR_rba_IoExtCy329_SignalVltSply_2_C DFES_FaultTyp.DFC_RBA_IODIAGPWR_rba_IoExtCy329_SignalVltSply_2OT_C DFES_FaultTyp.DFC_RBA_IODIAGPWR_rba_IoExtCy329_SignalVltSply_2OV_C DFES_FaultTyp.DFC_RBA_IODIAGPWR_rba_IoExtCy329_SignalVltSply_2SCG_C DFES_FaultTyp.DFC_RBA_IODIAGPWR_rba_IoExtCy329_SignalVltSply_2UV_C DFES_FaultTyp.DFC_CAN_E_TIMEOUT_C DFES_FaultTyp.DFC_LIN_E_TIMEOUT_C DFES_FaultTyp.DFC_MRlyOL_C DFES_FaultTyp.DFC_MRlySCB_C DFES_FaultTyp.DFC_MRlySCG_C DFES_FaultTyp.DFC_rba_MultiStackTrace_Threshold_C DFES_FaultTyp.DFC_BSWM_E_ACTION_FAILED_C DFES_FaultTyp.DFC_BSWM_E_INTRPTQUEUE_FULL_C DFES_FaultTyp.DFC_RBA_IOEXTLIB_KEEPALIVE_DRV_C DFES_FaultTyp.DFC_RBA_IOEXTLIB_KEEPALIVE_INI_C DFES_FaultTyp.DFC_rba_IoSigRtc_StopCounter_C DFES_FaultTyp.DFC_rba_MRly_Diag_Stk_Event_C DFES_FaultTyp.DFC_rba_MemDiag_MemReadErr_C DFES_FaultTyp.DFC_rba_MemDiag_MemWrErr_C DFES_FaultTyp.DFC_rba_SyC_IrrSwOffTrigEngRun_Event_C DFES_FaultTyp.DFC_rba_T15_Diag_ComInVld_Event_C DFES_FaultTyp.DFC_rba_T15_Diag_ComOff_HwOn_Event_C DFES_FaultTyp.DFC_rba_T15_Diag_ComOn_HwOff_Event_C DFES_FaultTyp.DFC_AppAllSnsrDfct_C DFES_FaultTyp.DFC_BattUStdbyDiaOL_C DFES_FaultTyp.DFC_BigLeakIntkMnfldEmiInfl_C DFES_FaultTyp.DFC_BrkMnSwtContOnWarnLmp_C DFES_FaultTyp.DFC_BrkMnSwtNotStpWarnLmp_C DFES_FaultTyp.DFC_BrkRdntSwtContOnWarnLmp_C DFES_FaultTyp.DFC_BrkRdntSwtNotStpWarnLmp_C DFES_FaultTyp.DFC_CEngDsTColdStrtMax_C DFES_FaultTyp.DFC_CEngDsTColdStrtMin_C DFES_FaultTyp.DFC_CEngDsTImps_C DFES_FaultTyp.DFC_CEngDsTPlausLSC_C DFES_FaultTyp.DFC_CEngDsTPlausSTC_C DFES_FaultTyp.DFC_CEngDsTSRCMax_C DFES_FaultTyp.DFC_CEngDsTSRCMin_C DFES_FaultTyp.DFC_CEngDsTSig_C DFES_FaultTyp.DFC_CEngUsTSRCMax_C DFES_FaultTyp.DFC_CEngUsTSRCMin_C DFES_FaultTyp.DFC_DCDCFltDet_C DFES_FaultTyp.DFC_DKRSA_C DFES_FaultTyp.DFC_DKVSmax_C DFES_FaultTyp.DFC_DKnpl_C DFES_FaultTyp.DFC_DSSmax_C DFES_FaultTyp.DFC_DSTTI_C DFES_FaultTyp.DFC_DSUmax_C DFES_FaultTyp.DFC_EGRVlvOL_C DFES_FaultTyp.DFC_EGRVlvSCB_C DFES_FaultTyp.DFC_EGRVlvSCG_C DFES_FaultTyp.DFC_EGSDUS2B1LtrDly_C DFES_FaultTyp.DFC_EGSDUS2B1LtrPT1_C DFES_FaultTyp.DFC_EGSDUS2B1RtlDly_C DFES_FaultTyp.DFC_EGSDUS2B1RtlPT1_C DFES_FaultTyp.DFC_EGSDUS2B1TarLean_C DFES_FaultTyp.DFC_EGSDUS2B1TarRich_C DFES_FaultTyp.DFC_ETAKHLmax_C DFES_FaultTyp.DFC_ETAKHTmax_C DFES_FaultTyp.DFC_EngICO_C DFES_FaultTyp.DFC_EngPrtOvrSpdMon_C DFES_FaultTyp.DFC_EpmCaSI1ErrSig_C DFES_FaultTyp.DFC_EpmCaSI1NoSig_C DFES_FaultTyp.DFC_EpmCaSI1OfsErr_C DFES_FaultTyp.DFC_EpmCrSErrSig_C DFES_FaultTyp.DFC_EpmCrSNoSig_C DFES_FaultTyp.DFC_EtaEngIdleNonCsers_C DFES_FaultTyp.DFC_EtaEngPtlNonCsers_C DFES_FaultTyp.DFC_FRAmax_C DFES_FaultTyp.DFC_FRAmin_C DFES_FaultTyp.DFC_GbxRvsSwtStk_C DFES_FaultTyp.DFC_HDRmax_C DFES_FaultTyp.DFC_HEGOS2B1ElecMax_C DFES_FaultTyp.DFC_HEGOS2B1ElecMin_C DFES_FaultTyp.DFC_HEGOS2B1ElecSig_C DFES_FaultTyp.DFC_HEGOS2B1HtgNpl_C DFES_FaultTyp.DFC_IntkAirTIntkMnfldCrssMax_C DFES_FaultTyp.DFC_IntkAirTIntkMnfldCrssMin_C DFES_FaultTyp.DFC_IntkAirTIntkMnfldHSCMax_C DFES_FaultTyp.DFC_IntkAirTIntkMnfldImps_C DFES_FaultTyp.DFC_IntkAirTIntkMnfldPRCMax_C DFES_FaultTyp.DFC_IntkAirTIntkMnfldPRCMin_C DFES_FaultTyp.DFC_IntkAirTIntkMnfldSRCMax_C DFES_FaultTyp.DFC_IntkAirTIntkMnfldSRCMin_C DFES_FaultTyp.DFC_IntkAirTIntkMnfldSTC_C DFES_FaultTyp.DFC_KS1max_C DFES_FaultTyp.DFC_KS1min_C DFES_FaultTyp.DFC_LMmax_C DFES_FaultTyp.DFC_LZSRnpl_C DFES_FaultTyp.DFC_LamDynDiagS1B1_C DFES_FaultTyp.DFC_LeakIntkMnfldEmiInfl_C DFES_FaultTyp.DFC_MD00max_C DFES_FaultTyp.DFC_MDBmax_C DFES_FaultTyp.DFC_MDCat_C DFES_FaultTyp.DFC_MDCatCrit_C DFES_FaultTyp.DFC_MDCatCurr_C DFES_FaultTyp.DFC_MDCyl_0_C DFES_FaultTyp.DFC_MDCyl_1_C DFES_FaultTyp.DFC_MDCyl_2_C DFES_FaultTyp.DFC_MDCyl_3_C DFES_FaultTyp.DFC_MDEmi_C DFES_FaultTyp.DFC_MDEmiStrt_C DFES_FaultTyp.DFC_MDFco_C DFES_FaultTyp.DFC_MDMpl_C DFES_FaultTyp.DFC_MDSegTiAdpn_C DFES_FaultTyp.DFC_MDmax_C DFES_FaultTyp.DFC_MOXEMM_SMU_ALM0_0_C DFES_FaultTyp.DFC_MOXEMM_SMU_ALM0_1_C DFES_FaultTyp.DFC_MOXEMM_SMU_ALM0_10_C DFES_FaultTyp.DFC_MOXEMM_SMU_ALM0_11_C DFES_FaultTyp.DFC_MOXEMM_SMU_ALM0_13_C DFES_FaultTyp.DFC_MOXEMM_SMU_ALM0_14_C DFES_FaultTyp.DFC_MOXEMM_SMU_ALM0_2_C DFES_FaultTyp.DFC_MOXEMM_SMU_ALM0_22_C DFES_FaultTyp.DFC_MOXEMM_SMU_ALM0_23_C DFES_FaultTyp.DFC_MOXEMM_SMU_ALM0_4_C DFES_FaultTyp.DFC_MOXEMM_SMU_ALM0_5_C DFES_FaultTyp.DFC_MOXEMM_SMU_ALM0_7_C DFES_FaultTyp.DFC_MOXEMM_SMU_ALM0_8_C DFES_FaultTyp.DFC_MOXEMM_SMU_ALM10_16_C DFES_FaultTyp.DFC_MOXEMM_SMU_ALM10_17_C DFES_FaultTyp.DFC_MOXEMM_SMU_ALM10_21_C DFES_FaultTyp.DFC_MOXEMM_SMU_ALM11_0_C DFES_FaultTyp.DFC_MOXEMM_SMU_ALM11_1_C DFES_FaultTyp.DFC_MOXEMM_SMU_ALM11_2_C DFES_FaultTyp.DFC_MOXEMM_SMU_ALM11_3_C DFES_FaultTyp.DFC_MOXEMM_SMU_ALM11_4_C DFES_FaultTyp.DFC_MOXEMM_SMU_ALM11_5_C DFES_FaultTyp.DFC_MOXEMM_SMU_ALM11_8_C DFES_FaultTyp.DFC_MOXEMM_SMU_ALM11_9_C DFES_FaultTyp.DFC_MOXEMM_SMU_ALM1_0_C DFES_FaultTyp.DFC_MOXEMM_SMU_ALM1_1_C DFES_FaultTyp.DFC_MOXEMM_SMU_ALM1_10_C DFES_FaultTyp.DFC_MOXEMM_SMU_ALM1_11_C DFES_FaultTyp.DFC_MOXEMM_SMU_ALM1_13_C DFES_FaultTyp.DFC_MOXEMM_SMU_ALM1_14_C DFES_FaultTyp.DFC_MOXEMM_SMU_ALM1_2_C DFES_FaultTyp.DFC_MOXEMM_SMU_ALM1_22_C DFES_FaultTyp.DFC_MOXEMM_SMU_ALM1_23_C DFES_FaultTyp.DFC_MOXEMM_SMU_ALM1_4_C DFES_FaultTyp.DFC_MOXEMM_SMU_ALM1_5_C DFES_FaultTyp.DFC_MOXEMM_SMU_ALM1_7_C DFES_FaultTyp.DFC_MOXEMM_SMU_ALM1_8_C DFES_FaultTyp.DFC_MOXEMM_SMU_ALM21_0_C DFES_FaultTyp.DFC_MOXEMM_SMU_ALM21_16_C DFES_FaultTyp.DFC_MOXEMM_SMU_ALM21_3_C DFES_FaultTyp.DFC_MOXEMM_SMU_ALM2_1_C DFES_FaultTyp.DFC_MOXEMM_SMU_ALM2_10_C DFES_FaultTyp.DFC_MOXEMM_SMU_ALM2_11_C DFES_FaultTyp.DFC_MOXEMM_SMU_ALM2_13_C DFES_FaultTyp.DFC_MOXEMM_SMU_ALM2_14_C DFES_FaultTyp.DFC_MOXEMM_SMU_ALM2_22_C DFES_FaultTyp.DFC_MOXEMM_SMU_ALM2_23_C DFES_FaultTyp.DFC_MOXEMM_SMU_ALM2_4_C DFES_FaultTyp.DFC_MOXEMM_SMU_ALM2_5_C DFES_FaultTyp.DFC_MOXEMM_SMU_ALM2_7_C DFES_FaultTyp.DFC_MOXEMM_SMU_ALM2_8_C DFES_FaultTyp.DFC_MOXEMM_SMU_ALM6_0_C DFES_FaultTyp.DFC_MOXEMM_SMU_ALM6_11_C DFES_FaultTyp.DFC_MOXEMM_SMU_ALM6_12_C DFES_FaultTyp.DFC_MOXEMM_SMU_ALM6_14_C DFES_FaultTyp.DFC_MOXEMM_SMU_ALM6_15_C DFES_FaultTyp.DFC_MOXEMM_SMU_ALM6_17_C DFES_FaultTyp.DFC_MOXEMM_SMU_ALM6_18_C DFES_FaultTyp.DFC_MOXEMM_SMU_ALM6_20_C DFES_FaultTyp.DFC_MOXEMM_SMU_ALM6_21_C DFES_FaultTyp.DFC_MOXEMM_SMU_ALM6_25_C DFES_FaultTyp.DFC_MOXEMM_SMU_ALM6_4_C DFES_FaultTyp.DFC_MOXEMM_SMU_ALM6_5_C DFES_FaultTyp.DFC_MOXEMM_SMU_ALM6_7_C DFES_FaultTyp.DFC_MOXEMM_SMU_ALM6_8_C DFES_FaultTyp.DFC_MOXEMM_SMU_ALM7_1_C DFES_FaultTyp.DFC_MOXEMM_SMU_ALM7_12_C DFES_FaultTyp.DFC_MOXEMM_SMU_ALM7_13_C DFES_FaultTyp.DFC_MOXEMM_SMU_ALM7_14_C DFES_FaultTyp.DFC_MOXEMM_SMU_ALM7_15_C DFES_FaultTyp.DFC_MOXEMM_SMU_ALM7_16_C DFES_FaultTyp.DFC_MOXEMM_SMU_ALM7_17_C DFES_FaultTyp.DFC_MOXEMM_SMU_ALM7_2_C DFES_FaultTyp.DFC_MOXEMM_SMU_ALM7_20_C DFES_FaultTyp.DFC_MOXEMM_SMU_ALM7_25_C DFES_FaultTyp.DFC_MOXEMM_SMU_ALM7_26_C DFES_FaultTyp.DFC_MOXEMM_SMU_ALM7_28_C DFES_FaultTyp.DFC_MOXEMM_SMU_ALM7_29_C DFES_FaultTyp.DFC_MOXEMM_SMU_ALM7_30_C DFES_FaultTyp.DFC_MOXEMM_SMU_ALM7_31_C DFES_FaultTyp.DFC_MOXEMM_SMU_ALM8_0_C DFES_FaultTyp.DFC_MOXEMM_SMU_ALM8_1_C DFES_FaultTyp.DFC_MOXEMM_SMU_ALM8_10_C DFES_FaultTyp.DFC_MOXEMM_SMU_ALM8_11_C DFES_FaultTyp.DFC_MOXEMM_SMU_ALM8_12_C DFES_FaultTyp.DFC_MOXEMM_SMU_ALM8_16_C DFES_FaultTyp.DFC_MOXEMM_SMU_ALM8_18_C DFES_FaultTyp.DFC_MOXEMM_SMU_ALM8_2_C DFES_FaultTyp.DFC_MOXEMM_SMU_ALM8_3_C DFES_FaultTyp.DFC_MOXEMM_SMU_ALM8_31_C DFES_FaultTyp.DFC_MOXEMM_SMU_ALM8_4_C DFES_FaultTyp.DFC_MOXEMM_SMU_ALM9_0_C DFES_FaultTyp.DFC_MOXEMM_SMU_ALM9_15_C DFES_FaultTyp.DFC_MOXEMM_SMU_ALM9_3_C DFES_FaultTyp.DFC_MoCADCNTP_C DFES_FaultTyp.DFC_MoCADCTst_C DFES_FaultTyp.DFC_MoCSOPICO_C DFES_FaultTyp.DFC_MoFAPP_C DFES_FaultTyp.DFC_MoFAirFilgPrdc_C DFES_FaultTyp.DFC_MoFAirFlCtOffPfi_C DFES_FaultTyp.DFC_MoFAirFlCylPfi_C DFES_FaultTyp.DFC_MoFAirFlIn_C DFES_FaultTyp.DFC_MoFAirFlMixCtlPfiChkAirFl_C DFES_FaultTyp.DFC_MoFAirFlMixCtlPfiChkCtrl_C DFES_FaultTyp.DFC_MoFAirFlMode_C DFES_FaultTyp.DFC_MoFESpd_C DFES_FaultTyp.DFC_MoFIACo_C DFES_FaultTyp.DFC_MoFICOL1_C DFES_FaultTyp.DFC_MoFICOL2_C DFES_FaultTyp.DFC_MoFStrt_C DFES_FaultTyp.DFC_MoFTrqCmp_C DFES_FaultTyp.DFC_MoFTrqCmpMax_C DFES_FaultTyp.DFC_MoFTrqCmpMin_C DFES_FaultTyp.DFC_MoFVarPostBldSel_C DFES_FaultTyp.DFC_MoXEMMHwLTMCUFW_C DFES_FaultTyp.DFC_MoXEMMHwLTMonBIST_C DFES_FaultTyp.DFC_MoXEMMHwLTRegMonTest_C DFES_FaultTyp.DFC_MoXEMMHwLTStbySMUAlvTest_C DFES_FaultTyp.DFC_MoXEMMHwLTTempSens_C DFES_FaultTyp.DFC_MoXEMMHwLTUCBCfg_C DFES_FaultTyp.DFC_OCWDAABEActv_C DFES_FaultTyp.DFC_OCWDACom_C DFES_FaultTyp.DFC_OCWDAErrPin_C DFES_FaultTyp.DFC_OCWDAOvrVltg_C DFES_FaultTyp.DFC_ORAmax_C DFES_FaultTyp.DFC_ORAmin_C DFES_FaultTyp.DFC_PLLSUmax_C DFES_FaultTyp.DFC_PLLSUmin_C DFES_FaultTyp.DFC_PSR1max_C DFES_FaultTyp.DFC_PSRBmax_C DFES_FaultTyp.DFC_PSRBmin_C DFES_FaultTyp.DFC_PSRPmax_C DFES_FaultTyp.DFC_PSRPmin_C DFES_FaultTyp.DFC_PSRPsig_C DFES_FaultTyp.DFC_PSRmax_C DFES_FaultTyp.DFC_PUmax_C DFES_FaultTyp.DFC_P_VSE11_OL_C DFES_FaultTyp.DFC_P_VSE11_SCB_C DFES_FaultTyp.DFC_P_VSE11_SCG_C DFES_FaultTyp.DFC_PhyHighAPP1_C DFES_FaultTyp.DFC_PhyHighAPP2_C DFES_FaultTyp.DFC_PhyLowAPP1_C DFES_FaultTyp.DFC_PhyLowAPP2_C DFES_FaultTyp.DFC_SRCHighAPP1_C DFES_FaultTyp.DFC_SRCHighAPP2_C DFES_FaultTyp.DFC_SRCLowAPP1_C DFES_FaultTyp.DFC_SRCLowAPP2_C DFES_FaultTyp.DFC_SSpMon2_C DFES_FaultTyp.DFC_SWReset_0_C DFES_FaultTyp.DFC_SWReset_1_C DFES_FaultTyp.DFC_SWReset_2_C DFES_FaultTyp.DFC_SyncAPP_C DFES_FaultTyp.DFC_TAmax_Dummy_C DFES_FaultTyp.DFC_TKAEmax_C DFES_FaultTyp.DFC_TKAEmin_C DFES_FaultTyp.DFC_TKARmax_C DFES_FaultTyp.DFC_TKARnpl_C DFES_FaultTyp.DFC_TMmax_Dummy_C DFES_FaultTyp.DFC_TUMmax_Dummy_C DFES_FaultTyp.DFC_TWCDPriCatB1_C DFES_FaultTyp.DFC_ThrVlvClsdPosnFirstOffsLrnImpoB1_C DFES_FaultTyp.DFC_ThrVlvClsdPosnOffsLrnImpoB1_C DFES_FaultTyp.DFC_ThrVlvClsdPosnOffsLrnMaxB1_C DFES_FaultTyp.DFC_ThrVlvClsdPosnOffsLrnMinB1_C DFES_FaultTyp.DFC_ThrVlvCtrlDeB1_C DFES_FaultTyp.DFC_ThrVlvDycB1_C DFES_FaultTyp.DFC_ThrVlvLimpAirPosnMaxAbsltDriftB1_C DFES_FaultTyp.DFC_ThrVlvLimpAirPosnMaxB1_C DFES_FaultTyp.DFC_ThrVlvLimpAirPosnMaxRelDriftB1_C DFES_FaultTyp.DFC_ThrVlvLimpAirPosnMinB1_C DFES_FaultTyp.DFC_ThrVlvOpenLoadB1_C DFES_FaultTyp.DFC_ThrVlvOpenSprgB1_C DFES_FaultTyp.DFC_ThrVlvOpenSprgSprdB1_C DFES_FaultTyp.DFC_ThrVlvOpenSprgTwnB1_C DFES_FaultTyp.DFC_ThrVlvOverTB1_C DFES_FaultTyp.DFC_ThrVlvRetSprgB1_C DFES_FaultTyp.DFC_ThrVlvRetSprgSprdB1_C DFES_FaultTyp.DFC_ThrVlvRetSprgTwnB1_C DFES_FaultTyp.DFC_ThrVlvSens1MaxB1_C DFES_FaultTyp.DFC_ThrVlvSens1NplB1_C DFES_FaultTyp.DFC_ThrVlvSens2MaxB1_C DFES_FaultTyp.DFC_ThrVlvSens2MinB1_C DFES_FaultTyp.DFC_ThrVlvSens2NplB1_C DFES_FaultTyp.DFC_ThrVlvShoCircB1_C DFES_FaultTyp.DFC_ThrVlvSpiErrB1_C DFES_FaultTyp.DFC_ThrvlvSens1MinB1_C DFES_FaultTyp.DFC_TiOffTBasdChkFast_C DFES_FaultTyp.DFC_TiOffTBasdChkSlow_C DFES_FaultTyp.DFC_UEGOHeatrCtlS1B1_C DFES_FaultTyp.DFC_UEGOSnsrMntdS1B1_C DFES_FaultTyp.DFC_VehVSig_C DFES_FaultTyp.DFC_VlvLftFbSwtIntk11SpclFail_C DFES_FaultTyp.DFC_VlvLftFbSwtIntk11StdFail_C DFES_GrpRpr.DFC_Unused_C DFES_GrpRpr.DFC_AltIOACGFailr_C DFES_GrpRpr.DFC_AltIOACGHiVltg_C DFES_GrpRpr.DFC_AltIOACGLoVltg_C DFES_GrpRpr.DFC_AltIOACGTHi_C DFES_GrpRpr.DFC_AltIODConnACG_C DFES_GrpRpr.DFC_BattUHiFailr_C DFES_GrpRpr.DFC_BattULoFailr_C DFES_GrpRpr.DFC_BrkBstPDriftHiErr_C DFES_GrpRpr.DFC_BrkBstPDriftLoErr_C /end DEF_CHARACTERISTIC
 FUNCTION_VERSION "30000.73.0_2.0.0" /end FUNCTION
/begin COMPU_METHOD DFC_Verb "" TAB_VERB "%6.3" "-" COMPU_TAB_REF DFC_Verb /end COMPU_METHOD
/begin COMPU_VTAB DFC_Verb "" TAB_VERB 704 0 "DFC_Unused" 318 "DFC_ACEvpTSRCMax" 319 "DFC_ACEvpTSRCMin" 320 "DFC_AirCClntPAnaSRCMax" 321 "DFC_AirCClntPAnaSRCMin" 259 "DFC_AirCCmprOL" 260 "DFC_AirCCmprOvrTemp" 261 "DFC_AirCCmprSCB" 262 "DFC_AirCCmprSCG" 322 "DFC_AirCSwtNpl" 323 "DFC_AirCSwtSig" 263 "DFC_AltErr" 1 "DFC_AltIOACGFailr" 2 "DFC_AltIOACGHiVltg" 3 "DFC_AltIOACGLoVltg" 4 "DFC_AltIOACGTHi" 5 "DFC_AltIODConnACG" 429 "DFC_AppAllSnsrDfct" 6 "DFC_BattUHiFailr" 7 "DFC_BattULoFailr" 264 "DFC_BattUSRCMax" 265 "DFC_BattUSRCMin" 430 "DFC_BattUStdbyDiaOL" 431 "DFC_BigLeakIntkMnfldEmiInfl" 324 "DFC_Brk" 8 "DFC_BrkBstPDriftHiErr" 9 "DFC_BrkBstPDriftLoErr" 10 "DFC_BrkBstPSnsrStuck" 11 "DFC_BrkMnSwtContOn" 432 "DFC_BrkMnSwtContOnWarnLmp" 12 "DFC_BrkMnSwtNotStp" 433 "DFC_BrkMnSwtNotStpWarnLmp" 13 "DFC_BrkNpl" 14 "DFC_BrkRdntSwtContOn" 434 "DFC_BrkRdntSwtContOnWarnLmp" 15 "DFC_BrkRdntSwtNotStp" 435 "DFC_BrkRdntSwtNotStpWarnLmp" 325 "DFC_BrkSig" 417 "DFC_BSWM_E_ACTION_FAILED" 418 "DFC_BSWM_E_INTRPTQUEUE_FULL" 393 "DFC_BusDiagCANAPPLBusOff" 394 "DFC_BusDiagCANCANCBusOff" 395 "DFC_BusDiagCANVEHICLEBusOff" 411 "DFC_CAN_E_TIMEOUT" 436 "DFC_CEngDsTColdStrtMax" 437 "DFC_CEngDsTColdStrtMin" 438 "DFC_CEngDsTImps" 439 "DFC_CEngDsTPlausLSC" 440 "DFC_CEngDsTPlausSTC" 443 "DFC_CEngDsTSig" 441 "DFC_CEngDsTSRCMax" 442 "DFC_CEngDsTSRCMin" 444 "DFC_CEngUsTSRCMax" 445 "DFC_CEngUsTSRCMin" 366 "DFC_Clth2ONStuck" 367 "DFC_Clth2ONStuckLdc" 16 "DFC_Clth3ONStuck" 368 "DFC_Clth3ONStuckLdc" 369 "DFC_Clth3ONStuckPostDrv" 17 "DFC_Clth4OFFStuck" 370 "DFC_Clth4ONStuck" 371 "DFC_Clth4ONStuckLdc" 236 "DFC_ClthMax" 336 "DFC_ClthNpl" 18 "DFC_ClthOFFStuck" 19 "DFC_ClthONStuck" 326 "DFC_ClthSig" 20 "DFC_ClthStkFailInfo" 21 "DFC_ComACFailInfo" 22 "DFC_ComATFTValErr" 23 "DFC_ComATMILReq" 24 "DFC_ComAYCAChksum" 25 "DFC_ComAYCARingCnt" 26 "DFC_ComAYCATOut" 27 "DFC_ComAYCDChkSum" 28 "DFC_ComAYCDTOut" 29 "DFC_ComAYCFChksum" 30 "DFC_ComAYCFRingCnt" 31 "DFC_ComAYCFTOut" 32 "DFC_ComAYCGChksum" 33 "DFC_ComAYCGRingCnt" 34 "DFC_ComAYCGTOut" 35 "DFC_ComAYCIChkSum" 36 "DFC_ComAYCIRingCnt" 37 "DFC_ComAYCITOut" 38 "DFC_ComBCM1ChkSum" 39 "DFC_ComBCM1RingCnt" 40 "DFC_ComBCM1TOut" 41 "DFC_ComCANABusOffErr" 42 "DFC_ComCANBBusOffErr" 43 "DFC_ComCANCBusOffErr" 44 "DFC_ComCGW1ChkSum" 45 "DFC_ComCGW1RingCnt" 46 "DFC_ComCGW1TOut" 266 "DFC_ComChksTCU1" 267 "DFC_ComChksTCU11" 268 "DFC_ComChksTCU12" 269 "DFC_ComChksTCU13" 270 "DFC_ComChksTCU2" 271 "DFC_ComChksTCU3" 272 "DFC_ComChksTCU4" 273 "DFC_ComCntTCU1" 274 "DFC_ComCntTCU11" 275 "DFC_ComCntTCU12" 276 "DFC_ComCntTCU13" 277 "DFC_ComCntTCU2" 278 "DFC_ComCntTCU3" 279 "DFC_ComCntTCU4" 47 "DFC_ComConvBoostErr" 48 "DFC_ComConvSlipErr" 372 "DFC_ComDLCTCU01" 373 "DFC_ComDLCTCU02" 374 "DFC_ComDLCTCU1" 375 "DFC_ComDLCTCU11" 376 "DFC_ComDLCTCU12" 377 "DFC_ComDLCTCU13" 378 "DFC_ComDLCTCU14" 379 "DFC_ComDLCTCU2" 380 "DFC_ComDLCTCU3" 381 "DFC_ComDLCTCU4" 49 "DFC_ComEAT10Chksum" 50 "DFC_ComEAT10RingCnt" 51 "DFC_ComEAT10TOut" 52 "DFC_ComEAT11ChkSum" 53 "DFC_ComEAT11RingCnt" 54 "DFC_ComEAT11TOut" 55 "DFC_ComEAT12ChkSum" 56 "DFC_ComEAT12RingCnt" 57 "DFC_ComEAT12TOut" 58 "DFC_ComEAT13ChkSum" 59 "DFC_ComEAT13RingCnt" 60 "DFC_ComEAT13TOut" 61 "DFC_ComEAT1Chksum" 62 "DFC_ComEAT1RingCnt" 63 "DFC_ComEAT1TOut" 64 "DFC_ComEAT2ChkSum" 65 "DFC_ComEAT2RingCnt" 66 "DFC_ComEAT2TOut" 67 "DFC_ComEAT4ChkSum" 68 "DFC_ComEAT4RingCnt" 69 "DFC_ComEAT4TOut" 70 "DFC_ComEAT6Chksum" 71 "DFC_ComEAT6RingCnt" 72 "DFC_ComEAT6TOut" 73 "DFC_ComEAT7Chksum" 74 "DFC_ComEAT7RingCnt" 75 "DFC_ComEAT7TOut" 76 "DFC_ComEAT8Chksum" 77 "DFC_ComEAT8RingCnt" 78 "DFC_ComEAT8TOut" 79 "DFC_ComEATAChksum" 80 "DFC_ComEATARingCnt" 81 "DFC_ComEATATOut" 82 "DFC_ComEATBChkSum" 83 "DFC_ComEATBRingCnt" 84 "DFC_ComEATBTOut" 85 "DFC_ComEATCChksum" 86 "DFC_ComEATCRingCnt" 87 "DFC_ComEATCTOut" 88 "DFC_ComEBBAChksum" 89 "DFC_ComEBBARingCnt" 90 "DFC_ComEBBATOut" 94 "DFC_ComEngCanRxErr" 91 "DFC_ComEPS1Chksum" 92 "DFC_ComEPS1RingCnt" 93 "DFC_ComEPS1TOut" 95 "DFC_ComGrvySnsrErr" 96 "DFC_ComGwIMG1ChkSum" 97 "DFC_ComGwIMG1RingCnt" 98 "DFC_ComGwIMG1TOut" 99 "DFC_ComGwIMG3ChkSum" 100 "DFC_ComGwIMG3RingCnt" 101 "DFC_ComGwIMG3TOut" 102 "DFC_ComGwIMG4ChkSum" 103 "DFC_ComGwIMG4RingCnt" 104 "DFC_ComGwIMG4TOut" 105 "DFC_ComGwIMG5ChkSum" 106 "DFC_ComGwIMG5RingCnt" 107 "DFC_ComGwIMG5TOut" 108 "DFC_ComGwIMG6ChkSum" 109 "DFC_ComGwIMG6RingCnt" 110 "DFC_ComGwIMG6TOut" 111 "DFC_ComIDASBChksum" 112 "DFC_ComIDASBRingCnt" 113 "DFC_ComIDASBTOut" 114 "DFC_ComIMGMILReq" 115 "DFC_ComISSPrms" 116 "DFC_ComMETAChksum" 117 "DFC_ComMETARingCnt" 118 "DFC_ComMETATOut" 119 "DFC_ComMETCChksum" 120 "DFC_ComMETCRingCnt" 121 "DFC_ComMETCTOut" 122 "DFC_ComMETDChksum" 123 "DFC_ComMETDRingCnt" 124 "DFC_ComMETDTOut" 125 "DFC_ComMETE2Chksum" 126 "DFC_ComMETE2RingCnt" 127 "DFC_ComMETE2TOut" 128 "DFC_ComMETFChksum" 129 "DFC_ComMETFRingCnt" 130 "DFC_ComMETFTOut" 131 "DFC_ComMETGChksum" 132 "DFC_ComMETGRingCnt" 133 "DFC_ComMETGTOut" 134 "DFC_ComMETH2Chksum" 135 "DFC_ComMETH2RingCnt" 136 "DFC_ComMETH2TOut" 137 "DFC_ComMETHChksum" 138 "DFC_ComMETHRingCnt" 139 "DFC_ComMETHTOut" 140 "DFC_ComMETIChksum" 141 "DFC_ComMETIRingCnt" 142 "DFC_ComMETITOut" 143 "DFC_ComMETKChksum" 144 "DFC_ComMETKRingCnt" 145 "DFC_ComMETKTOut" 146 "DFC_ComMETLChksum" 147 "DFC_ComMETLRingCnt" 148 "DFC_ComMETLTOut" 149 "DFC_ComMETMChksum" 150 "DFC_ComMETMRingCnt" 151 "DFC_ComMETMTOut" 152 "DFC_ComMETNChksum" 153 "DFC_ComMETNRingCnt" 154 "DFC_ComMETNTOut" 155 "DFC_ComMtrCom" 156 "DFC_ComPCUChkSum" 157 "DFC_ComPCURingCnt" 158 "DFC_ComPCUTOut" 159 "DFC_ComSRSAChksum" 160 "DFC_ComSRSARingCnt" 161 "DFC_ComSRSATOut" 162 "DFC_ComSRSBChksum" 163 "DFC_ComSRSBRingCnt" 164 "DFC_ComSRSBTOut" 165 "DFC_ComSRSChksum" 166 "DFC_ComSRSErr" 167 "DFC_ComSRSRingCnt" 168 "DFC_ComSRSTOut" 280 "DFC_ComTOutTCU01" 281 "DFC_ComTOutTCU02" 282 "DFC_ComTOutTCU1" 283 "DFC_ComTOutTCU11" 284 "DFC_ComTOutTCU12" 285 "DFC_ComTOutTCU13" 286 "DFC_ComTOutTCU14" 287 "DFC_ComTOutTCU2" 288 "DFC_ComTOutTCU3" 289 "DFC_ComTOutTCU4" 169 "DFC_ComVehSpdPndFltTCU" 446 "DFC_DCDCFltDet" 290 "DFC_DevLibBattUHi" 291 "DFC_DevLibBattULo" 449 "DFC_DKnpl" 447 "DFC_DKRSA" 448 "DFC_DKVSmax" 450 "DFC_DSSmax" 451 "DFC_DSTTI" 452 "DFC_DSUmax" 170 "DFC_EbsChartcCurrErr" 171 "DFC_EbsSelfDiagErr" 383 "DFC_EbsSocFlt" 453 "DFC_EGRVlvOL" 454 "DFC_EGRVlvSCB" 455 "DFC_EGRVlvSCG" 456 "DFC_EGSDUS2B1LtrDly" 457 "DFC_EGSDUS2B1LtrPT1" 458 "DFC_EGSDUS2B1RtlDly" 459 "DFC_EGSDUS2B1RtlPT1" 460 "DFC_EGSDUS2B1TarLean" 461 "DFC_EGSDUS2B1TarRich" 464 "DFC_EngICO" 465 "DFC_EngPrtOvrSpdMon" 466 "DFC_EpmCaSI1ErrSig" 467 "DFC_EpmCaSI1NoSig" 468 "DFC_EpmCaSI1OfsErr" 469 "DFC_EpmCrSErrSig" 470 "DFC_EpmCrSNoSig" 471 "DFC_EtaEngIdleNonCsers" 472 "DFC_EtaEngPtlNonCsers" 462 "DFC_ETAKHLmax" 463 "DFC_ETAKHTmax" 337 "DFC_EV1max" 338 "DFC_EV1min" 339 "DFC_EV1sig" 340 "DFC_EV2max" 341 "DFC_EV2min" 342 "DFC_EV2sig" 343 "DFC_EV3max" 344 "DFC_EV3min" 345 "DFC_EV3sig" 346 "DFC_EV4max" 347 "DFC_EV4min" 348 "DFC_EV4sig" 382 "DFC_EVX" 292 "DFC_FanDIOOL_0" 293 "DFC_FanDIOOL_1" 294 "DFC_FanDIOOvrTemp_0" 295 "DFC_FanDIOOvrTemp_1" 296 "DFC_FanDIOSCB_0" 297 "DFC_FanDIOSCB_1" 298 "DFC_FanDIOSCG_0" 299 "DFC_FanDIOSCG_1" 473 "DFC_FRAmax" 474 "DFC_FRAmin" 172 "DFC_GbxCANDigPlausErr" 173 "DFC_GbxNPos1SRCMax" 174 "DFC_GbxNPos1SRCMin" 175 "DFC_GbxNPos2SRCMax" 176 "DFC_GbxNPos2SRCMin" 177 "DFC_GbxNPosAlvChk" 178 "DFC_GbxNPosSyncErr" 349 "DFC_GbxPNPosnDrvCdn" 350 "DFC_GbxPNPosnPlausy" 475 "DFC_GbxRvsSwtStk" 476 "DFC_HDRmax" 477 "DFC_HEGOS2B1ElecMax" 478 "DFC_HEGOS2B1ElecMin" 479 "DFC_HEGOS2B1ElecSig" 480 "DFC_HEGOS2B1HtgNpl" 179 "DFC_HEGOS2B1HtrPsMax" 180 "DFC_HEGOS2B1HtrPsMin" 181 "DFC_HEGOS2B1HtrPsSig" 327 "DFC_HLSDemOvhtEngLim" 384 "DFC_I14229VINErr" 237 "DFC_IgnClPs_DevComErr" 238 "DFC_IgnClPs_LineOl_0" 239 "DFC_IgnClPs_LineOl_1" 240 "DFC_IgnClPs_LineOl_2" 241 "DFC_IgnClPs_LineOl_3" 242 "DFC_IgnClPs_LineScb_0" 243 "DFC_IgnClPs_LineScb_1" 244 "DFC_IgnClPs_LineScb_2" 245 "DFC_IgnClPs_LineScb_3" 246 "DFC_IgnClPs_LineScg_0" 247 "DFC_IgnClPs_LineScg_1" 248 "DFC_IgnClPs_LineScg_2" 249 "DFC_IgnClPs_LineScg_3" 481 "DFC_IntkAirTIntkMnfldCrssMax" 482 "DFC_IntkAirTIntkMnfldCrssMin" 483 "DFC_IntkAirTIntkMnfldHSCMax" 484 "DFC_IntkAirTIntkMnfldImps" 485 "DFC_IntkAirTIntkMnfldPRCMax" 486 "DFC_IntkAirTIntkMnfldPRCMin" 487 "DFC_IntkAirTIntkMnfldSRCMax" 488 "DFC_IntkAirTIntkMnfldSRCMin" 489 "DFC_IntkAirTIntkMnfldSTC" 362 "DFC_KnDetSens1PortAMax" 363 "DFC_KnDetSens1PortAMin" 364 "DFC_KnDetSens1PortBMax" 365 "DFC_KnDetSens1PortBMin" 490 "DFC_KS1max" 491 "DFC_KS1min" 494 "DFC_LamDynDiagS1B1" 495 "DFC_LeakIntkMnfldEmiInfl" 412 "DFC_LIN_E_TIMEOUT" 182 "DFC_LinCSErrACG" 183 "DFC_LinCSErrEBS" 184 "DFC_LinHdrTimeoutErrACG" 185 "DFC_LinHdrTimeoutErrEBS" 186 "DFC_LinMsgTimeoutErrACG" 187 "DFC_LinMsgTimeoutErrEBS" 188 "DFC_LinNoStrtComErr" 385 "DFC_LLRKHmax" 386 "DFC_LLRKHmin" 387 "DFC_LLRmax" 388 "DFC_LLRmin" 492 "DFC_LMmax" 493 "DFC_LZSRnpl" 496 "DFC_MD00max" 497 "DFC_MDBmax" 498 "DFC_MDCat" 499 "DFC_MDCatCrit" 500 "DFC_MDCatCurr" 501 "DFC_MDCyl_0" 502 "DFC_MDCyl_1" 503 "DFC_MDCyl_2" 504 "DFC_MDCyl_3" 505 "DFC_MDEmi" 506 "DFC_MDEmiStrt" 507 "DFC_MDFco" 510 "DFC_MDmax" 508 "DFC_MDMpl" 509 "DFC_MDSegTiAdpn" 205 "DFC_MisfDetdVWhlFrntLePlaus" 206 "DFC_MisfDetdVWhlFrntRiPlaus" 207 "DFC_MisfDetdVWhlReLePlaus" 208 "DFC_MisfDetdVWhlReRiPlaus" 189 "DFC_MisfDetVWhlFrntLeOORHi" 190 "DFC_MisfDetVWhlFrntLeRatyHi" 191 "DFC_MisfDetVWhlFrntLeRatyLo" 192 "DFC_MisfDetVWhlFrntLeStuck" 193 "DFC_MisfDetVWhlFrntRiOORHi" 194 "DFC_MisfDetVWhlFrntRiRatyHi" 195 "DFC_MisfDetVWhlFrntRiRatyLo" 196 "DFC_MisfDetVWhlFrntRiStuck" 197 "DFC_MisfDetVWhlReLeOORHi" 198 "DFC_MisfDetVWhlReLeRatyHi" 199 "DFC_MisfDetVWhlReLeRatyLo" 200 "DFC_MisfDetVWhlReLeStuck" 201 "DFC_MisfDetVWhlReRiOORHi" 202 "DFC_MisfDetVWhlReRiRatyHi" 203 "DFC_MisfDetVWhlReRiRatyLo" 204 "DFC_MisfDetVWhlReRiStuck" 605 "DFC_MoCADCNTP" 606 "DFC_MoCADCTst" 607 "DFC_MoCSOPICO" 609 "DFC_MoFAirFilgPrdc" 610 "DFC_MoFAirFlCtOffPfi" 611 "DFC_MoFAirFlCylPfi" 612 "DFC_MoFAirFlIn" 613 "DFC_MoFAirFlMixCtlPfiChkAirFl" 614 "DFC_MoFAirFlMixCtlPfiChkCtrl" 615 "DFC_MoFAirFlMode" 608 "DFC_MoFAPP" 616 "DFC_MoFESpd" 617 "DFC_MoFIACo" 618 "DFC_MoFICOL1" 619 "DFC_MoFICOL2" 620 "DFC_MoFStrt" 621 "DFC_MoFTrqCmp" 622 "DFC_MoFTrqCmpMax" 623 "DFC_MoFTrqCmpMin" 624 "DFC_MoFVarPostBldSel" 511 "DFC_MOXEMM_SMU_ALM0_0" 512 "DFC_MOXEMM_SMU_ALM0_1" 513 "DFC_MOXEMM_SMU_ALM0_10" 514 "DFC_MOXEMM_SMU_ALM0_11" 515 "DFC_MOXEMM_SMU_ALM0_13" 516 "DFC_MOXEMM_SMU_ALM0_14" 517 "DFC_MOXEMM_SMU_ALM0_2" 518 "DFC_MOXEMM_SMU_ALM0_22" 519 "DFC_MOXEMM_SMU_ALM0_23" 520 "DFC_MOXEMM_SMU_ALM0_4" 521 "DFC_MOXEMM_SMU_ALM0_5" 522 "DFC_MOXEMM_SMU_ALM0_7" 523 "DFC_MOXEMM_SMU_ALM0_8" 524 "DFC_MOXEMM_SMU_ALM10_16" 525 "DFC_MOXEMM_SMU_ALM10_17" 526 "DFC_MOXEMM_SMU_ALM10_21" 527 "DFC_MOXEMM_SMU_ALM11_0" 528 "DFC_MOXEMM_SMU_ALM11_1" 529 "DFC_MOXEMM_SMU_ALM11_2" 530 "DFC_MOXEMM_SMU_ALM11_3" 531 "DFC_MOXEMM_SMU_ALM11_4" 532 "DFC_MOXEMM_SMU_ALM11_5" 533 "DFC_MOXEMM_SMU_ALM11_8" 534 "DFC_MOXEMM_SMU_ALM11_9" 535 "DFC_MOXEMM_SMU_ALM1_0" 536 "DFC_MOXEMM_SMU_ALM1_1" 537 "DFC_MOXEMM_SMU_ALM1_10" 538 "DFC_MOXEMM_SMU_ALM1_11" 539 "DFC_MOXEMM_SMU_ALM1_13" 540 "DFC_MOXEMM_SMU_ALM1_14" 541 "DFC_MOXEMM_SMU_ALM1_2" 542 "DFC_MOXEMM_SMU_ALM1_22" 543 "DFC_MOXEMM_SMU_ALM1_23" 544 "DFC_MOXEMM_SMU_ALM1_4" 545 "DFC_MOXEMM_SMU_ALM1_5" 546 "DFC_MOXEMM_SMU_ALM1_7" 547 "DFC_MOXEMM_SMU_ALM1_8" 548 "DFC_MOXEMM_SMU_ALM21_0" 549 "DFC_MOXEMM_SMU_ALM21_16" 550 "DFC_MOXEMM_SMU_ALM21_3" 551 "DFC_MOXEMM_SMU_ALM2_1" 552 "DFC_MOXEMM_SMU_ALM2_10" 553 "DFC_MOXEMM_SMU_ALM2_11" 554 "DFC_MOXEMM_SMU_ALM2_13" 555 "DFC_MOXEMM_SMU_ALM2_14" 556 "DFC_MOXEMM_SMU_ALM2_22" 557 "DFC_MOXEMM_SMU_ALM2_23" 558 "DFC_MOXEMM_SMU_ALM2_4" 559 "DFC_MOXEMM_SMU_ALM2_5" 560 "DFC_MOXEMM_SMU_ALM2_7" 561 "DFC_MOXEMM_SMU_ALM2_8" 562 "DFC_MOXEMM_SMU_ALM6_0" 563 "DFC_MOXEMM_SMU_ALM6_11" 564 "DFC_MOXEMM_SMU_ALM6_12" 565 "DFC_MOXEMM_SMU_ALM6_14" 566 "DFC_MOXEMM_SMU_ALM6_15" 567 "DFC_MOXEMM_SMU_ALM6_17" 568 "DFC_MOXEMM_SMU_ALM6_18" 569 "DFC_MOXEMM_SMU_ALM6_20" 570 "DFC_MOXEMM_SMU_ALM6_21" 571 "DFC_MOXEMM_SMU_ALM6_25" 572 "DFC_MOXEMM_SMU_ALM6_4" 573 "DFC_MOXEMM_SMU_ALM6_5" 574 "DFC_MOXEMM_SMU_ALM6_7" 575 "DFC_MOXEMM_SMU_ALM6_8" 576 "DFC_MOXEMM_SMU_ALM7_1" 577 "DFC_MOXEMM_SMU_ALM7_12" 578 "DFC_MOXEMM_SMU_ALM7_13" 579 "DFC_MOXEMM_SMU_ALM7_14" 580 "DFC_MOXEMM_SMU_ALM7_15" 581 "DFC_MOXEMM_SMU_ALM7_16" 582 "DFC_MOXEMM_SMU_ALM7_17" 583 "DFC_MOXEMM_SMU_ALM7_2" 584 "DFC_MOXEMM_SMU_ALM7_20" 585 "DFC_MOXEMM_SMU_ALM7_25" 586 "DFC_MOXEMM_SMU_ALM7_26" 587 "DFC_MOXEMM_SMU_ALM7_28" 588 "DFC_MOXEMM_SMU_ALM7_29" 589 "DFC_MOXEMM_SMU_ALM7_30" 590 "DFC_MOXEMM_SMU_ALM7_31" 591 "DFC_MOXEMM_SMU_ALM8_0" 592 "DFC_MOXEMM_SMU_ALM8_1" 593 "DFC_MOXEMM_SMU_ALM8_10" 594 "DFC_MOXEMM_SMU_ALM8_11" 595 "DFC_MOXEMM_SMU_ALM8_12" 596 "DFC_MOXEMM_SMU_ALM8_16" 597 "DFC_MOXEMM_SMU_ALM8_18" 598 "DFC_MOXEMM_SMU_ALM8_2" 599 "DFC_MOXEMM_SMU_ALM8_3" 600 "DFC_MOXEMM_SMU_ALM8_31" 601 "DFC_MOXEMM_SMU_ALM8_4" 602 "DFC_MOXEMM_SMU_ALM9_0" 603 "DFC_MOXEMM_SMU_ALM9_15" 604 "DFC_MOXEMM_SMU_ALM9_3" 625 "DFC_MoXEMMHwLTMCUFW" 626 "DFC_MoXEMMHwLTMonBIST" 627 "DFC_MoXEMMHwLTRegMonTest" 628 "DFC_MoXEMMHwLTStbySMUAlvTest" 629 "DFC_MoXEMMHwLTTempSens" 630 "DFC_MoXEMMHwLTUCBCfg" 300 "DFC_MRlyDcOL" 301 "DFC_MRlyDcSCB" 302 "DFC_MRlyDcSCG" 413 "DFC_MRlyOL" 414 "DFC_MRlySCB" 415 "DFC_MRlySCG" 631 "DFC_OCWDAABEActv" 632 "DFC_OCWDACom" 633 "DFC_OCWDAErrPin" 634 "DFC_OCWDAOvrVltg" 328 "DFC_OilPNpl" 635 "DFC_ORAmax" 636 "DFC_ORAmin" 647 "DFC_P_VSE11_OL" 648 "DFC_P_VSE11_SCB" 649 "DFC_P_VSE11_SCG" 351 "DFC_PEnvCcMax" 352 "DFC_PEnvCcMin" 353 "DFC_PEnvRngChkMax" 354 "DFC_PEnvRngChkMin" 209 "DFC_PEnvSigRngMax" 210 "DFC_PEnvSigRngMin" 355 "DFC_PEnvSnsrPlaus" 650 "DFC_PhyHighAPP1" 651 "DFC_PhyHighAPP2" 652 "DFC_PhyLowAPP1" 653 "DFC_PhyLowAPP2" 329 "DFC_PIntkVUsLineHiB1" 330 "DFC_PIntkVUsLineLoB1" 637 "DFC_PLLSUmax" 638 "DFC_PLLSUmin" 303 "DFC_PSPOL" 304 "DFC_PSPOvrTemp" 305 "DFC_PSPSCB" 306 "DFC_PSPSCG" 639 "DFC_PSR1max" 640 "DFC_PSRBmax" 641 "DFC_PSRBmin" 645 "DFC_PSRmax" 642 "DFC_PSRPmax" 643 "DFC_PSRPmin" 644 "DFC_PSRPsig" 646 "DFC_PUmax" 396 "DFC_RBA_IODIAGPWR_rba_IoExtCy329_SignalVltSply_0" 397 "DFC_RBA_IODIAGPWR_rba_IoExtCy329_SignalVltSply_0OT" 398 "DFC_RBA_IODIAGPWR_rba_IoExtCy329_SignalVltSply_0OV" 399 "DFC_RBA_IODIAGPWR_rba_IoExtCy329_SignalVltSply_0SCG" 400 "DFC_RBA_IODIAGPWR_rba_IoExtCy329_SignalVltSply_0UV" 401 "DFC_RBA_IODIAGPWR_rba_IoExtCy329_SignalVltSply_1" 402 "DFC_RBA_IODIAGPWR_rba_IoExtCy329_SignalVltSply_1OT" 403 "DFC_RBA_IODIAGPWR_rba_IoExtCy329_SignalVltSply_1OV" 404 "DFC_RBA_IODIAGPWR_rba_IoExtCy329_SignalVltSply_1SCG" 405 "DFC_RBA_IODIAGPWR_rba_IoExtCy329_SignalVltSply_1UV" 406 "DFC_RBA_IODIAGPWR_rba_IoExtCy329_SignalVltSply_2" 407 "DFC_RBA_IODIAGPWR_rba_IoExtCy329_SignalVltSply_2OT" 408 "DFC_RBA_IODIAGPWR_rba_IoExtCy329_SignalVltSply_2OV" 409 "DFC_RBA_IODIAGPWR_rba_IoExtCy329_SignalVltSply_2SCG" 410 "DFC_RBA_IODIAGPWR_rba_IoExtCy329_SignalVltSply_2UV" 419 "DFC_RBA_IOEXTLIB_KEEPALIVE_DRV" 420 "DFC_RBA_IOEXTLIB_KEEPALIVE_INI" 421 "DFC_rba_IoSigRtc_StopCounter" 423 "DFC_rba_MemDiag_MemReadErr" 424 "DFC_rba_MemDiag_MemWrErr" 422 "DFC_rba_MRly_Diag_Stk_Event" 416 "DFC_rba_MultiStackTrace_Threshold" 425 "DFC_rba_SyC_IrrSwOffTrigEngRun_Event" 426 "DFC_rba_T15_Diag_ComInVld_Event" 427 "DFC_rba_T15_Diag_ComOff_HwOn_Event" 428 "DFC_rba_T15_Diag_ComOn_HwOff_Event" 389 "DFC_RoughRoad" 390 "DFC_SiaEEPRdErr" 391 "DFC_SiaEEPWrngCod" 654 "DFC_SRCHighAPP1" 655 "DFC_SRCHighAPP2" 656 "DFC_SRCLowAPP1" 657 "DFC_SRCLowAPP2" 658 "DFC_SSpMon2" 211 "DFC_StmFault" 213 "DFC_StrtCtlErr" 212 "DFC_StrtCtOffPth" 214 "DFC_StrtFault" 215 "DFC_StrtLckJudg1" 216 "DFC_StrtLckJudg2" 217 "DFC_StrtOL" 218 "DFC_StrtOL2" 219 "DFC_StrtSCB" 220 "DFC_StrtSCB2" 221 "DFC_StrtSCG" 222 "DFC_StrtSCG2" 223 "DFC_StrtStkRly1" 224 "DFC_StrtStkRly2" 659 "DFC_SWReset_0" 660 "DFC_SWReset_1" 661 "DFC_SWReset_2" 662 "DFC_SyncAPP" 307 "DFC_T50Err" 663 "DFC_TAmax_Dummy" 225 "DFC_TEVEmax" 226 "DFC_TEVEmin" 227 "DFC_TEVEsig" 671 "DFC_ThrVlvClsdPosnFirstOffsLrnImpoB1" 672 "DFC_ThrVlvClsdPosnOffsLrnImpoB1" 673 "DFC_ThrVlvClsdPosnOffsLrnMaxB1" 674 "DFC_ThrVlvClsdPosnOffsLrnMinB1" 675 "DFC_ThrVlvCtrlDeB1" 676 "DFC_ThrVlvDycB1" 677 "DFC_ThrVlvLimpAirPosnMaxAbsltDriftB1" 678 "DFC_ThrVlvLimpAirPosnMaxB1" 679 "DFC_ThrVlvLimpAirPosnMaxRelDriftB1" 680 "DFC_ThrVlvLimpAirPosnMinB1" 308 "DFC_ThrVlvLoBattB1" 681 "DFC_ThrVlvOpenLoadB1" 682 "DFC_ThrVlvOpenSprgB1" 683 "DFC_ThrVlvOpenSprgSprdB1" 684 "DFC_ThrVlvOpenSprgTwnB1" 685 "DFC_ThrVlvOverTB1" 686 "DFC_ThrVlvRetSprgB1" 687 "DFC_ThrVlvRetSprgSprdB1" 688 "DFC_ThrVlvRetSprgTwnB1" 689 "DFC_ThrVlvSens1MaxB1" 696 "DFC_ThrvlvSens1MinB1" 690 "DFC_ThrVlvSens1NplB1" 691 "DFC_ThrVlvSens2MaxB1" 692 "DFC_ThrVlvSens2MinB1" 693 "DFC_ThrVlvSens2NplB1" 694 "DFC_ThrVlvShoCircB1" 695 "DFC_ThrVlvSpiErrB1" 697 "DFC_TiOffTBasdChkFast" 698 "DFC_TiOffTBasdChkSlow" 664 "DFC_TKAEmax" 665 "DFC_TKAEmin" 666 "DFC_TKARmax" 667 "DFC_TKARnpl" 668 "DFC_TMmax_Dummy" 669 "DFC_TUMmax_Dummy" 670 "DFC_TWCDPriCatB1" 250 "DFC_UEGOASICS1B1" 392 "DFC_UegoDummy" 699 "DFC_UEGOHeatrCtlS1B1" 356 "DFC_UEGOHeatrPsS1B1Max" 357 "DFC_UEGOHeatrPsS1B1Min" 358 "DFC_UEGOHeatrPsS1B1Sig" 359 "DFC_UEGOHeatrRlyPsOLS1B1" 360 "DFC_UEGOHeatrRlyPsSCBS1B1" 361 "DFC_UEGOHeatrRlyPsSCGS1B1" 257 "DFC_UegoOlApesS1B1" 251 "DFC_UEGOOLIPES1B1" 258 "DFC_UegoOlRCmpS1B1" 252 "DFC_UEGOOLRES1B1" 253 "DFC_UEGOSCBS1B1" 254 "DFC_UEGOSCGS1B1" 700 "DFC_UEGOSnsrMntdS1B1" 256 "DFC_UEGOSnsrS1B1" 255 "DFC_UEGOSPIS1B1" 228 "DFC_VehVAllPlaus" 229 "DFC_VehVNCSnsrElecFailr" 309 "DFC_VehVPhysRngHi" 331 "DFC_VehVPhysRngLo" 230 "DFC_VehVPlausCan" 231 "DFC_VehVPlausFco" 232 "DFC_VehVPlausPwr" 233 "DFC_VehVPlausV2N" 310 "DFC_VehVSclOutOL" 311 "DFC_VehVSclOutOT" 312 "DFC_VehVSclOutSCB" 313 "DFC_VehVSclOutSCG" 701 "DFC_VehVSig" 332 "DFC_VehVSigCan" 333 "DFC_VehVSigCanSafe" 314 "DFC_VehVSnsrARngHi" 315 "DFC_VehVSnsrBRngHi" 316 "DFC_VehVSpdRtyDiag" 234 "DFC_VehVSpdSnsrAElecFailr" 235 "DFC_VehVSpdSnsrBElecFailr" 317 "DFC_VehVWhlErr" 334 "DFC_VlvLftFbOilPSnsrIntk11SRCMax" 335 "DFC_VlvLftFbOilPSnsrIntk11SRCMin" 702 "DFC_VlvLftFbSwtIntk11SpclFail" 703 "DFC_VlvLftFbSwtIntk11StdFail" DEFAULT_VALUE "---" /end COMPU_VTAB
/begin COMPU_METHOD DFES_OneToOne "" RAT_FUNC "%6.2" "-" COEFFS 0 1 0 0 0 1 /end COMPU_METHOD
/begin RECORD_LAYOUT Val_Wu16 FNC_VALUES 1 UWORD COLUMN_DIR DIRECT /end RECORD_LAYOUT
/begin RECORD_LAYOUT Val_Wu8 FNC_VALUES 1 UBYTE COLUMN_DIR DIRECT /end RECORD_LAYOUT
/end MODULE
/end PROJECT
