ASAP2_VERSION 1 60
/begin PROJECT MG1CA020 "MG1CA020"
/begin HEADER "" VERSION "MG1CA020_6SAY_V011_TPROT" PROJECT_NO MG1CA020 /end HEADER
/begin MODULE DIM ""
/begin MOD_COMMON "" BYTE_ORDER MSB_LAST ALIGNMENT_BYTE 1 ALIGNMENT_WORD 2 ALIGNMENT_LONG 4 ALIGNMENT_INT64 4 ALIGNMENT_FLOAT32_IEEE 4 ALIGNMENT_FLOAT64_IEEE 4 DATA_SIZE 32 /end MOD_COMMON
/begin CHARACTERISTIC MisfDet_dnThdContRdcFac_C "factor on negative dn Values for reduction of dnThdCont" VALUE 0x805314E4 RB_Val_Wu16 0.9999847 fak_uw_b1 0.00 0.9999847 FORMAT "%9.7" /end CHARACTERISTIC
/begin CHARACTERISTIC MisfDet_dnThdContRdcIdx_C "selection of dn value in ascending order for reduction of dnThdCont" VALUE 0x805314E6 RB_Val_Wu8 255.0 OneToOne 0.00 255.0 FORMAT "%5.1" /end CHARACTERISTIC
/begin CHARACTERISTIC MisfDet_dnThdDecFilFac_C "filter factore for limitation of negative gradient of detection threshold" VALUE 0x805314E8 RB_Val_Wu16 0.9999847 fak_uw_b1 0.00 0.9999847 FORMAT "%9.7" /end CHARACTERISTIC
/begin CHARACTERISTIC MisfDet_dnThdDecMaxCont_T "maximum negative gradient of detection threshold for continuous misfires" CURVE 0x805314EA RB_Curve_S16_S16 4095.938 dn_Compu -2048.000 2047.938 FORMAT "%8.3"
 /begin AXIS_DESCR STD_AXIS MisfDet_nEngSync EngN 4 -16384.00 16383.50 FORMAT "%8.2" DEPOSIT ABSOLUTE /end AXIS_DESCR
/end CHARACTERISTIC
/begin CHARACTERISTIC MisfDet_dnThdDecMaxDif_T "maximum negative gradient of detection threshold for differential method" CURVE 0x805314FC RB_Curve_S16_S16 4095.938 dn_Compu -2048.000 2047.938 FORMAT "%8.3"
 /begin AXIS_DESCR STD_AXIS MisfDet_nEngSync EngN 4 -16384.00 16383.50 FORMAT "%8.2" DEPOSIT ABSOLUTE /end AXIS_DESCR
/end CHARACTERISTIC
/begin CHARACTERISTIC MisfDet_dnThdDecMax_T "maximum negative gradient of detection threshold" CURVE 0x8053150E RB_Curve_S16_S16 4095.938 dn_Compu -2048.000 2047.938 FORMAT "%8.3"
 /begin AXIS_DESCR STD_AXIS MisfDet_nEngSync EngN 4 -16384.00 16383.50 FORMAT "%8.2" DEPOSIT ABSOLUTE /end AXIS_DESCR
/end CHARACTERISTIC
/begin CHARACTERISTIC MisfDet_dnThdFacLteCmbDrv.Cmn_GT "Factor to detection threshold at late combustion barycenter / all transmission types" CURVE 0x8053162C RB_CurveGroup_U16 1.999969 fak_uw_b2 0.00 1.999969 FORMAT "%8.6"
 /begin AXIS_DESCR COM_AXIS MisfDet_iaMdnAvrg kw_q0p75 4 -96.00 95.25 FORMAT "%5.2" AXIS_PTS_REF MisfDet_dnThdFacLteCmbDrv_AX /end AXIS_DESCR
/end CHARACTERISTIC
/begin AXIS_PTS MisfDet_dnThdFacLteCmbDrv_AX "ignition angle axes of factor to detection threshold at late combustion barycenter" 0x80531580 MisfDet_iaMdnAvrg RB_Axis_S8 191.3 kw_q0p75 4 -96.00 95.25 FORMAT "%5.2" DEPOSIT ABSOLUTE /end AXIS_PTS
/begin CHARACTERISTIC MisfDet_dnThdFacLteCmbIdle.Cmn_GT "Factor to detection threshold at late combustion barycenter at low idle / all transmission types" CURVE 0x80531634 RB_CurveGroup_U16 1.999969 fak_uw_b2 0.00 1.999969 FORMAT "%8.6"
 /begin AXIS_DESCR COM_AXIS MisfDet_iaMdnAvrg kw_q0p75 4 -96.00 95.25 FORMAT "%5.2" AXIS_PTS_REF MisfDet_dnThdFacLteCmbIdle_AX /end AXIS_DESCR
/end CHARACTERISTIC
/begin AXIS_PTS MisfDet_dnThdFacLteCmbIdle_AX "ignition angle axes of factor to detection threshold at late combustion barycenter at idle" 0x80531585 MisfDet_iaMdnAvrg RB_Axis_S8 191.3 kw_q0p75 4 -96.00 95.25 FORMAT "%5.2" DEPOSIT ABSOLUTE /end AXIS_PTS
/begin CHARACTERISTIC MisfDet_dnThdFacStrt_T "Factor to detection threshold at engine start" CURVE 0x80531520 RB_Curve_U16_U16 1.999969 fak_uw_b2 0.00 1.999969 FORMAT "%8.6"
 /begin AXIS_DESCR STD_AXIS MisfDet_tiEngRunSum t_q0p1 4 0.00 6553.500 FORMAT "%8.3" DEPOSIT ABSOLUTE /end AXIS_DESCR
/end CHARACTERISTIC
/begin AXIS_PTS MisfDet_dnThdIdleLteCmbTq_AX "torque axes for threshold map idle late combustion" 0x8053158A MisfDet_tqBascSync RB_Axis_U16 99.99847 rel_uw_b100 6 0.00 99.99847 FORMAT "%8.5" DEPOSIT ABSOLUTE /end AXIS_PTS
/begin AXIS_PTS MisfDet_dnThdIdleTq_AX "torque axis for base maps at idle" 0x80531598 MisfDet_tqBascSync RB_Axis_U16 99.99847 rel_uw_b100 6 0.00 99.99847 FORMAT "%8.5" DEPOSIT ABSOLUTE /end AXIS_PTS
/begin CHARACTERISTIC MisfDet_dnThdMapDrvCatHeatGrip.Std.Cmn_GM "Thresholds for catalyst heating at driving operation closed clutch / standard engine roughness / all transmission types" MAP 0x8053163C RB_MapGroup_S16 4095.938 dn_Compu -2048.000 2047.938 FORMAT "%8.3"
 /begin AXIS_DESCR COM_AXIS MisfDet_tqBascSync rel_uw_b100 8 0.00 99.99847 FORMAT "%8.5" AXIS_PTS_REF MisfDet_dnThdTq_AX /end AXIS_DESCR
 /begin AXIS_DESCR COM_AXIS MisfDet_nEngSync EngN 8 -16384.00 16383.50 FORMAT "%8.2" AXIS_PTS_REF MisfDet_dnThdN_AX /end AXIS_DESCR
/end CHARACTERISTIC
/begin CHARACTERISTIC MisfDet_dnThdMapDrvCatHeatGrip.Cont.Cmn_GM "Thresholds for catalyst heating at driving operation closed clutch / continuous misfire (filtered engine roughness) / all transmission types" MAP 0x805316BC RB_MapGroup_S16 4095.938 dn_Compu -2048.000 2047.938 FORMAT "%8.3"
 /begin AXIS_DESCR COM_AXIS MisfDet_tqBascSync rel_uw_b100 8 0.00 99.99847 FORMAT "%8.5" AXIS_PTS_REF MisfDet_dnThdTq_AX /end AXIS_DESCR
 /begin AXIS_DESCR COM_AXIS MisfDet_nEngSync EngN 8 -16384.00 16383.50 FORMAT "%8.2" AXIS_PTS_REF MisfDet_dnThdN_AX /end AXIS_DESCR
/end CHARACTERISTIC
/begin CHARACTERISTIC MisfDet_dnThdMapDrvCatHeatGrip.Dif.Cmn_GM "Thresholds for catalyst heating at driving operation closed clutch / differetial engine roughness / all transmission types" MAP 0x8053173C RB_MapGroup_S16 4095.938 dn_Compu -2048.000 2047.938 FORMAT "%8.3"
 /begin AXIS_DESCR COM_AXIS MisfDet_tqBascSync rel_uw_b100 8 0.00 99.99847 FORMAT "%8.5" AXIS_PTS_REF MisfDet_dnThdTq_AX /end AXIS_DESCR
 /begin AXIS_DESCR COM_AXIS MisfDet_nEngSync EngN 8 -16384.00 16383.50 FORMAT "%8.2" AXIS_PTS_REF MisfDet_dnThdN_AX /end AXIS_DESCR
/end CHARACTERISTIC
/begin CHARACTERISTIC MisfDet_dnThdMapDrvCatHeatOpen.Std.Cmn_GM "Thresholds for catalyst heating at driving operation slipping clutch / standard engine roughness / all transmission types" MAP 0x805317BC RB_MapGroup_S16 4095.938 dn_Compu -2048.000 2047.938 FORMAT "%8.3"
 /begin AXIS_DESCR COM_AXIS MisfDet_tqBascSync rel_uw_b100 8 0.00 99.99847 FORMAT "%8.5" AXIS_PTS_REF MisfDet_dnThdTq_AX /end AXIS_DESCR
 /begin AXIS_DESCR COM_AXIS MisfDet_nEngSync EngN 8 -16384.00 16383.50 FORMAT "%8.2" AXIS_PTS_REF MisfDet_dnThdN_AX /end AXIS_DESCR
/end CHARACTERISTIC
/begin CHARACTERISTIC MisfDet_dnThdMapDrvCatHeatOpen.Cont.Cmn_GM "Thresholds for catalyst heating at driving operation slipping clutch / continuous misfire (filtered engine roughness) / all transmission types" MAP 0x8053183C RB_MapGroup_S16 4095.938 dn_Compu -2048.000 2047.938 FORMAT "%8.3"
 /begin AXIS_DESCR COM_AXIS MisfDet_tqBascSync rel_uw_b100 8 0.00 99.99847 FORMAT "%8.5" AXIS_PTS_REF MisfDet_dnThdTq_AX /end AXIS_DESCR
 /begin AXIS_DESCR COM_AXIS MisfDet_nEngSync EngN 8 -16384.00 16383.50 FORMAT "%8.2" AXIS_PTS_REF MisfDet_dnThdN_AX /end AXIS_DESCR
/end CHARACTERISTIC
/begin CHARACTERISTIC MisfDet_dnThdMapDrvCatHeatOpen.Dif.Cmn_GM "Thresholds for catalyst heating at driving operation slipping clutch / differetial engine roughness / all transmission types" MAP 0x805318BC RB_MapGroup_S16 4095.938 dn_Compu -2048.000 2047.938 FORMAT "%8.3"
 /begin AXIS_DESCR COM_AXIS MisfDet_tqBascSync rel_uw_b100 8 0.00 99.99847 FORMAT "%8.5" AXIS_PTS_REF MisfDet_dnThdTq_AX /end AXIS_DESCR
 /begin AXIS_DESCR COM_AXIS MisfDet_nEngSync EngN 8 -16384.00 16383.50 FORMAT "%8.2" AXIS_PTS_REF MisfDet_dnThdN_AX /end AXIS_DESCR
/end CHARACTERISTIC
/begin CHARACTERISTIC MisfDet_dnThdMapDrvCatHeatSlip.Std.Cmn_GM "Thresholds for catalyst heating at driving operation opened clutch / standard engine roughness / all transmission types" MAP 0x8053193C RB_MapGroup_S16 4095.938 dn_Compu -2048.000 2047.938 FORMAT "%8.3"
 /begin AXIS_DESCR COM_AXIS MisfDet_tqBascSync rel_uw_b100 8 0.00 99.99847 FORMAT "%8.5" AXIS_PTS_REF MisfDet_dnThdTq_AX /end AXIS_DESCR
 /begin AXIS_DESCR COM_AXIS MisfDet_nEngSync EngN 8 -16384.00 16383.50 FORMAT "%8.2" AXIS_PTS_REF MisfDet_dnThdN_AX /end AXIS_DESCR
/end CHARACTERISTIC
/begin CHARACTERISTIC MisfDet_dnThdMapDrvCatHeatSlip.Cont.Cmn_GM "Thresholds for catalyst heating at driving operation opened clutch / continuous misfire (filtered engine roughness) / all transmission types" MAP 0x805319BC RB_MapGroup_S16 4095.938 dn_Compu -2048.000 2047.938 FORMAT "%8.3"
 /begin AXIS_DESCR COM_AXIS MisfDet_tqBascSync rel_uw_b100 8 0.00 99.99847 FORMAT "%8.5" AXIS_PTS_REF MisfDet_dnThdTq_AX /end AXIS_DESCR
 /begin AXIS_DESCR COM_AXIS MisfDet_nEngSync EngN 8 -16384.00 16383.50 FORMAT "%8.2" AXIS_PTS_REF MisfDet_dnThdN_AX /end AXIS_DESCR
/end CHARACTERISTIC
/begin CHARACTERISTIC MisfDet_dnThdMapDrvCatHeatSlip.Dif.Cmn_GM "Thresholds for catalyst heating at driving operation opened clutch / differetial engine roughness / all transmission types" MAP 0x80531A3C RB_MapGroup_S16 4095.938 dn_Compu -2048.000 2047.938 FORMAT "%8.3"
 /begin AXIS_DESCR COM_AXIS MisfDet_tqBascSync rel_uw_b100 8 0.00 99.99847 FORMAT "%8.5" AXIS_PTS_REF MisfDet_dnThdTq_AX /end AXIS_DESCR
 /begin AXIS_DESCR COM_AXIS MisfDet_nEngSync EngN 8 -16384.00 16383.50 FORMAT "%8.2" AXIS_PTS_REF MisfDet_dnThdN_AX /end AXIS_DESCR
/end CHARACTERISTIC
/begin CHARACTERISTIC MisfDet_dnThdMapIdle.Std.Cmn_GT "Thresholds for idle / standard engine roughness / all transmission types" CURVE 0x80531ABC RB_CurveGroup_S16 4095.938 dn_Compu -2048.000 2047.938 FORMAT "%8.3"
 /begin AXIS_DESCR COM_AXIS MisfDet_tqBascSync rel_uw_b100 6 0.00 99.99847 FORMAT "%8.5" AXIS_PTS_REF MisfDet_dnThdIdleTq_AX /end AXIS_DESCR
/end CHARACTERISTIC
/begin CHARACTERISTIC MisfDet_dnThdMapIdle.Cont.Cmn_GT "Thresholds for idle / continuous misfire (filtered engine roughness) / all transmission types" CURVE 0x80531AC8 RB_CurveGroup_S16 4095.938 dn_Compu -2048.000 2047.938 FORMAT "%8.3"
 /begin AXIS_DESCR COM_AXIS MisfDet_tqBascSync rel_uw_b100 6 0.00 99.99847 FORMAT "%8.5" AXIS_PTS_REF MisfDet_dnThdIdleTq_AX /end AXIS_DESCR
/end CHARACTERISTIC
/begin CHARACTERISTIC MisfDet_dnThdMapIdle.Dif.Cmn_GT "Thresholds for idle / differetial engine roughness / all transmission types" CURVE 0x80531AD4 RB_CurveGroup_S16 4095.938 dn_Compu -2048.000 2047.938 FORMAT "%8.3"
 /begin AXIS_DESCR COM_AXIS MisfDet_tqBascSync rel_uw_b100 6 0.00 99.99847 FORMAT "%8.5" AXIS_PTS_REF MisfDet_dnThdIdleTq_AX /end AXIS_DESCR
/end CHARACTERISTIC
/begin CHARACTERISTIC MisfDet_dnThdMapIdleAltvPosn.Std.Cmn_GT "Thresholds for idle alternative segment position / standard engine roughness / all transmission types" CURVE 0x80531AE0 RB_CurveGroup_S16 4095.938 dn_Compu -2048.000 2047.938 FORMAT "%8.3"
 /begin AXIS_DESCR COM_AXIS MisfDet_tqBascSync rel_uw_b100 6 0.00 99.99847 FORMAT "%8.5" AXIS_PTS_REF MisfDet_dnThdIdleTq_AX /end AXIS_DESCR
/end CHARACTERISTIC
/begin CHARACTERISTIC MisfDet_dnThdMapIdleAltvPosn.Cont.Cmn_GT "Thresholds for idle alternative segment position / continuous misfire (filtered engine roughness) / all transmission types" CURVE 0x80531AEC RB_CurveGroup_S16 4095.938 dn_Compu -2048.000 2047.938 FORMAT "%8.3"
 /begin AXIS_DESCR COM_AXIS MisfDet_tqBascSync rel_uw_b100 6 0.00 99.99847 FORMAT "%8.5" AXIS_PTS_REF MisfDet_dnThdIdleTq_AX /end AXIS_DESCR
/end CHARACTERISTIC
/begin CHARACTERISTIC MisfDet_dnThdMapIdleAltvPosn.Dif.Cmn_GT "Thresholds for idle alternative segment position / differetial engine roughness / all transmission types" CURVE 0x80531AF8 RB_CurveGroup_S16 4095.938 dn_Compu -2048.000 2047.938 FORMAT "%8.3"
 /begin AXIS_DESCR COM_AXIS MisfDet_tqBascSync rel_uw_b100 6 0.00 99.99847 FORMAT "%8.5" AXIS_PTS_REF MisfDet_dnThdIdleTq_AX /end AXIS_DESCR
/end CHARACTERISTIC
/begin CHARACTERISTIC MisfDet_dnThdMapIdleCatHeat.Std.Cmn_GT "Thresholds for idle catalyst heating / standard engine roughness / all transmission types" CURVE 0x80531B04 RB_CurveGroup_S16 4095.938 dn_Compu -2048.000 2047.938 FORMAT "%8.3"
 /begin AXIS_DESCR COM_AXIS MisfDet_tqBascSync rel_uw_b100 6 0.00 99.99847 FORMAT "%8.5" AXIS_PTS_REF MisfDet_dnThdIdleLteCmbTq_AX /end AXIS_DESCR
/end CHARACTERISTIC
/begin CHARACTERISTIC MisfDet_dnThdMapIdleCatHeat.Cont.Cmn_GT "Thresholds for idle catalyst heating / continuous misfire (filtered engine roughness) / all transmission types" CURVE 0x80531B10 RB_CurveGroup_S16 4095.938 dn_Compu -2048.000 2047.938 FORMAT "%8.3"
 /begin AXIS_DESCR COM_AXIS MisfDet_tqBascSync rel_uw_b100 6 0.00 99.99847 FORMAT "%8.5" AXIS_PTS_REF MisfDet_dnThdIdleLteCmbTq_AX /end AXIS_DESCR
/end CHARACTERISTIC
/begin CHARACTERISTIC MisfDet_dnThdMapIdleCatHeat.Dif.Cmn_GT "Thresholds for idle catalyst heating / differetial engine roughness / all transmission types" CURVE 0x80531B1C RB_CurveGroup_S16 4095.938 dn_Compu -2048.000 2047.938 FORMAT "%8.3"
 /begin AXIS_DESCR COM_AXIS MisfDet_tqBascSync rel_uw_b100 6 0.00 99.99847 FORMAT "%8.5" AXIS_PTS_REF MisfDet_dnThdIdleLteCmbTq_AX /end AXIS_DESCR
/end CHARACTERISTIC
/begin CHARACTERISTIC MisfDet_dnThdMapIdleCatWrm.Std.Cmn_GT "Thresholds for idle catalyst warming / standard engine roughness / all transmission types" CURVE 0x80531B28 RB_CurveGroup_S16 4095.938 dn_Compu -2048.000 2047.938 FORMAT "%8.3"
 /begin AXIS_DESCR COM_AXIS MisfDet_tqBascSync rel_uw_b100 6 0.00 99.99847 FORMAT "%8.5" AXIS_PTS_REF MisfDet_dnThdIdleTq_AX /end AXIS_DESCR
/end CHARACTERISTIC
/begin CHARACTERISTIC MisfDet_dnThdMapIdleCatWrm.Cont.Cmn_GT "Thresholds for idle catalyst warming / continuous misfire (filtered engine roughness) / all transmission types" CURVE 0x80531B34 RB_CurveGroup_S16 4095.938 dn_Compu -2048.000 2047.938 FORMAT "%8.3"
 /begin AXIS_DESCR COM_AXIS MisfDet_tqBascSync rel_uw_b100 6 0.00 99.99847 FORMAT "%8.5" AXIS_PTS_REF MisfDet_dnThdIdleTq_AX /end AXIS_DESCR
/end CHARACTERISTIC
/begin CHARACTERISTIC MisfDet_dnThdMapIdleCatWrm.Dif.Cmn_GT "Thresholds for idle catalyst warming / differetial engine roughness / all transmission types" CURVE 0x80531B40 RB_CurveGroup_S16 4095.938 dn_Compu -2048.000 2047.938 FORMAT "%8.3"
 /begin AXIS_DESCR COM_AXIS MisfDet_tqBascSync rel_uw_b100 6 0.00 99.99847 FORMAT "%8.5" AXIS_PTS_REF MisfDet_dnThdIdleTq_AX /end AXIS_DESCR
/end CHARACTERISTIC
/begin CHARACTERISTIC MisfDet_dnThdMapPtGrip.Std.Cmn_GM "Thresholds for closed clutch / standard engine roughness / all transmission types" MAP 0x80531B4C RB_MapGroup_S16 4095.938 dn_Compu -2048.000 2047.938 FORMAT "%8.3"
 /begin AXIS_DESCR COM_AXIS MisfDet_tqBascSync rel_uw_b100 8 0.00 99.99847 FORMAT "%8.5" AXIS_PTS_REF MisfDet_dnThdTq_AX /end AXIS_DESCR
 /begin AXIS_DESCR COM_AXIS MisfDet_nEngSync EngN 8 -16384.00 16383.50 FORMAT "%8.2" AXIS_PTS_REF MisfDet_dnThdN_AX /end AXIS_DESCR
/end CHARACTERISTIC
/begin CHARACTERISTIC MisfDet_dnThdMapPtGrip.Cont.Cmn_GM "Thresholds for closed clutch / continuous misfire (filtered engine roughness) / all transmission types" MAP 0x80531BCC RB_MapGroup_S16 4095.938 dn_Compu -2048.000 2047.938 FORMAT "%8.3"
 /begin AXIS_DESCR COM_AXIS MisfDet_tqBascSync rel_uw_b100 8 0.00 99.99847 FORMAT "%8.5" AXIS_PTS_REF MisfDet_dnThdTq_AX /end AXIS_DESCR
 /begin AXIS_DESCR COM_AXIS MisfDet_nEngSync EngN 8 -16384.00 16383.50 FORMAT "%8.2" AXIS_PTS_REF MisfDet_dnThdN_AX /end AXIS_DESCR
/end CHARACTERISTIC
/begin CHARACTERISTIC MisfDet_dnThdMapPtGrip.Dif.Cmn_GM "Thresholds for closed clutch / differetial engine roughness / all transmission types" MAP 0x80531C4C RB_MapGroup_S16 4095.938 dn_Compu -2048.000 2047.938 FORMAT "%8.3"
 /begin AXIS_DESCR COM_AXIS MisfDet_tqBascSync rel_uw_b100 8 0.00 99.99847 FORMAT "%8.5" AXIS_PTS_REF MisfDet_dnThdTq_AX /end AXIS_DESCR
 /begin AXIS_DESCR COM_AXIS MisfDet_nEngSync EngN 8 -16384.00 16383.50 FORMAT "%8.2" AXIS_PTS_REF MisfDet_dnThdN_AX /end AXIS_DESCR
/end CHARACTERISTIC
/begin CHARACTERISTIC MisfDet_dnThdMapPtOpen.Std.Cmn_GM "Thresholds for slipping clutch / standard engine roughness / all transmission types" MAP 0x80531CCC RB_MapGroup_S16 4095.938 dn_Compu -2048.000 2047.938 FORMAT "%8.3"
 /begin AXIS_DESCR COM_AXIS MisfDet_tqBascSync rel_uw_b100 8 0.00 99.99847 FORMAT "%8.5" AXIS_PTS_REF MisfDet_dnThdTq_AX /end AXIS_DESCR
 /begin AXIS_DESCR COM_AXIS MisfDet_nEngSync EngN 8 -16384.00 16383.50 FORMAT "%8.2" AXIS_PTS_REF MisfDet_dnThdN_AX /end AXIS_DESCR
/end CHARACTERISTIC
/begin CHARACTERISTIC MisfDet_dnThdMapPtOpen.Cont.Cmn_GM "Thresholds for slipping clutch / continuous misfire (filtered engine roughness) / all transmission types" MAP 0x80531D4C RB_MapGroup_S16 4095.938 dn_Compu -2048.000 2047.938 FORMAT "%8.3"
 /begin AXIS_DESCR COM_AXIS MisfDet_tqBascSync rel_uw_b100 8 0.00 99.99847 FORMAT "%8.5" AXIS_PTS_REF MisfDet_dnThdTq_AX /end AXIS_DESCR
 /begin AXIS_DESCR COM_AXIS MisfDet_nEngSync EngN 8 -16384.00 16383.50 FORMAT "%8.2" AXIS_PTS_REF MisfDet_dnThdN_AX /end AXIS_DESCR
/end CHARACTERISTIC
/begin CHARACTERISTIC MisfDet_dnThdMapPtOpen.Dif.Cmn_GM "Thresholds for slipping clutch / differetial engine roughness / all transmission types" MAP 0x80531DCC RB_MapGroup_S16 4095.938 dn_Compu -2048.000 2047.938 FORMAT "%8.3"
 /begin AXIS_DESCR COM_AXIS MisfDet_tqBascSync rel_uw_b100 8 0.00 99.99847 FORMAT "%8.5" AXIS_PTS_REF MisfDet_dnThdTq_AX /end AXIS_DESCR
 /begin AXIS_DESCR COM_AXIS MisfDet_nEngSync EngN 8 -16384.00 16383.50 FORMAT "%8.2" AXIS_PTS_REF MisfDet_dnThdN_AX /end AXIS_DESCR
/end CHARACTERISTIC
/begin CHARACTERISTIC MisfDet_dnThdMapPtSlip.Std.Cmn_GM "Thresholds for opened clutch / standard engine roughness / all transmission types" MAP 0x80531E4C RB_MapGroup_S16 4095.938 dn_Compu -2048.000 2047.938 FORMAT "%8.3"
 /begin AXIS_DESCR COM_AXIS MisfDet_tqBascSync rel_uw_b100 8 0.00 99.99847 FORMAT "%8.5" AXIS_PTS_REF MisfDet_dnThdTq_AX /end AXIS_DESCR
 /begin AXIS_DESCR COM_AXIS MisfDet_nEngSync EngN 8 -16384.00 16383.50 FORMAT "%8.2" AXIS_PTS_REF MisfDet_dnThdN_AX /end AXIS_DESCR
/end CHARACTERISTIC
/begin CHARACTERISTIC MisfDet_dnThdMapPtSlip.Cont.Cmn_GM "Thresholds for opened clutch / continuous misfire (filtered engine roughness) / all transmission types" MAP 0x80531ECC RB_MapGroup_S16 4095.938 dn_Compu -2048.000 2047.938 FORMAT "%8.3"
 /begin AXIS_DESCR COM_AXIS MisfDet_tqBascSync rel_uw_b100 8 0.00 99.99847 FORMAT "%8.5" AXIS_PTS_REF MisfDet_dnThdTq_AX /end AXIS_DESCR
 /begin AXIS_DESCR COM_AXIS MisfDet_nEngSync EngN 8 -16384.00 16383.50 FORMAT "%8.2" AXIS_PTS_REF MisfDet_dnThdN_AX /end AXIS_DESCR
/end CHARACTERISTIC
/begin CHARACTERISTIC MisfDet_dnThdMapPtSlip.Dif.Cmn_GM "Thresholds for opened clutch / differetial engine roughness / all transmission types" MAP 0x80531F4C RB_MapGroup_S16 4095.938 dn_Compu -2048.000 2047.938 FORMAT "%8.3"
 /begin AXIS_DESCR COM_AXIS MisfDet_tqBascSync rel_uw_b100 8 0.00 99.99847 FORMAT "%8.5" AXIS_PTS_REF MisfDet_dnThdTq_AX /end AXIS_DESCR
 /begin AXIS_DESCR COM_AXIS MisfDet_nEngSync EngN 8 -16384.00 16383.50 FORMAT "%8.2" AXIS_PTS_REF MisfDet_dnThdN_AX /end AXIS_DESCR
/end CHARACTERISTIC
/begin CHARACTERISTIC MisfDet_dnThdMinBlkDnAdpnNvCorrn.Cmn_GM "minimum limitation for inhibiting the usage of long time adaptation values / all transmission types" MAP 0x80531FCC RB_MapGroup_S16 2047.938 dn_Compu 0.00 2047.938 FORMAT "%8.3" EXTENDED_LIMITS -2048.000 2047.938
 /begin AXIS_DESCR COM_AXIS MisfDet_tqBascSync rel_uw_b100 4 0.00 99.99847 FORMAT "%8.5" AXIS_PTS_REF MisfDet_dnThdMinDnAdpnTq_AX /end AXIS_DESCR
 /begin AXIS_DESCR COM_AXIS MisfDet_nEngSync EngN 8 -16384.00 16383.50 FORMAT "%8.2" AXIS_PTS_REF MisfDet_dnThdMinDnAdpnN_AX /end AXIS_DESCR
/end CHARACTERISTIC
/begin CHARACTERISTIC MisfDet_dnThdMinBlkDnAdpnNvCorrn1.Cmn_GM "minimum limitation for inhibiting the usage of long time adaptation values / all transmission types" MAP 0x8053200C RB_MapGroup_S16 2047.938 dn_Compu 0.00 2047.938 FORMAT "%8.3" EXTENDED_LIMITS -2048.000 2047.938
 /begin AXIS_DESCR COM_AXIS MisfDet_tqBascSync rel_uw_b100 4 0.00 99.99847 FORMAT "%8.5" AXIS_PTS_REF MisfDet_dnThdMinDnAdpnTq_AX /end AXIS_DESCR
 /begin AXIS_DESCR COM_AXIS MisfDet_nEngSync EngN 8 -16384.00 16383.50 FORMAT "%8.2" AXIS_PTS_REF MisfDet_dnThdMinDnAdpnN_AX /end AXIS_DESCR
/end CHARACTERISTIC
/begin CHARACTERISTIC MisfDet_dnThdMinCont.Cmn_GM "Threshold limitation for continuous misfires / all transmission types" MAP 0x8053204C RB_MapGroup_S16 2047.938 dn_Compu 0.00 2047.938 FORMAT "%8.3" EXTENDED_LIMITS -2048.000 2047.938
 /begin AXIS_DESCR COM_AXIS MisfDet_tqBascSync rel_uw_b100 8 0.00 99.99847 FORMAT "%8.5" AXIS_PTS_REF MisfDet_dnThdTq_AX /end AXIS_DESCR
 /begin AXIS_DESCR COM_AXIS MisfDet_nEngSync EngN 8 -16384.00 16383.50 FORMAT "%8.2" AXIS_PTS_REF MisfDet_dnThdN_AX /end AXIS_DESCR
/end CHARACTERISTIC
/begin CHARACTERISTIC MisfDet_dnThdMinContIdle_M "Threshold limitation for continuous misfires in half engine mode" MAP 0x805315A6 RB_Map_U16S16_S16 4095.938 dn_Compu -2048.000 2047.938 FORMAT "%8.3"
 /begin AXIS_DESCR STD_AXIS MisfDet_tqBascSync rel_uw_b100 4 0.00 99.99847 FORMAT "%8.5" DEPOSIT ABSOLUTE /end AXIS_DESCR
 /begin AXIS_DESCR STD_AXIS MisfDet_nEngSync EngN 3 -16384.00 16383.50 FORMAT "%8.2" DEPOSIT ABSOLUTE /end AXIS_DESCR
/end CHARACTERISTIC
/begin CHARACTERISTIC MisfDet_dnThdMinDnAdpn.Cmn_GM "minimum limitation in case of incomplete dn adaptation / all transmission types" MAP 0x805320CC RB_MapGroup_S16 2047.938 dn_Compu 0.00 2047.938 FORMAT "%8.3" EXTENDED_LIMITS -2048.000 2047.938
 /begin AXIS_DESCR COM_AXIS MisfDet_tqBascSync rel_uw_b100 4 0.00 99.99847 FORMAT "%8.5" AXIS_PTS_REF MisfDet_dnThdMinDnAdpnTq_AX /end AXIS_DESCR
 /begin AXIS_DESCR COM_AXIS MisfDet_nEngSync EngN 8 -16384.00 16383.50 FORMAT "%8.2" AXIS_PTS_REF MisfDet_dnThdMinDnAdpnN_AX /end AXIS_DESCR
/end CHARACTERISTIC
/begin AXIS_PTS MisfDet_dnThdMinDnAdpnN_AX "engine speed axes for minimum limitation in cae of incomplete dn adaptation" 0x805315D0 MisfDet_nEngSync RB_Axis_S16 32767.50 EngN 8 -16384.00 16383.50 FORMAT "%8.2" DEPOSIT ABSOLUTE /end AXIS_PTS
/begin AXIS_PTS MisfDet_dnThdMinDnAdpnTq_AX "torque axes for minimum limitation in cae of incomplete dn adaptation" 0x805315E2 MisfDet_tqBascSync RB_Axis_U16 99.99847 rel_uw_b100 4 0.00 99.99847 FORMAT "%8.5" DEPOSIT ABSOLUTE /end AXIS_PTS
/begin CHARACTERISTIC MisfDet_dnThdMinFacLteCmb.Cmn_C "Minimum limitation of threshold while using the correction factor for late combustion / all transmission types" VALUE 0x8053157E RB_Val_Ws16 2047.938 dn_Compu 0.00 2047.938 FORMAT "%8.3" EXTENDED_LIMITS -2048.000 2047.938 /end CHARACTERISTIC
/begin AXIS_PTS MisfDet_dnThdN_AX "engine speed axis for base maps" 0x805315EC MisfDet_nEngSync RB_Axis_S16 32767.50 EngN 8 -16384.00 16383.50 FORMAT "%8.2" DEPOSIT ABSOLUTE /end AXIS_PTS
/begin CHARACTERISTIC MisfDet_dnThdOffsTCatHeat_T "temperature dependent offset to detection threshold during catalyst heating" CURVE 0x80531532 RB_Curve_S16_S16 4095.938 dn_Compu -2048.000 2047.938 FORMAT "%8.3"
 /begin AXIS_DESCR STD_AXIS MisfDet_tEng Temp_Cels 8 -3549.940 3003.560 FORMAT "%8.3" DEPOSIT ABSOLUTE /end AXIS_DESCR
/end CHARACTERISTIC
/begin CHARACTERISTIC MisfDet_dnThdOffsT_T "temperature dependent offset to detection threshold" CURVE 0x80531554 RB_Curve_S16_S16 4095.938 dn_Compu -2048.000 2047.938 FORMAT "%8.3"
 /begin AXIS_DESCR STD_AXIS MisfDet_tEng Temp_Cels 8 -3549.940 3003.560 FORMAT "%8.3" DEPOSIT ABSOLUTE /end AXIS_DESCR
/end CHARACTERISTIC
/begin CHARACTERISTIC MisfDet_dnThdTiMinDynLim_C "Time after start without dynamic limitation" VALUE 0x80531576 RB_Val_Wu8 25.50 t_q0p1 0.00 25.50 FORMAT "%5.2" /end CHARACTERISTIC
/begin AXIS_PTS MisfDet_dnThdTq_AX "torque axis for base maps" 0x805315FE MisfDet_tqBascSync RB_Axis_U16 99.99847 rel_uw_b100 8 0.00 99.99847 FORMAT "%8.5" DEPOSIT ABSOLUTE /end AXIS_PTS
/begin CHARACTERISTIC MisfDet_facCritScav_C "Scavenging rate to enable special cat monitoring" VALUE 0x805313CA Val_Wu16 15.99976 fak_uw_b16 0.00 15.99976 FORMAT "%8.5" /end CHARACTERISTIC
/begin CHARACTERISTIC MisfDet_iaCatWrmThd_C "Ignition angle threshold for detecting catalyst warming." VALUE 0x80531610 RB_Val_Ws8 191.3 kw_q0p75 -96.00 95.25 FORMAT "%5.2" /end CHARACTERISTIC
/begin CHARACTERISTIC MisfDet_maskDnThdMinBlkDnAdpnNvCorrnCmbTyp_CA "Selection mask for inhibiting condition for minimum limitation for inhibiting the usage of long time adaptation values depending on diesel or gasoline motor" VAL_BLK 0x80531614 RB_ValA_Wu32 4294967295.00 OneToOne 0.00 4294967295.00 FORMAT "%13.2" NUMBER 3 /end CHARACTERISTIC
/begin CHARACTERISTIC MisfDet_maskDnThdMinBlkDnAdpnNvCorrn_CA "Selection mask for inhibiting condition for minimum limitation for inhibiting the usage of long time adaptation values" VAL_BLK 0x80531620 RB_ValA_Wu16 65535.00 OneToOne 0.00 65535.00 FORMAT "%8.2" NUMBER 3 /end CHARACTERISTIC
/begin CHARACTERISTIC MisfDet_maxToothDeEolNLim_C "engine speed threshold for usage of remaining tooth tolerance after EOL adaptation" VALUE 0x80531578 RB_Val_Ws16 32767.50 EngN -16384.00 16383.50 FORMAT "%8.2" /end CHARACTERISTIC
/begin CHARACTERISTIC MisfDet_maxToothDeEol_C "maximum tooth tolerance of crank wheel after EOL adaptation for offset calculation" VALUE 0x8053157A RB_Val_Wu8 0.9961 kw_q0p0039 0.00 0.9961 /end CHARACTERISTIC
/begin CHARACTERISTIC MisfDet_maxToothDe_C "maximum tooth tolerance of crank wheel for offset calculation" VALUE 0x8053157B RB_Val_Wu8 0.9961 kw_q0p0039 0.00 0.9961 /end CHARACTERISTIC
/begin CHARACTERISTIC MisfDet_nrDcycDrvRcdrRst_C "Number of driving cycles to reset endurance test counters" VALUE 0x805314E2 RB_Val_Wu8 255.0 OneToOne 0.00 255.0 FORMAT "%5.1" /end CHARACTERISTIC
/begin CHARACTERISTIC MisfDet_rGripMaxOpen_C "Maximum grip for status open drive train" VALUE 0x80531626 RB_Val_Ws16 655.3500 Fact100 -327.6800 327.6700 FORMAT "%8.4" /end CHARACTERISTIC
/begin CHARACTERISTIC MisfDet_rGripMinClsd_C "Minimum grip for status engaged drive train" VALUE 0x80531628 RB_Val_Ws16 655.3500 Fact100 -327.6800 327.6700 FORMAT "%8.4" /end CHARACTERISTIC
/begin CHARACTERISTIC MisfDet_stcCatDmgCritScavIntlCntrMax_C "Maximum number of catalyst damaginging intervals at high scavenging rate to change the weighting factor" VALUE 0x805313CC RB_Val_Wu8 255.0 OneToOne 0.00 255.0 FORMAT "%5.1" /end CHARACTERISTIC
/begin CHARACTERISTIC MisfDet_stcCatDmgDebIntlNr_C "number of encounters from catalyst damaging till FSP entry" VALUE 0x805313CD RB_Val_Wu8 2.000 OneToOne 1.000 3.000 FORMAT "%5.3" EXTENDED_LIMITS 0.00 255.0 /end CHARACTERISTIC
/begin CHARACTERISTIC MisfDet_stcCatDmgDebNMax_C "maximum engine speed for debouncing" VALUE 0x805313CE RB_Val_Ws16 32767.50 EngN -16384.00 16383.50 FORMAT "%8.2" /end CHARACTERISTIC
/begin CHARACTERISTIC MisfDet_stcCatDmgDebTqMax_T "maximum torque for debouncing" CURVE 0x805313D0 RB_Curve_S16_U16_Static 99.99847 rel_uw_b100 0.00 99.99847 FORMAT "%8.5"
 /begin AXIS_DESCR STD_AXIS Epm_nEng EngN 10 -16384.00 16383.50 FORMAT "%8.2" DEPOSIT ABSOLUTE /end AXIS_DESCR
/end CHARACTERISTIC
/begin CHARACTERISTIC MisfDet_stcCatDmgFcoNrCylBnkMax_CA "maximum number of deactivateable cylinders on exhaust bank" VAL_BLK 0x805314BC RB_ValA_Wu8 255.0 OneToOne 0.00 255.0 FORMAT "%5.1" NUMBER 1 /end CHARACTERISTIC
/begin CHARACTERISTIC MisfDet_stcCatDmgFcoNrIntlMin_T "Necessary number of intervals criterias for cylinder deactivation met" CURVE 0x805314BE RB_Curve_S16_U8_Static 255.0 OneToOne 0.00 255.0 FORMAT "%5.1"
 /begin AXIS_DESCR STD_AXIS Epm_nEng EngN 8 -16384.00 16383.50 FORMAT "%8.2" DEPOSIT ABSOLUTE /end AXIS_DESCR
/end CHARACTERISTIC
/begin CHARACTERISTIC MisfDet_stcCatDmgFcoNrIntlStrt_C "Minimum number of intervals since start for cylinder deactivation" VALUE 0x805314D8 RB_Val_Wu8 255.0 OneToOne 0.00 255.0 FORMAT "%5.1" /end CHARACTERISTIC
/begin CHARACTERISTIC MisfDet_stcCatDmgFcoRatMin_C "Minimum contribution ratio of a cylinder to catalyst damaging for cylinder deactivation" VALUE 0x805314DA Val_Wu16 99.99847 rel_uw_b100 0.00 99.99847 FORMAT "%8.5" /end CHARACTERISTIC
/begin CHARACTERISTIC MisfDet_stcCatDmgFcoThd_CA "Threshold for weighted misfire counter for cylinder deactivation" VAL_BLK 0x805314DC RB_ValA_Wu16 65535.00 OneToOne 0.00 65535.00 FORMAT "%8.2" NUMBER 1 /end CHARACTERISTIC
/begin CHARACTERISTIC MisfDet_stcCatExtFirstIntlFac_C "Extension factor for first cat interval in case of cold engine" VALUE 0x805313FA RB_Val_Wu8 255.0 OneToOne 0.00 255.0 FORMAT "%5.1" /end CHARACTERISTIC
/begin CHARACTERISTIC MisfDet_stcCatExtFirstIntlT_C "Maximum temperature for extension of first cat interval" VALUE 0x805313FC RB_Val_Ws16 6553.500 Temp_Cels -3549.940 3003.560 FORMAT "%8.3" /end CHARACTERISTIC
/begin CHARACTERISTIC MisfDet_stcCatRatMinCylIdn_C "Minimum contribution ratio of misfire sum for cylinder individual misfire fault" VALUE 0x805313FE Val_Wu16 99.99847 rel_uw_b100 0.00 99.99847 FORMAT "%8.5" /end CHARACTERISTIC
/begin CHARACTERISTIC MisfDet_stcCatRatMinMpl_C "Minimum contribution ratio of misfire sum for multiple misfire fault" VALUE 0x80531400 Val_Wu16 99.99847 rel_uw_b100 0.00 99.99847 FORMAT "%8.5" /end CHARACTERISTIC
/begin CHARACTERISTIC MisfDet_stcCatThdStrt_CA "Threshold for catalyst damaging at first interval" VAL_BLK 0x80531402 RB_ValA_Wu16 65535.00 OneToOne 0.00 65535.00 FORMAT "%8.2" NUMBER 1 /end CHARACTERISTIC
/begin CHARACTERISTIC MisfDet_stcCatThd_CA "Threshold for catalyst damaging" VAL_BLK 0x80531404 RB_ValA_Wu16 65535.00 OneToOne 0.00 65535.00 FORMAT "%8.2" NUMBER 1 /end CHARACTERISTIC
/begin CHARACTERISTIC MisfDet_stcCatWghtFacCritScav_M "Map for catalyst protection, weighting factors considering high scavenging rates" MAP 0x80531406 RB_Map_S16U16_U8 255.0 OneToOne 0.00 255.0 FORMAT "%5.1"
 /begin AXIS_DESCR STD_AXIS Epm_nEng EngN 6 -16384.00 16383.50 FORMAT "%8.2" DEPOSIT ABSOLUTE /end AXIS_DESCR
 /begin AXIS_DESCR STD_AXIS MisfDet_tqBasc rel_uw_b100 6 0.00 99.99847 FORMAT "%8.5" DEPOSIT ABSOLUTE /end AXIS_DESCR
/end CHARACTERISTIC
/begin CHARACTERISTIC MisfDet_stcCatWghtFacPfiMax_C "weighting factor for misfire counter at open locked injector" VALUE 0x80531446 RB_Val_Wu8 255.0 OneToOne 0.00 255.0 FORMAT "%5.1" /end CHARACTERISTIC
/begin CHARACTERISTIC MisfDet_stcCatWghtFac_M "weighting factor for misfire counter" MAP 0x80531448 RB_Map_S16U16_U8 255.0 OneToOne 0.00 255.0 FORMAT "%5.1"
 /begin AXIS_DESCR STD_AXIS Epm_nEng EngN 8 -16384.00 16383.50 FORMAT "%8.2" DEPOSIT ABSOLUTE /end AXIS_DESCR
 /begin AXIS_DESCR STD_AXIS MisfDet_tqBasc rel_uw_b100 8 0.00 99.99847 FORMAT "%8.5" DEPOSIT ABSOLUTE /end AXIS_DESCR
/end CHARACTERISTIC
/begin CHARACTERISTIC MisfDet_stcEmiNrIntl_C "Number of damaged emission intervals which will cause a fault memory entry" VALUE 0x805314B0 Val_Wu8 3.000 OneToOne 1.000 4.000 FORMAT "%5.3" EXTENDED_LIMITS 0.00 255.0 /end CHARACTERISTIC
/begin CHARACTERISTIC MisfDet_stcEmiRatMinCylIdn_C "minimum ratio of misfire sum for cylinder individual fault code" VALUE 0x805314B2 Val_Wu16 99.99847 rel_uw_b100 0.00 99.99847 FORMAT "%8.5" /end CHARACTERISTIC
/begin CHARACTERISTIC MisfDet_stcEmiRatMinMpl_C "minimum ratio of misfire sum for multiple fault code" VALUE 0x805314B4 Val_Wu16 99.99847 rel_uw_b100 0.00 99.99847 FORMAT "%8.5" /end CHARACTERISTIC
/begin CHARACTERISTIC MisfDet_stcEmiThdStrtCatHeat_C "threshold for emission exceedance first interval cat heating" VALUE 0x805314B6 RB_Val_Wu16 65535.00 OneToOne 0.00 65535.00 FORMAT "%8.2" /end CHARACTERISTIC
/begin CHARACTERISTIC MisfDet_stcEmiThdStrt_C "threshold for emission exceedance first interval" VALUE 0x805314B8 RB_Val_Wu16 65535.00 OneToOne 0.00 65535.00 FORMAT "%8.2" /end CHARACTERISTIC
/begin CHARACTERISTIC MisfDet_stcEmiThd_C "threshold for emission exceedance" VALUE 0x805314BA RB_Val_Wu16 65535.00 OneToOne 0.00 65535.00 FORMAT "%8.2" /end CHARACTERISTIC
/begin CHARACTERISTIC MisfDet_stCfgOBD_C "configuration switch Obd requirement" VALUE 0x805314E0 RB_Val_Wu8 255.0 OneToOne 0.00 255.0 FORMAT "%5.1" /end CHARACTERISTIC
/begin CHARACTERISTIC MisfDet_stStcCatCfg_C "configuration code word MisfDet_stcCat" VALUE 0x805314AC RB_Val_Wu8 255.0 OneToOne 0.00 255.0 FORMAT "%5.1" /end CHARACTERISTIC
/begin CHARACTERISTIC MisfDet_stStcCatDmgFcoCfg_C "Configuration code word MisfDet_StcCat" VALUE 0x805314DE RB_Val_Wu8 255.0 OneToOne 0.00 255.0 FORMAT "%5.1" /end CHARACTERISTIC
/begin CHARACTERISTIC MisfDet_stStcMiscCfg_C "configuration switch StcMisc" VALUE 0x805314E3 RB_Val_Wu8 255.0 OneToOne 0.00 255.0 FORMAT "%5.1" /end CHARACTERISTIC
/begin CHARACTERISTIC MisfDet_stThdCalcnCfg_C "configuration mask threshold calculation" VALUE 0x8053157C RB_Val_Wu8 255.0 OneToOne 0.00 255.0 FORMAT "%5.1" /end CHARACTERISTIC
/begin CHARACTERISTIC MisfDet_stThdMapSelnCfg_C "configuration code word ThdMapSeln" VALUE 0x8053162A RB_Val_Wu8 255.0 OneToOne 0.00 255.0 FORMAT "%5.1" /end CHARACTERISTIC
/begin CHARACTERISTIC MisfDet_tiDebCatHealCritScav_C "Debounce time to reset DFC_MDCatCrit" VALUE 0x805314AE Val_Wu16 6553.500 t_q0p1 0.00 6553.500 FORMAT "%8.3" /end CHARACTERISTIC
/begin CHARACTERISTIC MoCADC_ctDebNTP_C "Final value of Error counter for verifying of Null-Load-Test-Pulse" VALUE 0x8053B660 Val_Wu8 5100.00 t20ms_ub_b5100 0.00 5100.00 /end CHARACTERISTIC
/begin CHARACTERISTIC MoCADC_ctDebTst_C "Error counter end value of test voltage verification" VALUE 0x8053B661 Val_Wu8 255.0 dez 0.00 255.0 FORMAT "%5.1" /end CHARACTERISTIC
/begin CHARACTERISTIC MoCADC_ctRstNTP_C "Number of permitted resets for verifying of Null-Load-Test-Pulse" VALUE 0x8053B662 Val_Wu8 255.0 dez 0.00 255.0 FORMAT "%5.1" /end CHARACTERISTIC
/begin CHARACTERISTIC MoCADC_ctRstTst_C "Number of permissible resets in case of an error in test voltage verification" VALUE 0x8053B663 Val_Wu8 255.0 dez 0.00 255.0 FORMAT "%5.1" /end CHARACTERISTIC
/begin CHARACTERISTIC MoCADC_uNTPMax_C "Maximum ADC value in case of ADC channel moved to low during the ADC verification" VALUE 0x8053B664 Val_Wu8 2.490 spg_q0p00977 0.00 2.490 FORMAT "%5.3" /end CHARACTERISTIC
/begin CHARACTERISTIC MoCADC_uTstMax_C "Maximum test voltage in ADC test" VALUE 0x8053BD80 Val_Ws16 319995.1 spg_q4p88_mV -160000.0 159995.1 FORMAT "%8.1" /end CHARACTERISTIC
/begin CHARACTERISTIC MoCADC_uTstMin_C "Minimum test voltage in ADC test" VALUE 0x8053BD82 Val_Ws16 319995.1 spg_q4p88_mV -160000.0 159995.1 FORMAT "%8.1" /end CHARACTERISTIC
/begin CHARACTERISTIC MoCCPU_stLockStepTstActv_CW "Codeword to create lockstep core error for test purpose" VALUE 0x8053CD00 Val_Wu8 1.000 dez 0.00 1.000 FORMAT "%5.3" EXTENDED_LIMITS 0.00 255.0 /end CHARACTERISTIC
/begin CHARACTERISTIC MoCGTM_cntrCMPErrbitHealMax_C "Number of times CMP patter match should occur to initiate healing of MoCGTM_cntrCMPErrbit" VALUE 0x8053B666 Val_Wu8 255.0 dez 0.00 255.0 FORMAT "%5.1" /end CHARACTERISTIC
/begin CHARACTERISTIC MoCGTM_cntrDebErrMax_C "Max. allowed deviation between badcase created and detected occured" VALUE 0x8053B667 Val_Wu8 255.0 dez 0.00 255.0 FORMAT "%5.1" /end CHARACTERISTIC
/begin CHARACTERISTIC MoCGTM_stChksTstActv_CW "Calibration for ECU-MST test of MCS ROM check" VALUE 0x8053CD02 Val_Wu8 1.000 dez 0.00 1.000 FORMAT "%5.3" EXTENDED_LIMITS 0.00 255.0 /end CHARACTERISTIC
/begin CHARACTERISTIC MoCGTM_stSWResetDem_CW "Codeword for enabling reset and Error pin as error reaction in case of failure of MoCGTM tests" VALUE 0x8053B66C Val_Wu8 255.0 dez 0.00 255.0 FORMAT "%5.1" /end CHARACTERISTIC
/begin CHARACTERISTIC MoCGTM_stTestActv_CW "Codeword to activate MFT (Monitoring Function Test) and check the error reaction from MoCGTM_Co" VALUE 0x8053CD03 Val_Wu8 1.000 dez 0.00 1.000 FORMAT "%5.3" EXTENDED_LIMITS 0.00 255.0 /end CHARACTERISTIC
/begin CHARACTERISTIC MoCHwLogicTest_stTestActv_CW "Codeword to activate MFT (Monitoring Function Test) and check the error reaction from MoCHwLogicTest_Co" VALUE 0x8053CD04 Val_Wu8 255.0 dez 0.00 255.0 FORMAT "%5.1" /end CHARACTERISTIC
/begin CHARACTERISTIC MoCHwLogicTest_swtDisblErrReactn_CW "Calibration to disable error reaction from checks in hardware logic test module" VALUE 0x8053B66E Val_Wu8 255.0 dez 0.00 255.0 FORMAT "%5.1" /end CHARACTERISTIC
/begin CHARACTERISTIC MoCHwLogicTest_swtDisblFwChk_CA "Calibration to disable error reaction from Firmware checks" VAL_BLK 0x8053BD34 ValA_Wu32 4294967295.00 OneToOne 0.00 4294967295.00 FORMAT "%13.2" NUMBER 5 /end CHARACTERISTIC
/begin CHARACTERISTIC MoCIWDH_stPtlRespTstActv_CW "Codeword to destroy the partial response from MoCIWDH if enabled" VALUE 0x8053CD05 Val_Wu8 1.000 dez 0.00 1.000 FORMAT "%5.3" EXTENDED_LIMITS 0.00 255.0 /end CHARACTERISTIC
/begin CHARACTERISTIC MoCMemStrtUp_chkRamTest_C "Parameter to request corruption of RAM test during complete memory test" VALUE 0x8053CD06 Val_Wu8 255.0 dez 0.00 255.0 FORMAT "%5.1" /end CHARACTERISTIC
/begin CHARACTERISTIC MoCMemStrtUp_chkRomTest_C "Parameter to request corruption of ROM test during complete memory test" VALUE 0x8053CD07 Val_Wu8 255.0 dez 0.00 255.0 FORMAT "%5.1" /end CHARACTERISTIC
/begin CHARACTERISTIC MoCMem_ctDebErrChkRAM_C "Error tolerance threshold for double storage and cyclic RAM-Test" VALUE 0x8053B670 Val_Wu8 255.0 dez 0.00 255.0 FORMAT "%5.1" /end CHARACTERISTIC
/begin CHARACTERISTIC MoCMem_ctDebErrChkROM_C "Error tolerance threshold for cyclic ROM-Test" VALUE 0x8053B671 Val_Wu8 255.0 dez 0.00 255.0 FORMAT "%5.1" /end CHARACTERISTIC
/begin CHARACTERISTIC MoCMem_ctDebHealChkRAMCpl_C "Complement of the tolerance threshold of the healing counter for the double storage and the cyclical RAM-tests" VALUE 0x8053CD08 Val_Wu8 255.0 dez 0.00 255.0 FORMAT "%5.1" /end CHARACTERISTIC
/begin CHARACTERISTIC MoCMem_ctDebHealChkRAM_C "Tolerance threshold of the healing counter for the double storage and the cyclical RAM-tests" VALUE 0x8053B672 Val_Wu8 255.0 dez 0.00 255.0 FORMAT "%5.1" /end CHARACTERISTIC
/begin CHARACTERISTIC MoCMem_ctDebHealChkROMCpl_C "Complement of the tolerance threshold of the healing counter for the cyclical ROM-tests" VALUE 0x8053CD09 Val_Wu8 255.0 dez 0.00 255.0 FORMAT "%5.1" /end CHARACTERISTIC
/begin CHARACTERISTIC MoCMem_ctDebHealChkROM_C "Tolerance threshold of the healing counter for the cyclical ROM-tests" VALUE 0x8053B673 Val_Wu8 255.0 dez 0.00 255.0 FORMAT "%5.1" /end CHARACTERISTIC
/begin CHARACTERISTIC MoCMem_noMEMChkRstCpl_CW "Double storage for MoCMem_noMEMChkRst_CW" VALUE 0x8053CD0A Val_Wu8 255.0 dez 0.00 255.0 FORMAT "%5.1" /end CHARACTERISTIC
/begin CHARACTERISTIC MoCMem_noMEMChkRst_CW "Disables the error reaction found during the cyclical memory check (Depends on MOCMEM_CONF_SERIES_TOOLCHAIN and MO_ROM_SY)" VALUE 0x8053B674 Val_Wu8 255.0 dez 0.00 255.0 FORMAT "%5.1" /end CHARACTERISTIC
/begin CHARACTERISTIC MoCMem_numRamChk_C "Number of 32-bit memory cells to be tested in cyclical RAM-check" VALUE 0x8053BD84 Val_Wu16 65535.00 dez 0.00 65535.00 FORMAT "%8.2" /end CHARACTERISTIC
/begin CHARACTERISTIC MoCMem_numRomChk_CA "Number of 32-bit memory cells to be tested in cyclical ROM-check." VAL_BLK 0x8053BD86 ValA_Wu16 65535.00 dez 0.00 65535.00 FORMAT "%8.2" NUMBER 4 /end CHARACTERISTIC
/begin CHARACTERISTIC MoCMem_RamTst_CW "Code word for simulating error in cyclic RAM, Stack and CSA test" VALUE 0x8053CD0B Val_Wu8 255.0 dez 0.00 255.0 FORMAT "%5.1" /end CHARACTERISTIC
/begin CHARACTERISTIC MoCMem_RomTst_CW "code word for requiring the reaction test of the cyclic ROM test" VALUE 0x8053CD0C Val_Wu8 255.0 dez 0.00 255.0 FORMAT "%5.1" /end CHARACTERISTIC
/begin CHARACTERISTIC MoCMem_stSwtAutRamChkConf_C "Switch to select automatic configuration of block size for the cyclic RAM check" VALUE 0x8053B675 Val_Wu8 255.0 dez 0.00 255.0 FORMAT "%5.1" /end CHARACTERISTIC
/begin CHARACTERISTIC MoCMem_stSwtAutRomChkConf_C "Switch to select automatic configuration of block size for the cyclic ROM check" VALUE 0x8053B676 Val_Wu8 255.0 dez 0.00 255.0 FORMAT "%5.1" /end CHARACTERISTIC
/begin CHARACTERISTIC MoCPFC_stPtlRespTestActv_CW "codeword to simulate wrong PFC response error" VALUE 0x8053CD0E Val_Wu8 255.0 dez 0.00 255.0 FORMAT "%5.1" /end CHARACTERISTIC
/begin CHARACTERISTIC MoCSCC_cntrDebMax_C "Debounce counter for configuration check error" VALUE 0x8053B678 Val_Wu8 255.0 dez 0.00 255.0 FORMAT "%5.1" /end CHARACTERISTIC
/begin CHARACTERISTIC MoCSCC_stSCCTstActv_CW "status bits to simulate the safety feature configuration check fault" VALUE 0x8053CD30 Val_Wu16 65535.00 dez 0.00 65535.00 FORMAT "%8.2" /end CHARACTERISTIC
/begin CHARACTERISTIC MoCSCC_swtDisblEmmChk_CA "Disable activation check of EMM events, each bit corresponds to a specific EMM event" VAL_BLK 0x8053BD48 ValA_Wu32 4294967295.00 OneToOne 0.00 4294967295.00 FORMAT "%13.2" NUMBER 12 /end CHARACTERISTIC
/begin CHARACTERISTIC MoCSCC_swtLfastWrkarndActv_CW "Deactivation of crossbar MPU check for activation of LFAST interface" VALUE 0x8053B679 Val_Wu8 255.0 dez 0.00 255.0 FORMAT "%5.1" /end CHARACTERISTIC
/begin CHARACTERISTIC MoCSOP_cntrDebCtrlLinesActvThd_C "Debounce level to determine a robust calibration of debounce counter for control lines active during positive test" VALUE 0x8053CD10 Val_Wu8 255.0 dez 0.00 255.0 FORMAT "%5.1" /end CHARACTERISTIC
/begin CHARACTERISTIC MoCSOP_cntrFrMacroTicEnd_C "Synchronisation of FlexRay Shutoff Path Test with specified MacroTick (Slot-End)" VALUE 0x8053BD8E Val_Wu16 65535.00 dez 0.00 65535.00 FORMAT "%8.2" /end CHARACTERISTIC
/begin CHARACTERISTIC MoCSOP_cntrFrMacroTicStrt_C "Synchronisation of FlexRay Shutoff Path Test with specified MacroTick (Slot-Start)" VALUE 0x8053BD90 Val_Wu16 65535.00 dez 0.00 65535.00 FORMAT "%8.2" /end CHARACTERISTIC
/begin CHARACTERISTIC MoCSOP_ctDebCANFrTest_C "Debounce counter for the maximum timeout deviation in the CAN and FlexRay test" VALUE 0x8053B67A Val_Wu8 255.0 dez 0.00 255.0 FORMAT "%5.1" /end CHARACTERISTIC
/begin CHARACTERISTIC MoCSOP_ctDebSOPTst_C "Maximum duration of the power stages shut-off path test" VALUE 0x8053BD92 Val_Wu16 65535.00 dez 0.00 65535.00 FORMAT "%8.2" /end CHARACTERISTIC
/begin CHARACTERISTIC MoCSOP_ctDebSycDrv_C "Maximum number of debounce count to confirm the Syc_stSub state to support secure engine off feature" VALUE 0x8053B67B Val_Wu8 255.0 dez 0.00 255.0 FORMAT "%5.1" /end CHARACTERISTIC
/begin CHARACTERISTIC MoCSOP_ctRstCANFrTest_C "Limit of resets executed in CANFR shut off path test" VALUE 0x8053B67C Val_Wu8 255.0 dez 0.00 255.0 FORMAT "%5.1" /end CHARACTERISTIC
/begin CHARACTERISTIC MoCSOP_ctRst_C "limit of resets executed in shut off path test" VALUE 0x8053B67D Val_Wu8 255.0 dez 0.00 255.0 FORMAT "%5.1" /end CHARACTERISTIC
/begin CHARACTERISTIC MoCSOP_nEngMaxOVLthDisbl_C "Maximum engine speed for activating the overvoltage latch in the VDD5 monitoring hardware" VALUE 0x8053BD94 Val_Ws16 32767.50 EngN -16384.00 16383.50 FORMAT "%8.2" /end CHARACTERISTIC
/begin CHARACTERISTIC MoCSOP_stCANErrReac_CW "codeword for activating the error reaction CAN-driver-disabling" VALUE 0x8053B67E Val_Wu8 255.0 dez 0.00 255.0 FORMAT "%5.1" /end CHARACTERISTIC
/begin CHARACTERISTIC MoCSOP_stCANTestActv_CW "Test label for ECU-MST purpose for CANFR test" VALUE 0x8053CD11 Val_Wu8 1.000 dez 0.00 1.000 FORMAT "%5.3" EXTENDED_LIMITS 0.00 255.0 /end CHARACTERISTIC
/begin CHARACTERISTIC MoCSOP_stErrReactnERPN_CA "Includes the error reaction type based on the error combinations of ERPN-Errorpin path" VAL_BLK 0x8053B67F ValA_Wu8 2.00000000000 MoCSOP_stErrReactnERPN_CA_Compu 0.00 2.00000000000 FORMAT "%13.11" NUMBER 4 /end CHARACTERISTIC
/begin CHARACTERISTIC MoCSOP_stErrReactn_CA "Includes the error reaction type based on the error combinations of InjVlv and PVMT shut off paths" VAL_BLK 0x8053B683 ValA_Wu8 2.00000000000 MoCSOP_stErrReactn_CA_Compu 0.00 2.00000000000 FORMAT "%13.11" NUMBER 16 /end CHARACTERISTIC
/begin CHARACTERISTIC MoCSOP_stMMErrReac_CW "code word for activating the fault reaction MM reset" VALUE 0x8053B693 Val_Wu8 255.0 dez 0.00 255.0 FORMAT "%5.1" /end CHARACTERISTIC
/begin CHARACTERISTIC MoCSOP_stOVErrReactn_C "Error reaction for an error in overvoltage test" VALUE 0x8053B694 Val_Wu8 1.00000000000 MoCSOP_stOVErrReactn_C_Compu 1.00000000000 2.00000000000 FORMAT "%13.11" /end CHARACTERISTIC
/begin CHARACTERISTIC MoCSOP_stReqCANFrTest_C "Calibration to decide for the execution of CANFR test" VALUE 0x8053B695 Val_Wu8 255.0 dez 0.00 255.0 FORMAT "%5.1" /end CHARACTERISTIC
/begin CHARACTERISTIC MoCSOP_stSWResetDem_CW "Status-Bit for Software-Reset demand in case of shut-off path test error" VALUE 0x8053B696 Val_Wu8 255.0 dez 0.00 255.0 FORMAT "%5.1" /end CHARACTERISTIC
/begin CHARACTERISTIC MoCSOP_stTestActv_CW "Codeword to activate MFT and check the error reaction from shut off path test" VALUE 0x8053CD12 Val_Wu8 1.000 dez 0.00 1.000 FORMAT "%5.3" EXTENDED_LIMITS 0.00 255.0 /end CHARACTERISTIC
/begin CHARACTERISTIC MoCSOP_swtAlwysPsTest_C "Switch to select repetition of power stage SOP test in case of broken after run" VALUE 0x8053B697 Val_Wu8 1.000 dez 0.00 1.000 FORMAT "%5.3" EXTENDED_LIMITS 0.00 255.0 /end CHARACTERISTIC
/begin CHARACTERISTIC MoCSOP_swtRepFaildPESTest_C "Switch to repeat the complete MoCSOP test in case of an aborted after-run if there was an error in previous CAN-FR, Injection Control lines test" VALUE 0x8053B698 Val_Wu8 1.000 dez 0.00 1.000 FORMAT "%5.3" EXTENDED_LIMITS 0.00 255.0 /end CHARACTERISTIC
/begin CHARACTERISTIC MoFACC_swtCANEna_C "Calibration to enabledisable CAN extraction" VALUE 0x8053B69A Val_Wu8 1.00000000000 B_TRUE 0.00 1.00000000000 FORMAT "%13.11" /end CHARACTERISTIC
/begin AXIS_PTS MoFAirFlEta_nEng_Ax "Data point distribution for engine speed" 0x8053B6BC MoFESpd_nEng Axis_Xu8 10200. nmot_q40 12 0.00 10200. FORMAT "%5.0" DEPOSIT ABSOLUTE /end AXIS_PTS
/begin AXIS_PTS MoFAirFlEta_ratFillg_Ax "Axis grid distribution for air charge" 0x8053BDBC MoFAirFl_ratFillg Axis_Xu16 1535.977 rel_uw_q0p0234 12 0.00 1535.977 FORMAT "%8.3" DEPOSIT ABSOLUTE /end AXIS_PTS
/begin CHARACTERISTIC MoFAirFl_cntrAfimActvMax_C "Max. allowed AFIM active time in function monitoring" VALUE 0x8053BDB8 Val_Wu16 65535.00 OneToOne 0.00 65535.00 FORMAT "%8.2" /end CHARACTERISTIC
/begin CHARACTERISTIC MoFAirFl_cntrErrDebMaxCtOffPfi_C "Max. allowed error debounce time in function MoFAirFl_CtOffPfi" VALUE 0x8053B6B2 Val_Wu8 255.0 OneToOne 0.00 255.0 FORMAT "%5.1" /end CHARACTERISTIC
/begin CHARACTERISTIC MoFAirFl_cntrErrDebMaxCylPfi_C "Max. allowed error debounce time in function MoFAirFl_CylPfi" VALUE 0x8053B6B6 Val_Wu8 255.0 OneToOne 0.00 255.0 FORMAT "%5.1" /end CHARACTERISTIC
/begin CHARACTERISTIC MoFAirFl_cntrRstMaxCtOffPfi_C "Maximum number of Pre-ICO-Resets in function MoFAirFl_CtOffPfi" VALUE 0x8053B6B3 Val_Wu8 255.0 OneToOne 0.00 255.0 FORMAT "%5.1" /end CHARACTERISTIC
/begin CHARACTERISTIC MoFAirFl_cntrRstMaxCylPfi_C "Maximum number of Pre-ICO-Resets in function MoFAirFl_CylPfi" VALUE 0x8053B6B7 Val_Wu8 255.0 OneToOne 0.00 255.0 FORMAT "%5.1" /end CHARACTERISTIC
/begin CHARACTERISTIC MoFAirFl_etaIA_T "Ignition angle efficiency in function monitoring" CURVE 0x8053BDD6 ValA_Wu16 1.999969 fak_uw_b2 0.00 1.999969 FORMAT "%8.6"
 /begin AXIS_DESCR COM_AXIS MoFAirFl_iaDelta zw_ub_q0p75 8 0.00 191.3 FORMAT "%5.1" AXIS_PTS_REF MoFAirFl_iaDelta_Ax /end AXIS_DESCR
/end CHARACTERISTIC
/begin CHARACTERISTIC MoFAirFl_etaLam_T "Lambda efficiency in function monitoring" CURVE 0x8053BDE6 ValA_Wu16 1.999969 fak_uw_b2 0.00 1.999969 FORMAT "%8.6"
 /begin AXIS_DESCR COM_AXIS MoFAirFl_ratLamSp fak_uw_b16 8 0.00 15.99976 FORMAT "%8.5" AXIS_PTS_REF MoFAirFl_ratLamSp_Ax /end AXIS_DESCR
/end CHARACTERISTIC
/begin CHARACTERISTIC MoFAirFl_facCorFuAvrgMax_C "Maximum permitted average value for cylinder individual fuel correction in function monitoring" VALUE 0x8053BDBA Val_Wu16 1.999969 fak_uw_b2 0.00 1.999969 FORMAT "%8.6" /end CHARACTERISTIC
/begin CHARACTERISTIC MoFAirFl_facCorrnFuMCylIndAfimMax_C "Max. allowed value cylinder individual fuel corrections (AFIM) in function monitoring" VALUE 0x8053B6B8 Val_Wu8 1.992188 fak_ub_b2 0.00 1.992188 FORMAT "%8.6" /end CHARACTERISTIC
/begin CHARACTERISTIC MoFAirFl_facCorrnFuMCylIndMax_C "Max. allowed value cylinder individual fuel corrections in function monitoring" VALUE 0x8053B6B9 Val_Wu8 1.992188 fak_ub_b2 0.00 1.992188 FORMAT "%8.6" /end CHARACTERISTIC
/begin CHARACTERISTIC MoFAirFl_iaDeltaOptLam_T "Delta optimal ignition angle lambda dependent in function monitoring" CURVE 0x8053B6CA Mo_DataCurveSstU16WU8_Static 191.3 zw_ub_q0p75 0.00 191.3 FORMAT "%5.1"
 /begin AXIS_DESCR STD_AXIS MoFAirFl_ratLamSp fak_uw_b16 8 0.00 15.99976 FORMAT "%8.5" DEPOSIT ABSOLUTE /end AXIS_DESCR
/end CHARACTERISTIC
/begin CHARACTERISTIC MoFAirFl_iaDeltaOptT_T "Delta optimal ignition angle temperature dependent in function monitoring" CURVE 0x8053B6E4 ValA_Wu8 191.3 zw_ub_q0p75 0.00 191.3 FORMAT "%5.1"
 /begin AXIS_DESCR COM_AXIS MoF_tEng temp_ub_q0p75_o48 8 -48.0 143.3 FORMAT "%5.1" AXIS_PTS_REF MoF_tEng_DST /end AXIS_DESCR
/end CHARACTERISTIC
/begin AXIS_PTS MoFAirFl_iaDelta_Ax "Axis grid distribution for delta ignition angle in function monitoring" 0x8053B6EC MoFAirFl_iaDelta Axis_Xu8 191.3 zw_ub_q0p75 8 0.00 191.3 FORMAT "%5.1" DEPOSIT ABSOLUTE /end AXIS_PTS
/begin CHARACTERISTIC MoFAirFl_iaOptm_M "Optimal ignition angle in function monitoring" MAP 0x8053B6F5 MapG_Ws8 191.3 zw_sb_q0p75 -96.00 95.25 FORMAT "%5.2"
 /begin AXIS_DESCR COM_AXIS MoFAirFl_ratFillg rel_uw_q0p0234 12 0.00 1535.977 FORMAT "%8.3" AXIS_PTS_REF MoFAirFlEta_ratFillg_Ax /end AXIS_DESCR
 /begin AXIS_DESCR COM_AXIS MoFESpd_nEng nmot_q40 12 0.00 10200. FORMAT "%5.0" AXIS_PTS_REF MoFAirFlEta_nEng_Ax /end AXIS_DESCR
/end CHARACTERISTIC
/begin CHARACTERISTIC MoFAirFl_nEngStallg_C "Engine speed threshold for stall detection in function monitoring" VALUE 0x8053B6B4 Val_Wu8 10200. nmot_q40 0.00 10200. FORMAT "%5.0" /end CHARACTERISTIC
/begin CHARACTERISTIC MoFAirFl_nErrHndlgActvnCtOffPfi_C "Engine speed threshold for activation of error handling in function MoFAirFl_CtOffPfi" VALUE 0x8053B6B5 Val_Wu8 10200. nmot_q40 0.00 10200. FORMAT "%5.0" /end CHARACTERISTIC
/begin CHARACTERISTIC MoFAirFl_nErrHndlgActvnCylPfi_C "Engine speed threshold for activation of error handling in function MoFAirFl_CylPfi" VALUE 0x8053B6BA Val_Wu8 10200. nmot_q40 0.00 10200. FORMAT "%5.0" /end CHARACTERISTIC
/begin AXIS_PTS MoFAirFl_ratLamSp_Ax "Axis grid distribution for lambda in function monitoring" 0x8053BDF6 MoFAirFl_ratLamSp Axis_Xu16 15.99976 fak_uw_b16 8 0.00 15.99976 FORMAT "%8.5" DEPOSIT ABSOLUTE /end AXIS_PTS
/begin CHARACTERISTIC MoFAirFl_stCfgCyl_C "Codeword for configuration of function MoFAirFl_Cyl (Gdi, Pfi)" VALUE 0x8053B6BB Val_Wu8 255.0 OneToOne 0.00 255.0 FORMAT "%5.1" /end CHARACTERISTIC
/begin AXIS_PTS MoF_tEng_DST "interpolation node distribution for engine temperature in the function monitoring" 0x8053BA5F MoF_tEng Axis_Xu8 191.3 temp_ub_q0p75_o48 8 -48.0 143.3 FORMAT "%5.1" DEPOSIT ABSOLUTE /end AXIS_PTS
/begin MEASUREMENT etaaus_um "Fuel cut off efficiency for monitoring" UBYTE fak_ub_b2 1 100 0.00 1.992188 FORMAT "%8.6" ECU_ADDRESS 0x60012304 /end MEASUREMENT
/begin MEASUREMENT etaaus_ur "RAM data redundancy for ETAAUS_UM" UBYTE OneToOne 1 100 0.00 255.0 FORMAT "%5.1" ECU_ADDRESS 0x60011C0D /end MEASUREMENT
/begin MEASUREMENT evz_aus_um "Fuel cut off state for monitoring" UBYTE OneToOne 1 100 0.00 255.0 FORMAT "%5.1" ECU_ADDRESS 0x6001230A /end MEASUREMENT
/begin MEASUREMENT evz_aus_ur "RAM data redundancy for EVZ_AUS_UR" UBYTE OneToOne 1 100 0.00 255.0 FORMAT "%5.1" ECU_ADDRESS 0x60011C13 /end MEASUREMENT
/begin MEASUREMENT MisfDet_cylFrzFrmData "Cylinder number relevant for similar conditions" SBYTE OneToOne 1 100 -128.0 127.0 FORMAT "%5.1" ECU_ADDRESS 0x600363AA /end MEASUREMENT
/begin MEASUREMENT MisfDet_dnThd "Threshold for circular acceleration" SWORD dn_Compu 1 100 -2048.000 2047.938 FORMAT "%8.3" ECU_ADDRESS 0x5000071C /end MEASUREMENT
/begin MEASUREMENT MisfDet_dnThdCont "Threshold for continuous misfires" SWORD dn_Compu 1 100 -2048.000 2047.938 FORMAT "%8.3" ECU_ADDRESS 0x5000071E /end MEASUREMENT
/begin MEASUREMENT MisfDet_dnThdContRdcVal "value for reduction of dnThdCont" SWORD dn_Compu 1 100 -2048.000 2047.938 FORMAT "%8.3" ECU_ADDRESS 0x70001896 /end MEASUREMENT
/begin MEASUREMENT MisfDet_dnThdCor "preliminary detection threshold including correction offsets and factors" SWORD dn_Compu 1 100 -2048.000 2047.938 FORMAT "%8.3" ECU_ADDRESS 0x50000720 /end MEASUREMENT
/begin MEASUREMENT MisfDet_dnThdCorCont "preliminary detection threshold for continuous misfires including correction offsets and factors" SWORD dn_Compu 1 100 -2048.000 2047.938 FORMAT "%8.3" ECU_ADDRESS 0x50000634 /end MEASUREMENT
/begin MEASUREMENT MisfDet_dnThdCorDif "preliminary detection threshold for differential method including correction offsets and factors" SWORD dn_Compu 1 100 -2048.000 2047.938 FORMAT "%8.3" ECU_ADDRESS 0x50000636 /end MEASUREMENT
/begin MEASUREMENT MisfDet_dnThdDecLim "limitation of negative gradients of detection threshold" SWORD dn_Compu 1 100 -2048.000 2047.938 FORMAT "%8.3" ECU_ADDRESS 0x50000638 /end MEASUREMENT
/begin MEASUREMENT MisfDet_dnThdDecLimCont "limitation of negative gradients of detection threshold for continuous misfire" SWORD dn_Compu 1 100 -2048.000 2047.938 FORMAT "%8.3" ECU_ADDRESS 0x5000063A /end MEASUREMENT
/begin MEASUREMENT MisfDet_dnThdDecLimDif "limitation of negative gradients of detection threshold for differential method" SWORD dn_Compu 1 100 -2048.000 2047.938 FORMAT "%8.3" ECU_ADDRESS 0x5000063C /end MEASUREMENT
/begin MEASUREMENT MisfDet_dnThdDif "detection threshold for differential method" SWORD dn_Compu 1 100 -2048.000 2047.938 FORMAT "%8.3" ECU_ADDRESS 0x50000722 /end MEASUREMENT
/begin MEASUREMENT MisfDet_dnThdDynLim "Threshold for sporadic misfires with limited dynamic" SWORD dn_Compu 1 100 -2048.000 2047.938 FORMAT "%8.3" ECU_ADDRESS 0x5000063E /end MEASUREMENT
/begin MEASUREMENT MisfDet_dnThdDynLimCont "Threshold for continuous misfires with limited dynamic" SWORD dn_Compu 1 100 -2048.000 2047.938 FORMAT "%8.3" ECU_ADDRESS 0x50000640 /end MEASUREMENT
/begin MEASUREMENT MisfDet_dnThdFacLteCmb "Factor to detection threshold at late combustion barycenter" UWORD fak_uw_b2 1 100 0.00 1.999969 FORMAT "%8.6" ECU_ADDRESS 0x70001CDC /end MEASUREMENT
/begin MEASUREMENT MisfDet_dnThdFacLteCmbMapOut "Factor to detection threshold at late combustion barycenter curve output" UWORD fak_uw_b2 1 100 0.00 1.999969 FORMAT "%8.6" ECU_ADDRESS 0x70001CDA /end MEASUREMENT
/begin MEASUREMENT MisfDet_dnThdFacStrt "Factor to detection threshold at engine start" UWORD fak_uw_b2 1 100 0.00 1.999969 FORMAT "%8.6" ECU_ADDRESS 0x50000724 /end MEASUREMENT
/begin MEASUREMENT MisfDet_dnThdMapOut "Threshold output from map" SWORD dn_Compu 1 100 -2048.000 2047.938 FORMAT "%8.3" ECU_ADDRESS 0x50000728 /end MEASUREMENT
/begin MEASUREMENT MisfDet_dnThdMapOutCont "threshold for continuous misfires, output from map" SWORD dn_Compu 1 100 -2048.000 2047.938 FORMAT "%8.3" ECU_ADDRESS 0x5000072A /end MEASUREMENT
/begin MEASUREMENT MisfDet_dnThdMapOutDif "map output of base map for differential method" SWORD dn_Compu 1 100 -2048.000 2047.938 FORMAT "%8.3" ECU_ADDRESS 0x5000072C /end MEASUREMENT
/begin MEASUREMENT MisfDet_dnThdMinAdpn "Minimum limitation of threshold due to incomplete adaptations" SWORD dn_Compu 1 100 -2048.000 2047.938 FORMAT "%8.3" ECU_ADDRESS 0x5000072E /end MEASUREMENT
/begin MEASUREMENT MisfDet_dnThdMinContOut "Threshold limitation for continuous misfires map output" SWORD dn_Compu 1 100 -2048.000 2047.938 FORMAT "%8.3" ECU_ADDRESS 0x50000730 /end MEASUREMENT
/begin MEASUREMENT MisfDet_dnThdMinDnAdpnMapIdx "map index for minimum limitation in case of incomplete dn adaptation" SBYTE MisfDet_dnThdMinDnAdpnMapIdx_VERB 1 100 -1.00000000000 2.00000000000 FORMAT "%13.11" ECU_ADDRESS 0x70001895 /end MEASUREMENT
/begin MEASUREMENT MisfDet_dnThdMinDnAdpnMapOut "minimum limitation in case of incomplete dn adaptation map output" SWORD dn_Compu 1 100 -2048.000 2047.938 FORMAT "%8.3" ECU_ADDRESS 0x50000732 /end MEASUREMENT
/begin MEASUREMENT MisfDet_dnThdMinDnAdpnVal "Minimum limitation of threshold due to incomplete dn adaptation, curve output" SWORD dn_Compu 1 100 -2048.000 2047.938 FORMAT "%8.3" ECU_ADDRESS 0x70001D4E /end MEASUREMENT
/begin MEASUREMENT MisfDet_dnThdMinSegTiAdpn "minimum limitation in case of incomplete dnsegment time adaptation" SWORD dn_Compu 1 100 -2048.000 2047.938 FORMAT "%8.3" ECU_ADDRESS 0x70001D4C /end MEASUREMENT
/begin MEASUREMENT MisfDet_dnThdOffsT "temperature dependent offset to detection threshold" SWORD dn_Compu 1 100 -2048.000 2047.938 FORMAT "%8.3" ECU_ADDRESS 0x50000734 /end MEASUREMENT
/begin MEASUREMENT MisfDet_dnThdSyncContFiltd "filtered detection threshold for continuous misfires" SWORD dn_Compu 1 100 -2048.000 2047.938 FORMAT "%8.3" ECU_ADDRESS 0x50000642 /end MEASUREMENT
/begin MEASUREMENT MisfDet_idxThdMap "index of threshold map" UBYTE MisfDet_idxThdMap_VERB 1 100 0.00 22.0000000000 FORMAT "%13.10" ECU_ADDRESS 0x50000869 /end MEASUREMENT
/begin MEASUREMENT MisfDet_idxThdMapSync "index for map selection synchronised" UBYTE MisfDet_idxThdMap_VERB 1 100 0.00 22.0000000000 FORMAT "%13.10" ECU_ADDRESS 0x70001894 /end MEASUREMENT
/begin MEASUREMENT MisfDet_ignCntr "Ignition counter endurance test" ULONG OneToOne 1 100 0.00 4294967295.00 FORMAT "%13.2" ECU_ADDRESS 0x600363A4 /end MEASUREMENT
/begin MEASUREMENT MisfDet_maskStcCatFltCylIdn "cylinder individual fault state single cylinder fault" UWORD OneToOne 1 100 0.00 65535.00 FORMAT "%8.2" ECU_ADDRESS 0x50000740 /end MEASUREMENT
/begin MEASUREMENT MisfDet_maskStcCatFltMpl "cylinder individual fault state multiple fault" UWORD OneToOne 1 100 0.00 65535.00 FORMAT "%8.2" ECU_ADDRESS 0x60000544 /end MEASUREMENT
/begin MEASUREMENT MisfDet_maskStcEmiFltCylIdn "cylinder individual fault state single cylinder fault" UWORD OneToOne 1 100 0.00 65535.00 FORMAT "%8.2" ECU_ADDRESS 0x70001CD8 /end MEASUREMENT
/begin MEASUREMENT MisfDet_maskStcEmiFltMpl "cylinder individual fault state multiple fault" UWORD OneToOne 1 100 0.00 65535.00 FORMAT "%8.2" ECU_ADDRESS 0x70001CD6 /end MEASUREMENT
/begin MEASUREMENT MisfDet_misfCntrCyl "misfire counter endurance test" UWORD OneToOne 1 100 0.00 65535.00 FORMAT "%8.2" ARRAY_SIZE 4 ECU_ADDRESS 0x6003639C /end MEASUREMENT
/begin MEASUREMENT MisfDet_misfCntrSum "sum of cylinder individual misfire counter endurance test" UWORD OneToOne 1 100 0.00 65535.00 FORMAT "%8.2" ECU_ADDRESS 0x60000458 /end MEASUREMENT
/begin MEASUREMENT MisfDet_nrDcycDrvRcdr "Number driving cycles to reset endurance test counters" UBYTE OneToOne 1 100 0.00 255.0 FORMAT "%5.1" ECU_ADDRESS 0x600363A8 /end MEASUREMENT
/begin MEASUREMENT MisfDet_simrCdn.n "Freeze frame data for similar conditions misfire fault / engine speed for similar conditions" UWORD nmot_uw_q0p25 1 100 0.00 16383.75 FORMAT "%8.2" ECU_ADDRESS 0x5000041C /end MEASUREMENT
/begin MEASUREMENT MisfDet_simrCdn.load "Freeze frame data for similar conditions misfire fault / load for similar conditions" UBYTE rel_ub_b99p6 1 100 0.00 99.61 FORMAT "%5.2" ECU_ADDRESS 0x5000041E /end MEASUREMENT
/begin MEASUREMENT MisfDet_simrCdn.T "Freeze frame data for similar conditions misfire fault / Warm-Up state for similar coditions" UBYTE B_TRUE 1 100 0.00 1.00000000000 BIT_MASK 0x1 FORMAT "%13.11" ECU_ADDRESS 0x5000041F /end MEASUREMENT
/begin MEASUREMENT MisfDet_stCatDmg "cat damage during past intervall" UBYTE B_TRUE 1 100 0.00 1.00000000000 BIT_MASK 0x1 FORMAT "%13.11" ECU_ADDRESS 0x50005D8F /end MEASUREMENT
/begin MEASUREMENT MisfDet_stCatDmgBnk "exhaust bank individual statusbyte for catalyst damaging misfire rate exceeded" UBYTE OneToOne 1 100 0.00 255.0 FORMAT "%5.1" ECU_ADDRESS 0x500008A5 /end MEASUREMENT
/begin MEASUREMENT MisfDet_stCatDmgBnkCurrIntl "Catalyst damage bank index" UBYTE OneToOne 1 100 0.00 255.0 FORMAT "%5.1" ECU_ADDRESS 0x60000799 /end MEASUREMENT
/begin MEASUREMENT MisfDet_stCatDmgCritScav "Catalyst damaginging at high scavenging rate detected" UBYTE B_TRUE 1 100 0.00 1.00000000000 BIT_MASK 0x1 FORMAT "%13.11" ECU_ADDRESS 0x6000A7C6 /end MEASUREMENT
/begin MEASUREMENT MisfDet_stCatDmgCritScavCurr "Catalyst damaginging at high scavenging rate detected at current interval" UBYTE B_TRUE 1 100 0.00 1.00000000000 BIT_MASK 0x1 FORMAT "%13.11" ECU_ADDRESS 0x6000A7C5 /end MEASUREMENT
/begin MEASUREMENT MisfDet_stCatDmgCurrIntl "Condition for catalyst damaging misfire detected for this kat- intervall" UBYTE B_TRUE 1 100 0.00 1.00000000000 BIT_MASK 0x1 FORMAT "%13.11" ECU_ADDRESS 0x6000A7C4 /end MEASUREMENT
/begin MEASUREMENT MisfDet_stCatDmgDebd "status debouncing for catalyst damaging expired" UBYTE B_TRUE 1 100 0.00 1.00000000000 BIT_MASK 0x1 FORMAT "%13.11" ECU_ADDRESS 0x70000190 /end MEASUREMENT
/begin MEASUREMENT MisfDet_stCatDmgDebMisfOutdRng "status misfire detected out of range for debouncing" UBYTE B_TRUE 1 100 0.00 1.00000000000 BIT_MASK 0x1 FORMAT "%13.11" ECU_ADDRESS 0x7000018F /end MEASUREMENT
/begin MEASUREMENT MisfDet_stCatDmgDebOutOfRng "status out of range for debouncing" UBYTE B_TRUE 1 100 0.00 1.00000000000 BIT_MASK 0x1 FORMAT "%13.11" ECU_ADDRESS 0x7000018E /end MEASUREMENT
/begin MEASUREMENT MisfDet_stCatDmgFcoCyl "state flag fuel cutoff by catalyst damaging misfiring rates" UBYTE OneToOne 1 100 0.00 255.0 FORMAT "%5.1" ECU_ADDRESS 0x500008A6 /end MEASUREMENT
/begin MEASUREMENT MisfDet_stCatDmgFcoCylCurrIntl "Cylinder has fulfilled criterias for cylinder deactivatino at current interval" UWORD OneToOne 1 100 0.00 65535.00 FORMAT "%8.2" ECU_ADDRESS 0x6000045E /end MEASUREMENT
/begin MEASUREMENT MisfDet_stCatDmgFcoEng "state flag fuel cutoff by catalyst damaging misfiring rates" UWORD OneToOne 1 100 0.00 65535.00 FORMAT "%8.2" ECU_ADDRESS 0x50000758 /end MEASUREMENT
/begin MEASUREMENT MisfDet_stCatDmgLstIntl "catalyst damaging at past interval" UBYTE B_TRUE 1 100 0.00 1.00000000000 BIT_MASK 0x1 FORMAT "%13.11" ECU_ADDRESS 0x6000A7C3 /end MEASUREMENT
/begin MEASUREMENT MisfDet_stCatFltMpl "multiple misfire fault detected" UBYTE B_TRUE 1 100 0.00 1.00000000000 BIT_MASK 0x1 FORMAT "%13.11" ECU_ADDRESS 0x7000018D /end MEASUREMENT
/begin MEASUREMENT MisfDet_stCatIntlCritScav "High scavenging rate at current cat interval" UBYTE B_TRUE 1 100 0.00 1.00000000000 BIT_MASK 0x1 FORMAT "%13.11" ECU_ADDRESS 0x6000A7C2 /end MEASUREMENT
/begin MEASUREMENT MisfDet_StcCatCntrSimrCdn.misfBnk "counter of catalyst damage in similar conditions / misfire counter sum of exhaust bank under similar conditions" UWORD OneToOne 1 100 0.00 65535.00 FORMAT "%8.2" ARRAY_SIZE 1 ECU_ADDRESS 0x5000022C /end MEASUREMENT
/begin MEASUREMENT MisfDet_StcCatCntrSimrCdn.ign "counter of catalyst damage in similar conditions / ignition counter in cat interval" UWORD OneToOne 1 100 0.00 65535.00 FORMAT "%8.2" ECU_ADDRESS 0x5000022E /end MEASUREMENT
/begin MEASUREMENT MisfDet_stcCatDmgCritScavIntlCntr "Catalyst damaginging intervals at high scavenging rate" UBYTE OneToOne 1 100 0.00 255.0 FORMAT "%5.1" ECU_ADDRESS 0x70001C1B /end MEASUREMENT
/begin MEASUREMENT MisfDet_stcCatDmgDebIntlCntr "counter encountered from catalyst damaging till FSP entry" UBYTE OneToOne 1 100 0.00 255.0 FORMAT "%5.1" ECU_ADDRESS 0x60000729 /end MEASUREMENT
/begin MEASUREMENT MisfDet_stcCatDmgFcoNrCylBnk "number of deactivated cylinders on exhaust bank" UBYTE OneToOne 1 100 0.00 255.0 FORMAT "%5.1" ARRAY_SIZE 1 ECU_ADDRESS 0x500008AD /end MEASUREMENT
/begin MEASUREMENT MisfDet_stcCatDmgFcoNrIntlCyl "Number of intervals criterias for cylinder deactivation met" UBYTE OneToOne 1 100 0.00 255.0 FORMAT "%5.1" ARRAY_SIZE 4 ECU_ADDRESS 0x50000420 /end MEASUREMENT
/begin MEASUREMENT MisfDet_stcCatDmgFcoNrIntlMin "Necessary number of intervals criterias for cylinder deactivation met" UBYTE OneToOne 1 100 0.00 255.0 FORMAT "%5.1" ECU_ADDRESS 0x50005D2C /end MEASUREMENT
/begin MEASUREMENT MisfDet_stcCatDmgFcoNrIntlStrt "Number of intervals since start" UBYTE OneToOne 1 100 0.00 255.0 FORMAT "%5.1" ECU_ADDRESS 0x6000072A /end MEASUREMENT
/begin MEASUREMENT MisfDet_stcCatDmgNrCyl "Number of catalyst damaging cylinders" UBYTE OneToOne 1 100 0.00 255.0 FORMAT "%5.1" ECU_ADDRESS 0x6000079F /end MEASUREMENT
/begin MEASUREMENT MisfDet_stcCatIgnCntr "Ignition counter for cat interval" UWORD OneToOne 1 100 0.00 65535.00 FORMAT "%8.2" ECU_ADDRESS 0x50000760 /end MEASUREMENT
/begin MEASUREMENT MisfDet_stcCatIntlLen "Number of ignitions of cat interval" UWORD OneToOne 1 100 0.00 65535.00 FORMAT "%8.2" ECU_ADDRESS 0x50000762 /end MEASUREMENT
/begin MEASUREMENT MisfDet_stcCatIntlLenMaxSimrCdn "Length of cat interval for similar conditions" UWORD OneToOne 1 100 0.00 65535.00 FORMAT "%8.2" ECU_ADDRESS 0x60000460 /end MEASUREMENT
/begin MEASUREMENT MisfDet_stcCatMisfCntrBnk "Weighted misfire counter for exhaust bank" UWORD OneToOne 1 100 0.00 65535.00 FORMAT "%8.2" ARRAY_SIZE 1 ECU_ADDRESS 0x50000764 /end MEASUREMENT
/begin MEASUREMENT MisfDet_stcCatMisfCntrBnkCritScav "Counter for catalyst damaging misfire per cylinder bank considering high scavenging rate" UWORD OneToOne 1 100 0.00 65535.00 FORMAT "%8.2" ARRAY_SIZE 1 ECU_ADDRESS 0x70001CD4 /end MEASUREMENT
/begin MEASUREMENT MisfDet_stcCatMisfCntrCyl "weighted misfire counter cylinder individual" UWORD OneToOne 1 100 0.00 65535.00 FORMAT "%8.2" ARRAY_SIZE 4 ECU_ADDRESS 0x500005B0 /end MEASUREMENT
/begin MEASUREMENT MisfDet_stcCatMisfCntrSumNotWght "unweighted misfire counter for cat interval" UWORD dez 1 100 0.00 65535.00 FORMAT "%8.2" ECU_ADDRESS 0x6000055A /end MEASUREMENT
/begin MEASUREMENT MisfDet_stcCatThd "Threshold for catalyst damaging" UWORD OneToOne 1 100 0.00 65535.00 FORMAT "%8.2" ECU_ADDRESS 0x50000766 /end MEASUREMENT
/begin MEASUREMENT MisfDet_stcCatThdMaxSimrCdn "Threshold for catalyst damaging for similar conditions" UWORD OneToOne 1 100 0.00 65535.00 FORMAT "%8.2" ECU_ADDRESS 0x60000462 /end MEASUREMENT
/begin MEASUREMENT MisfDet_stcCatWghtFac "weighting factor for misfire counter" UBYTE OneToOne 1 100 0.00 255.0 FORMAT "%5.1" ECU_ADDRESS 0x500008AF /end MEASUREMENT
/begin MEASUREMENT MisfDet_stcCatWghtFacCritScav "Catalyst protection, weighting factors considering high scavenging rates" UBYTE OneToOne 1 100 0.00 255.0 FORMAT "%5.1" ECU_ADDRESS 0x70001C1A /end MEASUREMENT
/begin MEASUREMENT MisfDet_stcEmiIgnCntr "ignition counter for emission interval" UWORD OneToOne 1 100 0.00 65535.00 FORMAT "%8.2" ECU_ADDRESS 0x50000768 /end MEASUREMENT
/begin MEASUREMENT MisfDet_stcEmiIntlCntr "interval counter for emission statistic" UBYTE OneToOne 1 100 0.00 255.0 FORMAT "%5.1" ECU_ADDRESS 0x70001C19 /end MEASUREMENT
/begin MEASUREMENT MisfDet_stcEmiIntlDmgCntr "counter iof damaged emission intervals" UBYTE OneToOne 1 100 0.00 255.0 FORMAT "%5.1" ECU_ADDRESS 0x70001C18 /end MEASUREMENT
/begin MEASUREMENT MisfDet_stcEmiMisfCntrCyl "cylinder individual misfire counter for emission statistic" UWORD OneToOne 1 100 0.00 65535.00 FORMAT "%8.2" ARRAY_SIZE 4 ECU_ADDRESS 0x500005B8 /end MEASUREMENT
/begin MEASUREMENT MisfDet_stcEmiMisfCntrSum "misfire sum counter emission statistic" UWORD OneToOne 1 100 0.00 65535.00 FORMAT "%8.2" ECU_ADDRESS 0x5000076A /end MEASUREMENT
/begin MEASUREMENT MisfDet_stcEmiStructCntr.misfSum "structure for counters of emission statistic / misfire sum counter" UWORD OneToOne 1 100 0.00 65535.00 FORMAT "%8.2" ECU_ADDRESS 0x5000064A /end MEASUREMENT
/begin MEASUREMENT MisfDet_stcEmiStructCntr.misfCyl "structure for counters of emission statistic / cylinder individual misfire counter" UWORD OneToOne 1 100 0.00 65535.00 FORMAT "%8.2" ARRAY_SIZE 4 ECU_ADDRESS 0x5000064C /end MEASUREMENT
/begin MEASUREMENT MisfDet_stcEmiStructCntr.ign "structure for counters of emission statistic / ignition counter in emission interval" UWORD OneToOne 1 100 0.00 65535.00 FORMAT "%8.2" ECU_ADDRESS 0x50000654 /end MEASUREMENT
/begin MEASUREMENT MisfDet_stcEmiStructCntr.intl "structure for counters of emission statistic / counter emission intervals" UBYTE OneToOne 1 100 0.00 255.0 FORMAT "%5.1" ECU_ADDRESS 0x50000656 /end MEASUREMENT
/begin MEASUREMENT MisfDet_stcEmiStructCntr.dmgIntl "structure for counters of emission statistic / number of damaged intervals" UBYTE OneToOne 1 100 0.00 255.0 FORMAT "%5.1" ECU_ADDRESS 0x50000657 /end MEASUREMENT
/begin MEASUREMENT MisfDet_stcEmiStructCntr.stCylDmgCylIdn "structure for counters of emission statistic / status erroneous cylinders for cylinder individual fault" UWORD OneToOne 1 100 0.00 65535.00 FORMAT "%8.2" ECU_ADDRESS 0x50000658 /end MEASUREMENT
/begin MEASUREMENT MisfDet_stcEmiStructCntr.stCylDmgMtpl "structure for counters of emission statistic / status erroneous cylinders for multiple ault" UWORD OneToOne 1 100 0.00 65535.00 FORMAT "%8.2" ECU_ADDRESS 0x5000065A /end MEASUREMENT
/begin MEASUREMENT MisfDet_stcEmiStructSimrCdn.misfSum "structure for counters of emission statistic if similar conditions are encountered / misfire sum counter" UWORD OneToOne 1 100 0.00 65535.00 FORMAT "%8.2" ECU_ADDRESS 0x50000424 /end MEASUREMENT
/begin MEASUREMENT MisfDet_stcEmiStructSimrCdn.ign "structure for counters of emission statistic if similar conditions are encountered / ignition counter in emission interval" UWORD OneToOne 1 100 0.00 65535.00 FORMAT "%8.2" ECU_ADDRESS 0x50000426 /end MEASUREMENT
/begin MEASUREMENT MisfDet_stcEmiStructSimrCdn.intl "structure for counters of emission statistic if similar conditions are encountered / counter emission intervals" UWORD OneToOne 1 100 0.00 65535.00 FORMAT "%8.2" ECU_ADDRESS 0x50000428 /end MEASUREMENT
/begin MEASUREMENT MisfDet_stcEmiStructSimrCdn.dmgIntl "structure for counters of emission statistic if similar conditions are encountered / number of damaged intervals" UBYTE OneToOne 1 100 0.00 255.0 FORMAT "%5.1" ECU_ADDRESS 0x5000042A /end MEASUREMENT
/begin MEASUREMENT MisfDet_stcEmiStructSimrCdnStrt.misfSum "structure for counters of emission statistic if similar conditions are encountered first interval / misfire sum counter" UWORD OneToOne 1 100 0.00 65535.00 FORMAT "%8.2" ECU_ADDRESS 0x5000042C /end MEASUREMENT
/begin MEASUREMENT MisfDet_stcEmiStructSimrCdnStrt.ign "structure for counters of emission statistic if similar conditions are encountered first interval / ignition counter in emission interval" UWORD OneToOne 1 100 0.00 65535.00 FORMAT "%8.2" ECU_ADDRESS 0x5000042E /end MEASUREMENT
/begin MEASUREMENT MisfDet_stcEmiStructSimrCdnStrt.intl "structure for counters of emission statistic if similar conditions are encountered first interval / counter emission intervals" UWORD OneToOne 1 100 0.00 65535.00 FORMAT "%8.2" ECU_ADDRESS 0x50000430 /end MEASUREMENT
/begin MEASUREMENT MisfDet_stcEmiStructSimrCdnStrt.dmgIntl "structure for counters of emission statistic if similar conditions are encountered first interval / number of damaged intervals" UBYTE OneToOne 1 100 0.00 255.0 FORMAT "%5.1" ECU_ADDRESS 0x50000432 /end MEASUREMENT
/begin MEASUREMENT MisfDet_stcEmiThd "threshold for emission exceedance" UWORD OneToOne 1 100 0.00 65535.00 FORMAT "%8.2" ECU_ADDRESS 0x70001CD2 /end MEASUREMENT
/begin MEASUREMENT MisfDet_stDnThdDynLim "dynamic limitation enabled" UBYTE B_TRUE 1 100 0.00 1.00000000000 BIT_MASK 0x1 FORMAT "%13.11" ECU_ADDRESS 0x700006EB /end MEASUREMENT
/begin MEASUREMENT MisfDet_stEmiDmgCurrIntl "State of emission damgage current interval" UBYTE B_TRUE 1 100 0.00 1.00000000000 BIT_MASK 0x1 FORMAT "%13.11" ECU_ADDRESS 0x6000A7B9 /end MEASUREMENT
/begin MEASUREMENT MisfDet_stEmiFltMpl "Status multiple fault by emission exceedance" UBYTE B_TRUE 1 100 0.00 1.00000000000 BIT_MASK 0x1 FORMAT "%13.11" ECU_ADDRESS 0x7000018C /end MEASUREMENT
/begin MEASUREMENT MisfDet_stExhDmgSuspc "suspicion for emission relevant misfire rate" UBYTE B_TRUE 1 100 0.00 1.00000000000 BIT_MASK 0x1 FORMAT "%13.11" ECU_ADDRESS 0x50005D95 /end MEASUREMENT
/begin MEASUREMENT MisfDet_stFlt "status of fault types in DFES" UBYTE OneToOne 1 100 0.00 255.0 FORMAT "%5.1" ECU_ADDRESS 0x600363A9 /end MEASUREMENT
/begin MEASUREMENT MisfDet_stFltCurrDcyc "status of fault types at current driving cycle" UBYTE OneToOne 1 100 0.00 255.0 FORMAT "%5.1" ECU_ADDRESS 0x6000079A /end MEASUREMENT
/begin MEASUREMENT MisfDet_stFltCyl "bit mask cylinders with fault code entry" UWORD OneToOne 1 100 0.00 65535.00 FORMAT "%8.2" ECU_ADDRESS 0x60000556 /end MEASUREMENT
/begin MEASUREMENT MisfDet_stFltPrevDcyc "status of fault types of past driving cycles" UBYTE OneToOne 1 100 0.00 255.0 FORMAT "%5.1" ECU_ADDRESS 0x500008A8 /end MEASUREMENT
/begin MEASUREMENT MisfDet_stOk "Status of ok report specific for the fault types" UBYTE OneToOne 1 100 0.00 255.0 FORMAT "%5.1" ECU_ADDRESS 0x60000728 /end MEASUREMENT
/begin MEASUREMENT MisfDet_stSimrCdn "similar conditions encaountered for misfire faults" UBYTE B_TRUE 1 100 0.00 1.00000000000 BIT_MASK 0x1 FORMAT "%13.11" ECU_ADDRESS 0x50005DAA /end MEASUREMENT
/begin MEASUREMENT MisfDet_stStcCatIntlHealSimrCdn "status healing with similar conditions encountered" UBYTE B_TRUE 1 100 0.00 1.00000000000 BIT_MASK 0x1 FORMAT "%13.11" ECU_ADDRESS 0x50005DAB /end MEASUREMENT
/begin MEASUREMENT MisfDet_stStcCatRstCompl200ms "State reset of catalyst statistics completed (200ms)" UBYTE B_TRUE 1 100 0.00 1.00000000000 BIT_MASK 0x1 FORMAT "%13.11" ECU_ADDRESS 0x6000A7A2 /end MEASUREMENT
/begin MEASUREMENT MisfDet_stStcCatStrt "Status first interval (200 CrS rev)" UBYTE B_TRUE 1 100 0.00 1.00000000000 BIT_MASK 0x1 FORMAT "%13.11" ECU_ADDRESS 0x50005DAD /end MEASUREMENT
/begin MEASUREMENT MisfDet_stStcEmiDmgLstIntl "Exhaust damage during last interval" UBYTE B_TRUE 1 100 0.00 1.00000000000 BIT_MASK 0x1 FORMAT "%13.11" ECU_ADDRESS 0x6000A7A1 /end MEASUREMENT
/begin MEASUREMENT MisfDet_stStcEmiFrzFrm "Status Freeze Frame reservation" UBYTE B_TRUE 1 100 0.00 1.00000000000 BIT_MASK 0x1 FORMAT "%13.11" ECU_ADDRESS 0x50005DAE /end MEASUREMENT
/begin MEASUREMENT MisfDet_stStcEmiIntlHealSimrCdn "Status healing encountering similar conditions" UBYTE B_TRUE 1 100 0.00 1.00000000000 BIT_MASK 0x1 FORMAT "%13.11" ECU_ADDRESS 0x50005DAF /end MEASUREMENT
/begin MEASUREMENT MisfDet_stStcEmiIntlHealSimrCdnStrt "Status healing first interval encountering similar conditions" UBYTE B_TRUE 1 100 0.00 1.00000000000 BIT_MASK 0x1 FORMAT "%13.11" ECU_ADDRESS 0x50005DB0 /end MEASUREMENT
/begin MEASUREMENT MisfDet_stStcEmiStrt "status first emission interval" UBYTE B_TRUE 1 100 0.00 1.00000000000 BIT_MASK 0x1 FORMAT "%13.11" ECU_ADDRESS 0x50005DB3 /end MEASUREMENT
/begin MEASUREMENT MisfDet_stStcEmiStrtCatHeat "status cat heat t first emission interval" UBYTE B_TRUE 1 100 0.00 1.00000000000 BIT_MASK 0x1 FORMAT "%13.11" ECU_ADDRESS 0x50005DB4 /end MEASUREMENT
/begin MEASUREMENT MisfDet_stStcEmiStrtSrv "Status first interval (independent from configuration)" UBYTE B_TRUE 1 100 0.00 1.00000000000 BIT_MASK 0x1 FORMAT "%13.11" ECU_ADDRESS 0x6000A7A0 /end MEASUREMENT
/begin MEASUREMENT MisfDet_tiDebCatHealCritScav "Debounce counter to reset DFC_MDCatCrit" UWORD t_q0p1 1 100 0.00 6553.500 FORMAT "%8.3" ECU_ADDRESS 0x70001CD0 /end MEASUREMENT
/begin MEASUREMENT MoCADC_bChkActv "Bit info ADC check by Null Load Testimpuls is active" UBYTE B_TRUE 1 100 0.00 1.00000000000 BIT_MASK 0x8 FORMAT "%13.11" ECU_ADDRESS 0x600123E3 /end MEASUREMENT
/begin MEASUREMENT MoCADC_bDef "Bit info ADC check detected an error" UBYTE B_TRUE 1 100 0.00 1.00000000000 BIT_MASK 0x80 FORMAT "%13.11" ECU_ADDRESS 0x600123E3 /end MEASUREMENT
/begin MEASUREMENT MoCADC_bNTPActv "Null load test impulse check active in ADC monitoring" UBYTE B_TRUE 1 100 0.00 1.00000000000 BIT_MASK 0x1 FORMAT "%13.11" ECU_ADDRESS 0x600123E3 /end MEASUREMENT
/begin MEASUREMENT MoCADC_bNTPErr "Bitinfo in MoCADC_st for irreversible error in ADC check by NuLL Load Testimpuls" UBYTE B_TRUE 1 100 0.00 1.00000000000 BIT_MASK 0x40 FORMAT "%13.11" ECU_ADDRESS 0x600123E3 /end MEASUREMENT
/begin MEASUREMENT MoCADC_bNTPRel "Null load test impulse was released" UBYTE B_TRUE 1 100 0.00 1.00000000000 BIT_MASK 0x2 FORMAT "%13.11" ECU_ADDRESS 0x600123E3 /end MEASUREMENT
/begin MEASUREMENT MoCADC_bTstErr "Bitinfo in MoCADC_st for testvoltage out of permissible range" UBYTE B_TRUE 1 100 0.00 1.00000000000 BIT_MASK 0x4 FORMAT "%13.11" ECU_ADDRESS 0x600123E3 /end MEASUREMENT
/begin MEASUREMENT MoCADC_ctDebNTP "Error counter for verifying of Null-load-Test-pulse" UBYTE OneToOne 1 100 0.00 255.0 FORMAT "%5.1" ECU_ADDRESS 0x600123E5 /end MEASUREMENT
/begin MEASUREMENT MoCADC_ctDebNTPCpl "Double storage for error counter for testing with null load test pulse procedure" UBYTE OneToOne 1 100 0.00 255.0 FORMAT "%5.1" ECU_ADDRESS 0x60011D86 /end MEASUREMENT
/begin MEASUREMENT MoCADC_ctDebTst "Error counter for testing the test voltage" UBYTE OneToOne 1 100 0.00 255.0 FORMAT "%5.1" ECU_ADDRESS 0x600123E4 /end MEASUREMENT
/begin MEASUREMENT MoCADC_ctDebTstCpl "Double storage for error counter for testing with test voltage" UBYTE OneToOne 1 100 0.00 255.0 FORMAT "%5.1" ECU_ADDRESS 0x60011D85 /end MEASUREMENT
/begin MEASUREMENT MoCADC_ctTstNTP "counter of testflag in diagnosis for ADC - Null Load TestPulse check" UBYTE OneToOne 1 100 0.00 255.0 FORMAT "%5.1" ECU_ADDRESS 0x60011D84 /end MEASUREMENT
/begin MEASUREMENT MoCADC_ctTstTst "counter of testflag in diagnosis for ADC - testvoltage check" UBYTE OneToOne 1 100 0.00 255.0 FORMAT "%5.1" ECU_ADDRESS 0x60011D83 /end MEASUREMENT
/begin MEASUREMENT MoCADC_flgClrNTP "Flag bit to indicate request to clear fault memory" UBYTE B_TRUE 1 100 0.00 1.00000000000 BIT_MASK 0x1 FORMAT "%13.11" ECU_ADDRESS 0x7000018B /end MEASUREMENT
/begin MEASUREMENT MoCADC_flgClrTst "Flag bit to indicate request to clear fault memory" UBYTE B_TRUE 1 100 0.00 1.00000000000 BIT_MASK 0x1 FORMAT "%13.11" ECU_ADDRESS 0x7000018A /end MEASUREMENT
/begin MEASUREMENT MoCADC_flgNTPTest "Indicates that the NTP test on APP2 is executed atleast once" UBYTE OneToOne 1 100 0.00 255.0 FORMAT "%5.1" ECU_ADDRESS 0x60011D82 /end MEASUREMENT
/begin MEASUREMENT MoCADC_st "Status Info of ADC monitoring" UBYTE dez 1 100 0.00 255.0 FORMAT "%5.1" ECU_ADDRESS 0x600123E3 /end MEASUREMENT
/begin MEASUREMENT MoCADC_stCpl "Double storage of status Info of ADC monitoring" UBYTE dez 1 100 0.00 255.0 FORMAT "%5.1" ECU_ADDRESS 0x60011D81 /end MEASUREMENT
/begin MEASUREMENT MoCADC_stMsg "Status info from ADC Monitoring, message forLevel1" UBYTE dez 1 100 0.00 255.0 FORMAT "%5.1" ECU_ADDRESS 0x600006C7 /end MEASUREMENT
/begin MEASUREMENT MoCADC_uNTP_mp "Voltage at ADC for acceleration pedal signal 2" UWORD spg_q0p00977 1 100 0.00 639.9902 FORMAT "%8.4" ECU_ADDRESS 0x70008800 /end MEASUREMENT
/begin MEASUREMENT MoCADC_uTst_mp "Voltage at ADC test voltage input" SWORD spg_q4p88_mV 1 100 -160000.0 159995.1 FORMAT "%8.1" ECU_ADDRESS 0x700087FE /end MEASUREMENT
/begin MEASUREMENT MoCCom_bPFCNew "condition new question received for program flow check" UBYTE B_TRUE 1 100 0.00 1.00000000000 BIT_MASK 0x2 FORMAT "%13.11" ECU_ADDRESS 0x600117C8 /end MEASUREMENT
/begin MEASUREMENT MoCCom_bSwShrNew "new question received for software sharing module" UBYTE B_TRUE 1 100 0.00 1.00000000000 BIT_MASK 0x10 FORMAT "%13.11" ECU_ADDRESS 0x600117C8 /end MEASUREMENT
/begin MEASUREMENT MoCCom_cntrInCorrRespTime "Incorrect response time counter" UBYTE OneToOne 1 100 0.00 255.0 FORMAT "%5.1" ECU_ADDRESS 0x60011D80 /end MEASUREMENT
/begin MEASUREMENT MoCCom_cntrSyncMonModl "Counter to increment when incomplete response is received" UBYTE OneToOne 1 100 0.00 255.0 FORMAT "%5.1" ECU_ADDRESS 0x60011D7F /end MEASUREMENT
/begin MEASUREMENT MoCCom_cntrWDAErrThd "Error counter threshold of the external monitoring module" UBYTE OneToOne 1 100 3.000 4.000 FORMAT "%5.3" ECU_ADDRESS 0x60011D6E /end MEASUREMENT
/begin MEASUREMENT MoCCom_cntrWDAErrThdCpl "Complement of Error counter threshold of the external monitoring module" UBYTE OneToOne 1 100 0.00 255.0 FORMAT "%5.1" ECU_ADDRESS 0x60011D7E /end MEASUREMENT
/begin MEASUREMENT MoCCom_cntrWDAErrThdMsg "Error counter threshold of the external monitoring module (a message for Level 1)" UBYTE dez 1 100 3.000 4.000 FORMAT "%5.3" ECU_ADDRESS 0x600007A1 /end MEASUREMENT
/begin MEASUREMENT MoCCom_ctBusErr "error counter for communication bus error between FC and other ASICS like power stage ASIC, Monitoring module etc" UBYTE OneToOne 1 100 0.00 255.0 FORMAT "%5.1" ECU_ADDRESS 0x60011D7D /end MEASUREMENT
/begin MEASUREMENT MoCCom_ctBusErrCpl "Complement variable for bus errors" UBYTE OneToOne 1 100 0.00 255.0 FORMAT "%5.1" ECU_ADDRESS 0x60011D7C /end MEASUREMENT
/begin MEASUREMENT MoCCom_ctErrFC "error counter for failure in function controller" UBYTE OneToOne 1 100 0.00 255.0 FORMAT "%5.1" ECU_ADDRESS 0x60011D6D /end MEASUREMENT
/begin MEASUREMENT MoCCom_ctErrFCCpl "RAM data redundancy for MoCCom_ctErrFC" UBYTE OneToOne 1 100 0.00 255.0 FORMAT "%5.1" ECU_ADDRESS 0x60011D7B /end MEASUREMENT
/begin MEASUREMENT MoCCom_ctErrMM "error counter of monitoring module" UBYTE OneToOne 1 100 0.00 255.0 FORMAT "%5.1" ECU_ADDRESS 0x60011D6C /end MEASUREMENT
/begin MEASUREMENT MoCCom_ctErrMMMsg "info for level 1: error counter of monitoring module" UBYTE dez 1 100 0.00 255.0 FORMAT "%5.1" ECU_ADDRESS 0x600007A2 /end MEASUREMENT
/begin MEASUREMENT MoCCom_ctErrMMOld "old value of the error count got from the monitoring module" UBYTE OneToOne 1 100 0.00 255.0 FORMAT "%5.1" ECU_ADDRESS 0x60011D7A /end MEASUREMENT
/begin MEASUREMENT MoCCom_ctErrOSTimeout "error counter for timeout of operating system" UBYTE OneToOne 1 100 0.00 255.0 FORMAT "%5.1" ECU_ADDRESS 0x60011D79 /end MEASUREMENT
/begin MEASUREMENT MoCCom_Query "Enlarged query from monitoring module" ULONG dez 1 100 0.00 4294967295.00 FORMAT "%13.2" ECU_ADDRESS 0x60011D64 /end MEASUREMENT
/begin MEASUREMENT MoCCom_Response "Response to the query from monitoring module" ULONG dez 1 100 0.00 4294967295.00 FORMAT "%13.2" ECU_ADDRESS 0x60011D68 /end MEASUREMENT
/begin MEASUREMENT MoCCom_Response_mp "copy of the response to the monitoring module" ULONG dez 1 100 0.00 4294967295.00 FORMAT "%13.2" ECU_ADDRESS 0x70008638 /end MEASUREMENT
/begin MEASUREMENT MoCCom_stBusErr "Status variable for bus error" UBYTE OneToOne 1 100 0.00 255.0 FORMAT "%5.1" ECU_ADDRESS 0x60011D78 /end MEASUREMENT
/begin MEASUREMENT MoCCom_stCheckState "Actual step of MoCCOM inner state machine" UBYTE MoCCom_stCheckState_Compu 1 100 0.00 7.00000000000 FORMAT "%13.11" ECU_ADDRESS 0x60011D77 /end MEASUREMENT
/begin MEASUREMENT MoCCom_stCheckStateCpl "complement variable for actual step of moccom inner state machine" UBYTE OneToOne 1 100 0.00 255.0 FORMAT "%5.1" ECU_ADDRESS 0x60011D76 /end MEASUREMENT
/begin MEASUREMENT MoCCom_stComActvOld "Variable to update the SOP test active status" UBYTE OneToOne 1 100 0.00 255.0 FORMAT "%5.1" ECU_ADDRESS 0x60011D75 /end MEASUREMENT
/begin MEASUREMENT MoCCom_stComActvOldCpl "Complement of MoCCom_stComActvOld" UBYTE OneToOne 1 100 0.00 255.0 FORMAT "%5.1" ECU_ADDRESS 0x60011D74 /end MEASUREMENT
/begin MEASUREMENT MoCCom_stComState "Actual step of MoCCOM WD communication state machine" UBYTE MoCCom_stComState_Compu 1 100 0.00 2.00000000000 FORMAT "%13.11" ECU_ADDRESS 0x60011D73 /end MEASUREMENT
/begin MEASUREMENT MoCCom_stErrEna "status variable, if reinitialisation of power stages CJ945 and CY372 is necessary" UBYTE OneToOne 1 100 0.00 255.0 FORMAT "%5.1" ECU_ADDRESS 0x60011D72 /end MEASUREMENT
/begin MEASUREMENT MoCCom_stErrEnaCpl "double storaged status variable, if reinitialisation of power stages CJ945 and CY372 is necessary" UBYTE OneToOne 1 100 0.00 255.0 FORMAT "%5.1" ECU_ADDRESS 0x60011D71 /end MEASUREMENT
/begin MEASUREMENT MoCCom_stQueryNew "Bitbase for info 'new query from monitoring module'" UBYTE OneToOne 1 100 0.00 255.0 FORMAT "%5.1" ECU_ADDRESS 0x600117C8 /end MEASUREMENT
/begin MEASUREMENT MoCCom_stWdgThdErr "Status variable for watchdog threshold error" UBYTE OneToOne 1 100 0.00 255.0 FORMAT "%5.1" ECU_ADDRESS 0x60011D70 /end MEASUREMENT
/begin MEASUREMENT MoCCom_stWdgTiWinErr "Status variable for watchdog time window error" UBYTE OneToOne 1 100 0.00 255.0 FORMAT "%5.1" ECU_ADDRESS 0x60011D6F /end MEASUREMENT
/begin MEASUREMENT MoCCom_SwShrPtlResp "Partial response contribution from software sharing modules" ULONG OneToOne 1 100 0.00 4294967295.00 FORMAT "%13.2" ECU_ADDRESS 0x60011D60 /end MEASUREMENT
/begin MEASUREMENT MoCCPU_PartResp "Partial response from instruction test to monitoring module" ULONG OneToOne 1 100 0.00 4294967295.00 FORMAT "%13.2" ECU_ADDRESS 0x60011D5C /end MEASUREMENT
/begin MEASUREMENT MoCEMM_idxNumCurrErr "Variable to store the number of current error requests" UWORD OneToOne 1 100 0.00 65535.00 FORMAT "%8.2" ECU_ADDRESS 0x600117C6 /end MEASUREMENT
/begin MEASUREMENT MoCEMM_stEmmAlrms "State of EMM alarm groups" ULONG dez 1 100 0.00 4294967295.00 FORMAT "%13.2" ARRAY_SIZE 22 ECU_ADDRESS 0x60012388 /end MEASUREMENT
/begin MEASUREMENT MoCEMM_stEmmAlrmsCpl "Complement of MoCEMM_stEmmAlrms" ULONG dez 1 100 0.00 4294967295.00 FORMAT "%13.2" ARRAY_SIZE 22 ECU_ADDRESS 0x60011D00 /end MEASUREMENT
/begin MEASUREMENT MoCEMM_stEmmAlrmsMsg "State of EMM alarm groups" ULONG dez 1 100 0.00 4294967295.00 FORMAT "%13.2" ARRAY_SIZE 22 ECU_ADDRESS 0x60000380 /end MEASUREMENT
/begin MEASUREMENT MoCEMM_stEmmAlrmsNv "State of EMM alarm groups in NV-Ram" ULONG dez 1 100 0.00 4294967295.00 FORMAT "%13.2" ARRAY_SIZE 22 ECU_ADDRESS 0x60036344 /end MEASUREMENT
/begin MEASUREMENT MoCEMM_stEmmErrorPin "Physical state of error pin" UBYTE dez 1 100 0.00 255.0 FORMAT "%5.1" ECU_ADDRESS 0x600123E0 /end MEASUREMENT
/begin MEASUREMENT MoCEMM_stEmmErrorPinCpl "Complement of physical state of error pin" UBYTE dez 1 100 0.00 255.0 FORMAT "%5.1" ECU_ADDRESS 0x60011D5B /end MEASUREMENT
/begin MEASUREMENT MoCEMM_stEmmGPIO "State of Master controllers output GPIO line" UBYTE dez 1 100 0.00 255.0 FORMAT "%5.1" ECU_ADDRESS 0x60011D5A /end MEASUREMENT
/begin MEASUREMENT MoCEMM_stPwrOnRstHdl "Variable to store the status of execution of power-on reset handler" UBYTE OneToOne 1 100 0.00 255.0 FORMAT "%5.1" ECU_ADDRESS 0x600123E2 /end MEASUREMENT
/begin MEASUREMENT MoCEMM_stPwrOnRstHdlCpl "Complement variable to store the status of execution of power-on reset handler" UBYTE OneToOne 1 100 0.00 255.0 FORMAT "%5.1" ECU_ADDRESS 0x60011D59 /end MEASUREMENT
/begin MEASUREMENT MoCEMM_stPwrOnRstReq "Variable to store the status of power-on reset request" UBYTE OneToOne 1 100 0.00 255.0 FORMAT "%5.1" ECU_ADDRESS 0x600123E1 /end MEASUREMENT
/begin MEASUREMENT MoCEMM_stPwrOnRstReqCpl "Complement variable to store the status of power-on reset request" UBYTE OneToOne 1 100 0.00 255.0 FORMAT "%5.1" ECU_ADDRESS 0x60011D58 /end MEASUREMENT
/begin MEASUREMENT MoCEMM_structCurrReq.MoCEMM_cntrInfo "Structure to store the current PORST request / Structure member to store number of power on resets" ULONG OneToOne 1 100 0.00 4294967295.00 FORMAT "%13.2" ECU_ADDRESS 0x70001F58 /end MEASUREMENT
/begin MEASUREMENT MoCEMM_structCurrReq.MoCEMM_blkInfo "Structure to store the current PORST request / Structure member to store error ID, error statues and Diagnosis data" ULONG OneToOne 1 100 0.00 4294967295.00 FORMAT "%13.2" ARRAY_SIZE 17 ECU_ADDRESS 0x70001F5C /end MEASUREMENT
/begin MEASUREMENT MoCEMM_structCurrReq.MoCEMM_cntrInfoCpl "Structure to store the current PORST request / Complement of MoCEMM_cntrInfo" ULONG OneToOne 1 100 0.00 4294967295.00 FORMAT "%13.2" ECU_ADDRESS 0x70002000 /end MEASUREMENT
/begin MEASUREMENT MoCEMM_structFlash.MoCEMM_cntrInfo "Structure to store the error information from NvM memory. / Structure member to store number of power on resets" ULONG OneToOne 1 100 0.00 4294967295.00 FORMAT "%13.2" ECU_ADDRESS 0x70001EAC /end MEASUREMENT
/begin MEASUREMENT MoCEMM_structFlash.MoCEMM_blkInfo "Structure to store the error information from NvM memory. / Structure member to store error ID, error statues and Diagnosis data" ULONG OneToOne 1 100 0.00 4294967295.00 FORMAT "%13.2" ARRAY_SIZE 41 ECU_ADDRESS 0x70001EB0 /end MEASUREMENT
/begin MEASUREMENT MoCEMM_structFlash.MoCEMM_cntrInfoCpl "Structure to store the error information from NvM memory. / Complement of MoCEMM_cntrInfo" ULONG OneToOne 1 100 0.00 4294967295.00 FORMAT "%13.2" ECU_ADDRESS 0x70001F54 /end MEASUREMENT
/begin MEASUREMENT MoCEMM_stSWErrorPinReqAry "Status array for errorpin handler which software modules are in fault state" ULONG MoExe_Co_PFC_ID_Compu 1 100 0.00 16777471.0000 FORMAT "%13.4" ARRAY_SIZE 10 ECU_ADDRESS 0x7003ABD4 /end MEASUREMENT
/begin MEASUREMENT MoCEMM_stSWErrorPinReqAryCpl "Complement of MoCEMM_stSWErrorPinReqAry" ULONG OneToOne 1 100 0.00 4294967295.00 FORMAT "%13.2" ARRAY_SIZE 10 ECU_ADDRESS 0x7003ABAC /end MEASUREMENT
/begin MEASUREMENT MoCEMM_wdgTout "Variable to store timeout of internal watchdog" ULONG OneToOne 1 100 0.00 4294967295.00 FORMAT "%13.2" ECU_ADDRESS 0x7003ABA8 /end MEASUREMENT
/begin MEASUREMENT MoCGTM_aryCMPErrBit "Output array obtained from CMP_IRQ_NOTIFY" UBYTE OneToOne 1 100 0.00 255.0 FORMAT "%5.1" ARRAY_SIZE 4 ECU_ADDRESS 0x60012381 /end MEASUREMENT
/begin MEASUREMENT MoCGTM_aryCMPErrBitCpl "Complement variable for Output array obtained from CMP_IRQ_NOTIFY" UBYTE OneToOne 1 100 0.00 255.0 FORMAT "%5.1" ARRAY_SIZE 4 ECU_ADDRESS 0x60011CFB /end MEASUREMENT
/begin MEASUREMENT MoCGTM_bbOut1 "Bit bases for storing status of compare bit" UBYTE OneToOne 1 100 0.00 255.0 FORMAT "%5.1" ECU_ADDRESS 0x60012374 /end MEASUREMENT
/begin MEASUREMENT MoCGTM_bbOut1Cpl "complement variable for MoCGTMCo_bbOut1" UBYTE OneToOne 1 100 0.00 255.0 FORMAT "%5.1" ECU_ADDRESS 0x60011CFA /end MEASUREMENT
/begin MEASUREMENT MoCGTM_cmpErrAryIdx "Array index for CMP unit check" UBYTE OneToOne 1 100 0.00 255.0 FORMAT "%5.1" ECU_ADDRESS 0x60012380 /end MEASUREMENT
/begin MEASUREMENT MoCGTM_cmpErrAryIdxCpl "Complement variable for MoCGTM_cmpErrAryIdx" UBYTE OneToOne 1 100 0.00 255.0 FORMAT "%5.1" ECU_ADDRESS 0x60011CF9 /end MEASUREMENT
/begin MEASUREMENT MoCGTM_cntrBadcase "Number of bad cases triggered by MCS" ULONG OneToOne 1 100 0.00 4294967295.00 FORMAT "%13.2" ECU_ADDRESS 0x60012370 /end MEASUREMENT
/begin MEASUREMENT MoCGTM_cntrCMPErrbit "Number of times badcase detected by CMP unit" ULONG OneToOne 1 100 0.00 4294967295.00 FORMAT "%13.2" ECU_ADDRESS 0x6001236C /end MEASUREMENT
/begin MEASUREMENT MoCGTM_cntrCMPErrbitCpl "Complement variable for MoCGTM_CMPErrbitCnt" ULONG OneToOne 1 100 0.00 4294967295.00 FORMAT "%13.2" ECU_ADDRESS 0x60011CF0 /end MEASUREMENT
/begin MEASUREMENT MoCGTM_cntrCMPErrbitHeal "Healing counter for MoCGTM_cntrCMPErrbit" UBYTE OneToOne 1 100 0.00 255.0 FORMAT "%5.1" ECU_ADDRESS 0x6001237F /end MEASUREMENT
/begin MEASUREMENT MoCGTM_cntrCMPErrbitHealCpl "Complement variable for MoCGTM_cntrCMPErrbitHeal" UBYTE OneToOne 1 100 0.00 255.0 FORMAT "%5.1" ECU_ADDRESS 0x60011CF8 /end MEASUREMENT
/begin MEASUREMENT MoCGTM_cntrDebErr "Error Debounce Counter for Pattern Mismatch error" UBYTE OneToOne 1 100 0.00 255.0 FORMAT "%5.1" ECU_ADDRESS 0x6001237E /end MEASUREMENT
/begin MEASUREMENT MoCGTM_cntrDebErrCpl "Complement of the Error Debounce Counter for Pattern Mismatch error" UBYTE OneToOne 1 100 0.00 255.0 FORMAT "%5.1" ECU_ADDRESS 0x60011CF7 /end MEASUREMENT
/begin MEASUREMENT MoCGTM_cntrDebErrMax "Max. deviation between badcase created and detected occurred" UBYTE OneToOne 1 100 0.00 255.0 FORMAT "%5.1" ECU_ADDRESS 0x60011CF6 /end MEASUREMENT
/begin MEASUREMENT MoCGTM_cntrMCS1 "Number of times MCS1 triggered from core" ULONG OneToOne 1 100 0.00 4294967295.00 FORMAT "%13.2" ECU_ADDRESS 0x60012368 /end MEASUREMENT
/begin MEASUREMENT MoCGTM_cntrMCS1Old "previous raster value of Number of times MCS1 triggered from core" ULONG OneToOne 1 100 0.00 4294967295.00 FORMAT "%13.2" ECU_ADDRESS 0x60012364 /end MEASUREMENT
/begin MEASUREMENT MoCGTM_cntrMCS1OldCpl "complement variable for MoCGTM_cntrMCS1Old" ULONG OneToOne 1 100 0.00 4294967295.00 FORMAT "%13.2" ECU_ADDRESS 0x60011CEC /end MEASUREMENT
/begin MEASUREMENT MoCGTM_cntrMCS2 "Number of times MCS2 triggered from core" ULONG OneToOne 1 100 0.00 4294967295.00 FORMAT "%13.2" ECU_ADDRESS 0x60012360 /end MEASUREMENT
/begin MEASUREMENT MoCGTM_cntrMCS2Old "previous raster value of Number of times MCS2 triggered from core" ULONG OneToOne 1 100 0.00 4294967295.00 FORMAT "%13.2" ECU_ADDRESS 0x6001235C /end MEASUREMENT
/begin MEASUREMENT MoCGTM_cntrMCS2OldCpl "complement variable for MoCGTM_cntrMCS2Old" ULONG OneToOne 1 100 0.00 4294967295.00 FORMAT "%13.2" ECU_ADDRESS 0x60011CE8 /end MEASUREMENT
/begin MEASUREMENT MoCGTM_cntrMsmCMPErrBit "Number of mismatch between MoCGTM_aryCMPErrBit and MoCGTM_exptCMPErrBit_CA" UBYTE OneToOne 1 100 0.00 255.0 FORMAT "%5.1" ECU_ADDRESS 0x6001237D /end MEASUREMENT
/begin MEASUREMENT MoCGTM_cntrRouteSigErr "Number of time signal routing error occured in GTM" UBYTE OneToOne 1 100 0.00 255.0 FORMAT "%5.1" ECU_ADDRESS 0x6001237C /end MEASUREMENT
/begin MEASUREMENT MoCGTM_cntrRouteSigErrCpl "Complement variable for MoCGTM_cntrRouteSigErr" UBYTE OneToOne 1 100 0.00 255.0 FORMAT "%5.1" ECU_ADDRESS 0x60011CF5 /end MEASUREMENT
/begin MEASUREMENT MoCGTM_currChksVal "Value of calculated checksum of current MCS module" ULONG OneToOne 1 100 0.00 4294967295.00 FORMAT "%13.2" ECU_ADDRESS 0x60012358 /end MEASUREMENT
/begin MEASUREMENT MoCGTM_currChksValCpl "Complement of value of calculated checksum of current MCS module" ULONG OneToOne 1 100 0.00 4294967295.00 FORMAT "%13.2" ECU_ADDRESS 0x60011CE4 /end MEASUREMENT
/begin MEASUREMENT MoCGTM_currMCSModlAryIdx "Array index for MCS modules used during MCS ROM memory check" UBYTE OneToOne 1 100 0.00 255.0 FORMAT "%5.1" ECU_ADDRESS 0x6001237B /end MEASUREMENT
/begin MEASUREMENT MoCGTM_flgCmpErr "compare error bit status" UBYTE B_TRUE 1 100 0.00 1.00000000000 BIT_MASK 0x1 FORMAT "%13.11" ECU_ADDRESS 0x60012374 /end MEASUREMENT
/begin MEASUREMENT MoCGTM_McsData_ptr1Cpl "Complement for MCS data pointer1" ULONG OneToOne 1 100 0.00 4294967295.00 FORMAT "%13.2" ECU_ADDRESS 0x60011CE0 /end MEASUREMENT
/begin MEASUREMENT MoCGTM_McsData_ptr2Cpl "Complement for MCS data pointer2" ULONG OneToOne 1 100 0.00 4294967295.00 FORMAT "%13.2" ECU_ADDRESS 0x60011CDC /end MEASUREMENT
/begin MEASUREMENT MoCGTM_numMCS1Ch "MCS channel number selected for MCS1" UBYTE OneToOne 1 100 0.00 255.0 FORMAT "%5.1" ECU_ADDRESS 0x6001237A /end MEASUREMENT
/begin MEASUREMENT MoCGTM_numMCS1Modl "MCS module number selected for MCS1" UBYTE OneToOne 1 100 0.00 255.0 FORMAT "%5.1" ECU_ADDRESS 0x60012379 /end MEASUREMENT
/begin MEASUREMENT MoCGTM_numMCS2Ch "MCS channel number selected for MCS2" UBYTE OneToOne 1 100 0.00 255.0 FORMAT "%5.1" ECU_ADDRESS 0x60012378 /end MEASUREMENT
/begin MEASUREMENT MoCGTM_numMCS2Modl "MCS module number selected for MCS2" UBYTE OneToOne 1 100 0.00 255.0 FORMAT "%5.1" ECU_ADDRESS 0x60012377 /end MEASUREMENT
/begin MEASUREMENT MoCGTM_PtlResp "Partial respose of MoCGTM_Co" ULONG OneToOne 1 100 0.00 4294967295.00 FORMAT "%13.2" ECU_ADDRESS 0x60011CCC /end MEASUREMENT
/begin MEASUREMENT MoCGTM_PtlRespCpl "Complement variable for MoCGTM_PtlResp" ULONG OneToOne 1 100 0.00 4294967295.00 FORMAT "%13.2" ECU_ADDRESS 0x60011CD8 /end MEASUREMENT
/begin MEASUREMENT MoCGTM_stBadcaseTrig "Indicates creation of badcase in MCS2" ULONG OneToOne 1 100 0.00 4294967295.00 FORMAT "%13.2" ECU_ADDRESS 0x60012354 /end MEASUREMENT
/begin MEASUREMENT MoCGTM_stErr "Indicates failure in BSW function call" UBYTE OneToOne 1 100 0.00 255.0 FORMAT "%5.1" ECU_ADDRESS 0x60012376 /end MEASUREMENT
/begin MEASUREMENT MoCGTM_stErrChks "Status of checksum error in MCS ROM check" UBYTE OneToOne 1 100 0.00 255.0 FORMAT "%5.1" ECU_ADDRESS 0x60012375 /end MEASUREMENT
/begin MEASUREMENT MoCGTM_stErrCpl "Complement variable for MoCGTM_stErr" UBYTE OneToOne 1 100 0.00 255.0 FORMAT "%5.1" ECU_ADDRESS 0x60011CF4 /end MEASUREMENT
/begin MEASUREMENT MoCGTM_tiCurrMCSVal "Timestamp at which TIM read to be performed after MCS trigger from safety core" ULONG OneToOne 1 100 0.00 4294967295.00 FORMAT "%13.2" ECU_ADDRESS 0x60012350 /end MEASUREMENT
/begin MEASUREMENT MoCGTM_tiCurrTskcall "Time stamp current task call" ULONG OneToOne 1 100 0.00 4294967295.00 FORMAT "%13.2" ECU_ADDRESS 0x60011CD4 /end MEASUREMENT
/begin MEASUREMENT MoCGTM_tiExeMCS1_MP "Measurement of time taken for complete execution of MCS1 in ticks" ULONG RBPtCel_ti_0p4_1 1 100 0.00 1717986918.00 FORMAT "%13.2" ECU_ADDRESS 0x70008634 /end MEASUREMENT
/begin MEASUREMENT MoCGTM_tiExeMCS2_MP "Measurement of time taken for complete execution of MCS2 in ticks" ULONG RBPtCel_ti_0p4_1 1 100 0.00 1717986918.00 FORMAT "%13.2" ECU_ADDRESS 0x70008630 /end MEASUREMENT
/begin MEASUREMENT MoCGTM_tiFallEdgeBadcase_MP "Measurement point for Falling edge time stamp in MCS2 during badcase" ULONG OneToOne 1 100 0.00 4294967295.00 FORMAT "%13.2" ECU_ADDRESS 0x7000862C /end MEASUREMENT
/begin MEASUREMENT MoCGTM_tiFallEdgeMCS1_MP "Measurement point for Falling edge time stamp in MCS1" ULONG OneToOne 1 100 0.00 4294967295.00 FORMAT "%13.2" ECU_ADDRESS 0x70008628 /end MEASUREMENT
/begin MEASUREMENT MoCGTM_tiFallEdgeMCS2_MP "Measurement point for Falling edge time stamp in MCS2" ULONG OneToOne 1 100 0.00 4294967295.00 FORMAT "%13.2" ECU_ADDRESS 0x70008624 /end MEASUREMENT
/begin MEASUREMENT MoCGTM_tiMCSTIMRead "Current rising edge time stamp received from TIM before the control trigger from safety core is passed" ULONG OneToOne 1 100 0.00 4294967295.00 FORMAT "%13.2" ECU_ADDRESS 0x6001234C /end MEASUREMENT
/begin MEASUREMENT MoCGTM_tiPrevMCS1Trig_MP "Measurement point for Timestamp of previous trigger for MCS1 execution from safety core" ULONG OneToOne 1 100 0.00 4294967295.00 FORMAT "%13.2" ECU_ADDRESS 0x70008620 /end MEASUREMENT
/begin MEASUREMENT MoCGTM_tiPrevMCS2Trig_MP "Measurement point for Timestamp of previous trigger for MCS2 execution from safety core" ULONG OneToOne 1 100 0.00 4294967295.00 FORMAT "%13.2" ECU_ADDRESS 0x7000861C /end MEASUREMENT
/begin MEASUREMENT MoCGTM_tiPrevTskcall "Time stamp previous task call" ULONG OneToOne 1 100 0.00 4294967295.00 FORMAT "%13.2" ECU_ADDRESS 0x60011CD0 /end MEASUREMENT
/begin MEASUREMENT MoCGTM_tiRisngEdgeMCS1_MP "Measurement point for Rising edge time stamp in MCS1" ULONG OneToOne 1 100 0.00 4294967295.00 FORMAT "%13.2" ECU_ADDRESS 0x70008618 /end MEASUREMENT
/begin MEASUREMENT MoCGTM_tiRisngEdgeMCS2_MP "Measurement point for Rising edge time stamp in MCS2" ULONG OneToOne 1 100 0.00 4294967295.00 FORMAT "%13.2" ECU_ADDRESS 0x70008614 /end MEASUREMENT
/begin MEASUREMENT MoCGTM_tiTskCalldst_MP "Measurepoint time between two task calls" ULONG OneToOne 1 100 0.00 4294967295.00 FORMAT "%13.2" ECU_ADDRESS 0x70008610 /end MEASUREMENT
/begin MEASUREMENT MoCHwLogicTest_flgAlvTestChk "Standby SMU alivetest check error" UBYTE B_TRUE 1 100 0.00 1.00000000000 BIT_MASK 0x8 FORMAT "%13.11" ECU_ADDRESS 0x600117C4 /end MEASUREMENT
/begin MEASUREMENT MoCHwLogicTest_flgFwChk "Firmware check error" UBYTE B_TRUE 1 100 0.00 1.00000000000 BIT_MASK 0x1 FORMAT "%13.11" ECU_ADDRESS 0x600117C4 /end MEASUREMENT
/begin MEASUREMENT MoCHwLogicTest_flgMONBISTChk "MONBIST error" UBYTE B_TRUE 1 100 0.00 1.00000000000 BIT_MASK 0x2 FORMAT "%13.11" ECU_ADDRESS 0x600117C4 /end MEASUREMENT
/begin MEASUREMENT MoCHwLogicTest_flgSFFDChk "Safety flip-flop test error" UBYTE B_TRUE 1 100 0.00 1.00000000000 BIT_MASK 0x4 FORMAT "%13.11" ECU_ADDRESS 0x600117C4 /end MEASUREMENT
/begin MEASUREMENT MoCHwLogicTest_flgTempChk "Temperature latent fault check error" UBYTE B_TRUE 1 100 0.00 1.00000000000 BIT_MASK 0x10 FORMAT "%13.11" ECU_ADDRESS 0x600117C4 /end MEASUREMENT
/begin MEASUREMENT MoCHwLogicTest_flgUCBErrChk "Safety critical register evaluation check error" UBYTE B_TRUE 1 100 0.00 1.00000000000 BIT_MASK 0x20 FORMAT "%13.11" ECU_ADDRESS 0x600117C4 /end MEASUREMENT
/begin MEASUREMENT MoCHwLogicTest_PtlResp "Partial response from HW Logic Test module" ULONG OneToOne 1 100 0.00 4294967295.00 FORMAT "%13.2" ECU_ADDRESS 0x600117C0 /end MEASUREMENT
/begin MEASUREMENT MoCHwLogicTest_stErr "Status word to report hardware logic test error" UBYTE OneToOne 1 100 0.00 255.0 FORMAT "%5.1" ECU_ADDRESS 0x600117C4 /end MEASUREMENT
/begin MEASUREMENT MoCIWDH_bbLoc1 "Bit bases for storing status of concatenated value read from ring buffer" UBYTE OneToOne 1 100 0.00 255.0 FORMAT "%5.1" ECU_ADDRESS 0x6001234A /end MEASUREMENT
/begin MEASUREMENT MoCIWDH_bbLoc1Cpl "complement variable for MoCIWDH_bbLoc1" UBYTE OneToOne 1 100 0.00 255.0 FORMAT "%5.1" ECU_ADDRESS 0x60011CC8 /end MEASUREMENT
/begin MEASUREMENT MoCIWDH_cntChksAry "Array to hold the Number of entries made into each ring buffer by each task-core combination" UBYTE OneToOne 1 100 0.00 255.0 FORMAT "%5.1" ARRAY_SIZE 1 ECU_ADDRESS 0x60012349 /end MEASUREMENT
/begin MEASUREMENT MoCIWDH_cntrRollgAry "Array to hold the internal watchdog handler rolling counter value" ULONG OneToOne 1 100 0.00 4294967295.00 FORMAT "%13.2" ARRAY_SIZE 1 ECU_ADDRESS 0x60012344 /end MEASUREMENT
/begin MEASUREMENT MoCIWDH_cntrRollgAryCpl "Double storage for Array to hold the internal watchdog handler rolling counter value" ULONG OneToOne 1 100 0.00 4294967295.00 FORMAT "%13.2" ARRAY_SIZE 1 ECU_ADDRESS 0x60011CC4 /end MEASUREMENT
/begin MEASUREMENT MoCIWDH_flgConcatValErr "status of concatenated value read from ring buffer" UBYTE B_TRUE 1 100 0.00 1.00000000000 BIT_MASK 0x1 FORMAT "%13.11" ECU_ADDRESS 0x6001234A /end MEASUREMENT
/begin MEASUREMENT MoCIWDH_numChksAry "Extracted checksum from the concatenated value read from each task-core combination ring buffer" ULONG OneToOne 1 100 0.00 4294967295.00 FORMAT "%13.2" ARRAY_SIZE 1 ECU_ADDRESS 0x60012340 /end MEASUREMENT
/begin MEASUREMENT MoCIWDH_numConcatValAry "Concatenated value of PFC checksum and rolling counter of each task-core combination" ULONG OneToOne 1 100 0.00 4294967295.00 FORMAT "%13.2" ARRAY_SIZE 1 ECU_ADDRESS 0x6001233C /end MEASUREMENT
/begin MEASUREMENT MoCIWDH_PtlResp "Partial response of MoCIWDH_Co" ULONG OneToOne 1 100 0.00 4294967295.00 FORMAT "%13.2" ECU_ADDRESS 0x60011CBC /end MEASUREMENT
/begin MEASUREMENT MoCIWDH_PtlRespCpl "Double storage for Partial response of MoCIWDH_Co" ULONG OneToOne 1 100 0.00 4294967295.00 FORMAT "%13.2" ECU_ADDRESS 0x60011CC0 /end MEASUREMENT
/begin MEASUREMENT MoCIWDH_stErrAry "Status word to report internal watchdog handler errors for each task-core combination" UBYTE OneToOne 1 100 0.00 255.0 FORMAT "%5.1" ARRAY_SIZE 1 ECU_ADDRESS 0x60012348 /end MEASUREMENT
/begin MEASUREMENT MoCMemStrtUp_adrEccErr "Backup of the memory address of the last occured uncorrectable ECC errors" ULONG OneToOne 1 100 0.00 4294967295.00 FORMAT "%13.2" ECU_ADDRESS 0x7003AB94 /end MEASUREMENT
/begin MEASUREMENT MoCMemStrtUp_chkRamTest "Variable to corrupt Ram check in the next startup" UBYTE OneToOne 1 100 0.00 255.0 FORMAT "%5.1" ECU_ADDRESS 0x7003ABA5 /end MEASUREMENT
/begin MEASUREMENT MoCMemStrtUp_chkRomTest "Variable to corrupt Rom check in the next startup" UBYTE OneToOne 1 100 0.00 255.0 FORMAT "%5.1" ECU_ADDRESS 0x7003ABA4 /end MEASUREMENT
/begin MEASUREMENT MoCMemStrtUp_tiRamChk "Variable to store runtime of RAM test during startup" ULONG OneToOne 1 100 0.00 4294967295.00 FORMAT "%13.2" ECU_ADDRESS 0x7003ABA0 /end MEASUREMENT
/begin MEASUREMENT MoCMemStrtUp_tiRomChk "Variable to store runtime of ROM test during startup" ULONG OneToOne 1 100 0.00 4294967295.00 FORMAT "%13.2" ECU_ADDRESS 0x7003AB9C /end MEASUREMENT
/begin MEASUREMENT MoCMemStrtUp_toutWdg "Variable to store timeout of internal watchdog" ULONG OneToOne 1 100 0.00 4294967295.00 FORMAT "%13.2" ECU_ADDRESS 0x7003AB98 /end MEASUREMENT
/begin MEASUREMENT MoCMem_adChkSumBlk "Addresses of checksum blocks configured for cyclic memory check" ULONG dez 1 100 0.00 4294967295.00 FORMAT "%13.2" ARRAY_SIZE 2 ECU_ADDRESS 0x600117B8 /end MEASUREMENT
/begin MEASUREMENT MoCMem_adChkSumBlkCpl "Double storage for MoCMem_adChkSumBlk" ULONG dez 1 100 0.00 4294967295.00 FORMAT "%13.2" ARRAY_SIZE 2 ECU_ADDRESS 0x60011CAC /end MEASUREMENT
/begin MEASUREMENT MoCMem_ctDebErrChkROM "error debounce counter for cyclical ROM-test" UBYTE OneToOne 1 100 0.00 255.0 FORMAT "%5.1" ECU_ADDRESS 0x60012339 /end MEASUREMENT
/begin MEASUREMENT MoCMem_ctDebErrChkROMCpl "complement of the error debounce counter for cyclical ROM-test" UBYTE OneToOne 1 100 0.00 255.0 FORMAT "%5.1" ECU_ADDRESS 0x60011CB8 /end MEASUREMENT
/begin MEASUREMENT MoCMem_ctDebHealChkROM "error healing counter for cyclical ROM-test" UWORD OneToOne 1 100 0.00 65535.00 FORMAT "%8.2" ECU_ADDRESS 0x6001231A /end MEASUREMENT
/begin MEASUREMENT MoCMem_ctDebHealChkROMCpl "complement of the error healing counter for cyclical ROM-test" UWORD OneToOne 1 100 0.00 65535.00 FORMAT "%8.2" ECU_ADDRESS 0x60011C96 /end MEASUREMENT
/begin MEASUREMENT MoCMem_ctLrnROM "Counter for the learn process of the ROM check" UBYTE OneToOne 1 100 0.00 255.0 FORMAT "%5.1" ECU_ADDRESS 0x60012338 /end MEASUREMENT
/begin MEASUREMENT MoCMem_ctLrnROMCpl "Complement of the counter for the learn process of the ROM check" UBYTE OneToOne 1 100 0.00 255.0 FORMAT "%5.1" ECU_ADDRESS 0x60011CB7 /end MEASUREMENT
/begin MEASUREMENT MoCMem_idxCSAry "Array index to point to the desired checksum block" UBYTE OneToOne 1 100 0.00 255.0 FORMAT "%5.1" ECU_ADDRESS 0x60012337 /end MEASUREMENT
/begin MEASUREMENT MoCMem_idxCSAryCpl "Double storage for MoCMem_idxCSAry" UBYTE OneToOne 1 100 0.00 255.0 FORMAT "%5.1" ECU_ADDRESS 0x60011CB6 /end MEASUREMENT
/begin MEASUREMENT MoCMem_nrRomChk "Number of 32-bit memory cells to be tested in cyclical ROM check" UWORD OneToOne 1 100 0.00 65535.00 FORMAT "%8.2" ARRAY_SIZE 4 ECU_ADDRESS 0x60012312 /end MEASUREMENT
/begin MEASUREMENT MoCMem_nrRomChkCpl "Double storage of the number of 32-bit memory cells to be tested in cyclical ROM check" UWORD OneToOne 1 100 0.00 65535.00 FORMAT "%8.2" ARRAY_SIZE 4 ECU_ADDRESS 0x60011C8E /end MEASUREMENT
/begin MEASUREMENT MoCMem_nrRomChkSize "Memory size in Byte that is tested in the cyclic ROM check" ULONG OneToOne 1 100 0.00 4294967295.00 FORMAT "%13.2" ECU_ADDRESS 0x60012330 /end MEASUREMENT
/begin MEASUREMENT MoCMem_numChkSumCurrent "current checksum for cyclical ROM-check" ULONG OneToOne 1 100 0.00 4294967295.00 FORMAT "%13.2" ECU_ADDRESS 0x6001232C /end MEASUREMENT
/begin MEASUREMENT MoCMem_numChkSumCurrentCpl "RAM data redundancy for MoCMem_numChkSumCurrent" ULONG OneToOne 1 100 0.00 4294967295.00 FORMAT "%13.2" ECU_ADDRESS 0x60011CA8 /end MEASUREMENT
/begin MEASUREMENT MoCMem_RomCurrentPtr "pointer with the address for the cyclic checked ROM area which should be checkt at the next cyclic call of the cyclic ROM check" ULONG default 1 100 0.00 4294967295.00 FORMAT "%13.2" ECU_ADDRESS 0x60012328 /end MEASUREMENT
/begin MEASUREMENT MoCMem_RomCurrentPtrCpl "duplicate storage of MoCMem_RomCurrentPtrCpl" ULONG OneToOne 1 100 0.00 4294967295.00 FORMAT "%13.2" ECU_ADDRESS 0x60011CA4 /end MEASUREMENT
/begin MEASUREMENT MoCMem_stDataCycChkBlk "DME support available for data set block" UBYTE OneToOne 1 100 0.00 255.0 FORMAT "%5.1" ARRAY_SIZE 2 ECU_ADDRESS 0x60012335 /end MEASUREMENT
/begin MEASUREMENT MoCMem_stDataCycChkBlkCpl "Double storage of DME support available for data set block" UBYTE OneToOne 1 100 0.00 255.0 FORMAT "%5.1" ARRAY_SIZE 2 ECU_ADDRESS 0x60011CB4 /end MEASUREMENT
/begin MEASUREMENT MoCMem_stDisChk "State of the deactivation of the ROM cyclic test" UBYTE OneToOne 1 100 0.00 255.0 FORMAT "%5.1" ECU_ADDRESS 0x60012334 /end MEASUREMENT
/begin MEASUREMENT MoCMem_tiROMAccus "Sum of the intervals between function calls during the learn process" ULONG OneToOne 1 100 0.00 4294967295.00 FORMAT "%13.2" ECU_ADDRESS 0x60012324 /end MEASUREMENT
/begin MEASUREMENT MoCMem_tiROMAccusCpl "Complement of the sum of the intervals between function calls during the learn process" ULONG OneToOne 1 100 0.00 4294967295.00 FORMAT "%13.2" ECU_ADDRESS 0x60011CA0 /end MEASUREMENT
/begin MEASUREMENT MoCMem_tiROMus "Timestamp of the current call" ULONG OneToOne 1 100 0.00 4294967295.00 FORMAT "%13.2" ECU_ADDRESS 0x60012320 /end MEASUREMENT
/begin MEASUREMENT MoCMem_tiROMusCpl "Complement of the timestamp of the current call" ULONG OneToOne 1 100 0.00 4294967295.00 FORMAT "%13.2" ECU_ADDRESS 0x60011C9C /end MEASUREMENT
/begin MEASUREMENT MoCMem_tiROMusOld "Timestamp of the previous call" ULONG OneToOne 1 100 0.00 4294967295.00 FORMAT "%13.2" ECU_ADDRESS 0x6001231C /end MEASUREMENT
/begin MEASUREMENT MoCMem_tiROMusOldCpl "Complement of the timestamp of the previous call" ULONG OneToOne 1 100 0.00 4294967295.00 FORMAT "%13.2" ECU_ADDRESS 0x60011C98 /end MEASUREMENT
/begin MEASUREMENT MoCPFC_Checksum "Inter result of checksum calculation in the program flow check" ULONG OneToOne 1 100 0.00 4294967295.00 FORMAT "%13.2" ECU_ADDRESS 0x60011C84 /end MEASUREMENT
/begin MEASUREMENT MoCPFC_Checkword "Modul specific signature for building the checksum of the PFC in function monitoring" ULONG OneToOne 1 100 0.00 4294967295.00 FORMAT "%13.2" ECU_ADDRESS 0x60011C88 /end MEASUREMENT
/begin MEASUREMENT MoCPFC_Counter "Module call counter for program flow check in monitoring" UBYTE OneToOne 1 100 0.00 255.0 FORMAT "%5.1" ECU_ADDRESS 0x60011C8C /end MEASUREMENT
/begin MEASUREMENT MoCPFC_PtlResp "Partial response from program flow check to monitoring module" ULONG OneToOne 1 100 0.00 4294967295.00 FORMAT "%13.2" ECU_ADDRESS 0x60011C80 /end MEASUREMENT
/begin MEASUREMENT MoCSCC_stLfastWrkarndActv_MP "State of deactivation of crossbar MPU check for activation of LFAST interface" UBYTE OneToOne 1 100 0.00 255.0 FORMAT "%5.1" ECU_ADDRESS 0x70008A6E /end MEASUREMENT
/begin MEASUREMENT MoCSCC_stMstInstFnd "State of found Master instance" ULONG dez 1 100 0.00 4294967295.00 FORMAT "%13.2" ECU_ADDRESS 0x5000176C /end MEASUREMENT
/begin MEASUREMENT MoCSOP_cntrDebErrPinActv "debounce counter for active error pin during positive and overvoltage test" UBYTE OneToOne 1 100 0.00 255.0 FORMAT "%5.1" ECU_ADDRESS 0x60011C7C /end MEASUREMENT
/begin MEASUREMENT MoCSOP_cntrDebErrPinActvCpl "Complement of debounce counter for active error pin during positive and overvoltage test" UBYTE OneToOne 1 100 0.00 255.0 FORMAT "%5.1" ECU_ADDRESS 0x60011C7B /end MEASUREMENT
/begin MEASUREMENT MoCSOP_cntrDebExtErrPinEveActv "Debounce counter for error in disabling of external error pin event" UBYTE OneToOne 1 100 0.00 255.0 FORMAT "%5.1" ECU_ADDRESS 0x60011C7A /end MEASUREMENT
/begin MEASUREMENT MoCSOP_cntrDebExtErrPinEveActvCpl "Complement of debounce counter for error in disabling of external error pin event" UBYTE OneToOne 1 100 0.00 255.0 FORMAT "%5.1" ECU_ADDRESS 0x60011C79 /end MEASUREMENT
/begin MEASUREMENT MoCSOP_cntrDebExtErrPinEveActv_MP "Measurement Array for debounce counter for error in disabling of external error pin event" UBYTE OneToOne 1 100 0.00 255.0 FORMAT "%5.1" ARRAY_SIZE 25 ECU_ADDRESS 0x70008A55 /end MEASUREMENT
/begin MEASUREMENT MoCSOP_cntrDebSycDrv "Debounce counter for the delay required in reading the injection power stages" UBYTE OneToOne 1 100 0.00 255.0 FORMAT "%5.1" ECU_ADDRESS 0x60011C78 /end MEASUREMENT
/begin MEASUREMENT MoCSOP_cntrDebSycDrvCpl "Double storage of MoCSOP_cntrDebSycDrv" UBYTE OneToOne 1 100 0.00 255.0 FORMAT "%5.1" ECU_ADDRESS 0x60011C77 /end MEASUREMENT
/begin MEASUREMENT MoCSOP_cntrSignalSwtDelay "Counter to debounce the delay required in reading the feedback line status" UBYTE OneToOne 1 100 0.00 255.0 FORMAT "%5.1" ECU_ADDRESS 0x60011C76 /end MEASUREMENT
/begin MEASUREMENT MoCSOP_cntrSignalSwtDelayCpl "Double storage of MoCSOP_cntrSignalSwtDelay" UBYTE OneToOne 1 100 0.00 255.0 FORMAT "%5.1" ECU_ADDRESS 0x60011C75 /end MEASUREMENT
/begin MEASUREMENT MoCSOP_ctBusErr "error counter for communication bus error between FC and other ASICS like power stage ASIC, Monitoring module etc" UBYTE OneToOne 1 100 0.00 255.0 FORMAT "%5.1" ECU_ADDRESS 0x60011C74 /end MEASUREMENT
/begin MEASUREMENT MoCSOP_ctBusErr_MP "Measurement point of error counter for communication bus error between FC and other ASICS like power stage ASIC, Monitoring module etc" UBYTE OneToOne 1 100 0.00 255.0 FORMAT "%5.1" ARRAY_SIZE 25 ECU_ADDRESS 0x70008A3C /end MEASUREMENT
/begin MEASUREMENT MoCSOP_ctCANFrIdx "Index for MoCSOPs measurement point arrays for CANFR test" UBYTE OneToOne 1 100 0.00 255.0 FORMAT "%5.1" ECU_ADDRESS 0x60011C73 /end MEASUREMENT
/begin MEASUREMENT MoCSOP_ctDebCANFrTest "timeout error counter in CAN and FlexRay test" UBYTE OneToOne 1 100 0.00 255.0 FORMAT "%5.1" ECU_ADDRESS 0x60011C72 /end MEASUREMENT
/begin MEASUREMENT MoCSOP_ctDebCANFrTestCpl "complement of the timeout error counter in CAN and FlexRay test" UBYTE OneToOne 1 100 0.00 255.0 FORMAT "%5.1" ECU_ADDRESS 0x60011C71 /end MEASUREMENT
/begin MEASUREMENT MoCSOP_ctDebSOPTst "Number of repetitions of shut-off path test (implementation of a time monitoring)" UWORD OneToOne 1 100 0.00 65535.00 FORMAT "%8.2" ECU_ADDRESS 0x60011C3E /end MEASUREMENT
/begin MEASUREMENT MoCSOP_ctDebSOPTstCpl "Complement copy of MoCSOP_ctDebSOPTst" UWORD OneToOne 1 100 0.00 65535.00 FORMAT "%8.2" ECU_ADDRESS 0x60011C3C /end MEASUREMENT
/begin MEASUREMENT MoCSOP_ctErrMM "Copy of the error counter from the monitoring module in function controller" UBYTE OneToOne 1 100 0.00 255.0 FORMAT "%5.1" ECU_ADDRESS 0x60011C52 /end MEASUREMENT
/begin MEASUREMENT MoCSOP_ctErrMM_mp "Array copy of MoCSOP_ctErrMM in 2,2ms- Raster" UBYTE OneToOne 1 100 0.00 255.0 FORMAT "%5.1" ARRAY_SIZE 25 ECU_ADDRESS 0x70008A23 /end MEASUREMENT
/begin MEASUREMENT MoCSOP_ctErrOSTimeout "error counter handling Alarm Task period" UBYTE OneToOne 1 100 0.00 255.0 FORMAT "%5.1" ECU_ADDRESS 0x60011C70 /end MEASUREMENT
/begin MEASUREMENT MoCSOP_ctIdx "Index for MoCSOPs measurement point arrays (for full measurements without data loss with an INCA 10ms raster, though a 2.2 ms alarm task raster =gt; 5 or 4 entries10ms ). Shows the last written index position." UBYTE OneToOne 1 100 0.00 255.0 FORMAT "%5.1" ECU_ADDRESS 0x60011C6F /end MEASUREMENT
/begin MEASUREMENT MoCSOP_ctRespOffsetTst "Counter used for test purpose in time of response" UWORD OneToOne 1 100 0.00 65535.00 FORMAT "%8.2" ECU_ADDRESS 0x60011C3A /end MEASUREMENT
/begin MEASUREMENT MoCSOP_ctRst "number of resets executed in shut off path test" UBYTE OneToOne 1 100 0.00 255.0 FORMAT "%5.1" ECU_ADDRESS 0x60034763 /end MEASUREMENT
/begin MEASUREMENT MoCSOP_ctRstCANFrTest "No of Resets executed for CANFR test" UBYTE OneToOne 1 100 0.00 255.0 FORMAT "%5.1" ECU_ADDRESS 0x60034762 /end MEASUREMENT
/begin MEASUREMENT MoCSOP_ctRstCANFrTestCpl "complement number of resets executed in CANFR shut off path test" UBYTE OneToOne 1 100 0.00 255.0 FORMAT "%5.1" ECU_ADDRESS 0x60034761 /end MEASUREMENT
/begin MEASUREMENT MoCSOP_ctRstCpl "complement number of resets executed in shut off path test" UBYTE OneToOne 1 100 0.00 255.0 FORMAT "%5.1" ECU_ADDRESS 0x60034760 /end MEASUREMENT
/begin MEASUREMENT MoCSOP_flgErrPinActvd "Flag to indicate if error pin is activated during Error Pin negative test" UBYTE OneToOne 1 100 0.00 255.0 FORMAT "%5.1" ECU_ADDRESS 0x60011C6E /end MEASUREMENT
/begin MEASUREMENT MoCSOP_flgErrPinActvdCpl "Double storage for MoCSOP_flgErrPinActvd" UBYTE OneToOne 1 100 0.00 255.0 FORMAT "%5.1" ECU_ADDRESS 0x60011C6D /end MEASUREMENT
/begin MEASUREMENT MoCSOP_flgReqSOPTest "Flag to indicate that a request to execute shuit off path test is present" UBYTE OneToOne 1 100 0.00 255.0 FORMAT "%5.1" ECU_ADDRESS 0x60012311 /end MEASUREMENT
/begin MEASUREMENT MoCSOP_flgReqSOPTestCpl "Complement of request to execute SOP test variable" UBYTE OneToOne 1 100 0.00 255.0 FORMAT "%5.1" ECU_ADDRESS 0x60011C6C /end MEASUREMENT
/begin MEASUREMENT MoCSOP_flgT15RisngEdge "Flag to detect the T15_st rising edge" UBYTE OneToOne 1 100 0.00 255.0 FORMAT "%5.1" ECU_ADDRESS 0x60012310 /end MEASUREMENT
/begin MEASUREMENT MoCSOP_flgT15RisngEdgeCpl "Complement of T15 rising edge variable" UBYTE OneToOne 1 100 0.00 255.0 FORMAT "%5.1" ECU_ADDRESS 0x60011C6B /end MEASUREMENT
/begin MEASUREMENT MoCSOP_st "status of the shut-down path test" UWORD OneToOne 1 100 0.00 65535.00 FORMAT "%8.2" ECU_ADDRESS 0x60034758 /end MEASUREMENT
/begin MEASUREMENT MoCSOP_stActMsg "copy of the status variable for synchronizing shut off path test and query-/response communication" UBYTE dez 1 100 0.00 255.0 FORMAT "%5.1" ECU_ADDRESS 0x600007A3 /end MEASUREMENT
/begin MEASUREMENT MoCSOP_stActvMsg "Information for level 1, 2: Shut-off path test is on or WDA-line is active (injections disabled)" UBYTE dez 1 100 0.00 255.0 FORMAT "%5.1" ECU_ADDRESS 0x600007A4 /end MEASUREMENT
/begin MEASUREMENT MoCSOP_stBusErr "status variable for communication bus error between FC and other ASICS like power stage ASIC, Monitoring module etc" UWORD OneToOne 1 100 0.00 65535.00 FORMAT "%8.2" ECU_ADDRESS 0x60011C38 /end MEASUREMENT
/begin MEASUREMENT MoCSOP_stBusErr_MP "Measurement point for status variable for communication bus error between FC and other ASICS like power stage ASIC, Monitoring module etc" UWORD OneToOne 1 100 0.00 65535.00 FORMAT "%8.2" ARRAY_SIZE 25 ECU_ADDRESS 0x700087CC /end MEASUREMENT
/begin MEASUREMENT MoCSOP_stCANFrTest "CANFR test status" UBYTE OneToOne 1 100 0.00 255.0 FORMAT "%5.1" ECU_ADDRESS 0x60011C51 /end MEASUREMENT
/begin MEASUREMENT MoCSOP_stCANFrTestCpl "Complement of status of CANFR test status" UBYTE OneToOne 1 100 0.00 255.0 FORMAT "%5.1" ECU_ADDRESS 0x60011C6A /end MEASUREMENT
/begin MEASUREMENT MoCSOP_stCANFrTestErr "Error status of CANFR test" UBYTE OneToOne 1 100 0.00 255.0 FORMAT "%5.1" ECU_ADDRESS 0x60011C69 /end MEASUREMENT
/begin MEASUREMENT MoCSOP_stCANFrTestErrReas "Reason for CAN-FR shut off path test failure" UBYTE OneToOne 1 100 0.00 255.0 FORMAT "%5.1" ECU_ADDRESS 0x6003475F /end MEASUREMENT
/begin MEASUREMENT MoCSOP_stCANFrTestErrReasCpl "Complement of reason for CAN-FR shut off path test failure" UBYTE OneToOne 1 100 0.00 255.0 FORMAT "%5.1" ECU_ADDRESS 0x6003475E /end MEASUREMENT
/begin MEASUREMENT MoCSOP_stCANFrTestState "status of state machine check CANFR test" UBYTE OneToOne 1 100 0.00 255.0 FORMAT "%5.1" ECU_ADDRESS 0x60011C68 /end MEASUREMENT
/begin MEASUREMENT MoCSOP_stCANFrTestStateCpl "Complement of MoCSOP_stCANFrTestState" UBYTE OneToOne 1 100 0.00 255.0 FORMAT "%5.1" ECU_ADDRESS 0x60011C67 /end MEASUREMENT
/begin MEASUREMENT MoCSOP_stCanTdi "Status bit for activation or deactivation of the CAN_TDI shut off path during an active WDA line" UBYTE B_TRUE 1 100 0.00 1.00000000000 BIT_MASK 0x1 FORMAT "%13.11" ECU_ADDRESS 0x60011C66 /end MEASUREMENT
/begin MEASUREMENT MoCSOP_stCANTestState_mp "measurement-array for displaying the actual state of the state machine during the CAN test" UBYTE MoCSOP_stCANFrTestState_mp_Compu 1 100 0.00 12.0000000000 FORMAT "%13.10" ARRAY_SIZE 12 ECU_ADDRESS 0x70008A17 /end MEASUREMENT
/begin MEASUREMENT MoCSOP_stCheckState "status state machine check power stages" UBYTE MoCSOP_stCheckStateCY329_mp_Compu 1 100 0.00 18.0000000000 FORMAT "%13.10" ECU_ADDRESS 0x60011C65 /end MEASUREMENT
/begin MEASUREMENT MoCSOP_stCheckStateCpl "Complement of MoCSOP_stCheckState" UBYTE OneToOne 1 100 0.00 255.0 FORMAT "%5.1" ECU_ADDRESS 0x60011C64 /end MEASUREMENT
/begin MEASUREMENT MoCSOP_stCheckState_mp "State variable indicates which MoCSOP step is executed" UBYTE MoCSOP_stCheckStateCY329_mp_Compu 1 100 0.00 18.0000000000 FORMAT "%13.10" ARRAY_SIZE 25 ECU_ADDRESS 0x700089FE /end MEASUREMENT
/begin MEASUREMENT MoCSOP_stComActv "status for communication from MoCCOM active" UBYTE OneToOne 1 100 0.00 255.0 FORMAT "%5.1" ECU_ADDRESS 0x60011C50 /end MEASUREMENT
/begin MEASUREMENT MoCSOP_stComActvCpl "RAM data redundancy for MoCSOP_stComActv" UBYTE OneToOne 1 100 0.00 255.0 FORMAT "%5.1" ECU_ADDRESS 0x60011C4F /end MEASUREMENT
/begin MEASUREMENT MoCSOP_stComTrcvOld "Array to hold the STB pin status of the transceivers before the Com shut off path test" ULONG OneToOne 1 100 0.00 4294967295.00 FORMAT "%13.2" ARRAY_SIZE 3 ECU_ADDRESS 0x60011C40 /end MEASUREMENT
/begin MEASUREMENT MoCSOP_stCpl "RAM data redundancy for MoCSOP_st" UWORD OneToOne 1 100 0.00 65535.00 FORMAT "%8.2" ECU_ADDRESS 0x6003475A /end MEASUREMENT
/begin MEASUREMENT MoCSOP_stDia "diagnose status of the shut-down path test" UBYTE OneToOne 1 100 0.00 255.0 FORMAT "%5.1" ECU_ADDRESS 0x60011C63 /end MEASUREMENT
/begin MEASUREMENT MoCSOP_stDiaCpl "RAM data redundancy for MoCSOP_stDia" UBYTE OneToOne 1 100 0.00 255.0 FORMAT "%5.1" ECU_ADDRESS 0x60011C62 /end MEASUREMENT
/begin MEASUREMENT MoCSOP_stDiaERPN "diagnose status of the CY329 specific shut off path tests" UBYTE OneToOne 1 100 0.00 255.0 FORMAT "%5.1" ECU_ADDRESS 0x60011C61 /end MEASUREMENT
/begin MEASUREMENT MoCSOP_stDiaERPNCpl "Complement for diagnose status of the CY329 specific shut off path tests" UBYTE OneToOne 1 100 0.00 255.0 FORMAT "%5.1" ECU_ADDRESS 0x60011C60 /end MEASUREMENT
/begin MEASUREMENT MoCSOP_stEmmState_MP "Measurement Array for EMM state" UBYTE MoCSOP_stEmmStateIFX_MP_Compu 1 100 0.00 32.0000000000 FORMAT "%13.10" ARRAY_SIZE 25 ECU_ADDRESS 0x700089E5 /end MEASUREMENT
/begin MEASUREMENT MoCSOP_stErr "contains the state of the communication via SPI-subsystem to the monitoring module" UBYTE OneToOne 1 100 0.00 255.0 FORMAT "%5.1" ECU_ADDRESS 0x60011C5F /end MEASUREMENT
/begin MEASUREMENT MoCSOP_stErrPinActvnReq "Status for the activation of the error pin in the FlexRay or CAN test, if the WDA line was not active during the test." UBYTE OneToOne 1 100 0.00 255.0 FORMAT "%5.1" ECU_ADDRESS 0x60011C5E /end MEASUREMENT
/begin MEASUREMENT MoCSOP_stErrPin_MP "Measurement point with the actual error pin status" UBYTE MoCSOP_stErrPin_MP_Compu 1 100 0.00 1.00000000000 FORMAT "%13.11" ARRAY_SIZE 25 ECU_ADDRESS 0x700089CC /end MEASUREMENT
/begin MEASUREMENT MoCSOP_stErrReactn "Status which error reaction type will be executed" UBYTE OneToOne 1 100 0.00 255.0 FORMAT "%5.1" ECU_ADDRESS 0x60011C5D /end MEASUREMENT
/begin MEASUREMENT MoCSOP_stErrReactnERPN "Status to indicate which error reaction type will be triggered for CY329 specific shut off path tests" UBYTE OneToOne 1 100 0.00 255.0 FORMAT "%5.1" ECU_ADDRESS 0x60011C5C /end MEASUREMENT
/begin MEASUREMENT MoCSOP_stInhbStrtCdn "Status to start shut-off path test interupted due to inhibit line active condition" UBYTE OneToOne 1 100 0.00 255.0 FORMAT "%5.1" ECU_ADDRESS 0x6001230F /end MEASUREMENT
/begin MEASUREMENT MoCSOP_stOvl "Status variable for CJ945 overvoltage detection latch" UBYTE dez 1 100 0.00 255.0 FORMAT "%5.1" ECU_ADDRESS 0x600007A6 /end MEASUREMENT
/begin MEASUREMENT MoCSOP_stOvlCpl "Double storage of the status variable for CJ945 overvoltage detection latch" UBYTE dez 1 100 0.00 255.0 FORMAT "%5.1" ECU_ADDRESS 0x600007A7 /end MEASUREMENT
/begin MEASUREMENT MoCSOP_stOVTstStatusEval "Overvoltage test evaluation status" UBYTE OneToOne 1 100 0.00 255.0 FORMAT "%5.1" ECU_ADDRESS 0x60011C5B /end MEASUREMENT
/begin MEASUREMENT MoCSOP_stOVTstStatusEvalCpl "Complement variable for overvoltage test evaluation status" UBYTE OneToOne 1 100 0.00 255.0 FORMAT "%5.1" ECU_ADDRESS 0x60011C5A /end MEASUREMENT
/begin MEASUREMENT MoCSOP_stPVMTUnderTest "PVMT signal which is under test during overvoltage test" UBYTE OneToOne 1 100 0.00 255.0 FORMAT "%5.1" ECU_ADDRESS 0x60011C59 /end MEASUREMENT
/begin MEASUREMENT MoCSOP_stRdy "Status variable for synchronisation from shut-off path test and query/response communication (test is done completely)" UBYTE OneToOne 1 100 0.00 255.0 FORMAT "%5.1" ECU_ADDRESS 0x6003475D /end MEASUREMENT
/begin MEASUREMENT MoCSOP_stRdyCan "indicates that the CAN test was executed" UBYTE OneToOne 1 100 0.00 255.0 FORMAT "%5.1" ECU_ADDRESS 0x60011C4E /end MEASUREMENT
/begin MEASUREMENT MoCSOP_stRdyCanCpl "Complement of MoCSOP_stRdyCan" UBYTE OneToOne 1 100 0.00 255.0 FORMAT "%5.1" ECU_ADDRESS 0x60011C58 /end MEASUREMENT
/begin MEASUREMENT MoCSOP_stRdyCpl "Double storage for status variable for synchronisation from shut-off path test and query/response communication" UBYTE OneToOne 1 100 0.00 255.0 FORMAT "%5.1" ECU_ADDRESS 0x6003475C /end MEASUREMENT
/begin MEASUREMENT MoCSOP_stRdyFr "Indicates whether the FlexRay test was executed" UBYTE OneToOne 1 100 0.00 255.0 FORMAT "%5.1" ECU_ADDRESS 0x60011C4D /end MEASUREMENT
/begin MEASUREMENT MoCSOP_stRdyFrCpl "Complement of MoCSOP_stRdyFr" UBYTE OneToOne 1 100 0.00 255.0 FORMAT "%5.1" ECU_ADDRESS 0x60011C57 /end MEASUREMENT
/begin MEASUREMENT MoCSOP_stRdyInj "Indicates that the Injection control lines test was executed" UBYTE OneToOne 1 100 0.00 255.0 FORMAT "%5.1" ECU_ADDRESS 0x60011C4C /end MEASUREMENT
/begin MEASUREMENT MoCSOP_stRdyInjCpl "Complement of MoCSOP_stRdyInj" UBYTE OneToOne 1 100 0.00 255.0 FORMAT "%5.1" ECU_ADDRESS 0x60011C56 /end MEASUREMENT
/begin MEASUREMENT MoCSOP_stRdyMsg "information for level 1,2 about status of synchronizing shut off path test and query-/resonse-communication" UBYTE OneToOne 1 100 0.00 255.0 FORMAT "%5.1" ECU_ADDRESS 0x6000A6F3 /end MEASUREMENT
/begin MEASUREMENT MoCSOP_stReqPSStatus "Status of request power stage function" UBYTE OneToOne 1 100 0.00 255.0 FORMAT "%5.1" ECU_ADDRESS 0x60011C55 /end MEASUREMENT
/begin MEASUREMENT MoCSOP_stReqPSStatusBusErr "Status of bus error in request powerstage status function" UBYTE OneToOne 1 100 0.00 255.0 FORMAT "%5.1" ECU_ADDRESS 0x60011C54 /end MEASUREMENT
/begin MEASUREMENT MoCSOP_stT15Old "Variable to update the T15_st status" UBYTE OneToOne 1 100 0.00 255.0 FORMAT "%5.1" ECU_ADDRESS 0x6001230E /end MEASUREMENT
/begin MEASUREMENT MoCSOP_stT15OldCpl "Complement of MoCSOP_stT15Old" UBYTE OneToOne 1 100 0.00 255.0 FORMAT "%5.1" ECU_ADDRESS 0x60011C53 /end MEASUREMENT
/begin MEASUREMENT MoCSOP_tiCanTest_MP "Actual time which was needed for the execution of the CAN test itself" ULONG MoCSOP_Time_us 1 100 0.00 4294967295.00 FORMAT "%13.2" ECU_ADDRESS 0x7000860C /end MEASUREMENT
/begin MEASUREMENT MoExe_ctCyc "10 ms counter to generate scheduling for monitoring" UBYTE OneToOne 1 100 0.00 255.0 FORMAT "%5.1" ECU_ADDRESS 0x6001230D /end MEASUREMENT
/begin MEASUREMENT MoExe_ctCycCpl "Complement variable for MoExe_ctCyc" UBYTE OneToOne 1 100 0.00 255.0 FORMAT "%5.1" ECU_ADDRESS 0x60011C15 /end MEASUREMENT
/begin MEASUREMENT MoFACCCo_bbOutCpl "duplicate storage for MoFACCCo_bbOut" UBYTE OneToOne 1 100 0.00 255.0 FORMAT "%5.1" ECU_ADDRESS 0x60011C14 /end MEASUREMENT
/begin MEASUREMENT MoFACC_flgPtd "condition ACC permitted in the function monitoring" UBYTE B_TRUE 1 100 0.00 1.00000000000 BIT_MASK 0x1 FORMAT "%13.11" ECU_ADDRESS 0x6001230C /end MEASUREMENT
/begin MEASUREMENT MoFAirFlCtOffPfi_flgClr "Condition clear FCM in function MoFAirFl_CtOffPfi" UBYTE B_TRUE 1 100 0.00 1.00000000000 BIT_MASK 0x1 FORMAT "%13.11" ECU_ADDRESS 0x70000189 /end MEASUREMENT
/begin MEASUREMENT MoFAirFlCylPfi_flgClr "Condition clear FCM in function MoFAirFl_CylPfi" UBYTE B_TRUE 1 100 0.00 1.00000000000 BIT_MASK 0x1 FORMAT "%13.11" ECU_ADDRESS 0x70000188 /end MEASUREMENT
/begin MEASUREMENT MoFAirFlEta_nEng_Ax_result "Supporting coordinate for engine speed during function monitoring" SLONG dez 1 100 -2147483648.00 2147483647.00 FORMAT "%13.2" ECU_ADDRESS 0x60012300 /end MEASUREMENT
/begin MEASUREMENT MoFAirFlEta_ratFillg_Ax_result "Result of grid search for air charge in function monitoring" SLONG dez 1 100 -2147483648.00 2147483647.00 FORMAT "%13.2" ECU_ADDRESS 0x600122FC /end MEASUREMENT
/begin MEASUREMENT MoFAirFl_cntrAfimActvPfi "Counter for AFIM activation time in function monitoring (PFI)" UWORD OneToOne 1 100 0.00 65535.00 FORMAT "%8.2" ECU_ADDRESS 0x60012306 /end MEASUREMENT
/begin MEASUREMENT MoFAirFl_cntrAfimActvPfiCpl "Ram data redundancy for MoFAirFl_cntrAfimActvPfi" UWORD OneToOne 1 100 0.00 65535.00 FORMAT "%8.2" ECU_ADDRESS 0x60011C0E /end MEASUREMENT
/begin MEASUREMENT MoFAirFl_cntrDiagDebCtOffPfi "Diagnosis counter in function MoFAirFl_CtOffPfi" UBYTE OneToOne 1 100 0.00 255.0 FORMAT "%5.1" ECU_ADDRESS 0x6000638F /end MEASUREMENT
/begin MEASUREMENT MoFAirFl_cntrDiagDebCylPfi "Diagnosis counter in function MoFAirFl_CylPfi" UBYTE OneToOne 1 100 0.00 255.0 FORMAT "%5.1" ECU_ADDRESS 0x6000638E /end MEASUREMENT
/begin MEASUREMENT MoFAirFl_cntrErrDebCtOffPfi "Error debounce counter in function MoFAirFl_CtOffPfi" UBYTE OneToOne 1 100 0.00 255.0 FORMAT "%5.1" ECU_ADDRESS 0x6001230B /end MEASUREMENT
/begin MEASUREMENT MoFAirFl_cntrErrDebCtOffPfiCpl "Ram data redundancy for MoFAirFl_cntrErrDebCtOffPfi" UBYTE OneToOne 1 100 0.00 255.0 FORMAT "%5.1" ECU_ADDRESS 0x60011C12 /end MEASUREMENT
/begin MEASUREMENT MoFAirFl_cntrErrDebCylPfi "Error debounce counter in function MoFAirFl_CylPfi" UBYTE OneToOne 1 100 0.00 255.0 FORMAT "%5.1" ECU_ADDRESS 0x60012308 /end MEASUREMENT
/begin MEASUREMENT MoFAirFl_cntrErrDebCylPfiCpl "Ram data redundancy for MoFAirFl_cntrErrDebCylPfi" UBYTE OneToOne 1 100 0.00 255.0 FORMAT "%5.1" ECU_ADDRESS 0x60011C10 /end MEASUREMENT
/begin MEASUREMENT MoFAirFl_etaIA "Ignition angle efficiency in function monitoring" UWORD fak_uw_b2 1 100 0.00 1.999969 FORMAT "%8.6" ECU_ADDRESS 0x600122EE /end MEASUREMENT
/begin MEASUREMENT MoFAirFl_etaIACpl "Ram data redundancy for MoFAirFl_etaIA" UWORD OneToOne 1 100 0.00 65535.00 FORMAT "%8.2" ECU_ADDRESS 0x60011C0A /end MEASUREMENT
/begin MEASUREMENT MoFAirFl_etaInjCtOff "Injection cut-off efficiency in function monitoring" UWORD fak_uw_b2 1 100 0.00 1.999969 FORMAT "%8.6" ECU_ADDRESS 0x600122EC /end MEASUREMENT
/begin MEASUREMENT MoFAirFl_etaInjCtOffCpl "Ram data redundancy for MoFAirFl_etaInjCtOff" UWORD OneToOne 1 100 0.00 65535.00 FORMAT "%8.2" ECU_ADDRESS 0x60011C08 /end MEASUREMENT
/begin MEASUREMENT MoFAirFl_etaInjSplt "Injection split efficiency in function monitoring" UWORD fak_uw_b2 1 100 0.00 1.999969 FORMAT "%8.6" ECU_ADDRESS 0x600122EA /end MEASUREMENT
/begin MEASUREMENT MoFAirFl_etaInjSpltCpl "Ram data redundancy for MoFAirFl_etaInjSplt" UWORD OneToOne 1 100 0.00 65535.00 FORMAT "%8.2" ECU_ADDRESS 0x60011C06 /end MEASUREMENT
/begin MEASUREMENT MoFAirFl_etaLam "Lambda efficiency in function monitoring" UWORD fak_uw_b2 1 100 0.00 1.999969 FORMAT "%8.6" ECU_ADDRESS 0x600122E8 /end MEASUREMENT
/begin MEASUREMENT MoFAirFl_etaLamCpl "Ram data redundancy for MoFAirFl_etaLam" UWORD OneToOne 1 100 0.00 65535.00 FORMAT "%8.2" ECU_ADDRESS 0x60011C04 /end MEASUREMENT
/begin MEASUREMENT MoFAirFl_flgIrrvErrCtOffPfiMsg "Irreversible error bit in function MoFAirFl_CtOffPfi" UBYTE B_TRUE 1 100 0.00 1.00000000000 BIT_MASK 0x1 FORMAT "%13.11" ECU_ADDRESS 0x700006D9 /end MEASUREMENT
/begin MEASUREMENT MoFAirFl_flgIrrvErrCylPfiMsg "Irreversible error bit in function MoFAirFl_CylPfi" UBYTE B_TRUE 1 100 0.00 1.00000000000 BIT_MASK 0x1 FORMAT "%13.11" ECU_ADDRESS 0x700006D8 /end MEASUREMENT
/begin MEASUREMENT MoFAirFl_flgTestCtOffPfiMsg "Bit test conditions for diagnosis in function MoFAirFl_CtOffPfi" UBYTE B_TRUE 1 100 0.00 1.00000000000 BIT_MASK 0x1 FORMAT "%13.11" ECU_ADDRESS 0x700006D2 /end MEASUREMENT
/begin MEASUREMENT MoFAirFl_flgTestCylPfiMsg "Bit test conditions for diagnosis in function MoFAirFl_CylPfi" UBYTE B_TRUE 1 100 0.00 1.00000000000 BIT_MASK 0x1 FORMAT "%13.11" ECU_ADDRESS 0x700006D1 /end MEASUREMENT
/begin MEASUREMENT MoFAirFl_iaDelta "Delta ignition angle in function monitoring" UBYTE zw_ub_q0p75 1 100 0.00 191.3 FORMAT "%5.1" ECU_ADDRESS 0x60012305 /end MEASUREMENT
/begin MEASUREMENT MoFAirFl_iaDeltaCpl "RAM data redundancy for MoFAirFl_iaDelta" UBYTE OneToOne 1 100 0.00 255.0 FORMAT "%5.1" ECU_ADDRESS 0x60011C0C /end MEASUREMENT
/begin MEASUREMENT MoFAirFl_iaDelta_Ax_result "Result of grid search for delta ignition angle in function monitoring" SLONG dez 1 100 -2147483648.00 2147483647.00 FORMAT "%13.2" ECU_ADDRESS 0x600122F8 /end MEASUREMENT
/begin MEASUREMENT MoFAirFl_ratLamSp "Desired lambda in function monitoring" UWORD fak_uw_b16 1 100 0.00 15.99976 FORMAT "%8.5" ECU_ADDRESS 0x600122F0 /end MEASUREMENT
/begin MEASUREMENT MoFAirFl_ratLamSpCpl "RAM data redundancy for MoFAirFl_ratLamSp" UWORD OneToOne 1 100 0.00 65535.00 FORMAT "%8.2" ECU_ADDRESS 0x60011C02 /end MEASUREMENT
/begin MEASUREMENT MoFAirFl_ratLamSp_Ax_result "Result of grid search for lambda in function monitoring" SLONG dez 1 100 -2147483648.00 2147483647.00 FORMAT "%13.2" ECU_ADDRESS 0x600122F4 /end MEASUREMENT
/begin MEASUREMENT MoFAirFl_stCtOffMask "Injection cut-off mask in function monitoring" UBYTE OneToOne 1 100 0.00 255.0 FORMAT "%5.1" ECU_ADDRESS 0x60012309 /end MEASUREMENT
/begin MEASUREMENT MoFAirFl_stCtOffMaskCpl "RAM data redundancy for MoFAirFl_stCtOffMask" UBYTE OneToOne 1 100 0.00 255.0 FORMAT "%5.1" ECU_ADDRESS 0x60011C11 /end MEASUREMENT
/begin MEASUREMENT MoFAirFl_stErrCtOffPfiMsg "State error information from MoFAirFl_CtOffPfi (exported)" UBYTE OneToOne 1 100 0.00 255.0 FORMAT "%5.1" ECU_ADDRESS 0x6000A338 /end MEASUREMENT
/begin MEASUREMENT MoFAirFl_stErrCtOffPfi_MP "State error information from MoFAirFl_CtOffPfi" UBYTE OneToOne 1 100 0.00 255.0 FORMAT "%5.1" ECU_ADDRESS 0x70008C29 /end MEASUREMENT
/begin MEASUREMENT MoFAirFl_stErrCylPfiMsg "State error information from MoFAirFl_CylPfi (exported)" UBYTE OneToOne 1 100 0.00 255.0 FORMAT "%5.1" ECU_ADDRESS 0x6000A337 /end MEASUREMENT
/begin MEASUREMENT MoFAirFl_stErrCylPfi_MP "State error information from MoFAirFl_CylPfi" UBYTE OneToOne 1 100 0.00 255.0 FORMAT "%5.1" ECU_ADDRESS 0x70008C28 /end MEASUREMENT
/begin MEASUREMENT Mo_flgIrrvErrNTPMsg "Irreversible error bit of ADC implemented as message - Null Load TestPulse check" UBYTE B_TRUE 1 100 0.00 1.00000000000 BIT_MASK 0x1 FORMAT "%13.11" ECU_ADDRESS 0x6000A79F /end MEASUREMENT
/begin MEASUREMENT Mo_flgIrrvErrSOPMsg "Irreversible error bit of shut-off path test" UBYTE B_TRUE 1 100 0.00 1.00000000000 BIT_MASK 0x1 FORMAT "%13.11" ECU_ADDRESS 0x6000A79E /end MEASUREMENT
/begin MEASUREMENT Mo_flgIrrvErrTstMsg "Irreversible error bit of ADC implemented as message - Testvoltage check" UBYTE B_TRUE 1 100 0.00 1.00000000000 BIT_MASK 0x1 FORMAT "%13.11" ECU_ADDRESS 0x6000A79D /end MEASUREMENT
/begin FUNCTION MisfDet_StcCat "1.28.0    Misfire statistic for detection of catalyst damaging misfire and cylinder deactivation"
 /begin DEF_CHARACTERISTIC MisfDet_facCritScav_C MisfDet_stcCatDmgCritScavIntlCntrMax_C MisfDet_stcCatDmgDebIntlNr_C MisfDet_stcCatDmgDebNMax_C MisfDet_stcCatDmgDebTqMax_T MisfDet_stcCatExtFirstIntlFac_C MisfDet_stcCatExtFirstIntlT_C MisfDet_stcCatRatMinCylIdn_C MisfDet_stcCatRatMinMpl_C MisfDet_stcCatThdStrt_CA MisfDet_stcCatThd_CA MisfDet_stcCatWghtFacCritScav_M MisfDet_stcCatWghtFacPfiMax_C MisfDet_stcCatWghtFac_M MisfDet_stStcCatCfg_C MisfDet_tiDebCatHealCritScav_C /end DEF_CHARACTERISTIC
 /begin REF_CHARACTERISTIC MisfDet_stCfgOBD_C /end REF_CHARACTERISTIC
 /begin IN_MEASUREMENT Epm_nEng flamlu_w_msg MisfDet_cylCntr MisfDet_nEngSync MisfDet_nrCylMisfNoId MisfDet_stBlkStc MisfDet_stCntMisf MisfDet_stFcmClr MisfDet_stFcmClr100ms MisfDet_stFcmClr200ms MisfDet_stFltPrevDcyc MisfDet_stInjLockdOpen MisfDet_stNoInjSync MisfDet_stReIni MisfDet_stReIni100ms MisfDet_stReIni200ms MisfDet_stSimrCdn MisfDet_tEngStrt MisfDet_tqBasc MisfDet_tqBascSync SyC_stSub /end IN_MEASUREMENT
 /begin OUT_MEASUREMENT MisfDet_maskStcCatFltCylIdn MisfDet_maskStcCatFltMpl MisfDet_stCatDmg MisfDet_stCatDmgBnk MisfDet_stCatDmgCurrIntl MisfDet_stCatDmgLstIntl MisfDet_stcCatIgnCntr MisfDet_stcCatIntlLen MisfDet_stcCatMisfCntrBnk MisfDet_stcCatMisfCntrCyl MisfDet_stcCatMisfCntrSumNotWght MisfDet_stcCatThd MisfDet_stcCatWghtFac MisfDet_stStcCatIntlHealSimrCdn MisfDet_stStcCatStrt /end OUT_MEASUREMENT
 /begin LOC_MEASUREMENT MisfDet_stCatDmgBnkCurrIntl MisfDet_stCatDmgCritScav MisfDet_stCatDmgCritScavCurr MisfDet_stCatDmgDebd MisfDet_stCatDmgDebMisfOutdRng MisfDet_stCatDmgDebOutOfRng MisfDet_stCatFltMpl MisfDet_stCatIntlCritScav MisfDet_StcCatCntrSimrCdn.misfBnk MisfDet_StcCatCntrSimrCdn.ign MisfDet_stcCatDmgCritScavIntlCntr MisfDet_stcCatDmgDebIntlCntr MisfDet_stcCatDmgNrCyl MisfDet_stcCatIntlLenMaxSimrCdn MisfDet_stcCatMisfCntrBnkCritScav MisfDet_stcCatThdMaxSimrCdn MisfDet_stcCatWghtFacCritScav MisfDet_stStcCatRstCompl200ms MisfDet_tiDebCatHealCritScav /end LOC_MEASUREMENT
 FUNCTION_VERSION "1.28.0" /end FUNCTION
/begin FUNCTION MisfDet_StcExh "1.25.0    Misfire statistic for detection of exhaust limit exceedance"
 /begin DEF_CHARACTERISTIC MisfDet_stcEmiNrIntl_C MisfDet_stcEmiRatMinCylIdn_C MisfDet_stcEmiRatMinMpl_C MisfDet_stcEmiThdStrtCatHeat_C MisfDet_stcEmiThdStrt_C MisfDet_stcEmiThd_C /end DEF_CHARACTERISTIC
 /begin REF_CHARACTERISTIC MisfDet_stCfgOBD_C /end REF_CHARACTERISTIC
 /begin IN_MEASUREMENT MisfDet_cylCntr MisfDet_nrCylMisfNoId MisfDet_stBlkStc MisfDet_stCatHeat MisfDet_stCntMisf MisfDet_stFcmClr MisfDet_stFltPrevDcyc MisfDet_stNoInjSync MisfDet_stReIni MisfDet_stSimrCdn /end IN_MEASUREMENT
 /begin OUT_MEASUREMENT MisfDet_maskStcEmiFltCylIdn MisfDet_maskStcEmiFltMpl MisfDet_stcEmiIgnCntr MisfDet_stcEmiIntlCntr MisfDet_stcEmiIntlDmgCntr MisfDet_stcEmiMisfCntrCyl MisfDet_stcEmiMisfCntrSum MisfDet_stcEmiThd MisfDet_stEmiDmgCurrIntl MisfDet_stStcEmiDmgLstIntl MisfDet_stStcEmiIntlHealSimrCdn MisfDet_stStcEmiIntlHealSimrCdnStrt MisfDet_stStcEmiStrt MisfDet_stStcEmiStrtSrv /end OUT_MEASUREMENT
 /begin LOC_MEASUREMENT MisfDet_stcEmiStructCntr.misfSum MisfDet_stcEmiStructCntr.misfCyl MisfDet_stcEmiStructCntr.ign MisfDet_stcEmiStructCntr.intl MisfDet_stcEmiStructCntr.dmgIntl MisfDet_stcEmiStructCntr.stCylDmgCylIdn MisfDet_stcEmiStructCntr.stCylDmgMtpl MisfDet_stcEmiStructSimrCdn.misfSum MisfDet_stcEmiStructSimrCdn.ign MisfDet_stcEmiStructSimrCdn.intl MisfDet_stcEmiStructSimrCdn.dmgIntl MisfDet_stcEmiStructSimrCdnStrt.misfSum MisfDet_stcEmiStructSimrCdnStrt.ign MisfDet_stcEmiStructSimrCdnStrt.intl MisfDet_stcEmiStructSimrCdnStrt.dmgIntl MisfDet_stEmiFltMpl MisfDet_stStcEmiFrzFrm MisfDet_stStcEmiStrtCatHeat /end LOC_MEASUREMENT
 FUNCTION_VERSION "1.25.0" /end FUNCTION
/begin FUNCTION MisfDet_StcFco "1.17.0    Misfire statistic for cylinder individual fuel cut off in case of catalyst damaging misfire rate"
 /begin DEF_CHARACTERISTIC MisfDet_stcCatDmgFcoNrCylBnkMax_CA MisfDet_stcCatDmgFcoNrIntlMin_T MisfDet_stcCatDmgFcoNrIntlStrt_C MisfDet_stcCatDmgFcoRatMin_C MisfDet_stcCatDmgFcoThd_CA MisfDet_stStcCatDmgFcoCfg_C /end DEF_CHARACTERISTIC
 /begin IN_MEASUREMENT Epm_nEng MisfDet_cylCntr MisfDet_stBlkStc MisfDet_stCatDmgCurrIntl MisfDet_stcCatIgnCntr MisfDet_stcCatIntlLen MisfDet_stcCatMisfCntrBnk MisfDet_stcCatMisfCntrCyl MisfDet_stcCatThd MisfDet_stFcmClr MisfDet_stInjLockdOpen MisfDet_stReIni SyC_stSub /end IN_MEASUREMENT
 /begin OUT_MEASUREMENT MisfDet_stCatDmgFcoCyl MisfDet_stCatDmgFcoEng /end OUT_MEASUREMENT
 /begin LOC_MEASUREMENT MisfDet_stCatDmgFcoCylCurrIntl MisfDet_stcCatDmgFcoNrCylBnk MisfDet_stcCatDmgFcoNrIntlCyl MisfDet_stcCatDmgFcoNrIntlMin MisfDet_stcCatDmgFcoNrIntlStrt /end LOC_MEASUREMENT
 FUNCTION_VERSION "1.17.0" /end FUNCTION
/begin FUNCTION MisfDet_StcIfDSM "1.23.0    Misfire interface to diagnostic system manager (DSM)" /begin DEF_CHARACTERISTIC MisfDet_stCfgOBD_C /end DEF_CHARACTERISTIC
 /begin IN_MEASUREMENT DSM_TripChgFinshd MisfDet_stcEmiMisfCntrCyl MisfDet_stFcmClr100ms MisfDet_stStcCatIntlHealSimrCdn MisfDet_stStcEmiIntlHealSimrCdn MisfDet_stStcEmiIntlHealSimrCdnStrt SyC_stSub /end IN_MEASUREMENT
 /begin OUT_MEASUREMENT MisfDet_stFlt MisfDet_stFltCurrDcyc MisfDet_stFltCyl MisfDet_stFltPrevDcyc MisfDet_stSimrCdn /end OUT_MEASUREMENT
 /begin LOC_MEASUREMENT MisfDet_cylFrzFrmData MisfDet_simrCdn.n MisfDet_simrCdn.load MisfDet_simrCdn.T MisfDet_stOk /end LOC_MEASUREMENT
 FUNCTION_VERSION "1.23.0" /end FUNCTION
/begin FUNCTION MisfDet_StcMisc "1.11.2    Miscellaneous misfire statistics (similar conditions, longterm calibration support, arv,)" /begin DEF_CHARACTERISTIC MisfDet_nrDcycDrvRcdrRst_C MisfDet_stStcMiscCfg_C /end DEF_CHARACTERISTIC
 /begin IN_MEASUREMENT Epm_nEng MisfDet_cylCntr MisfDet_stBlkStc MisfDet_stCntMisf SyC_stSub /end IN_MEASUREMENT
 /begin OUT_MEASUREMENT MisfDet_ignCntr MisfDet_misfCntrCyl MisfDet_misfCntrSum MisfDet_stExhDmgSuspc /end OUT_MEASUREMENT
 /begin LOC_MEASUREMENT MisfDet_nrDcycDrvRcdr /end LOC_MEASUREMENT
 FUNCTION_VERSION "1.11.2" /end FUNCTION
/begin FUNCTION MisfDet_ThdCalcn "1.24.0    Misfire detection, Threshold calculation"
 /begin DEF_CHARACTERISTIC MisfDet_dnThdContRdcFac_C MisfDet_dnThdContRdcIdx_C MisfDet_dnThdDecFilFac_C MisfDet_dnThdDecMaxCont_T MisfDet_dnThdDecMaxDif_T MisfDet_dnThdDecMax_T MisfDet_dnThdFacStrt_T MisfDet_dnThdMinFacLteCmb.Cmn_C MisfDet_dnThdOffsTCatHeat_T MisfDet_dnThdOffsT_T MisfDet_dnThdTiMinDynLim_C MisfDet_maxToothDeEolNLim_C MisfDet_maxToothDeEol_C MisfDet_maxToothDe_C MisfDet_stThdCalcnCfg_C /end DEF_CHARACTERISTIC
 /begin REF_CHARACTERISTIC MisfDet_dnFilFacMax_C MisfDet_dnQnts_C /end REF_CHARACTERISTIC
 /begin IN_MEASUREMENT Epm_numCyl MisfDet_dnAdpnQlyFac MisfDet_dnFltdCyl MisfDet_dnThdFacLteCmbMapOut MisfDet_dnThdMapOut MisfDet_dnThdMapOutCont MisfDet_dnThdMapOutDif MisfDet_dnThdMinContOut MisfDet_dnThdMinDnAdpnMapOut MisfDet_nEngSync MisfDet_segPosnLenSync MisfDet_stCatHeat MisfDet_stDnDifSelActv MisfDet_stSegShift MisfDet_stSegTiAdpnRdy MisfDet_stSegTiAdpnSync MisfDet_stSegTiAdpnTypeRdy MisfDet_stStcEmiStrt MisfDet_tEng MisfDet_tiEngRun MisfDet_tiEngRunSum /end IN_MEASUREMENT
 /begin OUT_MEASUREMENT MisfDet_dnThd MisfDet_dnThdCont MisfDet_dnThdCor MisfDet_dnThdDif MisfDet_dnThdMinAdpn MisfDet_dnThdOffsT /end OUT_MEASUREMENT
 /begin LOC_MEASUREMENT MisfDet_dnThdContRdcVal MisfDet_dnThdCorCont MisfDet_dnThdCorDif MisfDet_dnThdDecLim MisfDet_dnThdDecLimCont MisfDet_dnThdDecLimDif MisfDet_dnThdDynLim MisfDet_dnThdDynLimCont MisfDet_dnThdFacLteCmb MisfDet_dnThdFacStrt MisfDet_dnThdMinDnAdpnVal MisfDet_dnThdMinSegTiAdpn MisfDet_dnThdSyncContFiltd MisfDet_stDnThdDynLim /end LOC_MEASUREMENT
 FUNCTION_VERSION "1.24.0" /end FUNCTION
/begin FUNCTION MisfDet_ThdMapSeln "1.11.0    Base map selection for threshold calculation"
 /begin DEF_CHARACTERISTIC MisfDet_dnThdFacLteCmbDrv.Cmn_GT MisfDet_dnThdFacLteCmbDrv_AX MisfDet_dnThdFacLteCmbIdle.Cmn_GT MisfDet_dnThdFacLteCmbIdle_AX MisfDet_dnThdIdleLteCmbTq_AX MisfDet_dnThdIdleTq_AX MisfDet_dnThdMapDrvCatHeatGrip.Std.Cmn_GM MisfDet_dnThdMapDrvCatHeatGrip.Cont.Cmn_GM MisfDet_dnThdMapDrvCatHeatGrip.Dif.Cmn_GM MisfDet_dnThdMapDrvCatHeatOpen.Std.Cmn_GM MisfDet_dnThdMapDrvCatHeatOpen.Cont.Cmn_GM MisfDet_dnThdMapDrvCatHeatOpen.Dif.Cmn_GM MisfDet_dnThdMapDrvCatHeatSlip.Std.Cmn_GM MisfDet_dnThdMapDrvCatHeatSlip.Cont.Cmn_GM MisfDet_dnThdMapDrvCatHeatSlip.Dif.Cmn_GM MisfDet_dnThdMapIdle.Std.Cmn_GT MisfDet_dnThdMapIdle.Cont.Cmn_GT MisfDet_dnThdMapIdle.Dif.Cmn_GT MisfDet_dnThdMapIdleAltvPosn.Std.Cmn_GT MisfDet_dnThdMapIdleAltvPosn.Cont.Cmn_GT MisfDet_dnThdMapIdleAltvPosn.Dif.Cmn_GT MisfDet_dnThdMapIdleCatHeat.Std.Cmn_GT MisfDet_dnThdMapIdleCatHeat.Cont.Cmn_GT MisfDet_dnThdMapIdleCatHeat.Dif.Cmn_GT MisfDet_dnThdMapIdleCatWrm.Std.Cmn_GT MisfDet_dnThdMapIdleCatWrm.Cont.Cmn_GT MisfDet_dnThdMapIdleCatWrm.Dif.Cmn_GT MisfDet_dnThdMapPtGrip.Std.Cmn_GM MisfDet_dnThdMapPtGrip.Cont.Cmn_GM MisfDet_dnThdMapPtGrip.Dif.Cmn_GM MisfDet_dnThdMapPtOpen.Std.Cmn_GM MisfDet_dnThdMapPtOpen.Cont.Cmn_GM MisfDet_dnThdMapPtOpen.Dif.Cmn_GM MisfDet_dnThdMapPtSlip.Std.Cmn_GM MisfDet_dnThdMapPtSlip.Cont.Cmn_GM MisfDet_dnThdMapPtSlip.Dif.Cmn_GM MisfDet_dnThdMinBlkDnAdpnNvCorrn.Cmn_GM MisfDet_dnThdMinBlkDnAdpnNvCorrn1.Cmn_GM MisfDet_dnThdMinCont.Cmn_GM MisfDet_dnThdMinContIdle_M MisfDet_dnThdMinDnAdpn.Cmn_GM MisfDet_dnThdMinDnAdpnN_AX MisfDet_dnThdMinDnAdpnTq_AX MisfDet_dnThdN_AX MisfDet_dnThdTq_AX MisfDet_iaCatWrmThd_C MisfDet_maskDnThdMinBlkDnAdpnNvCorrnCmbTyp_CA MisfDet_maskDnThdMinBlkDnAdpnNvCorrn_CA MisfDet_rGripMaxOpen_C MisfDet_rGripMinClsd_C MisfDet_stThdMapSelnCfg_C /end DEF_CHARACTERISTIC
 /begin IN_MEASUREMENT B_kw_msg MisfDet_dnDly MisfDet_iaMdnAvrg MisfDet_maskDnAdpnNvCorrnCmbd MisfDet_maskDnAdpnNvCorrnCmbdCmbTyp MisfDet_nEngSync MisfDet_stBlkDnAdpnNvCorrn MisfDet_stCatHeat MisfDet_stIdle MisfDet_stOpenPt MisfDet_stSegShift MisfDet_tqBascSync PT_rGrip /end IN_MEASUREMENT
 /begin OUT_MEASUREMENT MisfDet_dnThdFacLteCmbMapOut MisfDet_dnThdMapOut MisfDet_dnThdMapOutCont MisfDet_dnThdMapOutDif MisfDet_dnThdMinContOut MisfDet_dnThdMinDnAdpnMapOut /end OUT_MEASUREMENT
 /begin LOC_MEASUREMENT MisfDet_dnThdMinDnAdpnMapIdx MisfDet_idxThdMap MisfDet_idxThdMapSync /end LOC_MEASUREMENT
 FUNCTION_VERSION "1.11.0" /end FUNCTION
/begin FUNCTION MoCADC_Co "80.8.0    Microcontroller Monitoring: AD-converter"
 /begin DEF_CHARACTERISTIC MoCADC_ctDebNTP_C MoCADC_ctDebTst_C MoCADC_ctRstNTP_C MoCADC_ctRstTst_C MoCADC_uNTPMax_C MoCADC_uTstMax_C MoCADC_uTstMin_C /end DEF_CHARACTERISTIC
 /begin IN_MEASUREMENT MoGlbl_vblStructCpl.Mo_stCplChk MoGlbl_vblStructCpl.Mo_stMoCCpl Mo_ctRst Mo_ctRstCpl Mo_stMoF Mo_stMoFCpl /end IN_MEASUREMENT
 /begin OUT_MEASUREMENT MoCADC_bChkActv MoCADC_bDef MoCADC_bNTPActv MoCADC_bNTPErr MoCADC_bNTPRel MoCADC_bTstErr MoCADC_st MoCADC_stMsg Mo_flgIrrvErrNTPMsg Mo_flgIrrvErrTstMsg /end OUT_MEASUREMENT
 /begin LOC_MEASUREMENT MoCADC_ctDebNTP MoCADC_ctDebNTPCpl MoCADC_ctDebTst MoCADC_ctDebTstCpl MoCADC_ctTstNTP MoCADC_ctTstTst MoCADC_flgClrNTP MoCADC_flgClrTst MoCADC_flgNTPTest MoCADC_stCpl MoCADC_uNTP_mp MoCADC_uTst_mp /end LOC_MEASUREMENT
 FUNCTION_VERSION "80.8.0" /end FUNCTION
/begin FUNCTION MoCCom_Co "81.26.0   Microcontroller Monitoring: Query-response-communication between MM and FC"
 /begin IN_MEASUREMENT MoCCPU_PartResp MoCGTM_PtlResp MoCHwLogicTest_PtlResp MoCIWDH_PtlResp MoCPFC_PtlResp MoCSOP_stActvMsg MoCSOP_stComActv MoCSOP_stComActvCpl /end IN_MEASUREMENT
 /begin OUT_MEASUREMENT MoCCom_bPFCNew MoCCom_bSwShrNew MoCCom_cntrWDAErrThd MoCCom_cntrWDAErrThdMsg MoCCom_ctErrFC MoCCom_ctErrMM MoCCom_ctErrMMMsg MoCCom_Query MoCCom_stQueryNew MoCCom_SwShrPtlResp /end OUT_MEASUREMENT
 /begin LOC_MEASUREMENT MoCCom_cntrInCorrRespTime MoCCom_cntrSyncMonModl MoCCom_cntrWDAErrThdCpl MoCCom_ctBusErr MoCCom_ctBusErrCpl MoCCom_ctErrFCCpl MoCCom_ctErrMMOld MoCCom_ctErrOSTimeout MoCCom_Response MoCCom_Response_mp MoCCom_stBusErr MoCCom_stCheckState MoCCom_stCheckStateCpl MoCCom_stComActvOld MoCCom_stComActvOldCpl MoCCom_stComState MoCCom_stErrEna MoCCom_stErrEnaCpl MoCCom_stWdgThdErr MoCCom_stWdgTiWinErr /end LOC_MEASUREMENT
 FUNCTION_VERSION "81.26.0" /end FUNCTION
/begin FUNCTION MoCCPU_Co "80.6.0    Microcontroller Monitoring: Instruction test" /begin DEF_CHARACTERISTIC MoCCPU_stLockStepTstActv_CW /end DEF_CHARACTERISTIC /begin OUT_MEASUREMENT MoCCPU_PartResp /end OUT_MEASUREMENT FUNCTION_VERSION "80.6.0" /end FUNCTION
/begin FUNCTION MoCEMM_Co "1.24.0    Microcontroller Monitoring: Error Management Module(EMM)" /begin IN_MEASUREMENT MoCSOP_stComActv /end IN_MEASUREMENT
 /begin OUT_MEASUREMENT MoCEMM_stEmmAlrms MoCEMM_stEmmAlrmsMsg MoCEMM_stEmmAlrmsNv MoCEMM_stEmmErrorPin /end OUT_MEASUREMENT
 /begin LOC_MEASUREMENT MoCEMM_idxNumCurrErr MoCEMM_stEmmAlrmsCpl MoCEMM_stEmmErrorPinCpl MoCEMM_stEmmGPIO MoCEMM_stPwrOnRstHdl MoCEMM_stPwrOnRstHdlCpl MoCEMM_stPwrOnRstReq MoCEMM_stPwrOnRstReqCpl MoCEMM_structCurrReq.MoCEMM_cntrInfo MoCEMM_structCurrReq.MoCEMM_blkInfo MoCEMM_structCurrReq.MoCEMM_cntrInfoCpl MoCEMM_structFlash.MoCEMM_cntrInfo MoCEMM_structFlash.MoCEMM_blkInfo MoCEMM_structFlash.MoCEMM_cntrInfoCpl MoCEMM_stSWErrorPinReqAry MoCEMM_stSWErrorPinReqAryCpl MoCEMM_wdgTout /end LOC_MEASUREMENT
 FUNCTION_VERSION "1.24.0" /end FUNCTION
/begin FUNCTION MoCGTM_Co "1.16.0    Microcontroller Monitoring: Generic Timer Module (GTM)"
 /begin DEF_CHARACTERISTIC MoCGTM_cntrCMPErrbitHealMax_C MoCGTM_cntrDebErrMax_C MoCGTM_stChksTstActv_CW MoCGTM_stSWResetDem_CW MoCGTM_stTestActv_CW /end DEF_CHARACTERISTIC
 /begin OUT_MEASUREMENT MoCGTM_bbOut1 MoCGTM_flgCmpErr MoCGTM_PtlResp /end OUT_MEASUREMENT
 /begin LOC_MEASUREMENT MoCGTM_aryCMPErrBit MoCGTM_aryCMPErrBitCpl MoCGTM_bbOut1Cpl MoCGTM_cmpErrAryIdx MoCGTM_cmpErrAryIdxCpl MoCGTM_cntrBadcase MoCGTM_cntrCMPErrbit MoCGTM_cntrCMPErrbitCpl MoCGTM_cntrCMPErrbitHeal MoCGTM_cntrCMPErrbitHealCpl MoCGTM_cntrDebErr MoCGTM_cntrDebErrCpl MoCGTM_cntrDebErrMax MoCGTM_cntrMCS1 MoCGTM_cntrMCS1Old MoCGTM_cntrMCS1OldCpl MoCGTM_cntrMCS2 MoCGTM_cntrMCS2Old MoCGTM_cntrMCS2OldCpl MoCGTM_cntrMsmCMPErrBit MoCGTM_cntrRouteSigErr MoCGTM_cntrRouteSigErrCpl MoCGTM_currChksVal MoCGTM_currChksValCpl MoCGTM_currMCSModlAryIdx MoCGTM_McsData_ptr1Cpl MoCGTM_McsData_ptr2Cpl MoCGTM_numMCS1Ch MoCGTM_numMCS1Modl MoCGTM_numMCS2Ch MoCGTM_numMCS2Modl MoCGTM_PtlRespCpl MoCGTM_stBadcaseTrig MoCGTM_stErr MoCGTM_stErrChks MoCGTM_stErrCpl MoCGTM_tiCurrMCSVal MoCGTM_tiCurrTskcall MoCGTM_tiExeMCS1_MP MoCGTM_tiExeMCS2_MP MoCGTM_tiFallEdgeBadcase_MP MoCGTM_tiFallEdgeMCS1_MP MoCGTM_tiFallEdgeMCS2_MP MoCGTM_tiMCSTIMRead MoCGTM_tiPrevMCS1Trig_MP MoCGTM_tiPrevMCS2Trig_MP MoCGTM_tiPrevTskcall MoCGTM_tiRisngEdgeMCS1_MP MoCGTM_tiRisngEdgeMCS2_MP MoCGTM_tiTskCalldst_MP /end LOC_MEASUREMENT
 FUNCTION_VERSION "1.16.0" /end FUNCTION
/begin FUNCTION MoCHwLogicTest_Co "1.4.0     Microcontroller Monitoring: Hardware Logic Test"
 /begin DEF_CHARACTERISTIC MoCHwLogicTest_stTestActv_CW MoCHwLogicTest_swtDisblErrReactn_CW MoCHwLogicTest_swtDisblFwChk_CA /end DEF_CHARACTERISTIC
 /begin OUT_MEASUREMENT MoCHwLogicTest_PtlResp /end OUT_MEASUREMENT
 /begin LOC_MEASUREMENT MoCHwLogicTest_flgAlvTestChk MoCHwLogicTest_flgFwChk MoCHwLogicTest_flgMONBISTChk MoCHwLogicTest_flgSFFDChk MoCHwLogicTest_flgTempChk MoCHwLogicTest_flgUCBErrChk MoCHwLogicTest_stErr /end LOC_MEASUREMENT
 FUNCTION_VERSION "1.4.0" /end FUNCTION
/begin FUNCTION MoCIWDH_Co "2.1.0     Microcontroller Monitoring: Internal watchdog handler" /begin DEF_CHARACTERISTIC MoCIWDH_stPtlRespTstActv_CW /end DEF_CHARACTERISTIC /begin OUT_MEASUREMENT MoCIWDH_PtlResp /end OUT_MEASUREMENT
 /begin LOC_MEASUREMENT MoCIWDH_bbLoc1 MoCIWDH_bbLoc1Cpl MoCIWDH_cntChksAry MoCIWDH_cntrRollgAry MoCIWDH_cntrRollgAryCpl MoCIWDH_flgConcatValErr MoCIWDH_numChksAry MoCIWDH_numConcatValAry MoCIWDH_PtlRespCpl MoCIWDH_stErrAry /end LOC_MEASUREMENT
 FUNCTION_VERSION "2.1.0" /end FUNCTION
/begin FUNCTION MoCMemStrtUp_Co "1.0.0     Microcontroller Monitoring: Startup memory test" /begin DEF_CHARACTERISTIC MoCMemStrtUp_chkRamTest_C MoCMemStrtUp_chkRomTest_C /end DEF_CHARACTERISTIC /begin OUT_MEASUREMENT MoCMemStrtUp_adrEccErr /end OUT_MEASUREMENT
 /begin LOC_MEASUREMENT MoCMemStrtUp_chkRamTest MoCMemStrtUp_chkRomTest MoCMemStrtUp_tiRamChk MoCMemStrtUp_tiRomChk MoCMemStrtUp_toutWdg /end LOC_MEASUREMENT
 FUNCTION_VERSION "1.0.0" /end FUNCTION
/begin FUNCTION MoCMem_Co "80.24.1   Microcontroller Monitoring: Cyclic memory test"
 /begin DEF_CHARACTERISTIC MoCMem_ctDebErrChkRAM_C MoCMem_ctDebErrChkROM_C MoCMem_ctDebHealChkRAMCpl_C MoCMem_ctDebHealChkRAM_C MoCMem_ctDebHealChkROMCpl_C MoCMem_ctDebHealChkROM_C MoCMem_noMEMChkRstCpl_CW MoCMem_noMEMChkRst_CW MoCMem_numRamChk_C MoCMem_numRomChk_CA MoCMem_RamTst_CW MoCMem_RomTst_CW MoCMem_stSwtAutRamChkConf_C MoCMem_stSwtAutRomChkConf_C /end DEF_CHARACTERISTIC
 /begin IN_MEASUREMENT MoExe_ctCyc /end IN_MEASUREMENT
 /begin LOC_MEASUREMENT MoCMem_adChkSumBlk MoCMem_adChkSumBlkCpl MoCMem_ctDebErrChkROM MoCMem_ctDebErrChkROMCpl MoCMem_ctDebHealChkROM MoCMem_ctDebHealChkROMCpl MoCMem_ctLrnROM MoCMem_ctLrnROMCpl MoCMem_idxCSAry MoCMem_idxCSAryCpl MoCMem_nrRomChk MoCMem_nrRomChkCpl MoCMem_nrRomChkSize MoCMem_numChkSumCurrent MoCMem_numChkSumCurrentCpl MoCMem_RomCurrentPtr MoCMem_RomCurrentPtrCpl MoCMem_stDataCycChkBlk MoCMem_stDataCycChkBlkCpl MoCMem_stDisChk MoCMem_tiROMAccus MoCMem_tiROMAccusCpl MoCMem_tiROMus MoCMem_tiROMusCpl MoCMem_tiROMusOld MoCMem_tiROMusOldCpl /end LOC_MEASUREMENT
 FUNCTION_VERSION "80.24.1" /end FUNCTION
/begin FUNCTION MoCPFC_Co "14.4.0    Microcontroller Monitoring: Program flow check" /begin DEF_CHARACTERISTIC MoCPFC_stPtlRespTestActv_CW /end DEF_CHARACTERISTIC /begin IN_MEASUREMENT MoCCom_bPFCNew MoCCom_Query /end IN_MEASUREMENT /begin OUT_MEASUREMENT MoCPFC_Checksum MoCPFC_PtlResp /end OUT_MEASUREMENT /begin LOC_MEASUREMENT MoCPFC_Checkword MoCPFC_Counter /end LOC_MEASUREMENT FUNCTION_VERSION "14.4.0" /end FUNCTION
/begin FUNCTION MoCSCC_Co "1.27.0    Microcontroller Monitoring: Safety feature Configuration Check(SCC)"
 /begin DEF_CHARACTERISTIC MoCSCC_cntrDebMax_C MoCSCC_stSCCTstActv_CW MoCSCC_swtDisblEmmChk_CA MoCSCC_swtLfastWrkarndActv_CW /end DEF_CHARACTERISTIC
 /begin REF_CHARACTERISTIC MoCSOP_stReqCANFrTest_C /end REF_CHARACTERISTIC
 /begin IN_MEASUREMENT MoCSOP_stComActv /end IN_MEASUREMENT
 /begin LOC_MEASUREMENT MoCSCC_stLfastWrkarndActv_MP MoCSCC_stMstInstFnd /end LOC_MEASUREMENT
 FUNCTION_VERSION "1.27.0" /end FUNCTION
/begin FUNCTION MoCSOP_Co "81.28.0   Microcontroller Monitoring: Shut-off path test"
 /begin DEF_CHARACTERISTIC MoCSOP_cntrDebCtrlLinesActvThd_C MoCSOP_cntrFrMacroTicEnd_C MoCSOP_cntrFrMacroTicStrt_C MoCSOP_ctDebCANFrTest_C MoCSOP_ctDebSOPTst_C MoCSOP_ctDebSycDrv_C MoCSOP_ctRstCANFrTest_C MoCSOP_ctRst_C MoCSOP_nEngMaxOVLthDisbl_C MoCSOP_stCANErrReac_CW MoCSOP_stCANTestActv_CW MoCSOP_stErrReactnERPN_CA MoCSOP_stErrReactn_CA MoCSOP_stMMErrReac_CW MoCSOP_stOVErrReactn_C MoCSOP_stReqCANFrTest_C MoCSOP_stSWResetDem_CW MoCSOP_stTestActv_CW MoCSOP_swtAlwysPsTest_C MoCSOP_swtRepFaildPESTest_C /end DEF_CHARACTERISTIC
 /begin IN_MEASUREMENT Epm_nEng MoGlbl_vblStructCpl.Mo_stCplChk MoGlbl_vblStructCpl.Mo_stMoCCpl Mo_stMoF Mo_stMoFCpl T15_st /end IN_MEASUREMENT
 /begin OUT_MEASUREMENT MoCSOP_ctErrMM MoCSOP_st MoCSOP_stActMsg MoCSOP_stActvMsg MoCSOP_stCANFrTest MoCSOP_stComActv MoCSOP_stComActvCpl MoCSOP_stOvl MoCSOP_stRdy MoCSOP_stRdyCan MoCSOP_stRdyCpl MoCSOP_stRdyFr MoCSOP_stRdyInj MoCSOP_stRdyMsg /end OUT_MEASUREMENT
 /begin LOC_MEASUREMENT MoCSOP_cntrDebErrPinActv MoCSOP_cntrDebErrPinActvCpl MoCSOP_cntrDebExtErrPinEveActv MoCSOP_cntrDebExtErrPinEveActvCpl MoCSOP_cntrDebExtErrPinEveActv_MP MoCSOP_cntrDebSycDrv MoCSOP_cntrDebSycDrvCpl MoCSOP_cntrSignalSwtDelay MoCSOP_cntrSignalSwtDelayCpl MoCSOP_ctBusErr MoCSOP_ctBusErr_MP MoCSOP_ctCANFrIdx MoCSOP_ctDebCANFrTest MoCSOP_ctDebCANFrTestCpl MoCSOP_ctDebSOPTst MoCSOP_ctDebSOPTstCpl MoCSOP_ctErrMM_mp MoCSOP_ctErrOSTimeout MoCSOP_ctIdx MoCSOP_ctRespOffsetTst MoCSOP_ctRst MoCSOP_ctRstCANFrTest MoCSOP_ctRstCANFrTestCpl MoCSOP_ctRstCpl MoCSOP_flgErrPinActvd MoCSOP_flgErrPinActvdCpl MoCSOP_flgReqSOPTest MoCSOP_flgReqSOPTestCpl MoCSOP_flgT15RisngEdge MoCSOP_flgT15RisngEdgeCpl MoCSOP_stBusErr MoCSOP_stBusErr_MP MoCSOP_stCANFrTestCpl MoCSOP_stCANFrTestErr MoCSOP_stCANFrTestErrReas MoCSOP_stCANFrTestErrReasCpl MoCSOP_stCANFrTestState MoCSOP_stCANFrTestStateCpl MoCSOP_stCanTdi MoCSOP_stCANTestState_mp MoCSOP_stCheckState MoCSOP_stCheckStateCpl MoCSOP_stCheckState_mp MoCSOP_stComTrcvOld MoCSOP_stCpl MoCSOP_stDia MoCSOP_stDiaCpl MoCSOP_stDiaERPN MoCSOP_stDiaERPNCpl MoCSOP_stEmmState_MP MoCSOP_stErr MoCSOP_stErrPinActvnReq MoCSOP_stErrPin_MP MoCSOP_stErrReactn MoCSOP_stErrReactnERPN MoCSOP_stInhbStrtCdn MoCSOP_stOvlCpl MoCSOP_stOVTstStatusEval MoCSOP_stOVTstStatusEvalCpl MoCSOP_stPVMTUnderTest MoCSOP_stRdyCanCpl MoCSOP_stRdyFrCpl MoCSOP_stRdyInjCpl MoCSOP_stReqPSStatus MoCSOP_stReqPSStatusBusErr MoCSOP_stT15Old MoCSOP_stT15OldCpl MoCSOP_tiCanTest_MP Mo_flgIrrvErrSOPMsg /end LOC_MEASUREMENT
 FUNCTION_VERSION "81.28.0" /end FUNCTION
/begin FUNCTION MoExe_Co "742.2.0   Monitoring: Execution control" /begin OUT_MEASUREMENT MoExe_ctCyc MoExe_ctCycCpl /end OUT_MEASUREMENT FUNCTION_VERSION "742.2.0" /end FUNCTION
/begin FUNCTION MoFACC_Co "112.0.0   Function Monitoring: Adaptive cruise control" /begin DEF_CHARACTERISTIC MoFACC_swtCANEna_C /end DEF_CHARACTERISTIC
 /begin IN_MEASUREMENT MoFFrm_Rx_flgACCActv MoFFrm_Rx_stPdu_GWIMG3 Mo_stCplChk Mo_stMoC Mo_stMoCCpl /end IN_MEASUREMENT
 /begin OUT_MEASUREMENT MoFACC_flgPtd /end OUT_MEASUREMENT
 /begin LOC_MEASUREMENT MoFACCCo_bbOutCpl /end LOC_MEASUREMENT
 FUNCTION_VERSION "112.0.0" /end FUNCTION
/begin FUNCTION MoFAirFl_CtOffPfi "11.0.0    Function Monitoring: Fuel cut off PFI"
 /begin DEF_CHARACTERISTIC MoFAirFl_cntrErrDebMaxCtOffPfi_C MoFAirFl_cntrRstMaxCtOffPfi_C MoFAirFl_nEngStallg_C MoFAirFl_nErrHndlgActvnCtOffPfi_C /end DEF_CHARACTERISTIC
 /begin IN_MEASUREMENT MoFAirFl_CtOffIfClass_V13I.evz_auscpl MoFAirFl_CtOffIfClass_V13I.evz_auscpl_mem MoFAirFl_CtOffIfClass_V13I.evz_austot MoFAirFl_CtOffIfClass_V13I.evz_austot_mem MoFAirFl_CtOffIfClass_V13I.flgInjEnad MoFAirFl_CtOffIfClass_V13I.injTrigCylMsk MoFAirFl_CtOffIfClass_V13I.injmode_zzylh MoFAirFl_CtOffIfClass_V13I.injmode_zzylh_rdnt MoFAirFl_CtOffIfClass_V13I.injmode_zzyln MoFAirFl_CtOffIfClass_V13I.injmode_zzyln_rdnt MoFAirFl_CtOffIfClass_V13I.injmode_zzyls MoFAirFl_CtOffIfClass_V13I.injmode_zzyls_rdnt MoFAirFl_CtOffIfClass_V13I.stInjPfiDeactvAry MoFAirFl_CtOffIfClass_V13I.stInjPfiDeactvAryRdnt MoFAirFl_CtOffIfClass_V13I.stInjPfiDeactvBkupAry MoFAirFl_CtOffIfClass_V13I.stInjTiPfi MoFAirFl_CtOffIfClass_V13I.stInjTiPfi1InjrA MoFAirFl_CtOffIfClass_V13I.stInjTiPfi1InjrARdnt MoFAirFl_CtOffIfClass_V13I.stInjTiPfi1InjrB MoFAirFl_CtOffIfClass_V13I.stInjTiPfi1InjrBRdnt MoFAirFl_CtOffIfClass_V13I.stInjTiPfi2InjrA MoFAirFl_CtOffIfClass_V13I.stInjTiPfi2InjrARdnt MoFAirFl_CtOffIfClass_V13I.stInjTiPfi2InjrB MoFAirFl_CtOffIfClass_V13I.stInjTiPfi2InjrBRdnt MoFAirFl_CtOffIfClass_V13I.stInjTiPfiRdnt MoFAirFl_flgErrCom MoFESpd_nEng MoF_bAirFlChkDisbl Mo_bPostDrv Mo_bPreDrv Mo_ctRst Mo_ctRstCpl Mo_stCplChk Mo_stMoC Mo_stMoCCpl Mo_stMoF Mo_stMoFCpl /end IN_MEASUREMENT
 /begin OUT_MEASUREMENT evz_aus_um MoFAirFl_flgIrrvErrCtOffPfiMsg MoFAirFl_flgTestCtOffPfiMsg MoFAirFl_stCtOffMask MoFAirFl_stErrCtOffPfiMsg /end OUT_MEASUREMENT
 /begin LOC_MEASUREMENT evz_aus_ur MoFAirFlCtOffPfi_flgClr MoFAirFl_cntrDiagDebCtOffPfi MoFAirFl_cntrErrDebCtOffPfi MoFAirFl_cntrErrDebCtOffPfiCpl MoFAirFl_stCtOffMaskCpl MoFAirFl_stErrCtOffPfi_MP /end LOC_MEASUREMENT
 FUNCTION_VERSION "11.0.0" /end FUNCTION
/begin FUNCTION MoFAirFl_CylPfi "11.0.0    Function Monitoring: Cylinder individual fuel correction PFI"
 /begin DEF_CHARACTERISTIC MoFAirFl_cntrAfimActvMax_C MoFAirFl_cntrErrDebMaxCylPfi_C MoFAirFl_cntrRstMaxCylPfi_C MoFAirFl_facCorFuAvrgMax_C MoFAirFl_facCorrnFuMCylIndAfimMax_C MoFAirFl_facCorrnFuMCylIndMax_C MoFAirFl_nErrHndlgActvnCylPfi_C MoFAirFl_stCfgCyl_C /end DEF_CHARACTERISTIC
 /begin REF_CHARACTERISTIC MoFAirFl_nrCylTot_C /end REF_CHARACTERISTIC
 /begin IN_MEASUREMENT MoFAirFl_MixMngtIfClass_V13I.B_afimreq MoFAirFl_MixMngtIfClass_V13I.facBnk MoFAirFl_MixMngtIfClass_V13I.facBnk2Pfi MoFAirFl_MixMngtIfClass_V13I.facBnkPfi MoFAirFl_MixMngtIfClass_V13I.facLamCtlPfiAry MoFAirFl_MixMngtIfClass_V13I.facLamCtlPfiAryRdnt MoFAirFl_MixMngtIfClass_V13I.facLamCtlPfiBkupAry MoFAirFl_MixMngtIfClass_V13I.facPcPfiRest MoFAirFl_MixMngtIfClass_V13I.facPcPfiRestBnk2 MoFAirFl_MixMngtIfClass_V13I.facPcRest MoFAirFl_MixMngtIfClass_V13I.facPrtnPfi MoFAirFl_MixMngtIfClass_V13I.facPrtnPfiAry MoFAirFl_MixMngtIfClass_V13I.facPrtnPfiAryRdnt MoFAirFl_MixMngtIfClass_V13I.facPrtnPfiBkupAry MoFAirFl_MixMngtIfClass_V13I.fakeslsa MoFAirFl_MixMngtIfClass_V13I.ffuevali MoFAirFl_MixMngtIfClass_V13I.ffuevalipfi MoFAirFl_MixMngtIfClass_V13I.fkrkAry MoFAirFl_MixMngtIfClass_V13I.fkrkPfiAry MoFAirFl_MixMngtIfClass_V13I.fkrkPfiAryRdnt MoFAirFl_MixMngtIfClass_V13I.flgLamSplitActv MoFAirFl_MixMngtIfClass_V13I.fnsad MoFAirFl_MixMngtIfClass_V13I.fr MoFAirFl_MixMngtIfClass_V13I.fr2 MoFAirFl_MixMngtIfClass_V13I.fragdi MoFAirFl_MixMngtIfClass_V13I.fragdi2 MoFAirFl_MixMngtIfClass_V13I.frapfi MoFAirFl_MixMngtIfClass_V13I.frapfi2 MoFAirFl_MixMngtIfClass_V13I.lamsbg MoFAirFl_MixMngtIfClass_V13I.lamsbg2 MoFAirFl_MixMngtIfClass_V13I.larils MoFAirFl_MixMngtIfClass_V13I.larils2 MoFAirFl_MixMngtIfClass_V13I.rCtlPriB1 MoFAirFl_MixMngtIfClass_V13I.rCtlPriB2 MoFAirFl_MixMngtIfClass_V13I.ratChrgAirCylPredPfi MoFAirFl_MixMngtIfClass_V13I.ratFuMCylInd MoFAirFl_MixMngtIfClass_V13I.ratFuMGdi MoFAirFl_MixMngtIfClass_V13I.ratFuMGdiBnk2 MoFAirFl_MixMngtIfClass_V13I.ratFuMPfi MoFAirFl_MixMngtIfClass_V13I.ratFuMPfiBnk2 MoFAirFl_MixMngtIfClass_V13I.ratFuPrtnPfiInjAry MoFAirFl_MixMngtIfClass_V13I.ratFuPrtnPfiInjAryRdnt MoFAirFl_MixMngtIfClass_V13I.ratFuPrtnPfiInjBkupAry MoFAirFl_MixMngtIfClass_V13I.ratPrdcAirPrtnPfiAry MoFAirFl_MixMngtIfClass_V13I.ratPrdcAirPrtnPfiAryRdnt MoFAirFl_MixMngtIfClass_V13I.ratPrdcAirPrtnPfiBkupAry MoFAirFl_MixMngtIfClass_V13I.rkagdi MoFAirFl_MixMngtIfClass_V13I.rkagdi2 MoFAirFl_MixMngtIfClass_V13I.rkapfi MoFAirFl_MixMngtIfClass_V13I.rkapfi2 MoFAirFl_MixMngtIfClass_V13I.rkausg MoFAirFl_MixMngtIfClass_V13I.rkte MoFAirFl_MixMngtIfClass_V13I.rkteBnk1 MoFAirFl_MixMngtIfClass_V13I.rkteBnk2 MoFAirFl_MixMngtIfClass_V13I.rkukg MoFAirFl_MixMngtIfClass_V13I.rkukgpfi MoFAirFl_MixMngtIfClass_V13I.rlfg MoFAirFl_MixMngtIfClass_V13I.rlfgBnk1 MoFAirFl_MixMngtIfClass_V13I.rlfgBnk2 MoFAirFl_MixMngtIfClass_V13I.rlp MoFAirFl_MixMngtIfClass_V13I.rlpBnk1 MoFAirFl_MixMngtIfClass_V13I.rlpBnk2 MoFAirFl_MixMngtIfClass_V13I.rlrext MoFAirFl_MixMngtIfClass_V13I.rlrextBnk1 MoFAirFl_MixMngtIfClass_V13I.rlrextBnk2 MoFAirFl_MixMngtIfClass_V13I.rlrint MoFAirFl_MixMngtIfClass_V13I.rlrintBnk1 MoFAirFl_MixMngtIfClass_V13I.rlrintBnk2 MoFESpd_nEng MoF_bAirFlChkDisbl Mo_bPostDrv Mo_bPreDrv Mo_ctRst Mo_ctRstCpl Mo_stCplChk Mo_stMoC Mo_stMoCCpl Mo_stMoF Mo_stMoFCpl /end IN_MEASUREMENT
 /begin OUT_MEASUREMENT MoFAirFl_flgIrrvErrCylPfiMsg MoFAirFl_flgTestCylPfiMsg MoFAirFl_stErrCylPfiMsg /end OUT_MEASUREMENT
 /begin LOC_MEASUREMENT MoFAirFlCylPfi_flgClr MoFAirFl_cntrAfimActvPfi MoFAirFl_cntrAfimActvPfiCpl MoFAirFl_cntrDiagDebCylPfi MoFAirFl_cntrErrDebCylPfi MoFAirFl_cntrErrDebCylPfiCpl MoFAirFl_stErrCylPfi_MP /end LOC_MEASUREMENT
 FUNCTION_VERSION "11.0.0" /end FUNCTION
/begin FUNCTION MoFAirFl_Eta "36.0.0    Function Monitoring: Efficiencies for air and fuel"
 /begin DEF_CHARACTERISTIC MoFAirFlEta_nEng_Ax MoFAirFlEta_ratFillg_Ax MoFAirFl_etaIA_T MoFAirFl_etaLam_T MoFAirFl_iaDeltaOptLam_T MoFAirFl_iaDeltaOptT_T MoFAirFl_iaDelta_Ax MoFAirFl_iaOptm_M MoFAirFl_ratLamSp_Ax /end DEF_CHARACTERISTIC
 /begin REF_CHARACTERISTIC MoFAirFl_nrCylTot_C MoFAirFl_stCfgMoFAirFl_C MoF_tEng_DST /end REF_CHARACTERISTIC
 /begin IN_MEASUREMENT MoFAirFl_MixMngtIfClass_V13I.B_afimreq MoFAirFl_MixMngtIfClass_V13I.facBnk MoFAirFl_MixMngtIfClass_V13I.facBnk2Pfi MoFAirFl_MixMngtIfClass_V13I.facBnkPfi MoFAirFl_MixMngtIfClass_V13I.facLamCtlPfiAry MoFAirFl_MixMngtIfClass_V13I.facLamCtlPfiAryRdnt MoFAirFl_MixMngtIfClass_V13I.facLamCtlPfiBkupAry MoFAirFl_MixMngtIfClass_V13I.facPcPfiRest MoFAirFl_MixMngtIfClass_V13I.facPcPfiRestBnk2 MoFAirFl_MixMngtIfClass_V13I.facPcRest MoFAirFl_MixMngtIfClass_V13I.facPrtnPfi MoFAirFl_MixMngtIfClass_V13I.facPrtnPfiAry MoFAirFl_MixMngtIfClass_V13I.facPrtnPfiAryRdnt MoFAirFl_MixMngtIfClass_V13I.facPrtnPfiBkupAry MoFAirFl_MixMngtIfClass_V13I.fakeslsa MoFAirFl_MixMngtIfClass_V13I.ffuevali MoFAirFl_MixMngtIfClass_V13I.ffuevalipfi MoFAirFl_MixMngtIfClass_V13I.fkrkAry MoFAirFl_MixMngtIfClass_V13I.fkrkPfiAry MoFAirFl_MixMngtIfClass_V13I.fkrkPfiAryRdnt MoFAirFl_MixMngtIfClass_V13I.flgLamSplitActv MoFAirFl_MixMngtIfClass_V13I.fnsad MoFAirFl_MixMngtIfClass_V13I.fr MoFAirFl_MixMngtIfClass_V13I.fr2 MoFAirFl_MixMngtIfClass_V13I.fragdi MoFAirFl_MixMngtIfClass_V13I.fragdi2 MoFAirFl_MixMngtIfClass_V13I.frapfi MoFAirFl_MixMngtIfClass_V13I.frapfi2 MoFAirFl_MixMngtIfClass_V13I.lamsbg MoFAirFl_MixMngtIfClass_V13I.lamsbg2 MoFAirFl_MixMngtIfClass_V13I.larils MoFAirFl_MixMngtIfClass_V13I.larils2 MoFAirFl_MixMngtIfClass_V13I.rCtlPriB1 MoFAirFl_MixMngtIfClass_V13I.rCtlPriB2 MoFAirFl_MixMngtIfClass_V13I.ratChrgAirCylPredPfi MoFAirFl_MixMngtIfClass_V13I.ratFuMCylInd MoFAirFl_MixMngtIfClass_V13I.ratFuMGdi MoFAirFl_MixMngtIfClass_V13I.ratFuMGdiBnk2 MoFAirFl_MixMngtIfClass_V13I.ratFuMPfi MoFAirFl_MixMngtIfClass_V13I.ratFuMPfiBnk2 MoFAirFl_MixMngtIfClass_V13I.ratFuPrtnPfiInjAry MoFAirFl_MixMngtIfClass_V13I.ratFuPrtnPfiInjAryRdnt MoFAirFl_MixMngtIfClass_V13I.ratFuPrtnPfiInjBkupAry MoFAirFl_MixMngtIfClass_V13I.ratPrdcAirPrtnPfiAry MoFAirFl_MixMngtIfClass_V13I.ratPrdcAirPrtnPfiAryRdnt MoFAirFl_MixMngtIfClass_V13I.ratPrdcAirPrtnPfiBkupAry MoFAirFl_MixMngtIfClass_V13I.rkagdi MoFAirFl_MixMngtIfClass_V13I.rkagdi2 MoFAirFl_MixMngtIfClass_V13I.rkapfi MoFAirFl_MixMngtIfClass_V13I.rkapfi2 MoFAirFl_MixMngtIfClass_V13I.rkausg MoFAirFl_MixMngtIfClass_V13I.rkte MoFAirFl_MixMngtIfClass_V13I.rkteBnk1 MoFAirFl_MixMngtIfClass_V13I.rkteBnk2 MoFAirFl_MixMngtIfClass_V13I.rkukg MoFAirFl_MixMngtIfClass_V13I.rkukgpfi MoFAirFl_MixMngtIfClass_V13I.rlfg MoFAirFl_MixMngtIfClass_V13I.rlfgBnk1 MoFAirFl_MixMngtIfClass_V13I.rlfgBnk2 MoFAirFl_MixMngtIfClass_V13I.rlp MoFAirFl_MixMngtIfClass_V13I.rlpBnk1 MoFAirFl_MixMngtIfClass_V13I.rlpBnk2 MoFAirFl_MixMngtIfClass_V13I.rlrext MoFAirFl_MixMngtIfClass_V13I.rlrextBnk1 MoFAirFl_MixMngtIfClass_V13I.rlrextBnk2 MoFAirFl_MixMngtIfClass_V13I.rlrint MoFAirFl_MixMngtIfClass_V13I.rlrintBnk1 MoFAirFl_MixMngtIfClass_V13I.rlrintBnk2 MoFAirFl_ratFillg MoFAirFl_stCtOffMask MoFAirFl_TrqActIfClass_V13I.agIntkClsd MoFAirFl_TrqActIfClass_V13I.dzworri MoFAirFl_TrqActIfClass_V13I.etaaufte MoFAirFl_TrqActIfClass_V13I.etazwist MoFAirFl_TrqActIfClass_V13I.ratInertCyl MoFAirFl_TrqActIfClass_V13I.ratInertEgrExtCyl MoFAirFl_TrqActIfClass_V13I.ratInertEgrIntCyl MoFAirFl_TrqActIfClass_V13I.zwcalcar_zzylzue MoFAirFl_TrqActIfClass_V13I.zwopt MoFAirFl_TrqActIfClass_V13I.zwout MoFAirFl_TrqActIfClass_V13I.zwoutcpl MoFAirFl_TrqActIfClass_V13I.zwouthiresl MoFAirFl_TrqActIfClass_V13I.zwouthireslAry_zzylzue MoFAirFl_TrqActIfClass_V13I.zwouthireslRdnt MoFESpd_nEng MoFIA_iaOutp MoF_tEng MoF_tEng_DST_result Mo_stCplChk Mo_stMoC Mo_stMoCCpl /end IN_MEASUREMENT
 /begin OUT_MEASUREMENT etaaus_um MoFAirFl_etaIA MoFAirFl_etaInjCtOff MoFAirFl_etaInjSplt MoFAirFl_etaLam /end OUT_MEASUREMENT
 /begin LOC_MEASUREMENT etaaus_ur MoFAirFlEta_nEng_Ax_result MoFAirFlEta_ratFillg_Ax_result MoFAirFl_etaIACpl MoFAirFl_etaInjCtOffCpl MoFAirFl_etaInjSpltCpl MoFAirFl_etaLamCpl MoFAirFl_iaDelta MoFAirFl_iaDeltaCpl MoFAirFl_iaDelta_Ax_result MoFAirFl_ratLamSp MoFAirFl_ratLamSpCpl MoFAirFl_ratLamSp_Ax_result /end LOC_MEASUREMENT
 FUNCTION_VERSION "36.0.0" /end FUNCTION
/begin COMPU_METHOD B_TRUE "" TAB_VERB "%6.3" "" COMPU_TAB_REF B_TRUE /end COMPU_METHOD
/begin COMPU_VTAB B_TRUE "" TAB_VERB 2 0 "FALSE" 1 "TRUE" /end COMPU_VTAB
/begin COMPU_METHOD dez "" RAT_FUNC "%6.2" "" COEFFS 0 1 0 0 0 1 /end COMPU_METHOD
/begin COMPU_METHOD dn_Compu "" RAT_FUNC "%6.4" "rad/s^2" COEFFS 0 16 0 0 0 1 /end COMPU_METHOD
/begin COMPU_METHOD EngN "" RAT_FUNC "%6.3" "rpm" COEFFS 0 2 0 0 0 1 /end COMPU_METHOD
/begin COMPU_METHOD Fact100 "" RAT_FUNC "%6.4" "-" COEFFS 0 100 0 0 0 1 /end COMPU_METHOD
/begin COMPU_METHOD fak_ub_b2 "" RAT_FUNC "%8.5" "-" COEFFS 0 256 0 0 0 2 /end COMPU_METHOD
/begin COMPU_METHOD fak_uw_b1 "" RAT_FUNC "%7.6" "-" COEFFS 0 65536 0 0 0 1 /end COMPU_METHOD
/begin COMPU_METHOD fak_uw_b16 "" RAT_FUNC "%6.5" "-" COEFFS 0 65536 0 0 0 16 /end COMPU_METHOD
/begin COMPU_METHOD fak_uw_b2 "" RAT_FUNC "%7.6" "-" COEFFS 0 65536 0 0 0 2 /end COMPU_METHOD
/begin COMPU_METHOD kw_q0p0039 "" RAT_FUNC "%6.4" "Grad KW" COEFFS 0 256 0 0 0 1 /end COMPU_METHOD
/begin COMPU_METHOD kw_q0p75 "" RAT_FUNC "%6.3" "Grad KW" COEFFS 0 4 0 0 0 3 /end COMPU_METHOD
/begin COMPU_METHOD MisfDet_dnThdMinDnAdpnMapIdx_VERB "" TAB_VERB "%6.3" "" COMPU_TAB_REF MisfDet_dnThdMinDnAdpnMapIdx_VERB /end COMPU_METHOD
/begin COMPU_VTAB MisfDet_dnThdMinDnAdpnMapIdx_VERB "" TAB_VERB 4 -1 "None" 0 "MinDnAdpn" 1 "MinBlkDnAdpnNvCorrn" 2 "MinBlkDnAdpnNvCorrn1" /end COMPU_VTAB
/begin COMPU_METHOD MisfDet_idxThdMap_VERB "" TAB_VERB "%6.3" "" COMPU_TAB_REF MisfDet_idxThdMap_VERB /end COMPU_METHOD
/begin COMPU_VTAB MisfDet_idxThdMap_VERB "" TAB_VERB 23 0 "PtOpen" 1 "PtSlip" 12 "IdleStrat" 13 "IdleLamSplit" 14 "IdleStdPfltRgn" 15 "IdleAltvPosn" 16 "IdleThermCoorn" 17 "IdleCatWrm" 18 "IdleCatHeat" 19 "IdleAltvPfltRgn" 20 "IdleAltvPosnLamSplit" 21 "EclOpen" 2 "PtGrip" 3 "Hem" 4 "DrvStrat" 5 "DrvCatHeatOpen" 6 "DrvCatHeatSlip" 7 "DrvCatHeatGrip" 8 "PfltRgnPtOpen" 9 "PfltRgnPtSlip" 10 "PfltRgnPtGrip" 11 "Idle" 22 "EclSlip" /end COMPU_VTAB
/begin COMPU_METHOD MoCCom_stCheckState_Compu "" TAB_VERB "%6.3" "" COMPU_TAB_REF MoCCom_stCheckState_Compu /end COMPU_METHOD
/begin COMPU_VTAB MoCCom_stCheckState_Compu "" TAB_VERB 8 0 "MOCCOM_CO_COR_IN_TIME_AND_VALUE_1" 1 "MOCCOM_CO_COR_IN_TIME_AND_VALUE_2" 2 "MOCCOM_CO_TOO_EARLY" 3 "MOCCOM_CO_COR_IN_TIME_AND_VALUE_3" 4 "MOCCOM_CO_TOO_LATE" 5 "MOCCOM_CO_COR_IN_TIME_AND_VALUE_4A" 6 "MOCCOM_CO_COR_IN_TIME_AND_VALUE_4B" 7 "MOCCOM_CO_COR_IN_TIME_INC_IN_VALUE" /end COMPU_VTAB
/begin COMPU_METHOD MoCCom_stComState_Compu "" TAB_VERB "%6.3" "" COMPU_TAB_REF MoCCom_stComState_Compu /end COMPU_METHOD
/begin COMPU_VTAB MoCCom_stComState_Compu "" TAB_VERB 3 0 "MOCCOM_CO_SYNCHRONIZING" 1 "MOCCOM_CO_RECEIVING_QUERY" 2 "MOCCOM_CO_SENDING_RESP" /end COMPU_VTAB
/begin COMPU_METHOD MoCSOP_stCANFrTestState_mp_Compu "" TAB_VERB "%6.3" "" COMPU_TAB_REF MoCSOP_stCANFrTestState_mp_Compu /end COMPU_METHOD
/begin COMPU_VTAB MoCSOP_stCANFrTestState_mp_Compu "" TAB_VERB 13 0 "-" 1 "STEP_WAITFORPROTSTATE" 2 "STEP_WAITFORSTART" 3 "STEP_1" 4 "STEP_2" 5 "STEP_3" 6 "STEP_4" 7 "STEP_5" 8 "STEP_6" 9 "STEP_7" 10 "STEP_8" 11 "STEP_ERROR" 12 "STEP_FINISH" /end COMPU_VTAB
/begin COMPU_METHOD MoCSOP_stCheckStateCY329_mp_Compu "" TAB_VERB "%6.3" "" COMPU_TAB_REF MoCSOP_stCheckStateCY329_mp_Compu /end COMPU_METHOD
/begin COMPU_VTAB MoCSOP_stCheckStateCY329_mp_Compu "" TAB_VERB 19 0 "-" 1 "MOCSOP_CO_OUT_OF_DRIVE" 2 "MOCSOP_CO_POSITIVE_TEST_PREP" 3 "MOCSOP_CO_POSITIVE_TEST_DIA" 4 "MOCSOP_CO_WDA_TEST_PREP" 5 "MOCSOP_CO_WDA_TEST_DIA" 6 "MOCSOP_CO_MM2ERRSWITCH_TEST_PREP" 7 "MOCSOP_CO_MM2ERRSWITCH_TEST_DIA" 8 "MOCSOP_CO_ERRPIN_TEST_PREP" 9 "MOCSOP_CO_ERRPIN_TEST_DIA" 10 "MOCSOP_CO_ERR2WDASWITCH_TEST_PREP" 11 "MOCSOP_CO_ERR2WDASWITCH_TEST_DIA" 12 "MOCSOP_CO_OVERVOLTAGE_TEST_PREP" 13 "MOCSOP_CO_OVERVOLTAGE_TEST_DIA" 14 "MOCSOP_CO_POSITIVE_TEST_OVERVOLTAGE_PREP" 15 "MOCSOP_CO_POSITIVE_TEST_OVERVOLTAGE_DIA" 16 "MOCSOP_CO_ERR_CHECK" 17 "MOCSOP_CO_ERR_REACTION" 18 "MOCSOP_CO_TO_MOCCOM" /end COMPU_VTAB
/begin COMPU_METHOD MoCSOP_stEmmStateIFX_MP_Compu "" TAB_VERB "%6.3" "" COMPU_TAB_REF MoCSOP_stEmmStateIFX_MP_Compu /end COMPU_METHOD
/begin COMPU_VTAB MoCSOP_stEmmStateIFX_MP_Compu "" TAB_VERB 4 0 "SSM_START" 1 "SSM_RUN" 2 "SSM_FAULT" 32 "STATE_ERROR" /end COMPU_VTAB
/begin COMPU_METHOD MoCSOP_stErrPin_MP_Compu "" TAB_VERB "%6.3" "" COMPU_TAB_REF MoCSOP_stErrPin_MP_Compu /end COMPU_METHOD
/begin COMPU_VTAB MoCSOP_stErrPin_MP_Compu "" TAB_VERB 2 0 "ERRPIN_ACTIVE" 1 "ERRPIN_NOT_ACTIVE" /end COMPU_VTAB
/begin COMPU_METHOD MoCSOP_stErrReactnERPN_CA_Compu "" TAB_VERB "%6.3" "" COMPU_TAB_REF MoCSOP_stErrReactnERPN_CA_Compu /end COMPU_METHOD
/begin COMPU_VTAB MoCSOP_stErrReactnERPN_CA_Compu "" TAB_VERB 3 0 "MOCSOP_CO_REACTN_NORMAL_RUN" 1 "MOCSOP_CO_REACTN_ICO" 2 "MOCSOP_CO_REACTN_RESETLOOP" /end COMPU_VTAB
/begin COMPU_METHOD MoCSOP_stErrReactn_CA_Compu "" TAB_VERB "%6.3" "" COMPU_TAB_REF MoCSOP_stErrReactn_CA_Compu /end COMPU_METHOD
/begin COMPU_VTAB MoCSOP_stErrReactn_CA_Compu "" TAB_VERB 3 0 "MOCSOP_CO_REACTN_NORMAL_RUN" 1 "MOCSOP_CO_REACTN_ICO" 2 "MOCSOP_CO_REACTN_RESETLOOP" /end COMPU_VTAB
/begin COMPU_METHOD MoCSOP_stOVErrReactn_C_Compu "" TAB_VERB "%6.3" "" COMPU_TAB_REF MoCSOP_stOVErrReactn_C_Compu /end COMPU_METHOD
/begin COMPU_VTAB MoCSOP_stOVErrReactn_C_Compu "" TAB_VERB 2 1 "MOCSOP_CO_REACTN_ICO" 2 "MOCSOP_CO_REACTN_RESETLOOP" /end COMPU_VTAB
/begin COMPU_METHOD MoCSOP_Time_us "" RAT_FUNC "%6.2" "us" COEFFS 0 1 0 0 0 1 /end COMPU_METHOD
/begin COMPU_METHOD MoExe_Co_PFC_ID_Compu "" TAB_VERB "%6.3" "" COMPU_TAB_REF MoExe_Co_PFC_ID_Compu /end COMPU_METHOD
/begin COMPU_VTAB MoExe_Co_PFC_ID_Compu "" TAB_VERB 85 0 "-" 16777471 "MOCEMM_CO_REQERRPIN_ID_HW" 16777217 "MOCEMM_CO_REQERRPIN_ID_MOCMEM" 16777216 "MOCEMM_CO_REQERRPIN_ID_MOCCOM" 16777218 "MOCEMM_CO_REQERRPIN_ID_MOCSOP" 16777225 "MOCEMM_CO_REQERRPIN_ID_MOCADC" 16777220 "MOCEMM_CO_REQERRPIN_ID_MOFWDA" 16777219 "MOCEMM_CO_REQERRPIN_ID_MOCEMM" 16777221 "MOCEMM_CO_REQERRPIN_ID_OCWDATEST" 16777222 "MOCEMM_CO_REQERRPIN_ID_SWSHRL2" 16777223 "MOCEMM_CO_REQERRPIN_ID_MOCGTM" 16777224 "MOCEMM_CO_REQERRPIN_ID_MOCSCC" 16777226 "MOCEMM_CO_REQERRPIN_ID_MOCIWDH" 11 "MO_ADAP_PROC_CORE1_10MS_NR1_PFC_ID" 10 "MO_GLBL_PROC_CORE1_10MS_NR1_PFC_ID" 70 "MO_GLBL_PROC_MANYCORE_CORE1_10MS_NR1_PFC_ID" 2 "MOCADC_CO_PROC_CORE1_10MS_NR1_PFC_ID" 71 "MOCCOM_CO_PROC_CORE1_10MS_NR1_PFC_ID" 67 "MOCCPU_CO_PROC_CORE1_10MS_NR1_PFC_ID" 7 "MOCEMM_CO_PROC_CORE1_10MS_NR1_PFC_ID" 9 "MOCGTM_CO_PROC_CORE1_10MS_NR1_PFC_ID" 68 "MOCIWDH_CO_PROC_CORE1_10MS_NR1_PFC_ID" 5 "MOCMEM_CO_CHKCSA_PROC_CORE1_10MS_NR1_PFC_ID" 62 "MOCMEM_CO_CHKRAM_PROC_CORE1_10MS_NR1_PFC_ID" 8 "MOCMEM_CO_CHKROM_PROC_CORE1_10MS_NR1_PFC_ID" 4 "MOCMEM_CO_CHKSTCK_PROC_CORE1_10MS_NR1_PFC_ID" 64 "MOCMEM_CO_ERRHDL_PROC_CORE1_10MS_NR1_PFC_ID" 69 "MOCPFC_CO_IWDH_PROC_CORE1_10MS_NR1_PFC_ID" 66 "MOCPFC_CO_MANYCORE_PROC_CORE1_10MS_NR1_PFC_ID" 63 "MOCSCC_CO_PROC_CORE1_10MS_NR1_PFC_ID" 72 "MOCSOP_CO_PROC_CORE1_10MS_NR1_PFC_ID" 6 "MOCSOP_CO_PROC_10MS_CORE1_10MS_NR1_PFC_ID" 1 "MOEXE_CO_TASK_CTCYC_CORE1_TASK10MS_NR1_PFC_ID" 28 "MOFACC_CO_PROC_CORE1_10MS_NR1_PFC_ID" 49 "MOFAIR_FILGPRDC_PROC_CORE1_10MS_NR1_PFC_ID" 52 "MOFAIRFL_CTOFFPFI_PROC_CORE1_10MS_NR1_PFC_ID" 51 "MOFAIRFL_CYLPFI_PROC_CORE1_10MS_NR1_PFC_ID" 53 "MOFAIRFL_ETA_PROC_CORE1_10MS_NR1_PFC_ID" 47 "MOFAIRFL_IN_PROC_CORE1_10MS_NR1_PFC_ID" 50 "MOFAIRFL_MIXCTLPFI_PROC_CORE1_10MS_NR1_PFC_ID" 48 "MOFAIRFL_MODE_PROC_CORE1_10MS_NR1_PFC_ID" 20 "MOFAPP_CO_PROC_CORE1_10MS_NR1_PFC_ID" 21 "MOFAPP_REL_PROC_CORE1_10MS_NR1_PFC_ID" 19 "MOFBRK_CO_PROC_CORE1_10MS_NR1_PFC_ID" 27 "MOFCCTL_CO_PROC_CORE1_10MS_NR1_PFC_ID" 22 "MOFCLTH_CO_PROC_CORE1_10MS_NR1_PFC_ID" 42 "MOFCOVEH_CO_PROC_CORE1_10MS_NR1_PFC_ID" 29 "MOFDCS_CO_PROC_CORE1_10MS_NR1_PFC_ID" 31 "MOFDRAS_CO_PROC_CORE1_10MS_NR1_PFC_ID" 40 "MOFDRDEM_CO_PROC_CORE1_10MS_NR1_PFC_ID" 41 "MOFDRDEM_MIN_PROC_CORE1_10MS_NR1_PFC_ID" 39 "MOFDRVPRGSWT_CO_PROC_CORE1_10MS_NR1_PFC_ID" 17 "MOFESPD_CO_PROC_CORE1_10MS_NR1_PFC_ID" 32 "MOFETC_CO_PROC_CORE1_10MS_NR1_PFC_ID" 33 "MOFEXTINT_CO_PROC_CORE1_10MS_NR1_PFC_ID" 12 "MOFFRM_RX_PROC_CORE1_10MS_NR1_PFC_ID" 13 "MOFFRMCOORRCUST_RX_PROC_CORE1_10MS_NR1_PFC_ID" 16 "MOFHYBRX_CO_PROC_CORE1_10MS_NR1_PFC_ID" 54 "MOFIA_CO_PROC_CORE1_10MS_NR1_PFC_ID" 60 "MOFICO_CO_PROC_CORE1_10MS_NR1_PFC_ID" 15 "MOFIN_CO_PROC_CORE1_10MS_NR1_PFC_ID" 38 "MOFSPDG_CO_PROC_CORE1_10MS_NR1_PFC_ID" 35 "MOFSTRT_CO_PROC_CORE1_10MS_NR1_PFC_ID" 34 "MOFSTRT_IN_PROC_CORE1_10MS_NR1_PFC_ID" 36 "MOFSTRT_RLS_PROC_CORE1_10MS_NR1_PFC_ID" 25 "MOFTENG_CO_PROC_CORE1_10MS_NR1_PFC_ID" 30 "MOFTRA_CO_PROC_CORE1_10MS_NR1_PFC_ID" 55 "MOFTRQACT_ENG_PROC_CORE1_10MS_NR1_PFC_ID" 56 "MOFTRQACT_SUM_PROC_CORE1_10MS_NR1_PFC_ID" 57 "MOFTRQCMP_ENG_PROC_CORE1_10MS_NR1_PFC_ID" 58 "MOFTRQCMP_MAX_PROC_CORE1_10MS_NR1_PFC_ID" 59 "MOFTRQCMP_MIN_PROC_CORE1_10MS_NR1_PFC_ID" 37 "MOFTRQLIM_ENG_PROC_CORE1_10MS_NR1_PFC_ID" 26 "MOFTRQLOS_CO_PROC_CORE1_10MS_NR1_PFC_ID" 44 "MOFTRQPTD_EMAC_PROC_CORE1_10MS_NR1_PFC_ID" 45 "MOFTRQPTD_ENG_PROC_CORE1_10MS_NR1_PFC_ID" 43 "MOFTRQPTD_MAX_PROC_CORE1_10MS_NR1_PFC_ID" 46 "MOFTRQPTD_MIN_PROC_CORE1_10MS_NR1_PFC_ID" 24 "MOFTRQRAT_CO_PROC_CORE1_10MS_NR1_PFC_ID" 18 "MOFVAR_CO_PROC_CORE1_10MS_NR1_PFC_ID" 65 "MOFVAR_POSTBLDSEL_PROC_CORE1_10MS_NR1_PFC_ID" 14 "MOFVEHIFC_IFADP1_PROC_CORE1_10MS_NR1_PFC_ID" 23 "MOFVSS_CO_PROC_CORE1_10MS_NR1_PFC_ID" 61 "MOFWDA_CO_PROC_CORE1_10MS_NR1_PFC_ID" 3 "MOSYSCTRL_CO_PROC_CORE1_10MS_NR1_PFC_ID" /end COMPU_VTAB
/begin COMPU_METHOD nmot_q40 "" RAT_FUNC "%6.1" "1/min" COEFFS 0 1 0 0 0 40 /end COMPU_METHOD
/begin COMPU_METHOD nmot_uw_q0p25 "" RAT_FUNC "%6.3" "1/min" COEFFS 0 1 0 0 0 0.25 /end COMPU_METHOD
/begin COMPU_METHOD OneToOne "" RAT_FUNC "%6.2" "-" COEFFS 0 1 0 0 0 1 /end COMPU_METHOD
/begin COMPU_METHOD RBPtCel_ti_0p4_1 "" RAT_FUNC "%6.3" "us" COEFFS 0 5 0 0 0 2 /end COMPU_METHOD
/begin COMPU_METHOD rel_ub_b99p6 "" RAT_FUNC "%6.3" "%" COEFFS 0 256 0 0 0 100 /end COMPU_METHOD
/begin COMPU_METHOD rel_uw_b100 "" RAT_FUNC "%6.4" "%" COEFFS 0 65536 0 0 0 100 /end COMPU_METHOD
/begin COMPU_METHOD rel_uw_q0p0234 "" RAT_FUNC "%6.4" "%" COEFFS 0 32 0 0 0 0.75 /end COMPU_METHOD
/begin COMPU_METHOD spg_q0p00977 "" RAT_FUNC "%6.4" "V" COEFFS 0 256 0 0 0 2.5 /end COMPU_METHOD
/begin COMPU_METHOD spg_q4p88_mV "" RAT_FUNC "%6.2" "mV" COEFFS 0 1024 0 0 0 5000 /end COMPU_METHOD
/begin COMPU_METHOD SY_CACTP22_Compu "" TAB_VERB "%6.3" "" COMPU_TAB_REF SY_CACTP22_Compu /end COMPU_METHOD
/begin COMPU_VTAB SY_CACTP22_Compu "" TAB_VERB 7 0 "no sensor" 1 "TFA1" 2 "TFA2" 3 "TFA3" 4 "TFA4" 5 "TFA5" 6 "TFA6" /end COMPU_VTAB
/begin COMPU_METHOD SY_CANVAR_Compu "" TAB_VERB "%6.3" "" COMPU_TAB_REF SY_CANVAR_Compu /end COMPU_METHOD
/begin COMPU_VTAB SY_CANVAR_Compu "" TAB_VERB 10 0 "Ferrari CAN" 1 "Florence CAN I" 2 "Florence CAN" 3 "CAN 144" 4 "Florence CAN II" 5 "Powernet-CAN" 6 "Florence CAN II 2nd Vers" 7 "NextGen CAN" 8 "Dallara CAN" 9 "Florence CAN II 3rd Vers" /end COMPU_VTAB
/begin COMPU_METHOD SY_CATACT_Compu "" TAB_VERB "%6.3" "" COMPU_TAB_REF SY_CATACT_Compu /end COMPU_METHOD
/begin COMPU_VTAB SY_CATACT_Compu "" TAB_VERB 2 0 "False" 1 "True" /end COMPU_VTAB
/begin COMPU_METHOD SY_CFCEO_Compu "" TAB_VERB "%6.3" "" COMPU_TAB_REF SY_CFCEO_Compu /end COMPU_METHOD
/begin COMPU_VTAB SY_CFCEO_Compu "" TAB_VERB 2 0 "GasCapCheck_NotAvailable" 1 "GasCapCheck_Available" /end COMPU_VTAB
/begin COMPU_METHOD SY_CFMST_Compu "" TAB_VERB "%6.3" "" COMPU_TAB_REF SY_CFMST_Compu /end COMPU_METHOD
/begin COMPU_VTAB SY_CFMST_Compu "" TAB_VERB 2 0 "kein Throttle Stomp Clear Flood in Start" 1 "Throttle Stomp Clear Flood in Start vorhanden" /end COMPU_VTAB
/begin COMPU_METHOD SY_CHFCIML_Compu "" TAB_VERB "%6.3" "" COMPU_TAB_REF SY_CHFCIML_Compu /end COMPU_METHOD
/begin COMPU_VTAB SY_CHFCIML_Compu "" TAB_VERB 2 0 "SY_CHFCIML_FALSE" 1 "SY_CHFCIML_TRUE" /end COMPU_VTAB
/begin COMPU_METHOD SY_CHSPLMI_Compu "" TAB_VERB "%6.3" "" COMPU_TAB_REF SY_CHSPLMI_Compu /end COMPU_METHOD
/begin COMPU_VTAB SY_CHSPLMI_Compu "" TAB_VERB 2 0 "Direct definition of setpoint lambda" 1 "Definition by mixture lambda of exhaust gas" /end COMPU_VTAB
/begin COMPU_METHOD SY_CJ230_Compu "" TAB_VERB "%6.3" "" COMPU_TAB_REF SY_CJ230_Compu /end COMPU_METHOD
/begin COMPU_VTAB SY_CJ230_Compu "" TAB_VERB 4 0 "0 CJ230 Bauteine im Gerät verbaut" 1 "1 CJ230 Baustein im Gerät verbaut" 2 "2 CJ230 Bausteine im Gerät verbaut" 3 "3 CJ230 Bausteine im Gerät verbaut" /end COMPU_VTAB
/begin COMPU_METHOD SY_CJ840_Compu "" RAT_FUNC "%6.2" "" COEFFS 0 1 0 0 0 1 /end COMPU_METHOD
/begin COMPU_METHOD SY_CJ841_Compu "" TAB_VERB "%6.3" "" COMPU_TAB_REF SY_CJ841_Compu /end COMPU_METHOD
/begin COMPU_VTAB SY_CJ841_Compu "" TAB_VERB 3 0 "no CJ841" 1 "one CJ841" 2 "two CJ841" /end COMPU_VTAB
/begin COMPU_METHOD SY_CJ870_Compu "" TAB_VERB "%6.3" "" COMPU_TAB_REF SY_CJ870_Compu /end COMPU_METHOD
/begin COMPU_VTAB SY_CJ870_Compu "" TAB_VERB 3 0 "no CJ870" 1 "one CJ870" 2 "two CJ870" /end COMPU_VTAB
/begin COMPU_METHOD SY_CK200_Compu "" RAT_FUNC "%6.2" "" COEFFS 0 1 0 0 0 1 /end COMPU_METHOD
/begin COMPU_METHOD SY_CK240_Compu "" RAT_FUNC "%6.2" "" COEFFS 0 1 0 0 0 1 /end COMPU_METHOD
/begin COMPU_METHOD SY_CK260_Compu "" RAT_FUNC "%6.2" "" COEFFS 0 1 0 0 0 1 /end COMPU_METHOD
/begin COMPU_METHOD SY_CKA_Compu "" TAB_VERB "%6.3" "" COMPU_TAB_REF SY_CKA_Compu /end COMPU_METHOD
/begin COMPU_VTAB SY_CKA_Compu "" TAB_VERB 2 0 "chemisches Katalysatoraufheizen nicht möglich" 1 "chemisches Katalysatoraufheizen möglich" /end COMPU_VTAB
/begin COMPU_METHOD SY_CNG_Compu "" TAB_VERB "%6.3" "" COMPU_TAB_REF SY_CNG_Compu /end COMPU_METHOD
/begin COMPU_VTAB SY_CNG_Compu "" TAB_VERB 6 0 "Kein System mit CNG" 1 "System mit CNG" 2 "System mit CNG und EOBD" 3 "System mit CNG Fehlerpfade ASV1...5" 4 "System mit CNG Plattform" 5 "System with customer options on CNG platform" /end COMPU_VTAB
/begin COMPU_METHOD SY_COPOTI_Compu "" TAB_VERB "%6.3" "" COMPU_TAB_REF SY_COPOTI_Compu /end COMPU_METHOD
/begin COMPU_VTAB SY_COPOTI_Compu "" TAB_VERB 2 0 "kein CO-Poti vorhanden" 1 "CO-Poti vorhanden" /end COMPU_VTAB
/begin COMPU_METHOD SY_CPRDYL_Compu "" TAB_VERB "%6.3" "" COMPU_TAB_REF SY_CPRDYL_Compu /end COMPU_METHOD
/begin COMPU_VTAB SY_CPRDYL_Compu "" TAB_VERB 2 0 "No specific enrichment at high load dynamic avail." 1 "Specific enrichment at high load dynamic available" /end COMPU_VTAB
/begin COMPU_METHOD SY_CPRLAOX_Compu "" TAB_VERB "%6.3" "" COMPU_TAB_REF SY_CPRLAOX_Compu /end COMPU_METHOD
/begin COMPU_VTAB SY_CPRLAOX_Compu "" TAB_VERB 2 0 "No lower limit of enrichment by comp. protection" 1 "Lower limit of enrichment by comp. prot. possible" /end COMPU_VTAB
/begin COMPU_METHOD SY_CPRLG_Compu "" TAB_VERB "%6.3" "" COMPU_TAB_REF SY_CPRLG_Compu /end COMPU_METHOD
/begin COMPU_VTAB SY_CPRLG_Compu "" TAB_VERB 2 0 "No spec. enrichment at high load + low gear avail." 1 "Spec. enrichment at high load + low gear available" /end COMPU_VTAB
/begin COMPU_METHOD SY_CPRSCV_Compu "" TAB_VERB "%6.3" "" COMPU_TAB_REF SY_CPRSCV_Compu /end COMPU_METHOD
/begin COMPU_VTAB SY_CPRSCV_Compu "" TAB_VERB 2 0 "Enrichment independent of swirl control valve" 1 "Specific enrichment for high/low swirl" /end COMPU_VTAB
/begin COMPU_METHOD SY_CVT_Compu "" TAB_VERB "%6.3" "" COMPU_TAB_REF SY_CVT_Compu /end COMPU_METHOD
/begin COMPU_VTAB SY_CVT_Compu "" TAB_VERB 2 0 "no CVT Gear installed" 1 "CVT Gear installed" /end COMPU_VTAB
/begin COMPU_METHOD SY_D2CTRFLT_Compu "" RAT_FUNC "%6.2" "" COEFFS 0 1 0 0 0 1 /end COMPU_METHOD
/begin COMPU_METHOD SY_DAPRID_Compu "" TAB_VERB "%6.3" "" COMPU_TAB_REF SY_DAPRID_Compu /end COMPU_METHOD
/begin COMPU_VTAB SY_DAPRID_Compu "" TAB_VERB 11 0 "keine Zuordnung" 1 "ME 9.7 NGV" 2 "ME 17.7 UHP" 3 "MED 17.7.1 MoVE" 4 "MED 17.7.2 M270/M274" 5 "M276Desla" 6 "MED 17.7.4 M177/M178" 7 "ME17.7.20 M281 Smart" 8 "ME17.7.20 M281 REX" 9 "kein MED17 Projekt" 10 "MED17.7.7 M260/M264" /end COMPU_VTAB
/begin COMPU_METHOD SY_DCPVLRR_Compu "" TAB_VERB "%6.3" "" COMPU_TAB_REF SY_DCPVLRR_Compu /end COMPU_METHOD
/begin COMPU_VTAB SY_DCPVLRR_Compu "" TAB_VERB 2 0 "kein Lambdareglerreset nach DTEV" 1 "Lambdareglerreset aktiviert nach DTEV" /end COMPU_VTAB
/begin COMPU_METHOD SY_DCPVPAS_Compu "" TAB_VERB "%6.3" "" COMPU_TAB_REF SY_DCPVPAS_Compu /end COMPU_METHOD
/begin COMPU_VTAB SY_DCPVPAS_Compu "" TAB_VERB 2 0 "False" 1 "True" /end COMPU_VTAB
/begin COMPU_METHOD SY_DCPVSPL_Compu "" TAB_VERB "%6.3" "" COMPU_TAB_REF SY_DCPVSPL_Compu /end COMPU_METHOD
/begin COMPU_VTAB SY_DCPVSPL_Compu "" TAB_VERB 2 0 "False" 1 "True" /end COMPU_VTAB
/begin COMPU_METHOD SY_DCPV_Compu "" TAB_VERB "%6.3" "" COMPU_TAB_REF SY_DCPV_Compu /end COMPU_METHOD
/begin COMPU_VTAB SY_DCPV_Compu "" TAB_VERB 9 0 "00_No_CPV_Diag" 1 "01_DTEV_based" 2 "02_DTEV_wothout_PassiveCheck" 11 "11_Using_TankPSensor" 12 "12_TankPSensor_based+DTEV_Workshop_AddOn" 16 "16_CPV-check_with_DTESP" 21 "21_using_DMTL_pump" 22 "22_CPV_Diag_Selectable_DMTL_or_DTEV" 30 "30_CPV-check_with_cross_correlation" /end COMPU_VTAB
/begin COMPU_METHOD SY_DCV_Compu "" TAB_VERB "%6.3" "" COMPU_TAB_REF SY_DCV_Compu /end COMPU_METHOD
/begin COMPU_VTAB SY_DCV_Compu "" TAB_VERB 2 0 "Keine Diagnose Kurbelgehäuseentlüftung vorhanden" 1 "Diagnose Kurbelgehäuseentlüftung vorhanden" /end COMPU_VTAB
/begin COMPU_METHOD SY_DCYLIMB_Compu "" TAB_VERB "%6.3" "" COMPU_TAB_REF SY_DCYLIMB_Compu /end COMPU_METHOD
/begin COMPU_VTAB SY_DCYLIMB_Compu "" TAB_VERB 2 0 "SY_DCYLIMB_NO" 1 "SY_DCYLIMB_YES" /end COMPU_VTAB
/begin COMPU_METHOD SY_DDS2A3_Compu "" TAB_VERB "%6.3" "" COMPU_TAB_REF SY_DDS2A3_Compu /end COMPU_METHOD
/begin COMPU_VTAB SY_DDS2A3_Compu "" TAB_VERB 2 0 "PRES_SENS_INACTV" 1 "PRES_SENS_ACTV" /end COMPU_VTAB
/begin COMPU_METHOD SY_DDTLSFK_Compu "" TAB_VERB "%6.3" "" COMPU_TAB_REF SY_DDTLSFK_Compu /end COMPU_METHOD
/begin COMPU_VTAB SY_DDTLSFK_Compu "" TAB_VERB 2 0 "False" 1 "True" /end COMPU_VTAB
/begin COMPU_METHOD SY_DDTLSHK_Compu "" TAB_VERB "%6.3" "" COMPU_TAB_REF SY_DDTLSHK_Compu /end COMPU_METHOD
/begin COMPU_VTAB SY_DDTLSHK_Compu "" TAB_VERB 2 0 "False" 1 "True" /end COMPU_VTAB
/begin COMPU_METHOD SY_DEGFE_Compu "" TAB_VERB "%6.3" "" COMPU_TAB_REF SY_DEGFE_Compu /end COMPU_METHOD
/begin COMPU_VTAB SY_DEGFE_Compu "" TAB_VERB 5 0 "DiagWithoutMassFlowAdaption" 1 "DiagWithMassFlowAdaption" 2 "DiagWithMassFlowAdaptionPinPointing MAF" 3 "DiagWithMassFlowAdaptionPinPointing MAP" 4 "DiagWithMassFlowAdaptionPinPointingServiceDia MAP" /end COMPU_VTAB
/begin COMPU_METHOD SY_DESOK_Compu "" TAB_VERB "%6.3" "" COMPU_TAB_REF SY_DESOK_Compu /end COMPU_METHOD
/begin COMPU_VTAB SY_DESOK_Compu "" TAB_VERB 2 0 "shortened EOL-test unavailable" 1 "shortened EOL-test available" /end COMPU_VTAB
/begin COMPU_METHOD SY_DEVAL_Compu "" TAB_VERB "%6.3" "" COMPU_TAB_REF SY_DEVAL_Compu /end COMPU_METHOD
/begin COMPU_VTAB SY_DEVAL_Compu "" TAB_VERB 2 0 "disabled" 1 "enabled" /end COMPU_VTAB
/begin COMPU_METHOD SY_DFPMFFR_Compu "" TAB_VERB "%6.3" "" COMPU_TAB_REF SY_DFPMFFR_Compu /end COMPU_METHOD
/begin COMPU_VTAB SY_DFPMFFR_Compu "" TAB_VERB 2 0 "keine Unterstützung FFR Anforderung" 1 "Unterstützung FFR Anforderung" /end COMPU_VTAB
/begin COMPU_METHOD SY_DFRAVUE_Compu "" TAB_VERB "%6.3" "" COMPU_TAB_REF SY_DFRAVUE_Compu /end COMPU_METHOD
/begin COMPU_VTAB SY_DFRAVUE_Compu "" TAB_VERB 2 0 "False" 1 "True" /end COMPU_VTAB
/begin COMPU_METHOD SY_DFRST_Compu "" TAB_VERB "%6.3" "" COMPU_TAB_REF SY_DFRST_Compu /end COMPU_METHOD
/begin COMPU_VTAB SY_DFRST_Compu "" TAB_VERB 2 0 "False" 1 "True" /end COMPU_VTAB
/begin COMPU_METHOD SY_DHDEVOE_Compu "" TAB_VERB "%6.3" "" COMPU_TAB_REF SY_DHDEVOE_Compu /end COMPU_METHOD
/begin COMPU_VTAB SY_DHDEVOE_Compu "" TAB_VERB 2 0 "no_error_reaction" 1 "error_reaction" /end COMPU_VTAB
/begin COMPU_METHOD SY_DIGBT_Compu "" TAB_VERB "%6.3" "" COMPU_TAB_REF SY_DIGBT_Compu /end COMPU_METHOD
/begin COMPU_VTAB SY_DIGBT_Compu "" TAB_VERB 8 0 "0" 1 "1" 2 "2" 3 "3" 4 "4" 5 "5" 6 "6" 7 "7" /end COMPU_VTAB
/begin COMPU_METHOD SY_DIONDE_Compu "" TAB_VERB "%6.3" "" COMPU_TAB_REF SY_DIONDE_Compu /end COMPU_METHOD
/begin COMPU_VTAB SY_DIONDE_Compu "" TAB_VERB 2 0 "False" 1 "True" /end COMPU_VTAB
/begin COMPU_METHOD SY_DIRST_Compu "" TAB_VERB "%6.3" "" COMPU_TAB_REF SY_DIRST_Compu /end COMPU_METHOD
/begin COMPU_VTAB SY_DIRST_Compu "" TAB_VERB 4 0 "NO_DIRST" 1 "STARTER_SUP" 2 "NO_STARTER_SUP" 3 "STARTER_SRE" /end COMPU_VTAB
/begin COMPU_METHOD SY_DISDPLT_Compu "" TAB_VERB "%6.3" "" COMPU_TAB_REF SY_DISDPLT_Compu /end COMPU_METHOD
/begin COMPU_VTAB SY_DISDPLT_Compu "" TAB_VERB 2 0 "No diagnosis deactivation during very first start." 1 "Diagnosis deactivation during very first start." /end COMPU_VTAB
/begin COMPU_METHOD SY_DKATDPL_Compu "" TAB_VERB "%6.3" "" COMPU_TAB_REF SY_DKATDPL_Compu /end COMPU_METHOD
/begin COMPU_VTAB SY_DKATDPL_Compu "" TAB_VERB 2 0 "False" 1 "True" /end COMPU_VTAB
/begin COMPU_METHOD SY_DKATTE_Compu "" TAB_VERB "%6.3" "" COMPU_TAB_REF SY_DKATTE_Compu /end COMPU_METHOD
/begin COMPU_VTAB SY_DKATTE_Compu "" TAB_VERB 2 0 "False" 1 "True" /end COMPU_VTAB
/begin COMPU_METHOD SY_DKNOTVVT_Compu "" TAB_VERB "%6.3" "" COMPU_TAB_REF SY_DKNOTVVT_Compu /end COMPU_METHOD
/begin COMPU_VTAB SY_DKNOTVVT_Compu "" TAB_VERB 2 0 "False" 1 "True" /end COMPU_VTAB
/begin COMPU_METHOD SY_DKVFTAL_Compu "" TAB_VERB "%6.3" "" COMPU_TAB_REF SY_DKVFTAL_Compu /end COMPU_METHOD
/begin COMPU_VTAB SY_DKVFTAL_Compu "" TAB_VERB 2 0 "fuel mixture fault entries enabled" 1 "calculation of enabling fuel mixture fault entries" /end COMPU_VTAB
/begin COMPU_METHOD SY_DKVSCMB_Compu "" TAB_VERB "%6.3" "" COMPU_TAB_REF SY_DKVSCMB_Compu /end COMPU_METHOD
/begin COMPU_VTAB SY_DKVSCMB_Compu "" TAB_VERB 2 0 "False" 1 "True" /end COMPU_VTAB
/begin COMPU_METHOD SY_DKVSDFRM_Compu "" TAB_VERB "%6.3" "" COMPU_TAB_REF SY_DKVSDFRM_Compu /end COMPU_METHOD
/begin COMPU_VTAB SY_DKVSDFRM_Compu "" TAB_VERB 2 0 "False" 1 "True" /end COMPU_VTAB
/begin COMPU_METHOD SY_DKVSFFC_Compu "" TAB_VERB "%6.3" "" COMPU_TAB_REF SY_DKVSFFC_Compu /end COMPU_METHOD
/begin COMPU_VTAB SY_DKVSFFC_Compu "" TAB_VERB 2 0 "False" 1 "True" /end COMPU_VTAB
/begin COMPU_METHOD SY_DKVSSC_Compu "" TAB_VERB "%6.3" "" COMPU_TAB_REF SY_DKVSSC_Compu /end COMPU_METHOD
/begin COMPU_VTAB SY_DKVSSC_Compu "" TAB_VERB 2 0 "no similar conditions in DKVS" 1 "similar conditions in DKVS" /end COMPU_VTAB
/begin COMPU_METHOD SY_DLBTSZW_Compu "" TAB_VERB "%6.3" "" COMPU_TAB_REF SY_DLBTSZW_Compu /end COMPU_METHOD
/begin COMPU_VTAB SY_DLBTSZW_Compu "" TAB_VERB 2 0 "False" 1 "True" /end COMPU_VTAB
/begin COMPU_METHOD SY_DLDPATC_Compu "" TAB_VERB "%6.3" "" COMPU_TAB_REF SY_DLDPATC_Compu /end COMPU_METHOD
/begin COMPU_VTAB SY_DLDPATC_Compu "" TAB_VERB 2 0 "False" 1 "True" /end COMPU_VTAB
/begin COMPU_METHOD SY_DLDP_Compu "" TAB_VERB "%6.3" "" COMPU_TAB_REF SY_DLDP_Compu /end COMPU_METHOD
/begin COMPU_VTAB SY_DLDP_Compu "" TAB_VERB 2 0 "kein DLDP System" 1 "DLDP System" /end COMPU_VTAB
/begin COMPU_METHOD SY_DLLRNPL_Compu "" TAB_VERB "%6.3" "" COMPU_TAB_REF SY_DLLRNPL_Compu /end COMPU_METHOD
/begin COMPU_VTAB SY_DLLRNPL_Compu "" TAB_VERB 2 0 "False" 1 "True" /end COMPU_VTAB
/begin COMPU_METHOD SY_DLSHVTO_Compu "" TAB_VERB "%6.3" "" COMPU_TAB_REF SY_DLSHVTO_Compu /end COMPU_METHOD
/begin COMPU_VTAB SY_DLSHVTO_Compu "" TAB_VERB 2 0 "False" 1 "True" /end COMPU_VTAB
/begin COMPU_METHOD SY_DLSHV_Compu "" TAB_VERB "%6.3" "" COMPU_TAB_REF SY_DLSHV_Compu /end COMPU_METHOD
/begin COMPU_VTAB SY_DLSHV_Compu "" TAB_VERB 2 0 "keine Sonde-Vertauschung hinter Kat erkennbar" 1 "Sonde-Vertauschung hinter Kat erkennbar" /end COMPU_VTAB
/begin COMPU_METHOD SY_DLSUV_Compu "" TAB_VERB "%6.3" "" COMPU_TAB_REF SY_DLSUV_Compu /end COMPU_METHOD
/begin COMPU_VTAB SY_DLSUV_Compu "" TAB_VERB 2 0 "keine Lambdasondenvertauscherkennung vor KAT aktiv" 1 "Lambdasondenvertauscherkennung vor KAT aktiv" /end COMPU_VTAB
/begin COMPU_METHOD SY_DMDADAP_Compu "" TAB_VERB "%6.3" "" COMPU_TAB_REF SY_DMDADAP_Compu /end COMPU_METHOD
/begin COMPU_VTAB SY_DMDADAP_Compu "" TAB_VERB 3 0 "standard adaptation" 1 "adaptation with %DMDADAP" 2 "adaptation with %DMDSIC" /end COMPU_VTAB
/begin COMPU_METHOD SY_DMDATEH_Compu "" TAB_VERB "%6.3" "" COMPU_TAB_REF SY_DMDATEH_Compu /end COMPU_METHOD
/begin COMPU_VTAB SY_DMDATEH_Compu "" TAB_VERB 2 0 "disabled" 1 "enabled" /end COMPU_VTAB
/begin COMPU_METHOD SY_DMDBTGT_Compu "" TAB_VERB "%6.3" "" COMPU_TAB_REF SY_DMDBTGT_Compu /end COMPU_METHOD
/begin COMPU_VTAB SY_DMDBTGT_Compu "" TAB_VERB 2 0 "NO_DMD_GearTypeSpecificBaseThreshold" 1 "DMD_GearTypeSpecificBaseThreshold" /end COMPU_VTAB
/begin COMPU_METHOD SY_DMDCYLID_Compu "" TAB_VERB "%6.3" "" COMPU_TAB_REF SY_DMDCYLID_Compu /end COMPU_METHOD
/begin COMPU_VTAB SY_DMDCYLID_Compu "" TAB_VERB 2 0 "False" 1 "True" /end COMPU_VTAB
/begin COMPU_METHOD SY_DMDFCER_Compu "" TAB_VERB "%6.3" "" COMPU_TAB_REF SY_DMDFCER_Compu /end COMPU_METHOD
/begin COMPU_VTAB SY_DMDFCER_Compu "" TAB_VERB 2 0 "False" 1 "True" /end COMPU_VTAB
/begin COMPU_METHOD SY_DMDPAT_Compu "" TAB_VERB "%6.3" "" COMPU_TAB_REF SY_DMDPAT_Compu /end COMPU_METHOD
/begin COMPU_VTAB SY_DMDPAT_Compu "" TAB_VERB 5 0 "No algorithm is activated" 1 "Activates additional algorithm" 2 "Activates additional algorithm(plausability check)" 3 "pat_algo_wo_id" 4 "PatDetnByFrqEvln" /end COMPU_VTAB
/begin COMPU_METHOD SY_DMDSEGV_Compu "" TAB_VERB "%6.3" "" COMPU_TAB_REF SY_DMDSEGV_Compu /end COMPU_METHOD
/begin COMPU_VTAB SY_DMDSEGV_Compu "" TAB_VERB 2 0 "no switch over of misfire segment" 1 "switch over of misfire segment" /end COMPU_VTAB
/begin COMPU_METHOD SY_DMDSTQ_Compu "" RAT_FUNC "%6.2" "" COEFFS 0 1 0 0 0 1 /end COMPU_METHOD
/begin COMPU_METHOD SY_DMDTAL_Compu "" TAB_VERB "%6.3" "" COMPU_TAB_REF SY_DMDTAL_Compu /end COMPU_METHOD
/begin COMPU_VTAB SY_DMDTAL_Compu "" TAB_VERB 2 0 "keine Unterdrückung MIL an bei leerem Tank" 1 "Unterdrückung MIL an bei leerem Tank" /end COMPU_VTAB
/begin COMPU_METHOD SY_DMDZAG_Compu "" TAB_VERB "%6.3" "" COMPU_TAB_REF SY_DMDZAG_Compu /end COMPU_METHOD
/begin COMPU_VTAB SY_DMDZAG_Compu "" TAB_VERB 3 0 "Misfire generation with DMDZAG not available" 1 "Misfire generation with DMDZAG available, case 1" 2 "Misfire generation with DMDZAG available, case 2" /end COMPU_VTAB
/begin COMPU_METHOD SY_DMTL_Compu "" TAB_VERB "%6.3" "" COMPU_TAB_REF SY_DMTL_Compu /end COMPU_METHOD
/begin COMPU_VTAB SY_DMTL_Compu "" TAB_VERB 2 0 "DMTL_NotAvailable" 1 "DMTL_Available" /end COMPU_VTAB
/begin COMPU_METHOD SY_DNSTAT_Compu "" RAT_FUNC "%6.2" "" COEFFS 0 1 0 0 0 1 /end COMPU_METHOD
/begin COMPU_METHOD SY_DOPZW_Compu "" TAB_VERB "%6.3" "" COMPU_TAB_REF SY_DOPZW_Compu /end COMPU_METHOD
/begin COMPU_VTAB SY_DOPZW_Compu "" TAB_VERB 2 0 "keine doppelte Zündausgabe aktiv" 1 "doppelte Zündausgabe aktiv" /end COMPU_VTAB
/begin COMPU_METHOD SY_DPCS_Compu "" TAB_VERB "%6.3" "" COMPU_TAB_REF SY_DPCS_Compu /end COMPU_METHOD
/begin COMPU_VTAB SY_DPCS_Compu "" TAB_VERB 12 0 "no leak test" 11 "EONV stand alone" 21 "DMTL" 30 "NVLD" 36 "DLDP" 41 "DMTL with TEV-Check, DTEVP" 42 "DMTL with DMTL as pressure sensor" 43 "DMTL as pressure sensor" 46 "DTESK" 51 "DTESK, EONV (open gas cap, 1mm, 0.5mm)" 52 "DTESK, EONV (open gas cap, 0.5mm)" 53 "DTESK, EONV (both for 1mm)" /end COMPU_VTAB
/begin COMPU_METHOD SY_DPLTCWL_Compu "" TAB_VERB "%6.3" "" COMPU_TAB_REF SY_DPLTCWL_Compu /end COMPU_METHOD
/begin COMPU_VTAB SY_DPLTCWL_Compu "" TAB_VERB 3 0 "SY_DPLTCWL_0" 1 "SY_DPLTCWL_1" 2 "SY_DPLTCWL_2" /end COMPU_VTAB
/begin COMPU_METHOD SY_DSKVND_Compu "" TAB_VERB "%6.3" "" COMPU_TAB_REF SY_DSKVND_Compu /end COMPU_METHOD
/begin COMPU_VTAB SY_DSKVND_Compu "" TAB_VERB 2 0 "kein Kraftstoffniederdrucksensor vorhanden" 1 "Kraftstoffniederdrucksensor vorhanden" /end COMPU_VTAB
/begin COMPU_METHOD SY_DSKVRIN_Compu "" TAB_VERB "%6.3" "" COMPU_TAB_REF SY_DSKVRIN_Compu /end COMPU_METHOD
/begin COMPU_VTAB SY_DSKVRIN_Compu "" TAB_VERB 2 0 "False" 1 "True" /end COMPU_VTAB
/begin COMPU_METHOD t20ms_ub_b5100 "" RAT_FUNC "%7.2" "ms" COEFFS 0 1 0 0 0 20 /end COMPU_METHOD
/begin COMPU_METHOD Temp_Cels "" RAT_FUNC "%6.1" "deg C" COEFFS 0 10 2731.4 0 0 1 /end COMPU_METHOD
/begin COMPU_METHOD temp_ub_q0p75_o48 "" RAT_FUNC "%6.2" "Grad C" COEFFS 0 1 48 0 0 0.75 /end COMPU_METHOD
/begin COMPU_METHOD t_q0p1 "" RAT_FUNC "%6.3" "s" COEFFS 0 10 0 0 0 1 /end COMPU_METHOD
/begin COMPU_METHOD zw_sb_q0p75 "" RAT_FUNC "%6.3" "Grad KW" COEFFS 0 255 0 0 0 191.25 /end COMPU_METHOD
/begin COMPU_METHOD zw_ub_q0p75 "" RAT_FUNC "%6.3" "Grad KW" COEFFS 0 255 0 0 0 191.25 /end COMPU_METHOD
/begin COMPU_METHOD default "" RAT_FUNC "%6.2" "" COEFFS 0 1 0 0 0 1 /end COMPU_METHOD
/begin RECORD_LAYOUT Axis_Xu16 NO_AXIS_PTS_X 1 UWORD AXIS_PTS_X 2 UWORD INDEX_INCR DIRECT /end RECORD_LAYOUT
/begin RECORD_LAYOUT Axis_Xu8 NO_AXIS_PTS_X 1 UBYTE AXIS_PTS_X 2 UBYTE INDEX_INCR DIRECT /end RECORD_LAYOUT
/begin RECORD_LAYOUT MapG_Ws8 FNC_VALUES 1 SBYTE COLUMN_DIR DIRECT /end RECORD_LAYOUT
/begin RECORD_LAYOUT Mo_DataCurveSstU16WU8_Static NO_AXIS_PTS_X 1 UWORD AXIS_PTS_X 2 UWORD INDEX_INCR DIRECT FNC_VALUES 3 UBYTE COLUMN_DIR DIRECT STATIC_RECORD_LAYOUT /end RECORD_LAYOUT
/begin RECORD_LAYOUT RB_Axis_S16 NO_AXIS_PTS_X 1 SWORD AXIS_PTS_X 2 SWORD INDEX_INCR DIRECT /end RECORD_LAYOUT
/begin RECORD_LAYOUT RB_Axis_S8 NO_AXIS_PTS_X 1 SBYTE AXIS_PTS_X 2 SBYTE INDEX_INCR DIRECT /end RECORD_LAYOUT
/begin RECORD_LAYOUT RB_Axis_U16 NO_AXIS_PTS_X 1 UWORD AXIS_PTS_X 2 UWORD INDEX_INCR DIRECT /end RECORD_LAYOUT
/begin RECORD_LAYOUT RB_CurveGroup_S16 FNC_VALUES 1 SWORD COLUMN_DIR DIRECT /end RECORD_LAYOUT
/begin RECORD_LAYOUT RB_CurveGroup_U16 FNC_VALUES 1 UWORD COLUMN_DIR DIRECT /end RECORD_LAYOUT
/begin RECORD_LAYOUT RB_Curve_S16_S16 NO_AXIS_PTS_X 1 SWORD AXIS_PTS_X 2 SWORD INDEX_INCR DIRECT FNC_VALUES 3 SWORD COLUMN_DIR DIRECT /end RECORD_LAYOUT
/begin RECORD_LAYOUT RB_Curve_S16_U16_Static NO_AXIS_PTS_X 1 SWORD AXIS_PTS_X 2 SWORD INDEX_INCR DIRECT FNC_VALUES 3 UWORD COLUMN_DIR DIRECT STATIC_RECORD_LAYOUT /end RECORD_LAYOUT
/begin RECORD_LAYOUT RB_Curve_S16_U8_Static NO_AXIS_PTS_X 1 SWORD AXIS_PTS_X 2 SWORD INDEX_INCR DIRECT FNC_VALUES 3 UBYTE COLUMN_DIR DIRECT STATIC_RECORD_LAYOUT /end RECORD_LAYOUT
/begin RECORD_LAYOUT RB_Curve_U16_U16 NO_AXIS_PTS_X 1 UWORD AXIS_PTS_X 2 UWORD INDEX_INCR DIRECT FNC_VALUES 3 UWORD COLUMN_DIR DIRECT /end RECORD_LAYOUT
/begin RECORD_LAYOUT RB_MapGroup_S16 FNC_VALUES 1 SWORD COLUMN_DIR DIRECT /end RECORD_LAYOUT
/begin RECORD_LAYOUT RB_Map_S16U16_U8 NO_AXIS_PTS_X 1 SWORD NO_AXIS_PTS_Y 2 SWORD AXIS_PTS_X 3 SWORD INDEX_INCR DIRECT AXIS_PTS_Y 4 UWORD INDEX_INCR DIRECT FNC_VALUES 5 UBYTE ROW_DIR DIRECT /end RECORD_LAYOUT
/begin RECORD_LAYOUT RB_Map_U16S16_S16 NO_AXIS_PTS_X 1 UWORD NO_AXIS_PTS_Y 2 UWORD AXIS_PTS_X 3 UWORD INDEX_INCR DIRECT AXIS_PTS_Y 4 SWORD INDEX_INCR DIRECT FNC_VALUES 5 SWORD COLUMN_DIR DIRECT /end RECORD_LAYOUT
/begin RECORD_LAYOUT RB_ValA_Wu16 FNC_VALUES 1 UWORD COLUMN_DIR DIRECT /end RECORD_LAYOUT
/begin RECORD_LAYOUT RB_ValA_Wu32 FNC_VALUES 1 ULONG COLUMN_DIR DIRECT /end RECORD_LAYOUT
/begin RECORD_LAYOUT RB_ValA_Wu8 FNC_VALUES 1 UBYTE COLUMN_DIR DIRECT /end RECORD_LAYOUT
/begin RECORD_LAYOUT RB_Val_Ws16 FNC_VALUES 1 SWORD COLUMN_DIR DIRECT /end RECORD_LAYOUT
/begin RECORD_LAYOUT RB_Val_Ws8 FNC_VALUES 1 SBYTE COLUMN_DIR DIRECT /end RECORD_LAYOUT
/begin RECORD_LAYOUT RB_Val_Wu16 FNC_VALUES 1 UWORD COLUMN_DIR DIRECT /end RECORD_LAYOUT
/begin RECORD_LAYOUT RB_Val_Wu8 FNC_VALUES 1 UBYTE COLUMN_DIR DIRECT /end RECORD_LAYOUT
/begin RECORD_LAYOUT ValA_Wu16 FNC_VALUES 1 UWORD COLUMN_DIR DIRECT /end RECORD_LAYOUT
/begin RECORD_LAYOUT ValA_Wu32 FNC_VALUES 1 ULONG COLUMN_DIR DIRECT /end RECORD_LAYOUT
/begin RECORD_LAYOUT ValA_Wu8 FNC_VALUES 1 UBYTE COLUMN_DIR DIRECT /end RECORD_LAYOUT
/begin RECORD_LAYOUT Val_Ws16 FNC_VALUES 1 SWORD COLUMN_DIR DIRECT /end RECORD_LAYOUT
/begin RECORD_LAYOUT Val_Wu16 FNC_VALUES 1 UWORD COLUMN_DIR DIRECT /end RECORD_LAYOUT
/begin RECORD_LAYOUT Val_Wu8 FNC_VALUES 1 UBYTE COLUMN_DIR DIRECT /end RECORD_LAYOUT
/end MODULE
/end PROJECT
