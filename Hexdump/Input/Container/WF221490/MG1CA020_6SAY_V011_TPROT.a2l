ASAP2_VERSION 1 60
/begin PROJECT MG1CA020 "MG1CA020"
/begin HEADER "" VERSION "MG1CA020_6SAY_V011_TPROT" PROJECT_NO MG1CA020 /end HEADER
/begin MODULE DIM ""
/begin MOD_COMMON "" BYTE_ORDER MSB_LAST ALIGNMENT_BYTE 1 ALIGNMENT_WORD 2 ALIGNMENT_LONG 4 ALIGNMENT_INT64 4 ALIGNMENT_FLOAT32_IEEE 4 ALIGNMENT_FLOAT64_IEEE 4 DATA_SIZE 32 /end MOD_COMMON
/begin CHARACTERISTIC Com_bDigMtrUnit_C "Default value for Speed Meter display unit in case of frame error" VALUE 0x8051C212 Val_Wu8 1.000 OneToOne 0.00 1.000 FORMAT "%5.3" EXTENDED_LIMITS 0.00 255.0 /end CHARACTERISTIC
/begin CHARACTERISTIC Com_ctCRingMETE2_C "Default application value for Com_ctCRingMETE2 in case of defective reception" VALUE 0x8051C20A RB_Val_Wu8 255.0 OneToOne 0.00 255.0 FORMAT "%5.1" /end CHARACTERISTIC
/begin CHARACTERISTIC Com_ctCRingMETG_C "The message counter for METG frame" VALUE 0x8051C21E RB_Val_Wu8 3.000 OneToOne 0.00 3.000 FORMAT "%5.3" EXTENDED_LIMITS 0.00 255.0 /end CHARACTERISTIC
/begin CHARACTERISTIC Com_ctCRingMETH2_C "Default Calibration for Ring Counter of METH2 Frame" VALUE 0x8051C228 RB_Val_Wu8 3.000 OneToOne 0.00 3.000 FORMAT "%5.3" EXTENDED_LIMITS 0.00 255.0 /end CHARACTERISTIC
/begin CHARACTERISTIC Com_ctCRingMETM_C "Default application value for Com_ctCRingMETM in case of defective reception" VALUE 0x8051C242 RB_Val_Wu8 3.000 OneToOne 0.00 3.000 FORMAT "%5.3" EXTENDED_LIMITS 0.00 255.0 /end CHARACTERISTIC
/begin CHARACTERISTIC Com_ctCRingMETN_C "Default application value for Com_ctCRingMETN in case of defective reception" VALUE 0x8051C248 RB_Val_Wu8 3.000 OneToOne 0.00 3.000 FORMAT "%5.3" EXTENDED_LIMITS 0.00 255.0 /end CHARACTERISTIC
/begin CHARACTERISTIC Com_dEBBAMaxDiff_C "Maximal allowed difference between two consecutive message counter values for CAN frame EBBA for detection of jumping message counter" VALUE 0x8051C24E RB_Val_Wu8 255.0 OneToOne 0.00 255.0 FORMAT "%5.1" /end CHARACTERISTIC
/begin CHARACTERISTIC Com_dEBBAMaxPer_C "Threshold for detection of stopped message counter for CAN frame EBBA" VALUE 0x8051C24F RB_Val_Wu8 255.0 OneToOne 0.00 255.0 FORMAT "%5.1" /end CHARACTERISTIC
/begin CHARACTERISTIC Com_dMETAMaxDiff_C "Maximum difference between 2 message counters of META for error detection" VALUE 0x8051C1F8 RB_Val_Wu8 255.0 OneToOne 0.00 255.0 FORMAT "%5.1" /end CHARACTERISTIC
/begin CHARACTERISTIC Com_dMETAMaxPer_C "Maximum value of period for detection of META stopped message counter" VALUE 0x8051C1F9 RB_Val_Wu8 255.0 OneToOne 0.00 255.0 FORMAT "%5.1" /end CHARACTERISTIC
/begin CHARACTERISTIC Com_dMETASigSel_C "Signal selection data for META frame" VALUE 0x8051C1FA RB_Val_Wu8 255.0 OneToOne 0.00 255.0 FORMAT "%5.1" /end CHARACTERISTIC
/begin CHARACTERISTIC Com_dMETCMaxDiff_C "Application value for the maximum allowed difference between the values of the message conter of two consecutive frames" VALUE 0x8051C1FE RB_Val_Wu8 255.0 OneToOne 0.00 255.0 FORMAT "%5.1" /end CHARACTERISTIC
/begin CHARACTERISTIC Com_dMETCMaxPer_C "Application value for the maximum number of times the same value for the message counter may be received" VALUE 0x8051C1FF RB_Val_Wu8 255.0 OneToOne 0.00 255.0 FORMAT "%5.1" /end CHARACTERISTIC
/begin CHARACTERISTIC Com_dMETCSigSel_C "Signal selection data for METC frame" VALUE 0x8051C200 RB_Val_Wu8 255.0 OneToOne 0.00 255.0 FORMAT "%5.1" /end CHARACTERISTIC
/begin CHARACTERISTIC Com_dMETDMaxDiff_C "Application value for the maximum allowed difference between the values of the message conter of two consecutive METD frames" VALUE 0x8051C204 RB_Val_Wu8 255.0 OneToOne 0.00 255.0 FORMAT "%5.1" /end CHARACTERISTIC
/begin CHARACTERISTIC Com_dMETDMaxPer_C "Application value for the maximum number of times the same value for the message counter may be received" VALUE 0x8051C205 RB_Val_Wu8 255.0 OneToOne 0.00 255.0 FORMAT "%5.1" /end CHARACTERISTIC
/begin CHARACTERISTIC Com_dMETE2MaxDiff_C "Application constant for Maximum difference between the counter values for METE2 frame" VALUE 0x8051C20B RB_Val_Wu8 255.0 OneToOne 0.00 255.0 FORMAT "%5.1" /end CHARACTERISTIC
/begin CHARACTERISTIC Com_dMETE2MaxPer_C "Period for METE2 frame." VALUE 0x8051C20C RB_Val_Wu8 255.0 OneToOne 0.00 255.0 FORMAT "%5.1" /end CHARACTERISTIC
/begin CHARACTERISTIC Com_dMETFMaxDiff_C "Application constant for Maximum difference for METF frame" VALUE 0x8051C213 Val_Wu8 255.0 OneToOne 0.00 255.0 FORMAT "%5.1" /end CHARACTERISTIC
/begin CHARACTERISTIC Com_dMETFMaxPer_C "Threshold for detection of stopped message counter for CAN frame METF" VALUE 0x8051C214 Val_Wu8 255.0 OneToOne 0.00 255.0 FORMAT "%5.1" /end CHARACTERISTIC
/begin CHARACTERISTIC Com_dMETGMaxDiff_C "Application constant for Maximum difference for METG frame" VALUE 0x8051C21F RB_Val_Wu8 255.0 OneToOne 0.00 255.0 FORMAT "%5.1" /end CHARACTERISTIC
/begin CHARACTERISTIC Com_dMETGMaxPer_C "Threshold for detection of stopped message counter for CAN frame METG" VALUE 0x8051C220 RB_Val_Wu8 255.0 OneToOne 0.00 255.0 FORMAT "%5.1" /end CHARACTERISTIC
/begin CHARACTERISTIC Com_dMETH2MaxDiff_C "Application constant for Maximum difference for METH2 frame." VALUE 0x8051C229 RB_Val_Wu8 255.0 OneToOne 0.00 255.0 FORMAT "%5.1" /end CHARACTERISTIC
/begin CHARACTERISTIC Com_dMETH2MaxPer_C "Threshold for detection of stopped message counter for CAN frame METH2" VALUE 0x8051C22A RB_Val_Wu8 255.0 OneToOne 0.00 255.0 FORMAT "%5.1" /end CHARACTERISTIC
/begin CHARACTERISTIC Com_dMETH2SigSel_C "Signal selection data for METH2 frame" VALUE 0x8051C22B RB_Val_Wu8 255.0 OneToOne 0.00 255.0 FORMAT "%5.1" /end CHARACTERISTIC
/begin CHARACTERISTIC Com_dMETHMaxDiff_C "Application constant for Maximum difference for METH frame." VALUE 0x8051C224 RB_Val_Wu8 255.0 OneToOne 0.00 255.0 FORMAT "%5.1" /end CHARACTERISTIC
/begin CHARACTERISTIC Com_dMETHMaxPer_C "Threshold for detection of stopped message counter for CAN frame METH." VALUE 0x8051C225 RB_Val_Wu8 255.0 OneToOne 0.00 255.0 FORMAT "%5.1" /end CHARACTERISTIC
/begin CHARACTERISTIC Com_dMETIMaxDiff_C "Application constant for Maximum difference between the counter values for METI frame." VALUE 0x8051C232 RB_Val_Wu8 255.0 OneToOne 0.00 255.0 FORMAT "%5.1" /end CHARACTERISTIC
/begin CHARACTERISTIC Com_dMETIMaxPer_C "Period for METI frame." VALUE 0x8051C233 RB_Val_Wu8 255.0 OneToOne 0.00 255.0 FORMAT "%5.1" /end CHARACTERISTIC
/begin CHARACTERISTIC Com_dMETISigSel_C "Signal selection data for METI frame" VALUE 0x8051C234 RB_Val_Wu8 255.0 OneToOne 0.00 255.0 FORMAT "%5.1" /end CHARACTERISTIC
/begin CHARACTERISTIC Com_dMETKMaxDiff_C "Maximum difference between 2 message counters of METK for error detection" VALUE 0x8051C238 RB_Val_Wu8 255.0 OneToOne 0.00 255.0 FORMAT "%5.1" /end CHARACTERISTIC
/begin CHARACTERISTIC Com_dMETKMaxPer_C "Maximum value of period for detection of METK stopped message counter" VALUE 0x8051C239 RB_Val_Wu8 255.0 OneToOne 0.00 255.0 FORMAT "%5.1" /end CHARACTERISTIC
/begin CHARACTERISTIC Com_dMETKSigSel_C "Signal selection data for METK frame" VALUE 0x8051C23A RB_Val_Wu8 255.0 OneToOne 0.00 255.0 FORMAT "%5.1" /end CHARACTERISTIC
/begin CHARACTERISTIC Com_dMETLMaxDiff_C "Maximum difference between 2 message counters of METL for error detection" VALUE 0x8051C240 RB_Val_Wu8 255.0 OneToOne 0.00 255.0 FORMAT "%5.1" /end CHARACTERISTIC
/begin CHARACTERISTIC Com_dMETLMaxPer_C "Maximum value of period for detection of METL stopped message counter" VALUE 0x8051C241 RB_Val_Wu8 255.0 OneToOne 0.00 255.0 FORMAT "%5.1" /end CHARACTERISTIC
/begin CHARACTERISTIC Com_dMETMMaxDiff_C "Application constant for Maximum difference between the counter values for METM frame" VALUE 0x8051C243 RB_Val_Wu8 255.0 OneToOne 0.00 255.0 FORMAT "%5.1" /end CHARACTERISTIC
/begin CHARACTERISTIC Com_dMETMMaxPer_C "Period for METM frame" VALUE 0x8051C244 RB_Val_Wu8 255.0 OneToOne 0.00 255.0 FORMAT "%5.1" /end CHARACTERISTIC
/begin CHARACTERISTIC Com_dMETNMaxDiff_C "Application constant for Maximum difference between the counter values for METN frame" VALUE 0x8051C249 RB_Val_Wu8 255.0 OneToOne 0.00 255.0 FORMAT "%5.1" /end CHARACTERISTIC
/begin CHARACTERISTIC Com_dMETNMaxPer_C "Period for METN frame" VALUE 0x8051C24A RB_Val_Wu8 255.0 OneToOne 0.00 255.0 FORMAT "%5.1" /end CHARACTERISTIC
/begin CHARACTERISTIC Com_lDstMETK_C "Calibration for Coverage distance" VALUE 0x8051C23C RB_Val_Ws32 16777215.0000 OilMlg 0.00 16777215.0000 FORMAT "%13.4" EXTENDED_LIMITS -2147483648.00 2147483647.00 /end CHARACTERISTIC
/begin CHARACTERISTIC Com_nrActPtcActv_C "Calibartion for Actual number of activated PTC elements" VALUE 0x8051C22C RB_Val_Wu8 15.00 OneToOne 0.00 15.00 FORMAT "%5.2" EXTENDED_LIMITS 0.00 255.0 /end CHARACTERISTIC
/begin CHARACTERISTIC Com_numCsumMETA_C "Checksum calibration for META" VALUE 0x8051C1FB RB_Val_Wu8 15.00 OneToOne 0.00 15.00 FORMAT "%5.2" EXTENDED_LIMITS 0.00 255.0 /end CHARACTERISTIC
/begin CHARACTERISTIC Com_numCsumMETD_C "Default value for Checksum message for METD frame in case of error" VALUE 0x8051C206 RB_Val_Wu8 15.00 OneToOne 0.00 15.00 FORMAT "%5.2" EXTENDED_LIMITS 0.00 255.0 /end CHARACTERISTIC
/begin CHARACTERISTIC Com_numCsumMETE2_C "Default application value for Com_numCsumMETE2 in case of defective reception." VALUE 0x8051C20D RB_Val_Wu8 255.0 OneToOne 0.00 255.0 FORMAT "%5.1" /end CHARACTERISTIC
/begin CHARACTERISTIC Com_numCsumMETF_C "Default value for Check sum of METF frame in case of frame error" VALUE 0x8051C215 Val_Wu8 15.00 OneToOne 0.00 15.00 FORMAT "%5.2" EXTENDED_LIMITS 0.00 255.0 /end CHARACTERISTIC
/begin CHARACTERISTIC Com_numCsumMETG_C "Checksum calibration for METG" VALUE 0x8051C221 RB_Val_Wu8 15.00 OneToOne 0.00 15.00 FORMAT "%5.2" EXTENDED_LIMITS 0.00 255.0 /end CHARACTERISTIC
/begin CHARACTERISTIC Com_numCsumMETH2_C "Default Calibration for Checksum of METH2 Frame" VALUE 0x8051C22D RB_Val_Wu8 15.00 OneToOne 0.00 15.00 FORMAT "%5.2" EXTENDED_LIMITS 0.00 255.0 /end CHARACTERISTIC
/begin CHARACTERISTIC Com_numCsumMETH_C "Checksum calibration for METH frame." VALUE 0x8051C226 RB_Val_Wu8 15.00 OneToOne 0.00 15.00 FORMAT "%5.2" EXTENDED_LIMITS 0.00 255.0 /end CHARACTERISTIC
/begin CHARACTERISTIC Com_numCsumMETM_C "Default application value for Com_numCsumMETM in case of defective reception" VALUE 0x8051C245 RB_Val_Wu8 15.00 OneToOne 0.00 15.00 FORMAT "%5.2" EXTENDED_LIMITS 0.00 255.0 /end CHARACTERISTIC
/begin CHARACTERISTIC Com_numCsumMETN_C "Default application value for Com_numCsumMETN in case of defective reception" VALUE 0x8051C24B RB_Val_Wu8 15.00 OneToOne 0.00 15.00 FORMAT "%5.2" EXTENDED_LIMITS 0.00 255.0 /end CHARACTERISTIC
/begin CHARACTERISTIC Com_stACCut_C "Default value for air conditioner status of METG frame in case of frame error" VALUE 0x8051C222 RB_Val_Wu8 7.000 OneToOne 0.00 7.000 FORMAT "%5.3" EXTENDED_LIMITS 0.00 255.0 /end CHARACTERISTIC
/begin CHARACTERISTIC Com_stACGUpReq_C "Default calibration for Com_stACGUpReq" VALUE 0x8051C22E RB_Val_Wu8 1.000 OneToOne 0.00 1.000 FORMAT "%5.3" EXTENDED_LIMITS 0.00 255.0 /end CHARACTERISTIC
/begin CHARACTERISTIC Com_stBattOTAReq_C "Calibration for status of OTA operation" VALUE 0x8051C22F RB_Val_Wu8 1.000 OneToOne 0.00 1.000 FORMAT "%5.3" EXTENDED_LIMITS 0.00 255.0 /end CHARACTERISTIC
/begin CHARACTERISTIC Com_stECON_C "Default value for Com_stECON , when error is reported" VALUE 0x8051C207 RB_Val_Wu8 1.000 OneToOne 0.00 1.000 FORMAT "%5.3" EXTENDED_LIMITS 0.00 255.0 /end CHARACTERISTIC
/begin CHARACTERISTIC Com_stMtrCustDftReq_C "default value of Meter request" VALUE 0x8051C246 RB_Val_Wu8 255.0 OneToOne 0.00 255.0 FORMAT "%5.1" /end CHARACTERISTIC
/begin CHARACTERISTIC Com_stMtrCustStReq_C "Default value Calibration parameter for Com_stMtrCustStReq message" VALUE 0x8051C247 RB_Val_Wu8 255.0 OneToOne 0.00 255.0 FORMAT "%5.1" /end CHARACTERISTIC
/begin CHARACTERISTIC Com_stTarSpdDisp_C "Target Speed Display" VALUE 0x8051C216 Val_Wu8 1.000 OneToOne 0.00 1.000 FORMAT "%5.3" EXTENDED_LIMITS 0.00 255.0 /end CHARACTERISTIC
/begin CHARACTERISTIC Com_swtMETAMonEna_C "META error monitoring enable switch" VALUE 0x8051C1FC RB_Val_Wu8 255.0 OneToOne 0.00 255.0 FORMAT "%5.1" /end CHARACTERISTIC
/begin CHARACTERISTIC Com_swtMETDMonFrmSel_C "METD and METD2 frame selection switch" VALUE 0x8053AD40 Val_Wu8 1.000 OneToOne 0.00 1.000 FORMAT "%5.3" EXTENDED_LIMITS 0.00 255.0 /end CHARACTERISTIC
/begin CHARACTERISTIC Com_swtMETFMonEna_C "METF error monitoring enable switch" VALUE 0x8051C217 Val_Wu8 255.0 OneToOne 0.00 255.0 FORMAT "%5.1" /end CHARACTERISTIC
/begin CHARACTERISTIC Com_swtMETHMonEna_C "METH error monitoring enable switch" VALUE 0x8051C227 RB_Val_Wu8 255.0 OneToOne 0.00 255.0 FORMAT "%5.1" /end CHARACTERISTIC
/begin CHARACTERISTIC Com_tACAirTOut_C "Calibration for METER_AC_Out Air Temperature" VALUE 0x8051C230 RB_Val_Wu8 127.5 temp_q0p5_o30_degC -30.00 97.50 FORMAT "%5.2" /end CHARACTERISTIC
/begin CHARACTERISTIC Com_tACMtrEvaInfo_C "AC EVA temperature information calibration" VALUE 0x8051C24C RB_Val_Wu8 127.5 temp_q0p5_o30_degC -30.00 97.50 FORMAT "%5.2" /end CHARACTERISTIC
/begin CHARACTERISTIC Com_tAirInsdCbn_C "Default application value for Com_tAirInsdCbn in case of defective reception." VALUE 0x8051C20E RB_Val_Ws16 255. Com_EvaTemp_Compu -30. 225. FORMAT "%2.0" EXTENDED_LIMITS -32798. 32737. /end CHARACTERISTIC
/begin CHARACTERISTIC Com_tiISSPrms_C "Default value Idle Stop Persmission time" VALUE 0x8051C208 RB_Val_Wu8 240.0 Time_sec_q1_COMPU 0.00 240.0 FORMAT "%5.1" EXTENDED_LIMITS 0.00 255.0 /end CHARACTERISTIC
/begin CHARACTERISTIC Com_tMETE2AirOutside_C "Default application value for Com_tMETE2AirOutside in case of defective reception." VALUE 0x8051C210 RB_Val_Ws16 102.0000 Temp_Cels -40.04000 61.96000 FORMAT "%8.5" EXTENDED_LIMITS -3549.940 3003.560 /end CHARACTERISTIC
/begin CHARACTERISTIC Com_tOutd_C "Outside air temperature Calibration" VALUE 0x8051C202 RB_Val_Ws16 102.0000 Temp_Cels -40.04000 61.96000 FORMAT "%8.5" EXTENDED_LIMITS -3549.940 3003.560 /end CHARACTERISTIC
/begin CHARACTERISTIC Com_vAnaVeh_C "Default value for Meter display speed in case of frame error'" VALUE 0x8051C218 Val_Wu16 655.3500 Vel 0.00 655.3500 FORMAT "%8.4" /end CHARACTERISTIC
/begin CHARACTERISTIC Com_vDigVehRaw_C "Default value for Speed Meter display target value(Raw Value) in case of frame error'" VALUE 0x8051C21A Val_Wu16 655.3500 Vel 0.00 655.3500 FORMAT "%8.4" /end CHARACTERISTIC
/begin CHARACTERISTIC Com_vDigVeh_C "Default value for Digital Speed Meter display target value(Hysteresis processing value for display) in case of frame error'" VALUE 0x8051C21C Val_Wu8 255.0 OneToOne 0.00 255.0 FORMAT "%5.1" /end CHARACTERISTIC
/begin CHARACTERISTIC CstrPurg_nrTestPls_C "number of test pulses per driving cycle" VALUE 0x8051C12C RB_Val_Wu32 4294967295.00 dez 0.00 4294967295.00 FORMAT "%13.2" /end CHARACTERISTIC
/begin CHARACTERISTIC CstrPurg_stDiagCpvCCSeln_C "Code word to select which purge line or Bank are using a cross correlation based algorithm" VALUE 0x8051C126 RB_Val_Wu8 255.0 OneToOne 0.00 255.0 FORMAT "%5.1" /end CHARACTERISTIC
/begin CHARACTERISTIC CstrPurg_stDiagCpvDmtlSeln_C "Code word to select which purge line or Bank are using a DMTL based algorithm" VALUE 0x8051C127 RB_Val_Wu8 255.0 OneToOne 0.00 255.0 FORMAT "%5.1" /end CHARACTERISTIC
/begin CHARACTERISTIC CstrPurg_stDiagCpvDteskSeln_C "Code word to select which purge line or Bank are using a DTESK based algorithm" VALUE 0x8051C128 RB_Val_Wu8 255.0 OneToOne 0.00 255.0 FORMAT "%5.1" /end CHARACTERISTIC
/begin CHARACTERISTIC CstrPurg_stDiagCpvPsnsrSeln_C "Code word to select which purge line or Bank are using a pressure sensor based algorithm" VALUE 0x8051C129 RB_Val_Wu8 255.0 OneToOne 0.00 255.0 FORMAT "%5.1" /end CHARACTERISTIC
/begin CHARACTERISTIC CstrPurg_tiBtwPlsElecErr_C "time between to test pulses to detect an electrical error of the CPV" VALUE 0x8051C130 RB_Val_Ws16 655350.0 t_q10_ms -327680.0 327670.0 FORMAT "%8.1" /end CHARACTERISTIC
/begin CHARACTERISTIC CstrPurg_tiBtwPlsOverT_C "time between to test pulses to detect an overtemperature error of the CPV" VALUE 0x8051C132 RB_Val_Ws16 655.3500 t_q0p01 -327.6800 327.6700 FORMAT "%8.4" /end CHARACTERISTIC
/begin CHARACTERISTIC CstrPurg_tiDlyElecDiag_C "Delay time to enable CPV electrical diagnosis" VALUE 0x8051C134 RB_Val_Wu8 25.50 t_q0p1 0.00 25.50 FORMAT "%5.2" /end CHARACTERISTIC
/begin CHARACTERISTIC CWPSTEVE "code word for shutdown of output-stage diagnosis" VALUE 0x8051C135 RB_Val_Wu8 255.0 dez 0.00 255.0 FORMAT "%5.1" /end CHARACTERISTIC
/begin CHARACTERISTIC DTR_OBDMID.DTR_OBDMID_01_TID_DTLTR_C "" VALUE 0x804EE578 Val_Wu8 255.0 DFC_OneToOne 0.00 255.0 FORMAT "%5.1" /end CHARACTERISTIC
/begin CHARACTERISTIC DTR_OBDMID.DTR_OBDMID_01_TID_DTRTL_C "" VALUE 0x804EE579 Val_Wu8 255.0 DFC_OneToOne 0.00 255.0 FORMAT "%5.1" /end CHARACTERISTIC
/begin CHARACTERISTIC DTR_OBDMID.DTR_OBDMID_01_TID_OFFSN_C "" VALUE 0x804EE57A Val_Wu8 255.0 DFC_OneToOne 0.00 255.0 FORMAT "%5.1" /end CHARACTERISTIC
/begin CHARACTERISTIC DTR_OBDMID.DTR_OBDMID_01_TID_OFFSP_C "" VALUE 0x804EE57B Val_Wu8 255.0 DFC_OneToOne 0.00 255.0 FORMAT "%5.1" /end CHARACTERISTIC
/begin CHARACTERISTIC DTR_OBDMID.DTR_OBDMID_01_TID_SnsrMntdDiag_C "" VALUE 0x804EE57C Val_Wu8 255.0 DFC_OneToOne 0.00 255.0 FORMAT "%5.1" /end CHARACTERISTIC
/begin CHARACTERISTIC DTR_OBDMID.DTR_OBDMID_01_TID_TCLTR_C "" VALUE 0x804EE57D Val_Wu8 255.0 DFC_OneToOne 0.00 255.0 FORMAT "%5.1" /end CHARACTERISTIC
/begin CHARACTERISTIC DTR_OBDMID.DTR_OBDMID_01_TID_TCRTL_C "" VALUE 0x804EE57E Val_Wu8 255.0 DFC_OneToOne 0.00 255.0 FORMAT "%5.1" /end CHARACTERISTIC
/begin CHARACTERISTIC DTR_OBDMID.DTR_OBDMID_02_TID_05_C "" VALUE 0x804EE57F Val_Wu8 255.0 DFC_OneToOne 0.00 255.0 FORMAT "%5.1" /end CHARACTERISTIC
/begin CHARACTERISTIC DTR_OBDMID.DTR_OBDMID_02_TID_06_C "" VALUE 0x804EE580 Val_Wu8 255.0 DFC_OneToOne 0.00 255.0 FORMAT "%5.1" /end CHARACTERISTIC
/begin CHARACTERISTIC DTR_OBDMID.DTR_OBDMID_02_TID_LtrDly_C "" VALUE 0x804EE581 Val_Wu8 255.0 DFC_OneToOne 0.00 255.0 FORMAT "%5.1" /end CHARACTERISTIC
/begin CHARACTERISTIC DTR_OBDMID.DTR_OBDMID_02_TID_RtlDly_C "" VALUE 0x804EE582 Val_Wu8 255.0 DFC_OneToOne 0.00 255.0 FORMAT "%5.1" /end CHARACTERISTIC
/begin CHARACTERISTIC DTR_OBDMID.DTR_OBDMID_02_TID_TarLean_C "" VALUE 0x804EE583 Val_Wu8 255.0 DFC_OneToOne 0.00 255.0 FORMAT "%5.1" /end CHARACTERISTIC
/begin CHARACTERISTIC DTR_OBDMID.DTR_OBDMID_02_TID_TarRich_C "" VALUE 0x804EE584 Val_Wu8 255.0 DFC_OneToOne 0.00 255.0 FORMAT "%5.1" /end CHARACTERISTIC
/begin CHARACTERISTIC DTR_OBDMID.DTR_OBDMID_21_TID_OS_C "" VALUE 0x804EE585 Val_Wu8 255.0 DFC_OneToOne 0.00 255.0 FORMAT "%5.1" /end CHARACTERISTIC
/begin CHARACTERISTIC DTR_OBDMID.DTR_OBDMID_41_TID_TKER_C "" VALUE 0x804EE586 Val_Wu8 255.0 DFC_OneToOne 0.00 255.0 FORMAT "%5.1" /end CHARACTERISTIC
/begin CHARACTERISTIC DTR_OBDMID.DTR_OBDMID_42_TID_HTR_C "" VALUE 0x804EE587 Val_Wu8 255.0 DFC_OneToOne 0.00 255.0 FORMAT "%5.1" /end CHARACTERISTIC
/begin CHARACTERISTIC DTR_OBDMID.DTR_OBDMID_a2_TID_0b_0_C "" VALUE 0x804EE588 Val_Wu8 255.0 DFC_OneToOne 0.00 255.0 FORMAT "%5.1" /end CHARACTERISTIC
/begin CHARACTERISTIC DTR_OBDMID.DTR_OBDMID_a2_TID_0b_1_C "" VALUE 0x804EE589 Val_Wu8 255.0 DFC_OneToOne 0.00 255.0 FORMAT "%5.1" /end CHARACTERISTIC
/begin CHARACTERISTIC DTR_OBDMID.DTR_OBDMID_a2_TID_0b_2_C "" VALUE 0x804EE58A Val_Wu8 255.0 DFC_OneToOne 0.00 255.0 FORMAT "%5.1" /end CHARACTERISTIC
/begin CHARACTERISTIC DTR_OBDMID.DTR_OBDMID_a2_TID_0b_3_C "" VALUE 0x804EE58B Val_Wu8 255.0 DFC_OneToOne 0.00 255.0 FORMAT "%5.1" /end CHARACTERISTIC
/begin CHARACTERISTIC DTR_OBDMID.DTR_OBDMID_a2_TID_0c_0_C "" VALUE 0x804EE58C Val_Wu8 255.0 DFC_OneToOne 0.00 255.0 FORMAT "%5.1" /end CHARACTERISTIC
/begin CHARACTERISTIC DTR_OBDMID.DTR_OBDMID_a2_TID_0c_1_C "" VALUE 0x804EE58D Val_Wu8 255.0 DFC_OneToOne 0.00 255.0 FORMAT "%5.1" /end CHARACTERISTIC
/begin CHARACTERISTIC DTR_OBDMID.DTR_OBDMID_a2_TID_0c_2_C "" VALUE 0x804EE58E Val_Wu8 255.0 DFC_OneToOne 0.00 255.0 FORMAT "%5.1" /end CHARACTERISTIC
/begin CHARACTERISTIC DTR_OBDMID.DTR_OBDMID_a2_TID_0c_3_C "" VALUE 0x804EE58F Val_Wu8 255.0 DFC_OneToOne 0.00 255.0 FORMAT "%5.1" /end CHARACTERISTIC
/begin CHARACTERISTIC DTR_OBDMID.DTR_UegoDummy_C "" VALUE 0x804EE590 Val_Wu8 255.0 DFC_OneToOne 0.00 255.0 FORMAT "%5.1" /end CHARACTERISTIC
/begin CHARACTERISTIC DTR_OBDMID.DTR_UegoOlRCmpS1B1_C "" VALUE 0x804EE591 Val_Wu8 255.0 DFC_OneToOne 0.00 255.0 FORMAT "%5.1" /end CHARACTERISTIC
/begin CHARACTERISTIC DTR_Suprt.DTR_OBDMID_01_TID_DTLTR_C "" VALUE 0x804EE592 Val_Wu8 1.00000000000 DTR_Suprt_Compu 0.00 1.00000000000 FORMAT "%13.11" /end CHARACTERISTIC
/begin CHARACTERISTIC DTR_Suprt.DTR_OBDMID_01_TID_DTRTL_C "" VALUE 0x804EE593 Val_Wu8 1.00000000000 DTR_Suprt_Compu 0.00 1.00000000000 FORMAT "%13.11" /end CHARACTERISTIC
/begin CHARACTERISTIC DTR_Suprt.DTR_OBDMID_01_TID_OFFSN_C "" VALUE 0x804EE594 Val_Wu8 1.00000000000 DTR_Suprt_Compu 0.00 1.00000000000 FORMAT "%13.11" /end CHARACTERISTIC
/begin CHARACTERISTIC DTR_Suprt.DTR_OBDMID_01_TID_OFFSP_C "" VALUE 0x804EE595 Val_Wu8 1.00000000000 DTR_Suprt_Compu 0.00 1.00000000000 FORMAT "%13.11" /end CHARACTERISTIC
/begin CHARACTERISTIC DTR_Suprt.DTR_OBDMID_01_TID_SnsrMntdDiag_C "" VALUE 0x804EE596 Val_Wu8 1.00000000000 DTR_Suprt_Compu 0.00 1.00000000000 FORMAT "%13.11" /end CHARACTERISTIC
/begin CHARACTERISTIC DTR_Suprt.DTR_OBDMID_01_TID_TCLTR_C "" VALUE 0x804EE597 Val_Wu8 1.00000000000 DTR_Suprt_Compu 0.00 1.00000000000 FORMAT "%13.11" /end CHARACTERISTIC
/begin CHARACTERISTIC DTR_Suprt.DTR_OBDMID_01_TID_TCRTL_C "" VALUE 0x804EE598 Val_Wu8 1.00000000000 DTR_Suprt_Compu 0.00 1.00000000000 FORMAT "%13.11" /end CHARACTERISTIC
/begin CHARACTERISTIC DTR_Suprt.DTR_OBDMID_02_TID_05_C "" VALUE 0x804EE599 Val_Wu8 1.00000000000 DTR_Suprt_Compu 0.00 1.00000000000 FORMAT "%13.11" /end CHARACTERISTIC
/begin CHARACTERISTIC DTR_Suprt.DTR_OBDMID_02_TID_06_C "" VALUE 0x804EE59A Val_Wu8 1.00000000000 DTR_Suprt_Compu 0.00 1.00000000000 FORMAT "%13.11" /end CHARACTERISTIC
/begin CHARACTERISTIC DTR_Suprt.DTR_OBDMID_02_TID_LtrDly_C "" VALUE 0x804EE59B Val_Wu8 1.00000000000 DTR_Suprt_Compu 0.00 1.00000000000 FORMAT "%13.11" /end CHARACTERISTIC
/begin CHARACTERISTIC DTR_Suprt.DTR_OBDMID_02_TID_RtlDly_C "" VALUE 0x804EE59C Val_Wu8 1.00000000000 DTR_Suprt_Compu 0.00 1.00000000000 FORMAT "%13.11" /end CHARACTERISTIC
/begin CHARACTERISTIC DTR_Suprt.DTR_OBDMID_02_TID_TarLean_C "" VALUE 0x804EE59D Val_Wu8 1.00000000000 DTR_Suprt_Compu 0.00 1.00000000000 FORMAT "%13.11" /end CHARACTERISTIC
/begin CHARACTERISTIC DTR_Suprt.DTR_OBDMID_02_TID_TarRich_C "" VALUE 0x804EE59E Val_Wu8 1.00000000000 DTR_Suprt_Compu 0.00 1.00000000000 FORMAT "%13.11" /end CHARACTERISTIC
/begin CHARACTERISTIC DTR_Suprt.DTR_OBDMID_21_TID_OS_C "" VALUE 0x804EE59F Val_Wu8 1.00000000000 DTR_Suprt_Compu 0.00 1.00000000000 FORMAT "%13.11" /end CHARACTERISTIC
/begin CHARACTERISTIC DTR_Suprt.DTR_OBDMID_41_TID_TKER_C "" VALUE 0x804EE5A0 Val_Wu8 1.00000000000 DTR_Suprt_Compu 0.00 1.00000000000 FORMAT "%13.11" /end CHARACTERISTIC
/begin CHARACTERISTIC DTR_Suprt.DTR_OBDMID_42_TID_HTR_C "" VALUE 0x804EE5A1 Val_Wu8 1.00000000000 DTR_Suprt_Compu 0.00 1.00000000000 FORMAT "%13.11" /end CHARACTERISTIC
/begin CHARACTERISTIC DTR_Suprt.DTR_OBDMID_a2_TID_0b_0_C "" VALUE 0x804EE5A2 Val_Wu8 1.00000000000 DTR_Suprt_Compu 0.00 1.00000000000 FORMAT "%13.11" /end CHARACTERISTIC
/begin CHARACTERISTIC DTR_Suprt.DTR_OBDMID_a2_TID_0b_1_C "" VALUE 0x804EE5A3 Val_Wu8 1.00000000000 DTR_Suprt_Compu 0.00 1.00000000000 FORMAT "%13.11" /end CHARACTERISTIC
/begin CHARACTERISTIC DTR_Suprt.DTR_OBDMID_a2_TID_0b_2_C "" VALUE 0x804EE5A4 Val_Wu8 1.00000000000 DTR_Suprt_Compu 0.00 1.00000000000 FORMAT "%13.11" /end CHARACTERISTIC
/begin CHARACTERISTIC DTR_Suprt.DTR_OBDMID_a2_TID_0b_3_C "" VALUE 0x804EE5A5 Val_Wu8 1.00000000000 DTR_Suprt_Compu 0.00 1.00000000000 FORMAT "%13.11" /end CHARACTERISTIC
/begin CHARACTERISTIC DTR_Suprt.DTR_OBDMID_a2_TID_0c_0_C "" VALUE 0x804EE5A6 Val_Wu8 1.00000000000 DTR_Suprt_Compu 0.00 1.00000000000 FORMAT "%13.11" /end CHARACTERISTIC
/begin CHARACTERISTIC DTR_Suprt.DTR_OBDMID_a2_TID_0c_1_C "" VALUE 0x804EE5A7 Val_Wu8 1.00000000000 DTR_Suprt_Compu 0.00 1.00000000000 FORMAT "%13.11" /end CHARACTERISTIC
/begin CHARACTERISTIC DTR_Suprt.DTR_OBDMID_a2_TID_0c_2_C "" VALUE 0x804EE5A8 Val_Wu8 1.00000000000 DTR_Suprt_Compu 0.00 1.00000000000 FORMAT "%13.11" /end CHARACTERISTIC
/begin CHARACTERISTIC DTR_Suprt.DTR_OBDMID_a2_TID_0c_3_C "" VALUE 0x804EE5A9 Val_Wu8 1.00000000000 DTR_Suprt_Compu 0.00 1.00000000000 FORMAT "%13.11" /end CHARACTERISTIC
/begin CHARACTERISTIC DTR_Suprt.DTR_UegoDummy_C "" VALUE 0x804EE5AA Val_Wu8 1.00000000000 DTR_Suprt_Compu 0.00 1.00000000000 FORMAT "%13.11" /end CHARACTERISTIC
/begin CHARACTERISTIC DTR_Suprt.DTR_UegoOlRCmpS1B1_C "" VALUE 0x804EE5AB Val_Wu8 1.00000000000 DTR_Suprt_Compu 0.00 1.00000000000 FORMAT "%13.11" /end CHARACTERISTIC
/begin CHARACTERISTIC DTR_TID.DTR_OBDMID_01_TID_DTLTR_C "" VALUE 0x804EE5AC Val_Wu8 255.0 DFC_OneToOne 0.00 255.0 FORMAT "%5.1" /end CHARACTERISTIC
/begin CHARACTERISTIC DTR_TID.DTR_OBDMID_01_TID_DTRTL_C "" VALUE 0x804EE5AD Val_Wu8 255.0 DFC_OneToOne 0.00 255.0 FORMAT "%5.1" /end CHARACTERISTIC
/begin CHARACTERISTIC DTR_TID.DTR_OBDMID_01_TID_OFFSN_C "" VALUE 0x804EE5AE Val_Wu8 255.0 DFC_OneToOne 0.00 255.0 FORMAT "%5.1" /end CHARACTERISTIC
/begin CHARACTERISTIC DTR_TID.DTR_OBDMID_01_TID_OFFSP_C "" VALUE 0x804EE5AF Val_Wu8 255.0 DFC_OneToOne 0.00 255.0 FORMAT "%5.1" /end CHARACTERISTIC
/begin CHARACTERISTIC DTR_TID.DTR_OBDMID_01_TID_SnsrMntdDiag_C "" VALUE 0x804EE5B0 Val_Wu8 255.0 DFC_OneToOne 0.00 255.0 FORMAT "%5.1" /end CHARACTERISTIC
/begin CHARACTERISTIC DTR_TID.DTR_OBDMID_01_TID_TCLTR_C "" VALUE 0x804EE5B1 Val_Wu8 255.0 DFC_OneToOne 0.00 255.0 FORMAT "%5.1" /end CHARACTERISTIC
/begin CHARACTERISTIC DTR_TID.DTR_OBDMID_01_TID_TCRTL_C "" VALUE 0x804EE5B2 Val_Wu8 255.0 DFC_OneToOne 0.00 255.0 FORMAT "%5.1" /end CHARACTERISTIC
/begin CHARACTERISTIC DTR_TID.DTR_OBDMID_02_TID_05_C "" VALUE 0x804EE5B3 Val_Wu8 255.0 DFC_OneToOne 0.00 255.0 FORMAT "%5.1" /end CHARACTERISTIC
/begin CHARACTERISTIC DTR_TID.DTR_OBDMID_02_TID_06_C "" VALUE 0x804EE5B4 Val_Wu8 255.0 DFC_OneToOne 0.00 255.0 FORMAT "%5.1" /end CHARACTERISTIC
/begin CHARACTERISTIC DTR_TID.DTR_OBDMID_02_TID_LtrDly_C "" VALUE 0x804EE5B5 Val_Wu8 255.0 DFC_OneToOne 0.00 255.0 FORMAT "%5.1" /end CHARACTERISTIC
/begin CHARACTERISTIC DTR_TID.DTR_OBDMID_02_TID_RtlDly_C "" VALUE 0x804EE5B6 Val_Wu8 255.0 DFC_OneToOne 0.00 255.0 FORMAT "%5.1" /end CHARACTERISTIC
/begin CHARACTERISTIC DTR_TID.DTR_OBDMID_02_TID_TarLean_C "" VALUE 0x804EE5B7 Val_Wu8 255.0 DFC_OneToOne 0.00 255.0 FORMAT "%5.1" /end CHARACTERISTIC
/begin CHARACTERISTIC DTR_TID.DTR_OBDMID_02_TID_TarRich_C "" VALUE 0x804EE5B8 Val_Wu8 255.0 DFC_OneToOne 0.00 255.0 FORMAT "%5.1" /end CHARACTERISTIC
/begin CHARACTERISTIC DTR_TID.DTR_OBDMID_21_TID_OS_C "" VALUE 0x804EE5B9 Val_Wu8 255.0 DFC_OneToOne 0.00 255.0 FORMAT "%5.1" /end CHARACTERISTIC
/begin CHARACTERISTIC DTR_TID.DTR_OBDMID_41_TID_TKER_C "" VALUE 0x804EE5BA Val_Wu8 255.0 DFC_OneToOne 0.00 255.0 FORMAT "%5.1" /end CHARACTERISTIC
/begin CHARACTERISTIC DTR_TID.DTR_OBDMID_42_TID_HTR_C "" VALUE 0x804EE5BB Val_Wu8 255.0 DFC_OneToOne 0.00 255.0 FORMAT "%5.1" /end CHARACTERISTIC
/begin CHARACTERISTIC DTR_TID.DTR_OBDMID_a2_TID_0b_0_C "" VALUE 0x804EE5BC Val_Wu8 255.0 DFC_OneToOne 0.00 255.0 FORMAT "%5.1" /end CHARACTERISTIC
/begin CHARACTERISTIC DTR_TID.DTR_OBDMID_a2_TID_0b_1_C "" VALUE 0x804EE5BD Val_Wu8 255.0 DFC_OneToOne 0.00 255.0 FORMAT "%5.1" /end CHARACTERISTIC
/begin CHARACTERISTIC DTR_TID.DTR_OBDMID_a2_TID_0b_2_C "" VALUE 0x804EE5BE Val_Wu8 255.0 DFC_OneToOne 0.00 255.0 FORMAT "%5.1" /end CHARACTERISTIC
/begin CHARACTERISTIC DTR_TID.DTR_OBDMID_a2_TID_0b_3_C "" VALUE 0x804EE5BF Val_Wu8 255.0 DFC_OneToOne 0.00 255.0 FORMAT "%5.1" /end CHARACTERISTIC
/begin CHARACTERISTIC DTR_TID.DTR_OBDMID_a2_TID_0c_0_C "" VALUE 0x804EE5C0 Val_Wu8 255.0 DFC_OneToOne 0.00 255.0 FORMAT "%5.1" /end CHARACTERISTIC
/begin CHARACTERISTIC DTR_TID.DTR_OBDMID_a2_TID_0c_1_C "" VALUE 0x804EE5C1 Val_Wu8 255.0 DFC_OneToOne 0.00 255.0 FORMAT "%5.1" /end CHARACTERISTIC
/begin CHARACTERISTIC DTR_TID.DTR_OBDMID_a2_TID_0c_2_C "" VALUE 0x804EE5C2 Val_Wu8 255.0 DFC_OneToOne 0.00 255.0 FORMAT "%5.1" /end CHARACTERISTIC
/begin CHARACTERISTIC DTR_TID.DTR_OBDMID_a2_TID_0c_3_C "" VALUE 0x804EE5C3 Val_Wu8 255.0 DFC_OneToOne 0.00 255.0 FORMAT "%5.1" /end CHARACTERISTIC
/begin CHARACTERISTIC DTR_TID.DTR_UegoDummy_C "" VALUE 0x804EE5C4 Val_Wu8 255.0 DFC_OneToOne 0.00 255.0 FORMAT "%5.1" /end CHARACTERISTIC
/begin CHARACTERISTIC DTR_TID.DTR_UegoOlRCmpS1B1_C "" VALUE 0x804EE5C5 Val_Wu8 255.0 DFC_OneToOne 0.00 255.0 FORMAT "%5.1" /end CHARACTERISTIC
/begin CHARACTERISTIC Ebs_cntrDebSocFlt_C "Counter to indicate the number of times an error in SOC has to be consecutively detected" VALUE 0x8051E424 RB_Val_Wu8 255.0 OneToOne 0.00 255.0 FORMAT "%5.1" /end CHARACTERISTIC
/begin CHARACTERISTIC Ebs_facRCorrn_T "Factor for correction of internal resistance of battery based on battery temperature" CURVE 0x8051E426 RB_Curve_S16_S16 2.550000 Fact1000 0.00 2.550000 FORMAT "%8.6" EXTENDED_LIMITS -32.76800 32.76700
 /begin AXIS_DESCR STD_AXIS Ebs_tBattFild SCR_TEMP_CELS_float 6 -32768.00 32767.00 FORMAT "%8.2" DEPOSIT ABSOLUTE /end AXIS_DESCR
/end CHARACTERISTIC
/begin CHARACTERISTIC Ebs_flgSwtSOCSeln_C "Switch to select the source of SOC" VALUE 0x8051E440 RB_Val_Wu8 1.00000000000 B_TRUE 0.00 1.00000000000 FORMAT "%13.11" /end CHARACTERISTIC
/begin CHARACTERISTIC Ebs_iBattRepl_C "Replacement current value for test" VALUE 0x8051E442 RB_Val_Ws16 655.3500 Curr_A -327.6800 327.6700 FORMAT "%8.4" /end CHARACTERISTIC
/begin CHARACTERISTIC Ebs_iS16MaxLim_C "Max limit for S16 Curr_A" VALUE 0x8051E444 RB_Val_Ws32 4194303999.02 Curr_mA_q0p9765625_COMPU -2097152000.00 2097151999.02 FORMAT "%13.2" /end CHARACTERISTIC
/begin CHARACTERISTIC Ebs_iS16MinLim_C "Min limit for S16 Curr_A" VALUE 0x8051E448 RB_Val_Ws32 4194303999.02 Curr_mA_q0p9765625_COMPU -2097152000.00 2097151999.02 FORMAT "%13.2" /end CHARACTERISTIC
/begin CHARACTERISTIC Ebs_qAcmMax_C "Calibration for maximum value of battery accumulated charge and discahrge that can be received from EBS" VALUE 0x8051E44C RB_Val_Ws32 21474836.4700 q0p01_A_h_1 0.00 21474836.4700 FORMAT "%13.4" EXTENDED_LIMITS -21474836.4800 21474836.4700 /end CHARACTERISTIC
/begin CHARACTERISTIC Ebs_qBattNom_T "Nominal battery charge based on battery temperature" CURVE 0x8051E450 RB_Curve_S16_S16 655.3500 q0p01_A_h_1 -327.6800 327.6700 FORMAT "%8.4"
 /begin AXIS_DESCR STD_AXIS Com_tBattEBS SCR_TEMP_CELS_float 6 -32768.00 32767.00 FORMAT "%8.2" DEPOSIT ABSOLUTE /end AXIS_DESCR
/end CHARACTERISTIC
/begin CHARACTERISTIC Ebs_qChrgDft_C "Default charge value to be used for initialization in case ENVRAM history is lost." VALUE 0x8051E46C RB_Val_Wu32 42949672.9500 q0p01_A_h_1 0.00 42949672.9500 FORMAT "%13.4" /end CHARACTERISTIC
/begin CHARACTERISTIC Ebs_qDchaDft_C "Default discharge value to be used for initialization in case ENVRAM history is lost" VALUE 0x8051E470 RB_Val_Wu32 42949672.9500 q0p01_A_h_1 0.00 42949672.9500 FORMAT "%13.4" /end CHARACTERISTIC
/begin CHARACTERISTIC Ebs_qSohRepl_C "Replacement SOH value for test" VALUE 0x8051E474 RB_Val_Ws16 8191.875 ElecChrg_Ah_q0p125_COMPU -4096.000 4095.875 FORMAT "%8.3" /end CHARACTERISTIC
/begin CHARACTERISTIC Ebs_ratDeltaSocThd1_C "Threshold limit of delta SOC for detection of fault 1" VALUE 0x8051E476 RB_Val_Wu8 127.5 RBPtCel_Perc_0p5_1 0.00 127.5 FORMAT "%5.1" /end CHARACTERISTIC
/begin CHARACTERISTIC Ebs_ratDeltaSocThd2_C "Threshold limit of delta SOC for detection of fault 2" VALUE 0x8051E478 RB_Val_Wu16 32767.50 RBPtCel_Perc_0p5_1 0.00 32767.50 FORMAT "%8.2" /end CHARACTERISTIC
/begin CHARACTERISTIC Ebs_ratDifThd_C "Threshold limit of SOC to detect error with respect to previous driving cycle" VALUE 0x8051E47A RB_Val_Wu8 127.5 RBPtCel_Perc_0p5_1 0.00 127.5 FORMAT "%5.1" /end CHARACTERISTIC
/begin CHARACTERISTIC Ebs_ratSocRepl_C "Replacement SOC value for test" VALUE 0x8051E47B RB_Val_Wu8 127.5 RBPtCel_Perc_0p5_1 0.00 127.5 FORMAT "%5.1" /end CHARACTERISTIC
/begin CHARACTERISTIC Ebs_ratSohRepl_C "Replacement SOH value for test" VALUE 0x8051E47C RB_Val_Ws16 799.9878 Prc -400.0000 399.9878 FORMAT "%8.4" /end CHARACTERISTIC
/begin CHARACTERISTIC Ebs_ratTarSoc_C "Target SOC for integrated current calculation" VALUE 0x8051E47E RB_Val_Wu8 127.5 RBPtCel_Perc_0p5_1 0.00 127.5 FORMAT "%5.1" /end CHARACTERISTIC
/begin CHARACTERISTIC Ebs_rBattRSRCHiThd_C "Higher threshold for battery internal resistance for calculating the error status in battery resistance signal received from EBS" VALUE 0x8051E480 RB_Val_Ws16 0.6553500 RBPtCel_r_0p00001_1 -0.3276800 0.3276700 FORMAT "%9.7" /end CHARACTERISTIC
/begin CHARACTERISTIC Ebs_rBattRSRCLoThd_C "Lower threshold for battery internal resistance for calculating the error status in battery resistance signal received from EBS" VALUE 0x8051E482 RB_Val_Ws16 0.6553500 RBPtCel_r_0p00001_1 -0.3276800 0.3276700 FORMAT "%9.7" /end CHARACTERISTIC
/begin CHARACTERISTIC Ebs_swtCtl_C "Switch for testing" VALUE 0x8051E484 RB_Val_Wu16 65535.00 OneToOne 0.00 65535.00 FORMAT "%8.2" /end CHARACTERISTIC
/begin CHARACTERISTIC Ebs_tBattRepl_C "Replacement temperature value for test" VALUE 0x8051E486 RB_Val_Ws16 65535.00 SCR_TEMP_CELS_float -32768.00 32767.00 FORMAT "%8.2" /end CHARACTERISTIC
/begin CHARACTERISTIC Ebs_tiDlyAftStrtrCut_C "Time period after cranking after which battery internal resistance is to be read" VALUE 0x8051E488 RB_Val_Ws16 655.3500 Time_s -327.6800 327.6700 FORMAT "%8.4" /end CHARACTERISTIC
/begin CHARACTERISTIC Ebs_tiElpdSnceBattSnsrRst_C "Time elapsed since reset of battery sensor until which battery temperature will be indicated as invalid" VALUE 0x8051E48C RB_Val_Ws32 21474836.4700 Time_s 0.00 21474836.4700 FORMAT "%13.4" EXTENDED_LIMITS -21474836.4800 21474836.4700 /end CHARACTERISTIC
/begin CHARACTERISTIC Ebs_tiRatSohFild_C "T1 filter time for SOH" VALUE 0x8051E490 RB_Val_Ws16 4294.8362200 TimeDelay_s 0.1310760 4294.9672960 FORMAT "%12.7" EXTENDED_LIMITS 0.13107600012 4294.9672960 /end CHARACTERISTIC
/begin CHARACTERISTIC Ebs_tiSocFil_C "T1 filter time for SOC" VALUE 0x8051E492 RB_Val_Ws16 4294.8362200 TimeDelay_s 0.1310760 4294.9672960 FORMAT "%12.7" EXTENDED_LIMITS 0.13107600012 4294.9672960 /end CHARACTERISTIC
/begin CHARACTERISTIC Ebs_tiSocSohHistOnDly_C "Initial Delay when Ignition is ON whcih prevents the Soc and Soh values from filtering" VALUE 0x8051E494 RB_Val_Wu16 655.3500 Time_s 0.00 655.3500 FORMAT "%8.4" /end CHARACTERISTIC
/begin CHARACTERISTIC Ebs_tiSohFil_C "T1 filter time for SOH" VALUE 0x8051E496 RB_Val_Ws16 4294.8362200 TimeDelay_s 0.1310760 4294.9672960 FORMAT "%12.7" EXTENDED_LIMITS 0.13107600012 4294.9672960 /end CHARACTERISTIC
/begin CHARACTERISTIC Ebs_tiT15OnDly_C "Turn ON delay time of T15_st to evaluate battery sensor diagnosis" VALUE 0x8051E498 RB_Val_Wu16 655.3500 Time_s 0.00 655.3500 FORMAT "%8.4" /end CHARACTERISTIC
/begin CHARACTERISTIC Ebs_tiTBattFil_C "T1 filter time for battery temperature" VALUE 0x8051E49A RB_Val_Ws16 4294.8362200 TimeDelay_s 0.1310760 4294.9672960 FORMAT "%12.7" EXTENDED_LIMITS 0.13107600012 4294.9672960 /end CHARACTERISTIC
/begin CHARACTERISTIC Ebs_tiUBattFil_C "T1 filter time for battery voltage" VALUE 0x8051E49C RB_Val_Ws16 4294.8362200 TimeDelay_s 0.1310760 4294.9672960 FORMAT "%12.7" EXTENDED_LIMITS 0.13107600012 4294.9672960 /end CHARACTERISTIC
/begin CHARACTERISTIC Ebs_tiUSofFild_C "T1 filter time for SOF" VALUE 0x8051E49E RB_Val_Ws16 4294.8362200 TimeDelay_s 0.1310760 4294.9672960 FORMAT "%12.7" EXTENDED_LIMITS 0.13107600012 4294.9672960 /end CHARACTERISTIC
/begin CHARACTERISTIC Ebs_uBattRepl_C "Replacement voltage value for test" VALUE 0x8051E4A0 RB_Val_Ws16 63999.02 U_mV_q0p9765625_COMPU -32000.00 31999.02 FORMAT "%8.2" /end CHARACTERISTIC
/begin CHARACTERISTIC Ebs_uSofRepl_C "Replacement SOF value for test" VALUE 0x8051E4A2 RB_Val_Ws16 4095.938 spg_q0p0625_V -2048.000 2047.938 FORMAT "%8.3" /end CHARACTERISTIC
/begin CHARACTERISTIC P_VSE11_nrPSPTstPls_C "Number of the additional testpulses for the PSP-relay port" VALUE 0x8051C138 RB_Val_Wu32 4294967295.00 OneToOne 0.00 4294967295.00 FORMAT "%13.2" /end CHARACTERISTIC
/begin CHARACTERISTIC P_VSE11_tiBtwElecFlt_C "Time between tests in case of electrical error" VALUE 0x8051C13C RB_Val_Ws16 655350.0 Time_ms -327680.0 327670.0 FORMAT "%8.1" /end CHARACTERISTIC
/begin CHARACTERISTIC P_VSE11_tiBtwOTFlt_C "Time between tests in case of Over Temperature error" VALUE 0x8051C13E RB_Val_Ws16 655.3500 Time_s -327.6800 327.6700 FORMAT "%8.4" /end CHARACTERISTIC
/begin CHARACTERISTIC TSTARTMX "time limit for detection of inadmissible time of engine start" VALUE 0x8051C122 RB_Val_Wu16 655.3500 t10msxs_uw_b655p35 0.00 655.3500 FORMAT "%8.4" /end CHARACTERISTIC
/begin CHARACTERISTIC TurnondelaySwtIntkExh_C "Delay for Intake and Exhaust Turn On Switch" VALUE 0x8051C140 RB_Val_Wu8 25.50 t_q0p1 0.00 25.50 FORMAT "%5.2" /end CHARACTERISTIC
/begin CHARACTERISTIC VlvLft_IntDbTiHiLo_C "Calibration for High to Low transition for Internal debounce used for feedback switch diagnosis in Valvelift module." VALUE 0x8051C142 RB_Val_Ws16 655350.0 Time_ms -327680.0 327670.0 FORMAT "%8.1" /end CHARACTERISTIC
/begin CHARACTERISTIC VlvLft_IntDbTiLoHi_C "Calibration for Low to High transition for Internal debounce used for feedback switch diagnosis in Valvelift module." VALUE 0x8051C144 RB_Val_Ws16 655350.0 Time_ms -327680.0 327670.0 FORMAT "%8.1" /end CHARACTERISTIC
/begin CHARACTERISTIC VlvLft_stFbSnsrDiagEnaIntk_C "Code word for enabling sensor diagnosis (intake)" VALUE 0x8051C146 RB_Val_Wboolean 1.00000000000 B_TRUE 0.00 1.00000000000 FORMAT "%13.11" /end CHARACTERISTIC
/begin CHARACTERISTIC VlvLft_stFbSwtDiagEnaIntk_C "Code word for feedback intake switch diagnosis enabling" VALUE 0x8051C147 RB_Val_Wu8 255.0 dez 0.00 255.0 FORMAT "%5.1" /end CHARACTERISTIC
/begin CHARACTERISTIC Vlvlft_stPsDiaDisbl_C "Codeword for deactivating the powerstage diagnosis for Valvelift" VALUE 0x8051C148 RB_Val_Wu16 65535.00 OneToOne 0.00 65535.00 FORMAT "%8.2" /end CHARACTERISTIC
/begin CHARACTERISTIC Vlvlft_stPsDiaSwitch_C "Switch to enable\disable diagnosis operation if FID set" VALUE 0x8051C14A RB_Val_Wu8 1.00000000000 B_TRUE 0.00 1.00000000000 FORMAT "%13.11" /end CHARACTERISTIC
/begin CHARACTERISTIC VlvLft_stPwrStgDiagEnaIntkExh_C "Power Stage Diagnosis Intake Exhaust enable" VALUE 0x8051C14B RB_Val_Wu8 255.0 dez 0.00 255.0 FORMAT "%5.1" /end CHARACTERISTIC
/begin CHARACTERISTIC VlvLft_tiDiagStrtDly_C "Delay to begin diagnosis after diagnosis begin condition is fulfilled." VALUE 0x8051C14C RB_Val_Wu16 6553.500 t_q0p1 0.00 6553.500 FORMAT "%8.3" /end CHARACTERISTIC
/begin CHARACTERISTIC VlvLft_tiSpclMaxIntk_C "Maximum time acceptable for special switch intake" VALUE 0x8051C14E RB_Val_Wu16 65535.00 t_q1_ms 0.00 65535.00 FORMAT "%8.2" /end CHARACTERISTIC
/begin CHARACTERISTIC VlvLft_tiStdMaxIntk_C "Maximum time acceptable for Standard switch intake" VALUE 0x8051C150 RB_Val_Wu16 65535.00 t_q1_ms 0.00 65535.00 FORMAT "%8.2" /end CHARACTERISTIC
/begin CHARACTERISTIC VlvLft_uOilPSnsrSRCMax_C "Maximum voltage value of sensor for SRC Electrical diagnosis" VALUE 0x8051C152 RB_Val_Ws16 13107.00 Volt -6553.600 6553.400 FORMAT "%8.3" /end CHARACTERISTIC
/begin CHARACTERISTIC VlvLft_uOilPSnsrSRCMin_C "Minimum voltage value of sensor for SRC Electrical diagnosis" VALUE 0x8051C154 RB_Val_Ws16 13107.00 Volt -6553.600 6553.400 FORMAT "%8.3" /end CHARACTERISTIC
/begin CHARACTERISTIC ZTSTMX "limit of counter of wrong starts" VALUE 0x8051C124 RB_Val_Wu8 255.0 dez 0.00 255.0 FORMAT "%5.1" /end CHARACTERISTIC
/begin CHARACTERISTIC ZTSTMXOK "linit of counter of good starts" VALUE 0x8051C125 RB_Val_Wu8 255.0 dez 0.00 255.0 FORMAT "%5.1" /end CHARACTERISTIC
/begin MEASUREMENT B_dstti "condition enable diagnosis start time" UBYTE B_TRUE 1 100 0.00 1.00000000000 BIT_MASK 0x1 FORMAT "%13.11" ECU_ADDRESS 0x700002D0 /end MEASUREMENT
/begin MEASUREMENT B_eteve_msg "electrical error of the CPV has been detected by the standard diagnosis" UBYTE B_TRUE 1 100 0.00 1.00000000000 BIT_MASK 0x1 FORMAT "%13.11" ECU_ADDRESS 0x60009FCE /end MEASUREMENT
/begin MEASUREMENT B_limtstok_msg "condition good start" UBYTE B_TRUE 1 100 0.00 1.00000000000 BIT_MASK 0x1 FORMAT "%13.11" ECU_ADDRESS 0x70000A08 /end MEASUREMENT
/begin MEASUREMENT B_limtst_msg "condition bad start" UBYTE B_TRUE 1 100 0.00 1.00000000000 BIT_MASK 0x1 FORMAT "%13.11" ECU_ADDRESS 0x70000A09 /end MEASUREMENT
/begin MEASUREMENT B_staanloc "Condition start request for diagnosis of time of start" UBYTE B_TRUE 1 100 0.00 1.00000000000 BIT_MASK 0x1 FORMAT "%13.11" ECU_ADDRESS 0x700002CF /end MEASUREMENT
/begin MEASUREMENT B_sttime_msg "condition start time exceeded" UBYTE B_TRUE 1 100 0.00 1.00000000000 BIT_MASK 0x1 FORMAT "%13.11" ECU_ADDRESS 0x70000996 /end MEASUREMENT
/begin MEASUREMENT Com_iACCmpr "Air Conditioner variable capacity compressor control current" UWORD i_q1_mA 1 100 0.00 65535.00 FORMAT "%8.2" ECU_ADDRESS 0x60004D76 /end MEASUREMENT
/begin MEASUREMENT Com_lDst "Coverage distance received from meter" SLONG OilMlg 1 100 -2147483648.00 2147483647.00 FORMAT "%13.2" ECU_ADDRESS 0x60001C2C /end MEASUREMENT
/begin MEASUREMENT Com_lDstMETK "Coverage distance" SLONG OilMlg 1 100 -2147483648.00 2147483647.00 FORMAT "%13.2" ECU_ADDRESS 0x50004BF4 /end MEASUREMENT
/begin MEASUREMENT Com_lDstMETK1 "Coverage distance Byte1" UBYTE OneToOne 1 100 0.00 255.0 FORMAT "%5.1" ECU_ADDRESS 0x6000A0BF /end MEASUREMENT
/begin MEASUREMENT Com_lDstMETK2 "Coverage distance Byte2" UBYTE OneToOne 1 100 0.00 255.0 FORMAT "%5.1" ECU_ADDRESS 0x6000A0BE /end MEASUREMENT
/begin MEASUREMENT Com_lDstMETK3 "Coverage distance Byte3" UBYTE OneToOne 1 100 0.00 255.0 FORMAT "%5.1" ECU_ADDRESS 0x6000A0BD /end MEASUREMENT
/begin MEASUREMENT Com_stFailCode "B_CAN failure status" UBYTE OneToOne 1 100 0.00 255.0 FORMAT "%5.1" ECU_ADDRESS 0x6000A08F /end MEASUREMENT
/begin MEASUREMENT Com_stLiSwtInfoMETI "status of headlight information received on METI frame" UBYTE OneToOne 1 100 0.00 255.0 FORMAT "%5.1" ECU_ADDRESS 0x6000A08E /end MEASUREMENT
/begin MEASUREMENT Com_stMCUUnFailCode "MCU unit failure status" UBYTE OneToOne 1 100 0.00 255.0 FORMAT "%5.1" ECU_ADDRESS 0x6000A08C /end MEASUREMENT
/begin MEASUREMENT Com_stMETDCanErr "METD frame status" UBYTE OneToOne 1 100 0.00 255.0 FORMAT "%5.1" ECU_ADDRESS 0x6000A4DF /end MEASUREMENT
/begin MEASUREMENT Com_stMETNCanErr "METN frame status" UBYTE OneToOne 1 100 0.00 255.0 FORMAT "%5.1" ECU_ADDRESS 0x6000A4DC /end MEASUREMENT
/begin MEASUREMENT Com_stMonMETA "Error Status Message for META Frame" UBYTE OneToOne 1 100 0.00 255.0 FORMAT "%5.1" ECU_ADDRESS 0x6000A4D5 /end MEASUREMENT
/begin MEASUREMENT Com_stMonMETF "Status of METF error monitoring" UBYTE OneToOne 1 100 0.00 255.0 FORMAT "%5.1" ECU_ADDRESS 0x6000A77A /end MEASUREMENT
/begin MEASUREMENT Com_stMonMETH "Status of METH error monitoring" UBYTE OneToOne 1 100 0.00 255.0 FORMAT "%5.1" ECU_ADDRESS 0x6000A4D4 /end MEASUREMENT
/begin MEASUREMENT Com_stMonMETL "METL frame preliminary error status" UBYTE OneToOne 1 100 0.00 255.0 FORMAT "%5.1" ECU_ADDRESS 0x6000A4D3 /end MEASUREMENT
/begin MEASUREMENT Com_stRxEBBA "Staus of EBBA Frame Reception" UBYTE OneToOne 1 100 0.00 255.0 FORMAT "%5.1" ECU_ADDRESS 0x6000A4B3 /end MEASUREMENT
/begin MEASUREMENT Com_stRxEBBAChkSumOk "Staus of Checksum Error in EBBA frame" UBYTE OneToOne 1 100 0.00 255.0 FORMAT "%5.1" ECU_ADDRESS 0x6000A4B2 /end MEASUREMENT
/begin MEASUREMENT Com_stRxEBBADeb "Debounced Status of EBBA Frame Reception" UBYTE OneToOne 1 100 0.00 255.0 FORMAT "%5.1" ECU_ADDRESS 0x6000A4B1 /end MEASUREMENT
/begin MEASUREMENT Com_stRxEBBAOk "Error Staus of EBBA Frame Reception" UBYTE OneToOne 1 100 0.00 255.0 FORMAT "%5.1" ECU_ADDRESS 0x6000A4B0 /end MEASUREMENT
/begin MEASUREMENT Com_stRxEBBARingCntOk "Staus of Ring counter Error in EBBA frame" UBYTE OneToOne 1 100 0.00 255.0 FORMAT "%5.1" ECU_ADDRESS 0x6000A4AF /end MEASUREMENT
/begin MEASUREMENT Com_tMETCEnvTRaw "Raw values of outside air temperature for METC Frame" UBYTE OneToOne 1 100 0.00 255.0 FORMAT "%5.1" ECU_ADDRESS 0x6000A085 /end MEASUREMENT
/begin MEASUREMENT Com_tMETEEnvTRaw "Raw values of outside air temperature for METE Frame" UBYTE OneToOne 1 100 0.00 255.0 FORMAT "%5.1" ECU_ADDRESS 0x6000A45A /end MEASUREMENT
/begin MEASUREMENT Com_vDigVehKmph "Digital Speed Meter display target value(Hysteresis processing value for display) in kmph" UBYTE RBPtCel_v_1p0_1 1 100 0.00 255.0 FORMAT "%5.1" ECU_ADDRESS 0x6000A455 /end MEASUREMENT
/begin MEASUREMENT Com_vDigVehMph "Digital Speed Meter display target value(Hysteresis processing value for display) in mph" UBYTE Vel_CrCtl1_MPH 1 100 0.00 255.0 FORMAT "%5.1" ECU_ADDRESS 0x6000A454 /end MEASUREMENT
/begin MEASUREMENT CstrPurg_flgCpvElecErrOpenLoad "open load error of the CPV has been detected by the standard diagnosis" UBYTE B_TRUE 1 100 0.00 1.00000000000 BIT_MASK 0x1 FORMAT "%13.11" ECU_ADDRESS 0x60009FB7 /end MEASUREMENT
/begin MEASUREMENT CstrPurg_flgCpvElecErrShoCircBatt "short circuit to battery error of the CPV has been detected by the standard diagnosis" UBYTE B_TRUE 1 100 0.00 1.00000000000 BIT_MASK 0x1 FORMAT "%13.11" ECU_ADDRESS 0x60009FB6 /end MEASUREMENT
/begin MEASUREMENT CstrPurg_flgCpvElecErrShoCircGnd "short circuit to ground error of the CPV has been detected by the standard diagnosis" UBYTE B_TRUE 1 100 0.00 1.00000000000 BIT_MASK 0x1 FORMAT "%13.11" ECU_ADDRESS 0x60009FB5 /end MEASUREMENT
/begin MEASUREMENT CstrPurg_flgDiagCpv1CCHiLoad "Diag CPV Bank1 in the high load purge line using the Cross Correlation algorithm (Released via code word)" UBYTE B_TRUE 1 100 0.00 1.00000000000 BIT_MASK 0x1 FORMAT "%13.11" ECU_ADDRESS 0x700008BD /end MEASUREMENT
/begin MEASUREMENT CstrPurg_flgDiagCpv1CCLoLoad "Diag CPV Bank1 in the low load purge line using the Cross Correlation algorithm (Released via code word)" UBYTE B_TRUE 1 100 0.00 1.00000000000 BIT_MASK 0x1 FORMAT "%13.11" ECU_ADDRESS 0x700008BC /end MEASUREMENT
/begin MEASUREMENT CstrPurg_flgDiagCpv1DmtlHiLoad "Diag CPV Bank1 in the high load purge line using the DMTL algorithm (Released via code word)" UBYTE B_TRUE 1 100 0.00 1.00000000000 BIT_MASK 0x1 FORMAT "%13.11" ECU_ADDRESS 0x700008BB /end MEASUREMENT
/begin MEASUREMENT CstrPurg_flgDiagCpv1DmtlLoLoad "Diag CPV Bank1 in the low load purge line using the DMTL algorithm (Released via code word)" UBYTE B_TRUE 1 100 0.00 1.00000000000 BIT_MASK 0x1 FORMAT "%13.11" ECU_ADDRESS 0x700008BA /end MEASUREMENT
/begin MEASUREMENT CstrPurg_flgDiagCpv1DteskLoLoad "Diag CPV Bank1 in the low load purge line using DTESK algorithm (Release via code word)" UBYTE B_TRUE 1 100 0.00 1.00000000000 BIT_MASK 0x1 FORMAT "%13.11" ECU_ADDRESS 0x700008B9 /end MEASUREMENT
/begin MEASUREMENT CstrPurg_flgDiagCpv1PSnsrHiLoad "Diag CPV Bank1 in the high load purge line using a pressure sensor based algorithm (Released via code word)" UBYTE B_TRUE 1 100 0.00 1.00000000000 BIT_MASK 0x1 FORMAT "%13.11" ECU_ADDRESS 0x700008B8 /end MEASUREMENT
/begin MEASUREMENT CstrPurg_flgDiagCpv1PSnsrLoLoad "Diag CPV Bank1 in the low load purge line using a pressure sensor based algorithm (Released via code word)" UBYTE B_TRUE 1 100 0.00 1.00000000000 BIT_MASK 0x1 FORMAT "%13.11" ECU_ADDRESS 0x700008B7 /end MEASUREMENT
/begin MEASUREMENT CstrPurg_flgDiagCpv2CCHiLoad "Diag CPV Bank2 in the high load purge line using the Cross Correlation algorithm (Released via code word)" UBYTE B_TRUE 1 100 0.00 1.00000000000 BIT_MASK 0x1 FORMAT "%13.11" ECU_ADDRESS 0x700008B6 /end MEASUREMENT
/begin MEASUREMENT CstrPurg_flgDiagCpv2CCLoLoad "Diag CPV Bank2 in the low load purge line using the Cross Correlation algorithm (Released via code word)" UBYTE B_TRUE 1 100 0.00 1.00000000000 BIT_MASK 0x1 FORMAT "%13.11" ECU_ADDRESS 0x700008B5 /end MEASUREMENT
/begin MEASUREMENT CstrPurg_flgDiagCpv2PSnsrHiLoad "Diag CPV Bank2 in the high load purge line using a pressure sensor based algorithm (Release via code word)" UBYTE B_TRUE 1 100 0.00 1.00000000000 BIT_MASK 0x1 FORMAT "%13.11" ECU_ADDRESS 0x700008B4 /end MEASUREMENT
/begin MEASUREMENT CstrPurg_flgDiagCpv2PSnsrLoLoad "Diag CPV Bank2 in the low load purge line using a pressure sensor based algorithm (Release via code word)" UBYTE B_TRUE 1 100 0.00 1.00000000000 BIT_MASK 0x1 FORMAT "%13.11" ECU_ADDRESS 0x700008B3 /end MEASUREMENT
/begin MEASUREMENT CstrPurg_flgElecDiagEnad "Condition to enable Electrical Diagnosis of CPV" UBYTE B_TRUE 1 100 0.00 1.00000000000 BIT_MASK 0x1 FORMAT "%13.11" ECU_ADDRESS 0x6000659E /end MEASUREMENT
/begin MEASUREMENT CstrPurg_stCpvElecErrDiag "status of the standard powerstage diagnosis of the CPV" ULONG dez 1 100 0.00 4294967295.00 FORMAT "%13.2" ECU_ADDRESS 0x500011A4 /end MEASUREMENT
/begin MEASUREMENT DSM_SRCIntk11Max "Local variable for Intake valve electrical diagnosis result" ULONG OneToOne 1 100 0.00 4294967295.00 FORMAT "%13.2" ECU_ADDRESS 0x70001A30 /end MEASUREMENT
/begin MEASUREMENT DSM_SRCIntk11Min "Local variable for Intake valve Electrical diagnosis result" ULONG OneToOne 1 100 0.00 4294967295.00 FORMAT "%13.2" ECU_ADDRESS 0x70001A2C /end MEASUREMENT
/begin MEASUREMENT DsplECU_ctMETARngCnt_MP "Measurement point for received Ring counter value of metf" UBYTE OneToOne 1 100 0.00 255.0 FORMAT "%5.1" ECU_ADDRESS 0x70008DAF /end MEASUREMENT
/begin MEASUREMENT DsplECU_ctMETCRngCnt_MP "Alive counter measurement point" UBYTE OneToOne 1 100 0.00 255.0 FORMAT "%5.1" ECU_ADDRESS 0x70008DAE /end MEASUREMENT
/begin MEASUREMENT DsplECU_ctMETDRngCnt_MP "Measurement point for received Ring counter value" UBYTE OneToOne 1 100 0.00 255.0 FORMAT "%5.1" ECU_ADDRESS 0x70008DAD /end MEASUREMENT
/begin MEASUREMENT DsplECU_ctMETE2RngCnt_MP "Alive counter measurement point for SRSB METE2" UBYTE OneToOne 1 100 0.00 255.0 FORMAT "%5.1" ECU_ADDRESS 0x70008DAC /end MEASUREMENT
/begin MEASUREMENT DsplECU_ctMETFRngCnt_MP "Received ring counter value of METF" UBYTE OneToOne 1 100 0.00 255.0 FORMAT "%5.1" ECU_ADDRESS 0x70008DAB /end MEASUREMENT
/begin MEASUREMENT DsplECU_ctMETGRngCnt_MP "Alive counter measurement point" UBYTE OneToOne 1 100 0.00 255.0 FORMAT "%5.1" ECU_ADDRESS 0x70008DAA /end MEASUREMENT
/begin MEASUREMENT DsplECU_ctMETH2RngCnt_MP "Alive counter measurement point for METH2" UBYTE OneToOne 1 100 0.00 255.0 FORMAT "%5.1" ECU_ADDRESS 0x70008DA8 /end MEASUREMENT
/begin MEASUREMENT DsplECU_ctMETHRngCnt_MP "Alive counter measurement point for SRSB METH" UBYTE OneToOne 1 100 0.00 255.0 FORMAT "%5.1" ECU_ADDRESS 0x70008DA9 /end MEASUREMENT
/begin MEASUREMENT DsplECU_ctMETLRngCnt_MP "Alive counter measurement point" UBYTE OneToOne 1 100 0.00 255.0 FORMAT "%5.1" ECU_ADDRESS 0x70008DA5 /end MEASUREMENT
/begin MEASUREMENT DsplECU_ctMETMRngCnt_MP "Alive counter measurement point" UBYTE OneToOne 1 100 0.00 255.0 FORMAT "%5.1" ECU_ADDRESS 0x70008DA4 /end MEASUREMENT
/begin MEASUREMENT DsplECU_ctMETNRngCnt_MP "Error couter for METN Frame" UBYTE OneToOne 1 100 0.00 255.0 FORMAT "%5.1" ECU_ADDRESS 0x70008DA3 /end MEASUREMENT
/begin MEASUREMENT DsplECU_ctRngMETI_MP "Alive counter measurement point" UBYTE OneToOne 1 100 0.00 255.0 FORMAT "%5.1" ECU_ADDRESS 0x70008DA7 /end MEASUREMENT
/begin MEASUREMENT DsplECU_ctRngMETK_MP "Alive counter measurement point" UBYTE OneToOne 1 100 0.00 255.0 FORMAT "%5.1" ECU_ADDRESS 0x70008DA6 /end MEASUREMENT
/begin MEASUREMENT DTR_valLoLim.DTR_OBDMID_01_TID_DTLTR "lower limits (Mode06) / lower limit of diagnostic test result DTR_OBDMID_01_TID_DTLTR" UWORD DFC_OneToOne 1 100 0.00 65535.00 FORMAT "%8.2" ECU_ADDRESS 0x60035F3C /end MEASUREMENT
/begin MEASUREMENT DTR_valLoLim.DTR_OBDMID_01_TID_DTRTL "lower limits (Mode06) / lower limit of diagnostic test result DTR_OBDMID_01_TID_DTRTL" UWORD DFC_OneToOne 1 100 0.00 65535.00 FORMAT "%8.2" ECU_ADDRESS 0x60035F3E /end MEASUREMENT
/begin MEASUREMENT DTR_valLoLim.DTR_OBDMID_01_TID_OFFSN "lower limits (Mode06) / lower limit of diagnostic test result DTR_OBDMID_01_TID_OFFSN" UWORD DFC_OneToOne 1 100 0.00 65535.00 FORMAT "%8.2" ECU_ADDRESS 0x60035F40 /end MEASUREMENT
/begin MEASUREMENT DTR_valLoLim.DTR_OBDMID_01_TID_OFFSP "lower limits (Mode06) / lower limit of diagnostic test result DTR_OBDMID_01_TID_OFFSP" UWORD DFC_OneToOne 1 100 0.00 65535.00 FORMAT "%8.2" ECU_ADDRESS 0x60035F42 /end MEASUREMENT
/begin MEASUREMENT DTR_valLoLim.DTR_OBDMID_01_TID_SnsrMntdDiag "lower limits (Mode06) / lower limit of diagnostic test result DTR_OBDMID_01_TID_SnsrMntdDiag" UWORD DFC_OneToOne 1 100 0.00 65535.00 FORMAT "%8.2" ECU_ADDRESS 0x60035F44 /end MEASUREMENT
/begin MEASUREMENT DTR_valLoLim.DTR_OBDMID_01_TID_TCLTR "lower limits (Mode06) / lower limit of diagnostic test result DTR_OBDMID_01_TID_TCLTR" UWORD DFC_OneToOne 1 100 0.00 65535.00 FORMAT "%8.2" ECU_ADDRESS 0x60035F46 /end MEASUREMENT
/begin MEASUREMENT DTR_valLoLim.DTR_OBDMID_01_TID_TCRTL "lower limits (Mode06) / lower limit of diagnostic test result DTR_OBDMID_01_TID_TCRTL" UWORD DFC_OneToOne 1 100 0.00 65535.00 FORMAT "%8.2" ECU_ADDRESS 0x60035F48 /end MEASUREMENT
/begin MEASUREMENT DTR_valLoLim.DTR_OBDMID_02_TID_05 "lower limits (Mode06) / lower limit of diagnostic test result DTR_OBDMID_02_TID_05" UWORD DFC_OneToOne 1 100 0.00 65535.00 FORMAT "%8.2" ECU_ADDRESS 0x60035F4A /end MEASUREMENT
/begin MEASUREMENT DTR_valLoLim.DTR_OBDMID_02_TID_06 "lower limits (Mode06) / lower limit of diagnostic test result DTR_OBDMID_02_TID_06" UWORD DFC_OneToOne 1 100 0.00 65535.00 FORMAT "%8.2" ECU_ADDRESS 0x60035F4C /end MEASUREMENT
/begin MEASUREMENT DTR_valLoLim.DTR_OBDMID_02_TID_LtrDly "lower limits (Mode06) / lower limit of diagnostic test result DTR_OBDMID_02_TID_LtrDly" UWORD DFC_OneToOne 1 100 0.00 65535.00 FORMAT "%8.2" ECU_ADDRESS 0x60035F4E /end MEASUREMENT
/begin MEASUREMENT DTR_valLoLim.DTR_OBDMID_02_TID_RtlDly "lower limits (Mode06) / lower limit of diagnostic test result DTR_OBDMID_02_TID_RtlDly" UWORD DFC_OneToOne 1 100 0.00 65535.00 FORMAT "%8.2" ECU_ADDRESS 0x60035F50 /end MEASUREMENT
/begin MEASUREMENT DTR_valLoLim.DTR_OBDMID_02_TID_TarLean "lower limits (Mode06) / lower limit of diagnostic test result DTR_OBDMID_02_TID_TarLean" UWORD DFC_OneToOne 1 100 0.00 65535.00 FORMAT "%8.2" ECU_ADDRESS 0x60035F52 /end MEASUREMENT
/begin MEASUREMENT DTR_valLoLim.DTR_OBDMID_02_TID_TarRich "lower limits (Mode06) / lower limit of diagnostic test result DTR_OBDMID_02_TID_TarRich" UWORD DFC_OneToOne 1 100 0.00 65535.00 FORMAT "%8.2" ECU_ADDRESS 0x60035F54 /end MEASUREMENT
/begin MEASUREMENT DTR_valLoLim.DTR_OBDMID_21_TID_OS "lower limits (Mode06) / lower limit of diagnostic test result DTR_OBDMID_21_TID_OS" UWORD DFC_OneToOne 1 100 0.00 65535.00 FORMAT "%8.2" ECU_ADDRESS 0x60035F56 /end MEASUREMENT
/begin MEASUREMENT DTR_valLoLim.DTR_OBDMID_41_TID_TKER "lower limits (Mode06) / lower limit of diagnostic test result DTR_OBDMID_41_TID_TKER" UWORD DFC_OneToOne 1 100 0.00 65535.00 FORMAT "%8.2" ECU_ADDRESS 0x60035F58 /end MEASUREMENT
/begin MEASUREMENT DTR_valLoLim.DTR_OBDMID_42_TID_HTR "lower limits (Mode06) / lower limit of diagnostic test result DTR_OBDMID_42_TID_HTR" UWORD DFC_OneToOne 1 100 0.00 65535.00 FORMAT "%8.2" ECU_ADDRESS 0x60035F5A /end MEASUREMENT
/begin MEASUREMENT DTR_valLoLim.DTR_OBDMID_a2_TID_0b_0 "lower limits (Mode06) / lower limit of diagnostic test result DTR_OBDMID_a2_TID_0b_0" UWORD DFC_OneToOne 1 100 0.00 65535.00 FORMAT "%8.2" ECU_ADDRESS 0x60035F5C /end MEASUREMENT
/begin MEASUREMENT DTR_valLoLim.DTR_OBDMID_a2_TID_0b_1 "lower limits (Mode06) / lower limit of diagnostic test result DTR_OBDMID_a2_TID_0b_1" UWORD DFC_OneToOne 1 100 0.00 65535.00 FORMAT "%8.2" ECU_ADDRESS 0x60035F5E /end MEASUREMENT
/begin MEASUREMENT DTR_valLoLim.DTR_OBDMID_a2_TID_0b_2 "lower limits (Mode06) / lower limit of diagnostic test result DTR_OBDMID_a2_TID_0b_2" UWORD DFC_OneToOne 1 100 0.00 65535.00 FORMAT "%8.2" ECU_ADDRESS 0x60035F60 /end MEASUREMENT
/begin MEASUREMENT DTR_valLoLim.DTR_OBDMID_a2_TID_0b_3 "lower limits (Mode06) / lower limit of diagnostic test result DTR_OBDMID_a2_TID_0b_3" UWORD DFC_OneToOne 1 100 0.00 65535.00 FORMAT "%8.2" ECU_ADDRESS 0x60035F62 /end MEASUREMENT
/begin MEASUREMENT DTR_valLoLim.DTR_OBDMID_a2_TID_0c_0 "lower limits (Mode06) / lower limit of diagnostic test result DTR_OBDMID_a2_TID_0c_0" UWORD DFC_OneToOne 1 100 0.00 65535.00 FORMAT "%8.2" ECU_ADDRESS 0x60035F64 /end MEASUREMENT
/begin MEASUREMENT DTR_valLoLim.DTR_OBDMID_a2_TID_0c_1 "lower limits (Mode06) / lower limit of diagnostic test result DTR_OBDMID_a2_TID_0c_1" UWORD DFC_OneToOne 1 100 0.00 65535.00 FORMAT "%8.2" ECU_ADDRESS 0x60035F66 /end MEASUREMENT
/begin MEASUREMENT DTR_valLoLim.DTR_OBDMID_a2_TID_0c_2 "lower limits (Mode06) / lower limit of diagnostic test result DTR_OBDMID_a2_TID_0c_2" UWORD DFC_OneToOne 1 100 0.00 65535.00 FORMAT "%8.2" ECU_ADDRESS 0x60035F68 /end MEASUREMENT
/begin MEASUREMENT DTR_valLoLim.DTR_OBDMID_a2_TID_0c_3 "lower limits (Mode06) / lower limit of diagnostic test result DTR_OBDMID_a2_TID_0c_3" UWORD DFC_OneToOne 1 100 0.00 65535.00 FORMAT "%8.2" ECU_ADDRESS 0x60035F6A /end MEASUREMENT
/begin MEASUREMENT DTR_valLoLim.DTR_UegoDummy "lower limits (Mode06) / lower limit of diagnostic test result DTR_UegoDummy" UWORD DFC_OneToOne 1 100 0.00 65535.00 FORMAT "%8.2" ECU_ADDRESS 0x60035F6C /end MEASUREMENT
/begin MEASUREMENT DTR_valLoLim.DTR_UegoOlRCmpS1B1 "lower limits (Mode06) / lower limit of diagnostic test result DTR_UegoOlRCmpS1B1" UWORD DFC_OneToOne 1 100 0.00 65535.00 FORMAT "%8.2" ECU_ADDRESS 0x60035F6E /end MEASUREMENT
/begin MEASUREMENT DTR_valTst.DTR_OBDMID_01_TID_DTLTR "last test value (Mode06) / last test result of DTR_OBDMID_01_TID_DTLTR" UWORD DFC_OneToOne 1 100 0.00 65535.00 FORMAT "%8.2" ECU_ADDRESS 0x60035FA4 /end MEASUREMENT
/begin MEASUREMENT DTR_valTst.DTR_OBDMID_01_TID_DTRTL "last test value (Mode06) / last test result of DTR_OBDMID_01_TID_DTRTL" UWORD DFC_OneToOne 1 100 0.00 65535.00 FORMAT "%8.2" ECU_ADDRESS 0x60035FA6 /end MEASUREMENT
/begin MEASUREMENT DTR_valTst.DTR_OBDMID_01_TID_OFFSN "last test value (Mode06) / last test result of DTR_OBDMID_01_TID_OFFSN" UWORD DFC_OneToOne 1 100 0.00 65535.00 FORMAT "%8.2" ECU_ADDRESS 0x60035FA8 /end MEASUREMENT
/begin MEASUREMENT DTR_valTst.DTR_OBDMID_01_TID_OFFSP "last test value (Mode06) / last test result of DTR_OBDMID_01_TID_OFFSP" UWORD DFC_OneToOne 1 100 0.00 65535.00 FORMAT "%8.2" ECU_ADDRESS 0x60035FAA /end MEASUREMENT
/begin MEASUREMENT DTR_valTst.DTR_OBDMID_01_TID_SnsrMntdDiag "last test value (Mode06) / last test result of DTR_OBDMID_01_TID_SnsrMntdDiag" UWORD DFC_OneToOne 1 100 0.00 65535.00 FORMAT "%8.2" ECU_ADDRESS 0x60035FAC /end MEASUREMENT
/begin MEASUREMENT DTR_valTst.DTR_OBDMID_01_TID_TCLTR "last test value (Mode06) / last test result of DTR_OBDMID_01_TID_TCLTR" UWORD DFC_OneToOne 1 100 0.00 65535.00 FORMAT "%8.2" ECU_ADDRESS 0x60035FAE /end MEASUREMENT
/begin MEASUREMENT DTR_valTst.DTR_OBDMID_01_TID_TCRTL "last test value (Mode06) / last test result of DTR_OBDMID_01_TID_TCRTL" UWORD DFC_OneToOne 1 100 0.00 65535.00 FORMAT "%8.2" ECU_ADDRESS 0x60035FB0 /end MEASUREMENT
/begin MEASUREMENT DTR_valTst.DTR_OBDMID_02_TID_05 "last test value (Mode06) / last test result of DTR_OBDMID_02_TID_05" UWORD DFC_OneToOne 1 100 0.00 65535.00 FORMAT "%8.2" ECU_ADDRESS 0x60035FB2 /end MEASUREMENT
/begin MEASUREMENT DTR_valTst.DTR_OBDMID_02_TID_06 "last test value (Mode06) / last test result of DTR_OBDMID_02_TID_06" UWORD DFC_OneToOne 1 100 0.00 65535.00 FORMAT "%8.2" ECU_ADDRESS 0x60035FB4 /end MEASUREMENT
/begin MEASUREMENT DTR_valTst.DTR_OBDMID_02_TID_LtrDly "last test value (Mode06) / last test result of DTR_OBDMID_02_TID_LtrDly" UWORD DFC_OneToOne 1 100 0.00 65535.00 FORMAT "%8.2" ECU_ADDRESS 0x60035FB6 /end MEASUREMENT
/begin MEASUREMENT DTR_valTst.DTR_OBDMID_02_TID_RtlDly "last test value (Mode06) / last test result of DTR_OBDMID_02_TID_RtlDly" UWORD DFC_OneToOne 1 100 0.00 65535.00 FORMAT "%8.2" ECU_ADDRESS 0x60035FB8 /end MEASUREMENT
/begin MEASUREMENT DTR_valTst.DTR_OBDMID_02_TID_TarLean "last test value (Mode06) / last test result of DTR_OBDMID_02_TID_TarLean" UWORD DFC_OneToOne 1 100 0.00 65535.00 FORMAT "%8.2" ECU_ADDRESS 0x60035FBA /end MEASUREMENT
/begin MEASUREMENT DTR_valTst.DTR_OBDMID_02_TID_TarRich "last test value (Mode06) / last test result of DTR_OBDMID_02_TID_TarRich" UWORD DFC_OneToOne 1 100 0.00 65535.00 FORMAT "%8.2" ECU_ADDRESS 0x60035FBC /end MEASUREMENT
/begin MEASUREMENT DTR_valTst.DTR_OBDMID_21_TID_OS "last test value (Mode06) / last test result of DTR_OBDMID_21_TID_OS" UWORD DFC_OneToOne 1 100 0.00 65535.00 FORMAT "%8.2" ECU_ADDRESS 0x60035FBE /end MEASUREMENT
/begin MEASUREMENT DTR_valTst.DTR_OBDMID_41_TID_TKER "last test value (Mode06) / last test result of DTR_OBDMID_41_TID_TKER" UWORD DFC_OneToOne 1 100 0.00 65535.00 FORMAT "%8.2" ECU_ADDRESS 0x60035FC0 /end MEASUREMENT
/begin MEASUREMENT DTR_valTst.DTR_OBDMID_42_TID_HTR "last test value (Mode06) / last test result of DTR_OBDMID_42_TID_HTR" UWORD DFC_OneToOne 1 100 0.00 65535.00 FORMAT "%8.2" ECU_ADDRESS 0x60035FC2 /end MEASUREMENT
/begin MEASUREMENT DTR_valTst.DTR_OBDMID_a2_TID_0b_0 "last test value (Mode06) / last test result of DTR_OBDMID_a2_TID_0b_0" UWORD DFC_OneToOne 1 100 0.00 65535.00 FORMAT "%8.2" ECU_ADDRESS 0x60035FC4 /end MEASUREMENT
/begin MEASUREMENT DTR_valTst.DTR_OBDMID_a2_TID_0b_1 "last test value (Mode06) / last test result of DTR_OBDMID_a2_TID_0b_1" UWORD DFC_OneToOne 1 100 0.00 65535.00 FORMAT "%8.2" ECU_ADDRESS 0x60035FC6 /end MEASUREMENT
/begin MEASUREMENT DTR_valTst.DTR_OBDMID_a2_TID_0b_2 "last test value (Mode06) / last test result of DTR_OBDMID_a2_TID_0b_2" UWORD DFC_OneToOne 1 100 0.00 65535.00 FORMAT "%8.2" ECU_ADDRESS 0x60035FC8 /end MEASUREMENT
/begin MEASUREMENT DTR_valTst.DTR_OBDMID_a2_TID_0b_3 "last test value (Mode06) / last test result of DTR_OBDMID_a2_TID_0b_3" UWORD DFC_OneToOne 1 100 0.00 65535.00 FORMAT "%8.2" ECU_ADDRESS 0x60035FCA /end MEASUREMENT
/begin MEASUREMENT DTR_valTst.DTR_OBDMID_a2_TID_0c_0 "last test value (Mode06) / last test result of DTR_OBDMID_a2_TID_0c_0" UWORD DFC_OneToOne 1 100 0.00 65535.00 FORMAT "%8.2" ECU_ADDRESS 0x60035FCC /end MEASUREMENT
/begin MEASUREMENT DTR_valTst.DTR_OBDMID_a2_TID_0c_1 "last test value (Mode06) / last test result of DTR_OBDMID_a2_TID_0c_1" UWORD DFC_OneToOne 1 100 0.00 65535.00 FORMAT "%8.2" ECU_ADDRESS 0x60035FCE /end MEASUREMENT
/begin MEASUREMENT DTR_valTst.DTR_OBDMID_a2_TID_0c_2 "last test value (Mode06) / last test result of DTR_OBDMID_a2_TID_0c_2" UWORD DFC_OneToOne 1 100 0.00 65535.00 FORMAT "%8.2" ECU_ADDRESS 0x60035FD0 /end MEASUREMENT
/begin MEASUREMENT DTR_valTst.DTR_OBDMID_a2_TID_0c_3 "last test value (Mode06) / last test result of DTR_OBDMID_a2_TID_0c_3" UWORD DFC_OneToOne 1 100 0.00 65535.00 FORMAT "%8.2" ECU_ADDRESS 0x60035FD2 /end MEASUREMENT
/begin MEASUREMENT DTR_valTst.DTR_UegoDummy "last test value (Mode06) / last test result of DTR_UegoDummy" UWORD DFC_OneToOne 1 100 0.00 65535.00 FORMAT "%8.2" ECU_ADDRESS 0x60035FD4 /end MEASUREMENT
/begin MEASUREMENT DTR_valTst.DTR_UegoOlRCmpS1B1 "last test value (Mode06) / last test result of DTR_UegoOlRCmpS1B1" UWORD DFC_OneToOne 1 100 0.00 65535.00 FORMAT "%8.2" ECU_ADDRESS 0x60035FD6 /end MEASUREMENT
/begin MEASUREMENT DTR_valUpLim.DTR_OBDMID_01_TID_DTLTR "upper limits (Mode06) / upper limit of diagnostic test result DTR_OBDMID_01_TID_DTLTR" UWORD DFC_OneToOne 1 100 0.00 65535.00 FORMAT "%8.2" ECU_ADDRESS 0x60035F70 /end MEASUREMENT
/begin MEASUREMENT DTR_valUpLim.DTR_OBDMID_01_TID_DTRTL "upper limits (Mode06) / upper limit of diagnostic test result DTR_OBDMID_01_TID_DTRTL" UWORD DFC_OneToOne 1 100 0.00 65535.00 FORMAT "%8.2" ECU_ADDRESS 0x60035F72 /end MEASUREMENT
/begin MEASUREMENT DTR_valUpLim.DTR_OBDMID_01_TID_OFFSN "upper limits (Mode06) / upper limit of diagnostic test result DTR_OBDMID_01_TID_OFFSN" UWORD DFC_OneToOne 1 100 0.00 65535.00 FORMAT "%8.2" ECU_ADDRESS 0x60035F74 /end MEASUREMENT
/begin MEASUREMENT DTR_valUpLim.DTR_OBDMID_01_TID_OFFSP "upper limits (Mode06) / upper limit of diagnostic test result DTR_OBDMID_01_TID_OFFSP" UWORD DFC_OneToOne 1 100 0.00 65535.00 FORMAT "%8.2" ECU_ADDRESS 0x60035F76 /end MEASUREMENT
/begin MEASUREMENT DTR_valUpLim.DTR_OBDMID_01_TID_SnsrMntdDiag "upper limits (Mode06) / upper limit of diagnostic test result DTR_OBDMID_01_TID_SnsrMntdDiag" UWORD DFC_OneToOne 1 100 0.00 65535.00 FORMAT "%8.2" ECU_ADDRESS 0x60035F78 /end MEASUREMENT
/begin MEASUREMENT DTR_valUpLim.DTR_OBDMID_01_TID_TCLTR "upper limits (Mode06) / upper limit of diagnostic test result DTR_OBDMID_01_TID_TCLTR" UWORD DFC_OneToOne 1 100 0.00 65535.00 FORMAT "%8.2" ECU_ADDRESS 0x60035F7A /end MEASUREMENT
/begin MEASUREMENT DTR_valUpLim.DTR_OBDMID_01_TID_TCRTL "upper limits (Mode06) / upper limit of diagnostic test result DTR_OBDMID_01_TID_TCRTL" UWORD DFC_OneToOne 1 100 0.00 65535.00 FORMAT "%8.2" ECU_ADDRESS 0x60035F7C /end MEASUREMENT
/begin MEASUREMENT DTR_valUpLim.DTR_OBDMID_02_TID_05 "upper limits (Mode06) / upper limit of diagnostic test result DTR_OBDMID_02_TID_05" UWORD DFC_OneToOne 1 100 0.00 65535.00 FORMAT "%8.2" ECU_ADDRESS 0x60035F7E /end MEASUREMENT
/begin MEASUREMENT DTR_valUpLim.DTR_OBDMID_02_TID_06 "upper limits (Mode06) / upper limit of diagnostic test result DTR_OBDMID_02_TID_06" UWORD DFC_OneToOne 1 100 0.00 65535.00 FORMAT "%8.2" ECU_ADDRESS 0x60035F80 /end MEASUREMENT
/begin MEASUREMENT DTR_valUpLim.DTR_OBDMID_02_TID_LtrDly "upper limits (Mode06) / upper limit of diagnostic test result DTR_OBDMID_02_TID_LtrDly" UWORD DFC_OneToOne 1 100 0.00 65535.00 FORMAT "%8.2" ECU_ADDRESS 0x60035F82 /end MEASUREMENT
/begin MEASUREMENT DTR_valUpLim.DTR_OBDMID_02_TID_RtlDly "upper limits (Mode06) / upper limit of diagnostic test result DTR_OBDMID_02_TID_RtlDly" UWORD DFC_OneToOne 1 100 0.00 65535.00 FORMAT "%8.2" ECU_ADDRESS 0x60035F84 /end MEASUREMENT
/begin MEASUREMENT DTR_valUpLim.DTR_OBDMID_02_TID_TarLean "upper limits (Mode06) / upper limit of diagnostic test result DTR_OBDMID_02_TID_TarLean" UWORD DFC_OneToOne 1 100 0.00 65535.00 FORMAT "%8.2" ECU_ADDRESS 0x60035F86 /end MEASUREMENT
/begin MEASUREMENT DTR_valUpLim.DTR_OBDMID_02_TID_TarRich "upper limits (Mode06) / upper limit of diagnostic test result DTR_OBDMID_02_TID_TarRich" UWORD DFC_OneToOne 1 100 0.00 65535.00 FORMAT "%8.2" ECU_ADDRESS 0x60035F88 /end MEASUREMENT
/begin MEASUREMENT DTR_valUpLim.DTR_OBDMID_21_TID_OS "upper limits (Mode06) / upper limit of diagnostic test result DTR_OBDMID_21_TID_OS" UWORD DFC_OneToOne 1 100 0.00 65535.00 FORMAT "%8.2" ECU_ADDRESS 0x60035F8A /end MEASUREMENT
/begin MEASUREMENT DTR_valUpLim.DTR_OBDMID_41_TID_TKER "upper limits (Mode06) / upper limit of diagnostic test result DTR_OBDMID_41_TID_TKER" UWORD DFC_OneToOne 1 100 0.00 65535.00 FORMAT "%8.2" ECU_ADDRESS 0x60035F8C /end MEASUREMENT
/begin MEASUREMENT DTR_valUpLim.DTR_OBDMID_42_TID_HTR "upper limits (Mode06) / upper limit of diagnostic test result DTR_OBDMID_42_TID_HTR" UWORD DFC_OneToOne 1 100 0.00 65535.00 FORMAT "%8.2" ECU_ADDRESS 0x60035F8E /end MEASUREMENT
/begin MEASUREMENT DTR_valUpLim.DTR_OBDMID_a2_TID_0b_0 "upper limits (Mode06) / upper limit of diagnostic test result DTR_OBDMID_a2_TID_0b_0" UWORD DFC_OneToOne 1 100 0.00 65535.00 FORMAT "%8.2" ECU_ADDRESS 0x60035F90 /end MEASUREMENT
/begin MEASUREMENT DTR_valUpLim.DTR_OBDMID_a2_TID_0b_1 "upper limits (Mode06) / upper limit of diagnostic test result DTR_OBDMID_a2_TID_0b_1" UWORD DFC_OneToOne 1 100 0.00 65535.00 FORMAT "%8.2" ECU_ADDRESS 0x60035F92 /end MEASUREMENT
/begin MEASUREMENT DTR_valUpLim.DTR_OBDMID_a2_TID_0b_2 "upper limits (Mode06) / upper limit of diagnostic test result DTR_OBDMID_a2_TID_0b_2" UWORD DFC_OneToOne 1 100 0.00 65535.00 FORMAT "%8.2" ECU_ADDRESS 0x60035F94 /end MEASUREMENT
/begin MEASUREMENT DTR_valUpLim.DTR_OBDMID_a2_TID_0b_3 "upper limits (Mode06) / upper limit of diagnostic test result DTR_OBDMID_a2_TID_0b_3" UWORD DFC_OneToOne 1 100 0.00 65535.00 FORMAT "%8.2" ECU_ADDRESS 0x60035F96 /end MEASUREMENT
/begin MEASUREMENT DTR_valUpLim.DTR_OBDMID_a2_TID_0c_0 "upper limits (Mode06) / upper limit of diagnostic test result DTR_OBDMID_a2_TID_0c_0" UWORD DFC_OneToOne 1 100 0.00 65535.00 FORMAT "%8.2" ECU_ADDRESS 0x60035F98 /end MEASUREMENT
/begin MEASUREMENT DTR_valUpLim.DTR_OBDMID_a2_TID_0c_1 "upper limits (Mode06) / upper limit of diagnostic test result DTR_OBDMID_a2_TID_0c_1" UWORD DFC_OneToOne 1 100 0.00 65535.00 FORMAT "%8.2" ECU_ADDRESS 0x60035F9A /end MEASUREMENT
/begin MEASUREMENT DTR_valUpLim.DTR_OBDMID_a2_TID_0c_2 "upper limits (Mode06) / upper limit of diagnostic test result DTR_OBDMID_a2_TID_0c_2" UWORD DFC_OneToOne 1 100 0.00 65535.00 FORMAT "%8.2" ECU_ADDRESS 0x60035F9C /end MEASUREMENT
/begin MEASUREMENT DTR_valUpLim.DTR_OBDMID_a2_TID_0c_3 "upper limits (Mode06) / upper limit of diagnostic test result DTR_OBDMID_a2_TID_0c_3" UWORD DFC_OneToOne 1 100 0.00 65535.00 FORMAT "%8.2" ECU_ADDRESS 0x60035F9E /end MEASUREMENT
/begin MEASUREMENT DTR_valUpLim.DTR_UegoDummy "upper limits (Mode06) / upper limit of diagnostic test result DTR_UegoDummy" UWORD DFC_OneToOne 1 100 0.00 65535.00 FORMAT "%8.2" ECU_ADDRESS 0x60035FA0 /end MEASUREMENT
/begin MEASUREMENT DTR_valUpLim.DTR_UegoOlRCmpS1B1 "upper limits (Mode06) / upper limit of diagnostic test result DTR_UegoOlRCmpS1B1" UWORD DFC_OneToOne 1 100 0.00 65535.00 FORMAT "%8.2" ECU_ADDRESS 0x60035FA2 /end MEASUREMENT
/begin MEASUREMENT EBBA_ctEBBARngCnt_MP "Measuring Point for EBBA Ring Counter" UBYTE OneToOne 1 100 0.00 3.000 FORMAT "%5.3" ECU_ADDRESS 0x70008DA2 /end MEASUREMENT
/begin MEASUREMENT Ebs_cntrAcmChrgOvf "Counter for indication of number of times overflow has occured in accumulated battery charge value received from EBS" UWORD OneToOne 1 100 0.00 65535.00 FORMAT "%8.2" ECU_ADDRESS 0x60003BC8 /end MEASUREMENT
/begin MEASUREMENT Ebs_cntrAcmDchaOvf "Counter to indicate overflow in accumulated battery discharge" UWORD OneToOne 1 100 0.00 65535.00 FORMAT "%8.2" ECU_ADDRESS 0x60003BC6 /end MEASUREMENT
/begin MEASUREMENT Ebs_cntrBattEbs "Value of EBS counter for internal resistance measurement" UBYTE OneToOne 1 100 0.00 255.0 FORMAT "%5.1" ECU_ADDRESS 0x6003477C /end MEASUREMENT
/begin MEASUREMENT Ebs_cntrIntResUpdPrev "Previous value of the counter for intermal resistance measurement" UBYTE OneToOne 1 100 0.00 255.0 FORMAT "%5.1" ECU_ADDRESS 0x600366D8 /end MEASUREMENT
/begin MEASUREMENT Ebs_cntrSocFlt1 "Counter to indicate number of times SOC fault level 1 is detected" UBYTE OneToOne 1 100 0.00 255.0 FORMAT "%5.1" ECU_ADDRESS 0x60006597 /end MEASUREMENT
/begin MEASUREMENT Ebs_cntrSocFlt2 "Counter to indicate number of times SOC fault level 2 is detected" UBYTE OneToOne 1 100 0.00 255.0 FORMAT "%5.1" ECU_ADDRESS 0x60006596 /end MEASUREMENT
/begin MEASUREMENT Ebs_facRCorrn "Factor for correction of internal resistance of battery based on battery temperature" SWORD Fact1000 1 100 0.00 2.550000 FORMAT "%8.6" ECU_ADDRESS 0x60004B06 /end MEASUREMENT
/begin MEASUREMENT Ebs_flgBliChrgCalcnCmpl "Flag of blind charge calculation is complete" UBYTE B_TRUE 1 100 0.00 1.00000000000 BIT_MASK 0x1 FORMAT "%13.11" ECU_ADDRESS 0x60009FAF /end MEASUREMENT
/begin MEASUREMENT Ebs_flgRst "EBS after reset" UBYTE B_TRUE 1 100 0.00 1.00000000000 BIT_MASK 0x1 FORMAT "%13.11" ECU_ADDRESS 0x60009FAE /end MEASUREMENT
/begin MEASUREMENT Ebs_flgSOCFlt "Flag to indicate the IBS SOC error when 1% change or no change in IBS SOC reached the threshold" UBYTE B_TRUE 1 100 0.00 1.00000000000 BIT_MASK 0x1 FORMAT "%13.11" ECU_ADDRESS 0x60009FAD /end MEASUREMENT
/begin MEASUREMENT Ebs_flgTestActv "Flag to indicate if SOC plausibility test is active" UBYTE B_TRUE 1 100 0.00 1.00000000000 BIT_MASK 0x1 FORMAT "%13.11" ECU_ADDRESS 0x60006595 /end MEASUREMENT
/begin MEASUREMENT Ebs_iBattFild "Sensor value battery current" SWORD Curr_A 1 100 -327.6800 327.6700 FORMAT "%8.4" ECU_ADDRESS 0x60004B04 /end MEASUREMENT
/begin MEASUREMENT Ebs_iStbIAft0HrDcyc "The Battery current at transition to LIN off" SWORD i_q0p01_A 1 100 -327.6800 327.6700 FORMAT "%8.4" ARRAY_SIZE 5 ECU_ADDRESS 0x600366B8 /end MEASUREMENT
/begin MEASUREMENT Ebs_qBliChrg "Blind charge by battery" ULONG q0p01_A_h_1 1 100 0.00 42949672.9500 FORMAT "%13.4" ECU_ADDRESS 0x60001BE8 /end MEASUREMENT
/begin MEASUREMENT Ebs_qBliDcha "Blind discharge by battery" ULONG q0p01_A_h_1 1 100 0.00 42949672.9500 FORMAT "%13.4" ECU_ADDRESS 0x50004C40 /end MEASUREMENT
/begin MEASUREMENT Ebs_qBliDchaTot "Total blind discharge current" ULONG q0p01_A_h_1 1 100 0.00 42949672.9500 FORMAT "%13.4" ECU_ADDRESS 0x50004C44 /end MEASUREMENT
/begin MEASUREMENT Ebs_qBliDchaTotDcyc "The total discharge amount for Dark current hystory function" ULONG q0p01_A_h_1 1 100 0.00 42949672.9500 FORMAT "%13.4" ARRAY_SIZE 5 ECU_ADDRESS 0x600366A4 /end MEASUREMENT
/begin MEASUREMENT Ebs_qChrgDchaDif "Difference between battery accumulated charge and discharge" ULONG q0p01_A_h_1 1 100 0.00 42949672.9500 FORMAT "%13.4" ECU_ADDRESS 0x50001488 /end MEASUREMENT
/begin MEASUREMENT Ebs_qChrgDurgT15Off "Battery charge level before last ignition off" SLONG q0p01_A_h_1 1 100 -21474836.4800 21474836.4700 FORMAT "%13.4" ECU_ADDRESS 0x600366D4 /end MEASUREMENT
/begin MEASUREMENT Ebs_qChrgDurgT15On "Battery charge level during ignition on" SLONG q0p01_A_h_1 1 100 -21474836.4800 21474836.4700 FORMAT "%13.4" ECU_ADDRESS 0x5000148C /end MEASUREMENT
/begin MEASUREMENT Ebs_qChrgPrev "Previous value of battery charge from EBS" SLONG q0p01_A_h_1 1 100 -21474836.4800 21474836.4700 FORMAT "%13.4" ECU_ADDRESS 0x50001490 /end MEASUREMENT
/begin MEASUREMENT Ebs_qChrgRef "Refernce value of battery charge" SLONG q0p01_A_h_1 1 100 -21474836.4800 21474836.4700 FORMAT "%13.4" ECU_ADDRESS 0x600017C0 /end MEASUREMENT
/begin MEASUREMENT Ebs_qChrgSum "Accumulated battery charge received from EBS" SLONG q0p01_A_h_1 1 100 -21474836.4800 21474836.4700 FORMAT "%13.4" ECU_ADDRESS 0x600017BC /end MEASUREMENT
/begin MEASUREMENT Ebs_qDchaDurgT15Off "Battery discharge during last ignition off" SLONG q0p01_A_h_1 1 100 -21474836.4800 21474836.4700 FORMAT "%13.4" ECU_ADDRESS 0x600366D0 /end MEASUREMENT
/begin MEASUREMENT Ebs_qDchaDurgT15On "Battery discharge during ignition on" SLONG q0p01_A_h_1 1 100 -21474836.4800 21474836.4700 FORMAT "%13.4" ECU_ADDRESS 0x600017B8 /end MEASUREMENT
/begin MEASUREMENT Ebs_qDchaPrev "Previous value of accumulated battery discharge" SLONG q0p01_A_h_1 1 100 -21474836.4800 21474836.4700 FORMAT "%13.4" ECU_ADDRESS 0x600017B4 /end MEASUREMENT
/begin MEASUREMENT Ebs_qDchaRef "Refernce value of accumulated battery discharge" SLONG q0p01_A_h_1 1 100 -21474836.4800 21474836.4700 FORMAT "%13.4" ECU_ADDRESS 0x600017B0 /end MEASUREMENT
/begin MEASUREMENT Ebs_qDchaSum "Accumulated battery discharge received form EBS" SLONG q0p01_A_h_1 1 100 -21474836.4800 21474836.4700 FORMAT "%13.4" ECU_ADDRESS 0x600017AC /end MEASUREMENT
/begin MEASUREMENT Ebs_qIntegdICmp "Integrated current value for compensation" SLONG q0p01_A_h_1 1 100 -21474836.4800 21474836.4700 FORMAT "%13.4" ECU_ADDRESS 0x60001C1C /end MEASUREMENT
/begin MEASUREMENT Ebs_qSohFild "Sensor value SOH (State of health)" SWORD ElecChrg_Ah_q0p125_COMPU 1 100 -4096.000 4095.875 FORMAT "%8.3" ECU_ADDRESS 0x60004B02 /end MEASUREMENT
/begin MEASUREMENT Ebs_qSohFildHist "ENV RAM variable which stores the filtered qSoh value from COM" SWORD ElecChrg_Ah_q0p125_COMPU 1 100 -4096.000 4095.875 FORMAT "%8.3" ECU_ADDRESS 0x600366CC /end MEASUREMENT
/begin MEASUREMENT Ebs_qStbIAft1HrDcyc "The Integrated battery current 1hr after transition to LIN off" SWORD q0p01_A_h_1 1 100 -327.6800 327.6700 FORMAT "%8.4" ARRAY_SIZE 5 ECU_ADDRESS 0x6003669A /end MEASUREMENT
/begin MEASUREMENT Ebs_qStbIAft2HrDcyc "The Integrated battery current 2hr after transition to LIN off" SWORD q0p01_A_h_1 1 100 -327.6800 327.6700 FORMAT "%8.4" ARRAY_SIZE 5 ECU_ADDRESS 0x60036690 /end MEASUREMENT
/begin MEASUREMENT Ebs_qStbILastDcyc "The Integrated battery current during last hour just before transition to LIN ON" SWORD q0p01_A_h_1 1 100 -327.6800 327.6700 FORMAT "%8.4" ARRAY_SIZE 5 ECU_ADDRESS 0x60036686 /end MEASUREMENT
/begin MEASUREMENT Ebs_qTotBliDcha "Total Blind discharge value including negative values" SLONG q0p01_A_h_1 1 100 -21474836.4800 21474836.4700 FORMAT "%13.4" ECU_ADDRESS 0x50004C48 /end MEASUREMENT
/begin MEASUREMENT Ebs_ratEstimdDeltaSoc "Delts SOC ratio estimated based on accumulated charge and discharge of battery" UWORD RBPtCel_Perc_0p5_1 1 100 0.00 32767.50 FORMAT "%8.2" ECU_ADDRESS 0x60003BC4 /end MEASUREMENT
/begin MEASUREMENT Ebs_ratSoc "Battery SOC used for plausibility check" UBYTE RBPtCel_Perc_0p5_1 1 100 0.00 127.5 FORMAT "%5.1" ECU_ADDRESS 0x60006594 /end MEASUREMENT
/begin MEASUREMENT Ebs_ratSocFild "Sensor value SOC (State of charge)" UBYTE RBPtCel_Perc_0p5_1 1 100 0.00 127.5 FORMAT "%5.1" ECU_ADDRESS 0x6000A073 /end MEASUREMENT
/begin MEASUREMENT Ebs_ratSocFildHist "ENV RAM variable which stores the filtered ratSoc form COM." UBYTE RBPtCel_Perc_0p5_1 1 100 0.00 127.5 FORMAT "%5.1" ECU_ADDRESS 0x600366CA /end MEASUREMENT
/begin MEASUREMENT Ebs_ratSocHist "History value of SOC ratio from EBS in previous driving cycle" UBYTE RBPtCel_Perc_0p5_1 1 100 0.00 127.5 FORMAT "%5.1" ECU_ADDRESS 0x60036685 /end MEASUREMENT
/begin MEASUREMENT Ebs_ratSohFild "Sensor value SOH (State of health)" SWORD Prc 1 100 0.00 399.9878 FORMAT "%8.4" ECU_ADDRESS 0x60004AFA /end MEASUREMENT
/begin MEASUREMENT Ebs_ratSohFildHist "ENV RAM variable which stores the filtered ratSoh value from COM" SWORD Prc 1 100 -400.0000 399.9878 FORMAT "%8.4" ECU_ADDRESS 0x600366C8 /end MEASUREMENT
/begin MEASUREMENT Ebs_rBatt "Average battery resistance over driving cycles" SWORD RBPtCel_r_0p00001_1 1 100 -0.3276800 0.3276700 FORMAT "%9.7" ECU_ADDRESS 0x60004B00 /end MEASUREMENT
/begin MEASUREMENT Ebs_rBattAct "Inner resistance of battery" SWORD RBPtCel_r_0p00001_1 1 100 -0.3276800 0.3276700 FORMAT "%9.7" ECU_ADDRESS 0x60004AFE /end MEASUREMENT
/begin MEASUREMENT Ebs_rBattActSum "Sum of battery resistance measured" SLONG RBPtCel_r_0p00001_1 1 100 -21474.8364800 21474.8364700 FORMAT "%13.7" ECU_ADDRESS 0x60034778 /end MEASUREMENT
/begin MEASUREMENT Ebs_rBattMeasd "Battery resistance measured by EBS" SWORD RBPtCel_r_0p00001_1 1 100 -0.3276800 0.3276700 FORMAT "%9.7" ECU_ADDRESS 0x60004AFC /end MEASUREMENT
/begin MEASUREMENT Ebs_stBattInvld "Battery temperature invalid due to EBS reset" UBYTE B_TRUE 1 100 0.00 1.00000000000 BIT_MASK 0x1 FORMAT "%13.11" ECU_ADDRESS 0x60009FAC /end MEASUREMENT
/begin MEASUREMENT Ebs_stBattRVld "Status of valid measurement of battery internal resistance" UBYTE B_TRUE 1 100 0.00 1.00000000000 BIT_MASK 0x1 FORMAT "%13.11" ECU_ADDRESS 0x60009FAB /end MEASUREMENT
/begin MEASUREMENT Ebs_stBattTempInvld "Status to indicate if battery temperature is invalid" UBYTE B_TRUE 1 100 0.00 1.00000000000 BIT_MASK 0x1 FORMAT "%13.11" ECU_ADDRESS 0x60034775 /end MEASUREMENT
/begin MEASUREMENT Ebs_stChkSocPlausy1 "Status of check for SOC plausibility check 1" UBYTE OneToOne 1 100 0.00 255.0 FORMAT "%5.1" ECU_ADDRESS 0x60006593 /end MEASUREMENT
/begin MEASUREMENT Ebs_stChkSocPlausy2 "Status of check for SOC plausibility check 2" UBYTE OneToOne 1 100 0.00 255.0 FORMAT "%5.1" ECU_ADDRESS 0x60006592 /end MEASUREMENT
/begin MEASUREMENT Ebs_stEbsPlausyChk "Status of EBS plausibility checks" UBYTE B_TRUE 1 100 0.00 1.00000000000 BIT_MASK 0x1 FORMAT "%13.11" ECU_ADDRESS 0x60009FAA /end MEASUREMENT
/begin MEASUREMENT Ebs_stEngSt "Status of transition of engine state" UBYTE B_TRUE 1 100 0.00 1.00000000000 BIT_MASK 0x1 FORMAT "%13.11" ECU_ADDRESS 0x60006591 /end MEASUREMENT
/begin MEASUREMENT Ebs_stErr "Sensor values not valid (Initialisation, communication fault, measurement error)" UBYTE OneToOne 1 100 0.00 255.0 FORMAT "%5.1" ECU_ADDRESS 0x6000A072 /end MEASUREMENT
/begin MEASUREMENT Ebs_stIMonUpdEna "Status active IMON operation" UBYTE B_TRUE 1 100 0.00 1.00000000000 BIT_MASK 0x1 FORMAT "%13.11" ECU_ADDRESS 0x60034774 /end MEASUREMENT
/begin MEASUREMENT Ebs_stIMonUp_MP "Measurement point status IMON enable" UBYTE B_TRUE 1 100 0.00 1.00000000000 BIT_MASK 0x1 FORMAT "%13.11" ECU_ADDRESS 0x70008DA1 /end MEASUREMENT
/begin MEASUREMENT Ebs_stRErr_MP "Status of error in battery resistance signal received from EBS" UBYTE B_TRUE 1 100 0.00 1.00000000000 BIT_MASK 0x1 FORMAT "%13.11" ECU_ADDRESS 0x70008DA0 /end MEASUREMENT
/begin MEASUREMENT Ebs_stRInhbSpst "Inhibit Stop-Start functionality" UBYTE B_TRUE 1 100 0.00 1.00000000000 BIT_MASK 0x1 FORMAT "%13.11" ECU_ADDRESS 0x60009FA9 /end MEASUREMENT
/begin MEASUREMENT Ebs_stRMsrmnt_MP "Status of error in measurement of battery resistance" UBYTE B_TRUE 1 100 0.00 1.00000000000 BIT_MASK 0x1 FORMAT "%13.11" ECU_ADDRESS 0x70008D9F /end MEASUREMENT
/begin MEASUREMENT Ebs_stRSumOvf "Overflow check for total battery resistance" UBYTE B_TRUE 1 100 0.00 1.00000000000 BIT_MASK 0x1 FORMAT "%13.11" ECU_ADDRESS 0x60006590 /end MEASUREMENT
/begin MEASUREMENT Ebs_stSelfDiagErrEna "Status of EBS self-diagnosis error" UBYTE B_TRUE 1 100 0.00 1.00000000000 BIT_MASK 0x1 FORMAT "%13.11" ECU_ADDRESS 0x60009FA8 /end MEASUREMENT
/begin MEASUREMENT Ebs_stSocErrChk "Status of SOC error check" UBYTE OneToOne 1 100 0.00 255.0 FORMAT "%5.1" ECU_ADDRESS 0x6003476E /end MEASUREMENT
/begin MEASUREMENT Ebs_stStbIEBSByt0 "EBSD Byte 0 Raw value for dark current hystory function" UBYTE OneToOne 1 100 0.00 255.0 FORMAT "%5.1" ARRAY_SIZE 5 ECU_ADDRESS 0x60036680 /end MEASUREMENT
/begin MEASUREMENT Ebs_stStbIEBSByt1 "EBSD Byte 1 Raw value for dark current hystory function" UBYTE OneToOne 1 100 0.00 255.0 FORMAT "%5.1" ARRAY_SIZE 5 ECU_ADDRESS 0x6003667B /end MEASUREMENT
/begin MEASUREMENT Ebs_stStbIEBSByt2 "EBSD Byte 2 Raw value for dark current hystory function" UBYTE OneToOne 1 100 0.00 255.0 FORMAT "%5.1" ARRAY_SIZE 5 ECU_ADDRESS 0x60036676 /end MEASUREMENT
/begin MEASUREMENT Ebs_stStbIEBSByt3 "EBSD Byte 3 Raw value for dark current hystory function" UBYTE OneToOne 1 100 0.00 255.0 FORMAT "%5.1" ARRAY_SIZE 5 ECU_ADDRESS 0x60036671 /end MEASUREMENT
/begin MEASUREMENT Ebs_stStbIEBSByt4 "EBSD Byte 4 Raw value for dark current hystory function" UBYTE OneToOne 1 100 0.00 255.0 FORMAT "%5.1" ARRAY_SIZE 5 ECU_ADDRESS 0x6003666C /end MEASUREMENT
/begin MEASUREMENT Ebs_stStrtRMsrmnt "Start of battery resistance measurement" UBYTE B_TRUE 1 100 0.00 1.00000000000 BIT_MASK 0x1 FORMAT "%13.11" ECU_ADDRESS 0x6000658F /end MEASUREMENT
/begin MEASUREMENT Ebs_stStrtTmrCond "Status of condition to start timer for resistance measurement" UBYTE B_TRUE 1 100 0.00 1.00000000000 BIT_MASK 0x1 FORMAT "%13.11" ECU_ADDRESS 0x700002C7 /end MEASUREMENT
/begin MEASUREMENT Ebs_stT50 "Status of key-start detection" UBYTE B_TRUE 1 100 0.00 1.00000000000 BIT_MASK 0x1 FORMAT "%13.11" ECU_ADDRESS 0x600340E6 /end MEASUREMENT
/begin MEASUREMENT Ebs_tBattFild "Temperature from battery sensor after modeling" SWORD SCR_TEMP_CELS_float 1 100 -32768.00 32767.00 FORMAT "%8.2" ECU_ADDRESS 0x60004AF8 /end MEASUREMENT
/begin MEASUREMENT Ebs_tiAftBattSnsrRst "Time after reset of battery sensor" SLONG Time_s 1 100 0.00 21474836.4700 FORMAT "%13.4" ECU_ADDRESS 0x60034770 /end MEASUREMENT
/begin MEASUREMENT Ebs_tiDurnAftIgnOffDcyc "IG-OFF duration for Dark current hystory function" SLONG Time_Hr 1 100 -1073741824.00 1073741823.50 FORMAT "%13.2" ARRAY_SIZE 5 ECU_ADDRESS 0x60036658 /end MEASUREMENT
/begin MEASUREMENT Ebs_tiElpdSnceBattSnsrRst "Time elapsed since reset of battery sensor" SLONG Time_s 1 100 0.00 21474836.4700 FORMAT "%13.4" ECU_ADDRESS 0x600366C4 /end MEASUREMENT
/begin MEASUREMENT Ebs_tiT15OnDly "Turn ON delay time of T15_st to evaluate battery sensor diagnosis" UWORD Time_s 1 100 0.00 655.3500 FORMAT "%8.4" ECU_ADDRESS 0x600048F6 /end MEASUREMENT
/begin MEASUREMENT Ebs_uBattFild "Sensor value battery voltage" SWORD U_mV_q0p9765625_COMPU 1 100 -32000.00 31999.02 FORMAT "%8.2" ECU_ADDRESS 0x60004AF6 /end MEASUREMENT
/begin MEASUREMENT Ebs_uSofFild "Estimated supply voltage drop while cranking" SWORD spg_q0p0625_V 1 100 -2048.000 2047.938 FORMAT "%8.3" ECU_ADDRESS 0x60004AF4 /end MEASUREMENT
/begin MEASUREMENT EngStrt_ctReIniDsttiDrvEnter "Local Counter for tracking the entering os system state from PRE or POST DRIVE to DRIVE in DSTTI" UBYTE OneToOne 1 100 0.00 255.0 FORMAT "%5.1" ECU_ADDRESS 0x600065A1 /end MEASUREMENT
/begin MEASUREMENT fbIntkActrErrDebSpcl11 "Feedback error debounce level for special lift actuator 11" ULONG OneToOne 1 100 0.00 65535.0000000 FORMAT "%13.7" ECU_ADDRESS 0x60000320 /end MEASUREMENT
/begin MEASUREMENT fbIntkActrErrDebStd11 "Feedback error debounce level for standard lift actuator 11" ULONG OneToOne 1 100 0.00 65535.0000000 FORMAT "%13.7" ECU_ADDRESS 0x50000494 /end MEASUREMENT
/begin MEASUREMENT fbIntkActrErrIntDebSpcl11 "Feedback error signal from Internal debounce method for Intake Switch 11 in Special lift." UBYTE B_TRUE 1 100 0.00 1.00000000000 BIT_MASK 0x1 FORMAT "%13.11" ECU_ADDRESS 0x600007B5 /end MEASUREMENT
/begin MEASUREMENT fbIntkActrErrIntDebStd11 "Feedback error signal from Internal debounce method for Intake Switch 11 in Standard lift." UBYTE B_TRUE 1 100 0.00 1.00000000000 BIT_MASK 0x1 FORMAT "%13.11" ECU_ADDRESS 0x600007B6 /end MEASUREMENT
/begin MEASUREMENT FPCtl_flgReIniDTEVE100ms "Re-Initialisation necessary for DTEVE 100ms" UBYTE B_TRUE 1 100 0.00 1.00000000000 BIT_MASK 0x1 FORMAT "%13.11" ECU_ADDRESS 0x6000659D /end MEASUREMENT
/begin MEASUREMENT sttime_w_msg "time from start request to end of start" UWORD t10msxs_uw_b655p35 1 100 0.00 655.3500 FORMAT "%8.4" ECU_ADDRESS 0x60004BB2 /end MEASUREMENT
/begin MEASUREMENT tiSpclIntk11 "transition time since special switch request for intake actuator 11" UWORD dez 1 100 0.00 65535.00 FORMAT "%8.2" ECU_ADDRESS 0x60000496 /end MEASUREMENT
/begin MEASUREMENT tiStdIntk11 "transition time since standard switch request for intake actuator 11" UWORD dez 1 100 0.00 65535.00 FORMAT "%8.2" ECU_ADDRESS 0x60000498 /end MEASUREMENT
/begin MEASUREMENT VlvLft_cntrReIni "counter for state re-initialization" UBYTE OneToOne 1 100 0.00 255.0 FORMAT "%5.1" ECU_ADDRESS 0x6000659C /end MEASUREMENT
/begin MEASUREMENT VlvLft_flgBdeseeDlyd "Diagnosis power stage: entry conditions fulfilled and Engine cranking finished status after a preset delay. Used to enable VlvLft powerstage diagnosis." UBYTE B_TRUE 1 100 0.00 1.00000000000 BIT_MASK 0x1 FORMAT "%13.11" ECU_ADDRESS 0x6000659B /end MEASUREMENT
/begin MEASUREMENT Vlvlft_flgBdeseeloc "Local variable for Diagnosis power stage: entry conditions fulfilled" UBYTE B_TRUE 1 100 0.00 1.00000000000 BIT_MASK 0x1 FORMAT "%13.11" ECU_ADDRESS 0x6000659A /end MEASUREMENT
/begin MEASUREMENT Vlvlft_flgDSMClr "DSM Clear flag for Valvelift" UBYTE B_TRUE 1 100 0.00 1.00000000000 BIT_MASK 0x1 FORMAT "%13.11" ECU_ADDRESS 0x60006599 /end MEASUREMENT
/begin MEASUREMENT Vlvlft_flgfbIntkSpcl11Fail "Feedback signal fail for Intake Special Lift Actuator 1" UBYTE B_TRUE 1 100 0.00 1.00000000000 BIT_MASK 0x1 FORMAT "%13.11" ECU_ADDRESS 0x700002CE /end MEASUREMENT
/begin MEASUREMENT Vlvlft_flgfbIntkSpcl11Suc "Feedback signal Success for Intake Special Lift Actuator 1" UBYTE B_TRUE 1 100 0.00 1.00000000000 BIT_MASK 0x1 FORMAT "%13.11" ECU_ADDRESS 0x700002CD /end MEASUREMENT
/begin MEASUREMENT Vlvlft_flgfbIntkStd11Fail "Feedback signal fail for Intake Standard Lift Actuator 1" UBYTE B_TRUE 1 100 0.00 1.00000000000 BIT_MASK 0x1 FORMAT "%13.11" ECU_ADDRESS 0x700002CC /end MEASUREMENT
/begin MEASUREMENT Vlvlft_flgfbIntkStd11Suc "Feedback signal Success for Intake Standard Lift Actuator 1" UBYTE B_TRUE 1 100 0.00 1.00000000000 BIT_MASK 0x1 FORMAT "%13.11" ECU_ADDRESS 0x700002CB /end MEASUREMENT
/begin MEASUREMENT Vlvlft_flgIntkDebEnaSpcl11 "Debouncing Enabled Flag for Intake Specail lift Actuator 1" UBYTE B_TRUE 1 100 0.00 1.00000000000 BIT_MASK 0x1 FORMAT "%13.11" ECU_ADDRESS 0x700002CA /end MEASUREMENT
/begin MEASUREMENT Vlvlft_flgIntkDebEnaStd11 "Debouncing Enabled Flag for Intake Standard lift Actuator 1" UBYTE B_TRUE 1 100 0.00 1.00000000000 BIT_MASK 0x1 FORMAT "%13.11" ECU_ADDRESS 0x700002C9 /end MEASUREMENT
/begin MEASUREMENT VlvLft_flgSwtExh11DiagNumRel "DIUMPR numerator release condition for exhaust valve 11" UBYTE dez 1 100 0.00 255.0 FORMAT "%5.1" ECU_ADDRESS 0x6000072F /end MEASUREMENT
/begin MEASUREMENT VlvLft_flgSwtIntk11DiagNumRel "DIUMPR numerator release condition for intake valve 11" UBYTE dez 1 100 0.00 255.0 FORMAT "%5.1" ECU_ADDRESS 0x60000730 /end MEASUREMENT
/begin MEASUREMENT VlvLft_stFbSnsrDiagEnaIntk "Sensor diagnosis enabled flag for Intake" UBYTE B_TRUE 1 100 0.00 1.00000000000 BIT_MASK 0x1 FORMAT "%13.11" ECU_ADDRESS 0x700002C8 /end MEASUREMENT
/begin MEASUREMENT Vlvlft_stPsDiagEna "Codeword for enabling the powerstage diagnosis for Valvelift" UBYTE B_TRUE 1 100 0.00 1.00000000000 BIT_MASK 0x1 FORMAT "%13.11" ECU_ADDRESS 0x60006598 /end MEASUREMENT
/begin MEASUREMENT zllimtst "counter wrong starts" UBYTE dez 1 100 0.00 255.0 FORMAT "%5.1" ECU_ADDRESS 0x600065A0 /end MEASUREMENT
/begin MEASUREMENT zllimtstok "counter good starts" UBYTE dez 1 100 0.00 255.0 FORMAT "%5.1" ECU_ADDRESS 0x6000659F /end MEASUREMENT
/begin FUNCTION DSM_DTRCompu "1.25.0    DSM DTR computation methods" FUNCTION_VERSION "1.25.0" /end FUNCTION
/begin FUNCTION DsplECU_META "8.4.0_6SAAReception process for the CAN frame META"
 /begin DEF_CHARACTERISTIC Com_dMETAMaxDiff_C Com_dMETAMaxPer_C Com_dMETASigSel_C Com_numCsumMETA_C Com_swtMETAMonEna_C /end DEF_CHARACTERISTIC
 /begin IN_MEASUREMENT Com_ctCRingMETA Com_numCsumMETA Com_stBCANReprogm Com_stFrmRxEna Com_stMon Com_stPrkgBrkSw Com_uFlLvlRaw Dspl_stCrsMaiSwtInfo /end IN_MEASUREMENT
 /begin OUT_MEASUREMENT Com_stMonMETA /end OUT_MEASUREMENT
 /begin LOC_MEASUREMENT DsplECU_ctMETARngCnt_MP /end LOC_MEASUREMENT
 FUNCTION_VERSION "8.4.0_6SAA" /end FUNCTION
/begin FUNCTION DsplECU_METC "10.3.0_6SAAReception process for the CAN frame METC"
 /begin DEF_CHARACTERISTIC Com_dMETCMaxDiff_C Com_dMETCMaxPer_C Com_dMETCSigSel_C Com_tOutd_C /end DEF_CHARACTERISTIC
 /begin IN_MEASUREMENT Com_ctCRingMETC Com_numCsumMETC Com_stFrmRxEna Com_stFrtFog Com_stMon Com_stRrFog Com_stWiprMETC Com_tOutd /end IN_MEASUREMENT
 /begin OUT_MEASUREMENT Com_tMETCEnvTRaw /end OUT_MEASUREMENT
 /begin LOC_MEASUREMENT DsplECU_ctMETCRngCnt_MP /end LOC_MEASUREMENT
 FUNCTION_VERSION "10.3.0_6SAA" /end FUNCTION
/begin FUNCTION DsplECU_METD "9.4.0_6SAACAN messages of the Display ECU (METD)"
 /begin DEF_CHARACTERISTIC Com_dMETDMaxDiff_C Com_dMETDMaxPer_C Com_numCsumMETD_C Com_stECON_C Com_swtMETDMonFrmSel_C Com_tiISSPrms_C /end DEF_CHARACTERISTIC
 /begin IN_MEASUREMENT Com_ctCRingMETD Com_numCsumMETD Com_stECON Com_stFrmRxEna Com_stISSInhbnSwt Com_stMon Com_stSwISInhbSts Com_tiISSPrms Com_tMtrEvaMETD /end IN_MEASUREMENT
 /begin OUT_MEASUREMENT Com_stMETDCanErr /end OUT_MEASUREMENT
 /begin LOC_MEASUREMENT DsplECU_ctMETDRngCnt_MP /end LOC_MEASUREMENT
 FUNCTION_VERSION "9.4.0_6SAA" /end FUNCTION
/begin FUNCTION DsplECU_METE2 "6.2.0_6SAACAN messages of the Display ECU (METE2)"
 /begin DEF_CHARACTERISTIC Com_ctCRingMETE2_C Com_dMETE2MaxDiff_C Com_dMETE2MaxPer_C Com_numCsumMETE2_C Com_tAirInsdCbn_C Com_tMETE2AirOutside_C /end DEF_CHARACTERISTIC
 /begin IN_MEASUREMENT Com_ctCRingMETE2 Com_numCsumMETE2 Com_stAirCdnr Com_stFrmRxEna Com_stMETE2ACISSInhbReq Com_stMETE2FrntDfrstSwtInfo Com_stMon Com_tAirInsdCbn Com_tMETE2AirOutside /end IN_MEASUREMENT
 /begin OUT_MEASUREMENT Com_tMETEEnvTRaw /end OUT_MEASUREMENT
 /begin LOC_MEASUREMENT DsplECU_ctMETE2RngCnt_MP /end LOC_MEASUREMENT
 FUNCTION_VERSION "6.2.0_6SAA" /end FUNCTION
/begin FUNCTION DsplECU_METF "6.3.0_6SAACAN messages of the Display ECU (METF)"
 /begin DEF_CHARACTERISTIC Com_bDigMtrUnit_C Com_dMETFMaxDiff_C Com_dMETFMaxPer_C Com_numCsumMETF_C Com_stTarSpdDisp_C Com_swtMETFMonEna_C Com_vAnaVeh_C Com_vDigVehRaw_C Com_vDigVeh_C /end DEF_CHARACTERISTIC
 /begin IN_MEASUREMENT Com_bDigMtrUnit Com_numCsumMETF Com_stFrmRxEna Com_stMon Com_stTarSpdDisp Com_vAnaVeh Com_vDigVeh Com_vDigVehRaw /end IN_MEASUREMENT
 /begin OUT_MEASUREMENT Com_stMonMETF Com_vDigVehKmph Com_vDigVehMph /end OUT_MEASUREMENT
 /begin LOC_MEASUREMENT DsplECU_ctMETFRngCnt_MP /end LOC_MEASUREMENT
 FUNCTION_VERSION "6.3.0_6SAA" /end FUNCTION
/begin FUNCTION DsplECU_METG "7.2.0_6SAACAN messages of the Display ECU (METG)"
 /begin DEF_CHARACTERISTIC Com_ctCRingMETG_C Com_dMETGMaxDiff_C Com_dMETGMaxPer_C Com_numCsumMETG_C Com_stACCut_C /end DEF_CHARACTERISTIC
 /begin IN_MEASUREMENT Com_ctCRingMETG Com_numCsumMETG Com_stACCut Com_stACMETG Com_stEngHoodOpn Com_stFrmRxEna Com_stICUHoodErr Com_stMon /end IN_MEASUREMENT
 /begin LOC_MEASUREMENT DsplECU_ctMETGRngCnt_MP /end LOC_MEASUREMENT
 FUNCTION_VERSION "7.2.0_6SAA" /end FUNCTION
/begin FUNCTION DsplECU_METH "6.2.0_6SAACAN messages of the Display ECU (METH)"
 /begin DEF_CHARACTERISTIC Com_dMETHMaxDiff_C Com_dMETHMaxPer_C Com_numCsumMETH_C Com_swtMETHMonEna_C /end DEF_CHARACTERISTIC
 /begin IN_MEASUREMENT Com_iACCmprHiByte Com_iACCmprLoByte Com_numCsumMETH Com_stFrmRxEna Com_stMon /end IN_MEASUREMENT
 /begin OUT_MEASUREMENT Com_iACCmpr Com_stMonMETH /end OUT_MEASUREMENT
 /begin LOC_MEASUREMENT DsplECU_ctMETHRngCnt_MP /end LOC_MEASUREMENT
 FUNCTION_VERSION "6.2.0_6SAA" /end FUNCTION
/begin FUNCTION DsplECU_METH2 "8.1.0_6SAACAN messages of the Display ECU (METH)"
 /begin DEF_CHARACTERISTIC Com_ctCRingMETH2_C Com_dMETH2MaxDiff_C Com_dMETH2MaxPer_C Com_dMETH2SigSel_C Com_nrActPtcActv_C Com_numCsumMETH2_C Com_stACGUpReq_C Com_stBattOTAReq_C Com_tACAirTOut_C /end DEF_CHARACTERISTIC
 /begin IN_MEASUREMENT Com_ctCRingMETH2 Com_nrActPtcActv Com_numCsumMETH2 Com_stACGUpReq Com_stBattOTAReq Com_stFrmRxEna Com_stMon Com_tACAirTOut /end IN_MEASUREMENT
 /begin LOC_MEASUREMENT DsplECU_ctMETH2RngCnt_MP /end LOC_MEASUREMENT
 FUNCTION_VERSION "8.1.0_6SAA" /end FUNCTION
/begin FUNCTION DsplECU_METI "6.3.0_6SAACAN messages of the Display ECU (METI)" /begin DEF_CHARACTERISTIC Com_dMETIMaxDiff_C Com_dMETIMaxPer_C Com_dMETISigSel_C /end DEF_CHARACTERISTIC
 /begin IN_MEASUREMENT Com_bDeIce Com_bMicuInfo Com_bReDEFOutCdn Com_bReDEFSwCdn Com_bRMDRLKCInfo Com_bRMHLHiRly Com_bRMHLLoRly Com_bRMILLSml Com_ctCRingMETI Com_numCsumMETI Com_stAcInfo Com_stFrmRxEna Com_stMon Com_stWiprActvnCdn Com_uFrntBlowrU Com_uMICUTxBlowrU Com_uRrBlowrU /end IN_MEASUREMENT
 /begin OUT_MEASUREMENT Com_stLiSwtInfoMETI /end OUT_MEASUREMENT
 /begin LOC_MEASUREMENT DsplECU_ctRngMETI_MP /end LOC_MEASUREMENT
 FUNCTION_VERSION "6.3.0_6SAA" /end FUNCTION
/begin FUNCTION DsplECU_METK "10.2.0_6SAAReception process for the CAN frame METK"
 /begin DEF_CHARACTERISTIC Com_dMETKMaxDiff_C Com_dMETKMaxPer_C Com_dMETKSigSel_C Com_lDstMETK_C /end DEF_CHARACTERISTIC
 /begin IN_MEASUREMENT CoEng_st Com_ctCRingMETK Com_lDstMETKRaw Com_numCsumMETK Com_stACFailInfo Com_stBCANInfo Com_stCombUnitFailInfo Com_stDstMETK Com_stFrmRxEna Com_stMICUInfo Com_stMon Com_stRstReq Dspl_stASLRxErr T50_st /end IN_MEASUREMENT
 /begin OUT_MEASUREMENT Com_lDst Com_lDstMETK Com_stFailCode Com_stMCUUnFailCode /end OUT_MEASUREMENT
 /begin LOC_MEASUREMENT Com_lDstMETK1 Com_lDstMETK2 Com_lDstMETK3 DsplECU_ctRngMETK_MP /end LOC_MEASUREMENT
 FUNCTION_VERSION "10.2.0_6SAA" /end FUNCTION
/begin FUNCTION DsplECU_METL "6.3.0_6SAAReception process for the CAN frame METL" /begin DEF_CHARACTERISTIC Com_dMETLMaxDiff_C Com_dMETLMaxPer_C /end DEF_CHARACTERISTIC
 /begin IN_MEASUREMENT Com_ctCRingMETL Com_numCsumMETL Com_stFrmRxEna Com_stMon Dspl_stACCASLSwtInfo Dspl_stCrsSwtInfo /end IN_MEASUREMENT
 /begin OUT_MEASUREMENT Com_stMonMETL /end OUT_MEASUREMENT
 /begin LOC_MEASUREMENT DsplECU_ctMETLRngCnt_MP /end LOC_MEASUREMENT
 FUNCTION_VERSION "6.3.0_6SAA" /end FUNCTION
/begin FUNCTION DsplECU_METM "5.2.0_6SAACAN messages of the Display ECU (METM)"
 /begin DEF_CHARACTERISTIC Com_ctCRingMETM_C Com_dMETMMaxDiff_C Com_dMETMMaxPer_C Com_numCsumMETM_C Com_stMtrCustDftReq_C Com_stMtrCustStReq_C /end DEF_CHARACTERISTIC
 /begin IN_MEASUREMENT Com_ctCRingMETM Com_numCsumMETM Com_stFrmRxEna Com_stMon Com_stMtrCustDftReq Com_stMtrCustStReq /end IN_MEASUREMENT
 /begin LOC_MEASUREMENT DsplECU_ctMETMRngCnt_MP /end LOC_MEASUREMENT
 FUNCTION_VERSION "5.2.0_6SAA" /end FUNCTION
/begin FUNCTION DsplECU_METN "5.1.0_6SAACAN messages of the Display ECU (METN)"
 /begin DEF_CHARACTERISTIC Com_ctCRingMETN_C Com_dMETNMaxDiff_C Com_dMETNMaxPer_C Com_numCsumMETN_C Com_tACMtrEvaInfo_C /end DEF_CHARACTERISTIC
 /begin IN_MEASUREMENT Com_ctCRingMETN Com_numCsumMETN Com_stFrmRxEna Com_stMon Com_tACMtrEvaInfo /end IN_MEASUREMENT
 /begin OUT_MEASUREMENT Com_stMETNCanErr /end OUT_MEASUREMENT
 /begin LOC_MEASUREMENT DsplECU_ctMETNRngCnt_MP /end LOC_MEASUREMENT
 FUNCTION_VERSION "5.1.0_6SAA" /end FUNCTION
/begin FUNCTION DSQ "30000.10.0Diagnostic Signal Quality" FUNCTION_VERSION "30000.10.0" /end FUNCTION
/begin FUNCTION DSTTI "4.7.0     Diagnosis start time" /begin DEF_CHARACTERISTIC TSTARTMX ZTSTMX ZTSTMXOK /end DEF_CHARACTERISTIC
 /begin IN_MEASUREMENT B_staanf_msg EngStrt_bFrstStrtEnd EngStrt_bStrtEnd SyC_ctDrvEnter SyC_stSub /end IN_MEASUREMENT
 /begin OUT_MEASUREMENT B_limtstok_msg B_limtst_msg B_sttime_msg sttime_w_msg /end OUT_MEASUREMENT
 /begin LOC_MEASUREMENT B_dstti B_staanloc EngStrt_ctReIniDsttiDrvEnter zllimtst zllimtstok /end LOC_MEASUREMENT
 FUNCTION_VERSION "4.7.0" /end FUNCTION
/begin FUNCTION DTEVCOOR "30000.0.0 Coordination function diagnosis canister purge valve"
 /begin DEF_CHARACTERISTIC CstrPurg_stDiagCpvCCSeln_C CstrPurg_stDiagCpvDmtlSeln_C CstrPurg_stDiagCpvDteskSeln_C CstrPurg_stDiagCpvPsnsrSeln_C /end DEF_CHARACTERISTIC
 /begin IN_MEASUREMENT B_cdtes_msg /end IN_MEASUREMENT
 /begin OUT_MEASUREMENT CstrPurg_flgDiagCpv1CCHiLoad CstrPurg_flgDiagCpv1CCLoLoad CstrPurg_flgDiagCpv1DmtlHiLoad CstrPurg_flgDiagCpv1DmtlLoLoad CstrPurg_flgDiagCpv1DteskLoLoad CstrPurg_flgDiagCpv1PSnsrHiLoad CstrPurg_flgDiagCpv1PSnsrLoLoad CstrPurg_flgDiagCpv2CCHiLoad CstrPurg_flgDiagCpv2CCLoLoad CstrPurg_flgDiagCpv2PSnsrHiLoad CstrPurg_flgDiagCpv2PSnsrLoLoad /end OUT_MEASUREMENT
 FUNCTION_VERSION "30000.0.0" /end FUNCTION
/begin FUNCTION DTEVE "30301.1.0_1.2.0Diagnosis; power stage of canister purge valve"
 /begin DEF_CHARACTERISTIC CstrPurg_nrTestPls_C CstrPurg_tiBtwPlsElecErr_C CstrPurg_tiBtwPlsOverT_C CstrPurg_tiDlyElecDiag_C CWPSTEVE /end DEF_CHARACTERISTIC
 /begin IN_MEASUREMENT CstrPurg_flgUBattOk EngStrt_bStrtEnd /end IN_MEASUREMENT
 /begin OUT_MEASUREMENT B_eteve_msg CstrPurg_flgCpvElecErrOpenLoad CstrPurg_flgCpvElecErrShoCircBatt CstrPurg_flgCpvElecErrShoCircGnd /end OUT_MEASUREMENT
 /begin LOC_MEASUREMENT CstrPurg_flgElecDiagEnad CstrPurg_stCpvElecErrDiag FPCtl_flgReIniDTEVE100ms /end LOC_MEASUREMENT
 FUNCTION_VERSION "30301.1.0_1.2.0" /end FUNCTION
/begin FUNCTION DTR "30000.8.0 Diagnostic Test Results for Service 0x06"
 /begin DEF_CHARACTERISTIC DTR_OBDMID.DTR_OBDMID_01_TID_DTLTR_C DTR_OBDMID.DTR_OBDMID_01_TID_DTRTL_C DTR_OBDMID.DTR_OBDMID_01_TID_OFFSN_C DTR_OBDMID.DTR_OBDMID_01_TID_OFFSP_C DTR_OBDMID.DTR_OBDMID_01_TID_SnsrMntdDiag_C DTR_OBDMID.DTR_OBDMID_01_TID_TCLTR_C DTR_OBDMID.DTR_OBDMID_01_TID_TCRTL_C DTR_OBDMID.DTR_OBDMID_02_TID_05_C DTR_OBDMID.DTR_OBDMID_02_TID_06_C DTR_OBDMID.DTR_OBDMID_02_TID_LtrDly_C DTR_OBDMID.DTR_OBDMID_02_TID_RtlDly_C DTR_OBDMID.DTR_OBDMID_02_TID_TarLean_C DTR_OBDMID.DTR_OBDMID_02_TID_TarRich_C DTR_OBDMID.DTR_OBDMID_21_TID_OS_C DTR_OBDMID.DTR_OBDMID_41_TID_TKER_C DTR_OBDMID.DTR_OBDMID_42_TID_HTR_C DTR_OBDMID.DTR_OBDMID_a2_TID_0b_0_C DTR_OBDMID.DTR_OBDMID_a2_TID_0b_1_C DTR_OBDMID.DTR_OBDMID_a2_TID_0b_2_C DTR_OBDMID.DTR_OBDMID_a2_TID_0b_3_C DTR_OBDMID.DTR_OBDMID_a2_TID_0c_0_C DTR_OBDMID.DTR_OBDMID_a2_TID_0c_1_C DTR_OBDMID.DTR_OBDMID_a2_TID_0c_2_C DTR_OBDMID.DTR_OBDMID_a2_TID_0c_3_C DTR_OBDMID.DTR_UegoDummy_C DTR_OBDMID.DTR_UegoOlRCmpS1B1_C DTR_Suprt.DTR_OBDMID_01_TID_DTLTR_C DTR_Suprt.DTR_OBDMID_01_TID_DTRTL_C DTR_Suprt.DTR_OBDMID_01_TID_OFFSN_C DTR_Suprt.DTR_OBDMID_01_TID_OFFSP_C DTR_Suprt.DTR_OBDMID_01_TID_SnsrMntdDiag_C DTR_Suprt.DTR_OBDMID_01_TID_TCLTR_C DTR_Suprt.DTR_OBDMID_01_TID_TCRTL_C DTR_Suprt.DTR_OBDMID_02_TID_05_C DTR_Suprt.DTR_OBDMID_02_TID_06_C DTR_Suprt.DTR_OBDMID_02_TID_LtrDly_C DTR_Suprt.DTR_OBDMID_02_TID_RtlDly_C DTR_Suprt.DTR_OBDMID_02_TID_TarLean_C DTR_Suprt.DTR_OBDMID_02_TID_TarRich_C DTR_Suprt.DTR_OBDMID_21_TID_OS_C DTR_Suprt.DTR_OBDMID_41_TID_TKER_C DTR_Suprt.DTR_OBDMID_42_TID_HTR_C DTR_Suprt.DTR_OBDMID_a2_TID_0b_0_C DTR_Suprt.DTR_OBDMID_a2_TID_0b_1_C DTR_Suprt.DTR_OBDMID_a2_TID_0b_2_C DTR_Suprt.DTR_OBDMID_a2_TID_0b_3_C DTR_Suprt.DTR_OBDMID_a2_TID_0c_0_C DTR_Suprt.DTR_OBDMID_a2_TID_0c_1_C DTR_Suprt.DTR_OBDMID_a2_TID_0c_2_C DTR_Suprt.DTR_OBDMID_a2_TID_0c_3_C DTR_Suprt.DTR_UegoDummy_C DTR_Suprt.DTR_UegoOlRCmpS1B1_C DTR_TID.DTR_OBDMID_01_TID_DTLTR_C DTR_TID.DTR_OBDMID_01_TID_DTRTL_C DTR_TID.DTR_OBDMID_01_TID_OFFSN_C DTR_TID.DTR_OBDMID_01_TID_OFFSP_C DTR_TID.DTR_OBDMID_01_TID_SnsrMntdDiag_C DTR_TID.DTR_OBDMID_01_TID_TCLTR_C DTR_TID.DTR_OBDMID_01_TID_TCRTL_C DTR_TID.DTR_OBDMID_02_TID_05_C DTR_TID.DTR_OBDMID_02_TID_06_C DTR_TID.DTR_OBDMID_02_TID_LtrDly_C DTR_TID.DTR_OBDMID_02_TID_RtlDly_C DTR_TID.DTR_OBDMID_02_TID_TarLean_C DTR_TID.DTR_OBDMID_02_TID_TarRich_C DTR_TID.DTR_OBDMID_21_TID_OS_C DTR_TID.DTR_OBDMID_41_TID_TKER_C DTR_TID.DTR_OBDMID_42_TID_HTR_C DTR_TID.DTR_OBDMID_a2_TID_0b_0_C DTR_TID.DTR_OBDMID_a2_TID_0b_1_C DTR_TID.DTR_OBDMID_a2_TID_0b_2_C DTR_TID.DTR_OBDMID_a2_TID_0b_3_C DTR_TID.DTR_OBDMID_a2_TID_0c_0_C DTR_TID.DTR_OBDMID_a2_TID_0c_1_C DTR_TID.DTR_OBDMID_a2_TID_0c_2_C DTR_TID.DTR_OBDMID_a2_TID_0c_3_C DTR_TID.DTR_UegoDummy_C DTR_TID.DTR_UegoOlRCmpS1B1_C /end DEF_CHARACTERISTIC
 /begin LOC_MEASUREMENT DTR_valLoLim.DTR_OBDMID_01_TID_DTLTR DTR_valLoLim.DTR_OBDMID_01_TID_DTRTL DTR_valLoLim.DTR_OBDMID_01_TID_OFFSN DTR_valLoLim.DTR_OBDMID_01_TID_OFFSP DTR_valLoLim.DTR_OBDMID_01_TID_SnsrMntdDiag DTR_valLoLim.DTR_OBDMID_01_TID_TCLTR DTR_valLoLim.DTR_OBDMID_01_TID_TCRTL DTR_valLoLim.DTR_OBDMID_02_TID_05 DTR_valLoLim.DTR_OBDMID_02_TID_06 DTR_valLoLim.DTR_OBDMID_02_TID_LtrDly DTR_valLoLim.DTR_OBDMID_02_TID_RtlDly DTR_valLoLim.DTR_OBDMID_02_TID_TarLean DTR_valLoLim.DTR_OBDMID_02_TID_TarRich DTR_valLoLim.DTR_OBDMID_21_TID_OS DTR_valLoLim.DTR_OBDMID_41_TID_TKER DTR_valLoLim.DTR_OBDMID_42_TID_HTR DTR_valLoLim.DTR_OBDMID_a2_TID_0b_0 DTR_valLoLim.DTR_OBDMID_a2_TID_0b_1 DTR_valLoLim.DTR_OBDMID_a2_TID_0b_2 DTR_valLoLim.DTR_OBDMID_a2_TID_0b_3 DTR_valLoLim.DTR_OBDMID_a2_TID_0c_0 DTR_valLoLim.DTR_OBDMID_a2_TID_0c_1 DTR_valLoLim.DTR_OBDMID_a2_TID_0c_2 DTR_valLoLim.DTR_OBDMID_a2_TID_0c_3 DTR_valLoLim.DTR_UegoDummy DTR_valLoLim.DTR_UegoOlRCmpS1B1 DTR_valTst.DTR_OBDMID_01_TID_DTLTR DTR_valTst.DTR_OBDMID_01_TID_DTRTL DTR_valTst.DTR_OBDMID_01_TID_OFFSN DTR_valTst.DTR_OBDMID_01_TID_OFFSP DTR_valTst.DTR_OBDMID_01_TID_SnsrMntdDiag DTR_valTst.DTR_OBDMID_01_TID_TCLTR DTR_valTst.DTR_OBDMID_01_TID_TCRTL DTR_valTst.DTR_OBDMID_02_TID_05 DTR_valTst.DTR_OBDMID_02_TID_06 DTR_valTst.DTR_OBDMID_02_TID_LtrDly DTR_valTst.DTR_OBDMID_02_TID_RtlDly DTR_valTst.DTR_OBDMID_02_TID_TarLean DTR_valTst.DTR_OBDMID_02_TID_TarRich DTR_valTst.DTR_OBDMID_21_TID_OS DTR_valTst.DTR_OBDMID_41_TID_TKER DTR_valTst.DTR_OBDMID_42_TID_HTR DTR_valTst.DTR_OBDMID_a2_TID_0b_0 DTR_valTst.DTR_OBDMID_a2_TID_0b_1 DTR_valTst.DTR_OBDMID_a2_TID_0b_2 DTR_valTst.DTR_OBDMID_a2_TID_0b_3 DTR_valTst.DTR_OBDMID_a2_TID_0c_0 DTR_valTst.DTR_OBDMID_a2_TID_0c_1 DTR_valTst.DTR_OBDMID_a2_TID_0c_2 DTR_valTst.DTR_OBDMID_a2_TID_0c_3 DTR_valTst.DTR_UegoDummy DTR_valTst.DTR_UegoOlRCmpS1B1 DTR_valUpLim.DTR_OBDMID_01_TID_DTLTR DTR_valUpLim.DTR_OBDMID_01_TID_DTRTL DTR_valUpLim.DTR_OBDMID_01_TID_OFFSN DTR_valUpLim.DTR_OBDMID_01_TID_OFFSP DTR_valUpLim.DTR_OBDMID_01_TID_SnsrMntdDiag DTR_valUpLim.DTR_OBDMID_01_TID_TCLTR DTR_valUpLim.DTR_OBDMID_01_TID_TCRTL DTR_valUpLim.DTR_OBDMID_02_TID_05 DTR_valUpLim.DTR_OBDMID_02_TID_06 DTR_valUpLim.DTR_OBDMID_02_TID_LtrDly DTR_valUpLim.DTR_OBDMID_02_TID_RtlDly DTR_valUpLim.DTR_OBDMID_02_TID_TarLean DTR_valUpLim.DTR_OBDMID_02_TID_TarRich DTR_valUpLim.DTR_OBDMID_21_TID_OS DTR_valUpLim.DTR_OBDMID_41_TID_TKER DTR_valUpLim.DTR_OBDMID_42_TID_HTR DTR_valUpLim.DTR_OBDMID_a2_TID_0b_0 DTR_valUpLim.DTR_OBDMID_a2_TID_0b_1 DTR_valUpLim.DTR_OBDMID_a2_TID_0b_2 DTR_valUpLim.DTR_OBDMID_a2_TID_0b_3 DTR_valUpLim.DTR_OBDMID_a2_TID_0c_0 DTR_valUpLim.DTR_OBDMID_a2_TID_0c_1 DTR_valUpLim.DTR_OBDMID_a2_TID_0c_2 DTR_valUpLim.DTR_OBDMID_a2_TID_0c_3 DTR_valUpLim.DTR_UegoDummy DTR_valUpLim.DTR_UegoOlRCmpS1B1 /end LOC_MEASUREMENT
 FUNCTION_VERSION "30000.8.0" /end FUNCTION
/begin FUNCTION DVHEE "14.1.0_1.2.0Electrical Diagnosis Powerstage Valve Lift Control"
 /begin DEF_CHARACTERISTIC P_VSE11_nrPSPTstPls_C P_VSE11_tiBtwElecFlt_C P_VSE11_tiBtwOTFlt_C TurnondelaySwtIntkExh_C VlvLft_IntDbTiHiLo_C VlvLft_IntDbTiLoHi_C VlvLft_stFbSnsrDiagEnaIntk_C VlvLft_stFbSwtDiagEnaIntk_C Vlvlft_stPsDiaDisbl_C Vlvlft_stPsDiaSwitch_C VlvLft_stPwrStgDiagEnaIntkExh_C VlvLft_tiDiagStrtDly_C VlvLft_tiSpclMaxIntk_C VlvLft_tiStdMaxIntk_C VlvLft_uOilPSnsrSRCMax_C VlvLft_uOilPSnsrSRCMin_C /end DEF_CHARACTERISTIC
 /begin IN_MEASUREMENT B_desee_msg DevLib_stPwrStgEnaCond EngStrt_bStrtEnd GEVCtl_flgIntkVlvLftEna SyC_ctPostDrvLeave SyC_stSub VlvLft_fbIntkSwtOutp11 VlvLft_flgCtrlActrIntk1 VlvLft_flgEnerBgnAdpnIntk VlvLft_stFbSnsrActvIntk Vlvlft_stFbSwtActvIntk VlvLft_uRawPSnsrIntk /end IN_MEASUREMENT
 /begin LOC_MEASUREMENT DSM_SRCIntk11Max DSM_SRCIntk11Min fbIntkActrErrDebSpcl11 fbIntkActrErrDebStd11 fbIntkActrErrIntDebSpcl11 fbIntkActrErrIntDebStd11 tiSpclIntk11 tiStdIntk11 VlvLft_cntrReIni VlvLft_flgBdeseeDlyd Vlvlft_flgBdeseeloc Vlvlft_flgDSMClr Vlvlft_flgfbIntkSpcl11Fail Vlvlft_flgfbIntkSpcl11Suc Vlvlft_flgfbIntkStd11Fail Vlvlft_flgfbIntkStd11Suc Vlvlft_flgIntkDebEnaSpcl11 Vlvlft_flgIntkDebEnaStd11 VlvLft_flgSwtExh11DiagNumRel VlvLft_flgSwtIntk11DiagNumRel VlvLft_stFbSnsrDiagEnaIntk Vlvlft_stPsDiagEna /end LOC_MEASUREMENT
 FUNCTION_VERSION "14.1.0_1.2.0" /end FUNCTION
/begin FUNCTION EBBECU_EBBA "3.2.0_6SAASignal processing of CAN frame EBBA" /begin DEF_CHARACTERISTIC Com_dEBBAMaxDiff_C Com_dEBBAMaxPer_C /end DEF_CHARACTERISTIC
 /begin IN_MEASUREMENT Com_bBrkPedON Com_ctCRingEBBA Com_numCsumEBBA Com_stBrkPedON Com_stCANANoBusOff Com_stEBB Com_stFrmRxEna Com_stMon /end IN_MEASUREMENT
 /begin OUT_MEASUREMENT Com_stRxEBBA Com_stRxEBBAChkSumOk Com_stRxEBBADeb Com_stRxEBBAOk Com_stRxEBBARingCntOk /end OUT_MEASUREMENT
 /begin LOC_MEASUREMENT EBBA_ctEBBARngCnt_MP /end LOC_MEASUREMENT
 FUNCTION_VERSION "3.2.0_6SAA" /end FUNCTION
/begin FUNCTION Ebs_VD "6.21.0    virtual driver Electrical Battery Sensor"
 /begin DEF_CHARACTERISTIC Ebs_cntrDebSocFlt_C Ebs_facRCorrn_T Ebs_flgSwtSOCSeln_C Ebs_iBattRepl_C Ebs_iS16MaxLim_C Ebs_iS16MinLim_C Ebs_qAcmMax_C Ebs_qBattNom_T Ebs_qChrgDft_C Ebs_qDchaDft_C Ebs_qSohRepl_C Ebs_ratDeltaSocThd1_C Ebs_ratDeltaSocThd2_C Ebs_ratDifThd_C Ebs_ratSocRepl_C Ebs_ratSohRepl_C Ebs_ratTarSoc_C Ebs_rBattRSRCHiThd_C Ebs_rBattRSRCLoThd_C Ebs_swtCtl_C Ebs_tBattRepl_C Ebs_tiDlyAftStrtrCut_C Ebs_tiElpdSnceBattSnsrRst_C Ebs_tiRatSohFild_C Ebs_tiSocFil_C Ebs_tiSocSohHistOnDly_C Ebs_tiSohFil_C Ebs_tiT15OnDly_C Ebs_tiTBattFil_C Ebs_tiUBattFil_C Ebs_tiUSofFild_C Ebs_uBattRepl_C Ebs_uSofRepl_C /end DEF_CHARACTERISTIC
 /begin IN_MEASUREMENT Batt_ratSOCCalc CoEng_stMai CoEng_stMaiOld Com_bBliChrg Com_cntrIntResUpd Com_dEBSDByt0 Com_dEBSDByt1 Com_dEBSDByt2 Com_dEBSDByt3 Com_dEBSDByt4 Com_flgEbsRst Com_iBattEBS Com_iStbIAft0Hr Com_qChrg Com_qDisChrg Com_qSoh Com_qStbIAft1Hr Com_qStbIAft2Hr Com_qStbILast Com_ratSoc Com_ratSoh Com_rMeasdBattREbs Com_stBattDchaVltgPrdnSig Com_stBattDgrtSig Com_stCharErr Com_stMon Com_stSensErr Com_stSoc Com_tBattEBS Com_tiDurnAftIgnOff Com_uBattEBS Com_uPeak Eep_EnvRamInvld SyC_tiEcuOff T15_st T50_st /end IN_MEASUREMENT
 /begin OUT_MEASUREMENT Ebs_facRCorrn Ebs_flgBliChrgCalcnCmpl Ebs_flgRst Ebs_flgSOCFlt Ebs_iBattFild Ebs_iStbIAft0HrDcyc Ebs_qBliChrg Ebs_qBliDcha Ebs_qBliDchaTot Ebs_qBliDchaTotDcyc Ebs_qIntegdICmp Ebs_qSohFild Ebs_qStbIAft1HrDcyc Ebs_qStbIAft2HrDcyc Ebs_qStbILastDcyc Ebs_qTotBliDcha Ebs_ratSocFild Ebs_ratSocHist Ebs_ratSohFild Ebs_rBatt Ebs_rBattAct Ebs_rBattMeasd Ebs_stBattInvld Ebs_stBattRVld Ebs_stEbsPlausyChk Ebs_stErr Ebs_stRInhbSpst Ebs_stSelfDiagErrEna Ebs_stSocErrChk Ebs_stStbIEBSByt0 Ebs_stStbIEBSByt1 Ebs_stStbIEBSByt2 Ebs_stStbIEBSByt3 Ebs_stStbIEBSByt4 Ebs_tBattFild Ebs_tiDurnAftIgnOffDcyc Ebs_tiT15OnDly Ebs_uBattFild Ebs_uSofFild /end OUT_MEASUREMENT
 /begin LOC_MEASUREMENT Ebs_cntrAcmChrgOvf Ebs_cntrAcmDchaOvf Ebs_cntrBattEbs Ebs_cntrIntResUpdPrev Ebs_cntrSocFlt1 Ebs_cntrSocFlt2 Ebs_flgTestActv Ebs_qChrgDchaDif Ebs_qChrgDurgT15Off Ebs_qChrgDurgT15On Ebs_qChrgPrev Ebs_qChrgRef Ebs_qChrgSum Ebs_qDchaDurgT15Off Ebs_qDchaDurgT15On Ebs_qDchaPrev Ebs_qDchaRef Ebs_qDchaSum Ebs_qSohFildHist Ebs_ratEstimdDeltaSoc Ebs_ratSoc Ebs_ratSocFildHist Ebs_ratSohFildHist Ebs_rBattActSum Ebs_stBattTempInvld Ebs_stChkSocPlausy1 Ebs_stChkSocPlausy2 Ebs_stEngSt Ebs_stIMonUpdEna Ebs_stIMonUp_MP Ebs_stRErr_MP Ebs_stRMsrmnt_MP Ebs_stRSumOvf Ebs_stStrtRMsrmnt Ebs_stStrtTmrCond Ebs_stT50 Ebs_tiAftBattSnsrRst Ebs_tiElpdSnceBattSnsrRst /end LOC_MEASUREMENT
 FUNCTION_VERSION "6.21.0" /end FUNCTION
/begin COMPU_METHOD B_TRUE "" TAB_VERB "%6.3" "" COMPU_TAB_REF B_TRUE /end COMPU_METHOD
/begin COMPU_VTAB B_TRUE "" TAB_VERB 2 0 "FALSE" 1 "TRUE" /end COMPU_VTAB
/begin COMPU_METHOD Com_EvaTemp_Compu "" RAT_FUNC "%1.0" "" COEFFS 0 1 30 0 0 1 /end COMPU_METHOD
/begin COMPU_METHOD Curr_A "" RAT_FUNC "%6.4" "A" COEFFS 0 100 0 0 0 1 /end COMPU_METHOD
/begin COMPU_METHOD Curr_mA_q0p9765625_COMPU "" RAT_FUNC "%6.2" "mA" COEFFS 0 1.024 0 0 0 1 /end COMPU_METHOD
/begin COMPU_METHOD dez "" RAT_FUNC "%6.2" "" COEFFS 0 1 0 0 0 1 /end COMPU_METHOD
/begin COMPU_METHOD DFC_OneToOne "" RAT_FUNC "%6.2" "-" COEFFS 0 1 0 0 0 1 /end COMPU_METHOD
/begin COMPU_METHOD DTR_Suprt_Compu "" TAB_VERB "%6.3" "-" COMPU_TAB_REF DTR_Suprt_Compu /end COMPU_METHOD
/begin COMPU_VTAB DTR_Suprt_Compu "" TAB_VERB 2 0 "Not supported" 1 "Supported" /end COMPU_VTAB
/begin COMPU_METHOD ElecChrg_Ah_q0p125_COMPU "" RAT_FUNC "%6.3" "Ah" COEFFS 0 8 0 0 0 1 /end COMPU_METHOD
/begin COMPU_METHOD ETKS_SY_Compu "" TAB_VERB "%6.3" "" COMPU_TAB_REF ETKS_SY_Compu /end COMPU_METHOD
/begin COMPU_VTAB ETKS_SY_Compu "" TAB_VERB 2 0 "No ETKS" 1 "ETKS" /end COMPU_VTAB
/begin COMPU_METHOD ETS_LEAN_SY_Compu "" RAT_FUNC "%6.2" "" COEFFS 0 1 0 0 0 1 /end COMPU_METHOD
/begin COMPU_METHOD ETS_NSC_SY_Compu "" RAT_FUNC "%6.2" "" COEFFS 0 1 0 0 0 1 /end COMPU_METHOD
/begin COMPU_METHOD ETS_PFLT1_SY_Compu "" RAT_FUNC "%6.2" "" COEFFS 0 1 0 0 0 1 /end COMPU_METHOD
/begin COMPU_METHOD ETS_PFLT2_SY_Compu "" RAT_FUNC "%6.2" "" COEFFS 0 1 0 0 0 1 /end COMPU_METHOD
/begin COMPU_METHOD ETS_PHC_SY_Compu "" RAT_FUNC "%6.2" "" COEFFS 0 1 0 0 0 1 /end COMPU_METHOD
/begin COMPU_METHOD ETS_SOX_SY_Compu "" RAT_FUNC "%6.2" "" COEFFS 0 1 0 0 0 1 /end COMPU_METHOD
/begin COMPU_METHOD EVAPDI_BLKDLINE_SC_Compu "" TAB_VERB "%6.3" "" COMPU_TAB_REF EVAPDI_BLKDLINE_SC_Compu /end COMPU_METHOD
/begin COMPU_VTAB EVAPDI_BLKDLINE_SC_Compu "" TAB_VERB 2 0 "disabled" 1 "enabled" /end COMPU_VTAB
/begin COMPU_METHOD EVAPRDSMIXFLDP_TYPAVL_SC_Compu "" TAB_VERB "%6.3" "" COMPU_TAB_REF EVAPRDSMIXFLDP_TYPAVL_SC_Compu /end COMPU_METHOD
/begin COMPU_VTAB EVAPRDSMIXFLDP_TYPAVL_SC_Compu "" TAB_VERB 2 0 "False" 1 "True" /end COMPU_VTAB
/begin COMPU_METHOD EVAPRDSMIXFLDT_TYPAVL_SC_Compu "" TAB_VERB "%6.3" "" COMPU_TAB_REF EVAPRDSMIXFLDT_TYPAVL_SC_Compu /end COMPU_METHOD
/begin COMPU_VTAB EVAPRDSMIXFLDT_TYPAVL_SC_Compu "" TAB_VERB 2 0 "False" 1 "True" /end COMPU_VTAB
/begin COMPU_METHOD EVREX_SY_Compu "" TAB_VERB "%6.3" "" COMPU_TAB_REF EVREX_SY_Compu /end COMPU_METHOD
/begin COMPU_VTAB EVREX_SY_Compu "" TAB_VERB 3 0 "EVREX_NO" 1 "EVREX_ECU" 2 "EVREX_VCU" /end COMPU_VTAB
/begin COMPU_METHOD EVTYP_SY_Compu "" TAB_VERB "%6.3" "" COMPU_TAB_REF EVTYP_SY_Compu /end COMPU_METHOD
/begin COMPU_VTAB EVTYP_SY_Compu "" TAB_VERB 2 0 "NOEV" 1 "EV" /end COMPU_VTAB
/begin COMPU_METHOD EWPECU_ACTV_SY_Compu "" TAB_VERB "%6.3" "" COMPU_TAB_REF EWPECU_ACTV_SY_Compu /end COMPU_METHOD
/begin COMPU_VTAB EWPECU_ACTV_SY_Compu "" TAB_VERB 2 0 "False" 1 "True" /end COMPU_VTAB
/begin COMPU_METHOD EXCLSNFCOMINAIR_SC_Compu "" TAB_VERB "%6.3" "" COMPU_TAB_REF EXCLSNFCOMINAIR_SC_Compu /end COMPU_METHOD
/begin COMPU_VTAB EXCLSNFCOMINAIR_SC_Compu "" TAB_VERB 2 0 "False" 1 "True" /end COMPU_VTAB
/begin COMPU_METHOD EXH2BNKACTVNTYPSEL_SC_Compu "" TAB_VERB "%6.3" "" COMPU_TAB_REF EXH2BNKACTVNTYPSEL_SC_Compu /end COMPU_METHOD
/begin COMPU_VTAB EXH2BNKACTVNTYPSEL_SC_Compu "" TAB_VERB 2 0 "False" 1 "True" /end COMPU_VTAB
/begin COMPU_METHOD EXHBNKNUM_SY_Compu "" RAT_FUNC "%6.2" "" COEFFS 0 1 0 0 0 1 /end COMPU_METHOD
/begin COMPU_METHOD EXHCO_ACTVNINHBNFCO_SC_Compu "" TAB_VERB "%6.3" "" COMPU_TAB_REF EXHCO_ACTVNINHBNFCO_SC_Compu /end COMPU_METHOD
/begin COMPU_VTAB EXHCO_ACTVNINHBNFCO_SC_Compu "" TAB_VERB 2 0 "Deactivated" 1 "Activated" /end COMPU_VTAB
/begin COMPU_METHOD EXHDVT_TSNSRCFG_SC_Compu "" TAB_VERB "%6.3" "" COMPU_TAB_REF EXHDVT_TSNSRCFG_SC_Compu /end COMPU_METHOD
/begin COMPU_VTAB EXHDVT_TSNSRCFG_SC_Compu "" TAB_VERB 7 1 "ExhTSnsr_1" 2 "ExhTSnsr_2" 3 "ExhTSnsr_1_2" 4 "ExhTSnsr_3" 7 "ExhTSnsr_1_2_3" 8 "ExhTSnsr_4" 15 "ExhTSnsr_1_2_3_4" /end COMPU_VTAB
/begin COMPU_METHOD EXHDVT_YSPLITCFGEXHSYS_SC_Compu "" TAB_VERB "%6.3" "" COMPU_TAB_REF EXHDVT_YSPLITCFGEXHSYS_SC_Compu /end COMPU_METHOD
/begin COMPU_VTAB EXHDVT_YSPLITCFGEXHSYS_SC_Compu "" TAB_VERB 4 0 "No_YSplit" 1 "UpStream_YSplit" 2 "DownStream_YSplit" 3 "BothStream_YSpli" /end COMPU_VTAB
/begin COMPU_METHOD EXHEVAPRDSFLDT_TYPAVL_SC_Compu "" TAB_VERB "%6.3" "" COMPU_TAB_REF EXHEVAPRDSFLDT_TYPAVL_SC_Compu /end COMPU_METHOD
/begin COMPU_VTAB EXHEVAPRDSFLDT_TYPAVL_SC_Compu "" TAB_VERB 2 0 "False" 1 "True" /end COMPU_VTAB
/begin COMPU_METHOD EXHEVAPRDSGAST_TYPAVL_SC_Compu "" TAB_VERB "%6.3" "" COMPU_TAB_REF EXHEVAPRDSGAST_TYPAVL_SC_Compu /end COMPU_METHOD
/begin COMPU_VTAB EXHEVAPRDSGAST_TYPAVL_SC_Compu "" TAB_VERB 2 0 "False" 1 "True" /end COMPU_VTAB
/begin COMPU_METHOD EXHEVAPRUSFLDP_TYPAVL_SC_Compu "" TAB_VERB "%6.3" "" COMPU_TAB_REF EXHEVAPRUSFLDP_TYPAVL_SC_Compu /end COMPU_METHOD
/begin COMPU_VTAB EXHEVAPRUSFLDP_TYPAVL_SC_Compu "" TAB_VERB 2 0 "False" 1 "True" /end COMPU_VTAB
/begin COMPU_METHOD EXHEVAPRUSFLDT_TYPAVL_SC_Compu "" TAB_VERB "%6.3" "" COMPU_TAB_REF EXHEVAPRUSFLDT_TYPAVL_SC_Compu /end COMPU_METHOD
/begin COMPU_VTAB EXHEVAPRUSFLDT_TYPAVL_SC_Compu "" TAB_VERB 2 0 "False" 1 "True" /end COMPU_VTAB
/begin COMPU_METHOD EXHEVAPRUSGAST_TYPAVL_SC_Compu "" TAB_VERB "%6.3" "" COMPU_TAB_REF EXHEVAPRUSGAST_TYPAVL_SC_Compu /end COMPU_METHOD
/begin COMPU_VTAB EXHEVAPRUSGAST_TYPAVL_SC_Compu "" TAB_VERB 2 0 "False" 1 "True" /end COMPU_VTAB
/begin COMPU_METHOD EXHFLP2_TYPAVL_SY_Compu "" TAB_VERB "%6.3" "" COMPU_TAB_REF EXHFLP2_TYPAVL_SY_Compu /end COMPU_METHOD
/begin COMPU_VTAB EXHFLP2_TYPAVL_SY_Compu "" TAB_VERB 2 0 "False" 1 "True" /end COMPU_VTAB
/begin COMPU_METHOD EXHFLP2_TYPTWINFLW_SY_Compu "" TAB_VERB "%6.3" "" COMPU_TAB_REF EXHFLP2_TYPTWINFLW_SY_Compu /end COMPU_METHOD
/begin COMPU_VTAB EXHFLP2_TYPTWINFLW_SY_Compu "" TAB_VERB 2 0 "False" 1 "True" /end COMPU_VTAB
/begin COMPU_METHOD EXHFLPLPI_TYPAVL_SC_Compu "" TAB_VERB "%6.3" "" COMPU_TAB_REF EXHFLPLPI_TYPAVL_SC_Compu /end COMPU_METHOD
/begin COMPU_VTAB EXHFLPLPI_TYPAVL_SC_Compu "" TAB_VERB 2 0 "False" 1 "True" /end COMPU_VTAB
/begin COMPU_METHOD EXHFLP_PWMOUTCAL_SY_Compu "" TAB_VERB "%6.3" "" COMPU_TAB_REF EXHFLP_PWMOUTCAL_SY_Compu /end COMPU_METHOD
/begin COMPU_VTAB EXHFLP_PWMOUTCAL_SY_Compu "" TAB_VERB 2 0 "FALSE" 1 "TRUE" /end COMPU_VTAB
/begin COMPU_METHOD EXHFLP_TYPAVLDELIBSTDACTR_SY_Compu "" TAB_VERB "%6.3" "" COMPU_TAB_REF EXHFLP_TYPAVLDELIBSTDACTR_SY_Compu /end COMPU_METHOD
/begin COMPU_VTAB EXHFLP_TYPAVLDELIBSTDACTR_SY_Compu "" TAB_VERB 2 0 "FALSE" 1 "TRUE" /end COMPU_VTAB
/begin COMPU_METHOD EXHFLP_TYPAVL_SY_Compu "" TAB_VERB "%6.3" "" COMPU_TAB_REF EXHFLP_TYPAVL_SY_Compu /end COMPU_METHOD
/begin COMPU_VTAB EXHFLP_TYPAVL_SY_Compu "" TAB_VERB 2 0 "FALSE" 1 "TRUE" /end COMPU_VTAB
/begin COMPU_METHOD EXHFLP_TYPTWINFLW_SY_Compu "" TAB_VERB "%6.3" "" COMPU_TAB_REF EXHFLP_TYPTWINFLW_SY_Compu /end COMPU_METHOD
/begin COMPU_VTAB EXHFLP_TYPTWINFLW_SY_Compu "" TAB_VERB 2 0 "0" 1 "1" /end COMPU_VTAB
/begin COMPU_METHOD EXHMGTTQINTLSTGY_SC_Compu "" TAB_VERB "%6.3" "" COMPU_TAB_REF EXHMGTTQINTLSTGY_SC_Compu /end COMPU_METHOD
/begin COMPU_VTAB EXHMGTTQINTLSTGY_SC_Compu "" TAB_VERB 2 0 "False" 1 "True" /end COMPU_VTAB
/begin COMPU_METHOD EXHMGT_ACTVCPTPROTNCOORR_SC_Compu "" TAB_VERB "%6.3" "" COMPU_TAB_REF EXHMGT_ACTVCPTPROTNCOORR_SC_Compu /end COMPU_METHOD
/begin COMPU_VTAB EXHMGT_ACTVCPTPROTNCOORR_SC_Compu "" TAB_VERB 2 0 "False" 1 "True" /end COMPU_VTAB
/begin COMPU_METHOD EXHMGT_ACTVNLIMNTQTCAT_SC_Compu "" TAB_VERB "%6.3" "" COMPU_TAB_REF EXHMGT_ACTVNLIMNTQTCAT_SC_Compu /end COMPU_METHOD
/begin COMPU_VTAB EXHMGT_ACTVNLIMNTQTCAT_SC_Compu "" TAB_VERB 2 0 "False" 1 "True" /end COMPU_VTAB
/begin COMPU_METHOD EXHMGT_CATHEATGENGSTREQACTV_SC_Compu "" TAB_VERB "%6.3" "" COMPU_TAB_REF EXHMGT_CATHEATGENGSTREQACTV_SC_Compu /end COMPU_METHOD
/begin COMPU_VTAB EXHMGT_CATHEATGENGSTREQACTV_SC_Compu "" TAB_VERB 2 0 "False" 1 "True" /end COMPU_VTAB
/begin COMPU_METHOD EXHMGT_CATWRMHLDCLSDCLU_SC_Compu "" TAB_VERB "%6.3" "" COMPU_TAB_REF EXHMGT_CATWRMHLDCLSDCLU_SC_Compu /end COMPU_METHOD
/begin COMPU_VTAB EXHMGT_CATWRMHLDCLSDCLU_SC_Compu "" TAB_VERB 2 0 "False" 1 "True" /end COMPU_VTAB
/begin COMPU_METHOD EXHMGT_CMBENGDRVOFFDLYENA_SC_Compu "" TAB_VERB "%6.3" "" COMPU_TAB_REF EXHMGT_CMBENGDRVOFFDLYENA_SC_Compu /end COMPU_METHOD
/begin COMPU_VTAB EXHMGT_CMBENGDRVOFFDLYENA_SC_Compu "" TAB_VERB 2 0 "False" 1 "True" /end COMPU_VTAB
/begin COMPU_METHOD EXHMGT_CMBNEVLNDIAGETAIA_SC_Compu "" TAB_VERB "%6.3" "" COMPU_TAB_REF EXHMGT_CMBNEVLNDIAGETAIA_SC_Compu /end COMPU_METHOD
/begin COMPU_VTAB EXHMGT_CMBNEVLNDIAGETAIA_SC_Compu "" TAB_VERB 2 0 "False" 1 "True" /end COMPU_VTAB
/begin COMPU_METHOD EXHMGT_CORRNLAMCATHEATG_SC_Compu "" TAB_VERB "%6.3" "" COMPU_TAB_REF EXHMGT_CORRNLAMCATHEATG_SC_Compu /end COMPU_METHOD
/begin COMPU_VTAB EXHMGT_CORRNLAMCATHEATG_SC_Compu "" TAB_VERB 2 0 "False" 1 "True" /end COMPU_VTAB
/begin COMPU_METHOD EXHMGT_CORRNLAMSECAIRSYS_SC_Compu "" TAB_VERB "%6.3" "" COMPU_TAB_REF EXHMGT_CORRNLAMSECAIRSYS_SC_Compu /end COMPU_METHOD
/begin COMPU_VTAB EXHMGT_CORRNLAMSECAIRSYS_SC_Compu "" TAB_VERB 2 0 "False" 1 "True" /end COMPU_VTAB
/begin COMPU_METHOD EXHMGT_CPTPROTNDRVCDN_SC_Compu "" TAB_VERB "%6.3" "" COMPU_TAB_REF EXHMGT_CPTPROTNDRVCDN_SC_Compu /end COMPU_METHOD
/begin COMPU_VTAB EXHMGT_CPTPROTNDRVCDN_SC_Compu "" TAB_VERB 2 0 "False" 1 "True" /end COMPU_VTAB
/begin COMPU_METHOD EXHMGT_CPTPROTNENGT_SC_Compu "" TAB_VERB "%6.3" "" COMPU_TAB_REF EXHMGT_CPTPROTNENGT_SC_Compu /end COMPU_METHOD
/begin COMPU_VTAB EXHMGT_CPTPROTNENGT_SC_Compu "" TAB_VERB 2 0 "DEACTIVE" 1 "ACTIVE" /end COMPU_VTAB
/begin COMPU_METHOD EXHMGT_CPTPROTNGOVRREDNFILLG_SC_Compu "" TAB_VERB "%6.3" "" COMPU_TAB_REF EXHMGT_CPTPROTNGOVRREDNFILLG_SC_Compu /end COMPU_METHOD
/begin COMPU_VTAB EXHMGT_CPTPROTNGOVRREDNFILLG_SC_Compu "" TAB_VERB 2 0 "False" 1 "True" /end COMPU_VTAB
/begin COMPU_METHOD EXHMGT_CPTPROTNGOVR_SC_Compu "" TAB_VERB "%6.3" "" COMPU_TAB_REF EXHMGT_CPTPROTNGOVR_SC_Compu /end COMPU_METHOD
/begin COMPU_VTAB EXHMGT_CPTPROTNGOVR_SC_Compu "" TAB_VERB 2 0 "False" 1 "True" /end COMPU_VTAB
/begin COMPU_METHOD EXHMGT_CPTPROTNPREIGN_SC_Compu "" TAB_VERB "%6.3" "" COMPU_TAB_REF EXHMGT_CPTPROTNPREIGN_SC_Compu /end COMPU_METHOD
/begin COMPU_VTAB EXHMGT_CPTPROTNPREIGN_SC_Compu "" TAB_VERB 2 0 "False" 1 "True" /end COMPU_VTAB
/begin COMPU_METHOD EXHMGT_CPTPROTNTRRNMOD_SC_Compu "" TAB_VERB "%6.3" "" COMPU_TAB_REF EXHMGT_CPTPROTNTRRNMOD_SC_Compu /end COMPU_METHOD
/begin COMPU_VTAB EXHMGT_CPTPROTNTRRNMOD_SC_Compu "" TAB_VERB 2 0 "False" 1 "True" /end COMPU_VTAB
/begin COMPU_METHOD EXHMGT_CYLINDCPTPROTN_SC_Compu "" TAB_VERB "%6.3" "" COMPU_TAB_REF EXHMGT_CYLINDCPTPROTN_SC_Compu /end COMPU_METHOD
/begin COMPU_VTAB EXHMGT_CYLINDCPTPROTN_SC_Compu "" TAB_VERB 2 0 "False" 1 "True" /end COMPU_VTAB
/begin COMPU_METHOD EXHMGT_DEACTVNDIAGIGNHYB_SC_Compu "" TAB_VERB "%6.3" "" COMPU_TAB_REF EXHMGT_DEACTVNDIAGIGNHYB_SC_Compu /end COMPU_METHOD
/begin COMPU_VTAB EXHMGT_DEACTVNDIAGIGNHYB_SC_Compu "" TAB_VERB 2 0 "False" 1 "True" /end COMPU_VTAB
/begin COMPU_METHOD EXHMGT_DEACTVNINJCPTPROTN_SC_Compu "" TAB_VERB "%6.3" "" COMPU_TAB_REF EXHMGT_DEACTVNINJCPTPROTN_SC_Compu /end COMPU_METHOD
/begin COMPU_VTAB EXHMGT_DEACTVNINJCPTPROTN_SC_Compu "" TAB_VERB 2 0 "False" 1 "True" /end COMPU_VTAB
/begin COMPU_METHOD EXHMGT_DMDCATHEATGDESOXTWC_SC_Compu "" TAB_VERB "%6.3" "" COMPU_TAB_REF EXHMGT_DMDCATHEATGDESOXTWC_SC_Compu /end COMPU_METHOD
/begin COMPU_VTAB EXHMGT_DMDCATHEATGDESOXTWC_SC_Compu "" TAB_VERB 2 0 "False" 1 "True" /end COMPU_VTAB
/begin COMPU_METHOD EXHMGT_ENAFEATTQINNRLIMNCATHEATG_SC_Compu "" TAB_VERB "%6.3" "" COMPU_TAB_REF EXHMGT_ENAFEATTQINNRLIMNCATHEATG_SC_Compu /end COMPU_METHOD
/begin COMPU_VTAB EXHMGT_ENAFEATTQINNRLIMNCATHEATG_SC_Compu "" TAB_VERB 2 0 "EXHMGT_ENAFEATTQINNRLIMNCATHEATG_SC = 0" 1 "EXHMGT_ENAFEATTQINNRLIMNCATHEATG_SC = 1" /end COMPU_VTAB
/begin COMPU_METHOD EXHMGT_KNKCTRLCPTPROTN_SC_Compu "" TAB_VERB "%6.3" "" COMPU_TAB_REF EXHMGT_KNKCTRLCPTPROTN_SC_Compu /end COMPU_METHOD
/begin COMPU_VTAB EXHMGT_KNKCTRLCPTPROTN_SC_Compu "" TAB_VERB 2 0 "False" 1 "True" /end COMPU_VTAB
/begin COMPU_METHOD EXHMGT_LAMONECNCPTCPTPROTN_SC_Compu "" TAB_VERB "%6.3" "" COMPU_TAB_REF EXHMGT_LAMONECNCPTCPTPROTN_SC_Compu /end COMPU_METHOD
/begin COMPU_VTAB EXHMGT_LAMONECNCPTCPTPROTN_SC_Compu "" TAB_VERB 2 0 "False" 1 "True" /end COMPU_VTAB
/begin COMPU_METHOD EXHMGT_MFLOWFCOINHBNCPTPROTN_SC_Compu "" TAB_VERB "%6.3" "" COMPU_TAB_REF EXHMGT_MFLOWFCOINHBNCPTPROTN_SC_Compu /end COMPU_METHOD
/begin COMPU_VTAB EXHMGT_MFLOWFCOINHBNCPTPROTN_SC_Compu "" TAB_VERB 2 0 "0" 1 "1" /end COMPU_VTAB
/begin COMPU_METHOD EXHMGT_NRBRICKCAT1_SC_Compu "" RAT_FUNC "%6.2" "" COEFFS 0 1 0 0 0 1 /end COMPU_METHOD
/begin COMPU_METHOD EXHMGT_NRBRICKCAT2_SC_Compu "" RAT_FUNC "%6.2" "" COEFFS 0 1 0 0 0 1 /end COMPU_METHOD
/begin COMPU_METHOD EXHMGT_POSNCATNSC1_SC_Compu "" TAB_VERB "%6.3" "" COMPU_TAB_REF EXHMGT_POSNCATNSC1_SC_Compu /end COMPU_METHOD
/begin COMPU_VTAB EXHMGT_POSNCATNSC1_SC_Compu "" TAB_VERB 5 0 "NSC1_NO" 1 "NSC1_CAT1" 2 "NSC1_CAT2" 3 "NSC1_CAT3" 4 "NSC1_CAT4" /end COMPU_VTAB
/begin COMPU_METHOD EXHMGT_POSNCATNSC2_SC_Compu "" TAB_VERB "%6.3" "" COMPU_TAB_REF EXHMGT_POSNCATNSC2_SC_Compu /end COMPU_METHOD
/begin COMPU_VTAB EXHMGT_POSNCATNSC2_SC_Compu "" TAB_VERB 5 0 "NSC2_NO" 1 "NSC2_CAT1" 2 "NSC2_CAT2" 3 "NSC2_CAT3" 4 "NSC2_CAT4" /end COMPU_VTAB
/begin COMPU_METHOD EXHMGT_PTSTANDDECOUPLENA_SC_Compu "" TAB_VERB "%6.3" "" COMPU_TAB_REF EXHMGT_PTSTANDDECOUPLENA_SC_Compu /end COMPU_METHOD
/begin COMPU_VTAB EXHMGT_PTSTANDDECOUPLENA_SC_Compu "" TAB_VERB 2 0 "False" 1 "True" /end COMPU_VTAB
/begin COMPU_METHOD EXHMGT_SECAIRVLVCTRL2ECU_SC_Compu "" TAB_VERB "%6.3" "" COMPU_TAB_REF EXHMGT_SECAIRVLVCTRL2ECU_SC_Compu /end COMPU_METHOD
/begin COMPU_VTAB EXHMGT_SECAIRVLVCTRL2ECU_SC_Compu "" TAB_VERB 2 0 "False" 1 "True" /end COMPU_VTAB
/begin COMPU_METHOD EXHMGT_SELNSTGYCSERSDIAG_SC_Compu "" TAB_VERB "%6.3" "" COMPU_TAB_REF EXHMGT_SELNSTGYCSERSDIAG_SC_Compu /end COMPU_METHOD
/begin COMPU_VTAB EXHMGT_SELNSTGYCSERSDIAG_SC_Compu "" TAB_VERB 3 0 "0" 1 "1" 2 "2" /end COMPU_VTAB
/begin COMPU_METHOD EXHMGT_SEPPCLAMCAT_SC_Compu "" TAB_VERB "%6.3" "" COMPU_TAB_REF EXHMGT_SEPPCLAMCAT_SC_Compu /end COMPU_METHOD
/begin COMPU_VTAB EXHMGT_SEPPCLAMCAT_SC_Compu "" TAB_VERB 2 0 "False" 1 "True" /end COMPU_VTAB
/begin COMPU_METHOD EXHMGT_STCATHEATGSHIFTPAT_SC_Compu "" TAB_VERB "%6.3" "" COMPU_TAB_REF EXHMGT_STCATHEATGSHIFTPAT_SC_Compu /end COMPU_METHOD
/begin COMPU_VTAB EXHMGT_STCATHEATGSHIFTPAT_SC_Compu "" TAB_VERB 2 0 "False" 1 "True" /end COMPU_VTAB
/begin COMPU_METHOD EXHMGT_STGYCATHEATGEEDCLD_SC_Compu "" TAB_VERB "%6.3" "" COMPU_TAB_REF EXHMGT_STGYCATHEATGEEDCLD_SC_Compu /end COMPU_METHOD
/begin COMPU_VTAB EXHMGT_STGYCATHEATGEEDCLD_SC_Compu "" TAB_VERB 2 0 "False" 1 "True" /end COMPU_VTAB
/begin COMPU_METHOD EXHMGT_SWTENGSTRTDLYACTV_SC_Compu "" TAB_VERB "%6.3" "" COMPU_TAB_REF EXHMGT_SWTENGSTRTDLYACTV_SC_Compu /end COMPU_METHOD
/begin COMPU_VTAB EXHMGT_SWTENGSTRTDLYACTV_SC_Compu "" TAB_VERB 2 0 "False" 1 "True" /end COMPU_VTAB
/begin COMPU_METHOD EXHMGT_TEXHGOVRRGNGPF_SC_Compu "" TAB_VERB "%6.3" "" COMPU_TAB_REF EXHMGT_TEXHGOVRRGNGPF_SC_Compu /end COMPU_METHOD
/begin COMPU_VTAB EXHMGT_TEXHGOVRRGNGPF_SC_Compu "" TAB_VERB 2 0 "False" 1 "True" /end COMPU_VTAB
/begin COMPU_METHOD EXHMGT_TGRDTBASDCATWRMREQRST_SC_Compu "" TAB_VERB "%6.3" "" COMPU_TAB_REF EXHMGT_TGRDTBASDCATWRMREQRST_SC_Compu /end COMPU_METHOD
/begin COMPU_VTAB EXHMGT_TGRDTBASDCATWRMREQRST_SC_Compu "" TAB_VERB 2 0 "FALSE" 1 "TRUE" /end COMPU_VTAB
/begin COMPU_METHOD EXHMGT_TRBALTICPTPROTN_SC_Compu "" TAB_VERB "%6.3" "" COMPU_TAB_REF EXHMGT_TRBALTICPTPROTN_SC_Compu /end COMPU_METHOD
/begin COMPU_VTAB EXHMGT_TRBALTICPTPROTN_SC_Compu "" TAB_VERB 2 0 "False" 1 "True" /end COMPU_VTAB
/begin COMPU_METHOD EXHMGT_TRSMEXHSYSWRMUPMON_SC_Compu "" TAB_VERB "%6.3" "" COMPU_TAB_REF EXHMGT_TRSMEXHSYSWRMUPMON_SC_Compu /end COMPU_METHOD
/begin COMPU_VTAB EXHMGT_TRSMEXHSYSWRMUPMON_SC_Compu "" TAB_VERB 2 0 "False" 1 "True" /end COMPU_VTAB
/begin COMPU_METHOD EXHMGT_TRSMEXHSYSWRMUPSELN_SC_Compu "" TAB_VERB "%6.3" "" COMPU_TAB_REF EXHMGT_TRSMEXHSYSWRMUPSELN_SC_Compu /end COMPU_METHOD
/begin COMPU_VTAB EXHMGT_TRSMEXHSYSWRMUPSELN_SC_Compu "" TAB_VERB 3 0 "FC_DISAD" 1 "ENAD_MINENG_CATT" 2 "ENAD_MINENG_SCRT" /end COMPU_VTAB
/begin COMPU_METHOD EXHMGT_VAR_SY_Compu "" TAB_VERB "%6.3" "" COMPU_TAB_REF EXHMGT_VAR_SY_Compu /end COMPU_METHOD
/begin COMPU_VTAB EXHMGT_VAR_SY_Compu "" TAB_VERB 48 1 "DAI" 3 "VWW" 4 "POR" 5 "AUD" 6 "OPE" 9 "FIA" 11 "BMW" 14 "PSA" 15 "REN" 17 "ALF" 18 "SAB" 19 "VOL" 20 "NIS" 21 "GMU" 22 "FOR" 26 "IMJ" 36 "MAN" 51 "SEA" 53 "CHR" 54 "JAG" 55 "ROL" 69 "FER" 72 "TOY" 123 "MIT" 147 "HYU" 159 "HON" 160 "MAZ" 183 "CU" 190 "LRG" 204 "VVW" 214 "AVT" 242 "Iveco" 243 "DMC" 248 "SUZ" 267 "SSANGYONG" 270 "KEF" 289 "AMG" 308 "TAT" 319 "MVM" 385 "UAES" 425 "Polaris" 590 "Scania" 609 "Deutz" 828 "RBCD" 898 "MFTBC" 999 "ALL" 2887 "Nonox" 9454 "Fuso" /end COMPU_VTAB
/begin COMPU_METHOD EXHMOD_ACTVTTSTRCOM_SC_Compu "" TAB_VERB "%6.3" "" COMPU_TAB_REF EXHMOD_ACTVTTSTRCOM_SC_Compu /end COMPU_METHOD
/begin COMPU_VTAB EXHMOD_ACTVTTSTRCOM_SC_Compu "" TAB_VERB 2 0 "False" 1 "True" /end COMPU_VTAB
/begin COMPU_METHOD EXHMOD_ADPNCOOLGCRV_SC_Compu "" TAB_VERB "%6.3" "" COMPU_TAB_REF EXHMOD_ADPNCOOLGCRV_SC_Compu /end COMPU_METHOD
/begin COMPU_VTAB EXHMOD_ADPNCOOLGCRV_SC_Compu "" TAB_VERB 2 0 "DISABLE" 1 "ENABLE" /end COMPU_VTAB
/begin COMPU_METHOD EXHMOD_APPL_SC_Compu "" TAB_VERB "%6.3" "" COMPU_TAB_REF EXHMOD_APPL_SC_Compu /end COMPU_METHOD
/begin COMPU_VTAB EXHMOD_APPL_SC_Compu "" TAB_VERB 2 0 "0" 1 "1" /end COMPU_VTAB
/begin COMPU_METHOD Fact1000 "" RAT_FUNC "%6.5" "-" COEFFS 0 1000 0 0 0 1 /end COMPU_METHOD
/begin COMPU_METHOD i_q0p01_A "" RAT_FUNC "%6.4" "A" COEFFS 0 1 0 0 0 0.01 /end COMPU_METHOD
/begin COMPU_METHOD i_q1_mA "" RAT_FUNC "%6.2" "mA" COEFFS 0 1 0 0 0 1 /end COMPU_METHOD
/begin COMPU_METHOD OilMlg "" RAT_FUNC "%6.2" "km" COEFFS 0 1 0 0 0 1 /end COMPU_METHOD
/begin COMPU_METHOD OneToOne "" RAT_FUNC "%6.2" "-" COEFFS 0 1 0 0 0 1 /end COMPU_METHOD
/begin COMPU_METHOD Prc "" RAT_FUNC "%6.4" "%" COEFFS 0 81.92 0 0 0 1 /end COMPU_METHOD
/begin COMPU_METHOD q0p01_A_h_1 "" RAT_FUNC "%6.4" "Ah" COEFFS 0 100 0 0 0 1 /end COMPU_METHOD
/begin COMPU_METHOD RBPtCel_Perc_0p5_1 "" RAT_FUNC "%6.3" "%" COEFFS 0 2 0 0 0 1 /end COMPU_METHOD
/begin COMPU_METHOD RBPtCel_r_0p00001_1 "" RAT_FUNC "%8.7" "Ohm" COEFFS 0 100000 0 0 0 1 /end COMPU_METHOD
/begin COMPU_METHOD RBPtCel_v_1p0_1 "" RAT_FUNC "%6.2" "km/h" COEFFS 0 1 0 0 0 1 /end COMPU_METHOD
/begin COMPU_METHOD SCR_TEMP_CELS_float "" RAT_FUNC "%6.2" "deg C" COEFFS 0 1 0 0 0 1 /end COMPU_METHOD
/begin COMPU_METHOD spg_q0p0625_V "" RAT_FUNC "%6.4" "V" COEFFS 0 16 0 0 0 1 /end COMPU_METHOD
/begin COMPU_METHOD t10msxs_uw_b655p35 "" RAT_FUNC "%6.4" "s" COEFFS 0 1 0 0 0 0.01 /end COMPU_METHOD
/begin COMPU_METHOD Temp_Cels "" RAT_FUNC "%6.1" "deg C" COEFFS 0 10 2731.4 0 0 1 /end COMPU_METHOD
/begin COMPU_METHOD temp_q0p5_o30_degC "" RAT_FUNC "%6.2" "deg C" COEFFS 0 2 60 0 0 1 /end COMPU_METHOD
/begin COMPU_METHOD TimeDelay_s "" RAT_FUNC "%6.1" "s" COEFFS 0 0 1 0 0.00023283064365387 0 /end COMPU_METHOD
/begin COMPU_METHOD Time_Hr "" RAT_FUNC "%6.3" "h" COEFFS 0 2 0 0 0 1 /end COMPU_METHOD
/begin COMPU_METHOD Time_ms "" RAT_FUNC "%6.1" "ms" COEFFS 0 0.1 0 0 0 1 /end COMPU_METHOD
/begin COMPU_METHOD Time_s "" RAT_FUNC "%6.4" "s" COEFFS 0 100 0 0 0 1 /end COMPU_METHOD
/begin COMPU_METHOD Time_sec_q1_COMPU "" RAT_FUNC "%6.2" "s" COEFFS 0 1 0 0 0 1 /end COMPU_METHOD
/begin COMPU_METHOD t_q0p01 "" RAT_FUNC "%6.4" "s" COEFFS 0 100 0 0 0 1 /end COMPU_METHOD
/begin COMPU_METHOD t_q0p1 "" RAT_FUNC "%6.3" "s" COEFFS 0 10 0 0 0 1 /end COMPU_METHOD
/begin COMPU_METHOD t_q10_ms "" RAT_FUNC "%6.1" "ms" COEFFS 0 1 0 0 0 10 /end COMPU_METHOD
/begin COMPU_METHOD t_q1_ms "" RAT_FUNC "%6.2" "ms" COEFFS 0 1 0 0 0 1 /end COMPU_METHOD
/begin COMPU_METHOD U_mV_q0p9765625_COMPU "" RAT_FUNC "%6.2" "mV" COEFFS 0 1.024 0 0 0 1 /end COMPU_METHOD
/begin COMPU_METHOD Vel "" RAT_FUNC "%6.4" "km/h" COEFFS 0 100 0 0 0 1 /end COMPU_METHOD
/begin COMPU_METHOD Vel_CrCtl1_MPH "" RAT_FUNC "%6.2" "MPH" COEFFS 0 1 0 0 0 1 /end COMPU_METHOD
/begin COMPU_METHOD Volt "" RAT_FUNC "%6.3" "mV" COEFFS 0 5 0 0 0 1 /end COMPU_METHOD
/begin RECORD_LAYOUT RB_Curve_S16_S16 NO_AXIS_PTS_X 1 SWORD AXIS_PTS_X 2 SWORD INDEX_INCR DIRECT FNC_VALUES 3 SWORD COLUMN_DIR DIRECT /end RECORD_LAYOUT
/begin RECORD_LAYOUT RB_Val_Wboolean FNC_VALUES 1 UBYTE COLUMN_DIR DIRECT /end RECORD_LAYOUT
/begin RECORD_LAYOUT RB_Val_Ws16 FNC_VALUES 1 SWORD COLUMN_DIR DIRECT /end RECORD_LAYOUT
/begin RECORD_LAYOUT RB_Val_Ws32 FNC_VALUES 1 SLONG COLUMN_DIR DIRECT /end RECORD_LAYOUT
/begin RECORD_LAYOUT RB_Val_Wu16 FNC_VALUES 1 UWORD COLUMN_DIR DIRECT /end RECORD_LAYOUT
/begin RECORD_LAYOUT RB_Val_Wu32 FNC_VALUES 1 ULONG COLUMN_DIR DIRECT /end RECORD_LAYOUT
/begin RECORD_LAYOUT RB_Val_Wu8 FNC_VALUES 1 UBYTE COLUMN_DIR DIRECT /end RECORD_LAYOUT
/begin RECORD_LAYOUT Val_Wu16 FNC_VALUES 1 UWORD COLUMN_DIR DIRECT /end RECORD_LAYOUT
/begin RECORD_LAYOUT Val_Wu8 FNC_VALUES 1 UBYTE COLUMN_DIR DIRECT /end RECORD_LAYOUT
/end MODULE
/end PROJECT
