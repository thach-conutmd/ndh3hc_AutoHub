ASAP2_VERSION 1 60
/begin PROJECT MG1CA020 "MG1CA020"
/begin HEADER "" VERSION "MG1CA020_6SAY_V011_TPROT" PROJECT_NO MG1CA020 /end HEADER
/begin MODULE DIM ""
/begin MOD_COMMON "" BYTE_ORDER MSB_LAST ALIGNMENT_BYTE 1 ALIGNMENT_WORD 2 ALIGNMENT_LONG 4 ALIGNMENT_INT64 4 ALIGNMENT_FLOAT32_IEEE 4 ALIGNMENT_FLOAT64_IEEE 4 DATA_SIZE 32 /end MOD_COMMON
/begin CHARACTERISTIC DFES_GrpRpr.DFC_BrkBstPSnsrStuck_C "common MIL debouncing / group representative for common MIL debouncing of DFC_BrkBstPSnsrStuck" VALUE 0x804F9E20 Val_Wu16 703.000000000 DFC_Verb 0.00 703.000000000 FORMAT "%13.9" /end CHARACTERISTIC
/begin CHARACTERISTIC DFES_GrpRpr.DFC_BrkMnSwtContOn_C "common MIL debouncing / group representative for common MIL debouncing of DFC_BrkMnSwtContOn" VALUE 0x804F9E22 Val_Wu16 703.000000000 DFC_Verb 0.00 703.000000000 FORMAT "%13.9" /end CHARACTERISTIC
/begin CHARACTERISTIC DFES_GrpRpr.DFC_BrkMnSwtNotStp_C "common MIL debouncing / group representative for common MIL debouncing of DFC_BrkMnSwtNotStp" VALUE 0x804F9E24 Val_Wu16 703.000000000 DFC_Verb 0.00 703.000000000 FORMAT "%13.9" /end CHARACTERISTIC
/begin CHARACTERISTIC DFES_GrpRpr.DFC_BrkNpl_C "common MIL debouncing / group representative for common MIL debouncing of DFC_BrkNpl" VALUE 0x804F9E26 Val_Wu16 703.000000000 DFC_Verb 0.00 703.000000000 FORMAT "%13.9" /end CHARACTERISTIC
/begin CHARACTERISTIC DFES_GrpRpr.DFC_BrkRdntSwtContOn_C "common MIL debouncing / group representative for common MIL debouncing of DFC_BrkRdntSwtContOn" VALUE 0x804F9E28 Val_Wu16 703.000000000 DFC_Verb 0.00 703.000000000 FORMAT "%13.9" /end CHARACTERISTIC
/begin CHARACTERISTIC DFES_GrpRpr.DFC_BrkRdntSwtNotStp_C "common MIL debouncing / group representative for common MIL debouncing of DFC_BrkRdntSwtNotStp" VALUE 0x804F9E2A Val_Wu16 703.000000000 DFC_Verb 0.00 703.000000000 FORMAT "%13.9" /end CHARACTERISTIC
/begin CHARACTERISTIC DFES_GrpRpr.DFC_Clth3ONStuck_C "common MIL debouncing / group representative for common MIL debouncing of DFC_Clth3ONStuck" VALUE 0x804F9E2C Val_Wu16 703.000000000 DFC_Verb 0.00 703.000000000 FORMAT "%13.9" /end CHARACTERISTIC
/begin CHARACTERISTIC DFES_GrpRpr.DFC_Clth4OFFStuck_C "common MIL debouncing / group representative for common MIL debouncing of DFC_Clth4OFFStuck" VALUE 0x804F9E2E Val_Wu16 703.000000000 DFC_Verb 0.00 703.000000000 FORMAT "%13.9" /end CHARACTERISTIC
/begin CHARACTERISTIC DFES_GrpRpr.DFC_ClthOFFStuck_C "common MIL debouncing / group representative for common MIL debouncing of DFC_ClthOFFStuck" VALUE 0x804F9E30 Val_Wu16 703.000000000 DFC_Verb 0.00 703.000000000 FORMAT "%13.9" /end CHARACTERISTIC
/begin CHARACTERISTIC DFES_GrpRpr.DFC_ClthONStuck_C "common MIL debouncing / group representative for common MIL debouncing of DFC_ClthONStuck" VALUE 0x804F9E32 Val_Wu16 703.000000000 DFC_Verb 0.00 703.000000000 FORMAT "%13.9" /end CHARACTERISTIC
/begin CHARACTERISTIC DFES_GrpRpr.DFC_ClthStkFailInfo_C "common MIL debouncing / group representative for common MIL debouncing of DFC_ClthStkFailInfo" VALUE 0x804F9E34 Val_Wu16 703.000000000 DFC_Verb 0.00 703.000000000 FORMAT "%13.9" /end CHARACTERISTIC
/begin CHARACTERISTIC DFES_GrpRpr.DFC_ComACFailInfo_C "common MIL debouncing / group representative for common MIL debouncing of DFC_ComACFailInfo" VALUE 0x804F9E36 Val_Wu16 703.000000000 DFC_Verb 0.00 703.000000000 FORMAT "%13.9" /end CHARACTERISTIC
/begin CHARACTERISTIC DFES_GrpRpr.DFC_ComATFTValErr_C "common MIL debouncing / group representative for common MIL debouncing of DFC_ComATFTValErr" VALUE 0x804F9E38 Val_Wu16 703.000000000 DFC_Verb 0.00 703.000000000 FORMAT "%13.9" /end CHARACTERISTIC
/begin CHARACTERISTIC DFES_GrpRpr.DFC_ComATMILReq_C "common MIL debouncing / group representative for common MIL debouncing of DFC_ComATMILReq" VALUE 0x804F9E3A Val_Wu16 703.000000000 DFC_Verb 0.00 703.000000000 FORMAT "%13.9" /end CHARACTERISTIC
/begin CHARACTERISTIC DFES_GrpRpr.DFC_ComAYCAChksum_C "common MIL debouncing / group representative for common MIL debouncing of DFC_ComAYCAChksum" VALUE 0x804F9E3C Val_Wu16 703.000000000 DFC_Verb 0.00 703.000000000 FORMAT "%13.9" /end CHARACTERISTIC
/begin CHARACTERISTIC DFES_GrpRpr.DFC_ComAYCARingCnt_C "common MIL debouncing / group representative for common MIL debouncing of DFC_ComAYCARingCnt" VALUE 0x804F9E3E Val_Wu16 703.000000000 DFC_Verb 0.00 703.000000000 FORMAT "%13.9" /end CHARACTERISTIC
/begin CHARACTERISTIC DFES_GrpRpr.DFC_ComAYCATOut_C "common MIL debouncing / group representative for common MIL debouncing of DFC_ComAYCATOut" VALUE 0x804F9E40 Val_Wu16 703.000000000 DFC_Verb 0.00 703.000000000 FORMAT "%13.9" /end CHARACTERISTIC
/begin CHARACTERISTIC DFES_GrpRpr.DFC_ComAYCDChkSum_C "common MIL debouncing / group representative for common MIL debouncing of DFC_ComAYCDChkSum" VALUE 0x804F9E42 Val_Wu16 703.000000000 DFC_Verb 0.00 703.000000000 FORMAT "%13.9" /end CHARACTERISTIC
/begin CHARACTERISTIC DFES_GrpRpr.DFC_ComAYCDTOut_C "common MIL debouncing / group representative for common MIL debouncing of DFC_ComAYCDTOut" VALUE 0x804F9E44 Val_Wu16 703.000000000 DFC_Verb 0.00 703.000000000 FORMAT "%13.9" /end CHARACTERISTIC
/begin CHARACTERISTIC DFES_GrpRpr.DFC_ComAYCFChksum_C "common MIL debouncing / group representative for common MIL debouncing of DFC_ComAYCFChksum" VALUE 0x804F9E46 Val_Wu16 703.000000000 DFC_Verb 0.00 703.000000000 FORMAT "%13.9" /end CHARACTERISTIC
/begin CHARACTERISTIC DFES_GrpRpr.DFC_ComAYCFRingCnt_C "common MIL debouncing / group representative for common MIL debouncing of DFC_ComAYCFRingCnt" VALUE 0x804F9E48 Val_Wu16 703.000000000 DFC_Verb 0.00 703.000000000 FORMAT "%13.9" /end CHARACTERISTIC
/begin CHARACTERISTIC DFES_GrpRpr.DFC_ComAYCFTOut_C "common MIL debouncing / group representative for common MIL debouncing of DFC_ComAYCFTOut" VALUE 0x804F9E4A Val_Wu16 703.000000000 DFC_Verb 0.00 703.000000000 FORMAT "%13.9" /end CHARACTERISTIC
/begin CHARACTERISTIC DFES_GrpRpr.DFC_ComAYCGChksum_C "common MIL debouncing / group representative for common MIL debouncing of DFC_ComAYCGChksum" VALUE 0x804F9E4C Val_Wu16 703.000000000 DFC_Verb 0.00 703.000000000 FORMAT "%13.9" /end CHARACTERISTIC
/begin CHARACTERISTIC DFES_GrpRpr.DFC_ComAYCGRingCnt_C "common MIL debouncing / group representative for common MIL debouncing of DFC_ComAYCGRingCnt" VALUE 0x804F9E4E Val_Wu16 703.000000000 DFC_Verb 0.00 703.000000000 FORMAT "%13.9" /end CHARACTERISTIC
/begin CHARACTERISTIC DFES_GrpRpr.DFC_ComAYCGTOut_C "common MIL debouncing / group representative for common MIL debouncing of DFC_ComAYCGTOut" VALUE 0x804F9E50 Val_Wu16 703.000000000 DFC_Verb 0.00 703.000000000 FORMAT "%13.9" /end CHARACTERISTIC
/begin CHARACTERISTIC DFES_GrpRpr.DFC_ComAYCIChkSum_C "common MIL debouncing / group representative for common MIL debouncing of DFC_ComAYCIChkSum" VALUE 0x804F9E52 Val_Wu16 703.000000000 DFC_Verb 0.00 703.000000000 FORMAT "%13.9" /end CHARACTERISTIC
/begin CHARACTERISTIC DFES_GrpRpr.DFC_ComAYCIRingCnt_C "common MIL debouncing / group representative for common MIL debouncing of DFC_ComAYCIRingCnt" VALUE 0x804F9E54 Val_Wu16 703.000000000 DFC_Verb 0.00 703.000000000 FORMAT "%13.9" /end CHARACTERISTIC
/begin CHARACTERISTIC DFES_GrpRpr.DFC_ComAYCITOut_C "common MIL debouncing / group representative for common MIL debouncing of DFC_ComAYCITOut" VALUE 0x804F9E56 Val_Wu16 703.000000000 DFC_Verb 0.00 703.000000000 FORMAT "%13.9" /end CHARACTERISTIC
/begin CHARACTERISTIC DFES_GrpRpr.DFC_ComBCM1ChkSum_C "common MIL debouncing / group representative for common MIL debouncing of DFC_ComBCM1ChkSum" VALUE 0x804F9E58 Val_Wu16 703.000000000 DFC_Verb 0.00 703.000000000 FORMAT "%13.9" /end CHARACTERISTIC
/begin CHARACTERISTIC DFES_GrpRpr.DFC_ComBCM1RingCnt_C "common MIL debouncing / group representative for common MIL debouncing of DFC_ComBCM1RingCnt" VALUE 0x804F9E5A Val_Wu16 703.000000000 DFC_Verb 0.00 703.000000000 FORMAT "%13.9" /end CHARACTERISTIC
/begin CHARACTERISTIC DFES_GrpRpr.DFC_ComBCM1TOut_C "common MIL debouncing / group representative for common MIL debouncing of DFC_ComBCM1TOut" VALUE 0x804F9E5C Val_Wu16 703.000000000 DFC_Verb 0.00 703.000000000 FORMAT "%13.9" /end CHARACTERISTIC
/begin CHARACTERISTIC DFES_GrpRpr.DFC_ComCANABusOffErr_C "common MIL debouncing / group representative for common MIL debouncing of DFC_ComCANABusOffErr" VALUE 0x804F9E5E Val_Wu16 703.000000000 DFC_Verb 0.00 703.000000000 FORMAT "%13.9" /end CHARACTERISTIC
/begin CHARACTERISTIC DFES_GrpRpr.DFC_ComCANBBusOffErr_C "common MIL debouncing / group representative for common MIL debouncing of DFC_ComCANBBusOffErr" VALUE 0x804F9E60 Val_Wu16 703.000000000 DFC_Verb 0.00 703.000000000 FORMAT "%13.9" /end CHARACTERISTIC
/begin CHARACTERISTIC DFES_GrpRpr.DFC_ComCANCBusOffErr_C "common MIL debouncing / group representative for common MIL debouncing of DFC_ComCANCBusOffErr" VALUE 0x804F9E62 Val_Wu16 703.000000000 DFC_Verb 0.00 703.000000000 FORMAT "%13.9" /end CHARACTERISTIC
/begin CHARACTERISTIC DFES_GrpRpr.DFC_ComCGW1ChkSum_C "common MIL debouncing / group representative for common MIL debouncing of DFC_ComCGW1ChkSum" VALUE 0x804F9E64 Val_Wu16 703.000000000 DFC_Verb 0.00 703.000000000 FORMAT "%13.9" /end CHARACTERISTIC
/begin CHARACTERISTIC DFES_GrpRpr.DFC_ComCGW1RingCnt_C "common MIL debouncing / group representative for common MIL debouncing of DFC_ComCGW1RingCnt" VALUE 0x804F9E66 Val_Wu16 703.000000000 DFC_Verb 0.00 703.000000000 FORMAT "%13.9" /end CHARACTERISTIC
/begin CHARACTERISTIC DFES_GrpRpr.DFC_ComCGW1TOut_C "common MIL debouncing / group representative for common MIL debouncing of DFC_ComCGW1TOut" VALUE 0x804F9E68 Val_Wu16 703.000000000 DFC_Verb 0.00 703.000000000 FORMAT "%13.9" /end CHARACTERISTIC
/begin CHARACTERISTIC DFES_GrpRpr.DFC_ComConvBoostErr_C "common MIL debouncing / group representative for common MIL debouncing of DFC_ComConvBoostErr" VALUE 0x804F9E6A Val_Wu16 703.000000000 DFC_Verb 0.00 703.000000000 FORMAT "%13.9" /end CHARACTERISTIC
/begin CHARACTERISTIC DFES_GrpRpr.DFC_ComConvSlipErr_C "common MIL debouncing / group representative for common MIL debouncing of DFC_ComConvSlipErr" VALUE 0x804F9E6C Val_Wu16 703.000000000 DFC_Verb 0.00 703.000000000 FORMAT "%13.9" /end CHARACTERISTIC
/begin CHARACTERISTIC DFES_GrpRpr.DFC_ComEAT10Chksum_C "common MIL debouncing / group representative for common MIL debouncing of DFC_ComEAT10Chksum" VALUE 0x804F9E6E Val_Wu16 703.000000000 DFC_Verb 0.00 703.000000000 FORMAT "%13.9" /end CHARACTERISTIC
/begin CHARACTERISTIC DFES_GrpRpr.DFC_ComEAT10RingCnt_C "common MIL debouncing / group representative for common MIL debouncing of DFC_ComEAT10RingCnt" VALUE 0x804F9E70 Val_Wu16 703.000000000 DFC_Verb 0.00 703.000000000 FORMAT "%13.9" /end CHARACTERISTIC
/begin CHARACTERISTIC DFES_GrpRpr.DFC_ComEAT10TOut_C "common MIL debouncing / group representative for common MIL debouncing of DFC_ComEAT10TOut" VALUE 0x804F9E72 Val_Wu16 703.000000000 DFC_Verb 0.00 703.000000000 FORMAT "%13.9" /end CHARACTERISTIC
/begin CHARACTERISTIC DFES_GrpRpr.DFC_ComEAT11ChkSum_C "common MIL debouncing / group representative for common MIL debouncing of DFC_ComEAT11ChkSum" VALUE 0x804F9E74 Val_Wu16 703.000000000 DFC_Verb 0.00 703.000000000 FORMAT "%13.9" /end CHARACTERISTIC
/begin CHARACTERISTIC DFES_GrpRpr.DFC_ComEAT11RingCnt_C "common MIL debouncing / group representative for common MIL debouncing of DFC_ComEAT11RingCnt" VALUE 0x804F9E76 Val_Wu16 703.000000000 DFC_Verb 0.00 703.000000000 FORMAT "%13.9" /end CHARACTERISTIC
/begin CHARACTERISTIC DFES_GrpRpr.DFC_ComEAT11TOut_C "common MIL debouncing / group representative for common MIL debouncing of DFC_ComEAT11TOut" VALUE 0x804F9E78 Val_Wu16 703.000000000 DFC_Verb 0.00 703.000000000 FORMAT "%13.9" /end CHARACTERISTIC
/begin CHARACTERISTIC DFES_GrpRpr.DFC_ComEAT12ChkSum_C "common MIL debouncing / group representative for common MIL debouncing of DFC_ComEAT12ChkSum" VALUE 0x804F9E7A Val_Wu16 703.000000000 DFC_Verb 0.00 703.000000000 FORMAT "%13.9" /end CHARACTERISTIC
/begin CHARACTERISTIC DFES_GrpRpr.DFC_ComEAT12RingCnt_C "common MIL debouncing / group representative for common MIL debouncing of DFC_ComEAT12RingCnt" VALUE 0x804F9E7C Val_Wu16 703.000000000 DFC_Verb 0.00 703.000000000 FORMAT "%13.9" /end CHARACTERISTIC
/begin CHARACTERISTIC DFES_GrpRpr.DFC_ComEAT12TOut_C "common MIL debouncing / group representative for common MIL debouncing of DFC_ComEAT12TOut" VALUE 0x804F9E7E Val_Wu16 703.000000000 DFC_Verb 0.00 703.000000000 FORMAT "%13.9" /end CHARACTERISTIC
/begin CHARACTERISTIC DFES_GrpRpr.DFC_ComEAT13ChkSum_C "common MIL debouncing / group representative for common MIL debouncing of DFC_ComEAT13ChkSum" VALUE 0x804F9E80 Val_Wu16 703.000000000 DFC_Verb 0.00 703.000000000 FORMAT "%13.9" /end CHARACTERISTIC
/begin CHARACTERISTIC DFES_GrpRpr.DFC_ComEAT13RingCnt_C "common MIL debouncing / group representative for common MIL debouncing of DFC_ComEAT13RingCnt" VALUE 0x804F9E82 Val_Wu16 703.000000000 DFC_Verb 0.00 703.000000000 FORMAT "%13.9" /end CHARACTERISTIC
/begin CHARACTERISTIC DFES_GrpRpr.DFC_ComEAT13TOut_C "common MIL debouncing / group representative for common MIL debouncing of DFC_ComEAT13TOut" VALUE 0x804F9E84 Val_Wu16 703.000000000 DFC_Verb 0.00 703.000000000 FORMAT "%13.9" /end CHARACTERISTIC
/begin CHARACTERISTIC DFES_GrpRpr.DFC_ComEAT1Chksum_C "common MIL debouncing / group representative for common MIL debouncing of DFC_ComEAT1Chksum" VALUE 0x804F9E86 Val_Wu16 703.000000000 DFC_Verb 0.00 703.000000000 FORMAT "%13.9" /end CHARACTERISTIC
/begin CHARACTERISTIC DFES_GrpRpr.DFC_ComEAT1RingCnt_C "common MIL debouncing / group representative for common MIL debouncing of DFC_ComEAT1RingCnt" VALUE 0x804F9E88 Val_Wu16 703.000000000 DFC_Verb 0.00 703.000000000 FORMAT "%13.9" /end CHARACTERISTIC
/begin CHARACTERISTIC DFES_GrpRpr.DFC_ComEAT1TOut_C "common MIL debouncing / group representative for common MIL debouncing of DFC_ComEAT1TOut" VALUE 0x804F9E8A Val_Wu16 703.000000000 DFC_Verb 0.00 703.000000000 FORMAT "%13.9" /end CHARACTERISTIC
/begin CHARACTERISTIC DFES_GrpRpr.DFC_ComEAT2ChkSum_C "common MIL debouncing / group representative for common MIL debouncing of DFC_ComEAT2ChkSum" VALUE 0x804F9E8C Val_Wu16 703.000000000 DFC_Verb 0.00 703.000000000 FORMAT "%13.9" /end CHARACTERISTIC
/begin CHARACTERISTIC DFES_GrpRpr.DFC_ComEAT2RingCnt_C "common MIL debouncing / group representative for common MIL debouncing of DFC_ComEAT2RingCnt" VALUE 0x804F9E8E Val_Wu16 703.000000000 DFC_Verb 0.00 703.000000000 FORMAT "%13.9" /end CHARACTERISTIC
/begin CHARACTERISTIC DFES_GrpRpr.DFC_ComEAT2TOut_C "common MIL debouncing / group representative for common MIL debouncing of DFC_ComEAT2TOut" VALUE 0x804F9E90 Val_Wu16 703.000000000 DFC_Verb 0.00 703.000000000 FORMAT "%13.9" /end CHARACTERISTIC
/begin CHARACTERISTIC DFES_GrpRpr.DFC_ComEAT4ChkSum_C "common MIL debouncing / group representative for common MIL debouncing of DFC_ComEAT4ChkSum" VALUE 0x804F9E92 Val_Wu16 703.000000000 DFC_Verb 0.00 703.000000000 FORMAT "%13.9" /end CHARACTERISTIC
/begin CHARACTERISTIC DFES_GrpRpr.DFC_ComEAT4RingCnt_C "common MIL debouncing / group representative for common MIL debouncing of DFC_ComEAT4RingCnt" VALUE 0x804F9E94 Val_Wu16 703.000000000 DFC_Verb 0.00 703.000000000 FORMAT "%13.9" /end CHARACTERISTIC
/begin CHARACTERISTIC DFES_GrpRpr.DFC_ComEAT4TOut_C "common MIL debouncing / group representative for common MIL debouncing of DFC_ComEAT4TOut" VALUE 0x804F9E96 Val_Wu16 703.000000000 DFC_Verb 0.00 703.000000000 FORMAT "%13.9" /end CHARACTERISTIC
/begin CHARACTERISTIC DFES_GrpRpr.DFC_ComEAT6Chksum_C "common MIL debouncing / group representative for common MIL debouncing of DFC_ComEAT6Chksum" VALUE 0x804F9E98 Val_Wu16 703.000000000 DFC_Verb 0.00 703.000000000 FORMAT "%13.9" /end CHARACTERISTIC
/begin CHARACTERISTIC DFES_GrpRpr.DFC_ComEAT6RingCnt_C "common MIL debouncing / group representative for common MIL debouncing of DFC_ComEAT6RingCnt" VALUE 0x804F9E9A Val_Wu16 703.000000000 DFC_Verb 0.00 703.000000000 FORMAT "%13.9" /end CHARACTERISTIC
/begin CHARACTERISTIC DFES_GrpRpr.DFC_ComEAT6TOut_C "common MIL debouncing / group representative for common MIL debouncing of DFC_ComEAT6TOut" VALUE 0x804F9E9C Val_Wu16 703.000000000 DFC_Verb 0.00 703.000000000 FORMAT "%13.9" /end CHARACTERISTIC
/begin CHARACTERISTIC DFES_GrpRpr.DFC_ComEAT7Chksum_C "common MIL debouncing / group representative for common MIL debouncing of DFC_ComEAT7Chksum" VALUE 0x804F9E9E Val_Wu16 703.000000000 DFC_Verb 0.00 703.000000000 FORMAT "%13.9" /end CHARACTERISTIC
/begin CHARACTERISTIC DFES_GrpRpr.DFC_ComEAT7RingCnt_C "common MIL debouncing / group representative for common MIL debouncing of DFC_ComEAT7RingCnt" VALUE 0x804F9EA0 Val_Wu16 703.000000000 DFC_Verb 0.00 703.000000000 FORMAT "%13.9" /end CHARACTERISTIC
/begin CHARACTERISTIC DFES_GrpRpr.DFC_ComEAT7TOut_C "common MIL debouncing / group representative for common MIL debouncing of DFC_ComEAT7TOut" VALUE 0x804F9EA2 Val_Wu16 703.000000000 DFC_Verb 0.00 703.000000000 FORMAT "%13.9" /end CHARACTERISTIC
/begin CHARACTERISTIC DFES_GrpRpr.DFC_ComEAT8Chksum_C "common MIL debouncing / group representative for common MIL debouncing of DFC_ComEAT8Chksum" VALUE 0x804F9EA4 Val_Wu16 703.000000000 DFC_Verb 0.00 703.000000000 FORMAT "%13.9" /end CHARACTERISTIC
/begin CHARACTERISTIC DFES_GrpRpr.DFC_ComEAT8RingCnt_C "common MIL debouncing / group representative for common MIL debouncing of DFC_ComEAT8RingCnt" VALUE 0x804F9EA6 Val_Wu16 703.000000000 DFC_Verb 0.00 703.000000000 FORMAT "%13.9" /end CHARACTERISTIC
/begin CHARACTERISTIC DFES_GrpRpr.DFC_ComEAT8TOut_C "common MIL debouncing / group representative for common MIL debouncing of DFC_ComEAT8TOut" VALUE 0x804F9EA8 Val_Wu16 703.000000000 DFC_Verb 0.00 703.000000000 FORMAT "%13.9" /end CHARACTERISTIC
/begin CHARACTERISTIC DFES_GrpRpr.DFC_ComEATAChksum_C "common MIL debouncing / group representative for common MIL debouncing of DFC_ComEATAChksum" VALUE 0x804F9EAA Val_Wu16 703.000000000 DFC_Verb 0.00 703.000000000 FORMAT "%13.9" /end CHARACTERISTIC
/begin CHARACTERISTIC DFES_GrpRpr.DFC_ComEATARingCnt_C "common MIL debouncing / group representative for common MIL debouncing of DFC_ComEATARingCnt" VALUE 0x804F9EAC Val_Wu16 703.000000000 DFC_Verb 0.00 703.000000000 FORMAT "%13.9" /end CHARACTERISTIC
/begin CHARACTERISTIC DFES_GrpRpr.DFC_ComEATATOut_C "common MIL debouncing / group representative for common MIL debouncing of DFC_ComEATATOut" VALUE 0x804F9EAE Val_Wu16 703.000000000 DFC_Verb 0.00 703.000000000 FORMAT "%13.9" /end CHARACTERISTIC
/begin CHARACTERISTIC DFES_GrpRpr.DFC_ComEATBChkSum_C "common MIL debouncing / group representative for common MIL debouncing of DFC_ComEATBChkSum" VALUE 0x804F9EB0 Val_Wu16 703.000000000 DFC_Verb 0.00 703.000000000 FORMAT "%13.9" /end CHARACTERISTIC
/begin CHARACTERISTIC DFES_GrpRpr.DFC_ComEATBRingCnt_C "common MIL debouncing / group representative for common MIL debouncing of DFC_ComEATBRingCnt" VALUE 0x804F9EB2 Val_Wu16 703.000000000 DFC_Verb 0.00 703.000000000 FORMAT "%13.9" /end CHARACTERISTIC
/begin CHARACTERISTIC DFES_GrpRpr.DFC_ComEATBTOut_C "common MIL debouncing / group representative for common MIL debouncing of DFC_ComEATBTOut" VALUE 0x804F9EB4 Val_Wu16 703.000000000 DFC_Verb 0.00 703.000000000 FORMAT "%13.9" /end CHARACTERISTIC
/begin CHARACTERISTIC DFES_GrpRpr.DFC_ComEATCChksum_C "common MIL debouncing / group representative for common MIL debouncing of DFC_ComEATCChksum" VALUE 0x804F9EB6 Val_Wu16 703.000000000 DFC_Verb 0.00 703.000000000 FORMAT "%13.9" /end CHARACTERISTIC
/begin CHARACTERISTIC DFES_GrpRpr.DFC_ComEATCRingCnt_C "common MIL debouncing / group representative for common MIL debouncing of DFC_ComEATCRingCnt" VALUE 0x804F9EB8 Val_Wu16 703.000000000 DFC_Verb 0.00 703.000000000 FORMAT "%13.9" /end CHARACTERISTIC
/begin CHARACTERISTIC DFES_GrpRpr.DFC_ComEATCTOut_C "common MIL debouncing / group representative for common MIL debouncing of DFC_ComEATCTOut" VALUE 0x804F9EBA Val_Wu16 703.000000000 DFC_Verb 0.00 703.000000000 FORMAT "%13.9" /end CHARACTERISTIC
/begin CHARACTERISTIC DFES_GrpRpr.DFC_ComEBBAChksum_C "common MIL debouncing / group representative for common MIL debouncing of DFC_ComEBBAChksum" VALUE 0x804F9EBC Val_Wu16 703.000000000 DFC_Verb 0.00 703.000000000 FORMAT "%13.9" /end CHARACTERISTIC
/begin CHARACTERISTIC DFES_GrpRpr.DFC_ComEBBARingCnt_C "common MIL debouncing / group representative for common MIL debouncing of DFC_ComEBBARingCnt" VALUE 0x804F9EBE Val_Wu16 703.000000000 DFC_Verb 0.00 703.000000000 FORMAT "%13.9" /end CHARACTERISTIC
/begin CHARACTERISTIC DFES_GrpRpr.DFC_ComEBBATOut_C "common MIL debouncing / group representative for common MIL debouncing of DFC_ComEBBATOut" VALUE 0x804F9EC0 Val_Wu16 703.000000000 DFC_Verb 0.00 703.000000000 FORMAT "%13.9" /end CHARACTERISTIC
/begin CHARACTERISTIC DFES_GrpRpr.DFC_ComEPS1Chksum_C "common MIL debouncing / group representative for common MIL debouncing of DFC_ComEPS1Chksum" VALUE 0x804F9EC2 Val_Wu16 703.000000000 DFC_Verb 0.00 703.000000000 FORMAT "%13.9" /end CHARACTERISTIC
/begin CHARACTERISTIC DFES_GrpRpr.DFC_ComEPS1RingCnt_C "common MIL debouncing / group representative for common MIL debouncing of DFC_ComEPS1RingCnt" VALUE 0x804F9EC4 Val_Wu16 703.000000000 DFC_Verb 0.00 703.000000000 FORMAT "%13.9" /end CHARACTERISTIC
/begin CHARACTERISTIC DFES_GrpRpr.DFC_ComEPS1TOut_C "common MIL debouncing / group representative for common MIL debouncing of DFC_ComEPS1TOut" VALUE 0x804F9EC6 Val_Wu16 703.000000000 DFC_Verb 0.00 703.000000000 FORMAT "%13.9" /end CHARACTERISTIC
/begin CHARACTERISTIC DFES_GrpRpr.DFC_ComEngCanRxErr_C "common MIL debouncing / group representative for common MIL debouncing of DFC_ComEngCanRxErr" VALUE 0x804F9EC8 Val_Wu16 703.000000000 DFC_Verb 0.00 703.000000000 FORMAT "%13.9" /end CHARACTERISTIC
/begin CHARACTERISTIC DFES_GrpRpr.DFC_ComGrvySnsrErr_C "common MIL debouncing / group representative for common MIL debouncing of DFC_ComGrvySnsrErr" VALUE 0x804F9ECA Val_Wu16 703.000000000 DFC_Verb 0.00 703.000000000 FORMAT "%13.9" /end CHARACTERISTIC
/begin CHARACTERISTIC DFES_GrpRpr.DFC_ComGwIMG1ChkSum_C "common MIL debouncing / group representative for common MIL debouncing of DFC_ComGwIMG1ChkSum" VALUE 0x804F9ECC Val_Wu16 703.000000000 DFC_Verb 0.00 703.000000000 FORMAT "%13.9" /end CHARACTERISTIC
/begin CHARACTERISTIC DFES_GrpRpr.DFC_ComGwIMG1RingCnt_C "common MIL debouncing / group representative for common MIL debouncing of DFC_ComGwIMG1RingCnt" VALUE 0x804F9ECE Val_Wu16 703.000000000 DFC_Verb 0.00 703.000000000 FORMAT "%13.9" /end CHARACTERISTIC
/begin CHARACTERISTIC DFES_GrpRpr.DFC_ComGwIMG1TOut_C "common MIL debouncing / group representative for common MIL debouncing of DFC_ComGwIMG1TOut" VALUE 0x804F9ED0 Val_Wu16 703.000000000 DFC_Verb 0.00 703.000000000 FORMAT "%13.9" /end CHARACTERISTIC
/begin CHARACTERISTIC DFES_GrpRpr.DFC_ComGwIMG3ChkSum_C "common MIL debouncing / group representative for common MIL debouncing of DFC_ComGwIMG3ChkSum" VALUE 0x804F9ED2 Val_Wu16 703.000000000 DFC_Verb 0.00 703.000000000 FORMAT "%13.9" /end CHARACTERISTIC
/begin CHARACTERISTIC DFES_GrpRpr.DFC_ComGwIMG3RingCnt_C "common MIL debouncing / group representative for common MIL debouncing of DFC_ComGwIMG3RingCnt" VALUE 0x804F9ED4 Val_Wu16 703.000000000 DFC_Verb 0.00 703.000000000 FORMAT "%13.9" /end CHARACTERISTIC
/begin CHARACTERISTIC DFES_GrpRpr.DFC_ComGwIMG3TOut_C "common MIL debouncing / group representative for common MIL debouncing of DFC_ComGwIMG3TOut" VALUE 0x804F9ED6 Val_Wu16 703.000000000 DFC_Verb 0.00 703.000000000 FORMAT "%13.9" /end CHARACTERISTIC
/begin CHARACTERISTIC DFES_GrpRpr.DFC_ComGwIMG4ChkSum_C "common MIL debouncing / group representative for common MIL debouncing of DFC_ComGwIMG4ChkSum" VALUE 0x804F9ED8 Val_Wu16 703.000000000 DFC_Verb 0.00 703.000000000 FORMAT "%13.9" /end CHARACTERISTIC
/begin CHARACTERISTIC DFES_GrpRpr.DFC_ComGwIMG4RingCnt_C "common MIL debouncing / group representative for common MIL debouncing of DFC_ComGwIMG4RingCnt" VALUE 0x804F9EDA Val_Wu16 703.000000000 DFC_Verb 0.00 703.000000000 FORMAT "%13.9" /end CHARACTERISTIC
/begin CHARACTERISTIC DFES_GrpRpr.DFC_ComGwIMG4TOut_C "common MIL debouncing / group representative for common MIL debouncing of DFC_ComGwIMG4TOut" VALUE 0x804F9EDC Val_Wu16 703.000000000 DFC_Verb 0.00 703.000000000 FORMAT "%13.9" /end CHARACTERISTIC
/begin CHARACTERISTIC DFES_GrpRpr.DFC_ComGwIMG5ChkSum_C "common MIL debouncing / group representative for common MIL debouncing of DFC_ComGwIMG5ChkSum" VALUE 0x804F9EDE Val_Wu16 703.000000000 DFC_Verb 0.00 703.000000000 FORMAT "%13.9" /end CHARACTERISTIC
/begin CHARACTERISTIC DFES_GrpRpr.DFC_ComGwIMG5RingCnt_C "common MIL debouncing / group representative for common MIL debouncing of DFC_ComGwIMG5RingCnt" VALUE 0x804F9EE0 Val_Wu16 703.000000000 DFC_Verb 0.00 703.000000000 FORMAT "%13.9" /end CHARACTERISTIC
/begin CHARACTERISTIC DFES_GrpRpr.DFC_ComGwIMG5TOut_C "common MIL debouncing / group representative for common MIL debouncing of DFC_ComGwIMG5TOut" VALUE 0x804F9EE2 Val_Wu16 703.000000000 DFC_Verb 0.00 703.000000000 FORMAT "%13.9" /end CHARACTERISTIC
/begin CHARACTERISTIC DFES_GrpRpr.DFC_ComGwIMG6ChkSum_C "common MIL debouncing / group representative for common MIL debouncing of DFC_ComGwIMG6ChkSum" VALUE 0x804F9EE4 Val_Wu16 703.000000000 DFC_Verb 0.00 703.000000000 FORMAT "%13.9" /end CHARACTERISTIC
/begin CHARACTERISTIC DFES_GrpRpr.DFC_ComGwIMG6RingCnt_C "common MIL debouncing / group representative for common MIL debouncing of DFC_ComGwIMG6RingCnt" VALUE 0x804F9EE6 Val_Wu16 703.000000000 DFC_Verb 0.00 703.000000000 FORMAT "%13.9" /end CHARACTERISTIC
/begin CHARACTERISTIC DFES_GrpRpr.DFC_ComGwIMG6TOut_C "common MIL debouncing / group representative for common MIL debouncing of DFC_ComGwIMG6TOut" VALUE 0x804F9EE8 Val_Wu16 703.000000000 DFC_Verb 0.00 703.000000000 FORMAT "%13.9" /end CHARACTERISTIC
/begin CHARACTERISTIC DFES_GrpRpr.DFC_ComIDASBChksum_C "common MIL debouncing / group representative for common MIL debouncing of DFC_ComIDASBChksum" VALUE 0x804F9EEA Val_Wu16 703.000000000 DFC_Verb 0.00 703.000000000 FORMAT "%13.9" /end CHARACTERISTIC
/begin CHARACTERISTIC DFES_GrpRpr.DFC_ComIDASBRingCnt_C "common MIL debouncing / group representative for common MIL debouncing of DFC_ComIDASBRingCnt" VALUE 0x804F9EEC Val_Wu16 703.000000000 DFC_Verb 0.00 703.000000000 FORMAT "%13.9" /end CHARACTERISTIC
/begin CHARACTERISTIC DFES_GrpRpr.DFC_ComIDASBTOut_C "common MIL debouncing / group representative for common MIL debouncing of DFC_ComIDASBTOut" VALUE 0x804F9EEE Val_Wu16 703.000000000 DFC_Verb 0.00 703.000000000 FORMAT "%13.9" /end CHARACTERISTIC
/begin CHARACTERISTIC DFES_GrpRpr.DFC_ComIMGMILReq_C "common MIL debouncing / group representative for common MIL debouncing of DFC_ComIMGMILReq" VALUE 0x804F9EF0 Val_Wu16 703.000000000 DFC_Verb 0.00 703.000000000 FORMAT "%13.9" /end CHARACTERISTIC
/begin CHARACTERISTIC DFES_GrpRpr.DFC_ComISSPrms_C "common MIL debouncing / group representative for common MIL debouncing of DFC_ComISSPrms" VALUE 0x804F9EF2 Val_Wu16 703.000000000 DFC_Verb 0.00 703.000000000 FORMAT "%13.9" /end CHARACTERISTIC
/begin CHARACTERISTIC DFES_GrpRpr.DFC_ComMETAChksum_C "common MIL debouncing / group representative for common MIL debouncing of DFC_ComMETAChksum" VALUE 0x804F9EF4 Val_Wu16 703.000000000 DFC_Verb 0.00 703.000000000 FORMAT "%13.9" /end CHARACTERISTIC
/begin CHARACTERISTIC DFES_GrpRpr.DFC_ComMETARingCnt_C "common MIL debouncing / group representative for common MIL debouncing of DFC_ComMETARingCnt" VALUE 0x804F9EF6 Val_Wu16 703.000000000 DFC_Verb 0.00 703.000000000 FORMAT "%13.9" /end CHARACTERISTIC
/begin CHARACTERISTIC DFES_GrpRpr.DFC_ComMETATOut_C "common MIL debouncing / group representative for common MIL debouncing of DFC_ComMETATOut" VALUE 0x804F9EF8 Val_Wu16 703.000000000 DFC_Verb 0.00 703.000000000 FORMAT "%13.9" /end CHARACTERISTIC
/begin CHARACTERISTIC DFES_GrpRpr.DFC_ComMETCChksum_C "common MIL debouncing / group representative for common MIL debouncing of DFC_ComMETCChksum" VALUE 0x804F9EFA Val_Wu16 703.000000000 DFC_Verb 0.00 703.000000000 FORMAT "%13.9" /end CHARACTERISTIC
/begin CHARACTERISTIC DFES_GrpRpr.DFC_ComMETCRingCnt_C "common MIL debouncing / group representative for common MIL debouncing of DFC_ComMETCRingCnt" VALUE 0x804F9EFC Val_Wu16 703.000000000 DFC_Verb 0.00 703.000000000 FORMAT "%13.9" /end CHARACTERISTIC
/begin CHARACTERISTIC DFES_GrpRpr.DFC_ComMETCTOut_C "common MIL debouncing / group representative for common MIL debouncing of DFC_ComMETCTOut" VALUE 0x804F9EFE Val_Wu16 703.000000000 DFC_Verb 0.00 703.000000000 FORMAT "%13.9" /end CHARACTERISTIC
/begin CHARACTERISTIC DFES_GrpRpr.DFC_ComMETDChksum_C "common MIL debouncing / group representative for common MIL debouncing of DFC_ComMETDChksum" VALUE 0x804F9F00 Val_Wu16 703.000000000 DFC_Verb 0.00 703.000000000 FORMAT "%13.9" /end CHARACTERISTIC
/begin CHARACTERISTIC DFES_GrpRpr.DFC_ComMETDRingCnt_C "common MIL debouncing / group representative for common MIL debouncing of DFC_ComMETDRingCnt" VALUE 0x804F9F02 Val_Wu16 703.000000000 DFC_Verb 0.00 703.000000000 FORMAT "%13.9" /end CHARACTERISTIC
/begin CHARACTERISTIC DFES_GrpRpr.DFC_ComMETDTOut_C "common MIL debouncing / group representative for common MIL debouncing of DFC_ComMETDTOut" VALUE 0x804F9F04 Val_Wu16 703.000000000 DFC_Verb 0.00 703.000000000 FORMAT "%13.9" /end CHARACTERISTIC
/begin CHARACTERISTIC DFES_GrpRpr.DFC_ComMETE2Chksum_C "common MIL debouncing / group representative for common MIL debouncing of DFC_ComMETE2Chksum" VALUE 0x804F9F06 Val_Wu16 703.000000000 DFC_Verb 0.00 703.000000000 FORMAT "%13.9" /end CHARACTERISTIC
/begin CHARACTERISTIC DFES_GrpRpr.DFC_ComMETE2RingCnt_C "common MIL debouncing / group representative for common MIL debouncing of DFC_ComMETE2RingCnt" VALUE 0x804F9F08 Val_Wu16 703.000000000 DFC_Verb 0.00 703.000000000 FORMAT "%13.9" /end CHARACTERISTIC
/begin CHARACTERISTIC DFES_GrpRpr.DFC_ComMETE2TOut_C "common MIL debouncing / group representative for common MIL debouncing of DFC_ComMETE2TOut" VALUE 0x804F9F0A Val_Wu16 703.000000000 DFC_Verb 0.00 703.000000000 FORMAT "%13.9" /end CHARACTERISTIC
/begin CHARACTERISTIC DFES_GrpRpr.DFC_ComMETFChksum_C "common MIL debouncing / group representative for common MIL debouncing of DFC_ComMETFChksum" VALUE 0x804F9F0C Val_Wu16 703.000000000 DFC_Verb 0.00 703.000000000 FORMAT "%13.9" /end CHARACTERISTIC
/begin CHARACTERISTIC DFES_GrpRpr.DFC_ComMETFRingCnt_C "common MIL debouncing / group representative for common MIL debouncing of DFC_ComMETFRingCnt" VALUE 0x804F9F0E Val_Wu16 703.000000000 DFC_Verb 0.00 703.000000000 FORMAT "%13.9" /end CHARACTERISTIC
/begin CHARACTERISTIC DFES_GrpRpr.DFC_ComMETFTOut_C "common MIL debouncing / group representative for common MIL debouncing of DFC_ComMETFTOut" VALUE 0x804F9F10 Val_Wu16 703.000000000 DFC_Verb 0.00 703.000000000 FORMAT "%13.9" /end CHARACTERISTIC
/begin CHARACTERISTIC DFES_GrpRpr.DFC_ComMETGChksum_C "common MIL debouncing / group representative for common MIL debouncing of DFC_ComMETGChksum" VALUE 0x804F9F12 Val_Wu16 703.000000000 DFC_Verb 0.00 703.000000000 FORMAT "%13.9" /end CHARACTERISTIC
/begin CHARACTERISTIC DFES_GrpRpr.DFC_ComMETGRingCnt_C "common MIL debouncing / group representative for common MIL debouncing of DFC_ComMETGRingCnt" VALUE 0x804F9F14 Val_Wu16 703.000000000 DFC_Verb 0.00 703.000000000 FORMAT "%13.9" /end CHARACTERISTIC
/begin CHARACTERISTIC DFES_GrpRpr.DFC_ComMETGTOut_C "common MIL debouncing / group representative for common MIL debouncing of DFC_ComMETGTOut" VALUE 0x804F9F16 Val_Wu16 703.000000000 DFC_Verb 0.00 703.000000000 FORMAT "%13.9" /end CHARACTERISTIC
/begin CHARACTERISTIC DFES_GrpRpr.DFC_ComMETH2Chksum_C "common MIL debouncing / group representative for common MIL debouncing of DFC_ComMETH2Chksum" VALUE 0x804F9F18 Val_Wu16 703.000000000 DFC_Verb 0.00 703.000000000 FORMAT "%13.9" /end CHARACTERISTIC
/begin CHARACTERISTIC DFES_GrpRpr.DFC_ComMETH2RingCnt_C "common MIL debouncing / group representative for common MIL debouncing of DFC_ComMETH2RingCnt" VALUE 0x804F9F1A Val_Wu16 703.000000000 DFC_Verb 0.00 703.000000000 FORMAT "%13.9" /end CHARACTERISTIC
/begin CHARACTERISTIC DFES_GrpRpr.DFC_ComMETH2TOut_C "common MIL debouncing / group representative for common MIL debouncing of DFC_ComMETH2TOut" VALUE 0x804F9F1C Val_Wu16 703.000000000 DFC_Verb 0.00 703.000000000 FORMAT "%13.9" /end CHARACTERISTIC
/begin CHARACTERISTIC DFES_GrpRpr.DFC_ComMETHChksum_C "common MIL debouncing / group representative for common MIL debouncing of DFC_ComMETHChksum" VALUE 0x804F9F1E Val_Wu16 703.000000000 DFC_Verb 0.00 703.000000000 FORMAT "%13.9" /end CHARACTERISTIC
/begin CHARACTERISTIC DFES_GrpRpr.DFC_ComMETHRingCnt_C "common MIL debouncing / group representative for common MIL debouncing of DFC_ComMETHRingCnt" VALUE 0x804F9F20 Val_Wu16 703.000000000 DFC_Verb 0.00 703.000000000 FORMAT "%13.9" /end CHARACTERISTIC
/begin CHARACTERISTIC DFES_GrpRpr.DFC_ComMETHTOut_C "common MIL debouncing / group representative for common MIL debouncing of DFC_ComMETHTOut" VALUE 0x804F9F22 Val_Wu16 703.000000000 DFC_Verb 0.00 703.000000000 FORMAT "%13.9" /end CHARACTERISTIC
/begin CHARACTERISTIC DFES_GrpRpr.DFC_ComMETIChksum_C "common MIL debouncing / group representative for common MIL debouncing of DFC_ComMETIChksum" VALUE 0x804F9F24 Val_Wu16 703.000000000 DFC_Verb 0.00 703.000000000 FORMAT "%13.9" /end CHARACTERISTIC
/begin CHARACTERISTIC DFES_GrpRpr.DFC_ComMETIRingCnt_C "common MIL debouncing / group representative for common MIL debouncing of DFC_ComMETIRingCnt" VALUE 0x804F9F26 Val_Wu16 703.000000000 DFC_Verb 0.00 703.000000000 FORMAT "%13.9" /end CHARACTERISTIC
/begin CHARACTERISTIC DFES_GrpRpr.DFC_ComMETITOut_C "common MIL debouncing / group representative for common MIL debouncing of DFC_ComMETITOut" VALUE 0x804F9F28 Val_Wu16 703.000000000 DFC_Verb 0.00 703.000000000 FORMAT "%13.9" /end CHARACTERISTIC
/begin CHARACTERISTIC DFES_GrpRpr.DFC_ComMETKChksum_C "common MIL debouncing / group representative for common MIL debouncing of DFC_ComMETKChksum" VALUE 0x804F9F2A Val_Wu16 703.000000000 DFC_Verb 0.00 703.000000000 FORMAT "%13.9" /end CHARACTERISTIC
/begin CHARACTERISTIC DFES_GrpRpr.DFC_ComMETKRingCnt_C "common MIL debouncing / group representative for common MIL debouncing of DFC_ComMETKRingCnt" VALUE 0x804F9F2C Val_Wu16 703.000000000 DFC_Verb 0.00 703.000000000 FORMAT "%13.9" /end CHARACTERISTIC
/begin CHARACTERISTIC DFES_GrpRpr.DFC_ComMETKTOut_C "common MIL debouncing / group representative for common MIL debouncing of DFC_ComMETKTOut" VALUE 0x804F9F2E Val_Wu16 703.000000000 DFC_Verb 0.00 703.000000000 FORMAT "%13.9" /end CHARACTERISTIC
/begin CHARACTERISTIC DFES_GrpRpr.DFC_ComMETLChksum_C "common MIL debouncing / group representative for common MIL debouncing of DFC_ComMETLChksum" VALUE 0x804F9F30 Val_Wu16 703.000000000 DFC_Verb 0.00 703.000000000 FORMAT "%13.9" /end CHARACTERISTIC
/begin CHARACTERISTIC DFES_GrpRpr.DFC_ComMETLRingCnt_C "common MIL debouncing / group representative for common MIL debouncing of DFC_ComMETLRingCnt" VALUE 0x804F9F32 Val_Wu16 703.000000000 DFC_Verb 0.00 703.000000000 FORMAT "%13.9" /end CHARACTERISTIC
/begin CHARACTERISTIC DFES_GrpRpr.DFC_ComMETLTOut_C "common MIL debouncing / group representative for common MIL debouncing of DFC_ComMETLTOut" VALUE 0x804F9F34 Val_Wu16 703.000000000 DFC_Verb 0.00 703.000000000 FORMAT "%13.9" /end CHARACTERISTIC
/begin CHARACTERISTIC DFES_GrpRpr.DFC_ComMETMChksum_C "common MIL debouncing / group representative for common MIL debouncing of DFC_ComMETMChksum" VALUE 0x804F9F36 Val_Wu16 703.000000000 DFC_Verb 0.00 703.000000000 FORMAT "%13.9" /end CHARACTERISTIC
/begin CHARACTERISTIC DFES_GrpRpr.DFC_ComMETMRingCnt_C "common MIL debouncing / group representative for common MIL debouncing of DFC_ComMETMRingCnt" VALUE 0x804F9F38 Val_Wu16 703.000000000 DFC_Verb 0.00 703.000000000 FORMAT "%13.9" /end CHARACTERISTIC
/begin CHARACTERISTIC DFES_GrpRpr.DFC_ComMETMTOut_C "common MIL debouncing / group representative for common MIL debouncing of DFC_ComMETMTOut" VALUE 0x804F9F3A Val_Wu16 703.000000000 DFC_Verb 0.00 703.000000000 FORMAT "%13.9" /end CHARACTERISTIC
/begin CHARACTERISTIC DFES_GrpRpr.DFC_ComMETNChksum_C "common MIL debouncing / group representative for common MIL debouncing of DFC_ComMETNChksum" VALUE 0x804F9F3C Val_Wu16 703.000000000 DFC_Verb 0.00 703.000000000 FORMAT "%13.9" /end CHARACTERISTIC
/begin CHARACTERISTIC DFES_GrpRpr.DFC_ComMETNRingCnt_C "common MIL debouncing / group representative for common MIL debouncing of DFC_ComMETNRingCnt" VALUE 0x804F9F3E Val_Wu16 703.000000000 DFC_Verb 0.00 703.000000000 FORMAT "%13.9" /end CHARACTERISTIC
/begin CHARACTERISTIC DFES_GrpRpr.DFC_ComMETNTOut_C "common MIL debouncing / group representative for common MIL debouncing of DFC_ComMETNTOut" VALUE 0x804F9F40 Val_Wu16 703.000000000 DFC_Verb 0.00 703.000000000 FORMAT "%13.9" /end CHARACTERISTIC
/begin CHARACTERISTIC DFES_GrpRpr.DFC_ComMtrCom_C "common MIL debouncing / group representative for common MIL debouncing of DFC_ComMtrCom" VALUE 0x804F9F42 Val_Wu16 703.000000000 DFC_Verb 0.00 703.000000000 FORMAT "%13.9" /end CHARACTERISTIC
/begin CHARACTERISTIC DFES_GrpRpr.DFC_ComPCUChkSum_C "common MIL debouncing / group representative for common MIL debouncing of DFC_ComPCUChkSum" VALUE 0x804F9F44 Val_Wu16 703.000000000 DFC_Verb 0.00 703.000000000 FORMAT "%13.9" /end CHARACTERISTIC
/begin CHARACTERISTIC DFES_GrpRpr.DFC_ComPCURingCnt_C "common MIL debouncing / group representative for common MIL debouncing of DFC_ComPCURingCnt" VALUE 0x804F9F46 Val_Wu16 703.000000000 DFC_Verb 0.00 703.000000000 FORMAT "%13.9" /end CHARACTERISTIC
/begin CHARACTERISTIC DFES_GrpRpr.DFC_ComPCUTOut_C "common MIL debouncing / group representative for common MIL debouncing of DFC_ComPCUTOut" VALUE 0x804F9F48 Val_Wu16 703.000000000 DFC_Verb 0.00 703.000000000 FORMAT "%13.9" /end CHARACTERISTIC
/begin CHARACTERISTIC DFES_GrpRpr.DFC_ComSRSAChksum_C "common MIL debouncing / group representative for common MIL debouncing of DFC_ComSRSAChksum" VALUE 0x804F9F4A Val_Wu16 703.000000000 DFC_Verb 0.00 703.000000000 FORMAT "%13.9" /end CHARACTERISTIC
/begin CHARACTERISTIC DFES_GrpRpr.DFC_ComSRSARingCnt_C "common MIL debouncing / group representative for common MIL debouncing of DFC_ComSRSARingCnt" VALUE 0x804F9F4C Val_Wu16 703.000000000 DFC_Verb 0.00 703.000000000 FORMAT "%13.9" /end CHARACTERISTIC
/begin CHARACTERISTIC DFES_GrpRpr.DFC_ComSRSATOut_C "common MIL debouncing / group representative for common MIL debouncing of DFC_ComSRSATOut" VALUE 0x804F9F4E Val_Wu16 703.000000000 DFC_Verb 0.00 703.000000000 FORMAT "%13.9" /end CHARACTERISTIC
/begin CHARACTERISTIC DFES_GrpRpr.DFC_ComSRSBChksum_C "common MIL debouncing / group representative for common MIL debouncing of DFC_ComSRSBChksum" VALUE 0x804F9F50 Val_Wu16 703.000000000 DFC_Verb 0.00 703.000000000 FORMAT "%13.9" /end CHARACTERISTIC
/begin CHARACTERISTIC DFES_GrpRpr.DFC_ComSRSBRingCnt_C "common MIL debouncing / group representative for common MIL debouncing of DFC_ComSRSBRingCnt" VALUE 0x804F9F52 Val_Wu16 703.000000000 DFC_Verb 0.00 703.000000000 FORMAT "%13.9" /end CHARACTERISTIC
/begin CHARACTERISTIC DFES_GrpRpr.DFC_ComSRSBTOut_C "common MIL debouncing / group representative for common MIL debouncing of DFC_ComSRSBTOut" VALUE 0x804F9F54 Val_Wu16 703.000000000 DFC_Verb 0.00 703.000000000 FORMAT "%13.9" /end CHARACTERISTIC
/begin CHARACTERISTIC DFES_GrpRpr.DFC_ComSRSChksum_C "common MIL debouncing / group representative for common MIL debouncing of DFC_ComSRSChksum" VALUE 0x804F9F56 Val_Wu16 703.000000000 DFC_Verb 0.00 703.000000000 FORMAT "%13.9" /end CHARACTERISTIC
/begin CHARACTERISTIC DFES_GrpRpr.DFC_ComSRSErr_C "common MIL debouncing / group representative for common MIL debouncing of DFC_ComSRSErr" VALUE 0x804F9F58 Val_Wu16 703.000000000 DFC_Verb 0.00 703.000000000 FORMAT "%13.9" /end CHARACTERISTIC
/begin CHARACTERISTIC DFES_GrpRpr.DFC_ComSRSRingCnt_C "common MIL debouncing / group representative for common MIL debouncing of DFC_ComSRSRingCnt" VALUE 0x804F9F5A Val_Wu16 703.000000000 DFC_Verb 0.00 703.000000000 FORMAT "%13.9" /end CHARACTERISTIC
/begin CHARACTERISTIC DFES_GrpRpr.DFC_ComSRSTOut_C "common MIL debouncing / group representative for common MIL debouncing of DFC_ComSRSTOut" VALUE 0x804F9F5C Val_Wu16 703.000000000 DFC_Verb 0.00 703.000000000 FORMAT "%13.9" /end CHARACTERISTIC
/begin CHARACTERISTIC DFES_GrpRpr.DFC_ComVehSpdPndFltTCU_C "common MIL debouncing / group representative for common MIL debouncing of DFC_ComVehSpdPndFltTCU" VALUE 0x804F9F5E Val_Wu16 703.000000000 DFC_Verb 0.00 703.000000000 FORMAT "%13.9" /end CHARACTERISTIC
/begin CHARACTERISTIC DFES_GrpRpr.DFC_EbsChartcCurrErr_C "common MIL debouncing / group representative for common MIL debouncing of DFC_EbsChartcCurrErr" VALUE 0x804F9F60 Val_Wu16 703.000000000 DFC_Verb 0.00 703.000000000 FORMAT "%13.9" /end CHARACTERISTIC
/begin CHARACTERISTIC DFES_GrpRpr.DFC_EbsSelfDiagErr_C "common MIL debouncing / group representative for common MIL debouncing of DFC_EbsSelfDiagErr" VALUE 0x804F9F62 Val_Wu16 703.000000000 DFC_Verb 0.00 703.000000000 FORMAT "%13.9" /end CHARACTERISTIC
/begin CHARACTERISTIC DFES_GrpRpr.DFC_GbxCANDigPlausErr_C "common MIL debouncing / group representative for common MIL debouncing of DFC_GbxCANDigPlausErr" VALUE 0x804F9F64 Val_Wu16 703.000000000 DFC_Verb 0.00 703.000000000 FORMAT "%13.9" /end CHARACTERISTIC
/begin CHARACTERISTIC DFES_GrpRpr.DFC_GbxNPos1SRCMax_C "common MIL debouncing / group representative for common MIL debouncing of DFC_GbxNPos1SRCMax" VALUE 0x804F9F66 Val_Wu16 703.000000000 DFC_Verb 0.00 703.000000000 FORMAT "%13.9" /end CHARACTERISTIC
/begin CHARACTERISTIC DFES_GrpRpr.DFC_GbxNPos1SRCMin_C "common MIL debouncing / group representative for common MIL debouncing of DFC_GbxNPos1SRCMin" VALUE 0x804F9F68 Val_Wu16 703.000000000 DFC_Verb 0.00 703.000000000 FORMAT "%13.9" /end CHARACTERISTIC
/begin CHARACTERISTIC DFES_GrpRpr.DFC_GbxNPos2SRCMax_C "common MIL debouncing / group representative for common MIL debouncing of DFC_GbxNPos2SRCMax" VALUE 0x804F9F6A Val_Wu16 703.000000000 DFC_Verb 0.00 703.000000000 FORMAT "%13.9" /end CHARACTERISTIC
/begin CHARACTERISTIC DFES_GrpRpr.DFC_GbxNPos2SRCMin_C "common MIL debouncing / group representative for common MIL debouncing of DFC_GbxNPos2SRCMin" VALUE 0x804F9F6C Val_Wu16 703.000000000 DFC_Verb 0.00 703.000000000 FORMAT "%13.9" /end CHARACTERISTIC
/begin CHARACTERISTIC DFES_GrpRpr.DFC_GbxNPosAlvChk_C "common MIL debouncing / group representative for common MIL debouncing of DFC_GbxNPosAlvChk" VALUE 0x804F9F6E Val_Wu16 703.000000000 DFC_Verb 0.00 703.000000000 FORMAT "%13.9" /end CHARACTERISTIC
/begin CHARACTERISTIC DFES_GrpRpr.DFC_GbxNPosSyncErr_C "common MIL debouncing / group representative for common MIL debouncing of DFC_GbxNPosSyncErr" VALUE 0x804F9F70 Val_Wu16 703.000000000 DFC_Verb 0.00 703.000000000 FORMAT "%13.9" /end CHARACTERISTIC
/begin CHARACTERISTIC DFES_GrpRpr.DFC_HEGOS2B1HtrPsMax_C "common MIL debouncing / group representative for common MIL debouncing of DFC_HEGOS2B1HtrPsMax" VALUE 0x804F9F72 Val_Wu16 703.000000000 DFC_Verb 0.00 703.000000000 FORMAT "%13.9" /end CHARACTERISTIC
/begin CHARACTERISTIC DFES_GrpRpr.DFC_HEGOS2B1HtrPsMin_C "common MIL debouncing / group representative for common MIL debouncing of DFC_HEGOS2B1HtrPsMin" VALUE 0x804F9F74 Val_Wu16 703.000000000 DFC_Verb 0.00 703.000000000 FORMAT "%13.9" /end CHARACTERISTIC
/begin CHARACTERISTIC DFES_GrpRpr.DFC_HEGOS2B1HtrPsSig_C "common MIL debouncing / group representative for common MIL debouncing of DFC_HEGOS2B1HtrPsSig" VALUE 0x804F9F76 Val_Wu16 703.000000000 DFC_Verb 0.00 703.000000000 FORMAT "%13.9" /end CHARACTERISTIC
/begin CHARACTERISTIC DFES_GrpRpr.DFC_LinCSErrACG_C "common MIL debouncing / group representative for common MIL debouncing of DFC_LinCSErrACG" VALUE 0x804F9F78 Val_Wu16 703.000000000 DFC_Verb 0.00 703.000000000 FORMAT "%13.9" /end CHARACTERISTIC
/begin CHARACTERISTIC DFES_GrpRpr.DFC_LinCSErrEBS_C "common MIL debouncing / group representative for common MIL debouncing of DFC_LinCSErrEBS" VALUE 0x804F9F7A Val_Wu16 703.000000000 DFC_Verb 0.00 703.000000000 FORMAT "%13.9" /end CHARACTERISTIC
/begin CHARACTERISTIC DFES_GrpRpr.DFC_LinHdrTimeoutErrACG_C "common MIL debouncing / group representative for common MIL debouncing of DFC_LinHdrTimeoutErrACG" VALUE 0x804F9F7C Val_Wu16 703.000000000 DFC_Verb 0.00 703.000000000 FORMAT "%13.9" /end CHARACTERISTIC
/begin CHARACTERISTIC DFES_GrpRpr.DFC_LinHdrTimeoutErrEBS_C "common MIL debouncing / group representative for common MIL debouncing of DFC_LinHdrTimeoutErrEBS" VALUE 0x804F9F7E Val_Wu16 703.000000000 DFC_Verb 0.00 703.000000000 FORMAT "%13.9" /end CHARACTERISTIC
/begin CHARACTERISTIC DFES_GrpRpr.DFC_LinMsgTimeoutErrACG_C "common MIL debouncing / group representative for common MIL debouncing of DFC_LinMsgTimeoutErrACG" VALUE 0x804F9F80 Val_Wu16 703.000000000 DFC_Verb 0.00 703.000000000 FORMAT "%13.9" /end CHARACTERISTIC
/begin CHARACTERISTIC DFES_GrpRpr.DFC_LinMsgTimeoutErrEBS_C "common MIL debouncing / group representative for common MIL debouncing of DFC_LinMsgTimeoutErrEBS" VALUE 0x804F9F82 Val_Wu16 703.000000000 DFC_Verb 0.00 703.000000000 FORMAT "%13.9" /end CHARACTERISTIC
/begin CHARACTERISTIC DFES_GrpRpr.DFC_LinNoStrtComErr_C "common MIL debouncing / group representative for common MIL debouncing of DFC_LinNoStrtComErr" VALUE 0x804F9F84 Val_Wu16 703.000000000 DFC_Verb 0.00 703.000000000 FORMAT "%13.9" /end CHARACTERISTIC
/begin CHARACTERISTIC DFES_GrpRpr.DFC_MisfDetVWhlFrntLeOORHi_C "common MIL debouncing / group representative for common MIL debouncing of DFC_MisfDetVWhlFrntLeOORHi" VALUE 0x804F9F86 Val_Wu16 703.000000000 DFC_Verb 0.00 703.000000000 FORMAT "%13.9" /end CHARACTERISTIC
/begin CHARACTERISTIC DFES_GrpRpr.DFC_MisfDetVWhlFrntLeRatyHi_C "common MIL debouncing / group representative for common MIL debouncing of DFC_MisfDetVWhlFrntLeRatyHi" VALUE 0x804F9F88 Val_Wu16 703.000000000 DFC_Verb 0.00 703.000000000 FORMAT "%13.9" /end CHARACTERISTIC
/begin CHARACTERISTIC DFES_GrpRpr.DFC_MisfDetVWhlFrntLeRatyLo_C "common MIL debouncing / group representative for common MIL debouncing of DFC_MisfDetVWhlFrntLeRatyLo" VALUE 0x804F9F8A Val_Wu16 703.000000000 DFC_Verb 0.00 703.000000000 FORMAT "%13.9" /end CHARACTERISTIC
/begin CHARACTERISTIC DFES_GrpRpr.DFC_MisfDetVWhlFrntLeStuck_C "common MIL debouncing / group representative for common MIL debouncing of DFC_MisfDetVWhlFrntLeStuck" VALUE 0x804F9F8C Val_Wu16 703.000000000 DFC_Verb 0.00 703.000000000 FORMAT "%13.9" /end CHARACTERISTIC
/begin CHARACTERISTIC DFES_GrpRpr.DFC_MisfDetVWhlFrntRiOORHi_C "common MIL debouncing / group representative for common MIL debouncing of DFC_MisfDetVWhlFrntRiOORHi" VALUE 0x804F9F8E Val_Wu16 703.000000000 DFC_Verb 0.00 703.000000000 FORMAT "%13.9" /end CHARACTERISTIC
/begin CHARACTERISTIC DFES_GrpRpr.DFC_MisfDetVWhlFrntRiRatyHi_C "common MIL debouncing / group representative for common MIL debouncing of DFC_MisfDetVWhlFrntRiRatyHi" VALUE 0x804F9F90 Val_Wu16 703.000000000 DFC_Verb 0.00 703.000000000 FORMAT "%13.9" /end CHARACTERISTIC
/begin CHARACTERISTIC DFES_GrpRpr.DFC_MisfDetVWhlFrntRiRatyLo_C "common MIL debouncing / group representative for common MIL debouncing of DFC_MisfDetVWhlFrntRiRatyLo" VALUE 0x804F9F92 Val_Wu16 703.000000000 DFC_Verb 0.00 703.000000000 FORMAT "%13.9" /end CHARACTERISTIC
/begin CHARACTERISTIC DFES_GrpRpr.DFC_MisfDetVWhlFrntRiStuck_C "common MIL debouncing / group representative for common MIL debouncing of DFC_MisfDetVWhlFrntRiStuck" VALUE 0x804F9F94 Val_Wu16 703.000000000 DFC_Verb 0.00 703.000000000 FORMAT "%13.9" /end CHARACTERISTIC
/begin CHARACTERISTIC DFES_GrpRpr.DFC_MisfDetVWhlReLeOORHi_C "common MIL debouncing / group representative for common MIL debouncing of DFC_MisfDetVWhlReLeOORHi" VALUE 0x804F9F96 Val_Wu16 703.000000000 DFC_Verb 0.00 703.000000000 FORMAT "%13.9" /end CHARACTERISTIC
/begin CHARACTERISTIC DFES_GrpRpr.DFC_MisfDetVWhlReLeRatyHi_C "common MIL debouncing / group representative for common MIL debouncing of DFC_MisfDetVWhlReLeRatyHi" VALUE 0x804F9F98 Val_Wu16 703.000000000 DFC_Verb 0.00 703.000000000 FORMAT "%13.9" /end CHARACTERISTIC
/begin CHARACTERISTIC DFES_GrpRpr.DFC_MisfDetVWhlReLeRatyLo_C "common MIL debouncing / group representative for common MIL debouncing of DFC_MisfDetVWhlReLeRatyLo" VALUE 0x804F9F9A Val_Wu16 703.000000000 DFC_Verb 0.00 703.000000000 FORMAT "%13.9" /end CHARACTERISTIC
/begin CHARACTERISTIC DFES_GrpRpr.DFC_MisfDetVWhlReLeStuck_C "common MIL debouncing / group representative for common MIL debouncing of DFC_MisfDetVWhlReLeStuck" VALUE 0x804F9F9C Val_Wu16 703.000000000 DFC_Verb 0.00 703.000000000 FORMAT "%13.9" /end CHARACTERISTIC
/begin CHARACTERISTIC DFES_GrpRpr.DFC_MisfDetVWhlReRiOORHi_C "common MIL debouncing / group representative for common MIL debouncing of DFC_MisfDetVWhlReRiOORHi" VALUE 0x804F9F9E Val_Wu16 703.000000000 DFC_Verb 0.00 703.000000000 FORMAT "%13.9" /end CHARACTERISTIC
/begin CHARACTERISTIC DFES_GrpRpr.DFC_MisfDetVWhlReRiRatyHi_C "common MIL debouncing / group representative for common MIL debouncing of DFC_MisfDetVWhlReRiRatyHi" VALUE 0x804F9FA0 Val_Wu16 703.000000000 DFC_Verb 0.00 703.000000000 FORMAT "%13.9" /end CHARACTERISTIC
/begin CHARACTERISTIC DFES_GrpRpr.DFC_MisfDetVWhlReRiRatyLo_C "common MIL debouncing / group representative for common MIL debouncing of DFC_MisfDetVWhlReRiRatyLo" VALUE 0x804F9FA2 Val_Wu16 703.000000000 DFC_Verb 0.00 703.000000000 FORMAT "%13.9" /end CHARACTERISTIC
/begin CHARACTERISTIC DFES_GrpRpr.DFC_MisfDetVWhlReRiStuck_C "common MIL debouncing / group representative for common MIL debouncing of DFC_MisfDetVWhlReRiStuck" VALUE 0x804F9FA4 Val_Wu16 703.000000000 DFC_Verb 0.00 703.000000000 FORMAT "%13.9" /end CHARACTERISTIC
/begin CHARACTERISTIC DFES_GrpRpr.DFC_MisfDetdVWhlFrntLePlaus_C "common MIL debouncing / group representative for common MIL debouncing of DFC_MisfDetdVWhlFrntLePlaus" VALUE 0x804F9FA6 Val_Wu16 703.000000000 DFC_Verb 0.00 703.000000000 FORMAT "%13.9" /end CHARACTERISTIC
/begin CHARACTERISTIC DFES_GrpRpr.DFC_MisfDetdVWhlFrntRiPlaus_C "common MIL debouncing / group representative for common MIL debouncing of DFC_MisfDetdVWhlFrntRiPlaus" VALUE 0x804F9FA8 Val_Wu16 703.000000000 DFC_Verb 0.00 703.000000000 FORMAT "%13.9" /end CHARACTERISTIC
/begin CHARACTERISTIC DFES_GrpRpr.DFC_MisfDetdVWhlReLePlaus_C "common MIL debouncing / group representative for common MIL debouncing of DFC_MisfDetdVWhlReLePlaus" VALUE 0x804F9FAA Val_Wu16 703.000000000 DFC_Verb 0.00 703.000000000 FORMAT "%13.9" /end CHARACTERISTIC
/begin CHARACTERISTIC DFES_GrpRpr.DFC_MisfDetdVWhlReRiPlaus_C "common MIL debouncing / group representative for common MIL debouncing of DFC_MisfDetdVWhlReRiPlaus" VALUE 0x804F9FAC Val_Wu16 703.000000000 DFC_Verb 0.00 703.000000000 FORMAT "%13.9" /end CHARACTERISTIC
/begin CHARACTERISTIC DFES_GrpRpr.DFC_PEnvSigRngMax_C "common MIL debouncing / group representative for common MIL debouncing of DFC_PEnvSigRngMax" VALUE 0x804F9FAE Val_Wu16 703.000000000 DFC_Verb 0.00 703.000000000 FORMAT "%13.9" /end CHARACTERISTIC
/begin CHARACTERISTIC DFES_GrpRpr.DFC_PEnvSigRngMin_C "common MIL debouncing / group representative for common MIL debouncing of DFC_PEnvSigRngMin" VALUE 0x804F9FB0 Val_Wu16 703.000000000 DFC_Verb 0.00 703.000000000 FORMAT "%13.9" /end CHARACTERISTIC
/begin CHARACTERISTIC DFES_GrpRpr.DFC_StmFault_C "common MIL debouncing / group representative for common MIL debouncing of DFC_StmFault" VALUE 0x804F9FB2 Val_Wu16 703.000000000 DFC_Verb 0.00 703.000000000 FORMAT "%13.9" /end CHARACTERISTIC
/begin CHARACTERISTIC DFES_GrpRpr.DFC_StrtCtOffPth_C "common MIL debouncing / group representative for common MIL debouncing of DFC_StrtCtOffPth" VALUE 0x804F9FB4 Val_Wu16 703.000000000 DFC_Verb 0.00 703.000000000 FORMAT "%13.9" /end CHARACTERISTIC
/begin CHARACTERISTIC DFES_GrpRpr.DFC_StrtCtlErr_C "common MIL debouncing / group representative for common MIL debouncing of DFC_StrtCtlErr" VALUE 0x804F9FB6 Val_Wu16 703.000000000 DFC_Verb 0.00 703.000000000 FORMAT "%13.9" /end CHARACTERISTIC
/begin CHARACTERISTIC DFES_GrpRpr.DFC_StrtFault_C "common MIL debouncing / group representative for common MIL debouncing of DFC_StrtFault" VALUE 0x804F9FB8 Val_Wu16 703.000000000 DFC_Verb 0.00 703.000000000 FORMAT "%13.9" /end CHARACTERISTIC
/begin CHARACTERISTIC DFES_GrpRpr.DFC_StrtLckJudg1_C "common MIL debouncing / group representative for common MIL debouncing of DFC_StrtLckJudg1" VALUE 0x804F9FBA Val_Wu16 703.000000000 DFC_Verb 0.00 703.000000000 FORMAT "%13.9" /end CHARACTERISTIC
/begin CHARACTERISTIC DFES_GrpRpr.DFC_StrtLckJudg2_C "common MIL debouncing / group representative for common MIL debouncing of DFC_StrtLckJudg2" VALUE 0x804F9FBC Val_Wu16 703.000000000 DFC_Verb 0.00 703.000000000 FORMAT "%13.9" /end CHARACTERISTIC
/begin CHARACTERISTIC DFES_GrpRpr.DFC_StrtOL_C "common MIL debouncing / group representative for common MIL debouncing of DFC_StrtOL" VALUE 0x804F9FBE Val_Wu16 703.000000000 DFC_Verb 0.00 703.000000000 FORMAT "%13.9" /end CHARACTERISTIC
/begin CHARACTERISTIC DFES_GrpRpr.DFC_StrtOL2_C "common MIL debouncing / group representative for common MIL debouncing of DFC_StrtOL2" VALUE 0x804F9FC0 Val_Wu16 703.000000000 DFC_Verb 0.00 703.000000000 FORMAT "%13.9" /end CHARACTERISTIC
/begin CHARACTERISTIC DFES_GrpRpr.DFC_StrtSCB_C "common MIL debouncing / group representative for common MIL debouncing of DFC_StrtSCB" VALUE 0x804F9FC2 Val_Wu16 703.000000000 DFC_Verb 0.00 703.000000000 FORMAT "%13.9" /end CHARACTERISTIC
/begin CHARACTERISTIC DFES_GrpRpr.DFC_StrtSCB2_C "common MIL debouncing / group representative for common MIL debouncing of DFC_StrtSCB2" VALUE 0x804F9FC4 Val_Wu16 703.000000000 DFC_Verb 0.00 703.000000000 FORMAT "%13.9" /end CHARACTERISTIC
/begin CHARACTERISTIC DFES_GrpRpr.DFC_StrtSCG_C "common MIL debouncing / group representative for common MIL debouncing of DFC_StrtSCG" VALUE 0x804F9FC6 Val_Wu16 703.000000000 DFC_Verb 0.00 703.000000000 FORMAT "%13.9" /end CHARACTERISTIC
/begin CHARACTERISTIC DFES_GrpRpr.DFC_StrtSCG2_C "common MIL debouncing / group representative for common MIL debouncing of DFC_StrtSCG2" VALUE 0x804F9FC8 Val_Wu16 703.000000000 DFC_Verb 0.00 703.000000000 FORMAT "%13.9" /end CHARACTERISTIC
/begin CHARACTERISTIC DFES_GrpRpr.DFC_StrtStkRly1_C "common MIL debouncing / group representative for common MIL debouncing of DFC_StrtStkRly1" VALUE 0x804F9FCA Val_Wu16 703.000000000 DFC_Verb 0.00 703.000000000 FORMAT "%13.9" /end CHARACTERISTIC
/begin CHARACTERISTIC DFES_GrpRpr.DFC_StrtStkRly2_C "common MIL debouncing / group representative for common MIL debouncing of DFC_StrtStkRly2" VALUE 0x804F9FCC Val_Wu16 703.000000000 DFC_Verb 0.00 703.000000000 FORMAT "%13.9" /end CHARACTERISTIC
/begin CHARACTERISTIC DFES_GrpRpr.DFC_TEVEmax_C "common MIL debouncing / group representative for common MIL debouncing of DFC_TEVEmax" VALUE 0x804F9FCE Val_Wu16 703.000000000 DFC_Verb 0.00 703.000000000 FORMAT "%13.9" /end CHARACTERISTIC
/begin CHARACTERISTIC DFES_GrpRpr.DFC_TEVEmin_C "common MIL debouncing / group representative for common MIL debouncing of DFC_TEVEmin" VALUE 0x804F9FD0 Val_Wu16 703.000000000 DFC_Verb 0.00 703.000000000 FORMAT "%13.9" /end CHARACTERISTIC
/begin CHARACTERISTIC DFES_GrpRpr.DFC_TEVEsig_C "common MIL debouncing / group representative for common MIL debouncing of DFC_TEVEsig" VALUE 0x804F9FD2 Val_Wu16 703.000000000 DFC_Verb 0.00 703.000000000 FORMAT "%13.9" /end CHARACTERISTIC
/begin CHARACTERISTIC DFES_GrpRpr.DFC_VehVAllPlaus_C "common MIL debouncing / group representative for common MIL debouncing of DFC_VehVAllPlaus" VALUE 0x804F9FD4 Val_Wu16 703.000000000 DFC_Verb 0.00 703.000000000 FORMAT "%13.9" /end CHARACTERISTIC
/begin CHARACTERISTIC DFES_GrpRpr.DFC_VehVNCSnsrElecFailr_C "common MIL debouncing / group representative for common MIL debouncing of DFC_VehVNCSnsrElecFailr" VALUE 0x804F9FD6 Val_Wu16 703.000000000 DFC_Verb 0.00 703.000000000 FORMAT "%13.9" /end CHARACTERISTIC
/begin CHARACTERISTIC DFES_GrpRpr.DFC_VehVPlausCan_C "common MIL debouncing / group representative for common MIL debouncing of DFC_VehVPlausCan" VALUE 0x804F9FD8 Val_Wu16 703.000000000 DFC_Verb 0.00 703.000000000 FORMAT "%13.9" /end CHARACTERISTIC
/begin CHARACTERISTIC DFES_GrpRpr.DFC_VehVPlausFco_C "common MIL debouncing / group representative for common MIL debouncing of DFC_VehVPlausFco" VALUE 0x804F9FDA Val_Wu16 703.000000000 DFC_Verb 0.00 703.000000000 FORMAT "%13.9" /end CHARACTERISTIC
/begin CHARACTERISTIC DFES_GrpRpr.DFC_VehVPlausPwr_C "common MIL debouncing / group representative for common MIL debouncing of DFC_VehVPlausPwr" VALUE 0x804F9FDC Val_Wu16 703.000000000 DFC_Verb 0.00 703.000000000 FORMAT "%13.9" /end CHARACTERISTIC
/begin CHARACTERISTIC DFES_GrpRpr.DFC_VehVPlausV2N_C "common MIL debouncing / group representative for common MIL debouncing of DFC_VehVPlausV2N" VALUE 0x804F9FDE Val_Wu16 703.000000000 DFC_Verb 0.00 703.000000000 FORMAT "%13.9" /end CHARACTERISTIC
/begin CHARACTERISTIC DFES_GrpRpr.DFC_VehVSpdSnsrAElecFailr_C "common MIL debouncing / group representative for common MIL debouncing of DFC_VehVSpdSnsrAElecFailr" VALUE 0x804F9FE0 Val_Wu16 703.000000000 DFC_Verb 0.00 703.000000000 FORMAT "%13.9" /end CHARACTERISTIC
/begin CHARACTERISTIC DFES_GrpRpr.DFC_VehVSpdSnsrBElecFailr_C "common MIL debouncing / group representative for common MIL debouncing of DFC_VehVSpdSnsrBElecFailr" VALUE 0x804F9FE2 Val_Wu16 703.000000000 DFC_Verb 0.00 703.000000000 FORMAT "%13.9" /end CHARACTERISTIC
/begin CHARACTERISTIC DFES_GrpRpr.DFC_ClthMax_C "common MIL debouncing / group representative for common MIL debouncing of DFC_ClthMax" VALUE 0x804F9FE4 Val_Wu16 703.000000000 DFC_Verb 0.00 703.000000000 FORMAT "%13.9" /end CHARACTERISTIC
/begin CHARACTERISTIC DFES_GrpRpr.DFC_IgnClPs_DevComErr_C "common MIL debouncing / group representative for common MIL debouncing of DFC_IgnClPs_DevComErr" VALUE 0x804F9FE6 Val_Wu16 703.000000000 DFC_Verb 0.00 703.000000000 FORMAT "%13.9" /end CHARACTERISTIC
/begin CHARACTERISTIC DFES_GrpRpr.DFC_IgnClPs_LineOl_0_C "common MIL debouncing / group representative for common MIL debouncing of DFC_IgnClPs_LineOl_0" VALUE 0x804F9FE8 Val_Wu16 703.000000000 DFC_Verb 0.00 703.000000000 FORMAT "%13.9" /end CHARACTERISTIC
/begin CHARACTERISTIC DFES_GrpRpr.DFC_IgnClPs_LineOl_1_C "common MIL debouncing / group representative for common MIL debouncing of DFC_IgnClPs_LineOl_1" VALUE 0x804F9FEA Val_Wu16 703.000000000 DFC_Verb 0.00 703.000000000 FORMAT "%13.9" /end CHARACTERISTIC
/begin CHARACTERISTIC DFES_GrpRpr.DFC_IgnClPs_LineOl_2_C "common MIL debouncing / group representative for common MIL debouncing of DFC_IgnClPs_LineOl_2" VALUE 0x804F9FEC Val_Wu16 703.000000000 DFC_Verb 0.00 703.000000000 FORMAT "%13.9" /end CHARACTERISTIC
/begin CHARACTERISTIC DFES_GrpRpr.DFC_IgnClPs_LineOl_3_C "common MIL debouncing / group representative for common MIL debouncing of DFC_IgnClPs_LineOl_3" VALUE 0x804F9FEE Val_Wu16 703.000000000 DFC_Verb 0.00 703.000000000 FORMAT "%13.9" /end CHARACTERISTIC
/begin CHARACTERISTIC DFES_GrpRpr.DFC_IgnClPs_LineScb_0_C "common MIL debouncing / group representative for common MIL debouncing of DFC_IgnClPs_LineScb_0" VALUE 0x804F9FF0 Val_Wu16 703.000000000 DFC_Verb 0.00 703.000000000 FORMAT "%13.9" /end CHARACTERISTIC
/begin CHARACTERISTIC DFES_GrpRpr.DFC_IgnClPs_LineScb_1_C "common MIL debouncing / group representative for common MIL debouncing of DFC_IgnClPs_LineScb_1" VALUE 0x804F9FF2 Val_Wu16 703.000000000 DFC_Verb 0.00 703.000000000 FORMAT "%13.9" /end CHARACTERISTIC
/begin CHARACTERISTIC DFES_GrpRpr.DFC_IgnClPs_LineScb_2_C "common MIL debouncing / group representative for common MIL debouncing of DFC_IgnClPs_LineScb_2" VALUE 0x804F9FF4 Val_Wu16 703.000000000 DFC_Verb 0.00 703.000000000 FORMAT "%13.9" /end CHARACTERISTIC
/begin CHARACTERISTIC DFES_GrpRpr.DFC_IgnClPs_LineScb_3_C "common MIL debouncing / group representative for common MIL debouncing of DFC_IgnClPs_LineScb_3" VALUE 0x804F9FF6 Val_Wu16 703.000000000 DFC_Verb 0.00 703.000000000 FORMAT "%13.9" /end CHARACTERISTIC
/begin CHARACTERISTIC DFES_GrpRpr.DFC_IgnClPs_LineScg_0_C "common MIL debouncing / group representative for common MIL debouncing of DFC_IgnClPs_LineScg_0" VALUE 0x804F9FF8 Val_Wu16 703.000000000 DFC_Verb 0.00 703.000000000 FORMAT "%13.9" /end CHARACTERISTIC
/begin CHARACTERISTIC DFES_GrpRpr.DFC_IgnClPs_LineScg_1_C "common MIL debouncing / group representative for common MIL debouncing of DFC_IgnClPs_LineScg_1" VALUE 0x804F9FFA Val_Wu16 703.000000000 DFC_Verb 0.00 703.000000000 FORMAT "%13.9" /end CHARACTERISTIC
/begin CHARACTERISTIC DFES_GrpRpr.DFC_IgnClPs_LineScg_2_C "common MIL debouncing / group representative for common MIL debouncing of DFC_IgnClPs_LineScg_2" VALUE 0x804F9FFC Val_Wu16 703.000000000 DFC_Verb 0.00 703.000000000 FORMAT "%13.9" /end CHARACTERISTIC
/begin CHARACTERISTIC DFES_GrpRpr.DFC_IgnClPs_LineScg_3_C "common MIL debouncing / group representative for common MIL debouncing of DFC_IgnClPs_LineScg_3" VALUE 0x804F9FFE Val_Wu16 703.000000000 DFC_Verb 0.00 703.000000000 FORMAT "%13.9" /end CHARACTERISTIC
/begin CHARACTERISTIC DFES_GrpRpr.DFC_UEGOASICS1B1_C "common MIL debouncing / group representative for common MIL debouncing of DFC_UEGOASICS1B1" VALUE 0x804FA000 Val_Wu16 703.000000000 DFC_Verb 0.00 703.000000000 FORMAT "%13.9" /end CHARACTERISTIC
/begin CHARACTERISTIC DFES_GrpRpr.DFC_UEGOOLIPES1B1_C "common MIL debouncing / group representative for common MIL debouncing of DFC_UEGOOLIPES1B1" VALUE 0x804FA002 Val_Wu16 703.000000000 DFC_Verb 0.00 703.000000000 FORMAT "%13.9" /end CHARACTERISTIC
/begin CHARACTERISTIC DFES_GrpRpr.DFC_UEGOOLRES1B1_C "common MIL debouncing / group representative for common MIL debouncing of DFC_UEGOOLRES1B1" VALUE 0x804FA004 Val_Wu16 703.000000000 DFC_Verb 0.00 703.000000000 FORMAT "%13.9" /end CHARACTERISTIC
/begin CHARACTERISTIC DFES_GrpRpr.DFC_UEGOSCBS1B1_C "common MIL debouncing / group representative for common MIL debouncing of DFC_UEGOSCBS1B1" VALUE 0x804FA006 Val_Wu16 703.000000000 DFC_Verb 0.00 703.000000000 FORMAT "%13.9" /end CHARACTERISTIC
/begin CHARACTERISTIC DFES_GrpRpr.DFC_UEGOSCGS1B1_C "common MIL debouncing / group representative for common MIL debouncing of DFC_UEGOSCGS1B1" VALUE 0x804FA008 Val_Wu16 703.000000000 DFC_Verb 0.00 703.000000000 FORMAT "%13.9" /end CHARACTERISTIC
/begin CHARACTERISTIC DFES_GrpRpr.DFC_UEGOSPIS1B1_C "common MIL debouncing / group representative for common MIL debouncing of DFC_UEGOSPIS1B1" VALUE 0x804FA00A Val_Wu16 703.000000000 DFC_Verb 0.00 703.000000000 FORMAT "%13.9" /end CHARACTERISTIC
/begin CHARACTERISTIC DFES_GrpRpr.DFC_UEGOSnsrS1B1_C "common MIL debouncing / group representative for common MIL debouncing of DFC_UEGOSnsrS1B1" VALUE 0x804FA00C Val_Wu16 703.000000000 DFC_Verb 0.00 703.000000000 FORMAT "%13.9" /end CHARACTERISTIC
/begin CHARACTERISTIC DFES_GrpRpr.DFC_UegoOlApesS1B1_C "common MIL debouncing / group representative for common MIL debouncing of DFC_UegoOlApesS1B1" VALUE 0x804FA00E Val_Wu16 703.000000000 DFC_Verb 0.00 703.000000000 FORMAT "%13.9" /end CHARACTERISTIC
/begin CHARACTERISTIC DFES_GrpRpr.DFC_UegoOlRCmpS1B1_C "common MIL debouncing / group representative for common MIL debouncing of DFC_UegoOlRCmpS1B1" VALUE 0x804FA010 Val_Wu16 703.000000000 DFC_Verb 0.00 703.000000000 FORMAT "%13.9" /end CHARACTERISTIC
/begin CHARACTERISTIC DFES_GrpRpr.DFC_AirCCmprOL_C "common MIL debouncing / group representative for common MIL debouncing of DFC_AirCCmprOL" VALUE 0x804FA012 Val_Wu16 703.000000000 DFC_Verb 0.00 703.000000000 FORMAT "%13.9" /end CHARACTERISTIC
/begin CHARACTERISTIC DFES_GrpRpr.DFC_AirCCmprOvrTemp_C "common MIL debouncing / group representative for common MIL debouncing of DFC_AirCCmprOvrTemp" VALUE 0x804FA014 Val_Wu16 703.000000000 DFC_Verb 0.00 703.000000000 FORMAT "%13.9" /end CHARACTERISTIC
/begin CHARACTERISTIC DFES_GrpRpr.DFC_AirCCmprSCB_C "common MIL debouncing / group representative for common MIL debouncing of DFC_AirCCmprSCB" VALUE 0x804FA016 Val_Wu16 703.000000000 DFC_Verb 0.00 703.000000000 FORMAT "%13.9" /end CHARACTERISTIC
/begin CHARACTERISTIC DFES_GrpRpr.DFC_AirCCmprSCG_C "common MIL debouncing / group representative for common MIL debouncing of DFC_AirCCmprSCG" VALUE 0x804FA018 Val_Wu16 703.000000000 DFC_Verb 0.00 703.000000000 FORMAT "%13.9" /end CHARACTERISTIC
/begin CHARACTERISTIC DFES_GrpRpr.DFC_AltErr_C "common MIL debouncing / group representative for common MIL debouncing of DFC_AltErr" VALUE 0x804FA01A Val_Wu16 703.000000000 DFC_Verb 0.00 703.000000000 FORMAT "%13.9" /end CHARACTERISTIC
/begin CHARACTERISTIC DFES_GrpRpr.DFC_BattUSRCMax_C "common MIL debouncing / group representative for common MIL debouncing of DFC_BattUSRCMax" VALUE 0x804FA01C Val_Wu16 703.000000000 DFC_Verb 0.00 703.000000000 FORMAT "%13.9" /end CHARACTERISTIC
/begin CHARACTERISTIC DFES_GrpRpr.DFC_BattUSRCMin_C "common MIL debouncing / group representative for common MIL debouncing of DFC_BattUSRCMin" VALUE 0x804FA01E Val_Wu16 703.000000000 DFC_Verb 0.00 703.000000000 FORMAT "%13.9" /end CHARACTERISTIC
/begin CHARACTERISTIC DFES_GrpRpr.DFC_ComChksTCU1_C "common MIL debouncing / group representative for common MIL debouncing of DFC_ComChksTCU1" VALUE 0x804FA020 Val_Wu16 703.000000000 DFC_Verb 0.00 703.000000000 FORMAT "%13.9" /end CHARACTERISTIC
/begin CHARACTERISTIC DFES_GrpRpr.DFC_ComChksTCU11_C "common MIL debouncing / group representative for common MIL debouncing of DFC_ComChksTCU11" VALUE 0x804FA022 Val_Wu16 703.000000000 DFC_Verb 0.00 703.000000000 FORMAT "%13.9" /end CHARACTERISTIC
/begin CHARACTERISTIC DFES_GrpRpr.DFC_ComChksTCU12_C "common MIL debouncing / group representative for common MIL debouncing of DFC_ComChksTCU12" VALUE 0x804FA024 Val_Wu16 703.000000000 DFC_Verb 0.00 703.000000000 FORMAT "%13.9" /end CHARACTERISTIC
/begin CHARACTERISTIC DFES_GrpRpr.DFC_ComChksTCU13_C "common MIL debouncing / group representative for common MIL debouncing of DFC_ComChksTCU13" VALUE 0x804FA026 Val_Wu16 703.000000000 DFC_Verb 0.00 703.000000000 FORMAT "%13.9" /end CHARACTERISTIC
/begin CHARACTERISTIC DFES_GrpRpr.DFC_ComChksTCU2_C "common MIL debouncing / group representative for common MIL debouncing of DFC_ComChksTCU2" VALUE 0x804FA028 Val_Wu16 703.000000000 DFC_Verb 0.00 703.000000000 FORMAT "%13.9" /end CHARACTERISTIC
/begin CHARACTERISTIC DFES_GrpRpr.DFC_ComChksTCU3_C "common MIL debouncing / group representative for common MIL debouncing of DFC_ComChksTCU3" VALUE 0x804FA02A Val_Wu16 703.000000000 DFC_Verb 0.00 703.000000000 FORMAT "%13.9" /end CHARACTERISTIC
/begin CHARACTERISTIC DFES_GrpRpr.DFC_ComChksTCU4_C "common MIL debouncing / group representative for common MIL debouncing of DFC_ComChksTCU4" VALUE 0x804FA02C Val_Wu16 703.000000000 DFC_Verb 0.00 703.000000000 FORMAT "%13.9" /end CHARACTERISTIC
/begin CHARACTERISTIC DFES_GrpRpr.DFC_ComCntTCU1_C "common MIL debouncing / group representative for common MIL debouncing of DFC_ComCntTCU1" VALUE 0x804FA02E Val_Wu16 703.000000000 DFC_Verb 0.00 703.000000000 FORMAT "%13.9" /end CHARACTERISTIC
/begin CHARACTERISTIC DFES_GrpRpr.DFC_ComCntTCU11_C "common MIL debouncing / group representative for common MIL debouncing of DFC_ComCntTCU11" VALUE 0x804FA030 Val_Wu16 703.000000000 DFC_Verb 0.00 703.000000000 FORMAT "%13.9" /end CHARACTERISTIC
/begin CHARACTERISTIC DFES_GrpRpr.DFC_ComCntTCU12_C "common MIL debouncing / group representative for common MIL debouncing of DFC_ComCntTCU12" VALUE 0x804FA032 Val_Wu16 703.000000000 DFC_Verb 0.00 703.000000000 FORMAT "%13.9" /end CHARACTERISTIC
/begin CHARACTERISTIC DFES_GrpRpr.DFC_ComCntTCU13_C "common MIL debouncing / group representative for common MIL debouncing of DFC_ComCntTCU13" VALUE 0x804FA034 Val_Wu16 703.000000000 DFC_Verb 0.00 703.000000000 FORMAT "%13.9" /end CHARACTERISTIC
/begin CHARACTERISTIC DFES_GrpRpr.DFC_ComCntTCU2_C "common MIL debouncing / group representative for common MIL debouncing of DFC_ComCntTCU2" VALUE 0x804FA036 Val_Wu16 703.000000000 DFC_Verb 0.00 703.000000000 FORMAT "%13.9" /end CHARACTERISTIC
/begin CHARACTERISTIC DFES_GrpRpr.DFC_ComCntTCU3_C "common MIL debouncing / group representative for common MIL debouncing of DFC_ComCntTCU3" VALUE 0x804FA038 Val_Wu16 703.000000000 DFC_Verb 0.00 703.000000000 FORMAT "%13.9" /end CHARACTERISTIC
/begin CHARACTERISTIC DFES_GrpRpr.DFC_ComCntTCU4_C "common MIL debouncing / group representative for common MIL debouncing of DFC_ComCntTCU4" VALUE 0x804FA03A Val_Wu16 703.000000000 DFC_Verb 0.00 703.000000000 FORMAT "%13.9" /end CHARACTERISTIC
/begin CHARACTERISTIC DFES_GrpRpr.DFC_ComTOutTCU01_C "common MIL debouncing / group representative for common MIL debouncing of DFC_ComTOutTCU01" VALUE 0x804FA03C Val_Wu16 703.000000000 DFC_Verb 0.00 703.000000000 FORMAT "%13.9" /end CHARACTERISTIC
/begin CHARACTERISTIC DFES_GrpRpr.DFC_ComTOutTCU02_C "common MIL debouncing / group representative for common MIL debouncing of DFC_ComTOutTCU02" VALUE 0x804FA03E Val_Wu16 703.000000000 DFC_Verb 0.00 703.000000000 FORMAT "%13.9" /end CHARACTERISTIC
/begin CHARACTERISTIC DFES_GrpRpr.DFC_ComTOutTCU1_C "common MIL debouncing / group representative for common MIL debouncing of DFC_ComTOutTCU1" VALUE 0x804FA040 Val_Wu16 703.000000000 DFC_Verb 0.00 703.000000000 FORMAT "%13.9" /end CHARACTERISTIC
/begin CHARACTERISTIC DFES_GrpRpr.DFC_ComTOutTCU11_C "common MIL debouncing / group representative for common MIL debouncing of DFC_ComTOutTCU11" VALUE 0x804FA042 Val_Wu16 703.000000000 DFC_Verb 0.00 703.000000000 FORMAT "%13.9" /end CHARACTERISTIC
/begin CHARACTERISTIC DFES_GrpRpr.DFC_ComTOutTCU12_C "common MIL debouncing / group representative for common MIL debouncing of DFC_ComTOutTCU12" VALUE 0x804FA044 Val_Wu16 703.000000000 DFC_Verb 0.00 703.000000000 FORMAT "%13.9" /end CHARACTERISTIC
/begin CHARACTERISTIC DFES_GrpRpr.DFC_ComTOutTCU13_C "common MIL debouncing / group representative for common MIL debouncing of DFC_ComTOutTCU13" VALUE 0x804FA046 Val_Wu16 703.000000000 DFC_Verb 0.00 703.000000000 FORMAT "%13.9" /end CHARACTERISTIC
/begin CHARACTERISTIC DFES_GrpRpr.DFC_ComTOutTCU14_C "common MIL debouncing / group representative for common MIL debouncing of DFC_ComTOutTCU14" VALUE 0x804FA048 Val_Wu16 703.000000000 DFC_Verb 0.00 703.000000000 FORMAT "%13.9" /end CHARACTERISTIC
/begin CHARACTERISTIC DFES_GrpRpr.DFC_ComTOutTCU2_C "common MIL debouncing / group representative for common MIL debouncing of DFC_ComTOutTCU2" VALUE 0x804FA04A Val_Wu16 703.000000000 DFC_Verb 0.00 703.000000000 FORMAT "%13.9" /end CHARACTERISTIC
/begin CHARACTERISTIC DFES_GrpRpr.DFC_ComTOutTCU3_C "common MIL debouncing / group representative for common MIL debouncing of DFC_ComTOutTCU3" VALUE 0x804FA04C Val_Wu16 703.000000000 DFC_Verb 0.00 703.000000000 FORMAT "%13.9" /end CHARACTERISTIC
/begin CHARACTERISTIC DFES_GrpRpr.DFC_ComTOutTCU4_C "common MIL debouncing / group representative for common MIL debouncing of DFC_ComTOutTCU4" VALUE 0x804FA04E Val_Wu16 703.000000000 DFC_Verb 0.00 703.000000000 FORMAT "%13.9" /end CHARACTERISTIC
/begin CHARACTERISTIC DFES_GrpRpr.DFC_DevLibBattUHi_C "common MIL debouncing / group representative for common MIL debouncing of DFC_DevLibBattUHi" VALUE 0x804FA050 Val_Wu16 703.000000000 DFC_Verb 0.00 703.000000000 FORMAT "%13.9" /end CHARACTERISTIC
/begin CHARACTERISTIC DFES_GrpRpr.DFC_DevLibBattULo_C "common MIL debouncing / group representative for common MIL debouncing of DFC_DevLibBattULo" VALUE 0x804FA052 Val_Wu16 703.000000000 DFC_Verb 0.00 703.000000000 FORMAT "%13.9" /end CHARACTERISTIC
/begin CHARACTERISTIC DFES_GrpRpr.DFC_FanDIOOL_0_C "common MIL debouncing / group representative for common MIL debouncing of DFC_FanDIOOL_0" VALUE 0x804FA054 Val_Wu16 703.000000000 DFC_Verb 0.00 703.000000000 FORMAT "%13.9" /end CHARACTERISTIC
/begin CHARACTERISTIC DFES_GrpRpr.DFC_FanDIOOL_1_C "common MIL debouncing / group representative for common MIL debouncing of DFC_FanDIOOL_1" VALUE 0x804FA056 Val_Wu16 703.000000000 DFC_Verb 0.00 703.000000000 FORMAT "%13.9" /end CHARACTERISTIC
/begin CHARACTERISTIC DFES_GrpRpr.DFC_FanDIOOvrTemp_0_C "common MIL debouncing / group representative for common MIL debouncing of DFC_FanDIOOvrTemp_0" VALUE 0x804FA058 Val_Wu16 703.000000000 DFC_Verb 0.00 703.000000000 FORMAT "%13.9" /end CHARACTERISTIC
/begin CHARACTERISTIC DFES_GrpRpr.DFC_FanDIOOvrTemp_1_C "common MIL debouncing / group representative for common MIL debouncing of DFC_FanDIOOvrTemp_1" VALUE 0x804FA05A Val_Wu16 703.000000000 DFC_Verb 0.00 703.000000000 FORMAT "%13.9" /end CHARACTERISTIC
/begin CHARACTERISTIC DFES_GrpRpr.DFC_FanDIOSCB_0_C "common MIL debouncing / group representative for common MIL debouncing of DFC_FanDIOSCB_0" VALUE 0x804FA05C Val_Wu16 703.000000000 DFC_Verb 0.00 703.000000000 FORMAT "%13.9" /end CHARACTERISTIC
/begin CHARACTERISTIC DFES_GrpRpr.DFC_FanDIOSCB_1_C "common MIL debouncing / group representative for common MIL debouncing of DFC_FanDIOSCB_1" VALUE 0x804FA05E Val_Wu16 703.000000000 DFC_Verb 0.00 703.000000000 FORMAT "%13.9" /end CHARACTERISTIC
/begin CHARACTERISTIC DFES_GrpRpr.DFC_FanDIOSCG_0_C "common MIL debouncing / group representative for common MIL debouncing of DFC_FanDIOSCG_0" VALUE 0x804FA060 Val_Wu16 703.000000000 DFC_Verb 0.00 703.000000000 FORMAT "%13.9" /end CHARACTERISTIC
/begin CHARACTERISTIC DFES_GrpRpr.DFC_FanDIOSCG_1_C "common MIL debouncing / group representative for common MIL debouncing of DFC_FanDIOSCG_1" VALUE 0x804FA062 Val_Wu16 703.000000000 DFC_Verb 0.00 703.000000000 FORMAT "%13.9" /end CHARACTERISTIC
/begin CHARACTERISTIC DFES_GrpRpr.DFC_MRlyDcOL_C "common MIL debouncing / group representative for common MIL debouncing of DFC_MRlyDcOL" VALUE 0x804FA064 Val_Wu16 703.000000000 DFC_Verb 0.00 703.000000000 FORMAT "%13.9" /end CHARACTERISTIC
/begin CHARACTERISTIC DFES_GrpRpr.DFC_MRlyDcSCB_C "common MIL debouncing / group representative for common MIL debouncing of DFC_MRlyDcSCB" VALUE 0x804FA066 Val_Wu16 703.000000000 DFC_Verb 0.00 703.000000000 FORMAT "%13.9" /end CHARACTERISTIC
/begin CHARACTERISTIC DFES_GrpRpr.DFC_MRlyDcSCG_C "common MIL debouncing / group representative for common MIL debouncing of DFC_MRlyDcSCG" VALUE 0x804FA068 Val_Wu16 703.000000000 DFC_Verb 0.00 703.000000000 FORMAT "%13.9" /end CHARACTERISTIC
/begin CHARACTERISTIC DFES_GrpRpr.DFC_PSPOL_C "common MIL debouncing / group representative for common MIL debouncing of DFC_PSPOL" VALUE 0x804FA06A Val_Wu16 703.000000000 DFC_Verb 0.00 703.000000000 FORMAT "%13.9" /end CHARACTERISTIC
/begin CHARACTERISTIC DFES_GrpRpr.DFC_PSPOvrTemp_C "common MIL debouncing / group representative for common MIL debouncing of DFC_PSPOvrTemp" VALUE 0x804FA06C Val_Wu16 703.000000000 DFC_Verb 0.00 703.000000000 FORMAT "%13.9" /end CHARACTERISTIC
/begin CHARACTERISTIC DFES_GrpRpr.DFC_PSPSCB_C "common MIL debouncing / group representative for common MIL debouncing of DFC_PSPSCB" VALUE 0x804FA06E Val_Wu16 703.000000000 DFC_Verb 0.00 703.000000000 FORMAT "%13.9" /end CHARACTERISTIC
/begin CHARACTERISTIC DFES_GrpRpr.DFC_PSPSCG_C "common MIL debouncing / group representative for common MIL debouncing of DFC_PSPSCG" VALUE 0x804FA070 Val_Wu16 703.000000000 DFC_Verb 0.00 703.000000000 FORMAT "%13.9" /end CHARACTERISTIC
/begin CHARACTERISTIC DFES_GrpRpr.DFC_T50Err_C "common MIL debouncing / group representative for common MIL debouncing of DFC_T50Err" VALUE 0x804FA072 Val_Wu16 703.000000000 DFC_Verb 0.00 703.000000000 FORMAT "%13.9" /end CHARACTERISTIC
/begin CHARACTERISTIC DFES_GrpRpr.DFC_ThrVlvLoBattB1_C "common MIL debouncing / group representative for common MIL debouncing of DFC_ThrVlvLoBattB1" VALUE 0x804FA074 Val_Wu16 703.000000000 DFC_Verb 0.00 703.000000000 FORMAT "%13.9" /end CHARACTERISTIC
/begin CHARACTERISTIC DFES_GrpRpr.DFC_VehVPhysRngHi_C "common MIL debouncing / group representative for common MIL debouncing of DFC_VehVPhysRngHi" VALUE 0x804FA076 Val_Wu16 703.000000000 DFC_Verb 0.00 703.000000000 FORMAT "%13.9" /end CHARACTERISTIC
/begin CHARACTERISTIC DFES_GrpRpr.DFC_VehVSclOutOL_C "common MIL debouncing / group representative for common MIL debouncing of DFC_VehVSclOutOL" VALUE 0x804FA078 Val_Wu16 703.000000000 DFC_Verb 0.00 703.000000000 FORMAT "%13.9" /end CHARACTERISTIC
/begin CHARACTERISTIC DFES_GrpRpr.DFC_VehVSclOutOT_C "common MIL debouncing / group representative for common MIL debouncing of DFC_VehVSclOutOT" VALUE 0x804FA07A Val_Wu16 703.000000000 DFC_Verb 0.00 703.000000000 FORMAT "%13.9" /end CHARACTERISTIC
/begin CHARACTERISTIC DFES_GrpRpr.DFC_VehVSclOutSCB_C "common MIL debouncing / group representative for common MIL debouncing of DFC_VehVSclOutSCB" VALUE 0x804FA07C Val_Wu16 703.000000000 DFC_Verb 0.00 703.000000000 FORMAT "%13.9" /end CHARACTERISTIC
/begin CHARACTERISTIC DFES_GrpRpr.DFC_VehVSclOutSCG_C "common MIL debouncing / group representative for common MIL debouncing of DFC_VehVSclOutSCG" VALUE 0x804FA07E Val_Wu16 703.000000000 DFC_Verb 0.00 703.000000000 FORMAT "%13.9" /end CHARACTERISTIC
/begin CHARACTERISTIC DFES_GrpRpr.DFC_VehVSnsrARngHi_C "common MIL debouncing / group representative for common MIL debouncing of DFC_VehVSnsrARngHi" VALUE 0x804FA080 Val_Wu16 703.000000000 DFC_Verb 0.00 703.000000000 FORMAT "%13.9" /end CHARACTERISTIC
/begin CHARACTERISTIC DFES_GrpRpr.DFC_VehVSnsrBRngHi_C "common MIL debouncing / group representative for common MIL debouncing of DFC_VehVSnsrBRngHi" VALUE 0x804FA082 Val_Wu16 703.000000000 DFC_Verb 0.00 703.000000000 FORMAT "%13.9" /end CHARACTERISTIC
/begin CHARACTERISTIC DFES_GrpRpr.DFC_VehVSpdRtyDiag_C "common MIL debouncing / group representative for common MIL debouncing of DFC_VehVSpdRtyDiag" VALUE 0x804FA084 Val_Wu16 703.000000000 DFC_Verb 0.00 703.000000000 FORMAT "%13.9" /end CHARACTERISTIC
/begin CHARACTERISTIC DFES_GrpRpr.DFC_VehVWhlErr_C "common MIL debouncing / group representative for common MIL debouncing of DFC_VehVWhlErr" VALUE 0x804FA086 Val_Wu16 703.000000000 DFC_Verb 0.00 703.000000000 FORMAT "%13.9" /end CHARACTERISTIC
/begin CHARACTERISTIC DFES_GrpRpr.DFC_ACEvpTSRCMax_C "common MIL debouncing / group representative for common MIL debouncing of DFC_ACEvpTSRCMax" VALUE 0x804FA088 Val_Wu16 703.000000000 DFC_Verb 0.00 703.000000000 FORMAT "%13.9" /end CHARACTERISTIC
/begin CHARACTERISTIC DFES_GrpRpr.DFC_ACEvpTSRCMin_C "common MIL debouncing / group representative for common MIL debouncing of DFC_ACEvpTSRCMin" VALUE 0x804FA08A Val_Wu16 703.000000000 DFC_Verb 0.00 703.000000000 FORMAT "%13.9" /end CHARACTERISTIC
/begin CHARACTERISTIC DFES_GrpRpr.DFC_AirCClntPAnaSRCMax_C "common MIL debouncing / group representative for common MIL debouncing of DFC_AirCClntPAnaSRCMax" VALUE 0x804FA08C Val_Wu16 703.000000000 DFC_Verb 0.00 703.000000000 FORMAT "%13.9" /end CHARACTERISTIC
/begin CHARACTERISTIC DFES_GrpRpr.DFC_AirCClntPAnaSRCMin_C "common MIL debouncing / group representative for common MIL debouncing of DFC_AirCClntPAnaSRCMin" VALUE 0x804FA08E Val_Wu16 703.000000000 DFC_Verb 0.00 703.000000000 FORMAT "%13.9" /end CHARACTERISTIC
/begin CHARACTERISTIC DFES_GrpRpr.DFC_AirCSwtNpl_C "common MIL debouncing / group representative for common MIL debouncing of DFC_AirCSwtNpl" VALUE 0x804FA090 Val_Wu16 703.000000000 DFC_Verb 0.00 703.000000000 FORMAT "%13.9" /end CHARACTERISTIC
/begin CHARACTERISTIC DFES_GrpRpr.DFC_AirCSwtSig_C "common MIL debouncing / group representative for common MIL debouncing of DFC_AirCSwtSig" VALUE 0x804FA092 Val_Wu16 703.000000000 DFC_Verb 0.00 703.000000000 FORMAT "%13.9" /end CHARACTERISTIC
/begin CHARACTERISTIC DFES_GrpRpr.DFC_Brk_C "common MIL debouncing / group representative for common MIL debouncing of DFC_Brk" VALUE 0x804FA094 Val_Wu16 703.000000000 DFC_Verb 0.00 703.000000000 FORMAT "%13.9" /end CHARACTERISTIC
/begin CHARACTERISTIC DFES_GrpRpr.DFC_BrkSig_C "common MIL debouncing / group representative for common MIL debouncing of DFC_BrkSig" VALUE 0x804FA096 Val_Wu16 703.000000000 DFC_Verb 0.00 703.000000000 FORMAT "%13.9" /end CHARACTERISTIC
/begin CHARACTERISTIC DFES_GrpRpr.DFC_ClthSig_C "common MIL debouncing / group representative for common MIL debouncing of DFC_ClthSig" VALUE 0x804FA098 Val_Wu16 703.000000000 DFC_Verb 0.00 703.000000000 FORMAT "%13.9" /end CHARACTERISTIC
/begin CHARACTERISTIC DFES_GrpRpr.DFC_HLSDemOvhtEngLim_C "common MIL debouncing / group representative for common MIL debouncing of DFC_HLSDemOvhtEngLim" VALUE 0x804FA09A Val_Wu16 703.000000000 DFC_Verb 0.00 703.000000000 FORMAT "%13.9" /end CHARACTERISTIC
/begin CHARACTERISTIC DFES_GrpRpr.DFC_OilPNpl_C "common MIL debouncing / group representative for common MIL debouncing of DFC_OilPNpl" VALUE 0x804FA09C Val_Wu16 703.000000000 DFC_Verb 0.00 703.000000000 FORMAT "%13.9" /end CHARACTERISTIC
/begin CHARACTERISTIC DFES_GrpRpr.DFC_PIntkVUsLineHiB1_C "common MIL debouncing / group representative for common MIL debouncing of DFC_PIntkVUsLineHiB1" VALUE 0x804FA09E Val_Wu16 703.000000000 DFC_Verb 0.00 703.000000000 FORMAT "%13.9" /end CHARACTERISTIC
/begin CHARACTERISTIC DFES_GrpRpr.DFC_PIntkVUsLineLoB1_C "common MIL debouncing / group representative for common MIL debouncing of DFC_PIntkVUsLineLoB1" VALUE 0x804FA0A0 Val_Wu16 703.000000000 DFC_Verb 0.00 703.000000000 FORMAT "%13.9" /end CHARACTERISTIC
/begin CHARACTERISTIC DFES_GrpRpr.DFC_VehVPhysRngLo_C "common MIL debouncing / group representative for common MIL debouncing of DFC_VehVPhysRngLo" VALUE 0x804FA0A2 Val_Wu16 703.000000000 DFC_Verb 0.00 703.000000000 FORMAT "%13.9" /end CHARACTERISTIC
/begin CHARACTERISTIC DFES_GrpRpr.DFC_VehVSigCan_C "common MIL debouncing / group representative for common MIL debouncing of DFC_VehVSigCan" VALUE 0x804FA0A4 Val_Wu16 703.000000000 DFC_Verb 0.00 703.000000000 FORMAT "%13.9" /end CHARACTERISTIC
/begin CHARACTERISTIC DFES_GrpRpr.DFC_VehVSigCanSafe_C "common MIL debouncing / group representative for common MIL debouncing of DFC_VehVSigCanSafe" VALUE 0x804FA0A6 Val_Wu16 703.000000000 DFC_Verb 0.00 703.000000000 FORMAT "%13.9" /end CHARACTERISTIC
/begin CHARACTERISTIC DFES_GrpRpr.DFC_VlvLftFbOilPSnsrIntk11SRCMax_C "common MIL debouncing / group representative for common MIL debouncing of DFC_VlvLftFbOilPSnsrIntk11SRCMax" VALUE 0x804FA0A8 Val_Wu16 703.000000000 DFC_Verb 0.00 703.000000000 FORMAT "%13.9" /end CHARACTERISTIC
/begin CHARACTERISTIC DFES_GrpRpr.DFC_VlvLftFbOilPSnsrIntk11SRCMin_C "common MIL debouncing / group representative for common MIL debouncing of DFC_VlvLftFbOilPSnsrIntk11SRCMin" VALUE 0x804FA0AA Val_Wu16 703.000000000 DFC_Verb 0.00 703.000000000 FORMAT "%13.9" /end CHARACTERISTIC
/begin CHARACTERISTIC DFES_GrpRpr.DFC_ClthNpl_C "common MIL debouncing / group representative for common MIL debouncing of DFC_ClthNpl" VALUE 0x804FA0AC Val_Wu16 703.000000000 DFC_Verb 0.00 703.000000000 FORMAT "%13.9" /end CHARACTERISTIC
/begin CHARACTERISTIC DFES_GrpRpr.DFC_EV1max_C "common MIL debouncing / group representative for common MIL debouncing of DFC_EV1max" VALUE 0x804FA0AE Val_Wu16 703.000000000 DFC_Verb 0.00 703.000000000 FORMAT "%13.9" /end CHARACTERISTIC
/begin CHARACTERISTIC DFES_GrpRpr.DFC_EV1min_C "common MIL debouncing / group representative for common MIL debouncing of DFC_EV1min" VALUE 0x804FA0B0 Val_Wu16 703.000000000 DFC_Verb 0.00 703.000000000 FORMAT "%13.9" /end CHARACTERISTIC
/begin CHARACTERISTIC DFES_GrpRpr.DFC_EV1sig_C "common MIL debouncing / group representative for common MIL debouncing of DFC_EV1sig" VALUE 0x804FA0B2 Val_Wu16 703.000000000 DFC_Verb 0.00 703.000000000 FORMAT "%13.9" /end CHARACTERISTIC
/begin CHARACTERISTIC DFES_GrpRpr.DFC_EV2max_C "common MIL debouncing / group representative for common MIL debouncing of DFC_EV2max" VALUE 0x804FA0B4 Val_Wu16 703.000000000 DFC_Verb 0.00 703.000000000 FORMAT "%13.9" /end CHARACTERISTIC
/begin CHARACTERISTIC DFES_GrpRpr.DFC_EV2min_C "common MIL debouncing / group representative for common MIL debouncing of DFC_EV2min" VALUE 0x804FA0B6 Val_Wu16 703.000000000 DFC_Verb 0.00 703.000000000 FORMAT "%13.9" /end CHARACTERISTIC
/begin CHARACTERISTIC DFES_GrpRpr.DFC_EV2sig_C "common MIL debouncing / group representative for common MIL debouncing of DFC_EV2sig" VALUE 0x804FA0B8 Val_Wu16 703.000000000 DFC_Verb 0.00 703.000000000 FORMAT "%13.9" /end CHARACTERISTIC
/begin CHARACTERISTIC DFES_GrpRpr.DFC_EV3max_C "common MIL debouncing / group representative for common MIL debouncing of DFC_EV3max" VALUE 0x804FA0BA Val_Wu16 703.000000000 DFC_Verb 0.00 703.000000000 FORMAT "%13.9" /end CHARACTERISTIC
/begin CHARACTERISTIC DFES_GrpRpr.DFC_EV3min_C "common MIL debouncing / group representative for common MIL debouncing of DFC_EV3min" VALUE 0x804FA0BC Val_Wu16 703.000000000 DFC_Verb 0.00 703.000000000 FORMAT "%13.9" /end CHARACTERISTIC
/begin CHARACTERISTIC DFES_GrpRpr.DFC_EV3sig_C "common MIL debouncing / group representative for common MIL debouncing of DFC_EV3sig" VALUE 0x804FA0BE Val_Wu16 703.000000000 DFC_Verb 0.00 703.000000000 FORMAT "%13.9" /end CHARACTERISTIC
/begin CHARACTERISTIC DFES_GrpRpr.DFC_EV4max_C "common MIL debouncing / group representative for common MIL debouncing of DFC_EV4max" VALUE 0x804FA0C0 Val_Wu16 703.000000000 DFC_Verb 0.00 703.000000000 FORMAT "%13.9" /end CHARACTERISTIC
/begin CHARACTERISTIC DFES_GrpRpr.DFC_EV4min_C "common MIL debouncing / group representative for common MIL debouncing of DFC_EV4min" VALUE 0x804FA0C2 Val_Wu16 703.000000000 DFC_Verb 0.00 703.000000000 FORMAT "%13.9" /end CHARACTERISTIC
/begin CHARACTERISTIC DFES_GrpRpr.DFC_EV4sig_C "common MIL debouncing / group representative for common MIL debouncing of DFC_EV4sig" VALUE 0x804FA0C4 Val_Wu16 703.000000000 DFC_Verb 0.00 703.000000000 FORMAT "%13.9" /end CHARACTERISTIC
/begin CHARACTERISTIC DFES_GrpRpr.DFC_GbxPNPosnDrvCdn_C "common MIL debouncing / group representative for common MIL debouncing of DFC_GbxPNPosnDrvCdn" VALUE 0x804FA0C6 Val_Wu16 703.000000000 DFC_Verb 0.00 703.000000000 FORMAT "%13.9" /end CHARACTERISTIC
/begin CHARACTERISTIC DFES_GrpRpr.DFC_GbxPNPosnPlausy_C "common MIL debouncing / group representative for common MIL debouncing of DFC_GbxPNPosnPlausy" VALUE 0x804FA0C8 Val_Wu16 703.000000000 DFC_Verb 0.00 703.000000000 FORMAT "%13.9" /end CHARACTERISTIC
/begin CHARACTERISTIC DFES_GrpRpr.DFC_PEnvCcMax_C "common MIL debouncing / group representative for common MIL debouncing of DFC_PEnvCcMax" VALUE 0x804FA0CA Val_Wu16 703.000000000 DFC_Verb 0.00 703.000000000 FORMAT "%13.9" /end CHARACTERISTIC
/begin CHARACTERISTIC DFES_GrpRpr.DFC_PEnvCcMin_C "common MIL debouncing / group representative for common MIL debouncing of DFC_PEnvCcMin" VALUE 0x804FA0CC Val_Wu16 703.000000000 DFC_Verb 0.00 703.000000000 FORMAT "%13.9" /end CHARACTERISTIC
/begin CHARACTERISTIC DFES_GrpRpr.DFC_PEnvRngChkMax_C "common MIL debouncing / group representative for common MIL debouncing of DFC_PEnvRngChkMax" VALUE 0x804FA0CE Val_Wu16 703.000000000 DFC_Verb 0.00 703.000000000 FORMAT "%13.9" /end CHARACTERISTIC
/begin CHARACTERISTIC DFES_GrpRpr.DFC_PEnvRngChkMin_C "common MIL debouncing / group representative for common MIL debouncing of DFC_PEnvRngChkMin" VALUE 0x804FA0D0 Val_Wu16 703.000000000 DFC_Verb 0.00 703.000000000 FORMAT "%13.9" /end CHARACTERISTIC
/begin CHARACTERISTIC DFES_GrpRpr.DFC_PEnvSnsrPlaus_C "common MIL debouncing / group representative for common MIL debouncing of DFC_PEnvSnsrPlaus" VALUE 0x804FA0D2 Val_Wu16 703.000000000 DFC_Verb 0.00 703.000000000 FORMAT "%13.9" /end CHARACTERISTIC
/begin CHARACTERISTIC DFES_GrpRpr.DFC_UEGOHeatrPsS1B1Max_C "common MIL debouncing / group representative for common MIL debouncing of DFC_UEGOHeatrPsS1B1Max" VALUE 0x804FA0D4 Val_Wu16 703.000000000 DFC_Verb 0.00 703.000000000 FORMAT "%13.9" /end CHARACTERISTIC
/begin CHARACTERISTIC DFES_GrpRpr.DFC_UEGOHeatrPsS1B1Min_C "common MIL debouncing / group representative for common MIL debouncing of DFC_UEGOHeatrPsS1B1Min" VALUE 0x804FA0D6 Val_Wu16 703.000000000 DFC_Verb 0.00 703.000000000 FORMAT "%13.9" /end CHARACTERISTIC
/begin CHARACTERISTIC DFES_GrpRpr.DFC_UEGOHeatrPsS1B1Sig_C "common MIL debouncing / group representative for common MIL debouncing of DFC_UEGOHeatrPsS1B1Sig" VALUE 0x804FA0D8 Val_Wu16 703.000000000 DFC_Verb 0.00 703.000000000 FORMAT "%13.9" /end CHARACTERISTIC
/begin CHARACTERISTIC DFES_GrpRpr.DFC_UEGOHeatrRlyPsOLS1B1_C "common MIL debouncing / group representative for common MIL debouncing of DFC_UEGOHeatrRlyPsOLS1B1" VALUE 0x804FA0DA Val_Wu16 703.000000000 DFC_Verb 0.00 703.000000000 FORMAT "%13.9" /end CHARACTERISTIC
/begin CHARACTERISTIC DFES_GrpRpr.DFC_UEGOHeatrRlyPsSCBS1B1_C "common MIL debouncing / group representative for common MIL debouncing of DFC_UEGOHeatrRlyPsSCBS1B1" VALUE 0x804FA0DC Val_Wu16 703.000000000 DFC_Verb 0.00 703.000000000 FORMAT "%13.9" /end CHARACTERISTIC
/begin CHARACTERISTIC DFES_GrpRpr.DFC_UEGOHeatrRlyPsSCGS1B1_C "common MIL debouncing / group representative for common MIL debouncing of DFC_UEGOHeatrRlyPsSCGS1B1" VALUE 0x804FA0DE Val_Wu16 703.000000000 DFC_Verb 0.00 703.000000000 FORMAT "%13.9" /end CHARACTERISTIC
/begin CHARACTERISTIC DFES_GrpRpr.DFC_KnDetSens1PortAMax_C "common MIL debouncing / group representative for common MIL debouncing of DFC_KnDetSens1PortAMax" VALUE 0x804FA0E0 Val_Wu16 703.000000000 DFC_Verb 0.00 703.000000000 FORMAT "%13.9" /end CHARACTERISTIC
/begin CHARACTERISTIC DFES_GrpRpr.DFC_KnDetSens1PortAMin_C "common MIL debouncing / group representative for common MIL debouncing of DFC_KnDetSens1PortAMin" VALUE 0x804FA0E2 Val_Wu16 703.000000000 DFC_Verb 0.00 703.000000000 FORMAT "%13.9" /end CHARACTERISTIC
/begin CHARACTERISTIC DFES_GrpRpr.DFC_KnDetSens1PortBMax_C "common MIL debouncing / group representative for common MIL debouncing of DFC_KnDetSens1PortBMax" VALUE 0x804FA0E4 Val_Wu16 703.000000000 DFC_Verb 0.00 703.000000000 FORMAT "%13.9" /end CHARACTERISTIC
/begin CHARACTERISTIC DFES_GrpRpr.DFC_KnDetSens1PortBMin_C "common MIL debouncing / group representative for common MIL debouncing of DFC_KnDetSens1PortBMin" VALUE 0x804FA0E6 Val_Wu16 703.000000000 DFC_Verb 0.00 703.000000000 FORMAT "%13.9" /end CHARACTERISTIC
/begin CHARACTERISTIC DFES_GrpRpr.DFC_Clth2ONStuck_C "common MIL debouncing / group representative for common MIL debouncing of DFC_Clth2ONStuck" VALUE 0x804FA0E8 Val_Wu16 703.000000000 DFC_Verb 0.00 703.000000000 FORMAT "%13.9" /end CHARACTERISTIC
/begin CHARACTERISTIC DFES_GrpRpr.DFC_Clth2ONStuckLdc_C "common MIL debouncing / group representative for common MIL debouncing of DFC_Clth2ONStuckLdc" VALUE 0x804FA0EA Val_Wu16 703.000000000 DFC_Verb 0.00 703.000000000 FORMAT "%13.9" /end CHARACTERISTIC
/begin CHARACTERISTIC DFES_GrpRpr.DFC_Clth3ONStuckLdc_C "common MIL debouncing / group representative for common MIL debouncing of DFC_Clth3ONStuckLdc" VALUE 0x804FA0EC Val_Wu16 703.000000000 DFC_Verb 0.00 703.000000000 FORMAT "%13.9" /end CHARACTERISTIC
/begin CHARACTERISTIC DFES_GrpRpr.DFC_Clth3ONStuckPostDrv_C "common MIL debouncing / group representative for common MIL debouncing of DFC_Clth3ONStuckPostDrv" VALUE 0x804FA0EE Val_Wu16 703.000000000 DFC_Verb 0.00 703.000000000 FORMAT "%13.9" /end CHARACTERISTIC
/begin CHARACTERISTIC DFES_GrpRpr.DFC_Clth4ONStuck_C "common MIL debouncing / group representative for common MIL debouncing of DFC_Clth4ONStuck" VALUE 0x804FA0F0 Val_Wu16 703.000000000 DFC_Verb 0.00 703.000000000 FORMAT "%13.9" /end CHARACTERISTIC
/begin CHARACTERISTIC DFES_GrpRpr.DFC_Clth4ONStuckLdc_C "common MIL debouncing / group representative for common MIL debouncing of DFC_Clth4ONStuckLdc" VALUE 0x804FA0F2 Val_Wu16 703.000000000 DFC_Verb 0.00 703.000000000 FORMAT "%13.9" /end CHARACTERISTIC
/begin CHARACTERISTIC DFES_GrpRpr.DFC_ComDLCTCU01_C "common MIL debouncing / group representative for common MIL debouncing of DFC_ComDLCTCU01" VALUE 0x804FA0F4 Val_Wu16 703.000000000 DFC_Verb 0.00 703.000000000 FORMAT "%13.9" /end CHARACTERISTIC
/begin CHARACTERISTIC DFES_GrpRpr.DFC_ComDLCTCU02_C "common MIL debouncing / group representative for common MIL debouncing of DFC_ComDLCTCU02" VALUE 0x804FA0F6 Val_Wu16 703.000000000 DFC_Verb 0.00 703.000000000 FORMAT "%13.9" /end CHARACTERISTIC
/begin CHARACTERISTIC DFES_GrpRpr.DFC_ComDLCTCU1_C "common MIL debouncing / group representative for common MIL debouncing of DFC_ComDLCTCU1" VALUE 0x804FA0F8 Val_Wu16 703.000000000 DFC_Verb 0.00 703.000000000 FORMAT "%13.9" /end CHARACTERISTIC
/begin CHARACTERISTIC DFES_GrpRpr.DFC_ComDLCTCU11_C "common MIL debouncing / group representative for common MIL debouncing of DFC_ComDLCTCU11" VALUE 0x804FA0FA Val_Wu16 703.000000000 DFC_Verb 0.00 703.000000000 FORMAT "%13.9" /end CHARACTERISTIC
/begin CHARACTERISTIC DFES_GrpRpr.DFC_ComDLCTCU12_C "common MIL debouncing / group representative for common MIL debouncing of DFC_ComDLCTCU12" VALUE 0x804FA0FC Val_Wu16 703.000000000 DFC_Verb 0.00 703.000000000 FORMAT "%13.9" /end CHARACTERISTIC
/begin CHARACTERISTIC DFES_GrpRpr.DFC_ComDLCTCU13_C "common MIL debouncing / group representative for common MIL debouncing of DFC_ComDLCTCU13" VALUE 0x804FA0FE Val_Wu16 703.000000000 DFC_Verb 0.00 703.000000000 FORMAT "%13.9" /end CHARACTERISTIC
/begin CHARACTERISTIC DFES_GrpRpr.DFC_ComDLCTCU14_C "common MIL debouncing / group representative for common MIL debouncing of DFC_ComDLCTCU14" VALUE 0x804FA100 Val_Wu16 703.000000000 DFC_Verb 0.00 703.000000000 FORMAT "%13.9" /end CHARACTERISTIC
/begin CHARACTERISTIC DFES_GrpRpr.DFC_ComDLCTCU2_C "common MIL debouncing / group representative for common MIL debouncing of DFC_ComDLCTCU2" VALUE 0x804FA102 Val_Wu16 703.000000000 DFC_Verb 0.00 703.000000000 FORMAT "%13.9" /end CHARACTERISTIC
/begin CHARACTERISTIC DFES_GrpRpr.DFC_ComDLCTCU3_C "common MIL debouncing / group representative for common MIL debouncing of DFC_ComDLCTCU3" VALUE 0x804FA104 Val_Wu16 703.000000000 DFC_Verb 0.00 703.000000000 FORMAT "%13.9" /end CHARACTERISTIC
/begin CHARACTERISTIC DFES_GrpRpr.DFC_ComDLCTCU4_C "common MIL debouncing / group representative for common MIL debouncing of DFC_ComDLCTCU4" VALUE 0x804FA106 Val_Wu16 703.000000000 DFC_Verb 0.00 703.000000000 FORMAT "%13.9" /end CHARACTERISTIC
/begin CHARACTERISTIC DFES_GrpRpr.DFC_EVX_C "common MIL debouncing / group representative for common MIL debouncing of DFC_EVX" VALUE 0x804FA108 Val_Wu16 703.000000000 DFC_Verb 0.00 703.000000000 FORMAT "%13.9" /end CHARACTERISTIC
/begin CHARACTERISTIC DFES_GrpRpr.DFC_EbsSocFlt_C "common MIL debouncing / group representative for common MIL debouncing of DFC_EbsSocFlt" VALUE 0x804FA10A Val_Wu16 703.000000000 DFC_Verb 0.00 703.000000000 FORMAT "%13.9" /end CHARACTERISTIC
/begin CHARACTERISTIC DFES_GrpRpr.DFC_I14229VINErr_C "common MIL debouncing / group representative for common MIL debouncing of DFC_I14229VINErr" VALUE 0x804FA10C Val_Wu16 703.000000000 DFC_Verb 0.00 703.000000000 FORMAT "%13.9" /end CHARACTERISTIC
/begin CHARACTERISTIC DFES_GrpRpr.DFC_LLRKHmax_C "common MIL debouncing / group representative for common MIL debouncing of DFC_LLRKHmax" VALUE 0x804FA10E Val_Wu16 703.000000000 DFC_Verb 0.00 703.000000000 FORMAT "%13.9" /end CHARACTERISTIC
/begin CHARACTERISTIC DFES_GrpRpr.DFC_LLRKHmin_C "common MIL debouncing / group representative for common MIL debouncing of DFC_LLRKHmin" VALUE 0x804FA110 Val_Wu16 703.000000000 DFC_Verb 0.00 703.000000000 FORMAT "%13.9" /end CHARACTERISTIC
/begin CHARACTERISTIC DFES_GrpRpr.DFC_LLRmax_C "common MIL debouncing / group representative for common MIL debouncing of DFC_LLRmax" VALUE 0x804FA112 Val_Wu16 703.000000000 DFC_Verb 0.00 703.000000000 FORMAT "%13.9" /end CHARACTERISTIC
/begin CHARACTERISTIC DFES_GrpRpr.DFC_LLRmin_C "common MIL debouncing / group representative for common MIL debouncing of DFC_LLRmin" VALUE 0x804FA114 Val_Wu16 703.000000000 DFC_Verb 0.00 703.000000000 FORMAT "%13.9" /end CHARACTERISTIC
/begin CHARACTERISTIC DFES_GrpRpr.DFC_RoughRoad_C "common MIL debouncing / group representative for common MIL debouncing of DFC_RoughRoad" VALUE 0x804FA116 Val_Wu16 703.000000000 DFC_Verb 0.00 703.000000000 FORMAT "%13.9" /end CHARACTERISTIC
/begin CHARACTERISTIC DFES_GrpRpr.DFC_SiaEEPRdErr_C "common MIL debouncing / group representative for common MIL debouncing of DFC_SiaEEPRdErr" VALUE 0x804FA118 Val_Wu16 703.000000000 DFC_Verb 0.00 703.000000000 FORMAT "%13.9" /end CHARACTERISTIC
/begin CHARACTERISTIC DFES_GrpRpr.DFC_SiaEEPWrngCod_C "common MIL debouncing / group representative for common MIL debouncing of DFC_SiaEEPWrngCod" VALUE 0x804FA11A Val_Wu16 703.000000000 DFC_Verb 0.00 703.000000000 FORMAT "%13.9" /end CHARACTERISTIC
/begin CHARACTERISTIC DFES_GrpRpr.DFC_UegoDummy_C "common MIL debouncing / group representative for common MIL debouncing of DFC_UegoDummy" VALUE 0x804FA11C Val_Wu16 703.000000000 DFC_Verb 0.00 703.000000000 FORMAT "%13.9" /end CHARACTERISTIC
/begin CHARACTERISTIC DFES_GrpRpr.DFC_BusDiagCANAPPLBusOff_C "common MIL debouncing / group representative for common MIL debouncing of DFC_BusDiagCANAPPLBusOff" VALUE 0x804FA11E Val_Wu16 703.000000000 DFC_Verb 0.00 703.000000000 FORMAT "%13.9" /end CHARACTERISTIC
/begin CHARACTERISTIC DFES_GrpRpr.DFC_BusDiagCANCANCBusOff_C "common MIL debouncing / group representative for common MIL debouncing of DFC_BusDiagCANCANCBusOff" VALUE 0x804FA120 Val_Wu16 703.000000000 DFC_Verb 0.00 703.000000000 FORMAT "%13.9" /end CHARACTERISTIC
/begin CHARACTERISTIC DFES_GrpRpr.DFC_BusDiagCANVEHICLEBusOff_C "common MIL debouncing / group representative for common MIL debouncing of DFC_BusDiagCANVEHICLEBusOff" VALUE 0x804FA122 Val_Wu16 703.000000000 DFC_Verb 0.00 703.000000000 FORMAT "%13.9" /end CHARACTERISTIC
/begin CHARACTERISTIC DFES_GrpRpr.DFC_RBA_IODIAGPWR_rba_IoExtCy329_SignalVltSply_0_C "common MIL debouncing / group representative for common MIL debouncing of DFC_RBA_IODIAGPWR_rba_IoExtCy329_SignalVltSply_0" VALUE 0x804FA124 Val_Wu16 703.000000000 DFC_Verb 0.00 703.000000000 FORMAT "%13.9" /end CHARACTERISTIC
/begin CHARACTERISTIC DFES_GrpRpr.DFC_RBA_IODIAGPWR_rba_IoExtCy329_SignalVltSply_0OT_C "common MIL debouncing / group representative for common MIL debouncing of DFC_RBA_IODIAGPWR_rba_IoExtCy329_SignalVltSply_0OT" VALUE 0x804FA126 Val_Wu16 703.000000000 DFC_Verb 0.00 703.000000000 FORMAT "%13.9" /end CHARACTERISTIC
/begin CHARACTERISTIC DFES_GrpRpr.DFC_RBA_IODIAGPWR_rba_IoExtCy329_SignalVltSply_0OV_C "common MIL debouncing / group representative for common MIL debouncing of DFC_RBA_IODIAGPWR_rba_IoExtCy329_SignalVltSply_0OV" VALUE 0x804FA128 Val_Wu16 703.000000000 DFC_Verb 0.00 703.000000000 FORMAT "%13.9" /end CHARACTERISTIC
/begin CHARACTERISTIC DFES_GrpRpr.DFC_RBA_IODIAGPWR_rba_IoExtCy329_SignalVltSply_0SCG_C "common MIL debouncing / group representative for common MIL debouncing of DFC_RBA_IODIAGPWR_rba_IoExtCy329_SignalVltSply_0SCG" VALUE 0x804FA12A Val_Wu16 703.000000000 DFC_Verb 0.00 703.000000000 FORMAT "%13.9" /end CHARACTERISTIC
/begin CHARACTERISTIC DFES_GrpRpr.DFC_RBA_IODIAGPWR_rba_IoExtCy329_SignalVltSply_0UV_C "common MIL debouncing / group representative for common MIL debouncing of DFC_RBA_IODIAGPWR_rba_IoExtCy329_SignalVltSply_0UV" VALUE 0x804FA12C Val_Wu16 703.000000000 DFC_Verb 0.00 703.000000000 FORMAT "%13.9" /end CHARACTERISTIC
/begin CHARACTERISTIC DFES_GrpRpr.DFC_RBA_IODIAGPWR_rba_IoExtCy329_SignalVltSply_1_C "common MIL debouncing / group representative for common MIL debouncing of DFC_RBA_IODIAGPWR_rba_IoExtCy329_SignalVltSply_1" VALUE 0x804FA12E Val_Wu16 703.000000000 DFC_Verb 0.00 703.000000000 FORMAT "%13.9" /end CHARACTERISTIC
/begin CHARACTERISTIC DFES_GrpRpr.DFC_RBA_IODIAGPWR_rba_IoExtCy329_SignalVltSply_1OT_C "common MIL debouncing / group representative for common MIL debouncing of DFC_RBA_IODIAGPWR_rba_IoExtCy329_SignalVltSply_1OT" VALUE 0x804FA130 Val_Wu16 703.000000000 DFC_Verb 0.00 703.000000000 FORMAT "%13.9" /end CHARACTERISTIC
/begin CHARACTERISTIC DFES_GrpRpr.DFC_RBA_IODIAGPWR_rba_IoExtCy329_SignalVltSply_1OV_C "common MIL debouncing / group representative for common MIL debouncing of DFC_RBA_IODIAGPWR_rba_IoExtCy329_SignalVltSply_1OV" VALUE 0x804FA132 Val_Wu16 703.000000000 DFC_Verb 0.00 703.000000000 FORMAT "%13.9" /end CHARACTERISTIC
/begin CHARACTERISTIC DFES_GrpRpr.DFC_RBA_IODIAGPWR_rba_IoExtCy329_SignalVltSply_1SCG_C "common MIL debouncing / group representative for common MIL debouncing of DFC_RBA_IODIAGPWR_rba_IoExtCy329_SignalVltSply_1SCG" VALUE 0x804FA134 Val_Wu16 703.000000000 DFC_Verb 0.00 703.000000000 FORMAT "%13.9" /end CHARACTERISTIC
/begin CHARACTERISTIC DFES_GrpRpr.DFC_RBA_IODIAGPWR_rba_IoExtCy329_SignalVltSply_1UV_C "common MIL debouncing / group representative for common MIL debouncing of DFC_RBA_IODIAGPWR_rba_IoExtCy329_SignalVltSply_1UV" VALUE 0x804FA136 Val_Wu16 703.000000000 DFC_Verb 0.00 703.000000000 FORMAT "%13.9" /end CHARACTERISTIC
/begin CHARACTERISTIC DFES_GrpRpr.DFC_RBA_IODIAGPWR_rba_IoExtCy329_SignalVltSply_2_C "common MIL debouncing / group representative for common MIL debouncing of DFC_RBA_IODIAGPWR_rba_IoExtCy329_SignalVltSply_2" VALUE 0x804FA138 Val_Wu16 703.000000000 DFC_Verb 0.00 703.000000000 FORMAT "%13.9" /end CHARACTERISTIC
/begin CHARACTERISTIC DFES_GrpRpr.DFC_RBA_IODIAGPWR_rba_IoExtCy329_SignalVltSply_2OT_C "common MIL debouncing / group representative for common MIL debouncing of DFC_RBA_IODIAGPWR_rba_IoExtCy329_SignalVltSply_2OT" VALUE 0x804FA13A Val_Wu16 703.000000000 DFC_Verb 0.00 703.000000000 FORMAT "%13.9" /end CHARACTERISTIC
/begin CHARACTERISTIC DFES_GrpRpr.DFC_RBA_IODIAGPWR_rba_IoExtCy329_SignalVltSply_2OV_C "common MIL debouncing / group representative for common MIL debouncing of DFC_RBA_IODIAGPWR_rba_IoExtCy329_SignalVltSply_2OV" VALUE 0x804FA13C Val_Wu16 703.000000000 DFC_Verb 0.00 703.000000000 FORMAT "%13.9" /end CHARACTERISTIC
/begin CHARACTERISTIC DFES_GrpRpr.DFC_RBA_IODIAGPWR_rba_IoExtCy329_SignalVltSply_2SCG_C "common MIL debouncing / group representative for common MIL debouncing of DFC_RBA_IODIAGPWR_rba_IoExtCy329_SignalVltSply_2SCG" VALUE 0x804FA13E Val_Wu16 703.000000000 DFC_Verb 0.00 703.000000000 FORMAT "%13.9" /end CHARACTERISTIC
/begin CHARACTERISTIC DFES_GrpRpr.DFC_RBA_IODIAGPWR_rba_IoExtCy329_SignalVltSply_2UV_C "common MIL debouncing / group representative for common MIL debouncing of DFC_RBA_IODIAGPWR_rba_IoExtCy329_SignalVltSply_2UV" VALUE 0x804FA140 Val_Wu16 703.000000000 DFC_Verb 0.00 703.000000000 FORMAT "%13.9" /end CHARACTERISTIC
/begin CHARACTERISTIC DFES_GrpRpr.DFC_CAN_E_TIMEOUT_C "common MIL debouncing / group representative for common MIL debouncing of DFC_CAN_E_TIMEOUT" VALUE 0x804FA142 Val_Wu16 703.000000000 DFC_Verb 0.00 703.000000000 FORMAT "%13.9" /end CHARACTERISTIC
/begin CHARACTERISTIC DFES_GrpRpr.DFC_LIN_E_TIMEOUT_C "common MIL debouncing / group representative for common MIL debouncing of DFC_LIN_E_TIMEOUT" VALUE 0x804FA144 Val_Wu16 703.000000000 DFC_Verb 0.00 703.000000000 FORMAT "%13.9" /end CHARACTERISTIC
/begin CHARACTERISTIC DFES_GrpRpr.DFC_MRlyOL_C "common MIL debouncing / group representative for common MIL debouncing of DFC_MRlyOL" VALUE 0x804FA146 Val_Wu16 703.000000000 DFC_Verb 0.00 703.000000000 FORMAT "%13.9" /end CHARACTERISTIC
/begin CHARACTERISTIC DFES_GrpRpr.DFC_MRlySCB_C "common MIL debouncing / group representative for common MIL debouncing of DFC_MRlySCB" VALUE 0x804FA148 Val_Wu16 703.000000000 DFC_Verb 0.00 703.000000000 FORMAT "%13.9" /end CHARACTERISTIC
/begin CHARACTERISTIC DFES_GrpRpr.DFC_MRlySCG_C "common MIL debouncing / group representative for common MIL debouncing of DFC_MRlySCG" VALUE 0x804FA14A Val_Wu16 703.000000000 DFC_Verb 0.00 703.000000000 FORMAT "%13.9" /end CHARACTERISTIC
/begin CHARACTERISTIC DFES_GrpRpr.DFC_rba_MultiStackTrace_Threshold_C "common MIL debouncing / group representative for common MIL debouncing of DFC_rba_MultiStackTrace_Threshold" VALUE 0x804FA14C Val_Wu16 703.000000000 DFC_Verb 0.00 703.000000000 FORMAT "%13.9" /end CHARACTERISTIC
/begin CHARACTERISTIC DFES_GrpRpr.DFC_BSWM_E_ACTION_FAILED_C "common MIL debouncing / group representative for common MIL debouncing of DFC_BSWM_E_ACTION_FAILED" VALUE 0x804FA14E Val_Wu16 703.000000000 DFC_Verb 0.00 703.000000000 FORMAT "%13.9" /end CHARACTERISTIC
/begin CHARACTERISTIC DFES_GrpRpr.DFC_BSWM_E_INTRPTQUEUE_FULL_C "common MIL debouncing / group representative for common MIL debouncing of DFC_BSWM_E_INTRPTQUEUE_FULL" VALUE 0x804FA150 Val_Wu16 703.000000000 DFC_Verb 0.00 703.000000000 FORMAT "%13.9" /end CHARACTERISTIC
/begin CHARACTERISTIC DFES_GrpRpr.DFC_RBA_IOEXTLIB_KEEPALIVE_DRV_C "common MIL debouncing / group representative for common MIL debouncing of DFC_RBA_IOEXTLIB_KEEPALIVE_DRV" VALUE 0x804FA152 Val_Wu16 703.000000000 DFC_Verb 0.00 703.000000000 FORMAT "%13.9" /end CHARACTERISTIC
/begin CHARACTERISTIC DFES_GrpRpr.DFC_RBA_IOEXTLIB_KEEPALIVE_INI_C "common MIL debouncing / group representative for common MIL debouncing of DFC_RBA_IOEXTLIB_KEEPALIVE_INI" VALUE 0x804FA154 Val_Wu16 703.000000000 DFC_Verb 0.00 703.000000000 FORMAT "%13.9" /end CHARACTERISTIC
/begin CHARACTERISTIC DFES_GrpRpr.DFC_rba_IoSigRtc_StopCounter_C "common MIL debouncing / group representative for common MIL debouncing of DFC_rba_IoSigRtc_StopCounter" VALUE 0x804FA156 Val_Wu16 703.000000000 DFC_Verb 0.00 703.000000000 FORMAT "%13.9" /end CHARACTERISTIC
/begin CHARACTERISTIC DFES_GrpRpr.DFC_rba_MRly_Diag_Stk_Event_C "common MIL debouncing / group representative for common MIL debouncing of DFC_rba_MRly_Diag_Stk_Event" VALUE 0x804FA158 Val_Wu16 703.000000000 DFC_Verb 0.00 703.000000000 FORMAT "%13.9" /end CHARACTERISTIC
/begin CHARACTERISTIC DFES_GrpRpr.DFC_rba_MemDiag_MemReadErr_C "common MIL debouncing / group representative for common MIL debouncing of DFC_rba_MemDiag_MemReadErr" VALUE 0x804FA15A Val_Wu16 703.000000000 DFC_Verb 0.00 703.000000000 FORMAT "%13.9" /end CHARACTERISTIC
/begin CHARACTERISTIC DFES_GrpRpr.DFC_rba_MemDiag_MemWrErr_C "common MIL debouncing / group representative for common MIL debouncing of DFC_rba_MemDiag_MemWrErr" VALUE 0x804FA15C Val_Wu16 703.000000000 DFC_Verb 0.00 703.000000000 FORMAT "%13.9" /end CHARACTERISTIC
/begin CHARACTERISTIC DFES_GrpRpr.DFC_rba_SyC_IrrSwOffTrigEngRun_Event_C "common MIL debouncing / group representative for common MIL debouncing of DFC_rba_SyC_IrrSwOffTrigEngRun_Event" VALUE 0x804FA15E Val_Wu16 703.000000000 DFC_Verb 0.00 703.000000000 FORMAT "%13.9" /end CHARACTERISTIC
/begin CHARACTERISTIC DFES_GrpRpr.DFC_rba_T15_Diag_ComInVld_Event_C "common MIL debouncing / group representative for common MIL debouncing of DFC_rba_T15_Diag_ComInVld_Event" VALUE 0x804FA160 Val_Wu16 703.000000000 DFC_Verb 0.00 703.000000000 FORMAT "%13.9" /end CHARACTERISTIC
/begin CHARACTERISTIC DFES_GrpRpr.DFC_rba_T15_Diag_ComOff_HwOn_Event_C "common MIL debouncing / group representative for common MIL debouncing of DFC_rba_T15_Diag_ComOff_HwOn_Event" VALUE 0x804FA162 Val_Wu16 703.000000000 DFC_Verb 0.00 703.000000000 FORMAT "%13.9" /end CHARACTERISTIC
/begin CHARACTERISTIC DFES_GrpRpr.DFC_rba_T15_Diag_ComOn_HwOff_Event_C "common MIL debouncing / group representative for common MIL debouncing of DFC_rba_T15_Diag_ComOn_HwOff_Event" VALUE 0x804FA164 Val_Wu16 703.000000000 DFC_Verb 0.00 703.000000000 FORMAT "%13.9" /end CHARACTERISTIC
/begin CHARACTERISTIC DFES_GrpRpr.DFC_AppAllSnsrDfct_C "common MIL debouncing / group representative for common MIL debouncing of DFC_AppAllSnsrDfct" VALUE 0x804FA166 Val_Wu16 703.000000000 DFC_Verb 0.00 703.000000000 FORMAT "%13.9" /end CHARACTERISTIC
/begin CHARACTERISTIC DFES_GrpRpr.DFC_BattUStdbyDiaOL_C "common MIL debouncing / group representative for common MIL debouncing of DFC_BattUStdbyDiaOL" VALUE 0x804FA168 Val_Wu16 703.000000000 DFC_Verb 0.00 703.000000000 FORMAT "%13.9" /end CHARACTERISTIC
/begin CHARACTERISTIC DFES_GrpRpr.DFC_BigLeakIntkMnfldEmiInfl_C "common MIL debouncing / group representative for common MIL debouncing of DFC_BigLeakIntkMnfldEmiInfl" VALUE 0x804FA16A Val_Wu16 703.000000000 DFC_Verb 0.00 703.000000000 FORMAT "%13.9" /end CHARACTERISTIC
/begin CHARACTERISTIC DFES_GrpRpr.DFC_BrkMnSwtContOnWarnLmp_C "common MIL debouncing / group representative for common MIL debouncing of DFC_BrkMnSwtContOnWarnLmp" VALUE 0x804FA16C Val_Wu16 703.000000000 DFC_Verb 0.00 703.000000000 FORMAT "%13.9" /end CHARACTERISTIC
/begin CHARACTERISTIC DFES_GrpRpr.DFC_BrkMnSwtNotStpWarnLmp_C "common MIL debouncing / group representative for common MIL debouncing of DFC_BrkMnSwtNotStpWarnLmp" VALUE 0x804FA16E Val_Wu16 703.000000000 DFC_Verb 0.00 703.000000000 FORMAT "%13.9" /end CHARACTERISTIC
/begin CHARACTERISTIC DFES_GrpRpr.DFC_BrkRdntSwtContOnWarnLmp_C "common MIL debouncing / group representative for common MIL debouncing of DFC_BrkRdntSwtContOnWarnLmp" VALUE 0x804FA170 Val_Wu16 703.000000000 DFC_Verb 0.00 703.000000000 FORMAT "%13.9" /end CHARACTERISTIC
/begin CHARACTERISTIC DFES_GrpRpr.DFC_BrkRdntSwtNotStpWarnLmp_C "common MIL debouncing / group representative for common MIL debouncing of DFC_BrkRdntSwtNotStpWarnLmp" VALUE 0x804FA172 Val_Wu16 703.000000000 DFC_Verb 0.00 703.000000000 FORMAT "%13.9" /end CHARACTERISTIC
/begin CHARACTERISTIC DFES_GrpRpr.DFC_CEngDsTColdStrtMax_C "common MIL debouncing / group representative for common MIL debouncing of DFC_CEngDsTColdStrtMax" VALUE 0x804FA174 Val_Wu16 703.000000000 DFC_Verb 0.00 703.000000000 FORMAT "%13.9" /end CHARACTERISTIC
/begin CHARACTERISTIC DFES_GrpRpr.DFC_CEngDsTColdStrtMin_C "common MIL debouncing / group representative for common MIL debouncing of DFC_CEngDsTColdStrtMin" VALUE 0x804FA176 Val_Wu16 703.000000000 DFC_Verb 0.00 703.000000000 FORMAT "%13.9" /end CHARACTERISTIC
/begin CHARACTERISTIC DFES_GrpRpr.DFC_CEngDsTImps_C "common MIL debouncing / group representative for common MIL debouncing of DFC_CEngDsTImps" VALUE 0x804FA178 Val_Wu16 703.000000000 DFC_Verb 0.00 703.000000000 FORMAT "%13.9" /end CHARACTERISTIC
/begin CHARACTERISTIC DFES_GrpRpr.DFC_CEngDsTPlausLSC_C "common MIL debouncing / group representative for common MIL debouncing of DFC_CEngDsTPlausLSC" VALUE 0x804FA17A Val_Wu16 703.000000000 DFC_Verb 0.00 703.000000000 FORMAT "%13.9" /end CHARACTERISTIC
/begin CHARACTERISTIC DFES_GrpRpr.DFC_CEngDsTPlausSTC_C "common MIL debouncing / group representative for common MIL debouncing of DFC_CEngDsTPlausSTC" VALUE 0x804FA17C Val_Wu16 703.000000000 DFC_Verb 0.00 703.000000000 FORMAT "%13.9" /end CHARACTERISTIC
/begin CHARACTERISTIC DFES_GrpRpr.DFC_CEngDsTSRCMax_C "common MIL debouncing / group representative for common MIL debouncing of DFC_CEngDsTSRCMax" VALUE 0x804FA17E Val_Wu16 703.000000000 DFC_Verb 0.00 703.000000000 FORMAT "%13.9" /end CHARACTERISTIC
/begin CHARACTERISTIC DFES_GrpRpr.DFC_CEngDsTSRCMin_C "common MIL debouncing / group representative for common MIL debouncing of DFC_CEngDsTSRCMin" VALUE 0x804FA180 Val_Wu16 703.000000000 DFC_Verb 0.00 703.000000000 FORMAT "%13.9" /end CHARACTERISTIC
/begin CHARACTERISTIC DFES_GrpRpr.DFC_CEngDsTSig_C "common MIL debouncing / group representative for common MIL debouncing of DFC_CEngDsTSig" VALUE 0x804FA182 Val_Wu16 703.000000000 DFC_Verb 0.00 703.000000000 FORMAT "%13.9" /end CHARACTERISTIC
/begin CHARACTERISTIC DFES_GrpRpr.DFC_CEngUsTSRCMax_C "common MIL debouncing / group representative for common MIL debouncing of DFC_CEngUsTSRCMax" VALUE 0x804FA184 Val_Wu16 703.000000000 DFC_Verb 0.00 703.000000000 FORMAT "%13.9" /end CHARACTERISTIC
/begin CHARACTERISTIC DFES_GrpRpr.DFC_CEngUsTSRCMin_C "common MIL debouncing / group representative for common MIL debouncing of DFC_CEngUsTSRCMin" VALUE 0x804FA186 Val_Wu16 703.000000000 DFC_Verb 0.00 703.000000000 FORMAT "%13.9" /end CHARACTERISTIC
/begin CHARACTERISTIC DFES_GrpRpr.DFC_DCDCFltDet_C "common MIL debouncing / group representative for common MIL debouncing of DFC_DCDCFltDet" VALUE 0x804FA188 Val_Wu16 703.000000000 DFC_Verb 0.00 703.000000000 FORMAT "%13.9" /end CHARACTERISTIC
/begin CHARACTERISTIC DFES_GrpRpr.DFC_DKRSA_C "common MIL debouncing / group representative for common MIL debouncing of DFC_DKRSA" VALUE 0x804FA18A Val_Wu16 703.000000000 DFC_Verb 0.00 703.000000000 FORMAT "%13.9" /end CHARACTERISTIC
/begin CHARACTERISTIC DFES_GrpRpr.DFC_DKVSmax_C "common MIL debouncing / group representative for common MIL debouncing of DFC_DKVSmax" VALUE 0x804FA18C Val_Wu16 703.000000000 DFC_Verb 0.00 703.000000000 FORMAT "%13.9" /end CHARACTERISTIC
/begin CHARACTERISTIC DFES_GrpRpr.DFC_DKnpl_C "common MIL debouncing / group representative for common MIL debouncing of DFC_DKnpl" VALUE 0x804FA18E Val_Wu16 703.000000000 DFC_Verb 0.00 703.000000000 FORMAT "%13.9" /end CHARACTERISTIC
/begin CHARACTERISTIC DFES_GrpRpr.DFC_DSSmax_C "common MIL debouncing / group representative for common MIL debouncing of DFC_DSSmax" VALUE 0x804FA190 Val_Wu16 703.000000000 DFC_Verb 0.00 703.000000000 FORMAT "%13.9" /end CHARACTERISTIC
/begin CHARACTERISTIC DFES_GrpRpr.DFC_DSTTI_C "common MIL debouncing / group representative for common MIL debouncing of DFC_DSTTI" VALUE 0x804FA192 Val_Wu16 703.000000000 DFC_Verb 0.00 703.000000000 FORMAT "%13.9" /end CHARACTERISTIC
/begin CHARACTERISTIC DFES_GrpRpr.DFC_DSUmax_C "common MIL debouncing / group representative for common MIL debouncing of DFC_DSUmax" VALUE 0x804FA194 Val_Wu16 703.000000000 DFC_Verb 0.00 703.000000000 FORMAT "%13.9" /end CHARACTERISTIC
/begin CHARACTERISTIC DFES_GrpRpr.DFC_EGRVlvOL_C "common MIL debouncing / group representative for common MIL debouncing of DFC_EGRVlvOL" VALUE 0x804FA196 Val_Wu16 703.000000000 DFC_Verb 0.00 703.000000000 FORMAT "%13.9" /end CHARACTERISTIC
/begin CHARACTERISTIC DFES_GrpRpr.DFC_EGRVlvSCB_C "common MIL debouncing / group representative for common MIL debouncing of DFC_EGRVlvSCB" VALUE 0x804FA198 Val_Wu16 703.000000000 DFC_Verb 0.00 703.000000000 FORMAT "%13.9" /end CHARACTERISTIC
/begin CHARACTERISTIC DFES_GrpRpr.DFC_EGRVlvSCG_C "common MIL debouncing / group representative for common MIL debouncing of DFC_EGRVlvSCG" VALUE 0x804FA19A Val_Wu16 703.000000000 DFC_Verb 0.00 703.000000000 FORMAT "%13.9" /end CHARACTERISTIC
/begin CHARACTERISTIC DFES_GrpRpr.DFC_EGSDUS2B1LtrDly_C "common MIL debouncing / group representative for common MIL debouncing of DFC_EGSDUS2B1LtrDly" VALUE 0x804FA19C Val_Wu16 703.000000000 DFC_Verb 0.00 703.000000000 FORMAT "%13.9" /end CHARACTERISTIC
/begin CHARACTERISTIC DFES_GrpRpr.DFC_EGSDUS2B1LtrPT1_C "common MIL debouncing / group representative for common MIL debouncing of DFC_EGSDUS2B1LtrPT1" VALUE 0x804FA19E Val_Wu16 703.000000000 DFC_Verb 0.00 703.000000000 FORMAT "%13.9" /end CHARACTERISTIC
/begin CHARACTERISTIC DFES_GrpRpr.DFC_EGSDUS2B1RtlDly_C "common MIL debouncing / group representative for common MIL debouncing of DFC_EGSDUS2B1RtlDly" VALUE 0x804FA1A0 Val_Wu16 703.000000000 DFC_Verb 0.00 703.000000000 FORMAT "%13.9" /end CHARACTERISTIC
/begin CHARACTERISTIC DFES_GrpRpr.DFC_EGSDUS2B1RtlPT1_C "common MIL debouncing / group representative for common MIL debouncing of DFC_EGSDUS2B1RtlPT1" VALUE 0x804FA1A2 Val_Wu16 703.000000000 DFC_Verb 0.00 703.000000000 FORMAT "%13.9" /end CHARACTERISTIC
/begin CHARACTERISTIC DFES_GrpRpr.DFC_EGSDUS2B1TarLean_C "common MIL debouncing / group representative for common MIL debouncing of DFC_EGSDUS2B1TarLean" VALUE 0x804FA1A4 Val_Wu16 703.000000000 DFC_Verb 0.00 703.000000000 FORMAT "%13.9" /end CHARACTERISTIC
/begin CHARACTERISTIC DFES_GrpRpr.DFC_EGSDUS2B1TarRich_C "common MIL debouncing / group representative for common MIL debouncing of DFC_EGSDUS2B1TarRich" VALUE 0x804FA1A6 Val_Wu16 703.000000000 DFC_Verb 0.00 703.000000000 FORMAT "%13.9" /end CHARACTERISTIC
/begin CHARACTERISTIC DFES_GrpRpr.DFC_ETAKHLmax_C "common MIL debouncing / group representative for common MIL debouncing of DFC_ETAKHLmax" VALUE 0x804FA1A8 Val_Wu16 703.000000000 DFC_Verb 0.00 703.000000000 FORMAT "%13.9" /end CHARACTERISTIC
/begin CHARACTERISTIC DFES_GrpRpr.DFC_ETAKHTmax_C "common MIL debouncing / group representative for common MIL debouncing of DFC_ETAKHTmax" VALUE 0x804FA1AA Val_Wu16 703.000000000 DFC_Verb 0.00 703.000000000 FORMAT "%13.9" /end CHARACTERISTIC
/begin CHARACTERISTIC DFES_GrpRpr.DFC_EngICO_C "common MIL debouncing / group representative for common MIL debouncing of DFC_EngICO" VALUE 0x804FA1AC Val_Wu16 703.000000000 DFC_Verb 0.00 703.000000000 FORMAT "%13.9" /end CHARACTERISTIC
/begin CHARACTERISTIC DFES_GrpRpr.DFC_EngPrtOvrSpdMon_C "common MIL debouncing / group representative for common MIL debouncing of DFC_EngPrtOvrSpdMon" VALUE 0x804FA1AE Val_Wu16 703.000000000 DFC_Verb 0.00 703.000000000 FORMAT "%13.9" /end CHARACTERISTIC
/begin CHARACTERISTIC DFES_GrpRpr.DFC_EpmCaSI1ErrSig_C "common MIL debouncing / group representative for common MIL debouncing of DFC_EpmCaSI1ErrSig" VALUE 0x804FA1B0 Val_Wu16 703.000000000 DFC_Verb 0.00 703.000000000 FORMAT "%13.9" /end CHARACTERISTIC
/begin CHARACTERISTIC DFES_GrpRpr.DFC_EpmCaSI1NoSig_C "common MIL debouncing / group representative for common MIL debouncing of DFC_EpmCaSI1NoSig" VALUE 0x804FA1B2 Val_Wu16 703.000000000 DFC_Verb 0.00 703.000000000 FORMAT "%13.9" /end CHARACTERISTIC
/begin CHARACTERISTIC DFES_GrpRpr.DFC_EpmCaSI1OfsErr_C "common MIL debouncing / group representative for common MIL debouncing of DFC_EpmCaSI1OfsErr" VALUE 0x804FA1B4 Val_Wu16 703.000000000 DFC_Verb 0.00 703.000000000 FORMAT "%13.9" /end CHARACTERISTIC
/begin CHARACTERISTIC DFES_GrpRpr.DFC_EpmCrSErrSig_C "common MIL debouncing / group representative for common MIL debouncing of DFC_EpmCrSErrSig" VALUE 0x804FA1B6 Val_Wu16 703.000000000 DFC_Verb 0.00 703.000000000 FORMAT "%13.9" /end CHARACTERISTIC
/begin CHARACTERISTIC DFES_GrpRpr.DFC_EpmCrSNoSig_C "common MIL debouncing / group representative for common MIL debouncing of DFC_EpmCrSNoSig" VALUE 0x804FA1B8 Val_Wu16 703.000000000 DFC_Verb 0.00 703.000000000 FORMAT "%13.9" /end CHARACTERISTIC
/begin CHARACTERISTIC DFES_GrpRpr.DFC_EtaEngIdleNonCsers_C "common MIL debouncing / group representative for common MIL debouncing of DFC_EtaEngIdleNonCsers" VALUE 0x804FA1BA Val_Wu16 703.000000000 DFC_Verb 0.00 703.000000000 FORMAT "%13.9" /end CHARACTERISTIC
/begin CHARACTERISTIC DFES_GrpRpr.DFC_EtaEngPtlNonCsers_C "common MIL debouncing / group representative for common MIL debouncing of DFC_EtaEngPtlNonCsers" VALUE 0x804FA1BC Val_Wu16 703.000000000 DFC_Verb 0.00 703.000000000 FORMAT "%13.9" /end CHARACTERISTIC
/begin CHARACTERISTIC DFES_GrpRpr.DFC_FRAmax_C "common MIL debouncing / group representative for common MIL debouncing of DFC_FRAmax" VALUE 0x804FA1BE Val_Wu16 703.000000000 DFC_Verb 0.00 703.000000000 FORMAT "%13.9" /end CHARACTERISTIC
/begin CHARACTERISTIC DFES_GrpRpr.DFC_FRAmin_C "common MIL debouncing / group representative for common MIL debouncing of DFC_FRAmin" VALUE 0x804FA1C0 Val_Wu16 703.000000000 DFC_Verb 0.00 703.000000000 FORMAT "%13.9" /end CHARACTERISTIC
/begin CHARACTERISTIC DFES_GrpRpr.DFC_GbxRvsSwtStk_C "common MIL debouncing / group representative for common MIL debouncing of DFC_GbxRvsSwtStk" VALUE 0x804FA1C2 Val_Wu16 703.000000000 DFC_Verb 0.00 703.000000000 FORMAT "%13.9" /end CHARACTERISTIC
/begin CHARACTERISTIC DFES_GrpRpr.DFC_HDRmax_C "common MIL debouncing / group representative for common MIL debouncing of DFC_HDRmax" VALUE 0x804FA1C4 Val_Wu16 703.000000000 DFC_Verb 0.00 703.000000000 FORMAT "%13.9" /end CHARACTERISTIC
/begin CHARACTERISTIC DFES_GrpRpr.DFC_HEGOS2B1ElecMax_C "common MIL debouncing / group representative for common MIL debouncing of DFC_HEGOS2B1ElecMax" VALUE 0x804FA1C6 Val_Wu16 703.000000000 DFC_Verb 0.00 703.000000000 FORMAT "%13.9" /end CHARACTERISTIC
/begin CHARACTERISTIC DFES_GrpRpr.DFC_HEGOS2B1ElecMin_C "common MIL debouncing / group representative for common MIL debouncing of DFC_HEGOS2B1ElecMin" VALUE 0x804FA1C8 Val_Wu16 703.000000000 DFC_Verb 0.00 703.000000000 FORMAT "%13.9" /end CHARACTERISTIC
/begin CHARACTERISTIC DFES_GrpRpr.DFC_HEGOS2B1ElecSig_C "common MIL debouncing / group representative for common MIL debouncing of DFC_HEGOS2B1ElecSig" VALUE 0x804FA1CA Val_Wu16 703.000000000 DFC_Verb 0.00 703.000000000 FORMAT "%13.9" /end CHARACTERISTIC
/begin CHARACTERISTIC DFES_GrpRpr.DFC_HEGOS2B1HtgNpl_C "common MIL debouncing / group representative for common MIL debouncing of DFC_HEGOS2B1HtgNpl" VALUE 0x804FA1CC Val_Wu16 703.000000000 DFC_Verb 0.00 703.000000000 FORMAT "%13.9" /end CHARACTERISTIC
/begin CHARACTERISTIC DFES_GrpRpr.DFC_IntkAirTIntkMnfldCrssMax_C "common MIL debouncing / group representative for common MIL debouncing of DFC_IntkAirTIntkMnfldCrssMax" VALUE 0x804FA1CE Val_Wu16 703.000000000 DFC_Verb 0.00 703.000000000 FORMAT "%13.9" /end CHARACTERISTIC
/begin CHARACTERISTIC DFES_GrpRpr.DFC_IntkAirTIntkMnfldCrssMin_C "common MIL debouncing / group representative for common MIL debouncing of DFC_IntkAirTIntkMnfldCrssMin" VALUE 0x804FA1D0 Val_Wu16 703.000000000 DFC_Verb 0.00 703.000000000 FORMAT "%13.9" /end CHARACTERISTIC
/begin CHARACTERISTIC DFES_GrpRpr.DFC_IntkAirTIntkMnfldHSCMax_C "common MIL debouncing / group representative for common MIL debouncing of DFC_IntkAirTIntkMnfldHSCMax" VALUE 0x804FA1D2 Val_Wu16 703.000000000 DFC_Verb 0.00 703.000000000 FORMAT "%13.9" /end CHARACTERISTIC
/begin CHARACTERISTIC DFES_GrpRpr.DFC_IntkAirTIntkMnfldImps_C "common MIL debouncing / group representative for common MIL debouncing of DFC_IntkAirTIntkMnfldImps" VALUE 0x804FA1D4 Val_Wu16 703.000000000 DFC_Verb 0.00 703.000000000 FORMAT "%13.9" /end CHARACTERISTIC
/begin CHARACTERISTIC DFES_GrpRpr.DFC_IntkAirTIntkMnfldPRCMax_C "common MIL debouncing / group representative for common MIL debouncing of DFC_IntkAirTIntkMnfldPRCMax" VALUE 0x804FA1D6 Val_Wu16 703.000000000 DFC_Verb 0.00 703.000000000 FORMAT "%13.9" /end CHARACTERISTIC
/begin CHARACTERISTIC DFES_GrpRpr.DFC_IntkAirTIntkMnfldPRCMin_C "common MIL debouncing / group representative for common MIL debouncing of DFC_IntkAirTIntkMnfldPRCMin" VALUE 0x804FA1D8 Val_Wu16 703.000000000 DFC_Verb 0.00 703.000000000 FORMAT "%13.9" /end CHARACTERISTIC
/begin CHARACTERISTIC DFES_GrpRpr.DFC_IntkAirTIntkMnfldSRCMax_C "common MIL debouncing / group representative for common MIL debouncing of DFC_IntkAirTIntkMnfldSRCMax" VALUE 0x804FA1DA Val_Wu16 703.000000000 DFC_Verb 0.00 703.000000000 FORMAT "%13.9" /end CHARACTERISTIC
/begin CHARACTERISTIC DFES_GrpRpr.DFC_IntkAirTIntkMnfldSRCMin_C "common MIL debouncing / group representative for common MIL debouncing of DFC_IntkAirTIntkMnfldSRCMin" VALUE 0x804FA1DC Val_Wu16 703.000000000 DFC_Verb 0.00 703.000000000 FORMAT "%13.9" /end CHARACTERISTIC
/begin CHARACTERISTIC DFES_GrpRpr.DFC_IntkAirTIntkMnfldSTC_C "common MIL debouncing / group representative for common MIL debouncing of DFC_IntkAirTIntkMnfldSTC" VALUE 0x804FA1DE Val_Wu16 703.000000000 DFC_Verb 0.00 703.000000000 FORMAT "%13.9" /end CHARACTERISTIC
/begin CHARACTERISTIC DFES_GrpRpr.DFC_KS1max_C "common MIL debouncing / group representative for common MIL debouncing of DFC_KS1max" VALUE 0x804FA1E0 Val_Wu16 703.000000000 DFC_Verb 0.00 703.000000000 FORMAT "%13.9" /end CHARACTERISTIC
/begin CHARACTERISTIC DFES_GrpRpr.DFC_KS1min_C "common MIL debouncing / group representative for common MIL debouncing of DFC_KS1min" VALUE 0x804FA1E2 Val_Wu16 703.000000000 DFC_Verb 0.00 703.000000000 FORMAT "%13.9" /end CHARACTERISTIC
/begin CHARACTERISTIC DFES_GrpRpr.DFC_LMmax_C "common MIL debouncing / group representative for common MIL debouncing of DFC_LMmax" VALUE 0x804FA1E4 Val_Wu16 703.000000000 DFC_Verb 0.00 703.000000000 FORMAT "%13.9" /end CHARACTERISTIC
/begin CHARACTERISTIC DFES_GrpRpr.DFC_LZSRnpl_C "common MIL debouncing / group representative for common MIL debouncing of DFC_LZSRnpl" VALUE 0x804FA1E6 Val_Wu16 703.000000000 DFC_Verb 0.00 703.000000000 FORMAT "%13.9" /end CHARACTERISTIC
/begin CHARACTERISTIC DFES_GrpRpr.DFC_LamDynDiagS1B1_C "common MIL debouncing / group representative for common MIL debouncing of DFC_LamDynDiagS1B1" VALUE 0x804FA1E8 Val_Wu16 703.000000000 DFC_Verb 0.00 703.000000000 FORMAT "%13.9" /end CHARACTERISTIC
/begin CHARACTERISTIC DFES_GrpRpr.DFC_LeakIntkMnfldEmiInfl_C "common MIL debouncing / group representative for common MIL debouncing of DFC_LeakIntkMnfldEmiInfl" VALUE 0x804FA1EA Val_Wu16 703.000000000 DFC_Verb 0.00 703.000000000 FORMAT "%13.9" /end CHARACTERISTIC
/begin CHARACTERISTIC DFES_GrpRpr.DFC_MD00max_C "common MIL debouncing / group representative for common MIL debouncing of DFC_MD00max" VALUE 0x804FA1EC Val_Wu16 703.000000000 DFC_Verb 0.00 703.000000000 FORMAT "%13.9" /end CHARACTERISTIC
/begin CHARACTERISTIC DFES_GrpRpr.DFC_MDBmax_C "common MIL debouncing / group representative for common MIL debouncing of DFC_MDBmax" VALUE 0x804FA1EE Val_Wu16 703.000000000 DFC_Verb 0.00 703.000000000 FORMAT "%13.9" /end CHARACTERISTIC
/begin CHARACTERISTIC DFES_GrpRpr.DFC_MDCat_C "common MIL debouncing / group representative for common MIL debouncing of DFC_MDCat" VALUE 0x804FA1F0 Val_Wu16 703.000000000 DFC_Verb 0.00 703.000000000 FORMAT "%13.9" /end CHARACTERISTIC
/begin CHARACTERISTIC DFES_GrpRpr.DFC_MDCatCrit_C "common MIL debouncing / group representative for common MIL debouncing of DFC_MDCatCrit" VALUE 0x804FA1F2 Val_Wu16 703.000000000 DFC_Verb 0.00 703.000000000 FORMAT "%13.9" /end CHARACTERISTIC
/begin CHARACTERISTIC DFES_GrpRpr.DFC_MDCatCurr_C "common MIL debouncing / group representative for common MIL debouncing of DFC_MDCatCurr" VALUE 0x804FA1F4 Val_Wu16 703.000000000 DFC_Verb 0.00 703.000000000 FORMAT "%13.9" /end CHARACTERISTIC
/begin CHARACTERISTIC DFES_GrpRpr.DFC_MDCyl_0_C "common MIL debouncing / group representative for common MIL debouncing of DFC_MDCyl_0" VALUE 0x804FA1F6 Val_Wu16 703.000000000 DFC_Verb 0.00 703.000000000 FORMAT "%13.9" /end CHARACTERISTIC
/begin CHARACTERISTIC DFES_GrpRpr.DFC_MDCyl_1_C "common MIL debouncing / group representative for common MIL debouncing of DFC_MDCyl_1" VALUE 0x804FA1F8 Val_Wu16 703.000000000 DFC_Verb 0.00 703.000000000 FORMAT "%13.9" /end CHARACTERISTIC
/begin CHARACTERISTIC DFES_GrpRpr.DFC_MDCyl_2_C "common MIL debouncing / group representative for common MIL debouncing of DFC_MDCyl_2" VALUE 0x804FA1FA Val_Wu16 703.000000000 DFC_Verb 0.00 703.000000000 FORMAT "%13.9" /end CHARACTERISTIC
/begin CHARACTERISTIC DFES_GrpRpr.DFC_MDCyl_3_C "common MIL debouncing / group representative for common MIL debouncing of DFC_MDCyl_3" VALUE 0x804FA1FC Val_Wu16 703.000000000 DFC_Verb 0.00 703.000000000 FORMAT "%13.9" /end CHARACTERISTIC
/begin CHARACTERISTIC DFES_GrpRpr.DFC_MDEmi_C "common MIL debouncing / group representative for common MIL debouncing of DFC_MDEmi" VALUE 0x804FA1FE Val_Wu16 703.000000000 DFC_Verb 0.00 703.000000000 FORMAT "%13.9" /end CHARACTERISTIC
/begin CHARACTERISTIC DFES_GrpRpr.DFC_MDEmiStrt_C "common MIL debouncing / group representative for common MIL debouncing of DFC_MDEmiStrt" VALUE 0x804FA200 Val_Wu16 703.000000000 DFC_Verb 0.00 703.000000000 FORMAT "%13.9" /end CHARACTERISTIC
/begin CHARACTERISTIC DFES_GrpRpr.DFC_MDFco_C "common MIL debouncing / group representative for common MIL debouncing of DFC_MDFco" VALUE 0x804FA202 Val_Wu16 703.000000000 DFC_Verb 0.00 703.000000000 FORMAT "%13.9" /end CHARACTERISTIC
/begin CHARACTERISTIC DFES_GrpRpr.DFC_MDMpl_C "common MIL debouncing / group representative for common MIL debouncing of DFC_MDMpl" VALUE 0x804FA204 Val_Wu16 703.000000000 DFC_Verb 0.00 703.000000000 FORMAT "%13.9" /end CHARACTERISTIC
/begin CHARACTERISTIC DFES_GrpRpr.DFC_MDSegTiAdpn_C "common MIL debouncing / group representative for common MIL debouncing of DFC_MDSegTiAdpn" VALUE 0x804FA206 Val_Wu16 703.000000000 DFC_Verb 0.00 703.000000000 FORMAT "%13.9" /end CHARACTERISTIC
/begin CHARACTERISTIC DFES_GrpRpr.DFC_MDmax_C "common MIL debouncing / group representative for common MIL debouncing of DFC_MDmax" VALUE 0x804FA208 Val_Wu16 703.000000000 DFC_Verb 0.00 703.000000000 FORMAT "%13.9" /end CHARACTERISTIC
/begin CHARACTERISTIC DFES_GrpRpr.DFC_MOXEMM_SMU_ALM0_0_C "common MIL debouncing / group representative for common MIL debouncing of DFC_MOXEMM_SMU_ALM0_0" VALUE 0x804FA20A Val_Wu16 703.000000000 DFC_Verb 0.00 703.000000000 FORMAT "%13.9" /end CHARACTERISTIC
/begin CHARACTERISTIC DFES_GrpRpr.DFC_MOXEMM_SMU_ALM0_1_C "common MIL debouncing / group representative for common MIL debouncing of DFC_MOXEMM_SMU_ALM0_1" VALUE 0x804FA20C Val_Wu16 703.000000000 DFC_Verb 0.00 703.000000000 FORMAT "%13.9" /end CHARACTERISTIC
/begin CHARACTERISTIC DFES_GrpRpr.DFC_MOXEMM_SMU_ALM0_10_C "common MIL debouncing / group representative for common MIL debouncing of DFC_MOXEMM_SMU_ALM0_10" VALUE 0x804FA20E Val_Wu16 703.000000000 DFC_Verb 0.00 703.000000000 FORMAT "%13.9" /end CHARACTERISTIC
/begin CHARACTERISTIC DFES_GrpRpr.DFC_MOXEMM_SMU_ALM0_11_C "common MIL debouncing / group representative for common MIL debouncing of DFC_MOXEMM_SMU_ALM0_11" VALUE 0x804FA210 Val_Wu16 703.000000000 DFC_Verb 0.00 703.000000000 FORMAT "%13.9" /end CHARACTERISTIC
/begin CHARACTERISTIC DFES_GrpRpr.DFC_MOXEMM_SMU_ALM0_13_C "common MIL debouncing / group representative for common MIL debouncing of DFC_MOXEMM_SMU_ALM0_13" VALUE 0x804FA212 Val_Wu16 703.000000000 DFC_Verb 0.00 703.000000000 FORMAT "%13.9" /end CHARACTERISTIC
/begin CHARACTERISTIC DFES_GrpRpr.DFC_MOXEMM_SMU_ALM0_14_C "common MIL debouncing / group representative for common MIL debouncing of DFC_MOXEMM_SMU_ALM0_14" VALUE 0x804FA214 Val_Wu16 703.000000000 DFC_Verb 0.00 703.000000000 FORMAT "%13.9" /end CHARACTERISTIC
/begin CHARACTERISTIC DFES_GrpRpr.DFC_MOXEMM_SMU_ALM0_2_C "common MIL debouncing / group representative for common MIL debouncing of DFC_MOXEMM_SMU_ALM0_2" VALUE 0x804FA216 Val_Wu16 703.000000000 DFC_Verb 0.00 703.000000000 FORMAT "%13.9" /end CHARACTERISTIC
/begin CHARACTERISTIC DFES_GrpRpr.DFC_MOXEMM_SMU_ALM0_22_C "common MIL debouncing / group representative for common MIL debouncing of DFC_MOXEMM_SMU_ALM0_22" VALUE 0x804FA218 Val_Wu16 703.000000000 DFC_Verb 0.00 703.000000000 FORMAT "%13.9" /end CHARACTERISTIC
/begin CHARACTERISTIC DFES_GrpRpr.DFC_MOXEMM_SMU_ALM0_23_C "common MIL debouncing / group representative for common MIL debouncing of DFC_MOXEMM_SMU_ALM0_23" VALUE 0x804FA21A Val_Wu16 703.000000000 DFC_Verb 0.00 703.000000000 FORMAT "%13.9" /end CHARACTERISTIC
/begin CHARACTERISTIC DFES_GrpRpr.DFC_MOXEMM_SMU_ALM0_4_C "common MIL debouncing / group representative for common MIL debouncing of DFC_MOXEMM_SMU_ALM0_4" VALUE 0x804FA21C Val_Wu16 703.000000000 DFC_Verb 0.00 703.000000000 FORMAT "%13.9" /end CHARACTERISTIC
/begin CHARACTERISTIC DFES_GrpRpr.DFC_MOXEMM_SMU_ALM0_5_C "common MIL debouncing / group representative for common MIL debouncing of DFC_MOXEMM_SMU_ALM0_5" VALUE 0x804FA21E Val_Wu16 703.000000000 DFC_Verb 0.00 703.000000000 FORMAT "%13.9" /end CHARACTERISTIC
/begin CHARACTERISTIC DFES_GrpRpr.DFC_MOXEMM_SMU_ALM0_7_C "common MIL debouncing / group representative for common MIL debouncing of DFC_MOXEMM_SMU_ALM0_7" VALUE 0x804FA220 Val_Wu16 703.000000000 DFC_Verb 0.00 703.000000000 FORMAT "%13.9" /end CHARACTERISTIC
/begin CHARACTERISTIC DFES_GrpRpr.DFC_MOXEMM_SMU_ALM0_8_C "common MIL debouncing / group representative for common MIL debouncing of DFC_MOXEMM_SMU_ALM0_8" VALUE 0x804FA222 Val_Wu16 703.000000000 DFC_Verb 0.00 703.000000000 FORMAT "%13.9" /end CHARACTERISTIC
/begin CHARACTERISTIC DFES_GrpRpr.DFC_MOXEMM_SMU_ALM10_16_C "common MIL debouncing / group representative for common MIL debouncing of DFC_MOXEMM_SMU_ALM10_16" VALUE 0x804FA224 Val_Wu16 703.000000000 DFC_Verb 0.00 703.000000000 FORMAT "%13.9" /end CHARACTERISTIC
/begin CHARACTERISTIC DFES_GrpRpr.DFC_MOXEMM_SMU_ALM10_17_C "common MIL debouncing / group representative for common MIL debouncing of DFC_MOXEMM_SMU_ALM10_17" VALUE 0x804FA226 Val_Wu16 703.000000000 DFC_Verb 0.00 703.000000000 FORMAT "%13.9" /end CHARACTERISTIC
/begin CHARACTERISTIC DFES_GrpRpr.DFC_MOXEMM_SMU_ALM10_21_C "common MIL debouncing / group representative for common MIL debouncing of DFC_MOXEMM_SMU_ALM10_21" VALUE 0x804FA228 Val_Wu16 703.000000000 DFC_Verb 0.00 703.000000000 FORMAT "%13.9" /end CHARACTERISTIC
/begin CHARACTERISTIC DFES_GrpRpr.DFC_MOXEMM_SMU_ALM11_0_C "common MIL debouncing / group representative for common MIL debouncing of DFC_MOXEMM_SMU_ALM11_0" VALUE 0x804FA22A Val_Wu16 703.000000000 DFC_Verb 0.00 703.000000000 FORMAT "%13.9" /end CHARACTERISTIC
/begin CHARACTERISTIC DFES_GrpRpr.DFC_MOXEMM_SMU_ALM11_1_C "common MIL debouncing / group representative for common MIL debouncing of DFC_MOXEMM_SMU_ALM11_1" VALUE 0x804FA22C Val_Wu16 703.000000000 DFC_Verb 0.00 703.000000000 FORMAT "%13.9" /end CHARACTERISTIC
/begin CHARACTERISTIC DFES_GrpRpr.DFC_MOXEMM_SMU_ALM11_2_C "common MIL debouncing / group representative for common MIL debouncing of DFC_MOXEMM_SMU_ALM11_2" VALUE 0x804FA22E Val_Wu16 703.000000000 DFC_Verb 0.00 703.000000000 FORMAT "%13.9" /end CHARACTERISTIC
/begin CHARACTERISTIC DFES_GrpRpr.DFC_MOXEMM_SMU_ALM11_3_C "common MIL debouncing / group representative for common MIL debouncing of DFC_MOXEMM_SMU_ALM11_3" VALUE 0x804FA230 Val_Wu16 703.000000000 DFC_Verb 0.00 703.000000000 FORMAT "%13.9" /end CHARACTERISTIC
/begin CHARACTERISTIC DFES_GrpRpr.DFC_MOXEMM_SMU_ALM11_4_C "common MIL debouncing / group representative for common MIL debouncing of DFC_MOXEMM_SMU_ALM11_4" VALUE 0x804FA232 Val_Wu16 703.000000000 DFC_Verb 0.00 703.000000000 FORMAT "%13.9" /end CHARACTERISTIC
/begin CHARACTERISTIC DFES_GrpRpr.DFC_MOXEMM_SMU_ALM11_5_C "common MIL debouncing / group representative for common MIL debouncing of DFC_MOXEMM_SMU_ALM11_5" VALUE 0x804FA234 Val_Wu16 703.000000000 DFC_Verb 0.00 703.000000000 FORMAT "%13.9" /end CHARACTERISTIC
/begin CHARACTERISTIC DFES_GrpRpr.DFC_MOXEMM_SMU_ALM11_8_C "common MIL debouncing / group representative for common MIL debouncing of DFC_MOXEMM_SMU_ALM11_8" VALUE 0x804FA236 Val_Wu16 703.000000000 DFC_Verb 0.00 703.000000000 FORMAT "%13.9" /end CHARACTERISTIC
/begin CHARACTERISTIC DFES_GrpRpr.DFC_MOXEMM_SMU_ALM11_9_C "common MIL debouncing / group representative for common MIL debouncing of DFC_MOXEMM_SMU_ALM11_9" VALUE 0x804FA238 Val_Wu16 703.000000000 DFC_Verb 0.00 703.000000000 FORMAT "%13.9" /end CHARACTERISTIC
/begin CHARACTERISTIC DFES_GrpRpr.DFC_MOXEMM_SMU_ALM1_0_C "common MIL debouncing / group representative for common MIL debouncing of DFC_MOXEMM_SMU_ALM1_0" VALUE 0x804FA23A Val_Wu16 703.000000000 DFC_Verb 0.00 703.000000000 FORMAT "%13.9" /end CHARACTERISTIC
/begin CHARACTERISTIC DFES_GrpRpr.DFC_MOXEMM_SMU_ALM1_1_C "common MIL debouncing / group representative for common MIL debouncing of DFC_MOXEMM_SMU_ALM1_1" VALUE 0x804FA23C Val_Wu16 703.000000000 DFC_Verb 0.00 703.000000000 FORMAT "%13.9" /end CHARACTERISTIC
/begin CHARACTERISTIC DFES_GrpRpr.DFC_MOXEMM_SMU_ALM1_10_C "common MIL debouncing / group representative for common MIL debouncing of DFC_MOXEMM_SMU_ALM1_10" VALUE 0x804FA23E Val_Wu16 703.000000000 DFC_Verb 0.00 703.000000000 FORMAT "%13.9" /end CHARACTERISTIC
/begin CHARACTERISTIC DFES_GrpRpr.DFC_MOXEMM_SMU_ALM1_11_C "common MIL debouncing / group representative for common MIL debouncing of DFC_MOXEMM_SMU_ALM1_11" VALUE 0x804FA240 Val_Wu16 703.000000000 DFC_Verb 0.00 703.000000000 FORMAT "%13.9" /end CHARACTERISTIC
/begin CHARACTERISTIC DFES_GrpRpr.DFC_MOXEMM_SMU_ALM1_13_C "common MIL debouncing / group representative for common MIL debouncing of DFC_MOXEMM_SMU_ALM1_13" VALUE 0x804FA242 Val_Wu16 703.000000000 DFC_Verb 0.00 703.000000000 FORMAT "%13.9" /end CHARACTERISTIC
/begin CHARACTERISTIC DFES_GrpRpr.DFC_MOXEMM_SMU_ALM1_14_C "common MIL debouncing / group representative for common MIL debouncing of DFC_MOXEMM_SMU_ALM1_14" VALUE 0x804FA244 Val_Wu16 703.000000000 DFC_Verb 0.00 703.000000000 FORMAT "%13.9" /end CHARACTERISTIC
/begin CHARACTERISTIC DFES_GrpRpr.DFC_MOXEMM_SMU_ALM1_2_C "common MIL debouncing / group representative for common MIL debouncing of DFC_MOXEMM_SMU_ALM1_2" VALUE 0x804FA246 Val_Wu16 703.000000000 DFC_Verb 0.00 703.000000000 FORMAT "%13.9" /end CHARACTERISTIC
/begin CHARACTERISTIC DFES_GrpRpr.DFC_MOXEMM_SMU_ALM1_22_C "common MIL debouncing / group representative for common MIL debouncing of DFC_MOXEMM_SMU_ALM1_22" VALUE 0x804FA248 Val_Wu16 703.000000000 DFC_Verb 0.00 703.000000000 FORMAT "%13.9" /end CHARACTERISTIC
/begin CHARACTERISTIC DFES_GrpRpr.DFC_MOXEMM_SMU_ALM1_23_C "common MIL debouncing / group representative for common MIL debouncing of DFC_MOXEMM_SMU_ALM1_23" VALUE 0x804FA24A Val_Wu16 703.000000000 DFC_Verb 0.00 703.000000000 FORMAT "%13.9" /end CHARACTERISTIC
/begin CHARACTERISTIC DFES_GrpRpr.DFC_MOXEMM_SMU_ALM1_4_C "common MIL debouncing / group representative for common MIL debouncing of DFC_MOXEMM_SMU_ALM1_4" VALUE 0x804FA24C Val_Wu16 703.000000000 DFC_Verb 0.00 703.000000000 FORMAT "%13.9" /end CHARACTERISTIC
/begin CHARACTERISTIC DFES_GrpRpr.DFC_MOXEMM_SMU_ALM1_5_C "common MIL debouncing / group representative for common MIL debouncing of DFC_MOXEMM_SMU_ALM1_5" VALUE 0x804FA24E Val_Wu16 703.000000000 DFC_Verb 0.00 703.000000000 FORMAT "%13.9" /end CHARACTERISTIC
/begin CHARACTERISTIC DFES_GrpRpr.DFC_MOXEMM_SMU_ALM1_7_C "common MIL debouncing / group representative for common MIL debouncing of DFC_MOXEMM_SMU_ALM1_7" VALUE 0x804FA250 Val_Wu16 703.000000000 DFC_Verb 0.00 703.000000000 FORMAT "%13.9" /end CHARACTERISTIC
/begin CHARACTERISTIC DFES_GrpRpr.DFC_MOXEMM_SMU_ALM1_8_C "common MIL debouncing / group representative for common MIL debouncing of DFC_MOXEMM_SMU_ALM1_8" VALUE 0x804FA252 Val_Wu16 703.000000000 DFC_Verb 0.00 703.000000000 FORMAT "%13.9" /end CHARACTERISTIC
/begin CHARACTERISTIC DFES_GrpRpr.DFC_MOXEMM_SMU_ALM21_0_C "common MIL debouncing / group representative for common MIL debouncing of DFC_MOXEMM_SMU_ALM21_0" VALUE 0x804FA254 Val_Wu16 703.000000000 DFC_Verb 0.00 703.000000000 FORMAT "%13.9" /end CHARACTERISTIC
/begin CHARACTERISTIC DFES_GrpRpr.DFC_MOXEMM_SMU_ALM21_16_C "common MIL debouncing / group representative for common MIL debouncing of DFC_MOXEMM_SMU_ALM21_16" VALUE 0x804FA256 Val_Wu16 703.000000000 DFC_Verb 0.00 703.000000000 FORMAT "%13.9" /end CHARACTERISTIC
/begin CHARACTERISTIC DFES_GrpRpr.DFC_MOXEMM_SMU_ALM21_3_C "common MIL debouncing / group representative for common MIL debouncing of DFC_MOXEMM_SMU_ALM21_3" VALUE 0x804FA258 Val_Wu16 703.000000000 DFC_Verb 0.00 703.000000000 FORMAT "%13.9" /end CHARACTERISTIC
/begin CHARACTERISTIC DFES_GrpRpr.DFC_MOXEMM_SMU_ALM2_1_C "common MIL debouncing / group representative for common MIL debouncing of DFC_MOXEMM_SMU_ALM2_1" VALUE 0x804FA25A Val_Wu16 703.000000000 DFC_Verb 0.00 703.000000000 FORMAT "%13.9" /end CHARACTERISTIC
/begin CHARACTERISTIC DFES_GrpRpr.DFC_MOXEMM_SMU_ALM2_10_C "common MIL debouncing / group representative for common MIL debouncing of DFC_MOXEMM_SMU_ALM2_10" VALUE 0x804FA25C Val_Wu16 703.000000000 DFC_Verb 0.00 703.000000000 FORMAT "%13.9" /end CHARACTERISTIC
/begin CHARACTERISTIC DFES_GrpRpr.DFC_MOXEMM_SMU_ALM2_11_C "common MIL debouncing / group representative for common MIL debouncing of DFC_MOXEMM_SMU_ALM2_11" VALUE 0x804FA25E Val_Wu16 703.000000000 DFC_Verb 0.00 703.000000000 FORMAT "%13.9" /end CHARACTERISTIC
/begin CHARACTERISTIC DFES_GrpRpr.DFC_MOXEMM_SMU_ALM2_13_C "common MIL debouncing / group representative for common MIL debouncing of DFC_MOXEMM_SMU_ALM2_13" VALUE 0x804FA260 Val_Wu16 703.000000000 DFC_Verb 0.00 703.000000000 FORMAT "%13.9" /end CHARACTERISTIC
/begin CHARACTERISTIC DFES_GrpRpr.DFC_MOXEMM_SMU_ALM2_14_C "common MIL debouncing / group representative for common MIL debouncing of DFC_MOXEMM_SMU_ALM2_14" VALUE 0x804FA262 Val_Wu16 703.000000000 DFC_Verb 0.00 703.000000000 FORMAT "%13.9" /end CHARACTERISTIC
/begin CHARACTERISTIC DFES_GrpRpr.DFC_MOXEMM_SMU_ALM2_22_C "common MIL debouncing / group representative for common MIL debouncing of DFC_MOXEMM_SMU_ALM2_22" VALUE 0x804FA264 Val_Wu16 703.000000000 DFC_Verb 0.00 703.000000000 FORMAT "%13.9" /end CHARACTERISTIC
/begin CHARACTERISTIC DFES_GrpRpr.DFC_MOXEMM_SMU_ALM2_23_C "common MIL debouncing / group representative for common MIL debouncing of DFC_MOXEMM_SMU_ALM2_23" VALUE 0x804FA266 Val_Wu16 703.000000000 DFC_Verb 0.00 703.000000000 FORMAT "%13.9" /end CHARACTERISTIC
/begin CHARACTERISTIC DFES_GrpRpr.DFC_MOXEMM_SMU_ALM2_4_C "common MIL debouncing / group representative for common MIL debouncing of DFC_MOXEMM_SMU_ALM2_4" VALUE 0x804FA268 Val_Wu16 703.000000000 DFC_Verb 0.00 703.000000000 FORMAT "%13.9" /end CHARACTERISTIC
/begin CHARACTERISTIC DFES_GrpRpr.DFC_MOXEMM_SMU_ALM2_5_C "common MIL debouncing / group representative for common MIL debouncing of DFC_MOXEMM_SMU_ALM2_5" VALUE 0x804FA26A Val_Wu16 703.000000000 DFC_Verb 0.00 703.000000000 FORMAT "%13.9" /end CHARACTERISTIC
/begin CHARACTERISTIC DFES_GrpRpr.DFC_MOXEMM_SMU_ALM2_7_C "common MIL debouncing / group representative for common MIL debouncing of DFC_MOXEMM_SMU_ALM2_7" VALUE 0x804FA26C Val_Wu16 703.000000000 DFC_Verb 0.00 703.000000000 FORMAT "%13.9" /end CHARACTERISTIC
/begin CHARACTERISTIC DFES_GrpRpr.DFC_MOXEMM_SMU_ALM2_8_C "common MIL debouncing / group representative for common MIL debouncing of DFC_MOXEMM_SMU_ALM2_8" VALUE 0x804FA26E Val_Wu16 703.000000000 DFC_Verb 0.00 703.000000000 FORMAT "%13.9" /end CHARACTERISTIC
/begin CHARACTERISTIC DFES_GrpRpr.DFC_MOXEMM_SMU_ALM6_0_C "common MIL debouncing / group representative for common MIL debouncing of DFC_MOXEMM_SMU_ALM6_0" VALUE 0x804FA270 Val_Wu16 703.000000000 DFC_Verb 0.00 703.000000000 FORMAT "%13.9" /end CHARACTERISTIC
/begin CHARACTERISTIC DFES_GrpRpr.DFC_MOXEMM_SMU_ALM6_11_C "common MIL debouncing / group representative for common MIL debouncing of DFC_MOXEMM_SMU_ALM6_11" VALUE 0x804FA272 Val_Wu16 703.000000000 DFC_Verb 0.00 703.000000000 FORMAT "%13.9" /end CHARACTERISTIC
/begin CHARACTERISTIC DFES_GrpRpr.DFC_MOXEMM_SMU_ALM6_12_C "common MIL debouncing / group representative for common MIL debouncing of DFC_MOXEMM_SMU_ALM6_12" VALUE 0x804FA274 Val_Wu16 703.000000000 DFC_Verb 0.00 703.000000000 FORMAT "%13.9" /end CHARACTERISTIC
/begin CHARACTERISTIC DFES_GrpRpr.DFC_MOXEMM_SMU_ALM6_14_C "common MIL debouncing / group representative for common MIL debouncing of DFC_MOXEMM_SMU_ALM6_14" VALUE 0x804FA276 Val_Wu16 703.000000000 DFC_Verb 0.00 703.000000000 FORMAT "%13.9" /end CHARACTERISTIC
/begin CHARACTERISTIC DFES_GrpRpr.DFC_MOXEMM_SMU_ALM6_15_C "common MIL debouncing / group representative for common MIL debouncing of DFC_MOXEMM_SMU_ALM6_15" VALUE 0x804FA278 Val_Wu16 703.000000000 DFC_Verb 0.00 703.000000000 FORMAT "%13.9" /end CHARACTERISTIC
/begin CHARACTERISTIC DFES_GrpRpr.DFC_MOXEMM_SMU_ALM6_17_C "common MIL debouncing / group representative for common MIL debouncing of DFC_MOXEMM_SMU_ALM6_17" VALUE 0x804FA27A Val_Wu16 703.000000000 DFC_Verb 0.00 703.000000000 FORMAT "%13.9" /end CHARACTERISTIC
/begin CHARACTERISTIC DFES_GrpRpr.DFC_MOXEMM_SMU_ALM6_18_C "common MIL debouncing / group representative for common MIL debouncing of DFC_MOXEMM_SMU_ALM6_18" VALUE 0x804FA27C Val_Wu16 703.000000000 DFC_Verb 0.00 703.000000000 FORMAT "%13.9" /end CHARACTERISTIC
/begin CHARACTERISTIC DFES_GrpRpr.DFC_MOXEMM_SMU_ALM6_20_C "common MIL debouncing / group representative for common MIL debouncing of DFC_MOXEMM_SMU_ALM6_20" VALUE 0x804FA27E Val_Wu16 703.000000000 DFC_Verb 0.00 703.000000000 FORMAT "%13.9" /end CHARACTERISTIC
/begin CHARACTERISTIC DFES_GrpRpr.DFC_MOXEMM_SMU_ALM6_21_C "common MIL debouncing / group representative for common MIL debouncing of DFC_MOXEMM_SMU_ALM6_21" VALUE 0x804FA280 Val_Wu16 703.000000000 DFC_Verb 0.00 703.000000000 FORMAT "%13.9" /end CHARACTERISTIC
/begin CHARACTERISTIC DFES_GrpRpr.DFC_MOXEMM_SMU_ALM6_25_C "common MIL debouncing / group representative for common MIL debouncing of DFC_MOXEMM_SMU_ALM6_25" VALUE 0x804FA282 Val_Wu16 703.000000000 DFC_Verb 0.00 703.000000000 FORMAT "%13.9" /end CHARACTERISTIC
/begin CHARACTERISTIC DFES_GrpRpr.DFC_MOXEMM_SMU_ALM6_4_C "common MIL debouncing / group representative for common MIL debouncing of DFC_MOXEMM_SMU_ALM6_4" VALUE 0x804FA284 Val_Wu16 703.000000000 DFC_Verb 0.00 703.000000000 FORMAT "%13.9" /end CHARACTERISTIC
/begin CHARACTERISTIC DFES_GrpRpr.DFC_MOXEMM_SMU_ALM6_5_C "common MIL debouncing / group representative for common MIL debouncing of DFC_MOXEMM_SMU_ALM6_5" VALUE 0x804FA286 Val_Wu16 703.000000000 DFC_Verb 0.00 703.000000000 FORMAT "%13.9" /end CHARACTERISTIC
/begin CHARACTERISTIC DFES_GrpRpr.DFC_MOXEMM_SMU_ALM6_7_C "common MIL debouncing / group representative for common MIL debouncing of DFC_MOXEMM_SMU_ALM6_7" VALUE 0x804FA288 Val_Wu16 703.000000000 DFC_Verb 0.00 703.000000000 FORMAT "%13.9" /end CHARACTERISTIC
/begin CHARACTERISTIC DFES_GrpRpr.DFC_MOXEMM_SMU_ALM6_8_C "common MIL debouncing / group representative for common MIL debouncing of DFC_MOXEMM_SMU_ALM6_8" VALUE 0x804FA28A Val_Wu16 703.000000000 DFC_Verb 0.00 703.000000000 FORMAT "%13.9" /end CHARACTERISTIC
/begin CHARACTERISTIC DFES_GrpRpr.DFC_MOXEMM_SMU_ALM7_1_C "common MIL debouncing / group representative for common MIL debouncing of DFC_MOXEMM_SMU_ALM7_1" VALUE 0x804FA28C Val_Wu16 703.000000000 DFC_Verb 0.00 703.000000000 FORMAT "%13.9" /end CHARACTERISTIC
/begin CHARACTERISTIC DFES_GrpRpr.DFC_MOXEMM_SMU_ALM7_12_C "common MIL debouncing / group representative for common MIL debouncing of DFC_MOXEMM_SMU_ALM7_12" VALUE 0x804FA28E Val_Wu16 703.000000000 DFC_Verb 0.00 703.000000000 FORMAT "%13.9" /end CHARACTERISTIC
/begin CHARACTERISTIC DFES_GrpRpr.DFC_MOXEMM_SMU_ALM7_13_C "common MIL debouncing / group representative for common MIL debouncing of DFC_MOXEMM_SMU_ALM7_13" VALUE 0x804FA290 Val_Wu16 703.000000000 DFC_Verb 0.00 703.000000000 FORMAT "%13.9" /end CHARACTERISTIC
/begin CHARACTERISTIC DFES_GrpRpr.DFC_MOXEMM_SMU_ALM7_14_C "common MIL debouncing / group representative for common MIL debouncing of DFC_MOXEMM_SMU_ALM7_14" VALUE 0x804FA292 Val_Wu16 703.000000000 DFC_Verb 0.00 703.000000000 FORMAT "%13.9" /end CHARACTERISTIC
/begin CHARACTERISTIC DFES_GrpRpr.DFC_MOXEMM_SMU_ALM7_15_C "common MIL debouncing / group representative for common MIL debouncing of DFC_MOXEMM_SMU_ALM7_15" VALUE 0x804FA294 Val_Wu16 703.000000000 DFC_Verb 0.00 703.000000000 FORMAT "%13.9" /end CHARACTERISTIC
/begin CHARACTERISTIC DFES_GrpRpr.DFC_MOXEMM_SMU_ALM7_16_C "common MIL debouncing / group representative for common MIL debouncing of DFC_MOXEMM_SMU_ALM7_16" VALUE 0x804FA296 Val_Wu16 703.000000000 DFC_Verb 0.00 703.000000000 FORMAT "%13.9" /end CHARACTERISTIC
/begin CHARACTERISTIC DFES_GrpRpr.DFC_MOXEMM_SMU_ALM7_17_C "common MIL debouncing / group representative for common MIL debouncing of DFC_MOXEMM_SMU_ALM7_17" VALUE 0x804FA298 Val_Wu16 703.000000000 DFC_Verb 0.00 703.000000000 FORMAT "%13.9" /end CHARACTERISTIC
/begin CHARACTERISTIC DFES_GrpRpr.DFC_MOXEMM_SMU_ALM7_2_C "common MIL debouncing / group representative for common MIL debouncing of DFC_MOXEMM_SMU_ALM7_2" VALUE 0x804FA29A Val_Wu16 703.000000000 DFC_Verb 0.00 703.000000000 FORMAT "%13.9" /end CHARACTERISTIC
/begin CHARACTERISTIC DFES_GrpRpr.DFC_MOXEMM_SMU_ALM7_20_C "common MIL debouncing / group representative for common MIL debouncing of DFC_MOXEMM_SMU_ALM7_20" VALUE 0x804FA29C Val_Wu16 703.000000000 DFC_Verb 0.00 703.000000000 FORMAT "%13.9" /end CHARACTERISTIC
/begin CHARACTERISTIC DFES_GrpRpr.DFC_MOXEMM_SMU_ALM7_25_C "common MIL debouncing / group representative for common MIL debouncing of DFC_MOXEMM_SMU_ALM7_25" VALUE 0x804FA29E Val_Wu16 703.000000000 DFC_Verb 0.00 703.000000000 FORMAT "%13.9" /end CHARACTERISTIC
/begin CHARACTERISTIC DFES_GrpRpr.DFC_MOXEMM_SMU_ALM7_26_C "common MIL debouncing / group representative for common MIL debouncing of DFC_MOXEMM_SMU_ALM7_26" VALUE 0x804FA2A0 Val_Wu16 703.000000000 DFC_Verb 0.00 703.000000000 FORMAT "%13.9" /end CHARACTERISTIC
/begin CHARACTERISTIC DFES_GrpRpr.DFC_MOXEMM_SMU_ALM7_28_C "common MIL debouncing / group representative for common MIL debouncing of DFC_MOXEMM_SMU_ALM7_28" VALUE 0x804FA2A2 Val_Wu16 703.000000000 DFC_Verb 0.00 703.000000000 FORMAT "%13.9" /end CHARACTERISTIC
/begin CHARACTERISTIC DFES_GrpRpr.DFC_MOXEMM_SMU_ALM7_29_C "common MIL debouncing / group representative for common MIL debouncing of DFC_MOXEMM_SMU_ALM7_29" VALUE 0x804FA2A4 Val_Wu16 703.000000000 DFC_Verb 0.00 703.000000000 FORMAT "%13.9" /end CHARACTERISTIC
/begin CHARACTERISTIC DFES_GrpRpr.DFC_MOXEMM_SMU_ALM7_30_C "common MIL debouncing / group representative for common MIL debouncing of DFC_MOXEMM_SMU_ALM7_30" VALUE 0x804FA2A6 Val_Wu16 703.000000000 DFC_Verb 0.00 703.000000000 FORMAT "%13.9" /end CHARACTERISTIC
/begin CHARACTERISTIC DFES_GrpRpr.DFC_MOXEMM_SMU_ALM7_31_C "common MIL debouncing / group representative for common MIL debouncing of DFC_MOXEMM_SMU_ALM7_31" VALUE 0x804FA2A8 Val_Wu16 703.000000000 DFC_Verb 0.00 703.000000000 FORMAT "%13.9" /end CHARACTERISTIC
/begin CHARACTERISTIC DFES_GrpRpr.DFC_MOXEMM_SMU_ALM8_0_C "common MIL debouncing / group representative for common MIL debouncing of DFC_MOXEMM_SMU_ALM8_0" VALUE 0x804FA2AA Val_Wu16 703.000000000 DFC_Verb 0.00 703.000000000 FORMAT "%13.9" /end CHARACTERISTIC
/begin CHARACTERISTIC DFES_GrpRpr.DFC_MOXEMM_SMU_ALM8_1_C "common MIL debouncing / group representative for common MIL debouncing of DFC_MOXEMM_SMU_ALM8_1" VALUE 0x804FA2AC Val_Wu16 703.000000000 DFC_Verb 0.00 703.000000000 FORMAT "%13.9" /end CHARACTERISTIC
/begin CHARACTERISTIC DFES_GrpRpr.DFC_MOXEMM_SMU_ALM8_10_C "common MIL debouncing / group representative for common MIL debouncing of DFC_MOXEMM_SMU_ALM8_10" VALUE 0x804FA2AE Val_Wu16 703.000000000 DFC_Verb 0.00 703.000000000 FORMAT "%13.9" /end CHARACTERISTIC
/begin CHARACTERISTIC DFES_GrpRpr.DFC_MOXEMM_SMU_ALM8_11_C "common MIL debouncing / group representative for common MIL debouncing of DFC_MOXEMM_SMU_ALM8_11" VALUE 0x804FA2B0 Val_Wu16 703.000000000 DFC_Verb 0.00 703.000000000 FORMAT "%13.9" /end CHARACTERISTIC
/begin CHARACTERISTIC DFES_GrpRpr.DFC_MOXEMM_SMU_ALM8_12_C "common MIL debouncing / group representative for common MIL debouncing of DFC_MOXEMM_SMU_ALM8_12" VALUE 0x804FA2B2 Val_Wu16 703.000000000 DFC_Verb 0.00 703.000000000 FORMAT "%13.9" /end CHARACTERISTIC
/begin CHARACTERISTIC DFES_GrpRpr.DFC_MOXEMM_SMU_ALM8_16_C "common MIL debouncing / group representative for common MIL debouncing of DFC_MOXEMM_SMU_ALM8_16" VALUE 0x804FA2B4 Val_Wu16 703.000000000 DFC_Verb 0.00 703.000000000 FORMAT "%13.9" /end CHARACTERISTIC
/begin CHARACTERISTIC DFES_GrpRpr.DFC_MOXEMM_SMU_ALM8_18_C "common MIL debouncing / group representative for common MIL debouncing of DFC_MOXEMM_SMU_ALM8_18" VALUE 0x804FA2B6 Val_Wu16 703.000000000 DFC_Verb 0.00 703.000000000 FORMAT "%13.9" /end CHARACTERISTIC
/begin CHARACTERISTIC DFES_GrpRpr.DFC_MOXEMM_SMU_ALM8_2_C "common MIL debouncing / group representative for common MIL debouncing of DFC_MOXEMM_SMU_ALM8_2" VALUE 0x804FA2B8 Val_Wu16 703.000000000 DFC_Verb 0.00 703.000000000 FORMAT "%13.9" /end CHARACTERISTIC
/begin CHARACTERISTIC DFES_GrpRpr.DFC_MOXEMM_SMU_ALM8_3_C "common MIL debouncing / group representative for common MIL debouncing of DFC_MOXEMM_SMU_ALM8_3" VALUE 0x804FA2BA Val_Wu16 703.000000000 DFC_Verb 0.00 703.000000000 FORMAT "%13.9" /end CHARACTERISTIC
/begin CHARACTERISTIC DFES_GrpRpr.DFC_MOXEMM_SMU_ALM8_31_C "common MIL debouncing / group representative for common MIL debouncing of DFC_MOXEMM_SMU_ALM8_31" VALUE 0x804FA2BC Val_Wu16 703.000000000 DFC_Verb 0.00 703.000000000 FORMAT "%13.9" /end CHARACTERISTIC
/begin CHARACTERISTIC DFES_GrpRpr.DFC_MOXEMM_SMU_ALM8_4_C "common MIL debouncing / group representative for common MIL debouncing of DFC_MOXEMM_SMU_ALM8_4" VALUE 0x804FA2BE Val_Wu16 703.000000000 DFC_Verb 0.00 703.000000000 FORMAT "%13.9" /end CHARACTERISTIC
/begin CHARACTERISTIC DFES_GrpRpr.DFC_MOXEMM_SMU_ALM9_0_C "common MIL debouncing / group representative for common MIL debouncing of DFC_MOXEMM_SMU_ALM9_0" VALUE 0x804FA2C0 Val_Wu16 703.000000000 DFC_Verb 0.00 703.000000000 FORMAT "%13.9" /end CHARACTERISTIC
/begin CHARACTERISTIC DFES_GrpRpr.DFC_MOXEMM_SMU_ALM9_15_C "common MIL debouncing / group representative for common MIL debouncing of DFC_MOXEMM_SMU_ALM9_15" VALUE 0x804FA2C2 Val_Wu16 703.000000000 DFC_Verb 0.00 703.000000000 FORMAT "%13.9" /end CHARACTERISTIC
/begin CHARACTERISTIC DFES_GrpRpr.DFC_MOXEMM_SMU_ALM9_3_C "common MIL debouncing / group representative for common MIL debouncing of DFC_MOXEMM_SMU_ALM9_3" VALUE 0x804FA2C4 Val_Wu16 703.000000000 DFC_Verb 0.00 703.000000000 FORMAT "%13.9" /end CHARACTERISTIC
/begin CHARACTERISTIC DFES_GrpRpr.DFC_MoCADCNTP_C "common MIL debouncing / group representative for common MIL debouncing of DFC_MoCADCNTP" VALUE 0x804FA2C6 Val_Wu16 703.000000000 DFC_Verb 0.00 703.000000000 FORMAT "%13.9" /end CHARACTERISTIC
/begin CHARACTERISTIC DFES_GrpRpr.DFC_MoCADCTst_C "common MIL debouncing / group representative for common MIL debouncing of DFC_MoCADCTst" VALUE 0x804FA2C8 Val_Wu16 703.000000000 DFC_Verb 0.00 703.000000000 FORMAT "%13.9" /end CHARACTERISTIC
/begin CHARACTERISTIC DFES_GrpRpr.DFC_MoCSOPICO_C "common MIL debouncing / group representative for common MIL debouncing of DFC_MoCSOPICO" VALUE 0x804FA2CA Val_Wu16 703.000000000 DFC_Verb 0.00 703.000000000 FORMAT "%13.9" /end CHARACTERISTIC
/begin CHARACTERISTIC DFES_GrpRpr.DFC_MoFAPP_C "common MIL debouncing / group representative for common MIL debouncing of DFC_MoFAPP" VALUE 0x804FA2CC Val_Wu16 703.000000000 DFC_Verb 0.00 703.000000000 FORMAT "%13.9" /end CHARACTERISTIC
/begin CHARACTERISTIC DFES_GrpRpr.DFC_MoFAirFilgPrdc_C "common MIL debouncing / group representative for common MIL debouncing of DFC_MoFAirFilgPrdc" VALUE 0x804FA2CE Val_Wu16 703.000000000 DFC_Verb 0.00 703.000000000 FORMAT "%13.9" /end CHARACTERISTIC
/begin CHARACTERISTIC DFES_GrpRpr.DFC_MoFAirFlCtOffPfi_C "common MIL debouncing / group representative for common MIL debouncing of DFC_MoFAirFlCtOffPfi" VALUE 0x804FA2D0 Val_Wu16 703.000000000 DFC_Verb 0.00 703.000000000 FORMAT "%13.9" /end CHARACTERISTIC
/begin CHARACTERISTIC DFES_GrpRpr.DFC_MoFAirFlCylPfi_C "common MIL debouncing / group representative for common MIL debouncing of DFC_MoFAirFlCylPfi" VALUE 0x804FA2D2 Val_Wu16 703.000000000 DFC_Verb 0.00 703.000000000 FORMAT "%13.9" /end CHARACTERISTIC
/begin CHARACTERISTIC DFES_GrpRpr.DFC_MoFAirFlIn_C "common MIL debouncing / group representative for common MIL debouncing of DFC_MoFAirFlIn" VALUE 0x804FA2D4 Val_Wu16 703.000000000 DFC_Verb 0.00 703.000000000 FORMAT "%13.9" /end CHARACTERISTIC
/begin CHARACTERISTIC DFES_GrpRpr.DFC_MoFAirFlMixCtlPfiChkAirFl_C "common MIL debouncing / group representative for common MIL debouncing of DFC_MoFAirFlMixCtlPfiChkAirFl" VALUE 0x804FA2D6 Val_Wu16 703.000000000 DFC_Verb 0.00 703.000000000 FORMAT "%13.9" /end CHARACTERISTIC
/begin CHARACTERISTIC DFES_GrpRpr.DFC_MoFAirFlMixCtlPfiChkCtrl_C "common MIL debouncing / group representative for common MIL debouncing of DFC_MoFAirFlMixCtlPfiChkCtrl" VALUE 0x804FA2D8 Val_Wu16 703.000000000 DFC_Verb 0.00 703.000000000 FORMAT "%13.9" /end CHARACTERISTIC
/begin CHARACTERISTIC DFES_GrpRpr.DFC_MoFAirFlMode_C "common MIL debouncing / group representative for common MIL debouncing of DFC_MoFAirFlMode" VALUE 0x804FA2DA Val_Wu16 703.000000000 DFC_Verb 0.00 703.000000000 FORMAT "%13.9" /end CHARACTERISTIC
/begin CHARACTERISTIC DFES_GrpRpr.DFC_MoFESpd_C "common MIL debouncing / group representative for common MIL debouncing of DFC_MoFESpd" VALUE 0x804FA2DC Val_Wu16 703.000000000 DFC_Verb 0.00 703.000000000 FORMAT "%13.9" /end CHARACTERISTIC
/begin CHARACTERISTIC DFES_GrpRpr.DFC_MoFIACo_C "common MIL debouncing / group representative for common MIL debouncing of DFC_MoFIACo" VALUE 0x804FA2DE Val_Wu16 703.000000000 DFC_Verb 0.00 703.000000000 FORMAT "%13.9" /end CHARACTERISTIC
/begin CHARACTERISTIC DFES_GrpRpr.DFC_MoFICOL1_C "common MIL debouncing / group representative for common MIL debouncing of DFC_MoFICOL1" VALUE 0x804FA2E0 Val_Wu16 703.000000000 DFC_Verb 0.00 703.000000000 FORMAT "%13.9" /end CHARACTERISTIC
/begin CHARACTERISTIC DFES_GrpRpr.DFC_MoFICOL2_C "common MIL debouncing / group representative for common MIL debouncing of DFC_MoFICOL2" VALUE 0x804FA2E2 Val_Wu16 703.000000000 DFC_Verb 0.00 703.000000000 FORMAT "%13.9" /end CHARACTERISTIC
/begin CHARACTERISTIC DFES_GrpRpr.DFC_MoFStrt_C "common MIL debouncing / group representative for common MIL debouncing of DFC_MoFStrt" VALUE 0x804FA2E4 Val_Wu16 703.000000000 DFC_Verb 0.00 703.000000000 FORMAT "%13.9" /end CHARACTERISTIC
/begin CHARACTERISTIC DFES_GrpRpr.DFC_MoFTrqCmp_C "common MIL debouncing / group representative for common MIL debouncing of DFC_MoFTrqCmp" VALUE 0x804FA2E6 Val_Wu16 703.000000000 DFC_Verb 0.00 703.000000000 FORMAT "%13.9" /end CHARACTERISTIC
/begin CHARACTERISTIC DFES_GrpRpr.DFC_MoFTrqCmpMax_C "common MIL debouncing / group representative for common MIL debouncing of DFC_MoFTrqCmpMax" VALUE 0x804FA2E8 Val_Wu16 703.000000000 DFC_Verb 0.00 703.000000000 FORMAT "%13.9" /end CHARACTERISTIC
/begin CHARACTERISTIC DFES_GrpRpr.DFC_MoFTrqCmpMin_C "common MIL debouncing / group representative for common MIL debouncing of DFC_MoFTrqCmpMin" VALUE 0x804FA2EA Val_Wu16 703.000000000 DFC_Verb 0.00 703.000000000 FORMAT "%13.9" /end CHARACTERISTIC
/begin CHARACTERISTIC DFES_GrpRpr.DFC_MoFVarPostBldSel_C "common MIL debouncing / group representative for common MIL debouncing of DFC_MoFVarPostBldSel" VALUE 0x804FA2EC Val_Wu16 703.000000000 DFC_Verb 0.00 703.000000000 FORMAT "%13.9" /end CHARACTERISTIC
/begin CHARACTERISTIC DFES_GrpRpr.DFC_MoXEMMHwLTMCUFW_C "common MIL debouncing / group representative for common MIL debouncing of DFC_MoXEMMHwLTMCUFW" VALUE 0x804FA2EE Val_Wu16 703.000000000 DFC_Verb 0.00 703.000000000 FORMAT "%13.9" /end CHARACTERISTIC
/begin CHARACTERISTIC DFES_GrpRpr.DFC_MoXEMMHwLTMonBIST_C "common MIL debouncing / group representative for common MIL debouncing of DFC_MoXEMMHwLTMonBIST" VALUE 0x804FA2F0 Val_Wu16 703.000000000 DFC_Verb 0.00 703.000000000 FORMAT "%13.9" /end CHARACTERISTIC
/begin CHARACTERISTIC DFES_GrpRpr.DFC_MoXEMMHwLTRegMonTest_C "common MIL debouncing / group representative for common MIL debouncing of DFC_MoXEMMHwLTRegMonTest" VALUE 0x804FA2F2 Val_Wu16 703.000000000 DFC_Verb 0.00 703.000000000 FORMAT "%13.9" /end CHARACTERISTIC
/begin CHARACTERISTIC DFES_GrpRpr.DFC_MoXEMMHwLTStbySMUAlvTest_C "common MIL debouncing / group representative for common MIL debouncing of DFC_MoXEMMHwLTStbySMUAlvTest" VALUE 0x804FA2F4 Val_Wu16 703.000000000 DFC_Verb 0.00 703.000000000 FORMAT "%13.9" /end CHARACTERISTIC
/begin FUNCTION DFES "30000.73.0_2.0.0Diagnostic Fault Event Storage"
 /begin DEF_CHARACTERISTIC DFES_GrpRpr.DFC_BrkBstPSnsrStuck_C DFES_GrpRpr.DFC_BrkMnSwtContOn_C DFES_GrpRpr.DFC_BrkMnSwtNotStp_C DFES_GrpRpr.DFC_BrkNpl_C DFES_GrpRpr.DFC_BrkRdntSwtContOn_C DFES_GrpRpr.DFC_BrkRdntSwtNotStp_C DFES_GrpRpr.DFC_Clth3ONStuck_C DFES_GrpRpr.DFC_Clth4OFFStuck_C DFES_GrpRpr.DFC_ClthOFFStuck_C DFES_GrpRpr.DFC_ClthONStuck_C DFES_GrpRpr.DFC_ClthStkFailInfo_C DFES_GrpRpr.DFC_ComACFailInfo_C DFES_GrpRpr.DFC_ComATFTValErr_C DFES_GrpRpr.DFC_ComATMILReq_C DFES_GrpRpr.DFC_ComAYCAChksum_C DFES_GrpRpr.DFC_ComAYCARingCnt_C DFES_GrpRpr.DFC_ComAYCATOut_C DFES_GrpRpr.DFC_ComAYCDChkSum_C DFES_GrpRpr.DFC_ComAYCDTOut_C DFES_GrpRpr.DFC_ComAYCFChksum_C DFES_GrpRpr.DFC_ComAYCFRingCnt_C DFES_GrpRpr.DFC_ComAYCFTOut_C DFES_GrpRpr.DFC_ComAYCGChksum_C DFES_GrpRpr.DFC_ComAYCGRingCnt_C DFES_GrpRpr.DFC_ComAYCGTOut_C DFES_GrpRpr.DFC_ComAYCIChkSum_C DFES_GrpRpr.DFC_ComAYCIRingCnt_C DFES_GrpRpr.DFC_ComAYCITOut_C DFES_GrpRpr.DFC_ComBCM1ChkSum_C DFES_GrpRpr.DFC_ComBCM1RingCnt_C DFES_GrpRpr.DFC_ComBCM1TOut_C DFES_GrpRpr.DFC_ComCANABusOffErr_C DFES_GrpRpr.DFC_ComCANBBusOffErr_C DFES_GrpRpr.DFC_ComCANCBusOffErr_C DFES_GrpRpr.DFC_ComCGW1ChkSum_C DFES_GrpRpr.DFC_ComCGW1RingCnt_C DFES_GrpRpr.DFC_ComCGW1TOut_C DFES_GrpRpr.DFC_ComConvBoostErr_C DFES_GrpRpr.DFC_ComConvSlipErr_C DFES_GrpRpr.DFC_ComEAT10Chksum_C DFES_GrpRpr.DFC_ComEAT10RingCnt_C DFES_GrpRpr.DFC_ComEAT10TOut_C DFES_GrpRpr.DFC_ComEAT11ChkSum_C DFES_GrpRpr.DFC_ComEAT11RingCnt_C DFES_GrpRpr.DFC_ComEAT11TOut_C DFES_GrpRpr.DFC_ComEAT12ChkSum_C DFES_GrpRpr.DFC_ComEAT12RingCnt_C DFES_GrpRpr.DFC_ComEAT12TOut_C DFES_GrpRpr.DFC_ComEAT13ChkSum_C DFES_GrpRpr.DFC_ComEAT13RingCnt_C DFES_GrpRpr.DFC_ComEAT13TOut_C DFES_GrpRpr.DFC_ComEAT1Chksum_C DFES_GrpRpr.DFC_ComEAT1RingCnt_C DFES_GrpRpr.DFC_ComEAT1TOut_C DFES_GrpRpr.DFC_ComEAT2ChkSum_C DFES_GrpRpr.DFC_ComEAT2RingCnt_C DFES_GrpRpr.DFC_ComEAT2TOut_C DFES_GrpRpr.DFC_ComEAT4ChkSum_C DFES_GrpRpr.DFC_ComEAT4RingCnt_C DFES_GrpRpr.DFC_ComEAT4TOut_C DFES_GrpRpr.DFC_ComEAT6Chksum_C DFES_GrpRpr.DFC_ComEAT6RingCnt_C DFES_GrpRpr.DFC_ComEAT6TOut_C DFES_GrpRpr.DFC_ComEAT7Chksum_C DFES_GrpRpr.DFC_ComEAT7RingCnt_C DFES_GrpRpr.DFC_ComEAT7TOut_C DFES_GrpRpr.DFC_ComEAT8Chksum_C DFES_GrpRpr.DFC_ComEAT8RingCnt_C DFES_GrpRpr.DFC_ComEAT8TOut_C DFES_GrpRpr.DFC_ComEATAChksum_C DFES_GrpRpr.DFC_ComEATARingCnt_C DFES_GrpRpr.DFC_ComEATATOut_C DFES_GrpRpr.DFC_ComEATBChkSum_C DFES_GrpRpr.DFC_ComEATBRingCnt_C DFES_GrpRpr.DFC_ComEATBTOut_C DFES_GrpRpr.DFC_ComEATCChksum_C DFES_GrpRpr.DFC_ComEATCRingCnt_C DFES_GrpRpr.DFC_ComEATCTOut_C DFES_GrpRpr.DFC_ComEBBAChksum_C DFES_GrpRpr.DFC_ComEBBARingCnt_C DFES_GrpRpr.DFC_ComEBBATOut_C DFES_GrpRpr.DFC_ComEPS1Chksum_C DFES_GrpRpr.DFC_ComEPS1RingCnt_C DFES_GrpRpr.DFC_ComEPS1TOut_C DFES_GrpRpr.DFC_ComEngCanRxErr_C DFES_GrpRpr.DFC_ComGrvySnsrErr_C DFES_GrpRpr.DFC_ComGwIMG1ChkSum_C DFES_GrpRpr.DFC_ComGwIMG1RingCnt_C DFES_GrpRpr.DFC_ComGwIMG1TOut_C DFES_GrpRpr.DFC_ComGwIMG3ChkSum_C DFES_GrpRpr.DFC_ComGwIMG3RingCnt_C DFES_GrpRpr.DFC_ComGwIMG3TOut_C DFES_GrpRpr.DFC_ComGwIMG4ChkSum_C DFES_GrpRpr.DFC_ComGwIMG4RingCnt_C DFES_GrpRpr.DFC_ComGwIMG4TOut_C DFES_GrpRpr.DFC_ComGwIMG5ChkSum_C DFES_GrpRpr.DFC_ComGwIMG5RingCnt_C DFES_GrpRpr.DFC_ComGwIMG5TOut_C DFES_GrpRpr.DFC_ComGwIMG6ChkSum_C DFES_GrpRpr.DFC_ComGwIMG6RingCnt_C DFES_GrpRpr.DFC_ComGwIMG6TOut_C DFES_GrpRpr.DFC_ComIDASBChksum_C DFES_GrpRpr.DFC_ComIDASBRingCnt_C DFES_GrpRpr.DFC_ComIDASBTOut_C DFES_GrpRpr.DFC_ComIMGMILReq_C DFES_GrpRpr.DFC_ComISSPrms_C DFES_GrpRpr.DFC_ComMETAChksum_C DFES_GrpRpr.DFC_ComMETARingCnt_C DFES_GrpRpr.DFC_ComMETATOut_C DFES_GrpRpr.DFC_ComMETCChksum_C DFES_GrpRpr.DFC_ComMETCRingCnt_C DFES_GrpRpr.DFC_ComMETCTOut_C DFES_GrpRpr.DFC_ComMETDChksum_C DFES_GrpRpr.DFC_ComMETDRingCnt_C DFES_GrpRpr.DFC_ComMETDTOut_C DFES_GrpRpr.DFC_ComMETE2Chksum_C DFES_GrpRpr.DFC_ComMETE2RingCnt_C DFES_GrpRpr.DFC_ComMETE2TOut_C DFES_GrpRpr.DFC_ComMETFChksum_C DFES_GrpRpr.DFC_ComMETFRingCnt_C DFES_GrpRpr.DFC_ComMETFTOut_C DFES_GrpRpr.DFC_ComMETGChksum_C DFES_GrpRpr.DFC_ComMETGRingCnt_C DFES_GrpRpr.DFC_ComMETGTOut_C DFES_GrpRpr.DFC_ComMETH2Chksum_C DFES_GrpRpr.DFC_ComMETH2RingCnt_C DFES_GrpRpr.DFC_ComMETH2TOut_C DFES_GrpRpr.DFC_ComMETHChksum_C DFES_GrpRpr.DFC_ComMETHRingCnt_C DFES_GrpRpr.DFC_ComMETHTOut_C DFES_GrpRpr.DFC_ComMETIChksum_C DFES_GrpRpr.DFC_ComMETIRingCnt_C DFES_GrpRpr.DFC_ComMETITOut_C DFES_GrpRpr.DFC_ComMETKChksum_C DFES_GrpRpr.DFC_ComMETKRingCnt_C DFES_GrpRpr.DFC_ComMETKTOut_C DFES_GrpRpr.DFC_ComMETLChksum_C DFES_GrpRpr.DFC_ComMETLRingCnt_C DFES_GrpRpr.DFC_ComMETLTOut_C DFES_GrpRpr.DFC_ComMETMChksum_C DFES_GrpRpr.DFC_ComMETMRingCnt_C DFES_GrpRpr.DFC_ComMETMTOut_C DFES_GrpRpr.DFC_ComMETNChksum_C DFES_GrpRpr.DFC_ComMETNRingCnt_C DFES_GrpRpr.DFC_ComMETNTOut_C DFES_GrpRpr.DFC_ComMtrCom_C DFES_GrpRpr.DFC_ComPCUChkSum_C DFES_GrpRpr.DFC_ComPCURingCnt_C DFES_GrpRpr.DFC_ComPCUTOut_C DFES_GrpRpr.DFC_ComSRSAChksum_C DFES_GrpRpr.DFC_ComSRSARingCnt_C DFES_GrpRpr.DFC_ComSRSATOut_C DFES_GrpRpr.DFC_ComSRSBChksum_C DFES_GrpRpr.DFC_ComSRSBRingCnt_C DFES_GrpRpr.DFC_ComSRSBTOut_C DFES_GrpRpr.DFC_ComSRSChksum_C DFES_GrpRpr.DFC_ComSRSErr_C DFES_GrpRpr.DFC_ComSRSRingCnt_C DFES_GrpRpr.DFC_ComSRSTOut_C DFES_GrpRpr.DFC_ComVehSpdPndFltTCU_C DFES_GrpRpr.DFC_EbsChartcCurrErr_C DFES_GrpRpr.DFC_EbsSelfDiagErr_C DFES_GrpRpr.DFC_GbxCANDigPlausErr_C DFES_GrpRpr.DFC_GbxNPos1SRCMax_C DFES_GrpRpr.DFC_GbxNPos1SRCMin_C DFES_GrpRpr.DFC_GbxNPos2SRCMax_C DFES_GrpRpr.DFC_GbxNPos2SRCMin_C DFES_GrpRpr.DFC_GbxNPosAlvChk_C DFES_GrpRpr.DFC_GbxNPosSyncErr_C DFES_GrpRpr.DFC_HEGOS2B1HtrPsMax_C DFES_GrpRpr.DFC_HEGOS2B1HtrPsMin_C DFES_GrpRpr.DFC_HEGOS2B1HtrPsSig_C DFES_GrpRpr.DFC_LinCSErrACG_C DFES_GrpRpr.DFC_LinCSErrEBS_C DFES_GrpRpr.DFC_LinHdrTimeoutErrACG_C DFES_GrpRpr.DFC_LinHdrTimeoutErrEBS_C DFES_GrpRpr.DFC_LinMsgTimeoutErrACG_C DFES_GrpRpr.DFC_LinMsgTimeoutErrEBS_C DFES_GrpRpr.DFC_LinNoStrtComErr_C DFES_GrpRpr.DFC_MisfDetVWhlFrntLeOORHi_C DFES_GrpRpr.DFC_MisfDetVWhlFrntLeRatyHi_C DFES_GrpRpr.DFC_MisfDetVWhlFrntLeRatyLo_C DFES_GrpRpr.DFC_MisfDetVWhlFrntLeStuck_C DFES_GrpRpr.DFC_MisfDetVWhlFrntRiOORHi_C DFES_GrpRpr.DFC_MisfDetVWhlFrntRiRatyHi_C DFES_GrpRpr.DFC_MisfDetVWhlFrntRiRatyLo_C DFES_GrpRpr.DFC_MisfDetVWhlFrntRiStuck_C DFES_GrpRpr.DFC_MisfDetVWhlReLeOORHi_C DFES_GrpRpr.DFC_MisfDetVWhlReLeRatyHi_C DFES_GrpRpr.DFC_MisfDetVWhlReLeRatyLo_C DFES_GrpRpr.DFC_MisfDetVWhlReLeStuck_C DFES_GrpRpr.DFC_MisfDetVWhlReRiOORHi_C DFES_GrpRpr.DFC_MisfDetVWhlReRiRatyHi_C DFES_GrpRpr.DFC_MisfDetVWhlReRiRatyLo_C DFES_GrpRpr.DFC_MisfDetVWhlReRiStuck_C DFES_GrpRpr.DFC_MisfDetdVWhlFrntLePlaus_C DFES_GrpRpr.DFC_MisfDetdVWhlFrntRiPlaus_C DFES_GrpRpr.DFC_MisfDetdVWhlReLePlaus_C DFES_GrpRpr.DFC_MisfDetdVWhlReRiPlaus_C DFES_GrpRpr.DFC_PEnvSigRngMax_C DFES_GrpRpr.DFC_PEnvSigRngMin_C DFES_GrpRpr.DFC_StmFault_C DFES_GrpRpr.DFC_StrtCtOffPth_C DFES_GrpRpr.DFC_StrtCtlErr_C DFES_GrpRpr.DFC_StrtFault_C DFES_GrpRpr.DFC_StrtLckJudg1_C DFES_GrpRpr.DFC_StrtLckJudg2_C DFES_GrpRpr.DFC_StrtOL_C DFES_GrpRpr.DFC_StrtOL2_C DFES_GrpRpr.DFC_StrtSCB_C DFES_GrpRpr.DFC_StrtSCB2_C DFES_GrpRpr.DFC_StrtSCG_C DFES_GrpRpr.DFC_StrtSCG2_C DFES_GrpRpr.DFC_StrtStkRly1_C DFES_GrpRpr.DFC_StrtStkRly2_C DFES_GrpRpr.DFC_TEVEmax_C DFES_GrpRpr.DFC_TEVEmin_C DFES_GrpRpr.DFC_TEVEsig_C DFES_GrpRpr.DFC_VehVAllPlaus_C DFES_GrpRpr.DFC_VehVNCSnsrElecFailr_C DFES_GrpRpr.DFC_VehVPlausCan_C DFES_GrpRpr.DFC_VehVPlausFco_C DFES_GrpRpr.DFC_VehVPlausPwr_C DFES_GrpRpr.DFC_VehVPlausV2N_C DFES_GrpRpr.DFC_VehVSpdSnsrAElecFailr_C DFES_GrpRpr.DFC_VehVSpdSnsrBElecFailr_C DFES_GrpRpr.DFC_ClthMax_C DFES_GrpRpr.DFC_IgnClPs_DevComErr_C DFES_GrpRpr.DFC_IgnClPs_LineOl_0_C DFES_GrpRpr.DFC_IgnClPs_LineOl_1_C DFES_GrpRpr.DFC_IgnClPs_LineOl_2_C DFES_GrpRpr.DFC_IgnClPs_LineOl_3_C DFES_GrpRpr.DFC_IgnClPs_LineScb_0_C DFES_GrpRpr.DFC_IgnClPs_LineScb_1_C DFES_GrpRpr.DFC_IgnClPs_LineScb_2_C DFES_GrpRpr.DFC_IgnClPs_LineScb_3_C DFES_GrpRpr.DFC_IgnClPs_LineScg_0_C DFES_GrpRpr.DFC_IgnClPs_LineScg_1_C DFES_GrpRpr.DFC_IgnClPs_LineScg_2_C DFES_GrpRpr.DFC_IgnClPs_LineScg_3_C DFES_GrpRpr.DFC_UEGOASICS1B1_C DFES_GrpRpr.DFC_UEGOOLIPES1B1_C DFES_GrpRpr.DFC_UEGOOLRES1B1_C DFES_GrpRpr.DFC_UEGOSCBS1B1_C DFES_GrpRpr.DFC_UEGOSCGS1B1_C DFES_GrpRpr.DFC_UEGOSPIS1B1_C DFES_GrpRpr.DFC_UEGOSnsrS1B1_C DFES_GrpRpr.DFC_UegoOlApesS1B1_C DFES_GrpRpr.DFC_UegoOlRCmpS1B1_C DFES_GrpRpr.DFC_AirCCmprOL_C DFES_GrpRpr.DFC_AirCCmprOvrTemp_C DFES_GrpRpr.DFC_AirCCmprSCB_C DFES_GrpRpr.DFC_AirCCmprSCG_C DFES_GrpRpr.DFC_AltErr_C DFES_GrpRpr.DFC_BattUSRCMax_C DFES_GrpRpr.DFC_BattUSRCMin_C DFES_GrpRpr.DFC_ComChksTCU1_C DFES_GrpRpr.DFC_ComChksTCU11_C DFES_GrpRpr.DFC_ComChksTCU12_C DFES_GrpRpr.DFC_ComChksTCU13_C DFES_GrpRpr.DFC_ComChksTCU2_C DFES_GrpRpr.DFC_ComChksTCU3_C DFES_GrpRpr.DFC_ComChksTCU4_C DFES_GrpRpr.DFC_ComCntTCU1_C DFES_GrpRpr.DFC_ComCntTCU11_C DFES_GrpRpr.DFC_ComCntTCU12_C DFES_GrpRpr.DFC_ComCntTCU13_C DFES_GrpRpr.DFC_ComCntTCU2_C DFES_GrpRpr.DFC_ComCntTCU3_C DFES_GrpRpr.DFC_ComCntTCU4_C DFES_GrpRpr.DFC_ComTOutTCU01_C DFES_GrpRpr.DFC_ComTOutTCU02_C DFES_GrpRpr.DFC_ComTOutTCU1_C DFES_GrpRpr.DFC_ComTOutTCU11_C DFES_GrpRpr.DFC_ComTOutTCU12_C DFES_GrpRpr.DFC_ComTOutTCU13_C DFES_GrpRpr.DFC_ComTOutTCU14_C DFES_GrpRpr.DFC_ComTOutTCU2_C DFES_GrpRpr.DFC_ComTOutTCU3_C DFES_GrpRpr.DFC_ComTOutTCU4_C DFES_GrpRpr.DFC_DevLibBattUHi_C DFES_GrpRpr.DFC_DevLibBattULo_C DFES_GrpRpr.DFC_FanDIOOL_0_C DFES_GrpRpr.DFC_FanDIOOL_1_C DFES_GrpRpr.DFC_FanDIOOvrTemp_0_C DFES_GrpRpr.DFC_FanDIOOvrTemp_1_C DFES_GrpRpr.DFC_FanDIOSCB_0_C DFES_GrpRpr.DFC_FanDIOSCB_1_C DFES_GrpRpr.DFC_FanDIOSCG_0_C DFES_GrpRpr.DFC_FanDIOSCG_1_C DFES_GrpRpr.DFC_MRlyDcOL_C DFES_GrpRpr.DFC_MRlyDcSCB_C DFES_GrpRpr.DFC_MRlyDcSCG_C DFES_GrpRpr.DFC_PSPOL_C DFES_GrpRpr.DFC_PSPOvrTemp_C DFES_GrpRpr.DFC_PSPSCB_C DFES_GrpRpr.DFC_PSPSCG_C DFES_GrpRpr.DFC_T50Err_C DFES_GrpRpr.DFC_ThrVlvLoBattB1_C DFES_GrpRpr.DFC_VehVPhysRngHi_C DFES_GrpRpr.DFC_VehVSclOutOL_C DFES_GrpRpr.DFC_VehVSclOutOT_C DFES_GrpRpr.DFC_VehVSclOutSCB_C DFES_GrpRpr.DFC_VehVSclOutSCG_C DFES_GrpRpr.DFC_VehVSnsrARngHi_C DFES_GrpRpr.DFC_VehVSnsrBRngHi_C DFES_GrpRpr.DFC_VehVSpdRtyDiag_C DFES_GrpRpr.DFC_VehVWhlErr_C DFES_GrpRpr.DFC_ACEvpTSRCMax_C DFES_GrpRpr.DFC_ACEvpTSRCMin_C DFES_GrpRpr.DFC_AirCClntPAnaSRCMax_C DFES_GrpRpr.DFC_AirCClntPAnaSRCMin_C DFES_GrpRpr.DFC_AirCSwtNpl_C DFES_GrpRpr.DFC_AirCSwtSig_C DFES_GrpRpr.DFC_Brk_C DFES_GrpRpr.DFC_BrkSig_C DFES_GrpRpr.DFC_ClthSig_C DFES_GrpRpr.DFC_HLSDemOvhtEngLim_C DFES_GrpRpr.DFC_OilPNpl_C DFES_GrpRpr.DFC_PIntkVUsLineHiB1_C DFES_GrpRpr.DFC_PIntkVUsLineLoB1_C DFES_GrpRpr.DFC_VehVPhysRngLo_C DFES_GrpRpr.DFC_VehVSigCan_C DFES_GrpRpr.DFC_VehVSigCanSafe_C DFES_GrpRpr.DFC_VlvLftFbOilPSnsrIntk11SRCMax_C DFES_GrpRpr.DFC_VlvLftFbOilPSnsrIntk11SRCMin_C DFES_GrpRpr.DFC_ClthNpl_C DFES_GrpRpr.DFC_EV1max_C DFES_GrpRpr.DFC_EV1min_C DFES_GrpRpr.DFC_EV1sig_C DFES_GrpRpr.DFC_EV2max_C DFES_GrpRpr.DFC_EV2min_C DFES_GrpRpr.DFC_EV2sig_C DFES_GrpRpr.DFC_EV3max_C DFES_GrpRpr.DFC_EV3min_C DFES_GrpRpr.DFC_EV3sig_C DFES_GrpRpr.DFC_EV4max_C DFES_GrpRpr.DFC_EV4min_C DFES_GrpRpr.DFC_EV4sig_C DFES_GrpRpr.DFC_GbxPNPosnDrvCdn_C DFES_GrpRpr.DFC_GbxPNPosnPlausy_C DFES_GrpRpr.DFC_PEnvCcMax_C DFES_GrpRpr.DFC_PEnvCcMin_C DFES_GrpRpr.DFC_PEnvRngChkMax_C DFES_GrpRpr.DFC_PEnvRngChkMin_C DFES_GrpRpr.DFC_PEnvSnsrPlaus_C DFES_GrpRpr.DFC_UEGOHeatrPsS1B1Max_C DFES_GrpRpr.DFC_UEGOHeatrPsS1B1Min_C DFES_GrpRpr.DFC_UEGOHeatrPsS1B1Sig_C DFES_GrpRpr.DFC_UEGOHeatrRlyPsOLS1B1_C DFES_GrpRpr.DFC_UEGOHeatrRlyPsSCBS1B1_C DFES_GrpRpr.DFC_UEGOHeatrRlyPsSCGS1B1_C DFES_GrpRpr.DFC_KnDetSens1PortAMax_C DFES_GrpRpr.DFC_KnDetSens1PortAMin_C DFES_GrpRpr.DFC_KnDetSens1PortBMax_C DFES_GrpRpr.DFC_KnDetSens1PortBMin_C DFES_GrpRpr.DFC_Clth2ONStuck_C DFES_GrpRpr.DFC_Clth2ONStuckLdc_C DFES_GrpRpr.DFC_Clth3ONStuckLdc_C DFES_GrpRpr.DFC_Clth3ONStuckPostDrv_C DFES_GrpRpr.DFC_Clth4ONStuck_C DFES_GrpRpr.DFC_Clth4ONStuckLdc_C DFES_GrpRpr.DFC_ComDLCTCU01_C DFES_GrpRpr.DFC_ComDLCTCU02_C DFES_GrpRpr.DFC_ComDLCTCU1_C DFES_GrpRpr.DFC_ComDLCTCU11_C DFES_GrpRpr.DFC_ComDLCTCU12_C DFES_GrpRpr.DFC_ComDLCTCU13_C DFES_GrpRpr.DFC_ComDLCTCU14_C DFES_GrpRpr.DFC_ComDLCTCU2_C DFES_GrpRpr.DFC_ComDLCTCU3_C DFES_GrpRpr.DFC_ComDLCTCU4_C DFES_GrpRpr.DFC_EVX_C DFES_GrpRpr.DFC_EbsSocFlt_C DFES_GrpRpr.DFC_I14229VINErr_C DFES_GrpRpr.DFC_LLRKHmax_C DFES_GrpRpr.DFC_LLRKHmin_C DFES_GrpRpr.DFC_LLRmax_C DFES_GrpRpr.DFC_LLRmin_C DFES_GrpRpr.DFC_RoughRoad_C DFES_GrpRpr.DFC_SiaEEPRdErr_C DFES_GrpRpr.DFC_SiaEEPWrngCod_C DFES_GrpRpr.DFC_UegoDummy_C DFES_GrpRpr.DFC_BusDiagCANAPPLBusOff_C DFES_GrpRpr.DFC_BusDiagCANCANCBusOff_C DFES_GrpRpr.DFC_BusDiagCANVEHICLEBusOff_C DFES_GrpRpr.DFC_RBA_IODIAGPWR_rba_IoExtCy329_SignalVltSply_0_C DFES_GrpRpr.DFC_RBA_IODIAGPWR_rba_IoExtCy329_SignalVltSply_0OT_C DFES_GrpRpr.DFC_RBA_IODIAGPWR_rba_IoExtCy329_SignalVltSply_0OV_C DFES_GrpRpr.DFC_RBA_IODIAGPWR_rba_IoExtCy329_SignalVltSply_0SCG_C DFES_GrpRpr.DFC_RBA_IODIAGPWR_rba_IoExtCy329_SignalVltSply_0UV_C DFES_GrpRpr.DFC_RBA_IODIAGPWR_rba_IoExtCy329_SignalVltSply_1_C DFES_GrpRpr.DFC_RBA_IODIAGPWR_rba_IoExtCy329_SignalVltSply_1OT_C DFES_GrpRpr.DFC_RBA_IODIAGPWR_rba_IoExtCy329_SignalVltSply_1OV_C DFES_GrpRpr.DFC_RBA_IODIAGPWR_rba_IoExtCy329_SignalVltSply_1SCG_C DFES_GrpRpr.DFC_RBA_IODIAGPWR_rba_IoExtCy329_SignalVltSply_1UV_C DFES_GrpRpr.DFC_RBA_IODIAGPWR_rba_IoExtCy329_SignalVltSply_2_C DFES_GrpRpr.DFC_RBA_IODIAGPWR_rba_IoExtCy329_SignalVltSply_2OT_C DFES_GrpRpr.DFC_RBA_IODIAGPWR_rba_IoExtCy329_SignalVltSply_2OV_C DFES_GrpRpr.DFC_RBA_IODIAGPWR_rba_IoExtCy329_SignalVltSply_2SCG_C DFES_GrpRpr.DFC_RBA_IODIAGPWR_rba_IoExtCy329_SignalVltSply_2UV_C DFES_GrpRpr.DFC_CAN_E_TIMEOUT_C DFES_GrpRpr.DFC_LIN_E_TIMEOUT_C DFES_GrpRpr.DFC_MRlyOL_C DFES_GrpRpr.DFC_MRlySCB_C DFES_GrpRpr.DFC_MRlySCG_C DFES_GrpRpr.DFC_rba_MultiStackTrace_Threshold_C DFES_GrpRpr.DFC_BSWM_E_ACTION_FAILED_C DFES_GrpRpr.DFC_BSWM_E_INTRPTQUEUE_FULL_C DFES_GrpRpr.DFC_RBA_IOEXTLIB_KEEPALIVE_DRV_C DFES_GrpRpr.DFC_RBA_IOEXTLIB_KEEPALIVE_INI_C DFES_GrpRpr.DFC_rba_IoSigRtc_StopCounter_C DFES_GrpRpr.DFC_rba_MRly_Diag_Stk_Event_C DFES_GrpRpr.DFC_rba_MemDiag_MemReadErr_C DFES_GrpRpr.DFC_rba_MemDiag_MemWrErr_C DFES_GrpRpr.DFC_rba_SyC_IrrSwOffTrigEngRun_Event_C DFES_GrpRpr.DFC_rba_T15_Diag_ComInVld_Event_C DFES_GrpRpr.DFC_rba_T15_Diag_ComOff_HwOn_Event_C DFES_GrpRpr.DFC_rba_T15_Diag_ComOn_HwOff_Event_C DFES_GrpRpr.DFC_AppAllSnsrDfct_C DFES_GrpRpr.DFC_BattUStdbyDiaOL_C DFES_GrpRpr.DFC_BigLeakIntkMnfldEmiInfl_C DFES_GrpRpr.DFC_BrkMnSwtContOnWarnLmp_C DFES_GrpRpr.DFC_BrkMnSwtNotStpWarnLmp_C DFES_GrpRpr.DFC_BrkRdntSwtContOnWarnLmp_C DFES_GrpRpr.DFC_BrkRdntSwtNotStpWarnLmp_C DFES_GrpRpr.DFC_CEngDsTColdStrtMax_C DFES_GrpRpr.DFC_CEngDsTColdStrtMin_C DFES_GrpRpr.DFC_CEngDsTImps_C DFES_GrpRpr.DFC_CEngDsTPlausLSC_C DFES_GrpRpr.DFC_CEngDsTPlausSTC_C DFES_GrpRpr.DFC_CEngDsTSRCMax_C DFES_GrpRpr.DFC_CEngDsTSRCMin_C DFES_GrpRpr.DFC_CEngDsTSig_C DFES_GrpRpr.DFC_CEngUsTSRCMax_C DFES_GrpRpr.DFC_CEngUsTSRCMin_C DFES_GrpRpr.DFC_DCDCFltDet_C DFES_GrpRpr.DFC_DKRSA_C DFES_GrpRpr.DFC_DKVSmax_C DFES_GrpRpr.DFC_DKnpl_C DFES_GrpRpr.DFC_DSSmax_C DFES_GrpRpr.DFC_DSTTI_C DFES_GrpRpr.DFC_DSUmax_C DFES_GrpRpr.DFC_EGRVlvOL_C DFES_GrpRpr.DFC_EGRVlvSCB_C DFES_GrpRpr.DFC_EGRVlvSCG_C DFES_GrpRpr.DFC_EGSDUS2B1LtrDly_C DFES_GrpRpr.DFC_EGSDUS2B1LtrPT1_C DFES_GrpRpr.DFC_EGSDUS2B1RtlDly_C DFES_GrpRpr.DFC_EGSDUS2B1RtlPT1_C DFES_GrpRpr.DFC_EGSDUS2B1TarLean_C DFES_GrpRpr.DFC_EGSDUS2B1TarRich_C DFES_GrpRpr.DFC_ETAKHLmax_C DFES_GrpRpr.DFC_ETAKHTmax_C DFES_GrpRpr.DFC_EngICO_C DFES_GrpRpr.DFC_EngPrtOvrSpdMon_C DFES_GrpRpr.DFC_EpmCaSI1ErrSig_C DFES_GrpRpr.DFC_EpmCaSI1NoSig_C DFES_GrpRpr.DFC_EpmCaSI1OfsErr_C DFES_GrpRpr.DFC_EpmCrSErrSig_C DFES_GrpRpr.DFC_EpmCrSNoSig_C DFES_GrpRpr.DFC_EtaEngIdleNonCsers_C DFES_GrpRpr.DFC_EtaEngPtlNonCsers_C DFES_GrpRpr.DFC_FRAmax_C DFES_GrpRpr.DFC_FRAmin_C DFES_GrpRpr.DFC_GbxRvsSwtStk_C DFES_GrpRpr.DFC_HDRmax_C DFES_GrpRpr.DFC_HEGOS2B1ElecMax_C DFES_GrpRpr.DFC_HEGOS2B1ElecMin_C DFES_GrpRpr.DFC_HEGOS2B1ElecSig_C DFES_GrpRpr.DFC_HEGOS2B1HtgNpl_C DFES_GrpRpr.DFC_IntkAirTIntkMnfldCrssMax_C DFES_GrpRpr.DFC_IntkAirTIntkMnfldCrssMin_C DFES_GrpRpr.DFC_IntkAirTIntkMnfldHSCMax_C DFES_GrpRpr.DFC_IntkAirTIntkMnfldImps_C DFES_GrpRpr.DFC_IntkAirTIntkMnfldPRCMax_C DFES_GrpRpr.DFC_IntkAirTIntkMnfldPRCMin_C DFES_GrpRpr.DFC_IntkAirTIntkMnfldSRCMax_C DFES_GrpRpr.DFC_IntkAirTIntkMnfldSRCMin_C DFES_GrpRpr.DFC_IntkAirTIntkMnfldSTC_C DFES_GrpRpr.DFC_KS1max_C DFES_GrpRpr.DFC_KS1min_C DFES_GrpRpr.DFC_LMmax_C DFES_GrpRpr.DFC_LZSRnpl_C DFES_GrpRpr.DFC_LamDynDiagS1B1_C DFES_GrpRpr.DFC_LeakIntkMnfldEmiInfl_C DFES_GrpRpr.DFC_MD00max_C DFES_GrpRpr.DFC_MDBmax_C DFES_GrpRpr.DFC_MDCat_C DFES_GrpRpr.DFC_MDCatCrit_C DFES_GrpRpr.DFC_MDCatCurr_C DFES_GrpRpr.DFC_MDCyl_0_C DFES_GrpRpr.DFC_MDCyl_1_C DFES_GrpRpr.DFC_MDCyl_2_C DFES_GrpRpr.DFC_MDCyl_3_C DFES_GrpRpr.DFC_MDEmi_C DFES_GrpRpr.DFC_MDEmiStrt_C DFES_GrpRpr.DFC_MDFco_C DFES_GrpRpr.DFC_MDMpl_C DFES_GrpRpr.DFC_MDSegTiAdpn_C DFES_GrpRpr.DFC_MDmax_C DFES_GrpRpr.DFC_MOXEMM_SMU_ALM0_0_C DFES_GrpRpr.DFC_MOXEMM_SMU_ALM0_1_C DFES_GrpRpr.DFC_MOXEMM_SMU_ALM0_10_C DFES_GrpRpr.DFC_MOXEMM_SMU_ALM0_11_C DFES_GrpRpr.DFC_MOXEMM_SMU_ALM0_13_C DFES_GrpRpr.DFC_MOXEMM_SMU_ALM0_14_C DFES_GrpRpr.DFC_MOXEMM_SMU_ALM0_2_C DFES_GrpRpr.DFC_MOXEMM_SMU_ALM0_22_C DFES_GrpRpr.DFC_MOXEMM_SMU_ALM0_23_C DFES_GrpRpr.DFC_MOXEMM_SMU_ALM0_4_C DFES_GrpRpr.DFC_MOXEMM_SMU_ALM0_5_C DFES_GrpRpr.DFC_MOXEMM_SMU_ALM0_7_C DFES_GrpRpr.DFC_MOXEMM_SMU_ALM0_8_C DFES_GrpRpr.DFC_MOXEMM_SMU_ALM10_16_C DFES_GrpRpr.DFC_MOXEMM_SMU_ALM10_17_C DFES_GrpRpr.DFC_MOXEMM_SMU_ALM10_21_C DFES_GrpRpr.DFC_MOXEMM_SMU_ALM11_0_C DFES_GrpRpr.DFC_MOXEMM_SMU_ALM11_1_C DFES_GrpRpr.DFC_MOXEMM_SMU_ALM11_2_C DFES_GrpRpr.DFC_MOXEMM_SMU_ALM11_3_C DFES_GrpRpr.DFC_MOXEMM_SMU_ALM11_4_C DFES_GrpRpr.DFC_MOXEMM_SMU_ALM11_5_C DFES_GrpRpr.DFC_MOXEMM_SMU_ALM11_8_C DFES_GrpRpr.DFC_MOXEMM_SMU_ALM11_9_C DFES_GrpRpr.DFC_MOXEMM_SMU_ALM1_0_C DFES_GrpRpr.DFC_MOXEMM_SMU_ALM1_1_C DFES_GrpRpr.DFC_MOXEMM_SMU_ALM1_10_C DFES_GrpRpr.DFC_MOXEMM_SMU_ALM1_11_C DFES_GrpRpr.DFC_MOXEMM_SMU_ALM1_13_C DFES_GrpRpr.DFC_MOXEMM_SMU_ALM1_14_C DFES_GrpRpr.DFC_MOXEMM_SMU_ALM1_2_C DFES_GrpRpr.DFC_MOXEMM_SMU_ALM1_22_C DFES_GrpRpr.DFC_MOXEMM_SMU_ALM1_23_C DFES_GrpRpr.DFC_MOXEMM_SMU_ALM1_4_C DFES_GrpRpr.DFC_MOXEMM_SMU_ALM1_5_C DFES_GrpRpr.DFC_MOXEMM_SMU_ALM1_7_C DFES_GrpRpr.DFC_MOXEMM_SMU_ALM1_8_C DFES_GrpRpr.DFC_MOXEMM_SMU_ALM21_0_C DFES_GrpRpr.DFC_MOXEMM_SMU_ALM21_16_C DFES_GrpRpr.DFC_MOXEMM_SMU_ALM21_3_C DFES_GrpRpr.DFC_MOXEMM_SMU_ALM2_1_C DFES_GrpRpr.DFC_MOXEMM_SMU_ALM2_10_C DFES_GrpRpr.DFC_MOXEMM_SMU_ALM2_11_C DFES_GrpRpr.DFC_MOXEMM_SMU_ALM2_13_C DFES_GrpRpr.DFC_MOXEMM_SMU_ALM2_14_C DFES_GrpRpr.DFC_MOXEMM_SMU_ALM2_22_C DFES_GrpRpr.DFC_MOXEMM_SMU_ALM2_23_C DFES_GrpRpr.DFC_MOXEMM_SMU_ALM2_4_C DFES_GrpRpr.DFC_MOXEMM_SMU_ALM2_5_C DFES_GrpRpr.DFC_MOXEMM_SMU_ALM2_7_C DFES_GrpRpr.DFC_MOXEMM_SMU_ALM2_8_C DFES_GrpRpr.DFC_MOXEMM_SMU_ALM6_0_C DFES_GrpRpr.DFC_MOXEMM_SMU_ALM6_11_C DFES_GrpRpr.DFC_MOXEMM_SMU_ALM6_12_C DFES_GrpRpr.DFC_MOXEMM_SMU_ALM6_14_C DFES_GrpRpr.DFC_MOXEMM_SMU_ALM6_15_C DFES_GrpRpr.DFC_MOXEMM_SMU_ALM6_17_C DFES_GrpRpr.DFC_MOXEMM_SMU_ALM6_18_C DFES_GrpRpr.DFC_MOXEMM_SMU_ALM6_20_C DFES_GrpRpr.DFC_MOXEMM_SMU_ALM6_21_C DFES_GrpRpr.DFC_MOXEMM_SMU_ALM6_25_C DFES_GrpRpr.DFC_MOXEMM_SMU_ALM6_4_C DFES_GrpRpr.DFC_MOXEMM_SMU_ALM6_5_C DFES_GrpRpr.DFC_MOXEMM_SMU_ALM6_7_C DFES_GrpRpr.DFC_MOXEMM_SMU_ALM6_8_C DFES_GrpRpr.DFC_MOXEMM_SMU_ALM7_1_C DFES_GrpRpr.DFC_MOXEMM_SMU_ALM7_12_C DFES_GrpRpr.DFC_MOXEMM_SMU_ALM7_13_C DFES_GrpRpr.DFC_MOXEMM_SMU_ALM7_14_C DFES_GrpRpr.DFC_MOXEMM_SMU_ALM7_15_C DFES_GrpRpr.DFC_MOXEMM_SMU_ALM7_16_C DFES_GrpRpr.DFC_MOXEMM_SMU_ALM7_17_C DFES_GrpRpr.DFC_MOXEMM_SMU_ALM7_2_C DFES_GrpRpr.DFC_MOXEMM_SMU_ALM7_20_C DFES_GrpRpr.DFC_MOXEMM_SMU_ALM7_25_C DFES_GrpRpr.DFC_MOXEMM_SMU_ALM7_26_C DFES_GrpRpr.DFC_MOXEMM_SMU_ALM7_28_C DFES_GrpRpr.DFC_MOXEMM_SMU_ALM7_29_C DFES_GrpRpr.DFC_MOXEMM_SMU_ALM7_30_C DFES_GrpRpr.DFC_MOXEMM_SMU_ALM7_31_C DFES_GrpRpr.DFC_MOXEMM_SMU_ALM8_0_C DFES_GrpRpr.DFC_MOXEMM_SMU_ALM8_1_C DFES_GrpRpr.DFC_MOXEMM_SMU_ALM8_10_C DFES_GrpRpr.DFC_MOXEMM_SMU_ALM8_11_C DFES_GrpRpr.DFC_MOXEMM_SMU_ALM8_12_C DFES_GrpRpr.DFC_MOXEMM_SMU_ALM8_16_C DFES_GrpRpr.DFC_MOXEMM_SMU_ALM8_18_C DFES_GrpRpr.DFC_MOXEMM_SMU_ALM8_2_C DFES_GrpRpr.DFC_MOXEMM_SMU_ALM8_3_C DFES_GrpRpr.DFC_MOXEMM_SMU_ALM8_31_C DFES_GrpRpr.DFC_MOXEMM_SMU_ALM8_4_C DFES_GrpRpr.DFC_MOXEMM_SMU_ALM9_0_C DFES_GrpRpr.DFC_MOXEMM_SMU_ALM9_15_C DFES_GrpRpr.DFC_MOXEMM_SMU_ALM9_3_C DFES_GrpRpr.DFC_MoCADCNTP_C DFES_GrpRpr.DFC_MoCADCTst_C DFES_GrpRpr.DFC_MoCSOPICO_C DFES_GrpRpr.DFC_MoFAPP_C DFES_GrpRpr.DFC_MoFAirFilgPrdc_C DFES_GrpRpr.DFC_MoFAirFlCtOffPfi_C DFES_GrpRpr.DFC_MoFAirFlCylPfi_C DFES_GrpRpr.DFC_MoFAirFlIn_C DFES_GrpRpr.DFC_MoFAirFlMixCtlPfiChkAirFl_C DFES_GrpRpr.DFC_MoFAirFlMixCtlPfiChkCtrl_C DFES_GrpRpr.DFC_MoFAirFlMode_C DFES_GrpRpr.DFC_MoFESpd_C DFES_GrpRpr.DFC_MoFIACo_C DFES_GrpRpr.DFC_MoFICOL1_C DFES_GrpRpr.DFC_MoFICOL2_C DFES_GrpRpr.DFC_MoFStrt_C DFES_GrpRpr.DFC_MoFTrqCmp_C DFES_GrpRpr.DFC_MoFTrqCmpMax_C DFES_GrpRpr.DFC_MoFTrqCmpMin_C DFES_GrpRpr.DFC_MoFVarPostBldSel_C DFES_GrpRpr.DFC_MoXEMMHwLTMCUFW_C DFES_GrpRpr.DFC_MoXEMMHwLTMonBIST_C DFES_GrpRpr.DFC_MoXEMMHwLTRegMonTest_C DFES_GrpRpr.DFC_MoXEMMHwLTStbySMUAlvTest_C /end DEF_CHARACTERISTIC
 FUNCTION_VERSION "30000.73.0_2.0.0" /end FUNCTION
/begin COMPU_METHOD DFC_Verb "" TAB_VERB "%6.3" "-" COMPU_TAB_REF DFC_Verb /end COMPU_METHOD
/begin COMPU_VTAB DFC_Verb "" TAB_VERB 704 0 "DFC_Unused" 318 "DFC_ACEvpTSRCMax" 319 "DFC_ACEvpTSRCMin" 320 "DFC_AirCClntPAnaSRCMax" 321 "DFC_AirCClntPAnaSRCMin" 259 "DFC_AirCCmprOL" 260 "DFC_AirCCmprOvrTemp" 261 "DFC_AirCCmprSCB" 262 "DFC_AirCCmprSCG" 322 "DFC_AirCSwtNpl" 323 "DFC_AirCSwtSig" 263 "DFC_AltErr" 1 "DFC_AltIOACGFailr" 2 "DFC_AltIOACGHiVltg" 3 "DFC_AltIOACGLoVltg" 4 "DFC_AltIOACGTHi" 5 "DFC_AltIODConnACG" 429 "DFC_AppAllSnsrDfct" 6 "DFC_BattUHiFailr" 7 "DFC_BattULoFailr" 264 "DFC_BattUSRCMax" 265 "DFC_BattUSRCMin" 430 "DFC_BattUStdbyDiaOL" 431 "DFC_BigLeakIntkMnfldEmiInfl" 324 "DFC_Brk" 8 "DFC_BrkBstPDriftHiErr" 9 "DFC_BrkBstPDriftLoErr" 10 "DFC_BrkBstPSnsrStuck" 11 "DFC_BrkMnSwtContOn" 432 "DFC_BrkMnSwtContOnWarnLmp" 12 "DFC_BrkMnSwtNotStp" 433 "DFC_BrkMnSwtNotStpWarnLmp" 13 "DFC_BrkNpl" 14 "DFC_BrkRdntSwtContOn" 434 "DFC_BrkRdntSwtContOnWarnLmp" 15 "DFC_BrkRdntSwtNotStp" 435 "DFC_BrkRdntSwtNotStpWarnLmp" 325 "DFC_BrkSig" 417 "DFC_BSWM_E_ACTION_FAILED" 418 "DFC_BSWM_E_INTRPTQUEUE_FULL" 393 "DFC_BusDiagCANAPPLBusOff" 394 "DFC_BusDiagCANCANCBusOff" 395 "DFC_BusDiagCANVEHICLEBusOff" 411 "DFC_CAN_E_TIMEOUT" 436 "DFC_CEngDsTColdStrtMax" 437 "DFC_CEngDsTColdStrtMin" 438 "DFC_CEngDsTImps" 439 "DFC_CEngDsTPlausLSC" 440 "DFC_CEngDsTPlausSTC" 443 "DFC_CEngDsTSig" 441 "DFC_CEngDsTSRCMax" 442 "DFC_CEngDsTSRCMin" 444 "DFC_CEngUsTSRCMax" 445 "DFC_CEngUsTSRCMin" 366 "DFC_Clth2ONStuck" 367 "DFC_Clth2ONStuckLdc" 16 "DFC_Clth3ONStuck" 368 "DFC_Clth3ONStuckLdc" 369 "DFC_Clth3ONStuckPostDrv" 17 "DFC_Clth4OFFStuck" 370 "DFC_Clth4ONStuck" 371 "DFC_Clth4ONStuckLdc" 236 "DFC_ClthMax" 336 "DFC_ClthNpl" 18 "DFC_ClthOFFStuck" 19 "DFC_ClthONStuck" 326 "DFC_ClthSig" 20 "DFC_ClthStkFailInfo" 21 "DFC_ComACFailInfo" 22 "DFC_ComATFTValErr" 23 "DFC_ComATMILReq" 24 "DFC_ComAYCAChksum" 25 "DFC_ComAYCARingCnt" 26 "DFC_ComAYCATOut" 27 "DFC_ComAYCDChkSum" 28 "DFC_ComAYCDTOut" 29 "DFC_ComAYCFChksum" 30 "DFC_ComAYCFRingCnt" 31 "DFC_ComAYCFTOut" 32 "DFC_ComAYCGChksum" 33 "DFC_ComAYCGRingCnt" 34 "DFC_ComAYCGTOut" 35 "DFC_ComAYCIChkSum" 36 "DFC_ComAYCIRingCnt" 37 "DFC_ComAYCITOut" 38 "DFC_ComBCM1ChkSum" 39 "DFC_ComBCM1RingCnt" 40 "DFC_ComBCM1TOut" 41 "DFC_ComCANABusOffErr" 42 "DFC_ComCANBBusOffErr" 43 "DFC_ComCANCBusOffErr" 44 "DFC_ComCGW1ChkSum" 45 "DFC_ComCGW1RingCnt" 46 "DFC_ComCGW1TOut" 266 "DFC_ComChksTCU1" 267 "DFC_ComChksTCU11" 268 "DFC_ComChksTCU12" 269 "DFC_ComChksTCU13" 270 "DFC_ComChksTCU2" 271 "DFC_ComChksTCU3" 272 "DFC_ComChksTCU4" 273 "DFC_ComCntTCU1" 274 "DFC_ComCntTCU11" 275 "DFC_ComCntTCU12" 276 "DFC_ComCntTCU13" 277 "DFC_ComCntTCU2" 278 "DFC_ComCntTCU3" 279 "DFC_ComCntTCU4" 47 "DFC_ComConvBoostErr" 48 "DFC_ComConvSlipErr" 372 "DFC_ComDLCTCU01" 373 "DFC_ComDLCTCU02" 374 "DFC_ComDLCTCU1" 375 "DFC_ComDLCTCU11" 376 "DFC_ComDLCTCU12" 377 "DFC_ComDLCTCU13" 378 "DFC_ComDLCTCU14" 379 "DFC_ComDLCTCU2" 380 "DFC_ComDLCTCU3" 381 "DFC_ComDLCTCU4" 49 "DFC_ComEAT10Chksum" 50 "DFC_ComEAT10RingCnt" 51 "DFC_ComEAT10TOut" 52 "DFC_ComEAT11ChkSum" 53 "DFC_ComEAT11RingCnt" 54 "DFC_ComEAT11TOut" 55 "DFC_ComEAT12ChkSum" 56 "DFC_ComEAT12RingCnt" 57 "DFC_ComEAT12TOut" 58 "DFC_ComEAT13ChkSum" 59 "DFC_ComEAT13RingCnt" 60 "DFC_ComEAT13TOut" 61 "DFC_ComEAT1Chksum" 62 "DFC_ComEAT1RingCnt" 63 "DFC_ComEAT1TOut" 64 "DFC_ComEAT2ChkSum" 65 "DFC_ComEAT2RingCnt" 66 "DFC_ComEAT2TOut" 67 "DFC_ComEAT4ChkSum" 68 "DFC_ComEAT4RingCnt" 69 "DFC_ComEAT4TOut" 70 "DFC_ComEAT6Chksum" 71 "DFC_ComEAT6RingCnt" 72 "DFC_ComEAT6TOut" 73 "DFC_ComEAT7Chksum" 74 "DFC_ComEAT7RingCnt" 75 "DFC_ComEAT7TOut" 76 "DFC_ComEAT8Chksum" 77 "DFC_ComEAT8RingCnt" 78 "DFC_ComEAT8TOut" 79 "DFC_ComEATAChksum" 80 "DFC_ComEATARingCnt" 81 "DFC_ComEATATOut" 82 "DFC_ComEATBChkSum" 83 "DFC_ComEATBRingCnt" 84 "DFC_ComEATBTOut" 85 "DFC_ComEATCChksum" 86 "DFC_ComEATCRingCnt" 87 "DFC_ComEATCTOut" 88 "DFC_ComEBBAChksum" 89 "DFC_ComEBBARingCnt" 90 "DFC_ComEBBATOut" 94 "DFC_ComEngCanRxErr" 91 "DFC_ComEPS1Chksum" 92 "DFC_ComEPS1RingCnt" 93 "DFC_ComEPS1TOut" 95 "DFC_ComGrvySnsrErr" 96 "DFC_ComGwIMG1ChkSum" 97 "DFC_ComGwIMG1RingCnt" 98 "DFC_ComGwIMG1TOut" 99 "DFC_ComGwIMG3ChkSum" 100 "DFC_ComGwIMG3RingCnt" 101 "DFC_ComGwIMG3TOut" 102 "DFC_ComGwIMG4ChkSum" 103 "DFC_ComGwIMG4RingCnt" 104 "DFC_ComGwIMG4TOut" 105 "DFC_ComGwIMG5ChkSum" 106 "DFC_ComGwIMG5RingCnt" 107 "DFC_ComGwIMG5TOut" 108 "DFC_ComGwIMG6ChkSum" 109 "DFC_ComGwIMG6RingCnt" 110 "DFC_ComGwIMG6TOut" 111 "DFC_ComIDASBChksum" 112 "DFC_ComIDASBRingCnt" 113 "DFC_ComIDASBTOut" 114 "DFC_ComIMGMILReq" 115 "DFC_ComISSPrms" 116 "DFC_ComMETAChksum" 117 "DFC_ComMETARingCnt" 118 "DFC_ComMETATOut" 119 "DFC_ComMETCChksum" 120 "DFC_ComMETCRingCnt" 121 "DFC_ComMETCTOut" 122 "DFC_ComMETDChksum" 123 "DFC_ComMETDRingCnt" 124 "DFC_ComMETDTOut" 125 "DFC_ComMETE2Chksum" 126 "DFC_ComMETE2RingCnt" 127 "DFC_ComMETE2TOut" 128 "DFC_ComMETFChksum" 129 "DFC_ComMETFRingCnt" 130 "DFC_ComMETFTOut" 131 "DFC_ComMETGChksum" 132 "DFC_ComMETGRingCnt" 133 "DFC_ComMETGTOut" 134 "DFC_ComMETH2Chksum" 135 "DFC_ComMETH2RingCnt" 136 "DFC_ComMETH2TOut" 137 "DFC_ComMETHChksum" 138 "DFC_ComMETHRingCnt" 139 "DFC_ComMETHTOut" 140 "DFC_ComMETIChksum" 141 "DFC_ComMETIRingCnt" 142 "DFC_ComMETITOut" 143 "DFC_ComMETKChksum" 144 "DFC_ComMETKRingCnt" 145 "DFC_ComMETKTOut" 146 "DFC_ComMETLChksum" 147 "DFC_ComMETLRingCnt" 148 "DFC_ComMETLTOut" 149 "DFC_ComMETMChksum" 150 "DFC_ComMETMRingCnt" 151 "DFC_ComMETMTOut" 152 "DFC_ComMETNChksum" 153 "DFC_ComMETNRingCnt" 154 "DFC_ComMETNTOut" 155 "DFC_ComMtrCom" 156 "DFC_ComPCUChkSum" 157 "DFC_ComPCURingCnt" 158 "DFC_ComPCUTOut" 159 "DFC_ComSRSAChksum" 160 "DFC_ComSRSARingCnt" 161 "DFC_ComSRSATOut" 162 "DFC_ComSRSBChksum" 163 "DFC_ComSRSBRingCnt" 164 "DFC_ComSRSBTOut" 165 "DFC_ComSRSChksum" 166 "DFC_ComSRSErr" 167 "DFC_ComSRSRingCnt" 168 "DFC_ComSRSTOut" 280 "DFC_ComTOutTCU01" 281 "DFC_ComTOutTCU02" 282 "DFC_ComTOutTCU1" 283 "DFC_ComTOutTCU11" 284 "DFC_ComTOutTCU12" 285 "DFC_ComTOutTCU13" 286 "DFC_ComTOutTCU14" 287 "DFC_ComTOutTCU2" 288 "DFC_ComTOutTCU3" 289 "DFC_ComTOutTCU4" 169 "DFC_ComVehSpdPndFltTCU" 446 "DFC_DCDCFltDet" 290 "DFC_DevLibBattUHi" 291 "DFC_DevLibBattULo" 449 "DFC_DKnpl" 447 "DFC_DKRSA" 448 "DFC_DKVSmax" 450 "DFC_DSSmax" 451 "DFC_DSTTI" 452 "DFC_DSUmax" 170 "DFC_EbsChartcCurrErr" 171 "DFC_EbsSelfDiagErr" 383 "DFC_EbsSocFlt" 453 "DFC_EGRVlvOL" 454 "DFC_EGRVlvSCB" 455 "DFC_EGRVlvSCG" 456 "DFC_EGSDUS2B1LtrDly" 457 "DFC_EGSDUS2B1LtrPT1" 458 "DFC_EGSDUS2B1RtlDly" 459 "DFC_EGSDUS2B1RtlPT1" 460 "DFC_EGSDUS2B1TarLean" 461 "DFC_EGSDUS2B1TarRich" 464 "DFC_EngICO" 465 "DFC_EngPrtOvrSpdMon" 466 "DFC_EpmCaSI1ErrSig" 467 "DFC_EpmCaSI1NoSig" 468 "DFC_EpmCaSI1OfsErr" 469 "DFC_EpmCrSErrSig" 470 "DFC_EpmCrSNoSig" 471 "DFC_EtaEngIdleNonCsers" 472 "DFC_EtaEngPtlNonCsers" 462 "DFC_ETAKHLmax" 463 "DFC_ETAKHTmax" 337 "DFC_EV1max" 338 "DFC_EV1min" 339 "DFC_EV1sig" 340 "DFC_EV2max" 341 "DFC_EV2min" 342 "DFC_EV2sig" 343 "DFC_EV3max" 344 "DFC_EV3min" 345 "DFC_EV3sig" 346 "DFC_EV4max" 347 "DFC_EV4min" 348 "DFC_EV4sig" 382 "DFC_EVX" 292 "DFC_FanDIOOL_0" 293 "DFC_FanDIOOL_1" 294 "DFC_FanDIOOvrTemp_0" 295 "DFC_FanDIOOvrTemp_1" 296 "DFC_FanDIOSCB_0" 297 "DFC_FanDIOSCB_1" 298 "DFC_FanDIOSCG_0" 299 "DFC_FanDIOSCG_1" 473 "DFC_FRAmax" 474 "DFC_FRAmin" 172 "DFC_GbxCANDigPlausErr" 173 "DFC_GbxNPos1SRCMax" 174 "DFC_GbxNPos1SRCMin" 175 "DFC_GbxNPos2SRCMax" 176 "DFC_GbxNPos2SRCMin" 177 "DFC_GbxNPosAlvChk" 178 "DFC_GbxNPosSyncErr" 349 "DFC_GbxPNPosnDrvCdn" 350 "DFC_GbxPNPosnPlausy" 475 "DFC_GbxRvsSwtStk" 476 "DFC_HDRmax" 477 "DFC_HEGOS2B1ElecMax" 478 "DFC_HEGOS2B1ElecMin" 479 "DFC_HEGOS2B1ElecSig" 480 "DFC_HEGOS2B1HtgNpl" 179 "DFC_HEGOS2B1HtrPsMax" 180 "DFC_HEGOS2B1HtrPsMin" 181 "DFC_HEGOS2B1HtrPsSig" 327 "DFC_HLSDemOvhtEngLim" 384 "DFC_I14229VINErr" 237 "DFC_IgnClPs_DevComErr" 238 "DFC_IgnClPs_LineOl_0" 239 "DFC_IgnClPs_LineOl_1" 240 "DFC_IgnClPs_LineOl_2" 241 "DFC_IgnClPs_LineOl_3" 242 "DFC_IgnClPs_LineScb_0" 243 "DFC_IgnClPs_LineScb_1" 244 "DFC_IgnClPs_LineScb_2" 245 "DFC_IgnClPs_LineScb_3" 246 "DFC_IgnClPs_LineScg_0" 247 "DFC_IgnClPs_LineScg_1" 248 "DFC_IgnClPs_LineScg_2" 249 "DFC_IgnClPs_LineScg_3" 481 "DFC_IntkAirTIntkMnfldCrssMax" 482 "DFC_IntkAirTIntkMnfldCrssMin" 483 "DFC_IntkAirTIntkMnfldHSCMax" 484 "DFC_IntkAirTIntkMnfldImps" 485 "DFC_IntkAirTIntkMnfldPRCMax" 486 "DFC_IntkAirTIntkMnfldPRCMin" 487 "DFC_IntkAirTIntkMnfldSRCMax" 488 "DFC_IntkAirTIntkMnfldSRCMin" 489 "DFC_IntkAirTIntkMnfldSTC" 362 "DFC_KnDetSens1PortAMax" 363 "DFC_KnDetSens1PortAMin" 364 "DFC_KnDetSens1PortBMax" 365 "DFC_KnDetSens1PortBMin" 490 "DFC_KS1max" 491 "DFC_KS1min" 494 "DFC_LamDynDiagS1B1" 495 "DFC_LeakIntkMnfldEmiInfl" 412 "DFC_LIN_E_TIMEOUT" 182 "DFC_LinCSErrACG" 183 "DFC_LinCSErrEBS" 184 "DFC_LinHdrTimeoutErrACG" 185 "DFC_LinHdrTimeoutErrEBS" 186 "DFC_LinMsgTimeoutErrACG" 187 "DFC_LinMsgTimeoutErrEBS" 188 "DFC_LinNoStrtComErr" 385 "DFC_LLRKHmax" 386 "DFC_LLRKHmin" 387 "DFC_LLRmax" 388 "DFC_LLRmin" 492 "DFC_LMmax" 493 "DFC_LZSRnpl" 496 "DFC_MD00max" 497 "DFC_MDBmax" 498 "DFC_MDCat" 499 "DFC_MDCatCrit" 500 "DFC_MDCatCurr" 501 "DFC_MDCyl_0" 502 "DFC_MDCyl_1" 503 "DFC_MDCyl_2" 504 "DFC_MDCyl_3" 505 "DFC_MDEmi" 506 "DFC_MDEmiStrt" 507 "DFC_MDFco" 510 "DFC_MDmax" 508 "DFC_MDMpl" 509 "DFC_MDSegTiAdpn" 205 "DFC_MisfDetdVWhlFrntLePlaus" 206 "DFC_MisfDetdVWhlFrntRiPlaus" 207 "DFC_MisfDetdVWhlReLePlaus" 208 "DFC_MisfDetdVWhlReRiPlaus" 189 "DFC_MisfDetVWhlFrntLeOORHi" 190 "DFC_MisfDetVWhlFrntLeRatyHi" 191 "DFC_MisfDetVWhlFrntLeRatyLo" 192 "DFC_MisfDetVWhlFrntLeStuck" 193 "DFC_MisfDetVWhlFrntRiOORHi" 194 "DFC_MisfDetVWhlFrntRiRatyHi" 195 "DFC_MisfDetVWhlFrntRiRatyLo" 196 "DFC_MisfDetVWhlFrntRiStuck" 197 "DFC_MisfDetVWhlReLeOORHi" 198 "DFC_MisfDetVWhlReLeRatyHi" 199 "DFC_MisfDetVWhlReLeRatyLo" 200 "DFC_MisfDetVWhlReLeStuck" 201 "DFC_MisfDetVWhlReRiOORHi" 202 "DFC_MisfDetVWhlReRiRatyHi" 203 "DFC_MisfDetVWhlReRiRatyLo" 204 "DFC_MisfDetVWhlReRiStuck" 605 "DFC_MoCADCNTP" 606 "DFC_MoCADCTst" 607 "DFC_MoCSOPICO" 609 "DFC_MoFAirFilgPrdc" 610 "DFC_MoFAirFlCtOffPfi" 611 "DFC_MoFAirFlCylPfi" 612 "DFC_MoFAirFlIn" 613 "DFC_MoFAirFlMixCtlPfiChkAirFl" 614 "DFC_MoFAirFlMixCtlPfiChkCtrl" 615 "DFC_MoFAirFlMode" 608 "DFC_MoFAPP" 616 "DFC_MoFESpd" 617 "DFC_MoFIACo" 618 "DFC_MoFICOL1" 619 "DFC_MoFICOL2" 620 "DFC_MoFStrt" 621 "DFC_MoFTrqCmp" 622 "DFC_MoFTrqCmpMax" 623 "DFC_MoFTrqCmpMin" 624 "DFC_MoFVarPostBldSel" 511 "DFC_MOXEMM_SMU_ALM0_0" 512 "DFC_MOXEMM_SMU_ALM0_1" 513 "DFC_MOXEMM_SMU_ALM0_10" 514 "DFC_MOXEMM_SMU_ALM0_11" 515 "DFC_MOXEMM_SMU_ALM0_13" 516 "DFC_MOXEMM_SMU_ALM0_14" 517 "DFC_MOXEMM_SMU_ALM0_2" 518 "DFC_MOXEMM_SMU_ALM0_22" 519 "DFC_MOXEMM_SMU_ALM0_23" 520 "DFC_MOXEMM_SMU_ALM0_4" 521 "DFC_MOXEMM_SMU_ALM0_5" 522 "DFC_MOXEMM_SMU_ALM0_7" 523 "DFC_MOXEMM_SMU_ALM0_8" 524 "DFC_MOXEMM_SMU_ALM10_16" 525 "DFC_MOXEMM_SMU_ALM10_17" 526 "DFC_MOXEMM_SMU_ALM10_21" 527 "DFC_MOXEMM_SMU_ALM11_0" 528 "DFC_MOXEMM_SMU_ALM11_1" 529 "DFC_MOXEMM_SMU_ALM11_2" 530 "DFC_MOXEMM_SMU_ALM11_3" 531 "DFC_MOXEMM_SMU_ALM11_4" 532 "DFC_MOXEMM_SMU_ALM11_5" 533 "DFC_MOXEMM_SMU_ALM11_8" 534 "DFC_MOXEMM_SMU_ALM11_9" 535 "DFC_MOXEMM_SMU_ALM1_0" 536 "DFC_MOXEMM_SMU_ALM1_1" 537 "DFC_MOXEMM_SMU_ALM1_10" 538 "DFC_MOXEMM_SMU_ALM1_11" 539 "DFC_MOXEMM_SMU_ALM1_13" 540 "DFC_MOXEMM_SMU_ALM1_14" 541 "DFC_MOXEMM_SMU_ALM1_2" 542 "DFC_MOXEMM_SMU_ALM1_22" 543 "DFC_MOXEMM_SMU_ALM1_23" 544 "DFC_MOXEMM_SMU_ALM1_4" 545 "DFC_MOXEMM_SMU_ALM1_5" 546 "DFC_MOXEMM_SMU_ALM1_7" 547 "DFC_MOXEMM_SMU_ALM1_8" 548 "DFC_MOXEMM_SMU_ALM21_0" 549 "DFC_MOXEMM_SMU_ALM21_16" 550 "DFC_MOXEMM_SMU_ALM21_3" 551 "DFC_MOXEMM_SMU_ALM2_1" 552 "DFC_MOXEMM_SMU_ALM2_10" 553 "DFC_MOXEMM_SMU_ALM2_11" 554 "DFC_MOXEMM_SMU_ALM2_13" 555 "DFC_MOXEMM_SMU_ALM2_14" 556 "DFC_MOXEMM_SMU_ALM2_22" 557 "DFC_MOXEMM_SMU_ALM2_23" 558 "DFC_MOXEMM_SMU_ALM2_4" 559 "DFC_MOXEMM_SMU_ALM2_5" 560 "DFC_MOXEMM_SMU_ALM2_7" 561 "DFC_MOXEMM_SMU_ALM2_8" 562 "DFC_MOXEMM_SMU_ALM6_0" 563 "DFC_MOXEMM_SMU_ALM6_11" 564 "DFC_MOXEMM_SMU_ALM6_12" 565 "DFC_MOXEMM_SMU_ALM6_14" 566 "DFC_MOXEMM_SMU_ALM6_15" 567 "DFC_MOXEMM_SMU_ALM6_17" 568 "DFC_MOXEMM_SMU_ALM6_18" 569 "DFC_MOXEMM_SMU_ALM6_20" 570 "DFC_MOXEMM_SMU_ALM6_21" 571 "DFC_MOXEMM_SMU_ALM6_25" 572 "DFC_MOXEMM_SMU_ALM6_4" 573 "DFC_MOXEMM_SMU_ALM6_5" 574 "DFC_MOXEMM_SMU_ALM6_7" 575 "DFC_MOXEMM_SMU_ALM6_8" 576 "DFC_MOXEMM_SMU_ALM7_1" 577 "DFC_MOXEMM_SMU_ALM7_12" 578 "DFC_MOXEMM_SMU_ALM7_13" 579 "DFC_MOXEMM_SMU_ALM7_14" 580 "DFC_MOXEMM_SMU_ALM7_15" 581 "DFC_MOXEMM_SMU_ALM7_16" 582 "DFC_MOXEMM_SMU_ALM7_17" 583 "DFC_MOXEMM_SMU_ALM7_2" 584 "DFC_MOXEMM_SMU_ALM7_20" 585 "DFC_MOXEMM_SMU_ALM7_25" 586 "DFC_MOXEMM_SMU_ALM7_26" 587 "DFC_MOXEMM_SMU_ALM7_28" 588 "DFC_MOXEMM_SMU_ALM7_29" 589 "DFC_MOXEMM_SMU_ALM7_30" 590 "DFC_MOXEMM_SMU_ALM7_31" 591 "DFC_MOXEMM_SMU_ALM8_0" 592 "DFC_MOXEMM_SMU_ALM8_1" 593 "DFC_MOXEMM_SMU_ALM8_10" 594 "DFC_MOXEMM_SMU_ALM8_11" 595 "DFC_MOXEMM_SMU_ALM8_12" 596 "DFC_MOXEMM_SMU_ALM8_16" 597 "DFC_MOXEMM_SMU_ALM8_18" 598 "DFC_MOXEMM_SMU_ALM8_2" 599 "DFC_MOXEMM_SMU_ALM8_3" 600 "DFC_MOXEMM_SMU_ALM8_31" 601 "DFC_MOXEMM_SMU_ALM8_4" 602 "DFC_MOXEMM_SMU_ALM9_0" 603 "DFC_MOXEMM_SMU_ALM9_15" 604 "DFC_MOXEMM_SMU_ALM9_3" 625 "DFC_MoXEMMHwLTMCUFW" 626 "DFC_MoXEMMHwLTMonBIST" 627 "DFC_MoXEMMHwLTRegMonTest" 628 "DFC_MoXEMMHwLTStbySMUAlvTest" 629 "DFC_MoXEMMHwLTTempSens" 630 "DFC_MoXEMMHwLTUCBCfg" 300 "DFC_MRlyDcOL" 301 "DFC_MRlyDcSCB" 302 "DFC_MRlyDcSCG" 413 "DFC_MRlyOL" 414 "DFC_MRlySCB" 415 "DFC_MRlySCG" 631 "DFC_OCWDAABEActv" 632 "DFC_OCWDACom" 633 "DFC_OCWDAErrPin" 634 "DFC_OCWDAOvrVltg" 328 "DFC_OilPNpl" 635 "DFC_ORAmax" 636 "DFC_ORAmin" 647 "DFC_P_VSE11_OL" 648 "DFC_P_VSE11_SCB" 649 "DFC_P_VSE11_SCG" 351 "DFC_PEnvCcMax" 352 "DFC_PEnvCcMin" 353 "DFC_PEnvRngChkMax" 354 "DFC_PEnvRngChkMin" 209 "DFC_PEnvSigRngMax" 210 "DFC_PEnvSigRngMin" 355 "DFC_PEnvSnsrPlaus" 650 "DFC_PhyHighAPP1" 651 "DFC_PhyHighAPP2" 652 "DFC_PhyLowAPP1" 653 "DFC_PhyLowAPP2" 329 "DFC_PIntkVUsLineHiB1" 330 "DFC_PIntkVUsLineLoB1" 637 "DFC_PLLSUmax" 638 "DFC_PLLSUmin" 303 "DFC_PSPOL" 304 "DFC_PSPOvrTemp" 305 "DFC_PSPSCB" 306 "DFC_PSPSCG" 639 "DFC_PSR1max" 640 "DFC_PSRBmax" 641 "DFC_PSRBmin" 645 "DFC_PSRmax" 642 "DFC_PSRPmax" 643 "DFC_PSRPmin" 644 "DFC_PSRPsig" 646 "DFC_PUmax" 396 "DFC_RBA_IODIAGPWR_rba_IoExtCy329_SignalVltSply_0" 397 "DFC_RBA_IODIAGPWR_rba_IoExtCy329_SignalVltSply_0OT" 398 "DFC_RBA_IODIAGPWR_rba_IoExtCy329_SignalVltSply_0OV" 399 "DFC_RBA_IODIAGPWR_rba_IoExtCy329_SignalVltSply_0SCG" 400 "DFC_RBA_IODIAGPWR_rba_IoExtCy329_SignalVltSply_0UV" 401 "DFC_RBA_IODIAGPWR_rba_IoExtCy329_SignalVltSply_1" 402 "DFC_RBA_IODIAGPWR_rba_IoExtCy329_SignalVltSply_1OT" 403 "DFC_RBA_IODIAGPWR_rba_IoExtCy329_SignalVltSply_1OV" 404 "DFC_RBA_IODIAGPWR_rba_IoExtCy329_SignalVltSply_1SCG" 405 "DFC_RBA_IODIAGPWR_rba_IoExtCy329_SignalVltSply_1UV" 406 "DFC_RBA_IODIAGPWR_rba_IoExtCy329_SignalVltSply_2" 407 "DFC_RBA_IODIAGPWR_rba_IoExtCy329_SignalVltSply_2OT" 408 "DFC_RBA_IODIAGPWR_rba_IoExtCy329_SignalVltSply_2OV" 409 "DFC_RBA_IODIAGPWR_rba_IoExtCy329_SignalVltSply_2SCG" 410 "DFC_RBA_IODIAGPWR_rba_IoExtCy329_SignalVltSply_2UV" 419 "DFC_RBA_IOEXTLIB_KEEPALIVE_DRV" 420 "DFC_RBA_IOEXTLIB_KEEPALIVE_INI" 421 "DFC_rba_IoSigRtc_StopCounter" 423 "DFC_rba_MemDiag_MemReadErr" 424 "DFC_rba_MemDiag_MemWrErr" 422 "DFC_rba_MRly_Diag_Stk_Event" 416 "DFC_rba_MultiStackTrace_Threshold" 425 "DFC_rba_SyC_IrrSwOffTrigEngRun_Event" 426 "DFC_rba_T15_Diag_ComInVld_Event" 427 "DFC_rba_T15_Diag_ComOff_HwOn_Event" 428 "DFC_rba_T15_Diag_ComOn_HwOff_Event" 389 "DFC_RoughRoad" 390 "DFC_SiaEEPRdErr" 391 "DFC_SiaEEPWrngCod" 654 "DFC_SRCHighAPP1" 655 "DFC_SRCHighAPP2" 656 "DFC_SRCLowAPP1" 657 "DFC_SRCLowAPP2" 658 "DFC_SSpMon2" 211 "DFC_StmFault" 213 "DFC_StrtCtlErr" 212 "DFC_StrtCtOffPth" 214 "DFC_StrtFault" 215 "DFC_StrtLckJudg1" 216 "DFC_StrtLckJudg2" 217 "DFC_StrtOL" 218 "DFC_StrtOL2" 219 "DFC_StrtSCB" 220 "DFC_StrtSCB2" 221 "DFC_StrtSCG" 222 "DFC_StrtSCG2" 223 "DFC_StrtStkRly1" 224 "DFC_StrtStkRly2" 659 "DFC_SWReset_0" 660 "DFC_SWReset_1" 661 "DFC_SWReset_2" 662 "DFC_SyncAPP" 307 "DFC_T50Err" 663 "DFC_TAmax_Dummy" 225 "DFC_TEVEmax" 226 "DFC_TEVEmin" 227 "DFC_TEVEsig" 671 "DFC_ThrVlvClsdPosnFirstOffsLrnImpoB1" 672 "DFC_ThrVlvClsdPosnOffsLrnImpoB1" 673 "DFC_ThrVlvClsdPosnOffsLrnMaxB1" 674 "DFC_ThrVlvClsdPosnOffsLrnMinB1" 675 "DFC_ThrVlvCtrlDeB1" 676 "DFC_ThrVlvDycB1" 677 "DFC_ThrVlvLimpAirPosnMaxAbsltDriftB1" 678 "DFC_ThrVlvLimpAirPosnMaxB1" 679 "DFC_ThrVlvLimpAirPosnMaxRelDriftB1" 680 "DFC_ThrVlvLimpAirPosnMinB1" 308 "DFC_ThrVlvLoBattB1" 681 "DFC_ThrVlvOpenLoadB1" 682 "DFC_ThrVlvOpenSprgB1" 683 "DFC_ThrVlvOpenSprgSprdB1" 684 "DFC_ThrVlvOpenSprgTwnB1" 685 "DFC_ThrVlvOverTB1" 686 "DFC_ThrVlvRetSprgB1" 687 "DFC_ThrVlvRetSprgSprdB1" 688 "DFC_ThrVlvRetSprgTwnB1" 689 "DFC_ThrVlvSens1MaxB1" 696 "DFC_ThrvlvSens1MinB1" 690 "DFC_ThrVlvSens1NplB1" 691 "DFC_ThrVlvSens2MaxB1" 692 "DFC_ThrVlvSens2MinB1" 693 "DFC_ThrVlvSens2NplB1" 694 "DFC_ThrVlvShoCircB1" 695 "DFC_ThrVlvSpiErrB1" 697 "DFC_TiOffTBasdChkFast" 698 "DFC_TiOffTBasdChkSlow" 664 "DFC_TKAEmax" 665 "DFC_TKAEmin" 666 "DFC_TKARmax" 667 "DFC_TKARnpl" 668 "DFC_TMmax_Dummy" 669 "DFC_TUMmax_Dummy" 670 "DFC_TWCDPriCatB1" 250 "DFC_UEGOASICS1B1" 392 "DFC_UegoDummy" 699 "DFC_UEGOHeatrCtlS1B1" 356 "DFC_UEGOHeatrPsS1B1Max" 357 "DFC_UEGOHeatrPsS1B1Min" 358 "DFC_UEGOHeatrPsS1B1Sig" 359 "DFC_UEGOHeatrRlyPsOLS1B1" 360 "DFC_UEGOHeatrRlyPsSCBS1B1" 361 "DFC_UEGOHeatrRlyPsSCGS1B1" 257 "DFC_UegoOlApesS1B1" 251 "DFC_UEGOOLIPES1B1" 258 "DFC_UegoOlRCmpS1B1" 252 "DFC_UEGOOLRES1B1" 253 "DFC_UEGOSCBS1B1" 254 "DFC_UEGOSCGS1B1" 700 "DFC_UEGOSnsrMntdS1B1" 256 "DFC_UEGOSnsrS1B1" 255 "DFC_UEGOSPIS1B1" 228 "DFC_VehVAllPlaus" 229 "DFC_VehVNCSnsrElecFailr" 309 "DFC_VehVPhysRngHi" 331 "DFC_VehVPhysRngLo" 230 "DFC_VehVPlausCan" 231 "DFC_VehVPlausFco" 232 "DFC_VehVPlausPwr" 233 "DFC_VehVPlausV2N" 310 "DFC_VehVSclOutOL" 311 "DFC_VehVSclOutOT" 312 "DFC_VehVSclOutSCB" 313 "DFC_VehVSclOutSCG" 701 "DFC_VehVSig" 332 "DFC_VehVSigCan" 333 "DFC_VehVSigCanSafe" 314 "DFC_VehVSnsrARngHi" 315 "DFC_VehVSnsrBRngHi" 316 "DFC_VehVSpdRtyDiag" 234 "DFC_VehVSpdSnsrAElecFailr" 235 "DFC_VehVSpdSnsrBElecFailr" 317 "DFC_VehVWhlErr" 334 "DFC_VlvLftFbOilPSnsrIntk11SRCMax" 335 "DFC_VlvLftFbOilPSnsrIntk11SRCMin" 702 "DFC_VlvLftFbSwtIntk11SpclFail" 703 "DFC_VlvLftFbSwtIntk11StdFail" DEFAULT_VALUE "---" /end COMPU_VTAB
/begin RECORD_LAYOUT Val_Wu16 FNC_VALUES 1 UWORD COLUMN_DIR DIRECT /end RECORD_LAYOUT
/end MODULE
/end PROJECT
