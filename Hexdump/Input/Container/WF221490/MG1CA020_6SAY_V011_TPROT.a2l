ASAP2_VERSION 1 60
/begin PROJECT MG1CA020 "MG1CA020"
/begin HEADER "" VERSION "MG1CA020_6SAY_V011_TPROT" PROJECT_NO MG1CA020 /end HEADER
/begin MODULE DIM ""
/begin MOD_COMMON "" BYTE_ORDER MSB_LAST ALIGNMENT_BYTE 1 ALIGNMENT_WORD 2 ALIGNMENT_LONG 4 ALIGNMENT_INT64 4 ALIGNMENT_FLOAT32_IEEE 4 ALIGNMENT_FLOAT64_IEEE 4 DATA_SIZE 32 /end MOD_COMMON
/begin CHARACTERISTIC CoEOM_BdeLcyMpg_I.OperMod2Idx_M "Mapping of a 16-bit mode of operation to the classic 8-bit GDI mode of operation. / Mapping-Table for the conversion of the operation-mode-information in an other format" MAP 0x80508C82 RB_Map_U8U8_U8 255.0 OneToOne 0.00 255.0 FORMAT "%5.1"
 /begin AXIS_DESCR STD_AXIS NO_INPUT_QUANTITY CoEOM_idxOperModCfgd_VERB 4 0.00 3.00000000000 FORMAT "%13.11" DEPOSIT ABSOLUTE /end AXIS_DESCR
 /begin AXIS_DESCR STD_AXIS NO_INPUT_QUANTITY CoEOM_idxOperModStgTot_VERB 5 0.00 15.0000000000 FORMAT "%13.10" DEPOSIT ABSOLUTE /end AXIS_DESCR
/end CHARACTERISTIC
/begin CHARACTERISTIC CoEOM_dmCvlc_C "Delta air mass threshold that decides that a coordinated torque neutral switch is necessary" VALUE 0x80508B98 RB_Val_Ws16 1535.977 rel_q0p02344 -768.0000 767.9766 FORMAT "%8.4" /end CHARACTERISTIC
/begin CHARACTERISTIC CoEOM_flgActvdEomSwtIniStrt_C "Parameter for activation of initialization to CoEOM_stEOMIni_C at start request" VALUE 0x80508B9A RB_Val_Wu8 1.00000000000 B_TRUE 0.00 1.00000000000 FORMAT "%13.11" /end CHARACTERISTIC
/begin CHARACTERISTIC CoEOM_flgEnblSwtStgyStrt_C "Activation of shift strategy 1 at CoEng_stMai == COENG_ST_STARTING" VALUE 0x80508B9B RB_Val_Wu8 1.00000000000 B_TRUE 0.00 1.00000000000 FORMAT "%13.11" /end CHARACTERISTIC
/begin CHARACTERISTIC CoEOM_flgEomInterHosPln_C "Only for testing: determination of CoEOM_flgEomInterHosPln (0 -- false)." VALUE 0x80508C72 RB_Val_Wu8 255.0 OneToOne 0.00 255.0 FORMAT "%5.1" /end CHARACTERISTIC
/begin CHARACTERISTIC CoEOM_idxSwtStgySeld_M "Map to define the shift strategy dependent on the EOM" MAP 0x80508B9C RB_Map_U8U8_U8 255.0 OneToOne 0.00 255.0 FORMAT "%5.1"
 /begin AXIS_DESCR STD_AXIS CoEOM_idxGroupEomActv OneToOne 7 0.00 255.0 FORMAT "%5.1" DEPOSIT ABSOLUTE /end AXIS_DESCR
 /begin AXIS_DESCR STD_AXIS CoEOM_idxGroupEomDes OneToOne 7 0.00 255.0 FORMAT "%5.1" DEPOSIT ABSOLUTE /end AXIS_DESCR
/end CHARACTERISTIC
/begin CHARACTERISTIC CoEOM_InbnMatModi_a "Inhibit matrix, in which only configured operating modes and stages can be selected" VAL_BLK 0x80508BDE RB_ValA_Wu16 65535.00 OneToOne 0.00 65535.00 FORMAT "%8.2" READ_ONLY NUMBER 32 /end CHARACTERISTIC
/begin CHARACTERISTIC CoEOM_stEnblEomSwt_C "Bit coded parameter to select, in which conditions of CoEng_stMai a new engine operation mode is accepted" VALUE 0x80508C1E RB_Val_Wu16 65535.00 OneToOne 0.00 65535.00 FORMAT "%8.2" /end CHARACTERISTIC
/begin AXIS_PTS CoEOM_stEomActv_AX "" 0x80508C20 NO_INPUT_QUANTITY RB_Axis_U16 7951.00000000 CoEOM_stEomStgTot_VERB 4 0.00 7951.00000000 FORMAT "%13.8" DEPOSIT ABSOLUTE /end AXIS_PTS
/begin AXIS_PTS CoEOM_stEomDesReqd_AX "distribution for requested mode of operation - interpolation of group axis allowed only in synchro task" 0x80508C2A NO_INPUT_QUANTITY RB_Axis_U16 7951.00000000 CoEOM_stEomStgTot_VERB 4 0.00 7951.00000000 FORMAT "%13.8" DEPOSIT ABSOLUTE /end AXIS_PTS
/begin CHARACTERISTIC CoEOM_stEOMIni_C "Initialization value of operating mode" VALUE 0x80508C34 RB_Val_Wu16 7951.00000000 CoEOM_stEomStgTot_VERB 0.00 7951.00000000 FORMAT "%13.8" /end CHARACTERISTIC
/begin CHARACTERISTIC CoEOM_stEomStgyIgnRels_C "Bitmask to control the ignition angle release dependent on the switch strategy" VALUE 0x80508C36 RB_Val_Wu8 255.0 OneToOne 0.00 255.0 FORMAT "%5.1" /end CHARACTERISTIC
/begin CHARACTERISTIC CoEOM_stPhaEomIgnRels_C "Phase of operation mode to request a ignition angle release." VALUE 0x80508C37 RB_Val_Wu8 255.0 OneToOne 0.00 255.0 FORMAT "%5.1" /end CHARACTERISTIC
/begin CHARACTERISTIC CoEOM_stPhaEomShift2_C "Threshold phase of the mode of operation change-over" VALUE 0x80508C73 RB_Val_Wu8 255.0 OneToOne 0.00 255.0 FORMAT "%5.1" /end CHARACTERISTIC
/begin CHARACTERISTIC CoEOM_stPhaEomShift_C "Threshold phase of the mode of operation change-over" VALUE 0x80508C74 RB_Val_Wu8 255.0 OneToOne 0.00 255.0 FORMAT "%5.1" /end CHARACTERISTIC
/begin CHARACTERISTIC CoEOM_stThdPhaEomShiftMax_C "A range of switching states is protected to be interrupted. This is the maximum threshold of the protected area" VALUE 0x80508C38 RB_Val_Wu8 255.0 OneToOne 0.00 255.0 FORMAT "%5.1" /end CHARACTERISTIC
/begin CHARACTERISTIC CoEOM_stThdPhaEomShiftMin_C "A range of switching states is protected to be interrupted. This is the minimum threshold of the protected area" VALUE 0x80508C39 RB_Val_Wu8 255.0 OneToOne 0.00 255.0 FORMAT "%5.1" /end CHARACTERISTIC
/begin CHARACTERISTIC CoEOM_SwtStgy1.stTrigAftSwt_C "Switching strategy of eom switches that operates without trigger / Needed actuators at the end of a switch" VALUE 0x80508C3C RB_Val_Wu16 65535.00 OneToOne 0.00 65535.00 FORMAT "%8.2" /end CHARACTERISTIC
/begin CHARACTERISTIC CoEOM_SwtStgy1.tiMaxAirStaty_C "Switching strategy of eom switches that operates without trigger / Time-out label for AirSys feedback" VALUE 0x80508C3E RB_Val_Ws16 655.3500 Time_s -327.6800 327.6700 FORMAT "%8.4" /end CHARACTERISTIC
/begin CHARACTERISTIC CoEOM_SwtStgy2.stTrigAftSwt_C "Switching strategy of eom switches that operates with triggers and filling preparation / Needed actuators at the end of a switch" VALUE 0x80508C40 RB_Val_Wu16 65535.00 OneToOne 0.00 65535.00 FORMAT "%8.2" /end CHARACTERISTIC
/begin CHARACTERISTIC CoEOM_SwtStgy2.stTrig_C "Switching strategy of eom switches that operates with triggers and filling preparation / Label to calibrate the desired preparation trigger" VALUE 0x80508C42 RB_Val_Wu16 65535.00 OneToOne 0.00 65535.00 FORMAT "%8.2" /end CHARACTERISTIC
/begin CHARACTERISTIC CoEOM_SwtStgy2.tiMaxAirPrep_C "Switching strategy of eom switches that operates with triggers and filling preparation / Maximal time of filling preparation" VALUE 0x80508C44 RB_Val_Ws16 655.3500 Time_s -327.6800 327.6700 FORMAT "%8.4" /end CHARACTERISTIC
/begin CHARACTERISTIC CoEOM_SwtStgy2.tiMaxAirStaty_C "Switching strategy of eom switches that operates with triggers and filling preparation / Time-out label for AirSys feedback" VALUE 0x80508C46 RB_Val_Ws16 655.3500 Time_s -327.6800 327.6700 FORMAT "%8.4" /end CHARACTERISTIC
/begin CHARACTERISTIC CoEOM_SwtStgy2.tiMaxTrigAckd_C "Switching strategy of eom switches that operates with triggers and filling preparation / Time-out label for trigger feedback" VALUE 0x80508C48 RB_Val_Ws16 655.3500 Time_s -327.6800 327.6700 FORMAT "%8.4" /end CHARACTERISTIC
/begin CHARACTERISTIC CoEOM_SwtStgy5.stTrigAftSwt_C "Switch strategy for triggered valve lift switch / Label to calibrate the desired triggers (new stationary values) after a switch" VALUE 0x80508C4A RB_Val_Wu16 65535.00 OneToOne 0.00 65535.00 FORMAT "%8.2" /end CHARACTERISTIC
/begin CHARACTERISTIC CoEOM_SwtStgy5.stTrig_C "Switch strategy for triggered valve lift switch / Label to calibrate the desired preparation trigger" VALUE 0x80508C4C RB_Val_Wu16 65535.00 OneToOne 0.00 65535.00 FORMAT "%8.2" /end CHARACTERISTIC
/begin CHARACTERISTIC CoEOM_SwtStgy5.tiMaxAirStaty_C "Switch strategy for triggered valve lift switch / Time-out label for AirSys feedback" VALUE 0x80508C4E RB_Val_Ws16 655.3500 Time_s -327.6800 327.6700 FORMAT "%8.4" /end CHARACTERISTIC
/begin CHARACTERISTIC CoEOM_SwtStgy5.tiMaxTrigAckd_C "Switch strategy for triggered valve lift switch / Time-out label for trigger feedback" VALUE 0x80508C50 RB_Val_Ws16 655.3500 Time_s -327.6800 327.6700 FORMAT "%8.4" /end CHARACTERISTIC
/begin CHARACTERISTIC CoEOM_SwtStgy_I.OperMod2Idx_M "Map to select the desired switching strategy: Here, groups of eoms and stages can be made / Mapping-Table for the conversion of the operation-mode-information in an other format" MAP 0x80508C52 RB_Map_U8U8_U8 255.0 OneToOne 0.00 255.0 FORMAT "%5.1"
 /begin AXIS_DESCR STD_AXIS NO_INPUT_QUANTITY CoEOM_idxOperModCfgd_VERB 4 0.00 3.00000000000 FORMAT "%13.11" DEPOSIT ABSOLUTE /end AXIS_DESCR
 /begin AXIS_DESCR STD_AXIS NO_INPUT_QUANTITY CoEOM_idxOperModStgTot_VERB 5 0.00 15.0000000000 FORMAT "%13.10" DEPOSIT ABSOLUTE /end AXIS_DESCR
/end CHARACTERISTIC
/begin CHARACTERISTIC CoEOM_trqInrLimDelta_C "Delta for limited torque request for set path" VALUE 0x80508C3A RB_Val_Ws16 6553.500 md_q0p1 -3276.800 3276.700 FORMAT "%8.3" /end CHARACTERISTIC
/begin CHARACTERISTIC CoEOM_VheLcyMpg_I.OperMod2Idx_M "Mapping of a 16-bit mode of operation to the valve lift. / Mapping-Table for the conversion of the operation-mode-information in an other format" MAP 0x80508CA2 RB_Map_U8U8_U8 255.0 OneToOne 0.00 255.0 FORMAT "%5.1"
 /begin AXIS_DESCR STD_AXIS NO_INPUT_QUANTITY CoEOM_idxOperModCfgd_VERB 4 0.00 3.00000000000 FORMAT "%13.11" DEPOSIT ABSOLUTE /end AXIS_DESCR
 /begin AXIS_DESCR STD_AXIS NO_INPUT_QUANTITY CoEOM_idxOperModStgTot_VERB 5 0.00 15.0000000000 FORMAT "%13.10" DEPOSIT ABSOLUTE /end AXIS_DESCR
/end CHARACTERISTIC
/begin CHARACTERISTIC CoESS_iElecLdRstLe_C "Electric Load Current Lower threshold" VALUE 0x80508CC4 RB_Val_Ws16 655.3500 Curr_A -327.6800 327.6700 FORMAT "%8.4" /end CHARACTERISTIC
/begin CHARACTERISTIC CoESS_iElecLdRstRht_C "Electric load current high threshold" VALUE 0x80508CC6 RB_Val_Ws16 655.3500 Curr_A -327.6800 327.6700 FORMAT "%8.4" /end CHARACTERISTIC
/begin CHARACTERISTIC CoESS_iElecLdThres_C "Threshold value of electrical load" VALUE 0x80508CC8 RB_Val_Ws16 655.3500 Curr_A -327.6800 327.6700 FORMAT "%8.4" /end CHARACTERISTIC
/begin CHARACTERISTIC CoESS_iEPSLdLe1_C "EPS Load Lower threshold 1" VALUE 0x80508CCA RB_Val_Ws16 655.3500 Curr_A -327.6800 327.6700 FORMAT "%8.4" /end CHARACTERISTIC
/begin CHARACTERISTIC CoESS_iEPSLdLe2_C "EPS Load current Load 2" VALUE 0x80508CCC RB_Val_Ws16 655.3500 Curr_A -327.6800 327.6700 FORMAT "%8.4" /end CHARACTERISTIC
/begin CHARACTERISTIC CoESS_iEPSLdRht1_C "EPS Load current lower threshold 2" VALUE 0x80508CCE RB_Val_Ws16 655.3500 Curr_A -327.6800 327.6700 FORMAT "%8.4" /end CHARACTERISTIC
/begin CHARACTERISTIC CoESS_iEPSLdRht2_C "EPS current load higher threshold" VALUE 0x80508CD0 RB_Val_Ws16 655.3500 Curr_A -327.6800 327.6700 FORMAT "%8.4" /end CHARACTERISTIC
/begin CHARACTERISTIC CoESS_nIdlBattThres_C "Speed threshold value for set condition" VALUE 0x80508CD2 RB_Val_Ws16 32767.50 EngN -16384.00 16383.50 FORMAT "%8.2" /end CHARACTERISTIC
/begin CHARACTERISTIC CoESS_nMax_C "Max. engine speed limitation request from Electrical Supply System" VALUE 0x80508CD4 RB_Val_Ws16 32767.50 EngN -16384.00 16383.50 FORMAT "%8.2" /end CHARACTERISTIC
/begin CHARACTERISTIC CoESS_nMin1Batt_C "Minimum engine speed request 1" VALUE 0x80508CD6 RB_Val_Ws16 32767.50 EngN -16384.00 16383.50 FORMAT "%8.2" /end CHARACTERISTIC
/begin CHARACTERISTIC CoESS_nMin2Batt_C "Minimum engine speed request 2" VALUE 0x80508CD8 RB_Val_Ws16 32767.50 EngN -16384.00 16383.50 FORMAT "%8.2" /end CHARACTERISTIC
/begin CHARACTERISTIC CoESS_nMin3Batt_C "Minimum engine speed request 3" VALUE 0x80508CDA RB_Val_Ws16 32767.50 EngN -16384.00 16383.50 FORMAT "%8.2" /end CHARACTERISTIC
/begin CHARACTERISTIC CoESS_nMin4Batt_C "Minimum Engine speed Request4" VALUE 0x80508CDC RB_Val_Ws16 32767.50 EngN -16384.00 16383.50 FORMAT "%8.2" /end CHARACTERISTIC
/begin CHARACTERISTIC CoESS_nMin5Batt_C "Minimum Engine speed Request 5" VALUE 0x80508CDE RB_Val_Ws16 32767.50 EngN -16384.00 16383.50 FORMAT "%8.2" /end CHARACTERISTIC
/begin CHARACTERISTIC CoESS_nMinAltLoad_C "Minimum alternator idle up speed" VALUE 0x80508CE0 RB_Val_Ws16 32767.50 EngN -16384.00 16383.50 FORMAT "%8.2" /end CHARACTERISTIC
/begin CHARACTERISTIC CoESS_nMinThres_C "Basic threshold value for set condition" VALUE 0x80508CE2 RB_Val_Ws16 32767.50 EngN -16384.00 16383.50 FORMAT "%8.2" /end CHARACTERISTIC
/begin CHARACTERISTIC CoESS_stRampDeActv_C "Switch to deactivate ramping function for blower fan minimum voltage request" VALUE 0x80508D00 RB_Val_Wu8 1.00000000000 B_TRUE 0.00 1.00000000000 FORMAT "%13.11" /end CHARACTERISTIC
/begin CHARACTERISTIC CoESS_swtElecLdSel_C "Calibration parameter to select electrical load" VALUE 0x80508CE4 RB_Val_Wu8 1.000 OneToOne 0.00 1.000 FORMAT "%5.3" EXTENDED_LIMITS 0.00 255.0 /end CHARACTERISTIC
/begin CHARACTERISTIC CoESS_tiAltIdleUp_C "Filter time for alternator idle up speed request" VALUE 0x80508CE8 RB_Val_Ws32 4294.9672940000000 TimeDelay_s 0.0000020000000 4294.9672959999998 FORMAT "%19.14" EXTENDED_LIMITS 0.000002000000001 4294.9672959999998 /end CHARACTERISTIC
/begin CHARACTERISTIC CoESS_tiHiLoBattRst_C "High to low debounce time for battery voltage getting greater than threshold to set the default selection for ESS engine speed" VALUE 0x80508CEC RB_Val_Ws16 655350.0 TimeDeb -327680.0 327670.0 FORMAT "%8.1" /end CHARACTERISTIC
/begin CHARACTERISTIC CoESS_tiHiLoBattSet_C "High to low debounce time for battery voltage getting greater than threshold to set the calibration selection for ESS engine speed" VALUE 0x80508CEE RB_Val_Ws16 655350.0 TimeDeb -327680.0 327670.0 FORMAT "%8.1" /end CHARACTERISTIC
/begin CHARACTERISTIC CoESS_tiHiLoEngSet_C "High to low debounce time for engine speed getting greater than threshold to set the calibration selection for ESS engine speed" VALUE 0x80508CF0 RB_Val_Ws16 655350.0 TimeDeb -327680.0 327670.0 FORMAT "%8.1" /end CHARACTERISTIC
/begin CHARACTERISTIC CoESS_tiLoHiBattRst_C "Low to high debounce time for battery voltage getting greater than threshold to set the default selection for ESS engine speed" VALUE 0x80508CF2 RB_Val_Ws16 655350.0 TimeDeb -327680.0 327670.0 FORMAT "%8.1" /end CHARACTERISTIC
/begin CHARACTERISTIC CoESS_tiLoHiBattSet_C "Low to high debounce time for battery voltage getting greater than threshold to set the calibration selection for ESS engine speed" VALUE 0x80508CF4 RB_Val_Ws16 655350.0 TimeDeb -327680.0 327670.0 FORMAT "%8.1" /end CHARACTERISTIC
/begin CHARACTERISTIC CoESS_tiLoHiEngSet_C "Low to high debounce time for engine speed getting greater than threshold to set the calibration selection for ESS engine speed" VALUE 0x80508CF6 RB_Val_Ws16 655350.0 TimeDeb -327680.0 327670.0 FORMAT "%8.1" /end CHARACTERISTIC
/begin CHARACTERISTIC CoESS_uAirCmprDmdLowr_C "The falling AC demand ACG voltage limit" VALUE 0x80508D02 RB_Val_Ws16 1310700. Volt_Batt -655360.0 655340.0 FORMAT "%8.1" /end CHARACTERISTIC
/begin CHARACTERISTIC CoESS_uAirCmprDmdU_C "The AC demand ACG voltage limit" VALUE 0x80508D04 RB_Val_Ws16 1310700. Volt_Batt -655360.0 655340.0 FORMAT "%8.1" /end CHARACTERISTIC
/begin CHARACTERISTIC CoESS_uBlowrFanHysHi_C "The high limit of blower fan target voltage for slope ramp calculation" VALUE 0x80508D06 RB_Val_Ws16 1310700. Volt_Batt -655360.0 655340.0 FORMAT "%8.1" /end CHARACTERISTIC
/begin CHARACTERISTIC CoESS_uBlowrFanHysLo_C "The low limit of blower fan target voltage for slope ramp calculation" VALUE 0x80508D08 RB_Val_Ws16 1310700. Volt_Batt -655360.0 655340.0 FORMAT "%8.1" /end CHARACTERISTIC
/begin CHARACTERISTIC CoESS_uBlowrTarUHysLowr_C "The Lower limit of blower target voltage" VALUE 0x80508D0A RB_Val_Ws16 1310700. Volt_Batt -655360.0 655340.0 FORMAT "%8.1" /end CHARACTERISTIC
/begin CHARACTERISTIC CoESS_uBlowrTarUHysUppr_C "The Upper limit of blower target voltage" VALUE 0x80508D0C RB_Val_Ws16 1310700. Volt_Batt -655360.0 655340.0 FORMAT "%8.1" /end CHARACTERISTIC
/begin CHARACTERISTIC CoESS_uIdlBattThresRst_C "Battery voltage threshold value for reset condition" VALUE 0x80508CF8 RB_Val_Ws16 1310700. Volt_Batt -655360.0 655340.0 FORMAT "%8.1" /end CHARACTERISTIC
/begin CHARACTERISTIC CoESS_uIdlBattThresSet_C "Battery voltage threshold value for set condition" VALUE 0x80508CFA RB_Val_Ws16 1310700. Volt_Batt -655360.0 655340.0 FORMAT "%8.1" /end CHARACTERISTIC
/begin CHARACTERISTIC CoESS_uMinPspAirChrg_M "Minimum supply voltage for IGC requested from relative air charge" MAP 0x80508D0E RB_Map_U16S16_S16 1310700. Volt_Batt -655360.0 655340.0 FORMAT "%8.1"
 /begin AXIS_DESCR STD_AXIS rl_w rel_q0p0234 3 0.00 1535.977 FORMAT "%8.3" DEPOSIT ABSOLUTE /end AXIS_DESCR
 /begin AXIS_DESCR STD_AXIS Epm_nEng EngN 3 -16384.00 16383.50 FORMAT "%8.2" DEPOSIT ABSOLUTE /end AXIS_DESCR
/end CHARACTERISTIC
/begin CHARACTERISTIC CoESS_uNegSlopRampHi_C "Negative high ramp slope value for blower fan minimum voltage request" VALUE 0x80508D30 RB_Val_Ws16 19999.69 RmpVoltBatt -10000.00 9999.69 FORMAT "%8.2" EXTENDED_LIMITS -10000.00 9999.695 /end CHARACTERISTIC
/begin CHARACTERISTIC CoESS_uNegSlopRampLo_C "Negative low ramp slope value for blower fan minimum voltage request" VALUE 0x80508D32 RB_Val_Ws16 19999.69 RmpVoltBatt -10000.00 9999.69 FORMAT "%8.2" EXTENDED_LIMITS -10000.00 9999.695 /end CHARACTERISTIC
/begin CHARACTERISTIC CoESS_uPosSlopRamp_C "Positive ramp slope value for blower fan minimum voltage request" VALUE 0x80508D34 RB_Val_Ws16 19999.69 RmpVoltBatt -10000.00 9999.69 FORMAT "%8.2" EXTENDED_LIMITS -10000.00 9999.695 /end CHARACTERISTIC
/begin CHARACTERISTIC CoESS_vMinThres_C "Velocity threshold value for set condition" VALUE 0x80508CFC RB_Val_Ws16 655.3500 Vel -327.6800 327.6700 FORMAT "%8.4" /end CHARACTERISTIC
/begin CHARACTERISTIC CoETM_facAftRun2_C "calculate the second after run time by scaling down the initial after run time" VALUE 0x80508D38 RB_Val_Ws16 7.999878 Fact -4.000000 3.999878 FORMAT "%8.6" /end CHARACTERISTIC
/begin CHARACTERISTIC CoETM_facClgAftRunTEnv_CUR "Factor for cooling after run Environment Temperatuer" CURVE 0x80508D3A RB_Curve_S16_S16 511.9922 Fact1 -256.0000 255.9922 FORMAT "%8.4"
 /begin AXIS_DESCR STD_AXIS GlbDa_tEnv Temp_Cels 3 -3549.940 3003.560 FORMAT "%8.3" DEPOSIT ABSOLUTE /end AXIS_DESCR
/end CHARACTERISTIC
/begin CHARACTERISTIC CoETM_facClgAftRun_CUR "Factor for fading duty cycle during afterun" CURVE 0x80508D48 RB_Curve_S16_S16 7.999878 Fact -4.000000 3.999878 FORMAT "%8.6"
 /begin AXIS_DESCR STD_AXIS CoETM_tiClgAftRun_mp Time_s 5 -327.6800 327.6700 FORMAT "%8.4" DEPOSIT ABSOLUTE /end AXIS_DESCR
/end CHARACTERISTIC
/begin CHARACTERISTIC CoETM_rClgAftRun_MAP "Determinaton of thermal capacity in the afterrun" MAP 0x80508D5E RB_Map_S16S16_S16 799.9878 Prc -400.0000 399.9878 FORMAT "%8.4"
 /begin AXIS_DESCR STD_AXIS CoETM_tClntEngOut_mp Temp_Cels 3 -3549.940 3003.560 FORMAT "%8.3" DEPOSIT ABSOLUTE /end AXIS_DESCR
 /begin AXIS_DESCR STD_AXIS GlbDa_tEnv Temp_Cels 3 -3549.940 3003.560 FORMAT "%8.3" DEPOSIT ABSOLUTE /end AXIS_DESCR
/end CHARACTERISTIC
/begin CHARACTERISTIC CoETM_rClgDemFan_CUR "cooling demand for Fan" CURVE 0x80508D80 RB_Curve_S16_S16 799.9878 Prc -400.0000 399.9878 FORMAT "%8.4"
 /begin AXIS_DESCR STD_AXIS CoETM_rClgDemLim_mp Prc 5 -400.0000 399.9878 FORMAT "%8.4" DEPOSIT ABSOLUTE /end AXIS_DESCR
/end CHARACTERISTIC
/begin CHARACTERISTIC CoETM_rClgDemMax_C "max. required cooling power" VALUE 0x80508D96 RB_Val_Ws16 799.9878 Prc -400.0000 399.9878 FORMAT "%8.4" /end CHARACTERISTIC
/begin CHARACTERISTIC CoETM_rClgDemMin_C "min. required cooling power" VALUE 0x80508D98 RB_Val_Ws16 799.9878 Prc -400.0000 399.9878 FORMAT "%8.4" /end CHARACTERISTIC
/begin CHARACTERISTIC CoETM_rClgIntegMax_C "max. integral part of cooling power" VALUE 0x80508D9A RB_Val_Ws16 799.9878 Prc -400.0000 399.9878 FORMAT "%8.4" /end CHARACTERISTIC
/begin CHARACTERISTIC CoETM_rClgIntegMin_C "min. integral part of cooling power" VALUE 0x80508D9C RB_Val_Ws16 799.9878 Prc -400.0000 399.9878 FORMAT "%8.4" /end CHARACTERISTIC
/begin CHARACTERISTIC CoETM_rClgKi_CUR "gain factor for integral controller for ETM_rClgDem" CURVE 0x80508D9E RB_Curve_S16_S16 799.9878 Prc -400.0000 399.9878 FORMAT "%8.4"
 /begin AXIS_DESCR STD_AXIS CoETM_tDvt_mp TempDiff_Kelv 3 -3276.800 3276.700 FORMAT "%8.3" DEPOSIT ABSOLUTE /end AXIS_DESCR
/end CHARACTERISTIC
/begin CHARACTERISTIC CoETM_rClgKp_CUR "gain factor for proportional controller for ETM_rClgDem" CURVE 0x80508DAC RB_Curve_S16_S16 799.9878 Prc -400.0000 399.9878 FORMAT "%8.4"
 /begin AXIS_DESCR STD_AXIS CoETM_tDvt_mp TempDiff_Kelv 3 -3276.800 3276.700 FORMAT "%8.3" DEPOSIT ABSOLUTE /end AXIS_DESCR
/end CHARACTERISTIC
/begin CHARACTERISTIC CoETM_swtSrc_C "switch for source of calculation of desired temperature" VALUE 0x80508DBA RB_Val_Wu8 255.0 OneToOne 0.00 255.0 FORMAT "%5.1" /end CHARACTERISTIC
/begin CHARACTERISTIC CoETM_tAftRunAbrt_C "Time constant for aborting after-run phase 2" VALUE 0x80508DBC RB_Val_Ws16 3276.700 Temp_Cels -273.140 3003.560 FORMAT "%8.3" EXTENDED_LIMITS -3549.940 3003.560 /end CHARACTERISTIC
/begin CHARACTERISTIC CoETM_tClntEngOutStg1Max_C "maximal temperaturelevel stage1" VALUE 0x80508DBE RB_Val_Ws16 6553.500 Temp_Cels -3549.940 3003.560 FORMAT "%8.3" /end CHARACTERISTIC
/begin CHARACTERISTIC CoETM_tClntEngOutStg1Min_C "minimal temperaturelevel stage1" VALUE 0x80508DC0 RB_Val_Ws16 6553.500 Temp_Cels -3549.940 3003.560 FORMAT "%8.3" /end CHARACTERISTIC
/begin CHARACTERISTIC CoETM_tClntEngOutStg2Max_C "maximal temperaturelevel stage2" VALUE 0x80508DC2 RB_Val_Ws16 6553.500 Temp_Cels -3549.940 3003.560 FORMAT "%8.3" /end CHARACTERISTIC
/begin CHARACTERISTIC CoETM_tClntEngOutStg2Min_C "minimal temperaturelevel stage2" VALUE 0x80508DC4 RB_Val_Ws16 6553.500 Temp_Cels -3549.940 3003.560 FORMAT "%8.3" /end CHARACTERISTIC
/begin CHARACTERISTIC CoETM_tDvtMax_C "max. deviation coolant temp. to calculate I-part" VALUE 0x80508DC6 RB_Val_Ws16 6553.500 TempDiff_Kelv -3276.800 3276.700 FORMAT "%8.3" /end CHARACTERISTIC
/begin CHARACTERISTIC CoETM_tDvtMin_C "min. deviation coolant temp. to calculate I-part" VALUE 0x80508DC8 RB_Val_Ws16 6553.500 TempDiff_Kelv -3276.800 3276.700 FORMAT "%8.3" /end CHARACTERISTIC
/begin CHARACTERISTIC CoETM_tDvtStg0_C "deviation to activate fan stage 0" VALUE 0x80508DCA RB_Val_Ws16 6553.500 TempDiff_Kelv -3276.800 3276.700 FORMAT "%8.3" /end CHARACTERISTIC
/begin CHARACTERISTIC CoETM_tDvtStg1_C "deviation to activate fan stage 1" VALUE 0x80508DCC RB_Val_Ws16 6553.500 TempDiff_Kelv -3276.800 3276.700 FORMAT "%8.3" /end CHARACTERISTIC
/begin CHARACTERISTIC CoETM_tDvtStg2_C "deviation to activate fan stage 2" VALUE 0x80508DCE RB_Val_Ws16 6553.500 TempDiff_Kelv -3276.800 3276.700 FORMAT "%8.3" /end CHARACTERISTIC
/begin CHARACTERISTIC CoETM_tEngOutSubsOff_C "Substitute value of coolant temp. at engine outlet after engine stop" VALUE 0x80508DD0 RB_Val_Ws16 6553.500 Temp_Cels -3549.940 3003.560 FORMAT "%8.3" /end CHARACTERISTIC
/begin CHARACTERISTIC CoETM_tiClgAftRun2_MAP "delivers second after run time" MAP 0x80508DD2 RB_Map_S16S16_U16 327.6700 Time_s 0.00 327.6700 FORMAT "%8.4" EXTENDED_LIMITS 0.00 655.3500
 /begin AXIS_DESCR STD_AXIS CoETM_tEngOutOff_mp Temp_Cels 3 -3549.940 3003.560 FORMAT "%8.3" DEPOSIT ABSOLUTE /end AXIS_DESCR
 /begin AXIS_DESCR STD_AXIS GlbDa_tEnv Temp_Cels 3 -3549.940 3003.560 FORMAT "%8.3" DEPOSIT ABSOLUTE /end AXIS_DESCR
/end CHARACTERISTIC
/begin CHARACTERISTIC CoETM_tiClgAftRunCons_MAP "Determining after-run time depending on fuel consumption" MAP 0x80508DF4 RB_Map_S16S16_U16 655.3500 Time_s 0.00 655.3500 FORMAT "%8.4"
 /begin AXIS_DESCR STD_AXIS CoETM_tEngOutOff_mp Temp_Cels 3 -3549.940 3003.560 FORMAT "%8.3" DEPOSIT ABSOLUTE /end AXIS_DESCR
 /begin AXIS_DESCR STD_AXIS FlSys_dvolFlCons FlConsum_l_h 3 -327.6800 327.6700 FORMAT "%8.4" DEPOSIT ABSOLUTE /end AXIS_DESCR
/end CHARACTERISTIC
/begin CHARACTERISTIC CoETM_tiClgAftRunOil_CUR "Determining after-run time depending on oil temperature" CURVE 0x80508E16 RB_Curve_S16_S16 327.6700 Time_s 0.00 327.6700 FORMAT "%8.4" EXTENDED_LIMITS -327.6800 327.6700
 /begin AXIS_DESCR STD_AXIS Oil_tSwmp Temp_Cels 3 -3549.940 3003.560 FORMAT "%8.3" DEPOSIT ABSOLUTE /end AXIS_DESCR
/end CHARACTERISTIC
/begin CHARACTERISTIC CoETM_tiClgAftRun_MAP "delivers after run time" MAP 0x80508E24 RB_Map_S16S16_U16 655.3500 Time_s 0.00 655.3500 FORMAT "%8.4"
 /begin AXIS_DESCR STD_AXIS CoETM_tEngOutOff_mp Temp_Cels 3 -3549.940 3003.560 FORMAT "%8.3" DEPOSIT ABSOLUTE /end AXIS_DESCR
 /begin AXIS_DESCR STD_AXIS GlbDa_tEnv Temp_Cels 3 -3549.940 3003.560 FORMAT "%8.3" DEPOSIT ABSOLUTE /end AXIS_DESCR
/end CHARACTERISTIC
/begin CHARACTERISTIC CoETM_tiClgIntegT1_C "time factor for integral controller" VALUE 0x80508E48 RB_Val_Ws32 4294.9672940000000 TimeDelay_s 0.0000020000000 4294.9672959999998 FORMAT "%19.14" EXTENDED_LIMITS 0.000002000000001 4294.9672959999998 /end CHARACTERISTIC
/begin CHARACTERISTIC CoETS_bFltDemLeadEnf_C "Calibration to enforce demand for torque in lead path" VALUE 0x80508E4C RB_Val_Wu8 1.00000000000 B_TRUE 0.00 1.00000000000 FORMAT "%13.11" /end CHARACTERISTIC
/begin CHARACTERISTIC CoETS_nTrqRatMin_C "Threshold for calculation of torque ratio" VALUE 0x80508E50 RB_Val_Ws16 32767.50 EngN -16384.00 16383.50 FORMAT "%8.2" /end CHARACTERISTIC
/begin CHARACTERISTIC CoETS_stFltIntvEnd_CW "Calibration: Request of filtering the end of an intervention by the driveability filter." VALUE 0x80508E4E RB_Val_Wu16 65535.00 dez 0.00 65535.00 FORMAT "%8.2" /end CHARACTERISTIC
/begin CHARACTERISTIC ComEBS_chNomCapBattSens_C "Initalize physical value of nominal capacity of battery" VALUE 0x805144B8 RB_Val_Ws16 65535.00 AmpHrs_Ah -32768.00 32767.00 FORMAT "%8.2" /end CHARACTERISTIC
/begin CHARACTERISTIC ComEBS_rBattSensCh_C "Initalize value for status Of Charge" VALUE 0x805144BA RB_Val_Ws16 799.9878 Prc -400.0000 399.9878 FORMAT "%8.4" /end CHARACTERISTIC
/begin CHARACTERISTIC ComEBS_rBattSensSOH_C "Slope of state of health of EBS" VALUE 0x805144BC RB_Val_Ws16 799.9878 Prc -400.0000 399.9878 FORMAT "%8.4" /end CHARACTERISTIC
/begin CHARACTERISTIC ComEBS_stBattCrntRng_C "Init value for 2 bits Battery Current Range value Received from EBS" VALUE 0x805144BE RB_Val_Wu8 255.0 OneToOne 0.00 255.0 FORMAT "%5.1" /end CHARACTERISTIC
/begin CHARACTERISTIC ComEBS_stBattSensFlagIni_C "Battery state flag init value" VALUE 0x805144BF RB_Val_Wu8 255.0 OneToOne 0.00 255.0 FORMAT "%5.1" /end CHARACTERISTIC
/begin CHARACTERISTIC ComEBS_stEBSInvld_C "Initalize for Error flag from EBS sensor indicating the COM communication problem with ECU" VALUE 0x805144C0 RB_Val_Wu8 255.0 OneToOne 0.00 255.0 FORMAT "%5.1" /end CHARACTERISTIC
/begin CHARACTERISTIC ComEBS_stLinRespErr_C "Init value for COM sensor signals response error" VALUE 0x805144C1 RB_Val_Wu8 255.0 OneToOne 0.00 255.0 FORMAT "%5.1" /end CHARACTERISTIC
/begin CHARACTERISTIC ComEBS_tBattSens_C "Init value for Battery temperature received from EBS" VALUE 0x805144C2 RB_Val_Wu16 32767.50 Temp_Fatc -40.00 32727.50 FORMAT "%8.2" /end CHARACTERISTIC
/begin CHARACTERISTIC ComEBS_uBattSensSOF_C "Slope of state of function of EBS" VALUE 0x805144C4 RB_Val_Ws16 65.53500 spg_q0p001 -32.76800 32.76700 FORMAT "%8.5" /end CHARACTERISTIC
/begin CHARACTERISTIC ComEBS_uBattSens_C "Init value for 14 bits Battery Voltage Received from EBS" VALUE 0x805144C6 RB_Val_Ws16 65.53500 spg_q0p001 -32.76800 32.76700 FORMAT "%8.5" /end CHARACTERISTIC
/begin AXIS_PTS CoME_calEngSpeed_AXIS "Axis for CoME group curves" 0x805098C4 Epm_nEng RB_Axis_S16 32767.50 EngN 5 -16384.00 16383.50 FORMAT "%8.2" DEPOSIT ABSOLUTE /end AXIS_PTS
/begin CHARACTERISTIC CoME_drPedHi_C "Gradient of maximum accelerator pedal value (lower hysteresis value)" VALUE 0x805098D0 RB_Val_Ws16 39999.39 PrcPerSec -20000.00 19999.39 FORMAT "%8.2" /end CHARACTERISTIC
/begin CHARACTERISTIC CoME_drPedLo_C "Gradient of maximum accelerator pedal value (lower hysteresis value)" VALUE 0x805098D2 RB_Val_Ws16 39999.39 PrcPerSec -20000.00 19999.39 FORMAT "%8.2" /end CHARACTERISTIC
/begin CHARACTERISTIC CoME_nEng1Hi_C "Minimum engine speed (upper hysteresis value - 1)" VALUE 0x805098D4 RB_Val_Ws16 32767.50 EngN -16384.00 16383.50 FORMAT "%8.2" /end CHARACTERISTIC
/begin CHARACTERISTIC CoME_nEng1Lo_C "Minimum engine speed (lower hysteresis value - 1)" VALUE 0x805098D6 RB_Val_Ws16 32767.50 EngN -16384.00 16383.50 FORMAT "%8.2" /end CHARACTERISTIC
/begin CHARACTERISTIC CoME_nEng2Hi_C "Minimum engine speed (lower hysteresis value - 2)" VALUE 0x805098D8 RB_Val_Ws16 32767.50 EngN -16384.00 16383.50 FORMAT "%8.2" /end CHARACTERISTIC
/begin CHARACTERISTIC CoME_nEng2Lo_C "Minimum engine speed (lower hysteresis value - 2)" VALUE 0x805098DA RB_Val_Ws16 32767.50 EngN -16384.00 16383.50 FORMAT "%8.2" /end CHARACTERISTIC
/begin CHARACTERISTIC CoME_numTraGearMax_C "Minimum gear number" VALUE 0x805098DC RB_Val_Wu8 255.0 OneToOne 0.00 255.0 FORMAT "%5.1" /end CHARACTERISTIC
/begin CHARACTERISTIC CoME_pEnv1Hi_C "Minimum environmental pressure (upper hysteresis value - 1)" VALUE 0x805098DE RB_Val_Ws16 65535.00 Pres_hPa -32768.00 32767.00 FORMAT "%8.2" /end CHARACTERISTIC
/begin CHARACTERISTIC CoME_pEnv1Lo_C "Minimum environmental pressure (lower hysteresis value - 1)" VALUE 0x805098E0 RB_Val_Ws16 65535.00 Pres_hPa -32768.00 32767.00 FORMAT "%8.2" /end CHARACTERISTIC
/begin CHARACTERISTIC CoME_pEnv2Hi_C "Minimum environmental pressure (upper hysteresis value - 2)" VALUE 0x805098E2 RB_Val_Ws16 65535.00 Pres_hPa -32768.00 32767.00 FORMAT "%8.2" /end CHARACTERISTIC
/begin CHARACTERISTIC CoME_pEnv2Lo_C "Minimum environmental pressure (lower hysteresis value - 2)" VALUE 0x805098E4 RB_Val_Ws16 65535.00 Pres_hPa -32768.00 32767.00 FORMAT "%8.2" /end CHARACTERISTIC
/begin CHARACTERISTIC CoME_rPedHi_C "Maximum accelerator pedal value (upper hysteresis value)" VALUE 0x805098E6 RB_Val_Ws16 799.9878 Prc -400.0000 399.9878 FORMAT "%8.4" /end CHARACTERISTIC
/begin CHARACTERISTIC CoME_rPedLo_C "Maximum accelerator pedal value (lower hysteresis value)" VALUE 0x805098E8 RB_Val_Ws16 799.9878 Prc -400.0000 399.9878 FORMAT "%8.4" /end CHARACTERISTIC
/begin CHARACTERISTIC CoME_stAlt_CW "Status: Alternator shut-off conditions" VALUE 0x805098EA RB_Val_Wu8 255.0 OneToOne 0.00 255.0 FORMAT "%5.1" /end CHARACTERISTIC
/begin CHARACTERISTIC CoME_stEEM_C "Status: Electrical energy management" VALUE 0x805098EB RB_Val_Wu8 1.00000000000 B_TRUE 0.00 1.00000000000 FORMAT "%13.11" /end CHARACTERISTIC
/begin CHARACTERISTIC CoME_stFan_CW "Status: Fan switch-off conditions" VALUE 0x805098EC RB_Val_Wu8 255.0 OneToOne 0.00 255.0 FORMAT "%5.1" /end CHARACTERISTIC
/begin CHARACTERISTIC CoME_stNReqESS_C "Status of the speed demand for Minimum engine speed request from Electrical Supply System" VALUE 0x805098C0 RB_Val_Wu8 255.0 OneToOne 0.00 255.0 FORMAT "%5.1" /end CHARACTERISTIC
/begin CHARACTERISTIC CoME_stNReqTSAC_C "Status of the idle speed demand request" VALUE 0x805098C1 RB_Val_Wu8 255.0 OneToOne 0.00 255.0 FORMAT "%5.1" /end CHARACTERISTIC
/begin CHARACTERISTIC CoME_stNReqTS_C "Status of the speed demand for Lowest engine speed requested by the thermal system" VALUE 0x805098C2 RB_Val_Wu8 255.0 OneToOne 0.00 255.0 FORMAT "%5.1" /end CHARACTERISTIC
/begin CHARACTERISTIC CoME_stNReqVehMot_C "Status of the speed demand for Minimum engine speed demand by Vehicle accessories" VALUE 0x805098C3 RB_Val_Wu8 255.0 OneToOne 0.00 255.0 FORMAT "%5.1" /end CHARACTERISTIC
/begin CHARACTERISTIC CoME_tEnvAir1Hi_C "Minimum environmental air temperature (upper hysteresis value - 1)" VALUE 0x805098EE RB_Val_Ws16 6553.500 Temp_Cels -3549.940 3003.560 FORMAT "%8.3" /end CHARACTERISTIC
/begin CHARACTERISTIC CoME_tEnvAir1Lo_C "Maximum environmental air temperature (lower hysteresis value - 1)" VALUE 0x805098F0 RB_Val_Ws16 6553.500 Temp_Cels -3549.940 3003.560 FORMAT "%8.3" /end CHARACTERISTIC
/begin CHARACTERISTIC CoME_tEnvAir2Hi_C "Maximum environmental air temperature (upper hysteresis value - 2)" VALUE 0x805098F2 RB_Val_Ws16 6553.500 Temp_Cels -3549.940 3003.560 FORMAT "%8.3" /end CHARACTERISTIC
/begin CHARACTERISTIC CoME_tEnvAir2Lo_C "Maximum environmental air temperature (lower hysteresis value - 2)" VALUE 0x805098F4 RB_Val_Ws16 6553.500 Temp_Cels -3549.940 3003.560 FORMAT "%8.3" /end CHARACTERISTIC
/begin CHARACTERISTIC CoME_tiBattVltgOff_C "Minimum switch-off time because of low battery voltage" VALUE 0x805098F6 RB_Val_Ws16 655.3500 Time_s -327.6800 327.6700 FORMAT "%8.4" /end CHARACTERISTIC
/begin CHARACTERISTIC CoME_tiDrvOn_C "Minimum switch-on time after switch-off because of driveaway or acceleration" VALUE 0x805098F8 RB_Val_Ws16 655.3500 Time_s -327.6800 327.6700 FORMAT "%8.4" /end CHARACTERISTIC
/begin CHARACTERISTIC CoME_tiMaxOffAcc_CUR "Maximum switch-off time during acceleration" CURVE 0x805098FA RB_CurveGroup_S16 655.3500 Time_s -327.6800 327.6700 FORMAT "%8.4"
 /begin AXIS_DESCR COM_AXIS Epm_nEng EngN 5 -16384.00 16383.50 FORMAT "%8.2" AXIS_PTS_REF CoME_calEngSpeed_AXIS /end AXIS_DESCR
/end CHARACTERISTIC
/begin CHARACTERISTIC CoME_tiMaxOffDrvOff_CUR "Maximum switch-off time during drive-off" CURVE 0x80509904 RB_CurveGroup_S16 655.3500 Time_s -327.6800 327.6700 FORMAT "%8.4"
 /begin AXIS_DESCR COM_AXIS Epm_nEng EngN 5 -16384.00 16383.50 FORMAT "%8.2" AXIS_PTS_REF CoME_calEngSpeed_AXIS /end AXIS_DESCR
/end CHARACTERISTIC
/begin CHARACTERISTIC CoME_tiMinOffAcc_CUR "Minimum switch-off time during acceleration" CURVE 0x8050990E RB_CurveGroup_S16 655.3500 Time_s -327.6800 327.6700 FORMAT "%8.4"
 /begin AXIS_DESCR COM_AXIS Epm_nEng EngN 5 -16384.00 16383.50 FORMAT "%8.2" AXIS_PTS_REF CoME_calEngSpeed_AXIS /end AXIS_DESCR
/end CHARACTERISTIC
/begin CHARACTERISTIC CoME_tiMinOffDrvOff_CUR "Minimum switch-off time during drive-off" CURVE 0x80509918 RB_CurveGroup_S16 655.3500 Time_s -327.6800 327.6700 FORMAT "%8.4"
 /begin AXIS_DESCR COM_AXIS Epm_nEng EngN 5 -16384.00 16383.50 FORMAT "%8.2" AXIS_PTS_REF CoME_calEngSpeed_AXIS /end AXIS_DESCR
/end CHARACTERISTIC
/begin CHARACTERISTIC CoME_tiOffStopAC_C "Turn-off delay for leaving vehicle state STOP (for AC)" VALUE 0x80509922 RB_Val_Wu16 655.3500 Time_s 0.00 655.3500 FORMAT "%8.4" /end CHARACTERISTIC
/begin CHARACTERISTIC CoME_tiOffStopAlt_C "Turn-off delay for leaving vehicle state STOP (for alternator)" VALUE 0x80509924 RB_Val_Wu16 655.3500 Time_s 0.00 655.3500 FORMAT "%8.4" /end CHARACTERISTIC
/begin CHARACTERISTIC CoME_tiOffStopFan_C "Turn-off delay for leaving vehicle state STOP (for fan)" VALUE 0x80509926 RB_Val_Wu16 655.3500 Time_s 0.00 655.3500 FORMAT "%8.4" /end CHARACTERISTIC
/begin CHARACTERISTIC CoME_tiOffStrtAC_C "Debouncing time after engine start" VALUE 0x80509928 RB_Val_Ws16 655.3500 Time_s -327.6800 327.6700 FORMAT "%8.4" /end CHARACTERISTIC
/begin CHARACTERISTIC CoME_tiOffStrtAlt_C "Debouncing time after engine start" VALUE 0x8050992A RB_Val_Ws16 655.3500 Time_s -327.6800 327.6700 FORMAT "%8.4" /end CHARACTERISTIC
/begin CHARACTERISTIC CoME_trqAcc_C "Permissible torque consumption for AC during acceleration" VALUE 0x8050992C RB_Val_Ws16 6553.500 Trq -3276.800 3276.700 FORMAT "%8.3" /end CHARACTERISTIC
/begin CHARACTERISTIC CoME_trqACMax_C "maximum torque of AC compressor" VALUE 0x8050992E RB_Val_Ws16 6553.500 Trq -3276.800 3276.700 FORMAT "%8.3" /end CHARACTERISTIC
/begin CHARACTERISTIC CoME_trqBattVltg_C "Permissible torque consumption for AC during low battery voltage" VALUE 0x80509930 RB_Val_Ws16 6553.500 Trq -3276.800 3276.700 FORMAT "%8.3" /end CHARACTERISTIC
/begin CHARACTERISTIC CoME_trqDrvOff_C "Maximum allowed A/C torque during drive-off" VALUE 0x80509932 RB_Val_Ws16 6553.500 Trq -3276.800 3276.700 FORMAT "%8.3" /end CHARACTERISTIC
/begin CHARACTERISTIC CoME_trqStop_C "Maximum allowed AC torque during engine stop" VALUE 0x80509934 RB_Val_Ws16 6553.500 Trq -3276.800 3276.700 FORMAT "%8.3" /end CHARACTERISTIC
/begin CHARACTERISTIC CoME_trqStrt_C "Maximum allowed A/C torque during engine start" VALUE 0x80509936 RB_Val_Ws16 6553.500 Trq -3276.800 3276.700 FORMAT "%8.3" /end CHARACTERISTIC
/begin CHARACTERISTIC CoME_uBattMinHi_C "Minimum battery voltage (upper hysteresis value)" VALUE 0x80509938 RB_Val_Ws16 1310700. Volt_Batt -655360.0 655340.0 FORMAT "%8.1" /end CHARACTERISTIC
/begin CHARACTERISTIC CoME_uBattMinLo_C "Minimum battery voltage (lower hysteresis value)" VALUE 0x8050993A RB_Val_Ws16 1310700. Volt_Batt -655360.0 655340.0 FORMAT "%8.1" /end CHARACTERISTIC
/begin CHARACTERISTIC CoME_vX1Hi_C "Minimum vehicle speed (upper hysteresis value - 1)" VALUE 0x8050993C RB_Val_Ws16 655.3500 Vel -327.6800 327.6700 FORMAT "%8.4" /end CHARACTERISTIC
/begin CHARACTERISTIC CoME_vX1Lo_C "Minimum vehicle speed (lower hysteresis value - 1)" VALUE 0x8050993E RB_Val_Ws16 655.3500 Vel -327.6800 327.6700 FORMAT "%8.4" /end CHARACTERISTIC
/begin CHARACTERISTIC CoME_vX2Hi_C "Minimum vehicle speed (upper hysteresis value - 2)" VALUE 0x80509940 RB_Val_Ws16 655.3500 Vel -327.6800 327.6700 FORMAT "%8.4" /end CHARACTERISTIC
/begin CHARACTERISTIC CoME_vX2Lo_C "Minimum vehicle speed (lower hysteresis value - 2)" VALUE 0x80509942 RB_Val_Ws16 655.3500 Vel -327.6800 327.6700 FORMAT "%8.4" /end CHARACTERISTIC
/begin CHARACTERISTIC Com_cwEepSpasRst_C "Codeword to reset the SPAS autodetection status in EEPROM." VALUE 0x805144C8 RB_Val_Wu8 255.0 OneToOne 0.00 255.0 FORMAT "%5.1" /end CHARACTERISTIC
/begin CHARACTERISTIC Com_cwSpasDiagCfg_C "Codeword to configure diagnosis for SPAS" VALUE 0x805144C9 RB_Val_Wu8 255.0 OneToOne 0.00 255.0 FORMAT "%5.1" /end CHARACTERISTIC
/begin CHARACTERISTIC Com_stFrmRxEna_CA "Enable mask for receive frames" VAL_BLK 0x805144CA ValA_Wu8 255.0 OneToOne 0.00 255.0 FORMAT "%5.1" NUMBER 6 /end CHARACTERISTIC
/begin CHARACTERISTIC Com_stFrmRxPstDrvEna_CA "Post Drive Enable mask for receive frames" VAL_BLK 0x805144D0 ValA_Wu8 255.0 OneToOne 0.00 255.0 FORMAT "%5.1" NUMBER 6 /end CHARACTERISTIC
/begin CHARACTERISTIC Com_stFrmTxEna_CA "Enable mask for transmit frames" VAL_BLK 0x805144D6 ValA_Wu8 255.0 OneToOne 0.00 255.0 FORMAT "%5.1" NUMBER 6 /end CHARACTERISTIC
/begin CHARACTERISTIC Com_stFrmTxPstDrvEna_CA "Posr Drive Enable mask for transmit frames" VAL_BLK 0x805144DC ValA_Wu8 255.0 OneToOne 0.00 255.0 FORMAT "%5.1" NUMBER 6 /end CHARACTERISTIC
/begin CHARACTERISTIC Com_stswtBrkOper_C "Parameter to select VSA_DRV_BRKTRQ" VALUE 0x805144E2 RB_Val_Wu8 255.0 OneToOne 0.00 255.0 FORMAT "%5.1" /end CHARACTERISTIC
/begin CHARACTERISTIC Com_stSwtISABAct_C "Calibration selection for ISAB operation status" VALUE 0x805144E3 RB_Val_Wu8 255.0 OneToOne 0.00 255.0 FORMAT "%5.1" /end CHARACTERISTIC
/begin CHARACTERISTIC Com_stSwtISABEna_C "Calibration selection for ISAB permission status" VALUE 0x805144E4 RB_Val_Wu8 255.0 OneToOne 0.00 255.0 FORMAT "%5.1" /end CHARACTERISTIC
/begin CHARACTERISTIC Com_stswtVirtAPPSelSig_C "Selection switch send the virtual acc pedal ratio and virtual acc pedal ratio learned" VALUE 0x805144E5 Val_Wu8 255.0 OneToOne 0.00 255.0 FORMAT "%5.1" /end CHARACTERISTIC
/begin CHARACTERISTIC Com_stSyncSpasDetn_C "Thereshold for state of synchronization to enable SPAS diagnosis" VALUE 0x805144E6 RB_Val_Wu8 30.0000000000 Epm_stSync_State_t 0.00 30.0000000000 FORMAT "%13.10" /end CHARACTERISTIC
/begin CHARACTERISTIC Com_stVSAFIdErrWghtFac_CA "Calibration array for communicating the error value for each module" VAL_BLK 0x805144E7 ValA_Wu8 255.0 OneToOne 0.00 255.0 FORMAT "%5.1" NUMBER 28 /end CHARACTERISTIC
/begin CHARACTERISTIC Com_stVSASumTrqErrESP_C "Calibartion for ESP module for comapring the total ERROR weight value for VSA" VALUE 0x80514504 Val_Wu16 65535.00 OneToOne 0.00 65535.00 FORMAT "%8.2" /end CHARACTERISTIC
/begin CHARACTERISTIC Com_swtACEVAMtrSwtInfo_C "Switching to AC EVA temperature from diffrent module." VALUE 0x80514506 Val_Wu8 255.0 OneToOne 0.00 255.0 FORMAT "%5.1" /end CHARACTERISTIC
/begin CHARACTERISTIC Com_swtCANVer_C "Calibration to select the CAN generation" VALUE 0x80514508 RB_Val_Wu16 2.000000 OneToOne 1.000000 3.000000 FORMAT "%8.6" EXTENDED_LIMITS 0.00 65535.00 /end CHARACTERISTIC
/begin CHARACTERISTIC Com_swtEnaChksAlvCntrGbxEATA_C "swich to enable check sum and alive counter of EATA" VALUE 0x80514520 RB_Val_Wu8 1.00000000000 B_TRUE 0.00 1.00000000000 FORMAT "%13.11" /end CHARACTERISTIC
/begin CHARACTERISTIC Com_swtEnvT_C "Switch to Select the Outside Air Temperature" VALUE 0x8051450A Val_Wu8 255.0 OneToOne 0.00 255.0 FORMAT "%5.1" /end CHARACTERISTIC
/begin CHARACTERISTIC Com_swtSelAPPENGA_C "Selection of accelerator pedal position for ENGA frame" VALUE 0x8051450B ValA_Wu8 255.0 OneToOne 0.00 255.0 FORMAT "%5.1" /end CHARACTERISTIC
/begin CHARACTERISTIC Com_swtSelAPPENGT_C "Selection of accelerator pedal position for ENGT frame" VALUE 0x8051450C Val_Wu8 255.0 OneToOne 0.00 255.0 FORMAT "%5.1" /end CHARACTERISTIC
/begin CHARACTERISTIC Com_tiIgnSpasDetnDly_C "Delay time to enable the SPAS diagnosis activation after ignition ON" VALUE 0x8051450E RB_Val_Ws16 655.3500 Time_s -327.6800 327.6700 FORMAT "%8.4" /end CHARACTERISTIC
/begin CHARACTERISTIC Com_tiMonBatt_C "Delay time for monitoring of send and receive frames after battery voltage exceeds the threshold value" VALUE 0x80514510 RB_Val_Ws16 655350.0 Time_ms -327680.0 327670.0 FORMAT "%8.1" /end CHARACTERISTIC
/begin CHARACTERISTIC Com_tiMonStrt_C "Delay time for monitoring of send and receive frames after T15 On" VALUE 0x80514512 RB_Val_Ws16 655350.0 Time_ms -327680.0 327670.0 FORMAT "%8.1" /end CHARACTERISTIC
/begin CHARACTERISTIC Com_tiSpas2DetnThd_C "Threshold time to confirm the presence of SPAS by monitoring SPAS2 frame reception status." VALUE 0x80514514 RB_Val_Ws16 655350.0 Time_ms -327680.0 327670.0 FORMAT "%8.1" /end CHARACTERISTIC
/begin CHARACTERISTIC Com_tiSpasDetnDly_C "Delay time for the completion of SPAS autodetection after the diagnosis enable conditions are met." VALUE 0x80514516 RB_Val_Ws16 655.3500 Time_s -327.6800 327.6700 FORMAT "%8.4" /end CHARACTERISTIC
/begin CHARACTERISTIC Com_uBattSpasMax_C "Max threshold of battery voltage for general diagnosis condition for SPAS" VALUE 0x80514518 RB_Val_Ws16 1310700. Volt_Batt -655360.0 655340.0 FORMAT "%8.1" /end CHARACTERISTIC
/begin CHARACTERISTIC Com_uBattSpasMin_C "Min threshold of battery voltage for general diagnosis condition for SPAS" VALUE 0x8051451A RB_Val_Ws16 1310700. Volt_Batt -655360.0 655340.0 FORMAT "%8.1" /end CHARACTERISTIC
/begin CHARACTERISTIC Com_uMonBatt_C "Threshold for battery voltage to enable monitoring" VALUE 0x8051451C RB_Val_Ws16 1310700. Volt_Batt -655360.0 655340.0 FORMAT "%8.1" /end CHARACTERISTIC
/begin CHARACTERISTIC KLBDEMTAFC "Temperature correction factor for air charge" CURVE 0x80508C75 RB_Curve_U8_U8 1.992188 fak_ub_b2 0.00 1.992188 FORMAT "%8.6"
 /begin AXIS_DESCR STD_AXIS tanrm fak_ub_b2 6 0.00 1.992188 FORMAT "%8.6" DEPOSIT ABSOLUTE /end AXIS_DESCR
/end CHARACTERISTIC
/begin CHARACTERISTIC Lin_uOCV_C "Init value for last open circuit voltage of battery" VALUE 0x8051451E RB_Val_Wu16 65.53500 spg_q0p001_op10_V 10.00000 75.53500 FORMAT "%8.5" /end CHARACTERISTIC
/begin MEASUREMENT ACC_bBrkReq "Brake status for Adaptive Cruise Control" UBYTE B_TRUE 1 100 0.00 1.00000000000 BIT_MASK 0x1 FORMAT "%13.11" ECU_ADDRESS 0x70000AD4 /end MEASUREMENT
/begin MEASUREMENT bdemagrs "GDI desired mode for EGR" UBYTE OneToOne 1 100 0.00 255.0 FORMAT "%5.1" ECU_ADDRESS 0x60009BB1 /end MEASUREMENT
/begin MEASUREMENT bdemagrs_msg "GDI desired mode for EGR" UBYTE OneToOne 1 100 0.00 255.0 FORMAT "%5.1" ECU_ADDRESS 0x6000E43C /end MEASUREMENT
/begin MEASUREMENT bdemfes_msg "GDI desired mode for filling interventions" UBYTE OneToOne 1 100 0.00 255.0 FORMAT "%5.1" ECU_ADDRESS 0x6000E43D /end MEASUREMENT
/begin MEASUREMENT bdemlbks "GDI desired mode for swirl control" UBYTE OneToOne 1 100 0.00 255.0 FORMAT "%5.1" ECU_ADDRESS 0x60009BB0 /end MEASUREMENT
/begin MEASUREMENT bdemodbv_msg "GDI-mode byte of burning conditions" UBYTE dez 1 100 0.00 255.0 FORMAT "%5.1" ECU_ADDRESS 0x6000E43F /end MEASUREMENT
/begin MEASUREMENT bdemodfaOld_msg "GDI desired mode driver in the last computing time slot." UBYTE OneToOne 1 100 0.00 255.0 FORMAT "%5.1" ECU_ADDRESS 0x6000E440 /end MEASUREMENT
/begin MEASUREMENT bdemodfa_msg "GDI desired mode driver." UBYTE OneToOne 1 100 0.00 255.0 FORMAT "%5.1" ECU_ADDRESS 0x6000E441 /end MEASUREMENT
/begin MEASUREMENT bdemodfa_tmp "Intermediate value for internal purposes." UBYTE OneToOne 1 100 0.00 255.0 FORMAT "%5.1" ECU_ADDRESS 0x60009BB5 /end MEASUREMENT
/begin MEASUREMENT bdemodmd_msg "GDI desired mode torque control." UBYTE OneToOne 1 100 0.00 255.0 FORMAT "%5.1" ECU_ADDRESS 0x6000E442 /end MEASUREMENT
/begin MEASUREMENT bdemodrdnt_msg "Redundancy for GDI mode" UBYTE OneToOne 1 100 0.00 255.0 FORMAT "%5.1" ECU_ADDRESS 0x6000E443 /end MEASUREMENT
/begin MEASUREMENT bdemods_msg "GDI desired mode" UBYTE dez 1 100 0.00 255.0 FORMAT "%5.1" ECU_ADDRESS 0x6000E444 /end MEASUREMENT
/begin MEASUREMENT bdemods_tmp "Intermediate value for internal purposes." UBYTE dez 1 100 0.00 255.0 FORMAT "%5.1" ECU_ADDRESS 0x60009BB4 /end MEASUREMENT
/begin MEASUREMENT bdemods_w_msg "GDI desired mode (low byte) + states (high byte)." UWORD dez 1 100 0.00 65535.00 FORMAT "%8.2" ECU_ADDRESS 0x6000E2F2 /end MEASUREMENT
/begin MEASUREMENT bdemods_w_tmp "Intermediate value for internal purposes." UWORD dez 1 100 0.00 65535.00 FORMAT "%8.2" ECU_ADDRESS 0x60003E6E /end MEASUREMENT
/begin MEASUREMENT bdemodvkh_msg "GDI possible modes before catalyst heating." UBYTE dez 1 100 0.00 255.0 FORMAT "%5.1" ECU_ADDRESS 0x6000E445 /end MEASUREMENT
/begin MEASUREMENT bdemodvrbt_msg "Definite forbidden operating modes." UBYTE OneToOne 1 100 0.00 255.0 FORMAT "%5.1" ECU_ADDRESS 0x6000E446 /end MEASUREMENT
/begin MEASUREMENT bdemodz_msg "GDI target EOM." UBYTE OneToOne 1 100 0.00 255.0 FORMAT "%5.1" ECU_ADDRESS 0x6000A2A5 /end MEASUREMENT
/begin MEASUREMENT bdemodz_tmp "Intermediate value for internal purposes." UBYTE OneToOne 1 100 0.00 255.0 FORMAT "%5.1" ECU_ADDRESS 0x60009BB3 /end MEASUREMENT
/begin MEASUREMENT bdemod_msg "operating mode of gasoline direct injection" UBYTE OneToOne 1 100 0.00 255.0 FORMAT "%5.1" ECU_ADDRESS 0x6000E43E /end MEASUREMENT
/begin MEASUREMENT bdemsus "GDI desired mode for variable intake manifold" UBYTE OneToOne 1 100 0.00 255.0 FORMAT "%5.1" ECU_ADDRESS 0x60009BAF /end MEASUREMENT
/begin MEASUREMENT B_baschs_msg "GDI desired mode stratified (B_schs, B_skhs)" UBYTE B_TRUE 1 100 0.00 1.00000000000 BIT_MASK 0x1 FORMAT "%13.11" ECU_ADDRESS 0x70000AB5 /end MEASUREMENT
/begin MEASUREMENT B_basch_msg "stratified operating mode active (stratified or stratified catalyst heating)" UBYTE B_TRUE 1 100 0.00 1.00000000000 BIT_MASK 0x1 FORMAT "%13.11" ECU_ADDRESS 0x70000AB6 /end MEASUREMENT
/begin MEASUREMENT B_bdeminst_tmp "Intermediate value for internal purposes." UBYTE B_TRUE 1 100 0.00 1.00000000000 BIT_MASK 0x1 FORMAT "%13.11" ECU_ADDRESS 0x70000307 /end MEASUREMENT
/begin MEASUREMENT B_bdemodfa_msg "The desired driver mode will become the target operating mode." UBYTE B_TRUE 1 100 0.00 1.00000000000 BIT_MASK 0x1 FORMAT "%13.11" ECU_ADDRESS 0x70000AB3 /end MEASUREMENT
/begin MEASUREMENT B_bdemz_msg "GDI-mode dynamic state" UBYTE B_TRUE 1 100 0.00 1.00000000000 BIT_MASK 0x1 FORMAT "%13.11" ECU_ADDRESS 0x70000AB2 /end MEASUREMENT
/begin MEASUREMENT B_bderlsts_msg "Trigger because of Eom changes to the air mass control (input in collector function)." UBYTE B_TRUE 1 100 0.00 1.00000000000 BIT_MASK 0x1 FORMAT "%13.11" ECU_ADDRESS 0x70000AB1 /end MEASUREMENT
/begin MEASUREMENT B_bdetes_msg "Trigger because of Eom changes to the canister purge (input in collector function)." UBYTE B_TRUE 1 100 0.00 1.00000000000 BIT_MASK 0x1 FORMAT "%13.11" ECU_ADDRESS 0x70000AB0 /end MEASUREMENT
/begin MEASUREMENT B_berhom_msg "calculate homogeneous mode" UBYTE B_TRUE 1 100 0.00 1.00000000000 BIT_MASK 0x1 FORMAT "%13.11" ECU_ADDRESS 0x70000AAF /end MEASUREMENT
/begin MEASUREMENT B_bersch_msg "calculate stratified charge mode" UBYTE B_TRUE 1 100 0.00 1.00000000000 BIT_MASK 0x1 FORMAT "%13.11" ECU_ADDRESS 0x70000AAE /end MEASUREMENT
/begin MEASUREMENT B_berskh_msg "calculate stratified catalyst heating mode" UBYTE B_TRUE 1 100 0.00 1.00000000000 BIT_MASK 0x1 FORMAT "%13.11" ECU_ADDRESS 0x70000AAD /end MEASUREMENT
/begin MEASUREMENT B_eahoms_msg "GDI desired injection mode homogeneous (B_homs, B_hmms, B_hoss, B_hsps)." UBYTE B_TRUE 1 100 0.00 1.00000000000 BIT_MASK 0x1 FORMAT "%13.11" ECU_ADDRESS 0x70000A8B /end MEASUREMENT
/begin MEASUREMENT B_eahom_msg "GDI injection mode homogeneous (B_hom, B_hmm, B_hos)" UBYTE B_TRUE 1 100 0.00 1.00000000000 BIT_MASK 0x1 FORMAT "%13.11" ECU_ADDRESS 0x70000A8C /end MEASUREMENT
/begin MEASUREMENT B_easchs_msg "GDI desired injection mode stratified (B_schs, B_hoss, B_skhs)." UBYTE B_TRUE 1 100 0.00 1.00000000000 BIT_MASK 0x1 FORMAT "%13.11" ECU_ADDRESS 0x70000A89 /end MEASUREMENT
/begin MEASUREMENT B_easch_msg "GDI injection mode stratified (B_sch, B_hos, B_skh)" UBYTE B_TRUE 1 100 0.00 1.00000000000 BIT_MASK 0x1 FORMAT "%13.11" ECU_ADDRESS 0x70000A8A /end MEASUREMENT
/begin MEASUREMENT B_hksab_msg "homogeneous-knocking protection mode permitted by exit function" UBYTE B_TRUE 1 100 0.00 1.00000000000 BIT_MASK 0x1 FORMAT "%13.11" ECU_ADDRESS 0x70000A4B /end MEASUREMENT
/begin MEASUREMENT B_hksagrs_msg "GDI-desired mode homogeneous-knocking protection for EGR" UBYTE B_TRUE 1 100 0.00 1.00000000000 BIT_MASK 0x1 FORMAT "%13.11" ECU_ADDRESS 0x70000A4A /end MEASUREMENT
/begin MEASUREMENT B_hksen_msg "condition: homogeneous knocking prevention mode possible" UBYTE B_TRUE 1 100 0.00 1.00000000000 BIT_MASK 0x1 FORMAT "%13.11" ECU_ADDRESS 0x70000A49 /end MEASUREMENT
/begin MEASUREMENT B_hksfes_msg "GDI desired mode homogeneous-knocking protection for air mass control" UBYTE B_TRUE 1 100 0.00 1.00000000000 BIT_MASK 0x1 FORMAT "%13.11" ECU_ADDRESS 0x70000A48 /end MEASUREMENT
/begin MEASUREMENT B_hkss_msg "GDI desired mode homogeneous knocking prevention." UBYTE B_TRUE 1 100 0.00 1.00000000000 BIT_MASK 0x1 FORMAT "%13.11" ECU_ADDRESS 0x70000A47 /end MEASUREMENT
/begin MEASUREMENT B_hksz_msg "GDI target mode homogeneous knocking prevention" UBYTE B_TRUE 1 100 0.00 1.00000000000 BIT_MASK 0x1 FORMAT "%13.11" ECU_ADDRESS 0x70000A46 /end MEASUREMENT
/begin MEASUREMENT B_hmmagrs_msg "GDI-desired mode homogeneous lean for EGR" UBYTE B_TRUE 1 100 0.00 1.00000000000 BIT_MASK 0x1 FORMAT "%13.11" ECU_ADDRESS 0x70000A44 /end MEASUREMENT
/begin MEASUREMENT B_hmmen_msg "condition: homogeneous lean mode possible" UBYTE B_TRUE 1 100 0.00 1.00000000000 BIT_MASK 0x1 FORMAT "%13.11" ECU_ADDRESS 0x70000A43 /end MEASUREMENT
/begin MEASUREMENT B_hmmfes_msg "GDI desired mode homogeneous lean for air mass control" UBYTE B_TRUE 1 100 0.00 1.00000000000 BIT_MASK 0x1 FORMAT "%13.11" ECU_ADDRESS 0x70000A42 /end MEASUREMENT
/begin MEASUREMENT B_hmms_msg "GDI desired mode homogeneous lean" UBYTE B_TRUE 1 100 0.00 1.00000000000 BIT_MASK 0x1 FORMAT "%13.11" ECU_ADDRESS 0x70000A41 /end MEASUREMENT
/begin MEASUREMENT B_hmmz_msg "GDI target mode homogeneous lean" UBYTE B_TRUE 1 100 0.00 1.00000000000 BIT_MASK 0x1 FORMAT "%13.11" ECU_ADDRESS 0x70000A40 /end MEASUREMENT
/begin MEASUREMENT B_homagrs_msg "GDI-desired mode homogeneous for EGR." UBYTE B_TRUE 1 100 0.00 1.00000000000 BIT_MASK 0x1 FORMAT "%13.11" ECU_ADDRESS 0x70000A3F /end MEASUREMENT
/begin MEASUREMENT B_homen_msg "condition: homogeneous mode possible" UBYTE B_TRUE 1 100 0.00 1.00000000000 BIT_MASK 0x1 FORMAT "%13.11" ECU_ADDRESS 0x70000A3E /end MEASUREMENT
/begin MEASUREMENT B_homfes_msg "GDI desired mode homogeneous for air mass control" UBYTE B_TRUE 1 100 0.00 1.00000000000 BIT_MASK 0x1 FORMAT "%13.11" ECU_ADDRESS 0x70000A3D /end MEASUREMENT
/begin MEASUREMENT B_homs_msg "GDI desired mode homogeneous" UBYTE B_TRUE 1 100 0.00 1.00000000000 BIT_MASK 0x1 FORMAT "%13.11" ECU_ADDRESS 0x70000A3C /end MEASUREMENT
/begin MEASUREMENT B_homz_msg "GDI target mode homogeneous" UBYTE B_TRUE 1 100 0.00 1.00000000000 BIT_MASK 0x1 FORMAT "%13.11" ECU_ADDRESS 0x70000A3B /end MEASUREMENT
/begin MEASUREMENT B_hosagrs_msg "GDI-desired mode homogeneous-stratified for EGR" UBYTE B_TRUE 1 100 0.00 1.00000000000 BIT_MASK 0x1 FORMAT "%13.11" ECU_ADDRESS 0x70000A39 /end MEASUREMENT
/begin MEASUREMENT B_hosen_msg "condition: semi-stratified mode possible" UBYTE B_TRUE 1 100 0.00 1.00000000000 BIT_MASK 0x1 FORMAT "%13.11" ECU_ADDRESS 0x70000A38 /end MEASUREMENT
/begin MEASUREMENT B_hosfes_msg "GDI desired mode homogeneous/stratified for air mass control" UBYTE B_TRUE 1 100 0.00 1.00000000000 BIT_MASK 0x1 FORMAT "%13.11" ECU_ADDRESS 0x70000A37 /end MEASUREMENT
/begin MEASUREMENT B_hoss_msg "GDI desired mode homogeneous/stratified (double injection)" UBYTE B_TRUE 1 100 0.00 1.00000000000 BIT_MASK 0x1 FORMAT "%13.11" ECU_ADDRESS 0x70000A36 /end MEASUREMENT
/begin MEASUREMENT B_hosz_msg "GDI target mode homogeneousstratified (double injection)" UBYTE B_TRUE 1 100 0.00 1.00000000000 BIT_MASK 0x1 FORMAT "%13.11" ECU_ADDRESS 0x70000A35 /end MEASUREMENT
/begin MEASUREMENT B_hos_msg "GDI mode homogeneous/stratified (double injection)" UBYTE B_TRUE 1 100 0.00 1.00000000000 BIT_MASK 0x1 FORMAT "%13.11" ECU_ADDRESS 0x70000A3A /end MEASUREMENT
/begin MEASUREMENT B_hsgm_msg "condition operation mode HOS throttled possible" UBYTE B_TRUE 1 100 0.00 1.00000000000 BIT_MASK 0x1 FORMAT "%13.11" ECU_ADDRESS 0x70000A34 /end MEASUREMENT
/begin MEASUREMENT B_hspagrs_msg "Condition homogeneous split as target operating mode for EGR" UBYTE B_TRUE 1 100 0.00 1.00000000000 BIT_MASK 0x1 FORMAT "%13.11" ECU_ADDRESS 0x70000A32 /end MEASUREMENT
/begin MEASUREMENT B_hspen_msg "Homogeneous-split EOM possible." UBYTE B_TRUE 1 100 0.00 1.00000000000 BIT_MASK 0x1 FORMAT "%13.11" ECU_ADDRESS 0x70000A31 /end MEASUREMENT
/begin MEASUREMENT B_hspfes_msg "GDI desired mode homogeneous-split for air mass control" UBYTE B_TRUE 1 100 0.00 1.00000000000 BIT_MASK 0x1 FORMAT "%13.11" ECU_ADDRESS 0x70000A30 /end MEASUREMENT
/begin MEASUREMENT B_hsps_msg "Short-term target operating mode homogeneous split." UBYTE B_TRUE 1 100 0.00 1.00000000000 BIT_MASK 0x1 FORMAT "%13.11" ECU_ADDRESS 0x70000A2F /end MEASUREMENT
/begin MEASUREMENT B_hspz_msg "Condition long-term target operating mode homogeneous split" UBYTE B_TRUE 1 100 0.00 1.00000000000 BIT_MASK 0x1 FORMAT "%13.11" ECU_ADDRESS 0x70000A2E /end MEASUREMENT
/begin MEASUREMENT B_mwab_msg "GDI-mode change: exit current operation mode" UBYTE B_TRUE 1 100 0.00 1.00000000000 BIT_MASK 0x1 FORMAT "%13.11" ECU_ADDRESS 0x700009E8 /end MEASUREMENT
/begin MEASUREMENT B_mwnwss_msg "Trigger of a mode change of the camshaft control." UBYTE B_TRUE 1 100 0.00 1.00000000000 BIT_MASK 0x1 FORMAT "%13.11" ECU_ADDRESS 0x700009E7 /end MEASUREMENT
/begin MEASUREMENT B_mwuss_msg "GDI mode change switchover (trigger)" UBYTE B_TRUE 1 100 0.00 1.00000000000 BIT_MASK 0x1 FORMAT "%13.11" ECU_ADDRESS 0x700009E4 /end MEASUREMENT
/begin MEASUREMENT B_nobdem_msg "Switch GDI mode switching at high engine speed." UBYTE B_TRUE 1 100 0.00 1.00000000000 BIT_MASK 0x1 FORMAT "%13.11" ECU_ADDRESS 0x700009DF /end MEASUREMENT
/begin MEASUREMENT B_scgm_msg "condition operation mode SCH throttled possible" UBYTE B_TRUE 1 100 0.00 1.00000000000 BIT_MASK 0x1 FORMAT "%13.11" ECU_ADDRESS 0x700009B6 /end MEASUREMENT
/begin MEASUREMENT B_schagrs_msg "GDI-desired mode stratified for EGR" UBYTE B_TRUE 1 100 0.00 1.00000000000 BIT_MASK 0x1 FORMAT "%13.11" ECU_ADDRESS 0x700009B5 /end MEASUREMENT
/begin MEASUREMENT B_schen_msg "condition: stratified mode possible" UBYTE B_TRUE 1 100 0.00 1.00000000000 BIT_MASK 0x1 FORMAT "%13.11" ECU_ADDRESS 0x700009B4 /end MEASUREMENT
/begin MEASUREMENT B_schfes_msg "GDI desired mode stratified for air mass control" UBYTE B_TRUE 1 100 0.00 1.00000000000 BIT_MASK 0x1 FORMAT "%13.11" ECU_ADDRESS 0x700009B3 /end MEASUREMENT
/begin MEASUREMENT B_schs_msg "GDI desired mode stratified" UBYTE B_TRUE 1 100 0.00 1.00000000000 BIT_MASK 0x1 FORMAT "%13.11" ECU_ADDRESS 0x700009B2 /end MEASUREMENT
/begin MEASUREMENT B_schz_msg "GDI target mode stratified" UBYTE B_TRUE 1 100 0.00 1.00000000000 BIT_MASK 0x1 FORMAT "%13.11" ECU_ADDRESS 0x700009B1 /end MEASUREMENT
/begin MEASUREMENT B_skhagrs_msg "GDI-desired mode stratified-catalyst heating for EGR" UBYTE B_TRUE 1 100 0.00 1.00000000000 BIT_MASK 0x1 FORMAT "%13.11" ECU_ADDRESS 0x700009AE /end MEASUREMENT
/begin MEASUREMENT B_skhfes_msg "GDI desired mode stratified/catalyst heating for air mass control" UBYTE B_TRUE 1 100 0.00 1.00000000000 BIT_MASK 0x1 FORMAT "%13.11" ECU_ADDRESS 0x700009AD /end MEASUREMENT
/begin MEASUREMENT B_skhs "GDI desired mode stratified/catalyst heating (double injection)" UBYTE B_TRUE 1 100 0.00 1.00000000000 BIT_MASK 0x1 FORMAT "%13.11" ECU_ADDRESS 0x70000306 /end MEASUREMENT
/begin MEASUREMENT B_skhs_msg "GDI desired mode stratified/catalyst heating (double injection)" UBYTE B_TRUE 1 100 0.00 1.00000000000 BIT_MASK 0x1 FORMAT "%13.11" ECU_ADDRESS 0x700009AC /end MEASUREMENT
/begin MEASUREMENT B_skhz_msg "GDI target mode stratified catalyst heating" UBYTE B_TRUE 1 100 0.00 1.00000000000 BIT_MASK 0x1 FORMAT "%13.11" ECU_ADDRESS 0x700009AB /end MEASUREMENT
/begin MEASUREMENT B_ubaov_msg "Change of operating mode without delay." UBYTE B_TRUE 1 100 0.00 1.00000000000 BIT_MASK 0x1 FORMAT "%13.11" ECU_ADDRESS 0x70000971 /end MEASUREMENT
/begin MEASUREMENT B_umhomsch_msg "2-stage switching from HOM to SCH" UBYTE B_TRUE 1 100 0.00 1.00000000000 BIT_MASK 0x1 FORMAT "%13.11" ECU_ADDRESS 0x7000096A /end MEASUREMENT
/begin MEASUREMENT B_umschhom_msg "2-stage switching from SCH to HOM" UBYTE B_TRUE 1 100 0.00 1.00000000000 BIT_MASK 0x1 FORMAT "%13.11" ECU_ADDRESS 0x70000969 /end MEASUREMENT
/begin MEASUREMENT B_vhegfes_msg "Condition valve lift variation for charge control" UBYTE B_TRUE 1 100 0.00 1.00000000000 BIT_MASK 0x1 FORMAT "%13.11" ECU_ADDRESS 0x70000964 /end MEASUREMENT
/begin MEASUREMENT B_vhegs_msg "desired mode on high valve lift" UBYTE B_TRUE 1 100 0.00 1.00000000000 BIT_MASK 0x1 FORMAT "%13.11" ECU_ADDRESS 0x70000963 /end MEASUREMENT
/begin MEASUREMENT B_vhegtes_msg "Condition valve lift variation switching canister purge (trigger)." UBYTE B_TRUE 1 100 0.00 1.00000000000 BIT_MASK 0x1 FORMAT "%13.11" ECU_ADDRESS 0x70000962 /end MEASUREMENT
/begin MEASUREMENT B_vhegvss_msg "Condition valve lift variation switching camshaft control (trigger)" UBYTE B_TRUE 1 100 0.00 1.00000000000 BIT_MASK 0x1 FORMAT "%13.11" ECU_ADDRESS 0x70000960 /end MEASUREMENT
/begin MEASUREMENT B_vheg_msg "Condition high valve lift active" UBYTE B_TRUE 1 100 0.00 1.00000000000 BIT_MASK 0x1 FORMAT "%13.11" ECU_ADDRESS 0x70000966 /end MEASUREMENT
/begin MEASUREMENT B_vheinst_msg "Condition instationary state during valve lift variation." UBYTE B_TRUE 1 100 0.00 1.00000000000 BIT_MASK 0x1 FORMAT "%13.11" ECU_ADDRESS 0x7000095F /end MEASUREMENT
/begin MEASUREMENT B_vherlsts_msg "Condition valve lift switching stationary charge (trigger)." UBYTE B_TRUE 1 100 0.00 1.00000000000 BIT_MASK 0x1 FORMAT "%13.11" ECU_ADDRESS 0x7000095E /end MEASUREMENT
/begin MEASUREMENT B_zwschfes_msg "GDI desired mode stratified for air mass control" UBYTE B_TRUE 1 100 0.00 1.00000000000 BIT_MASK 0x1 FORMAT "%13.11" ECU_ADDRESS 0x7000094D /end MEASUREMENT
/begin MEASUREMENT B_zwschs_msg "condition desired GDI operating mode with ignition angle for stratified mode" UBYTE B_TRUE 1 100 0.00 1.00000000000 BIT_MASK 0x1 FORMAT "%13.11" ECU_ADDRESS 0x7000094C /end MEASUREMENT
/begin MEASUREMENT CoEng_flgDesEomDsm "Flag: desired engine mode of operation is determined by Diagnostic System Management." UBYTE B_TRUE 1 100 0.00 1.00000000000 BIT_MASK 0x1 FORMAT "%13.11" ECU_ADDRESS 0x700008D3 /end MEASUREMENT
/begin MEASUREMENT CoEng_flgDesEomLimp "Flag: desired engine mode of operation is determined by limp home function." UBYTE B_TRUE 1 100 0.00 1.00000000000 BIT_MASK 0x1 FORMAT "%13.11" ECU_ADDRESS 0x700008D2 /end MEASUREMENT
/begin MEASUREMENT CoEng_flgDesEomNsc "Flag: desired engine mode of operation is determined by NOx storage catalyst function." UBYTE B_TRUE 1 100 0.00 1.00000000000 BIT_MASK 0x1 FORMAT "%13.11" ECU_ADDRESS 0x700008D1 /end MEASUREMENT
/begin MEASUREMENT CoEOM_bHLN "Condition GDI mode homogeneous lean" UBYTE B_TRUE 1 100 0.00 1.00000000000 BIT_MASK 0x1 FORMAT "%13.11" ECU_ADDRESS 0x700008F7 /end MEASUREMENT
/begin MEASUREMENT CoEOM_bHOM "Homogeneous operating mode of gasoline direct injection" UBYTE B_TRUE 1 100 0.00 1.00000000000 BIT_MASK 0x1 FORMAT "%13.11" ECU_ADDRESS 0x700008F6 /end MEASUREMENT
/begin MEASUREMENT CoEOM_bIASTF "Condition ignition angle for stratified operating mode active" UBYTE B_TRUE 1 100 0.00 1.00000000000 BIT_MASK 0x1 FORMAT "%13.11" ECU_ADDRESS 0x700008F5 /end MEASUREMENT
/begin MEASUREMENT CoEOM_bSPC "Condition GDI operation mode stratified post injection for catalyst heating (SPC)" UBYTE B_TRUE 1 100 0.00 1.00000000000 BIT_MASK 0x1 FORMAT "%13.11" ECU_ADDRESS 0x700008F4 /end MEASUREMENT
/begin MEASUREMENT CoEOM_bTransActv "Status if an operation mode change is active" UBYTE B_TRUE 1 100 0.00 1.00000000000 BIT_MASK 0x1 FORMAT "%13.11" ECU_ADDRESS 0x700008F3 /end MEASUREMENT
/begin MEASUREMENT CoEOM_ctCylAdv "Cylinder counter for updating coeom array" UBYTE OneToOne 1 100 0.00 255.0 FORMAT "%5.1" ECU_ADDRESS 0x50000846 /end MEASUREMENT
/begin MEASUREMENT CoEOM_ctCylAdvTmng "Calculated cylinder index for CoEOM_flgTmngFinshed (local variable, do not use as import)" UBYTE OneToOne 1 100 0.00 255.0 FORMAT "%5.1" ECU_ADDRESS 0x50000847 /end MEASUREMENT
/begin MEASUREMENT CoEOM_flgCylAdvCalcd "Cylinder for switching to new EOM selected" UBYTE B_TRUE 1 100 0.00 1.00000000000 BIT_MASK 0x1 FORMAT "%13.11" ECU_ADDRESS 0x70000308 /end MEASUREMENT
/begin MEASUREMENT CoEOM_flgCylAdvCalcdTmng "Cylinder for leaving Timing selected" UBYTE B_TRUE 1 100 0.00 1.00000000000 BIT_MASK 0x1 FORMAT "%13.11" ECU_ADDRESS 0x700008F2 /end MEASUREMENT
/begin MEASUREMENT CoEOM_flgDesEomAbort "Flag: desired engine mode of operation is determined by exit function." UBYTE B_TRUE 1 100 0.00 1.00000000000 BIT_MASK 0x1 FORMAT "%13.11" ECU_ADDRESS 0x700008F1 /end MEASUREMENT
/begin MEASUREMENT CoEOM_flgDesTqAdjmt "Flag: desired engine mode of operation is determined by engine torque adjustment." UBYTE B_TRUE 1 100 0.00 1.00000000000 BIT_MASK 0x1 FORMAT "%13.11" ECU_ADDRESS 0x700008F0 /end MEASUREMENT
/begin MEASUREMENT CoEOM_flgEomIgnRels "The mode of operation change-over requests ignition angle release." UBYTE B_TRUE 1 100 0.00 1.00000000000 BIT_MASK 0x1 FORMAT "%13.11" ECU_ADDRESS 0x700008EE /end MEASUREMENT
/begin MEASUREMENT CoEOM_flgEomInterHosPln "Flag: the intermediate operating mode HOS is planned." UBYTE B_TRUE 1 100 0.00 1.00000000000 BIT_MASK 0x1 FORMAT "%13.11" ECU_ADDRESS 0x700008ED /end MEASUREMENT
/begin MEASUREMENT CoEOM_flgEomSwtActv "Switching of engine operating mode active" UBYTE B_TRUE 1 100 0.00 1.00000000000 BIT_MASK 0x1 FORMAT "%13.11" ECU_ADDRESS 0x700008EC /end MEASUREMENT
/begin MEASUREMENT CoEOM_flgEomSwtDes "Signals for a computing time slot the start of a mode of operation change-over." UBYTE B_TRUE 1 100 0.00 1.00000000000 BIT_MASK 0x1 FORMAT "%13.11" ECU_ADDRESS 0x700008EB /end MEASUREMENT
/begin MEASUREMENT CoEOM_flgEomSwtIniDesLoc "Local bit so switch the desired Value to the initial value CoEOM_stEOMIni_C" UBYTE B_TRUE 1 100 0.00 1.00000000000 BIT_MASK 0x1 FORMAT "%13.11" ECU_ADDRESS 0x700008EA /end MEASUREMENT
/begin MEASUREMENT CoEOM_flgEomSwtIniLoc "Local tigger for initialisation at start request" UBYTE B_TRUE 1 100 0.00 1.00000000000 BIT_MASK 0x1 FORMAT "%13.11" ECU_ADDRESS 0x700008E9 /end MEASUREMENT
/begin MEASUREMENT CoEOM_flgEomTrigAirStaty "Demand to the air system to adjust the stationary air filling." UBYTE B_TRUE 1 100 0.00 1.00000000000 BIT_MASK 0x1 FORMAT "%13.11" ECU_ADDRESS 0x700008E8 /end MEASUREMENT
/begin MEASUREMENT CoEOM_flgHkp "Flag: The engine operation mode HKP (homogeneous knocking prevention) is active." UBYTE B_TRUE 1 100 0.00 1.00000000000 BIT_MASK 0x1 FORMAT "%13.11" ECU_ADDRESS 0x700008E7 /end MEASUREMENT
/begin MEASUREMENT CoEOM_flgHosAllwdExcpn "Flag: The intermediate operating mode Hos is allowed exceptionally because it is forbidden only by B_hoslldi." UBYTE B_TRUE 1 100 0.00 1.00000000000 BIT_MASK 0x1 FORMAT "%13.11" ECU_ADDRESS 0x700008E6 /end MEASUREMENT
/begin MEASUREMENT CoEOM_flgHsp "Flag: The engine operation mode HSP (homogeneous-split) is active." UBYTE B_TRUE 1 100 0.00 1.00000000000 BIT_MASK 0x1 FORMAT "%13.11" ECU_ADDRESS 0x700008E5 /end MEASUREMENT
/begin MEASUREMENT CoEOM_flgNxtCylCalcnTrig "Calculation of next switchable cylinder will be executed (triggered)" UBYTE B_TRUE 1 100 0.00 1.00000000000 BIT_MASK 0x1 FORMAT "%13.11" ECU_ADDRESS 0x70001A48 /end MEASUREMENT
/begin MEASUREMENT CoEOM_flgProlgSlip "Slip expansion for automatic transmission is active." UBYTE B_TRUE 1 100 0.00 1.00000000000 BIT_MASK 0x1 FORMAT "%13.11" ECU_ADDRESS 0x700008E4 /end MEASUREMENT
/begin MEASUREMENT CoEOM_flgStrat "stratified operating mode of gasoline direct injection" UBYTE B_TRUE 1 100 0.00 1.00000000000 BIT_MASK 0x1 FORMAT "%13.11" ECU_ADDRESS 0x700008E2 /end MEASUREMENT
/begin MEASUREMENT CoEOM_flgTmngExeSync "Bit, if state A_TMNG_STGY is activated in sync-raster" UBYTE B_TRUE 1 100 0.00 1.00000000000 BIT_MASK 0x1 FORMAT "%13.11" ECU_ADDRESS 0x700008E1 /end MEASUREMENT
/begin MEASUREMENT CoEOM_flgTmngFinshed "Eom Swt timing finished. Next cylinder will burn in new Eom" UBYTE B_TRUE 1 100 0.00 1.00000000000 BIT_MASK 0x1 FORMAT "%13.11" ECU_ADDRESS 0x700008E0 /end MEASUREMENT
/begin MEASUREMENT CoEOM_flgTqCalcnReqd "The torque calculation for the mode of operation change-over is requested." UBYTE B_TRUE 1 100 0.00 1.00000000000 BIT_MASK 0x1 FORMAT "%13.11" ECU_ADDRESS 0x700008DF /end MEASUREMENT
/begin MEASUREMENT CoEOM_flgUnstyShftPred "Flag: a mode of operation change-over with unsteady phase is expected." UBYTE B_TRUE 1 100 0.00 1.00000000000 BIT_MASK 0x1 FORMAT "%13.11" ECU_ADDRESS 0x700008DE /end MEASUREMENT
/begin MEASUREMENT CoEOM_idxGroupEomActv "Index of the mode of operation group of the active mode of operation." UBYTE OneToOne 1 100 0.00 255.0 FORMAT "%5.1" ECU_ADDRESS 0x600006D0 /end MEASUREMENT
/begin MEASUREMENT CoEOM_idxGroupEomDes "Index of the mode of operation group of the desired mode of operation." UBYTE OneToOne 1 100 0.00 255.0 FORMAT "%5.1" ECU_ADDRESS 0x600006D1 /end MEASUREMENT
/begin MEASUREMENT CoEOM_idxSwtStgyM "Local interims value for desired switch strategy out of calibration MAP" UBYTE OneToOne 1 100 0.00 255.0 FORMAT "%5.1" ECU_ADDRESS 0x600006D2 /end MEASUREMENT
/begin MEASUREMENT CoEOM_idxSwtStgySeld "The number of the chosen strategy for switching the EOM." UBYTE OneToOne 1 100 0.00 255.0 FORMAT "%5.1" ECU_ADDRESS 0x60000757 /end MEASUREMENT
/begin MEASUREMENT CoEOM_idxSwtStgySeldLoc "Local copy of CoEOM_idxSwtStgySeld" UBYTE OneToOne 1 100 0.00 255.0 FORMAT "%5.1" ECU_ADDRESS 0x600006D3 /end MEASUREMENT
/begin MEASUREMENT CoEOM_nrPrdnHoz "Length of the array CoEOM_stEomCylAdv_a for the extended prediction horizon" UBYTE OneToOne 1 100 1.0 255.0 FORMAT "%5.1" ECU_ADDRESS 0x50000886 /end MEASUREMENT
/begin MEASUREMENT CoEOM_stEom "Current engine operation mode (single value)" UWORD CoEOM_stEomStgTot_VERB 1 100 0.00 7951.00000000 FORMAT "%13.8" ECU_ADDRESS 0x600004D6 /end MEASUREMENT
/begin MEASUREMENT CoEOM_stEomActv "Current mode of operation of the internal-combustion engine" UWORD CoEOM_stEomStgTot_VERB 1 100 0.00 7951.00000000 FORMAT "%13.8" ECU_ADDRESS 0x600004D8 /end MEASUREMENT
/begin MEASUREMENT CoEOM_stEomActvLoc "Local copy of CoEOM_stEomActv" UWORD CoEOM_stEomStgTot_VERB 1 100 0.00 7951.00000000 FORMAT "%13.8" ECU_ADDRESS 0x600003FC /end MEASUREMENT
/begin MEASUREMENT CoEOM_stEomActvTmng "current mode of operation of the internal-combustion engine after timing condition" UWORD CoEOM_stEomStgTot_VERB 1 100 0.00 7951.00000000 FORMAT "%13.8" ECU_ADDRESS 0x600004DA /end MEASUREMENT
/begin MEASUREMENT CoEOM_stEomActvTmngLoc "Local copy of CoEOM_stEomActvTmng" UWORD CoEOM_stEomStgTot_VERB 1 100 0.00 7951.00000000 FORMAT "%13.8" ECU_ADDRESS 0x600003FE /end MEASUREMENT
/begin MEASUREMENT CoEOM_stEomCylAdv_a "Array with target eoms for each cylinder. Prediction done with new cylinder counter Gen_ctCylAdv" UWORD CoEOM_stEomStgTot_VERB 1 100 0.00 7951.00000000 FORMAT "%13.8" ARRAY_SIZE 4 ECU_ADDRESS 0x500004E0 /end MEASUREMENT
/begin MEASUREMENT CoEOM_stEomDesReqdLoc "Local copy of the requested mode of operation." UWORD CoEOM_stEomStgTot_VERB 1 100 0.00 7951.00000000 FORMAT "%13.8" ECU_ADDRESS 0x600004DC /end MEASUREMENT
/begin MEASUREMENT CoEOM_stEomLoc "Local copy of CoEOM_stEom" UWORD CoEOM_stEomStgTot_VERB 1 100 0.00 7951.00000000 FORMAT "%13.8" ECU_ADDRESS 0x50000622 /end MEASUREMENT
/begin MEASUREMENT CoEOM_stEomTar "Target mode of operation." UWORD CoEOM_stEomStgTot_VERB 1 100 0.00 7951.00000000 FORMAT "%13.8" ECU_ADDRESS 0x600004DE /end MEASUREMENT
/begin MEASUREMENT CoEOM_stEomTarActr "Engine operation mode for actuators." UWORD CoEOM_stEomStgTot_VERB 1 100 0.00 7951.00000000 FORMAT "%13.8" ECU_ADDRESS 0x600004E0 /end MEASUREMENT
/begin MEASUREMENT CoEOM_stEomTarActrLoc "Local copy of CoEOM_stEomTarActr" UWORD CoEOM_stEomStgTot_VERB 1 100 0.00 7951.00000000 FORMAT "%13.8" ECU_ADDRESS 0x60000404 /end MEASUREMENT
/begin MEASUREMENT CoEOM_stEomTarAirSys "The mode of operation default for the air system." UWORD CoEOM_stEomStgTot_VERB 1 100 0.00 7951.00000000 FORMAT "%13.8" ECU_ADDRESS 0x600004E2 /end MEASUREMENT
/begin MEASUREMENT CoEOM_stEomTarAirSysLoc "Local copy of CoEOM_stEomTarAirSys" UWORD CoEOM_stEomStgTot_VERB 1 100 0.00 7951.00000000 FORMAT "%13.8" ECU_ADDRESS 0x60000406 /end MEASUREMENT
/begin MEASUREMENT CoEOM_stEomTarHw "Target eom for hardware actuator (e.g. valve lift)" UWORD CoEOM_stEomStgTot_VERB 1 100 0.00 7951.00000000 FORMAT "%13.8" ECU_ADDRESS 0x600004E4 /end MEASUREMENT
/begin MEASUREMENT CoEOM_stEomTarHwLoc "Local copy of CoEOM_stEomTarHw" UWORD CoEOM_stEomStgTot_VERB 1 100 0.00 7951.00000000 FORMAT "%13.8" ECU_ADDRESS 0x600004E6 /end MEASUREMENT
/begin MEASUREMENT CoEOM_stEomTarInj "Engine operation mode for the injection system." UWORD CoEOM_stEomStgTot_VERB 1 100 0.00 7951.00000000 FORMAT "%13.8" ECU_ADDRESS 0x600004EA /end MEASUREMENT
/begin MEASUREMENT CoEOM_stEomTarInjLoc "Local copy of CoEOM_stEomTarInj" UWORD CoEOM_stEomStgTot_VERB 1 100 0.00 7951.00000000 FORMAT "%13.8" ECU_ADDRESS 0x60000408 /end MEASUREMENT
/begin MEASUREMENT CoEOM_stEomTarLbk "Engine operation mode for LBK" UWORD CoEOM_stEomStgTot_VERB 1 100 0.00 7951.00000000 FORMAT "%13.8" ECU_ADDRESS 0x600004EE /end MEASUREMENT
/begin MEASUREMENT CoEOM_stEomTarLbkLoc "Local copy of CoEOM_stEomTarLbk" UWORD CoEOM_stEomStgTot_VERB 1 100 0.00 7951.00000000 FORMAT "%13.8" ECU_ADDRESS 0x6000040A /end MEASUREMENT
/begin MEASUREMENT CoEOM_stEomTarLoc "Local copy of CoEOM_stEomTar" UWORD CoEOM_stEomStgTot_VERB 1 100 0.00 7951.00000000 FORMAT "%13.8" ECU_ADDRESS 0x600004F0 /end MEASUREMENT
/begin MEASUREMENT CoEOM_stEomTarPostProlgSlip "Target mode of operation after slip expansion (changes later than bdemodz)." UBYTE OneToOne 1 100 0.00 255.0 FORMAT "%5.1" ECU_ADDRESS 0x6000E401 /end MEASUREMENT
/begin MEASUREMENT CoEOM_stEomTarPrev "Previous target engine operating mode for switch" UWORD CoEOM_stEomStgTot_VERB 1 100 0.00 7951.00000000 FORMAT "%13.8" ECU_ADDRESS 0x600004F2 /end MEASUREMENT
/begin MEASUREMENT CoEOM_stOpMAct "Active operation mode" UWORD OneToOne 1 100 0.00 65535.00 FORMAT "%8.2" ECU_ADDRESS 0x500059F2 /end MEASUREMENT
/begin MEASUREMENT CoEOM_stOpMPos "Bit mask of the possible operation modes for the DSM-Scheduler" UBYTE dez 1 100 0.00 255.0 FORMAT "%5.1" ECU_ADDRESS 0x6000A688 /end MEASUREMENT
/begin MEASUREMENT CoEOM_stPhaEomShift "Phase of the mode of operation change-over." UBYTE OneToOne 1 100 0.00 255.0 FORMAT "%5.1" ECU_ADDRESS 0x60000758 /end MEASUREMENT
/begin MEASUREMENT CoEOM_stPhaEomShiftLoc "Local copy of CoEOM_stPhaEomShift" UBYTE OneToOne 1 100 0.00 255.0 FORMAT "%5.1" ECU_ADDRESS 0x60000759 /end MEASUREMENT
/begin MEASUREMENT CoEOM_stTrigActvt "Demand of the mode of operation control to the actuators to prepare itself for a change-over." UWORD OneToOne 1 100 0.00 65535.00 FORMAT "%8.2" ECU_ADDRESS 0x600004F6 /end MEASUREMENT
/begin MEASUREMENT CoEOM_stTrigActvtLoc "Local copy of CoEOM_stTrigActvt" UWORD OneToOne 1 100 0.00 65535.00 FORMAT "%8.2" ECU_ADDRESS 0x6000040C /end MEASUREMENT
/begin MEASUREMENT CoEOM_SwtStgy1.flgEomSwtDes "Switching strategy of eom switches that operates without trigger / Signals for a computing time slot the start of a mode of operation change-over" UBYTE OneToOne 1 100 0.00 255.0 FORMAT "%5.1" ECU_ADDRESS 0x5000011C /end MEASUREMENT
/begin MEASUREMENT CoEOM_SwtStgy1.flgRelAirStatyEomChg "Switching strategy of eom switches that operates without trigger / After a change of the mode of operation the charge is settled stationarily" UBYTE OneToOne 1 100 0.00 255.0 FORMAT "%5.1" ECU_ADDRESS 0x5000011D /end MEASUREMENT
/begin MEASUREMENT CoEOM_SwtStgy1.flgTmngFinshed "Switching strategy of eom switches that operates without trigger / sturcture variable: cylinder will burn in new eom" UBYTE OneToOne 1 100 0.00 255.0 FORMAT "%5.1" ECU_ADDRESS 0x5000011E /end MEASUREMENT
/begin MEASUREMENT CoEOM_SwtStgy1.flgWrStEomActv "Switching strategy of eom switches that operates without trigger / Triggerflag to write the CoEOM_stEomActv values" UBYTE B_TRUE 1 100 0.00 1.00000000000 BIT_MASK 0x1 FORMAT "%13.11" ECU_ADDRESS 0x5000011F /end MEASUREMENT
/begin MEASUREMENT CoEOM_SwtStgy1.flgWrStEomActvTmng "Switching strategy of eom switches that operates without trigger / Triggerflag to write the CoEOM_stEomActvTmng values" UBYTE B_TRUE 1 100 0.00 1.00000000000 BIT_MASK 0x1 FORMAT "%13.11" ECU_ADDRESS 0x50000120 /end MEASUREMENT
/begin MEASUREMENT CoEOM_SwtStgy1.flgWrStEomTarActr "Switching strategy of eom switches that operates without trigger / Triggerflag to write the CoEOM_stEomTarActr values" UBYTE B_TRUE 1 100 0.00 1.00000000000 BIT_MASK 0x1 FORMAT "%13.11" ECU_ADDRESS 0x50000121 /end MEASUREMENT
/begin MEASUREMENT CoEOM_SwtStgy1.flgWrStEomTarAirSys "Switching strategy of eom switches that operates without trigger / Triggerflag to write the CoEOM_stEomTarAirSys values" UBYTE B_TRUE 1 100 0.00 1.00000000000 BIT_MASK 0x1 FORMAT "%13.11" ECU_ADDRESS 0x50000122 /end MEASUREMENT
/begin MEASUREMENT CoEOM_SwtStgy1.flgWrStEomTarHw "Switching strategy of eom switches that operates without trigger / Triggerflag to write the CoEOM_stEomTarHw values" UBYTE B_TRUE 1 100 0.00 1.00000000000 BIT_MASK 0x1 FORMAT "%13.11" ECU_ADDRESS 0x50000123 /end MEASUREMENT
/begin MEASUREMENT CoEOM_SwtStgy1.flgWrStEomTarInj "Switching strategy of eom switches that operates without trigger / Triggerflag to write the CoEOM_stEomTarInj values" UBYTE B_TRUE 1 100 0.00 1.00000000000 BIT_MASK 0x1 FORMAT "%13.11" ECU_ADDRESS 0x50000124 /end MEASUREMENT
/begin MEASUREMENT CoEOM_SwtStgy1.flgWrStEomTarLbk "Switching strategy of eom switches that operates without trigger / Triggerflag to write the CoEOM_stEomTarLbk values" UBYTE B_TRUE 1 100 0.00 1.00000000000 BIT_MASK 0x1 FORMAT "%13.11" ECU_ADDRESS 0x50000125 /end MEASUREMENT
/begin MEASUREMENT CoEOM_SwtStgy1.sm "Switching strategy of eom switches that operates without trigger / Current state of state machine" UBYTE CoEOM_SwtStgy1_sm_VERB 1 100 0.00 2.00000000000 FORMAT "%13.11" ECU_ADDRESS 0x50000126 /end MEASUREMENT
/begin MEASUREMENT CoEOM_SwtStgy1.stPhaEomShift "Switching strategy of eom switches that operates without trigger / Phase of the mode of operation change-over" UBYTE OneToOne 1 100 0.00 255.0 FORMAT "%5.1" ECU_ADDRESS 0x50000127 /end MEASUREMENT
/begin MEASUREMENT CoEOM_SwtStgy1.stTrigActvt "Switching strategy of eom switches that operates without trigger / Demand of the mode of operation control to the actuators to prepare itself for a change-over" UWORD OneToOne 1 100 0.00 65535.00 FORMAT "%8.2" ECU_ADDRESS 0x50000128 /end MEASUREMENT
/begin MEASUREMENT CoEOM_SwtStgy1.tiSwt "Switching strategy of eom switches that operates without trigger / Ex-time in the respective condition of the mode of operation change-over" SWORD Time_s 1 100 -327.6800 327.6700 FORMAT "%8.4" ECU_ADDRESS 0x5000012A /end MEASUREMENT
/begin MEASUREMENT CoEOM_SwtStgy2.flgEomSwtDes "Switching strategy of eom switches that operates with triggers and filling preparation / Ignition system switches over to a new mode of operation" UBYTE OneToOne 1 100 0.00 255.0 FORMAT "%5.1" ECU_ADDRESS 0x5000012C /end MEASUREMENT
/begin MEASUREMENT CoEOM_SwtStgy2.flgRelAirStatyEomChg "Switching strategy of eom switches that operates with triggers and filling preparation / After a change of the mode of operation the charge is settled stationarily" UBYTE OneToOne 1 100 0.00 255.0 FORMAT "%5.1" ECU_ADDRESS 0x5000012D /end MEASUREMENT
/begin MEASUREMENT CoEOM_SwtStgy2.flgTmngFinshed "Switching strategy of eom switches that operates with triggers and filling preparation / sturcture variable: cylinder will burn in new eom" UBYTE OneToOne 1 100 0.00 255.0 FORMAT "%5.1" ECU_ADDRESS 0x5000012E /end MEASUREMENT
/begin MEASUREMENT CoEOM_SwtStgy2.flgTqCalcnAckd "Switching strategy of eom switches that operates with triggers and filling preparation / predicted torque matches target torque" UBYTE OneToOne 1 100 0.00 255.0 FORMAT "%5.1" ECU_ADDRESS 0x5000012F /end MEASUREMENT
/begin MEASUREMENT CoEOM_SwtStgy2.flgWrStEomActv "Switching strategy of eom switches that operates with triggers and filling preparation / Triggerflag to write the CoEOM_stEomActv values" UBYTE B_TRUE 1 100 0.00 1.00000000000 BIT_MASK 0x1 FORMAT "%13.11" ECU_ADDRESS 0x50000130 /end MEASUREMENT
/begin MEASUREMENT CoEOM_SwtStgy2.flgWrStEomActvTmng "Switching strategy of eom switches that operates with triggers and filling preparation / Triggerflag to write the CoEOM_stEomActvTmng values" UBYTE B_TRUE 1 100 0.00 1.00000000000 BIT_MASK 0x1 FORMAT "%13.11" ECU_ADDRESS 0x50000131 /end MEASUREMENT
/begin MEASUREMENT CoEOM_SwtStgy2.flgWrStEomTarActr "Switching strategy of eom switches that operates with triggers and filling preparation / Triggerflag to write the CoEOM_stEomTarActr values" UBYTE B_TRUE 1 100 0.00 1.00000000000 BIT_MASK 0x1 FORMAT "%13.11" ECU_ADDRESS 0x50000132 /end MEASUREMENT
/begin MEASUREMENT CoEOM_SwtStgy2.flgWrStEomTarAirSys "Switching strategy of eom switches that operates with triggers and filling preparation / Triggerflag to write the CoEOM_stEomTarAirSys values" UBYTE B_TRUE 1 100 0.00 1.00000000000 BIT_MASK 0x1 FORMAT "%13.11" ECU_ADDRESS 0x50000133 /end MEASUREMENT
/begin MEASUREMENT CoEOM_SwtStgy2.flgWrStEomTarHw "Switching strategy of eom switches that operates with triggers and filling preparation / Triggerflag to write the CoEOM_stEomTarHw values" UBYTE B_TRUE 1 100 0.00 1.00000000000 BIT_MASK 0x1 FORMAT "%13.11" ECU_ADDRESS 0x50000134 /end MEASUREMENT
/begin MEASUREMENT CoEOM_SwtStgy2.flgWrStEomTarInj "Switching strategy of eom switches that operates with triggers and filling preparation / Triggerflag to write the CoEOM_stEomTarInj values" UBYTE B_TRUE 1 100 0.00 1.00000000000 BIT_MASK 0x1 FORMAT "%13.11" ECU_ADDRESS 0x50000135 /end MEASUREMENT
/begin MEASUREMENT CoEOM_SwtStgy2.flgWrStEomTarLbk "Switching strategy of eom switches that operates with triggers and filling preparation / Triggerflag to write the CoEOM_stEomTarLbk values" UBYTE B_TRUE 1 100 0.00 1.00000000000 BIT_MASK 0x1 FORMAT "%13.11" ECU_ADDRESS 0x50000136 /end MEASUREMENT
/begin MEASUREMENT CoEOM_SwtStgy2.sm "Switching strategy of eom switches that operates with triggers and filling preparation / Current state of state machine" UBYTE CoEOM_SwtStgy2_sm_VERB 1 100 0.00 4.00000000000 FORMAT "%13.11" ECU_ADDRESS 0x50000137 /end MEASUREMENT
/begin MEASUREMENT CoEOM_SwtStgy2.stPhaEomShift "Switching strategy of eom switches that operates with triggers and filling preparation / Phase of the mode of operation change-over" UBYTE OneToOne 1 100 0.00 255.0 FORMAT "%5.1" ECU_ADDRESS 0x50000138 /end MEASUREMENT
/begin MEASUREMENT CoEOM_SwtStgy2.stTrigAckd "Switching strategy of eom switches that operates with triggers and filling preparation / Receipts of the systems by appropriate demand because of a mode of operation change" UWORD OneToOne 1 100 0.00 65535.00 FORMAT "%8.2" ECU_ADDRESS 0x5000013A /end MEASUREMENT
/begin MEASUREMENT CoEOM_SwtStgy2.stTrigActvt "Switching strategy of eom switches that operates with triggers and filling preparation / Demand of the mode of operation control to the actuators to prepare itself for a change-over" UWORD OneToOne 1 100 0.00 65535.00 FORMAT "%8.2" ECU_ADDRESS 0x5000013C /end MEASUREMENT
/begin MEASUREMENT CoEOM_SwtStgy2.tiSwt "Switching strategy of eom switches that operates with triggers and filling preparation / Ex-time in the respective condition of the mode of operation change-over" SWORD Time_s 1 100 -327.6800 327.6700 FORMAT "%8.4" ECU_ADDRESS 0x5000013E /end MEASUREMENT
/begin MEASUREMENT CoEOM_SwtStgy5.flgEomSwtDes "Switch strategy for triggered valve lift switch / Internal variable to see that a switch is desired" UBYTE OneToOne 1 100 0.00 255.0 FORMAT "%5.1" ECU_ADDRESS 0x50000610 /end MEASUREMENT
/begin MEASUREMENT CoEOM_SwtStgy5.flgRelAirStatyEomChg "Switch strategy for triggered valve lift switch / Internal variable to see that the AirSys has a stable relative air calculation" UBYTE OneToOne 1 100 0.00 255.0 FORMAT "%5.1" ECU_ADDRESS 0x50000611 /end MEASUREMENT
/begin MEASUREMENT CoEOM_SwtStgy5.flgTmngFinshed "Switch strategy for triggered valve lift switch / Internal variable to see if the timing calculation of the switch (next cylinder will burn in new eom) is finished" UBYTE OneToOne 1 100 0.00 255.0 FORMAT "%5.1" ECU_ADDRESS 0x50000612 /end MEASUREMENT
/begin MEASUREMENT CoEOM_SwtStgy5.flgWrStEomActv "Switch strategy for triggered valve lift switch / Triggerflag to write the CoEOM_stEomActv values" UBYTE B_TRUE 1 100 0.00 1.00000000000 BIT_MASK 0x1 FORMAT "%13.11" ECU_ADDRESS 0x50000613 /end MEASUREMENT
/begin MEASUREMENT CoEOM_SwtStgy5.flgWrStEomActvTmng "Switch strategy for triggered valve lift switch / Triggerflag to write the CoEOM_stEomActvTmng values" UBYTE B_TRUE 1 100 0.00 1.00000000000 BIT_MASK 0x1 FORMAT "%13.11" ECU_ADDRESS 0x50000614 /end MEASUREMENT
/begin MEASUREMENT CoEOM_SwtStgy5.flgWrStEomTarActr "Switch strategy for triggered valve lift switch / Triggerflag to write the CoEOM_stEomTarActr values" UBYTE B_TRUE 1 100 0.00 1.00000000000 BIT_MASK 0x1 FORMAT "%13.11" ECU_ADDRESS 0x50000615 /end MEASUREMENT
/begin MEASUREMENT CoEOM_SwtStgy5.flgWrStEomTarAirSys "Switch strategy for triggered valve lift switch / Triggerflag to write the CoEOM_stEomTarAirSys values" UBYTE B_TRUE 1 100 0.00 1.00000000000 BIT_MASK 0x1 FORMAT "%13.11" ECU_ADDRESS 0x50000616 /end MEASUREMENT
/begin MEASUREMENT CoEOM_SwtStgy5.flgWrStEomTarHw "Switch strategy for triggered valve lift switch / Triggerflag to write the CoEOM_stEomTarHw values" UBYTE B_TRUE 1 100 0.00 1.00000000000 BIT_MASK 0x1 FORMAT "%13.11" ECU_ADDRESS 0x50000617 /end MEASUREMENT
/begin MEASUREMENT CoEOM_SwtStgy5.flgWrStEomTarInj "Switch strategy for triggered valve lift switch / Triggerflag to write the CoEOM_stEomTarInj values" UBYTE B_TRUE 1 100 0.00 1.00000000000 BIT_MASK 0x1 FORMAT "%13.11" ECU_ADDRESS 0x50000618 /end MEASUREMENT
/begin MEASUREMENT CoEOM_SwtStgy5.flgWrStEomTarLbk "Switch strategy for triggered valve lift switch / Triggerflag to write the CoEOM_stEomTarLbk values" UBYTE B_TRUE 1 100 0.00 1.00000000000 BIT_MASK 0x1 FORMAT "%13.11" ECU_ADDRESS 0x50000619 /end MEASUREMENT
/begin MEASUREMENT CoEOM_SwtStgy5.sm "Switch strategy for triggered valve lift switch / Internal variable to see the verbal state of the switch" UBYTE CoEOM_SwtStgy5_sm_VERB 1 100 0.00 3.00000000000 FORMAT "%13.11" ECU_ADDRESS 0x5000061A /end MEASUREMENT
/begin MEASUREMENT CoEOM_SwtStgy5.stPhaEomShift "Switch strategy for triggered valve lift switch / Internal variable to see the current state of the switch" UBYTE OneToOne 1 100 0.00 255.0 FORMAT "%5.1" ECU_ADDRESS 0x5000061B /end MEASUREMENT
/begin MEASUREMENT CoEOM_SwtStgy5.stTrigAckd "Switch strategy for triggered valve lift switch / Internal variable to see the recieved feedbacks" UWORD OneToOne 1 100 0.00 65535.00 FORMAT "%8.2" ECU_ADDRESS 0x5000061C /end MEASUREMENT
/begin MEASUREMENT CoEOM_SwtStgy5.stTrigActvt "Switch strategy for triggered valve lift switch / Internal variable to see the choosen actuators" UWORD OneToOne 1 100 0.00 65535.00 FORMAT "%8.2" ECU_ADDRESS 0x5000061E /end MEASUREMENT
/begin MEASUREMENT CoEOM_SwtStgy5.tiSwt "Switch strategy for triggered valve lift switch / Time in state" SWORD Time_s 1 100 -327.6800 327.6700 FORMAT "%8.4" ECU_ADDRESS 0x50000620 /end MEASUREMENT
/begin MEASUREMENT CoEOM_tAirMnfldUsThrAdpr "Air temperature upstream throttle." UWORD temp_q0p0234 1 100 0.00 1535.977 FORMAT "%8.3" ECU_ADDRESS 0x60003E6C /end MEASUREMENT
/begin MEASUREMENT CoEOM_tiSwt "Ex-time in the respective condition of the mode of operation change-over." SWORD Time_s 1 100 -327.6800 327.6700 FORMAT "%8.4" ECU_ADDRESS 0x6000040E /end MEASUREMENT
/begin MEASUREMENT CoEOM_tiSwtSWT_I.tiStrd "Time of engine operating mode switch / Sum value" SWORD Time_s 1 100 -327.6800 327.6700 FORMAT "%8.4" ECU_ADDRESS 0x60000410 /end MEASUREMENT
/begin MEASUREMENT CoESS_cntrReIni "counter for state re-initialization" UBYTE OneToOne 1 100 0.00 255.0 FORMAT "%5.1" ECU_ADDRESS 0x60009BAE /end MEASUREMENT
/begin MEASUREMENT CoESS_flgUReq "Flag to indicate blower fan voltage request is set" UBYTE B_TRUE 1 100 0.00 1.00000000000 BIT_MASK 0x1 FORMAT "%13.11" ECU_ADDRESS 0x60009FBF /end MEASUREMENT
/begin MEASUREMENT CoESS_nMinAltIdleUp "Minimum alternator idle up speed request" SWORD EngN 1 100 -16384.00 16383.50 FORMAT "%8.2" ECU_ADDRESS 0x60003E6A /end MEASUREMENT
/begin MEASUREMENT CoESS_stAlt "Engage request to alternator from Mechanical Energy Coordinator" UBYTE OneToOne 1 100 0.00 255.0 FORMAT "%5.1" ECU_ADDRESS 0x6000E402 /end MEASUREMENT
/begin MEASUREMENT CoESS_uBlowrUMinReq "Blower fan minimum voltage request" SWORD Volt_Batt 1 100 -655360.0 655340.0 FORMAT "%8.1" ECU_ADDRESS 0x60004B50 /end MEASUREMENT
/begin MEASUREMENT CoESS_uBlowrUUnRampUnfild "Blower fan unfiltered unramped volatge" SWORD Volt_Batt 1 100 -655360.0 655340.0 FORMAT "%8.1" ECU_ADDRESS 0x60004B4E /end MEASUREMENT
/begin MEASUREMENT CoESS_uFuPmpMinReq "Fuel pump minimum voltage request" SWORD Volt_Batt 1 100 -655360.0 655340.0 FORMAT "%8.1" ECU_ADDRESS 0x60004B4C /end MEASUREMENT
/begin MEASUREMENT CoESS_uMinReq "minimum supply voltage for IGC" SWORD Volt_Batt 1 100 -655360.0 655340.0 FORMAT "%8.1" ECU_ADDRESS 0x60004B4A /end MEASUREMENT
/begin MEASUREMENT CoESS_uSlopRampVal "Ramp slope value for blower fan minimum voltage request" SWORD RmpVoltBatt 1 100 -10000.00 9999.69 FORMAT "%8.2" ECU_ADDRESS 0x60004B48 /end MEASUREMENT
/begin MEASUREMENT CoETM_flgAftRun_mp "Status of Afterrun" UBYTE B_TRUE 1 100 0.00 1.00000000000 BIT_MASK 0x1 FORMAT "%13.11" ECU_ADDRESS 0x70009244 /end MEASUREMENT
/begin MEASUREMENT CoETM_rClgDemLim_mp "Necessary cooling requirement through engine fan" SWORD Prc 1 100 -400.0000 399.9878 FORMAT "%8.4" ECU_ADDRESS 0x70009242 /end MEASUREMENT
/begin MEASUREMENT CoETM_rClgIntegLim_mp "limited integral part for ETM_rClgDem" SWORD Prc 1 100 -400.0000 399.9878 FORMAT "%8.4" ECU_ADDRESS 0x70009240 /end MEASUREMENT
/begin MEASUREMENT CoETM_rClgProp_mp "proportional part of ETM_rClgDem" SWORD Prc 1 100 -400.0000 399.9878 FORMAT "%8.4" ECU_ADDRESS 0x7000923E /end MEASUREMENT
/begin MEASUREMENT CoETM_tClntEngOut_mp "Coolant temperature at engine outlet" SWORD Temp_Cels 1 100 -3549.940 3003.560 FORMAT "%8.3" ECU_ADDRESS 0x7000923C /end MEASUREMENT
/begin MEASUREMENT CoETM_tDvt_mp "deviation coolant temp." SWORD TempDiff_Kelv 1 100 -3276.800 3276.700 FORMAT "%8.3" ECU_ADDRESS 0x7000923A /end MEASUREMENT
/begin MEASUREMENT CoETM_tEngOutOff_mp "coolant temperature at engine outlet after engine stop" SWORD Temp_Cels 1 100 -3549.940 3003.560 FORMAT "%8.3" ECU_ADDRESS 0x70009238 /end MEASUREMENT
/begin MEASUREMENT CoETM_tiClgAftRun2_mp "second after run time" SWORD Time_s 1 100 0.00 327.6700 FORMAT "%8.4" ECU_ADDRESS 0x70009236 /end MEASUREMENT
/begin MEASUREMENT CoETM_tiClgAftRunMax2_mp "max. remain after run time to calculate second after run time" SWORD Time_s 1 100 0.00 327.6700 FORMAT "%8.4" ECU_ADDRESS 0x70009234 /end MEASUREMENT
/begin MEASUREMENT CoETM_tiClgAftRunOpt_mp "Optional after-run time" SWORD Time_s 1 100 0.00 327.6700 FORMAT "%8.4" ECU_ADDRESS 0x70009232 /end MEASUREMENT
/begin MEASUREMENT CoETM_tiClgAftRun_mp "time to require an rel. cooling power during after run" SWORD Time_s 1 100 0.00 327.6700 FORMAT "%8.4" ECU_ADDRESS 0x70009230 /end MEASUREMENT
/begin MEASUREMENT CoETS_bDecrIntvLead "Decreasing torque intervention on lead path active" UBYTE B_TRUE 1 100 0.00 1.00000000000 BIT_MASK 0x1 FORMAT "%13.11" ECU_ADDRESS 0x70000305 /end MEASUREMENT
/begin MEASUREMENT CoETS_bEngLimActvLead "Engine limitation on lead-path active" UBYTE B_TRUE 1 100 0.00 1.00000000000 BIT_MASK 0x1 FORMAT "%13.11" ECU_ADDRESS 0x6000A7CE /end MEASUREMENT
/begin MEASUREMENT CoETS_bFltDemLead "Demand for torque filtering in lead path" UBYTE B_TRUE 1 100 0.00 1.00000000000 BIT_MASK 0x1 FORMAT "%13.11" ECU_ADDRESS 0x6000A7CD /end MEASUREMENT
/begin MEASUREMENT CoETS_bFltDemSet "Demand for torque filtering in set path" UBYTE B_TRUE 1 100 0.00 1.00000000000 BIT_MASK 0x1 FORMAT "%13.11" ECU_ADDRESS 0x6000A7CC /end MEASUREMENT
/begin MEASUREMENT CoETS_bFltIntvEnd "Filtering by ASDrf of the end of the torque intervention demanded." UBYTE B_TRUE 1 100 0.00 1.00000000000 BIT_MASK 0x1 FORMAT "%13.11" ECU_ADDRESS 0x70000304 /end MEASUREMENT
/begin MEASUREMENT CoETS_bIncrIntvLead "Increasing torque intervention on lead path active" UBYTE B_TRUE 1 100 0.00 1.00000000000 BIT_MASK 0x1 FORMAT "%13.11" ECU_ADDRESS 0x70000303 /end MEASUREMENT
/begin MEASUREMENT CoETS_bIntvActvDes "Torque intervention on set path" UBYTE B_TRUE 1 100 0.00 1.00000000000 BIT_MASK 0x1 FORMAT "%13.11" ECU_ADDRESS 0x6000A7CB /end MEASUREMENT
/begin MEASUREMENT CoETS_bIntvActvLead "Torque intervention on lead path active" UBYTE B_TRUE 1 100 0.00 1.00000000000 BIT_MASK 0x1 FORMAT "%13.11" ECU_ADDRESS 0x700008DD /end MEASUREMENT
/begin MEASUREMENT CoETS_bTraIntvActv "Status transmission intervention active." UBYTE B_TRUE 1 100 0.00 1.00000000000 BIT_MASK 0x1 FORMAT "%13.11" ECU_ADDRESS 0x6000A7CA /end MEASUREMENT
/begin MEASUREMENT CoETS_rTrq "Calculated load value" SWORD Prc 1 100 0.00 399.9878 FORMAT "%8.4" ECU_ADDRESS 0x6000521A /end MEASUREMENT
/begin MEASUREMENT CoETS_trqInrCurrLim "current lowest limitation torque (inner engine torque)" SWORD Trq 1 100 0.00 3276.700 FORMAT "%8.3" ECU_ADDRESS 0x6000E140 /end MEASUREMENT
/begin MEASUREMENT CoETS_trqInrLeadCo "Torque demand for lead path with engine sided coordination" SWORD Trq 1 100 0.00 3276.700 FORMAT "%8.3" ECU_ADDRESS 0x6000E146 /end MEASUREMENT
/begin MEASUREMENT CoETS_trqInrLeadWoCo "Torque demand for lead path without coordination" SWORD Trq 1 100 0.00 3276.700 FORMAT "%8.3" ECU_ADDRESS 0x6000E148 /end MEASUREMENT
/begin MEASUREMENT CoETS_trqInrLimLead "Coordinated limitation of lead path" SWORD Trq 1 100 0.00 3276.700 FORMAT "%8.3" ECU_ADDRESS 0x500059F4 /end MEASUREMENT
/begin MEASUREMENT CoETS_trqInrLimSet "Limitation torque without the part of the speed governor" SWORD Trq 1 100 0.00 3276.700 FORMAT "%8.3" ECU_ADDRESS 0x6000E14A /end MEASUREMENT
/begin MEASUREMENT CoETS_trqInrSetCo "Coordinated torque demand for set path" SWORD Trq 1 100 0.00 3276.700 FORMAT "%8.3" ECU_ADDRESS 0x500059F8 /end MEASUREMENT
/begin MEASUREMENT CoETS_trqInrSetWoCo "Torque demand for set path without coordination" SWORD Trq 1 100 0.00 3276.700 FORMAT "%8.3" ECU_ADDRESS 0x6000E14C /end MEASUREMENT
/begin MEASUREMENT CoETS_trqInrTgtCo "Coordinated target torque for set path" SWORD Trq 1 100 0.00 3276.700 FORMAT "%8.3" ECU_ADDRESS 0x60005216 /end MEASUREMENT
/begin MEASUREMENT CoETS_trqInrTgtWoCo "Target torque for set path without coordination" SWORD Trq 1 100 0.00 3276.700 FORMAT "%8.3" ECU_ADDRESS 0x60005214 /end MEASUREMENT
/begin MEASUREMENT CoETS_trqInrVehLimMin_mp "coordinated limitation torque of vehicle functions (inner torque)" SWORD Trq 1 100 0.00 3276.700 FORMAT "%8.3" ECU_ADDRESS 0x7000922E /end MEASUREMENT
/begin MEASUREMENT CoETS_trqLimLead "Coordinated limitation on lead path" SWORD Trq 1 100 0.00 3276.700 FORMAT "%8.3" ECU_ADDRESS 0x6000E14E /end MEASUREMENT
/begin MEASUREMENT CoME_flgAcc "Status: acceleration" UBYTE B_TRUE 1 100 0.00 1.00000000000 BIT_MASK 0x1 FORMAT "%13.11" ECU_ADDRESS 0x6000A201 /end MEASUREMENT
/begin MEASUREMENT CoME_flgAccMax "AC status: maximum time off in case of acceleration" UBYTE B_TRUE 1 100 0.00 1.00000000000 BIT_MASK 0x1 FORMAT "%13.11" ECU_ADDRESS 0x6000A200 /end MEASUREMENT
/begin MEASUREMENT CoME_flgAccMin "AC status: minimal time off in case of acceleration" UBYTE B_TRUE 1 100 0.00 1.00000000000 BIT_MASK 0x1 FORMAT "%13.11" ECU_ADDRESS 0x6000A1FF /end MEASUREMENT
/begin MEASUREMENT CoME_flgAccTmr "status: acceleration after timer" UBYTE B_TRUE 1 100 0.00 1.00000000000 BIT_MASK 0x1 FORMAT "%13.11" ECU_ADDRESS 0x6000A1FE /end MEASUREMENT
/begin MEASUREMENT CoME_flgBattVltg "status: low battery voltage" UBYTE B_TRUE 1 100 0.00 1.00000000000 BIT_MASK 0x1 FORMAT "%13.11" ECU_ADDRESS 0x6000A1FD /end MEASUREMENT
/begin MEASUREMENT CoME_flgBattVltgTmr "status: low battery voltage after timer" UBYTE B_TRUE 1 100 0.00 1.00000000000 BIT_MASK 0x1 FORMAT "%13.11" ECU_ADDRESS 0x6000A1FC /end MEASUREMENT
/begin MEASUREMENT CoME_flgDrvOff "status: drive off" UBYTE B_TRUE 1 100 0.00 1.00000000000 BIT_MASK 0x1 FORMAT "%13.11" ECU_ADDRESS 0x6000A1FB /end MEASUREMENT
/begin MEASUREMENT CoME_flgDrvOffMax "AC status: maximal time off in case of drive off" UBYTE B_TRUE 1 100 0.00 1.00000000000 BIT_MASK 0x1 FORMAT "%13.11" ECU_ADDRESS 0x6000A1FA /end MEASUREMENT
/begin MEASUREMENT CoME_flgDrvOffMin "AC status: minimum time off in case of drive off" UBYTE B_TRUE 1 100 0.00 1.00000000000 BIT_MASK 0x1 FORMAT "%13.11" ECU_ADDRESS 0x6000A1F9 /end MEASUREMENT
/begin MEASUREMENT CoME_flgDrvOffTmr "status: drive off after timer" UBYTE B_TRUE 1 100 0.00 1.00000000000 BIT_MASK 0x1 FORMAT "%13.11" ECU_ADDRESS 0x6000A1F8 /end MEASUREMENT
/begin MEASUREMENT CoME_flgDrvTmr "Status: Drive Timer" UBYTE B_TRUE 1 100 0.00 1.00000000000 BIT_MASK 0x1 FORMAT "%13.11" ECU_ADDRESS 0x6000A1F7 /end MEASUREMENT
/begin MEASUREMENT CoME_flgOffAcc "Reset: Acc" UBYTE B_TRUE 1 100 0.00 1.00000000000 BIT_MASK 0x1 FORMAT "%13.11" ECU_ADDRESS 0x6000A1F6 /end MEASUREMENT
/begin MEASUREMENT CoME_flgOffDrvOff "Reset: Drive Off" UBYTE B_TRUE 1 100 0.00 1.00000000000 BIT_MASK 0x1 FORMAT "%13.11" ECU_ADDRESS 0x6000A1F5 /end MEASUREMENT
/begin MEASUREMENT CoME_flgStop "Vehicle state STOP (Stopping or Auto Stopping)" UBYTE B_TRUE 1 100 0.00 1.00000000000 BIT_MASK 0x1 FORMAT "%13.11" ECU_ADDRESS 0x6000A1F4 /end MEASUREMENT
/begin MEASUREMENT CoME_flgStrt "status: start" UBYTE B_TRUE 1 100 0.00 1.00000000000 BIT_MASK 0x1 FORMAT "%13.11" ECU_ADDRESS 0x6000A1F3 /end MEASUREMENT
/begin MEASUREMENT CoME_flgStrtTmrAC "status: engine start after timer" UBYTE B_TRUE 1 100 0.00 1.00000000000 BIT_MASK 0x1 FORMAT "%13.11" ECU_ADDRESS 0x6000A1F2 /end MEASUREMENT
/begin MEASUREMENT CoME_nMax "Maximum engine speed limit of accessories" SWORD EngN 1 100 -16384.00 16383.50 FORMAT "%8.2" ECU_ADDRESS 0x6000520E /end MEASUREMENT
/begin MEASUREMENT CoME_nMin "Minimum low-idle speed requirement of accessories" SWORD EngN 1 100 -16384.00 16383.50 FORMAT "%8.2" ECU_ADDRESS 0x6000520C /end MEASUREMENT
/begin MEASUREMENT CoME_nMinTemp "The maximum of unfiltered and Tip in behaviour speed demand" SWORD EngN 1 100 -16384.00 16383.50 FORMAT "%8.2" ECU_ADDRESS 0x60003E68 /end MEASUREMENT
/begin MEASUREMENT CoME_nMinTipIn "The current minimal speed demand for Tip in behaviour" SWORD EngN 1 100 -16384.00 16383.50 FORMAT "%8.2" ECU_ADDRESS 0x60003E66 /end MEASUREMENT
/begin MEASUREMENT CoME_nMinUnFlt "The current minimal unfiltered speed demand" SWORD EngN 1 100 -16384.00 16383.50 FORMAT "%8.2" ECU_ADDRESS 0x60003E64 /end MEASUREMENT
/begin MEASUREMENT CoME_stNSetP "Status: Nature of low-idle speed increase" UBYTE OneToOne 1 100 0.00 255.0 FORMAT "%5.1" ECU_ADDRESS 0x6000A672 /end MEASUREMENT
/begin MEASUREMENT CoME_tiMaxOffAcc "Maximal shutoff time by ACC" SWORD Time_s 1 100 -327.6800 327.6700 FORMAT "%8.4" ECU_ADDRESS 0x6000520A /end MEASUREMENT
/begin MEASUREMENT CoME_tiMaxOffDrvOff "Maximal shutoff time by Drive off" SWORD Time_s 1 100 -327.6800 327.6700 FORMAT "%8.4" ECU_ADDRESS 0x60005208 /end MEASUREMENT
/begin MEASUREMENT CoME_tiMinOffAcc "Minimal shutoff time by ACC" SWORD Time_s 1 100 -327.6800 327.6700 FORMAT "%8.4" ECU_ADDRESS 0x60005206 /end MEASUREMENT
/begin MEASUREMENT CoME_tiMinOffDrvOff "Minimal shutoff time by Drive Off" SWORD Time_s 1 100 -327.6800 327.6700 FORMAT "%8.4" ECU_ADDRESS 0x60005204 /end MEASUREMENT
/begin MEASUREMENT CoME_tqAcsy "Accessories torque request from thermal system, electrical system and hydrualic power steering" SWORD Trq 1 100 -3276.800 3276.700 FORMAT "%8.3" ECU_ADDRESS 0x60003E62 /end MEASUREMENT
/begin MEASUREMENT CoME_trqDesComp "Application parameter for Torque demand of mechanical co-ordinator" SWORD Trq 1 100 -3276.800 3276.700 FORMAT "%8.3" ECU_ADDRESS 0x60005202 /end MEASUREMENT
/begin MEASUREMENT CoME_trqResv "Reserve torque demand of mechanical co-ordinator" SWORD Trq 1 100 -3276.800 3276.700 FORMAT "%8.3" ECU_ADDRESS 0x60005200 /end MEASUREMENT
/begin MEASUREMENT Com_aLatGA "Lattitude_G information" UWORD Com_aLgtG_Compu 1 100 -24.500 3111.446 FORMAT "%8.3" ECU_ADDRESS 0x60004D8C /end MEASUREMENT
/begin MEASUREMENT Com_aLgtG "Vehicle Acceleration information related to Longitudinal_G sensor" UWORD Com_aLgtG_Compu 1 100 -24.500 3111.446 FORMAT "%8.3" ECU_ADDRESS 0x60004D8A /end MEASUREMENT
/begin MEASUREMENT Com_bDeIce "Front de-ice status" UBYTE OneToOne 1 100 0.00 255.0 FORMAT "%5.1" ECU_ADDRESS 0x6000A0EC /end MEASUREMENT
/begin MEASUREMENT Com_bDigMtrUnit "Speed Meter display unit" UBYTE OneToOne 1 100 0.00 255.0 FORMAT "%5.1" ECU_ADDRESS 0x6000A639 /end MEASUREMENT
/begin MEASUREMENT Com_bMicuInfo "MICU information" UBYTE OneToOne 1 100 0.00 255.0 FORMAT "%5.1" ECU_ADDRESS 0x6000A0EB /end MEASUREMENT
/begin MEASUREMENT Com_bReDEFOutCdn "Rear DEF output condition (A/C output)" UBYTE OneToOne 1 100 0.00 255.0 FORMAT "%5.1" ECU_ADDRESS 0x6000A0E6 /end MEASUREMENT
/begin MEASUREMENT Com_bReDEFSwCdn "Rear DEF SW condition" UBYTE OneToOne 1 100 0.00 255.0 FORMAT "%5.1" ECU_ADDRESS 0x6000A0E5 /end MEASUREMENT
/begin MEASUREMENT Com_bRMDRLKCInfo "KC DRL information" UBYTE OneToOne 1 100 0.00 255.0 FORMAT "%5.1" ECU_ADDRESS 0x6000A0EA /end MEASUREMENT
/begin MEASUREMENT Com_bRMHLHiRly "High headlight lighting" UBYTE OneToOne 1 100 0.00 255.0 FORMAT "%5.1" ECU_ADDRESS 0x6000A0E9 /end MEASUREMENT
/begin MEASUREMENT Com_bRMHLLoRly "Low headlight lighting" UBYTE OneToOne 1 100 0.00 255.0 FORMAT "%5.1" ECU_ADDRESS 0x6000A0E8 /end MEASUREMENT
/begin MEASUREMENT Com_bRMILLSml "Small light lighting" UBYTE OneToOne 1 100 0.00 255.0 FORMAT "%5.1" ECU_ADDRESS 0x6000A0E7 /end MEASUREMENT
/begin MEASUREMENT Com_ctCRingBCM1 "Ring Counter for the BCM1 Frame" UBYTE OneToOne 1 100 0.00 255.0 FORMAT "%5.1" ECU_ADDRESS 0x6000075F /end MEASUREMENT
/begin MEASUREMENT Com_ctCRingMETA "Ring counter for META frame" UBYTE OneToOne 1 100 0.00 255.0 FORMAT "%5.1" ECU_ADDRESS 0x6000A607 /end MEASUREMENT
/begin MEASUREMENT Com_ctCRingMETC "Ring counter for frame METC" UBYTE OneToOne 1 100 0.00 255.0 FORMAT "%5.1" ECU_ADDRESS 0x6000A606 /end MEASUREMENT
/begin MEASUREMENT Com_ctCRingMETD "Ring counter for the frame METD" UBYTE OneToOne 1 100 0.00 255.0 FORMAT "%5.1" ECU_ADDRESS 0x6000A605 /end MEASUREMENT
/begin MEASUREMENT Com_ctCRingMETE2 "Ring counter message for METE2 frame" UBYTE OneToOne 1 100 0.00 255.0 FORMAT "%5.1" ECU_ADDRESS 0x6000A604 /end MEASUREMENT
/begin MEASUREMENT Com_ctCRingMETF "" UBYTE OneToOne 1 100 0.00 255.0 FORMAT "%5.1" ECU_ADDRESS 0x6000A603 /end MEASUREMENT
/begin MEASUREMENT Com_ctCRingMETG "CAN ring counter for METG frame" UBYTE OneToOne 1 100 0.00 255.0 FORMAT "%5.1" ECU_ADDRESS 0x6000A602 /end MEASUREMENT
/begin MEASUREMENT Com_ctCRingMETH "" UBYTE OneToOne 1 100 0.00 255.0 FORMAT "%5.1" ECU_ADDRESS 0x6000A600 /end MEASUREMENT
/begin MEASUREMENT Com_ctCRingMETH2 "Ring Counter of METH2 Frame" UBYTE OneToOne 1 100 0.00 255.0 FORMAT "%5.1" ECU_ADDRESS 0x6000A601 /end MEASUREMENT
/begin MEASUREMENT Com_ctCRingMETI "Ringcounter value of METI frame" UBYTE OneToOne 1 100 0.00 255.0 FORMAT "%5.1" ECU_ADDRESS 0x6000A0D6 /end MEASUREMENT
/begin MEASUREMENT Com_ctCRingMETK "Ring counter for METK frame" UBYTE OneToOne 1 100 0.00 255.0 FORMAT "%5.1" ECU_ADDRESS 0x6000A0D5 /end MEASUREMENT
/begin MEASUREMENT Com_ctCRingMETL "Ring counter for METL frame" UBYTE OneToOne 1 100 0.00 255.0 FORMAT "%5.1" ECU_ADDRESS 0x6000A5FF /end MEASUREMENT
/begin MEASUREMENT Com_ctCRingMETM "Ringcounter value of METM frame" UBYTE OneToOne 1 100 0.00 255.0 FORMAT "%5.1" ECU_ADDRESS 0x6000A5FE /end MEASUREMENT
/begin MEASUREMENT Com_ctCRingMETN "Ringcounter value of METN frame" UBYTE OneToOne 1 100 0.00 255.0 FORMAT "%5.1" ECU_ADDRESS 0x6000A5FD /end MEASUREMENT
/begin MEASUREMENT Com_ctCRingSRS "Ring counter message for SRS frame." UBYTE OneToOne 1 100 0.00 255.0 FORMAT "%5.1" ECU_ADDRESS 0x70001C35 /end MEASUREMENT
/begin MEASUREMENT Com_ctCRingSRSA "Engine ECU Receive SRSA frame Counter" UBYTE OneToOne 1 100 0.00 255.0 FORMAT "%5.1" ECU_ADDRESS 0x6000A5FB /end MEASUREMENT
/begin MEASUREMENT Com_ctCRingSRSB "Ring counter message for SRSB frame." UBYTE OneToOne 1 100 0.00 255.0 FORMAT "%5.1" ECU_ADDRESS 0x6000A5FA /end MEASUREMENT
/begin MEASUREMENT Com_iACCmprHiByte "Air Conditioner variable capacity compressor control current Higher byte" UBYTE i_q1_mA 1 100 0.00 255.0 FORMAT "%5.1" ECU_ADDRESS 0x6000A5E2 /end MEASUREMENT
/begin MEASUREMENT Com_iACCmprLoByte "Air Conditioner variable capacity compressor control current Lower byte" UBYTE i_q1_mA 1 100 0.00 255.0 FORMAT "%5.1" ECU_ADDRESS 0x6000A5E1 /end MEASUREMENT
/begin MEASUREMENT Com_iEPS1ElecLd "EPS Load Current" SWORD Curr_A 1 100 -327.6800 327.6700 FORMAT "%8.4" ECU_ADDRESS 0x600051BC /end MEASUREMENT
/begin MEASUREMENT Com_lDstMETKRaw "Coverage distance Raw" SLONG OneToOne 1 100 -2147483648.00 2147483647.00 FORMAT "%13.2" ECU_ADDRESS 0x60001C28 /end MEASUREMENT
/begin MEASUREMENT Com_nrActPtcActv "Actual number of activated PTC elements" UBYTE OneToOne 1 100 0.00 255.0 FORMAT "%5.1" ECU_ADDRESS 0x6000A5E0 /end MEASUREMENT
/begin MEASUREMENT Com_numCsumBCM1 "CheckSum for BCM1 Frame" UBYTE OneToOne 1 100 0.00 255.0 FORMAT "%5.1" ECU_ADDRESS 0x60000763 /end MEASUREMENT
/begin MEASUREMENT Com_numCsumMETA "Checksum for META" UBYTE OneToOne 1 100 0.00 255.0 FORMAT "%5.1" ECU_ADDRESS 0x6000A5AB /end MEASUREMENT
/begin MEASUREMENT Com_numCsumMETC "Checksum for frame METC" UBYTE OneToOne 1 100 0.00 255.0 FORMAT "%5.1" ECU_ADDRESS 0x6000A5AA /end MEASUREMENT
/begin MEASUREMENT Com_numCsumMETD "Checksum for METD frame" UBYTE OneToOne 1 100 0.00 255.0 FORMAT "%5.1" ECU_ADDRESS 0x6000A5A9 /end MEASUREMENT
/begin MEASUREMENT Com_numCsumMETE2 "Period for METE2 frame." UBYTE OneToOne 1 100 0.00 255.0 FORMAT "%5.1" ECU_ADDRESS 0x6000A5A8 /end MEASUREMENT
/begin MEASUREMENT Com_numCsumMETF "Checksum message for frame METF" UBYTE OneToOne 1 100 0.00 255.0 FORMAT "%5.1" ECU_ADDRESS 0x6000A5A7 /end MEASUREMENT
/begin MEASUREMENT Com_numCsumMETG "CAN check sum for METG frame" UBYTE OneToOne 1 100 0.00 255.0 FORMAT "%5.1" ECU_ADDRESS 0x6000A5A6 /end MEASUREMENT
/begin MEASUREMENT Com_numCsumMETH "Checksum for METH frame." UBYTE OneToOne 1 100 0.00 255.0 FORMAT "%5.1" ECU_ADDRESS 0x6000A5A4 /end MEASUREMENT
/begin MEASUREMENT Com_numCsumMETH2 "Checksum of METH2 Frame" UBYTE OneToOne 1 100 0.00 255.0 FORMAT "%5.1" ECU_ADDRESS 0x6000A5A5 /end MEASUREMENT
/begin MEASUREMENT Com_numCsumMETI "Checksum value of METI frame" UBYTE OneToOne 1 100 0.00 255.0 FORMAT "%5.1" ECU_ADDRESS 0x6000A0AB /end MEASUREMENT
/begin MEASUREMENT Com_numCsumMETK "Checksum for METK" UBYTE OneToOne 1 100 0.00 255.0 FORMAT "%5.1" ECU_ADDRESS 0x6000A0AA /end MEASUREMENT
/begin MEASUREMENT Com_numCsumMETL "Checksum for METL" UBYTE OneToOne 1 100 0.00 255.0 FORMAT "%5.1" ECU_ADDRESS 0x6000A5A3 /end MEASUREMENT
/begin MEASUREMENT Com_numCsumMETM "Checksum value of METM frame" UBYTE OneToOne 1 100 0.00 255.0 FORMAT "%5.1" ECU_ADDRESS 0x6000A5A2 /end MEASUREMENT
/begin MEASUREMENT Com_numCsumMETN "Checksum value of METN frame" UBYTE OneToOne 1 100 0.00 255.0 FORMAT "%5.1" ECU_ADDRESS 0x6000A5A1 /end MEASUREMENT
/begin MEASUREMENT Com_numCsumSRS "Checksum message for SRS frame." UBYTE OneToOne 1 100 0.00 255.0 FORMAT "%5.1" ECU_ADDRESS 0x70001C30 /end MEASUREMENT
/begin MEASUREMENT Com_numCsumSRSA "Engine ECU Receive SRSA frame Check sum" UBYTE OneToOne 1 100 0.00 255.0 FORMAT "%5.1" ECU_ADDRESS 0x6000A59F /end MEASUREMENT
/begin MEASUREMENT Com_numCsumSRSB "Checksum message for SRSB frame." UBYTE OneToOne 1 100 0.00 255.0 FORMAT "%5.1" ECU_ADDRESS 0x6000A59E /end MEASUREMENT
/begin MEASUREMENT Com_nYaw1UpprData "YAW1 Upper Data" UWORD YawRate_q0p2441_om125 1 100 -125.00 15874.76 FORMAT "%8.2" ECU_ADDRESS 0x60004D72 /end MEASUREMENT
/begin MEASUREMENT Com_rAPPENGA "The acceleration pedal position for frame ENGA" SWORD Prc 1 100 -400.0000 399.9878 FORMAT "%8.4" ECU_ADDRESS 0x6000519C /end MEASUREMENT
/begin MEASUREMENT Com_rAPPENGT "Selection of accelerator pedal position for CAN tranmission(ENGT Frame)" SWORD Prc 1 100 -400.0000 399.9878 FORMAT "%8.4" ECU_ADDRESS 0x6000519A /end MEASUREMENT
/begin MEASUREMENT Com_rASLCCENGT "message for Accelerator pedal position value depending on ASL and CC" SWORD Prc 1 100 -400.0000 399.9878 FORMAT "%8.4" ECU_ADDRESS 0x60005198 /end MEASUREMENT
/begin MEASUREMENT Com_rVirtAPP "Accelerator pedal position (PT demand)" SWORD Prc 1 100 -400.0000 399.9878 FORMAT "%8.4" ECU_ADDRESS 0x6000518C /end MEASUREMENT
/begin MEASUREMENT Com_stAbnormCpu "Information about failure determines in CPU(microcomputer)" UBYTE OneToOne 1 100 0.00 255.0 FORMAT "%5.1" ECU_ADDRESS 0x6000A577 /end MEASUREMENT
/begin MEASUREMENT Com_stAbnormVcc "Information about Abnormal Supply voltage(IG) of Longitudinal_G sensor" UBYTE OneToOne 1 100 0.00 255.0 FORMAT "%5.1" ECU_ADDRESS 0x6000A576 /end MEASUREMENT
/begin MEASUREMENT Com_stAC "Air Conditioner(AC) State" UBYTE OneToOne 1 100 0.00 255.0 FORMAT "%5.1" ECU_ADDRESS 0x6000A591 /end MEASUREMENT
/begin MEASUREMENT Com_stACCActv "IDAS ACC active status" UBYTE OneToOne 1 100 0.00 255.0 FORMAT "%5.1" ECU_ADDRESS 0x6000A58F /end MEASUREMENT
/begin MEASUREMENT Com_stACCut "Permission of Air Conditioner Cut" UBYTE OneToOne 1 100 0.00 255.0 FORMAT "%5.1" ECU_ADDRESS 0x6000A589 /end MEASUREMENT
/begin MEASUREMENT Com_stACFailInfo "Alternating current failure status" UBYTE OneToOne 1 100 0.00 255.0 FORMAT "%5.1" ECU_ADDRESS 0x6000A0A8 /end MEASUREMENT
/begin MEASUREMENT Com_stACGUpReq "Status of ACG power generation request (14.5V fixed demand) from AC" UBYTE OneToOne 1 100 0.00 255.0 FORMAT "%5.1" ECU_ADDRESS 0x6000A588 /end MEASUREMENT
/begin MEASUREMENT Com_stAcInfo "A/C info" UBYTE OneToOne 1 100 0.00 255.0 FORMAT "%5.1" ECU_ADDRESS 0x6000A0A5 /end MEASUREMENT
/begin MEASUREMENT Com_stACISSInhbReqRes "request to inhibit stop engine" UBYTE OneToOne 1 100 0.00 255.0 FORMAT "%5.1" ECU_ADDRESS 0x6000A587 /end MEASUREMENT
/begin MEASUREMENT Com_stACMETG "Ac Status in METG Frame" UBYTE OneToOne 1 100 0.00 255.0 FORMAT "%5.1" ECU_ADDRESS 0x6000A586 /end MEASUREMENT
/begin MEASUREMENT Com_stAirCdnr "Message from air conditioner" UBYTE OneToOne 1 100 0.00 255.0 FORMAT "%5.1" ECU_ADDRESS 0x6000A573 /end MEASUREMENT
/begin MEASUREMENT Com_stAPPFailrDetInfo "status of Accel pedal position sensor failure confirmed" UBYTE B_TRUE 1 100 0.00 1.00000000000 BIT_MASK 0x1 FORMAT "%13.11" ECU_ADDRESS 0x60009FBC /end MEASUREMENT
/begin MEASUREMENT Com_stAPPNormDetInfo "status of Accel pedal position sensor normal confirmed" UBYTE B_TRUE 1 100 0.00 1.00000000000 BIT_MASK 0x1 FORMAT "%13.11" ECU_ADDRESS 0x60009FBB /end MEASUREMENT
/begin MEASUREMENT Com_stAPPSensFail "Status message to indicate Accelerator Pedal Sensor failure" UBYTE OneToOne 1 100 0.00 255.0 FORMAT "%5.1" ECU_ADDRESS 0x6000A584 /end MEASUREMENT
/begin MEASUREMENT Com_stATMILReq "MIL request recieved from ACC ECU" UBYTE OneToOne 1 100 0.00 255.0 BIT_MASK 0x1 FORMAT "%5.1" ECU_ADDRESS 0x6000A1AE /end MEASUREMENT
/begin MEASUREMENT Com_stBattOTAReq "Status of OTA operation" UBYTE OneToOne 1 100 0.00 255.0 FORMAT "%5.1" ECU_ADDRESS 0x6000A569 /end MEASUREMENT
/begin MEASUREMENT Com_stBCANInfo "status of B-CAN information" UBYTE OneToOne 1 100 0.00 255.0 FORMAT "%5.1" ECU_ADDRESS 0x6000A0A4 /end MEASUREMENT
/begin MEASUREMENT Com_stBCANReprogm "status of BCAN reprogramming" UBYTE OneToOne 1 100 0.00 255.0 FORMAT "%5.1" ECU_ADDRESS 0x6000A1AD /end MEASUREMENT
/begin MEASUREMENT Com_stCalCmplLatG "Lateral_G calibration complete" UBYTE OneToOne 1 100 0.00 255.0 FORMAT "%5.1" ECU_ADDRESS 0x6000A55E /end MEASUREMENT
/begin MEASUREMENT Com_stCalCmplLgtG "Information about Calibration complete of Longitudinal_G sensor" UBYTE OneToOne 1 100 0.00 255.0 FORMAT "%5.1" ECU_ADDRESS 0x6000A55D /end MEASUREMENT
/begin MEASUREMENT Com_stCANANoBusOff "F1-CAN Bus Off Error status" UBYTE OneToOne 1 100 0.00 255.0 FORMAT "%5.1" ECU_ADDRESS 0x6000A566 /end MEASUREMENT
/begin MEASUREMENT Com_stCANBNoBusOff "CAN_B Bussoff status." UBYTE OneToOne 1 100 0.00 255.0 FORMAT "%5.1" ECU_ADDRESS 0x6000A565 /end MEASUREMENT
/begin MEASUREMENT Com_stCANCNoBusOff "P CAN Bus Off error status" UBYTE OneToOne 1 100 0.00 255.0 FORMAT "%5.1" ECU_ADDRESS 0x6000A564 /end MEASUREMENT
/begin MEASUREMENT Com_stCfmdPPosn "Confirmed Park-Position" UBYTE OneToOne 1 100 0.00 255.0 FORMAT "%5.1" ECU_ADDRESS 0x6000A557 /end MEASUREMENT
/begin MEASUREMENT Com_stCllsnDetn "Collision detection functionality" UBYTE OneToOne 1 100 0.00 255.0 FORMAT "%5.1" ECU_ADDRESS 0x6000A553 /end MEASUREMENT
/begin MEASUREMENT Com_stCombUnitFailInfo "Status of COMB unit fail information from B-CAN" UBYTE OneToOne 1 100 0.00 255.0 FORMAT "%5.1" ECU_ADDRESS 0x6000A09E /end MEASUREMENT
/begin MEASUREMENT Com_stComVSA "Inhibit error information from VSA" UBYTE OneToOne 1 100 0.00 255.0 FORMAT "%5.1" ECU_ADDRESS 0x6000A54F /end MEASUREMENT
/begin MEASUREMENT Com_stDstMETK "Status of total meter distance" UBYTE OneToOne 1 100 0.00 255.0 FORMAT "%5.1" ECU_ADDRESS 0x6000A09B /end MEASUREMENT
/begin MEASUREMENT Com_stECON "Status of ECON lamp" UBYTE OneToOne 1 100 0.00 255.0 FORMAT "%5.1" ECU_ADDRESS 0x6000A537 /end MEASUREMENT
/begin MEASUREMENT Com_stEngHoodOpn "Engine Hood status" UBYTE OneToOne 1 100 0.00 255.0 FORMAT "%5.1" ECU_ADDRESS 0x6000A524 /end MEASUREMENT
/begin MEASUREMENT Com_stEngRun "Engine run status" UBYTE OneToOne 1 100 0.00 255.0 FORMAT "%5.1" ECU_ADDRESS 0x6000A520 /end MEASUREMENT
/begin MEASUREMENT Com_stEnvT "Error status of environmental temperature" UBYTE OneToOne 1 100 0.00 255.0 FORMAT "%5.1" ECU_ADDRESS 0x6000A51C /end MEASUREMENT
/begin MEASUREMENT Com_stEthnlSErr "status of Ethanol sensor error" UBYTE OneToOne 1 100 0.00 255.0 FORMAT "%5.1" ECU_ADDRESS 0x6000A51A /end MEASUREMENT
/begin MEASUREMENT Com_stEwpErr "EWP error state via CAN" UBYTE OneToOne 1 100 0.00 255.0 FORMAT "%5.1" ECU_ADDRESS 0x6000A519 /end MEASUREMENT
/begin MEASUREMENT Com_stFailrLatG "Lateral_G failure" UBYTE OneToOne 1 100 0.00 255.0 FORMAT "%5.1" ECU_ADDRESS 0x6000A516 /end MEASUREMENT
/begin MEASUREMENT Com_stFailrLgtG "Information about failure of Longitudinal_G sensor" UBYTE OneToOne 1 100 0.00 255.0 FORMAT "%5.1" ECU_ADDRESS 0x6000A515 /end MEASUREMENT
/begin MEASUREMENT Com_stFrmRxEna "Receive Frame enable switch" UBYTE OneToOne 1 100 0.00 255.0 FORMAT "%5.1" ARRAY_SIZE 6 ECU_ADDRESS 0x6000A50F /end MEASUREMENT
/begin MEASUREMENT Com_stFrmTxEna "enable status of transmit frames" UBYTE OneToOne 1 100 0.00 255.0 FORMAT "%5.1" ARRAY_SIZE 6 ECU_ADDRESS 0x6000A509 /end MEASUREMENT
/begin MEASUREMENT Com_stFrntDfrstSwtInfoRes "front side defroster switch status" UBYTE OneToOne 1 100 0.00 255.0 FORMAT "%5.1" ECU_ADDRESS 0x6000A508 /end MEASUREMENT
/begin MEASUREMENT Com_stFrtFog "Meter Front Fog Status" UBYTE OneToOne 1 100 0.00 255.0 FORMAT "%5.1" ECU_ADDRESS 0x6000A507 /end MEASUREMENT
/begin MEASUREMENT Com_stFuCtrlReq "Fuel control request signal" UBYTE OneToOne 1 100 0.00 255.0 FORMAT "%5.1" ECU_ADDRESS 0x6000A77B /end MEASUREMENT
/begin MEASUREMENT Com_stICUHoodErr "ICU Hood Communication status" UBYTE OneToOne 1 100 0.00 255.0 FORMAT "%5.1" ECU_ADDRESS 0x6000A4FD /end MEASUREMENT
/begin MEASUREMENT Com_stIDASShftReq "Shift down request from IDAS" UBYTE OneToOne 1 100 0.00 255.0 FORMAT "%5.1" ECU_ADDRESS 0x6000A4FA /end MEASUREMENT
/begin MEASUREMENT Com_stIDASTrqLowSel "Status of ASL control." UBYTE OneToOne 1 100 0.00 255.0 FORMAT "%5.1" ECU_ADDRESS 0x6000A4F9 /end MEASUREMENT
/begin MEASUREMENT Com_stISABAct "ISAB operation status" UBYTE OneToOne 1 100 0.00 255.0 FORMAT "%5.1" ECU_ADDRESS 0x6000A4F0 /end MEASUREMENT
/begin MEASUREMENT Com_stISABEna "ISAB permission status" UBYTE OneToOne 1 100 0.00 255.0 FORMAT "%5.1" ECU_ADDRESS 0x6000A4EF /end MEASUREMENT
/begin MEASUREMENT Com_stISSInhbnSwt "Status of ISS ( Idle start/stop) inhibition switch received over CAN" UBYTE OneToOne 1 100 0.00 255.0 FORMAT "%5.1" ECU_ADDRESS 0x6000A4EC /end MEASUREMENT
/begin MEASUREMENT Com_stLiSwtInfo "status of light switch information for MET2 frame" UBYTE OneToOne 1 100 0.00 255.0 FORMAT "%5.1" ECU_ADDRESS 0x6000A4E4 /end MEASUREMENT
/begin MEASUREMENT Com_stMETE2ACISSInhbReq "Idle stop inhibition flag" UBYTE OneToOne 1 100 0.00 255.0 FORMAT "%5.1" ECU_ADDRESS 0x6000A4DE /end MEASUREMENT
/begin MEASUREMENT Com_stMETE2FrntDfrstSwtInfo "Status of Front Defroster switch information" UBYTE OneToOne 1 100 0.00 255.0 FORMAT "%5.1" ECU_ADDRESS 0x6000A4DD /end MEASUREMENT
/begin MEASUREMENT Com_stMICUInfo "status of MICU information" UBYTE OneToOne 1 100 0.00 255.0 FORMAT "%5.1" ECU_ADDRESS 0x6000A08B /end MEASUREMENT
/begin MEASUREMENT Com_stMon "Interface for enabling the monitoring conditions for CAN Frames" UBYTE OneToOne 1 100 0.00 255.0 FORMAT "%5.1" ECU_ADDRESS 0x6000A4D7 /end MEASUREMENT
/begin MEASUREMENT Com_stMonitor "Status for Eanbling the monitoring condition of CAN Frames" UBYTE OneToOne 1 100 0.00 255.0 FORMAT "%5.1" ECU_ADDRESS 0x6000A4D2 /end MEASUREMENT
/begin MEASUREMENT Com_stMtrCustDftReq "Customizing default demand" UBYTE OneToOne 1 100 0.00 255.0 FORMAT "%5.1" ECU_ADDRESS 0x6000A4D1 /end MEASUREMENT
/begin MEASUREMENT Com_stMtrCustFlg "Customizing function execution flag" UBYTE OneToOne 1 100 0.00 255.0 FORMAT "%5.1" ECU_ADDRESS 0x6000A4D0 /end MEASUREMENT
/begin MEASUREMENT Com_stMtrCustStReq "ECU mapped message for CAN signal METER_CUSTOM_STATUS" UBYTE OneToOne 1 100 0.00 255.0 FORMAT "%5.1" ECU_ADDRESS 0x6000A4CF /end MEASUREMENT
/begin MEASUREMENT Com_stMtrEva "METER_EVA_TEMP" UBYTE OneToOne 1 100 0.00 255.0 FORMAT "%5.1" ECU_ADDRESS 0x6000A4CE /end MEASUREMENT
/begin MEASUREMENT Com_stNotTxDrvgF "TM Free condition" UBYTE OneToOne 1 100 0.00 255.0 FORMAT "%5.1" ECU_ADDRESS 0x6000A4CC /end MEASUREMENT
/begin MEASUREMENT Com_stPrkgBrkSw "parking brake status" UBYTE OneToOne 1 100 0.00 255.0 FORMAT "%5.1" ECU_ADDRESS 0x6000A4C3 /end MEASUREMENT
/begin MEASUREMENT Com_stPrmntErrYaw1 "YAW1 Permanent Error" UBYTE OneToOne 1 100 0.00 255.0 FORMAT "%5.1" ECU_ADDRESS 0x6000A4C2 /end MEASUREMENT
/begin MEASUREMENT Com_stRemEngStrtr "Remote Engine Starter State" UBYTE OneToOne 1 100 0.00 1.000 BIT_MASK 0x1 FORMAT "%5.3" ECU_ADDRESS 0x70000AD9 /end MEASUREMENT
/begin MEASUREMENT Com_stRrFog "Meter Rear Fog Status" UBYTE OneToOne 1 100 0.00 255.0 FORMAT "%5.1" ECU_ADDRESS 0x6000A4C0 /end MEASUREMENT
/begin MEASUREMENT Com_stRstReq "Reset switch data during engine oil change" UBYTE OneToOne 1 100 0.00 255.0 FORMAT "%5.1" ECU_ADDRESS 0x6000A08A /end MEASUREMENT
/begin MEASUREMENT Com_stSeatBltInfo "Driver seat belt information received in SRS frame." UBYTE Com_stSeatBltInfo_COMPU_VERB 1 100 0.00 3.00000000000 FORMAT "%13.11" ECU_ADDRESS 0x60000776 /end MEASUREMENT
/begin MEASUREMENT Com_stSrvModDispReq "Engine Service Mode Information" UBYTE OneToOne 1 100 0.00 255.0 FORMAT "%5.1" ECU_ADDRESS 0x6000A494 /end MEASUREMENT
/begin MEASUREMENT Com_stStaActvReq "Starter Information over CAN" UBYTE OneToOne 1 100 0.00 255.0 BIT_MASK 0x1 FORMAT "%5.1" ECU_ADDRESS 0x6000A1A1 /end MEASUREMENT
/begin MEASUREMENT Com_stStrtupProc "Information about startup process(when the sensor output can not be guaranteed)" UBYTE OneToOne 1 100 0.00 255.0 FORMAT "%5.1" ECU_ADDRESS 0x6000A490 /end MEASUREMENT
/begin MEASUREMENT Com_stSwISInhbSts "Software Switch Status IS Inhibition" UBYTE OneToOne 1 100 0.00 255.0 FORMAT "%5.1" ECU_ADDRESS 0x6000A48F /end MEASUREMENT
/begin MEASUREMENT Com_stTarSpdDisp "Status of CCACC target speed display" UBYTE OneToOne 1 100 0.00 255.0 FORMAT "%5.1" ECU_ADDRESS 0x6000A488 /end MEASUREMENT
/begin MEASUREMENT Com_stTempAbnormLatG "Temporarily abnormal Lateral-G" UBYTE OneToOne 1 100 0.00 255.0 FORMAT "%5.1" ECU_ADDRESS 0x6000A487 /end MEASUREMENT
/begin MEASUREMENT Com_stTempAbnormLgtG "Information about Temporarily abnormal of Longitudinal_G sensor" UBYTE OneToOne 1 100 0.00 255.0 FORMAT "%5.1" ECU_ADDRESS 0x6000A486 /end MEASUREMENT
/begin MEASUREMENT Com_stTmpErrYaw1 "YAW1 Temporary Error" UBYTE OneToOne 1 100 0.00 255.0 FORMAT "%5.1" ECU_ADDRESS 0x6000A484 /end MEASUREMENT
/begin MEASUREMENT Com_stVINWriteClrDone "Clear process done flag" UBYTE OneToOne 1 100 0.00 255.0 FORMAT "%5.1" ECU_ADDRESS 0x6000A47B /end MEASUREMENT
/begin MEASUREMENT Com_stVSAAirPThrUsSnsrErr "Error weight value from Air pressure Throttle Upstream sensor module" UBYTE OneToOne 1 100 0.00 255.0 FORMAT "%5.1" ECU_ADDRESS 0x6000A479 /end MEASUREMENT
/begin MEASUREMENT Com_stVSAAPedlErr "error weight value from Ped module" UBYTE OneToOne 1 100 0.00 255.0 FORMAT "%5.1" ECU_ADDRESS 0x6000A47A /end MEASUREMENT
/begin MEASUREMENT Com_stVSABstCtrlErr "error weight value from clth module" UBYTE OneToOne 1 100 0.00 255.0 FORMAT "%5.1" ECU_ADDRESS 0x6000A478 /end MEASUREMENT
/begin MEASUREMENT Com_stVSADetrmAirMErr "error weight value from Air mass module" UBYTE OneToOne 1 100 0.00 255.0 FORMAT "%5.1" ECU_ADDRESS 0x6000A476 /end MEASUREMENT
/begin MEASUREMENT Com_stVSAECUHwErr "Error weight value from ECU hardware" UBYTE OneToOne 1 100 0.00 255.0 FORMAT "%5.1" ECU_ADDRESS 0x6000A475 /end MEASUREMENT
/begin MEASUREMENT Com_stVSAEngPosngErr "error weight value from Eng posng module" UBYTE OneToOne 1 100 0.00 255.0 FORMAT "%5.1" ECU_ADDRESS 0x6000A474 /end MEASUREMENT
/begin MEASUREMENT Com_stVSAEnvtlAirPSnsrErr "Error weight value from Environmental Air Pressure Sensor module" UBYTE OneToOne 1 100 0.00 255.0 FORMAT "%5.1" ECU_ADDRESS 0x6000A473 /end MEASUREMENT
/begin MEASUREMENT Com_stVSAFlSplyErr "error weight value from fuel supply module" UBYTE OneToOne 1 100 0.00 255.0 FORMAT "%5.1" ECU_ADDRESS 0x6000A472 /end MEASUREMENT
/begin MEASUREMENT Com_stVSAGEVCntrlErr "error weight value from fuel GevCntrl module" UBYTE OneToOne 1 100 0.00 255.0 FORMAT "%5.1" ECU_ADDRESS 0x6000A471 /end MEASUREMENT
/begin MEASUREMENT Com_stVSAHFMSnsrErr "Error weight value from HFM Sensor module" UBYTE OneToOne 1 100 0.00 255.0 FORMAT "%5.1" ECU_ADDRESS 0x6000A470 /end MEASUREMENT
/begin MEASUREMENT Com_stVSAIgnCtrlErr "error weight value from Ign control module" UBYTE OneToOne 1 100 0.00 255.0 FORMAT "%5.1" ECU_ADDRESS 0x6000A46F /end MEASUREMENT
/begin MEASUREMENT Com_stVSAInhbInfo "Sum of all error weight for the VSA module" UBYTE OneToOne 1 100 0.00 255.0 FORMAT "%5.1" ECU_ADDRESS 0x6000A46E /end MEASUREMENT
/begin MEASUREMENT Com_stVSAInjCtrlErr "error weight value from Inj Control module" UBYTE OneToOne 1 100 0.00 255.0 FORMAT "%5.1" ECU_ADDRESS 0x6000A46D /end MEASUREMENT
/begin MEASUREMENT Com_stVSAIntkAirPSnsrErr "Error weight valu from Intake Air Pressure sensor module" UBYTE OneToOne 1 100 0.00 255.0 FORMAT "%5.1" ECU_ADDRESS 0x6000A46C /end MEASUREMENT
/begin MEASUREMENT Com_stVSALamCtrlErr "error weight value from Lam module" UBYTE OneToOne 1 100 0.00 255.0 FORMAT "%5.1" ECU_ADDRESS 0x6000A46B /end MEASUREMENT
/begin MEASUREMENT Com_stVSAMisfErr "error weight value from miss fire module" UBYTE OneToOne 1 100 0.00 255.0 FORMAT "%5.1" ECU_ADDRESS 0x6000A469 /end MEASUREMENT
/begin MEASUREMENT Com_stVSAMonErr "error weight value from monitoring module" UBYTE OneToOne 1 100 0.00 255.0 FORMAT "%5.1" ECU_ADDRESS 0x6000A468 /end MEASUREMENT
/begin MEASUREMENT Com_stVSASumTrqErr "Total Error Weight value for the VSA module." UWORD OneToOne 1 100 0.00 65535.00 FORMAT "%8.2" ECU_ADDRESS 0x60004D62 /end MEASUREMENT
/begin MEASUREMENT Com_stVSAThrVlvErr "error weight value from thr vlv module" UBYTE OneToOne 1 100 0.00 255.0 FORMAT "%5.1" ECU_ADDRESS 0x6000A466 /end MEASUREMENT
/begin MEASUREMENT Com_stVSATrboChrgnErr "Error weight value from Turbo charging module" UBYTE OneToOne 1 100 0.00 255.0 FORMAT "%5.1" ECU_ADDRESS 0x6000A465 /end MEASUREMENT
/begin MEASUREMENT Com_stVSAVehSpdImpsErr "Error weight value from Vehicle speed plausibility check module." UBYTE OneToOne 1 100 0.00 255.0 FORMAT "%5.1" ECU_ADDRESS 0x6000A464 /end MEASUREMENT
/begin MEASUREMENT Com_stVSAVlvLftCtrlErr "error weight value from vlv control module" UBYTE OneToOne 1 100 0.00 255.0 FORMAT "%5.1" ECU_ADDRESS 0x6000A463 /end MEASUREMENT
/begin MEASUREMENT Com_stWiprActvnCdn "Wiper activation condition" UBYTE OneToOne 1 100 0.00 255.0 FORMAT "%5.1" ECU_ADDRESS 0x6000A087 /end MEASUREMENT
/begin MEASUREMENT Com_stWiprMETC "Wiper status in METC Frame." UBYTE OneToOne 1 100 0.00 255.0 FORMAT "%5.1" ECU_ADDRESS 0x6000A45E /end MEASUREMENT
/begin MEASUREMENT Com_swtCANVer "Selected CAN generation (HMC GS)" UWORD OneToOne 1 100 0.00 3.000000 FORMAT "%8.6" ECU_ADDRESS 0x60004D60 /end MEASUREMENT
/begin MEASUREMENT Com_tACAirTOut "METER_AC_Out Air Temperature" UBYTE temp_q0p5_o30_degC 1 100 -30.00 97.50 FORMAT "%5.2" ECU_ADDRESS 0x6000A45C /end MEASUREMENT
/begin MEASUREMENT Com_tACMtrEvaInfo "AC EVA temperature information" UBYTE temp_q0p5_o30_degC 1 100 -30.00 97.50 FORMAT "%5.2" ECU_ADDRESS 0x6000A45B /end MEASUREMENT
/begin MEASUREMENT Com_tAirInsdCbn "Inside Cabin Air Temperature" SWORD Com_EvaTemp_Compu 1 100 -32798. 32737. FORMAT "%2.0" ECU_ADDRESS 0x60005184 /end MEASUREMENT
/begin MEASUREMENT Com_tAirOutside "Outside air temperature." SWORD Temp_Cels 1 100 -3549.940 3003.560 FORMAT "%8.3" ECU_ADDRESS 0x60005182 /end MEASUREMENT
/begin MEASUREMENT Com_tEnvT "Environment air temperature" SWORD Temp_Cels 1 100 -3549.940 3003.560 FORMAT "%8.3" ECU_ADDRESS 0x70002C30 /end MEASUREMENT
/begin MEASUREMENT Com_tiISSPrms "Idle Stop Permission time" UBYTE Time_Second 1 100 0.00 255.0 FORMAT "%5.1" ECU_ADDRESS 0x6000A457 /end MEASUREMENT
/begin MEASUREMENT Com_tMETE2AirOutside "Outside Temperature" SWORD Temp_Cels 1 100 -3549.940 3003.560 FORMAT "%8.3" ECU_ADDRESS 0x60005178 /end MEASUREMENT
/begin MEASUREMENT Com_tMtrEva "The temperature of the evaporator" UBYTE Com_EvaTemp_Compu 1 100 -30. 225. FORMAT "%2.0" ECU_ADDRESS 0x6000A459 /end MEASUREMENT
/begin MEASUREMENT Com_tMtrEvaMETD "Evaporator temperature of AC" UBYTE Com_EvaTemp_Compu 1 100 -30. 225. FORMAT "%2.0" ECU_ADDRESS 0x6000A458 /end MEASUREMENT
/begin MEASUREMENT Com_tOutd "Information of outside indicated temperature" SWORD Temp_Cels 1 100 -3549.940 3003.560 FORMAT "%8.3" ECU_ADDRESS 0x60005176 /end MEASUREMENT
/begin MEASUREMENT Com_tqBrkOper "Brake operation torque (Driver input)" UWORD TrqPerSec 1 100 0.00 65535.00 FORMAT "%8.2" ECU_ADDRESS 0x60004D5C /end MEASUREMENT
/begin MEASUREMENT Com_tqIDASTar "IDAS target torque" SWORD TrqPerSec 1 100 -32768.00 32767.00 FORMAT "%8.2" ECU_ADDRESS 0x60005172 /end MEASUREMENT
/begin MEASUREMENT Com_trq2IDASTar "ASLISA cooperative operation required torque crankshaft torque" SWORD RBPtCel_tq_1p0_1 1 100 -32768.00 32767.00 FORMAT "%8.2" ECU_ADDRESS 0x60005168 /end MEASUREMENT
/begin MEASUREMENT Com_uFlLvlRaw "8 bit A/D Raw value of the fuel level" SWORD spg_uw_b5 1 100 -160.0000 159.9951 FORMAT "%8.4" ECU_ADDRESS 0x6000515A /end MEASUREMENT
/begin MEASUREMENT Com_uFlLvlRawRes "Fuel level staus raw value" SWORD spg_uw_b5 1 100 -160.0000 159.9951 FORMAT "%8.4" ECU_ADDRESS 0x60005158 /end MEASUREMENT
/begin MEASUREMENT Com_uFrntBlowrU "Target front Blower voltage" UBYTE Volt_q1 1 100 0.00 255.0 FORMAT "%5.1" ECU_ADDRESS 0x6000A084 /end MEASUREMENT
/begin MEASUREMENT Com_uMICUTxBlowrU "MICU Tx blower voltage" UBYTE Volt_q1 1 100 0.00 255.0 FORMAT "%5.1" ECU_ADDRESS 0x6000A083 /end MEASUREMENT
/begin MEASUREMENT Com_uRrBlowrU "Target rear Blower voltage" UBYTE Volt_q1 1 100 0.00 255.0 FORMAT "%5.1" ECU_ADDRESS 0x6000A082 /end MEASUREMENT
/begin MEASUREMENT Com_vAnaVeh "Meter display speed" UWORD Vel 1 100 0.00 655.3500 FORMAT "%8.4" ECU_ADDRESS 0x60004D4E /end MEASUREMENT
/begin MEASUREMENT Com_vDigVeh "Digital Speed Meter display target value(Hysteresis processing value for display)" UBYTE OneToOne 1 100 0.00 255.0 FORMAT "%5.1" ECU_ADDRESS 0x6000A456 /end MEASUREMENT
/begin MEASUREMENT Com_vDigVehRaw "Speed Meter display target value(Raw Value)" UWORD Vel 1 100 0.00 655.3500 FORMAT "%8.4" ECU_ADDRESS 0x60004D4C /end MEASUREMENT
/begin MEASUREMENT CoVeh_stAlt "Status: Alternator start-up" UBYTE B_TRUE 1 100 0.00 1.00000000000 BIT_MASK 0x1 FORMAT "%13.11" ECU_ADDRESS 0x6000A1C5 /end MEASUREMENT
/begin MEASUREMENT CoVeh_stFan "Status: Fan start-up" UBYTE B_TRUE 1 100 0.00 1.00000000000 BIT_MASK 0x1 FORMAT "%13.11" ECU_ADDRESS 0x6000A1C4 /end MEASUREMENT
/begin MEASUREMENT CoVeh_trqAcs "Torque demand of accessories" SWORD Trq 1 100 -3276.800 3276.700 FORMAT "%8.3" ECU_ADDRESS 0x500059FE /end MEASUREMENT
/begin MEASUREMENT CoVeh_trqMaxAC "Maximum allowed AC torque consumption" SWORD Trq 1 100 -3276.800 3276.700 FORMAT "%8.3" ECU_ADDRESS 0x600051D2 /end MEASUREMENT
/begin MEASUREMENT dmiagk_w_msg "Torque gradient set point." SWORD rel_q0p003052_pc_DIV_s 1 100 -100.0000 99.9969 FORMAT "%8.4" ECU_ADDRESS 0x6000E2FE /end MEASUREMENT
/begin MEASUREMENT Dspl_stACCASLSwtInfo "ACC / ASL Switch information" UBYTE OneToOne 1 100 0.00 255.0 FORMAT "%5.1" ECU_ADDRESS 0x6000A3C1 /end MEASUREMENT
/begin MEASUREMENT Dspl_stASLRxErr "ASL reception CAN frame error information" UBYTE OneToOne 1 100 0.00 255.0 FORMAT "%5.1" ECU_ADDRESS 0x6000A07D /end MEASUREMENT
/begin MEASUREMENT Dspl_stCrsMaiSwtInfo "Cruise Main Switch information" UBYTE OneToOne 1 100 0.00 255.0 FORMAT "%5.1" ECU_ADDRESS 0x6000A191 /end MEASUREMENT
/begin MEASUREMENT Dspl_stCrsSwtInfo "Cruise Switch Information" UBYTE OneToOne 1 100 0.00 255.0 FORMAT "%5.1" ECU_ADDRESS 0x6000A3BF /end MEASUREMENT
/begin MEASUREMENT ESS_bEngStopEna "stop release electrical supply system" UBYTE B_TRUE 1 100 0.00 1.00000000000 BIT_MASK 0x1 FORMAT "%13.11" ECU_ADDRESS 0x70000810 /end MEASUREMENT
/begin MEASUREMENT ESS_bEngStrtReq "Electrical supply system require motor start" UBYTE B_TRUE 1 100 0.00 1.00000000000 BIT_MASK 0x1 FORMAT "%13.11" ECU_ADDRESS 0x7000080E /end MEASUREMENT
/begin MEASUREMENT ESS_nMax "Max. engine speed request from Electrical Supply System" SWORD EngN 1 100 -16384.00 16383.50 FORMAT "%8.2" ECU_ADDRESS 0x600050EA /end MEASUREMENT
/begin MEASUREMENT ESS_nMin "Min. engine speed request from Electrical Supply System" SWORD EngN 1 100 -16384.00 16383.50 FORMAT "%8.2" ECU_ADDRESS 0x600050E8 /end MEASUREMENT
/begin MEASUREMENT ESS_trqDesAcs "Torque request from Electrical Supply System" SWORD Trq 1 100 -3276.800 3276.700 FORMAT "%8.3" ECU_ADDRESS 0x600050E4 /end MEASUREMENT
/begin MEASUREMENT ESS_trqResvAcs "Torque reserve request from Electrical Supply System" SWORD Trq 1 100 -3276.800 3276.700 FORMAT "%8.3" ECU_ADDRESS 0x600050E2 /end MEASUREMENT
/begin MEASUREMENT ETM_rClgDem "Relative fan cooling power required by engine cooling" SWORD Prc 1 100 -400.0000 399.9878 FORMAT "%8.4" ECU_ADDRESS 0x60004B08 /end MEASUREMENT
/begin MEASUREMENT GlbDa_trqCrSVehLimMin "current limitation torque from GlbDa on crankshaft torque level" SWORD Trq 1 100 -3276.800 3276.700 FORMAT "%8.3" ECU_ADDRESS 0x6000E270 /end MEASUREMENT
/begin MEASUREMENT GlbDa_trqVehLimMin "current limitation from GlbDa" SWORD Trq 1 100 -3276.800 3276.700 FORMAT "%8.3" ECU_ADDRESS 0x60005048 /end MEASUREMENT
/begin MEASUREMENT hymbdefa_msg "hysteresis for desire torque from driver for determination of bdemodfa" UBYTE rel_ub_b100 1 100 0.00 99.61 FORMAT "%5.2" ECU_ADDRESS 0x6000E453 /end MEASUREMENT
/begin MEASUREMENT misobdembv_msg "engine torque for hysteresis of mode map KFBDEMBV" UBYTE rel_ub_b100 1 100 0.00 99.61 FORMAT "%5.2" ECU_ADDRESS 0x6000E455 /end MEASUREMENT
/begin MEASUREMENT misobdestracc_msg "misobdestracc_msg" UBYTE rel_ub_b100 1 100 0.00 99.61 FORMAT "%5.2" ECU_ADDRESS 0x6000A29C /end MEASUREMENT
/begin MEASUREMENT nmotbdembv_msg "engine speed for hysteresis of mode map KFBDEMBV" UBYTE nmot_ub_q40 1 100 0.00 10200. FORMAT "%5.0" ECU_ADDRESS 0x6000E457 /end MEASUREMENT
/begin MEASUREMENT prioko_msg "Coordinated priority GDI desired mode." UBYTE OneToOne 1 100 0.00 255.0 FORMAT "%5.1" ECU_ADDRESS 0x6000E459 /end MEASUREMENT
/begin MEASUREMENT stAftRun "After run status used in calculation of cooling demand" UBYTE B_TRUE 1 100 0.00 1.00000000000 BIT_MASK 0x1 FORMAT "%13.11" ECU_ADDRESS 0x60034784 /end MEASUREMENT
/begin MEASUREMENT stOffAcc "AC compressor status: reset condition for switch off time due to acceleration" UBYTE B_TRUE 1 100 0.00 1.00000000000 BIT_MASK 0x1 FORMAT "%13.11" ECU_ADDRESS 0x60009BAD /end MEASUREMENT
/begin MEASUREMENT stOffDrvOff "AC compressor status: reset condition for switch off time due to drive off" UBYTE B_TRUE 1 100 0.00 1.00000000000 BIT_MASK 0x1 FORMAT "%13.11" ECU_ADDRESS 0x60009BAC /end MEASUREMENT
/begin MEASUREMENT tanrm "Normalization factor for intake or air temperature" UBYTE fak_ub_b2 1 100 0.00 1.992188 FORMAT "%8.6" ECU_ADDRESS 0x60009BB2 /end MEASUREMENT
/begin MEASUREMENT tiClgAftRun "Final value for time for cooling after run used in calculation of cooling demand" SWORD Time_s 1 100 -327.6800 327.6700 FORMAT "%8.4" ECU_ADDRESS 0x60034782 /end MEASUREMENT
/begin MEASUREMENT tiClgAftRunMax2 "Time for cooling after run used in calculation of cooling demand" SWORD Time_s 1 100 0.00 327.6700 FORMAT "%8.4" ECU_ADDRESS 0x60034780 /end MEASUREMENT
/begin FUNCTION CoEOM_Swt "2.13.0    ICE Mode Control: Coordination of the Switch-over"
 /begin DEF_CHARACTERISTIC CoEOM_dmCvlc_C CoEOM_flgActvdEomSwtIniStrt_C CoEOM_flgEnblSwtStgyStrt_C CoEOM_idxSwtStgySeld_M CoEOM_InbnMatModi_a CoEOM_stEnblEomSwt_C CoEOM_stEomActv_AX CoEOM_stEomDesReqd_AX CoEOM_stEOMIni_C CoEOM_stEomStgyIgnRels_C CoEOM_stPhaEomIgnRels_C CoEOM_stThdPhaEomShiftMax_C CoEOM_stThdPhaEomShiftMin_C CoEOM_SwtStgy1.stTrigAftSwt_C CoEOM_SwtStgy1.tiMaxAirStaty_C CoEOM_SwtStgy2.stTrigAftSwt_C CoEOM_SwtStgy2.stTrig_C CoEOM_SwtStgy2.tiMaxAirPrep_C CoEOM_SwtStgy2.tiMaxAirStaty_C CoEOM_SwtStgy2.tiMaxTrigAckd_C CoEOM_SwtStgy5.stTrigAftSwt_C CoEOM_SwtStgy5.stTrig_C CoEOM_SwtStgy5.tiMaxAirStaty_C CoEOM_SwtStgy5.tiMaxTrigAckd_C CoEOM_SwtStgy_I.OperMod2Idx_M CoEOM_trqInrLimDelta_C /end DEF_CHARACTERISTIC
 /begin IN_MEASUREMENT AirMod_ratChrgDeltaSwtAirSys CoEng_stMai CoEOM_flgRelAirStatyEomChg CoEOM_stEomDes CoEOM_stTrigAckd Epm_stSync fmi2trq_w_msg Gen_ctCylAdv GEVCtl_nrCylSyncVlvLftIntk PthSet_trqInrLim TMERng_ratTqBascPred Veh_flgDyn /end IN_MEASUREMENT
 /begin OUT_MEASUREMENT CoEOM_flgEomIgnRels CoEOM_flgEomSwtActv CoEOM_flgEomTrigAirStaty CoEOM_flgTqCalcnReqd CoEOM_idxSwtStgySeld CoEOM_stEom CoEOM_stEomActv CoEOM_stEomActvTmng CoEOM_stEomCylAdv_a CoEOM_stEomTar CoEOM_stEomTarActr CoEOM_stEomTarAirSys CoEOM_stEomTarHw CoEOM_stEomTarInj CoEOM_stEomTarLbk CoEOM_stPhaEomShift CoEOM_stTrigActvt /end OUT_MEASUREMENT
 /begin LOC_MEASUREMENT CoEOM_ctCylAdv CoEOM_ctCylAdvTmng CoEOM_flgCylAdvCalcd CoEOM_flgCylAdvCalcdTmng CoEOM_flgEomSwtDes CoEOM_flgEomSwtIniDesLoc CoEOM_flgEomSwtIniLoc CoEOM_flgNxtCylCalcnTrig CoEOM_flgTmngExeSync CoEOM_flgTmngFinshed CoEOM_idxGroupEomActv CoEOM_idxGroupEomDes CoEOM_idxSwtStgyM CoEOM_idxSwtStgySeldLoc CoEOM_nrPrdnHoz CoEOM_stEomActvLoc CoEOM_stEomActvTmngLoc CoEOM_stEomDesReqdLoc CoEOM_stEomLoc CoEOM_stEomTarActrLoc CoEOM_stEomTarAirSysLoc CoEOM_stEomTarHwLoc CoEOM_stEomTarInjLoc CoEOM_stEomTarLbkLoc CoEOM_stEomTarLoc CoEOM_stEomTarPrev CoEOM_stPhaEomShiftLoc CoEOM_stTrigActvtLoc CoEOM_SwtStgy1.flgEomSwtDes CoEOM_SwtStgy1.flgRelAirStatyEomChg CoEOM_SwtStgy1.flgTmngFinshed CoEOM_SwtStgy1.flgWrStEomActv CoEOM_SwtStgy1.flgWrStEomActvTmng CoEOM_SwtStgy1.flgWrStEomTarActr CoEOM_SwtStgy1.flgWrStEomTarAirSys CoEOM_SwtStgy1.flgWrStEomTarHw CoEOM_SwtStgy1.flgWrStEomTarInj CoEOM_SwtStgy1.flgWrStEomTarLbk CoEOM_SwtStgy1.sm CoEOM_SwtStgy1.stPhaEomShift CoEOM_SwtStgy1.stTrigActvt CoEOM_SwtStgy1.tiSwt CoEOM_SwtStgy2.flgEomSwtDes CoEOM_SwtStgy2.flgRelAirStatyEomChg CoEOM_SwtStgy2.flgTmngFinshed CoEOM_SwtStgy2.flgTqCalcnAckd CoEOM_SwtStgy2.flgWrStEomActv CoEOM_SwtStgy2.flgWrStEomActvTmng CoEOM_SwtStgy2.flgWrStEomTarActr CoEOM_SwtStgy2.flgWrStEomTarAirSys CoEOM_SwtStgy2.flgWrStEomTarHw CoEOM_SwtStgy2.flgWrStEomTarInj CoEOM_SwtStgy2.flgWrStEomTarLbk CoEOM_SwtStgy2.sm CoEOM_SwtStgy2.stPhaEomShift CoEOM_SwtStgy2.stTrigAckd CoEOM_SwtStgy2.stTrigActvt CoEOM_SwtStgy2.tiSwt CoEOM_SwtStgy5.flgEomSwtDes CoEOM_SwtStgy5.flgRelAirStatyEomChg CoEOM_SwtStgy5.flgTmngFinshed CoEOM_SwtStgy5.flgWrStEomActv CoEOM_SwtStgy5.flgWrStEomActvTmng CoEOM_SwtStgy5.flgWrStEomTarActr CoEOM_SwtStgy5.flgWrStEomTarAirSys CoEOM_SwtStgy5.flgWrStEomTarHw CoEOM_SwtStgy5.flgWrStEomTarInj CoEOM_SwtStgy5.flgWrStEomTarLbk CoEOM_SwtStgy5.sm CoEOM_SwtStgy5.stPhaEomShift CoEOM_SwtStgy5.stTrigAckd CoEOM_SwtStgy5.stTrigActvt CoEOM_SwtStgy5.tiSwt CoEOM_tiSwt CoEOM_tiSwtSWT_I.tiStrd /end LOC_MEASUREMENT
 FUNCTION_VERSION "2.13.0" /end FUNCTION
/begin FUNCTION CoEOM_Vld2Lcy "100.18.0  Interface adapter MC CoEOM to old software"
 /begin DEF_CHARACTERISTIC CoEOM_BdeLcyMpg_I.OperMod2Idx_M CoEOM_flgEomInterHosPln_C CoEOM_stPhaEomShift2_C CoEOM_stPhaEomShift_C CoEOM_VheLcyMpg_I.OperMod2Idx_M KLBDEMTAFC /end DEF_CHARACTERISTIC
 /begin IN_MEASUREMENT B_rlvheg_msg CoEOM_EomBasis1_I.stOperMod CoEOM_EomBasis1_I.stOperModPrio CoEOM_EomBasis1_I.stOperModStg CoEOM_flgEomActvInhb CoEOM_flgEomIgnRels CoEOM_flgEomTrigAirStaty CoEOM_flgRelAirStatyEomChg CoEOM_flgTqCalcnReqd CoEOM_idxSwtStgySeld CoEOM_stEomCylAdv_a CoEOM_stEomDest CoEOM_stEomTar CoEOM_stEomTarActr CoEOM_stEomTarAirSys CoEOM_stEomTarInj CoEOM_stPhaEomShift CoEOM_stTrigActvt Epm_nEng GEVCtl_nrCylSyncVlvLftIntk IntkAirT_tThrVlvUs mivbeb_w_msg /end IN_MEASUREMENT
 /begin OUT_MEASUREMENT bdemagrs bdemagrs_msg bdemfes_msg bdemlbks bdemodbv_msg bdemodfaOld_msg bdemodfa_msg bdemodmd_msg bdemodrdnt_msg bdemods_msg bdemods_w_msg bdemodvkh_msg bdemodvrbt_msg bdemodz_msg bdemod_msg bdemsus B_baschs_msg B_basch_msg B_bdemodfa_msg B_bdemz_msg B_bderlsts_msg B_bdetes_msg B_berhom_msg B_bersch_msg B_berskh_msg B_eahoms_msg B_eahom_msg B_easchs_msg B_easch_msg B_hksab_msg B_hksagrs_msg B_hksen_msg B_hksfes_msg B_hkss_msg B_hksz_msg B_hmmagrs_msg B_hmmen_msg B_hmmfes_msg B_hmms_msg B_hmmz_msg B_homagrs_msg B_homen_msg B_homfes_msg B_homs_msg B_homz_msg B_hosagrs_msg B_hosen_msg B_hosfes_msg B_hoss_msg B_hosz_msg B_hos_msg B_hsgm_msg B_hspagrs_msg B_hspen_msg B_hspfes_msg B_hsps_msg B_hspz_msg B_mwab_msg B_mwnwss_msg B_mwuss_msg B_nobdem_msg B_scgm_msg B_schagrs_msg B_schen_msg B_schfes_msg B_schs_msg B_schz_msg B_skhagrs_msg B_skhfes_msg B_skhs B_skhs_msg B_skhz_msg B_ubaov_msg B_umhomsch_msg B_umschhom_msg B_vhegfes_msg B_vhegs_msg B_vhegtes_msg B_vhegvss_msg B_vheg_msg B_vheinst_msg B_vherlsts_msg B_zwschfes_msg B_zwschs_msg CoEng_flgDesEomDsm CoEng_flgDesEomLimp CoEng_flgDesEomNsc CoEOM_bHLN CoEOM_bHOM CoEOM_bIASTF CoEOM_bSPC CoEOM_bTransActv CoEOM_flgDesEomAbort CoEOM_flgDesTqAdjmt CoEOM_flgEomInterHosPln CoEOM_flgHkp CoEOM_flgHosAllwdExcpn CoEOM_flgHsp CoEOM_flgProlgSlip CoEOM_flgStrat CoEOM_flgUnstyShftPred CoEOM_stEomTarPostProlgSlip CoEOM_stOpMAct CoEOM_stOpMPos dmiagk_w_msg hymbdefa_msg misobdembv_msg misobdestracc_msg nmotbdembv_msg prioko_msg /end OUT_MEASUREMENT
 /begin LOC_MEASUREMENT bdemodfa_tmp bdemods_tmp bdemods_w_tmp bdemodz_tmp B_bdeminst_tmp CoEOM_tAirMnfldUsThrAdpr tanrm /end LOC_MEASUREMENT
 FUNCTION_VERSION "100.18.0" /end FUNCTION
/begin FUNCTION CoESS_Dem "52.0.0    Coordinator of electrical supply system"
 /begin DEF_CHARACTERISTIC CoESS_iElecLdRstLe_C CoESS_iElecLdRstRht_C CoESS_iElecLdThres_C CoESS_iEPSLdLe1_C CoESS_iEPSLdLe2_C CoESS_iEPSLdRht1_C CoESS_iEPSLdRht2_C CoESS_nIdlBattThres_C CoESS_nMax_C CoESS_nMin1Batt_C CoESS_nMin2Batt_C CoESS_nMin3Batt_C CoESS_nMin4Batt_C CoESS_nMin5Batt_C CoESS_nMinAltLoad_C CoESS_nMinThres_C CoESS_swtElecLdSel_C CoESS_tiAltIdleUp_C CoESS_tiHiLoBattRst_C CoESS_tiHiLoBattSet_C CoESS_tiHiLoEngSet_C CoESS_tiLoHiBattRst_C CoESS_tiLoHiBattSet_C CoESS_tiLoHiEngSet_C CoESS_uIdlBattThresRst_C CoESS_uIdlBattThresSet_C CoESS_vMinThres_C /end DEF_CHARACTERISTIC
 /begin IN_MEASUREMENT Alt_flgAltLoadIdleUpReq Alt_stDchaAltUpprLimStk Alt_trqDes Alt_trqResv Batt_bEngStopEna Batt_bEngStrtReq CoEng_st ElecLd_iEPSLd ElecLd_iLd Epm_nEng ESS_uBatt GlbDa_vX HLSDem_nSetPLo PT_bNoGrip PT_stTraType SpdGov_nSetPLo SyC_ctPostDrvLeave Tra_flgNeutPrkg /end IN_MEASUREMENT
 /begin OUT_MEASUREMENT ESS_bEngStopEna ESS_bEngStrtReq ESS_nMax ESS_nMin ESS_trqDesAcs ESS_trqResvAcs /end OUT_MEASUREMENT
 /begin LOC_MEASUREMENT CoESS_cntrReIni CoESS_nMinAltIdleUp /end LOC_MEASUREMENT
 FUNCTION_VERSION "52.0.0" /end FUNCTION
/begin FUNCTION CoESS_Ord "2.9.0     Order of the electrical supply system coordinator" /begin IN_MEASUREMENT CoVeh_stAlt /end IN_MEASUREMENT /begin OUT_MEASUREMENT CoESS_stAlt /end OUT_MEASUREMENT FUNCTION_VERSION "2.9.0" /end FUNCTION
/begin FUNCTION CoESS_RecupUReq "4.9.0     Minimum Voltage Request for 12V Recuperation"
 /begin DEF_CHARACTERISTIC CoESS_stRampDeActv_C CoESS_uAirCmprDmdLowr_C CoESS_uAirCmprDmdU_C CoESS_uBlowrFanHysHi_C CoESS_uBlowrFanHysLo_C CoESS_uBlowrTarUHysLowr_C CoESS_uBlowrTarUHysUppr_C CoESS_uMinPspAirChrg_M CoESS_uNegSlopRampHi_C CoESS_uNegSlopRampLo_C CoESS_uPosSlopRamp_C /end DEF_CHARACTERISTIC
 /begin IN_MEASUREMENT Alt_uDes Blwr_uVoltReq Epm_nEng FanCtl_stPDpdtDutyHiDmd rl_w T15_st /end IN_MEASUREMENT
 /begin OUT_MEASUREMENT CoESS_flgUReq CoESS_uBlowrUMinReq CoESS_uBlowrUUnRampUnfild CoESS_uFuPmpMinReq CoESS_uMinReq CoESS_uSlopRampVal /end OUT_MEASUREMENT
 FUNCTION_VERSION "4.9.0" /end FUNCTION
/begin FUNCTION CoETM_ClgDem "2.4.0     Engine Thermal Management Cooling Demand"
 /begin DEF_CHARACTERISTIC CoETM_facAftRun2_C CoETM_facClgAftRunTEnv_CUR CoETM_facClgAftRun_CUR CoETM_rClgAftRun_MAP CoETM_rClgDemFan_CUR CoETM_rClgDemMax_C CoETM_rClgDemMin_C CoETM_rClgIntegMax_C CoETM_rClgIntegMin_C CoETM_rClgKi_CUR CoETM_rClgKp_CUR CoETM_swtSrc_C CoETM_tAftRunAbrt_C CoETM_tClntEngOutStg1Max_C CoETM_tClntEngOutStg1Min_C CoETM_tClntEngOutStg2Max_C CoETM_tClntEngOutStg2Min_C CoETM_tDvtMax_C CoETM_tDvtMin_C CoETM_tDvtStg0_C CoETM_tDvtStg1_C CoETM_tDvtStg2_C CoETM_tEngOutSubsOff_C CoETM_tiClgAftRun2_MAP CoETM_tiClgAftRunCons_MAP CoETM_tiClgAftRunOil_CUR CoETM_tiClgAftRun_MAP CoETM_tiClgIntegT1_C /end DEF_CHARACTERISTIC
 /begin IN_MEASUREMENT CoEng_st CoTS_tClntEngOutDes FlSys_dvolFlCons GlbDa_tEnv Oil_tSwmp TS_tClntEngOut /end IN_MEASUREMENT
 /begin OUT_MEASUREMENT ETM_rClgDem /end OUT_MEASUREMENT
 /begin LOC_MEASUREMENT CoETM_flgAftRun_mp CoETM_rClgDemLim_mp CoETM_rClgIntegLim_mp CoETM_rClgProp_mp CoETM_tClntEngOut_mp CoETM_tDvt_mp CoETM_tEngOutOff_mp CoETM_tiClgAftRun2_mp CoETM_tiClgAftRunMax2_mp CoETM_tiClgAftRunOpt_mp CoETM_tiClgAftRun_mp stAftRun tiClgAftRun tiClgAftRunMax2 /end LOC_MEASUREMENT
 FUNCTION_VERSION "2.4.0" /end FUNCTION
/begin FUNCTION CoETS_FltDem "7.2.0_1.0.0Filter demand for drivability filter" /begin DEF_CHARACTERISTIC CoETS_bFltDemLeadEnf_C CoETS_stFltIntvEnd_CW /end DEF_CHARACTERISTIC
 /begin IN_MEASUREMENT ASDrf_trqClthLeadEng GlbDa_stTrqDem StatyCoorn_tqCluLeadLimd /end IN_MEASUREMENT
 /begin OUT_MEASUREMENT CoETS_bFltDemLead CoETS_bFltDemSet CoETS_bIntvActvDes CoETS_bIntvActvLead CoETS_bTraIntvActv /end OUT_MEASUREMENT
 /begin LOC_MEASUREMENT CoETS_bDecrIntvLead CoETS_bFltIntvEnd CoETS_bIncrIntvLead /end LOC_MEASUREMENT
 FUNCTION_VERSION "7.2.0_1.0.0" /end FUNCTION
/begin FUNCTION CoETS_StTrqLimCalc "24.2.0    Minimum Torque Limitation" /begin DEF_CHARACTERISTIC CoETS_nTrqRatMin_C /end DEF_CHARACTERISTIC
 /begin IN_MEASUREMENT ActMod_trqInr CoVeh_trqAcs EngDem_trqInrLim Epm_nEng PT_rTrq PT_trqLos PT_trqTraPrt RngMod_trqClthMin VehMot_trqPrtDfftl /end IN_MEASUREMENT
 /begin OUT_MEASUREMENT CoETS_rTrq CoETS_trqInrCurrLim GlbDa_trqCrSVehLimMin GlbDa_trqVehLimMin /end OUT_MEASUREMENT
 /begin LOC_MEASUREMENT CoETS_trqInrVehLimMin_mp /end LOC_MEASUREMENT
 FUNCTION_VERSION "24.2.0" /end FUNCTION
/begin FUNCTION CoETS_TrqCnv "8.0.0_159.0.0Torque conversion from engine input torque into inner torque"
 /begin IN_MEASUREMENT PtCoornDyn_tqCrksftLead PTDist_tqCrksftSet RngMod_trqCrSMin /end IN_MEASUREMENT
 /begin OUT_MEASUREMENT CoETS_trqInrLeadWoCo CoETS_trqInrSetWoCo CoETS_trqInrTgtWoCo /end OUT_MEASUREMENT
 FUNCTION_VERSION "8.0.0_159.0.0" /end FUNCTION
/begin FUNCTION CoETS_TrqCoord "8.0.1     Torque-Coordination engine sided torque interventions"
 /begin IN_MEASUREMENT CoETS_trqInrLeadWoCo CoETS_trqInrSetWoCo CoETS_trqInrTgtWoCo EngDem_trqInrLim EngDem_trqInrLimLead /end IN_MEASUREMENT
 /begin OUT_MEASUREMENT CoETS_bEngLimActvLead CoETS_trqInrLeadCo CoETS_trqInrLimLead CoETS_trqInrLimSet CoETS_trqInrSetCo CoETS_trqInrTgtCo CoETS_trqLimLead /end OUT_MEASUREMENT
 FUNCTION_VERSION "8.0.1" /end FUNCTION
/begin FUNCTION ComCIL_Co "319.24.0_1.0.0coordinator of the frame manager"
 /begin DEF_CHARACTERISTIC ComEBS_chNomCapBattSens_C ComEBS_rBattSensCh_C ComEBS_rBattSensSOH_C ComEBS_stBattCrntRng_C ComEBS_stBattSensFlagIni_C ComEBS_stEBSInvld_C ComEBS_stLinRespErr_C ComEBS_tBattSens_C ComEBS_uBattSensSOF_C ComEBS_uBattSens_C Com_cwEepSpasRst_C Com_cwSpasDiagCfg_C Com_stFrmRxEna_CA Com_stFrmRxPstDrvEna_CA Com_stFrmTxEna_CA Com_stFrmTxPstDrvEna_CA Com_stswtBrkOper_C Com_stSwtISABAct_C Com_stSwtISABEna_C Com_stswtVirtAPPSelSig_C Com_stSyncSpasDetn_C Com_stVSAFIdErrWghtFac_CA Com_stVSASumTrqErrESP_C Com_swtACEVAMtrSwtInfo_C Com_swtCANVer_C Com_swtEnvT_C Com_swtSelAPPENGA_C Com_swtSelAPPENGT_C Com_tiIgnSpasDetnDly_C Com_tiMonBatt_C Com_tiMonStrt_C Com_tiSpas2DetnThd_C Com_tiSpasDetnDly_C Com_uBattSpasMax_C Com_uBattSpasMin_C Com_uMonBatt_C Lin_uOCV_C /end DEF_CHARACTERISTIC
 /begin IN_MEASUREMENT APP_bSRCHigh1 APP_bSRCHigh2 APP_bSRCLow1 APP_bSRCLow2 APP_bSync APP_r APP_rUnFlt APP_stSigSrc BattU_u BusDiag_flgAPPLBUSOFF BusDiag_flgCANCBUSOFF BusDiag_flgVEHICLEBUSOFF CoEng_st Com_flgLINShtDwnTiDlyExp Com_iElecLd Com_stACMETG Com_stATMILReqEAT8 Com_stAYCFFuCtrlReq Com_stCfmdPPosnFCAN Com_stCfmdPPosnPTCAN Com_stClrCmplInfoVINRegst Com_stEAT12RingCntChkSumErr Com_stEAT12TOutBusOffErr Com_stEAT13RingCntChkSumErr Com_stEAT13TOutBusOffErr Com_stIMGACCBrkReq Com_stIMGDrvTq Com_stIMGLimTq Com_stIMGMILReq Com_stIMGShiftReq Com_stISABActAYCI Com_stISABEnaAYCI Com_stLiSwtInfoMETI Com_stMETDCanErr Com_stMETE2ACISSInhbReq Com_stMETE2FrntDfrstSwtInfo Com_stMETNCanErr Com_stMtrCustStReq Com_stNotTxDrvgFFCAN Com_stNotTxDrvgFPTCAN Com_stVINWrClrDone Com_tMETCEnvTRaw Com_tMETE2AirOutside Com_tMETEEnvTRaw Com_tMtrEvaMETD Com_tOutd Com_tqIMGReqDrv Com_tqIMGSuppReq Com_uFlLvlRaw I14229_stABSFailCnclActv PT_stTraType StrtCtl_flgEngStrtSeq StrtCtl_flgEngStrtSeqCmpl Strt_st SysDiag_flgCModJdg T15_st VMD_rVirtAPP VMD_rVirtAPPLrn /end IN_MEASUREMENT
 /begin OUT_MEASUREMENT ACC_bBrkReq Com_iEPS1ElecLd Com_rAPPENGA Com_rAPPENGT Com_rASLCCENGT Com_rVirtAPP Com_stAC Com_stACCActv Com_stACISSInhbReqRes Com_stAPPFailrDetInfo Com_stAPPNormDetInfo Com_stAPPSensFail Com_stATMILReq Com_stCANANoBusOff Com_stCANBNoBusOff Com_stCANCNoBusOff Com_stCfmdPPosn Com_stComVSA Com_stEngRun Com_stEnvT Com_stEthnlSErr Com_stEwpErr Com_stFrmRxEna Com_stFrmTxEna Com_stFrntDfrstSwtInfoRes Com_stFuCtrlReq Com_stIDASShftReq Com_stIDASTrqLowSel Com_stISABAct Com_stISABEna Com_stLiSwtInfo Com_stMon Com_stMonitor Com_stMtrCustFlg Com_stMtrEva Com_stNotTxDrvgF Com_stSrvModDispReq Com_stStaActvReq Com_stVINWriteClrDone Com_stVSAAirPThrUsSnsrErr Com_stVSAAPedlErr Com_stVSABstCtrlErr Com_stVSADetrmAirMErr Com_stVSAECUHwErr Com_stVSAEngPosngErr Com_stVSAEnvtlAirPSnsrErr Com_stVSAFlSplyErr Com_stVSAGEVCntrlErr Com_stVSAHFMSnsrErr Com_stVSAIgnCtrlErr Com_stVSAInhbInfo Com_stVSAInjCtrlErr Com_stVSAIntkAirPSnsrErr Com_stVSALamCtrlErr Com_stVSAMisfErr Com_stVSAMonErr Com_stVSASumTrqErr Com_stVSAThrVlvErr Com_stVSATrboChrgnErr Com_stVSAVehSpdImpsErr Com_stVSAVlvLftCtrlErr Com_swtCANVer Com_tAirOutside Com_tEnvT Com_tMtrEva Com_tqBrkOper Com_tqIDASTar Com_trq2IDASTar Com_uFlLvlRawRes /end OUT_MEASUREMENT
 FUNCTION_VERSION "319.24.0_1.0.0" /end FUNCTION
/begin FUNCTION ComCo_Lyr "14.1.0_6SAAComCo Layer" FUNCTION_VERSION "14.1.0_6SAA" /end FUNCTION
/begin FUNCTION CoME_DemCoord "135.7.0   Mechanical energy Coordinator - Determination torque/engine speed request for accessories"
 /begin DEF_CHARACTERISTIC CoME_stNReqESS_C CoME_stNReqTSAC_C CoME_stNReqTS_C CoME_stNReqVehMot_C /end DEF_CHARACTERISTIC
 /begin IN_MEASUREMENT Epm_nEng ESS_nMax ESS_nMin ESS_trqDesAcs ESS_trqResvAcs PT_trqLosComp PT_trqResv TS_nMax TS_nMin TS_nMinAC TS_trqDesAcs TS_trqResvAcs /end IN_MEASUREMENT
 /begin OUT_MEASUREMENT CoME_nMax CoME_nMin CoME_stNSetP CoME_trqDesComp CoME_trqResv CoVeh_trqAcs /end OUT_MEASUREMENT
 /begin LOC_MEASUREMENT CoME_nMinTemp CoME_nMinTipIn CoME_nMinUnFlt CoME_tqAcsy /end LOC_MEASUREMENT
 FUNCTION_VERSION "135.7.0" /end FUNCTION
/begin FUNCTION CoME_ShutOff "3.7.0     Mechanical energy Coordinator - Determination of shut off condition for accessories"
 /begin DEF_CHARACTERISTIC CoME_calEngSpeed_AXIS CoME_drPedHi_C CoME_drPedLo_C CoME_nEng1Hi_C CoME_nEng1Lo_C CoME_nEng2Hi_C CoME_nEng2Lo_C CoME_numTraGearMax_C CoME_pEnv1Hi_C CoME_pEnv1Lo_C CoME_pEnv2Hi_C CoME_pEnv2Lo_C CoME_rPedHi_C CoME_rPedLo_C CoME_stAlt_CW CoME_stEEM_C CoME_stFan_CW CoME_tEnvAir1Hi_C CoME_tEnvAir1Lo_C CoME_tEnvAir2Hi_C CoME_tEnvAir2Lo_C CoME_tiBattVltgOff_C CoME_tiDrvOn_C CoME_tiMaxOffAcc_CUR CoME_tiMaxOffDrvOff_CUR CoME_tiMinOffAcc_CUR CoME_tiMinOffDrvOff_CUR CoME_tiOffStopAC_C CoME_tiOffStopAlt_C CoME_tiOffStopFan_C CoME_tiOffStrtAC_C CoME_tiOffStrtAlt_C CoME_trqAcc_C CoME_trqACMax_C CoME_trqBattVltg_C CoME_trqDrvOff_C CoME_trqStop_C CoME_trqStrt_C CoME_uBattMinHi_C CoME_uBattMinLo_C CoME_vX1Hi_C CoME_vX1Lo_C CoME_vX2Hi_C CoME_vX2Lo_C /end DEF_CHARACTERISTIC
 /begin IN_MEASUREMENT CoEng_stMai Epm_nEng ESS_uBatt GlbDa_pEnv GlbDa_tEnv GlbDa_vX Tra_numGear VehMot_drAccPedUnFlt VehMot_rAccPedFlt /end IN_MEASUREMENT
 /begin OUT_MEASUREMENT CoME_flgAcc CoME_flgAccMax CoME_flgAccMin CoME_flgAccTmr CoME_flgBattVltg CoME_flgBattVltgTmr CoME_flgDrvOff CoME_flgDrvOffMax CoME_flgDrvOffMin CoME_flgDrvOffTmr CoME_flgDrvTmr CoME_flgOffAcc CoME_flgOffDrvOff CoME_flgStop CoME_flgStrt CoME_flgStrtTmrAC CoME_tiMaxOffAcc CoME_tiMaxOffDrvOff CoME_tiMinOffAcc CoME_tiMinOffDrvOff CoVeh_stAlt CoVeh_stFan CoVeh_trqMaxAC /end OUT_MEASUREMENT
 /begin LOC_MEASUREMENT stOffAcc stOffDrvOff /end LOC_MEASUREMENT
 FUNCTION_VERSION "3.7.0" /end FUNCTION
/begin FUNCTION Common "3.3.0     central header file" FUNCTION_VERSION "3.3.0" /end FUNCTION
/begin FUNCTION CommonCELPrj "30059.0.0 header file for CELPrj package" FUNCTION_VERSION "30059.0.0" /end FUNCTION
/begin FUNCTION ComScl_Appl "109.13.0_1.0.0Application of ComScl Layer" /begin DEF_CHARACTERISTIC Com_swtEnaChksAlvCntrGbxEATA_C /end DEF_CHARACTERISTIC
 /begin REF_CHARACTERISTIC Com_dENG21SigSel_C Com_dENG25SigSel_C Com_dENGBSigSel_C Com_dENGK3SigSel_C Com_dENGOSigSel_C Com_dENGQSigSel_C Com_dENGRSigSel_C Com_dENGT2SigSel_C Com_dENGV2SigSel_C Com_dENGZSigSel_C /end REF_CHARACTERISTIC
 FUNCTION_VERSION "109.13.0_1.0.0" /end FUNCTION
/begin FUNCTION ComScl_Bdy "16.2.0_6SAASignal processing of frames from Body Control Module"
 /begin OUT_MEASUREMENT Com_aLatGA Com_aLgtG Com_ctCRingBCM1 Com_ctCRingSRS Com_ctCRingSRSA Com_ctCRingSRSB Com_numCsumBCM1 Com_numCsumSRS Com_numCsumSRSA Com_numCsumSRSB Com_nYaw1UpprData Com_stAbnormCpu Com_stAbnormVcc Com_stCalCmplLatG Com_stCalCmplLgtG Com_stCllsnDetn Com_stFailrLatG Com_stFailrLgtG Com_stPrmntErrYaw1 Com_stRemEngStrtr Com_stSeatBltInfo Com_stStrtupProc Com_stTempAbnormLatG Com_stTempAbnormLgtG Com_stTmpErrYaw1 /end OUT_MEASUREMENT
 FUNCTION_VERSION "16.2.0_6SAA" /end FUNCTION
/begin FUNCTION ComScl_Dspl "36.2.0_6SAASignal processing of frames from Display ECU"
 /begin OUT_MEASUREMENT Com_bDeIce Com_bDigMtrUnit Com_bMicuInfo Com_bReDEFOutCdn Com_bReDEFSwCdn Com_bRMDRLKCInfo Com_bRMHLHiRly Com_bRMHLLoRly Com_bRMILLSml Com_ctCRingMETA Com_ctCRingMETC Com_ctCRingMETD Com_ctCRingMETE2 Com_ctCRingMETF Com_ctCRingMETG Com_ctCRingMETH Com_ctCRingMETH2 Com_ctCRingMETI Com_ctCRingMETK Com_ctCRingMETL Com_ctCRingMETM Com_ctCRingMETN Com_iACCmprHiByte Com_iACCmprLoByte Com_lDstMETKRaw Com_nrActPtcActv Com_numCsumMETA Com_numCsumMETC Com_numCsumMETD Com_numCsumMETE2 Com_numCsumMETF Com_numCsumMETG Com_numCsumMETH Com_numCsumMETH2 Com_numCsumMETI Com_numCsumMETK Com_numCsumMETL Com_numCsumMETM Com_numCsumMETN Com_stACCut Com_stACFailInfo Com_stACGUpReq Com_stAcInfo Com_stACMETG Com_stAirCdnr Com_stBattOTAReq Com_stBCANInfo Com_stBCANReprogm Com_stCombUnitFailInfo Com_stDstMETK Com_stECON Com_stEngHoodOpn Com_stFrtFog Com_stICUHoodErr Com_stISSInhbnSwt Com_stMETE2ACISSInhbReq Com_stMETE2FrntDfrstSwtInfo Com_stMICUInfo Com_stMtrCustDftReq Com_stMtrCustStReq Com_stPrkgBrkSw Com_stRrFog Com_stRstReq Com_stSwISInhbSts Com_stTarSpdDisp Com_stWiprActvnCdn Com_stWiprMETC Com_tACAirTOut Com_tACMtrEvaInfo Com_tAirInsdCbn Com_tiISSPrms Com_tMETE2AirOutside Com_tMtrEvaMETD Com_tOutd Com_uFlLvlRaw Com_uFrntBlowrU Com_uMICUTxBlowrU Com_uRrBlowrU Com_vAnaVeh Com_vDigVeh Com_vDigVehRaw Dspl_stACCASLSwtInfo Dspl_stASLRxErr Dspl_stCrsMaiSwtInfo Dspl_stCrsSwtInfo /end OUT_MEASUREMENT
 FUNCTION_VERSION "36.2.0_6SAA" /end FUNCTION
/begin FUNCTION ComScl_Eng "154.10.0_1.0.0Signal processing of frames from Engine ECU"
 /begin IN_MEASUREMENT AccPed_flgIDSDrvModFailr AccPed_flgIDSDrvModTmpInhb ACCtl_flgACCutPrms ACCtl_iCmprDwnIReq ACEvpT_tAvg AC_trqDes AirC_stPsCmpr AirMod_ratRelAirM Alt_flgACGExctCmpl Alt_flgACGFailr Alt_flgLockUpCluExtnReq APP_uRaw1unLim Batt_flgDarkIAllwCondA Batt_flgDarkIAllwCondB BrkPed_flgISABReq BrkPed_tqIMGISABIdleStop Brk_stMnRaw Brk_stRedRaw Clth3_st CoDsplCtl_stOilLmp CoEng_nFco CoEng_nRstrt CoEng_tiNormalOBD Com_bCVTIdleStop Com_bCVTStopEna Com_ctEngData Com_ctFrmENGN Com_ctFrzSyn Com_dDTCRaw1 Com_dDTCRaw2 Com_dDTCRaw3 Com_dPhysAdr Com_flgACReq Com_flgCylIndFcoStrtd Com_flgFcoRdy Com_flgISABReq Com_flgValFailJdg Com_flgValNormJdg Com_flgVirtApp Com_lTotRing Com_nEngSpd Com_nEngSpdSmotng Com_nrEngByte1 Com_nrEngByte2 Com_nrEngByte3 Com_nrEngByte4 Com_nrEngByte5 Com_nrEngByte6 Com_nSetPLo Com_numDTCHi Com_numDTCLo Com_pClnt Com_pEnvPRaw Com_pEnvPRawENGL Com_pforISABIdleStop Com_rAccrPedlPosn Com_rACCTxEstSlp Com_rAPPENGA Com_rThrVlvAct Com_rVirtAPP Com_stalchpct Com_stAltFail Com_stAPPFailrDetInfo Com_stAPPNormDetInfo Com_stAPPSensFail Com_stAutoStaInfo Com_stAutoStaInfoMtr Com_stAYCFErr Com_stCCClthSwt Com_stChkChgnSysInfo Com_stChrgnSys Com_stCmnCntCdnStart Com_stDcyc Com_stDrvModDisp Com_stDtcInhbClr Com_stDTCMem Com_stDTCTyp Com_stDTCUpd Com_stEMTestModEna Com_stEngBrkApp Com_stEngBrkOvrdInfo Com_stEngBrkOvrdMtr Com_stEngCooltTFail Com_stENGECUIG1 Com_stEngIntkAirFail Com_stEngRemSt Com_stEngRtMilUpd Com_stEngRun Com_stEngSpd30DegFail Com_stEngStop Com_stENGT2AYCAck Com_stENGT2NPos Com_stENGT2RvsPos Com_stENGTAYCAck Com_stENGTNPos Com_stEngWrmUp40CycWoFail Com_stErrLmp Com_stEstmTqNormJdg Com_stFailrDetn Com_stFrzLvl Com_stFrzUpd Com_stGbxNPosSFailEngT2 Com_stIDASEngFail Com_stIDASInhb Com_stImsLmp Com_stISSRelsPreNotif Com_stLmp5AltIO Com_stLmp5AltIOENGO Com_stMILMul Com_stMilMultiSerios Com_stOBSUpd Com_stOilLmp Com_stOilLmpInfo Com_stOilLow Com_stPASensFail Com_stPBSensFail Com_stPrmntDenomCdnJdgStop Com_stSILClthSwt Com_stSrvModDispReq Com_stStaActvReq Com_stThrPosnFail Com_stTqRvsnEnaFlg Com_stTrqAccuracySlow Com_stTrqReqFast Com_stTrqReqSlow Com_stVINErrENGV2 Com_stVINUnRegENGV2 Com_stWarnOilLvl Com_swtDrvMod Com_tAirCACDs Com_tCEngDsT Com_ThrVlvActSens1AbsltB1 Com_ThrVlvActSens1RelB1 Com_tiExptFcoStrt Com_tiHACCut Com_tqEstimdEngCrkLvl Com_tqMaxIDAS Com_tqMinIDAS Com_trqDes Com_trqDesENGT1 Com_trqDesENGT2 Com_trqEng Com_trqEngENG16 Com_trqEngENGT2 Com_trqEngEstimd Com_uBattDetnENGECU Com_uIG1DetnENGECU Com_vhegfe Com_volFlConsAdd Com_vVeh CoVeh_flgPtcShtOff CrCtl_stACCAPPOn CrCtl_stActive CrCtl_stDR1Req CrCtl_stDR2Req CrCtl_stDRReqNo CrCtl_stFailCond CrCtl_stGuidDispNo CrCtl_stLmpOn CrCtl_stManCncl CrCUI_numGearPosnADAS ects2svc_msg EnvP_p Epm_nEng Epm_nEngRaw Gbx_stAnaNPosBrkHld HLSDem_nSetPHi I14229_stVINWriteClrReq I15031_PID1C LLim_numMETAlrm LLim_numMETMemSpd LLim_stActvLmp LLim_stMetCCMode2 LLim_stMETVehUn PIntkVUs_p RngMod_trqLos SrvCSwt_st SSEUI_stDrvrGuidInhb SSEUI_stISSInhbReas SSEUI_stISSLampReq SSEUI_stISSLampReqInfo SSEUI_stISSWarnReq SSEUI_stStrtClthReq StrtCtl_flgEPBReq StrtCtl_flgPShiftLockReq StrtCtl_flgVehDrvInhb StrtCtl_flgVehDrvRdy T15_st ThrVlv_ratActSens1AbsltB1_u8 ThrVlv_ratActSens1RelB1_u8 tmottstr_w Tra_numStInd Tra_stAmbLmp Tra_stCrkNotCmpl Tra_stEcoLmpIdc VMD_rDasVirtAPP VMSI_stDCSPlusOK wdks_w /end IN_MEASUREMENT
 FUNCTION_VERSION "154.10.0_1.0.0" /end FUNCTION
/begin COMPU_METHOD AmpHrs_Ah "" RAT_FUNC "%6.2" "Ah" COEFFS 0 1 0 0 0 1 /end COMPU_METHOD
/begin COMPU_METHOD B_TRUE "" TAB_VERB "%6.3" "" COMPU_TAB_REF B_TRUE /end COMPU_METHOD
/begin COMPU_VTAB B_TRUE "" TAB_VERB 2 0 "FALSE" 1 "TRUE" /end COMPU_VTAB
/begin COMPU_METHOD CoEOM_idxOperModCfgd_VERB "" TAB_VERB "%6.3" "-" COMPU_TAB_REF CoEOM_idxOperModCfgd_VERB /end COMPU_METHOD
/begin COMPU_VTAB CoEOM_idxOperModCfgd_VERB "" TAB_VERB 4 0 "Base" 1 "WarmUp" 2 "CatHtg" 3 "Start" /end COMPU_VTAB
/begin COMPU_METHOD CoEOM_idxOperModStgTot_VERB "" TAB_VERB "%6.3" "-" COMPU_TAB_REF CoEOM_idxOperModStgTot_VERB /end COMPU_METHOD
/begin COMPU_VTAB CoEOM_idxOperModStgTot_VERB "" TAB_VERB 16 0 "HOM_FullLft" 1 "Stage 1" 2 "Stage 2" 3 "Stage 3" 4 "HOM_EIVC" 5 "Stage 5" 6 "Stage 6" 7 "Stage 7" 8 "Stage 8" 9 "Stage 9" 10 "Stage 10" 11 "Stage 11" 12 "Stage 12" 13 "Stage 13" 14 "Stage 14" 15 "Stage 15" /end COMPU_VTAB
/begin COMPU_METHOD CoEOM_stEomStgTot_VERB "" TAB_VERB "%6.3" "-" COMPU_TAB_REF CoEOM_stEomStgTot_VERB /end COMPU_METHOD
/begin COMPU_VTAB CoEOM_stEomStgTot_VERB "" TAB_VERB 513 0 "Base_HOM_FullLft" 1 "n/a [00;01]" 2 "n/a [00;02]" 3 "n/a [00;03]" 4 "Base_HOM_EIVC" 5 "n/a [00;05]" 6 "n/a [00;06]" 7 "n/a [00;07]" 8 "n/a [00;08]" 9 "n/a [00;09]" 10 "n/a [00;10]" 11 "n/a [00;11]" 12 "n/a [00;12]" 13 "n/a [00;13]" 14 "n/a [00;14]" 15 "n/a [00;15]" 255 "No_Demand" 256 "n/a [01;00]" 257 "n/a [01;01]" 258 "n/a [01;02]" 259 "n/a [01;03]" 260 "n/a [01;04]" 261 "n/a [01;05]" 262 "n/a [01;06]" 263 "n/a [01;07]" 264 "n/a [01;08]" 265 "n/a [01;09]" 266 "n/a [01;10]" 267 "n/a [01;11]" 268 "n/a [01;12]" 269 "n/a [01;13]" 270 "n/a [01;14]" 271 "n/a [01;15]" 512 "n/a [02;00]" 513 "n/a [02;01]" 514 "n/a [02;02]" 515 "n/a [02;03]" 516 "n/a [02;04]" 517 "n/a [02;05]" 518 "n/a [02;06]" 519 "n/a [02;07]" 520 "n/a [02;08]" 521 "n/a [02;09]" 522 "n/a [02;10]" 523 "n/a [02;11]" 524 "n/a [02;12]" 525 "n/a [02;13]" 526 "n/a [02;14]" 527 "n/a [02;15]" 768 "Start_FullLft" 769 "n/a [03;01]" 770 "n/a [03;02]" 771 "n/a [03;03]" 772 "Start_EIVC" 773 "n/a [03;05]" 774 "n/a [03;06]" 775 "n/a [03;07]" 776 "n/a [03;08]" 777 "n/a [03;09]" 778 "n/a [03;10]" 779 "n/a [03;11]" 780 "n/a [03;12]" 781 "n/a [03;13]" 782 "n/a [03;14]" 783 "n/a [03;15]" 1024 "n/a [04;00]" 1025 "n/a [04;01]" 1026 "n/a [04;02]" 1027 "n/a [04;03]" 1028 "n/a [04;04]" 1029 "n/a [04;05]" 1030 "n/a [04;06]" 1031 "n/a [04;07]" 1032 "n/a [04;08]" 1033 "n/a [04;09]" 1034 "n/a [04;10]" 1035 "n/a [04;11]" 1036 "n/a [04;12]" 1037 "n/a [04;13]" 1038 "n/a [04;14]" 1039 "n/a [04;15]" 1280 "n/a [05;00]" 1281 "n/a [05;01]" 1282 "n/a [05;02]" 1283 "n/a [05;03]" 1284 "n/a [05;04]" 1285 "n/a [05;05]" 1286 "n/a [05;06]" 1287 "n/a [05;07]" 1288 "n/a [05;08]" 1289 "n/a [05;09]" 1290 "n/a [05;10]" 1291 "n/a [05;11]" 1292 "n/a [05;12]" 1293 "n/a [05;13]" 1294 "n/a [05;14]" 1295 "n/a [05;15]" 1536 "n/a [06;00]" 1537 "n/a [06;01]" 1538 "n/a [06;02]" 1539 "n/a [06;03]" 1540 "n/a [06;04]" 1541 "n/a [06;05]" 1542 "n/a [06;06]" 1543 "n/a [06;07]" 1544 "n/a [06;08]" 1545 "n/a [06;09]" 1546 "n/a [06;10]" 1547 "n/a [06;11]" 1548 "n/a [06;12]" 1549 "n/a [06;13]" 1550 "n/a [06;14]" 1551 "n/a [06;15]" 1792 "n/a [07;00]" 1793 "n/a [07;01]" 1794 "n/a [07;02]" 1795 "n/a [07;03]" 1796 "n/a [07;04]" 1797 "n/a [07;05]" 1798 "n/a [07;06]" 1799 "n/a [07;07]" 1800 "n/a [07;08]" 1801 "n/a [07;09]" 1802 "n/a [07;10]" 1803 "n/a [07;11]" 1804 "n/a [07;12]" 1805 "n/a [07;13]" 1806 "n/a [07;14]" 1807 "n/a [07;15]" 2048 "n/a [08;00]" 2049 "n/a [08;01]" 2050 "n/a [08;02]" 2051 "n/a [08;03]" 2052 "n/a [08;04]" 2053 "n/a [08;05]" 2054 "n/a [08;06]" 2055 "n/a [08;07]" 2056 "n/a [08;08]" 2057 "n/a [08;09]" 2058 "n/a [08;10]" 2059 "n/a [08;11]" 2060 "n/a [08;12]" 2061 "n/a [08;13]" 2062 "n/a [08;14]" 2063 "n/a [08;15]" 2304 "n/a [09;00]" 2305 "n/a [09;01]" 2306 "n/a [09;02]" 2307 "n/a [09;03]" 2308 "n/a [09;04]" 2309 "n/a [09;05]" 2310 "n/a [09;06]" 2311 "n/a [09;07]" 2312 "n/a [09;08]" 2313 "n/a [09;09]" 2314 "n/a [09;10]" 2315 "n/a [09;11]" 2316 "n/a [09;12]" 2317 "n/a [09;13]" 2318 "n/a [09;14]" 2319 "n/a [09;15]" 2560 "n/a [10;00]" 2561 "n/a [10;01]" 2562 "n/a [10;02]" 2563 "n/a [10;03]" 2564 "n/a [10;04]" 2565 "n/a [10;05]" 2566 "n/a [10;06]" 2567 "n/a [10;07]" 2568 "n/a [10;08]" 2569 "n/a [10;09]" 2570 "n/a [10;10]" 2571 "n/a [10;11]" 2572 "n/a [10;12]" 2573 "n/a [10;13]" 2574 "n/a [10;14]" 2575 "n/a [10;15]" 2816 "n/a [11;00]" 2817 "n/a [11;01]" 2818 "n/a [11;02]" 2819 "n/a [11;03]" 2820 "n/a [11;04]" 2821 "n/a [11;05]" 2822 "n/a [11;06]" 2823 "n/a [11;07]" 2824 "n/a [11;08]" 2825 "n/a [11;09]" 2826 "n/a [11;10]" 2827 "n/a [11;11]" 2828 "n/a [11;12]" 2829 "n/a [11;13]" 2830 "n/a [11;14]" 2831 "n/a [11;15]" 3072 "n/a [12;00]" 3073 "n/a [12;01]" 3074 "n/a [12;02]" 3075 "n/a [12;03]" 3076 "n/a [12;04]" 3077 "n/a [12;05]" 3078 "n/a [12;06]" 3079 "n/a [12;07]" 3080 "n/a [12;08]" 3081 "n/a [12;09]" 3082 "n/a [12;10]" 3083 "n/a [12;11]" 3084 "n/a [12;12]" 3085 "n/a [12;13]" 3086 "n/a [12;14]" 3087 "n/a [12;15]" 3328 "n/a [13;00]" 3329 "n/a [13;01]" 3330 "n/a [13;02]" 3331 "n/a [13;03]" 3332 "n/a [13;04]" 3333 "n/a [13;05]" 3334 "n/a [13;06]" 3335 "n/a [13;07]" 3336 "n/a [13;08]" 3337 "n/a [13;09]" 3338 "n/a [13;10]" 3339 "n/a [13;11]" 3340 "n/a [13;12]" 3341 "n/a [13;13]" 3342 "n/a [13;14]" 3343 "n/a [13;15]" 3584 "n/a [14;00]" 3585 "n/a [14;01]" 3586 "n/a [14;02]" 3587 "n/a [14;03]" 3588 "n/a [14;04]" 3589 "n/a [14;05]" 3590 "n/a [14;06]" 3591 "n/a [14;07]" 3592 "n/a [14;08]" 3593 "n/a [14;09]" 3594 "n/a [14;10]" 3595 "n/a [14;11]" 3596 "n/a [14;12]" 3597 "n/a [14;13]" 3598 "n/a [14;14]" 3599 "n/a [14;15]" 3840 "n/a [15;00]" 3841 "n/a [15;01]" 3842 "n/a [15;02]" 3843 "n/a [15;03]" 3844 "n/a [15;04]" 3845 "n/a [15;05]" 3846 "n/a [15;06]" 3847 "n/a [15;07]" 3848 "n/a [15;08]" 3849 "n/a [15;09]" 3850 "n/a [15;10]" 3851 "n/a [15;11]" 3852 "n/a [15;12]" 3853 "n/a [15;13]" 3854 "n/a [15;14]" 3855 "n/a [15;15]" 4096 "n/a [16;00]" 4097 "n/a [16;01]" 4098 "n/a [16;02]" 4099 "n/a [16;03]" 4100 "n/a [16;04]" 4101 "n/a [16;05]" 4102 "n/a [16;06]" 4103 "n/a [16;07]" 4104 "n/a [16;08]" 4105 "n/a [16;09]" 4106 "n/a [16;10]" 4107 "n/a [16;11]" 4108 "n/a [16;12]" 4109 "n/a [16;13]" 4110 "n/a [16;14]" 4111 "n/a [16;15]" 4352 "n/a [17;00]" 4353 "n/a [17;01]" 4354 "n/a [17;02]" 4355 "n/a [17;03]" 4356 "n/a [17;04]" 4357 "n/a [17;05]" 4358 "n/a [17;06]" 4359 "n/a [17;07]" 4360 "n/a [17;08]" 4361 "n/a [17;09]" 4362 "n/a [17;10]" 4363 "n/a [17;11]" 4364 "n/a [17;12]" 4365 "n/a [17;13]" 4366 "n/a [17;14]" 4367 "n/a [17;15]" 4608 "n/a [18;00]" 4609 "n/a [18;01]" 4610 "n/a [18;02]" 4611 "n/a [18;03]" 4612 "n/a [18;04]" 4613 "n/a [18;05]" 4614 "n/a [18;06]" 4615 "n/a [18;07]" 4616 "n/a [18;08]" 4617 "n/a [18;09]" 4618 "n/a [18;10]" 4619 "n/a [18;11]" 4620 "n/a [18;12]" 4621 "n/a [18;13]" 4622 "n/a [18;14]" 4623 "n/a [18;15]" 4864 "n/a [19;00]" 4865 "n/a [19;01]" 4866 "n/a [19;02]" 4867 "n/a [19;03]" 4868 "n/a [19;04]" 4869 "n/a [19;05]" 4870 "n/a [19;06]" 4871 "n/a [19;07]" 4872 "n/a [19;08]" 4873 "n/a [19;09]" 4874 "n/a [19;10]" 4875 "n/a [19;11]" 4876 "n/a [19;12]" 4877 "n/a [19;13]" 4878 "n/a [19;14]" 4879 "n/a [19;15]" 5120 "n/a [20;00]" 5121 "n/a [20;01]" 5122 "n/a [20;02]" 5123 "n/a [20;03]" 5124 "n/a [20;04]" 5125 "n/a [20;05]" 5126 "n/a [20;06]" 5127 "n/a [20;07]" 5128 "n/a [20;08]" 5129 "n/a [20;09]" 5130 "n/a [20;10]" 5131 "n/a [20;11]" 5132 "n/a [20;12]" 5133 "n/a [20;13]" 5134 "n/a [20;14]" 5135 "n/a [20;15]" 5376 "n/a [21;00]" 5377 "n/a [21;01]" 5378 "n/a [21;02]" 5379 "n/a [21;03]" 5380 "n/a [21;04]" 5381 "n/a [21;05]" 5382 "n/a [21;06]" 5383 "n/a [21;07]" 5384 "n/a [21;08]" 5385 "n/a [21;09]" 5386 "n/a [21;10]" 5387 "n/a [21;11]" 5388 "n/a [21;12]" 5389 "n/a [21;13]" 5390 "n/a [21;14]" 5391 "n/a [21;15]" 5632 "n/a [22;00]" 5633 "n/a [22;01]" 5634 "n/a [22;02]" 5635 "n/a [22;03]" 5636 "n/a [22;04]" 5637 "n/a [22;05]" 5638 "n/a [22;06]" 5639 "n/a [22;07]" 5640 "n/a [22;08]" 5641 "n/a [22;09]" 5642 "n/a [22;10]" 5643 "n/a [22;11]" 5644 "n/a [22;12]" 5645 "n/a [22;13]" 5646 "n/a [22;14]" 5647 "n/a [22;15]" 5888 "n/a [23;00]" 5889 "n/a [23;01]" 5890 "n/a [23;02]" 5891 "n/a [23;03]" 5892 "n/a [23;04]" 5893 "n/a [23;05]" 5894 "n/a [23;06]" 5895 "n/a [23;07]" 5896 "n/a [23;08]" 5897 "n/a [23;09]" 5898 "n/a [23;10]" 5899 "n/a [23;11]" 5900 "n/a [23;12]" 5901 "n/a [23;13]" 5902 "n/a [23;14]" 5903 "n/a [23;15]" 6144 "n/a [24;00]" 6145 "n/a [24;01]" 6146 "n/a [24;02]" 6147 "n/a [24;03]" 6148 "n/a [24;04]" 6149 "n/a [24;05]" 6150 "n/a [24;06]" 6151 "n/a [24;07]" 6152 "n/a [24;08]" 6153 "n/a [24;09]" 6154 "n/a [24;10]" 6155 "n/a [24;11]" 6156 "n/a [24;12]" 6157 "n/a [24;13]" 6158 "n/a [24;14]" 6159 "n/a [24;15]" 6400 "n/a [25;00]" 6401 "n/a [25;01]" 6402 "n/a [25;02]" 6403 "n/a [25;03]" 6404 "n/a [25;04]" 6405 "n/a [25;05]" 6406 "n/a [25;06]" 6407 "n/a [25;07]" 6408 "n/a [25;08]" 6409 "n/a [25;09]" 6410 "n/a [25;10]" 6411 "n/a [25;11]" 6412 "n/a [25;12]" 6413 "n/a [25;13]" 6414 "n/a [25;14]" 6415 "n/a [25;15]" 6656 "n/a [26;00]" 6657 "n/a [26;01]" 6658 "n/a [26;02]" 6659 "n/a [26;03]" 6660 "n/a [26;04]" 6661 "n/a [26;05]" 6662 "n/a [26;06]" 6663 "n/a [26;07]" 6664 "n/a [26;08]" 6665 "n/a [26;09]" 6666 "n/a [26;10]" 6667 "n/a [26;11]" 6668 "n/a [26;12]" 6669 "n/a [26;13]" 6670 "n/a [26;14]" 6671 "n/a [26;15]" 6912 "n/a [27;00]" 6913 "n/a [27;01]" 6914 "n/a [27;02]" 6915 "n/a [27;03]" 6916 "n/a [27;04]" 6917 "n/a [27;05]" 6918 "n/a [27;06]" 6919 "n/a [27;07]" 6920 "n/a [27;08]" 6921 "n/a [27;09]" 6922 "n/a [27;10]" 6923 "n/a [27;11]" 6924 "n/a [27;12]" 6925 "n/a [27;13]" 6926 "n/a [27;14]" 6927 "n/a [27;15]" 7168 "n/a [28;00]" 7169 "n/a [28;01]" 7170 "n/a [28;02]" 7171 "n/a [28;03]" 7172 "n/a [28;04]" 7173 "n/a [28;05]" 7174 "n/a [28;06]" 7175 "n/a [28;07]" 7176 "n/a [28;08]" 7177 "n/a [28;09]" 7178 "n/a [28;10]" 7179 "n/a [28;11]" 7180 "n/a [28;12]" 7181 "n/a [28;13]" 7182 "n/a [28;14]" 7183 "n/a [28;15]" 7424 "n/a [29;00]" 7425 "n/a [29;01]" 7426 "n/a [29;02]" 7427 "n/a [29;03]" 7428 "n/a [29;04]" 7429 "n/a [29;05]" 7430 "n/a [29;06]" 7431 "n/a [29;07]" 7432 "n/a [29;08]" 7433 "n/a [29;09]" 7434 "n/a [29;10]" 7435 "n/a [29;11]" 7436 "n/a [29;12]" 7437 "n/a [29;13]" 7438 "n/a [29;14]" 7439 "n/a [29;15]" 7680 "n/a [30;00]" 7681 "n/a [30;01]" 7682 "n/a [30;02]" 7683 "n/a [30;03]" 7684 "n/a [30;04]" 7685 "n/a [30;05]" 7686 "n/a [30;06]" 7687 "n/a [30;07]" 7688 "n/a [30;08]" 7689 "n/a [30;09]" 7690 "n/a [30;10]" 7691 "n/a [30;11]" 7692 "n/a [30;12]" 7693 "n/a [30;13]" 7694 "n/a [30;14]" 7695 "n/a [30;15]" 7936 "n/a [31;00]" 7937 "n/a [31;01]" 7938 "n/a [31;02]" 7939 "n/a [31;03]" 7940 "n/a [31;04]" 7941 "n/a [31;05]" 7942 "n/a [31;06]" 7943 "n/a [31;07]" 7944 "n/a [31;08]" 7945 "n/a [31;09]" 7946 "n/a [31;10]" 7947 "n/a [31;11]" 7948 "n/a [31;12]" 7949 "n/a [31;13]" 7950 "n/a [31;14]" 7951 "n/a [31;15]" /end COMPU_VTAB
/begin COMPU_METHOD CoEOM_SwtStgy1_sm_VERB "" TAB_VERB "%6.3" "" COMPU_TAB_REF CoEOM_SwtStgy1_sm_VERB /end COMPU_METHOD
/begin COMPU_VTAB CoEOM_SwtStgy1_sm_VERB "" TAB_VERB 3 0 "A_INACTV_STGY1" 1 "A_TMNG_STGY1" 2 "A_WAIT_STGY1" /end COMPU_VTAB
/begin COMPU_METHOD CoEOM_SwtStgy2_sm_VERB "" TAB_VERB "%6.3" "" COMPU_TAB_REF CoEOM_SwtStgy2_sm_VERB /end COMPU_METHOD
/begin COMPU_VTAB CoEOM_SwtStgy2_sm_VERB "" TAB_VERB 5 0 "A_INACTV_STGY2" 1 "A_FILLGPREPN_STGY2" 2 "A_TMNG_STGY2" 3 "A_TRIG_STGY2" 4 "A_WAIT_STGY2" /end COMPU_VTAB
/begin COMPU_METHOD CoEOM_SwtStgy5_sm_VERB "" TAB_VERB "%6.3" "" COMPU_TAB_REF CoEOM_SwtStgy5_sm_VERB /end COMPU_METHOD
/begin COMPU_VTAB CoEOM_SwtStgy5_sm_VERB "" TAB_VERB 4 0 "A_INACTV_STGY5" 1 "A_TMNG_STGY5" 2 "A_TRIG_STGY5" 3 "A_WAIT_STGY5" /end COMPU_VTAB
/begin COMPU_METHOD Com_aLgtG_Compu "" RAT_FUNC "%6.2" "Mtr_per_sec2" COEFFS 0 208980 5120000 0 0 10000 /end COMPU_METHOD
/begin COMPU_METHOD Com_EvaTemp_Compu "" RAT_FUNC "%1.0" "" COEFFS 0 1 30 0 0 1 /end COMPU_METHOD
/begin COMPU_METHOD Com_stSeatBltInfo_COMPU_VERB "" TAB_VERB "%6.3" "" COMPU_TAB_REF Com_stSeatBltInfo_COMPU_VERB /end COMPU_METHOD
/begin COMPU_VTAB Com_stSeatBltInfo_COMPU_VERB "" TAB_VERB 4 0 "UNABLE_TO_CONFIRM" 1 "SEATBELT_NOT_WEARING" 2 "SEATBELT_WEARING" 3 "SEATBELT_BUCKLESW_ERROR" /end COMPU_VTAB
/begin COMPU_METHOD Curr_A "" RAT_FUNC "%6.4" "A" COEFFS 0 100 0 0 0 1 /end COMPU_METHOD
/begin COMPU_METHOD dez "" RAT_FUNC "%6.2" "" COEFFS 0 1 0 0 0 1 /end COMPU_METHOD
/begin COMPU_METHOD DIABAS_CALIDCVNCTRL_SC_Compu "" TAB_VERB "%6.3" "" COMPU_TAB_REF DIABAS_CALIDCVNCTRL_SC_Compu /end COMPU_METHOD
/begin COMPU_VTAB DIABAS_CALIDCVNCTRL_SC_Compu "" TAB_VERB 3 0 "CALIDCVN_LEG" 1 "CALIDCVN_MIX" 2 "CALIDCVN_AUTO" /end COMPU_VTAB
/begin COMPU_METHOD DIABAS_CALIDCVNLENSEQ_SC_Compu "" RAT_FUNC "%6.2" "" COEFFS 0 1 0 0 0 1 /end COMPU_METHOD
/begin COMPU_METHOD DIABAS_CRCTAB_SY_Compu "" TAB_VERB "%6.3" "" COMPU_TAB_REF DIABAS_CRCTAB_SY_Compu /end COMPU_METHOD
/begin COMPU_VTAB DIABAS_CRCTAB_SY_Compu "" TAB_VERB 2 0 "False" 1 "True" /end COMPU_VTAB
/begin COMPU_METHOD DIABAS_DTCFILVERS_SC_Compu "" RAT_FUNC "%6.2" "" COEFFS 0 1 0 0 0 1 /end COMPU_METHOD
/begin COMPU_METHOD DIABAS_ETCINTSTATE_SC_Compu "" TAB_VERB "%6.3" "" COMPU_TAB_REF DIABAS_ETCINTSTATE_SC_Compu /end COMPU_METHOD
/begin COMPU_VTAB DIABAS_ETCINTSTATE_SC_Compu "" TAB_VERB 2 0 "False" 1 "True" /end COMPU_VTAB
/begin COMPU_METHOD DIABAS_IFFLOATSIG_SC_Compu "" TAB_VERB "%6.3" "" COMPU_TAB_REF DIABAS_IFFLOATSIG_SC_Compu /end COMPU_METHOD
/begin COMPU_VTAB DIABAS_IFFLOATSIG_SC_Compu "" TAB_VERB 2 0 "False" 1 "True" /end COMPU_VTAB
/begin COMPU_METHOD DIABAS_PNDRPRTMOD2_SC_Compu "" TAB_VERB "%6.3" "" COMPU_TAB_REF DIABAS_PNDRPRTMOD2_SC_Compu /end COMPU_METHOD
/begin COMPU_VTAB DIABAS_PNDRPRTMOD2_SC_Compu "" TAB_VERB 2 0 "False" 1 "True" /end COMPU_VTAB
/begin COMPU_METHOD DIABAS_PRMIDAUTVIEW_SC_Compu "" TAB_VERB "%6.3" "" COMPU_TAB_REF DIABAS_PRMIDAUTVIEW_SC_Compu /end COMPU_METHOD
/begin COMPU_VTAB DIABAS_PRMIDAUTVIEW_SC_Compu "" TAB_VERB 2 0 "False" 1 "True" /end COMPU_VTAB
/begin COMPU_METHOD DIABAS_SCRCTL_RCNT_RESET_SY_Compu "" TAB_VERB "%6.3" "" COMPU_TAB_REF DIABAS_SCRCTL_RCNT_RESET_SY_Compu /end COMPU_METHOD
/begin COMPU_VTAB DIABAS_SCRCTL_RCNT_RESET_SY_Compu "" TAB_VERB 2 0 "False" 1 "True" /end COMPU_VTAB
/begin COMPU_METHOD DIABAS_SRV8_SC_Compu "" RAT_FUNC "%6.2" "" COEFFS 0 1 0 0 0 1 /end COMPU_METHOD
/begin COMPU_METHOD DIABAS_VAR_SY_Compu "" TAB_VERB "%6.3" "" COMPU_TAB_REF DIABAS_VAR_SY_Compu /end COMPU_METHOD
/begin COMPU_VTAB DIABAS_VAR_SY_Compu "" TAB_VERB 53 0 "kein Kundenbezug" 1 "DAI" 3 "VWW" 4 "POR" 5 "AUD" 6 "OPE" 9 "FIA" 11 "BMW" 14 "PSA" 15 "REN" 17 "ALF" 18 "SAB" 19 "VOL" 20 "NIS" 21 "GMU" 22 "FOR" 26 "IMJ" 36 "MAN" 51 "SEA" 53 "CHR" 54 "JAG" 55 "ROL" 57 "FORD_EU_Diesel" 69 "FER" 72 "TOY" 123 "MIT" 147 "HYU" 159 "HON" 160 "MAZ" 183 "CU" 190 "LRG" 204 "VVW" 214 "AVT" 242 "Iveco" 243 "DMC" 248 "SUZ" 267 "SSANGYONG" 270 "KEF" 289 "AMG" 308 "TAT" 319 "MVM" 328 "MM" 339 "AML" 385 "UAES" 578 "AL" 590 "SCANIA" 658 "Isuzu" 760 "WEICHAI" 828 "RBCD" 898 "MFTBC" 999 "ALL" 2887 "Nonox" 9454 "Fuso" /end COMPU_VTAB
/begin COMPU_METHOD DIACPV_SY_Compu "" TAB_VERB "%6.3" "" COMPU_TAB_REF DIACPV_SY_Compu /end COMPU_METHOD
/begin COMPU_VTAB DIACPV_SY_Compu "" TAB_VERB 9 0 "No CPV diagnosis" 1 "01 only %DTEV-based incl. passive check" 2 "02 %DTEV-based without passive check" 11 "11 only tank presure sensor based" 12 "12 tank pressure sensor based + add on %DTEV" 16 "CPV-check with DTESP" 21 "21 only based on DMTL-pump" 22 "CPV-check with DMTL or DTEV-based" 30 "Canister_purge_valve_check_with_cross_correlation" /end COMPU_VTAB
/begin COMPU_METHOD DIADEM_SY_Compu "" TAB_VERB "%6.3" "" COMPU_TAB_REF DIADEM_SY_Compu /end COMPU_METHOD
/begin COMPU_VTAB DIADEM_SY_Compu "" TAB_VERB 2 0 "False" 1 "True" /end COMPU_VTAB
/begin COMPU_METHOD DIAGADAPT_SC_Compu "" TAB_VERB "%6.3" "" COMPU_TAB_REF DIAGADAPT_SC_Compu /end COMPU_METHOD
/begin COMPU_VTAB DIAGADAPT_SC_Compu "" TAB_VERB 2 0 "False" 1 "True" /end COMPU_VTAB
/begin COMPU_METHOD DIAGCOM_CALCAN_SC_Compu "" TAB_VERB "%6.3" "" COMPU_TAB_REF DIAGCOM_CALCAN_SC_Compu /end COMPU_METHOD
/begin COMPU_VTAB DIAGCOM_CALCAN_SC_Compu "" TAB_VERB 2 0 "False" 1 "True" /end COMPU_VTAB
/begin COMPU_METHOD DIAGCOM_CANFD_SC_Compu "" TAB_VERB "%6.3" "" COMPU_TAB_REF DIAGCOM_CANFD_SC_Compu /end COMPU_METHOD
/begin COMPU_VTAB DIAGCOM_CANFD_SC_Compu "" TAB_VERB 2 0 "False" 1 "True" /end COMPU_VTAB
/begin COMPU_METHOD DIAGCOM_RDPI_SY_Compu "" TAB_VERB "%6.3" "" COMPU_TAB_REF DIAGCOM_RDPI_SY_Compu /end COMPU_METHOD
/begin COMPU_VTAB DIAGCOM_RDPI_SY_Compu "" TAB_VERB 2 0 "0" 1 "1" /end COMPU_VTAB
/begin COMPU_METHOD DIAGCOM_RESPONEVT_SY_Compu "" TAB_VERB "%6.3" "" COMPU_TAB_REF DIAGCOM_RESPONEVT_SY_Compu /end COMPU_METHOD
/begin COMPU_VTAB DIAGCOM_RESPONEVT_SY_Compu "" TAB_VERB 2 0 "FALSE" 1 "TRUE" /end COMPU_VTAB
/begin COMPU_METHOD DIAGCOM_RINGBUF_SY_Compu "" TAB_VERB "%6.3" "" COMPU_TAB_REF DIAGCOM_RINGBUF_SY_Compu /end COMPU_METHOD
/begin COMPU_VTAB DIAGCOM_RINGBUF_SY_Compu "" TAB_VERB 2 0 "False" 1 "True" /end COMPU_VTAB
/begin COMPU_METHOD DIAGCPV1DMTLHILOAD_SC_Compu "" TAB_VERB "%6.3" "" COMPU_TAB_REF DIAGCPV1DMTLHILOAD_SC_Compu /end COMPU_METHOD
/begin COMPU_VTAB DIAGCPV1DMTLHILOAD_SC_Compu "" TAB_VERB 2 0 "False" 1 "True" /end COMPU_VTAB
/begin COMPU_METHOD DIAGCPV1DMTLLOLOAD_SC_Compu "" TAB_VERB "%6.3" "" COMPU_TAB_REF DIAGCPV1DMTLLOLOAD_SC_Compu /end COMPU_METHOD
/begin COMPU_VTAB DIAGCPV1DMTLLOLOAD_SC_Compu "" TAB_VERB 2 0 "False" 1 "True" /end COMPU_VTAB
/begin COMPU_METHOD DIAGCPV1DTESKLOLOAD_SC_Compu "" TAB_VERB "%6.3" "" COMPU_TAB_REF DIAGCPV1DTESKLOLOAD_SC_Compu /end COMPU_METHOD
/begin COMPU_VTAB DIAGCPV1DTESKLOLOAD_SC_Compu "" TAB_VERB 2 0 "False" 1 "True" /end COMPU_VTAB
/begin COMPU_METHOD DIAGCPV1PSNSRHILOAD_SC_Compu "" TAB_VERB "%6.3" "" COMPU_TAB_REF DIAGCPV1PSNSRHILOAD_SC_Compu /end COMPU_METHOD
/begin COMPU_VTAB DIAGCPV1PSNSRHILOAD_SC_Compu "" TAB_VERB 2 0 "False" 1 "True" /end COMPU_VTAB
/begin COMPU_METHOD DIAGCPV1PSNSRLOLOAD_SC_Compu "" TAB_VERB "%6.3" "" COMPU_TAB_REF DIAGCPV1PSNSRLOLOAD_SC_Compu /end COMPU_METHOD
/begin COMPU_VTAB DIAGCPV1PSNSRLOLOAD_SC_Compu "" TAB_VERB 2 0 "False" 1 "True" /end COMPU_VTAB
/begin COMPU_METHOD DIAGCPV2PSNSRHILOAD_SC_Compu "" TAB_VERB "%6.3" "" COMPU_TAB_REF DIAGCPV2PSNSRHILOAD_SC_Compu /end COMPU_METHOD
/begin COMPU_VTAB DIAGCPV2PSNSRHILOAD_SC_Compu "" TAB_VERB 2 0 "False" 1 "True" /end COMPU_VTAB
/begin COMPU_METHOD DIAGCPV2PSNSRLOLOAD_SC_Compu "" TAB_VERB "%6.3" "" COMPU_TAB_REF DIAGCPV2PSNSRLOLOAD_SC_Compu /end COMPU_METHOD
/begin COMPU_VTAB DIAGCPV2PSNSRLOLOAD_SC_Compu "" TAB_VERB 2 0 "False" 1 "True" /end COMPU_VTAB
/begin COMPU_METHOD DIAGFUSPLYERRDEB_SC_Compu "" TAB_VERB "%6.3" "" COMPU_TAB_REF DIAGFUSPLYERRDEB_SC_Compu /end COMPU_METHOD
/begin COMPU_VTAB DIAGFUSPLYERRDEB_SC_Compu "" TAB_VERB 3 0 "0" 1 "1" 2 "2" /end COMPU_VTAB
/begin COMPU_METHOD DIAGFUTANKEMPTY_SC_Compu "" TAB_VERB "%6.3" "" COMPU_TAB_REF DIAGFUTANKEMPTY_SC_Compu /end COMPU_METHOD
/begin COMPU_VTAB DIAGFUTANKEMPTY_SC_Compu "" TAB_VERB 2 0 "False" 1 "True" /end COMPU_VTAB
/begin COMPU_METHOD DIASRV_INF78_SC_Compu "" TAB_VERB "%6.3" "" COMPU_TAB_REF DIASRV_INF78_SC_Compu /end COMPU_METHOD
/begin COMPU_VTAB DIASRV_INF78_SC_Compu "" TAB_VERB 2 0 "False" 1 "True" /end COMPU_VTAB
/begin COMPU_METHOD DIBOX_SY_Compu "" TAB_VERB "%6.3" "" COMPU_TAB_REF DIBOX_SY_Compu /end COMPU_METHOD
/begin COMPU_VTAB DIBOX_SY_Compu "" TAB_VERB 2 0 "False" 1 "True" /end COMPU_VTAB
/begin COMPU_METHOD DifCoef_COMPU "" RAT_FUNC "%6.2" "J/m/K/s" COEFFS 0 1 0 0 0 1 /end COMPU_METHOD
/begin COMPU_METHOD DifCoef_q0p0001_COMPU "" RAT_FUNC "%7.6" "J/m/K/s" COEFFS 0 10000 0 0 0 1 /end COMPU_METHOD
/begin COMPU_METHOD DIFFPRT_SY_Compu "" TAB_VERB "%6.3" "" COMPU_TAB_REF DIFFPRT_SY_Compu /end COMPU_METHOD
/begin COMPU_VTAB DIFFPRT_SY_Compu "" TAB_VERB 2 0 "FALSE" 1 "TRUE" /end COMPU_VTAB
/begin COMPU_METHOD DIFFRAT_SC_Compu "" TAB_VERB "%6.3" "" COMPU_TAB_REF DIFFRAT_SC_Compu /end COMPU_METHOD
/begin COMPU_VTAB DIFFRAT_SC_Compu "" TAB_VERB 2 0 "False" 1 "True" /end COMPU_VTAB
/begin COMPU_METHOD DINH_DEF25DEB0DI_SC_Compu "" TAB_VERB "%6.3" "" COMPU_TAB_REF DINH_DEF25DEB0DI_SC_Compu /end COMPU_METHOD
/begin COMPU_VTAB DINH_DEF25DEB0DI_SC_Compu "" TAB_VERB 2 0 "False" 1 "True" /end COMPU_VTAB
/begin COMPU_METHOD DINH_FID_VIEW_SC_Compu "" TAB_VERB "%6.3" "" COMPU_TAB_REF DINH_FID_VIEW_SC_Compu /end COMPU_METHOD
/begin COMPU_VTAB DINH_FID_VIEW_SC_Compu "" TAB_VERB 2 0 "False" 1 "True" /end COMPU_VTAB
/begin COMPU_METHOD DINH_NEWTRIPWITHFCMCLR_SC_Compu "" TAB_VERB "%6.3" "" COMPU_TAB_REF DINH_NEWTRIPWITHFCMCLR_SC_Compu /end COMPU_METHOD
/begin COMPU_VTAB DINH_NEWTRIPWITHFCMCLR_SC_Compu "" TAB_VERB 2 0 "False" 1 "True" /end COMPU_VTAB
/begin COMPU_METHOD DIPO_SY_Compu "" TAB_VERB "%6.3" "" COMPU_TAB_REF DIPO_SY_Compu /end COMPU_METHOD
/begin COMPU_VTAB DIPO_SY_Compu "" TAB_VERB 2 0 "0" 1 "1" /end COMPU_VTAB
/begin COMPU_METHOD DISTAB_SY_Compu "" TAB_VERB "%6.3" "" COMPU_TAB_REF DISTAB_SY_Compu /end COMPU_METHOD
/begin COMPU_VTAB DISTAB_SY_Compu "" TAB_VERB 2 0 "No Distab" 1 "Distab" /end COMPU_VTAB
/begin COMPU_METHOD DIUMPR_500MD_SY_Compu "" TAB_VERB "%6.3" "" COMPU_TAB_REF DIUMPR_500MD_SY_Compu /end COMPU_METHOD
/begin COMPU_VTAB DIUMPR_500MD_SY_Compu "" TAB_VERB 2 0 "0" 1 "1" /end COMPU_VTAB
/begin COMPU_METHOD DIUMPR_COLDSTARTDEN_SC_Compu "" TAB_VERB "%6.3" "" COMPU_TAB_REF DIUMPR_COLDSTARTDEN_SC_Compu /end COMPU_METHOD
/begin COMPU_VTAB DIUMPR_COLDSTARTDEN_SC_Compu "" TAB_VERB 2 0 "False" 1 "True" /end COMPU_VTAB
/begin COMPU_METHOD DIUMPR_DATAFROMCAN_SC_Compu "" TAB_VERB "%6.3" "" COMPU_TAB_REF DIUMPR_DATAFROMCAN_SC_Compu /end COMPU_METHOD
/begin COMPU_VTAB DIUMPR_DATAFROMCAN_SC_Compu "" TAB_VERB 2 0 "False" 1 "True" /end COMPU_VTAB
/begin COMPU_METHOD DIUMPR_DENOMCDN_SC_Compu "" TAB_VERB "%6.3" "" COMPU_TAB_REF DIUMPR_DENOMCDN_SC_Compu /end COMPU_METHOD
/begin COMPU_VTAB DIUMPR_DENOMCDN_SC_Compu "" TAB_VERB 3 0 "DenomConds_Local" 1 "DenomConds_DSMApl" 2 "DenomConds_AutosarApi" /end COMPU_VTAB
/begin COMPU_METHOD DIUMPR_DSTTRVLDSNCERST_SC_Compu "" TAB_VERB "%6.3" "" COMPU_TAB_REF DIUMPR_DSTTRVLDSNCERST_SC_Compu /end COMPU_METHOD
/begin COMPU_VTAB DIUMPR_DSTTRVLDSNCERST_SC_Compu "" TAB_VERB 2 0 "False" 1 "True" /end COMPU_VTAB
/begin COMPU_METHOD DIUMPR_EVAPDENOMTIPRPSYSOFF_SC_Compu "" TAB_VERB "%6.3" "" COMPU_TAB_REF DIUMPR_EVAPDENOMTIPRPSYSOFF_SC_Compu /end COMPU_METHOD
/begin COMPU_VTAB DIUMPR_EVAPDENOMTIPRPSYSOFF_SC_Compu "" TAB_VERB 2 0 "False" 1 "True" /end COMPU_VTAB
/begin COMPU_METHOD DIUMPR_EVAPDEN_SY_Compu "" TAB_VERB "%6.3" "" COMPU_TAB_REF DIUMPR_EVAPDEN_SY_Compu /end COMPU_METHOD
/begin COMPU_VTAB DIUMPR_EVAPDEN_SY_Compu "" TAB_VERB 2 0 "False" 1 "True" /end COMPU_VTAB
/begin COMPU_METHOD DIUMPR_FUENGOPERTI_SC_Compu "" TAB_VERB "%6.3" "" COMPU_TAB_REF DIUMPR_FUENGOPERTI_SC_Compu /end COMPU_METHOD
/begin COMPU_VTAB DIUMPR_FUENGOPERTI_SC_Compu "" TAB_VERB 2 0 "False" 1 "True" /end COMPU_VTAB
/begin COMPU_METHOD DIUMPR_IGNCYCTMR_SC_Compu "" TAB_VERB "%6.3" "" COMPU_TAB_REF DIUMPR_IGNCYCTMR_SC_Compu /end COMPU_METHOD
/begin COMPU_VTAB DIUMPR_IGNCYCTMR_SC_Compu "" TAB_VERB 2 0 "False" 1 "True" /end COMPU_VTAB
/begin COMPU_METHOD DIUMPR_NUMDENOMIDXGRP_SY_Compu "" TAB_VERB "%6.3" "" COMPU_TAB_REF DIUMPR_NUMDENOMIDXGRP_SY_Compu /end COMPU_METHOD
/begin COMPU_VTAB DIUMPR_NUMDENOMIDXGRP_SY_Compu "" TAB_VERB 2 0 "False" 1 "True" /end COMPU_VTAB
/begin COMPU_METHOD DKPROSG_SY_Compu "" TAB_VERB "%6.3" "" COMPU_TAB_REF DKPROSG_SY_Compu /end COMPU_METHOD
/begin COMPU_VTAB DKPROSG_SY_Compu "" TAB_VERB 4 0 "NODK" 1 "1DK" 2 "2DK" 3 "3DK" /end COMPU_VTAB
/begin COMPU_METHOD DKVSTDFC_SC_Compu "" TAB_VERB "%6.3" "" COMPU_TAB_REF DKVSTDFC_SC_Compu /end COMPU_METHOD
/begin COMPU_VTAB DKVSTDFC_SC_Compu "" TAB_VERB 2 0 "False" 1 "True" /end COMPU_VTAB
/begin COMPU_METHOD DLLR_CSERSACTV2_SC_Compu "" TAB_VERB "%6.3" "" COMPU_TAB_REF DLLR_CSERSACTV2_SC_Compu /end COMPU_METHOD
/begin COMPU_VTAB DLLR_CSERSACTV2_SC_Compu "" TAB_VERB 2 0 "FALSE" 1 "TRUE" /end COMPU_VTAB
/begin COMPU_METHOD DLLR_CSERSACTV_SC_Compu "" TAB_VERB "%6.3" "" COMPU_TAB_REF DLLR_CSERSACTV_SC_Compu /end COMPU_METHOD
/begin COMPU_VTAB DLLR_CSERSACTV_SC_Compu "" TAB_VERB 2 0 "False" 1 "True" /end COMPU_VTAB
/begin COMPU_METHOD dmNOx_mg_p_s "" RAT_FUNC "%6.3" "mg/s" COEFFS 0 6.66666666666667 0 0 0 1 /end COMPU_METHOD
/begin COMPU_METHOD dmOilAsh_mg_p_s "" RAT_FUNC "%6.4" "mg/s" COEFFS 0 100 0 0 0 1 /end COMPU_METHOD
/begin COMPU_METHOD dmSoot_g_p_s "" RAT_FUNC "%7.6" "g/s" COEFFS 0 10000 0 0 0 1 /end COMPU_METHOD
/begin COMPU_METHOD dmSoot_mg_p_s "" RAT_FUNC "%6.4" "mg/s" COEFFS 0 100 0 0 0 1 /end COMPU_METHOD
/begin COMPU_METHOD DOCU_VAR_SY_Compu "" TAB_VERB "%6.3" "" COMPU_TAB_REF DOCU_VAR_SY_Compu /end COMPU_METHOD
/begin COMPU_VTAB DOCU_VAR_SY_Compu "" TAB_VERB 42 1 "DAI" 3 "VWW" 4 "POR" 5 "AUD" 6 "OPE" 9 "FIA" 11 "BMW" 14 "PSA" 15 "REN" 17 "ALF" 18 "SAB" 19 "VOL" 20 "NIS" 21 "GMU" 22 "FOR" 26 "IMJ" 36 "MAN" 51 "SEA" 53 "CHR" 54 "JAG" 55 "ROL" 69 "FER" 72 "TOY" 123 "MIT" 147 "HYU" 159 "HON" 160 "MAZ" 183 "CU" 190 "LRG" 204 "VVW" 214 "AVT" 242 "Iveco" 243 "DMC" 248 "SUZ" 267 "SSANGYONG" 289 "AMG" 308 "TAT" 319 "MVM" 385 "UAES" 828 "RBCD" 999 "ALL" 9454 "Fuso" /end COMPU_VTAB
/begin COMPU_METHOD DOGOVFLT_SY_Compu "" TAB_VERB "%6.3" "" COMPU_TAB_REF DOGOVFLT_SY_Compu /end COMPU_METHOD
/begin COMPU_VTAB DOGOVFLT_SY_Compu "" TAB_VERB 2 0 "ZERO" 1 "ACTIV" /end COMPU_VTAB
/begin COMPU_METHOD DOGOVSUP_INHOUSE_SC_Compu "" TAB_VERB "%6.3" "" COMPU_TAB_REF DOGOVSUP_INHOUSE_SC_Compu /end COMPU_METHOD
/begin COMPU_VTAB DOGOVSUP_INHOUSE_SC_Compu "" TAB_VERB 2 0 "False" 1 "True" /end COMPU_VTAB
/begin COMPU_METHOD DOGOVTYP_SY_Compu "" TAB_VERB "%6.3" "" COMPU_TAB_REF DOGOVTYP_SY_Compu /end COMPU_METHOD
/begin COMPU_VTAB DOGOVTYP_SY_Compu "" TAB_VERB 5 0 "0" 1 "1" 2 "2" 3 "3" 4 "4" /end COMPU_VTAB
/begin COMPU_METHOD DOGOV_CLUSIG_SC_Compu "" TAB_VERB "%6.3" "" COMPU_TAB_REF DOGOV_CLUSIG_SC_Compu /end COMPU_METHOD
/begin COMPU_VTAB DOGOV_CLUSIG_SC_Compu "" TAB_VERB 2 0 "False" 1 "True" /end COMPU_VTAB
/begin COMPU_METHOD DOGOV_SY_Compu "" TAB_VERB "%6.3" "" COMPU_TAB_REF DOGOV_SY_Compu /end COMPU_METHOD
/begin COMPU_VTAB DOGOV_SY_Compu "" TAB_VERB 2 0 "False" 1 "True" /end COMPU_VTAB
/begin COMPU_METHOD DOIP_SC_Compu "" TAB_VERB "%6.3" "" COMPU_TAB_REF DOIP_SC_Compu /end COMPU_METHOD
/begin COMPU_VTAB DOIP_SC_Compu "" TAB_VERB 2 0 "INACTIVE" 1 "ACTIVE" /end COMPU_VTAB
/begin COMPU_METHOD EngN "" RAT_FUNC "%6.3" "rpm" COEFFS 0 2 0 0 0 1 /end COMPU_METHOD
/begin COMPU_METHOD Epm_stSync_State_t "" TAB_VERB "%6.3" "" COMPU_TAB_REF Epm_stSync_State_t /end COMPU_METHOD
/begin COMPU_VTAB Epm_stSync_State_t "" TAB_VERB 5 0 "EPM_NO_SYNC" 10 "EPM_ALE_SYNC" 20 "EPM_CAS_SYNC" 21 "EPM_DIRSTALE_SYNC" 30 "EPM_FULL_SYNC" /end COMPU_VTAB
/begin COMPU_METHOD Fact "" RAT_FUNC "%6.5" "-" COEFFS 0 8192 0 0 0 1 /end COMPU_METHOD
/begin COMPU_METHOD Fact1 "" RAT_FUNC "%6.4" "-" COEFFS 0 128 0 0 0 1 /end COMPU_METHOD
/begin COMPU_METHOD fak_ub_b2 "" RAT_FUNC "%8.5" "-" COEFFS 0 256 0 0 0 2 /end COMPU_METHOD
/begin COMPU_METHOD FlConsum_l_h "" RAT_FUNC "%6.4" "l/h" COEFFS 0 100 0 0 0 1 /end COMPU_METHOD
/begin COMPU_METHOD i_q1_mA "" RAT_FUNC "%6.2" "mA" COEFFS 0 1 0 0 0 1 /end COMPU_METHOD
/begin COMPU_METHOD md_q0p1 "" RAT_FUNC "%6.3" "Nm" COEFFS 0 10 0 0 0 1 /end COMPU_METHOD
/begin COMPU_METHOD nmot_ub_q40 "" RAT_FUNC "%6.1" "1/min" COEFFS 0 1 0 0 0 40 /end COMPU_METHOD
/begin COMPU_METHOD OneToOne "" RAT_FUNC "%6.2" "-" COEFFS 0 1 0 0 0 1 /end COMPU_METHOD
/begin COMPU_METHOD Prc "" RAT_FUNC "%6.4" "%" COEFFS 0 81.92 0 0 0 1 /end COMPU_METHOD
/begin COMPU_METHOD PrcPerSec "" RAT_FUNC "%6.3" "%/s" COEFFS 0 1.6384 0 0 0 1 /end COMPU_METHOD
/begin COMPU_METHOD Pres_hPa "" RAT_FUNC "%6.2" "hPa" COEFFS 0 1 0 0 0 1 /end COMPU_METHOD
/begin COMPU_METHOD RBPtCel_tq_1p0_1 "" RAT_FUNC "%6.2" "Nm" COEFFS 0 1 0 0 0 1 /end COMPU_METHOD
/begin COMPU_METHOD rel_q0p003052_pc_DIV_s "" RAT_FUNC "%6.4" "%/s" COEFFS 0 65536 0 0 0 200 /end COMPU_METHOD
/begin COMPU_METHOD rel_q0p0234 "" RAT_FUNC "%6.4" "%" COEFFS 0 128 0 0 0 3 /end COMPU_METHOD
/begin COMPU_METHOD rel_q0p02344 "" RAT_FUNC "%6.4" "%" COEFFS 0 32 0 0 0 0.75 /end COMPU_METHOD
/begin COMPU_METHOD rel_ub_b100 "" RAT_FUNC "%6.3" "%" COEFFS 0 256 0 0 0 100 /end COMPU_METHOD
/begin COMPU_METHOD RmpVoltBatt "" RAT_FUNC "%6.3" "mV/s" COEFFS 0 3.2768 0 0 0 1 /end COMPU_METHOD
/begin COMPU_METHOD spg_q0p001 "" RAT_FUNC "%6.5" "V" COEFFS 0 1000 0 0 0 1 /end COMPU_METHOD
/begin COMPU_METHOD spg_q0p001_op10_V "" RAT_FUNC "%6.2" "V" COEFFS 0 1000 -10000 0 0 1 /end COMPU_METHOD
/begin COMPU_METHOD spg_uw_b5 "" RAT_FUNC "%6.4" "V" COEFFS 0 1024 0 0 0 5 /end COMPU_METHOD
/begin COMPU_METHOD TempDiff_Kelv "" RAT_FUNC "%6.3" "K" COEFFS 0 10 0 0 0 1 /end COMPU_METHOD
/begin COMPU_METHOD Temp_Cels "" RAT_FUNC "%6.1" "deg C" COEFFS 0 10 2731.4 0 0 1 /end COMPU_METHOD
/begin COMPU_METHOD Temp_Fatc "" RAT_FUNC "%6.2" "degC" COEFFS 0 2 80 0 0 1 /end COMPU_METHOD
/begin COMPU_METHOD temp_q0p0234 "" RAT_FUNC "%6.4" "K" COEFFS 0 256 0 0 0 6 /end COMPU_METHOD
/begin COMPU_METHOD temp_q0p5_o30_degC "" RAT_FUNC "%6.2" "deg C" COEFFS 0 2 60 0 0 1 /end COMPU_METHOD
/begin COMPU_METHOD TimeDeb "" RAT_FUNC "%6.1" "ms" COEFFS 0 0.1 0 0 0 1 /end COMPU_METHOD
/begin COMPU_METHOD TimeDelay_s "" RAT_FUNC "%6.1" "s" COEFFS 0 0 1 0 0.00023283064365387 0 /end COMPU_METHOD
/begin COMPU_METHOD Time_ms "" RAT_FUNC "%6.1" "ms" COEFFS 0 0.1 0 0 0 1 /end COMPU_METHOD
/begin COMPU_METHOD Time_s "" RAT_FUNC "%6.4" "s" COEFFS 0 100 0 0 0 1 /end COMPU_METHOD
/begin COMPU_METHOD Time_Second "" RAT_FUNC "%6.2" "s" COEFFS 0 1 0 0 0 1 /end COMPU_METHOD
/begin COMPU_METHOD Trq "" RAT_FUNC "%6.3" "Nm" COEFFS 0 10 0 0 0 1 /end COMPU_METHOD
/begin COMPU_METHOD TrqPerSec "" RAT_FUNC "%6.2" "Nm/s" COEFFS 0 1 0 0 0 1 /end COMPU_METHOD
/begin COMPU_METHOD Vel "" RAT_FUNC "%6.4" "km/h" COEFFS 0 100 0 0 0 1 /end COMPU_METHOD
/begin COMPU_METHOD Volt_Batt "" RAT_FUNC "%6.1" "mV" COEFFS 0 0.05 0 0 0 1 /end COMPU_METHOD
/begin COMPU_METHOD Volt_q1 "" RAT_FUNC "%6.2" "V" COEFFS 0 1 0 0 0 1 /end COMPU_METHOD
/begin COMPU_METHOD YawRate_q0p2441_om125 "" RAT_FUNC "%6.3" "Deg/s" COEFFS 0 1023 127875 0 0 249.7559 /end COMPU_METHOD
/begin RECORD_LAYOUT RB_Axis_S16 NO_AXIS_PTS_X 1 SWORD AXIS_PTS_X 2 SWORD INDEX_INCR DIRECT /end RECORD_LAYOUT
/begin RECORD_LAYOUT RB_Axis_U16 NO_AXIS_PTS_X 1 UWORD AXIS_PTS_X 2 UWORD INDEX_INCR DIRECT /end RECORD_LAYOUT
/begin RECORD_LAYOUT RB_CurveGroup_S16 FNC_VALUES 1 SWORD COLUMN_DIR DIRECT /end RECORD_LAYOUT
/begin RECORD_LAYOUT RB_Curve_S16_S16 NO_AXIS_PTS_X 1 SWORD AXIS_PTS_X 2 SWORD INDEX_INCR DIRECT FNC_VALUES 3 SWORD COLUMN_DIR DIRECT /end RECORD_LAYOUT
/begin RECORD_LAYOUT RB_Curve_U8_U8 NO_AXIS_PTS_X 1 UBYTE AXIS_PTS_X 2 UBYTE INDEX_INCR DIRECT FNC_VALUES 3 UBYTE COLUMN_DIR DIRECT /end RECORD_LAYOUT
/begin RECORD_LAYOUT RB_Map_S16S16_S16 NO_AXIS_PTS_X 1 SWORD NO_AXIS_PTS_Y 2 SWORD AXIS_PTS_X 3 SWORD INDEX_INCR DIRECT AXIS_PTS_Y 4 SWORD INDEX_INCR DIRECT FNC_VALUES 5 SWORD COLUMN_DIR DIRECT /end RECORD_LAYOUT
/begin RECORD_LAYOUT RB_Map_S16S16_U16 NO_AXIS_PTS_X 1 SWORD NO_AXIS_PTS_Y 2 SWORD AXIS_PTS_X 3 SWORD INDEX_INCR DIRECT AXIS_PTS_Y 4 SWORD INDEX_INCR DIRECT FNC_VALUES 5 UWORD COLUMN_DIR DIRECT /end RECORD_LAYOUT
/begin RECORD_LAYOUT RB_Map_U16S16_S16 NO_AXIS_PTS_X 1 UWORD NO_AXIS_PTS_Y 2 UWORD AXIS_PTS_X 3 UWORD INDEX_INCR DIRECT AXIS_PTS_Y 4 SWORD INDEX_INCR DIRECT FNC_VALUES 5 SWORD COLUMN_DIR DIRECT /end RECORD_LAYOUT
/begin RECORD_LAYOUT RB_Map_U8U8_U8 NO_AXIS_PTS_X 1 UBYTE NO_AXIS_PTS_Y 2 UBYTE AXIS_PTS_X 3 UBYTE INDEX_INCR DIRECT AXIS_PTS_Y 4 UBYTE INDEX_INCR DIRECT FNC_VALUES 5 UBYTE COLUMN_DIR DIRECT /end RECORD_LAYOUT
/begin RECORD_LAYOUT RB_ValA_Wu16 FNC_VALUES 1 UWORD COLUMN_DIR DIRECT /end RECORD_LAYOUT
/begin RECORD_LAYOUT RB_Val_Ws16 FNC_VALUES 1 SWORD COLUMN_DIR DIRECT /end RECORD_LAYOUT
/begin RECORD_LAYOUT RB_Val_Ws32 FNC_VALUES 1 SLONG COLUMN_DIR DIRECT /end RECORD_LAYOUT
/begin RECORD_LAYOUT RB_Val_Wu16 FNC_VALUES 1 UWORD COLUMN_DIR DIRECT /end RECORD_LAYOUT
/begin RECORD_LAYOUT RB_Val_Wu8 FNC_VALUES 1 UBYTE COLUMN_DIR DIRECT /end RECORD_LAYOUT
/begin RECORD_LAYOUT ValA_Wu8 FNC_VALUES 1 UBYTE COLUMN_DIR DIRECT /end RECORD_LAYOUT
/begin RECORD_LAYOUT Val_Wu16 FNC_VALUES 1 UWORD COLUMN_DIR DIRECT /end RECORD_LAYOUT
/begin RECORD_LAYOUT Val_Wu8 FNC_VALUES 1 UBYTE COLUMN_DIR DIRECT /end RECORD_LAYOUT
/end MODULE
/end PROJECT
