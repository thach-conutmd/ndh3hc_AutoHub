ASAP2_VERSION 1 60
/begin PROJECT MG1CA020 "MG1CA020"
/begin HEADER "" VERSION "MG1CA020_6SAY_V011_TPROT" PROJECT_NO MG1CA020 /end HEADER
/begin MODULE DIM ""
/begin MOD_COMMON "" BYTE_ORDER MSB_LAST ALIGNMENT_BYTE 1 ALIGNMENT_WORD 2 ALIGNMENT_LONG 4 ALIGNMENT_INT64 4 ALIGNMENT_FLOAT32_IEEE 4 ALIGNMENT_FLOAT64_IEEE 4 DATA_SIZE 32 /end MOD_COMMON
/begin CHARACTERISTIC CrCtl_facACCECOffAResUp3_MAP "Acceleration factor for changing APP limitation number for ECON to 4 from 3 (for Resume, ECON sw OFF, and during ACC)" MAP 0x80515F0A Map_Xs16Ys16Ws16 0.9960938 Fact_CrCtl 0.00 0.9960938 FORMAT "%9.7" EXTENDED_LIMITS -128.0000 127.9961
 /begin AXIS_DESCR STD_AXIS CrCtl_tiDRAccnControl_mp Time_ms_100ms 6 -3276800. 3276700. FORMAT "%8.0" DEPOSIT ABSOLUTE /end AXIS_DESCR
 /begin AXIS_DESCR STD_AXIS CrCtl_vSpdVar_mp Vel_CrCtl 6 -128.0000 127.9961 FORMAT "%8.4" DEPOSIT ABSOLUTE /end AXIS_DESCR
/end CHARACTERISTIC
/begin CHARACTERISTIC CrCtl_facACCECOffAResUp4_MAP "Acceleration factor for changing APP limitation number for ECON to 5 from 4 (for Resume, ECON sw OFF, and during ACC)" MAP 0x80515F6E Map_Xs16Ys16Ws16 0.9960938 Fact_CrCtl 0.00 0.9960938 FORMAT "%9.7" EXTENDED_LIMITS -128.0000 127.9961
 /begin AXIS_DESCR STD_AXIS CrCtl_tiDRAccnControl_mp Time_ms_100ms 6 -3276800. 3276700. FORMAT "%8.0" DEPOSIT ABSOLUTE /end AXIS_DESCR
 /begin AXIS_DESCR STD_AXIS CrCtl_vSpdVar_mp Vel_CrCtl 6 -128.0000 127.9961 FORMAT "%8.4" DEPOSIT ABSOLUTE /end AXIS_DESCR
/end CHARACTERISTIC
/begin CHARACTERISTIC CrCtl_facACCECOffAResUp5_MAP "Acceleration factor for changing APP limitation number for ECON to 2 from 1 (for Resume, ECON sw ON, and during ACC)" MAP 0x80515FD2 Map_Xs16Ys16Ws16 0.9960938 Fact_CrCtl 0.00 0.9960938 FORMAT "%9.7" EXTENDED_LIMITS -128.0000 127.9961
 /begin AXIS_DESCR STD_AXIS CrCtl_tiDRAccnControl_mp Time_ms_100ms 6 -3276800. 3276700. FORMAT "%8.0" DEPOSIT ABSOLUTE /end AXIS_DESCR
 /begin AXIS_DESCR STD_AXIS CrCtl_vSpdVar_mp Vel_CrCtl 6 -128.0000 127.9961 FORMAT "%8.4" DEPOSIT ABSOLUTE /end AXIS_DESCR
/end CHARACTERISTIC
/begin CHARACTERISTIC CrCtl_facACCECOnAAppUp2_CUR "Acceleration factor for changing APP limitation number for ECON to 3 from 2 (for Acceleration , ECON sw ON, and during ACC)" CURVE 0x80516036 RB_Cur_Xs16Ws16 0.9960938 Fact_CrCtl 0.00 0.9960938 FORMAT "%9.7" EXTENDED_LIMITS -128.0000 127.9961
 /begin AXIS_DESCR STD_AXIS CrCtl_tiDRAccnControl_mp Time_ms_100ms 6 -3276800. 3276700. FORMAT "%8.0" DEPOSIT ABSOLUTE /end AXIS_DESCR
/end CHARACTERISTIC
/begin CHARACTERISTIC CrCtl_facACCECOnAAppUp3_CUR "Acceleration factor for changing APP limitation number for ECON to 4 from 3 (for Acceleration , ECON sw ON, and during ACC)" CURVE 0x80516050 RB_Cur_Xs16Ws16 0.9960938 Fact_CrCtl 0.00 0.9960938 FORMAT "%9.7" EXTENDED_LIMITS -128.0000 127.9961
 /begin AXIS_DESCR STD_AXIS CrCtl_tiDRAccnControl_mp Time_ms_100ms 6 -3276800. 3276700. FORMAT "%8.0" DEPOSIT ABSOLUTE /end AXIS_DESCR
/end CHARACTERISTIC
/begin CHARACTERISTIC CrCtl_facACCECOnAAppUp4_CUR "Acceleration factor for changing APP limitation number for ECON to 5 from 4 (for Acceleration , ECON sw ON, and during ACC)" CURVE 0x8051606A RB_Cur_Xs16Ws16 0.9960938 Fact_CrCtl 0.00 0.9960938 FORMAT "%9.7" EXTENDED_LIMITS -128.0000 127.9961
 /begin AXIS_DESCR STD_AXIS CrCtl_tiDRAccnControl_mp Time_ms_100ms 6 -3276800. 3276700. FORMAT "%8.0" DEPOSIT ABSOLUTE /end AXIS_DESCR
/end CHARACTERISTIC
/begin CHARACTERISTIC CrCtl_facACCECOnAAppUp5_CUR "Slope for changing APP limitation number for ECON to 1 from 2 (for ECON sw OFF)" CURVE 0x80516084 RB_Cur_Xs16Ws16 0.9960938 Fact_CrCtl 0.00 0.9960938 FORMAT "%9.7" EXTENDED_LIMITS -128.0000 127.9961
 /begin AXIS_DESCR STD_AXIS CrCtl_tiDRAccnControl_mp Time_ms_100ms 6 -3276800. 3276700. FORMAT "%8.0" DEPOSIT ABSOLUTE /end AXIS_DESCR
/end CHARACTERISTIC
/begin CHARACTERISTIC CrCtl_facACCECOnAFbUp2_CUR "Acceleration factor for changing APP limitation number for ECON to 3 from 2 (for FB, ECON sw ON, and during ACC)" CURVE 0x8051609E RB_Cur_Xs16Ws16 0.9960938 Fact_CrCtl 0.00 0.9960938 FORMAT "%9.7" EXTENDED_LIMITS -128.0000 127.9961
 /begin AXIS_DESCR STD_AXIS CrCtl_vSpdVar_mp Vel_CrCtl 6 -128.0000 127.9961 FORMAT "%8.4" DEPOSIT ABSOLUTE /end AXIS_DESCR
/end CHARACTERISTIC
/begin CHARACTERISTIC CrCtl_facACCECOnAFbUp3_CUR "Acceleration factor for changing APP limitation number for ECON to 4 from 3 (for FB, ECON sw ON, and during ACC)" CURVE 0x805160B8 RB_Cur_Xs16Ws16 0.9960938 Fact_CrCtl 0.00 0.9960938 FORMAT "%9.7" EXTENDED_LIMITS -128.0000 127.9961
 /begin AXIS_DESCR STD_AXIS CrCtl_vSpdVar_mp Vel_CrCtl 6 -128.0000 127.9961 FORMAT "%8.4" DEPOSIT ABSOLUTE /end AXIS_DESCR
/end CHARACTERISTIC
/begin CHARACTERISTIC CrCtl_facACCECOnAFbUp4_CUR "Acceleration factor for changing APP limitation number for ECON to 5 from 4 (for FB, ECON sw ON, and during ACC)" CURVE 0x805160D2 RB_Cur_Xs16Ws16 0.9960938 Fact_CrCtl 0.00 0.9960938 FORMAT "%9.7" EXTENDED_LIMITS -128.0000 127.9961
 /begin AXIS_DESCR STD_AXIS CrCtl_vSpdVar_mp Vel_CrCtl 6 -128.0000 127.9961 FORMAT "%8.4" DEPOSIT ABSOLUTE /end AXIS_DESCR
/end CHARACTERISTIC
/begin CHARACTERISTIC CrCtl_facACCECOnAFbUp5_CUR "Acceleration factor for changing APP limitation number for ECON to 2 from 1 (for Acceleration and ECON sw OFF)" CURVE 0x805160EC RB_Cur_Xs16Ws16 0.9960938 Fact_CrCtl 0.00 0.9960938 FORMAT "%9.7" EXTENDED_LIMITS -128.0000 127.9961
 /begin AXIS_DESCR STD_AXIS CrCtl_vSpdVar_mp Vel_CrCtl 6 -128.0000 127.9961 FORMAT "%8.4" DEPOSIT ABSOLUTE /end AXIS_DESCR
/end CHARACTERISTIC
/begin CHARACTERISTIC CrCtl_facACCECOnAResUp2_MAP "Acceleration factor for changing APP limitation number for ECON to 3 from 2 (for Resume, ECON sw ON, and during ACC)" MAP 0x80516106 Map_Xs16Ys16Ws16 0.9960938 Fact_CrCtl 0.00 0.9960938 FORMAT "%9.7" EXTENDED_LIMITS -128.0000 127.9961
 /begin AXIS_DESCR STD_AXIS CrCtl_tiDRAccnControl_mp Time_ms_100ms 6 -3276800. 3276700. FORMAT "%8.0" DEPOSIT ABSOLUTE /end AXIS_DESCR
 /begin AXIS_DESCR STD_AXIS CrCtl_vSpdVar_mp Vel_CrCtl 6 -128.0000 127.9961 FORMAT "%8.4" DEPOSIT ABSOLUTE /end AXIS_DESCR
/end CHARACTERISTIC
/begin CHARACTERISTIC CrCtl_facACCECOnAResUp3_MAP "Acceleration factor for changing APP limitation number for ECON to 4 from 3 (for Resume, ECON sw ON, and during ACC)" MAP 0x8051616A Map_Xs16Ys16Ws16 0.9960938 Fact_CrCtl 0.00 0.9960938 FORMAT "%9.7" EXTENDED_LIMITS -128.0000 127.9961
 /begin AXIS_DESCR STD_AXIS CrCtl_tiDRAccnControl_mp Time_ms_100ms 6 -3276800. 3276700. FORMAT "%8.0" DEPOSIT ABSOLUTE /end AXIS_DESCR
 /begin AXIS_DESCR STD_AXIS CrCtl_vSpdVar_mp Vel_CrCtl 6 -128.0000 127.9961 FORMAT "%8.4" DEPOSIT ABSOLUTE /end AXIS_DESCR
/end CHARACTERISTIC
/begin CHARACTERISTIC CrCtl_facACCECOnAResUp4_MAP "Acceleration factor for changing APP limitation number for ECON to 5 from 4 (for Resume, ECON sw ON, and during ACC)" MAP 0x805161CE Map_Xs16Ys16Ws16 0.9960938 Fact_CrCtl 0.00 0.9960938 FORMAT "%9.7" EXTENDED_LIMITS -128.0000 127.9961
 /begin AXIS_DESCR STD_AXIS CrCtl_tiDRAccnControl_mp Time_ms_100ms 6 -3276800. 3276700. FORMAT "%8.0" DEPOSIT ABSOLUTE /end AXIS_DESCR
 /begin AXIS_DESCR STD_AXIS CrCtl_vSpdVar_mp Vel_CrCtl 6 -128.0000 127.9961 FORMAT "%8.4" DEPOSIT ABSOLUTE /end AXIS_DESCR
/end CHARACTERISTIC
/begin CHARACTERISTIC CrCtl_facACCECOnAResUp5_MAP "Acceleration factor for changing APP limitation number for ECON to 2 from 1 (for FB and ECON sw OFF)" MAP 0x80516232 Map_Xs16Ys16Ws16 0.9960938 Fact_CrCtl 0.00 0.9960938 FORMAT "%9.7" EXTENDED_LIMITS -128.0000 127.9961
 /begin AXIS_DESCR STD_AXIS CrCtl_tiDRAccnControl_mp Time_ms_100ms 6 -3276800. 3276700. FORMAT "%8.0" DEPOSIT ABSOLUTE /end AXIS_DESCR
 /begin AXIS_DESCR STD_AXIS CrCtl_vSpdVar_mp Vel_CrCtl 6 -128.0000 127.9961 FORMAT "%8.4" DEPOSIT ABSOLUTE /end AXIS_DESCR
/end CHARACTERISTIC
/begin CHARACTERISTIC CrCtl_facAccnRed12_GCUR "Curve for Reduing factor of acceleration contorol value" CURVE 0x80516296 CurG_Ws16 511.9844 Fact_CrCtl2 0.00 511.9844 FORMAT "%8.4" EXTENDED_LIMITS -512.0000 511.9844
 /begin AXIS_DESCR COM_AXIS CrCtl_vVehUpByte Vel_CrCtl1 12 0.00 255.0000 FORMAT "%8.4" EXTENDED_LIMITS -32768.00 32767.00 AXIS_PTS_REF CrCtl_vAccnCont_AX /end AXIS_DESCR
/end CHARACTERISTIC
/begin CHARACTERISTIC CrCtl_facACtrlECDecelCls_GCUR "Correct value of APP in top gear for ECON" CURVE 0x805162AE CurG_Ws16 1023.984 Fact_CrCtl2 -512.0000 511.9844 FORMAT "%8.4"
 /begin AXIS_DESCR COM_AXIS CrCtl_vVehUpByte Vel_CrCtl1 6 0.00 255.0000 FORMAT "%8.4" EXTENDED_LIMITS -32768.00 32767.00 AXIS_PTS_REF CrCtl_vAccnCont_AXIS /end AXIS_DESCR
/end CHARACTERISTIC
/begin CHARACTERISTIC CrCtl_facACtrlECDecelOpn_GCUR "Curve for reducing factor of acceleration contorol value for ECON (close)" CURVE 0x805162BA CurG_Ws16 1023.984 Fact_CrCtl2 -512.0000 511.9844 FORMAT "%8.4"
 /begin AXIS_DESCR COM_AXIS CrCtl_vVehUpByte Vel_CrCtl1 6 0.00 255.0000 FORMAT "%8.4" EXTENDED_LIMITS -32768.00 32767.00 AXIS_PTS_REF CrCtl_vAccnCont_AXIS /end AXIS_DESCR
/end CHARACTERISTIC
/begin CHARACTERISTIC CrCtl_facAPPRedRevi_GCUR "Curve for factor of APP reduce revisions value for Clutch out" CURVE 0x805162C6 CurG_Ws16 511.9844 Fact_CrCtl2 0.00 511.9844 FORMAT "%8.4" EXTENDED_LIMITS -512.0000 511.9844
 /begin AXIS_DESCR COM_AXIS CrCUI_nFlt EngNCrCtl 6 0.00 32767.00 FORMAT "%8.2" EXTENDED_LIMITS -32768.00 32767.00 AXIS_PTS_REF CrCtl_nFlt_AXIS /end AXIS_DESCR
/end CHARACTERISTIC
/begin AXIS_PTS CrCtl_facAPPReviX_AXIS "Number of X-Axispoints for CrCtl_facAPPRevi_GMAP." 0x805162D2 CrCtl_rReq_mp Axis_Xs16 163.8350 APPCrCtl1 12 0.00 163.8350 FORMAT "%8.4" EXTENDED_LIMITS -163.8400 163.8350 DEPOSIT ABSOLUTE /end AXIS_PTS
/begin AXIS_PTS CrCtl_facAPPReviY_AXIS "Number of Y-axispoints for CrCtl_facAPPRevi_GMAP." 0x805162EC CrCtl_vVehUpByte Axis_Xs16 255.0000 Vel_CrCtl1 6 0.00 255.0000 FORMAT "%8.4" EXTENDED_LIMITS -32768.00 32767.00 DEPOSIT ABSOLUTE /end AXIS_PTS
/begin CHARACTERISTIC CrCtl_facCmftAccnRed12_GCUR "Curve for Reducing factor of acceleration control value for Comfort mode" CURVE 0x805162FA CurG_Ws16 511.9844 Fact_CrCtl2 0.00 511.9844 FORMAT "%8.4" EXTENDED_LIMITS -512.0000 511.9844
 /begin AXIS_DESCR COM_AXIS CrCtl_vVehUpByte Vel_CrCtl1 12 0.00 255.0000 FORMAT "%8.4" EXTENDED_LIMITS -32768.00 32767.00 AXIS_PTS_REF CrCtl_vAccnCont_AX /end AXIS_DESCR
/end CHARACTERISTIC
/begin CHARACTERISTIC CrCtl_facCmftFdbkAccnVal0_C "Acceleration feed back factor value under Gear no.0 for Comfort mode" VALUE 0x80516312 Val_Ws16 255.9922 Fact1 0.00 255.9922 FORMAT "%8.4" EXTENDED_LIMITS -256.0000 255.9922 /end CHARACTERISTIC
/begin CHARACTERISTIC CrCtl_facCmftFdbkAccnVal1_C "Acceleration feed back factor value under Gear no.1 for Comfort mode" VALUE 0x80516314 Val_Ws16 255.9922 Fact1 0.00 255.9922 FORMAT "%8.4" EXTENDED_LIMITS -256.0000 255.9922 /end CHARACTERISTIC
/begin CHARACTERISTIC CrCtl_facCmftFdbkAccnVal2_C "Acceleration feed back factor value under Gear no.2 for Comfort mode" VALUE 0x80516316 Val_Ws16 255.9922 Fact1 0.00 255.9922 FORMAT "%8.4" EXTENDED_LIMITS -256.0000 255.9922 /end CHARACTERISTIC
/begin CHARACTERISTIC CrCtl_facCmftFdbkAccnVal3_C "Acceleration feed back factor value under Gear no.3 for Comfort mode" VALUE 0x80516318 Val_Ws16 255.9922 Fact1 0.00 255.9922 FORMAT "%8.4" EXTENDED_LIMITS -256.0000 255.9922 /end CHARACTERISTIC
/begin CHARACTERISTIC CrCtl_facCmftFdbkAccnVal4_C "Acceleration feed back factor value under Gear no.4 for Comfort mode" VALUE 0x8051631A Val_Ws16 255.9922 Fact1 0.00 255.9922 FORMAT "%8.4" EXTENDED_LIMITS -256.0000 255.9922 /end CHARACTERISTIC
/begin CHARACTERISTIC CrCtl_facCmftFdbkDReviVal0_C "Feed Back D factor revision value for Comfort mode under Gear no.0" VALUE 0x8051631C Val_Ws16 255.9922 Fact1 0.00 255.9922 FORMAT "%8.4" EXTENDED_LIMITS -256.0000 255.9922 /end CHARACTERISTIC
/begin CHARACTERISTIC CrCtl_facCmftFdbkDReviVal1_C "Feed Back D factor revision value for Comfort mode under Gear no.1" VALUE 0x8051631E Val_Ws16 255.9922 Fact1 0.00 255.9922 FORMAT "%8.4" EXTENDED_LIMITS -256.0000 255.9922 /end CHARACTERISTIC
/begin CHARACTERISTIC CrCtl_facCmftFdbkDReviVal2_C "Feed Back D factor revision value for Comfort mode under Gear no.2" VALUE 0x80516320 Val_Ws16 255.9922 Fact1 0.00 255.9922 FORMAT "%8.4" EXTENDED_LIMITS -256.0000 255.9922 /end CHARACTERISTIC
/begin CHARACTERISTIC CrCtl_facCmftFdbkDReviVal3_C "Feed Back D factor revision value for Comfort mode under Gear no.3" VALUE 0x80516322 Val_Ws16 255.9922 Fact1 0.00 255.9922 FORMAT "%8.4" EXTENDED_LIMITS -256.0000 255.9922 /end CHARACTERISTIC
/begin CHARACTERISTIC CrCtl_facCmftFdbkDReviVal4_C "Feed Back D factor revision value for Comfort mode under Gear no.4" VALUE 0x80516324 Val_Ws16 255.9922 Fact1 0.00 255.9922 FORMAT "%8.4" EXTENDED_LIMITS -256.0000 255.9922 /end CHARACTERISTIC
/begin CHARACTERISTIC CrCtl_facCmftFdbkPReviVal0_C "Feed Back P factor revision value for Comfort mode under Gear no.0" VALUE 0x80516326 Val_Ws16 255.9922 Fact1 0.00 255.9922 FORMAT "%8.4" EXTENDED_LIMITS -256.0000 255.9922 /end CHARACTERISTIC
/begin CHARACTERISTIC CrCtl_facCmftFdbkPReviVal1_C "Feed Back P factor revision value for Comfort mode under Gear no.1" VALUE 0x80516328 Val_Ws16 255.9922 Fact1 0.00 255.9922 FORMAT "%8.4" EXTENDED_LIMITS -256.0000 255.9922 /end CHARACTERISTIC
/begin CHARACTERISTIC CrCtl_facCmftFdbkPReviVal2_C "Feed Back P factor revision value for Comfort mode under Gear no.2" VALUE 0x8051632A Val_Ws16 255.9922 Fact1 0.00 255.9922 FORMAT "%8.4" EXTENDED_LIMITS -256.0000 255.9922 /end CHARACTERISTIC
/begin CHARACTERISTIC CrCtl_facCmftFdbkPReviVal3_C "Feed Back P factor revision value for Comfort mode under Gear no.3" VALUE 0x8051632C Val_Ws16 255.9922 Fact1 0.00 255.9922 FORMAT "%8.4" EXTENDED_LIMITS -256.0000 255.9922 /end CHARACTERISTIC
/begin CHARACTERISTIC CrCtl_facCmftFdbkPReviVal4_C "Feed Back P factor revision value for Comfort mode under Gear no.4" VALUE 0x8051632E Val_Ws16 255.9922 Fact1 0.00 255.9922 FORMAT "%8.4" EXTENDED_LIMITS -256.0000 255.9922 /end CHARACTERISTIC
/begin CHARACTERISTIC CrCtl_facContTapInitRevi_C "factor of continuation Tap initial revision request value" VALUE 0x80516330 Val_Ws16 0.4960938 Fact_CrCtl 0.00 0.4960938 FORMAT "%9.7" EXTENDED_LIMITS -128.0000 127.9961 /end CHARACTERISTIC
/begin CHARACTERISTIC CrCtl_facDecnRevi12_GCUR "Curve for deceleration revision factor value" CURVE 0x80516332 CurG_Ws16 511.9844 Fact_CrCtl2 0.00 511.9844 FORMAT "%8.4" EXTENDED_LIMITS -512.0000 511.9844
 /begin AXIS_DESCR COM_AXIS CrCtl_vDesUpByte_mp Vel_CrCtl1 12 0.00 255.0000 FORMAT "%8.4" EXTENDED_LIMITS -32768.00 32767.00 AXIS_PTS_REF CrCtl_vFdbkArea_AX /end AXIS_DESCR
/end CHARACTERISTIC
/begin CHARACTERISTIC CrCtl_facDiffCoeffDR1ACCEL_CUR "Accel differential coeffecient for DR1 judgement at CC_ACCEL" CURVE 0x8051634A RB_Cur_Xs16Ws16 0.9960938 Fact_CrCtl 0.00 0.9960938 FORMAT "%9.7" EXTENDED_LIMITS -128.0000 127.9961
 /begin AXIS_DESCR STD_AXIS CrCtl_tiDRAccnControl_mp Time_ms_100ms 6 -3276800. 3276700. FORMAT "%8.0" DEPOSIT ABSOLUTE /end AXIS_DESCR
/end CHARACTERISTIC
/begin CHARACTERISTIC CrCtl_facDiffCoeffDR1FB_CUR "Accel differential coeffecient for DR1 judgement at CC_F/B" CURVE 0x80516364 RB_Cur_Xs16Ws16 0.9960938 Fact_CrCtl 0.00 0.9960938 FORMAT "%9.7" EXTENDED_LIMITS -128.0000 127.9961
 /begin AXIS_DESCR STD_AXIS CrCtl_vSpdDvtRgl_mp Vel_CrCtl 6 -128.0000 127.9961 FORMAT "%8.4" DEPOSIT ABSOLUTE /end AXIS_DESCR
/end CHARACTERISTIC
/begin CHARACTERISTIC CrCtl_facDiffCoeffDR1Resume_MAP "Accel differential coeffecient data for DR1 judgement at CC_RESUME" MAP 0x8051637E Map_Xs16Ys16Ws16 0.9960938 Fact_CrCtl 0.00 0.9960938 FORMAT "%9.7" EXTENDED_LIMITS -128.0000 127.9961
 /begin AXIS_DESCR STD_AXIS CrCtl_tiDRAccnControl_mp Time_ms_100ms 6 0.00 3276700. FORMAT "%8.0" EXTENDED_LIMITS -3276800. 3276700. DEPOSIT ABSOLUTE /end AXIS_DESCR
 /begin AXIS_DESCR STD_AXIS CrCtl_vSpdDvtRgl_mp Vel_CrCtl 6 -128.0000 127.9961 FORMAT "%8.4" DEPOSIT ABSOLUTE /end AXIS_DESCR
/end CHARACTERISTIC
/begin CHARACTERISTIC CrCtl_facDiffCoeffDR2ACCEL_CUR "Accel differential coeffecient for DR2 judgement at CC_ACCEL" CURVE 0x805163E2 RB_Cur_Xs16Ws16 0.9960938 Fact_CrCtl 0.00 0.9960938 FORMAT "%9.7" EXTENDED_LIMITS -128.0000 127.9961
 /begin AXIS_DESCR STD_AXIS CrCtl_tiDRAccnControl_mp Time_ms_100ms 6 -3276800. 3276700. FORMAT "%8.0" DEPOSIT ABSOLUTE /end AXIS_DESCR
/end CHARACTERISTIC
/begin CHARACTERISTIC CrCtl_facDiffCoeffDR2FB_CUR "Accel differential coeffecient for DR2 judgement at CC_F/B" CURVE 0x805163FC RB_Cur_Xs16Ws16 0.9960938 Fact_CrCtl 0.00 0.9960938 FORMAT "%9.7" EXTENDED_LIMITS -128.0000 127.9961
 /begin AXIS_DESCR STD_AXIS CrCtl_vSpdDvtRgl_mp Vel_CrCtl 6 -128.0000 127.9961 FORMAT "%8.4" DEPOSIT ABSOLUTE /end AXIS_DESCR
/end CHARACTERISTIC
/begin CHARACTERISTIC CrCtl_facDiffCoeffDR2Resume_MAP "Accel defferential coeffecient data for DR2 judgement at CC_RESUME" MAP 0x80516416 Map_Xs16Ys16Ws16 255.9961 Fact_CrCtl -128.0000 127.9961 FORMAT "%8.4"
 /begin AXIS_DESCR STD_AXIS CrCtl_tiDRAccnControl_mp Time_ms_100ms 6 -3276800. 3276700. FORMAT "%8.0" DEPOSIT ABSOLUTE /end AXIS_DESCR
 /begin AXIS_DESCR STD_AXIS CrCtl_vSpdDvtRgl_mp Vel_CrCtl 6 -128.0000 127.9961 FORMAT "%8.4" DEPOSIT ABSOLUTE /end AXIS_DESCR
/end CHARACTERISTIC
/begin CHARACTERISTIC CrCtl_facDiffCoeffDR3ACCEL_CUR "Accel defferential coeffecient for DR3 judgement at CC_ACCEL" CURVE 0x8051647A RB_Cur_Xs16Ws16 0.9960938 Fact_CrCtl 0.00 0.9960938 FORMAT "%9.7" EXTENDED_LIMITS -128.0000 127.9961
 /begin AXIS_DESCR STD_AXIS CrCtl_tiDRAccnControl_mp Time_ms_100ms 6 0.00 3276700. FORMAT "%8.0" EXTENDED_LIMITS -3276800. 3276700. DEPOSIT ABSOLUTE /end AXIS_DESCR
/end CHARACTERISTIC
/begin CHARACTERISTIC CrCtl_facDiffCoeffDR3FB_CUR "Accel defferential coeffecient for DR3 judgement at CC_ACCEL" CURVE 0x80516494 RB_Cur_Xs16Ws16 0.9960938 Fact_CrCtl 0.00 0.9960938 FORMAT "%9.7" EXTENDED_LIMITS -128.0000 127.9961
 /begin AXIS_DESCR STD_AXIS CrCtl_vSpdDvtRgl_mp Vel_CrCtl 6 -128.0000 127.9961 FORMAT "%8.4" DEPOSIT ABSOLUTE /end AXIS_DESCR
/end CHARACTERISTIC
/begin CHARACTERISTIC CrCtl_facDiffCoeffDR3Resume_MAP "Accel defferential coeffecient data for DR3 judgement at CC_RESUME" MAP 0x805164AE Map_Xs16Ys16Ws16 255.9961 Fact_CrCtl -128.0000 127.9961 FORMAT "%8.4"
 /begin AXIS_DESCR STD_AXIS CrCtl_tiDRAccnControl_mp Time_ms_100ms 6 -3276800. 3276700. FORMAT "%8.0" DEPOSIT ABSOLUTE /end AXIS_DESCR
 /begin AXIS_DESCR STD_AXIS CrCtl_vSpdDvtRgl_mp Vel_CrCtl 6 -128.0000 127.9961 FORMAT "%8.4" DEPOSIT ABSOLUTE /end AXIS_DESCR
/end CHARACTERISTIC
/begin CHARACTERISTIC CrCtl_facDiffCoeffDR4ACCEL_CUR "Accel differential coeffecient data for DR4 judgement at CC_ACCEL" CURVE 0x80516512 RB_Cur_Xs16Ws16 0.9960938 Fact_CrCtl 0.00 0.9960938 FORMAT "%9.7" EXTENDED_LIMITS -128.0000 127.9961
 /begin AXIS_DESCR STD_AXIS CrCtl_tiDRAccnControl_mp Time_ms_100ms 6 0.00 3276700. FORMAT "%8.0" EXTENDED_LIMITS -3276800. 3276700. DEPOSIT ABSOLUTE /end AXIS_DESCR
/end CHARACTERISTIC
/begin CHARACTERISTIC CrCtl_facDiffCoeffDR4FB_CUR "Accel differential coeffecient data for DR4 judgement at CC_FB" CURVE 0x8051652C RB_Cur_Xs16Ws16 0.9960938 Fact_CrCtl 0.00 0.9960938 FORMAT "%9.7" EXTENDED_LIMITS -128.0000 127.9961
 /begin AXIS_DESCR STD_AXIS CrCtl_vSpdDvtRgl_mp Vel_CrCtl 6 -128.0000 127.9961 FORMAT "%8.4" DEPOSIT ABSOLUTE /end AXIS_DESCR
/end CHARACTERISTIC
/begin CHARACTERISTIC CrCtl_facDiffCoeffDR4Resume_MAP "Accel differential coeffecient data for DR4 judgement at CC_RESUME" MAP 0x80516546 Map_Xs16Ys16Ws16 0.9960938 Fact_CrCtl 0.00 0.9960938 FORMAT "%9.7" EXTENDED_LIMITS -128.0000 127.9961
 /begin AXIS_DESCR STD_AXIS CrCtl_tiDRAccnControl_mp Time_ms_100ms 6 0.00 3276700. FORMAT "%8.0" EXTENDED_LIMITS -3276800. 3276700. DEPOSIT ABSOLUTE /end AXIS_DESCR
 /begin AXIS_DESCR STD_AXIS CrCtl_vSpdDvtRgl_mp Vel_CrCtl 6 -128.0000 127.9961 FORMAT "%8.4" DEPOSIT ABSOLUTE /end AXIS_DESCR
/end CHARACTERISTIC
/begin CHARACTERISTIC CrCtl_facDiffCoeffDR5ACCEL_CUR "Accel differential coeffecient data for DR5 judgement at CC_ACCEL" CURVE 0x805165AA RB_Cur_Xs16Ws16 0.9960938 Fact_CrCtl 0.00 0.9960938 FORMAT "%9.7" EXTENDED_LIMITS -128.0000 127.9961
 /begin AXIS_DESCR STD_AXIS CrCtl_tiDRAccnControl_mp Time_ms_100ms 6 0.00 3276700. FORMAT "%8.0" EXTENDED_LIMITS -3276800. 3276700. DEPOSIT ABSOLUTE /end AXIS_DESCR
/end CHARACTERISTIC
/begin CHARACTERISTIC CrCtl_facDiffCoeffDR5FB_CUR "Accel differential coeffecient data for DR5 judgement at CC_FB" CURVE 0x805165C4 RB_Cur_Xs16Ws16 0.9960938 Fact_CrCtl 0.00 0.9960938 FORMAT "%9.7" EXTENDED_LIMITS -128.0000 127.9961
 /begin AXIS_DESCR STD_AXIS CrCtl_vSpdDvtRgl_mp Vel_CrCtl 6 -128.0000 127.9961 FORMAT "%8.4" DEPOSIT ABSOLUTE /end AXIS_DESCR
/end CHARACTERISTIC
/begin CHARACTERISTIC CrCtl_facDiffCoeffDR5Resume_MAP "Accel differential coeffecient data for DR5 judgement at CC_RESUME" MAP 0x805165DE Map_Xs16Ys16Ws16 0.9960938 Fact_CrCtl 0.00 0.9960938 FORMAT "%9.7" EXTENDED_LIMITS -128.0000 127.9961
 /begin AXIS_DESCR STD_AXIS CrCtl_tiDRAccnControl_mp Time_ms_100ms 6 0.00 3276700. FORMAT "%8.0" EXTENDED_LIMITS -3276800. 3276700. DEPOSIT ABSOLUTE /end AXIS_DESCR
 /begin AXIS_DESCR STD_AXIS CrCtl_vSpdDvtRgl_mp Vel_CrCtl 6 -128.0000 127.9961 FORMAT "%8.4" DEPOSIT ABSOLUTE /end AXIS_DESCR
/end CHARACTERISTIC
/begin CHARACTERISTIC CrCtl_facDiffCoeffDR6ACCEL_CUR "Accel differential coeffecient data for DR6 judgement at CC_ACCEL" CURVE 0x80516642 RB_Cur_Xs16Ws16 0.9960938 Fact_CrCtl 0.00 0.9960938 FORMAT "%9.7" EXTENDED_LIMITS -128.0000 127.9961
 /begin AXIS_DESCR STD_AXIS CrCtl_tiDRAccnControl_mp Time_ms_100ms 6 0.00 3276700. FORMAT "%8.0" EXTENDED_LIMITS -3276800. 3276700. DEPOSIT ABSOLUTE /end AXIS_DESCR
/end CHARACTERISTIC
/begin CHARACTERISTIC CrCtl_facDiffCoeffDR6FB_CUR "Accel differential coeffecient data for DR6 judgement at CC_FB" CURVE 0x8051665C RB_Cur_Xs16Ws16 0.9960938 Fact_CrCtl 0.00 0.9960938 FORMAT "%9.7" EXTENDED_LIMITS -128.0000 127.9961
 /begin AXIS_DESCR STD_AXIS CrCtl_vSpdDvtRgl_mp Vel_CrCtl 6 -128.0000 127.9961 FORMAT "%8.4" DEPOSIT ABSOLUTE /end AXIS_DESCR
/end CHARACTERISTIC
/begin CHARACTERISTIC CrCtl_facDiffCoeffDR6Resume_MAP "Accel differential coeffecient data for DR6 judgement at CC_RESUME" MAP 0x80516676 Map_Xs16Ys16Ws16 0.9960938 Fact_CrCtl 0.00 0.9960938 FORMAT "%9.7" EXTENDED_LIMITS -128.0000 127.9961
 /begin AXIS_DESCR STD_AXIS CrCtl_tiDRAccnControl_mp Time_ms_100ms 6 0.00 3276700. FORMAT "%8.0" EXTENDED_LIMITS -3276800. 3276700. DEPOSIT ABSOLUTE /end AXIS_DESCR
 /begin AXIS_DESCR STD_AXIS CrCtl_vSpdDvtRgl_mp Vel_CrCtl 6 -128.0000 127.9961 FORMAT "%8.4" DEPOSIT ABSOLUTE /end AXIS_DESCR
/end CHARACTERISTIC
/begin CHARACTERISTIC CrCtl_facDiffCoeffDR7ACCEL_CUR "Accel differential coeffecient data for DR7 judgement at CC_ACCEL" CURVE 0x805166DA RB_Cur_Xs16Ws16 0.9960938 Fact_CrCtl 0.00 0.9960938 FORMAT "%9.7" EXTENDED_LIMITS -128.0000 127.9961
 /begin AXIS_DESCR STD_AXIS CrCtl_tiDRAccnControl_mp Time_ms_100ms 6 0.00 3276700. FORMAT "%8.0" EXTENDED_LIMITS -3276800. 3276700. DEPOSIT ABSOLUTE /end AXIS_DESCR
/end CHARACTERISTIC
/begin CHARACTERISTIC CrCtl_facDiffCoeffDR7FB_CUR "Accel differential coeffecient data for DR7 judgement at CC_FB" CURVE 0x805166F4 RB_Cur_Xs16Ws16 0.9960938 Fact_CrCtl 0.00 0.9960938 FORMAT "%9.7" EXTENDED_LIMITS -128.0000 127.9961
 /begin AXIS_DESCR STD_AXIS CrCtl_vSpdDvtRgl_mp Vel_CrCtl 6 -128.0000 127.9961 FORMAT "%8.4" DEPOSIT ABSOLUTE /end AXIS_DESCR
/end CHARACTERISTIC
/begin CHARACTERISTIC CrCtl_facDiffCoeffDR7Resume_MAP "Accel differential coeffecient data for DR7 judgement at CC_RESUME" MAP 0x8051670E Map_Xs16Ys16Ws16 0.9960938 Fact_CrCtl 0.00 0.9960938 FORMAT "%9.7" EXTENDED_LIMITS -128.0000 127.9961
 /begin AXIS_DESCR STD_AXIS CrCtl_tiDRAccnControl_mp Time_ms_100ms 6 0.00 3276700. FORMAT "%8.0" EXTENDED_LIMITS -3276800. 3276700. DEPOSIT ABSOLUTE /end AXIS_DESCR
 /begin AXIS_DESCR STD_AXIS CrCtl_vSpdDvtRgl_mp Vel_CrCtl 6 -128.0000 127.9961 FORMAT "%8.4" DEPOSIT ABSOLUTE /end AXIS_DESCR
/end CHARACTERISTIC
/begin CHARACTERISTIC CrCtl_facEC1LGAppDiffCls_GMAP "Correct value of APP in 1 level lower gear for ECON and close side" MAP 0x80516772 MapG_Ws16 511.9922 Fact1 -256.0000 255.9922 FORMAT "%8.4"
 /begin AXIS_DESCR COM_AXIS CrCtl_rReq_mp APPCrCtl1 12 0.00 163.8350 FORMAT "%8.4" EXTENDED_LIMITS -163.8400 163.8350 AXIS_PTS_REF CrCtl_facAPPReviX_AXIS /end AXIS_DESCR
 /begin AXIS_DESCR COM_AXIS CrCtl_vVehUpByte Vel_CrCtl1 6 0.00 255.0000 FORMAT "%8.4" EXTENDED_LIMITS -32768.00 32767.00 AXIS_PTS_REF CrCtl_facAPPReviY_AXIS /end AXIS_DESCR
/end CHARACTERISTIC
/begin CHARACTERISTIC CrCtl_facEC1LGAppDiff_GMAP "Correct value of APP in 1 level lower gear for ECON for open" MAP 0x80516802 MapG_Ws16 511.9922 Fact1 -256.0000 255.9922 FORMAT "%8.4"
 /begin AXIS_DESCR COM_AXIS CrCtl_rReq_mp APPCrCtl1 12 0.00 163.8350 FORMAT "%8.4" EXTENDED_LIMITS -163.8400 163.8350 AXIS_PTS_REF CrCtl_facAPPReviX_AXIS /end AXIS_DESCR
 /begin AXIS_DESCR COM_AXIS CrCtl_vVehUpByte Vel_CrCtl1 6 0.00 255.0000 FORMAT "%8.4" EXTENDED_LIMITS -32768.00 32767.00 AXIS_PTS_REF CrCtl_facAPPReviY_AXIS /end AXIS_DESCR
/end CHARACTERISTIC
/begin CHARACTERISTIC CrCtl_facEC2LGAppDiffCls_GMAP "Correct value of APP in 2 level lower gear for ECON and close side" MAP 0x80516892 MapG_Ws16 511.9922 Fact1 -256.0000 255.9922 FORMAT "%8.4"
 /begin AXIS_DESCR COM_AXIS CrCtl_rReq_mp APPCrCtl1 12 0.00 163.8350 FORMAT "%8.4" EXTENDED_LIMITS -163.8400 163.8350 AXIS_PTS_REF CrCtl_facAPPReviX_AXIS /end AXIS_DESCR
 /begin AXIS_DESCR COM_AXIS CrCtl_vVehUpByte Vel_CrCtl1 6 0.00 255.0000 FORMAT "%8.4" EXTENDED_LIMITS -32768.00 32767.00 AXIS_PTS_REF CrCtl_facAPPReviY_AXIS /end AXIS_DESCR
/end CHARACTERISTIC
/begin CHARACTERISTIC CrCtl_facEC2LGAppDiff_GMAP "Correct value of APP in 2 level lower gear for ECON for open side" MAP 0x80516922 MapG_Ws16 511.9922 Fact1 -256.0000 255.9922 FORMAT "%8.4"
 /begin AXIS_DESCR COM_AXIS CrCtl_rReq_mp APPCrCtl1 12 0.00 163.8350 FORMAT "%8.4" EXTENDED_LIMITS -163.8400 163.8350 AXIS_PTS_REF CrCtl_facAPPReviX_AXIS /end AXIS_DESCR
 /begin AXIS_DESCR COM_AXIS CrCtl_vVehUpByte Vel_CrCtl1 6 0.00 255.0000 FORMAT "%8.4" EXTENDED_LIMITS -32768.00 32767.00 AXIS_PTS_REF CrCtl_facAPPReviY_AXIS /end AXIS_DESCR
/end CHARACTERISTIC
/begin CHARACTERISTIC CrCtl_facEC3LGAppDiffCls_GMAP "Correct value of APP in 3 level lower gear for ECON and close side" MAP 0x805169B2 MapG_Ws16 511.9922 Fact1 -256.0000 255.9922 FORMAT "%8.4"
 /begin AXIS_DESCR COM_AXIS CrCtl_rReq_mp APPCrCtl1 12 0.00 163.8350 FORMAT "%8.4" EXTENDED_LIMITS -163.8400 163.8350 AXIS_PTS_REF CrCtl_facAPPReviX_AXIS /end AXIS_DESCR
 /begin AXIS_DESCR COM_AXIS CrCtl_vVehUpByte Vel_CrCtl1 6 0.00 255.0000 FORMAT "%8.4" EXTENDED_LIMITS -32768.00 32767.00 AXIS_PTS_REF CrCtl_facAPPReviY_AXIS /end AXIS_DESCR
/end CHARACTERISTIC
/begin CHARACTERISTIC CrCtl_facEC3LGAppDiff_GMAP "Correct value of APP in 3 level lower gear for ECON for open side" MAP 0x80516A42 MapG_Ws16 511.9922 Fact1 -256.0000 255.9922 FORMAT "%8.4"
 /begin AXIS_DESCR COM_AXIS CrCtl_rReq_mp APPCrCtl1 12 0.00 163.8350 FORMAT "%8.4" EXTENDED_LIMITS -163.8400 163.8350 AXIS_PTS_REF CrCtl_facAPPReviX_AXIS /end AXIS_DESCR
 /begin AXIS_DESCR COM_AXIS CrCtl_vVehUpByte Vel_CrCtl1 6 0.00 255.0000 FORMAT "%8.4" EXTENDED_LIMITS -32768.00 32767.00 AXIS_PTS_REF CrCtl_facAPPReviY_AXIS /end AXIS_DESCR
/end CHARACTERISTIC
/begin CHARACTERISTIC CrCtl_facEC4LGAppDiffCls_GMAP "Correct value of APP in 4 level lower gear for ECON and close side" MAP 0x80516AD2 MapG_Ws16 511.9922 Fact1 -256.0000 255.9922 FORMAT "%8.4"
 /begin AXIS_DESCR COM_AXIS CrCtl_rReq_mp APPCrCtl1 12 0.00 163.8350 FORMAT "%8.4" EXTENDED_LIMITS -163.8400 163.8350 AXIS_PTS_REF CrCtl_facAPPReviX_AXIS /end AXIS_DESCR
 /begin AXIS_DESCR COM_AXIS CrCtl_vVehUpByte Vel_CrCtl1 6 0.00 255.0000 FORMAT "%8.4" EXTENDED_LIMITS -32768.00 32767.00 AXIS_PTS_REF CrCtl_facAPPReviY_AXIS /end AXIS_DESCR
/end CHARACTERISTIC
/begin CHARACTERISTIC CrCtl_facEC4LGAppDiff_GMAP "Correct value of APP in 4 level lower gear for ECON for open side" MAP 0x80516B62 MapG_Ws16 511.9922 Fact1 -256.0000 255.9922 FORMAT "%8.4"
 /begin AXIS_DESCR COM_AXIS CrCtl_rReq_mp APPCrCtl1 12 0.00 163.8350 FORMAT "%8.4" EXTENDED_LIMITS -163.8400 163.8350 AXIS_PTS_REF CrCtl_facAPPReviX_AXIS /end AXIS_DESCR
 /begin AXIS_DESCR COM_AXIS CrCtl_vVehUpByte Vel_CrCtl1 6 0.00 255.0000 FORMAT "%8.4" EXTENDED_LIMITS -32768.00 32767.00 AXIS_PTS_REF CrCtl_facAPPReviY_AXIS /end AXIS_DESCR
/end CHARACTERISTIC
/begin CHARACTERISTIC CrCtl_facECAppInitCor_CUR "Correct value of TAPUP initial request APP for ECON" CURVE 0x80516BF2 RB_Curve_S16_U8_Static 3.984 Fact_CrCtl2 0.00 3.984 FORMAT "%5.3"
 /begin AXIS_DESCR STD_AXIS CrCtl_vSpdTab_mp Vel_CrCtl1 6 -32768.00 32767.00 FORMAT "%8.2" DEPOSIT ABSOLUTE /end AXIS_DESCR
/end CHARACTERISTIC
/begin CHARACTERISTIC CrCtl_facECDR1ResA_MAP "Accel differential coeffecient data for DR1 judgement at CC_RESUME for ECON" MAP 0x80516C06 Map_Xs16Ys16Ws16 0.9960938 Fact_CrCtl 0.00 0.9960938 FORMAT "%9.7" EXTENDED_LIMITS -128.0000 127.9961
 /begin AXIS_DESCR STD_AXIS CrCtl_tiDRAccnControl_mp Time_ms_100ms 6 0.00 3276700. FORMAT "%8.0" EXTENDED_LIMITS -3276800. 3276700. DEPOSIT ABSOLUTE /end AXIS_DESCR
 /begin AXIS_DESCR STD_AXIS CrCtl_vSpdDvtRgl_mp Vel_CrCtl 6 -128.0000 127.9961 FORMAT "%8.4" DEPOSIT ABSOLUTE /end AXIS_DESCR
/end CHARACTERISTIC
/begin CHARACTERISTIC CrCtl_facECDR2ResA_MAP "Accel differential coeffecient data for DR2 judgement at CC_RESUME for ECON" MAP 0x80516C6A Map_Xs16Ys16Ws16 0.9960938 Fact_CrCtl 0.00 0.9960938 FORMAT "%9.7" EXTENDED_LIMITS -128.0000 127.9961
 /begin AXIS_DESCR STD_AXIS CrCtl_tiDRAccnControl_mp Time_ms_100ms 6 0.00 3276700. FORMAT "%8.0" EXTENDED_LIMITS -3276800. 3276700. DEPOSIT ABSOLUTE /end AXIS_DESCR
 /begin AXIS_DESCR STD_AXIS CrCtl_vSpdDvtRgl_mp Vel_CrCtl 6 -128.0000 127.9961 FORMAT "%8.4" DEPOSIT ABSOLUTE /end AXIS_DESCR
/end CHARACTERISTIC
/begin CHARACTERISTIC CrCtl_facECDR3ResA_MAP "Accel differential coeffecient data for DR3 judgement at CC_RESUME for ECON" MAP 0x80516CCE Map_Xs16Ys16Ws16 0.9960938 Fact_CrCtl 0.00 0.9960938 FORMAT "%9.7" EXTENDED_LIMITS -128.0000 127.9961
 /begin AXIS_DESCR STD_AXIS CrCtl_tiDRAccnControl_mp Time_ms_100ms 6 0.00 3276700. FORMAT "%8.0" EXTENDED_LIMITS -3276800. 3276700. DEPOSIT ABSOLUTE /end AXIS_DESCR
 /begin AXIS_DESCR STD_AXIS CrCtl_vSpdDvtRgl_mp Vel_CrCtl 6 -128.0000 127.9961 FORMAT "%8.4" DEPOSIT ABSOLUTE /end AXIS_DESCR
/end CHARACTERISTIC
/begin CHARACTERISTIC CrCtl_facECDR4ResA_MAP "Accel differential coeffecient data for DR4 judgement at CC_RESUME for ECON" MAP 0x80516D32 Map_Xs16Ys16Ws16 0.9960938 Fact_CrCtl 0.00 0.9960938 FORMAT "%9.7" EXTENDED_LIMITS -128.0000 127.9961
 /begin AXIS_DESCR STD_AXIS CrCtl_tiDRAccnControl_mp Time_ms_100ms 6 0.00 3276700. FORMAT "%8.0" EXTENDED_LIMITS -3276800. 3276700. DEPOSIT ABSOLUTE /end AXIS_DESCR
 /begin AXIS_DESCR STD_AXIS CrCtl_vSpdDvtRgl_mp Vel_CrCtl 6 -128.0000 127.9961 FORMAT "%8.4" DEPOSIT ABSOLUTE /end AXIS_DESCR
/end CHARACTERISTIC
/begin CHARACTERISTIC CrCtl_facECDR5ResA_MAP "Accel differential coeffecient data for DR5 judgement at CC_RESUME for ECON" MAP 0x80516D96 Map_Xs16Ys16Ws16 0.9960938 Fact_CrCtl 0.00 0.9960938 FORMAT "%9.7" EXTENDED_LIMITS -128.0000 127.9961
 /begin AXIS_DESCR STD_AXIS CrCtl_tiDRAccnControl_mp Time_ms_100ms 6 0.00 3276700. FORMAT "%8.0" EXTENDED_LIMITS -3276800. 3276700. DEPOSIT ABSOLUTE /end AXIS_DESCR
 /begin AXIS_DESCR STD_AXIS CrCtl_vSpdDvtRgl_mp Vel_CrCtl 6 -128.0000 127.9961 FORMAT "%8.4" DEPOSIT ABSOLUTE /end AXIS_DESCR
/end CHARACTERISTIC
/begin CHARACTERISTIC CrCtl_facECDR6ResA_MAP "Accel differential coeffecient data for DR6 judgement at CC_RESUME for ECON" MAP 0x80516DFA Map_Xs16Ys16Ws16 0.9960938 Fact_CrCtl 0.00 0.9960938 FORMAT "%9.7" EXTENDED_LIMITS -128.0000 127.9961
 /begin AXIS_DESCR STD_AXIS CrCtl_tiDRAccnControl_mp Time_ms_100ms 6 0.00 3276700. FORMAT "%8.0" EXTENDED_LIMITS -3276800. 3276700. DEPOSIT ABSOLUTE /end AXIS_DESCR
 /begin AXIS_DESCR STD_AXIS CrCtl_vSpdDvtRgl_mp Vel_CrCtl 6 -128.0000 127.9961 FORMAT "%8.4" DEPOSIT ABSOLUTE /end AXIS_DESCR
/end CHARACTERISTIC
/begin CHARACTERISTIC CrCtl_facECDR7ResA_MAP "Accel differential coeffecient data for DR7 judgement at CC_RESUME for ECON" MAP 0x80516E5E Map_Xs16Ys16Ws16 0.9960938 Fact_CrCtl 0.00 0.9960938 FORMAT "%9.7" EXTENDED_LIMITS -128.0000 127.9961
 /begin AXIS_DESCR STD_AXIS CrCtl_tiDRAccnControl_mp Time_ms_100ms 6 0.00 3276700. FORMAT "%8.0" EXTENDED_LIMITS -3276800. 3276700. DEPOSIT ABSOLUTE /end AXIS_DESCR
 /begin AXIS_DESCR STD_AXIS CrCtl_vSpdDvtRgl_mp Vel_CrCtl 6 -128.0000 127.9961 FORMAT "%8.4" DEPOSIT ABSOLUTE /end AXIS_DESCR
/end CHARACTERISTIC
/begin CHARACTERISTIC CrCtl_facEcoFdbkAccnVal0_C "Acceleration feed back factor value under Gear no.0 for Eco mode" VALUE 0x80516EC2 Val_Ws16 255.9922 Fact1 0.00 255.9922 FORMAT "%8.4" EXTENDED_LIMITS -256.0000 255.9922 /end CHARACTERISTIC
/begin CHARACTERISTIC CrCtl_facEcoFdbkAccnVal1_C "Acceleration feed back factor value under Gear no.1 for Eco mode" VALUE 0x80516EC4 Val_Ws16 255.9922 Fact1 0.00 255.9922 FORMAT "%8.4" EXTENDED_LIMITS -256.0000 255.9922 /end CHARACTERISTIC
/begin CHARACTERISTIC CrCtl_facEcoFdbkAccnVal2_C "Acceleration feed back factor value under Gear no.2 for Eco mode" VALUE 0x80516EC6 Val_Ws16 255.9922 Fact1 0.00 255.9922 FORMAT "%8.4" EXTENDED_LIMITS -256.0000 255.9922 /end CHARACTERISTIC
/begin CHARACTERISTIC CrCtl_facEcoFdbkAccnVal3_C "Acceleration feed back factor value under Gear no.3 for Eco mode" VALUE 0x80516EC8 Val_Ws16 255.9922 Fact1 0.00 255.9922 FORMAT "%8.4" EXTENDED_LIMITS -256.0000 255.9922 /end CHARACTERISTIC
/begin CHARACTERISTIC CrCtl_facEcoFdbkAccnVal4_C "Acceleration feed back factor value under Gear no.4 for Eco mode" VALUE 0x80516ECA Val_Ws16 255.9922 Fact1 0.00 255.9922 FORMAT "%8.4" EXTENDED_LIMITS -256.0000 255.9922 /end CHARACTERISTIC
/begin CHARACTERISTIC CrCtl_facEcoFdbkDReviVal0_C "Feed Back D factor revision value for Eco mode under Gear no.0" VALUE 0x80516ECC Val_Ws16 255.9922 Fact1 0.00 255.9922 FORMAT "%8.4" EXTENDED_LIMITS -256.0000 255.9922 /end CHARACTERISTIC
/begin CHARACTERISTIC CrCtl_facEcoFdbkDReviVal1_C "Feed Back D factor revision value for Eco mode under Gear no.1" VALUE 0x80516ECE Val_Ws16 255.9922 Fact1 0.00 255.9922 FORMAT "%8.4" EXTENDED_LIMITS -256.0000 255.9922 /end CHARACTERISTIC
/begin CHARACTERISTIC CrCtl_facEcoFdbkDReviVal2_C "Feed Back D factor revision value for Eco mode under Gear no.2" VALUE 0x80516ED0 Val_Ws16 255.9922 Fact1 0.00 255.9922 FORMAT "%8.4" EXTENDED_LIMITS -256.0000 255.9922 /end CHARACTERISTIC
/begin CHARACTERISTIC CrCtl_facEcoFdbkDReviVal3_C "Feed Back D factor revision value for Eco mode under Gear no.3" VALUE 0x80516ED2 Val_Ws16 255.9922 Fact1 0.00 255.9922 FORMAT "%8.4" EXTENDED_LIMITS -256.0000 255.9922 /end CHARACTERISTIC
/begin CHARACTERISTIC CrCtl_facEcoFdbkDReviVal4_C "Feed Back D factor revision value for Eco mode under Gear no.4" VALUE 0x80516ED4 Val_Ws16 255.9922 Fact1 0.00 255.9922 FORMAT "%8.4" EXTENDED_LIMITS -256.0000 255.9922 /end CHARACTERISTIC
/begin CHARACTERISTIC CrCtl_facEcoFdbkPReviVal0_C "Feed Back P factor revision value for Eco mode under Gear no.0" VALUE 0x80516ED6 Val_Ws16 255.9922 Fact1 0.00 255.9922 FORMAT "%8.4" EXTENDED_LIMITS -256.0000 255.9922 /end CHARACTERISTIC
/begin CHARACTERISTIC CrCtl_facEcoFdbkPReviVal1_C "Feed Back P factor revision value for Eco mode under Gear no.1" VALUE 0x80516ED8 Val_Ws16 255.9922 Fact1 0.00 255.9922 FORMAT "%8.4" EXTENDED_LIMITS -256.0000 255.9922 /end CHARACTERISTIC
/begin CHARACTERISTIC CrCtl_facEcoFdbkPReviVal2_C "Feed Back P factor revision value for Eco mode under Gear no.2" VALUE 0x80516EDA Val_Ws16 255.9922 Fact1 0.00 255.9922 FORMAT "%8.4" EXTENDED_LIMITS -256.0000 255.9922 /end CHARACTERISTIC
/begin CHARACTERISTIC CrCtl_facEcoFdbkPReviVal3_C "Feed Back P factor revision value for Eco mode under Gear no.3" VALUE 0x80516EDC Val_Ws16 255.9922 Fact1 0.00 255.9922 FORMAT "%8.4" EXTENDED_LIMITS -256.0000 255.9922 /end CHARACTERISTIC
/begin CHARACTERISTIC CrCtl_facEcoFdbkPReviVal4_C "Feed Back P factor revision value for Eco mode under Gear no.4" VALUE 0x80516EDE Val_Ws16 255.9922 Fact1 0.00 255.9922 FORMAT "%8.4" EXTENDED_LIMITS -256.0000 255.9922 /end CHARACTERISTIC
/begin CHARACTERISTIC CrCtl_facECOffAAppUp2_CUR "Acceleration factor for changing APP limitation number for ECON to 3 from 2 (for Acceleration and ECON sw OFF)" CURVE 0x80516EE0 RB_Cur_Xs16Ws16 0.9960938 Fact_CrCtl 0.00 0.9960938 FORMAT "%9.7" EXTENDED_LIMITS -128.0000 127.9961
 /begin AXIS_DESCR STD_AXIS CrCtl_tiDRAccnControl_mp Time_ms_100ms 6 -3276800. 3276700. FORMAT "%8.0" DEPOSIT ABSOLUTE /end AXIS_DESCR
/end CHARACTERISTIC
/begin CHARACTERISTIC CrCtl_facECOffAAppUp3_CUR "Acceleration factor for changing APP limitation number for ECON to 4 from 3 (for Acceleration and ECON sw OFF)" CURVE 0x80516EFA RB_Cur_Xs16Ws16 0.9960938 Fact_CrCtl 0.00 0.9960938 FORMAT "%9.7" EXTENDED_LIMITS -128.0000 127.9961
 /begin AXIS_DESCR STD_AXIS CrCtl_tiDRAccnControl_mp Time_ms_100ms 6 -3276800. 3276700. FORMAT "%8.0" DEPOSIT ABSOLUTE /end AXIS_DESCR
/end CHARACTERISTIC
/begin CHARACTERISTIC CrCtl_facECOffAAppUp4_CUR "Acceleration factor for changing APP limitation number for ECON to 5 from 4 (for Acceleration and ECON sw OFF)" CURVE 0x80516F14 RB_Cur_Xs16Ws16 0.9960938 Fact_CrCtl 0.00 0.9960938 FORMAT "%9.7" EXTENDED_LIMITS -128.0000 127.9961
 /begin AXIS_DESCR STD_AXIS CrCtl_tiDRAccnControl_mp Time_ms_100ms 6 -3276800. 3276700. FORMAT "%8.0" DEPOSIT ABSOLUTE /end AXIS_DESCR
/end CHARACTERISTIC
/begin CHARACTERISTIC CrCtl_facECOffAAppUp5_CUR "Acceleration factor for changing APP limitation number for ECON to 2 from 1 (for Acceleration and ECON sw ON)" CURVE 0x80516F2E RB_Cur_Xs16Ws16 0.9960938 Fact_CrCtl 0.00 0.9960938 FORMAT "%9.7" EXTENDED_LIMITS -128.0000 127.9961
 /begin AXIS_DESCR STD_AXIS CrCtl_tiDRAccnControl_mp Time_ms_100ms 6 -3276800. 3276700. FORMAT "%8.0" DEPOSIT ABSOLUTE /end AXIS_DESCR
/end CHARACTERISTIC
/begin CHARACTERISTIC CrCtl_facECOffAFbUp2_CUR "Acceleration factor for changing APP limitation number for ECON to 3 from 2 (for FB and ECON sw OFF)" CURVE 0x80516F48 RB_Cur_Xs16Ws16 0.9960938 Fact_CrCtl 0.00 0.9960938 FORMAT "%9.7" EXTENDED_LIMITS -128.0000 127.9961
 /begin AXIS_DESCR STD_AXIS CrCtl_vSpdVar_mp Vel_CrCtl 6 -128.0000 127.9961 FORMAT "%8.4" DEPOSIT ABSOLUTE /end AXIS_DESCR
/end CHARACTERISTIC
/begin CHARACTERISTIC CrCtl_facECOffAFbUp3_CUR "Acceleration factor for changing APP limitation number for ECON to 4 from 3 (for FB and ECON sw OFF)" CURVE 0x80516F62 RB_Cur_Xs16Ws16 0.9960938 Fact_CrCtl 0.00 0.9960938 FORMAT "%9.7" EXTENDED_LIMITS -128.0000 127.9961
 /begin AXIS_DESCR STD_AXIS CrCtl_vSpdVar_mp Vel_CrCtl 6 -128.0000 127.9961 FORMAT "%8.4" DEPOSIT ABSOLUTE /end AXIS_DESCR
/end CHARACTERISTIC
/begin CHARACTERISTIC CrCtl_facECOffAFbUp4_CUR "Acceleration factor for changing APP limitation number for ECON to 5 from 4 (for FB and ECON sw OFF)" CURVE 0x80516F7C RB_Cur_Xs16Ws16 0.9960938 Fact_CrCtl 0.00 0.9960938 FORMAT "%9.7" EXTENDED_LIMITS -128.0000 127.9961
 /begin AXIS_DESCR STD_AXIS CrCtl_vSpdVar_mp Vel_CrCtl 6 -128.0000 127.9961 FORMAT "%8.4" DEPOSIT ABSOLUTE /end AXIS_DESCR
/end CHARACTERISTIC
/begin CHARACTERISTIC CrCtl_facECOffAFbUp5_CUR "Acceleration factor for changing APP limitation number for ECON to 2 from 1 (for FB and ECON sw ON)" CURVE 0x80516F96 RB_Cur_Xs16Ws16 0.9960938 Fact_CrCtl 0.00 0.9960938 FORMAT "%9.7" EXTENDED_LIMITS -128.0000 127.9961
 /begin AXIS_DESCR STD_AXIS CrCtl_vSpdVar_mp Vel_CrCtl 6 -128.0000 127.9961 FORMAT "%8.4" DEPOSIT ABSOLUTE /end AXIS_DESCR
/end CHARACTERISTIC
/begin CHARACTERISTIC CrCtl_facECOffAResUp2_MAP "Acceleration factor for changing APP limitation number for ECON to 3 from 2 (for Resume and ECON sw OFF)" MAP 0x80516FB0 Map_Xs16Ys16Ws16 0.9960938 Fact_CrCtl 0.00 0.9960938 FORMAT "%9.7" EXTENDED_LIMITS -128.0000 127.9961
 /begin AXIS_DESCR STD_AXIS CrCtl_tiDRAccnControl_mp Time_ms_100ms 6 -3276800. 3276700. FORMAT "%8.0" DEPOSIT ABSOLUTE /end AXIS_DESCR
 /begin AXIS_DESCR STD_AXIS CrCtl_vSpdVar_mp Vel_CrCtl 6 -128.0000 127.9961 FORMAT "%8.4" DEPOSIT ABSOLUTE /end AXIS_DESCR
/end CHARACTERISTIC
/begin CHARACTERISTIC CrCtl_facECOffAResUp3_MAP "Acceleration factor for changing APP limitation number for ECON to 4 from 3 (for Resume and ECON sw OFF)" MAP 0x80517014 Map_Xs16Ys16Ws16 0.9960938 Fact_CrCtl 0.00 0.9960938 FORMAT "%9.7" EXTENDED_LIMITS -128.0000 127.9961
 /begin AXIS_DESCR STD_AXIS CrCtl_tiDRAccnControl_mp Time_ms_100ms 6 -3276800. 3276700. FORMAT "%8.0" DEPOSIT ABSOLUTE /end AXIS_DESCR
 /begin AXIS_DESCR STD_AXIS CrCtl_vSpdVar_mp Vel_CrCtl 6 -128.0000 127.9961 FORMAT "%8.4" DEPOSIT ABSOLUTE /end AXIS_DESCR
/end CHARACTERISTIC
/begin CHARACTERISTIC CrCtl_facECOffAResUp4_MAP "Acceleration factor for changing APP limitation number for ECON to 5 from 4 (for Resume and ECON sw OFF)" MAP 0x80517078 Map_Xs16Ys16Ws16 0.9960938 Fact_CrCtl 0.00 0.9960938 FORMAT "%9.7" EXTENDED_LIMITS -128.0000 127.9961
 /begin AXIS_DESCR STD_AXIS CrCtl_tiDRAccnControl_mp Time_ms_100ms 6 -3276800. 3276700. FORMAT "%8.0" DEPOSIT ABSOLUTE /end AXIS_DESCR
 /begin AXIS_DESCR STD_AXIS CrCtl_vSpdVar_mp Vel_CrCtl 6 -128.0000 127.9961 FORMAT "%8.4" DEPOSIT ABSOLUTE /end AXIS_DESCR
/end CHARACTERISTIC
/begin CHARACTERISTIC CrCtl_facECOffAResUp5_MAP "Acceleration factor for changing APP limitation number for ECON to 2 from 1 (for Resume and ECON sw ON)" MAP 0x805170DC Map_Xs16Ys16Ws16 0.9960938 Fact_CrCtl 0.00 0.9960938 FORMAT "%9.7" EXTENDED_LIMITS -128.0000 127.9961
 /begin AXIS_DESCR STD_AXIS CrCtl_tiDRAccnControl_mp Time_ms_100ms 6 -3276800. 3276700. FORMAT "%8.0" DEPOSIT ABSOLUTE /end AXIS_DESCR
 /begin AXIS_DESCR STD_AXIS CrCtl_vSpdVar_mp Vel_CrCtl 6 -128.0000 127.9961 FORMAT "%8.4" DEPOSIT ABSOLUTE /end AXIS_DESCR
/end CHARACTERISTIC
/begin CHARACTERISTIC CrCtl_facECOnAAppUp2_CUR "Acceleration factor for changing APP limitation number for ECON to 3 from 2 (for Acceleration and ECON sw ON)" CURVE 0x80517140 RB_Cur_Xs16Ws16 0.9960938 Fact_CrCtl 0.00 0.9960938 FORMAT "%9.7" EXTENDED_LIMITS -128.0000 127.9961
 /begin AXIS_DESCR STD_AXIS CrCtl_tiDRAccnControl_mp Time_ms_100ms 6 -3276800. 3276700. FORMAT "%8.0" DEPOSIT ABSOLUTE /end AXIS_DESCR
/end CHARACTERISTIC
/begin CHARACTERISTIC CrCtl_facECOnAAppUp3_CUR "Acceleration factor for changing APP limitation number for ECON to 4 from 3 (for Acceleration and ECON sw ON)" CURVE 0x8051715A RB_Cur_Xs16Ws16 0.9960938 Fact_CrCtl 0.00 0.9960938 FORMAT "%9.7" EXTENDED_LIMITS -128.0000 127.9961
 /begin AXIS_DESCR STD_AXIS CrCtl_tiDRAccnControl_mp Time_ms_100ms 6 -3276800. 3276700. FORMAT "%8.0" DEPOSIT ABSOLUTE /end AXIS_DESCR
/end CHARACTERISTIC
/begin CHARACTERISTIC CrCtl_facECOnAAppUp4_CUR "Acceleration factor for changing APP limitation number for ECON to 5 from 4 (for Acceleration and ECON sw ON)" CURVE 0x80517174 RB_Cur_Xs16Ws16 0.9960938 Fact_CrCtl 0.00 0.9960938 FORMAT "%9.7" EXTENDED_LIMITS -128.0000 127.9961
 /begin AXIS_DESCR STD_AXIS CrCtl_tiDRAccnControl_mp Time_ms_100ms 6 -3276800. 3276700. FORMAT "%8.0" DEPOSIT ABSOLUTE /end AXIS_DESCR
/end CHARACTERISTIC
/begin CHARACTERISTIC CrCtl_facECOnAAppUp5_CUR "Acceleration factor for changing APP limitation number for ECON to 2 from 1 (for Acceleration , ECON sw OFF, and during ACC)" CURVE 0x8051718E RB_Cur_Xs16Ws16 0.9960938 Fact_CrCtl 0.00 0.9960938 FORMAT "%9.7" EXTENDED_LIMITS -128.0000 127.9961
 /begin AXIS_DESCR STD_AXIS CrCtl_tiDRAccnControl_mp Time_ms_100ms 6 -3276800. 3276700. FORMAT "%8.0" DEPOSIT ABSOLUTE /end AXIS_DESCR
/end CHARACTERISTIC
/begin CHARACTERISTIC CrCtl_facECOnAFbUp2_CUR "Acceleration factor for changing APP limitation number for ECON to 3 from 2 (for FB and ECON sw ON)" CURVE 0x805171A8 RB_Cur_Xs16Ws16 0.9960938 Fact_CrCtl 0.00 0.9960938 FORMAT "%9.7" EXTENDED_LIMITS -128.0000 127.9961
 /begin AXIS_DESCR STD_AXIS CrCtl_vSpdVar_mp Vel_CrCtl 6 -128.0000 127.9961 FORMAT "%8.4" DEPOSIT ABSOLUTE /end AXIS_DESCR
/end CHARACTERISTIC
/begin CHARACTERISTIC CrCtl_facECOnAFbUp3_CUR "Acceleration factor for changing APP limitation number for ECON to 4 from 3 (for FB and ECON sw ON)" CURVE 0x805171C2 RB_Cur_Xs16Ws16 0.9960938 Fact_CrCtl 0.00 0.9960938 FORMAT "%9.7" EXTENDED_LIMITS -128.0000 127.9961
 /begin AXIS_DESCR STD_AXIS CrCtl_vSpdVar_mp Vel_CrCtl 6 -128.0000 127.9961 FORMAT "%8.4" DEPOSIT ABSOLUTE /end AXIS_DESCR
/end CHARACTERISTIC
/begin CHARACTERISTIC CrCtl_facECOnAFbUp4_CUR "Acceleration factor for changing APP limitation number for ECON to 5 from 4 (for FB and ECON sw ON)" CURVE 0x805171DC RB_Cur_Xs16Ws16 0.9960938 Fact_CrCtl 0.00 0.9960938 FORMAT "%9.7" EXTENDED_LIMITS -128.0000 127.9961
 /begin AXIS_DESCR STD_AXIS CrCtl_vSpdVar_mp Vel_CrCtl 6 -128.0000 127.9961 FORMAT "%8.4" DEPOSIT ABSOLUTE /end AXIS_DESCR
/end CHARACTERISTIC
/begin CHARACTERISTIC CrCtl_facECOnAFbUp5_CUR "Acceleration factor for changing APP limitation number for ECON to 2 from 1 (for FB, ECON sw OFF, and during ACC)" CURVE 0x805171F6 RB_Cur_Xs16Ws16 0.9960938 Fact_CrCtl 0.00 0.9960938 FORMAT "%9.7" EXTENDED_LIMITS -128.0000 127.9961
 /begin AXIS_DESCR STD_AXIS CrCtl_vSpdVar_mp Vel_CrCtl 6 -128.0000 127.9961 FORMAT "%8.4" DEPOSIT ABSOLUTE /end AXIS_DESCR
/end CHARACTERISTIC
/begin CHARACTERISTIC CrCtl_facECOnAResUp2_MAP "Acceleration factor for changing APP limitation number for ECON to 3 from 2 (for Resume and ECON sw ON)" MAP 0x80517210 Map_Xs16Ys16Ws16 0.9960938 Fact_CrCtl 0.00 0.9960938 FORMAT "%9.7" EXTENDED_LIMITS -128.0000 127.9961
 /begin AXIS_DESCR STD_AXIS CrCtl_tiDRAccnControl_mp Time_ms_100ms 6 -3276800. 3276700. FORMAT "%8.0" DEPOSIT ABSOLUTE /end AXIS_DESCR
 /begin AXIS_DESCR STD_AXIS CrCtl_vSpdVar_mp Vel_CrCtl 6 -128.0000 127.9961 FORMAT "%8.4" DEPOSIT ABSOLUTE /end AXIS_DESCR
/end CHARACTERISTIC
/begin CHARACTERISTIC CrCtl_facECOnAResUp3_MAP "Acceleration factor for changing APP limitation number for ECON to 4 from 3 (for Resume and ECON sw ON)" MAP 0x80517274 Map_Xs16Ys16Ws16 0.9960938 Fact_CrCtl 0.00 0.9960938 FORMAT "%9.7" EXTENDED_LIMITS -128.0000 127.9961
 /begin AXIS_DESCR STD_AXIS CrCtl_tiDRAccnControl_mp Time_ms_100ms 6 -3276800. 3276700. FORMAT "%8.0" DEPOSIT ABSOLUTE /end AXIS_DESCR
 /begin AXIS_DESCR STD_AXIS CrCtl_vSpdVar_mp Vel_CrCtl 6 -128.0000 127.9961 FORMAT "%8.4" DEPOSIT ABSOLUTE /end AXIS_DESCR
/end CHARACTERISTIC
/begin CHARACTERISTIC CrCtl_facECOnAResUp4_MAP "Acceleration factor for changing APP limitation number for ECON to 5 from 4 (for Resume and ECON sw ON)" MAP 0x805172D8 Map_Xs16Ys16Ws16 0.9960938 Fact_CrCtl 0.00 0.9960938 FORMAT "%9.7" EXTENDED_LIMITS -128.0000 127.9961
 /begin AXIS_DESCR STD_AXIS CrCtl_tiDRAccnControl_mp Time_ms_100ms 6 -3276800. 3276700. FORMAT "%8.0" DEPOSIT ABSOLUTE /end AXIS_DESCR
 /begin AXIS_DESCR STD_AXIS CrCtl_vSpdVar_mp Vel_CrCtl 6 -128.0000 127.9961 FORMAT "%8.4" DEPOSIT ABSOLUTE /end AXIS_DESCR
/end CHARACTERISTIC
/begin CHARACTERISTIC CrCtl_facECOnAResUp5_MAP "Acceleration factor for changing APP limitation number for ECON to 2 from 1 (for Resume, ECON sw OFF, and during ACC)" MAP 0x8051733C Map_Xs16Ys16Ws16 0.9960938 Fact_CrCtl 0.00 0.9960938 FORMAT "%9.7" EXTENDED_LIMITS -128.0000 127.9961
 /begin AXIS_DESCR STD_AXIS CrCtl_tiDRAccnControl_mp Time_ms_100ms 6 -3276800. 3276700. FORMAT "%8.0" DEPOSIT ABSOLUTE /end AXIS_DESCR
 /begin AXIS_DESCR STD_AXIS CrCtl_vSpdVar_mp Vel_CrCtl 6 -128.0000 127.9961 FORMAT "%8.4" DEPOSIT ABSOLUTE /end AXIS_DESCR
/end CHARACTERISTIC
/begin CHARACTERISTIC CrCtl_facECTGAppDiffCls_GMAP "Correct value of APP in top gear for ECON and close side" MAP 0x805173A0 MapG_Ws16 511.9922 Fact1 -256.0000 255.9922 FORMAT "%8.4"
 /begin AXIS_DESCR COM_AXIS CrCtl_rReq_mp APPCrCtl1 12 0.00 163.8350 FORMAT "%8.4" EXTENDED_LIMITS -163.8400 163.8350 AXIS_PTS_REF CrCtl_facAPPReviX_AXIS /end AXIS_DESCR
 /begin AXIS_DESCR COM_AXIS CrCtl_vVehUpByte Vel_CrCtl1 6 0.00 255.0000 FORMAT "%8.4" EXTENDED_LIMITS -32768.00 32767.00 AXIS_PTS_REF CrCtl_facAPPReviY_AXIS /end AXIS_DESCR
/end CHARACTERISTIC
/begin CHARACTERISTIC CrCtl_facECTGAppDiff_GMAP "Correct value of APP in excepting top gear for ECON" MAP 0x80517430 MapG_Ws16 511.9922 Fact1 -256.0000 255.9922 FORMAT "%8.4"
 /begin AXIS_DESCR COM_AXIS CrCtl_rReq_mp APPCrCtl1 12 0.00 163.8350 FORMAT "%8.4" EXTENDED_LIMITS -163.8400 163.8350 AXIS_PTS_REF CrCtl_facAPPReviX_AXIS /end AXIS_DESCR
 /begin AXIS_DESCR COM_AXIS CrCtl_vVehUpByte Vel_CrCtl1 6 0.00 255.0000 FORMAT "%8.4" EXTENDED_LIMITS -32768.00 32767.00 AXIS_PTS_REF CrCtl_facAPPReviY_AXIS /end AXIS_DESCR
/end CHARACTERISTIC
/begin CHARACTERISTIC CrCtl_facFbACmftD12_GMAP "MAP for acceleration Feed Back D factor for comfort mode" MAP 0x805174C0 MapG_Ws16 511.9844 Fact_CrCtl2 0.00 511.9844 FORMAT "%8.4" EXTENDED_LIMITS -512.0000 511.9844
 /begin AXIS_DESCR COM_AXIS CrCtl_vVehUpByte Vel_CrCtl1 12 0.00 255.0000 FORMAT "%8.4" EXTENDED_LIMITS -32768.00 32767.00 AXIS_PTS_REF CrCtl_facFbAX_AXIS /end AXIS_DESCR
 /begin AXIS_DESCR COM_AXIS CrCtl_vAccnVar_mp Vel_CrCtl 9 -128.0000 127.9961 FORMAT "%8.4" AXIS_PTS_REF CrCtl_facFbAY_AXIS /end AXIS_DESCR
/end CHARACTERISTIC
/begin CHARACTERISTIC CrCtl_facFbACmftP12_GMAP "MAP for acceleration Feed Back P factor for comfort mode" MAP 0x80517598 MapG_Ws16 511.9844 Fact_CrCtl2 0.00 511.9844 FORMAT "%8.4" EXTENDED_LIMITS -512.0000 511.9844
 /begin AXIS_DESCR COM_AXIS CrCtl_vVehUpByte Vel_CrCtl1 12 0.00 255.0000 FORMAT "%8.4" EXTENDED_LIMITS -32768.00 32767.00 AXIS_PTS_REF CrCtl_facFbAX_AXIS /end AXIS_DESCR
 /begin AXIS_DESCR COM_AXIS CrCtl_vAccnVar_mp Vel_CrCtl 9 -128.0000 127.9961 FORMAT "%8.4" AXIS_PTS_REF CrCtl_facFbAY_AXIS /end AXIS_DESCR
/end CHARACTERISTIC
/begin CHARACTERISTIC CrCtl_facFbAD12_GMAP "Map for acceleration FeedBack D factor" MAP 0x80517670 MapG_Ws16 511.9844 Fact_CrCtl2 0.00 511.9844 FORMAT "%8.4" EXTENDED_LIMITS -512.0000 511.9844
 /begin AXIS_DESCR COM_AXIS CrCtl_vVehUpByte Vel_CrCtl1 12 0.00 255.0000 FORMAT "%8.4" EXTENDED_LIMITS -32768.00 32767.00 AXIS_PTS_REF CrCtl_facFbAX_AXIS /end AXIS_DESCR
 /begin AXIS_DESCR COM_AXIS CrCtl_vAccnVar_mp Vel_CrCtl 9 -128.0000 127.9961 FORMAT "%8.4" AXIS_PTS_REF CrCtl_facFbAY_AXIS /end AXIS_DESCR
/end CHARACTERISTIC
/begin CHARACTERISTIC CrCtl_facFbAEcoD12_GMAP "Map for acceleration FeedBack D factor for Eco mode" MAP 0x80517748 MapG_Ws16 511.9844 Fact_CrCtl2 0.00 511.9844 FORMAT "%8.4" EXTENDED_LIMITS -512.0000 511.9844
 /begin AXIS_DESCR COM_AXIS CrCtl_vVehUpByte Vel_CrCtl1 12 0.00 255.0000 FORMAT "%8.4" EXTENDED_LIMITS -32768.00 32767.00 AXIS_PTS_REF CrCtl_facFbAX_AXIS /end AXIS_DESCR
 /begin AXIS_DESCR COM_AXIS CrCtl_vAccnVar_mp Vel_CrCtl 9 -128.0000 127.9961 FORMAT "%8.4" AXIS_PTS_REF CrCtl_facFbAY_AXIS /end AXIS_DESCR
/end CHARACTERISTIC
/begin CHARACTERISTIC CrCtl_facFbAEcoP12_GMAP "Map for acceleration FeedBack P factor for Eco mode" MAP 0x80517820 MapG_Ws16 511.9844 Fact_CrCtl2 0.00 511.9844 FORMAT "%8.4" EXTENDED_LIMITS -512.0000 511.9844
 /begin AXIS_DESCR COM_AXIS CrCtl_vVehUpByte Vel_CrCtl1 12 0.00 255.0000 FORMAT "%8.4" EXTENDED_LIMITS -32768.00 32767.00 AXIS_PTS_REF CrCtl_facFbAX_AXIS /end AXIS_DESCR
 /begin AXIS_DESCR COM_AXIS CrCtl_vAccnVar_mp Vel_CrCtl 9 -128.0000 127.9961 FORMAT "%8.4" AXIS_PTS_REF CrCtl_facFbAY_AXIS /end AXIS_DESCR
/end CHARACTERISTIC
/begin CHARACTERISTIC CrCtl_facFbAP12_GMAP "Map for acceleration FeedBack P factor" MAP 0x805178F8 MapG_Ws16 511.9844 Fact_CrCtl2 0.00 511.9844 FORMAT "%8.4" EXTENDED_LIMITS -512.0000 511.9844
 /begin AXIS_DESCR COM_AXIS CrCtl_vVehUpByte Vel_CrCtl1 12 0.00 255.0000 FORMAT "%8.4" EXTENDED_LIMITS -32768.00 32767.00 AXIS_PTS_REF CrCtl_facFbAX_AXIS /end AXIS_DESCR
 /begin AXIS_DESCR COM_AXIS CrCtl_vAccnVar_mp Vel_CrCtl 9 -128.0000 127.9961 FORMAT "%8.4" AXIS_PTS_REF CrCtl_facFbAY_AXIS /end AXIS_DESCR
/end CHARACTERISTIC
/begin AXIS_PTS CrCtl_facFbAreaX_AXIS "X-Axis for vehicle speed feed back APP request group MAP" 0x805179D0 CrCtl_vDesUpByte_mp Axis_Xs16 255.0000 Vel_CrCtl1 12 0.00 255.0000 FORMAT "%8.4" EXTENDED_LIMITS -32768.00 32767.00 DEPOSIT ABSOLUTE /end AXIS_PTS
/begin AXIS_PTS CrCtl_facFbAreaY_AXIS "Y-Axis for vehicle speed feed back APP request group MAP" 0x805179EA CrCtl_vSpdVar_mp Axis_Xs16 255.9961 Vel_CrCtl 12 -128.0000 127.9961 FORMAT "%8.4" DEPOSIT ABSOLUTE /end AXIS_PTS
/begin CHARACTERISTIC CrCtl_facFbASptD12_GMAP "Map for acceleration FeedBack D factor for Sport mode" MAP 0x80517A04 MapG_Ws16 511.9844 Fact_CrCtl2 0.00 511.9844 FORMAT "%8.4" EXTENDED_LIMITS -512.0000 511.9844
 /begin AXIS_DESCR COM_AXIS CrCtl_vVehUpByte Vel_CrCtl1 12 0.00 255.0000 FORMAT "%8.4" EXTENDED_LIMITS -32768.00 32767.00 AXIS_PTS_REF CrCtl_facFbAX_AXIS /end AXIS_DESCR
 /begin AXIS_DESCR COM_AXIS CrCtl_vAccnVar_mp Vel_CrCtl 9 -128.0000 127.9961 FORMAT "%8.4" AXIS_PTS_REF CrCtl_facFbAY_AXIS /end AXIS_DESCR
/end CHARACTERISTIC
/begin CHARACTERISTIC CrCtl_facFbASptP12_GMAP "Map for acceleration FeedBack P factor for Sport mode" MAP 0x80517ADC MapG_Ws16 511.9844 Fact_CrCtl2 0.00 511.9844 FORMAT "%8.4" EXTENDED_LIMITS -512.0000 511.9844
 /begin AXIS_DESCR COM_AXIS CrCtl_vVehUpByte Vel_CrCtl1 12 0.00 255.0000 FORMAT "%8.4" EXTENDED_LIMITS -32768.00 32767.00 AXIS_PTS_REF CrCtl_facFbAX_AXIS /end AXIS_DESCR
 /begin AXIS_DESCR COM_AXIS CrCtl_vAccnVar_mp Vel_CrCtl 9 -128.0000 127.9961 FORMAT "%8.4" AXIS_PTS_REF CrCtl_facFbAY_AXIS /end AXIS_DESCR
/end CHARACTERISTIC
/begin AXIS_PTS CrCtl_facFbAX_AXIS "X-Asix for output acceleration factor of Group MAP" 0x80517BB4 CrCtl_vVehUpByte Axis_Xs16 255.0000 Vel_CrCtl1 12 0.00 255.0000 FORMAT "%8.4" EXTENDED_LIMITS -32768.00 32767.00 DEPOSIT ABSOLUTE /end AXIS_PTS
/begin AXIS_PTS CrCtl_facFbAY_AXIS "Y-Asix for output acceleration factor of Group MAP" 0x80517BCE CrCtl_vAccnVar_mp Axis_Xs16 255.9961 Vel_CrCtl 9 -128.0000 127.9961 FORMAT "%8.4" DEPOSIT ABSOLUTE /end AXIS_PTS
/begin CHARACTERISTIC CrCtl_facFbCmftD12_GMAP "MAP for vehicle speed feed back area D factor value for comfort mode" MAP 0x80517BE2 MapG_Ws16 511.9844 Fact_CrCtl2 0.00 511.9844 FORMAT "%8.4" EXTENDED_LIMITS -512.0000 511.9844
 /begin AXIS_DESCR COM_AXIS CrCtl_vDesUpByte_mp Vel_CrCtl1 12 0.00 255.0000 FORMAT "%8.4" EXTENDED_LIMITS -32768.00 32767.00 AXIS_PTS_REF CrCtl_facFbAreaX_AXIS /end AXIS_DESCR
 /begin AXIS_DESCR COM_AXIS CrCtl_vSpdVar_mp Vel_CrCtl 12 -128.0000 127.9961 FORMAT "%8.4" AXIS_PTS_REF CrCtl_facFbAreaY_AXIS /end AXIS_DESCR
/end CHARACTERISTIC
/begin CHARACTERISTIC CrCtl_facFbCmftP12_GMAP "MAP for vehicle speed feed back area P factor value for comfort mode" MAP 0x80517D02 MapG_Ws16 31.99902 Fact_CrCtl3 0.00 31.99902 FORMAT "%8.5" EXTENDED_LIMITS -32.00000 31.99902
 /begin AXIS_DESCR COM_AXIS CrCtl_vDesUpByte_mp Vel_CrCtl1 12 0.00 255.0000 FORMAT "%8.4" EXTENDED_LIMITS -32768.00 32767.00 AXIS_PTS_REF CrCtl_facFbAreaX_AXIS /end AXIS_DESCR
 /begin AXIS_DESCR COM_AXIS CrCtl_vSpdVar_mp Vel_CrCtl 12 -128.0000 127.9961 FORMAT "%8.4" AXIS_PTS_REF CrCtl_facFbAreaY_AXIS /end AXIS_DESCR
/end CHARACTERISTIC
/begin CHARACTERISTIC CrCtl_facFbD12_GMAP "MAP for vehicle speed feed back area D factor value for normal mode" MAP 0x80517E22 MapG_Ws16 511.9844 Fact_CrCtl2 0.00 511.9844 FORMAT "%8.4" EXTENDED_LIMITS -512.0000 511.9844
 /begin AXIS_DESCR COM_AXIS CrCtl_vDesUpByte_mp Vel_CrCtl1 12 0.00 255.0000 FORMAT "%8.4" EXTENDED_LIMITS -32768.00 32767.00 AXIS_PTS_REF CrCtl_facFbAreaX_AXIS /end AXIS_DESCR
 /begin AXIS_DESCR COM_AXIS CrCtl_vSpdVar_mp Vel_CrCtl 12 -128.0000 127.9961 FORMAT "%8.4" AXIS_PTS_REF CrCtl_facFbAreaY_AXIS /end AXIS_DESCR
/end CHARACTERISTIC
/begin CHARACTERISTIC CrCtl_facFbEcoD12_GMAP "MAP for vehicle speed feed back area D factor value for economy mode" MAP 0x80517F42 MapG_Ws16 511.9844 Fact_CrCtl2 0.00 511.9844 FORMAT "%8.4" EXTENDED_LIMITS -512.0000 511.9844
 /begin AXIS_DESCR COM_AXIS CrCtl_vDesUpByte_mp Vel_CrCtl1 12 0.00 255.0000 FORMAT "%8.4" EXTENDED_LIMITS -32768.00 32767.00 AXIS_PTS_REF CrCtl_facFbAreaX_AXIS /end AXIS_DESCR
 /begin AXIS_DESCR COM_AXIS CrCtl_vSpdVar_mp Vel_CrCtl 12 -128.0000 127.9961 FORMAT "%8.4" AXIS_PTS_REF CrCtl_facFbAreaY_AXIS /end AXIS_DESCR
/end CHARACTERISTIC
/begin CHARACTERISTIC CrCtl_facFbEcoP12_GMAP "MAP for vehicle speed feed back area P factor value for economy mode" MAP 0x80518062 MapG_Ws16 31.99902 Fact_CrCtl3 0.00 31.99902 FORMAT "%8.5" EXTENDED_LIMITS -32.00000 31.99902
 /begin AXIS_DESCR COM_AXIS CrCtl_vDesUpByte_mp Vel_CrCtl1 12 0.00 255.0000 FORMAT "%8.4" EXTENDED_LIMITS -32768.00 32767.00 AXIS_PTS_REF CrCtl_facFbAreaX_AXIS /end AXIS_DESCR
 /begin AXIS_DESCR COM_AXIS CrCtl_vSpdVar_mp Vel_CrCtl 12 -128.0000 127.9961 FORMAT "%8.4" AXIS_PTS_REF CrCtl_facFbAreaY_AXIS /end AXIS_DESCR
/end CHARACTERISTIC
/begin CHARACTERISTIC CrCtl_facFbP12_GMAP "MAP for vehicle speed feed back area D factor value for normal mode" MAP 0x80518182 MapG_Ws16 31.99902 Fact_CrCtl3 0.00 31.99902 FORMAT "%8.5" EXTENDED_LIMITS -32.00000 31.99902
 /begin AXIS_DESCR COM_AXIS CrCtl_vDesUpByte_mp Vel_CrCtl1 12 0.00 255.0000 FORMAT "%8.4" EXTENDED_LIMITS -32768.00 32767.00 AXIS_PTS_REF CrCtl_facFbAreaX_AXIS /end AXIS_DESCR
 /begin AXIS_DESCR COM_AXIS CrCtl_vSpdVar_mp Vel_CrCtl 12 -128.0000 127.9961 FORMAT "%8.4" AXIS_PTS_REF CrCtl_facFbAreaY_AXIS /end AXIS_DESCR
/end CHARACTERISTIC
/begin CHARACTERISTIC CrCtl_facFbPlusRD12_GMAP "MAP for vehicle speed feed back area D factor value for Plus R mode" MAP 0x805182A2 MapG_Ws16 511.9844 Fact_CrCtl2 0.00 511.9844 FORMAT "%8.4" EXTENDED_LIMITS -512.0000 511.9844
 /begin AXIS_DESCR COM_AXIS CrCtl_vDesUpByte_mp Vel_CrCtl1 12 0.00 255.0000 FORMAT "%8.4" EXTENDED_LIMITS -32768.00 32767.00 AXIS_PTS_REF CrCtl_facFbAreaX_AXIS /end AXIS_DESCR
 /begin AXIS_DESCR COM_AXIS CrCtl_vSpdVar_mp Vel_CrCtl 12 -128.0000 127.9961 FORMAT "%8.4" AXIS_PTS_REF CrCtl_facFbAreaY_AXIS /end AXIS_DESCR
/end CHARACTERISTIC
/begin CHARACTERISTIC CrCtl_facFbPlusRP12_GMAP "MAP for vehicle speed feed back area P factor value for Plus R mode" MAP 0x805183C2 MapG_Ws16 31.99902 Fact_CrCtl3 0.00 31.99902 FORMAT "%8.5" EXTENDED_LIMITS -32.00000 31.99902
 /begin AXIS_DESCR COM_AXIS CrCtl_vDesUpByte_mp Vel_CrCtl1 12 0.00 255.0000 FORMAT "%8.4" EXTENDED_LIMITS -32768.00 32767.00 AXIS_PTS_REF CrCtl_facFbAreaX_AXIS /end AXIS_DESCR
 /begin AXIS_DESCR COM_AXIS CrCtl_vSpdVar_mp Vel_CrCtl 12 -128.0000 127.9961 FORMAT "%8.4" AXIS_PTS_REF CrCtl_facFbAreaY_AXIS /end AXIS_DESCR
/end CHARACTERISTIC
/begin CHARACTERISTIC CrCtl_facFbSptD12_GMAP "MAP for vehicle speed feed back area D factor value for sport mode" MAP 0x805184E2 MapG_Ws16 511.9844 Fact_CrCtl2 0.00 511.9844 FORMAT "%8.4" EXTENDED_LIMITS -512.0000 511.9844
 /begin AXIS_DESCR COM_AXIS CrCtl_vDesUpByte_mp Vel_CrCtl1 12 0.00 255.0000 FORMAT "%8.4" EXTENDED_LIMITS -32768.00 32767.00 AXIS_PTS_REF CrCtl_facFbAreaX_AXIS /end AXIS_DESCR
 /begin AXIS_DESCR COM_AXIS CrCtl_vSpdVar_mp Vel_CrCtl 12 -128.0000 127.9961 FORMAT "%8.4" AXIS_PTS_REF CrCtl_facFbAreaY_AXIS /end AXIS_DESCR
/end CHARACTERISTIC
/begin CHARACTERISTIC CrCtl_facFbSptP12_GMAP "MAP for vehicle speed feed back area P factor value for sport mode" MAP 0x80518602 MapG_Ws16 31.99902 Fact_CrCtl3 0.00 31.99902 FORMAT "%8.5" EXTENDED_LIMITS -32.00000 31.99902
 /begin AXIS_DESCR COM_AXIS CrCtl_vDesUpByte_mp Vel_CrCtl1 12 0.00 255.0000 FORMAT "%8.4" EXTENDED_LIMITS -32768.00 32767.00 AXIS_PTS_REF CrCtl_facFbAreaX_AXIS /end AXIS_DESCR
 /begin AXIS_DESCR COM_AXIS CrCtl_vSpdVar_mp Vel_CrCtl 12 -128.0000 127.9961 FORMAT "%8.4" AXIS_PTS_REF CrCtl_facFbAreaY_AXIS /end AXIS_DESCR
/end CHARACTERISTIC
/begin CHARACTERISTIC CrCtl_facFdbkAccnP0Kmh_GCUR "Curve for acceleration Feed Back P factor 0 value(Km/h spec)" CURVE 0x80518722 CurG_Ws16 511.9844 Fact_CrCtl2 0.00 511.9844 FORMAT "%8.4" EXTENDED_LIMITS -512.0000 511.9844
 /begin AXIS_DESCR COM_AXIS CrCtl_vVehUpByte Vel_CrCtl1 6 0.00 255.0000 FORMAT "%8.4" EXTENDED_LIMITS -32768.00 32767.00 AXIS_PTS_REF CrCtl_vAccnCont_AXIS /end AXIS_DESCR
/end CHARACTERISTIC
/begin CHARACTERISTIC CrCtl_facFdbkAccnP0_GCUR "Curve for acceleration Feed Back P factor 0 value" CURVE 0x8051872E CurG_Ws16 511.9844 Fact_CrCtl2 0.00 511.9844 FORMAT "%8.4" EXTENDED_LIMITS -512.0000 511.9844
 /begin AXIS_DESCR COM_AXIS CrCtl_vVehUpByte Vel_CrCtl1 6 0.00 255.0000 FORMAT "%8.4" EXTENDED_LIMITS -32768.00 32767.00 AXIS_PTS_REF CrCtl_vAccnCont_AXIS /end AXIS_DESCR
/end CHARACTERISTIC
/begin CHARACTERISTIC CrCtl_facFdbkAccnP1Kmh_GCUR "Curve for acceleration Feed Back P factor 1 value(Km/h spec)" CURVE 0x8051873A CurG_Ws16 511.9844 Fact_CrCtl2 0.00 511.9844 FORMAT "%8.4" EXTENDED_LIMITS -512.0000 511.9844
 /begin AXIS_DESCR COM_AXIS CrCtl_vVehUpByte Vel_CrCtl1 6 0.00 255.0000 FORMAT "%8.4" EXTENDED_LIMITS -32768.00 32767.00 AXIS_PTS_REF CrCtl_vAccnCont_AXIS /end AXIS_DESCR
/end CHARACTERISTIC
/begin CHARACTERISTIC CrCtl_facFdbkAccnP1_GCUR "Curve for acceleration Feed Back P factor 1 value" CURVE 0x80518746 CurG_Ws16 511.9844 Fact_CrCtl2 0.00 511.9844 FORMAT "%8.4" EXTENDED_LIMITS -512.0000 511.9844
 /begin AXIS_DESCR COM_AXIS CrCtl_vVehUpByte Vel_CrCtl1 6 0.00 255.0000 FORMAT "%8.4" EXTENDED_LIMITS -32768.00 32767.00 AXIS_PTS_REF CrCtl_vAccnCont_AXIS /end AXIS_DESCR
/end CHARACTERISTIC
/begin CHARACTERISTIC CrCtl_facFdbkAccnP2Kmh_GCUR "Curve for acceleration Feed Back P factor 2 value(Km/h spec)" CURVE 0x80518752 CurG_Ws16 511.9844 Fact_CrCtl2 0.00 511.9844 FORMAT "%8.4" EXTENDED_LIMITS -512.0000 511.9844
 /begin AXIS_DESCR COM_AXIS CrCtl_vVehUpByte Vel_CrCtl1 6 0.00 255.0000 FORMAT "%8.4" EXTENDED_LIMITS -32768.00 32767.00 AXIS_PTS_REF CrCtl_vAccnCont_AXIS /end AXIS_DESCR
/end CHARACTERISTIC
/begin CHARACTERISTIC CrCtl_facFdbkAccnP2_GCUR "Curve for acceleration Feed Back P factor 2 value" CURVE 0x8051875E CurG_Ws16 511.9844 Fact_CrCtl2 0.00 511.9844 FORMAT "%8.4" EXTENDED_LIMITS -512.0000 511.9844
 /begin AXIS_DESCR COM_AXIS CrCtl_vVehUpByte Vel_CrCtl1 6 0.00 255.0000 FORMAT "%8.4" EXTENDED_LIMITS -32768.00 32767.00 AXIS_PTS_REF CrCtl_vAccnCont_AXIS /end AXIS_DESCR
/end CHARACTERISTIC
/begin CHARACTERISTIC CrCtl_facFdbkAccnP3Kmh_GCUR "Curve for acceleration Feed Back P factor 3 value(Km/h spec)" CURVE 0x8051876A CurG_Ws16 511.9844 Fact_CrCtl2 0.00 511.9844 FORMAT "%8.4" EXTENDED_LIMITS -512.0000 511.9844
 /begin AXIS_DESCR COM_AXIS CrCtl_vVehUpByte Vel_CrCtl1 6 0.00 255.0000 FORMAT "%8.4" EXTENDED_LIMITS -32768.00 32767.00 AXIS_PTS_REF CrCtl_vAccnCont_AXIS /end AXIS_DESCR
/end CHARACTERISTIC
/begin CHARACTERISTIC CrCtl_facFdbkAccnP3_GCUR "Curve for acceleration Feed Back P factor 3 value" CURVE 0x80518776 CurG_Ws16 511.9844 Fact_CrCtl2 0.00 511.9844 FORMAT "%8.4" EXTENDED_LIMITS -512.0000 511.9844
 /begin AXIS_DESCR COM_AXIS CrCtl_vVehUpByte Vel_CrCtl1 6 0.00 255.0000 FORMAT "%8.4" EXTENDED_LIMITS -32768.00 32767.00 AXIS_PTS_REF CrCtl_vAccnCont_AXIS /end AXIS_DESCR
/end CHARACTERISTIC
/begin CHARACTERISTIC CrCtl_facFdbkAccnP4Kmh_GCUR "Curve for acceleration Feed Back P factor 4 value(Km/h spec)" CURVE 0x80518782 CurG_Ws16 511.9844 Fact_CrCtl2 0.00 511.9844 FORMAT "%8.4" EXTENDED_LIMITS -512.0000 511.9844
 /begin AXIS_DESCR COM_AXIS CrCtl_vVehUpByte Vel_CrCtl1 6 0.00 255.0000 FORMAT "%8.4" EXTENDED_LIMITS -32768.00 32767.00 AXIS_PTS_REF CrCtl_vAccnCont_AXIS /end AXIS_DESCR
/end CHARACTERISTIC
/begin CHARACTERISTIC CrCtl_facFdbkAccnP4_GCUR "Curve for acceleration Feed Back P factor 4 value" CURVE 0x8051878E CurG_Ws16 511.9844 Fact_CrCtl2 0.00 511.9844 FORMAT "%8.4" EXTENDED_LIMITS -512.0000 511.9844
 /begin AXIS_DESCR COM_AXIS CrCtl_vVehUpByte Vel_CrCtl1 6 0.00 255.0000 FORMAT "%8.4" EXTENDED_LIMITS -32768.00 32767.00 AXIS_PTS_REF CrCtl_vAccnCont_AXIS /end AXIS_DESCR
/end CHARACTERISTIC
/begin CHARACTERISTIC CrCtl_facFdbkAccnVal0_C "Acceleration feed back factor value under Gear no.0" VALUE 0x8051879A Val_Ws16 255.9922 Fact1 0.00 255.9922 FORMAT "%8.4" EXTENDED_LIMITS -256.0000 255.9922 /end CHARACTERISTIC
/begin CHARACTERISTIC CrCtl_facFdbkAccnVal1_C "Acceleration feed back factor value under Gear no.1" VALUE 0x8051879C Val_Ws16 255.9922 Fact1 0.00 255.9922 FORMAT "%8.4" EXTENDED_LIMITS -256.0000 255.9922 /end CHARACTERISTIC
/begin CHARACTERISTIC CrCtl_facFdbkAccnVal2_C "Acceleration feed back factor value under Gear no.2" VALUE 0x8051879E Val_Ws16 255.9922 Fact1 0.00 255.9922 FORMAT "%8.4" EXTENDED_LIMITS -256.0000 255.9922 /end CHARACTERISTIC
/begin CHARACTERISTIC CrCtl_facFdbkAccnVal3_C "Acceleration feed back factor value under Gear no.3" VALUE 0x805187A0 Val_Ws16 255.9922 Fact1 0.00 255.9922 FORMAT "%8.4" EXTENDED_LIMITS -256.0000 255.9922 /end CHARACTERISTIC
/begin CHARACTERISTIC CrCtl_facFdbkAccnVal4_C "Acceleration feed back factor value under Gear no.4" VALUE 0x805187A2 Val_Ws16 255.9922 Fact1 0.00 255.9922 FORMAT "%8.4" EXTENDED_LIMITS -256.0000 255.9922 /end CHARACTERISTIC
/begin CHARACTERISTIC CrCtl_facFdbkDReviVal0_C "Feed Back D factor revision value under Gear no.0" VALUE 0x805187A4 Val_Ws16 255.9922 Fact1 0.00 255.9922 FORMAT "%8.4" EXTENDED_LIMITS -256.0000 255.9922 /end CHARACTERISTIC
/begin CHARACTERISTIC CrCtl_facFdbkDReviVal1_C "Feed Back D factor revision value under Gear no.1" VALUE 0x805187A6 Val_Ws16 255.9922 Fact1 0.00 255.9922 FORMAT "%8.4" EXTENDED_LIMITS -256.0000 255.9922 /end CHARACTERISTIC
/begin CHARACTERISTIC CrCtl_facFdbkDReviVal2_C "Feed Back D factor revision value under Gear no.2" VALUE 0x805187A8 Val_Ws16 255.9922 Fact1 0.00 255.9922 FORMAT "%8.4" EXTENDED_LIMITS -256.0000 255.9922 /end CHARACTERISTIC
/begin CHARACTERISTIC CrCtl_facFdbkDReviVal3_C "Feed Back D factor revision value under Gear no.3" VALUE 0x805187AA Val_Ws16 255.9922 Fact1 0.00 255.9922 FORMAT "%8.4" EXTENDED_LIMITS -256.0000 255.9922 /end CHARACTERISTIC
/begin CHARACTERISTIC CrCtl_facFdbkDReviVal4_C "Feed Back D factor revision value under Gear no.4" VALUE 0x805187AC Val_Ws16 255.9922 Fact1 0.00 255.9922 FORMAT "%8.4" EXTENDED_LIMITS -256.0000 255.9922 /end CHARACTERISTIC
/begin CHARACTERISTIC CrCtl_facFdbkPReviVal0_C "Feed Back P factor revision value under Gear no.0" VALUE 0x805187AE Val_Ws16 255.9922 Fact1 0.00 255.9922 FORMAT "%8.4" EXTENDED_LIMITS -256.0000 255.9922 /end CHARACTERISTIC
/begin CHARACTERISTIC CrCtl_facFdbkPReviVal1_C "Feed Back P factor revision value under Gear no.1" VALUE 0x805187B0 Val_Ws16 255.9922 Fact1 0.00 255.9922 FORMAT "%8.4" EXTENDED_LIMITS -256.0000 255.9922 /end CHARACTERISTIC
/begin CHARACTERISTIC CrCtl_facFdbkPReviVal2_C "Feed Back P factor revision value under Gear no.2" VALUE 0x805187B2 Val_Ws16 255.9922 Fact1 0.00 255.9922 FORMAT "%8.4" EXTENDED_LIMITS -256.0000 255.9922 /end CHARACTERISTIC
/begin CHARACTERISTIC CrCtl_facFdbkPReviVal3_C "Feed Back P factor revision value under Gear no.3" VALUE 0x805187B4 Val_Ws16 255.9922 Fact1 0.00 255.9922 FORMAT "%8.4" EXTENDED_LIMITS -256.0000 255.9922 /end CHARACTERISTIC
/begin CHARACTERISTIC CrCtl_facFdbkPReviVal4_C "Feed Back P factor revision value under Gear no.4" VALUE 0x805187B6 Val_Ws16 255.9922 Fact1 0.00 255.9922 FORMAT "%8.4" EXTENDED_LIMITS -256.0000 255.9922 /end CHARACTERISTIC
/begin CHARACTERISTIC CrCtl_facFolFdbkGn12_GCUR "Curve for Feed Back Gain factor of ACC acceleration value" CURVE 0x805187B8 CurG_Ws16 2047.938 Fact2 0.00 2047.938 FORMAT "%8.3" EXTENDED_LIMITS -2048.000 2047.938
 /begin AXIS_DESCR COM_AXIS CrCtl_vDesUpByte_mp Vel_CrCtl1 12 0.00 255.0000 FORMAT "%8.4" EXTENDED_LIMITS -32768.00 32767.00 AXIS_PTS_REF CrCtl_vFdbkArea_AX /end AXIS_DESCR
/end CHARACTERISTIC
/begin CHARACTERISTIC CrCtl_facNeLimDCont_GCUR "Curve for Clutch out Ne Set D factor value" CURVE 0x805187D0 CurG_Ws16 511.9844 Fact_CrCtl2 0.00 511.9844 FORMAT "%8.4" EXTENDED_LIMITS -512.0000 511.9844
 /begin AXIS_DESCR COM_AXIS CrCUI_nFlt EngNCrCtl 6 0.00 32767.00 FORMAT "%8.2" EXTENDED_LIMITS -32768.00 32767.00 AXIS_PTS_REF CrCtl_nFlt_AXIS /end AXIS_DESCR
/end CHARACTERISTIC
/begin CHARACTERISTIC CrCtl_facNeLimPCont_GCUR "Curve for Clutch out Ne Set P factor value" CURVE 0x805187DC CurG_Ws16 31.99902 Fact_CrCtl3 0.00 31.99902 FORMAT "%8.5" EXTENDED_LIMITS -32.00000 31.99902
 /begin AXIS_DESCR COM_AXIS CrCUI_nFlt EngNCrCtl 6 0.00 32767.00 FORMAT "%8.2" EXTENDED_LIMITS -32768.00 32767.00 AXIS_PTS_REF CrCtl_nFlt_AXIS /end AXIS_DESCR
/end CHARACTERISTIC
/begin CHARACTERISTIC CrCtl_facSpt1LGAppDiffCls_GMAP "Correct value of APP in 1 level lower gear for close side for sport mode" MAP 0x805187E8 MapG_Ws16 511.9922 Fact1 -256.0000 255.9922 FORMAT "%8.4"
 /begin AXIS_DESCR COM_AXIS CrCtl_rReq_mp APPCrCtl1 12 0.00 163.8350 FORMAT "%8.4" EXTENDED_LIMITS -163.8400 163.8350 AXIS_PTS_REF CrCtl_facAPPReviX_AXIS /end AXIS_DESCR
 /begin AXIS_DESCR COM_AXIS CrCtl_vVehUpByte Vel_CrCtl1 6 0.00 255.0000 FORMAT "%8.4" EXTENDED_LIMITS -32768.00 32767.00 AXIS_PTS_REF CrCtl_facAPPReviY_AXIS /end AXIS_DESCR
/end CHARACTERISTIC
/begin CHARACTERISTIC CrCtl_facSpt1LGAppDiff_GMAP "Correct value of APP in 1 level lower gear for open side for sport mode" MAP 0x80518878 MapG_Ws16 511.9922 Fact1 -256.0000 255.9922 FORMAT "%8.4"
 /begin AXIS_DESCR COM_AXIS CrCtl_rReq_mp APPCrCtl1 12 0.00 163.8350 FORMAT "%8.4" EXTENDED_LIMITS -163.8400 163.8350 AXIS_PTS_REF CrCtl_facAPPReviX_AXIS /end AXIS_DESCR
 /begin AXIS_DESCR COM_AXIS CrCtl_vVehUpByte Vel_CrCtl1 6 0.00 255.0000 FORMAT "%8.4" EXTENDED_LIMITS -32768.00 32767.00 AXIS_PTS_REF CrCtl_facAPPReviY_AXIS /end AXIS_DESCR
/end CHARACTERISTIC
/begin CHARACTERISTIC CrCtl_facSpt2LGAppDiffCls_GMAP "Correct value of APP in 2 level lower gear for close side for sport mode" MAP 0x80518908 MapG_Ws16 511.9922 Fact1 -256.0000 255.9922 FORMAT "%8.4"
 /begin AXIS_DESCR COM_AXIS CrCtl_rReq_mp APPCrCtl1 12 0.00 163.8350 FORMAT "%8.4" EXTENDED_LIMITS -163.8400 163.8350 AXIS_PTS_REF CrCtl_facAPPReviX_AXIS /end AXIS_DESCR
 /begin AXIS_DESCR COM_AXIS CrCtl_vVehUpByte Vel_CrCtl1 6 0.00 255.0000 FORMAT "%8.4" EXTENDED_LIMITS -32768.00 32767.00 AXIS_PTS_REF CrCtl_facAPPReviY_AXIS /end AXIS_DESCR
/end CHARACTERISTIC
/begin CHARACTERISTIC CrCtl_facSpt2LGAppDiff_GMAP "Correct value of APP in 2 level lower gear for open side for sport mode" MAP 0x80518998 MapG_Ws16 511.9922 Fact1 -256.0000 255.9922 FORMAT "%8.4"
 /begin AXIS_DESCR COM_AXIS CrCtl_rReq_mp APPCrCtl1 12 0.00 163.8350 FORMAT "%8.4" EXTENDED_LIMITS -163.8400 163.8350 AXIS_PTS_REF CrCtl_facAPPReviX_AXIS /end AXIS_DESCR
 /begin AXIS_DESCR COM_AXIS CrCtl_vVehUpByte Vel_CrCtl1 6 0.00 255.0000 FORMAT "%8.4" EXTENDED_LIMITS -32768.00 32767.00 AXIS_PTS_REF CrCtl_facAPPReviY_AXIS /end AXIS_DESCR
/end CHARACTERISTIC
/begin CHARACTERISTIC CrCtl_facSpt3LGAppDiffCls_GMAP "Correct value of APP in 3 level lower gear for close side for sport mode" MAP 0x80518A28 MapG_Ws16 511.9922 Fact1 -256.0000 255.9922 FORMAT "%8.4"
 /begin AXIS_DESCR COM_AXIS CrCtl_rReq_mp APPCrCtl1 12 0.00 163.8350 FORMAT "%8.4" EXTENDED_LIMITS -163.8400 163.8350 AXIS_PTS_REF CrCtl_facAPPReviX_AXIS /end AXIS_DESCR
 /begin AXIS_DESCR COM_AXIS CrCtl_vVehUpByte Vel_CrCtl1 6 0.00 255.0000 FORMAT "%8.4" EXTENDED_LIMITS -32768.00 32767.00 AXIS_PTS_REF CrCtl_facAPPReviY_AXIS /end AXIS_DESCR
/end CHARACTERISTIC
/begin CHARACTERISTIC CrCtl_facSpt3LGAppDiff_GMAP "Correct value of APP in 3 level lower gear for open side for sport mode" MAP 0x80518AB8 MapG_Ws16 511.9922 Fact1 -256.0000 255.9922 FORMAT "%8.4"
 /begin AXIS_DESCR COM_AXIS CrCtl_rReq_mp APPCrCtl1 12 0.00 163.8350 FORMAT "%8.4" EXTENDED_LIMITS -163.8400 163.8350 AXIS_PTS_REF CrCtl_facAPPReviX_AXIS /end AXIS_DESCR
 /begin AXIS_DESCR COM_AXIS CrCtl_vVehUpByte Vel_CrCtl1 6 0.00 255.0000 FORMAT "%8.4" EXTENDED_LIMITS -32768.00 32767.00 AXIS_PTS_REF CrCtl_facAPPReviY_AXIS /end AXIS_DESCR
/end CHARACTERISTIC
/begin CHARACTERISTIC CrCtl_facSpt4LGAppDiffCls_GMAP "Correct value of APP in 4 level lower gear for close side for sport mode" MAP 0x80518B48 MapG_Ws16 511.9922 Fact1 -256.0000 255.9922 FORMAT "%8.4"
 /begin AXIS_DESCR COM_AXIS CrCtl_rReq_mp APPCrCtl1 12 0.00 163.8350 FORMAT "%8.4" EXTENDED_LIMITS -163.8400 163.8350 AXIS_PTS_REF CrCtl_facAPPReviX_AXIS /end AXIS_DESCR
 /begin AXIS_DESCR COM_AXIS CrCtl_vVehUpByte Vel_CrCtl1 6 0.00 255.0000 FORMAT "%8.4" EXTENDED_LIMITS -32768.00 32767.00 AXIS_PTS_REF CrCtl_facAPPReviY_AXIS /end AXIS_DESCR
/end CHARACTERISTIC
/begin CHARACTERISTIC CrCtl_facSpt4LGAppDiff_GMAP "Correct value of APP in 4 level lower gear for open side for sport mode" MAP 0x80518BD8 MapG_Ws16 511.9922 Fact1 -256.0000 255.9922 FORMAT "%8.4"
 /begin AXIS_DESCR COM_AXIS CrCtl_rReq_mp APPCrCtl1 12 0.00 163.8350 FORMAT "%8.4" EXTENDED_LIMITS -163.8400 163.8350 AXIS_PTS_REF CrCtl_facAPPReviX_AXIS /end AXIS_DESCR
 /begin AXIS_DESCR COM_AXIS CrCtl_vVehUpByte Vel_CrCtl1 6 0.00 255.0000 FORMAT "%8.4" EXTENDED_LIMITS -32768.00 32767.00 AXIS_PTS_REF CrCtl_facAPPReviY_AXIS /end AXIS_DESCR
/end CHARACTERISTIC
/begin CHARACTERISTIC CrCtl_facSptAccnRed12_GCUR "Curve for Reducing factor of acceleration control value for sport mode" CURVE 0x80518C68 CurG_Ws16 511.9844 Fact_CrCtl2 0.00 511.9844 FORMAT "%8.4" EXTENDED_LIMITS -512.0000 511.9844
 /begin AXIS_DESCR COM_AXIS CrCtl_vVehUpByte Vel_CrCtl1 12 0.00 255.0000 FORMAT "%8.4" EXTENDED_LIMITS -32768.00 32767.00 AXIS_PTS_REF CrCtl_vAccnCont_AX /end AXIS_DESCR
/end CHARACTERISTIC
/begin CHARACTERISTIC CrCtl_facSptFdbkAccnP0_GCUR "Curve for acceleration Feed Back P factor 0 value for sport mode" CURVE 0x80518C80 CurG_Ws16 511.9844 Fact_CrCtl2 0.00 511.9844 FORMAT "%8.4" EXTENDED_LIMITS -512.0000 511.9844
 /begin AXIS_DESCR COM_AXIS CrCtl_vVehUpByte Vel_CrCtl1 6 0.00 255.0000 FORMAT "%8.4" EXTENDED_LIMITS -32768.00 32767.00 AXIS_PTS_REF CrCtl_vAccnCont_AXIS /end AXIS_DESCR
/end CHARACTERISTIC
/begin CHARACTERISTIC CrCtl_facSptFdbkAccnP1_GCUR "Curve for acceleration Feed Back P factor 1 value for sport mode" CURVE 0x80518C8C CurG_Ws16 511.9844 Fact_CrCtl2 0.00 511.9844 FORMAT "%8.4" EXTENDED_LIMITS -512.0000 511.9844
 /begin AXIS_DESCR COM_AXIS CrCtl_vVehUpByte Vel_CrCtl1 6 0.00 255.0000 FORMAT "%8.4" EXTENDED_LIMITS -32768.00 32767.00 AXIS_PTS_REF CrCtl_vAccnCont_AXIS /end AXIS_DESCR
/end CHARACTERISTIC
/begin CHARACTERISTIC CrCtl_facSptFdbkAccnP2_GCUR "Curve for acceleration Feed Back P factor 2 value for sport mode" CURVE 0x80518C98 CurG_Ws16 511.9844 Fact_CrCtl2 0.00 511.9844 FORMAT "%8.4" EXTENDED_LIMITS -512.0000 511.9844
 /begin AXIS_DESCR COM_AXIS CrCtl_vVehUpByte Vel_CrCtl1 6 0.00 255.0000 FORMAT "%8.4" EXTENDED_LIMITS -32768.00 32767.00 AXIS_PTS_REF CrCtl_vAccnCont_AXIS /end AXIS_DESCR
/end CHARACTERISTIC
/begin CHARACTERISTIC CrCtl_facSptFdbkAccnP3_GCUR "Curve for acceleration Feed Back P factor 3 value for sport mode" CURVE 0x80518CA4 CurG_Ws16 511.9844 Fact_CrCtl2 0.00 511.9844 FORMAT "%8.4" EXTENDED_LIMITS -512.0000 511.9844
 /begin AXIS_DESCR COM_AXIS CrCtl_vVehUpByte Vel_CrCtl1 6 0.00 255.0000 FORMAT "%8.4" EXTENDED_LIMITS -32768.00 32767.00 AXIS_PTS_REF CrCtl_vAccnCont_AXIS /end AXIS_DESCR
/end CHARACTERISTIC
/begin CHARACTERISTIC CrCtl_facSptFdbkAccnP4_GCUR "Curve for acceleration Feed Back P factor 4 value for sport mode" CURVE 0x80518CB0 CurG_Ws16 511.9844 Fact_CrCtl2 0.00 511.9844 FORMAT "%8.4" EXTENDED_LIMITS -512.0000 511.9844
 /begin AXIS_DESCR COM_AXIS CrCtl_vVehUpByte Vel_CrCtl1 6 0.00 255.0000 FORMAT "%8.4" EXTENDED_LIMITS -32768.00 32767.00 AXIS_PTS_REF CrCtl_vAccnCont_AXIS /end AXIS_DESCR
/end CHARACTERISTIC
/begin CHARACTERISTIC CrCtl_facSptFdbkAccnVal0_C "Acceleration feed back factor value under Gear no.0 for Sport mode" VALUE 0x80518CBC Val_Ws16 255.9922 Fact1 0.00 255.9922 FORMAT "%8.4" EXTENDED_LIMITS -256.0000 255.9922 /end CHARACTERISTIC
/begin CHARACTERISTIC CrCtl_facSptFdbkAccnVal1_C "Acceleration feed back factor value under Gear no.1 for Sport mode" VALUE 0x80518CBE Val_Ws16 255.9922 Fact1 0.00 255.9922 FORMAT "%8.4" EXTENDED_LIMITS -256.0000 255.9922 /end CHARACTERISTIC
/begin CHARACTERISTIC CrCtl_facSptFdbkAccnVal2_C "Acceleration feed back factor value under Gear no.2 for Sport mode" VALUE 0x80518CC0 Val_Ws16 255.9922 Fact1 0.00 255.9922 FORMAT "%8.4" EXTENDED_LIMITS -256.0000 255.9922 /end CHARACTERISTIC
/begin CHARACTERISTIC CrCtl_facSptFdbkAccnVal3_C "Acceleration feed back factor value under Gear no.3 for Sport mode" VALUE 0x80518CC2 Val_Ws16 255.9922 Fact1 0.00 255.9922 FORMAT "%8.4" EXTENDED_LIMITS -256.0000 255.9922 /end CHARACTERISTIC
/begin CHARACTERISTIC CrCtl_facSptFdbkAccnVal4_C "Acceleration feed back factor value under Gear no.4 for Sport mode" VALUE 0x80518CC4 Val_Ws16 255.9922 Fact1 0.00 255.9922 FORMAT "%8.4" EXTENDED_LIMITS -256.0000 255.9922 /end CHARACTERISTIC
/begin CHARACTERISTIC CrCtl_facSptFdbkDReviVal0_C "Feed Back D factor revision value for sport mode under Gear no.0" VALUE 0x80518CC6 Val_Ws16 255.9922 Fact1 0.00 255.9922 FORMAT "%8.4" EXTENDED_LIMITS -256.0000 255.9922 /end CHARACTERISTIC
/begin CHARACTERISTIC CrCtl_facSptFdbkDReviVal1_C "Feed Back D factor revision value for sport mode under Gear no.1" VALUE 0x80518CC8 Val_Ws16 255.9922 Fact1 0.00 255.9922 FORMAT "%8.4" EXTENDED_LIMITS -256.0000 255.9922 /end CHARACTERISTIC
/begin CHARACTERISTIC CrCtl_facSptFdbkDReviVal2_C "Feed Back D factor revision value for sport mode under Gear no.2" VALUE 0x80518CCA Val_Ws16 255.9922 Fact1 0.00 255.9922 FORMAT "%8.4" EXTENDED_LIMITS -256.0000 255.9922 /end CHARACTERISTIC
/begin CHARACTERISTIC CrCtl_facSptFdbkDReviVal3_C "Feed Back D factor revision value for sport mode under Gear no.3" VALUE 0x80518CCC Val_Ws16 255.9922 Fact1 0.00 255.9922 FORMAT "%8.4" EXTENDED_LIMITS -256.0000 255.9922 /end CHARACTERISTIC
/begin CHARACTERISTIC CrCtl_facSptFdbkDReviVal4_C "Feed Back D factor revision value for sport mode under Gear no.4" VALUE 0x80518CCE Val_Ws16 255.9922 Fact1 0.00 255.9922 FORMAT "%8.4" EXTENDED_LIMITS -256.0000 255.9922 /end CHARACTERISTIC
/begin CHARACTERISTIC CrCtl_facSptFdbkPReviVal0_C "Feed Back P factor revision value for sport mode under Gear no.0" VALUE 0x80518CD0 Val_Ws16 255.9922 Fact1 0.00 255.9922 FORMAT "%8.4" EXTENDED_LIMITS -256.0000 255.9922 /end CHARACTERISTIC
/begin CHARACTERISTIC CrCtl_facSptFdbkPReviVal1_C "Feed Back P factor revision value for sport mode under Gear no.1" VALUE 0x80518CD2 Val_Ws16 255.9922 Fact1 0.00 255.9922 FORMAT "%8.4" EXTENDED_LIMITS -256.0000 255.9922 /end CHARACTERISTIC
/begin CHARACTERISTIC CrCtl_facSptFdbkPReviVal2_C "Feed Back P factor revision value for sport mode under Gear no.2" VALUE 0x80518CD4 Val_Ws16 255.9922 Fact1 0.00 255.9922 FORMAT "%8.4" EXTENDED_LIMITS -256.0000 255.9922 /end CHARACTERISTIC
/begin CHARACTERISTIC CrCtl_facSptFdbkPReviVal3_C "Feed Back P factor revision value for sport mode under Gear no.3" VALUE 0x80518CD6 Val_Ws16 255.9922 Fact1 0.00 255.9922 FORMAT "%8.4" EXTENDED_LIMITS -256.0000 255.9922 /end CHARACTERISTIC
/begin CHARACTERISTIC CrCtl_facSptFdbkPReviVal4_C "Feed Back P factor revision value for sport mode under Gear no.4" VALUE 0x80518CD8 Val_Ws16 255.9922 Fact1 0.00 255.9922 FORMAT "%8.4" EXTENDED_LIMITS -256.0000 255.9922 /end CHARACTERISTIC
/begin CHARACTERISTIC CrCtl_facSptTGAppDiffCls_GMAP "Correct value of APP in top gear for close side for sport mode" MAP 0x80518CDA MapG_Ws16 511.9922 Fact1 -256.0000 255.9922 FORMAT "%8.4"
 /begin AXIS_DESCR COM_AXIS CrCtl_rReq_mp APPCrCtl1 12 0.00 163.8350 FORMAT "%8.4" EXTENDED_LIMITS -163.8400 163.8350 AXIS_PTS_REF CrCtl_facAPPReviX_AXIS /end AXIS_DESCR
 /begin AXIS_DESCR COM_AXIS CrCtl_vVehUpByte Vel_CrCtl1 6 0.00 255.0000 FORMAT "%8.4" EXTENDED_LIMITS -32768.00 32767.00 AXIS_PTS_REF CrCtl_facAPPReviY_AXIS /end AXIS_DESCR
/end CHARACTERISTIC
/begin CHARACTERISTIC CrCtl_facSptTGAppDiff_GMAP "Correct value of APP in top gear for open side for sport mode" MAP 0x80518D6A MapG_Ws16 511.9922 Fact1 -256.0000 255.9922 FORMAT "%8.4"
 /begin AXIS_DESCR COM_AXIS CrCtl_rReq_mp APPCrCtl1 12 0.00 163.8350 FORMAT "%8.4" EXTENDED_LIMITS -163.8400 163.8350 AXIS_PTS_REF CrCtl_facAPPReviX_AXIS /end AXIS_DESCR
 /begin AXIS_DESCR COM_AXIS CrCtl_vVehUpByte Vel_CrCtl1 6 0.00 255.0000 FORMAT "%8.4" EXTENDED_LIMITS -32768.00 32767.00 AXIS_PTS_REF CrCtl_facAPPReviY_AXIS /end AXIS_DESCR
/end CHARACTERISTIC
/begin CHARACTERISTIC CrCtl_facTGAppDiffCls_GMAP "Correct value of APP in top gear for close side" MAP 0x80518DFA MapG_Ws16 511.9922 Fact1 -256.0000 255.9922 FORMAT "%8.4"
 /begin AXIS_DESCR COM_AXIS CrCtl_rReq_mp APPCrCtl1 12 0.00 163.8350 FORMAT "%8.4" EXTENDED_LIMITS -163.8400 163.8350 AXIS_PTS_REF CrCtl_facAPPReviX_AXIS /end AXIS_DESCR
 /begin AXIS_DESCR COM_AXIS CrCtl_vVehUpByte Vel_CrCtl1 6 0.00 255.0000 FORMAT "%8.4" EXTENDED_LIMITS -32768.00 32767.00 AXIS_PTS_REF CrCtl_facAPPReviY_AXIS /end AXIS_DESCR
/end CHARACTERISTIC
/begin CHARACTERISTIC CrCtl_facTGAppDiff_GMAP "Correct value of APP in top gear for open side" MAP 0x80518E8A MapG_Ws16 511.9922 Fact1 -256.0000 255.9922 FORMAT "%8.4"
 /begin AXIS_DESCR COM_AXIS CrCtl_rReq_mp APPCrCtl1 12 0.00 163.8350 FORMAT "%8.4" EXTENDED_LIMITS -163.8400 163.8350 AXIS_PTS_REF CrCtl_facAPPReviX_AXIS /end AXIS_DESCR
 /begin AXIS_DESCR COM_AXIS CrCtl_vVehUpByte Vel_CrCtl1 6 0.00 255.0000 FORMAT "%8.4" EXTENDED_LIMITS -32768.00 32767.00 AXIS_PTS_REF CrCtl_facAPPReviY_AXIS /end AXIS_DESCR
/end CHARACTERISTIC
/begin CHARACTERISTIC CrCtl_facTrgAccnRateEcon_T "Calibration to determine the target accleration rate based on the difference between target speed and current speed in economy mode" CURVE 0x80518F1A RB_Cur_Xs16Ws16 655.3500 Fact100 -327.6800 327.6700 FORMAT "%8.4"
 /begin AXIS_DESCR STD_AXIS CrCtl_vSpdVar_mp Vel_CrCtl 6 -128.0000 127.9961 FORMAT "%8.4" DEPOSIT ABSOLUTE /end AXIS_DESCR
/end CHARACTERISTIC
/begin CHARACTERISTIC CrCtl_facTrgAccnRateNrml_T "Calibration to determine the target accleration rate based on the difference between target speed and current speed in Normal mode" CURVE 0x80518F34 RB_Cur_Xs16Ws16 655.3500 Fact100 -327.6800 327.6700 FORMAT "%8.4"
 /begin AXIS_DESCR STD_AXIS CrCtl_vSpdVar_mp Vel_CrCtl 6 -128.0000 127.9961 FORMAT "%8.4" DEPOSIT ABSOLUTE /end AXIS_DESCR
/end CHARACTERISTIC
/begin CHARACTERISTIC CrCtl_facVehSpdFlt_C "factor for Filtering Vehicle Speed" VALUE 0x80518F4E Val_Wu8 1.000 fak_q0p00392 0.00 1.000 FORMAT "%5.3" /end CHARACTERISTIC
/begin AXIS_PTS CrCtl_nAPPReqChng_AXIS "Axis for Gear Change APP request group curve." 0x80518F50 CrCtl_nDesVal_mp Axis_Xs16 32767.00 EngNCrCtl 6 0.00 32767.00 FORMAT "%8.2" EXTENDED_LIMITS -32768.00 32767.00 DEPOSIT ABSOLUTE /end AXIS_PTS
/begin AXIS_PTS CrCtl_nFlt_AXIS "Axis Points for filtered Ne value of cruise control" 0x80518F5E CrCUI_nFlt Axis_Xs16 32767.00 EngNCrCtl 6 0.00 32767.00 FORMAT "%8.2" EXTENDED_LIMITS -32768.00 32767.00 DEPOSIT ABSOLUTE /end AXIS_PTS
/begin CHARACTERISTIC CrCtl_nTrqOffChkAdd_C "Torque off Check NE additional value" VALUE 0x80518F6C Val_Ws16 32767.00 EngNCrCtl 0.00 32767.00 FORMAT "%8.2" EXTENDED_LIMITS -32768.00 32767.00 /end CHARACTERISTIC
/begin CHARACTERISTIC CrCtl_nTrqOffReqChk_CUR "Curve for Torque off Check NE value" CURVE 0x80518F6E RB_Cur_Xs16Ws16 32767.00 EngNCrCtl 0.00 32767.00 FORMAT "%8.2" EXTENDED_LIMITS -32768.00 32767.00
 /begin AXIS_DESCR STD_AXIS CrCUI_nLIDes EngNCrCtl 6 -32768.00 32767.00 FORMAT "%8.2" DEPOSIT ABSOLUTE /end AXIS_DESCR
/end CHARACTERISTIC
/begin CHARACTERISTIC CrCtl_numACCECAppLowrLim_C "RP (hysteresis Lo) value for ECON" VALUE 0x80518F88 Val_Wu8 127.0 OneToOne 0.00 127.0 FORMAT "%5.1" EXTENDED_LIMITS 0.00 255.0 /end CHARACTERISTIC
/begin CHARACTERISTIC CrCtl_numATType_C "switch for selecting the type of transmission used" VALUE 0x80518F89 Val_Wu8 255.0 OneToOne 0.00 255.0 FORMAT "%5.1" /end CHARACTERISTIC
/begin CHARACTERISTIC CrCtl_numCCECAppLowrLim_C "Curve for target acceleration standerd value for ECON" VALUE 0x80518F8A Val_Wu8 127.0 OneToOne 0.00 127.0 FORMAT "%5.1" EXTENDED_LIMITS 0.00 255.0 /end CHARACTERISTIC
/begin CHARACTERISTIC CrCtl_numDRPrmntCvtGearShiftMap_CA "Array for CVT gear shift map number" VAL_BLK 0x80518F8B ValA_Wu8 255.0 OneToOne 0.00 255.0 FORMAT "%5.1" NUMBER 3 /end CHARACTERISTIC
/begin CHARACTERISTIC CrCtl_numTrqRat_C "Torque Ratio calculation Number" VALUE 0x80518F8E Val_Wu8 127.0 OneToOne 0.00 127.0 FORMAT "%5.1" EXTENDED_LIMITS 0.00 255.0 /end CHARACTERISTIC
/begin CHARACTERISTIC CrCtl_r10msAddVar_C "APP request every 10ms Add variant value" VALUE 0x80518F90 Val_Ws16 163.8350 APPCrCtl1 0.00 163.8350 FORMAT "%8.4" EXTENDED_LIMITS -163.8400 163.8350 /end CHARACTERISTIC
/begin CHARACTERISTIC CrCtl_r10msSubVar_C "APP request every 10ms Sub variant value" VALUE 0x80518F92 Val_Ws16 163.8350 APPCrCtl1 0.00 163.8350 FORMAT "%8.4" EXTENDED_LIMITS -163.8400 163.8350 /end CHARACTERISTIC
/begin CHARACTERISTIC CrCtl_rACCBrkReqChng_CUR "Curve for APP request value of Gear Change for ACC Brake On" CURVE 0x80518F94 RB_Cur_Xs16Ws16 163.8350 APPCrCtl1 0.00 163.8350 FORMAT "%8.4" EXTENDED_LIMITS -163.8400 163.8350
 /begin AXIS_DESCR STD_AXIS CrCUI_nFlt EngNCrCtl 6 -32768.00 32767.00 FORMAT "%8.2" DEPOSIT ABSOLUTE /end AXIS_DESCR
/end CHARACTERISTIC
/begin CHARACTERISTIC CrCtl_rACCECOffSlopDwn1_CUR "Slope for changing APP limitation number for ECON to 2 from 3 (for ECON sw OFF and during ACC)" CURVE 0x80518FAE RB_Cur_Xs16Ws16 255.9961 Prc_CrCtl4 -128.0000 127.9961 FORMAT "%8.4"
 /begin AXIS_DESCR STD_AXIS CrCtl_vVehUpByte Vel_CrCtl1 6 -32768.00 32767.00 FORMAT "%8.2" DEPOSIT ABSOLUTE /end AXIS_DESCR
/end CHARACTERISTIC
/begin CHARACTERISTIC CrCtl_rACCECOffSlopDwn2_CUR "Slope for changing APP limitation number for ECON to 3 from 4 (for ECON sw OFF and during ACC)" CURVE 0x80518FC8 RB_Cur_Xs16Ws16 255.9961 Prc_CrCtl4 -128.0000 127.9961 FORMAT "%8.4"
 /begin AXIS_DESCR STD_AXIS CrCtl_vVehUpByte Vel_CrCtl1 6 -32768.00 32767.00 FORMAT "%8.2" DEPOSIT ABSOLUTE /end AXIS_DESCR
/end CHARACTERISTIC
/begin CHARACTERISTIC CrCtl_rACCECOffSlopDwn3_CUR "Slope for changing APP limitation number for ECON to 4 from 5 (for ECON sw OFF and during ACC)" CURVE 0x80518FE2 RB_Cur_Xs16Ws16 255.9961 Prc_CrCtl4 -128.0000 127.9961 FORMAT "%8.4"
 /begin AXIS_DESCR STD_AXIS CrCtl_vVehUpByte Vel_CrCtl1 6 -32768.00 32767.00 FORMAT "%8.2" DEPOSIT ABSOLUTE /end AXIS_DESCR
/end CHARACTERISTIC
/begin CHARACTERISTIC CrCtl_rACCECOffSlopDwn4_CUR "Slope for changing APP limitation number for ECON to 1 from 2 (for ECON sw ON and during ACC)" CURVE 0x80518FFC RB_Cur_Xs16Ws16 255.9961 Prc_CrCtl4 -128.0000 127.9961 FORMAT "%8.4"
 /begin AXIS_DESCR STD_AXIS CrCtl_vVehUpByte Vel_CrCtl1 6 -32768.00 32767.00 FORMAT "%8.2" DEPOSIT ABSOLUTE /end AXIS_DESCR
/end CHARACTERISTIC
/begin CHARACTERISTIC CrCtl_rACCECOnSlopDwn1_CUR "Slope for changing APP limitation number for ECON to 2 from 3 (for ECON sw ON and during ACC)" CURVE 0x80519016 RB_Cur_Xs16Ws16 255.9961 Prc_CrCtl4 -128.0000 127.9961 FORMAT "%8.4"
 /begin AXIS_DESCR STD_AXIS CrCtl_vVehUpByte Vel_CrCtl1 6 -32768.00 32767.00 FORMAT "%8.2" DEPOSIT ABSOLUTE /end AXIS_DESCR
/end CHARACTERISTIC
/begin CHARACTERISTIC CrCtl_rACCECOnSlopDwn2_CUR "Slope for changing APP limitation number for ECON to 3 from 4 (for ECON sw ON and during ACC)" CURVE 0x80519030 RB_Cur_Xs16Ws16 255.9961 Prc_CrCtl4 -128.0000 127.9961 FORMAT "%8.4"
 /begin AXIS_DESCR STD_AXIS CrCtl_vVehUpByte Vel_CrCtl1 6 -32768.00 32767.00 FORMAT "%8.2" DEPOSIT ABSOLUTE /end AXIS_DESCR
/end CHARACTERISTIC
/begin CHARACTERISTIC CrCtl_rACCECOnSlopDwn3_CUR "Slope for changing APP limitation number for ECON to 4 from 5 (for ECON sw ON and during ACC)" CURVE 0x8051904A RB_Cur_Xs16Ws16 255.9961 Prc_CrCtl4 -128.0000 127.9961 FORMAT "%8.4"
 /begin AXIS_DESCR STD_AXIS CrCtl_vVehUpByte Vel_CrCtl1 6 -32768.00 32767.00 FORMAT "%8.2" DEPOSIT ABSOLUTE /end AXIS_DESCR
/end CHARACTERISTIC
/begin CHARACTERISTIC CrCtl_rACCECOnSlopDwn4_CUR "Mask timer for changing APP limitation number for ECON (for APP limitation number up)" CURVE 0x80519064 RB_Cur_Xs16Ws16 255.9961 Prc_CrCtl4 -128.0000 127.9961 FORMAT "%8.4"
 /begin AXIS_DESCR STD_AXIS CrCtl_vVehUpByte Vel_CrCtl1 6 -32768.00 32767.00 FORMAT "%8.2" DEPOSIT ABSOLUTE /end AXIS_DESCR
/end CHARACTERISTIC
/begin CHARACTERISTIC CrCtl_rACCFstTUTrgAccnFdbk_C "ACC First Tap Up target acceleration reduce feed back value" VALUE 0x8051907E Val_Ws16 3276.700 Prc_CrCtl2 0.00 3276.700 FORMAT "%8.3" EXTENDED_LIMITS -3276.800 3276.700 /end CHARACTERISTIC
/begin CHARACTERISTIC CrCtl_rACCFstTUTrgAccnRed_C "ACC First Tap Up target acceleration reduce value" VALUE 0x80519080 Val_Ws16 3276.700 Prc_CrCtl2 0.00 3276.700 FORMAT "%8.3" EXTENDED_LIMITS -3276.800 3276.700 /end CHARACTERISTIC
/begin CHARACTERISTIC CrCtl_rAccOffNTG_GMAP "MAP for output Accel off(Not Top Gear)" MAP 0x80519082 MapG_Ws16 163.8350 APPCrCtl1 0.00 163.8350 FORMAT "%8.4" EXTENDED_LIMITS -163.8400 163.8350
 /begin AXIS_DESCR COM_AXIS CrCtl_vVehUpByte Vel_CrCtl1 6 0.00 255.0000 FORMAT "%8.4" EXTENDED_LIMITS -32768.00 32767.00 AXIS_PTS_REF CrCtl_rAccOffX_AXIS /end AXIS_DESCR
 /begin AXIS_DESCR COM_AXIS CrCtl_rEstSlpFltVal Prc_CrCtl4 9 -128.0000 127.9961 FORMAT "%8.4" AXIS_PTS_REF CrCtl_rAccOffY_AXIS /end AXIS_DESCR
/end CHARACTERISTIC
/begin CHARACTERISTIC CrCtl_rAccOffTG_GMAP "MAP for output Accel off(Top Gear)" MAP 0x805190EE MapG_Ws16 163.8350 APPCrCtl1 0.00 163.8350 FORMAT "%8.4" EXTENDED_LIMITS -163.8400 163.8350
 /begin AXIS_DESCR COM_AXIS CrCtl_vVehUpByte Vel_CrCtl1 6 0.00 255.0000 FORMAT "%8.4" EXTENDED_LIMITS -32768.00 32767.00 AXIS_PTS_REF CrCtl_rAccOffX_AXIS /end AXIS_DESCR
 /begin AXIS_DESCR COM_AXIS CrCtl_rEstSlpFltVal Prc_CrCtl4 9 -128.0000 127.9961 FORMAT "%8.4" AXIS_PTS_REF CrCtl_rAccOffY_AXIS /end AXIS_DESCR
/end CHARACTERISTIC
/begin AXIS_PTS CrCtl_rAccOffX_AXIS "X-Axis for Output Accel Off group MAP" 0x8051915A CrCtl_vVehUpByte Axis_Xs16 255.0000 Vel_CrCtl1 6 0.00 255.0000 FORMAT "%8.4" EXTENDED_LIMITS -32768.00 32767.00 DEPOSIT ABSOLUTE /end AXIS_PTS
/begin AXIS_PTS CrCtl_rAccOffY_AXIS "Y-Axis for Output Accel Off group MAP" 0x80519168 CrCtl_rEstSlpFltVal Axis_Xs16 255.9961 Prc_CrCtl4 9 -128.0000 127.9961 FORMAT "%8.4" DEPOSIT ABSOLUTE /end AXIS_PTS
/begin CHARACTERISTIC CrCtl_rACCReqChngStrt_GCUR "Curve for Gear Change start APP request value" CURVE 0x8051917C CurG_Ws16 163.8350 APPCrCtl1 0.00 163.8350 FORMAT "%8.4" EXTENDED_LIMITS -163.8400 163.8350
 /begin AXIS_DESCR COM_AXIS CrCtl_nDesVal_mp EngNCrCtl 6 0.00 32767.00 FORMAT "%8.2" EXTENDED_LIMITS -32768.00 32767.00 AXIS_PTS_REF CrCtl_nAPPReqChng_AXIS /end AXIS_DESCR
/end CHARACTERISTIC
/begin CHARACTERISTIC CrCtl_rACCTDInitNTG_GCUR "Curve for Tap Down initial value(Not Top Gear) for ACC" CURVE 0x80519188 CurG_Ws16 163.8350 APPCrCtl1 0.00 163.8350 FORMAT "%8.4" EXTENDED_LIMITS -163.8400 163.8350
 /begin AXIS_DESCR COM_AXIS CrCtl_vVehUpByte Vel_CrCtl1 6 0.00 255.0000 FORMAT "%8.4" EXTENDED_LIMITS -32768.00 32767.00 AXIS_PTS_REF CrCtl_vTapDnInit_AXIS /end AXIS_DESCR
/end CHARACTERISTIC
/begin CHARACTERISTIC CrCtl_rACCTDInitTG_GCUR "Curve for Tap Down initial value(Top Gear) for ACC" CURVE 0x80519194 CurG_Ws16 163.8350 APPCrCtl1 0.00 163.8350 FORMAT "%8.4" EXTENDED_LIMITS -163.8400 163.8350
 /begin AXIS_DESCR COM_AXIS CrCtl_vVehUpByte Vel_CrCtl1 6 0.00 255.0000 FORMAT "%8.4" EXTENDED_LIMITS -32768.00 32767.00 AXIS_PTS_REF CrCtl_vTapDnInit_AXIS /end AXIS_DESCR
/end CHARACTERISTIC
/begin CHARACTERISTIC CrCtl_rACCTUInitNTG_GCUR "Curve for Tap Up initial value(Not Top Gear) for ACC" CURVE 0x805191A0 CurG_Ws16 163.8350 APPCrCtl1 0.00 163.8350 FORMAT "%8.4" EXTENDED_LIMITS -163.8400 163.8350
 /begin AXIS_DESCR COM_AXIS CrCtl_vVehUpByte Vel_CrCtl1 6 0.00 255.0000 FORMAT "%8.4" EXTENDED_LIMITS -32768.00 32767.00 AXIS_PTS_REF CrCtl_vTapUpInit_AXIS /end AXIS_DESCR
/end CHARACTERISTIC
/begin CHARACTERISTIC CrCtl_rACCTUInitTG_GCUR "Curve for Tap Up initial value(Top Gear) for ACC" CURVE 0x805191AC CurG_Ws16 163.8350 APPCrCtl1 0.00 163.8350 FORMAT "%8.4" EXTENDED_LIMITS -163.8400 163.8350
 /begin AXIS_DESCR COM_AXIS CrCtl_vVehUpByte Vel_CrCtl1 6 0.00 255.0000 FORMAT "%8.4" EXTENDED_LIMITS -32768.00 32767.00 AXIS_PTS_REF CrCtl_vTapUpInit_AXIS /end AXIS_DESCR
/end CHARACTERISTIC
/begin CHARACTERISTIC CrCtl_rAppACCFUEC_GCUR "Added value1 in each 100ms to desired vehicle speed for ECON (ECON sw OFF, Continuous TAPUP)" CURVE 0x805191B8 CurG_Ws16 327.6750 APPCrCtl1 -163.8400 163.8350 FORMAT "%8.4"
 /begin AXIS_DESCR COM_AXIS CrCtl_vVehSpd_mp Vel_CrCtl1 12 -32768.00 32767.00 FORMAT "%8.2" AXIS_PTS_REF CrCtl_vAPPLim_AXIS /end AXIS_DESCR
/end CHARACTERISTIC
/begin CHARACTERISTIC CrCtl_rAPPACCFUKmph_GCUR "Upper limit of acc. pedal opening at ACC follow-up control (Kmph)" CURVE 0x805191D0 CurG_Ws16 327.6750 APPCrCtl1 -163.8400 163.8350 FORMAT "%8.4"
 /begin AXIS_DESCR COM_AXIS CrCtl_vVehSpd_mp Vel_CrCtl1 12 -32768.00 32767.00 FORMAT "%8.2" AXIS_PTS_REF CrCtl_vAPPLim_AXIS /end AXIS_DESCR
/end CHARACTERISTIC
/begin CHARACTERISTIC CrCtl_rAPPACCFUMph_GCUR "Upper limit of acc. pedal opening at ACC follow-up control(MPH)" CURVE 0x805191E8 CurG_Ws16 327.6750 APPCrCtl1 -163.8400 163.8350 FORMAT "%8.4"
 /begin AXIS_DESCR COM_AXIS CrCtl_vVehSpd_mp Vel_CrCtl1 12 -32768.00 32767.00 FORMAT "%8.2" AXIS_PTS_REF CrCtl_vAPPLim_AXIS /end AXIS_DESCR
/end CHARACTERISTIC
/begin CHARACTERISTIC CrCtl_rAPPOpnDR1CnclDwnSlp_CUR "Accped opening for DR1 cancellation at CC down slope" CURVE 0x80519200 RB_Cur_Xs16Ws16 163.8350 APPCrCtl1 0.00 163.8350 FORMAT "%8.4" EXTENDED_LIMITS -163.8400 163.8350
 /begin AXIS_DESCR STD_AXIS CrCtl_vVehUpByte Vel_CrCtl1 6 0.00 32767.00 FORMAT "%8.2" EXTENDED_LIMITS -32768.00 32767.00 DEPOSIT ABSOLUTE /end AXIS_DESCR
/end CHARACTERISTIC
/begin CHARACTERISTIC CrCtl_rAPPOpnDR2CnclDwnSlp_CUR "Accped opening for DR2 cancellation at CC down slope" CURVE 0x8051921A RB_Cur_Xs16Ws16 163.8350 APPCrCtl1 0.00 163.8350 FORMAT "%8.4" EXTENDED_LIMITS -163.8400 163.8350
 /begin AXIS_DESCR STD_AXIS CrCtl_vVehUpByte Vel_CrCtl1 6 0.00 32767.00 FORMAT "%8.2" EXTENDED_LIMITS -32768.00 32767.00 DEPOSIT ABSOLUTE /end AXIS_DESCR
/end CHARACTERISTIC
/begin CHARACTERISTIC CrCtl_rAPPOpnDR3CnclDwnSlp_CUR "Accped opening for DR3 cancellation at CC down slope" CURVE 0x80519234 RB_Cur_Xs16Ws16 163.8350 APPCrCtl1 0.00 163.8350 FORMAT "%8.4" EXTENDED_LIMITS -163.8400 163.8350
 /begin AXIS_DESCR STD_AXIS CrCtl_vVehUpByte Vel_CrCtl1 6 0.00 32767.00 FORMAT "%8.2" EXTENDED_LIMITS -32768.00 32767.00 DEPOSIT ABSOLUTE /end AXIS_DESCR
/end CHARACTERISTIC
/begin CHARACTERISTIC CrCtl_rAPPOpnDR4CnclDwnSlp_CUR "Accped opening for DR4 cancellation at CC down slope" CURVE 0x8051924E RB_Cur_Xs16Ws16 163.8350 APPCrCtl1 0.00 163.8350 FORMAT "%8.4" EXTENDED_LIMITS -163.8400 163.8350
 /begin AXIS_DESCR STD_AXIS CrCtl_vVehUpByte Vel_CrCtl1 6 0.00 32767.00 FORMAT "%8.2" EXTENDED_LIMITS -32768.00 32767.00 DEPOSIT ABSOLUTE /end AXIS_DESCR
/end CHARACTERISTIC
/begin CHARACTERISTIC CrCtl_rAPPOpnDR5CnclDwnSlp_CUR "Accped opening for DR5 cancellation at CC down slope" CURVE 0x80519268 RB_Cur_Xs16Ws16 163.8350 APPCrCtl1 0.00 163.8350 FORMAT "%8.4" EXTENDED_LIMITS -163.8400 163.8350
 /begin AXIS_DESCR STD_AXIS CrCtl_vVehUpByte Vel_CrCtl1 6 0.00 32767.00 FORMAT "%8.2" EXTENDED_LIMITS -32768.00 32767.00 DEPOSIT ABSOLUTE /end AXIS_DESCR
/end CHARACTERISTIC
/begin CHARACTERISTIC CrCtl_rAPPOpnDR6CnclDwnSlp_CUR "Accped opening for DR6 cancellation at CC down slope" CURVE 0x80519282 RB_Cur_Xs16Ws16 163.8350 APPCrCtl1 0.00 163.8350 FORMAT "%8.4" EXTENDED_LIMITS -163.8400 163.8350
 /begin AXIS_DESCR STD_AXIS CrCtl_vVehUpByte Vel_CrCtl1 6 0.00 32767.00 FORMAT "%8.2" EXTENDED_LIMITS -32768.00 32767.00 DEPOSIT ABSOLUTE /end AXIS_DESCR
/end CHARACTERISTIC
/begin CHARACTERISTIC CrCtl_rAPPOpnDR7CnclDwnSlp_CUR "Accped opening for DR7 cancellation at CC down slope" CURVE 0x8051929C RB_Cur_Xs16Ws16 163.8350 APPCrCtl1 0.00 163.8350 FORMAT "%8.4" EXTENDED_LIMITS -163.8400 163.8350
 /begin AXIS_DESCR STD_AXIS CrCtl_vVehUpByte Vel_CrCtl1 6 0.00 32767.00 FORMAT "%8.2" EXTENDED_LIMITS -32768.00 32767.00 DEPOSIT ABSOLUTE /end AXIS_DESCR
/end CHARACTERISTIC
/begin CHARACTERISTIC CrCtl_rClthOutLimVal_C "APP limit value for Clutch out" VALUE 0x805192B6 Val_Ws16 163.8350 APPCrCtl1 0.00 163.8350 FORMAT "%8.4" EXTENDED_LIMITS -163.8400 163.8350 /end CHARACTERISTIC
/begin CHARACTERISTIC CrCtl_rCmftAPPACCFUMph_GCUR "Upper limit of acc. pedal opening at ACC follow-up control( MPH) for Comfort mode" CURVE 0x805192B8 CurG_Ws16 327.6750 APPCrCtl1 -163.8400 163.8350 FORMAT "%8.4"
 /begin AXIS_DESCR COM_AXIS CrCtl_vVehSpd_mp Vel_CrCtl1 12 -32768.00 32767.00 FORMAT "%8.2" AXIS_PTS_REF CrCtl_vAPPLim_AXIS /end AXIS_DESCR
/end CHARACTERISTIC
/begin CHARACTERISTIC CrCtl_rCmftLSFStrtAPP1_GCUR "Curve for LSF start demand value for request level 1 for Comfort mode" CURVE 0x805192D0 CurG_Ws16 327.6750 APPCrCtl1 -163.8400 163.8350 FORMAT "%8.4"
 /begin AXIS_DESCR COM_AXIS CrCtl_vVehUpByte Vel_CrCtl1 12 -32768.00 32767.00 FORMAT "%8.2" AXIS_PTS_REF CrCtl_vLSFStrtAPP_AXIS /end AXIS_DESCR
/end CHARACTERISTIC
/begin CHARACTERISTIC CrCtl_rCmftMaxAppCCEC_GCUR "Selected easily condition to change desired vehicle speed for ECON for Comfort mode" CURVE 0x805192E8 CurG_Ws16 327.6750 APPCrCtl1 -163.8400 163.8350 FORMAT "%8.4"
 /begin AXIS_DESCR COM_AXIS CrCtl_vVehSpd_mp Vel_CrCtl1 12 -32768.00 32767.00 FORMAT "%8.2" AXIS_PTS_REF CrCtl_vAPPLim_AXIS /end AXIS_DESCR
/end CHARACTERISTIC
/begin CHARACTERISTIC CrCtl_rCmftMaxAPPCCMph_GCUR "Max. acc pedal opening at CC(MPH) for Comfort mode" CURVE 0x80519300 CurG_Ws16 327.6750 APPCrCtl1 -163.8400 163.8350 FORMAT "%8.4"
 /begin AXIS_DESCR COM_AXIS CrCtl_vVehSpd_mp Vel_CrCtl1 12 -32768.00 32767.00 FORMAT "%8.2" AXIS_PTS_REF CrCtl_vAPPLim_AXIS /end AXIS_DESCR
/end CHARACTERISTIC
/begin CHARACTERISTIC CrCtl_rCmftMaxCC3LGMph_GCUR "Max. acc. pedal opening at CC3 lower gear (MPH) for Comfort mode" CURVE 0x80519318 CurG_Ws16 327.6750 APPCrCtl1 -163.8400 163.8350 FORMAT "%8.4"
 /begin AXIS_DESCR COM_AXIS CrCtl_vVehSpd_mp Vel_CrCtl1 12 -32768.00 32767.00 FORMAT "%8.2" AXIS_PTS_REF CrCtl_vAPPLim_AXIS /end AXIS_DESCR
/end CHARACTERISTIC
/begin CHARACTERISTIC CrCtl_rCmftMaxCC4LGMph_GCUR "Max. acc. pedal opening at CC4 lower gear (MPH) for Comfort mode" CURVE 0x80519330 CurG_Ws16 327.6750 APPCrCtl1 -163.8400 163.8350 FORMAT "%8.4"
 /begin AXIS_DESCR COM_AXIS CrCtl_vVehSpd_mp Vel_CrCtl1 12 -32768.00 32767.00 FORMAT "%8.2" AXIS_PTS_REF CrCtl_vAPPLim_AXIS /end AXIS_DESCR
/end CHARACTERISTIC
/begin CHARACTERISTIC CrCtl_rCmftMaxCC5LGMph_GCUR "Max. acc. pedal opening at CC5 lower gear (MPH) for Comfort mode" CURVE 0x80519348 CurG_Ws16 327.6750 APPCrCtl1 -163.8400 163.8350 FORMAT "%8.4"
 /begin AXIS_DESCR COM_AXIS CrCtl_vVehSpd_mp Vel_CrCtl1 12 -32768.00 32767.00 FORMAT "%8.2" AXIS_PTS_REF CrCtl_vAPPLim_AXIS /end AXIS_DESCR
/end CHARACTERISTIC
/begin CHARACTERISTIC CrCtl_rCmftMaxCC6LGMph_GCUR "Max. acc. pedal opening at CC6 lower gear (MPH) for Comfort mode" CURVE 0x80519360 CurG_Ws16 327.6750 APPCrCtl1 -163.8400 163.8350 FORMAT "%8.4"
 /begin AXIS_DESCR COM_AXIS CrCtl_vVehSpd_mp Vel_CrCtl1 12 -32768.00 32767.00 FORMAT "%8.2" AXIS_PTS_REF CrCtl_vAPPLim_AXIS /end AXIS_DESCR
/end CHARACTERISTIC
/begin CHARACTERISTIC CrCtl_rCmftMaxCCLGMph_GCUR "Max. acc. pedal opening at CC2 lower gear (MPH) for Comfort mode" CURVE 0x80519378 CurG_Ws16 327.6750 APPCrCtl1 -163.8400 163.8350 FORMAT "%8.4"
 /begin AXIS_DESCR COM_AXIS CrCtl_vVehSpd_mp Vel_CrCtl1 12 -32768.00 32767.00 FORMAT "%8.2" AXIS_PTS_REF CrCtl_vAPPLim_AXIS /end AXIS_DESCR
/end CHARACTERISTIC
/begin CHARACTERISTIC CrCtl_rCmftMaxCCNGMph_GCUR "Max. acc. pedal opening at CC next gear (MPH) for Comfort mode" CURVE 0x80519390 CurG_Ws16 327.6750 APPCrCtl1 -163.8400 163.8350 FORMAT "%8.4"
 /begin AXIS_DESCR COM_AXIS CrCtl_vVehSpd_mp Vel_CrCtl1 12 -32768.00 32767.00 FORMAT "%8.2" AXIS_PTS_REF CrCtl_vAPPLim_AXIS /end AXIS_DESCR
/end CHARACTERISTIC
/begin CHARACTERISTIC CrCtl_rCmftMaxCCTGMph_GCUR "Max. acc. pedal opening at CC top gear (MPH) for Comfort mode" CURVE 0x805193A8 CurG_Ws16 327.6750 APPCrCtl1 -163.8400 163.8350 FORMAT "%8.4"
 /begin AXIS_DESCR COM_AXIS CrCtl_vVehSpd_mp Vel_CrCtl1 12 -32768.00 32767.00 FORMAT "%8.2" AXIS_PTS_REF CrCtl_vAPPLim_AXIS /end AXIS_DESCR
/end CHARACTERISTIC
/begin CHARACTERISTIC CrCtl_rCmftTDInitNTG_GCUR "Curve for Tap Down initial value(Not Top Gear) for CC for Comfort mode" CURVE 0x805193C0 CurG_Ws16 327.6750 APPCrCtl1 -163.8400 163.8350 FORMAT "%8.4"
 /begin AXIS_DESCR COM_AXIS CrCtl_vVehUpByte Vel_CrCtl1 6 0.00 255.0000 FORMAT "%8.4" EXTENDED_LIMITS -32768.00 32767.00 AXIS_PTS_REF CrCtl_vTapDnInit_AXIS /end AXIS_DESCR
/end CHARACTERISTIC
/begin CHARACTERISTIC CrCtl_rCmftTDInitTG_GCUR "Curve for Tap Down initial value(Top Gear) for CC for Comfort mode" CURVE 0x805193CC CurG_Ws16 327.6750 APPCrCtl1 -163.8400 163.8350 FORMAT "%8.4"
 /begin AXIS_DESCR COM_AXIS CrCtl_vVehUpByte Vel_CrCtl1 6 0.00 255.0000 FORMAT "%8.4" EXTENDED_LIMITS -32768.00 32767.00 AXIS_PTS_REF CrCtl_vTapDnInit_AXIS /end AXIS_DESCR
/end CHARACTERISTIC
/begin CHARACTERISTIC CrCtl_rCmftTUInitNTG_GCUR "Curve for Tap Up initial value(Not Top Gear) for CC for Comfort mode" CURVE 0x805193D8 CurG_Ws16 327.6750 APPCrCtl1 -163.8400 163.8350 FORMAT "%8.4"
 /begin AXIS_DESCR COM_AXIS CrCtl_vVehUpByte Vel_CrCtl1 6 0.00 255.0000 FORMAT "%8.4" EXTENDED_LIMITS -32768.00 32767.00 AXIS_PTS_REF CrCtl_vTapUpInit_AXIS /end AXIS_DESCR
/end CHARACTERISTIC
/begin CHARACTERISTIC CrCtl_rCmftTUInitTG_GCUR "Curve for Tap Up initial value(Top Gear) for CC for Comfort mode" CURVE 0x805193E4 CurG_Ws16 327.6750 APPCrCtl1 -163.8400 163.8350 FORMAT "%8.4"
 /begin AXIS_DESCR COM_AXIS CrCtl_vVehUpByte Vel_CrCtl1 6 0.00 255.0000 FORMAT "%8.4" EXTENDED_LIMITS -32768.00 32767.00 AXIS_PTS_REF CrCtl_vTapUpInit_AXIS /end AXIS_DESCR
/end CHARACTERISTIC
/begin CHARACTERISTIC CrCtl_rDRAppCnclDnSlp_C "DR cancel judgement acc.pedal opening at CC down slope." VALUE 0x805193F0 Val_Ws16 327.6750 APPCrCtl1 -163.8400 163.8350 FORMAT "%8.4" /end CHARACTERISTIC
/begin AXIS_PTS CrCtl_rDwn_AXIS "Axis for torque or App down for cruise control cancel group curve" 0x805193F2 CrCtl_rDes Axis_Xs16 163.8350 APPCrCtl1 6 0.00 163.8350 FORMAT "%8.4" EXTENDED_LIMITS -163.8400 163.8350 DEPOSIT ABSOLUTE /end AXIS_PTS
/begin CHARACTERISTIC CrCtl_rECAppAdd10ms_C "APP request every 10ms Sub variant value during ECON active" VALUE 0x80519400 Val_Ws16 163.8350 APPCrCtl1 0.00 163.8350 FORMAT "%8.4" EXTENDED_LIMITS -163.8400 163.8350 /end CHARACTERISTIC
/begin CHARACTERISTIC CrCtl_rECAppSub10ms_C "Corrected deviation speed to check the end of resume off control" VALUE 0x80519402 Val_Ws16 163.8350 APPCrCtl1 0.00 163.8350 FORMAT "%8.4" EXTENDED_LIMITS -163.8400 163.8350 /end CHARACTERISTIC
/begin CHARACTERISTIC CrCtl_rEcoAccOffNTG_GMAP "MAP for output Accel off(Not Top Gear) for Eco mode" MAP 0x80519404 MapG_Ws16 327.6750 APPCrCtl1 -163.8400 163.8350 FORMAT "%8.4"
 /begin AXIS_DESCR COM_AXIS CrCtl_vVehUpByte Vel_CrCtl1 6 0.00 255.0000 FORMAT "%8.4" EXTENDED_LIMITS -32768.00 32767.00 AXIS_PTS_REF CrCtl_rAccOffX_AXIS /end AXIS_DESCR
 /begin AXIS_DESCR COM_AXIS CrCtl_rEstSlpFltVal Prc_CrCtl4 9 -128.0000 127.9961 FORMAT "%8.4" AXIS_PTS_REF CrCtl_rAccOffY_AXIS /end AXIS_DESCR
/end CHARACTERISTIC
/begin CHARACTERISTIC CrCtl_rEcoAccOffTG_GMAP "MAP for output Accel off(Top Gear) for Eco mode" MAP 0x80519470 MapG_Ws16 327.6750 APPCrCtl1 -163.8400 163.8350 FORMAT "%8.4"
 /begin AXIS_DESCR COM_AXIS CrCtl_vVehUpByte Vel_CrCtl1 6 0.00 255.0000 FORMAT "%8.4" EXTENDED_LIMITS -32768.00 32767.00 AXIS_PTS_REF CrCtl_rAccOffX_AXIS /end AXIS_DESCR
 /begin AXIS_DESCR COM_AXIS CrCtl_rEstSlpFltVal Prc_CrCtl4 9 -128.0000 127.9961 FORMAT "%8.4" AXIS_PTS_REF CrCtl_rAccOffY_AXIS /end AXIS_DESCR
/end CHARACTERISTIC
/begin CHARACTERISTIC CrCtl_rECOffAppLimNum1_MAP "Correct value of APP in top gear for ECON" MAP 0x805194DC Map_Xs16Ys16Ws16 327.6750 APPCrCtl1 -163.8400 163.8350 FORMAT "%8.4"
 /begin AXIS_DESCR STD_AXIS CrCUI_nEngSpd EngNCrCtl 12 0.00 10000.00 FORMAT "%8.2" EXTENDED_LIMITS -32768.00 32767.00 DEPOSIT ABSOLUTE /end AXIS_DESCR
 /begin AXIS_DESCR STD_AXIS CrCtl_vVehUpByte Vel_CrCtl1 6 0.00 255.0000 FORMAT "%8.4" EXTENDED_LIMITS -32768.00 32767.00 DEPOSIT ABSOLUTE /end AXIS_DESCR
/end CHARACTERISTIC
/begin CHARACTERISTIC CrCtl_rECOffAppLimNum2_MAP "Curve for reducing factor of acceleration contorol value for ECON (close)" MAP 0x80519594 Map_Xs16Ys16Ws16 327.6750 APPCrCtl1 -163.8400 163.8350 FORMAT "%8.4"
 /begin AXIS_DESCR STD_AXIS CrCUI_nEngSpd EngNCrCtl 12 0.00 10000.00 FORMAT "%8.2" EXTENDED_LIMITS -32768.00 32767.00 DEPOSIT ABSOLUTE /end AXIS_DESCR
 /begin AXIS_DESCR STD_AXIS CrCtl_vVehUpByte Vel_CrCtl1 6 0.00 255.0000 FORMAT "%8.4" EXTENDED_LIMITS -32768.00 32767.00 DEPOSIT ABSOLUTE /end AXIS_DESCR
/end CHARACTERISTIC
/begin CHARACTERISTIC CrCtl_rECOffAppLimNum3_MAP "Curve for reducing factor of acceleration contorol value for ECON (open)" MAP 0x8051964C Map_Xs16Ys16Ws16 327.6750 APPCrCtl1 -163.8400 163.8350 FORMAT "%8.4"
 /begin AXIS_DESCR STD_AXIS CrCUI_nEngSpd EngNCrCtl 12 0.00 10000.00 FORMAT "%8.2" EXTENDED_LIMITS -32768.00 32767.00 DEPOSIT ABSOLUTE /end AXIS_DESCR
 /begin AXIS_DESCR STD_AXIS CrCtl_vVehUpByte Vel_CrCtl1 6 0.00 255.0000 FORMAT "%8.4" EXTENDED_LIMITS -32768.00 32767.00 DEPOSIT ABSOLUTE /end AXIS_DESCR
/end CHARACTERISTIC
/begin CHARACTERISTIC CrCtl_rECOffAppLimNum4_MAP "Correct value of TAPUP initial request APP for ECON" MAP 0x80519704 Map_Xs16Ys16Ws16 327.6750 APPCrCtl1 -163.8400 163.8350 FORMAT "%8.4"
 /begin AXIS_DESCR STD_AXIS CrCUI_nEngSpd EngNCrCtl 12 0.00 10000.00 FORMAT "%8.2" EXTENDED_LIMITS -32768.00 32767.00 DEPOSIT ABSOLUTE /end AXIS_DESCR
 /begin AXIS_DESCR STD_AXIS CrCtl_vVehUpByte Vel_CrCtl1 6 0.00 255.0000 FORMAT "%8.4" EXTENDED_LIMITS -32768.00 32767.00 DEPOSIT ABSOLUTE /end AXIS_DESCR
/end CHARACTERISTIC
/begin CHARACTERISTIC CrCtl_rECOffAppLimNum5_MAP "Correct value of initial request APP for ECON" MAP 0x805197BC Map_Xs16Ys16Ws16 327.6750 APPCrCtl1 -163.8400 163.8350 FORMAT "%8.4"
 /begin AXIS_DESCR STD_AXIS CrCUI_nEngSpd EngNCrCtl 12 0.00 10000.00 FORMAT "%8.2" EXTENDED_LIMITS -32768.00 32767.00 DEPOSIT ABSOLUTE /end AXIS_DESCR
 /begin AXIS_DESCR STD_AXIS CrCtl_vVehUpByte Vel_CrCtl1 6 0.00 255.0000 FORMAT "%8.4" EXTENDED_LIMITS -32768.00 32767.00 DEPOSIT ABSOLUTE /end AXIS_DESCR
/end CHARACTERISTIC
/begin CHARACTERISTIC CrCtl_rECOffSlopDwn1_CUR "Slope for changing APP limitation number for ECON to 2 from 3 (for ECON sw OFF)" CURVE 0x80519874 RB_Cur_Xs16Ws16 255.9961 Prc_CrCtl4 -128.0000 127.9961 FORMAT "%8.4"
 /begin AXIS_DESCR STD_AXIS CrCtl_vVehUpByte Vel_CrCtl1 6 -32768.00 32767.00 FORMAT "%8.2" DEPOSIT ABSOLUTE /end AXIS_DESCR
/end CHARACTERISTIC
/begin CHARACTERISTIC CrCtl_rECOffSlopDwn2_CUR "Slope for changing APP limitation number for ECON to 3 from 4 (for ECON sw OFF)" CURVE 0x8051988E RB_Cur_Xs16Ws16 255.9961 Prc_CrCtl4 -128.0000 127.9961 FORMAT "%8.4"
 /begin AXIS_DESCR STD_AXIS CrCtl_vVehUpByte Vel_CrCtl1 6 -32768.00 32767.00 FORMAT "%8.2" DEPOSIT ABSOLUTE /end AXIS_DESCR
/end CHARACTERISTIC
/begin CHARACTERISTIC CrCtl_rECOffSlopDwn3_CUR "Slope for changing APP limitation number for ECON to 4 from 5 (for ECON sw OFF)" CURVE 0x805198A8 RB_Cur_Xs16Ws16 255.9961 Prc_CrCtl4 -128.0000 127.9961 FORMAT "%8.4"
 /begin AXIS_DESCR STD_AXIS CrCtl_vVehUpByte Vel_CrCtl1 6 -32768.00 32767.00 FORMAT "%8.2" DEPOSIT ABSOLUTE /end AXIS_DESCR
/end CHARACTERISTIC
/begin CHARACTERISTIC CrCtl_rECOffSlopDwn4_CUR "Slope for changing APP limitation number for ECON to 1 from 2 (for ECON sw ON)" CURVE 0x805198C2 RB_Cur_Xs16Ws16 255.9961 Prc_CrCtl4 -128.0000 127.9961 FORMAT "%8.4"
 /begin AXIS_DESCR STD_AXIS CrCtl_vVehUpByte Vel_CrCtl1 6 -32768.00 32767.00 FORMAT "%8.2" DEPOSIT ABSOLUTE /end AXIS_DESCR
/end CHARACTERISTIC
/begin CHARACTERISTIC CrCtl_rEcoLSFStrtAPP1_GCUR "Curve for LSF start demand value for request level 1 for Eco mode" CURVE 0x805198DC CurG_Ws16 327.6750 APPCrCtl1 -163.8400 163.8350 FORMAT "%8.4"
 /begin AXIS_DESCR COM_AXIS CrCtl_vVehUpByte Vel_CrCtl1 12 -32768.00 32767.00 FORMAT "%8.2" AXIS_PTS_REF CrCtl_vLSFStrtAPP_AXIS /end AXIS_DESCR
/end CHARACTERISTIC
/begin CHARACTERISTIC CrCtl_rECOnAppLimNum1_MAP "Enable resume off control" MAP 0x805198F4 Map_Xs16Ys16Ws16 327.6750 APPCrCtl1 -163.8400 163.8350 FORMAT "%8.4"
 /begin AXIS_DESCR STD_AXIS CrCUI_nEngSpd EngNCrCtl 12 0.00 10000.00 FORMAT "%8.2" EXTENDED_LIMITS -32768.00 32767.00 DEPOSIT ABSOLUTE /end AXIS_DESCR
 /begin AXIS_DESCR STD_AXIS CrCtl_vVehUpByte Vel_CrCtl1 6 0.00 255.0000 FORMAT "%8.4" EXTENDED_LIMITS -32768.00 32767.00 DEPOSIT ABSOLUTE /end AXIS_DESCR
/end CHARACTERISTIC
/begin CHARACTERISTIC CrCtl_rECOnAppLimNum2_MAP "Corrected deviation speed to check the end of resume off control" MAP 0x805199AC Map_Xs16Ys16Ws16 327.6750 APPCrCtl1 -163.8400 163.8350 FORMAT "%8.4"
 /begin AXIS_DESCR STD_AXIS CrCUI_nEngSpd EngNCrCtl 12 0.00 10000.00 FORMAT "%8.2" EXTENDED_LIMITS -32768.00 32767.00 DEPOSIT ABSOLUTE /end AXIS_DESCR
 /begin AXIS_DESCR STD_AXIS CrCtl_vVehUpByte Vel_CrCtl1 6 0.00 255.0000 FORMAT "%8.4" EXTENDED_LIMITS -32768.00 32767.00 DEPOSIT ABSOLUTE /end AXIS_DESCR
/end CHARACTERISTIC
/begin CHARACTERISTIC CrCtl_rECOnAppLimNum3_MAP "APP request every 10ms Sub variant value during ECON active" MAP 0x80519A64 Map_Xs16Ys16Ws16 327.6750 APPCrCtl1 -163.8400 163.8350 FORMAT "%8.4"
 /begin AXIS_DESCR STD_AXIS CrCUI_nEngSpd EngNCrCtl 12 0.00 10000.00 FORMAT "%8.2" EXTENDED_LIMITS -32768.00 32767.00 DEPOSIT ABSOLUTE /end AXIS_DESCR
 /begin AXIS_DESCR STD_AXIS CrCtl_vVehUpByte Vel_CrCtl1 6 0.00 255.0000 FORMAT "%8.4" EXTENDED_LIMITS -32768.00 32767.00 DEPOSIT ABSOLUTE /end AXIS_DESCR
/end CHARACTERISTIC
/begin CHARACTERISTIC CrCtl_rECOnAppLimNum4_MAP "APP request every 10ms Add variant value during ECON active" MAP 0x80519B1C Map_Xs16Ys16Ws16 327.6750 APPCrCtl1 -163.8400 163.8350 FORMAT "%8.4"
 /begin AXIS_DESCR STD_AXIS CrCUI_nEngSpd EngNCrCtl 12 0.00 10000.00 FORMAT "%8.2" EXTENDED_LIMITS -32768.00 32767.00 DEPOSIT ABSOLUTE /end AXIS_DESCR
 /begin AXIS_DESCR STD_AXIS CrCtl_vVehUpByte Vel_CrCtl1 6 0.00 255.0000 FORMAT "%8.4" EXTENDED_LIMITS -32768.00 32767.00 DEPOSIT ABSOLUTE /end AXIS_DESCR
/end CHARACTERISTIC
/begin CHARACTERISTIC CrCtl_rECOnAppLimNum5_MAP "Correct value of APP in excepting top gear for ECON" MAP 0x80519BD4 Map_Xs16Ys16Ws16 327.6750 APPCrCtl1 -163.8400 163.8350 FORMAT "%8.4"
 /begin AXIS_DESCR STD_AXIS CrCUI_nEngSpd EngNCrCtl 12 0.00 10000.00 FORMAT "%8.2" EXTENDED_LIMITS -32768.00 32767.00 DEPOSIT ABSOLUTE /end AXIS_DESCR
 /begin AXIS_DESCR STD_AXIS CrCtl_vVehUpByte Vel_CrCtl1 6 0.00 255.0000 FORMAT "%8.4" EXTENDED_LIMITS -32768.00 32767.00 DEPOSIT ABSOLUTE /end AXIS_DESCR
/end CHARACTERISTIC
/begin CHARACTERISTIC CrCtl_rECOnSlopDwn1_CUR "Slope for changing APP limitation number for ECON to 2 from 3 (for ECON sw ON)" CURVE 0x80519C8C RB_Cur_Xs16Ws16 255.9961 Prc_CrCtl4 -128.0000 127.9961 FORMAT "%8.4"
 /begin AXIS_DESCR STD_AXIS CrCtl_vVehUpByte Vel_CrCtl1 6 -32768.00 32767.00 FORMAT "%8.2" DEPOSIT ABSOLUTE /end AXIS_DESCR
/end CHARACTERISTIC
/begin CHARACTERISTIC CrCtl_rECOnSlopDwn2_CUR "Slope for changing APP limitation number for ECON to 3 from 4 (for ECON sw ON)" CURVE 0x80519CA6 RB_Cur_Xs16Ws16 255.9961 Prc_CrCtl4 -128.0000 127.9961 FORMAT "%8.4"
 /begin AXIS_DESCR STD_AXIS CrCtl_vVehUpByte Vel_CrCtl1 6 -32768.00 32767.00 FORMAT "%8.2" DEPOSIT ABSOLUTE /end AXIS_DESCR
/end CHARACTERISTIC
/begin CHARACTERISTIC CrCtl_rECOnSlopDwn3_CUR "Slope for changing APP limitation number for ECON to 4 from 5 (for ECON sw ON)" CURVE 0x80519CC0 RB_Cur_Xs16Ws16 255.9961 Prc_CrCtl4 -128.0000 127.9961 FORMAT "%8.4"
 /begin AXIS_DESCR STD_AXIS CrCtl_vVehUpByte Vel_CrCtl1 6 -32768.00 32767.00 FORMAT "%8.2" DEPOSIT ABSOLUTE /end AXIS_DESCR
/end CHARACTERISTIC
/begin CHARACTERISTIC CrCtl_rECOnSlopDwn4_CUR "Slope for changing APP limitation number for ECON to 1 from 2 (for ECON sw OFF and during ACC)" CURVE 0x80519CDA RB_Cur_Xs16Ws16 255.9961 Prc_CrCtl4 -128.0000 127.9961 FORMAT "%8.4"
 /begin AXIS_DESCR STD_AXIS CrCtl_vVehUpByte Vel_CrCtl1 6 -32768.00 32767.00 FORMAT "%8.2" DEPOSIT ABSOLUTE /end AXIS_DESCR
/end CHARACTERISTIC
/begin CHARACTERISTIC CrCtl_rEcoResOffNTG_GMAP "MAP for output resume off (Not Top Gear) for Eco mode" MAP 0x80519CF4 MapG_Ws16 327.6750 APPCrCtl1 -163.8400 163.8350 FORMAT "%8.4"
 /begin AXIS_DESCR COM_AXIS CrCtl_vVehUpByte Vel_CrCtl1 6 0.00 255.0000 FORMAT "%8.4" EXTENDED_LIMITS -32768.00 32767.00 AXIS_PTS_REF CrCtl_rAccOffX_AXIS /end AXIS_DESCR
 /begin AXIS_DESCR COM_AXIS CrCtl_rEstSlpFltVal Prc_CrCtl4 9 -128.0000 127.9961 FORMAT "%8.4" AXIS_PTS_REF CrCtl_rAccOffY_AXIS /end AXIS_DESCR
/end CHARACTERISTIC
/begin CHARACTERISTIC CrCtl_rEcoResOffTG_GMAP "MAP for output resume off (Top Gear) for Eco mode" MAP 0x80519D60 MapG_Ws16 327.6750 APPCrCtl1 -163.8400 163.8350 FORMAT "%8.4"
 /begin AXIS_DESCR COM_AXIS CrCtl_vVehUpByte Vel_CrCtl1 6 0.00 255.0000 FORMAT "%8.4" EXTENDED_LIMITS -32768.00 32767.00 AXIS_PTS_REF CrCtl_rAccOffX_AXIS /end AXIS_DESCR
 /begin AXIS_DESCR COM_AXIS CrCtl_rEstSlpFltVal Prc_CrCtl4 9 -128.0000 127.9961 FORMAT "%8.4" AXIS_PTS_REF CrCtl_rAccOffY_AXIS /end AXIS_DESCR
/end CHARACTERISTIC
/begin CHARACTERISTIC CrCtl_rEcoTDInitNTG_GCUR "Curve for Tap Down initial value(Not Top Gear) for CC for Eco mode" CURVE 0x80519DCC CurG_Ws16 327.6750 APPCrCtl1 -163.8400 163.8350 FORMAT "%8.4"
 /begin AXIS_DESCR COM_AXIS CrCtl_vVehUpByte Vel_CrCtl1 6 0.00 255.0000 FORMAT "%8.4" EXTENDED_LIMITS -32768.00 32767.00 AXIS_PTS_REF CrCtl_vTapDnInit_AXIS /end AXIS_DESCR
/end CHARACTERISTIC
/begin CHARACTERISTIC CrCtl_rEcoTDInitTG_GCUR "Curve for Tap Down initial value(Top Gear) for CC for Eco mode" CURVE 0x80519DD8 CurG_Ws16 327.6750 APPCrCtl1 -163.8400 163.8350 FORMAT "%8.4"
 /begin AXIS_DESCR COM_AXIS CrCtl_vVehUpByte Vel_CrCtl1 6 0.00 255.0000 FORMAT "%8.4" EXTENDED_LIMITS -32768.00 32767.00 AXIS_PTS_REF CrCtl_vTapDnInit_AXIS /end AXIS_DESCR
/end CHARACTERISTIC
/begin CHARACTERISTIC CrCtl_rEcoTUInitNTG_GCUR "Curve for Tap Up initial value(Not Top Gear) for CC for Eco mode" CURVE 0x80519DE4 CurG_Ws16 327.6750 APPCrCtl1 -163.8400 163.8350 FORMAT "%8.4"
 /begin AXIS_DESCR COM_AXIS CrCtl_vVehUpByte Vel_CrCtl1 6 0.00 255.0000 FORMAT "%8.4" EXTENDED_LIMITS -32768.00 32767.00 AXIS_PTS_REF CrCtl_vTapUpInit_AXIS /end AXIS_DESCR
/end CHARACTERISTIC
/begin CHARACTERISTIC CrCtl_rEcoTUInitTG_GCUR "Curve for Tap Up initial value(Top Gear) for CC for Eco mode" CURVE 0x80519DF0 CurG_Ws16 327.6750 APPCrCtl1 -163.8400 163.8350 FORMAT "%8.4"
 /begin AXIS_DESCR COM_AXIS CrCtl_vVehUpByte Vel_CrCtl1 6 0.00 255.0000 FORMAT "%8.4" EXTENDED_LIMITS -32768.00 32767.00 AXIS_PTS_REF CrCtl_vTapUpInit_AXIS /end AXIS_DESCR
/end CHARACTERISTIC
/begin CHARACTERISTIC CrCtl_rECShiftVal1_MAP "MAP for output resume off (Top Gear)" MAP 0x80519DFC Map_Xs16Ys16Ws16 327.6750 APPCrCtl1 -163.8400 163.8350 FORMAT "%8.4"
 /begin AXIS_DESCR STD_AXIS CrCUI_nEngSpd EngNCrCtl 12 0.00 10000.00 FORMAT "%8.2" EXTENDED_LIMITS -32768.00 32767.00 DEPOSIT ABSOLUTE /end AXIS_DESCR
 /begin AXIS_DESCR STD_AXIS CrCtl_rDes APPCrCtl1 12 -163.8400 163.8350 FORMAT "%8.4" DEPOSIT ABSOLUTE /end AXIS_DESCR
/end CHARACTERISTIC
/begin CHARACTERISTIC CrCtl_rECShiftVal2_MAP "MAP for output resume off (Not Top Gear)" MAP 0x80519F50 Map_Xs16Ys16Ws16 327.6750 APPCrCtl1 -163.8400 163.8350 FORMAT "%8.4"
 /begin AXIS_DESCR STD_AXIS CrCUI_nEngSpd EngNCrCtl 12 0.00 10000.00 FORMAT "%8.2" EXTENDED_LIMITS -32768.00 32767.00 DEPOSIT ABSOLUTE /end AXIS_DESCR
 /begin AXIS_DESCR STD_AXIS CrCtl_rDes APPCrCtl1 12 -163.8400 163.8350 FORMAT "%8.4" DEPOSIT ABSOLUTE /end AXIS_DESCR
/end CHARACTERISTIC
/begin CHARACTERISTIC CrCtl_rECShiftVal3_MAP "MAP for output resume off (Top Gear, EU Km/h)" MAP 0x8051A0A4 Map_Xs16Ys16Ws16 327.6750 APPCrCtl1 -163.8400 163.8350 FORMAT "%8.4"
 /begin AXIS_DESCR STD_AXIS CrCUI_nEngSpd EngNCrCtl 12 0.00 10000.00 FORMAT "%8.2" EXTENDED_LIMITS -32768.00 32767.00 DEPOSIT ABSOLUTE /end AXIS_DESCR
 /begin AXIS_DESCR STD_AXIS CrCtl_rDes APPCrCtl1 12 -163.8400 163.8350 FORMAT "%8.4" DEPOSIT ABSOLUTE /end AXIS_DESCR
/end CHARACTERISTIC
/begin CHARACTERISTIC CrCtl_rECShiftVal4_MAP "MAP for output resume off (Not Top Gear, EU Km/h)" MAP 0x8051A1F8 Map_Xs16Ys16Ws16 327.6750 APPCrCtl1 -163.8400 163.8350 FORMAT "%8.4"
 /begin AXIS_DESCR STD_AXIS CrCUI_nEngSpd EngNCrCtl 12 0.00 10000.00 FORMAT "%8.2" EXTENDED_LIMITS -32768.00 32767.00 DEPOSIT ABSOLUTE /end AXIS_DESCR
 /begin AXIS_DESCR STD_AXIS CrCtl_rDes APPCrCtl1 12 -163.8400 163.8350 FORMAT "%8.4" DEPOSIT ABSOLUTE /end AXIS_DESCR
/end CHARACTERISTIC
/begin CHARACTERISTIC CrCtl_rECShiftVal5_MAP "During ACC follow-up control,deviation in accel data for DR1 judgement for ECON" MAP 0x8051A34C Map_Xs16Ys16Ws16 327.6750 APPCrCtl1 -163.8400 163.8350 FORMAT "%8.4"
 /begin AXIS_DESCR STD_AXIS CrCUI_nEngSpd EngNCrCtl 12 0.00 10000.00 FORMAT "%8.2" EXTENDED_LIMITS -32768.00 32767.00 DEPOSIT ABSOLUTE /end AXIS_DESCR
 /begin AXIS_DESCR STD_AXIS CrCtl_rDes APPCrCtl1 12 -163.8400 163.8350 FORMAT "%8.4" DEPOSIT ABSOLUTE /end AXIS_DESCR
/end CHARACTERISTIC
/begin CHARACTERISTIC CrCtl_rEstSlpValDR1Cncl_CUR "Slope assessed value data for CC_DR1 cancel judgement" CURVE 0x8051A4A0 RB_Cur_Xs16Ws16 127.9961 Prc_CrCtl4 0.00 127.9961 FORMAT "%8.4" EXTENDED_LIMITS -128.0000 127.9961
 /begin AXIS_DESCR STD_AXIS CrCtl_vVehUpByte Vel_CrCtl1 6 0.00 32767.00 FORMAT "%8.2" EXTENDED_LIMITS -32768.00 32767.00 DEPOSIT ABSOLUTE /end AXIS_DESCR
/end CHARACTERISTIC
/begin CHARACTERISTIC CrCtl_rEstSlpValDR2Cncl_CUR "Slope assessed value data for CC_DR2 cancel judgement" CURVE 0x8051A4BA RB_Cur_Xs16Ws16 127.9961 Prc_CrCtl4 0.00 127.9961 FORMAT "%8.4" EXTENDED_LIMITS -128.0000 127.9961
 /begin AXIS_DESCR STD_AXIS CrCtl_vVehUpByte Vel_CrCtl1 6 0.00 32767.00 FORMAT "%8.2" EXTENDED_LIMITS -32768.00 32767.00 DEPOSIT ABSOLUTE /end AXIS_DESCR
/end CHARACTERISTIC
/begin CHARACTERISTIC CrCtl_rEstSlpValDR3Cncl_CUR "Slope assessed value data for CC_DR3 cancel judgement" CURVE 0x8051A4D4 RB_Cur_Xs16Ws16 127.9961 Prc_CrCtl4 0.00 127.9961 FORMAT "%8.4" EXTENDED_LIMITS -128.0000 127.9961
 /begin AXIS_DESCR STD_AXIS CrCtl_vVehUpByte Vel_CrCtl1 6 0.00 32767.00 FORMAT "%8.2" EXTENDED_LIMITS -32768.00 32767.00 DEPOSIT ABSOLUTE /end AXIS_DESCR
/end CHARACTERISTIC
/begin CHARACTERISTIC CrCtl_rEstSlpValDR4Cncl_CUR "Slope assessed value data for CC_DR4 cancel judgement" CURVE 0x8051A4EE RB_Cur_Xs16Ws16 255.9961 Prc_CrCtl4 -128.0000 127.9961 FORMAT "%8.4"
 /begin AXIS_DESCR STD_AXIS CrCtl_vVehUpByte Vel_CrCtl1 6 -32768.00 32767.00 FORMAT "%8.2" DEPOSIT ABSOLUTE /end AXIS_DESCR
/end CHARACTERISTIC
/begin CHARACTERISTIC CrCtl_rEstSlpValDR5Cncl_CUR "Slope assessed value data for CC_DR5 cancel judgement" CURVE 0x8051A508 RB_Cur_Xs16Ws16 255.9961 Prc_CrCtl4 -128.0000 127.9961 FORMAT "%8.4"
 /begin AXIS_DESCR STD_AXIS CrCtl_vVehUpByte Vel_CrCtl1 6 -32768.00 32767.00 FORMAT "%8.2" DEPOSIT ABSOLUTE /end AXIS_DESCR
/end CHARACTERISTIC
/begin CHARACTERISTIC CrCtl_rEstSlpValDR6Cncl_CUR "Slope assessed value data for CC_DR6 cancel judgement" CURVE 0x8051A522 RB_Cur_Xs16Ws16 255.9961 Prc_CrCtl4 -128.0000 127.9961 FORMAT "%8.4"
 /begin AXIS_DESCR STD_AXIS CrCtl_vVehUpByte Vel_CrCtl1 6 -32768.00 32767.00 FORMAT "%8.2" DEPOSIT ABSOLUTE /end AXIS_DESCR
/end CHARACTERISTIC
/begin CHARACTERISTIC CrCtl_rEstSlpValDR7Cncl_CUR "Slope assessed value data for CC_DR7 cancel judgement" CURVE 0x8051A53C RB_Cur_Xs16Ws16 255.9961 Prc_CrCtl4 -128.0000 127.9961 FORMAT "%8.4"
 /begin AXIS_DESCR STD_AXIS CrCtl_vVehUpByte Vel_CrCtl1 6 -32768.00 32767.00 FORMAT "%8.2" DEPOSIT ABSOLUTE /end AXIS_DESCR
/end CHARACTERISTIC
/begin CHARACTERISTIC CrCtl_rFstDwnCncl_GCUR "Curve for first torque Down for Cruise Control cancel" CURVE 0x8051A556 CurG_Ws16 163.8350 APPCrCtl1 0.00 163.8350 FORMAT "%8.4" EXTENDED_LIMITS -163.8400 163.8350
 /begin AXIS_DESCR COM_AXIS CrCtl_rDes APPCrCtl1 6 0.00 163.8350 FORMAT "%8.4" EXTENDED_LIMITS -163.8400 163.8350 AXIS_PTS_REF CrCtl_rDwn_AXIS /end AXIS_DESCR
/end CHARACTERISTIC
/begin CHARACTERISTIC CrCtl_rInitCmftReqNTG_GMAP "MAP for initial APP request(Not Top Gear) for comfort mode" MAP 0x8051A562 MapG_Ws16 327.6750 APPCrCtl1 -163.8400 163.8350 FORMAT "%8.4"
 /begin AXIS_DESCR COM_AXIS CrCtl_vSpdTab_mp Vel_CrCtl1 6 0.00 255.0000 FORMAT "%8.4" EXTENDED_LIMITS -32768.00 32767.00 AXIS_PTS_REF CrCtl_rInitReqX_AXIS /end AXIS_DESCR
 /begin AXIS_DESCR COM_AXIS CrCtl_rEstSlpTab_mp Prc_CrCtl4 5 -128.0000 127.9961 FORMAT "%8.4" AXIS_PTS_REF CrCtl_rInitReqY_AXIS /end AXIS_DESCR
/end CHARACTERISTIC
/begin CHARACTERISTIC CrCtl_rInitCmftReqTG_GMAP "MAP for initial APP request(Top Gear) for comfort mode" MAP 0x8051A59E MapG_Ws16 327.6750 APPCrCtl1 -163.8400 163.8350 FORMAT "%8.4"
 /begin AXIS_DESCR COM_AXIS CrCtl_vSpdTab_mp Vel_CrCtl1 6 0.00 255.0000 FORMAT "%8.4" EXTENDED_LIMITS -32768.00 32767.00 AXIS_PTS_REF CrCtl_rInitReqX_AXIS /end AXIS_DESCR
 /begin AXIS_DESCR COM_AXIS CrCtl_rEstSlpTab_mp Prc_CrCtl4 5 -128.0000 127.9961 FORMAT "%8.4" AXIS_PTS_REF CrCtl_rInitReqY_AXIS /end AXIS_DESCR
/end CHARACTERISTIC
/begin CHARACTERISTIC CrCtl_rInitEcoReqNTG_GMAP "MAP for initial APP request(Not Top Gear) for economy mode" MAP 0x8051A5DA MapG_Ws16 327.6750 APPCrCtl1 -163.8400 163.8350 FORMAT "%8.4"
 /begin AXIS_DESCR COM_AXIS CrCtl_vSpdTab_mp Vel_CrCtl1 6 0.00 255.0000 FORMAT "%8.4" EXTENDED_LIMITS -32768.00 32767.00 AXIS_PTS_REF CrCtl_rInitReqX_AXIS /end AXIS_DESCR
 /begin AXIS_DESCR COM_AXIS CrCtl_rEstSlpTab_mp Prc_CrCtl4 5 -128.0000 127.9961 FORMAT "%8.4" AXIS_PTS_REF CrCtl_rInitReqY_AXIS /end AXIS_DESCR
/end CHARACTERISTIC
/begin CHARACTERISTIC CrCtl_rInitEcoReqTG_GMAP "MAP for initial APP request(Top Gear) for economy mode" MAP 0x8051A616 MapG_Ws16 327.6750 APPCrCtl1 -163.8400 163.8350 FORMAT "%8.4"
 /begin AXIS_DESCR COM_AXIS CrCtl_vSpdTab_mp Vel_CrCtl1 6 0.00 255.0000 FORMAT "%8.4" EXTENDED_LIMITS -32768.00 32767.00 AXIS_PTS_REF CrCtl_rInitReqX_AXIS /end AXIS_DESCR
 /begin AXIS_DESCR COM_AXIS CrCtl_rEstSlpTab_mp Prc_CrCtl4 5 -128.0000 127.9961 FORMAT "%8.4" AXIS_PTS_REF CrCtl_rInitReqY_AXIS /end AXIS_DESCR
/end CHARACTERISTIC
/begin CHARACTERISTIC CrCtl_rInitPlusRReqNTG_GMAP "MAP for initial APP request(Not Top Gear) for PlusR mode" MAP 0x8051A652 MapG_Ws16 327.6750 APPCrCtl1 -163.8400 163.8350 FORMAT "%8.4"
 /begin AXIS_DESCR COM_AXIS CrCtl_vSpdTab_mp Vel_CrCtl1 6 0.00 255.0000 FORMAT "%8.4" EXTENDED_LIMITS -32768.00 32767.00 AXIS_PTS_REF CrCtl_rInitReqX_AXIS /end AXIS_DESCR
 /begin AXIS_DESCR COM_AXIS CrCtl_rEstSlpTab_mp Prc_CrCtl4 5 -128.0000 127.9961 FORMAT "%8.4" AXIS_PTS_REF CrCtl_rInitReqY_AXIS /end AXIS_DESCR
/end CHARACTERISTIC
/begin CHARACTERISTIC CrCtl_rInitPlusRReqTG_GMAP "MAP for initial APP request(Top Gear) for PlusR mode" MAP 0x8051A68E MapG_Ws16 327.6750 APPCrCtl1 -163.8400 163.8350 FORMAT "%8.4"
 /begin AXIS_DESCR COM_AXIS CrCtl_vSpdTab_mp Vel_CrCtl1 6 0.00 255.0000 FORMAT "%8.4" EXTENDED_LIMITS -32768.00 32767.00 AXIS_PTS_REF CrCtl_rInitReqX_AXIS /end AXIS_DESCR
 /begin AXIS_DESCR COM_AXIS CrCtl_rEstSlpTab_mp Prc_CrCtl4 5 -128.0000 127.9961 FORMAT "%8.4" AXIS_PTS_REF CrCtl_rInitReqY_AXIS /end AXIS_DESCR
/end CHARACTERISTIC
/begin CHARACTERISTIC CrCtl_rInitReqNTG_GMAP "MAP for initial APP request(Not Top Gear)" MAP 0x8051A6CA MapG_Ws16 163.8350 APPCrCtl1 0.00 163.8350 FORMAT "%8.4" EXTENDED_LIMITS -163.8400 163.8350
 /begin AXIS_DESCR COM_AXIS CrCtl_vSpdTab_mp Vel_CrCtl1 6 0.00 255.0000 FORMAT "%8.4" EXTENDED_LIMITS -32768.00 32767.00 AXIS_PTS_REF CrCtl_rInitReqX_AXIS /end AXIS_DESCR
 /begin AXIS_DESCR COM_AXIS CrCtl_rEstSlpTab_mp Prc_CrCtl4 5 -128.0000 127.9961 FORMAT "%8.4" AXIS_PTS_REF CrCtl_rInitReqY_AXIS /end AXIS_DESCR
/end CHARACTERISTIC
/begin CHARACTERISTIC CrCtl_rInitReqTG_GMAP "MAP for initial APP request(Top Gear)" MAP 0x8051A706 MapG_Ws16 163.8350 APPCrCtl1 0.00 163.8350 FORMAT "%8.4" EXTENDED_LIMITS -163.8400 163.8350
 /begin AXIS_DESCR COM_AXIS CrCtl_vSpdTab_mp Vel_CrCtl1 6 0.00 255.0000 FORMAT "%8.4" EXTENDED_LIMITS -32768.00 32767.00 AXIS_PTS_REF CrCtl_rInitReqX_AXIS /end AXIS_DESCR
 /begin AXIS_DESCR COM_AXIS CrCtl_rEstSlpTab_mp Prc_CrCtl4 5 -128.0000 127.9961 FORMAT "%8.4" AXIS_PTS_REF CrCtl_rInitReqY_AXIS /end AXIS_DESCR
/end CHARACTERISTIC
/begin AXIS_PTS CrCtl_rInitReqX_AXIS "X-Axis for initial APP request group MAP" 0x8051A742 CrCtl_vSpdTab_mp Axis_Xs16 255.0000 Vel_CrCtl1 6 0.00 255.0000 FORMAT "%8.4" EXTENDED_LIMITS -32768.00 32767.00 DEPOSIT ABSOLUTE /end AXIS_PTS
/begin AXIS_PTS CrCtl_rInitReqY_AXIS "Y-Axis for initial APP request group MAP" 0x8051A750 CrCtl_rEstSlpTab_mp Axis_Xs16 255.9961 Prc_CrCtl4 5 -128.0000 127.9961 FORMAT "%8.4" DEPOSIT ABSOLUTE /end AXIS_PTS
/begin CHARACTERISTIC CrCtl_rInitSptReqNTG_GMAP "MAP for initial APP request(Not Top Gear) for sport mode" MAP 0x8051A75C MapG_Ws16 327.6750 APPCrCtl1 -163.8400 163.8350 FORMAT "%8.4"
 /begin AXIS_DESCR COM_AXIS CrCtl_vSpdTab_mp Vel_CrCtl1 6 0.00 255.0000 FORMAT "%8.4" EXTENDED_LIMITS -32768.00 32767.00 AXIS_PTS_REF CrCtl_rInitReqX_AXIS /end AXIS_DESCR
 /begin AXIS_DESCR COM_AXIS CrCtl_rEstSlpTab_mp Prc_CrCtl4 5 -128.0000 127.9961 FORMAT "%8.4" AXIS_PTS_REF CrCtl_rInitReqY_AXIS /end AXIS_DESCR
/end CHARACTERISTIC
/begin CHARACTERISTIC CrCtl_rInitSptReqTG_GMAP "MAP for initial APP request(Top Gear) for sport mode" MAP 0x8051A798 MapG_Ws16 327.6750 APPCrCtl1 -163.8400 163.8350 FORMAT "%8.4"
 /begin AXIS_DESCR COM_AXIS CrCtl_vSpdTab_mp Vel_CrCtl1 6 0.00 255.0000 FORMAT "%8.4" EXTENDED_LIMITS -32768.00 32767.00 AXIS_PTS_REF CrCtl_rInitReqX_AXIS /end AXIS_DESCR
 /begin AXIS_DESCR COM_AXIS CrCtl_rEstSlpTab_mp Prc_CrCtl4 5 -128.0000 127.9961 FORMAT "%8.4" AXIS_PTS_REF CrCtl_rInitReqY_AXIS /end AXIS_DESCR
/end CHARACTERISTIC
/begin CHARACTERISTIC CrCtl_rLSFStrtAPP1_GCUR "Curve for LSF start demand value for request level 1" CURVE 0x8051A7D4 CurG_Ws16 327.6750 APPCrCtl1 -163.8400 163.8350 FORMAT "%8.4"
 /begin AXIS_DESCR COM_AXIS CrCtl_vVehUpByte Vel_CrCtl1 12 -32768.00 32767.00 FORMAT "%8.2" AXIS_PTS_REF CrCtl_vLSFStrtAPP_AXIS /end AXIS_DESCR
/end CHARACTERISTIC
/begin CHARACTERISTIC CrCtl_rMaxAppCCEC_GCUR "Selected easily condition to change desired vehicle speed for ECON" CURVE 0x8051A7EC CurG_Ws16 327.6750 APPCrCtl1 -163.8400 163.8350 FORMAT "%8.4"
 /begin AXIS_DESCR COM_AXIS CrCtl_vVehSpd_mp Vel_CrCtl1 12 -32768.00 32767.00 FORMAT "%8.2" AXIS_PTS_REF CrCtl_vAPPLim_AXIS /end AXIS_DESCR
/end CHARACTERISTIC
/begin CHARACTERISTIC CrCtl_rMaxAPPCCKmph_GCUR "Max. acc pedal opening at CC (Kmph)" CURVE 0x8051A804 CurG_Ws16 327.6750 APPCrCtl1 -163.8400 163.8350 FORMAT "%8.4"
 /begin AXIS_DESCR COM_AXIS CrCtl_vVehSpd_mp Vel_CrCtl1 12 -32768.00 32767.00 FORMAT "%8.2" AXIS_PTS_REF CrCtl_vAPPLim_AXIS /end AXIS_DESCR
/end CHARACTERISTIC
/begin CHARACTERISTIC CrCtl_rMaxAPPCCMph_GCUR "Max. acc pedal opening at CC(MPH)" CURVE 0x8051A81C CurG_Ws16 327.6750 APPCrCtl1 -163.8400 163.8350 FORMAT "%8.4"
 /begin AXIS_DESCR COM_AXIS CrCtl_vVehSpd_mp Vel_CrCtl1 12 -32768.00 32767.00 FORMAT "%8.2" AXIS_PTS_REF CrCtl_vAPPLim_AXIS /end AXIS_DESCR
/end CHARACTERISTIC
/begin CHARACTERISTIC CrCtl_rMaxCC3LGEC_GCUR "Added value3 in each 100ms to desired vehicle speed for ECON (ECON sw ON, Continuous TAPUP)" CURVE 0x8051A834 CurG_Ws16 327.6750 APPCrCtl1 -163.8400 163.8350 FORMAT "%8.4"
 /begin AXIS_DESCR COM_AXIS CrCtl_vVehSpd_mp Vel_CrCtl1 12 -32768.00 32767.00 FORMAT "%8.2" AXIS_PTS_REF CrCtl_vAPPLim_AXIS /end AXIS_DESCR
/end CHARACTERISTIC
/begin CHARACTERISTIC CrCtl_rMaxCC3LGMph_GCUR "Max. acc. pedal opening at CC3 lower gear (MPH)" CURVE 0x8051A84C CurG_Ws16 327.6750 APPCrCtl1 -163.8400 163.8350 FORMAT "%8.4"
 /begin AXIS_DESCR COM_AXIS CrCtl_vVehSpd_mp Vel_CrCtl1 12 -32768.00 32767.00 FORMAT "%8.2" AXIS_PTS_REF CrCtl_vAPPLim_AXIS /end AXIS_DESCR
/end CHARACTERISTIC
/begin CHARACTERISTIC CrCtl_rMaxCC4LGEC_GCUR "Added value4 in each 100ms to desired vehicle speed for ECON (ECON sw ON, Continuous TAPUP)" CURVE 0x8051A864 CurG_Ws16 327.6750 APPCrCtl1 -163.8400 163.8350 FORMAT "%8.4"
 /begin AXIS_DESCR COM_AXIS CrCtl_vVehSpd_mp Vel_CrCtl1 12 -32768.00 32767.00 FORMAT "%8.2" AXIS_PTS_REF CrCtl_vAPPLim_AXIS /end AXIS_DESCR
/end CHARACTERISTIC
/begin CHARACTERISTIC CrCtl_rMaxCC4LGMph_GCUR "Max. acc. pedal opening at CC4 lower gear (MPH)" CURVE 0x8051A87C CurG_Ws16 327.6750 APPCrCtl1 -163.8400 163.8350 FORMAT "%8.4"
 /begin AXIS_DESCR COM_AXIS CrCtl_vVehSpd_mp Vel_CrCtl1 12 -32768.00 32767.00 FORMAT "%8.2" AXIS_PTS_REF CrCtl_vAPPLim_AXIS /end AXIS_DESCR
/end CHARACTERISTIC
/begin CHARACTERISTIC CrCtl_rMaxCC5LGEC_GCUR "Added value5 in each 100ms to desired vehicle speed for ECON (ECON sw ON, Continuous TAPUP)" CURVE 0x8051A894 CurG_Ws16 327.6750 APPCrCtl1 -163.8400 163.8350 FORMAT "%8.4"
 /begin AXIS_DESCR COM_AXIS CrCtl_vVehSpd_mp Vel_CrCtl1 12 -32768.00 32767.00 FORMAT "%8.2" AXIS_PTS_REF CrCtl_vAPPLim_AXIS /end AXIS_DESCR
/end CHARACTERISTIC
/begin CHARACTERISTIC CrCtl_rMaxCC5LGMph_GCUR "Max. acc. pedal opening at CC5 lower gear (MPH)" CURVE 0x8051A8AC CurG_Ws16 327.6750 APPCrCtl1 -163.8400 163.8350 FORMAT "%8.4"
 /begin AXIS_DESCR COM_AXIS CrCtl_vVehSpd_mp Vel_CrCtl1 12 -32768.00 32767.00 FORMAT "%8.2" AXIS_PTS_REF CrCtl_vAPPLim_AXIS /end AXIS_DESCR
/end CHARACTERISTIC
/begin CHARACTERISTIC CrCtl_rMaxCC6LGEC_GCUR "Added value6 in each 100ms to desired vehicle speed for ECON (ECON sw ON, Continuous TAPUP)" CURVE 0x8051A8C4 CurG_Ws16 327.6750 APPCrCtl1 -163.8400 163.8350 FORMAT "%8.4"
 /begin AXIS_DESCR COM_AXIS CrCtl_vVehSpd_mp Vel_CrCtl1 12 -32768.00 32767.00 FORMAT "%8.2" AXIS_PTS_REF CrCtl_vAPPLim_AXIS /end AXIS_DESCR
/end CHARACTERISTIC
/begin CHARACTERISTIC CrCtl_rMaxCC6LGMph_GCUR "Max. acc. pedal opening at CC6 lower gear (MPH)" CURVE 0x8051A8DC CurG_Ws16 327.6750 APPCrCtl1 -163.8400 163.8350 FORMAT "%8.4"
 /begin AXIS_DESCR COM_AXIS CrCtl_vVehSpd_mp Vel_CrCtl1 12 -32768.00 32767.00 FORMAT "%8.2" AXIS_PTS_REF CrCtl_vAPPLim_AXIS /end AXIS_DESCR
/end CHARACTERISTIC
/begin CHARACTERISTIC CrCtl_rMaxCCLGEC_GCUR "Added value2 in each 100ms to desired vehicle speed for ECON (ECON sw ON, Continuous TAPUP)" CURVE 0x8051A8F4 CurG_Ws16 327.6750 APPCrCtl1 -163.8400 163.8350 FORMAT "%8.4"
 /begin AXIS_DESCR COM_AXIS CrCtl_vVehSpd_mp Vel_CrCtl1 12 -32768.00 32767.00 FORMAT "%8.2" AXIS_PTS_REF CrCtl_vAPPLim_AXIS /end AXIS_DESCR
/end CHARACTERISTIC
/begin CHARACTERISTIC CrCtl_rMaxCCLGKmph_GCUR "Max. acc. pedal opening at CC2 lower gear (KMPH)" CURVE 0x8051A90C CurG_Ws16 327.6750 APPCrCtl1 -163.8400 163.8350 FORMAT "%8.4"
 /begin AXIS_DESCR COM_AXIS CrCtl_vVehSpd_mp Vel_CrCtl1 12 -32768.00 32767.00 FORMAT "%8.2" AXIS_PTS_REF CrCtl_vAPPLim_AXIS /end AXIS_DESCR
/end CHARACTERISTIC
/begin CHARACTERISTIC CrCtl_rMaxCCLGMph_GCUR "Max. acc. pedal opening at CC2 lower gear (MPH)" CURVE 0x8051A924 CurG_Ws16 327.6750 APPCrCtl1 -163.8400 163.8350 FORMAT "%8.4"
 /begin AXIS_DESCR COM_AXIS CrCtl_vVehSpd_mp Vel_CrCtl1 12 -32768.00 32767.00 FORMAT "%8.2" AXIS_PTS_REF CrCtl_vAPPLim_AXIS /end AXIS_DESCR
/end CHARACTERISTIC
/begin CHARACTERISTIC CrCtl_rMaxCCNGEC_GCUR "Added value1 in each 100ms to desired vehicle speed for ECON (ECON sw ON, Continuous TAPUP)" CURVE 0x8051A93C CurG_Ws16 327.6750 APPCrCtl1 -163.8400 163.8350 FORMAT "%8.4"
 /begin AXIS_DESCR COM_AXIS CrCtl_vVehSpd_mp Vel_CrCtl1 12 -32768.00 32767.00 FORMAT "%8.2" AXIS_PTS_REF CrCtl_vAPPLim_AXIS /end AXIS_DESCR
/end CHARACTERISTIC
/begin CHARACTERISTIC CrCtl_rMaxCCNGKmph_GCUR "Max. acc. pedal opening at CC next gear(KMPH)" CURVE 0x8051A954 CurG_Ws16 327.6750 APPCrCtl1 -163.8400 163.8350 FORMAT "%8.4"
 /begin AXIS_DESCR COM_AXIS CrCtl_vVehSpd_mp Vel_CrCtl1 12 -32768.00 32767.00 FORMAT "%8.2" AXIS_PTS_REF CrCtl_vAPPLim_AXIS /end AXIS_DESCR
/end CHARACTERISTIC
/begin CHARACTERISTIC CrCtl_rMaxCCNGMph_GCUR "Max. acc. pedal opening at CC next gear (MPH)" CURVE 0x8051A96C CurG_Ws16 327.6750 APPCrCtl1 -163.8400 163.8350 FORMAT "%8.4"
 /begin AXIS_DESCR COM_AXIS CrCtl_vVehSpd_mp Vel_CrCtl1 12 -32768.00 32767.00 FORMAT "%8.2" AXIS_PTS_REF CrCtl_vAPPLim_AXIS /end AXIS_DESCR
/end CHARACTERISTIC
/begin CHARACTERISTIC CrCtl_rMaxCCTGEC_GCUR "Added value2 in each 100ms to desired vehicle speed for ECON (ECON sw OFF, Continuous TAPUP)" CURVE 0x8051A984 CurG_Ws16 327.6750 APPCrCtl1 -163.8400 163.8350 FORMAT "%8.4"
 /begin AXIS_DESCR COM_AXIS CrCtl_vVehSpd_mp Vel_CrCtl1 12 -32768.00 32767.00 FORMAT "%8.2" AXIS_PTS_REF CrCtl_vAPPLim_AXIS /end AXIS_DESCR
/end CHARACTERISTIC
/begin CHARACTERISTIC CrCtl_rMaxCCTGKmph_GCUR "Max. acc. pedal opening at CC top gear (KMPH)" CURVE 0x8051A99C CurG_Ws16 327.6750 APPCrCtl1 -163.8400 163.8350 FORMAT "%8.4"
 /begin AXIS_DESCR COM_AXIS CrCtl_vVehSpd_mp Vel_CrCtl1 12 -32768.00 32767.00 FORMAT "%8.2" AXIS_PTS_REF CrCtl_vAPPLim_AXIS /end AXIS_DESCR
/end CHARACTERISTIC
/begin CHARACTERISTIC CrCtl_rMaxCCTGMph_GCUR "Max. acc. pedal opening at CC top gear (MPH)" CURVE 0x8051A9B4 CurG_Ws16 327.6750 APPCrCtl1 -163.8400 163.8350 FORMAT "%8.4"
 /begin AXIS_DESCR COM_AXIS CrCtl_vVehSpd_mp Vel_CrCtl1 12 -32768.00 32767.00 FORMAT "%8.2" AXIS_PTS_REF CrCtl_vAPPLim_AXIS /end AXIS_DESCR
/end CHARACTERISTIC
/begin CHARACTERISTIC CrCtl_rMaxVal_C "maximum threshold for APP value" VALUE 0x8051A9CC Val_Ws16 163.8350 APPCrCtl1 0.00 163.8350 FORMAT "%8.4" EXTENDED_LIMITS -163.8400 163.8350 /end CHARACTERISTIC
/begin CHARACTERISTIC CrCtl_rReqChng_GCUR "Curve for Gear Change APP request value" CURVE 0x8051A9CE CurG_Ws16 163.8350 APPCrCtl1 0.00 163.8350 FORMAT "%8.4" EXTENDED_LIMITS -163.8400 163.8350
 /begin AXIS_DESCR COM_AXIS CrCtl_nDesVal_mp EngNCrCtl 6 0.00 32767.00 FORMAT "%8.2" EXTENDED_LIMITS -32768.00 32767.00 AXIS_PTS_REF CrCtl_nAPPReqChng_AXIS /end AXIS_DESCR
/end CHARACTERISTIC
/begin CHARACTERISTIC CrCtl_rResOffNTGKmh_GMAP "MAP for output resume off (Not Top Gear, EU Km/h)" MAP 0x8051A9DA MapG_Ws16 327.6750 APPCrCtl1 -163.8400 163.8350 FORMAT "%8.4"
 /begin AXIS_DESCR COM_AXIS CrCtl_vVehUpByte Vel_CrCtl1 6 0.00 255.0000 FORMAT "%8.4" EXTENDED_LIMITS -32768.00 32767.00 AXIS_PTS_REF CrCtl_rAccOffX_AXIS /end AXIS_DESCR
 /begin AXIS_DESCR COM_AXIS CrCtl_rEstSlpFltVal Prc_CrCtl4 9 -128.0000 127.9961 FORMAT "%8.4" AXIS_PTS_REF CrCtl_rAccOffY_AXIS /end AXIS_DESCR
/end CHARACTERISTIC
/begin CHARACTERISTIC CrCtl_rResOffNTG_GMAP "MAP for output resume off (Not Top Gear)" MAP 0x8051AA46 MapG_Ws16 327.6750 APPCrCtl1 -163.8400 163.8350 FORMAT "%8.4"
 /begin AXIS_DESCR COM_AXIS CrCtl_vVehUpByte Vel_CrCtl1 6 0.00 255.0000 FORMAT "%8.4" EXTENDED_LIMITS -32768.00 32767.00 AXIS_PTS_REF CrCtl_rAccOffX_AXIS /end AXIS_DESCR
 /begin AXIS_DESCR COM_AXIS CrCtl_rEstSlpFltVal Prc_CrCtl4 9 -128.0000 127.9961 FORMAT "%8.4" AXIS_PTS_REF CrCtl_rAccOffY_AXIS /end AXIS_DESCR
/end CHARACTERISTIC
/begin CHARACTERISTIC CrCtl_rResOffTGKmh_GMAP "MAP for output resume off (Top Gear, EU Km/h)" MAP 0x8051AAB2 MapG_Ws16 327.6750 APPCrCtl1 -163.8400 163.8350 FORMAT "%8.4"
 /begin AXIS_DESCR COM_AXIS CrCtl_vVehUpByte Vel_CrCtl1 6 0.00 255.0000 FORMAT "%8.4" EXTENDED_LIMITS -32768.00 32767.00 AXIS_PTS_REF CrCtl_rAccOffX_AXIS /end AXIS_DESCR
 /begin AXIS_DESCR COM_AXIS CrCtl_rEstSlpFltVal Prc_CrCtl4 9 -128.0000 127.9961 FORMAT "%8.4" AXIS_PTS_REF CrCtl_rAccOffY_AXIS /end AXIS_DESCR
/end CHARACTERISTIC
/begin CHARACTERISTIC CrCtl_rResOffTG_GMAP "MAP for output resume off (Top Gear)" MAP 0x8051AB1E MapG_Ws16 327.6750 APPCrCtl1 -163.8400 163.8350 FORMAT "%8.4"
 /begin AXIS_DESCR COM_AXIS CrCtl_vVehUpByte Vel_CrCtl1 6 0.00 255.0000 FORMAT "%8.4" EXTENDED_LIMITS -32768.00 32767.00 AXIS_PTS_REF CrCtl_rAccOffX_AXIS /end AXIS_DESCR
 /begin AXIS_DESCR COM_AXIS CrCtl_rEstSlpFltVal Prc_CrCtl4 9 -128.0000 127.9961 FORMAT "%8.4" AXIS_PTS_REF CrCtl_rAccOffY_AXIS /end AXIS_DESCR
/end CHARACTERISTIC
/begin CHARACTERISTIC CrCtl_rSecDwnCncl_GCUR "Curve for second APP Down for Cruise Control cancel" CURVE 0x8051AB8A CurG_Ws16 163.8350 APPCrCtl1 0.00 163.8350 FORMAT "%8.4" EXTENDED_LIMITS -163.8400 163.8350
 /begin AXIS_DESCR COM_AXIS CrCtl_rDes APPCrCtl1 6 0.00 163.8350 FORMAT "%8.4" EXTENDED_LIMITS -163.8400 163.8350 AXIS_PTS_REF CrCtl_rDwn_AXIS /end AXIS_DESCR
/end CHARACTERISTIC
/begin CHARACTERISTIC CrCtl_rSptAccOffNTG_GMAP "MAP for output Accel off(Not Top Gear) for sport mode" MAP 0x8051AB96 MapG_Ws16 327.6750 APPCrCtl1 -163.8400 163.8350 FORMAT "%8.4"
 /begin AXIS_DESCR COM_AXIS CrCtl_vVehUpByte Vel_CrCtl1 6 0.00 255.0000 FORMAT "%8.4" EXTENDED_LIMITS -32768.00 32767.00 AXIS_PTS_REF CrCtl_rAccOffX_AXIS /end AXIS_DESCR
 /begin AXIS_DESCR COM_AXIS CrCtl_rEstSlpFltVal Prc_CrCtl4 9 -128.0000 127.9961 FORMAT "%8.4" AXIS_PTS_REF CrCtl_rAccOffY_AXIS /end AXIS_DESCR
/end CHARACTERISTIC
/begin CHARACTERISTIC CrCtl_rSptAccOffTG_GMAP "MAP for output Accel off(Top Gear) for sport mode" MAP 0x8051AC02 MapG_Ws16 327.6750 APPCrCtl1 -163.8400 163.8350 FORMAT "%8.4"
 /begin AXIS_DESCR COM_AXIS CrCtl_vVehUpByte Vel_CrCtl1 6 0.00 255.0000 FORMAT "%8.4" EXTENDED_LIMITS -32768.00 32767.00 AXIS_PTS_REF CrCtl_rAccOffX_AXIS /end AXIS_DESCR
 /begin AXIS_DESCR COM_AXIS CrCtl_rEstSlpFltVal Prc_CrCtl4 9 -128.0000 127.9961 FORMAT "%8.4" AXIS_PTS_REF CrCtl_rAccOffY_AXIS /end AXIS_DESCR
/end CHARACTERISTIC
/begin CHARACTERISTIC CrCtl_rSptAPPACCFUMph_GCUR "Upper limit of acc. pedal opening at ACC follow-up control( MPH) for sport mode" CURVE 0x8051AC6E CurG_Ws16 327.6750 APPCrCtl1 -163.8400 163.8350 FORMAT "%8.4"
 /begin AXIS_DESCR COM_AXIS CrCtl_vVehSpd_mp Vel_CrCtl1 12 -32768.00 32767.00 FORMAT "%8.2" AXIS_PTS_REF CrCtl_vAPPLim_AXIS /end AXIS_DESCR
/end CHARACTERISTIC
/begin CHARACTERISTIC CrCtl_rSptLSFStrtAPP1_GCUR "Curve for LSF start demand value for request level 1 for Sport mode" CURVE 0x8051AC86 CurG_Ws16 327.6750 APPCrCtl1 -163.8400 163.8350 FORMAT "%8.4"
 /begin AXIS_DESCR COM_AXIS CrCtl_vVehUpByte Vel_CrCtl1 12 -32768.00 32767.00 FORMAT "%8.2" AXIS_PTS_REF CrCtl_vLSFStrtAPP_AXIS /end AXIS_DESCR
/end CHARACTERISTIC
/begin CHARACTERISTIC CrCtl_rSptMaxAppCCEC_GCUR "Selected easily condition to change desired vehicle speed for ECON for sport mode" CURVE 0x8051AC9E CurG_Ws16 327.6750 APPCrCtl1 -163.8400 163.8350 FORMAT "%8.4"
 /begin AXIS_DESCR COM_AXIS CrCtl_vVehSpd_mp Vel_CrCtl1 12 -32768.00 32767.00 FORMAT "%8.2" AXIS_PTS_REF CrCtl_vAPPLim_AXIS /end AXIS_DESCR
/end CHARACTERISTIC
/begin CHARACTERISTIC CrCtl_rSptMaxAPPCCMph_GCUR "Max. acc pedal opening at CC(MPH) for sport mode" CURVE 0x8051ACB6 CurG_Ws16 327.6750 APPCrCtl1 -163.8400 163.8350 FORMAT "%8.4"
 /begin AXIS_DESCR COM_AXIS CrCtl_vVehSpd_mp Vel_CrCtl1 12 -32768.00 32767.00 FORMAT "%8.2" AXIS_PTS_REF CrCtl_vAPPLim_AXIS /end AXIS_DESCR
/end CHARACTERISTIC
/begin CHARACTERISTIC CrCtl_rSptMaxCC3LGMph_GCUR "Max. acc. pedal opening at CC3 lower gear (MPH) for sport mode" CURVE 0x8051ACCE CurG_Ws16 327.6750 APPCrCtl1 -163.8400 163.8350 FORMAT "%8.4"
 /begin AXIS_DESCR COM_AXIS CrCtl_vVehSpd_mp Vel_CrCtl1 12 -32768.00 32767.00 FORMAT "%8.2" AXIS_PTS_REF CrCtl_vAPPLim_AXIS /end AXIS_DESCR
/end CHARACTERISTIC
/begin CHARACTERISTIC CrCtl_rSptMaxCC4LGMph_GCUR "Max. acc. pedal opening at CC4 lower gear (MPH) for sport mode" CURVE 0x8051ACE6 CurG_Ws16 327.6750 APPCrCtl1 -163.8400 163.8350 FORMAT "%8.4"
 /begin AXIS_DESCR COM_AXIS CrCtl_vVehSpd_mp Vel_CrCtl1 12 -32768.00 32767.00 FORMAT "%8.2" AXIS_PTS_REF CrCtl_vAPPLim_AXIS /end AXIS_DESCR
/end CHARACTERISTIC
/begin CHARACTERISTIC CrCtl_rSptMaxCC5LGMph_GCUR "Max. acc. pedal opening at CC5 lower gear (MPH) for sport mode" CURVE 0x8051ACFE CurG_Ws16 327.6750 APPCrCtl1 -163.8400 163.8350 FORMAT "%8.4"
 /begin AXIS_DESCR COM_AXIS CrCtl_vVehSpd_mp Vel_CrCtl1 12 -32768.00 32767.00 FORMAT "%8.2" AXIS_PTS_REF CrCtl_vAPPLim_AXIS /end AXIS_DESCR
/end CHARACTERISTIC
/begin CHARACTERISTIC CrCtl_rSptMaxCC6LGMph_GCUR "Max. acc. pedal opening at CC6 lower gear (MPH) for sport mode" CURVE 0x8051AD16 CurG_Ws16 327.6750 APPCrCtl1 -163.8400 163.8350 FORMAT "%8.4"
 /begin AXIS_DESCR COM_AXIS CrCtl_vVehSpd_mp Vel_CrCtl1 12 -32768.00 32767.00 FORMAT "%8.2" AXIS_PTS_REF CrCtl_vAPPLim_AXIS /end AXIS_DESCR
/end CHARACTERISTIC
/begin CHARACTERISTIC CrCtl_rSptMaxCCLGMph_GCUR "Max. acc. pedal opening at CC2 lower gear (MPH) for sport mode" CURVE 0x8051AD2E CurG_Ws16 327.6750 APPCrCtl1 -163.8400 163.8350 FORMAT "%8.4"
 /begin AXIS_DESCR COM_AXIS CrCtl_vVehSpd_mp Vel_CrCtl1 12 -32768.00 32767.00 FORMAT "%8.2" AXIS_PTS_REF CrCtl_vAPPLim_AXIS /end AXIS_DESCR
/end CHARACTERISTIC
/begin CHARACTERISTIC CrCtl_rSptMaxCCNGMph_GCUR "Max. acc. pedal opening at CC next gear (MPH) for sport mode" CURVE 0x8051AD46 CurG_Ws16 327.6750 APPCrCtl1 -163.8400 163.8350 FORMAT "%8.4"
 /begin AXIS_DESCR COM_AXIS CrCtl_vVehSpd_mp Vel_CrCtl1 12 -32768.00 32767.00 FORMAT "%8.2" AXIS_PTS_REF CrCtl_vAPPLim_AXIS /end AXIS_DESCR
/end CHARACTERISTIC
/begin CHARACTERISTIC CrCtl_rSptMaxCCTGMph_GCUR "Max. acc. pedal opening at CC top gear (MPH) for sport mode" CURVE 0x8051AD5E CurG_Ws16 327.6750 APPCrCtl1 -163.8400 163.8350 FORMAT "%8.4"
 /begin AXIS_DESCR COM_AXIS CrCtl_vVehSpd_mp Vel_CrCtl1 12 -32768.00 32767.00 FORMAT "%8.2" AXIS_PTS_REF CrCtl_vAPPLim_AXIS /end AXIS_DESCR
/end CHARACTERISTIC
/begin CHARACTERISTIC CrCtl_rSptReqChng_GCUR "Curve for Gear Change APP request value for sport mode" CURVE 0x8051AD76 CurG_Ws16 327.6750 APPCrCtl1 -163.8400 163.8350 FORMAT "%8.4"
 /begin AXIS_DESCR COM_AXIS CrCtl_nDesVal_mp EngNCrCtl 6 0.00 32767.00 FORMAT "%8.2" EXTENDED_LIMITS -32768.00 32767.00 AXIS_PTS_REF CrCtl_nAPPReqChng_AXIS /end AXIS_DESCR
/end CHARACTERISTIC
/begin CHARACTERISTIC CrCtl_rSptResOffNTG_GMAP "MAP for output resume off (Not Top Gear) for sport mode" MAP 0x8051AD82 MapG_Ws16 327.6750 APPCrCtl1 -163.8400 163.8350 FORMAT "%8.4"
 /begin AXIS_DESCR COM_AXIS CrCtl_vVehUpByte Vel_CrCtl1 6 0.00 255.0000 FORMAT "%8.4" EXTENDED_LIMITS -32768.00 32767.00 AXIS_PTS_REF CrCtl_rAccOffX_AXIS /end AXIS_DESCR
 /begin AXIS_DESCR COM_AXIS CrCtl_rEstSlpFltVal Prc_CrCtl4 9 -128.0000 127.9961 FORMAT "%8.4" AXIS_PTS_REF CrCtl_rAccOffY_AXIS /end AXIS_DESCR
/end CHARACTERISTIC
/begin CHARACTERISTIC CrCtl_rSptResOffTG_GMAP "MAP for output resume off (Top Gear) for sport mode" MAP 0x8051ADEE MapG_Ws16 327.6750 APPCrCtl1 -163.8400 163.8350 FORMAT "%8.4"
 /begin AXIS_DESCR COM_AXIS CrCtl_vVehUpByte Vel_CrCtl1 6 0.00 255.0000 FORMAT "%8.4" EXTENDED_LIMITS -32768.00 32767.00 AXIS_PTS_REF CrCtl_rAccOffX_AXIS /end AXIS_DESCR
 /begin AXIS_DESCR COM_AXIS CrCtl_rEstSlpFltVal Prc_CrCtl4 9 -128.0000 127.9961 FORMAT "%8.4" AXIS_PTS_REF CrCtl_rAccOffY_AXIS /end AXIS_DESCR
/end CHARACTERISTIC
/begin CHARACTERISTIC CrCtl_rSptTDInitNTG_GCUR "Curve for Tap Down initial value(Not Top Gear) for CC for sport mode" CURVE 0x8051AE5A CurG_Ws16 327.6750 APPCrCtl1 -163.8400 163.8350 FORMAT "%8.4"
 /begin AXIS_DESCR COM_AXIS CrCtl_vVehUpByte Vel_CrCtl1 6 0.00 255.0000 FORMAT "%8.4" EXTENDED_LIMITS -32768.00 32767.00 AXIS_PTS_REF CrCtl_vTapDnInit_AXIS /end AXIS_DESCR
/end CHARACTERISTIC
/begin CHARACTERISTIC CrCtl_rSptTDInitTG_GCUR "Curve for Tap Down initial value(Top Gear) for CC for sport mode" CURVE 0x8051AE66 CurG_Ws16 327.6750 APPCrCtl1 -163.8400 163.8350 FORMAT "%8.4"
 /begin AXIS_DESCR COM_AXIS CrCtl_vVehUpByte Vel_CrCtl1 6 0.00 255.0000 FORMAT "%8.4" EXTENDED_LIMITS -32768.00 32767.00 AXIS_PTS_REF CrCtl_vTapDnInit_AXIS /end AXIS_DESCR
/end CHARACTERISTIC
/begin CHARACTERISTIC CrCtl_rSptTUInitNTG_GCUR "Curve for Tap Up initial value(Not Top Gear) for CC for sport mode" CURVE 0x8051AE72 CurG_Ws16 327.6750 APPCrCtl1 -163.8400 163.8350 FORMAT "%8.4"
 /begin AXIS_DESCR COM_AXIS CrCtl_vVehUpByte Vel_CrCtl1 6 0.00 255.0000 FORMAT "%8.4" EXTENDED_LIMITS -32768.00 32767.00 AXIS_PTS_REF CrCtl_vTapUpInit_AXIS /end AXIS_DESCR
/end CHARACTERISTIC
/begin CHARACTERISTIC CrCtl_rSptTUInitTG_GCUR "Curve for Tap Up initial value(Top Gear) for CC for sport mode" CURVE 0x8051AE7E CurG_Ws16 327.6750 APPCrCtl1 -163.8400 163.8350 FORMAT "%8.4"
 /begin AXIS_DESCR COM_AXIS CrCtl_vVehUpByte Vel_CrCtl1 6 0.00 255.0000 FORMAT "%8.4" EXTENDED_LIMITS -32768.00 32767.00 AXIS_PTS_REF CrCtl_vTapUpInit_AXIS /end AXIS_DESCR
/end CHARACTERISTIC
/begin CHARACTERISTIC CrCtl_rTDInitNTG_GCUR "Curve for Tap Down initial value(Not Top Gear) for CC" CURVE 0x8051AE8A CurG_Ws16 163.8350 APPCrCtl1 0.00 163.8350 FORMAT "%8.4" EXTENDED_LIMITS -163.8400 163.8350
 /begin AXIS_DESCR COM_AXIS CrCtl_vVehUpByte Vel_CrCtl1 6 0.00 255.0000 FORMAT "%8.4" EXTENDED_LIMITS -32768.00 32767.00 AXIS_PTS_REF CrCtl_vTapDnInit_AXIS /end AXIS_DESCR
/end CHARACTERISTIC
/begin CHARACTERISTIC CrCtl_rTDInitTG_GCUR "Curve for Tap Down initial value(Top Gear) for CC" CURVE 0x8051AE96 CurG_Ws16 163.8350 APPCrCtl1 0.00 163.8350 FORMAT "%8.4" EXTENDED_LIMITS -163.8400 163.8350
 /begin AXIS_DESCR COM_AXIS CrCtl_vVehUpByte Vel_CrCtl1 6 0.00 255.0000 FORMAT "%8.4" EXTENDED_LIMITS -32768.00 32767.00 AXIS_PTS_REF CrCtl_vTapDnInit_AXIS /end AXIS_DESCR
/end CHARACTERISTIC
/begin CHARACTERISTIC CrCtl_rTrgSub_CUR "Curve for subtraction value of target APP value" CURVE 0x8051AEA2 RB_Cur_Xs16Ws16 163.8350 APPCrCtl1 0.00 163.8350 FORMAT "%8.4" EXTENDED_LIMITS -163.8400 163.8350
 /begin AXIS_DESCR STD_AXIS CrCtl_vVehUpByte Vel_CrCtl1 6 0.00 255.0000 FORMAT "%8.4" EXTENDED_LIMITS -32768.00 32767.00 DEPOSIT ABSOLUTE /end AXIS_DESCR
/end CHARACTERISTIC
/begin CHARACTERISTIC CrCtl_rTrqDflVal_C "default value of Torque Ratio value" VALUE 0x8051AEBC Val_Ws8 127.0 Prc_CrCtl 0.00 127.0 FORMAT "%5.1" EXTENDED_LIMITS -128.0 127.0 /end CHARACTERISTIC
/begin CHARACTERISTIC CrCtl_rTUInitDRlo_GCUR "Tap up initialisation value incase of down request" CURVE 0x8051AEBE CurG_Ws16 163.8350 APPCrCtl1 0.00 163.8350 FORMAT "%8.4" EXTENDED_LIMITS -163.8400 163.8350
 /begin AXIS_DESCR COM_AXIS CrCtl_vVehUpByte Vel_CrCtl1 6 0.00 255.0000 FORMAT "%8.4" EXTENDED_LIMITS -32768.00 32767.00 AXIS_PTS_REF CrCtl_vTapUpInit_AXIS /end AXIS_DESCR
/end CHARACTERISTIC
/begin CHARACTERISTIC CrCtl_rTUInitNTG_GCUR "Curve for Tap Up initial value(Not Top Gear) for CC" CURVE 0x8051AECA CurG_Ws16 163.8350 APPCrCtl1 0.00 163.8350 FORMAT "%8.4" EXTENDED_LIMITS -163.8400 163.8350
 /begin AXIS_DESCR COM_AXIS CrCtl_vVehUpByte Vel_CrCtl1 6 0.00 255.0000 FORMAT "%8.4" EXTENDED_LIMITS -32768.00 32767.00 AXIS_PTS_REF CrCtl_vTapUpInit_AXIS /end AXIS_DESCR
/end CHARACTERISTIC
/begin CHARACTERISTIC CrCtl_rTUInitTG_GCUR "Curve for Tap Up initial value(Top Gear) for CC" CURVE 0x8051AED6 CurG_Ws16 163.8350 APPCrCtl1 0.00 163.8350 FORMAT "%8.4" EXTENDED_LIMITS -163.8400 163.8350
 /begin AXIS_DESCR COM_AXIS CrCtl_vVehUpByte Vel_CrCtl1 6 0.00 255.0000 FORMAT "%8.4" EXTENDED_LIMITS -32768.00 32767.00 AXIS_PTS_REF CrCtl_vTapUpInit_AXIS /end AXIS_DESCR
/end CHARACTERISTIC
/begin CHARACTERISTIC CrCtl_stACCClthOutSel_C "selected value by Clutch out case carry out control for ACC" VALUE 0x8051AEE2 Val_Wu8 1.000 OneToOne 0.00 1.000 FORMAT "%5.3" EXTENDED_LIMITS 0.00 255.0 /end CHARACTERISTIC
/begin CHARACTERISTIC CrCtl_stACCECActv_C "Selected control to change desired vehicle speed for ECON in stages" VALUE 0x8051AEE3 Val_Wu8 1.000 OneToOne 0.00 1.000 FORMAT "%5.3" EXTENDED_LIMITS 0.00 255.0 /end CHARACTERISTIC
/begin CHARACTERISTIC CrCtl_stACCUpLimCnclGDwnNr_C "Down No of ACC ceiling release instruction judgment gear" VALUE 0x8051AEE4 Val_Wu8 127.0 OneToOne 0.00 127.0 FORMAT "%5.1" EXTENDED_LIMITS 0.00 255.0 /end CHARACTERISTIC
/begin CHARACTERISTIC CrCtl_stCCECActv_C "ACC RP (hysteresis Lo) value for ECON" VALUE 0x8051AEE5 Val_Wu8 1.000 OneToOne 0.00 1.000 FORMAT "%5.3" EXTENDED_LIMITS 0.00 255.0 /end CHARACTERISTIC
/begin CHARACTERISTIC CrCtl_stCCMaxAPPGDwnNr_C "Down No of gear of judgment of opening of greatest acceleration" VALUE 0x8051AEE6 Val_Wu8 127.0 OneToOne 0.00 127.0 FORMAT "%5.1" EXTENDED_LIMITS 0.00 255.0 /end CHARACTERISTIC
/begin CHARACTERISTIC CrCtl_stCCUpLimCnclGDwnNr_C "Down No of CC ceiling release instruction judgment gear" VALUE 0x8051AEE7 Val_Wu8 127.0 OneToOne 0.00 127.0 FORMAT "%5.1" EXTENDED_LIMITS 0.00 255.0 /end CHARACTERISTIC
/begin CHARACTERISTIC CrCtl_stDisAPPInc_C "Flag for disabling the increase in reqtd. acc. pedal opening after deciding CC_DR" VALUE 0x8051AEE8 Val_Wu8 255.0 OneToOne 0.00 255.0 FORMAT "%5.1" /end CHARACTERISTIC
/begin CHARACTERISTIC CrCtl_stDR1AccnTmrDisbl_C "DR1 acceleration judgement timer disabling flag for CC up slope" VALUE 0x8051AEE9 Val_Wu8 255.0 OneToOne 0.00 255.0 FORMAT "%5.1" /end CHARACTERISTIC
/begin CHARACTERISTIC CrCtl_stDR2AccnTmrDisbl_C "DR2 acceleration judgement timer disabling flag for CC upslope" VALUE 0x8051AEEA Val_Wu8 255.0 OneToOne 0.00 255.0 FORMAT "%5.1" /end CHARACTERISTIC
/begin CHARACTERISTIC CrCtl_stDR3AccnTmrDisbl_C "DR3 cancellation judgement timer disabling flag for CC up slope" VALUE 0x8051AEEB Val_Wu8 255.0 OneToOne 0.00 255.0 FORMAT "%5.1" /end CHARACTERISTIC
/begin CHARACTERISTIC CrCtl_stDR4AccnTmrDisbl_C "DR4 acceleration judgement timer disabling flag for CC up slope" VALUE 0x8051AEEC Val_Wu8 255.0 OneToOne 0.00 255.0 FORMAT "%5.1" /end CHARACTERISTIC
/begin CHARACTERISTIC CrCtl_stDR5AccnTmrDisbl_C "DR5 acceleration judgement timer disabling flag for CC up slope" VALUE 0x8051AEED Val_Wu8 255.0 OneToOne 0.00 255.0 FORMAT "%5.1" /end CHARACTERISTIC
/begin CHARACTERISTIC CrCtl_stDR6AccnTmrDisbl_C "DR6 acceleration judgement timer disabling flag for CC up slope" VALUE 0x8051AEEE Val_Wu8 255.0 OneToOne 0.00 255.0 FORMAT "%5.1" /end CHARACTERISTIC
/begin CHARACTERISTIC CrCtl_stDR7AccnTmrDisbl_C "DR7 acceleration judgement timer disabling flag for CC up slope" VALUE 0x8051AEEF Val_Wu8 255.0 OneToOne 0.00 255.0 FORMAT "%5.1" /end CHARACTERISTIC
/begin CHARACTERISTIC CrCtl_stECAppLimSel_C "Curve for target acceleration standerd value for ECON (during accel)" VALUE 0x8051AEF0 Val_Wu8 1.000 OneToOne 0.00 1.000 FORMAT "%5.3" EXTENDED_LIMITS 0.00 255.0 /end CHARACTERISTIC
/begin CHARACTERISTIC CrCtl_stECAppUpprLim_C "Added value1 in each 100ms to desired vehicle speed for ECON (ECON sw ON)" VALUE 0x8051AEF1 Val_Wu8 1.000 OneToOne 0.00 1.000 FORMAT "%5.3" EXTENDED_LIMITS 0.00 255.0 /end CHARACTERISTIC
/begin CHARACTERISTIC CrCtl_stECDesSelCdn_C "Selected control to change desired vehicle speed for ECON in stages" VALUE 0x8051AEF2 Val_Wu8 1.000 OneToOne 0.00 1.000 FORMAT "%5.3" EXTENDED_LIMITS 0.00 255.0 /end CHARACTERISTIC
/begin CHARACTERISTIC CrCtl_stECDesSelProc_C "RP (hysteresis Lo) value for ECON" VALUE 0x8051AEF3 Val_Wu8 1.000 OneToOne 0.00 1.000 FORMAT "%5.3" EXTENDED_LIMITS 0.00 255.0 /end CHARACTERISTIC
/begin CHARACTERISTIC CrCtl_stECDR1DwnSlpDi_C "Output select flag for DR1 judgement at CC down slp for ECON" VALUE 0x8051AEF4 Val_Wu8 1.000 OneToOne 0.00 1.000 FORMAT "%5.3" EXTENDED_LIMITS 0.00 255.0 /end CHARACTERISTIC
/begin CHARACTERISTIC CrCtl_stECDR2DwnSlpDi_C "Output select flag for DR2 judgement at CC down slp for ECON" VALUE 0x8051AEF5 Val_Wu8 1.000 OneToOne 0.00 1.000 FORMAT "%5.3" EXTENDED_LIMITS 0.00 255.0 /end CHARACTERISTIC
/begin CHARACTERISTIC CrCtl_stECDR3DwnSlpDi_C "Output select flag for DR3 judgement at CC down slp for ECON" VALUE 0x8051AEF6 Val_Wu8 1.000 OneToOne 0.00 1.000 FORMAT "%5.3" EXTENDED_LIMITS 0.00 255.0 /end CHARACTERISTIC
/begin CHARACTERISTIC CrCtl_stGearMapNo_CA "Array for Gear Map Number for Cruise Control" VAL_BLK 0x8051AEF7 ValA_Wu8 255.0 OneToOne 0.00 255.0 FORMAT "%5.1" NUMBER 4 /end CHARACTERISTIC
/begin CHARACTERISTIC CrCtl_stNeLimSel_C "Engine speed limit control select value" VALUE 0x8051AEFB Val_Wu8 1.000 OneToOne 0.00 1.000 FORMAT "%5.3" EXTENDED_LIMITS 0.00 255.0 /end CHARACTERISTIC
/begin CHARACTERISTIC CrCtl_stResOffEna_C "Enable resume off control" VALUE 0x8051AEFC Val_Wu8 1.000 OneToOne 0.00 1.000 FORMAT "%5.3" EXTENDED_LIMITS 0.00 255.0 /end CHARACTERISTIC
/begin CHARACTERISTIC CrCtl_stSwtPDCtrlEna_C "Switch to enable PD control" VALUE 0x8051AEFD Val_Wu8 1.000 OneToOne 0.00 1.000 FORMAT "%5.3" EXTENDED_LIMITS 0.00 255.0 /end CHARACTERISTIC
/begin CHARACTERISTIC CrCtl_stUpACC1LG_C "Flag for indicating the upper limit canc. in ACC1 lower gear" VALUE 0x8051AEFE Val_Wu8 255.0 OneToOne 0.00 255.0 FORMAT "%5.1" /end CHARACTERISTIC
/begin CHARACTERISTIC CrCtl_stUpACC2LG_C "Flag for indicating the upper limit canc. in ACC2 lower gear" VALUE 0x8051AEFF Val_Wu8 255.0 OneToOne 0.00 255.0 FORMAT "%5.1" /end CHARACTERISTIC
/begin CHARACTERISTIC CrCtl_stUpACCTG_C "Flag for indicating the upper limit canc. in ACC top gear" VALUE 0x8051AF00 Val_Wu8 255.0 OneToOne 0.00 255.0 FORMAT "%5.1" /end CHARACTERISTIC
/begin CHARACTERISTIC CrCtl_stUpCC1LG_C "Flag for indicating the upper limit canc. in CC1 lower gear" VALUE 0x8051AF01 Val_Wu8 255.0 OneToOne 0.00 255.0 FORMAT "%5.1" /end CHARACTERISTIC
/begin CHARACTERISTIC CrCtl_stUpCC2LG_C "Flag for indicating the upper limit canc. in CC2 lower gear" VALUE 0x8051AF02 Val_Wu8 255.0 OneToOne 0.00 255.0 FORMAT "%5.1" /end CHARACTERISTIC
/begin CHARACTERISTIC CrCtl_stUpCCTG_C "Flag for indicating the upper limit canc. in CC top gear" VALUE 0x8051AF03 Val_Wu8 255.0 OneToOne 0.00 255.0 FORMAT "%5.1" /end CHARACTERISTIC
/begin CHARACTERISTIC CrCtl_stUpperGear_C "Status of Upper Gear" VALUE 0x8051AF04 Val_Wu8 255.0 OneToOne 0.00 255.0 FORMAT "%5.1" /end CHARACTERISTIC
/begin CHARACTERISTIC CrCtl_stVehSpdSel_C "Status value for vehicle speed selection" VALUE 0x8051AF05 Val_Wu8 1.000 OneToOne 0.00 1.000 FORMAT "%5.3" EXTENDED_LIMITS 0.00 255.0 /end CHARACTERISTIC
/begin CHARACTERISTIC CrCtl_swtACCTrgAccnSel_C "Switch to select target acceleration value for ACC" VALUE 0x8051AF06 Val_Wu8 1.000 OneToOne 0.00 1.000 FORMAT "%5.3" EXTENDED_LIMITS 0.00 255.0 /end CHARACTERISTIC
/begin CHARACTERISTIC CrCtl_SwtDRnrEna_C "Switch to enable cruise control Down Request number for AT" VALUE 0x8051AF07 Val_Wu8 1.000 OneToOne 0.00 1.000 FORMAT "%5.3" EXTENDED_LIMITS 0.00 255.0 /end CHARACTERISTIC
/begin CHARACTERISTIC CrCtl_tiACCChngRes_C "Resume to ACC Change Gear for setpoint speed change check time" VALUE 0x8051AF08 Val_Ws16 327670.0 Time_ms 0.00 327670.0 FORMAT "%8.1" EXTENDED_LIMITS -327680.0 327670.0 /end CHARACTERISTIC
/begin CHARACTERISTIC CrCtl_tiAccnDR1UpSlp_C "Judgement time for DR1 acceleration at CC upslope DR1 acceleration judgement time for CC up slope" VALUE 0x8051AF0A Val_Ws16 6553500. Time_ms_100ms -3276800. 3276700. FORMAT "%8.0" /end CHARACTERISTIC
/begin CHARACTERISTIC CrCtl_tiAccnDR2UpSlp_C "Judgement time for DR2 acceleration at CC upslope/DR2 acceleration judgement time for CC up slope" VALUE 0x8051AF0C Val_Ws16 6553500. Time_ms_100ms -3276800. 3276700. FORMAT "%8.0" /end CHARACTERISTIC
/begin CHARACTERISTIC CrCtl_tiAccnDR3UpSlp_C "Judgement time for DR3 acceleration at CC upslope/DR2 acceleration judgement time for CC up slope" VALUE 0x8051AF0E Val_Ws16 6553500. Time_ms_100ms -3276800. 3276700. FORMAT "%8.0" /end CHARACTERISTIC
/begin CHARACTERISTIC CrCtl_tiAccnDR4UpSlp_C "Judgement time for DR4 acceleration at CC up slope\ DR4 acceleration judgement time for CC up slope" VALUE 0x8051AF10 Val_Ws16 6553500. Time_ms_100ms -3276800. 3276700. FORMAT "%8.0" /end CHARACTERISTIC
/begin CHARACTERISTIC CrCtl_tiAccnDR5UpSlp_C "Judgement time for DR5 acceleration at CC up slope\ DR5 acceleration judgement time for CC up slope" VALUE 0x8051AF12 Val_Ws16 6553500. Time_ms_100ms -3276800. 3276700. FORMAT "%8.0" /end CHARACTERISTIC
/begin CHARACTERISTIC CrCtl_tiAccnDR6UpSlp_C "Judgement time for DR6 acceleration at CC up slope\ DR6 acceleration judgement time for CC up slope" VALUE 0x8051AF14 Val_Ws16 6553500. Time_ms_100ms -3276800. 3276700. FORMAT "%8.0" /end CHARACTERISTIC
/begin CHARACTERISTIC CrCtl_tiAccnDR7UpSlp_C "Judgement time for DR7 acceleration at CC up slope\ DR7 acceleration judgement time for CC up slope" VALUE 0x8051AF16 Val_Ws16 6553500. Time_ms_100ms -3276800. 3276700. FORMAT "%8.0" /end CHARACTERISTIC
/begin CHARACTERISTIC CrCtl_tiCC1LGMaxRat_C "CC1 lower gear max. opening stick time" VALUE 0x8051AF18 Val_Ws16 6553500. Time_ms_100ms -3276800. 3276700. FORMAT "%8.0" /end CHARACTERISTIC
/begin CHARACTERISTIC CrCtl_tiCC2LGMaxRat_C "CC2 lower gear max. opening stick time" VALUE 0x8051AF1A Val_Ws16 6553500. Time_ms_100ms -3276800. 3276700. FORMAT "%8.0" /end CHARACTERISTIC
/begin CHARACTERISTIC CrCtl_tiCC3LGMaxRat_C "CC3 lower gear max. opening stick time" VALUE 0x8051AF1C Val_Ws16 6553500. Time_ms_100ms -3276800. 3276700. FORMAT "%8.0" /end CHARACTERISTIC
/begin CHARACTERISTIC CrCtl_tiCC4LGMaxRat_C "CC4 lower gear max. opening stick time" VALUE 0x8051AF1E Val_Ws16 6553500. Time_ms_100ms -3276800. 3276700. FORMAT "%8.0" /end CHARACTERISTIC
/begin CHARACTERISTIC CrCtl_tiCC5LGMaxRat_C "CC5 lower gear max. opening stick time" VALUE 0x8051AF20 Val_Ws16 6553500. Time_ms_100ms -3276800. 3276700. FORMAT "%8.0" /end CHARACTERISTIC
/begin CHARACTERISTIC CrCtl_tiCC6LGMaxRat_C "CC6 lower gear max. opening stick time" VALUE 0x8051AF22 Val_Ws16 6553500. Time_ms_100ms -3276800. 3276700. FORMAT "%8.0" /end CHARACTERISTIC
/begin CHARACTERISTIC CrCtl_tiCCMaxRat_C "CC max. opening stick time" VALUE 0x8051AF24 Val_Ws16 6553500. Time_ms_100ms -3276800. 3276700. FORMAT "%8.0" /end CHARACTERISTIC
/begin CHARACTERISTIC CrCtl_tiCCTGMaxRat_C "CC top gear max. opening stick time" VALUE 0x8051AF26 Val_Ws16 6553500. Time_ms_100ms -3276800. 3276700. FORMAT "%8.0" /end CHARACTERISTIC
/begin CHARACTERISTIC CrCtl_tiClthOnContChng_C "time to Clutch On NE F/B control change check" VALUE 0x8051AF28 Val_Ws16 327670.0 Time_ms 0.00 327670.0 FORMAT "%8.1" EXTENDED_LIMITS -327680.0 327670.0 /end CHARACTERISTIC
/begin CHARACTERISTIC CrCtl_tiContnsErrChk_C "Time of Cruise control error continuous check value" VALUE 0x8051AF2A Val_Ws16 327670.0 Time_ms 0.00 327670.0 FORMAT "%8.1" EXTENDED_LIMITS -327680.0 327670.0 /end CHARACTERISTIC
/begin CHARACTERISTIC CrCtl_tiDR1CnclHold_C "Time for retaining DR1 cancellation at CC up slope(also DR1 cancel hold time for CC up-slope" VALUE 0x8051AF2C Val_Ws16 3276700. Time_ms_100ms 0.00 3276700. FORMAT "%8.0" EXTENDED_LIMITS -3276800. 3276700. /end CHARACTERISTIC
/begin CHARACTERISTIC CrCtl_tiDR1CnclMskDwnSlp_C "DR1 cancellation judgement time at CC down slope" VALUE 0x8051AF2E Val_Ws16 6553500. Time_ms_100ms -3276800. 3276700. FORMAT "%8.0" /end CHARACTERISTIC
/begin CHARACTERISTIC CrCtl_tiDR1CnclUpSlp_C "DR1 cancel judgement time for CC up slope" VALUE 0x8051AF30 Val_Ws16 6553500. Time_ms_100ms -3276800. 3276700. FORMAT "%8.0" /end CHARACTERISTIC
/begin CHARACTERISTIC CrCtl_tiDR2CnclHold_C "Time for retaining DR2 cancellation at CC up slope(also DR cancel hold time for CC up-slope )" VALUE 0x8051AF32 Val_Ws16 3276700. Time_ms_100ms 0.00 3276700. FORMAT "%8.0" EXTENDED_LIMITS -3276800. 3276700. /end CHARACTERISTIC
/begin CHARACTERISTIC CrCtl_tiDR2CnclMskDwnSlp_C "DR2 cancellation judgement time at CC down slope" VALUE 0x8051AF34 Val_Ws16 6553500. Time_ms_100ms -3276800. 3276700. FORMAT "%8.0" /end CHARACTERISTIC
/begin CHARACTERISTIC CrCtl_tiDR2CnclUpSlp_C "DR2 cancel judgement time for CC up slope" VALUE 0x8051AF36 Val_Ws16 6553500. Time_ms_100ms -3276800. 3276700. FORMAT "%8.0" /end CHARACTERISTIC
/begin CHARACTERISTIC CrCtl_tiDR3CnclHold_C "Time for retaining DR3 cancellation at CC up slope(also DR3 cancel hold time for CC up-slope )" VALUE 0x8051AF38 Val_Ws16 3276700. Time_ms_100ms 0.00 3276700. FORMAT "%8.0" EXTENDED_LIMITS -3276800. 3276700. /end CHARACTERISTIC
/begin CHARACTERISTIC CrCtl_tiDR3CnclMskDwnSlp_C "DR3 cancellation judgement time at CC down slope" VALUE 0x8051AF3A Val_Ws16 6553500. Time_ms_100ms -3276800. 3276700. FORMAT "%8.0" /end CHARACTERISTIC
/begin CHARACTERISTIC CrCtl_tiDR3CnclUpSlp_C "DR3 cancel judgement time for CC up slope" VALUE 0x8051AF3C Val_Ws16 6553500. Time_ms_100ms -3276800. 3276700. FORMAT "%8.0" /end CHARACTERISTIC
/begin CHARACTERISTIC CrCtl_tiDR4CnclHold_C "Time for retaining DR4 cancellation at CC up slope(also DR4 cancel hold time for CC up-slope )" VALUE 0x8051AF3E Val_Ws16 3276700. Time_ms_100ms 0.00 3276700. FORMAT "%8.0" EXTENDED_LIMITS -3276800. 3276700. /end CHARACTERISTIC
/begin CHARACTERISTIC CrCtl_tiDR4CnclMskDwnSlp_C "DR4 cancellation judgement time at CC down slope" VALUE 0x8051AF40 Val_Ws16 6553500. Time_ms_100ms -3276800. 3276700. FORMAT "%8.0" /end CHARACTERISTIC
/begin CHARACTERISTIC CrCtl_tiDR4CnclUpSlp_C "DR4 cancel judgement time for CC up slope" VALUE 0x8051AF42 Val_Ws16 6553500. Time_ms_100ms -3276800. 3276700. FORMAT "%8.0" /end CHARACTERISTIC
/begin CHARACTERISTIC CrCtl_tiDR5CnclHold_C "Time for retaining DR5 cancellation at CC up slope(also DR5 cancel hold time for CC up-slope )" VALUE 0x8051AF44 Val_Ws16 3276700. Time_ms_100ms 0.00 3276700. FORMAT "%8.0" EXTENDED_LIMITS -3276800. 3276700. /end CHARACTERISTIC
/begin CHARACTERISTIC CrCtl_tiDR5CnclMskDwnSlp_C "DR5 cancellation judgement time at CC down slope" VALUE 0x8051AF46 Val_Ws16 6553500. Time_ms_100ms -3276800. 3276700. FORMAT "%8.0" /end CHARACTERISTIC
/begin CHARACTERISTIC CrCtl_tiDR5CnclUpSlp_C "DR5 cancel judgement time for CC up slope" VALUE 0x8051AF48 Val_Ws16 6553500. Time_ms_100ms -3276800. 3276700. FORMAT "%8.0" /end CHARACTERISTIC
/begin CHARACTERISTIC CrCtl_tiDR6CnclHold_C "Time for retaining DR6 cancellation at CC up slope(also DR6 cancel hold time for CC up-slope )" VALUE 0x8051AF4A Val_Ws16 3276700. Time_ms_100ms 0.00 3276700. FORMAT "%8.0" EXTENDED_LIMITS -3276800. 3276700. /end CHARACTERISTIC
/begin CHARACTERISTIC CrCtl_tiDR6CnclMskDwnSlp_C "DR6 cancellation judgement time at CC down slope" VALUE 0x8051AF4C Val_Ws16 6553500. Time_ms_100ms -3276800. 3276700. FORMAT "%8.0" /end CHARACTERISTIC
/begin CHARACTERISTIC CrCtl_tiDR6CnclUpSlp_C "DR6 cancel judgement time for CC up slope" VALUE 0x8051AF4E Val_Ws16 6553500. Time_ms_100ms -3276800. 3276700. FORMAT "%8.0" /end CHARACTERISTIC
/begin CHARACTERISTIC CrCtl_tiDR7CnclHold_C "Time for retaining DR7 cancellation at CC up slope(also DR7 cancel hold time for CC up-slope )" VALUE 0x8051AF50 Val_Ws16 3276700. Time_ms_100ms 0.00 3276700. FORMAT "%8.0" EXTENDED_LIMITS -3276800. 3276700. /end CHARACTERISTIC
/begin CHARACTERISTIC CrCtl_tiDR7CnclMskDwnSlp_C "DR7 cancellation judgement time at CC down slope" VALUE 0x8051AF52 Val_Ws16 6553500. Time_ms_100ms -3276800. 3276700. FORMAT "%8.0" /end CHARACTERISTIC
/begin CHARACTERISTIC CrCtl_tiDR7CnclUpSlp_C "DR7 cancel judgement time for CC up slope" VALUE 0x8051AF54 Val_Ws16 6553500. Time_ms_100ms -3276800. 3276700. FORMAT "%8.0" /end CHARACTERISTIC
/begin CHARACTERISTIC CrCtl_tiDRCnclPROSMADisbl_C "Down-slope prosma disable request flag at CC_DR cancellation" VALUE 0x8051AF56 Val_Ws16 6553500. Time_ms_100ms -3276800. 3276700. FORMAT "%8.0" /end CHARACTERISTIC
/begin CHARACTERISTIC CrCtl_tiDRMskB_C "CC_DR mask time B" VALUE 0x8051AF58 Val_Ws16 6553500. Time_ms_100ms -3276800. 3276700. FORMAT "%8.0" /end CHARACTERISTIC
/begin CHARACTERISTIC CrCtl_tiDRMskC_C "CC_DR mask time C" VALUE 0x8051AF5A Val_Ws16 6553500. Time_ms_100ms -3276800. 3276700. FORMAT "%8.0" /end CHARACTERISTIC
/begin CHARACTERISTIC CrCtl_tiDRMskD_C "CC_DR mask time D" VALUE 0x8051AF5C Val_Ws16 6553500. Time_ms_100ms -3276800. 3276700. FORMAT "%8.0" /end CHARACTERISTIC
/begin CHARACTERISTIC CrCtl_tiDRMskE_C "CC_DR mask time E" VALUE 0x8051AF5E Val_Ws16 6553500. Time_ms_100ms -3276800. 3276700. FORMAT "%8.0" /end CHARACTERISTIC
/begin CHARACTERISTIC CrCtl_tiDRMskF_C "CC_DR mask time F" VALUE 0x8051AF60 Val_Ws16 6553500. Time_ms_100ms -3276800. 3276700. FORMAT "%8.0" /end CHARACTERISTIC
/begin CHARACTERISTIC CrCtl_tiDwnReqDisbl_C "DR disable timer at start of CC Control" VALUE 0x8051AF62 Val_Ws16 3276700. Time_ms_100ms 0.00 3276700. FORMAT "%8.0" EXTENDED_LIMITS -3276800. 3276700. /end CHARACTERISTIC
/begin CHARACTERISTIC CrCtl_tiECAppContns1_C "Deviation in accel data for DR1 judgement at CC up slope for ECON" VALUE 0x8051AF64 Val_Ws16 3276700. Time_ms_100ms 0.00 3276700. FORMAT "%8.0" EXTENDED_LIMITS -3276800. 3276700. /end CHARACTERISTIC
/begin CHARACTERISTIC CrCtl_tiECAppContns2_C "Accel differential coeffecient data for DR1 judgement at CC_RESUME for ECON" VALUE 0x8051AF66 Val_Ws16 3276700. Time_ms_100ms 0.00 3276700. FORMAT "%8.0" EXTENDED_LIMITS -3276800. 3276700. /end CHARACTERISTIC
/begin CHARACTERISTIC CrCtl_tiECAppContns3_C "Accel differential coeffecient data for DR1 judgement at ACC_RESUME" VALUE 0x8051AF68 Val_Ws16 3276700. Time_ms_100ms 0.00 3276700. FORMAT "%8.0" EXTENDED_LIMITS -3276800. 3276700. /end CHARACTERISTIC
/begin CHARACTERISTIC CrCtl_tiECAppContns4_C "Accel differential coeffecient data for DR1 judgement at ACC_RESUME for ECON" VALUE 0x8051AF6A Val_Ws16 3276700. Time_ms_100ms 0.00 3276700. FORMAT "%8.0" EXTENDED_LIMITS -3276800. 3276700. /end CHARACTERISTIC
/begin CHARACTERISTIC CrCtl_tiECMaskAUp2_C "Mask timer for changing APP limitation number for ECON to 3 from 2 (for Acceleration)" VALUE 0x8051AF6C Val_Ws16 3276700. Time_ms_100ms 0.00 3276700. FORMAT "%8.0" EXTENDED_LIMITS -3276800. 3276700. /end CHARACTERISTIC
/begin CHARACTERISTIC CrCtl_tiECMaskAUp3_C "Mask timer for changing APP limitation number for ECON to 4 from 3 (for Acceleration)" VALUE 0x8051AF6E Val_Ws16 3276700. Time_ms_100ms 0.00 3276700. FORMAT "%8.0" EXTENDED_LIMITS -3276800. 3276700. /end CHARACTERISTIC
/begin CHARACTERISTIC CrCtl_tiECMaskAUp4_C "Mask timer for changing APP limitation number for ECON to 5 from 4 (for Acceleration)" VALUE 0x8051AF70 Val_Ws16 3276700. Time_ms_100ms 0.00 3276700. FORMAT "%8.0" EXTENDED_LIMITS -3276800. 3276700. /end CHARACTERISTIC
/begin CHARACTERISTIC CrCtl_tiECMaskAUp5_C "Mask timer for changing APP limitation number for ECON to 1 from 2" VALUE 0x8051AF72 Val_Ws16 3276700. Time_ms_100ms 0.00 3276700. FORMAT "%8.0" EXTENDED_LIMITS -3276800. 3276700. /end CHARACTERISTIC
/begin CHARACTERISTIC CrCtl_tiECMaskDwn1_C "Mask timer for changing APP limitation number for ECON to 2 from 3" VALUE 0x8051AF74 Val_Ws16 3276700. Time_ms_100ms 0.00 3276700. FORMAT "%8.0" EXTENDED_LIMITS -3276800. 3276700. /end CHARACTERISTIC
/begin CHARACTERISTIC CrCtl_tiECMaskDwn2_C "Mask timer for changing APP limitation number for ECON to 3 from 4" VALUE 0x8051AF76 Val_Ws16 3276700. Time_ms_100ms 0.00 3276700. FORMAT "%8.0" EXTENDED_LIMITS -3276800. 3276700. /end CHARACTERISTIC
/begin CHARACTERISTIC CrCtl_tiECMaskDwn3_C "Mask timer for changing APP limitation number for ECON to 4 from 5" VALUE 0x8051AF78 Val_Ws16 3276700. Time_ms_100ms 0.00 3276700. FORMAT "%8.0" EXTENDED_LIMITS -3276800. 3276700. /end CHARACTERISTIC
/begin CHARACTERISTIC CrCtl_tiECMaskDwn4_C "Deviation speed for selecting variation of desired vehicle speed for ECON (Continuous TAPUP, Enable hysteresis, ECON sw OFF)" VALUE 0x8051AF7A Val_Ws16 3276700. Time_ms_100ms 0.00 3276700. FORMAT "%8.0" EXTENDED_LIMITS -3276800. 3276700. /end CHARACTERISTIC
/begin CHARACTERISTIC CrCtl_tiECMaskNumUp_C "Mask timer for changing APP limitation number for ECON to 2 from 1 (for Acceleration)" VALUE 0x8051AF7C Val_Ws16 3276700. Time_ms_100ms 0.00 3276700. FORMAT "%8.0" EXTENDED_LIMITS -3276800. 3276700. /end CHARACTERISTIC
/begin CHARACTERISTIC CrCtl_tiExtCont_C "time to extend Cruise Control check" VALUE 0x8051AF7E Val_Ws16 327670.0 Time_ms 0.00 327670.0 FORMAT "%8.1" EXTENDED_LIMITS -327680.0 327670.0 /end CHARACTERISTIC
/begin CHARACTERISTIC CrCtl_tiGuidDispTime_C "Time of guide display check value" VALUE 0x8051AF80 Val_Ws16 327670.0 Time_ms 0.00 327670.0 FORMAT "%8.1" EXTENDED_LIMITS -327680.0 327670.0 /end CHARACTERISTIC
/begin CHARACTERISTIC CrCtl_tiMskDR2DwnSlp_C "Mask time for DR2 judgement at CC down slope" VALUE 0x8051AF82 Val_Ws16 6553500. Time_ms_100ms -3276800. 3276700. FORMAT "%8.0" /end CHARACTERISTIC
/begin CHARACTERISTIC CrCtl_tiMskDR2UpSlp_C "Mask time for DR2 judgement at CC upslope" VALUE 0x8051AF84 Val_Ws16 6553500. Time_ms_100ms -3276800. 3276700. FORMAT "%8.0" /end CHARACTERISTIC
/begin CHARACTERISTIC CrCtl_tiMskDR3DwnSlp_C "Mask time for DR3 judgement at CC down slope" VALUE 0x8051AF86 Val_Ws16 6553500. Time_ms_100ms -3276800. 3276700. FORMAT "%8.0" /end CHARACTERISTIC
/begin CHARACTERISTIC CrCtl_tiMskDR3UpSlp_C "Mask time for DR3 judgement at CC upslope" VALUE 0x8051AF88 Val_Ws16 6553500. Time_ms_100ms -3276800. 3276700. FORMAT "%8.0" /end CHARACTERISTIC
/begin CHARACTERISTIC CrCtl_tiMskDR4DwnSlp_C "Mask time for DR4 judgement at CC down slope" VALUE 0x8051AF8A Val_Ws16 6553500. Time_ms_100ms -3276800. 3276700. FORMAT "%8.0" /end CHARACTERISTIC
/begin CHARACTERISTIC CrCtl_tiMskDR4UpSlp_C "Mask time for DR4 judgement at CC upslope" VALUE 0x8051AF8C Val_Ws16 6553500. Time_ms_100ms -3276800. 3276700. FORMAT "%8.0" /end CHARACTERISTIC
/begin CHARACTERISTIC CrCtl_tiMskDR5DwnSlp_C "Mask time for DR5 judgement at CC down slope" VALUE 0x8051AF8E Val_Ws16 6553500. Time_ms_100ms -3276800. 3276700. FORMAT "%8.0" /end CHARACTERISTIC
/begin CHARACTERISTIC CrCtl_tiMskDR5UpSlp_C "Mask time for DR5 judgement at CC upslope" VALUE 0x8051AF90 Val_Ws16 6553500. Time_ms_100ms -3276800. 3276700. FORMAT "%8.0" /end CHARACTERISTIC
/begin CHARACTERISTIC CrCtl_tiMskDR6DwnSlp_C "Mask time for DR6 judgement at CC down slope" VALUE 0x8051AF92 Val_Ws16 6553500. Time_ms_100ms -3276800. 3276700. FORMAT "%8.0" /end CHARACTERISTIC
/begin CHARACTERISTIC CrCtl_tiMskDR6UpSlp_C "Mask time for DR6 judgement at CC upslope" VALUE 0x8051AF94 Val_Ws16 6553500. Time_ms_100ms -3276800. 3276700. FORMAT "%8.0" /end CHARACTERISTIC
/begin CHARACTERISTIC CrCtl_tiMskDR7DwnSlp_C "Mask time for DR7 judgement at CC down slope" VALUE 0x8051AF96 Val_Ws16 6553500. Time_ms_100ms -3276800. 3276700. FORMAT "%8.0" /end CHARACTERISTIC
/begin CHARACTERISTIC CrCtl_tiMskDR7UpSlp_C "Mask time for DR7 judgement at CC upslope" VALUE 0x8051AF98 Val_Ws16 6553500. Time_ms_100ms -3276800. 3276700. FORMAT "%8.0" /end CHARACTERISTIC
/begin CHARACTERISTIC CrCtl_tiSpdCnclMskDR2DR1_C "DR2/DR1 speed cancel time for CC down slope" VALUE 0x8051AF9A Val_Ws16 6553500. Time_ms_100ms -3276800. 3276700. FORMAT "%8.0" /end CHARACTERISTIC
/begin CHARACTERISTIC CrCtl_tiSpdCnclMskDR3DR2_C "DR3/DR2 speed cancel mask time for CC down slope" VALUE 0x8051AF9C Val_Ws16 6553500. Time_ms_100ms -3276800. 3276700. FORMAT "%8.0" /end CHARACTERISTIC
/begin CHARACTERISTIC CrCtl_tiSpdCnclMskDR4DR3_C "DR4\DR3 speed cancel time for CC down slope" VALUE 0x8051AF9E Val_Ws16 6553500. Time_ms_100ms -3276800. 3276700. FORMAT "%8.0" /end CHARACTERISTIC
/begin CHARACTERISTIC CrCtl_tiSpdCnclMskDR5DR4_C "DR5\DR4 speed cancel time for CC down slope" VALUE 0x8051AFA0 Val_Ws16 6553500. Time_ms_100ms -3276800. 3276700. FORMAT "%8.0" /end CHARACTERISTIC
/begin CHARACTERISTIC CrCtl_tiSpdCnclMskDR6DR5_C "DR6\DR5 speed cancel time for CC down slope" VALUE 0x8051AFA2 Val_Ws16 6553500. Time_ms_100ms -3276800. 3276700. FORMAT "%8.0" /end CHARACTERISTIC
/begin CHARACTERISTIC CrCtl_tiSpdCnclMskDR7DR6_C "DR7\DR6 speed cancel time for CC down slope" VALUE 0x8051AFA4 Val_Ws16 6553500. Time_ms_100ms -3276800. 3276700. FORMAT "%8.0" /end CHARACTERISTIC
/begin CHARACTERISTIC CrCtl_tiTrqIncReqDisbl_C "Time for disabling the increase in torque during acc.ped opening requested after CC_DR judgement." VALUE 0x8051AFA6 Val_Ws16 6553500. Time_ms_100ms -3276800. 3276700. FORMAT "%8.0" /end CHARACTERISTIC
/begin CHARACTERISTIC CrCtl_tiWaitReqDR0DR1_C "Time to wait DR1 request after DR0 request" VALUE 0x8051AFA8 Val_Ws16 655350.0 Time_ms -327680.0 327670.0 FORMAT "%8.1" /end CHARACTERISTIC
/begin CHARACTERISTIC CrCtl_tiWaitReqDR1DR0_C "Time to wait DR0 request after DR1 request" VALUE 0x8051AFAA Val_Ws16 655350.0 Time_ms -327680.0 327670.0 FORMAT "%8.1" /end CHARACTERISTIC
/begin CHARACTERISTIC CrCtl_tiWaitReqDR1DR2_C "Time to wait DR2 request after DR1 request" VALUE 0x8051AFAC Val_Ws16 655350.0 Time_ms -327680.0 327670.0 FORMAT "%8.1" /end CHARACTERISTIC
/begin CHARACTERISTIC CrCtl_tiWaitReqDR2DR1_C "Time to wait DR1 request after DR2 request" VALUE 0x8051AFAE Val_Ws16 655350.0 Time_ms -327680.0 327670.0 FORMAT "%8.1" /end CHARACTERISTIC
/begin CHARACTERISTIC CrCtl_tiWaitReqDR2DR3_C "Time to wait DR3 request after DR2 request" VALUE 0x8051AFB0 Val_Ws16 655350.0 Time_ms -327680.0 327670.0 FORMAT "%8.1" /end CHARACTERISTIC
/begin CHARACTERISTIC CrCtl_tiWaitReqDR3DR2_C "Time to wait DR2 request after DR3 request" VALUE 0x8051AFB2 Val_Ws16 655350.0 Time_ms -327680.0 327670.0 FORMAT "%8.1" /end CHARACTERISTIC
/begin CHARACTERISTIC CrCtl_tiWaitReqDR3DR4_C "Time to wait DR2 request after DR3 request" VALUE 0x8051AFB4 Val_Ws16 655350.0 Time_ms -327680.0 327670.0 FORMAT "%8.1" /end CHARACTERISTIC
/begin CHARACTERISTIC CrCtl_tiWaitReqDR4DR3_C "Time to wait DR3 request after DR4 request" VALUE 0x8051AFB6 Val_Ws16 655350.0 Time_ms -327680.0 327670.0 FORMAT "%8.1" /end CHARACTERISTIC
/begin CHARACTERISTIC CrCtl_tiWaitReqDR4DR5_C "Time to wait DR5 request after DR4 request" VALUE 0x8051AFB8 Val_Ws16 655350.0 Time_ms -327680.0 327670.0 FORMAT "%8.1" /end CHARACTERISTIC
/begin CHARACTERISTIC CrCtl_tiWaitReqDR5DR4_C "Time to wait DR4 request after DR5 request" VALUE 0x8051AFBA Val_Ws16 655350.0 Time_ms -327680.0 327670.0 FORMAT "%8.1" /end CHARACTERISTIC
/begin CHARACTERISTIC CrCtl_tiWaitReqDR5DR6_C "Time to wait DR6 request after DR5 request" VALUE 0x8051AFBC Val_Ws16 655350.0 Time_ms -327680.0 327670.0 FORMAT "%8.1" /end CHARACTERISTIC
/begin CHARACTERISTIC CrCtl_tiWaitReqDR6DR5_C "Time to wait DR5 request after DR6 request" VALUE 0x8051AFBE Val_Ws16 655350.0 Time_ms -327680.0 327670.0 FORMAT "%8.1" /end CHARACTERISTIC
/begin CHARACTERISTIC CrCtl_tiWaitReqDR6DR7_C "Time to wait DR7 request after DR6 request" VALUE 0x8051AFC0 Val_Ws16 655350.0 Time_ms -327680.0 327670.0 FORMAT "%8.1" /end CHARACTERISTIC
/begin CHARACTERISTIC CrCtl_vACCECDvtDR1UpSlp_C "During ACC follow-up control,deviation in accel data for DR1 judgement for ECON" VALUE 0x8051AFC2 Val_Ws16 127.9961 Vel_CrCtl 0.00 127.9961 FORMAT "%8.4" EXTENDED_LIMITS -128.0000 127.9961 /end CHARACTERISTIC
/begin CHARACTERISTIC CrCtl_vACCECDvtDR2UpSlp_C "During ACC follow-up control,deviation in accel data for DR2 judgement for ECON" VALUE 0x8051AFC4 Val_Ws16 127.9961 Vel_CrCtl 0.00 127.9961 FORMAT "%8.4" EXTENDED_LIMITS -128.0000 127.9961 /end CHARACTERISTIC
/begin CHARACTERISTIC CrCtl_vACCECDvtDR3UpSlp_C "During ACC follow-up control,deviation in accel data for DR3 judgement for ECON" VALUE 0x8051AFC6 Val_Ws16 127.9961 Vel_CrCtl 0.00 127.9961 FORMAT "%8.4" EXTENDED_LIMITS -128.0000 127.9961 /end CHARACTERISTIC
/begin CHARACTERISTIC CrCtl_vACCECDvtDR4UpSlp_C "During ACC follow-up control,deviation in accel data for DR4 judgement for ECON" VALUE 0x8051AFC8 Val_Ws16 127.9961 Vel_CrCtl 0.00 127.9961 FORMAT "%8.4" EXTENDED_LIMITS -128.0000 127.9961 /end CHARACTERISTIC
/begin CHARACTERISTIC CrCtl_vACCECDvtDR5UpSlp_C "During ACC follow-up control,deviation in accel data for DR5 judgement for ECON" VALUE 0x8051AFCA Val_Ws16 127.9961 Vel_CrCtl 0.00 127.9961 FORMAT "%8.4" EXTENDED_LIMITS -128.0000 127.9961 /end CHARACTERISTIC
/begin CHARACTERISTIC CrCtl_vACCECDvtDR6UpSlp_C "During ACC follow-up control,deviation in accel data for DR6 judgement for ECON" VALUE 0x8051AFCC Val_Ws16 127.9961 Vel_CrCtl 0.00 127.9961 FORMAT "%8.4" EXTENDED_LIMITS -128.0000 127.9961 /end CHARACTERISTIC
/begin CHARACTERISTIC CrCtl_vACCECDvtDR7UpSlp_C "During ACC follow-up control,deviation in accel data for DR7 judgement for ECON" VALUE 0x8051AFCE Val_Ws16 127.9961 Vel_CrCtl 0.00 127.9961 FORMAT "%8.4" EXTENDED_LIMITS -128.0000 127.9961 /end CHARACTERISTIC
/begin CHARACTERISTIC CrCtl_vACCECOffDvtDwn1_C "Output select flag for DR3 judgement at CC down slp for ECON" VALUE 0x8051AFD0 Val_Ws16 127.9961 Vel_CrCtl 0.00 127.9961 FORMAT "%8.4" EXTENDED_LIMITS -128.0000 127.9961 /end CHARACTERISTIC
/begin CHARACTERISTIC CrCtl_vACCECOffDvtDwn2_C "Deviation speed for changing APP limitation number for ECON to 3 from 4 (for ECON sw OFF and during ACC)" VALUE 0x8051AFD2 Val_Ws16 127.9961 Vel_CrCtl 0.00 127.9961 FORMAT "%8.4" EXTENDED_LIMITS -128.0000 127.9961 /end CHARACTERISTIC
/begin CHARACTERISTIC CrCtl_vACCECOffDvtDwn3_C "Deviation speed for changing APP limitation number for ECON to 4 from 5 (for ECON sw OFF and during ACC)" VALUE 0x8051AFD4 Val_Ws16 127.9961 Vel_CrCtl 0.00 127.9961 FORMAT "%8.4" EXTENDED_LIMITS -128.0000 127.9961 /end CHARACTERISTIC
/begin CHARACTERISTIC CrCtl_vACCECOffDvtDwn4_C "Deviation speed for changing APP limitation number for ECON to 1 from 2 (for ECON sw ON and during ACC)" VALUE 0x8051AFD6 Val_Ws16 127.9961 Vel_CrCtl 0.00 127.9961 FORMAT "%8.4" EXTENDED_LIMITS -128.0000 127.9961 /end CHARACTERISTIC
/begin CHARACTERISTIC CrCtl_vACCECOffDvtUp2_C "Accel differential coeffecient for DR2 judgement at ACC_F/B" VALUE 0x8051AFD8 Val_Ws16 127.9961 Vel_CrCtl 0.00 127.9961 FORMAT "%8.4" EXTENDED_LIMITS -128.0000 127.9961 /end CHARACTERISTIC
/begin CHARACTERISTIC CrCtl_vACCECOffDvtUp3_C "Accel differential coeffecient for DR2 judgement at ACC_F/B for ECON" VALUE 0x8051AFDA Val_Ws16 127.9961 Vel_CrCtl 0.00 127.9961 FORMAT "%8.4" EXTENDED_LIMITS -128.0000 127.9961 /end CHARACTERISTIC
/begin CHARACTERISTIC CrCtl_vACCECOffDvtUp4_C "Accel differential coeffecient for DR2 judgement at CC_ACCEL for ECON" VALUE 0x8051AFDC Val_Ws16 127.9961 Vel_CrCtl 0.00 127.9961 FORMAT "%8.4" EXTENDED_LIMITS -128.0000 127.9961 /end CHARACTERISTIC
/begin CHARACTERISTIC CrCtl_vACCECOffDvtUp5_C "During ACC follow-up control,deviation in accel data for DR3 judgement for ECON" VALUE 0x8051AFDE Val_Ws16 127.9961 Vel_CrCtl 0.00 127.9961 FORMAT "%8.4" EXTENDED_LIMITS -128.0000 127.9961 /end CHARACTERISTIC
/begin CHARACTERISTIC CrCtl_vACCECOnDvtDwn1_C "Deviation speed for changing APP limitation number for ECON to 2 from 3 (for ECON sw ON and during ACC)" VALUE 0x8051AFE0 Val_Ws16 127.9961 Vel_CrCtl 0.00 127.9961 FORMAT "%8.4" EXTENDED_LIMITS -128.0000 127.9961 /end CHARACTERISTIC
/begin CHARACTERISTIC CrCtl_vACCECOnDvtDwn2_C "Deviation speed for changing APP limitation number for ECON to 3 from 4 (for ECON sw ON and during ACC)" VALUE 0x8051AFE2 Val_Ws16 127.9961 Vel_CrCtl 0.00 127.9961 FORMAT "%8.4" EXTENDED_LIMITS -128.0000 127.9961 /end CHARACTERISTIC
/begin CHARACTERISTIC CrCtl_vACCECOnDvtDwn3_C "Deviation speed for changing APP limitation number for ECON to 4 from 5 (for ECON sw ON and during ACC)" VALUE 0x8051AFE4 Val_Ws16 127.9961 Vel_CrCtl 0.00 127.9961 FORMAT "%8.4" EXTENDED_LIMITS -128.0000 127.9961 /end CHARACTERISTIC
/begin CHARACTERISTIC CrCtl_vACCECOnDvtDwn4_C "Acceleration factor for changing APP limitation number for ECON to 2 from 1 (for Resume and ECON sw OFF)" VALUE 0x8051AFE6 Val_Ws16 127.9961 Vel_CrCtl 0.00 127.9961 FORMAT "%8.4" EXTENDED_LIMITS -128.0000 127.9961 /end CHARACTERISTIC
/begin CHARACTERISTIC CrCtl_vACCECOnDvtUp2_C "Deviation in accel data for DR3 judgement at CC up slope for ECON" VALUE 0x8051AFE8 Val_Ws16 127.9961 Vel_CrCtl 0.00 127.9961 FORMAT "%8.4" EXTENDED_LIMITS -128.0000 127.9961 /end CHARACTERISTIC
/begin CHARACTERISTIC CrCtl_vACCECOnDvtUp3_C "Accel differential coeffecient data for DR3 judgement at CC_RESUME for ECON" VALUE 0x8051AFEA Val_Ws16 127.9961 Vel_CrCtl 0.00 127.9961 FORMAT "%8.4" EXTENDED_LIMITS -128.0000 127.9961 /end CHARACTERISTIC
/begin CHARACTERISTIC CrCtl_vACCECOnDvtUp4_C "Accel differential coeffecient data for DR3 judgement at ACC_RESUME" VALUE 0x8051AFEC Val_Ws16 127.9961 Vel_CrCtl 0.00 127.9961 FORMAT "%8.4" EXTENDED_LIMITS -128.0000 127.9961 /end CHARACTERISTIC
/begin CHARACTERISTIC CrCtl_vACCECOnDvtUp5_C "Accel differential coeffecient data for DR3 judgement at ACC_RESUME for ECON" VALUE 0x8051AFEE Val_Ws16 127.9961 Vel_CrCtl 0.00 127.9961 FORMAT "%8.4" EXTENDED_LIMITS -128.0000 127.9961 /end CHARACTERISTIC
/begin AXIS_PTS CrCtl_vAccnBas_AX "Axis Points for Acceleration Base of cruise control" 0x8051AFF0 CrCtl_vVehUpByte Axis_Xs16 255.0000 Vel_CrCtl1 12 0.00 255.0000 FORMAT "%8.4" EXTENDED_LIMITS -32768.00 32767.00 DEPOSIT ABSOLUTE /end AXIS_PTS
/begin AXIS_PTS CrCtl_vAccnBas_AXIS "Axis Points for Acceleration Base of cruise control" 0x8051B00A CrCtl_vVehUpByte Axis_Xs16 255.0000 Vel_CrCtl1 6 0.00 255.0000 FORMAT "%8.4" EXTENDED_LIMITS -32768.00 32767.00 DEPOSIT ABSOLUTE /end AXIS_PTS
/begin AXIS_PTS CrCtl_vAccnCont_AX "Axis Points for Acceleration Continuous of cruise control" 0x8051B018 CrCtl_vVehUpByte Axis_Xs16 255.0000 Vel_CrCtl1 12 0.00 255.0000 FORMAT "%8.4" EXTENDED_LIMITS -32768.00 32767.00 DEPOSIT ABSOLUTE /end AXIS_PTS
/begin AXIS_PTS CrCtl_vAccnCont_AXIS "Axis Points for Acceleration Continuous of cruise control" 0x8051B032 CrCtl_vVehUpByte Axis_Xs16 255.0000 Vel_CrCtl1 6 0.00 255.0000 FORMAT "%8.4" EXTENDED_LIMITS -32768.00 32767.00 DEPOSIT ABSOLUTE /end AXIS_PTS
/begin CHARACTERISTIC CrCtl_vAccnDR1DwnSlpCoast_CUR "Acc. Data for DR1 Judgement at CC down slope during coast" CURVE 0x8051B040 RB_Cur_Xs16Ws16 255.9961 Vel_CrCtl -128.0000 127.9961 FORMAT "%8.4"
 /begin AXIS_DESCR STD_AXIS CrCtl_vVehUpByte Vel_CrCtl1 6 0.00 32767.00 FORMAT "%8.2" EXTENDED_LIMITS -32768.00 32767.00 DEPOSIT ABSOLUTE /end AXIS_DESCR
/end CHARACTERISTIC
/begin AXIS_PTS CrCtl_vAPPLim_AXIS "Axis Points for APP Limit speed of cruise control" 0x8051B214 CrCtl_vVehSpd_mp Axis_Xs16 65535.00 Vel_CrCtl1 12 -32768.00 32767.00 FORMAT "%8.2" DEPOSIT ABSOLUTE /end AXIS_PTS
/begin AXIS_PTS CrCtl_vFdbkArea_AX "Axis Points for Feedback Area speed of cruise control" 0x8051BC24 CrCtl_vDesUpByte_mp Axis_Xs16 255.0000 Vel_CrCtl1 12 0.00 255.0000 FORMAT "%8.4" EXTENDED_LIMITS -32768.00 32767.00 DEPOSIT ABSOLUTE /end AXIS_PTS
/begin AXIS_PTS CrCtl_vLSFStrtAPP_AXIS "Axis for LSF start demand value" 0x8051BC80 CrCtl_vVehUpByte Axis_Xs16 65535.00 Vel_CrCtl1 12 -32768.00 32767.00 FORMAT "%8.2" DEPOSIT ABSOLUTE /end AXIS_PTS
/begin AXIS_PTS CrCtl_vTapDnInit_AXIS "Axis Points for Tap Down initial speed of cruise control" 0x8051BD96 CrCtl_vVehUpByte Axis_Xs16 255.0000 Vel_CrCtl1 6 0.00 255.0000 FORMAT "%8.4" EXTENDED_LIMITS -32768.00 32767.00 DEPOSIT ABSOLUTE /end AXIS_PTS
/begin AXIS_PTS CrCtl_vTapUpInit_AXIS "Axis Points for Tap Up initial speed of cruise control" 0x8051BDA4 CrCtl_vVehUpByte Axis_Xs16 255.0000 Vel_CrCtl1 6 0.00 255.0000 FORMAT "%8.4" EXTENDED_LIMITS -32768.00 32767.00 DEPOSIT ABSOLUTE /end AXIS_PTS
/begin FUNCTION CrCtl_TrqCalc "6.2.0     Cruise Control torque calculation"
 /begin DEF_CHARACTERISTIC CrCtl_facACCECOffAResUp3_MAP CrCtl_facACCECOffAResUp4_MAP CrCtl_facACCECOffAResUp5_MAP CrCtl_facACCECOnAAppUp2_CUR CrCtl_facACCECOnAAppUp3_CUR CrCtl_facACCECOnAAppUp4_CUR CrCtl_facACCECOnAAppUp5_CUR CrCtl_facACCECOnAFbUp2_CUR CrCtl_facACCECOnAFbUp3_CUR CrCtl_facACCECOnAFbUp4_CUR CrCtl_facACCECOnAFbUp5_CUR CrCtl_facACCECOnAResUp2_MAP CrCtl_facACCECOnAResUp3_MAP CrCtl_facACCECOnAResUp4_MAP CrCtl_facACCECOnAResUp5_MAP CrCtl_facAccnRed12_GCUR CrCtl_facACtrlECDecelCls_GCUR CrCtl_facACtrlECDecelOpn_GCUR CrCtl_facAPPRedRevi_GCUR CrCtl_facAPPReviX_AXIS CrCtl_facAPPReviY_AXIS CrCtl_facCmftAccnRed12_GCUR CrCtl_facCmftFdbkAccnVal0_C CrCtl_facCmftFdbkAccnVal1_C CrCtl_facCmftFdbkAccnVal2_C CrCtl_facCmftFdbkAccnVal3_C CrCtl_facCmftFdbkAccnVal4_C CrCtl_facCmftFdbkDReviVal0_C CrCtl_facCmftFdbkDReviVal1_C CrCtl_facCmftFdbkDReviVal2_C CrCtl_facCmftFdbkDReviVal3_C CrCtl_facCmftFdbkDReviVal4_C CrCtl_facCmftFdbkPReviVal0_C CrCtl_facCmftFdbkPReviVal1_C CrCtl_facCmftFdbkPReviVal2_C CrCtl_facCmftFdbkPReviVal3_C CrCtl_facCmftFdbkPReviVal4_C CrCtl_facContTapInitRevi_C CrCtl_facDecnRevi12_GCUR CrCtl_facDiffCoeffDR1ACCEL_CUR CrCtl_facDiffCoeffDR1FB_CUR CrCtl_facDiffCoeffDR1Resume_MAP CrCtl_facDiffCoeffDR2ACCEL_CUR CrCtl_facDiffCoeffDR2FB_CUR CrCtl_facDiffCoeffDR2Resume_MAP CrCtl_facDiffCoeffDR3ACCEL_CUR CrCtl_facDiffCoeffDR3FB_CUR CrCtl_facDiffCoeffDR3Resume_MAP CrCtl_facDiffCoeffDR4ACCEL_CUR CrCtl_facDiffCoeffDR4FB_CUR CrCtl_facDiffCoeffDR4Resume_MAP CrCtl_facDiffCoeffDR5ACCEL_CUR CrCtl_facDiffCoeffDR5FB_CUR CrCtl_facDiffCoeffDR5Resume_MAP CrCtl_facDiffCoeffDR6ACCEL_CUR CrCtl_facDiffCoeffDR6FB_CUR CrCtl_facDiffCoeffDR6Resume_MAP CrCtl_facDiffCoeffDR7ACCEL_CUR CrCtl_facDiffCoeffDR7FB_CUR CrCtl_facDiffCoeffDR7Resume_MAP CrCtl_facEC1LGAppDiffCls_GMAP CrCtl_facEC1LGAppDiff_GMAP CrCtl_facEC2LGAppDiffCls_GMAP CrCtl_facEC2LGAppDiff_GMAP CrCtl_facEC3LGAppDiffCls_GMAP CrCtl_facEC3LGAppDiff_GMAP CrCtl_facEC4LGAppDiffCls_GMAP CrCtl_facEC4LGAppDiff_GMAP CrCtl_facECAppInitCor_CUR CrCtl_facECDR1ResA_MAP CrCtl_facECDR2ResA_MAP CrCtl_facECDR3ResA_MAP CrCtl_facECDR4ResA_MAP CrCtl_facECDR5ResA_MAP CrCtl_facECDR6ResA_MAP CrCtl_facECDR7ResA_MAP CrCtl_facEcoFdbkAccnVal0_C CrCtl_facEcoFdbkAccnVal1_C CrCtl_facEcoFdbkAccnVal2_C CrCtl_facEcoFdbkAccnVal3_C CrCtl_facEcoFdbkAccnVal4_C CrCtl_facEcoFdbkDReviVal0_C CrCtl_facEcoFdbkDReviVal1_C CrCtl_facEcoFdbkDReviVal2_C CrCtl_facEcoFdbkDReviVal3_C CrCtl_facEcoFdbkDReviVal4_C CrCtl_facEcoFdbkPReviVal0_C CrCtl_facEcoFdbkPReviVal1_C CrCtl_facEcoFdbkPReviVal2_C CrCtl_facEcoFdbkPReviVal3_C CrCtl_facEcoFdbkPReviVal4_C CrCtl_facECOffAAppUp2_CUR CrCtl_facECOffAAppUp3_CUR CrCtl_facECOffAAppUp4_CUR CrCtl_facECOffAAppUp5_CUR CrCtl_facECOffAFbUp2_CUR CrCtl_facECOffAFbUp3_CUR CrCtl_facECOffAFbUp4_CUR CrCtl_facECOffAFbUp5_CUR CrCtl_facECOffAResUp2_MAP CrCtl_facECOffAResUp3_MAP CrCtl_facECOffAResUp4_MAP CrCtl_facECOffAResUp5_MAP CrCtl_facECOnAAppUp2_CUR CrCtl_facECOnAAppUp3_CUR CrCtl_facECOnAAppUp4_CUR CrCtl_facECOnAAppUp5_CUR CrCtl_facECOnAFbUp2_CUR CrCtl_facECOnAFbUp3_CUR CrCtl_facECOnAFbUp4_CUR CrCtl_facECOnAFbUp5_CUR CrCtl_facECOnAResUp2_MAP CrCtl_facECOnAResUp3_MAP CrCtl_facECOnAResUp4_MAP CrCtl_facECOnAResUp5_MAP CrCtl_facECTGAppDiffCls_GMAP CrCtl_facECTGAppDiff_GMAP CrCtl_facFbACmftD12_GMAP CrCtl_facFbACmftP12_GMAP CrCtl_facFbAD12_GMAP CrCtl_facFbAEcoD12_GMAP CrCtl_facFbAEcoP12_GMAP CrCtl_facFbAP12_GMAP CrCtl_facFbAreaX_AXIS CrCtl_facFbAreaY_AXIS CrCtl_facFbASptD12_GMAP CrCtl_facFbASptP12_GMAP CrCtl_facFbAX_AXIS CrCtl_facFbAY_AXIS CrCtl_facFbCmftD12_GMAP CrCtl_facFbCmftP12_GMAP CrCtl_facFbD12_GMAP CrCtl_facFbEcoD12_GMAP CrCtl_facFbEcoP12_GMAP CrCtl_facFbP12_GMAP CrCtl_facFbPlusRD12_GMAP CrCtl_facFbPlusRP12_GMAP CrCtl_facFbSptD12_GMAP CrCtl_facFbSptP12_GMAP CrCtl_facFdbkAccnP0Kmh_GCUR CrCtl_facFdbkAccnP0_GCUR CrCtl_facFdbkAccnP1Kmh_GCUR CrCtl_facFdbkAccnP1_GCUR CrCtl_facFdbkAccnP2Kmh_GCUR CrCtl_facFdbkAccnP2_GCUR CrCtl_facFdbkAccnP3Kmh_GCUR CrCtl_facFdbkAccnP3_GCUR CrCtl_facFdbkAccnP4Kmh_GCUR CrCtl_facFdbkAccnP4_GCUR CrCtl_facFdbkAccnVal0_C CrCtl_facFdbkAccnVal1_C CrCtl_facFdbkAccnVal2_C CrCtl_facFdbkAccnVal3_C CrCtl_facFdbkAccnVal4_C CrCtl_facFdbkDReviVal0_C CrCtl_facFdbkDReviVal1_C CrCtl_facFdbkDReviVal2_C CrCtl_facFdbkDReviVal3_C CrCtl_facFdbkDReviVal4_C CrCtl_facFdbkPReviVal0_C CrCtl_facFdbkPReviVal1_C CrCtl_facFdbkPReviVal2_C CrCtl_facFdbkPReviVal3_C CrCtl_facFdbkPReviVal4_C CrCtl_facFolFdbkGn12_GCUR CrCtl_facNeLimDCont_GCUR CrCtl_facNeLimPCont_GCUR CrCtl_facSpt1LGAppDiffCls_GMAP CrCtl_facSpt1LGAppDiff_GMAP CrCtl_facSpt2LGAppDiffCls_GMAP CrCtl_facSpt2LGAppDiff_GMAP CrCtl_facSpt3LGAppDiffCls_GMAP CrCtl_facSpt3LGAppDiff_GMAP CrCtl_facSpt4LGAppDiffCls_GMAP CrCtl_facSpt4LGAppDiff_GMAP CrCtl_facSptAccnRed12_GCUR CrCtl_facSptFdbkAccnP0_GCUR CrCtl_facSptFdbkAccnP1_GCUR CrCtl_facSptFdbkAccnP2_GCUR CrCtl_facSptFdbkAccnP3_GCUR CrCtl_facSptFdbkAccnP4_GCUR CrCtl_facSptFdbkAccnVal0_C CrCtl_facSptFdbkAccnVal1_C CrCtl_facSptFdbkAccnVal2_C CrCtl_facSptFdbkAccnVal3_C CrCtl_facSptFdbkAccnVal4_C CrCtl_facSptFdbkDReviVal0_C CrCtl_facSptFdbkDReviVal1_C CrCtl_facSptFdbkDReviVal2_C CrCtl_facSptFdbkDReviVal3_C CrCtl_facSptFdbkDReviVal4_C CrCtl_facSptFdbkPReviVal0_C CrCtl_facSptFdbkPReviVal1_C CrCtl_facSptFdbkPReviVal2_C CrCtl_facSptFdbkPReviVal3_C CrCtl_facSptFdbkPReviVal4_C CrCtl_facSptTGAppDiffCls_GMAP CrCtl_facSptTGAppDiff_GMAP CrCtl_facTGAppDiffCls_GMAP CrCtl_facTGAppDiff_GMAP CrCtl_facTrgAccnRateEcon_T CrCtl_facTrgAccnRateNrml_T CrCtl_facVehSpdFlt_C CrCtl_nAPPReqChng_AXIS CrCtl_nFlt_AXIS CrCtl_nTrqOffChkAdd_C CrCtl_nTrqOffReqChk_CUR CrCtl_numACCECAppLowrLim_C CrCtl_numATType_C CrCtl_numCCECAppLowrLim_C CrCtl_numDRPrmntCvtGearShiftMap_CA CrCtl_numTrqRat_C CrCtl_r10msAddVar_C CrCtl_r10msSubVar_C CrCtl_rACCBrkReqChng_CUR CrCtl_rACCECOffSlopDwn1_CUR CrCtl_rACCECOffSlopDwn2_CUR CrCtl_rACCECOffSlopDwn3_CUR CrCtl_rACCECOffSlopDwn4_CUR CrCtl_rACCECOnSlopDwn1_CUR CrCtl_rACCECOnSlopDwn2_CUR CrCtl_rACCECOnSlopDwn3_CUR CrCtl_rACCECOnSlopDwn4_CUR CrCtl_rACCFstTUTrgAccnFdbk_C CrCtl_rACCFstTUTrgAccnRed_C CrCtl_rAccOffNTG_GMAP CrCtl_rAccOffTG_GMAP CrCtl_rAccOffX_AXIS CrCtl_rAccOffY_AXIS CrCtl_rACCReqChngStrt_GCUR CrCtl_rACCTDInitNTG_GCUR CrCtl_rACCTDInitTG_GCUR CrCtl_rACCTUInitNTG_GCUR CrCtl_rACCTUInitTG_GCUR CrCtl_rAppACCFUEC_GCUR CrCtl_rAPPACCFUKmph_GCUR CrCtl_rAPPACCFUMph_GCUR CrCtl_rAPPOpnDR1CnclDwnSlp_CUR CrCtl_rAPPOpnDR2CnclDwnSlp_CUR CrCtl_rAPPOpnDR3CnclDwnSlp_CUR CrCtl_rAPPOpnDR4CnclDwnSlp_CUR CrCtl_rAPPOpnDR5CnclDwnSlp_CUR CrCtl_rAPPOpnDR6CnclDwnSlp_CUR CrCtl_rAPPOpnDR7CnclDwnSlp_CUR CrCtl_rClthOutLimVal_C CrCtl_rCmftAPPACCFUMph_GCUR CrCtl_rCmftLSFStrtAPP1_GCUR CrCtl_rCmftMaxAppCCEC_GCUR CrCtl_rCmftMaxAPPCCMph_GCUR CrCtl_rCmftMaxCC3LGMph_GCUR CrCtl_rCmftMaxCC4LGMph_GCUR CrCtl_rCmftMaxCC5LGMph_GCUR CrCtl_rCmftMaxCC6LGMph_GCUR CrCtl_rCmftMaxCCLGMph_GCUR CrCtl_rCmftMaxCCNGMph_GCUR CrCtl_rCmftMaxCCTGMph_GCUR CrCtl_rCmftTDInitNTG_GCUR CrCtl_rCmftTDInitTG_GCUR CrCtl_rCmftTUInitNTG_GCUR CrCtl_rCmftTUInitTG_GCUR CrCtl_rDRAppCnclDnSlp_C CrCtl_rDwn_AXIS CrCtl_rECAppAdd10ms_C CrCtl_rECAppSub10ms_C CrCtl_rEcoAccOffNTG_GMAP CrCtl_rEcoAccOffTG_GMAP CrCtl_rECOffAppLimNum1_MAP CrCtl_rECOffAppLimNum2_MAP CrCtl_rECOffAppLimNum3_MAP CrCtl_rECOffAppLimNum4_MAP CrCtl_rECOffAppLimNum5_MAP CrCtl_rECOffSlopDwn1_CUR CrCtl_rECOffSlopDwn2_CUR CrCtl_rECOffSlopDwn3_CUR CrCtl_rECOffSlopDwn4_CUR CrCtl_rEcoLSFStrtAPP1_GCUR CrCtl_rECOnAppLimNum1_MAP CrCtl_rECOnAppLimNum2_MAP CrCtl_rECOnAppLimNum3_MAP CrCtl_rECOnAppLimNum4_MAP CrCtl_rECOnAppLimNum5_MAP CrCtl_rECOnSlopDwn1_CUR CrCtl_rECOnSlopDwn2_CUR CrCtl_rECOnSlopDwn3_CUR CrCtl_rECOnSlopDwn4_CUR CrCtl_rEcoResOffNTG_GMAP CrCtl_rEcoResOffTG_GMAP CrCtl_rEcoTDInitNTG_GCUR CrCtl_rEcoTDInitTG_GCUR CrCtl_rEcoTUInitNTG_GCUR CrCtl_rEcoTUInitTG_GCUR CrCtl_rECShiftVal1_MAP CrCtl_rECShiftVal2_MAP CrCtl_rECShiftVal3_MAP CrCtl_rECShiftVal4_MAP CrCtl_rECShiftVal5_MAP CrCtl_rEstSlpValDR1Cncl_CUR CrCtl_rEstSlpValDR2Cncl_CUR CrCtl_rEstSlpValDR3Cncl_CUR CrCtl_rEstSlpValDR4Cncl_CUR CrCtl_rEstSlpValDR5Cncl_CUR CrCtl_rEstSlpValDR6Cncl_CUR CrCtl_rEstSlpValDR7Cncl_CUR CrCtl_rFstDwnCncl_GCUR CrCtl_rInitCmftReqNTG_GMAP CrCtl_rInitCmftReqTG_GMAP CrCtl_rInitEcoReqNTG_GMAP CrCtl_rInitEcoReqTG_GMAP CrCtl_rInitPlusRReqNTG_GMAP CrCtl_rInitPlusRReqTG_GMAP CrCtl_rInitReqNTG_GMAP CrCtl_rInitReqTG_GMAP CrCtl_rInitReqX_AXIS CrCtl_rInitReqY_AXIS CrCtl_rInitSptReqNTG_GMAP CrCtl_rInitSptReqTG_GMAP CrCtl_rLSFStrtAPP1_GCUR CrCtl_rMaxAppCCEC_GCUR CrCtl_rMaxAPPCCKmph_GCUR CrCtl_rMaxAPPCCMph_GCUR CrCtl_rMaxCC3LGEC_GCUR CrCtl_rMaxCC3LGMph_GCUR CrCtl_rMaxCC4LGEC_GCUR CrCtl_rMaxCC4LGMph_GCUR CrCtl_rMaxCC5LGEC_GCUR CrCtl_rMaxCC5LGMph_GCUR CrCtl_rMaxCC6LGEC_GCUR CrCtl_rMaxCC6LGMph_GCUR CrCtl_rMaxCCLGEC_GCUR CrCtl_rMaxCCLGKmph_GCUR CrCtl_rMaxCCLGMph_GCUR CrCtl_rMaxCCNGEC_GCUR CrCtl_rMaxCCNGKmph_GCUR CrCtl_rMaxCCNGMph_GCUR CrCtl_rMaxCCTGEC_GCUR CrCtl_rMaxCCTGKmph_GCUR CrCtl_rMaxCCTGMph_GCUR CrCtl_rMaxVal_C CrCtl_rReqChng_GCUR CrCtl_rResOffNTGKmh_GMAP CrCtl_rResOffNTG_GMAP CrCtl_rResOffTGKmh_GMAP CrCtl_rResOffTG_GMAP CrCtl_rSecDwnCncl_GCUR CrCtl_rSptAccOffNTG_GMAP CrCtl_rSptAccOffTG_GMAP CrCtl_rSptAPPACCFUMph_GCUR CrCtl_rSptLSFStrtAPP1_GCUR CrCtl_rSptMaxAppCCEC_GCUR CrCtl_rSptMaxAPPCCMph_GCUR CrCtl_rSptMaxCC3LGMph_GCUR CrCtl_rSptMaxCC4LGMph_GCUR CrCtl_rSptMaxCC5LGMph_GCUR CrCtl_rSptMaxCC6LGMph_GCUR CrCtl_rSptMaxCCLGMph_GCUR CrCtl_rSptMaxCCNGMph_GCUR CrCtl_rSptMaxCCTGMph_GCUR CrCtl_rSptReqChng_GCUR CrCtl_rSptResOffNTG_GMAP CrCtl_rSptResOffTG_GMAP CrCtl_rSptTDInitNTG_GCUR CrCtl_rSptTDInitTG_GCUR CrCtl_rSptTUInitNTG_GCUR CrCtl_rSptTUInitTG_GCUR CrCtl_rTDInitNTG_GCUR CrCtl_rTDInitTG_GCUR CrCtl_rTrgSub_CUR CrCtl_rTrqDflVal_C CrCtl_rTUInitDRlo_GCUR CrCtl_rTUInitNTG_GCUR CrCtl_rTUInitTG_GCUR CrCtl_stACCClthOutSel_C CrCtl_stACCECActv_C CrCtl_stACCUpLimCnclGDwnNr_C CrCtl_stCCECActv_C CrCtl_stCCMaxAPPGDwnNr_C CrCtl_stCCUpLimCnclGDwnNr_C CrCtl_stDisAPPInc_C CrCtl_stDR1AccnTmrDisbl_C CrCtl_stDR2AccnTmrDisbl_C CrCtl_stDR3AccnTmrDisbl_C CrCtl_stDR4AccnTmrDisbl_C CrCtl_stDR5AccnTmrDisbl_C CrCtl_stDR6AccnTmrDisbl_C CrCtl_stDR7AccnTmrDisbl_C CrCtl_stECAppLimSel_C CrCtl_stECAppUpprLim_C CrCtl_stECDesSelCdn_C CrCtl_stECDesSelProc_C CrCtl_stECDR1DwnSlpDi_C CrCtl_stECDR2DwnSlpDi_C CrCtl_stECDR3DwnSlpDi_C CrCtl_stGearMapNo_CA CrCtl_stNeLimSel_C CrCtl_stResOffEna_C CrCtl_stSwtPDCtrlEna_C CrCtl_stUpACC1LG_C CrCtl_stUpACC2LG_C CrCtl_stUpACCTG_C CrCtl_stUpCC1LG_C CrCtl_stUpCC2LG_C CrCtl_stUpCCTG_C CrCtl_stUpperGear_C CrCtl_stVehSpdSel_C CrCtl_swtACCTrgAccnSel_C CrCtl_SwtDRnrEna_C CrCtl_tiACCChngRes_C CrCtl_tiAccnDR1UpSlp_C CrCtl_tiAccnDR2UpSlp_C CrCtl_tiAccnDR3UpSlp_C CrCtl_tiAccnDR4UpSlp_C CrCtl_tiAccnDR5UpSlp_C CrCtl_tiAccnDR6UpSlp_C CrCtl_tiAccnDR7UpSlp_C CrCtl_tiCC1LGMaxRat_C CrCtl_tiCC2LGMaxRat_C CrCtl_tiCC3LGMaxRat_C CrCtl_tiCC4LGMaxRat_C CrCtl_tiCC5LGMaxRat_C CrCtl_tiCC6LGMaxRat_C CrCtl_tiCCMaxRat_C CrCtl_tiCCTGMaxRat_C CrCtl_tiClthOnContChng_C CrCtl_tiContnsErrChk_C CrCtl_tiDR1CnclHold_C CrCtl_tiDR1CnclMskDwnSlp_C CrCtl_tiDR1CnclUpSlp_C CrCtl_tiDR2CnclHold_C CrCtl_tiDR2CnclMskDwnSlp_C CrCtl_tiDR2CnclUpSlp_C CrCtl_tiDR3CnclHold_C CrCtl_tiDR3CnclMskDwnSlp_C CrCtl_tiDR3CnclUpSlp_C CrCtl_tiDR4CnclHold_C CrCtl_tiDR4CnclMskDwnSlp_C CrCtl_tiDR4CnclUpSlp_C CrCtl_tiDR5CnclHold_C CrCtl_tiDR5CnclMskDwnSlp_C CrCtl_tiDR5CnclUpSlp_C CrCtl_tiDR6CnclHold_C CrCtl_tiDR6CnclMskDwnSlp_C CrCtl_tiDR6CnclUpSlp_C CrCtl_tiDR7CnclHold_C CrCtl_tiDR7CnclMskDwnSlp_C CrCtl_tiDR7CnclUpSlp_C CrCtl_tiDRCnclPROSMADisbl_C CrCtl_tiDRMskB_C CrCtl_tiDRMskC_C CrCtl_tiDRMskD_C CrCtl_tiDRMskE_C CrCtl_tiDRMskF_C CrCtl_tiDwnReqDisbl_C CrCtl_tiECAppContns1_C CrCtl_tiECAppContns2_C CrCtl_tiECAppContns3_C CrCtl_tiECAppContns4_C CrCtl_tiECMaskAUp2_C CrCtl_tiECMaskAUp3_C CrCtl_tiECMaskAUp4_C CrCtl_tiECMaskAUp5_C CrCtl_tiECMaskDwn1_C CrCtl_tiECMaskDwn2_C CrCtl_tiECMaskDwn3_C CrCtl_tiECMaskDwn4_C CrCtl_tiECMaskNumUp_C CrCtl_tiExtCont_C CrCtl_tiGuidDispTime_C CrCtl_tiMskDR2DwnSlp_C CrCtl_tiMskDR2UpSlp_C CrCtl_tiMskDR3DwnSlp_C CrCtl_tiMskDR3UpSlp_C CrCtl_tiMskDR4DwnSlp_C CrCtl_tiMskDR4UpSlp_C CrCtl_tiMskDR5DwnSlp_C CrCtl_tiMskDR5UpSlp_C CrCtl_tiMskDR6DwnSlp_C CrCtl_tiMskDR6UpSlp_C CrCtl_tiMskDR7DwnSlp_C CrCtl_tiMskDR7UpSlp_C CrCtl_tiSpdCnclMskDR2DR1_C CrCtl_tiSpdCnclMskDR3DR2_C CrCtl_tiSpdCnclMskDR4DR3_C CrCtl_tiSpdCnclMskDR5DR4_C CrCtl_tiSpdCnclMskDR6DR5_C CrCtl_tiSpdCnclMskDR7DR6_C CrCtl_tiTrqIncReqDisbl_C CrCtl_tiWaitReqDR0DR1_C CrCtl_tiWaitReqDR1DR0_C CrCtl_tiWaitReqDR1DR2_C CrCtl_tiWaitReqDR2DR1_C CrCtl_tiWaitReqDR2DR3_C CrCtl_tiWaitReqDR3DR2_C CrCtl_tiWaitReqDR3DR4_C CrCtl_tiWaitReqDR4DR3_C CrCtl_tiWaitReqDR4DR5_C CrCtl_tiWaitReqDR5DR4_C CrCtl_tiWaitReqDR5DR6_C CrCtl_tiWaitReqDR6DR5_C CrCtl_tiWaitReqDR6DR7_C CrCtl_vACCECDvtDR1UpSlp_C CrCtl_vACCECDvtDR2UpSlp_C CrCtl_vACCECDvtDR3UpSlp_C CrCtl_vACCECDvtDR4UpSlp_C CrCtl_vACCECDvtDR5UpSlp_C CrCtl_vACCECDvtDR6UpSlp_C CrCtl_vACCECDvtDR7UpSlp_C CrCtl_vACCECOffDvtDwn1_C CrCtl_vACCECOffDvtDwn2_C CrCtl_vACCECOffDvtDwn3_C CrCtl_vACCECOffDvtDwn4_C CrCtl_vACCECOffDvtUp2_C CrCtl_vACCECOffDvtUp3_C CrCtl_vACCECOffDvtUp4_C CrCtl_vACCECOffDvtUp5_C CrCtl_vACCECOnDvtDwn1_C CrCtl_vACCECOnDvtDwn2_C CrCtl_vACCECOnDvtDwn3_C CrCtl_vACCECOnDvtDwn4_C CrCtl_vACCECOnDvtUp2_C CrCtl_vACCECOnDvtUp3_C CrCtl_vACCECOnDvtUp4_C CrCtl_vACCECOnDvtUp5_C CrCtl_vAccnBas_AX CrCtl_vAccnBas_AXIS CrCtl_vAccnCont_AX CrCtl_vAccnCont_AXIS CrCtl_vAccnDR1DwnSlpCoast_CUR /end DEF_CHARACTERISTIC
 FUNCTION_VERSION "6.2.0" /end FUNCTION
/begin COMPU_METHOD APPCrCtl1 "" RAT_FUNC "%6.4" "%" COEFFS 0 200 0 0 0 1 /end COMPU_METHOD
/begin COMPU_METHOD EngNCrCtl "" RAT_FUNC "%6.2" "rpm" COEFFS 0 1 0 0 0 1 /end COMPU_METHOD
/begin COMPU_METHOD Fact1 "" RAT_FUNC "%6.4" "-" COEFFS 0 128 0 0 0 1 /end COMPU_METHOD
/begin COMPU_METHOD Fact100 "" RAT_FUNC "%6.4" "-" COEFFS 0 100 0 0 0 1 /end COMPU_METHOD
/begin COMPU_METHOD Fact2 "" RAT_FUNC "%6.4" "-" COEFFS 0 16 0 0 0 1 /end COMPU_METHOD
/begin COMPU_METHOD Fact_CrCtl "" RAT_FUNC "%6.4" "-" COEFFS 0 256 0 0 0 1 /end COMPU_METHOD
/begin COMPU_METHOD Fact_CrCtl2 "" RAT_FUNC "%6.4" "-" COEFFS 0 64 0 0 0 1 /end COMPU_METHOD
/begin COMPU_METHOD Fact_CrCtl3 "" RAT_FUNC "%6.5" "-" COEFFS 0 1024 0 0 0 1 /end COMPU_METHOD
/begin COMPU_METHOD fak_q0p00392 "" RAT_FUNC "%6.4" "-" COEFFS 0 255 0 0 0 1 /end COMPU_METHOD
/begin COMPU_METHOD OneToOne "" RAT_FUNC "%6.2" "-" COEFFS 0 1 0 0 0 1 /end COMPU_METHOD
/begin COMPU_METHOD Prc_CrCtl "" RAT_FUNC "%6.2" "%" COEFFS 0 1 0 0 0 1 /end COMPU_METHOD
/begin COMPU_METHOD Prc_CrCtl2 "" RAT_FUNC "%6.3" "%" COEFFS 0 10 0 0 0 1 /end COMPU_METHOD
/begin COMPU_METHOD Prc_CrCtl4 "" RAT_FUNC "%6.4" "%" COEFFS 0 256 0 0 0 1 /end COMPU_METHOD
/begin COMPU_METHOD Time_ms "" RAT_FUNC "%6.1" "ms" COEFFS 0 0.1 0 0 0 1 /end COMPU_METHOD
/begin COMPU_METHOD Time_ms_100ms "" RAT_FUNC "%6.0" "ms" COEFFS 0 0.01 0 0 0 1 /end COMPU_METHOD
/begin COMPU_METHOD Vel_CrCtl "" RAT_FUNC "%6.4" "km/h" COEFFS 0 256 0 0 0 1 /end COMPU_METHOD
/begin COMPU_METHOD Vel_CrCtl1 "" RAT_FUNC "%6.2" "km/h" COEFFS 0 1 0 0 0 1 /end COMPU_METHOD
/*********** End of merged RECORD_LAYOUT blocks ***********/
/begin RECORD_LAYOUT Axis_Xs16 NO_AXIS_PTS_X 1 SWORD AXIS_PTS_X 2 SWORD INDEX_INCR DIRECT /end RECORD_LAYOUT
/begin RECORD_LAYOUT CurG_Ws16 FNC_VALUES 1 SWORD COLUMN_DIR DIRECT /end RECORD_LAYOUT
/begin RECORD_LAYOUT MapG_Ws16 FNC_VALUES 1 SWORD COLUMN_DIR DIRECT /end RECORD_LAYOUT
/begin RECORD_LAYOUT Map_Xs16Ys16Ws16 NO_AXIS_PTS_X 1 SWORD NO_AXIS_PTS_Y 2 SWORD AXIS_PTS_X 3 SWORD INDEX_INCR DIRECT AXIS_PTS_Y 4 SWORD INDEX_INCR DIRECT FNC_VALUES 5 SWORD COLUMN_DIR DIRECT /end RECORD_LAYOUT
/begin RECORD_LAYOUT RB_Curve_S16_U8_Static NO_AXIS_PTS_X 1 SWORD AXIS_PTS_X 2 SWORD INDEX_INCR DIRECT FNC_VALUES 3 UBYTE COLUMN_DIR DIRECT STATIC_RECORD_LAYOUT /end RECORD_LAYOUT
/begin RECORD_LAYOUT RB_Cur_Xs16Ws16 NO_AXIS_PTS_X 1 SWORD AXIS_PTS_X 2 SWORD INDEX_INCR DIRECT FNC_VALUES 3 SWORD COLUMN_DIR DIRECT /end RECORD_LAYOUT
/begin RECORD_LAYOUT ValA_Wu8 FNC_VALUES 1 UBYTE COLUMN_DIR DIRECT /end RECORD_LAYOUT
/begin RECORD_LAYOUT Val_Ws16 FNC_VALUES 1 SWORD COLUMN_DIR DIRECT /end RECORD_LAYOUT
/begin RECORD_LAYOUT Val_Ws8 FNC_VALUES 1 SBYTE COLUMN_DIR DIRECT /end RECORD_LAYOUT
/begin RECORD_LAYOUT Val_Wu8 FNC_VALUES 1 UBYTE COLUMN_DIR DIRECT /end RECORD_LAYOUT
/end MODULE
/end PROJECT
