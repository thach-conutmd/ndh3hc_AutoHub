ASAP2_VERSION 1 60
/begin PROJECT MG1CA020 "MG1CA020"
/begin HEADER "" VERSION "MG1CA020_6SAY_V011_TPROT" PROJECT_NO MG1CA020 /end HEADER
/begin MODULE DIM ""
/begin MOD_COMMON "" BYTE_ORDER MSB_LAST ALIGNMENT_BYTE 1 ALIGNMENT_WORD 2 ALIGNMENT_LONG 4 ALIGNMENT_INT64 4 ALIGNMENT_FLOAT32_IEEE 4 ALIGNMENT_FLOAT64_IEEE 4 DATA_SIZE 32 /end MOD_COMMON
/begin CHARACTERISTIC ACTR_TST_CP_ATS_ATS.LimitTypeMsk_C "Actuator test ACTR_TST_CP_ATS_ATS / Tester demand monitoring enable mask for actuators" VALUE 0x8053A554 Val_Wu8 255.0 OneToOne 0.00 255.0 FORMAT "%5.1" /end CHARACTERISTIC
/begin CHARACTERISTIC ACTR_TST_CP_ATS_ATS.CnvNorm_C "Actuator test ACTR_TST_CP_ATS_ATS / Conversion norm used for conversion to/from internal scaling" VALUE 0x8053A555 Val_Wu8 255.0 OneToOne 0.00 255.0 FORMAT "%5.1" /end CHARACTERISTIC
/begin CHARACTERISTIC ACTR_TST_CP_ATS_ATS.LowLim_C "Actuator test ACTR_TST_CP_ATS_ATS / Lower limit for monitoring" VALUE 0x8053A556 Val_Ws16 799.9878 Prc -400.0000 399.9878 FORMAT "%8.4" /end CHARACTERISTIC
/begin CHARACTERISTIC ACTR_TST_CP_ATS_ATS.UpLim_C "Actuator test ACTR_TST_CP_ATS_ATS / Upper limit for monitoring" VALUE 0x8053A558 Val_Ws16 799.9878 Prc -400.0000 399.9878 FORMAT "%8.4" /end CHARACTERISTIC
/begin CHARACTERISTIC ACTR_TST_CP_ATS_ATS.CnvFac_C "Actuator test ACTR_TST_CP_ATS_ATS / Factor used for conversion to/from internal scaling" VALUE 0x8053A55C Val_Ws32 4294967295.00 OneToOne -2147483648.00 2147483647.00 FORMAT "%13.2" /end CHARACTERISTIC
/begin CHARACTERISTIC ACTR_TST_CP_ATS_ATS.CnvOfs_C "Actuator test ACTR_TST_CP_ATS_ATS / Offset used for conversion to/from internal scaling" VALUE 0x8053A560 Val_Ws16 65535.00 OneToOne -32768.00 32767.00 FORMAT "%8.2" /end CHARACTERISTIC
/begin CHARACTERISTIC ACTR_TST_CP_ATS_ATS.DfltVal_C "Actuator test ACTR_TST_CP_ATS_ATS / Default value for standbytest" VALUE 0x8053A562 Val_Ws16 65535.00 OneToOne -32768.00 32767.00 FORMAT "%8.2" /end CHARACTERISTIC
/begin CHARACTERISTIC ACTR_TST_THRVLV_ATS_ATS.LimitTypeMsk_C "Actuator test ACTR_TST_THRVLV_ATS_ATS / Tester demand monitoring enable mask for actuators" VALUE 0x8053A564 Val_Wu8 255.0 OneToOne 0.00 255.0 FORMAT "%5.1" /end CHARACTERISTIC
/begin CHARACTERISTIC ACTR_TST_THRVLV_ATS_ATS.CnvNorm_C "Actuator test ACTR_TST_THRVLV_ATS_ATS / Conversion norm used for conversion to/from internal scaling" VALUE 0x8053A565 Val_Wu8 255.0 OneToOne 0.00 255.0 FORMAT "%5.1" /end CHARACTERISTIC
/begin CHARACTERISTIC ACTR_TST_THRVLV_ATS_ATS.LowLim_C "Actuator test ACTR_TST_THRVLV_ATS_ATS / Lower limit for monitoring" VALUE 0x8053A566 Val_Ws16 25599.61 rel_ub_b99p6 -12800.00 12799.61 FORMAT "%8.2" /end CHARACTERISTIC
/begin CHARACTERISTIC ACTR_TST_THRVLV_ATS_ATS.UpLim_C "Actuator test ACTR_TST_THRVLV_ATS_ATS / Upper limit for monitoring" VALUE 0x8053A568 Val_Ws16 25599.61 rel_ub_b99p6 -12800.00 12799.61 FORMAT "%8.2" /end CHARACTERISTIC
/begin CHARACTERISTIC ACTR_TST_THRVLV_ATS_ATS.CnvFac_C "Actuator test ACTR_TST_THRVLV_ATS_ATS / Factor used for conversion to/from internal scaling" VALUE 0x8053A56C Val_Ws32 4294967295.00 OneToOne -2147483648.00 2147483647.00 FORMAT "%13.2" /end CHARACTERISTIC
/begin CHARACTERISTIC ACTR_TST_THRVLV_ATS_ATS.CnvOfs_C "Actuator test ACTR_TST_THRVLV_ATS_ATS / Offset used for conversion to/from internal scaling" VALUE 0x8053A570 Val_Ws16 65535.00 OneToOne -32768.00 32767.00 FORMAT "%8.2" /end CHARACTERISTIC
/begin CHARACTERISTIC ACTR_TST_THRVLV_ATS_ATS.DfltVal_C "Actuator test ACTR_TST_THRVLV_ATS_ATS / Default value for standbytest" VALUE 0x8053A572 Val_Ws16 65535.00 OneToOne -32768.00 32767.00 FORMAT "%8.2" /end CHARACTERISTIC
/begin CHARACTERISTIC ASDrf_Cfg2_CW "configuration label 2 for driveability filter" VALUE 0x804FCE8A RB_Val_Wu16 65535.00 dez 0.00 65535.00 FORMAT "%8.2" /end CHARACTERISTIC
/begin CHARACTERISTIC ASDrf_Cfg3_CW "configuration label 3 for driveability filter gradient limitiation" VALUE 0x804FCE8C RB_Val_Wu8 255.0 dez 0.00 255.0 FORMAT "%5.1" /end CHARACTERISTIC
/begin CHARACTERISTIC ASDrf_Cfg4_CW "configuration label 4 for driveability filter" VALUE 0x804FCE8E RB_Val_Wu16 65535.00 dez 0.00 65535.00 FORMAT "%8.2" /end CHARACTERISTIC
/begin CHARACTERISTIC ASDrf_Cfg_CW "configuration label for driveability filter" VALUE 0x804FCE90 RB_Val_Wu16 65535.00 dez 0.00 65535.00 FORMAT "%8.2" /end CHARACTERISTIC
/begin CHARACTERISTIC ASDrf_CoefAAirCdnrOnGripNeg_GT "Coef A, Grip at clutch, neg. load alteration damping for AC on" CURVE 0x804FCE92 RB_CurveGroup_U8 15.94 q0p0625_DIV_Nm_s 0.00 15.94 FORMAT "%5.2"
 /begin AXIS_DESCR COM_AXIS PT_rTrq TransR 8 -327.6800 327.6700 FORMAT "%8.4" AXIS_PTS_REF ASDrf_rTrq_DST /end AXIS_DESCR
/end CHARACTERISTIC
/begin CHARACTERISTIC ASDrf_CoefAGripMtModNeg_GT "Coef A, Grip at clutch, manual transmission mode, neg. load alteration damping" CURVE 0x804FCE9A RB_CurveGroup_U8 15.94 q0p0625_DIV_Nm_s 0.00 15.94 FORMAT "%5.2"
 /begin AXIS_DESCR COM_AXIS PT_rTrq TransR 8 -327.6800 327.6700 FORMAT "%8.4" AXIS_PTS_REF ASDrf_rTrq_DST /end AXIS_DESCR
/end CHARACTERISTIC
/begin CHARACTERISTIC ASDrf_CoefAGripMtModPosAbv_GT "Coef A, Grip at clutch, manual transmission mode, pos. load alteration damping" CURVE 0x804FCEA2 RB_CurveGroup_U8 15.94 q0p0625_DIV_Nm_s 0.00 15.94 FORMAT "%5.2"
 /begin AXIS_DESCR COM_AXIS PT_rTrq TransR 8 -327.6800 327.6700 FORMAT "%8.4" AXIS_PTS_REF ASDrf_rTrq_DST /end AXIS_DESCR
/end CHARACTERISTIC
/begin CHARACTERISTIC ASDrf_CoefAGripMtModPosBlw_GT "Coef A, Grip at clutch, manual transmission mode, pos. load alteration damping" CURVE 0x804FCEAA RB_CurveGroup_U8 15.94 q0p0625_DIV_Nm_s 0.00 15.94 FORMAT "%5.2"
 /begin AXIS_DESCR COM_AXIS PT_rTrq TransR 8 -327.6800 327.6700 FORMAT "%8.4" AXIS_PTS_REF ASDrf_rTrq_DST /end AXIS_DESCR
/end CHARACTERISTIC
/begin CHARACTERISTIC ASDrf_CoefAGripNeg_CUR "Coef A, Grip at clutch, neg. load alteration damping" CURVE 0x804FCEB2 RB_CurveGroup_U8 15.94 q0p0625_DIV_Nm_s 0.00 15.94 FORMAT "%5.2"
 /begin AXIS_DESCR COM_AXIS PT_rTrq TransR 8 -327.6800 327.6700 FORMAT "%8.4" AXIS_PTS_REF ASDrf_rTrq_DST /end AXIS_DESCR
/end CHARACTERISTIC
/begin CHARACTERISTIC ASDrf_CoefAGripPosAbvAcOn_GCUR "Coef A, Grip at clutch, pos. load alteration damping during AC On" CURVE 0x804FCEBA RB_CurveGroup_U8 15.94 q0p0625_DIV_Nm_s 0.00 15.94 FORMAT "%5.2"
 /begin AXIS_DESCR COM_AXIS PT_rTrq TransR 8 -327.6800 327.6700 FORMAT "%8.4" AXIS_PTS_REF ASDrf_rTrq_DST /end AXIS_DESCR
/end CHARACTERISTIC
/begin CHARACTERISTIC ASDrf_CoefAGripPosAbv_GCUR "Coef A, Grip at clutch, pos. load alteration damping" CURVE 0x804FCEC2 RB_CurveGroup_U8 15.94 q0p0625_DIV_Nm_s 0.00 15.94 FORMAT "%5.2"
 /begin AXIS_DESCR COM_AXIS PT_rTrq TransR 8 -327.6800 327.6700 FORMAT "%8.4" AXIS_PTS_REF ASDrf_rTrq_DST /end AXIS_DESCR
/end CHARACTERISTIC
/begin CHARACTERISTIC ASDrf_CoefAGripPosBlwAcOn_GCUR "Coef A, Grip at clutch, pos. load alteration damping during AC On" CURVE 0x804FCECA RB_CurveGroup_U8 15.94 q0p0625_DIV_Nm_s 0.00 15.94 FORMAT "%5.2"
 /begin AXIS_DESCR COM_AXIS PT_rTrq TransR 8 -327.6800 327.6700 FORMAT "%8.4" AXIS_PTS_REF ASDrf_rTrq_DST /end AXIS_DESCR
/end CHARACTERISTIC
/begin CHARACTERISTIC ASDrf_CoefAGripPosBlw_GCUR "Coef A, Grip at clutch, pos. load alteration damping" CURVE 0x804FCED2 RB_CurveGroup_U8 15.94 q0p0625_DIV_Nm_s 0.00 15.94 FORMAT "%5.2"
 /begin AXIS_DESCR COM_AXIS PT_rTrq TransR 8 -327.6800 327.6700 FORMAT "%8.4" AXIS_PTS_REF ASDrf_rTrq_DST /end AXIS_DESCR
/end CHARACTERISTIC
/begin CHARACTERISTIC ASDrf_CoefASprtMtModNeg_GT "Coef A, Sport, Manual transmission mode, neg. load alteration damping" CURVE 0x804FCEDA RB_CurveGroup_U8 15.94 q0p0625_DIV_Nm_s 0.00 15.94 FORMAT "%5.2"
 /begin AXIS_DESCR COM_AXIS PT_rTrq TransR 8 -327.6800 327.6700 FORMAT "%8.4" AXIS_PTS_REF ASDrf_rTrq_DST /end AXIS_DESCR
/end CHARACTERISTIC
/begin CHARACTERISTIC ASDrf_CoefASprtMtModPosAbv_GT "Coef A, Sport, Manual transmission mode, pos. load alteration damping" CURVE 0x804FCEE2 RB_CurveGroup_U8 15.94 q0p0625_DIV_Nm_s 0.00 15.94 FORMAT "%5.2"
 /begin AXIS_DESCR COM_AXIS PT_rTrq TransR 8 -327.6800 327.6700 FORMAT "%8.4" AXIS_PTS_REF ASDrf_rTrq_DST /end AXIS_DESCR
/end CHARACTERISTIC
/begin CHARACTERISTIC ASDrf_CoefASprtMtModPosBlw_GT "Coef A, Sport, Manual transmission mode, pos. load alteration damping" CURVE 0x804FCEEA RB_CurveGroup_U8 15.94 q0p0625_DIV_Nm_s 0.00 15.94 FORMAT "%5.2"
 /begin AXIS_DESCR COM_AXIS PT_rTrq TransR 8 -327.6800 327.6700 FORMAT "%8.4" AXIS_PTS_REF ASDrf_rTrq_DST /end AXIS_DESCR
/end CHARACTERISTIC
/begin CHARACTERISTIC ASDrf_CoefASprtNegAcOn_GT "Coef A, Sport, neg. load alteration damping with AC on" CURVE 0x804FCEF2 RB_CurveGroup_U8 15.94 q0p0625_DIV_Nm_s 0.00 15.94 FORMAT "%5.2"
 /begin AXIS_DESCR COM_AXIS PT_rTrq TransR 8 -327.6800 327.6700 FORMAT "%8.4" AXIS_PTS_REF ASDrf_rTrq_DST /end AXIS_DESCR
/end CHARACTERISTIC
/begin CHARACTERISTIC ASDrf_CoefASprtNeg_GT "Coef A, Sport, neg. load alteration damping" CURVE 0x804FCEFA RB_CurveGroup_U8 15.94 q0p0625_DIV_Nm_s 0.00 15.94 FORMAT "%5.2"
 /begin AXIS_DESCR COM_AXIS PT_rTrq TransR 8 -327.6800 327.6700 FORMAT "%8.4" AXIS_PTS_REF ASDrf_rTrq_DST /end AXIS_DESCR
/end CHARACTERISTIC
/begin CHARACTERISTIC ASDrf_CoefASprtPosAbvAcOn_GT "Coef A, Sport, pos. load alteration damping with AC on" CURVE 0x804FCF02 RB_CurveGroup_U8 15.94 q0p0625_DIV_Nm_s 0.00 15.94 FORMAT "%5.2"
 /begin AXIS_DESCR COM_AXIS PT_rTrq TransR 8 -327.6800 327.6700 FORMAT "%8.4" AXIS_PTS_REF ASDrf_rTrq_DST /end AXIS_DESCR
/end CHARACTERISTIC
/begin CHARACTERISTIC ASDrf_CoefASprtPosAbv_GT "Coef A, Sport, pos. load alteration damping" CURVE 0x804FCF0A RB_CurveGroup_U8 15.94 q0p0625_DIV_Nm_s 0.00 15.94 FORMAT "%5.2"
 /begin AXIS_DESCR COM_AXIS PT_rTrq TransR 8 -327.6800 327.6700 FORMAT "%8.4" AXIS_PTS_REF ASDrf_rTrq_DST /end AXIS_DESCR
/end CHARACTERISTIC
/begin CHARACTERISTIC ASDrf_CoefASprtPosBlwAcOn_GT "Coef A, Sport, pos. load alteration damping with AC on" CURVE 0x804FCF12 RB_CurveGroup_U8 15.94 q0p0625_DIV_Nm_s 0.00 15.94 FORMAT "%5.2"
 /begin AXIS_DESCR COM_AXIS PT_rTrq TransR 8 -327.6800 327.6700 FORMAT "%8.4" AXIS_PTS_REF ASDrf_rTrq_DST /end AXIS_DESCR
/end CHARACTERISTIC
/begin CHARACTERISTIC ASDrf_CoefASprtPosBlw_GT "Coef A, Sport, pos. load alteration damping" CURVE 0x804FCF1A RB_CurveGroup_U8 15.94 q0p0625_DIV_Nm_s 0.00 15.94 FORMAT "%5.2"
 /begin AXIS_DESCR COM_AXIS PT_rTrq TransR 8 -327.6800 327.6700 FORMAT "%8.4" AXIS_PTS_REF ASDrf_rTrq_DST /end AXIS_DESCR
/end CHARACTERISTIC
/begin CHARACTERISTIC ASDrf_CoefBAirCdnrOnGripNeg_GM "Coef B, Grip at clutch, neg. load alteration damping for AC on" MAP 0x804FCF22 RB_MapGroup_U8 2540. mdgrad_q10 10. 2550. FORMAT "%5.0" EXTENDED_LIMITS 0.00 2550.
 /begin AXIS_DESCR COM_AXIS ASDrf_tqCluBasc Trq 5 -3276.800 3276.700 FORMAT "%8.3" AXIS_PTS_REF ASDrf_trqClthBs_DST /end AXIS_DESCR
 /begin AXIS_DESCR COM_AXIS Epm_nEng EngN 8 -16384.00 16383.50 FORMAT "%8.2" AXIS_PTS_REF ASDrf_nEng_DST /end AXIS_DESCR
/end CHARACTERISTIC
/begin CHARACTERISTIC ASDrf_CoefBGripMtModNeg_GM "Coef B, Grip at clutch, manual transmission mode, neg. load alteration damping" MAP 0x804FCF4A RB_MapGroup_U8 2540. mdgrad_q10 10. 2550. FORMAT "%5.0" EXTENDED_LIMITS 0.00 2550.
 /begin AXIS_DESCR COM_AXIS ASDrf_tqCluBasc Trq 5 -3276.800 3276.700 FORMAT "%8.3" AXIS_PTS_REF ASDrf_trqClthBs_DST /end AXIS_DESCR
 /begin AXIS_DESCR COM_AXIS Epm_nEng EngN 8 -16384.00 16383.50 FORMAT "%8.2" AXIS_PTS_REF ASDrf_nEng_DST /end AXIS_DESCR
/end CHARACTERISTIC
/begin CHARACTERISTIC ASDrf_CoefBGripMtModPosAbv_GM "Coef B, Grip at clutch, manual transmission mode, pos. load alteration damping" MAP 0x804FCF72 RB_MapGroup_U8 2540. mdgrad_q10 10. 2550. FORMAT "%5.0" EXTENDED_LIMITS 0.00 2550.
 /begin AXIS_DESCR COM_AXIS PT_rTrq TransR 8 -327.6800 327.6700 FORMAT "%8.4" AXIS_PTS_REF ASDrf_rTrq_DST /end AXIS_DESCR
 /begin AXIS_DESCR COM_AXIS Epm_nEng EngN 8 -16384.00 16383.50 FORMAT "%8.2" AXIS_PTS_REF ASDrf_nEng_DST /end AXIS_DESCR
/end CHARACTERISTIC
/begin CHARACTERISTIC ASDrf_CoefBGripMtModPosBlw_GM "Coef B, Grip at clutch, manual transmission mode, pos. load alteration damping" MAP 0x804FCFB2 RB_MapGroup_U8 2550. mdgrad_q10 0.00 2550. FORMAT "%5.0"
 /begin AXIS_DESCR COM_AXIS PT_rTrq TransR 8 -327.6800 327.6700 FORMAT "%8.4" AXIS_PTS_REF ASDrf_rTrq_DST /end AXIS_DESCR
 /begin AXIS_DESCR COM_AXIS Epm_nEng EngN 8 -16384.00 16383.50 FORMAT "%8.2" AXIS_PTS_REF ASDrf_nEng_DST /end AXIS_DESCR
/end CHARACTERISTIC
/begin CHARACTERISTIC ASDrf_CoefBGripNeg_GMAP "Coef B, Grip at clutch, neg. load alteration damping" MAP 0x804FCFF2 RB_MapGroup_U8 2540. mdgrad_q10 10. 2550. FORMAT "%5.0" EXTENDED_LIMITS 0.00 2550.
 /begin AXIS_DESCR COM_AXIS ASDrf_tqCluBasc Trq 5 -3276.800 3276.700 FORMAT "%8.3" AXIS_PTS_REF ASDrf_trqClthBs_DST /end AXIS_DESCR
 /begin AXIS_DESCR COM_AXIS ASDrf_nPt EngN 8 -16384.00 16383.50 FORMAT "%8.2" AXIS_PTS_REF ASDrf_nPt_DST /end AXIS_DESCR
/end CHARACTERISTIC
/begin CHARACTERISTIC ASDrf_CoefBGripPosAbvAcOn_GMAP "Coef B, Grip at clutch, pos. load alteration damping during AC On" MAP 0x804FD01A RB_MapGroup_U8 2540. mdgrad_q10 10. 2550. FORMAT "%5.0" EXTENDED_LIMITS 0.00 2550.
 /begin AXIS_DESCR COM_AXIS PT_rTrq TransR 8 -327.6800 327.6700 FORMAT "%8.4" AXIS_PTS_REF ASDrf_rTrq_DST /end AXIS_DESCR
 /begin AXIS_DESCR COM_AXIS Epm_nEng EngN 8 -16384.00 16383.50 FORMAT "%8.2" AXIS_PTS_REF ASDrf_nEng_DST /end AXIS_DESCR
/end CHARACTERISTIC
/begin CHARACTERISTIC ASDrf_CoefBGripPosAbv_GMAP "Coef B, Grip at clutch, pos. load alteration damping" MAP 0x804FD05A RB_MapGroup_U8 2540. mdgrad_q10 10. 2550. FORMAT "%5.0" EXTENDED_LIMITS 0.00 2550.
 /begin AXIS_DESCR COM_AXIS PT_rTrq TransR 8 -327.6800 327.6700 FORMAT "%8.4" AXIS_PTS_REF ASDrf_rTrq_DST /end AXIS_DESCR
 /begin AXIS_DESCR COM_AXIS ASDrf_nPt EngN 8 -16384.00 16383.50 FORMAT "%8.2" AXIS_PTS_REF ASDrf_nPt_DST /end AXIS_DESCR
/end CHARACTERISTIC
/begin CHARACTERISTIC ASDrf_CoefBGripPosBlwAcOn_GMAP "Coef B, Grip at clutch, pos. load alteration damping during AC On" MAP 0x804FD09A RB_MapGroup_U8 2550. mdgrad_q10 0.00 2550. FORMAT "%5.0"
 /begin AXIS_DESCR COM_AXIS PT_rTrq TransR 8 -327.6800 327.6700 FORMAT "%8.4" AXIS_PTS_REF ASDrf_rTrq_DST /end AXIS_DESCR
 /begin AXIS_DESCR COM_AXIS Epm_nEng EngN 8 -16384.00 16383.50 FORMAT "%8.2" AXIS_PTS_REF ASDrf_nEng_DST /end AXIS_DESCR
/end CHARACTERISTIC
/begin CHARACTERISTIC ASDrf_CoefBGripPosBlw_GMAP "Coef B, Grip at clutch, pos. load alteration damping" MAP 0x804FD0DA RB_MapGroup_U8 2550. mdgrad_q10 0.00 2550. FORMAT "%5.0"
 /begin AXIS_DESCR COM_AXIS PT_rTrq TransR 8 -327.6800 327.6700 FORMAT "%8.4" AXIS_PTS_REF ASDrf_rTrq_DST /end AXIS_DESCR
 /begin AXIS_DESCR COM_AXIS ASDrf_nPt EngN 8 -16384.00 16383.50 FORMAT "%8.2" AXIS_PTS_REF ASDrf_nPt_DST /end AXIS_DESCR
/end CHARACTERISTIC
/begin CHARACTERISTIC ASDrf_CoefBSprtMtModNeg_GM "Coef B, Sport, Manual transmission mode, neg. load alteration damping" MAP 0x804FD11A RB_MapGroup_U8 2540. mdgrad_q10 10. 2550. FORMAT "%5.0" EXTENDED_LIMITS 0.00 2550.
 /begin AXIS_DESCR COM_AXIS ASDrf_tqCluBasc Trq 5 -3276.800 3276.700 FORMAT "%8.3" AXIS_PTS_REF ASDrf_trqClthBs_DST /end AXIS_DESCR
 /begin AXIS_DESCR COM_AXIS Epm_nEng EngN 8 -16384.00 16383.50 FORMAT "%8.2" AXIS_PTS_REF ASDrf_nEng_DST /end AXIS_DESCR
/end CHARACTERISTIC
/begin CHARACTERISTIC ASDrf_CoefBSprtMtModPosAbv_GM "Coef B, Sport, Manual transmission mode, pos. load alteration damping" MAP 0x804FD142 RB_MapGroup_U8 2540. mdgrad_q10 10. 2550. FORMAT "%5.0" EXTENDED_LIMITS 0.00 2550.
 /begin AXIS_DESCR COM_AXIS PT_rTrq TransR 8 -327.6800 327.6700 FORMAT "%8.4" AXIS_PTS_REF ASDrf_rTrq_DST /end AXIS_DESCR
 /begin AXIS_DESCR COM_AXIS Epm_nEng EngN 8 -16384.00 16383.50 FORMAT "%8.2" AXIS_PTS_REF ASDrf_nEng_DST /end AXIS_DESCR
/end CHARACTERISTIC
/begin CHARACTERISTIC ASDrf_CoefBSprtMtModPosBlw_GM "Coef B, Sport, Manual transmission mode, pos. load alteration damping" MAP 0x804FD182 RB_MapGroup_U8 2550. mdgrad_q10 0.00 2550. FORMAT "%5.0"
 /begin AXIS_DESCR COM_AXIS PT_rTrq TransR 8 -327.6800 327.6700 FORMAT "%8.4" AXIS_PTS_REF ASDrf_rTrq_DST /end AXIS_DESCR
 /begin AXIS_DESCR COM_AXIS Epm_nEng EngN 8 -16384.00 16383.50 FORMAT "%8.2" AXIS_PTS_REF ASDrf_nEng_DST /end AXIS_DESCR
/end CHARACTERISTIC
/begin CHARACTERISTIC ASDrf_CoefBSprtNegAcOn_GM "Coef B, Sport, neg. load alteration damping with AC on" MAP 0x804FD1C2 RB_MapGroup_U8 2540. mdgrad_q10 10. 2550. FORMAT "%5.0" EXTENDED_LIMITS 0.00 2550.
 /begin AXIS_DESCR COM_AXIS ASDrf_tqCluBasc Trq 5 -3276.800 3276.700 FORMAT "%8.3" AXIS_PTS_REF ASDrf_trqClthBs_DST /end AXIS_DESCR
 /begin AXIS_DESCR COM_AXIS Epm_nEng EngN 8 -16384.00 16383.50 FORMAT "%8.2" AXIS_PTS_REF ASDrf_nEng_DST /end AXIS_DESCR
/end CHARACTERISTIC
/begin CHARACTERISTIC ASDrf_CoefBSprtNeg_GM "Coef B, Sport, neg. load alteration damping" MAP 0x804FD1EA RB_MapGroup_U8 2540. mdgrad_q10 10. 2550. FORMAT "%5.0" EXTENDED_LIMITS 0.00 2550.
 /begin AXIS_DESCR COM_AXIS ASDrf_tqCluBasc Trq 5 -3276.800 3276.700 FORMAT "%8.3" AXIS_PTS_REF ASDrf_trqClthBs_DST /end AXIS_DESCR
 /begin AXIS_DESCR COM_AXIS Epm_nEng EngN 8 -16384.00 16383.50 FORMAT "%8.2" AXIS_PTS_REF ASDrf_nEng_DST /end AXIS_DESCR
/end CHARACTERISTIC
/begin CHARACTERISTIC ASDrf_CoefBSprtPosAbvAcOn_GM "Coef B, Sport, pos. load alteration damping with AC on" MAP 0x804FD212 RB_MapGroup_U8 2540. mdgrad_q10 10. 2550. FORMAT "%5.0" EXTENDED_LIMITS 0.00 2550.
 /begin AXIS_DESCR COM_AXIS PT_rTrq TransR 8 -327.6800 327.6700 FORMAT "%8.4" AXIS_PTS_REF ASDrf_rTrq_DST /end AXIS_DESCR
 /begin AXIS_DESCR COM_AXIS Epm_nEng EngN 8 -16384.00 16383.50 FORMAT "%8.2" AXIS_PTS_REF ASDrf_nEng_DST /end AXIS_DESCR
/end CHARACTERISTIC
/begin CHARACTERISTIC ASDrf_CoefBSprtPosAbv_GM "Coef B, Sport, pos. load alteration damping" MAP 0x804FD252 RB_MapGroup_U8 2540. mdgrad_q10 10. 2550. FORMAT "%5.0" EXTENDED_LIMITS 0.00 2550.
 /begin AXIS_DESCR COM_AXIS PT_rTrq TransR 8 -327.6800 327.6700 FORMAT "%8.4" AXIS_PTS_REF ASDrf_rTrq_DST /end AXIS_DESCR
 /begin AXIS_DESCR COM_AXIS Epm_nEng EngN 8 -16384.00 16383.50 FORMAT "%8.2" AXIS_PTS_REF ASDrf_nEng_DST /end AXIS_DESCR
/end CHARACTERISTIC
/begin CHARACTERISTIC ASDrf_CoefBSprtPosBlwAcOn_GM "Coef B, Sport, pos. load alteration damping with AC on" MAP 0x804FD292 RB_MapGroup_U8 2550. mdgrad_q10 0.00 2550. FORMAT "%5.0"
 /begin AXIS_DESCR COM_AXIS PT_rTrq TransR 8 -327.6800 327.6700 FORMAT "%8.4" AXIS_PTS_REF ASDrf_rTrq_DST /end AXIS_DESCR
 /begin AXIS_DESCR COM_AXIS Epm_nEng EngN 8 -16384.00 16383.50 FORMAT "%8.2" AXIS_PTS_REF ASDrf_nEng_DST /end AXIS_DESCR
/end CHARACTERISTIC
/begin CHARACTERISTIC ASDrf_CoefBSprtPosBlw_GM "Coef B, Sport, pos. load alteration damping" MAP 0x804FD2D2 RB_MapGroup_U8 2550. mdgrad_q10 0.00 2550. FORMAT "%5.0"
 /begin AXIS_DESCR COM_AXIS PT_rTrq TransR 8 -327.6800 327.6700 FORMAT "%8.4" AXIS_PTS_REF ASDrf_rTrq_DST /end AXIS_DESCR
 /begin AXIS_DESCR COM_AXIS Epm_nEng EngN 8 -16384.00 16383.50 FORMAT "%8.2" AXIS_PTS_REF ASDrf_nEng_DST /end AXIS_DESCR
/end CHARACTERISTIC
/begin CHARACTERISTIC ASDrf_CoeffAGripMtModNegAcOn_GT "coefficient A negative load alteration when AC is On" CURVE 0x804FD312 RB_CurveGroup_U8 15.94 q0p0625_DIV_Nm_s 0.00 15.94 FORMAT "%5.2"
 /begin AXIS_DESCR COM_AXIS PT_rTrq TransR 8 -327.6800 327.6700 FORMAT "%8.4" AXIS_PTS_REF ASDrf_rTrq_DST /end AXIS_DESCR
/end CHARACTERISTIC
/begin CHARACTERISTIC ASDrf_CoeffAGripMtModPosAbvAcOn_GT "coefficient A, positive load alteration when AC is On for above" CURVE 0x804FD31A RB_CurveGroup_U8 15.94 q0p0625_DIV_Nm_s 0.00 15.94 FORMAT "%5.2"
 /begin AXIS_DESCR COM_AXIS PT_rTrq TransR 8 -327.6800 327.6700 FORMAT "%8.4" AXIS_PTS_REF ASDrf_rTrq_DST /end AXIS_DESCR
/end CHARACTERISTIC
/begin CHARACTERISTIC ASDrf_CoeffAGripMtModPosBlwAcOn_GT "coefficient A, positive load alteration when AC is On for below" CURVE 0x804FD322 RB_CurveGroup_U8 15.94 q0p0625_DIV_Nm_s 0.00 15.94 FORMAT "%5.2"
 /begin AXIS_DESCR COM_AXIS PT_rTrq TransR 8 -327.6800 327.6700 FORMAT "%8.4" AXIS_PTS_REF ASDrf_rTrq_DST /end AXIS_DESCR
/end CHARACTERISTIC
/begin CHARACTERISTIC ASDrf_CoeffASptMtModNegAcOn_GT "coefficient A Sport Mode negative load alteration when AC is On" CURVE 0x804FD32A RB_CurveGroup_U8 15.94 q0p0625_DIV_Nm_s 0.00 15.94 FORMAT "%5.2"
 /begin AXIS_DESCR COM_AXIS PT_rTrq TransR 8 -327.6800 327.6700 FORMAT "%8.4" AXIS_PTS_REF ASDrf_rTrq_DST /end AXIS_DESCR
/end CHARACTERISTIC
/begin CHARACTERISTIC ASDrf_CoeffASptMtModPosAbvAcOn_GT "coefficient A Sport Mode positive load alteration when AC is On for above" CURVE 0x804FD332 RB_CurveGroup_U8 15.94 q0p0625_DIV_Nm_s 0.00 15.94 FORMAT "%5.2"
 /begin AXIS_DESCR COM_AXIS PT_rTrq TransR 8 -327.6800 327.6700 FORMAT "%8.4" AXIS_PTS_REF ASDrf_rTrq_DST /end AXIS_DESCR
/end CHARACTERISTIC
/begin CHARACTERISTIC ASDrf_CoeffASptMtModPosBlwAcOn_GT "coefficient A Sport Mode positive load alteration when AC is On for below" CURVE 0x804FD33A RB_CurveGroup_U8 15.94 q0p0625_DIV_Nm_s 0.00 15.94 FORMAT "%5.2"
 /begin AXIS_DESCR COM_AXIS PT_rTrq TransR 8 -327.6800 327.6700 FORMAT "%8.4" AXIS_PTS_REF ASDrf_rTrq_DST /end AXIS_DESCR
/end CHARACTERISTIC
/begin CHARACTERISTIC ASDrf_CoeffBGripMtModNegAcOn_GM "coefficient B negative load alteration when AC is On" MAP 0x804FD342 RB_MapGroup_U8 2540. mdgrad_q10 10. 2550. FORMAT "%5.0" EXTENDED_LIMITS 0.00 2550.
 /begin AXIS_DESCR COM_AXIS ASDrf_tqCluBasc Trq 5 -3276.800 3276.700 FORMAT "%8.3" AXIS_PTS_REF ASDrf_trqClthBs_DST /end AXIS_DESCR
 /begin AXIS_DESCR COM_AXIS Epm_nEng EngN 8 -16384.00 16383.50 FORMAT "%8.2" AXIS_PTS_REF ASDrf_nEng_DST /end AXIS_DESCR
/end CHARACTERISTIC
/begin CHARACTERISTIC ASDrf_CoeffBGripMtModPosAbvAcOn_GM "coefficient B, positive load alteration when AC is On for above" MAP 0x804FD36A RB_MapGroup_U8 2540. mdgrad_q10 10. 2550. FORMAT "%5.0" EXTENDED_LIMITS 0.00 2550.
 /begin AXIS_DESCR COM_AXIS PT_rTrq TransR 8 -327.6800 327.6700 FORMAT "%8.4" AXIS_PTS_REF ASDrf_rTrq_DST /end AXIS_DESCR
 /begin AXIS_DESCR COM_AXIS Epm_nEng EngN 8 -16384.00 16383.50 FORMAT "%8.2" AXIS_PTS_REF ASDrf_nEng_DST /end AXIS_DESCR
/end CHARACTERISTIC
/begin CHARACTERISTIC ASDrf_CoeffBGripMtModPosBlwAcOn_GM "coefficient B, positive load alteration when AC is On for below" MAP 0x804FD3AA RB_MapGroup_U8 2550. mdgrad_q10 0.00 2550. FORMAT "%5.0"
 /begin AXIS_DESCR COM_AXIS PT_rTrq TransR 8 -327.6800 327.6700 FORMAT "%8.4" AXIS_PTS_REF ASDrf_rTrq_DST /end AXIS_DESCR
 /begin AXIS_DESCR COM_AXIS Epm_nEng EngN 8 -16384.00 16383.50 FORMAT "%8.2" AXIS_PTS_REF ASDrf_nEng_DST /end AXIS_DESCR
/end CHARACTERISTIC
/begin CHARACTERISTIC ASDrf_CoeffBSptMtModNegAcOn_GM "coefficient B Sport Mode negative load alteration when AC is On" MAP 0x804FD3EA RB_MapGroup_U8 2540. mdgrad_q10 10. 2550. FORMAT "%5.0" EXTENDED_LIMITS 0.00 2550.
 /begin AXIS_DESCR COM_AXIS ASDrf_tqCluBasc Trq 5 -3276.800 3276.700 FORMAT "%8.3" AXIS_PTS_REF ASDrf_trqClthBs_DST /end AXIS_DESCR
 /begin AXIS_DESCR COM_AXIS Epm_nEng EngN 8 -16384.00 16383.50 FORMAT "%8.2" AXIS_PTS_REF ASDrf_nEng_DST /end AXIS_DESCR
/end CHARACTERISTIC
/begin CHARACTERISTIC ASDrf_CoeffBSptMtModPosAbvAcOn_GM "coefficient B Sport Mode positive load alteration when AC is On for above" MAP 0x804FD412 RB_MapGroup_U8 2540. mdgrad_q10 10. 2550. FORMAT "%5.0" EXTENDED_LIMITS 0.00 2550.
 /begin AXIS_DESCR COM_AXIS PT_rTrq TransR 8 -327.6800 327.6700 FORMAT "%8.4" AXIS_PTS_REF ASDrf_rTrq_DST /end AXIS_DESCR
 /begin AXIS_DESCR COM_AXIS Epm_nEng EngN 8 -16384.00 16383.50 FORMAT "%8.2" AXIS_PTS_REF ASDrf_nEng_DST /end AXIS_DESCR
/end CHARACTERISTIC
/begin CHARACTERISTIC ASDrf_CoeffBSptMtModPosBlwAcOn_GM "coefficient B Sport Mode positive load alteration when AC is On for below" MAP 0x804FD452 RB_MapGroup_U8 2550. mdgrad_q10 0.00 2550. FORMAT "%5.0"
 /begin AXIS_DESCR COM_AXIS PT_rTrq TransR 8 -327.6800 327.6700 FORMAT "%8.4" AXIS_PTS_REF ASDrf_rTrq_DST /end AXIS_DESCR
 /begin AXIS_DESCR COM_AXIS Epm_nEng EngN 8 -16384.00 16383.50 FORMAT "%8.2" AXIS_PTS_REF ASDrf_nEng_DST /end AXIS_DESCR
/end CHARACTERISTIC
/begin AXIS_PTS ASDrf_dnEngFlt_DST "gradient of engine speed" 0x804FD492 Epm_dnEngFlt RB_Axis_S16 32767.50 EngNGrd 6 -16384.00 16383.50 FORMAT "%8.2" DEPOSIT ABSOLUTE /end AXIS_PTS
/begin CHARACTERISTIC ASDrf_facCoefAGripAirCdnrOnNeg_GT "weighting factor for Coef A engine temperature dependent for AC on" CURVE 0x804FD4A0 RB_CurveGroup_U8 1.992188 fak_ub_b2 0.00 1.992188 FORMAT "%8.6"
 /begin AXIS_DESCR COM_AXIS EngDa_tEng Temp_Cels 6 -3549.940 3003.560 FORMAT "%8.3" AXIS_PTS_REF ASDrf_tEng_DST /end AXIS_DESCR
/end CHARACTERISTIC
/begin CHARACTERISTIC ASDrf_facCoefAGripNeg_GT "weighting factor for Coef A engine temperature dependent" CURVE 0x804FD4A6 RB_CurveGroup_U8 1.992188 fak_ub_b2 0.00 1.992188 FORMAT "%8.6"
 /begin AXIS_DESCR COM_AXIS EngDa_tEng Temp_Cels 6 -3549.940 3003.560 FORMAT "%8.3" AXIS_PTS_REF ASDrf_tEng_DST /end AXIS_DESCR
/end CHARACTERISTIC
/begin CHARACTERISTIC ASDrf_facCoefAMtModPosAbv_GT "weighting for CoefA, manual transmission mode, pos" CURVE 0x804FD4AC RB_CurveGroup_U8 1.000000 fak_ub_b2 0.00 1.000000 FORMAT "%8.6" EXTENDED_LIMITS 0.00 1.992188
 /begin AXIS_DESCR COM_AXIS ASDrf_facDesDyn Fact 10 -4.000000 3.999878 FORMAT "%8.6" AXIS_PTS_REF ASDrf_facDesDyn_DST /end AXIS_DESCR
/end CHARACTERISTIC
/begin CHARACTERISTIC ASDrf_facCoefAPosAbvAcOn_GCUR "weighting for CoefA during AC On" CURVE 0x804FD4B6 RB_CurveGroup_U8 1.000000 fak_ub_b2 0.00 1.000000 FORMAT "%8.6" EXTENDED_LIMITS 0.00 1.992188
 /begin AXIS_DESCR COM_AXIS ASDrf_facDesDyn Fact 10 -4.000000 3.999878 FORMAT "%8.6" AXIS_PTS_REF ASDrf_facDesDyn_DST /end AXIS_DESCR
/end CHARACTERISTIC
/begin CHARACTERISTIC ASDrf_facCoefAPosAbv_GCUR "weighting for CoefA" CURVE 0x804FD4C0 RB_CurveGroup_U8 1.000000 fak_ub_b2 0.00 1.000000 FORMAT "%8.6" EXTENDED_LIMITS 0.00 1.992188
 /begin AXIS_DESCR COM_AXIS ASDrf_facDesDyn Fact 10 -4.000000 3.999878 FORMAT "%8.6" AXIS_PTS_REF ASDrf_facDesDyn_DST /end AXIS_DESCR
/end CHARACTERISTIC
/begin CHARACTERISTIC ASDrf_facCoefASprtMtModPosAbv_GT "weighting for CoefA Sport, Manual transmission mode" CURVE 0x804FD4CA RB_CurveGroup_U8 1.000000 fak_ub_b2 0.00 1.000000 FORMAT "%8.6" EXTENDED_LIMITS 0.00 1.992188
 /begin AXIS_DESCR COM_AXIS ASDrf_facDesDyn Fact 10 -4.000000 3.999878 FORMAT "%8.6" AXIS_PTS_REF ASDrf_facDesDyn_DST /end AXIS_DESCR
/end CHARACTERISTIC
/begin CHARACTERISTIC ASDrf_facCoefASprtPosAbvAcOn_GT "weighting for CoefA Sport with AC on" CURVE 0x804FD4D4 RB_CurveGroup_U8 1.000000 fak_ub_b2 0.00 1.000000 FORMAT "%8.6" EXTENDED_LIMITS 0.00 1.992188
 /begin AXIS_DESCR COM_AXIS ASDrf_facDesDyn Fact 10 -4.000000 3.999878 FORMAT "%8.6" AXIS_PTS_REF ASDrf_facDesDyn_DST /end AXIS_DESCR
/end CHARACTERISTIC
/begin CHARACTERISTIC ASDrf_facCoefASprtPosAbv_GT "weighting for CoefA Sport" CURVE 0x804FD4DE RB_CurveGroup_U8 1.000000 fak_ub_b2 0.00 1.000000 FORMAT "%8.6" EXTENDED_LIMITS 0.00 1.992188
 /begin AXIS_DESCR COM_AXIS ASDrf_facDesDyn Fact 10 -4.000000 3.999878 FORMAT "%8.6" AXIS_PTS_REF ASDrf_facDesDyn_DST /end AXIS_DESCR
/end CHARACTERISTIC
/begin CHARACTERISTIC ASDrf_facCoefBAirCdnrOnNeg_GT "weighting factor for Coef B for AC on" CURVE 0x804FD4E8 RB_CurveGroup_U8 7.969 fak_ub_b8 0.00 7.969 FORMAT "%5.3"
 /begin AXIS_DESCR COM_AXIS PT_rTrq TransR 8 -327.6800 327.6700 FORMAT "%8.4" AXIS_PTS_REF ASDrf_rTrq_DST /end AXIS_DESCR
/end CHARACTERISTIC
/begin CHARACTERISTIC ASDrf_facCoefBGripAirCdnrOnNeg_GT "weighting factor for Coef B engine temperature dependent for AC on" CURVE 0x804FD4F0 RB_CurveGroup_U8 1.992188 fak_ub_b2 0.00 1.992188 FORMAT "%8.6"
 /begin AXIS_DESCR COM_AXIS EngDa_tEng Temp_Cels 6 -3549.940 3003.560 FORMAT "%8.3" AXIS_PTS_REF ASDrf_tEng_DST /end AXIS_DESCR
/end CHARACTERISTIC
/begin CHARACTERISTIC ASDrf_facCoefBGripNeg_GT "weighting factor for Coef B engine temperature dependent" CURVE 0x804FD4F6 RB_CurveGroup_U8 1.992188 fak_ub_b2 0.00 1.992188 FORMAT "%8.6"
 /begin AXIS_DESCR COM_AXIS EngDa_tEng Temp_Cels 6 -3549.940 3003.560 FORMAT "%8.3" AXIS_PTS_REF ASDrf_tEng_DST /end AXIS_DESCR
/end CHARACTERISTIC
/begin CHARACTERISTIC ASDrf_facCoefBMtModNeg_GT "weighting factor Coef B, manual transmission mode, neg" CURVE 0x804FD4FC RB_CurveGroup_U8 7.969 fak_ub_b8 0.00 7.969 FORMAT "%5.3"
 /begin AXIS_DESCR COM_AXIS PT_rTrq TransR 8 -327.6800 327.6700 FORMAT "%8.4" AXIS_PTS_REF ASDrf_rTrq_DST /end AXIS_DESCR
/end CHARACTERISTIC
/begin CHARACTERISTIC ASDrf_facCoefBMtModPosAbv_GM "weighting factor Coef B, manual transmission mode, pos. load alteration damping" MAP 0x804FD504 RB_MapGroup_U8 1.000000 fak_ub_b2 0.00 1.000000 FORMAT "%8.6" EXTENDED_LIMITS 0.00 1.992188
 /begin AXIS_DESCR COM_AXIS ASDrf_facDesDyn Fact 10 -4.000000 3.999878 FORMAT "%8.6" AXIS_PTS_REF ASDrf_facDesDyn_DST /end AXIS_DESCR
 /begin AXIS_DESCR COM_AXIS Epm_nEng EngN 8 -16384.00 16383.50 FORMAT "%8.2" AXIS_PTS_REF ASDrf_nEng_DST /end AXIS_DESCR
/end CHARACTERISTIC
/begin CHARACTERISTIC ASDrf_facCoefBMtModPosBlw_GM "weighting factor Coef B, manual transmission mode, pos. load alteration damping" MAP 0x804FD554 RB_MapGroup_U8 1.000000 fak_ub_b2 0.00 1.000000 FORMAT "%8.6" EXTENDED_LIMITS 0.00 1.992188
 /begin AXIS_DESCR COM_AXIS ASDrf_facDesDyn Fact 10 -4.000000 3.999878 FORMAT "%8.6" AXIS_PTS_REF ASDrf_facDesDyn_DST /end AXIS_DESCR
 /begin AXIS_DESCR COM_AXIS Epm_nEng EngN 8 -16384.00 16383.50 FORMAT "%8.2" AXIS_PTS_REF ASDrf_nEng_DST /end AXIS_DESCR
/end CHARACTERISTIC
/begin CHARACTERISTIC ASDrf_facCoefBNeg_GCUR "weighting factor for Coef B" CURVE 0x804FD5A4 RB_CurveGroup_U8 7.969 fak_ub_b8 0.00 7.969 FORMAT "%5.3"
 /begin AXIS_DESCR COM_AXIS PT_rTrq TransR 8 -327.6800 327.6700 FORMAT "%8.4" AXIS_PTS_REF ASDrf_rTrq_DST /end AXIS_DESCR
/end CHARACTERISTIC
/begin CHARACTERISTIC ASDrf_facCoefBPosAbvAcOn_GMAP "weighting factor Coef B, pos. load alteration damping during AC On" MAP 0x804FD5AC RB_MapGroup_U8 1.000000 fak_ub_b2 0.00 1.000000 FORMAT "%8.6" EXTENDED_LIMITS 0.00 1.992188
 /begin AXIS_DESCR COM_AXIS ASDrf_facDesDyn Fact 10 -4.000000 3.999878 FORMAT "%8.6" AXIS_PTS_REF ASDrf_facDesDyn_DST /end AXIS_DESCR
 /begin AXIS_DESCR COM_AXIS Epm_nEng EngN 8 -16384.00 16383.50 FORMAT "%8.2" AXIS_PTS_REF ASDrf_nEng_DST /end AXIS_DESCR
/end CHARACTERISTIC
/begin CHARACTERISTIC ASDrf_facCoefBPosAbv_GMAP "weighting factor Coef B, pos. load alteration damping" MAP 0x804FD5FC RB_MapGroup_U8 1.000000 fak_ub_b2 0.00 1.000000 FORMAT "%8.6" EXTENDED_LIMITS 0.00 1.992188
 /begin AXIS_DESCR COM_AXIS ASDrf_facDesDyn Fact 10 -4.000000 3.999878 FORMAT "%8.6" AXIS_PTS_REF ASDrf_facDesDyn_DST /end AXIS_DESCR
 /begin AXIS_DESCR COM_AXIS ASDrf_nPt EngN 8 -16384.00 16383.50 FORMAT "%8.2" AXIS_PTS_REF ASDrf_nPt_DST /end AXIS_DESCR
/end CHARACTERISTIC
/begin CHARACTERISTIC ASDrf_facCoefBPosBlwAcOn_GMAP "weighting factor Coef B, pos. load alteration damping during AC On" MAP 0x804FD64C RB_MapGroup_U8 1.000000 fak_ub_b2 0.00 1.000000 FORMAT "%8.6" EXTENDED_LIMITS 0.00 1.992188
 /begin AXIS_DESCR COM_AXIS ASDrf_facDesDyn Fact 10 -4.000000 3.999878 FORMAT "%8.6" AXIS_PTS_REF ASDrf_facDesDyn_DST /end AXIS_DESCR
 /begin AXIS_DESCR COM_AXIS Epm_nEng EngN 8 -16384.00 16383.50 FORMAT "%8.2" AXIS_PTS_REF ASDrf_nEng_DST /end AXIS_DESCR
/end CHARACTERISTIC
/begin CHARACTERISTIC ASDrf_facCoefBPosBlw_GMAP "weighting factor Coef B, pos. load alteration damping" MAP 0x804FD69C RB_MapGroup_U8 1.000000 fak_ub_b2 0.00 1.000000 FORMAT "%8.6" EXTENDED_LIMITS 0.00 1.992188
 /begin AXIS_DESCR COM_AXIS ASDrf_facDesDyn Fact 10 -4.000000 3.999878 FORMAT "%8.6" AXIS_PTS_REF ASDrf_facDesDyn_DST /end AXIS_DESCR
 /begin AXIS_DESCR COM_AXIS ASDrf_nPt EngN 8 -16384.00 16383.50 FORMAT "%8.2" AXIS_PTS_REF ASDrf_nPt_DST /end AXIS_DESCR
/end CHARACTERISTIC
/begin CHARACTERISTIC ASDrf_facCoefBSprtMtModNeg_GT "weighting factor for Coef B Sport, Manual transmission mode" CURVE 0x804FD6EC RB_CurveGroup_U8 7.969 fak_ub_b8 0.00 7.969 FORMAT "%5.3"
 /begin AXIS_DESCR COM_AXIS PT_rTrq TransR 8 -327.6800 327.6700 FORMAT "%8.4" AXIS_PTS_REF ASDrf_rTrq_DST /end AXIS_DESCR
/end CHARACTERISTIC
/begin CHARACTERISTIC ASDrf_facCoefBSprtMtModPosAbv_GM "weighting factor Coef B, Sport, Manual transmission mode, pos. load alteration damping" MAP 0x804FD6F4 RB_MapGroup_U8 1.000000 fak_ub_b2 0.00 1.000000 FORMAT "%8.6" EXTENDED_LIMITS 0.00 1.992188
 /begin AXIS_DESCR COM_AXIS ASDrf_facDesDyn Fact 10 -4.000000 3.999878 FORMAT "%8.6" AXIS_PTS_REF ASDrf_facDesDyn_DST /end AXIS_DESCR
 /begin AXIS_DESCR COM_AXIS Epm_nEng EngN 8 -16384.00 16383.50 FORMAT "%8.2" AXIS_PTS_REF ASDrf_nEng_DST /end AXIS_DESCR
/end CHARACTERISTIC
/begin CHARACTERISTIC ASDrf_facCoefBSprtMtModPosBlw_GM "weighting factor Coef B, Sport, Manual transmission mode, pos. load alteration damping" MAP 0x804FD744 RB_MapGroup_U8 1.000000 fak_ub_b2 0.00 1.000000 FORMAT "%8.6" EXTENDED_LIMITS 0.00 1.992188
 /begin AXIS_DESCR COM_AXIS ASDrf_facDesDyn Fact 10 -4.000000 3.999878 FORMAT "%8.6" AXIS_PTS_REF ASDrf_facDesDyn_DST /end AXIS_DESCR
 /begin AXIS_DESCR COM_AXIS Epm_nEng EngN 8 -16384.00 16383.50 FORMAT "%8.2" AXIS_PTS_REF ASDrf_nEng_DST /end AXIS_DESCR
/end CHARACTERISTIC
/begin CHARACTERISTIC ASDrf_facCoefBSprtNegAcOn_GT "weighting factor for Coef B Sport with AC on" CURVE 0x804FD794 RB_CurveGroup_U8 7.969 fak_ub_b8 0.00 7.969 FORMAT "%5.3"
 /begin AXIS_DESCR COM_AXIS PT_rTrq TransR 8 -327.6800 327.6700 FORMAT "%8.4" AXIS_PTS_REF ASDrf_rTrq_DST /end AXIS_DESCR
/end CHARACTERISTIC
/begin CHARACTERISTIC ASDrf_facCoefBSprtNeg_GT "weighting factor for Coef B Sport" CURVE 0x804FD79C RB_CurveGroup_U8 7.969 fak_ub_b8 0.00 7.969 FORMAT "%5.3"
 /begin AXIS_DESCR COM_AXIS PT_rTrq TransR 8 -327.6800 327.6700 FORMAT "%8.4" AXIS_PTS_REF ASDrf_rTrq_DST /end AXIS_DESCR
/end CHARACTERISTIC
/begin CHARACTERISTIC ASDrf_facCoefBSprtPosAbvAcOn_GM "weighting factor Coef B, Sport, pos. load alteration damping with AC on" MAP 0x804FD7A4 RB_MapGroup_U8 1.000000 fak_ub_b2 0.00 1.000000 FORMAT "%8.6" EXTENDED_LIMITS 0.00 1.992188
 /begin AXIS_DESCR COM_AXIS ASDrf_facDesDyn Fact 10 -4.000000 3.999878 FORMAT "%8.6" AXIS_PTS_REF ASDrf_facDesDyn_DST /end AXIS_DESCR
 /begin AXIS_DESCR COM_AXIS Epm_nEng EngN 8 -16384.00 16383.50 FORMAT "%8.2" AXIS_PTS_REF ASDrf_nEng_DST /end AXIS_DESCR
/end CHARACTERISTIC
/begin CHARACTERISTIC ASDrf_facCoefBSprtPosAbv_GM "weighting factor Coef B, Sport, pos. load alteration damping" MAP 0x804FD7F4 RB_MapGroup_U8 1.000000 fak_ub_b2 0.00 1.000000 FORMAT "%8.6" EXTENDED_LIMITS 0.00 1.992188
 /begin AXIS_DESCR COM_AXIS ASDrf_facDesDyn Fact 10 -4.000000 3.999878 FORMAT "%8.6" AXIS_PTS_REF ASDrf_facDesDyn_DST /end AXIS_DESCR
 /begin AXIS_DESCR COM_AXIS Epm_nEng EngN 8 -16384.00 16383.50 FORMAT "%8.2" AXIS_PTS_REF ASDrf_nEng_DST /end AXIS_DESCR
/end CHARACTERISTIC
/begin CHARACTERISTIC ASDrf_facCoefBSprtPosBlwAcOn_GM "weighting factor Coef B, Sport, pos. load alteration damping with AC on" MAP 0x804FD844 RB_MapGroup_U8 1.000000 fak_ub_b2 0.00 1.000000 FORMAT "%8.6" EXTENDED_LIMITS 0.00 1.992188
 /begin AXIS_DESCR COM_AXIS ASDrf_facDesDyn Fact 10 -4.000000 3.999878 FORMAT "%8.6" AXIS_PTS_REF ASDrf_facDesDyn_DST /end AXIS_DESCR
 /begin AXIS_DESCR COM_AXIS Epm_nEng EngN 8 -16384.00 16383.50 FORMAT "%8.2" AXIS_PTS_REF ASDrf_nEng_DST /end AXIS_DESCR
/end CHARACTERISTIC
/begin CHARACTERISTIC ASDrf_facCoefBSprtPosBlw_GM "weighting factor Coef B, Sport, pos. load alteration damping" MAP 0x804FD894 RB_MapGroup_U8 1.000000 fak_ub_b2 0.00 1.000000 FORMAT "%8.6" EXTENDED_LIMITS 0.00 1.992188
 /begin AXIS_DESCR COM_AXIS ASDrf_facDesDyn Fact 10 -4.000000 3.999878 FORMAT "%8.6" AXIS_PTS_REF ASDrf_facDesDyn_DST /end AXIS_DESCR
 /begin AXIS_DESCR COM_AXIS Epm_nEng EngN 8 -16384.00 16383.50 FORMAT "%8.2" AXIS_PTS_REF ASDrf_nEng_DST /end AXIS_DESCR
/end CHARACTERISTIC
/begin CHARACTERISTIC ASDrf_facCoeffAMtModPosAbvAcOn_GT "weighting factor for coefficient A, positive load alteration when AC is On for above" CURVE 0x804FD8E4 RB_CurveGroup_U8 1.000000 fak_ub_b2 0.00 1.000000 FORMAT "%8.6" EXTENDED_LIMITS 0.00 1.992188
 /begin AXIS_DESCR COM_AXIS ASDrf_facDesDyn Fact 10 -4.000000 3.999878 FORMAT "%8.6" AXIS_PTS_REF ASDrf_facDesDyn_DST /end AXIS_DESCR
/end CHARACTERISTIC
/begin CHARACTERISTIC ASDrf_facCoeffASptMtModPosAbvAcOn_GT "weighting factor for coefficient A, Sport mode positive load alteration when AC isOn for above" CURVE 0x804FD8EE RB_CurveGroup_U8 1.000000 fak_ub_b2 0.00 1.000000 FORMAT "%8.6" EXTENDED_LIMITS 0.00 1.992188
 /begin AXIS_DESCR COM_AXIS ASDrf_facDesDyn Fact 10 -4.000000 3.999878 FORMAT "%8.6" AXIS_PTS_REF ASDrf_facDesDyn_DST /end AXIS_DESCR
/end CHARACTERISTIC
/begin CHARACTERISTIC ASDrf_facCoeffBMtModNegAcOn_GT "weighting factor for coefficient B, negative load alteration when AC is On" CURVE 0x804FD8F8 RB_CurveGroup_U8 7.969 fak_ub_b8 0.00 7.969 FORMAT "%5.3"
 /begin AXIS_DESCR COM_AXIS PT_rTrq TransR 8 -327.6800 327.6700 FORMAT "%8.4" AXIS_PTS_REF ASDrf_rTrq_DST /end AXIS_DESCR
/end CHARACTERISTIC
/begin CHARACTERISTIC ASDrf_facCoeffBMtModPosAbvAcOn_GM "weighting factor for coefficient B, positive load alteration when AC is On for above" MAP 0x804FD900 RB_MapGroup_U8 1.000000 fak_ub_b2 0.00 1.000000 FORMAT "%8.6" EXTENDED_LIMITS 0.00 1.992188
 /begin AXIS_DESCR COM_AXIS ASDrf_facDesDyn Fact 10 -4.000000 3.999878 FORMAT "%8.6" AXIS_PTS_REF ASDrf_facDesDyn_DST /end AXIS_DESCR
 /begin AXIS_DESCR COM_AXIS Epm_nEng EngN 8 -16384.00 16383.50 FORMAT "%8.2" AXIS_PTS_REF ASDrf_nEng_DST /end AXIS_DESCR
/end CHARACTERISTIC
/begin CHARACTERISTIC ASDrf_facCoeffBMtModPosBlwAcOn_GM "weighting factor for coefficient B, positive load alteration when AC is On for below" MAP 0x804FD950 RB_MapGroup_U8 1.000000 fak_ub_b2 0.00 1.000000 FORMAT "%8.6" EXTENDED_LIMITS 0.00 1.992188
 /begin AXIS_DESCR COM_AXIS ASDrf_facDesDyn Fact 10 -4.000000 3.999878 FORMAT "%8.6" AXIS_PTS_REF ASDrf_facDesDyn_DST /end AXIS_DESCR
 /begin AXIS_DESCR COM_AXIS Epm_nEng EngN 8 -16384.00 16383.50 FORMAT "%8.2" AXIS_PTS_REF ASDrf_nEng_DST /end AXIS_DESCR
/end CHARACTERISTIC
/begin CHARACTERISTIC ASDrf_facCoeffBSptMtModNegAcOn_GT "weighting factor for coefficient B, sport mode negative load alteration when AC is On" CURVE 0x804FD9A0 RB_CurveGroup_U8 7.969 fak_ub_b8 0.00 7.969 FORMAT "%5.3"
 /begin AXIS_DESCR COM_AXIS PT_rTrq TransR 8 -327.6800 327.6700 FORMAT "%8.4" AXIS_PTS_REF ASDrf_rTrq_DST /end AXIS_DESCR
/end CHARACTERISTIC
/begin CHARACTERISTIC ASDrf_facCoeffBSptMtModPosAbvAcOn_GM "weighting factor for coefficient B, sport mode positive load alteration when AC is On for above" MAP 0x804FD9A8 RB_MapGroup_U8 1.000000 fak_ub_b2 0.00 1.000000 FORMAT "%8.6" EXTENDED_LIMITS 0.00 1.992188
 /begin AXIS_DESCR COM_AXIS ASDrf_facDesDyn Fact 10 -4.000000 3.999878 FORMAT "%8.6" AXIS_PTS_REF ASDrf_facDesDyn_DST /end AXIS_DESCR
 /begin AXIS_DESCR COM_AXIS Epm_nEng EngN 8 -16384.00 16383.50 FORMAT "%8.2" AXIS_PTS_REF ASDrf_nEng_DST /end AXIS_DESCR
/end CHARACTERISTIC
/begin CHARACTERISTIC ASDrf_facCoeffBSptMtModPosBlwAcOn_GM "weighting factor for coefficient B, sport mode positive load alteration when AC is On for below" MAP 0x804FD9F8 RB_MapGroup_U8 1.000000 fak_ub_b2 0.00 1.000000 FORMAT "%8.6" EXTENDED_LIMITS 0.00 1.992188
 /begin AXIS_DESCR COM_AXIS ASDrf_facDesDyn Fact 10 -4.000000 3.999878 FORMAT "%8.6" AXIS_PTS_REF ASDrf_facDesDyn_DST /end AXIS_DESCR
 /begin AXIS_DESCR COM_AXIS Epm_nEng EngN 8 -16384.00 16383.50 FORMAT "%8.2" AXIS_PTS_REF ASDrf_nEng_DST /end AXIS_DESCR
/end CHARACTERISTIC
/begin AXIS_PTS ASDrf_facDesDyn_DST "driveability factor" 0x804FDA48 ASDrf_facDesDyn RB_Axis_S16 7.999878 Fact 10 -4.000000 3.999878 FORMAT "%8.6" DEPOSIT ABSOLUTE /end AXIS_PTS
/begin CHARACTERISTIC ASDrf_facTiAirCdnrOnNeg_GT "weighting factor time constant, negative load alteration damping for AC on" CURVE 0x804FDA5E RB_CurveGroup_U8 7.969 fak_ub_b8 0.00 7.969 FORMAT "%5.3"
 /begin AXIS_DESCR COM_AXIS PT_rTrq TransR 8 -327.6800 327.6700 FORMAT "%8.4" AXIS_PTS_REF ASDrf_rTrq_DST /end AXIS_DESCR
/end CHARACTERISTIC
/begin CHARACTERISTIC ASDrf_facTiFltSetGripAirCdnrOnNeg_GT "weighting factor time constant engine temperature dependent for AC on" CURVE 0x804FDA66 RB_CurveGroup_U8 1.992188 fak_ub_b2 0.00 1.992188 FORMAT "%8.6"
 /begin AXIS_DESCR COM_AXIS EngDa_tEng Temp_Cels 6 -3549.940 3003.560 FORMAT "%8.3" AXIS_PTS_REF ASDrf_tEng_DST /end AXIS_DESCR
/end CHARACTERISTIC
/begin CHARACTERISTIC ASDrf_facTiFltSetGripNeg_GT "weighting factor time constant engine temperature dependent" CURVE 0x804FDA6C RB_CurveGroup_U8 1.992188 fak_ub_b2 0.00 1.992188 FORMAT "%8.6"
 /begin AXIS_DESCR COM_AXIS EngDa_tEng Temp_Cels 6 -3549.940 3003.560 FORMAT "%8.3" AXIS_PTS_REF ASDrf_tEng_DST /end AXIS_DESCR
/end CHARACTERISTIC
/begin CHARACTERISTIC ASDrf_facTiMtModNegAcOn_GT "time constant, negative load alteration when AC is On" CURVE 0x804FDA72 RB_CurveGroup_U8 7.969 fak_ub_b8 0.00 7.969 FORMAT "%5.3"
 /begin AXIS_DESCR COM_AXIS PT_rTrq TransR 8 -327.6800 327.6700 FORMAT "%8.4" AXIS_PTS_REF ASDrf_rTrq_DST /end AXIS_DESCR
/end CHARACTERISTIC
/begin CHARACTERISTIC ASDrf_facTiMtModNeg_GT "weighting factor time constant manual transmission mode neg." CURVE 0x804FDA7A RB_CurveGroup_U8 7.969 fak_ub_b8 0.00 7.969 FORMAT "%5.3"
 /begin AXIS_DESCR COM_AXIS PT_rTrq TransR 8 -327.6800 327.6700 FORMAT "%8.4" AXIS_PTS_REF ASDrf_rTrq_DST /end AXIS_DESCR
/end CHARACTERISTIC
/begin CHARACTERISTIC ASDrf_facTiMtModPosAbvAcOn_GM "time constant, positive load alteration when AC is On for above" MAP 0x804FDA82 RB_MapGroup_U8 14.94 fak_ub_b16 1.00 15.94 FORMAT "%5.2" EXTENDED_LIMITS 0.00 15.94
 /begin AXIS_DESCR COM_AXIS ASDrf_facDesDyn Fact 10 -4.000000 3.999878 FORMAT "%8.6" AXIS_PTS_REF ASDrf_facDesDyn_DST /end AXIS_DESCR
 /begin AXIS_DESCR COM_AXIS Epm_nEng EngN 8 -16384.00 16383.50 FORMAT "%8.2" AXIS_PTS_REF ASDrf_nEng_DST /end AXIS_DESCR
/end CHARACTERISTIC
/begin CHARACTERISTIC ASDrf_facTiMtModPosAbv_GM "weighting factor time constant, manual transmission mode, pos. load alteration damping" MAP 0x804FDAD2 RB_MapGroup_U8 14.94 fak_ub_b16 1.00 15.94 FORMAT "%5.2" EXTENDED_LIMITS 0.00 15.94
 /begin AXIS_DESCR COM_AXIS ASDrf_facDesDyn Fact 10 -4.000000 3.999878 FORMAT "%8.6" AXIS_PTS_REF ASDrf_facDesDyn_DST /end AXIS_DESCR
 /begin AXIS_DESCR COM_AXIS Epm_nEng EngN 8 -16384.00 16383.50 FORMAT "%8.2" AXIS_PTS_REF ASDrf_nEng_DST /end AXIS_DESCR
/end CHARACTERISTIC
/begin CHARACTERISTIC ASDrf_facTiMtModPosBlwAcOn_GM "time constant, positive load alteration when AC is On for below" MAP 0x804FDB22 RB_MapGroup_U8 14.94 fak_ub_b16 1.00 15.94 FORMAT "%5.2" EXTENDED_LIMITS 0.00 15.94
 /begin AXIS_DESCR COM_AXIS ASDrf_facDesDyn Fact 10 -4.000000 3.999878 FORMAT "%8.6" AXIS_PTS_REF ASDrf_facDesDyn_DST /end AXIS_DESCR
 /begin AXIS_DESCR COM_AXIS Epm_nEng EngN 8 -16384.00 16383.50 FORMAT "%8.2" AXIS_PTS_REF ASDrf_nEng_DST /end AXIS_DESCR
/end CHARACTERISTIC
/begin CHARACTERISTIC ASDrf_facTiMtModPosBlw_GM "weighting factor time constant, manual transmission mode, pos. load alteration damping" MAP 0x804FDB72 RB_MapGroup_U8 14.94 fak_ub_b16 1.00 15.94 FORMAT "%5.2" EXTENDED_LIMITS 0.00 15.94
 /begin AXIS_DESCR COM_AXIS ASDrf_facDesDyn Fact 10 -4.000000 3.999878 FORMAT "%8.6" AXIS_PTS_REF ASDrf_facDesDyn_DST /end AXIS_DESCR
 /begin AXIS_DESCR COM_AXIS Epm_nEng EngN 8 -16384.00 16383.50 FORMAT "%8.2" AXIS_PTS_REF ASDrf_nEng_DST /end AXIS_DESCR
/end CHARACTERISTIC
/begin CHARACTERISTIC ASDrf_facTiNeg_GCUR "weighting factor time constant, negative load alteration damping" CURVE 0x804FDBC2 RB_CurveGroup_U8 7.969 fak_ub_b8 0.00 7.969 FORMAT "%5.3"
 /begin AXIS_DESCR COM_AXIS PT_rTrq TransR 8 -327.6800 327.6700 FORMAT "%8.4" AXIS_PTS_REF ASDrf_rTrq_DST /end AXIS_DESCR
/end CHARACTERISTIC
/begin CHARACTERISTIC ASDrf_facTiPosAbvAcOn_GMAP "weighting factor time constant pos. load alteration damping during AC On" MAP 0x804FDBCA RB_MapGroup_U8 14.94 fak_ub_b16 1.00 15.94 FORMAT "%5.2" EXTENDED_LIMITS 0.00 15.94
 /begin AXIS_DESCR COM_AXIS ASDrf_facDesDyn Fact 10 -4.000000 3.999878 FORMAT "%8.6" AXIS_PTS_REF ASDrf_facDesDyn_DST /end AXIS_DESCR
 /begin AXIS_DESCR COM_AXIS Epm_nEng EngN 8 -16384.00 16383.50 FORMAT "%8.2" AXIS_PTS_REF ASDrf_nEng_DST /end AXIS_DESCR
/end CHARACTERISTIC
/begin CHARACTERISTIC ASDrf_facTiPosAbv_GMAP "weighting factor time constant pos. load alteration damping" MAP 0x804FDC1A RB_MapGroup_U8 14.94 fak_ub_b16 1.00 15.94 FORMAT "%5.2" EXTENDED_LIMITS 0.00 15.94
 /begin AXIS_DESCR COM_AXIS ASDrf_facDesDyn Fact 10 -4.000000 3.999878 FORMAT "%8.6" AXIS_PTS_REF ASDrf_facDesDyn_DST /end AXIS_DESCR
 /begin AXIS_DESCR COM_AXIS ASDrf_nPt EngN 8 -16384.00 16383.50 FORMAT "%8.2" AXIS_PTS_REF ASDrf_nPt_DST /end AXIS_DESCR
/end CHARACTERISTIC
/begin CHARACTERISTIC ASDrf_facTiPosBlwAcOn_GMAP "weighting factor time constant pos. load alteration damping during AC On" MAP 0x804FDC6A RB_MapGroup_U8 14.94 fak_ub_b16 1.00 15.94 FORMAT "%5.2" EXTENDED_LIMITS 0.00 15.94
 /begin AXIS_DESCR COM_AXIS ASDrf_facDesDyn Fact 10 -4.000000 3.999878 FORMAT "%8.6" AXIS_PTS_REF ASDrf_facDesDyn_DST /end AXIS_DESCR
 /begin AXIS_DESCR COM_AXIS Epm_nEng EngN 8 -16384.00 16383.50 FORMAT "%8.2" AXIS_PTS_REF ASDrf_nEng_DST /end AXIS_DESCR
/end CHARACTERISTIC
/begin CHARACTERISTIC ASDrf_facTiPosBlw_GMAP "weighting factor time constant pos. load alteration damping" MAP 0x804FDCBA RB_MapGroup_U8 14.94 fak_ub_b16 1.00 15.94 FORMAT "%5.2" EXTENDED_LIMITS 0.00 15.94
 /begin AXIS_DESCR COM_AXIS ASDrf_facDesDyn Fact 10 -4.000000 3.999878 FORMAT "%8.6" AXIS_PTS_REF ASDrf_facDesDyn_DST /end AXIS_DESCR
 /begin AXIS_DESCR COM_AXIS ASDrf_nPt EngN 8 -16384.00 16383.50 FORMAT "%8.2" AXIS_PTS_REF ASDrf_nPt_DST /end AXIS_DESCR
/end CHARACTERISTIC
/begin CHARACTERISTIC ASDrf_facTiSprtMtModNeg_GT "weighting factor time constant, Sport, Manual transmission mode, negative load alteration damping" CURVE 0x804FDD0A RB_CurveGroup_U8 7.969 fak_ub_b8 0.00 7.969 FORMAT "%5.3"
 /begin AXIS_DESCR COM_AXIS PT_rTrq TransR 8 -327.6800 327.6700 FORMAT "%8.4" AXIS_PTS_REF ASDrf_rTrq_DST /end AXIS_DESCR
/end CHARACTERISTIC
/begin CHARACTERISTIC ASDrf_facTiSprtMtModPosAbv_GM "weighting factor time constant, Sport, Manual transmission mode, pos. load alteration damping" MAP 0x804FDD12 RB_MapGroup_U8 14.94 fak_ub_b16 1.00 15.94 FORMAT "%5.2" EXTENDED_LIMITS 0.00 15.94
 /begin AXIS_DESCR COM_AXIS ASDrf_facDesDyn Fact 10 -4.000000 3.999878 FORMAT "%8.6" AXIS_PTS_REF ASDrf_facDesDyn_DST /end AXIS_DESCR
 /begin AXIS_DESCR COM_AXIS Epm_nEng EngN 8 -16384.00 16383.50 FORMAT "%8.2" AXIS_PTS_REF ASDrf_nEng_DST /end AXIS_DESCR
/end CHARACTERISTIC
/begin CHARACTERISTIC ASDrf_facTiSprtMtModPosBlw_GM "weighting factor time constant, Sport, Manual transmission mode, pos. load alteration damping" MAP 0x804FDD62 RB_MapGroup_U8 14.94 fak_ub_b16 1.00 15.94 FORMAT "%5.2" EXTENDED_LIMITS 0.00 15.94
 /begin AXIS_DESCR COM_AXIS ASDrf_facDesDyn Fact 10 -4.000000 3.999878 FORMAT "%8.6" AXIS_PTS_REF ASDrf_facDesDyn_DST /end AXIS_DESCR
 /begin AXIS_DESCR COM_AXIS Epm_nEng EngN 8 -16384.00 16383.50 FORMAT "%8.2" AXIS_PTS_REF ASDrf_nEng_DST /end AXIS_DESCR
/end CHARACTERISTIC
/begin CHARACTERISTIC ASDrf_facTiSprtNegAcOn_GT "weighting factor time constant, Sport , negative load alteration damping with AC on" CURVE 0x804FDDB2 RB_CurveGroup_U8 7.969 fak_ub_b8 0.00 7.969 FORMAT "%5.3"
 /begin AXIS_DESCR COM_AXIS PT_rTrq TransR 8 -327.6800 327.6700 FORMAT "%8.4" AXIS_PTS_REF ASDrf_rTrq_DST /end AXIS_DESCR
/end CHARACTERISTIC
/begin CHARACTERISTIC ASDrf_facTiSprtNeg_GT "weighting factor time constant, Sport , negative load alteration damping" CURVE 0x804FDDBA RB_CurveGroup_U8 7.969 fak_ub_b8 0.00 7.969 FORMAT "%5.3"
 /begin AXIS_DESCR COM_AXIS PT_rTrq TransR 8 -327.6800 327.6700 FORMAT "%8.4" AXIS_PTS_REF ASDrf_rTrq_DST /end AXIS_DESCR
/end CHARACTERISTIC
/begin CHARACTERISTIC ASDrf_facTiSprtPosAbvAcOn_GM "weighting factor time constant, Sport, pos. load alteration damping with AC on" MAP 0x804FDDC2 RB_MapGroup_U8 14.94 fak_ub_b16 1.00 15.94 FORMAT "%5.2" EXTENDED_LIMITS 0.00 15.94
 /begin AXIS_DESCR COM_AXIS ASDrf_facDesDyn Fact 10 -4.000000 3.999878 FORMAT "%8.6" AXIS_PTS_REF ASDrf_facDesDyn_DST /end AXIS_DESCR
 /begin AXIS_DESCR COM_AXIS Epm_nEng EngN 8 -16384.00 16383.50 FORMAT "%8.2" AXIS_PTS_REF ASDrf_nEng_DST /end AXIS_DESCR
/end CHARACTERISTIC
/begin CHARACTERISTIC ASDrf_facTiSprtPosAbv_GM "weighting factor time constant, Sport, pos. load alteration damping" MAP 0x804FDE12 RB_MapGroup_U8 14.94 fak_ub_b16 1.00 15.94 FORMAT "%5.2" EXTENDED_LIMITS 0.00 15.94
 /begin AXIS_DESCR COM_AXIS ASDrf_facDesDyn Fact 10 -4.000000 3.999878 FORMAT "%8.6" AXIS_PTS_REF ASDrf_facDesDyn_DST /end AXIS_DESCR
 /begin AXIS_DESCR COM_AXIS Epm_nEng EngN 8 -16384.00 16383.50 FORMAT "%8.2" AXIS_PTS_REF ASDrf_nEng_DST /end AXIS_DESCR
/end CHARACTERISTIC
/begin CHARACTERISTIC ASDrf_facTiSprtPosBlwAcOn_GM "weighting factor time constant, Sport, pos. load alteration damping with AC on" MAP 0x804FDE62 RB_MapGroup_U8 14.94 fak_ub_b16 1.00 15.94 FORMAT "%5.2" EXTENDED_LIMITS 0.00 15.94
 /begin AXIS_DESCR COM_AXIS ASDrf_facDesDyn Fact 10 -4.000000 3.999878 FORMAT "%8.6" AXIS_PTS_REF ASDrf_facDesDyn_DST /end AXIS_DESCR
 /begin AXIS_DESCR COM_AXIS Epm_nEng EngN 8 -16384.00 16383.50 FORMAT "%8.2" AXIS_PTS_REF ASDrf_nEng_DST /end AXIS_DESCR
/end CHARACTERISTIC
/begin CHARACTERISTIC ASDrf_facTiSprtPosBlw_GM "weighting factor time constant, Sport, pos. load alteration damping" MAP 0x804FDEB2 RB_MapGroup_U8 14.94 fak_ub_b16 1.00 15.94 FORMAT "%5.2" EXTENDED_LIMITS 0.00 15.94
 /begin AXIS_DESCR COM_AXIS ASDrf_facDesDyn Fact 10 -4.000000 3.999878 FORMAT "%8.6" AXIS_PTS_REF ASDrf_facDesDyn_DST /end AXIS_DESCR
 /begin AXIS_DESCR COM_AXIS Epm_nEng EngN 8 -16384.00 16383.50 FORMAT "%8.2" AXIS_PTS_REF ASDrf_nEng_DST /end AXIS_DESCR
/end CHARACTERISTIC
/begin CHARACTERISTIC ASDrf_facTiSptMtModNegAcOn_GT "time constant, sport mode negative load alteration when AC is On" CURVE 0x804FDF02 RB_CurveGroup_U8 7.969 fak_ub_b8 0.00 7.969 FORMAT "%5.3"
 /begin AXIS_DESCR COM_AXIS PT_rTrq TransR 8 -327.6800 327.6700 FORMAT "%8.4" AXIS_PTS_REF ASDrf_rTrq_DST /end AXIS_DESCR
/end CHARACTERISTIC
/begin CHARACTERISTIC ASDrf_facTiSptMtModPosAbvAcOn_GM "time constant, sport mode positive load alteration when AC is On for above" MAP 0x804FDF0A RB_MapGroup_U8 14.94 fak_ub_b16 1.00 15.94 FORMAT "%5.2" EXTENDED_LIMITS 0.00 15.94
 /begin AXIS_DESCR COM_AXIS ASDrf_facDesDyn Fact 10 -4.000000 3.999878 FORMAT "%8.6" AXIS_PTS_REF ASDrf_facDesDyn_DST /end AXIS_DESCR
 /begin AXIS_DESCR COM_AXIS Epm_nEng EngN 8 -16384.00 16383.50 FORMAT "%8.2" AXIS_PTS_REF ASDrf_nEng_DST /end AXIS_DESCR
/end CHARACTERISTIC
/begin CHARACTERISTIC ASDrf_facTiSptMtModPosBlwAcOn_GM "time constant, sport mode positive load alteration when AC is On for below" MAP 0x804FDF5A RB_MapGroup_U8 14.94 fak_ub_b16 1.00 15.94 FORMAT "%5.2" EXTENDED_LIMITS 0.00 15.94
 /begin AXIS_DESCR COM_AXIS ASDrf_facDesDyn Fact 10 -4.000000 3.999878 FORMAT "%8.6" AXIS_PTS_REF ASDrf_facDesDyn_DST /end AXIS_DESCR
 /begin AXIS_DESCR COM_AXIS Epm_nEng EngN 8 -16384.00 16383.50 FORMAT "%8.2" AXIS_PTS_REF ASDrf_nEng_DST /end AXIS_DESCR
/end CHARACTERISTIC
/begin CHARACTERISTIC ASDrf_KdFilSetGripAirCdnrOnNeg_GM "unfiltered part, Grip at clutch, neg. load alteration damping with AC on" MAP 0x804FDFAA RB_MapGroup_U8 1.000000 fak_ub_b2 0.00 1.000000 FORMAT "%8.6" EXTENDED_LIMITS 0.00 1.992188
 /begin AXIS_DESCR COM_AXIS PT_rTrq TransR 8 -327.6800 327.6700 FORMAT "%8.4" AXIS_PTS_REF ASDrf_rTrq_DST /end AXIS_DESCR
 /begin AXIS_DESCR COM_AXIS Epm_nEng EngN 8 -16384.00 16383.50 FORMAT "%8.2" AXIS_PTS_REF ASDrf_nEng_DST /end AXIS_DESCR
/end CHARACTERISTIC
/begin CHARACTERISTIC ASDrf_KdFilSetGripMtModNegAcOn_GM "infiltered part, negative load alteration when AC is On" MAP 0x804FDFEA RB_MapGroup_U8 1.000000 fak_ub_b2 0.00 1.000000 FORMAT "%8.6" EXTENDED_LIMITS 0.00 1.992188
 /begin AXIS_DESCR COM_AXIS PT_rTrq TransR 8 -327.6800 327.6700 FORMAT "%8.4" AXIS_PTS_REF ASDrf_rTrq_DST /end AXIS_DESCR
 /begin AXIS_DESCR COM_AXIS Epm_nEng EngN 8 -16384.00 16383.50 FORMAT "%8.2" AXIS_PTS_REF ASDrf_nEng_DST /end AXIS_DESCR
/end CHARACTERISTIC
/begin CHARACTERISTIC ASDrf_KdFilSetGripMtModNeg_GM "unfiltered part, Grip at clutch, manual transmission mode, neg. load alteration damping" MAP 0x804FE02A RB_MapGroup_U8 1.000000 fak_ub_b2 0.00 1.000000 FORMAT "%8.6" EXTENDED_LIMITS 0.00 1.992188
 /begin AXIS_DESCR COM_AXIS PT_rTrq TransR 8 -327.6800 327.6700 FORMAT "%8.4" AXIS_PTS_REF ASDrf_rTrq_DST /end AXIS_DESCR
 /begin AXIS_DESCR COM_AXIS Epm_nEng EngN 8 -16384.00 16383.50 FORMAT "%8.2" AXIS_PTS_REF ASDrf_nEng_DST /end AXIS_DESCR
/end CHARACTERISTIC
/begin CHARACTERISTIC ASDrf_KdFilSetGripMtModPosAbvAcOn_GM "infiltered part, positive load alteration when AC is On for above" MAP 0x804FE06A RB_MapGroup_U8 1.000000 fak_ub_b2 0.00 1.000000 FORMAT "%8.6" EXTENDED_LIMITS 0.00 1.992188
 /begin AXIS_DESCR COM_AXIS PT_rTrq TransR 8 -327.6800 327.6700 FORMAT "%8.4" AXIS_PTS_REF ASDrf_rTrq_DST /end AXIS_DESCR
 /begin AXIS_DESCR COM_AXIS Epm_nEng EngN 8 -16384.00 16383.50 FORMAT "%8.2" AXIS_PTS_REF ASDrf_nEng_DST /end AXIS_DESCR
/end CHARACTERISTIC
/begin CHARACTERISTIC ASDrf_KdFilSetGripMtModPosAbv_GM "unfiltered part, Grip at clutch, manual tranission mode, pos. load alteration damping" MAP 0x804FE0AA RB_MapGroup_U8 1.000000 fak_ub_b2 0.00 1.000000 FORMAT "%8.6" EXTENDED_LIMITS 0.00 1.992188
 /begin AXIS_DESCR COM_AXIS PT_rTrq TransR 8 -327.6800 327.6700 FORMAT "%8.4" AXIS_PTS_REF ASDrf_rTrq_DST /end AXIS_DESCR
 /begin AXIS_DESCR COM_AXIS Epm_nEng EngN 8 -16384.00 16383.50 FORMAT "%8.2" AXIS_PTS_REF ASDrf_nEng_DST /end AXIS_DESCR
/end CHARACTERISTIC
/begin CHARACTERISTIC ASDrf_KdFilSetGripNeg_GM "unfiltered part, Grip at clutch, neg. load alteration damping" MAP 0x804FE0EA RB_MapGroup_U8 1.000000 fak_ub_b2 0.00 1.000000 FORMAT "%8.6" EXTENDED_LIMITS 0.00 1.992188
 /begin AXIS_DESCR COM_AXIS PT_rTrq TransR 8 -327.6800 327.6700 FORMAT "%8.4" AXIS_PTS_REF ASDrf_rTrq_DST /end AXIS_DESCR
 /begin AXIS_DESCR COM_AXIS Epm_nEng EngN 8 -16384.00 16383.50 FORMAT "%8.2" AXIS_PTS_REF ASDrf_nEng_DST /end AXIS_DESCR
/end CHARACTERISTIC
/begin CHARACTERISTIC ASDrf_KdFilSetGripPosAbvAcOn_GM "unfiltered part, Grip at clutch, pos. load alteration damping during AC On" MAP 0x804FE12A RB_MapGroup_U8 1.000000 fak_ub_b2 0.00 1.000000 FORMAT "%8.6" EXTENDED_LIMITS 0.00 1.992188
 /begin AXIS_DESCR COM_AXIS PT_rTrq TransR 8 -327.6800 327.6700 FORMAT "%8.4" AXIS_PTS_REF ASDrf_rTrq_DST /end AXIS_DESCR
 /begin AXIS_DESCR COM_AXIS Epm_nEng EngN 8 -16384.00 16383.50 FORMAT "%8.2" AXIS_PTS_REF ASDrf_nEng_DST /end AXIS_DESCR
/end CHARACTERISTIC
/begin CHARACTERISTIC ASDrf_KdFilSetGripPosAbv_GM "unfiltered part, Grip at clutch, pos. load alteration damping" MAP 0x804FE16A RB_MapGroup_U8 1.000000 fak_ub_b2 0.00 1.000000 FORMAT "%8.6" EXTENDED_LIMITS 0.00 1.992188
 /begin AXIS_DESCR COM_AXIS PT_rTrq TransR 8 -327.6800 327.6700 FORMAT "%8.4" AXIS_PTS_REF ASDrf_rTrq_DST /end AXIS_DESCR
 /begin AXIS_DESCR COM_AXIS Epm_nEng EngN 8 -16384.00 16383.50 FORMAT "%8.2" AXIS_PTS_REF ASDrf_nEng_DST /end AXIS_DESCR
/end CHARACTERISTIC
/begin CHARACTERISTIC ASDrf_KdFilSetSprtMtModNeg_GM "unfiltered part, Sport, Manual transmission mode, neg. load alteration damping" MAP 0x804FE1AA RB_MapGroup_U8 1.000000 fak_ub_b2 0.00 1.000000 FORMAT "%8.6" EXTENDED_LIMITS 0.00 1.992188
 /begin AXIS_DESCR COM_AXIS PT_rTrq TransR 8 -327.6800 327.6700 FORMAT "%8.4" AXIS_PTS_REF ASDrf_rTrq_DST /end AXIS_DESCR
 /begin AXIS_DESCR COM_AXIS Epm_nEng EngN 8 -16384.00 16383.50 FORMAT "%8.2" AXIS_PTS_REF ASDrf_nEng_DST /end AXIS_DESCR
/end CHARACTERISTIC
/begin CHARACTERISTIC ASDrf_KdFilSetSprtMtModPosAbv_GM "unfiltered part, Sport, Manual transmission mode, pos. load alteration damping" MAP 0x804FE1EA RB_MapGroup_U8 1.000000 fak_ub_b2 0.00 1.000000 FORMAT "%8.6" EXTENDED_LIMITS 0.00 1.992188
 /begin AXIS_DESCR COM_AXIS PT_rTrq TransR 8 -327.6800 327.6700 FORMAT "%8.4" AXIS_PTS_REF ASDrf_rTrq_DST /end AXIS_DESCR
 /begin AXIS_DESCR COM_AXIS Epm_nEng EngN 8 -16384.00 16383.50 FORMAT "%8.2" AXIS_PTS_REF ASDrf_nEng_DST /end AXIS_DESCR
/end CHARACTERISTIC
/begin CHARACTERISTIC ASDrf_KdFilSetSprtNegAcOn_GM "unfiltered part, Sport , neg. load alteration damping with AC on" MAP 0x804FE22A RB_MapGroup_U8 1.000000 fak_ub_b2 0.00 1.000000 FORMAT "%8.6" EXTENDED_LIMITS 0.00 1.992188
 /begin AXIS_DESCR COM_AXIS PT_rTrq TransR 8 -327.6800 327.6700 FORMAT "%8.4" AXIS_PTS_REF ASDrf_rTrq_DST /end AXIS_DESCR
 /begin AXIS_DESCR COM_AXIS Epm_nEng EngN 8 -16384.00 16383.50 FORMAT "%8.2" AXIS_PTS_REF ASDrf_nEng_DST /end AXIS_DESCR
/end CHARACTERISTIC
/begin CHARACTERISTIC ASDrf_KdFilSetSprtNeg_GM "unfiltered part, Sport , neg. load alteration damping" MAP 0x804FE26A RB_MapGroup_U8 1.000000 fak_ub_b2 0.00 1.000000 FORMAT "%8.6" EXTENDED_LIMITS 0.00 1.992188
 /begin AXIS_DESCR COM_AXIS PT_rTrq TransR 8 -327.6800 327.6700 FORMAT "%8.4" AXIS_PTS_REF ASDrf_rTrq_DST /end AXIS_DESCR
 /begin AXIS_DESCR COM_AXIS Epm_nEng EngN 8 -16384.00 16383.50 FORMAT "%8.2" AXIS_PTS_REF ASDrf_nEng_DST /end AXIS_DESCR
/end CHARACTERISTIC
/begin CHARACTERISTIC ASDrf_KdFilSetSprtPosAbvAcOn_GM "unfiltered part, Sport, pos. load alteration damping with AC on" MAP 0x804FE2AA RB_MapGroup_U8 1.000000 fak_ub_b2 0.00 1.000000 FORMAT "%8.6" EXTENDED_LIMITS 0.00 1.992188
 /begin AXIS_DESCR COM_AXIS PT_rTrq TransR 8 -327.6800 327.6700 FORMAT "%8.4" AXIS_PTS_REF ASDrf_rTrq_DST /end AXIS_DESCR
 /begin AXIS_DESCR COM_AXIS Epm_nEng EngN 8 -16384.00 16383.50 FORMAT "%8.2" AXIS_PTS_REF ASDrf_nEng_DST /end AXIS_DESCR
/end CHARACTERISTIC
/begin CHARACTERISTIC ASDrf_KdFilSetSprtPosAbv_GM "unfiltered part, Sport, pos. load alteration damping" MAP 0x804FE2EA RB_MapGroup_U8 1.000000 fak_ub_b2 0.00 1.000000 FORMAT "%8.6" EXTENDED_LIMITS 0.00 1.992188
 /begin AXIS_DESCR COM_AXIS PT_rTrq TransR 8 -327.6800 327.6700 FORMAT "%8.4" AXIS_PTS_REF ASDrf_rTrq_DST /end AXIS_DESCR
 /begin AXIS_DESCR COM_AXIS Epm_nEng EngN 8 -16384.00 16383.50 FORMAT "%8.2" AXIS_PTS_REF ASDrf_nEng_DST /end AXIS_DESCR
/end CHARACTERISTIC
/begin CHARACTERISTIC ASDrf_KdFilSetSptMtModNegAcOn_GM "infiltered part, Sport Mode negative load alteration when AC is On" MAP 0x804FE32A RB_MapGroup_U8 1.000000 fak_ub_b2 0.00 1.000000 FORMAT "%8.6" EXTENDED_LIMITS 0.00 1.992188
 /begin AXIS_DESCR COM_AXIS PT_rTrq TransR 8 -327.6800 327.6700 FORMAT "%8.4" AXIS_PTS_REF ASDrf_rTrq_DST /end AXIS_DESCR
 /begin AXIS_DESCR COM_AXIS Epm_nEng EngN 8 -16384.00 16383.50 FORMAT "%8.2" AXIS_PTS_REF ASDrf_nEng_DST /end AXIS_DESCR
/end CHARACTERISTIC
/begin CHARACTERISTIC ASDrf_KdFilSetSptMtModPosAbvAcOn_GM "infiltered part, Sport Mode positive load alteration when AC is On for above" MAP 0x804FE36A RB_MapGroup_U8 1.000000 fak_ub_b2 0.00 1.000000 FORMAT "%8.6" EXTENDED_LIMITS 0.00 1.992188
 /begin AXIS_DESCR COM_AXIS PT_rTrq TransR 8 -327.6800 327.6700 FORMAT "%8.4" AXIS_PTS_REF ASDrf_rTrq_DST /end AXIS_DESCR
 /begin AXIS_DESCR COM_AXIS Epm_nEng EngN 8 -16384.00 16383.50 FORMAT "%8.2" AXIS_PTS_REF ASDrf_nEng_DST /end AXIS_DESCR
/end CHARACTERISTIC
/begin CHARACTERISTIC ASDrf_nATSlipOpnEngSpdLo_C "Low speed threshold for the automatic transmission slip open w.r.t engine speed" VALUE 0x804FE3AA RB_Val_Ws16 32767.50 EngN -16384.00 16383.50 FORMAT "%8.2" /end CHARACTERISTIC
/begin CHARACTERISTIC ASDrf_nDiffCnvrEngSelThd_C "Threshold for the speed difference between turbine speed and engine speed" VALUE 0x804FE3AC RB_Val_Ws16 32767.50 EngN -16384.00 16383.50 FORMAT "%8.2" /end CHARACTERISTIC
/begin AXIS_PTS ASDrf_nEng_DST "engine speed" 0x804FE3AE Epm_nEng RB_Axis_S16 32767.50 EngN 8 -16384.00 16383.50 FORMAT "%8.2" DEPOSIT ABSOLUTE /end AXIS_PTS
/begin AXIS_PTS ASDrf_nPt_DST "speed powertrain" 0x804FE3C0 ASDrf_nPt RB_Axis_S16 32767.50 EngN 8 -16384.00 16383.50 FORMAT "%8.2" DEPOSIT ABSOLUTE /end AXIS_PTS
/begin AXIS_PTS ASDrf_nrGear_DST "gear" 0x804FE3D2 Tra_numGear RB_Axis_S8 255.0 OneToOne 10 -128.0 127.0 FORMAT "%5.1" DEPOSIT ABSOLUTE /end AXIS_PTS
/begin CHARACTERISTIC ASDrf_nThresNCmp_GMAP "Correction of turbine rpm during open converter clutch" MAP 0x804FE3DE RB_MapGroup_S16 32767.50 nmot_q0p5 -16384.00 16383.50 FORMAT "%8.2"
 /begin AXIS_DESCR COM_AXIS PT_rTrq TransR 8 -327.6800 327.6700 FORMAT "%8.4" AXIS_PTS_REF ASDrf_rTrq_DST /end AXIS_DESCR
 /begin AXIS_DESCR COM_AXIS Epm_dnEngFlt EngNGrd 6 -16384.00 16383.50 FORMAT "%8.2" AXIS_PTS_REF ASDrf_dnEngFlt_DST /end AXIS_DESCR
/end CHARACTERISTIC
/begin CHARACTERISTIC ASDrf_nTrbnThresHi_C "Higher threshold for the turbine speed" VALUE 0x804FE43E RB_Val_Ws16 32767.50 EngN -16384.00 16383.50 FORMAT "%8.2" /end CHARACTERISTIC
/begin CHARACTERISTIC ASDrf_nTrbnThresLo_C "Lower threshold for the turbine speed" VALUE 0x804FE440 RB_Val_Ws16 32767.50 EngN -16384.00 16383.50 FORMAT "%8.2" /end CHARACTERISTIC
/begin CHARACTERISTIC ASDrf_ratSlipOpenActvThdSpt_M "Ratio of Active slip open threshold for sports mode" MAP 0x804FE442 RB_Map_S16U16_U16 327.6750 CrCtlSlipRat 0.00 327.6750 FORMAT "%8.4"
 /begin AXIS_DESCR STD_AXIS Epm_nEng EngN 11 -16384.00 16383.50 FORMAT "%8.2" DEPOSIT ABSOLUTE /end AXIS_DESCR
 /begin AXIS_DESCR STD_AXIS Com_rTrsmTotFild Fact_2pwr11 10 0.00 31.99951 FORMAT "%8.5" DEPOSIT ABSOLUTE /end AXIS_DESCR
/end CHARACTERISTIC
/begin CHARACTERISTIC ASDrf_ratSlipOpenActvThdTrsmMt_M "Ratio of Active slip open threshold for manual transmission" MAP 0x804FE54C RB_Map_S16U16_U16 327.6750 CrCtlSlipRat 0.00 327.6750 FORMAT "%8.4"
 /begin AXIS_DESCR STD_AXIS Epm_nEng EngN 11 -16384.00 16383.50 FORMAT "%8.2" DEPOSIT ABSOLUTE /end AXIS_DESCR
 /begin AXIS_DESCR STD_AXIS Com_rTrsmTotFild Fact_2pwr11 10 0.00 31.99951 FORMAT "%8.5" DEPOSIT ABSOLUTE /end AXIS_DESCR
/end CHARACTERISTIC
/begin CHARACTERISTIC ASDrf_ratSlipOpenAppCmpSpt_M "Ratio of Active slip open Acceleration pedal compensation for sports mode" MAP 0x804FE656 RB_Map_S16U16_U16 163.0000 CrCtlSlipRat 0.00 163.0000 FORMAT "%8.4" EXTENDED_LIMITS 0.00 327.6750
 /begin AXIS_DESCR STD_AXIS APP_r Prc 10 -400.0000 399.9878 FORMAT "%8.4" DEPOSIT ABSOLUTE /end AXIS_DESCR
 /begin AXIS_DESCR STD_AXIS Com_rTrsmTotFild Fact_2pwr11 10 0.00 31.99951 FORMAT "%8.5" DEPOSIT ABSOLUTE /end AXIS_DESCR
/end CHARACTERISTIC
/begin CHARACTERISTIC ASDrf_ratSlipOpenAppCmpTrsmMt_M "Ratio of Active slip open Acceleration pedal compensation for manual transmission" MAP 0x804FE74A RB_Map_S16U16_U16 163.0000 CrCtlSlipRat 0.00 163.0000 FORMAT "%8.4" EXTENDED_LIMITS 0.00 327.6750
 /begin AXIS_DESCR STD_AXIS APP_r Prc 10 -400.0000 399.9878 FORMAT "%8.4" DEPOSIT ABSOLUTE /end AXIS_DESCR
 /begin AXIS_DESCR STD_AXIS Com_rTrsmTotFild Fact_2pwr11 10 0.00 31.99951 FORMAT "%8.5" DEPOSIT ABSOLUTE /end AXIS_DESCR
/end CHARACTERISTIC
/begin CHARACTERISTIC ASDrf_ratSlipOpenAppCmp_M "Ratio of Active slip open Acceleration pedal compensation" MAP 0x804FE83E RB_Map_S16U16_U16 163.0000 CrCtlSlipRat 0.00 163.0000 FORMAT "%8.4" EXTENDED_LIMITS 0.00 327.6750
 /begin AXIS_DESCR STD_AXIS APP_r Prc 10 -400.0000 399.9878 FORMAT "%8.4" DEPOSIT ABSOLUTE /end AXIS_DESCR
 /begin AXIS_DESCR STD_AXIS Com_rTrsmTotFild Fact_2pwr11 10 0.00 31.99951 FORMAT "%8.5" DEPOSIT ABSOLUTE /end AXIS_DESCR
/end CHARACTERISTIC
/begin CHARACTERISTIC ASDrf_ratSlipOpenEngCmpSpt_M "Ratio of Active slip open Engine speed compensation for sports mode" MAP 0x804FE932 RB_Map_S16U16_U16 163.0000 CrCtlSlipRat 0.00 163.0000 FORMAT "%8.4" EXTENDED_LIMITS 0.00 327.6750
 /begin AXIS_DESCR STD_AXIS Epm_nEng EngN 11 -16384.00 16383.50 FORMAT "%8.2" DEPOSIT ABSOLUTE /end AXIS_DESCR
 /begin AXIS_DESCR STD_AXIS Com_rTrsmTotFild Fact_2pwr11 10 0.00 31.99951 FORMAT "%8.5" DEPOSIT ABSOLUTE /end AXIS_DESCR
/end CHARACTERISTIC
/begin CHARACTERISTIC ASDrf_ratSlipOpenEngCmpTrsmMt_M "Ratio of Active slip open Engine speed compensation for manual transmission" MAP 0x804FEA3C RB_Map_S16U16_U16 163.0000 CrCtlSlipRat 0.00 163.0000 FORMAT "%8.4" EXTENDED_LIMITS 0.00 327.6750
 /begin AXIS_DESCR STD_AXIS Epm_nEng EngN 11 -16384.00 16383.50 FORMAT "%8.2" DEPOSIT ABSOLUTE /end AXIS_DESCR
 /begin AXIS_DESCR STD_AXIS Com_rTrsmTotFild Fact_2pwr11 10 0.00 31.99951 FORMAT "%8.5" DEPOSIT ABSOLUTE /end AXIS_DESCR
/end CHARACTERISTIC
/begin CHARACTERISTIC ASDrf_rATSlipOpnActvThres_MAP "Threshold for the enabling converter slip open state for AT" MAP 0x804FEB46 RB_Map_S16U16_U16 327.6750 CrCtlSlipRat 0.00 327.6750 FORMAT "%8.4"
 /begin AXIS_DESCR STD_AXIS Epm_nEng EngN 11 -16384.00 16383.50 FORMAT "%8.2" DEPOSIT ABSOLUTE /end AXIS_DESCR
 /begin AXIS_DESCR STD_AXIS Com_rTrsmTotFild Fact_2pwr11 10 0.00 31.99951 FORMAT "%8.5" DEPOSIT ABSOLUTE /end AXIS_DESCR
/end CHARACTERISTIC
/begin CHARACTERISTIC ASDrf_rATSlipOpnNCmp_MAP "Threshold to determinine engine speed lower than turbine speed for converter slip open state in AT" MAP 0x804FEC50 RB_Map_S16U16_U16 163.0000 CrCtlSlipRat 0.00 163.0000 FORMAT "%8.4" EXTENDED_LIMITS 0.00 327.6750
 /begin AXIS_DESCR STD_AXIS Epm_nEng EngN 11 -16384.00 16383.50 FORMAT "%8.2" DEPOSIT ABSOLUTE /end AXIS_DESCR
 /begin AXIS_DESCR STD_AXIS Com_rTrsmTotFild Fact_2pwr11 10 0.00 31.99951 FORMAT "%8.5" DEPOSIT ABSOLUTE /end AXIS_DESCR
/end CHARACTERISTIC
/begin CHARACTERISTIC ASDrf_rGripThres_C "Threshold for grip detection" VALUE 0x804FED5A RB_Val_Ws16 655.3500 TransR -327.6800 327.6700 FORMAT "%8.4" /end CHARACTERISTIC
/begin AXIS_PTS ASDrf_rTrq_DST "ratio of transmission" 0x804FED5C PT_rTrq RB_Axis_S16 655.3500 TransR 8 -327.6800 327.6700 FORMAT "%8.4" DEPOSIT ABSOLUTE /end AXIS_PTS
/begin CHARACTERISTIC ASDrf_stEngOperModSeln_FT "Satus to select drivability mode for parameter" CURVE 0x804FED6E RB_Curve_U8_U8 255.0 OneToOne 0.00 255.0 FORMAT "%5.1"
 /begin AXIS_DESCR STD_AXIS AccPed_swtDrvMod OneToOne 16 0.00 255.0 FORMAT "%5.1" DEPOSIT ABSOLUTE /end AXIS_DESCR
/end CHARACTERISTIC
/begin CHARACTERISTIC ASDrf_tATSlipOpnEngTLo_C "Low coolant temperature threshold for the automatic transmission slip open" VALUE 0x804FED90 RB_Val_Ws16 6553.500 Temp_Cels -3549.940 3003.560 FORMAT "%8.3" /end CHARACTERISTIC
/begin AXIS_PTS ASDrf_tEng_DST "engine temperature" 0x804FED92 EngDa_tEng RB_Axis_S16 6553.500 Temp_Cels 6 -3549.940 3003.560 FORMAT "%8.3" DEPOSIT ABSOLUTE /end AXIS_PTS
/begin CHARACTERISTIC ASDrf_tiFilSetGripMtModNegAcOn_GM "time constant, negative load alteration when Ac is On" MAP 0x804FEDA0 RB_MapGroup_U8 2.540 t_q0p01 0.010 2.550 FORMAT "%5.3" EXTENDED_LIMITS 0.00 2.550
 /begin AXIS_DESCR COM_AXIS ASDrf_tqCluBasc Trq 5 -3276.800 3276.700 FORMAT "%8.3" AXIS_PTS_REF ASDrf_trqClthBs_DST /end AXIS_DESCR
 /begin AXIS_DESCR COM_AXIS Epm_nEng EngN 8 -16384.00 16383.50 FORMAT "%8.2" AXIS_PTS_REF ASDrf_nEng_DST /end AXIS_DESCR
/end CHARACTERISTIC
/begin CHARACTERISTIC ASDrf_tiFilSetGripMtModNeg_GM "time constant, Grip at clutch, manual transmission mode, neg. load alteration damping" MAP 0x804FEDC8 RB_MapGroup_U8 2.540 t_q0p01 0.010 2.550 FORMAT "%5.3" EXTENDED_LIMITS 0.00 2.550
 /begin AXIS_DESCR COM_AXIS ASDrf_tqCluBasc Trq 5 -3276.800 3276.700 FORMAT "%8.3" AXIS_PTS_REF ASDrf_trqClthBs_DST /end AXIS_DESCR
 /begin AXIS_DESCR COM_AXIS Epm_nEng EngN 8 -16384.00 16383.50 FORMAT "%8.2" AXIS_PTS_REF ASDrf_nEng_DST /end AXIS_DESCR
/end CHARACTERISTIC
/begin CHARACTERISTIC ASDrf_tiFilSetGripMtModPosAbvAcOn_GM "time constant, positive load alteration when Ac is On for above" MAP 0x804FEDF0 RB_MapGroup_U8 2.540 t_q0p01 0.010 2.550 FORMAT "%5.3" EXTENDED_LIMITS 0.00 2.550
 /begin AXIS_DESCR COM_AXIS PT_rTrq TransR 8 -327.6800 327.6700 FORMAT "%8.4" AXIS_PTS_REF ASDrf_rTrq_DST /end AXIS_DESCR
 /begin AXIS_DESCR COM_AXIS Epm_nEng EngN 8 -16384.00 16383.50 FORMAT "%8.2" AXIS_PTS_REF ASDrf_nEng_DST /end AXIS_DESCR
/end CHARACTERISTIC
/begin CHARACTERISTIC ASDrf_tiFilSetGripMtModPosAbv_GM "time constant, Grip at clutch, manual transmission mode, pos. load alteration damping" MAP 0x804FEE30 RB_MapGroup_U8 2.540 t_q0p01 0.010 2.550 FORMAT "%5.3" EXTENDED_LIMITS 0.00 2.550
 /begin AXIS_DESCR COM_AXIS PT_rTrq TransR 8 -327.6800 327.6700 FORMAT "%8.4" AXIS_PTS_REF ASDrf_rTrq_DST /end AXIS_DESCR
 /begin AXIS_DESCR COM_AXIS Epm_nEng EngN 8 -16384.00 16383.50 FORMAT "%8.2" AXIS_PTS_REF ASDrf_nEng_DST /end AXIS_DESCR
/end CHARACTERISTIC
/begin CHARACTERISTIC ASDrf_tiFilSetGripMtModPosBlwAcOn_GM "time constant, positive load alteration when Ac is On for below" MAP 0x804FEE70 RB_MapGroup_U8 2.540 t_q0p01 0.010 2.550 FORMAT "%5.3" EXTENDED_LIMITS 0.00 2.550
 /begin AXIS_DESCR COM_AXIS PT_rTrq TransR 8 -327.6800 327.6700 FORMAT "%8.4" AXIS_PTS_REF ASDrf_rTrq_DST /end AXIS_DESCR
 /begin AXIS_DESCR COM_AXIS Epm_nEng EngN 8 -16384.00 16383.50 FORMAT "%8.2" AXIS_PTS_REF ASDrf_nEng_DST /end AXIS_DESCR
/end CHARACTERISTIC
/begin CHARACTERISTIC ASDrf_tiFilSetGripMtModPosBlw_GM "time constant, Grip at clutch, manual transmission mode, pos. load alteration damping" MAP 0x804FEEB0 RB_MapGroup_U8 2.540 t_q0p01 0.010 2.550 FORMAT "%5.3" EXTENDED_LIMITS 0.00 2.550
 /begin AXIS_DESCR COM_AXIS PT_rTrq TransR 8 -327.6800 327.6700 FORMAT "%8.4" AXIS_PTS_REF ASDrf_rTrq_DST /end AXIS_DESCR
 /begin AXIS_DESCR COM_AXIS Epm_nEng EngN 8 -16384.00 16383.50 FORMAT "%8.2" AXIS_PTS_REF ASDrf_nEng_DST /end AXIS_DESCR
/end CHARACTERISTIC
/begin CHARACTERISTIC ASDrf_tiFilSetSprtMtModNeg_GM "time constant, Sport, Manual transmission mode, neg. load alteration damping" MAP 0x804FEEF0 RB_MapGroup_U8 2.540 t_q0p01 0.010 2.550 FORMAT "%5.3" EXTENDED_LIMITS 0.00 2.550
 /begin AXIS_DESCR COM_AXIS ASDrf_tqCluBasc Trq 5 -3276.800 3276.700 FORMAT "%8.3" AXIS_PTS_REF ASDrf_trqClthBs_DST /end AXIS_DESCR
 /begin AXIS_DESCR COM_AXIS Epm_nEng EngN 8 -16384.00 16383.50 FORMAT "%8.2" AXIS_PTS_REF ASDrf_nEng_DST /end AXIS_DESCR
/end CHARACTERISTIC
/begin CHARACTERISTIC ASDrf_tiFilSetSprtMtModPosAbv_GM "time constant, Sport, Manual transmission mode, pos. load alteration damping" MAP 0x804FEF18 RB_MapGroup_U8 2.540 t_q0p01 0.010 2.550 FORMAT "%5.3" EXTENDED_LIMITS 0.00 2.550
 /begin AXIS_DESCR COM_AXIS PT_rTrq TransR 8 -327.6800 327.6700 FORMAT "%8.4" AXIS_PTS_REF ASDrf_rTrq_DST /end AXIS_DESCR
 /begin AXIS_DESCR COM_AXIS Epm_nEng EngN 8 -16384.00 16383.50 FORMAT "%8.2" AXIS_PTS_REF ASDrf_nEng_DST /end AXIS_DESCR
/end CHARACTERISTIC
/begin CHARACTERISTIC ASDrf_tiFilSetSprtMtModPosBlw_GM "time constant, Sport, Manual transmission mode, pos. load alteration damping" MAP 0x804FEF58 RB_MapGroup_U8 2.540 t_q0p01 0.010 2.550 FORMAT "%5.3" EXTENDED_LIMITS 0.00 2.550
 /begin AXIS_DESCR COM_AXIS PT_rTrq TransR 8 -327.6800 327.6700 FORMAT "%8.4" AXIS_PTS_REF ASDrf_rTrq_DST /end AXIS_DESCR
 /begin AXIS_DESCR COM_AXIS Epm_nEng EngN 8 -16384.00 16383.50 FORMAT "%8.2" AXIS_PTS_REF ASDrf_nEng_DST /end AXIS_DESCR
/end CHARACTERISTIC
/begin CHARACTERISTIC ASDrf_tiFilSetSprtNegAcOn_GM "time constant, Sport , neg. load alteration damping with AC on" MAP 0x804FEF98 RB_MapGroup_U8 2.540 t_q0p01 0.010 2.550 FORMAT "%5.3" EXTENDED_LIMITS 0.00 2.550
 /begin AXIS_DESCR COM_AXIS ASDrf_tqCluBasc Trq 5 -3276.800 3276.700 FORMAT "%8.3" AXIS_PTS_REF ASDrf_trqClthBs_DST /end AXIS_DESCR
 /begin AXIS_DESCR COM_AXIS Epm_nEng EngN 8 -16384.00 16383.50 FORMAT "%8.2" AXIS_PTS_REF ASDrf_nEng_DST /end AXIS_DESCR
/end CHARACTERISTIC
/begin CHARACTERISTIC ASDrf_tiFilSetSprtNeg_GM "time constant, Sport , neg. load alteration damping" MAP 0x804FEFC0 RB_MapGroup_U8 2.540 t_q0p01 0.010 2.550 FORMAT "%5.3" EXTENDED_LIMITS 0.00 2.550
 /begin AXIS_DESCR COM_AXIS ASDrf_tqCluBasc Trq 5 -3276.800 3276.700 FORMAT "%8.3" AXIS_PTS_REF ASDrf_trqClthBs_DST /end AXIS_DESCR
 /begin AXIS_DESCR COM_AXIS Epm_nEng EngN 8 -16384.00 16383.50 FORMAT "%8.2" AXIS_PTS_REF ASDrf_nEng_DST /end AXIS_DESCR
/end CHARACTERISTIC
/begin CHARACTERISTIC ASDrf_tiFilSetSprtPosAbvAcOn_GM "time constant, Sport, pos. load alteration damping with AC on" MAP 0x804FEFE8 RB_MapGroup_U8 2.540 t_q0p01 0.010 2.550 FORMAT "%5.3" EXTENDED_LIMITS 0.00 2.550
 /begin AXIS_DESCR COM_AXIS PT_rTrq TransR 8 -327.6800 327.6700 FORMAT "%8.4" AXIS_PTS_REF ASDrf_rTrq_DST /end AXIS_DESCR
 /begin AXIS_DESCR COM_AXIS Epm_nEng EngN 8 -16384.00 16383.50 FORMAT "%8.2" AXIS_PTS_REF ASDrf_nEng_DST /end AXIS_DESCR
/end CHARACTERISTIC
/begin CHARACTERISTIC ASDrf_tiFilSetSprtPosAbv_GM "time constant, Sport, pos. load alteration damping" MAP 0x804FF028 RB_MapGroup_U8 2.540 t_q0p01 0.010 2.550 FORMAT "%5.3" EXTENDED_LIMITS 0.00 2.550
 /begin AXIS_DESCR COM_AXIS PT_rTrq TransR 8 -327.6800 327.6700 FORMAT "%8.4" AXIS_PTS_REF ASDrf_rTrq_DST /end AXIS_DESCR
 /begin AXIS_DESCR COM_AXIS Epm_nEng EngN 8 -16384.00 16383.50 FORMAT "%8.2" AXIS_PTS_REF ASDrf_nEng_DST /end AXIS_DESCR
/end CHARACTERISTIC
/begin CHARACTERISTIC ASDrf_tiFilSetSprtPosBlwAcOn_GM "time constant, Sport, pos. load alteration damping with AC on" MAP 0x804FF068 RB_MapGroup_U8 2.540 t_q0p01 0.010 2.550 FORMAT "%5.3" EXTENDED_LIMITS 0.00 2.550
 /begin AXIS_DESCR COM_AXIS PT_rTrq TransR 8 -327.6800 327.6700 FORMAT "%8.4" AXIS_PTS_REF ASDrf_rTrq_DST /end AXIS_DESCR
 /begin AXIS_DESCR COM_AXIS Epm_nEng EngN 8 -16384.00 16383.50 FORMAT "%8.2" AXIS_PTS_REF ASDrf_nEng_DST /end AXIS_DESCR
/end CHARACTERISTIC
/begin CHARACTERISTIC ASDrf_tiFilSetSprtPosBlw_GM "time constant, Sport, pos. load alteration damping" MAP 0x804FF0A8 RB_MapGroup_U8 2.540 t_q0p01 0.010 2.550 FORMAT "%5.3" EXTENDED_LIMITS 0.00 2.550
 /begin AXIS_DESCR COM_AXIS PT_rTrq TransR 8 -327.6800 327.6700 FORMAT "%8.4" AXIS_PTS_REF ASDrf_rTrq_DST /end AXIS_DESCR
 /begin AXIS_DESCR COM_AXIS Epm_nEng EngN 8 -16384.00 16383.50 FORMAT "%8.2" AXIS_PTS_REF ASDrf_nEng_DST /end AXIS_DESCR
/end CHARACTERISTIC
/begin CHARACTERISTIC ASDrf_tiFilSetSptMtModNegAcOn_GM "time constant, sport Mode negative load alteration when Ac is On" MAP 0x804FF0E8 RB_MapGroup_U8 2.540 t_q0p01 0.010 2.550 FORMAT "%5.3" EXTENDED_LIMITS 0.00 2.550
 /begin AXIS_DESCR COM_AXIS ASDrf_tqCluBasc Trq 5 -3276.800 3276.700 FORMAT "%8.3" AXIS_PTS_REF ASDrf_trqClthBs_DST /end AXIS_DESCR
 /begin AXIS_DESCR COM_AXIS Epm_nEng EngN 8 -16384.00 16383.50 FORMAT "%8.2" AXIS_PTS_REF ASDrf_nEng_DST /end AXIS_DESCR
/end CHARACTERISTIC
/begin CHARACTERISTIC ASDrf_tiFilSetSptMtModPosAbvAcOn_GM "time constant, sport Mode positive load alteration when Ac is On for above" MAP 0x804FF110 RB_MapGroup_U8 2.540 t_q0p01 0.010 2.550 FORMAT "%5.3" EXTENDED_LIMITS 0.00 2.550
 /begin AXIS_DESCR COM_AXIS PT_rTrq TransR 8 -327.6800 327.6700 FORMAT "%8.4" AXIS_PTS_REF ASDrf_rTrq_DST /end AXIS_DESCR
 /begin AXIS_DESCR COM_AXIS Epm_nEng EngN 8 -16384.00 16383.50 FORMAT "%8.2" AXIS_PTS_REF ASDrf_nEng_DST /end AXIS_DESCR
/end CHARACTERISTIC
/begin CHARACTERISTIC ASDrf_tiFilSetSptMtModPosBlwAcOn_GM "time constant, sport Mode positive load alteration when Ac is On for below" MAP 0x804FF150 RB_MapGroup_U8 2.540 t_q0p01 0.010 2.550 FORMAT "%5.3" EXTENDED_LIMITS 0.00 2.550
 /begin AXIS_DESCR COM_AXIS PT_rTrq TransR 8 -327.6800 327.6700 FORMAT "%8.4" AXIS_PTS_REF ASDrf_rTrq_DST /end AXIS_DESCR
 /begin AXIS_DESCR COM_AXIS Epm_nEng EngN 8 -16384.00 16383.50 FORMAT "%8.2" AXIS_PTS_REF ASDrf_nEng_DST /end AXIS_DESCR
/end CHARACTERISTIC
/begin CHARACTERISTIC ASDrf_tiFltSetAirCdnrOnGripNeg_GM "time constant, Grip at clutch, neg. load alteration damping for AC on" MAP 0x804FF190 RB_MapGroup_U8 2.540 t_q0p01 0.010 2.550 FORMAT "%5.3" EXTENDED_LIMITS 0.00 2.550
 /begin AXIS_DESCR COM_AXIS ASDrf_tqCluBasc Trq 5 -3276.800 3276.700 FORMAT "%8.3" AXIS_PTS_REF ASDrf_trqClthBs_DST /end AXIS_DESCR
 /begin AXIS_DESCR COM_AXIS Epm_nEng EngN 8 -16384.00 16383.50 FORMAT "%8.2" AXIS_PTS_REF ASDrf_nEng_DST /end AXIS_DESCR
/end CHARACTERISTIC
/begin CHARACTERISTIC ASDrf_tiFltSetAirCdnrOnNegFCO_GT "time constant for transission into FCO für AC on" CURVE 0x804FF1B8 RB_CurveGroup_U8 2.540 t_q0p01 0.010 2.550 FORMAT "%5.3" EXTENDED_LIMITS 0.00 2.550
 /begin AXIS_DESCR COM_AXIS Epm_nEng EngN 8 -16384.00 16383.50 FORMAT "%8.2" AXIS_PTS_REF ASDrf_nEng_DST /end AXIS_DESCR
/end CHARACTERISTIC
/begin CHARACTERISTIC ASDrf_tiFltSetGripNeg_MAP "time constant, Grip at clutch, neg. load alteration damping" MAP 0x804FF1C0 RB_MapGroup_U8 2.540 t_q0p01 0.010 2.550 FORMAT "%5.3" EXTENDED_LIMITS 0.00 2.550
 /begin AXIS_DESCR COM_AXIS ASDrf_tqCluBasc Trq 5 -3276.800 3276.700 FORMAT "%8.3" AXIS_PTS_REF ASDrf_trqClthBs_DST /end AXIS_DESCR
 /begin AXIS_DESCR COM_AXIS ASDrf_nPt EngN 8 -16384.00 16383.50 FORMAT "%8.2" AXIS_PTS_REF ASDrf_nPt_DST /end AXIS_DESCR
/end CHARACTERISTIC
/begin CHARACTERISTIC ASDrf_tiFltSetGripPosAbvAcOn_GMAP "time constant, Grip at clutch, pos. load alteration damping during AC On" MAP 0x804FF1E8 RB_MapGroup_U8 2.540 t_q0p01 0.010 2.550 FORMAT "%5.3" EXTENDED_LIMITS 0.00 2.550
 /begin AXIS_DESCR COM_AXIS PT_rTrq TransR 8 -327.6800 327.6700 FORMAT "%8.4" AXIS_PTS_REF ASDrf_rTrq_DST /end AXIS_DESCR
 /begin AXIS_DESCR COM_AXIS Epm_nEng EngN 8 -16384.00 16383.50 FORMAT "%8.2" AXIS_PTS_REF ASDrf_nEng_DST /end AXIS_DESCR
/end CHARACTERISTIC
/begin CHARACTERISTIC ASDrf_tiFltSetGripPosAbv_GMAP "time constant, Grip at clutch, pos. load alteration damping" MAP 0x804FF228 RB_MapGroup_U8 2.540 t_q0p01 0.010 2.550 FORMAT "%5.3" EXTENDED_LIMITS 0.00 2.550
 /begin AXIS_DESCR COM_AXIS PT_rTrq TransR 8 -327.6800 327.6700 FORMAT "%8.4" AXIS_PTS_REF ASDrf_rTrq_DST /end AXIS_DESCR
 /begin AXIS_DESCR COM_AXIS ASDrf_nPt EngN 8 -16384.00 16383.50 FORMAT "%8.2" AXIS_PTS_REF ASDrf_nPt_DST /end AXIS_DESCR
/end CHARACTERISTIC
/begin CHARACTERISTIC ASDrf_tiFltSetGripPosBlwAcOn_GMAP "time constant, Grip at clutch, pos. load alteration damping during AC On" MAP 0x804FF268 RB_MapGroup_U8 2.540 t_q0p01 0.010 2.550 FORMAT "%5.3" EXTENDED_LIMITS 0.00 2.550
 /begin AXIS_DESCR COM_AXIS PT_rTrq TransR 8 -327.6800 327.6700 FORMAT "%8.4" AXIS_PTS_REF ASDrf_rTrq_DST /end AXIS_DESCR
 /begin AXIS_DESCR COM_AXIS Epm_nEng EngN 8 -16384.00 16383.50 FORMAT "%8.2" AXIS_PTS_REF ASDrf_nEng_DST /end AXIS_DESCR
/end CHARACTERISTIC
/begin CHARACTERISTIC ASDrf_tiFltSetGripPosBlw_GMAP "time constant, Grip at clutch, pos. load alteration damping" MAP 0x804FF2A8 RB_MapGroup_U8 2.540 t_q0p01 0.010 2.550 FORMAT "%5.3" EXTENDED_LIMITS 0.00 2.550
 /begin AXIS_DESCR COM_AXIS PT_rTrq TransR 8 -327.6800 327.6700 FORMAT "%8.4" AXIS_PTS_REF ASDrf_rTrq_DST /end AXIS_DESCR
 /begin AXIS_DESCR COM_AXIS ASDrf_nPt EngN 8 -16384.00 16383.50 FORMAT "%8.2" AXIS_PTS_REF ASDrf_nPt_DST /end AXIS_DESCR
/end CHARACTERISTIC
/begin CHARACTERISTIC ASDrf_tiFltSetNegFCOSprt_GCUR "Sports mode:time constant for transission into FCO" CURVE 0x804FF2E8 RB_CurveGroup_U8 2.540 t_q0p01 0.010 2.550 FORMAT "%5.3" EXTENDED_LIMITS 0.00 2.550
 /begin AXIS_DESCR COM_AXIS Epm_nEng EngN 8 -16384.00 16383.50 FORMAT "%8.2" AXIS_PTS_REF ASDrf_nEng_DST /end AXIS_DESCR
/end CHARACTERISTIC
/begin CHARACTERISTIC ASDrf_tiFltSetNegFCO_GCUR "time constant for transission into FCO" CURVE 0x804FF2F0 RB_CurveGroup_U8 2.540 t_q0p01 0.010 2.550 FORMAT "%5.3" EXTENDED_LIMITS 0.00 2.550
 /begin AXIS_DESCR COM_AXIS ASDrf_nPt EngN 8 -16384.00 16383.50 FORMAT "%8.2" AXIS_PTS_REF ASDrf_nPt_DST /end AXIS_DESCR
/end CHARACTERISTIC
/begin CHARACTERISTIC ASDrf_tiFltSetNegMax_C "maximum filter time at negative load change" VALUE 0x804FF2F8 RB_Val_Wu8 2.540 t_q0p01 0.010 2.550 FORMAT "%5.3" EXTENDED_LIMITS 0.00 2.550 /end CHARACTERISTIC
/begin CHARACTERISTIC ASDrf_tiFltSetPosFCOSprt_GMAP "Sports mode:time constant for resumption after fuel cut off" MAP 0x804FF2F9 RB_MapGroup_U8 2.540 t_q0p01 0.010 2.550 FORMAT "%5.3" EXTENDED_LIMITS 0.00 2.550
 /begin AXIS_DESCR COM_AXIS ASDrf_facDesDyn Fact 10 -4.000000 3.999878 FORMAT "%8.6" AXIS_PTS_REF ASDrf_facDesDyn_DST /end AXIS_DESCR
 /begin AXIS_DESCR COM_AXIS PT_rTrq TransR 8 -327.6800 327.6700 FORMAT "%8.4" AXIS_PTS_REF ASDrf_rTrq_DST /end AXIS_DESCR
/end CHARACTERISTIC
/begin CHARACTERISTIC ASDrf_tiFltSetPosFCO_GMAP "time constant for resumption after fuel cut off" MAP 0x804FF349 RB_MapGroup_U8 2.540 t_q0p01 0.010 2.550 FORMAT "%5.3" EXTENDED_LIMITS 0.00 2.550
 /begin AXIS_DESCR COM_AXIS ASDrf_facDesDyn Fact 10 -4.000000 3.999878 FORMAT "%8.6" AXIS_PTS_REF ASDrf_facDesDyn_DST /end AXIS_DESCR
 /begin AXIS_DESCR COM_AXIS PT_rTrq TransR 8 -327.6800 327.6700 FORMAT "%8.4" AXIS_PTS_REF ASDrf_rTrq_DST /end AXIS_DESCR
/end CHARACTERISTIC
/begin CHARACTERISTIC ASDrf_tiMaxCalcOff_C "maximum use time of reset condition" VALUE 0x804FF399 RB_Val_Wu8 2.550 t_q0p01 0.00 2.550 FORMAT "%5.3" /end CHARACTERISTIC
/begin CHARACTERISTIC ASDrf_tqLosOfsAirCdnrOnNegSet_C "offset to clutch torque zero neg. load alteration damping for AC on" VALUE 0x804FF39A RB_Val_Ws16 6553.500 md_sw_q0p1 -3276.800 3276.700 FORMAT "%8.3" /end CHARACTERISTIC
/begin AXIS_PTS ASDrf_trqClthBs_DST "basic torque on clutch level" 0x804FF39C ASDrf_tqCluBasc RB_Axis_S16 6553.500 Trq 5 -3276.800 3276.700 FORMAT "%8.3" DEPOSIT ABSOLUTE /end AXIS_PTS
/begin CHARACTERISTIC ASDrf_trqLosOfsNegSetSprt_C "Sports mode:offset to clutch torque zero neg. load alteration damping" VALUE 0x804FF3A8 RB_Val_Ws16 6553.500 md_sw_q0p1 -3276.800 3276.700 FORMAT "%8.3" /end CHARACTERISTIC
/begin CHARACTERISTIC ASDrf_trqLosOfsNegSet_C "offset to clutch torque zero neg. load alteration damping" VALUE 0x804FF3AA RB_Val_Ws16 6553.500 Trq -3276.800 3276.700 FORMAT "%8.3" /end CHARACTERISTIC
/begin CHARACTERISTIC ASDrf_trqLosOfsPosSetSprt_C "Sports mode:offset to clutch torque zero pos. load alteration damping" VALUE 0x804FF3AC RB_Val_Ws16 6553.500 md_sw_q0p1 -3276.800 3276.700 FORMAT "%8.3" /end CHARACTERISTIC
/begin CHARACTERISTIC ASDrf_trqLosOfsPosSet_C "offset to clutch torque zero pos. load alteration damping" VALUE 0x804FF3AE RB_Val_Ws16 6553.500 Trq -3276.800 3276.700 FORMAT "%8.3" /end CHARACTERISTIC
/begin CHARACTERISTIC ASDrf_trqThresDP1_C "torque threshold negative load alteration" VALUE 0x804FF3B0 RB_Val_Ws16 3276.700 Trq 0.00 3276.700 FORMAT "%8.3" EXTENDED_LIMITS -3276.800 3276.700 /end CHARACTERISTIC
/begin CHARACTERISTIC ASDrf_trqThresDP2_C "torque threshold negative load alteration" VALUE 0x804FF3B2 RB_Val_Ws16 3276.800 Trq -3276.800 0.00 FORMAT "%8.3" EXTENDED_LIMITS -3276.800 3276.700 /end CHARACTERISTIC
/begin CHARACTERISTIC ASDrf_vDONeg_C "speed threshold for negative driveability" VALUE 0x804FF3B4 RB_Val_Ws16 655.3500 vel_q0p01 -327.6800 327.6700 FORMAT "%8.4" /end CHARACTERISTIC
/begin CHARACTERISTIC ASDrf_vDOPos_C "speed threshold for positive driveability" VALUE 0x804FF3B6 RB_Val_Ws16 655.3500 vel_q0p01 -327.6800 327.6700 FORMAT "%8.4" /end CHARACTERISTIC
/begin CHARACTERISTIC ASDrf_vNoGripDQ_C "speed threshold for no grip" VALUE 0x804FF3B8 RB_Val_Ws16 655.3500 vel_q0p01 -327.6800 327.6700 FORMAT "%8.4" /end CHARACTERISTIC
/begin CHARACTERISTIC ATS_Standby_Disabled_C "" VALUE 0x8053A5A4 Val_Wu8 255.0 OneToOne 0.00 255.0 FORMAT "%5.1" /end CHARACTERISTIC
/begin CHARACTERISTIC ATS_tiTstDemHeal_C "" VALUE 0x8053A5A6 Val_Wu16 655.3500 Time_s 0.00 655.3500 FORMAT "%8.4" /end CHARACTERISTIC
/begin CHARACTERISTIC ATS_tiTstDemMax_C "" VALUE 0x8053A5A8 Val_Wu16 655.3500 Time_s 0.00 655.3500 FORMAT "%8.4" /end CHARACTERISTIC
/begin CHARACTERISTIC ATS_TmrBehaviour_C "" VALUE 0x8053A5AA Val_Wu8 255.0 OneToOne 0.00 255.0 FORMAT "%5.1" /end CHARACTERISTIC
/begin CHARACTERISTIC ATS_TstDemMaxEngN_C "" VALUE 0x8053A5BC Val_Wu8 10200. EngN_LRes 0.00 10200. FORMAT "%5.0" /end CHARACTERISTIC
/begin CHARACTERISTIC ATS_TstDemMaxVSSCDV_C "" VALUE 0x8053A5BE Val_Ws16 655.3500 Vel -327.6800 327.6700 FORMAT "%8.4" /end CHARACTERISTIC
/begin CHARACTERISTIC BattU_facFild_C "Gain factor for battery voltage filter" VALUE 0x805079A4 RB_Val_Wu16 0.9999847 fak_uw_b1 0.00 0.9999847 FORMAT "%9.7" /end CHARACTERISTIC
/begin CHARACTERISTIC BattU_flgBattDetnIMGECUEna_C "Flag enable for battery detection voltage of IMG ECU" VALUE 0x805079A6 RB_Val_Wboolean 1.00000000000 B_TRUE 0.00 1.00000000000 FORMAT "%13.11" /end CHARACTERISTIC
/begin CHARACTERISTIC BattU_flgBattDetnTCUECUEna_C "Flag enable for battery detection voltage of TCU ECU" VALUE 0x805079A7 RB_Val_Wboolean 1.00000000000 B_TRUE 0.00 1.00000000000 FORMAT "%13.11" /end CHARACTERISTIC
/begin CHARACTERISTIC BattU_flgBattUMonEna_C "Switch to enable the battery voltage diagnosis" VALUE 0x805079A8 RB_Val_Wboolean 1.00000000000 B_TRUE 0.00 1.00000000000 FORMAT "%13.11" /end CHARACTERISTIC
/begin CHARACTERISTIC BattU_nEngStabThd_C "Engine speed stable threshold" VALUE 0x805079AA RB_Val_Ws16 32767.50 EngN -16384.00 16383.50 FORMAT "%8.2" /end CHARACTERISTIC
/begin CHARACTERISTIC BattU_numUStbyDiaDeb_C "Threshold for DFC (DFC_BattUStdbyDiaOL)" VALUE 0x805079A2 RB_Val_Wu8 255.0 OneToOne 0.00 255.0 FORMAT "%5.1" /end CHARACTERISTIC
/begin CHARACTERISTIC BattU_RmpSlpNeg_C "Negative ramp slope threshold value for devlibTransStage structure" VALUE 0x805079AC RB_Val_Ws32 655358999.634 RmpVoltBatt 1000.061 655359999.695 FORMAT "%13.3" EXTENDED_LIMITS -655360000.000 655359999.695 /end CHARACTERISTIC
/begin CHARACTERISTIC BattU_RmpSlpPos_C "Positive ramp slope threshold value for devlibTransStage structure" VALUE 0x805079B0 RB_Val_Ws32 655358999.634 RmpVoltBatt 1000.061 655359999.695 FORMAT "%13.3" EXTENDED_LIMITS -655360000.000 655359999.695 /end CHARACTERISTIC
/begin CHARACTERISTIC BattU_stPwrStgDiaDis_C "Status of Power Stage Diagnostic Discrete" VALUE 0x80507996 RB_Val_Wu16 65535.00 OneToOne 0.00 65535.00 FORMAT "%8.2" /end CHARACTERISTIC
/begin CHARACTERISTIC BattU_stSensId_C "Status of the Sensor ID word of the Device Library Transition Stage which is used to calculate battery voltage" VALUE 0x805079B4 RB_Val_Wu8 255.0 OneToOne 0.00 255.0 FORMAT "%5.1" /end CHARACTERISTIC
/begin CHARACTERISTIC BattU_swtCorFacActv_C "Switch for enabling battery factor correction calculation" VALUE 0x805079B5 RB_Val_Wu8 255.0 OneToOne 0.00 255.0 FORMAT "%5.1" /end CHARACTERISTIC
/begin CHARACTERISTIC BattU_swtRated_C "Switch for rated voltage selection" VALUE 0x805079B6 RB_Val_Wu8 255.0 OneToOne 0.00 255.0 FORMAT "%5.1" /end CHARACTERISTIC
/begin CHARACTERISTIC BattU_tiCSTDef_C "CST Defect time" VALUE 0x80507998 RB_Val_Ws16 655350.0 Time_ms -327680.0 327670.0 FORMAT "%8.1" /end CHARACTERISTIC
/begin CHARACTERISTIC BattU_tiIgnONDlyThd_C "Ignition ON delay time threshold" VALUE 0x805079B8 RB_Val_Wu16 655.3500 Time_s 0.00 655.3500 FORMAT "%8.4" /end CHARACTERISTIC
/begin CHARACTERISTIC BattU_tiSensLo_C "Delay time to detect battery voltage in normal state" VALUE 0x805079BA RB_Val_Wu16 655350.0 Time_ms 0.00 655350.0 FORMAT "%8.1" /end CHARACTERISTIC
/begin CHARACTERISTIC BattU_tiSRCActvDly_C "Delay Time to enable SRC high and Low check if engine is in RUNNING" VALUE 0x805079BC RB_Val_Ws32 42949672.9500 Time_s -21474836.4800 21474836.4700 FORMAT "%13.4" /end CHARACTERISTIC
/begin CHARACTERISTIC BattU_tiStabPsOffDly_C "Stable Powerstae OFF Delay" VALUE 0x8050799A RB_Val_Ws16 655350.0 Time_ms -327680.0 327670.0 FORMAT "%8.1" /end CHARACTERISTIC
/begin CHARACTERISTIC BattU_tiStabPsOnDly_C "Stable Powerstae ON Delay" VALUE 0x8050799C RB_Val_Ws16 655350.0 Time_ms -327680.0 327670.0 FORMAT "%8.1" /end CHARACTERISTIC
/begin CHARACTERISTIC BattU_uHiUFailrThd_C "Battery voltage high failure determination threshold" VALUE 0x805079C0 RB_Val_Ws16 1310700. Volt_Batt -655360.0 655340.0 FORMAT "%8.1" /end CHARACTERISTIC
/begin CHARACTERISTIC BattU_uLoUFailrThd_C "Battery voltage low failure determination threshold" VALUE 0x805079C2 RB_Val_Ws16 1310700. Volt_Batt -655360.0 655340.0 FORMAT "%8.1" /end CHARACTERISTIC
/begin CHARACTERISTIC BattU_uNrm_C "Normal battery voltage to calculate the correction factor" VALUE 0x805079C4 RB_Val_Ws16 1310700. Volt_Batt -655360.0 655340.0 FORMAT "%8.1" /end CHARACTERISTIC
/begin CHARACTERISTIC BattU_uSensLo_C "Sensed battery low voltage" VALUE 0x805079C6 RB_Val_Ws16 1310700. Volt_Batt -655360.0 655340.0 FORMAT "%8.1" /end CHARACTERISTIC
/begin CHARACTERISTIC BattU_uSnsrFildIni_C "Initial value for battery sensored filter" VALUE 0x805079C8 RB_Val_Ws16 1310700. Volt_Batt -655360.0 655340.0 FORMAT "%8.1" /end CHARACTERISTIC
/begin CHARACTERISTIC BattU_uSRCMax_C "Max. voltage for SRC high check" VALUE 0x805079CA RB_Val_Ws16 13107.00 Volt -6553.600 6553.400 FORMAT "%8.3" /end CHARACTERISTIC
/begin CHARACTERISTIC BattU_uSRCMin_C "Min. voltage for SRC low check" VALUE 0x805079CC RB_Val_Ws16 13107.00 Volt -6553.600 6553.400 FORMAT "%8.3" /end CHARACTERISTIC
/begin CHARACTERISTIC BattU_uTransDft_C "Battery voltage Transition default value in case of devlib" VALUE 0x805079CE RB_Val_Wu16 28600.00 Volt_Batt 0.00 28600.00 FORMAT "%8.2" EXTENDED_LIMITS 0.00 1310700. /end CHARACTERISTIC
/begin CHARACTERISTIC BattU_uTransf_CUR "Transformation curve for battery voltage" CURVE 0x80507954 RB_Curve_S16_S16 1310700. Volt_Batt -655360.0 655340.0 FORMAT "%8.1"
 /begin AXIS_DESCR STD_AXIS BattU_uRaw_mp Volt 16 -6553.600 6553.400 FORMAT "%8.3" DEPOSIT ABSOLUTE /end AXIS_DESCR
/end CHARACTERISTIC
/begin CHARACTERISTIC BattU_uWrgDetnPrevnThd_C "Battery voltage threshold to prevent wrong detection" VALUE 0x805079D0 RB_Val_Ws16 1310700. Volt_Batt -655360.0 655340.0 FORMAT "%8.1" /end CHARACTERISTIC
/begin CHARACTERISTIC BattU_vSRCMaxLim_C "Vehicle speed threshold to perform the SRC high check" VALUE 0x805079D2 RB_Val_Ws16 655.3500 Vel -327.6800 327.6700 FORMAT "%8.4" /end CHARACTERISTIC
/begin CHARACTERISTIC Batt_tiCSTWarrant_C "CST warrant delay threshold timer to avoid On-Off-On in short time" VALUE 0x8050799E RB_Val_Wu16 655350.0 Time_ms 0.00 655350.0 FORMAT "%8.1" /end CHARACTERISTIC
/begin CHARACTERISTIC Batt_tiUStabAftStrt_C "Time for voltage stable after start" VALUE 0x805079A0 RB_Val_Wu16 655350.0 Time_ms 0.00 655350.0 FORMAT "%8.1" /end CHARACTERISTIC
/begin CHARACTERISTIC ComEBS_iStByCurrAft0hTypBOfs_C "Calibration for offset of ast stand-by current after ignition off" VALUE 0x80507938 RB_Val_Ws16 655.3500 i_q0p01_A -327.6800 327.6700 FORMAT "%8.4" /end CHARACTERISTIC
/begin CHARACTERISTIC ComEBS_iStByCurrTypBSlp_C "Calibration for slope of last stand-by current after ignition off" VALUE 0x8050793C RB_Val_Ws32 429.496729500 Slope -214.748364800 214.748364700 FORMAT "%13.9" /end CHARACTERISTIC
/begin CHARACTERISTIC ComEBS_qStByCurrAft1hTypBOfs_C "Offset for Stand-by current at 1 hour after ignition off" VALUE 0x80507940 RB_Val_Ws16 655.3500 q0p01_A_h_1 -327.6800 327.6700 FORMAT "%8.4" /end CHARACTERISTIC
/begin CHARACTERISTIC ComEBS_qStByCurrAft2hTypBOfs_C "Offset for Stand-by current at 2 hour after ignition off" VALUE 0x80507942 RB_Val_Ws16 655.3500 q0p01_A_h_1 -327.6800 327.6700 FORMAT "%8.4" /end CHARACTERISTIC
/begin CHARACTERISTIC ComEBS_qStByCurrLstTypBOfs_C "Offset for Last stand-by current after ignition off" VALUE 0x80507944 RB_Val_Ws16 655.3500 q0p01_A_h_1 -327.6800 327.6700 FORMAT "%8.4" /end CHARACTERISTIC
/begin CHARACTERISTIC Com_dEBSDByt0_C "Calibration for initial value of Com_dEBSDByt0" VALUE 0x80507946 RB_Val_Wu8 255.0 OneToOne 0.00 255.0 FORMAT "%5.1" /end CHARACTERISTIC
/begin CHARACTERISTIC Com_dEBSDByt1_C "Calibration for initial value of Com_dEBSDByt1" VALUE 0x80507947 RB_Val_Wu8 255.0 OneToOne 0.00 255.0 FORMAT "%5.1" /end CHARACTERISTIC
/begin CHARACTERISTIC Com_dEBSDByt2_C "Calibration for initial value of Com_dEBSDByt2" VALUE 0x80507948 RB_Val_Wu8 255.0 OneToOne 0.00 255.0 FORMAT "%5.1" /end CHARACTERISTIC
/begin CHARACTERISTIC Com_dEBSDByt3_C "Calibration for initial value of Com_dEBSDByt3" VALUE 0x80507949 RB_Val_Wu8 255.0 OneToOne 0.00 255.0 FORMAT "%5.1" /end CHARACTERISTIC
/begin CHARACTERISTIC Com_dEBSDByt4_C "Calibration for initial value of Com_dEBSDByt4" VALUE 0x8050794A RB_Val_Wu8 255.0 OneToOne 0.00 255.0 FORMAT "%5.1" /end CHARACTERISTIC
/begin CHARACTERISTIC EBS_qNorm_C "Callibration for battery state of health with respect to charge capacity" VALUE 0x8050794C RB_Val_Ws16 8191.875 ElecChrg_Ah_q0p125_COMPU -4096.000 4095.875 FORMAT "%8.3" /end CHARACTERISTIC
/begin CHARACTERISTIC PSPVDKUG "Ratio pspvdk not reduced" VALUE 0x804FF3BA RB_Val_Wu16 1.999969 fak_uw_b2 0.00 1.999969 FORMAT "%8.6" READ_ONLY /end CHARACTERISTIC
/begin CHARACTERISTIC TDUBEVAB "Debouncing time for injector cut-off due to low on-board power supply voltage" VALUE 0x80507950 RB_Val_Wu8 25.50 t_q0p1 0.00 25.50 FORMAT "%5.2" /end CHARACTERISTIC
/begin CHARACTERISTIC UBEVABW "threshold of the battery voltage for the injection valve cutoff" VALUE 0x80507952 RB_Val_Wu16 1538.827 spg_uw_q0p023481 0.00 1538.827 FORMAT "%8.3" /end CHARACTERISTIC
/begin CHARACTERISTIC Vlvlft_agOffsSafeSwt_C "Valve Lift Angle crank for switch intake" VALUE 0x804FF3BC RB_Val_Wu16 65535.00 kw_q1 0.00 65535.00 FORMAT "%8.2" /end CHARACTERISTIC
/begin CHARACTERISTIC Vlvlft_nrCylActrIntk_T "Allocate Cylinder to corresponding actuator" VAL_BLK 0x804FF3BE RB_ValA_Wu8 255.0 dez 0.00 255.0 FORMAT "%5.1" NUMBER 8 /end CHARACTERISTIC
/begin CHARACTERISTIC VlvLft_nrSegOffsTrigChrgDetrmIntk_C "No of segments offset for delaying aircharge calculation signal one synchro before expected valve switch." VALUE 0x804FF3C6 RB_Val_Wu8 8.000 dez 0.00 8.000 FORMAT "%5.3" EXTENDED_LIMITS 0.00 255.0 /end CHARACTERISTIC
/begin CHARACTERISTIC VlvLft_percAirChrgChgThd_C "Threshold for dynamic relative air charge for DK when switching air actuators" VALUE 0x804FF3C8 RB_Val_Ws16 1535.977 rel_q0p0234 -768.0000 767.9766 FORMAT "%8.4" /end CHARACTERISTIC
/begin CHARACTERISTIC VlvLft_selStdLftCfg_C "Codeword to select Standard Lift configuration" VALUE 0x804FF3CA RB_Val_Wu8 255.0 dez 0.00 255.0 FORMAT "%5.1" /end CHARACTERISTIC
/begin CHARACTERISTIC Vlvlft_tiEleclDlySpclIntk_M "Map for Electrical delay during Special Lift" MAP 0x804FF3CB RB_Map_U8U8_U8 255.0 t_q1_ms 0.00 255.0 FORMAT "%5.1"
 /begin AXIS_DESCR STD_AXIS NO_INPUT_QUANTITY temp_ub_q0p75_o48 6 -48.0 143.3 FORMAT "%5.1" DEPOSIT ABSOLUTE /end AXIS_DESCR
 /begin AXIS_DESCR STD_AXIS NO_INPUT_QUANTITY spg_q0p1 6 0.00 25.50 FORMAT "%5.2" DEPOSIT ABSOLUTE /end AXIS_DESCR
/end CHARACTERISTIC
/begin CHARACTERISTIC Vlvlft_tiEleclDlyStdIntk_M "Map for Electrical delay during Standard Lift" MAP 0x804FF3FD RB_Map_U8U8_U8 255.0 t_q1_ms 0.00 255.0 FORMAT "%5.1"
 /begin AXIS_DESCR STD_AXIS NO_INPUT_QUANTITY temp_ub_q0p75_o48 6 -48.0 143.3 FORMAT "%5.1" DEPOSIT ABSOLUTE /end AXIS_DESCR
 /begin AXIS_DESCR STD_AXIS NO_INPUT_QUANTITY spg_q0p1 6 0.00 25.50 FORMAT "%5.2" DEPOSIT ABSOLUTE /end AXIS_DESCR
/end CHARACTERISTIC
/begin CHARACTERISTIC Vlvlft_tiMeclDlySpclIntk_M "Map for Mechanical delay during Special Lift" MAP 0x804FF42F RB_Map_U8U8_U8 255.0 t_q1_ms 0.00 255.0 FORMAT "%5.1"
 /begin AXIS_DESCR STD_AXIS NO_INPUT_QUANTITY temp_ub_q0p75_o48 6 -48.0 143.3 FORMAT "%5.1" DEPOSIT ABSOLUTE /end AXIS_DESCR
 /begin AXIS_DESCR STD_AXIS NO_INPUT_QUANTITY nmot_ub_q40 6 0.00 10200. FORMAT "%5.0" DEPOSIT ABSOLUTE /end AXIS_DESCR
/end CHARACTERISTIC
/begin CHARACTERISTIC Vlvlft_tiMeclDlyStdIntk_M "Map for Mechanical delay during Standard Lift" MAP 0x804FF461 RB_Map_U8U8_U8 255.0 t_q1_ms 0.00 255.0 FORMAT "%5.1"
 /begin AXIS_DESCR STD_AXIS NO_INPUT_QUANTITY temp_ub_q0p75_o48 6 -48.0 143.3 FORMAT "%5.1" DEPOSIT ABSOLUTE /end AXIS_DESCR
 /begin AXIS_DESCR STD_AXIS NO_INPUT_QUANTITY nmot_ub_q40 6 0.00 10200. FORMAT "%5.0" DEPOSIT ABSOLUTE /end AXIS_DESCR
/end CHARACTERISTIC
/begin CHARACTERISTIC Vlvlft_tiOilPDlySpclIntk_M "Map for pressure pump delay during Special Lift" MAP 0x804FF494 RB_Map_S16S16_S16 510.0000 t_q1_ms -255.0000 255.0000 FORMAT "%8.4" EXTENDED_LIMITS -32768.00 32767.00
 /begin AXIS_DESCR STD_AXIS NO_INPUT_QUANTITY temp_ub_q0p75_o48 6 -48.0000 143.2500 FORMAT "%8.4" EXTENDED_LIMITS -24624.00 24527.25 DEPOSIT ABSOLUTE /end AXIS_DESCR
 /begin AXIS_DESCR STD_AXIS NO_INPUT_QUANTITY Pres 6 0.00 1638.300 FORMAT "%8.3" EXTENDED_LIMITS -3276.800 3276.700 DEPOSIT ABSOLUTE /end AXIS_DESCR
/end CHARACTERISTIC
/begin CHARACTERISTIC Vlvlft_tiOilPDlyStdIntk_M "Map for pressure pump delay during Standard Lift" MAP 0x804FF4F8 RB_Map_S16S16_S16 510.0000 t_q1_ms -255.0000 255.0000 FORMAT "%8.4" EXTENDED_LIMITS -32768.00 32767.00
 /begin AXIS_DESCR STD_AXIS NO_INPUT_QUANTITY temp_ub_q0p75_o48 6 -48.0000 143.2500 FORMAT "%8.4" EXTENDED_LIMITS -24624.00 24527.25 DEPOSIT ABSOLUTE /end AXIS_DESCR
 /begin AXIS_DESCR STD_AXIS NO_INPUT_QUANTITY Pres 6 0.00 1638.300 FORMAT "%8.3" EXTENDED_LIMITS -3276.800 3276.700 DEPOSIT ABSOLUTE /end AXIS_DESCR
/end CHARACTERISTIC
/begin MEASUREMENT arqttev_w_msg "Set value by tester for canister purge valve" SWORD rel_q0p01 1 100 -327.6800 327.6700 FORMAT "%8.4" ECU_ADDRESS 0x60004DE4 /end MEASUREMENT
/begin MEASUREMENT ASDrf_bATSlipOpnInhb "Bit status indicating converter slip open inhibition for Automatic Transmission" UBYTE B_TRUE 1 100 0.00 1.00000000000 BIT_MASK 0x1 FORMAT "%13.11" ECU_ADDRESS 0x60009C45 /end MEASUREMENT
/begin MEASUREMENT ASDrf_bCalcTrqBs "calculation base torque active" UBYTE B_TRUE 1 100 0.00 1.00000000000 BIT_MASK 0x1 FORMAT "%13.11" ECU_ADDRESS 0x6000A25B /end MEASUREMENT
/begin MEASUREMENT ASDrf_bCalcTrqBsFF_I.status "flip-flop calculation base torque active / current value of RS-FF" UBYTE B_TRUE 1 100 0.00 1.00000000000 BIT_MASK 0x1 FORMAT "%13.11" ECU_ADDRESS 0x6000E38E /end MEASUREMENT
/begin MEASUREMENT ASDrf_bConvSlipOpn "Converter slip open" UBYTE B_TRUE 1 100 0.00 1.00000000000 BIT_MASK 0x1 FORMAT "%13.11" ECU_ADDRESS 0x6000A25A /end MEASUREMENT
/begin MEASUREMENT ASDrf_bNCmp "engine speed lower than turbin speed" UBYTE B_TRUE 1 100 0.00 1.00000000000 BIT_MASK 0x1 FORMAT "%13.11" ECU_ADDRESS 0x6000A258 /end MEASUREMENT
/begin MEASUREMENT ASDrf_bNCmpCvt "engine speed lower than turbin speed for CVT" UBYTE B_TRUE 1 100 0.00 1.00000000000 BIT_MASK 0x1 FORMAT "%13.11" ECU_ADDRESS 0x6000A257 /end MEASUREMENT
/begin MEASUREMENT ASDrf_bNCmpFF_I.status "flip-flop slip open active / current value of RS-FF" UBYTE B_TRUE 1 100 0.00 1.00000000000 BIT_MASK 0x1 FORMAT "%13.11" ECU_ADDRESS 0x6000E38F /end MEASUREMENT
/begin MEASUREMENT ASDrf_bNoGrip "Open Clutch from view of ASDrf" UBYTE B_TRUE 1 100 0.00 1.00000000000 BIT_MASK 0x1 FORMAT "%13.11" ECU_ADDRESS 0x6000A256 /end MEASUREMENT
/begin MEASUREMENT ASDrf_bSlipOpnActv "slip open active" UBYTE B_TRUE 1 100 0.00 1.00000000000 BIT_MASK 0x1 FORMAT "%13.11" ECU_ADDRESS 0x6000A251 /end MEASUREMENT
/begin MEASUREMENT ASDrf_CoefA "coefficient A of the parabolic limiter" UBYTE q0p0625_DIV_Nm_s 1 100 0.00 15.94 FORMAT "%5.2" ECU_ADDRESS 0x70002D76 /end MEASUREMENT
/begin MEASUREMENT ASDrf_CoefB "coefficient B of the parabolic limiter" UBYTE mdgrad_q10 1 100 10. 2550. FORMAT "%5.0" ECU_ADDRESS 0x70002D77 /end MEASUREMENT
/begin MEASUREMENT ASDrf_ctIniDrvSelPar10ms "drive cycle counter 10ms-task" UBYTE OneToOne 1 100 0.00 255.0 FORMAT "%5.1" ECU_ADDRESS 0x6000E395 /end MEASUREMENT
/begin MEASUREMENT ASDrf_dtqERNM_I.oldSignal "rising edge for reset of calculation base torque active / value of input signal last calculation" UBYTE B_TRUE 1 100 0.00 1.00000000000 BIT_MASK 0x1 FORMAT "%13.11" ECU_ADDRESS 0x60009C44 /end MEASUREMENT
/begin MEASUREMENT ASDrf_dtqTOFFVNM_I.time "turn off delay for reset of calculation base torque active / delay time" UBYTE t_q0p01 1 100 0.00 2.550 FORMAT "%5.3" ECU_ADDRESS 0x60009C43 /end MEASUREMENT
/begin MEASUREMENT ASDrf_facDesDyn "Factor driving dynamic" SWORD Fact 1 100 -4.000000 3.999878 FORMAT "%8.6" ECU_ADDRESS 0x600052BA /end MEASUREMENT
/begin MEASUREMENT ASDrf_flgSptModActv "Flag to indicate sport mode related drivability parameters are active" UBYTE B_TRUE 1 100 0.00 1.00000000000 BIT_MASK 0x1 FORMAT "%13.11" ECU_ADDRESS 0x6000A250 /end MEASUREMENT
/begin MEASUREMENT ASDrf_flgTrsmMtModActv "manual gear mode active" UBYTE B_TRUE 1 100 0.00 1.00000000000 BIT_MASK 0x1 FORMAT "%13.11" ECU_ADDRESS 0x6000A24F /end MEASUREMENT
/begin MEASUREMENT ASDrf_KdFltSet "factor: not filtered drivers request" UBYTE fak_ub_b2 1 100 0.00 1.000000 FORMAT "%8.6" ECU_ADDRESS 0x6000E3E7 /end MEASUREMENT
/begin MEASUREMENT ASDrf_nPt "speed powertrain" SWORD EngN 1 100 -16384.00 16383.50 FORMAT "%8.2" ECU_ADDRESS 0x600052B8 /end MEASUREMENT
/begin MEASUREMENT ASDrf_nThresNCmp "Correction of turbine rpm during open converter clutch" SWORD nmot_q0p5 1 100 -16384.00 16383.50 FORMAT "%8.2" ECU_ADDRESS 0x70002C1C /end MEASUREMENT
/begin MEASUREMENT ASDrf_posSlipOpnER_I.buffer "rising edge torque gradient for slip open active / rising edge detected" UBYTE B_TRUE 1 100 0.00 1.00000000000 BIT_MASK 0x1 FORMAT "%13.11" ECU_ADDRESS 0x60003FD0 /end MEASUREMENT
/begin MEASUREMENT ASDrf_posSlipOpnER_I.oldSignal "rising edge torque gradient for slip open active / flag rising edge" UBYTE B_TRUE 1 100 0.00 1.00000000000 BIT_MASK 0x1 FORMAT "%13.11" ECU_ADDRESS 0x60003FD1 /end MEASUREMENT
/begin MEASUREMENT ASDrf_ratSlipOpenCmp "Open Slip compensation" UWORD CrCtlSlipRat 1 100 0.00 327.6750 FORMAT "%8.4" ECU_ADDRESS 0x60003FD8 /end MEASUREMENT
/begin MEASUREMENT ASDrf_rConvSlip "Ratio of Turbine speed to engine speed in percentage" UWORD CrCtlSlipRat 1 100 0.00 327.6750 FORMAT "%8.4" ECU_ADDRESS 0x60004DB4 /end MEASUREMENT
/begin MEASUREMENT ASDrf_stEngOperModSeln "Satus to select drivability mode for parameter" UBYTE OneToOne 1 100 0.00 255.0 FORMAT "%5.1" ECU_ADDRESS 0x70001A9C /end MEASUREMENT
/begin MEASUREMENT ASDrf_stParSet "status acktive set of parameter" UWORD dez 1 100 0.00 65535.00 FORMAT "%8.2" ECU_ADDRESS 0x70002B62 /end MEASUREMENT
/begin MEASUREMENT ASDrf_tiFltSet "time constant set path" UBYTE t_q0p01 1 100 0.010 2.550 FORMAT "%5.3" ECU_ADDRESS 0x6000E3E8 /end MEASUREMENT
/begin MEASUREMENT ASDrf_tqCluBas "base torque clutch torque level" SWORD Trq 1 100 -3276.800 3276.700 FORMAT "%8.3" ECU_ADDRESS 0x600052B6 /end MEASUREMENT
/begin MEASUREMENT ASDrf_tqCluBasc "basic clutch torque" SWORD Trq 1 100 -3276.800 3276.700 FORMAT "%8.3" ECU_ADDRESS 0x600052B2 /end MEASUREMENT
/begin MEASUREMENT ASDrf_tqCluBasLead "base torque clutch torque level for lead path" SWORD Trq 1 100 -3276.800 3276.700 FORMAT "%8.3" ECU_ADDRESS 0x600052B4 /end MEASUREMENT
/begin MEASUREMENT ASDrf_tqCluDemSet "set torque before ASD clutch torque level" SWORD Trq 1 100 -3276.800 3276.700 FORMAT "%8.3" ECU_ADDRESS 0x600052B0 /end MEASUREMENT
/begin MEASUREMENT ASDrf_tqLossBasc "Torque loss Bsis" SWORD Trq 1 100 -3276.800 3276.700 FORMAT "%8.3" ECU_ADDRESS 0x60003FD6 /end MEASUREMENT
/begin MEASUREMENT ASDrf_trqLosClthComp "Torque loss clutch compensation" SWORD Trq 1 100 -3276.800 3276.700 FORMAT "%8.3" ECU_ADDRESS 0x60003FD4 /end MEASUREMENT
/begin MEASUREMENT ASDrf_trqLosComp "Torque loss compensation" SWORD Trq 1 100 -3276.800 3276.700 FORMAT "%8.3" ECU_ADDRESS 0x60003FD2 /end MEASUREMENT
/begin MEASUREMENT ASDrf_trqLosSet "reference torque for ASD" SWORD Trq 1 100 -3276.800 3276.700 FORMAT "%8.3" ECU_ADDRESS 0x600052A4 /end MEASUREMENT
/begin MEASUREMENT ATS_ctCurRunTst "" UBYTE OneToOne 1 100 0.00 255.0 FORMAT "%5.1" ECU_ADDRESS 0x6000A795 /end MEASUREMENT
/begin MEASUREMENT ATS_IntvVal_mp "Intervention value" SWORD OneToOne 1 100 -32768.00 32767.00 FORMAT "%8.2" ECU_ADDRESS 0x700089C8 /end MEASUREMENT
/begin MEASUREMENT ATS_stMon "status of ATS internal monitoring" UBYTE OneToOne 1 100 0.00 255.0 FORMAT "%5.1" ECU_ADDRESS 0x6000A801 /end MEASUREMENT
/begin MEASUREMENT ATS_stMonTimeLimit "Behaviour time limit response for new tester demands" UBYTE OneToOne 1 100 0.00 255.0 FORMAT "%5.1" ECU_ADDRESS 0x6000A794 /end MEASUREMENT
/begin MEASUREMENT ATS_TstStatus_mp "Status of actuatorintervention" UBYTE OneToOne 1 100 0.00 255.0 FORMAT "%5.1" ECU_ADDRESS 0x70008ABC /end MEASUREMENT
/begin MEASUREMENT BattU_cntrReIni "Control ReInitialization" UBYTE OneToOne 1 100 0.00 255.0 FORMAT "%5.1" ECU_ADDRESS 0x60009C34 /end MEASUREMENT
/begin MEASUREMENT BattU_facCor "Correction factor for battery voltage" SWORD Fact 1 100 -4.000000 3.999878 FORMAT "%8.6" ECU_ADDRESS 0x6000526A /end MEASUREMENT
/begin MEASUREMENT BattU_flgChrgrCnctd "Flag indicates the charger is connected" UBYTE B_TRUE 1 100 0.00 1.00000000000 BIT_MASK 0x1 FORMAT "%13.11" ECU_ADDRESS 0x60009C33 /end MEASUREMENT
/begin MEASUREMENT BattU_flgEEPWriteRetVal "EEP write block status BATTUSTBYDIA" UBYTE B_TRUE 1 100 0.00 1.00000000000 BIT_MASK 0x1 FORMAT "%13.11" ECU_ADDRESS 0x600006CC /end MEASUREMENT
/begin MEASUREMENT BattU_flgErrDSQ "Temp flag signal indicates low under voltage" UBYTE B_TRUE 1 100 0.00 1.00000000000 BIT_MASK 0x1 FORMAT "%13.11" ECU_ADDRESS 0x60009C32 /end MEASUREMENT
/begin MEASUREMENT BattU_flgHiUFailrCfmd "Battery voltage high failure confirmed flag" UBYTE B_TRUE 1 100 0.00 1.00000000000 BIT_MASK 0x1 FORMAT "%13.11" ECU_ADDRESS 0x6000A228 /end MEASUREMENT
/begin MEASUREMENT BattU_flgHiUNormCfmd "Battery voltage high normal confirmed flag" UBYTE B_TRUE 1 100 0.00 1.00000000000 BIT_MASK 0x1 FORMAT "%13.11" ECU_ADDRESS 0x6000A227 /end MEASUREMENT
/begin MEASUREMENT BattU_flgIgnOnDlyDiagEna "Ignition delay for diagnosis enable" UBYTE B_TRUE 1 100 0.00 1.00000000000 BIT_MASK 0x1 FORMAT "%13.11" ECU_ADDRESS 0x60009C31 /end MEASUREMENT
/begin MEASUREMENT BattU_flgLoUFailrCfmd "Battery voltage low failure confirmed flag" UBYTE B_TRUE 1 100 0.00 1.00000000000 BIT_MASK 0x1 FORMAT "%13.11" ECU_ADDRESS 0x6000A226 /end MEASUREMENT
/begin MEASUREMENT BattU_flgLoUNormCfmd "Battery voltage low normal confirmed flag" UBYTE B_TRUE 1 100 0.00 1.00000000000 BIT_MASK 0x1 FORMAT "%13.11" ECU_ADDRESS 0x6000A225 /end MEASUREMENT
/begin MEASUREMENT BattU_flgPwrFail "Flag for interruption of power supply" UBYTE B_TRUE 1 100 0.00 1.00000000000 BIT_MASK 0x1 FORMAT "%13.11" ECU_ADDRESS 0x60009FC8 /end MEASUREMENT
/begin MEASUREMENT Battu_flgRstrtReq "Engine restart request from engine-stall or IS restart" UBYTE B_TRUE 1 100 0.00 1.00000000000 BIT_MASK 0x1 FORMAT "%13.11" ECU_ADDRESS 0x60009C37 /end MEASUREMENT
/begin MEASUREMENT BattU_flgUStab "Voltage stable after start" UBYTE B_TRUE 1 100 0.00 1.00000000000 BIT_MASK 0x1 FORMAT "%13.11" ECU_ADDRESS 0x60009C36 /end MEASUREMENT
/begin MEASUREMENT BattU_NrEveCntr "Error counter for DFC" UWORD OneToOne 1 100 0.00 65535.00 FORMAT "%8.2" ECU_ADDRESS 0x600003F2 /end MEASUREMENT
/begin MEASUREMENT BattU_PrevErrSt "Status of perivous error state" UBYTE B_TRUE 1 100 0.00 1.00000000000 BIT_MASK 0x1 FORMAT "%13.11" ECU_ADDRESS 0x600006CB /end MEASUREMENT
/begin MEASUREMENT BattU_SensBuf "Sensor Buffer" SWORD Volt 1 100 -6553.600 6553.400 FORMAT "%8.3" ARRAY_SIZE 11 ECU_ADDRESS 0x60003FA8 /end MEASUREMENT
/begin MEASUREMENT BattU_SensBufLoc "Intermediate buffer for sorting values from ADC" SWORD Volt 1 100 -6553.600 6553.400 FORMAT "%8.3" ARRAY_SIZE 11 ECU_ADDRESS 0x50005228 /end MEASUREMENT
/begin MEASUREMENT BattU_stCSTEnbl_mp "Status of CST Enable" UBYTE B_TRUE 1 100 0.00 1.00000000000 BIT_MASK 0x1 FORMAT "%13.11" ECU_ADDRESS 0x70009291 /end MEASUREMENT
/begin MEASUREMENT BattU_stDiagCmpl_mp "Status of Diagnosis Complete" UBYTE B_TRUE 1 100 0.00 1.00000000000 BIT_MASK 0x1 FORMAT "%13.11" ECU_ADDRESS 0x70009290 /end MEASUREMENT
/begin MEASUREMENT BattU_stEEPBlockRetVal "EEP read block Status of BATTUSTBYDIA" UBYTE OneToOne 1 100 0.00 255.0 FORMAT "%5.1" ECU_ADDRESS 0x60009C35 /end MEASUREMENT
/begin MEASUREMENT BattU_stEepEveCnt "EEP read Status of defect counter" UBYTE OneToOne 1 100 0.00 255.0 FORMAT "%5.1" ECU_ADDRESS 0x600006CD /end MEASUREMENT
/begin MEASUREMENT BattU_stEepPrevErr "EEP read Status of Pervious erorr state" UBYTE OneToOne 1 100 0.00 255.0 FORMAT "%5.1" ECU_ADDRESS 0x600006CE /end MEASUREMENT
/begin MEASUREMENT BattU_stEngCmbCmpl "Engine combustion complete flag" UBYTE OneToOne 1 100 0.00 255.0 FORMAT "%5.1" ECU_ADDRESS 0x6000A6AA /end MEASUREMENT
/begin MEASUREMENT BattU_stErrDSQ "Signal indicates low under voltage" UBYTE OneToOne 1 100 0.00 255.0 FORMAT "%5.1" ECU_ADDRESS 0x6000A6A9 /end MEASUREMENT
/begin MEASUREMENT BattU_stFltTstEnaCond_mp "Status of Fault Test Enable Condition" UBYTE B_TRUE 1 100 0.00 1.00000000000 BIT_MASK 0x1 FORMAT "%13.11" ECU_ADDRESS 0x7000928F /end MEASUREMENT
/begin MEASUREMENT BattU_stFltTstRst_mp "Status of Fault Test Reset" UBYTE B_TRUE 1 100 0.00 1.00000000000 BIT_MASK 0x1 FORMAT "%13.11" ECU_ADDRESS 0x7000928E /end MEASUREMENT
/begin MEASUREMENT BattU_stPwrFail "State interruption of power supply" UBYTE B_TRUE 1 100 0.00 1.00000000000 BIT_MASK 0x1 FORMAT "%13.11" ECU_ADDRESS 0x60009FC7 /end MEASUREMENT
/begin MEASUREMENT BattU_stStabPs "Status of boost converter activation" UBYTE B_TRUE 1 100 0.00 1.00000000000 BIT_MASK 0x1 FORMAT "%13.11" ECU_ADDRESS 0x6000A224 /end MEASUREMENT
/begin MEASUREMENT BattU_tiCSTDef_mp "CST Defect time" SWORD Time_ms 1 100 -327680.0 327670.0 FORMAT "%8.1" ECU_ADDRESS 0x7000928C /end MEASUREMENT
/begin MEASUREMENT Battu_tiCSTWarrant "CST warrant delay timer to avoid On-Off-On in short time" UWORD Time_ms 1 100 0.00 655350.0 FORMAT "%8.1" ECU_ADDRESS 0x60003FA6 /end MEASUREMENT
/begin MEASUREMENT BattU_u "Battery voltage" SWORD Volt_Batt 1 100 -655360.0 655340.0 FORMAT "%8.1" ECU_ADDRESS 0x500059EA /end MEASUREMENT
/begin MEASUREMENT BattU_uBattDetnIMGCnv "Battery detection voltage of IMG ECU convert to mV" SWORD Volt_Batt 1 100 -655360.0 655340.0 FORMAT "%8.1" ECU_ADDRESS 0x60003FA4 /end MEASUREMENT
/begin MEASUREMENT BattU_uBattDetnTCUCnv "Battery detection voltage of TCU ECU convert to mV" SWORD Volt_Batt 1 100 -655360.0 655340.0 FORMAT "%8.1" ECU_ADDRESS 0x60003FA2 /end MEASUREMENT
/begin MEASUREMENT BattU_uRated "Rated battery voltage" SWORD Volt_Batt 1 100 -655360.0 655340.0 FORMAT "%8.1" ECU_ADDRESS 0x60005268 /end MEASUREMENT
/begin MEASUREMENT BattU_uRaw "Battery voltage before defect detection and handling" SWORD Volt 1 100 -6553.600 6553.400 FORMAT "%8.3" ECU_ADDRESS 0x60005266 /end MEASUREMENT
/begin MEASUREMENT BattU_uRaw_mp "Raw battery voltage measuring point" SWORD Volt 1 100 -6553.600 6553.400 FORMAT "%8.3" ECU_ADDRESS 0x70009292 /end MEASUREMENT
/begin MEASUREMENT BattU_uSens "Sensed battery voltage" SWORD Volt_Batt 1 100 -655360.0 655340.0 FORMAT "%8.1" ECU_ADDRESS 0x6000E12C /end MEASUREMENT
/begin MEASUREMENT BattU_uSnsrFild "Filtered battery sensored voltage" SWORD Volt_Batt 1 100 -655360.0 655340.0 FORMAT "%8.1" ECU_ADDRESS 0x60005264 /end MEASUREMENT
/begin MEASUREMENT B_cwdk_msg "device control DCPIDCM" UBYTE B_TRUE 1 100 0.00 1.00000000000 BIT_MASK 0x1 FORMAT "%13.11" ECU_ADDRESS 0x70000AA1 /end MEASUREMENT
/begin MEASUREMENT B_faevz_msg "condition cylinder fade out by tester" UBYTE B_TRUE 1 100 0.00 1.00000000000 BIT_MASK 0x1 FORMAT "%13.11" ECU_ADDRESS 0x70000A69 /end MEASUREMENT
/begin MEASUREMENT B_hrevab "demand injection valve cutoff at error of main relay" UBYTE B_TRUE 1 100 0.00 1.00000000000 BIT_MASK 0x1 FORMAT "%13.11" ECU_ADDRESS 0x600000F8 /end MEASUREMENT
/begin MEASUREMENT B_kdhre "condition switch on components supplied via main relay for UBR diagnosis purpose" UBYTE B_TRUE 1 100 0.00 1.00000000000 BIT_MASK 0x1 FORMAT "%13.11" ECU_ADDRESS 0x7000037E /end MEASUREMENT
/begin MEASUREMENT B_rqttev_msg "Condition request by tester for canister purge valve" UBYTE B_TRUE 1 100 0.00 1.00000000000 BIT_MASK 0x1 FORMAT "%13.11" ECU_ADDRESS 0x700009BA /end MEASUREMENT
/begin MEASUREMENT B_ubg "Validity of ub, ubsq, ubrsq" UBYTE B_TRUE 1 100 0.00 1.00000000000 BIT_MASK 0x1 FORMAT "%13.11" ECU_ADDRESS 0x600000F7 /end MEASUREMENT
/begin MEASUREMENT B_vhegfeloc "local variable for the mentioned label name in the var. e.g FC_var name" UBYTE B_TRUE 1 100 0.00 1.00000000000 BIT_MASK 0x1 FORMAT "%13.11" ECU_ADDRESS 0x70001BF4 /end MEASUREMENT
/begin MEASUREMENT B_vhegfe_msg "condition: high valve lift for timing of air charge determination ( one calculation step before calculation of air charge for switched cylinder)" UBYTE B_TRUE 1 100 0.00 1.00000000000 BIT_MASK 0x1 FORMAT "%13.11" ECU_ADDRESS 0x70001BF5 /end MEASUREMENT
/begin MEASUREMENT ComEBS_ctCrkngDetn "Number of times of cranking detection" UWORD OneToOne 1 100 0.00 65535.00 FORMAT "%8.2" ECU_ADDRESS 0x60004D9A /end MEASUREMENT
/begin MEASUREMENT ComEBS_ctMeasmtCrk "Cranking Measurement counter" UBYTE OneToOne 1 100 0.00 255.0 FORMAT "%5.1" ECU_ADDRESS 0x6000A651 /end MEASUREMENT
/begin MEASUREMENT ComEBS_ctResRpl "Ripple Ri update counter" UBYTE OneToOne 1 100 0.00 255.0 FORMAT "%5.1" ECU_ADDRESS 0x6000A650 /end MEASUREMENT
/begin MEASUREMENT ComEBS_iBattStrtCrn "Starting current at cranking" SWORD q1_om600_A 1 100 -33368.00 32167.00 FORMAT "%8.2" ECU_ADDRESS 0x600051C4 /end MEASUREMENT
/begin MEASUREMENT ComEBS_idBattData "Data identification" UBYTE OneToOne 1 100 0.00 255.0 FORMAT "%5.1" ECU_ADDRESS 0x6000A64F /end MEASUREMENT
/begin MEASUREMENT ComEBS_iMaxBattDcha "Max Discharge at cranking" SLONG q0p1_om1500_A 1 100 -214749864.800 214746864.700 FORMAT "%13.3" ECU_ADDRESS 0x60001D38 /end MEASUREMENT
/begin MEASUREMENT ComEBS_numBattPart "Part Number" UBYTE OneToOne 1 100 0.00 255.0 FORMAT "%5.1" ECU_ADDRESS 0x6000A64E /end MEASUREMENT
/begin MEASUREMENT ComEBS_numLowSOCDetn "Number of times of SOC 30 detection" UBYTE OneToOne 1 100 0.00 255.0 FORMAT "%5.1" ECU_ADDRESS 0x6000A64D /end MEASUREMENT
/begin MEASUREMENT ComEBS_resPul "Pulse Ri" UWORD q0p01_mOhm 1 100 0.00 655.3500 FORMAT "%8.4" ECU_ADDRESS 0x60004D98 /end MEASUREMENT
/begin MEASUREMENT ComEBS_resRpl "Ri_Ripple" UWORD q0p01_mOhm 1 100 0.00 655.3500 FORMAT "%8.4" ECU_ADDRESS 0x60004D96 /end MEASUREMENT
/begin MEASUREMENT ComEBS_stBattChg "Battery Change judgement" UBYTE OneToOne 1 100 0.00 255.0 FORMAT "%5.1" ECU_ADDRESS 0x6000A64C /end MEASUREMENT
/begin MEASUREMENT ComEBS_stBattComResErr "Communication response error" UBYTE OneToOne 1 100 0.00 255.0 FORMAT "%5.1" ECU_ADDRESS 0x6000A64B /end MEASUREMENT
/begin MEASUREMENT ComEBS_stBattSplrDiscern "Supplier discernment" UWORD OneToOne 1 100 0.00 65535.00 FORMAT "%8.2" ECU_ADDRESS 0x60004D94 /end MEASUREMENT
/begin MEASUREMENT ComEBS_stBattWrmLvl "Battery warm level" UBYTE OneToOne 1 100 0.00 255.0 FORMAT "%5.1" ECU_ADDRESS 0x6000A649 /end MEASUREMENT
/begin MEASUREMENT ComEBS_stChrgReq "Charge request state" UBYTE OneToOne 1 100 0.00 255.0 FORMAT "%5.1" ECU_ADDRESS 0x6000A648 /end MEASUREMENT
/begin MEASUREMENT ComEBS_stFitng "Fitting State" UBYTE OneToOne 1 100 0.00 255.0 FORMAT "%5.1" ECU_ADDRESS 0x6000A647 /end MEASUREMENT
/begin MEASUREMENT ComEBS_stHarnR "Harness Resistance state" UBYTE OneToOne 1 100 0.00 255.0 FORMAT "%5.1" ECU_ADDRESS 0x6000A646 /end MEASUREMENT
/begin MEASUREMENT ComEBS_stSensErrAftIgnOff "Battery Sensor error flag after IG OFF" UBYTE OneToOne 1 100 0.00 255.0 FORMAT "%5.1" ECU_ADDRESS 0x6000A645 /end MEASUREMENT
/begin MEASUREMENT ComEBS_stTermOffDetn "Terminal OFF Detection State" UBYTE OneToOne 1 100 0.00 255.0 FORMAT "%5.1" ECU_ADDRESS 0x6000A644 /end MEASUREMENT
/begin MEASUREMENT ComEBS_tBattResPul "Battery Fluid temperature at measuring pulse Ri" UBYTE q1_om40_DegCgrd 1 100 -40.0 215.0 FORMAT "%5.1" ECU_ADDRESS 0x6000A643 /end MEASUREMENT
/begin MEASUREMENT ComEBS_tBattSensASIC "ASIC temperature of EBS" UBYTE q1_om40_DegCgrd 1 100 -40.0 215.0 FORMAT "%5.1" ECU_ADDRESS 0x6000A642 /end MEASUREMENT
/begin MEASUREMENT ComEBS_tiBattON "Battery operating time" UWORD RBPtCel_ti_1p0_6 1 100 0.00 65535.00 FORMAT "%8.2" ECU_ADDRESS 0x60004D92 /end MEASUREMENT
/begin MEASUREMENT ComEBS_tiT15ON "IG-ON Elapsed time" UWORD RBPtCel_ti_1p0_4 1 100 0.00 65535.00 FORMAT "%8.2" ECU_ADDRESS 0x60004D90 /end MEASUREMENT
/begin MEASUREMENT ComEBS_tMaxBatt "Max T_BATT during soak" UBYTE q1_om40_DegCgrd 1 100 -40.0 215.0 FORMAT "%5.1" ECU_ADDRESS 0x6000A641 /end MEASUREMENT
/begin MEASUREMENT ComEBS_tMinBatt "Min T_BATT during soak" UBYTE q1_om40_DegCgrd 1 100 -40.0 215.0 FORMAT "%5.1" ECU_ADDRESS 0x6000A640 /end MEASUREMENT
/begin MEASUREMENT ComEBS_uBattSOFV "State of function with respect to voltage" SWORD q0p0625_V 1 100 -2048.000 2047.938 FORMAT "%8.3" ECU_ADDRESS 0x600051C0 /end MEASUREMENT
/begin MEASUREMENT ComEBS_uBattUCO "Battery quiescent voltage" SWORD u_Batt_V_q0p00097656 1 100 -32.00000 31.99902 FORMAT "%8.5" ECU_ADDRESS 0x600051BE /end MEASUREMENT
/begin MEASUREMENT ComEBS_xMnfcDate "Manufacure Date" UWORD OneToOne 1 100 0.00 65535.00 FORMAT "%8.2" ECU_ADDRESS 0x60004D8E /end MEASUREMENT
/begin MEASUREMENT Com_bBliChrg "Status of blind charging" UBYTE OneToOne 1 100 0.00 255.0 FORMAT "%5.1" ECU_ADDRESS 0x6000A63B /end MEASUREMENT
/begin MEASUREMENT Com_cntrIntResUpd "Value of EBS counter for internal resistance measurement" UBYTE OneToOne 1 100 0.00 255.0 FORMAT "%5.1" ECU_ADDRESS 0x6000A636 /end MEASUREMENT
/begin MEASUREMENT Com_dEBSDByt0 "EBSD Byte 0 Raw value" UBYTE OneToOne 1 100 0.00 255.0 FORMAT "%5.1" ECU_ADDRESS 0x6000A5F4 /end MEASUREMENT
/begin MEASUREMENT Com_dEBSDByt1 "EBSD Byte 1 Raw value" UBYTE OneToOne 1 100 0.00 255.0 FORMAT "%5.1" ECU_ADDRESS 0x6000A5F3 /end MEASUREMENT
/begin MEASUREMENT Com_dEBSDByt2 "EBSD Byte 2 Raw value" UBYTE OneToOne 1 100 0.00 255.0 FORMAT "%5.1" ECU_ADDRESS 0x6000A5F2 /end MEASUREMENT
/begin MEASUREMENT Com_dEBSDByt3 "EBSD Byte 3 Raw value" UBYTE OneToOne 1 100 0.00 255.0 FORMAT "%5.1" ECU_ADDRESS 0x6000A5F1 /end MEASUREMENT
/begin MEASUREMENT Com_dEBSDByt4 "EBSD Byte 4 Raw value" UBYTE OneToOne 1 100 0.00 255.0 FORMAT "%5.1" ECU_ADDRESS 0x6000A5F0 /end MEASUREMENT
/begin MEASUREMENT Com_flgEbsRst "Flag to indicate reset of EBS" UBYTE OneToOne 1 100 0.00 255.0 FORMAT "%5.1" ECU_ADDRESS 0x60000DDF /end MEASUREMENT
/begin MEASUREMENT Com_iBattEBS "Battery current from EBS" SLONG Curr_mA_q0p9765625_COMPU 1 100 -2097152000.00 2097151999.02 FORMAT "%13.2" ECU_ADDRESS 0x60001D30 /end MEASUREMENT
/begin MEASUREMENT Com_iStbIAft0Hr "Current value at IG-OFF timing" SWORD i_q0p01_A 1 100 -327.6800 327.6700 FORMAT "%8.4" ECU_ADDRESS 0x600051B8 /end MEASUREMENT
/begin MEASUREMENT Com_qChrg "Battery accumulated charge received from EBS" SLONG q0p01_A_h_1 1 100 -21474836.4800 21474836.4700 FORMAT "%13.4" ECU_ADDRESS 0x50004C08 /end MEASUREMENT
/begin MEASUREMENT Com_qDisChrg "Battery accumulated discharge received from EBS" SLONG q0p01_A_h_1 1 100 -21474836.4800 21474836.4700 FORMAT "%13.4" ECU_ADDRESS 0x50004C0C /end MEASUREMENT
/begin MEASUREMENT Com_qSoh "battery state of health with respect to charge capacity" SWORD ElecChrg_Ah_q0p125_COMPU 1 100 -4096.000 4095.875 FORMAT "%8.3" ECU_ADDRESS 0x600051A4 /end MEASUREMENT
/begin MEASUREMENT Com_qStbIAft1Hr "Current integration value during IG-OFF to 1 hour pass" SWORD q0p01_A_h_1 1 100 -327.6800 327.6700 FORMAT "%8.4" ECU_ADDRESS 0x600051A2 /end MEASUREMENT
/begin MEASUREMENT Com_qStbIAft2Hr "Current integration value during 1 hour to 2 hour" SWORD q0p01_A_h_1 1 100 -327.6800 327.6700 FORMAT "%8.4" ECU_ADDRESS 0x600051A0 /end MEASUREMENT
/begin MEASUREMENT Com_qStbILast "Current integration value during last 1 hour" SWORD q0p01_A_h_1 1 100 -327.6800 327.6700 FORMAT "%8.4" ECU_ADDRESS 0x6000519E /end MEASUREMENT
/begin MEASUREMENT Com_ratSoc "Status of charge" UBYTE rel_ub_b127p5 1 100 0.00 127.5 FORMAT "%5.1" ECU_ADDRESS 0x6000A595 /end MEASUREMENT
/begin MEASUREMENT Com_ratSoh "Battery SOH received from EBS" SWORD Prc 1 100 -400.0000 399.9878 FORMAT "%8.4" ECU_ADDRESS 0x60005188 /end MEASUREMENT
/begin MEASUREMENT Com_rMeasdBattREbs "Internal resistance of the battery measured by EBS" SWORD RBPtCel_r_0p00001_1 1 100 -0.3276800 0.3276700 FORMAT "%9.7" ECU_ADDRESS 0x60005192 /end MEASUREMENT
/begin MEASUREMENT Com_stBattDchaVltgPrdnSig "Discharge voltage descent prediction signal" UBYTE OneToOne 1 100 0.00 255.0 FORMAT "%5.1" ECU_ADDRESS 0x6000A56B /end MEASUREMENT
/begin MEASUREMENT Com_stBattDgrtSig "Capacity degradation state signal" UBYTE OneToOne 1 100 0.00 255.0 FORMAT "%5.1" ECU_ADDRESS 0x6000A56A /end MEASUREMENT
/begin MEASUREMENT Com_stCharErr "Battery current plausibility flag" UBYTE OneToOne 1 100 0.00 255.0 FORMAT "%5.1" ECU_ADDRESS 0x6000A554 /end MEASUREMENT
/begin MEASUREMENT Com_stLinFmtRxn "LIN format reception state" UBYTE OneToOne 1 100 0.00 255.0 FORMAT "%5.1" ECU_ADDRESS 0x6000A4E3 /end MEASUREMENT
/begin MEASUREMENT Com_stPulResUpd "Pulse Ri update state" UBYTE OneToOne 1 100 0.00 255.0 FORMAT "%5.1" ECU_ADDRESS 0x6000A4C1 /end MEASUREMENT
/begin MEASUREMENT Com_stSensErr "Battery Sensor error flag" UBYTE OneToOne 1 100 0.00 255.0 FORMAT "%5.1" ECU_ADDRESS 0x6000A4A6 /end MEASUREMENT
/begin MEASUREMENT Com_stSoc "State of SOC signal" UBYTE OneToOne 1 100 0.00 255.0 FORMAT "%5.1" ECU_ADDRESS 0x6000A496 /end MEASUREMENT
/begin MEASUREMENT Com_tBattEBS "Battery temperature from EBS" SWORD SCR_TEMP_CELS_float 1 100 -32768.00 32767.00 FORMAT "%8.2" ECU_ADDRESS 0x60005180 /end MEASUREMENT
/begin MEASUREMENT Com_tiDurnAftIgnOff "IG-OFF Duration time" SLONG Time_Hr 1 100 -1073741824.00 1073741823.50 FORMAT "%13.2" ECU_ADDRESS 0x50004C10 /end MEASUREMENT
/begin MEASUREMENT Com_uBattEBS "Battery voltage from EBS" SWORD U_mV_q0p9765625_COMPU 1 100 -32000.00 31999.02 FORMAT "%8.2" ECU_ADDRESS 0x6000515C /end MEASUREMENT
/begin MEASUREMENT Com_uPeak "Battery voltage at cranking peak" SWORD q0p0625_V 1 100 -2048.000 2047.938 FORMAT "%8.3" ECU_ADDRESS 0x60005156 /end MEASUREMENT
/begin MEASUREMENT ctBattSamples "Counter for Battery samples" UBYTE OneToOne 1 100 0.00 255.0 FORMAT "%5.1" ECU_ADDRESS 0x70002D6D /end MEASUREMENT
/begin MEASUREMENT cvwdk_msg "device control value DCPIDCM" UBYTE rel_ub_b99p6 1 100 0.00 99.61 FORMAT "%5.2" ECU_ADDRESS 0x6000A2A4 /end MEASUREMENT
/begin MEASUREMENT devoff_msg "injector fade out pattern at tester requirement" UBYTE dez 1 100 0.00 255.0 FORMAT "%5.1" ECU_ADDRESS 0x6000A2A3 /end MEASUREMENT
/begin MEASUREMENT Epm_stSpdloc10ms "Engine Speed local variable" UBYTE B_TRUE 1 100 0.00 1.00000000000 BIT_MASK 0x1 FORMAT "%13.11" ECU_ADDRESS 0x6000A18F /end MEASUREMENT
/begin MEASUREMENT pspvds_w_msg "quotient manifold pressurepressure before throttle plate" UWORD fak_uw_b2 1 100 0.00 1.999969 FORMAT "%8.6" ECU_ADDRESS 0x60000AF0 /end MEASUREMENT
/begin MEASUREMENT pssol_w_msg "Set intake manifold pressure" UWORD p_uw_q0p039 1 100 0.00 2559.961 FORMAT "%8.3" ECU_ADDRESS 0x60000AF2 /end MEASUREMENT
/begin MEASUREMENT ub "Battery voltage" UBYTE spg_ubatt 1 100 0.00 24.02 FORMAT "%5.2" ECU_ADDRESS 0x60009C3E /end MEASUREMENT
/begin MEASUREMENT ubdq "battery voltage (on board), double standard quantization" UBYTE spg_q0p2 1 100 0.00 51.00 FORMAT "%5.2" ECU_ADDRESS 0x60009C3D /end MEASUREMENT
/begin MEASUREMENT ubdq_w "battery voltage (on board), double standard quantization" UWORD spg_q0p78125Em3 1 100 0.00 51.19922 FORMAT "%8.5" ECU_ADDRESS 0x60003FCA /end MEASUREMENT
/begin MEASUREMENT ubrdq "battery voltage(higher range) via main relay, standard quantization" UBYTE spg_q0p2 1 100 0.00 51.00 FORMAT "%5.2" ECU_ADDRESS 0x60009C3C /end MEASUREMENT
/begin MEASUREMENT ubrdq_w "battery voltage (on board), double standard quantization" UWORD spg_q0p78125Em3 1 100 0.00 51.19922 FORMAT "%8.5" ECU_ADDRESS 0x60003FC8 /end MEASUREMENT
/begin MEASUREMENT ubrsq "battery voltage via main relay, standard quantization" UBYTE spg_q0p1 1 100 0.00 25.50 FORMAT "%5.2" ECU_ADDRESS 0x60009C3B /end MEASUREMENT
/begin MEASUREMENT ubrsqf_w "battery voltage via main relay, standard quantization, filtered value" UWORD spg_q0p00039 1 100 0.00 25.59961 FORMAT "%8.5" ECU_ADDRESS 0x60003FC6 /end MEASUREMENT
/begin MEASUREMENT ubrsq_w "battery voltage (word) via main relay, standard quantization" UWORD spg_q0p00039 1 100 0.00 25.59961 FORMAT "%8.5" ECU_ADDRESS 0x60003FC4 /end MEASUREMENT
/begin MEASUREMENT ubsq "battery voltage (on board), conversed to standard quantization" UBYTE spg_q0p1 1 100 0.00 25.50 FORMAT "%5.2" ECU_ADDRESS 0x60009C3A /end MEASUREMENT
/begin MEASUREMENT ubsqf "battery voltage (on board), conversed to standard quantization and low pass filt" UBYTE spg_q0p1 1 100 0.00 25.50 FORMAT "%5.2" ECU_ADDRESS 0x60009C39 /end MEASUREMENT
/begin MEASUREMENT ubsqf_w "battery voltage (on board), conversed to standard quantization and low pass filt" UWORD spg_q0p00039 1 100 0.00 25.59961 FORMAT "%8.5" ECU_ADDRESS 0x60003FC2 /end MEASUREMENT
/begin MEASUREMENT ubsq_w "battery voltage (on board), conversed to standard quantization" UWORD spg_q0p00039 1 100 0.00 25.59961 FORMAT "%8.5" ECU_ADDRESS 0x60003FC0 /end MEASUREMENT
/begin MEASUREMENT VlvLftCtl_agCrkforSwtIntkloc "local variable for FC:AVHE appended with the parent variable name" UWORD kw_q1 1 100 0.00 39500.00 FORMAT "%8.2" ECU_ADDRESS 0x5000079E /end MEASUREMENT
/begin MEASUREMENT VlvLftCtl_agGrundwertlocS0 "local variable for FC:AVHE appended with the parent variable name" UBYTE kw_q1 1 100 0.00 255.0 FORMAT "%5.1" ECU_ADDRESS 0x6000072C /end MEASUREMENT
/begin MEASUREMENT VlvLftCtl_facdrldvlswlocS0 "local variable for FC:AVHE appended with the parent variable name" SWORD rel_q0p0234 1 100 0.00 767.9766 FORMAT "%8.4" ECU_ADDRESS 0x6000046E /end MEASUREMENT
/begin MEASUREMENT VlvLftCtl_flgBkl15locS0loc "local variable for FC:AVHE appended with the parent variable name" UBYTE B_TRUE 1 100 0.00 1.00000000000 BIT_MASK 0x1 FORMAT "%13.11" ECU_ADDRESS 0x70001A8E /end MEASUREMENT
/begin MEASUREMENT VlvLftCtl_flgBnminloc10ms "local variable for FC:AVHE appended with the parent variable name" UBYTE B_TRUE 1 100 0.00 1.00000000000 BIT_MASK 0x1 FORMAT "%13.11" ECU_ADDRESS 0x6000A10C /end MEASUREMENT
/begin MEASUREMENT VlvLftCtl_flgBvhegabgnlocS0 "local variable for FC:AVHE appended with the parent variable name" UBYTE B_TRUE 1 100 0.00 1.00000000000 BIT_MASK 0x1 FORMAT "%13.11" ECU_ADDRESS 0x70001A8D /end MEASUREMENT
/begin MEASUREMENT VlvLftCtl_flgfbIntkswtoutp11loc "local variable for FC:AVHE appended with the parent variable name" UBYTE B_TRUE 1 100 0.00 1.00000000000 BIT_MASK 0x1 FORMAT "%13.11" ECU_ADDRESS 0x60009C42 /end MEASUREMENT
/begin MEASUREMENT VlvLftCtl_flgSyncVlvPosIntkloc "local variable for FC:AVHE appended with the parent variable name" UBYTE B_TRUE 1 100 0.00 1.00000000000 BIT_MASK 0x1 FORMAT "%13.11" ECU_ADDRESS 0x70001A8C /end MEASUREMENT
/begin MEASUREMENT VlvLftCtl_nmotloc10ms "local variable for FC:AVHE appended with the parent variable name" UBYTE nmot_ub_q40 1 100 0.00 10200. FORMAT "%5.0" ECU_ADDRESS 0x6000A2AB /end MEASUREMENT
/begin MEASUREMENT VlvLftCtl_nrCylSyncIntkloc "local variable for FC:AVHE appended with the parent variable name" UBYTE dez 1 100 0.00 255.0 FORMAT "%5.1" ECU_ADDRESS 0x50000872 /end MEASUREMENT
/begin MEASUREMENT VlvLftCtl_nrSegSwtIntkloc "local variable for FC:AVHE appended with the parent variable name" UBYTE dez 1 100 0.00 255.0 FORMAT "%5.1" ECU_ADDRESS 0x50000873 /end MEASUREMENT
/begin MEASUREMENT VlvLftCtl_nzzyllocS0 "local variable for FC:AVHE appended with the parent variable name" UBYTE dez 1 100 0.00 255.0 FORMAT "%5.1" ECU_ADDRESS 0x6000072D /end MEASUREMENT
/begin MEASUREMENT VlvLftCtl_poilploc20ms "local variable for FC:AVHE appended with the parent variable name" SWORD Pres 1 100 -3276.800 3276.700 FORMAT "%8.3" ECU_ADDRESS 0x60003FCE /end MEASUREMENT
/begin MEASUREMENT VlvLftCtl_ttochloc20ms "local variable for FC:AVHE appended with the parent variable name" UBYTE temp_ub_q0p75_o48 1 100 -48.0 143.3 FORMAT "%5.1" ECU_ADDRESS 0x60009C41 /end MEASUREMENT
/begin MEASUREMENT VlvLftCtl_ubsqfloc20ms "local variable for FC:AVHE appended with the parent variable name" UBYTE spg_q0p1 1 100 0.00 25.50 FORMAT "%5.2" ECU_ADDRESS 0x60009C40 /end MEASUREMENT
/begin MEASUREMENT VlvLftCtl_vwkwloc20ms "local variable for FC:AVHA appended with the parent variable name" UBYTE rel_ub_q0p1875 1 100 0.00 47.81 FORMAT "%5.2" ECU_ADDRESS 0x60009C3F /end MEASUREMENT
/begin MEASUREMENT VlvLftCtl_vwkwlocS0 "local variable for FC:AVHE appended with the parent variable name" UBYTE rel_ub_q0p1875 1 100 0.00 47.81 FORMAT "%5.2" ECU_ADDRESS 0x70001A8B /end MEASUREMENT
/begin MEASUREMENT VlvLftCtl_wvhesdw20ms "local variable for FC:AVHE appended with the parent variable name" UWORD kw_q1 1 100 0.00 39500.00 FORMAT "%8.2" ECU_ADDRESS 0x60003FCC /end MEASUREMENT
/begin MEASUREMENT VlvLft_agCrkForSwtIntk_msg "Valve Lift Angle crank for switch intake" UWORD kw_q1 1 100 0.00 39500.00 FORMAT "%8.2" ECU_ADDRESS 0x60004C16 /end MEASUREMENT
/begin MEASUREMENT VlvLft_fbIntkSwtVrbl11 "Verbal display of Actuator 11 feedback high or low cam" UBYTE VLVLFT_FBSWT_VERB 1 100 0.00 1.00000000000 FORMAT "%13.11" ECU_ADDRESS 0x6000A2AA /end MEASUREMENT
/begin MEASUREMENT VlvLft_fbStIntkVrbl "Verbal display of ValveLft feedback high or low cam" UBYTE VLVLFT_FBSWT_VERB 1 100 0.00 1.00000000000 FORMAT "%13.11" ECU_ADDRESS 0x6000A2A9 /end MEASUREMENT
/begin MEASUREMENT VlvLft_flgCoorn1SynctoSwt "coordination signal one synchro before Valve switch" UBYTE B_TRUE 1 100 0.00 1.00000000000 BIT_MASK 0x1 FORMAT "%13.11" ECU_ADDRESS 0x70001BE8 /end MEASUREMENT
/begin MEASUREMENT VlvLft_flgCoornStrtofSwt "Coordination signal for start of Valve switch" UBYTE B_TRUE 1 100 0.00 1.00000000000 BIT_MASK 0x1 FORMAT "%13.11" ECU_ADDRESS 0x70001BE7 /end MEASUREMENT
/begin MEASUREMENT VlvLft_flgCtrlActrIntk1 "Condition controlling inlet magnetic valve 1 for VLI" UBYTE B_TRUE 1 100 0.00 1.00000000000 BIT_MASK 0x1 FORMAT "%13.11" ECU_ADDRESS 0x70001BE6 /end MEASUREMENT
/begin MEASUREMENT VlvLft_flgEnerBgnAdpnIntk "Flag energise begin adapted for Intake." UBYTE B_TRUE 1 100 0.00 1.00000000000 BIT_MASK 0x1 FORMAT "%13.11" ECU_ADDRESS 0x70001BE5 /end MEASUREMENT
/begin MEASUREMENT VlvLft_flgFbVlvStIntk "Condition valve lift variation switching camshaft control (hand shake)" UBYTE B_TRUE 1 100 0.00 1.00000000000 BIT_MASK 0x1 FORMAT "%13.11" ECU_ADDRESS 0x70001BE4 /end MEASUREMENT
/begin MEASUREMENT VlvLft_flgSyncVlvPosIntk_msg "Beginend of synchronization valve lift variation deactivation, injection, air charge and ignition 2 sychros before switch" UBYTE B_TRUE 1 100 0.00 1.00000000000 BIT_MASK 0x1 FORMAT "%13.11" ECU_ADDRESS 0x70001BE3 /end MEASUREMENT
/begin MEASUREMENT VlvLft_nrCylSyncIntk_msg "Cylinder number of first activateddeactivated VLI cylinder updated 2 syncros before switch" UBYTE dez 1 100 0.00 255.0 FORMAT "%5.1" ECU_ADDRESS 0x500008B5 /end MEASUREMENT
/begin MEASUREMENT VlvLft_nrSegSwtIntk_msg "Number of segments until VLI possible" UBYTE dez 1 100 0.00 255.0 FORMAT "%5.1" ECU_ADDRESS 0x70001C10 /end MEASUREMENT
/begin MEASUREMENT VlvLft_stflgCtrlActrIntkVrbl1 "Verbal display of VlvLft_flgCtrlActrIntk1 signal" UBYTE VLVLFT_SIGACTR_VERB 1 100 0.00 1.00000000000 FORMAT "%13.11" ECU_ADDRESS 0x6000A2A8 /end MEASUREMENT
/begin MEASUREMENT VlvLft_tiDlyVlvActvnIntk "Delay time for VLI-valve activation" UBYTE t_q1_ms 1 100 0.00 255.0 FORMAT "%5.1" ECU_ADDRESS 0x6000A2A7 /end MEASUREMENT
/begin MEASUREMENT wub "battery voltage; scanned value of ADC" UBYTE spg_ubatt 1 100 0.00 24.02 FORMAT "%5.2" ECU_ADDRESS 0x60009C38 /end MEASUREMENT
/begin MEASUREMENT wub_w "battery voltage; scanned value of ADC (16Bit from 10Bit resolution)" UWORD spg_uw_q0p023481 1 100 0.00 1538.827 FORMAT "%8.3" ECU_ADDRESS 0x60003FBE /end MEASUREMENT
/begin MEASUREMENT wvhesd_w_msg "crank angle from begin of switching lifted cam to inlet valve opens (based on current cam profile)" UWORD kw_q1 1 100 0.00 39500.00 FORMAT "%8.2" ECU_ADDRESS 0x50005C7C /end MEASUREMENT
/begin MEASUREMENT zzylvheb "Calculated VHE starting with cylinder number" UBYTE dez 1 100 0.00 254.0 FORMAT "%5.1" ECU_ADDRESS 0x5000087F /end MEASUREMENT
/begin MEASUREMENT zzylvheb_temp "The cylinder number which is going to actuated first." UBYTE dez 1 100 0.00 254.0 FORMAT "%5.1" ECU_ADDRESS 0x60000750 /end MEASUREMENT
/begin FUNCTION ASDrf_SelPar "28.5.0    Parameter sets of drivability filters"
 /begin DEF_CHARACTERISTIC ASDrf_Cfg2_CW ASDrf_Cfg3_CW ASDrf_Cfg4_CW ASDrf_Cfg_CW ASDrf_CoefAAirCdnrOnGripNeg_GT ASDrf_CoefAGripMtModNeg_GT ASDrf_CoefAGripMtModPosAbv_GT ASDrf_CoefAGripMtModPosBlw_GT ASDrf_CoefAGripNeg_CUR ASDrf_CoefAGripPosAbvAcOn_GCUR ASDrf_CoefAGripPosAbv_GCUR ASDrf_CoefAGripPosBlwAcOn_GCUR ASDrf_CoefAGripPosBlw_GCUR ASDrf_CoefASprtMtModNeg_GT ASDrf_CoefASprtMtModPosAbv_GT ASDrf_CoefASprtMtModPosBlw_GT ASDrf_CoefASprtNegAcOn_GT ASDrf_CoefASprtNeg_GT ASDrf_CoefASprtPosAbvAcOn_GT ASDrf_CoefASprtPosAbv_GT ASDrf_CoefASprtPosBlwAcOn_GT ASDrf_CoefASprtPosBlw_GT ASDrf_CoefBAirCdnrOnGripNeg_GM ASDrf_CoefBGripMtModNeg_GM ASDrf_CoefBGripMtModPosAbv_GM ASDrf_CoefBGripMtModPosBlw_GM ASDrf_CoefBGripNeg_GMAP ASDrf_CoefBGripPosAbvAcOn_GMAP ASDrf_CoefBGripPosAbv_GMAP ASDrf_CoefBGripPosBlwAcOn_GMAP ASDrf_CoefBGripPosBlw_GMAP ASDrf_CoefBSprtMtModNeg_GM ASDrf_CoefBSprtMtModPosAbv_GM ASDrf_CoefBSprtMtModPosBlw_GM ASDrf_CoefBSprtNegAcOn_GM ASDrf_CoefBSprtNeg_GM ASDrf_CoefBSprtPosAbvAcOn_GM ASDrf_CoefBSprtPosAbv_GM ASDrf_CoefBSprtPosBlwAcOn_GM ASDrf_CoefBSprtPosBlw_GM ASDrf_CoeffAGripMtModNegAcOn_GT ASDrf_CoeffAGripMtModPosAbvAcOn_GT ASDrf_CoeffAGripMtModPosBlwAcOn_GT ASDrf_CoeffASptMtModNegAcOn_GT ASDrf_CoeffASptMtModPosAbvAcOn_GT ASDrf_CoeffASptMtModPosBlwAcOn_GT ASDrf_CoeffBGripMtModNegAcOn_GM ASDrf_CoeffBGripMtModPosAbvAcOn_GM ASDrf_CoeffBGripMtModPosBlwAcOn_GM ASDrf_CoeffBSptMtModNegAcOn_GM ASDrf_CoeffBSptMtModPosAbvAcOn_GM ASDrf_CoeffBSptMtModPosBlwAcOn_GM ASDrf_dnEngFlt_DST ASDrf_facCoefAGripAirCdnrOnNeg_GT ASDrf_facCoefAGripNeg_GT ASDrf_facCoefAMtModPosAbv_GT ASDrf_facCoefAPosAbvAcOn_GCUR ASDrf_facCoefAPosAbv_GCUR ASDrf_facCoefASprtMtModPosAbv_GT ASDrf_facCoefASprtPosAbvAcOn_GT ASDrf_facCoefASprtPosAbv_GT ASDrf_facCoefBAirCdnrOnNeg_GT ASDrf_facCoefBGripAirCdnrOnNeg_GT ASDrf_facCoefBGripNeg_GT ASDrf_facCoefBMtModNeg_GT ASDrf_facCoefBMtModPosAbv_GM ASDrf_facCoefBMtModPosBlw_GM ASDrf_facCoefBNeg_GCUR ASDrf_facCoefBPosAbvAcOn_GMAP ASDrf_facCoefBPosAbv_GMAP ASDrf_facCoefBPosBlwAcOn_GMAP ASDrf_facCoefBPosBlw_GMAP ASDrf_facCoefBSprtMtModNeg_GT ASDrf_facCoefBSprtMtModPosAbv_GM ASDrf_facCoefBSprtMtModPosBlw_GM ASDrf_facCoefBSprtNegAcOn_GT ASDrf_facCoefBSprtNeg_GT ASDrf_facCoefBSprtPosAbvAcOn_GM ASDrf_facCoefBSprtPosAbv_GM ASDrf_facCoefBSprtPosBlwAcOn_GM ASDrf_facCoefBSprtPosBlw_GM ASDrf_facCoeffAMtModPosAbvAcOn_GT ASDrf_facCoeffASptMtModPosAbvAcOn_GT ASDrf_facCoeffBMtModNegAcOn_GT ASDrf_facCoeffBMtModPosAbvAcOn_GM ASDrf_facCoeffBMtModPosBlwAcOn_GM ASDrf_facCoeffBSptMtModNegAcOn_GT ASDrf_facCoeffBSptMtModPosAbvAcOn_GM ASDrf_facCoeffBSptMtModPosBlwAcOn_GM ASDrf_facDesDyn_DST ASDrf_facTiAirCdnrOnNeg_GT ASDrf_facTiFltSetGripAirCdnrOnNeg_GT ASDrf_facTiFltSetGripNeg_GT ASDrf_facTiMtModNegAcOn_GT ASDrf_facTiMtModNeg_GT ASDrf_facTiMtModPosAbvAcOn_GM ASDrf_facTiMtModPosAbv_GM ASDrf_facTiMtModPosBlwAcOn_GM ASDrf_facTiMtModPosBlw_GM ASDrf_facTiNeg_GCUR ASDrf_facTiPosAbvAcOn_GMAP ASDrf_facTiPosAbv_GMAP ASDrf_facTiPosBlwAcOn_GMAP ASDrf_facTiPosBlw_GMAP ASDrf_facTiSprtMtModNeg_GT ASDrf_facTiSprtMtModPosAbv_GM ASDrf_facTiSprtMtModPosBlw_GM ASDrf_facTiSprtNegAcOn_GT ASDrf_facTiSprtNeg_GT ASDrf_facTiSprtPosAbvAcOn_GM ASDrf_facTiSprtPosAbv_GM ASDrf_facTiSprtPosBlwAcOn_GM ASDrf_facTiSprtPosBlw_GM ASDrf_facTiSptMtModNegAcOn_GT ASDrf_facTiSptMtModPosAbvAcOn_GM ASDrf_facTiSptMtModPosBlwAcOn_GM ASDrf_KdFilSetGripAirCdnrOnNeg_GM ASDrf_KdFilSetGripMtModNegAcOn_GM ASDrf_KdFilSetGripMtModNeg_GM ASDrf_KdFilSetGripMtModPosAbvAcOn_GM ASDrf_KdFilSetGripMtModPosAbv_GM ASDrf_KdFilSetGripNeg_GM ASDrf_KdFilSetGripPosAbvAcOn_GM ASDrf_KdFilSetGripPosAbv_GM ASDrf_KdFilSetSprtMtModNeg_GM ASDrf_KdFilSetSprtMtModPosAbv_GM ASDrf_KdFilSetSprtNegAcOn_GM ASDrf_KdFilSetSprtNeg_GM ASDrf_KdFilSetSprtPosAbvAcOn_GM ASDrf_KdFilSetSprtPosAbv_GM ASDrf_KdFilSetSptMtModNegAcOn_GM ASDrf_KdFilSetSptMtModPosAbvAcOn_GM ASDrf_nATSlipOpnEngSpdLo_C ASDrf_nDiffCnvrEngSelThd_C ASDrf_nEng_DST ASDrf_nPt_DST ASDrf_nrGear_DST ASDrf_nThresNCmp_GMAP ASDrf_nTrbnThresHi_C ASDrf_nTrbnThresLo_C ASDrf_ratSlipOpenActvThdSpt_M ASDrf_ratSlipOpenActvThdTrsmMt_M ASDrf_ratSlipOpenAppCmpSpt_M ASDrf_ratSlipOpenAppCmpTrsmMt_M ASDrf_ratSlipOpenAppCmp_M ASDrf_ratSlipOpenEngCmpSpt_M ASDrf_ratSlipOpenEngCmpTrsmMt_M ASDrf_rATSlipOpnActvThres_MAP ASDrf_rATSlipOpnNCmp_MAP ASDrf_rGripThres_C ASDrf_rTrq_DST ASDrf_stEngOperModSeln_FT ASDrf_tATSlipOpnEngTLo_C ASDrf_tEng_DST ASDrf_tiFilSetGripMtModNegAcOn_GM ASDrf_tiFilSetGripMtModNeg_GM ASDrf_tiFilSetGripMtModPosAbvAcOn_GM ASDrf_tiFilSetGripMtModPosAbv_GM ASDrf_tiFilSetGripMtModPosBlwAcOn_GM ASDrf_tiFilSetGripMtModPosBlw_GM ASDrf_tiFilSetSprtMtModNeg_GM ASDrf_tiFilSetSprtMtModPosAbv_GM ASDrf_tiFilSetSprtMtModPosBlw_GM ASDrf_tiFilSetSprtNegAcOn_GM ASDrf_tiFilSetSprtNeg_GM ASDrf_tiFilSetSprtPosAbvAcOn_GM ASDrf_tiFilSetSprtPosAbv_GM ASDrf_tiFilSetSprtPosBlwAcOn_GM ASDrf_tiFilSetSprtPosBlw_GM ASDrf_tiFilSetSptMtModNegAcOn_GM ASDrf_tiFilSetSptMtModPosAbvAcOn_GM ASDrf_tiFilSetSptMtModPosBlwAcOn_GM ASDrf_tiFltSetAirCdnrOnGripNeg_GM ASDrf_tiFltSetAirCdnrOnNegFCO_GT ASDrf_tiFltSetGripNeg_MAP ASDrf_tiFltSetGripPosAbvAcOn_GMAP ASDrf_tiFltSetGripPosAbv_GMAP ASDrf_tiFltSetGripPosBlwAcOn_GMAP ASDrf_tiFltSetGripPosBlw_GMAP ASDrf_tiFltSetNegFCOSprt_GCUR ASDrf_tiFltSetNegFCO_GCUR ASDrf_tiFltSetNegMax_C ASDrf_tiFltSetPosFCOSprt_GMAP ASDrf_tiFltSetPosFCO_GMAP ASDrf_tiMaxCalcOff_C ASDrf_tqLosOfsAirCdnrOnNegSet_C ASDrf_trqClthBs_DST ASDrf_trqLosOfsNegSetSprt_C ASDrf_trqLosOfsNegSet_C ASDrf_trqLosOfsPosSetSprt_C ASDrf_trqLosOfsPosSet_C ASDrf_trqThresDP1_C ASDrf_trqThresDP2_C ASDrf_vDONeg_C ASDrf_vDOPos_C ASDrf_vNoGripDQ_C /end DEF_CHARACTERISTIC
 /begin IN_MEASUREMENT AccPed_swtDrvMod AirC_stPsCmpr APP_r ASDrf_bPosNegDes ASDrf_stLimMinMax ASDrf_trqClthFlt CEngDsT_t CoETS_bFltDemSet CoETS_trqInrLimSet Com_flgExecdManMod Com_rTrsmTotFild Com_stEATBByte0Info Com_stShftInNeutr Com_stShftInPark Com_stShiftPosnIndcn Com_stTrqReqFast Com_stTrsmFailMod Conv_nTrbn CoVeh_trqAcs EngDa_tEng EngStrt_bStrtEnd Epm_dnEngFlt Epm_nEng Gbx_bATSlipOpn Gbx_bNCmp Gbx_nTrbn Gbx_stNPos LsComp_tqCmpActvSpdGovr LsComp_tqSwilLossNotFild PthLead_trqInrLead PthSet_stCylIndivCtOff PthSet_stTrgFCO PT_bConvSlipOpn PT_nClth PT_rGrip PT_rTrq PT_stTraType RngMod_trqClthMin RngMod_trqCrSBs RngMod_trqInrBs SpdGov_trqClth SpdGov_trqLead StatyCoorn_tqCluDesLimd SyC_ctDrvEnter Tra_numGear VehMot_facDesDyn VehV_v /end IN_MEASUREMENT
 /begin OUT_MEASUREMENT ASDrf_bCalcTrqBs ASDrf_bConvSlipOpn ASDrf_bNCmp ASDrf_bNCmpCvt ASDrf_bNoGrip ASDrf_bSlipOpnActv ASDrf_CoefA ASDrf_CoefB ASDrf_facDesDyn ASDrf_flgSptModActv ASDrf_flgTrsmMtModActv ASDrf_KdFltSet ASDrf_nPt ASDrf_nThresNCmp ASDrf_rConvSlip ASDrf_tiFltSet ASDrf_tqCluBas ASDrf_tqCluBasc ASDrf_tqCluBasLead ASDrf_tqCluDemSet ASDrf_trqLosSet /end OUT_MEASUREMENT
 /begin LOC_MEASUREMENT ASDrf_bATSlipOpnInhb ASDrf_bCalcTrqBsFF_I.status ASDrf_bNCmpFF_I.status ASDrf_ctIniDrvSelPar10ms ASDrf_dtqERNM_I.oldSignal ASDrf_dtqTOFFVNM_I.time ASDrf_posSlipOpnER_I.buffer ASDrf_posSlipOpnER_I.oldSignal ASDrf_ratSlipOpenCmp ASDrf_stEngOperModSeln ASDrf_stParSet ASDrf_tqLossBasc ASDrf_trqLosClthComp ASDrf_trqLosComp /end LOC_MEASUREMENT
 FUNCTION_VERSION "28.5.0" /end FUNCTION
/begin FUNCTION ATCADAP "5.1.0     software adapter for MF ATC" /begin DEF_CHARACTERISTIC PSPVDKUG /end DEF_CHARACTERISTIC /begin IN_MEASUREMENT psrs_w_msg SyC_stSub vpsrvd_w_msg /end IN_MEASUREMENT /begin OUT_MEASUREMENT pspvds_w_msg pssol_w_msg /end OUT_MEASUREMENT FUNCTION_VERSION "5.1.0" /end FUNCTION
/begin FUNCTION ATS2CP "68.0.0    ATS configuration for tank purge valve" /begin OUT_MEASUREMENT arqttev_w_msg B_rqttev_msg /end OUT_MEASUREMENT FUNCTION_VERSION "68.0.0" /end FUNCTION
/begin FUNCTION ATS2INJ "68.0.0    ATS interface for injection test" /begin OUT_MEASUREMENT B_faevz_msg devoff_msg /end OUT_MEASUREMENT FUNCTION_VERSION "68.0.0" /end FUNCTION
/begin FUNCTION ATS2THRVLV "68.0.0    ATS configuration for throttle valve" /begin OUT_MEASUREMENT B_cwdk_msg cvwdk_msg /end OUT_MEASUREMENT FUNCTION_VERSION "68.0.0" /end FUNCTION
/begin FUNCTION ATSADAPT "68.0.0    adapter for ATS" FUNCTION_VERSION "68.0.0" /end FUNCTION
/begin FUNCTION ATSExtd_Std "30000.0.0 Handling of actuator test demands with diagnostics extended" FUNCTION_VERSION "30000.0.0" /end FUNCTION
/begin FUNCTION ATS_Std "30000.29.0Handling of actuator test demands with diagnostics"
 /begin DEF_CHARACTERISTIC ACTR_TST_CP_ATS_ATS.LimitTypeMsk_C ACTR_TST_CP_ATS_ATS.CnvNorm_C ACTR_TST_CP_ATS_ATS.LowLim_C ACTR_TST_CP_ATS_ATS.UpLim_C ACTR_TST_CP_ATS_ATS.CnvFac_C ACTR_TST_CP_ATS_ATS.CnvOfs_C ACTR_TST_CP_ATS_ATS.DfltVal_C ACTR_TST_THRVLV_ATS_ATS.LimitTypeMsk_C ACTR_TST_THRVLV_ATS_ATS.CnvNorm_C ACTR_TST_THRVLV_ATS_ATS.LowLim_C ACTR_TST_THRVLV_ATS_ATS.UpLim_C ACTR_TST_THRVLV_ATS_ATS.CnvFac_C ACTR_TST_THRVLV_ATS_ATS.CnvOfs_C ACTR_TST_THRVLV_ATS_ATS.DfltVal_C ATS_Standby_Disabled_C ATS_tiTstDemHeal_C ATS_tiTstDemMax_C ATS_TmrBehaviour_C ATS_TstDemMaxEngN_C ATS_TstDemMaxVSSCDV_C /end DEF_CHARACTERISTIC
 /begin REF_CHARACTERISTIC AirCCmpr_ATS.LimitTypeMsk_C AirCCmpr_ATS.CnvNorm_C AirCCmpr_ATS.LowLim_C AirCCmpr_ATS.UpLim_C AirCCmpr_ATS.CnvFac_C AirCCmpr_ATS.CnvOfs_C AirCCmpr_ATS.DfltVal_C AltIO_ATS.LimitTypeMsk_C AltIO_ATS.CnvNorm_C AltIO_ATS.LowLim_C AltIO_ATS.UpLim_C AltIO_ATS.CnvFac_C AltIO_ATS.CnvOfs_C AltIO_ATS.DfltVal_C APP_I_P_ATS_ATS.LimitTypeMsk_C APP_I_P_ATS_ATS.CnvNorm_C APP_I_P_ATS_ATS.LowLim_C APP_I_P_ATS_ATS.UpLim_C APP_I_P_ATS_ATS.CnvFac_C APP_I_P_ATS_ATS.CnvOfs_C APP_I_P_ATS_ATS.DfltVal_C ATS_TrbCh_B1.LimitTypeMsk_C ATS_TrbCh_B1.CnvNorm_C ATS_TrbCh_B1.LowLim_C ATS_TrbCh_B1.UpLim_C ATS_TrbCh_B1.CnvFac_C ATS_TrbCh_B1.CnvOfs_C ATS_TrbCh_B1.DfltVal_C CACPmpRly_ATS.LimitTypeMsk_C CACPmpRly_ATS.CnvNorm_C CACPmpRly_ATS.LowLim_C CACPmpRly_ATS.UpLim_C CACPmpRly_ATS.CnvFac_C CACPmpRly_ATS.CnvOfs_C CACPmpRly_ATS.DfltVal_C CACPmp_ATS.LimitTypeMsk_C CACPmp_ATS.CnvNorm_C CACPmp_ATS.LowLim_C CACPmp_ATS.UpLim_C CACPmp_ATS.CnvFac_C CACPmp_ATS.CnvOfs_C CACPmp_ATS.DfltVal_C CByVlvB1_Test_ATS.LimitTypeMsk_C CByVlvB1_Test_ATS.CnvNorm_C CByVlvB1_Test_ATS.LowLim_C CByVlvB1_Test_ATS.UpLim_C CByVlvB1_Test_ATS.CnvFac_C CByVlvB1_Test_ATS.CnvOfs_C CByVlvB1_Test_ATS.DfltVal_C FanDig0_ATS.LimitTypeMsk_C FanDig0_ATS.CnvNorm_C FanDig0_ATS.LowLim_C FanDig0_ATS.UpLim_C FanDig0_ATS.CnvFac_C FanDig0_ATS.CnvOfs_C FanDig0_ATS.DfltVal_C FanDig1_ATS.LimitTypeMsk_C FanDig1_ATS.CnvNorm_C FanDig1_ATS.LowLim_C FanDig1_ATS.UpLim_C FanDig1_ATS.CnvFac_C FanDig1_ATS.CnvOfs_C FanDig1_ATS.DfltVal_C GbxRevLck_ATS.LimitTypeMsk_C GbxRevLck_ATS.CnvNorm_C GbxRevLck_ATS.LowLim_C GbxRevLck_ATS.UpLim_C GbxRevLck_ATS.CnvFac_C GbxRevLck_ATS.CnvOfs_C GbxRevLck_ATS.DfltVal_C InjSys_FcoCylInd_ATS_ATS.LimitTypeMsk_C InjSys_FcoCylInd_ATS_ATS.CnvNorm_C InjSys_FcoCylInd_ATS_ATS.LowLim_C InjSys_FcoCylInd_ATS_ATS.UpLim_C InjSys_FcoCylInd_ATS_ATS.CnvFac_C InjSys_FcoCylInd_ATS_ATS.CnvOfs_C InjSys_FcoCylInd_ATS_ATS.DfltVal_C PHAACTRINTK_CTL_ATS_ATS.LimitTypeMsk_C PHAACTRINTK_CTL_ATS_ATS.CnvNorm_C PHAACTRINTK_CTL_ATS_ATS.LowLim_C PHAACTRINTK_CTL_ATS_ATS.UpLim_C PHAACTRINTK_CTL_ATS_ATS.CnvFac_C PHAACTRINTK_CTL_ATS_ATS.CnvOfs_C PHAACTRINTK_CTL_ATS_ATS.DfltVal_C PHAACTROUTL_CTL_ATS_ATS.LimitTypeMsk_C PHAACTROUTL_CTL_ATS_ATS.CnvNorm_C PHAACTROUTL_CTL_ATS_ATS.LowLim_C PHAACTROUTL_CTL_ATS_ATS.UpLim_C PHAACTROUTL_CTL_ATS_ATS.CnvFac_C PHAACTROUTL_CTL_ATS_ATS.CnvOfs_C PHAACTROUTL_CTL_ATS_ATS.DfltVal_C PSPDig_ATS.LimitTypeMsk_C PSPDig_ATS.CnvNorm_C PSPDig_ATS.LowLim_C PSPDig_ATS.UpLim_C PSPDig_ATS.CnvFac_C PSPDig_ATS.CnvOfs_C PSPDig_ATS.DfltVal_C ThrVlv_ATS.LimitTypeMsk_C ThrVlv_ATS.CnvNorm_C ThrVlv_ATS.LowLim_C ThrVlv_ATS.UpLim_C ThrVlv_ATS.CnvFac_C ThrVlv_ATS.CnvOfs_C ThrVlv_ATS.DfltVal_C VLVLFT_SPINTK_ATS.LimitTypeMsk_C VLVLFT_SPINTK_ATS.CnvNorm_C VLVLFT_SPINTK_ATS.LowLim_C VLVLFT_SPINTK_ATS.UpLim_C VLVLFT_SPINTK_ATS.CnvFac_C VLVLFT_SPINTK_ATS.CnvOfs_C VLVLFT_SPINTK_ATS.DfltVal_C /end REF_CHARACTERISTIC
 /begin IN_MEASUREMENT Epm_nEngLRes T15_st VehV_v /end IN_MEASUREMENT
 /begin OUT_MEASUREMENT ATS_ctCurRunTst ATS_stMon ATS_stMonTimeLimit /end OUT_MEASUREMENT
 /begin LOC_MEASUREMENT ATS_IntvVal_mp ATS_TstStatus_mp /end LOC_MEASUREMENT
 FUNCTION_VERSION "30000.29.0" /end FUNCTION
/begin FUNCTION AVHE "14.0.0    Control of variable valve lift inlet"
 /begin DEF_CHARACTERISTIC Vlvlft_agOffsSafeSwt_C Vlvlft_nrCylActrIntk_T VlvLft_nrSegOffsTrigChrgDetrmIntk_C VlvLft_percAirChrgChgThd_C VlvLft_selStdLftCfg_C Vlvlft_tiEleclDlySpclIntk_M Vlvlft_tiEleclDlyStdIntk_M Vlvlft_tiMeclDlySpclIntk_M Vlvlft_tiMeclDlyStdIntk_M Vlvlft_tiOilPDlySpclIntk_M Vlvlft_tiOilPDlyStdIntk_M /end DEF_CHARACTERISTIC
 /begin IN_MEASUREMENT BattU_uFild B_kl15_msg B_vhegabgn_msg CoEng_stSpVlvLftIntk drldvls_w_msg Epm_ctCyl Epm_nEng Epm_stSpd GEVCtl_agDifStdSpclLftOpenIntk GEVCtl_agIntkOpen grundwert_msg OilP_p SyC_stSub toch_msg VlvLft_fbIntkSwtOutp11 Vlvlft_stFbSwtActvIntk vwkw_msg /end IN_MEASUREMENT
 /begin OUT_MEASUREMENT B_vhegfe_msg VlvLft_agCrkForSwtIntk_msg VlvLft_fbIntkSwtVrbl11 VlvLft_fbStIntkVrbl VlvLft_flgCoorn1SynctoSwt VlvLft_flgCoornStrtofSwt VlvLft_flgCtrlActrIntk1 VlvLft_flgEnerBgnAdpnIntk VlvLft_flgFbVlvStIntk VlvLft_flgSyncVlvPosIntk_msg VlvLft_nrCylSyncIntk_msg VlvLft_nrSegSwtIntk_msg VlvLft_stflgCtrlActrIntkVrbl1 VlvLft_tiDlyVlvActvnIntk wvhesd_w_msg /end OUT_MEASUREMENT
 /begin LOC_MEASUREMENT B_vhegfeloc Epm_stSpdloc10ms VlvLftCtl_agCrkforSwtIntkloc VlvLftCtl_agGrundwertlocS0 VlvLftCtl_facdrldvlswlocS0 VlvLftCtl_flgBkl15locS0loc VlvLftCtl_flgBnminloc10ms VlvLftCtl_flgBvhegabgnlocS0 VlvLftCtl_flgfbIntkswtoutp11loc VlvLftCtl_flgSyncVlvPosIntkloc VlvLftCtl_nmotloc10ms VlvLftCtl_nrCylSyncIntkloc VlvLftCtl_nrSegSwtIntkloc VlvLftCtl_nzzyllocS0 VlvLftCtl_poilploc20ms VlvLftCtl_ttochloc20ms VlvLftCtl_ubsqfloc20ms VlvLftCtl_vwkwloc20ms VlvLftCtl_vwkwlocS0 VlvLftCtl_wvhesdw20ms zzylvheb zzylvheb_temp /end LOC_MEASUREMENT
 FUNCTION_VERSION "14.0.0" /end FUNCTION
/begin FUNCTION AVSExtd_Std "30000.0.0 Adjustment Value Service extended" FUNCTION_VERSION "30000.0.0" /end FUNCTION
/begin FUNCTION AVS_Std "30000.15.0Adjustment Value Service" FUNCTION_VERSION "30000.15.0" /end FUNCTION
/begin FUNCTION BattECU_EBS "17.3.0_6SAABattECU LIN frames"
 /begin DEF_CHARACTERISTIC ComEBS_iStByCurrAft0hTypBOfs_C ComEBS_iStByCurrTypBSlp_C ComEBS_qStByCurrAft1hTypBOfs_C ComEBS_qStByCurrAft2hTypBOfs_C ComEBS_qStByCurrLstTypBOfs_C Com_dEBSDByt0_C Com_dEBSDByt1_C Com_dEBSDByt2_C Com_dEBSDByt3_C Com_dEBSDByt4_C EBS_qNorm_C /end DEF_CHARACTERISTIC
 /begin IN_MEASUREMENT Linappl_stFrstFrmRxd Lin_BS_B_Signal_OCV_8_r_msg Lin_BS_B_Signal_STBATTSENRST_1_r_msg Lin_BS_B_Signal_TASIC_8_r_msg Lin_BS_B_Signal_tiDurAftIgnOff_16_r_msg Lin_BS_Signal_B_BattChg_2_r_msg Lin_BS_Signal_B_BATTCH_16_r_msg Lin_BS_Signal_B_BATTDCHA_16_r_msg Lin_BS_Signal_B_BATT_WARM_LEVEL_3_r_msg Lin_BS_Signal_B_BCF_1_r_msg Lin_BS_Signal_B_CHARERR_1_r_msg Lin_BS_Signal_B_ctCrkngDetn_16_r_msg Lin_BS_Signal_B_CTINTRESUPD_2_r_msg Lin_BS_Signal_B_ctMeasmtCrk_2_r_msg Lin_BS_Signal_B_CtResRpl_5_r_msg Lin_BS_Signal_B_ERROR_RES_1_r_msg Lin_BS_Signal_B_iBattStrtCrn_14_r_msg Lin_BS_Signal_B_IBAT_16_r_msg Lin_BS_Signal_B_IBAT_8_r_msg Lin_BS_Signal_B_idBattData_8_r_msg Lin_BS_Signal_B_iMaxBattDcha_16_r_msg Lin_BS_Signal_B_iStByCurrAft0h_10_r_msg Lin_BS_Signal_B_iStByCurrAft1h_10_r_msg Lin_BS_Signal_B_iStByCurrAft2h_10_r_msg Lin_BS_Signal_B_iStByCurrLst_10_r_msg Lin_BS_Signal_B_LIN_TYPE_RX_4_r_msg Lin_BS_Signal_B_numBattPart_8_r_msg Lin_BS_Signal_B_numLowSOCDetn_8_r_msg Lin_BS_Signal_B_PulResUpd_2_r_msg Lin_BS_Signal_B_RESMEASDBATT_16_r_msg Lin_BS_Signal_B_resPul_16_r_msg Lin_BS_Signal_B_ResRpl_11_r_msg Lin_BS_Signal_B_SOC_10_r_msg Lin_BS_Signal_B_SOC_STATE_3_r_msg Lin_BS_Signal_B_SOHSOFLrng_2_r_msg Lin_BS_Signal_B_SOH_10_r_msg Lin_BS_Signal_B_stChrgReq_3_r_msg Lin_BS_Signal_B_stFitng_1_r_msg Lin_BS_Signal_B_stHarnR_2_r_msg Lin_BS_Signal_B_SUPPLIER_CODE_8_r_msg Lin_BS_Signal_B_TBattResPul_8_r_msg Lin_BS_Signal_B_TBAT_8_r_msg Lin_BS_Signal_B_TerminalOFFDetn_2_r_msg Lin_BS_Signal_B_tiBattON_16_r_msg Lin_BS_Signal_B_tiT15ON_11_r_msg Lin_BS_Signal_B_tMaxBatt_8_r_msg Lin_BS_Signal_B_tMinBatt_8_r_msg Lin_BS_Signal_B_uBattSOFV_8_r_msg Lin_BS_Signal_B_UBAT_16_r_msg Lin_BS_Signal_B_uPeak_16_r_msg Lin_BS_Signal_B_xMnfcDate_16_r_msg Lin_BS_Signal_ERRCMN_1_r_msg Lin_BS_Signal_ERRST_1_r_msg /end IN_MEASUREMENT
 /begin OUT_MEASUREMENT ComEBS_ctCrkngDetn ComEBS_ctMeasmtCrk ComEBS_ctResRpl ComEBS_iBattStrtCrn ComEBS_idBattData ComEBS_iMaxBattDcha ComEBS_numBattPart ComEBS_numLowSOCDetn ComEBS_resPul ComEBS_resRpl ComEBS_stBattChg ComEBS_stBattComResErr ComEBS_stBattSplrDiscern ComEBS_stBattWrmLvl ComEBS_stChrgReq ComEBS_stFitng ComEBS_stHarnR ComEBS_stSensErrAftIgnOff ComEBS_stTermOffDetn ComEBS_tBattResPul ComEBS_tBattSensASIC ComEBS_tiBattON ComEBS_tiT15ON ComEBS_tMaxBatt ComEBS_tMinBatt ComEBS_uBattSOFV ComEBS_uBattUCO ComEBS_xMnfcDate Com_bBliChrg Com_cntrIntResUpd Com_dEBSDByt0 Com_dEBSDByt1 Com_dEBSDByt2 Com_dEBSDByt3 Com_dEBSDByt4 Com_flgEbsRst Com_iBattEBS Com_iStbIAft0Hr Com_qChrg Com_qDisChrg Com_qSoh Com_qStbIAft1Hr Com_qStbIAft2Hr Com_qStbILast Com_ratSoc Com_ratSoh Com_rMeasdBattREbs Com_stBattDchaVltgPrdnSig Com_stBattDgrtSig Com_stCharErr Com_stLinFmtRxn Com_stPulResUpd Com_stSensErr Com_stSoc Com_tBattEBS Com_tiDurnAftIgnOff Com_uBattEBS Com_uPeak /end OUT_MEASUREMENT
 FUNCTION_VERSION "17.3.0_6SAA" /end FUNCTION
/begin FUNCTION BattU2MED "1.8.2     Interface Adapter BattU to MED" /begin DEF_CHARACTERISTIC TDUBEVAB UBEVABW /end DEF_CHARACTERISTIC /begin IN_MEASUREMENT BattU_u BattU_uSens /end IN_MEASUREMENT
 /begin OUT_MEASUREMENT B_hrevab B_kdhre B_ubg ub ubdq ubdq_w ubrdq ubrdq_w ubrsq ubrsqf_w ubrsq_w ubsq ubsqf ubsqf_w ubsq_w wub wub_w /end OUT_MEASUREMENT
 FUNCTION_VERSION "1.8.2" /end FUNCTION
/begin FUNCTION BattU_DD "2.14.0    Battery Voltage Acquisition Device Driver" /begin DEF_CHARACTERISTIC BattU_uTransf_CUR /end DEF_CHARACTERISTIC /begin OUT_MEASUREMENT BattU_uRaw BattU_uSens /end OUT_MEASUREMENT /begin LOC_MEASUREMENT BattU_SensBuf BattU_SensBufLoc BattU_uRaw_mp ctBattSamples /end LOC_MEASUREMENT FUNCTION_VERSION "2.14.0" /end FUNCTION
/begin FUNCTION BattU_DrpPrv "6.0.0_1.0.0Power pump to inhibit voltage drops in case of initiate"
 /begin DEF_CHARACTERISTIC BattU_stPwrStgDiaDis_C BattU_tiCSTDef_C BattU_tiStabPsOffDly_C BattU_tiStabPsOnDly_C Batt_tiCSTWarrant_C Batt_tiUStabAftStrt_C /end DEF_CHARACTERISTIC
 /begin IN_MEASUREMENT CoEng_st ComDCDC_stCSTHist CoVOM_bEngPreStrtOrd DevLib_stPwrStgEnaCond Strt_stStaActv T15_st /end IN_MEASUREMENT
 /begin OUT_MEASUREMENT BattU_stStabPs /end OUT_MEASUREMENT
 /begin LOC_MEASUREMENT Battu_flgRstrtReq BattU_flgUStab BattU_stCSTEnbl_mp BattU_stDiagCmpl_mp BattU_stFltTstEnaCond_mp BattU_stFltTstRst_mp BattU_tiCSTDef_mp Battu_tiCSTWarrant /end LOC_MEASUREMENT
 FUNCTION_VERSION "6.0.0_1.0.0" /end FUNCTION
/begin FUNCTION BattU_PwrFail "2.9.0     Battery Voltage Powerfail Detection" /begin OUT_MEASUREMENT BattU_stPwrFail /end OUT_MEASUREMENT /begin LOC_MEASUREMENT BattU_flgPwrFail /end LOC_MEASUREMENT FUNCTION_VERSION "2.9.0" /end FUNCTION
/begin FUNCTION BattU_UStbyDia "2.1.1     Diagnosis of stand-by power supply line" /begin DEF_CHARACTERISTIC BattU_numUStbyDiaDeb_C /end DEF_CHARACTERISTIC /begin IN_MEASUREMENT BattU_stPwrFail /end IN_MEASUREMENT
 /begin LOC_MEASUREMENT BattU_flgEEPWriteRetVal BattU_NrEveCntr BattU_PrevErrSt BattU_stEEPBlockRetVal BattU_stEepEveCnt BattU_stEepPrevErr /end LOC_MEASUREMENT
 FUNCTION_VERSION "2.1.1" /end FUNCTION
/begin FUNCTION BattU_VD "40.2.0_1.1.0Battery Voltage Acquisition Virtual Device"
 /begin DEF_CHARACTERISTIC BattU_facFild_C BattU_flgBattDetnIMGECUEna_C BattU_flgBattDetnTCUECUEna_C BattU_flgBattUMonEna_C BattU_nEngStabThd_C BattU_RmpSlpNeg_C BattU_RmpSlpPos_C BattU_stSensId_C BattU_swtCorFacActv_C BattU_swtRated_C BattU_tiIgnONDlyThd_C BattU_tiSensLo_C BattU_tiSRCActvDly_C BattU_uHiUFailrThd_C BattU_uLoUFailrThd_C BattU_uNrm_C BattU_uSensLo_C BattU_uSnsrFildIni_C BattU_uSRCMax_C BattU_uSRCMin_C BattU_uTransDft_C BattU_uWrgDetnPrevnThd_C BattU_vSRCMaxLim_C /end DEF_CHARACTERISTIC
 /begin IN_MEASUREMENT BattU_uRaw BattU_uSens CoEng_st Com_uBattDetnIMGECU Com_uBattDetnTCUECU Epm_nEng MRly_st SyC_ctPostDrvLeave SyC_stSub T15_st VehV_v /end IN_MEASUREMENT
 /begin OUT_MEASUREMENT BattU_facCor BattU_flgHiUFailrCfmd BattU_flgHiUNormCfmd BattU_flgLoUFailrCfmd BattU_flgLoUNormCfmd BattU_stEngCmbCmpl BattU_stErrDSQ BattU_u BattU_uRated BattU_uSnsrFild /end OUT_MEASUREMENT
 /begin LOC_MEASUREMENT BattU_cntrReIni BattU_flgChrgrCnctd BattU_flgErrDSQ BattU_flgIgnOnDlyDiagEna BattU_uBattDetnIMGCnv BattU_uBattDetnTCUCnv /end LOC_MEASUREMENT
 FUNCTION_VERSION "40.2.0_1.1.0" /end FUNCTION
/begin COMPU_METHOD B_TRUE "" TAB_VERB "%6.3" "" COMPU_TAB_REF B_TRUE /end COMPU_METHOD
/begin COMPU_VTAB B_TRUE "" TAB_VERB 2 0 "FALSE" 1 "TRUE" /end COMPU_VTAB
/begin COMPU_METHOD CAMSFT_NOERRHEALDCYC_SC_Compu "" TAB_VERB "%6.3" "" COMPU_TAB_REF CAMSFT_NOERRHEALDCYC_SC_Compu /end COMPU_METHOD
/begin COMPU_VTAB CAMSFT_NOERRHEALDCYC_SC_Compu "" TAB_VERB 2 0 "False" 1 "True" /end COMPU_VTAB
/begin COMPU_METHOD CAMSFT_NOMINOVLMISF_SC_Compu "" TAB_VERB "%6.3" "" COMPU_TAB_REF CAMSFT_NOMINOVLMISF_SC_Compu /end COMPU_METHOD
/begin COMPU_VTAB CAMSFT_NOMINOVLMISF_SC_Compu "" TAB_VERB 2 0 "False" 1 "True" /end COMPU_VTAB
/begin COMPU_METHOD CAMSFT_POIL_SC_Compu "" TAB_VERB "%6.3" "" COMPU_TAB_REF CAMSFT_POIL_SC_Compu /end COMPU_METHOD
/begin COMPU_VTAB CAMSFT_POIL_SC_Compu "" TAB_VERB 2 0 "False" 1 "True" /end COMPU_VTAB
/begin COMPU_METHOD CAMSFT_REFADPNCLNGRQRD_SC_Compu "" TAB_VERB "%6.3" "" COMPU_TAB_REF CAMSFT_REFADPNCLNGRQRD_SC_Compu /end COMPU_METHOD
/begin COMPU_VTAB CAMSFT_REFADPNCLNGRQRD_SC_Compu "" TAB_VERB 2 0 "no_cleaning_required" 1 "cleaning_required" /end COMPU_VTAB
/begin COMPU_METHOD CAMSFT_REFPOSNCORRNTYP_SC_Compu "" TAB_VERB "%6.3" "" COMPU_TAB_REF CAMSFT_REFPOSNCORRNTYP_SC_Compu /end COMPU_METHOD
/begin COMPU_VTAB CAMSFT_REFPOSNCORRNTYP_SC_Compu "" TAB_VERB 5 0 "no_correction" 1 "AdpnKnDet" 2 "SWSH_VAR3" 3 "SWSH" 4 "ChrAdap" /end COMPU_VTAB
/begin COMPU_METHOD CAMSFT_REFPOSNCORRN_SC_Compu "" TAB_VERB "%6.3" "" COMPU_TAB_REF CAMSFT_REFPOSNCORRN_SC_Compu /end COMPU_METHOD
/begin COMPU_VTAB CAMSFT_REFPOSNCORRN_SC_Compu "" TAB_VERB 2 0 "False" 1 "True" /end COMPU_VTAB
/begin COMPU_METHOD CAMSFT_REFPOSNINTK_SC_Compu "" TAB_VERB "%6.3" "" COMPU_TAB_REF CAMSFT_REFPOSNINTK_SC_Compu /end COMPU_METHOD
/begin COMPU_VTAB CAMSFT_REFPOSNINTK_SC_Compu "" TAB_VERB 2 0 "False" 1 "True" /end COMPU_VTAB
/begin COMPU_METHOD CAMSFT_REFPOSNOUTL_SC_Compu "" TAB_VERB "%6.3" "" COMPU_TAB_REF CAMSFT_REFPOSNOUTL_SC_Compu /end COMPU_METHOD
/begin COMPU_VTAB CAMSFT_REFPOSNOUTL_SC_Compu "" TAB_VERB 2 0 "False" 1 "True" /end COMPU_VTAB
/begin COMPU_METHOD CAMSFT_SOLNTMDL_SC_Compu "" TAB_VERB "%6.3" "" COMPU_TAB_REF CAMSFT_SOLNTMDL_SC_Compu /end COMPU_METHOD
/begin COMPU_VTAB CAMSFT_SOLNTMDL_SC_Compu "" TAB_VERB 2 0 "False" 1 "True" /end COMPU_VTAB
/begin COMPU_METHOD CAMSFT_SPCLDUTYCYCINTVACTVT_SC_Compu "" TAB_VERB "%6.3" "" COMPU_TAB_REF CAMSFT_SPCLDUTYCYCINTVACTVT_SC_Compu /end COMPU_METHOD
/begin COMPU_VTAB CAMSFT_SPCLDUTYCYCINTVACTVT_SC_Compu "" TAB_VERB 2 0 "False" 1 "True" /end COMPU_VTAB
/begin COMPU_METHOD CAMSFT_SPCLSPRGNEGTSYS_SC_Compu "" TAB_VERB "%6.3" "" COMPU_TAB_REF CAMSFT_SPCLSPRGNEGTSYS_SC_Compu /end COMPU_METHOD
/begin COMPU_VTAB CAMSFT_SPCLSPRGNEGTSYS_SC_Compu "" TAB_VERB 2 0 "False" 1 "True" /end COMPU_VTAB
/begin COMPU_METHOD CAMSFT_SWTOFFPSELECERRDSTCN_SC_Compu "" TAB_VERB "%6.3" "" COMPU_TAB_REF CAMSFT_SWTOFFPSELECERRDSTCN_SC_Compu /end COMPU_METHOD
/begin COMPU_VTAB CAMSFT_SWTOFFPSELECERRDSTCN_SC_Compu "" TAB_VERB 2 0 "False" 1 "True" /end COMPU_VTAB
/begin COMPU_METHOD CAMSFT_VARIINTK_SC_Compu "" TAB_VERB "%6.3" "" COMPU_TAB_REF CAMSFT_VARIINTK_SC_Compu /end COMPU_METHOD
/begin COMPU_VTAB CAMSFT_VARIINTK_SC_Compu "" TAB_VERB 3 0 "NoShft" 1 "2PtShft" 2 "ContShft" /end COMPU_VTAB
/begin COMPU_METHOD CAMSFT_VARIOUTL_SC_Compu "" TAB_VERB "%6.3" "" COMPU_TAB_REF CAMSFT_VARIOUTL_SC_Compu /end COMPU_METHOD
/begin COMPU_VTAB CAMSFT_VARIOUTL_SC_Compu "" TAB_VERB 3 0 "NoShft" 1 "2PtShft" 2 "ContShft" /end COMPU_VTAB
/begin COMPU_METHOD CANBMS_SY_Compu "" TAB_VERB "%6.3" "" COMPU_TAB_REF CANBMS_SY_Compu /end COMPU_METHOD
/begin COMPU_VTAB CANBMS_SY_Compu "" TAB_VERB 2 0 "False" 1 "True" /end COMPU_VTAB
/begin COMPU_METHOD CANEPB_SY_Compu "" TAB_VERB "%6.3" "" COMPU_TAB_REF CANEPB_SY_Compu /end COMPU_METHOD
/begin COMPU_VTAB CANEPB_SY_Compu "" TAB_VERB 2 0 "False" 1 "True" /end COMPU_VTAB
/begin COMPU_METHOD CANGENN_SC_Compu "" TAB_VERB "%6.3" "" COMPU_TAB_REF CANGENN_SC_Compu /end COMPU_METHOD
/begin COMPU_VTAB CANGENN_SC_Compu "" TAB_VERB 2 1 "CAN_1_0" 2 "CAN_2_0" /end COMPU_VTAB
/begin COMPU_METHOD CANIPCORETYPE_SC_Compu "" TAB_VERB "%6.3" "" COMPU_TAB_REF CANIPCORETYPE_SC_Compu /end COMPU_METHOD
/begin COMPU_VTAB CANIPCORETYPE_SC_Compu "" TAB_VERB 2 0 "0" 1 "1" /end COMPU_VTAB
/begin COMPU_METHOD CANIVSS_SC_Compu "" TAB_VERB "%6.3" "" COMPU_TAB_REF CANIVSS_SC_Compu /end COMPU_METHOD
/begin COMPU_VTAB CANIVSS_SC_Compu "" TAB_VERB 2 0 "False" 1 "True" /end COMPU_VTAB
/begin COMPU_METHOD CANMCU_SY_Compu "" TAB_VERB "%6.3" "" COMPU_TAB_REF CANMCU_SY_Compu /end COMPU_METHOD
/begin COMPU_VTAB CANMCU_SY_Compu "" TAB_VERB 2 0 "False" 1 "True" /end COMPU_VTAB
/begin COMPU_METHOD CANMDPS_SY_Compu "" TAB_VERB "%6.3" "" COMPU_TAB_REF CANMDPS_SY_Compu /end COMPU_METHOD
/begin COMPU_VTAB CANMDPS_SY_Compu "" TAB_VERB 2 0 "False" 1 "True" /end COMPU_VTAB
/begin COMPU_METHOD CANNM_SC_Compu "" TAB_VERB "%6.3" "" COMPU_TAB_REF CANNM_SC_Compu /end COMPU_METHOD
/begin COMPU_VTAB CANNM_SC_Compu "" TAB_VERB 2 0 "False" 1 "True" /end COMPU_VTAB
/begin COMPU_METHOD CANOPI_SY_Compu "" TAB_VERB "%6.3" "" COMPU_TAB_REF CANOPI_SY_Compu /end COMPU_METHOD
/begin COMPU_VTAB CANOPI_SY_Compu "" TAB_VERB 2 0 "False" 1 "True" /end COMPU_VTAB
/begin COMPU_METHOD CANSAS_SY_Compu "" TAB_VERB "%6.3" "" COMPU_TAB_REF CANSAS_SY_Compu /end COMPU_METHOD
/begin COMPU_VTAB CANSAS_SY_Compu "" TAB_VERB 2 0 "False" 1 "True" /end COMPU_VTAB
/begin COMPU_METHOD CANSM_SC_Compu "" TAB_VERB "%6.3" "" COMPU_TAB_REF CANSM_SC_Compu /end COMPU_METHOD
/begin COMPU_VTAB CANSM_SC_Compu "" TAB_VERB 2 0 "False" 1 "True" /end COMPU_VTAB
/begin COMPU_METHOD CANSPAS_SY_Compu "" TAB_VERB "%6.3" "" COMPU_TAB_REF CANSPAS_SY_Compu /end COMPU_METHOD
/begin COMPU_VTAB CANSPAS_SY_Compu "" TAB_VERB 2 0 "False" 1 "True" /end COMPU_VTAB
/begin COMPU_METHOD CANTCS_SY_Compu "" TAB_VERB "%6.3" "" COMPU_TAB_REF CANTCS_SY_Compu /end COMPU_METHOD
/begin COMPU_VTAB CANTCS_SY_Compu "" TAB_VERB 2 0 "False" 1 "True" /end COMPU_VTAB
/begin COMPU_METHOD CANTMU_SY_Compu "" RAT_FUNC "%6.2" "" COEFFS 0 1 0 0 0 1 /end COMPU_METHOD
/begin COMPU_METHOD CANTP_SC_Compu "" TAB_VERB "%6.3" "" COMPU_TAB_REF CANTP_SC_Compu /end COMPU_METHOD
/begin COMPU_VTAB CANTP_SC_Compu "" TAB_VERB 2 0 "False" 1 "True" /end COMPU_VTAB
/begin COMPU_METHOD CANTSYN_SC_Compu "" TAB_VERB "%6.3" "" COMPU_TAB_REF CANTSYN_SC_Compu /end COMPU_METHOD
/begin COMPU_VTAB CANTSYN_SC_Compu "" TAB_VERB 2 0 "False" 1 "True" /end COMPU_VTAB
/begin COMPU_METHOD CANVER_SY_Compu "" TAB_VERB "%6.3" "" COMPU_TAB_REF CANVER_SY_Compu /end COMPU_METHOD
/begin COMPU_VTAB CANVER_SY_Compu "" TAB_VERB 3 0 "CANVER_V4V5" 1 "CANVER_MLB" 2 "CANVER_MQB" /end COMPU_VTAB
/begin COMPU_METHOD CAN_MDS_SC_Compu "" TAB_VERB "%6.3" "" COMPU_TAB_REF CAN_MDS_SC_Compu /end COMPU_METHOD
/begin COMPU_VTAB CAN_MDS_SC_Compu "" TAB_VERB 2 0 "CAN_MDS_OFF" 1 "CAN_MDS_ON" /end COMPU_VTAB
/begin COMPU_METHOD CARBMDLYR19UPD2016_SC_Compu "" RAT_FUNC "%6.2" "" COEFFS 0 1 0 0 0 1 /end COMPU_METHOD
/begin COMPU_METHOD CASI1_SSP_SY_Compu "" TAB_VERB "%6.3" "" COMPU_TAB_REF CASI1_SSP_SY_Compu /end COMPU_METHOD
/begin COMPU_VTAB CASI1_SSP_SY_Compu "" TAB_VERB 4 0 "NO_CAS_SSPMON" 1 "SSPMON1" 2 "SSPMON2" 3 "SSPMON3" /end COMPU_VTAB
/begin COMPU_METHOD CASI2_SSP_SY_Compu "" TAB_VERB "%6.3" "" COMPU_TAB_REF CASI2_SSP_SY_Compu /end COMPU_METHOD
/begin COMPU_VTAB CASI2_SSP_SY_Compu "" TAB_VERB 4 0 "NO_CAS_SSPMON" 1 "SSPMON1" 2 "SSPMON2" 3 "SSPMON3" /end COMPU_VTAB
/begin COMPU_METHOD CASO1_SSP_SY_Compu "" TAB_VERB "%6.3" "" COMPU_TAB_REF CASO1_SSP_SY_Compu /end COMPU_METHOD
/begin COMPU_VTAB CASO1_SSP_SY_Compu "" TAB_VERB 4 0 "NO_CAS_SSPMON" 1 "SSPMON1" 2 "SSPMON2" 3 "SSPMON3" /end COMPU_VTAB
/begin COMPU_METHOD CASO2_SSP_SY_Compu "" TAB_VERB "%6.3" "" COMPU_TAB_REF CASO2_SSP_SY_Compu /end COMPU_METHOD
/begin COMPU_VTAB CASO2_SSP_SY_Compu "" TAB_VERB 4 0 "NO_CAS_SSPMON" 1 "SSPMON1" 2 "SSPMON2" 3 "SSPMON3" /end COMPU_VTAB
/begin COMPU_METHOD CASTYP_SY_Compu "" TAB_VERB "%6.3" "" COMPU_TAB_REF CASTYP_SY_Compu /end COMPU_METHOD
/begin COMPU_VTAB CASTYP_SY_Compu "" TAB_VERB 8 0 "INDIVIDUAL" 1 "CAS_GS_STD_4TOOTH" 2 "CAS_3TOOTH" 3 "CAS_PULSE" 4 "CAS_HALFMOON" 5 "CAS_5TOOH" 6 "CAS_DS_STD_3TEETH" 7 "CAS_3TOOTH_180_60" /end COMPU_VTAB
/begin COMPU_METHOD CAS_ADAP_SY_Compu "" TAB_VERB "%6.3" "" COMPU_TAB_REF CAS_ADAP_SY_Compu /end COMPU_METHOD
/begin COMPU_VTAB CAS_ADAP_SY_Compu "" TAB_VERB 4 0 "NO_ADAP" 1 "ADAP" 2 "ADAP_MNTCHK" 3 "ADAP_MNTCHK_INDEDGE" /end COMPU_VTAB
/begin COMPU_METHOD CAS_ANGLE_SY_Compu "" TAB_VERB "%6.3" "" COMPU_TAB_REF CAS_ANGLE_SY_Compu /end COMPU_METHOD
/begin COMPU_VTAB CAS_ANGLE_SY_Compu "" TAB_VERB 3 0 "NO_ANGLE" 1 "VIA_MESSAGE" 2 "VIA_SERVICE" /end COMPU_VTAB
/begin COMPU_METHOD CAS_BACKUPVAR_SY_Compu "" TAB_VERB "%6.3" "" COMPU_TAB_REF CAS_BACKUPVAR_SY_Compu /end COMPU_METHOD
/begin COMPU_VTAB CAS_BACKUPVAR_SY_Compu "" TAB_VERB 3 0 "NO_VAR" 1 "ACC_CURVE" 2 "CAS_START" /end COMPU_VTAB
/begin COMPU_METHOD CAS_BACKUP_SY_Compu "" TAB_VERB "%6.3" "" COMPU_TAB_REF CAS_BACKUP_SY_Compu /end COMPU_METHOD
/begin COMPU_VTAB CAS_BACKUP_SY_Compu "" TAB_VERB 5 0 "NO_BACKUP" 1 "TST_INJ" 2 "DOUBLE_IGN" 3 "TST_INJ_GDI" 4 "TST_INJ_DS" /end COMPU_VTAB
/begin COMPU_METHOD CAS_CY30CONF_SY_Compu "" TAB_VERB "%6.3" "" COMPU_TAB_REF CAS_CY30CONF_SY_Compu /end COMPU_METHOD
/begin COMPU_VTAB CAS_CY30CONF_SY_Compu "" TAB_VERB 4 0 "hard-wired" 1 "CONF_TH is set from SW" 2 "CONF_K is set from SW" 3 "CONF_K  and CONF_TH is set from SW" /end COMPU_VTAB
/begin COMPU_METHOD CAS_DIAG_SY_Compu "" TAB_VERB "%6.3" "" COMPU_TAB_REF CAS_DIAG_SY_Compu /end COMPU_METHOD
/begin COMPU_VTAB CAS_DIAG_SY_Compu "" TAB_VERB 4 0 "STD" 1 "ADD_OFFS" 2 "ADD_MINMAX" 3 "ADD_IUMPR" /end COMPU_VTAB
/begin COMPU_METHOD CAS_I1_SY_Compu "" TAB_VERB "%6.3" "" COMPU_TAB_REF CAS_I1_SY_Compu /end COMPU_METHOD
/begin COMPU_VTAB CAS_I1_SY_Compu "" TAB_VERB 2 0 "NO_SIGNAL" 1 "SIGNAL_AVAILABLE" /end COMPU_VTAB
/begin COMPU_METHOD CAS_I2_SY_Compu "" TAB_VERB "%6.3" "" COMPU_TAB_REF CAS_I2_SY_Compu /end COMPU_METHOD
/begin COMPU_VTAB CAS_I2_SY_Compu "" TAB_VERB 2 0 "NO_SIGNAL" 1 "SIGNAL_AVAILABLE" /end COMPU_VTAB
/begin COMPU_METHOD CAS_O1_SY_Compu "" TAB_VERB "%6.3" "" COMPU_TAB_REF CAS_O1_SY_Compu /end COMPU_METHOD
/begin COMPU_VTAB CAS_O1_SY_Compu "" TAB_VERB 2 0 "NO_SIGNAL" 1 "SIGNAL_AVAILABLE" /end COMPU_VTAB
/begin COMPU_METHOD CAS_O2_SY_Compu "" TAB_VERB "%6.3" "" COMPU_TAB_REF CAS_O2_SY_Compu /end COMPU_METHOD
/begin COMPU_VTAB CAS_O2_SY_Compu "" TAB_VERB 2 0 "NO_SIGNAL" 1 "SIGNAL_AVAILABLE" /end COMPU_VTAB
/begin COMPU_METHOD CATCPTPROTNEXTEGR_SC_Compu "" TAB_VERB "%6.3" "" COMPU_TAB_REF CATCPTPROTNEXTEGR_SC_Compu /end COMPU_METHOD
/begin COMPU_VTAB CATCPTPROTNEXTEGR_SC_Compu "" TAB_VERB 2 0 "False" 1 "True" /end COMPU_VTAB
/begin COMPU_METHOD CATHEATGELVTDTSTRT_SC_Compu "" TAB_VERB "%6.3" "" COMPU_TAB_REF CATHEATGELVTDTSTRT_SC_Compu /end COMPU_METHOD
/begin COMPU_VTAB CATHEATGELVTDTSTRT_SC_Compu "" TAB_VERB 2 0 "False" 1 "True" /end COMPU_VTAB
/begin COMPU_METHOD CATHEATGREPREQCYC_SC_Compu "" TAB_VERB "%6.3" "" COMPU_TAB_REF CATHEATGREPREQCYC_SC_Compu /end COMPU_METHOD
/begin COMPU_VTAB CATHEATGREPREQCYC_SC_Compu "" TAB_VERB 2 0 "False" 1 "True" /end COMPU_VTAB
/begin COMPU_METHOD CATHEATG_INHOUSE_SC_Compu "" TAB_VERB "%6.3" "" COMPU_TAB_REF CATHEATG_INHOUSE_SC_Compu /end COMPU_METHOD
/begin COMPU_VTAB CATHEATG_INHOUSE_SC_Compu "" TAB_VERB 2 0 "InHouse_CatHeatg_deactv" 1 "InHouse_CatHeatg_actv" /end COMPU_VTAB
/begin COMPU_METHOD CCACHPDST_TYPAVL_SY_Compu "" TAB_VERB "%6.3" "" COMPU_TAB_REF CCACHPDST_TYPAVL_SY_Compu /end COMPU_METHOD
/begin COMPU_VTAB CCACHPDST_TYPAVL_SY_Compu "" TAB_VERB 2 0 "False" 1 "True" /end COMPU_VTAB
/begin COMPU_METHOD CCACLPDST_TYPAVL_SY_Compu "" TAB_VERB "%6.3" "" COMPU_TAB_REF CCACLPDST_TYPAVL_SY_Compu /end COMPU_METHOD
/begin COMPU_VTAB CCACLPDST_TYPAVL_SY_Compu "" TAB_VERB 2 0 "False" 1 "True" /end COMPU_VTAB
/begin COMPU_METHOD CDASWILCAMSFTALLCYL_SC_Compu "" TAB_VERB "%6.3" "" COMPU_TAB_REF CDASWILCAMSFTALLCYL_SC_Compu /end COMPU_METHOD
/begin COMPU_VTAB CDASWILCAMSFTALLCYL_SC_Compu "" TAB_VERB 2 0 "False" 1 "True" /end COMPU_VTAB
/begin COMPU_METHOD CDAWOSWILVLV_SC_Compu "" TAB_VERB "%6.3" "" COMPU_TAB_REF CDAWOSWILVLV_SC_Compu /end COMPU_METHOD
/begin COMPU_VTAB CDAWOSWILVLV_SC_Compu "" TAB_VERB 2 0 "False" 1 "True" /end COMPU_VTAB
/begin COMPU_METHOD CDGEN_ENV_SC_Compu "" TAB_VERB "%6.3" "" COMPU_TAB_REF CDGEN_ENV_SC_Compu /end COMPU_METHOD
/begin COMPU_VTAB CDGEN_ENV_SC_Compu "" TAB_VERB 4 0 "CDGEN_ENV_DS" 1 "CDGEN_ENV_GS" 2 "CDGEN_ENV_DGS" 3 "CDGEN_ENV_MDG" /end COMPU_VTAB
/begin COMPU_METHOD CrCtlSlipRat "" RAT_FUNC "%6.4" "%" COEFFS 0 200 0 0 0 1 /end COMPU_METHOD
/begin COMPU_METHOD Curr_mA_q0p9765625_COMPU "" RAT_FUNC "%6.2" "mA" COEFFS 0 1.024 0 0 0 1 /end COMPU_METHOD
/begin COMPU_METHOD dez "" RAT_FUNC "%6.2" "" COEFFS 0 1 0 0 0 1 /end COMPU_METHOD
/begin COMPU_METHOD ElecChrg_Ah_q0p125_COMPU "" RAT_FUNC "%6.3" "Ah" COEFFS 0 8 0 0 0 1 /end COMPU_METHOD
/begin COMPU_METHOD EngN "" RAT_FUNC "%6.3" "rpm" COEFFS 0 2 0 0 0 1 /end COMPU_METHOD
/begin COMPU_METHOD EngNGrd "" RAT_FUNC "%6.3" "rpm/s" COEFFS 0 2 0 0 0 1 /end COMPU_METHOD
/begin COMPU_METHOD EngN_LRes "" RAT_FUNC "%6.1" "rpm" COEFFS 0 0.025 0 0 0 1 /end COMPU_METHOD
/begin COMPU_METHOD Fact "" RAT_FUNC "%6.5" "-" COEFFS 0 8192 0 0 0 1 /end COMPU_METHOD
/begin COMPU_METHOD Fact_2pwr11 "" RAT_FUNC "%6.5" "-" COEFFS 0 2048 0 0 0 1 /end COMPU_METHOD
/begin COMPU_METHOD fak_ub_b16 "" RAT_FUNC "%6.4" "-" COEFFS 0 256 0 0 0 16 /end COMPU_METHOD
/begin COMPU_METHOD fak_ub_b2 "" RAT_FUNC "%8.5" "-" COEFFS 0 256 0 0 0 2 /end COMPU_METHOD
/begin COMPU_METHOD fak_ub_b8 "" RAT_FUNC "%6.4" "-" COEFFS 0 256 0 0 0 8 /end COMPU_METHOD
/begin COMPU_METHOD fak_uw_b1 "" RAT_FUNC "%7.6" "-" COEFFS 0 65536 0 0 0 1 /end COMPU_METHOD
/begin COMPU_METHOD fak_uw_b2 "" RAT_FUNC "%7.6" "-" COEFFS 0 65536 0 0 0 2 /end COMPU_METHOD
/begin COMPU_METHOD i_q0p01_A "" RAT_FUNC "%6.4" "A" COEFFS 0 1 0 0 0 0.01 /end COMPU_METHOD
/begin COMPU_METHOD kw_q1 "" RAT_FUNC "%6.2" "Grad KW" COEFFS 0 1 0 0 0 1 /end COMPU_METHOD
/begin COMPU_METHOD mdgrad_q10 "" RAT_FUNC "%6.1" "Nm/s" COEFFS 0 1 0 0 0 10 /end COMPU_METHOD
/begin COMPU_METHOD md_sw_q0p1 "" RAT_FUNC "%6.3" "Nm" COEFFS 0 10 0 0 0 1 /end COMPU_METHOD
/begin COMPU_METHOD nmot_q0p5 "" RAT_FUNC "%6.3" "1/min" COEFFS 0 2 0 0 0 1 /end COMPU_METHOD
/begin COMPU_METHOD nmot_ub_q40 "" RAT_FUNC "%6.1" "1/min" COEFFS 0 1 0 0 0 40 /end COMPU_METHOD
/begin COMPU_METHOD OneToOne "" RAT_FUNC "%6.2" "-" COEFFS 0 1 0 0 0 1 /end COMPU_METHOD
/begin COMPU_METHOD Prc "" RAT_FUNC "%6.4" "%" COEFFS 0 81.92 0 0 0 1 /end COMPU_METHOD
/begin COMPU_METHOD Pres "" RAT_FUNC "%6.3" "kPa" COEFFS 0 10 0 0 0 1 /end COMPU_METHOD
/begin COMPU_METHOD p_uw_q0p039 "" RAT_FUNC "%6.4" "hPa" COEFFS 0 256 0 0 0 10 /end COMPU_METHOD
/begin COMPU_METHOD q0p01_A_h_1 "" RAT_FUNC "%6.4" "Ah" COEFFS 0 100 0 0 0 1 /end COMPU_METHOD
/begin COMPU_METHOD q0p01_mOhm "" RAT_FUNC "%6.4" "mOhm" COEFFS 0 100 0 0 0 1 /end COMPU_METHOD
/begin COMPU_METHOD q0p0625_DIV_Nm_s "" RAT_FUNC "%6.4" "1/(Nm*s)" COEFFS 0 65536 0 0 0 4096 /end COMPU_METHOD
/begin COMPU_METHOD q0p0625_V "" RAT_FUNC "%6.4" "V" COEFFS 0 16 0 0 0 1 /end COMPU_METHOD
/begin COMPU_METHOD q0p1_om1500_A "" RAT_FUNC "%6.0" "A" COEFFS 0 10 15000 0 0 1 /end COMPU_METHOD
/begin COMPU_METHOD q1_om40_DegCgrd "" RAT_FUNC "%6.2" "°C" COEFFS 0 1 40 0 0 1 /end COMPU_METHOD
/begin COMPU_METHOD q1_om600_A "" RAT_FUNC "%6.1" "A" COEFFS 0 1 600 0 0 1 /end COMPU_METHOD
/begin COMPU_METHOD RBPtCel_r_0p00001_1 "" RAT_FUNC "%8.7" "Ohm" COEFFS 0 100000 0 0 0 1 /end COMPU_METHOD
/begin COMPU_METHOD RBPtCel_ti_1p0_4 "" RAT_FUNC "%6.2" "min" COEFFS 0 1 0 0 0 1 /end COMPU_METHOD
/begin COMPU_METHOD RBPtCel_ti_1p0_6 "" RAT_FUNC "%6.2" "h" COEFFS 0 1 0 0 0 1 /end COMPU_METHOD
/begin COMPU_METHOD rel_q0p01 "" RAT_FUNC "%6.4" "%" COEFFS 0 100 0 0 0 1 /end COMPU_METHOD
/begin COMPU_METHOD rel_q0p0234 "" RAT_FUNC "%6.4" "%" COEFFS 0 128 0 0 0 3 /end COMPU_METHOD
/begin COMPU_METHOD rel_ub_b127p5 "" RAT_FUNC "%6.3" "%" COEFFS 0 2 0 0 0 1 /end COMPU_METHOD
/begin COMPU_METHOD rel_ub_b99p6 "" RAT_FUNC "%6.3" "%" COEFFS 0 256 0 0 0 100 /end COMPU_METHOD
/begin COMPU_METHOD rel_ub_q0p1875 "" RAT_FUNC "%6.3" "KW/ms" COEFFS 0 256 0 0 0 48 /end COMPU_METHOD
/begin COMPU_METHOD RmpVoltBatt "" RAT_FUNC "%6.3" "mV/s" COEFFS 0 3.2768 0 0 0 1 /end COMPU_METHOD
/begin COMPU_METHOD SCR_TEMP_CELS_float "" RAT_FUNC "%6.2" "deg C" COEFFS 0 1 0 0 0 1 /end COMPU_METHOD
/begin COMPU_METHOD Slope "" RAT_FUNC "%10.9" "" COEFFS 0 10000000 0 0 0 1 /end COMPU_METHOD
/begin COMPU_METHOD spg_q0p00039 "" RAT_FUNC "%6.5" "V" COEFFS 0 1 0 0 0 0.000390625 /end COMPU_METHOD
/begin COMPU_METHOD spg_q0p1 "" RAT_FUNC "%6.3" "V" COEFFS 0 1 0 0 0 0.1 /end COMPU_METHOD
/begin COMPU_METHOD spg_q0p2 "" RAT_FUNC "%6.3" "V" COEFFS 0 5 0 0 0 1 /end COMPU_METHOD
/begin COMPU_METHOD spg_q0p78125Em3 "" RAT_FUNC "%6.5" "V" COEFFS 0 65536 0 0 0 51.2 /end COMPU_METHOD
/begin COMPU_METHOD spg_ubatt "" RAT_FUNC "%6.3" "V" COEFFS 0 10.6157112526539 0 0 0 1 /end COMPU_METHOD
/begin COMPU_METHOD spg_uw_q0p023481 "" RAT_FUNC "%6.4" "V" COEFFS 0 1 0 0 0 0.023481 /end COMPU_METHOD
/begin COMPU_METHOD Temp_Cels "" RAT_FUNC "%6.1" "deg C" COEFFS 0 10 2731.4 0 0 1 /end COMPU_METHOD
/begin COMPU_METHOD temp_ub_q0p75_o48 "" RAT_FUNC "%6.2" "Grad C" COEFFS 0 1 48 0 0 0.75 /end COMPU_METHOD
/begin COMPU_METHOD Time_Hr "" RAT_FUNC "%6.3" "h" COEFFS 0 2 0 0 0 1 /end COMPU_METHOD
/begin COMPU_METHOD Time_ms "" RAT_FUNC "%6.1" "ms" COEFFS 0 0.1 0 0 0 1 /end COMPU_METHOD
/begin COMPU_METHOD Time_s "" RAT_FUNC "%6.4" "s" COEFFS 0 100 0 0 0 1 /end COMPU_METHOD
/begin COMPU_METHOD TransR "" RAT_FUNC "%6.4" "-" COEFFS 0 100 0 0 0 1 /end COMPU_METHOD
/begin COMPU_METHOD Trq "" RAT_FUNC "%6.3" "Nm" COEFFS 0 10 0 0 0 1 /end COMPU_METHOD
/begin COMPU_METHOD t_q0p01 "" RAT_FUNC "%6.4" "s" COEFFS 0 100 0 0 0 1 /end COMPU_METHOD
/begin COMPU_METHOD t_q0p1 "" RAT_FUNC "%6.3" "s" COEFFS 0 10 0 0 0 1 /end COMPU_METHOD
/begin COMPU_METHOD t_q1_ms "" RAT_FUNC "%6.2" "ms" COEFFS 0 1 0 0 0 1 /end COMPU_METHOD
/begin COMPU_METHOD u_Batt_V_q0p00097656 "" RAT_FUNC "%6.5" "V" COEFFS 0 1024 0 0 0 1 /end COMPU_METHOD
/begin COMPU_METHOD U_mV_q0p9765625_COMPU "" RAT_FUNC "%6.2" "mV" COEFFS 0 1.024 0 0 0 1 /end COMPU_METHOD
/begin COMPU_METHOD Vel "" RAT_FUNC "%6.4" "km/h" COEFFS 0 100 0 0 0 1 /end COMPU_METHOD
/begin COMPU_METHOD vel_q0p01 "" RAT_FUNC "%6.4" "km/h" COEFFS 0 100 0 0 0 1 /end COMPU_METHOD
/begin COMPU_METHOD VLVLFT_FBSWT_VERB "" TAB_VERB "%6.3" "" COMPU_TAB_REF VLVLFT_FBSWT_VERB /end COMPU_METHOD
/begin COMPU_VTAB VLVLFT_FBSWT_VERB "" TAB_VERB 2 0 "VLVLFT_FBSWT_LOWCAM" 1 "VLVLFT_FBSWT_HIGHCAM" /end COMPU_VTAB
/begin COMPU_METHOD VLVLFT_SIGACTR_VERB "" TAB_VERB "%6.3" "" COMPU_TAB_REF VLVLFT_SIGACTR_VERB /end COMPU_METHOD
/begin COMPU_VTAB VLVLFT_SIGACTR_VERB "" TAB_VERB 2 0 "VLVLFT_SIGACTR_LOWCAM" 1 "VLVLFT_SIGACTR_HIGHCAM" /end COMPU_VTAB
/begin COMPU_METHOD Volt "" RAT_FUNC "%6.3" "mV" COEFFS 0 5 0 0 0 1 /end COMPU_METHOD
/begin COMPU_METHOD Volt_Batt "" RAT_FUNC "%6.1" "mV" COEFFS 0 0.05 0 0 0 1 /end COMPU_METHOD
/begin RECORD_LAYOUT RB_Axis_S16 NO_AXIS_PTS_X 1 SWORD AXIS_PTS_X 2 SWORD INDEX_INCR DIRECT /end RECORD_LAYOUT
/begin RECORD_LAYOUT RB_Axis_S8 NO_AXIS_PTS_X 1 SBYTE AXIS_PTS_X 2 SBYTE INDEX_INCR DIRECT /end RECORD_LAYOUT
/begin RECORD_LAYOUT RB_CurveGroup_U8 FNC_VALUES 1 UBYTE COLUMN_DIR DIRECT /end RECORD_LAYOUT
/begin RECORD_LAYOUT RB_Curve_S16_S16 NO_AXIS_PTS_X 1 SWORD AXIS_PTS_X 2 SWORD INDEX_INCR DIRECT FNC_VALUES 3 SWORD COLUMN_DIR DIRECT /end RECORD_LAYOUT
/begin RECORD_LAYOUT RB_Curve_U8_U8 NO_AXIS_PTS_X 1 UBYTE AXIS_PTS_X 2 UBYTE INDEX_INCR DIRECT FNC_VALUES 3 UBYTE COLUMN_DIR DIRECT /end RECORD_LAYOUT
/begin RECORD_LAYOUT RB_MapGroup_S16 FNC_VALUES 1 SWORD COLUMN_DIR DIRECT /end RECORD_LAYOUT
/begin RECORD_LAYOUT RB_MapGroup_U8 FNC_VALUES 1 UBYTE COLUMN_DIR DIRECT /end RECORD_LAYOUT
/begin RECORD_LAYOUT RB_Map_S16S16_S16 NO_AXIS_PTS_X 1 SWORD NO_AXIS_PTS_Y 2 SWORD AXIS_PTS_X 3 SWORD INDEX_INCR DIRECT AXIS_PTS_Y 4 SWORD INDEX_INCR DIRECT FNC_VALUES 5 SWORD COLUMN_DIR DIRECT /end RECORD_LAYOUT
/begin RECORD_LAYOUT RB_Map_S16U16_U16 NO_AXIS_PTS_X 1 SWORD NO_AXIS_PTS_Y 2 SWORD AXIS_PTS_X 3 SWORD INDEX_INCR DIRECT AXIS_PTS_Y 4 UWORD INDEX_INCR DIRECT FNC_VALUES 5 UWORD ROW_DIR DIRECT /end RECORD_LAYOUT
/begin RECORD_LAYOUT RB_Map_U8U8_U8 NO_AXIS_PTS_X 1 UBYTE NO_AXIS_PTS_Y 2 UBYTE AXIS_PTS_X 3 UBYTE INDEX_INCR DIRECT AXIS_PTS_Y 4 UBYTE INDEX_INCR DIRECT FNC_VALUES 5 UBYTE COLUMN_DIR DIRECT /end RECORD_LAYOUT
/begin RECORD_LAYOUT RB_ValA_Wu8 FNC_VALUES 1 UBYTE COLUMN_DIR DIRECT /end RECORD_LAYOUT
/begin RECORD_LAYOUT RB_Val_Wboolean FNC_VALUES 1 UBYTE COLUMN_DIR DIRECT /end RECORD_LAYOUT
/begin RECORD_LAYOUT RB_Val_Ws16 FNC_VALUES 1 SWORD COLUMN_DIR DIRECT /end RECORD_LAYOUT
/begin RECORD_LAYOUT RB_Val_Ws32 FNC_VALUES 1 SLONG COLUMN_DIR DIRECT /end RECORD_LAYOUT
/begin RECORD_LAYOUT RB_Val_Wu16 FNC_VALUES 1 UWORD COLUMN_DIR DIRECT /end RECORD_LAYOUT
/begin RECORD_LAYOUT RB_Val_Wu8 FNC_VALUES 1 UBYTE COLUMN_DIR DIRECT /end RECORD_LAYOUT
/begin RECORD_LAYOUT Val_Ws16 FNC_VALUES 1 SWORD COLUMN_DIR DIRECT /end RECORD_LAYOUT
/begin RECORD_LAYOUT Val_Ws32 FNC_VALUES 1 SLONG COLUMN_DIR DIRECT /end RECORD_LAYOUT
/begin RECORD_LAYOUT Val_Wu16 FNC_VALUES 1 UWORD COLUMN_DIR DIRECT /end RECORD_LAYOUT
/begin RECORD_LAYOUT Val_Wu8 FNC_VALUES 1 UBYTE COLUMN_DIR DIRECT /end RECORD_LAYOUT
/end MODULE
/end PROJECT
