ASAP2_VERSION 1 60
/begin PROJECT MG1CA020 "MG1CA020"
/begin HEADER "" VERSION "MG1CA020_6SAY_V011_TPROT" PROJECT_NO MG1CA020 /end HEADER
/begin MODULE DIM ""
/begin MOD_COMMON "" BYTE_ORDER MSB_LAST ALIGNMENT_BYTE 1 ALIGNMENT_WORD 2 ALIGNMENT_LONG 4 ALIGNMENT_INT64 4 ALIGNMENT_FLOAT32_IEEE 4 ALIGNMENT_FLOAT64_IEEE 4 DATA_SIZE 32 /end MOD_COMMON
/begin CHARACTERISTIC Com_dPCUMaxDiff_C "Application constant for Maximum difference for PCU frame" VALUE 0x80533284 RB_Val_Wu8 255.0 OneToOne 0.00 255.0 FORMAT "%5.1" /end CHARACTERISTIC
/begin CHARACTERISTIC Com_dPCUMaxPer_C "Threshold for detection of stopped message counter for CAN frame PCU" VALUE 0x80533285 RB_Val_Wu8 255.0 OneToOne 0.00 255.0 FORMAT "%5.1" /end CHARACTERISTIC
/begin CHARACTERISTIC Com_stPCUEngStrtInhb_C "Default value for the status of engine start inhibition flag" VALUE 0x80533286 RB_Val_Wu8 1.000 OneToOne 0.00 1.000 FORMAT "%5.3" EXTENDED_LIMITS 0.00 255.0 /end CHARACTERISTIC
/begin CHARACTERISTIC CoPT_flgFcoInhbEna_C "calibration to enable the Powertrain inhibits fuel cut-off" VALUE 0x805332F8 RB_Val_Wu8 255.0 OneToOne 0.00 255.0 FORMAT "%5.1" /end CHARACTERISTIC
/begin CHARACTERISTIC CoPT_flgFuCutOffActvEna_C "calibration to enable the Fuel Cut Off active" VALUE 0x805332F9 RB_Val_Wu8 255.0 OneToOne 0.00 255.0 FORMAT "%5.1" /end CHARACTERISTIC
/begin CHARACTERISTIC CoPT_nMinSysErrLim_C "Limit value for minimum speed in case of system errors" VALUE 0x8053342E RB_Val_Ws16 32767.50 EngN -16384.00 16383.50 FORMAT "%8.2" /end CHARACTERISTIC
/begin CHARACTERISTIC Eep_ClrWrCounter_CW "Codeword to clear write counters" VALUE 0x804D828E Val_Wu8 255.0 OneToOne 0.00 255.0 FORMAT "%5.1" /end CHARACTERISTIC
/begin CHARACTERISTIC Eep_EnFirstInit_CW "Codeword to start a first initialization in EEP" VALUE 0x804D828D Val_Wu8 255.0 OneToOne 0.00 255.0 FORMAT "%5.1" /end CHARACTERISTIC
/begin CHARACTERISTIC Eep_EnvRamClr_CW "Codeword to clear contents of ENVRAM" VALUE 0x804D828C Val_Wu8 255.0 OneToOne 0.00 255.0 FORMAT "%5.1" /end CHARACTERISTIC
/begin CHARACTERISTIC OilSwmpT_facEngOffTiCoolgCoeff_T "Factor calculated based on engine off time to calculate initial oil temperature." CURVE 0x80532FBA RB_Curve_U16_U16 0.9999847 fak_uw_b1 0.00 0.9999847 FORMAT "%9.7"
 /begin AXIS_DESCR STD_AXIS OilSwmpT_tiEngOffTi t_q10 10 0.00 327670.0 FORMAT "%8.1" EXTENDED_LIMITS 0.00 655350.0 DEPOSIT ABSOLUTE /end AXIS_DESCR
/end CHARACTERISTIC
/begin CHARACTERISTIC OilSwmpT_facEngSpdCoeff_T "heat release coefficient based on engine speed to calculate model value for oil temperature." CURVE 0x80532FE4 RB_Curve_S16_S16 0.9999695 fak_q3p0518Em5 0.00 0.9999695 FORMAT "%9.7" EXTENDED_LIMITS -1.000000 0.9999695
 /begin AXIS_DESCR STD_AXIS Epm_nEng EngN 11 -16384.00 16383.50 FORMAT "%8.2" DEPOSIT ABSOLUTE /end AXIS_DESCR
/end CHARACTERISTIC
/begin CHARACTERISTIC OilSwmpT_facVehSpdCoeff_T "heat release coefficient based on vehicle speed to calculate model value for oil temperature." CURVE 0x80533012 RB_Curve_S16_S16 0.9999695 fak_q3p0518Em5 0.00 0.9999695 FORMAT "%9.7" EXTENDED_LIMITS -1.000000 0.9999695
 /begin AXIS_DESCR STD_AXIS VehV_v Vel 12 -327.6800 327.6700 FORMAT "%8.4" DEPOSIT ABSOLUTE /end AXIS_DESCR
/end CHARACTERISTIC
/begin CHARACTERISTIC OilSwmpT_swtMdl2Cfg_C "Calibration switch to select calculation method for second oil-temperature model" VALUE 0x80533044 RB_Val_Wu8 1.000 OneToOne 0.00 1.000 FORMAT "%5.3" EXTENDED_LIMITS 0.00 255.0 /end CHARACTERISTIC
/begin CHARACTERISTIC OilSwmpT_tAFSTBlkHeatrDetn_C "Calibration parameter to detect whether block heater is present or not." VALUE 0x80533046 RB_Val_Ws16 6553.500 Temp_Cels -3549.940 3003.560 FORMAT "%8.3" /end CHARACTERISTIC
/begin CHARACTERISTIC OilSwmpT_tBlkHeatrCoeff_C "Block heater coefficient Calibration parameter to detect engine off time duration" VALUE 0x80533048 RB_Val_Ws16 6553.500 Temp_Cels -3549.940 3003.560 FORMAT "%8.3" /end CHARACTERISTIC
/begin CHARACTERISTIC OilSwmpT_tCEngDsTBlkHeatrDetn_T "curve based on intake air temperature inorder to compare with engine coolant temperature for block heater detection." CURVE 0x8053304A RB_Curve_S16_S16 6553.500 Temp_Cels -3549.940 3003.560 FORMAT "%8.3"
 /begin AXIS_DESCR STD_AXIS OilSwmpt_tIntkSnsr Temp_Cels 3 -3549.940 3003.560 FORMAT "%8.3" DEPOSIT ABSOLUTE /end AXIS_DESCR
/end CHARACTERISTIC
/begin CHARACTERISTIC OilSwmpT_tHeatCoeff_M "Heat coefficient based on engine speed and intake air mass(Map)" MAP 0x80533058 RB_Map_S16S16_U16 0.9999847 RBPtCel_t_1p52588em5_1 0.00 0.9999847 FORMAT "%9.7"
 /begin AXIS_DESCR STD_AXIS Epm_nEng EngN 11 -16384.00 16383.50 FORMAT "%8.2" DEPOSIT ABSOLUTE /end AXIS_DESCR
 /begin AXIS_DESCR STD_AXIS OilLfT_mAirPerCyl AirMassPerCyl 20 -3276.800 3276.700 FORMAT "%8.3" DEPOSIT ABSOLUTE /end AXIS_DESCR
/end CHARACTERISTIC
/begin CHARACTERISTIC OilSwmpT_tiEngOffDurn_C "calibration parameter to detect egine off time is long or not." VALUE 0x80533252 RB_Val_Wu16 327670.0 t_q10 0.00 327670.0 FORMAT "%8.1" EXTENDED_LIMITS 0.00 655350.0 /end CHARACTERISTIC
/begin CHARACTERISTIC OilSwmpT_tiEngOff_T "curve to calculate engine off time based on engine coolant temperature" CURVE 0x80533254 RB_Curve_U16_U16 327670.0 t_q10 0.00 327670.0 FORMAT "%8.1" EXTENDED_LIMITS 0.00 655350.0
 /begin AXIS_DESCR STD_AXIS OilSwmpT_facEngOffTiCoeff fak_uw_b1 10 0.00 0.9999847 FORMAT "%9.7" DEPOSIT ABSOLUTE /end AXIS_DESCR
/end CHARACTERISTIC
/begin CHARACTERISTIC OilSwmpt_tIntkSnsrSeln_C "calibration parameter to select intake air temperatures." VALUE 0x8053327E RB_Val_Wu8 255.0 OneToOne 0.00 255.0 FORMAT "%5.1" /end CHARACTERISTIC
/begin CHARACTERISTIC OilSwmpT_tSafeValMtrDisp_C "Alternative values during failure mode for Meter display" VALUE 0x80533280 RB_Val_Ws16 6553.500 Temp_Cels -3549.940 3003.560 FORMAT "%8.3" /end CHARACTERISTIC
/begin CHARACTERISTIC OilSwmpt_tSafeVal_C "Safe calibration value in case of sensor errors." VALUE 0x80533282 RB_Val_Ws16 6553.500 Temp_Cels -3549.940 3003.560 FORMAT "%8.3" /end CHARACTERISTIC
/begin CHARACTERISTIC PhyMod_CalorificValueGS_C "Constant for calorific value of fuel (gasoline) with units MJKG" VALUE 0x805336FA RB_Val_Ws16 6553.500 EnrgPerMass -3276.800 3276.700 FORMAT "%8.3" /end CHARACTERISTIC
/begin CHARACTERISTIC PhyMod_cpHeatExh_C "Specific heat capacity of the exhaust gas" VALUE 0x805336FC RB_Val_Ws16 655350.0 Thr_Cpty_ExhGs -327680.0 327670.0 FORMAT "%8.1" /end CHARACTERISTIC
/begin CHARACTERISTIC PhyMod_facClntTrq_C "factor engine coolant entry - combustion" VALUE 0x805336FE RB_Val_Wu8 1.992188 fak_ub_b2 0.00 1.992188 FORMAT "%8.6" /end CHARACTERISTIC
/begin CHARACTERISTIC PhyMod_jCmbEng_C "Moment of inertia of the combustion engine" VALUE 0x80533700 RB_Val_Wu16 9.999847 j_q0p000153 0.00 9.999847 FORMAT "%8.6" /end CHARACTERISTIC
/begin CHARACTERISTIC PhyMod_tiDerEngFil_CUR "Filtering time constant for the engine speed used in calculation of moment of inertia" CURVE 0x80533702 RB_Curve_S16_S16 10.00015 TimeDelay_s_Lin_16 -5.000153 5.000000 FORMAT "%8.6"
 /begin AXIS_DESCR STD_AXIS PhyMod_dnEngDerUnFild nmotgrd_q2 7 -65536.00 65534.00 FORMAT "%8.2" DEPOSIT ABSOLUTE /end AXIS_DESCR
/end CHARACTERISTIC
/begin CHARACTERISTIC PID51_stFuTyp_C "coding of fuel type without consideration of vehicle configuration" VALUE 0x80533288 RB_Val_Wu8 255.0 OneToOne 0.00 255.0 FORMAT "%5.1" /end CHARACTERISTIC
/begin CHARACTERISTIC PID51_swtVehTyp_C "configurationsswitch of vehicle type" VALUE 0x80533289 RB_Val_Wu8 255.0 OneToOne 0.00 255.0 FORMAT "%5.1" /end CHARACTERISTIC
/begin CHARACTERISTIC PIDA6_lDstLim_C "Traveled distance, after which value will be written into EEPROM" VALUE 0x8053328C RB_Val_Ws32 429496729.500 RBPtCel_dst_0p1_2 -214748364.800 214748364.700 FORMAT "%13.3" /end CHARACTERISTIC
/begin CHARACTERISTIC PIntkVUs_facCnvnSlopAdc_C "Convertion factor for raw value to physical value convertion for ADC sensor" VALUE 0x80533290 RB_Val_Wu16 1638.375 q0p025_hPa_DIV_V 0.00 1638.375 FORMAT "%8.3" /end CHARACTERISTIC
/begin CHARACTERISTIC PIntkVUs_nEngThresPresRawIni_C "engine threshold for raw pressure calculation during initialization" VALUE 0x80533292 RB_Val_Ws16 32767.50 EngN -16384.00 16383.50 FORMAT "%8.2" /end CHARACTERISTIC
/begin CHARACTERISTIC PIntkVUs_nThresSync_C "threshold to switch between time- and segment-synchronous calculation" VALUE 0x80533294 RB_Val_Ws16 32767.50 EngN -16384.00 16383.50 FORMAT "%8.2" /end CHARACTERISTIC
/begin CHARACTERISTIC PIntkVUs_pADCVltgTrfPresOfs_C "offset pressure for curve ADC voltage to pressure transformation" VALUE 0x80533296 RB_Val_Ws16 5119.922 p_q0p078 -2560.000 2559.922 FORMAT "%8.3" /end CHARACTERISTIC
/begin CHARACTERISTIC PIntkVUs_stCfg_C "Codeword for configuration of manifold pressure function" VALUE 0x80533298 RB_Val_Wu8 255.0 OneToOne 0.00 255.0 FORMAT "%5.1" /end CHARACTERISTIC
/begin CHARACTERISTIC PIntkVUs_tiPt1VltgSegBasdTi_T "Segment time dependent time constant for PT1 filter, voltage curve" CURVE 0x8053329A RB_Curve_S16_S16 32.76700 Time_s_1 0.00 32.76700 FORMAT "%8.5" EXTENDED_LIMITS -32.76800 32.76700
 /begin AXIS_DESCR STD_AXIS PIntkVUs_tiSegADCData Time_s_1 16 -32.76800 32.76700 FORMAT "%8.5" DEPOSIT ABSOLUTE /end AXIS_DESCR
/end CHARACTERISTIC
/begin CHARACTERISTIC PIntkVUs_uThresMax_C "maximum voltage threshold for electrical diagnosis" VALUE 0x805332DC RB_Val_Wu16 4.999665 Volt_q0p00007629 0.00 4.999665 FORMAT "%8.6" /end CHARACTERISTIC
/begin CHARACTERISTIC PIntkVUs_uThresMin_C "minimum voltage threshold for electrical diagnosis" VALUE 0x805332DE RB_Val_Wu16 4.999665 Volt_q0p00007629 0.00 4.999665 FORMAT "%8.6" /end CHARACTERISTIC
/begin CHARACTERISTIC PSPCtlG_CodWd "Code word to activate Cyclic activation of fuel tank low pressure pump during StartStop" VALUE 0x805332E0 RB_Val_Wu8 255.0 dez 0.00 255.0 FORMAT "%5.1" /end CHARACTERISTIC
/begin CHARACTERISTIC PSPCtl_ctEngStopPSPOnOff_C "maximum number of preruns of EKP during stop-phase" VALUE 0x805332E1 RB_Val_Wu8 255.0 dez 0.00 255.0 FORMAT "%5.1" /end CHARACTERISTIC
/begin CHARACTERISTIC PSPCtl_ctPreRunDrvMax_C "max. number of PSP pre-runs without reaching end of start" VALUE 0x805332E2 RB_Val_Wu8 255.0 OneToOne 0.00 255.0 FORMAT "%5.1" /end CHARACTERISTIC
/begin CHARACTERISTIC PSPCtl_ctPreRunPreDrvMax_C "max. number of PSP pre-runs in ecu predrive state" VALUE 0x805332E3 RB_Val_Wu8 255.0 OneToOne 0.00 255.0 FORMAT "%5.1" /end CHARACTERISTIC
/begin CHARACTERISTIC PSPCtl_cwPSPCtl_CW "codeword of function PSPCtl_Co" VALUE 0x805332E4 RB_Val_Wu8 255.0 OneToOne 0.00 255.0 FORMAT "%5.1" /end CHARACTERISTIC
/begin CHARACTERISTIC PSPCtl_tiEngOffPreRun_C "threshold soak time for enabling PSP-pre-run" VALUE 0x805332E6 RB_Val_Wu16 65535.00 t_q1 0.00 65535.00 FORMAT "%8.2" /end CHARACTERISTIC
/begin CHARACTERISTIC PSPCtl_tiEngStalDly_C "Prolongation time of fuel pump activity after engine stall" VALUE 0x805332E8 RB_Val_Wu16 655.3500 t_q0p01 0.00 655.3500 FORMAT "%8.4" /end CHARACTERISTIC
/begin CHARACTERISTIC PSPCtl_tiEngStopPSPOff_C "time PSP switched OFF during engine stop phase" VALUE 0x805332EA RB_Val_Wu16 655.3500 t_q0p01 0.00 655.3500 FORMAT "%8.4" /end CHARACTERISTIC
/begin CHARACTERISTIC PSPCtl_tiEngStopPSPOn_C "time PSP switched ON during engine stop phase" VALUE 0x805332EC RB_Val_Wu16 655.3500 t_q0p01 0.00 655.3500 FORMAT "%8.4" /end CHARACTERISTIC
/begin CHARACTERISTIC PSPCtl_tiPreRunDrv_C "max. time for PSP pre-run during ECU-Drive state" VALUE 0x805332EE RB_Val_Wu16 655.3500 t_q0p01 0.00 655.3500 FORMAT "%8.4" /end CHARACTERISTIC
/begin CHARACTERISTIC PSPCtl_tiPreRunPreDrv_C "max. time for PSP pre-run during ECU-PreDrive state" VALUE 0x805332F0 RB_Val_Wu16 655.3500 t_q0p01 0.00 655.3500 FORMAT "%8.4" /end CHARACTERISTIC
/begin CHARACTERISTIC PSPCtl_tiStrtDem_C "Time for fast fuel pump activation during start" VALUE 0x805332F2 RB_Val_Wu8 2.550 t_q0p01 0.00 2.550 FORMAT "%5.3" /end CHARACTERISTIC
/begin CHARACTERISTIC PSPDig_ATS.LimitTypeMsk_C "Actuator test PSPDig_ATS / Tester demand monitoring enable mask for actuators" VALUE 0x8053A650 Val_Wu8 255.0 OneToOne 0.00 255.0 FORMAT "%5.1" /end CHARACTERISTIC
/begin CHARACTERISTIC PSPDig_ATS.CnvNorm_C "Actuator test PSPDig_ATS / Conversion norm used for conversion to/from internal scaling" VALUE 0x8053A651 Val_Wu8 255.0 OneToOne 0.00 255.0 FORMAT "%5.1" /end CHARACTERISTIC
/begin CHARACTERISTIC PSPDig_ATS.LowLim_C "Actuator test PSPDig_ATS / Lower limit for monitoring" VALUE 0x8053A652 Val_Ws16 65535.00 OneToOne -32768.00 32767.00 FORMAT "%8.2" /end CHARACTERISTIC
/begin CHARACTERISTIC PSPDig_ATS.UpLim_C "Actuator test PSPDig_ATS / Upper limit for monitoring" VALUE 0x8053A654 Val_Ws16 65535.00 OneToOne -32768.00 32767.00 FORMAT "%8.2" /end CHARACTERISTIC
/begin CHARACTERISTIC PSPDig_ATS.CnvFac_C "Actuator test PSPDig_ATS / Factor used for conversion to/from internal scaling" VALUE 0x8053A658 Val_Ws32 4294967295.00 OneToOne -2147483648.00 2147483647.00 FORMAT "%13.2" /end CHARACTERISTIC
/begin CHARACTERISTIC PSPDig_ATS.CnvOfs_C "Actuator test PSPDig_ATS / Offset used for conversion to/from internal scaling" VALUE 0x8053A65C Val_Ws16 65535.00 OneToOne -32768.00 32767.00 FORMAT "%8.2" /end CHARACTERISTIC
/begin CHARACTERISTIC PSPDig_ATS.DfltVal_C "Actuator test PSPDig_ATS / Default value for standbytest" VALUE 0x8053A65E Val_Ws16 65535.00 OneToOne -32768.00 32767.00 FORMAT "%8.2" /end CHARACTERISTIC
/begin CHARACTERISTIC PSP_DigOutp.tiBtwTstSCB_C "Structure containing parameters for digital output power stage error handling for pre-supply pump / Time between tests for SCB error" VALUE 0x8053B162 Kw_Ws16 655350.0 Time_ms -327680.0 327670.0 FORMAT "%8.1" /end CHARACTERISTIC
/begin CHARACTERISTIC PSP_DigOutp.tiBtwTstOT_C "Structure containing parameters for digital output power stage error handling for pre-supply pump / Time between tests for OT error" VALUE 0x8053B164 Kw_Ws16 655.3500 Time_s -327.6800 327.6700 FORMAT "%8.4" /end CHARACTERISTIC
/begin CHARACTERISTIC PSP_DigOutp.numTstMax_C "Structure containing parameters for digital output power stage error handling for pre-supply pump / Maximum number of tests allowed on permanent defect" VALUE 0x8053B166 Kw_Wu16 65535.00 OneToOne 0.00 65535.00 FORMAT "%8.2" /end CHARACTERISTIC
/begin CHARACTERISTIC PSP_stPsDiaDisbl_C "switch for disabling the diagnosis of the pre supply pump powerstage" VALUE 0x805332F4 RB_Val_Wu16 65535.00 OneToOne 0.00 65535.00 FORMAT "%8.2" /end CHARACTERISTIC
/begin CHARACTERISTIC PSP_stPsDisbl_C "switch for disabling the pre supply pump powerstage" VALUE 0x805332F6 RB_Val_Wu16 65535.00 OneToOne 0.00 65535.00 FORMAT "%8.2" /end CHARACTERISTIC
/begin CHARACTERISTIC PT2ME_CW "CW for PT2ME" VALUE 0x805332FA RB_Val_Wu8 255.0 dez 0.00 255.0 FORMAT "%5.1" /end CHARACTERISTIC
/begin CHARACTERISTIC PT2ME_numGearAsgn_T "Curve to interpolate the current and the desired gear" CURVE 0x805332FC RB_Curve_S8_U8_Static 255.0 dez 0.00 255.0 FORMAT "%5.1"
 /begin AXIS_DESCR STD_AXIS NO_INPUT_QUANTITY dez 12 -128.0 127.0 FORMAT "%5.1" DEPOSIT ABSOLUTE /end AXIS_DESCR
/end CHARACTERISTIC
/begin CHARACTERISTIC PT2ME_tiThresAftEngSt_C "adapter parameter time threshold after engine start for evaluation of drive position B_fs" VALUE 0x80533316 RB_Val_Wu16 655.3500 t10msxs_uw_b655p35 0.00 655.3500 FORMAT "%8.4" /end CHARACTERISTIC
/begin CHARACTERISTIC PtCoornDyn_dtqIntvMinSpdCtrlNegSlop_C "Negative slope for ramping minimum limits when a decreasing intervention should be overwritten by the speed control demand." VALUE 0x80533720 RB_Val_Ws32 6553599.99847 RmpTrq -3276800.00000 3276799.99847 FORMAT "%13.5" /end CHARACTERISTIC
/begin CHARACTERISTIC PtCoornDyn_dtqIntvMinSpdCtrlPosSlop_C "Positive slope for ramping minimum limits when a decreasing intervention should be overwritten by the speed control demand." VALUE 0x80533724 RB_Val_Ws32 6553599.99847 RmpTrq -3276800.00000 3276799.99847 FORMAT "%13.5" /end CHARACTERISTIC
/begin CHARACTERISTIC PtCoornDyn_dTqRampLeadStabyIntvDecNeg_C "Negative ramp slope for decreasing stability intervention torque on lead path at clutch level" VALUE 0x8053372C RB_Val_Ws32 6553599.99847 RmpTrq -3276800.00000 3276799.99847 FORMAT "%13.5" /end CHARACTERISTIC
/begin CHARACTERISTIC PtCoornDyn_dTqRampLeadStabyIntvDecPos_C "Positive ramp slope for decreasing stability intervention torque on lead path at clutch level" VALUE 0x80533730 RB_Val_Ws32 6553599.99847 RmpTrq -3276800.00000 3276799.99847 FORMAT "%13.5" /end CHARACTERISTIC
/begin CHARACTERISTIC PtCoornDyn_dTqRampLeadTrsmIntvDecNeg_C "Negative ramp slope for decreasing transmission intervention torque on lead path at clutch level" VALUE 0x80533734 RB_Val_Ws32 6553599.99847 RmpTrq -3276800.00000 3276799.99847 FORMAT "%13.5" /end CHARACTERISTIC
/begin CHARACTERISTIC PtCoornDyn_dTqRampLeadTrsmIntvDecPos_C "Positive ramp slope for decreasing transmission intervention torque on lead path at clutch level" VALUE 0x80533738 RB_Val_Ws32 6553599.99847 RmpTrq -3276800.00000 3276799.99847 FORMAT "%13.5" /end CHARACTERISTIC
/begin CHARACTERISTIC PtCoornDyn_nIdleSpdDelta_C "Parameter to vary idle speed condition in hysteresis to avoid toggling" VALUE 0x80533728 RB_Val_Ws16 32767.50 nmot_sw_q0p5 -16384.00 16383.50 FORMAT "%8.2" /end CHARACTERISTIC
/begin CHARACTERISTIC PtCoornDyn_nIdleSpdOffst_C "Parameter to vary idle speed offset in hysteresis" VALUE 0x8053372A RB_Val_Ws16 32767.50 nmot_sw_q0p5 -16384.00 16383.50 FORMAT "%8.2" /end CHARACTERISTIC
/begin CHARACTERISTIC PtCoornDyn_tiDlyLeadStabyIntvDec_C "Delay time to discard decreasing stability intervention on lead path" VALUE 0x8053373C RB_Val_Ws32 4294967.29500 Time_ms_DT -2147483.64800 2147483.64700 FORMAT "%13.5" /end CHARACTERISTIC
/begin CHARACTERISTIC PtCoornDyn_tiDlyLeadTrsmIntvDec_C "Delay time to discard decreasing transmission intervention on lead path" VALUE 0x80533740 RB_Val_Ws32 4294967.29500 Time_ms_DT -2147483.64800 2147483.64700 FORMAT "%13.5" /end CHARACTERISTIC
/begin CHARACTERISTIC PTDist_flgIaRelsLeadFil_C "Flag to enable ignition angle release due to dynamic torque requirements and ignition angle release with ramping, when the Demand for torque filtering in lead path is active." VALUE 0x8053331A RB_Val_Wu8 1.00000000000 B_TRUE 0.00 1.00000000000 FORMAT "%13.11" /end CHARACTERISTIC
/begin CHARACTERISTIC PTDist_flgLADIaRels_C "Flag to enable the ignition angle release due to dynamic torque requirements and ignition angle release with ramping, when the Maximum torque for limitation by ASD reference filter is less than or equal to the Propulsion torque limited by stationary limi" VALUE 0x8053331B RB_Val_Wu8 1.00000000000 B_TRUE 0.00 1.00000000000 FORMAT "%13.11" /end CHARACTERISTIC
/begin CHARACTERISTIC PTDist_tqDiffIARlsNegACOffIdleHi_T "Dynamic Torque Difference for enabling Intervention Active(Firing ange adjustment) in case of Negative gradients and AC off with high threshold" CURVE 0x8053331C RB_Curve_S16_S16 6553.500 md_q0p1 -3276.800 3276.700 FORMAT "%8.3"
 /begin AXIS_DESCR STD_AXIS ActMod_trqClthWoDstC md_q0p1 5 -3276.800 3276.700 FORMAT "%8.3" DEPOSIT ABSOLUTE /end AXIS_DESCR
/end CHARACTERISTIC
/begin CHARACTERISTIC PTDist_tqDiffIARlsNegACOffIdleLo_T "Dynamic Torque Difference for enabling Intervention Active(Firing ange adjustment) in case of Negative gradients and AC off with low threshold" CURVE 0x80533332 RB_Curve_S16_S16 6553.500 md_q0p1 -3276.800 3276.700 FORMAT "%8.3"
 /begin AXIS_DESCR STD_AXIS ActMod_trqClthWoDstC md_q0p1 5 -3276.800 3276.700 FORMAT "%8.3" DEPOSIT ABSOLUTE /end AXIS_DESCR
/end CHARACTERISTIC
/begin CHARACTERISTIC PTDist_tqDiffIARlsNegACOnIdleHi_T "Dynamic Torque Difference for enabling Intervention Active(Firing ange adjustment) in case of Negative gradients and AC on with high threshold" CURVE 0x80533348 RB_Curve_S16_S16 6553.500 md_q0p1 -3276.800 3276.700 FORMAT "%8.3"
 /begin AXIS_DESCR STD_AXIS ActMod_trqClthWoDstC md_q0p1 5 -3276.800 3276.700 FORMAT "%8.3" DEPOSIT ABSOLUTE /end AXIS_DESCR
/end CHARACTERISTIC
/begin CHARACTERISTIC PTDist_tqDiffIARlsNegACOnIdleLo_T "Dynamic Torque Difference for enabling Intervention Active(Firing ange adjustment) in case of Negative gradients and AC on with low threshold" CURVE 0x8053335E RB_Curve_S16_S16 6553.500 md_q0p1 -3276.800 3276.700 FORMAT "%8.3"
 /begin AXIS_DESCR STD_AXIS ActMod_trqClthWoDstC md_q0p1 5 -3276.800 3276.700 FORMAT "%8.3" DEPOSIT ABSOLUTE /end AXIS_DESCR
/end CHARACTERISTIC
/begin CHARACTERISTIC PTDist_tqDiffIARlsNegACOnNonIdleHi_T "Dynamic Torque Difference for enabling Intervention Active(Firing ange adjustment) in case of Negative gradients and AC on none idle with high threshold" CURVE 0x80533374 RB_Curve_S16_S16 6553.500 md_q0p1 -3276.800 3276.700 FORMAT "%8.3"
 /begin AXIS_DESCR STD_AXIS ActMod_trqClthWoDstC md_q0p1 5 -3276.800 3276.700 FORMAT "%8.3" DEPOSIT ABSOLUTE /end AXIS_DESCR
/end CHARACTERISTIC
/begin CHARACTERISTIC PTDist_tqDiffIARlsNegACOnNonIdleLo_T "Dynamic Torque Difference for enabling Intervention Active(Firing ange adjustment) in case of Negative gradients and AC on none idle with low threshold" CURVE 0x8053338A RB_Curve_S16_S16 6553.500 md_q0p1 -3276.800 3276.700 FORMAT "%8.3"
 /begin AXIS_DESCR STD_AXIS ActMod_trqClthWoDstC md_q0p1 5 -3276.800 3276.700 FORMAT "%8.3" DEPOSIT ABSOLUTE /end AXIS_DESCR
/end CHARACTERISTIC
/begin CHARACTERISTIC PTDist_tqDiffIARlsPosACOnHi_T "Dynamic Torque Difference for enabling Intervention Active(Firing ange adjustment) in case of Positive gradients and AC on with high threshold" CURVE 0x805333A0 RB_Curve_S16_S16 6553.500 md_q0p1 -3276.800 3276.700 FORMAT "%8.3"
 /begin AXIS_DESCR STD_AXIS ActMod_trqClthWoDstC md_q0p1 5 -3276.800 3276.700 FORMAT "%8.3" DEPOSIT ABSOLUTE /end AXIS_DESCR
/end CHARACTERISTIC
/begin CHARACTERISTIC PTDist_tqDiffIARlsPosACOnLo_T "Dynamic Torque Difference for enabling Intervention Active(Firing ange adjustment) in case of Positive gradients and AC on with low threshold" CURVE 0x805333B6 RB_Curve_S16_S16 6553.500 md_q0p1 -3276.800 3276.700 FORMAT "%8.3"
 /begin AXIS_DESCR STD_AXIS ActMod_trqClthWoDstC md_q0p1 5 -3276.800 3276.700 FORMAT "%8.3" DEPOSIT ABSOLUTE /end AXIS_DESCR
/end CHARACTERISTIC
/begin CHARACTERISTIC PTDist_tqHiThdLADIaRels_C "Upper calibratable torque threshold above which if input torque goes(i.e. if Maximum torque for limitation by ASD reference filter is higher than the Propulsion torque limited by stationanry limits),the load alteration damper is not active." VALUE 0x805333CC RB_Val_Ws16 6553.500 Trq -3276.800 3276.700 FORMAT "%8.3" /end CHARACTERISTIC
/begin CHARACTERISTIC PTDist_tqHiThdLeadFilInactv_C "Upper calibratable torque threshold beyond which if input torque goes, ignition angle release due to dynamic torque requirements and ignition angle release with ramping is set , when the Demand for torque filtering in lead path is not active." VALUE 0x805333CE RB_Val_Ws16 3276.700 md_q0p1 0.00 3276.700 FORMAT "%8.3" EXTENDED_LIMITS -3276.800 3276.700 /end CHARACTERISTIC
/begin CHARACTERISTIC PTDist_tqICEMaxOffs_C "Maximum allowed Offset torque at the crankshaft level" VALUE 0x805333D0 RB_Val_Ws16 6553.500 Trq -3276.800 3276.700 FORMAT "%8.3" /end CHARACTERISTIC
/begin CHARACTERISTIC PTDist_tqLoThdLADIaRels_C "Lower calibratable torque threshold below which if input torque goes (i.e. if Maximum torque for limitation by ASD reference filter is equal to or lower than the Propulsion torque limited by stationanry limits) the load alteration damper is active." VALUE 0x805333D2 RB_Val_Ws16 6553.500 Trq -3276.800 3276.700 FORMAT "%8.3" /end CHARACTERISTIC
/begin CHARACTERISTIC PTDist_tqLoThdLeadFilInactv_C "Lower calibratable torque threshold below which if input torque goes , the ignition angle release due to dynamic torque requirements and ignition angle release with ramping is reset, when the Demand for torque filtering in lead path is not active." VALUE 0x805333D4 RB_Val_Ws16 6553.500 md_q0p1 -3276.800 3276.700 FORMAT "%8.3" /end CHARACTERISTIC
/begin CHARACTERISTIC PTDist_trqDiffDynIntvActvNeg_T "Dynamic Torque Difference for enabling Intervention Active (Firing angle adjustment) in case of Negative gradients" CURVE 0x805333D6 RB_Curve_S16_S16 3276.700 md_q0p1 0.00 3276.700 FORMAT "%8.3" EXTENDED_LIMITS -3276.800 3276.700
 /begin AXIS_DESCR STD_AXIS ActMod_trqClthWoDstC md_q0p1 5 -3276.800 3276.700 FORMAT "%8.3" DEPOSIT ABSOLUTE /end AXIS_DESCR
/end CHARACTERISTIC
/begin CHARACTERISTIC PTDist_trqDiffDynIntvActvPos_T "Dynamic Torque Difference for enabling Intervention Active (Firing angle adjustment) in case of Positive gradients" CURVE 0x805333EC RB_Curve_S16_S16 3276.700 md_q0p1 0.00 3276.700 FORMAT "%8.3" EXTENDED_LIMITS -3276.800 3276.700
 /begin AXIS_DESCR STD_AXIS ActMod_trqClthWoDstC md_q0p1 5 -3276.800 3276.700 FORMAT "%8.3" DEPOSIT ABSOLUTE /end AXIS_DESCR
/end CHARACTERISTIC
/begin CHARACTERISTIC PTDist_trqOfsDynActvNeg_T "Dynamic offset Torque for enabling Intervention Active (Firing angle adjustment) in case of Negative gradients" CURVE 0x80533402 RB_Curve_S16_S16 6553.500 md_q0p1 -3276.800 3276.700 FORMAT "%8.3"
 /begin AXIS_DESCR STD_AXIS ActMod_trqClthWoDstC md_q0p1 5 -3276.800 3276.700 FORMAT "%8.3" DEPOSIT ABSOLUTE /end AXIS_DESCR
/end CHARACTERISTIC
/begin CHARACTERISTIC PTDist_trqOfsDynActvPos_T "Dynamic offset Torque for enabling Intervention Active (Firing angle adjustment) in case of Positive gradients" CURVE 0x80533418 RB_Curve_S16_S16 6553.500 md_q0p1 -3276.800 3276.700 FORMAT "%8.3"
 /begin AXIS_DESCR STD_AXIS ActMod_trqClthWoDstC md_q0p1 5 -3276.800 3276.700 FORMAT "%8.3" DEPOSIT ABSOLUTE /end AXIS_DESCR
/end CHARACTERISTIC
/begin CHARACTERISTIC PthLead_stTrqCalc_CW "Code word for configuring calculations of torque reserve in module" VALUE 0x80533744 RB_Val_Wu8 255.0 OneToOne 0.00 255.0 FORMAT "%5.1" /end CHARACTERISTIC
/begin CHARACTERISTIC PThrVlvUs_nSwtSynCalcThd_C "engine speed threshold, above which calculation of pressure sensor value in synchro-process is possible" VALUE 0x805336DE RB_Val_Ws16 32767.50 EngN -16384.00 16383.50 FORMAT "%8.2" /end CHARACTERISTIC
/begin CHARACTERISTIC PThrVlvUs_pDifAirFilMax_C "Maximum pressure difference over air filter for diagnosis of pressure value throttle valve upstream" VALUE 0x805336E0 RB_Val_Wu16 5119.922 p_q0p078 0.00 5119.922 FORMAT "%8.3" /end CHARACTERISTIC
/begin CHARACTERISTIC PThrVlvUs_pDifAirFilUsVehV_T "rise in pressure upstream air filter depending on vehicle speed" CURVE 0x805336E2 RB_Curve_S16_U16_Static 2559.961 p_uw_q0p039 0.00 2559.961 FORMAT "%8.3"
 /begin AXIS_DESCR STD_AXIS VehV_v Vel 4 -327.6800 327.6700 FORMAT "%8.4" DEPOSIT ABSOLUTE /end AXIS_DESCR
/end CHARACTERISTIC
/begin CHARACTERISTIC PThrVlvUs_pSnsrTolrMax_C "Maximum pressure sensor tolerance" VALUE 0x805336F4 RB_Val_Wu16 5119.922 p_q0p078 0.00 5119.922 FORMAT "%8.3" /end CHARACTERISTIC
/begin CHARACTERISTIC PThrVlvUs_pSubValMax_C "substitute value for highest possible pressure upstream of throttle valve" VALUE 0x805336F6 RB_Val_Wu16 5119.922 p_q0p078 0.00 5119.922 FORMAT "%8.3" /end CHARACTERISTIC
/begin CHARACTERISTIC PThrVlvUs_pSubValMin_C "substitute value for lowest possible pressure upstream of throttle valve" VALUE 0x805336F8 RB_Val_Wu16 5119.922 p_q0p078 0.00 5119.922 FORMAT "%8.3" /end CHARACTERISTIC
/begin CHARACTERISTIC PthSet_dTqIgnAgRlsPos_C "Derivative torque for ignition angle release positive Calibration" VALUE 0x80533938 RB_Val_Ws32 6553599.99847 RmpTrq -3276800.00000 3276799.99847 FORMAT "%13.5" /end CHARACTERISTIC
/begin CHARACTERISTIC PthSet_dtrqIALckRmp2_C "Delta torque for change limitation at withdrawl of IA-release" VALUE 0x8053393C RB_Val_Ws16 3276.600 Trq 0.100 3276.700 FORMAT "%8.3" EXTENDED_LIMITS -3276.800 3276.700 /end CHARACTERISTIC
/begin CHARACTERISTIC PthSet_dtrqIALckRmp_C "Delta torque for change limitation at withdrawl of IA-release" VALUE 0x8053393E RB_Val_Ws16 32750.00 mdgrad_q10 10.00 32760.00 FORMAT "%8.2" EXTENDED_LIMITS -327680.0 327670.0 /end CHARACTERISTIC
/begin CHARACTERISTIC PthSet_dtrqIARlsRmp2_C "Delta torque for change limitation at IA-release" VALUE 0x80533748 RB_Val_Ws32 6553599.99847 RmpTrq -3276800.00000 3276799.99847 FORMAT "%13.5" /end CHARACTERISTIC
/begin CHARACTERISTIC PthSet_dtrqIARlsRmp_MAP "MAP for Derivative torque from ignition angle release ramp" MAP 0x8053374C RB_Map_S16S16_S32 6553599.99847 RmpTrq -3276800.00000 3276799.99847 FORMAT "%13.5"
 /begin AXIS_DESCR STD_AXIS Tra_numGear OneToOne 10 -128.0000 127.0000 FORMAT "%8.4" EXTENDED_LIMITS -32768.00 32767.00 DEPOSIT ABSOLUTE /end AXIS_DESCR
 /begin AXIS_DESCR STD_AXIS RngMod_trqInrBs md_q0p1 8 -3276.800 3276.700 FORMAT "%8.3" DEPOSIT ABSOLUTE /end AXIS_DESCR
/end CHARACTERISTIC
/begin CHARACTERISTIC PthSet_facFCOMin_C "Factor for computing torque threshold for transition into overrun fuel cutoff" VALUE 0x805338C4 RB_Val_Wu8 0.9961 fak_ub_b1 0.00 0.9961 /end CHARACTERISTIC
/begin CHARACTERISTIC PthSet_facMonFCOLo_C "Factor for lower hysteresis threshold for fuel cutoff due to monitoring level 1" VALUE 0x80533940 RB_Val_Wu8 1.992188 fak_ub_b2 0.00 1.992188 FORMAT "%8.6" /end CHARACTERISTIC
/begin CHARACTERISTIC PthSet_flgEnaOvrRunHyst_C "Mask to enable torque hysteresis based cylinder fuel cut-off release" VALUE 0x805338C5 RB_Val_Wboolean 1.00000000000 B_TRUE 0.00 1.00000000000 FORMAT "%13.11" /end CHARACTERISTIC
/begin CHARACTERISTIC PthSet_flgInnrLimdCutOffEna_C "Condition Inner Limitation Cut Off Enable" VALUE 0x80533941 RB_Val_Wboolean 1.00000000000 B_TRUE 0.00 1.00000000000 FORMAT "%13.11" /end CHARACTERISTIC
/begin CHARACTERISTIC PthSet_nOvrRunThres_C "Lower engine speed threshold for the activation of overrun fuel cut-off" VALUE 0x805338C6 RB_Val_Ws16 32767.50 EngN -16384.00 16383.50 FORMAT "%8.2" /end CHARACTERISTIC
/begin CHARACTERISTIC PthSet_numMaxCylCtOff_C "Maximum number of masked cylinders during cylinder individual fuel cut-off" VALUE 0x805338C8 RB_Val_Wu8 255.0 OneToOne 0.00 255.0 FORMAT "%5.1" /end CHARACTERISTIC
/begin CHARACTERISTIC PthSet_stIaRlsCmftMask_C "Mask to choose conditions relevant for ignition angle release with ramp" VALUE 0x805338B4 RB_Val_Wu16 65535.00 OneToOne 0.00 65535.00 FORMAT "%8.2" /end CHARACTERISTIC
/begin CHARACTERISTIC PthSet_stIaRlsIntvMask_C "Mask to choose conditions relevant for ignition angle release without ramp" VALUE 0x805338B6 RB_Val_Wu16 65535.00 OneToOne 0.00 65535.00 FORMAT "%8.2" /end CHARACTERISTIC
/begin CHARACTERISTIC PthSet_stIaRlsSlowRampMask_C "Mask to choose conditions relevant for ignition angle release with slow ramp" VALUE 0x805338B8 RB_Val_Wu16 65535.00 OneToOne 0.00 65535.00 FORMAT "%8.2" /end CHARACTERISTIC
/begin CHARACTERISTIC PthSet_stIaRlsWoIntvMask_C "Mask to choose conditions relevant for ignition angle release without intervention" VALUE 0x805338BA RB_Val_Wu16 65535.00 OneToOne 0.00 65535.00 FORMAT "%8.2" /end CHARACTERISTIC
/begin CHARACTERISTIC PthSet_stIaRlsWoTrsmIntvMask_C "Mask to choose conditions relevant for ignition angle release without transmission intervention" VALUE 0x805338BC RB_Val_Wu16 65535.00 OneToOne 0.00 65535.00 FORMAT "%8.2" /end CHARACTERISTIC
/begin CHARACTERISTIC PthSet_stOvrRun_CW "Codeword to configure cylinder individual fuel cut-off based on different conditions" VALUE 0x805338C9 RB_Val_Wu8 255.0 OneToOne 0.00 255.0 FORMAT "%5.1" /end CHARACTERISTIC
/begin CHARACTERISTIC PthSet_stSwtNoGripSeln_C "Switch to select no grip condition" VALUE 0x805338BE RB_Val_Wu8 255.0 OneToOne 0.00 255.0 FORMAT "%5.1" /end CHARACTERISTIC
/begin CHARACTERISTIC PthSet_stTrqDist_CW "Codeword to enable use of exclusive torque reserve, Slope of torque ramp after withdrawal of ignition angle release in the torque distibution path" VALUE 0x80533942 RB_Val_Wu8 255.0 OneToOne 0.00 255.0 FORMAT "%5.1" /end CHARACTERISTIC
/begin CHARACTERISTIC PthSet_SwtFCOTqInhbn_C "A switch to deactivate the consideration of minimum combustion engine torque for Fuel cut off" VALUE 0x805338CA RB_Val_Wboolean 1.00000000000 B_TRUE 0.00 1.00000000000 FORMAT "%13.11" /end CHARACTERISTIC
/begin CHARACTERISTIC PthSet_tiFcoDlyTmr_C "delay time of the timer PthSet_flgFcoReqflgT_I" VALUE 0x805338CB RB_Val_Wu8 2.500 Time_s 0.00 2.500 FORMAT "%5.3" EXTENDED_LIMITS 0.00 2.550 /end CHARACTERISTIC
/begin CHARACTERISTIC PthSet_tiMaxPhRstrt_C "Maximum period of time for phase Restart after overrun cutoff" VALUE 0x805338CC RB_Val_Wu8 2.540 Time_s 0.010 2.550 FORMAT "%5.3" EXTENDED_LIMITS 0.00 2.550 /end CHARACTERISTIC
/begin CHARACTERISTIC PthSet_tiUpShift_CUR "used for FCO delay of the selected gear from 2 to 9" CURVE 0x805338CE RB_Curve_S16_U16_Static 3.000000 Time_s 0.00 3.000000 FORMAT "%8.6" EXTENDED_LIMITS 0.00 655.3500
 /begin AXIS_DESCR STD_AXIS Gbx_numGearTrgt OneToOne 8 -32768.00 32767.00 FORMAT "%8.2" DEPOSIT ABSOLUTE /end AXIS_DESCR
/end CHARACTERISTIC
/begin CHARACTERISTIC PthSet_tqIARmpOffset_C "offset torque to limit the Ignition angle release Ramp Torque" VALUE 0x80533944 RB_Val_Ws16 3276.700 Trq 0.00 3276.700 FORMAT "%8.3" EXTENDED_LIMITS -3276.800 3276.700 /end CHARACTERISTIC
/begin CHARACTERISTIC PthSet_tqLoadBasdThdFcoOff_CUR "Threshold torque for the release of cylinder fuel cut-off disable" CURVE 0x805338F0 RB_Curve_U16_S16_Static 3276.700 Trq 0.00 3276.700 FORMAT "%8.3" EXTENDED_LIMITS -3276.800 3276.700
 /begin AXIS_DESCR STD_AXIS rl_w_msg rel_q0p0234 8 0.00 1535.977 FORMAT "%8.3" DEPOSIT ABSOLUTE /end AXIS_DESCR
/end CHARACTERISTIC
/begin CHARACTERISTIC PthSet_tqLoadBasdThdFcoOn_CUR "Threshold torque for the release of cylinder fuel cut-off enable" CURVE 0x80533912 RB_Curve_U16_S16_Static 3276.700 Trq 0.00 3276.700 FORMAT "%8.3" EXTENDED_LIMITS -3276.800 3276.700
 /begin AXIS_DESCR STD_AXIS rl_w_msg rel_q0p0234 8 0.00 1535.977 FORMAT "%8.3" DEPOSIT ABSOLUTE /end AXIS_DESCR
/end CHARACTERISTIC
/begin CHARACTERISTIC PthSet_trqHysOvrRun_C "Torque hysteresis for decision of cylinder fuel cutoff" VALUE 0x80533934 RB_Val_Ws16 6553.500 Trq -3276.800 3276.700 FORMAT "%8.3" /end CHARACTERISTIC
/begin CHARACTERISTIC PthSet_trqIARlsRmpActvnThd_C "torque threshold for activation of ignition angle release ramp" VALUE 0x805338C0 RB_Val_Ws16 25.00000 md_q0p1 0.00 25.00000 FORMAT "%8.5" EXTENDED_LIMITS -3276.800 3276.700 /end CHARACTERISTIC
/begin CHARACTERISTIC PTSSE_bStrtEnaCVT_C "Engine start enable" VALUE 0x80533430 RB_Val_Wu8 1.00000000000 B_TRUE 0.00 1.00000000000 FORMAT "%13.11" /end CHARACTERISTIC
/begin CHARACTERISTIC PTSSE_stGbxSpstReqActv_C "Active status of start stop request from Gearbox ECU via CAN" VALUE 0x80533431 RB_Val_Wu8 2.000 OneToOne 0.00 2.000 FORMAT "%5.3" EXTENDED_LIMITS 0.00 255.0 /end CHARACTERISTIC
/begin CHARACTERISTIC PTSSE_stSpstReq_T "Curve to map the start stop request from Gearbox ECU" CURVE 0x80533432 RB_Curve_U8_U8 255.0 OneToOne 0.00 255.0 FORMAT "%5.1"
 /begin AXIS_DESCR STD_AXIS Gbx_stSpstReq OneToOne 10 0.00 255.0 FORMAT "%5.1" DEPOSIT ABSOLUTE /end AXIS_DESCR
/end CHARACTERISTIC
/begin CHARACTERISTIC PT_cntrEngActvIgn_C "Engine active counter threshold" VALUE 0x80533448 RB_Val_Wu8 255.0 OneToOne 0.00 255.0 FORMAT "%5.1" /end CHARACTERISTIC
/begin CHARACTERISTIC PT_dtqNegSlopSetWoIntv_M "Map value for the Delta torque for negative slope for IARls_WoIntv" MAP 0x8053354C RB_Map_S8S16_S16 6553.500 NmPerSec -3276.800 3276.700 FORMAT "%8.3"
 /begin AXIS_DESCR STD_AXIS Tra_numGear OneToOne 10 -128.0 127.0 FORMAT "%5.1" DEPOSIT ABSOLUTE /end AXIS_DESCR
 /begin AXIS_DESCR STD_AXIS RngMod_trqInrBs md_q0p1 8 -3276.800 3276.700 FORMAT "%8.3" DEPOSIT ABSOLUTE /end AXIS_DESCR
/end CHARACTERISTIC
/begin CHARACTERISTIC PT_dtqNegSlopWoTrsmIntv_M "Map Value of the Delta torque for negative slope for IARls_WoTrsmIntv" MAP 0x80533608 RB_Map_S8S16_S16 6553.500 NmPerSec -3276.800 3276.700 FORMAT "%8.3"
 /begin AXIS_DESCR STD_AXIS Tra_numGear OneToOne 10 -128.0 127.0 FORMAT "%5.1" DEPOSIT ABSOLUTE /end AXIS_DESCR
 /begin AXIS_DESCR STD_AXIS RngMod_trqInrBs md_q0p1 8 -3276.800 3276.700 FORMAT "%8.3" DEPOSIT ABSOLUTE /end AXIS_DESCR
/end CHARACTERISTIC
/begin CHARACTERISTIC PT_dtqPosSlopSetWoIntv_C "Delta torque for positive slope for IARls_WoIntv" VALUE 0x805336C4 RB_Val_Wu32 6553599.99847 RmpTrq 0.00 6553599.99847 FORMAT "%13.5" /end CHARACTERISTIC
/begin CHARACTERISTIC PT_dtqPosSlopSetWoTrsmIntv_C "Delta torque for positive slope for IARls_WoTrsmIntv" VALUE 0x805336C8 RB_Val_Wu32 6553599.99847 RmpTrq 0.00 6553599.99847 FORMAT "%13.5" /end CHARACTERISTIC
/begin CHARACTERISTIC PT_flgIndcdLimnBascTq_C "Basic indicated torque limitaion" VALUE 0x80533449 RB_Val_Wboolean 1.00000000000 B_TRUE 0.00 1.00000000000 FORMAT "%13.11" /end CHARACTERISTIC
/begin CHARACTERISTIC PT_flgInnrTqLimEna_C "Target engine torque under limitation enable flag" VALUE 0x8053344A RB_Val_Wboolean 1.00000000000 B_TRUE 0.00 1.00000000000 FORMAT "%13.11" /end CHARACTERISTIC
/begin CHARACTERISTIC PT_flgNPosSnsrRdnt_C "Flag to select configuration of neutral gear switch sensor (single or redundant)" VALUE 0x80533464 RB_Val_Wu8 1.00000000000 B_TRUE 0.00 1.00000000000 FORMAT "%13.11" /end CHARACTERISTIC
/begin CHARACTERISTIC PT_flgSwtIntvDrvrDmdRstFco_C "Parameter to consider driver demand during intervention in resetting the FCO flags on parallel path" VALUE 0x805336CC RB_Val_Wu8 1.00000000000 B_TRUE 0.00 1.00000000000 FORMAT "%13.11" /end CHARACTERISTIC
/begin CHARACTERISTIC PT_flgSwtStabyIntvIncSetOverrun_C "Parameter to consider increasing Stability intervention in resetting the FCO flags on parallel path" VALUE 0x805336CD RB_Val_Wu8 1.00000000000 B_TRUE 0.00 1.00000000000 FORMAT "%13.11" /end CHARACTERISTIC
/begin CHARACTERISTIC PT_flgSwtTrsmIntvIncSetOvrRun_C "Parameter to consider increasing transmission intervention in resetting the FCO flags on parallel path" VALUE 0x805336CE RB_Val_Wu8 1.00000000000 B_TRUE 0.00 1.00000000000 FORMAT "%13.11" /end CHARACTERISTIC
/begin CHARACTERISTIC PT_flgTqLimnInnr_C "Inner torque limitation" VALUE 0x8053344B RB_Val_Wboolean 1.00000000000 B_TRUE 0.00 1.00000000000 FORMAT "%13.11" /end CHARACTERISTIC
/begin CHARACTERISTIC PT_flgTqRmpIALckDsbl_C "Parameter to disable the ignition release ramp" VALUE 0x805336CF RB_Val_Wu8 1.00000000000 B_TRUE 0.00 1.00000000000 FORMAT "%13.11" /end CHARACTERISTIC
/begin CHARACTERISTIC PT_GripCfg_CW "codeword for the configuration of the function PT_Grip" VALUE 0x80533465 RB_Val_Wu8 255.0 OneToOne 0.00 255.0 FORMAT "%5.1" /end CHARACTERISTIC
/begin CHARACTERISTIC PT_nMinAftIdle_MAP "Conditions for RPM increase and gear state following idling at the time of clutch-release judgement" MAP 0x80533466 RB_Map_S16U16_U16 16383.75 nmot_uw_q0p25 0.00 16383.75 FORMAT "%8.2"
 /begin AXIS_DESCR STD_AXIS Tra_numGear OneToOne 8 -32768.00 32767.00 FORMAT "%8.2" DEPOSIT ABSOLUTE /end AXIS_DESCR
 /begin AXIS_DESCR STD_AXIS PT_nBgnIdle nmot_uw_q0p25 8 0.00 16383.75 FORMAT "%8.2" DEPOSIT ABSOLUTE /end AXIS_DESCR
/end CHARACTERISTIC
/begin CHARACTERISTIC PT_rClthSlipDeb_C "Analogue value for the state PT_bNoGrip = FALSE and clutch slips, debounced (manual clutch)." VALUE 0x8053350A RB_Val_Ws16 655.3500 Fact100 -327.6800 327.6700 FORMAT "%8.4" /end CHARACTERISTIC
/begin CHARACTERISTIC PT_rClthSlip_C "Analogue value for the state PT_bNoGrip = FALSE and clutch slips (manual clutch) or clutch is in a slip state / controlled operation (automated clutch)." VALUE 0x8053350C RB_Val_Ws16 655.3500 Fact100 -327.6800 327.6700 FORMAT "%8.4" /end CHARACTERISTIC
/begin CHARACTERISTIC PT_rConvSlipClsd_C "Analogue value for the state PT_bNoGrip = FALSE and converter lockup clutch is almost closed, little slip." VALUE 0x8053350E RB_Val_Ws16 655.3500 Fact100 -327.6800 327.6700 FORMAT "%8.4" /end CHARACTERISTIC
/begin CHARACTERISTIC PT_rConvSlipOpn_C "Analogue value for the state PT_bNoGrip = FALSE and converter lockup clutch is open (converter in slip)." VALUE 0x80533510 RB_Val_Ws16 655.3500 Fact100 -327.6800 327.6700 FORMAT "%8.4" /end CHARACTERISTIC
/begin CHARACTERISTIC PT_rConvSlip_C "Analogue value for the state PT_bNoGrip = FALSE and converter lockup clutch is controlled or is in controlled slip operation." VALUE 0x80533512 RB_Val_Ws16 655.3500 Fact100 -327.6800 327.6700 FORMAT "%8.4" /end CHARACTERISTIC
/begin CHARACTERISTIC PT_rGripDfl_C "Analog value for the state where none of the single bit messages is TRUE" VALUE 0x80533514 RB_Val_Ws16 655.3500 Fact100 -327.6800 327.6700 FORMAT "%8.4" /end CHARACTERISTIC
/begin CHARACTERISTIC PT_rGrip_C "Analog value for the state grip is for sure present (the converter lockup clutch / the automated or manual clutch is completely closed and PT_bNoGrip = FALSE)." VALUE 0x80533516 RB_Val_Ws16 655.3500 Fact100 -327.6800 327.6700 FORMAT "%8.4" /end CHARACTERISTIC
/begin CHARACTERISTIC PT_rMaxThrAgChg_C "Maximum change in driver requested throttle opening for deactivating detection of rpm overshoot after idling" VALUE 0x80533518 RB_Val_Ws16 399.9939 rel_sw_b200 -200.0000 199.9939 FORMAT "%8.4" /end CHARACTERISTIC
/begin CHARACTERISTIC PT_rMinEngLd_CUR "Minimum load for activating detection of rpm overshoot after idling" CURVE 0x8053351A RB_Curve_U16_U16 1535.977 rel_uw_q0p0234 0.00 1535.977 FORMAT "%8.3"
 /begin AXIS_DESCR STD_AXIS NO_INPUT_QUANTITY nmot_q0p25 8 0.00 16383.75 FORMAT "%8.2" DEPOSIT ABSOLUTE /end AXIS_DESCR
/end CHARACTERISTIC
/begin CHARACTERISTIC PT_rMinThrAgChg_C "Minimum change in driver requested throttle opening for activating detection of rpm overshooting after idling" VALUE 0x8053353C RB_Val_Ws16 199.9969 rel_uw_b200 -100.0000 99.9969 FORMAT "%8.4" EXTENDED_LIMITS -100.0000 99.99695 /end CHARACTERISTIC
/begin CHARACTERISTIC PT_rNoGrip_C "Analog value for the state grip is for sure excluded" VALUE 0x8053353E RB_Val_Ws16 655.3500 Fact100 -327.6800 327.6700 FORMAT "%8.4" /end CHARACTERISTIC
/begin CHARACTERISTIC PT_rTrqDfl_C "Default value for torque ratio" VALUE 0x805336D8 RB_Val_Ws16 655.3500 TransR -327.6800 327.6700 FORMAT "%8.4" /end CHARACTERISTIC
/begin CHARACTERISTIC PT_stClthSensPrs_C "Calibration switch represents clutch sensor present or not" VALUE 0x80533540 RB_Val_Wu8 255.0 OneToOne 0.00 255.0 FORMAT "%5.1" /end CHARACTERISTIC
/begin CHARACTERISTIC PT_swtClthGrip_C "The switch to choose the status of clutch in case of grip" VALUE 0x80533541 RB_Val_Wu8 1.00000000000 B_TRUE 0.00 1.00000000000 FORMAT "%13.11" /end CHARACTERISTIC
/begin CHARACTERISTIC PT_swtDetTypeCAN_C "Determines if value is read from CAN or not" VALUE 0x805336DA RB_Val_Ws8 255.0 OneToOne -128.0 127.0 FORMAT "%5.1" /end CHARACTERISTIC
/begin CHARACTERISTIC PT_swtEngTqEstimtdSeln_C "Switch engine estimated torque calibration" VALUE 0x8053344C RB_Val_Wboolean 1.00000000000 B_TRUE 0.00 1.00000000000 FORMAT "%13.11" /end CHARACTERISTIC
/begin CHARACTERISTIC PT_swtTrqRatNoFrz_C "Prevention of freeze of powertrain torque ratio." VALUE 0x805336DB RB_Val_Wu8 1.000 OneToOne 0.00 1.000 FORMAT "%5.3" EXTENDED_LIMITS 0.00 255.0 /end CHARACTERISTIC
/begin CHARACTERISTIC Pt_tiAcOffDetn_C "Air compressor turn off delay time" VALUE 0x80533450 RB_Val_Ws32 4294.96729500 Time_Dt -2147.48364800 2147.48364700 FORMAT "%13.8" /end CHARACTERISTIC
/begin CHARACTERISTIC PT_tiAcOnDetn_C "Air compressor turn on delay time" VALUE 0x80533454 RB_Val_Ws32 4294.96729500 Time_Dt -2147.48364800 2147.48364700 FORMAT "%13.8" /end CHARACTERISTIC
/begin CHARACTERISTIC PT_tiDebClthStSlip_C "Debouncing time for the formation of the state ""clutch slips, debounced"" (manual clutch)." VALUE 0x80533544 RB_Val_Ws32 4294.96729500 Time_Dt -2147.48364800 2147.48364700 FORMAT "%13.8" /end CHARACTERISTIC
/begin CHARACTERISTIC PT_tiEngLimActvDesDly_C "Engine torque limitation active delay time" VALUE 0x80533458 RB_Val_Ws32 4294.96729500 Time_Dt -2147.48364800 2147.48364700 FORMAT "%13.8" /end CHARACTERISTIC
/begin CHARACTERISTIC PT_tiOverrunInactvTrsmIntvDec_C "the delay time for the turn on delay for overrun inactive transmission intervention" VALUE 0x805336D0 RB_Val_Ws16 655.3500 Time_s -327.6800 327.6700 FORMAT "%8.4" /end CHARACTERISTIC
/begin CHARACTERISTIC PT_tiOverrunInactvWoIntv_C "the delay time for the turn on delay for overrun inactive without intervention" VALUE 0x805336D2 RB_Val_Ws16 655.3500 Time_s -327.6800 327.6700 FORMAT "%8.4" /end CHARACTERISTIC
/begin CHARACTERISTIC PT_tiThrOpngChg_C "Delay time for calculation of change in driver requested throttle opening" VALUE 0x80533548 RB_Val_Wu8 2.550 t_q0p01 0.00 2.550 FORMAT "%5.3" /end CHARACTERISTIC
/begin CHARACTERISTIC PT_tqDifThdHysHiDrvDmdActv_C "Hysterisis High threshold limit to avoid tolerance issues in torque for which the difference in VMD_tqCluDes and RngMod_trqCrSMin should be greater than a calibratable threshold." VALUE 0x805336D4 RB_Val_Ws16 6553.500 Trq -3276.800 3276.700 FORMAT "%8.3" /end CHARACTERISTIC
/begin CHARACTERISTIC PT_tqDifThdHysLoDrvDmdActv_C "Hysterisis Low threshold limit to avoid tolerance issues in torque for which the difference in VMD_tqCluDes and RngMod_trqCrSMin should be greater than a calibratable threshold." VALUE 0x805336D6 RB_Val_Ws16 6553.500 Trq -3276.800 3276.700 FORMAT "%8.3" /end CHARACTERISTIC
/begin CHARACTERISTIC PT_tqDrvrDmdMinThd_C "Calibration for maximum limit for Torque Demand by driver" VALUE 0x8053345C RB_Val_Ws16 6553.500 Trq -3276.800 3276.700 FORMAT "%8.3" /end CHARACTERISTIC
/begin CHARACTERISTIC PT_trqRateLimitActvDiff_C "Torque rate limit activation differ" VALUE 0x8053345E RB_Val_Ws16 6553.500 Trq -3276.800 3276.700 FORMAT "%8.3" /end CHARACTERISTIC
/begin CHARACTERISTIC PT_trqRateLimitActvTrqTh_C "Torque rate limit activation threshold" VALUE 0x80533460 RB_Val_Ws16 6553.500 Trq -3276.800 3276.700 FORMAT "%8.3" /end CHARACTERISTIC
/begin CHARACTERISTIC PT_trqRateLimit_C "Torque rate limit calibration" VALUE 0x80533462 RB_Val_Ws16 6553.500 Trq -3276.800 3276.700 FORMAT "%8.3" /end CHARACTERISTIC
/begin CHARACTERISTIC PT_vMinGrip_C "minimum vehicle speed for grip determination" VALUE 0x8053354A RB_Val_Ws16 655.3500 Vel -327.6800 327.6700 FORMAT "%8.4" /end CHARACTERISTIC
/begin CHARACTERISTIC PT_vMinTrqRat_C "Minimum vehicle speed" VALUE 0x805336DC RB_Val_Ws16 655.3500 Vel -327.6800 327.6700 FORMAT "%8.4" /end CHARACTERISTIC
/begin CHARACTERISTIC VF2ME_DMRWAN_C "delta torque loss torque converter" VALUE 0x80533318 RB_Val_Wu8 99.61 rel_ub_b99p6 0.00 99.61 FORMAT "%5.2" /end CHARACTERISTIC
/begin MEASUREMENT APP_stPlaBrk "State of plausibility APP with brake" UBYTE OneToOne 1 100 0.00 255.0 FORMAT "%5.1" ECU_ADDRESS 0x6000A6BA /end MEASUREMENT
/begin MEASUREMENT B_eepwf "Condition Powerfail EEPROM" UBYTE B_TRUE 1 100 0.00 1.00000000000 BIT_MASK 0x1 FORMAT "%13.11" ECU_ADDRESS 0x7000013D /end MEASUREMENT
/begin MEASUREMENT B_ekpvl_msg "condition EKP lead time" UBYTE B_TRUE 1 100 0.00 1.00000000000 BIT_MASK 0x1 FORMAT "%13.11" ECU_ADDRESS 0x6000015F /end MEASUREMENT
/begin MEASUREMENT B_fs_msg "Condition driving state (automatic gear box)" UBYTE B_TRUE 1 100 0.00 1.00000000000 BIT_MASK 0x1 FORMAT "%13.11" ECU_ADDRESS 0x70000A5B /end MEASUREMENT
/begin MEASUREMENT B_gsch_msg "Condition gear-shift in process" UBYTE B_TRUE 1 100 0.00 1.00000000000 BIT_MASK 0x1 FORMAT "%13.11" ECU_ADDRESS 0x70000A4F /end MEASUREMENT
/begin MEASUREMENT B_gwhs_msg "Condition gear shift in case of manual gear shift lever" UBYTE B_TRUE 1 100 0.00 1.00000000000 BIT_MASK 0x1 FORMAT "%13.11" ECU_ADDRESS 0x70000A4D /end MEASUREMENT
/begin MEASUREMENT B_psinirg_msg "Validity status for raw pressure before engine starts" UBYTE B_TRUE 1 100 0.00 1.00000000000 BIT_MASK 0x1 FORMAT "%13.11" ECU_ADDRESS 0x700009CF /end MEASUREMENT
/begin MEASUREMENT B_psrmw_msg "Condition for mean value intake manifold pressure" UBYTE B_TRUE 1 100 0.00 1.00000000000 BIT_MASK 0x1 FORMAT "%13.11" ECU_ADDRESS 0x700009C9 /end MEASUREMENT
/begin MEASUREMENT B_psrrg_msg "Condition intake manifold pressure rawvalue valid" UBYTE B_TRUE 1 100 0.00 1.00000000000 BIT_MASK 0x1 FORMAT "%13.11" ECU_ADDRESS 0x700009C8 /end MEASUREMENT
/begin MEASUREMENT B_pvdg_msg "condition: pressure upstream throttle valve valid" UBYTE B_TRUE 1 100 0.00 1.00000000000 BIT_MASK 0x1 FORMAT "%13.11" ECU_ADDRESS 0x700009C3 /end MEASUREMENT
/begin MEASUREMENT B_pwf "condition for powerfail" UBYTE B_TRUE 1 100 0.00 1.00000000000 BIT_MASK 0x1 FORMAT "%13.11" ECU_ADDRESS 0x7000013C /end MEASUREMENT
/begin MEASUREMENT B_tapcm_msg "Condition output duty cycle PCM" UBYTE B_TRUE 1 100 0.00 1.00000000000 BIT_MASK 0x1 FORMAT "%13.11" ECU_ADDRESS 0x6000012B /end MEASUREMENT
/begin MEASUREMENT B_wkauf_msg "Condition for open lock up clutch" UBYTE B_TRUE 1 100 0.00 1.00000000000 BIT_MASK 0x1 FORMAT "%13.11" ECU_ADDRESS 0x70000958 /end MEASUREMENT
/begin MEASUREMENT B_wkr_msg "condition clutch controlled" UBYTE B_TRUE 1 100 0.00 1.00000000000 BIT_MASK 0x1 FORMAT "%13.11" ECU_ADDRESS 0x70000957 /end MEASUREMENT
/begin MEASUREMENT B_wk_msg "condition: converter lockup clutch closed" UBYTE B_TRUE 1 100 0.00 1.00000000000 BIT_MASK 0x1 FORMAT "%13.11" ECU_ADDRESS 0x70000959 /end MEASUREMENT
/begin MEASUREMENT B_zwget_msg "Ignition angle intervention via transmission intervention" UBYTE B_TRUE 1 100 0.00 1.00000000000 BIT_MASK 0x1 FORMAT "%13.11" ECU_ADDRESS 0x7000094F /end MEASUREMENT
/begin MEASUREMENT CoPT_flgFuCutOffActv "Fuel Cut Off active" UBYTE B_TRUE 1 100 0.00 1.00000000000 BIT_MASK 0x1 FORMAT "%13.11" ECU_ADDRESS 0x6000A1F0 /end MEASUREMENT
/begin MEASUREMENT CoPT_nASTDes "Transmission synchronisation speed" SWORD EngN 1 100 -16384.00 16383.50 FORMAT "%8.2" ECU_ADDRESS 0x70002C2A /end MEASUREMENT
/begin MEASUREMENT CoPT_nMaxAcs "Application parameter for Maximum engine speed demand of accessories" SWORD EngN 1 100 -16384.00 16383.50 FORMAT "%8.2" ECU_ADDRESS 0x6000E178 /end MEASUREMENT
/begin MEASUREMENT CoPT_nMaxSysErr "Application parameter for maximum engine speed demand during a system error" SWORD EngN 1 100 -16384.00 16383.50 FORMAT "%8.2" ECU_ADDRESS 0x6000E17A /end MEASUREMENT
/begin MEASUREMENT CoPT_nMaxTra "Application parameter for Maximum engine speed demand of Transmission" SWORD EngN 1 100 -16384.00 16383.50 FORMAT "%8.2" ECU_ADDRESS 0x6000E17C /end MEASUREMENT
/begin MEASUREMENT CoPT_nMinAcs "Application parameter for Minimum engine speed demand of Accessories" SWORD EngN 1 100 -16384.00 16383.50 FORMAT "%8.2" ECU_ADDRESS 0x600051F6 /end MEASUREMENT
/begin MEASUREMENT CoPT_nMinSysErr "Application parameter for minimum engine speed demand during a system error" SWORD EngN 1 100 -16384.00 16383.50 FORMAT "%8.2" ECU_ADDRESS 0x600051F4 /end MEASUREMENT
/begin MEASUREMENT CoPT_nMinTra "Application parameter for Minimum engine speed demand of transmission" SWORD EngN 1 100 -16384.00 16383.50 FORMAT "%8.2" ECU_ADDRESS 0x600051F2 /end MEASUREMENT
/begin MEASUREMENT CoPT_stAST "Status word which defines status of transmission synchronisation speed request" UWORD OneToOne 1 100 0.00 65535.00 FORMAT "%8.2" ECU_ADDRESS 0x70002C2C /end MEASUREMENT
/begin MEASUREMENT CoPT_stNSetPAcs "Application parameter for State of low idle speed request of accessories" UBYTE OneToOne 1 100 0.00 255.0 FORMAT "%5.1" ECU_ADDRESS 0x6000A66C /end MEASUREMENT
/begin MEASUREMENT CoPT_stNSetPSysErr "Application parameter for state of low idle speed request while system error" UBYTE OneToOne 1 100 0.00 255.0 FORMAT "%5.1" ECU_ADDRESS 0x6000A66B /end MEASUREMENT
/begin MEASUREMENT CoPT_stNSetPTra "Application parameter for State of low idle speed request of transmission" UBYTE OneToOne 1 100 0.00 255.0 FORMAT "%5.1" ECU_ADDRESS 0x6000A66A /end MEASUREMENT
/begin MEASUREMENT CoPT_tiASTDes "Transmission synchronisation time" SWORD Time_s 1 100 -327.6800 327.6700 FORMAT "%8.4" ECU_ADDRESS 0x70002C2E /end MEASUREMENT
/begin MEASUREMENT dmrwan_msg "Torque reserve for torque converter" UBYTE rel_ub_b99p6 1 100 0.00 99.61 FORMAT "%5.2" ECU_ADDRESS 0x60009FFF /end MEASUREMENT
/begin MEASUREMENT Eep_ctAbsCallWrFkt "16-bit-counter which counts the function calls to Eep_Write and Eep_Init over all driving cycles" UWORD OneToOne 1 100 0.00 65535.00 FORMAT "%8.2" ECU_ADDRESS 0x60034980 /end MEASUREMENT
/begin MEASUREMENT Eep_ctCallWrFkt "Counter which counts the function calls to Eep_Write and Eep_Init during one driving cycle" UWORD OneToOne 1 100 0.00 65535.00 FORMAT "%8.2" ECU_ADDRESS 0x600340CA /end MEASUREMENT
/begin MEASUREMENT Eep_ctMaxCallWrFkt "Maximum value of Eep_ctCallWrFkt" UWORD OneToOne 1 100 0.00 65535.00 FORMAT "%8.2" ECU_ADDRESS 0x60034982 /end MEASUREMENT
/begin MEASUREMENT Eep_EnvRamHist "History state ENVRAM" UBYTE OneToOne 1 100 0.00 255.0 FORMAT "%5.1" ECU_ADDRESS 0x6000A8AE /end MEASUREMENT
/begin MEASUREMENT Eep_EnvRamInvld "Invalidity state ENVRAM" UBYTE OneToOne 1 100 0.00 255.0 FORMAT "%5.1" ECU_ADDRESS 0x6000E460 /end MEASUREMENT
/begin MEASUREMENT Eep_PostdrvBlkIdx_s16 "Block Index of currently stored block" SWORD OneToOne 1 100 -32768.00 32767.00 FORMAT "%8.2" ECU_ADDRESS 0x60005462 /end MEASUREMENT
/begin MEASUREMENT Eep_stBlk "Status array with status of each EEP block" UWORD OneToOne 1 100 0.00 65535.00 FORMAT "%8.2" ARRAY_SIZE 35 ECU_ADDRESS 0x50005C9A /end MEASUREMENT
/begin MEASUREMENT Eep_stMain "Main state of EEP" SLONG Eep_MainStates_Verb 1 100 0.00 14.0000000000 FORMAT "%13.10" ECU_ADDRESS 0x60001DF0 /end MEASUREMENT
/begin MEASUREMENT Eep_stPostDrv "Status of EEP process in PostDrive / PreDrive" UBYTE Eep_PostDrvState_Verb 1 100 0.00 4.00000000000 FORMAT "%13.11" ECU_ADDRESS 0x6000A8AC /end MEASUREMENT
/begin MEASUREMENT EISGov_trq "resulted output torque of EISGov controller" SWORD md_q0p1 1 100 -3276.800 3276.700 FORMAT "%8.3" ECU_ADDRESS 0x600050EC /end MEASUREMENT
/begin MEASUREMENT fpvd_w_msg "correction factor for pressure upstream throttle valve" UWORD fak_uw_b8 1 100 0.00 7.999878 FORMAT "%8.6" ECU_ADDRESS 0x60000604 /end MEASUREMENT
/begin MEASUREMENT gangist_msg "Actual gear position" UBYTE dez 1 100 0.00 255.0 FORMAT "%5.1" ECU_ADDRESS 0x70002DB0 /end MEASUREMENT
/begin MEASUREMENT gangi_msg "Engaged gear" UBYTE dez 1 100 0.00 255.0 FORMAT "%5.1" ECU_ADDRESS 0x6000A29D /end MEASUREMENT
/begin MEASUREMENT gangsist_msg "Current gear" SBYTE dez 1 100 -128.0 127.0 FORMAT "%5.1" ECU_ADDRESS 0x6000A6C7 /end MEASUREMENT
/begin MEASUREMENT gangsziel_msg "desired gear" SBYTE dez 1 100 -128.0 127.0 FORMAT "%5.1" ECU_ADDRESS 0x70002DB1 /end MEASUREMENT
/begin MEASUREMENT InjCtl_qRaw "raw value of injection mass" UWORD rel_uw_b3072 1 100 0.00 3071.953 FORMAT "%8.3" ECU_ADDRESS 0x60004CAE /end MEASUREMENT
/begin MEASUREMENT mdwan_w_msg "Torque request of the torque converter" UWORD rel_sw_b100 1 100 0.00 99.99695 FORMAT "%8.5" ECU_ADDRESS 0x60004814 /end MEASUREMENT
/begin MEASUREMENT OilSwmpT_dtCEngDsTMdl "Difference between oil temperature model value and engine coolant temprature." SWORD Temp_Cels 1 100 -3549.940 3003.560 FORMAT "%8.3" ECU_ADDRESS 0x60000BC6 /end MEASUREMENT
/begin MEASUREMENT OilSwmpT_dtEnvTMdl "Difference between oil temperature model value and ambient temperature Model value for Oil deterioration system" SWORD Temp_Cels 1 100 -3549.940 3003.560 FORMAT "%8.3" ECU_ADDRESS 0x60000BC4 /end MEASUREMENT
/begin MEASUREMENT OilSwmpT_dtMdl2 "Difference between engine speed air mass coefficient temperature and vehicle speed coefficient temeprature." SLONG RBPtCel_t_1p52588em5_1 1 100 -32768.0000000 32767.9999847 FORMAT "%13.7" ECU_ADDRESS 0x60000BC0 /end MEASUREMENT
/begin MEASUREMENT OilSwmpT_facEngOffTiCoeff "Engine off time coefficient" UWORD fak_uw_b1 1 100 0.00 0.9999847 FORMAT "%9.7" ECU_ADDRESS 0x60000BBE /end MEASUREMENT
/begin MEASUREMENT OilSwmpT_facEngOffTiCoolgCoeff "Factor calculated based on engine off time to calculate initial oil temperature." UWORD fak_uw_b1 1 100 0.00 0.9999847 FORMAT "%9.7" ECU_ADDRESS 0x60000BBC /end MEASUREMENT
/begin MEASUREMENT OilSwmpT_facEngSpdCoeff "heat release coefficient based on engine speed to calculate model value for oil temperature." SWORD fak_q3p0518Em5 1 100 0.00 0.9999695 FORMAT "%9.7" ECU_ADDRESS 0x60000BBA /end MEASUREMENT
/begin MEASUREMENT OilSwmpT_facVehSpdCoeff "heat release coefficient based on vehicle speed to calculate model value for oil temperature." SWORD fak_q3p0518Em5 1 100 0.00 0.9999695 FORMAT "%9.7" ECU_ADDRESS 0x60000BB8 /end MEASUREMENT
/begin MEASUREMENT OilSwmpT_flgEngStrtCmpl "Oil temperature after engine start completion" UBYTE B_TRUE 1 100 0.00 1.00000000000 BIT_MASK 0x1 FORMAT "%13.11" ECU_ADDRESS 0x600000D1 /end MEASUREMENT
/begin MEASUREMENT OilSwmpT_flgFinshd "Flag to indicate model value for oil temperature is completed" UBYTE B_TRUE 1 100 0.00 1.00000000000 BIT_MASK 0x1 FORMAT "%13.11" ECU_ADDRESS 0x60009F88 /end MEASUREMENT
/begin MEASUREMENT OilSwmpT_flgInit "Flag to indicate initial oil temperature is completed." UBYTE B_TRUE 1 100 0.00 1.00000000000 BIT_MASK 0x1 FORMAT "%13.11" ECU_ADDRESS 0x700006B1 /end MEASUREMENT
/begin MEASUREMENT OilSwmpT_stEepReadCEngDsTBkup "EEP Read status" UBYTE OneToOne 1 100 0.00 255.0 FORMAT "%5.1" ECU_ADDRESS 0x60006311 /end MEASUREMENT
/begin MEASUREMENT OilSwmpT_stEepReadflgFinshd "EEP Read status" UBYTE OneToOne 1 100 0.00 255.0 FORMAT "%5.1" ECU_ADDRESS 0x60006310 /end MEASUREMENT
/begin MEASUREMENT OilSwmpT_stEepReadMdl "EEP Read status" UBYTE OneToOne 1 100 0.00 255.0 FORMAT "%5.1" ECU_ADDRESS 0x6000630F /end MEASUREMENT
/begin MEASUREMENT OilSwmpT_stEepReadMtrDisp "EEP Read status" UBYTE OneToOne 1 100 0.00 255.0 FORMAT "%5.1" ECU_ADDRESS 0x6000630E /end MEASUREMENT
/begin MEASUREMENT OilSwmpT_stTMdl2 "Status of the oil temperature model" UBYTE OneToOne 1 100 0.00 255.0 FORMAT "%5.1" ECU_ADDRESS 0x6000A027 /end MEASUREMENT
/begin MEASUREMENT OilSwmpT_tCEngDsTBkup "Back up engine coolant temperature." SWORD Temp_Cels 1 100 -3549.940 3003.560 FORMAT "%8.3" ECU_ADDRESS 0x6000364A /end MEASUREMENT
/begin MEASUREMENT OilSwmpT_tDifCEngDsTEnvT "Difference between engine coolant temperature and the ambient temperature model value for Oil deterioration system to calulate engine off time coefficient." SWORD Temp_Cels 1 100 -3549.940 3003.560 FORMAT "%8.3" ECU_ADDRESS 0x60000BB6 /end MEASUREMENT
/begin MEASUREMENT OilSwmpT_tDifCEngDsTEnvTOld "Difference between back up coolant temperature and the ambient temperature model value for Oil deterioration system to calulate engine off time coefficient." SWORD Temp_Cels 1 100 -3549.940 3003.560 FORMAT "%8.3" ECU_ADDRESS 0x60000BB4 /end MEASUREMENT
/begin MEASUREMENT OilSwmpT_tDifEngSpdAirMCoeff "Difference between heat coefficient temperature and engine speed coefficient temperature." SLONG RBPtCel_t_1p52588em5_1 1 100 -32768.0000000 32767.9999847 FORMAT "%13.7" ECU_ADDRESS 0x50000F1C /end MEASUREMENT
/begin MEASUREMENT OilSwmpT_tDifEngSpdCoeff "Engine speed coefficient temperature" SLONG RBPtCel_t_1p52588em5_1 1 100 -32768.0000000 32767.9999847 FORMAT "%13.7" ECU_ADDRESS 0x60000BB0 /end MEASUREMENT
/begin MEASUREMENT OilSwmpT_tDifMdl "Differnce between model value for oil temperature and the ambient temperature model value for Oil deterioration system to calculate initial oil temperature." SWORD Temp_Cels 1 100 -3549.940 3003.560 FORMAT "%8.3" ECU_ADDRESS 0x60000BAC /end MEASUREMENT
/begin MEASUREMENT OilSwmpT_tDifVehSpdCoeff "Vehicle speed coefficient temperature to calculate model value for oil temperature." SLONG RBPtCel_t_1p52588em5_1 1 100 -32768.0000000 32767.9999847 FORMAT "%13.7" ECU_ADDRESS 0x60000BA8 /end MEASUREMENT
/begin MEASUREMENT OilSwmpT_tEngOffTiCoeff "Engine off time coefficient temperature to calculate initial oil temperature" SWORD Temp_Cels 1 100 -3549.940 3003.560 FORMAT "%8.3" ECU_ADDRESS 0x60000BA4 /end MEASUREMENT
/begin MEASUREMENT OilSwmpT_tHeatCoeff "Map to claculate heat coefficient based on engine speed and intake air mass." UWORD RBPtCel_t_1p52588em5_1 1 100 0.00 0.9999847 FORMAT "%9.7" ECU_ADDRESS 0x60000BA2 /end MEASUREMENT
/begin MEASUREMENT OilSwmpT_tiEngOffTi "Engine off time calculated based on engine coolant temperature" UWORD t_q10 1 100 0.00 327670.0 FORMAT "%8.1" ECU_ADDRESS 0x60000BA0 /end MEASUREMENT
/begin MEASUREMENT OilSwmpT_tInit "Initial oil temperature for model value calculation of oil temperature" SWORD Temp_Cels 1 100 -3549.940 3003.560 FORMAT "%8.3" ECU_ADDRESS 0x60000B9E /end MEASUREMENT
/begin MEASUREMENT OilSwmpt_tIntkSnsr "selected intake air temperature" SWORD Temp_Cels 1 100 -3549.940 3003.560 FORMAT "%8.3" ECU_ADDRESS 0x60000B9C /end MEASUREMENT
/begin MEASUREMENT OilSwmpT_tMdl2 "Model value for Oil deterioration system: Temperature of oil in sump" SWORD Temp_Cels 1 100 -3549.940 3003.560 FORMAT "%8.3" ECU_ADDRESS 0x6000499A /end MEASUREMENT
/begin MEASUREMENT OilSwmpT_tMtrDisp "Estimated oil temperature for meter display" SWORD Temp_Cels 1 100 -3549.940 3003.560 FORMAT "%8.3" ECU_ADDRESS 0x60004994 /end MEASUREMENT
/begin MEASUREMENT OilSwmpT_tTmp "Temporary oil temperature for the model value calulation." SLONG RBPtCel_t_1p52588em5_1 1 100 -32768.0000000 32767.9999847 FORMAT "%13.7" ECU_ADDRESS 0x60000B98 /end MEASUREMENT
/begin MEASUREMENT PCUECU_ctRngPCU_MP "Alive counter measurement point" UBYTE OneToOne 1 100 0.00 255.0 FORMAT "%5.1" ECU_ADDRESS 0x70008BDA /end MEASUREMENT
/begin MEASUREMENT PhyMod_ctTqJDrvEnter "Filtered enginespeed for calcualtion of moment of inertia" UBYTE OneToOne 1 100 0.00 255.0 FORMAT "%5.1" ECU_ADDRESS 0x6000A30D /end MEASUREMENT
/begin MEASUREMENT PhyMod_dmFuCns "Volumetric flow of fuel in kg per h" SWORD InjMassPerTime 1 100 -327.6800 327.6700 FORMAT "%8.4" ECU_ADDRESS 0x60003648 /end MEASUREMENT
/begin MEASUREMENT PhyMod_dnEngDerFild "Filtered enginespeed for calcualtion of moment of inertia" SWORD nmotgrd_q2 1 100 -65536.00 65534.00 FORMAT "%8.2" ECU_ADDRESS 0x70002B86 /end MEASUREMENT
/begin MEASUREMENT PhyMod_dnEngDerFild_mp "Filtered enginespeed for calcualtion of moment of inertia" SWORD nmotgrd_q2 1 100 -65536.00 65534.00 FORMAT "%8.2" ECU_ADDRESS 0x70008BD8 /end MEASUREMENT
/begin MEASUREMENT PhyMod_dnEngDerUnFild "Unfiltered engine speed gradient" SWORD nmotgrd_q2 1 100 -65536.00 65534.00 FORMAT "%8.2" ECU_ADDRESS 0x6000D950 /end MEASUREMENT
/begin MEASUREMENT PhyMod_dnEngDerUnFild_mp "Unfiltered engine speed gradient" SWORD nmotgrd_q2 1 100 -65536.00 65534.00 FORMAT "%8.2" ECU_ADDRESS 0x70008BD6 /end MEASUREMENT
/begin MEASUREMENT PhyMod_jCmbEng "Moment of inertia of the combustion engine" UWORD j_q0p000153 1 100 0.00 9.999847 FORMAT "%8.6" ECU_ADDRESS 0x70002C6A /end MEASUREMENT
/begin MEASUREMENT PhyMod_jEng "Moment of inertia" SWORD Moment_Inertia 1 100 -327.6800 327.6700 FORMAT "%8.4" ECU_ADDRESS 0x70002C6C /end MEASUREMENT
/begin MEASUREMENT PhyMod_pwrClntEntry "heat insertion of engine into coolant agent" SWORD Pwr2 1 100 -617662.2 617643.4 FORMAT "%8.1" ECU_ADDRESS 0x6000496E /end MEASUREMENT
/begin MEASUREMENT PhyMod_pwrEgLoss "Power loss to exhaust gas" SLONG Pwr2 1 100 -40479113113.6 40479113094.7 FORMAT "%13.1" ECU_ADDRESS 0x6000136C /end MEASUREMENT
/begin MEASUREMENT PhyMod_pwrLos "Total energy loss dissipated in the engine" SLONG Pwr2 1 100 -40479113113.6 40479113094.7 FORMAT "%13.1" ECU_ADDRESS 0x60001C0C /end MEASUREMENT
/begin MEASUREMENT PhyMod_pwrTheo "Theoretically supplied power" SLONG Pwr2 1 100 -40479113113.6 40479113094.7 FORMAT "%13.1" ECU_ADDRESS 0x60001C08 /end MEASUREMENT
/begin MEASUREMENT PhyMod_pwrTheoloc "theoretical supplied power local variable" SLONG Pwr2 1 100 -40479113113.6 40479113094.7 FORMAT "%13.1" ECU_ADDRESS 0x500018BC /end MEASUREMENT
/begin MEASUREMENT PhyMod_tiDerEngFil_mp "Timeconstant for enginespeed filter" SWORD TimeDelay_s_Lin_16 1 100 0.000153 5.000000 FORMAT "%8.6" ECU_ADDRESS 0x70008BD4 /end MEASUREMENT
/begin MEASUREMENT PhyMod_tqJEng "Resulting torque from inertia" SWORD Trq 1 100 -3276.800 3276.700 FORMAT "%8.3" ECU_ADDRESS 0x70002C6E /end MEASUREMENT
/begin MEASUREMENT PID51_stFuTyp "current type of the combustion engine" UBYTE OneToOne 1 100 0.00 255.0 FORMAT "%5.1" ECU_ADDRESS 0x6000A011 /end MEASUREMENT
/begin MEASUREMENT PIDA6_lDstDrvngCyc "Distance traveled in the current driving cycle" ULONG RBPtCel_dst_0p1_2 1 100 0.00 429496729.500 FORMAT "%13.3" ECU_ADDRESS 0x50004D3C /end MEASUREMENT
/begin MEASUREMENT PIDA6_lDstStrt "Traveled distance at the start of the current driving cycle" ULONG RBPtCel_dst_0p1_2 1 100 0.00 429496729.500 FORMAT "%13.3" ECU_ADDRESS 0x6000CDF8 /end MEASUREMENT
/begin MEASUREMENT PIDA6_lTotDst "Total travelled distance for PIDA6" ULONG RBPtCel_dst_0p1_2 1 100 0.00 429496729.500 FORMAT "%13.3" ECU_ADDRESS 0x50004D40 /end MEASUREMENT
/begin MEASUREMENT PIDA6_lTotDstLstStored "Last value of total distance in EEP" ULONG RBPtCel_dst_0p1_2 1 100 0.00 429496729.500 FORMAT "%13.3" ECU_ADDRESS 0x60034750 /end MEASUREMENT
/begin MEASUREMENT PIDA6_lTotDstProtd "Total travelled distance for PIDA6 in Protected Ram" ULONG RBPtCel_dst_0p1_2 1 100 0.00 429496729.500 FORMAT "%13.3" ECU_ADDRESS 0x6003474C /end MEASUREMENT
/begin MEASUREMENT PIDA6_stEepOrder "Return value of EEP write function" UBYTE OneToOne 1 100 0.00 255.0 FORMAT "%5.1" ECU_ADDRESS 0x6000630D /end MEASUREMENT
/begin MEASUREMENT PIDA6_stEepWrite "State machine for direct write to EEP" UBYTE OneToOne 1 100 0.00 255.0 FORMAT "%5.1" ECU_ADDRESS 0x6000630C /end MEASUREMENT
/begin MEASUREMENT PIntkVUs_dpRaw "differential raw intake manifold pressure (gradient)" SWORD pgrd_q0p3125 1 100 -10240.00 10239.69 FORMAT "%8.2" ECU_ADDRESS 0x70001D4A /end MEASUREMENT
/begin MEASUREMENT PIntkVUs_flgIniFinshdB1 "alculation of pRawIni-raw-pressure during initialization finished, bank 1" UBYTE B_TRUE 1 100 0.00 1.00000000000 BIT_MASK 0x1 FORMAT "%13.11" ECU_ADDRESS 0x6000630B /end MEASUREMENT
/begin MEASUREMENT PIntkVUs_flgPRawIniVldB1 "Validity status for raw pressure before engine starts - Bank 1" UBYTE B_TRUE 1 100 0.00 1.00000000000 BIT_MASK 0x1 FORMAT "%13.11" ECU_ADDRESS 0x6000A16C /end MEASUREMENT
/begin MEASUREMENT PIntkVUs_flgPRawVldB1 "validity for raw pressure of intake manifold pressure bank1" UBYTE B_TRUE 1 100 0.00 1.00000000000 BIT_MASK 0x1 FORMAT "%13.11" ECU_ADDRESS 0x7000069A /end MEASUREMENT
/begin MEASUREMENT PIntkVUs_flgPRawVldLocSynBasdB1 "Validity of the rawsignal of manifold pressure (synchronous raster, local variable) bank1" UBYTE B_TRUE 1 100 0.00 1.00000000000 BIT_MASK 0x1 FORMAT "%13.11" ECU_ADDRESS 0x70000149 /end MEASUREMENT
/begin MEASUREMENT PIntkVUs_flgPRawVldLocTiBasdB1 "Validity of the rawsignal of manifold pressure (timebased, local variable) bank1" UBYTE B_TRUE 1 100 0.00 1.00000000000 BIT_MASK 0x1 FORMAT "%13.11" ECU_ADDRESS 0x70000148 /end MEASUREMENT
/begin MEASUREMENT PIntkVUs_flgPRawVldTiBasdB1 "Validity for raw pressure of intake manifold pressure (timebased) bank1" UBYTE B_TRUE 1 100 0.00 1.00000000000 BIT_MASK 0x1 FORMAT "%13.11" ECU_ADDRESS 0x70000699 /end MEASUREMENT
/begin MEASUREMENT PIntkVUs_flgRngErrMaxLocSyn "raw high range signal flag(synchronous raster,local variable)" UBYTE B_TRUE 1 100 0.00 1.00000000000 BIT_MASK 0x1 FORMAT "%13.11" ECU_ADDRESS 0x600007A8 /end MEASUREMENT
/begin MEASUREMENT PIntkVUs_flgRngErrMaxLocTi "raw high range signal flag (timebased, local variable)" UBYTE B_TRUE 1 100 0.00 1.00000000000 BIT_MASK 0x1 FORMAT "%13.11" ECU_ADDRESS 0x6000A16B /end MEASUREMENT
/begin MEASUREMENT PIntkVUs_flgRngErrMaxSyn "raw high range signal flag (synchronous raster)" UBYTE B_TRUE 1 100 0.00 1.00000000000 BIT_MASK 0x1 FORMAT "%13.11" ECU_ADDRESS 0x500008B1 /end MEASUREMENT
/begin MEASUREMENT PIntkVUs_flgRngErrMaxTi "raw high range signal flag (timebased)" UBYTE B_TRUE 1 100 0.00 1.00000000000 BIT_MASK 0x1 FORMAT "%13.11" ECU_ADDRESS 0x6000A16A /end MEASUREMENT
/begin MEASUREMENT PIntkVUs_flgRngErrMinLocSyn "raw low range signal flag(synchronous raster,local variable)" UBYTE B_TRUE 1 100 0.00 1.00000000000 BIT_MASK 0x1 FORMAT "%13.11" ECU_ADDRESS 0x600007A9 /end MEASUREMENT
/begin MEASUREMENT PIntkVUs_flgRngErrMinLocTi "raw low range signal flag (timebased, local variable)" UBYTE B_TRUE 1 100 0.00 1.00000000000 BIT_MASK 0x1 FORMAT "%13.11" ECU_ADDRESS 0x6000A169 /end MEASUREMENT
/begin MEASUREMENT PIntkVUs_flgRngErrMinSyn "raw low range signal flag (synchronous raster)" UBYTE B_TRUE 1 100 0.00 1.00000000000 BIT_MASK 0x1 FORMAT "%13.11" ECU_ADDRESS 0x500008B2 /end MEASUREMENT
/begin MEASUREMENT PIntkVUs_flgRngErrMinTi "raw low range signal flag (timebased)" UBYTE B_TRUE 1 100 0.00 1.00000000000 BIT_MASK 0x1 FORMAT "%13.11" ECU_ADDRESS 0x6000A168 /end MEASUREMENT
/begin MEASUREMENT PIntkVUs_nrRawCnt "counter for number of raw values for averaging" ULONG OneToOne 1 100 0.00 4294967295.00 FORMAT "%13.2" ECU_ADDRESS 0x500005C4 /end MEASUREMENT
/begin MEASUREMENT PIntkVUs_nrRawCntSynBasd "counter for number of raw values for averaging (synchronous raster)" ULONG OneToOne 1 100 0.00 4294967295.00 FORMAT "%13.2" ECU_ADDRESS 0x70001750 /end MEASUREMENT
/begin MEASUREMENT PIntkVUs_nrRawCntTiBasd "counter for number of raw values for averaging (timebased)" ULONG OneToOne 1 100 0.00 4294967295.00 FORMAT "%13.2" ECU_ADDRESS 0x6000CDFC /end MEASUREMENT
/begin MEASUREMENT PIntkVUs_pRaw "Intake manifold pressure rawvalue" UWORD p_q0p078 1 100 0.00 5119.922 FORMAT "%8.3" ECU_ADDRESS 0x6000057A /end MEASUREMENT
/begin MEASUREMENT PIntkVUs_pRawB1 "Intake manifold pressure rawvalue - Bank 1" UWORD p_q0p078 1 100 0.00 5119.922 FORMAT "%8.3" ECU_ADDRESS 0x70001CC2 /end MEASUREMENT
/begin MEASUREMENT PIntkVUs_pRawIni "Raw pressure during initialization before engine starts" UWORD p_q0p078 1 100 0.00 5119.922 FORMAT "%8.3" ECU_ADDRESS 0x60004C70 /end MEASUREMENT
/begin MEASUREMENT PIntkVUs_pRawIniB1 "Raw pressure during initialization before engine starts - Bank 1" UWORD p_q0p078 1 100 0.00 5119.922 FORMAT "%8.3" ECU_ADDRESS 0x60004C6E /end MEASUREMENT
/begin MEASUREMENT PIntkVUs_pRawLocSynBasd "raw manifold pressure (synchronous raster,local variable)" UWORD p_q0p078 1 100 0.00 5119.922 FORMAT "%8.3" ECU_ADDRESS 0x5000065C /end MEASUREMENT
/begin MEASUREMENT PIntkVUs_pRawObd "Absolute Pressure not corrected for Freeze Frame and Mode 12" UWORD p_q0p078 1 100 0.00 5119.922 FORMAT "%8.3" ECU_ADDRESS 0x70001CC0 /end MEASUREMENT
/begin MEASUREMENT PIntkVUs_pRawOld "value old raw manifold pressure" UWORD p_q0p078 1 100 0.00 5119.922 FORMAT "%8.3" ECU_ADDRESS 0x5000065E /end MEASUREMENT
/begin MEASUREMENT PIntkVUs_pRawTiBasdB1 "Raw pressure - Syncbased - Bank 1" UWORD p_q0p078 1 100 0.00 5119.922 FORMAT "%8.3" ECU_ADDRESS 0x60004C6C /end MEASUREMENT
/begin MEASUREMENT PIntkVUs_stEdgRsChk "edge rise check status for correct calculation of pressure gradient while engine start" UBYTE B_TRUE 1 100 0.00 1.00000000000 BIT_MASK 0x1 FORMAT "%13.11" ECU_ADDRESS 0x5000086B /end MEASUREMENT
/begin MEASUREMENT PIntkVUs_stPresIniVld "Validity status for raw pressure before engine starts - Bank 1" UBYTE B_TRUE 1 100 0.00 1.00000000000 BIT_MASK 0x1 FORMAT "%13.11" ECU_ADDRESS 0x6000A167 /end MEASUREMENT
/begin MEASUREMENT PIntkVUs_stSRCVld "Signal range check valid status" UBYTE B_TRUE 1 100 0.00 1.00000000000 BIT_MASK 0x1 FORMAT "%13.11" ECU_ADDRESS 0x500008B3 /end MEASUREMENT
/begin MEASUREMENT PIntkVUs_tiSegADCData "Cylinder segment time used for addressing of curve for filtering of ADC data based voltage input" SWORD Time_s_1 1 100 -32.76800 32.76700 FORMAT "%8.5" ECU_ADDRESS 0x7000174E /end MEASUREMENT
/begin MEASUREMENT PIntkVUs_uRawAvrgSynBasd "raw voltage average of manifold pressure sensor (synchronous raster)" UWORD Volt_q0p00007629 1 100 0.00 4.999665 FORMAT "%8.6" ECU_ADDRESS 0x50000660 /end MEASUREMENT
/begin MEASUREMENT PIntkVUs_uRawAvrgTiBasd "raw voltage average of manifold pressure sensor (timebased)" UWORD Volt_q0p00007629 1 100 0.00 4.999665 FORMAT "%8.6" ECU_ADDRESS 0x6000D94E /end MEASUREMENT
/begin MEASUREMENT PIntkVUs_uRawFlt "filtered raw voltage of manifold pressure sensor" UWORD Volt_q0p00007629 1 100 0.00 4.999665 FORMAT "%8.6" ECU_ADDRESS 0x7000174C /end MEASUREMENT
/begin MEASUREMENT PIntkVUs_uRawSum "raw voltage sum of manifold pressure sensor" ULONG Volt_q0p00007629 1 100 0.00 327663.054936 FORMAT "%13.6" ECU_ADDRESS 0x500005C8 /end MEASUREMENT
/begin MEASUREMENT PIntkVUs_uRawSumSynBasd "raw voltage sum of manifold pressure sensor (synchronous raster)" ULONG Volt_q0p00007629 1 100 0.00 327663.054936 FORMAT "%13.6" ECU_ADDRESS 0x70001748 /end MEASUREMENT
/begin MEASUREMENT PIntkVUs_uRawSumTiBasd "raw voltage sum of manifold pressure sensor (timebased)" ULONG Volt_q0p00007629 1 100 0.00 327663.054936 FORMAT "%13.6" ECU_ADDRESS 0x70002A7C /end MEASUREMENT
/begin MEASUREMENT PIntkVUs_uRawUnFlt "unfiltered raw voltage of manifold pressure sensor" UWORD Volt_q0p00007629 1 100 0.00 4.999665 FORMAT "%8.6" ECU_ADDRESS 0x70001CBE /end MEASUREMENT
/begin MEASUREMENT psini_w_msg "Raw pressure before engine start in the intake manifold" UWORD p_q0p039 1 100 0.00 2559.961 FORMAT "%8.3" ECU_ADDRESS 0x6000E324 /end MEASUREMENT
/begin MEASUREMENT PSPCtlG_bEngCyclStSp "Condition to stop the Cyclic activation of EKP pump during Startstop" UBYTE B_TRUE 1 100 0.00 1.00000000000 BIT_MASK 0x1 FORMAT "%13.11" ECU_ADDRESS 0x600000D0 /end MEASUREMENT
/begin MEASUREMENT PSPCtl_bEngSpdDet "condition engine speed detected for control of the PSP" UBYTE B_TRUE 1 100 0.00 1.00000000000 BIT_MASK 0x1 FORMAT "%13.11" ECU_ADDRESS 0x600000CF /end MEASUREMENT
/begin MEASUREMENT PSPCtl_bEngStop "condition PSP control when engine in stop phase" UBYTE B_TRUE 1 100 0.00 1.00000000000 BIT_MASK 0x1 FORMAT "%13.11" ECU_ADDRESS 0x600000CE /end MEASUREMENT
/begin MEASUREMENT PSPCtl_bPreRun "condition PSP pre-run" UBYTE B_TRUE 1 100 0.00 1.00000000000 BIT_MASK 0x1 FORMAT "%13.11" ECU_ADDRESS 0x600000CD /end MEASUREMENT
/begin MEASUREMENT PSPCtl_bPreRunEnbl "condition PSP pre-run enabled" UBYTE B_TRUE 1 100 0.00 1.00000000000 BIT_MASK 0x1 FORMAT "%13.11" ECU_ADDRESS 0x600000CC /end MEASUREMENT
/begin MEASUREMENT PSPCtl_bPreRunLck "condition PSP pre-run locked" UBYTE B_TRUE 1 100 0.00 1.00000000000 BIT_MASK 0x1 FORMAT "%13.11" ECU_ADDRESS 0x600000CB /end MEASUREMENT
/begin MEASUREMENT PSPCtl_bPSPDisbl "condition PSP control disabled" UBYTE B_TRUE 1 100 0.00 1.00000000000 BIT_MASK 0x1 FORMAT "%13.11" ECU_ADDRESS 0x600000CA /end MEASUREMENT
/begin MEASUREMENT PSPCtl_bPSPXPreDrv "condition extend PreDrv" UBYTE B_TRUE 1 100 0.00 1.00000000000 BIT_MASK 0x1 FORMAT "%13.11" ECU_ADDRESS 0x600000C9 /end MEASUREMENT
/begin MEASUREMENT PSPCtl_bShOffPSP "condition PSP control was locked (e.g. crash)" UBYTE B_TRUE 1 100 0.00 1.00000000000 BIT_MASK 0x1 FORMAT "%13.11" ECU_ADDRESS 0x60034984 /end MEASUREMENT
/begin MEASUREMENT PSPCtl_ctPreRun "number of PSP pre-runs without reaching end of start" UBYTE OneToOne 1 100 0.00 255.0 FORMAT "%5.1" ECU_ADDRESS 0x60036327 /end MEASUREMENT
/begin MEASUREMENT PSPCtl_flgPwrOnRst "Power on reset" UBYTE B_TRUE 1 100 0.00 1.00000000000 BIT_MASK 0x1 FORMAT "%13.11" ECU_ADDRESS 0x600000C8 /end MEASUREMENT
/begin MEASUREMENT PSPCtl_tiPreRun "time of PSP pre-run" UWORD t_q0p01 1 100 0.00 655.3500 FORMAT "%8.4" ECU_ADDRESS 0x60000B94 /end MEASUREMENT
/begin MEASUREMENT PSP_st "Status information for activating the pre-supply pump (1=on/0=off)" UBYTE OneToOne 1 100 0.00 255.0 FORMAT "%5.1" ECU_ADDRESS 0x60000DDE /end MEASUREMENT
/begin MEASUREMENT PSP_stActv_mp "Request for PSP activation" UBYTE B_TRUE 1 100 0.00 1.00000000000 BIT_MASK 0x1 FORMAT "%13.11" ECU_ADDRESS 0x70008BD2 /end MEASUREMENT
/begin MEASUREMENT PSP_stDetSleep "state for detection of power on" ULONG OneToOne 1 100 0.00 4294967295.00 FORMAT "%13.2" ECU_ADDRESS 0x7003AB8C /end MEASUREMENT
/begin MEASUREMENT PSP_stPs "Status signal for actuating the power stage of the electric supply pump" UBYTE OneToOne 1 100 0.00 255.0 FORMAT "%5.1" ECU_ADDRESS 0x60000B0C /end MEASUREMENT
/begin MEASUREMENT psrrff_w_msg "intake manifold pressure (absolute) not corrected for Freeze Frame and Mode $1$2" UWORD p_q0p078 1 100 0.00 5119.922 FORMAT "%8.3" ECU_ADDRESS 0x70001C5E /end MEASUREMENT
/begin MEASUREMENT psrr_w_msg "intake manifold pressure (absolute) not corrected" UWORD p_q0p078 1 100 0.00 5119.922 FORMAT "%8.3" ECU_ADDRESS 0x6000066C /end MEASUREMENT
/begin MEASUREMENT PT2ME_numLstGear "previous gear" SBYTE OneToOne 1 100 -128.0 127.0 FORMAT "%5.1" ECU_ADDRESS 0x6000E429 /end MEASUREMENT
/begin MEASUREMENT PtCoornDyn_flgGenericLimnActvDes "Flag for active status of generic priority limitation and limitation" UBYTE B_TRUE 1 100 0.00 1.00000000000 BIT_MASK 0x1 FORMAT "%13.11" ECU_ADDRESS 0x6000A159 /end MEASUREMENT
/begin MEASUREMENT PtCoornDyn_flgSpdCtrlDecIntvOvrd "A decreasing intervention should be overwritten by the speed control demand" UBYTE B_TRUE 1 100 0.00 1.00000000000 BIT_MASK 0x1 FORMAT "%13.11" ECU_ADDRESS 0x6000A158 /end MEASUREMENT
/begin MEASUREMENT PtCoornDyn_flgStabyIntvActvDes "Status stability interventions active" UBYTE B_TRUE 1 100 0.00 1.00000000000 BIT_MASK 0x1 FORMAT "%13.11" ECU_ADDRESS 0x6000A157 /end MEASUREMENT
/begin MEASUREMENT PtCoornDyn_flgStabyIntvDecActvDes "Status decreasing stability intervention active" UBYTE B_TRUE 1 100 0.00 1.00000000000 BIT_MASK 0x1 FORMAT "%13.11" ECU_ADDRESS 0x6000A156 /end MEASUREMENT
/begin MEASUREMENT PtCoornDyn_flgStabyIntvIncActvDes "Status increasing stability intervention active" UBYTE B_TRUE 1 100 0.00 1.00000000000 BIT_MASK 0x1 FORMAT "%13.11" ECU_ADDRESS 0x6000A155 /end MEASUREMENT
/begin MEASUREMENT PtCoornDyn_flgTrsmIntvActvDes "transmission intervention active" UBYTE B_TRUE 1 100 0.00 1.00000000000 BIT_MASK 0x1 FORMAT "%13.11" ECU_ADDRESS 0x6000A154 /end MEASUREMENT
/begin MEASUREMENT PtCoornDyn_flgTrsmIntvDecActvDes "decreasing transmission intervention active" UBYTE B_TRUE 1 100 0.00 1.00000000000 BIT_MASK 0x1 FORMAT "%13.11" ECU_ADDRESS 0x6000A153 /end MEASUREMENT
/begin MEASUREMENT PtCoornDyn_flgTrsmIntvIncActvDes "increasing transmission intervention active" UBYTE B_TRUE 1 100 0.00 1.00000000000 BIT_MASK 0x1 FORMAT "%13.11" ECU_ADDRESS 0x6000A152 /end MEASUREMENT
/begin MEASUREMENT PtCoornDyn_stIntvLead "Status of intervention on lead path (consist of engine torque only)" UBYTE OneToOne 1 100 0.00 255.0 FORMAT "%5.1" ECU_ADDRESS 0x6000A30C /end MEASUREMENT
/begin MEASUREMENT PtCoornDyn_tqCluDecIntvMinLimn "Minimum limit for decreasing intervention" SWORD Trq 1 100 -3276.800 3276.700 FORMAT "%8.3" ECU_ADDRESS 0x60003646 /end MEASUREMENT
/begin MEASUREMENT PtCoornDyn_tqCluDecIntvMinLimnLead "minimum allowable torque for decreasing interventions" SWORD Trq 1 100 -3276.800 3276.700 FORMAT "%8.3" ECU_ADDRESS 0x60003638 /end MEASUREMENT
/begin MEASUREMENT PtCoornDyn_tqCluDes "Filtered and limited propulsion torque with all interventions for total desired torque path on clutch level" SWORD Trq 1 100 -3276.800 3276.700 FORMAT "%8.3" ECU_ADDRESS 0x60004F7E /end MEASUREMENT
/begin MEASUREMENT PtCoornDyn_tqCluDesGenericLimn "generic limitation torque coordinated with minimum possible torque" SWORD Trq 1 100 -3276.800 3276.700 FORMAT "%8.3" ECU_ADDRESS 0x60004F7C /end MEASUREMENT
/begin MEASUREMENT PtCoornDyn_tqCluDesWithMeclLimn "Filtered torque limited with SpdGov mechanical limits" SWORD Trq 1 100 -3276.800 3276.700 FORMAT "%8.3" ECU_ADDRESS 0x60004F7A /end MEASUREMENT
/begin MEASUREMENT PtCoornDyn_tqCluDesWoIntv "Filtered and limited propulsion torque without any interventions for total desired torque path on clutch level" SWORD Trq 1 100 -3276.800 3276.700 FORMAT "%8.3" ECU_ADDRESS 0x60004F78 /end MEASUREMENT
/begin MEASUREMENT PtCoornDyn_tqCluDesWoTrsmIntv "Filtered and limited propulsion torque without transmission intervention for total desired torque path on clutch level" SWORD Trq 1 100 -3276.800 3276.700 FORMAT "%8.3" ECU_ADDRESS 0x60004F76 /end MEASUREMENT
/begin MEASUREMENT PtCoornDyn_tqCluLeadAftStabyIntvInc_MP "Torque at clutch level on lead path after stability increase intervention coordination" SWORD Trq 1 100 -3276.800 3276.700 FORMAT "%8.3" ECU_ADDRESS 0x70008BD0 /end MEASUREMENT
/begin MEASUREMENT PtCoornDyn_tqCluLeadAftTrsmIntvDec_MP "Decrease transmission intervention torque at clutch level on lead path after ramp" SWORD Trq 1 100 -3276.800 3276.700 FORMAT "%8.3" ECU_ADDRESS 0x70008BCE /end MEASUREMENT
/begin MEASUREMENT PtCoornDyn_tqCluLeadBefIntvCoorn "Desired filitered demand torque before limitation and intervention" SWORD Trq 1 100 -3276.800 3276.700 FORMAT "%8.3" ECU_ADDRESS 0x60003636 /end MEASUREMENT
/begin MEASUREMENT PtCoornDyn_tqCluLeadDesGenericLimn "Desired generic limitation torque" SWORD Trq 1 100 -3276.800 3276.700 FORMAT "%8.3" ECU_ADDRESS 0x60004F74 /end MEASUREMENT
/begin MEASUREMENT PtCoornDyn_tqCluLeadGenericLimn "Desired generic limitation torque at lead path (consist of engine torque only)" SWORD Trq 1 100 -3276.800 3276.700 FORMAT "%8.3" ECU_ADDRESS 0x60004F72 /end MEASUREMENT
/begin MEASUREMENT PtCoornDyn_tqCluLeadStabyIntv "Intervention torque required at clutch level on lead path (consist of engine torque only) after considering stability intervention" SWORD Trq 1 100 -3276.800 3276.700 FORMAT "%8.3" ECU_ADDRESS 0x60004F70 /end MEASUREMENT
/begin MEASUREMENT PtCoornDyn_tqCluLeadStabyIntvDecAftRamp_MP "Decrease stability intervention torque at clutch level on lead path after ramp" SWORD Trq 1 100 -3276.800 3276.700 FORMAT "%8.3" ECU_ADDRESS 0x70008BCC /end MEASUREMENT
/begin MEASUREMENT PtCoornDyn_tqCluLeadStabyIntvDec_MP "Torque at clutch level on lead path after stability decrease intervention coordination" SWORD Trq 1 100 -3276.800 3276.700 FORMAT "%8.3" ECU_ADDRESS 0x70008BCA /end MEASUREMENT
/begin MEASUREMENT PtCoornDyn_tqCluLeadStabyIntvInc_MP "Torque at clutch level on lead path after stability increase intervention coordination" SWORD Trq 1 100 -3276.800 3276.700 FORMAT "%8.3" ECU_ADDRESS 0x70008BC8 /end MEASUREMENT
/begin MEASUREMENT PtCoornDyn_tqCluLeadTrsmIntv "Intervention torque required at clutch level on lead path after considering stability and transmission interventions" SWORD Trq 1 100 -3276.800 3276.700 FORMAT "%8.3" ECU_ADDRESS 0x60004F6E /end MEASUREMENT
/begin MEASUREMENT PtCoornDyn_tqCluLeadTrsmIntvDecAftRamp_MP "Decrease Transmission intervention torque at clutch level on lead path after ramp" SWORD Trq 1 100 -3276.800 3276.700 FORMAT "%8.3" ECU_ADDRESS 0x70008BC6 /end MEASUREMENT
/begin MEASUREMENT PtCoornDyn_tqCluLeadTrsmIntvDec_MP "Decrease transmission intervention torque at clutch level on lead path after ramp coordination" SWORD Trq 1 100 -3276.800 3276.700 FORMAT "%8.3" ECU_ADDRESS 0x70008BC4 /end MEASUREMENT
/begin MEASUREMENT PtCoornDyn_tqCluLeadTrsmIntvInc "Generic priority limitaion coordinated with transmission increasing intervention at lead path" SWORD Trq 1 100 -3276.800 3276.700 FORMAT "%8.3" ECU_ADDRESS 0x60004F6C /end MEASUREMENT
/begin MEASUREMENT PtCoornDyn_tqCluLeadTrsmIntvInc_MP "Torque at clutch level on lead path after transmission increase intervention coordination" SWORD Trq 1 100 -3276.800 3276.700 FORMAT "%8.3" ECU_ADDRESS 0x70008BC2 /end MEASUREMENT
/begin MEASUREMENT PtCoornDyn_tqCluMax "max. total torque for increasing interventions on set path" SWORD Trq 1 100 -3276.800 3276.700 FORMAT "%8.3" ECU_ADDRESS 0x60003644 /end MEASUREMENT
/begin MEASUREMENT PtCoornDyn_tqCluMin "lower torque limit for decreasing stability and transmission interventions" SWORD Trq 1 100 -3276.800 3276.700 FORMAT "%8.3" ECU_ADDRESS 0x60003642 /end MEASUREMENT
/begin MEASUREMENT PtCoornDyn_tqCluStabyIntvDecLimDes "limited decreasing stability intervention torque including speed controller torque" SWORD Trq 1 100 -3276.800 3276.700 FORMAT "%8.3" ECU_ADDRESS 0x60004F6A /end MEASUREMENT
/begin MEASUREMENT PtCoornDyn_tqCluStabyIntvInc "sum driver demand with increasing stability intervention" SWORD Trq 1 100 -3276.800 3276.700 FORMAT "%8.3" ECU_ADDRESS 0x60003640 /end MEASUREMENT
/begin MEASUREMENT PtCoornDyn_tqCluStabyIntvIncLimDes "limited increasing stability intervention torque for des path" SWORD Trq 1 100 -3276.800 3276.700 FORMAT "%8.3" ECU_ADDRESS 0x60004F68 /end MEASUREMENT
/begin MEASUREMENT PtCoornDyn_tqCluTrsmIntvDecLimDes "limited decreasing transmission intervention torque including speed controller torque" SWORD Trq 1 100 -3276.800 3276.700 FORMAT "%8.3" ECU_ADDRESS 0x60004F66 /end MEASUREMENT
/begin MEASUREMENT PtCoornDyn_tqCluTrsmIntvDecLimDesWoIncStabyLimn "limited decreasing transmission intervention torque including speed controller torque without increasing stability limitation" SWORD Trq 1 100 -3276.800 3276.700 FORMAT "%8.3" ECU_ADDRESS 0x60004F64 /end MEASUREMENT
/begin MEASUREMENT PtCoornDyn_tqCluTrsmIntvIncLimDes "limited increasing transmission intervention torque for des path" SWORD Trq 1 100 -3276.800 3276.700 FORMAT "%8.3" ECU_ADDRESS 0x60004F62 /end MEASUREMENT
/begin MEASUREMENT PtCoornDyn_tqCrksftDecIntvMinLimn "minimum crankshaft torque limit for decreasing interventions" SWORD Trq 1 100 -3276.800 3276.700 FORMAT "%8.3" ECU_ADDRESS 0x6000363E /end MEASUREMENT
/begin MEASUREMENT PtCoornDyn_tqCrksftLead "Coordinated propulsion torque with all interventions for lead path at crankshaft level" SWORD Trq 1 100 -3276.800 3276.700 FORMAT "%8.3" ECU_ADDRESS 0x60004F60 /end MEASUREMENT
/begin MEASUREMENT PtCoornDyn_tqCrksftMin "minimum crankshaft torque of the system" SWORD Trq 1 100 -3276.800 3276.700 FORMAT "%8.3" ECU_ADDRESS 0x6000363C /end MEASUREMENT
/begin MEASUREMENT PtCoornDyn_tqDmdFromSpdGovr "torque demand from speed governor." SWORD Trq 1 100 -3276.800 3276.700 FORMAT "%8.3" ECU_ADDRESS 0x6000363A /end MEASUREMENT
/begin MEASUREMENT PtCoornDyn_tqDmdFromSpdGovrLead "torque demand from speed governor on lead path" SWORD Trq 1 100 -3276.800 3276.700 FORMAT "%8.3" ECU_ADDRESS 0x60003634 /end MEASUREMENT
/begin MEASUREMENT PTDist_cntrReIni "ReIni counter" UBYTE OneToOne 1 100 0.00 255.0 FORMAT "%5.1" ECU_ADDRESS 0x6000630A /end MEASUREMENT
/begin MEASUREMENT PTDist_flgIgnAgRelsDynEng "Status of powertrain demand for ignition angle release due to dynamic engine torque requirements, without external interventions" UBYTE B_TRUE 1 100 0.00 1.00000000000 BIT_MASK 0x1 FORMAT "%13.11" ECU_ADDRESS 0x6000A165 /end MEASUREMENT
/begin MEASUREMENT PTDist_flgIgnAgRelsNoRmp "Status of ignition angle release including external interventions for powertrain demand" UBYTE B_TRUE 1 100 0.00 1.00000000000 BIT_MASK 0x1 FORMAT "%13.11" ECU_ADDRESS 0x6000A164 /end MEASUREMENT
/begin MEASUREMENT PTDist_flgIgnAgRelsRmp "Status of Ignition angle release for powertrain demand" UBYTE B_TRUE 1 100 0.00 1.00000000000 BIT_MASK 0x1 FORMAT "%13.11" ECU_ADDRESS 0x6000A163 /end MEASUREMENT
/begin MEASUREMENT PTDist_flgLADIaRels "Flag that indicates that the Load Alteration Damper is active i.e. the Maximum torque for limitation by ASD reference filter is less than or equal to the Propulsion torque limited by stationanry limits" UBYTE B_TRUE 1 100 0.00 1.00000000000 BIT_MASK 0x1 FORMAT "%13.11" ECU_ADDRESS 0x60006309 /end MEASUREMENT
/begin MEASUREMENT PTDist_flgTqICESetMax "Flag to indicate that ICE cannot provide maximum torque with current air charge during drive off with clutch pedal" UBYTE B_TRUE 1 100 0.00 1.00000000000 BIT_MASK 0x1 FORMAT "%13.11" ECU_ADDRESS 0x6000A162 /end MEASUREMENT
/begin MEASUREMENT PTDist_tqCluSetStabyIntv "torque request on set path for combustion engine with stability interventions" SWORD Trq 1 100 -3276.800 3276.700 FORMAT "%8.3" ECU_ADDRESS 0x60004FCC /end MEASUREMENT
/begin MEASUREMENT PTDist_tqCluSetWoIntv "torque request on set path without interventions" SWORD Trq 1 100 -3276.800 3276.700 FORMAT "%8.3" ECU_ADDRESS 0x60004FCA /end MEASUREMENT
/begin MEASUREMENT PTDist_tqCrksftSet "Filtered and limited propulsion torque with all interventions for set path on crankshaft level" SWORD Trq 1 100 -3276.800 3276.700 FORMAT "%8.3" ECU_ADDRESS 0x60004FC8 /end MEASUREMENT
/begin MEASUREMENT PTDist_tqHiThdLeadFilActv "Upper calibratable torque threshold beyond which if input torque goes, ignition angle release due to dynamic torque requirements and ignition angle release with ramping is set , when the Demand for torque filtering in lead path is active." SWORD md_q0p1 1 100 -3276.800 3276.700 FORMAT "%8.3" ECU_ADDRESS 0x60003632 /end MEASUREMENT
/begin MEASUREMENT PTDist_tqIntvMin "minimum intervention torque" SWORD Trq 1 100 -3276.800 3276.700 FORMAT "%8.3" ECU_ADDRESS 0x60003630 /end MEASUREMENT
/begin MEASUREMENT PTDist_tqLoThdLeadFilActv "Lower calibratable torque threshold below which if input torque goes , the ignition angle release due to dynamic torque requirements and ignition angle release with ramping is reset, when the Demand for torque filtering in lead path is active." SWORD md_q0p1 1 100 -3276.800 3276.700 FORMAT "%8.3" ECU_ADDRESS 0x6000362E /end MEASUREMENT
/begin MEASUREMENT PthLead_bMonLim "Status active monitoring limitation level 1 for lead path" UBYTE B_TRUE 1 100 0.00 1.00000000000 BIT_MASK 0x1 FORMAT "%13.11" ECU_ADDRESS 0x60006308 /end MEASUREMENT
/begin MEASUREMENT PthLead_stActvMonLim "State of monitoring limitation" UBYTE OneToOne 1 100 0.00 255.0 FORMAT "%5.1" ECU_ADDRESS 0x6000A30B /end MEASUREMENT
/begin MEASUREMENT PthLead_stTrqResvActv "Condition: torque reserve active" UBYTE B_TRUE 1 100 0.00 1.00000000000 BIT_MASK 0x1 FORMAT "%13.11" ECU_ADDRESS 0x6000A150 /end MEASUREMENT
/begin MEASUREMENT PthLead_trqCHRef "Reference torque for the calculation of catalyser heating torque reserve" SWORD Trq 1 100 0.00 3276.700 FORMAT "%8.3" ECU_ADDRESS 0x6000362C /end MEASUREMENT
/begin MEASUREMENT PthLead_trqDes "Torque request for the calculation of torque reserves" SWORD Trq 1 100 0.00 3276.700 FORMAT "%8.3" ECU_ADDRESS 0x6000362A /end MEASUREMENT
/begin MEASUREMENT PthLead_trqDesRef "Reference ignition torque lead path including lead part of idle-speed (pullaway) controller" SWORD Trq 1 100 0.00 3276.700 FORMAT "%8.3" ECU_ADDRESS 0x60003628 /end MEASUREMENT
/begin MEASUREMENT PthLead_trqInrLead "Inner torque lead value" SWORD Trq 1 100 0.00 3276.700 FORMAT "%8.3" ECU_ADDRESS 0x60004F5E /end MEASUREMENT
/begin MEASUREMENT PthLead_trqInrNoMon "Lead torque before monitoring level 1" SWORD Trq 1 100 0.00 3276.700 FORMAT "%8.3" ECU_ADDRESS 0x6000E2AC /end MEASUREMENT
/begin MEASUREMENT PthLead_trqResv "Requested torque reserve" SWORD Trq 1 100 0.00 3276.700 FORMAT "%8.3" ECU_ADDRESS 0x6000E2AE /end MEASUREMENT
/begin MEASUREMENT PthLead_trqResvEta "Torque reserve due to efficiency requests" SWORD Trq 1 100 0.00 3276.700 FORMAT "%8.3" ECU_ADDRESS 0x6000D952 /end MEASUREMENT
/begin MEASUREMENT PthLead_trqResvRel "Maximum relative torque reserves" SWORD Trq 1 100 0.00 3276.700 FORMAT "%8.3" ECU_ADDRESS 0x6000E2B0 /end MEASUREMENT
/begin MEASUREMENT PthLead_trqResvRelA "relative torque reserve type A realized on engine" SWORD Trq 1 100 0.00 3276.700 FORMAT "%8.3" ECU_ADDRESS 0x60004F5C /end MEASUREMENT
/begin MEASUREMENT PthLead_trqResvRelB "relative torque reserve type B" SWORD Trq 1 100 0.00 3276.700 FORMAT "%8.3" ECU_ADDRESS 0x60004F5A /end MEASUREMENT
/begin MEASUREMENT PThrVlvUs_facNom "normalization factor pressure upstream throttle valve" UWORD fak_uw_b8 1 100 0.00 7.999878 FORMAT "%8.6" ECU_ADDRESS 0x50000778 /end MEASUREMENT
/begin MEASUREMENT PThrVlvUs_facNomB1 "normalization factor pressure upstream throttle valve bank1" UWORD fak_uw_b8 1 100 0.00 7.999878 FORMAT "%8.6" ECU_ADDRESS 0x70001CBC /end MEASUREMENT
/begin MEASUREMENT PThrVlvUs_facNrmPEnv "Ratio: boost pressure upstream throttle valve to ambient pressure" UWORD fak_q0p000122 1 100 0.00 7.999878 FORMAT "%8.6" ECU_ADDRESS 0x5000077A /end MEASUREMENT
/begin MEASUREMENT PThrVlvUs_flgPVld "Pressure value valid status" UBYTE B_TRUE 1 100 0.00 1.00000000000 BIT_MASK 0x1 FORMAT "%13.11" ECU_ADDRESS 0x7000068D /end MEASUREMENT
/begin MEASUREMENT PThrVlvUs_flgPVldB1 "Pressure value valid status bank1" UBYTE B_TRUE 1 100 0.00 1.00000000000 BIT_MASK 0x1 FORMAT "%13.11" ECU_ADDRESS 0x7000068C /end MEASUREMENT
/begin MEASUREMENT PThrVlvUs_p "pressure upstream throttle valve, averaged value" UWORD p_q0p078 1 100 0.00 5119.922 FORMAT "%8.3" ECU_ADDRESS 0x5000077C /end MEASUREMENT
/begin MEASUREMENT PThrVlvUs_pB1 "pressure upstream throttle valve bank1" UWORD p_q0p078 1 100 0.00 5119.922 FORMAT "%8.3" ECU_ADDRESS 0x5000077E /end MEASUREMENT
/begin MEASUREMENT PThrVlvUs_pMax "maximum pressure upstream throttle valve, averaged value" UWORD p_q0p078 1 100 0.00 5119.922 FORMAT "%8.3" ECU_ADDRESS 0x50000780 /end MEASUREMENT
/begin MEASUREMENT PThrVlvUs_pMaxB1 "maximum pressure upstream throttle valve bank1" UWORD p_q0p078 1 100 0.00 5119.922 FORMAT "%8.3" ECU_ADDRESS 0x70001CBA /end MEASUREMENT
/begin MEASUREMENT PThrVlvUs_pMin "minimum pressure upstream throttle valve, averaged value" UWORD p_q0p078 1 100 0.00 5119.922 FORMAT "%8.3" ECU_ADDRESS 0x70001CB8 /end MEASUREMENT
/begin MEASUREMENT PThrVlvUs_pMinB1 "minimum pressure upstream throttle valve bank1" UWORD p_q0p078 1 100 0.00 5119.922 FORMAT "%8.3" ECU_ADDRESS 0x70001CB6 /end MEASUREMENT
/begin MEASUREMENT PthSet_bCylIndivFCOAft "Condition cylinder individual fuel cut-off at restart after overrun fuel cut-off" UBYTE B_TRUE 1 100 0.00 1.00000000000 BIT_MASK 0x1 FORMAT "%13.11" ECU_ADDRESS 0x6000A14F /end MEASUREMENT
/begin MEASUREMENT PthSet_bCylIndivFCOBef "Condition cylinder individual fuel cut-off at transition into overrun fuel cut-off" UBYTE B_TRUE 1 100 0.00 1.00000000000 BIT_MASK 0x1 FORMAT "%13.11" ECU_ADDRESS 0x6000A14E /end MEASUREMENT
/begin MEASUREMENT PthSet_bEnaCylIndivFCO "Enable cylinder individual fuel cut-off" UBYTE B_TRUE 1 100 0.00 1.00000000000 BIT_MASK 0x1 FORMAT "%13.11" ECU_ADDRESS 0x60006307 /end MEASUREMENT
/begin MEASUREMENT PthSet_bEnaFCO "Torque threshold for cylinder individual fuel cut-off reached" UBYTE B_TRUE 1 100 0.00 1.00000000000 BIT_MASK 0x1 FORMAT "%13.11" ECU_ADDRESS 0x6000A14D /end MEASUREMENT
/begin MEASUREMENT PthSet_bEnaIndivRes "Enable cylinderindividual resume after overrun" UBYTE B_TRUE 1 100 0.00 1.00000000000 BIT_MASK 0x1 FORMAT "%13.11" ECU_ADDRESS 0x6000A79C /end MEASUREMENT
/begin MEASUREMENT PthSet_bIAIntv "condition: ignition angle intervention of torque structure" UBYTE B_TRUE 1 100 0.00 1.00000000000 BIT_MASK 0x1 FORMAT "%13.11" ECU_ADDRESS 0x50005DB6 /end MEASUREMENT
/begin MEASUREMENT PthSet_bIARlsMon "Ignition angle release due to monitoring level 1" UBYTE B_TRUE 1 100 0.00 1.00000000000 BIT_MASK 0x1 FORMAT "%13.11" ECU_ADDRESS 0x60006301 /end MEASUREMENT
/begin MEASUREMENT PthSet_bIARlsNoIntv "Ignition angle release not because of intervention" UBYTE B_TRUE 1 100 0.00 1.00000000000 BIT_MASK 0x1 FORMAT "%13.11" ECU_ADDRESS 0x7000068B /end MEASUREMENT
/begin MEASUREMENT PthSet_bIARlsNoTraIntv "IA-release excluding gear intervention" UBYTE B_TRUE 1 100 0.00 1.00000000000 BIT_MASK 0x1 FORMAT "%13.11" ECU_ADDRESS 0x7000068A /end MEASUREMENT
/begin MEASUREMENT PthSet_bIARlsWiMon "Ignition angle release including monitoring level 1" UBYTE B_TRUE 1 100 0.00 1.00000000000 BIT_MASK 0x1 FORMAT "%13.11" ECU_ADDRESS 0x60006300 /end MEASUREMENT
/begin MEASUREMENT PthSet_bIARlsWoDstC "Ignition angle release without disturbance control" UBYTE B_TRUE 1 100 0.00 1.00000000000 BIT_MASK 0x1 FORMAT "%13.11" ECU_ADDRESS 0x50005DB7 /end MEASUREMENT
/begin MEASUREMENT PthSet_bMonLimFCO "Monitoring level 1 active on cutoff path" UBYTE B_TRUE 1 100 0.00 1.00000000000 BIT_MASK 0x1 FORMAT "%13.11" ECU_ADDRESS 0x600062FF /end MEASUREMENT
/begin MEASUREMENT PthSet_bMonLimIA "Monitoring level 1 active on ignition path" UBYTE B_TRUE 1 100 0.00 1.00000000000 BIT_MASK 0x1 FORMAT "%13.11" ECU_ADDRESS 0x600062FE /end MEASUREMENT
/begin MEASUREMENT PthSet_bOvrRun "Condition: overrun fuel cut-off" UBYTE B_TRUE 1 100 0.00 1.00000000000 BIT_MASK 0x1 FORMAT "%13.11" ECU_ADDRESS 0x50005DB9 /end MEASUREMENT
/begin MEASUREMENT PthSet_bOvrRunCdnPrsnt "Local variable to store Over Run condition" UBYTE B_TRUE 1 100 0.00 1.00000000000 BIT_MASK 0x1 FORMAT "%13.11" ECU_ADDRESS 0x60006306 /end MEASUREMENT
/begin MEASUREMENT PthSet_bPhCO "Phase ""overrun fuel cutoff"" active" UBYTE B_TRUE 1 100 0.00 1.00000000000 BIT_MASK 0x1 FORMAT "%13.11" ECU_ADDRESS 0x60006305 /end MEASUREMENT
/begin MEASUREMENT PthSet_bUpShiftDly "Local variable to store Gear Up shift fuel cut off delay" UBYTE B_TRUE 1 100 0.00 1.00000000000 BIT_MASK 0x1 FORMAT "%13.11" ECU_ADDRESS 0x60006304 /end MEASUREMENT
/begin MEASUREMENT PthSet_dtqRmpIgnAgRls "Derivative torque from ignition angle release ramp" SLONG RmpTrq 1 100 -3276800.00000 3276799.99847 FORMAT "%13.5" ECU_ADDRESS 0x50004D44 /end MEASUREMENT
/begin MEASUREMENT PthSet_flgIgnAgRlsRmpActvn "Flag for ignition angle release ramp active" UBYTE B_TRUE 1 100 0.00 1.00000000000 BIT_MASK 0x1 FORMAT "%13.11" ECU_ADDRESS 0x50005DBB /end MEASUREMENT
/begin MEASUREMENT PthSet_stActvMonLim "State of monitoring limitation" UBYTE OneToOne 1 100 0.00 255.0 FORMAT "%5.1" ECU_ADDRESS 0x6000E42D /end MEASUREMENT
/begin MEASUREMENT PthSet_stCylIndivCtOff "Condition: cylinder individual cut-off" UBYTE B_TRUE 1 100 0.00 1.00000000000 BIT_MASK 0x1 FORMAT "%13.11" ECU_ADDRESS 0x50005DBD /end MEASUREMENT
/begin MEASUREMENT PthSet_stFcoDlyTmrtmp "used for functioning of fuel cut-off delay timer during gear shifts" UBYTE B_TRUE 1 100 0.00 1.00000000000 BIT_MASK 0x1 FORMAT "%13.11" ECU_ADDRESS 0x60006303 /end MEASUREMENT
/begin MEASUREMENT PthSet_stIARls "condition: ignition angle release" UBYTE B_TRUE 1 100 0.00 1.00000000000 BIT_MASK 0x1 FORMAT "%13.11" ECU_ADDRESS 0x70001BEA /end MEASUREMENT
/begin MEASUREMENT PthSet_stIgnAgRls "Status of Ignition angle release" UWORD OneToOne 1 100 0.00 65535.00 FORMAT "%8.2" ECU_ADDRESS 0x60004C5E /end MEASUREMENT
/begin MEASUREMENT PthSet_stOvrRun "Condition: overrun fuel cut-off" UBYTE B_TRUE 1 100 0.00 1.00000000000 BIT_MASK 0x1 FORMAT "%13.11" ECU_ADDRESS 0x50005DBE /end MEASUREMENT
/begin MEASUREMENT PthSet_stOvrRunEna "Condition: overrun fuel cut-off possible due to torque demand as well as other demands" UBYTE B_TRUE 1 100 0.00 1.00000000000 BIT_MASK 0x1 FORMAT "%13.11" ECU_ADDRESS 0x6000A79B /end MEASUREMENT
/begin MEASUREMENT PthSet_stOvrRunPhActv "Condition: phase A or phase B active at overrun fuel cut-off" UBYTE B_TRUE 1 100 0.00 1.00000000000 BIT_MASK 0x1 FORMAT "%13.11" ECU_ADDRESS 0x6000A79A /end MEASUREMENT
/begin MEASUREMENT PthSet_stRampActv "Status to indicates ramp activation" UBYTE B_TRUE 1 100 0.00 1.00000000000 BIT_MASK 0x1 FORMAT "%13.11" ECU_ADDRESS 0x70001745 /end MEASUREMENT
/begin MEASUREMENT PthSet_stRampPosn "Status to indicate Ramp position" UBYTE B_TRUE 1 100 0.00 1.00000000000 BIT_MASK 0x1 FORMAT "%13.11" ECU_ADDRESS 0x70001744 /end MEASUREMENT
/begin MEASUREMENT PthSet_stToffDlytmp "delayed gear upshift status introduced by fuel cut-off delay timer during gear shifts" UBYTE B_TRUE 1 100 0.00 1.00000000000 BIT_MASK 0x1 FORMAT "%13.11" ECU_ADDRESS 0x60006302 /end MEASUREMENT
/begin MEASUREMENT PthSet_stTrgFCO "Status word to trigger the cylinder individual cut-off" UBYTE OneToOne 1 100 0.00 255.0 FORMAT "%5.1" ECU_ADDRESS 0x6000E42E /end MEASUREMENT
/begin MEASUREMENT PthSet_tqIARIsRamp "Desire Torque on ignition angle release ramp" SWORD Trq 1 100 0.00 3276.700 FORMAT "%8.3" ECU_ADDRESS 0x70001742 /end MEASUREMENT
/begin MEASUREMENT PthSet_tqInnrLimdRamp "Ramping factor for Desired torque for set path limited on basic limits" SWORD Trq 1 100 0.00 3276.700 FORMAT "%8.3" ECU_ADDRESS 0x70001740 /end MEASUREMENT
/begin MEASUREMENT PthSet_trqInrBsMinFCO_mp "Modified indicated basic torque, lower limit, for release of fuel cutoff" SWORD Trq 1 100 0.00 3276.700 FORMAT "%8.3" ECU_ADDRESS 0x70008BC0 /end MEASUREMENT
/begin MEASUREMENT PthSet_trqInrCtOff "set torque for cut-off path" SWORD Trq 1 100 0.00 3276.700 FORMAT "%8.3" ECU_ADDRESS 0x6000E2B2 /end MEASUREMENT
/begin MEASUREMENT PthSet_trqInrDes "Coordinated torque request before torque range limitation" SWORD Trq 1 100 0.00 3276.700 FORMAT "%8.3" ECU_ADDRESS 0x70002C72 /end MEASUREMENT
/begin MEASUREMENT PthSet_trqInrDes_mp "Coordinated torque request before torque range limitation in syncronous path" UWORD md_q0p1 1 100 0.00 6553.500 FORMAT "%8.3" ECU_ADDRESS 0x70008BBE /end MEASUREMENT
/begin MEASUREMENT PthSet_trqInrIA "Resulting set torque for ignition angle path" SWORD Trq 1 100 0.00 3276.700 FORMAT "%8.3" ECU_ADDRESS 0x6000E2B6 /end MEASUREMENT
/begin MEASUREMENT PthSet_trqInrIABef "Resulting set torque for ignition angle path before monitoring level 1" SWORD Trq 1 100 0.00 3276.700 FORMAT "%8.3" ECU_ADDRESS 0x50005B02 /end MEASUREMENT
/begin MEASUREMENT PthSet_trqInrLim "Limited torque request for set path" SWORD Trq 1 100 0.00 3276.700 FORMAT "%8.3" ECU_ADDRESS 0x60004F58 /end MEASUREMENT
/begin MEASUREMENT PthSet_trqInrLtd "Desired torque for set path limited on basic limits" SWORD Trq 1 100 0.00 3276.700 FORMAT "%8.3" ECU_ADDRESS 0x50005B06 /end MEASUREMENT
/begin MEASUREMENT PthSet_trqInrLtdIA "Desired torque for ignition path limited on basic limits" SWORD Trq 1 100 0.00 3276.700 FORMAT "%8.3" ECU_ADDRESS 0x500054AE /end MEASUREMENT
/begin MEASUREMENT PthSet_trqInrLtdWoDstC_mp "Inner set path torque limited on basic limits without anti-jerk intervention" SWORD md_q0p1 1 100 0.00 3276.700 FORMAT "%8.3" ECU_ADDRESS 0x70008BBC /end MEASUREMENT
/begin MEASUREMENT PthSet_trqInrWoDstC "Set torque without disturbance control intervention" SWORD Trq 1 100 0.00 3276.700 FORMAT "%8.3" ECU_ADDRESS 0x6000E2B8 /end MEASUREMENT
/begin MEASUREMENT PthSet_trqInrWoDstCBef "Set torque without disturbance control intervention before monitoring level 1" SWORD Trq 1 100 0.00 3276.700 FORMAT "%8.3" ECU_ADDRESS 0x500054B0 /end MEASUREMENT
/begin MEASUREMENT PthSet_trqRmpIALck "Delta torque for ramp after withdrawal of ignition angle release" SWORD Trq 1 100 0.00 3276.700 FORMAT "%8.3" ECU_ADDRESS 0x6000E2BA /end MEASUREMENT
/begin MEASUREMENT PT_bAutoStrtRls "Enable bit for autostart from the point of view of the grip of the powertrain." UBYTE B_TRUE 1 100 0.00 1.00000000000 BIT_MASK 0x1 FORMAT "%13.11" ECU_ADDRESS 0x6000A161 /end MEASUREMENT
/begin MEASUREMENT PT_bClthSlip "The automated clutch is in a slip state / controlled operation and PT_bNoGrip = FALSE." UBYTE B_TRUE 1 100 0.00 1.00000000000 BIT_MASK 0x1 FORMAT "%13.11" ECU_ADDRESS 0x6000A160 /end MEASUREMENT
/begin MEASUREMENT PT_bClthSlipOpn "The automated clutch is in drive-off state and PT_bNoGrip = FALSE." UBYTE B_TRUE 1 100 0.00 1.00000000000 BIT_MASK 0x1 FORMAT "%13.11" ECU_ADDRESS 0x6000A15F /end MEASUREMENT
/begin MEASUREMENT PT_bConvSlip "The converter lockup clutch is controlled or is in controlled slip operation and PT_bNoGrip = FALSE." UBYTE B_TRUE 1 100 0.00 1.00000000000 BIT_MASK 0x1 FORMAT "%13.11" ECU_ADDRESS 0x6000A15E /end MEASUREMENT
/begin MEASUREMENT PT_bConvSlipClsd "The converter lockup clutch is almost closed, little slip, and PT_bNoGrip = FALSE." UBYTE B_TRUE 1 100 0.00 1.00000000000 BIT_MASK 0x1 FORMAT "%13.11" ECU_ADDRESS 0x6000A15D /end MEASUREMENT
/begin MEASUREMENT PT_bConvSlipOpn "The converter lockup clutch is open (converter in slip) and PT_bNoGrip = FALSE." UBYTE B_TRUE 1 100 0.00 1.00000000000 BIT_MASK 0x1 FORMAT "%13.11" ECU_ADDRESS 0x6000A15C /end MEASUREMENT
/begin MEASUREMENT PT_bDrvDmdActvWoIntv "Status of driver demand based on interventions active" UBYTE B_TRUE 1 100 0.00 1.00000000000 BIT_MASK 0x1 FORMAT "%13.11" ECU_ADDRESS 0x70000147 /end MEASUREMENT
/begin MEASUREMENT PT_bDrvDmdActvWoTrsmIntv "Status of driver demand based on transmission interventions active" UBYTE B_TRUE 1 100 0.00 1.00000000000 BIT_MASK 0x1 FORMAT "%13.11" ECU_ADDRESS 0x70000146 /end MEASUREMENT
/begin MEASUREMENT PT_bEngStopEna "Engine stop request of transmission" UBYTE B_TRUE 1 100 0.00 1.00000000000 BIT_MASK 0x1 FORMAT "%13.11" ECU_ADDRESS 0x70000692 /end MEASUREMENT
/begin MEASUREMENT PT_bEngStopReq "Stop request from Drive train" UBYTE B_TRUE 1 100 0.00 1.00000000000 BIT_MASK 0x1 FORMAT "%13.11" ECU_ADDRESS 0x70000691 /end MEASUREMENT
/begin MEASUREMENT PT_bEngStrtEna "PT enables engine start" UBYTE B_TRUE 1 100 0.00 1.00000000000 BIT_MASK 0x1 FORMAT "%13.11" ECU_ADDRESS 0x70000690 /end MEASUREMENT
/begin MEASUREMENT PT_bEngStrtReq "Engine start request of transmission" UBYTE B_TRUE 1 100 0.00 1.00000000000 BIT_MASK 0x1 FORMAT "%13.11" ECU_ADDRESS 0x7000068F /end MEASUREMENT
/begin MEASUREMENT PT_bGrip "grip is for sure present (the converter lockup clutch / the automated or manual clutch is completely closed and PT_bNoGrip = FALSE)." UBYTE B_TRUE 1 100 0.00 1.00000000000 BIT_MASK 0x1 FORMAT "%13.11" ECU_ADDRESS 0x6000A15B /end MEASUREMENT
/begin MEASUREMENT PT_bIdleOvrSht "Condition judgement rpm overshoot after idling" UBYTE B_TRUE 1 100 0.00 1.00000000000 BIT_MASK 0x1 FORMAT "%13.11" ECU_ADDRESS 0x600062F0 /end MEASUREMENT
/begin MEASUREMENT PT_bNoGrip "Grip is definitely ruled out" UBYTE B_TRUE 1 100 0.00 1.00000000000 BIT_MASK 0x1 FORMAT "%13.11" ECU_ADDRESS 0x6000A15A /end MEASUREMENT
/begin MEASUREMENT PT_bOvrRunInactvIntvDes "Overrun inactive status based on interventions active" UBYTE B_TRUE 1 100 0.00 1.00000000000 BIT_MASK 0x1 FORMAT "%13.11" ECU_ADDRESS 0x70000145 /end MEASUREMENT
/begin MEASUREMENT PT_bOvrRunInactvTrsmIntvDes "Overrun inactive status based on transmission interventions active" UBYTE B_TRUE 1 100 0.00 1.00000000000 BIT_MASK 0x1 FORMAT "%13.11" ECU_ADDRESS 0x70000144 /end MEASUREMENT
/begin MEASUREMENT PT_bOvrRunInactvWoIntv "Overrun inactive status for without intervention parallel path" UBYTE B_TRUE 1 100 0.00 1.00000000000 BIT_MASK 0x1 FORMAT "%13.11" ECU_ADDRESS 0x70000143 /end MEASUREMENT
/begin MEASUREMENT PT_bOvrRunInactvWoTrsmIntv "Overrun inactive status for without transmission intervention parallel path" UBYTE B_TRUE 1 100 0.00 1.00000000000 BIT_MASK 0x1 FORMAT "%13.11" ECU_ADDRESS 0x70000142 /end MEASUREMENT
/begin MEASUREMENT PT_bSetOverrunStabyIntvIncActv "Overrun inactive status based on increasing Satbility intervention" UBYTE B_TRUE 1 100 0.00 1.00000000000 BIT_MASK 0x1 FORMAT "%13.11" ECU_ADDRESS 0x70000141 /end MEASUREMENT
/begin MEASUREMENT PT_bSetOvrRunTrsmIntvIncActv "Overrun inactive status based on increasing transmission intervention" UBYTE B_TRUE 1 100 0.00 1.00000000000 BIT_MASK 0x1 FORMAT "%13.11" ECU_ADDRESS 0x70000140 /end MEASUREMENT
/begin MEASUREMENT PT_dnClth "Engine speed gradient at clutch level" SWORD EngNGrd 1 100 -16384.00 16383.50 FORMAT "%8.2" ECU_ADDRESS 0x60004FC6 /end MEASUREMENT
/begin MEASUREMENT PT_dtqNegSlopSetWoIntv "Delta torque for negative slope for IARls_WoIntv" ULONG RmpTrq 1 100 0.00 6553599.99847 FORMAT "%13.5" ECU_ADDRESS 0x60001368 /end MEASUREMENT
/begin MEASUREMENT PT_dtqNegSlopWoTrsmIntv "Delta torque for negative slope for IARls_WoTrsmIntv" ULONG RmpTrq 1 100 0.00 6553599.99847 FORMAT "%13.5" ECU_ADDRESS 0x60001364 /end MEASUREMENT
/begin MEASUREMENT PT_facRedStgEff "Redudant stage effective factor" UWORD fak_uw_b2 1 100 0.00 1.999969 FORMAT "%8.6" ECU_ADDRESS 0x60003626 /end MEASUREMENT
/begin MEASUREMENT PT_facSprkEff "Sparkling effective factor" UWORD fak_uw_b2 1 100 0.00 1.999969 FORMAT "%8.6" ECU_ADDRESS 0x60003624 /end MEASUREMENT
/begin MEASUREMENT Pt_flgAcOff "Air compressor turn off request flag" UBYTE B_TRUE 1 100 0.00 1.00000000000 BIT_MASK 0x1 FORMAT "%13.11" ECU_ADDRESS 0x600062FD /end MEASUREMENT
/begin MEASUREMENT PT_flgAcOn "Air compressor turn on request flag" UBYTE B_TRUE 1 100 0.00 1.00000000000 BIT_MASK 0x1 FORMAT "%13.11" ECU_ADDRESS 0x600062FC /end MEASUREMENT
/begin MEASUREMENT PT_flgAcOnOffSigPls "Air compressor turn on off pulse flag" UBYTE B_TRUE 1 100 0.00 1.00000000000 BIT_MASK 0x1 FORMAT "%13.11" ECU_ADDRESS 0x600062FB /end MEASUREMENT
/begin MEASUREMENT PT_flgDrvDmdActv "Status driver demand is active" UBYTE B_TRUE 1 100 0.00 1.00000000000 BIT_MASK 0x1 FORMAT "%13.11" ECU_ADDRESS 0x7000013F /end MEASUREMENT
/begin MEASUREMENT PT_flgDrvrDmdHLR_I "Hysterisis for Driver demand" UBYTE B_TRUE 1 100 0.00 1.00000000000 BIT_MASK 0x1 FORMAT "%13.11" ECU_ADDRESS 0x7000013E /end MEASUREMENT
/begin MEASUREMENT PT_flgEngActv "Engine active indicator flag" UBYTE B_TRUE 1 100 0.00 1.00000000000 BIT_MASK 0x1 FORMAT "%13.11" ECU_ADDRESS 0x7000173E /end MEASUREMENT
/begin MEASUREMENT PT_flgEngLimActvDes "Target engine limitation active flag" UBYTE B_TRUE 1 100 0.00 1.00000000000 BIT_MASK 0x1 FORMAT "%13.11" ECU_ADDRESS 0x600062FA /end MEASUREMENT
/begin MEASUREMENT PT_flgEngLimDesCdn "Target engine limitation active conditions" UBYTE B_TRUE 1 100 0.00 1.00000000000 BIT_MASK 0x1 FORMAT "%13.11" ECU_ADDRESS 0x600062F9 /end MEASUREMENT
/begin MEASUREMENT Pt_flgFcoInhb "Powertrain inhibits fuel cut-off." UBYTE B_TRUE 1 100 0.00 1.00000000000 BIT_MASK 0x1 FORMAT "%13.11" ECU_ADDRESS 0x6000A151 /end MEASUREMENT
/begin MEASUREMENT PT_flgHiVTLarge "Larger VT torque flag" UBYTE B_TRUE 1 100 0.00 1.00000000000 BIT_MASK 0x1 FORMAT "%13.11" ECU_ADDRESS 0x600062F8 /end MEASUREMENT
/begin MEASUREMENT PT_flgHiVTLargeSync "Larger VT torque sync flag" UBYTE B_TRUE 1 100 0.00 1.00000000000 BIT_MASK 0x1 FORMAT "%13.11" ECU_ADDRESS 0x600062F7 /end MEASUREMENT
/begin MEASUREMENT PT_flgRateLimitActv "Flag indicating rate limiter is actived" UBYTE B_TRUE 1 100 0.00 1.00000000000 BIT_MASK 0x1 FORMAT "%13.11" ECU_ADDRESS 0x7000173D /end MEASUREMENT
/begin MEASUREMENT PT_flgRateLimitActvSync "Sync flag indicating rate limiter is actived" UBYTE B_TRUE 1 100 0.00 1.00000000000 BIT_MASK 0x1 FORMAT "%13.11" ECU_ADDRESS 0x7000173C /end MEASUREMENT
/begin MEASUREMENT PT_flgRateLimitArea "Flag indicating rate limiter in active area" UBYTE B_TRUE 1 100 0.00 1.00000000000 BIT_MASK 0x1 FORMAT "%13.11" ECU_ADDRESS 0x600062F6 /end MEASUREMENT
/begin MEASUREMENT PT_flgRateLimitAreaSync "Sync flag indicating rate limiter in active area" UBYTE B_TRUE 1 100 0.00 1.00000000000 BIT_MASK 0x1 FORMAT "%13.11" ECU_ADDRESS 0x600062F5 /end MEASUREMENT
/begin MEASUREMENT PT_flgRateLimitTrqDiff "Rate limiter torque deviation flag" UBYTE B_TRUE 1 100 0.00 1.00000000000 BIT_MASK 0x1 FORMAT "%13.11" ECU_ADDRESS 0x7000173B /end MEASUREMENT
/begin MEASUREMENT PT_flgRateLimitTrqDiffSync "Rate limiter torque deviation sync flag" UBYTE B_TRUE 1 100 0.00 1.00000000000 BIT_MASK 0x1 FORMAT "%13.11" ECU_ADDRESS 0x7000173A /end MEASUREMENT
/begin MEASUREMENT PT_flgTqVTLoHiOld "Previous larger VT torque flag" UBYTE B_TRUE 1 100 0.00 1.00000000000 BIT_MASK 0x1 FORMAT "%13.11" ECU_ADDRESS 0x70001739 /end MEASUREMENT
/begin MEASUREMENT PT_flgTqVTLoHiOldSync "Previous larger VT torque sync flag" UBYTE B_TRUE 1 100 0.00 1.00000000000 BIT_MASK 0x1 FORMAT "%13.11" ECU_ADDRESS 0x70001738 /end MEASUREMENT
/begin MEASUREMENT PT_flgVTSwt "Hi VT and Lo VT swtiching flag" UBYTE B_TRUE 1 100 0.00 1.00000000000 BIT_MASK 0x1 FORMAT "%13.11" ECU_ADDRESS 0x70001737 /end MEASUREMENT
/begin MEASUREMENT PT_flgVTSwtSync "Hi VT and Lo VT swtiching sync flag" UBYTE B_TRUE 1 100 0.00 1.00000000000 BIT_MASK 0x1 FORMAT "%13.11" ECU_ADDRESS 0x70001736 /end MEASUREMENT
/begin MEASUREMENT PT_flgZeroCrs "VT torque crossing zero point flag" UBYTE B_TRUE 1 100 0.00 1.00000000000 BIT_MASK 0x1 FORMAT "%13.11" ECU_ADDRESS 0x70001735 /end MEASUREMENT
/begin MEASUREMENT PT_flgZeroCrsSync "VT torque crossing zero point sync flag" UBYTE B_TRUE 1 100 0.00 1.00000000000 BIT_MASK 0x1 FORMAT "%13.11" ECU_ADDRESS 0x70001734 /end MEASUREMENT
/begin MEASUREMENT PT_nBgnIdle "Engine rpm at beginning of idling" UWORD nmot_uw_q0p25 1 100 0.00 16383.75 FORMAT "%8.2" ECU_ADDRESS 0x60004C6A /end MEASUREMENT
/begin MEASUREMENT PT_nClth "Speed at clutch input" SWORD EngN 1 100 -16384.00 16383.50 FORMAT "%8.2" ECU_ADDRESS 0x60004FC4 /end MEASUREMENT
/begin MEASUREMENT PT_nDifIdlSpd "Difference between current rpm and rpm at beginning of idling" UWORD nmot_uw_q0p25 1 100 0.00 16383.75 FORMAT "%8.2" ECU_ADDRESS 0x600035F4 /end MEASUREMENT
/begin MEASUREMENT PT_rAirBasdOptTqDes "Target air based optimal torque ratio" UWORD rel_uw_b100 1 100 0.00 99.99847 FORMAT "%8.5" ECU_ADDRESS 0x60003622 /end MEASUREMENT
/begin MEASUREMENT PT_rAirBasdOptTqDesSync "Sync target air based optimal torque ratio" UWORD rel_uw_b100 1 100 0.00 99.99847 FORMAT "%8.5" ECU_ADDRESS 0x60003620 /end MEASUREMENT
/begin MEASUREMENT PT_rAirBasdOptTqReq "Request air based optimal torque ratio" UWORD rel_uw_b100 1 100 0.00 99.99847 FORMAT "%8.5" ECU_ADDRESS 0x6000361E /end MEASUREMENT
/begin MEASUREMENT PT_rAirBasdOptTqReqSync "Sync request air based optimal torque ratio" UWORD rel_uw_b100 1 100 0.00 99.99847 FORMAT "%8.5" ECU_ADDRESS 0x6000361C /end MEASUREMENT
/begin MEASUREMENT PT_rDifThrAgReq "Change in driver requisted throttle opening" SWORD rel_sw_b200 1 100 -200.0000 199.9939 FORMAT "%8.4" ECU_ADDRESS 0x600035F2 /end MEASUREMENT
/begin MEASUREMENT PT_rEngTq "Engine esitmated torque ratio" UWORD rel_uw_b100 1 100 0.00 99.99847 FORMAT "%8.5" ECU_ADDRESS 0x6000361A /end MEASUREMENT
/begin MEASUREMENT PT_rGrip "Analogue value for the grip states." SWORD Fact100 1 100 -327.6800 327.6700 FORMAT "%8.4" ECU_ADDRESS 0x6000E2A0 /end MEASUREMENT
/begin MEASUREMENT PT_rTrq "Powertrain torque ratio" SWORD TransR 1 100 -327.6800 327.6700 FORMAT "%8.4" ECU_ADDRESS 0x60004FA8 /end MEASUREMENT
/begin MEASUREMENT PT_rTrqTmp1_mp "Measuringpoint for intermediate result-value 1 for PT_rTrq" SWORD TransR 1 100 -327.6800 327.6700 FORMAT "%8.4" ECU_ADDRESS 0x70008BBA /end MEASUREMENT
/begin MEASUREMENT PT_rTrqTmp2_mp "Measuringpoint for intermediate result-value 2 for PT_rTrq" SWORD TransR 1 100 -327.6800 327.6700 FORMAT "%8.4" ECU_ADDRESS 0x70008BB8 /end MEASUREMENT
/begin MEASUREMENT PT_rTrqWoConvRat "torque ratio of the power train without differential and converter torque ratio" SWORD TransR 1 100 -327.6800 327.6700 FORMAT "%8.4" ECU_ADDRESS 0x6000E2A4 /end MEASUREMENT
/begin MEASUREMENT PT_stClth "Clutch signal output based on sensor information or rpm overshoot detection" UBYTE OneToOne 1 100 0.00 255.0 FORMAT "%5.1" ECU_ADDRESS 0x600062EF /end MEASUREMENT
/begin MEASUREMENT PT_stClthDetd "Condition rpm overshoot after idling detected" UBYTE OneToOne 1 100 0.00 255.0 FORMAT "%5.1" ECU_ADDRESS 0x6000A310 /end MEASUREMENT
/begin MEASUREMENT PT_stTqDem "contains highest prior function with torque demand" UWORD OneToOne 1 100 0.00 65535.00 FORMAT "%8.2" ECU_ADDRESS 0x60004C68 /end MEASUREMENT
/begin MEASUREMENT PT_tqAcsSync "Sync accessories torque" SWORD Trq 1 100 -3276.800 3276.700 FORMAT "%8.3" ECU_ADDRESS 0x60004FA6 /end MEASUREMENT
/begin MEASUREMENT PT_tqCluBsWoIntv "Basic torque at clutch level without interventions" SWORD Trq 1 100 -3276.800 3276.700 FORMAT "%8.3" ECU_ADDRESS 0x600035F0 /end MEASUREMENT
/begin MEASUREMENT PT_tqCluBsWoTrsmIntv "Basic torque at clutch level without transmission interventions" SWORD Trq 1 100 -3276.800 3276.700 FORMAT "%8.3" ECU_ADDRESS 0x600035EE /end MEASUREMENT
/begin MEASUREMENT PT_tqCluDesCmp "Target compensation torque at clutch level" SWORD Trq 1 100 -3276.800 3276.700 FORMAT "%8.3" ECU_ADDRESS 0x60003618 /end MEASUREMENT
/begin MEASUREMENT PT_tqCluDesWoIntv "Target clutch torque without intervention" SWORD Trq 1 100 -3276.800 3276.700 FORMAT "%8.3" ECU_ADDRESS 0x60003616 /end MEASUREMENT
/begin MEASUREMENT PT_tqCluEngAllIntvExt "Driver demanded torque on engine (clutch level) with all interventions for parallel path" SWORD Trq 1 100 -3276.800 3276.700 FORMAT "%8.3" ECU_ADDRESS 0x60004FA4 /end MEASUREMENT
/begin MEASUREMENT PT_tqCluEngPtdSet "Limiting torque(clutch level) of setpoint path from the monitoring" SWORD md_q0p1 1 100 -3276.800 3276.700 FORMAT "%8.3" ECU_ADDRESS 0x600035EC /end MEASUREMENT
/begin MEASUREMENT PT_tqCluEngWoIntvExt "Driver demanded torque on engine (clutch level) without interventions for parallel path" SWORD Trq 1 100 -3276.800 3276.700 FORMAT "%8.3" ECU_ADDRESS 0x60004FA2 /end MEASUREMENT
/begin MEASUREMENT PT_tqCluEngWoTrsmIntvExt "Driver demanded torque on engine (clutch level) without transmission interventions for parallel path" SWORD Trq 1 100 -3276.800 3276.700 FORMAT "%8.3" ECU_ADDRESS 0x60004FA0 /end MEASUREMENT
/begin MEASUREMENT PT_tqCluMinEngWoFco "Minimum clutch torque without cutoff and without quasistationary torque of the electric motor" SWORD Trq 1 100 -3276.800 3276.700 FORMAT "%8.3" ECU_ADDRESS 0x60004F9E /end MEASUREMENT
/begin MEASUREMENT PT_tqCluRmpIALckExt "Delta torque for ramp after withdrawal of ignition angle release at clutch level" SWORD Trq 1 100 -3276.800 3276.700 FORMAT "%8.3" ECU_ADDRESS 0x600035EA /end MEASUREMENT
/begin MEASUREMENT PT_tqCluSetWoIntvFcoLimd "Driver demanded torque after FCO limitation for without intervention parallel path" SWORD Trq 1 100 -3276.800 3276.700 FORMAT "%8.3" ECU_ADDRESS 0x600035E8 /end MEASUREMENT
/begin MEASUREMENT PT_tqCluSetWoIntvHemLimd "Driver demanded torque after HEM limitation for without intervention parallel path" SWORD Trq 1 100 -3276.800 3276.700 FORMAT "%8.3" ECU_ADDRESS 0x600035E6 /end MEASUREMENT
/begin MEASUREMENT PT_tqCluSetWoTrsmIntvFcoLimd "Driver demanded torque after FCO limitation for without transmission intervention parallel path" SWORD Trq 1 100 -3276.800 3276.700 FORMAT "%8.3" ECU_ADDRESS 0x600035E4 /end MEASUREMENT
/begin MEASUREMENT PT_tqCluSetWoTrsmIntvHemLimd "Driver demanded torque after HEM limitation for without transmission intervention parallel path" SWORD Trq 1 100 -3276.800 3276.700 FORMAT "%8.3" ECU_ADDRESS 0x600035E2 /end MEASUREMENT
/begin MEASUREMENT PT_tqCluTrsmWoIntv "Desired ramp output torque at cluth level without intervention" SLONG Trq 1 100 -214748364.800 214748364.700 FORMAT "%13.3" ECU_ADDRESS 0x60001360 /end MEASUREMENT
/begin MEASUREMENT PT_tqCluTrsmWoTrsmIntv "Desired ramp output torque at cluth level without transmission intervention" SLONG Trq 1 100 -214748364.800 214748364.700 FORMAT "%13.3" ECU_ADDRESS 0x6000135C /end MEASUREMENT
/begin MEASUREMENT PT_tqCluWoIntv "Desired torque at cluth level without intervention" SWORD Trq 1 100 -3276.800 3276.700 FORMAT "%8.3" ECU_ADDRESS 0x600035E0 /end MEASUREMENT
/begin MEASUREMENT PT_tqCluWoTrsmIntv "Desired torque at cluth level without transmission intervention" SWORD Trq 1 100 -3276.800 3276.700 FORMAT "%8.3" ECU_ADDRESS 0x600035DE /end MEASUREMENT
/begin MEASUREMENT PT_tqCrksftDesOld "Previous target crankshaft torque" SWORD Trq 1 100 -3276.800 3276.700 FORMAT "%8.3" ECU_ADDRESS 0x60003614 /end MEASUREMENT
/begin MEASUREMENT PT_tqCrksftDesOldSync "Previous sync target crankshaft torque" SWORD Trq 1 100 -3276.800 3276.700 FORMAT "%8.3" ECU_ADDRESS 0x60003612 /end MEASUREMENT
/begin MEASUREMENT PT_tqCrksftSetWoIntv "driver demanded torque after Ignition Angle Release limitation without intervention (crankshaft level)" SWORD Trq 1 100 -3276.800 3276.700 FORMAT "%8.3" ECU_ADDRESS 0x60004F96 /end MEASUREMENT
/begin MEASUREMENT PT_tqCrksftSetWoTrsmIntv "driver demanded torque after IA Release limitation without transmission intervention (crankshaft level)" SWORD Trq 1 100 -3276.800 3276.700 FORMAT "%8.3" ECU_ADDRESS 0x60004F94 /end MEASUREMENT
/begin MEASUREMENT PT_tqCrSMinSync "Sync Minimum engine torque at the crankshaft level" SWORD md_q0p1 1 100 -3276.800 3276.700 FORMAT "%8.3" ECU_ADDRESS 0x60004F98 /end MEASUREMENT
/begin MEASUREMENT PT_tqDesENGT1 "Target engine torque request by driver" SWORD Trq 1 100 -3276.800 3276.700 FORMAT "%8.3" ECU_ADDRESS 0x60004F92 /end MEASUREMENT
/begin MEASUREMENT PT_tqDesENGT2 "Target VSA engine torque" SLONG Trq 1 100 -6553.60000000 6553.60000000 FORMAT "%13.8" ECU_ADDRESS 0x60001CE0 /end MEASUREMENT
/begin MEASUREMENT PT_tqEngCrksftEstimd "Engine crankshaft estimated torque" SWORD Trq 1 100 -3276.800 3276.700 FORMAT "%8.3" ECU_ADDRESS 0x60003610 /end MEASUREMENT
/begin MEASUREMENT PT_tqEngCrksftEstimdSync "Sync engine crankshaft estimated torque" SWORD Trq 1 100 -3276.800 3276.700 FORMAT "%8.3" ECU_ADDRESS 0x6000360E /end MEASUREMENT
/begin MEASUREMENT PT_tqEngENG16 "Target engine torque with limitation" SWORD Trq 1 100 -3276.800 3276.700 FORMAT "%8.3" ECU_ADDRESS 0x60004F90 /end MEASUREMENT
/begin MEASUREMENT PT_tqEngEstimtd "Engine estimated torque" SWORD md_q0p1 1 100 -3276.800 3276.700 FORMAT "%8.3" ECU_ADDRESS 0x60004F8E /end MEASUREMENT
/begin MEASUREMENT PT_tqEngEstimtdSync "Sync engine estimated torque" SWORD md_q0p1 1 100 -3276.800 3276.700 FORMAT "%8.3" ECU_ADDRESS 0x70001732 /end MEASUREMENT
/begin MEASUREMENT PT_tqEngEstimtdTmp "Temporary engine estimated torque" SWORD md_q0p1 1 100 -3276.800 3276.700 FORMAT "%8.3" ECU_ADDRESS 0x6000360C /end MEASUREMENT
/begin MEASUREMENT PT_tqEngPrtLimMechInnr "Inner torque limitation due to NMAX-limitation" SWORD md_sw_q0p1 1 100 -3276.800 3276.700 FORMAT "%8.3" ECU_ADDRESS 0x6000360A /end MEASUREMENT
/begin MEASUREMENT PT_tqInrSync "Sync inner torque" SWORD Trq 1 100 -3276.800 3276.700 FORMAT "%8.3" ECU_ADDRESS 0x70001730 /end MEASUREMENT
/begin MEASUREMENT PT_tqRelAirDes "Target relative air based torque" UWORD rel_uw_b100 1 100 0.00 99.99847 FORMAT "%8.5" ECU_ADDRESS 0x60004C66 /end MEASUREMENT
/begin MEASUREMENT PT_tqRelAirDesSync "Sync target relative air based torque" UWORD rel_uw_b100 1 100 0.00 99.99847 FORMAT "%8.5" ECU_ADDRESS 0x60004C64 /end MEASUREMENT
/begin MEASUREMENT PT_tqRelAirReq "Request relative air based torque" UWORD rel_uw_b100 1 100 0.00 99.99847 FORMAT "%8.5" ECU_ADDRESS 0x60004C62 /end MEASUREMENT
/begin MEASUREMENT PT_tqRelAirReqSync "Sync request relative air based torque" UWORD rel_uw_b100 1 100 0.00 99.99847 FORMAT "%8.5" ECU_ADDRESS 0x60004C60 /end MEASUREMENT
/begin MEASUREMENT PT_tqResvEng "Combustion engine torque reserve" SWORD Trq 1 100 -3276.800 3276.700 FORMAT "%8.3" ECU_ADDRESS 0x60004F8C /end MEASUREMENT
/begin MEASUREMENT PT_tqWhlMinEngWoFco "Minimum wheel torque with only internal combustion engine firing" SLONG TrqPrpHigh 1 100 -214748364.800 214748364.700 FORMAT "%13.3" ECU_ADDRESS 0x60001CDC /end MEASUREMENT
/begin MEASUREMENT PT_trqClthMax "maximum torque (engine) + dynamic maximum torque (electrical machine)" SWORD Trq 1 100 -3276.800 3276.700 FORMAT "%8.3" ECU_ADDRESS 0x60004F8A /end MEASUREMENT
/begin MEASUREMENT PT_trqClthMin "Minimum clutch torque" SWORD Trq 1 100 -3276.800 3276.700 FORMAT "%8.3" ECU_ADDRESS 0x60004F88 /end MEASUREMENT
/begin MEASUREMENT PT_trqCrSHiVT "Crankshaft Hi VTEC torque" SWORD Trq 1 100 -3276.800 3276.700 FORMAT "%8.3" ECU_ADDRESS 0x60003608 /end MEASUREMENT
/begin MEASUREMENT PT_trqCrSHiVTSync "Sync crankshaft Hi VTEC torque" SWORD Trq 1 100 -3276.800 3276.700 FORMAT "%8.3" ECU_ADDRESS 0x60003606 /end MEASUREMENT
/begin MEASUREMENT PT_trqCrSLoVT "Crankshaft Lo VTEC torque" SWORD Trq 1 100 -3276.800 3276.700 FORMAT "%8.3" ECU_ADDRESS 0x60003604 /end MEASUREMENT
/begin MEASUREMENT PT_trqCrSLoVTSync "Sync crankshaft Lo VTEC torque" SWORD Trq 1 100 -3276.800 3276.700 FORMAT "%8.3" ECU_ADDRESS 0x60003602 /end MEASUREMENT
/begin MEASUREMENT PT_trqDiff "Absolute Lo Hi VT different torque" SWORD Trq 1 100 -3276.800 3276.700 FORMAT "%8.3" ECU_ADDRESS 0x60003600 /end MEASUREMENT
/begin MEASUREMENT PT_trqDiffSync "Sync absolute Lo Hi VT different torque" SWORD Trq 1 100 -3276.800 3276.700 FORMAT "%8.3" ECU_ADDRESS 0x600035FE /end MEASUREMENT
/begin MEASUREMENT PT_trqEngTrqToCvt "Target engine estimated torque under rate limiter" SWORD Trq 1 100 -3276.800 3276.700 FORMAT "%8.3" ECU_ADDRESS 0x60004F86 /end MEASUREMENT
/begin MEASUREMENT PT_trqEngTrqToCvtSync "Sync target engine estimated torque under rate limiter" SWORD Trq 1 100 -3276.800 3276.700 FORMAT "%8.3" ECU_ADDRESS 0x60004F84 /end MEASUREMENT
/begin MEASUREMENT PT_trqLos "Parameter for Loss torque of the drive train" SWORD Trq 1 100 -3276.800 3276.700 FORMAT "%8.3" ECU_ADDRESS 0x60004F82 /end MEASUREMENT
/begin MEASUREMENT PT_trqLosComp "Torque loss of the power train" SWORD Trq 1 100 -3276.800 3276.700 FORMAT "%8.3" ECU_ADDRESS 0x6000E2A8 /end MEASUREMENT
/begin MEASUREMENT PT_trqMax "Absoluted maximum toqure between Lo Hi VT" SWORD Trq 1 100 -3276.800 3276.700 FORMAT "%8.3" ECU_ADDRESS 0x600035FC /end MEASUREMENT
/begin MEASUREMENT PT_trqMaxSync "Sync absoluted maximum toqure between Lo Hi VT" SWORD Trq 1 100 -3276.800 3276.700 FORMAT "%8.3" ECU_ADDRESS 0x600035FA /end MEASUREMENT
/begin MEASUREMENT PT_trqResv "Request for reserve torque of the power train" SWORD Trq 1 100 -3276.800 3276.700 FORMAT "%8.3" ECU_ADDRESS 0x6000E2AA /end MEASUREMENT
/begin MEASUREMENT PT_trqTgtTrqCrS "Target VT crankshaft torque" SWORD Trq 1 100 -3276.800 3276.700 FORMAT "%8.3" ECU_ADDRESS 0x600035F8 /end MEASUREMENT
/begin MEASUREMENT PT_trqTgtTrqCrSSync "Sync Target VT crankshaft torque" SWORD Trq 1 100 -3276.800 3276.700 FORMAT "%8.3" ECU_ADDRESS 0x600035F6 /end MEASUREMENT
/begin MEASUREMENT PT_trqWhl "Wheel actual torque" SLONG TrqPrpHigh 1 100 -214748364.800 214748364.700 FORMAT "%13.3" ECU_ADDRESS 0x60001CD8 /end MEASUREMENT
/begin MEASUREMENT PT_trqWhlMax "Maximum wheel torque" SLONG TrqPrpHigh 1 100 -214748364.800 214748364.700 FORMAT "%13.3" ECU_ADDRESS 0x60001CD4 /end MEASUREMENT
/begin MEASUREMENT PT_trqWhlMin "Minimum wheel torque" SLONG TrqPrpHigh 1 100 -214748364.800 214748364.700 FORMAT "%13.3" ECU_ADDRESS 0x60001CCC /end MEASUREMENT
/begin MEASUREMENT PT_trqWhlMinEng "Minimum wheel torque from the engine" SLONG TrqPrpHigh 1 100 -214748364.800 214748364.700 FORMAT "%13.3" ECU_ADDRESS 0x60001CC8 /end MEASUREMENT
/begin MEASUREMENT pvdmn_w_msg "minimum pressure upstream of the throttle valve" UWORD p_q0p078 1 100 0.00 5119.922 FORMAT "%8.3" ECU_ADDRESS 0x60000678 /end MEASUREMENT
/begin MEASUREMENT pvdmx_w_msg "maximum pressure upstream of the throttle valve" UWORD p_q0p078 1 100 0.00 5119.922 FORMAT "%8.3" ECU_ADDRESS 0x6000067C /end MEASUREMENT
/begin MEASUREMENT pvd_w_msg "pressure upstream throttle valve ( value from 0...5120hPa )" UWORD p_q0p078 1 100 0.00 5119.922 FORMAT "%8.3" ECU_ADDRESS 0x60000670 /end MEASUREMENT
/begin MEASUREMENT pvlf_w_msg "pressure upstream air filter" UWORD p_uw_q0p078 1 100 0.00 5119.922 FORMAT "%8.3" ECU_ADDRESS 0x70001C5A /end MEASUREMENT
/begin MEASUREMENT rba_MemDiagExtd_nrLstReadSngErr "Block id of last occurred read error for single storage blocks" UWORD OneToOne 1 100 0.00 65535.00 FORMAT "%8.2" ECU_ADDRESS 0x60034748 /end MEASUREMENT
/begin MEASUREMENT rba_MemDiag_flgInhbDiag "Diagnosis is inhibited" UBYTE B_TRUE 1 100 0.00 1.00000000000 BIT_MASK 0x1 FORMAT "%13.11" ECU_ADDRESS 0x7000013B /end MEASUREMENT
/begin MEASUREMENT rba_MemDiag_nrLstReadErr "Block id of last occurred read error" UWORD OneToOne 1 100 0.00 65535.00 FORMAT "%8.2" ECU_ADDRESS 0x60034746 /end MEASUREMENT
/begin MEASUREMENT rba_MemDiag_nrLstWrErr "Block id of last occurred write error" UWORD OneToOne 1 100 0.00 65535.00 FORMAT "%8.2" ECU_ADDRESS 0x60034744 /end MEASUREMENT
/begin MEASUREMENT redistar "redist array for the delay of miist_w" UBYTE dez 1 100 0.00 11.00 FORMAT "%5.2" ARRAY_SIZE 4 ECU_ADDRESS 0x600062F1 /end MEASUREMENT
/begin MEASUREMENT Reset_APP_rUnFlt "Protected copy of APP_rUnFlt for freeze frame" SWORD Prc 1 100 -400.0000 399.9878 FORMAT "%8.4" ECU_ADDRESS 0x60034742 /end MEASUREMENT
/begin MEASUREMENT Reset_BattU_u "Battery voltage" SWORD Volt_Batt 1 100 -655360.0 655340.0 FORMAT "%8.1" ECU_ADDRESS 0x60034740 /end MEASUREMENT
/begin MEASUREMENT Reset_CoETS_rTrq "Protected copy of CoETS_rTrq for freeze frame" SWORD Prc 1 100 -400.0000 399.9878 FORMAT "%8.4" ECU_ADDRESS 0x6003473E /end MEASUREMENT
/begin MEASUREMENT Reset_Env_ctRst "Reset counter which counts all resets" UBYTE OneToOne 1 100 0.00 255.0 FORMAT "%5.1" ECU_ADDRESS 0x600062EE /end MEASUREMENT
/begin MEASUREMENT Reset_Env_xGrp "Reset group of last reset" UBYTE OneToOne 1 100 0.00 255.0 FORMAT "%5.1" ECU_ADDRESS 0x600062ED /end MEASUREMENT
/begin MEASUREMENT Reset_Env_xId "Reset-ID of the last reset reason (Copy of Reset_Env.xId)" UWORD OneToOne 1 100 0.00 65535.00 FORMAT "%8.2" ECU_ADDRESS 0x600035DC /end MEASUREMENT
/begin MEASUREMENT Reset_Epm_nEng "Protected copy of Epm_nEng for freeze frame" SWORD EngN 1 100 -16384.00 16383.50 FORMAT "%8.2" ECU_ADDRESS 0x6003473C /end MEASUREMENT
/begin MEASUREMENT Reset_GlbDa_lTotDst "total distance since first start captured at software reset" SLONG Length 1 100 -2147483648.00 2147483647.00 FORMAT "%13.2" ECU_ADDRESS 0x60034738 /end MEASUREMENT
/begin MEASUREMENT Reset_T15_st "Protected copy of T15_st for freeze frame" UBYTE OneToOne 1 100 0.00 255.0 BIT_MASK 0x1 FORMAT "%5.1" ECU_ADDRESS 0x60034734 /end MEASUREMENT
/begin MEASUREMENT Reset_VehV_v "Protected copy of Veh_v for freeze frame" SWORD Vel 1 100 -327.6800 327.6700 FORMAT "%8.4" ECU_ADDRESS 0x60034732 /end MEASUREMENT
/begin MEASUREMENT TMECmb_IfEtaIaTqAct_I.HSPActv "combustion dataset for next combustion / Combustion dataset: condition GDI-operating mode for actual ignition cylinder is homogeneous-split" UBYTE dez 1 100 0.00 255.0 FORMAT "%5.1" ECU_ADDRESS 0x50000688 /end MEASUREMENT
/begin MEASUREMENT TMECmb_IfEtaIaTqAct_I.f2kazw "combustion dataset for next combustion / combustion data set" UBYTE fak_ub_b1 1 100 0.00 0.9961 ECU_ADDRESS 0x50000689 /end MEASUREMENT
/begin MEASUREMENT TMECmb_IfEtaIaTqAct_I.flb "combustion dataset for next combustion / Combustion dataset: Factor charge-movement" UBYTE fak_ub_b1 1 100 0.00 0.9961 ECU_ADDRESS 0x5000068A /end MEASUREMENT
/begin MEASUREMENT TMECmb_IfEtaIaTqAct_I.lamsbg "combustion dataset for next combustion / lambda input for interface class" UWORD fak_uw_b16 1 100 0.00 15.99976 FORMAT "%8.5" ECU_ADDRESS 0x5000068C /end MEASUREMENT
/begin MEASUREMENT TMECmb_IfEtaIaTqAct_I.nEng "combustion dataset for next combustion / Combustion dataset: Average engine speed of one cylinder segment" UWORD nmot_uw_q0p25 1 100 0.00 16383.75 FORMAT "%8.2" ECU_ADDRESS 0x5000068E /end MEASUREMENT
/begin MEASUREMENT TMECmb_IfEtaIaTqAct_I.rl "combustion dataset for next combustion / Combustion dataset: Relative air charge" UWORD rel_uw_q0p0234 1 100 0.00 1535.977 FORMAT "%8.3" ECU_ADDRESS 0x50000690 /end MEASUREMENT
/begin MEASUREMENT TMECmb_IfEtaIaTqAct_I.rri "combustion dataset for next combustion / inert gas rate input for interface class" UWORD rel_uw_b100 1 100 0.00 99.99847 FORMAT "%8.5" ECU_ADDRESS 0x50000692 /end MEASUREMENT
/begin MEASUREMENT TMECmb_IfEtaIaTqAct_I.split2ka "combustion dataset for next combustion / Combustion dataset: Factor for splitting CNG and Gasoline" UWORD fak_uw_b2 1 100 0.00 1.000000 FORMAT "%8.6" ECU_ADDRESS 0x50000694 /end MEASUREMENT
/begin MEASUREMENT uevges_msg "Transmission ratio total" UBYTE fak_q0p1 1 100 0.00 25.50 FORMAT "%5.2" ECU_ADDRESS 0x70002DB5 /end MEASUREMENT
/begin MEASUREMENT uevges_w_msg "Transmission ratio total (Word-Variables)" UWORD fak_q0p02 1 100 0.00 1310.700 FORMAT "%8.3" ECU_ADDRESS 0x70002D14 /end MEASUREMENT
/begin MEASUREMENT vpvdkpu_w_msg "Ratio: boost pressure upstream throttle to ambient pressure" UWORD fak_q0p000122 1 100 0.00 7.999878 FORMAT "%8.6" ECU_ADDRESS 0x70001C4C /end MEASUREMENT
/begin FUNCTION OilSwmpT_VdMdl2 "1.6.0     Calculation of model value for Oil deterioration system: Temperature of oil in sump"
 /begin DEF_CHARACTERISTIC OilSwmpT_facEngOffTiCoolgCoeff_T OilSwmpT_facEngSpdCoeff_T OilSwmpT_facVehSpdCoeff_T OilSwmpT_swtMdl2Cfg_C OilSwmpT_tAFSTBlkHeatrDetn_C OilSwmpT_tBlkHeatrCoeff_C OilSwmpT_tCEngDsTBlkHeatrDetn_T OilSwmpT_tHeatCoeff_M OilSwmpT_tiEngOffDurn_C OilSwmpT_tiEngOff_T OilSwmpt_tIntkSnsrSeln_C OilSwmpT_tSafeValMtrDisp_C OilSwmpt_tSafeVal_C /end DEF_CHARACTERISTIC
 /begin IN_MEASUREMENT CEngDsT_t EnvT_tMdl2 Epm_nEng IntkAirT_tIntkMnfld IntkAirT_tThrVlvUs OilLfT_mAirPerCyl OilLfT_stFailSafeActn VehV_v /end IN_MEASUREMENT
 /begin OUT_MEASUREMENT OilSwmpT_flgFinshd OilSwmpT_flgInit OilSwmpT_stTMdl2 OilSwmpT_tMdl2 OilSwmpT_tMtrDisp /end OUT_MEASUREMENT
 /begin LOC_MEASUREMENT OilSwmpT_dtCEngDsTMdl OilSwmpT_dtEnvTMdl OilSwmpT_dtMdl2 OilSwmpT_facEngOffTiCoeff OilSwmpT_facEngOffTiCoolgCoeff OilSwmpT_facEngSpdCoeff OilSwmpT_facVehSpdCoeff OilSwmpT_flgEngStrtCmpl OilSwmpT_stEepReadCEngDsTBkup OilSwmpT_stEepReadflgFinshd OilSwmpT_stEepReadMdl OilSwmpT_stEepReadMtrDisp OilSwmpT_tCEngDsTBkup OilSwmpT_tDifCEngDsTEnvT OilSwmpT_tDifCEngDsTEnvTOld OilSwmpT_tDifEngSpdAirMCoeff OilSwmpT_tDifEngSpdCoeff OilSwmpT_tDifMdl OilSwmpT_tDifVehSpdCoeff OilSwmpT_tEngOffTiCoeff OilSwmpT_tHeatCoeff OilSwmpT_tiEngOffTi OilSwmpT_tInit OilSwmpt_tIntkSnsr OilSwmpT_tTmp /end LOC_MEASUREMENT
 FUNCTION_VERSION "1.6.0" /end FUNCTION
/begin FUNCTION PCUECU_PCU "21.3.0_6SAACAN messages of the Power Control unit ECU (PCU)" /begin DEF_CHARACTERISTIC Com_dPCUMaxDiff_C Com_dPCUMaxPer_C Com_stPCUEngStrtInhb_C /end DEF_CHARACTERISTIC
 /begin IN_MEASUREMENT Com_ctCRingPCU Com_numCsumPCU Com_stBCANReprogm Com_stFrmRxEna Com_stMon Com_stPCUEngStrtInhb /end IN_MEASUREMENT
 /begin LOC_MEASUREMENT PCUECU_ctRngPCU_MP /end LOC_MEASUREMENT
 FUNCTION_VERSION "21.3.0_6SAA" /end FUNCTION
/begin FUNCTION PhyMod_ClntEntry "2.4.1     Heat Entry of Engine into Coolant Agent"
 /begin DEF_CHARACTERISTIC PhyMod_CalorificValueGS_C PhyMod_cpHeatExh_C PhyMod_facClntTrq_C /end DEF_CHARACTERISTIC
 /begin IN_MEASUREMENT ActMod_pwrCrksft ExhMod_dmExhMnfB1 ExhMod_tExhMnfB1 InjSys_dvolFu IntkAirT_tIntkMnfld lamsbg_w_msg /end IN_MEASUREMENT
 /begin OUT_MEASUREMENT PhyMod_pwrClntEntry PhyMod_pwrLos PhyMod_pwrTheo /end OUT_MEASUREMENT
 /begin LOC_MEASUREMENT PhyMod_dmFuCns PhyMod_pwrEgLoss PhyMod_pwrTheoloc /end LOC_MEASUREMENT
 FUNCTION_VERSION "2.4.1" /end FUNCTION
/begin FUNCTION PhyMod_TqJCalc "1.5.0     Calculation of the inertia torque of the internal combustion Engine" /begin DEF_CHARACTERISTIC PhyMod_jCmbEng_C PhyMod_tiDerEngFil_CUR /end DEF_CHARACTERISTIC /begin IN_MEASUREMENT Epm_nEng10ms SyC_ctDrvEnter /end IN_MEASUREMENT
 /begin OUT_MEASUREMENT PhyMod_ctTqJDrvEnter PhyMod_jCmbEng PhyMod_jEng PhyMod_tqJEng /end OUT_MEASUREMENT
 /begin LOC_MEASUREMENT PhyMod_dnEngDerFild PhyMod_dnEngDerFild_mp PhyMod_dnEngDerUnFild PhyMod_dnEngDerUnFild_mp PhyMod_tiDerEngFil_mp /end LOC_MEASUREMENT
 FUNCTION_VERSION "1.5.0" /end FUNCTION
/begin FUNCTION PID51_FuTyp "1.8.0     Type of fuel currently being utilized by the vehicle" /begin DEF_CHARACTERISTIC PID51_stFuTyp_C PID51_swtVehTyp_C /end DEF_CHARACTERISTIC /begin OUT_MEASUREMENT PID51_stFuTyp /end OUT_MEASUREMENT FUNCTION_VERSION "1.8.0" /end FUNCTION
/begin FUNCTION PIDA6_OdoCalc "1.2.0     Odometer Calculation for PID 0xA6" /begin DEF_CHARACTERISTIC PIDA6_lDstLim_C /end DEF_CHARACTERISTIC /begin IN_MEASUREMENT Com_lTotOdo /end IN_MEASUREMENT /begin OUT_MEASUREMENT PIDA6_lDstDrvngCyc PIDA6_lTotDst /end OUT_MEASUREMENT
 /begin LOC_MEASUREMENT PIDA6_lDstStrt PIDA6_lTotDstLstStored PIDA6_lTotDstProtd PIDA6_stEepOrder PIDA6_stEepWrite /end LOC_MEASUREMENT
 FUNCTION_VERSION "1.2.0" /end FUNCTION
/begin FUNCTION PIntkVUs_DD "16.29.1   pressure upstream inlet valve"
 /begin DEF_CHARACTERISTIC PIntkVUs_facCnvnSlopAdc_C PIntkVUs_nEngThresPresRawIni_C PIntkVUs_nThresSync_C PIntkVUs_pADCVltgTrfPresOfs_C PIntkVUs_stCfg_C PIntkVUs_tiPt1VltgSegBasdTi_T PIntkVUs_uThresMax_C PIntkVUs_uThresMin_C /end DEF_CHARACTERISTIC
 /begin IN_MEASUREMENT B_syn2fe_msg DSM_TripChgFinshd EpmCrS_tiSeg Epm_nEng Epm_nEng10ms Epm_stSync SyC_stSub /end IN_MEASUREMENT
 /begin OUT_MEASUREMENT B_psinirg_msg B_psrmw_msg B_psrrg_msg PIntkVUs_dpRaw PIntkVUs_flgPRawIniVldB1 PIntkVUs_flgPRawVldB1 PIntkVUs_flgPRawVldTiBasdB1 PIntkVUs_pRaw PIntkVUs_pRawB1 PIntkVUs_pRawIni PIntkVUs_pRawIniB1 PIntkVUs_pRawObd PIntkVUs_pRawTiBasdB1 PIntkVUs_stPresIniVld PIntkVUs_stSRCVld PIntkVUs_uRawUnFlt psini_w_msg psrrff_w_msg psrr_w_msg /end OUT_MEASUREMENT
 /begin LOC_MEASUREMENT PIntkVUs_flgIniFinshdB1 PIntkVUs_flgPRawVldLocSynBasdB1 PIntkVUs_flgPRawVldLocTiBasdB1 PIntkVUs_flgRngErrMaxLocSyn PIntkVUs_flgRngErrMaxLocTi PIntkVUs_flgRngErrMaxSyn PIntkVUs_flgRngErrMaxTi PIntkVUs_flgRngErrMinLocSyn PIntkVUs_flgRngErrMinLocTi PIntkVUs_flgRngErrMinSyn PIntkVUs_flgRngErrMinTi PIntkVUs_nrRawCnt PIntkVUs_nrRawCntSynBasd PIntkVUs_nrRawCntTiBasd PIntkVUs_pRawLocSynBasd PIntkVUs_pRawOld PIntkVUs_stEdgRsChk PIntkVUs_tiSegADCData PIntkVUs_uRawAvrgSynBasd PIntkVUs_uRawAvrgTiBasd PIntkVUs_uRawFlt PIntkVUs_uRawSum PIntkVUs_uRawSumSynBasd PIntkVUs_uRawSumTiBasd /end LOC_MEASUREMENT
 FUNCTION_VERSION "16.29.1" /end FUNCTION
/begin FUNCTION PSPCtlG_Co "52.6.0    Operating conditions of the electric fuel pump"
 /begin DEF_CHARACTERISTIC PSPCtlG_CodWd PSPCtl_ctEngStopPSPOnOff_C PSPCtl_ctPreRunDrvMax_C PSPCtl_ctPreRunPreDrvMax_C PSPCtl_cwPSPCtl_CW PSPCtl_tiEngOffPreRun_C PSPCtl_tiEngStalDly_C PSPCtl_tiEngStopPSPOff_C PSPCtl_tiEngStopPSPOn_C PSPCtl_tiPreRunDrv_C PSPCtl_tiPreRunPreDrv_C PSPCtl_tiStrtDem_C /end DEF_CHARACTERISTIC
 /begin IN_MEASUREMENT B_stopeng_msg CoEng_st CoEng_stOld CoVeh_stEngStrtOrd Epm_nEng Strt_stStaActv SyC_stSub tengsq1_w_msg TiEngOff_stTi /end IN_MEASUREMENT
 /begin OUT_MEASUREMENT B_ekpvl_msg B_tapcm_msg PSP_st /end OUT_MEASUREMENT
 /begin LOC_MEASUREMENT PSPCtlG_bEngCyclStSp PSPCtl_bEngSpdDet PSPCtl_bEngStop PSPCtl_bPreRun PSPCtl_bPreRunEnbl PSPCtl_bPreRunLck PSPCtl_bPSPDisbl PSPCtl_bPSPXPreDrv PSPCtl_bShOffPSP PSPCtl_ctPreRun PSPCtl_flgPwrOnRst PSPCtl_tiPreRun PSP_stDetSleep /end LOC_MEASUREMENT
 FUNCTION_VERSION "52.6.0" /end FUNCTION
/begin FUNCTION PSPG_DDCo "52.2.0    Device Driver of the fuel pump electronic control module"
 /begin DEF_CHARACTERISTIC PSPDig_ATS.LimitTypeMsk_C PSPDig_ATS.CnvNorm_C PSPDig_ATS.LowLim_C PSPDig_ATS.UpLim_C PSPDig_ATS.CnvFac_C PSPDig_ATS.CnvOfs_C PSPDig_ATS.DfltVal_C PSP_DigOutp.tiBtwTstSCB_C PSP_DigOutp.tiBtwTstOT_C PSP_DigOutp.numTstMax_C PSP_stPsDiaDisbl_C PSP_stPsDisbl_C /end DEF_CHARACTERISTIC
 /begin IN_MEASUREMENT DevLib_stPwrStgEnaCond MoCSOP_stActvMsg PSP_st /end IN_MEASUREMENT
 /begin OUT_MEASUREMENT PSP_stPs /end OUT_MEASUREMENT
 /begin LOC_MEASUREMENT PSP_stActv_mp /end LOC_MEASUREMENT
 FUNCTION_VERSION "52.2.0" /end FUNCTION
/begin FUNCTION PT2ME "137.1.0   Interface Adapter PT to MED 7/9"
 /begin DEF_CHARACTERISTIC CoPT_flgFcoInhbEna_C CoPT_flgFuCutOffActvEna_C PT2ME_CW PT2ME_numGearAsgn_T PT2ME_tiThresAftEngSt_C VF2ME_DMRWAN_C /end DEF_CHARACTERISTIC
 /begin REF_CHARACTERISTIC MDNORM /end REF_CHARACTERISTIC
 /begin IN_MEASUREMENT APP_bPlaBrk CoEng_flgRelsFco Com_flgCvtFcoPrms Com_stHvyDecelFlg Conv_trqLd CoPT_bTraShftActvDes Gbx_stPNPos PT_bConvSlip PT_bConvSlipOpn PT_bGrip PT_bNoGrip PT_rTraGear PT_stTraShftOp PT_stTraType SpdGov_trqSet tnst_w_msg Tra_numGear Tra_numGearDes VehMot_rTrqDfftl /end IN_MEASUREMENT
 /begin OUT_MEASUREMENT APP_stPlaBrk B_fs_msg B_gsch_msg B_gwhs_msg B_wkauf_msg B_wkr_msg B_wk_msg B_zwget_msg CoPT_flgFuCutOffActv dmrwan_msg EISGov_trq gangist_msg gangi_msg gangsist_msg gangsziel_msg InjCtl_qRaw mdwan_w_msg PT2ME_numLstGear Pt_flgFcoInhb uevges_msg uevges_w_msg /end OUT_MEASUREMENT
 FUNCTION_VERSION "137.1.0" /end FUNCTION
/begin FUNCTION PtCoornDyn_TqDes "135.10.0  Dynamic Coordination and Limitation - desired driver torque"
 /begin DEF_CHARACTERISTIC PtCoornDyn_dtqIntvMinSpdCtrlNegSlop_C PtCoornDyn_dtqIntvMinSpdCtrlPosSlop_C PtCoornDyn_nIdleSpdDelta_C PtCoornDyn_nIdleSpdOffst_C /end DEF_CHARACTERISTIC
 /begin IN_MEASUREMENT ASDrf_trqClthFlt CoVeh_trqAcs HLSDem_nSetPLo LsComp_tqCmpActvSpdGovr LsComp_tqSwilLossNotFild PT_nClth PT_tqCluTrsmProtn RngMod_trqCrSMin RngMod_trqCrSMinWoCtOff RngMod_trqCrSSetMax SpdGov_trqClth SpdGov_trqClthLimMechDes Tra_trqDesMax Tra_trqDesMin VehMot_tqCluDesGenericLimn VMSI_tqCluDesMax VMSI_tqCluMin /end IN_MEASUREMENT
 /begin OUT_MEASUREMENT PtCoornDyn_flgGenericLimnActvDes PtCoornDyn_flgSpdCtrlDecIntvOvrd PtCoornDyn_flgStabyIntvActvDes PtCoornDyn_flgStabyIntvDecActvDes PtCoornDyn_flgStabyIntvIncActvDes PtCoornDyn_flgTrsmIntvActvDes PtCoornDyn_flgTrsmIntvDecActvDes PtCoornDyn_flgTrsmIntvIncActvDes PtCoornDyn_tqCluDes PtCoornDyn_tqCluDesGenericLimn PtCoornDyn_tqCluDesWithMeclLimn PtCoornDyn_tqCluDesWoIntv PtCoornDyn_tqCluDesWoTrsmIntv PtCoornDyn_tqCluStabyIntvDecLimDes PtCoornDyn_tqCluStabyIntvIncLimDes PtCoornDyn_tqCluTrsmIntvDecLimDes PtCoornDyn_tqCluTrsmIntvDecLimDesWoIncStabyLimn PtCoornDyn_tqCluTrsmIntvIncLimDes /end OUT_MEASUREMENT
 /begin LOC_MEASUREMENT PtCoornDyn_tqCluDecIntvMinLimn PtCoornDyn_tqCluMax PtCoornDyn_tqCluMin PtCoornDyn_tqCluStabyIntvInc PtCoornDyn_tqCrksftDecIntvMinLimn PtCoornDyn_tqCrksftMin PtCoornDyn_tqDmdFromSpdGovr /end LOC_MEASUREMENT
 FUNCTION_VERSION "135.10.0" /end FUNCTION
/begin FUNCTION PtCoornDyn_TqLead "138.0.0   Dynamic Coordination and Limitation - Lead Path"
 /begin DEF_CHARACTERISTIC PtCoornDyn_dTqRampLeadStabyIntvDecNeg_C PtCoornDyn_dTqRampLeadStabyIntvDecPos_C PtCoornDyn_dTqRampLeadTrsmIntvDecNeg_C PtCoornDyn_dTqRampLeadTrsmIntvDecPos_C PtCoornDyn_tiDlyLeadStabyIntvDec_C PtCoornDyn_tiDlyLeadTrsmIntvDec_C /end DEF_CHARACTERISTIC
 /begin IN_MEASUREMENT ASDrf_trqClthLeadEng CoVeh_trqAcs LsComp_tqCmpActvSpdGovr LsComp_tqSwilLossNotFild PtCoornDyn_flgSpdCtrlDecIntvOvrd PT_tqCluTrsmProtn RngMod_trqCrSMin RngMod_trqCrSMinWoCtOff SpdGov_trqClthLimMechLead SpdGov_trqLead StatyCoorn_flgEnaBypCmpdTq TMERng_tqCrksftLeadMaxStabCdn Tra_trqLeadMax Tra_trqLeadMin VehMot_tqCluLeadGenericLimn VMSI_tqCluLeadMax VMSI_tqCluMin /end IN_MEASUREMENT
 /begin OUT_MEASUREMENT PtCoornDyn_stIntvLead PtCoornDyn_tqCluLeadGenericLimn PtCoornDyn_tqCluLeadStabyIntv PtCoornDyn_tqCluLeadTrsmIntv PtCoornDyn_tqCrksftLead /end OUT_MEASUREMENT
 /begin LOC_MEASUREMENT PtCoornDyn_tqCluDecIntvMinLimnLead PtCoornDyn_tqCluLeadAftStabyIntvInc_MP PtCoornDyn_tqCluLeadAftTrsmIntvDec_MP PtCoornDyn_tqCluLeadBefIntvCoorn PtCoornDyn_tqCluLeadDesGenericLimn PtCoornDyn_tqCluLeadStabyIntvDecAftRamp_MP PtCoornDyn_tqCluLeadStabyIntvDec_MP PtCoornDyn_tqCluLeadStabyIntvInc_MP PtCoornDyn_tqCluLeadTrsmIntvDecAftRamp_MP PtCoornDyn_tqCluLeadTrsmIntvDec_MP PtCoornDyn_tqCluLeadTrsmIntvInc PtCoornDyn_tqCluLeadTrsmIntvInc_MP PtCoornDyn_tqDmdFromSpdGovrLead /end LOC_MEASUREMENT
 FUNCTION_VERSION "138.0.0" /end FUNCTION
/begin FUNCTION PTCOP_TrqCnv "31.6.1    Current Operating point drive train"
 /begin IN_MEASUREMENT ActMod_trqCrS CoVeh_trqAcs PT_rTrq PT_trqLos RngMod_trqCrSMax RngMod_trqCrSMin RngMod_trqCrSMinWoCtOff VehMot_rTrqDfftl /end IN_MEASUREMENT
 /begin OUT_MEASUREMENT PT_tqCluMinEngWoFco PT_tqWhlMinEngWoFco PT_trqClthMax PT_trqClthMin PT_trqWhl PT_trqWhlMax PT_trqWhlMin PT_trqWhlMinEng /end OUT_MEASUREMENT
 FUNCTION_VERSION "31.6.1" /end FUNCTION
/begin FUNCTION PTDist_Dyn "16.1.0    Dynamic Torque Distribution for Hybrid Vehicle"
 /begin DEF_CHARACTERISTIC PTDist_flgIaRelsLeadFil_C PTDist_flgLADIaRels_C PTDist_tqDiffIARlsNegACOffIdleHi_T PTDist_tqDiffIARlsNegACOffIdleLo_T PTDist_tqDiffIARlsNegACOnIdleHi_T PTDist_tqDiffIARlsNegACOnIdleLo_T PTDist_tqDiffIARlsNegACOnNonIdleHi_T PTDist_tqDiffIARlsNegACOnNonIdleLo_T PTDist_tqDiffIARlsPosACOnHi_T PTDist_tqDiffIARlsPosACOnLo_T PTDist_tqHiThdLADIaRels_C PTDist_tqHiThdLeadFilInactv_C PTDist_tqICEMaxOffs_C PTDist_tqLoThdLADIaRels_C PTDist_tqLoThdLeadFilInactv_C PTDist_trqDiffDynIntvActvNeg_T PTDist_trqDiffDynIntvActvPos_T PTDist_trqOfsDynActvNeg_T PTDist_trqOfsDynActvPos_T /end DEF_CHARACTERISTIC
 /begin IN_MEASUREMENT ActMod_trqClthWoDstC AirC_stPsCmpr ASDrf_bNoRmp ASDrf_bPosNegDes ASDrf_trqClthMax B_ll_msg CoETS_bFltDemLead CoVeh_trqAcs PtCoornDyn_flgStabyIntvActvDes PtCoornDyn_flgTrsmIntvActvDes PtCoornDyn_tqCluDes PtCoornDyn_tqCluDesWoIntv PtCoornDyn_tqCluDesWoTrsmIntv RngMod_trqCrSMin RngMod_trqCrSSetMax SpdGov_bNLimActv StatyCoorn_tqCluDesLimd SyC_ctPostDrvLeave Tra_trqDesMax VMSI_tqCluDesMax /end IN_MEASUREMENT
 /begin OUT_MEASUREMENT PTDist_flgIgnAgRelsDynEng PTDist_flgIgnAgRelsNoRmp PTDist_flgIgnAgRelsRmp PTDist_flgTqICESetMax PTDist_tqCluSetStabyIntv PTDist_tqCluSetWoIntv PTDist_tqCrksftSet /end OUT_MEASUREMENT
 /begin LOC_MEASUREMENT PTDist_cntrReIni PTDist_flgLADIaRels PTDist_tqHiThdLeadFilActv PTDist_tqIntvMin PTDist_tqLoThdLeadFilActv /end LOC_MEASUREMENT
 FUNCTION_VERSION "16.1.0" /end FUNCTION
/begin FUNCTION PthLead_TrqCalc "26.0.0_1.2.0PathLead Torque Calculation" /begin DEF_CHARACTERISTIC PthLead_stTrqCalc_CW /end DEF_CHARACTERISTIC
 /begin IN_MEASUREMENT ASDrf_trqClthFlt CoETS_trqInrLeadCo CoETS_trqLimLead CoPT_trqResvEng CoVeh_trqAcs EGSDCmn_tqResvParl EGSys_etaCH EngDem_trqInrLim EngReq_trqResvQckTst EngTrqPtd_trqLead LsComp_tqCmpActvSpdGovr LsComp_tqSwilLossNotFild PhyMod_etaIgnBsAvrg PhyMod_etaIgnMin PtCoornDyn_flgStabyIntvActvDes PtCoornDyn_flgTrsmIntvActvDes PtCoornDyn_tqCluDes PtCoornDyn_tqCluDesWoTrsmIntv RngMod_trqCrSMin SpdGov_trqFlt SpdGov_trqLead /end IN_MEASUREMENT
 /begin OUT_MEASUREMENT PthLead_stActvMonLim PthLead_stTrqResvActv PthLead_trqInrLead PthLead_trqInrNoMon PthLead_trqResv PthLead_trqResvRel PthLead_trqResvRelA PthLead_trqResvRelB /end OUT_MEASUREMENT
 /begin LOC_MEASUREMENT PthLead_bMonLim PthLead_trqCHRef PthLead_trqDes PthLead_trqDesRef PthLead_trqResvEta /end LOC_MEASUREMENT
 FUNCTION_VERSION "26.0.0_1.2.0" /end FUNCTION
/begin FUNCTION PThrVlvUs_Vd "1.7.0     Pressure throttle valve upstream (virtual device)"
 /begin DEF_CHARACTERISTIC PThrVlvUs_nSwtSynCalcThd_C PThrVlvUs_pDifAirFilMax_C PThrVlvUs_pDifAirFilUsVehV_T PThrVlvUs_pSnsrTolrMax_C PThrVlvUs_pSubValMax_C PThrVlvUs_pSubValMin_C /end DEF_CHARACTERISTIC
 /begin IN_MEASUREMENT Epm_nEng Epm_stSync PEnv_dpAirFilThr PEnv_p PEnv_pRaw VehV_v /end IN_MEASUREMENT
 /begin OUT_MEASUREMENT B_pvdg_msg fpvd_w_msg PThrVlvUs_facNom PThrVlvUs_facNomB1 PThrVlvUs_facNrmPEnv PThrVlvUs_flgPVld PThrVlvUs_flgPVldB1 PThrVlvUs_p PThrVlvUs_pB1 PThrVlvUs_pMax PThrVlvUs_pMaxB1 PThrVlvUs_pMin PThrVlvUs_pMinB1 pvdmn_w_msg pvdmx_w_msg pvd_w_msg pvlf_w_msg vpvdkpu_w_msg /end OUT_MEASUREMENT
 FUNCTION_VERSION "1.7.0" /end FUNCTION
/begin FUNCTION PthSet_IARls "12.9.0    PathSet Ignition Angle Release"
 /begin DEF_CHARACTERISTIC PthSet_dtrqIARlsRmp2_C PthSet_dtrqIARlsRmp_MAP PthSet_stIaRlsCmftMask_C PthSet_stIaRlsIntvMask_C PthSet_stIaRlsSlowRampMask_C PthSet_stIaRlsWoIntvMask_C PthSet_stIaRlsWoTrsmIntvMask_C PthSet_stSwtNoGripSeln_C PthSet_trqIARlsRmpActvnThd_C /end DEF_CHARACTERISTIC
 /begin IN_MEASUREMENT AirSys_bTrqInflCmft CoEng_bModtr CoEng_bStrtEndIA CoEng_bStrtEndTrqStruct CoEOM_flgCvlcIgnRels CoETS_trqInrSetCo DOGov_bActv GlbDa_stTrqDem PtCoornDyn_flgStabyIntvActvDes PTDist_flgIgnAgRelsDynEng PTDist_flgIgnAgRelsNoRmp PTDist_flgIgnAgRelsRmp PthLead_stTrqResvActv PthSet_stOvrRunPhActv PT_bNoGrip RngMod_trqInrBs SpdGov_bNLimActv Tra_numGear Tra_stAST /end IN_MEASUREMENT
 /begin OUT_MEASUREMENT PthSet_bIARlsNoIntv PthSet_bIARlsNoTraIntv PthSet_bIARlsWoDstC PthSet_dtqRmpIgnAgRls PthSet_flgIgnAgRlsRmpActvn PthSet_stIgnAgRls /end OUT_MEASUREMENT
 FUNCTION_VERSION "12.9.0" /end FUNCTION
/begin FUNCTION PthSet_OvrRun "21.11.0_159.1.0PathSet OverRun"
 /begin DEF_CHARACTERISTIC PthSet_facFCOMin_C PthSet_flgEnaOvrRunHyst_C PthSet_nOvrRunThres_C PthSet_numMaxCylCtOff_C PthSet_stOvrRun_CW PthSet_SwtFCOTqInhbn_C PthSet_tiFcoDlyTmr_C PthSet_tiMaxPhRstrt_C PthSet_tiUpShift_CUR PthSet_tqLoadBasdThdFcoOff_CUR PthSet_tqLoadBasdThdFcoOn_CUR PthSet_trqHysOvrRun_C /end DEF_CHARACTERISTIC
 /begin IN_MEASUREMENT AirSys_bTrqInflLimp CoEng_bCtOffConDel CoEng_bFrstStrtEnd CoEng_bStrtEndTrqStruct CoETS_bTraIntvActv CoETS_trqInrSetCo Com_flgUpshiftMod ECT_bFCOEnaCmpnPrt Epm_nEng10ms Gbx_numGearTrgt GlbDa_stTrqDem InjSys_bInjVlvActv InjSys_stActRedStg LIGov_nDiff PthSet_stActvMonLim PthSet_trqInrCtOff PT_flgLimnFCOReq rl_w_msg RngMod_trqInrBsMin RngMod_trqInrMinWoCtOff SpdGov_bEngPrtLimOvrSpd TCE_flgGenericFcoReq TCE_flgGenericFcoRst TrqCnv_numRedStgDem /end IN_MEASUREMENT
 /begin OUT_MEASUREMENT PthSet_bCylIndivFCOAft PthSet_bCylIndivFCOBef PthSet_bEnaFCO PthSet_bEnaIndivRes PthSet_bOvrRun PthSet_stCylIndivCtOff PthSet_stOvrRun PthSet_stOvrRunEna PthSet_stOvrRunPhActv PthSet_stTrgFCO /end OUT_MEASUREMENT
 /begin LOC_MEASUREMENT PthSet_bEnaCylIndivFCO PthSet_bOvrRunCdnPrsnt PthSet_bPhCO PthSet_bUpShiftDly PthSet_stFcoDlyTmrtmp PthSet_stToffDlytmp PthSet_trqInrBsMinFCO_mp /end LOC_MEASUREMENT
 FUNCTION_VERSION "21.11.0_159.1.0" /end FUNCTION
/begin FUNCTION PthSet_TrqDist "11.4.1_159.2.0PathSet Torque Distribution"
 /begin DEF_CHARACTERISTIC PthSet_dTqIgnAgRlsPos_C PthSet_dtrqIALckRmp2_C PthSet_dtrqIALckRmp_C PthSet_facMonFCOLo_C PthSet_flgInnrLimdCutOffEna_C PthSet_stTrqDist_CW PthSet_tqIARmpOffset_C /end DEF_CHARACTERISTIC
 /begin IN_MEASUREMENT ASDdc_trq CoEng_bStrtEndIA CoETS_trqInrLimSet CoETS_trqInrSetCo EngDem_trqInrLimCtOff EngTrqPtd_trqSet EpmCrS_tiSeg InjSys_bInjVlvActv PTDist_flgTqICESetMax PthSet_bIARlsWoDstC PthSet_dtqRmpIgnAgRls PthSet_flgIgnAgRlsRmpActvn RngMod_trqInrBs RngMod_trqInrBsMax RngMod_trqInrBsMin SpdGov_trqClth SpdGov_trqSet /end IN_MEASUREMENT
 /begin OUT_MEASUREMENT PthSet_bIAIntv PthSet_stActvMonLim PthSet_stIARls PthSet_trqInrCtOff PthSet_trqInrDes PthSet_trqInrIA PthSet_trqInrIABef PthSet_trqInrLim PthSet_trqInrLtd PthSet_trqInrWoDstC PthSet_trqRmpIALck /end OUT_MEASUREMENT
 /begin LOC_MEASUREMENT PthSet_bIARlsMon PthSet_bIARlsWiMon PthSet_bMonLimFCO PthSet_bMonLimIA PthSet_stRampActv PthSet_stRampPosn PthSet_tqIARIsRamp PthSet_tqInnrLimdRamp PthSet_trqInrDes_mp PthSet_trqInrLtdIA PthSet_trqInrLtdWoDstC_mp PthSet_trqInrWoDstCBef /end LOC_MEASUREMENT
 FUNCTION_VERSION "11.4.1_159.2.0" /end FUNCTION
/begin FUNCTION PTLo_LosCalc "3.12.0    Drive train loss" /begin IN_MEASUREMENT Conv_trqLd Conv_trqResv RngMod_trqComp Tra_trqLos /end IN_MEASUREMENT /begin OUT_MEASUREMENT PT_trqLos PT_trqLosComp PT_trqResv /end OUT_MEASUREMENT FUNCTION_VERSION "3.12.0" /end FUNCTION
/begin FUNCTION PTODi_SpdCoord "31.1.0    Task distributor of the drive train - speed co-ordination" /begin DEF_CHARACTERISTIC CoPT_nMinSysErrLim_C /end DEF_CHARACTERISTIC
 /begin IN_MEASUREMENT AccPed_nMax AccPed_nMin AccPed_stNSetP CoME_nMax CoME_nMin CoME_stNSetP HiPSys_flgDeactvnFuInjInhbn Tra_nASTDes Tra_nMax Tra_nMin Tra_stAST Tra_stNSetP Tra_tiASTDes /end IN_MEASUREMENT
 /begin OUT_MEASUREMENT CoPT_nASTDes CoPT_nMaxAcs CoPT_nMaxSysErr CoPT_nMaxTra CoPT_nMinAcs CoPT_nMinSysErr CoPT_nMinTra CoPT_stAST CoPT_stNSetPAcs CoPT_stNSetPSysErr CoPT_stNSetPTra CoPT_tiASTDes /end OUT_MEASUREMENT
 FUNCTION_VERSION "31.1.0" /end FUNCTION
/begin FUNCTION PTSSE_SetData "10.0.0    PowerTrainStopStartEngine"
 /begin DEF_CHARACTERISTIC PTSSE_bStrtEnaCVT_C PTSSE_stGbxSpstReqActv_C PTSSE_stSpstReq_T /end DEF_CHARACTERISTIC
 /begin IN_MEASUREMENT Com_stPreStop Com_stTranStop Gbx_stSpstReq T15_st /end IN_MEASUREMENT
 /begin OUT_MEASUREMENT PT_bEngStopEna PT_bEngStopReq PT_bEngStrtEna PT_bEngStrtReq /end OUT_MEASUREMENT
 FUNCTION_VERSION "10.0.0" /end FUNCTION
/begin FUNCTION PT_Axispoints "59.0.0    Defines the supporting points for PT" FUNCTION_VERSION "59.0.0" /end FUNCTION
/begin FUNCTION PT_ComSigPrepn "27.0.0    Signal Preparation of powertrain Information which are communicated to other ECUs"
 /begin DEF_CHARACTERISTIC PT_cntrEngActvIgn_C PT_flgIndcdLimnBascTq_C PT_flgInnrTqLimEna_C PT_flgTqLimnInnr_C PT_swtEngTqEstimtdSeln_C Pt_tiAcOffDetn_C PT_tiAcOnDetn_C PT_tiEngLimActvDesDly_C PT_tqDrvrDmdMinThd_C PT_trqRateLimitActvDiff_C PT_trqRateLimitActvTrqTh_C PT_trqRateLimit_C /end DEF_CHARACTERISTIC
 /begin REF_CHARACTERISTIC KFMIOP MDNORM /end REF_CHARACTERISTIC
 /begin IN_MEASUREMENT ActMod_trqInr AC_trqDes AirMod_ratChrgAirCylAdv_a anztib_msg B_ll_msg B_vhegv B_vhegzw CoME_trqDesComp Com_rTrqCnvBoost Conv_trqOilPmpLoss CoVeh_trqAcs EngDem_trqInrLim Epm_nEng etazaist_w_msg etazwist_w_msg etazwsol_w_msg fmi2trq_w_msg Gen_ctCylAdv Ign_ia_real_s8 LIGov_trq miopt_w_msg PtCoornDyn_tqCluDesWoIntv PthSet_trqInrIA PT_rTrq rlfgdsvheg_w_msg rlfgdsvhek_w_msg RngMod_trqCrSMin RngMod_trqInrBs RngMod_trqInrBsMin SpdGov_facComp SpdGov_trqEngPrtLimMech TMERng_etaChrg VehMot_rTrqDfftl VMD_tqCluDes zwopt_w_msg zzaehl_w_msg zzylzue_msg /end IN_MEASUREMENT
 /begin OUT_MEASUREMENT PT_tqAcsSync PT_tqCrSMinSync PT_tqDesENGT1 PT_tqDesENGT2 PT_tqEngENG16 PT_tqEngEstimtd PT_tqRelAirDes PT_tqRelAirDesSync PT_tqRelAirReq PT_tqRelAirReqSync PT_trqEngTrqToCvt PT_trqEngTrqToCvtSync /end OUT_MEASUREMENT
 /begin LOC_MEASUREMENT PT_facRedStgEff PT_facSprkEff Pt_flgAcOff PT_flgAcOn PT_flgAcOnOffSigPls PT_flgEngActv PT_flgEngLimActvDes PT_flgEngLimDesCdn PT_flgHiVTLarge PT_flgHiVTLargeSync PT_flgRateLimitActv PT_flgRateLimitActvSync PT_flgRateLimitArea PT_flgRateLimitAreaSync PT_flgRateLimitTrqDiff PT_flgRateLimitTrqDiffSync PT_flgTqVTLoHiOld PT_flgTqVTLoHiOldSync PT_flgVTSwt PT_flgVTSwtSync PT_flgZeroCrs PT_flgZeroCrsSync PT_rAirBasdOptTqDes PT_rAirBasdOptTqDesSync PT_rAirBasdOptTqReq PT_rAirBasdOptTqReqSync PT_rEngTq PT_tqCluDesCmp PT_tqCluDesWoIntv PT_tqCrksftDesOld PT_tqCrksftDesOldSync PT_tqEngCrksftEstimd PT_tqEngCrksftEstimdSync PT_tqEngEstimtdSync PT_tqEngEstimtdTmp PT_tqEngPrtLimMechInnr PT_tqInrSync PT_trqCrSHiVT PT_trqCrSHiVTSync PT_trqCrSLoVT PT_trqCrSLoVTSync PT_trqDiff PT_trqDiffSync PT_trqMax PT_trqMaxSync PT_trqTgtTrqCrS PT_trqTgtTrqCrSSync redistar TMECmb_IfEtaIaTqAct_I.HSPActv TMECmb_IfEtaIaTqAct_I.f2kazw TMECmb_IfEtaIaTqAct_I.flb TMECmb_IfEtaIaTqAct_I.lamsbg TMECmb_IfEtaIaTqAct_I.nEng TMECmb_IfEtaIaTqAct_I.rl TMECmb_IfEtaIaTqAct_I.rri TMECmb_IfEtaIaTqAct_I.split2ka /end LOC_MEASUREMENT
 FUNCTION_VERSION "27.0.0" /end FUNCTION
/begin FUNCTION PT_Grip "138.1.0   Drive train grip"
 /begin DEF_CHARACTERISTIC PT_flgNPosSnsrRdnt_C PT_GripCfg_CW PT_nMinAftIdle_MAP PT_rClthSlipDeb_C PT_rClthSlip_C PT_rConvSlipClsd_C PT_rConvSlipOpn_C PT_rConvSlip_C PT_rGripDfl_C PT_rGrip_C PT_rMaxThrAgChg_C PT_rMinEngLd_CUR PT_rMinThrAgChg_C PT_rNoGrip_C PT_stClthSensPrs_C PT_swtClthGrip_C PT_tiDebClthStSlip_C PT_tiThrOpngChg_C PT_vMinGrip_C /end DEF_CHARACTERISTIC
 /begin IN_MEASUREMENT B_ll_msg Clth_st CoEng_bCtOffCon Epm_nEng Gbx_bHaltDisEgdActv Gbx_stConvClth Gbx_stPNPos mrfa_w_msg PT_stTraType rl_w_msg T50_st Tra_numGear VehV_v /end IN_MEASUREMENT
 /begin OUT_MEASUREMENT PT_bAutoStrtRls PT_bClthSlip PT_bClthSlipOpn PT_bConvSlip PT_bConvSlipClsd PT_bConvSlipOpn PT_bGrip PT_bNoGrip PT_nBgnIdle PT_rGrip PT_stClthDetd /end OUT_MEASUREMENT
 /begin LOC_MEASUREMENT PT_bIdleOvrSht PT_nDifIdlSpd PT_rDifThrAgReq PT_stClth /end LOC_MEASUREMENT
 FUNCTION_VERSION "138.1.0" /end FUNCTION
/begin FUNCTION PT_SetData "4.8.0     Drive train information"
 /begin IN_MEASUREMENT Epm_dnEng Epm_nEng LsComp_tqResv PtCoornDyn_flgStabyIntvActvDes PtCoornDyn_flgStabyIntvDecActvDes PtCoornDyn_flgStabyIntvIncActvDes PtCoornDyn_flgTrsmIntvActvDes PtCoornDyn_flgTrsmIntvDecActvDes PtCoornDyn_flgTrsmIntvIncActvDes PtCoornDyn_tqCluDes PT_tqCluTrsmProtn SpdGov_st SpdGov_trqClthLimMechDes SpdGov_trqResvRel StatyCoorn_tqCluDesBefLimn VehMot_stPrpAccPed VehMot_stPrpCrCtl VehMot_stPrpLLim /end IN_MEASUREMENT
 /begin OUT_MEASUREMENT PT_dnClth PT_nClth PT_stTqDem PT_tqResvEng /end OUT_MEASUREMENT
 FUNCTION_VERSION "4.8.0" /end FUNCTION
/begin FUNCTION PT_TqDataExt "1.7.1     Determination of relevant torque data delivered to external control units for torque interventions"
 /begin DEF_CHARACTERISTIC PT_dtqNegSlopSetWoIntv_M PT_dtqNegSlopWoTrsmIntv_M PT_dtqPosSlopSetWoIntv_C PT_dtqPosSlopSetWoTrsmIntv_C PT_flgSwtIntvDrvrDmdRstFco_C PT_flgSwtStabyIntvIncSetOverrun_C PT_flgSwtTrsmIntvIncSetOvrRun_C PT_flgTqRmpIALckDsbl_C PT_tiOverrunInactvTrsmIntvDec_C PT_tiOverrunInactvWoIntv_C PT_tqDifThdHysHiDrvDmdActv_C PT_tqDifThdHysLoDrvDmdActv_C /end DEF_CHARACTERISTIC
 /begin IN_MEASUREMENT ActMod_trqCrS ActMod_trqCrSWoIntv ActMod_trqCrSWoTraIntv CoVeh_trqAcs EngTrqPtd_trqSet InjSys_bInjVlvActv PtCoornDyn_flgStabyIntvActvDes PtCoornDyn_flgStabyIntvIncActvDes PtCoornDyn_flgTrsmIntvActvDes PtCoornDyn_flgTrsmIntvIncActvDes PTDist_tqCluSetStabyIntv PTDist_tqCluSetWoIntv PthSet_bIARlsNoIntv PthSet_bIARlsNoTraIntv PthSet_bOvrRun PthSet_trqRmpIALck RngMod_trqCrSMin RngMod_trqInrBs RngMod_trqInrBsMin Tra_numGear VMD_tqCluDes /end IN_MEASUREMENT
 /begin OUT_MEASUREMENT PT_tqCluEngAllIntvExt PT_tqCluEngWoIntvExt PT_tqCluEngWoTrsmIntvExt PT_tqCrksftSetWoIntv PT_tqCrksftSetWoTrsmIntv /end OUT_MEASUREMENT
 /begin LOC_MEASUREMENT PT_bDrvDmdActvWoIntv PT_bDrvDmdActvWoTrsmIntv PT_bOvrRunInactvIntvDes PT_bOvrRunInactvTrsmIntvDes PT_bOvrRunInactvWoIntv PT_bOvrRunInactvWoTrsmIntv PT_bSetOverrunStabyIntvIncActv PT_bSetOvrRunTrsmIntvIncActv PT_dtqNegSlopSetWoIntv PT_dtqNegSlopWoTrsmIntv PT_flgDrvDmdActv PT_flgDrvrDmdHLR_I PT_tqCluBsWoIntv PT_tqCluBsWoTrsmIntv PT_tqCluEngPtdSet PT_tqCluRmpIALckExt PT_tqCluSetWoIntvFcoLimd PT_tqCluSetWoIntvHemLimd PT_tqCluSetWoTrsmIntvFcoLimd PT_tqCluSetWoTrsmIntvHemLimd PT_tqCluTrsmWoIntv PT_tqCluTrsmWoTrsmIntv PT_tqCluWoIntv PT_tqCluWoTrsmIntv /end LOC_MEASUREMENT
 FUNCTION_VERSION "1.7.1" /end FUNCTION
/begin FUNCTION PT_TrqRat "2.6.0     Powertrain Torque Ratio"
 /begin DEF_CHARACTERISTIC PT_rTrqDfl_C PT_swtDetTypeCAN_C PT_swtTrqRatNoFrz_C PT_vMinTrqRat_C /end DEF_CHARACTERISTIC
 /begin IN_MEASUREMENT Gbx_rTrq GlbDa_vX PT_bGrip PT_bNoGrip PT_rTraGear PT_stTraType Tra_bRTraCan /end IN_MEASUREMENT
 /begin OUT_MEASUREMENT PT_rTrq PT_rTrqWoConvRat /end OUT_MEASUREMENT
 /begin LOC_MEASUREMENT PT_rTrqTmp1_mp PT_rTrqTmp2_mp /end LOC_MEASUREMENT
 FUNCTION_VERSION "2.6.0" /end FUNCTION
/begin FUNCTION rba_BypAdapt "1.44.0    Adapter to the DGS Bypass functionality" FUNCTION_VERSION "1.44.0" /end FUNCTION
/begin FUNCTION rba_DcmCore_If "1.8.0     MSR Interface generator for Autosar DCM" FUNCTION_VERSION "1.8.0" /end FUNCTION
/begin FUNCTION rba_DiagAdapt "1.13.0    Adaption of the Diagcom Interfaces to Autosar DCM to enable usage of ComDia and DiaBas with DCM" FUNCTION_VERSION "1.13.0" /end FUNCTION
/begin FUNCTION rba_EepAdaptDGS "1.41.0    Eep adapter" /begin DEF_CHARACTERISTIC Eep_ClrWrCounter_CW Eep_EnFirstInit_CW Eep_EnvRamClr_CW /end DEF_CHARACTERISTIC /begin OUT_MEASUREMENT B_eepwf B_pwf Eep_EnvRamHist Eep_EnvRamInvld /end OUT_MEASUREMENT
 /begin LOC_MEASUREMENT Eep_ctAbsCallWrFkt Eep_ctCallWrFkt Eep_ctMaxCallWrFkt Eep_PostdrvBlkIdx_s16 Eep_stBlk Eep_stMain Eep_stPostDrv /end LOC_MEASUREMENT
 FUNCTION_VERSION "1.41.0" /end FUNCTION
/begin FUNCTION rba_MemDiag "2.9.0     OBD diagnosis for memory components"
 /begin OUT_MEASUREMENT rba_MemDiagExtd_nrLstReadSngErr rba_MemDiag_flgInhbDiag rba_MemDiag_nrLstReadErr rba_MemDiag_nrLstWrErr /end OUT_MEASUREMENT
 FUNCTION_VERSION "2.9.0" /end FUNCTION
/begin FUNCTION Reset_CallBack "8.5.0     callback function for Reset-Package"
 /begin IN_MEASUREMENT APP_rUnFlt BattU_u CoETS_rTrq Epm_nEng GlbDa_lTotDst T15_st VehV_v /end IN_MEASUREMENT
 /begin OUT_MEASUREMENT Reset_Env_ctRst Reset_Env_xGrp Reset_Env_xId /end OUT_MEASUREMENT
 /begin LOC_MEASUREMENT Reset_APP_rUnFlt Reset_BattU_u Reset_CoETS_rTrq Reset_Epm_nEng Reset_GlbDa_lTotDst Reset_T15_st Reset_VehV_v /end LOC_MEASUREMENT
 FUNCTION_VERSION "8.5.0" /end FUNCTION
/begin COMPU_METHOD AirMassPerCyl "" RAT_FUNC "%6.3" "mg/Hub" COEFFS 0 10 0 0 0 1 /end COMPU_METHOD
/begin COMPU_METHOD B_TRUE "" TAB_VERB "%6.3" "" COMPU_TAB_REF B_TRUE /end COMPU_METHOD
/begin COMPU_VTAB B_TRUE "" TAB_VERB 2 0 "FALSE" 1 "TRUE" /end COMPU_VTAB
/begin COMPU_METHOD dez "" RAT_FUNC "%6.2" "" COEFFS 0 1 0 0 0 1 /end COMPU_METHOD
/begin COMPU_METHOD Eep_MainStates_Verb "" TAB_VERB "%6.3" "" COMPU_TAB_REF Eep_MainStates_Verb /end COMPU_METHOD
/begin COMPU_VTAB Eep_MainStates_Verb "" TAB_VERB 15 0 "EEP_SHUTDWN_RUN" 1 "EEP_INI_RUN" 2 "EEP_MIGRATION_RUN" 3 "EEP_INI_INTERNAL" 4 "EEP_NORMAL_RUN" 5 "EEP_BEGPD_REQUEST" 6 "EEP_BEGPD_RUN" 7 "EEP_ENDPD_REQUEST" 8 "EEP_ENDPD_RUN" 9 "EEP_PREDRV_REQUEST" 10 "EEP_PREDRV_RUN" 11 "EEP_FIRSTINIT_INI" 12 "EEP_RAM_INI" 13 "EEP_ENVRAM_INI" 14 "EEP_REINIT_INI" /end COMPU_VTAB
/begin COMPU_METHOD Eep_PostDrvState_Verb "" TAB_VERB "%6.3" "" COMPU_TAB_REF Eep_PostDrvState_Verb /end COMPU_METHOD
/begin COMPU_VTAB Eep_PostDrvState_Verb "" TAB_VERB 5 0 "EEP_POSTDRV_INI" 1 "EEP_POSTDRV_SEARCHBLKIDX" 2 "EEP_POSTDRV_SAVEBLK" 3 "EEP_POSTDRV_SAVEBLK_PENDING" 4 "EEP_POSTDRV_WAIT" /end COMPU_VTAB
/begin COMPU_METHOD EngN "" RAT_FUNC "%6.3" "rpm" COEFFS 0 2 0 0 0 1 /end COMPU_METHOD
/begin COMPU_METHOD EngNGrd "" RAT_FUNC "%6.3" "rpm/s" COEFFS 0 2 0 0 0 1 /end COMPU_METHOD
/begin COMPU_METHOD EnrgPerMass "" RAT_FUNC "%6.3" "MJ/Kg" COEFFS 0 10 0 0 0 1 /end COMPU_METHOD
/begin COMPU_METHOD Fact100 "" RAT_FUNC "%6.4" "-" COEFFS 0 100 0 0 0 1 /end COMPU_METHOD
/begin COMPU_METHOD fak_q0p000122 "" RAT_FUNC "%6.5" "1/(g*s)" COEFFS 0 65536 0 0 0 8 /end COMPU_METHOD
/begin COMPU_METHOD fak_q0p02 "" RAT_FUNC "%6.4" "" COEFFS 0 50 0 0 0 1 /end COMPU_METHOD
/begin COMPU_METHOD fak_q0p1 "" RAT_FUNC "%6.3" "-" COEFFS 0 1 0 0 0 0.1 /end COMPU_METHOD
/begin COMPU_METHOD fak_q3p0518Em5 "" RAT_FUNC "%7.6" "" COEFFS 0 32768 0 0 0 1 /end COMPU_METHOD
/begin COMPU_METHOD fak_ub_b1 "" RAT_FUNC "%6.4" "-" COEFFS 0 256 0 0 0 1 /end COMPU_METHOD
/begin COMPU_METHOD fak_ub_b2 "" RAT_FUNC "%8.5" "-" COEFFS 0 256 0 0 0 2 /end COMPU_METHOD
/begin COMPU_METHOD fak_uw_b1 "" RAT_FUNC "%7.6" "-" COEFFS 0 65536 0 0 0 1 /end COMPU_METHOD
/begin COMPU_METHOD fak_uw_b16 "" RAT_FUNC "%6.5" "-" COEFFS 0 65536 0 0 0 16 /end COMPU_METHOD
/begin COMPU_METHOD fak_uw_b2 "" RAT_FUNC "%7.6" "-" COEFFS 0 65536 0 0 0 2 /end COMPU_METHOD
/begin COMPU_METHOD fak_uw_b8 "" RAT_FUNC "%6.5" "-" COEFFS 0 65536 0 0 0 8 /end COMPU_METHOD
/begin COMPU_METHOD InjMassPerTime "" RAT_FUNC "%6.4" "Kg/h" COEFFS 0 100 0 0 0 1 /end COMPU_METHOD
/begin COMPU_METHOD j_q0p000153 "" RAT_FUNC "%6.5" "kg m^2" COEFFS 0 65536 0 0 0 10 /end COMPU_METHOD
/begin COMPU_METHOD Length "" RAT_FUNC "%6.2" "m" COEFFS 0 1 0 0 0 1 /end COMPU_METHOD
/begin COMPU_METHOD mdgrad_q10 "" RAT_FUNC "%6.1" "Nm/s" COEFFS 0 1 0 0 0 10 /end COMPU_METHOD
/begin COMPU_METHOD md_q0p1 "" RAT_FUNC "%6.3" "Nm" COEFFS 0 10 0 0 0 1 /end COMPU_METHOD
/begin COMPU_METHOD md_sw_q0p1 "" RAT_FUNC "%6.3" "Nm" COEFFS 0 10 0 0 0 1 /end COMPU_METHOD
/begin COMPU_METHOD Moment_Inertia "" RAT_FUNC "%6.4" "kg * m^2" COEFFS 0 100 0 0 0 1 /end COMPU_METHOD
/begin COMPU_METHOD nmotgrd_q2 "" RAT_FUNC "%6.2" "1/(min*s)" COEFFS 0 1 0 0 0 2 /end COMPU_METHOD
/begin COMPU_METHOD nmot_q0p25 "" RAT_FUNC "%6.3" "1/min" COEFFS 0 4 0 0 0 1 /end COMPU_METHOD
/begin COMPU_METHOD nmot_sw_q0p5 "" RAT_FUNC "%6.3" "1/min" COEFFS 0 2 0 0 0 1 /end COMPU_METHOD
/begin COMPU_METHOD nmot_uw_q0p25 "" RAT_FUNC "%6.3" "1/min" COEFFS 0 1 0 0 0 0.25 /end COMPU_METHOD
/begin COMPU_METHOD NmPerSec "" RAT_FUNC "%6.3" "Nm/s" COEFFS 0 10 0 0 0 1 /end COMPU_METHOD
/begin COMPU_METHOD OneToOne "" RAT_FUNC "%6.2" "-" COEFFS 0 1 0 0 0 1 /end COMPU_METHOD
/begin COMPU_METHOD pgrd_q0p3125 "" RAT_FUNC "%6.3" "hPa/s" COEFFS 0 256 0 0 0 80 /end COMPU_METHOD
/begin COMPU_METHOD Prc "" RAT_FUNC "%6.4" "%" COEFFS 0 81.92 0 0 0 1 /end COMPU_METHOD
/begin COMPU_METHOD Pwr2 "" RAT_FUNC "%6.1" "W" COEFFS 0 0.0530516476972949 0 0 0 1 /end COMPU_METHOD
/begin COMPU_METHOD p_q0p039 "" RAT_FUNC "%6.4" "hPa" COEFFS 0 256 0 0 0 10 /end COMPU_METHOD
/begin COMPU_METHOD p_q0p078 "" RAT_FUNC "%6.4" "hPa" COEFFS 0 64 0 0 0 5 /end COMPU_METHOD
/begin COMPU_METHOD p_uw_q0p039 "" RAT_FUNC "%6.4" "hPa" COEFFS 0 256 0 0 0 10 /end COMPU_METHOD
/begin COMPU_METHOD p_uw_q0p078 "" RAT_FUNC "%6.4" "hPa" COEFFS 0 256 0 0 0 20 /end COMPU_METHOD
/begin COMPU_METHOD q0p025_hPa_DIV_V "" RAT_FUNC "%6.4" "hPa/V" COEFFS 0 40 0 0 0 1 /end COMPU_METHOD
/begin COMPU_METHOD RBPtCel_dst_0p1_2 "" RAT_FUNC "%6.3" "km" COEFFS 0 10 0 0 0 1 /end COMPU_METHOD
/begin COMPU_METHOD RBPtCel_t_1p52588em5_1 "" RAT_FUNC "%7.6" "Deg C" COEFFS 0 65536 0 0 0 1 /end COMPU_METHOD
/begin COMPU_METHOD rel_q0p0234 "" RAT_FUNC "%6.4" "%" COEFFS 0 128 0 0 0 3 /end COMPU_METHOD
/begin COMPU_METHOD rel_sw_b100 "" RAT_FUNC "%6.4" "%" COEFFS 0 32768 0 0 0 100 /end COMPU_METHOD
/begin COMPU_METHOD rel_sw_b200 "" RAT_FUNC "%6.4" "%" COEFFS 0 65536 0 0 0 400 /end COMPU_METHOD
/begin COMPU_METHOD rel_ub_b99p6 "" RAT_FUNC "%6.3" "%" COEFFS 0 256 0 0 0 100 /end COMPU_METHOD
/begin COMPU_METHOD rel_uw_b100 "" RAT_FUNC "%6.4" "%" COEFFS 0 65536 0 0 0 100 /end COMPU_METHOD
/begin COMPU_METHOD rel_uw_b200 "" RAT_FUNC "%6.4" "%" COEFFS 0 65536 0 0 0 200 /end COMPU_METHOD
/begin COMPU_METHOD rel_uw_b3072 "" RAT_FUNC "%6.4" "%" COEFFS 0 65536 0 0 0 3072 /end COMPU_METHOD
/begin COMPU_METHOD rel_uw_q0p0234 "" RAT_FUNC "%6.4" "%" COEFFS 0 32 0 0 0 0.75 /end COMPU_METHOD
/begin COMPU_METHOD RmpTrq "" RAT_FUNC "%6.4" "Nm/s" COEFFS 0 655.36 0 0 0 1 /end COMPU_METHOD
/begin COMPU_METHOD SY_NSCVT_Compu "" RAT_FUNC "%6.2" "" COEFFS 0 1 0 0 0 1 /end COMPU_METHOD
/begin COMPU_METHOD SY_NSFLX_Compu "" RAT_FUNC "%6.2" "" COEFFS 0 1 0 0 0 1 /end COMPU_METHOD
/begin COMPU_METHOD SY_NSGEN_Compu "" RAT_FUNC "%6.2" "" COEFFS 0 1 0 0 0 1 /end COMPU_METHOD
/begin COMPU_METHOD SY_NSHTD_Compu "" RAT_FUNC "%6.2" "" COEFFS 0 1 0 0 0 1 /end COMPU_METHOD
/begin COMPU_METHOD SY_NSHTI_Compu "" RAT_FUNC "%6.2" "" COEFFS 0 1 0 0 0 1 /end COMPU_METHOD
/begin COMPU_METHOD SY_NSKO_Compu "" RAT_FUNC "%6.2" "" COEFFS 0 1 0 0 0 1 /end COMPU_METHOD
/begin COMPU_METHOD SY_NSLPH_Compu "" RAT_FUNC "%6.2" "" COEFFS 0 1 0 0 0 1 /end COMPU_METHOD
/begin COMPU_METHOD SY_NSLWR_Compu "" RAT_FUNC "%6.2" "" COEFFS 0 1 0 0 0 1 /end COMPU_METHOD
/begin COMPU_METHOD SY_NSPST_Compu "" RAT_FUNC "%6.2" "" COEFFS 0 1 0 0 0 1 /end COMPU_METHOD
/begin COMPU_METHOD SY_NSPTS_Compu "" RAT_FUNC "%6.2" "" COEFFS 0 1 0 0 0 1 /end COMPU_METHOD
/begin COMPU_METHOD SY_NSPWG_Compu "" RAT_FUNC "%6.2" "" COEFFS 0 1 0 0 0 1 /end COMPU_METHOD
/begin COMPU_METHOD SY_NSP_Compu "" TAB_VERB "%6.3" "" COMPU_TAB_REF SY_NSP_Compu /end COMPU_METHOD
/begin COMPU_VTAB SY_NSP_Compu "" TAB_VERB 2 0 "NO_POSTINJ" 1 "POSTINJ" /end COMPU_VTAB
/begin COMPU_METHOD SY_NSREC_Compu "" RAT_FUNC "%6.2" "" COEFFS 0 1 0 0 0 1 /end COMPU_METHOD
/begin COMPU_METHOD SY_NSRNG_Compu "" RAT_FUNC "%6.2" "" COEFFS 0 1 0 0 0 1 /end COMPU_METHOD
/begin COMPU_METHOD SY_NSSTR_Compu "" RAT_FUNC "%6.2" "" COEFFS 0 1 0 0 0 1 /end COMPU_METHOD
/begin COMPU_METHOD SY_NSTCU_Compu "" RAT_FUNC "%6.2" "" COEFFS 0 1 0 0 0 1 /end COMPU_METHOD
/begin COMPU_METHOD SY_NSTST_Compu "" RAT_FUNC "%6.2" "" COEFFS 0 1 0 0 0 1 /end COMPU_METHOD
/begin COMPU_METHOD SY_NSVSP_Compu "" RAT_FUNC "%6.2" "" COEFFS 0 1 0 0 0 1 /end COMPU_METHOD
/begin COMPU_METHOD SY_NSWIH_Compu "" RAT_FUNC "%6.2" "" COEFFS 0 1 0 0 0 1 /end COMPU_METHOD
/begin COMPU_METHOD SY_NVLD_Compu "" TAB_VERB "%6.3" "" COMPU_TAB_REF SY_NVLD_Compu /end COMPU_METHOD
/begin COMPU_VTAB SY_NVLD_Compu "" TAB_VERB 2 0 "False" 1 "True" /end COMPU_VTAB
/begin COMPU_METHOD SY_NVRAMBK_Compu "" TAB_VERB "%6.3" "" COMPU_TAB_REF SY_NVRAMBK_Compu /end COMPU_METHOD
/begin COMPU_VTAB SY_NVRAMBK_Compu "" TAB_VERB 2 0 "kein nonvolatileRAM backup" 1 "nonvolatileRAM backup" /end COMPU_VTAB
/begin COMPU_METHOD SY_NWFH_Compu "" TAB_VERB "%6.3" "" COMPU_TAB_REF SY_NWFH_Compu /end COMPU_METHOD
/begin COMPU_VTAB SY_NWFH_Compu "" TAB_VERB 2 0 "INDEP_HIGHT" 1 "DEP_HIGHT" /end COMPU_VTAB
/begin COMPU_METHOD SY_NWGA2_Compu "" TAB_VERB "%6.3" "" COMPU_TAB_REF SY_NWGA2_Compu /end COMPU_METHOD
/begin COMPU_VTAB SY_NWGA2_Compu "" TAB_VERB 5 0 "kein Phasengeber auf Nockenwelle verbaut" 1 "Phasengeber 1 auf Nockenwelle Auslass 2" 2 "Phasengeber 2 auf Nockenwelle Auslass 2" 3 "Phasengeber 3 auf Nockenwelle Auslass 2" 4 "Phasengeber 4 auf Nockenwelle Auslass 2" /end COMPU_VTAB
/begin COMPU_METHOD SY_NWGA_Compu "" TAB_VERB "%6.3" "" COMPU_TAB_REF SY_NWGA_Compu /end COMPU_METHOD
/begin COMPU_VTAB SY_NWGA_Compu "" TAB_VERB 5 0 "kein Phasengeber auf Nockenwelle verbaut" 1 "Phasengeber 1 auf Nockenwelle Auslass" 2 "Phasengeber 2 auf Nockenwelle Auslass" 3 "Phasengeber 3 auf Nockenwelle Auslass" 4 "Phasengeber 4 auf Nockenwelle Auslass" /end COMPU_VTAB
/begin COMPU_METHOD SY_NWGE2_Compu "" TAB_VERB "%6.3" "" COMPU_TAB_REF SY_NWGE2_Compu /end COMPU_METHOD
/begin COMPU_VTAB SY_NWGE2_Compu "" TAB_VERB 5 0 "kein Phasengeber auf Nockenwelle verbaut" 1 "Phasengeber 1 auf Nockenwelle Einlass 2" 2 "Phasengeber 2 auf Nockenwelle Einlass 2" 3 "Phasengeber 3 auf Nockenwelle Einlass 2" 4 "Phasengeber 4 auf Nockenwelle Einlass 2" /end COMPU_VTAB
/begin COMPU_METHOD SY_NWGE_Compu "" TAB_VERB "%6.3" "" COMPU_TAB_REF SY_NWGE_Compu /end COMPU_METHOD
/begin COMPU_VTAB SY_NWGE_Compu "" TAB_VERB 5 0 "kein Phasengeber auf Nockenwelle verbaut" 1 "Phasengeber 1 auf Nockenwelle Einlass" 2 "Phasengeber 2 auf Nockenwelle Einlass" 3 "Phasengeber 3 auf Nockenwelle Einlass" 4 "Phasengeber 4 auf Nockenwelle Einlass" /end COMPU_VTAB
/begin COMPU_METHOD SY_NWMSV_Compu "" TAB_VERB "%6.3" "" COMPU_TAB_REF SY_NWMSV_Compu /end COMPU_METHOD
/begin COMPU_VTAB SY_NWMSV_Compu "" TAB_VERB 9 0 "HDP mounted on fixed camshaft" 1 "HDP mounted on camshaft customer controlled" 2 "HDP mounted on inlet valve camshaft controlled" 3 "HDP mounted on outlet valve camshaft controlled" 4 "HDP mounted on inlet valve camshaft bank 2" 5 "HDP mounted on outlet valve camshaft bank 2" 6 "HDP mounted on intermediate shaft" 7 "HDP mounted on intermediate shaft with asymmetric" 8 "mounting of HDP is calibrated" /end COMPU_VTAB
/begin COMPU_METHOD SY_NWSA_Compu "" TAB_VERB "%6.3" "" COMPU_TAB_REF SY_NWSA_Compu /end COMPU_METHOD
/begin COMPU_VTAB SY_NWSA_Compu "" TAB_VERB 3 0 "no outlet camshaft control" 1 "2 point outlet camshaft control" 2 "continuous outlet camshaft control" /end COMPU_VTAB
/begin COMPU_METHOD SY_NWSHSS_Compu "" TAB_VERB "%6.3" "" COMPU_TAB_REF SY_NWSHSS_Compu /end COMPU_METHOD
/begin COMPU_VTAB SY_NWSHSS_Compu "" TAB_VERB 2 0 "False" 1 "True" /end COMPU_VTAB
/begin COMPU_METHOD SY_NWSKR_Compu "" TAB_VERB "%6.3" "" COMPU_TAB_REF SY_NWSKR_Compu /end COMPU_METHOD
/begin COMPU_VTAB SY_NWSKR_Compu "" TAB_VERB 2 0 "ErkennungDerVentilVerstellungDynamik_Unaktiv" 1 "ErkennungDerVentilVerstellungDynamik_Aktiv" /end COMPU_VTAB
/begin COMPU_METHOD SY_NWSV_Compu "" TAB_VERB "%6.3" "" COMPU_TAB_REF SY_NWSV_Compu /end COMPU_METHOD
/begin COMPU_VTAB SY_NWSV_Compu "" TAB_VERB 4 0 "DICP" 1 "DECP" 2 "DDCPI" 3 "DDCPE" /end COMPU_VTAB
/begin COMPU_METHOD SY_NWS_Compu "" TAB_VERB "%6.3" "" COMPU_TAB_REF SY_NWS_Compu /end COMPU_METHOD
/begin COMPU_VTAB SY_NWS_Compu "" TAB_VERB 3 0 "keine Nockenwellensteuerung vorhanden" 1 "2 Punkt Nockenwellensteuerung vorhanden" 2 "kontinuierliche Nockenwellensteuerung vorhanden" /end COMPU_VTAB
/begin COMPU_METHOD SY_OBDBR05_Compu "" TAB_VERB "%6.3" "" COMPU_TAB_REF SY_OBDBR05_Compu /end COMPU_METHOD
/begin COMPU_VTAB SY_OBDBR05_Compu "" TAB_VERB 2 0 "OBD2 2005 Biennial Review will be deactivated" 1 "OBD2 2005 Biennial Review will be activated" /end COMPU_VTAB
/begin COMPU_METHOD SY_OBMD_Compu "" TAB_VERB "%6.3" "" COMPU_TAB_REF SY_OBMD_Compu /end COMPU_METHOD
/begin COMPU_VTAB SY_OBMD_Compu "" TAB_VERB 2 0 "Overboost füllungsbasiert" 1 "Overboost momentenbasiert" /end COMPU_VTAB
/begin COMPU_METHOD SY_OSTERST_Compu "" TAB_VERB "%6.3" "" COMPU_TAB_REF SY_OSTERST_Compu /end COMPU_METHOD
/begin COMPU_VTAB SY_OSTERST_Compu "" TAB_VERB 2 0 "SY_OSTERST == 0" 1 "SY_OSTERST > 0" /end COMPU_VTAB
/begin COMPU_METHOD SY_OSTNOFF_Compu "" TAB_VERB "%6.3" "" COMPU_TAB_REF SY_OSTNOFF_Compu /end COMPU_METHOD
/begin COMPU_VTAB SY_OSTNOFF_Compu "" TAB_VERB 2 0 "FALSE" 1 "TRUE" /end COMPU_VTAB
/begin COMPU_METHOD SY_OTMERST_Compu "" TAB_VERB "%6.3" "" COMPU_TAB_REF SY_OTMERST_Compu /end COMPU_METHOD
/begin COMPU_VTAB SY_OTMERST_Compu "" TAB_VERB 2 0 "SY_OTMERST==0" 1 "SY_OTMERST>0" /end COMPU_VTAB
/begin COMPU_METHOD SY_PABMODU_Compu "" TAB_VERB "%6.3" "" COMPU_TAB_REF SY_PABMODU_Compu /end COMPU_METHOD
/begin COMPU_VTAB SY_PABMODU_Compu "" TAB_VERB 4 0 "SY_PABMODU_0" 1 "SY_PABMODU_1" 2 "SY_PABMODU_2" 3 "SY_PABMODU_3" /end COMPU_VTAB
/begin COMPU_METHOD SY_PAFGBE_Compu "" TAB_VERB "%6.3" "" COMPU_TAB_REF SY_PAFGBE_Compu /end COMPU_METHOD
/begin COMPU_VTAB SY_PAFGBE_Compu "" TAB_VERB 2 0 "end of line features not activated" 1 "end of line features activated" /end COMPU_VTAB
/begin COMPU_METHOD SY_PEMDIA_Compu "" TAB_VERB "%6.3" "" COMPU_TAB_REF SY_PEMDIA_Compu /end COMPU_METHOD
/begin COMPU_VTAB SY_PEMDIA_Compu "" TAB_VERB 6 0 "no_PEM_Diagnosis" 1 "PEM_Diag_on" 2 "PWMDIAG_20HZ" 3 "PWMDIAG_100Hz" 4 "PWMDIAG" 5 "pwm" /end COMPU_VTAB
/begin COMPU_METHOD SY_PID41_Compu "" TAB_VERB "%6.3" "" COMPU_TAB_REF SY_PID41_Compu /end COMPU_METHOD
/begin COMPU_VTAB SY_PID41_Compu "" TAB_VERB 2 0 "False" 1 "True" /end COMPU_VTAB
/begin COMPU_METHOD SY_PLNGFIL_Compu "" TAB_VERB "%6.3" "" COMPU_TAB_REF SY_PLNGFIL_Compu /end COMPU_METHOD
/begin COMPU_VTAB SY_PLNGFIL_Compu "" TAB_VERB 2 0 "false" 1 "true" /end COMPU_VTAB
/begin COMPU_METHOD SY_PSF_Compu "" TAB_VERB "%6.3" "" COMPU_TAB_REF SY_PSF_Compu /end COMPU_METHOD
/begin COMPU_VTAB SY_PSF_Compu "" TAB_VERB 2 0 "gefilterter Saugrohrdruck nicht verwendet" 1 "gefilterter Saugrohrdruck verwendet" /end COMPU_VTAB
/begin COMPU_METHOD SY_PSMXAPP_Compu "" TAB_VERB "%6.3" "" COMPU_TAB_REF SY_PSMXAPP_Compu /end COMPU_METHOD
/begin COMPU_VTAB SY_PSMXAPP_Compu "" TAB_VERB 3 0 "not for test bench" 1 "also for test bench (1 map for all lean modes)" 2 "also for test bench (maps for all lean modes)" /end COMPU_VTAB
/begin COMPU_METHOD SY_PSR2SYN_Compu "" TAB_VERB "%6.3" "" COMPU_TAB_REF SY_PSR2SYN_Compu /end COMPU_METHOD
/begin COMPU_VTAB SY_PSR2SYN_Compu "" TAB_VERB 2 0 "False" 1 "True" /end COMPU_VTAB
/begin COMPU_METHOD SY_PSTDRST_Compu "" TAB_VERB "%6.3" "" COMPU_TAB_REF SY_PSTDRST_Compu /end COMPU_METHOD
/begin COMPU_VTAB SY_PSTDRST_Compu "" TAB_VERB 2 0 "false" 1 "true" /end COMPU_VTAB
/begin COMPU_METHOD SY_PSUV_Compu "" TAB_VERB "%6.3" "" COMPU_TAB_REF SY_PSUV_Compu /end COMPU_METHOD
/begin COMPU_VTAB SY_PSUV_Compu "" TAB_VERB 2 0 "False" 1 "True" /end COMPU_VTAB
/begin COMPU_METHOD SY_PTLHC_Compu "" TAB_VERB "%6.3" "" COMPU_TAB_REF SY_PTLHC_Compu /end COMPU_METHOD
/begin COMPU_VTAB SY_PTLHC_Compu "" TAB_VERB 2 0 "False" 1 "True" /end COMPU_VTAB
/begin COMPU_METHOD SY_PTL_Compu "" TAB_VERB "%6.3" "" COMPU_TAB_REF SY_PTL_Compu /end COMPU_METHOD
/begin COMPU_VTAB SY_PTL_Compu "" TAB_VERB 2 0 "relative inner moment" 1 "Physical Torque Levels" /end COMPU_VTAB
/begin COMPU_METHOD SY_PTO_Compu "" TAB_VERB "%6.3" "" COMPU_TAB_REF SY_PTO_Compu /end COMPU_METHOD
/begin COMPU_VTAB SY_PTO_Compu "" TAB_VERB 2 0 "False" 1 "True" /end COMPU_VTAB
/begin COMPU_METHOD SY_RDE_Compu "" TAB_VERB "%6.3" "" COMPU_TAB_REF SY_RDE_Compu /end COMPU_METHOD
/begin COMPU_VTAB SY_RDE_Compu "" TAB_VERB 5 0 "inaktiv bzw. keine RDE" 1 "über Auswertung des Zahnsignals der Kurbelwelle" 2 "über Nockenwellen-Muster" 3 "über Zahnsignal der KW und NW-Muster" 4 "wie 3 und zusätzlich über Saugrohrdruck" /end COMPU_VTAB
/begin COMPU_METHOD SY_REDEX_Compu "" TAB_VERB "%6.3" "" COMPU_TAB_REF SY_REDEX_Compu /end COMPU_METHOD
/begin COMPU_VTAB SY_REDEX_Compu "" TAB_VERB 2 0 "0" 1 "1" /end COMPU_VTAB
/begin COMPU_METHOD SY_REDMI_Compu "" TAB_VERB "%6.3" "" COMPU_TAB_REF SY_REDMI_Compu /end COMPU_METHOD
/begin COMPU_VTAB SY_REDMI_Compu "" TAB_VERB 2 0 "False" 1 "True" /end COMPU_VTAB
/begin COMPU_METHOD SY_REDSTAR_Compu "" TAB_VERB "%6.3" "" COMPU_TAB_REF SY_REDSTAR_Compu /end COMPU_METHOD
/begin COMPU_VTAB SY_REDSTAR_Compu "" TAB_VERB 2 0 "FALSE" 1 "TRUE" /end COMPU_VTAB
/begin COMPU_METHOD SY_RLAPP_Compu "" TAB_VERB "%6.3" "" COMPU_TAB_REF SY_RLAPP_Compu /end COMPU_METHOD
/begin COMPU_VTAB SY_RLAPP_Compu "" TAB_VERB 2 0 "keine rlsol-Regelung vorhanden" 1 "rlsol-Regelung vorhanden" /end COMPU_VTAB
/begin COMPU_METHOD SY_RLMXKV_Compu "" TAB_VERB "%6.3" "" COMPU_TAB_REF SY_RLMXKV_Compu /end COMPU_METHOD
/begin COMPU_VTAB SY_RLMXKV_Compu "" TAB_VERB 2 0 "no_rlmxkv" 1 "rlmxkv" /end COMPU_VTAB
/begin COMPU_METHOD SY_RLRK_Compu "" TAB_VERB "%6.3" "" COMPU_TAB_REF SY_RLRK_Compu /end COMPU_METHOD
/begin COMPU_VTAB SY_RLRK_Compu "" TAB_VERB 2 0 "System ohne rl/rk-Überwachung" 1 "System mit rl/rk-Überwachung" /end COMPU_VTAB
/begin COMPU_METHOD SY_RLXDZW_Compu "" TAB_VERB "%6.3" "" COMPU_TAB_REF SY_RLXDZW_Compu /end COMPU_METHOD
/begin COMPU_VTAB SY_RLXDZW_Compu "" TAB_VERB 2 0 "False" 1 "True" /end COMPU_VTAB
/begin COMPU_METHOD SY_RLXRED_Compu "" TAB_VERB "%6.3" "" COMPU_TAB_REF SY_RLXRED_Compu /end COMPU_METHOD
/begin COMPU_VTAB SY_RLXRED_Compu "" TAB_VERB 2 0 "SY_RLXRED=0" 1 "SY_RLXRED=1" /end COMPU_VTAB
/begin COMPU_METHOD SY_RLXVD_Compu "" TAB_VERB "%6.3" "" COMPU_TAB_REF SY_RLXVD_Compu /end COMPU_METHOD
/begin COMPU_VTAB SY_RLXVD_Compu "" TAB_VERB 3 0 "SY_RLXVD_0" 1 "SY_RLXVD_1" 2 "SY_RLXVD_2" /end COMPU_VTAB
/begin COMPU_METHOD SY_RQMNUGA_Compu "" TAB_VERB "%6.3" "" COMPU_TAB_REF SY_RQMNUGA_Compu /end COMPU_METHOD
/begin COMPU_VTAB SY_RQMNUGA_Compu "" TAB_VERB 2 0 "False" 1 "True" /end COMPU_VTAB
/begin COMPU_METHOD SY_RVS_Compu "" TAB_VERB "%6.3" "" COMPU_TAB_REF SY_RVS_Compu /end COMPU_METHOD
/begin COMPU_VTAB SY_RVS_Compu "" TAB_VERB 2 0 "no remote vehicle start request" 1 "remote vehicle start request" /end COMPU_VTAB
/begin COMPU_METHOD SY_RZSZ_Compu "" TAB_VERB "%6.3" "" COMPU_TAB_REF SY_RZSZ_Compu /end COMPU_METHOD
/begin COMPU_VTAB SY_RZSZ_Compu "" TAB_VERB 2 0 "OFF" 1 "ON" /end COMPU_VTAB
/begin COMPU_METHOD SY_SAGS_Compu "" TAB_VERB "%6.3" "" COMPU_TAB_REF SY_SAGS_Compu /end COMPU_METHOD
/begin COMPU_VTAB SY_SAGS_Compu "" TAB_VERB 2 0 "False" 1 "True" /end COMPU_VTAB
/begin COMPU_METHOD SY_SALSU_Compu "" TAB_VERB "%6.3" "" COMPU_TAB_REF SY_SALSU_Compu /end COMPU_METHOD
/begin COMPU_VTAB SY_SALSU_Compu "" TAB_VERB 2 0 "kein Schubabgleich" 1 "Schubabgleich vorhanden" /end COMPU_VTAB
/begin COMPU_METHOD SY_SCG_Compu "" TAB_VERB "%6.3" "" COMPU_TAB_REF SY_SCG_Compu /end COMPU_METHOD
/begin COMPU_VTAB SY_SCG_Compu "" TAB_VERB 2 0 "False" 1 "True" /end COMPU_VTAB
/begin COMPU_METHOD SY_SCHUMZW_Compu "" RAT_FUNC "%6.2" "" COEFFS 0 1 0 0 0 1 /end COMPU_METHOD
/begin COMPU_METHOD SY_SCH_Compu "" TAB_VERB "%6.3" "" COMPU_TAB_REF SY_SCH_Compu /end COMPU_METHOD
/begin COMPU_VTAB SY_SCH_Compu "" TAB_VERB 2 0 "False" 1 "True" /end COMPU_VTAB
/begin COMPU_METHOD SY_SGANZFR_Compu "" TAB_VERB "%6.3" "" COMPU_TAB_REF SY_SGANZFR_Compu /end COMPU_METHOD
/begin COMPU_VTAB SY_SGANZFR_Compu "" TAB_VERB 2 1 "1 SG 1 FR" 2 "2 SG pro Fuel Rail" /end COMPU_VTAB
/begin COMPU_METHOD SY_SGANZ_Compu "" TAB_VERB "%6.3" "" COMPU_TAB_REF SY_SGANZ_Compu /end COMPU_METHOD
/begin COMPU_VTAB SY_SGANZ_Compu "" TAB_VERB 3 1 "Ein Steuergeräte Motormanagement Konzept" 2 "Zwei Steuergeräte Motormanagement Konzept" 3 "Drei Steuergeräte Motormanagement Konzept" /end COMPU_VTAB
/begin COMPU_METHOD SY_SKH_Compu "" TAB_VERB "%6.3" "" COMPU_TAB_REF SY_SKH_Compu /end COMPU_METHOD
/begin COMPU_VTAB SY_SKH_Compu "" TAB_VERB 2 0 "False" 1 "True" /end COMPU_VTAB
/begin COMPU_METHOD SY_SKR_Compu "" TAB_VERB "%6.3" "" COMPU_TAB_REF SY_SKR_Compu /end COMPU_METHOD
/begin COMPU_VTAB SY_SKR_Compu "" TAB_VERB 2 0 "False" 1 "True" /end COMPU_VTAB
/begin COMPU_METHOD SY_SLPANZ_Compu "" TAB_VERB "%6.3" "" COMPU_TAB_REF SY_SLPANZ_Compu /end COMPU_METHOD
/begin COMPU_VTAB SY_SLPANZ_Compu "" TAB_VERB 3 0 "keine SLP" 1 "1 SLP" 2 "2 SLP" /end COMPU_VTAB
/begin COMPU_METHOD SY_SLS_Compu "" TAB_VERB "%6.3" "" COMPU_TAB_REF SY_SLS_Compu /end COMPU_METHOD
/begin COMPU_VTAB SY_SLS_Compu "" TAB_VERB 3 0 "keine Sekundärluftpumpe vorhanden" 1 "Sekundärluftpumpe vorhanden" 2 "GGSLSHFM vorhanden" /end COMPU_VTAB
/begin COMPU_METHOD SY_SLVANZ_Compu "" TAB_VERB "%6.3" "" COMPU_TAB_REF SY_SLVANZ_Compu /end COMPU_METHOD
/begin COMPU_VTAB SY_SLVANZ_Compu "" TAB_VERB 4 0 "kein SLV" 1 "1 SLV" 2 "2 SLV" 4 "4 SLV" /end COMPU_VTAB
/begin COMPU_METHOD SY_SLVEST_Compu "" TAB_VERB "%6.3" "" COMPU_TAB_REF SY_SLVEST_Compu /end COMPU_METHOD
/begin COMPU_VTAB SY_SLVEST_Compu "" TAB_VERB 3 0 "SLVEST_ZERO" 1 "SLVEST_ONE" 2 "SLVEST_TWO" /end COMPU_VTAB
/begin COMPU_METHOD SY_SOTUN_Compu "" TAB_VERB "%6.3" "" COMPU_TAB_REF SY_SOTUN_Compu /end COMPU_METHOD
/begin COMPU_VTAB SY_SOTUN_Compu "" TAB_VERB 2 0 "False" 1 "True" /end COMPU_VTAB
/begin COMPU_METHOD SY_SPRSTRT_Compu "" TAB_VERB "%6.3" "" COMPU_TAB_REF SY_SPRSTRT_Compu /end COMPU_METHOD
/begin COMPU_VTAB SY_SPRSTRT_Compu "" TAB_VERB 2 0 "False" 1 "True" /end COMPU_VTAB
/begin COMPU_METHOD SY_SSPPSR_Compu "" TAB_VERB "%6.3" "" COMPU_TAB_REF SY_SSPPSR_Compu /end COMPU_METHOD
/begin COMPU_VTAB SY_SSPPSR_Compu "" TAB_VERB 6 0 "powersupply diagnosis deactivated" 1 "MAP sensor connected to powersupply1" 2 "MAP sensor connected to powersupply2" 3 "MAP sensor connected to powersupply3" 4 "MAP sensor connected to powersupply4" 5 "MAP sensor connected to powersupply5" /end COMPU_VTAB
/begin COMPU_METHOD SY_STADAP_Compu "" TAB_VERB "%6.3" "" COMPU_TAB_REF SY_STADAP_Compu /end COMPU_METHOD
/begin COMPU_VTAB SY_STADAP_Compu "" TAB_VERB 3 0 "no STADAP" 1 "STADAP inside" 2 "STADAP incl. fuel reset" /end COMPU_VTAB
/begin COMPU_METHOD SY_STAEVAB_Compu "" TAB_VERB "%6.3" "" COMPU_TAB_REF SY_STAEVAB_Compu /end COMPU_METHOD
/begin COMPU_VTAB SY_STAEVAB_Compu "" TAB_VERB 2 0 "False" 1 "True" /end COMPU_VTAB
/begin COMPU_METHOD SY_STARTDK_Compu "" TAB_VERB "%6.3" "" COMPU_TAB_REF SY_STARTDK_Compu /end COMPU_METHOD
/begin COMPU_VTAB SY_STARTDK_Compu "" TAB_VERB 3 0 "DK-Start-Winkel" 1 "DK-Start-Massenstrom" 2 "DK-Start-Massenstrom-und-Winkel" /end COMPU_VTAB
/begin COMPU_METHOD SY_STASTO_Compu "" TAB_VERB "%6.3" "" COMPU_TAB_REF SY_STASTO_Compu /end COMPU_METHOD
/begin COMPU_VTAB SY_STASTO_Compu "" TAB_VERB 2 0 "Kein Start-Stopp" 1 "Start-Stop vorhanden" /end COMPU_VTAB
/begin COMPU_METHOD SY_STATIST_Compu "" TAB_VERB "%6.3" "" COMPU_TAB_REF SY_STATIST_Compu /end COMPU_METHOD
/begin COMPU_VTAB SY_STATIST_Compu "" TAB_VERB 2 0 "keine Betriebsmodi-Statistik berechnen" 1 "Betriebsmodi-Statistik berechnen" /end COMPU_VTAB
/begin COMPU_METHOD SY_STA_Compu "" TAB_VERB "%6.3" "" COMPU_TAB_REF SY_STA_Compu /end COMPU_METHOD
/begin COMPU_VTAB SY_STA_Compu "" TAB_VERB 2 0 "kein Automatikstart" 1 "Automatikstart" /end COMPU_VTAB
/begin COMPU_METHOD SY_STELRHE_Compu "" TAB_VERB "%6.3" "" COMPU_TAB_REF SY_STELRHE_Compu /end COMPU_METHOD
/begin COMPU_VTAB SY_STELRHE_Compu "" TAB_VERB 2 0 "2 Punkt Lambdaregelung vorhanden" 1 "stetige Lambdaregelung mit 2-Punktsonde vorhanden" /end COMPU_VTAB
/begin COMPU_METHOD SY_STERBTS_Compu "" TAB_VERB "%6.3" "" COMPU_TAB_REF SY_STERBTS_Compu /end COMPU_METHOD
/begin COMPU_VTAB SY_STERBTS_Compu "" TAB_VERB 2 0 "kein bankselektiver Bauteileschutz" 1 "bankselektiver Bauteileschutz" /end COMPU_VTAB
/begin COMPU_METHOD SY_STERHK_Compu "" TAB_VERB "%6.3" "" COMPU_TAB_REF SY_STERHK_Compu /end COMPU_METHOD
/begin COMPU_VTAB SY_STERHK_Compu "" TAB_VERB 2 0 "Mono Lambdaregelung hinter KAT" 1 "Stereo Lambdaregelung hinter KAT" /end COMPU_VTAB
/begin COMPU_METHOD SY_STERSY_Compu "" TAB_VERB "%6.3" "" COMPU_TAB_REF SY_STERSY_Compu /end COMPU_METHOD
/begin COMPU_VTAB SY_STERSY_Compu "" TAB_VERB 2 0 "Asymmetrische Abgasanlage" 1 "Symmetrische Abgasanlage" /end COMPU_VTAB
/begin COMPU_METHOD SY_STERVK_Compu "" TAB_VERB "%6.3" "" COMPU_TAB_REF SY_STERVK_Compu /end COMPU_METHOD
/begin COMPU_VTAB SY_STERVK_Compu "" TAB_VERB 2 0 "Mono Lambdaregelung vor KAT" 1 "Stereo Lambdaregelung vor KAT" /end COMPU_VTAB
/begin COMPU_METHOD SY_STETLR_Compu "" TAB_VERB "%6.3" "" COMPU_TAB_REF SY_STETLR_Compu /end COMPU_METHOD
/begin COMPU_VTAB SY_STETLR_Compu "" TAB_VERB 2 0 "2 Punkt Lambdaregelung vorhanden" 1 "stetige Lambdaregelung vorhanden" /end COMPU_VTAB
/begin COMPU_METHOD SY_SUVTYP_Compu "" TAB_VERB "%6.3" "" COMPU_TAB_REF SY_SUVTYP_Compu /end COMPU_METHOD
/begin COMPU_VTAB SY_SUVTYP_Compu "" TAB_VERB 7 0 "SY_SUVTYP_0" 1 "SY_SUVTYP_1" 2 "SY_SUVTYP_2" 3 "SY_SUVTYP_3" 4 "SY_SUVTYP_4" 5 "SY_SUVTYP_5" 6 "SY_SUVTYP_6" /end COMPU_VTAB
/begin COMPU_METHOD SY_SUV_Compu "" TAB_VERB "%6.3" "" COMPU_TAB_REF SY_SUV_Compu /end COMPU_METHOD
/begin COMPU_VTAB SY_SUV_Compu "" TAB_VERB 2 0 "FALSE" 1 "TRUE" /end COMPU_VTAB
/begin COMPU_METHOD SY_SU_Compu "" TAB_VERB "%6.3" "" COMPU_TAB_REF SY_SU_Compu /end COMPU_METHOD
/begin COMPU_VTAB SY_SU_Compu "" TAB_VERB 3 0 "keine Saugrohrumschaltung" 1 "1 Saugrohrumschaltungsklappe" 2 "2 Saugrohrumschaltungsklappen" /end COMPU_VTAB
/begin COMPU_METHOD SY_SVBB_Compu "" TAB_VERB "%6.3" "" COMPU_TAB_REF SY_SVBB_Compu /end COMPU_METHOD
/begin COMPU_VTAB SY_SVBB_Compu "" TAB_VERB 2 0 "NOSVBB" 1 "SVBBETAS" /end COMPU_VTAB
/begin COMPU_METHOD SY_TAHEVCH_Compu "" TAB_VERB "%6.3" "" COMPU_TAB_REF SY_TAHEVCH_Compu /end COMPU_METHOD
/begin COMPU_VTAB SY_TAHEVCH_Compu "" TAB_VERB 4 0 "TAHEVCH_TMOT" 1 "TAHEVCH_CHdT_TAEV" 2 "TAHEVCH_CHdT_TEV" 3 "TAHEVCH_CHdT" /end COMPU_VTAB
/begin COMPU_METHOD SY_TAKH_Compu "" TAB_VERB "%6.3" "" COMPU_TAB_REF SY_TAKH_Compu /end COMPU_METHOD
/begin COMPU_VTAB SY_TAKH_Compu "" TAB_VERB 2 0 "False" 1 "True" /end COMPU_VTAB
/begin COMPU_METHOD SY_TANDK_Compu "" TAB_VERB "%6.3" "" COMPU_TAB_REF SY_TANDK_Compu /end COMPU_METHOD
/begin COMPU_VTAB SY_TANDK_Compu "" TAB_VERB 2 0 "False" 1 "True" /end COMPU_VTAB
/begin COMPU_METHOD SY_TANSPOS_Compu "" TAB_VERB "%6.3" "" COMPU_TAB_REF SY_TANSPOS_Compu /end COMPU_METHOD
/begin COMPU_VTAB SY_TANSPOS_Compu "" TAB_VERB 4 0 "NO_TANS" 1 "TFA1_TANS" 2 "TFA2_TANS" 3 "TFA3_TANS" /end COMPU_VTAB
/begin COMPU_METHOD SY_TASR2_Compu "" TAB_VERB "%6.3" "" COMPU_TAB_REF SY_TASR2_Compu /end COMPU_METHOD
/begin COMPU_VTAB SY_TASR2_Compu "" TAB_VERB 2 0 "False" 1 "True" /end COMPU_VTAB
/begin COMPU_METHOD SY_TASR_Compu "" TAB_VERB "%6.3" "" COMPU_TAB_REF SY_TASR_Compu /end COMPU_METHOD
/begin COMPU_VTAB SY_TASR_Compu "" TAB_VERB 2 0 "False" 1 "True" /end COMPU_VTAB
/begin COMPU_METHOD SY_TAVDK2_Compu "" TAB_VERB "%6.3" "" COMPU_TAB_REF SY_TAVDK2_Compu /end COMPU_METHOD
/begin COMPU_VTAB SY_TAVDK2_Compu "" TAB_VERB 2 0 "False" 1 "True" /end COMPU_VTAB
/begin COMPU_METHOD SY_TAVDK_Compu "" TAB_VERB "%6.3" "" COMPU_TAB_REF SY_TAVDK_Compu /end COMPU_METHOD
/begin COMPU_VTAB SY_TAVDK_Compu "" TAB_VERB 2 0 "False" 1 "True" /end COMPU_VTAB
/begin COMPU_METHOD SY_TAVVM_Compu "" TAB_VERB "%6.3" "" COMPU_TAB_REF SY_TAVVM_Compu /end COMPU_METHOD
/begin COMPU_VTAB SY_TAVVM_Compu "" TAB_VERB 6 0 "TAVVM_TUMG" 1 "TAVVM_PHYS" 2 "TAVVM_PHYS_BYPASS" 3 "TAVVM_TANLF" 4 "TAVVM_RAWSENS" 5 "TAVVM_PHYSADV_SUV" /end COMPU_VTAB
/begin COMPU_METHOD SY_TAVV_Compu "" TAB_VERB "%6.3" "" COMPU_TAB_REF SY_TAVV_Compu /end COMPU_METHOD
/begin COMPU_VTAB SY_TAVV_Compu "" TAB_VERB 2 0 "TAVV_NO" 1 "TAVV_YES" /end COMPU_VTAB
/begin COMPU_METHOD SY_TCACINT_Compu "" TAB_VERB "%6.3" "" COMPU_TAB_REF SY_TCACINT_Compu /end COMPU_METHOD
/begin COMPU_VTAB SY_TCACINT_Compu "" TAB_VERB 4 0 "no sensor" 1 "TFA1" 2 "TFA2" 3 "TFA3" /end COMPU_VTAB
/begin COMPU_METHOD SY_TCACOUT_Compu "" TAB_VERB "%6.3" "" COMPU_TAB_REF SY_TCACOUT_Compu /end COMPU_METHOD
/begin COMPU_VTAB SY_TCACOUT_Compu "" TAB_VERB 4 0 "no sensor" 1 "TFA1" 2 "TFA2" 3 "TFA3" /end COMPU_VTAB
/begin COMPU_METHOD SY_TCBCINT_Compu "" TAB_VERB "%6.3" "" COMPU_TAB_REF SY_TCBCINT_Compu /end COMPU_METHOD
/begin COMPU_VTAB SY_TCBCINT_Compu "" TAB_VERB 4 0 "no sensor" 1 "TFA1" 2 "TFA2" 3 "TFA3" /end COMPU_VTAB
/begin COMPU_METHOD SY_TCBCOUT_Compu "" TAB_VERB "%6.3" "" COMPU_TAB_REF SY_TCBCOUT_Compu /end COMPU_METHOD
/begin COMPU_VTAB SY_TCBCOUT_Compu "" TAB_VERB 4 0 "no sensor" 1 "TFA1" 2 "TFA2" 3 "TFA3" /end COMPU_VTAB
/begin COMPU_METHOD SY_TCNS_Compu "" TAB_VERB "%6.3" "" COMPU_TAB_REF SY_TCNS_Compu /end COMPU_METHOD
/begin COMPU_VTAB SY_TCNS_Compu "" TAB_VERB 2 0 "kein Testereingriff LL-Solldrehzahlumschaltung" 1 "Testereingriff LL-Solldrehzahlumschaltung" /end COMPU_VTAB
/begin COMPU_METHOD t10msxs_uw_b655p35 "" RAT_FUNC "%6.4" "s" COEFFS 0 1 0 0 0 0.01 /end COMPU_METHOD
/begin COMPU_METHOD Temp_Cels "" RAT_FUNC "%6.1" "deg C" COEFFS 0 10 2731.4 0 0 1 /end COMPU_METHOD
/begin COMPU_METHOD Thr_Cpty_ExhGs "" RAT_FUNC "%6.1" "J/kgK" COEFFS 0 0.1 0 0 0 1 /end COMPU_METHOD
/begin COMPU_METHOD TimeDelay_s_Lin_16 "" RAT_FUNC "%6.5" "s" COEFFS 0 6553.4 0 0 0 1 /end COMPU_METHOD
/begin COMPU_METHOD Time_Dt "" RAT_FUNC "%9.8" "s" COEFFS 0 1000000 0 0 0 1 /end COMPU_METHOD
/begin COMPU_METHOD Time_ms "" RAT_FUNC "%6.1" "ms" COEFFS 0 0.1 0 0 0 1 /end COMPU_METHOD
/begin COMPU_METHOD Time_ms_DT "" RAT_FUNC "%6.5" "ms" COEFFS 0 1000 0 0 0 1 /end COMPU_METHOD
/begin COMPU_METHOD Time_s "" RAT_FUNC "%6.4" "s" COEFFS 0 100 0 0 0 1 /end COMPU_METHOD
/begin COMPU_METHOD Time_s_1 "" RAT_FUNC "%6.5" "" COEFFS 0 1000 0 0 0 1 /end COMPU_METHOD
/begin COMPU_METHOD TransR "" RAT_FUNC "%6.4" "-" COEFFS 0 100 0 0 0 1 /end COMPU_METHOD
/begin COMPU_METHOD Trq "" RAT_FUNC "%6.3" "Nm" COEFFS 0 10 0 0 0 1 /end COMPU_METHOD
/begin COMPU_METHOD TrqPrpHigh "" RAT_FUNC "%6.3" "Nm" COEFFS 0 10 0 0 0 1 /end COMPU_METHOD
/begin COMPU_METHOD t_q0p01 "" RAT_FUNC "%6.4" "s" COEFFS 0 100 0 0 0 1 /end COMPU_METHOD
/begin COMPU_METHOD t_q1 "" RAT_FUNC "%6.2" "s" COEFFS 0 1 0 0 0 1 /end COMPU_METHOD
/begin COMPU_METHOD t_q10 "" RAT_FUNC "%6.1" "s" COEFFS 0 1 0 0 0 10 /end COMPU_METHOD
/begin COMPU_METHOD Vel "" RAT_FUNC "%6.4" "km/h" COEFFS 0 100 0 0 0 1 /end COMPU_METHOD
/begin COMPU_METHOD Volt_Batt "" RAT_FUNC "%6.1" "mV" COEFFS 0 0.05 0 0 0 1 /end COMPU_METHOD
/begin COMPU_METHOD Volt_q0p00007629 "" RAT_FUNC "%7.6" "V" COEFFS 0 13107.8778345786 0 0 0 1 /end COMPU_METHOD
/begin RECORD_LAYOUT Kw_Ws16 FNC_VALUES 1 SWORD COLUMN_DIR DIRECT /end RECORD_LAYOUT
/begin RECORD_LAYOUT Kw_Wu16 FNC_VALUES 1 UWORD COLUMN_DIR DIRECT /end RECORD_LAYOUT
/begin RECORD_LAYOUT RB_Curve_S16_S16 NO_AXIS_PTS_X 1 SWORD AXIS_PTS_X 2 SWORD INDEX_INCR DIRECT FNC_VALUES 3 SWORD COLUMN_DIR DIRECT /end RECORD_LAYOUT
/begin RECORD_LAYOUT RB_Curve_S16_U16_Static NO_AXIS_PTS_X 1 SWORD AXIS_PTS_X 2 SWORD INDEX_INCR DIRECT FNC_VALUES 3 UWORD COLUMN_DIR DIRECT STATIC_RECORD_LAYOUT /end RECORD_LAYOUT
/begin RECORD_LAYOUT RB_Curve_S8_U8_Static NO_AXIS_PTS_X 1 SBYTE AXIS_PTS_X 2 SBYTE INDEX_INCR DIRECT FNC_VALUES 3 UBYTE COLUMN_DIR DIRECT STATIC_RECORD_LAYOUT /end RECORD_LAYOUT
/begin RECORD_LAYOUT RB_Curve_U16_S16_Static NO_AXIS_PTS_X 1 UWORD AXIS_PTS_X 2 UWORD INDEX_INCR DIRECT FNC_VALUES 3 SWORD COLUMN_DIR DIRECT STATIC_RECORD_LAYOUT /end RECORD_LAYOUT
/begin RECORD_LAYOUT RB_Curve_U16_U16 NO_AXIS_PTS_X 1 UWORD AXIS_PTS_X 2 UWORD INDEX_INCR DIRECT FNC_VALUES 3 UWORD COLUMN_DIR DIRECT /end RECORD_LAYOUT
/begin RECORD_LAYOUT RB_Curve_U8_U8 NO_AXIS_PTS_X 1 UBYTE AXIS_PTS_X 2 UBYTE INDEX_INCR DIRECT FNC_VALUES 3 UBYTE COLUMN_DIR DIRECT /end RECORD_LAYOUT
/begin RECORD_LAYOUT RB_Map_S16S16_S32 NO_AXIS_PTS_X 1 SWORD NO_AXIS_PTS_Y 2 SWORD AXIS_PTS_X 3 SWORD INDEX_INCR DIRECT AXIS_PTS_Y 4 SWORD INDEX_INCR DIRECT FNC_VALUES 5 SLONG COLUMN_DIR DIRECT /end RECORD_LAYOUT
/begin RECORD_LAYOUT RB_Map_S16S16_U16 NO_AXIS_PTS_X 1 SWORD NO_AXIS_PTS_Y 2 SWORD AXIS_PTS_X 3 SWORD INDEX_INCR DIRECT AXIS_PTS_Y 4 SWORD INDEX_INCR DIRECT FNC_VALUES 5 UWORD COLUMN_DIR DIRECT /end RECORD_LAYOUT
/begin RECORD_LAYOUT RB_Map_S16U16_U16 NO_AXIS_PTS_X 1 SWORD NO_AXIS_PTS_Y 2 SWORD AXIS_PTS_X 3 SWORD INDEX_INCR DIRECT AXIS_PTS_Y 4 UWORD INDEX_INCR DIRECT FNC_VALUES 5 UWORD ROW_DIR DIRECT /end RECORD_LAYOUT
/begin RECORD_LAYOUT RB_Map_S8S16_S16 NO_AXIS_PTS_X 1 SBYTE NO_AXIS_PTS_Y 2 SBYTE AXIS_PTS_X 3 SBYTE INDEX_INCR DIRECT AXIS_PTS_Y 4 SWORD INDEX_INCR DIRECT FNC_VALUES 5 SWORD ROW_DIR DIRECT /end RECORD_LAYOUT
/begin RECORD_LAYOUT RB_Val_Wboolean FNC_VALUES 1 UBYTE COLUMN_DIR DIRECT /end RECORD_LAYOUT
/begin RECORD_LAYOUT RB_Val_Ws16 FNC_VALUES 1 SWORD COLUMN_DIR DIRECT /end RECORD_LAYOUT
/begin RECORD_LAYOUT RB_Val_Ws32 FNC_VALUES 1 SLONG COLUMN_DIR DIRECT /end RECORD_LAYOUT
/begin RECORD_LAYOUT RB_Val_Ws8 FNC_VALUES 1 SBYTE COLUMN_DIR DIRECT /end RECORD_LAYOUT
/begin RECORD_LAYOUT RB_Val_Wu16 FNC_VALUES 1 UWORD COLUMN_DIR DIRECT /end RECORD_LAYOUT
/begin RECORD_LAYOUT RB_Val_Wu32 FNC_VALUES 1 ULONG COLUMN_DIR DIRECT /end RECORD_LAYOUT
/begin RECORD_LAYOUT RB_Val_Wu8 FNC_VALUES 1 UBYTE COLUMN_DIR DIRECT /end RECORD_LAYOUT
/begin RECORD_LAYOUT Val_Ws16 FNC_VALUES 1 SWORD COLUMN_DIR DIRECT /end RECORD_LAYOUT
/begin RECORD_LAYOUT Val_Ws32 FNC_VALUES 1 SLONG COLUMN_DIR DIRECT /end RECORD_LAYOUT
/begin RECORD_LAYOUT Val_Wu8 FNC_VALUES 1 UBYTE COLUMN_DIR DIRECT /end RECORD_LAYOUT
/end MODULE
/end PROJECT
