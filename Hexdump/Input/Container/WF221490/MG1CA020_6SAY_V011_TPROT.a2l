ASAP2_VERSION 1 60
/begin PROJECT MG1CA020 "MG1CA020"
/begin HEADER "" VERSION "MG1CA020_6SAY_V011_TPROT" PROJECT_NO MG1CA020 /end HEADER
/begin MODULE DIM ""
/begin MOD_COMMON "" BYTE_ORDER MSB_LAST ALIGNMENT_BYTE 1 ALIGNMENT_WORD 2 ALIGNMENT_LONG 4 ALIGNMENT_INT64 4 ALIGNMENT_FLOAT32_IEEE 4 ALIGNMENT_FLOAT64_IEEE 4 DATA_SIZE 32 /end MOD_COMMON
/begin CHARACTERISTIC CWIGC "Codeword ignition control (IGC)" VALUE 0x80538362 RB_Val_Wu8 255.0 dez 0.00 255.0 FORMAT "%5.1" /end CHARACTERISTIC
/begin CHARACTERISTIC CWWDKSOM "codeword WDKSOM (throttle angle without torque-structure)" VALUE 0x80538270 RB_Val_Wu8 255.0 dez 0.00 255.0 FORMAT "%5.1" /end CHARACTERISTIC
/begin CHARACTERISTIC CWZWMINBG "Codeword to activate FC-interal features(ZWMINBG)" VALUE 0x80538EEE RB_Val_Wu8 255.0 dez 0.00 255.0 FORMAT "%5.1" /end CHARACTERISTIC
/begin CHARACTERISTIC CWZWOPTWL "codeword for switchover of zwopt" VALUE 0x80539FC6 RB_Val_Wu8 255.0 dez 0.00 255.0 FORMAT "%5.1" /end CHARACTERISTIC
/begin CHARACTERISTIC CWZWWLE "Code word for %ZWWL" VALUE 0x8053A1E0 RB_Val_Wu8 255.0 dez 0.00 255.0 FORMAT "%5.1" /end CHARACTERISTIC
/begin CHARACTERISTIC DFZWMNST "delta factor ZWmin regulation after start" VALUE 0x80539688 RB_Val_Wu16 0.9999847 fak_uw_b1 0.00 0.9999847 FORMAT "%9.7" /end CHARACTERISTIC
/begin CHARACTERISTIC DVHEGOFF "Delta of numbers of synchros after setting B_vhegzsy on asegvhe" VALUE 0x8053A1DC RB_Val_Ws8 255.0 dez -128.0 127.0 FORMAT "%5.1" /end CHARACTERISTIC
/begin CHARACTERISTIC DVHEKOFF "Delta of numbers of synchros after resetting B_vhegzsy on asegvhe" VALUE 0x8053A1DD RB_Val_Ws8 255.0 dez -128.0 127.0 FORMAT "%5.1" /end CHARACTERISTIC
/begin CHARACTERISTIC DZWOM "temperature-dependent offset of optimized model reference ignition angle" CURVE 0x80539FC8 RB_Curve_U16_S16_Static 191.9971 zw_q2p9297Em3_deg_KW -96.00000 95.99707 FORMAT "%8.5"
 /begin AXIS_DESCR STD_AXIS NO_INPUT_QUANTITY temp_ub_q0p75_o48 5 -48.0000 143.2500 FORMAT "%8.4" EXTENDED_LIMITS -48.00000 49103.25 DEPOSIT ABSOLUTE /end AXIS_DESCR
/end CHARACTERISTIC
/begin AXIS_PTS EngStrt_facCorrAltiAgIgn_AX "axis for distrubution for factor correction based on altitude" 0x80539FEC PEnv_facCorrAlti RB_Axis_U16 3.999939 fak_uw_b4 5 0.00 3.999939 FORMAT "%8.6" DEPOSIT ABSOLUTE /end AXIS_PTS
/begin CHARACTERISTIC EngStrt_idxClassSelnAgIgn_T "Curve class selector for ignition angle during start" CURVE 0x80539FF8 RB_Curve_U16_U8_Static 255.0 OneToOne 0.00 255.0 FORMAT "%5.1"
 /begin AXIS_DESCR STD_AXIS EngStrt_stStrtReq ENGSTRT_STSTRTREQ_SET_COMPU_VERB 6 0.00 16384.0000000 FORMAT "%13.7" DEPOSIT ABSOLUTE /end AXIS_DESCR
/end CHARACTERISTIC
/begin CHARACTERISTIC EngStrt_idxSelnAgIgnCoMStrt_T "Curve class instance selector for ignition angle during start (change of mind)" CURVE 0x8053A00C RB_Curve_U16_U8_Static 1.00000000000 ENGSTRT_AGIGNCOMSTRT_SET_COMPU_VERB 0.00 1.00000000000 FORMAT "%13.11"
 /begin AXIS_DESCR STD_AXIS EngStrt_stStrtReq ENGSTRT_STSTRTREQ_SET_COMPU_VERB 6 0.00 16384.0000000 FORMAT "%13.7" DEPOSIT ABSOLUTE /end AXIS_DESCR
/end CHARACTERISTIC
/begin CHARACTERISTIC EngStrt_idxSelnAgIgnStrtCorrOffs_T "curve for calculating correction offset" CURVE 0x8053A020 RB_Curve_U16_U8_Static 1.00000000000 ENGSTRT_AGIGNSTRTCORROFFS_SET_COMPU_VERB 0.00 1.00000000000 FORMAT "%13.11"
 /begin AXIS_DESCR STD_AXIS EngStrt_stStrtReq ENGSTRT_STSTRTREQ_SET_COMPU_VERB 6 0.00 16384.0000000 FORMAT "%13.7" DEPOSIT ABSOLUTE /end AXIS_DESCR
/end CHARACTERISTIC
/begin CHARACTERISTIC EngStrt_idxSelnAgIgnStrtOffs_T "Curve class instance selector for ignition angle during start (offset)" CURVE 0x8053A034 RB_Curve_U16_U8_Static 0.00 ENGSTRT_AGIGNSTRTOFFS_SET_COMPU_VERB 0.00 0.00 FORMAT "%13.2"
 /begin AXIS_DESCR STD_AXIS EngStrt_stStrtReq ENGSTRT_STSTRTREQ_SET_COMPU_VERB 6 0.00 16384.0000000 FORMAT "%13.7" DEPOSIT ABSOLUTE /end AXIS_DESCR
/end CHARACTERISTIC
/begin CHARACTERISTIC EngStrt_idxSelnAgIgnStrt_T "Curve class instance selector for ignition angle during start (base calibration)" CURVE 0x8053A048 RB_Curve_U16_U8_Static 0.00 ENGSTRT_AGIGNSTRT_SET_COMPU_VERB 0.00 0.00 FORMAT "%13.2"
 /begin AXIS_DESCR STD_AXIS EngStrt_stStrtReq ENGSTRT_STSTRTREQ_SET_COMPU_VERB 6 0.00 16384.0000000 FORMAT "%13.7" DEPOSIT ABSOLUTE /end AXIS_DESCR
/end CHARACTERISTIC
/begin AXIS_PTS EngStrt_nEngAgIgn_AX "Base point distribution over engine speed for the ignition angle at start" 0x8053A05C Epm_nEng RB_Axis_S16 32767.50 EngN 8 -16384.00 16383.50 FORMAT "%8.2" DEPOSIT ABSOLUTE /end AXIS_PTS
/begin AXIS_PTS EngStrt_ratChrgAgIgnStrt_AX "Base point distribution over air charge for the ignition angle at start" 0x8053A06E AirMod_ratChrgAirCyl RB_Axis_U16 1535.977 rel_q0p02344 6 0.00 1535.977 FORMAT "%8.3" DEPOSIT ABSOLUTE /end AXIS_PTS
/begin AXIS_PTS EngStrt_rPedAgIgn_AX "Base point distribution over accelerator pedal angle for ignition path at start" 0x8053A07C APP_r RB_Axis_S16 799.9878 Prc 10 -400.0000 399.9878 FORMAT "%8.4" DEPOSIT ABSOLUTE /end AXIS_PTS
/begin AXIS_PTS EngStrt_tIntkMnfldAgIgn_AX "axis for distribution for intake air temperature in manifold" 0x8053A092 IntkAirT_tIntkMnfld RB_Axis_S16 6553.500 Temp_Cels 6 -3549.940 3003.560 FORMAT "%8.3" DEPOSIT ABSOLUTE /end AXIS_PTS
/begin AXIS_PTS EngStrt_tStrtAgIgn_AX "Base point distribution over start temperature for the ignition angle at start" 0x8053A0A0 EngStrt_tStrtCoor RB_Axis_S16 3276.700 Temp_Cels 8 -273.140 3003.560 FORMAT "%8.3" EXTENDED_LIMITS -3549.940 3003.560 DEPOSIT ABSOLUTE /end AXIS_PTS
/begin CHARACTERISTIC ExhMgT_diaInertCylVlvLft_M "Map for delta ignition angle based on residual gas rate for component protection" MAP 0x8053909E RB_Map_U16U16_S8 191.3 zw_sb_q0p75 -96.00 95.25 FORMAT "%5.2"
 /begin AXIS_DESCR STD_AXIS Ign_ratChrgAirCyl rel_uw_q0p0234 12 0.00 1535.977 FORMAT "%8.3" DEPOSIT ABSOLUTE /end AXIS_DESCR
 /begin AXIS_DESCR STD_AXIS ExhMgT_ratInertCylVlvLft rel_uw_b100 12 0.00 99.99847 FORMAT "%8.5" DEPOSIT ABSOLUTE /end AXIS_DESCR
/end CHARACTERISTIC
/begin CHARACTERISTIC ExhMgT_facFillgRednCptProtn_C "threshold for maximum air charge for component protection if transmission intervention is active" VALUE 0x80539162 RB_Val_Wu16 1.999969 fak_uw_b2 0.00 1.999969 FORMAT "%8.6" /end CHARACTERISTIC
/begin CHARACTERISTIC ExhMgT_iaLoVlvLftHom_M "latest ign.angle for low valve-lift HOM for component protection" MAP 0x80539164 RB_MapGroup_S8 191.3 zw_sb_q0p75 -96.00 95.25 FORMAT "%5.2"
 /begin AXIS_DESCR COM_AXIS Epm_nEng EngN 20 -16384.00 16383.50 FORMAT "%8.2" AXIS_PTS_REF Ign_nEngVS12_AX /end AXIS_DESCR
 /begin AXIS_DESCR COM_AXIS Ign_ratChrgAirCyl rel_q0p0234 12 0.00 1535.977 FORMAT "%8.3" AXIS_PTS_REF Ign_ratChrgAirVS12_AX /end AXIS_DESCR
/end CHARACTERISTIC
/begin AXIS_PTS ExhMgT_nEng16_AX "distribution for lambda component protection terrain mode in dependence of engine speed" 0x80539254 Epm_nEng RB_Axis_S16 32767.50 EngN 16 -16384.00 16383.50 FORMAT "%8.2" DEPOSIT ABSOLUTE /end AXIS_PTS
/begin AXIS_PTS ExhMgT_ratChrgAir12_AX "distribution for filtered air charge" 0x80539276 AirMod_ratChrgAirCyl RB_Axis_U16 1535.977 rel_uw_q0p0234 12 0.00 1535.977 FORMAT "%8.3" DEPOSIT ABSOLUTE /end AXIS_PTS
/begin CHARACTERISTIC ExhMgT_ratInertCylRefVlvLft1_M "Map1 for reference inert gas rate for short lift to calculate delta ignition angle for component protection" MAP 0x80539290 RB_MapGroup_U16 99.99847 rel_uw_b100 0.00 99.99847 FORMAT "%8.5"
 /begin AXIS_DESCR COM_AXIS Epm_nEng EngN 16 -16384.00 16383.50 FORMAT "%8.2" AXIS_PTS_REF ExhMgT_nEng16_AX /end AXIS_DESCR
 /begin AXIS_DESCR COM_AXIS AirMod_ratChrgAirCyl rel_uw_q0p0234 12 0.00 1535.977 FORMAT "%8.3" AXIS_PTS_REF ExhMgT_ratChrgAir12_AX /end AXIS_DESCR
/end CHARACTERISTIC
/begin CHARACTERISTIC ExhMgT_ratInertCylRefVlvLft2_M "Map2 for reference inert gas rate for short lift to calculate delta ignition angle for component protection" MAP 0x80539410 RB_MapGroup_U16 99.99847 rel_uw_b100 0.00 99.99847 FORMAT "%8.5"
 /begin AXIS_DESCR COM_AXIS Epm_nEng EngN 16 -16384.00 16383.50 FORMAT "%8.2" AXIS_PTS_REF ExhMgT_nEng16_AX /end AXIS_DESCR
 /begin AXIS_DESCR COM_AXIS AirMod_ratChrgAirCyl rel_uw_q0p0234 12 0.00 1535.977 FORMAT "%8.3" AXIS_PTS_REF ExhMgT_ratChrgAir12_AX /end AXIS_DESCR
/end CHARACTERISTIC
/begin CHARACTERISTIC ExhMgT_tThdIaCptProtn_C "temperature threshold for related ignition timing for component protection if transmission intervention is active." VALUE 0x80539590 RB_Val_Ws16 6553.500 temp_q0p1_K -3276.800 3276.700 FORMAT "%8.3" /end CHARACTERISTIC
/begin CHARACTERISTIC ExhMgT_tThdIaLteBl_C "temperature threshold for related ignition timing for Brennbarkeitsgrenze" VALUE 0x80539592 RB_Val_Ws16 6553.500 temp_q0p1_K -3276.800 3276.700 FORMAT "%8.3" /end CHARACTERISTIC
/begin CHARACTERISTIC FDZWPU "weighting factor (intake-pressure dep.) for zwmn-offs." CURVE 0x8053968A RB_Curve_U16_U8_Static 0.9961 fak_ub_b1 0.00 0.9961
 /begin AXIS_DESCR STD_AXIS PEnv_p p_uw_q0p039 5 0.00 2559.961 FORMAT "%8.3" DEPOSIT ABSOLUTE /end AXIS_DESCR
/end CHARACTERISTIC
/begin CHARACTERISTIC FLAMTMPBTS "temperature threshold for related ignition timing for component protection" VALUE 0x80539594 RB_Val_Ws16 6553.500 temp_q0p1_K -3276.800 3276.700 FORMAT "%8.3" /end CHARACTERISTIC
/begin CHARACTERISTIC FLAMTMPBVG "temperature threshold for related ignition timing for Brennbarkeitsgrenze" VALUE 0x80539596 RB_Val_Ws16 6553.500 temp_q0p1_K -3276.800 3276.700 FORMAT "%8.3" /end CHARACTERISTIC
/begin CHARACTERISTIC FZWWLRL "weighting delta ignition sparc advance during engine warm up phase" MAP 0x8053A1E1 RB_Map_U8U8_U8 1.992188 fak_ub_b2 0.00 1.992188 FORMAT "%8.6"
 /begin AXIS_DESCR STD_AXIS EngStrt_nEngZWWL nmot_ub_q40 10 0.00 10200. FORMAT "%5.0" DEPOSIT ABSOLUTE /end AXIS_DESCR
 /begin AXIS_DESCR STD_AXIS EngStrt_relAirFillg rel_ub_q0p75 10 0.00 191.3 FORMAT "%5.1" DEPOSIT ABSOLUTE /end AXIS_DESCR
/end CHARACTERISTIC
/begin CHARACTERISTIC FZWWLRLN "weighting of delta ignition angle at warm-up" MAP 0x8053A25B RB_Map_U8U8_U8 1.992188 fak_ub_b2 0.00 1.992188 FORMAT "%8.6"
 /begin AXIS_DESCR STD_AXIS EngStrt_nEngZWWL nmot_ub_q40 10 0.00 10200. FORMAT "%5.0" DEPOSIT ABSOLUTE /end AXIS_DESCR
 /begin AXIS_DESCR STD_AXIS EngStrt_relAirFillg rel_ub_q0p75 10 0.00 191.3 FORMAT "%5.1" DEPOSIT ABSOLUTE /end AXIS_DESCR
/end CHARACTERISTIC
/begin CHARACTERISTIC FZWWLTMOT "temperature dependent weighting delta ingnition angle in warm-up" MAP 0x8053A2D6 RB_Map_U8U16_U8 1.992188 fak_ub_b2 0.00 1.992188 FORMAT "%8.6"
 /begin AXIS_DESCR STD_AXIS EngStrt_tEngZWWL temp_ub_q0p75_o48 10 -48.0 143.3 FORMAT "%5.1" DEPOSIT ABSOLUTE /end AXIS_DESCR
 /begin AXIS_DESCR STD_AXIS tyzwwlnm_w temp_q0p0234_o273 10 -273.150 1262.827 FORMAT "%8.3" DEPOSIT ABSOLUTE /end AXIS_DESCR
/end CHARACTERISTIC
/begin AXIS_PTS IGCTL_Bat08_AX "Distribution dependent of BattU_u" 0x8053827E BattU_u RB_Axis_S16 1310700. Volt_Batt 8 -655360.0 655340.0 FORMAT "%8.1" DEPOSIT ABSOLUTE /end AXIS_PTS
/begin CHARACTERISTIC IgCtl_diaAltiCorrnKnkCtrl_M "Delta ignition angle for knock control with altitude correction" MAP 0x8053894E RB_Map_U16U16_S16 6553.500 zw_q0p1 -3276.800 3276.700 FORMAT "%8.3"
 /begin AXIS_DESCR STD_AXIS PEnv_facCorrAlti fak_uw_b4 6 0.00 3.999939 FORMAT "%8.6" DEPOSIT ABSOLUTE /end AXIS_DESCR
 /begin AXIS_DESCR STD_AXIS AirMod_ratChrgAirCyl rel_q0p0234 6 0.00 1535.977 FORMAT "%8.3" DEPOSIT ABSOLUTE /end AXIS_DESCR
/end CHARACTERISTIC
/begin CHARACTERISTIC IgCtl_diaKnkCtrlIntkAirTEngT_C "ignition angle offset for knock control based on intake air temperature" VALUE 0x805389B2 RB_Val_Ws16 6553.500 zw_q0p1 -3276.800 3276.700 FORMAT "%8.3" /end CHARACTERISTIC
/begin CHARACTERISTIC IgCtl_diaKnkTEngIntk_M "Delta ignition angle for knock control from engine and intake air temperature" MAP 0x805389B4 RB_Map_S16S16_S16 6553.500 zw_q0p1 -3276.800 3276.700 FORMAT "%8.3"
 /begin AXIS_DESCR STD_AXIS CEngDsT_t Temp_Cels 16 -3549.940 3003.560 FORMAT "%8.3" DEPOSIT ABSOLUTE /end AXIS_DESCR
 /begin AXIS_DESCR STD_AXIS IgCtl_tSelTKnkCtrlIntk Temp_Cels 16 -3549.940 3003.560 FORMAT "%8.3" DEPOSIT ABSOLUTE /end AXIS_DESCR
/end CHARACTERISTIC
/begin CHARACTERISTIC IgCtl_diaRampFuCutOff_C "Delta ignition angle offset during fuel cut-off after a calibratable amount of time" VALUE 0x80538EEF RB_Val_Ws8 191.3 kw_q0p75 -96.00 95.25 FORMAT "%5.2" /end CHARACTERISTIC
/begin CHARACTERISTIC IgCtl_facIaKnkColdEthnlMin_M "Weighting of delta ignition angle for knock control during cold start condition with minimum second fuel" MAP 0x80538BF8 RB_Map_S16U16_U8 1.992188 fak_ub_b2 0.00 1.992188 FORMAT "%8.6"
 /begin AXIS_DESCR STD_AXIS Epm_nEng EngN 16 -16384.00 16383.50 FORMAT "%8.2" DEPOSIT ABSOLUTE /end AXIS_DESCR
 /begin AXIS_DESCR STD_AXIS AirMod_ratChrgAirCyl rel_q0p0234 12 0.00 1535.977 FORMAT "%8.3" DEPOSIT ABSOLUTE /end AXIS_DESCR
/end CHARACTERISTIC
/begin CHARACTERISTIC IgCtl_facIaKnkHiAlti_M "map of altitude correction factor for knock protection" MAP 0x80538CF4 RB_Map_S16U16_U8 1.992188 fak_ub_b2 0.00 1.992188 FORMAT "%8.6"
 /begin AXIS_DESCR STD_AXIS Epm_nEng EngN 16 -16384.00 16383.50 FORMAT "%8.2" DEPOSIT ABSOLUTE /end AXIS_DESCR
 /begin AXIS_DESCR STD_AXIS AirMod_ratChrgAirCyl rel_q0p0234 12 0.00 1535.977 FORMAT "%8.3" DEPOSIT ABSOLUTE /end AXIS_DESCR
/end CHARACTERISTIC
/begin CHARACTERISTIC IgCtl_facIaKnkWrmEthnlMin_M "Weighting of delta ignition angle for knock control during warm condition with minimum second fuel" MAP 0x80538DF0 RB_Map_S16U16_U8 1.992188 fak_ub_b2 0.00 1.992188 FORMAT "%8.6"
 /begin AXIS_DESCR STD_AXIS Epm_nEng EngN 16 -16384.00 16383.50 FORMAT "%8.2" DEPOSIT ABSOLUTE /end AXIS_DESCR
 /begin AXIS_DESCR STD_AXIS AirMod_ratChrgAirCyl rel_q0p0234 12 0.00 1535.977 FORMAT "%8.3" DEPOSIT ABSOLUTE /end AXIS_DESCR
/end CHARACTERISTIC
/begin CHARACTERISTIC IgCtl_HiAltiCmp_M "High altitude compensation map" MAP 0x8053969C RB_Map_U16U16_S16 191.2500 kw_q0p75 -96.00000 95.25000 FORMAT "%8.5" EXTENDED_LIMITS -24576.00 24575.25
 /begin AXIS_DESCR STD_AXIS PEnv_facCorrAlti fak_uw_b4 6 0.00 3.999939 FORMAT "%8.6" DEPOSIT ABSOLUTE /end AXIS_DESCR
 /begin AXIS_DESCR STD_AXIS AirMod_ratChrgAirCyl rel_q0p0234 8 0.00 1535.977 FORMAT "%8.3" DEPOSIT ABSOLUTE /end AXIS_DESCR
/end CHARACTERISTIC
/begin CHARACTERISTIC IgCtl_iaCalApprch_C "Application interface fixed basic ignition angle" VALUE 0x80538364 RB_Val_Ws16 6553.500 zw_q0p1 -3276.800 3276.700 FORMAT "%8.3" /end CHARACTERISTIC
/begin CHARACTERISTIC IgCtl_iaDiffKnkAdpn_C "threshold for difference between base and desired ignition angle to detect intervention of knock adaption via ignition angle" VALUE 0x80539FDE RB_Val_Ws16 1.000000 zw_q0p1 0.00 1.000000 FORMAT "%8.6" EXTENDED_LIMITS -3276.800 3276.700 /end CHARACTERISTIC
/begin CHARACTERISTIC IgCtl_iaFixdOutpAppl_C "Application interface fixed output ignition angle" VALUE 0x80539FE0 RB_Val_Ws16 6553.500 zw_q0p1 -3276.800 3276.700 FORMAT "%8.3" /end CHARACTERISTIC
/begin CHARACTERISTIC IgCtl_iaLoVlvLftGearShift_GM "Low valve lift dependent ignition angle during gearshift" MAP 0x80538EF0 RB_MapGroup_S8 191.3 kw_q0p75 -96.00 95.25 FORMAT "%5.2"
 /begin AXIS_DESCR COM_AXIS Epm_nEng EngN 16 -16384.00 16383.50 FORMAT "%8.2" AXIS_PTS_REF Ign_nEng16_AX /end AXIS_DESCR
 /begin AXIS_DESCR COM_AXIS Ign_ratChrgAirCyl rel_q0p0234 12 0.00 1535.977 FORMAT "%8.3" AXIS_PTS_REF Ign_ratChrgAir12_AX /end AXIS_DESCR
/end CHARACTERISTIC
/begin CHARACTERISTIC IgCtl_iaLteTEng_T "Characteristic curve for correcting the latest ignition angle depending on the engine temperature in Homogenmodus (HOM)" CURVE 0x8053971C RB_Curve_S16_S8_Static 191.3 kw_q0p75 -96.00 95.25 FORMAT "%5.2"
 /begin AXIS_DESCR STD_AXIS CEngDsT_t Temp_Cels 8 -3549.940 3003.560 FORMAT "%8.3" DEPOSIT ABSOLUTE /end AXIS_DESCR
/end CHARACTERISTIC
/begin CHARACTERISTIC IgCtl_nEngThdFixdIa_C "engine speed threshold for fixed ign.angle output" VALUE 0x80539FE2 RB_Val_Ws16 32767.50 EngN -16384.00 16383.50 FORMAT "%8.2" /end CHARACTERISTIC
/begin CHARACTERISTIC IgCtl_nrSegIntkVlvlftSwtDly_C "number of segments to delay intake valve lift switchover for ignition" VALUE 0x8053A1DE RB_Val_Wu8 255.0 dez 0.00 255.0 FORMAT "%5.1" /end CHARACTERISTIC
/begin CHARACTERISTIC IgCtl_offsFacDiaLteFuCutOff_C "Offset to ramp down the ignition angle during fuel cut-off" VALUE 0x80538FB0 RB_Val_Wu8 0.9961 fak_ub_b1 0.00 0.9961 /end CHARACTERISTIC
/begin CHARACTERISTIC IgCtl_pIntkThdFixdIaPlaMod_C "Inlet pressure threshold for fixed ign.angle output(plant-mode)" VALUE 0x80539FE4 RB_Val_Wu16 5119.922 p_uw_q0p078 0.00 5119.922 FORMAT "%8.3" /end CHARACTERISTIC
/begin CHARACTERISTIC IgCtl_pIntkThdFixdIa_C "Inlet pressure threshold for fixed ign.angle output" VALUE 0x80539FE6 RB_Val_Wu16 5119.922 p_uw_q0p078 0.00 5119.922 FORMAT "%8.3" /end CHARACTERISTIC
/begin CHARACTERISTIC IgCtl_ratCluHysL_C "lower threshold for clutch indicating gearshift" VALUE 0x80538FB2 RB_Val_Ws16 255.9961 Prc_Fact256 -128.0000 127.9961 FORMAT "%8.4" /end CHARACTERISTIC
/begin CHARACTERISTIC IgCtl_ratCluHysR_C "upper threshold for clutch indicating gearshift" VALUE 0x80538FB4 RB_Val_Ws16 255.9961 Prc_Fact256 -128.0000 127.9961 FORMAT "%8.4" /end CHARACTERISTIC
/begin CHARACTERISTIC IgCtl_selTIgnKnkCtrl_C "codeword for selection of temperature for delta ignition angle calculation for knock protection" VALUE 0x80538EEC RB_Val_Wu8 6.000 dez 0.00 6.000 FORMAT "%5.3" EXTENDED_LIMITS 0.00 255.0 /end CHARACTERISTIC
/begin AXIS_PTS IGCTL_tEng08_AX "Distribution dependent of EngDa_tEng" 0x80539736 CEngDsT_t RB_Axis_S16 6553.500 Temp_Cels 8 -3549.940 3003.560 FORMAT "%8.3" DEPOSIT ABSOLUTE /end AXIS_PTS
/begin AXIS_PTS IGCTL_tEng12_AX "Distribution dependent of EngDa_tEng(12x)" 0x80539748 CEngDsT_t RB_Axis_S16 6553.500 Temp_Cels 12 -3549.940 3003.560 FORMAT "%8.3" DEPOSIT ABSOLUTE /end AXIS_PTS
/begin CHARACTERISTIC IgCtl_tiFuCutOffDly_C "delay time for fuel cut-off" VALUE 0x80538FB6 RB_Val_Wu8 255.0 dez 0.00 255.0 FORMAT "%5.1" /end CHARACTERISTIC
/begin CHARACTERISTIC IgCtl_tiMaxTqIntvGearShift_C "max.time for torque-intervention(zwsol) during gear-shift(with spec.late ign.angle)" VALUE 0x80538FB7 RB_Val_Wu8 2.550 t_q0p01 0.00 2.550 FORMAT "%5.3" /end CHARACTERISTIC
/begin CHARACTERISTIC IgCtl_tiMaxTqIntvGearShift_T "Max.time for torque-intervention(zwsol) during gear-shift(with spec.late ign.angle) depending on engine speed" CURVE 0x80538FB8 RB_Curve_S16_U16_Static 655.3500 t_q0p01 0.00 655.3500 FORMAT "%8.4"
 /begin AXIS_DESCR STD_AXIS Epm_nEng EngN 8 -16384.00 16383.50 FORMAT "%8.2" DEPOSIT ABSOLUTE /end AXIS_DESCR
/end CHARACTERISTIC
/begin CHARACTERISTIC IgCtl_tiResiGasCutOff_C "Time until residual gas pushed out at cut-off" VALUE 0x80538FDA RB_Val_Wu8 2.550 t_q0p01 0.00 2.550 FORMAT "%5.3" /end CHARACTERISTIC
/begin CHARACTERISTIC IgCtl_tThdFixdIa_C "Temp.threshold for fixed ign.angle output" VALUE 0x80539FE8 RB_Val_Ws16 6553.500 Temp_Cels -3549.940 3003.560 FORMAT "%8.3" /end CHARACTERISTIC
/begin CHARACTERISTIC IgCtl_vThdVehMax_C "calibration threshold for vehicle speed" VALUE 0x80538FDC RB_Val_Ws16 655.3500 Vel -327.6800 327.6700 FORMAT "%8.4" /end CHARACTERISTIC
/begin CHARACTERISTIC Ign_diaAPP_C "Application interface ignition angle adjustment" VALUE 0x80538366 RB_Val_Ws16 6553.500 zw_q0p1 -3276.800 3276.700 FORMAT "%8.3" /end CHARACTERISTIC
/begin CHARACTERISTIC Ign_diaLtpuHOM_M "delta of Latest ignition angle in HOM mode dependent on ambient pressure" MAP 0x80539762 RB_MapGroup_S8 191.3 kw_q0p75 -96.00 95.25 FORMAT "%5.2"
 /begin AXIS_DESCR COM_AXIS Epm_nEng EngN 16 -16384.00 16383.50 FORMAT "%8.2" AXIS_PTS_REF Ign_nEng16_AX /end AXIS_DESCR
 /begin AXIS_DESCR COM_AXIS Ign_ratChrgAirCyl rel_q0p0234 12 0.00 1535.977 FORMAT "%8.3" AXIS_PTS_REF Ign_ratChrgAir12_AX /end AXIS_DESCR
/end CHARACTERISTIC
/begin CHARACTERISTIC Ign_flgIaThrVlvIceActv_C "Activation of ignition angle calculation for iced up throttle valve" VALUE 0x80539822 RB_Val_Wboolean 1.00000000000 B_TRUE 0.00 1.00000000000 FORMAT "%13.11" /end CHARACTERISTIC
/begin CHARACTERISTIC Ign_flgIdleDetnActv_C "Detection of engine idle speed for activation of ignition angle calculation for iced up throttle valve" VALUE 0x80539823 RB_Val_Wboolean 1.00000000000 B_TRUE 0.00 1.00000000000 FORMAT "%13.11" /end CHARACTERISTIC
/begin CHARACTERISTIC Ign_iaBasMax_M "Maximum base ignition-angle" MAP 0x80538368 RB_Map_S16U16_S16 6553.500 zw_q0p1 -3276.800 3276.700 FORMAT "%8.3"
 /begin AXIS_DESCR STD_AXIS Epm_nEng EngN 12 -16384.00 16383.50 FORMAT "%8.2" DEPOSIT ABSOLUTE /end AXIS_DESCR
 /begin AXIS_DESCR STD_AXIS AirMod_ratChrgAirCyl rel_q0p0234 12 0.00 1535.977 FORMAT "%8.3" DEPOSIT ABSOLUTE /end AXIS_DESCR
/end CHARACTERISTIC
/begin CHARACTERISTIC Ign_iaMnThrVlvIce_T "Temperature depending retarded ignition angle curve in case of iced throttle valve" CURVE 0x80539824 RB_Curve_S16_S8_Static 191.3 kw_q0p75 -96.00 95.25 FORMAT "%5.2"
 /begin AXIS_DESCR STD_AXIS CEngDsT_t Temp_Cels 8 -3549.940 3003.560 FORMAT "%8.3" DEPOSIT ABSOLUTE /end AXIS_DESCR
/end CHARACTERISTIC
/begin CHARACTERISTIC Ign_iaPrVL1_GM "Ignition-angle map at changed valve lift" MAP 0x805384BC RB_MapGroup_S16 191.3000 zw_q0p1 -96.00000 95.30000 FORMAT "%8.5" EXTENDED_LIMITS -3276.800 3276.700
 /begin AXIS_DESCR COM_AXIS Epm_nEng EngN 16 -16384.00 16383.50 FORMAT "%8.2" AXIS_PTS_REF Ign_nEng16_AX /end AXIS_DESCR
 /begin AXIS_DESCR COM_AXIS Ign_ratChrgAirCyl rel_q0p0234 16 0.00 1535.977 FORMAT "%8.3" AXIS_PTS_REF Ign_ratChrgAir16_AX /end AXIS_DESCR
/end CHARACTERISTIC
/begin CHARACTERISTIC Ign_iaPr_GM "primary ignition angle map" MAP 0x805386BC RB_MapGroup_S16 191.3000 zw_q0p1 -96.00000 95.30000 FORMAT "%8.5" EXTENDED_LIMITS -3276.800 3276.700
 /begin AXIS_DESCR COM_AXIS Epm_nEng EngN 16 -16384.00 16383.50 FORMAT "%8.2" AXIS_PTS_REF Ign_nEng16_AX /end AXIS_DESCR
 /begin AXIS_DESCR COM_AXIS Ign_ratChrgAirCyl rel_q0p0234 16 0.00 1535.977 FORMAT "%8.3" AXIS_PTS_REF Ign_ratChrgAir16_AX /end AXIS_DESCR
/end CHARACTERISTIC
/begin AXIS_PTS Ign_nEng08_AX "Distribution dependent of Epm_nEng(8)" 0x80538290 Epm_nEng RB_Axis_S16 32767.50 EngN 8 -16384.00 16383.50 FORMAT "%8.2" DEPOSIT ABSOLUTE /end AXIS_PTS
/begin AXIS_PTS Ign_nEng12_AX "Distribution dependent of Epm_nEng(12)" 0x8053891A Epm_nEng RB_Axis_S16 32767.50 EngN 12 -16384.00 16383.50 FORMAT "%8.2" DEPOSIT ABSOLUTE /end AXIS_PTS
/begin AXIS_PTS Ign_nEng16_AX "Distribution dependent of Epm_nEng(16)" 0x805388BC Epm_nEng RB_Axis_S16 32767.50 EngN 16 -16384.00 16383.50 FORMAT "%8.2" DEPOSIT ABSOLUTE /end AXIS_PTS
/begin AXIS_PTS Ign_nEng20_AX "Distribution dependent of Epm_nEng(20)" 0x80534118 Epm_nEng RB_Axis_S16 32767.50 EngN 20 -16384.00 16383.50 FORMAT "%8.2" DEPOSIT ABSOLUTE /end AXIS_PTS
/begin AXIS_PTS Ign_nEngVS12_AX "engine speed dep.map" 0x80534142 Epm_nEng RB_Axis_S16 32767.50 EngN 20 -16384.00 16383.50 FORMAT "%8.2" DEPOSIT ABSOLUTE /end AXIS_PTS
/begin AXIS_PTS Ign_ratChrgAir12_AX "Distribution(12) dependent of AirMod_ratChrgAirCyl(rl_w)" 0x805388DE Ign_ratChrgAirCyl RB_Axis_U16 1535.977 rel_q0p0234 12 0.00 1535.977 FORMAT "%8.3" DEPOSIT ABSOLUTE /end AXIS_PTS
/begin AXIS_PTS Ign_ratChrgAir16_AX "Distribution(16) dependent of AirMod_ratChrgAirCyl(rl_w)" 0x805388F8 Ign_ratChrgAirCyl RB_Axis_U16 1535.977 rel_q0p0234 16 0.00 1535.977 FORMAT "%8.3" DEPOSIT ABSOLUTE /end AXIS_PTS
/begin AXIS_PTS Ign_ratChrgAirGdiPfi12_AX "Distribution(12) dependent of AirMod_ratChrgAirCyl or Ign_ratChrgAirCyl" 0x80538934 Ign_ratChrgAirCyl RB_Axis_U16 1535.977 rel_q0p0234 12 0.00 1535.977 FORMAT "%8.3" DEPOSIT ABSOLUTE /end AXIS_PTS
/begin AXIS_PTS Ign_ratChrgAirVS12_AX "load dep. map" 0x8053416C Ign_ratChrgAirCyl RB_Axis_U16 1535.977 rel_q0p0234 12 0.00 1535.977 FORMAT "%8.3" DEPOSIT ABSOLUTE /end AXIS_PTS
/begin CHARACTERISTIC KFDZMNST "Map for offset minimal ignition angle during after-start overshoot" MAP 0x8053983E RB_Map_S16S16_S8 191.3 kw_q0p75 -96.00 95.25 FORMAT "%5.2"
 /begin AXIS_DESCR STD_AXIS Epm_nEng EngN 4 -16384.00 16383.50 FORMAT "%8.2" DEPOSIT ABSOLUTE /end AXIS_DESCR
 /begin AXIS_DESCR STD_AXIS CEngDsT_tStrt Temp_Cels 6 -3549.940 3003.560 FORMAT "%8.3" DEPOSIT ABSOLUTE /end AXIS_DESCR
/end CHARACTERISTIC
/begin CHARACTERISTIC KFFSZNM "dwell-time shortening for reducing power dissipation during high engine-speed + temperature" MAP 0x805382A2 RB_MapGroup_U8 0.9961 fak_ub_b1 0.00 0.9961
 /begin AXIS_DESCR COM_AXIS Epm_nEng EngN 8 -16384.00 16383.50 FORMAT "%8.2" AXIS_PTS_REF Ign_nEng08_AX /end AXIS_DESCR
 /begin AXIS_DESCR COM_AXIS CEngDsT_t Temp_Cels 8 -3549.940 3003.560 FORMAT "%8.3" AXIS_PTS_REF IGCTL_tEng08_AX /end AXIS_DESCR
/end CHARACTERISTIC
/begin CHARACTERISTIC KFSZT "Dwell angle characteristic map" MAP 0x805382E2 RB_MapGroup_U16 65.53500 t_q0p001_ms 0.00 65.53500 FORMAT "%8.5"
 /begin AXIS_DESCR COM_AXIS BattU_u Volt_Batt 8 -655360.0 655340.0 FORMAT "%8.1" AXIS_PTS_REF IGCTL_Bat08_AX /end AXIS_DESCR
 /begin AXIS_DESCR COM_AXIS CEngDsT_t Temp_Cels 8 -3549.940 3003.560 FORMAT "%8.3" AXIS_PTS_REF IGCTL_tEng08_AX /end AXIS_DESCR
/end CHARACTERISTIC
/begin CHARACTERISTIC KFZWMN "Map for latest ignition angle, describes burning limit." MAP 0x8053986E RB_MapGroup_S8 191.3 kw_q0p75 -96.00 95.25 FORMAT "%5.2"
 /begin AXIS_DESCR COM_AXIS Epm_nEng EngN 16 -16384.00 16383.50 FORMAT "%8.2" AXIS_PTS_REF Ign_nEng16_AX /end AXIS_DESCR
 /begin AXIS_DESCR COM_AXIS Ign_ratChrgAirCyl rel_q0p0234 12 0.00 1535.977 FORMAT "%8.3" AXIS_PTS_REF Ign_ratChrgAir12_AX /end AXIS_DESCR
/end CHARACTERISTIC
/begin CHARACTERISTIC KFZWMNBTSVH "latest allowed ignition timing for component protection for valve lift adjustment (long valve lift)" MAP 0x80539598 RB_MapGroup_S8 191.3 zw_sb_q0p75 -96.00 95.25 FORMAT "%5.2"
 /begin AXIS_DESCR COM_AXIS Epm_nEng EngN 20 -16384.00 16383.50 FORMAT "%8.2" AXIS_PTS_REF Ign_nEng20_AX /end AXIS_DESCR
 /begin AXIS_DESCR COM_AXIS Ign_ratChrgAirCyl rel_q0p0234 12 0.00 1535.977 FORMAT "%8.3" AXIS_PTS_REF Ign_ratChrgAir12_AX /end AXIS_DESCR
/end CHARACTERISTIC
/begin CHARACTERISTIC KFZWMNGS "Map for latest ignition angle during geasrshift" MAP 0x80538FDE RB_MapGroup_S8 191.3 kw_q0p75 -96.00 95.25 FORMAT "%5.2"
 /begin AXIS_DESCR COM_AXIS Epm_nEng EngN 16 -16384.00 16383.50 FORMAT "%8.2" AXIS_PTS_REF Ign_nEng16_AX /end AXIS_DESCR
 /begin AXIS_DESCR COM_AXIS Ign_ratChrgAirCyl rel_q0p0234 12 0.00 1535.977 FORMAT "%8.3" AXIS_PTS_REF Ign_ratChrgAir12_AX /end AXIS_DESCR
/end CHARACTERISTIC
/begin CHARACTERISTIC KFZWMNKHLL "Map for minimal ignition angle catalyst warm-up by idle speed" MAP 0x8053992E RB_Map_S16U16_S8 191.3 kw_q0p75 -96.00 95.25 FORMAT "%5.2"
 /begin AXIS_DESCR STD_AXIS Epm_nEng EngN 16 -16384.00 16383.50 FORMAT "%8.2" DEPOSIT ABSOLUTE /end AXIS_DESCR
 /begin AXIS_DESCR STD_AXIS AirMod_ratChrgAirCyl rel_q0p0234 12 0.00 1535.977 FORMAT "%8.3" DEPOSIT ABSOLUTE /end AXIS_DESCR
/end CHARACTERISTIC
/begin CHARACTERISTIC KFZWMNKHLLVHK "Late ign.angle map for special intake valve lift" MAP 0x80539A2A RB_Map_S16U16_S8 191.3 kw_q0p75 -96.00 95.25 FORMAT "%5.2"
 /begin AXIS_DESCR STD_AXIS Epm_nEng EngN 16 -16384.00 16383.50 FORMAT "%8.2" DEPOSIT ABSOLUTE /end AXIS_DESCR
 /begin AXIS_DESCR STD_AXIS AirMod_ratChrgAirCyl rel_q0p0234 12 0.00 1535.977 FORMAT "%8.3" DEPOSIT ABSOLUTE /end AXIS_DESCR
/end CHARACTERISTIC
/begin CHARACTERISTIC KFZWMVHK "latest ign.angle for low valve-lift" MAP 0x80539B26 RB_MapGroup_S8 191.3 kw_q0p75 -96.00 95.25 FORMAT "%5.2"
 /begin AXIS_DESCR COM_AXIS Epm_nEng EngN 16 -16384.00 16383.50 FORMAT "%8.2" AXIS_PTS_REF Ign_nEng16_AX /end AXIS_DESCR
 /begin AXIS_DESCR COM_AXIS Ign_ratChrgAirCyl rel_q0p0234 12 0.00 1535.977 FORMAT "%8.3" AXIS_PTS_REF Ign_ratChrgAir12_AX /end AXIS_DESCR
/end CHARACTERISTIC
/begin CHARACTERISTIC KFZWOP "Optimized model reference ignition angle" MAP 0x80539BE6 RB_MapGroup_S16 191.9971 zw_q2p9297Em3_deg_KW -96.00000 95.99707 FORMAT "%8.5"
 /begin AXIS_DESCR COM_AXIS NO_INPUT_QUANTITY nmot_uw_q0p25 16 0.00 16383.75 FORMAT "%8.2" AXIS_PTS_REF SNMOPUW /end AXIS_DESCR
 /begin AXIS_DESCR COM_AXIS NO_INPUT_QUANTITY rel_uw_q0p0234 12 0.00 1535.977 FORMAT "%8.3" AXIS_PTS_REF SRLOPUW /end AXIS_DESCR
/end CHARACTERISTIC
/begin CHARACTERISTIC KFZWOPV "Optimized model reference ignition angle, low valve lift" MAP 0x80539D66 RB_MapGroup_S16 191.9971 zw_q2p9297Em3_deg_KW -96.00000 95.99707 FORMAT "%8.5"
 /begin AXIS_DESCR COM_AXIS NO_INPUT_QUANTITY nmot_uw_q0p25 20 0.00 16383.75 FORMAT "%8.2" AXIS_PTS_REF SNMOVUW /end AXIS_DESCR
 /begin AXIS_DESCR COM_AXIS NO_INPUT_QUANTITY rel_uw_q0p0234 12 0.00 1535.977 FORMAT "%8.3" AXIS_PTS_REF SRLOVUW /end AXIS_DESCR
/end CHARACTERISTIC
/begin CHARACTERISTIC KFZWWLNMOT "Delta ignition sparc advance during engine warm up phase" MAP 0x8053A35A RB_Map_U8U16_S16 191.2500 zw_sb_q0p75 -96.00000 95.25000 FORMAT "%8.5" EXTENDED_LIMITS -24576.00 24575.25
 /begin AXIS_DESCR STD_AXIS EngStrt_nEngZWWL nmot_ub_q40 10 0.00 10200. FORMAT "%5.0" DEPOSIT ABSOLUTE /end AXIS_DESCR
 /begin AXIS_DESCR STD_AXIS tyzwwlnm_w temp_q0p0234_o273 10 -273.150 1262.827 FORMAT "%8.3" DEPOSIT ABSOLUTE /end AXIS_DESCR
/end CHARACTERISTIC
/begin CHARACTERISTIC KFZWWLRL "Delta ignition sparc advance during engine warm up phase" MAP 0x8053A442 RB_Map_U8U8_S8 191.3 zw_sb_q0p75 -96.00 95.25 FORMAT "%5.2"
 /begin AXIS_DESCR STD_AXIS EngStrt_tEngZWWL temp_ub_q0p75_o48 10 -48.0 143.3 FORMAT "%5.1" DEPOSIT ABSOLUTE /end AXIS_DESCR
 /begin AXIS_DESCR STD_AXIS EngStrt_relAirFillg rel_ub_q0p75 10 0.00 191.3 FORMAT "%5.1" DEPOSIT ABSOLUTE /end AXIS_DESCR
/end CHARACTERISTIC
/begin CHARACTERISTIC SNMDKSRF "level detection of engine stop for throttle self-cleaning-function" VALUE 0x80538271 RB_Val_Wu8 280.0 EngN_LRes 0.00 280.0 FORMAT "%5.1" EXTENDED_LIMITS 0.00 10200. /end CHARACTERISTIC
/begin AXIS_PTS SNMOPUW "set points engine speed" 0x80539F46 NO_INPUT_QUANTITY RB_Axis_U16 16383.75 nmot_uw_q0p25 16 0.00 16383.75 FORMAT "%8.2" DEPOSIT ABSOLUTE /end AXIS_PTS
/begin AXIS_PTS SNMOVUW "set points engine speed for low valve lift" 0x80539F68 NO_INPUT_QUANTITY RB_Axis_U16 16383.75 nmot_uw_q0p25 20 0.00 16383.75 FORMAT "%8.2" DEPOSIT ABSOLUTE /end AXIS_PTS
/begin AXIS_PTS SRLOPUW "set point distribution relative charge" 0x80539F92 NO_INPUT_QUANTITY RB_Axis_U16 1535.977 rel_uw_q0p0234 12 0.00 1535.977 FORMAT "%8.3" DEPOSIT ABSOLUTE /end AXIS_PTS
/begin AXIS_PTS SRLOVUW "set point distribution relative charge for low valve lift" 0x80539FAC NO_INPUT_QUANTITY RB_Axis_U16 1535.977 rel_uw_q0p0234 12 0.00 1535.977 FORMAT "%8.3" DEPOSIT ABSOLUTE /end AXIS_PTS
/begin CHARACTERISTIC SVFDKSRF "level detection of vehicle stop for throttle self-cleaning-function" VALUE 0x80538272 RB_Val_Ws16 655.3500 Vel -327.6800 327.6700 FORMAT "%8.4" /end CHARACTERISTIC
/begin CHARACTERISTIC TSRFDKI "fixed time for initialization (throttle self-cleaning-function)" VALUE 0x80538274 RB_Val_Wu16 655.3500 t_q0p01 0.00 655.3500 FORMAT "%8.4" /end CHARACTERISTIC
/begin CHARACTERISTIC TSRFDKO "fixed time for upper stop position (throttle self-cleaning-function)" VALUE 0x80538276 RB_Val_Wu8 2.550 t_q0p01 0.00 2.550 FORMAT "%5.3" /end CHARACTERISTIC
/begin CHARACTERISTIC TSRFDKU "fixed time for lower stop position (throttle self-cleaning-function)" VALUE 0x80538277 RB_Val_Wu8 2.550 t_q0p01 0.00 2.550 FORMAT "%5.3" /end CHARACTERISTIC
/begin CHARACTERISTIC VehV_ctDvtMax_C "Maximum number of deviations below which wheel error is detected" VALUE 0x8053818C RB_Val_Wu8 255.0 OneToOne 0.00 255.0 FORMAT "%5.1" /end CHARACTERISTIC
/begin CHARACTERISTIC VehV_ctDvtMin_C "Minimum number of deviations above which wheel error is detected" VALUE 0x8053818D RB_Val_Wu8 255.0 OneToOne 0.00 255.0 FORMAT "%5.1" /end CHARACTERISTIC
/begin CHARACTERISTIC VehV_ctTolrPerd_C "Amount of impulses which are tolerated, during two calculation cycles of the process." VALUE 0x8053818E RB_Val_Wu16 65535.00 OneToOne 0.00 65535.00 FORMAT "%8.2" /end CHARACTERISTIC
/begin CHARACTERISTIC VehV_dstPerImp_C "The calculated distance per impulse value" VALUE 0x80538190 RB_Val_Wu16 0.5965200 LengthCpp 0.00 0.5965200 FORMAT "%9.7" EXTENDED_LIMITS 0.00 0.6553500 /end CHARACTERISTIC
/begin CHARACTERISTIC VehV_facTireAxlCorrMax_C "Upper limit of the tire and axle correction factor" VALUE 0x80538194 RB_Val_Wu32 16033212.0000 PerKm 10000.0000 16043212.0000 FORMAT "%13.4" EXTENDED_LIMITS 0.00 4294967295.00 /end CHARACTERISTIC
/begin CHARACTERISTIC VehV_facTireAxlCorrMin_C "Lower limit of the tire and axle correction factor" VALUE 0x80538198 RB_Val_Wu32 16041535.0000 PerKm 1677.0000 16043212.0000 FORMAT "%13.4" EXTENDED_LIMITS 0.00 4294967295.00 /end CHARACTERISTIC
/begin CHARACTERISTIC VehV_flgExcdLim_C "VehV_flgExcdLim is set to this value if the minimum speed was reached at least once in the current driving cycle" VALUE 0x805381FC RB_Val_Wu8 1.00000000000 B_TRUE 0.00 1.00000000000 FORMAT "%13.11" /end CHARACTERISTIC
/begin CHARACTERISTIC VehV_flgPtCdnSel_C "Switch for powertrain condition selection for plausibility check" VALUE 0x805381FD RB_Val_Wu8 1.00000000000 B_TRUE 0.00 1.00000000000 FORMAT "%13.11" /end CHARACTERISTIC
/begin CHARACTERISTIC VehV_flgPwrPlausHealEna_C "Flag for heal enable condition selection" VALUE 0x805381FE RB_Val_Wu8 1.00000000000 B_TRUE 0.00 1.00000000000 FORMAT "%13.11" /end CHARACTERISTIC
/begin CHARACTERISTIC VehV_flgSwtIntrptIniEna_C "Calibration switch for enabling the movining average calculation Initialization part." VALUE 0x8053819C RB_Val_Wu8 1.00000000000 B_TRUE 0.00 1.00000000000 FORMAT "%13.11" /end CHARACTERISTIC
/begin CHARACTERISTIC VehV_nrSegAvrg16_C "Calibration value 16 for the Number of signals required for averaging the time period of PWM signals" VALUE 0x8053819D RB_Val_Wu8 254.0 OneToOne 1.0 255.0 FORMAT "%5.1" EXTENDED_LIMITS 0.00 255.0 /end CHARACTERISTIC
/begin CHARACTERISTIC VehV_nrSegAvrg32_C "Calibration value 32 for the Number of signals required for averaging the time period of PWM signals" VALUE 0x8053819E RB_Val_Wu8 254.0 OneToOne 1.0 255.0 FORMAT "%5.1" EXTENDED_LIMITS 0.00 255.0 /end CHARACTERISTIC
/begin CHARACTERISTIC VehV_nrSegAvrg4_C "Calibration value 4 for the Number of signals required for averaging the time period of PWM signals" VALUE 0x8053819F RB_Val_Wu8 254.0 OneToOne 1.0 255.0 FORMAT "%5.1" EXTENDED_LIMITS 0.00 255.0 /end CHARACTERISTIC
/begin CHARACTERISTIC VehV_nrSegAvrg64_C "Calibration value 64 for the Number of signals required for averaging the time period of PWM signals" VALUE 0x805381A0 RB_Val_Wu8 254.0 OneToOne 1.0 255.0 FORMAT "%5.1" EXTENDED_LIMITS 0.00 255.0 /end CHARACTERISTIC
/begin CHARACTERISTIC VehV_nrSegAvrg8_C "Calibration value 8 for the Number of signals required for averaging the time period of PWM signals" VALUE 0x805381A1 RB_Val_Wu8 254.0 OneToOne 1.0 255.0 FORMAT "%5.1" EXTENDED_LIMITS 0.00 255.0 /end CHARACTERISTIC
/begin CHARACTERISTIC VehV_nrSegAvrg_C "Calibration for number of signals required for averaging the time period of PWM signals" VALUE 0x805381A2 RB_Val_Wu8 254.0 OneToOne 1.0 255.0 FORMAT "%5.1" EXTENDED_LIMITS 0.00 255.0 /end CHARACTERISTIC
/begin CHARACTERISTIC VehV_nThresPlaFcoMax_C "Maximum engine speed limit for vehicle speed fuel cut off plausibilisation" VALUE 0x80538200 RB_Val_Ws16 32767.50 EngN -16384.00 16383.50 FORMAT "%8.2" /end CHARACTERISTIC
/begin CHARACTERISTIC VehV_nThresPlaFcoMin_C "Minimum engine speed limit for vehicle speed fuel cut off plausibilisation" VALUE 0x80538202 RB_Val_Ws16 32767.50 EngN -16384.00 16383.50 FORMAT "%8.2" /end CHARACTERISTIC
/begin CHARACTERISTIC VehV_nThresPlaMinV2N_C "Minimum engine speed limit to enable vehicle speed V2N plausibilisation" VALUE 0x80538204 RB_Val_Ws16 32767.50 EngN -16384.00 16383.50 FORMAT "%8.2" /end CHARACTERISTIC
/begin CHARACTERISTIC VehV_nThresPlaPwrMaxDfct_C "Maximum engine speed threshold value to activate the defect enable condition" VALUE 0x80538206 RB_Val_Ws16 32767.50 EngN -16384.00 16383.50 FORMAT "%8.2" /end CHARACTERISTIC
/begin CHARACTERISTIC VehV_nThresPlaPwrMaxOk_C "Maximum engine speed threshold value to activate the heal enable condition" VALUE 0x80538208 RB_Val_Ws16 32767.50 EngN -16384.00 16383.50 FORMAT "%8.2" /end CHARACTERISTIC
/begin CHARACTERISTIC VehV_nThresPlaPwrMinDfct_C "Minimum engine speed threshold value to activate the defect enable condition" VALUE 0x8053820A RB_Val_Ws16 32767.50 EngN -16384.00 16383.50 FORMAT "%8.2" /end CHARACTERISTIC
/begin CHARACTERISTIC VehV_nThresPlaPwrMinOk_C "Minimum engine speed threshold value to activate the heal enable condition" VALUE 0x8053820C RB_Val_Ws16 32767.00 EngN -16383.50 16383.50 FORMAT "%8.2" EXTENDED_LIMITS -16384.00 16383.50 /end CHARACTERISTIC
/begin CHARACTERISTIC VehV_numSclOut_C "Time scaling number for vehicle speed output" VALUE 0x805381E0 Val_Wu8 255.0 OneToOne 0.00 255.0 FORMAT "%5.1" /end CHARACTERISTIC
/begin CHARACTERISTIC VehV_numSegSens_C "Number of teeth of Tone wheel" VALUE 0x805381A3 RB_Val_Wu8 49.00 OneToOne 1.00 50.00 FORMAT "%5.2" EXTENDED_LIMITS 0.00 255.0 /end CHARACTERISTIC
/begin CHARACTERISTIC VehV_PwmOut.rMin_C "Structure for the PWM out signal / Minimum threshold for the duty cycle" VALUE 0x8053B64E Kw_Ws16 100.0000 DtyCyc 0.00 100.0000 FORMAT "%8.4" EXTENDED_LIMITS -327.6800 327.6700 /end CHARACTERISTIC
/begin CHARACTERISTIC VehV_PwmOut.rMax_C "Structure for the PWM out signal / Maximum threshold for the duty cycle" VALUE 0x8053B650 Kw_Ws16 100.0000 DtyCyc 0.00 100.0000 FORMAT "%8.4" EXTENDED_LIMITS -327.6800 327.6700 /end CHARACTERISTIC
/begin CHARACTERISTIC VehV_PwmOut.tiBtwTstSCB_C "Structure for the PWM out signal / Time between recurring test for SCB error" VALUE 0x8053B652 Kw_Ws16 1000.000 Time_ms 0.00 1000.000 FORMAT "%8.3" EXTENDED_LIMITS -327680.0 327670.0 /end CHARACTERISTIC
/begin CHARACTERISTIC VehV_PwmOut.tiBtwTstOT_C "Structure for the PWM out signal / Time between recurring test for OT error" VALUE 0x8053B654 Kw_Ws16 327.6700 Time_s 0.00 327.6700 FORMAT "%8.4" EXTENDED_LIMITS -327.6800 327.6700 /end CHARACTERISTIC
/begin CHARACTERISTIC VehV_PwmOut.numTstMax_C "Structure for the PWM out signal / Maximum number of tests allowed on permanent defect" VALUE 0x8053B656 Kw_Wu16 65535.00 OneToOne 0.00 65535.00 FORMAT "%8.2" /end CHARACTERISTIC
/begin CHARACTERISTIC VehV_PwmOut.swtBattCor_C "Structure for the PWM out signal / Switch to enable battery correction" VALUE 0x8053B658 Kw_Wu8 1.000 OneToOne 0.00 1.000 FORMAT "%5.3" EXTENDED_LIMITS 0.00 255.0 /end CHARACTERISTIC
/begin CHARACTERISTIC VehV_rAxl_C "Rear axle drive ratio" VALUE 0x805381A4 RB_Val_Wu16 4.000000 Fact0002 2.000000 6.000000 FORMAT "%8.6" EXTENDED_LIMITS 0.00 13.10700 /end CHARACTERISTIC
/begin CHARACTERISTIC VehV_rDifPlaus_C "Threshold value of transmission gear ratio difference" VALUE 0x8053820E RB_Val_Ws16 65.53500 Fact1000 -32.76800 32.76700 FORMAT "%8.5" /end CHARACTERISTIC
/begin CHARACTERISTIC VehV_rMaxDty_C "Maximum duty cycle for the PWM out configuration" VALUE 0x805381E2 Val_Ws16 100.0000 DtyCyc 0.00 100.0000 FORMAT "%8.4" EXTENDED_LIMITS -327.6800 327.6700 /end CHARACTERISTIC
/begin CHARACTERISTIC VehV_rSclOut_C "Scale out ratio for vehicle speed output" VALUE 0x805381E4 Val_Ws16 100.0000 DtyCyc 0.00 100.0000 FORMAT "%8.4" EXTENDED_LIMITS -327.6800 327.6700 /end CHARACTERISTIC
/begin CHARACTERISTIC VehV_rSpdDiffCorrnFac_C "correction factor for Average value of sensor A and sensor B" VALUE 0x80538210 RB_Val_Wu16 655.3500 Prc_Fact100 0.00 655.3500 FORMAT "%8.4" /end CHARACTERISTIC
/begin CHARACTERISTIC VehV_rThresWhlErr_C "Threshold value for the percentage deviation to detect an error" VALUE 0x805381A6 RB_Val_Ws16 655.3500 Prc_q0p01_COMPU -327.6800 327.6700 FORMAT "%8.4" /end CHARACTERISTIC
/begin CHARACTERISTIC VehV_rV2NDifThd_CUR "Curve for V2N ratio" CURVE 0x80538212 RB_Curve_S16_S16 65.53500 Fact1000 -32.76800 32.76700 FORMAT "%8.5"
 /begin AXIS_DESCR STD_AXIS VehV_vSnsrAbslt_MP Vel 6 -327.6800 327.6700 FORMAT "%8.4" DEPOSIT ABSOLUTE /end AXIS_DESCR
/end CHARACTERISTIC
/begin CHARACTERISTIC VehV_stLvl_C "State of power stage voltage level for vehicle speed output" VALUE 0x805381E6 Val_Wu8 255.0 OneToOne 0.00 255.0 FORMAT "%5.1" /end CHARACTERISTIC
/begin CHARACTERISTIC VehV_stPsDiaDisbl_C "Parameter to disable vehicle speed diagnosis" VALUE 0x805381E8 Val_Wu16 65535.00 OneToOne 0.00 65535.00 FORMAT "%8.2" /end CHARACTERISTIC
/begin CHARACTERISTIC VehV_stPsDisbl_C "Parameter to disable vehicle speed output" VALUE 0x805381EA Val_Wu16 65535.00 OneToOne 0.00 65535.00 FORMAT "%8.2" /end CHARACTERISTIC
/begin CHARACTERISTIC VehV_stPsInv_C "Parameter to inverse the output to the powerstage" VALUE 0x805381EC Val_Wu8 1.000 OneToOne 0.00 1.000 FORMAT "%5.3" EXTENDED_LIMITS 0.00 255.0 /end CHARACTERISTIC
/begin CHARACTERISTIC VehV_swtDftT15Off_C "Switch to select default vehicle speed when T15 is switched off" VALUE 0x8053822C RB_Val_Wu8 1.00000000000 B_TRUE 0.00 1.00000000000 FORMAT "%13.11" /end CHARACTERISTIC
/begin CHARACTERISTIC VehV_swtDrctDstPerImp_C "Selection between the direct distance per impulse value or the calculated value" VALUE 0x805381A8 RB_Val_Wu8 1.00000000000 B_TRUE 0.00 1.00000000000 FORMAT "%13.11" /end CHARACTERISTIC
/begin CHARACTERISTIC VehV_swtPlausSel_C "Selection of the Plausibility Checks of the vehicle velocity (bit coded)" VALUE 0x8053822D RB_Val_Wu8 255.0 OneToOne 0.00 255.0 FORMAT "%5.1" /end CHARACTERISTIC
/begin CHARACTERISTIC VehV_swtPwrExcdLim_C "Switch wether condition shall be used for power plausibility check: minimum speed was reached at least once in the current driving cycle" VALUE 0x8053822E RB_Val_Wu8 1.00000000000 B_TRUE 0.00 1.00000000000 FORMAT "%13.11" /end CHARACTERISTIC
/begin CHARACTERISTIC VehV_swtSigPWMOut_C "Switch to select input source for vehicle speed to calculate PWM output signal" VALUE 0x805381ED Val_Wu8 255.0 OneToOne 0.00 255.0 FORMAT "%5.1" /end CHARACTERISTIC
/begin CHARACTERISTIC VehV_swtSigSafe_C "Switch to select vehicle speed from safe input source" VALUE 0x8053822F RB_Val_Wu8 255.0 OneToOne 0.00 255.0 FORMAT "%5.1" /end CHARACTERISTIC
/begin CHARACTERISTIC VehV_swtSigStd_C "Switch to select vehicle speed from standard input source" VALUE 0x80538230 RB_Val_Wu8 255.0 OneToOne 0.00 255.0 FORMAT "%5.1" /end CHARACTERISTIC
/begin CHARACTERISTIC VehV_tiAPT1_C "Time constant for low pass filtering of the vehicle acceleration" VALUE 0x80538232 RB_Val_Ws16 655.3500 Time_s -327.6800 327.6700 FORMAT "%8.4" /end CHARACTERISTIC
/begin CHARACTERISTIC VehV_tiDebImpsCan_C "Debounce time for detection of vehicle speed plausibility error via CAN" VALUE 0x80538234 RB_Val_Ws16 327.6700 Time_s 0.00 327.6700 FORMAT "%8.4" EXTENDED_LIMITS -327.6800 327.6700 /end CHARACTERISTIC
/begin CHARACTERISTIC VehV_tiDebImpsFco_C "Debounce time for detection of vehicle speed plausibility error from fuel cut off plausibility check" VALUE 0x80538236 RB_Val_Ws16 327.6700 Time_s 0.00 327.6700 FORMAT "%8.4" EXTENDED_LIMITS -327.6800 327.6700 /end CHARACTERISTIC
/begin CHARACTERISTIC VehV_tiDebImpsPwr_C "Debounce time for detection of vehicle speed plausibility error from fuel power plausibility check" VALUE 0x80538238 RB_Val_Ws16 327.6700 Time_s 0.00 327.6700 FORMAT "%8.4" EXTENDED_LIMITS -327.6800 327.6700 /end CHARACTERISTIC
/begin CHARACTERISTIC VehV_tiDebImpsV2NTrsm_C "Delay time to confirm V2N plausibilisation error for CVT" VALUE 0x8053823A RB_Val_Ws16 327.6700 Time_s 0.00 327.6700 FORMAT "%8.4" EXTENDED_LIMITS -327.6800 327.6700 /end CHARACTERISTIC
/begin CHARACTERISTIC VehV_tiIntrptDisad_C "Time Period since the last the Interrupt was enabled" VALUE 0x805381AA RB_Val_Ws16 655350.0 Time_ms -327680.0 327670.0 FORMAT "%8.1" /end CHARACTERISTIC
/begin CHARACTERISTIC VehV_tiOffDlyAvdInitPls_C "Defines the additional delay to avoid the initial PWM pulse.Thus the calculation of vehicle speed is started after this additional delay" VALUE 0x805381AC RB_Val_Ws16 655350.0 Time_ms -327680.0 327670.0 FORMAT "%8.1" /end CHARACTERISTIC
/begin CHARACTERISTIC VehV_tiOutMax_C "Maximum period to output vehicl speed pulse" VALUE 0x805381F0 Val_Ws32 3299.00000000 Period_1000 1.00000000 3300.00000000 FORMAT "%13.8" EXTENDED_LIMITS -2147483.64800 2147483.64700 /end CHARACTERISTIC
/begin CHARACTERISTIC VehV_tiOutMin_C "Miniimum period to output vehicl speed pulse" VALUE 0x805381F4 Val_Ws32 3299.00000000 Period_1000 1.00000000 3300.00000000 FORMAT "%13.8" EXTENDED_LIMITS -2147483.64800 2147483.64700 /end CHARACTERISTIC
/begin CHARACTERISTIC VehV_tiPerMax_C "Max. period duration of vehicle speed sensor signal" VALUE 0x805381B0 RB_Val_Ws32 214748364.750 Time_PwmHigh -107374182.400 107374182.350 FORMAT "%13.3" /end CHARACTERISTIC
/begin CHARACTERISTIC VehV_tiPh_C "Phase timer value of PWM signal for vehicle speed output" VALUE 0x805381F8 Val_Ws16 3276.700 Period 0.00 3276.700 FORMAT "%8.3" EXTENDED_LIMITS -3276.800 3276.700 /end CHARACTERISTIC
/begin CHARACTERISTIC VehV_tiPwrPlausDfctEna_C "Debounce time for power plausibility defect enable condition" VALUE 0x8053823C RB_Val_Ws16 327.6700 Time_s 0.00 327.6700 FORMAT "%8.4" EXTENDED_LIMITS -327.6800 327.6700 /end CHARACTERISTIC
/begin CHARACTERISTIC VehV_tiPwrPlausHealEna_C "Debounce time for power plausibility healing enable condition" VALUE 0x8053823E RB_Val_Ws16 327.6700 Time_s 0.00 327.6700 FORMAT "%8.4" EXTENDED_LIMITS -327.6800 327.6700 /end CHARACTERISTIC
/begin CHARACTERISTIC VehV_tiSegAvrg16Le_C "Hysteresis left limit for Time period." VALUE 0x805381B4 RB_Val_Ws32 214748364.750 Time_PwmHigh -107374182.400 107374182.350 FORMAT "%13.3" /end CHARACTERISTIC
/begin CHARACTERISTIC VehV_tiSegAvrg16Ri_C "Hysteresis right limit for Time period." VALUE 0x805381B8 RB_Val_Ws32 214748364.750 Time_PwmHigh -107374182.400 107374182.350 FORMAT "%13.3" /end CHARACTERISTIC
/begin CHARACTERISTIC VehV_tiSegAvrg32Le_C "Hysteresis left limit for Time period." VALUE 0x805381BC RB_Val_Ws32 214748364.750 Time_PwmHigh -107374182.400 107374182.350 FORMAT "%13.3" /end CHARACTERISTIC
/begin CHARACTERISTIC VehV_tiSegAvrg32Ri_C "Hysteresis right limit for Time period." VALUE 0x805381C0 RB_Val_Ws32 214748364.750 Time_PwmHigh -107374182.400 107374182.350 FORMAT "%13.3" /end CHARACTERISTIC
/begin CHARACTERISTIC VehV_tiSegAvrg4Le_C "Hysteresis left limit for Time period." VALUE 0x805381C4 RB_Val_Ws32 214748364.750 Time_PwmHigh -107374182.400 107374182.350 FORMAT "%13.3" /end CHARACTERISTIC
/begin CHARACTERISTIC VehV_tiSegAvrg4Ri_C "Hysteresis right limit for Time period." VALUE 0x805381C8 RB_Val_Ws32 214748364.750 Time_PwmHigh -107374182.400 107374182.350 FORMAT "%13.3" /end CHARACTERISTIC
/begin CHARACTERISTIC VehV_tiSegAvrg8Le_C "Hysteresis left limit for Time period." VALUE 0x805381CC RB_Val_Ws32 214748364.750 Time_PwmHigh -107374182.400 107374182.350 FORMAT "%13.3" /end CHARACTERISTIC
/begin CHARACTERISTIC VehV_tiSegAvrg8Ri_C "Hysteresis right limit for Time period." VALUE 0x805381D0 RB_Val_Ws32 214748364.750 Time_PwmHigh -107374182.400 107374182.350 FORMAT "%13.3" /end CHARACTERISTIC
/begin CHARACTERISTIC VehV_tiT15ON_C "Turn on delay for accepting the vehicle speed PWM signal when T15_st is turned ON." VALUE 0x805381D4 RB_Val_Ws16 327670.0 Time_ms 0.00 327670.0 FORMAT "%8.1" EXTENDED_LIMITS -327680.0 327670.0 /end CHARACTERISTIC
/begin CHARACTERISTIC VehV_tiThdExcdLim_C "Debounce time for detection minimum speed was reached at least once in the current driving cycle" VALUE 0x80538240 RB_Val_Ws16 327.6700 Time_s 0.00 327.6700 FORMAT "%8.4" EXTENDED_LIMITS -327.6800 327.6700 /end CHARACTERISTIC
/begin CHARACTERISTIC VehV_tiUnJit_C "Turn on delay for using the old value for vehicle speed when the jitters are there in the signal." VALUE 0x805381D6 RB_Val_Ws16 327670.0 Time_ms 0.00 327670.0 FORMAT "%8.1" EXTENDED_LIMITS -327680.0 327670.0 /end CHARACTERISTIC
/begin CHARACTERISTIC VehV_tiVAccPT1_C "PT1 filter time constant for the vehicle speed used in acceleration calculation" VALUE 0x80538244 RB_Val_Wr32 9.99900000 Time_s_float 0.0010000 10.0000000 FORMAT "%10.7" EXTENDED_LIMITS -3.40282347E+038 3.40282347E+038 /end CHARACTERISTIC
/begin CHARACTERISTIC VehV_tiVPT1_C "Time constant for low pass filtering of the vehicle speed" VALUE 0x80538248 RB_Val_Ws16 655.3500 Time_s -327.6800 327.6700 FORMAT "%8.4" /end CHARACTERISTIC
/begin CHARACTERISTIC VehV_trqThresPlaDef_C "Engine torque threshold for detecting the plausibility error in vehicle speed" VALUE 0x8053824A RB_Val_Ws16 6553.500 Trq -3276.800 3276.700 FORMAT "%8.3" /end CHARACTERISTIC
/begin CHARACTERISTIC VehV_trqThresPlaOk_C "Engine torque threshold for healing the plausibility error in vehicle speed" VALUE 0x8053824C RB_Val_Ws16 6553.500 Trq -3276.800 3276.700 FORMAT "%8.3" /end CHARACTERISTIC
/begin CHARACTERISTIC VehV_tThresPlaFco_C "Minimum engine temperature limit above which vehicle speed fuel cutoff plausibilisation is enabled" VALUE 0x8053824E RB_Val_Ws16 6553.500 Temp_Cels -3549.940 3003.560 FORMAT "%8.3" /end CHARACTERISTIC
/begin CHARACTERISTIC VehV_tThresPlaPwr_C "Minimum engine temperature limit above which vehicle speed power plausibilisation is enabled" VALUE 0x80538250 RB_Val_Ws16 6553.500 Temp_Cels -3549.940 3003.560 FORMAT "%8.3" /end CHARACTERISTIC
/begin CHARACTERISTIC VehV_vDflOBD_C "Default value for OBD relevent vehicle speed in case of permanent error" VALUE 0x80538252 RB_Val_Ws16 655.3500 Vel -327.6800 327.6700 FORMAT "%8.4" /end CHARACTERISTIC
/begin CHARACTERISTIC VehV_vDfl_C "Default vehicle speed value in case the sensed vehicle speed crosses Min or Max limits" VALUE 0x80538254 RB_Val_Ws16 655.3500 Vel -327.6800 327.6700 FORMAT "%8.4" /end CHARACTERISTIC
/begin CHARACTERISTIC VehV_vDftT15Off_C "Default value for VehV_vSens when T15 is Off" VALUE 0x80538256 RB_Val_Ws16 655.3500 Vel -327.6800 327.6700 FORMAT "%8.4" /end CHARACTERISTIC
/begin CHARACTERISTIC VehV_vLowThres_C "Top_Vehicle_Speed_Low_Threshold" VALUE 0x80538258 RB_Val_Ws16 655.3500 Vel -327.6800 327.6700 FORMAT "%8.4" /end CHARACTERISTIC
/begin CHARACTERISTIC VehV_vMaxFix_C "Max limit for the top speed calculation" VALUE 0x8053825A RB_Val_Ws16 655.3500 Vel -327.6800 327.6700 FORMAT "%8.4" /end CHARACTERISTIC
/begin CHARACTERISTIC VehV_vMin_C "min. sensed vehicle speed for calculation of outputted vehicle speed" VALUE 0x8053825C RB_Val_Ws16 655.3500 Vel -327.6800 327.6700 FORMAT "%8.4" /end CHARACTERISTIC
/begin CHARACTERISTIC VehV_vPhysRngMax_C "Maximum value of vehicle speed above which physical range max error is reported" VALUE 0x8053825E RB_Val_Ws16 655.3500 Vel -327.6800 327.6700 FORMAT "%8.4" /end CHARACTERISTIC
/begin CHARACTERISTIC VehV_vPhysRngMin_C "Minimum value of vehicle speed below which physical range min error is reported" VALUE 0x80538260 RB_Val_Ws16 655.3500 Vel -327.6800 327.6700 FORMAT "%8.4" /end CHARACTERISTIC
/begin CHARACTERISTIC VehV_vSensDiffLim_C "Limit to decide if the vehicle speed signal is jitter." VALUE 0x805381D8 RB_Val_Ws16 327.6700 Vel 0.00 327.6700 FORMAT "%8.4" EXTENDED_LIMITS -327.6800 327.6700 /end CHARACTERISTIC
/begin CHARACTERISTIC VehV_vSnsrFailrThd_C "Threshold for indicating sensor failure condition" VALUE 0x80538262 RB_Val_Ws16 655.3500 Vel -327.6800 327.6700 FORMAT "%8.4" /end CHARACTERISTIC
/begin CHARACTERISTIC VehV_vSnsrSpdDiffThd_C "Threshold value for speed sensor rationality diagnosis" VALUE 0x80538264 RB_Val_Ws16 655.3500 Vel -327.6800 327.6700 FORMAT "%8.4" /end CHARACTERISTIC
/begin CHARACTERISTIC VehV_vThdExcdLim_C "Velocity for detection minimum speed was reached at least once in the current driving cycle" VALUE 0x80538266 RB_Val_Ws16 655.3500 Vel -327.6800 327.6700 FORMAT "%8.4" /end CHARACTERISTIC
/begin CHARACTERISTIC VehV_vThresPlaFco_C "Vehicle speed threshold for detection of vehicle speed Fuel cuttoff plausibilisation error" VALUE 0x80538268 RB_Val_Ws16 655.3500 Vel -327.6800 327.6700 FORMAT "%8.4" /end CHARACTERISTIC
/begin CHARACTERISTIC VehV_vThresPlaPwrDef_C "Vehicle speed threshold for detecting the plausibility error in vehicle speed" VALUE 0x8053826A RB_Val_Ws16 655.3500 Vel -327.6800 327.6700 FORMAT "%8.4" /end CHARACTERISTIC
/begin CHARACTERISTIC VehV_vThresPlaPwrOk_C "Vehicle speed threshold for healing the plausibility error in vehicle speed" VALUE 0x8053826C RB_Val_Ws16 655.3500 Vel -327.6800 327.6700 FORMAT "%8.4" /end CHARACTERISTIC
/begin CHARACTERISTIC VehV_vThresPlaV2N_C "Vehicle speed threshold for detecting V2N plausibility error" VALUE 0x8053826E RB_Val_Ws16 655.3500 Vel -327.6800 327.6700 FORMAT "%8.4" /end CHARACTERISTIC
/begin CHARACTERISTIC VehV_vWhlErrMax_C "Maximum vehicle velocity below which the wheel error detection is enabled" VALUE 0x805381DA RB_Val_Ws16 655.3500 Vel -327.6800 327.6700 FORMAT "%8.4" /end CHARACTERISTIC
/begin CHARACTERISTIC VehV_vWhlErrMin_C "Minimum vehicle velocity above which the wheel error detection is enabled" VALUE 0x805381DC RB_Val_Ws16 655.3500 Vel -327.6800 327.6700 FORMAT "%8.4" /end CHARACTERISTIC
/begin CHARACTERISTIC VMD_rDrvModCorrnCmft_T "Curve to adjust the Virtual accelerator pedal position in Comfort drive mode" CURVE 0x80537FA4 RB_Curve_S16_S16 799.9878 Prc -400.0000 399.9878 FORMAT "%8.4"
 /begin AXIS_DESCR STD_AXIS VMD_rASLCC Prc 10 -400.0000 399.9878 FORMAT "%8.4" DEPOSIT ABSOLUTE /end AXIS_DESCR
/end CHARACTERISTIC
/begin CHARACTERISTIC VMD_rDrvModCorrnEco_T "Curve to adjust the Virtual accelerator pedal position in Economy drive mode" CURVE 0x80537FCE RB_Curve_S16_S16 799.9878 Prc -400.0000 399.9878 FORMAT "%8.4"
 /begin AXIS_DESCR STD_AXIS VMD_rASLCC Prc 10 -400.0000 399.9878 FORMAT "%8.4" DEPOSIT ABSOLUTE /end AXIS_DESCR
/end CHARACTERISTIC
/begin CHARACTERISTIC VMD_rDrvModCorrnNorm_T "Curve to adjust the Virtual accelerator pedal position in Normal drive mode" CURVE 0x80537FF8 RB_Curve_S16_S16 799.9878 Prc -400.0000 399.9878 FORMAT "%8.4"
 /begin AXIS_DESCR STD_AXIS VMD_rASLCC Prc 10 -400.0000 399.9878 FORMAT "%8.4" DEPOSIT ABSOLUTE /end AXIS_DESCR
/end CHARACTERISTIC
/begin CHARACTERISTIC VMD_rDrvModCorrnSnow_T "Curve to adjust the Virtual accelerator pedal position in Snow drive mode" CURVE 0x80538022 RB_Curve_S16_S16 799.9878 Prc -400.0000 399.9878 FORMAT "%8.4"
 /begin AXIS_DESCR STD_AXIS VMD_rASLCC Prc 10 -400.0000 399.9878 FORMAT "%8.4" DEPOSIT ABSOLUTE /end AXIS_DESCR
/end CHARACTERISTIC
/begin CHARACTERISTIC VMD_rDrvModCorrnSpt_T "Curve to adjust the Virtual accelerator pedal position in Sport drive mode" CURVE 0x8053804C RB_Curve_S16_S16 799.9878 Prc -400.0000 399.9878 FORMAT "%8.4"
 /begin AXIS_DESCR STD_AXIS VMD_rASLCC Prc 10 -400.0000 399.9878 FORMAT "%8.4" DEPOSIT ABSOLUTE /end AXIS_DESCR
/end CHARACTERISTIC
/begin CHARACTERISTIC VMD_rMinWoRamp_C "Minimum accped ratio difference for ramping of torque during drive mode change to be activated" VALUE 0x80538076 RB_Val_Ws16 799.9878 Prc -400.0000 399.9878 FORMAT "%8.4" /end CHARACTERISTIC
/begin CHARACTERISTIC VMD_stAslAccSel_C "Status of Switch for selection of ASL or CC value" VALUE 0x80538078 RB_Val_Wu8 255.0 OneToOne 0.00 255.0 FORMAT "%5.1" /end CHARACTERISTIC
/begin CHARACTERISTIC VMD_tiRampSlopModChg_CA "Time period within which ramping of accped ratio during drive mode change should be finished" VAL_BLK 0x8053807A RB_Val_Ws16 655.3500 Time_s -327.6800 327.6700 FORMAT "%8.4" NUMBER 12 /end CHARACTERISTIC
/begin CHARACTERISTIC VMSI_dtqRmpDCSP.Neg_C "Ramp gradient for shut down of increasing intervention DCS / Ramp structure" VALUE 0x805380A8 RB_Val_Ws32 6553599.99847 RmpTrqPrpHigh -3276800.00000 3276799.99847 FORMAT "%13.5" /end CHARACTERISTIC
/begin CHARACTERISTIC VMSI_dtqRmpDCSP.Pos_C "Ramp gradient for shut down of increasing intervention DCS / Ramp structure" VALUE 0x805380AC RB_Val_Ws32 6553599.99847 RmpTrqPrpHigh -3276800.00000 3276799.99847 FORMAT "%13.5" /end CHARACTERISTIC
/begin CHARACTERISTIC VMSI_dtqRmpTCSP.Neg_C "Ramp gradient for shut down of decreasing intervention TCS / Ramp structure" VALUE 0x805380B0 RB_Val_Ws32 6553599.99847 RmpTrqPrpHigh -3276800.00000 3276799.99847 FORMAT "%13.5" /end CHARACTERISTIC
/begin CHARACTERISTIC VMSI_dtqRmpTCSP.Pos_C "Ramp gradient for shut down of decreasing intervention TCS / Ramp structure" VALUE 0x805380B4 RB_Val_Ws32 6553599.99847 RmpTrqPrpHigh -3276800.00000 3276799.99847 FORMAT "%13.5" /end CHARACTERISTIC
/begin CHARACTERISTIC VMSI_stCfg_C "DCS shut off configuration" VALUE 0x80538094 RB_Val_Wu8 255.0 OneToOne 0.00 255.0 FORMAT "%5.1" /end CHARACTERISTIC
/begin CHARACTERISTIC VMSI_swtSlipCtl_C "Switch for available stabilty intervention" VALUE 0x80538095 RB_Val_Wu8 255.0 OneToOne 0.00 255.0 FORMAT "%5.1" /end CHARACTERISTIC
/begin CHARACTERISTIC VMSI_tiPlusOff_C "DCS torque control disable timer" VALUE 0x80538096 RB_Val_Wu16 327460.0 Time_ms 0.00 327460.0 FORMAT "%8.1" EXTENDED_LIMITS 0.00 655350.0 /end CHARACTERISTIC
/begin CHARACTERISTIC VMSI_tiPlus_C "DCS torque control enable timer" VALUE 0x80538098 RB_Val_Wu16 327460.0 Time_ms 0.00 327460.0 FORMAT "%8.1" EXTENDED_LIMITS 0.00 655350.0 /end CHARACTERISTIC
/begin CHARACTERISTIC VMSI_trqLimDCSNorm_C "DCS torque control normal limit value" VALUE 0x8053809C RB_Val_Ws32 1500.00000000 TrqPrpHigh -500.00000000 1000.00000000 FORMAT "%13.8" EXTENDED_LIMITS -214748364.800 214748364.700 /end CHARACTERISTIC
/begin CHARACTERISTIC VMSI_trqLimDCSPlus_C "DCS torque control plus limit value" VALUE 0x805380A0 RB_Val_Ws32 1500.00000000 TrqPrpHigh -500.00000000 1000.00000000 FORMAT "%13.8" EXTENDED_LIMITS -214748364.800 214748364.700 /end CHARACTERISTIC
/begin CHARACTERISTIC VMSI_trqMin_C "Testvalue for DCS Intervention" VALUE 0x805380A4 RB_Val_Ws32 100000.000000 TrqPrpHigh -50000.0000000 50000.0000000 FORMAT "%13.7" EXTENDED_LIMITS -214748364.800 214748364.700 /end CHARACTERISTIC
/begin CHARACTERISTIC WDKSRFE "throttle angle end position (self-cleaning-function)" VALUE 0x80538278 RB_Val_Wu8 99.61 relDK_q0p390631 0.00 99.61 FORMAT "%5.2" /end CHARACTERISTIC
/begin CHARACTERISTIC WDKSRFI "throttle angle initial position (self-cleaning-function)" VALUE 0x80538279 RB_Val_Wu8 99.61 relDK_q0p390631 0.00 99.61 FORMAT "%5.2" /end CHARACTERISTIC
/begin CHARACTERISTIC WDKSRFO "throttle angle upper stop position (self-cleaning-function)" VALUE 0x8053827A RB_Val_Wu8 99.61 relDK_q0p390631 0.00 99.61 FORMAT "%5.2" /end CHARACTERISTIC
/begin CHARACTERISTIC WDKSRFU "throttle angle lower stop position (self-cleaning-function)" VALUE 0x8053827B RB_Val_Wu8 99.61 relDK_q0p390631 0.00 99.61 FORMAT "%5.2" /end CHARACTERISTIC
/begin CHARACTERISTIC Wiper_stActv_C "Calibration for wiper active status" VALUE 0x8053827C RB_Val_Wu8 255.0 OneToOne 0.00 255.0 FORMAT "%5.1" /end CHARACTERISTIC
/begin CHARACTERISTIC Wiper_stSwt_C "Calibration for the diffrerent content of CAN message input" VALUE 0x8053827D RB_Val_Wu8 1.000 OneToOne 0.00 1.000 FORMAT "%5.3" EXTENDED_LIMITS 0.00 255.0 /end CHARACTERISTIC
/begin CHARACTERISTIC ZWSTT_COM.agIgnCoMStrt_GM "Class instance for ignition angle at change of mind / Grouped map Ignition angle at change of mind" MAP 0x8053A0FC RB_MapGroup_S8 191.3 zw_sb_q0p75 -96.00 95.25 FORMAT "%5.2"
 /begin AXIS_DESCR COM_AXIS AirMod_ratChrgAirCyl rel_q0p02344 6 0.00 1535.977 FORMAT "%8.3" AXIS_PTS_REF EngStrt_ratChrgAgIgnStrt_AX /end AXIS_DESCR
 /begin AXIS_DESCR COM_AXIS Epm_nEng EngN 8 -16384.00 16383.50 FORMAT "%8.2" AXIS_PTS_REF EngStrt_nEngAgIgn_AX /end AXIS_DESCR
/end CHARACTERISTIC
/begin CHARACTERISTIC ZWSTT_COMWAITSTRTR.agIgnCoMStrt_GM " / Grouped map Ignition angle at change of mind" MAP 0x8053A0B8 RB_MapGroup_S8 191.3 zw_sb_q0p75 -96.00 95.25 FORMAT "%5.2"
 /begin AXIS_DESCR COM_AXIS AirMod_ratChrgAirCyl rel_q0p02344 6 0.00 1535.977 FORMAT "%8.3" AXIS_PTS_REF EngStrt_ratChrgAgIgnStrt_AX /end AXIS_DESCR
 /begin AXIS_DESCR COM_AXIS Epm_nEng EngN 8 -16384.00 16383.50 FORMAT "%8.2" AXIS_PTS_REF EngStrt_nEngAgIgn_AX /end AXIS_DESCR
/end CHARACTERISTIC
/begin CHARACTERISTIC ZWSTT_CORR.agIgnOffsCorrAlti_T "correction factor / Altitude correction curve" CURVE 0x8053A130 RB_CurveGroup_S8 191.3 zw_sb_q0p75 -96.00 95.25 FORMAT "%5.2"
 /begin AXIS_DESCR COM_AXIS PEnv_facCorrAlti fak_uw_b4 5 0.00 3.999939 FORMAT "%8.6" AXIS_PTS_REF EngStrt_facCorrAltiAgIgn_AX /end AXIS_DESCR
/end CHARACTERISTIC
/begin CHARACTERISTIC ZWSTT_CORR.agIgnOffsIntkAir_T "correction factor / Intake air offset correction curve" CURVE 0x8053A135 RB_CurveGroup_S8 191.3 zw_sb_q0p75 -96.00 95.25 FORMAT "%5.2"
 /begin AXIS_DESCR COM_AXIS IntkAirT_tIntkMnfld Temp_Cels 6 -3549.940 3003.560 FORMAT "%8.3" AXIS_PTS_REF EngStrt_tIntkMnfldAgIgn_AX /end AXIS_DESCR
/end CHARACTERISTIC
/begin CHARACTERISTIC ZWSTT_CORR_2.agIgnOffsCorrAlti_T " / Altitude correction curve" CURVE 0x8053A0EC RB_CurveGroup_S8 191.3 zw_sb_q0p75 -96.00 95.25 FORMAT "%5.2"
 /begin AXIS_DESCR COM_AXIS PEnv_facCorrAlti fak_uw_b4 5 0.00 3.999939 FORMAT "%8.6" AXIS_PTS_REF EngStrt_facCorrAltiAgIgn_AX /end AXIS_DESCR
/end CHARACTERISTIC
/begin CHARACTERISTIC ZWSTT_CORR_2.agIgnOffsIntkAir_T " / Intake air offset correction curve" CURVE 0x8053A0F1 RB_CurveGroup_S8 191.3 zw_sb_q0p75 -96.00 95.25 FORMAT "%5.2"
 /begin AXIS_DESCR COM_AXIS IntkAirT_tIntkMnfld Temp_Cels 6 -3549.940 3003.560 FORMAT "%8.3" AXIS_PTS_REF EngStrt_tIntkMnfldAgIgn_AX /end AXIS_DESCR
/end CHARACTERISTIC
/begin CHARACTERISTIC ZWSTT_FOLW.agIgnStrtOffs_GM "Class instance for ignition angle offset at following start / Grouped map Ignition angle offset at start (driver request)" MAP 0x8053A140 RB_MapGroup_S8 191.3 zw_sb_q0p75 -96.00 95.25 FORMAT "%5.2"
 /begin AXIS_DESCR COM_AXIS APP_r Prc 10 -400.0000 399.9878 FORMAT "%8.4" AXIS_PTS_REF EngStrt_rPedAgIgn_AX /end AXIS_DESCR
 /begin AXIS_DESCR COM_AXIS Epm_nEng EngN 8 -16384.00 16383.50 FORMAT "%8.2" AXIS_PTS_REF EngStrt_nEngAgIgn_AX /end AXIS_DESCR
/end CHARACTERISTIC
/begin CHARACTERISTIC ZWSTT_FOLW.facAgIgnStrtOffs_GT "Class instance for ignition angle offset at following start / Grouped curve factor for ignition angle offset at start (driver request)" CURVE 0x8053A190 RB_CurveGroup_U8 1.992188 fak_ub_b2 0.00 1.992188 FORMAT "%8.6"
 /begin AXIS_DESCR COM_AXIS EngStrt_tStrtCoor Temp_Cels 8 -273.140 3003.560 FORMAT "%8.3" EXTENDED_LIMITS -3549.940 3003.560 AXIS_PTS_REF EngStrt_tStrtAgIgn_AX /end AXIS_DESCR
/end CHARACTERISTIC
/begin CHARACTERISTIC ZWSTT_LOP.agIgnStrt_GM "Class instance for ignition angle at low pressure start / Grouped map Ignition angle at start (base value)" MAP 0x8053A19C RB_MapGroup_S8 191.3 zw_sb_q0p75 -96.00 95.25 FORMAT "%5.2"
 /begin AXIS_DESCR COM_AXIS Epm_nEng EngN 8 -16384.00 16383.50 FORMAT "%8.2" AXIS_PTS_REF EngStrt_nEngAgIgn_AX /end AXIS_DESCR
 /begin AXIS_DESCR COM_AXIS EngStrt_tStrtCoor Temp_Cels 8 -273.140 3003.560 FORMAT "%8.3" EXTENDED_LIMITS -3549.940 3003.560 AXIS_PTS_REF EngStrt_tStrtAgIgn_AX /end AXIS_DESCR
/end CHARACTERISTIC
/begin MEASUREMENT B_engoff_msg "Condition engine off (throttle self-cleaning-function)" UBYTE B_TRUE 1 100 0.00 1.00000000000 BIT_MASK 0x1 FORMAT "%13.11" ECU_ADDRESS 0x6000015E /end MEASUREMENT
/begin MEASUREMENT B_srfdke_msg "Condition throttle in end position (self-cleaning-function)" UBYTE B_TRUE 1 100 0.00 1.00000000000 BIT_MASK 0x1 FORMAT "%13.11" ECU_ADDRESS 0x60000130 /end MEASUREMENT
/begin MEASUREMENT B_srfdko_msg "Condition throttle in upper stop position (self-cleaning-function)" UBYTE B_TRUE 1 100 0.00 1.00000000000 BIT_MASK 0x1 FORMAT "%13.11" ECU_ADDRESS 0x6000012F /end MEASUREMENT
/begin MEASUREMENT B_srfdku_msg "Condition throttle in lower stop position (self-cleaning-function)" UBYTE B_TRUE 1 100 0.00 1.00000000000 BIT_MASK 0x1 FORMAT "%13.11" ECU_ADDRESS 0x6000012E /end MEASUREMENT
/begin MEASUREMENT B_zwmngs_msg "Ignition angle late limit during gearshift with ignition angle intervention" UBYTE B_TRUE 1 100 0.00 1.00000000000 BIT_MASK 0x1 FORMAT "%13.11" ECU_ADDRESS 0x6000A229 /end MEASUREMENT
/begin MEASUREMENT B_zwms_msg "engine prot." UBYTE B_TRUE 1 100 0.00 1.00000000000 BIT_MASK 0x1 FORMAT "%13.11" ECU_ADDRESS 0x7000094E /end MEASUREMENT
/begin MEASUREMENT B_zwsyn "Condition crankshaft-synchronous calculation of maps for ignition angle" UBYTE B_TRUE 1 100 0.00 1.00000000000 BIT_MASK 0x1 FORMAT "%13.11" ECU_ADDRESS 0x700016C0 /end MEASUREMENT
/begin MEASUREMENT ChrCtl_B_srfdko_EF_I.buffer "Falling edge of B_srfdko / memory to detect falling edge" UBYTE B_TRUE 1 100 0.00 1.00000000000 BIT_MASK 0x1 FORMAT "%13.11" ECU_ADDRESS 0x60000B5A /end MEASUREMENT
/begin MEASUREMENT ChrCtl_B_srfdko_EF_I.oldSignal "Falling edge of B_srfdko / memory to detect falling edge" UBYTE B_TRUE 1 100 0.00 1.00000000000 BIT_MASK 0x1 FORMAT "%13.11" ECU_ADDRESS 0x60000B5B /end MEASUREMENT
/begin MEASUREMENT ChrCtl_B_srfdku_EF_I.buffer "Falling edge of B_srfdku / memory to detect falling edge" UBYTE B_TRUE 1 100 0.00 1.00000000000 BIT_MASK 0x1 FORMAT "%13.11" ECU_ADDRESS 0x60000B58 /end MEASUREMENT
/begin MEASUREMENT ChrCtl_B_srfdku_EF_I.oldSignal "Falling edge of B_srfdku / memory to detect falling edge" UBYTE B_TRUE 1 100 0.00 1.00000000000 BIT_MASK 0x1 FORMAT "%13.11" ECU_ADDRESS 0x60000B59 /end MEASUREMENT
/begin MEASUREMENT ChrCtl_SRFDKI_TONV_I.outbit "Variable TurnOnDelay counter for SRFDKI / return value" UBYTE B_TRUE 1 100 0.00 1.00000000000 BIT_MASK 0x1 FORMAT "%13.11" ECU_ADDRESS 0x60000B54 /end MEASUREMENT
/begin MEASUREMENT ChrCtl_SRFDKI_TONV_I.time "Variable TurnOnDelay counter for SRFDKI / expired delay time" UWORD t_q0p01 1 100 0.00 655.3500 FORMAT "%8.4" ECU_ADDRESS 0x60000B56 /end MEASUREMENT
/begin MEASUREMENT ChrCtl_SRFDKO_TE_I.inOld "TimerEnabled counter for SRFDKO / Previous state of input value" UBYTE B_TRUE 1 100 0.00 1.00000000000 BIT_MASK 0x1 FORMAT "%13.11" ECU_ADDRESS 0x60000B52 /end MEASUREMENT
/begin MEASUREMENT ChrCtl_SRFDKO_TE_I.timeCounter "TimerEnabled counter for SRFDKO / Remaining time of the timer" UBYTE t_q0p01 1 100 0.00 2.550 FORMAT "%5.3" ECU_ADDRESS 0x60000B53 /end MEASUREMENT
/begin MEASUREMENT ChrCtl_SRFDKU_T_I.timeCounter "Timer counter for SRFDKU / Remaining time of the timer" UBYTE t_q0p01 1 100 0.00 2.550 FORMAT "%5.3" ECU_ADDRESS 0x60000B50 /end MEASUREMENT
/begin MEASUREMENT dzwmntmp "temp.delta late ign. angle" SBYTE kw_q0p75 1 100 -96.00 95.25 FORMAT "%5.2" ECU_ADDRESS 0x700016C6 /end MEASUREMENT
/begin MEASUREMENT dzwotm_w_msg "temperature-dependent correction of optimized model reference ignition angle" SWORD zw_q2p9297Em3_deg_KW 1 100 -96.00000 95.99707 FORMAT "%8.5" ECU_ADDRESS 0x500007BC /end MEASUREMENT
/begin MEASUREMENT dzwwl_msg "delta ignition angle from warm-up" SBYTE zw_sb_q0p75 1 100 -96.00 95.25 FORMAT "%5.2" ECU_ADDRESS 0x6000E447 /end MEASUREMENT
/begin MEASUREMENT dzwwl_s16_msg "dzwwl_s16 as message" SWORD zw_q0p1 1 100 -3276.800 3276.700 FORMAT "%8.3" ECU_ADDRESS 0x60004DD6 /end MEASUREMENT
/begin MEASUREMENT EngStrt_agIgnStrtCorrOffs_MP "Measuring point Delta ignition angle during start" SBYTE zw_sb_q0p75 1 100 -96.00 95.25 FORMAT "%5.2" ECU_ADDRESS 0x70008ABE /end MEASUREMENT
/begin MEASUREMENT EngStrt_idxClassSelnAgIgn_MP "Measuring point index class selector for ignition angle during start" UBYTE OneToOne 1 100 0.00 255.0 FORMAT "%5.1" ECU_ADDRESS 0x70008ABD /end MEASUREMENT
/begin MEASUREMENT EngStrt_nEngZWWL "Internal engine speed for function ZWWL" UBYTE nmot_ub_q40 1 100 0.00 10200. FORMAT "%5.0" ECU_ADDRESS 0x60006209 /end MEASUREMENT
/begin MEASUREMENT EngStrt_relAirFillg "relative air filling for function ZWWL" UBYTE rel_ub_q0p75 1 100 0.00 191.3 FORMAT "%5.1" ECU_ADDRESS 0x60006208 /end MEASUREMENT
/begin MEASUREMENT EngStrt_tEngZWWL "Internal engine temperature for function ZWWL" UBYTE temp_ub_q0p75_o48 1 100 -48.0 143.3 FORMAT "%5.1" ECU_ADDRESS 0x60006207 /end MEASUREMENT
/begin MEASUREMENT ExhMgT_diaInertCylVlvLft "delta ignition angle based on residual gas rate for component protection" SBYTE zw_sb_q0p75 1 100 -96.00 95.25 FORMAT "%5.2" ECU_ADDRESS 0x700016D2 /end MEASUREMENT
/begin MEASUREMENT ExhMgT_facCptProtnGearShift "factor component prot. during gearshift" UBYTE fak_ub_b1 1 100 0.00 0.9961 ECU_ADDRESS 0x6000A067 /end MEASUREMENT
/begin MEASUREMENT ExhMgT_ratInertCylVlvLft "Residual gas reference for component protection" UWORD rel_uw_b100 1 100 0.00 99.99847 FORMAT "%8.5" ECU_ADDRESS 0x700016D0 /end MEASUREMENT
/begin MEASUREMENT flambts_msg "factor lambda component protection" UBYTE fak_ub_b1 1 100 0.00 0.9961 ECU_ADDRESS 0x60009FF7 /end MEASUREMENT
/begin MEASUREMENT ftsztl "factor for dwell period reduction (i.e.depends on air charge)" UBYTE fak_ub_b1 1 100 0.00 0.9961 ECU_ADDRESS 0x6000620D /end MEASUREMENT
/begin MEASUREMENT fzwmn_w "fade out factor for latest ignition angle during afterstart" UWORD fak_uw_b1 1 100 0.00 0.9999847 FORMAT "%9.7" ECU_ADDRESS 0x6000342E /end MEASUREMENT
/begin MEASUREMENT Gen_ctCylAdv "EPM SW-cylinder counter doubled range" UBYTE dez 1 100 0.00 255.0 FORMAT "%5.1" ECU_ADDRESS 0x5000088A /end MEASUREMENT
/begin MEASUREMENT IgCtl_diaAltiCorrnKnkCtrl "Delta ignition angle for knock control with altitude correction" SWORD zw_q0p1 1 100 -3276.800 3276.700 FORMAT "%8.3" ECU_ADDRESS 0x60003434 /end MEASUREMENT
/begin MEASUREMENT IgCtl_diaCorrnPEnv "Ignition angle correction due to ambient pressure" SBYTE kw_q0p75 1 100 -96.00 95.25 FORMAT "%5.2" ECU_ADDRESS 0x70001C49 /end MEASUREMENT
/begin MEASUREMENT IgCtl_diaKnkTEngIntk "Delta ignition angle for knock control from engine and intake air temperature" SWORD zw_q0p1 1 100 -3276.800 3276.700 FORMAT "%8.3" ECU_ADDRESS 0x60003432 /end MEASUREMENT
/begin MEASUREMENT IgCtl_diaLteEngT "Offset for the maximum retarded spark limitation due to engine temperature" SBYTE kw_q0p75 1 100 -96.00 95.25 FORMAT "%5.2" ECU_ADDRESS 0x70001C48 /end MEASUREMENT
/begin MEASUREMENT IgCtl_diaLteFuCutOff "delta ignition angle offset for fuel cut-off" SBYTE kw_q0p75 1 100 -96.00 95.25 FORMAT "%5.2" ECU_ADDRESS 0x700016D5 /end MEASUREMENT
/begin MEASUREMENT IgCtl_dwlt_u16 "dwell-time" UWORD t_q0p001_ms 1 100 0.00 65.53500 FORMAT "%8.5" ECU_ADDRESS 0x6000E28E /end MEASUREMENT
/begin MEASUREMENT IgCtl_facRampIaLteFuCutOff "fuel cut-off request" UBYTE fak_ub_b1 1 100 0.00 0.9961 ECU_ADDRESS 0x70001C26 /end MEASUREMENT
/begin MEASUREMENT IgCtl_flgFixdIaOutpTstr "Flag of Ignition angle is fixed due to T-terminal request" UBYTE B_TRUE 1 100 0.00 1.00000000000 BIT_MASK 0x1 FORMAT "%13.11" ECU_ADDRESS 0x70001BF1 /end MEASUREMENT
/begin MEASUREMENT IgCtl_flgFuCutOffDetn "Fuel cut-off detection flag" UBYTE B_TRUE 1 100 0.00 1.00000000000 BIT_MASK 0x1 FORMAT "%13.11" ECU_ADDRESS 0x6000A17D /end MEASUREMENT
/begin MEASUREMENT IgCtl_flgIntkAirFltSnsrKnkProtn "flag for intake air temperature Fault sensor for Ignition control" UBYTE B_TRUE 1 100 0.00 1.00000000000 BIT_MASK 0x1 FORMAT "%13.11" ECU_ADDRESS 0x6000620C /end MEASUREMENT
/begin MEASUREMENT IgCtl_flgIntkVlvlftSwtDly "intake valve lift switchover delay for ignition" UBYTE B_TRUE 1 100 0.00 1.00000000000 BIT_MASK 0x1 FORMAT "%13.11" ECU_ADDRESS 0x70001BF0 /end MEASUREMENT
/begin MEASUREMENT IgCtl_flgTFltSnsrKnkProtn "flag forr engine coolant temperature Fault sensor for Ignition control" UBYTE B_TRUE 1 100 0.00 1.00000000000 BIT_MASK 0x1 FORMAT "%13.11" ECU_ADDRESS 0x6000620B /end MEASUREMENT
/begin MEASUREMENT IgCtl_iaDiffKnkAdpn "difference between base and desired ignition angle to detect intervention of knock adaption via ignition angle" SWORD zw_q0p1 1 100 -3276.800 3276.700 FORMAT "%8.3" ECU_ADDRESS 0x700016C2 /end MEASUREMENT
/begin MEASUREMENT IgCtl_iaLteCamsftPha "Ignition late limit, dependent on camshaft angular position resp. valve timing" SBYTE kw_q0p75 1 100 -96.00 95.25 FORMAT "%5.2" ECU_ADDRESS 0x700016C5 /end MEASUREMENT
/begin MEASUREMENT IgCtl_iaLteCamsftPhaLowVlvlft "Ignition late limit, dependent on camshaft angular position resp. valve timing - Low valve lift" SBYTE kw_q0p75 1 100 -96.00 95.25 FORMAT "%5.2" ECU_ADDRESS 0x700016C4 /end MEASUREMENT
/begin MEASUREMENT IgCtl_iaLteGearShiftSecFu "late ignition angle for gear shift" SBYTE kw_q0p75 1 100 -96.00 95.25 FORMAT "%5.2" ECU_ADDRESS 0x700016D4 /end MEASUREMENT
/begin MEASUREMENT IgCtl_iaLteLimDyn "dynamic late ignition angle limit (temporary available)" SBYTE kw_q0p75 1 100 -96.00 95.25 FORMAT "%5.2" ECU_ADDRESS 0x700016D3 /end MEASUREMENT
/begin MEASUREMENT IgCtl_iaLteLimStat "static late ignition angle limit (permanent possible)" SBYTE kw_q0p75 1 100 -96.00 95.25 FORMAT "%5.2" ECU_ADDRESS 0x70001C46 /end MEASUREMENT
/begin MEASUREMENT IgCtl_iaOutpRdnt "redundancy of output ignition angle" UWORD dez 1 100 0.00 65535.00 FORMAT "%8.2" ECU_ADDRESS 0x70001CEC /end MEASUREMENT
/begin MEASUREMENT IgCtl_iaPrimHomMinCptProtnIntv "primary ignition angle HOM assuming minimal component protection intervention through lambda" SWORD zw_q0p1 1 100 -96.00000 95.30000 FORMAT "%8.5" ECU_ADDRESS 0x70001D88 /end MEASUREMENT
/begin MEASUREMENT IgCtl_iaPrimMap "current map value of prim.ign.angle(pos.1)" SWORD zw_q0p1 1 100 -3276.800 3276.700 FORMAT "%8.3" ECU_ADDRESS 0x700016EA /end MEASUREMENT
/begin MEASUREMENT IgCtl_iaPrimMapVlvlft "Primary ignition angle from calibration map at low valve lift" SWORD zw_q0p1 1 100 -3276.800 3276.700 FORMAT "%8.3" ECU_ADDRESS 0x700016E8 /end MEASUREMENT
/begin MEASUREMENT IgCtl_iaPrimMinCptProtnIntv "primary ignition angle(16bit) assuming minimal component protection intervention through lambda" SWORD zw_q0p1 1 100 -96.00000 95.30000 FORMAT "%8.5" ECU_ADDRESS 0x70001D86 /end MEASUREMENT
/begin MEASUREMENT IgCtl_iaPrimWoLam "primary ignition angle without lambda correction" SWORD zw_q0p1 1 100 -3276.800 3276.700 FORMAT "%8.3" ECU_ADDRESS 0x700016E6 /end MEASUREMENT
/begin MEASUREMENT IgCtl_numfol_u8 "number of follow-up sparcs during sparc-band ignition-mode" UBYTE dez 1 100 0.00 255.0 FORMAT "%5.1" ECU_ADDRESS 0x50005D8B /end MEASUREMENT
/begin MEASUREMENT igctl_ovl_u8 "Start-Dwell overlap counter" UBYTE dez 1 100 0.00 255.0 FORMAT "%5.1" ECU_ADDRESS 0x70001C08 /end MEASUREMENT
/begin MEASUREMENT IgCtl_tSelTKnkCtrlIntk "selected temperature for delta ignition angle calculation for knock protection" SWORD Temp_Cels 1 100 -3549.940 3003.560 FORMAT "%8.3" ECU_ADDRESS 0x60003430 /end MEASUREMENT
/begin MEASUREMENT Ign_bstrt_iaLT "start-up phase with latest ignition angle not yet reached" UBYTE B_TRUE 1 100 0.00 1.00000000000 BIT_MASK 0x1 FORMAT "%13.11" ECU_ADDRESS 0x6000A17C /end MEASUREMENT
/begin MEASUREMENT Ign_bVlvLInNxtCmbs "condition cylinder number with combustion with standard intake valve-lift" UBYTE B_TRUE 1 100 0.00 1.00000000000 BIT_MASK 0x1 FORMAT "%13.11" ECU_ADDRESS 0x70001BEF /end MEASUREMENT
/begin MEASUREMENT Ign_bVlvLInNxtIAs "condition cylinder number with ignition angle for standard intake valve-lift" UBYTE B_TRUE 1 100 0.00 1.00000000000 BIT_MASK 0x1 FORMAT "%13.11" ECU_ADDRESS 0x70001BEE /end MEASUREMENT
/begin MEASUREMENT Ign_ctCylAdv_a "2x array with extended ign.cyl.no." UBYTE dez 1 100 0.00 255.0 FORMAT "%5.1" ARRAY_SIZE 2 ECU_ADDRESS 0x500006EC /end MEASUREMENT
/begin MEASUREMENT Ign_ctCyl_a "cyl.numbers for which new ign.angle values are calculated in current early sync. (must be DIRECT-SELECTABLE)" UBYTE dez 1 100 0.00 255.0 FORMAT "%5.1" ARRAY_SIZE 2 ECU_ADDRESS 0x500006EE /end MEASUREMENT
/begin MEASUREMENT Ign_diaBasWoKnkMax_a "Ignition-angle delta (Maximum ignition angle - Base ignition angle), without selective knock-protection offsets" SWORD zw_q0p1 1 100 -3276.800 3276.700 FORMAT "%8.3" ARRAY_SIZE 4 ECU_ADDRESS 0x70001D7E /end MEASUREMENT
/begin MEASUREMENT Ign_diaKP_s16 "offset ignition angle knock protection" SWORD zw_q0p1 1 100 -3276.800 3276.700 FORMAT "%8.3" ECU_ADDRESS 0x50005AD0 /end MEASUREMENT
/begin MEASUREMENT Ign_diaKP_s8 "Offset ignition angle knock protection" SBYTE kw_q0p75 1 100 -96.00 95.25 FORMAT "%5.2" ECU_ADDRESS 0x6000E426 /end MEASUREMENT
/begin MEASUREMENT Ign_diaVlvL_s16 "offset ign.angle switchable valvelift" SWORD zw_q0p1 1 100 -96.00000 95.30000 FORMAT "%8.5" ECU_ADDRESS 0x70001D7C /end MEASUREMENT
/begin MEASUREMENT Ign_flgIAmapsyn "Condition crankshaft-synchronous calculation of maps for ignition angle" UBYTE B_TRUE 1 100 0.00 1.00000000000 BIT_MASK 0x1 FORMAT "%13.11" ECU_ADDRESS 0x70001BED /end MEASUREMENT
/begin MEASUREMENT Ign_iaBasAdv_as16 "extended array for basic ign.angle" SWORD zw_q0p1 1 100 -3276.800 3276.700 FORMAT "%8.3" ARRAY_SIZE 4 ECU_ADDRESS 0x70001D74 /end MEASUREMENT
/begin MEASUREMENT Ign_iaBasNKC_s16 "basic ign.angle without knock control" SWORD zw_q0p1 1 100 -96.00000 95.30000 FORMAT "%8.5" ECU_ADDRESS 0x500006F0 /end MEASUREMENT
/begin MEASUREMENT Ign_iaBasNKC_s8 "basic ign.angle without knock control" SBYTE kw_q0p75 1 100 -96.00 95.25 FORMAT "%5.2" ECU_ADDRESS 0x50000891 /end MEASUREMENT
/begin MEASUREMENT Ign_iaBas_as16 "basic ignition angle (knock-limit) array (16bit)" SWORD zw_q0p1 1 100 -96.00000 95.30000 FORMAT "%8.5" ARRAY_SIZE 2 ECU_ADDRESS 0x50000554 /end MEASUREMENT
/begin MEASUREMENT Ign_iaBas_s16 "basic ignition angle (knock-limit) curr.cyl.(16bit)" SWORD zw_q0p1 1 100 -3276.800 3276.700 FORMAT "%8.3" ECU_ADDRESS 0x500006F2 /end MEASUREMENT
/begin MEASUREMENT Ign_iaBas_s8 "basic ignition angle (knock-limit) current cylinder" SBYTE kw_q0p75 1 100 -96.00 95.25 FORMAT "%5.2" ECU_ADDRESS 0x50000892 /end MEASUREMENT
/begin MEASUREMENT Ign_iacalc_as8 "outcoming ignition angle array" SBYTE kw_q0p75 1 100 -96.00 95.25 FORMAT "%5.2" ARRAY_SIZE 4 ECU_ADDRESS 0x50000558 /end MEASUREMENT
/begin MEASUREMENT Ign_iacalc_s8 "current outcoming ignition angle" SBYTE kw_q0p75 1 100 -96.00 95.25 FORMAT "%5.2" ECU_ADDRESS 0x6000078E /end MEASUREMENT
/begin MEASUREMENT Ign_iacpl_au8 "(array)current complement of outcoming ignition angle" UBYTE dez 1 100 0.00 255.0 FORMAT "%5.1" ARRAY_SIZE 4 ECU_ADDRESS 0x70001C22 /end MEASUREMENT
/begin MEASUREMENT Ign_iacpl_u8 "current complement of outcoming ignition angle" UBYTE dez 1 100 0.00 255.0 FORMAT "%5.1" ECU_ADDRESS 0x70001C21 /end MEASUREMENT
/begin MEASUREMENT Ign_iaLT_bl "currently latest possible ign.angle(burning limit)" SBYTE kw_q0p75 1 100 -96.00 95.25 FORMAT "%5.2" ECU_ADDRESS 0x50000893 /end MEASUREMENT
/begin MEASUREMENT Ign_iaPrHOM_s16 "primary ignition angle HOM(16bit)" SWORD zw_q0p1 1 100 -96.00000 95.30000 FORMAT "%8.5" ECU_ADDRESS 0x70001D72 /end MEASUREMENT
/begin MEASUREMENT Ign_iaPrMap_s16 "current map value of prim.ign.angle(16bit)" SWORD zw_q0p1 1 100 -3276.800 3276.700 FORMAT "%8.3" ECU_ADDRESS 0x70001D70 /end MEASUREMENT
/begin MEASUREMENT Ign_iaPr_s16 "primary ignition angle(16bit)" SWORD zw_q0p1 1 100 -96.00000 95.30000 FORMAT "%8.5" ECU_ADDRESS 0x500006F4 /end MEASUREMENT
/begin MEASUREMENT Ign_iaPr_s8 "primary ignition angle" SBYTE kw_q0p75 1 100 -96.00 95.25 FORMAT "%5.2" ECU_ADDRESS 0x6000078C /end MEASUREMENT
/begin MEASUREMENT Ign_ia_cyl1 "ign.angle cylinder 1" SBYTE kw_q0p75 1 100 -96.00 95.25 FORMAT "%5.2" ECU_ADDRESS 0x70001C44 /end MEASUREMENT
/begin MEASUREMENT Ign_ia_LT "currently latest possible ign.angle" SBYTE kw_q0p75 1 100 -96.00 95.25 FORMAT "%5.2" ECU_ADDRESS 0x70001C45 /end MEASUREMENT
/begin MEASUREMENT Ign_ia_real_s16 "real ign.angle" SWORD zw_q0p1 1 100 -96.00000 95.30000 FORMAT "%8.5" ECU_ADDRESS 0x70001D6E /end MEASUREMENT
/begin MEASUREMENT Ign_ia_real_s8 "Ignition angle in real data type" SBYTE kw_q0p75 1 100 -96.00 95.25 FORMAT "%5.2" ECU_ADDRESS 0x50000895 /end MEASUREMENT
/begin MEASUREMENT Ign_ratChrgAirCyl "Relative charge of air in currently ignited cylinder" UWORD rel_q0p0234 1 100 0.00 1535.977 FORMAT "%8.3" ECU_ADDRESS 0x500006F6 /end MEASUREMENT
/begin MEASUREMENT Ign_ratChrgAirCylLoR "Relative charge of air in next ignited cylinder(8bit)" UBYTE rel_q0p75 1 100 0.00 191.3 FORMAT "%5.1" ECU_ADDRESS 0x70001C20 /end MEASUREMENT
/begin MEASUREMENT Ign_stiaBasKnk "Cylinder-individual bit pattern for detection of ignition angle interventions for knock control" UBYTE dez 1 100 0.00 255.0 FORMAT "%5.1" ECU_ADDRESS 0x60000791 /end MEASUREMENT
/begin MEASUREMENT Ign_stVlvLInIA "Bitarray for switching inlet valve-lift for cyl.-no of the next ignitions" UBYTE dez 1 100 0.00 255.0 FORMAT "%5.1" ECU_ADDRESS 0x60000790 /end MEASUREMENT
/begin MEASUREMENT rlmdzs_w_msg "synchronized relative air charge for torque model" UWORD rel_uw_q0p0234 1 100 0.00 1535.977 FORMAT "%8.3" ECU_ADDRESS 0x70001C52 /end MEASUREMENT
/begin MEASUREMENT szouttem_w "temporare dwell time" UWORD t_q0p001_ms 1 100 0.00 65.53500 FORMAT "%8.5" ECU_ADDRESS 0x60003436 /end MEASUREMENT
/begin MEASUREMENT TMECmb_iaRefAdv_a "Optimized model reference ignition angle" SWORD zw_q2p9297Em3_deg_KW 1 100 -96.00000 95.99707 FORMAT "%8.5" ARRAY_SIZE 4 ECU_ADDRESS 0x70001D3A /end MEASUREMENT
/begin MEASUREMENT tyzwwlnm_w "temperature as input for delta ignition sparc advance during engine warm up phase." UWORD temp_q0p0234_o273 1 100 -273.150 1262.827 FORMAT "%8.3" ECU_ADDRESS 0x6000342C /end MEASUREMENT
/begin MEASUREMENT VehVDDOut_ctReIni "Re-Init value for global drive cycle counter which is incremented when system state SyC_PostDrive is left" UBYTE OneToOne 1 100 0.00 255.0 FORMAT "%5.1" ECU_ADDRESS 0x60006216 /end MEASUREMENT
/begin MEASUREMENT VehV_a "Vehicle Acceleration" SWORD Acc 1 100 -32.76800 32.76700 FORMAT "%8.5" ECU_ADDRESS 0x60004DFC /end MEASUREMENT
/begin MEASUREMENT VehV_aFilt_MP "Measurement of Filtered vehicle acceleration" SWORD Acc 1 100 -32.76800 32.76700 FORMAT "%8.5" ECU_ADDRESS 0x70008AE4 /end MEASUREMENT
/begin MEASUREMENT VehV_aRawUnFlt "Raw vehicle acceleration" SWORD Acc 1 100 -32.76800 32.76700 FORMAT "%8.5" ECU_ADDRESS 0x6000E2E8 /end MEASUREMENT
/begin MEASUREMENT VehV_ctBuf "Buffer to hold the percentage difference in time period" SLONG OneToOne 1 100 -2147483648.00 2147483647.00 FORMAT "%13.2" ARRAY_SIZE 5 ECU_ADDRESS 0x600011A4 /end MEASUREMENT
/begin MEASUREMENT VehV_ctPerdIntrpt "Count value of the PWM pulses" ULONG OneToOne 1 100 0.00 4294967295.00 FORMAT "%13.2" ECU_ADDRESS 0x600011A0 /end MEASUREMENT
/begin MEASUREMENT VehV_ctPeriodOld_mp "Mesuring point to hold the previous PWM pulse count" ULONG OneToOne 1 100 0.00 4294967295.00 FORMAT "%13.2" ECU_ADDRESS 0x70008AFC /end MEASUREMENT
/begin MEASUREMENT VehV_ctPeriod_mp "Mesuring point to hold the present PWM pulse count" ULONG OneToOne 1 100 0.00 4294967295.00 FORMAT "%13.2" ECU_ADDRESS 0x70008AF8 /end MEASUREMENT
/begin MEASUREMENT VehV_DSQSafe_MP "Safe Signal Quality raw vehicle speed signal" UBYTE OneToOne 1 100 0.00 255.0 FORMAT "%5.1" ECU_ADDRESS 0x70008AE2 /end MEASUREMENT
/begin MEASUREMENT VehV_DSQStd_MP "standard Signal Quality raw vehicle speed signal" UBYTE OneToOne 1 100 0.00 255.0 FORMAT "%5.1" ECU_ADDRESS 0x70008AE1 /end MEASUREMENT
/begin MEASUREMENT VehV_facTireAxlCorr "Tire Axle correction factor" ULONG PerKm 1 100 0.00 4294967295.00 FORMAT "%13.2" ECU_ADDRESS 0x6000D75C /end MEASUREMENT
/begin MEASUREMENT VehV_flgExcdLim "minimum speed was reached at least once in the current driving cycle" UBYTE B_TRUE 1 100 0.00 1.00000000000 BIT_MASK 0x1 FORMAT "%13.11" ECU_ADDRESS 0x6000E439 /end MEASUREMENT
/begin MEASUREMENT VehV_flgIntrptEna "Flag to check Interrupt was enabled" UBYTE B_TRUE 1 100 0.00 1.00000000000 BIT_MASK 0x1 FORMAT "%13.11" ECU_ADDRESS 0x6000621C /end MEASUREMENT
/begin MEASUREMENT VehV_flgV2NEna_MP "Measuring point to detect enabling of V2N plausibilisation check" UBYTE B_TRUE 1 100 0.00 1.00000000000 BIT_MASK 0x1 FORMAT "%13.11" ECU_ADDRESS 0x70008AE0 /end MEASUREMENT
/begin MEASUREMENT VehV_flgV2NErr "Flag to detect error condition for V2N plausibilisation" UBYTE B_TRUE 1 100 0.00 1.00000000000 BIT_MASK 0x1 FORMAT "%13.11" ECU_ADDRESS 0x60006215 /end MEASUREMENT
/begin MEASUREMENT VehV_flgV2NGearChkEna "Flag to enable V2N plausibilisation in case of .Manual transmission" UBYTE B_TRUE 1 100 0.00 1.00000000000 BIT_MASK 0x1 FORMAT "%13.11" ECU_ADDRESS 0x700000C8 /end MEASUREMENT
/begin MEASUREMENT VehV_flgV2NHeal "Flag to detect healing condition for V2N plausibilisation" UBYTE B_TRUE 1 100 0.00 1.00000000000 BIT_MASK 0x1 FORMAT "%13.11" ECU_ADDRESS 0x60006214 /end MEASUREMENT
/begin MEASUREMENT VehV_nArySpdCntr "vehicle speed array counter" UBYTE OneToOne 1 100 0.00 255.0 FORMAT "%5.1" ECU_ADDRESS 0x6000A2AE /end MEASUREMENT
/begin MEASUREMENT VehV_nrNewWrIdx "New value for number of Interrupts" UBYTE OneToOne 1 100 0.00 255.0 FORMAT "%5.1" ECU_ADDRESS 0x6000621B /end MEASUREMENT
/begin MEASUREMENT VehV_nrSegAvrg "Number of signals required for averaging the time period of PWM signals" UBYTE OneToOne 1 100 0.00 255.0 FORMAT "%5.1" ECU_ADDRESS 0x6000621A /end MEASUREMENT
/begin MEASUREMENT VehV_nrWrIdx "Number of Interrupts for storing the Period values into Array" UBYTE OneToOne 1 100 0.00 255.0 FORMAT "%5.1" ECU_ADDRESS 0x6000A2AD /end MEASUREMENT
/begin MEASUREMENT VehV_rTraGearDif_MP "Difference between powertrain and computed gear transmission ratio" SWORD Fact1000 1 100 -32.76800 32.76700 FORMAT "%8.5" ECU_ADDRESS 0x70008ADE /end MEASUREMENT
/begin MEASUREMENT VehV_rTraGearFild "Filtered gear transmission ratio" SWORD Fact1000 1 100 -32.76800 32.76700 FORMAT "%8.5" ECU_ADDRESS 0x60003438 /end MEASUREMENT
/begin MEASUREMENT VehV_rTraGearFild_MP "Measuring point for filtered gear transmission ratio" SWORD Fact1000 1 100 -32.76800 32.76700 FORMAT "%8.5" ECU_ADDRESS 0x70008ADC /end MEASUREMENT
/begin MEASUREMENT VehV_rTraGear_MP "Measuring point for gear transmission ratio" SWORD Fact1000 1 100 -32.76800 32.76700 FORMAT "%8.5" ECU_ADDRESS 0x70008ADA /end MEASUREMENT
/begin MEASUREMENT VehV_rV2N_MP "Measuring point for vehicle to engine speed ratio" SWORD Fact1000 1 100 -32.76800 32.76700 FORMAT "%8.5" ECU_ADDRESS 0x70008AD8 /end MEASUREMENT
/begin MEASUREMENT VehV_stSig "PWM Signal status" UBYTE OneToOne 1 100 0.00 255.0 FORMAT "%5.1" ECU_ADDRESS 0x6000A2AC /end MEASUREMENT
/begin MEASUREMENT VehV_stSigIntrpt "PWM Signal status" UBYTE B_TRUE 1 100 0.00 1.00000000000 BIT_MASK 0x1 FORMAT "%13.11" ECU_ADDRESS 0x60006219 /end MEASUREMENT
/begin MEASUREMENT VehV_stSigSrc "Current active Signal Source for vehicle speed sensing" UBYTE OneToOne 1 100 0.00 255.0 FORMAT "%5.1" ECU_ADDRESS 0x6000E43A /end MEASUREMENT
/begin MEASUREMENT VehV_stT15WaitEdg "status of wait for 2 rising edges for the speed sensor" UBYTE B_TRUE 1 100 0.00 1.00000000000 BIT_MASK 0x1 FORMAT "%13.11" ECU_ADDRESS 0x60006218 /end MEASUREMENT
/begin MEASUREMENT VehV_stTopSpdLim "Status Top Speed Limit" UBYTE OneToOne 1 100 0.00 255.0 FORMAT "%5.1" ECU_ADDRESS 0x6000E43B /end MEASUREMENT
/begin MEASUREMENT VehV_stVehVWhlErrDet "status of wheel error detection" UBYTE B_TRUE 1 100 0.00 1.00000000000 BIT_MASK 0x1 FORMAT "%13.11" ECU_ADDRESS 0x60006217 /end MEASUREMENT
/begin MEASUREMENT VehV_tiDiff "variable to hold the percentage difference in the time periods" SLONG Prc_q0p01_COMPU 1 100 -21474836.4800 21474836.4700 FORMAT "%13.4" ARRAY_SIZE 5 ECU_ADDRESS 0x6000118C /end MEASUREMENT
/begin MEASUREMENT VehV_tiPerAvrg "Aerage time period between 2VSS impluse" SLONG Time_PwmHigh 1 100 0.00 107374182.350 FORMAT "%13.3" ECU_ADDRESS 0x50004E08 /end MEASUREMENT
/begin MEASUREMENT VehV_tiPerdAry "Array to store the period of the PWM signal" SLONG Time_PwmHigh 1 100 0.00 107374182.350 FORMAT "%13.3" ARRAY_SIZE 64 ECU_ADDRESS 0x60001088 /end MEASUREMENT
/begin MEASUREMENT VehV_tiPerdIntrpt "Time period of each PWM signal" SLONG Time_PwmHigh 1 100 -107374182.400 107374182.350 FORMAT "%13.3" ECU_ADDRESS 0x60001188 /end MEASUREMENT
/begin MEASUREMENT VehV_tiPeriodOld_mp "Mesuring point to hold the previous time period" ULONG Time_PwmHigh 1 100 0.00 107374182.350 FORMAT "%13.3" ECU_ADDRESS 0x70008AF4 /end MEASUREMENT
/begin MEASUREMENT VehV_tiPeriod_mp "Mesuring point to hold the present time period" ULONG Time_PwmHigh 1 100 0.00 107374182.350 FORMAT "%13.3" ECU_ADDRESS 0x70008AF0 /end MEASUREMENT
/begin MEASUREMENT VehV_tiSclOut_mp "Measuring point for scaled out time of vehicle speed output" SLONG Period_1000 1 100 -2147483.64800 2147483.64700 FORMAT "%13.5" ECU_ADDRESS 0x70008AE8 /end MEASUREMENT
/begin MEASUREMENT VehV_tiSegAvrg "Average time period of PWM signals" SLONG Time_PwmHigh 1 100 0.00 107374182.350 FORMAT "%13.3" ECU_ADDRESS 0x60001C94 /end MEASUREMENT
/begin MEASUREMENT VehV_v "Vehicle speed" SWORD Vel 1 100 -327.6800 327.6700 FORMAT "%8.4" ECU_ADDRESS 0x50005C54 /end MEASUREMENT
/begin MEASUREMENT VehV_vAcclFlt_mp "vehicle speed used in acceleration calculation" SLONG Vel_High 1 100 -2147483.64800 2147483.64700 FORMAT "%13.5" ECU_ADDRESS 0x70008AD4 /end MEASUREMENT
/begin MEASUREMENT VehV_vErrFrzVal "Freezed vehicle speed during error" SWORD Vel 1 100 -327.6800 327.6700 FORMAT "%8.4" ECU_ADDRESS 0x6000E2EA /end MEASUREMENT
/begin MEASUREMENT VehV_vFltOld_mp "Previous value of Filtered raw vehicle speed" SLONG Vel_High 1 100 -2147483.64800 2147483.64700 FORMAT "%13.5" ECU_ADDRESS 0x70008AD0 /end MEASUREMENT
/begin MEASUREMENT VehV_vNCSnsrAryVal "NC sensor vehicle speed array value" SWORD Vel 1 100 -327.6800 327.6700 FORMAT "%8.4" ECU_ADDRESS 0x60004DFA /end MEASUREMENT
/begin MEASUREMENT VehV_vNCSnsrAvg "NC sensor vehicle speed average formula" SWORD Vel 1 100 -327.6800 327.6700 FORMAT "%8.4" ECU_ADDRESS 0x60004DF8 /end MEASUREMENT
/begin MEASUREMENT VehV_vNCSnsrSum "NC sensor vehicle speed sum formula" SLONG Vel 1 100 -21474836.4800 21474836.4700 FORMAT "%13.4" ECU_ADDRESS 0x50004E0C /end MEASUREMENT
/begin MEASUREMENT VehV_vNCSpdSnsrAry "NC sensor vehicle speed array" SWORD Vel 1 100 -327.6800 327.6700 FORMAT "%8.4" ARRAY_SIZE 5 ECU_ADDRESS 0x50005636 /end MEASUREMENT
/begin MEASUREMENT VehV_vSens "Sensed vehicle speed" SWORD Vel 1 100 -327.6800 327.6700 FORMAT "%8.4" ECU_ADDRESS 0x6000E2EC /end MEASUREMENT
/begin MEASUREMENT VehV_vSensHw "sensed vehicle speed from hardware" SWORD Vel 1 100 -327.6800 327.6700 FORMAT "%8.4" ECU_ADDRESS 0x60004DF6 /end MEASUREMENT
/begin MEASUREMENT VehV_vSensOBD "Sensed vehicle speed for OBD" SWORD Vel 1 100 -327.6800 327.6700 FORMAT "%8.4" ECU_ADDRESS 0x6000E2EE /end MEASUREMENT
/begin MEASUREMENT VehV_vSensPre_mp "Vehicle speed signal prior to checking the signal if it is jitter." SWORD Vel 1 100 -327.6800 327.6700 FORMAT "%8.4" ECU_ADDRESS 0x70008AEC /end MEASUREMENT
/begin MEASUREMENT VehV_vSnsrAbslt_MP "Absolute value of sensed vehicle speed." SWORD Vel 1 100 -327.6800 327.6700 FORMAT "%8.4" ECU_ADDRESS 0x70008ACC /end MEASUREMENT
/begin MEASUREMENT VehV_vSnsrSafe_MP "Safe Signal Sensed vehicle speed" SWORD Vel 1 100 -327.6800 327.6700 FORMAT "%8.4" ECU_ADDRESS 0x70008ACA /end MEASUREMENT
/begin MEASUREMENT VehV_vSnsrSpdDiffAbslt "Differential absolute value of vehicle speed sensor" SWORD Vel 1 100 -327.6800 327.6700 FORMAT "%8.4" ECU_ADDRESS 0x60004DF4 /end MEASUREMENT
/begin MEASUREMENT VehV_vSnsrSpdDiffThd "Threshold of vehicle speed average formula" SWORD Vel 1 100 -327.6800 327.6700 FORMAT "%8.4" ECU_ADDRESS 0x60004DF2 /end MEASUREMENT
/begin MEASUREMENT VehV_vSnsrStd_MP "standard signal Sensed vehicle speed" SWORD Vel 1 100 -327.6800 327.6700 FORMAT "%8.4" ECU_ADDRESS 0x70008AC8 /end MEASUREMENT
/begin MEASUREMENT VehV_vSpdSnsrAAry "wheel A vehicle speed sensorA array" SWORD Vel 1 100 -327.6800 327.6700 FORMAT "%8.4" ARRAY_SIZE 5 ECU_ADDRESS 0x50005640 /end MEASUREMENT
/begin MEASUREMENT VehV_vSpdSnsrAAryVal "wheel A vehicle speed sensor array value" SWORD Vel 1 100 -327.6800 327.6700 FORMAT "%8.4" ECU_ADDRESS 0x60004DF0 /end MEASUREMENT
/begin MEASUREMENT VehV_vSpdSnsrAAvg "vehicle speed sensor average value for wheel A" SWORD Vel 1 100 -327.6800 327.6700 FORMAT "%8.4" ECU_ADDRESS 0x60004DEE /end MEASUREMENT
/begin MEASUREMENT VehV_vSpdSnsrASum "Wheel A vehicle speed sensor sum" SLONG Vel 1 100 -21474836.4800 21474836.4700 FORMAT "%13.4" ECU_ADDRESS 0x60001C90 /end MEASUREMENT
/begin MEASUREMENT VehV_vSpdSnsrBAry "Wheel B vehicle speed sensor array" SWORD Vel 1 100 -327.6800 327.6700 FORMAT "%8.4" ARRAY_SIZE 5 ECU_ADDRESS 0x5000564A /end MEASUREMENT
/begin MEASUREMENT VehV_vSpdSnsrBAryVal "Wheel B vehicle speed sensor array value" SWORD Vel 1 100 -327.6800 327.6700 FORMAT "%8.4" ECU_ADDRESS 0x60004DEC /end MEASUREMENT
/begin MEASUREMENT VehV_vSpdSnsrBAvg "Wheel B vehicle speed sensor average formula" SWORD Vel 1 100 -327.6800 327.6700 FORMAT "%8.4" ECU_ADDRESS 0x60004DEA /end MEASUREMENT
/begin MEASUREMENT VehV_vSpdSnsrBSum "Wheel B vehicle speed sensor sum formula" SLONG Vel 1 100 -21474836.4800 21474836.4700 FORMAT "%13.4" ECU_ADDRESS 0x60001C8C /end MEASUREMENT
/begin MEASUREMENT VehV_vUnFlt "Unfiltered value of vehicle velocity" SWORD Vel 1 100 -327.6800 327.6700 FORMAT "%8.4" ECU_ADDRESS 0x60004DE8 /end MEASUREMENT
/begin MEASUREMENT VMD_facDasModSwt "Factor for ramping of accped ratio value during change in drive mode for driver assistance demand" SLONG Fact 1 100 -262144.000000 262143.999878 FORMAT "%13.6" ECU_ADDRESS 0x60001CBC /end MEASUREMENT
/begin MEASUREMENT VMD_facDasModSwtStep "Factor for step change in slope used for ramping of accped ratio during change in drive mode for driver assistance demand" SLONG Fact 1 100 -262144.000000 262143.999878 FORMAT "%13.6" ECU_ADDRESS 0x60001CB8 /end MEASUREMENT
/begin MEASUREMENT VMD_facModSwt "Factor for ramping of accped ratio value during change in drive mode" SLONG Fact 1 100 -262144.000000 262143.999878 FORMAT "%13.6" ECU_ADDRESS 0x60001CB4 /end MEASUREMENT
/begin MEASUREMENT VMD_facModSwtLrn "Factor for ramping of accped ratio value during change in drive mode for learn functionality" SLONG Fact 1 100 -262144.000000 262143.999878 FORMAT "%13.6" ECU_ADDRESS 0x60001CB0 /end MEASUREMENT
/begin MEASUREMENT VMD_facModSwtStep "Factor for step change in slope used for ramping of accped ratio during change in drive mode" SLONG Fact 1 100 -262144.000000 262143.999878 FORMAT "%13.6" ECU_ADDRESS 0x60001CAC /end MEASUREMENT
/begin MEASUREMENT VMD_facModSwtStepLrn "Factor for step change in slope used for ramping of accped ratio during change in drive mode for learn functionality" SLONG Fact 1 100 -262144.000000 262143.999878 FORMAT "%13.6" ECU_ADDRESS 0x60001CA8 /end MEASUREMENT
/begin MEASUREMENT VMD_rASLCC "Virtual accelerator pedal position based on driver ,CC and ASL demanded ratio" SWORD Prc 1 100 -400.0000 399.9878 FORMAT "%8.4" ECU_ADDRESS 0x60004E56 /end MEASUREMENT
/begin MEASUREMENT VMD_rASLCCLrn "Virtual accelerator pedal position based on driver ,CC and ASL demanded ratio for learn functionality" SWORD Prc 1 100 -400.0000 399.9878 FORMAT "%8.4" ECU_ADDRESS 0x60004E54 /end MEASUREMENT
/begin MEASUREMENT VMD_rDasDrvMod "Virtual accelerator pedal position after drive mode driver assistance demand" SWORD Prc 1 100 -400.0000 399.9878 FORMAT "%8.4" ECU_ADDRESS 0x60004E52 /end MEASUREMENT
/begin MEASUREMENT VMD_rDasDrvModCorrd "Virtual accelerator pedal position after drive mode correction for driver assistance demand" SWORD Prc 1 100 -400.0000 399.9878 FORMAT "%8.4" ECU_ADDRESS 0x60004E50 /end MEASUREMENT
/begin MEASUREMENT VMD_rDasDrvModCorrdEco "Virtual accelerator pedal position after Eco drive mode correction for driver assistance demand" SWORD Prc 1 100 -400.0000 399.9878 FORMAT "%8.4" ECU_ADDRESS 0x60004E4E /end MEASUREMENT
/begin MEASUREMENT VMD_rDasDrvModCorrdNew "Virtual accelerator pedal position based on current drive mode for driver assistance demand" SWORD Prc 1 100 -400.0000 399.9878 FORMAT "%8.4" ECU_ADDRESS 0x60004E4C /end MEASUREMENT
/begin MEASUREMENT VMD_rDasDrvModCorrdNewTmp "Temporary value of Virtual accelerator pedal position based on current drive mode for driver assistance demand" SWORD Prc 1 100 -400.0000 399.9878 FORMAT "%8.4" ECU_ADDRESS 0x60004E4A /end MEASUREMENT
/begin MEASUREMENT VMD_rDasDrvModCorrdNorm "Virtual accelerator pedal position after Eco drive mode correction for driver assistance demand" SWORD Prc 1 100 -400.0000 399.9878 FORMAT "%8.4" ECU_ADDRESS 0x60004E48 /end MEASUREMENT
/begin MEASUREMENT VMD_rDasDrvModCorrdOld "Virtual accelerator pedal position based on previous drive mode for driver assistance demand" SWORD Prc 1 100 -400.0000 399.9878 FORMAT "%8.4" ECU_ADDRESS 0x60004E46 /end MEASUREMENT
/begin MEASUREMENT VMD_rDasDrvModCorrdOldTmp "Temporary value of Virtual accelerator pedal position based on previous drive mode for driver assistance demand" SWORD Prc 1 100 -400.0000 399.9878 FORMAT "%8.4" ECU_ADDRESS 0x60004E44 /end MEASUREMENT
/begin MEASUREMENT VMD_rDasVirtAPP "inverse calculated accelerator pedal value for driver assistance demand" SWORD Prc 1 100 -400.0000 399.9878 FORMAT "%8.4" ECU_ADDRESS 0x60004E42 /end MEASUREMENT
/begin MEASUREMENT VMD_rDrvModCorrd "Virtual accelerator pedal position after drive mode correction" SWORD Prc 1 100 -400.0000 399.9878 FORMAT "%8.4" ECU_ADDRESS 0x60004E40 /end MEASUREMENT
/begin MEASUREMENT VMD_rDrvModCorrdEco "Virtual accelerator pedal position after Eco drive mode correction" SWORD Prc 1 100 -400.0000 399.9878 FORMAT "%8.4" ECU_ADDRESS 0x60004E3E /end MEASUREMENT
/begin MEASUREMENT VMD_rDrvModCorrdEcoLrn "Virtual accelerator pedal position after Eco drive mode correction for learn functionality" SWORD Prc 1 100 -400.0000 399.9878 FORMAT "%8.4" ECU_ADDRESS 0x60004E3C /end MEASUREMENT
/begin MEASUREMENT VMD_rDrvModCorrdLrn "Virtual accelerator pedal position after drive mode correction for learn functionality" SWORD Prc 1 100 -400.0000 399.9878 FORMAT "%8.4" ECU_ADDRESS 0x60004E3A /end MEASUREMENT
/begin MEASUREMENT VMD_rDrvModCorrdNew "Virtual accelerator pedal position based on current drive mode" SWORD Prc 1 100 -400.0000 399.9878 FORMAT "%8.4" ECU_ADDRESS 0x60004E38 /end MEASUREMENT
/begin MEASUREMENT VMD_rDrvModCorrdNewLrn "Virtual accelerator pedal position based on current drive mode for learn functionality" SWORD Prc 1 100 -400.0000 399.9878 FORMAT "%8.4" ECU_ADDRESS 0x60004E36 /end MEASUREMENT
/begin MEASUREMENT VMD_rDrvModCorrdNewTmp "Temporary value of Virtual accelerator pedal position based on current drive mode" SWORD Prc 1 100 -400.0000 399.9878 FORMAT "%8.4" ECU_ADDRESS 0x60004E34 /end MEASUREMENT
/begin MEASUREMENT VMD_rDrvModCorrdNewTmpLrn "Temporary value of Virtual accelerator pedal position based on current drive mode for learn functionality" SWORD Prc 1 100 -400.0000 399.9878 FORMAT "%8.4" ECU_ADDRESS 0x60004E32 /end MEASUREMENT
/begin MEASUREMENT VMD_rDrvModCorrdNorm "Virtual accelerator pedal position after Eco drive mode correction" SWORD Prc 1 100 -400.0000 399.9878 FORMAT "%8.4" ECU_ADDRESS 0x60004E30 /end MEASUREMENT
/begin MEASUREMENT VMD_rDrvModCorrdNormLrn "Virtual accelerator pedal position after Eco drive mode correction for learn functionality" SWORD Prc 1 100 -400.0000 399.9878 FORMAT "%8.4" ECU_ADDRESS 0x60004E2E /end MEASUREMENT
/begin MEASUREMENT VMD_rDrvModCorrdOld "Virtual accelerator pedal position based on previous drive mode" SWORD Prc 1 100 -400.0000 399.9878 FORMAT "%8.4" ECU_ADDRESS 0x60004E2C /end MEASUREMENT
/begin MEASUREMENT VMD_rDrvModCorrdOldLrn "Virtual accelerator pedal position based on previous drive mode for learn functionality" SWORD Prc 1 100 -400.0000 399.9878 FORMAT "%8.4" ECU_ADDRESS 0x60004E2A /end MEASUREMENT
/begin MEASUREMENT VMD_rDrvModCorrdOldTmp "Temporary value of Virtual accelerator pedal position based on previous drive mode" SWORD Prc 1 100 -400.0000 399.9878 FORMAT "%8.4" ECU_ADDRESS 0x60004E28 /end MEASUREMENT
/begin MEASUREMENT VMD_rDrvModCorrdOldTmpLrn "Temporary value of Virtual accelerator pedal position based on previous drive mode for learn functionality" SWORD Prc 1 100 -400.0000 399.9878 FORMAT "%8.4" ECU_ADDRESS 0x60004E26 /end MEASUREMENT
/begin MEASUREMENT VMD_rVirtAPP "inverse calculated accelerator pedal value" SWORD Prc 1 100 -400.0000 399.9878 FORMAT "%8.4" ECU_ADDRESS 0x60004E24 /end MEASUREMENT
/begin MEASUREMENT VMD_rVirtAPPLrn "Inverse calculated accelerator pedal value for learn functionality" SWORD Prc 1 100 -400.0000 399.9878 FORMAT "%8.4" ECU_ADDRESS 0x60004E22 /end MEASUREMENT
/begin MEASUREMENT VMD_stDasRampActv "Status of accped ratio ramp during mode change for driver assistance demand" UBYTE OneToOne 1 100 0.00 1.000 FORMAT "%5.3" ECU_ADDRESS 0x6000A2B6 /end MEASUREMENT
/begin MEASUREMENT VMD_stRampActv "Status of accped ratio ramp during mode change" UBYTE OneToOne 1 100 0.00 1.000 FORMAT "%5.3" ECU_ADDRESS 0x6000A2B5 /end MEASUREMENT
/begin MEASUREMENT VMD_stRampActvLrn "Status of accped ratio ramp during mode change for learn functionality" UBYTE OneToOne 1 100 0.00 1.000 FORMAT "%5.3" ECU_ADDRESS 0x6000A2B4 /end MEASUREMENT
/begin MEASUREMENT VMSI_flgDCSPlusChk "Signal check Plus torque not requested during DCS operations in Disable mode" UBYTE B_TRUE 1 100 0.00 1.00000000000 BIT_MASK 0x1 FORMAT "%13.11" ECU_ADDRESS 0x60006213 /end MEASUREMENT
/begin MEASUREMENT VMSI_flgRampShtOffCdnDCS "Flag to indicate the ramp shutoff condition for DCS intervention" UBYTE B_TRUE 1 100 0.00 1.00000000000 BIT_MASK 0x1 FORMAT "%13.11" ECU_ADDRESS 0x60006212 /end MEASUREMENT
/begin MEASUREMENT VMSI_flgRampShtOffCdnTCS "Flag to indicate the ramp shutoff condition for TCS intervention" UBYTE B_TRUE 1 100 0.00 1.00000000000 BIT_MASK 0x1 FORMAT "%13.11" ECU_ADDRESS 0x60006211 /end MEASUREMENT
/begin MEASUREMENT VMSI_flgShtOffCdnDCS "flag to indicate the shutoff condition for DCS intervention" UBYTE B_TRUE 1 100 0.00 1.00000000000 BIT_MASK 0x1 FORMAT "%13.11" ECU_ADDRESS 0x60006210 /end MEASUREMENT
/begin MEASUREMENT VMSI_flgShtOffCdnTCS "Flag to indicate the shutoff condition for TCS intervention" UBYTE B_TRUE 1 100 0.00 1.00000000000 BIT_MASK 0x1 FORMAT "%13.11" ECU_ADDRESS 0x6000620F /end MEASUREMENT
/begin MEASUREMENT VMSI_stDCSPlusCtrl "DCS torque plus control state" UBYTE OneToOne 1 100 0.00 255.0 FORMAT "%5.1" ECU_ADDRESS 0x6000620E /end MEASUREMENT
/begin MEASUREMENT VMSI_stDCSPlusOK "DCS torque plus control OK flag" UBYTE OneToOne 1 100 0.00 255.0 FORMAT "%5.1" ECU_ADDRESS 0x6000A2B3 /end MEASUREMENT
/begin MEASUREMENT VMSI_stDCSPtd "Application parameter for Raising stability intervention from level 1 is not allowed" UBYTE OneToOne 1 100 0.00 255.0 FORMAT "%5.1" ECU_ADDRESS 0x6000A2B2 /end MEASUREMENT
/begin MEASUREMENT VMSI_tqCluDesMax "Decreasing torque intervention from stability program (ESP) at clutch level" SWORD Trq 1 100 -3276.800 3276.700 FORMAT "%8.3" ECU_ADDRESS 0x60004E1E /end MEASUREMENT
/begin MEASUREMENT VMSI_tqCluLeadMax "Decreasing lead torque intervention from stability program (ESP) at clutch level" SWORD Trq 1 100 -3276.800 3276.700 FORMAT "%8.3" ECU_ADDRESS 0x60004E1C /end MEASUREMENT
/begin MEASUREMENT VMSI_tqCluMin "Increasing torque intervention from stability program (ESP) at clutch level" SWORD Trq 1 100 -3276.800 3276.700 FORMAT "%8.3" ECU_ADDRESS 0x60004E1A /end MEASUREMENT
/begin MEASUREMENT VMSI_tqDCSRampOut_MP "Measuring point for the ramp output of the shutdown ramp of increasing stability intervention" SLONG TrqPrpHigh 1 100 -214748364.800 214748364.700 FORMAT "%13.3" ECU_ADDRESS 0x70008AC4 /end MEASUREMENT
/begin MEASUREMENT VMSI_tqTCSRampOut_MP "Measuring point for the ramp output of the cut-off ramp of the decreasing stability intervention" SLONG TrqPrpHigh 1 100 -214748364.800 214748364.700 FORMAT "%13.3" ECU_ADDRESS 0x70008AC0 /end MEASUREMENT
/begin MEASUREMENT VMSI_trqDesMax "Decreasing torque intervention by stability program" SLONG TrqPrpHigh 1 100 -50000.0000000 50000.0000000 FORMAT "%13.7" ECU_ADDRESS 0x50004DFC /end MEASUREMENT
/begin MEASUREMENT VMSI_trqLeadMax "Decreasing lead torque intervention by stability program" SLONG TrqPrpHigh 1 100 -50000.0000000 50000.0000000 FORMAT "%13.7" ECU_ADDRESS 0x60001CA0 /end MEASUREMENT
/begin MEASUREMENT VMSI_trqMin "Increasing torque intervention by stability program" SLONG TrqPrpHigh 1 100 -50000.0000000 50000.0000000 FORMAT "%13.7" ECU_ADDRESS 0x50004E00 /end MEASUREMENT
/begin MEASUREMENT VMSI_trqMinLowrLim "Increasing torque intervention by stability program lower limit" SLONG TrqPrpHigh 1 100 -50000.0000000 50000.0000000 FORMAT "%13.7" ECU_ADDRESS 0x60001084 /end MEASUREMENT
/begin MEASUREMENT wdksom_w_msg "desired throttle angle without torque structure" UWORD relDK_uw_b100 1 100 0.00 100.0000 FORMAT "%8.4" ECU_ADDRESS 0x60000DE8 /end MEASUREMENT
/begin MEASUREMENT Wiper_flgActv "Wind screen wiper active" UBYTE B_TRUE 1 100 0.00 1.00000000000 BIT_MASK 0x1 FORMAT "%13.11" ECU_ADDRESS 0x6000A10B /end MEASUREMENT
/begin MEASUREMENT zwgruhom_w "basic ignition angle for homogeneous operation" SWORD zw_q0p1 1 100 -3276.800 3276.700 FORMAT "%8.3" ECU_ADDRESS 0x700016E4 /end MEASUREMENT
/begin MEASUREMENT zwkfzw_w "primary ignition angle from map Ign_iaPr...GM" SWORD zw_q0p1 1 100 -3276.800 3276.700 FORMAT "%8.3" ECU_ADDRESS 0x700016E2 /end MEASUREMENT
/begin MEASUREMENT zwmn "retarded ignition timing" SBYTE kw_q0p75 1 100 -96.00 95.25 FORMAT "%5.2" ECU_ADDRESS 0x5000087D /end MEASUREMENT
/begin MEASUREMENT zwmnhom "maximum retarded spark limitation for operating mode HOM" SBYTE kw_q0p75 1 100 -96.00 95.25 FORMAT "%5.2" ECU_ADDRESS 0x70001C3F /end MEASUREMENT
/begin MEASUREMENT zwmnhomst "maximum retarded spark limitation for operating mode HOM during engine start" SBYTE kw_q0p75 1 100 -96.00 95.25 FORMAT "%5.2" ECU_ADDRESS 0x6000A6C4 /end MEASUREMENT
/begin MEASUREMENT zwmnst "latest possible ign.angle during start" SBYTE kw_q0p75 1 100 -96.00 95.25 FORMAT "%5.2" ECU_ADDRESS 0x6000620A /end MEASUREMENT
/begin MEASUREMENT zwoptl1_w_msg "Optimized model reference ignition angle at lambda = 1 (high resolution)" SWORD zw_q2p9297Em3_deg_KW 1 100 -96.00000 95.99707 FORMAT "%8.5" ECU_ADDRESS 0x5000083C /end MEASUREMENT
/begin MEASUREMENT zwopt_w_msg "Optimized model reference ignition angle" SWORD zw_q2p9297Em3_deg_KW 1 100 -96.00000 95.99707 FORMAT "%8.5" ECU_ADDRESS 0x5000083A /end MEASUREMENT
/begin MEASUREMENT zwoutzyl_w_msg "Ignition angle output array" SWORD zw_q0p1 1 100 -96.00000 95.30000 FORMAT "%8.5" ARRAY_SIZE 4 ECU_ADDRESS 0x50000600 /end MEASUREMENT
/begin MEASUREMENT zwspaebts_msg "latest allowed ignition timing in case of component protection" SBYTE zw_sb_q0p75 1 100 -96.00 95.25 FORMAT "%5.2" ECU_ADDRESS 0x70001C3E /end MEASUREMENT
/begin MEASUREMENT ZWSTT_COM.agIgnCoMStrt "Class instance for ignition angle at change of mind / Ignition angle at change of mind" SBYTE zw_sb_q0p75 1 100 -96.00 95.25 FORMAT "%5.2" ECU_ADDRESS 0x60000732 /end MEASUREMENT
/begin MEASUREMENT ZWSTT_COMWAITSTRTR.agIgnCoMStrt " / Ignition angle at change of mind" SBYTE zw_sb_q0p75 1 100 -96.00 95.25 FORMAT "%5.2" ECU_ADDRESS 0x60000731 /end MEASUREMENT
/begin MEASUREMENT ZWSTT_CORR.agIgnStrtCorrOffs "correction factor / Offset correction" SBYTE zw_sb_q0p75 1 100 -96.00 95.25 FORMAT "%5.2" ECU_ADDRESS 0x60000734 /end MEASUREMENT
/begin MEASUREMENT ZWSTT_CORR_2.agIgnStrtCorrOffs " / Offset correction" SBYTE zw_sb_q0p75 1 100 -96.00 95.25 FORMAT "%5.2" ECU_ADDRESS 0x60000733 /end MEASUREMENT
/begin MEASUREMENT ZWSTT_FOLW.agIgnStrtOffs "Class instance for ignition angle offset at following start / Ignition angle offset at start (driver request)" SBYTE zw_sb_q0p75 1 100 -96.00 95.25 FORMAT "%5.2" ECU_ADDRESS 0x60000735 /end MEASUREMENT
/begin MEASUREMENT ZWSTT_LOP.agIgnStrtBas "Class instance for ignition angle at low pressure start / Ignition angle at start (base value)" SBYTE zw_sb_q0p75 1 100 -96.00 95.25 FORMAT "%5.2" ECU_ADDRESS 0x60000736 /end MEASUREMENT
/begin MEASUREMENT zwstt_msg "Ignition angle during sta" SBYTE zw_sb_q0p75 1 100 -96.00 95.25 FORMAT "%5.2" ECU_ADDRESS 0x600007C6 /end MEASUREMENT
/begin MEASUREMENT zzylzuear "cylinder numbers relevant to ignition angle calculation in actual bisynchro task" UBYTE dez 1 100 0.00 255.0 FORMAT "%5.1" ARRAY_SIZE 2 ECU_ADDRESS 0x500006CA /end MEASUREMENT
/begin FUNCTION VehV_DD "169.1.0   Vehicle Speed - Device Driver"
 /begin DEF_CHARACTERISTIC VehV_ctDvtMax_C VehV_ctDvtMin_C VehV_ctTolrPerd_C VehV_dstPerImp_C VehV_facTireAxlCorrMax_C VehV_facTireAxlCorrMin_C VehV_flgSwtIntrptIniEna_C VehV_nrSegAvrg16_C VehV_nrSegAvrg32_C VehV_nrSegAvrg4_C VehV_nrSegAvrg64_C VehV_nrSegAvrg8_C VehV_nrSegAvrg_C VehV_numSegSens_C VehV_rAxl_C VehV_rThresWhlErr_C VehV_swtDrctDstPerImp_C VehV_tiIntrptDisad_C VehV_tiOffDlyAvdInitPls_C VehV_tiPerMax_C VehV_tiSegAvrg16Le_C VehV_tiSegAvrg16Ri_C VehV_tiSegAvrg32Le_C VehV_tiSegAvrg32Ri_C VehV_tiSegAvrg4Le_C VehV_tiSegAvrg4Ri_C VehV_tiSegAvrg8Le_C VehV_tiSegAvrg8Ri_C VehV_tiT15ON_C VehV_tiUnJit_C VehV_vSensDiffLim_C VehV_vWhlErrMax_C VehV_vWhlErrMin_C /end DEF_CHARACTERISTIC
 /begin IN_MEASUREMENT GlbDa_lWhlCirc T15_st /end IN_MEASUREMENT
 /begin OUT_MEASUREMENT VehV_facTireAxlCorr VehV_nrWrIdx VehV_stSig VehV_tiPerAvrg VehV_tiPerdAry VehV_tiSegAvrg VehV_vSensHw /end OUT_MEASUREMENT
 /begin LOC_MEASUREMENT VehV_ctBuf VehV_ctPerdIntrpt VehV_ctPeriodOld_mp VehV_ctPeriod_mp VehV_flgIntrptEna VehV_nrNewWrIdx VehV_nrSegAvrg VehV_stSigIntrpt VehV_stT15WaitEdg VehV_stVehVWhlErrDet VehV_tiDiff VehV_tiPerdIntrpt VehV_tiPeriodOld_mp VehV_tiPeriod_mp VehV_vSensPre_mp /end LOC_MEASUREMENT
 FUNCTION_VERSION "169.1.0" /end FUNCTION
/begin FUNCTION VehV_DDOut "9.0.0     PWM output"
 /begin DEF_CHARACTERISTIC VehV_numSclOut_C VehV_PwmOut.rMin_C VehV_PwmOut.rMax_C VehV_PwmOut.tiBtwTstSCB_C VehV_PwmOut.tiBtwTstOT_C VehV_PwmOut.numTstMax_C VehV_PwmOut.swtBattCor_C VehV_rMaxDty_C VehV_rSclOut_C VehV_stLvl_C VehV_stPsDiaDisbl_C VehV_stPsDisbl_C VehV_stPsInv_C VehV_swtSigPWMOut_C VehV_tiOutMax_C VehV_tiOutMin_C VehV_tiPh_C /end DEF_CHARACTERISTIC
 /begin IN_MEASUREMENT Com_vVeh DevLib_stPwrStgEnaCond SyC_ctPostDrvLeave VehV_tiPerAvrg /end IN_MEASUREMENT
 /begin LOC_MEASUREMENT VehVDDOut_ctReIni VehV_tiSclOut_mp /end LOC_MEASUREMENT
 FUNCTION_VERSION "9.0.0" /end FUNCTION
/begin FUNCTION VehV_VD "169.0.0   Vehicle Speed - Virtual Device"
 /begin DEF_CHARACTERISTIC VehV_flgExcdLim_C VehV_flgPtCdnSel_C VehV_flgPwrPlausHealEna_C VehV_nThresPlaFcoMax_C VehV_nThresPlaFcoMin_C VehV_nThresPlaMinV2N_C VehV_nThresPlaPwrMaxDfct_C VehV_nThresPlaPwrMaxOk_C VehV_nThresPlaPwrMinDfct_C VehV_nThresPlaPwrMinOk_C VehV_rDifPlaus_C VehV_rSpdDiffCorrnFac_C VehV_rV2NDifThd_CUR VehV_swtDftT15Off_C VehV_swtPlausSel_C VehV_swtPwrExcdLim_C VehV_swtSigSafe_C VehV_swtSigStd_C VehV_tiAPT1_C VehV_tiDebImpsCan_C VehV_tiDebImpsFco_C VehV_tiDebImpsPwr_C VehV_tiDebImpsV2NTrsm_C VehV_tiPwrPlausDfctEna_C VehV_tiPwrPlausHealEna_C VehV_tiThdExcdLim_C VehV_tiVAccPT1_C VehV_tiVPT1_C VehV_trqThresPlaDef_C VehV_trqThresPlaOk_C VehV_tThresPlaFco_C VehV_tThresPlaPwr_C VehV_vDflOBD_C VehV_vDfl_C VehV_vDftT15Off_C VehV_vLowThres_C VehV_vMaxFix_C VehV_vMin_C VehV_vPhysRngMax_C VehV_vPhysRngMin_C VehV_vSnsrFailrThd_C VehV_vSnsrSpdDiffThd_C VehV_vThdExcdLim_C VehV_vThresPlaFco_C VehV_vThresPlaPwrDef_C VehV_vThresPlaPwrOk_C VehV_vThresPlaV2N_C /end DEF_CHARACTERISTIC
 /begin IN_MEASUREMENT ActMod_trqInr Clth_st Com_stMon Com_stVehSpdSensErr Com_vVeh Com_vVeh2 Conv_rTrq EngDa_tEng Epm_nEng Gbx_bLimp Gbx_stPNPos GlbDa_lWhlCirc PthSet_bOvrRun PT_bGrip PT_rTraGear PT_stTraType StbIntv_vWhlSpd T15_st VehMot_rTrqDfftl VehV_vSensHw /end IN_MEASUREMENT
 /begin OUT_MEASUREMENT VehV_a VehV_aRawUnFlt VehV_flgExcdLim VehV_stSigSrc VehV_stTopSpdLim VehV_v VehV_vErrFrzVal VehV_vSens VehV_vSensOBD VehV_vUnFlt /end OUT_MEASUREMENT
 /begin LOC_MEASUREMENT VehV_aFilt_MP VehV_DSQSafe_MP VehV_DSQStd_MP VehV_flgV2NEna_MP VehV_flgV2NErr VehV_flgV2NGearChkEna VehV_flgV2NHeal VehV_nArySpdCntr VehV_rTraGearDif_MP VehV_rTraGearFild VehV_rTraGearFild_MP VehV_rTraGear_MP VehV_rV2N_MP VehV_vAcclFlt_mp VehV_vFltOld_mp VehV_vNCSnsrAryVal VehV_vNCSnsrAvg VehV_vNCSnsrSum VehV_vNCSpdSnsrAry VehV_vSnsrAbslt_MP VehV_vSnsrSafe_MP VehV_vSnsrSpdDiffAbslt VehV_vSnsrSpdDiffThd VehV_vSnsrStd_MP VehV_vSpdSnsrAAry VehV_vSpdSnsrAAryVal VehV_vSpdSnsrAAvg VehV_vSpdSnsrASum VehV_vSpdSnsrBAry VehV_vSpdSnsrBAryVal VehV_vSpdSnsrBAvg VehV_vSpdSnsrBSum /end LOC_MEASUREMENT
 FUNCTION_VERSION "169.0.0" /end FUNCTION
/begin FUNCTION VlvLft_GlbDefn "1.1.0     Global definitions for VlvLft" FUNCTION_VERSION "1.1.0" /end FUNCTION
/begin FUNCTION VMD_Axispoints "26.1.0    Vehicle Motion Demand data set points" FUNCTION_VERSION "26.1.0" /end FUNCTION
/begin FUNCTION VMD_VirtAPP "50.0.0    virtual accelerator pedal position"
 /begin DEF_CHARACTERISTIC VMD_rDrvModCorrnCmft_T VMD_rDrvModCorrnEco_T VMD_rDrvModCorrnNorm_T VMD_rDrvModCorrnSnow_T VMD_rDrvModCorrnSpt_T VMD_rMinWoRamp_C VMD_stAslAccSel_C VMD_tiRampSlopModChg_CA /end DEF_CHARACTERISTIC
 /begin REF_CHARACTERISTIC AccPed_swtDrvModSeln_C /end REF_CHARACTERISTIC
 /begin IN_MEASUREMENT AccPed_flgDrvModChg AccPed_nrGearFildTmp AccPed_stDrvModPrev AccPed_swtDrvMod APP_r APP_rMaxLrnUnFlt CoVMD_r CrCtl_stActive LLim_stActive T15_st /end IN_MEASUREMENT
 /begin OUT_MEASUREMENT VMD_facDasModSwt VMD_facDasModSwtStep VMD_facModSwt VMD_facModSwtLrn VMD_facModSwtStep VMD_facModSwtStepLrn VMD_rASLCC VMD_rASLCCLrn VMD_rDasDrvMod VMD_rDasDrvModCorrd VMD_rDasDrvModCorrdEco VMD_rDasDrvModCorrdNew VMD_rDasDrvModCorrdNewTmp VMD_rDasDrvModCorrdNorm VMD_rDasDrvModCorrdOld VMD_rDasDrvModCorrdOldTmp VMD_rDasVirtAPP VMD_rDrvModCorrd VMD_rDrvModCorrdEco VMD_rDrvModCorrdEcoLrn VMD_rDrvModCorrdLrn VMD_rDrvModCorrdNew VMD_rDrvModCorrdNewLrn VMD_rDrvModCorrdNewTmp VMD_rDrvModCorrdNewTmpLrn VMD_rDrvModCorrdNorm VMD_rDrvModCorrdNormLrn VMD_rDrvModCorrdOld VMD_rDrvModCorrdOldLrn VMD_rDrvModCorrdOldTmp VMD_rDrvModCorrdOldTmpLrn VMD_rVirtAPP VMD_rVirtAPPLrn VMD_stDasRampActv VMD_stRampActv VMD_stRampActvLrn /end OUT_MEASUREMENT
 FUNCTION_VERSION "50.0.0" /end FUNCTION
/begin FUNCTION VMSI_PlausTrqIntv "40.1.0    Vehicle motion stability intervention"
 /begin DEF_CHARACTERISTIC VMSI_dtqRmpDCSP.Neg_C VMSI_dtqRmpDCSP.Pos_C VMSI_dtqRmpTCSP.Neg_C VMSI_dtqRmpTCSP.Pos_C VMSI_stCfg_C VMSI_swtSlipCtl_C VMSI_tiPlusOff_C VMSI_tiPlus_C VMSI_trqLimDCSNorm_C VMSI_trqLimDCSPlus_C VMSI_trqMin_C /end DEF_CHARACTERISTIC
 /begin IN_MEASUREMENT MoFExtInt_stDCSPtdMsg PtCoornDyn_flgStabyIntvDecActvDes PtCoornDyn_flgStabyIntvIncActvDes PT_rTrq PT_trqLos StbIntv_bDCSIntv StbIntv_bDCSNeutr StbIntv_bTCSIntv StbIntv_bTCSNeutr StbIntv_flgDCSPlusTrqReqd StbIntv_trqDCSDes StbIntv_trqTCSDes StbIntv_trqTCSLead T15_st VehMot_rTrqDfftl /end IN_MEASUREMENT
 /begin OUT_MEASUREMENT VMSI_stDCSPlusOK VMSI_stDCSPtd VMSI_tqCluDesMax VMSI_tqCluLeadMax VMSI_tqCluMin VMSI_trqDesMax VMSI_trqLeadMax VMSI_trqMin /end OUT_MEASUREMENT
 /begin LOC_MEASUREMENT VMSI_flgDCSPlusChk VMSI_flgRampShtOffCdnDCS VMSI_flgRampShtOffCdnTCS VMSI_flgShtOffCdnDCS VMSI_flgShtOffCdnTCS VMSI_stDCSPlusCtrl VMSI_tqDCSRampOut_MP VMSI_tqTCSRampOut_MP VMSI_trqMinLowrLim /end LOC_MEASUREMENT
 FUNCTION_VERSION "40.1.0" /end FUNCTION
/begin FUNCTION WDKSOM "5.2.0     calculation of desired throttle angle without torque structure"
 /begin DEF_CHARACTERISTIC CWWDKSOM SNMDKSRF SVFDKSRF TSRFDKI TSRFDKO TSRFDKU WDKSRFE WDKSRFI WDKSRFO WDKSRFU /end DEF_CHARACTERISTIC
 /begin IN_MEASUREMENT Epm_nEngLRes SyC_stSub VehV_v /end IN_MEASUREMENT
 /begin OUT_MEASUREMENT B_engoff_msg B_srfdke_msg B_srfdko_msg B_srfdku_msg wdksom_w_msg /end OUT_MEASUREMENT
 /begin LOC_MEASUREMENT ChrCtl_B_srfdko_EF_I.buffer ChrCtl_B_srfdko_EF_I.oldSignal ChrCtl_B_srfdku_EF_I.buffer ChrCtl_B_srfdku_EF_I.oldSignal ChrCtl_SRFDKI_TONV_I.outbit ChrCtl_SRFDKI_TONV_I.time ChrCtl_SRFDKO_TE_I.inOld ChrCtl_SRFDKO_TE_I.timeCounter ChrCtl_SRFDKU_T_I.timeCounter /end LOC_MEASUREMENT
 FUNCTION_VERSION "5.2.0" /end FUNCTION
/begin FUNCTION Wiper_DD "8.0.0     Device Driver for wiper active" /begin DEF_CHARACTERISTIC Wiper_stActv_C Wiper_stSwt_C /end DEF_CHARACTERISTIC /begin IN_MEASUREMENT Com_stWipr Com_stWiprActvnCdn T15_st /end IN_MEASUREMENT /begin OUT_MEASUREMENT Wiper_flgActv /end OUT_MEASUREMENT FUNCTION_VERSION "8.0.0" /end FUNCTION
/begin FUNCTION XcpAppl "4200.5.0_7.1.0XCP Calibration Protocol Applikation" FUNCTION_VERSION "4200.5.0_7.1.0" /end FUNCTION
/begin FUNCTION ZUESZ "44.1.0    Ignition, calculation of coil closing time" /begin DEF_CHARACTERISTIC IGCTL_Bat08_AX Ign_nEng08_AX KFFSZNM KFSZT /end DEF_CHARACTERISTIC /begin REF_CHARACTERISTIC IGCTL_tEng08_AX /end REF_CHARACTERISTIC /begin IN_MEASUREMENT BattU_u CEngDsT_t Epm_nEng SyC_stSub /end IN_MEASUREMENT /begin OUT_MEASUREMENT IgCtl_dwlt_u16 IgCtl_numfol_u8 /end OUT_MEASUREMENT /begin LOC_MEASUREMENT ftsztl szouttem_w /end LOC_MEASUREMENT FUNCTION_VERSION "44.1.0" /end FUNCTION
/begin FUNCTION ZWBAS "44.4.0_1.1.0calculation ignition angles for zwbasar" /begin DEF_CHARACTERISTIC CWIGC IgCtl_iaCalApprch_C Ign_diaAPP_C Ign_iaBasMax_M /end DEF_CHARACTERISTIC
 /begin IN_MEASUREMENT AirMod_ratChrgAirCyl CoEng_bStrtEndTrqStruct EngStrt_diaWrmUp Epm_ctCyl Epm_nEng IgCtl_flgIntkVlvlftSwtDly IgCtl_iaPrimHomMinCptProtnIntv Ign_bVlvLInNxtIAs Ign_diaKP_s16 Ign_diaVlvL_s16 Ign_flgIAmapsyn Ign_iaPrHOM_s16 Ign_stVlvLInIA IKCtl_agKnkRtdtAry_s16 IKCtl_iaDynAdpnOffs_s16 zwstt_msg /end IN_MEASUREMENT
 /begin OUT_MEASUREMENT Gen_ctCylAdv IgCtl_iaPrimMinCptProtnIntv igctl_ovl_u8 Ign_ctCylAdv_a Ign_ctCyl_a Ign_diaBasWoKnkMax_a Ign_iaBasAdv_as16 Ign_iaBasNKC_s16 Ign_iaBasNKC_s8 Ign_iaBas_as16 Ign_iaBas_s16 Ign_iaBas_s8 Ign_iaPr_s16 Ign_iaPr_s8 /end OUT_MEASUREMENT
 /begin LOC_MEASUREMENT zzylzuear /end LOC_MEASUREMENT
 FUNCTION_VERSION "44.4.0_1.1.0" /end FUNCTION
/begin FUNCTION ZWGRU "61.0.0    Basic ignition angle"
 /begin DEF_CHARACTERISTIC Ign_iaPrVL1_GM Ign_iaPr_GM Ign_nEng16_AX Ign_ratChrgAir12_AX Ign_ratChrgAir16_AX /end DEF_CHARACTERISTIC
 /begin IN_MEASUREMENT Epm_nEng IgCtl_diaBascLam IgCtl_diaBascLamCptProtn IgCtl_flgIntkVlvlftSwtDly Ign_bVlvLInNxtIAs Ign_flgIAmapsyn Ign_ratChrgAirCyl SyC_stSub /end IN_MEASUREMENT
 /begin OUT_MEASUREMENT IgCtl_iaPrimHomMinCptProtnIntv Ign_diaVlvL_s16 Ign_iaPrHOM_s16 Ign_iaPrMap_s16 /end OUT_MEASUREMENT
 /begin LOC_MEASUREMENT IgCtl_iaPrimMap IgCtl_iaPrimMapVlvlft IgCtl_iaPrimWoLam zwgruhom_w zwkfzw_w /end LOC_MEASUREMENT
 FUNCTION_VERSION "61.0.0" /end FUNCTION
/begin FUNCTION ZWHBDEB2 "29.1.0    Correction of basic ignition angle for 2nd intake manifold & homogen. GDI-modes" /begin DEF_CHARACTERISTIC Ign_nEng12_AX Ign_ratChrgAirGdiPfi12_AX /end DEF_CHARACTERISTIC /begin IN_MEASUREMENT Epm_nEng Ign_ratChrgAirCyl SyC_stSub /end IN_MEASUREMENT FUNCTION_VERSION "29.1.0" /end FUNCTION
/begin FUNCTION ZWKS "21.3.0    Ignition timing knock protection"
 /begin DEF_CHARACTERISTIC IgCtl_diaAltiCorrnKnkCtrl_M IgCtl_diaKnkCtrlIntkAirTEngT_C IgCtl_diaKnkTEngIntk_M IgCtl_facIaKnkColdEthnlMin_M IgCtl_facIaKnkHiAlti_M IgCtl_facIaKnkWrmEthnlMin_M IgCtl_selTIgnKnkCtrl_C /end DEF_CHARACTERISTIC
 /begin IN_MEASUREMENT AirMod_ratChrgAirCyl CEngDsT_t Epm_nEng IntkAirT_tIntkMnfld IntkAirT_tThrVlvUs PEnv_facCorrAlti SyC_stSub tansk_w_msg /end IN_MEASUREMENT
 /begin OUT_MEASUREMENT Ign_diaKP_s16 Ign_diaKP_s8 /end OUT_MEASUREMENT
 /begin LOC_MEASUREMENT IgCtl_diaAltiCorrnKnkCtrl IgCtl_diaKnkTEngIntk IgCtl_flgIntkAirFltSnsrKnkProtn IgCtl_flgTFltSnsrKnkProtn IgCtl_tSelTKnkCtrlIntk /end LOC_MEASUREMENT
 FUNCTION_VERSION "21.3.0" /end FUNCTION
/begin FUNCTION ZWMINBG "40.4.0    calculation of allowed retarded ignition"
 /begin DEF_CHARACTERISTIC CWZWMINBG IgCtl_diaRampFuCutOff_C IgCtl_iaLoVlvLftGearShift_GM IgCtl_offsFacDiaLteFuCutOff_C IgCtl_ratCluHysL_C IgCtl_ratCluHysR_C IgCtl_tiFuCutOffDly_C IgCtl_tiMaxTqIntvGearShift_C IgCtl_tiMaxTqIntvGearShift_T IgCtl_tiResiGasCutOff_C IgCtl_vThdVehMax_C KFZWMNGS /end DEF_CHARACTERISTIC
 /begin REF_CHARACTERISTIC Ign_nEng16_AX Ign_ratChrgAir12_AX /end REF_CHARACTERISTIC
 /begin IN_MEASUREMENT B_nozwe_msg B_sa_msg B_zwappl_msg Clth_r Clth_st CoETS_bTraIntvActv Epm_nEng flambts_msg IgCtl_diaCorrnPEnv IgCtl_diaLteEngT Ign_bstrt_iaLT Ign_bVlvLInNxtIAs Ign_iaBas_s8 Ign_iaLT_bl Ign_ratChrgAirCyl PT_stTraType SyC_stSub VehV_v zwsol_w_msg zwspaebts_msg /end IN_MEASUREMENT
 /begin OUT_MEASUREMENT B_zwmngs_msg Ign_ia_LT /end OUT_MEASUREMENT
 /begin LOC_MEASUREMENT IgCtl_diaLteFuCutOff IgCtl_facRampIaLteFuCutOff IgCtl_flgFuCutOffDetn IgCtl_iaLteGearShiftSecFu IgCtl_iaLteLimDyn IgCtl_iaLteLimStat /end LOC_MEASUREMENT
 FUNCTION_VERSION "40.4.0" /end FUNCTION
/begin FUNCTION ZWMINBTS "6.13.0_1.1.0Calculation of allowed retard ignition timing for component protection"
 /begin DEF_CHARACTERISTIC ExhMgT_diaInertCylVlvLft_M ExhMgT_facFillgRednCptProtn_C ExhMgT_iaLoVlvLftHom_M ExhMgT_nEng16_AX ExhMgT_ratChrgAir12_AX ExhMgT_ratInertCylRefVlvLft1_M ExhMgT_ratInertCylRefVlvLft2_M ExhMgT_tThdIaCptProtn_C ExhMgT_tThdIaLteBl_C FLAMTMPBTS FLAMTMPBVG KFZWMNBTSVH /end DEF_CHARACTERISTIC
 /begin REF_CHARACTERISTIC Ign_nEng20_AX Ign_nEngVS12_AX Ign_ratChrgAir12_AX Ign_ratChrgAirVS12_AX /end REF_CHARACTERISTIC
 /begin IN_MEASUREMENT AirMod_ratChrgAirCyl Epm_nEng ExhMgT_tMinTExhCptProtnGlb frlmxbts_w_msg Ign_bVlvLInNxtIAs Ign_flgIAmapsyn Ign_ratChrgAirCyl Ign_stVlvLInIA rri_w_msg SyC_stSub /end IN_MEASUREMENT
 /begin OUT_MEASUREMENT B_zwms_msg ExhMgT_facCptProtnGearShift flambts_msg zwspaebts_msg /end OUT_MEASUREMENT
 /begin LOC_MEASUREMENT ExhMgT_diaInertCylVlvLft ExhMgT_ratInertCylVlvLft /end LOC_MEASUREMENT
 FUNCTION_VERSION "6.13.0_1.1.0" /end FUNCTION
/begin FUNCTION ZWMINBVG "32.2.0    Calculation of maximum retarded spark limitation - burning limit"
 /begin DEF_CHARACTERISTIC DFZWMNST FDZWPU IgCtl_HiAltiCmp_M IgCtl_iaLteTEng_T IGCTL_tEng08_AX IGCTL_tEng12_AX Ign_diaLtpuHOM_M Ign_flgIaThrVlvIceActv_C Ign_flgIdleDetnActv_C Ign_iaMnThrVlvIce_T KFDZMNST KFZWMN KFZWMNKHLL KFZWMNKHLLVHK KFZWMVHK /end DEF_CHARACTERISTIC
 /begin REF_CHARACTERISTIC Ign_nEng08_AX Ign_nEng16_AX Ign_ratChrgAir12_AX /end REF_CHARACTERISTIC
 /begin IN_MEASUREMENT AirMod_ratChrgAirCyl B_ll_msg B_munst_msg CEngDsT_t CEngDsT_tStrt CoEng_bStrtEndIA EGSys_bCH Epm_nEng Ign_bVlvLInNxtIAs Ign_ratChrgAirCyl PEnv_facCorrAlti PEnv_p SyC_stSub ThrVlv_flgColdCdnOffsActvB1 zwstt_msg /end IN_MEASUREMENT
 /begin OUT_MEASUREMENT IgCtl_diaCorrnPEnv IgCtl_diaLteEngT Ign_bstrt_iaLT Ign_iaLT_bl zwmnhom zwmnhomst /end OUT_MEASUREMENT
 /begin LOC_MEASUREMENT dzwmntmp fzwmn_w IgCtl_iaLteCamsftPha IgCtl_iaLteCamsftPhaLowVlvlft zwmn zwmnst /end LOC_MEASUREMENT
 FUNCTION_VERSION "32.2.0" /end FUNCTION
/begin FUNCTION ZWOPT "8.5.0     Calculation of the optimized model reference ignition angle" /begin IN_MEASUREMENT dzwol_w_msg dzwotm_w_msg Gen_ctCylAdv zwoptl1_w_msg /end IN_MEASUREMENT /begin OUT_MEASUREMENT TMECmb_iaRefAdv_a zwopt_w_msg /end OUT_MEASUREMENT FUNCTION_VERSION "8.5.0" /end FUNCTION
/begin FUNCTION ZWOPTL1 "1.5.0     Calculation of the optimized model reference ignition angle at lambda=1" /begin DEF_CHARACTERISTIC KFZWOP KFZWOPV SNMOPUW SNMOVUW SRLOPUW SRLOVUW /end DEF_CHARACTERISTIC
 /begin IN_MEASUREMENT AirMod_ratChrgAirCylAdv_a Epm_nEng Gen_ctCylAdv Ign_bVlvLInNxtIAs /end IN_MEASUREMENT
 /begin OUT_MEASUREMENT rlmdzs_w_msg zwoptl1_w_msg /end OUT_MEASUREMENT
 FUNCTION_VERSION "1.5.0" /end FUNCTION
/begin FUNCTION ZWOPTWL "1.6.0     Calculation of the optimized correction model reference ignition angle for warm up" /begin DEF_CHARACTERISTIC CWZWOPTWL DZWOM /end DEF_CHARACTERISTIC /begin IN_MEASUREMENT CEngDsT_t dzwwl_msg /end IN_MEASUREMENT /begin OUT_MEASUREMENT dzwotm_w_msg /end OUT_MEASUREMENT FUNCTION_VERSION "1.6.0" /end FUNCTION
/begin FUNCTION ZWOUT "22.11.0   Ignition angle calculation"
 /begin DEF_CHARACTERISTIC IgCtl_iaDiffKnkAdpn_C IgCtl_iaFixdOutpAppl_C IgCtl_nEngThdFixdIa_C IgCtl_pIntkThdFixdIaPlaMod_C IgCtl_pIntkThdFixdIa_C IgCtl_tThdFixdIa_C /end DEF_CHARACTERISTIC
 /begin IN_MEASUREMENT B_zwappl_msg CEngDsT_t DReqSwt_stClrDeb EngStrt_bStrtEnd Epm_ctCyl Epm_nEng Ign_ctCyl_a Ign_iaBas_as16 Ign_ia_LT InjSys_stActRedStg psr_w_msg PthSet_bIAIntv PthSet_bOvrRun SyC_stSub SysDiag_stTestMod VehV_v zwsol_w_msg /end IN_MEASUREMENT
 /begin OUT_MEASUREMENT IgCtl_flgFixdIaOutpTstr IgCtl_iaOutpRdnt Ign_iacalc_as8 Ign_iacalc_s8 Ign_iacpl_au8 Ign_iacpl_u8 Ign_ia_cyl1 Ign_ia_real_s16 Ign_ia_real_s8 Ign_stiaBasKnk zwoutzyl_w_msg /end OUT_MEASUREMENT
 /begin LOC_MEASUREMENT IgCtl_iaDiffKnkAdpn /end LOC_MEASUREMENT
 FUNCTION_VERSION "22.11.0" /end FUNCTION
/begin FUNCTION ZWSTT "12.10.0   Igniton at start"
 /begin DEF_CHARACTERISTIC EngStrt_facCorrAltiAgIgn_AX EngStrt_idxClassSelnAgIgn_T EngStrt_idxSelnAgIgnCoMStrt_T EngStrt_idxSelnAgIgnStrtCorrOffs_T EngStrt_idxSelnAgIgnStrtOffs_T EngStrt_idxSelnAgIgnStrt_T EngStrt_nEngAgIgn_AX EngStrt_ratChrgAgIgnStrt_AX EngStrt_rPedAgIgn_AX EngStrt_tIntkMnfldAgIgn_AX EngStrt_tStrtAgIgn_AX ZWSTT_COM.agIgnCoMStrt_GM ZWSTT_COMWAITSTRTR.agIgnCoMStrt_GM ZWSTT_CORR.agIgnOffsCorrAlti_T ZWSTT_CORR.agIgnOffsIntkAir_T ZWSTT_CORR_2.agIgnOffsCorrAlti_T ZWSTT_CORR_2.agIgnOffsIntkAir_T ZWSTT_FOLW.agIgnStrtOffs_GM ZWSTT_FOLW.facAgIgnStrtOffs_GT ZWSTT_LOP.agIgnStrt_GM /end DEF_CHARACTERISTIC
 /begin IN_MEASUREMENT AirMod_ratChrgAirCyl APP_r B_ad_msg EngStrt_flgStrtEndIgn EngStrt_stStrtReq EngStrt_tStrtCoor Epm_nEng IntkAirT_tIntkMnfld PEnv_facCorrAlti /end IN_MEASUREMENT
 /begin OUT_MEASUREMENT zwstt_msg /end OUT_MEASUREMENT
 /begin LOC_MEASUREMENT EngStrt_agIgnStrtCorrOffs_MP EngStrt_idxClassSelnAgIgn_MP ZWSTT_COM.agIgnCoMStrt ZWSTT_COMWAITSTRTR.agIgnCoMStrt ZWSTT_CORR.agIgnStrtCorrOffs ZWSTT_CORR_2.agIgnStrtCorrOffs ZWSTT_FOLW.agIgnStrtOffs ZWSTT_LOP.agIgnStrtBas /end LOC_MEASUREMENT
 FUNCTION_VERSION "12.10.0" /end FUNCTION
/begin FUNCTION ZWSYNVHE "7.2.0     synchronization of ignition angle calculation for variable inlet valve lift" /begin DEF_CHARACTERISTIC DVHEGOFF DVHEKOFF IgCtl_nrSegIntkVlvlftSwtDly_C /end DEF_CHARACTERISTIC
 /begin IN_MEASUREMENT AirMod_ratChrgAirCyl B_rlvheg_msg drldvls_w_msg EngStrt_flgStrtEndTqStruct igctl_ovl_u8 VlvLft_flgCoornStrtofSwt VlvLft_nrSegSwtIntk_msg /end IN_MEASUREMENT
 /begin OUT_MEASUREMENT B_zwsyn IgCtl_flgIntkVlvlftSwtDly Ign_bVlvLInNxtCmbs Ign_bVlvLInNxtIAs Ign_flgIAmapsyn Ign_ratChrgAirCyl Ign_ratChrgAirCylLoR Ign_stVlvLInIA /end OUT_MEASUREMENT
 FUNCTION_VERSION "7.2.0" /end FUNCTION
/begin FUNCTION ZWWL "13.6.0    Ignition during warm-up" /begin DEF_CHARACTERISTIC CWZWWLE FZWWLRL FZWWLRLN FZWWLTMOT KFZWWLNMOT KFZWWLRL /end DEF_CHARACTERISTIC
 /begin IN_MEASUREMENT CEngDsT_t Epm_nEngLRes IntkAirT_tThrVlvUs rl_msg taev_w_msg tansk_w_msg tmot /end IN_MEASUREMENT
 /begin OUT_MEASUREMENT dzwwl_msg dzwwl_s16_msg /end OUT_MEASUREMENT
 /begin LOC_MEASUREMENT EngStrt_nEngZWWL EngStrt_relAirFillg EngStrt_tEngZWWL tyzwwlnm_w /end LOC_MEASUREMENT
 FUNCTION_VERSION "13.6.0" /end FUNCTION
/begin COMPU_METHOD Acc "" RAT_FUNC "%6.5" "m/s^2" COEFFS 0 1000 0 0 0 1 /end COMPU_METHOD
/begin COMPU_METHOD B_TRUE "" TAB_VERB "%6.3" "" COMPU_TAB_REF B_TRUE /end COMPU_METHOD
/begin COMPU_VTAB B_TRUE "" TAB_VERB 2 0 "FALSE" 1 "TRUE" /end COMPU_VTAB
/begin COMPU_METHOD dez "" RAT_FUNC "%6.2" "" COEFFS 0 1 0 0 0 1 /end COMPU_METHOD
/begin COMPU_METHOD DtyCyc "" RAT_FUNC "%6.4" "%" COEFFS 0 100 0 0 0 1 /end COMPU_METHOD
/begin COMPU_METHOD EngN "" RAT_FUNC "%6.3" "rpm" COEFFS 0 2 0 0 0 1 /end COMPU_METHOD
/begin COMPU_METHOD EngN_LRes "" RAT_FUNC "%6.1" "rpm" COEFFS 0 0.025 0 0 0 1 /end COMPU_METHOD
/begin COMPU_METHOD ENGSTRT_AGIGNCOMSTRT_SET_COMPU_VERB "" TAB_VERB "%6.3" "-" COMPU_TAB_REF ENGSTRT_AGIGNCOMSTRT_SET_COMPU_VERB /end COMPU_METHOD
/begin COMPU_VTAB ENGSTRT_AGIGNCOMSTRT_SET_COMPU_VERB "" TAB_VERB 2 0 "ZWSTT_COM" 1 "ZWSTT_COMWAITSTRTR" /end COMPU_VTAB
/begin COMPU_METHOD ENGSTRT_AGIGNSTRTCORROFFS_SET_COMPU_VERB "" TAB_VERB "%6.3" "-" COMPU_TAB_REF ENGSTRT_AGIGNSTRTCORROFFS_SET_COMPU_VERB /end COMPU_METHOD
/begin COMPU_VTAB ENGSTRT_AGIGNSTRTCORROFFS_SET_COMPU_VERB "" TAB_VERB 2 0 "ZWSTT_CORR" 1 "ZWSTT_CORR_2" /end COMPU_VTAB
/begin COMPU_METHOD ENGSTRT_AGIGNSTRTOFFS_SET_COMPU_VERB "" TAB_VERB "%6.3" "-" COMPU_TAB_REF ENGSTRT_AGIGNSTRTOFFS_SET_COMPU_VERB /end COMPU_METHOD
/begin COMPU_VTAB ENGSTRT_AGIGNSTRTOFFS_SET_COMPU_VERB "" TAB_VERB 1 0 "ZWSTT_FOLW" /end COMPU_VTAB
/begin COMPU_METHOD ENGSTRT_AGIGNSTRT_SET_COMPU_VERB "" TAB_VERB "%6.3" "-" COMPU_TAB_REF ENGSTRT_AGIGNSTRT_SET_COMPU_VERB /end COMPU_METHOD
/begin COMPU_VTAB ENGSTRT_AGIGNSTRT_SET_COMPU_VERB "" TAB_VERB 1 0 "ZWSTT_LOP" /end COMPU_VTAB
/begin COMPU_METHOD ENGSTRT_STSTRTREQ_SET_COMPU_VERB "" TAB_VERB "%6.3" "-" COMPU_TAB_REF ENGSTRT_STSTRTREQ_SET_COMPU_VERB /end COMPU_METHOD
/begin COMPU_VTAB ENGSTRT_STSTRTREQ_SET_COMPU_VERB "" TAB_VERB 6 0 "ENGSTRT_NOSTRT" 1025 "ENGSTRT_PFI" 8192 "ENGSTRT_COMRUNNG" 8193 "ENGSTRT_COMSTRTG" 8194 "ENGSTRT_COMWAITSTRTR" 16384 "ENGSTRT_FOLW" /end COMPU_VTAB
/begin COMPU_METHOD Fact "" RAT_FUNC "%6.5" "-" COEFFS 0 8192 0 0 0 1 /end COMPU_METHOD
/begin COMPU_METHOD Fact0002 "" RAT_FUNC "%6.5" "-" COEFFS 0 5000 0 0 0 1 /end COMPU_METHOD
/begin COMPU_METHOD Fact1000 "" RAT_FUNC "%6.5" "-" COEFFS 0 1000 0 0 0 1 /end COMPU_METHOD
/begin COMPU_METHOD fak_ub_b1 "" RAT_FUNC "%6.4" "-" COEFFS 0 256 0 0 0 1 /end COMPU_METHOD
/begin COMPU_METHOD fak_ub_b2 "" RAT_FUNC "%8.5" "-" COEFFS 0 256 0 0 0 2 /end COMPU_METHOD
/begin COMPU_METHOD fak_uw_b1 "" RAT_FUNC "%7.6" "-" COEFFS 0 65536 0 0 0 1 /end COMPU_METHOD
/begin COMPU_METHOD fak_uw_b2 "" RAT_FUNC "%7.6" "-" COEFFS 0 65536 0 0 0 2 /end COMPU_METHOD
/begin COMPU_METHOD fak_uw_b4 "" RAT_FUNC "%7.6" "-" COEFFS 0 65536 0 0 0 4 /end COMPU_METHOD
/begin COMPU_METHOD kw_q0p75 "" RAT_FUNC "%6.3" "Grad KW" COEFFS 0 4 0 0 0 3 /end COMPU_METHOD
/begin COMPU_METHOD LengthCpp "" RAT_FUNC "%8.7" "m" COEFFS 0 100000 0 0 0 1 /end COMPU_METHOD
/begin COMPU_METHOD nmot_ub_q40 "" RAT_FUNC "%6.1" "1/min" COEFFS 0 1 0 0 0 40 /end COMPU_METHOD
/begin COMPU_METHOD nmot_uw_q0p25 "" RAT_FUNC "%6.3" "1/min" COEFFS 0 1 0 0 0 0.25 /end COMPU_METHOD
/begin COMPU_METHOD OneToOne "" RAT_FUNC "%6.2" "-" COEFFS 0 1 0 0 0 1 /end COMPU_METHOD
/begin COMPU_METHOD Period "" RAT_FUNC "%6.3" "ms" COEFFS 0 10 0 0 0 1 /end COMPU_METHOD
/begin COMPU_METHOD Period_1000 "" RAT_FUNC "%6.5" "ms" COEFFS 0 1000 0 0 0 1 /end COMPU_METHOD
/begin COMPU_METHOD PerKm "" RAT_FUNC "%6.2" "l/km" COEFFS 0 1 0 0 0 1 /end COMPU_METHOD
/begin COMPU_METHOD Prc "" RAT_FUNC "%6.4" "%" COEFFS 0 81.92 0 0 0 1 /end COMPU_METHOD
/begin COMPU_METHOD Prc_Fact100 "" RAT_FUNC "%6.4" "%" COEFFS 0 100 0 0 0 1 /end COMPU_METHOD
/begin COMPU_METHOD Prc_Fact256 "" RAT_FUNC "%6.4" "%" COEFFS 0 256 0 0 0 1 /end COMPU_METHOD
/begin COMPU_METHOD Prc_q0p01_COMPU "" RAT_FUNC "%6.4" "%" COEFFS 0 100 0 0 0 1 /end COMPU_METHOD
/begin COMPU_METHOD p_uw_q0p039 "" RAT_FUNC "%6.4" "hPa" COEFFS 0 256 0 0 0 10 /end COMPU_METHOD
/begin COMPU_METHOD p_uw_q0p078 "" RAT_FUNC "%6.4" "hPa" COEFFS 0 256 0 0 0 20 /end COMPU_METHOD
/begin COMPU_METHOD relDK_q0p390631 "" RAT_FUNC "%6.3" "%" COEFFS 0 65535 0 0 0 25600 /end COMPU_METHOD
/begin COMPU_METHOD relDK_uw_b100 "" RAT_FUNC "%6.4" "%DK" COEFFS 0 65535 0 0 0 100 /end COMPU_METHOD
/begin COMPU_METHOD rel_q0p0234 "" RAT_FUNC "%6.4" "%" COEFFS 0 128 0 0 0 3 /end COMPU_METHOD
/begin COMPU_METHOD rel_q0p02344 "" RAT_FUNC "%6.4" "%" COEFFS 0 32 0 0 0 0.75 /end COMPU_METHOD
/begin COMPU_METHOD rel_q0p75 "" RAT_FUNC "%6.3" "%" COEFFS 0 4 0 0 0 3 /end COMPU_METHOD
/begin COMPU_METHOD rel_ub_q0p75 "" RAT_FUNC "%6.3" "%" COEFFS 0 1 0 0 0 0.75 /end COMPU_METHOD
/begin COMPU_METHOD rel_uw_b100 "" RAT_FUNC "%6.4" "%" COEFFS 0 65536 0 0 0 100 /end COMPU_METHOD
/begin COMPU_METHOD rel_uw_q0p0234 "" RAT_FUNC "%6.4" "%" COEFFS 0 32 0 0 0 0.75 /end COMPU_METHOD
/begin COMPU_METHOD RmpTrqPrpHigh "" RAT_FUNC "%6.4" "Nm/s" COEFFS 0 655.36 0 0 0 1 /end COMPU_METHOD
/begin COMPU_METHOD Temp_Cels "" RAT_FUNC "%6.1" "deg C" COEFFS 0 10 2731.4 0 0 1 /end COMPU_METHOD
/begin COMPU_METHOD temp_q0p0234_o273 "" RAT_FUNC "%6.1" "Grad C" COEFFS 0 1 273.15 0 0 0.0234375 /end COMPU_METHOD
/begin COMPU_METHOD temp_q0p1_K "" RAT_FUNC "%6.3" "K" COEFFS 0 10 0 0 0 1 /end COMPU_METHOD
/begin COMPU_METHOD temp_ub_q0p75_o48 "" RAT_FUNC "%6.2" "Grad C" COEFFS 0 1 48 0 0 0.75 /end COMPU_METHOD
/begin COMPU_METHOD Time_ms "" RAT_FUNC "%6.1" "ms" COEFFS 0 0.1 0 0 0 1 /end COMPU_METHOD
/begin COMPU_METHOD Time_PwmHigh "" RAT_FUNC "%6.4" "us" COEFFS 0 20 0 0 0 1 /end COMPU_METHOD
/begin COMPU_METHOD Time_s "" RAT_FUNC "%6.4" "s" COEFFS 0 100 0 0 0 1 /end COMPU_METHOD
/begin COMPU_METHOD Time_s_float "" RAT_FUNC "%6.2" "s" COEFFS 0 1 0 0 0 1 /end COMPU_METHOD
/begin COMPU_METHOD Trq "" RAT_FUNC "%6.3" "Nm" COEFFS 0 10 0 0 0 1 /end COMPU_METHOD
/begin COMPU_METHOD TrqPrpHigh "" RAT_FUNC "%6.3" "Nm" COEFFS 0 10 0 0 0 1 /end COMPU_METHOD
/begin COMPU_METHOD t_q0p001_ms "" RAT_FUNC "%6.5" "ms" COEFFS 0 1 0 0 0 0.001 /end COMPU_METHOD
/begin COMPU_METHOD t_q0p01 "" RAT_FUNC "%6.4" "s" COEFFS 0 100 0 0 0 1 /end COMPU_METHOD
/begin COMPU_METHOD VEHV_PWMVLDYCHK_SC_Compu "" TAB_VERB "%6.3" "" COMPU_TAB_REF VEHV_PWMVLDYCHK_SC_Compu /end COMPU_METHOD
/begin COMPU_VTAB VEHV_PWMVLDYCHK_SC_Compu "" TAB_VERB 2 0 "deactivated" 1 "activated" /end COMPU_VTAB
/begin COMPU_METHOD VEHV_PWM_SC_Compu "" TAB_VERB "%6.3" "" COMPU_TAB_REF VEHV_PWM_SC_Compu /end COMPU_METHOD
/begin COMPU_VTAB VEHV_PWM_SC_Compu "" TAB_VERB 4 0 "No PWM" 1 "Pwm_InXt" 2 "Pwm_InPer" 3 "Pwm_In" /end COMPU_VTAB
/begin COMPU_METHOD VEHV_SC_Compu "" TAB_VERB "%6.3" "" COMPU_TAB_REF VEHV_SC_Compu /end COMPU_METHOD
/begin COMPU_VTAB VEHV_SC_Compu "" TAB_VERB 2 0 "False" 1 "True" /end COMPU_VTAB
/begin COMPU_METHOD VEHV_SELCOMSIG_SC_Compu "" TAB_VERB "%6.3" "" COMPU_TAB_REF VEHV_SELCOMSIG_SC_Compu /end COMPU_METHOD
/begin COMPU_VTAB VEHV_SELCOMSIG_SC_Compu "" TAB_VERB 4 0 "Vehicle_velocity" 1 "Displayed_Vehicle_Speed" 2 "single_wheel_speed_CAN" 3 "TCM_vehicle_velocity" /end COMPU_VTAB
/begin COMPU_METHOD VEHV_SGLWHLDIAG_SY_Compu "" TAB_VERB "%6.3" "" COMPU_TAB_REF VEHV_SGLWHLDIAG_SY_Compu /end COMPU_METHOD
/begin COMPU_VTAB VEHV_SGLWHLDIAG_SY_Compu "" TAB_VERB 3 0 "0" 1 "1" 2 "2" /end COMPU_VTAB
/begin COMPU_METHOD VEHV_SWTASRC_SC_Compu "" TAB_VERB "%6.3" "" COMPU_TAB_REF VEHV_SWTASRC_SC_Compu /end COMPU_METHOD
/begin COMPU_VTAB VEHV_SWTASRC_SC_Compu "" TAB_VERB 2 1 "A_VEHV" 2 "A_CAN" /end COMPU_VTAB
/begin COMPU_METHOD VEHV_SWTPLAUSCAN_SC_Compu "" TAB_VERB "%6.3" "" COMPU_TAB_REF VEHV_SWTPLAUSCAN_SC_Compu /end COMPU_METHOD
/begin COMPU_VTAB VEHV_SWTPLAUSCAN_SC_Compu "" TAB_VERB 2 0 "False" 1 "True" /end COMPU_VTAB
/begin COMPU_METHOD VEHV_SWTPLAUSFCO_SC_Compu "" TAB_VERB "%6.3" "" COMPU_TAB_REF VEHV_SWTPLAUSFCO_SC_Compu /end COMPU_METHOD
/begin COMPU_VTAB VEHV_SWTPLAUSFCO_SC_Compu "" TAB_VERB 2 0 "False" 1 "True" /end COMPU_VTAB
/begin COMPU_METHOD VEHV_SWTPLAUSPWR_SC_Compu "" TAB_VERB "%6.3" "" COMPU_TAB_REF VEHV_SWTPLAUSPWR_SC_Compu /end COMPU_METHOD
/begin COMPU_VTAB VEHV_SWTPLAUSPWR_SC_Compu "" TAB_VERB 2 0 "False" 1 "True" /end COMPU_VTAB
/begin COMPU_METHOD VEHV_SWTPLAUSREF_SC_Compu "" TAB_VERB "%6.3" "" COMPU_TAB_REF VEHV_SWTPLAUSREF_SC_Compu /end COMPU_METHOD
/begin COMPU_VTAB VEHV_SWTPLAUSREF_SC_Compu "" TAB_VERB 2 0 "False" 1 "True" /end COMPU_VTAB
/begin COMPU_METHOD VEHV_SWTPLAUSV2N_SC_Compu "" TAB_VERB "%6.3" "" COMPU_TAB_REF VEHV_SWTPLAUSV2N_SC_Compu /end COMPU_METHOD
/begin COMPU_VTAB VEHV_SWTPLAUSV2N_SC_Compu "" TAB_VERB 2 0 "False" 1 "True" /end COMPU_VTAB
/begin COMPU_METHOD VEHV_SWTPWRMDL_SC_Compu "" TAB_VERB "%6.3" "" COMPU_TAB_REF VEHV_SWTPWRMDL_SC_Compu /end COMPU_METHOD
/begin COMPU_VTAB VEHV_SWTPWRMDL_SC_Compu "" TAB_VERB 2 1 "1" 2 "2" /end COMPU_VTAB
/begin COMPU_METHOD VEHV_SWTSIGSELNEEP_SC_Compu "" TAB_VERB "%6.3" "" COMPU_TAB_REF VEHV_SWTSIGSELNEEP_SC_Compu /end COMPU_METHOD
/begin COMPU_VTAB VEHV_SWTSIGSELNEEP_SC_Compu "" TAB_VERB 2 0 "False" 1 "True" /end COMPU_VTAB
/begin COMPU_METHOD Vel "" RAT_FUNC "%6.4" "km/h" COEFFS 0 100 0 0 0 1 /end COMPU_METHOD
/begin COMPU_METHOD Velocity "" RAT_FUNC "%6.4" "m/s" COEFFS 0 178.571428571429 0 0 0 1 /end COMPU_METHOD
/begin COMPU_METHOD Vel_High "" RAT_FUNC "%6.5" "km/h" COEFFS 0 1000 0 0 0 1 /end COMPU_METHOD
/begin COMPU_METHOD Vel_High_float "" RAT_FUNC "%6.2" "km/h" COEFFS 0 1 0 0 0 1 /end COMPU_METHOD
/begin COMPU_METHOD Vel_SI "" RAT_FUNC "%6.4" "m/s" COEFFS 0 360 0 0 0 1 /end COMPU_METHOD
/begin COMPU_METHOD VERSSTOPMISFGDETNBYINJ_SY_Compu "" TAB_VERB "%6.3" "" COMPU_TAB_REF VERSSTOPMISFGDETNBYINJ_SY_Compu /end COMPU_METHOD
/begin COMPU_VTAB VERSSTOPMISFGDETNBYINJ_SY_Compu "" TAB_VERB 2 0 "0" 1 "1" /end COMPU_VTAB
/begin COMPU_METHOD VLVI_SY_Compu "" TAB_VERB "%6.3" "" COMPU_TAB_REF VLVI_SY_Compu /end COMPU_METHOD
/begin COMPU_VTAB VLVI_SY_Compu "" TAB_VERB 3 0 "VLVI_NONE" 1 "VLVI_2POINT" 2 "VLVI_CONT" /end COMPU_VTAB
/begin COMPU_METHOD VLVLFTI_TYPAVL_SC_Compu "" TAB_VERB "%6.3" "" COMPU_TAB_REF VLVLFTI_TYPAVL_SC_Compu /end COMPU_METHOD
/begin COMPU_VTAB VLVLFTI_TYPAVL_SC_Compu "" TAB_VERB 2 0 "False" 1 "True" /end COMPU_VTAB
/begin COMPU_METHOD VLVLFT_FBEXHSWT_SC_Compu "" TAB_VERB "%6.3" "" COMPU_TAB_REF VLVLFT_FBEXHSWT_SC_Compu /end COMPU_METHOD
/begin COMPU_VTAB VLVLFT_FBEXHSWT_SC_Compu "" TAB_VERB 2 0 "Absent" 1 "Present" /end COMPU_VTAB
/begin COMPU_METHOD VLVLFT_FBINTKSWT_SC_Compu "" TAB_VERB "%6.3" "" COMPU_TAB_REF VLVLFT_FBINTKSWT_SC_Compu /end COMPU_METHOD
/begin COMPU_VTAB VLVLFT_FBINTKSWT_SC_Compu "" TAB_VERB 2 0 "Absent" 1 "Present" /end COMPU_VTAB
/begin COMPU_METHOD VLVLFT_INTK_SC_Compu "" TAB_VERB "%6.3" "" COMPU_TAB_REF VLVLFT_INTK_SC_Compu /end COMPU_METHOD
/begin COMPU_VTAB VLVLFT_INTK_SC_Compu "" TAB_VERB 3 0 "NoLft" 1 "2PtLft" 2 "ContLft" /end COMPU_VTAB
/begin COMPU_METHOD VLVLFT_OUTL_SC_Compu "" TAB_VERB "%6.3" "" COMPU_TAB_REF VLVLFT_OUTL_SC_Compu /end COMPU_METHOD
/begin COMPU_VTAB VLVLFT_OUTL_SC_Compu "" TAB_VERB 3 0 "NoLft" 1 "2PtLft" 2 "ContLft" /end COMPU_VTAB
/begin COMPU_METHOD VLVLFT_POSNOFSPCLLFTINTK_SC_Compu "" TAB_VERB "%6.3" "" COMPU_TAB_REF VLVLFT_POSNOFSPCLLFTINTK_SC_Compu /end COMPU_METHOD
/begin COMPU_VTAB VLVLFT_POSNOFSPCLLFTINTK_SC_Compu "" TAB_VERB 2 0 "SPCL_LOW_CAM" 1 "SPCL_HIGH_CAM" /end COMPU_VTAB
/begin COMPU_METHOD VLVLFT_TYPINTK_SC_Compu "" TAB_VERB "%6.3" "" COMPU_TAB_REF VLVLFT_TYPINTK_SC_Compu /end COMPU_METHOD
/begin COMPU_VTAB VLVLFT_TYPINTK_SC_Compu "" TAB_VERB 8 0 "NoLift" 1 "ValveTronic" 2 "VarioCam+" 3 "AVS" 4 "VTEC" 5 "UniAir" 6 "CamTronic" 7 "UniValve" /end COMPU_VTAB
/begin COMPU_METHOD VLVLFT_TYPOUTL_SC_Compu "" TAB_VERB "%6.3" "" COMPU_TAB_REF VLVLFT_TYPOUTL_SC_Compu /end COMPU_METHOD
/begin COMPU_VTAB VLVLFT_TYPOUTL_SC_Compu "" TAB_VERB 8 0 "NoLift" 1 "ValveTronic" 2 "VarioCam+" 3 "AVS" 4 "VTEC" 5 "UniAir" 6 "CamTronic" 7 "UniValve" /end COMPU_VTAB
/begin COMPU_METHOD VLVLFT_UNIAIRINTK_SC_Compu "" TAB_VERB "%6.3" "" COMPU_TAB_REF VLVLFT_UNIAIRINTK_SC_Compu /end COMPU_METHOD
/begin COMPU_VTAB VLVLFT_UNIAIRINTK_SC_Compu "" TAB_VERB 2 0 "False" 1 "True" /end COMPU_VTAB
/begin COMPU_METHOD VlvVel "" RAT_FUNC "%6.3" "%/s" COEFFS 0 8.192 0 0 0 1 /end COMPU_METHOD
/begin COMPU_METHOD VMSI_RAMPENDINTV_SC_Compu "" TAB_VERB "%6.3" "" COMPU_TAB_REF VMSI_RAMPENDINTV_SC_Compu /end COMPU_METHOD
/begin COMPU_VTAB VMSI_RAMPENDINTV_SC_Compu "" TAB_VERB 2 0 "False" 1 "True" /end COMPU_VTAB
/begin COMPU_METHOD VNQ6040_SC_Compu "" TAB_VERB "%6.3" "" COMPU_TAB_REF VNQ6040_SC_Compu /end COMPU_METHOD
/begin COMPU_VTAB VNQ6040_SC_Compu "" TAB_VERB 11 0 "NoneASIC" 1 "OneASIC" 2 "TwoASICs" 3 "ThreeASICs" 4 "FourASICs" 5 "FiveASICs" 6 "SixASICs" 7 "SevenASICs" 8 "EightASICs" 9 "NineASICs" 10 "TenASICs" /end COMPU_VTAB
/begin COMPU_METHOD Vol1 "" RAT_FUNC "%9.8" "l" COEFFS 0 3600000 0 0 0 1 /end COMPU_METHOD
/begin COMPU_METHOD volAdd_ml "" RAT_FUNC "%6.3" "ml" COEFFS 0 10 0 0 0 1 /end COMPU_METHOD
/begin COMPU_METHOD volAdd_ml_fine "" RAT_FUNC "%6.5" "ml" COEFFS 0 1000 0 0 0 1 /end COMPU_METHOD
/begin COMPU_METHOD VolEngCap_COMPU "" RAT_FUNC "%9.8" "m^3" COEFFS 0 1000000 0 0 0 1 /end COMPU_METHOD
/begin COMPU_METHOD VolFine "" RAT_FUNC "%7.6" "m^3" COEFFS 0 10000 0 0 0 1 /end COMPU_METHOD
/begin COMPU_METHOD VoltPres "" RAT_FUNC "%6.3" "mV*hPa" COEFFS 0 10 0 0 0 1 /end COMPU_METHOD
/begin COMPU_METHOD VoltPres_HiRes "" RAT_FUNC "%6.4" "mV*hPa" COEFFS 0 100 0 0 0 1 /end COMPU_METHOD
/begin COMPU_METHOD Volt_Batt "" RAT_FUNC "%6.1" "mV" COEFFS 0 0.05 0 0 0 1 /end COMPU_METHOD
/begin COMPU_METHOD Volt_FnReso1 "" RAT_FUNC "%6.3" "mV" COEFFS 0 10 0 0 0 1 /end COMPU_METHOD
/begin COMPU_METHOD Volt_FnReso2 "" RAT_FUNC "%6.5" "mV" COEFFS 0 1000 0 0 0 1 /end COMPU_METHOD
/begin COMPU_METHOD Volt_per_Pres "" RAT_FUNC "%6.5" "mV/hPa" COEFFS 0 1000 0 0 0 1 /end COMPU_METHOD
/begin COMPU_METHOD Volt_q0p002_COMPU "" RAT_FUNC "%6.4" "V" COEFFS 0 500 0 0 0 1 /end COMPU_METHOD
/begin COMPU_METHOD Volt_Sq_HiRes "" RAT_FUNC "%6.3" "mV*mV" COEFFS 0 10 0 0 0 1 /end COMPU_METHOD
/begin COMPU_METHOD Vol_NSC "" RAT_FUNC "%7.6" "L" COEFFS 0 10000 0 0 0 1 /end COMPU_METHOD
/begin COMPU_METHOD vol_q1p5258Em7_l "" RAT_FUNC "%9.8" "l" COEFFS 0 65536 0 0 0 0.01 /end COMPU_METHOD
/begin COMPU_METHOD VSWVLVI_TYPAVL_SC_Compu "" TAB_VERB "%6.3" "" COMPU_TAB_REF VSWVLVI_TYPAVL_SC_Compu /end COMPU_METHOD
/begin COMPU_VTAB VSWVLVI_TYPAVL_SC_Compu "" TAB_VERB 2 0 "False" 1 "True" /end COMPU_VTAB
/begin COMPU_METHOD VSWVLV_AIRACTR_SC_Compu "" TAB_VERB "%6.3" "" COMPU_TAB_REF VSWVLV_AIRACTR_SC_Compu /end COMPU_METHOD
/begin COMPU_VTAB VSWVLV_AIRACTR_SC_Compu "" TAB_VERB 2 0 "False" 1 "True" /end COMPU_VTAB
/begin COMPU_METHOD VSWVLV_TYPAVLCONVENTIONAL_SC_Compu "" TAB_VERB "%6.3" "" COMPU_TAB_REF VSWVLV_TYPAVLCONVENTIONAL_SC_Compu /end COMPU_METHOD
/begin COMPU_VTAB VSWVLV_TYPAVLCONVENTIONAL_SC_Compu "" TAB_VERB 2 0 "False" 1 "True" /end COMPU_VTAB
/begin COMPU_METHOD VVTDSLAVL_SC_Compu "" TAB_VERB "%6.3" "" COMPU_TAB_REF VVTDSLAVL_SC_Compu /end COMPU_METHOD
/begin COMPU_VTAB VVTDSLAVL_SC_Compu "" TAB_VERB 2 0 "Disabled" 1 "Enabled" /end COMPU_VTAB
/begin COMPU_METHOD VVTIDLEMOD_SC_Compu "" TAB_VERB "%6.3" "" COMPU_TAB_REF VVTIDLEMOD_SC_Compu /end COMPU_METHOD
/begin COMPU_VTAB VVTIDLEMOD_SC_Compu "" TAB_VERB 2 0 "False" 1 "True" /end COMPU_VTAB
/begin COMPU_METHOD WAHT_SY_Compu "" TAB_VERB "%6.3" "" COMPU_TAB_REF WAHT_SY_Compu /end COMPU_METHOD
/begin COMPU_VTAB WAHT_SY_Compu "" TAB_VERB 2 0 "FALSE" 1 "TRUE" /end COMPU_VTAB
/begin COMPU_METHOD WaterMsPrHr "" RAT_FUNC "%6.5" "Kg/h" COEFFS 0 1000 0 0 0 1 /end COMPU_METHOD
/begin COMPU_METHOD WDGS_CFGADPR_SC_Compu "" TAB_VERB "%6.3" "" COMPU_TAB_REF WDGS_CFGADPR_SC_Compu /end COMPU_METHOD
/begin COMPU_VTAB WDGS_CFGADPR_SC_Compu "" TAB_VERB 2 0 "False" 1 "True" /end COMPU_VTAB
/begin COMPU_METHOD WESDEM_SY_Compu "" TAB_VERB "%6.3" "" COMPU_TAB_REF WESDEM_SY_Compu /end COMPU_METHOD
/begin COMPU_VTAB WESDEM_SY_Compu "" TAB_VERB 2 0 "False" 1 "True" /end COMPU_VTAB
/begin COMPU_METHOD WHRCOOLTPDIF_TYPAVL_SC_Compu "" TAB_VERB "%6.3" "" COMPU_TAB_REF WHRCOOLTPDIF_TYPAVL_SC_Compu /end COMPU_METHOD
/begin COMPU_VTAB WHRCOOLTPDIF_TYPAVL_SC_Compu "" TAB_VERB 2 0 "False" 1 "True" /end COMPU_VTAB
/begin COMPU_METHOD wink_q0p03125_deg "" RAT_FUNC "%6.4" "deg" COEFFS 0 32 0 0 0 1 /end COMPU_METHOD
/begin COMPU_METHOD WIPRIFTYP_SC_Compu "" TAB_VERB "%6.3" "" COMPU_TAB_REF WIPRIFTYP_SC_Compu /end COMPU_METHOD
/begin COMPU_VTAB WIPRIFTYP_SC_Compu "" TAB_VERB 5 0 "WIPRIFTYP_NON" 1 "WIPRIFTYP_DIG" 2 "WIPRIFTYP_ADC" 3 "WIPRIFTYP_MISC" 4 "WIPRIFTYP_BUS" /end COMPU_VTAB
/begin COMPU_METHOD WNTR_SY_Compu "" TAB_VERB "%6.3" "" COMPU_TAB_REF WNTR_SY_Compu /end COMPU_METHOD
/begin COMPU_VTAB WNTR_SY_Compu "" TAB_VERB 2 0 "False" 1 "True" /end COMPU_VTAB
/begin COMPU_METHOD WRMUPCSERS_SC_Compu "" TAB_VERB "%6.3" "" COMPU_TAB_REF WRMUPCSERS_SC_Compu /end COMPU_METHOD
/begin COMPU_VTAB WRMUPCSERS_SC_Compu "" TAB_VERB 2 0 "False" 1 "True" /end COMPU_VTAB
/begin COMPU_METHOD WTRCACT_TYPAVL_SC_Compu "" TAB_VERB "%6.3" "" COMPU_TAB_REF WTRCACT_TYPAVL_SC_Compu /end COMPU_METHOD
/begin COMPU_VTAB WTRCACT_TYPAVL_SC_Compu "" TAB_VERB 2 0 "False" 1 "True" /end COMPU_VTAB
/begin COMPU_METHOD WTRCOOLTP1_TYPAVL_SY_Compu "" TAB_VERB "%6.3" "" COMPU_TAB_REF WTRCOOLTP1_TYPAVL_SY_Compu /end COMPU_METHOD
/begin COMPU_VTAB WTRCOOLTP1_TYPAVL_SY_Compu "" TAB_VERB 2 0 "False" 1 "True" /end COMPU_VTAB
/begin COMPU_METHOD WTRCOOLTP_TYPAVL_SY_Compu "" TAB_VERB "%6.3" "" COMPU_TAB_REF WTRCOOLTP_TYPAVL_SY_Compu /end COMPU_METHOD
/begin COMPU_VTAB WTRCOOLTP_TYPAVL_SY_Compu "" TAB_VERB 2 0 "False" 1 "True" /end COMPU_VTAB
/begin COMPU_METHOD WTRINJSYS_SC_Compu "" TAB_VERB "%6.3" "" COMPU_TAB_REF WTRINJSYS_SC_Compu /end COMPU_METHOD
/begin COMPU_VTAB WTRINJSYS_SC_Compu "" TAB_VERB 3 0 "No_WtrInjSys" 1 "WtrInjSys_PWI" 2 "WtrInjSys_DWI" /end COMPU_VTAB
/begin COMPU_METHOD WTRPMP1_SC_Compu "" TAB_VERB "%6.3" "" COMPU_TAB_REF WTRPMP1_SC_Compu /end COMPU_METHOD
/begin COMPU_VTAB WTRPMP1_SC_Compu "" TAB_VERB 2 0 "False" 1 "True" /end COMPU_VTAB
/begin COMPU_METHOD WTRPMP2_SC_Compu "" TAB_VERB "%6.3" "" COMPU_TAB_REF WTRPMP2_SC_Compu /end COMPU_METHOD
/begin COMPU_VTAB WTRPMP2_SC_Compu "" TAB_VERB 2 0 "False" 1 "True" /end COMPU_VTAB
/begin COMPU_METHOD WTRPMP_VARNTYP_SC_Compu "" TAB_VERB "%6.3" "" COMPU_TAB_REF WTRPMP_VARNTYP_SC_Compu /end COMPU_METHOD
/begin COMPU_VTAB WTRPMP_VARNTYP_SC_Compu "" TAB_VERB 4 0 "None" 1 "SwaPmp_Demand" 2 "WtrPmp_Coorr" 3 "CustObject" /end COMPU_VTAB
/begin COMPU_METHOD XCORECDD_SC_Compu "" TAB_VERB "%6.3" "" COMPU_TAB_REF XCORECDD_SC_Compu /end COMPU_METHOD
/begin COMPU_VTAB XCORECDD_SC_Compu "" TAB_VERB 2 0 "False" 1 "True" /end COMPU_VTAB
/begin COMPU_METHOD XCPVERS_SC_Compu "" TAB_VERB "%6.3" "" COMPU_TAB_REF XCPVERS_SC_Compu /end COMPU_METHOD
/begin COMPU_VTAB XCPVERS_SC_Compu "" TAB_VERB 5 1 "XCP_1_0" 2 "XCP_1_1" 3 "XCP_1_2" 4 "XCP_1_3" 5 "XCP_1_4" /end COMPU_VTAB
/begin COMPU_METHOD XCP_SY_Compu "" TAB_VERB "%6.3" "" COMPU_TAB_REF XCP_SY_Compu /end COMPU_METHOD
/begin COMPU_VTAB XCP_SY_Compu "" TAB_VERB 2 0 "No XCP" 1 "XCP" /end COMPU_VTAB
/begin COMPU_METHOD XDI_SC_Compu "" TAB_VERB "%6.3" "" COMPU_TAB_REF XDI_SC_Compu /end COMPU_METHOD
/begin COMPU_VTAB XDI_SC_Compu "" TAB_VERB 2 0 "False" 1 "True" /end COMPU_VTAB
/begin COMPU_METHOD ZFC_SY_Compu "" TAB_VERB "%6.3" "" COMPU_TAB_REF ZFC_SY_Compu /end COMPU_METHOD
/begin COMPU_VTAB ZFC_SY_Compu "" TAB_VERB 2 0 "FALSE" 1 "TRUE" /end COMPU_VTAB
/begin COMPU_METHOD ZWMIN_ENAG_SC_Compu "" TAB_VERB "%6.3" "" COMPU_TAB_REF ZWMIN_ENAG_SC_Compu /end COMPU_METHOD
/begin COMPU_VTAB ZWMIN_ENAG_SC_Compu "" TAB_VERB 2 0 "False" 1 "True" /end COMPU_VTAB
/begin COMPU_METHOD zw_q0p1 "" RAT_FUNC "%6.3" "Grad KW" COEFFS 0 10 0 0 0 1 /end COMPU_METHOD
/begin COMPU_METHOD zw_q2p9297Em3_deg_KW "" RAT_FUNC "%6.4" "deg KW" COEFFS 0 1024 0 0 0 3 /end COMPU_METHOD
/begin COMPU_METHOD zw_sb_q0p75 "" RAT_FUNC "%6.3" "Grad KW" COEFFS 0 255 0 0 0 191.25 /end COMPU_METHOD
/begin RECORD_LAYOUT Kw_Ws16 FNC_VALUES 1 SWORD COLUMN_DIR DIRECT /end RECORD_LAYOUT
/begin RECORD_LAYOUT Kw_Wu16 FNC_VALUES 1 UWORD COLUMN_DIR DIRECT /end RECORD_LAYOUT
/begin RECORD_LAYOUT Kw_Wu8 FNC_VALUES 1 UBYTE COLUMN_DIR DIRECT /end RECORD_LAYOUT
/begin RECORD_LAYOUT RB_Axis_S16 NO_AXIS_PTS_X 1 SWORD AXIS_PTS_X 2 SWORD INDEX_INCR DIRECT /end RECORD_LAYOUT
/begin RECORD_LAYOUT RB_Axis_U16 NO_AXIS_PTS_X 1 UWORD AXIS_PTS_X 2 UWORD INDEX_INCR DIRECT /end RECORD_LAYOUT
/begin RECORD_LAYOUT RB_CurveGroup_S8 FNC_VALUES 1 SBYTE COLUMN_DIR DIRECT /end RECORD_LAYOUT
/begin RECORD_LAYOUT RB_CurveGroup_U8 FNC_VALUES 1 UBYTE COLUMN_DIR DIRECT /end RECORD_LAYOUT
/begin RECORD_LAYOUT RB_Curve_S16_S16 NO_AXIS_PTS_X 1 SWORD AXIS_PTS_X 2 SWORD INDEX_INCR DIRECT FNC_VALUES 3 SWORD COLUMN_DIR DIRECT /end RECORD_LAYOUT
/begin RECORD_LAYOUT RB_Curve_S16_S8_Static NO_AXIS_PTS_X 1 SWORD AXIS_PTS_X 2 SWORD INDEX_INCR DIRECT FNC_VALUES 3 SBYTE COLUMN_DIR DIRECT STATIC_RECORD_LAYOUT /end RECORD_LAYOUT
/begin RECORD_LAYOUT RB_Curve_S16_U16_Static NO_AXIS_PTS_X 1 SWORD AXIS_PTS_X 2 SWORD INDEX_INCR DIRECT FNC_VALUES 3 UWORD COLUMN_DIR DIRECT STATIC_RECORD_LAYOUT /end RECORD_LAYOUT
/begin RECORD_LAYOUT RB_Curve_U16_S16_Static NO_AXIS_PTS_X 1 UWORD AXIS_PTS_X 2 UWORD INDEX_INCR DIRECT FNC_VALUES 3 SWORD COLUMN_DIR DIRECT STATIC_RECORD_LAYOUT /end RECORD_LAYOUT
/begin RECORD_LAYOUT RB_Curve_U16_U8_Static NO_AXIS_PTS_X 1 UWORD AXIS_PTS_X 2 UWORD INDEX_INCR DIRECT FNC_VALUES 3 UBYTE COLUMN_DIR DIRECT STATIC_RECORD_LAYOUT /end RECORD_LAYOUT
/begin RECORD_LAYOUT RB_MapGroup_S16 FNC_VALUES 1 SWORD COLUMN_DIR DIRECT /end RECORD_LAYOUT
/begin RECORD_LAYOUT RB_MapGroup_S8 FNC_VALUES 1 SBYTE COLUMN_DIR DIRECT /end RECORD_LAYOUT
/begin RECORD_LAYOUT RB_MapGroup_U16 FNC_VALUES 1 UWORD COLUMN_DIR DIRECT /end RECORD_LAYOUT
/begin RECORD_LAYOUT RB_MapGroup_U8 FNC_VALUES 1 UBYTE COLUMN_DIR DIRECT /end RECORD_LAYOUT
/begin RECORD_LAYOUT RB_Map_S16S16_S16 NO_AXIS_PTS_X 1 SWORD NO_AXIS_PTS_Y 2 SWORD AXIS_PTS_X 3 SWORD INDEX_INCR DIRECT AXIS_PTS_Y 4 SWORD INDEX_INCR DIRECT FNC_VALUES 5 SWORD COLUMN_DIR DIRECT /end RECORD_LAYOUT
/begin RECORD_LAYOUT RB_Map_S16S16_S8 NO_AXIS_PTS_X 1 SWORD NO_AXIS_PTS_Y 2 SWORD AXIS_PTS_X 3 SWORD INDEX_INCR DIRECT AXIS_PTS_Y 4 SWORD INDEX_INCR DIRECT FNC_VALUES 5 SBYTE COLUMN_DIR DIRECT /end RECORD_LAYOUT
/begin RECORD_LAYOUT RB_Map_S16U16_S16 NO_AXIS_PTS_X 1 SWORD NO_AXIS_PTS_Y 2 SWORD AXIS_PTS_X 3 SWORD INDEX_INCR DIRECT AXIS_PTS_Y 4 UWORD INDEX_INCR DIRECT FNC_VALUES 5 SWORD ROW_DIR DIRECT /end RECORD_LAYOUT
/begin RECORD_LAYOUT RB_Map_S16U16_S8 NO_AXIS_PTS_X 1 SWORD NO_AXIS_PTS_Y 2 SWORD AXIS_PTS_X 3 SWORD INDEX_INCR DIRECT AXIS_PTS_Y 4 UWORD INDEX_INCR DIRECT FNC_VALUES 5 SBYTE ROW_DIR DIRECT /end RECORD_LAYOUT
/begin RECORD_LAYOUT RB_Map_S16U16_U8 NO_AXIS_PTS_X 1 SWORD NO_AXIS_PTS_Y 2 SWORD AXIS_PTS_X 3 SWORD INDEX_INCR DIRECT AXIS_PTS_Y 4 UWORD INDEX_INCR DIRECT FNC_VALUES 5 UBYTE ROW_DIR DIRECT /end RECORD_LAYOUT
/begin RECORD_LAYOUT RB_Map_U16U16_S16 NO_AXIS_PTS_X 1 UWORD NO_AXIS_PTS_Y 2 UWORD AXIS_PTS_X 3 UWORD INDEX_INCR DIRECT AXIS_PTS_Y 4 UWORD INDEX_INCR DIRECT FNC_VALUES 5 SWORD COLUMN_DIR DIRECT /end RECORD_LAYOUT
/begin RECORD_LAYOUT RB_Map_U16U16_S8 NO_AXIS_PTS_X 1 UWORD NO_AXIS_PTS_Y 2 UWORD AXIS_PTS_X 3 UWORD INDEX_INCR DIRECT AXIS_PTS_Y 4 UWORD INDEX_INCR DIRECT FNC_VALUES 5 SBYTE COLUMN_DIR DIRECT /end RECORD_LAYOUT
/begin RECORD_LAYOUT RB_Map_U8U16_S16 NO_AXIS_PTS_X 1 UBYTE NO_AXIS_PTS_Y 2 UBYTE AXIS_PTS_X 3 UBYTE INDEX_INCR DIRECT AXIS_PTS_Y 4 UWORD INDEX_INCR DIRECT FNC_VALUES 5 SWORD ROW_DIR DIRECT /end RECORD_LAYOUT
/begin RECORD_LAYOUT RB_Map_U8U16_U8 NO_AXIS_PTS_X 1 UBYTE NO_AXIS_PTS_Y 2 UBYTE AXIS_PTS_X 3 UBYTE INDEX_INCR DIRECT AXIS_PTS_Y 4 UWORD INDEX_INCR DIRECT FNC_VALUES 5 UBYTE ROW_DIR DIRECT /end RECORD_LAYOUT
/begin RECORD_LAYOUT RB_Map_U8U8_S8 NO_AXIS_PTS_X 1 UBYTE NO_AXIS_PTS_Y 2 UBYTE AXIS_PTS_X 3 UBYTE INDEX_INCR DIRECT AXIS_PTS_Y 4 UBYTE INDEX_INCR DIRECT FNC_VALUES 5 SBYTE COLUMN_DIR DIRECT /end RECORD_LAYOUT
/begin RECORD_LAYOUT RB_Map_U8U8_U8 NO_AXIS_PTS_X 1 UBYTE NO_AXIS_PTS_Y 2 UBYTE AXIS_PTS_X 3 UBYTE INDEX_INCR DIRECT AXIS_PTS_Y 4 UBYTE INDEX_INCR DIRECT FNC_VALUES 5 UBYTE COLUMN_DIR DIRECT /end RECORD_LAYOUT
/begin RECORD_LAYOUT RB_Val_Wboolean FNC_VALUES 1 UBYTE COLUMN_DIR DIRECT /end RECORD_LAYOUT
/begin RECORD_LAYOUT RB_Val_Wr32 FNC_VALUES 1 FLOAT32_IEEE COLUMN_DIR DIRECT /end RECORD_LAYOUT
/begin RECORD_LAYOUT RB_Val_Ws16 FNC_VALUES 1 SWORD COLUMN_DIR DIRECT /end RECORD_LAYOUT
/begin RECORD_LAYOUT RB_Val_Ws32 FNC_VALUES 1 SLONG COLUMN_DIR DIRECT /end RECORD_LAYOUT
/begin RECORD_LAYOUT RB_Val_Ws8 FNC_VALUES 1 SBYTE COLUMN_DIR DIRECT /end RECORD_LAYOUT
/begin RECORD_LAYOUT RB_Val_Wu16 FNC_VALUES 1 UWORD COLUMN_DIR DIRECT /end RECORD_LAYOUT
/begin RECORD_LAYOUT RB_Val_Wu32 FNC_VALUES 1 ULONG COLUMN_DIR DIRECT /end RECORD_LAYOUT
/begin RECORD_LAYOUT RB_Val_Wu8 FNC_VALUES 1 UBYTE COLUMN_DIR DIRECT /end RECORD_LAYOUT
/begin RECORD_LAYOUT Val_Ws16 FNC_VALUES 1 SWORD COLUMN_DIR DIRECT /end RECORD_LAYOUT
/begin RECORD_LAYOUT Val_Ws32 FNC_VALUES 1 SLONG COLUMN_DIR DIRECT /end RECORD_LAYOUT
/begin RECORD_LAYOUT Val_Wu16 FNC_VALUES 1 UWORD COLUMN_DIR DIRECT /end RECORD_LAYOUT
/begin RECORD_LAYOUT Val_Wu8 FNC_VALUES 1 UBYTE COLUMN_DIR DIRECT /end RECORD_LAYOUT
/begin UNIT AUTOSAR_CanIf_Units_NoUnit "No Unit" "noUnit" EXTENDED_SI SI_EXPONENTS 0 0 0 0 0 0 0 /end UNIT
/begin UNIT AUTOSAR_Com_Units_NoUnit "No Unit" "noUnit" EXTENDED_SI SI_EXPONENTS 0 0 0 0 0 0 0 /end UNIT
/begin UNIT AUTOSAR_ComM_Units_NoUnit "No Unit" "noUnit" EXTENDED_SI SI_EXPONENTS 0 0 0 0 0 0 0 /end UNIT
/begin UNIT AUTOSAR_LinIf_Units_NoUnit "No Unit" "noUnit" EXTENDED_SI SI_EXPONENTS 0 0 0 0 0 0 0 /end UNIT
/begin UNIT AUTOSAR_PduR_Units_NoUnit "No Unit" "noUnit" EXTENDED_SI SI_EXPONENTS 0 0 0 0 0 0 0 /end UNIT
/begin UNIT RB_RBA_rba_ComScl_Units_NoUnit "No Unit" "noUnit" EXTENDED_SI SI_EXPONENTS 0 0 0 0 0 0 0 /end UNIT
/begin UNIT RB_RBA_rba_Dme_Units_NoUnit "" "noUnit" EXTENDED_SI SI_EXPONENTS 0 0 0 0 0 0 0 /end UNIT
/begin UNIT RB_RBA_rba_Etks_Units_NoUnit "No Unit" "noUnit" EXTENDED_SI SI_EXPONENTS 0 0 0 0 0 0 0 /end UNIT
/begin UNIT RB_RBA_rba_IoExtLib_Units_NoUnit "No Unit" "noUnit" EXTENDED_SI SI_EXPONENTS 0 0 0 0 0 0 0 /end UNIT
/begin UNIT RB_RBA_rba_OsShell_Units_NoUnit "No Unit" "noUnit" EXTENDED_SI SI_EXPONENTS 0 0 0 0 0 0 0 /end UNIT
/end MODULE
/end PROJECT
