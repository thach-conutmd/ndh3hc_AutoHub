ASAP2_VERSION 1 60
/begin PROJECT MG1CA020 "MG1CA020"
/begin HEADER "" VERSION "MG1CA020_6SAY_V011_TPROT" PROJECT_NO MG1CA020 /end HEADER
/begin MODULE DIM ""
/begin MOD_COMMON "" BYTE_ORDER MSB_LAST ALIGNMENT_BYTE 1 ALIGNMENT_WORD 2 ALIGNMENT_LONG 4 ALIGNMENT_INT64 4 ALIGNMENT_FLOAT32_IEEE 4 ALIGNMENT_FLOAT64_IEEE 4 DATA_SIZE 32 /end MOD_COMMON
/begin CHARACTERISTIC EGSDO2_cntrLoad_C "Threshold for counter of load changes" VALUE 0x8051C656 RB_Val_Wu8 255.0 dez 0.00 255.0 FORMAT "%5.1" /end CHARACTERISTIC
/begin CHARACTERISTIC EGSDO2_dratFillgEnaOffs_C "Maximal allowed change in filling to enable fast offset adaptation" VALUE 0x8051C658 RB_Val_Wu16 1535.977 relNWU_q0p0234 0.00 1535.977 FORMAT "%8.3" /end CHARACTERISTIC
/begin CHARACTERISTIC EGSDO2_facBndToErrEvln_C "Factor for limitation of measured delay or transition time relative to fault threshold" VALUE 0x8051C516 RB_Val_Wu16 6.499878 fak_uw_b8 1.500000 7.999878 FORMAT "%8.6" EXTENDED_LIMITS 0.00 7.999878 /end CHARACTERISTIC
/begin CHARACTERISTIC EGSDO2_facBndToErrIdn_C "Factor for limitation of measured delay or transition time relative to fault threshold (identification)" VALUE 0x8051C5C8 RB_Val_Wu16 6.899902 fak_uw_b8 1.099976 7.999878 FORMAT "%8.6" EXTENDED_LIMITS 0.00 7.999878 /end CHARACTERISTIC
/begin CHARACTERISTIC EGSDO2_facDeltaStepEnd_C "Fraction of step height to end step response measurement" VALUE 0x8051C522 RB_Val_Wu16 0.9999847 fak_uw_b1 0.00 0.9999847 FORMAT "%9.7" /end CHARACTERISTIC
/begin CHARACTERISTIC EGSDO2_facDlyEquiv_T "Factor to calculate equivalent delay time" CURVE 0x8051C524 RB_Curve_U16_U16 0.9999847 fak_uw_b1 0.00 0.9999847 FORMAT "%9.7" READ_ONLY
 /begin AXIS_DESCR STD_AXIS NO_INPUT_QUANTITY fak_uw_b32 19 0.00 31.99951 FORMAT "%8.5" DEPOSIT ABSOLUTE /end AXIS_DESCR
/end CHARACTERISTIC
/begin CHARACTERISTIC EGSDO2_facIdnGainDly_C "Identification gain for delay time" VALUE 0x8051C502 RB_Val_Wu16 4095.938 t_q0p0625 0.00 4095.938 FORMAT "%8.3" /end CHARACTERISTIC
/begin CHARACTERISTIC EGSDO2_facIdnGainTran_C "Identification gain for transition time" VALUE 0x8051C504 RB_Val_Wu16 4095.938 t_q0p0625 0.00 4095.938 FORMAT "%8.3" /end CHARACTERISTIC
/begin CHARACTERISTIC EGSDO2_facInertGasEgr_C "Factor for weighting the relative filling of inert gas" VALUE 0x8051C70C RB_Val_Wu16 1.999969 fak_uw_b2 0.00 1.999969 FORMAT "%8.6" /end CHARACTERISTIC
/begin CHARACTERISTIC EGSDO2_facMdlNrmSumMin_C "Threshold for calculation of the loss function" VALUE 0x8051C508 RB_Val_Wu32 65535.9999847 fak_uw_b1 0.00 65535.9999847 FORMAT "%13.7" /end CHARACTERISTIC
/begin CHARACTERISTIC EGSDO2_facOffsFast_C "Learning factor for fast offset adaptation" VALUE 0x8051C5F8 RB_Val_Wu16 0.9999847 fak_uw_b1 0.00 0.9999847 FORMAT "%9.7" /end CHARACTERISTIC
/begin CHARACTERISTIC EGSDO2_facOffsSlow_C "Learning factor for slow offset adaptation" VALUE 0x8051C6AC RB_Val_Wu16 0.9999847 fak_uw_b1 0.00 0.9999847 FORMAT "%9.7" /end CHARACTERISTIC
/begin CHARACTERISTIC EGSDO2_facQlyDeFltSuspc_C "Threshold for the detection, that the error model is better than the nominal model" VALUE 0x8051C50C RB_Val_Wu16 127.9980 fak_uw_b128 0.00 127.9980 FORMAT "%8.4" /end CHARACTERISTIC
/begin CHARACTERISTIC EGSDO2_facQlyDeOKThd_C "Threshold that the error model is good enough" VALUE 0x8051C50E RB_Val_Wu16 127.9980 fak_uw_b128 0.00 127.9980 FORMAT "%8.4" /end CHARACTERISTIC
/begin CHARACTERISTIC EGSDO2_facQlyDeRstThd_C "Threshold for the detection, that the nominal model is better than the error model" VALUE 0x8051C510 RB_Val_Wu16 127.9980 fak_uw_b128 0.00 127.9980 FORMAT "%8.4" /end CHARACTERISTIC
/begin CHARACTERISTIC EGSDO2_facQlyFltSuspc_C "Threshold that the nominal model is not good enough" VALUE 0x8051C512 RB_Val_Wu16 127.9980 fak_uw_b128 0.00 127.9980 FORMAT "%8.4" /end CHARACTERISTIC
/begin CHARACTERISTIC EGSDO2_facTarLtrLamDyn_C "Lambda dynamic target lean rich" VALUE 0x8051C572 RB_Val_Wu16 1.999969 fak_uw_b2 0.00 1.999969 FORMAT "%8.6" /end CHARACTERISTIC
/begin CHARACTERISTIC EGSDO2_facTarRtlLamDyn_C "Lambda dynamic target rich lean" VALUE 0x8051C574 RB_Val_Wu16 1.999969 fak_uw_b2 0.00 1.999969 FORMAT "%8.6" /end CHARACTERISTIC
/begin CHARACTERISTIC EGSDO2_facTiTranTout_C "Factor for transition time at time-out criterion" VALUE 0x8051C576 RB_Val_Wu16 7.999878 fak_uw_b8 0.00 7.999878 FORMAT "%8.6" /end CHARACTERISTIC
/begin CHARACTERISTIC EGSDO2_flgEnaChkOnceOffsFast_CW "Codeword to activate the One-time check of the fast offset adaptation" VALUE 0x8051C65A RB_Val_Wu8 1.00000000000 B_TRUE 0.00 1.00000000000 FORMAT "%13.11" /end CHARACTERISTIC
/begin CHARACTERISTIC EGSDO2_flgEnaDebRatLamOffs_CW "enable debouncing based on lambda value" VALUE 0x8051C65B RB_Val_Wu8 1.00000000000 B_TRUE 0.00 1.00000000000 FORMAT "%13.11" /end CHARACTERISTIC
/begin CHARACTERISTIC EGSDO2_flgITwcHiResl_C "Code bit: I-part of lambda control downstream catalyst with high resolution" VALUE 0x8051C6AE RB_Val_Wu8 1.00000000000 B_TRUE 0.00 1.00000000000 FORMAT "%13.11" /end CHARACTERISTIC
/begin CHARACTERISTIC EGSDO2_flgLamOffsFastAftParl_CW "Fast offset adaptation runs after parallelization" VALUE 0x8051C6BE RB_Val_Wu8 1.00000000000 B_TRUE 0.00 1.00000000000 FORMAT "%13.11" /end CHARACTERISTIC
/begin CHARACTERISTIC EGSDO2_flgLamOffsFastPreParl_CW "Fast offset adaptation runs before parallelization" VALUE 0x8051C6BF RB_Val_Wu8 1.00000000000 B_TRUE 0.00 1.00000000000 FORMAT "%13.11" /end CHARACTERISTIC
/begin CHARACTERISTIC EGSDO2_flgLamSpDyn_C "Selection of lambda setpoint input for dynamic diagnosis" VALUE 0x8051C5CA RB_Val_Wu8 1.00000000000 B_TRUE 0.00 1.00000000000 FORMAT "%13.11" /end CHARACTERISTIC
/begin CHARACTERISTIC EGSDO2_flgLimLamOffsDynErr_CW "Codebit: Alternative limits for lambda offset in case of a dynamic error" VALUE 0x8051C6AF RB_Val_Wu8 1.00000000000 B_TRUE 0.00 1.00000000000 FORMAT "%13.11" /end CHARACTERISTIC
/begin CHARACTERISTIC EGSDO2_flgRstLamOffsDynErr_CW "Reset of lambda offset in case of a LSU dynamic error to the value at the beginning of the driving cycle" VALUE 0x8051C6B0 RB_Val_Wu8 1.00000000000 B_TRUE 0.00 1.00000000000 FORMAT "%13.11" /end CHARACTERISTIC
/begin CHARACTERISTIC EGSDO2_flgSlopChgIni_C "Activation of the reset filter and delay if change in slope direction" VALUE 0x8051C718 RB_Val_Wu8 1.00000000000 B_TRUE 0.00 1.00000000000 FORMAT "%13.11" /end CHARACTERISTIC
/begin CHARACTERISTIC EGSDO2_flgStepBgnReal_C "using of lambda reciprocal from the beginning of the step" VALUE 0x8051C578 RB_Val_Wu8 1.00000000000 B_TRUE 0.00 1.00000000000 FORMAT "%13.11" /end CHARACTERISTIC
/begin CHARACTERISTIC EGSDO2_flgStepEndReal_C "using of lambda reciprocal from the end of the step" VALUE 0x8051C579 RB_Val_Wu8 1.00000000000 B_TRUE 0.00 1.00000000000 FORMAT "%13.11" /end CHARACTERISTIC
/begin CHARACTERISTIC EGSDO2_mExhEnaGnrlNoCatPurge_C "Minimal exhaust mass threshold for general enabling of fast offset adaption if no catalyst purge done before" VALUE 0x8051C65C RB_Val_Wu16 1820.417 m_q0p0277_g 0.00 1820.417 FORMAT "%8.3" /end CHARACTERISTIC
/begin CHARACTERISTIC EGSDO2_mExhEnaGnrlShtrp_C "Minimal exhaust mass threshold for general enabling of fast offset adaption during short trip" VALUE 0x8051C65E RB_Val_Wu16 1820.417 m_q0p0277_g 0.00 1820.417 FORMAT "%8.3" /end CHARACTERISTIC
/begin CHARACTERISTIC EGSDO2_mExhEnaGnrl_C "Minimal exhaust mass threshold for general enabling of fast offset adaption" VALUE 0x8051C660 RB_Val_Wu16 1820.417 m_q0p0277_g 0.00 1820.417 FORMAT "%8.3" /end CHARACTERISTIC
/begin CHARACTERISTIC EGSDO2_mExhEnaOffsFast_T "Minimal exhaust mass threshold for enabling of fast offset adaption" CURVE 0x8051C5FA RB_Curve_S16_U16_Static 1820.417 m_q0p0277_g 0.00 1820.417 FORMAT "%8.3"
 /begin AXIS_DESCR STD_AXIS NO_INPUT_QUANTITY fak_sw_b1 8 -1.000000 0.999969 FORMAT "%8.6" EXTENDED_LIMITS -1.000000 0.9999695 DEPOSIT ABSOLUTE /end AXIS_DESCR
/end CHARACTERISTIC
/begin CHARACTERISTIC EGSDO2_mExhEnaShtrp_C "Minimal exhaust mass threshold for enabling of fast offset adaption during short trip" VALUE 0x8051C61C RB_Val_Wu16 1820.417 m_q0p0277_g 0.00 1820.417 FORMAT "%8.3" /end CHARACTERISTIC
/begin CHARACTERISTIC EGSDO2_mExhMEnaVirt_T "Minimal virtual exhaust mass threshold for enabling fast offset adaption in context of IUMPR simulation" CURVE 0x8051C61E RB_Curve_U8_U16_Static 1820.417 m_q0p0277_g 0.00 1820.417 FORMAT "%8.3"
 /begin AXIS_DESCR STD_AXIS NO_INPUT_QUANTITY dez 3 0.00 255.0 FORMAT "%5.1" DEPOSIT ABSOLUTE /end AXIS_DESCR
/end CHARACTERISTIC
/begin CHARACTERISTIC EGSDO2_mfExhMaxOffsFast_C "Maximal exhaust mass flow to enable fast offset adaptation" VALUE 0x8051C662 RB_Val_Wu16 6553.500 m_uw_b6553p5 0.00 6553.500 FORMAT "%8.3" /end CHARACTERISTIC
/begin CHARACTERISTIC EGSDO2_mfExhMinOffsFastShtrp_C "Minimal exhaust mass flow to enable fast offset adaptation during short trip" VALUE 0x8051C664 RB_Val_Wu16 6553.500 m_uw_b6553p5 0.00 6553.500 FORMAT "%8.3" /end CHARACTERISTIC
/begin CHARACTERISTIC EGSDO2_mfExhMinOffsFast_C "Minimal exhaust mass flow to enable fast offset adaptation" VALUE 0x8051C666 RB_Val_Wu16 6553.500 m_uw_b6553p5 0.00 6553.500 FORMAT "%8.3" /end CHARACTERISTIC
/begin CHARACTERISTIC EGSDO2_mfExhTmpMaxOffsFast_C "Maximum exhaust gas flow for the temporary release of the fast offset adaptation" VALUE 0x8051C668 RB_Val_Wu16 6553.500 m_uw_b6553p5 0.00 6553.500 FORMAT "%8.3" /end CHARACTERISTIC
/begin CHARACTERISTIC EGSDO2_mfExhTmpMinOffsFast_C "Minimal exhaust mass flow to temporarily enable fast offset adaptation" VALUE 0x8051C66A RB_Val_Wu16 6553.500 m_uw_b6553p5 0.00 6553.500 FORMAT "%8.3" /end CHARACTERISTIC
/begin CHARACTERISTIC EGSDO2_mfExhTwcCtrlIOperPnt_C "Exhasut gas mass to ensure stable opeation condition of TWC controller to release slwo offset path" VALUE 0x8051C6C0 RB_Val_Wu16 65.53500 m_q0p001_kg 0.00 65.53500 FORMAT "%8.5" /end CHARACTERISTIC
/begin CHARACTERISTIC EGSDO2_nEngMinEnaOffsFast_C "Minimal engine speed to enable fast offset adaptation" VALUE 0x8051C66C RB_Val_Ws16 32767.50 EngN -16384.00 16383.50 FORMAT "%8.2" /end CHARACTERISTIC
/begin CHARACTERISTIC EGSDO2_nEngSlowOffsMax_C "Maximum engine speed for slow adaptation" VALUE 0x8051C6C2 RB_Val_Ws16 32767.50 EngN -16384.00 16383.50 FORMAT "%8.2" /end CHARACTERISTIC
/begin CHARACTERISTIC EGSDO2_nEngSlowOffsMin_C "Minimum engine speed for slow adaptation" VALUE 0x8051C6C4 RB_Val_Ws16 32767.50 EngN -16384.00 16383.50 FORMAT "%8.2" /end CHARACTERISTIC
/begin CHARACTERISTIC EGSDO2_nrCntrOffsPredAbvThd_C "Threshold for counter that predicted offset is above threshold" VALUE 0x8051C628 RB_Val_Wu16 65535.00 dez 0.00 65535.00 FORMAT "%8.2" /end CHARACTERISTIC
/begin CHARACTERISTIC EGSDO2_nrExhMOffsFastVirt_C "Necessary number of exhaust masses to virtually debounce fault with fast offset adaptation (IUMPR simulation)" VALUE 0x8051C62A RB_Val_Wu8 255.0 dez 0.00 255.0 FORMAT "%5.1" /end CHARACTERISTIC
/begin CHARACTERISTIC EGSDO2_nrExhMOffsFast_C "Necessary number of exhaust masses to debounce fault with fast offset adaptation" VALUE 0x8051C62B RB_Val_Wu8 255.0 dez 0.00 255.0 FORMAT "%5.1" /end CHARACTERISTIC
/begin CHARACTERISTIC EGSDO2_nrMeasFltCfm_C "Necessary number of measurements for fault-confirmation" VALUE 0x8051C5CB RB_Val_Wu8 255.0 dez 0.00 255.0 FORMAT "%5.1" /end CHARACTERISTIC
/begin CHARACTERISTIC EGSDO2_nrNoStepRowOffsFast_C "Necessary number of no offset step (or increasing offset) in a row to debounce fast offset adaptation" VALUE 0x8051C62C RB_Val_Wu8 255.0 dez 0.00 255.0 FORMAT "%5.1" /end CHARACTERISTIC
/begin CHARACTERISTIC EGSDO2_numGrdtPnt_C "number of values for moving average of reciprocal lambda gradient" VALUE 0x8051C719 RB_Val_Wu8 254.0 OneToOne 1.0 255.0 FORMAT "%5.1" EXTENDED_LIMITS 0.00 255.0 /end CHARACTERISTIC
/begin CHARACTERISTIC EGSDO2_ofsCntrLoad_C "Positive offset for counter at load change" VALUE 0x8051C66E RB_Val_Wu8 255.0 dez 0.00 255.0 FORMAT "%5.1" /end CHARACTERISTIC
/begin CHARACTERISTIC EGSDO2_ofsCntrNegOffsFast_C "Negative offset to reduced counter after fast offset adaptation" VALUE 0x8051C62D RB_Val_Wu8 255.0 dez 0.00 255.0 FORMAT "%5.1" /end CHARACTERISTIC
/begin CHARACTERISTIC EGSDO2_ratLamDeltaActMax_C "Threshold for change in LSU offset to detect fast adaptation step" VALUE 0x8051C630 RB_Val_Ws32 131071.999969 fak_sw_b1 -65536.0000000 65535.9999695 FORMAT "%13.7" /end CHARACTERISTIC
/begin CHARACTERISTIC EGSDO2_ratLamOffsFltMax_C "Maximal (upper) fault threshold for lambda offset" VALUE 0x8051C6C6 RB_Val_Ws16 1.999969 fak_sw_b1 -1.000000 0.999969 FORMAT "%8.6" EXTENDED_LIMITS -1.000000 0.9999695 /end CHARACTERISTIC
/begin CHARACTERISTIC EGSDO2_ratLamOffsFltMin_C "Minimal (lower) fault threshold for lambda offset" VALUE 0x8051C6C8 RB_Val_Ws16 1.999969 fak_sw_b1 -1.000000 0.999969 FORMAT "%8.6" EXTENDED_LIMITS -1.000000 0.9999695 /end CHARACTERISTIC
/begin CHARACTERISTIC EGSDO2_ratLamOffsMaxDynErr_C "Maximal limit for lambda offset in case of LSU dynamic fault" VALUE 0x8051C6B2 RB_Val_Ws16 1.999969 fak_sw_b1 -1.000000 0.999969 FORMAT "%8.6" EXTENDED_LIMITS -1.000000 0.9999695 /end CHARACTERISTIC
/begin CHARACTERISTIC EGSDO2_ratLamOffsMax_C "Maximal limit for lambda offset" VALUE 0x8051C6B4 RB_Val_Ws16 1.999969 fak_sw_b1 -1.000000 0.999969 FORMAT "%8.6" EXTENDED_LIMITS -1.000000 0.9999695 /end CHARACTERISTIC
/begin CHARACTERISTIC EGSDO2_ratLamOffsMinDynErr_C "Minimal limit for lambda offset in case of LSU dynamic fault" VALUE 0x8051C6B6 RB_Val_Ws16 1.999969 fak_sw_b1 -1.000000 0.999969 FORMAT "%8.6" EXTENDED_LIMITS -1.000000 0.9999695 /end CHARACTERISTIC
/begin CHARACTERISTIC EGSDO2_ratLamOffsMin_C "Minimal limit for lambda offset" VALUE 0x8051C6B8 RB_Val_Ws16 1.999969 fak_sw_b1 -1.000000 0.999969 FORMAT "%8.6" EXTENDED_LIMITS -1.000000 0.9999695 /end CHARACTERISTIC
/begin CHARACTERISTIC EGSDO2_ratLamOffsPredCntr_C "Threshold for predicted lambda offset to increment counter" VALUE 0x8051C634 RB_Val_Wu16 1.999969 fak_uw_b2 0.00 1.999969 FORMAT "%8.6" /end CHARACTERISTIC
/begin CHARACTERISTIC EGSDO2_ratLamOffsPredCtrlrLim_C "Threshold for predicted lambda offset if controller is in limitation" VALUE 0x8051C636 RB_Val_Wu16 1.999969 fak_uw_b2 0.00 1.999969 FORMAT "%8.6" /end CHARACTERISTIC
/begin CHARACTERISTIC EGSDO2_ratLamOffsPredNeg_T "Threshold for negative predicted lambda offset to enable fast offset adaptation" CURVE 0x8051C638 RB_Curve_U16_U16 1.999969 fak_uw_b2 0.00 1.999969 FORMAT "%8.6"
 /begin AXIS_DESCR STD_AXIS NO_INPUT_QUANTITY fak_uw_b2 3 0.00 1.999969 FORMAT "%8.6" DEPOSIT ABSOLUTE /end AXIS_DESCR
/end CHARACTERISTIC
/begin CHARACTERISTIC EGSDO2_ratLamOffsPredPos_T "Threshold for positive predicted lambda offset to enable fast offset adaptation" CURVE 0x8051C646 RB_Curve_U16_U16 1.999969 fak_uw_b2 0.00 1.999969 FORMAT "%8.6"
 /begin AXIS_DESCR STD_AXIS NO_INPUT_QUANTITY fak_uw_b2 3 0.00 1.999969 FORMAT "%8.6" DEPOSIT ABSOLUTE /end AXIS_DESCR
/end CHARACTERISTIC
/begin CHARACTERISTIC EGSDO2_ratLamSpMaxMntdDiag_C "maximal lambda set point for sensor mounted diagnosis" VALUE 0x8051C71C RB_Val_Wu16 15.99976 fak_uw_b16 0.00 15.99976 FORMAT "%8.5" /end CHARACTERISTIC
/begin CHARACTERISTIC EGSDO2_ratLoadMinEnaOffsFastShtrp_C "Minimum relative load for release of fas offset adptation during short trip" VALUE 0x8051C670 RB_Val_Wu16 1535.977 rel_uw_q0p0234 0.00 1535.977 FORMAT "%8.3" /end CHARACTERISTIC
/begin CHARACTERISTIC EGSDO2_ratLoadMinEnaOffsFast_T "Minimal relative load to enable fast offset adaptation (engine speed dependent curve)" CURVE 0x8051C672 RB_Curve_S16_U16_Static 1535.977 rel_uw_q0p0234 0.00 1535.977 FORMAT "%8.3"
 /begin AXIS_DESCR STD_AXIS Epm_nEng EngN 5 -16384.00 16383.50 FORMAT "%8.2" DEPOSIT ABSOLUTE /end AXIS_DESCR
/end CHARACTERISTIC
/begin CHARACTERISTIC EGSDO2_ratLoadSlowOffsMax_T "Maximum relative load for slow adaptation" CURVE 0x8051C6CA RB_Curve_S16_U16_Static 1535.977 rel_q0p0234 0.00 1535.977 FORMAT "%8.3"
 /begin AXIS_DESCR STD_AXIS Epm_nEng EngN 6 -16384.00 16383.50 FORMAT "%8.2" DEPOSIT ABSOLUTE /end AXIS_DESCR
/end CHARACTERISTIC
/begin CHARACTERISTIC EGSDO2_ratLoadSlowOffsMin_T "Minimum relative load for slow adaptation" CURVE 0x8051C6E4 RB_Curve_S16_U16_Static 1535.977 rel_q0p0234 0.00 1535.977 FORMAT "%8.3"
 /begin AXIS_DESCR STD_AXIS Epm_nEng EngN 6 -16384.00 16383.50 FORMAT "%8.2" DEPOSIT ABSOLUTE /end AXIS_DESCR
/end CHARACTERISTIC
/begin CHARACTERISTIC EGSDO2_ratTranDlyTiDeadLtr_C "Threshold of the sum ratio of transition and delay time, lean to rich error" VALUE 0x8051C5DE RB_Val_Wu16 655.3500 fak_q0p01 0.00 655.3500 FORMAT "%8.4" /end CHARACTERISTIC
/begin CHARACTERISTIC EGSDO2_ratTranDlyTiDeadRtl_C "Threshold of the sum ratio of transition and delay time, rich to lean error" VALUE 0x8051C5E0 RB_Val_Wu16 655.3500 fak_q0p01 0.00 655.3500 FORMAT "%8.4" /end CHARACTERISTIC
/begin CHARACTERISTIC EGSDO2_ratTranDlyTiDeadSym_C "Threshold of the sum ratio of transition and delay time, symmetrical error" VALUE 0x8051C5E2 RB_Val_Wu16 655.3500 fak_q0p01 0.00 655.3500 FORMAT "%8.4" /end CHARACTERISTIC
/begin CHARACTERISTIC EGSDO2_ratTran_T "Transition time ratio for step response measurement" CURVE 0x8051C57A RB_Curve_U16_U16 31.99951 fak_uw_b32 0.00 31.99951 FORMAT "%8.5" READ_ONLY
 /begin AXIS_DESCR STD_AXIS NO_INPUT_QUANTITY fak_uw_b1 19 0.00 0.9999847 FORMAT "%9.7" DEPOSIT ABSOLUTE /end AXIS_DESCR
/end CHARACTERISTIC
/begin CHARACTERISTIC EGSDO2_stLamDyn_C "Code word of lambda-based dynamics diagnosis of a wide-band sensor" VALUE 0x8051C5CC RB_Val_Wu8 255.0 OneToOne 0.00 255.0 FORMAT "%5.1" /end CHARACTERISTIC
/begin CHARACTERISTIC EGSDO2_stLamOffsFast_C "Code word of fast offset adaptation" VALUE 0x8051C688 RB_Val_Wu8 255.0 dez 0.00 255.0 FORMAT "%5.1" /end CHARACTERISTIC
/begin CHARACTERISTIC EGSDO2_stLamPlaus_C "Code word of lambda plausibility diagnosis" VALUE 0x8051C6FE RB_Val_Wu8 255.0 dez 0.00 255.0 FORMAT "%5.1" /end CHARACTERISTIC
/begin CHARACTERISTIC EGSDO2_tCatMaxEnaOffsFast_C "maximum catalyst temperature to release the fast offset adaptation" VALUE 0x8051C68A RB_Val_Ws16 6553.500 Temp_Cels -3549.940 3003.560 FORMAT "%8.3" /end CHARACTERISTIC
/begin CHARACTERISTIC EGSDO2_tCatMinEnaOffsFast_C "minimum catalyst temperature to release the fast offset adaptation" VALUE 0x8051C68C RB_Val_Ws16 6553.500 Temp_Cels -3549.940 3003.560 FORMAT "%8.3" /end CHARACTERISTIC
/begin CHARACTERISTIC EGSDO2_tEngEnaOffsFast_C "Engine temperature threshold to enable fast offset adaptation" VALUE 0x8051C68E RB_Val_Ws16 6553.500 Temp_Cels -3549.940 3003.560 FORMAT "%8.3" /end CHARACTERISTIC
/begin CHARACTERISTIC EGSDO2_tEngMdlEnaOffsFast_C "Modelled engine temperature threshold to enable fast offset adaptation" VALUE 0x8051C690 RB_Val_Ws16 6553.500 Temp_Cels -3549.940 3003.560 FORMAT "%8.3" /end CHARACTERISTIC
/begin CHARACTERISTIC EGSDO2_tiAdpnPrmFil_C "Filter time constant for the filtering of the dynamik adaption time" VALUE 0x8051C5DC RB_Val_Wu16 6553.400 t_q0p1 0.100 6553.500 FORMAT "%8.3" EXTENDED_LIMITS 0.00 6553.500 /end CHARACTERISTIC
/begin CHARACTERISTIC EGSDO2_tiDebMntdDiagErr_C "debounce time for error regarding sensor mounted diagnosis" VALUE 0x8051C71E RB_Val_Wu8 25.50 t_q0p1 0.00 25.50 FORMAT "%5.2" /end CHARACTERISTIC
/begin CHARACTERISTIC EGSDO2_tiDlyAdpnThd_C "Threshold for the adaption of the delay time symmetrical" VALUE 0x8051C5E4 RB_Val_Wu16 655.3500 t_q0p01 0.00 655.3500 FORMAT "%8.4" /end CHARACTERISTIC
/begin CHARACTERISTIC EGSDO2_tiDlyDeltaAdpnThd_C "Minimal necessary delay difference lean-rich to rich-lean for a adaption lean to rich" VALUE 0x8051C5E6 RB_Val_Wu16 655.3500 t_q0p01 0.00 655.3500 FORMAT "%8.4" /end CHARACTERISTIC
/begin CHARACTERISTIC EGSDO2_tiDlyDeltaStepAdpn_C "Threshold for the adaption of the new delay value with the old delay value" VALUE 0x8051C5E8 RB_Val_Wu16 655.3500 t_q0p01 0.00 655.3500 FORMAT "%8.4" /end CHARACTERISTIC
/begin CHARACTERISTIC EGSDO2_tiDlyLtrStepFltThd_C "Fault threshold of delay time (step response, lean to rich)" VALUE 0x8051C5CE RB_Val_Wu16 655.3500 t_q0p01 0.00 655.3500 FORMAT "%8.4" /end CHARACTERISTIC
/begin CHARACTERISTIC EGSDO2_tiDlyRtlStepFltThd_C "Fault threshold of delay time (step response, rich to lean)" VALUE 0x8051C5D0 RB_Val_Wu16 655.3500 t_q0p01 0.00 655.3500 FORMAT "%8.4" /end CHARACTERISTIC
/begin CHARACTERISTIC EGSDO2_tiDlyStepChgCfm_C "Delay time difference for confirmation of step change" VALUE 0x8051C518 RB_Val_Wu16 655.3500 t_q0p01 0.00 655.3500 FORMAT "%8.4" /end CHARACTERISTIC
/begin CHARACTERISTIC EGSDO2_tiDlyStepChgSuspc_C "Delay time difference for step change suspicion" VALUE 0x8051C51A RB_Val_Wu16 655.3500 t_q0p01 0.00 655.3500 FORMAT "%8.4" /end CHARACTERISTIC
/begin CHARACTERISTIC EGSDO2_tiDt1HipFlt_C "Highpass time constant (DT1) at fault suspicion" VALUE 0x8051C70E RB_Val_Wu16 655.3400 t_q0p01 0.0100 655.3500 FORMAT "%8.4" EXTENDED_LIMITS 0.00 655.3500 /end CHARACTERISTIC
/begin CHARACTERISTIC EGSDO2_tiDt1Hip_C "Highpass time constant (DT1)" VALUE 0x8051C710 RB_Val_Wu16 655.3400 t_q0p01 0.0100 655.3500 FORMAT "%8.4" EXTENDED_LIMITS 0.00 655.3500 /end CHARACTERISTIC
/begin CHARACTERISTIC EGSDO2_tiEvlnIdnFirst_C "Debounce time for the first online identification adaption" VALUE 0x8051C5EA RB_Val_Wu16 6553.500 t_q0p1 0.00 6553.500 FORMAT "%8.3" /end CHARACTERISTIC
/begin CHARACTERISTIC EGSDO2_tiEvlnIdnMax_C "Maximum debounce time for the adaption with online identification" VALUE 0x8051C5EC RB_Val_Wu16 6553.500 t_q0p1 0.00 6553.500 FORMAT "%8.3" /end CHARACTERISTIC
/begin CHARACTERISTIC EGSDO2_tiEvlnIdn_C "Debounce time for the followed online identification adaption" VALUE 0x8051C5EE RB_Val_Wu16 6553.500 t_q0p1 0.00 6553.500 FORMAT "%8.3" /end CHARACTERISTIC
/begin CHARACTERISTIC EGSDO2_tiEwma_C "Weighting factor for EWMA filter" VALUE 0x8051C51C RB_Val_Wu16 0.9999847 fak_uw_b1 0.00 0.9999847 FORMAT "%9.7" /end CHARACTERISTIC
/begin CHARACTERISTIC EGSDO2_tiGrdtTmrThd_C "Time threshold to abort gradient-based dynamic diagnosis" VALUE 0x8051C5D2 RB_Val_Wu16 655.3500 t_q0p01 0.00 655.3500 FORMAT "%8.4" /end CHARACTERISTIC
/begin CHARACTERISTIC EGSDO2_tiLamMonOkVirtThd_C "Time threshold above which virtual lambda monitoring is okay" VALUE 0x8051C500 RB_Val_Wu16 655.3500 t_q0p01 0.00 655.3500 FORMAT "%8.4" /end CHARACTERISTIC
/begin CHARACTERISTIC EGSDO2_tiLamOffsSlowDebOffsShrtp_C "Debouncing time for slow offset adaptation during short trip (offset fault)" VALUE 0x8051C6BA RB_Val_Wu16 6553.500 t_q0p1 0.00 6553.500 FORMAT "%8.3" /end CHARACTERISTIC
/begin CHARACTERISTIC EGSDO2_tiLamOffsSlowDebOffs_C "Debouncing time for slow offset adaptation (offset fault)" VALUE 0x8051C6BC RB_Val_Wu16 6553.500 t_q0p1 0.00 6553.500 FORMAT "%8.3" /end CHARACTERISTIC
/begin CHARACTERISTIC EGSDO2_tiLossTmrThd_C "Time threshold to evaluate loss function" VALUE 0x8051C514 RB_Val_Wu16 655.3500 t_q0p01 0.00 655.3500 FORMAT "%8.4" /end CHARACTERISTIC
/begin CHARACTERISTIC EGSDO2_tiMdlAsymPreFilt_C "Time constant for prefilter of asymmetric fault model" VALUE 0x8051C712 RB_Val_Wu16 655.34999985 zk10msxs_uw_b655 0.01000015 655.36000000 FORMAT "%12.8" EXTENDED_LIMITS 0.010000152590 655.36000000 /end CHARACTERISTIC
/begin CHARACTERISTIC EGSDO2_tiMflowExhTmpMax_T "Maximum duration for temporary release of fast offset adaptation via maximum exhaust gas flow" CURVE 0x8051C692 RB_Curve_U16_U8_Static 25.50 t_q0p1 0.00 25.50 FORMAT "%5.2"
 /begin AXIS_DESCR STD_AXIS NO_INPUT_QUANTITY m_uw_b6553p5 4 0.00 6553.500 FORMAT "%8.3" DEPOSIT ABSOLUTE /end AXIS_DESCR
/end CHARACTERISTIC
/begin CHARACTERISTIC EGSDO2_tiMflowExhTmpMin_C "Maximal duration for temporary enabling of fast offset adaptation with minimal exhaust mass flow" VALUE 0x8051C6A0 RB_Val_Wu8 25.50 t_q0p1 0.00 25.50 FORMAT "%5.2" /end CHARACTERISTIC
/begin CHARACTERISTIC EGSDO2_tiPt1LamDerS1_C "Time constant of lambda (derivative) filter (sensor 1)" VALUE 0x8051C71A RB_Val_Wu16 655.3400 t_q0p01 0.0100 655.3500 FORMAT "%8.4" EXTENDED_LIMITS 0.00 655.3500 /end CHARACTERISTIC
/begin CHARACTERISTIC EGSDO2_tiPt1OffsPred_C "Filter time constant (PT1) for predicted offset" VALUE 0x8051C654 RB_Val_Wu16 6553.4999985 zk100msxs_uw_b6553 0.1000015 6553.6000000 FORMAT "%12.7" EXTENDED_LIMITS 0.10000152590 6553.6000000 /end CHARACTERISTIC
/begin CHARACTERISTIC EGSDO2_tiSumAdpnThd_C "Error suspicion threshold of the dynamic time of the sum of delay and transition for each direction" VALUE 0x8051C5D4 RB_Val_Wu16 655.3500 t_q0p01 0.00 655.3500 FORMAT "%8.4" /end CHARACTERISTIC
/begin CHARACTERISTIC EGSDO2_tiSumDeltaAdpnThd_C "Error suspicion threshold of the difference of the sums of delay and transition" VALUE 0x8051C5D6 RB_Val_Ws16 655.3500 t_q0p01 -327.6800 327.6700 FORMAT "%8.4" /end CHARACTERISTIC
/begin CHARACTERISTIC EGSDO2_tiSumRefCtrlActv_C "Threshold for summed time with active reference control" VALUE 0x8051C6A2 RB_Val_Wu16 6553.500 t_q0p1 0.00 6553.500 FORMAT "%8.3" /end CHARACTERISTIC
/begin CHARACTERISTIC EGSDO2_tiTranAdpnThd_C "Threshold for the adaption of the transition time symmetrical" VALUE 0x8051C5F0 RB_Val_Wu16 655.3500 t_q0p01 0.00 655.3500 FORMAT "%8.4" /end CHARACTERISTIC
/begin CHARACTERISTIC EGSDO2_tiTranBpNarrow_C "Transition time threshold for switching back to narrow bandpass" VALUE 0x8051C714 RB_Val_Wu16 655.3500 t_q0p01 0.00 655.3500 FORMAT "%8.4" /end CHARACTERISTIC
/begin CHARACTERISTIC EGSDO2_tiTranBpWide_C "Transition time threshold for switching to wide bandpass" VALUE 0x8051C716 RB_Val_Wu16 655.3500 t_q0p01 0.00 655.3500 FORMAT "%8.4" /end CHARACTERISTIC
/begin CHARACTERISTIC EGSDO2_tiTranDeltaAdpnThd_C "Minimal necessary transition difference lean-rich to rich-lean for a adaption lean to rich" VALUE 0x8051C5F2 RB_Val_Wu16 655.3500 t_q0p01 0.00 655.3500 FORMAT "%8.4" /end CHARACTERISTIC
/begin CHARACTERISTIC EGSDO2_tiTranDeltaStepAdpn_C "Threshold for the adaption of the new transition value with the old delay value" VALUE 0x8051C5F4 RB_Val_Wu16 655.3500 t_q0p01 0.00 655.3500 FORMAT "%8.4" /end CHARACTERISTIC
/begin CHARACTERISTIC EGSDO2_tiTranLtrStepFltThd_C "Fault threshold of transition time (step response, lean to rich)" VALUE 0x8051C5D8 RB_Val_Wu16 655.3500 t_q0p01 0.00 655.3500 FORMAT "%8.4" /end CHARACTERISTIC
/begin CHARACTERISTIC EGSDO2_tiTranRtlStepFltThd_C "Fault threshold of transition time (step response, rich to lean)" VALUE 0x8051C5DA RB_Val_Wu16 655.3500 t_q0p01 0.00 655.3500 FORMAT "%8.4" /end CHARACTERISTIC
/begin CHARACTERISTIC EGSDO2_tiTranStepChgCfm_C "Transition time difference for confirmation of step change" VALUE 0x8051C51E RB_Val_Wu16 655.3500 t_q0p01 0.00 655.3500 FORMAT "%8.4" /end CHARACTERISTIC
/begin CHARACTERISTIC EGSDO2_tiTranStepChgSuspc_C "Transition time difference for step change suspicion" VALUE 0x8051C520 RB_Val_Wu16 655.3500 t_q0p01 0.00 655.3500 FORMAT "%8.4" /end CHARACTERISTIC
/begin CHARACTERISTIC EGSDO2_tiTurnOffCtrlrSt_C "TurnOff delay after change in controller status" VALUE 0x8051C6A4 RB_Val_Wu8 25.50 t_q0p1 0.00 25.50 FORMAT "%5.2" /end CHARACTERISTIC
/begin CHARACTERISTIC EGSDO2_tiTurnOnCatTShtrp_C "TurnOn delay to enable fast offset adaptation by catalyst temperature at short trip" VALUE 0x8051C6A5 RB_Val_Wu8 25.50 t_q0p1 0.00 25.50 FORMAT "%5.2" /end CHARACTERISTIC
/begin CHARACTERISTIC EGSDO2_tiTurnOnCatT_C "TurnOn delay to enable fast offset adaptation by catalyst temperature" VALUE 0x8051C6A6 RB_Val_Wu8 25.50 t_q0p1 0.00 25.50 FORMAT "%5.2" /end CHARACTERISTIC
/begin CHARACTERISTIC EGSDO2_tiTurnOnCtrlrLim_C "TurnOn delay if lambda controller upstream catalyst at limitation and sensor voltages in opposite direction" VALUE 0x8051C6A7 RB_Val_Wu8 25.50 t_q0p1 0.00 25.50 FORMAT "%5.2" /end CHARACTERISTIC
/begin CHARACTERISTIC EGSDO2_tiTurnOnCtrlrSt_C "TurnOn delay after change in controller status" VALUE 0x8051C6A8 RB_Val_Wu8 25.50 t_q0p1 0.00 25.50 FORMAT "%5.2" /end CHARACTERISTIC
/begin CHARACTERISTIC EGSDO2_tiTurnOnNEng_C "Turn-on delay after falling below engine speed threshold to disable fast offset adaptation" VALUE 0x8051C6A9 RB_Val_Wu8 25.50 t_q0p1 0.00 25.50 FORMAT "%5.2" /end CHARACTERISTIC
/begin CHARACTERISTIC LamPlausB1_I.EGSDO2_ratLamOffsInin_C "Class instance of lambda-based plausibility diagnosis (offset) of a wideband sensor (bank 1) / Initialisation value for lambda offset (for calibration purposes only!)" VALUE 0x8051C708 RB_Val_Ws16 1.999969 fak_sw_b1 -1.000000 0.999969 FORMAT "%8.6" EXTENDED_LIMITS -1.000000 0.9999695 /end CHARACTERISTIC
/begin CHARACTERISTIC UEGO_ratLamMaxMntdDiag_C "air fuel ratio threshold for sensor mounted diagnosis" VALUE 0x8051C720 RB_Val_Wu16 15.99976 fak_uw_b16 0.00 15.99976 FORMAT "%8.5" /end CHARACTERISTIC
/begin MEASUREMENT B_sa_TONV_I.outbit "Turn-on delay to further disable fast adaptation after fuel cut-off / return value" UBYTE B_TRUE 1 100 0.00 1.00000000000 BIT_MASK 0x1 FORMAT "%13.11" ECU_ADDRESS 0x60003B38 /end MEASUREMENT
/begin MEASUREMENT B_sa_TONV_I.time "Turn-on delay to further disable fast adaptation after fuel cut-off / expired delay time" UBYTE t_q0p1 1 100 0.00 25.50 FORMAT "%5.2" ECU_ADDRESS 0x60003B39 /end MEASUREMENT
/begin MEASUREMENT ddltrmo_l "delta lambda between BGLSUOFFS-LRHKC" SLONG fak_sl_b1 1 100 -1.00000000000 0.99999999953 FORMAT "%13.11" ECU_ADDRESS 0x500022C4 /end MEASUREMENT
/begin MEASUREMENT DiumprB1_I.cntrStepLtrTripVirt "Class instance for IUMPR calculation for lambda-based dynamics diagnosis of a wideband-sensor (bank 1) / Number of virtual step response measurements in lean-rich direction of driving cycle" UBYTE dez 1 100 0.00 255.0 FORMAT "%5.1" ECU_ADDRESS 0x60003B46 /end MEASUREMENT
/begin MEASUREMENT DiumprB1_I.cntrStepRtlTripVirt "Class instance for IUMPR calculation for lambda-based dynamics diagnosis of a wideband-sensor (bank 1) / Number of virtual step response measurements in rich-lean direction of driving cycle" UBYTE dez 1 100 0.00 255.0 FORMAT "%5.1" ECU_ADDRESS 0x60003B47 /end MEASUREMENT
/begin MEASUREMENT DiumprB1_I.flgLamMonOkVirt "Class instance for IUMPR calculation for lambda-based dynamics diagnosis of a wideband-sensor (bank 1) / Virtual lambda monitoring okay (bank 1)" UBYTE B_TRUE 1 100 0.00 1.00000000000 BIT_MASK 0x1 FORMAT "%13.11" ECU_ADDRESS 0x60003B48 /end MEASUREMENT
/begin MEASUREMENT DiumprB1_I.flgStepVirtDne "Class instance for IUMPR calculation for lambda-based dynamics diagnosis of a wideband-sensor (bank 1) / Virtual step response measurement done" UBYTE B_TRUE 1 100 0.00 1.00000000000 BIT_MASK 0x1 FORMAT "%13.11" ECU_ADDRESS 0x60003B49 /end MEASUREMENT
/begin MEASUREMENT DiumprB1_I.tiEnaIdnVirt "Class instance for IUMPR calculation for lambda-based dynamics diagnosis of a wideband-sensor (bank 1) / Timer for enabled virtual identification" UWORD t_q0p01 1 100 0.00 655.3500 FORMAT "%8.4" ECU_ADDRESS 0x60003B4C /end MEASUREMENT
/begin MEASUREMENT DiumprB1_I.tiStepTmrVirt "Class instance for IUMPR calculation for lambda-based dynamics diagnosis of a wideband-sensor (bank 1) / Time after virtual step" UWORD t_q0p01 1 100 0.00 655.3500 FORMAT "%8.4" ECU_ADDRESS 0x60003B4A /end MEASUREMENT
/begin MEASUREMENT DiumprB1_I.StepStateVirt_I.flgDynStepLtrReset "Class instance for IUMPR calculation for lambda-based dynamics diagnosis of a wideband-sensor (bank 1) / virtual calculation of the step states / Reset of Step Measurment Ltr" UBYTE B_TRUE 1 100 0.00 1.00000000000 BIT_MASK 0x1 FORMAT "%13.11" ECU_ADDRESS 0x60003B4E /end MEASUREMENT
/begin MEASUREMENT DiumprB1_I.StepStateVirt_I.flgDynStepLtrSet "Class instance for IUMPR calculation for lambda-based dynamics diagnosis of a wideband-sensor (bank 1) / virtual calculation of the step states / start of Measurement Rtl" UBYTE B_TRUE 1 100 0.00 1.00000000000 BIT_MASK 0x1 FORMAT "%13.11" ECU_ADDRESS 0x60003B4F /end MEASUREMENT
/begin MEASUREMENT DiumprB1_I.StepStateVirt_I.flgDynStepRtlReset "Class instance for IUMPR calculation for lambda-based dynamics diagnosis of a wideband-sensor (bank 1) / virtual calculation of the step states / Reset of Step Measurment Rtl" UBYTE B_TRUE 1 100 0.00 1.00000000000 BIT_MASK 0x1 FORMAT "%13.11" ECU_ADDRESS 0x60003B50 /end MEASUREMENT
/begin MEASUREMENT DiumprB1_I.StepStateVirt_I.flgDynStepRtlSet "Class instance for IUMPR calculation for lambda-based dynamics diagnosis of a wideband-sensor (bank 1) / virtual calculation of the step states / start of Measurement Rtl" UBYTE B_TRUE 1 100 0.00 1.00000000000 BIT_MASK 0x1 FORMAT "%13.11" ECU_ADDRESS 0x60003B51 /end MEASUREMENT
/begin MEASUREMENT DiumprB1_I.StepVirtDneERNM_I.oldSignal "Class instance for IUMPR calculation for lambda-based dynamics diagnosis of a wideband-sensor (bank 1) / Edge rising for virtual step response evaluation done / value of input signal last calculation" UBYTE B_TRUE 1 100 0.00 1.00000000000 BIT_MASK 0x1 FORMAT "%13.11" ECU_ADDRESS 0x60003B54 /end MEASUREMENT
/begin MEASUREMENT DiumprB1_I.StepVirtLtrFF_I.status "Class instance for IUMPR calculation for lambda-based dynamics diagnosis of a wideband-sensor (bank 1) / Flip-Flop for virtual step response in lean-rich direction / current value of RS-FF" UBYTE B_TRUE 1 100 0.00 1.00000000000 BIT_MASK 0x1 FORMAT "%13.11" ECU_ADDRESS 0x60003B55 /end MEASUREMENT
/begin MEASUREMENT DiumprB1_I.StepVirtRtlFF_I.status "Class instance for IUMPR calculation for lambda-based dynamics diagnosis of a wideband-sensor (bank 1) / Flip-Flop for virtual step response in rich-lean direction / current value of RS-FF" UBYTE B_TRUE 1 100 0.00 1.00000000000 BIT_MASK 0x1 FORMAT "%13.11" ECU_ADDRESS 0x60003B56 /end MEASUREMENT
/begin MEASUREMENT dlatrmo_w "Lambda offset downstream lambda control" SWORD fak_sw_b1 1 100 -1.000000 0.999969 FORMAT "%8.6" ECU_ADDRESS 0x6000D9B4 /end MEASUREMENT
/begin MEASUREMENT EGSDO2_cntrLoad "Counter for load changes" UBYTE dez 1 100 0.00 255.0 FORMAT "%5.1" ECU_ADDRESS 0x6000656F /end MEASUREMENT
/begin MEASUREMENT EGSDO2_cntrStepLtrS1B1 "Number of evaluated steps in lean-rich direction (sensor 1, bank 1)" UBYTE dez 1 100 0.00 255.0 FORMAT "%5.1" ECU_ADDRESS 0x6000E40E /end MEASUREMENT
/begin MEASUREMENT EGSDO2_cntrStepLtrTripVirtS1B1 "Amount of virtual step response measurements in lean-rich direction of driving cycle" UBYTE dez 1 100 0.00 255.0 FORMAT "%5.1" ECU_ADDRESS 0x6000A076 /end MEASUREMENT
/begin MEASUREMENT EGSDO2_cntrStepRtlS1B1 "Number of evaluated steps in rich-lean direction (sensor 1, bank 1)" UBYTE dez 1 100 0.00 255.0 FORMAT "%5.1" ECU_ADDRESS 0x6000E40F /end MEASUREMENT
/begin MEASUREMENT EGSDO2_cntrStepRtlTripVirtS1B1 "Amount of virtual step response measurements in rich-lean direction of driving cycle" UBYTE dez 1 100 0.00 255.0 FORMAT "%5.1" ECU_ADDRESS 0x6000A075 /end MEASUREMENT
/begin MEASUREMENT EGSDO2_ctReini100msLamDyn "Local counter in LamDyn for number of driving cycles (leave postdrive) to enable reinitialization 100ms" UBYTE dez 1 100 0.00 255.0 FORMAT "%5.1" ECU_ADDRESS 0x6000E39B /end MEASUREMENT
/begin MEASUREMENT EGSDO2_ctReini100msLamDynAdpn "Local counter in LamDynAdpn) for number of driving cycles (leave postdrive) to enable reinitialization 100ms" UBYTE dez 1 100 0.00 255.0 FORMAT "%5.1" ECU_ADDRESS 0x60006570 /end MEASUREMENT
/begin MEASUREMENT EGSDO2_ctReIni100msLamOffsFast "counter for reinitialization trigger after PostDrive leave" UBYTE dez 1 100 0.00 255.0 FORMAT "%5.1" ECU_ADDRESS 0x6000656E /end MEASUREMENT
/begin MEASUREMENT EGSDO2_ctReIni100msLamPlaus "counter for reinitialization trigger after PostDrive leave" UBYTE dez 1 100 0.00 255.0 FORMAT "%5.1" ECU_ADDRESS 0x6000E39A /end MEASUREMENT
/begin MEASUREMENT EGSDO2_ctReIni10msLamDyn "Local counter in LamDyn for number of driving cycles (leave postdrive) to enable reinitialization 10ms" UBYTE dez 1 100 0.00 255.0 FORMAT "%5.1" ECU_ADDRESS 0x6000657A /end MEASUREMENT
/begin MEASUREMENT EGSDO2_ctReIni10msSigPrepn "ReIni counter" UBYTE dez 1 100 0.00 255.0 FORMAT "%5.1" ECU_ADDRESS 0x6000656C /end MEASUREMENT
/begin MEASUREMENT EGSDO2_CtrlrLimOffsB1TONV_I.outbit "TurnOn Delay to release offset detection if lambda control is in their limit / return value" UBYTE B_TRUE 1 100 0.00 1.00000000000 BIT_MASK 0x1 FORMAT "%13.11" ECU_ADDRESS 0x60003B36 /end MEASUREMENT
/begin MEASUREMENT EGSDO2_CtrlrLimOffsB1TONV_I.time "TurnOn Delay to release offset detection if lambda control is in their limit / expired delay time" UBYTE t_q0p1 1 100 0.00 25.50 FORMAT "%5.2" ECU_ADDRESS 0x60003B37 /end MEASUREMENT
/begin MEASUREMENT EGSDO2_CtrlrStOffsB1TOFFV_I.outbit "TurnOff delay of the release condition based on the condition of the lambda control / Output Bit" UBYTE B_TRUE 1 100 0.00 1.00000000000 BIT_MASK 0x1 FORMAT "%13.11" ECU_ADDRESS 0x60003B34 /end MEASUREMENT
/begin MEASUREMENT EGSDO2_CtrlrStOffsB1TOFFV_I.time "TurnOff delay of the release condition based on the condition of the lambda control / Occured Time" UBYTE t_q0p1 1 100 0.00 25.50 FORMAT "%5.2" ECU_ADDRESS 0x60003B35 /end MEASUREMENT
/begin MEASUREMENT EGSDO2_CtrlrStOffsB1TONV_I.outbit "TurnOn delay of the release condition based on the condition of the lambda control / return value" UBYTE B_TRUE 1 100 0.00 1.00000000000 BIT_MASK 0x1 FORMAT "%13.11" ECU_ADDRESS 0x60003B32 /end MEASUREMENT
/begin MEASUREMENT EGSDO2_CtrlrStOffsB1TONV_I.time "TurnOn delay of the release condition based on the condition of the lambda control / expired delay time" UBYTE t_q0p1 1 100 0.00 25.50 FORMAT "%5.2" ECU_ADDRESS 0x60003B33 /end MEASUREMENT
/begin MEASUREMENT EGSDO2_DerFilB1_I.dratLamRecpr "Derivation filter / Derivative of reciprocal lambda" SWORD freq_q9p1553Em5 1 100 -3.000000 2.999908 FORMAT "%8.6" ECU_ADDRESS 0x6000CCFC /end MEASUREMENT
/begin MEASUREMENT EGSDO2_DerFilB1_I.dratLamRecprFild "Derivation filter / Derivative of reciprocal lambda (filtered)" SWORD freq_q9p1553Em5 1 100 -3.000000 2.999908 FORMAT "%8.6" ECU_ADDRESS 0x6000CCFE /end MEASUREMENT
/begin MEASUREMENT EGSDO2_DerFilB1_I.dratLamRecprSum "Derivation filter / summe of the last reciprocol lambda gradient, to build the moving average" SLONG freq_q9p1553Em5 1 100 -196608.000000 196607.999908 FORMAT "%13.6" ECU_ADDRESS 0x6000CD00 /end MEASUREMENT
/begin MEASUREMENT EGSDO2_DerFilB1_I.idxInp "Derivation filter / index for moving average filter" UBYTE dez 1 100 0.00 10.00 FORMAT "%5.2" ECU_ADDRESS 0x6000CD04 /end MEASUREMENT
/begin MEASUREMENT EGSDO2_DerFilB1_I.ratLamRecpr "Derivation filter / reciprocal lambda" UWORD fak_q3p0518Em5 1 100 0.00 1.999969 FORMAT "%8.6" ECU_ADDRESS 0x6000CD06 /end MEASUREMENT
/begin MEASUREMENT EGSDO2_DerFilB1_I.ratLamRecprFild "Derivation filter / Reciprocal lambda (filtered)" UWORD fak_uw_b2 1 100 0.00 1.999969 FORMAT "%8.6" ECU_ADDRESS 0x6000CD08 /end MEASUREMENT
/begin MEASUREMENT EGSDO2_DerFilB1_I.ratlam_a "Derivation filter / array of reciprocol lambda gradient" SWORD freq_q9p1553Em5 1 100 -3.000000 2.999908 FORMAT "%8.6" ARRAY_SIZE 11 ECU_ADDRESS 0x6000CD0C /end MEASUREMENT
/begin MEASUREMENT EGSDO2_DerFilB1_I.tiFildDly "Derivation filter / Delaytime of reciprokol lambda in case of moving average" UWORD t_q0p01 1 100 0.00 655.3500 FORMAT "%8.4" ECU_ADDRESS 0x6000CD22 /end MEASUREMENT
/begin MEASUREMENT EGSDO2_DerFilB1_I.LamRecprLT_I.memory "Derivation filter / Lowpass filter (PT1) for reciprocal lambda / current lowpass value" ULONG fak_q4p6566Em10 1 100 0.00 1.999999999534339 FORMAT "%17.15" ECU_ADDRESS 0x6000CD24 /end MEASUREMENT
/begin MEASUREMENT EGSDO2_dratLamRecprFildS1B1 "Derivative of reciprocal lambda (filtered)" SWORD freq_q9p1553Em5 1 100 -3.000000 2.999908 FORMAT "%8.6" ECU_ADDRESS 0x600050FE /end MEASUREMENT
/begin MEASUREMENT EGSDO2_DynStepExptLtrFF_I.status "Flip-Flop for expected step response in lean-rich direction / current value of RS-FF" UBYTE B_TRUE 1 100 0.00 1.00000000000 BIT_MASK 0x1 FORMAT "%13.11" ECU_ADDRESS 0x60006579 /end MEASUREMENT
/begin MEASUREMENT EGSDO2_DynStepExptRtlFF_I.status "Flip-Flop for expected step response in rich-lean direction / current value of RS-FF" UBYTE B_TRUE 1 100 0.00 1.00000000000 BIT_MASK 0x1 FORMAT "%13.11" ECU_ADDRESS 0x60006578 /end MEASUREMENT
/begin MEASUREMENT EGSDO2_DynStepLtrFF_I.status "Flip-Flop for step response in lean-lean direction / current value of RS-FF" UBYTE B_TRUE 1 100 0.00 1.00000000000 BIT_MASK 0x1 FORMAT "%13.11" ECU_ADDRESS 0x60006577 /end MEASUREMENT
/begin MEASUREMENT EGSDO2_DynStepRtlFF_I.status "Flip-Flop for step response in rich-lean direction / current value of RS-FF" UBYTE B_TRUE 1 100 0.00 1.00000000000 BIT_MASK 0x1 FORMAT "%13.11" ECU_ADDRESS 0x60006576 /end MEASUREMENT
/begin MEASUREMENT EGSDO2_EnaCatOffsB1TTONV_I.outbit "TurnOn delay of the release condition based on the catalyst temperature / return value" UBYTE B_TRUE 1 100 0.00 1.00000000000 BIT_MASK 0x1 FORMAT "%13.11" ECU_ADDRESS 0x60003B30 /end MEASUREMENT
/begin MEASUREMENT EGSDO2_EnaCatOffsB1TTONV_I.time "TurnOn delay of the release condition based on the catalyst temperature / expired delay time" UBYTE t_q0p1 1 100 0.00 25.50 FORMAT "%5.2" ECU_ADDRESS 0x60003B31 /end MEASUREMENT
/begin MEASUREMENT EGSDO2_EnaMflowExhTmpMaxOffsB1TONV_I.outbit "TurnOn delay of the release condition based on the exhaust gas massflow / return value" UBYTE B_TRUE 1 100 0.00 1.00000000000 BIT_MASK 0x1 FORMAT "%13.11" ECU_ADDRESS 0x60003B2E /end MEASUREMENT
/begin MEASUREMENT EGSDO2_EnaMflowExhTmpMaxOffsB1TONV_I.time "TurnOn delay of the release condition based on the exhaust gas massflow / expired delay time" UBYTE t_q0p1 1 100 0.00 25.50 FORMAT "%5.2" ECU_ADDRESS 0x60003B2F /end MEASUREMENT
/begin MEASUREMENT EGSDO2_EnaMflowExhTmpMinOffsB1TONV_I.outbit "TurnOn delay of the release condition based on the exhaust gas massflow / return value" UBYTE B_TRUE 1 100 0.00 1.00000000000 BIT_MASK 0x1 FORMAT "%13.11" ECU_ADDRESS 0x60003B2C /end MEASUREMENT
/begin MEASUREMENT EGSDO2_EnaMflowExhTmpMinOffsB1TONV_I.time "TurnOn delay of the release condition based on the exhaust gas massflow / expired delay time" UBYTE t_q0p1 1 100 0.00 25.50 FORMAT "%5.2" ECU_ADDRESS 0x60003B2D /end MEASUREMENT
/begin MEASUREMENT EGSDO2_ExhMEnaGnrlOffsB1IK_I.memory "Exhaust gas massflow integral to release the fast offset adaptation / current integrator value" ULONG m_q4p239Em7_g 1 100 0.00 1820.44907366 FORMAT "%13.8" ECU_ADDRESS 0x600015B0 /end MEASUREMENT
/begin MEASUREMENT EGSDO2_facMdlFltDeEvlnB1 "Fault model deviation, Bank1" UWORD fak_uw_b128 1 100 0.00 127.9980 FORMAT "%8.4" ECU_ADDRESS 0x6000E1B8 /end MEASUREMENT
/begin MEASUREMENT EGSDO2_facMdlNomDeEvlnB1 "nominal model deviation, Bank1" UWORD fak_uw_b128 1 100 0.00 127.9980 FORMAT "%8.4" ECU_ADDRESS 0x6000E1BA /end MEASUREMENT
/begin MEASUREMENT EGSDO2_flgArithFiltg "Arithmetic filtering of the sensor upstream active" UBYTE B_TRUE 1 100 0.00 1.00000000000 BIT_MASK 0x1 FORMAT "%13.11" ECU_ADDRESS 0x70000865 /end MEASUREMENT
/begin MEASUREMENT EGSDO2_flgBpWideS1B1 "wide evaluation thresholds active" UBYTE B_TRUE 1 100 0.00 1.00000000000 BIT_MASK 0x1 FORMAT "%13.11" ECU_ADDRESS 0x70000864 /end MEASUREMENT
/begin MEASUREMENT EGSDO2_flgClrSigPrepn10msB1 "Indication of clearing of error memory" UBYTE B_TRUE 1 100 0.00 1.00000000000 BIT_MASK 0x1 FORMAT "%13.11" ECU_ADDRESS 0x70000285 /end MEASUREMENT
/begin MEASUREMENT EGSDO2_flgCtrlrLimOffsFastB1 "Lambda control fault suspicion" UBYTE B_TRUE 1 100 0.00 1.00000000000 BIT_MASK 0x1 FORMAT "%13.11" ECU_ADDRESS 0x70000294 /end MEASUREMENT
/begin MEASUREMENT EGSDO2_flgCtrlrLimSnsrOppOffsFastB1 "Lambda control fault suspicion" UBYTE B_TRUE 1 100 0.00 1.00000000000 BIT_MASK 0x1 FORMAT "%13.11" ECU_ADDRESS 0x70000293 /end MEASUREMENT
/begin MEASUREMENT EGSDO2_flgDebFltOffsFastS1B1 "Debounce condition for fault confirmation by fast offset adaptation (sensor 1, bank 1)" UBYTE B_TRUE 1 100 0.00 1.00000000000 BIT_MASK 0x1 FORMAT "%13.11" ECU_ADDRESS 0x70000862 /end MEASUREMENT
/begin MEASUREMENT EGSDO2_flgDebFltOffsFastVirtS1B1 "Virtual debounce condition (for IUMPR simulation) for fault confirmation by fast offset adaptation (sensor 1, bank 1)" UBYTE B_TRUE 1 100 0.00 1.00000000000 BIT_MASK 0x1 FORMAT "%13.11" ECU_ADDRESS 0x70000861 /end MEASUREMENT
/begin MEASUREMENT EGSDO2_flgDebHealOffsFastS1B1 "Debounce condition for fault healing by fast offset adaptation (sensor 1, bank 1)" UBYTE B_TRUE 1 100 0.00 1.00000000000 BIT_MASK 0x1 FORMAT "%13.11" ECU_ADDRESS 0x70000860 /end MEASUREMENT
/begin MEASUREMENT EGSDO2_flgDiOffsBnkIndpdt "Bank-independent disabling conditions of fast offset adaptation" UBYTE B_TRUE 1 100 0.00 1.00000000000 BIT_MASK 0x1 FORMAT "%13.11" ECU_ADDRESS 0x70000292 /end MEASUREMENT
/begin MEASUREMENT EGSDO2_flgDiOffsEngT "Disable fast offset adaptation due to engine temperature" UBYTE B_TRUE 1 100 0.00 1.00000000000 BIT_MASK 0x1 FORMAT "%13.11" ECU_ADDRESS 0x70000291 /end MEASUREMENT
/begin MEASUREMENT EGSDO2_flgDSMClrAdpnParlB1 "Indication of clearing of error memory" UBYTE B_TRUE 1 100 0.00 1.00000000000 BIT_MASK 0x1 FORMAT "%13.11" ECU_ADDRESS 0x70000295 /end MEASUREMENT
/begin MEASUREMENT EGSDO2_flgDynAdpnLtrS1B1 "Dynamic adaptation in lean-rich direction (sensor 1, bank 1)" UBYTE B_TRUE 1 100 0.00 1.00000000000 BIT_MASK 0x1 FORMAT "%13.11" ECU_ADDRESS 0x7000085F /end MEASUREMENT
/begin MEASUREMENT EGSDO2_flgDynAdpnRtlS1B1 "Dynamic adaptation in rich-lean direction (sensor 1, bank 1)" UBYTE B_TRUE 1 100 0.00 1.00000000000 BIT_MASK 0x1 FORMAT "%13.11" ECU_ADDRESS 0x7000085E /end MEASUREMENT
/begin MEASUREMENT EGSDO2_flgDynStepLtrB1 "Step in lean-rich direction" UBYTE B_TRUE 1 100 0.00 1.00000000000 BIT_MASK 0x1 FORMAT "%13.11" ECU_ADDRESS 0x70000858 /end MEASUREMENT
/begin MEASUREMENT EGSDO2_flgDynStepRtlB1 "Step in rich-lean direction" UBYTE B_TRUE 1 100 0.00 1.00000000000 BIT_MASK 0x1 FORMAT "%13.11" ECU_ADDRESS 0x70000857 /end MEASUREMENT
/begin MEASUREMENT EGSDO2_flgEnaGnrlCatTOffsFastB1 "Catalyst temperature criteria fulfilled" UBYTE B_TRUE 1 100 0.00 1.00000000000 BIT_MASK 0x1 FORMAT "%13.11" ECU_ADDRESS 0x70000290 /end MEASUREMENT
/begin MEASUREMENT EGSDO2_flgEnaGnrlExhMOffsFastB1 "Debounced enable conditions via massflow" UBYTE B_TRUE 1 100 0.00 1.00000000000 BIT_MASK 0x1 FORMAT "%13.11" ECU_ADDRESS 0x7000028F /end MEASUREMENT
/begin MEASUREMENT EGSDO2_flgEnaGnrlMflowExhOffsFastB1 "Massflow criteria fulfilled" UBYTE B_TRUE 1 100 0.00 1.00000000000 BIT_MASK 0x1 FORMAT "%13.11" ECU_ADDRESS 0x7000028E /end MEASUREMENT
/begin MEASUREMENT EGSDO2_flgEnaGnrlOffsFastB1 "General enabling condition of fast offset adaptation fulfilled (bank 1)" UBYTE B_TRUE 1 100 0.00 1.00000000000 BIT_MASK 0x1 FORMAT "%13.11" ECU_ADDRESS 0x70000856 /end MEASUREMENT
/begin MEASUREMENT EGSDO2_flgEnaGnrlPhyOffsFastB1 "Physical enable conditions fulfilled" UBYTE B_TRUE 1 100 0.00 1.00000000000 BIT_MASK 0x1 FORMAT "%13.11" ECU_ADDRESS 0x7000028D /end MEASUREMENT
/begin MEASUREMENT EGSDO2_flgEnaGnrlReldOffsFastB1 "Function released from DSM" UBYTE B_TRUE 1 100 0.00 1.00000000000 BIT_MASK 0x1 FORMAT "%13.11" ECU_ADDRESS 0x7000028C /end MEASUREMENT
/begin MEASUREMENT EGSDO2_flgEnaMflowExhTmpMaxOffsFastB1 "Massflow criteria fulfilled" UBYTE B_TRUE 1 100 0.00 1.00000000000 BIT_MASK 0x1 FORMAT "%13.11" ECU_ADDRESS 0x7000028B /end MEASUREMENT
/begin MEASUREMENT EGSDO2_flgEnaMflowExhTmpMinOffsFastB1 "Massflow criteria fulfilled" UBYTE B_TRUE 1 100 0.00 1.00000000000 BIT_MASK 0x1 FORMAT "%13.11" ECU_ADDRESS 0x7000028A /end MEASUREMENT
/begin MEASUREMENT EGSDO2_flgEnaOffsFastBnkIndpdt "Bank-independent enabling conditions of fast offset adaptation" UBYTE B_TRUE 1 100 0.00 1.00000000000 BIT_MASK 0x1 FORMAT "%13.11" ECU_ADDRESS 0x70000289 /end MEASUREMENT
/begin MEASUREMENT EGSDO2_flgEnaRefCtrlOffsFastB1 "reference lambda control" UBYTE B_TRUE 1 100 0.00 1.00000000000 BIT_MASK 0x1 FORMAT "%13.11" ECU_ADDRESS 0x70000288 /end MEASUREMENT
/begin MEASUREMENT EGSDO2_flgIdnFinshdS1B1 "Identification finished (sensor 1, bank 1)" UBYTE B_TRUE 1 100 0.00 1.00000000000 BIT_MASK 0x1 FORMAT "%13.11" ECU_ADDRESS 0x70000851 /end MEASUREMENT
/begin MEASUREMENT EGSDO2_flgIdnFltSuspcDeltaS1B1 "Error suspicion if the deviation of lean to rich and rich to lean is high enough" UBYTE B_TRUE 1 100 0.00 1.00000000000 BIT_MASK 0x1 FORMAT "%13.11" ECU_ADDRESS 0x7000084F /end MEASUREMENT
/begin MEASUREMENT EGSDO2_flgIdnFltSuspcLtrS1B1 "Error suspicion if lean to rich direction value is high enough" UBYTE B_TRUE 1 100 0.00 1.00000000000 BIT_MASK 0x1 FORMAT "%13.11" ECU_ADDRESS 0x7000084E /end MEASUREMENT
/begin MEASUREMENT EGSDO2_flgIdnFltSuspcRtlS1B1 "Error suspicion if rich to lean direction value is high enough" UBYTE B_TRUE 1 100 0.00 1.00000000000 BIT_MASK 0x1 FORMAT "%13.11" ECU_ADDRESS 0x7000084D /end MEASUREMENT
/begin MEASUREMENT EGSDO2_flgIdnFltSuspcS1B1 "error suspicion of the online identification" UBYTE B_TRUE 1 100 0.00 1.00000000000 BIT_MASK 0x1 FORMAT "%13.11" ECU_ADDRESS 0x7000084C /end MEASUREMENT
/begin MEASUREMENT EGSDO2_flgLamMonOkVirtB1 "Virtual lambda monitoring okay (bank 1)" UBYTE B_TRUE 1 100 0.00 1.00000000000 BIT_MASK 0x1 FORMAT "%13.11" ECU_ADDRESS 0x70000849 /end MEASUREMENT
/begin MEASUREMENT EGSDO2_flgLamOffsFastFltSuspcS1B1 "Fault suspicion from fast offset adaptation (sensor 1, bank 1)" UBYTE B_TRUE 1 100 0.00 1.00000000000 BIT_MASK 0x1 FORMAT "%13.11" ECU_ADDRESS 0x70000848 /end MEASUREMENT
/begin MEASUREMENT EGSDO2_flgLamPlausFltMaxS1B1 "Status of Lambda Plausibility max error" UBYTE B_TRUE 1 100 0.00 1.00000000000 BIT_MASK 0x1 FORMAT "%13.11" ECU_ADDRESS 0x70000847 /end MEASUREMENT
/begin MEASUREMENT EGSDO2_flgLamPlausFltMinS1B1 "Status of Lambda Plausibility min error" UBYTE B_TRUE 1 100 0.00 1.00000000000 BIT_MASK 0x1 FORMAT "%13.11" ECU_ADDRESS 0x70000846 /end MEASUREMENT
/begin MEASUREMENT EGSDO2_flgLamPlausFltSuspcS1B1 "Fault suspicion from lambda plausibility diagnosis (sensor 1, bank 1)" UBYTE B_TRUE 1 100 0.00 1.00000000000 BIT_MASK 0x1 FORMAT "%13.11" ECU_ADDRESS 0x70000845 /end MEASUREMENT
/begin MEASUREMENT EGSDO2_flgLamPlausFltVirtS1B1 "Status of virtual Lambda Plausibility error" UBYTE B_TRUE 1 100 0.00 1.00000000000 BIT_MASK 0x1 FORMAT "%13.11" ECU_ADDRESS 0x70000844 /end MEASUREMENT
/begin MEASUREMENT EGSDO2_flgLamPlausInhbParlS1B1 "Inhibition of parallelization by Lambda plausibility diagnosis (sensor 1, bank 1)" UBYTE B_TRUE 1 100 0.00 1.00000000000 BIT_MASK 0x1 FORMAT "%13.11" ECU_ADDRESS 0x70000843 /end MEASUREMENT
/begin MEASUREMENT EGSDO2_flgLamPlausParlDneOnceS1B1 "Parallelization done at least once in this cycle from Lambda plausiblity point of view (sensor 1, bank 1)" UBYTE B_TRUE 1 100 0.00 1.00000000000 BIT_MASK 0x1 FORMAT "%13.11" ECU_ADDRESS 0x70000842 /end MEASUREMENT
/begin MEASUREMENT EGSDO2_flgLamPlausTstdS1B1 "Lambda based plausibility diagnosis tested (sensor 1, bank 1)" UBYTE B_TRUE 1 100 0.00 1.00000000000 BIT_MASK 0x1 FORMAT "%13.11" ECU_ADDRESS 0x70000841 /end MEASUREMENT
/begin MEASUREMENT EGSDO2_flgLossEvlnDneB1 "LossFunction is evaluated" UBYTE B_TRUE 1 100 0.00 1.00000000000 BIT_MASK 0x1 FORMAT "%13.11" ECU_ADDRESS 0x70000840 /end MEASUREMENT
/begin MEASUREMENT EGSDO2_flgLossEvlnRlsStepB1 "Release for special step response measurement for lambda dynamic diagnosis, bank1" UBYTE B_TRUE 1 100 0.00 1.00000000000 BIT_MASK 0x1 FORMAT "%13.11" ECU_ADDRESS 0x70000297 /end MEASUREMENT
/begin MEASUREMENT EGSDO2_flgLtrStepChgS1B1 "Sudden deterioration detected (so called step change)" UBYTE B_TRUE 1 100 0.00 1.00000000000 BIT_MASK 0x1 FORMAT "%13.11" ECU_ADDRESS 0x7000083F /end MEASUREMENT
/begin MEASUREMENT EGSDO2_flgOperPntRelsDiag "Operation point release condition for the offset calculation slow path" UBYTE B_TRUE 1 100 0.00 1.00000000000 BIT_MASK 0x1 FORMAT "%13.11" ECU_ADDRESS 0x70000286 /end MEASUREMENT
/begin MEASUREMENT EGSDO2_flgQlyDeFltSuspcB1 "Fault suspicious based on loss function calculation, bank1" UBYTE B_TRUE 1 100 0.00 1.00000000000 BIT_MASK 0x1 FORMAT "%13.11" ECU_ADDRESS 0x7000083E /end MEASUREMENT
/begin MEASUREMENT EGSDO2_flgRstAdpnDynB1 "Reset of the adaption and evaluation values" UBYTE B_TRUE 1 100 0.00 1.00000000000 BIT_MASK 0x1 FORMAT "%13.11" ECU_ADDRESS 0x7000083D /end MEASUREMENT
/begin MEASUREMENT EGSDO2_flgRstExhMIntglOffsFastB1 "Reset conditions for massflow debouncing" UBYTE B_TRUE 1 100 0.00 1.00000000000 BIT_MASK 0x1 FORMAT "%13.11" ECU_ADDRESS 0x70000287 /end MEASUREMENT
/begin MEASUREMENT EGSDO2_flgRtlStepChgS1B1 "Sudden deterioration detected (so called step change)" UBYTE B_TRUE 1 100 0.00 1.00000000000 BIT_MASK 0x1 FORMAT "%13.11" ECU_ADDRESS 0x7000083C /end MEASUREMENT
/begin MEASUREMENT EGSDO2_flgStepLtrEvlnS1B1 "Step response measurement in lean-rich direction evaluated (sensor 1, bank 1)" UBYTE B_TRUE 1 100 0.00 1.00000000000 BIT_MASK 0x1 FORMAT "%13.11" ECU_ADDRESS 0x7000083B /end MEASUREMENT
/begin MEASUREMENT EGSDO2_flgStepRtlEvlnS1B1 "Step response measurement in rich-lean direction evaluated (sensor 1, bank 1)" UBYTE B_TRUE 1 100 0.00 1.00000000000 BIT_MASK 0x1 FORMAT "%13.11" ECU_ADDRESS 0x7000083A /end MEASUREMENT
/begin MEASUREMENT EGSDO2_flgSymTranOnly "Lambda dynamics diagnosis with symmetric transition time only (1 error pattern)" UBYTE B_TRUE 1 100 0.00 1.00000000000 BIT_MASK 0x1 FORMAT "%13.11" ECU_ADDRESS 0x70000839 /end MEASUREMENT
/begin MEASUREMENT EGSDO2_flgTranSlowB1 "Transition time unequal to 0 detected in Lambda signal, bank1" UBYTE B_TRUE 1 100 0.00 1.00000000000 BIT_MASK 0x1 FORMAT "%13.11" ECU_ADDRESS 0x70000296 /end MEASUREMENT
/begin MEASUREMENT EGSDO2_IdnSigB1_I.flgBpWide "Class for identification signals for lambda-based dynamics diagnosis of a wideband-sensor / Wide bandpass active" UBYTE B_TRUE 1 100 0.00 1.00000000000 BIT_MASK 0x1 FORMAT "%13.11" ECU_ADDRESS 0x500013C0 /end MEASUREMENT
/begin MEASUREMENT EGSDO2_IdnSigB1_I.ratLamRecprBp "Class for identification signals for lambda-based dynamics diagnosis of a wideband-sensor / Reciprocal lambda (bandpass filtered)" SWORD fak_q3p0518Em5 1 100 -1.000000 0.999969 FORMAT "%8.6" ECU_ADDRESS 0x500013C2 /end MEASUREMENT
/begin MEASUREMENT EGSDO2_IdnSigB1_I.ratLamRecprBpLtr "Class for identification signals for lambda-based dynamics diagnosis of a wideband-sensor / Reciprocal lambda (bandpass filtered in lean-rich direction)" UWORD fak_q3p0518Em5 1 100 0.00 1.999969 FORMAT "%8.6" ECU_ADDRESS 0x500013C4 /end MEASUREMENT
/begin MEASUREMENT EGSDO2_IdnSigB1_I.ratLamRecprBpRtl "Class for identification signals for lambda-based dynamics diagnosis of a wideband-sensor / Reciprocal lambda (bandpass filtered in rich-lean direction)" UWORD fak_q3p0518Em5 1 100 0.00 1.999969 FORMAT "%8.6" ECU_ADDRESS 0x500013C6 /end MEASUREMENT
/begin MEASUREMENT EGSDO2_IdnSigB1_I.ratLamRecprMdl "Class for identification signals for lambda-based dynamics diagnosis of a wideband-sensor / Reciprocal modelled lambda" UWORD fak_q3p0518Em5 1 100 0.00 1.999969 FORMAT "%8.6" ECU_ADDRESS 0x500013C8 /end MEASUREMENT
/begin MEASUREMENT EGSDO2_IdnSigB1_I.ratLamRecprMdlBp "Class for identification signals for lambda-based dynamics diagnosis of a wideband-sensor / Reciprocal modelled lambda (bandpass filtered)" SWORD fak_q3p0518Em5 1 100 -1.000000 0.999969 FORMAT "%8.6" ECU_ADDRESS 0x500013CA /end MEASUREMENT
/begin MEASUREMENT EGSDO2_IdnSigB1_I.ratLamRecprMdlBpLtr "Class for identification signals for lambda-based dynamics diagnosis of a wideband-sensor / Reciprocal modelled lambda (bandpass filtered in lean-rich direction)" UWORD fak_q3p0518Em5 1 100 0.00 1.999969 FORMAT "%8.6" ECU_ADDRESS 0x500013CC /end MEASUREMENT
/begin MEASUREMENT EGSDO2_IdnSigB1_I.ratLamRecprMdlBpRtl "Class for identification signals for lambda-based dynamics diagnosis of a wideband-sensor / Reciprocal modelled lambda (bandpass filtered in rich-lean direction)" UWORD fak_q3p0518Em5 1 100 0.00 1.999969 FORMAT "%8.6" ECU_ADDRESS 0x500013CE /end MEASUREMENT
/begin MEASUREMENT EGSDO2_IdnSigB1_I.ratLamRecprMdlChmb "Class for identification signals for lambda-based dynamics diagnosis of a wideband-sensor / Reciprocal modelled lambda in combustion chamber" UWORD fak_q3p0518Em5 1 100 0.00 1.999969 FORMAT "%8.6" ECU_ADDRESS 0x500013D0 /end MEASUREMENT
/begin MEASUREMENT EGSDO2_IdnSigB1_I.ratLamRecprMdlFlt "Class for identification signals for lambda-based dynamics diagnosis of a wideband-sensor / Reciprocal modelled lambda with fault model" UWORD fak_q3p0518Em5 1 100 0.00 1.999969 FORMAT "%8.6" ECU_ADDRESS 0x500013D2 /end MEASUREMENT
/begin MEASUREMENT EGSDO2_IdnSigB1_I.ratLamRecprMdlFltBp "Class for identification signals for lambda-based dynamics diagnosis of a wideband-sensor / Reciprocal modelled lambda with fault model (bandpass filtered)" SWORD fak_q3p0518Em5 1 100 -1.000000 0.999969 FORMAT "%8.6" ECU_ADDRESS 0x500013D4 /end MEASUREMENT
/begin MEASUREMENT EGSDO2_IdnSigB1_I.ratLamRecprMdlFltBpLtr "Class for identification signals for lambda-based dynamics diagnosis of a wideband-sensor / Reciprocal modelled lambda with fault model (bandpass filtered in lean-rich direction)" UWORD fak_q3p0518Em5 1 100 0.00 1.999969 FORMAT "%8.6" ECU_ADDRESS 0x500013D6 /end MEASUREMENT
/begin MEASUREMENT EGSDO2_IdnSigB1_I.ratLamRecprMdlFltBpRtl "Class for identification signals for lambda-based dynamics diagnosis of a wideband-sensor / Reciprocal modelled lambda with fault model (bandpass filtered in rich-lean direction)" UWORD fak_q3p0518Em5 1 100 0.00 1.999969 FORMAT "%8.6" ECU_ADDRESS 0x500013D8 /end MEASUREMENT
/begin MEASUREMENT EGSDO2_IdnSigB1_I.ratLamRecprSpChmbCorrd "Class for identification signals for lambda-based dynamics diagnosis of a wideband-sensor / Reciprocal lambda set point in combustion chamber (corrected due to EGR)" ULONG fak_uw_b1 1 100 0.00 65535.9999847 FORMAT "%13.7" ECU_ADDRESS 0x500013DC /end MEASUREMENT
/begin MEASUREMENT EGSDO2_IdnSigB1_I.LamLtrFF_I.status "Class for identification signals for lambda-based dynamics diagnosis of a wideband-sensor / . / current value of RS-FF" UBYTE B_TRUE 1 100 0.00 1.00000000000 BIT_MASK 0x1 FORMAT "%13.11" ECU_ADDRESS 0x500013E0 /end MEASUREMENT
/begin MEASUREMENT EGSDO2_IdnSigB1_I.MdlAsymLT_I.memory "Class for identification signals for lambda-based dynamics diagnosis of a wideband-sensor / Lowpass of asymmetric fault model / current lowpass value" ULONG fak_q4p6566Em10 1 100 0.00 1.999999999534339 FORMAT "%17.15" ECU_ADDRESS 0x50001414 /end MEASUREMENT
/begin MEASUREMENT EGSDO2_IdnSigB1_I.MdlAsymPreFilLT_I.memory "Class for identification signals for lambda-based dynamics diagnosis of a wideband-sensor / Prefilter of asymmetric fault model / current lowpass value" ULONG fak_q4p6566Em10 1 100 0.00 1.999999999534339 FORMAT "%17.15" ECU_ADDRESS 0x50001418 /end MEASUREMENT
/begin MEASUREMENT EGSDO2_IdnSigB1_I.SlopChgEBNM_I.oldSignal "Class for identification signals for lambda-based dynamics diagnosis of a wideband-sensor / Falling and rising edge to detect change in slope direction / EdgeBiNoMem.oldsignal" UBYTE B_TRUE 1 100 0.00 1.00000000000 BIT_MASK 0x1 FORMAT "%13.11" ECU_ADDRESS 0x5000141C /end MEASUREMENT
/begin MEASUREMENT EGSDO2_IdnSigB1_I.dratLamRecprFildLT_I.memory "Class for identification signals for lambda-based dynamics diagnosis of a wideband-sensor / Lowpass (PT1) for derivative of measured reciprocal lambda / current lowpass value" SLONG fak_q4p6566Em10 1 100 -1.000000000000000 0.999999999534339 FORMAT "%17.15" ECU_ADDRESS 0x50001420 /end MEASUREMENT
/begin MEASUREMENT EGSDO2_IdnSigB1_I.ratLamRecprMdlChmbLT_I.memory "Class for identification signals for lambda-based dynamics diagnosis of a wideband-sensor / Lowpass for reciprocal modelled lambda in combustion chamber / current lowpass value" ULONG fak_q4p6566Em10 1 100 0.00 1.999999999534339 FORMAT "%17.15" ECU_ADDRESS 0x50001454 /end MEASUREMENT
/begin MEASUREMENT EGSDO2_IdnSigB1_I.ratLamRecprMdlDt1LT_I.memory "Class for identification signals for lambda-based dynamics diagnosis of a wideband-sensor / Lowpass for filtered derivative of reciprocal modelled lambda / current lowpass value" ULONG fak_q4p6566Em10 1 100 0.00 1.999999999534339 FORMAT "%17.15" ECU_ADDRESS 0x50001458 /end MEASUREMENT
/begin MEASUREMENT EGSDO2_IdnSigB1_I.ratLamRecprMdlFltDt1LT_I.memory "Class for identification signals for lambda-based dynamics diagnosis of a wideband-sensor / Lowpass for filtered derivative of reciprocal modelled lambda with fault / current lowpass value" ULONG fak_q4p6566Em10 1 100 0.00 1.999999999534339 FORMAT "%17.15" ECU_ADDRESS 0x5000145C /end MEASUREMENT
/begin MEASUREMENT EGSDO2_IdnSigB1_I.ratLamRecprMdlFltLT_I.memory "Class for identification signals for lambda-based dynamics diagnosis of a wideband-sensor / Lowpass for reciprocal modelled lambda with fault / current lowpass value" ULONG fak_q4p6566Em10 1 100 0.00 1.999999999534339 FORMAT "%17.15" ECU_ADDRESS 0x50001460 /end MEASUREMENT
/begin MEASUREMENT EGSDO2_IdnSigB1_I.ratLamRecprMdlLT_I.memory "Class for identification signals for lambda-based dynamics diagnosis of a wideband-sensor / Lowpass for reciprocal modelled lambda / current lowpass value" ULONG fak_q4p6566Em10 1 100 0.00 1.999999999534339 FORMAT "%17.15" ECU_ADDRESS 0x50001464 /end MEASUREMENT
/begin MEASUREMENT EGSDO2_LamDynAdpnCalcB1_I.flgDynLtr "Class for the calculation of the plant parameter / Adaption in lean to rich direction" UBYTE B_TRUE 1 100 0.00 1.00000000000 BIT_MASK 0x1 FORMAT "%13.11" ECU_ADDRESS 0x6003661E /end MEASUREMENT
/begin MEASUREMENT EGSDO2_LamDynAdpnCalcB1_I.flgDynRtl "Class for the calculation of the plant parameter / Adaption in rich to lean direction" UBYTE B_TRUE 1 100 0.00 1.00000000000 BIT_MASK 0x1 FORMAT "%13.11" ECU_ADDRESS 0x6003661F /end MEASUREMENT
/begin MEASUREMENT EGSDO2_LamDynAdpnCalcB1_I.flgIdnDne "Class for the calculation of the plant parameter / Online identification adaption done" UBYTE B_TRUE 1 100 0.00 1.00000000000 BIT_MASK 0x1 FORMAT "%13.11" ECU_ADDRESS 0x50001468 /end MEASUREMENT
/begin MEASUREMENT EGSDO2_LamDynAdpnCalcB1_I.flgIdnEvln "Class for the calculation of the plant parameter / Evaluate online identification adaption" UBYTE B_TRUE 1 100 0.00 1.00000000000 BIT_MASK 0x1 FORMAT "%13.11" ECU_ADDRESS 0x50001469 /end MEASUREMENT
/begin MEASUREMENT EGSDO2_LamDynAdpnCalcB1_I.flgIdnFirstDne "Class for the calculation of the plant parameter / first online identification adaption evaluation done" UBYTE B_TRUE 1 100 0.00 1.00000000000 BIT_MASK 0x1 FORMAT "%13.11" ECU_ADDRESS 0x5000146A /end MEASUREMENT
/begin MEASUREMENT EGSDO2_LamDynAdpnCalcB1_I.flgIdnMax "Class for the calculation of the plant parameter / Maximum adaption time for the online identification reached" UBYTE B_TRUE 1 100 0.00 1.00000000000 BIT_MASK 0x1 FORMAT "%13.11" ECU_ADDRESS 0x5000146B /end MEASUREMENT
/begin MEASUREMENT EGSDO2_LamDynAdpnCalcB1_I.flgStepDlyLtr "Class for the calculation of the plant parameter / Trigger for the delay time lean to rich" UBYTE B_TRUE 1 100 0.00 1.00000000000 BIT_MASK 0x1 FORMAT "%13.11" ECU_ADDRESS 0x5000146C /end MEASUREMENT
/begin MEASUREMENT EGSDO2_LamDynAdpnCalcB1_I.flgStepDlyRtl "Class for the calculation of the plant parameter / Trigger for the delay time rich to lean" UBYTE B_TRUE 1 100 0.00 1.00000000000 BIT_MASK 0x1 FORMAT "%13.11" ECU_ADDRESS 0x5000146D /end MEASUREMENT
/begin MEASUREMENT EGSDO2_LamDynAdpnCalcB1_I.flgStepDlySym "Class for the calculation of the plant parameter / Trigger for the delay time symmetrical" UBYTE B_TRUE 1 100 0.00 1.00000000000 BIT_MASK 0x1 FORMAT "%13.11" ECU_ADDRESS 0x5000146E /end MEASUREMENT
/begin MEASUREMENT EGSDO2_LamDynAdpnCalcB1_I.flgStepEvln "Class for the calculation of the plant parameter / Step adaption evaluate" UBYTE B_TRUE 1 100 0.00 1.00000000000 BIT_MASK 0x1 FORMAT "%13.11" ECU_ADDRESS 0x5000146F /end MEASUREMENT
/begin MEASUREMENT EGSDO2_LamDynAdpnCalcB1_I.flgStepLtr "Class for the calculation of the plant parameter / Step adaption lean to rich" UBYTE B_TRUE 1 100 0.00 1.00000000000 BIT_MASK 0x1 FORMAT "%13.11" ECU_ADDRESS 0x50001470 /end MEASUREMENT
/begin MEASUREMENT EGSDO2_LamDynAdpnCalcB1_I.flgStepLtrDne "Class for the calculation of the plant parameter / Step adaption rich to lean evaluate" UBYTE B_TRUE 1 100 0.00 1.00000000000 BIT_MASK 0x1 FORMAT "%13.11" ECU_ADDRESS 0x50001471 /end MEASUREMENT
/begin MEASUREMENT EGSDO2_LamDynAdpnCalcB1_I.flgStepRtl "Class for the calculation of the plant parameter / Step adaption rich to lean" UBYTE B_TRUE 1 100 0.00 1.00000000000 BIT_MASK 0x1 FORMAT "%13.11" ECU_ADDRESS 0x50001472 /end MEASUREMENT
/begin MEASUREMENT EGSDO2_LamDynAdpnCalcB1_I.flgStepRtlDne "Class for the calculation of the plant parameter / Step adaption rich to lean evaluate" UBYTE B_TRUE 1 100 0.00 1.00000000000 BIT_MASK 0x1 FORMAT "%13.11" ECU_ADDRESS 0x50001473 /end MEASUREMENT
/begin MEASUREMENT EGSDO2_LamDynAdpnCalcB1_I.flgStepSym "Class for the calculation of the plant parameter / Step adaption symmetrical" UBYTE B_TRUE 1 100 0.00 1.00000000000 BIT_MASK 0x1 FORMAT "%13.11" ECU_ADDRESS 0x50001474 /end MEASUREMENT
/begin MEASUREMENT EGSDO2_LamDynAdpnCalcB1_I.stStep "Class for the calculation of the plant parameter / Detected error pattern" UBYTE dez 1 100 0.00 255.0 FORMAT "%5.1" ECU_ADDRESS 0x50001475 /end MEASUREMENT
/begin MEASUREMENT EGSDO2_LamDynAdpnCalcB1_I.tiDly "Class for the calculation of the plant parameter / Delay time" UWORD t_q0p01 1 100 0.00 655.3500 FORMAT "%8.4" ECU_ADDRESS 0x60036620 /end MEASUREMENT
/begin MEASUREMENT EGSDO2_LamDynAdpnCalcB1_I.tiDlyNotFild "Class for the calculation of the plant parameter / Delay time unfiltered" UWORD t_q0p01 1 100 0.00 655.3500 FORMAT "%8.4" ECU_ADDRESS 0x50001476 /end MEASUREMENT
/begin MEASUREMENT EGSDO2_LamDynAdpnCalcB1_I.tiSumTran "Class for the calculation of the plant parameter / Symmetrical transition time" UWORD t_q0p01 1 100 0.00 655.3500 FORMAT "%8.4" ECU_ADDRESS 0x50001478 /end MEASUREMENT
/begin MEASUREMENT EGSDO2_LamDynAdpnCalcB1_I.tiTran "Class for the calculation of the plant parameter / Transition time for adaptation" UWORD t_q0p01 1 100 0.00 655.3500 FORMAT "%8.4" ECU_ADDRESS 0x60036622 /end MEASUREMENT
/begin MEASUREMENT EGSDO2_LamDynAdpnCalcB1_I.tiTranNotFild "Class for the calculation of the plant parameter / Transition time for adaptation unfiltered" UWORD t_q0p01 1 100 0.00 655.3500 FORMAT "%8.4" ECU_ADDRESS 0x5000147A /end MEASUREMENT
/begin MEASUREMENT EGSDO2_LamDynAdpnCalcB1_I.AdpnFilDlyLT_I.memory "Class for the calculation of the plant parameter / Filter of the delay adaption time / current lowpass value" ULONG q1p5259Em7_s 1 100 0.00 655.359999847 FORMAT "%13.9" ECU_ADDRESS 0x5000147C /end MEASUREMENT
/begin MEASUREMENT EGSDO2_LamDynAdpnCalcB1_I.AdpnFilTranLT_I.memory "Class for the calculation of the plant parameter / Filter of the transition adaption time / current lowpass value" ULONG q1p5259Em7_s 1 100 0.00 655.359999847 FORMAT "%13.9" ECU_ADDRESS 0x50001480 /end MEASUREMENT
/begin MEASUREMENT EGSDO2_LamDynAdpnCalcB1_I.tiEnaIdnLtrSWE_I.timeCounter "Class for the calculation of the plant parameter / Time of the necessary adaption time of the online identification lean to rich / Elapsed time since start" UWORD t_q0p1 1 100 0.00 6553.500 FORMAT "%8.3" ECU_ADDRESS 0x50001484 /end MEASUREMENT
/begin MEASUREMENT EGSDO2_LamDynAdpnCalcB1_I.tiEnaIdnRtlSWE_I.timeCounter "Class for the calculation of the plant parameter / Time of the necessary adaption time of the online identification rich to lean / Elapsed time since start" UWORD t_q0p1 1 100 0.00 6553.500 FORMAT "%8.3" ECU_ADDRESS 0x50001486 /end MEASUREMENT
/begin MEASUREMENT EGSDO2_LamDynAdpnInhbS1B1ER_I.buffer "Trigger adaption inhibition / rising edge detected" UBYTE B_TRUE 1 100 0.00 1.00000000000 BIT_MASK 0x1 FORMAT "%13.11" ECU_ADDRESS 0x60003B3C /end MEASUREMENT
/begin MEASUREMENT EGSDO2_LamDynAdpnInhbS1B1ER_I.oldSignal "Trigger adaption inhibition / flag rising edge" UBYTE B_TRUE 1 100 0.00 1.00000000000 BIT_MASK 0x1 FORMAT "%13.11" ECU_ADDRESS 0x60003B3D /end MEASUREMENT
/begin MEASUREMENT EGSDO2_LamDynNoInhb100msS1B1EFNM_I.oldSignal "DSM inhibit of lambda based dynamics diagnostic revoked (edge falling, 100ms task) (sensor 1, bank 1) / memory to detect falling edge" UBYTE B_TRUE 1 100 0.00 1.00000000000 BIT_MASK 0x1 FORMAT "%13.11" ECU_ADDRESS 0x60006575 /end MEASUREMENT
/begin MEASUREMENT EGSDO2_LamDynNoInhbS1B1EF_I.buffer "DSM inhibit of lambda based dynamics diagnostic revoked (edge falling) (sensor 1, bank 1) / memory to detect falling edge" UBYTE B_TRUE 1 100 0.00 1.00000000000 BIT_MASK 0x1 FORMAT "%13.11" ECU_ADDRESS 0x60003B44 /end MEASUREMENT
/begin MEASUREMENT EGSDO2_LamDynNoInhbS1B1EF_I.oldSignal "DSM inhibit of lambda based dynamics diagnostic revoked (edge falling) (sensor 1, bank 1) / memory to detect falling edge" UBYTE B_TRUE 1 100 0.00 1.00000000000 BIT_MASK 0x1 FORMAT "%13.11" ECU_ADDRESS 0x60003B45 /end MEASUREMENT
/begin MEASUREMENT EGSDO2_NEngTONV_I.outbit "TurnOn Delay engine speed / return value" UBYTE B_TRUE 1 100 0.00 1.00000000000 BIT_MASK 0x1 FORMAT "%13.11" ECU_ADDRESS 0x60003B2A /end MEASUREMENT
/begin MEASUREMENT EGSDO2_NEngTONV_I.time "TurnOn Delay engine speed / expired delay time" UBYTE t_q0p1 1 100 0.00 25.50 FORMAT "%5.2" ECU_ADDRESS 0x60003B2B /end MEASUREMENT
/begin MEASUREMENT EGSDO2_NoCatPurgOffsB1FF_I.status "switch to minimal exhaust mass threshold if no catalyst purge donebefore / current value of RS-FF" UBYTE B_TRUE 1 100 0.00 1.00000000000 BIT_MASK 0x1 FORMAT "%13.11" ECU_ADDRESS 0x6000656D /end MEASUREMENT
/begin MEASUREMENT EGSDO2_nrMeasLtrTrpS1B1 "Number of step response measurements in lean-rich direction for driving cycle (sensor 1, bank 1)" UBYTE dez 1 100 0.00 255.0 FORMAT "%5.1" ECU_ADDRESS 0x6000E410 /end MEASUREMENT
/begin MEASUREMENT EGSDO2_nrMeasRtlTrpS1B1 "Number of step response measurements in rich-lean direction for driving cycle (sensor 1, bank 1)" UBYTE dez 1 100 0.00 255.0 FORMAT "%5.1" ECU_ADDRESS 0x6000E411 /end MEASUREMENT
/begin MEASUREMENT EGSDO2_QlyDeFltSuspcB1FF_I.status "Error suspicion of the loss function / current value of RS-FF" UBYTE B_TRUE 1 100 0.00 1.00000000000 BIT_MASK 0x1 FORMAT "%13.11" ECU_ADDRESS 0x60006574 /end MEASUREMENT
/begin MEASUREMENT EGSDO2_ralLamOffsDeltaExchS1B1_s32 "Delta lambda offset for neutral exchange of I-part of lambda controller downstream catalyst (sensor 1, bank 1)" SLONG fak_sl_b1 1 100 -1.00000000000 0.99999999953 FORMAT "%13.11" ECU_ADDRESS 0x60001C20 /end MEASUREMENT
/begin MEASUREMENT EGSDO2_ratLamOffsFastDeltaS1B1 "Fast adaptation step for lambda offset (sensor 1, bank 1)" SWORD fak_sw_b1 1 100 -1.000000 0.999969 FORMAT "%8.6" ECU_ADDRESS 0x60004B12 /end MEASUREMENT
/begin MEASUREMENT EGSDO2_ratLamOffsFastPredS1B1 "expected Lambda offset" SWORD fak_sw_b1 1 100 -1.000000 0.999969 FORMAT "%8.6" ECU_ADDRESS 0x6000E1BC /end MEASUREMENT
/begin MEASUREMENT EGSDO2_ratLamOffsPredRawB1 "predicted Offset" SWORD fak_sw_b1 1 100 -1.000000 0.999969 FORMAT "%8.6" ECU_ADDRESS 0x6000D89C /end MEASUREMENT
/begin MEASUREMENT EGSDO2_ratLamOffsS1B1 "Lambda offset (sensor 1, bank 1)" SWORD fak_sw_b1 1 100 -1.000000 0.999969 FORMAT "%8.6" ECU_ADDRESS 0x6000E1BE /end MEASUREMENT
/begin MEASUREMENT EGSDO2_ratLamOffsSrvS1B1 "Lambda offset for Service 01 (sensor 1, bank 1)" SWORD fak_sw_b1 1 100 -1.000000 0.999969 FORMAT "%8.6" ECU_ADDRESS 0x6000E1C0 /end MEASUREMENT
/begin MEASUREMENT EGSDO2_ratLamRecprBpLtrS1B1 "Reciprocal lambda (bandpass filtered in lean-rich direction)" UWORD fak_q3p0518Em5 1 100 0.00 1.999969 FORMAT "%8.6" ECU_ADDRESS 0x60004CFE /end MEASUREMENT
/begin MEASUREMENT EGSDO2_ratLamRecprBpRtlS1B1 "Reciprocal lambda (bandpass filtered in rich-lean direction)" UWORD fak_q3p0518Em5 1 100 0.00 1.999969 FORMAT "%8.6" ECU_ADDRESS 0x60004CFC /end MEASUREMENT
/begin MEASUREMENT EGSDO2_ratLamRecprBpS1B1 "Reciprocal lambda (bandpass filtered)" SWORD fak_q3p0518Em5 1 100 -1.000000 0.999969 FORMAT "%8.6" ECU_ADDRESS 0x600050FC /end MEASUREMENT
/begin MEASUREMENT EGSDO2_ratLamRecprFildS1B1 "Reciprocal lambda (filtered)" UWORD fak_q3p0518Em5 1 100 0.00 1.999969 FORMAT "%8.6" ECU_ADDRESS 0x60004CFA /end MEASUREMENT
/begin MEASUREMENT EGSDO2_ratLamRecprMdlBpLtrS1B1 "modelbased reciprocal lambda lean to rich" UWORD fak_q3p0518Em5 1 100 0.00 1.999969 FORMAT "%8.6" ECU_ADDRESS 0x6000E1C2 /end MEASUREMENT
/begin MEASUREMENT EGSDO2_ratLamRecprMdlBpRtlS1B1 "modelbased reciprocal lambda rich to lean" UWORD fak_q3p0518Em5 1 100 0.00 1.999969 FORMAT "%8.6" ECU_ADDRESS 0x60004CF8 /end MEASUREMENT
/begin MEASUREMENT EGSDO2_ratLamRecprMdlBpS1B1 "Reciprocal modelled lambda (bandpass filtered)" SWORD fak_q3p0518Em5 1 100 -1.000000 0.999969 FORMAT "%8.6" ECU_ADDRESS 0x600050FA /end MEASUREMENT
/begin MEASUREMENT EGSDO2_ratLamRecprMdlFltBpLtrS1B1 "Reciprocal modelled lambda with fault model (bandpass filtered in lean-rich direction)" UWORD fak_q3p0518Em5 1 100 0.00 1.999969 FORMAT "%8.6" ECU_ADDRESS 0x60004CF6 /end MEASUREMENT
/begin MEASUREMENT EGSDO2_ratLamRecprMdlFltBpRtlS1B1 "Reciprocal modelled lambda with fault model (bandpass filtered in rich-lean direction)" UWORD fak_q3p0518Em5 1 100 0.00 1.999969 FORMAT "%8.6" ECU_ADDRESS 0x60004CF4 /end MEASUREMENT
/begin MEASUREMENT EGSDO2_ratLamRecprMdlFltBpS1B1 "Reciprocal modelled lambda with fault model (bandpass filtered)" SWORD fak_q3p0518Em5 1 100 -1.000000 0.999969 FORMAT "%8.6" ECU_ADDRESS 0x600050F8 /end MEASUREMENT
/begin MEASUREMENT EGSDO2_ratLamRecprStepHeiB1 "Step height in reciprocal lambda, bank1" UWORD fak_uw_b2 1 100 0.00 1.999969 FORMAT "%8.6" ECU_ADDRESS 0x6000D89E /end MEASUREMENT
/begin MEASUREMENT EGSDO2_RstAdpnDynB1FF_I.status "Reset of the adaption and evaluation values / current value of RS-FF" UBYTE B_TRUE 1 100 0.00 1.00000000000 BIT_MASK 0x1 FORMAT "%13.11" ECU_ADDRESS 0x60006573 /end MEASUREMENT
/begin MEASUREMENT EGSDO2_SnsrMntdDiagS1B1_I.flgDSMClrReq "SnsrMntdDiag Class sensor 1 bank 1 / Condition DSM clear" UBYTE B_TRUE 1 100 0.00 1.00000000000 BIT_MASK 0x1 FORMAT "%13.11" ECU_ADDRESS 0x60003B20 /end MEASUREMENT
/begin MEASUREMENT EGSDO2_SnsrMntdDiagS1B1_I.flgErr "SnsrMntdDiag Class sensor 1 bank 1 / error detected" UBYTE B_TRUE 1 100 0.00 1.00000000000 BIT_MASK 0x1 FORMAT "%13.11" ECU_ADDRESS 0x60003B21 /end MEASUREMENT
/begin MEASUREMENT EGSDO2_SnsrMntdDiagS1B1_I.flgRdy "SnsrMntdDiag Class sensor 1 bank 1 / function ready for diagnose" UBYTE B_TRUE 1 100 0.00 1.00000000000 BIT_MASK 0x1 FORMAT "%13.11" ECU_ADDRESS 0x60003B22 /end MEASUREMENT
/begin MEASUREMENT EGSDO2_SnsrMntdDiagS1B1_I.flgRels "SnsrMntdDiag Class sensor 1 bank 1 / result exist" UBYTE B_TRUE 1 100 0.00 1.00000000000 BIT_MASK 0x1 FORMAT "%13.11" ECU_ADDRESS 0x60003B23 /end MEASUREMENT
/begin MEASUREMENT EGSDO2_SnsrMntdDiagS1B1_I.flgRes "SnsrMntdDiag Class sensor 1 bank 1 / result exist" UBYTE B_TRUE 1 100 0.00 1.00000000000 BIT_MASK 0x1 FORMAT "%13.11" ECU_ADDRESS 0x60003B24 /end MEASUREMENT
/begin MEASUREMENT EGSDO2_SnsrMntdDiagS1B1_I.SnsrMntdDiagNoErrTONV_I.outbit "SnsrMntdDiag Class sensor 1 bank 1 / Debouncing of no error / return value" UBYTE B_TRUE 1 100 0.00 1.00000000000 BIT_MASK 0x1 FORMAT "%13.11" ECU_ADDRESS 0x60003B26 /end MEASUREMENT
/begin MEASUREMENT EGSDO2_SnsrMntdDiagS1B1_I.SnsrMntdDiagNoErrTONV_I.time "SnsrMntdDiag Class sensor 1 bank 1 / Debouncing of no error / expired delay time" UBYTE t_q0p1 1 100 0.00 25.50 FORMAT "%5.2" ECU_ADDRESS 0x60003B27 /end MEASUREMENT
/begin MEASUREMENT EGSDO2_SnsrMntdDiagS1B1_I.SnsrMntdErrSuspcTONV_I.outbit "SnsrMntdDiag Class sensor 1 bank 1 / Debouncing of error suspicion / return value" UBYTE B_TRUE 1 100 0.00 1.00000000000 BIT_MASK 0x1 FORMAT "%13.11" ECU_ADDRESS 0x60003B28 /end MEASUREMENT
/begin MEASUREMENT EGSDO2_SnsrMntdDiagS1B1_I.SnsrMntdErrSuspcTONV_I.time "SnsrMntdDiag Class sensor 1 bank 1 / Debouncing of error suspicion / expired delay time" UBYTE t_q0p1 1 100 0.00 25.50 FORMAT "%5.2" ECU_ADDRESS 0x60003B29 /end MEASUREMENT
/begin MEASUREMENT EGSDO2_StepIf.dratLamRecprFild "class instance for step resond measurement signals / Temporary variable in interface class" SWORD freq_q9p1553Em5 1 100 -3.000000 2.999908 FORMAT "%8.6" ECU_ADDRESS 0x6000D888 /end MEASUREMENT
/begin MEASUREMENT EGSDO2_StepIf.flgTranSlow "class instance for step resond measurement signals / LSU Dynamic transition error is recognized" UBYTE B_TRUE 1 100 0.00 1.00000000000 BIT_MASK 0x1 FORMAT "%13.11" ECU_ADDRESS 0x6000D88A /end MEASUREMENT
/begin MEASUREMENT EGSDO2_StepIf.lamsbg_w "class instance for step resond measurement signals / Temporary variable in interface class" UWORD fak_uw_b16 1 100 0.00 15.99976 FORMAT "%8.5" ECU_ADDRESS 0x6000D88C /end MEASUREMENT
/begin MEASUREMENT EGSDO2_StepIf.ratLamRecprFild "class instance for step resond measurement signals / Temporary variable in interface class" UWORD fak_uw_b2 1 100 0.00 1.999969 FORMAT "%8.6" ECU_ADDRESS 0x6000D88E /end MEASUREMENT
/begin MEASUREMENT EGSDO2_StepIf.ratLamRecprStepHei "class instance for step resond measurement signals / Step height in reciprocal lambda" UWORD fak_uw_b2 1 100 0.00 1.999969 FORMAT "%8.6" ECU_ADDRESS 0x6000D890 /end MEASUREMENT
/begin MEASUREMENT EGSDO2_StepIf.stLamGenrParl "class instance for step resond measurement signals / Temporary variable in interface class" UBYTE OneToOne 1 100 0.00 255.0 FORMAT "%5.1" ECU_ADDRESS 0x6000D892 /end MEASUREMENT
/begin MEASUREMENT EGSDO2_StepIf.tlrslb_w "class instance for step resond measurement signals / Temporary variable in interface class" UWORD t_q0p01 1 100 0.0100 655.3500 FORMAT "%8.4" ECU_ADDRESS 0x6000D894 /end MEASUREMENT
/begin MEASUREMENT EGSDO2_StepIf.zlrslb_w "class instance for step resond measurement signals / Temporary variable in interface class" UWORD t_q0p01 1 100 0.0100 655.3500 FORMAT "%8.4" ECU_ADDRESS 0x6000D896 /end MEASUREMENT
/begin MEASUREMENT EGSDO2_StepStateB1_I.flgDynStepLtrReset "Calculation in which State the step measurement should be calulate / Reset of Step Measurment Ltr" UBYTE B_TRUE 1 100 0.00 1.00000000000 BIT_MASK 0x1 FORMAT "%13.11" ECU_ADDRESS 0x60003B3E /end MEASUREMENT
/begin MEASUREMENT EGSDO2_StepStateB1_I.flgDynStepLtrSet "Calculation in which State the step measurement should be calulate / start of Measurement Rtl" UBYTE B_TRUE 1 100 0.00 1.00000000000 BIT_MASK 0x1 FORMAT "%13.11" ECU_ADDRESS 0x60003B3F /end MEASUREMENT
/begin MEASUREMENT EGSDO2_StepStateB1_I.flgDynStepRtlReset "Calculation in which State the step measurement should be calulate / Reset of Step Measurment Rtl" UBYTE B_TRUE 1 100 0.00 1.00000000000 BIT_MASK 0x1 FORMAT "%13.11" ECU_ADDRESS 0x60003B40 /end MEASUREMENT
/begin MEASUREMENT EGSDO2_StepStateB1_I.flgDynStepRtlSet "Calculation in which State the step measurement should be calulate / start of Measurement Rtl" UBYTE B_TRUE 1 100 0.00 1.00000000000 BIT_MASK 0x1 FORMAT "%13.11" ECU_ADDRESS 0x60003B41 /end MEASUREMENT
/begin MEASUREMENT EGSDO2_stStepB1 "Status of step response measurement (detected pattern, bank 1)" UBYTE OneToOne 1 100 0.00 255.0 FORMAT "%5.1" ECU_ADDRESS 0x6000A074 /end MEASUREMENT
/begin MEASUREMENT EGSDO2_stStepNVB1 "Status of the pattern detection" UBYTE OneToOne 1 100 0.00 255.0 FORMAT "%5.1" ECU_ADDRESS 0x60036624 /end MEASUREMENT
/begin MEASUREMENT EGSDO2_tiDlyAdpnS1B1 "Upstream sensor delay time used for dynamics adaptation (sensor 1, bank 1)" UWORD t_q0p01 1 100 0.00 655.3500 FORMAT "%8.4" ECU_ADDRESS 0x60004910 /end MEASUREMENT
/begin MEASUREMENT EGSDO2_tiDlyIdnLtrB1 "Identified delay time in lean-rich direction (bank 1)" UWORD t_q0p01 1 100 0.00 655.3500 FORMAT "%8.4" ECU_ADDRESS 0x60004CF2 /end MEASUREMENT
/begin MEASUREMENT EGSDO2_tiDlyIdnRtlB1 "Identified delay time in rich-lean direction (bank 1)" UWORD t_q0p01 1 100 0.00 655.3500 FORMAT "%8.4" ECU_ADDRESS 0x60004CF0 /end MEASUREMENT
/begin MEASUREMENT EGSDO2_tiDlyLtrS1B1 "Delay time from step response measurement in lean-rich direction (sensor 1, bank 1)" UWORD t_q0p01 1 100 0.00 655.3500 FORMAT "%8.4" ECU_ADDRESS 0x6000E1C4 /end MEASUREMENT
/begin MEASUREMENT EGSDO2_tiDlyLtrStepS1B1 "Delay time from current step response measurement in lean-lean direction (sensor 1, bank 1)" SWORD t_q0p01 1 100 -327.6800 327.6700 FORMAT "%8.4" ECU_ADDRESS 0x60004B10 /end MEASUREMENT
/begin MEASUREMENT EGSDO2_tiDlyRtlS1B1 "Delay time from step response measurement in rich-lean direction (sensor 1, bank 1)" UWORD t_q0p01 1 100 0.00 655.3500 FORMAT "%8.4" ECU_ADDRESS 0x6000E1C6 /end MEASUREMENT
/begin MEASUREMENT EGSDO2_tiDlyRtlStepS1B1 "Delay time from current step response measurement in rich-lean direction (sensor 1, bank 1)" SWORD t_q0p01 1 100 -327.6800 327.6700 FORMAT "%8.4" ECU_ADDRESS 0x60004B0E /end MEASUREMENT
/begin MEASUREMENT EGSDO2_tiSumDeltaAdapS1B1 "Sum error difference of delay and transition between lean-rich and rich-lean" SWORD t_q0p01 1 100 -327.6800 327.6700 FORMAT "%8.4" ECU_ADDRESS 0x600050F6 /end MEASUREMENT
/begin MEASUREMENT EGSDO2_tiSumRefCtrlActvOffsFastB1 "Time activated cat control" UWORD t_q0p1 1 100 0.00 6553.500 FORMAT "%8.3" ECU_ADDRESS 0x60003B3A /end MEASUREMENT
/begin MEASUREMENT EGSDO2_tiTranAdpnS1B1 "Upstream sensor transition time used for dynamics adaptation (sensor 1, bank 1)" UWORD t_q0p01 1 100 0.00 655.3500 FORMAT "%8.4" ECU_ADDRESS 0x6000490A /end MEASUREMENT
/begin MEASUREMENT EGSDO2_tiTranIdnLtrB1 "Identified transition time in lean-rich direction (bank 1)" UWORD t_q0p01 1 100 0.00 655.3500 FORMAT "%8.4" ECU_ADDRESS 0x60004CEE /end MEASUREMENT
/begin MEASUREMENT EGSDO2_tiTranIdnRtlB1 "Identified transition time in rich-lean direction (bank 1)" UWORD t_q0p01 1 100 0.00 655.3500 FORMAT "%8.4" ECU_ADDRESS 0x60004CEC /end MEASUREMENT
/begin MEASUREMENT EGSDO2_tiTranLtrS1B1 "Transition time from step response measurement in lean-rich direction (sensor 1, bank 1)" UWORD t_q0p01 1 100 0.00 655.3500 FORMAT "%8.4" ECU_ADDRESS 0x6000E1C8 /end MEASUREMENT
/begin MEASUREMENT EGSDO2_tiTranLtrStepS1B1 "Transition time from current step response measurement in lean-lean direction (sensor 1, bank 1)" SWORD t_q0p01 1 100 -327.6800 327.6700 FORMAT "%8.4" ECU_ADDRESS 0x60004B0C /end MEASUREMENT
/begin MEASUREMENT EGSDO2_tiTranRtlS1B1 "Transition time from step response measurement in rich-lean direction (sensor 1, bank 1)" UWORD t_q0p01 1 100 0.00 655.3500 FORMAT "%8.4" ECU_ADDRESS 0x6000E1CA /end MEASUREMENT
/begin MEASUREMENT EGSDO2_tiTranRtlStepS1B1 "Transition time from current step response measurement in rich-lean direction (sensor 1, bank 1)" SWORD t_q0p01 1 100 -327.6800 327.6700 FORMAT "%8.4" ECU_ADDRESS 0x60004B0A /end MEASUREMENT
/begin MEASUREMENT IdnLossB1_I.facMdlFltDe "Class instance for loss function of identification for lambda-based dynamics diagnosis of a wideband-sensor (bank 1) / error model deviation" UWORD fak_uw_b4 1 100 0.00 3.999939 FORMAT "%8.6" ECU_ADDRESS 0x6000CD9C /end MEASUREMENT
/begin MEASUREMENT IdnLossB1_I.facMdlFltDeAvrg "Class instance for loss function of identification for lambda-based dynamics diagnosis of a wideband-sensor (bank 1) / average error model deviation" UWORD fak_uw_b128 1 100 0.00 127.9980 FORMAT "%8.4" ECU_ADDRESS 0x6000CD9E /end MEASUREMENT
/begin MEASUREMENT IdnLossB1_I.facMdlFltDeEvln "Class instance for loss function of identification for lambda-based dynamics diagnosis of a wideband-sensor (bank 1) / Fault model deviation" UWORD fak_uw_b128 1 100 0.00 127.9980 FORMAT "%8.4" ECU_ADDRESS 0x6000CDA0 /end MEASUREMENT
/begin MEASUREMENT IdnLossB1_I.facMdlFltQlySum "Class instance for loss function of identification for lambda-based dynamics diagnosis of a wideband-sensor (bank 1) / kumulated error model deviation" ULONG fak_uw_b4 1 100 0.00 262143.999939 FORMAT "%13.6" ECU_ADDRESS 0x6000CDA4 /end MEASUREMENT
/begin MEASUREMENT IdnLossB1_I.facMdlNom "Class instance for loss function of identification for lambda-based dynamics diagnosis of a wideband-sensor (bank 1) / squared nominal model factor" UWORD fak_uw_b1 1 100 0.00 0.9999847 FORMAT "%9.7" ECU_ADDRESS 0x6000CDA8 /end MEASUREMENT
/begin MEASUREMENT IdnLossB1_I.facMdlNomBasSum "Class instance for loss function of identification for lambda-based dynamics diagnosis of a wideband-sensor (bank 1) / kumulated squared nominal model factor" ULONG fak_uw_b1 1 100 0.00 65535.9999847 FORMAT "%13.7" ECU_ADDRESS 0x6000CDAC /end MEASUREMENT
/begin MEASUREMENT IdnLossB1_I.facMdlNomDe "Class instance for loss function of identification for lambda-based dynamics diagnosis of a wideband-sensor (bank 1) / nominal model deviation" UWORD fak_uw_b4 1 100 0.00 3.999939 FORMAT "%8.6" ECU_ADDRESS 0x6000CDB0 /end MEASUREMENT
/begin MEASUREMENT IdnLossB1_I.facMdlNomDeAvrg "Class instance for loss function of identification for lambda-based dynamics diagnosis of a wideband-sensor (bank 1) / average nominal model deviation" UWORD fak_uw_b128 1 100 0.00 127.9980 FORMAT "%8.4" ECU_ADDRESS 0x6000CDB2 /end MEASUREMENT
/begin MEASUREMENT IdnLossB1_I.facMdlNomDeEvln "Class instance for loss function of identification for lambda-based dynamics diagnosis of a wideband-sensor (bank 1) / nominal model deviation" UWORD fak_uw_b128 1 100 0.00 127.9980 FORMAT "%8.4" ECU_ADDRESS 0x6000CDB4 /end MEASUREMENT
/begin MEASUREMENT IdnLossB1_I.facMdlNomQlySum "Class instance for loss function of identification for lambda-based dynamics diagnosis of a wideband-sensor (bank 1) / kumulated nominal model deviation" ULONG fak_uw_b4 1 100 0.00 262143.999939 FORMAT "%13.6" ECU_ADDRESS 0x6000CDB8 /end MEASUREMENT
/begin MEASUREMENT IdnLossB1_I.flgFltSuspc "Class instance for loss function of identification for lambda-based dynamics diagnosis of a wideband-sensor (bank 1) / Fault suspicious based on loss function calculation" UBYTE B_TRUE 1 100 0.00 1.00000000000 BIT_MASK 0x1 FORMAT "%13.11" ECU_ADDRESS 0x6000CDBC /end MEASUREMENT
/begin MEASUREMENT IdnLossB1_I.flgLossEvlnDne "Class instance for loss function of identification for lambda-based dynamics diagnosis of a wideband-sensor (bank 1) / Evaluation of loss functions done" UBYTE B_TRUE 1 100 0.00 1.00000000000 BIT_MASK 0x1 FORMAT "%13.11" ECU_ADDRESS 0x6000CDBD /end MEASUREMENT
/begin MEASUREMENT IdnLossB1_I.flgRlsStep "Class instance for loss function of identification for lambda-based dynamics diagnosis of a wideband-sensor (bank 1) / Release of the step measurement" UBYTE B_TRUE 1 100 0.00 1.00000000000 BIT_MASK 0x1 FORMAT "%13.11" ECU_ADDRESS 0x6000CDBE /end MEASUREMENT
/begin MEASUREMENT IdnLossB1_I.flgRstAdpn "Class instance for loss function of identification for lambda-based dynamics diagnosis of a wideband-sensor (bank 1) / Reset of adaptation and identification values" UBYTE B_TRUE 1 100 0.00 1.00000000000 BIT_MASK 0x1 FORMAT "%13.11" ECU_ADDRESS 0x6000CDBF /end MEASUREMENT
/begin MEASUREMENT IdnLossB1_I.tiLossTmr "Class instance for loss function of identification for lambda-based dynamics diagnosis of a wideband-sensor (bank 1) / Timer of loss function calculation" UWORD t_q0p01 1 100 0.00 655.3500 FORMAT "%8.4" ECU_ADDRESS 0x6000CDC0 /end MEASUREMENT
/begin MEASUREMENT IdnLtrB1_I.dratLamDly "Class instance for identification in lean-rich direction for lambda-based dynamics diagnosis of a wideband-sensor (bank 1) / Derivative of reciprocal modelled lambda with fault model with respect to delay time" SWORD freq_q1p22Em4 1 100 -4.000000 3.999878 FORMAT "%8.6" ECU_ADDRESS 0x50001670 /end MEASUREMENT
/begin MEASUREMENT IdnLtrB1_I.dratLamTran "Class instance for identification in lean-rich direction for lambda-based dynamics diagnosis of a wideband-sensor (bank 1) / Derivative of reciprocal modelled lambda with fault model with respect to transition time" SWORD freq_q1p22Em4 1 100 -4.000000 3.999878 FORMAT "%8.6" ECU_ADDRESS 0x50001672 /end MEASUREMENT
/begin MEASUREMENT IdnLtrB1_I.ratLamErrNrm "Class instance for identification in lean-rich direction for lambda-based dynamics diagnosis of a wideband-sensor (bank 1) / Normalized modell error" SWORD fak_q3p0518Em5 1 100 -1.000000 0.999969 FORMAT "%8.6" ECU_ADDRESS 0x50001674 /end MEASUREMENT
/begin MEASUREMENT IdnLtrB1_I.ratLamRecprMdlBpFild "Class instance for identification in lean-rich direction for lambda-based dynamics diagnosis of a wideband-sensor (bank 1) / Reciprocal modelled lambda (bandpass filtered, filter value)" ULONG fak_q4p6566Em10 1 100 0.00 1.999999999534339 FORMAT "%17.15" ECU_ADDRESS 0x50001678 /end MEASUREMENT
/begin MEASUREMENT IdnLtrB1_I.ratLamRecprMdlFltBpFild "Class instance for identification in lean-rich direction for lambda-based dynamics diagnosis of a wideband-sensor (bank 1) / Reciprocal modelled lambda with fault model (bandpass filtered, filter value)" ULONG fak_q4p6566Em10 1 100 0.00 1.999999999534339 FORMAT "%17.15" ECU_ADDRESS 0x50001680 /end MEASUREMENT
/begin MEASUREMENT IdnLtrB1_I.tiDlyIdn "Class instance for identification in lean-rich direction for lambda-based dynamics diagnosis of a wideband-sensor (bank 1) / Identified delay time" UWORD t_q0p01 1 100 0.00 655.3500 FORMAT "%8.4" ECU_ADDRESS 0x50001688 /end MEASUREMENT
/begin MEASUREMENT IdnLtrB1_I.tiTranIdn "Class instance for identification in lean-rich direction for lambda-based dynamics diagnosis of a wideband-sensor (bank 1) / Identified transition time" UWORD t_q0p01 1 100 0.00 655.3500 FORMAT "%8.4" ECU_ADDRESS 0x5000168A /end MEASUREMENT
/begin MEASUREMENT IdnLtrB1_I.DerDlyDTTtopt_I.buffer "Class instance for identification in lean-rich direction for lambda-based dynamics diagnosis of a wideband-sensor (bank 1) / Dead time element for derivative with respect to dead time / buffer" SWORD freq_q1p22Em4 1 100 -4.000000 3.999878 FORMAT "%8.6" ARRAY_SIZE 21 ECU_ADDRESS 0x5000168C /end MEASUREMENT
/begin MEASUREMENT IdnLtrB1_I.DerDlyDTTtopt_I.counter "Class instance for identification in lean-rich direction for lambda-based dynamics diagnosis of a wideband-sensor (bank 1) / Dead time element for derivative with respect to dead time / counter" UWORD fak_uw_b2 1 100 0.00 1.000000 FORMAT "%8.6" ECU_ADDRESS 0x500016B6 /end MEASUREMENT
/begin MEASUREMENT IdnLtrB1_I.DerDlyDTTtopt_I.ds "Class instance for identification in lean-rich direction for lambda-based dynamics diagnosis of a wideband-sensor (bank 1) / Dead time element for derivative with respect to dead time / ds" UWORD fak_uw_b2 1 100 0.00 1.000000 FORMAT "%8.6" ECU_ADDRESS 0x500016B8 /end MEASUREMENT
/begin MEASUREMENT IdnLtrB1_I.DerDlyDTTtopt_I.pointer "Class instance for identification in lean-rich direction for lambda-based dynamics diagnosis of a wideband-sensor (bank 1) / Dead time element for derivative with respect to dead time / pointer" UBYTE dez 1 100 0.00 255.0 FORMAT "%5.1" ECU_ADDRESS 0x500016BA /end MEASUREMENT
/begin MEASUREMENT IdnLtrB1_I.DlyIdnIK_I.memory "Class instance for identification in lean-rich direction for lambda-based dynamics diagnosis of a wideband-sensor (bank 1) / Integrator for identified dead time / current integrator value" ULONG q1p5259Em7_s 1 100 0.00 655.359999847 FORMAT "%13.9" ECU_ADDRESS 0x500016BC /end MEASUREMENT
/begin MEASUREMENT IdnLtrB1_I.TranIdnIK_I.memory "Class instance for identification in lean-rich direction for lambda-based dynamics diagnosis of a wideband-sensor (bank 1) / Integrator for identified transition time / current integrator value" ULONG q1p5259Em7_s 1 100 0.00 655.359999847 FORMAT "%13.9" ECU_ADDRESS 0x500016C0 /end MEASUREMENT
/begin MEASUREMENT IdnRtlB1_I.dratLamDly "Class instance for identification in rich-lean direction for lambda-based dynamics diagnosis of a wideband-sensor (bank 1) / Derivative of reciprocal modelled lambda with fault model with respect to delay time" SWORD freq_q1p22Em4 1 100 -4.000000 3.999878 FORMAT "%8.6" ECU_ADDRESS 0x500016C4 /end MEASUREMENT
/begin MEASUREMENT IdnRtlB1_I.dratLamTran "Class instance for identification in rich-lean direction for lambda-based dynamics diagnosis of a wideband-sensor (bank 1) / Derivative of reciprocal modelled lambda with fault model with respect to transition time" SWORD freq_q1p22Em4 1 100 -4.000000 3.999878 FORMAT "%8.6" ECU_ADDRESS 0x500016C6 /end MEASUREMENT
/begin MEASUREMENT IdnRtlB1_I.ratLamErrNrm "Class instance for identification in rich-lean direction for lambda-based dynamics diagnosis of a wideband-sensor (bank 1) / Normalized modell error" SWORD fak_q3p0518Em5 1 100 -1.000000 0.999969 FORMAT "%8.6" ECU_ADDRESS 0x500016C8 /end MEASUREMENT
/begin MEASUREMENT IdnRtlB1_I.ratLamRecprMdlBpFild "Class instance for identification in rich-lean direction for lambda-based dynamics diagnosis of a wideband-sensor (bank 1) / Reciprocal modelled lambda (bandpass filtered, filter value)" ULONG fak_q4p6566Em10 1 100 0.00 1.999999999534339 FORMAT "%17.15" ECU_ADDRESS 0x500016CC /end MEASUREMENT
/begin MEASUREMENT IdnRtlB1_I.ratLamRecprMdlFltBpFild "Class instance for identification in rich-lean direction for lambda-based dynamics diagnosis of a wideband-sensor (bank 1) / Reciprocal modelled lambda with fault model (bandpass filtered, filter value)" ULONG fak_q4p6566Em10 1 100 0.00 1.999999999534339 FORMAT "%17.15" ECU_ADDRESS 0x500016D4 /end MEASUREMENT
/begin MEASUREMENT IdnRtlB1_I.tiDlyIdn "Class instance for identification in rich-lean direction for lambda-based dynamics diagnosis of a wideband-sensor (bank 1) / Identified delay time" UWORD t_q0p01 1 100 0.00 655.3500 FORMAT "%8.4" ECU_ADDRESS 0x500016DC /end MEASUREMENT
/begin MEASUREMENT IdnRtlB1_I.tiTranIdn "Class instance for identification in rich-lean direction for lambda-based dynamics diagnosis of a wideband-sensor (bank 1) / Identified transition time" UWORD t_q0p01 1 100 0.00 655.3500 FORMAT "%8.4" ECU_ADDRESS 0x500016DE /end MEASUREMENT
/begin MEASUREMENT IdnRtlB1_I.DerDlyDTTtopt_I.buffer "Class instance for identification in rich-lean direction for lambda-based dynamics diagnosis of a wideband-sensor (bank 1) / Dead time element for derivative with respect to dead time / buffer" SWORD freq_q1p22Em4 1 100 -4.000000 3.999878 FORMAT "%8.6" ARRAY_SIZE 21 ECU_ADDRESS 0x500016E0 /end MEASUREMENT
/begin MEASUREMENT IdnRtlB1_I.DerDlyDTTtopt_I.counter "Class instance for identification in rich-lean direction for lambda-based dynamics diagnosis of a wideband-sensor (bank 1) / Dead time element for derivative with respect to dead time / counter" UWORD fak_uw_b2 1 100 0.00 1.000000 FORMAT "%8.6" ECU_ADDRESS 0x5000170A /end MEASUREMENT
/begin MEASUREMENT IdnRtlB1_I.DerDlyDTTtopt_I.ds "Class instance for identification in rich-lean direction for lambda-based dynamics diagnosis of a wideband-sensor (bank 1) / Dead time element for derivative with respect to dead time / ds" UWORD fak_uw_b2 1 100 0.00 1.000000 FORMAT "%8.6" ECU_ADDRESS 0x5000170C /end MEASUREMENT
/begin MEASUREMENT IdnRtlB1_I.DerDlyDTTtopt_I.pointer "Class instance for identification in rich-lean direction for lambda-based dynamics diagnosis of a wideband-sensor (bank 1) / Dead time element for derivative with respect to dead time / pointer" UBYTE dez 1 100 0.00 255.0 FORMAT "%5.1" ECU_ADDRESS 0x5000170E /end MEASUREMENT
/begin MEASUREMENT IdnRtlB1_I.DlyIdnIK_I.memory "Class instance for identification in rich-lean direction for lambda-based dynamics diagnosis of a wideband-sensor (bank 1) / Integrator for identified dead time / current integrator value" ULONG q1p5259Em7_s 1 100 0.00 655.359999847 FORMAT "%13.9" ECU_ADDRESS 0x50001710 /end MEASUREMENT
/begin MEASUREMENT IdnRtlB1_I.TranIdnIK_I.memory "Class instance for identification in rich-lean direction for lambda-based dynamics diagnosis of a wideband-sensor (bank 1) / Integrator for identified transition time / current integrator value" ULONG q1p5259Em7_s 1 100 0.00 655.359999847 FORMAT "%13.9" ECU_ADDRESS 0x50001714 /end MEASUREMENT
/begin MEASUREMENT LamOffsFastB1_I.cntrExhM "Class instance for fast adaptation of lambda offset (bank 1) / Counter for exhaust masses to debounce fault with fast offset adaptation" UBYTE dez 1 100 0.00 255.0 FORMAT "%5.1" ECU_ADDRESS 0x60001575 /end MEASUREMENT
/begin MEASUREMENT LamOffsFastB1_I.cntrExhMVirt "Class instance for fast adaptation of lambda offset (bank 1) / Counter for virtual exhaust masses for IUMPR simulation of fast offset adaptation" UBYTE dez 1 100 0.00 255.0 FORMAT "%5.1" ECU_ADDRESS 0x60001576 /end MEASUREMENT
/begin MEASUREMENT LamOffsFastB1_I.cntrNoStepIncRow "Class instance for fast adaptation of lambda offset (bank 1) / Counter for no step in offset or increasing offset in a row" UBYTE dez 1 100 0.00 255.0 FORMAT "%5.1" ECU_ADDRESS 0x60001577 /end MEASUREMENT
/begin MEASUREMENT LamOffsFastB1_I.cntrNoStepRow "Class instance for fast adaptation of lambda offset (bank 1) / Counter for no step in offset in a row" UBYTE dez 1 100 0.00 255.0 FORMAT "%5.1" ECU_ADDRESS 0x60001578 /end MEASUREMENT
/begin MEASUREMENT LamOffsFastB1_I.cntrOffsPredAbvThd "Class instance for fast adaptation of lambda offset (bank 1) / Counter for predicted offset above threshold" UWORD dez 1 100 0.00 65535.00 FORMAT "%8.2" ECU_ADDRESS 0x6000157A /end MEASUREMENT
/begin MEASUREMENT LamOffsFastB1_I.flgDebFltOffsFast "Class instance for fast adaptation of lambda offset (bank 1) / Debounce condition for fault confirmation by fast offset adaptation" UBYTE B_TRUE 1 100 0.00 1.00000000000 BIT_MASK 0x1 FORMAT "%13.11" ECU_ADDRESS 0x6000157C /end MEASUREMENT
/begin MEASUREMENT LamOffsFastB1_I.flgDebFltOffsFastVirt "Class instance for fast adaptation of lambda offset (bank 1) / Virtual debounce condition (for IUMPR simulation) for fault confirmation by fast offset adaptation" UBYTE B_TRUE 1 100 0.00 1.00000000000 BIT_MASK 0x1 FORMAT "%13.11" ECU_ADDRESS 0x6000157D /end MEASUREMENT
/begin MEASUREMENT LamOffsFastB1_I.flgDebHealOffsFast "Class instance for fast adaptation of lambda offset (bank 1) / Debounce condition for fault healing by fast offset adaptation" UBYTE B_TRUE 1 100 0.00 1.00000000000 BIT_MASK 0x1 FORMAT "%13.11" ECU_ADDRESS 0x6000157E /end MEASUREMENT
/begin MEASUREMENT LamOffsFastB1_I.flgEna "Class instance for fast adaptation of lambda offset (bank 1) / Enabling of fast offset adaptation" UBYTE B_TRUE 1 100 0.00 1.00000000000 BIT_MASK 0x1 FORMAT "%13.11" ECU_ADDRESS 0x60001574 /end MEASUREMENT
/begin MEASUREMENT LamOffsFastB1_I.flgEnaExhM "Class instance for fast adaptation of lambda offset (bank 1) / Sufficient exhaust mass to enable fast offset adaptation" UBYTE B_TRUE 1 100 0.00 1.00000000000 BIT_MASK 0x2 FORMAT "%13.11" ECU_ADDRESS 0x60001574 /end MEASUREMENT
/begin MEASUREMENT LamOffsFastB1_I.flgEnaExhMVirt "Class instance for fast adaptation of lambda offset (bank 1) / Sufficient virtual exhaust mass to enable fast offset adaptation in context of IUMPR simulation" UBYTE B_TRUE 1 100 0.00 1.00000000000 BIT_MASK 0x10 FORMAT "%13.11" ECU_ADDRESS 0x60001574 /end MEASUREMENT
/begin MEASUREMENT LamOffsFastB1_I.flgLamOffsFastFltSuspc "Class instance for fast adaptation of lambda offset (bank 1) / fault suspicion from fast offset adaptation" UBYTE B_TRUE 1 100 0.00 1.00000000000 BIT_MASK 0x1 FORMAT "%13.11" ECU_ADDRESS 0x6000157F /end MEASUREMENT
/begin MEASUREMENT LamOffsFastB1_I.flgNoSignChgOffsPred "Class instance for fast adaptation of lambda offset (bank 1) / No sign change in raw value of predicted offset during exhaust mass interval" UBYTE B_TRUE 1 100 0.00 1.00000000000 BIT_MASK 0x40 FORMAT "%13.11" ECU_ADDRESS 0x60001574 /end MEASUREMENT
/begin MEASUREMENT LamOffsFastB1_I.ratLamOffsAbslt "Class instance for fast adaptation of lambda offset (bank 1) / Absolute value of lambda offset" UWORD fak_uw_b2 1 100 0.00 1.999969 FORMAT "%8.6" ECU_ADDRESS 0x60001580 /end MEASUREMENT
/begin MEASUREMENT LamOffsFastB1_I.ratLamOffsDeltaAbsPred "Class instance for fast adaptation of lambda offset (bank 1) / absolute value of expected really done adaptation step" SLONG fak_sw_b1 1 100 -65536.0000000 65535.9999695 FORMAT "%13.7" ECU_ADDRESS 0x60001584 /end MEASUREMENT
/begin MEASUREMENT LamOffsFastB1_I.ratLamOffsDeltaPred "Class instance for fast adaptation of lambda offset (bank 1) / expected really done adaptation step" SLONG fak_sw_b1 1 100 -65536.0000000 65535.9999695 FORMAT "%13.7" ECU_ADDRESS 0x60001588 /end MEASUREMENT
/begin MEASUREMENT LamOffsFastB1_I.ratLamOffsFastDelta "Class instance for fast adaptation of lambda offset (bank 1) / Fast adaptation step for lambda offset" SWORD fak_sw_b1 1 100 -1.000000 0.999969 FORMAT "%8.6" ECU_ADDRESS 0x6000158C /end MEASUREMENT
/begin MEASUREMENT LamOffsFastB1_I.ratLamOffsFastPred "Class instance for fast adaptation of lambda offset (bank 1) / expected Lambda offset" SWORD fak_sw_b1 1 100 -1.000000 0.999969 FORMAT "%8.6" ECU_ADDRESS 0x6000158E /end MEASUREMENT
/begin MEASUREMENT LamOffsFastB1_I.ratLamOffsPred "Class instance for fast adaptation of lambda offset (bank 1) / expected Lambda offset" SWORD fak_sw_b1 1 100 -1.000000 0.999969 FORMAT "%8.6" ECU_ADDRESS 0x60001590 /end MEASUREMENT
/begin MEASUREMENT LamOffsFastB1_I.ratLamOffsPredAbslt "Class instance for fast adaptation of lambda offset (bank 1) / Absolute value of predicted lambda offset" SWORD fak_sw_b1 1 100 -1.000000 0.999969 FORMAT "%8.6" ECU_ADDRESS 0x60001592 /end MEASUREMENT
/begin MEASUREMENT LamOffsFastB1_I.ExhMEnaGnrlVirtIK_I.memory "Class instance for fast adaptation of lambda offset (bank 1) / Virtual exhaust mass for general enabling of fast offset adaptation for IUMPR / current integrator value" ULONG m_q4p239Em7_g 1 100 0.00 1820.44907366 FORMAT "%13.8" ECU_ADDRESS 0x60001594 /end MEASUREMENT
/begin MEASUREMENT LamOffsFastB1_I.ExhMEnaIK_I.memory "Class instance for fast adaptation of lambda offset (bank 1) / Exhaust mass to enable fast offset adaptation / current integrator value" ULONG m_q4p239Em7_g 1 100 0.00 1820.44907366 FORMAT "%13.8" ECU_ADDRESS 0x60001598 /end MEASUREMENT
/begin MEASUREMENT LamOffsFastB1_I.ExhMEnaVirtIK_I.memory "Class instance for fast adaptation of lambda offset (bank 1) / Virtual exhaust mass to enable fast offset adaptation in context of IUMPR simulation / current integrator value" ULONG m_q4p239Em7_g 1 100 0.00 1820.44907366 FORMAT "%13.8" ECU_ADDRESS 0x6000159C /end MEASUREMENT
/begin MEASUREMENT LamOffsFastB1_I.LamOffsPredLT_I.memory "Class instance for fast adaptation of lambda offset (bank 1) / Predicted lambda offset / current lowpass value" SLONG fak_q4p6566Em10 1 100 -1.000000000000000 0.999999999534339 FORMAT "%17.15" ECU_ADDRESS 0x600015A0 /end MEASUREMENT
/begin MEASUREMENT LamOffsFastB1_I.LamOffsPredRawSignChgEB_I.buffer "Class instance for fast adaptation of lambda offset (bank 1) / Bi-directional edge to detect sign change of predicted raw lambda offset / EdgeBi.buffer" UBYTE B_TRUE 1 100 0.00 1.00000000000 BIT_MASK 0x1 FORMAT "%13.11" ECU_ADDRESS 0x600015A4 /end MEASUREMENT
/begin MEASUREMENT LamOffsFastB1_I.LamOffsPredRawSignChgEB_I.oldSignal "Class instance for fast adaptation of lambda offset (bank 1) / Bi-directional edge to detect sign change of predicted raw lambda offset / EdgeBi.odlSignal" UBYTE B_TRUE 1 100 0.00 1.00000000000 BIT_MASK 0x1 FORMAT "%13.11" ECU_ADDRESS 0x600015A5 /end MEASUREMENT
/begin MEASUREMENT LamOffsFastB1_I.LamOffsPredSignChgEB_I.buffer "Class instance for fast adaptation of lambda offset (bank 1) / Bi-directional edge to detect sign change of predicted lambda offset / EdgeBi.buffer" UBYTE B_TRUE 1 100 0.00 1.00000000000 BIT_MASK 0x1 FORMAT "%13.11" ECU_ADDRESS 0x600015A6 /end MEASUREMENT
/begin MEASUREMENT LamOffsFastB1_I.LamOffsPredSignChgEB_I.oldSignal "Class instance for fast adaptation of lambda offset (bank 1) / Bi-directional edge to detect sign change of predicted lambda offset / EdgeBi.odlSignal" UBYTE B_TRUE 1 100 0.00 1.00000000000 BIT_MASK 0x1 FORMAT "%13.11" ECU_ADDRESS 0x600015A7 /end MEASUREMENT
/begin MEASUREMENT LamOffsFastB1_I.LamPlausFltSuspcOffsB1EFNM_I.oldSignal "Class instance for fast adaptation of lambda offset (bank 1) / EdgeFalling: Fault suspicion from lambda plausibility diagnosis / memory to detect falling edge" UBYTE B_TRUE 1 100 0.00 1.00000000000 BIT_MASK 0x1 FORMAT "%13.11" ECU_ADDRESS 0x600015A8 /end MEASUREMENT
/begin MEASUREMENT LamOffsFastB1_I.flgCtrlrLimOffsER_I.buffer "Class instance for fast adaptation of lambda offset (bank 1) / EdgeRising: enabling condition of fast offset adaptation due to lambda control / rising edge detected" UBYTE B_TRUE 1 100 0.00 1.00000000000 BIT_MASK 0x1 FORMAT "%13.11" ECU_ADDRESS 0x600015AA /end MEASUREMENT
/begin MEASUREMENT LamOffsFastB1_I.flgCtrlrLimOffsER_I.oldSignal "Class instance for fast adaptation of lambda offset (bank 1) / EdgeRising: enabling condition of fast offset adaptation due to lambda control / flag rising edge" UBYTE B_TRUE 1 100 0.00 1.00000000000 BIT_MASK 0x1 FORMAT "%13.11" ECU_ADDRESS 0x600015AB /end MEASUREMENT
/begin MEASUREMENT LamOffsFastB1_I.flgFltSuspcOffsFF_I.status "Class instance for fast adaptation of lambda offset (bank 1) / FlipFlop: fault suspicion of fast offset adaptation / current value of RS-FF" UBYTE B_TRUE 1 100 0.00 1.00000000000 BIT_MASK 0x1 FORMAT "%13.11" ECU_ADDRESS 0x600015AC /end MEASUREMENT
/begin MEASUREMENT LamPlausB1_I.flgDiumprRlsNum "Class instance of lambda-based plausibility diagnosis (offset) of a wideband sensor (bank 1) / Release of IUMPR numerator" UBYTE B_TRUE 1 100 0.00 1.00000000000 BIT_MASK 0x1 FORMAT "%13.11" ECU_ADDRESS 0x50001720 /end MEASUREMENT
/begin MEASUREMENT LamPlausB1_I.flgEnaAddOffsSlow "Class instance of lambda-based plausibility diagnosis (offset) of a wideband sensor (bank 1) / Enabling of addition of lambda offset of slow offset adaptation" UBYTE B_TRUE 1 100 0.00 1.00000000000 BIT_MASK 0x1 FORMAT "%13.11" ECU_ADDRESS 0x50001736 /end MEASUREMENT
/begin MEASUREMENT LamPlausB1_I.flgEnaTwcCtrlIOperPnt "Class instance of lambda-based plausibility diagnosis (offset) of a wideband sensor (bank 1) / I-part of TWC controller active at desired operating point" UBYTE B_TRUE 1 100 0.00 1.00000000000 BIT_MASK 0x1 FORMAT "%13.11" ECU_ADDRESS 0x50001737 /end MEASUREMENT
/begin MEASUREMENT LamPlausB1_I.flgFltOffs "Class instance of lambda-based plausibility diagnosis (offset) of a wideband sensor (bank 1) / LSU plausibility error exists" UBYTE B_TRUE 1 100 0.00 1.00000000000 BIT_MASK 0x4 FORMAT "%13.11" ECU_ADDRESS 0x50001734 /end MEASUREMENT
/begin MEASUREMENT LamPlausB1_I.flgFltPllsuMax "Class instance of lambda-based plausibility diagnosis (offset) of a wideband sensor (bank 1) / Offset max error" UBYTE B_TRUE 1 100 0.00 1.00000000000 BIT_MASK 0x4 FORMAT "%13.11" ECU_ADDRESS 0x50001737 /end MEASUREMENT
/begin MEASUREMENT LamPlausB1_I.flgFltPllsuMin "Class instance of lambda-based plausibility diagnosis (offset) of a wideband sensor (bank 1) / Offset min error" UBYTE B_TRUE 1 100 0.00 1.00000000000 BIT_MASK 0x8 FORMAT "%13.11" ECU_ADDRESS 0x50001737 /end MEASUREMENT
/begin MEASUREMENT LamPlausB1_I.flgFltPrevTrip "Class instance of lambda-based plausibility diagnosis (offset) of a wideband sensor (bank 1) / Error status from last trip" UBYTE B_TRUE 1 100 0.00 1.00000000000 BIT_MASK 0x10 FORMAT "%13.11" ECU_ADDRESS 0x50001737 /end MEASUREMENT
/begin MEASUREMENT LamPlausB1_I.flgFltSuspcLeanRamp "Class instance of lambda-based plausibility diagnosis (offset) of a wideband sensor (bank 1) / Offset error suspicion, triggered by lambda ramp" UBYTE B_TRUE 1 100 0.00 1.00000000000 BIT_MASK 0x2 FORMAT "%13.11" ECU_ADDRESS 0x50001736 /end MEASUREMENT
/begin MEASUREMENT LamPlausB1_I.flgFltSuspcRichRamp "Class instance of lambda-based plausibility diagnosis (offset) of a wideband sensor (bank 1) / Offset error suspicion, triggered by lambda ramp" UBYTE B_TRUE 1 100 0.00 1.00000000000 BIT_MASK 0x4 FORMAT "%13.11" ECU_ADDRESS 0x50001736 /end MEASUREMENT
/begin MEASUREMENT LamPlausB1_I.flgFrzFrmOffsMax "Class instance of lambda-based plausibility diagnosis (offset) of a wideband sensor (bank 1) / FreezeFrame for offset fault max available" UBYTE B_TRUE 1 100 0.00 1.00000000000 BIT_MASK 0x4 FORMAT "%13.11" ECU_ADDRESS 0x6003661C /end MEASUREMENT
/begin MEASUREMENT LamPlausB1_I.flgFrzFrmOffsMin "Class instance of lambda-based plausibility diagnosis (offset) of a wideband sensor (bank 1) / FreezeFrame for offset fault min available" UBYTE B_TRUE 1 100 0.00 1.00000000000 BIT_MASK 0x8 FORMAT "%13.11" ECU_ADDRESS 0x6003661C /end MEASUREMENT
/begin MEASUREMENT LamPlausB1_I.flgFuTrmFltTmp "Class instance of lambda-based plausibility diagnosis (offset) of a wideband sensor (bank 1) / temporary fueltrim fault" UBYTE B_TRUE 1 100 0.00 1.00000000000 BIT_MASK 0x20 FORMAT "%13.11" ECU_ADDRESS 0x50001737 /end MEASUREMENT
/begin MEASUREMENT LamPlausB1_I.flgLamDynTstdOk "Class instance of lambda-based plausibility diagnosis (offset) of a wideband sensor (bank 1) / Lambda dynamic tested ok" UBYTE B_TRUE 1 100 0.00 1.00000000000 BIT_MASK 0x8 FORMAT "%13.11" ECU_ADDRESS 0x50001736 /end MEASUREMENT
/begin MEASUREMENT LamPlausB1_I.flgLamOffsDsmPrms "Class instance of lambda-based plausibility diagnosis (offset) of a wideband sensor (bank 1) / DSM permission for lambda offset diagnosis" UBYTE B_TRUE 1 100 0.00 1.00000000000 BIT_MASK 0x10 FORMAT "%13.11" ECU_ADDRESS 0x50001736 /end MEASUREMENT
/begin MEASUREMENT LamPlausB1_I.flgLamOffsFltHeal "Class instance of lambda-based plausibility diagnosis (offset) of a wideband sensor (bank 1) / Lambda offset fault healing" UBYTE B_TRUE 1 100 0.00 1.00000000000 BIT_MASK 0x80 FORMAT "%13.11" ECU_ADDRESS 0x50001734 /end MEASUREMENT
/begin MEASUREMENT LamPlausB1_I.flgLamOffsFltMax "Class instance of lambda-based plausibility diagnosis (offset) of a wideband sensor (bank 1) / Lambda offset fault maximum" UBYTE B_TRUE 1 100 0.00 1.00000000000 BIT_MASK 0x4 FORMAT "%13.11" ECU_ADDRESS 0x50001735 /end MEASUREMENT
/begin MEASUREMENT LamPlausB1_I.flgLamOffsFltMin "Class instance of lambda-based plausibility diagnosis (offset) of a wideband sensor (bank 1) / Lambda offset fault minimum" UBYTE B_TRUE 1 100 0.00 1.00000000000 BIT_MASK 0x8 FORMAT "%13.11" ECU_ADDRESS 0x50001735 /end MEASUREMENT
/begin MEASUREMENT LamPlausB1_I.flgLamOffsSlowDebOffs "Class instance of lambda-based plausibility diagnosis (offset) of a wideband sensor (bank 1) / Debouncing of offset fault by slow offset adaptation" UBYTE B_TRUE 1 100 0.00 1.00000000000 BIT_MASK 0x20 FORMAT "%13.11" ECU_ADDRESS 0x50001735 /end MEASUREMENT
/begin MEASUREMENT LamPlausB1_I.flgLamPlausFltMax "Class instance of lambda-based plausibility diagnosis (offset) of a wideband sensor (bank 1) / max-error of lambda offset diagnosis is found" UBYTE B_TRUE 1 100 0.00 1.00000000000 BIT_MASK 0x1 FORMAT "%13.11" ECU_ADDRESS 0x50001721 /end MEASUREMENT
/begin MEASUREMENT LamPlausB1_I.flgLamPlausFltMin "Class instance of lambda-based plausibility diagnosis (offset) of a wideband sensor (bank 1) / min-error of lambda offset diagnosis is found" UBYTE B_TRUE 1 100 0.00 1.00000000000 BIT_MASK 0x1 FORMAT "%13.11" ECU_ADDRESS 0x50001722 /end MEASUREMENT
/begin MEASUREMENT LamPlausB1_I.flgLamPlausFltSuspc "Class instance of lambda-based plausibility diagnosis (offset) of a wideband sensor (bank 1) / Fault suspicion of lambda plausibility diagnosis" UBYTE B_TRUE 1 100 0.00 1.00000000000 BIT_MASK 0x1 FORMAT "%13.11" ECU_ADDRESS 0x50001723 /end MEASUREMENT
/begin MEASUREMENT LamPlausB1_I.flgLamPlausFltVirt "Class instance of lambda-based plausibility diagnosis (offset) of a wideband sensor (bank 1) / virtual error simulation of lambda offset diagnosis is finished" UBYTE B_TRUE 1 100 0.00 1.00000000000 BIT_MASK 0x1 FORMAT "%13.11" ECU_ADDRESS 0x50001724 /end MEASUREMENT
/begin MEASUREMENT LamPlausB1_I.flgLamPlausInhbParl "Class instance of lambda-based plausibility diagnosis (offset) of a wideband sensor (bank 1) / Inhibit of parallelization by LSU plausibility diagnosis" UBYTE B_TRUE 1 100 0.00 1.00000000000 BIT_MASK 0x1 FORMAT "%13.11" ECU_ADDRESS 0x50001725 /end MEASUREMENT
/begin MEASUREMENT LamPlausB1_I.flgLamPlausParlDneOnce "Class instance of lambda-based plausibility diagnosis (offset) of a wideband sensor (bank 1) / Parallelization done at least once from LSU plausibility diagnosis point of view" UBYTE B_TRUE 1 100 0.00 1.00000000000 BIT_MASK 0x1 FORMAT "%13.11" ECU_ADDRESS 0x50001726 /end MEASUREMENT
/begin MEASUREMENT LamPlausB1_I.flgLamPlausTstd "Class instance of lambda-based plausibility diagnosis (offset) of a wideband sensor (bank 1) / Lambda based plausibility diagnosis tested" UBYTE B_TRUE 1 100 0.00 1.00000000000 BIT_MASK 0x1 FORMAT "%13.11" ECU_ADDRESS 0x50001727 /end MEASUREMENT
/begin MEASUREMENT LamPlausB1_I.flgPassdFtdla "Class instance of lambda-based plausibility diagnosis (offset) of a wideband sensor (bank 1) / Fueltrim tested ok" UBYTE B_TRUE 1 100 0.00 1.00000000000 BIT_MASK 0x40 FORMAT "%13.11" ECU_ADDRESS 0x50001737 /end MEASUREMENT
/begin MEASUREMENT LamPlausB1_I.flgPassdPllsu "Class instance of lambda-based plausibility diagnosis (offset) of a wideband sensor (bank 1) / Offset tested ok" UBYTE B_TRUE 1 100 0.00 1.00000000000 BIT_MASK 0x80 FORMAT "%13.11" ECU_ADDRESS 0x50001737 /end MEASUREMENT
/begin MEASUREMENT LamPlausB1_I.flgTstdPllsu "Class instance of lambda-based plausibility diagnosis (offset) of a wideband sensor (bank 1) / Offset tested" UBYTE B_TRUE 1 100 0.00 1.00000000000 BIT_MASK 0x1 FORMAT "%13.11" ECU_ADDRESS 0x50001738 /end MEASUREMENT
/begin MEASUREMENT LamPlausB1_I.flgVldLamPlausMax "Class instance of lambda-based plausibility diagnosis (offset) of a wideband sensor (bank 1) / Offset Validation Max" UBYTE B_TRUE 1 100 0.00 1.00000000000 BIT_MASK 0x2 FORMAT "%13.11" ECU_ADDRESS 0x50001738 /end MEASUREMENT
/begin MEASUREMENT LamPlausB1_I.flgVldLamPlausMin "Class instance of lambda-based plausibility diagnosis (offset) of a wideband sensor (bank 1) / Offset Validation Min" UBYTE B_TRUE 1 100 0.00 1.00000000000 BIT_MASK 0x4 FORMAT "%13.11" ECU_ADDRESS 0x50001738 /end MEASUREMENT
/begin MEASUREMENT LamPlausB1_I.ratLamOffs "Class instance of lambda-based plausibility diagnosis (offset) of a wideband sensor (bank 1) / Lambda offset" SWORD fak_sw_b1 1 100 -1.000000 0.999969 FORMAT "%8.6" ECU_ADDRESS 0x6003661A /end MEASUREMENT
/begin MEASUREMENT LamPlausB1_I.ratLamOffsCycBgn "Class instance of lambda-based plausibility diagnosis (offset) of a wideband sensor (bank 1) / Lambda offset at beginning of driving cycle" SWORD fak_sw_b1 1 100 -1.000000 0.999969 FORMAT "%8.6" ECU_ADDRESS 0x50001728 /end MEASUREMENT
/begin MEASUREMENT LamPlausB1_I.ratLamOffsDeltaExch_s32 "Class instance of lambda-based plausibility diagnosis (offset) of a wideband sensor (bank 1) / Delta lambda offset to exchange I-part of lambda controller downstream catalyst with lambda offset" SLONG fak_sl_b1 1 100 -1.00000000000 0.99999999953 FORMAT "%13.11" ECU_ADDRESS 0x5000172C /end MEASUREMENT
/begin MEASUREMENT LamPlausB1_I.tiLamOffsSlowActv "Class instance of lambda-based plausibility diagnosis (offset) of a wideband sensor (bank 1) / Cumulated time in which slow offset adaptation was active" UWORD t_q0p1 1 100 0.00 6553.500 FORMAT "%8.3" ECU_ADDRESS 0x5000173A /end MEASUREMENT
/begin MEASUREMENT LamPlausB1_I.LamDynErrER_I.buffer "Class instance of lambda-based plausibility diagnosis (offset) of a wideband sensor (bank 1) / ErrorTrigger / rising edge detected" UBYTE B_TRUE 1 100 0.00 1.00000000000 BIT_MASK 0x1 FORMAT "%13.11" ECU_ADDRESS 0x5000173C /end MEASUREMENT
/begin MEASUREMENT LamPlausB1_I.LamDynErrER_I.oldSignal "Class instance of lambda-based plausibility diagnosis (offset) of a wideband sensor (bank 1) / ErrorTrigger / flag rising edge" UBYTE B_TRUE 1 100 0.00 1.00000000000 BIT_MASK 0x1 FORMAT "%13.11" ECU_ADDRESS 0x5000173D /end MEASUREMENT
/begin MEASUREMENT LamPlausB1_I.LamPlausParlDneERNM_I.oldSignal "Class instance of lambda-based plausibility diagnosis (offset) of a wideband sensor (bank 1) / Edge rise for setting info: parallelization done for LamPlaus / value of input signal last calculation" UBYTE B_TRUE 1 100 0.00 1.00000000000 BIT_MASK 0x1 FORMAT "%13.11" ECU_ADDRESS 0x5000173E /end MEASUREMENT
/begin MEASUREMENT LamPlausB1_I.PLLSUDltSusFrzFrmERNM_I.oldSignal "Class instance of lambda-based plausibility diagnosis (offset) of a wideband sensor (bank 1) / Edge rising to delete suspected freeze frame of PLLSU fault / value of input signal last calculation" UBYTE B_TRUE 1 100 0.00 1.00000000000 BIT_MASK 0x1 FORMAT "%13.11" ECU_ADDRESS 0x5000173F /end MEASUREMENT
/begin MEASUREMENT LamPlausB1_I.flgFltSuspcER_I.buffer "Class instance of lambda-based plausibility diagnosis (offset) of a wideband sensor (bank 1) / There is a offset- or target error suspicion / rising edge detected" UBYTE B_TRUE 1 100 0.00 1.00000000000 BIT_MASK 0x1 FORMAT "%13.11" ECU_ADDRESS 0x50001740 /end MEASUREMENT
/begin MEASUREMENT LamPlausB1_I.flgFltSuspcER_I.oldSignal "Class instance of lambda-based plausibility diagnosis (offset) of a wideband sensor (bank 1) / There is a offset- or target error suspicion / flag rising edge" UBYTE B_TRUE 1 100 0.00 1.00000000000 BIT_MASK 0x1 FORMAT "%13.11" ECU_ADDRESS 0x50001741 /end MEASUREMENT
/begin MEASUREMENT LamPlausB1_I.flgFltSuspcFF_I.status "Class instance of lambda-based plausibility diagnosis (offset) of a wideband sensor (bank 1) / There is a offset- or target error suspicion / current value of RS-FF" UBYTE B_TRUE 1 100 0.00 1.00000000000 BIT_MASK 0x1 FORMAT "%13.11" ECU_ADDRESS 0x50001742 /end MEASUREMENT
/begin MEASUREMENT LamPlausB1_I.flgInhbParlER_I.buffer "Class instance of lambda-based plausibility diagnosis (offset) of a wideband sensor (bank 1) / Parallelization is inhibited, due to present offset error suspicion / rising edge detected" UBYTE B_TRUE 1 100 0.00 1.00000000000 BIT_MASK 0x1 FORMAT "%13.11" ECU_ADDRESS 0x50001744 /end MEASUREMENT
/begin MEASUREMENT LamPlausB1_I.flgInhbParlER_I.oldSignal "Class instance of lambda-based plausibility diagnosis (offset) of a wideband sensor (bank 1) / Parallelization is inhibited, due to present offset error suspicion / flag rising edge" UBYTE B_TRUE 1 100 0.00 1.00000000000 BIT_MASK 0x1 FORMAT "%13.11" ECU_ADDRESS 0x50001745 /end MEASUREMENT
/begin MEASUREMENT LamPlausB1_I.flgInhbParlFF_I.status "Class instance of lambda-based plausibility diagnosis (offset) of a wideband sensor (bank 1) / Parallelization is inhibited, due to present offset error suspicion / current value of RS-FF" UBYTE B_TRUE 1 100 0.00 1.00000000000 BIT_MASK 0x1 FORMAT "%13.11" ECU_ADDRESS 0x50001746 /end MEASUREMENT
/begin MEASUREMENT LamPlausB1_I.mfExhTwcCtrlIOperPntIK_I.memory "Class instance of lambda-based plausibility diagnosis (offset) of a wideband sensor (bank 1) / Integrator for exhaust mass after I-part TWC controller at desired operating point active / current integrator value" ULONG m_q1p5259Em8_kg 1 100 0.00 65.5359999847 FORMAT "%13.10" ECU_ADDRESS 0x50001748 /end MEASUREMENT
/begin MEASUREMENT ResFilLtrB1_I.cntrStep "Class instance for result filtering in lean-rich direction for lambda-based dynamics diagnosis of a wideband-sensor (bank 1) / Counter of step responses" UBYTE dez 1 100 0.00 255.0 FORMAT "%5.1" ECU_ADDRESS 0x60036630 /end MEASUREMENT
/begin MEASUREMENT ResFilLtrB1_I.cntrStepShtrp "Class instance for result filtering in lean-rich direction for lambda-based dynamics diagnosis of a wideband-sensor (bank 1) / Counter of step responses during short trip" UBYTE dez 1 100 0.00 255.0 FORMAT "%5.1" ECU_ADDRESS 0x500018C0 /end MEASUREMENT
/begin MEASUREMENT ResFilLtrB1_I.flgArith "Class instance for result filtering in lean-rich direction for lambda-based dynamics diagnosis of a wideband-sensor (bank 1) / Arithmetic filtering active" UBYTE B_TRUE 1 100 0.00 1.00000000000 BIT_MASK 0x1 FORMAT "%13.11" ECU_ADDRESS 0x500018C1 /end MEASUREMENT
/begin MEASUREMENT ResFilLtrB1_I.flgProdModParl "Class instance for result filtering in lean-rich direction for lambda-based dynamics diagnosis of a wideband-sensor (bank 1) / Production mode needs to be considered for parallel diagnosis of exhaust gas system" UBYTE B_TRUE 1 100 0.00 1.00000000000 BIT_MASK 0x1 FORMAT "%13.11" ECU_ADDRESS 0x500054B2 /end MEASUREMENT
/begin MEASUREMENT ResFilLtrB1_I.flgShtrpParl "Class instance for result filtering in lean-rich direction for lambda-based dynamics diagnosis of a wideband-sensor (bank 1) / Short trip request from parallelization" UBYTE B_TRUE 1 100 0.00 1.00000000000 BIT_MASK 0x1 FORMAT "%13.11" ECU_ADDRESS 0x500054B3 /end MEASUREMENT
/begin MEASUREMENT ResFilLtrB1_I.flgStepChg "Class instance for result filtering in lean-rich direction for lambda-based dynamics diagnosis of a wideband-sensor (bank 1) / Step change active" UBYTE B_TRUE 1 100 0.00 1.00000000000 BIT_MASK 0x1 FORMAT "%13.11" ECU_ADDRESS 0x60036631 /end MEASUREMENT
/begin MEASUREMENT ResFilLtrB1_I.nrMeasTrip "Class instance for result filtering in lean-rich direction for lambda-based dynamics diagnosis of a wideband-sensor (bank 1) / Number of measurements in current trip" UBYTE dez 1 100 0.00 255.0 FORMAT "%5.1" ECU_ADDRESS 0x500054B4 /end MEASUREMENT
/begin MEASUREMENT ResFilLtrB1_I.tiDlyAvrg "Class instance for result filtering in lean-rich direction for lambda-based dynamics diagnosis of a wideband-sensor (bank 1) / Averaged delay time" UWORD t_q0p01 1 100 0.00 655.3500 FORMAT "%8.4" ECU_ADDRESS 0x60036632 /end MEASUREMENT
/begin MEASUREMENT ResFilLtrB1_I.tiDlyEwma "Class instance for result filtering in lean-rich direction for lambda-based dynamics diagnosis of a wideband-sensor (bank 1) / Exponentially weigthed moving average (EWMA) of delay time" UWORD t_q0p01 1 100 0.00 655.3500 FORMAT "%8.4" ECU_ADDRESS 0x60036634 /end MEASUREMENT
/begin MEASUREMENT ResFilLtrB1_I.tiDlyStepRaw "Class instance for result filtering in lean-rich direction for lambda-based dynamics diagnosis of a wideband-sensor (bank 1) / Raw signal of delay time (unfiltered)" SWORD t_q0p01 1 100 -327.6800 327.6700 FORMAT "%8.4" ECU_ADDRESS 0x500054B6 /end MEASUREMENT
/begin MEASUREMENT ResFilLtrB1_I.tiTranAvrg "Class instance for result filtering in lean-rich direction for lambda-based dynamics diagnosis of a wideband-sensor (bank 1) / Averaged transition time" UWORD t_q0p01 1 100 0.00 655.3500 FORMAT "%8.4" ECU_ADDRESS 0x60036636 /end MEASUREMENT
/begin MEASUREMENT ResFilLtrB1_I.tiTranEwma "Class instance for result filtering in lean-rich direction for lambda-based dynamics diagnosis of a wideband-sensor (bank 1) / Exponentially weigthed moving average (EWMA) of transition time" UWORD t_q0p01 1 100 0.00 655.3500 FORMAT "%8.4" ECU_ADDRESS 0x60036638 /end MEASUREMENT
/begin MEASUREMENT ResFilLtrB1_I.tiTranStepRaw "Class instance for result filtering in lean-rich direction for lambda-based dynamics diagnosis of a wideband-sensor (bank 1) / Raw signal of transition time (unfiltered)" SWORD t_q0p01 1 100 -327.6800 327.6700 FORMAT "%8.4" ECU_ADDRESS 0x500054B8 /end MEASUREMENT
/begin MEASUREMENT ResFilLtrB1_I.tiDlyAvrgDL_I.memory "Class instance for result filtering in lean-rich direction for lambda-based dynamics diagnosis of a wideband-sensor (bank 1) / Digital lowpass for averaged delay time / current lowpass value" SLONG q1p5259Em7_s 1 100 -327.680000000 327.679999847 FORMAT "%13.9" ECU_ADDRESS 0x500018C4 /end MEASUREMENT
/begin MEASUREMENT ResFilLtrB1_I.tiDlyAvrgShtrpDL_I.memory "Class instance for result filtering in lean-rich direction for lambda-based dynamics diagnosis of a wideband-sensor (bank 1) / Digital lowpass for averaged delay time during short trip / current lowpass value" SLONG q1p5259Em7_s 1 100 -327.680000000 327.679999847 FORMAT "%13.9" ECU_ADDRESS 0x500018C8 /end MEASUREMENT
/begin MEASUREMENT ResFilLtrB1_I.tiDlyEwmaDL_I.memory "Class instance for result filtering in lean-rich direction for lambda-based dynamics diagnosis of a wideband-sensor (bank 1) / Digital lowpass for exponentially weigthed moving average (EWMA) of delay time / current lowpass value" SLONG q1p5259Em7_s 1 100 -327.680000000 327.679999847 FORMAT "%13.9" ECU_ADDRESS 0x500018CC /end MEASUREMENT
/begin MEASUREMENT ResFilLtrB1_I.tiTranAvrgDL_I.memory "Class instance for result filtering in lean-rich direction for lambda-based dynamics diagnosis of a wideband-sensor (bank 1) / Digital lowpass for averaged transition time / current lowpass value" SLONG q1p5259Em7_s 1 100 -327.680000000 327.679999847 FORMAT "%13.9" ECU_ADDRESS 0x500018D0 /end MEASUREMENT
/begin MEASUREMENT ResFilLtrB1_I.tiTranAvrgShtrpDL_I.memory "Class instance for result filtering in lean-rich direction for lambda-based dynamics diagnosis of a wideband-sensor (bank 1) / Digital lowpass for averaged transition time during short trip / current lowpass value" SLONG q1p5259Em7_s 1 100 -327.680000000 327.679999847 FORMAT "%13.9" ECU_ADDRESS 0x500018D4 /end MEASUREMENT
/begin MEASUREMENT ResFilLtrB1_I.tiTranEwmaDL_I.memory "Class instance for result filtering in lean-rich direction for lambda-based dynamics diagnosis of a wideband-sensor (bank 1) / Digital lowpass for exponentially weigthed moving average (EWMA) of transition time / current lowpass value" SLONG q1p5259Em7_s 1 100 -327.680000000 327.679999847 FORMAT "%13.9" ECU_ADDRESS 0x500018D8 /end MEASUREMENT
/begin MEASUREMENT ResFilRtlB1_I.cntrStep "Class instance for result filtering in rich-lean direction for lambda-based dynamics diagnosis of a wideband-sensor (bank 1) / Counter of step responses" UBYTE dez 1 100 0.00 255.0 FORMAT "%5.1" ECU_ADDRESS 0x60036626 /end MEASUREMENT
/begin MEASUREMENT ResFilRtlB1_I.cntrStepShtrp "Class instance for result filtering in rich-lean direction for lambda-based dynamics diagnosis of a wideband-sensor (bank 1) / Counter of step responses during short trip" UBYTE dez 1 100 0.00 255.0 FORMAT "%5.1" ECU_ADDRESS 0x500018DC /end MEASUREMENT
/begin MEASUREMENT ResFilRtlB1_I.flgArith "Class instance for result filtering in rich-lean direction for lambda-based dynamics diagnosis of a wideband-sensor (bank 1) / Arithmetic filtering active" UBYTE B_TRUE 1 100 0.00 1.00000000000 BIT_MASK 0x1 FORMAT "%13.11" ECU_ADDRESS 0x500018DD /end MEASUREMENT
/begin MEASUREMENT ResFilRtlB1_I.flgProdModParl "Class instance for result filtering in rich-lean direction for lambda-based dynamics diagnosis of a wideband-sensor (bank 1) / Production mode needs to be considered for parallel diagnosis of exhaust gas system" UBYTE B_TRUE 1 100 0.00 1.00000000000 BIT_MASK 0x1 FORMAT "%13.11" ECU_ADDRESS 0x500054BA /end MEASUREMENT
/begin MEASUREMENT ResFilRtlB1_I.flgShtrpParl "Class instance for result filtering in rich-lean direction for lambda-based dynamics diagnosis of a wideband-sensor (bank 1) / Short trip request from parallelization" UBYTE B_TRUE 1 100 0.00 1.00000000000 BIT_MASK 0x1 FORMAT "%13.11" ECU_ADDRESS 0x500054BB /end MEASUREMENT
/begin MEASUREMENT ResFilRtlB1_I.flgStepChg "Class instance for result filtering in rich-lean direction for lambda-based dynamics diagnosis of a wideband-sensor (bank 1) / Step change active" UBYTE B_TRUE 1 100 0.00 1.00000000000 BIT_MASK 0x1 FORMAT "%13.11" ECU_ADDRESS 0x60036627 /end MEASUREMENT
/begin MEASUREMENT ResFilRtlB1_I.nrMeasTrip "Class instance for result filtering in rich-lean direction for lambda-based dynamics diagnosis of a wideband-sensor (bank 1) / Number of measurements in current trip" UBYTE dez 1 100 0.00 255.0 FORMAT "%5.1" ECU_ADDRESS 0x500054BC /end MEASUREMENT
/begin MEASUREMENT ResFilRtlB1_I.tiDlyAvrg "Class instance for result filtering in rich-lean direction for lambda-based dynamics diagnosis of a wideband-sensor (bank 1) / Averaged delay time" UWORD t_q0p01 1 100 0.00 655.3500 FORMAT "%8.4" ECU_ADDRESS 0x60036628 /end MEASUREMENT
/begin MEASUREMENT ResFilRtlB1_I.tiDlyEwma "Class instance for result filtering in rich-lean direction for lambda-based dynamics diagnosis of a wideband-sensor (bank 1) / Exponentially weigthed moving average (EWMA) of delay time" UWORD t_q0p01 1 100 0.00 655.3500 FORMAT "%8.4" ECU_ADDRESS 0x6003662A /end MEASUREMENT
/begin MEASUREMENT ResFilRtlB1_I.tiDlyStepRaw "Class instance for result filtering in rich-lean direction for lambda-based dynamics diagnosis of a wideband-sensor (bank 1) / Raw signal of delay time (unfiltered)" SWORD t_q0p01 1 100 -327.6800 327.6700 FORMAT "%8.4" ECU_ADDRESS 0x500054BE /end MEASUREMENT
/begin MEASUREMENT ResFilRtlB1_I.tiTranAvrg "Class instance for result filtering in rich-lean direction for lambda-based dynamics diagnosis of a wideband-sensor (bank 1) / Averaged transition time" UWORD t_q0p01 1 100 0.00 655.3500 FORMAT "%8.4" ECU_ADDRESS 0x6003662C /end MEASUREMENT
/begin MEASUREMENT ResFilRtlB1_I.tiTranEwma "Class instance for result filtering in rich-lean direction for lambda-based dynamics diagnosis of a wideband-sensor (bank 1) / Exponentially weigthed moving average (EWMA) of transition time" UWORD t_q0p01 1 100 0.00 655.3500 FORMAT "%8.4" ECU_ADDRESS 0x6003662E /end MEASUREMENT
/begin MEASUREMENT ResFilRtlB1_I.tiTranStepRaw "Class instance for result filtering in rich-lean direction for lambda-based dynamics diagnosis of a wideband-sensor (bank 1) / Raw signal of transition time (unfiltered)" SWORD t_q0p01 1 100 -327.6800 327.6700 FORMAT "%8.4" ECU_ADDRESS 0x500054C0 /end MEASUREMENT
/begin MEASUREMENT ResFilRtlB1_I.tiDlyAvrgDL_I.memory "Class instance for result filtering in rich-lean direction for lambda-based dynamics diagnosis of a wideband-sensor (bank 1) / Digital lowpass for averaged delay time / current lowpass value" SLONG q1p5259Em7_s 1 100 -327.680000000 327.679999847 FORMAT "%13.9" ECU_ADDRESS 0x500018E0 /end MEASUREMENT
/begin MEASUREMENT ResFilRtlB1_I.tiDlyAvrgShtrpDL_I.memory "Class instance for result filtering in rich-lean direction for lambda-based dynamics diagnosis of a wideband-sensor (bank 1) / Digital lowpass for averaged delay time during short trip / current lowpass value" SLONG q1p5259Em7_s 1 100 -327.680000000 327.679999847 FORMAT "%13.9" ECU_ADDRESS 0x500018E4 /end MEASUREMENT
/begin MEASUREMENT ResFilRtlB1_I.tiDlyEwmaDL_I.memory "Class instance for result filtering in rich-lean direction for lambda-based dynamics diagnosis of a wideband-sensor (bank 1) / Digital lowpass for exponentially weigthed moving average (EWMA) of delay time / current lowpass value" SLONG q1p5259Em7_s 1 100 -327.680000000 327.679999847 FORMAT "%13.9" ECU_ADDRESS 0x500018E8 /end MEASUREMENT
/begin MEASUREMENT ResFilRtlB1_I.tiTranAvrgDL_I.memory "Class instance for result filtering in rich-lean direction for lambda-based dynamics diagnosis of a wideband-sensor (bank 1) / Digital lowpass for averaged transition time / current lowpass value" SLONG q1p5259Em7_s 1 100 -327.680000000 327.679999847 FORMAT "%13.9" ECU_ADDRESS 0x500018EC /end MEASUREMENT
/begin MEASUREMENT ResFilRtlB1_I.tiTranAvrgShtrpDL_I.memory "Class instance for result filtering in rich-lean direction for lambda-based dynamics diagnosis of a wideband-sensor (bank 1) / Digital lowpass for averaged transition time during short trip / current lowpass value" SLONG q1p5259Em7_s 1 100 -327.680000000 327.679999847 FORMAT "%13.9" ECU_ADDRESS 0x500018F0 /end MEASUREMENT
/begin MEASUREMENT ResFilRtlB1_I.tiTranEwmaDL_I.memory "Class instance for result filtering in rich-lean direction for lambda-based dynamics diagnosis of a wideband-sensor (bank 1) / Digital lowpass for exponentially weigthed moving average (EWMA) of transition time / current lowpass value" SLONG q1p5259Em7_s 1 100 -327.680000000 327.679999847 FORMAT "%13.9" ECU_ADDRESS 0x500018F4 /end MEASUREMENT
/begin MEASUREMENT StepLtrB1_I.cntrStepEvln "Class instance for step response measurement for lambda-based dynamics diagnosis of a wideband-sensor in lean-lean direction (bank 1) / Counter of measurement data during step response measurement" UWORD dez 1 100 0.00 65535.00 FORMAT "%8.2" ECU_ADDRESS 0x6000CE02 /end MEASUREMENT
/begin MEASUREMENT StepLtrB1_I.dratLamRecprLow "Class instance for step response measurement for lambda-based dynamics diagnosis of a wideband-sensor in lean-lean direction (bank 1) / lambda dynamic low" SWORD freq_q9p1553Em5 1 100 -3.000000 2.999908 FORMAT "%8.6" ECU_ADDRESS 0x6000CE04 /end MEASUREMENT
/begin MEASUREMENT StepLtrB1_I.dratLamRecprPeak "Class instance for step response measurement for lambda-based dynamics diagnosis of a wideband-sensor in lean-lean direction (bank 1) / Maximal or minimal gradient of reciprocal lambda" SWORD freq_q9p1553Em5 1 100 -3.000000 2.999908 FORMAT "%8.6" ECU_ADDRESS 0x6000CE06 /end MEASUREMENT
/begin MEASUREMENT StepLtrB1_I.dratLamRecprPeakNrm "Class instance for step response measurement for lambda-based dynamics diagnosis of a wideband-sensor in lean-lean direction (bank 1) / Maximal or minimal gradient of reciprocal lambda (normalized)" UWORD fak_uw_b1 1 100 0.00 0.9999847 FORMAT "%9.7" ECU_ADDRESS 0x6000CE08 /end MEASUREMENT
/begin MEASUREMENT StepLtrB1_I.flgStepEvln "Class instance for step response measurement for lambda-based dynamics diagnosis of a wideband-sensor in lean-lean direction (bank 1) / Evaluation of step response measurement active" UBYTE B_TRUE 1 100 0.00 1.00000000000 BIT_MASK 0x1 FORMAT "%13.11" ECU_ADDRESS 0x6000CE00 /end MEASUREMENT
/begin MEASUREMENT StepLtrB1_I.flgStepEvlnRes "Class instance for step response measurement for lambda-based dynamics diagnosis of a wideband-sensor in lean-lean direction (bank 1) / Step evaluated" UBYTE B_TRUE 1 100 0.00 1.00000000000 BIT_MASK 0x1 FORMAT "%13.11" ECU_ADDRESS 0x60006572 /end MEASUREMENT
/begin MEASUREMENT StepLtrB1_I.flgStepEvlnSuc "Class instance for step response measurement for lambda-based dynamics diagnosis of a wideband-sensor in lean-lean direction (bank 1) / Evaluation of step response measurement successful" UBYTE B_TRUE 1 100 0.00 1.00000000000 BIT_MASK 0x4 FORMAT "%13.11" ECU_ADDRESS 0x6000CE00 /end MEASUREMENT
/begin MEASUREMENT StepLtrB1_I.flgStepGrdt "Class instance for step response measurement for lambda-based dynamics diagnosis of a wideband-sensor in lean-lean direction (bank 1) / stepchange high enough" UBYTE B_TRUE 1 100 0.00 1.00000000000 BIT_MASK 0x8 FORMAT "%13.11" ECU_ADDRESS 0x6000CE00 /end MEASUREMENT
/begin MEASUREMENT StepLtrB1_I.ratLamRecprFildPeak "Class instance for step response measurement for lambda-based dynamics diagnosis of a wideband-sensor in lean-lean direction (bank 1) / Minimal or maximal value of reciprocal lambda after step" UWORD fak_q3p0518Em5 1 100 0.00 1.999969 FORMAT "%8.6" ECU_ADDRESS 0x6000CE0A /end MEASUREMENT
/begin MEASUREMENT StepLtrB1_I.ratLamRecprGrdtPeak "Class instance for step response measurement for lambda-based dynamics diagnosis of a wideband-sensor in lean-lean direction (bank 1) / Reciprocal lambda at maximal or minimal gradient" UWORD fak_q3p0518Em5 1 100 0.00 1.999969 FORMAT "%8.6" ECU_ADDRESS 0x6000CE0C /end MEASUREMENT
/begin MEASUREMENT StepLtrB1_I.ratLamRecprMax "Class instance for step response measurement for lambda-based dynamics diagnosis of a wideband-sensor in lean-lean direction (bank 1) / maximum reciprocal lambda" UWORD fak_uw_b2 1 100 0.00 1.999969 FORMAT "%8.6" ECU_ADDRESS 0x6000CE0E /end MEASUREMENT
/begin MEASUREMENT StepLtrB1_I.ratLamRecprMin "Class instance for step response measurement for lambda-based dynamics diagnosis of a wideband-sensor in lean-lean direction (bank 1) / minumum reciprocal lambda" UWORD fak_uw_b2 1 100 0.00 1.999969 FORMAT "%8.6" ECU_ADDRESS 0x6000CE10 /end MEASUREMENT
/begin MEASUREMENT StepLtrB1_I.ratLamRecprStepHeiBgnReal "Class instance for step response measurement for lambda-based dynamics diagnosis of a wideband-sensor in lean-lean direction (bank 1) / reciprocal lambda at the beginning of a step" UWORD fak_uw_b2 1 100 0.00 1.999969 FORMAT "%8.6" ECU_ADDRESS 0x6000CE12 /end MEASUREMENT
/begin MEASUREMENT StepLtrB1_I.ratLamRecprStepHeiReal "Class instance for step response measurement for lambda-based dynamics diagnosis of a wideband-sensor in lean-lean direction (bank 1) / reciprocal lambda" UWORD fak_uw_b2 1 100 0.00 1.999969 FORMAT "%8.6" ECU_ADDRESS 0x6000CE14 /end MEASUREMENT
/begin MEASUREMENT StepLtrB1_I.ratTran "Class instance for step response measurement for lambda-based dynamics diagnosis of a wideband-sensor in lean-lean direction (bank 1) / Ratio of transition times (sensor fault to nominal)" UWORD fak_uw_b32 1 100 0.00 31.99951 FORMAT "%8.5" ECU_ADDRESS 0x6000CE16 /end MEASUREMENT
/begin MEASUREMENT StepLtrB1_I.tiDly "Class instance for step response measurement for lambda-based dynamics diagnosis of a wideband-sensor in lean-lean direction (bank 1) / Detected delay time" SWORD t_q0p01 1 100 -327.6800 327.6700 FORMAT "%8.4" ECU_ADDRESS 0x6000CE18 /end MEASUREMENT
/begin MEASUREMENT StepLtrB1_I.tiDlyBasc "Class instance for step response measurement for lambda-based dynamics diagnosis of a wideband-sensor in lean-lean direction (bank 1) / Detected delay time (basic value)" SWORD t_q0p01 1 100 -327.6800 327.6700 FORMAT "%8.4" ECU_ADDRESS 0x6000CE1A /end MEASUREMENT
/begin MEASUREMENT StepLtrB1_I.tiDlyEquiv "Class instance for step response measurement for lambda-based dynamics diagnosis of a wideband-sensor in lean-lean direction (bank 1) / Equivalent delay time" UWORD t_q0p01 1 100 0.00 655.3500 FORMAT "%8.4" ECU_ADDRESS 0x6000CE1C /end MEASUREMENT
/begin MEASUREMENT StepLtrB1_I.tiGrdtPeak "Class instance for step response measurement for lambda-based dynamics diagnosis of a wideband-sensor in lean-lean direction (bank 1) / Time of maximal or minimal gradient" UWORD t_q0p01 1 100 0.00 655.3500 FORMAT "%8.4" ECU_ADDRESS 0x6000CE1E /end MEASUREMENT
/begin MEASUREMENT StepLtrB1_I.tiStepTmr "Class instance for step response measurement for lambda-based dynamics diagnosis of a wideband-sensor in lean-lean direction (bank 1) / Time after step" UWORD t_q0p01 1 100 0.00 655.3500 FORMAT "%8.4" ECU_ADDRESS 0x6000CE20 /end MEASUREMENT
/begin MEASUREMENT StepLtrB1_I.tiTran "Class instance for step response measurement for lambda-based dynamics diagnosis of a wideband-sensor in lean-lean direction (bank 1) / Detected transition time" SWORD t_q0p01 1 100 -327.6800 327.6700 FORMAT "%8.4" ECU_ADDRESS 0x6000CE22 /end MEASUREMENT
/begin MEASUREMENT StepLtrB1_I.StepEvlnERNM_I.oldSignal "Class instance for step response measurement for lambda-based dynamics diagnosis of a wideband-sensor in lean-lean direction (bank 1) / Edge rising at begin of step response evaluation / value of input signal last calculation" UBYTE B_TRUE 1 100 0.00 1.00000000000 BIT_MASK 0x1 FORMAT "%13.11" ECU_ADDRESS 0x6000CE24 /end MEASUREMENT
/begin MEASUREMENT StepLtrB1_I.StepEvlnFF_I.status "Class instance for step response measurement for lambda-based dynamics diagnosis of a wideband-sensor in lean-lean direction (bank 1) / Flip-Flop for successful evaluation of step response / current value of RS-FF" UBYTE B_TRUE 1 100 0.00 1.00000000000 BIT_MASK 0x1 FORMAT "%13.11" ECU_ADDRESS 0x6000CE25 /end MEASUREMENT
/begin MEASUREMENT StepLtrB1_I.StepEvlnSucER_I.buffer "Class instance for step response measurement for lambda-based dynamics diagnosis of a wideband-sensor in lean-lean direction (bank 1) / Edge rising for step response evaluation successful / rising edge detected" UBYTE B_TRUE 1 100 0.00 1.00000000000 BIT_MASK 0x1 FORMAT "%13.11" ECU_ADDRESS 0x6000CE26 /end MEASUREMENT
/begin MEASUREMENT StepLtrB1_I.StepEvlnSucER_I.oldSignal "Class instance for step response measurement for lambda-based dynamics diagnosis of a wideband-sensor in lean-lean direction (bank 1) / Edge rising for step response evaluation successful / flag rising edge" UBYTE B_TRUE 1 100 0.00 1.00000000000 BIT_MASK 0x1 FORMAT "%13.11" ECU_ADDRESS 0x6000CE27 /end MEASUREMENT
/begin MEASUREMENT StepLtrB1_I.StepEvlnTONV_I.outbit "Class instance for step response measurement for lambda-based dynamics diagnosis of a wideband-sensor in lean-lean direction (bank 1) / Turn-on delay for step response evaluation / return value" UBYTE B_TRUE 1 100 0.00 1.00000000000 BIT_MASK 0x1 FORMAT "%13.11" ECU_ADDRESS 0x6000CE28 /end MEASUREMENT
/begin MEASUREMENT StepLtrB1_I.StepEvlnTONV_I.time "Class instance for step response measurement for lambda-based dynamics diagnosis of a wideband-sensor in lean-lean direction (bank 1) / Turn-on delay for step response evaluation / expired delay time" UWORD t_q0p01 1 100 0.00 655.3500 FORMAT "%8.4" ECU_ADDRESS 0x6000CE2A /end MEASUREMENT
/begin MEASUREMENT StepLtrB1_I.TarDneER_I.buffer "Class instance for step response measurement for lambda-based dynamics diagnosis of a wideband-sensor in lean-lean direction (bank 1) / target done / rising edge detected" UBYTE B_TRUE 1 100 0.00 1.00000000000 BIT_MASK 0x1 FORMAT "%13.11" ECU_ADDRESS 0x6000CE2C /end MEASUREMENT
/begin MEASUREMENT StepLtrB1_I.TarDneER_I.oldSignal "Class instance for step response measurement for lambda-based dynamics diagnosis of a wideband-sensor in lean-lean direction (bank 1) / target done / flag rising edge" UBYTE B_TRUE 1 100 0.00 1.00000000000 BIT_MASK 0x1 FORMAT "%13.11" ECU_ADDRESS 0x6000CE2D /end MEASUREMENT
/begin MEASUREMENT StepLtrB1_I.TarDneFF_I.status "Class instance for step response measurement for lambda-based dynamics diagnosis of a wideband-sensor in lean-lean direction (bank 1) / target done / current value of RS-FF" UBYTE B_TRUE 1 100 0.00 1.00000000000 BIT_MASK 0x1 FORMAT "%13.11" ECU_ADDRESS 0x6000CE2E /end MEASUREMENT
/begin MEASUREMENT StepLtrB1_I.flgStepEF_I.buffer "Class instance for step response measurement for lambda-based dynamics diagnosis of a wideband-sensor in lean-lean direction (bank 1) / Stepdetection reset / memory to detect falling edge" UBYTE B_TRUE 1 100 0.00 1.00000000000 BIT_MASK 0x1 FORMAT "%13.11" ECU_ADDRESS 0x6000CE30 /end MEASUREMENT
/begin MEASUREMENT StepLtrB1_I.flgStepEF_I.oldSignal "Class instance for step response measurement for lambda-based dynamics diagnosis of a wideband-sensor in lean-lean direction (bank 1) / Stepdetection reset / memory to detect falling edge" UBYTE B_TRUE 1 100 0.00 1.00000000000 BIT_MASK 0x1 FORMAT "%13.11" ECU_ADDRESS 0x6000CE31 /end MEASUREMENT
/begin MEASUREMENT StepLtrB1_I.tiDeadTiNomAvrgDL_I.memory "Class instance for step response measurement for lambda-based dynamics diagnosis of a wideband-sensor in lean-lean direction (bank 1) / Digital lowpass to average nominal dead time / current lowpass value" ULONG q1p5259Em7_s 1 100 0.00 655.359999847 FORMAT "%13.9" ECU_ADDRESS 0x6000CE34 /end MEASUREMENT
/begin MEASUREMENT StepLtrB1_I.tiTiConNomAvrgDL_I.memory "Class instance for step response measurement for lambda-based dynamics diagnosis of a wideband-sensor in lean-lean direction (bank 1) / Digital lowpass to average nominal time constant / current lowpass value" ULONG q1p5259Em7_s 1 100 0.00 655.359999847 FORMAT "%13.9" ECU_ADDRESS 0x6000CE38 /end MEASUREMENT
/begin MEASUREMENT StepRtlB1_I.cntrStepEvln "Class instance for step response measurement for lambda-based dynamics diagnosis of a wideband-sensor in rich-lean direction (bank 1) / Counter of measurement data during step response measurement" UWORD dez 1 100 0.00 65535.00 FORMAT "%8.2" ECU_ADDRESS 0x6000CE3E /end MEASUREMENT
/begin MEASUREMENT StepRtlB1_I.dratLamRecprLow "Class instance for step response measurement for lambda-based dynamics diagnosis of a wideband-sensor in rich-lean direction (bank 1) / lambda dynamic low" SWORD freq_q9p1553Em5 1 100 -3.000000 2.999908 FORMAT "%8.6" ECU_ADDRESS 0x6000CE40 /end MEASUREMENT
/begin MEASUREMENT StepRtlB1_I.dratLamRecprPeak "Class instance for step response measurement for lambda-based dynamics diagnosis of a wideband-sensor in rich-lean direction (bank 1) / Maximal or minimal gradient of reciprocal lambda" SWORD freq_q9p1553Em5 1 100 -3.000000 2.999908 FORMAT "%8.6" ECU_ADDRESS 0x6000CE42 /end MEASUREMENT
/begin MEASUREMENT StepRtlB1_I.dratLamRecprPeakNrm "Class instance for step response measurement for lambda-based dynamics diagnosis of a wideband-sensor in rich-lean direction (bank 1) / Maximal or minimal gradient of reciprocal lambda (normalized)" UWORD fak_uw_b1 1 100 0.00 0.9999847 FORMAT "%9.7" ECU_ADDRESS 0x6000CE44 /end MEASUREMENT
/begin MEASUREMENT StepRtlB1_I.flgStepEvln "Class instance for step response measurement for lambda-based dynamics diagnosis of a wideband-sensor in rich-lean direction (bank 1) / Evaluation of step response measurement active" UBYTE B_TRUE 1 100 0.00 1.00000000000 BIT_MASK 0x1 FORMAT "%13.11" ECU_ADDRESS 0x6000CE3C /end MEASUREMENT
/begin MEASUREMENT StepRtlB1_I.flgStepEvlnRes "Class instance for step response measurement for lambda-based dynamics diagnosis of a wideband-sensor in rich-lean direction (bank 1) / Step evaluated" UBYTE B_TRUE 1 100 0.00 1.00000000000 BIT_MASK 0x1 FORMAT "%13.11" ECU_ADDRESS 0x60006571 /end MEASUREMENT
/begin MEASUREMENT StepRtlB1_I.flgStepEvlnSuc "Class instance for step response measurement for lambda-based dynamics diagnosis of a wideband-sensor in rich-lean direction (bank 1) / Evaluation of step response measurement successful" UBYTE B_TRUE 1 100 0.00 1.00000000000 BIT_MASK 0x4 FORMAT "%13.11" ECU_ADDRESS 0x6000CE3C /end MEASUREMENT
/begin MEASUREMENT StepRtlB1_I.flgStepGrdt "Class instance for step response measurement for lambda-based dynamics diagnosis of a wideband-sensor in rich-lean direction (bank 1) / stepchange high enough" UBYTE B_TRUE 1 100 0.00 1.00000000000 BIT_MASK 0x8 FORMAT "%13.11" ECU_ADDRESS 0x6000CE3C /end MEASUREMENT
/begin MEASUREMENT StepRtlB1_I.ratLamRecprFildPeak "Class instance for step response measurement for lambda-based dynamics diagnosis of a wideband-sensor in rich-lean direction (bank 1) / Minimal or maximal value of reciprocal lambda after step" UWORD fak_q3p0518Em5 1 100 0.00 1.999969 FORMAT "%8.6" ECU_ADDRESS 0x6000CE46 /end MEASUREMENT
/begin MEASUREMENT StepRtlB1_I.ratLamRecprGrdtPeak "Class instance for step response measurement for lambda-based dynamics diagnosis of a wideband-sensor in rich-lean direction (bank 1) / Reciprocal lambda at maximal or minimal gradient" UWORD fak_q3p0518Em5 1 100 0.00 1.999969 FORMAT "%8.6" ECU_ADDRESS 0x6000CE48 /end MEASUREMENT
/begin MEASUREMENT StepRtlB1_I.ratLamRecprMax "Class instance for step response measurement for lambda-based dynamics diagnosis of a wideband-sensor in rich-lean direction (bank 1) / maximum reciprocal lambda" UWORD fak_uw_b2 1 100 0.00 1.999969 FORMAT "%8.6" ECU_ADDRESS 0x6000CE4A /end MEASUREMENT
/begin MEASUREMENT StepRtlB1_I.ratLamRecprMin "Class instance for step response measurement for lambda-based dynamics diagnosis of a wideband-sensor in rich-lean direction (bank 1) / minumum reciprocal lambda" UWORD fak_uw_b2 1 100 0.00 1.999969 FORMAT "%8.6" ECU_ADDRESS 0x6000CE4C /end MEASUREMENT
/begin MEASUREMENT StepRtlB1_I.ratLamRecprStepHeiBgnReal "Class instance for step response measurement for lambda-based dynamics diagnosis of a wideband-sensor in rich-lean direction (bank 1) / reciprocal lambda at the beginning of a step" UWORD fak_uw_b2 1 100 0.00 1.999969 FORMAT "%8.6" ECU_ADDRESS 0x6000CE4E /end MEASUREMENT
/begin MEASUREMENT StepRtlB1_I.ratLamRecprStepHeiReal "Class instance for step response measurement for lambda-based dynamics diagnosis of a wideband-sensor in rich-lean direction (bank 1) / reciprocal lambda" UWORD fak_uw_b2 1 100 0.00 1.999969 FORMAT "%8.6" ECU_ADDRESS 0x6000CE50 /end MEASUREMENT
/begin MEASUREMENT StepRtlB1_I.ratTran "Class instance for step response measurement for lambda-based dynamics diagnosis of a wideband-sensor in rich-lean direction (bank 1) / Ratio of transition times (sensor fault to nominal)" UWORD fak_uw_b32 1 100 0.00 31.99951 FORMAT "%8.5" ECU_ADDRESS 0x6000CE52 /end MEASUREMENT
/begin MEASUREMENT StepRtlB1_I.tiDly "Class instance for step response measurement for lambda-based dynamics diagnosis of a wideband-sensor in rich-lean direction (bank 1) / Detected delay time" SWORD t_q0p01 1 100 -327.6800 327.6700 FORMAT "%8.4" ECU_ADDRESS 0x6000CE54 /end MEASUREMENT
/begin MEASUREMENT StepRtlB1_I.tiDlyBasc "Class instance for step response measurement for lambda-based dynamics diagnosis of a wideband-sensor in rich-lean direction (bank 1) / Detected delay time (basic value)" SWORD t_q0p01 1 100 -327.6800 327.6700 FORMAT "%8.4" ECU_ADDRESS 0x6000CE56 /end MEASUREMENT
/begin MEASUREMENT StepRtlB1_I.tiDlyEquiv "Class instance for step response measurement for lambda-based dynamics diagnosis of a wideband-sensor in rich-lean direction (bank 1) / Equivalent delay time" UWORD t_q0p01 1 100 0.00 655.3500 FORMAT "%8.4" ECU_ADDRESS 0x6000CE58 /end MEASUREMENT
/begin MEASUREMENT StepRtlB1_I.tiGrdtPeak "Class instance for step response measurement for lambda-based dynamics diagnosis of a wideband-sensor in rich-lean direction (bank 1) / Time of maximal or minimal gradient" UWORD t_q0p01 1 100 0.00 655.3500 FORMAT "%8.4" ECU_ADDRESS 0x6000CE5A /end MEASUREMENT
/begin MEASUREMENT StepRtlB1_I.tiStepTmr "Class instance for step response measurement for lambda-based dynamics diagnosis of a wideband-sensor in rich-lean direction (bank 1) / Time after step" UWORD t_q0p01 1 100 0.00 655.3500 FORMAT "%8.4" ECU_ADDRESS 0x6000CE5C /end MEASUREMENT
/begin MEASUREMENT StepRtlB1_I.tiTran "Class instance for step response measurement for lambda-based dynamics diagnosis of a wideband-sensor in rich-lean direction (bank 1) / Detected transition time" SWORD t_q0p01 1 100 -327.6800 327.6700 FORMAT "%8.4" ECU_ADDRESS 0x6000CE5E /end MEASUREMENT
/begin MEASUREMENT StepRtlB1_I.StepEvlnERNM_I.oldSignal "Class instance for step response measurement for lambda-based dynamics diagnosis of a wideband-sensor in rich-lean direction (bank 1) / Edge rising at begin of step response evaluation / value of input signal last calculation" UBYTE B_TRUE 1 100 0.00 1.00000000000 BIT_MASK 0x1 FORMAT "%13.11" ECU_ADDRESS 0x6000CE60 /end MEASUREMENT
/begin MEASUREMENT StepRtlB1_I.StepEvlnFF_I.status "Class instance for step response measurement for lambda-based dynamics diagnosis of a wideband-sensor in rich-lean direction (bank 1) / Flip-Flop for successful evaluation of step response / current value of RS-FF" UBYTE B_TRUE 1 100 0.00 1.00000000000 BIT_MASK 0x1 FORMAT "%13.11" ECU_ADDRESS 0x6000CE61 /end MEASUREMENT
/begin MEASUREMENT StepRtlB1_I.StepEvlnSucER_I.buffer "Class instance for step response measurement for lambda-based dynamics diagnosis of a wideband-sensor in rich-lean direction (bank 1) / Edge rising for step response evaluation successful / rising edge detected" UBYTE B_TRUE 1 100 0.00 1.00000000000 BIT_MASK 0x1 FORMAT "%13.11" ECU_ADDRESS 0x6000CE62 /end MEASUREMENT
/begin MEASUREMENT StepRtlB1_I.StepEvlnSucER_I.oldSignal "Class instance for step response measurement for lambda-based dynamics diagnosis of a wideband-sensor in rich-lean direction (bank 1) / Edge rising for step response evaluation successful / flag rising edge" UBYTE B_TRUE 1 100 0.00 1.00000000000 BIT_MASK 0x1 FORMAT "%13.11" ECU_ADDRESS 0x6000CE63 /end MEASUREMENT
/begin MEASUREMENT StepRtlB1_I.StepEvlnTONV_I.outbit "Class instance for step response measurement for lambda-based dynamics diagnosis of a wideband-sensor in rich-lean direction (bank 1) / Turn-on delay for step response evaluation / return value" UBYTE B_TRUE 1 100 0.00 1.00000000000 BIT_MASK 0x1 FORMAT "%13.11" ECU_ADDRESS 0x6000CE64 /end MEASUREMENT
/begin MEASUREMENT StepRtlB1_I.StepEvlnTONV_I.time "Class instance for step response measurement for lambda-based dynamics diagnosis of a wideband-sensor in rich-lean direction (bank 1) / Turn-on delay for step response evaluation / expired delay time" UWORD t_q0p01 1 100 0.00 655.3500 FORMAT "%8.4" ECU_ADDRESS 0x6000CE66 /end MEASUREMENT
/begin MEASUREMENT StepRtlB1_I.TarDneER_I.buffer "Class instance for step response measurement for lambda-based dynamics diagnosis of a wideband-sensor in rich-lean direction (bank 1) / target done / rising edge detected" UBYTE B_TRUE 1 100 0.00 1.00000000000 BIT_MASK 0x1 FORMAT "%13.11" ECU_ADDRESS 0x6000CE68 /end MEASUREMENT
/begin MEASUREMENT StepRtlB1_I.TarDneER_I.oldSignal "Class instance for step response measurement for lambda-based dynamics diagnosis of a wideband-sensor in rich-lean direction (bank 1) / target done / flag rising edge" UBYTE B_TRUE 1 100 0.00 1.00000000000 BIT_MASK 0x1 FORMAT "%13.11" ECU_ADDRESS 0x6000CE69 /end MEASUREMENT
/begin MEASUREMENT StepRtlB1_I.TarDneFF_I.status "Class instance for step response measurement for lambda-based dynamics diagnosis of a wideband-sensor in rich-lean direction (bank 1) / target done / current value of RS-FF" UBYTE B_TRUE 1 100 0.00 1.00000000000 BIT_MASK 0x1 FORMAT "%13.11" ECU_ADDRESS 0x6000CE6A /end MEASUREMENT
/begin MEASUREMENT StepRtlB1_I.flgStepEF_I.buffer "Class instance for step response measurement for lambda-based dynamics diagnosis of a wideband-sensor in rich-lean direction (bank 1) / Stepdetection reset / memory to detect falling edge" UBYTE B_TRUE 1 100 0.00 1.00000000000 BIT_MASK 0x1 FORMAT "%13.11" ECU_ADDRESS 0x6000CE6C /end MEASUREMENT
/begin MEASUREMENT StepRtlB1_I.flgStepEF_I.oldSignal "Class instance for step response measurement for lambda-based dynamics diagnosis of a wideband-sensor in rich-lean direction (bank 1) / Stepdetection reset / memory to detect falling edge" UBYTE B_TRUE 1 100 0.00 1.00000000000 BIT_MASK 0x1 FORMAT "%13.11" ECU_ADDRESS 0x6000CE6D /end MEASUREMENT
/begin MEASUREMENT StepRtlB1_I.tiDeadTiNomAvrgDL_I.memory "Class instance for step response measurement for lambda-based dynamics diagnosis of a wideband-sensor in rich-lean direction (bank 1) / Digital lowpass to average nominal dead time / current lowpass value" ULONG q1p5259Em7_s 1 100 0.00 655.359999847 FORMAT "%13.9" ECU_ADDRESS 0x6000CE70 /end MEASUREMENT
/begin MEASUREMENT StepRtlB1_I.tiTiConNomAvrgDL_I.memory "Class instance for step response measurement for lambda-based dynamics diagnosis of a wideband-sensor in rich-lean direction (bank 1) / Digital lowpass to average nominal time constant / current lowpass value" ULONG q1p5259Em7_s 1 100 0.00 655.359999847 FORMAT "%13.9" ECU_ADDRESS 0x6000CE74 /end MEASUREMENT
/begin FUNCTION EGSDO2_LamDyn "1.40.0    Lambda based dynamic diagnosis of a wideband sensor"
 /begin DEF_CHARACTERISTIC EGSDO2_tiLamMonOkVirtThd_C EGSDO2_facIdnGainDly_C EGSDO2_facIdnGainTran_C EGSDO2_facMdlNrmSumMin_C EGSDO2_facQlyDeFltSuspc_C EGSDO2_facQlyDeOKThd_C EGSDO2_facQlyDeRstThd_C EGSDO2_facQlyFltSuspc_C EGSDO2_tiLossTmrThd_C EGSDO2_facBndToErrEvln_C EGSDO2_tiDlyStepChgCfm_C EGSDO2_tiDlyStepChgSuspc_C EGSDO2_tiEwma_C EGSDO2_tiTranStepChgCfm_C EGSDO2_tiTranStepChgSuspc_C EGSDO2_facDeltaStepEnd_C EGSDO2_facDlyEquiv_T EGSDO2_facTarLtrLamDyn_C EGSDO2_facTarRtlLamDyn_C EGSDO2_facTiTranTout_C EGSDO2_flgStepBgnReal_C EGSDO2_flgStepEndReal_C EGSDO2_ratTran_T EGSDO2_facBndToErrIdn_C EGSDO2_flgLamSpDyn_C EGSDO2_nrMeasFltCfm_C EGSDO2_stLamDyn_C EGSDO2_tiDlyLtrStepFltThd_C EGSDO2_tiDlyRtlStepFltThd_C EGSDO2_tiGrdtTmrThd_C EGSDO2_tiSumAdpnThd_C EGSDO2_tiSumDeltaAdpnThd_C EGSDO2_tiTranLtrStepFltThd_C EGSDO2_tiTranRtlStepFltThd_C /end DEF_CHARACTERISTIC
 /begin REF_CHARACTERISTIC EGSDO2_flgIdnDurgParl_CW EGSDO2_flgSeqDyn_C EGSDCmn_flgSymTranOnly_CW EGSDO2_numGrdtPnt_C EGSDO2_tiPt1LamDerS1_C /end REF_CHARACTERISTIC
 /begin IN_MEASUREMENT EGSDCmn_flgIdnAdpnEndParlS1B1 EGSDCmn_flgIdnAdpnEndVirtParlS1B1 EGSDCmn_flgProdModParl EGSDCmn_flgSeg1B1VirtReldFinalParl EGSDCmn_flgShtrpParl EGSDCmn_stLamGenrParlB1 EGSDCmn_stVirtLamDynParlB1 EGSDO2_dratLamRecprFildS1B1 EGSDO2_flgDynAdpnLtrS1B1 EGSDO2_flgDynAdpnRtlS1B1 EGSDO2_flgEnaIdnB1 EGSDO2_flgEnaIdnLtrB1 EGSDO2_flgEnaIdnRtlB1 EGSDO2_flgEnaLossB1 EGSDO2_flgLamDynDFCErrB1 EGSDO2_flgLamDynDFCTstdB1 EGSDO2_ratLamRecprBpLtrS1B1 EGSDO2_ratLamRecprBpRtlS1B1 EGSDO2_ratLamRecprBpS1B1 EGSDO2_ratLamRecprFildS1B1 EGSDO2_ratLamRecprMdlBpLtrS1B1 EGSDO2_ratLamRecprMdlBpRtlS1B1 EGSDO2_ratLamRecprMdlBpS1B1 EGSDO2_ratLamRecprMdlFltBpLtrS1B1 EGSDO2_ratLamRecprMdlFltBpRtlS1B1 EGSDO2_ratLamRecprMdlFltBpS1B1 EGSDO2_stStepB1 EGSDO2_tiDlyAdpnS1B1 EGSDO2_tiTranAdpnS1B1 LamCtrl_ratLamSpNoDynS1B1 lamsbg_w_msg SyC_ctPostDrvLeave tlrslb_w_msg zlrslb_w_msg /end IN_MEASUREMENT
 /begin OUT_MEASUREMENT EGSDO2_cntrStepLtrS1B1 EGSDO2_cntrStepLtrTripVirtS1B1 EGSDO2_cntrStepRtlS1B1 EGSDO2_cntrStepRtlTripVirtS1B1 EGSDO2_facMdlFltDeEvlnB1 EGSDO2_facMdlNomDeEvlnB1 EGSDO2_flgArithFiltg EGSDO2_flgDynStepLtrB1 EGSDO2_flgDynStepRtlB1 EGSDO2_flgIdnFinshdS1B1 EGSDO2_flgIdnFltSuspcDeltaS1B1 EGSDO2_flgIdnFltSuspcLtrS1B1 EGSDO2_flgIdnFltSuspcRtlS1B1 EGSDO2_flgIdnFltSuspcS1B1 EGSDO2_flgLamMonOkVirtB1 EGSDO2_flgLossEvlnDneB1 EGSDO2_flgLtrStepChgS1B1 EGSDO2_flgQlyDeFltSuspcB1 EGSDO2_flgRstAdpnDynB1 EGSDO2_flgRtlStepChgS1B1 EGSDO2_flgStepLtrEvlnS1B1 EGSDO2_flgStepRtlEvlnS1B1 EGSDO2_flgSymTranOnly EGSDO2_nrMeasLtrTrpS1B1 EGSDO2_nrMeasRtlTrpS1B1 EGSDO2_tiDlyIdnLtrB1 EGSDO2_tiDlyIdnRtlB1 EGSDO2_tiDlyLtrS1B1 EGSDO2_tiDlyLtrStepS1B1 EGSDO2_tiDlyRtlS1B1 EGSDO2_tiDlyRtlStepS1B1 EGSDO2_tiSumDeltaAdapS1B1 EGSDO2_tiTranIdnLtrB1 EGSDO2_tiTranIdnRtlB1 EGSDO2_tiTranLtrS1B1 EGSDO2_tiTranLtrStepS1B1 EGSDO2_tiTranRtlS1B1 EGSDO2_tiTranRtlStepS1B1 /end OUT_MEASUREMENT
 /begin LOC_MEASUREMENT DiumprB1_I.cntrStepLtrTripVirt DiumprB1_I.cntrStepRtlTripVirt DiumprB1_I.flgLamMonOkVirt DiumprB1_I.flgStepVirtDne DiumprB1_I.tiEnaIdnVirt DiumprB1_I.tiStepTmrVirt DiumprB1_I.StepStateVirt_I.flgDynStepLtrReset DiumprB1_I.StepStateVirt_I.flgDynStepLtrSet DiumprB1_I.StepStateVirt_I.flgDynStepRtlReset DiumprB1_I.StepStateVirt_I.flgDynStepRtlSet DiumprB1_I.StepVirtDneERNM_I.oldSignal DiumprB1_I.StepVirtLtrFF_I.status DiumprB1_I.StepVirtRtlFF_I.status EGSDO2_ctReini100msLamDyn EGSDO2_ctReIni10msLamDyn EGSDO2_DynStepExptLtrFF_I.status EGSDO2_DynStepExptRtlFF_I.status EGSDO2_DynStepLtrFF_I.status EGSDO2_DynStepRtlFF_I.status EGSDO2_flgLossEvlnRlsStepB1 EGSDO2_flgTranSlowB1 EGSDO2_LamDynNoInhb100msS1B1EFNM_I.oldSignal EGSDO2_LamDynNoInhbS1B1EF_I.buffer EGSDO2_LamDynNoInhbS1B1EF_I.oldSignal EGSDO2_QlyDeFltSuspcB1FF_I.status EGSDO2_ratLamRecprStepHeiB1 EGSDO2_RstAdpnDynB1FF_I.status EGSDO2_StepIf.dratLamRecprFild EGSDO2_StepIf.flgTranSlow EGSDO2_StepIf.lamsbg_w EGSDO2_StepIf.ratLamRecprFild EGSDO2_StepIf.ratLamRecprStepHei EGSDO2_StepIf.stLamGenrParl EGSDO2_StepIf.tlrslb_w EGSDO2_StepIf.zlrslb_w EGSDO2_StepStateB1_I.flgDynStepLtrReset EGSDO2_StepStateB1_I.flgDynStepLtrSet EGSDO2_StepStateB1_I.flgDynStepRtlReset EGSDO2_StepStateB1_I.flgDynStepRtlSet IdnLossB1_I.facMdlFltDe IdnLossB1_I.facMdlFltDeAvrg IdnLossB1_I.facMdlFltDeEvln IdnLossB1_I.facMdlFltQlySum IdnLossB1_I.facMdlNom IdnLossB1_I.facMdlNomBasSum IdnLossB1_I.facMdlNomDe IdnLossB1_I.facMdlNomDeAvrg IdnLossB1_I.facMdlNomDeEvln IdnLossB1_I.facMdlNomQlySum IdnLossB1_I.flgFltSuspc IdnLossB1_I.flgLossEvlnDne IdnLossB1_I.flgRlsStep IdnLossB1_I.flgRstAdpn IdnLossB1_I.tiLossTmr IdnLtrB1_I.dratLamDly IdnLtrB1_I.dratLamTran IdnLtrB1_I.ratLamErrNrm IdnLtrB1_I.ratLamRecprMdlBpFild IdnLtrB1_I.ratLamRecprMdlFltBpFild IdnLtrB1_I.tiDlyIdn IdnLtrB1_I.tiTranIdn IdnLtrB1_I.DerDlyDTTtopt_I.buffer IdnLtrB1_I.DerDlyDTTtopt_I.counter IdnLtrB1_I.DerDlyDTTtopt_I.ds IdnLtrB1_I.DerDlyDTTtopt_I.pointer IdnLtrB1_I.DlyIdnIK_I.memory IdnLtrB1_I.TranIdnIK_I.memory IdnRtlB1_I.dratLamDly IdnRtlB1_I.dratLamTran IdnRtlB1_I.ratLamErrNrm IdnRtlB1_I.ratLamRecprMdlBpFild IdnRtlB1_I.ratLamRecprMdlFltBpFild IdnRtlB1_I.tiDlyIdn IdnRtlB1_I.tiTranIdn IdnRtlB1_I.DerDlyDTTtopt_I.buffer IdnRtlB1_I.DerDlyDTTtopt_I.counter IdnRtlB1_I.DerDlyDTTtopt_I.ds IdnRtlB1_I.DerDlyDTTtopt_I.pointer IdnRtlB1_I.DlyIdnIK_I.memory IdnRtlB1_I.TranIdnIK_I.memory ResFilLtrB1_I.cntrStep ResFilLtrB1_I.cntrStepShtrp ResFilLtrB1_I.flgArith ResFilLtrB1_I.flgProdModParl ResFilLtrB1_I.flgShtrpParl ResFilLtrB1_I.flgStepChg ResFilLtrB1_I.nrMeasTrip ResFilLtrB1_I.tiDlyAvrg ResFilLtrB1_I.tiDlyEwma ResFilLtrB1_I.tiDlyStepRaw ResFilLtrB1_I.tiTranAvrg ResFilLtrB1_I.tiTranEwma ResFilLtrB1_I.tiTranStepRaw ResFilLtrB1_I.tiDlyAvrgDL_I.memory ResFilLtrB1_I.tiDlyAvrgShtrpDL_I.memory ResFilLtrB1_I.tiDlyEwmaDL_I.memory ResFilLtrB1_I.tiTranAvrgDL_I.memory ResFilLtrB1_I.tiTranAvrgShtrpDL_I.memory ResFilLtrB1_I.tiTranEwmaDL_I.memory ResFilRtlB1_I.cntrStep ResFilRtlB1_I.cntrStepShtrp ResFilRtlB1_I.flgArith ResFilRtlB1_I.flgProdModParl ResFilRtlB1_I.flgShtrpParl ResFilRtlB1_I.flgStepChg ResFilRtlB1_I.nrMeasTrip ResFilRtlB1_I.tiDlyAvrg ResFilRtlB1_I.tiDlyEwma ResFilRtlB1_I.tiDlyStepRaw ResFilRtlB1_I.tiTranAvrg ResFilRtlB1_I.tiTranEwma ResFilRtlB1_I.tiTranStepRaw ResFilRtlB1_I.tiDlyAvrgDL_I.memory ResFilRtlB1_I.tiDlyAvrgShtrpDL_I.memory ResFilRtlB1_I.tiDlyEwmaDL_I.memory ResFilRtlB1_I.tiTranAvrgDL_I.memory ResFilRtlB1_I.tiTranAvrgShtrpDL_I.memory ResFilRtlB1_I.tiTranEwmaDL_I.memory StepLtrB1_I.cntrStepEvln StepLtrB1_I.dratLamRecprLow StepLtrB1_I.dratLamRecprPeak StepLtrB1_I.dratLamRecprPeakNrm StepLtrB1_I.flgStepEvln StepLtrB1_I.flgStepEvlnRes StepLtrB1_I.flgStepEvlnSuc StepLtrB1_I.flgStepGrdt StepLtrB1_I.ratLamRecprFildPeak StepLtrB1_I.ratLamRecprGrdtPeak StepLtrB1_I.ratLamRecprMax StepLtrB1_I.ratLamRecprMin StepLtrB1_I.ratLamRecprStepHeiBgnReal StepLtrB1_I.ratLamRecprStepHeiReal StepLtrB1_I.ratTran StepLtrB1_I.tiDly StepLtrB1_I.tiDlyBasc StepLtrB1_I.tiDlyEquiv StepLtrB1_I.tiGrdtPeak StepLtrB1_I.tiStepTmr StepLtrB1_I.tiTran StepLtrB1_I.StepEvlnERNM_I.oldSignal StepLtrB1_I.StepEvlnFF_I.status StepLtrB1_I.StepEvlnSucER_I.buffer StepLtrB1_I.StepEvlnSucER_I.oldSignal StepLtrB1_I.StepEvlnTONV_I.outbit StepLtrB1_I.StepEvlnTONV_I.time StepLtrB1_I.TarDneER_I.buffer StepLtrB1_I.TarDneER_I.oldSignal StepLtrB1_I.TarDneFF_I.status StepLtrB1_I.flgStepEF_I.buffer StepLtrB1_I.flgStepEF_I.oldSignal StepLtrB1_I.tiDeadTiNomAvrgDL_I.memory StepLtrB1_I.tiTiConNomAvrgDL_I.memory StepRtlB1_I.cntrStepEvln StepRtlB1_I.dratLamRecprLow StepRtlB1_I.dratLamRecprPeak StepRtlB1_I.dratLamRecprPeakNrm StepRtlB1_I.flgStepEvln StepRtlB1_I.flgStepEvlnRes StepRtlB1_I.flgStepEvlnSuc StepRtlB1_I.flgStepGrdt StepRtlB1_I.ratLamRecprFildPeak StepRtlB1_I.ratLamRecprGrdtPeak StepRtlB1_I.ratLamRecprMax StepRtlB1_I.ratLamRecprMin StepRtlB1_I.ratLamRecprStepHeiBgnReal StepRtlB1_I.ratLamRecprStepHeiReal StepRtlB1_I.ratTran StepRtlB1_I.tiDly StepRtlB1_I.tiDlyBasc StepRtlB1_I.tiDlyEquiv StepRtlB1_I.tiGrdtPeak StepRtlB1_I.tiStepTmr StepRtlB1_I.tiTran StepRtlB1_I.StepEvlnERNM_I.oldSignal StepRtlB1_I.StepEvlnFF_I.status StepRtlB1_I.StepEvlnSucER_I.buffer StepRtlB1_I.StepEvlnSucER_I.oldSignal StepRtlB1_I.StepEvlnTONV_I.outbit StepRtlB1_I.StepEvlnTONV_I.time StepRtlB1_I.TarDneER_I.buffer StepRtlB1_I.TarDneER_I.oldSignal StepRtlB1_I.TarDneFF_I.status StepRtlB1_I.flgStepEF_I.buffer StepRtlB1_I.flgStepEF_I.oldSignal StepRtlB1_I.tiDeadTiNomAvrgDL_I.memory StepRtlB1_I.tiTiConNomAvrgDL_I.memory /end LOC_MEASUREMENT
 FUNCTION_VERSION "1.40.0" /end FUNCTION
/begin FUNCTION EGSDO2_LamDynAdpn "1.1.1     Calculation of the Dynamic Values for Adaptation of the Lambda Signal"
 /begin DEF_CHARACTERISTIC EGSDO2_tiAdpnPrmFil_C EGSDO2_ratTranDlyTiDeadLtr_C EGSDO2_ratTranDlyTiDeadRtl_C EGSDO2_ratTranDlyTiDeadSym_C EGSDO2_tiDlyAdpnThd_C EGSDO2_tiDlyDeltaAdpnThd_C EGSDO2_tiDlyDeltaStepAdpn_C EGSDO2_tiEvlnIdnFirst_C EGSDO2_tiEvlnIdnMax_C EGSDO2_tiEvlnIdn_C EGSDO2_tiTranAdpnThd_C EGSDO2_tiTranDeltaAdpnThd_C EGSDO2_tiTranDeltaStepAdpn_C /end DEF_CHARACTERISTIC
 /begin REF_CHARACTERISTIC EGSDO2_tiSumDeltaAdpnThd_C /end REF_CHARACTERISTIC
 /begin IN_MEASUREMENT EGSDO2_flgEnaIdnLtrB1 EGSDO2_flgEnaIdnRtlB1 EGSDO2_flgIdnFinshdS1B1 EGSDO2_flgIdnFltSuspcDeltaS1B1 EGSDO2_flgIdnFltSuspcLtrS1B1 EGSDO2_flgIdnFltSuspcRtlS1B1 EGSDO2_flgIdnFltSuspcS1B1 EGSDO2_flgRstAdpnDynB1 EGSDO2_flgStepLtrEvlnS1B1 EGSDO2_flgStepRtlEvlnS1B1 EGSDO2_flgSymTranOnly EGSDO2_tiDlyIdnLtrB1 EGSDO2_tiDlyIdnRtlB1 EGSDO2_tiDlyLtrS1B1 EGSDO2_tiDlyRtlS1B1 EGSDO2_tiSumDeltaAdapS1B1 EGSDO2_tiTranIdnLtrB1 EGSDO2_tiTranIdnRtlB1 EGSDO2_tiTranLtrS1B1 EGSDO2_tiTranRtlS1B1 SyC_ctPostDrvLeave /end IN_MEASUREMENT
 /begin OUT_MEASUREMENT EGSDO2_flgDynAdpnLtrS1B1 EGSDO2_flgDynAdpnRtlS1B1 EGSDO2_stStepB1 EGSDO2_tiDlyAdpnS1B1 EGSDO2_tiTranAdpnS1B1 /end OUT_MEASUREMENT
 /begin LOC_MEASUREMENT EGSDO2_ctReini100msLamDynAdpn EGSDO2_flgDSMClrAdpnParlB1 EGSDO2_LamDynAdpnCalcB1_I.flgDynLtr EGSDO2_LamDynAdpnCalcB1_I.flgDynRtl EGSDO2_LamDynAdpnCalcB1_I.flgIdnDne EGSDO2_LamDynAdpnCalcB1_I.flgIdnEvln EGSDO2_LamDynAdpnCalcB1_I.flgIdnFirstDne EGSDO2_LamDynAdpnCalcB1_I.flgIdnMax EGSDO2_LamDynAdpnCalcB1_I.flgStepDlyLtr EGSDO2_LamDynAdpnCalcB1_I.flgStepDlyRtl EGSDO2_LamDynAdpnCalcB1_I.flgStepDlySym EGSDO2_LamDynAdpnCalcB1_I.flgStepEvln EGSDO2_LamDynAdpnCalcB1_I.flgStepLtr EGSDO2_LamDynAdpnCalcB1_I.flgStepLtrDne EGSDO2_LamDynAdpnCalcB1_I.flgStepRtl EGSDO2_LamDynAdpnCalcB1_I.flgStepRtlDne EGSDO2_LamDynAdpnCalcB1_I.flgStepSym EGSDO2_LamDynAdpnCalcB1_I.stStep EGSDO2_LamDynAdpnCalcB1_I.tiDly EGSDO2_LamDynAdpnCalcB1_I.tiDlyNotFild EGSDO2_LamDynAdpnCalcB1_I.tiSumTran EGSDO2_LamDynAdpnCalcB1_I.tiTran EGSDO2_LamDynAdpnCalcB1_I.tiTranNotFild EGSDO2_LamDynAdpnCalcB1_I.AdpnFilDlyLT_I.memory EGSDO2_LamDynAdpnCalcB1_I.AdpnFilTranLT_I.memory EGSDO2_LamDynAdpnCalcB1_I.tiEnaIdnLtrSWE_I.timeCounter EGSDO2_LamDynAdpnCalcB1_I.tiEnaIdnRtlSWE_I.timeCounter EGSDO2_LamDynAdpnInhbS1B1ER_I.buffer EGSDO2_LamDynAdpnInhbS1B1ER_I.oldSignal EGSDO2_stStepNVB1 /end LOC_MEASUREMENT
 FUNCTION_VERSION "1.1.1" /end FUNCTION
/begin FUNCTION EGSDO2_LamOffsFast "1.36.0    Fast detection of a lambda offset of a wideband sensor"
 /begin DEF_CHARACTERISTIC EGSDO2_facOffsFast_C EGSDO2_mExhEnaOffsFast_T EGSDO2_mExhEnaShtrp_C EGSDO2_mExhMEnaVirt_T EGSDO2_nrCntrOffsPredAbvThd_C EGSDO2_nrExhMOffsFastVirt_C EGSDO2_nrExhMOffsFast_C EGSDO2_nrNoStepRowOffsFast_C EGSDO2_ofsCntrNegOffsFast_C EGSDO2_ratLamDeltaActMax_C EGSDO2_ratLamOffsPredCntr_C EGSDO2_ratLamOffsPredCtrlrLim_C EGSDO2_ratLamOffsPredNeg_T EGSDO2_ratLamOffsPredPos_T EGSDO2_tiPt1OffsPred_C EGSDO2_cntrLoad_C EGSDO2_dratFillgEnaOffs_C EGSDO2_flgEnaChkOnceOffsFast_CW EGSDO2_flgEnaDebRatLamOffs_CW EGSDO2_mExhEnaGnrlNoCatPurge_C EGSDO2_mExhEnaGnrlShtrp_C EGSDO2_mExhEnaGnrl_C EGSDO2_mfExhMaxOffsFast_C EGSDO2_mfExhMinOffsFastShtrp_C EGSDO2_mfExhMinOffsFast_C EGSDO2_mfExhTmpMaxOffsFast_C EGSDO2_mfExhTmpMinOffsFast_C EGSDO2_nEngMinEnaOffsFast_C EGSDO2_ofsCntrLoad_C EGSDO2_ratLoadMinEnaOffsFastShtrp_C EGSDO2_ratLoadMinEnaOffsFast_T EGSDO2_stLamOffsFast_C EGSDO2_tCatMaxEnaOffsFast_C EGSDO2_tCatMinEnaOffsFast_C EGSDO2_tEngEnaOffsFast_C EGSDO2_tEngMdlEnaOffsFast_C EGSDO2_tiMflowExhTmpMax_T EGSDO2_tiMflowExhTmpMin_C EGSDO2_tiSumRefCtrlActv_C EGSDO2_tiTurnOffCtrlrSt_C EGSDO2_tiTurnOnCatTShtrp_C EGSDO2_tiTurnOnCatT_C EGSDO2_tiTurnOnCtrlrLim_C EGSDO2_tiTurnOnCtrlrSt_C EGSDO2_tiTurnOnNEng_C /end DEF_CHARACTERISTIC
 /begin REF_CHARACTERISTIC EGSDO2_flgLamOffsFastAftParl_CW EGSDO2_flgLimLamOffsDynErr_CW EGSDO2_ratLamOffsMaxDynErr_C EGSDO2_ratLamOffsMax_C EGSDO2_ratLamOffsMinDynErr_C EGSDO2_ratLamOffsMin_C /end REF_CHARACTERISTIC
 /begin IN_MEASUREMENT B_bag_msg B_frmax_msg B_frmin_msg B_khakt_msg B_kh_msg B_lasostc_msg B_lr_msg B_sa_msg B_vag_msg CEngDsT_t CEngDsT_tReplMdl drlas_w_msg EGSDCmn_flgRmnProdModParl EGSDCmn_flgS1B1O2PlausResVirtParl EGSDCmn_flgS1B1VldParl EGSDCmn_flgS2B1VldParl EGSDCmn_flgShtrpParl EGSDCmn_ratLamActS1B1 EGSDCmn_stVirtTarLeanOffsParlB1 EGSDCmn_stVirtTarRichOffsParlB1 EGSDO2_flgLamDynDFCErrB1 EGSDO2_flgLamPlausFltSuspcS1B1 EGSDO2_flgLamPlausParlDneOnceS1B1 EGSDO2_flgLamPlausTstdS1B1 EGSDO2_ratLamOffsS1B1 EngStrt_bFrstStrtEnd Epm_nEng ExhMod_mfExhCat1B1 ExhMod_tCat1B1 HEGO_uS2B1 rl_w_msg SyC_ctPostDrvLeave SyC_stSub TWCC_bEnaRichPurgB1 TWCC_bIPriB1 TWCC_bPPriB1 TWCC_rCtlErrPriB1 TWCC_rCtlPriB1 /end IN_MEASUREMENT
 /begin OUT_MEASUREMENT EGSDO2_flgDebFltOffsFastS1B1 EGSDO2_flgDebFltOffsFastVirtS1B1 EGSDO2_flgDebHealOffsFastS1B1 EGSDO2_flgEnaGnrlOffsFastB1 EGSDO2_flgLamOffsFastFltSuspcS1B1 EGSDO2_ratLamOffsFastDeltaS1B1 EGSDO2_ratLamOffsFastPredS1B1 /end OUT_MEASUREMENT
 /begin LOC_MEASUREMENT B_sa_TONV_I.outbit B_sa_TONV_I.time EGSDO2_cntrLoad EGSDO2_ctReIni100msLamOffsFast EGSDO2_CtrlrLimOffsB1TONV_I.outbit EGSDO2_CtrlrLimOffsB1TONV_I.time EGSDO2_CtrlrStOffsB1TOFFV_I.outbit EGSDO2_CtrlrStOffsB1TOFFV_I.time EGSDO2_CtrlrStOffsB1TONV_I.outbit EGSDO2_CtrlrStOffsB1TONV_I.time EGSDO2_EnaCatOffsB1TTONV_I.outbit EGSDO2_EnaCatOffsB1TTONV_I.time EGSDO2_EnaMflowExhTmpMaxOffsB1TONV_I.outbit EGSDO2_EnaMflowExhTmpMaxOffsB1TONV_I.time EGSDO2_EnaMflowExhTmpMinOffsB1TONV_I.outbit EGSDO2_EnaMflowExhTmpMinOffsB1TONV_I.time EGSDO2_ExhMEnaGnrlOffsB1IK_I.memory EGSDO2_flgCtrlrLimOffsFastB1 EGSDO2_flgCtrlrLimSnsrOppOffsFastB1 EGSDO2_flgDiOffsBnkIndpdt EGSDO2_flgDiOffsEngT EGSDO2_flgEnaGnrlCatTOffsFastB1 EGSDO2_flgEnaGnrlExhMOffsFastB1 EGSDO2_flgEnaGnrlMflowExhOffsFastB1 EGSDO2_flgEnaGnrlPhyOffsFastB1 EGSDO2_flgEnaGnrlReldOffsFastB1 EGSDO2_flgEnaMflowExhTmpMaxOffsFastB1 EGSDO2_flgEnaMflowExhTmpMinOffsFastB1 EGSDO2_flgEnaOffsFastBnkIndpdt EGSDO2_flgEnaRefCtrlOffsFastB1 EGSDO2_flgRstExhMIntglOffsFastB1 EGSDO2_NEngTONV_I.outbit EGSDO2_NEngTONV_I.time EGSDO2_NoCatPurgOffsB1FF_I.status EGSDO2_ratLamOffsPredRawB1 EGSDO2_tiSumRefCtrlActvOffsFastB1 LamOffsFastB1_I.cntrExhM LamOffsFastB1_I.cntrExhMVirt LamOffsFastB1_I.cntrNoStepIncRow LamOffsFastB1_I.cntrNoStepRow LamOffsFastB1_I.cntrOffsPredAbvThd LamOffsFastB1_I.flgDebFltOffsFast LamOffsFastB1_I.flgDebFltOffsFastVirt LamOffsFastB1_I.flgDebHealOffsFast LamOffsFastB1_I.flgEna LamOffsFastB1_I.flgEnaExhM LamOffsFastB1_I.flgEnaExhMVirt LamOffsFastB1_I.flgLamOffsFastFltSuspc LamOffsFastB1_I.flgNoSignChgOffsPred LamOffsFastB1_I.ratLamOffsAbslt LamOffsFastB1_I.ratLamOffsDeltaAbsPred LamOffsFastB1_I.ratLamOffsDeltaPred LamOffsFastB1_I.ratLamOffsFastDelta LamOffsFastB1_I.ratLamOffsFastPred LamOffsFastB1_I.ratLamOffsPred LamOffsFastB1_I.ratLamOffsPredAbslt LamOffsFastB1_I.ExhMEnaGnrlVirtIK_I.memory LamOffsFastB1_I.ExhMEnaIK_I.memory LamOffsFastB1_I.ExhMEnaVirtIK_I.memory LamOffsFastB1_I.LamOffsPredLT_I.memory LamOffsFastB1_I.LamOffsPredRawSignChgEB_I.buffer LamOffsFastB1_I.LamOffsPredRawSignChgEB_I.oldSignal LamOffsFastB1_I.LamOffsPredSignChgEB_I.buffer LamOffsFastB1_I.LamOffsPredSignChgEB_I.oldSignal LamOffsFastB1_I.LamPlausFltSuspcOffsB1EFNM_I.oldSignal LamOffsFastB1_I.flgCtrlrLimOffsER_I.buffer LamOffsFastB1_I.flgCtrlrLimOffsER_I.oldSignal LamOffsFastB1_I.flgFltSuspcOffsFF_I.status /end LOC_MEASUREMENT
 FUNCTION_VERSION "1.36.0" /end FUNCTION
/begin FUNCTION EGSDO2_LamPlaus "1.37.0    Lambda-based plausibility diagnosis (offset) of a wideband sensor"
 /begin DEF_CHARACTERISTIC EGSDO2_facOffsSlow_C EGSDO2_flgITwcHiResl_C EGSDO2_flgLimLamOffsDynErr_CW EGSDO2_flgRstLamOffsDynErr_CW EGSDO2_ratLamOffsMaxDynErr_C EGSDO2_ratLamOffsMax_C EGSDO2_ratLamOffsMinDynErr_C EGSDO2_ratLamOffsMin_C EGSDO2_tiLamOffsSlowDebOffsShrtp_C EGSDO2_tiLamOffsSlowDebOffs_C EGSDO2_flgLamOffsFastAftParl_CW EGSDO2_flgLamOffsFastPreParl_CW EGSDO2_mfExhTwcCtrlIOperPnt_C EGSDO2_nEngSlowOffsMax_C EGSDO2_nEngSlowOffsMin_C EGSDO2_ratLamOffsFltMax_C EGSDO2_ratLamOffsFltMin_C EGSDO2_ratLoadSlowOffsMax_T EGSDO2_ratLoadSlowOffsMin_T EGSDO2_stLamPlaus_C LamPlausB1_I.EGSDO2_ratLamOffsInin_C /end DEF_CHARACTERISTIC
 /begin IN_MEASUREMENT B_lrs_msg EGSDCmn_flgCat1EmptTOutParlB1 EGSDCmn_flgCat1FullTOutParlB1 EGSDCmn_flgEnvtlDiPID41Parl EGSDCmn_flgS1B1O2PlausResVirtParl EGSDCmn_flgS2B1TarLeanOkOnceParl EGSDCmn_flgS2B1TarRichOkOnceParl EGSDCmn_flgShtrpParl EGSDO2_flgDebFltOffsFastS1B1 EGSDO2_flgDebFltOffsFastVirtS1B1 EGSDO2_flgDebHealOffsFastS1B1 EGSDO2_flgEnaGnrlOffsFastB1 EGSDO2_flgLamDynDFCErrB1 EGSDO2_flgLamDynDFCTstdB1 EGSDO2_flgLamOffsFastFltSuspcS1B1 EGSDO2_ratLamOffsFastDeltaS1B1 Epm_nEng ExhMod_mfExhCat1B1 rl_w_msg SyC_ctPostDrvLeave SyC_stSub TWCC_bIPriB1 TWCC_rICtlHiReslPriB1 TWCC_rICtlPriB1 /end IN_MEASUREMENT
 /begin OUT_MEASUREMENT ddltrmo_l dlatrmo_w EGSDO2_flgLamPlausFltMaxS1B1 EGSDO2_flgLamPlausFltMinS1B1 EGSDO2_flgLamPlausFltSuspcS1B1 EGSDO2_flgLamPlausFltVirtS1B1 EGSDO2_flgLamPlausInhbParlS1B1 EGSDO2_flgLamPlausParlDneOnceS1B1 EGSDO2_flgLamPlausTstdS1B1 EGSDO2_ralLamOffsDeltaExchS1B1_s32 EGSDO2_ratLamOffsS1B1 EGSDO2_ratLamOffsSrvS1B1 /end OUT_MEASUREMENT
 /begin LOC_MEASUREMENT EGSDO2_ctReIni100msLamPlaus EGSDO2_flgOperPntRelsDiag LamPlausB1_I.flgDiumprRlsNum LamPlausB1_I.flgEnaAddOffsSlow LamPlausB1_I.flgEnaTwcCtrlIOperPnt LamPlausB1_I.flgFltOffs LamPlausB1_I.flgFltPllsuMax LamPlausB1_I.flgFltPllsuMin LamPlausB1_I.flgFltPrevTrip LamPlausB1_I.flgFltSuspcLeanRamp LamPlausB1_I.flgFltSuspcRichRamp LamPlausB1_I.flgFrzFrmOffsMax LamPlausB1_I.flgFrzFrmOffsMin LamPlausB1_I.flgFuTrmFltTmp LamPlausB1_I.flgLamDynTstdOk LamPlausB1_I.flgLamOffsDsmPrms LamPlausB1_I.flgLamOffsFltHeal LamPlausB1_I.flgLamOffsFltMax LamPlausB1_I.flgLamOffsFltMin LamPlausB1_I.flgLamOffsSlowDebOffs LamPlausB1_I.flgLamPlausFltMax LamPlausB1_I.flgLamPlausFltMin LamPlausB1_I.flgLamPlausFltSuspc LamPlausB1_I.flgLamPlausFltVirt LamPlausB1_I.flgLamPlausInhbParl LamPlausB1_I.flgLamPlausParlDneOnce LamPlausB1_I.flgLamPlausTstd LamPlausB1_I.flgPassdFtdla LamPlausB1_I.flgPassdPllsu LamPlausB1_I.flgTstdPllsu LamPlausB1_I.flgVldLamPlausMax LamPlausB1_I.flgVldLamPlausMin LamPlausB1_I.ratLamOffs LamPlausB1_I.ratLamOffsCycBgn LamPlausB1_I.ratLamOffsDeltaExch_s32 LamPlausB1_I.tiLamOffsSlowActv LamPlausB1_I.LamDynErrER_I.buffer LamPlausB1_I.LamDynErrER_I.oldSignal LamPlausB1_I.LamPlausParlDneERNM_I.oldSignal LamPlausB1_I.PLLSUDltSusFrzFrmERNM_I.oldSignal LamPlausB1_I.flgFltSuspcER_I.buffer LamPlausB1_I.flgFltSuspcER_I.oldSignal LamPlausB1_I.flgFltSuspcFF_I.status LamPlausB1_I.flgInhbParlER_I.buffer LamPlausB1_I.flgInhbParlER_I.oldSignal LamPlausB1_I.flgInhbParlFF_I.status LamPlausB1_I.mfExhTwcCtrlIOperPntIK_I.memory /end LOC_MEASUREMENT
 FUNCTION_VERSION "1.37.0" /end FUNCTION
/begin FUNCTION EGSDO2_SigPrepn "1.1.0     Signal preparation for lambda signal based system diagnoses"
 /begin DEF_CHARACTERISTIC EGSDO2_facInertGasEgr_C EGSDO2_tiDt1HipFlt_C EGSDO2_tiDt1Hip_C EGSDO2_tiMdlAsymPreFilt_C EGSDO2_tiTranBpNarrow_C EGSDO2_tiTranBpWide_C EGSDO2_flgSlopChgIni_C EGSDO2_numGrdtPnt_C EGSDO2_tiPt1LamDerS1_C /end DEF_CHARACTERISTIC
 /begin IN_MEASUREMENT EGSDCmn_ratLamActS1B1 EGSDO2_tiDlyIdnLtrB1 EGSDO2_tiDlyIdnRtlB1 EGSDO2_tiTranIdnLtrB1 EGSDO2_tiTranIdnRtlB1 fra_w_msg fr_w_msg InjSys_ratPrdcAirLamDes lamsbg_w_msg redistb1_msg rir_w_msg SyC_ctPostDrvLeave tlrslb_w_msg zlrsb_w_msg /end IN_MEASUREMENT
 /begin OUT_MEASUREMENT EGSDO2_dratLamRecprFildS1B1 EGSDO2_flgBpWideS1B1 EGSDO2_ratLamRecprBpLtrS1B1 EGSDO2_ratLamRecprBpRtlS1B1 EGSDO2_ratLamRecprBpS1B1 EGSDO2_ratLamRecprFildS1B1 EGSDO2_ratLamRecprMdlBpLtrS1B1 EGSDO2_ratLamRecprMdlBpRtlS1B1 EGSDO2_ratLamRecprMdlBpS1B1 EGSDO2_ratLamRecprMdlFltBpLtrS1B1 EGSDO2_ratLamRecprMdlFltBpRtlS1B1 EGSDO2_ratLamRecprMdlFltBpS1B1 /end OUT_MEASUREMENT
 /begin LOC_MEASUREMENT EGSDO2_ctReIni10msSigPrepn EGSDO2_DerFilB1_I.dratLamRecpr EGSDO2_DerFilB1_I.dratLamRecprFild EGSDO2_DerFilB1_I.dratLamRecprSum EGSDO2_DerFilB1_I.idxInp EGSDO2_DerFilB1_I.ratLamRecpr EGSDO2_DerFilB1_I.ratLamRecprFild EGSDO2_DerFilB1_I.ratlam_a EGSDO2_DerFilB1_I.tiFildDly EGSDO2_DerFilB1_I.LamRecprLT_I.memory EGSDO2_flgClrSigPrepn10msB1 EGSDO2_IdnSigB1_I.flgBpWide EGSDO2_IdnSigB1_I.ratLamRecprBp EGSDO2_IdnSigB1_I.ratLamRecprBpLtr EGSDO2_IdnSigB1_I.ratLamRecprBpRtl EGSDO2_IdnSigB1_I.ratLamRecprMdl EGSDO2_IdnSigB1_I.ratLamRecprMdlBp EGSDO2_IdnSigB1_I.ratLamRecprMdlBpLtr EGSDO2_IdnSigB1_I.ratLamRecprMdlBpRtl EGSDO2_IdnSigB1_I.ratLamRecprMdlChmb EGSDO2_IdnSigB1_I.ratLamRecprMdlFlt EGSDO2_IdnSigB1_I.ratLamRecprMdlFltBp EGSDO2_IdnSigB1_I.ratLamRecprMdlFltBpLtr EGSDO2_IdnSigB1_I.ratLamRecprMdlFltBpRtl EGSDO2_IdnSigB1_I.ratLamRecprSpChmbCorrd EGSDO2_IdnSigB1_I.LamLtrFF_I.status EGSDO2_IdnSigB1_I.MdlAsymLT_I.memory EGSDO2_IdnSigB1_I.MdlAsymPreFilLT_I.memory EGSDO2_IdnSigB1_I.SlopChgEBNM_I.oldSignal EGSDO2_IdnSigB1_I.dratLamRecprFildLT_I.memory EGSDO2_IdnSigB1_I.ratLamRecprMdlChmbLT_I.memory EGSDO2_IdnSigB1_I.ratLamRecprMdlDt1LT_I.memory EGSDO2_IdnSigB1_I.ratLamRecprMdlFltDt1LT_I.memory EGSDO2_IdnSigB1_I.ratLamRecprMdlFltLT_I.memory EGSDO2_IdnSigB1_I.ratLamRecprMdlLT_I.memory /end LOC_MEASUREMENT
 FUNCTION_VERSION "1.1.0" /end FUNCTION
/begin FUNCTION EGSDO2_SnsrMntdDiag "1.10.0    Diagnosis Oxygen Sensors at Air"
 /begin DEF_CHARACTERISTIC EGSDO2_ratLamSpMaxMntdDiag_C EGSDO2_tiDebMntdDiagErr_C UEGO_ratLamMaxMntdDiag_C /end DEF_CHARACTERISTIC
 /begin IN_MEASUREMENT B_evloc_msg EGSDCmn_flgS1B1VldParl EngStrt_bStrtEnd lamsons_w_msg SyC_ctPostDrvLeave UEGO_flgTCtrlDeLrgS1B1 UEGO_rLamEquivElecCorrdS1B1 /end IN_MEASUREMENT
 /begin LOC_MEASUREMENT EGSDO2_SnsrMntdDiagS1B1_I.flgDSMClrReq EGSDO2_SnsrMntdDiagS1B1_I.flgErr EGSDO2_SnsrMntdDiagS1B1_I.flgRdy EGSDO2_SnsrMntdDiagS1B1_I.flgRels EGSDO2_SnsrMntdDiagS1B1_I.flgRes EGSDO2_SnsrMntdDiagS1B1_I.SnsrMntdDiagNoErrTONV_I.outbit EGSDO2_SnsrMntdDiagS1B1_I.SnsrMntdDiagNoErrTONV_I.time EGSDO2_SnsrMntdDiagS1B1_I.SnsrMntdErrSuspcTONV_I.outbit EGSDO2_SnsrMntdDiagS1B1_I.SnsrMntdErrSuspcTONV_I.time /end LOC_MEASUREMENT
 FUNCTION_VERSION "1.10.0" /end FUNCTION
/begin COMPU_METHOD B_TRUE "" TAB_VERB "%6.3" "" COMPU_TAB_REF B_TRUE /end COMPU_METHOD
/begin COMPU_VTAB B_TRUE "" TAB_VERB 2 0 "FALSE" 1 "TRUE" /end COMPU_VTAB
/begin COMPU_METHOD dez "" RAT_FUNC "%6.2" "" COEFFS 0 1 0 0 0 1 /end COMPU_METHOD
/begin COMPU_METHOD EngN "" RAT_FUNC "%6.3" "rpm" COEFFS 0 2 0 0 0 1 /end COMPU_METHOD
/begin COMPU_METHOD EXHMOD_NRMAXPIPB2_SC_Compu "" RAT_FUNC "%6.2" "" COEFFS 0 1 0 0 0 1 /end COMPU_METHOD
/begin COMPU_METHOD EXHMOD_NRMAXSTRUCTELMB1_SC_Compu "" RAT_FUNC "%6.2" "" COEFFS 0 1 0 0 0 1 /end COMPU_METHOD
/begin COMPU_METHOD EXHMOD_NRMAXSTRUCTELMB2_SC_Compu "" RAT_FUNC "%6.2" "" COEFFS 0 1 0 0 0 1 /end COMPU_METHOD
/begin COMPU_METHOD EXHMOD_NRMPLBRICKCATB1_SC_Compu "" RAT_FUNC "%6.2" "" COEFFS 0 1 0 0 0 1 /end COMPU_METHOD
/begin COMPU_METHOD EXHMOD_NRMPLBRICKCATB2_SC_Compu "" RAT_FUNC "%6.2" "" COEFFS 0 1 0 0 0 1 /end COMPU_METHOD
/begin COMPU_METHOD EXHMOD_NRPNTSMAPCOOLGCRV_SC_Compu "" RAT_FUNC "%6.2" "" COEFFS 0 1 0 0 0 1 /end COMPU_METHOD
/begin COMPU_METHOD EXHMOD_NRPNTSMAPX_SC_Compu "" RAT_FUNC "%6.2" "" COEFFS 0 1 0 0 0 1 /end COMPU_METHOD
/begin COMPU_METHOD EXHMOD_NRPNTSMAPY_SC_Compu "" RAT_FUNC "%6.2" "" COEFFS 0 1 0 0 0 1 /end COMPU_METHOD
/begin COMPU_METHOD EXHMOD_NRSNSRB1_SC_Compu "" RAT_FUNC "%6.2" "" COEFFS 0 1 0 0 0 1 /end COMPU_METHOD
/begin COMPU_METHOD EXHMOD_NRSNSRB2_SC_Compu "" RAT_FUNC "%6.2" "" COEFFS 0 1 0 0 0 1 /end COMPU_METHOD
/begin COMPU_METHOD EXHMOD_NRTSNSRB1_SC_Compu "" RAT_FUNC "%6.2" "" COEFFS 0 1 0 0 0 1 /end COMPU_METHOD
/begin COMPU_METHOD EXHMOD_NRTSNSRB2_SC_Compu "" RAT_FUNC "%6.2" "" COEFFS 0 1 0 0 0 1 /end COMPU_METHOD
/begin COMPU_METHOD EXHMOD_PEXHMDLCFG_SC_Compu "" TAB_VERB "%6.3" "" COMPU_TAB_REF EXHMOD_PEXHMDLCFG_SC_Compu /end COMPU_METHOD
/begin COMPU_VTAB EXHMOD_PEXHMDLCFG_SC_Compu "" TAB_VERB 4 0 "0" 1 "1" 2 "2" 3 "3" /end COMPU_VTAB
/begin COMPU_METHOD EXHMOD_POSNCATGPF_SC_Compu "" TAB_VERB "%6.3" "" COMPU_TAB_REF EXHMOD_POSNCATGPF_SC_Compu /end COMPU_METHOD
/begin COMPU_VTAB EXHMOD_POSNCATGPF_SC_Compu "" TAB_VERB 6 0 "GPF_NO" 1 "GPF_CAT1" 2 "GPF_CAT2" 3 "GPF_CAT3" 4 "GPF_CAT4" 5 "GPF_CAT5" /end COMPU_VTAB
/begin COMPU_METHOD EXHMOD_SELNENGSTOPTI_SC_Compu "" TAB_VERB "%6.3" "" COMPU_TAB_REF EXHMOD_SELNENGSTOPTI_SC_Compu /end COMPU_METHOD
/begin COMPU_VTAB EXHMOD_SELNENGSTOPTI_SC_Compu "" TAB_VERB 3 0 "0" 1 "1" 2 "2" /end COMPU_VTAB
/begin COMPU_METHOD EXHMOD_SELNEXHFLAP_SC_Compu "" TAB_VERB "%6.3" "" COMPU_TAB_REF EXHMOD_SELNEXHFLAP_SC_Compu /end COMPU_METHOD
/begin COMPU_VTAB EXHMOD_SELNEXHFLAP_SC_Compu "" TAB_VERB 2 0 "False" 1 "True" /end COMPU_VTAB
/begin COMPU_METHOD EXHMOD_SELNTFCOMOD_SC_Compu "" TAB_VERB "%6.3" "" COMPU_TAB_REF EXHMOD_SELNTFCOMOD_SC_Compu /end COMPU_METHOD
/begin COMPU_VTAB EXHMOD_SELNTFCOMOD_SC_Compu "" TAB_VERB 3 0 "TEXHFCOCONST" 1 "TEXHFCOTAB" 2 "TEXHFCOMAP" /end COMPU_VTAB
/begin COMPU_METHOD EXHMOD_STPWRHEATEXT_SC_Compu "" TAB_VERB "%6.3" "" COMPU_TAB_REF EXHMOD_STPWRHEATEXT_SC_Compu /end COMPU_METHOD
/begin COMPU_VTAB EXHMOD_STPWRHEATEXT_SC_Compu "" TAB_VERB 2 0 "False" 1 "True" /end COMPU_VTAB
/begin COMPU_METHOD EXHMOD_TENVCORRN_SC_Compu "" TAB_VERB "%6.3" "" COMPU_TAB_REF EXHMOD_TENVCORRN_SC_Compu /end COMPU_METHOD
/begin COMPU_VTAB EXHMOD_TENVCORRN_SC_Compu "" TAB_VERB 2 0 "False" 1 "True" /end COMPU_VTAB
/begin COMPU_METHOD fak_q0p01 "" RAT_FUNC "%6.4" "" COEFFS 0 100 0 0 0 1 /end COMPU_METHOD
/begin COMPU_METHOD fak_q3p0518Em5 "" RAT_FUNC "%7.6" "" COEFFS 0 32768 0 0 0 1 /end COMPU_METHOD
/begin COMPU_METHOD fak_q4p6566Em10 "" RAT_FUNC "%18.17" "" COEFFS 0 2147483648 0 0 0 1 /end COMPU_METHOD
/begin COMPU_METHOD fak_sl_b1 "" RAT_FUNC "%12.11" "-" COEFFS 0 4294967296 0 0 0 2 /end COMPU_METHOD
/begin COMPU_METHOD fak_sw_b1 "" RAT_FUNC "%7.6" "-" COEFFS 0 65536 0 0 0 2 /end COMPU_METHOD
/begin COMPU_METHOD fak_uw_b1 "" RAT_FUNC "%7.6" "-" COEFFS 0 65536 0 0 0 1 /end COMPU_METHOD
/begin COMPU_METHOD fak_uw_b128 "" RAT_FUNC "%6.4" "-" COEFFS 0 65536 0 0 0 128 /end COMPU_METHOD
/begin COMPU_METHOD fak_uw_b16 "" RAT_FUNC "%6.5" "-" COEFFS 0 65536 0 0 0 16 /end COMPU_METHOD
/begin COMPU_METHOD fak_uw_b2 "" RAT_FUNC "%7.6" "-" COEFFS 0 65536 0 0 0 2 /end COMPU_METHOD
/begin COMPU_METHOD fak_uw_b32 "" RAT_FUNC "%6.5" "-" COEFFS 0 65536 0 0 0 32 /end COMPU_METHOD
/begin COMPU_METHOD fak_uw_b4 "" RAT_FUNC "%7.6" "-" COEFFS 0 65536 0 0 0 4 /end COMPU_METHOD
/begin COMPU_METHOD fak_uw_b8 "" RAT_FUNC "%6.5" "-" COEFFS 0 65536 0 0 0 8 /end COMPU_METHOD
/begin COMPU_METHOD freq_q1p22Em4 "" RAT_FUNC "%6.5" "1/s" COEFFS 0 8192 0 0 0 1 /end COMPU_METHOD
/begin COMPU_METHOD freq_q9p1553Em5 "" RAT_FUNC "%7.6" "1/s" COEFFS 0 65536 0 0 0 6 /end COMPU_METHOD
/begin COMPU_METHOD m_q0p001_kg "" RAT_FUNC "%6.5" "kg" COEFFS 0 1000 0 0 0 1 /end COMPU_METHOD
/begin COMPU_METHOD m_q0p0277_g "" RAT_FUNC "%6.4" "g" COEFFS 0 36 0 0 0 1 /end COMPU_METHOD
/begin COMPU_METHOD m_q1p5259Em8_kg "" RAT_FUNC "%10.9" "kg" COEFFS 0 65536000 0 0 0 1 /end COMPU_METHOD
/begin COMPU_METHOD m_q4p239Em7_g "" RAT_FUNC "%9.8" "g" COEFFS 0 2359290 0 0 0 1 /end COMPU_METHOD
/begin COMPU_METHOD m_uw_b6553p5 "" RAT_FUNC "%6.3" "kg/h" COEFFS 0 1 0 0 0 0.1 /end COMPU_METHOD
/begin COMPU_METHOD OneToOne "" RAT_FUNC "%6.2" "-" COEFFS 0 1 0 0 0 1 /end COMPU_METHOD
/begin COMPU_METHOD q1p5259Em7_s "" RAT_FUNC "%9.8" "s" COEFFS 0 65536 0 0 0 0.01 /end COMPU_METHOD
/begin COMPU_METHOD relNWU_q0p0234 "" RAT_FUNC "%6.4" "%/NWU" COEFFS 0 32 0 0 0 0.75 /end COMPU_METHOD
/begin COMPU_METHOD rel_q0p0234 "" RAT_FUNC "%6.4" "%" COEFFS 0 128 0 0 0 3 /end COMPU_METHOD
/begin COMPU_METHOD rel_uw_q0p0234 "" RAT_FUNC "%6.4" "%" COEFFS 0 32 0 0 0 0.75 /end COMPU_METHOD
/begin COMPU_METHOD Temp_Cels "" RAT_FUNC "%6.1" "deg C" COEFFS 0 10 2731.4 0 0 1 /end COMPU_METHOD
/begin COMPU_METHOD t_q0p01 "" RAT_FUNC "%6.4" "s" COEFFS 0 100 0 0 0 1 /end COMPU_METHOD
/begin COMPU_METHOD t_q0p0625 "" RAT_FUNC "%6.4" "s" COEFFS 0 16 0 0 0 1 /end COMPU_METHOD
/begin COMPU_METHOD t_q0p1 "" RAT_FUNC "%6.3" "s" COEFFS 0 10 0 0 0 1 /end COMPU_METHOD
/begin COMPU_METHOD zk100msxs_uw_b6553 "" RAT_FUNC "%6.1" "s" COEFFS 0 0 65536 0 10 0 /end COMPU_METHOD
/begin COMPU_METHOD zk10msxs_uw_b655 "" RAT_FUNC "%6.2" "s" COEFFS 0 0 65536 0 100 0 /end COMPU_METHOD
/begin RECORD_LAYOUT RB_Curve_S16_U16_Static NO_AXIS_PTS_X 1 SWORD AXIS_PTS_X 2 SWORD INDEX_INCR DIRECT FNC_VALUES 3 UWORD COLUMN_DIR DIRECT STATIC_RECORD_LAYOUT /end RECORD_LAYOUT
/begin RECORD_LAYOUT RB_Curve_U16_U16 NO_AXIS_PTS_X 1 UWORD AXIS_PTS_X 2 UWORD INDEX_INCR DIRECT FNC_VALUES 3 UWORD COLUMN_DIR DIRECT /end RECORD_LAYOUT
/begin RECORD_LAYOUT RB_Curve_U16_U8_Static NO_AXIS_PTS_X 1 UWORD AXIS_PTS_X 2 UWORD INDEX_INCR DIRECT FNC_VALUES 3 UBYTE COLUMN_DIR DIRECT STATIC_RECORD_LAYOUT /end RECORD_LAYOUT
/begin RECORD_LAYOUT RB_Curve_U8_U16_Static NO_AXIS_PTS_X 1 UBYTE AXIS_PTS_X 2 UBYTE INDEX_INCR DIRECT FNC_VALUES 3 UWORD COLUMN_DIR DIRECT STATIC_RECORD_LAYOUT /end RECORD_LAYOUT
/begin RECORD_LAYOUT RB_Val_Ws16 FNC_VALUES 1 SWORD COLUMN_DIR DIRECT /end RECORD_LAYOUT
/begin RECORD_LAYOUT RB_Val_Ws32 FNC_VALUES 1 SLONG COLUMN_DIR DIRECT /end RECORD_LAYOUT
/begin RECORD_LAYOUT RB_Val_Wu16 FNC_VALUES 1 UWORD COLUMN_DIR DIRECT /end RECORD_LAYOUT
/begin RECORD_LAYOUT RB_Val_Wu32 FNC_VALUES 1 ULONG COLUMN_DIR DIRECT /end RECORD_LAYOUT
/begin RECORD_LAYOUT RB_Val_Wu8 FNC_VALUES 1 UBYTE COLUMN_DIR DIRECT /end RECORD_LAYOUT
/end MODULE
/end PROJECT
