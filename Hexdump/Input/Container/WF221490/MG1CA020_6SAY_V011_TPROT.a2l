ASAP2_VERSION 1 60
/begin PROJECT MG1CA020 "MG1CA020"
/begin HEADER "" VERSION "MG1CA020_6SAY_V011_TPROT" PROJECT_NO MG1CA020 /end HEADER
/begin MODULE DIM ""
/begin MOD_COMMON "" BYTE_ORDER MSB_LAST ALIGNMENT_BYTE 1 ALIGNMENT_WORD 2 ALIGNMENT_LONG 4 ALIGNMENT_INT64 4 ALIGNMENT_FLOAT32_IEEE 4 ALIGNMENT_FLOAT64_IEEE 4 DATA_SIZE 32 /end MOD_COMMON
/begin CHARACTERISTIC AccPed_swtDrvModSeln_C "Drive mode selection switch" VALUE 0x80533F3C RB_Val_Wu8 255.0 OneToOne 0.00 255.0 FORMAT "%5.1" /end CHARACTERISTIC
/begin CHARACTERISTIC AirC_stSwtPrs_C "Calibration for AC switch pressed/unpressed status" VALUE 0x80533F3D RB_Val_Wu8 255.0 OneToOne 0.00 255.0 FORMAT "%5.1" /end CHARACTERISTIC
/begin CHARACTERISTIC alchpct_msg_C "" VALUE 0x80533F3E RB_Val_Wu8 99.61 rel_ub_b100 0.00 99.61 FORMAT "%5.2" /end CHARACTERISTIC
/begin CHARACTERISTIC App_flgSRCLo1HiImpdChk_C "" VALUE 0x80533F3F RB_Val_Wu8 1.00000000000 B_TRUE 0.00 1.00000000000 FORMAT "%13.11" /end CHARACTERISTIC
/begin CHARACTERISTIC App_flgSRCLo2HiImpdChk_C "" VALUE 0x80533F40 RB_Val_Wu8 1.00000000000 B_TRUE 0.00 1.00000000000 FORMAT "%13.11" /end CHARACTERISTIC
/begin CHARACTERISTIC APP_flgT15HealEnad_C "Calibration to enable SRC healing during T15 reset" VALUE 0x80533F41 RB_Val_Wu8 1.00000000000 B_TRUE 0.00 1.00000000000 FORMAT "%13.11" /end CHARACTERISTIC
/begin CHARACTERISTIC App_swtHiImpdChkEna_C "Switch to enable the High impedance check" VALUE 0x80533F42 RB_Val_Wu8 1.00000000000 B_TRUE 0.00 1.00000000000 FORMAT "%13.11" /end CHARACTERISTIC
/begin CHARACTERISTIC ATS_TrbCh_B1.LimitTypeMsk_C "Actuator test ATS_TrbCh_B1 / Tester demand monitoring enable mask for actuators" VALUE 0x8053A5AC Val_Wu8 255.0 OneToOne 0.00 255.0 FORMAT "%5.1" /end CHARACTERISTIC
/begin CHARACTERISTIC ATS_TrbCh_B1.CnvNorm_C "Actuator test ATS_TrbCh_B1 / Conversion norm used for conversion to/from internal scaling" VALUE 0x8053A5AD Val_Wu8 255.0 OneToOne 0.00 255.0 FORMAT "%5.1" /end CHARACTERISTIC
/begin CHARACTERISTIC ATS_TrbCh_B1.LowLim_C "Actuator test ATS_TrbCh_B1 / Lower limit for monitoring" VALUE 0x8053A5AE Val_Ws16 511.9922 rel_q0p0078125 -256.0000 255.9922 FORMAT "%8.4" /end CHARACTERISTIC
/begin CHARACTERISTIC ATS_TrbCh_B1.UpLim_C "Actuator test ATS_TrbCh_B1 / Upper limit for monitoring" VALUE 0x8053A5B0 Val_Ws16 511.9922 rel_q0p0078125 -256.0000 255.9922 FORMAT "%8.4" /end CHARACTERISTIC
/begin CHARACTERISTIC ATS_TrbCh_B1.CnvFac_C "Actuator test ATS_TrbCh_B1 / Factor used for conversion to/from internal scaling" VALUE 0x8053A5B4 Val_Ws32 4294967295.00 OneToOne -2147483648.00 2147483647.00 FORMAT "%13.2" /end CHARACTERISTIC
/begin CHARACTERISTIC ATS_TrbCh_B1.CnvOfs_C "Actuator test ATS_TrbCh_B1 / Offset used for conversion to/from internal scaling" VALUE 0x8053A5B8 Val_Ws16 65535.00 OneToOne -32768.00 32767.00 FORMAT "%8.2" /end CHARACTERISTIC
/begin CHARACTERISTIC ATS_TrbCh_B1.DfltVal_C "Actuator test ATS_TrbCh_B1 / Default value for standbytest" VALUE 0x8053A5BA Val_Ws16 65535.00 OneToOne -32768.00 32767.00 FORMAT "%8.2" /end CHARACTERISTIC
/begin CHARACTERISTIC BattU_tiThMinDSQ_C "Delay time for sensed voltage battery heals" VALUE 0x80533F44 RB_Val_Wu16 655350.0 Time_ms 0.00 655350.0 FORMAT "%8.1" /end CHARACTERISTIC
/begin CHARACTERISTIC BattU_uThMinDSQ_C "Low under voltage threshold" VALUE 0x80533F48 RB_Val_Ws32 26214000.0000 Volt_Batt -13107200.0000 13106800.0000 FORMAT "%13.4" EXTENDED_LIMITS -42949672960.0 42949672940.0 /end CHARACTERISTIC
/begin CHARACTERISTIC BrkPed_pForISABIdleStop_C "" VALUE 0x80533F4C RB_Val_Ws16 6553.500 Pres -3276.800 3276.700 FORMAT "%8.3" /end CHARACTERISTIC
/begin CHARACTERISTIC BrkP_dpMstCyl_C "" VALUE 0x80533F4E RB_Val_Ws16 6553500. PreshPa_10ms -3276800. 3276700. FORMAT "%8.0" /end CHARACTERISTIC
/begin CHARACTERISTIC BrkP_p_C "" VALUE 0x80533F50 RB_Val_Ws32 4294967295.00 Pres_hPa -2147483648.00 2147483647.00 FORMAT "%13.2" /end CHARACTERISTIC
/begin CHARACTERISTIC Brk_stEBBBrkDetn_C "" VALUE 0x80533F54 RB_Val_Wboolean 1.00000000000 B_TRUE 0.00 1.00000000000 FORMAT "%13.11" /end CHARACTERISTIC
/begin CHARACTERISTIC B_abor_msg_C "Calibration to update high amount of fuel in oil" VALUE 0x80533F55 RB_Val_Wu8 1.00000000000 B_TRUE 0.00 1.00000000000 FORMAT "%13.11" /end CHARACTERISTIC
/begin CHARACTERISTIC B_disagrkd_msg_C "Condition EGR disable caused by catalyst diagnosis" VALUE 0x80533F56 RB_Val_Wu8 1.00000000000 B_TRUE 0.00 1.00000000000 FORMAT "%13.11" /end CHARACTERISTIC
/begin CHARACTERISTIC B_dtdisagr_msg_C "Sperrung AGR durch bei aktiver TEV-Prüfung Disabling of EGR by active CPV check" VALUE 0x80533F57 RB_Val_Wu8 1.00000000000 B_TRUE 0.00 1.00000000000 FORMAT "%13.11" /end CHARACTERISTIC
/begin CHARACTERISTIC B_eagrv_msg_C "" VALUE 0x80533F58 RB_Val_Wu8 1.00000000000 B_TRUE 0.00 1.00000000000 FORMAT "%13.11" /end CHARACTERISTIC
/begin CHARACTERISTIC B_evasldel_msg_C "" VALUE 0x80533F59 RB_Val_Wu8 1.00000000000 B_TRUE 0.00 1.00000000000 FORMAT "%13.11" /end CHARACTERISTIC
/begin CHARACTERISTIC B_faagr_msg_C "" VALUE 0x80533F5A RB_Val_Wu8 1.00000000000 B_TRUE 0.00 1.00000000000 FORMAT "%13.11" /end CHARACTERISTIC
/begin CHARACTERISTIC B_fabe_msg_C "Sw adapter calibration for B_fabe_msg" VALUE 0x80533F5B RB_Val_Wu8 1.00000000000 B_TRUE 0.00 1.00000000000 FORMAT "%13.11" /end CHARACTERISTIC
/begin CHARACTERISTIC B_kuppl_msg_C "" VALUE 0x80533F5C RB_Val_Wboolean 1.00000000000 B_TRUE 0.00 1.00000000000 FORMAT "%13.11" /end CHARACTERISTIC
/begin CHARACTERISTIC B_teftstft_msg_C "" VALUE 0x80533F5D RB_Val_Wu8 1.00000000000 B_TRUE 0.00 1.00000000000 FORMAT "%13.11" /end CHARACTERISTIC
/begin CHARACTERISTIC B_tolcb_msg_C "" VALUE 0x80533F5E RB_Val_Wboolean 1.00000000000 B_TRUE 0.00 1.00000000000 FORMAT "%13.11" /end CHARACTERISTIC
/begin CHARACTERISTIC B_vhegv_C "" VALUE 0x80533F5F RB_Val_Wu8 1.00000000000 B_TRUE 0.00 1.00000000000 FORMAT "%13.11" /end CHARACTERISTIC
/begin CHARACTERISTIC B_vhegzw_C "" VALUE 0x80533F60 RB_Val_Wu8 1.00000000000 B_TRUE 0.00 1.00000000000 FORMAT "%13.11" /end CHARACTERISTIC
/begin CHARACTERISTIC CACPmpRly_ATS.LimitTypeMsk_C "Actuator test CACPmpRly_ATS / Tester demand monitoring enable mask for actuators" VALUE 0x8053A5C0 Val_Wu8 255.0 OneToOne 0.00 255.0 FORMAT "%5.1" /end CHARACTERISTIC
/begin CHARACTERISTIC CACPmpRly_ATS.CnvNorm_C "Actuator test CACPmpRly_ATS / Conversion norm used for conversion to/from internal scaling" VALUE 0x8053A5C1 Val_Wu8 255.0 OneToOne 0.00 255.0 FORMAT "%5.1" /end CHARACTERISTIC
/begin CHARACTERISTIC CACPmpRly_ATS.LowLim_C "Actuator test CACPmpRly_ATS / Lower limit for monitoring" VALUE 0x8053A5C2 Val_Ws16 65535.00 OneToOne -32768.00 32767.00 FORMAT "%8.2" /end CHARACTERISTIC
/begin CHARACTERISTIC CACPmpRly_ATS.UpLim_C "Actuator test CACPmpRly_ATS / Upper limit for monitoring" VALUE 0x8053A5C4 Val_Ws16 65535.00 OneToOne -32768.00 32767.00 FORMAT "%8.2" /end CHARACTERISTIC
/begin CHARACTERISTIC CACPmpRly_ATS.CnvFac_C "Actuator test CACPmpRly_ATS / Factor used for conversion to/from internal scaling" VALUE 0x8053A5C8 Val_Ws32 4294967295.00 OneToOne -2147483648.00 2147483647.00 FORMAT "%13.2" /end CHARACTERISTIC
/begin CHARACTERISTIC CACPmpRly_ATS.CnvOfs_C "Actuator test CACPmpRly_ATS / Offset used for conversion to/from internal scaling" VALUE 0x8053A5CC Val_Ws16 65535.00 OneToOne -32768.00 32767.00 FORMAT "%8.2" /end CHARACTERISTIC
/begin CHARACTERISTIC CACPmpRly_ATS.DfltVal_C "Actuator test CACPmpRly_ATS / Default value for standbytest" VALUE 0x8053A5CE Val_Ws16 65535.00 OneToOne -32768.00 32767.00 FORMAT "%8.2" /end CHARACTERISTIC
/begin CHARACTERISTIC CACPmp_ATS.LimitTypeMsk_C "Actuator test CACPmp_ATS / Tester demand monitoring enable mask for actuators" VALUE 0x8053A5D0 Val_Wu8 255.0 OneToOne 0.00 255.0 FORMAT "%5.1" /end CHARACTERISTIC
/begin CHARACTERISTIC CACPmp_ATS.CnvNorm_C "Actuator test CACPmp_ATS / Conversion norm used for conversion to/from internal scaling" VALUE 0x8053A5D1 Val_Wu8 255.0 OneToOne 0.00 255.0 FORMAT "%5.1" /end CHARACTERISTIC
/begin CHARACTERISTIC CACPmp_ATS.LowLim_C "Actuator test CACPmp_ATS / Lower limit for monitoring" VALUE 0x8053A5D2 Val_Wu16 99.99847 rel_uw_b100 0.00 99.99847 FORMAT "%8.5" /end CHARACTERISTIC
/begin CHARACTERISTIC CACPmp_ATS.UpLim_C "Actuator test CACPmp_ATS / Upper limit for monitoring" VALUE 0x8053A5D4 Val_Wu16 99.99847 rel_uw_b100 0.00 99.99847 FORMAT "%8.5" /end CHARACTERISTIC
/begin CHARACTERISTIC CACPmp_ATS.CnvFac_C "Actuator test CACPmp_ATS / Factor used for conversion to/from internal scaling" VALUE 0x8053A5D8 Val_Ws32 4294967295.00 OneToOne -2147483648.00 2147483647.00 FORMAT "%13.2" /end CHARACTERISTIC
/begin CHARACTERISTIC CACPmp_ATS.CnvOfs_C "Actuator test CACPmp_ATS / Offset used for conversion to/from internal scaling" VALUE 0x8053A5DC Val_Ws16 65535.00 OneToOne -32768.00 32767.00 FORMAT "%8.2" /end CHARACTERISTIC
/begin CHARACTERISTIC CACPmp_ATS.DfltVal_C "Actuator test CACPmp_ATS / Default value for standbytest" VALUE 0x8053A5DE Val_Wu16 65535.00 OneToOne 0.00 65535.00 FORMAT "%8.2" /end CHARACTERISTIC
/begin CHARACTERISTIC CByVlvB1_Test_ATS.LimitTypeMsk_C "Actuator test CByVlvB1_Test_ATS / Tester demand monitoring enable mask for actuators" VALUE 0x8053A5E0 Val_Wu8 255.0 OneToOne 0.00 255.0 FORMAT "%5.1" /end CHARACTERISTIC
/begin CHARACTERISTIC CByVlvB1_Test_ATS.CnvNorm_C "Actuator test CByVlvB1_Test_ATS / Conversion norm used for conversion to/from internal scaling" VALUE 0x8053A5E1 Val_Wu8 255.0 OneToOne 0.00 255.0 FORMAT "%5.1" /end CHARACTERISTIC
/begin CHARACTERISTIC CByVlvB1_Test_ATS.LowLim_C "Actuator test CByVlvB1_Test_ATS / Lower limit for monitoring" VALUE 0x8053A5E2 Val_Ws16 799.9878 Prc -400.0000 399.9878 FORMAT "%8.4" /end CHARACTERISTIC
/begin CHARACTERISTIC CByVlvB1_Test_ATS.UpLim_C "Actuator test CByVlvB1_Test_ATS / Upper limit for monitoring" VALUE 0x8053A5E4 Val_Ws16 799.9878 Prc -400.0000 399.9878 FORMAT "%8.4" /end CHARACTERISTIC
/begin CHARACTERISTIC CByVlvB1_Test_ATS.CnvFac_C "Actuator test CByVlvB1_Test_ATS / Factor used for conversion to/from internal scaling" VALUE 0x8053A5E8 Val_Ws32 4294967295.00 OneToOne -2147483648.00 2147483647.00 FORMAT "%13.2" /end CHARACTERISTIC
/begin CHARACTERISTIC CByVlvB1_Test_ATS.CnvOfs_C "Actuator test CByVlvB1_Test_ATS / Offset used for conversion to/from internal scaling" VALUE 0x8053A5EC Val_Ws16 65535.00 OneToOne -32768.00 32767.00 FORMAT "%8.2" /end CHARACTERISTIC
/begin CHARACTERISTIC CByVlvB1_Test_ATS.DfltVal_C "Actuator test CByVlvB1_Test_ATS / Default value for standbytest" VALUE 0x8053A5EE Val_Ws16 65535.00 OneToOne -32768.00 32767.00 FORMAT "%8.2" /end CHARACTERISTIC
/begin CHARACTERISTIC CDKVS "code word: DKVS active/inactive, CD..=0 -> no diagnosis" VALUE 0x80533F61 RB_Val_Wu8 255.0 dez 0.00 255.0 FORMAT "%5.1" /end CHARACTERISTIC
/begin CHARACTERISTIC CDLLR "code word DLLR inactive (EURO-coding), CD..=0 -> no diagnosis" VALUE 0x80533F62 RB_Val_Wu8 255.0 dez 0.00 255.0 FORMAT "%5.1" /end CHARACTERISTIC
/begin CHARACTERISTIC CDTES "code word disable canister-purge monitoring (Euro coding), CD..=0 -> no dia." VALUE 0x80533F63 RB_Val_Wu8 255.0 dez 0.00 255.0 FORMAT "%5.1" /end CHARACTERISTIC
/begin CHARACTERISTIC Clth_drFlt_C "Calibration label for Filtered Gradient of clutch pedal sensor" VALUE 0x80533F64 RB_Val_Ws16 255.9961 PrcHi_COMPU -128.0000 127.9961 FORMAT "%8.4" /end CHARACTERISTIC
/begin CHARACTERISTIC Clth_rKisspnt_C "calibration for Kiss point (Ratio of clutch at which the clutch torque is zero)" VALUE 0x80533F66 RB_Val_Ws16 255.9961 PrcHi_COMPU -128.0000 127.9961 FORMAT "%8.4" /end CHARACTERISTIC
/begin CHARACTERISTIC Clth_stClthExtd_C "calibration for Extended clutch pedal status" VALUE 0x80533F68 RB_Val_Wu8 255.0 OneToOne 0.00 255.0 FORMAT "%5.1" /end CHARACTERISTIC
/begin CHARACTERISTIC Clth_swtClthType_C "Switch to select the clutch signal source for calculation of 25% and 75% switching point" VALUE 0x80533F69 RB_Val_Wu8 255.0 OneToOne 0.00 255.0 FORMAT "%5.1" /end CHARACTERISTIC
/begin CHARACTERISTIC CoETS_trqInrDetModeFild_C "Coeng" VALUE 0x80533F6A RB_Val_Ws16 6553.500 md_q0p1 -3276.800 3276.700 FORMAT "%8.3" /end CHARACTERISTIC
/begin CHARACTERISTIC CoETS_trqInrDetMode_C "Sw adapter calibration for CoETS_trqInrDetMode" VALUE 0x80533F6C RB_Val_Ws16 6553.500 Trq -3276.800 3276.700 FORMAT "%8.3" /end CHARACTERISTIC
/begin CHARACTERISTIC ComDCDC_stDiagCirc1_C "" VALUE 0x80533F6E RB_Val_Wu8 255.0 OneToOne 0.00 255.0 FORMAT "%5.1" /end CHARACTERISTIC
/begin CHARACTERISTIC ComDCDC_stDiagCirc2_C "" VALUE 0x80533F6F RB_Val_Wu8 255.0 OneToOne 0.00 255.0 FORMAT "%5.1" /end CHARACTERISTIC
/begin CHARACTERISTIC ComDCDC_stRxErr_C "Calibration for DCDC reception error flag (ID 0x10 Byte1 bit 3)" VALUE 0x80533F70 RB_Val_Wu8 255.0 OneToOne 0.00 255.0 FORMAT "%5.1" /end CHARACTERISTIC
/begin CHARACTERISTIC ComEBS_stBattSizeDetc_C "" VALUE 0x80533F71 RB_Val_Wu8 255.0 OneToOne 0.00 255.0 FORMAT "%5.1" /end CHARACTERISTIC
/begin CHARACTERISTIC Com_flgACCNorm_C "" VALUE 0x80533F72 RB_Val_Wboolean 1.00000000000 B_TRUE 0.00 1.00000000000 FORMAT "%13.11" /end CHARACTERISTIC
/begin CHARACTERISTIC Com_flgEAT9Norm_C "" VALUE 0x80533F73 RB_Val_Wboolean 1.00000000000 B_TRUE 0.00 1.00000000000 FORMAT "%13.11" /end CHARACTERISTIC
/begin CHARACTERISTIC Com_flgLETAcTqResvReplcmt_C "" VALUE 0x80533F74 RB_Val_Wu8 1.00000000000 B_TRUE 0.00 1.00000000000 FORMAT "%13.11" /end CHARACTERISTIC
/begin CHARACTERISTIC Com_flgLETNoInjCntrCdn_C "" VALUE 0x80533F75 RB_Val_Wu8 1.00000000000 B_TRUE 0.00 1.00000000000 FORMAT "%13.11" /end CHARACTERISTIC
/begin CHARACTERISTIC Com_flgLETORATmrThd_C "" VALUE 0x80533F76 RB_Val_Wu8 1.00000000000 B_TRUE 0.00 1.00000000000 FORMAT "%13.11" /end CHARACTERISTIC
/begin CHARACTERISTIC Com_flgManCrkPTCANEna_C "Cal for Manual cranking based on PT-CAN" VALUE 0x80533F77 RB_Val_Wu8 255.0 OneToOne 0.00 255.0 FORMAT "%5.1" /end CHARACTERISTIC
/begin CHARACTERISTIC Com_flgManModIndcn_C "" VALUE 0x80533F78 RB_Val_Wu8 1.00000000000 B_TRUE 0.00 1.00000000000 FORMAT "%13.11" /end CHARACTERISTIC
/begin CHARACTERISTIC Com_numGearTrgt_C "Default value for target gear information recieved over CAN" VALUE 0x80533F79 RB_Val_Wu8 255.0 OneToOne 0.00 255.0 FORMAT "%5.1" /end CHARACTERISTIC
/begin CHARACTERISTIC Com_rClthPos_C "" VALUE 0x80533F7A RB_Val_Ws16 799.9878 Prc -400.0000 399.9878 FORMAT "%8.4" /end CHARACTERISTIC
/begin CHARACTERISTIC Com_stACCSpdUnit_C "Cal for Unit of speed of car for customizing" VALUE 0x80533F7C RB_Val_Wu8 255.0 OneToOne 0.00 255.0 FORMAT "%5.1" /end CHARACTERISTIC
/begin CHARACTERISTIC Com_stADSSpdLim_C "ADS Speed Limit Request calibration" VALUE 0x80533F7D RB_Val_Wu8 255.0 OneToOne 0.00 255.0 FORMAT "%5.1" /end CHARACTERISTIC
/begin CHARACTERISTIC Com_stATEnaCond_C "AT enable condition recieved over CAN" VALUE 0x80533F7E RB_Val_Wu8 255.0 OneToOne 0.00 255.0 FORMAT "%5.1" /end CHARACTERISTIC
/begin CHARACTERISTIC Com_stATErr4_C "Status of AT failure in case of vehicle speed sensor defect" VALUE 0x80533F7F RB_Val_Wu8 255.0 OneToOne 0.00 255.0 FORMAT "%5.1" /end CHARACTERISTIC
/begin CHARACTERISTIC Com_stATShftUpDwnReq_C "Calibration for AT Shift Indicator Lamp status" VALUE 0x80533F80 RB_Val_Wu8 255.0 OneToOne 0.00 255.0 FORMAT "%5.1" /end CHARACTERISTIC
/begin CHARACTERISTIC Com_stAYC_C "Default value for AYCB mode" VALUE 0x80533F81 RB_Val_Wu8 255.0 OneToOne 0.00 255.0 FORMAT "%5.1" /end CHARACTERISTIC
/begin CHARACTERISTIC Com_stBCDGearEngmt_C "Calibration label for BCD Gear engagement" VALUE 0x80533F82 RB_Val_Wu8 255.0 OneToOne 0.00 255.0 FORMAT "%5.1" /end CHARACTERISTIC
/begin CHARACTERISTIC Com_stCamHealDisp_C "Cal for Displaying of camera dirty" VALUE 0x80533F83 RB_Val_Wu8 255.0 OneToOne 0.00 255.0 FORMAT "%5.1" /end CHARACTERISTIC
/begin CHARACTERISTIC Com_stDispDmdEnvCdn_C "Cal for Request to display additional sign post information which is recognized. (R side)" VALUE 0x80533F84 RB_Val_Wu8 255.0 OneToOne 0.00 255.0 FORMAT "%5.1" /end CHARACTERISTIC
/begin CHARACTERISTIC Com_stDispDmdSignRi_C "Calibration for Display demand of sign in knowledge(R side)" VALUE 0x80533F85 RB_Val_Wu8 255.0 OneToOne 0.00 255.0 FORMAT "%5.1" /end CHARACTERISTIC
/begin CHARACTERISTIC Com_stEAT3Mon_C "Calibration for Status for EAT3 error monitoring" VALUE 0x80533F86 RB_Val_Wu8 255.0 OneToOne 0.00 255.0 FORMAT "%5.1" /end CHARACTERISTIC
/begin CHARACTERISTIC Com_stEngMapReq_C "Calibration for Com_stEngMapReq" VALUE 0x80533F87 RB_Val_Wu8 255.0 OneToOne 0.00 255.0 FORMAT "%5.1" /end CHARACTERISTIC
/begin CHARACTERISTIC Com_stEVPIdleStopFail_C "Calibration for Idle Stop Failure for EVP" VALUE 0x80533F88 RB_Val_Wu8 255.0 OneToOne 0.00 255.0 FORMAT "%5.1" /end CHARACTERISTIC
/begin CHARACTERISTIC Com_stEVPIdleStopReq_C "Calibration for Idle Stop enable disable Permission in EVP" VALUE 0x80533F89 RB_Val_Wu8 255.0 OneToOne 0.00 255.0 FORMAT "%5.1" /end CHARACTERISTIC
/begin CHARACTERISTIC Com_stHydPCtrlOper_C "Status of EPB liquid pressure control" VALUE 0x80533F8A RB_Val_Wu8 255.0 OneToOne 0.00 255.0 FORMAT "%5.1" /end CHARACTERISTIC
/begin CHARACTERISTIC Com_stISEBBFail_C "Dummy Calibration for EBB failure information from VSA" VALUE 0x80533F8B RB_Val_Wu8 255.0 OneToOne 0.00 255.0 FORMAT "%5.1" /end CHARACTERISTIC
/begin CHARACTERISTIC Com_stMonMET_C "cal for Error State in MET used for monitoring" VALUE 0x80533F8C RB_Val_Wu8 255.0 OneToOne 0.00 255.0 FORMAT "%5.1" /end CHARACTERISTIC
/begin CHARACTERISTIC Com_vDigVehMph_C "" VALUE 0x80533F8D RB_Val_Wu8 255.0 Vel_CrCtl1_MPH 0.00 255.0 FORMAT "%5.1" /end CHARACTERISTIC
/begin CHARACTERISTIC Conv_tiLvrChgDrvRvs_CUR "Dummy curve used for calculation of Time debound of gear lever shift from drive to reverse" CURVE 0x80533F8E RB_Curve_S16_S16 655350.0 TimeDeb -327680.0 327670.0 FORMAT "%8.1"
 /begin AXIS_DESCR STD_AXIS NO_INPUT_QUANTITY Temp_Cels 14 -3549.940 3003.560 FORMAT "%8.3" DEPOSIT ABSOLUTE /end AXIS_DESCR
/end CHARACTERISTIC
/begin CHARACTERISTIC Conv_tiLvrChgRvsDrv_CUR "Dummy curve used for calculation of Time debound of gear lever shift from reverse to drive" CURVE 0x80533FC8 RB_Curve_S16_S16 655350.0 TimeDeb -327680.0 327670.0 FORMAT "%8.1"
 /begin AXIS_DESCR STD_AXIS NO_INPUT_QUANTITY Temp_Cels 14 -3549.940 3003.560 FORMAT "%8.3" DEPOSIT ABSOLUTE /end AXIS_DESCR
/end CHARACTERISTIC
/begin CHARACTERISTIC Conv_tiRevLvrOffNeut_CUR "Dummy curve used for calculation of Debounce time when transition from reverse gear to Neutral." CURVE 0x80534002 RB_Curve_S16_S16 655350.0 TimeDeb -327680.0 327670.0 FORMAT "%8.1"
 /begin AXIS_DESCR STD_AXIS NO_INPUT_QUANTITY Temp_Cels 14 -3549.940 3003.560 FORMAT "%8.3" DEPOSIT ABSOLUTE /end AXIS_DESCR
/end CHARACTERISTIC
/begin CHARACTERISTIC Conv_tiRevLvrOffPark_CUR "Dummy curve used for calculation of Debounce time when transition from reverse gear to Park" CURVE 0x8053403C RB_Curve_S16_S16 655350.0 TimeDeb -327680.0 327670.0 FORMAT "%8.1"
 /begin AXIS_DESCR STD_AXIS NO_INPUT_QUANTITY Temp_Cels 14 -3549.940 3003.560 FORMAT "%8.3" DEPOSIT ABSOLUTE /end AXIS_DESCR
/end CHARACTERISTIC
/begin CHARACTERISTIC Conv_tqResvTDpdtDRACOn_CUR "Dummy curve used for calucatation of Temperature dependant reserve torque of gear lever shift from drive to reverse and vice versa when AC on" CURVE 0x80534076 RB_Curve_S16_S16 6553.500 Trq -3276.800 3276.700 FORMAT "%8.3"
 /begin AXIS_DESCR STD_AXIS NO_INPUT_QUANTITY Temp_Cels 14 -3549.940 3003.560 FORMAT "%8.3" DEPOSIT ABSOLUTE /end AXIS_DESCR
/end CHARACTERISTIC
/begin CHARACTERISTIC Conv_tqResvTDpdtDR_CUR "Dummy curve used for calucatation of Temperature dependant reserve torque of gear lever shift from drive to reverse and vice versa when AC off" CURVE 0x805340B0 RB_Curve_S16_S16 6553.500 Trq -3276.800 3276.700 FORMAT "%8.3"
 /begin AXIS_DESCR STD_AXIS NO_INPUT_QUANTITY Temp_Cels 14 -3549.940 3003.560 FORMAT "%8.3" DEPOSIT ABSOLUTE /end AXIS_DESCR
/end CHARACTERISTIC
/begin CHARACTERISTIC CrCtl_stIDASTqModFailr_C "" VALUE 0x805340EA RB_Val_Wu8 255.0 OneToOne 0.00 255.0 FORMAT "%5.1" /end CHARACTERISTIC
/begin CHARACTERISTIC CrCUI_stPlusRDrvMod_C "" VALUE 0x805340EB RB_Val_Wu8 1.000 OneToOne 0.00 1.000 FORMAT "%5.3" EXTENDED_LIMITS 0.00 255.0 /end CHARACTERISTIC
/begin CHARACTERISTIC CWMDAPP "code word for calibration without torque structure" VALUE 0x805340EC RB_Val_Wu8 255.0 dez 0.00 255.0 FORMAT "%5.1" /end CHARACTERISTIC
/begin CHARACTERISTIC CW_CY329_Boost_Perm_On_Test "" VALUE 0x805340ED RB_Val_Wu8 255.0 OneToOne 0.00 255.0 FORMAT "%5.1" /end CHARACTERISTIC
/begin CHARACTERISTIC Dspl_stCrsASLSelInfo_C "Cal for Cruise Control ASL select information" VALUE 0x805340EE RB_Val_Wu8 255.0 OneToOne 0.00 255.0 FORMAT "%5.1" /end CHARACTERISTIC
/begin CHARACTERISTIC ElecLd_stSRCChk_C "" VALUE 0x805340EF RB_Val_Wu8 255.0 OneToOne 0.00 255.0 FORMAT "%5.1" /end CHARACTERISTIC
/begin CHARACTERISTIC ElM_tqActWoAcsyCmp_C "" VALUE 0x805340F0 RB_Val_Ws16 6553.500 Trq -3276.800 3276.700 FORMAT "%8.3" /end CHARACTERISTIC
/begin CHARACTERISTIC EngStrt_diaWrmUp_C "" VALUE 0x805340F2 RB_Val_Ws16 6553.500 zw_q0p1 -3276.800 3276.700 FORMAT "%8.3" /end CHARACTERISTIC
/begin CHARACTERISTIC ESS_bEngStrtEna_C "Calibration for enablingdisabling start release from the electrical system" VALUE 0x805340F4 RB_Val_Wu8 1.00000000000 B_TRUE 0.00 1.00000000000 FORMAT "%13.11" /end CHARACTERISTIC
/begin CHARACTERISTIC ExhMgT_flgRelsLamCptProtn_C "" VALUE 0x805340F5 RB_Val_Wu8 1.00000000000 B_TRUE 0.00 1.00000000000 FORMAT "%13.11" /end CHARACTERISTIC
/begin CHARACTERISTIC GbxRevLck_ATS.LimitTypeMsk_C "Actuator test GbxRevLck_ATS / Tester demand monitoring enable mask for actuators" VALUE 0x8053A610 Val_Wu8 255.0 OneToOne 0.00 255.0 FORMAT "%5.1" /end CHARACTERISTIC
/begin CHARACTERISTIC GbxRevLck_ATS.CnvNorm_C "Actuator test GbxRevLck_ATS / Conversion norm used for conversion to/from internal scaling" VALUE 0x8053A611 Val_Wu8 255.0 OneToOne 0.00 255.0 FORMAT "%5.1" /end CHARACTERISTIC
/begin CHARACTERISTIC GbxRevLck_ATS.LowLim_C "Actuator test GbxRevLck_ATS / Lower limit for monitoring" VALUE 0x8053A612 Val_Ws16 65535.00 OneToOne -32768.00 32767.00 FORMAT "%8.2" /end CHARACTERISTIC
/begin CHARACTERISTIC GbxRevLck_ATS.UpLim_C "Actuator test GbxRevLck_ATS / Upper limit for monitoring" VALUE 0x8053A614 Val_Ws16 65535.00 OneToOne -32768.00 32767.00 FORMAT "%8.2" /end CHARACTERISTIC
/begin CHARACTERISTIC GbxRevLck_ATS.CnvFac_C "Actuator test GbxRevLck_ATS / Factor used for conversion to/from internal scaling" VALUE 0x8053A618 Val_Ws32 4294967295.00 OneToOne -2147483648.00 2147483647.00 FORMAT "%13.2" /end CHARACTERISTIC
/begin CHARACTERISTIC GbxRevLck_ATS.CnvOfs_C "Actuator test GbxRevLck_ATS / Offset used for conversion to/from internal scaling" VALUE 0x8053A61C Val_Ws16 65535.00 OneToOne -32768.00 32767.00 FORMAT "%8.2" /end CHARACTERISTIC
/begin CHARACTERISTIC GbxRevLck_ATS.DfltVal_C "Actuator test GbxRevLck_ATS / Default value for standbytest" VALUE 0x8053A61E Val_Ws16 65535.00 OneToOne -32768.00 32767.00 FORMAT "%8.2" /end CHARACTERISTIC
/begin CHARACTERISTIC Gbx_bATSlipOpn_C "" VALUE 0x805340F6 RB_Val_Wu8 1.00000000000 B_TRUE 0.00 1.00000000000 FORMAT "%13.11" /end CHARACTERISTIC
/begin CHARACTERISTIC Gbx_bNCmp_C "" VALUE 0x805340F7 RB_Val_Wu8 1.00000000000 B_TRUE 0.00 1.00000000000 FORMAT "%13.11" /end CHARACTERISTIC
/begin CHARACTERISTIC Gbx_bTIIIntv_C "calibration to update Gbx_bTIIIntv" VALUE 0x805340F8 RB_Val_Wu8 1.00000000000 B_TRUE 0.00 1.00000000000 FORMAT "%13.11" /end CHARACTERISTIC
/begin CHARACTERISTIC Gbx_flgNCtrlImp_C "Calibration for Operation of N control execution flag" VALUE 0x805340F9 RB_Val_Wboolean 1.00000000000 B_TRUE 0.00 1.00000000000 FORMAT "%13.11" /end CHARACTERISTIC
/begin CHARACTERISTIC Gbx_flgNCtrlRetStrt_C "Calibration for N control return judgement flag at brake ON" VALUE 0x805340FA RB_Val_Wboolean 1.00000000000 B_TRUE 0.00 1.00000000000 FORMAT "%13.11" /end CHARACTERISTIC
/begin CHARACTERISTIC Gbx_nRrngEngSpdInh_C "Calibration for Gbx_nRrngEngSpdInh" VALUE 0x805340FC RB_Val_Ws16 32767.50 EngN -16384.00 16383.50 FORMAT "%8.2" /end CHARACTERISTIC
/begin CHARACTERISTIC Gbx_rConvSlip_C "Cal for Transmission torque converter slip" VALUE 0x805340FE RB_Val_Ws16 327.6750 CrCtlSlipRat -163.8400 163.8350 FORMAT "%8.4" /end CHARACTERISTIC
/begin CHARACTERISTIC Gbx_uAPPMaxLrn_C "Calibration for Gearbox AT accelerator max learned voltage" VALUE 0x80534100 RB_Val_Ws16 1310700. Volt_Batt -655360.0 655340.0 FORMAT "%8.1" /end CHARACTERISTIC
/begin CHARACTERISTIC GEVCtl_agWidthCamProfLoLftIntk_C "Width of the intake valve cam profile (small cam) referred to 0.5mm lift" VALUE 0x80534102 RB_Val_Ws16 1023.984 kw_q0p0156 -512.0000 511.9844 FORMAT "%8.4" /end CHARACTERISTIC
/begin CHARACTERISTIC GEVCtl_flgPhaEnaPOil_C "" VALUE 0x80534104 RB_Val_Wu8 1.00000000000 B_TRUE 0.00 1.00000000000 FORMAT "%13.11" /end CHARACTERISTIC
/begin CHARACTERISTIC GEVCtl_flgSpSpclIntkVlvLft_C "" VALUE 0x80534105 RB_Val_Wu8 1.00000000000 B_TRUE 0.00 1.00000000000 FORMAT "%13.11" /end CHARACTERISTIC
/begin CHARACTERISTIC GEVCtl_ratLoad_C "Calibrtion Parameter : Relative load for setpoints determination of camshaft phase shifting" VALUE 0x80534106 RB_Val_Wu16 1535.977 rel_uw_q0p0234 0.00 1535.977 FORMAT "%8.3" /end CHARACTERISTIC
/begin CHARACTERISTIC GEVCtl_stPhaAdpr_C "Codeword interface test" VALUE 0x80534108 RB_Val_Wu8 255.0 OneToOne 0.00 255.0 FORMAT "%5.1" /end CHARACTERISTIC
/begin CHARACTERISTIC GEVCtl_tOilCylHd_C "Caliration parameter : Oil temperature cylinder head" VALUE 0x8053410A RB_Val_Ws16 6553.500 Temp_Cels -3549.940 3003.560 FORMAT "%8.3" /end CHARACTERISTIC
/begin CHARACTERISTIC HEGO_flgReIniSnsrTMdl_C "ReInitialization of sensor temperature model is activated" VALUE 0x8053410C RB_Val_Wu8 1.00000000000 B_TRUE 0.00 1.00000000000 FORMAT "%13.11" /end CHARACTERISTIC
/begin CHARACTERISTIC HEGO_resRiMaxPlaus_C "maximum plausible Ri, above which an open signal line can be expected" VALUE 0x8053410E RB_Val_Wu16 131070.0 r_uw_q2 0.00 131070.0 FORMAT "%8.1" /end CHARACTERISTIC
/begin CHARACTERISTIC HndBrk_stDebVal_C "Calibration for Debounced value of Hand Brake switch" VALUE 0x80534110 RB_Val_Wu8 255.0 OneToOne 0.00 255.0 FORMAT "%5.1" /end CHARACTERISTIC
/begin CHARACTERISTIC I14229iocbiCrCtl1_stVal_C "Calibration for Status of CrCtl 1 SFT" VALUE 0x80534112 RB_Val_Wu16 65535.00 OneToOne 0.00 65535.00 FORMAT "%8.2" /end CHARACTERISTIC
/begin CHARACTERISTIC I14229iocbiCrCtl_stVal_C "Calibration for Status of Cruise control lamp SFT" VALUE 0x80534114 RB_Val_Wu16 65535.00 OneToOne 0.00 65535.00 FORMAT "%8.2" /end CHARACTERISTIC
/begin CHARACTERISTIC I14229_stAutoStrtEna_C "status indicate Auto Start is supported" VALUE 0x80534116 RB_Val_Wu8 255.0 OneToOne 0.00 255.0 FORMAT "%5.1" /end CHARACTERISTIC
/begin CHARACTERISTIC I14229_stPCSEvapSwt_C "Calibration switch for DIDE801" VALUE 0x80534117 RB_Val_Wu8 255.0 OneToOne 0.00 255.0 FORMAT "%5.1" /end CHARACTERISTIC
/begin AXIS_PTS Ign_nEng20_AX "Distribution dependent of Epm_nEng(20)" 0x80534118 Epm_nEng RB_Axis_S16 32767.50 EngN 20 -16384.00 16383.50 FORMAT "%8.2" DEPOSIT ABSOLUTE /end AXIS_PTS
/begin AXIS_PTS Ign_nEngVS12_AX "engine speed dep.map" 0x80534142 Epm_nEng RB_Axis_S16 32767.50 EngN 20 -16384.00 16383.50 FORMAT "%8.2" DEPOSIT ABSOLUTE /end AXIS_PTS
/begin AXIS_PTS Ign_ratChrgAirVS12_AX "load dep. map" 0x8053416C Ign_ratChrgAirCyl RB_Axis_U16 1535.977 rel_q0p0234 12 0.00 1535.977 FORMAT "%8.3" DEPOSIT ABSOLUTE /end AXIS_PTS
/begin CHARACTERISTIC KW_CWADRES "" VALUE 0x80534186 RB_Val_Wu8 1.00000000000 B_TRUE 0.00 1.00000000000 FORMAT "%13.11" /end CHARACTERISTIC
/begin CHARACTERISTIC LAS_facRoadGrdt_C "Calibration label for Factor for Road gradient" VALUE 0x80534188 RB_Val_Ws16 655.3500 Prc_Fact100 -327.6800 327.6700 FORMAT "%8.4" /end CHARACTERISTIC
/begin CHARACTERISTIC NSWO1 "engine-speed threshold 1 for switching calculation" VALUE 0x8053418A RB_Val_Wu8 10200. nmot_ub_q40 0.00 10200. FORMAT "%5.0" /end CHARACTERISTIC
/begin CHARACTERISTIC NSWO2 "engine-speed threshold 2 for switching calculation" VALUE 0x8053418B RB_Val_Wu8 10200. nmot_ub_q40 0.00 10200. FORMAT "%5.0" /end CHARACTERISTIC
/begin CHARACTERISTIC Oil_p_C "" VALUE 0x8053418C RB_Val_Ws16 6553.500 Pres -3276.800 3276.700 FORMAT "%8.3" /end CHARACTERISTIC
/begin CHARACTERISTIC PCR_pDesVal_C "desired boost pressure" VALUE 0x8053418E RB_Val_Ws16 65535.00 Pres_hPa -32768.00 32767.00 FORMAT "%8.2" /end CHARACTERISTIC
/begin CHARACTERISTIC PHAACTRINTK_CTL_ATS_ATS.LimitTypeMsk_C "Actuator test PHAACTRINTK_CTL_ATS_ATS / Tester demand monitoring enable mask for actuators" VALUE 0x8053A630 Val_Wu8 255.0 OneToOne 0.00 255.0 FORMAT "%5.1" /end CHARACTERISTIC
/begin CHARACTERISTIC PHAACTRINTK_CTL_ATS_ATS.CnvNorm_C "Actuator test PHAACTRINTK_CTL_ATS_ATS / Conversion norm used for conversion to/from internal scaling" VALUE 0x8053A631 Val_Wu8 255.0 OneToOne 0.00 255.0 FORMAT "%5.1" /end CHARACTERISTIC
/begin CHARACTERISTIC PHAACTRINTK_CTL_ATS_ATS.LowLim_C "Actuator test PHAACTRINTK_CTL_ATS_ATS / Lower limit for monitoring" VALUE 0x8053A632 Val_Ws16 1023.984 kw_q0p0156 -512.0000 511.9844 FORMAT "%8.4" /end CHARACTERISTIC
/begin CHARACTERISTIC PHAACTRINTK_CTL_ATS_ATS.UpLim_C "Actuator test PHAACTRINTK_CTL_ATS_ATS / Upper limit for monitoring" VALUE 0x8053A634 Val_Ws16 1023.984 kw_q0p0156 -512.0000 511.9844 FORMAT "%8.4" /end CHARACTERISTIC
/begin CHARACTERISTIC PHAACTRINTK_CTL_ATS_ATS.CnvFac_C "Actuator test PHAACTRINTK_CTL_ATS_ATS / Factor used for conversion to/from internal scaling" VALUE 0x8053A638 Val_Ws32 4294967295.00 OneToOne -2147483648.00 2147483647.00 FORMAT "%13.2" /end CHARACTERISTIC
/begin CHARACTERISTIC PHAACTRINTK_CTL_ATS_ATS.CnvOfs_C "Actuator test PHAACTRINTK_CTL_ATS_ATS / Offset used for conversion to/from internal scaling" VALUE 0x8053A63C Val_Ws16 65535.00 OneToOne -32768.00 32767.00 FORMAT "%8.2" /end CHARACTERISTIC
/begin CHARACTERISTIC PHAACTRINTK_CTL_ATS_ATS.DfltVal_C "Actuator test PHAACTRINTK_CTL_ATS_ATS / Default value for standbytest" VALUE 0x8053A63E Val_Ws16 65535.00 OneToOne -32768.00 32767.00 FORMAT "%8.2" /end CHARACTERISTIC
/begin CHARACTERISTIC PHAACTROUTL_CTL_ATS_ATS.LimitTypeMsk_C "Actuator test PHAACTROUTL_CTL_ATS_ATS / Tester demand monitoring enable mask for actuators" VALUE 0x8053A640 Val_Wu8 255.0 OneToOne 0.00 255.0 FORMAT "%5.1" /end CHARACTERISTIC
/begin CHARACTERISTIC PHAACTROUTL_CTL_ATS_ATS.CnvNorm_C "Actuator test PHAACTROUTL_CTL_ATS_ATS / Conversion norm used for conversion to/from internal scaling" VALUE 0x8053A641 Val_Wu8 255.0 OneToOne 0.00 255.0 FORMAT "%5.1" /end CHARACTERISTIC
/begin CHARACTERISTIC PHAACTROUTL_CTL_ATS_ATS.LowLim_C "Actuator test PHAACTROUTL_CTL_ATS_ATS / Lower limit for monitoring" VALUE 0x8053A642 Val_Ws16 1023.984 kw_q0p0156 -512.0000 511.9844 FORMAT "%8.4" /end CHARACTERISTIC
/begin CHARACTERISTIC PHAACTROUTL_CTL_ATS_ATS.UpLim_C "Actuator test PHAACTROUTL_CTL_ATS_ATS / Upper limit for monitoring" VALUE 0x8053A644 Val_Ws16 1023.984 kw_q0p0156 -512.0000 511.9844 FORMAT "%8.4" /end CHARACTERISTIC
/begin CHARACTERISTIC PHAACTROUTL_CTL_ATS_ATS.CnvFac_C "Actuator test PHAACTROUTL_CTL_ATS_ATS / Factor used for conversion to/from internal scaling" VALUE 0x8053A648 Val_Ws32 4294967295.00 OneToOne -2147483648.00 2147483647.00 FORMAT "%13.2" /end CHARACTERISTIC
/begin CHARACTERISTIC PHAACTROUTL_CTL_ATS_ATS.CnvOfs_C "Actuator test PHAACTROUTL_CTL_ATS_ATS / Offset used for conversion to/from internal scaling" VALUE 0x8053A64C Val_Ws16 65535.00 OneToOne -32768.00 32767.00 FORMAT "%8.2" /end CHARACTERISTIC
/begin CHARACTERISTIC PHAACTROUTL_CTL_ATS_ATS.DfltVal_C "Actuator test PHAACTROUTL_CTL_ATS_ATS / Default value for standbytest" VALUE 0x8053A64E Val_Ws16 65535.00 OneToOne -32768.00 32767.00 FORMAT "%8.2" /end CHARACTERISTIC
/begin CHARACTERISTIC priobbora_msg_C "Substitute value for priobbora_msg" VALUE 0x80534190 RB_Val_Wu8 255.0 OneToOne 0.00 255.0 FORMAT "%5.1" /end CHARACTERISTIC
/begin CHARACTERISTIC priobbteh_msg_C "" VALUE 0x80534191 RB_Val_Wu8 255.0 OneToOne 0.00 255.0 FORMAT "%5.1" /end CHARACTERISTIC
/begin CHARACTERISTIC PRMAX "max.setpoint-value rail pressure" VALUE 0x80534192 RB_Val_Wu16 32.76750 p_q0p0005 0.00 32.76750 FORMAT "%8.5" /end CHARACTERISTIC
/begin CHARACTERISTIC psmxbkvg_w_msg_C "" VALUE 0x80534194 RB_Val_Wu16 2559.961 p_uw_q0p039 0.00 2559.961 FORMAT "%8.3" /end CHARACTERISTIC
/begin CHARACTERISTIC PSPCtl_flgRmnVapSuspc_C "" VALUE 0x80534196 RB_Val_Wu8 1.00000000000 B_TRUE 0.00 1.00000000000 FORMAT "%13.11" /end CHARACTERISTIC
/begin CHARACTERISTIC PTDist_flgCrkSftMintqSeln_C "Calibration to select minimum accessible engine torque" VALUE 0x80534197 RB_Val_Wu8 1.00000000000 B_TRUE 0.00 1.00000000000 FORMAT "%13.11" /end CHARACTERISTIC
/begin CHARACTERISTIC PTDist_flgEnaTCMFCOReqByp_C "Powertrain flag Enable TCM FCO Request Bypass" VALUE 0x80534198 RB_Val_Wu8 1.00000000000 B_TRUE 0.00 1.00000000000 FORMAT "%13.11" /end CHARACTERISTIC
/begin CHARACTERISTIC PTDist_tqdeltaTCMFCOReq_C "Powertrain Torque Delta TCM FCO Request" VALUE 0x8053419A RB_Val_Ws16 6553.500 md_q0p1 -3276.800 3276.700 FORMAT "%8.3" /end CHARACTERISTIC
/begin CHARACTERISTIC PT_trqWhlMaxEng_C "" VALUE 0x8053419C RB_Val_Ws32 429496729.500 TrqPrpHigh -214748364.800 214748364.700 FORMAT "%13.3" /end CHARACTERISTIC
/begin CHARACTERISTIC PT_trqWhlMinWoCtOff_C "" VALUE 0x805341A0 RB_Val_Ws32 429496729.500 TrqPrpHigh -214748364.800 214748364.700 FORMAT "%13.3" /end CHARACTERISTIC
/begin CHARACTERISTIC StrtCtl_ctFaultStrtLim_C "Number of fault starts before the starter cut off is changed" VALUE 0x8053447C RB_Val_Wu8 255.0 OneToOne 0.00 255.0 FORMAT "%5.1" /end CHARACTERISTIC
/begin CHARACTERISTIC StrtCtl_flgDiEPBCdn_C "Disable EPB condition flag" VALUE 0x8053447D RB_Val_Wu8 1.00000000000 B_TRUE 0.00 1.00000000000 FORMAT "%13.11" /end CHARACTERISTIC
/begin CHARACTERISTIC StrtCtl_nEngSpdThd_C "Threshold for engine speed. Further condition to stall the engine after remote start" VALUE 0x8053447E RB_Val_Ws16 32767.50 EngN -16384.00 16383.50 FORMAT "%8.2" /end CHARACTERISTIC
/begin CHARACTERISTIC StrtCtl_nEngStallThd_C "Engine speed threshold to detect a stalled engine" VALUE 0x80534480 RB_Val_Ws16 32767.50 EngN -16384.00 16383.50 FORMAT "%8.2" /end CHARACTERISTIC
/begin CHARACTERISTIC StrtCtl_nStrtActv_C "engine-speed threshold for detection of active starter" VALUE 0x80534482 RB_Val_Ws16 16383.50 EngN 0.00 16383.50 FORMAT "%8.2" EXTENDED_LIMITS -16384.00 16383.50 /end CHARACTERISTIC
/begin CHARACTERISTIC StrtCtl_nStrtIdl_C "idle starter engine speed" VALUE 0x80534484 RB_Val_Ws16 16383.50 EngN 0.00 16383.50 FORMAT "%8.2" EXTENDED_LIMITS -16384.00 16383.50 /end CHARACTERISTIC
/begin CHARACTERISTIC StrtCtl_nStrtRlsMax_C "maximum speed for starter release" VALUE 0x80534486 RB_Val_Ws16 16383.50 EngN 0.00 16383.50 FORMAT "%8.2" EXTENDED_LIMITS -16384.00 16383.50 /end CHARACTERISTIC
/begin CHARACTERISTIC StrtCtl_nThresStrtCtOff_MAP "engine-speed threshold for starter cut off" MAP 0x80534488 RB_Map_S16S16_S16 16383.50 EngN 0.00 16383.50 FORMAT "%8.2" EXTENDED_LIMITS -16384.00 16383.50
 /begin AXIS_DESCR STD_AXIS CEngDsT_t Temp_Cels 6 -3549.940 3003.560 FORMAT "%8.3" DEPOSIT ABSOLUTE /end AXIS_DESCR
 /begin AXIS_DESCR STD_AXIS BattU_u Volt_Batt 3 -655360.0 655340.0 FORMAT "%8.1" DEPOSIT ABSOLUTE /end AXIS_DESCR
/end CHARACTERISTIC
/begin CHARACTERISTIC StrtCtl_stIMG_C "Calibration to select for Integrated Management (IMG) arbitration on CAN signal" VALUE 0x805344C2 RB_Val_Wu8 1.00000000000 B_TRUE 0.00 1.00000000000 FORMAT "%13.11" /end CHARACTERISTIC
/begin CHARACTERISTIC StrtCtl_stNFaultStrt_Msk "bit mask fault start after starter cut off through speed limit" VALUE 0x805344C4 RB_Val_Wu16 65535.00 OneToOne 0.00 65535.00 FORMAT "%8.2" /end CHARACTERISTIC
/begin CHARACTERISTIC StrtCtl_stNPosnEnaForBit13_C "Calibration to select Neutral Position Check for Bit13 of Strater Release Conditions" VALUE 0x805344C6 RB_Val_Wu8 1.00000000000 B_TRUE 0.00 1.00000000000 FORMAT "%13.11" /end CHARACTERISTIC
/begin CHARACTERISTIC StrtCtl_stStA_CW "Code word for starter control" VALUE 0x805344C7 RB_Val_Wu8 255.0 OneToOne 0.00 255.0 FORMAT "%5.1" /end CHARACTERISTIC
/begin CHARACTERISTIC StrtCtl_stStrtCutOffMsk_C "Mask calibration for selecting starter cut off condition" VALUE 0x805344C8 RB_Val_Wu16 65535.00 OneToOne 0.00 65535.00 FORMAT "%8.2" /end CHARACTERISTIC
/begin CHARACTERISTIC StrtCtl_stStrtRls_Msk "Mask for release conditions for starter control" VALUE 0x805344CA RB_Val_Wu16 65535.00 OneToOne 0.00 65535.00 FORMAT "%8.2" /end CHARACTERISTIC
/begin CHARACTERISTIC StrtCtl_stStSpStrtRls_Msk "bit mask for starter release at start-stop" VALUE 0x805344CC RB_Val_Wu16 65535.00 OneToOne 0.00 65535.00 FORMAT "%8.2" /end CHARACTERISTIC
/begin CHARACTERISTIC StrtCtl_stSyncStrtOff_C "state of synchronization for analyse engine rotation at starter control" VALUE 0x805344CE RB_Val_Wu8 255.0 OneToOne 0.00 255.0 FORMAT "%5.1" /end CHARACTERISTIC
/begin CHARACTERISTIC StrtCtl_stTiFaultStrt_Msk "bit mask fault start after starter cut off through time limit" VALUE 0x805344D0 RB_Val_Wu16 65535.00 OneToOne 0.00 65535.00 FORMAT "%8.2" /end CHARACTERISTIC
/begin CHARACTERISTIC StrtCtl_stTraBrk_CW "codeword to activate the check of transmission, break" VALUE 0x805344D2 RB_Val_Wu8 255.0 OneToOne 0.00 255.0 FORMAT "%5.1" /end CHARACTERISTIC
/begin CHARACTERISTIC StrtCtl_tiAutoStrtRls_C "Auto start release delay time" VALUE 0x805344D4 RB_Val_Ws32 4294.96729500 Time_Dt -2147.48364800 2147.48364700 FORMAT "%13.8" /end CHARACTERISTIC
/begin CHARACTERISTIC StrtCtl_tiCanFailrDetnDly_C "Delay time value to detect the Can failure" VALUE 0x805344D8 RB_Val_Wu16 655350.0 Time_ms 0.00 655350.0 FORMAT "%8.1" /end CHARACTERISTIC
/begin CHARACTERISTIC StrtCtl_tiCnclStrtReqDeb_C "Delay time before delete start request" VALUE 0x805344DC RB_Val_Ws32 2147.48364700 Time_Dt 0.00 2147.48364700 FORMAT "%13.8" EXTENDED_LIMITS -2147.48364800 2147.48364700 /end CHARACTERISTIC
/begin CHARACTERISTIC StrtCtl_tiComNPDly_C "On delay of shift gear status" VALUE 0x805344E0 RB_Val_Ws32 2147.48364700 Time_Dt 0.00 2147.48364700 FORMAT "%13.8" EXTENDED_LIMITS -2147.48364800 2147.48364700 /end CHARACTERISTIC
/begin CHARACTERISTIC StrtCtl_tiDlyStrtCtOffV_C "debounce time for starter cut off via car speed" VALUE 0x805344E4 RB_Val_Ws16 327.6700 Time_s 0.00 327.6700 FORMAT "%8.4" EXTENDED_LIMITS -327.6800 327.6700 /end CHARACTERISTIC
/begin CHARACTERISTIC StrtCtl_tiEngStallThd_C "Time limit to confirm an engine stall" VALUE 0x805344E6 RB_Val_Wu8 2550. Time_ms 0.00 2550. FORMAT "%5.0" /end CHARACTERISTIC
/begin CHARACTERISTIC StrtCtl_tiEPBActtnReqDlyElpd_C "Time limit after the EPB actuation request beyond which EPB applied flag is set" VALUE 0x805344E8 RB_Val_Ws16 655350.0 Time_ms -327680.0 327670.0 FORMAT "%8.1" /end CHARACTERISTIC
/begin CHARACTERISTIC StrtCtl_tiFuPWait_C "Fuel pressure waiting timer threshold" VALUE 0x805344EA RB_Val_Wu16 655350.0 Time_ms 0.00 655350.0 FORMAT "%8.1" /end CHARACTERISTIC
/begin CHARACTERISTIC StrtCtl_tiIdleSpStCmftMax_C "Maximum time for comfort at idle stop for start cut off" VALUE 0x805344EC RB_Val_Ws16 327.6700 Time_s 0.00 327.6700 FORMAT "%8.4" EXTENDED_LIMITS -327.6800 327.6700 /end CHARACTERISTIC
/begin CHARACTERISTIC StrtCtl_tiIgnOnCANDeb_C "Delay time value to receive CAN frames after T15 ON" VALUE 0x805344F0 RB_Val_Ws32 2147.48364700 Time_Dt 0.00 2147.48364700 FORMAT "%13.8" EXTENDED_LIMITS -2147.48364800 2147.48364700 /end CHARACTERISTIC
/begin CHARACTERISTIC StrtCtl_tiIgnOnDeb_C "Delay time value to ignore EPB at the first crank from T15 ON" VALUE 0x805344F4 RB_Val_Ws32 2147.48364700 Time_Dt 0.00 2147.48364700 FORMAT "%13.8" EXTENDED_LIMITS -2147.48364800 2147.48364700 /end CHARACTERISTIC
/begin CHARACTERISTIC StrtCtl_tiManStrtOnDly_C "turn on delay period for recognition of manual start" VALUE 0x805344F8 RB_Val_Ws16 655.3500 Time_s -327.6800 327.6700 FORMAT "%8.4" /end CHARACTERISTIC
/begin CHARACTERISTIC StrtCtl_tiNMaxDeb_C "Debounce time for maximum speed for starter release" VALUE 0x805344FC RB_Val_Ws32 2147.48364700 Time_Dt 0.00 2147.48364700 FORMAT "%13.8" EXTENDED_LIMITS -2147.48364800 2147.48364700 /end CHARACTERISTIC
/begin CHARACTERISTIC StrtCtl_tiNZeroDeb_C "debounce time for zero rpm detection" VALUE 0x80534500 RB_Val_Ws32 2147.48364700 Time_Dt 0.00 2147.48364700 FORMAT "%13.8" EXTENDED_LIMITS -2147.48364800 2147.48364700 /end CHARACTERISTIC
/begin CHARACTERISTIC StrtCtl_tiPanicStrtReq_C "time of start request to detect a ""urgent start request""" VALUE 0x80534504 RB_Val_Ws16 327.6700 Time_s 0.00 327.6700 FORMAT "%8.4" EXTENDED_LIMITS -327.6800 327.6700 /end CHARACTERISTIC
/begin CHARACTERISTIC StrtCtl_tiPushBtnStrtCmft_T "Maximum starter operation time in case of push button start (comfort)" CURVE 0x80534506 RB_Curve_S16_S16 327.6700 Time_s 0.00 327.6700 FORMAT "%8.4" EXTENDED_LIMITS -327.6800 327.6700
 /begin AXIS_DESCR STD_AXIS CEngDsT_t Temp_Cels 5 -3549.940 3003.560 FORMAT "%8.3" DEPOSIT ABSOLUTE /end AXIS_DESCR
/end CHARACTERISTIC
/begin CHARACTERISTIC StrtCtl_tiStrtActv_C "debounce time for detection starter rpm" VALUE 0x8053451C RB_Val_Ws32 2147.48364700 Time_Dt 0.00 2147.48364700 FORMAT "%13.8" EXTENDED_LIMITS -2147.48364800 2147.48364700 /end CHARACTERISTIC
/begin CHARACTERISTIC StrtCtl_tiStrtCmftMax_CUR "maximum starter operation time for comfort" CURVE 0x80534520 RB_Curve_S16_S16 327.6700 Time_s 0.00 327.6700 FORMAT "%8.4" EXTENDED_LIMITS -327.6800 327.6700
 /begin AXIS_DESCR STD_AXIS CEngDsT_t Temp_Cels 3 -3549.940 3003.560 FORMAT "%8.3" DEPOSIT ABSOLUTE /end AXIS_DESCR
/end CHARACTERISTIC
/begin CHARACTERISTIC StrtCtl_tiStrtDlyMax_C "maximum delay of starter control" VALUE 0x8053452E RB_Val_Ws16 327.6700 Time_s 0.00 327.6700 FORMAT "%8.4" EXTENDED_LIMITS -327.6800 327.6700 /end CHARACTERISTIC
/begin CHARACTERISTIC StrtCtl_tiStrtDlyMin_C "minimum delay of starter control" VALUE 0x80534530 RB_Val_Ws16 327.6700 Time_s 0.00 327.6700 FORMAT "%8.4" EXTENDED_LIMITS -327.6800 327.6700 /end CHARACTERISTIC
/begin CHARACTERISTIC StrtCtl_tiStrtOffMin_C "minimum time between two starter activations" VALUE 0x80534534 RB_Val_Ws32 2147.38364700 Time_Dt 0.10000000 2147.48364700 FORMAT "%13.8" EXTENDED_LIMITS -2147.48364800 2147.48364700 /end CHARACTERISTIC
/begin CHARACTERISTIC StrtCtl_tiStrtOnMin_C "Minimum starter operation time at bypassing the time threshold" VALUE 0x80534538 RB_Val_Ws16 327.6700 Time_s 0.00 327.6700 FORMAT "%8.4" EXTENDED_LIMITS -327.6800 327.6700 /end CHARACTERISTIC
/begin CHARACTERISTIC StrtCtl_tiStrtOpPanicMax_MAP "maximum starter operation time at panic start" MAP 0x8053453A RB_Map_S16S16_S16 327.6700 Time_s 0.00 327.6700 FORMAT "%8.4" EXTENDED_LIMITS -327.6800 327.6700
 /begin AXIS_DESCR STD_AXIS CEngDsT_t Temp_Cels 3 -3549.940 3003.560 FORMAT "%8.3" DEPOSIT ABSOLUTE /end AXIS_DESCR
 /begin AXIS_DESCR STD_AXIS CoEng_tiStrtDly Time_ms 3 -327680.0 327670.0 FORMAT "%8.1" DEPOSIT ABSOLUTE /end AXIS_DESCR
/end CHARACTERISTIC
/begin CHARACTERISTIC StrtCtl_tiStrtOrdMax_C "maximum time for output start order (try to control the starter)" VALUE 0x8053455C RB_Val_Ws16 327.6700 Time_s 0.00 327.6700 FORMAT "%8.4" EXTENDED_LIMITS -327.6800 327.6700 /end CHARACTERISTIC
/begin CHARACTERISTIC StrtCtl_tiStrtPwrIdlMax_C "maximum starter operation time at starter-idle to limit the power consumption" VALUE 0x8053455E RB_Val_Ws16 327.6600 Time_s 0.0100 327.6700 FORMAT "%8.4" EXTENDED_LIMITS -327.6800 327.6700 /end CHARACTERISTIC
/begin CHARACTERISTIC StrtCtl_tiStrtPwrMax_CUR "maximum starter operation time to limit the power consumption" CURVE 0x80534560 RB_Curve_S16_S16 327.6600 Time_s 0.0100 327.6700 FORMAT "%8.4" EXTENDED_LIMITS -327.6800 327.6700
 /begin AXIS_DESCR STD_AXIS CEngDsT_t Temp_Cels 3 -3549.940 3003.560 FORMAT "%8.3" DEPOSIT ABSOLUTE /end AXIS_DESCR
/end CHARACTERISTIC
/begin CHARACTERISTIC StrtCtl_tiStrtReqRstDly_C "Off delay of stater request reset status" VALUE 0x80534570 RB_Val_Ws32 2147.48364700 Time_Dt 0.00 2147.48364700 FORMAT "%13.8" EXTENDED_LIMITS -2147.48364800 2147.48364700 /end CHARACTERISTIC
/begin CHARACTERISTIC StrtCtl_tiStrtReqTCUDlyIMG_C "Delay time after a start request trigger to wait CAN signal from TCU." VALUE 0x80534574 RB_Val_Wu16 655350.0 Time_ms 0.00 655350.0 FORMAT "%8.1" /end CHARACTERISTIC
/begin CHARACTERISTIC StrtCtl_tiStrtReqValDeb_C "Debounce time for validation of start request" VALUE 0x80534578 RB_Val_Ws32 2147.48364700 Time_Dt 0.00 2147.48364700 FORMAT "%13.8" EXTENDED_LIMITS -2147.48364800 2147.48364700 /end CHARACTERISTIC
/begin CHARACTERISTIC StrtCtl_tiStrtRlsDly_C "Delay timer for start release" VALUE 0x8053457C RB_Val_Ws32 4294.96729500 Time_Dt -2147.48364800 2147.48364700 FORMAT "%13.8" /end CHARACTERISTIC
/begin CHARACTERISTIC StrtCtl_uAutCrkInhb_C "Battery voltage threshold for auto cranking inhibition condition" VALUE 0x80534580 RB_Val_Ws16 1310700. Volt_Batt -655360.0 655340.0 FORMAT "%8.1" /end CHARACTERISTIC
/begin CHARACTERISTIC StrtCtl_uAutoCrkBatt_C "Battery voltage threshold for auto cranking mode." VALUE 0x80534582 RB_Val_Ws16 1310700. Volt_Batt -655360.0 655340.0 FORMAT "%8.1" /end CHARACTERISTIC
/begin CHARACTERISTIC StrtCtl_vThresStrtCtOff_C "car-speed threshold for starter cut off" VALUE 0x80534584 RB_Val_Ws16 327.6700 Vel 0.00 327.6700 FORMAT "%8.4" EXTENDED_LIMITS -327.6800 327.6700 /end CHARACTERISTIC
/begin CHARACTERISTIC StrtCtl_vVehRunngThd_C "Threshold speed for vehicle running status" VALUE 0x80534586 RB_Val_Ws16 655.3500 Vel -327.6800 327.6700 FORMAT "%8.4" /end CHARACTERISTIC
/begin CHARACTERISTIC Strt_cntrContnsRstrtIntlShoRepl_C "Replacement value for the EEPROM element storing Short interval counter less than 4min" VALUE 0x8053458A RB_Val_Wu8 255.0 OneToOne 0.00 255.0 FORMAT "%5.1" /end CHARACTERISTIC
/begin CHARACTERISTIC Strt_cntrRstrtIntlShoRepl_C "Replacement value for EEPROM element storing Short interval counter less than 30s" VALUE 0x8053458B RB_Val_Wu8 255.0 OneToOne 0.00 255.0 FORMAT "%5.1" /end CHARACTERISTIC
/begin CHARACTERISTIC Strt_ctCaSEdgMin_C "Application parameter for the number of phase transmitter edges" VALUE 0x8053458C RB_Val_Wu16 65535.00 OneToOne 0.00 65535.00 FORMAT "%8.2" /end CHARACTERISTIC
/begin CHARACTERISTIC Strt_flgStrtRlyCntRst_C "Calibration to reset the starter relay count value" VALUE 0x8053458E RB_Val_Wu8 1.00000000000 B_TRUE 0.00 1.00000000000 FORMAT "%13.11" /end CHARACTERISTIC
/begin CHARACTERISTIC Strt_nLckJudg1_C "Threshold engine speed for starter lock judgment 1" VALUE 0x80534590 RB_Val_Ws16 32767.50 EngN -16384.00 16383.50 FORMAT "%8.2" /end CHARACTERISTIC
/begin CHARACTERISTIC Strt_nLckJudg2_C "Threshold engine speed for starter lock judgment 2" VALUE 0x80534592 RB_Val_Ws16 32767.50 EngN -16384.00 16383.50 FORMAT "%8.2" /end CHARACTERISTIC
/begin CHARACTERISTIC Strt_swtCntRst_C "Calibration for software switch reset counter" VALUE 0x80534594 RB_Val_Wu8 1.00000000000 B_TRUE 0.00 1.00000000000 FORMAT "%13.11" /end CHARACTERISTIC
/begin CHARACTERISTIC Strt_swtStaActv_C "Calibration to select the configuration of the starter activity detection" VALUE 0x80534595 RB_Val_Wu8 1.00000000000 B_TRUE 0.00 1.00000000000 FORMAT "%13.11" /end CHARACTERISTIC
/begin CHARACTERISTIC Strt_tiContnsRstrt_C "Threshold value for Short Interval counter less than 4min between 3rd and 4th successive crankings" VALUE 0x80534596 RB_Val_Ws16 655.3500 Time_s -327.6800 327.6700 FORMAT "%8.4" /end CHARACTERISTIC
/begin CHARACTERISTIC Strt_tiImobChk_C "Timer to check for the immobilizer lock status" VALUE 0x80534598 RB_Val_Ws16 6553500. Time_ms_100ms -3276800. 3276700. FORMAT "%8.0" /end CHARACTERISTIC
/begin CHARACTERISTIC Strt_tiLckJudg1_C "The time period after which the starter lock judgment based on camshaft edge count should be evaluated" VALUE 0x8053459A RB_Val_Ws16 6553500. Time_ms_100ms -3276800. 3276700. FORMAT "%8.0" /end CHARACTERISTIC
/begin CHARACTERISTIC Strt_tiLckJudg2_C "The time period after which the starter lock judgment based on engine speed should be evaluated" VALUE 0x8053459C RB_Val_Ws16 6553500. Time_ms_100ms -3276800. 3276700. FORMAT "%8.0" /end CHARACTERISTIC
/begin CHARACTERISTIC Strt_tiRstrtIntl_C "Threshold value for the Short Interval timer less than 30s after 10s cranking" VALUE 0x8053459E RB_Val_Ws16 655.3500 Time_s -327.6800 327.6700 FORMAT "%8.4" /end CHARACTERISTIC
/begin CHARACTERISTIC Strt_tiStrtActv_C "Threshold value for 10s cranking" VALUE 0x805345A0 RB_Val_Ws16 655.3500 Time_s -327.6800 327.6700 FORMAT "%8.4" /end CHARACTERISTIC
/begin CHARACTERISTIC Strt_tiStrtCtOffDiaDur_C "Application parameter for the duration of the diagnosis of the turn off paths" VALUE 0x805345A2 RB_Val_Ws16 327.6700 Time_s 0.00 327.6700 FORMAT "%8.4" EXTENDED_LIMITS -327.6800 327.6700 /end CHARACTERISTIC
/begin CHARACTERISTIC Strt_uDiaThresCtOffHi_C "High Threshold value for starter cutoff diagnosis" VALUE 0x805345A4 RB_Val_Wu16 13107.00 Volt 0.00 13107.00 FORMAT "%8.2" /end CHARACTERISTIC
/begin CHARACTERISTIC Strt_uDiaThresCtOffLo_C "Low Threshold value for starter cutoff diagnosis" VALUE 0x805345A6 RB_Val_Wu16 13107.00 Volt 0.00 13107.00 FORMAT "%8.2" /end CHARACTERISTIC
/begin CHARACTERISTIC Strt_uDiaThresStkHi_C "High threshold value for starter diagnosis" VALUE 0x805345A8 RB_Val_Wu16 13107.00 Volt 0.00 13107.00 FORMAT "%8.2" /end CHARACTERISTIC
/begin CHARACTERISTIC Strt_uDiaThresStkLo_C "Low threshold value for starter diagnosis" VALUE 0x805345AA RB_Val_Wu16 13107.00 Volt 0.00 13107.00 FORMAT "%8.2" /end CHARACTERISTIC
/begin CHARACTERISTIC Strt_uStmDiaMin_C "Voltage threshold to enable the diagnosis of the starter module" VALUE 0x80534588 RB_Val_Ws16 1310700. Volt_Batt -655360.0 655340.0 FORMAT "%8.1" /end CHARACTERISTIC
/begin CHARACTERISTIC Strt_uStrtDiaMin_C "Minimum battery voltage to check a correct start activity" VALUE 0x805345AC RB_Val_Ws16 655340.0 Volt_Batt 0.00 655340.0 FORMAT "%8.1" EXTENDED_LIMITS -655360.0 655340.0 /end CHARACTERISTIC
/begin CHARACTERISTIC StSpSwt_SwtDeb.tiHiLo_C "Switch debounce structure for StSpSwt / Time for a High to Low transition" VALUE 0x8053B628 Kw_Ws16 655350.0 TimeDeb -327680.0 327670.0 FORMAT "%8.1" /end CHARACTERISTIC
/begin CHARACTERISTIC StSpSwt_SwtDeb.tiLoHi_C "Switch debounce structure for StSpSwt / Time for a Low to High transition" VALUE 0x8053B62A Kw_Ws16 655350.0 TimeDeb -327680.0 327670.0 FORMAT "%8.1" /end CHARACTERISTIC
/begin CHARACTERISTIC StSpSwt_swtSelTyp_C "Switch to select between signal from CAN or DIO" VALUE 0x80534424 RB_Val_Wu8 3.000 OneToOne 0.00 3.000 FORMAT "%5.3" EXTENDED_LIMITS 0.00 255.0 /end CHARACTERISTIC
/begin CHARACTERISTIC SysDiag_SwtCModEnbl_C "Activation switch for Certification mode calculation" VALUE 0x805345AE RB_Val_Wu8 255.0 OneToOne 0.00 255.0 FORMAT "%5.1" /end CHARACTERISTIC
/begin CHARACTERISTIC SysDiag_tiCModEng_C "Time duration for Certification mode calculation" VALUE 0x805345B0 RB_Val_Wu16 655.3500 t_q0p01 0.00 655.3500 FORMAT "%8.4" /end CHARACTERISTIC
/begin CHARACTERISTIC THS2ME_stConf_CW "Codeword: Configuration of THS2ME" VALUE 0x805341A4 RB_Val_Wu8 255.0 dez 0.00 255.0 FORMAT "%5.1" /end CHARACTERISTIC
/begin CHARACTERISTIC tolc_msg_C "" VALUE 0x805341A5 RB_Val_Wu8 255.0 temp_ub_q1_o60 -60.0 195.0 FORMAT "%5.1" /end CHARACTERISTIC
/begin CHARACTERISTIC VehMot_tqCluDesGenericLimn_C "configuration for VehMot_tqCluDesGenericLimn" VALUE 0x805341A6 RB_Val_Ws16 6553.500 Trq -3276.800 3276.700 FORMAT "%8.3" /end CHARACTERISTIC
/begin CHARACTERISTIC VehMot_tqCluLeadGenericLimn_C "configuration for VehMot_tqCluLeadGenericLimn" VALUE 0x805341A8 RB_Val_Ws16 6553.500 Trq -3276.800 3276.700 FORMAT "%8.3" /end CHARACTERISTIC
/begin CHARACTERISTIC VF2ME_THRESBKOE_C "threshold value torque demand for air condition compressor" VALUE 0x805341AA RB_Val_Ws16 6553.500 Trq -3276.800 3276.700 FORMAT "%8.3" /end CHARACTERISTIC
/begin CHARACTERISTIC WaHt_flgHeatrRiseReq_C "" VALUE 0x805341AC RB_Val_Wu8 1.00000000000 B_TRUE 0.00 1.00000000000 FORMAT "%13.11" /end CHARACTERISTIC
/begin CHARACTERISTIC WaHt_tDeltaEngT_C "" VALUE 0x805341AE RB_Val_Ws16 6553.500 Temp_Cels -3549.940 3003.560 FORMAT "%8.3" /end CHARACTERISTIC
/begin CHARACTERISTIC WESBM "angle intake closes before software reference mark (tR)" VALUE 0x805341B0 RB_Val_Wu8 717.2 kw_q2p8125 0.00 717.2 FORMAT "%5.1" /end CHARACTERISTIC
/begin CHARACTERISTIC wgvohsme_w_msg_C "" VALUE 0x805341B2 RB_Val_Ws16 1023.984 kw_q0p0156 -512.0000 511.9844 FORMAT "%8.4" /end CHARACTERISTIC
/begin CHARACTERISTIC wgvshsme_w_msg_C "" VALUE 0x805341B4 RB_Val_Ws16 1023.984 kw_q0p0156 -512.0000 511.9844 FORMAT "%8.4" /end CHARACTERISTIC
/begin CHARACTERISTIC ZWAPPL "Application interface ignition angle adjustment" VALUE 0x805341B6 RB_Val_Ws8 191.3 kw_q0p75 -96.00 95.25 FORMAT "%5.2" /end CHARACTERISTIC
/begin MEASUREMENT ACCI_aReq "acceleration request from ACC" SWORD Acc 1 100 -32.76800 32.76700 FORMAT "%8.5" ECU_ADDRESS 0x600004A8 /end MEASUREMENT
/begin MEASUREMENT ACCI_bACCPrs "Adaptive Cruise Control present status" UBYTE B_TRUE 1 100 0.00 1.00000000000 BIT_MASK 0x1 FORMAT "%13.11" ECU_ADDRESS 0x70000AD5 /end MEASUREMENT
/begin MEASUREMENT AccPed_flgIDSFctAvl "Integrated Dynamic System functional is available" UBYTE B_TRUE 1 100 0.00 1.00000000000 BIT_MASK 0x1 FORMAT "%13.11" ECU_ADDRESS 0x70000AD1 /end MEASUREMENT
/begin MEASUREMENT ACCtl_stDecelACCutDmd "Deceleration AC CUT demand" UBYTE B_TRUE 1 100 0.00 1.00000000000 BIT_MASK 0x1 FORMAT "%13.11" ECU_ADDRESS 0x70000AD2 /end MEASUREMENT
/begin MEASUREMENT ACC_bExsMinDstBrkReq "Status indicating distance in minimum" UBYTE OneToOne 1 100 0.00 255.0 FORMAT "%5.1" ECU_ADDRESS 0x6000A6C3 /end MEASUREMENT
/begin MEASUREMENT ACC_bFail "ACC fail status" UBYTE OneToOne 1 100 0.00 255.0 FORMAT "%5.1" ECU_ADDRESS 0x6000A6C2 /end MEASUREMENT
/begin MEASUREMENT ACC_bFrtCar "Status indicating vehicle in front" UBYTE OneToOne 1 100 0.00 255.0 FORMAT "%5.1" ECU_ADDRESS 0x6000A6C1 /end MEASUREMENT
/begin MEASUREMENT ACC_bJmpDes "Status indicating jump to desired velocity" UBYTE OneToOne 1 100 0.00 255.0 FORMAT "%5.1" ECU_ADDRESS 0x6000A6C0 /end MEASUREMENT
/begin MEASUREMENT ACC_rTrqAccRed "Target acceleration reduction ratio" SWORD Prc_CrCtl2 1 100 -3276.800 3276.700 FORMAT "%8.3" ECU_ADDRESS 0x60005302 /end MEASUREMENT
/begin MEASUREMENT ACC_st "ACC status" UBYTE OneToOne 1 100 0.00 255.0 FORMAT "%5.1" ECU_ADDRESS 0x6000A6BF /end MEASUREMENT
/begin MEASUREMENT ACC_stACCDR1Req "ACC down request 1 received over CAN" UBYTE OneToOne 1 100 0.00 255.0 FORMAT "%5.1" ECU_ADDRESS 0x6000A105 /end MEASUREMENT
/begin MEASUREMENT ACC_stACCDR2Req "ACC down request 2 received over CAN" UBYTE OneToOne 1 100 0.00 255.0 FORMAT "%5.1" ECU_ADDRESS 0x6000A104 /end MEASUREMENT
/begin MEASUREMENT ACC_vDes "Desired velocity for ACC" SLONG Vel_CrCtl 1 100 -8388608.00000 8388607.99609 FORMAT "%13.5" ECU_ADDRESS 0x60001D70 /end MEASUREMENT
/begin MEASUREMENT AirC_bBackliteHeatgReq "Driver demand backlite heating" UBYTE B_TRUE 1 100 0.00 1.00000000000 BIT_MASK 0x1 FORMAT "%13.11" ECU_ADDRESS 0x70000ACE /end MEASUREMENT
/begin MEASUREMENT AirC_stSwtPrs "Air Condition present" UBYTE OneToOne 1 100 0.00 255.0 FORMAT "%5.1" ECU_ADDRESS 0x6000A6AD /end MEASUREMENT
/begin MEASUREMENT AirMod_ratChrgDeltaSwtAirSys "Delta Airmass after switch" SWORD rel_q0p0234 1 100 -768.0000 767.9766 FORMAT "%8.4" ECU_ADDRESS 0x6000527A /end MEASUREMENT
/begin MEASUREMENT AirSys_tFld "Temperature field, induction system" SWORD Temp_Cels 1 100 -3549.940 3003.560 FORMAT "%8.3" ARRAY_SIZE 1 ECU_ADDRESS 0x60003596 /end MEASUREMENT
/begin MEASUREMENT Air_tCACDs "Temperature down stream of charged air cooler" SWORD Temp_Cels 1 100 -3549.940 3003.560 FORMAT "%8.3" ECU_ADDRESS 0x6000E12A /end MEASUREMENT
/begin MEASUREMENT alchpct_msg "Alcohol Fuel Percentage for PID52" UBYTE rel_ub_b100 1 100 0.00 99.61 FORMAT "%5.2" ECU_ADDRESS 0x6000A2A6 /end MEASUREMENT
/begin MEASUREMENT AltIO_uMeasd "Measured alternator voltage" SWORD Volt_Batt 1 100 -655360.0 655340.0 FORMAT "%8.1" ECU_ADDRESS 0x60004B82 /end MEASUREMENT
/begin MEASUREMENT App_flgHiImpdChkEna "Enabling condition for high impedance check" UBYTE B_TRUE 1 100 0.00 1.00000000000 BIT_MASK 0x1 FORMAT "%13.11" ECU_ADDRESS 0x70000ACA /end MEASUREMENT
/begin MEASUREMENT App_flgSRCLo1HiImpdChk "Result of high impedance check for sensor 1" UBYTE B_TRUE 1 100 0.00 1.00000000000 BIT_MASK 0x1 FORMAT "%13.11" ECU_ADDRESS 0x70000AC9 /end MEASUREMENT
/begin MEASUREMENT App_flgSRCLo2HiImpdChk "Result of high impedance check for sensor 2" UBYTE B_TRUE 1 100 0.00 1.00000000000 BIT_MASK 0x1 FORMAT "%13.11" ECU_ADDRESS 0x70000AC8 /end MEASUREMENT
/begin MEASUREMENT ASDrf_trqInrSet "ASD reference filter torque output" SWORD md_q0p1 1 100 0.00 3276.700 FORMAT "%8.3" ECU_ADDRESS 0x600052A6 /end MEASUREMENT
/begin MEASUREMENT AuxHtg_bActv "Auxiliary vehicle heater active" UBYTE B_TRUE 1 100 0.00 1.00000000000 BIT_MASK 0x1 FORMAT "%13.11" ECU_ADDRESS 0x70000AC7 /end MEASUREMENT
/begin MEASUREMENT BattU_uFild "Battery voltage filtered" SWORD Volt_Batt 1 100 -655360.0 655340.0 FORMAT "%8.1" ECU_ADDRESS 0x60004B70 /end MEASUREMENT
/begin MEASUREMENT Blwr_flgActv "AC-blower active" UBYTE B_TRUE 1 100 0.00 1.00000000000 BIT_MASK 0x1 FORMAT "%13.11" ECU_ADDRESS 0x7000094A /end MEASUREMENT
/begin MEASUREMENT BrkBstP_pSens "Sensed Brake Boost Vacuum pressure from sensor" SWORD Pres_hPa 1 100 -32768.00 32767.00 FORMAT "%8.2" ECU_ADDRESS 0x6000525A /end MEASUREMENT
/begin MEASUREMENT BrkPed_pForISABIdleStop "Brake pressure required at wheel for a given inclination to avoid roll back" SWORD Pres 1 100 -3276.800 3276.700 FORMAT "%8.3" ECU_ADDRESS 0x6000524A /end MEASUREMENT
/begin MEASUREMENT BrkP_dpMstCyl "Master Cylinder Differential Pressure" SWORD PreshPa_10ms 1 100 -3276800. 3276700. FORMAT "%8.0" ECU_ADDRESS 0x60005256 /end MEASUREMENT
/begin MEASUREMENT BrkP_p "Brake Pressure" SLONG Pres_hPa 1 100 -2147483648.00 2147483647.00 FORMAT "%13.2" ECU_ADDRESS 0x60001D60 /end MEASUREMENT
/begin MEASUREMENT Brk_pMnCyl "Pressure of main cylinder of brake pedal" SWORD Pres_LoRes_COMPU 1 100 -327.6800 327.6700 FORMAT "%8.4" ECU_ADDRESS 0x60005246 /end MEASUREMENT
/begin MEASUREMENT Brk_r "Standardized angle of brake pedal" SWORD Prc 1 100 -400.0000 399.9878 FORMAT "%8.4" ECU_ADDRESS 0x60005244 /end MEASUREMENT
/begin MEASUREMENT Brk_stEBBBrkDetn "Status to indicate vehicle is equipped with EBB Brake system" UBYTE B_TRUE 1 100 0.00 1.00000000000 BIT_MASK 0x1 FORMAT "%13.11" ECU_ADDRESS 0x70000947 /end MEASUREMENT
/begin MEASUREMENT B_abor_msg "high amount of fuel in oil" UBYTE B_TRUE 1 100 0.00 1.00000000000 BIT_MASK 0x1 FORMAT "%13.11" ECU_ADDRESS 0x70000AC4 /end MEASUREMENT
/begin MEASUREMENT B_adrsta_msg "Condition reset adaptation values of STADAP by reset of DFPM" UBYTE B_TRUE 1 100 0.00 1.00000000000 BIT_MASK 0x1 FORMAT "%13.11" ECU_ADDRESS 0x6000A244 /end MEASUREMENT
/begin MEASUREMENT B_ate_msg "Condition: fault of exhaust gas temperature sensor in the system" UBYTE B_TRUE 1 100 0.00 1.00000000000 BIT_MASK 0x1 FORMAT "%13.11" ECU_ADDRESS 0x70000ABE /end MEASUREMENT
/begin MEASUREMENT B_bkvmsisr_msg "Condition massflow into manifold from brake booster" UBYTE B_TRUE 1 100 0.00 1.00000000000 BIT_MASK 0x1 FORMAT "%13.11" ECU_ADDRESS 0x70000AAB /end MEASUREMENT
/begin MEASUREMENT B_bkvnkhab_msg "cond.: idle speed for catalyst heating cut off, because not enough pressure for" UBYTE B_TRUE 1 100 0.00 1.00000000000 BIT_MASK 0x1 FORMAT "%13.11" ECU_ADDRESS 0x70000AAA /end MEASUREMENT
/begin MEASUREMENT B_bkvsta_msg "Condition: start engine because of brake booster control" UBYTE B_TRUE 1 100 0.00 1.00000000000 BIT_MASK 0x1 FORMAT "%13.11" ECU_ADDRESS 0x60000164 /end MEASUREMENT
/begin MEASUREMENT B_cdkvs_msg "function active per codeword CDKVS" UBYTE B_TRUE 1 100 0.00 1.00000000000 BIT_MASK 0x1 FORMAT "%13.11" ECU_ADDRESS 0x70000AA8 /end MEASUREMENT
/begin MEASUREMENT B_cdllrkh_msg "function idle speed diagnosis during catalyst heating active per codeword CDLLR" UBYTE B_TRUE 1 100 0.00 1.00000000000 BIT_MASK 0x1 FORMAT "%13.11" ECU_ADDRESS 0x70000AA6 /end MEASUREMENT
/begin MEASUREMENT B_cdllr_msg "function normal idle speed diagnosis active per codeword CDLLR" UBYTE B_TRUE 1 100 0.00 1.00000000000 BIT_MASK 0x1 FORMAT "%13.11" ECU_ADDRESS 0x70000AA7 /end MEASUREMENT
/begin MEASUREMENT B_cdmd "function active per codeword CDMD" UBYTE B_TRUE 1 100 0.00 1.00000000000 BIT_MASK 0x4 FORMAT "%13.11" ECU_ADDRESS 0x60006294 /end MEASUREMENT
/begin MEASUREMENT B_cdtes_msg "function active per codeword CDTES or CWDTES" UBYTE B_TRUE 1 100 0.00 1.00000000000 BIT_MASK 0x1 FORMAT "%13.11" ECU_ADDRESS 0x70000AA5 /end MEASUREMENT
/begin MEASUREMENT B_cvt_msg "Continuously variable transmission." UBYTE B_TRUE 1 100 0.00 1.00000000000 BIT_MASK 0x1 FORMAT "%13.11" ECU_ADDRESS 0x70000AA2 /end MEASUREMENT
/begin MEASUREMENT B_dcy "condition for 'driving cycle' fulfilled" UBYTE B_TRUE 1 100 0.00 1.00000000000 BIT_MASK 0x1 FORMAT "%13.11" ECU_ADDRESS 0x70000AA0 /end MEASUREMENT
/begin MEASUREMENT B_dfonrst_msg "Reset DMDFON via tester" UBYTE B_TRUE 1 100 0.00 1.00000000000 BIT_MASK 0x1 FORMAT "%13.11" ECU_ADDRESS 0x6000A243 /end MEASUREMENT
/begin MEASUREMENT B_dknotb "Condition: some throttle valve backup mode active" UBYTE B_TRUE 1 100 0.00 1.00000000000 BIT_MASK 0x1 FORMAT "%13.11" ECU_ADDRESS 0x70000A9D /end MEASUREMENT
/begin MEASUREMENT B_dksbeg "condition: limiting throttle-valve setpoint value" UBYTE B_TRUE 1 100 0.00 1.00000000000 BIT_MASK 0x1 FORMAT "%13.11" ECU_ADDRESS 0x70000A9C /end MEASUREMENT
/begin MEASUREMENT B_dteaam_msg "Condition diagnosis CPV by opening the CPV active possible" UBYTE B_TRUE 1 100 0.00 1.00000000000 BIT_MASK 0x1 FORMAT "%13.11" ECU_ADDRESS 0x70000A92 /end MEASUREMENT
/begin MEASUREMENT B_dtest_msg "condition for start of TEV opening" UBYTE B_TRUE 1 100 0.00 1.00000000000 BIT_MASK 0x1 FORMAT "%13.11" ECU_ADDRESS 0x70000A90 /end MEASUREMENT
/begin MEASUREMENT B_dtes_msg "Condition for active diagnosis of canister purge system" UBYTE B_TRUE 1 100 0.00 1.00000000000 BIT_MASK 0x1 FORMAT "%13.11" ECU_ADDRESS 0x70000A91 /end MEASUREMENT
/begin MEASUREMENT B_dtmbh_msg "Condition correction of temperature if blockheater detected" UBYTE B_TRUE 1 100 0.00 1.00000000000 BIT_MASK 0x1 FORMAT "%13.11" ECU_ADDRESS 0x70000A8F /end MEASUREMENT
/begin MEASUREMENT B_ebfmod_msg "Condition initial fuelling mode active" UBYTE B_TRUE 1 100 0.00 1.00000000000 BIT_MASK 0x1 FORMAT "%13.11" ECU_ADDRESS 0x6000A242 /end MEASUREMENT
/begin MEASUREMENT B_eepwf_msg "Condition Power fail Electrically Erasable Programmable Read only Memory" UBYTE B_TRUE 1 100 0.00 1.00000000000 BIT_MASK 0x1 FORMAT "%13.11" ECU_ADDRESS 0x70000A85 /end MEASUREMENT
/begin MEASUREMENT B_evasldel_msg "Condition no injection cutoff request active and all injections are ignited" UBYTE B_TRUE 1 100 0.00 1.00000000000 BIT_MASK 0x1 FORMAT "%13.11" ECU_ADDRESS 0x6000A23F /end MEASUREMENT
/begin MEASUREMENT B_faagr_msg "Condition function request EGR and diagnostic routine for short test" UBYTE B_TRUE 1 100 0.00 1.00000000000 BIT_MASK 0x1 FORMAT "%13.11" ECU_ADDRESS 0x70000A6B /end MEASUREMENT
/begin MEASUREMENT B_faam_msg "request of general torque margin quick trip" UBYTE B_TRUE 1 100 0.00 1.00000000000 BIT_MASK 0x1 FORMAT "%13.11" ECU_ADDRESS 0x70000A6A /end MEASUREMENT
/begin MEASUREMENT B_fabe_msg "condition function request end of line test" UBYTE B_TRUE 1 100 0.00 1.00000000000 BIT_MASK 0x1 FORMAT "%13.11" ECU_ADDRESS 0x6000A23D /end MEASUREMENT
/begin MEASUREMENT B_fafkmsla_msg "Condition: Requirement for the clearing of the slow filling adaption values" UBYTE B_TRUE 1 100 0.00 1.00000000000 BIT_MASK 0x1 FORMAT "%13.11" ECU_ADDRESS 0x70000A68 /end MEASUREMENT
/begin MEASUREMENT B_falshvs_msg "Condition Function demand oxygen sensor heating before start" UBYTE B_TRUE 1 100 0.00 1.00000000000 BIT_MASK 0x1 FORMAT "%13.11" ECU_ADDRESS 0x6000A23C /end MEASUREMENT
/begin MEASUREMENT B_falzsr_msg "Condition function request diagnosis leckage to manifold for short test" UBYTE B_TRUE 1 100 0.00 1.00000000000 BIT_MASK 0x1 FORMAT "%13.11" ECU_ADDRESS 0x70000A67 /end MEASUREMENT
/begin MEASUREMENT B_fa_msg "condition general function request" UBYTE B_TRUE 1 100 0.00 1.00000000000 BIT_MASK 0x1 FORMAT "%13.11" ECU_ADDRESS 0x6000A23E /end MEASUREMENT
/begin MEASUREMENT B_fpwdkap_msg "throttle-valve control by accelerator pedal" UBYTE B_TRUE 1 100 0.00 1.00000000000 BIT_MASK 0x1 FORMAT "%13.11" ECU_ADDRESS 0x70000A61 /end MEASUREMENT
/begin MEASUREMENT B_hsp "GDI mode homogeneous-split" UBYTE B_TRUE 1 100 0.00 1.00000000000 BIT_MASK 0x1 FORMAT "%13.11" ECU_ADDRESS 0x70000A33 /end MEASUREMENT
/begin MEASUREMENT B_invlvbcd_msg "Request Double Boostering due to Error High Pressure Pump delivers too much" UBYTE B_TRUE 1 100 0.00 1.00000000000 BIT_MASK 0x1 FORMAT "%13.11" ECU_ADDRESS 0x70000A2A /end MEASUREMENT
/begin MEASUREMENT B_khatrip_msg "request catalyst heating for end of line test" UBYTE B_TRUE 1 100 0.00 1.00000000000 BIT_MASK 0x1 FORMAT "%13.11" ECU_ADDRESS 0x70000A22 /end MEASUREMENT
/begin MEASUREMENT B_kl15 "condition ignition switch on" UBYTE B_TRUE 1 100 0.00 1.00000000000 BIT_MASK 0x1 FORMAT "%13.11" ECU_ADDRESS 0x6000A239 /end MEASUREMENT
/begin MEASUREMENT B_koe_msg "Condition for air conditioner compressor ON" UBYTE B_TRUE 1 100 0.00 1.00000000000 BIT_MASK 0x1 FORMAT "%13.11" ECU_ADDRESS 0x70000A1D /end MEASUREMENT
/begin MEASUREMENT B_kuppl_msg "Condition clutch pedal pressed" UBYTE B_TRUE 1 100 0.00 1.00000000000 BIT_MASK 0x1 FORMAT "%13.11" ECU_ADDRESS 0x70000A1A /end MEASUREMENT
/begin MEASUREMENT B_ldsua_msg "Condition boost control: overrun air circulation valve active (open)" UBYTE B_TRUE 1 100 0.00 1.00000000000 BIT_MASK 0x1 FORMAT "%13.11" ECU_ADDRESS 0x70000A0A /end MEASUREMENT
/begin MEASUREMENT B_ll "Idle speed from driver's sight" UBYTE B_TRUE 1 100 0.00 1.00000000000 BIT_MASK 0x1 FORMAT "%13.11" ECU_ADDRESS 0x70000A07 /end MEASUREMENT
/begin MEASUREMENT B_llrein "Idle speed ready to be put into operation after start" UBYTE B_TRUE 1 100 0.00 1.00000000000 BIT_MASK 0x1 FORMAT "%13.11" ECU_ADDRESS 0x6000A236 /end MEASUREMENT
/begin MEASUREMENT B_llri "Condition activation of I-part of idle speed control" UBYTE B_TRUE 1 100 0.00 1.00000000000 BIT_MASK 0x1 FORMAT "%13.11" ECU_ADDRESS 0x70000A03 /end MEASUREMENT
/begin MEASUREMENT B_mdmi "Condition misfire detection low load-threshold" UBYTE B_TRUE 1 100 0.00 1.00000000000 BIT_MASK 0x1 FORMAT "%13.11" ECU_ADDRESS 0x700009F1 /end MEASUREMENT
/begin MEASUREMENT B_mdstop "misfire detection stop" UBYTE B_TRUE 1 100 0.00 1.00000000000 BIT_MASK 0x1 FORMAT "%13.11" ECU_ADDRESS 0x700009F0 /end MEASUREMENT
/begin MEASUREMENT B_nachl "ECU control for ECU switch off delay" UBYTE B_TRUE 1 100 0.00 1.00000000000 BIT_MASK 0x1 FORMAT "%13.11" ECU_ADDRESS 0x700009E3 /end MEASUREMENT
/begin MEASUREMENT B_nachlauf_msg "ECU control for ECU switch off delay" UBYTE B_TRUE 1 100 0.00 1.00000000000 BIT_MASK 0x1 FORMAT "%13.11" ECU_ADDRESS 0x6000013D /end MEASUREMENT
/begin MEASUREMENT B_nachl_msg "ECU control for ECU switch off delay" UBYTE B_TRUE 1 100 0.00 1.00000000000 BIT_MASK 0x1 FORMAT "%13.11" ECU_ADDRESS 0x6000013E /end MEASUREMENT
/begin MEASUREMENT B_nmot "condition engine speed: n > NMIN" UBYTE B_TRUE 1 100 0.00 1.00000000000 BIT_MASK 0x1 FORMAT "%13.11" ECU_ADDRESS 0x700009E0 /end MEASUREMENT
/begin MEASUREMENT B_norm_msg "ECU-condition normal engine management operation" UBYTE B_TRUE 1 100 0.00 1.00000000000 BIT_MASK 0x1 FORMAT "%13.11" ECU_ADDRESS 0x6000013C /end MEASUREMENT
/begin MEASUREMENT B_nswo1_msg "condition for engine-speed threshold 1 for switching calculation" UBYTE B_TRUE 1 100 0.00 1.00000000000 BIT_MASK 0x1 FORMAT "%13.11" ECU_ADDRESS 0x700009D6 /end MEASUREMENT
/begin MEASUREMENT B_nswo2_msg "engine-speed threshold 2 switching calculation" UBYTE B_TRUE 1 100 0.00 1.00000000000 BIT_MASK 0x1 FORMAT "%13.11" ECU_ADDRESS 0x700009D5 /end MEASUREMENT
/begin MEASUREMENT B_reqddskv_msg "Condition request action of fuel mixture adaptation because of a suspicion high pressure sensor offset" UBYTE B_TRUE 1 100 0.00 1.00000000000 BIT_MASK 0x1 FORMAT "%13.11" ECU_ADDRESS 0x700009BF /end MEASUREMENT
/begin MEASUREMENT B_stend "condition end of start" UBYTE B_TRUE 1 100 0.00 1.00000000000 BIT_MASK 0x1 FORMAT "%13.11" ECU_ADDRESS 0x700009A2 /end MEASUREMENT
/begin MEASUREMENT B_stveset_msg "Condition for pre injection" UBYTE B_TRUE 1 100 0.00 1.00000000000 BIT_MASK 0x1 FORMAT "%13.11" ECU_ADDRESS 0x70000995 /end MEASUREMENT
/begin MEASUREMENT B_tal_msg "Reserve;Condition: tank empty or reserve" UBYTE B_TRUE 1 100 0.00 1.00000000000 BIT_MASK 0x1 FORMAT "%13.11" ECU_ADDRESS 0x70000993 /end MEASUREMENT
/begin MEASUREMENT B_teftstft_msg "condition for first-start function with application code word" UBYTE B_TRUE 1 100 0.00 1.00000000000 BIT_MASK 0x1 FORMAT "%13.11" ECU_ADDRESS 0x70000989 /end MEASUREMENT
/begin MEASUREMENT B_tippg_msg "Condition Gear lifter in position Tipp shift gutter" UBYTE B_TRUE 1 100 0.00 1.00000000000 BIT_MASK 0x1 FORMAT "%13.11" ECU_ADDRESS 0x70000981 /end MEASUREMENT
/begin MEASUREMENT B_tolcb_msg "cond. Error status of oil temperature and oil level from combi message or from COWIV" UBYTE B_TRUE 1 100 0.00 1.00000000000 BIT_MASK 0x1 FORMAT "%13.11" ECU_ADDRESS 0x7000097C /end MEASUREMENT
/begin MEASUREMENT B_urstsprr "Bit to lock primal fuelling" UBYTE B_TRUE 1 100 0.00 1.00000000000 BIT_MASK 0x1 FORMAT "%13.11" ECU_ADDRESS 0x70000968 /end MEASUREMENT
/begin MEASUREMENT B_vheg "Condition high valve lift active" UBYTE B_TRUE 1 100 0.00 1.00000000000 BIT_MASK 0x1 FORMAT "%13.11" ECU_ADDRESS 0x6000A22D /end MEASUREMENT
/begin MEASUREMENT B_vhegfe "condition: high valve lift for timing of air charge determination ( one calculation step before calculation of air charge for switched cylinder)" UBYTE B_TRUE 1 100 0.00 1.00000000000 BIT_MASK 0x1 FORMAT "%13.11" ECU_ADDRESS 0x70000965 /end MEASUREMENT
/begin MEASUREMENT B_vhegv "Condition actual combustion cylinder is filled with large intake valve lift" UBYTE B_TRUE 1 100 0.00 1.00000000000 BIT_MASK 0x1 FORMAT "%13.11" ECU_ADDRESS 0x70000961 /end MEASUREMENT
/begin MEASUREMENT B_vhegzw "Condition actual ignition cylinder is filled with large intake valve lift" UBYTE B_TRUE 1 100 0.00 1.00000000000 BIT_MASK 0x1 FORMAT "%13.11" ECU_ADDRESS 0x6000A22C /end MEASUREMENT
/begin MEASUREMENT B_wakeup_msg "ECU-condition wake up operation" UBYTE B_TRUE 1 100 0.00 1.00000000000 BIT_MASK 0x1 FORMAT "%13.11" ECU_ADDRESS 0x60000124 /end MEASUREMENT
/begin MEASUREMENT B_wdksap_msg "throttle blade control by fixed value, bit 1 has priority" UBYTE B_TRUE 1 100 0.00 1.00000000000 BIT_MASK 0x1 FORMAT "%13.11" ECU_ADDRESS 0x7000095A /end MEASUREMENT
/begin MEASUREMENT B_zwappl_msg "Condition ignition-timing application without torque intervention" UBYTE B_TRUE 1 100 0.00 1.00000000000 BIT_MASK 0x1 FORMAT "%13.11" ECU_ADDRESS 0x70000950 /end MEASUREMENT
/begin MEASUREMENT CAClg_ratCoolgMax "Charge air cooling ratio maximum" UWORD rel_uw_b100 1 100 0.00 99.99847 FORMAT "%8.5" ECU_ADDRESS 0x60004DAC /end MEASUREMENT
/begin MEASUREMENT CAClg_ratCoolgMedHi "Charge air cooling ratio medium high" UWORD rel_uw_b100 1 100 0.00 99.99847 FORMAT "%8.5" ECU_ADDRESS 0x60004DAA /end MEASUREMENT
/begin MEASUREMENT CAClg_ratCoolgMedLo "Charge air cooling ratio medium low" UWORD rel_uw_b100 1 100 0.00 99.99847 FORMAT "%8.5" ECU_ADDRESS 0x60004DA8 /end MEASUREMENT
/begin MEASUREMENT CAClg_ratCoolgMin "Charge air cooling ratio minimum" UWORD rel_uw_b100 1 100 0.00 99.99847 FORMAT "%8.5" ECU_ADDRESS 0x60004DA6 /end MEASUREMENT
/begin MEASUREMENT CACPmp_uPlausyHiThd "CAC pump battery high thershold message" SWORD Volt_Batt 1 100 -655360.0 655340.0 FORMAT "%8.1" ECU_ADDRESS 0x60005242 /end MEASUREMENT
/begin MEASUREMENT CACPmp_uPlausyLoThd "CAC pump battery Low thershold message" SWORD Volt_Batt 1 100 -655360.0 655340.0 FORMAT "%8.1" ECU_ADDRESS 0x60004B6C /end MEASUREMENT
/begin MEASUREMENT CB_flgFlsProgmEveSts "Flag for Reprogramming event detection" UBYTE OneToOne 1 100 0.00 255.0 FORMAT "%5.1" ECU_ADDRESS 0x6000A0FE /end MEASUREMENT
/begin MEASUREMENT CEngDsT_tStopStrtEndOff "engine coolant stop temperature at start end off time" SWORD Temp_Cels 1 100 -3549.940 3003.560 FORMAT "%8.3" ECU_ADDRESS 0x60004B58 /end MEASUREMENT
/begin MEASUREMENT CEngUsT_t_Adp "" SWORD Temp_Cels 1 100 -3549.940 3003.560 FORMAT "%8.3" ECU_ADDRESS 0x60005224 /end MEASUREMENT
/begin MEASUREMENT Clth_drFlt "Filtered Gradient of clutch pedal sensor" SWORD PrcHi_COMPU 1 100 -128.0000 127.9961 FORMAT "%8.4" ECU_ADDRESS 0x60005222 /end MEASUREMENT
/begin MEASUREMENT Clth_r "Clutch ratio" SWORD Prc_Fact256 1 100 -128.0000 127.9961 FORMAT "%8.4" ECU_ADDRESS 0x60005220 /end MEASUREMENT
/begin MEASUREMENT Clth_rKisspnt "Kiss point (Ratio of clutch at which the clutch torque is zero)" SWORD PrcHi_COMPU 1 100 -128.0000 127.9961 FORMAT "%8.4" ECU_ADDRESS 0x6000521E /end MEASUREMENT
/begin MEASUREMENT Clth_stClthExtd "Extended clutch pedal status" UBYTE OneToOne 1 100 0.00 255.0 FORMAT "%5.1" ECU_ADDRESS 0x6000A693 /end MEASUREMENT
/begin MEASUREMENT Clth_swtClthType "switch for clutch signal selection" UBYTE OneToOne 1 100 0.00 255.0 FORMAT "%5.1" ECU_ADDRESS 0x6000A68D /end MEASUREMENT
/begin MEASUREMENT CoDsplCtl_OutAddLamps "" UBYTE OneToOne 1 100 0.00 255.0 FORMAT "%5.1" ARRAY_SIZE 20 ECU_ADDRESS 0x60006295 /end MEASUREMENT
/begin MEASUREMENT CoDsplCtl_stLmp4Out "Lamp4 output status" UBYTE OneToOne 1 100 0.00 255.0 FORMAT "%5.1" ECU_ADDRESS 0x6000A68C /end MEASUREMENT
/begin MEASUREMENT CoDsplCtl_stLmp5Out "Lamp5 output status" UBYTE dez 1 100 0.00 255.0 FORMAT "%5.1" ECU_ADDRESS 0x6000A68B /end MEASUREMENT
/begin MEASUREMENT CoEng_bCtOffCon "release condition for Cut Off" UBYTE B_TRUE 1 100 0.00 1.00000000000 BIT_MASK 0x1 FORMAT "%13.11" ECU_ADDRESS 0x700008DC /end MEASUREMENT
/begin MEASUREMENT CoEng_bFrstStrtEnd "Condition end of first start" UBYTE B_TRUE 1 100 0.00 1.00000000000 BIT_MASK 0x1 FORMAT "%13.11" ECU_ADDRESS 0x700008DB /end MEASUREMENT
/begin MEASUREMENT CoEng_bHEM "Condition half engine mode (HEM) active" UBYTE B_TRUE 1 100 0.00 1.00000000000 BIT_MASK 0x1 FORMAT "%13.11" ECU_ADDRESS 0x700008DA /end MEASUREMENT
/begin MEASUREMENT CoEng_bStrtEndIA "condition end of start for ignition release" UBYTE B_TRUE 1 100 0.00 1.00000000000 BIT_MASK 0x1 FORMAT "%13.11" ECU_ADDRESS 0x6000075A /end MEASUREMENT
/begin MEASUREMENT CoEng_bStrtEndSpdGov "condition end of start for speed governor" UBYTE B_TRUE 1 100 0.00 1.00000000000 BIT_MASK 0x1 FORMAT "%13.11" ECU_ADDRESS 0x700008D4 /end MEASUREMENT
/begin MEASUREMENT CoEng_bStrtEndTrqStruct "Condition end of start for activation of Md-structure" UBYTE B_TRUE 1 100 0.00 1.00000000000 BIT_MASK 0x1 FORMAT "%13.11" ECU_ADDRESS 0x6000075C /end MEASUREMENT
/begin MEASUREMENT CoEng_tiNormalOBD "Engine running time - for OBD requirement" ULONG Time_sec_q1_COMPU 1 100 0.00 4294967295.00 FORMAT "%13.2" ECU_ADDRESS 0x6000D6CC /end MEASUREMENT
/begin MEASUREMENT CoEng_tiStrtDly "Delay time at startup" SWORD Time_ms 1 100 -327680.0 327670.0 FORMAT "%8.1" ECU_ADDRESS 0x60005210 /end MEASUREMENT
/begin MEASUREMENT CoEOM_flgCvlcIgnRels "Ignition angle release due to valve lift switch" UBYTE B_TRUE 1 100 0.00 1.00000000000 BIT_MASK 0x1 FORMAT "%13.11" ECU_ADDRESS 0x60000756 /end MEASUREMENT
/begin MEASUREMENT CoETS_trqInrDetMode "coordinated torque demand for determination of operating mode" SWORD Trq 1 100 -3276.800 3276.700 FORMAT "%8.3" ECU_ADDRESS 0x6000E142 /end MEASUREMENT
/begin MEASUREMENT CoETS_trqInrDetModeFild "coordinated filtered torque demand for determination of operating mode" SWORD md_q0p1 1 100 -3276.800 3276.700 FORMAT "%8.3" ECU_ADDRESS 0x6000E144 /end MEASUREMENT
/begin MEASUREMENT CoETS_trqInrLead "desired lead (inner) torque (without Filter/ with reserve)" SWORD Trq 1 100 -3276.800 3276.700 FORMAT "%8.3" ECU_ADDRESS 0x60005218 /end MEASUREMENT
/begin MEASUREMENT ComDCDC_stCSTHist "CST History from DCDC" UBYTE OneToOne 1 100 0.00 255.0 FORMAT "%5.1" ECU_ADDRESS 0x6000A0ED /end MEASUREMENT
/begin MEASUREMENT ComDCDC_stDiagCirc1 "Status of DC-DC converter circuit 1" UBYTE OneToOne 1 100 0.00 255.0 FORMAT "%5.1" ECU_ADDRESS 0x6000A654 /end MEASUREMENT
/begin MEASUREMENT ComDCDC_stDiagCirc2 "Status of DC-DC converter circuit 2" UBYTE OneToOne 1 100 0.00 255.0 FORMAT "%5.1" ECU_ADDRESS 0x6000A653 /end MEASUREMENT
/begin MEASUREMENT ComDCDC_stRxErr "DCDC reception error flag (ID 0x10 Byte1 bit 3)" UBYTE OneToOne 1 100 0.00 255.0 FORMAT "%5.1" ECU_ADDRESS 0x6000A652 /end MEASUREMENT
/begin MEASUREMENT ComEBS_rBattSensCh "Status Of Charge from LIN" SWORD Prc 1 100 -400.0000 399.9878 FORMAT "%8.4" ECU_ADDRESS 0x600051C2 /end MEASUREMENT
/begin MEASUREMENT ComEBS_stBattSizeDetc "Battery size detection" UBYTE OneToOne 1 100 0.00 255.0 FORMAT "%5.1" ECU_ADDRESS 0x6000A64A /end MEASUREMENT
/begin MEASUREMENT ComEBS_uBattSens "14 bits Battery Voltage Received from EBS on LIN" SLONG spg_q0p001_V 1 100 -2147483.64800 2147483.64700 FORMAT "%13.5" ECU_ADDRESS 0x60001D34 /end MEASUREMENT
/begin MEASUREMENT Com_dACCCmdVehSpdDispd "ACC Command Vehicle Speed Displayed" UBYTE OneToOne 1 100 0.00 255.0 FORMAT "%5.1" ECU_ADDRESS 0x6000A5F5 /end MEASUREMENT
/begin MEASUREMENT Com_flgACCNorm "ACC Frame communication normal flag. (FId_ComACC is not inhibited)" UBYTE B_TRUE 1 100 0.00 1.00000000000 BIT_MASK 0x1 FORMAT "%13.11" ECU_ADDRESS 0x6000A1BC /end MEASUREMENT
/begin MEASUREMENT Com_flgEAT9Norm "EAT9 Frame communication normal flag. (FId_ComEAT9 is not inhibited)" UBYTE B_TRUE 1 100 0.00 1.00000000000 BIT_MASK 0x1 FORMAT "%13.11" ECU_ADDRESS 0x6000A1B9 /end MEASUREMENT
/begin MEASUREMENT Com_flgLETAcTqResvReplcmt "switch mode for Tester command request" UBYTE B_TRUE 1 100 0.00 1.00000000000 BIT_MASK 0x1 FORMAT "%13.11" ECU_ADDRESS 0x700008C3 /end MEASUREMENT
/begin MEASUREMENT Com_flgLETNoInjCntrCdn "switch for injection counter" UBYTE B_TRUE 1 100 0.00 1.00000000000 BIT_MASK 0x1 FORMAT "%13.11" ECU_ADDRESS 0x60009FBE /end MEASUREMENT
/begin MEASUREMENT Com_flgLETORATmrThd "switch for threshold time" UBYTE B_TRUE 1 100 0.00 1.00000000000 BIT_MASK 0x1 FORMAT "%13.11" ECU_ADDRESS 0x60009FBD /end MEASUREMENT
/begin MEASUREMENT Com_flgManCrkPTCANEna "Manual cranking based on PT-CAN" UBYTE OneToOne 1 100 0.00 255.0 FORMAT "%5.1" ECU_ADDRESS 0x6000A5E4 /end MEASUREMENT
/begin MEASUREMENT Com_flgUpshiftMod "Flag to indicate whether upshifting mode is in progress or not" UBYTE OneToOne 1 100 0.00 1.000 FORMAT "%5.3" ECU_ADDRESS 0x6000A0C0 /end MEASUREMENT
/begin MEASUREMENT Com_lTotOdo "Odometer received over CAN mesage" ULONG RBPtCel_dst_0p1_2 1 100 0.00 429496729.500 FORMAT "%13.3" ECU_ADDRESS 0x50004BF8 /end MEASUREMENT
/begin MEASUREMENT Com_nrIdAlt "Alternator ID" UBYTE OneToOne 1 100 0.00 255.0 FORMAT "%5.1" ECU_ADDRESS 0x6000A0BC /end MEASUREMENT
/begin MEASUREMENT Com_nrIdChp "Alternator chip ID" UBYTE OneToOne 1 100 0.00 255.0 FORMAT "%5.1" ECU_ADDRESS 0x6000A0BB /end MEASUREMENT
/begin MEASUREMENT Com_nrIdMnfc "Alternator manifactuerer ID" UBYTE OneToOne 1 100 0.00 255.0 FORMAT "%5.1" ECU_ADDRESS 0x6000A0BA /end MEASUREMENT
/begin MEASUREMENT Com_numGearTrgt "Selected gear information raw value from Gearbox ECU" UBYTE OneToOne 1 100 0.00 255.0 FORMAT "%5.1" ECU_ADDRESS 0x6000A59A /end MEASUREMENT
/begin MEASUREMENT Com_pEVPMnfldP "Brake relative negative pressure for EVP" SWORD Pres_mmhg_q2p685 1 100 -87982.08 87979.40 FORMAT "%8.2" ECU_ADDRESS 0x60004B36 /end MEASUREMENT
/begin MEASUREMENT Com_rAltLoad "Alternator load percentage" SWORD Prc 1 100 -400.0000 399.9878 FORMAT "%8.4" ECU_ADDRESS 0x60004B34 /end MEASUREMENT
/begin MEASUREMENT Com_rClthPos "Clutch Position" SWORD Prc 1 100 -400.0000 399.9878 FORMAT "%8.4" ECU_ADDRESS 0x60005194 /end MEASUREMENT
/begin MEASUREMENT Com_rClthStk "Quality Of Clutch Stroke" UBYTE Prc_EGR 1 100 0.00 100.0 FORMAT "%5.1" ECU_ADDRESS 0x6000A598 /end MEASUREMENT
/begin MEASUREMENT Com_stACCAMon "Monitoring status of ACCA Erro Condition" UBYTE OneToOne 1 100 0.00 255.0 FORMAT "%5.1" ECU_ADDRESS 0x6000A590 /end MEASUREMENT
/begin MEASUREMENT Com_stACCBMon "Monitoring status of ACCB Error Condition" UBYTE OneToOne 1 100 0.00 255.0 FORMAT "%5.1" ECU_ADDRESS 0x6000A58E /end MEASUREMENT
/begin MEASUREMENT Com_stACCIgrBrk "The throttle demand in a brake" UBYTE OneToOne 1 100 0.00 255.0 FORMAT "%5.1" ECU_ADDRESS 0x6000A58C /end MEASUREMENT
/begin MEASUREMENT Com_stACCSpdUnit "Unit of speed of car for customizing" UBYTE OneToOne 1 100 0.00 255.0 FORMAT "%5.1" ECU_ADDRESS 0x6000A58B /end MEASUREMENT
/begin MEASUREMENT Com_stACCTrsmGearChgReq "ACC Transmission Gear Change Request" UBYTE OneToOne 1 100 0.00 255.0 FORMAT "%5.1" ECU_ADDRESS 0x6000A58A /end MEASUREMENT
/begin MEASUREMENT Com_stActHSA "VSA HSA activation status" UBYTE OneToOne 1 100 0.00 255.0 FORMAT "%5.1" ECU_ADDRESS 0x6000A574 /end MEASUREMENT
/begin MEASUREMENT Com_stADSSpdLim "ADS Speed Limit Request" UBYTE OneToOne 1 100 0.00 255.0 FORMAT "%5.1" ECU_ADDRESS 0x6000A585 /end MEASUREMENT
/begin MEASUREMENT Com_stASROff "TC/ASR Control Status" UBYTE OneToOne 1 100 0.00 255.0 FORMAT "%5.1" ECU_ADDRESS 0x6000A583 /end MEASUREMENT
/begin MEASUREMENT Com_stATEnaCond "AT enable condition recieved over CAN" UBYTE OneToOne 1 100 0.00 255.0 FORMAT "%5.1" ECU_ADDRESS 0x6000A582 /end MEASUREMENT
/begin MEASUREMENT Com_stATErr4 "Status of AT failure in case of vehicle speed sensor defect" UBYTE OneToOne 1 100 0.00 255.0 FORMAT "%5.1" ECU_ADDRESS 0x6000A581 /end MEASUREMENT
/begin MEASUREMENT Com_stATISS "The status of AT ISS system condition" UBYTE OneToOne 1 100 0.00 255.0 FORMAT "%5.1" ECU_ADDRESS 0x6000A0A7 /end MEASUREMENT
/begin MEASUREMENT Com_stATPrkgProc "parking process status" UBYTE OneToOne 1 100 0.00 255.0 FORMAT "%5.1" ECU_ADDRESS 0x6000A0A6 /end MEASUREMENT
/begin MEASUREMENT Com_stATShftUpDwnReq "AT Shift Indicator Lamp status" UBYTE OneToOne 1 100 0.00 255.0 FORMAT "%5.1" ECU_ADDRESS 0x6000A57E /end MEASUREMENT
/begin MEASUREMENT Com_stAYC "AYC mode status" UBYTE OneToOne 1 100 0.00 255.0 FORMAT "%5.1" ECU_ADDRESS 0x6000A57D /end MEASUREMENT
/begin MEASUREMENT Com_stBCDGearEngmt "BCD Gear engagement" UBYTE OneToOne 1 100 0.00 255.0 FORMAT "%5.1" ECU_ADDRESS 0x6000A56C /end MEASUREMENT
/begin MEASUREMENT Com_stBrk "Status of Brk/FDR" UBYTE OneToOne 1 100 0.00 255.0 FORMAT "%5.1" ECU_ADDRESS 0x6000A568 /end MEASUREMENT
/begin MEASUREMENT Com_stBrkHldSys "Brake Hold System Active status" UBYTE OneToOne 1 100 0.00 255.0 FORMAT "%5.1" ECU_ADDRESS 0x6000A0A3 /end MEASUREMENT
/begin MEASUREMENT Com_stCamHealDisp "Displaying of camera dirty" UBYTE OneToOne 1 100 0.00 255.0 FORMAT "%5.1" ECU_ADDRESS 0x6000A55C /end MEASUREMENT
/begin MEASUREMENT Com_stClth "Clutch Status" UBYTE OneToOne 1 100 0.00 255.0 FORMAT "%5.1" ECU_ADDRESS 0x6000A0A0 /end MEASUREMENT
/begin MEASUREMENT Com_stClthPedlFailDet "Clutch Pedal Fault Detection inofrmation" UBYTE OneToOne 1 100 0.00 255.0 FORMAT "%5.1" ECU_ADDRESS 0x6000A551 /end MEASUREMENT
/begin MEASUREMENT Com_stClthStkFailInfo "Failure Information of Clutch Stroke Sensor" UBYTE OneToOne 1 100 0.00 255.0 FORMAT "%5.1" ECU_ADDRESS 0x6000A09F /end MEASUREMENT
/begin MEASUREMENT Com_stDispDmdEnvCdn "Request to display additional sign post information which is recognized. (R side)" UBYTE OneToOne 1 100 0.00 255.0 FORMAT "%5.1" ECU_ADDRESS 0x6000A548 /end MEASUREMENT
/begin MEASUREMENT Com_stDispDmdSignRi "Display demand of sign in knowledge(R side)" UBYTE OneToOne 1 100 0.00 255.0 FORMAT "%5.1" ECU_ADDRESS 0x6000A547 /end MEASUREMENT
/begin MEASUREMENT Com_stDrvModSwt "Status of Drive Mode Switch" UBYTE OneToOne 1 100 0.00 255.0 FORMAT "%5.1" ECU_ADDRESS 0x6000A09C /end MEASUREMENT
/begin MEASUREMENT Com_stEAT3Mon "Status for EAT3 error monitoring" UBYTE OneToOne 1 100 0.00 255.0 FORMAT "%5.1" ECU_ADDRESS 0x6000A540 /end MEASUREMENT
/begin MEASUREMENT Com_stEmgcyStrtReqOutSel "Emergency Engine Start Request" UBYTE OneToOne 1 100 0.00 255.0 FORMAT "%5.1" ECU_ADDRESS 0x6000A529 /end MEASUREMENT
/begin MEASUREMENT Com_stEngInhibReq "Request status Message for Inhibition" UBYTE OneToOne 1 100 0.00 255.0 FORMAT "%5.1" ECU_ADDRESS 0x6000A092 /end MEASUREMENT
/begin MEASUREMENT Com_stEngMapReq "Sport mode information for throttle progression request" UBYTE OneToOne 1 100 0.00 255.0 FORMAT "%5.1" ECU_ADDRESS 0x6000A522 /end MEASUREMENT
/begin MEASUREMENT Com_stEPBAppld "EPB operation" UBYTE OneToOne 1 100 0.00 255.0 FORMAT "%5.1" ECU_ADDRESS 0x6000A097 /end MEASUREMENT
/begin MEASUREMENT Com_stEPBFailrInfo "EPB Failure Information" UBYTE OneToOne 1 100 0.00 255.0 FORMAT "%5.1" ECU_ADDRESS 0x6000A096 /end MEASUREMENT
/begin MEASUREMENT Com_stEPBInhbAct "EPB Inhibit condition" UBYTE OneToOne 1 100 0.00 255.0 FORMAT "%5.1" ECU_ADDRESS 0x6000A095 /end MEASUREMENT
/begin MEASUREMENT Com_stEPBPlaSftyMod "EPB safety mode" UBYTE OneToOne 1 100 0.00 255.0 FORMAT "%5.1" ECU_ADDRESS 0x6000A094 /end MEASUREMENT
/begin MEASUREMENT Com_stEPBStInfo "EPB State Information" UBYTE OneToOne 1 100 0.00 255.0 FORMAT "%5.1" ECU_ADDRESS 0x6000A093 /end MEASUREMENT
/begin MEASUREMENT Com_stEVPIdleStopFail "Status for Idle Stop Failure for EVP" UBYTE OneToOne 1 100 0.00 255.0 FORMAT "%5.1" ECU_ADDRESS 0x6000A52B /end MEASUREMENT
/begin MEASUREMENT Com_stEVPIdleStopReq "Status for Idle Stop enable disable Permission in EVP" UBYTE OneToOne 1 100 0.00 255.0 FORMAT "%5.1" ECU_ADDRESS 0x6000A52A /end MEASUREMENT
/begin MEASUREMENT Com_stGbxNPos "Gearbox Neutral Position" UBYTE OneToOne 1 100 0.00 255.0 FORMAT "%5.1" ECU_ADDRESS 0x6000A504 /end MEASUREMENT
/begin MEASUREMENT Com_stGrip "Status Grip Powertrain" UBYTE dez 1 100 0.00 255.0 FORMAT "%5.1" ECU_ADDRESS 0x6000A500 /end MEASUREMENT
/begin MEASUREMENT Com_stHydPCtrlOper "EPB brake status information" UBYTE OneToOne 1 100 0.00 255.0 FORMAT "%5.1" ECU_ADDRESS 0x6000A4FE /end MEASUREMENT
/begin MEASUREMENT Com_stIngearEngmt "Ingear engagement status" UBYTE OneToOne 1 100 0.00 255.0 FORMAT "%5.1" ECU_ADDRESS 0x6000A4E9 /end MEASUREMENT
/begin MEASUREMENT Com_stInShiftNeut "Actual transmission position for N-range" UBYTE B_TRUE 1 100 0.00 1.00000000000 BIT_MASK 0x1 FORMAT "%13.11" ECU_ADDRESS 0x700008C2 /end MEASUREMENT
/begin MEASUREMENT Com_stInShiftPrkg "Actual transmission position for P-range" UBYTE B_TRUE 1 100 0.00 1.00000000000 BIT_MASK 0x1 FORMAT "%13.11" ECU_ADDRESS 0x700008C1 /end MEASUREMENT
/begin MEASUREMENT Com_stISEBBFail "EBB failure information from VSA" UBYTE OneToOne 1 100 0.00 255.0 FORMAT "%5.1" ECU_ADDRESS 0x6000A4ED /end MEASUREMENT
/begin MEASUREMENT Com_stLSFStrtValDmd "Low Speed Follow - Start Value Demand" UBYTE OneToOne 1 100 0.00 255.0 FORMAT "%5.1" ECU_ADDRESS 0x6000A4E6 /end MEASUREMENT
/begin MEASUREMENT Com_stMisfDetLineEnd "-" UBYTE B_TRUE 1 100 0.00 1.00000000000 BIT_MASK 0x1 FORMAT "%13.11" ECU_ADDRESS 0x700008C0 /end MEASUREMENT
/begin MEASUREMENT Com_stMonMET "Error State in MET used for monitoring" UBYTE OneToOne 1 100 0.00 255.0 FORMAT "%5.1" ECU_ADDRESS 0x6000A4D6 /end MEASUREMENT
/begin MEASUREMENT Com_stPPos "status of gear park" UBYTE B_TRUE 1 100 0.00 1.00000000000 BIT_MASK 0x1 FORMAT "%13.11" ECU_ADDRESS 0x700008BF /end MEASUREMENT
/begin MEASUREMENT Com_stRxEPB "EPB frame reception status" UBYTE OneToOne 1 100 0.00 255.0 FORMAT "%5.1" ECU_ADDRESS 0x6000A4AE /end MEASUREMENT
/begin MEASUREMENT Com_stRxEPBBDeb "Debounced Status of EPBB Frame Reception" UWORD OneToOne 1 100 0.00 65535.00 FORMAT "%8.2" ECU_ADDRESS 0x6000491A /end MEASUREMENT
/begin MEASUREMENT Com_stRxEPBBOk "Error Staus of EPBB Frame Reception" UBYTE OneToOne 1 100 0.00 255.0 FORMAT "%5.1" ECU_ADDRESS 0x6000A089 /end MEASUREMENT
/begin MEASUREMENT Com_stSptSwtDeb "Status of sport mode switch" UBYTE OneToOne 1 100 0.00 255.0 FORMAT "%5.1" ECU_ADDRESS 0x6000A088 /end MEASUREMENT
/begin MEASUREMENT Com_stStrtReqOutSel "Normal Engine Start Request" UBYTE OneToOne 1 100 0.00 255.0 FORMAT "%5.1" ECU_ADDRESS 0x6000A491 /end MEASUREMENT
/begin MEASUREMENT Com_stStSpEngStop "engine stop status in case of idle start stop" UBYTE OneToOne 1 100 0.00 255.0 FORMAT "%5.1" ECU_ADDRESS 0x6000A493 /end MEASUREMENT
/begin MEASUREMENT Com_stT50 "Status T50" UBYTE OneToOne 1 100 0.00 255.0 FORMAT "%5.1" ECU_ADDRESS 0x6000A48D /end MEASUREMENT
/begin MEASUREMENT Com_stTCamAbnormDisp "Displaying of camera temperature abnormality" UBYTE OneToOne 1 100 0.00 255.0 FORMAT "%5.1" ECU_ADDRESS 0x6000A48B /end MEASUREMENT
/begin MEASUREMENT Com_stTSRClrReas "Clear Reason for TSR(Camera unit)" UBYTE OneToOne 1 100 0.00 255.0 FORMAT "%5.1" ECU_ADDRESS 0x6000A489 /end MEASUREMENT
/begin MEASUREMENT Com_stWipr "Wiper status" UBYTE OneToOne 1 100 0.00 255.0 FORMAT "%5.1" ECU_ADDRESS 0x6000A45F /end MEASUREMENT
/begin MEASUREMENT Com_trqDesENGT1 "Torque Demand by driver" SLONG TrqCom 1 100 -13107.2000000 13107.0000000 FORMAT "%13.7" ECU_ADDRESS 0x60001D24 /end MEASUREMENT
/begin MEASUREMENT Com_trqDesENGT2 "Torque Data By Driver Request" SLONG RBPtCel_tq_1p0_1 1 100 -65536.0000000 65535.0000000 FORMAT "%13.7" ECU_ADDRESS 0x60001D20 /end MEASUREMENT
/begin MEASUREMENT Com_trqEngENG16 "Engine Torque Data for ENG16 frame" SWORD TrqCom 1 100 -6553.600 6553.400 FORMAT "%8.3" ECU_ADDRESS 0x600004FA /end MEASUREMENT
/begin MEASUREMENT Com_trqEngEstimd "Estimated engine Torque" SWORD TrqCom 1 100 -6553.600 6553.400 FORMAT "%8.3" ECU_ADDRESS 0x60005160 /end MEASUREMENT
/begin MEASUREMENT Conv_trqOilCoolrPmp "Compensation torque from converter oil cooler pump" SWORD Trq 1 100 -3276.800 3276.700 FORMAT "%8.3" ECU_ADDRESS 0x60005146 /end MEASUREMENT
/begin MEASUREMENT Conv_trqOilCoolrPmpRepl "Replacement value for compensation torque from converter oil cooler pump" SWORD Trq 1 100 -3276.800 3276.700 FORMAT "%8.3" ECU_ADDRESS 0x60005144 /end MEASUREMENT
/begin MEASUREMENT CoPOM_facTrqDynDist "factor for torque distribution of low idle controler" SWORD Fact 1 100 -4.000000 3.999878 FORMAT "%8.6" ECU_ADDRESS 0x600051FE /end MEASUREMENT
/begin MEASUREMENT CoPOM_numStrt "Start number (Request to start) from OpMode module" UBYTE OneToOne 1 100 0.00 255.0 FORMAT "%5.1" ECU_ADDRESS 0x6000A671 /end MEASUREMENT
/begin MEASUREMENT CoPOM_stM "Operating mode of hybrid system" UBYTE OneToOne 1 100 0.00 255.0 FORMAT "%5.1" ECU_ADDRESS 0x6000A66E /end MEASUREMENT
/begin MEASUREMENT CoPOM_stMnSt "Operation mode of hybrid system (binary representation)" UBYTE OneToOne 1 100 0.00 255.0 FORMAT "%5.1" ECU_ADDRESS 0x6000A66D /end MEASUREMENT
/begin MEASUREMENT CoPOM_tqDesEmQsty "Desired torque of the electric motor considering interventions from engine coordinator." SWORD Trq 1 100 -3276.800 3276.700 FORMAT "%8.3" ECU_ADDRESS 0x600051FC /end MEASUREMENT
/begin MEASUREMENT CoPOM_tqEmDynMin "Minimum dynamic torque of the electric motor for the usage in torque structure." SWORD Trq 1 100 -3276.800 3276.700 FORMAT "%8.3" ECU_ADDRESS 0x600051FA /end MEASUREMENT
/begin MEASUREMENT CoPT_bTraShftActvDes "Actual torque co-ordination on Des path through transmission shifting active" UBYTE B_TRUE 1 100 0.00 1.00000000000 BIT_MASK 0x1 FORMAT "%13.11" ECU_ADDRESS 0x700008CE /end MEASUREMENT
/begin MEASUREMENT CoPT_trqClthWoIntv "Set point torque without interventions" SWORD Trq 1 100 -3276.800 3276.700 FORMAT "%8.3" ECU_ADDRESS 0x600051F0 /end MEASUREMENT
/begin MEASUREMENT CoPT_trqDesCompEng "Application parameter for Engine torque desired for compensation" SWORD Trq 1 100 -3276.800 3276.700 FORMAT "%8.3" ECU_ADDRESS 0x6000E17E /end MEASUREMENT
/begin MEASUREMENT CoPT_trqResvEng "Combustion engine torque reserve" SWORD Trq 1 100 -3276.800 3276.700 FORMAT "%8.3" ECU_ADDRESS 0x6000E180 /end MEASUREMENT
/begin MEASUREMENT CoVeh_flgPtcShtOff "flag PTC de-activation request" UBYTE B_TRUE 1 100 0.00 1.00000000000 BIT_MASK 0x1 FORMAT "%13.11" ECU_ADDRESS 0x700008C4 /end MEASUREMENT
/begin MEASUREMENT CoVeh_tqDrvOff2MaxAC "Maximum AC torque in drive off condition" SWORD Trq 1 100 -3276.800 3276.700 FORMAT "%8.3" ECU_ADDRESS 0x600051D6 /end MEASUREMENT
/begin MEASUREMENT CoVeh_tqIdleMaxAC "Maximum AC torque in idle condition" SWORD Trq 1 100 -3276.800 3276.700 FORMAT "%8.3" ECU_ADDRESS 0x600051D4 /end MEASUREMENT
/begin MEASUREMENT CoVeh_trqDesComp "compensation torque by active low idle governor (signal 3)" SWORD Trq 1 100 -3276.800 3276.700 FORMAT "%8.3" ECU_ADDRESS 0x6000E184 /end MEASUREMENT
/begin MEASUREMENT CoVMD_flgIdleDrv "Condition idling active" UBYTE B_TRUE 1 100 0.00 1.00000000000 BIT_MASK 0x1 FORMAT "%13.11" ECU_ADDRESS 0x700008CD /end MEASUREMENT
/begin MEASUREMENT CoVM_bSIActvLead "Actual torque coordination VSC-sided on lead path active" UBYTE B_TRUE 1 100 0.00 1.00000000000 BIT_MASK 0x1 FORMAT "%13.11" ECU_ADDRESS 0x700008CC /end MEASUREMENT
/begin MEASUREMENT CoVM_trqLead "Propulsion torque after coordination with ESP interventions(wheel torque)" SLONG TrqPrpHigh 1 100 -214748364.800 214748364.700 FORMAT "%13.3" ECU_ADDRESS 0x60001D3C /end MEASUREMENT
/begin MEASUREMENT CoVOM_stAutoRstrtReq "status of Automatic restart request" UBYTE B_TRUE 1 100 0.00 1.00000000000 BIT_MASK 0x1 FORMAT "%13.11" ECU_ADDRESS 0x6000A1D4 /end MEASUREMENT
/begin MEASUREMENT CoVOM_stAutoRstrtReqGr1 "Automatic engine restart request group 1 condition" UBYTE B_TRUE 1 100 0.00 1.00000000000 BIT_MASK 0x1 FORMAT "%13.11" ECU_ADDRESS 0x6000A1D3 /end MEASUREMENT
/begin MEASUREMENT CoVOM_stAutoRstrtReqGr2 "Automatic engine restart request group 2 condition" UBYTE B_TRUE 1 100 0.00 1.00000000000 BIT_MASK 0x1 FORMAT "%13.11" ECU_ADDRESS 0x6000A1D2 /end MEASUREMENT
/begin MEASUREMENT CoVOM_stRstrtNoPtd "Variant Device driver for digital input" UBYTE B_TRUE 1 100 0.00 1.00000000000 BIT_MASK 0x1 FORMAT "%13.11" ECU_ADDRESS 0x700008C5 /end MEASUREMENT
/begin MEASUREMENT CoVOM_stStopRelsMask "Stop release mask status in operation state" ULONG OneToOne 1 100 0.00 4294967295.00 FORMAT "%13.2" ECU_ADDRESS 0x60001C80 /end MEASUREMENT
/begin MEASUREMENT CoVOM_stStopReqMask "Stop request mask status in opertation state" ULONG OneToOne 1 100 0.00 4294967295.00 FORMAT "%13.2" ECU_ADDRESS 0x60001C78 /end MEASUREMENT
/begin MEASUREMENT CoVOM_stStrtReqMask "Status of the start request mask" ULONG OneToOne 1 100 0.00 4294967295.00 FORMAT "%13.2" ECU_ADDRESS 0x60001C6C /end MEASUREMENT
/begin MEASUREMENT CrCtl_stIDASTqModFailr "IDAS torque mode fail status" UBYTE OneToOne 1 100 0.00 255.0 FORMAT "%5.1" ECU_ADDRESS 0x6000A3DD /end MEASUREMENT
/begin MEASUREMENT CrCUI_stPlusRDrvMod "Status of +R drive mode actived" UBYTE OneToOne 1 100 0.00 1.000 FORMAT "%5.3" ECU_ADDRESS 0x6000A422 /end MEASUREMENT
/begin MEASUREMENT CrC_stKey "Cruise Control Key status" UBYTE OneToOne 1 100 0.00 255.0 FORMAT "%5.1" ECU_ADDRESS 0x6000A410 /end MEASUREMENT
/begin MEASUREMENT Dfftl_bLowRng "Status reduction gearbox" UBYTE B_TRUE 1 100 0.00 1.00000000000 BIT_MASK 0x1 FORMAT "%13.11" ECU_ADDRESS 0x700008A9 /end MEASUREMENT
/begin MEASUREMENT dmsnte_w_msg "Standardized mass flow change through PCV" SWORD m_q0p1 1 100 -3276.800 3276.700 FORMAT "%8.3" ECU_ADDRESS 0x60004DDE /end MEASUREMENT
/begin MEASUREMENT DReqSwt_stClrDeb "Status of Diagnostic Memory Clear Switch after debouncing" UBYTE OneToOne 1 100 0.00 255.0 FORMAT "%5.1" ECU_ADDRESS 0x50005D76 /end MEASUREMENT
/begin MEASUREMENT DrvPrgSwt_bSprt "bit information: sport driving program is active" UBYTE B_TRUE 1 100 0.00 1.00000000000 BIT_MASK 0x1 FORMAT "%13.11" ECU_ADDRESS 0x6000A193 /end MEASUREMENT
/begin MEASUREMENT DrvPrgSwt_bSprtPlus "bit information: sport plus driving program is active" UBYTE B_TRUE 1 100 0.00 1.00000000000 BIT_MASK 0x1 FORMAT "%13.11" ECU_ADDRESS 0x700008A8 /end MEASUREMENT
/begin MEASUREMENT DrvPrgSwt_stEffModReqd "Status efficiency mode is requested" UBYTE dez 1 100 0.00 255.0 FORMAT "%5.1" ECU_ADDRESS 0x6000A3C2 /end MEASUREMENT
/begin MEASUREMENT DSMDur_tiMICumContGlb "Variable to record the cumulative number of hours during which the engine has been operated over its life while a continuous- co is activated" UWORD DSMDUR_MICntr_COMPU 1 100 0.00 65535.00 FORMAT "%8.2" ECU_ADDRESS 0x60004D20 /end MEASUREMENT
/begin MEASUREMENT Dspl_bVelInMiles "Unit of the displayed vehicle speed" UBYTE B_TRUE 1 100 0.00 1.00000000000 BIT_MASK 0x1 FORMAT "%13.11" ECU_ADDRESS 0x6000A192 /end MEASUREMENT
/begin MEASUREMENT Dspl_stCrsASLSelInfo "Cruise Control / ASL select information" UBYTE OneToOne 1 100 0.00 255.0 FORMAT "%5.1" ECU_ADDRESS 0x6000A3C0 /end MEASUREMENT
/begin MEASUREMENT EEM_chBatt "battery charge (SOF)" SWORD Ch_Ah_q0p5_COMPU 1 100 -16384.00 16383.50 FORMAT "%8.2" ECU_ADDRESS 0x60004B18 /end MEASUREMENT
/begin MEASUREMENT EEM_stBattChAc "Accuracy state of the battery charge" UBYTE OneToOne 1 100 0.00 255.0 FORMAT "%5.1" ECU_ADDRESS 0x6000A07C /end MEASUREMENT
/begin MEASUREMENT EepRdStrt "Starter EEP read status" UBYTE OneToOne 1 100 0.00 255.0 FORMAT "%5.1" ECU_ADDRESS 0x600062AE /end MEASUREMENT
/begin MEASUREMENT EepRdStrtRly "Starter relay EEP read status" UBYTE OneToOne 1 100 0.00 255.0 FORMAT "%5.1" ECU_ADDRESS 0x600062AD /end MEASUREMENT
/begin MEASUREMENT Eep_stISSStorgDiagActv "" UBYTE OneToOne 1 100 0.00 255.0 FORMAT "%5.1" ECU_ADDRESS 0x6000A071 /end MEASUREMENT
/begin MEASUREMENT ElecLd_iSensLd "Sensed value of the Electric Load current as read from sensor" SWORD Curr_A 1 100 -327.6800 327.6700 FORMAT "%8.4" ECU_ADDRESS 0x600050B6 /end MEASUREMENT
/begin MEASUREMENT ElecLd_stSRCChk "Status of SRC monitoring for ElecLd" UBYTE OneToOne 1 100 0.00 255.0 FORMAT "%5.1" ECU_ADDRESS 0x6000A3BA /end MEASUREMENT
/begin MEASUREMENT ElM_stOperModDes "Desired operation mode of electric motor" UBYTE OneToOne 1 100 0.00 255.0 FORMAT "%5.1" ECU_ADDRESS 0x6000A3BC /end MEASUREMENT
/begin MEASUREMENT ElM_tqActWoAcsyCmp "Actual torque from E-machine in Torque mode but set to 0Nm in Voltage mode" SWORD Trq 1 100 -3276.800 3276.700 FORMAT "%8.3" ECU_ADDRESS 0x600050DE /end MEASUREMENT
/begin MEASUREMENT ElM_tqDes "Desired torque of electric motor" SWORD Trq 1 100 -3276.800 3276.700 FORMAT "%8.3" ECU_ADDRESS 0x600050DC /end MEASUREMENT
/begin MEASUREMENT ElM_tqMaxGenr "Maximum allowed generator torque of electric motor" SWORD Trq 1 100 -3276.800 3276.700 FORMAT "%8.3" ECU_ADDRESS 0x600050DA /end MEASUREMENT
/begin MEASUREMENT ElM_tqMaxTqCtrl "Positive torque limitation in torque controlled mode" SWORD Trq 1 100 -3276.800 3276.700 FORMAT "%8.3" ECU_ADDRESS 0x600050D8 /end MEASUREMENT
/begin MEASUREMENT ElM_tqMinTqCtrl "Negative torque limitation in torque controlled mode" SWORD Trq 1 100 -3276.800 3276.700 FORMAT "%8.3" ECU_ADDRESS 0x600050D6 /end MEASUREMENT
/begin MEASUREMENT EngDa_tFld "Engine temperature field" SWORD Temp_Cels 1 100 -3549.940 3003.560 FORMAT "%8.3" ARRAY_SIZE 4 ECU_ADDRESS 0x50005A24 /end MEASUREMENT
/begin MEASUREMENT EngDa_tiEngOnOBD "Engine on time (OBD)" ULONG TimeEngOn 1 100 0.00 4294967295.00 FORMAT "%13.2" ECU_ADDRESS 0x60001C68 /end MEASUREMENT
/begin MEASUREMENT EngPrt_bNLimRed "Reduce of maximum engine speed" UBYTE B_TRUE 1 100 0.00 1.00000000000 BIT_MASK 0x1 FORMAT "%13.11" ECU_ADDRESS 0x6000A190 /end MEASUREMENT
/begin MEASUREMENT EngStrt_diaWrmUp "ignition angle offset during warmup" SWORD zw_q0p1 1 100 -3276.800 3276.700 FORMAT "%8.3" ECU_ADDRESS 0x70001DA4 /end MEASUREMENT
/begin MEASUREMENT EngStrt_nEngRstrtStgy2ThdLo "engine threshold restart strategy: nEng greater threshold means stgy 2, less than means stgy 3" SWORD EngN 1 100 -16384.00 16383.50 FORMAT "%8.2" ECU_ADDRESS 0x60004AF0 /end MEASUREMENT
/begin MEASUREMENT EnvT_stTSens "Status of the EnvT sensors" UBYTE OneToOne 1 100 0.00 255.0 FORMAT "%5.1" ECU_ADDRESS 0x6000A3B0 /end MEASUREMENT
/begin MEASUREMENT EnvT_tSens "Raw physical value" SWORD Temp_Cels 1 100 -3549.940 3003.560 FORMAT "%8.3" ECU_ADDRESS 0x6000509A /end MEASUREMENT
/begin MEASUREMENT EpmRRS_bEngStopAg "Validity of the engine run out position detection" UBYTE EpmRRS_bEngStopAg_t 1 100 0.00 1.00000000000 FORMAT "%13.11" ECU_ADDRESS 0x6000E416 /end MEASUREMENT
/begin MEASUREMENT ESS_bEngStrtEna "Start release from the electrical system" UBYTE B_TRUE 1 100 0.00 1.00000000000 BIT_MASK 0x1 FORMAT "%13.11" ECU_ADDRESS 0x7000080F /end MEASUREMENT
/begin MEASUREMENT ExhMgT_flgNoStopEngCatHeatg "condition stop prohibition because of a request from the exhaust system" UBYTE B_TRUE 1 100 0.00 1.00000000000 BIT_MASK 0x1 FORMAT "%13.11" ECU_ADDRESS 0x700007C4 /end MEASUREMENT
/begin MEASUREMENT ExhMgT_stPrioWpDmdHyb "priority of requested operating conditions for catalyst heating" UBYTE OneToOne 1 100 0.00 255.0 FORMAT "%5.1" ECU_ADDRESS 0x6000E420 /end MEASUREMENT
/begin MEASUREMENT FanCtl_stFanCtrlEnd "Status of fan control end" UBYTE B_TRUE 1 100 0.00 1.00000000000 BIT_MASK 0x1 FORMAT "%13.11" ECU_ADDRESS 0x60009F97 /end MEASUREMENT
/begin MEASUREMENT Fan_rPs "PWM output ratio for fan actuator 1" SWORD DtyCyc 1 100 -327.6800 327.6700 FORMAT "%8.4" ECU_ADDRESS 0x600049FC /end MEASUREMENT
/begin MEASUREMENT fethmnmx "ethanol content interpolation factor" UBYTE fak_ub_b2 1 100 0.00 1.992188 FORMAT "%8.6" ECU_ADDRESS 0x6000A2A0 /end MEASUREMENT
/begin MEASUREMENT fho "Altitude correction factor" UBYTE fak_ub_b4 1 100 0.00 3.984 FORMAT "%5.3" ECU_ADDRESS 0x6000A29F /end MEASUREMENT
/begin MEASUREMENT flamlu_w_msg "Ratio total charge to charge in cylinder" UWORD fak_uw_b16 1 100 0.00 15.99976 FORMAT "%8.5" ECU_ADDRESS 0x60004C0E /end MEASUREMENT
/begin MEASUREMENT FlSys_dvolFlCons "Fuel consumption l/h of the torque relevant injection quantity" SWORD FlConsum_l_h 1 100 -327.6800 327.6700 FORMAT "%8.4" ECU_ADDRESS 0x70002C56 /end MEASUREMENT
/begin MEASUREMENT fra_w "multiplicative correction of the mixture adaptation (word)" UWORD fak_uw_b2 1 100 0.00 1.999969 FORMAT "%8.6" ECU_ADDRESS 0x60004C0C /end MEASUREMENT
/begin MEASUREMENT ftead_w "factor fuel purge adaptation" SWORD fak_sw_b64 1 100 -64.00000 63.99805 FORMAT "%8.5" ECU_ADDRESS 0x60004DD4 /end MEASUREMENT
/begin MEASUREMENT FuelT_t "Temperature of fuel" SWORD Temp_Cels 1 100 -3549.940 3003.560 FORMAT "%8.3" ECU_ADDRESS 0x6000508E /end MEASUREMENT
/begin MEASUREMENT GbxMTAT_stTraType "Type of Transmission selected from hardware" UBYTE OneToOne 1 100 0.00 255.0 FORMAT "%5.1" ECU_ADDRESS 0x6000A3AD /end MEASUREMENT
/begin MEASUREMENT Gbx_bASTIntv "Message for status of AST intervention" UBYTE B_TRUE 1 100 0.00 1.00000000000 BIT_MASK 0x1 FORMAT "%13.11" ECU_ADDRESS 0x7000078D /end MEASUREMENT
/begin MEASUREMENT Gbx_bASTNeutr "Message for status of neutral state of AST" UBYTE OneToOne 1 100 0.00 255.0 FORMAT "%5.1" ECU_ADDRESS 0x6000E421 /end MEASUREMENT
/begin MEASUREMENT Gbx_bATSlipOpn "Gear box ATS Slip open" UBYTE B_TRUE 1 100 0.00 1.00000000000 BIT_MASK 0x1 FORMAT "%13.11" ECU_ADDRESS 0x6000A18A /end MEASUREMENT
/begin MEASUREMENT Gbx_bGearShftActv "Status of Gear Shift" UBYTE B_TRUE 1 100 0.00 1.00000000000 BIT_MASK 0x1 FORMAT "%13.11" ECU_ADDRESS 0x7000078C /end MEASUREMENT
/begin MEASUREMENT Gbx_bHaltDisEgdActv "stand still disengagement of the gearbox active" UBYTE B_TRUE 1 100 0.00 1.00000000000 BIT_MASK 0x1 FORMAT "%13.11" ECU_ADDRESS 0x7000078B /end MEASUREMENT
/begin MEASUREMENT Gbx_bLimp "Gearbox in limp home mode" UBYTE B_TRUE 1 100 0.00 1.00000000000 BIT_MASK 0x1 FORMAT "%13.11" ECU_ADDRESS 0x7000078A /end MEASUREMENT
/begin MEASUREMENT Gbx_bNCmp "Gear box Compensation" UBYTE B_TRUE 1 100 0.00 1.00000000000 BIT_MASK 0x1 FORMAT "%13.11" ECU_ADDRESS 0x6000A188 /end MEASUREMENT
/begin MEASUREMENT Gbx_bOvrRstrtActv "Support of overrun switch off" UBYTE B_TRUE 1 100 0.00 1.00000000000 BIT_MASK 0x1 FORMAT "%13.11" ECU_ADDRESS 0x70000789 /end MEASUREMENT
/begin MEASUREMENT Gbx_bRevGear "Message for active status of reverse gear shifting" UBYTE B_TRUE 1 100 0.00 1.00000000000 BIT_MASK 0x1 FORMAT "%13.11" ECU_ADDRESS 0x70000788 /end MEASUREMENT
/begin MEASUREMENT Gbx_bSailActv "ComCIL interface for CAN signal GE2_Segeln_aktiv" UBYTE B_TRUE 1 100 0.00 1.00000000000 BIT_MASK 0x1 FORMAT "%13.11" ECU_ADDRESS 0x70000787 /end MEASUREMENT
/begin MEASUREMENT Gbx_bTIIIntv "Release for increasing gearbox intervention torque of received" UBYTE B_TRUE 1 100 0.00 1.00000000000 BIT_MASK 0x1 FORMAT "%13.11" ECU_ADDRESS 0x70000786 /end MEASUREMENT
/begin MEASUREMENT Gbx_bTSCIntv "Release for decreasing gearbox intervention torque of received" UBYTE B_TRUE 1 100 0.00 1.00000000000 BIT_MASK 0x1 FORMAT "%13.11" ECU_ADDRESS 0x70000785 /end MEASUREMENT
/begin MEASUREMENT Gbx_flgNCtrlImp "Operation of N control execution flag" UBYTE B_TRUE 1 100 0.00 1.00000000000 BIT_MASK 0x1 FORMAT "%13.11" ECU_ADDRESS 0x70000784 /end MEASUREMENT
/begin MEASUREMENT Gbx_flgNCtrlRetStrt "N control return judgement flag at brake ON" UBYTE B_TRUE 1 100 0.00 1.00000000000 BIT_MASK 0x1 FORMAT "%13.11" ECU_ADDRESS 0x70000783 /end MEASUREMENT
/begin MEASUREMENT Gbx_nASTDes "Synchronized desired engine speed" SWORD EngN 1 100 -16384.00 16383.50 FORMAT "%8.2" ECU_ADDRESS 0x60005074 /end MEASUREMENT
/begin MEASUREMENT Gbx_nRrngEngSpdInh "Maximum engine speed for rear gear sent from gearbox" SWORD EngN 1 100 -16384.00 16383.50 FORMAT "%8.2" ECU_ADDRESS 0x70001D9A /end MEASUREMENT
/begin MEASUREMENT Gbx_numGear "Status of Actual gear" SBYTE dez 1 100 -128.0 127.0 FORMAT "%5.1" ECU_ADDRESS 0x6000A6CF /end MEASUREMENT
/begin MEASUREMENT Gbx_numGearTrgt "Status of Desired gear" SWORD OneToOne 1 100 -32768.00 32767.00 FORMAT "%8.2" ECU_ADDRESS 0x6000051A /end MEASUREMENT
/begin MEASUREMENT Gbx_ratOilCoolrPmp "Gear box oil pump load ratio over CAN" SWORD Prc 1 100 -400.0000 399.9878 FORMAT "%8.4" ECU_ADDRESS 0x60005066 /end MEASUREMENT
/begin MEASUREMENT Gbx_rConvSlip "Transmission torque converter slip" SWORD CrCtlSlipRat 1 100 -163.8400 163.8350 FORMAT "%8.4" ECU_ADDRESS 0x6000506A /end MEASUREMENT
/begin MEASUREMENT Gbx_rFanClgDem "Percentage of Fan Cooling Demand" SWORD Prc 1 100 -400.0000 399.9878 FORMAT "%8.4" ECU_ADDRESS 0x6000E268 /end MEASUREMENT
/begin MEASUREMENT Gbx_rTrq "Transmission function information from Gearbox ECU" SWORD TransR 1 100 -327.6800 327.6700 FORMAT "%8.4" ECU_ADDRESS 0x60005068 /end MEASUREMENT
/begin MEASUREMENT Gbx_rTrqTra "Message for ratio of transmission torque" SWORD TransR 1 100 -327.6800 327.6700 FORMAT "%8.4" ECU_ADDRESS 0x70001D98 /end MEASUREMENT
/begin MEASUREMENT Gbx_stHaltDisEgdActv "Stand still disengagement of the gearbox status" UBYTE OneToOne 1 100 0.00 255.0 FORMAT "%5.1" ECU_ADDRESS 0x6000A047 /end MEASUREMENT
/begin MEASUREMENT Gbx_stSpstReq "start stop request from Gearbox ECU via CAN" UBYTE OneToOne 1 100 0.00 255.0 FORMAT "%5.1" ECU_ADDRESS 0x6000A3A7 /end MEASUREMENT
/begin MEASUREMENT Gbx_tClntDes "Set point value of the coolant temperature (via CAN)" SWORD Temp_Cels 1 100 -3549.940 3003.560 FORMAT "%8.3" ECU_ADDRESS 0x60005064 /end MEASUREMENT
/begin MEASUREMENT Gbx_tiASTDes "Synchronization time" SWORD Time_s 1 100 -327.6800 327.6700 FORMAT "%8.4" ECU_ADDRESS 0x60005060 /end MEASUREMENT
/begin MEASUREMENT Gbx_trqPrt "Max stabilized transmission torque" SWORD Trq 1 100 -3276.800 3276.700 FORMAT "%8.3" ECU_ADDRESS 0x600049E2 /end MEASUREMENT
/begin MEASUREMENT Gbx_trqTIIDes "Torque desired by gearbox received on CAN (P057)" SWORD Trq 1 100 -3276.800 3276.700 FORMAT "%8.3" ECU_ADDRESS 0x6000E26A /end MEASUREMENT
/begin MEASUREMENT Gbx_trqTIILead "Lead intervention torque for increasing gearbox intervention" SWORD Trq 1 100 -3276.800 3276.700 FORMAT "%8.3" ECU_ADDRESS 0x600049E0 /end MEASUREMENT
/begin MEASUREMENT Gbx_trqTSCIntvDes "Internal engine target torque" SWORD Trq 1 100 -3276.800 3276.700 FORMAT "%8.3" ECU_ADDRESS 0x6000E26C /end MEASUREMENT
/begin MEASUREMENT Gbx_trqTSCIntvLead "Internal engine target torque" SWORD Trq 1 100 -3276.800 3276.700 FORMAT "%8.3" ECU_ADDRESS 0x600049DE /end MEASUREMENT
/begin MEASUREMENT Gbx_uAPPMaxLrn "Gearbox AT accelerator max learned voltage" SWORD Volt_Batt 1 100 -655360.0 655340.0 FORMAT "%8.1" ECU_ADDRESS 0x60005056 /end MEASUREMENT
/begin MEASUREMENT GEVCtl_flgPhaEnaPOil "Condition: oil pressure for camshaft control ok" UBYTE B_TRUE 1 100 0.00 1.00000000000 BIT_MASK 0x1 FORMAT "%13.11" ECU_ADDRESS 0x70000793 /end MEASUREMENT
/begin MEASUREMENT GEVCtl_flgSpSpclIntkVlvLft "Special cam lobe for intake camshaft desired" UBYTE B_TRUE 1 100 0.00 1.00000000000 BIT_MASK 0x1 FORMAT "%13.11" ECU_ADDRESS 0x70000791 /end MEASUREMENT
/begin MEASUREMENT GEVCtl_ratLoad "Relative load for setpoints determination of camshaft phase shifting" UWORD rel_uw_q0p0234 1 100 0.00 1535.977 FORMAT "%8.3" ECU_ADDRESS 0x60004CC2 /end MEASUREMENT
/begin MEASUREMENT GEVCtl_tOilCylHd "Oil temperature cylinder head" SWORD Temp_Cels 1 100 -3549.940 3003.560 FORMAT "%8.3" ECU_ADDRESS 0x6000E266 /end MEASUREMENT
/begin MEASUREMENT GlbDa_stTraPlus "The Traction Plus message map from the Frame Car Configuration" UBYTE OneToOne 1 100 0.00 255.0 FORMAT "%5.1" ECU_ADDRESS 0x6000A3A6 /end MEASUREMENT
/begin MEASUREMENT grundwert_msg "space between SW reference mark to TDC in KW" UBYTE kw_q1 1 100 0.00 255.0 FORMAT "%5.1" ECU_ADDRESS 0x50005DD1 /end MEASUREMENT
/begin MEASUREMENT HEGO_flgS2B1EnaLamCtlColdOper "lambda control enabled for Cold operation sensor 2 bank 1" UBYTE B_TRUE 1 100 0.00 1.00000000000 BIT_MASK 0x1 FORMAT "%13.11" ECU_ADDRESS 0x7000075C /end MEASUREMENT
/begin MEASUREMENT HiPSys_flgDeactvnFuInjInhbn "Flag for fuel cut inhibition in case of rail pressure max failure detection" UBYTE B_TRUE 1 100 0.00 1.00000000000 BIT_MASK 0x1 FORMAT "%13.11" ECU_ADDRESS 0x70000750 /end MEASUREMENT
/begin MEASUREMENT HndBrk_stDebVal "Debounced value of Hand Brake switch" UBYTE OneToOne 1 100 0.00 255.0 FORMAT "%5.1" ECU_ADDRESS 0x6000A39F /end MEASUREMENT
/begin MEASUREMENT I14229iocbiCrCtl1_stVal "Status of CrCtl 1 SFT" UWORD OneToOne 1 100 0.00 65535.00 FORMAT "%8.2" ECU_ADDRESS 0x600048A6 /end MEASUREMENT
/begin MEASUREMENT I14229iocbiCrCtl_stVal "Status of Cruise control lamp SFT" UWORD OneToOne 1 100 0.00 65535.00 FORMAT "%8.2" ECU_ADDRESS 0x600048A4 /end MEASUREMENT
/begin MEASUREMENT IKCtl_iaDynAdpnOffs_s16 "ignition retard during dyn-function of knock control" SWORD zw_q0p1 1 100 -3276.800 3276.700 FORMAT "%8.3" ECU_ADDRESS 0x500006E8 /end MEASUREMENT
/begin MEASUREMENT imlatm_w "integrated air mass flow from engine start to max. value (word)" UWORD m_uw_b23p3 1 100 0.00 23.30133 FORMAT "%8.5" ECU_ADDRESS 0x60004BFE /end MEASUREMENT
/begin MEASUREMENT InjSys_nrRedStgEnf "number of enforced cut off cylinders without torque structure requests" UBYTE dez 1 100 0.00 255.0 FORMAT "%5.1" ECU_ADDRESS 0x6000A37E /end MEASUREMENT
/begin MEASUREMENT InjSys_ofsCylCntrHom "Offset of cylinder counter for calculation of homogeneous injection, i.e. number of segments between calculation point and Ignition Top Dead Center (TDC)" UBYTE dez 1 100 0.00 255.0 FORMAT "%5.1" ECU_ADDRESS 0x50000898 /end MEASUREMENT
/begin MEASUREMENT InjSys_ofsCylCntrStrat "Offset of cylinder counter for calculation of the stratified injection, i.e. number of segments between calculation point and ignition TDC" UBYTE dez 1 100 0.00 255.0 FORMAT "%5.1" ECU_ADDRESS 0x50000899 /end MEASUREMENT
/begin MEASUREMENT IntkAirT_uSnsr3CrssSwtLoc "Spannungswert des Ansauglufttemperatursensors Snsr3, lokal" UWORD Volt 1 100 0.00 13107.00 FORMAT "%8.2" ECU_ADDRESS 0x60004894 /end MEASUREMENT
/begin MEASUREMENT i_lutskzyl_w "" UBYTE OneToOne 1 100 0.00 255.0 FORMAT "%5.1" ECU_ADDRESS 0x600062AA /end MEASUREMENT
/begin MEASUREMENT KONCW_flgRatLoadCalMod "Release condition for rl_w usage on GEVCtl_ratLoad calculation for calibration purposes" UBYTE B_TRUE 1 100 0.00 1.00000000000 BIT_MASK 0x1 FORMAT "%13.11" ECU_ADDRESS 0x70000714 /end MEASUREMENT
/begin MEASUREMENT LAS_facRoadGrdt "Factor for Road gradient" SWORD Prc_Fact100 1 100 -327.6800 327.6700 FORMAT "%8.4" ECU_ADDRESS 0x600049B6 /end MEASUREMENT
/begin MEASUREMENT LLim_bFcoDes_msg "Desired fuel cutoff" UBYTE B_TRUE 1 100 0.00 1.00000000000 BIT_MASK 0x1 FORMAT "%13.11" ECU_ADDRESS 0x70000700 /end MEASUREMENT
/begin MEASUREMENT lutskzyl_w "engine roughness test value, corrected, array with all cylinders" SWORD lu_MEx 1 100 -232.8306 232.8235 FORMAT "%8.4" ARRAY_SIZE 4 ECU_ADDRESS 0x6000358E /end MEASUREMENT
/begin MEASUREMENT MESCtrlr_nSpDif "Difference between set point and current engine speed" SWORD EngN 1 100 0.00 16383.50 FORMAT "%8.2" ECU_ADDRESS 0x60004FFA /end MEASUREMENT
/begin MEASUREMENT MoFTerminal_stT50EmgyMsg "T50 enable start enable message" UBYTE OneToOne 1 100 0.00 255.0 FORMAT "%5.1" ECU_ADDRESS 0x6000A32B /end MEASUREMENT
/begin MEASUREMENT mshfmst_w "air mass flow HFM 16-Bit value for scantool" UWORD m_q0p1 1 100 0.00 6553.500 FORMAT "%8.3" ECU_ADDRESS 0x60004BE0 /end MEASUREMENT
/begin MEASUREMENT nltrstdone_msg "nltrstdone_msg" UBYTE B_TRUE 1 100 0.00 1.00000000000 BIT_MASK 0x1 FORMAT "%13.11" ECU_ADDRESS 0x6000011A /end MEASUREMENT
/begin MEASUREMENT nstat "Stationary reference speed" UBYTE nmot_ub_q10 1 100 0.00 2550. FORMAT "%5.0" ECU_ADDRESS 0x6000A292 /end MEASUREMENT
/begin MEASUREMENT OilLfT_degOilDetern "The degree of engine oil deterioration (for E-OIL Life processing)." SWORD rel_q0p1 1 100 -3276.800 3276.700 FORMAT "%8.3" ECU_ADDRESS 0x60004FD2 /end MEASUREMENT
/begin MEASUREMENT OilLfT_mAirPerCyl "The amount of inhaled air in a cylinder" SWORD AirMassPerCyl 1 100 -3276.800 3276.700 FORMAT "%8.3" ECU_ADDRESS 0x600049B2 /end MEASUREMENT
/begin MEASUREMENT OilLfT_stFailOilTSnsr "Status of engine oil life system failure due to Oil Temperature sensor error" UBYTE B_TRUE 1 100 0.00 1.00000000000 BIT_MASK 0x1 FORMAT "%13.11" ECU_ADDRESS 0x700006B8 /end MEASUREMENT
/begin MEASUREMENT OilLfT_stFailSafeActn "The failsafe action execution about engine oil deterioration system is done by 1." UBYTE B_TRUE 1 100 0.00 1.00000000000 BIT_MASK 0x1 FORMAT "%13.11" ECU_ADDRESS 0x700006B7 /end MEASUREMENT
/begin MEASUREMENT OilP_p "Oil pressure" SWORD Pres_hPa 1 100 -32768.00 32767.00 FORMAT "%8.2" ECU_ADDRESS 0x60004FD0 /end MEASUREMENT
/begin MEASUREMENT OilSwmpT_uSnsrRaw "ADC-voltage of the oil temperature sensor" SWORD Volt 1 100 -6553.600 6553.400 FORMAT "%8.3" ECU_ADDRESS 0x60004986 /end MEASUREMENT
/begin MEASUREMENT Oil_p "Oil pressure engine" SWORD Pres 1 100 -3276.800 3276.700 FORMAT "%8.3" ECU_ADDRESS 0x60004FCE /end MEASUREMENT
/begin MEASUREMENT Oil_stAvusWarn "Warning: limitaion due to AVS-failure" UBYTE B_TRUE 1 100 0.00 1.00000000000 BIT_MASK 0x1 FORMAT "%13.11" ECU_ADDRESS 0x700006AF /end MEASUREMENT
/begin MEASUREMENT Oil_stOilLow "This is SW-VARIABLE" UBYTE OneToOne 1 100 0.00 255.0 FORMAT "%5.1" ECU_ADDRESS 0x6000A311 /end MEASUREMENT
/begin MEASUREMENT PEnv_dataDigSens "Digital raw data from ambient ait pressure sensor" ULONG spg_q1p221Em3_V 1 100 0.00 79.9987792969 FORMAT "%13.10" ECU_ADDRESS 0x60001BC8 /end MEASUREMENT
/begin MEASUREMENT PFltDes_flgInhbOverrun "Fuel cut off is not allowed if the particulate filte is full" UBYTE B_TRUE 1 100 0.00 1.00000000000 BIT_MASK 0x1 FORMAT "%13.11" ECU_ADDRESS 0x6000A16D /end MEASUREMENT
/begin MEASUREMENT PhyMod_trqDynEng "dynamic engine torque" SWORD md_sw_q0p1 1 100 -3276.800 3276.700 FORMAT "%8.3" ECU_ADDRESS 0x60004F80 /end MEASUREMENT
/begin MEASUREMENT priobbora_msg "priority of requested operating conditions for additive fuel mixture adaptation" UBYTE OneToOne 1 100 0.00 255.0 FORMAT "%5.1" ECU_ADDRESS 0x6000A28E /end MEASUREMENT
/begin MEASUREMENT priobbteh_msg "priority of requested operating conditions for canister purge system with high canister load" UBYTE OneToOne 1 100 0.00 255.0 FORMAT "%5.1" ECU_ADDRESS 0x6000A28D /end MEASUREMENT
/begin MEASUREMENT psmxbkvg_w_msg "max. manifold air pressure for boost pressure control" UWORD p_uw_q0p039 1 100 0.00 2559.961 FORMAT "%8.3" ECU_ADDRESS 0x60004808 /end MEASUREMENT
/begin MEASUREMENT PSPCtl_flgRmnVapSuspc "Condition:Vapor lock suspicion detected to trigger high voltage" UBYTE B_TRUE 1 100 0.00 1.00000000000 BIT_MASK 0x1 FORMAT "%13.11" ECU_ADDRESS 0x6000A166 /end MEASUREMENT
/begin MEASUREMENT PTDist_flgEmStrtgTqActv "Flag to check whether desired torque for electric motor is for starting of the engine" UBYTE B_TRUE 1 100 0.00 1.00000000000 BIT_MASK 0x1 FORMAT "%13.11" ECU_ADDRESS 0x70000695 /end MEASUREMENT
/begin MEASUREMENT PTDist_flgEvModSetLimnActv "EV mode limits the set engine torque" UBYTE B_TRUE 1 100 0.00 1.00000000000 BIT_MASK 0x1 FORMAT "%13.11" ECU_ADDRESS 0x70000694 /end MEASUREMENT
/begin MEASUREMENT ptek_w_msg "tank pressure (16 Bit)" SWORD p_q0p00122 1 100 -40.00000 39.99878 FORMAT "%8.5" ECU_ADDRESS 0x60004932 /end MEASUREMENT
/begin MEASUREMENT PthSet_flgCritTqIncPhd "Prohibited critical torque increase" UBYTE B_TRUE 1 100 0.00 1.00000000000 BIT_MASK 0x1 FORMAT "%13.11" ECU_ADDRESS 0x6000A14C /end MEASUREMENT
/begin MEASUREMENT PthSet_stOvrRunCoord "State of overrun detection of the overrun coordinator (0: no overrun; 1:overrun)" UBYTE OneToOne 1 100 0.00 1.000 FORMAT "%5.3" ECU_ADDRESS 0x70001C15 /end MEASUREMENT
/begin MEASUREMENT PthSet_trqInrFlt "Filtered torque request for set path" SWORD md_q0p1 1 100 -3276.800 3276.700 FORMAT "%8.3" ECU_ADDRESS 0x6000E2B4 /end MEASUREMENT
/begin MEASUREMENT PthSet_trqInrSet "PthSet: inner torque set value" SWORD Trq 1 100 -3276.800 3276.700 FORMAT "%8.3" ECU_ADDRESS 0x70002C74 /end MEASUREMENT
/begin MEASUREMENT PTODi_trqCrSLeadUnlim "Torque request for Lead-path engine without EngDem-limitation" SWORD Trq 1 100 -3276.800 3276.700 FORMAT "%8.3" ECU_ADDRESS 0x60000582 /end MEASUREMENT
/begin MEASUREMENT PT_bCtOffPhd "Status of fuel cut-off inhibition" UBYTE B_TRUE 1 100 0.00 1.00000000000 BIT_MASK 0x1 FORMAT "%13.11" ECU_ADDRESS 0x70000693 /end MEASUREMENT
/begin MEASUREMENT PT_flgLimnFCOReq "Fuel Cut Off request status" UBYTE B_TRUE 1 100 0.00 1.00000000000 BIT_MASK 0x1 FORMAT "%13.11" ECU_ADDRESS 0x7000068E /end MEASUREMENT
/begin MEASUREMENT PT_tqCluMinWoFco "Minimum clutch torque without cutoff" SWORD Trq 1 100 -3276.800 3276.700 FORMAT "%8.3" ECU_ADDRESS 0x60004F9C /end MEASUREMENT
/begin MEASUREMENT PT_trqCrSLeadPOp "propulsion lead torque for operation mode selection (crankshaft torque)" SWORD Trq 1 100 -3276.800 3276.700 FORMAT "%8.3" ECU_ADDRESS 0x6000E2A6 /end MEASUREMENT
/begin MEASUREMENT PT_trqCrSWoIntv "Set point torque without interventions on crankshaft torque level" SWORD Trq 1 100 -3276.800 3276.700 FORMAT "%8.3" ECU_ADDRESS 0x60004972 /end MEASUREMENT
/begin MEASUREMENT PT_trqTraPrt "maximum allowed inner torque" SWORD Trq 1 100 -3276.800 3276.700 FORMAT "%8.3" ECU_ADDRESS 0x60004970 /end MEASUREMENT
/begin MEASUREMENT PT_trqWhlMaxEng "Maximum wheel torque from the engine" SLONG TrqPrpHigh 1 100 -214748364.800 214748364.700 FORMAT "%13.3" ECU_ADDRESS 0x60001CD0 /end MEASUREMENT
/begin MEASUREMENT PT_trqWhlMinWoCtOff "Minimum wheel torque with internal combustion engine firing" SLONG TrqPrpHigh 1 100 -214748364.800 214748364.700 FORMAT "%13.3" ECU_ADDRESS 0x60001CC4 /end MEASUREMENT
/begin MEASUREMENT pu_w "Ambient pressure" UWORD p_uw_q0p039 1 100 0.00 2559.961 FORMAT "%8.3" ECU_ADDRESS 0x6000066E /end MEASUREMENT
/begin MEASUREMENT pvv_w_msg "pressure upstream booster" UWORD p_uw_q0p039 1 100 0.00 2559.961 FORMAT "%8.3" ECU_ADDRESS 0x60004BBE /end MEASUREMENT
/begin MEASUREMENT rlmdhoms_w_msg "desired relative air charge for homogeneous mode" UWORD rel_uw_q0p0234 1 100 0.00 1535.977 FORMAT "%8.3" ECU_ADDRESS 0x60004BBC /end MEASUREMENT
/begin MEASUREMENT rlmxbkv_w_msg "max.permitted air charge for brake booster" UWORD rel_uw_q0p0234 1 100 0.00 1535.977 FORMAT "%8.3" ECU_ADDRESS 0x6000E32C /end MEASUREMENT
/begin MEASUREMENT rlsol_w "desired relative air charge" UWORD rel_q0p02344 1 100 0.00 1535.977 FORMAT "%8.3" ECU_ADDRESS 0x60004BB8 /end MEASUREMENT
/begin MEASUREMENT rltedte_w_msg "from DTEV calculated relative charge through the purge control valve" UWORD rel_q0p02344 1 100 0.00 1535.977 FORMAT "%8.3" ECU_ADDRESS 0x60004BB6 /end MEASUREMENT
/begin MEASUREMENT rl_w "Relative air charge (Word)" UWORD rel_q0p0234 1 100 0.00 1535.977 FORMAT "%8.3" ECU_ADDRESS 0x60004802 /end MEASUREMENT
/begin MEASUREMENT RrDfogSwt_stRawVal "Raw value of Rear defogger switch signal" UBYTE OneToOne 1 100 0.00 255.0 FORMAT "%5.1" ECU_ADDRESS 0x6000E42F /end MEASUREMENT
/begin MEASUREMENT Shtrp_rTrqSetPointDia "Desired torque for Dia" SWORD Prc 1 100 -400.0000 399.9878 FORMAT "%8.4" ECU_ADDRESS 0x6000E2CA /end MEASUREMENT
/begin MEASUREMENT Shtrp_stAct "Short Trip diagnosis is active" UBYTE OneToOne 1 100 0.00 255.0 FORMAT "%5.1" ECU_ADDRESS 0x6000A2FF /end MEASUREMENT
/begin MEASUREMENT SpdGov_bNLimFCOReq "Fuel Cut-Off request for Engine speed limitation" UBYTE B_TRUE 1 100 0.00 1.00000000000 BIT_MASK 0x1 FORMAT "%13.11" ECU_ADDRESS 0x6000A145 /end MEASUREMENT
/begin MEASUREMENT SpdGov_trqEngPrtLimMech "Torque limitation due to NMAX-limitation" SWORD md_sw_q0p1 1 100 -3276.800 3276.700 FORMAT "%8.3" ECU_ADDRESS 0x60004F1A /end MEASUREMENT
/begin MEASUREMENT StbIntv_bESPErr "ESP system status" UBYTE B_TRUE 1 100 0.00 1.00000000000 BIT_MASK 0x1 FORMAT "%13.11" ECU_ADDRESS 0x70000681 /end MEASUREMENT
/begin MEASUREMENT StbIntv_bTCSDeActv "Status TCS deactivated" UBYTE B_TRUE 1 100 0.00 1.00000000000 BIT_MASK 0x1 FORMAT "%13.11" ECU_ADDRESS 0x70000680 /end MEASUREMENT
/begin MEASUREMENT stEepOrd_RstrtIntlSho "EEP Order status for the counter resetting when the Tester function is called" UBYTE OneToOne 1 100 0.00 255.0 FORMAT "%5.1" ECU_ADDRESS 0x600062AB /end MEASUREMENT
/begin MEASUREMENT stPsShOffSeq "Power stage shut-off sequence" UBYTE OneToOne 1 100 0.00 255.0 FORMAT "%5.1" ECU_ADDRESS 0x6003614E /end MEASUREMENT
/begin MEASUREMENT StrtCtl_bPanicStrtReq_MP "Condition urgent (panic) start request" UBYTE B_TRUE 1 100 0.00 1.00000000000 BIT_MASK 0x1 FORMAT "%13.11" ECU_ADDRESS 0x70008B9D /end MEASUREMENT
/begin MEASUREMENT StrtCtl_bPushBtnStrtCmft_MP "Measuring point for Push button start comfort" UBYTE B_TRUE 1 100 0.00 1.00000000000 BIT_MASK 0x1 FORMAT "%13.11" ECU_ADDRESS 0x70008B9C /end MEASUREMENT
/begin MEASUREMENT StrtCtl_bStrtActvN "Condition starter-engine rpm" UBYTE B_TRUE 1 100 0.00 1.00000000000 BIT_MASK 0x1 FORMAT "%13.11" ECU_ADDRESS 0x600062C3 /end MEASUREMENT
/begin MEASUREMENT StrtCtl_bStrtActv_MP "Condition starter-engine is active" UBYTE B_TRUE 1 100 0.00 1.00000000000 BIT_MASK 0x1 FORMAT "%13.11" ECU_ADDRESS 0x70008B9B /end MEASUREMENT
/begin MEASUREMENT StrtCtl_bStrtCmftMax_MP "Measuring point for maximum starter operation time for comfort" UBYTE B_TRUE 1 100 0.00 1.00000000000 BIT_MASK 0x1 FORMAT "%13.11" ECU_ADDRESS 0x70008B9A /end MEASUREMENT
/begin MEASUREMENT StrtCtl_bStrtDlyFin_MP "Condition end of delay of starter control" UBYTE B_TRUE 1 100 0.00 1.00000000000 BIT_MASK 0x1 FORMAT "%13.11" ECU_ADDRESS 0x70008B99 /end MEASUREMENT
/begin MEASUREMENT StrtCtl_bStrtOrd "Condition order for starter control" UBYTE B_TRUE 1 100 0.00 1.00000000000 BIT_MASK 0x1 FORMAT "%13.11" ECU_ADDRESS 0x600062C2 /end MEASUREMENT
/begin MEASUREMENT StrtCtl_bStrtReq "request for starter control" UBYTE B_TRUE 1 100 0.00 1.00000000000 BIT_MASK 0x1 FORMAT "%13.11" ECU_ADDRESS 0x600062B1 /end MEASUREMENT
/begin MEASUREMENT StrtCtl_bStrtReqCncl_MP "condition to cancel request for starter control" UBYTE B_TRUE 1 100 0.00 1.00000000000 BIT_MASK 0x1 FORMAT "%13.11" ECU_ADDRESS 0x70008B98 /end MEASUREMENT
/begin MEASUREMENT StrtCtl_bStrtReqIMG "start request validated for IMG" UBYTE B_TRUE 1 100 0.00 1.00000000000 BIT_MASK 0x1 FORMAT "%13.11" ECU_ADDRESS 0x600062C1 /end MEASUREMENT
/begin MEASUREMENT StrtCtl_bStrtReqVal_MP "request for starter control is valid" UBYTE B_TRUE 1 100 0.00 1.00000000000 BIT_MASK 0x1 FORMAT "%13.11" ECU_ADDRESS 0x70008B97 /end MEASUREMENT
/begin MEASUREMENT StrtCtl_bStrtrOperTiCdn_MP "Measuring point for Checking the Initial start time conditons" UBYTE B_TRUE 1 100 0.00 1.00000000000 BIT_MASK 0x1 FORMAT "%13.11" ECU_ADDRESS 0x70008B96 /end MEASUREMENT
/begin MEASUREMENT StrtCtl_bStSpStrtOrd "start order from start-stop-coordinator for starter control" UBYTE B_TRUE 1 100 0.00 1.00000000000 BIT_MASK 0x1 FORMAT "%13.11" ECU_ADDRESS 0x600062C0 /end MEASUREMENT
/begin MEASUREMENT StrtCtl_bTiLimCmftSel_MP "Measuring point for time limitation for comfort selection" UBYTE B_TRUE 1 100 0.00 1.00000000000 BIT_MASK 0x1 FORMAT "%13.11" ECU_ADDRESS 0x70008B95 /end MEASUREMENT
/begin MEASUREMENT StrtCtl_bTraBrkReqCnclDeb_MP "Delete start request with debounced TraBrk-signal" UBYTE B_TRUE 1 100 0.00 1.00000000000 BIT_MASK 0x1 FORMAT "%13.11" ECU_ADDRESS 0x70008B94 /end MEASUREMENT
/begin MEASUREMENT StrtCtl_bTraBrkStrtCtlLck "Transmission brake start control lock" UBYTE B_TRUE 1 100 0.00 1.00000000000 BIT_MASK 0x1 FORMAT "%13.11" ECU_ADDRESS 0x6000A13C /end MEASUREMENT
/begin MEASUREMENT StrtCtl_bTraBrkStrtReqCncl "Cancel start request as clutch brake missing" UBYTE B_TRUE 1 100 0.00 1.00000000000 BIT_MASK 0x1 FORMAT "%13.11" ECU_ADDRESS 0x6000A13B /end MEASUREMENT
/begin MEASUREMENT StrtCtl_ctNFaultStrt "Counter fault starts after starter cut off through speed limit" UBYTE OneToOne 1 100 0.00 255.0 FORMAT "%5.1" ECU_ADDRESS 0x600340A9 /end MEASUREMENT
/begin MEASUREMENT StrtCtl_ctStrtReqRst "Counter of requests to continue the start after reset" UBYTE OneToOne 1 100 0.00 255.0 FORMAT "%5.1" ECU_ADDRESS 0x600340A8 /end MEASUREMENT
/begin MEASUREMENT StrtCtl_ctTiFaultStrt "Counter fault starts after starter cut off through time limit" UBYTE OneToOne 1 100 0.00 255.0 FORMAT "%5.1" ECU_ADDRESS 0x600340AA /end MEASUREMENT
/begin MEASUREMENT StrtCtl_facStrtTiIdlMax_MP "percentage of used starter idle operation time to maximim allowed idle operation time" SWORD Fact 1 100 -4.000000 3.999878 FORMAT "%8.6" ECU_ADDRESS 0x70008B92 /end MEASUREMENT
/begin MEASUREMENT StrtCtl_facStrtTiMax_MP "percentage of used starter operation time to maximim allowed operation time" SWORD Fact 1 100 -4.000000 3.999878 FORMAT "%8.6" ECU_ADDRESS 0x70008B90 /end MEASUREMENT
/begin MEASUREMENT StrtCtl_flgBrkDetn "Brake detection flag" UBYTE B_TRUE 1 100 0.00 1.00000000000 BIT_MASK 0x1 FORMAT "%13.11" ECU_ADDRESS 0x6000A13A /end MEASUREMENT
/begin MEASUREMENT StrtCtl_flgEBBDfct "Defective EBB flag" UBYTE B_TRUE 1 100 0.00 1.00000000000 BIT_MASK 0x1 FORMAT "%13.11" ECU_ADDRESS 0x6000A139 /end MEASUREMENT
/begin MEASUREMENT StrtCtl_flgEBBShiftToPReq "Display Shift to P request" UBYTE B_TRUE 1 100 0.00 1.00000000000 BIT_MASK 0x1 FORMAT "%13.11" ECU_ADDRESS 0x6000A138 /end MEASUREMENT
/begin MEASUREMENT StrtCtl_flgEngIrrStop "Engine Irregular stop flag" UBYTE B_TRUE 1 100 0.00 1.00000000000 BIT_MASK 0x1 FORMAT "%13.11" ECU_ADDRESS 0x600062B0 /end MEASUREMENT
/begin MEASUREMENT StrtCtl_flgEngStall "Flag to detect engine stall" UBYTE B_TRUE 1 100 0.00 1.00000000000 BIT_MASK 0x1 FORMAT "%13.11" ECU_ADDRESS 0x6000A135 /end MEASUREMENT
/begin MEASUREMENT StrtCtl_flgEngStrtCmpl "Flag to indicate Engine start completion" UBYTE B_TRUE 1 100 0.00 1.00000000000 BIT_MASK 0x1 FORMAT "%13.11" ECU_ADDRESS 0x6000A134 /end MEASUREMENT
/begin MEASUREMENT StrtCtl_flgEngStrtProhb "Engine start inhibit based on Transmission status for MT vehicles" UBYTE B_TRUE 1 100 0.00 1.00000000000 BIT_MASK 0x1 FORMAT "%13.11" ECU_ADDRESS 0x6000A133 /end MEASUREMENT
/begin MEASUREMENT StrtCtl_flgEngStrtSeq "Engine start sequence" UBYTE B_TRUE 1 100 0.00 1.00000000000 BIT_MASK 0x1 FORMAT "%13.11" ECU_ADDRESS 0x6000A132 /end MEASUREMENT
/begin MEASUREMENT StrtCtl_flgEngStrtSeqCmpl "Engine start sequence complete status flag" UBYTE B_TRUE 1 100 0.00 1.00000000000 BIT_MASK 0x1 FORMAT "%13.11" ECU_ADDRESS 0x6000A131 /end MEASUREMENT
/begin MEASUREMENT StrtCtl_flgEPBAppld "EPB applied status information" UBYTE B_TRUE 1 100 0.00 1.00000000000 BIT_MASK 0x1 FORMAT "%13.11" ECU_ADDRESS 0x6000A137 /end MEASUREMENT
/begin MEASUREMENT StrtCtl_flgEPBIgnOn "Flag to indicate EPB at the first crank after T15 ON" UBYTE B_TRUE 1 100 0.00 1.00000000000 BIT_MASK 0x1 FORMAT "%13.11" ECU_ADDRESS 0x600062BF /end MEASUREMENT
/begin MEASUREMENT StrtCtl_flgEPBOffDetn "Flag to indicate EPB off detection" UBYTE B_TRUE 1 100 0.00 1.00000000000 BIT_MASK 0x1 FORMAT "%13.11" ECU_ADDRESS 0x600062BE /end MEASUREMENT
/begin MEASUREMENT StrtCtl_flgEPBReq "EPB actuation request flag" UBYTE B_TRUE 1 100 0.00 1.00000000000 BIT_MASK 0x1 FORMAT "%13.11" ECU_ADDRESS 0x6000A136 /end MEASUREMENT
/begin MEASUREMENT StrtCtl_flgFirstEngStrt "Flag to indicate first engine start" UBYTE B_TRUE 1 100 0.00 1.00000000000 BIT_MASK 0x1 FORMAT "%13.11" ECU_ADDRESS 0x6000A130 /end MEASUREMENT
/begin MEASUREMENT StrtCtl_flgIgnOnCANDeb "Delay time after T15 ON for receiving all the CAN frames" UBYTE B_TRUE 1 100 0.00 1.00000000000 BIT_MASK 0x1 FORMAT "%13.11" ECU_ADDRESS 0x600062BD /end MEASUREMENT
/begin MEASUREMENT StrtCtl_flgNeutNoPrms_MP "Starter control disable incase of Gear in N + EPB OFF" UBYTE B_TRUE 1 100 0.00 1.00000000000 BIT_MASK 0x1 FORMAT "%13.11" ECU_ADDRESS 0x70008B8E /end MEASUREMENT
/begin MEASUREMENT StrtCtl_flgPShiftLockReq "Flag for Parking shift lock request" UBYTE B_TRUE 1 100 0.00 1.00000000000 BIT_MASK 0x1 FORMAT "%13.11" ECU_ADDRESS 0x6000A12F /end MEASUREMENT
/begin MEASUREMENT StrtCtl_flgRxCrkATDeb_MP "CAN frames reception status after undervoltage reset" UBYTE B_TRUE 1 100 0.00 1.00000000000 BIT_MASK 0x1 FORMAT "%13.11" ECU_ADDRESS 0x70008B8D /end MEASUREMENT
/begin MEASUREMENT StrtCtl_flgSafeEngStrtCdn1 "Conditions for Auto cranking mode 1" UBYTE B_TRUE 1 100 0.00 1.00000000000 BIT_MASK 0x1 FORMAT "%13.11" ECU_ADDRESS 0x600062BC /end MEASUREMENT
/begin MEASUREMENT StrtCtl_flgSafeEngStrtCdn2 "General conditions for cranking mode 2" UBYTE B_TRUE 1 100 0.00 1.00000000000 BIT_MASK 0x1 FORMAT "%13.11" ECU_ADDRESS 0x600062BB /end MEASUREMENT
/begin MEASUREMENT StrtCtl_flgStrtAutCrk "Auto Cranking mode cut condition" UBYTE B_TRUE 1 100 0.00 1.00000000000 BIT_MASK 0x1 FORMAT "%13.11" ECU_ADDRESS 0x600062BA /end MEASUREMENT
/begin MEASUREMENT StrtCtl_flgStrtManCrk "Manual Cranking mode cut condition" UBYTE B_TRUE 1 100 0.00 1.00000000000 BIT_MASK 0x1 FORMAT "%13.11" ECU_ADDRESS 0x600062B9 /end MEASUREMENT
/begin MEASUREMENT StrtCtl_flgStrtReqERTOffDly "Flag to indicate the delayed trigger of start request" UBYTE B_TRUE 1 100 0.00 1.00000000000 BIT_MASK 0x1 FORMAT "%13.11" ECU_ADDRESS 0x600062B8 /end MEASUREMENT
/begin MEASUREMENT StrtCtl_flgSysStrtReq_MP "System start request" UBYTE B_TRUE 1 100 0.00 1.00000000000 BIT_MASK 0x1 FORMAT "%13.11" ECU_ADDRESS 0x70008B8C /end MEASUREMENT
/begin MEASUREMENT StrtCtl_flgT50RstReqTOffD_MP "Delay time to enable continue cranking incase of undervoltage reset" UBYTE B_TRUE 1 100 0.00 1.00000000000 BIT_MASK 0x1 FORMAT "%13.11" ECU_ADDRESS 0x70008B8B /end MEASUREMENT
/begin MEASUREMENT StrtCtl_flgTrsmCdnAT_MP "Engine start inhibit based on Transmission status for non-MT vehicles" UBYTE B_TRUE 1 100 0.00 1.00000000000 BIT_MASK 0x1 FORMAT "%13.11" ECU_ADDRESS 0x70008B8A /end MEASUREMENT
/begin MEASUREMENT StrtCtl_flgVehDrvInhb "Flag for indicating vehicle drive inhibit" UBYTE B_TRUE 1 100 0.00 1.00000000000 BIT_MASK 0x1 FORMAT "%13.11" ECU_ADDRESS 0x6000A12E /end MEASUREMENT
/begin MEASUREMENT StrtCtl_flgVehDrvRdy "Flag for indicating vehicle drive ready" UBYTE B_TRUE 1 100 0.00 1.00000000000 BIT_MASK 0x1 FORMAT "%13.11" ECU_ADDRESS 0x6000A12D /end MEASUREMENT
/begin MEASUREMENT StrtCtl_flgVehRunng "Vehicle running status" UBYTE B_TRUE 1 100 0.00 1.00000000000 BIT_MASK 0x1 FORMAT "%13.11" ECU_ADDRESS 0x6000A12C /end MEASUREMENT
/begin MEASUREMENT StrtCtl_flgVehStPtd "flag to indicate vehicle state judgement" UBYTE B_TRUE 1 100 0.00 1.00000000000 BIT_MASK 0x1 FORMAT "%13.11" ECU_ADDRESS 0x6000A12B /end MEASUREMENT
/begin MEASUREMENT StrtCtl_stAutManCrkCdn "Condition for cranking start: Auto or Manual mode" UBYTE OneToOne 1 100 0.00 255.0 FORMAT "%5.1" ECU_ADDRESS 0x600062B7 /end MEASUREMENT
/begin MEASUREMENT StrtCtl_stClthForStrtReqJdg "the judgment flag of clutch condition for start request" UBYTE B_TRUE 1 100 0.00 1.00000000000 BIT_MASK 0x1 FORMAT "%13.11" ECU_ADDRESS 0x6000A12A /end MEASUREMENT
/begin MEASUREMENT StrtCtl_stCrkEnaAT "Cranking enable for AT" UBYTE B_TRUE 1 100 0.00 1.00000000000 BIT_MASK 0x1 FORMAT "%13.11" ECU_ADDRESS 0x600062B6 /end MEASUREMENT
/begin MEASUREMENT StrtCtl_stCrkEnaIMG "Cranking enable stastus for IMG during Under-voltage reset" UBYTE B_TRUE 1 100 0.00 1.00000000000 BIT_MASK 0x1 FORMAT "%13.11" ECU_ADDRESS 0x600062B5 /end MEASUREMENT
/begin MEASUREMENT StrtCtl_stEngStrtCmplCntr "counter for Engine start complete" ULONG OneToOne 1 100 0.00 4294967295.00 FORMAT "%13.2" ECU_ADDRESS 0x60001338 /end MEASUREMENT
/begin MEASUREMENT StrtCtl_stIdleSpStTiLimHist "Long cranking Detected from starter" UBYTE B_TRUE 1 100 0.00 1.00000000000 BIT_MASK 0x1 FORMAT "%13.11" ECU_ADDRESS 0x6000A129 /end MEASUREMENT
/begin MEASUREMENT StrtCtl_stRstCrkEnaAT_MP "Cranking enable for AT" UBYTE B_TRUE 1 100 0.00 1.00000000000 BIT_MASK 0x1 FORMAT "%13.11" ECU_ADDRESS 0x70008B89 /end MEASUREMENT
/begin MEASUREMENT StrtCtl_stSafeEngStrt "Safe Engine start status" UBYTE B_TRUE 1 100 0.00 1.00000000000 BIT_MASK 0x1 FORMAT "%13.11" ECU_ADDRESS 0x6000A128 /end MEASUREMENT
/begin MEASUREMENT StrtCtl_stShiftN "Actual transmission position for N-range" UBYTE B_TRUE 1 100 0.00 1.00000000000 BIT_MASK 0x1 FORMAT "%13.11" ECU_ADDRESS 0x600062B4 /end MEASUREMENT
/begin MEASUREMENT StrtCtl_stShiftNP "Engine start inhibit based on gear status" UBYTE B_TRUE 1 100 0.00 1.00000000000 BIT_MASK 0x1 FORMAT "%13.11" ECU_ADDRESS 0x600062B3 /end MEASUREMENT
/begin MEASUREMENT StrtCtl_stShiftP "Actual transmission position for P-range" UBYTE B_TRUE 1 100 0.00 1.00000000000 BIT_MASK 0x1 FORMAT "%13.11" ECU_ADDRESS 0x600062B2 /end MEASUREMENT
/begin MEASUREMENT StrtCtl_stStrtCtOff "status of starter cut off conditions" UWORD OneToOne 1 100 0.00 65535.00 FORMAT "%8.2" ECU_ADDRESS 0x60004C5C /end MEASUREMENT
/begin MEASUREMENT StrtCtl_stStrtCtOffMem "Statusbyte for memorized starter cut off condition" UWORD OneToOne 1 100 0.00 65535.00 FORMAT "%8.2" ECU_ADDRESS 0x600035A2 /end MEASUREMENT
/begin MEASUREMENT StrtCtl_stStrtRls "status of release conditions for starter control" UWORD OneToOne 1 100 0.00 65535.00 FORMAT "%8.2" ECU_ADDRESS 0x60004C5A /end MEASUREMENT
/begin MEASUREMENT StrtCtl_stStSpStrtOrdCdn_MP "Condition of engine start order" UBYTE B_TRUE 1 100 0.00 1.00000000000 BIT_MASK 0x1 FORMAT "%13.11" ECU_ADDRESS 0x70008B88 /end MEASUREMENT
/begin MEASUREMENT StrtCtl_tiFuPWait "Fuel pressure waiting time" UWORD t_q0p01 1 100 0.00 655.3500 FORMAT "%8.4" ECU_ADDRESS 0x600035A0 /end MEASUREMENT
/begin MEASUREMENT StrtCtl_tiStrtDly "time of active starter delay" SWORD Time_s 1 100 -327.6800 327.6700 FORMAT "%8.4" ECU_ADDRESS 0x6000359E /end MEASUREMENT
/begin MEASUREMENT StrtCtl_tiStrtOff "Time since starter cut off" SWORD Time_s 1 100 -327.6800 327.6700 FORMAT "%8.4" ECU_ADDRESS 0x60036150 /end MEASUREMENT
/begin MEASUREMENT StrtCtl_tiStrtOn "Time since starter switch on" SWORD Time_s 1 100 -327.6800 327.6700 FORMAT "%8.4" ECU_ADDRESS 0x600340AC /end MEASUREMENT
/begin MEASUREMENT StrtCtl_tiStrtOnIdl "Time of starter operation in idle" SWORD Time_s 1 100 -327.6800 327.6700 FORMAT "%8.4" ECU_ADDRESS 0x6000359C /end MEASUREMENT
/begin MEASUREMENT StrtCtl_tiStrtOrd "time of active start order" SWORD Time_s 1 100 -327.6800 327.6700 FORMAT "%8.4" ECU_ADDRESS 0x6000359A /end MEASUREMENT
/begin MEASUREMENT StrtCtl_tiT50 "time of active start request T50" SWORD Time_s 1 100 -327.6800 327.6700 FORMAT "%8.4" ECU_ADDRESS 0x60003598 /end MEASUREMENT
/begin MEASUREMENT StrtCtl_vEBBVehSpd "Vehicle speed for judgement of EBB" SWORD Vel 1 100 -327.6800 327.6700 FORMAT "%8.4" ECU_ADDRESS 0x60004F06 /end MEASUREMENT
/begin MEASUREMENT Strt_bImobChk_mp "Measuring point for signal quality check of immobilizer lock status and SCS" UBYTE B_TRUE 1 100 0.00 1.00000000000 BIT_MASK 0x1 FORMAT "%13.11" ECU_ADDRESS 0x70008B84 /end MEASUREMENT
/begin MEASUREMENT Strt_bLckJudgActv_mp "Activation status of starter lock judgment" UBYTE B_TRUE 1 100 0.00 1.00000000000 BIT_MASK 0x1 FORMAT "%13.11" ECU_ADDRESS 0x70008B83 /end MEASUREMENT
/begin MEASUREMENT Strt_bLckT1Elpsd_mp "Status indicating that lock judgment timer1 elapsed." UBYTE B_TRUE 1 100 0.00 1.00000000000 BIT_MASK 0x1 FORMAT "%13.11" ECU_ADDRESS 0x70008B82 /end MEASUREMENT
/begin MEASUREMENT Strt_bLckT2Elpsd_mp "Status indicating that lock judgment timer2 elapsed." UBYTE B_TRUE 1 100 0.00 1.00000000000 BIT_MASK 0x1 FORMAT "%13.11" ECU_ADDRESS 0x70008B81 /end MEASUREMENT
/begin MEASUREMENT Strt_bPsShOffSeq_mp "Change order of powerstage cut off" UBYTE B_TRUE 1 100 0.00 1.00000000000 BIT_MASK 0x1 FORMAT "%13.11" ECU_ADDRESS 0x70008B80 /end MEASUREMENT
/begin MEASUREMENT Strt_bStmDiaBre_mp "State of the start diagnosis" UBYTE B_TRUE 1 100 0.00 1.00000000000 BIT_MASK 0x1 FORMAT "%13.11" ECU_ADDRESS 0x600062AF /end MEASUREMENT
/begin MEASUREMENT Strt_bStrtDia "Requirements for the diagnosis are fulfilled" UBYTE B_TRUE 1 100 0.00 1.00000000000 BIT_MASK 0x1 FORMAT "%13.11" ECU_ADDRESS 0x7000012D /end MEASUREMENT
/begin MEASUREMENT Strt_cntrContnsRstrtIntlSho "Short interval counter for less than 4min for 4th cranking after successive 3 times" UBYTE OneToOne 1 100 0.00 255.0 FORMAT "%5.1" ECU_ADDRESS 0x6000A2F2 /end MEASUREMENT
/begin MEASUREMENT Strt_cntrContnsStaActv "Successive 3 times counter" UBYTE OneToOne 1 100 0.00 255.0 FORMAT "%5.1" ECU_ADDRESS 0x6000A2F1 /end MEASUREMENT
/begin MEASUREMENT Strt_cntrRstrtIntlSho "Short interval counter for less than 30sec after clanking 10sec" UBYTE OneToOne 1 100 0.00 255.0 FORMAT "%5.1" ECU_ADDRESS 0x6000A2F0 /end MEASUREMENT
/begin MEASUREMENT Strt_cntrStaActv "10s continuous cranking counter" UBYTE OneToOne 1 100 0.00 255.0 FORMAT "%5.1" ECU_ADDRESS 0x6000A2EF /end MEASUREMENT
/begin MEASUREMENT Strt_cntStaRlyTot "Counter variable for starter relay" ULONG OneToOne 1 100 0.00 4294967295.00 FORMAT "%13.2" ECU_ADDRESS 0x60001318 /end MEASUREMENT
/begin MEASUREMENT Strt_cntTotRlyOper "Counter for starter relay message" ULONG OneToOne 1 100 0.00 4294967295.00 FORMAT "%13.2" ECU_ADDRESS 0x50004D50 /end MEASUREMENT
/begin MEASUREMENT Strt_cntTotRlyOper1 "First nibble of starter relay counter" UBYTE OneToOne 1 100 0.00 255.0 FORMAT "%5.1" ECU_ADDRESS 0x6000A2F6 /end MEASUREMENT
/begin MEASUREMENT Strt_cntTotRlyOper2 "second nibble of starter relay counter" UBYTE OneToOne 1 100 0.00 255.0 FORMAT "%5.1" ECU_ADDRESS 0x6000A2F5 /end MEASUREMENT
/begin MEASUREMENT Strt_cntTotRlyOper3 "Third nibble of starter relay counter" UBYTE OneToOne 1 100 0.00 255.0 FORMAT "%5.1" ECU_ADDRESS 0x6000A2F4 /end MEASUREMENT
/begin MEASUREMENT Strt_cntTotRlyOper4 "Fourth nibble of starter relay counter" UBYTE OneToOne 1 100 0.00 255.0 FORMAT "%5.1" ECU_ADDRESS 0x6000A2F3 /end MEASUREMENT
/begin MEASUREMENT Strt_ctCaSEdg_mp "Number of the edges in the camshaft" UWORD OneToOne 1 100 0.00 65535.00 FORMAT "%8.2" ECU_ADDRESS 0x70008B7E /end MEASUREMENT
/begin MEASUREMENT Strt_ctStopEngDC "Number changed starter status from OFF to ON in current DC" UWORD OneToOne 1 100 0.00 65535.00 FORMAT "%8.2" ECU_ADDRESS 0x60004C58 /end MEASUREMENT
/begin MEASUREMENT Strt_ctStopEngTot "Total number of changed starter status over DC" ULONG OneToOne 1 100 0.00 4294967295.00 FORMAT "%13.2" ECU_ADDRESS 0x60001C54 /end MEASUREMENT
/begin MEASUREMENT Strt_ctStopEngTot1 "Total number of changed starter status over DC" UBYTE OneToOne 1 100 0.00 255.0 FORMAT "%5.1" ECU_ADDRESS 0x6000A2EE /end MEASUREMENT
/begin MEASUREMENT Strt_ctStopEngTot2 "Total number of changed starter status over DC" UBYTE OneToOne 1 100 0.00 255.0 FORMAT "%5.1" ECU_ADDRESS 0x6000A2ED /end MEASUREMENT
/begin MEASUREMENT Strt_ctStopEngTot3 "Total number of changed starter status over DC" UBYTE OneToOne 1 100 0.00 255.0 FORMAT "%5.1" ECU_ADDRESS 0x6000A2EC /end MEASUREMENT
/begin MEASUREMENT Strt_ctStopEngTot4 "Total number of changed starter status over DC" UBYTE OneToOne 1 100 0.00 255.0 FORMAT "%5.1" ECU_ADDRESS 0x6000A2EB /end MEASUREMENT
/begin MEASUREMENT Strt_flgRstrtIntl "Flag indicating the occurrence of a 10s continuous cranking and next cranking within a period of threshold value of 30s." UBYTE B_TRUE 1 100 0.00 1.00000000000 BIT_MASK 0x1 FORMAT "%13.11" ECU_ADDRESS 0x7000067F /end MEASUREMENT
/begin MEASUREMENT Strt_flgStop "Flag indicating the non-occurrence of continuous long cranking within a threshold period" UBYTE B_TRUE 1 100 0.00 1.00000000000 BIT_MASK 0x1 FORMAT "%13.11" ECU_ADDRESS 0x7000067E /end MEASUREMENT
/begin MEASUREMENT Strt_st "Status activation starter relay" UBYTE OneToOne 1 100 0.00 255.0 FORMAT "%5.1" ECU_ADDRESS 0x6000A2EA /end MEASUREMENT
/begin MEASUREMENT Strt_stLckJudg "Status of lock determination" UBYTE B_TRUE 1 100 0.00 1.00000000000 BIT_MASK 0x1 FORMAT "%13.11" ECU_ADDRESS 0x6000A125 /end MEASUREMENT
/begin MEASUREMENT Strt_stLckJudg1 "Status of lock1 determination" UBYTE B_TRUE 1 100 0.00 1.00000000000 BIT_MASK 0x1 FORMAT "%13.11" ECU_ADDRESS 0x6000A127 /end MEASUREMENT
/begin MEASUREMENT Strt_stLckJudg2 "Status of lock2 determination" UBYTE B_TRUE 1 100 0.00 1.00000000000 BIT_MASK 0x1 FORMAT "%13.11" ECU_ADDRESS 0x6000A126 /end MEASUREMENT
/begin MEASUREMENT Strt_stOL "Error status: open load" ULONG OneToOne 1 100 0.00 4294967295.00 FORMAT "%13.2" ECU_ADDRESS 0x60001334 /end MEASUREMENT
/begin MEASUREMENT Strt_stOL2 "Error status: open load 2" ULONG OneToOne 1 100 0.00 4294967295.00 FORMAT "%13.2" ECU_ADDRESS 0x60001330 /end MEASUREMENT
/begin MEASUREMENT Strt_stPs "The output of the starter to the powerstage" UBYTE OneToOne 1 100 0.00 255.0 FORMAT "%5.1" ECU_ADDRESS 0x6000E430 /end MEASUREMENT
/begin MEASUREMENT Strt_stPsRet "Start output stage active" UBYTE OneToOne 1 100 0.00 255.0 FORMAT "%5.1" ECU_ADDRESS 0x6000A2E9 /end MEASUREMENT
/begin MEASUREMENT Strt_stSCB "Error Status: short to battery" ULONG OneToOne 1 100 0.00 4294967295.00 FORMAT "%13.2" ECU_ADDRESS 0x6000132C /end MEASUREMENT
/begin MEASUREMENT Strt_stSCB2 "Error status: short to battery 2" ULONG OneToOne 1 100 0.00 4294967295.00 FORMAT "%13.2" ECU_ADDRESS 0x60001328 /end MEASUREMENT
/begin MEASUREMENT Strt_stSCG "Error status: short to ground" ULONG OneToOne 1 100 0.00 4294967295.00 FORMAT "%13.2" ECU_ADDRESS 0x60001324 /end MEASUREMENT
/begin MEASUREMENT Strt_stSCG2 "Error status: short to ground 2" ULONG OneToOne 1 100 0.00 4294967295.00 FORMAT "%13.2" ECU_ADDRESS 0x60001320 /end MEASUREMENT
/begin MEASUREMENT Strt_stStaActv "State pinion starter active" UBYTE OneToOne 1 100 0.00 255.0 FORMAT "%5.1" ECU_ADDRESS 0x70002D91 /end MEASUREMENT
/begin MEASUREMENT Strt_stStaActvDly "Status indicating the occurrence of continuous long cranking" UBYTE B_TRUE 1 100 0.00 1.00000000000 BIT_MASK 0x1 FORMAT "%13.11" ECU_ADDRESS 0x600062AC /end MEASUREMENT
/begin MEASUREMENT Strt_stStmErrInfo_mp "Error status starter module" UWORD OneToOne 1 100 0.00 65535.00 FORMAT "%8.2" ECU_ADDRESS 0x70008B86 /end MEASUREMENT
/begin MEASUREMENT Strt_stStmFault "Error status hardware or communication" ULONG OneToOne 1 100 0.00 4294967295.00 FORMAT "%13.2" ECU_ADDRESS 0x6000131C /end MEASUREMENT
/begin MEASUREMENT Strt_stTstrActv "The status of tester demand for updating the starter related EEPROM data" UBYTE OneToOne 1 100 0.00 255.0 FORMAT "%5.1" ECU_ADDRESS 0x6000A2E8 /end MEASUREMENT
/begin MEASUREMENT Strt_tiStaActv_MP "Measuring point to indicate the output of the 10s cranking timer" SWORD Time_s 1 100 -327.6800 327.6700 FORMAT "%8.4" ECU_ADDRESS 0x70008B7C /end MEASUREMENT
/begin MEASUREMENT Strt_tiStopIntl_MP "Measuring point to indicate the starter OFF time" SWORD Time_s 1 100 -327.6800 327.6700 FORMAT "%8.4" ECU_ADDRESS 0x70008B7A /end MEASUREMENT
/begin MEASUREMENT Strt_uStrtMonDia "Starter voltage" UWORD Volt 1 100 0.00 13107.00 FORMAT "%8.2" ECU_ADDRESS 0x60004C56 /end MEASUREMENT
/begin MEASUREMENT StSpSwt_st "Status of Start Stop Switch" UBYTE OneToOne 1 100 0.00 255.0 FORMAT "%5.1" ECU_ADDRESS 0x6000A2FB /end MEASUREMENT
/begin MEASUREMENT StSpSwt_stRaw "Status of the Raw digital Start Stop pushswitch." UBYTE OneToOne 1 100 0.00 255.0 FORMAT "%5.1" ECU_ADDRESS 0x6000A2FA /end MEASUREMENT
/begin MEASUREMENT StSpSwt_stSelTyp "Staus of StartStop switch status" UBYTE OneToOne 1 100 0.00 255.0 FORMAT "%5.1" ECU_ADDRESS 0x6000A2F9 /end MEASUREMENT
/begin MEASUREMENT StSpSwt_stStrd "Stored value of Start Stop switch status" UBYTE OneToOne 1 100 0.00 255.0 FORMAT "%5.1" ECU_ADDRESS 0x6000A2F8 /end MEASUREMENT
/begin MEASUREMENT SyC_ctDrvEnter "Global drive cycle counter which is incremented when system state DRIVE is entered" UBYTE OneToOne 1 100 0.00 255.0 FORMAT "%5.1" ECU_ADDRESS 0x50005DC2 /end MEASUREMENT
/begin MEASUREMENT SyC_ctIrrSwOff "Counter for detection of irregular switch-off of the ECU" UBYTE OneToOne 1 100 0.00 255.0 FORMAT "%5.1" ECU_ADDRESS 0x6000A6F0 /end MEASUREMENT
/begin MEASUREMENT SyC_ctPostDrvLeave "Global drive cycle counter which is incremented when system state leaves post drive" UBYTE OneToOne 1 100 0.00 255.0 FORMAT "%5.1" ECU_ADDRESS 0x50005DC3 /end MEASUREMENT
/begin MEASUREMENT SyC_stHistTiPostDrvMax "State of the last time exceedings in PostDrive" UBYTE OneToOne 1 100 0.00 255.0 FORMAT "%5.1" ECU_ADDRESS 0x6000A2E7 /end MEASUREMENT
/begin MEASUREMENT SyC_stMn "Current system/ECU state" UBYTE ExeCon_State_01 1 100 0.00 3.00000000000 FORMAT "%13.11" ECU_ADDRESS 0x6000A6EF /end MEASUREMENT
/begin MEASUREMENT SyC_stMnOld "Previous system/ECU state" UBYTE ExeCon_State_01 1 100 0.00 3.00000000000 FORMAT "%13.11" ECU_ADDRESS 0x6000A6EE /end MEASUREMENT
/begin MEASUREMENT SyC_stPostDrv "PostDrive control state" UBYTE SyC_PostDrv_State 1 100 0.00 8.00000000000 FORMAT "%13.11" ECU_ADDRESS 0x70002D93 /end MEASUREMENT
/begin MEASUREMENT SyC_stPostDrvDel "post-drive delay request" UBYTE OneToOne 1 100 0.00 255.0 FORMAT "%5.1" ECU_ADDRESS 0x6000A6D8 /end MEASUREMENT
/begin MEASUREMENT SyC_stPreDrv "PreDrive control state" UBYTE SyC_PreDrv_State 1 100 0.00 9.00000000000 FORMAT "%13.11" ECU_ADDRESS 0x6000A6ED /end MEASUREMENT
/begin MEASUREMENT SyC_stPreDrvDel "Variable to check if predrive is prolonged or not" UBYTE OneToOne 1 100 0.00 255.0 FORMAT "%5.1" ECU_ADDRESS 0x70002D94 /end MEASUREMENT
/begin MEASUREMENT SyC_stSub "Current system/ECU sub-state" UBYTE ExeCon_State_02 1 100 0.00 6.00000000000 FORMAT "%13.11" ECU_ADDRESS 0x50005DC4 /end MEASUREMENT
/begin MEASUREMENT SyC_stSubOld "Previous system/ECU sub-state" UBYTE ExeCon_State_02 1 100 0.00 6.00000000000 FORMAT "%13.11" ECU_ADDRESS 0x50005DC5 /end MEASUREMENT
/begin MEASUREMENT SyC_stSwtOn_mp "Status current reason for switching-on ECU" UBYTE OneToOne 1 100 0.00 255.0 FORMAT "%5.1" ECU_ADDRESS 0x700089CB /end MEASUREMENT
/begin MEASUREMENT SyC_stVldTiEcuOff "ECU off time valid" UBYTE OneToOne 1 100 0.00 255.0 BIT_MASK 0x1 FORMAT "%5.1" ECU_ADDRESS 0x6000A6D7 /end MEASUREMENT
/begin MEASUREMENT SyC_tiBoot_mp "Time from ECU switch-on until system state SYC_INI is reached" ULONG Time_usec_q1_COMPU 1 100 0.00 4294967295.00 FORMAT "%13.2" ECU_ADDRESS 0x70008608 /end MEASUREMENT
/begin MEASUREMENT SyC_tiDrv "Time since state SYC_DRIVE was reached" ULONG Time_msec_q10_COMPU 1 100 0.00 42949672950.0 FORMAT "%13.1" ECU_ADDRESS 0x6000D734 /end MEASUREMENT
/begin MEASUREMENT SyC_tiEcuOff "ECU off time" SLONG Time_sec_q1_COMPU 1 100 -2147483648.00 2147483647.00 FORMAT "%13.2" ECU_ADDRESS 0x6000D73C /end MEASUREMENT
/begin MEASUREMENT SyC_tiFrst10ms "Time from ECU boot until the first 10ms task" UWORD Time_msec_q1_COMPU 1 100 0.00 65535.00 FORMAT "%8.2" ECU_ADDRESS 0x6000531A /end MEASUREMENT
/begin MEASUREMENT SyC_tiIniEnd_mp "Duration of system state SYC_INIEND" UWORD Time_usec_q1_COMPU 1 100 0.00 65535.00 FORMAT "%8.2" ECU_ADDRESS 0x700087CA /end MEASUREMENT
/begin MEASUREMENT SyC_tiIniSyn_mp "Duration of system state SYC_INISYN" UWORD Time_usec_q1_COMPU 1 100 0.00 65535.00 FORMAT "%8.2" ECU_ADDRESS 0x700087C8 /end MEASUREMENT
/begin MEASUREMENT SyC_tiIni_mp "Duration of system state SYC_INI" ULONG Time_usec_q1_COMPU 1 100 0.00 4294967295.00 FORMAT "%13.2" ECU_ADDRESS 0x70008604 /end MEASUREMENT
/begin MEASUREMENT SyC_tiPostDrv "Time since state SYC_POSTDRIVE was reached" ULONG Time_msec_q10_COMPU 1 100 0.00 42949672950.0 FORMAT "%13.1" ECU_ADDRESS 0x50004D58 /end MEASUREMENT
/begin MEASUREMENT SyC_tiPreDrv "Time since state SYC_PREDRIVE was reached" ULONG Time_msec_q10_COMPU 1 100 0.00 42949672950.0 FORMAT "%13.1" ECU_ADDRESS 0x50004D5C /end MEASUREMENT
/begin MEASUREMENT SysDiag_flgAppPressed "Flag for APP pressed in test coordinator" UBYTE B_TRUE 1 100 0.00 1.00000000000 BIT_MASK 0x1 FORMAT "%13.11" ECU_ADDRESS 0x6000A124 /end MEASUREMENT
/begin MEASUREMENT SysDiag_flgCModJdg "Sysdiag Judgment mode state" UBYTE B_TRUE 1 100 0.00 1.00000000000 BIT_MASK 0x1 FORMAT "%13.11" ECU_ADDRESS 0x6000A123 /end MEASUREMENT
/begin MEASUREMENT SysDiag_flgComErr "SysDiag flag com error" UBYTE B_TRUE 1 100 0.00 1.00000000000 BIT_MASK 0x1 FORMAT "%13.11" ECU_ADDRESS 0x6000A122 /end MEASUREMENT
/begin MEASUREMENT SysDiag_flgModInhb "Inhibit state" UBYTE B_TRUE 1 100 0.00 1.00000000000 BIT_MASK 0x1 FORMAT "%13.11" ECU_ADDRESS 0x6000A121 /end MEASUREMENT
/begin MEASUREMENT SysDiag_flgStCANRx "SysDiag flag for CAN receive" UBYTE B_TRUE 1 100 0.00 1.00000000000 BIT_MASK 0x1 FORMAT "%13.11" ECU_ADDRESS 0x6000A120 /end MEASUREMENT
/begin MEASUREMENT SysDiag_flgTiCMod "Duration limit for Certification mode calculation" UBYTE B_TRUE 1 100 0.00 1.00000000000 BIT_MASK 0x1 FORMAT "%13.11" ECU_ADDRESS 0x6000A11F /end MEASUREMENT
/begin MEASUREMENT SysDiag_nrAppUpDwnCnt1 "Accelerator pedal Pressed and released count1" UBYTE OneToOne 1 100 0.00 255.0 FORMAT "%5.1" ECU_ADDRESS 0x6000A2E6 /end MEASUREMENT
/begin MEASUREMENT SysDiag_nrAppUpDwnCnt2 "Accelerator pedal Pressed and released count2" UBYTE OneToOne 1 100 0.00 255.0 FORMAT "%5.1" ECU_ADDRESS 0x6000A2E5 /end MEASUREMENT
/begin MEASUREMENT SysDiag_nrAppUpDwnCnt3 "Accelerator pedal Pressed and released count3" UBYTE OneToOne 1 100 0.00 255.0 FORMAT "%5.1" ECU_ADDRESS 0x6000A2E4 /end MEASUREMENT
/begin MEASUREMENT SysDiag_nrBrkUpDwnCnt "Brk Count" UBYTE OneToOne 1 100 0.00 255.0 FORMAT "%5.1" ECU_ADDRESS 0x6000A2E3 /end MEASUREMENT
/begin MEASUREMENT SysDiag_stGearLvr "SysDiag status of gear level" UBYTE OneToOne 1 100 0.00 255.0 FORMAT "%5.1" ECU_ADDRESS 0x6000A2E2 /end MEASUREMENT
/begin MEASUREMENT SysDiag_stGearLvrOld "SysDiag status of old gear level" UBYTE OneToOne 1 100 0.00 255.0 FORMAT "%5.1" ECU_ADDRESS 0x60006293 /end MEASUREMENT
/begin MEASUREMENT SysDiag_stLvrSet "SysDiag status gear lever set" UBYTE B_TRUE 1 100 0.00 1.00000000000 BIT_MASK 0x1 FORMAT "%13.11" ECU_ADDRESS 0x6000A11E /end MEASUREMENT
/begin MEASUREMENT SysDiag_stOldClth3st "Clth3st old status" UBYTE OneToOne 1 100 0.00 255.0 FORMAT "%5.1" ECU_ADDRESS 0x60006292 /end MEASUREMENT
/begin MEASUREMENT SysDiag_stT15 "Sysdiag T15-On state" UBYTE B_TRUE 1 100 0.00 1.00000000000 BIT_MASK 0x1 FORMAT "%13.11" ECU_ADDRESS 0x60006291 /end MEASUREMENT
/begin MEASUREMENT SysDiag_stTestMod "test mode" UBYTE OneToOne 1 100 0.00 255.0 FORMAT "%5.1" ECU_ADDRESS 0x6000A2E1 /end MEASUREMENT
/begin MEASUREMENT tandk_w_msg "air temperature downstream Throttle valve" UWORD temp_q0p0234_o273 1 100 -273.150 1262.827 FORMAT "%8.3" ECU_ADDRESS 0x60004BAE /end MEASUREMENT
/begin MEASUREMENT tans "intake air temperature" UBYTE temp_ub_q0p75_o48 1 100 -48.0 143.3 FORMAT "%5.1" ECU_ADDRESS 0x6000A288 /end MEASUREMENT
/begin MEASUREMENT tansst_msg "Intake air temperature at cranking" UBYTE temp_ub_q0p75_o48 1 100 -48.0 143.3 FORMAT "%5.1" ECU_ADDRESS 0x6000A285 /end MEASUREMENT
/begin MEASUREMENT tateout_w "output duty cycle for canister purge valve (16 bit)" UWORD rel_q0p00153 1 100 0.00 99.99847 FORMAT "%8.5" ECU_ADDRESS 0x60004BAC /end MEASUREMENT
/begin MEASUREMENT temp_AirSys_tFld "" UBYTE OneToOne 1 100 0.00 255.0 FORMAT "%5.1" ECU_ADDRESS 0x600062A9 /end MEASUREMENT
/begin MEASUREMENT TiOff_stTiStrtEndOffVW "off time of start-end recognition for customer" UBYTE OneToOne 1 100 0.00 255.0 FORMAT "%5.1" ECU_ADDRESS 0x6000A005 /end MEASUREMENT
/begin MEASUREMENT tmot "Engine temperature" UBYTE temp_ub_q0p75_o48 1 100 -48.0 143.3 FORMAT "%5.1" ECU_ADDRESS 0x6000A282 /end MEASUREMENT
/begin MEASUREMENT tmottstr_w "Coolant Engine Temperature for PID-Service" UWORD temp_q0p0234_o273 1 100 -273.150 1262.827 FORMAT "%8.3" ECU_ADDRESS 0x60004B9E /end MEASUREMENT
/begin MEASUREMENT tmst "engine temperature at start" UBYTE temp_ub_q0p75_o48 1 100 -48.0 143.3 FORMAT "%5.1" ECU_ADDRESS 0x6000A281 /end MEASUREMENT
/begin MEASUREMENT tnachl_w_msg "time of ECU switch off delay" UWORD t100msxs_uw_b6553p6 1 100 0.00 6553.500 FORMAT "%8.3" ECU_ADDRESS 0x60037F06 /end MEASUREMENT
/begin MEASUREMENT toch "oil temperature in cylinder head" UBYTE temp_ub_q0p75_o48 1 100 -48.0 143.3 FORMAT "%5.1" ECU_ADDRESS 0x6000A280 /end MEASUREMENT
/begin MEASUREMENT tolc_msg "oil temperature from combi or from COWIV" UBYTE temp_ub_q1_o60 1 100 -60.0 195.0 FORMAT "%5.1" ECU_ADDRESS 0x60009FE1 /end MEASUREMENT
/begin MEASUREMENT Tra_bCANErrMax "Priority of speed limitation in case of CAN errors" UBYTE B_TRUE 1 100 0.00 1.00000000000 BIT_MASK 0x1 FORMAT "%13.11" ECU_ADDRESS 0x6000011C /end MEASUREMENT
/begin MEASUREMENT Tra_nPrdcInpN "Predicted rotational speed after gearbox intervention" SWORD EngN 1 100 -16384.00 16383.50 FORMAT "%8.2" ECU_ADDRESS 0x60004EEE /end MEASUREMENT
/begin MEASUREMENT Tra_numGearDisp "Actual gear number display" SBYTE OneToOne 1 100 -128.0 127.0 FORMAT "%5.1" ECU_ADDRESS 0x6000A6CD /end MEASUREMENT
/begin MEASUREMENT Tra_stEngStop "The status of the engine stalling judge" UBYTE OneToOne 1 100 0.00 255.0 FORMAT "%5.1" ECU_ADDRESS 0x6000A2D8 /end MEASUREMENT
/begin MEASUREMENT TrsmEmac_ratElmTrsm "Transmission ratio of electric machine" SWORD TransR 1 100 -327.6800 327.6700 FORMAT "%8.4" ECU_ADDRESS 0x60004EAC /end MEASUREMENT
/begin MEASUREMENT TWCD_bEnaOSCB1 "Condition OSC Measurement enabled, bank 1" UBYTE B_TRUE 1 100 0.00 1.00000000000 BIT_MASK 0x1 FORMAT "%13.11" ECU_ADDRESS 0x70000649 /end MEASUREMENT
/begin MEASUREMENT TWCD_bFinOSCMeasB1 "Condition OSC measurement finished, bank 1" UBYTE B_TRUE 1 100 0.00 1.00000000000 BIT_MASK 0x1 FORMAT "%13.11" ECU_ADDRESS 0x70000648 /end MEASUREMENT
/begin MEASUREMENT VehMot_tqCluDesGenericLimn "Extended generic limitation on des path" SWORD Trq 1 100 -3276.800 3276.700 FORMAT "%8.3" ECU_ADDRESS 0x60004E04 /end MEASUREMENT
/begin MEASUREMENT VehMot_tqCluGenericLim "Generic torque limitation at clutch level" SWORD Trq 1 100 -3276.800 3276.700 FORMAT "%8.3" ECU_ADDRESS 0x6000494A /end MEASUREMENT
/begin MEASUREMENT VehMot_tqCluLeadGenericLimn "Extended generic limitation on lead path (consist of engine torque only)" SWORD Trq 1 100 -3276.800 3276.700 FORMAT "%8.3" ECU_ADDRESS 0x60004E02 /end MEASUREMENT
/begin MEASUREMENT VehMot_trqDes "Desired torque for propulsion (transmission output torque)" SLONG TrqPrpHigh 1 100 -214748364.800 214748364.700 FORMAT "%13.3" ECU_ADDRESS 0x60001BEC /end MEASUREMENT
/begin MEASUREMENT VehMot_trqDesAcs "Required Torque of Vehicle Motion acsessories" SWORD Trq 1 100 -3276.800 3276.700 FORMAT "%8.3" ECU_ADDRESS 0x60004E00 /end MEASUREMENT
/begin MEASUREMENT VehMot_trqPrtDfftl "Differential protection torque" SLONG TrqPrpHigh 1 100 -214748364.800 214748364.700 FORMAT "%13.3" ECU_ADDRESS 0x50004E04 /end MEASUREMENT
/begin MEASUREMENT VehPos_rIncIX "Road Resistance Index information from Gearbox ECU" SWORD PrcHigh 1 100 -32.76800 32.76700 FORMAT "%8.5" ECU_ADDRESS 0x60004DFE /end MEASUREMENT
/begin MEASUREMENT VehV_flgStandStill "Standstill detection condition" UBYTE B_TRUE 1 100 0.00 1.00000000000 BIT_MASK 0x1 FORMAT "%13.11" ECU_ADDRESS 0x6000011B /end MEASUREMENT
/begin MEASUREMENT WaHt_flgHeatrRiseReq "Flag to enable the water temperature rise demand request." UBYTE B_TRUE 1 100 0.00 1.00000000000 BIT_MASK 0x1 FORMAT "%13.11" ECU_ADDRESS 0x7000059E /end MEASUREMENT
/begin MEASUREMENT WaHt_tDeltaEngT "Delta Engine temperature" SWORD Temp_Cels 1 100 -3549.940 3003.560 FORMAT "%8.3" ECU_ADDRESS 0x60004DE6 /end MEASUREMENT
/begin MEASUREMENT wdks_w "desired throttle angle w.r.t. to lower mechanical stop" UWORD relDK_uw_b100 1 100 0.00 100.0000 FORMAT "%8.4" ECU_ADDRESS 0x600006C2 /end MEASUREMENT
/begin MEASUREMENT wessbm_msg "angle: intake valve closes late until reference mark" UBYTE kw_q2p8125 1 100 0.00 717.2 FORMAT "%5.1" ECU_ADDRESS 0x60009FDC /end MEASUREMENT
/begin MEASUREMENT wgvohsme_w_msg "Average value: des. angle gas exch. valve opens intake hom.mode" SWORD kw_q0p0156 1 100 -512.0000 511.9844 FORMAT "%8.4" ECU_ADDRESS 0x60004930 /end MEASUREMENT
/begin MEASUREMENT wgvshsme_w_msg "Av.value: des. angle gas exch. valve closes intake hom.mode" SWORD kw_q0p0156 1 100 -512.0000 511.9844 FORMAT "%8.4" ECU_ADDRESS 0x6000492E /end MEASUREMENT
/begin MEASUREMENT wkratst "wkra updated with synchro" SBYTE kw_q0p75 1 100 -96.00 95.25 FORMAT "%5.2" ECU_ADDRESS 0x6000A6C6 /end MEASUREMENT
/begin MEASUREMENT wnwve_w_msg "NW-adjustment angle (intake)" SWORD kw_q0p0078 1 100 -256.0000 255.9922 FORMAT "%8.4" ECU_ADDRESS 0x60004DBA /end MEASUREMENT
/begin MEASUREMENT wnwvu_w_msg "Overlap angle intake and exhaust camshaft only by adj." UWORD kw_q0p0078 1 100 0.00 511.9922 FORMAT "%8.4" ECU_ADDRESS 0x60004B94 /end MEASUREMENT
/begin MEASUREMENT wped_w "normalized angle acceleration pedal" UWORD relPED_q0p00153 1 100 0.00 100.0000 FORMAT "%8.4" ECU_ADDRESS 0x60004B92 /end MEASUREMENT
/begin MEASUREMENT wtacvol_w "Row voltage value of AC volume temperature over ADC" UWORD spg_uw_q0p00488 1 100 0.00 319.9951 FORMAT "%8.4" ECU_ADDRESS 0x60004B8E /end MEASUREMENT
/begin MEASUREMENT zwist "real ignition angle" SBYTE kw_q0p75 1 100 -96.00 95.25 FORMAT "%5.2" ECU_ADDRESS 0x6000A6C5 /end MEASUREMENT
/begin MEASUREMENT zzbank_msg "cylinder allocation to exhaust banks" UBYTE dez 1 100 0.00 255.0 FORMAT "%5.1" ECU_ADDRESS 0x60009FDB /end MEASUREMENT
/begin MEASUREMENT zzylzue_msg "SW-cylinder counter for ignition calculation" UBYTE dez 1 100 0.00 11.00 FORMAT "%5.2" ECU_ADDRESS 0x70001C00 /end MEASUREMENT
/begin FUNCTION StrtCtl_StA "74.3.0_1.2.0Starter Control for Automatic Start"
 /begin DEF_CHARACTERISTIC StrtCtl_ctFaultStrtLim_C StrtCtl_flgDiEPBCdn_C StrtCtl_nEngSpdThd_C StrtCtl_nEngStallThd_C StrtCtl_nStrtActv_C StrtCtl_nStrtIdl_C StrtCtl_nStrtRlsMax_C StrtCtl_nThresStrtCtOff_MAP StrtCtl_stIMG_C StrtCtl_stNFaultStrt_Msk StrtCtl_stNPosnEnaForBit13_C StrtCtl_stStA_CW StrtCtl_stStrtCutOffMsk_C StrtCtl_stStrtRls_Msk StrtCtl_stStSpStrtRls_Msk StrtCtl_stSyncStrtOff_C StrtCtl_stTiFaultStrt_Msk StrtCtl_stTraBrk_CW StrtCtl_tiAutoStrtRls_C StrtCtl_tiCanFailrDetnDly_C StrtCtl_tiCnclStrtReqDeb_C StrtCtl_tiComNPDly_C StrtCtl_tiDlyStrtCtOffV_C StrtCtl_tiEngStallThd_C StrtCtl_tiEPBActtnReqDlyElpd_C StrtCtl_tiFuPWait_C StrtCtl_tiIdleSpStCmftMax_C StrtCtl_tiIgnOnCANDeb_C StrtCtl_tiIgnOnDeb_C StrtCtl_tiManStrtOnDly_C StrtCtl_tiNMaxDeb_C StrtCtl_tiNZeroDeb_C StrtCtl_tiPanicStrtReq_C StrtCtl_tiPushBtnStrtCmft_T StrtCtl_tiStrtActv_C StrtCtl_tiStrtCmftMax_CUR StrtCtl_tiStrtDlyMax_C StrtCtl_tiStrtDlyMin_C StrtCtl_tiStrtOffMin_C StrtCtl_tiStrtOnMin_C StrtCtl_tiStrtOpPanicMax_MAP StrtCtl_tiStrtOrdMax_C StrtCtl_tiStrtPwrIdlMax_C StrtCtl_tiStrtPwrMax_CUR StrtCtl_tiStrtReqRstDly_C StrtCtl_tiStrtReqTCUDlyIMG_C StrtCtl_tiStrtReqValDeb_C StrtCtl_tiStrtRlsDly_C StrtCtl_uAutCrkInhb_C StrtCtl_uAutoCrkBatt_C StrtCtl_vThresStrtCtOff_C StrtCtl_vVehRunngThd_C /end DEF_CHARACTERISTIC
 /begin IN_MEASUREMENT BattU_u BrkPed_flgEBBHiSlop Brk_st Brk_stEBBBrkDetn CEngDsT_t Clth2_st Clth3_st Clth4_st Clth_flgCluSwtImps Clth_st CoEng_st CoEng_tiStrtDly Com_bBrkPedON Com_flgAutCrkActv Com_flgManCrkFCANEna Com_flgManCrkPTCANEna Com_stAutoStaInfo Com_stBrkPedON Com_stCanErr Com_stCrkCdn Com_stEPBAppld Com_stEPBFailrInfo Com_stEPBInhbAct Com_stEPBPlaSftyMod Com_stNeutInfo Com_stNotTxDrvgF Com_stRemEngStrtr Com_stRxAYCDDeb Com_stRxAYCDOk Com_stRxEAT12Deb Com_stRxEAT13Deb Com_stRxEATBDeb Com_stRxEBBADeb Com_stRxEBBAOk Com_stRxEPBBDeb Com_stRxEPBBOk Com_stShftNP Com_vVehSpdCVTCtrl CoVeh_stEngStrtOrd CoVOM_bSSEEngStopPassed CoVOM_bSysOff CoVOM_stSSE DReqSwt_stClrDeb EpmRRS_bEngStopAg EpmRRS_stAgDetect Epm_nEng Epm_nEng10ms Epm_stSync Gbx_stAnNeutPosnFlt Gbx_stNPos Gbx_stPNPosnDeb GlbDa_vX PT_bAutoStrtRls PT_stTraType Sia_stOK SrvCSwt_st StbIntv_vWhlSpd Strt_st Strt_stLckJudg SyC_stSub T15_st T50_st VehV_v /end IN_MEASUREMENT
 /begin OUT_MEASUREMENT StrtCtl_bStrtReq StrtCtl_bTraBrkStrtCtlLck StrtCtl_bTraBrkStrtReqCncl StrtCtl_flgBrkDetn StrtCtl_flgEBBDfct StrtCtl_flgEBBShiftToPReq StrtCtl_flgEngIrrStop StrtCtl_flgEngStall StrtCtl_flgEngStrtCmpl StrtCtl_flgEngStrtProhb StrtCtl_flgEngStrtSeq StrtCtl_flgEngStrtSeqCmpl StrtCtl_flgEPBAppld StrtCtl_flgEPBReq StrtCtl_flgFirstEngStrt StrtCtl_flgPShiftLockReq StrtCtl_flgVehDrvInhb StrtCtl_flgVehDrvRdy StrtCtl_flgVehRunng StrtCtl_flgVehStPtd StrtCtl_stIdleSpStTiLimHist StrtCtl_stSafeEngStrt StrtCtl_stStrtCtOff StrtCtl_stStrtRls StrtCtl_vEBBVehSpd /end OUT_MEASUREMENT
 /begin LOC_MEASUREMENT StrtCtl_bPanicStrtReq_MP StrtCtl_bPushBtnStrtCmft_MP StrtCtl_bStrtActvN StrtCtl_bStrtActv_MP StrtCtl_bStrtCmftMax_MP StrtCtl_bStrtDlyFin_MP StrtCtl_bStrtOrd StrtCtl_bStrtReqCncl_MP StrtCtl_bStrtReqIMG StrtCtl_bStrtReqVal_MP StrtCtl_bStrtrOperTiCdn_MP StrtCtl_bStSpStrtOrd StrtCtl_bTiLimCmftSel_MP StrtCtl_bTraBrkReqCnclDeb_MP StrtCtl_ctNFaultStrt StrtCtl_ctStrtReqRst StrtCtl_ctTiFaultStrt StrtCtl_facStrtTiIdlMax_MP StrtCtl_facStrtTiMax_MP StrtCtl_flgEPBIgnOn StrtCtl_flgEPBOffDetn StrtCtl_flgIgnOnCANDeb StrtCtl_flgNeutNoPrms_MP StrtCtl_flgRxCrkATDeb_MP StrtCtl_flgSafeEngStrtCdn1 StrtCtl_flgSafeEngStrtCdn2 StrtCtl_flgStrtAutCrk StrtCtl_flgStrtManCrk StrtCtl_flgStrtReqERTOffDly StrtCtl_flgSysStrtReq_MP StrtCtl_flgT50RstReqTOffD_MP StrtCtl_flgTrsmCdnAT_MP StrtCtl_stAutManCrkCdn StrtCtl_stCrkEnaAT StrtCtl_stCrkEnaIMG StrtCtl_stEngStrtCmplCntr StrtCtl_stRstCrkEnaAT_MP StrtCtl_stShiftN StrtCtl_stShiftNP StrtCtl_stShiftP StrtCtl_stStrtCtOffMem StrtCtl_stStSpStrtOrdCdn_MP StrtCtl_tiFuPWait StrtCtl_tiStrtDly StrtCtl_tiStrtOff StrtCtl_tiStrtOn StrtCtl_tiStrtOnIdl StrtCtl_tiStrtOrd StrtCtl_tiT50 /end LOC_MEASUREMENT
 FUNCTION_VERSION "74.3.0_1.2.0" /end FUNCTION
/begin FUNCTION Strt_DD "90.0.0    Starter Relay Device Driver" /begin DEF_CHARACTERISTIC Strt_uStmDiaMin_C /end DEF_CHARACTERISTIC /begin IN_MEASUREMENT BattU_u Strt_stPs SyC_stSub /end IN_MEASUREMENT /begin OUT_MEASUREMENT Strt_stPsRet /end OUT_MEASUREMENT
 /begin LOC_MEASUREMENT Strt_bStmDiaBre_mp Strt_stOL Strt_stOL2 Strt_stSCB Strt_stSCB2 Strt_stSCG Strt_stSCG2 Strt_stStmErrInfo_mp Strt_stStmFault /end LOC_MEASUREMENT
 FUNCTION_VERSION "90.0.0" /end FUNCTION
/begin FUNCTION Strt_VD "70.0.0    Starter Virtual Device"
 /begin DEF_CHARACTERISTIC Strt_cntrContnsRstrtIntlShoRepl_C Strt_cntrRstrtIntlShoRepl_C Strt_ctCaSEdgMin_C Strt_flgStrtRlyCntRst_C Strt_nLckJudg1_C Strt_nLckJudg2_C Strt_swtCntRst_C Strt_swtStaActv_C Strt_tiContnsRstrt_C Strt_tiImobChk_C Strt_tiLckJudg1_C Strt_tiLckJudg2_C Strt_tiRstrtIntl_C Strt_tiStrtActv_C Strt_tiStrtCtOffDiaDur_C Strt_uDiaThresCtOffHi_C Strt_uDiaThresCtOffLo_C Strt_uDiaThresStkHi_C Strt_uDiaThresStkLo_C Strt_uStrtDiaMin_C /end DEF_CHARACTERISTIC
 /begin IN_MEASUREMENT BattU_u Epm_nEng Epm_nEng10ms MoF_stStrtMsg PT_bAutoStrtRls Sia_stIgnLck SrvCSwt_st Strt_stPsRet SyC_stSub T15_st T50_st /end IN_MEASUREMENT
 /begin OUT_MEASUREMENT stEepOrd_RstrtIntlSho Strt_cntrContnsRstrtIntlSho Strt_cntrContnsStaActv Strt_cntrRstrtIntlSho Strt_cntrStaActv Strt_cntTotRlyOper Strt_cntTotRlyOper1 Strt_cntTotRlyOper2 Strt_cntTotRlyOper3 Strt_cntTotRlyOper4 Strt_ctStopEngDC Strt_ctStopEngTot Strt_ctStopEngTot1 Strt_ctStopEngTot2 Strt_ctStopEngTot3 Strt_ctStopEngTot4 Strt_flgRstrtIntl Strt_flgStop Strt_st Strt_stLckJudg Strt_stLckJudg1 Strt_stLckJudg2 Strt_stPs Strt_stStaActv Strt_stTstrActv Strt_uStrtMonDia /end OUT_MEASUREMENT
 /begin LOC_MEASUREMENT EepRdStrt EepRdStrtRly stPsShOffSeq Strt_bImobChk_mp Strt_bLckJudgActv_mp Strt_bLckT1Elpsd_mp Strt_bLckT2Elpsd_mp Strt_bPsShOffSeq_mp Strt_bStrtDia Strt_cntStaRlyTot Strt_ctCaSEdg_mp Strt_stStaActvDly Strt_tiStaActv_MP Strt_tiStopIntl_MP /end LOC_MEASUREMENT
 FUNCTION_VERSION "70.0.0" /end FUNCTION
/begin FUNCTION StSpSwt_DD "70.0.0    Start Stop Enable Switch Device Driver"
 /begin DEF_CHARACTERISTIC StSpSwt_SwtDeb.tiHiLo_C StSpSwt_SwtDeb.tiLoHi_C StSpSwt_swtSelTyp_C /end DEF_CHARACTERISTIC
 /begin IN_MEASUREMENT Com_stISSInhbnSwt T15_st /end IN_MEASUREMENT
 /begin OUT_MEASUREMENT StSpSwt_st StSpSwt_stSelTyp StSpSwt_stStrd /end OUT_MEASUREMENT
 /begin LOC_MEASUREMENT StSpSwt_stRaw /end LOC_MEASUREMENT
 FUNCTION_VERSION "70.0.0" /end FUNCTION
/begin FUNCTION SWAdp "159.0.0_9.13.0central SW-Adapter (legacy)"
 /begin DEF_CHARACTERISTIC AccPed_swtDrvModSeln_C AirC_stSwtPrs_C alchpct_msg_C App_flgSRCLo1HiImpdChk_C App_flgSRCLo2HiImpdChk_C APP_flgT15HealEnad_C App_swtHiImpdChkEna_C ATS_TrbCh_B1.LimitTypeMsk_C ATS_TrbCh_B1.CnvNorm_C ATS_TrbCh_B1.LowLim_C ATS_TrbCh_B1.UpLim_C ATS_TrbCh_B1.CnvFac_C ATS_TrbCh_B1.CnvOfs_C ATS_TrbCh_B1.DfltVal_C BattU_tiThMinDSQ_C BattU_uThMinDSQ_C BrkPed_pForISABIdleStop_C BrkP_dpMstCyl_C BrkP_p_C Brk_stEBBBrkDetn_C B_abor_msg_C B_disagrkd_msg_C B_dtdisagr_msg_C B_eagrv_msg_C B_evasldel_msg_C B_faagr_msg_C B_fabe_msg_C B_kuppl_msg_C B_teftstft_msg_C B_tolcb_msg_C B_vhegv_C B_vhegzw_C CACPmpRly_ATS.LimitTypeMsk_C CACPmpRly_ATS.CnvNorm_C CACPmpRly_ATS.LowLim_C CACPmpRly_ATS.UpLim_C CACPmpRly_ATS.CnvFac_C CACPmpRly_ATS.CnvOfs_C CACPmpRly_ATS.DfltVal_C CACPmp_ATS.LimitTypeMsk_C CACPmp_ATS.CnvNorm_C CACPmp_ATS.LowLim_C CACPmp_ATS.UpLim_C CACPmp_ATS.CnvFac_C CACPmp_ATS.CnvOfs_C CACPmp_ATS.DfltVal_C CByVlvB1_Test_ATS.LimitTypeMsk_C CByVlvB1_Test_ATS.CnvNorm_C CByVlvB1_Test_ATS.LowLim_C CByVlvB1_Test_ATS.UpLim_C CByVlvB1_Test_ATS.CnvFac_C CByVlvB1_Test_ATS.CnvOfs_C CByVlvB1_Test_ATS.DfltVal_C CDKVS CDLLR CDTES Clth_drFlt_C Clth_rKisspnt_C Clth_stClthExtd_C Clth_swtClthType_C CoETS_trqInrDetModeFild_C CoETS_trqInrDetMode_C ComDCDC_stDiagCirc1_C ComDCDC_stDiagCirc2_C ComDCDC_stRxErr_C ComEBS_stBattSizeDetc_C Com_flgACCNorm_C Com_flgEAT9Norm_C Com_flgLETAcTqResvReplcmt_C Com_flgLETNoInjCntrCdn_C Com_flgLETORATmrThd_C Com_flgManCrkPTCANEna_C Com_flgManModIndcn_C Com_numGearTrgt_C Com_rClthPos_C Com_stACCSpdUnit_C Com_stADSSpdLim_C Com_stATEnaCond_C Com_stATErr4_C Com_stATShftUpDwnReq_C Com_stAYC_C Com_stBCDGearEngmt_C Com_stCamHealDisp_C Com_stDispDmdEnvCdn_C Com_stDispDmdSignRi_C Com_stEAT3Mon_C Com_stEngMapReq_C Com_stEVPIdleStopFail_C Com_stEVPIdleStopReq_C Com_stHydPCtrlOper_C Com_stISEBBFail_C Com_stMonMET_C Com_vDigVehMph_C Conv_tiLvrChgDrvRvs_CUR Conv_tiLvrChgRvsDrv_CUR Conv_tiRevLvrOffNeut_CUR Conv_tiRevLvrOffPark_CUR Conv_tqResvTDpdtDRACOn_CUR Conv_tqResvTDpdtDR_CUR CrCtl_stIDASTqModFailr_C CrCUI_stPlusRDrvMod_C CWMDAPP CW_CY329_Boost_Perm_On_Test Dspl_stCrsASLSelInfo_C ElecLd_stSRCChk_C ElM_tqActWoAcsyCmp_C EngStrt_diaWrmUp_C ESS_bEngStrtEna_C ExhMgT_flgRelsLamCptProtn_C GbxRevLck_ATS.LimitTypeMsk_C GbxRevLck_ATS.CnvNorm_C GbxRevLck_ATS.LowLim_C GbxRevLck_ATS.UpLim_C GbxRevLck_ATS.CnvFac_C GbxRevLck_ATS.CnvOfs_C GbxRevLck_ATS.DfltVal_C Gbx_bATSlipOpn_C Gbx_bNCmp_C Gbx_bTIIIntv_C Gbx_flgNCtrlImp_C Gbx_flgNCtrlRetStrt_C Gbx_nRrngEngSpdInh_C Gbx_rConvSlip_C Gbx_uAPPMaxLrn_C GEVCtl_agWidthCamProfLoLftIntk_C GEVCtl_flgPhaEnaPOil_C GEVCtl_flgSpSpclIntkVlvLft_C GEVCtl_ratLoad_C GEVCtl_stPhaAdpr_C GEVCtl_tOilCylHd_C HEGO_flgReIniSnsrTMdl_C HEGO_resRiMaxPlaus_C HndBrk_stDebVal_C I14229iocbiCrCtl1_stVal_C I14229iocbiCrCtl_stVal_C I14229_stAutoStrtEna_C I14229_stPCSEvapSwt_C Ign_nEng20_AX Ign_nEngVS12_AX Ign_ratChrgAirVS12_AX KW_CWADRES LAS_facRoadGrdt_C NSWO1 NSWO2 Oil_p_C PCR_pDesVal_C PHAACTRINTK_CTL_ATS_ATS.LimitTypeMsk_C PHAACTRINTK_CTL_ATS_ATS.CnvNorm_C PHAACTRINTK_CTL_ATS_ATS.LowLim_C PHAACTRINTK_CTL_ATS_ATS.UpLim_C PHAACTRINTK_CTL_ATS_ATS.CnvFac_C PHAACTRINTK_CTL_ATS_ATS.CnvOfs_C PHAACTRINTK_CTL_ATS_ATS.DfltVal_C PHAACTROUTL_CTL_ATS_ATS.LimitTypeMsk_C PHAACTROUTL_CTL_ATS_ATS.CnvNorm_C PHAACTROUTL_CTL_ATS_ATS.LowLim_C PHAACTROUTL_CTL_ATS_ATS.UpLim_C PHAACTROUTL_CTL_ATS_ATS.CnvFac_C PHAACTROUTL_CTL_ATS_ATS.CnvOfs_C PHAACTROUTL_CTL_ATS_ATS.DfltVal_C priobbora_msg_C priobbteh_msg_C PRMAX psmxbkvg_w_msg_C PSPCtl_flgRmnVapSuspc_C PTDist_flgCrkSftMintqSeln_C PTDist_flgEnaTCMFCOReqByp_C PTDist_tqdeltaTCMFCOReq_C PT_trqWhlMaxEng_C PT_trqWhlMinWoCtOff_C THS2ME_stConf_CW tolc_msg_C VehMot_tqCluDesGenericLimn_C VehMot_tqCluLeadGenericLimn_C VF2ME_THRESBKOE_C WaHt_flgHeatrRiseReq_C WaHt_tDeltaEngT_C WESBM wgvohsme_w_msg_C wgvshsme_w_msg_C ZWAPPL /end DEF_CHARACTERISTIC
 /begin REF_CHARACTERISTIC CoVOM_stStopRelsMask_C CoVOM_stStopReqMask_C CoVOM_stStrtReqMask_C MisfDet_swtOn_C /end REF_CHARACTERISTIC
 /begin IN_MEASUREMENT AccPed_tqMapBasd ACCtl_flgACReq ACCtl_stOut ACCtl_stTrqResv ActMod_trqCrS ActMod_trqInr AC_trqMaxAC AirC_stCmprAct APP_r ASDrf_trqClthFlt BattU_u BattU_uSens BrkBstP_pAftFil B_dknotb_msg B_dksbeg_msg B_dmdsteol B_kl15_msg B_kuppl B_llrein_msg B_llri_msg B_ll_msg B_mdmi_msg B_mdstop_msg B_milstp_msg B_nachl_msg B_stendll_msg B_vhegfe_msg B_vhegs_msg CEngDsT_t CEngDsT_tSnsrTstr CEngDsT_tStrt CEngUsT_t Clth_st CoEng_flgRelsFco CoEng_st CoEng_stMai CoEng_tiScneEngStrtPrmIdH1F CoEOM_flgEomIgnRels CoESS_flgUReq CoETS_trqInrLeadWoCo CoETS_trqInrLimSet CoETS_trqInrSetCo ComAlt_rAltDyc Com_bReDEFSwCdn Com_bTSCIntvFast Com_lDst Com_ratSoc Com_rTrsmTotFild Com_stTrsmFailMod Com_stWiprMETC Com_tMtrEva CoVeh_trqAcs DCM_stCurrDiagcSession drldvls_w_msg DSMAUX_stDCy_msg dzwwl_msg Eep_EnvRamHist Eep_EnvRamInvld EngStrt_bFrstStrtEnd EngStrt_bStrtEnd EngStrt_flgStrtEndIgn EngStrt_flgStrtEndTqStruct EngStrt_tiAftStrtEnd EnvP_p EnvT_t Epm_nEng Epm_nEngLRes etazwsol_w_msg ExhMod_mAirMfIntegEngStrt Fan_r Fan_r2 Fan_stPs fho_msg fmi2trq_w_msg fra_w_msg ftead_w_msg Gbx_nTrbn Gbx_stConvClth Gbx_tOilConv GlbDa_lTotDst GlbDa_stTrqDem HLSDem_bNMaxRed HLSDem_nSetPLo HLSDem_nSetPTrck Ign_ia_real_s8 Ign_ratChrgAirCyl IKCtl_agDynAdpnOffs_s8 InjSys_dvolFu InjSys_ratFuM IntkAirT_tIntkMnfld IntkAirT_tThrVlvUs LIGov_nDiff Lin_BS_Signal_B_UBAT_16_r_msg LLim_bFcoDes LsComp_tqCmpActvSpdGovr LsComp_tqSwilLossNotFild lutskzyl_w_msg milsol_w_msg OilSwmpT_t PEnv_dpAirFilThr PEnv_p PhyMod_tqJEng PtCoornDyn_flgTrsmIntvActvDes PtCoornDyn_stIntvLead PtCoornDyn_tqCluDesWoTrsmIntv PTDist_tqCrksftSet PthSet_bOvrRun PT_rTrq PT_stTraType PT_tqCluEngWoIntvExt PT_tqCluMinEngWoFco PT_tqCluTrsmProtn PT_tqDesENGT1 PT_tqDesENGT2 PT_tqEngENG16 PT_tqEngEstimtd PT_tqResvEng PT_trqLos PT_trqWhlMax rlsol_w_msg rl_w_msg RngMod_trqCrSMin RngMod_trqCrSMinWoCtOff RngMod_trqCrSSetMin RngMod_trqLos SpdGov_trqClthLimMechDes SrvCSwt_st StatyCoorn_tqCluDrvDmdDes SyC_stSub SysDiag_flgCModJdg tans_msg tasrg_w_msg tateout_w_msg TCE_flgCylIndFcoStrtd TCE_flgFcoRdy TCE_tiExptFcoStrt TiEngOn_tiTotEngRt tnst_w_msg toch_msg TWCD_flgMeasFinB1 VehV_v VMD_tqCluDes wdks_w_msg /end IN_MEASUREMENT
 /begin OUT_MEASUREMENT ACCI_aReq ACCI_bACCPrs AccPed_flgIDSFctAvl ACCtl_stDecelACCutDmd ACC_bExsMinDstBrkReq ACC_bFail ACC_bFrtCar ACC_bJmpDes ACC_rTrqAccRed ACC_st ACC_stACCDR1Req ACC_stACCDR2Req ACC_vDes AirC_bBackliteHeatgReq AirC_stSwtPrs AirMod_ratChrgDeltaSwtAirSys AirSys_tFld Air_tCACDs alchpct_msg AltIO_uMeasd App_flgHiImpdChkEna App_flgSRCLo1HiImpdChk App_flgSRCLo2HiImpdChk ASDrf_trqInrSet AuxHtg_bActv BattU_uFild Blwr_flgActv BrkBstP_pSens BrkPed_pForISABIdleStop BrkP_dpMstCyl BrkP_p Brk_pMnCyl Brk_r Brk_stEBBBrkDetn B_abor_msg B_adrsta_msg B_ate_msg B_bkvmsisr_msg B_bkvnkhab_msg B_bkvsta_msg B_cdkvs_msg B_cdllrkh_msg B_cdllr_msg B_cdmd B_cdtes_msg B_cvt_msg B_dcy B_dfonrst_msg B_dknotb B_dksbeg B_dteaam_msg B_dtest_msg B_dtes_msg B_dtmbh_msg B_ebfmod_msg B_eepwf_msg B_evasldel_msg B_faagr_msg B_faam_msg B_fabe_msg B_fafkmsla_msg B_falshvs_msg B_falzsr_msg B_fa_msg B_fpwdkap_msg B_hsp B_invlvbcd_msg B_khatrip_msg B_kl15 B_koe_msg B_kuppl_msg B_ldsua_msg B_ll B_llrein B_llri B_mdmi B_mdstop B_nachl B_nmot B_nswo1_msg B_nswo2_msg B_reqddskv_msg B_stend B_stveset_msg B_tal_msg B_teftstft_msg B_tippg_msg B_tolcb_msg B_urstsprr B_vheg B_vhegfe B_vhegv B_vhegzw B_wdksap_msg B_zwappl_msg CAClg_ratCoolgMax CAClg_ratCoolgMedHi CAClg_ratCoolgMedLo CAClg_ratCoolgMin CACPmp_uPlausyHiThd CACPmp_uPlausyLoThd CB_flgFlsProgmEveSts CEngDsT_tStopStrtEndOff CEngUsT_t_Adp Clth_drFlt Clth_r Clth_rKisspnt Clth_stClthExtd Clth_swtClthType CoDsplCtl_OutAddLamps CoDsplCtl_stLmp4Out CoDsplCtl_stLmp5Out CoEng_bCtOffCon CoEng_bFrstStrtEnd CoEng_bHEM CoEng_bStrtEndIA CoEng_bStrtEndSpdGov CoEng_bStrtEndTrqStruct CoEng_tiNormalOBD CoEng_tiStrtDly CoEOM_flgCvlcIgnRels CoETS_trqInrDetMode CoETS_trqInrDetModeFild CoETS_trqInrLead ComDCDC_stCSTHist ComDCDC_stDiagCirc1 ComDCDC_stDiagCirc2 ComDCDC_stRxErr ComEBS_rBattSensCh ComEBS_stBattSizeDetc ComEBS_uBattSens Com_dACCCmdVehSpdDispd Com_flgACCNorm Com_flgEAT9Norm Com_flgLETAcTqResvReplcmt Com_flgLETNoInjCntrCdn Com_flgLETORATmrThd Com_flgManCrkPTCANEna Com_flgUpshiftMod Com_lTotOdo Com_nrIdAlt Com_nrIdChp Com_nrIdMnfc Com_numGearTrgt Com_pEVPMnfldP Com_rAltLoad Com_rClthPos Com_rClthStk Com_stACCAMon Com_stACCBMon Com_stACCIgrBrk Com_stACCSpdUnit Com_stACCTrsmGearChgReq Com_stActHSA Com_stADSSpdLim Com_stASROff Com_stATEnaCond Com_stATErr4 Com_stATISS Com_stATPrkgProc Com_stATShftUpDwnReq Com_stAYC Com_stBCDGearEngmt Com_stBrk Com_stBrkHldSys Com_stCamHealDisp Com_stClth Com_stClthPedlFailDet Com_stClthStkFailInfo Com_stDispDmdEnvCdn Com_stDispDmdSignRi Com_stDrvModSwt Com_stEAT3Mon Com_stEmgcyStrtReqOutSel Com_stEngInhibReq Com_stEngMapReq Com_stEPBAppld Com_stEPBFailrInfo Com_stEPBInhbAct Com_stEPBPlaSftyMod Com_stEPBStInfo Com_stEVPIdleStopFail Com_stEVPIdleStopReq Com_stGbxNPos Com_stGrip Com_stHydPCtrlOper Com_stIngearEngmt Com_stInShiftNeut Com_stInShiftPrkg Com_stISEBBFail Com_stLSFStrtValDmd Com_stMisfDetLineEnd Com_stMonMET Com_stPPos Com_stRxEPB Com_stRxEPBBDeb Com_stRxEPBBOk Com_stSptSwtDeb Com_stStrtReqOutSel Com_stStSpEngStop Com_stT50 Com_stTCamAbnormDisp Com_stTSRClrReas Com_stWipr Com_trqDesENGT1 Com_trqDesENGT2 Com_trqEngENG16 Com_trqEngEstimd Conv_trqOilCoolrPmp Conv_trqOilCoolrPmpRepl CoPOM_facTrqDynDist CoPOM_numStrt CoPOM_stM CoPOM_stMnSt CoPOM_tqDesEmQsty CoPOM_tqEmDynMin CoPT_bTraShftActvDes CoPT_trqClthWoIntv CoPT_trqDesCompEng CoPT_trqResvEng CoVeh_flgPtcShtOff CoVeh_tqDrvOff2MaxAC CoVeh_tqIdleMaxAC CoVeh_trqDesComp CoVMD_flgIdleDrv CoVM_bSIActvLead CoVM_trqLead CoVOM_stAutoRstrtReq CoVOM_stAutoRstrtReqGr1 CoVOM_stAutoRstrtReqGr2 CoVOM_stRstrtNoPtd CoVOM_stStopRelsMask CoVOM_stStopReqMask CoVOM_stStrtReqMask CrCtl_stIDASTqModFailr CrCUI_stPlusRDrvMod CrC_stKey Dfftl_bLowRng dmsnte_w_msg DReqSwt_stClrDeb DrvPrgSwt_bSprt DrvPrgSwt_bSprtPlus DrvPrgSwt_stEffModReqd DSMDur_tiMICumContGlb Dspl_bVelInMiles Dspl_stCrsASLSelInfo EEM_chBatt EEM_stBattChAc Eep_stISSStorgDiagActv ElecLd_iSensLd ElecLd_stSRCChk ElM_stOperModDes ElM_tqActWoAcsyCmp ElM_tqDes ElM_tqMaxGenr ElM_tqMaxTqCtrl ElM_tqMinTqCtrl EngDa_tFld EngDa_tiEngOnOBD EngPrt_bNLimRed EngStrt_diaWrmUp EngStrt_nEngRstrtStgy2ThdLo EnvT_stTSens EnvT_tSens EpmRRS_bEngStopAg ESS_bEngStrtEna ExhMgT_flgNoStopEngCatHeatg ExhMgT_stPrioWpDmdHyb FanCtl_stFanCtrlEnd Fan_rPs fethmnmx fho flamlu_w_msg FlSys_dvolFlCons fra_w ftead_w FuelT_t GbxMTAT_stTraType Gbx_bASTIntv Gbx_bASTNeutr Gbx_bATSlipOpn Gbx_bGearShftActv Gbx_bHaltDisEgdActv Gbx_bLimp Gbx_bNCmp Gbx_bOvrRstrtActv Gbx_bRevGear Gbx_bSailActv Gbx_bTIIIntv Gbx_bTSCIntv Gbx_flgNCtrlImp Gbx_flgNCtrlRetStrt Gbx_nASTDes Gbx_nRrngEngSpdInh Gbx_numGear Gbx_numGearTrgt Gbx_ratOilCoolrPmp Gbx_rConvSlip Gbx_rFanClgDem Gbx_rTrq Gbx_rTrqTra Gbx_stHaltDisEgdActv Gbx_stSpstReq Gbx_tClntDes Gbx_tiASTDes Gbx_trqPrt Gbx_trqTIIDes Gbx_trqTIILead Gbx_trqTSCIntvDes Gbx_trqTSCIntvLead Gbx_uAPPMaxLrn GEVCtl_flgPhaEnaPOil GEVCtl_flgSpSpclIntkVlvLft GEVCtl_ratLoad GEVCtl_tOilCylHd GlbDa_stTraPlus grundwert_msg HEGO_flgS2B1EnaLamCtlColdOper HiPSys_flgDeactvnFuInjInhbn HndBrk_stDebVal I14229iocbiCrCtl1_stVal I14229iocbiCrCtl_stVal IKCtl_iaDynAdpnOffs_s16 imlatm_w InjSys_nrRedStgEnf IntkAirT_uSnsr3CrssSwtLoc KONCW_flgRatLoadCalMod LAS_facRoadGrdt LLim_bFcoDes_msg lutskzyl_w MESCtrlr_nSpDif MoFTerminal_stT50EmgyMsg mshfmst_w nstat OilLfT_degOilDetern OilLfT_mAirPerCyl OilLfT_stFailOilTSnsr OilLfT_stFailSafeActn OilP_p OilSwmpT_uSnsrRaw Oil_stAvusWarn Oil_stOilLow PEnv_dataDigSens PFltDes_flgInhbOverrun PhyMod_trqDynEng priobbora_msg priobbteh_msg psmxbkvg_w_msg PSPCtl_flgRmnVapSuspc PTDist_flgEmStrtgTqActv PTDist_flgEvModSetLimnActv ptek_w_msg PthSet_flgCritTqIncPhd PthSet_stOvrRunCoord PthSet_trqInrFlt PthSet_trqInrSet PTODi_trqCrSLeadUnlim PT_bCtOffPhd PT_flgLimnFCOReq PT_tqCluMinWoFco PT_trqCrSLeadPOp PT_trqCrSWoIntv PT_trqTraPrt PT_trqWhlMaxEng PT_trqWhlMinWoCtOff pu_w pvv_w_msg rlmdhoms_w_msg rlmxbkv_w_msg rlsol_w rltedte_w_msg rl_w RrDfogSwt_stRawVal Shtrp_rTrqSetPointDia Shtrp_stAct SpdGov_bNLimFCOReq SpdGov_trqEngPrtLimMech StbIntv_bESPErr StbIntv_bTCSDeActv StrtCtl_stClthForStrtReqJdg SyC_stHistTiPostDrvMax SysDiag_stTestMod tandk_w_msg tans tansst_msg tateout_w TiOff_stTiStrtEndOffVW tmot tmottstr_w tmst toch tolc_msg Tra_bCANErrMax Tra_nPrdcInpN Tra_numGearDisp Tra_stEngStop TrsmEmac_ratElmTrsm TWCD_bEnaOSCB1 TWCD_bFinOSCMeasB1 VehMot_tqCluDesGenericLimn VehMot_tqCluGenericLim VehMot_tqCluLeadGenericLimn VehMot_trqDes VehMot_trqDesAcs VehMot_trqPrtDfftl VehPos_rIncIX VehV_flgStandStill WaHt_flgHeatrRiseReq WaHt_tDeltaEngT wdks_w wessbm_msg wgvohsme_w_msg wgvshsme_w_msg wkratst wnwve_w_msg wnwvu_w_msg wped_w wtacvol_w zwist zzbank_msg /end OUT_MEASUREMENT
 /begin LOC_MEASUREMENT i_lutskzyl_w Oil_p temp_AirSys_tFld /end LOC_MEASUREMENT
 FUNCTION_VERSION "159.0.0_9.13.0" /end FUNCTION
/begin FUNCTION SyC2ME "10.4.0    Interface Adapter System Control to ME" /begin IN_MEASUREMENT Eep_EnvRamHist Eep_EnvRamInvld SyC_stSub T15_st /end IN_MEASUREMENT
 /begin OUT_MEASUREMENT B_nachlauf_msg B_nachl_msg B_norm_msg B_wakeup_msg tnachl_w_msg /end OUT_MEASUREMENT
 /begin LOC_MEASUREMENT nltrstdone_msg /end LOC_MEASUREMENT
 FUNCTION_VERSION "10.4.0" /end FUNCTION
/begin FUNCTION SyC_Vld2Lcy "1.19.0    SW Adapter System Control: Mapping Valid to Legacy Interface Elements" /begin IN_MEASUREMENT CoEng_st DSM_TripChgAndClrFinshd Epm_nEng /end IN_MEASUREMENT
 /begin OUT_MEASUREMENT SyC_ctDrvEnter SyC_ctIrrSwOff SyC_ctPostDrvLeave SyC_stMn SyC_stMnOld SyC_stPostDrv SyC_stPostDrvDel SyC_stPreDrv SyC_stPreDrvDel SyC_stSub SyC_stSubOld SyC_stVldTiEcuOff SyC_tiDrv SyC_tiEcuOff SyC_tiFrst10ms SyC_tiPostDrv SyC_tiPreDrv /end OUT_MEASUREMENT
 /begin LOC_MEASUREMENT SyC_stSwtOn_mp SyC_tiBoot_mp SyC_tiIniEnd_mp SyC_tiIniSyn_mp SyC_tiIni_mp /end LOC_MEASUREMENT
 FUNCTION_VERSION "1.19.0" /end FUNCTION
/begin FUNCTION SYNTIZW "4.5.0     BDE synchronization injection/ignition" /begin IN_MEASUREMENT Epm_ctCyl /end IN_MEASUREMENT /begin OUT_MEASUREMENT InjSys_ofsCylCntrHom InjSys_ofsCylCntrStrat zzylzue_msg /end OUT_MEASUREMENT FUNCTION_VERSION "4.5.0" /end FUNCTION
/begin FUNCTION SysDiag_TestCoorr "4.0.0     Test Coordinator" /begin DEF_CHARACTERISTIC SysDiag_SwtCModEnbl_C SysDiag_tiCModEng_C /end DEF_CHARACTERISTIC
 /begin IN_MEASUREMENT APP_r Brk_st Clth3_st Com_stRxEATBDeb Com_stSpdSnsrFailr Gbx_stGearLvr PT_stTraType T15_st T50_st VehV_v /end IN_MEASUREMENT
 /begin OUT_MEASUREMENT SysDiag_flgAppPressed SysDiag_flgCModJdg SysDiag_flgComErr SysDiag_flgModInhb SysDiag_flgStCANRx SysDiag_flgTiCMod SysDiag_nrAppUpDwnCnt1 SysDiag_nrAppUpDwnCnt2 SysDiag_nrAppUpDwnCnt3 SysDiag_nrBrkUpDwnCnt SysDiag_stGearLvr SysDiag_stLvrSet /end OUT_MEASUREMENT
 /begin LOC_MEASUREMENT SysDiag_stGearLvrOld SysDiag_stOldClth3st SysDiag_stT15 /end LOC_MEASUREMENT
 FUNCTION_VERSION "4.0.0" /end FUNCTION
/begin COMPU_METHOD Acc "" RAT_FUNC "%6.5" "m/s^2" COEFFS 0 1000 0 0 0 1 /end COMPU_METHOD
/begin COMPU_METHOD AirMassPerCyl "" RAT_FUNC "%6.3" "mg/Hub" COEFFS 0 10 0 0 0 1 /end COMPU_METHOD
/begin COMPU_METHOD B_TRUE "" TAB_VERB "%6.3" "" COMPU_TAB_REF B_TRUE /end COMPU_METHOD
/begin COMPU_VTAB B_TRUE "" TAB_VERB 2 0 "FALSE" 1 "TRUE" /end COMPU_VTAB
/begin COMPU_METHOD Ch_Ah_q0p5_COMPU "" RAT_FUNC "%6.3" "Ah" COEFFS 0 2 0 0 0 1 /end COMPU_METHOD
/begin COMPU_METHOD CrCtlSlipRat "" RAT_FUNC "%6.4" "%" COEFFS 0 200 0 0 0 1 /end COMPU_METHOD
/begin COMPU_METHOD Curr_A "" RAT_FUNC "%6.4" "A" COEFFS 0 100 0 0 0 1 /end COMPU_METHOD
/begin COMPU_METHOD dez "" RAT_FUNC "%6.2" "" COEFFS 0 1 0 0 0 1 /end COMPU_METHOD
/begin COMPU_METHOD DSMDUR_MICntr_COMPU "" RAT_FUNC "%6.2" "h" COEFFS 0 1 0 0 0 1 /end COMPU_METHOD
/begin COMPU_METHOD DtyCyc "" RAT_FUNC "%6.4" "%" COEFFS 0 100 0 0 0 1 /end COMPU_METHOD
/begin COMPU_METHOD EngN "" RAT_FUNC "%6.3" "rpm" COEFFS 0 2 0 0 0 1 /end COMPU_METHOD
/begin COMPU_METHOD EpmRRS_bEngStopAg_t "" TAB_VERB "%6.3" "" COMPU_TAB_REF EpmRRS_bEngStopAg_t /end COMPU_METHOD
/begin COMPU_VTAB EpmRRS_bEngStopAg_t "" TAB_VERB 2 0 "EPMRRS_AG_INVLD" 1 "EPMRRS_AG_VLD" /end COMPU_VTAB
/begin COMPU_METHOD ExeCon_State_01 "" TAB_VERB "%6.3" "" COMPU_TAB_REF ExeCon_State_01 /end COMPU_METHOD
/begin COMPU_VTAB ExeCon_State_01 "" TAB_VERB 4 0 "SYC_BOOT" 1 "SYC_PROC_INIT" 2 "SYC_PROC_EXEC" 3 "SYC_SHUTDOWN" /end COMPU_VTAB
/begin COMPU_METHOD ExeCon_State_02 "" TAB_VERB "%6.3" "" COMPU_TAB_REF ExeCon_State_02 /end COMPU_METHOD
/begin COMPU_VTAB ExeCon_State_02 "" TAB_VERB 7 0 "SYC_INI" 1 "SYC_INISYN" 2 "SYC_INIEND" 3 "SYC_PREDRIVE" 4 "SYC_DRIVE" 5 "SYC_POSTDRIVE" 6 "SYC_POST_OS_EXIT" /end COMPU_VTAB
/begin COMPU_METHOD Fact "" RAT_FUNC "%6.5" "-" COEFFS 0 8192 0 0 0 1 /end COMPU_METHOD
/begin COMPU_METHOD fak_sw_b64 "" RAT_FUNC "%6.4" "-" COEFFS 0 65536 0 0 0 128 /end COMPU_METHOD
/begin COMPU_METHOD fak_ub_b2 "" RAT_FUNC "%8.5" "-" COEFFS 0 256 0 0 0 2 /end COMPU_METHOD
/begin COMPU_METHOD fak_ub_b4 "" RAT_FUNC "%6.4" "-" COEFFS 0 256 0 0 0 4 /end COMPU_METHOD
/begin COMPU_METHOD fak_uw_b16 "" RAT_FUNC "%6.5" "-" COEFFS 0 65536 0 0 0 16 /end COMPU_METHOD
/begin COMPU_METHOD fak_uw_b2 "" RAT_FUNC "%7.6" "-" COEFFS 0 65536 0 0 0 2 /end COMPU_METHOD
/begin COMPU_METHOD FlConsum_l_h "" RAT_FUNC "%6.4" "l/h" COEFFS 0 100 0 0 0 1 /end COMPU_METHOD
/begin COMPU_METHOD kw_q0p0078 "" RAT_FUNC "%6.4" "Grad KW" COEFFS 0 128 0 0 0 1 /end COMPU_METHOD
/begin COMPU_METHOD kw_q0p0156 "" RAT_FUNC "%6.4" "Grad KW" COEFFS 0 64 0 0 0 1 /end COMPU_METHOD
/begin COMPU_METHOD kw_q0p75 "" RAT_FUNC "%6.3" "Grad KW" COEFFS 0 4 0 0 0 3 /end COMPU_METHOD
/begin COMPU_METHOD kw_q1 "" RAT_FUNC "%6.2" "Grad KW" COEFFS 0 1 0 0 0 1 /end COMPU_METHOD
/begin COMPU_METHOD kw_q2p8125 "" RAT_FUNC "%6.2" "deg KW" COEFFS 0 1 0 0 0 2.8125 /end COMPU_METHOD
/begin COMPU_METHOD lu_MEx "" RAT_FUNC "%6.4" "(Umdr./sec)^2" COEFFS 0 140.7374884 0 0 0 1 /end COMPU_METHOD
/begin COMPU_METHOD md_q0p1 "" RAT_FUNC "%6.3" "Nm" COEFFS 0 10 0 0 0 1 /end COMPU_METHOD
/begin COMPU_METHOD md_sw_q0p1 "" RAT_FUNC "%6.3" "Nm" COEFFS 0 10 0 0 0 1 /end COMPU_METHOD
/begin COMPU_METHOD m_q0p1 "" RAT_FUNC "%6.3" "kg/h" COEFFS 0 10 0 0 0 1 /end COMPU_METHOD
/begin COMPU_METHOD m_uw_b23p3 "" RAT_FUNC "%6.5" "kg" COEFFS 0 2812.5 0 0 0 1 /end COMPU_METHOD
/begin COMPU_METHOD nmot_ub_q10 "" RAT_FUNC "%6.1" "1/min" COEFFS 0 1 0 0 0 10 /end COMPU_METHOD
/begin COMPU_METHOD nmot_ub_q40 "" RAT_FUNC "%6.1" "1/min" COEFFS 0 1 0 0 0 40 /end COMPU_METHOD
/begin COMPU_METHOD OneToOne "" RAT_FUNC "%6.2" "-" COEFFS 0 1 0 0 0 1 /end COMPU_METHOD
/begin COMPU_METHOD Prc "" RAT_FUNC "%6.4" "%" COEFFS 0 81.92 0 0 0 1 /end COMPU_METHOD
/begin COMPU_METHOD PrcHigh "" RAT_FUNC "%6.5" "%" COEFFS 0 1000 0 0 0 1 /end COMPU_METHOD
/begin COMPU_METHOD PrcHi_COMPU "" RAT_FUNC "%6.4" "%" COEFFS 0 256 0 0 0 1 /end COMPU_METHOD
/begin COMPU_METHOD Prc_CrCtl2 "" RAT_FUNC "%6.3" "%" COEFFS 0 10 0 0 0 1 /end COMPU_METHOD
/begin COMPU_METHOD Prc_EGR "" RAT_FUNC "%6.3" "%" COEFFS 0 2.55 0 0 0 1 /end COMPU_METHOD
/begin COMPU_METHOD Prc_Fact100 "" RAT_FUNC "%6.4" "%" COEFFS 0 100 0 0 0 1 /end COMPU_METHOD
/begin COMPU_METHOD Prc_Fact256 "" RAT_FUNC "%6.4" "%" COEFFS 0 256 0 0 0 1 /end COMPU_METHOD
/begin COMPU_METHOD Pres "" RAT_FUNC "%6.3" "kPa" COEFFS 0 10 0 0 0 1 /end COMPU_METHOD
/begin COMPU_METHOD PreshPa_10ms "" RAT_FUNC "%6.0" "hPa/s" COEFFS 0 0.01 0 0 0 1 /end COMPU_METHOD
/begin COMPU_METHOD Pres_hPa "" RAT_FUNC "%6.2" "hPa" COEFFS 0 1 0 0 0 1 /end COMPU_METHOD
/begin COMPU_METHOD Pres_LoRes_COMPU "" RAT_FUNC "%6.4" "MPa" COEFFS 0 100 0 0 0 1 /end COMPU_METHOD
/begin COMPU_METHOD Pres_mmhg_q2p685 "" RAT_FUNC "%6.2" "mmHg" COEFFS 0 256 0 0 0 687.36 /end COMPU_METHOD
/begin COMPU_METHOD p_q0p0005 "" RAT_FUNC "%6.5" "MPa" COEFFS 0 10000 0 0 0 5 /end COMPU_METHOD
/begin COMPU_METHOD p_q0p00122 "" RAT_FUNC "%6.4" "hPa" COEFFS 0 65536 0 0 0 80 /end COMPU_METHOD
/begin COMPU_METHOD p_uw_q0p039 "" RAT_FUNC "%6.4" "hPa" COEFFS 0 256 0 0 0 10 /end COMPU_METHOD
/begin COMPU_METHOD RBPtCel_dst_0p1_2 "" RAT_FUNC "%6.3" "km" COEFFS 0 10 0 0 0 1 /end COMPU_METHOD
/begin COMPU_METHOD RBPtCel_tq_1p0_1 "" RAT_FUNC "%6.2" "Nm" COEFFS 0 1 0 0 0 1 /end COMPU_METHOD
/begin COMPU_METHOD relDK_uw_b100 "" RAT_FUNC "%6.4" "%DK" COEFFS 0 65535 0 0 0 100 /end COMPU_METHOD
/begin COMPU_METHOD relPED_q0p00153 "" RAT_FUNC "%6.4" "% PED" COEFFS 0 65535 0 0 0 100 /end COMPU_METHOD
/begin COMPU_METHOD rel_q0p00153 "" RAT_FUNC "%6.4" "%" COEFFS 0 65536 0 0 0 100 /end COMPU_METHOD
/begin COMPU_METHOD rel_q0p0078125 "" RAT_FUNC "%6.4" "%" COEFFS 0 128 0 0 0 1 /end COMPU_METHOD
/begin COMPU_METHOD rel_q0p0234 "" RAT_FUNC "%6.4" "%" COEFFS 0 128 0 0 0 3 /end COMPU_METHOD
/begin COMPU_METHOD rel_q0p02344 "" RAT_FUNC "%6.4" "%" COEFFS 0 32 0 0 0 0.75 /end COMPU_METHOD
/begin COMPU_METHOD rel_q0p1 "" RAT_FUNC "%6.3" "%" COEFFS 0 10 0 0 0 1 /end COMPU_METHOD
/begin COMPU_METHOD rel_ub_b100 "" RAT_FUNC "%6.3" "%" COEFFS 0 256 0 0 0 100 /end COMPU_METHOD
/begin COMPU_METHOD rel_uw_b100 "" RAT_FUNC "%6.4" "%" COEFFS 0 65536 0 0 0 100 /end COMPU_METHOD
/begin COMPU_METHOD rel_uw_q0p0234 "" RAT_FUNC "%6.4" "%" COEFFS 0 32 0 0 0 0.75 /end COMPU_METHOD
/begin COMPU_METHOD r_uw_q2 "" RAT_FUNC "%6.2" "Ohm" COEFFS 0 1 0 0 0 2 /end COMPU_METHOD
/begin COMPU_METHOD spg_q0p001_V "" RAT_FUNC "%6.5" "V" COEFFS 0 1000 0 0 0 1 /end COMPU_METHOD
/begin COMPU_METHOD spg_q1p221Em3_V "" RAT_FUNC "%6.4" "V" COEFFS 0 65536 0 0 0 80 /end COMPU_METHOD
/begin COMPU_METHOD spg_uw_q0p00488 "" RAT_FUNC "%6.4" "V" COEFFS 0 1024 0 0 0 5 /end COMPU_METHOD
/begin COMPU_METHOD SyC_PostDrv_State "" TAB_VERB "%6.3" "" COMPU_TAB_REF SyC_PostDrv_State /end COMPU_METHOD
/begin COMPU_VTAB SyC_PostDrv_State "" TAB_VERB 9 0 "SYC_POSTDRV_INACTV" 1 "SYC_POSTDRV_DSM_BGN" 2 "SYC_POSTDRV_EEP_BGN" 3 "SYC_POSTDRV_WAIT" 4 "SYC_POSTDRV_NWM" 5 "SYC_POSTDRV_DSM_END" 6 "SYC_POSTDRV_EEP_END" 7 "SYC_POSTDRV_MIN_TIME" 8 "SYC_POSTDRV_DONE" /end COMPU_VTAB
/begin COMPU_METHOD SyC_PreDrv_State "" TAB_VERB "%6.3" "" COMPU_TAB_REF SyC_PreDrv_State /end COMPU_METHOD
/begin COMPU_VTAB SyC_PreDrv_State "" TAB_VERB 10 0 "SYC_PREDRV_INI_DRV" 1 "SYC_PREDRV_DONE" 2 "SYC_PREDRV_INI_SHDWN" 3 "SYC_PREDRV_PROLONG" 4 "SYC_PREDRV_NWM" 5 "SYC_PREDRV_EEP" 6 "SYC_PREDRV_DSM" 7 "SYC_PREDRV_MR" 8 "SYC_PREDRV_MOM" 9 "SYC_PREDRV_EXIT" /end COMPU_VTAB
/begin COMPU_METHOD t100msxs_uw_b6553p6 "" RAT_FUNC "%6.3" "s" COEFFS 0 10 0 0 0 1 /end COMPU_METHOD
/begin COMPU_METHOD TCE_VAR_SY_Compu "" TAB_VERB "%6.3" "" COMPU_TAB_REF TCE_VAR_SY_Compu /end COMPU_METHOD
/begin COMPU_VTAB TCE_VAR_SY_Compu "" TAB_VERB 49 0 "kein Kundenbezug" 1 "DAI" 3 "VWW" 4 "POR" 5 "AUD" 6 "OPE" 9 "FIA" 11 "BMW" 14 "PSA" 15 "REN" 17 "ALF" 18 "SAB" 19 "VOL" 20 "NIS" 21 "GMU" 22 "FOR" 26 "IMJ" 36 "MAN" 51 "SEA" 53 "CHR" 54 "JAG" 55 "ROL" 69 "FER" 72 "TOY" 123 "MIT" 147 "HYU" 159 "HON" 160 "MAZ" 183 "CU" 190 "LRG" 204 "VVW" 214 "AVT" 242 "Iveco" 243 "DMC" 248 "SUZ" 267 "SSANGYONG" 270 "KEF" 289 "AMG" 308 "TAT" 319 "MVM" 385 "UAES" 578 "AL" 590 "SCANIA" 760 "WEICHAI" 828 "RBCD" 966 "International" 999 "ALL" 2887 "NONOX" 9454 "Fuso" /end COMPU_VTAB
/begin COMPU_METHOD TCLNTDSPLSNSRPRSNT_SC_Compu "" TAB_VERB "%6.3" "" COMPU_TAB_REF TCLNTDSPLSNSRPRSNT_SC_Compu /end COMPU_METHOD
/begin COMPU_VTAB TCLNTDSPLSNSRPRSNT_SC_Compu "" TAB_VERB 2 0 "False" 1 "True" /end COMPU_VTAB
/begin COMPU_METHOD TCSOVRDSTSCINC_SY_Compu "" TAB_VERB "%6.3" "" COMPU_TAB_REF TCSOVRDSTSCINC_SY_Compu /end COMPU_METHOD
/begin COMPU_VTAB TCSOVRDSTSCINC_SY_Compu "" TAB_VERB 2 0 "incr. TSC interv. overrides TCS interv." 1 "TCS interv. overrides incr. TSC interv." /end COMPU_VTAB
/begin COMPU_METHOD TDC_ADAP_SY_Compu "" TAB_VERB "%6.3" "" COMPU_TAB_REF TDC_ADAP_SY_Compu /end COMPU_METHOD
/begin COMPU_VTAB TDC_ADAP_SY_Compu "" TAB_VERB 4 0 "NO_TDC_ADAP" 1 "TDC_ADAP" 2 "TDC_ADAP_CPP" 3 "STAT_TDC_ADAP" /end COMPU_VTAB
/begin COMPU_METHOD TDC_UNEQLGEOM_SY_Compu "" TAB_VERB "%6.3" "" COMPU_TAB_REF TDC_UNEQLGEOM_SY_Compu /end COMPU_METHOD
/begin COMPU_VTAB TDC_UNEQLGEOM_SY_Compu "" TAB_VERB 2 0 "EQL_TDC" 1 "UNEQL_TDC" /end COMPU_VTAB
/begin COMPU_METHOD TDEV_DSQACTVT_SC_Compu "" TAB_VERB "%6.3" "" COMPU_TAB_REF TDEV_DSQACTVT_SC_Compu /end COMPU_METHOD
/begin COMPU_VTAB TDEV_DSQACTVT_SC_Compu "" TAB_VERB 2 0 "Inactive" 1 "Active" /end COMPU_VTAB
/begin COMPU_METHOD TDEV_VAR_SY_Compu "" TAB_VERB "%6.3" "" COMPU_TAB_REF TDEV_VAR_SY_Compu /end COMPU_METHOD
/begin COMPU_VTAB TDEV_VAR_SY_Compu "" TAB_VERB 46 1 "DAI" 3 "VWW" 4 "POR" 5 "AUD" 6 "OPE" 9 "FIA" 11 "BMW" 14 "PSA" 15 "REN" 17 "ALF" 18 "SAB" 19 "VOL" 20 "NIS" 21 "GMU" 22 "FOR" 26 "IMJ" 51 "SEA" 53 "CHR" 54 "JAG" 55 "ROL" 69 "FER" 72 "TOY" 112 "BMW-2wh" 123 "MIT" 147 "HYU" 159 "HON" 160 "MAZ" 183 "CU" 190 "LRG" 204 "VVW" 214 "AVT" 242 "Iveco" 243 "DMC" 248 "SUZ" 267 "SSANGYONG" 270 "KEF" 289 "AMG" 308 "TAT" 319 "MVM" 368 "Prince" 385 "UAES" 590 "Scania" 828 "RBCD" 999 "ALL" 2887 "Nonox" 9454 "Fuso" /end COMPU_VTAB
/begin COMPU_METHOD TDPDTCPVCTRL_SC_Compu "" TAB_VERB "%6.3" "" COMPU_TAB_REF TDPDTCPVCTRL_SC_Compu /end COMPU_METHOD
/begin COMPU_VTAB TDPDTCPVCTRL_SC_Compu "" TAB_VERB 2 0 "False" 1 "True" /end COMPU_VTAB
/begin COMPU_METHOD TECU_SMP480SENSPRS_SC_Compu "" TAB_VERB "%6.3" "" COMPU_TAB_REF TECU_SMP480SENSPRS_SC_Compu /end COMPU_METHOD
/begin COMPU_VTAB TECU_SMP480SENSPRS_SC_Compu "" TAB_VERB 2 0 "False" 1 "True" /end COMPU_VTAB
/begin COMPU_METHOD TECU_TMSGFMT_SC_Compu "" TAB_VERB "%6.3" "" COMPU_TAB_REF TECU_TMSGFMT_SC_Compu /end COMPU_METHOD
/begin COMPU_VTAB TECU_TMSGFMT_SC_Compu "" TAB_VERB 2 1 "MSG" 2 "MSG_ARRAY" /end COMPU_VTAB
/begin COMPU_METHOD TEGRCLR2DS_TYPAVL_SY_Compu "" TAB_VERB "%6.3" "" COMPU_TAB_REF TEGRCLR2DS_TYPAVL_SY_Compu /end COMPU_METHOD
/begin COMPU_VTAB TEGRCLR2DS_TYPAVL_SY_Compu "" TAB_VERB 2 0 "0" 1 "1" /end COMPU_VTAB
/begin COMPU_METHOD TEGRCLRDS_TYPAVL_SY_Compu "" TAB_VERB "%6.3" "" COMPU_TAB_REF TEGRCLRDS_TYPAVL_SY_Compu /end COMPU_METHOD
/begin COMPU_VTAB TEGRCLRDS_TYPAVL_SY_Compu "" TAB_VERB 2 0 "False" 1 "True" /end COMPU_VTAB
/begin COMPU_METHOD TEGRCLRLPDS_TYPAVL_SC_Compu "" TAB_VERB "%6.3" "" COMPU_TAB_REF TEGRCLRLPDS_TYPAVL_SC_Compu /end COMPU_METHOD
/begin COMPU_VTAB TEGRCLRLPDS_TYPAVL_SC_Compu "" TAB_VERB 2 0 "False" 1 "True" /end COMPU_VTAB
/begin COMPU_METHOD TEGRCLRUS_TYPAVL_SY_Compu "" TAB_VERB "%6.3" "" COMPU_TAB_REF TEGRCLRUS_TYPAVL_SY_Compu /end COMPU_METHOD
/begin COMPU_VTAB TEGRCLRUS_TYPAVL_SY_Compu "" TAB_VERB 2 0 "False" 1 "True" /end COMPU_VTAB
/begin COMPU_METHOD TEGRPIPUSSENS_SC_Compu "" TAB_VERB "%6.3" "" COMPU_TAB_REF TEGRPIPUSSENS_SC_Compu /end COMPU_METHOD
/begin COMPU_VTAB TEGRPIPUSSENS_SC_Compu "" TAB_VERB 3 0 "0" 1 "1" 2 "2" /end COMPU_VTAB
/begin COMPU_METHOD TEGRVLVHOTDS_TYPAVL_SC_Compu "" TAB_VERB "%6.3" "" COMPU_TAB_REF TEGRVLVHOTDS_TYPAVL_SC_Compu /end COMPU_METHOD
/begin COMPU_VTAB TEGRVLVHOTDS_TYPAVL_SC_Compu "" TAB_VERB 2 0 "False" 1 "True" /end COMPU_VTAB
/begin COMPU_METHOD Temp2Dyc_COMPU "" RAT_FUNC "%6.4" "deg C/%" COEFFS 0 100 0 0 0 1 /end COMPU_METHOD
/begin COMPU_METHOD TempC_float "" RAT_FUNC "%6.1" "deg C" COEFFS 0 1 273.14 0 0 1 /end COMPU_METHOD
/begin COMPU_METHOD TempDiff_Kelv_1K "" RAT_FUNC "%6.2" "K" COEFFS 0 1 0 0 0 1 /end COMPU_METHOD
/begin COMPU_METHOD Temp_Cels "" RAT_FUNC "%6.1" "deg C" COEFFS 0 10 2731.4 0 0 1 /end COMPU_METHOD
/begin COMPU_METHOD Temp_Cels1 "" RAT_FUNC "%6.1" "deg C" COEFFS 0 100 27314 0 0 1 /end COMPU_METHOD
/begin COMPU_METHOD Temp_Cels_1deg "" RAT_FUNC "%6.1" "deg C" COEFFS 0 1 273.14 0 0 1 /end COMPU_METHOD
/begin COMPU_METHOD Temp_Fahr "" RAT_FUNC "%6.1" "deg F" COEFFS 0 5.55555555555556 2553.62222222222 0 0 1 /end COMPU_METHOD
/begin COMPU_METHOD Temp_Kelv_Sec_CtT_Mon "" RAT_FUNC "%7.6" "deg C/s" COEFFS 0 40960 0 0 0 1 /end COMPU_METHOD
/begin COMPU_METHOD temp_q0p0234_o273 "" RAT_FUNC "%6.1" "Grad C" COEFFS 0 1 273.15 0 0 0.0234375 /end COMPU_METHOD
/begin COMPU_METHOD temp_q3p57Em7 "" RAT_FUNC "%9.8" "K" COEFFS 0 8388608 0 0 0 3 /end COMPU_METHOD
/begin COMPU_METHOD temp_ub_q0p75_o48 "" RAT_FUNC "%6.2" "Grad C" COEFFS 0 1 48 0 0 0.75 /end COMPU_METHOD
/begin COMPU_METHOD temp_ub_q1_o60 "" RAT_FUNC "%6.2" "Grad C" COEFFS 0 1 60 0 0 1 /end COMPU_METHOD
/begin COMPU_METHOD TFFVRES_SC_Compu "" TAB_VERB "%6.3" "" COMPU_TAB_REF TFFVRES_SC_Compu /end COMPU_METHOD
/begin COMPU_VTAB TFFVRES_SC_Compu "" TAB_VERB 2 0 "False" 1 "True" /end COMPU_VTAB
/begin COMPU_METHOD THDEV_VAR_SY_Compu "" TAB_VERB "%6.3" "" COMPU_TAB_REF THDEV_VAR_SY_Compu /end COMPU_METHOD
/begin COMPU_VTAB THDEV_VAR_SY_Compu "" TAB_VERB 49 1 "DAI" 3 "VWW" 4 "POR" 5 "AUD" 6 "OPE" 9 "FIA" 11 "BMW" 14 "PSA" 15 "REN" 17 "ALF" 18 "SAB" 19 "VOL" 20 "NIS" 21 "GMU" 22 "FOR" 26 "IMJ" 51 "SEA" 53 "CHR" 54 "JAG" 55 "ROL" 69 "FER" 72 "TOY" 123 "MIT" 147 "HYU" 159 "HON" 160 "MAZ" 183 "CU" 190 "LRG" 204 "VVW" 214 "AVT" 242 "Iveco" 243 "DMC" 248 "SUZ" 267 "SSANGYONG" 270 "KEF" 289 "AMG" 308 "TAT" 319 "MVM" 328 "MM" 385 "UAES" 590 "Scania" 760 "WEICHAI" 828 "RBCD" 858 "Kubota" 973 "Yanmar Japan" 999 "ALL" 2887 "Nonox" 9454 "Fuso" 9797 "Mitsubishi Heavy Industr" /end COMPU_VTAB
/begin COMPU_METHOD ThermalCoEff "" RAT_FUNC "%6.3" "W/m/m/k" COEFFS 0 10 0 0 0 1 /end COMPU_METHOD
/begin COMPU_METHOD TimeDeb "" RAT_FUNC "%6.1" "ms" COEFFS 0 0.1 0 0 0 1 /end COMPU_METHOD
/begin COMPU_METHOD TimeEngOn "" RAT_FUNC "%6.2" "s" COEFFS 0 1 0 0 0 1 /end COMPU_METHOD
/begin COMPU_METHOD Time_Dt "" RAT_FUNC "%9.8" "s" COEFFS 0 1000000 0 0 0 1 /end COMPU_METHOD
/begin COMPU_METHOD Time_ms "" RAT_FUNC "%6.1" "ms" COEFFS 0 0.1 0 0 0 1 /end COMPU_METHOD
/begin COMPU_METHOD Time_msec_q10_COMPU "" RAT_FUNC "%6.1" "ms" COEFFS 0 1 0 0 0 10 /end COMPU_METHOD
/begin COMPU_METHOD Time_msec_q1_COMPU "" RAT_FUNC "%6.2" "ms" COEFFS 0 1 0 0 0 1 /end COMPU_METHOD
/begin COMPU_METHOD Time_ms_100ms "" RAT_FUNC "%6.0" "ms" COEFFS 0 0.01 0 0 0 1 /end COMPU_METHOD
/begin COMPU_METHOD Time_s "" RAT_FUNC "%6.4" "s" COEFFS 0 100 0 0 0 1 /end COMPU_METHOD
/begin COMPU_METHOD Time_sec_q1_COMPU "" RAT_FUNC "%6.2" "s" COEFFS 0 1 0 0 0 1 /end COMPU_METHOD
/begin COMPU_METHOD Time_usec_q1_COMPU "" RAT_FUNC "%6.2" "us" COEFFS 0 1 0 0 0 1 /end COMPU_METHOD
/begin COMPU_METHOD TransR "" RAT_FUNC "%6.4" "-" COEFFS 0 100 0 0 0 1 /end COMPU_METHOD
/begin COMPU_METHOD Trq "" RAT_FUNC "%6.3" "Nm" COEFFS 0 10 0 0 0 1 /end COMPU_METHOD
/begin COMPU_METHOD TrqCom "" RAT_FUNC "%6.3" "Nm" COEFFS 0 5 0 0 0 1 /end COMPU_METHOD
/begin COMPU_METHOD TrqPrpHigh "" RAT_FUNC "%6.3" "Nm" COEFFS 0 10 0 0 0 1 /end COMPU_METHOD
/begin COMPU_METHOD t_q0p01 "" RAT_FUNC "%6.4" "s" COEFFS 0 100 0 0 0 1 /end COMPU_METHOD
/begin COMPU_METHOD Vel "" RAT_FUNC "%6.4" "km/h" COEFFS 0 100 0 0 0 1 /end COMPU_METHOD
/begin COMPU_METHOD Vel_CrCtl "" RAT_FUNC "%6.4" "km/h" COEFFS 0 256 0 0 0 1 /end COMPU_METHOD
/begin COMPU_METHOD Vel_CrCtl1_MPH "" RAT_FUNC "%6.2" "MPH" COEFFS 0 1 0 0 0 1 /end COMPU_METHOD
/begin COMPU_METHOD Volt "" RAT_FUNC "%6.3" "mV" COEFFS 0 5 0 0 0 1 /end COMPU_METHOD
/begin COMPU_METHOD Volt_Batt "" RAT_FUNC "%6.1" "mV" COEFFS 0 0.05 0 0 0 1 /end COMPU_METHOD
/begin COMPU_METHOD zw_q0p1 "" RAT_FUNC "%6.3" "Grad KW" COEFFS 0 10 0 0 0 1 /end COMPU_METHOD
/begin RECORD_LAYOUT Kw_Ws16 FNC_VALUES 1 SWORD COLUMN_DIR DIRECT /end RECORD_LAYOUT
/begin RECORD_LAYOUT RB_Axis_S16 NO_AXIS_PTS_X 1 SWORD AXIS_PTS_X 2 SWORD INDEX_INCR DIRECT /end RECORD_LAYOUT
/begin RECORD_LAYOUT RB_Axis_U16 NO_AXIS_PTS_X 1 UWORD AXIS_PTS_X 2 UWORD INDEX_INCR DIRECT /end RECORD_LAYOUT
/begin RECORD_LAYOUT RB_Curve_S16_S16 NO_AXIS_PTS_X 1 SWORD AXIS_PTS_X 2 SWORD INDEX_INCR DIRECT FNC_VALUES 3 SWORD COLUMN_DIR DIRECT /end RECORD_LAYOUT
/begin RECORD_LAYOUT RB_Map_S16S16_S16 NO_AXIS_PTS_X 1 SWORD NO_AXIS_PTS_Y 2 SWORD AXIS_PTS_X 3 SWORD INDEX_INCR DIRECT AXIS_PTS_Y 4 SWORD INDEX_INCR DIRECT FNC_VALUES 5 SWORD COLUMN_DIR DIRECT /end RECORD_LAYOUT
/begin RECORD_LAYOUT RB_Val_Wboolean FNC_VALUES 1 UBYTE COLUMN_DIR DIRECT /end RECORD_LAYOUT
/begin RECORD_LAYOUT RB_Val_Ws16 FNC_VALUES 1 SWORD COLUMN_DIR DIRECT /end RECORD_LAYOUT
/begin RECORD_LAYOUT RB_Val_Ws32 FNC_VALUES 1 SLONG COLUMN_DIR DIRECT /end RECORD_LAYOUT
/begin RECORD_LAYOUT RB_Val_Ws8 FNC_VALUES 1 SBYTE COLUMN_DIR DIRECT /end RECORD_LAYOUT
/begin RECORD_LAYOUT RB_Val_Wu16 FNC_VALUES 1 UWORD COLUMN_DIR DIRECT /end RECORD_LAYOUT
/begin RECORD_LAYOUT RB_Val_Wu8 FNC_VALUES 1 UBYTE COLUMN_DIR DIRECT /end RECORD_LAYOUT
/begin RECORD_LAYOUT Val_Ws16 FNC_VALUES 1 SWORD COLUMN_DIR DIRECT /end RECORD_LAYOUT
/begin RECORD_LAYOUT Val_Ws32 FNC_VALUES 1 SLONG COLUMN_DIR DIRECT /end RECORD_LAYOUT
/begin RECORD_LAYOUT Val_Wu16 FNC_VALUES 1 UWORD COLUMN_DIR DIRECT /end RECORD_LAYOUT
/begin RECORD_LAYOUT Val_Wu8 FNC_VALUES 1 UBYTE COLUMN_DIR DIRECT /end RECORD_LAYOUT
/end MODULE
/end PROJECT
