ASAP2_VERSION 1 60
/begin PROJECT MG1CA020 "MG1CA020"
/begin HEADER "" VERSION "MG1CA020_6SAY_V011_TPROT" PROJECT_NO MG1CA020 /end HEADER
/begin MODULE DIM ""
/begin MOD_COMMON "" BYTE_ORDER MSB_LAST ALIGNMENT_BYTE 1 ALIGNMENT_WORD 2 ALIGNMENT_LONG 4 ALIGNMENT_INT64 4 ALIGNMENT_FLOAT32_IEEE 4 ALIGNMENT_FLOAT64_IEEE 4 DATA_SIZE 32 /end MOD_COMMON
/begin CHARACTERISTIC ThrVlv_flgLimpAirPosnFctEnaB1_C "Limp air position enable for Bank1 Calibration" VALUE 0x804FA3B0 Val_Wu8 1.000 OneToOne 0.00 1.000 FORMAT "%5.3" EXTENDED_LIMITS 0.00 255.0 /end CHARACTERISTIC
/begin CHARACTERISTIC ThrVlv_IfClsdOffsLrnPrm_IF.nrDcycOffsLrnExeRels_C "Interface class instance, provides calibration parameters to calculate and check lower mechanical stop / Number of driving cycles by which offset learning execution is performed again" VALUE 0x804FA3B2 Val_Wu8 255.0 OneToOne 0.00 255.0 FORMAT "%5.1" /end CHARACTERISTIC
/begin CHARACTERISTIC ThrVlv_IfClsdOffsLrnPrm_IF.ratOffsLrnDutyCycThd_C "Interface class instance, provides calibration parameters to calculate and check lower mechanical stop / Duty Cycle threshold to start calculation of mechanical stop" VALUE 0x804FA3B4 Val_Ws16 511.9922 rel_q0p0078125 -256.0000 255.9922 FORMAT "%8.4" /end CHARACTERISTIC
/begin CHARACTERISTIC ThrVlv_IfClsdOffsLrnPrm_IF.ratOffsLrnStep_C "Interface class instance, provides calibration parameters to calculate and check lower mechanical stop / Position step- size to ramp into mechanical stop" VALUE 0x804FA3B6 Val_Ws16 511.9922 rel_q0p0078125 -256.0000 255.9922 FORMAT "%8.4" /end CHARACTERISTIC
/begin CHARACTERISTIC ThrVlv_IfClsdOffsLrnPrm_IF.ratOffsLrnStrtPosn_C "Interface class instance, provides calibration parameters to calculate and check lower mechanical stop / Desired position value to start ramping into mechanical stop" VALUE 0x804FA3B8 Val_Ws16 511.9922 rel_q0p0078125 -256.0000 255.9922 FORMAT "%8.4" /end CHARACTERISTIC
/begin CHARACTERISTIC ThrVlv_IfClsdOffsLrnPrm_IF.ratOffsLrnStrtRng_C "Interface class instance, provides calibration parameters to calculate and check lower mechanical stop / Range for actual position value (offset to Desired position value) to start ramping into mechanical stop" VALUE 0x804FA3BA Val_Ws16 511.9922 rel_q0p0078125 -256.0000 255.9922 FORMAT "%8.4" /end CHARACTERISTIC
/begin CHARACTERISTIC ThrVlv_IfClsdOffsLrnPrm_IF.tiOffsLrnStopPosn_C "Interface class instance, provides calibration parameters to calculate and check lower mechanical stop / Duration for average calculation of learned voltage at mechanical stop" VALUE 0x804FA3BC Val_Wu16 655.3500 t_q0p01 0.00 655.3500 FORMAT "%8.4" /end CHARACTERISTIC
/begin CHARACTERISTIC ThrVlv_IfClsdOffsLrnPrm_IF.tiOffsLrnTout_C "Interface class instance, provides calibration parameters to calculate and check lower mechanical stop / Timeout value for each individual learning step of mechanical stop learning" VALUE 0x804FA3BE Val_Wu16 655.3500 t_q0p01 0.00 655.3500 FORMAT "%8.4" /end CHARACTERISTIC
/begin CHARACTERISTIC ThrVlv_IfClsdOffsLrnPrm_IF.uElecOffsStopPosn_C "Interface class instance, provides calibration parameters to calculate and check lower mechanical stop / electrical offset for learned voltage at mechanical stop" VALUE 0x804FA3C0 Val_Wu16 79.99878 spg_q1p221Em3_V 0.00 79.99878 FORMAT "%8.5" /end CHARACTERISTIC
/begin CHARACTERISTIC ThrVlv_IfClsdOffsLrnPrm_IF.uElecStopPosn_C "Interface class instance, provides calibration parameters to calculate and check lower mechanical stop / voltage at mechanical stop in case no learned values available or offset learning error applied" VALUE 0x804FA3C2 Val_Wu16 79.99878 spg_q1p221Em3_V 0.00 79.99878 FORMAT "%8.5" /end CHARACTERISTIC
/begin CHARACTERISTIC ThrVlv_IfClsdOffsLrnPrm_IF.uElecStopSnsr1Max_C "Interface class instance, provides calibration parameters to calculate and check lower mechanical stop / Threshold for maximum voltage value allowed at mechanical stop, position sensor 1" VALUE 0x804FA3C4 Val_Wu16 79.99878 spg_q1p221Em3_V 0.00 79.99878 FORMAT "%8.5" /end CHARACTERISTIC
/begin CHARACTERISTIC ThrVlv_IfClsdOffsLrnPrm_IF.uElecStopSnsr1Min_C "Interface class instance, provides calibration parameters to calculate and check lower mechanical stop / Threshold for minimum voltage value allowed at mechanical stop, position sensor 1" VALUE 0x804FA3C6 Val_Wu16 79.99878 spg_q1p221Em3_V 0.00 79.99878 FORMAT "%8.5" /end CHARACTERISTIC
/begin CHARACTERISTIC ThrVlv_IfClsdOffsLrnPrm_IF.uOffsLrnCalcNotPlaus_C "Interface class instance, provides calibration parameters to calculate and check lower mechanical stop / Threshold for allowed voltage difference during mean value calculation at mechanical stop, position sensor 1" VALUE 0x804FA3C8 Val_Ws16 79.99878 spg_q1p221Em3_V -40.00000 39.99878 FORMAT "%8.5" /end CHARACTERISTIC
/begin CHARACTERISTIC ThrVlv_IfColdCdnOffsPrm_IF.flgCalcColdCdnOffs_C "Interface class instance, provides calibration parameters to calculate and check for position offset at cold temperature conditions / Function to calculate offset in case of cold condition and valve stuck enabled" VALUE 0x804FA3D0 Val_Wu8 1.000 OneToOne 0.00 1.000 FORMAT "%5.3" EXTENDED_LIMITS 0.00 255.0 /end CHARACTERISTIC
/begin CHARACTERISTIC ThrVlv_IfColdCdnOffsPrm_IF.flgColdCdnOffsMonRels_C "Interface class instance, provides calibration parameters to calculate and check for position offset at cold temperature conditions / Calculation of offset in case of cold conditions released by monitoring conditions" VALUE 0x804FA3D1 Val_Wu8 1.000 OneToOne 0.00 1.000 FORMAT "%5.3" EXTENDED_LIMITS 0.00 255.0 /end CHARACTERISTIC
/begin CHARACTERISTIC ThrVlv_IfColdCdnOffsPrm_IF.flgColdCdnOffsSimn_C "Interface class instance, provides calibration parameters to calculate and check for position offset at cold temperature conditions / Offset simulation in case of cold temperature condition active" VALUE 0x804FA3D2 Val_Wu8 1.000 OneToOne 0.00 1.000 FORMAT "%5.3" EXTENDED_LIMITS 0.00 255.0 /end CHARACTERISTIC
/begin CHARACTERISTIC ThrVlv_IfColdCdnOffsPrm_IF.flgColdCdnT_MAP "Interface class instance, provides calibration parameters to calculate and check for position offset at cold temperature conditions / MAP to calibrate Cold temperature condition" MAP 0x804FA3D4 Map_Xs16Ys16Ws16 1.000000 dez 0.00 1.000000 FORMAT "%8.6" EXTENDED_LIMITS -32768.00 32767.00
 /begin AXIS_DESCR STD_AXIS NO_INPUT_QUANTITY Temp_Cels 10 -3549.940 3003.560 FORMAT "%8.3" DEPOSIT ABSOLUTE /end AXIS_DESCR
 /begin AXIS_DESCR STD_AXIS NO_INPUT_QUANTITY Temp_Cels 10 -3549.940 3003.560 FORMAT "%8.3" DEPOSIT ABSOLUTE /end AXIS_DESCR
/end CHARACTERISTIC
/begin CHARACTERISTIC ThrVlv_IfColdCdnOffsPrm_IF.flgRvsColdCdnRampDwnCompl_C "Interface class instance, provides calibration parameters to calculate and check for position offset at cold temperature conditions / Stepwise ramp down of offset from cold temperature conditions to 0 at once, even if desired position is not 0, active" VALUE 0x804FA4C8 Val_Wu8 1.000 OneToOne 0.00 1.000 FORMAT "%5.3" EXTENDED_LIMITS 0.00 255.0 /end CHARACTERISTIC
/begin CHARACTERISTIC ThrVlv_IfColdCdnOffsPrm_IF.ratActGrdtColdCdnOffs_C "Interface class instance, provides calibration parameters to calculate and check for position offset at cold temperature conditions / Valve speed threshold to check for stuck valve at cold temperature conditions" VALUE 0x804FA4CA Val_Ws16 3839.941 q0p0586_pc_DIV_s -1920.000 1919.941 FORMAT "%8.3" /end CHARACTERISTIC
/begin CHARACTERISTIC ThrVlv_IfColdCdnOffsPrm_IF.ratColdCdnOffsDutyCycMax_C "Interface class instance, provides calibration parameters to calculate and check for position offset at cold temperature conditions / Duty Cycle threshold to calculate offset at cold temperature conditions" VALUE 0x804FA4CC Val_Ws16 511.9922 rel_q0p0078125 -256.0000 255.9922 FORMAT "%8.4" /end CHARACTERISTIC
/begin CHARACTERISTIC ThrVlv_IfColdCdnOffsPrm_IF.ratColdCdnOffsDutyCycMin_C "Interface class instance, provides calibration parameters to calculate and check for position offset at cold temperature conditions / Duty Cycle threshold to reduce offset from cold temperature conditions gradually" VALUE 0x804FA4CE Val_Ws16 511.9922 rel_q0p0078125 -256.0000 255.9922 FORMAT "%8.4" /end CHARACTERISTIC
/begin CHARACTERISTIC ThrVlv_IfColdCdnOffsPrm_IF.ratColdCdnOffsPosnThd_C "Interface class instance, provides calibration parameters to calculate and check for position offset at cold temperature conditions / Threshold for desired position to release check for cold temperature conditions" VALUE 0x804FA4D0 Val_Ws16 511.9922 rel_q0p0078125 -256.0000 255.9922 FORMAT "%8.4" /end CHARACTERISTIC
/begin CHARACTERISTIC ThrVlv_IfColdCdnOffsPrm_IF.ratColdCdnRelActPosn_C "Interface class instance, provides calibration parameters to calculate and check for position offset at cold temperature conditions / Threshold for actual position relative to desired position (offset) to release check for cold temperature conditions" VALUE 0x804FA4D2 Val_Ws16 511.9922 rel_q0p0078125 -256.0000 255.9922 FORMAT "%8.4" /end CHARACTERISTIC
/begin CHARACTERISTIC ThrVlv_IfColdCdnOffsPrm_IF.tAirColdCdnMltd_C "Interface class instance, provides calibration parameters to calculate and check for position offset at cold temperature conditions / Melted air temperature threshold to reduce offset from cold temperature conditions gradually" VALUE 0x804FA4D4 Val_Ws16 6553.500 Temp_Cels -3549.940 3003.560 FORMAT "%8.3" /end CHARACTERISTIC
/begin CHARACTERISTIC ThrVlv_IfColdCdnOffsPrm_IF.tEngColdCdnMltd_C "Interface class instance, provides calibration parameters to calculate and check for position offset at cold temperature conditions / Melted engine temperature threshold to reduce offset from cold temperature conditions gradually" VALUE 0x804FA4D6 Val_Ws16 6553.500 Temp_Cels -3549.940 3003.560 FORMAT "%8.3" /end CHARACTERISTIC
/begin CHARACTERISTIC ThrVlv_IfColdCdnOffsPrm_IF.tiDeltaRatActColdCdnOffsMin_C "Interface class instance, provides calibration parameters to calculate and check for position offset at cold temperature conditions / PT1 filter time for valve speed" VALUE 0x804FA4D8 Val_Ws32 2147.48364600 Time_Dt 0.00000100 2147.48364700 FORMAT "%13.8" EXTENDED_LIMITS -2147.48364800 2147.48364700 /end CHARACTERISTIC
/begin CHARACTERISTIC ThrVlv_IfColdCdnOffsPrm_IF.tiDutyCycColdCdnOffsDly_C "Interface class instance, provides calibration parameters to calculate and check for position offset at cold temperature conditions / Time for which Duty Cycle threshold must be exceeded to start calculation for offset at cold temperature conditions" VALUE 0x804FA4DC Val_Ws32 4294.96729500 Time_Dt -2147.48364800 2147.48364700 FORMAT "%13.8" /end CHARACTERISTIC
/begin CHARACTERISTIC ThrVlv_IfColdCdnOffsPrm_IF.tiDutyCycRvsColdCdnOffsDly_C "Interface class instance, provides calibration parameters to calculate and check for position offset at cold temperature conditions / Time for which Duty Cycle threshold must be exceeded to stop reducing of offset from cold temperature conditions gradually" VALUE 0x804FA4E0 Val_Ws32 4294.96729500 Time_Dt -2147.48364800 2147.48364700 FORMAT "%13.8" /end CHARACTERISTIC
/begin CHARACTERISTIC ThrVlv_IfColdCdnOffsPrm_IF.uColdCdnOffsMax_C "Interface class instance, provides calibration parameters to calculate and check for position offset at cold temperature conditions / Maximum allowed voltage offset at cold temperature conditions" VALUE 0x804FA4E4 Val_Ws16 79.99878 spg_q1p221Em3_V -40.00000 39.99878 FORMAT "%8.5" /end CHARACTERISTIC
/begin CHARACTERISTIC ThrVlv_IfColdCdnOffsPrm_IF.uColdCdnOffsMin_C "Interface class instance, provides calibration parameters to calculate and check for position offset at cold temperature conditions / Minimum allowed voltage offset at cold temperature conditions" VALUE 0x804FA4E6 Val_Ws16 79.99878 spg_q1p221Em3_V -40.00000 39.99878 FORMAT "%8.5" /end CHARACTERISTIC
/begin CHARACTERISTIC ThrVlv_IfColdCdnOffsPrm_IF.uColdCdnOffsSimn_C "Interface class instance, provides calibration parameters to calculate and check for position offset at cold temperature conditions / Simulated voltage offset for cold temperature condition" VALUE 0x804FA4E8 Val_Wu16 79.99878 spg_q1p221Em3_V 0.00 79.99878 FORMAT "%8.5" /end CHARACTERISTIC
/begin CHARACTERISTIC ThrVlv_IfColdCdnOffsPrm_IF.uColdCdnOffsStep_C "Interface class instance, provides calibration parameters to calculate and check for position offset at cold temperature conditions / Voltage step- size to reduce offset from cold temperature conditions" VALUE 0x804FA4EA Val_Wu16 79.99878 spg_q1p221Em3_V 0.00 79.99878 FORMAT "%8.5" /end CHARACTERISTIC
/begin CHARACTERISTIC ThrVlv_IfColdCdnOffsPrm_IF.uColdCdnOffs_C "Interface class instance, provides calibration parameters to calculate and check for position offset at cold temperature conditions / Additional offset to calculated offset from cold temperature conditions" VALUE 0x804FA4EC Val_Wu16 79.99878 spg_q1p221Em3_V 0.00 79.99878 FORMAT "%8.5" /end CHARACTERISTIC
/begin CHARACTERISTIC ThrVlv_IfLimpAirPosnPrm_IF.numDetLimpAirPosnCyc_C "Interface class instance, provides calibration parameters to calculate and check limp air position / Number of learning cycles to determine limp air position" VALUE 0x804FA4F0 Val_Wu8 127.0 OneToOne 0.00 127.0 FORMAT "%5.1" EXTENDED_LIMITS 0.00 255.0 /end CHARACTERISTIC
/begin CHARACTERISTIC ThrVlv_IfLimpAirPosnPrm_IF.tiLimpAirPosnCalc_C "Interface class instance, provides calibration parameters to calculate and check limp air position / Duration for avarage calculation of limp air position" VALUE 0x804FA4F2 Val_Wu16 655.3500 t_q0p01 0.00 655.3500 FORMAT "%8.4" /end CHARACTERISTIC
/begin CHARACTERISTIC ThrVlv_IfLimpAirPosnPrm_IF.tiLimpAirPosnStabDly_C "Interface class instance, provides calibration parameters to calculate and check limp air position / Time until actuator has levelled off into limp air position after power stage switch off" VALUE 0x804FA4F4 Val_Wu16 655.3500 t_q0p01 0.00 655.3500 FORMAT "%8.4" /end CHARACTERISTIC
/begin CHARACTERISTIC ThrVlv_IfLimpAirPosnPrm_IF.uLimpAirPosnDrift_C "Interface class instance, provides calibration parameters to calculate and check limp air position / Threshold for maximum drift of limp air position related to first learned value" VALUE 0x804FA4F6 Val_Wu16 79.99878 spg_q1p221Em3_V 0.00 79.99878 FORMAT "%8.5" /end CHARACTERISTIC
/begin CHARACTERISTIC ThrVlv_IfLimpAirPosnPrm_IF.uLimpAirPosnMax_C "Interface class instance, provides calibration parameters to calculate and check limp air position / Threshold for maximum absolute limp air position allowed" VALUE 0x804FA4F8 Val_Wu16 79.99878 spg_q1p221Em3_V 0.00 79.99878 FORMAT "%8.5" /end CHARACTERISTIC
/begin CHARACTERISTIC ThrVlv_IfLimpAirPosnPrm_IF.uLimpAirPosnMin_C "Interface class instance, provides calibration parameters to calculate and check limp air position / Threshold for minimum absolute limp air position allowed" VALUE 0x804FA4FA Val_Wu16 79.99878 spg_q1p221Em3_V 0.00 79.99878 FORMAT "%8.5" /end CHARACTERISTIC
/begin CHARACTERISTIC ThrVlv_IfLimpAirPosnPrm_IF.uLimpAirPosnPlaus_C "Interface class instance, provides calibration parameters to calculate and check limp air position / Threshold for plausibility check of actual learned value versus last stored value" VALUE 0x804FA4FC Val_Wu16 79.99878 spg_q1p221Em3_V 0.00 79.99878 FORMAT "%8.5" /end CHARACTERISTIC
/begin CHARACTERISTIC ThrVlv_IfOffsLrnRels_IF.nEngSpdThd_C "Interface class instance, provides calibration parameters to calculate the release conditions for offset learning / Engine speed threshold for offset learning release" VALUE 0x804FA4FE Val_Wu16 32767.50 nmot_q0p5 0.00 32767.50 FORMAT "%8.2" /end CHARACTERISTIC
/begin CHARACTERISTIC ThrVlv_IfOffsLrnRels_IF.stRlsMsk_C "Interface class instance, provides calibration parameters to calculate the release conditions for offset learning / Mask to select release conditions for offset learning" VALUE 0x804FA500 Val_Wu16 65535.00 OneToOne 0.00 65535.00 FORMAT "%8.2" /end CHARACTERISTIC
/begin CHARACTERISTIC ThrVlv_IfOffsLrnRels_IF.tAirMax_C "Interface class instance, provides calibration parameters to calculate the release conditions for offset learning / Maximum air temperature threshold for offset learning release" VALUE 0x804FA502 Val_Ws16 6553.500 Temp_Cels -3549.940 3003.560 FORMAT "%8.3" /end CHARACTERISTIC
/begin CHARACTERISTIC ThrVlv_IfOffsLrnRels_IF.tAirMin_C "Interface class instance, provides calibration parameters to calculate the release conditions for offset learning / Minimum air temperature threshold for offset learning release" VALUE 0x804FA504 Val_Ws16 6553.500 Temp_Cels -3549.940 3003.560 FORMAT "%8.3" /end CHARACTERISTIC
/begin CHARACTERISTIC ThrVlv_IfOffsLrnRels_IF.tEngMax_C "Interface class instance, provides calibration parameters to calculate the release conditions for offset learning / Maximum engine temperature threshold for offset learning release" VALUE 0x804FA506 Val_Ws16 6553.500 Temp_Cels -3549.940 3003.560 FORMAT "%8.3" /end CHARACTERISTIC
/begin CHARACTERISTIC ThrVlv_IfOffsLrnRels_IF.tEngMin_C "Interface class instance, provides calibration parameters to calculate the release conditions for offset learning / Minimum engine temperature threshold for offset learning release" VALUE 0x804FA508 Val_Ws16 6553.500 Temp_Cels -3549.940 3003.560 FORMAT "%8.3" /end CHARACTERISTIC
/begin CHARACTERISTIC ThrVlv_IfOffsLrnRels_IF.uBattMax_C "Interface class instance, provides calibration parameters to calculate the release conditions for offset learning / Maximum battery voltage threshold for offset learning release" VALUE 0x804FA50A Val_Ws16 1310700. Volt_Batt -655360.0 655340.0 FORMAT "%8.1" /end CHARACTERISTIC
/begin CHARACTERISTIC ThrVlv_IfOffsLrnRels_IF.uBattMin_C "Interface class instance, provides calibration parameters to calculate the release conditions for offset learning / Minimum battery voltage threshold for offset learning release" VALUE 0x804FA50C Val_Ws16 1310700. Volt_Batt -655360.0 655340.0 FORMAT "%8.1" /end CHARACTERISTIC
/begin CHARACTERISTIC ThrVlv_IfOffsLrnRels_IF.vVehVThd_C "Interface class instance, provides calibration parameters to calculate the release conditions for offset learning / Vehicle speed threshold for offset learning release" VALUE 0x804FA50E Val_Ws16 655.3500 Vel -327.6800 327.6700 FORMAT "%8.4" /end CHARACTERISTIC
/begin CHARACTERISTIC ThrVlv_IfOffsLrnSnsr2Prm_IF.uElecStopSnsr2Max_C "Interface class instance, provides calibration parameters to calculate and check Sensor2 values at lower mechanical stop / Threshold for maximum voltage value allowed at mechanical stop, position sensor 2" VALUE 0x804FA510 Val_Wu16 79.99878 spg_q1p221Em3_V 0.00 79.99878 FORMAT "%8.5" /end CHARACTERISTIC
/begin CHARACTERISTIC ThrVlv_IfOffsLrnSnsr2Prm_IF.uElecStopSnsr2Min_C "Interface class instance, provides calibration parameters to calculate and check Sensor2 values at lower mechanical stop / Threshold for minimum voltage value allowed at mechanical stop, position sensor 2" VALUE 0x804FA512 Val_Wu16 79.99878 spg_q1p221Em3_V 0.00 79.99878 FORMAT "%8.5" /end CHARACTERISTIC
/begin CHARACTERISTIC ThrVlv_IfOpenSprgChk_IF.flgOpenSprgChk_C "Interface class instance, provides calibration parameters to calculate open spring check. / Ceaning function enabled" VALUE 0x804FA514 Val_Wu8 1.000 OneToOne 0.00 1.000 FORMAT "%5.3" EXTENDED_LIMITS 0.00 255.0 /end CHARACTERISTIC
/begin CHARACTERISTIC ThrVlv_IfPsDiagPrm_IF.tiOpenLoadDiagTout_C "Interface class instance, provides calibration parameters to calculate and verify power stage diagnosis, bank 1 / Timeout value to wait for power stage open load- diagnosis" VALUE 0x804FA516 Val_Wu16 655.3500 t_q0p01 0.00 655.3500 FORMAT "%8.4" /end CHARACTERISTIC
/begin CHARACTERISTIC ThrVlv_IfRetSprgChkRels_IF.nEngSpdThd_C "Interface class instance, provides calibration parameters to calculate the release conditions for return spring check / Engine speed threshold for offset learning release" VALUE 0x804FA518 Val_Wu16 32767.50 nmot_q0p5 0.00 32767.50 FORMAT "%8.2" /end CHARACTERISTIC
/begin CHARACTERISTIC ThrVlv_IfRetSprgChkRels_IF.stRlsMsk_C "Interface class instance, provides calibration parameters to calculate the release conditions for return spring check / Mask to select release conditions for offset learning" VALUE 0x804FA51A Val_Wu16 65535.00 OneToOne 0.00 65535.00 FORMAT "%8.2" /end CHARACTERISTIC
/begin CHARACTERISTIC ThrVlv_IfRetSprgChkRels_IF.tAirMax_C "Interface class instance, provides calibration parameters to calculate the release conditions for return spring check / Maximum air temperature threshold for offset learning release" VALUE 0x804FA51C Val_Ws16 6553.500 Temp_Cels -3549.940 3003.560 FORMAT "%8.3" /end CHARACTERISTIC
/begin CHARACTERISTIC ThrVlv_IfRetSprgChkRels_IF.tAirMin_C "Interface class instance, provides calibration parameters to calculate the release conditions for return spring check / Minimum air temperature threshold for offset learning release" VALUE 0x804FA51E Val_Ws16 6553.500 Temp_Cels -3549.940 3003.560 FORMAT "%8.3" /end CHARACTERISTIC
/begin CHARACTERISTIC ThrVlv_IfRetSprgChkRels_IF.tEngMax_C "Interface class instance, provides calibration parameters to calculate the release conditions for return spring check / Maximum engine temperature threshold for offset learning release" VALUE 0x804FA520 Val_Ws16 6553.500 Temp_Cels -3549.940 3003.560 FORMAT "%8.3" /end CHARACTERISTIC
/begin CHARACTERISTIC ThrVlv_IfRetSprgChkRels_IF.tEngMin_C "Interface class instance, provides calibration parameters to calculate the release conditions for return spring check / Minimum engine temperature threshold for offset learning release" VALUE 0x804FA522 Val_Ws16 6553.500 Temp_Cels -3549.940 3003.560 FORMAT "%8.3" /end CHARACTERISTIC
/begin CHARACTERISTIC ThrVlv_IfRetSprgChkRels_IF.uBattMax_C "Interface class instance, provides calibration parameters to calculate the release conditions for return spring check / Maximum battery voltage threshold for offset learning release" VALUE 0x804FA524 Val_Ws16 1310700. Volt_Batt -655360.0 655340.0 FORMAT "%8.1" /end CHARACTERISTIC
/begin CHARACTERISTIC ThrVlv_IfRetSprgChkRels_IF.uBattMin_C "Interface class instance, provides calibration parameters to calculate the release conditions for return spring check / Minimum battery voltage threshold for offset learning release" VALUE 0x804FA526 Val_Ws16 1310700. Volt_Batt -655360.0 655340.0 FORMAT "%8.1" /end CHARACTERISTIC
/begin CHARACTERISTIC ThrVlv_IfRetSprgChkRels_IF.vVehVThd_C "Interface class instance, provides calibration parameters to calculate the release conditions for return spring check / Vehicle speed threshold for offset learning release" VALUE 0x804FA528 Val_Ws16 655.3500 Vel -327.6800 327.6700 FORMAT "%8.4" /end CHARACTERISTIC
/begin CHARACTERISTIC ThrVlv_IfSprgChkPrm_IF.ratLimpAirRng_C "Interface class instance, provides calibration parameters to calculate and verify return spring check / Range for actual position (offset to limp air position) to check whether limp air position is reached via return spring or via open spring" VALUE 0x804FA52A Val_Ws16 511.9922 rel_q0p0078125 -256.0000 255.9922 FORMAT "%8.4" /end CHARACTERISTIC
/begin CHARACTERISTIC ThrVlv_IfSprgChkPrm_IF.ratOpenSprgSprdRng_C "Interface class instance, provides calibration parameters to calculate and verify return spring check / Range for actual position (offset to desired value) to check whether open spring spread position is reached" VALUE 0x804FA52C Val_Ws16 511.9922 rel_q0p0078125 -256.0000 255.9922 FORMAT "%8.4" /end CHARACTERISTIC
/begin CHARACTERISTIC ThrVlv_IfSprgChkPrm_IF.ratRetSprgSprdRng_C "Interface class instance, provides calibration parameters to calculate and verify return spring check / Range for actual position (offset to desired value) to check whether return spring spread position is reached" VALUE 0x804FA52E Val_Ws16 511.9922 rel_q0p0078125 -256.0000 255.9922 FORMAT "%8.4" /end CHARACTERISTIC
/begin CHARACTERISTIC ThrVlv_IfSprgChkPrm_IF.ratRetSprgSprd_C "Interface class instance, provides calibration parameters to calculate and verify return spring check / Position by which return spring is spread starting from power off position" VALUE 0x804FA530 Val_Ws16 511.9922 rel_q0p0078125 -256.0000 255.9922 FORMAT "%8.4" /end CHARACTERISTIC
/begin CHARACTERISTIC ThrVlv_IfSprgChkPrm_IF.tiOpenSprgLimpAirPosn_C "Interface class instance, provides calibration parameters to calculate and verify return spring check / Maximum duration until limp air position must have been reached via open spring" VALUE 0x804FA532 Val_Wu16 655.3500 t_q0p01 0.00 655.3500 FORMAT "%8.4" /end CHARACTERISTIC
/begin CHARACTERISTIC ThrVlv_IfSprgChkPrm_IF.tiOpenSprgSprd_C "Interface class instance, provides calibration parameters to calculate and verify return spring check / Maximum duration until open spring spread position must have been reached" VALUE 0x804FA534 Val_Wu16 655.3500 t_q0p01 0.00 655.3500 FORMAT "%8.4" /end CHARACTERISTIC
/begin CHARACTERISTIC ThrVlv_IfSprgChkPrm_IF.tiRetSprgLimpAirPosn_C "Interface class instance, provides calibration parameters to calculate and verify return spring check / Maximum duration until limp air position must have been reached via return spring" VALUE 0x804FA536 Val_Wu16 655.3500 t_q0p01 0.00 655.3500 FORMAT "%8.4" /end CHARACTERISTIC
/begin CHARACTERISTIC ThrVlv_IfSprgChkPrm_IF.tiRetSprgSprd_C "Interface class instance, provides calibration parameters to calculate and verify return spring check / Maximum duration until return spring spread position must have been reached" VALUE 0x804FA538 Val_Wu16 655.3500 t_q0p01 0.00 655.3500 FORMAT "%8.4" /end CHARACTERISTIC
/begin CHARACTERISTIC ThrVlv_IfTmpOffsLrnPrm_IF.ratActGrdtTmpOffsLrn_C "Interface class instance, provides calibration parameters to calculate a temporary offset at lower mechanical stop / Valve speed threshold to start calculation of temporary adaptation" VALUE 0x804FA53C Val_Ws16 3839.941 q0p0586_pc_DIV_s -1920.000 1919.941 FORMAT "%8.3" /end CHARACTERISTIC
/begin CHARACTERISTIC ThrVlv_IfTmpOffsLrnPrm_IF.ratDesActDe_C "Interface class instance, provides calibration parameters to calculate a temporary offset at lower mechanical stop / Control deviation threshold to stop calculation of temporary adaptation" VALUE 0x804FA53E Val_Ws16 511.9922 rel_q0p0078125 -256.0000 255.9922 FORMAT "%8.4" /end CHARACTERISTIC
/begin CHARACTERISTIC ThrVlv_IfTmpOffsLrnPrm_IF.ratTmpOffsLrnDutyCycMax_C "Interface class instance, provides calibration parameters to calculate a temporary offset at lower mechanical stop / Duty Cycle threshold to start calculation of temporary adaptation" VALUE 0x804FA540 Val_Ws16 511.9922 rel_q0p0078125 -256.0000 255.9922 FORMAT "%8.4" /end CHARACTERISTIC
/begin CHARACTERISTIC ThrVlv_IfTmpOffsLrnPrm_IF.ratTmpOffsLrnDutyCycMin_C "Interface class instance, provides calibration parameters to calculate a temporary offset at lower mechanical stop / Duty Cycle threshold to stop calculation of temporary adaptation" VALUE 0x804FA542 Val_Ws16 511.9922 rel_q0p0078125 -256.0000 255.9922 FORMAT "%8.4" /end CHARACTERISTIC
/begin CHARACTERISTIC ThrVlv_IfTmpOffsLrnPrm_IF.ratTmpOffsLrnPosnThd_C "Interface class instance, provides calibration parameters to calculate a temporary offset at lower mechanical stop / Threshold for desired position to release temporary adaptation check" VALUE 0x804FA544 Val_Ws16 511.9922 rel_q0p0078125 -256.0000 255.9922 FORMAT "%8.4" /end CHARACTERISTIC
/begin CHARACTERISTIC ThrVlv_IfTmpOffsLrnPrm_IF.tEngTmpOffsMin_C "Interface class instance, provides calibration parameters to calculate a temporary offset at lower mechanical stop / Minimum engine temperature threshold to release temporary adaptation check" VALUE 0x804FA546 Val_Ws16 6553.500 Temp_Cels -3549.940 3003.560 FORMAT "%8.3" /end CHARACTERISTIC
/begin CHARACTERISTIC ThrVlv_IfTmpOffsLrnPrm_IF.tiDeltaRatActTmpOffsMin_C "Interface class instance, provides calibration parameters to calculate a temporary offset at lower mechanical stop / PT1 filter time for valve speed" VALUE 0x804FA548 Val_Ws32 2147.48364600 Time_Dt 0.00000100 2147.48364700 FORMAT "%13.8" EXTENDED_LIMITS -2147.48364800 2147.48364700 /end CHARACTERISTIC
/begin CHARACTERISTIC ThrVlv_IfTmpOffsLrnPrm_IF.tiDutyCycTmpOffsLrnDly_C "Interface class instance, provides calibration parameters to calculate a temporary offset at lower mechanical stop / Time for which Duty Cycle threshold must be exceeded to start calculation of temporary adaptation" VALUE 0x804FA54C Val_Ws32 4294.96729500 Time_Dt -2147.48364800 2147.48364700 FORMAT "%13.8" /end CHARACTERISTIC
/begin CHARACTERISTIC ThrVlv_IfTmpOffsLrnPrm_IF.tiTmpOffsLrnRvsAdpn_C "Interface class instance, provides calibration parameters to calculate a temporary offset at lower mechanical stop / Waiting time until a reverse adaptation of temporary offset is started" VALUE 0x804FA550 Val_Ws16 655.3500 Time_s -327.6800 327.6700 FORMAT "%8.4" /end CHARACTERISTIC
/begin CHARACTERISTIC ThrVlv_IfTmpOffsLrnPrm_IF.uTmpOffsLrnOffsMax_C "Interface class instance, provides calibration parameters to calculate a temporary offset at lower mechanical stop / Maximum allowed voltage offset for temporary adaptation" VALUE 0x804FA552 Val_Ws16 79.99878 spg_q1p221Em3_V -40.00000 39.99878 FORMAT "%8.5" /end CHARACTERISTIC
/begin CHARACTERISTIC ThrVlv_IfTmpOffsLrnPrm_IF.uTmpOffsLrnOffsMin_C "Interface class instance, provides calibration parameters to calculate a temporary offset at lower mechanical stop / Minimum allowed voltage offset for temporary adaptation" VALUE 0x804FA554 Val_Ws16 79.99878 spg_q1p221Em3_V -40.00000 39.99878 FORMAT "%8.5" /end CHARACTERISTIC
/begin CHARACTERISTIC ThrVlv_IfTmpOffsLrnPrm_IF.uTmpOffsLrnStep_C "Interface class instance, provides calibration parameters to calculate a temporary offset at lower mechanical stop / Voltage step- size by which temporary offset is increase at each calculation cycle" VALUE 0x804FA556 Val_Wu16 79.99878 spg_q1p221Em3_V 0.00 79.99878 FORMAT "%8.5" /end CHARACTERISTIC
/begin CHARACTERISTIC ThrVlv_OffsLrn_I.stOffsLrnSysStEnbl_C "Class instance of public class for offset learning / Bit Mask to enable offset learning for certain system states" VALUE 0x804FA560 Val_Wu16 65535.00 OneToOne 0.00 65535.00 FORMAT "%8.2" /end CHARACTERISTIC
/begin CHARACTERISTIC ThrVlv_OffsLrn_I.stOffsLrnTrig_C "Class instance of public class for offset learning / Bit mask to trigger offset learning or first offset learning via calibration" VALUE 0x804FA562 Val_Wu8 255.0 OneToOne 0.00 255.0 FORMAT "%5.1" /end CHARACTERISTIC
/begin CHARACTERISTIC ThrVlv_OffsLrn_I.tiOffsLrnPostDriveDly_C "Class instance of public class for offset learning / Delay time before offset learning will be started in Post Drive" VALUE 0x804FA564 Val_Ws32 4294.96729500 Time_Dt -2147.48364800 2147.48364700 FORMAT "%13.8" /end CHARACTERISTIC
/begin CHARACTERISTIC ThrVlv_OffsLrn_I.tiOffsLrnT15OnDly_C "Class instance of public class for offset learning / Delay time before offset learning will be started after T15 On" VALUE 0x804FA568 Val_Ws32 4294.96729500 Time_Dt -2147.48364800 2147.48364700 FORMAT "%13.8" /end CHARACTERISTIC
/begin CHARACTERISTIC ThrVlv_OffsLrn_I.tiPostDrivePwrStgOffDly_C "Class instance of public class for offset learning / Delay time for power stage Off indication in Post Drive" VALUE 0x804FA56C Val_Ws32 4294.96729500 Time_Dt -2147.48364800 2147.48364700 FORMAT "%13.8" /end CHARACTERISTIC
/begin CHARACTERISTIC ThrVlv_OffsLrn_I.uDiffEepStoreThres_C "Class instance of public class for offset learning / Voltage difference between old and new learned Value at lower mechanical stop to store values in EEP" VALUE 0x804FA570 Val_Wu16 79.99878 spg_q1p221Em3_V 0.00 79.99878 FORMAT "%8.5" /end CHARACTERISTIC
/begin CHARACTERISTIC ThrVlv_OffsLrn_I.uMovZon_C "Class instance of public class for offset learning / Voltage lift range which defines the moving zone 0 - 100 of the valve" VALUE 0x804FA572 Val_Wu16 79.99878 spg_q1p221Em3_V 0.00 79.99878 FORMAT "%8.5" /end CHARACTERISTIC
/begin CHARACTERISTIC ThrVlv_OffsLrn_I.uStopOpenSens1Max_C "Class instance of public class for offset learning / Maximum voltage limit for open position of the valve" VALUE 0x804FA574 Val_Wu16 79.99878 spg_q1p221Em3_V 0.00 79.99878 FORMAT "%8.5" /end CHARACTERISTIC
/begin MEASUREMENT ThrVlv_dRatPrVB1 "Slope of the throttle valve angle" UWORD rel_q0p002441 1 100 0.00 159.9976 FORMAT "%8.4" ECU_ADDRESS 0x60005318 /end MEASUREMENT
/begin MEASUREMENT ThrVlv_flgAdpnRelsB1 "Release of adaptation" UBYTE OneToOne 1 100 0.00 1.000 BIT_MASK 0x1 FORMAT "%5.3" ECU_ADDRESS 0x6000A7EB /end MEASUREMENT
/begin MEASUREMENT ThrVlv_flgColdCdnOffsActvB1 "Offset check at cold temperature conditions active" UBYTE OneToOne 1 100 0.00 1.000 BIT_MASK 0x1 FORMAT "%5.3" ECU_ADDRESS 0x6000A7EA /end MEASUREMENT
/begin MEASUREMENT ThrVlv_flgColdCdnTB1 "Cold temperature conditions detected" UBYTE OneToOne 1 100 0.00 1.000 BIT_MASK 0x1 FORMAT "%5.3" ECU_ADDRESS 0x6000A7E9 /end MEASUREMENT
/begin MEASUREMENT ThrVlv_flgDiInjB1 "Injection disabled by one of the throttle valve adaptation routines" UBYTE OneToOne 1 100 0.00 1.000 BIT_MASK 0x1 FORMAT "%5.3" ECU_ADDRESS 0x6000A7E4 /end MEASUREMENT
/begin MEASUREMENT ThrVlv_flgLimpAirPosnFctEnaB1 "Limp air position enable for Bank1" UBYTE OneToOne 1 100 0.00 1.000 BIT_MASK 0x1 FORMAT "%5.3" ECU_ADDRESS 0x6000A6D5 /end MEASUREMENT
/begin MEASUREMENT ThrVlv_flgOffsLrnAbortB1 "Offset learning aborted" UBYTE OneToOne 1 100 0.00 1.000 BIT_MASK 0x1 FORMAT "%5.3" ECU_ADDRESS 0x70002D99 /end MEASUREMENT
/begin MEASUREMENT ThrVlv_flgOffsLrnDsmClrDmdB1 "Request for DMS-Clear throttle valve offset learning, bank 1" UBYTE OneToOne 1 100 0.00 1.000 BIT_MASK 0x1 FORMAT "%5.3" ECU_ADDRESS 0x6000626F /end MEASUREMENT
/begin MEASUREMENT ThrVlv_flgOffsLrnPsOffB1 "Request powerstage off from ThrVlv_OffsLrn" UBYTE OneToOne 1 100 0.00 1.000 BIT_MASK 0x1 FORMAT "%5.3" ECU_ADDRESS 0x6000A7E1 /end MEASUREMENT
/begin MEASUREMENT ThrVlv_flgOffsLrnSucB1 "Offset learning finished successfully" UBYTE OneToOne 1 100 0.00 1.000 BIT_MASK 0x1 FORMAT "%5.3" ECU_ADDRESS 0x6000A7E0 /end MEASUREMENT
/begin MEASUREMENT ThrVlv_nrOffsLrnCycB1 "Counter of driving cycles for offset learning execution, 1st flow" UBYTE OneToOne 1 100 0.00 255.0 FORMAT "%5.1" ECU_ADDRESS 0x60036324 /end MEASUREMENT
/begin MEASUREMENT ThrVlv_nrOffsLrnStepB1 "Actual offset learning step" UWORD OneToOne 1 100 0.00 65535.00 FORMAT "%8.2" ECU_ADDRESS 0x70002C8A /end MEASUREMENT
/begin MEASUREMENT ThrVlv_OffsLrn_I.Snsr1DriftCmpArr "Class instance of public class for offset learning / Array for average calculation (sensor 1)" SWORD spg_q1p221Em3_V 1 100 -40.00000 39.99878 FORMAT "%8.5" ARRAY_SIZE 20 ECU_ADDRESS 0x6000CE90 /end MEASUREMENT
/begin MEASUREMENT ThrVlv_OffsLrn_I.Snsr2DriftCmpArr "Class instance of public class for offset learning / Array for average calculation (sensor 2)" SWORD spg_q1p221Em3_V 1 100 -40.00000 39.99878 FORMAT "%8.5" ARRAY_SIZE 20 ECU_ADDRESS 0x6000CEB8 /end MEASUREMENT
/begin MEASUREMENT ThrVlv_OffsLrn_I.USens1LWRLHPDif "Class instance of public class for offset learning / Deviation of actual to reference voltage" SLONG spg_q1p221Em3_V 1 100 -2621440.00000 2621439.99878 FORMAT "%13.5" ECU_ADDRESS 0x6000CEE0 /end MEASUREMENT
/begin MEASUREMENT ThrVlv_OffsLrn_I.dratActGrdtColdCdn "Class instance of public class for offset learning / Gradient of actual value position at check for cold temperature conditions" SWORD q0p0586_pc_DIV_s 1 100 -1920.000 1919.941 FORMAT "%8.3" ECU_ADDRESS 0x6000CEE6 /end MEASUREMENT
/begin MEASUREMENT ThrVlv_OffsLrn_I.dratActGrdtColdCdn_PT1In "Class instance of public class for offset learning / Gradient of actual value position at check for cold temperature conditions Pt1 in" SWORD q0p0586_pc_DIV_s 1 100 -1920.000 1919.941 FORMAT "%8.3" ECU_ADDRESS 0x6000CEE8 /end MEASUREMENT
/begin MEASUREMENT ThrVlv_OffsLrn_I.dratActGrdtIceChk "Class instance of public class for offset learning / Gradient of actual value position for ice check" SWORD q0p0586_pc_DIV_s 1 100 -1920.000 1919.941 FORMAT "%8.3" ECU_ADDRESS 0x6000CEEA /end MEASUREMENT
/begin MEASUREMENT ThrVlv_OffsLrn_I.dratActGrdtIceChkEngRun "Class instance of public class for offset learning / Gradient of actual value position for ice check at engine running" SWORD q0p0586_pc_DIV_s 1 100 -1920.000 1919.941 FORMAT "%8.3" ECU_ADDRESS 0x6000CEEC /end MEASUREMENT
/begin MEASUREMENT ThrVlv_OffsLrn_I.dratActGrdtTempOffsLrn "Class instance of public class for offset learning / Gradient of actual value position for temporary offset learning" SWORD q0p0586_pc_DIV_s 1 100 -1920.000 1919.941 FORMAT "%8.3" ECU_ADDRESS 0x6000CEEE /end MEASUREMENT
/begin MEASUREMENT ThrVlv_OffsLrn_I.dratActGrdtTempOffsLrn_PT1In "Class instance of public class for offset learning / Gradient of actual value position for temporary offset learning PT1 in" SWORD q0p0586_pc_DIV_s 1 100 -1920.000 1919.941 FORMAT "%8.3" ECU_ADDRESS 0x6000CEF0 /end MEASUREMENT
/begin MEASUREMENT ThrVlv_OffsLrn_I.facUBatt "Class instance of public class for offset learning / Battery voltage compensation based on 13,5V reference voltage" UWORD fak_q6p1035Em5 1 100 0.00 3.999939 FORMAT "%8.6" ECU_ADDRESS 0x6000CEF2 /end MEASUREMENT
/begin MEASUREMENT ThrVlv_OffsLrn_I.facWghtSlopSnsr1DriftNew "Class instance of public class for offset learning / New weight factor of the actual region (sensor 1)" UBYTE OneToOne 1 100 0.00 255.0 FORMAT "%5.1" ECU_ADDRESS 0x6000CEF4 /end MEASUREMENT
/begin MEASUREMENT ThrVlv_OffsLrn_I.facWghtSlopSnsr1DriftOld "Class instance of public class for offset learning / Old weight factor of the actual region (sensor 1)" UBYTE OneToOne 1 100 0.00 255.0 FORMAT "%5.1" ECU_ADDRESS 0x6000CEF5 /end MEASUREMENT
/begin MEASUREMENT ThrVlv_OffsLrn_I.facWghtSlopSnsr1DriftRng1 "Class instance of public class for offset learning / Weight factor for first, cold temperature region (sensor 1)" UBYTE OneToOne 1 100 0.00 255.0 FORMAT "%5.1" ECU_ADDRESS 0x600362E4 /end MEASUREMENT
/begin MEASUREMENT ThrVlv_OffsLrn_I.facWghtSlopSnsr1DriftRng2 "Class instance of public class for offset learning / Weight factor for second temperature region (sensor 1)" UBYTE OneToOne 1 100 0.00 255.0 FORMAT "%5.1" ECU_ADDRESS 0x600362E5 /end MEASUREMENT
/begin MEASUREMENT ThrVlv_OffsLrn_I.facWghtSlopSnsr1DriftRng3 "Class instance of public class for offset learning / Weight factor for third, hot temperature region (sensor 1)" UBYTE OneToOne 1 100 0.00 255.0 FORMAT "%5.1" ECU_ADDRESS 0x600362E6 /end MEASUREMENT
/begin MEASUREMENT ThrVlv_OffsLrn_I.facWghtSlopSnsr2DriftNew "Class instance of public class for offset learning / New weight factor of the actual region (sensor 2)" UBYTE OneToOne 1 100 0.00 255.0 FORMAT "%5.1" ECU_ADDRESS 0x6000CEF6 /end MEASUREMENT
/begin MEASUREMENT ThrVlv_OffsLrn_I.facWghtSlopSnsr2DriftOld "Class instance of public class for offset learning / Old weight factor of the actual region (sensor 2)" UBYTE OneToOne 1 100 0.00 255.0 FORMAT "%5.1" ECU_ADDRESS 0x6000CEF7 /end MEASUREMENT
/begin MEASUREMENT ThrVlv_OffsLrn_I.facWghtSlopSnsr2DriftRng1 "Class instance of public class for offset learning / Weight factor for first, cold temperature region (sensor 2)" UBYTE OneToOne 1 100 0.00 255.0 FORMAT "%5.1" ECU_ADDRESS 0x600362E7 /end MEASUREMENT
/begin MEASUREMENT ThrVlv_OffsLrn_I.facWghtSlopSnsr2DriftRng2 "Class instance of public class for offset learning / Weight factor for second temperature region (sensor 2)" UBYTE OneToOne 1 100 0.00 255.0 FORMAT "%5.1" ECU_ADDRESS 0x600362E8 /end MEASUREMENT
/begin MEASUREMENT ThrVlv_OffsLrn_I.facWghtSlopSnsr2DriftRng3 "Class instance of public class for offset learning / Weight factor for third, hot temperature region (sensor 2)" UBYTE OneToOne 1 100 0.00 255.0 FORMAT "%5.1" ECU_ADDRESS 0x600362E9 /end MEASUREMENT
/begin MEASUREMENT ThrVlv_OffsLrn_I.facWghtSnsrDriftRng0Ref "Class instance of public class for offset learning / Weight factor for the nominal reference position" UBYTE OneToOne 1 100 0.00 255.0 FORMAT "%5.1" ECU_ADDRESS 0x600362EA /end MEASUREMENT
/begin MEASUREMENT ThrVlv_OffsLrn_I.flgBrknLvrDetd "Class instance of public class for offset learning / Broken Lever has been detected" UBYTE OneToOne 1 100 0.00 1.000 BIT_MASK 0x1 FORMAT "%5.3" ECU_ADDRESS 0x6000CEF8 /end MEASUREMENT
/begin MEASUREMENT ThrVlv_OffsLrn_I.flgClngActv "Class instance of public class for offset learning / Cleaning active" UBYTE OneToOne 1 100 0.00 1.000 BIT_MASK 0x1 FORMAT "%5.3" ECU_ADDRESS 0x6000CEF9 /end MEASUREMENT
/begin MEASUREMENT ThrVlv_OffsLrn_I.flgClngCalc "Class instance of public class for offset learning / Cleaning function chosen" UBYTE OneToOne 1 100 0.00 1.000 BIT_MASK 0x1 FORMAT "%5.3" ECU_ADDRESS 0x6000CEFA /end MEASUREMENT
/begin MEASUREMENT ThrVlv_OffsLrn_I.flgClngFinshd "Class instance of public class for offset learning / Cleaning finished" UBYTE OneToOne 1 100 0.00 1.000 BIT_MASK 0x1 FORMAT "%5.3" ECU_ADDRESS 0x6000CEFB /end MEASUREMENT
/begin MEASUREMENT ThrVlv_OffsLrn_I.flgClngRampStartPosn "Class instance of public class for offset learning / Start position for cleaning to ramp to lower mechanical sto reached" UBYTE OneToOne 1 100 0.00 1.000 BIT_MASK 0x1 FORMAT "%5.3" ECU_ADDRESS 0x6000CEFC /end MEASUREMENT
/begin MEASUREMENT ThrVlv_OffsLrn_I.flgClngRels "Class instance of public class for offset learning / Cleaning released" UBYTE OneToOne 1 100 0.00 1.000 BIT_MASK 0x1 FORMAT "%5.3" ECU_ADDRESS 0x6000CEFD /end MEASUREMENT
/begin MEASUREMENT ThrVlv_OffsLrn_I.flgColdCdnOffsActv "Class instance of public class for offset learning / Offset check at cold temperature conditions active" UBYTE OneToOne 1 100 0.00 1.000 BIT_MASK 0x1 FORMAT "%5.3" ECU_ADDRESS 0x6000CEFE /end MEASUREMENT
/begin MEASUREMENT ThrVlv_OffsLrn_I.flgColdCdnT "Class instance of public class for offset learning / Cold temperature conditions detected" UBYTE OneToOne 1 100 0.00 1.000 BIT_MASK 0x1 FORMAT "%5.3" ECU_ADDRESS 0x6000CEFF /end MEASUREMENT
/begin MEASUREMENT ThrVlv_OffsLrn_I.flgDiInj "Class instance of public class for offset learning / Injection disabled by one of the adaptation routines" UBYTE OneToOne 1 100 0.00 1.000 BIT_MASK 0x1 FORMAT "%5.3" ECU_ADDRESS 0x6000CF00 /end MEASUREMENT
/begin MEASUREMENT ThrVlv_OffsLrn_I.flgDiStrtr "Class instance of public class for offset learning / condition to disable meshing of starter pinion active" UBYTE OneToOne 1 100 0.00 1.000 BIT_MASK 0x1 FORMAT "%5.3" ECU_ADDRESS 0x6000CF01 /end MEASUREMENT
/begin MEASUREMENT ThrVlv_OffsLrn_I.flgExePsDiag "Class instance of public class for offset learning / Power stage diagnosis, during offset learning functions is executed" UBYTE OneToOne 1 100 0.00 1.000 BIT_MASK 0x1 FORMAT "%5.3" ECU_ADDRESS 0x6000CF03 /end MEASUREMENT
/begin MEASUREMENT ThrVlv_OffsLrn_I.flgExtOffsLrnTrig "Class instance of public class for offset learning / external Trigger to start offset learning" UBYTE OneToOne 1 100 0.00 1.000 BIT_MASK 0x1 FORMAT "%5.3" ECU_ADDRESS 0x6000CF04 /end MEASUREMENT
/begin MEASUREMENT ThrVlv_OffsLrn_I.flgFrstLrnPrfm "Class instance of public class for offset learning / First learning performed" UBYTE OneToOne 1 100 0.00 1.000 BIT_MASK 0x1 FORMAT "%5.3" ECU_ADDRESS 0x6000CF05 /end MEASUREMENT
/begin MEASUREMENT ThrVlv_OffsLrn_I.flgFrstSnsrDriftCmp "Class instance of public class for offset learning / Flag of first sensordrift learning" UBYTE OneToOne 1 100 0.00 1.000 BIT_MASK 0x1 FORMAT "%5.3" ECU_ADDRESS 0x6000CF06 /end MEASUREMENT
/begin MEASUREMENT ThrVlv_OffsLrn_I.flgIceChkActv "Class instance of public class for offset learning / Ice check active" UBYTE OneToOne 1 100 0.00 1.000 BIT_MASK 0x1 FORMAT "%5.3" ECU_ADDRESS 0x6000CF07 /end MEASUREMENT
/begin MEASUREMENT ThrVlv_OffsLrn_I.flgIceChkClsdErr "Class instance of public class for offset learning / Ice error direction closed detected" UBYTE OneToOne 1 100 0.00 1.000 BIT_MASK 0x1 FORMAT "%5.3" ECU_ADDRESS 0x6000CF08 /end MEASUREMENT
/begin MEASUREMENT ThrVlv_OffsLrn_I.flgIceChkEngRunActv "Class instance of public class for offset learning / Ice check at engine running active" UBYTE OneToOne 1 100 0.00 1.000 BIT_MASK 0x1 FORMAT "%5.3" ECU_ADDRESS 0x6000CF09 /end MEASUREMENT
/begin MEASUREMENT ThrVlv_OffsLrn_I.flgIceChkEngRunClsd "Class instance of public class for offset learning / Ice direction closed detected for ice check at engine running" UBYTE OneToOne 1 100 0.00 1.000 BIT_MASK 0x1 FORMAT "%5.3" ECU_ADDRESS 0x6000CF0A /end MEASUREMENT
/begin MEASUREMENT ThrVlv_OffsLrn_I.flgIceChkEngRunClsdOffs "Class instance of public class for offset learning / Ice direction closed below limp air position detected, offset based on detected ice position active" UBYTE OneToOne 1 100 0.00 1.000 BIT_MASK 0x1 FORMAT "%5.3" ECU_ADDRESS 0x6000CF0B /end MEASUREMENT
/begin MEASUREMENT ThrVlv_OffsLrn_I.flgIceChkEngRunClsdOffsRels "Class instance of public class for offset learning / Offset calculation for ice below limp air position released" UBYTE OneToOne 1 100 0.00 1.000 BIT_MASK 0x1 FORMAT "%5.3" ECU_ADDRESS 0x6000CF0C /end MEASUREMENT
/begin MEASUREMENT ThrVlv_OffsLrn_I.flgIceChkEngRunExe "Class instance of public class for offset learning / Ice removal attempt for ice check at engine running is executed, including waiting for repetition" UBYTE OneToOne 1 100 0.00 1.000 BIT_MASK 0x1 FORMAT "%5.3" ECU_ADDRESS 0x6000CF0D /end MEASUREMENT
/begin MEASUREMENT ThrVlv_OffsLrn_I.flgIceChkEngRunOpen "Class instance of public class for offset learning / Ice direction open detected for ice check at engine running" UBYTE OneToOne 1 100 0.00 1.000 BIT_MASK 0x1 FORMAT "%5.3" ECU_ADDRESS 0x6000CF0E /end MEASUREMENT
/begin MEASUREMENT ThrVlv_OffsLrn_I.flgIceChkEngRunRamp "Class instance of public class for offset learning / Ramp to open position desired value active in case of successful ice removal direction open" UBYTE OneToOne 1 100 0.00 1.000 BIT_MASK 0x1 FORMAT "%5.3" ECU_ADDRESS 0x6000CF0F /end MEASUREMENT
/begin MEASUREMENT ThrVlv_OffsLrn_I.flgIceChkEngRunT "Class instance of public class for offset learning / Cold temperature conditions for ice check at engine running detected" UBYTE OneToOne 1 100 0.00 1.000 BIT_MASK 0x1 FORMAT "%5.3" ECU_ADDRESS 0x6000CF10 /end MEASUREMENT
/begin MEASUREMENT ThrVlv_OffsLrn_I.flgIceChkEngRunTog "Class instance of public class for offset learning / Offset to calculate actual set point value for ice removal attempt is added (False) or subtracted (True)" UBYTE OneToOne 1 100 0.00 1.000 BIT_MASK 0x1 FORMAT "%5.3" ECU_ADDRESS 0x6000CF11 /end MEASUREMENT
/begin MEASUREMENT ThrVlv_OffsLrn_I.flgIceChkFinshd "Class instance of public class for offset learning / Ice check finished" UBYTE OneToOne 1 100 0.00 1.000 BIT_MASK 0x1 FORMAT "%5.3" ECU_ADDRESS 0x6000CF12 /end MEASUREMENT
/begin MEASUREMENT ThrVlv_OffsLrn_I.flgIceChkOpenErr "Class instance of public class for offset learning / Ice error direction open detected" UBYTE OneToOne 1 100 0.00 1.000 BIT_MASK 0x1 FORMAT "%5.3" ECU_ADDRESS 0x6000CF13 /end MEASUREMENT
/begin MEASUREMENT ThrVlv_OffsLrn_I.flgIceChkRels "Class instance of public class for offset learning / Ice check released" UBYTE OneToOne 1 100 0.00 1.000 BIT_MASK 0x1 FORMAT "%5.3" ECU_ADDRESS 0x6000CF14 /end MEASUREMENT
/begin MEASUREMENT ThrVlv_OffsLrn_I.flgIceChkWakeupDlyFinshd "Class instance of public class for offset learning / Start delay for ice check after wake up is finished" UBYTE OneToOne 1 100 0.00 1.000 BIT_MASK 0x1 FORMAT "%5.3" ECU_ADDRESS 0x6000CF15 /end MEASUREMENT
/begin MEASUREMENT ThrVlv_OffsLrn_I.flgKeepColdCdnOffs "Class instance of public class for offset learning / Actual offset for cold temperature conditions is kept" UBYTE OneToOne 1 100 0.00 1.000 BIT_MASK 0x1 FORMAT "%5.3" ECU_ADDRESS 0x6000CF16 /end MEASUREMENT
/begin MEASUREMENT ThrVlv_OffsLrn_I.flgKeepIceChkEngRunOffs "Class instance of public class for offset learning / Actual offset from ice check at engine running is kept" UBYTE OneToOne 1 100 0.00 1.000 BIT_MASK 0x1 FORMAT "%5.3" ECU_ADDRESS 0x6000CF17 /end MEASUREMENT
/begin MEASUREMENT ThrVlv_OffsLrn_I.flgLimpAirPosnNpl "Class instance of public class for offset learning / Limp Air position not plausible" UBYTE OneToOne 1 100 0.00 1.000 BIT_MASK 0x1 FORMAT "%5.3" ECU_ADDRESS 0x6000CF19 /end MEASUREMENT
/begin MEASUREMENT ThrVlv_OffsLrn_I.flgLimpAirPosnSuc "Class instance of public class for offset learning / Learning of Limp Air position successful" UBYTE OneToOne 1 100 0.00 1.000 BIT_MASK 0x1 FORMAT "%5.3" ECU_ADDRESS 0x6000CF1A /end MEASUREMENT
/begin MEASUREMENT ThrVlv_OffsLrn_I.flgLongShoTermAdpnCalc "Class instance of public class for offset learning / Long term and short term adaptation chosen" UBYTE OneToOne 1 100 0.00 1.000 BIT_MASK 0x1 FORMAT "%5.3" ECU_ADDRESS 0x6000CF1B /end MEASUREMENT
/begin MEASUREMENT ThrVlv_OffsLrn_I.flgLongTermAdpnHist "Class instance of public class for offset learning / Long term adaptation history" UBYTE OneToOne 1 100 0.00 1.000 BIT_MASK 0x1 FORMAT "%5.3" ECU_ADDRESS 0x6000CF1C /end MEASUREMENT
/begin MEASUREMENT ThrVlv_OffsLrn_I.flgLongTermAdpnInhbn "Class instance of public class for offset learning / Long term adaptation not released" UBYTE OneToOne 1 100 0.00 1.000 BIT_MASK 0x1 FORMAT "%5.3" ECU_ADDRESS 0x6000CF1D /end MEASUREMENT
/begin MEASUREMENT ThrVlv_OffsLrn_I.flgLongTermAdpnRst "Class instance of public class for offset learning / Long term adaptation indication to reset to First learn values only once" UBYTE OneToOne 1 100 0.00 1.000 BIT_MASK 0x1 FORMAT "%5.3" ECU_ADDRESS 0x6000CF1E /end MEASUREMENT
/begin MEASUREMENT ThrVlv_OffsLrn_I.flgOffsLrnAbort "Class instance of public class for offset learning / Offset learning aborted" UBYTE OneToOne 1 100 0.00 1.000 BIT_MASK 0x1 FORMAT "%5.3" ECU_ADDRESS 0x6000CF1F /end MEASUREMENT
/begin MEASUREMENT ThrVlv_OffsLrn_I.flgOffsLrnActv "Class instance of public class for offset learning / Offset learning active" UBYTE OneToOne 1 100 0.00 1.000 BIT_MASK 0x1 FORMAT "%5.3" ECU_ADDRESS 0x6000CF20 /end MEASUREMENT
/begin MEASUREMENT ThrVlv_OffsLrn_I.flgOffsLrnClsdPosnSuc "Class instance of public class for offset learning / Offset learning of closed position successful" UBYTE OneToOne 1 100 0.00 1.000 BIT_MASK 0x1 FORMAT "%5.3" ECU_ADDRESS 0x6000CF21 /end MEASUREMENT
/begin MEASUREMENT ThrVlv_OffsLrn_I.flgOffsLrnRepnDly "Class instance of public class for offset learning / Delay until permanent offset learning can be repeated active" UBYTE OneToOne 1 100 0.00 1.000 BIT_MASK 0x1 FORMAT "%5.3" ECU_ADDRESS 0x6000CF24 /end MEASUREMENT
/begin MEASUREMENT ThrVlv_OffsLrn_I.flgOffsLrnSuc "Class instance of public class for offset learning / Offset learning successful" UBYTE OneToOne 1 100 0.00 1.000 BIT_MASK 0x1 FORMAT "%5.3" ECU_ADDRESS 0x6000CF25 /end MEASUREMENT
/begin MEASUREMENT ThrVlv_OffsLrn_I.flgOpenSprgChkCalc "Class instance of public class for offset learning / Open spring check chosen" UBYTE OneToOne 1 100 0.00 1.000 BIT_MASK 0x1 FORMAT "%5.3" ECU_ADDRESS 0x6000CF26 /end MEASUREMENT
/begin MEASUREMENT ThrVlv_OffsLrn_I.flgPSOffSnsrDriftCmp "Class instance of public class for offset learning / Flag to request disabling of power stage during sensordrift learning" UBYTE OneToOne 1 100 0.00 1.000 BIT_MASK 0x1 FORMAT "%5.3" ECU_ADDRESS 0x6000CF28 /end MEASUREMENT
/begin MEASUREMENT ThrVlv_OffsLrn_I.flgPhyRngClsdExcd "Class instance of public class for offset learning / Physical range check threshold direction closed exceeded" UBYTE OneToOne 1 100 0.00 1.000 BIT_MASK 0x1 FORMAT "%5.3" ECU_ADDRESS 0x6000CF29 /end MEASUREMENT
/begin MEASUREMENT ThrVlv_OffsLrn_I.flgPhyRngOpenExcd "Class instance of public class for offset learning / Physical range check threshold direction open exceeded" UBYTE OneToOne 1 100 0.00 1.000 BIT_MASK 0x1 FORMAT "%5.3" ECU_ADDRESS 0x6000CF2A /end MEASUREMENT
/begin MEASUREMENT ThrVlv_OffsLrn_I.flgPostDrivePwrStgOff "Class instance of public class for offset learning / Power stage off in post drive for at least .tiPostDrivePwrStgOffDly_C" UBYTE OneToOne 1 100 0.00 1.000 BIT_MASK 0x1 FORMAT "%5.3" ECU_ADDRESS 0x600362EB /end MEASUREMENT
/begin MEASUREMENT ThrVlv_OffsLrn_I.flgPrmntOffsLrnActv "Class instance of public class for offset learning / Permanent offset learning active" UBYTE OneToOne 1 100 0.00 1.000 BIT_MASK 0x1 FORMAT "%5.3" ECU_ADDRESS 0x6000CF2C /end MEASUREMENT
/begin MEASUREMENT ThrVlv_OffsLrn_I.flgPsDiagFinshd "Class instance of public class for offset learning / Power stage diagnosis, during offset learning functions finished" UBYTE OneToOne 1 100 0.00 1.000 BIT_MASK 0x1 FORMAT "%5.3" ECU_ADDRESS 0x6000CF2F /end MEASUREMENT
/begin MEASUREMENT ThrVlv_OffsLrn_I.flgPsDiagOpenLoad "Class instance of public class for offset learning / Power stage open load- diagnosis during offset learning functions is executed" UBYTE OneToOne 1 100 0.00 1.000 BIT_MASK 0x1 FORMAT "%5.3" ECU_ADDRESS 0x6000CF30 /end MEASUREMENT
/begin MEASUREMENT ThrVlv_OffsLrn_I.flgReqSnsrDriftDesPosn "Class instance of public class for offset learning / Flag to request that the sensordrift learning calculates the desired position of the throttle valve" UBYTE OneToOne 1 100 0.00 1.000 BIT_MASK 0x1 FORMAT "%5.3" ECU_ADDRESS 0x6000CF32 /end MEASUREMENT
/begin MEASUREMENT ThrVlv_OffsLrn_I.flgRetSprgChkAbort "Class instance of public class for offset learning / Return spring check aborted" UBYTE OneToOne 1 100 0.00 1.000 BIT_MASK 0x1 FORMAT "%5.3" ECU_ADDRESS 0x6000CF33 /end MEASUREMENT
/begin MEASUREMENT ThrVlv_OffsLrn_I.flgRetSprgChkActv "Class instance of public class for offset learning / Return spring check active" UBYTE OneToOne 1 100 0.00 1.000 BIT_MASK 0x1 FORMAT "%5.3" ECU_ADDRESS 0x6000CF34 /end MEASUREMENT
/begin MEASUREMENT ThrVlv_OffsLrn_I.flgRetSprgChkCalc "Class instance of public class for offset learning / Return spring check chosen" UBYTE OneToOne 1 100 0.00 1.000 BIT_MASK 0x1 FORMAT "%5.3" ECU_ADDRESS 0x6000CF35 /end MEASUREMENT
/begin MEASUREMENT ThrVlv_OffsLrn_I.flgRetSprgChkPrfm "Class instance of public class for offset learning / Return spring check performed" UBYTE OneToOne 1 100 0.00 1.000 BIT_MASK 0x1 FORMAT "%5.3" ECU_ADDRESS 0x6000CF36 /end MEASUREMENT
/begin MEASUREMENT ThrVlv_OffsLrn_I.flgRetSprgChkRls "Class instance of public class for offset learning / Return spring check released" UBYTE OneToOne 1 100 0.00 1.000 BIT_MASK 0x1 FORMAT "%5.3" ECU_ADDRESS 0x6000CF37 /end MEASUREMENT
/begin MEASUREMENT ThrVlv_OffsLrn_I.flgRetSprgChkSuc "Class instance of public class for offset learning / Return spring check successful" UBYTE OneToOne 1 100 0.00 1.000 BIT_MASK 0x1 FORMAT "%5.3" ECU_ADDRESS 0x6000CF38 /end MEASUREMENT
/begin MEASUREMENT ThrVlv_OffsLrn_I.flgRlsSnsrDriftCmp "Class instance of public class for offset learning / Flag for the release of sensordrift learning" UBYTE OneToOne 1 100 0.00 1.000 BIT_MASK 0x1 FORMAT "%5.3" ECU_ADDRESS 0x6000CF39 /end MEASUREMENT
/begin MEASUREMENT ThrVlv_OffsLrn_I.flgSnsrDriftCmpPt1Ini "Class instance of public class for offset learning / Flag to initialize pt-elements to estimate the temperature of the thorrtle valve" UBYTE OneToOne 1 100 0.00 1.000 BIT_MASK 0x1 FORMAT "%5.3" ECU_ADDRESS 0x6000CF3A /end MEASUREMENT
/begin MEASUREMENT ThrVlv_OffsLrn_I.flgSnsrDriftCmpSuc "Class instance of public class for offset learning / Flag to show successfull sensordrift learning" UBYTE OneToOne 1 100 0.00 1.000 BIT_MASK 0x1 FORMAT "%5.3" ECU_ADDRESS 0x6000CF3B /end MEASUREMENT
/begin MEASUREMENT ThrVlv_OffsLrn_I.flgTAdjmtColdIni "Class instance of public class for offset learning / Adaptation value of lower electrical stop at low temperatures has to be learned newly" UBYTE OneToOne 1 100 0.00 1.000 BIT_MASK 0x1 FORMAT "%5.3" ECU_ADDRESS 0x600362EC /end MEASUREMENT
/begin MEASUREMENT ThrVlv_OffsLrn_I.flgTAdjmtRels "Class instance of public class for offset learning / Reference temperature based calculation for temperatue related offset released" UBYTE OneToOne 1 100 0.00 1.000 BIT_MASK 0x1 FORMAT "%5.3" ECU_ADDRESS 0x6000CF3D /end MEASUREMENT
/begin MEASUREMENT ThrVlv_OffsLrn_I.flgTmpOffsLrnActv "Class instance of public class for offset learning / Temporary adaptation active" UBYTE OneToOne 1 100 0.00 1.000 BIT_MASK 0x1 FORMAT "%5.3" ECU_ADDRESS 0x6000CF3E /end MEASUREMENT
/begin MEASUREMENT ThrVlv_OffsLrn_I.flgUElStopCalcnNotPlaus "Class instance of public class for offset learning / Voltage value during calculation of mechanical stop not plausible" UBYTE OneToOne 1 100 0.00 1.000 BIT_MASK 0x1 FORMAT "%5.3" ECU_ADDRESS 0x6000CF3F /end MEASUREMENT
/begin MEASUREMENT ThrVlv_OffsLrn_I.nrClngCyc "Class instance of public class for offset learning / Counter of cleaning cycles while cleaning is performed" UBYTE OneToOne 1 100 0.00 255.0 FORMAT "%5.1" ECU_ADDRESS 0x6000CF40 /end MEASUREMENT
/begin MEASUREMENT ThrVlv_OffsLrn_I.nrClngStep "Class instance of public class for offset learning / Actual cleaning step" UBYTE OneToOne 1 100 0.00 255.0 FORMAT "%5.1" ECU_ADDRESS 0x6000CF41 /end MEASUREMENT
/begin MEASUREMENT ThrVlv_OffsLrn_I.nrDcycClng "Class instance of public class for offset learning / Counter of driving cycles for cleaning execution" UBYTE OneToOne 1 100 0.00 255.0 FORMAT "%5.1" ECU_ADDRESS 0x600362ED /end MEASUREMENT
/begin MEASUREMENT ThrVlv_OffsLrn_I.nrIceChkEngRunTogCyc "Class instance of public class for offset learning / Counter for number of attempts to remove ice at engine running" UBYTE OneToOne 1 100 0.00 255.0 FORMAT "%5.1" ECU_ADDRESS 0x6000CF42 /end MEASUREMENT
/begin MEASUREMENT ThrVlv_OffsLrn_I.nrIceChkStep "Class instance of public class for offset learning / Actual step for ice check" UBYTE OneToOne 1 100 0.00 255.0 FORMAT "%5.1" ECU_ADDRESS 0x6000CF43 /end MEASUREMENT
/begin MEASUREMENT ThrVlv_OffsLrn_I.nrIceChkWakeupCyc "Class instance of public class for offset learning / Counter for ice break attempts after wake up without engine start" UBYTE OneToOne 1 100 0.00 255.0 FORMAT "%5.1" ECU_ADDRESS 0x6000CF44 /end MEASUREMENT
/begin MEASUREMENT ThrVlv_OffsLrn_I.nrIceRmvAtmpt "Class instance of public class for offset learning / Number of attempts to remove the ice" UBYTE dez 1 100 0.00 255.0 FORMAT "%5.1" ECU_ADDRESS 0x6000CF45 /end MEASUREMENT
/begin MEASUREMENT ThrVlv_OffsLrn_I.nrOffsLrnCyc "Class instance of public class for offset learning / Counter of driving cycles for offset learning execution" UBYTE OneToOne 1 100 0.00 255.0 FORMAT "%5.1" ECU_ADDRESS 0x6000CF46 /end MEASUREMENT
/begin MEASUREMENT ThrVlv_OffsLrn_I.nrOffsLrnStep "Class instance of public class for offset learning / Actual offset learning step" UWORD OneToOne 1 100 0.00 65535.00 FORMAT "%8.2" ECU_ADDRESS 0x6000CF48 /end MEASUREMENT
/begin MEASUREMENT ThrVlv_OffsLrn_I.nrRetOpndSprgCyc "Class instance of public class for offset learning / Number of trials for transient oscillation into limp air position by open and by return spring" UBYTE OneToOne 1 100 0.00 255.0 FORMAT "%5.1" ECU_ADDRESS 0x6000CF4A /end MEASUREMENT
/begin MEASUREMENT ThrVlv_OffsLrn_I.nrRetSprgChkStep "Class instance of public class for offset learning / Actual step for return spring check" UWORD OneToOne 1 100 0.00 65535.00 FORMAT "%8.2" ECU_ADDRESS 0x6000CF4C /end MEASUREMENT
/begin MEASUREMENT ThrVlv_OffsLrn_I.nrSnsrDriftCmpStep "Class instance of public class for offset learning / Actual step of statemachine to learn sensordrift" UBYTE OneToOne 1 100 0.00 255.0 FORMAT "%5.1" ECU_ADDRESS 0x6000CF4E /end MEASUREMENT
/begin MEASUREMENT ThrVlv_OffsLrn_I.nrSnsrDriftIdx "Class instance of public class for offset learning / Index for accessing an array during average voltage calculation" UBYTE OneToOne 1 100 0.00 255.0 FORMAT "%5.1" ECU_ADDRESS 0x6000CF4F /end MEASUREMENT
/begin MEASUREMENT ThrVlv_OffsLrn_I.nrSnsrDriftRng "Class instance of public class for offset learning / Actual temperature region for sensordrift learning" UBYTE OneToOne 1 100 0.00 255.0 FORMAT "%5.1" ECU_ADDRESS 0x6000CF50 /end MEASUREMENT
/begin MEASUREMENT ThrVlv_OffsLrn_I.nrSnsrDriftVldyChkCyc "Class instance of public class for offset learning / Amount of driving cycles after which sensordrift is validated" UWORD OneToOne 1 100 0.00 65535.00 FORMAT "%8.2" ECU_ADDRESS 0x600362EE /end MEASUREMENT
/begin MEASUREMENT ThrVlv_OffsLrn_I.ratActOld "Class instance of public class for offset learning / Actual position value from previous calculation cycle" SWORD rel_q0p0078125 1 100 -256.0000 255.9922 FORMAT "%8.4" ECU_ADDRESS 0x6000CF52 /end MEASUREMENT
/begin MEASUREMENT ThrVlv_OffsLrn_I.ratActOldColdCdn "Class instance of public class for offset learning / Actual position value from previous calculation cycle for Offset check at cold temperature conditions" SWORD rel_q0p0078125 1 100 -256.0000 255.9922 FORMAT "%8.4" ECU_ADDRESS 0x6000CF54 /end MEASUREMENT
/begin MEASUREMENT ThrVlv_OffsLrn_I.ratActOldIceChk "Class instance of public class for offset learning / Actual position value from previous calculation cycle for ice check" SWORD rel_q0p0078125 1 100 -256.0000 255.9922 FORMAT "%8.4" ECU_ADDRESS 0x6000CF56 /end MEASUREMENT
/begin MEASUREMENT ThrVlv_OffsLrn_I.ratActOldIceChkEngRun "Class instance of public class for offset learning / Actual position value from previous calculation cycle for ice check at engine running" SWORD rel_q0p0078125 1 100 -256.0000 255.9922 FORMAT "%8.4" ECU_ADDRESS 0x6000CF58 /end MEASUREMENT
/begin MEASUREMENT ThrVlv_OffsLrn_I.ratDutyCycOffsLrnLim "Class instance of public class for offset learning / Value for dynamic duty cycle limitation at offset learning" SWORD rel_q0p0078125 1 100 -256.0000 255.9922 FORMAT "%8.4" ECU_ADDRESS 0x6000CF5C /end MEASUREMENT
/begin MEASUREMENT ThrVlv_OffsLrn_I.ratIceChkEngRun "Class instance of public class for offset learning / Detected ice position for ice check at engine running" SWORD rel_q0p0078125 1 100 -256.0000 255.9922 FORMAT "%8.4" ECU_ADDRESS 0x6000CF5E /end MEASUREMENT
/begin MEASUREMENT ThrVlv_OffsLrn_I.ratSnsr1DriftAct "Class instance of public class for offset learning / Gradient of sensordrift in the actual temperature region (sensor 1)" SLONG q6p357Em6_V_DIV_K 1 100 -13653.3333333 13653.3333270 FORMAT "%13.7" ECU_ADDRESS 0x600362F0 /end MEASUREMENT
/begin MEASUREMENT ThrVlv_OffsLrn_I.ratSnsr1DriftNew "Class instance of public class for offset learning / New gradient of sensordrift in the actual temperature region (sensor 1)" SLONG q6p357Em6_V_DIV_K 1 100 -13653.3333333 13653.3333270 FORMAT "%13.7" ECU_ADDRESS 0x600362F4 /end MEASUREMENT
/begin MEASUREMENT ThrVlv_OffsLrn_I.ratSnsr1DriftOld "Class instance of public class for offset learning / Old gradient of sensordrift in the actual temperature region (sensor 1)" SLONG q6p357Em6_V_DIV_K 1 100 -13653.3333333 13653.3333270 FORMAT "%13.7" ECU_ADDRESS 0x600362F8 /end MEASUREMENT
/begin MEASUREMENT ThrVlv_OffsLrn_I.ratSnsr1DriftRng1 "Class instance of public class for offset learning / Gradient of sensordrift in the first, cold temperature region (sensor 1)" SLONG q6p357Em6_V_DIV_K 1 100 -13653.3333333 13653.3333270 FORMAT "%13.7" ECU_ADDRESS 0x600362FC /end MEASUREMENT
/begin MEASUREMENT ThrVlv_OffsLrn_I.ratSnsr1DriftRng2 "Class instance of public class for offset learning / Gradient of sensordrift in the second temperature region (sensor 1)" SLONG q6p357Em6_V_DIV_K 1 100 -13653.3333333 13653.3333270 FORMAT "%13.7" ECU_ADDRESS 0x60036300 /end MEASUREMENT
/begin MEASUREMENT ThrVlv_OffsLrn_I.ratSnsr1DriftRng3 "Class instance of public class for offset learning / Gradient of sensordrift in the third, hot temperature region (sensor 1)" SLONG q6p357Em6_V_DIV_K 1 100 -13653.3333333 13653.3333270 FORMAT "%13.7" ECU_ADDRESS 0x60036304 /end MEASUREMENT
/begin MEASUREMENT ThrVlv_OffsLrn_I.ratSnsr2DriftAct "Class instance of public class for offset learning / Gradient of sensordrift in the actual temperature region (sensor 2)" SLONG q6p357Em6_V_DIV_K 1 100 -13653.3333333 13653.3333270 FORMAT "%13.7" ECU_ADDRESS 0x60036308 /end MEASUREMENT
/begin MEASUREMENT ThrVlv_OffsLrn_I.ratSnsr2DriftNew "Class instance of public class for offset learning / New gradient of sensordrift in the actual temperature region (sensor 2)" SLONG q6p357Em6_V_DIV_K 1 100 -13653.3333333 13653.3333270 FORMAT "%13.7" ECU_ADDRESS 0x6003630C /end MEASUREMENT
/begin MEASUREMENT ThrVlv_OffsLrn_I.ratSnsr2DriftOld "Class instance of public class for offset learning / Old gradient of sensordrift in the actual temperature region (sensor 2)" SLONG q6p357Em6_V_DIV_K 1 100 -13653.3333333 13653.3333270 FORMAT "%13.7" ECU_ADDRESS 0x60036310 /end MEASUREMENT
/begin MEASUREMENT ThrVlv_OffsLrn_I.ratSnsr2DriftRng1 "Class instance of public class for offset learning / Gradient of sensordrift in the first, cold temperature region (sensor 2)" SLONG q6p357Em6_V_DIV_K 1 100 -13653.3333333 13653.3333270 FORMAT "%13.7" ECU_ADDRESS 0x60036314 /end MEASUREMENT
/begin MEASUREMENT ThrVlv_OffsLrn_I.ratSnsr2DriftRng2 "Class instance of public class for offset learning / Gradient of sensordrift in the second temperature region (sensor 2)" SLONG q6p357Em6_V_DIV_K 1 100 -13653.3333333 13653.3333270 FORMAT "%13.7" ECU_ADDRESS 0x60036318 /end MEASUREMENT
/begin MEASUREMENT ThrVlv_OffsLrn_I.ratSnsr2DriftRng3 "Class instance of public class for offset learning / Gradient of sensordrift in the third, hot temperature region (sensor 2)" SLONG q6p357Em6_V_DIV_K 1 100 -13653.3333333 13653.3333270 FORMAT "%13.7" ECU_ADDRESS 0x6003631C /end MEASUREMENT
/begin MEASUREMENT ThrVlv_OffsLrn_I.stClngRlsCond "Class instance of public class for offset learning / Bitmask for status of cleaning release conditions" UWORD OneToOne 1 100 0.00 65535.00 FORMAT "%8.2" ECU_ADDRESS 0x6000CF6C /end MEASUREMENT
/begin MEASUREMENT ThrVlv_OffsLrn_I.stDevTypSC "Class instance of public class for offset learning / device type" UWORD OneToOne 1 100 0.00 65535.00 FORMAT "%8.2" ECU_ADDRESS 0x6000CF6E /end MEASUREMENT
/begin MEASUREMENT ThrVlv_OffsLrn_I.stIceChkMod "Class instance of public class for offset learning / Ice check mode" UBYTE OneToOne 1 100 0.00 255.0 FORMAT "%5.1" ECU_ADDRESS 0x6000CF70 /end MEASUREMENT
/begin MEASUREMENT ThrVlv_OffsLrn_I.stIceChkRlsCond "Class instance of public class for offset learning / Bitmask for status of ice check release conditions" UWORD OneToOne 1 100 0.00 65535.00 FORMAT "%8.2" ECU_ADDRESS 0x6000CF72 /end MEASUREMENT
/begin MEASUREMENT ThrVlv_OffsLrn_I.stLimpAirPosnLrn "Class instance of public class for offset learning / Actual learning step of limp air position" UWORD OneToOne 1 100 0.00 65535.00 FORMAT "%8.2" ECU_ADDRESS 0x6000CF74 /end MEASUREMENT
/begin MEASUREMENT ThrVlv_OffsLrn_I.stLongShoTermAdpn "Class instance of public class for offset learning / Bit mask for release status of long term and short term adaptation" UBYTE OneToOne 1 100 0.00 255.0 FORMAT "%5.1" ECU_ADDRESS 0x6000CF76 /end MEASUREMENT
/begin MEASUREMENT ThrVlv_OffsLrn_I.stMonBrknLvrDetd "Class instance of public class for offset learning / Broken lever detection monitoring status" UBYTE OneToOne 1 100 0.00 255.0 FORMAT "%5.1" ECU_ADDRESS 0x6000CF77 /end MEASUREMENT
/begin MEASUREMENT ThrVlv_OffsLrn_I.stOffsLrnOper "Class instance of public class for offset learning / Status for offset learning" UBYTE OneToOne 1 100 0.00 255.0 FORMAT "%5.1" ECU_ADDRESS 0x6000CF83 /end MEASUREMENT
/begin MEASUREMENT ThrVlv_OffsLrn_I.stOffsLrnRlsCond "Class instance of public class for offset learning / Bitmask for status of offset Learning release conditions" UWORD OneToOne 1 100 0.00 65535.00 FORMAT "%8.2" ECU_ADDRESS 0x6000CF84 /end MEASUREMENT
/begin MEASUREMENT ThrVlv_OffsLrn_I.stOffsLrnSt "Class instance of public class for offset learning / Bitmask for status of offset Learning" UWORD OneToOne 1 100 0.00 65535.00 FORMAT "%8.2" ECU_ADDRESS 0x6000CF86 /end MEASUREMENT
/begin MEASUREMENT ThrVlv_OffsLrn_I.stRetSprgChkRlsCond "Class instance of public class for offset learning / Bitmask for status of return spring release conditions" UWORD OneToOne 1 100 0.00 65535.00 FORMAT "%8.2" ECU_ADDRESS 0x6000CF88 /end MEASUREMENT
/begin MEASUREMENT ThrVlv_OffsLrn_I.tExhMnfOld "Class instance of public class for offset learning / Latest used Exhaustgas temperature manifold to calculate temperature dependent offset" SWORD Temp_Cels 1 100 -3549.940 3003.560 FORMAT "%8.3" ECU_ADDRESS 0x6000CF8A /end MEASUREMENT
/begin MEASUREMENT ThrVlv_OffsLrn_I.tExhMnfRef "Class instance of public class for offset learning / Reference exhaustgas temperature manifold after latest calculation of temperature dependent offset" SWORD Temp_Cels 1 100 -3549.940 3003.560 FORMAT "%8.3" ECU_ADDRESS 0x6000CF8C /end MEASUREMENT
/begin MEASUREMENT ThrVlv_OffsLrn_I.tSnsrDriftRngLst "Class instance of public class for offset learning / Temperature of the last successfull learning" SWORD Temp_Cels 1 100 -3549.940 3003.560 FORMAT "%8.3" ECU_ADDRESS 0x6000CF8E /end MEASUREMENT
/begin MEASUREMENT ThrVlv_OffsLrn_I.tSnsrEtcFil "Class instance of public class for offset learning / Estimated temperature of throttle valve sensor" SWORD Temp_Cels 1 100 -3549.940 3003.560 FORMAT "%8.3" ECU_ADDRESS 0x6000CF90 /end MEASUREMENT
/begin MEASUREMENT ThrVlv_OffsLrn_I.uAvgSnsr1LwrLHP "Class instance of public class for offset learning / Average sensor 1 voltage at limp home position" UWORD spg_q1p221Em3_V 1 100 0.00 79.99878 FORMAT "%8.5" ECU_ADDRESS 0x6000CF94 /end MEASUREMENT
/begin MEASUREMENT ThrVlv_OffsLrn_I.uAvgSnsr2LwrLHP "Class instance of public class for offset learning / Average sensor 2 voltage at limp home position" UWORD spg_q1p221Em3_V 1 100 0.00 79.99878 FORMAT "%8.5" ECU_ADDRESS 0x6000CF96 /end MEASUREMENT
/begin MEASUREMENT ThrVlv_OffsLrn_I.uDifElStopClsdActCold "Class instance of public class for offset learning / Voltage difference between actual learned Value at lower mechanical stop and reference value at low temperatures" SWORD spg_q1p221Em3_V 1 100 -40.00000 39.99878 FORMAT "%8.5" ECU_ADDRESS 0x6000CF98 /end MEASUREMENT
/begin MEASUREMENT ThrVlv_OffsLrn_I.uDifTOffs "Class instance of public class for offset learning / Temperature related offset for lower mechanical stop" SWORD spg_q1p221Em3_V 1 100 -40.00000 39.99878 FORMAT "%8.5" ECU_ADDRESS 0x6000CF9A /end MEASUREMENT
/begin MEASUREMENT ThrVlv_OffsLrn_I.uDifTOffsAct "Class instance of public class for offset learning / Temperature related offset for lower mechanical stop for actual calculation" SWORD spg_q1p221Em3_V 1 100 -40.00000 39.99878 FORMAT "%8.5" ECU_ADDRESS 0x6000CF9C /end MEASUREMENT
/begin MEASUREMENT ThrVlv_OffsLrn_I.uDifTOffsRef "Class instance of public class for offset learning / Temperature related offset for lower mechanical stop from previous calculation" SWORD spg_q1p221Em3_V 1 100 -40.00000 39.99878 FORMAT "%8.5" ECU_ADDRESS 0x6000CF9E /end MEASUREMENT
/begin MEASUREMENT ThrVlv_OffsLrn_I.uElStopClsdSens1 "Class instance of public class for offset learning / Actual learned sensor voltage of sensor 1 at the lower mechanical stop" UWORD spg_q1p221Em3_V 1 100 0.00 79.99878 FORMAT "%8.5" ECU_ADDRESS 0x6000CFA0 /end MEASUREMENT
/begin MEASUREMENT ThrVlv_OffsLrn_I.uElStopClsdSens1Old "Class instance of public class for offset learning / Copy of last learned sensor voltage of sensor 1 at the lower mechanical stop during permanent Offset learning" UWORD spg_q1p221Em3_V 1 100 0.00 79.99878 FORMAT "%8.5" ECU_ADDRESS 0x6000CFA4 /end MEASUREMENT
/begin MEASUREMENT ThrVlv_OffsLrn_I.uElStopClsdSens2 "Class instance of public class for offset learning / Actual learned sensor voltage of sensor 2 at the lower mechanical stop" UWORD spg_q1p221Em3_V 1 100 0.00 79.99878 FORMAT "%8.5" ECU_ADDRESS 0x6000CFA6 /end MEASUREMENT
/begin MEASUREMENT ThrVlv_OffsLrn_I.uElStopOpenSens1 "Class instance of public class for offset learning / Actual learned sensor voltage of sensor 1 at the upper mechanical stop" UWORD spg_q1p221Em3_V 1 100 0.00 79.99878 FORMAT "%8.5" ECU_ADDRESS 0x6000CFAA /end MEASUREMENT
/begin MEASUREMENT ThrVlv_OffsLrn_I.uElStopOpenSens1Frst "Class instance of public class for offset learning / Learned reference sensor voltage of sensor 1 at the upper mechanical stop" UWORD spg_q1p221Em3_V 1 100 0.00 79.99878 FORMAT "%8.5" ECU_ADDRESS 0x6000CFAC /end MEASUREMENT
/begin MEASUREMENT ThrVlv_OffsLrn_I.uElStopOpenSens2 "Class instance of public class for offset learning / Actual learned sensor voltage of sensor 2 at the upper mechanical stop" UWORD spg_q1p221Em3_V 1 100 0.00 79.99878 FORMAT "%8.5" ECU_ADDRESS 0x6000CFAE /end MEASUREMENT
/begin MEASUREMENT ThrVlv_OffsLrn_I.uElStopOpenSens2Frst "Class instance of public class for offset learning / Learned reference sensor voltage of sensor 2 at the upper mechanical stop" UWORD spg_q1p221Em3_V 1 100 0.00 79.99878 FORMAT "%8.5" ECU_ADDRESS 0x6000CFB0 /end MEASUREMENT
/begin MEASUREMENT ThrVlv_OffsLrn_I.uLimpAirPosnOpenSens1 "Class instance of public class for offset learning / Variable to sum up voltage of sensor 1 at limp air position for mean value, open spring" UWORD spg_q1p221Em3_V 1 100 0.00 79.99878 FORMAT "%8.5" ECU_ADDRESS 0x6000CFB2 /end MEASUREMENT
/begin MEASUREMENT ThrVlv_OffsLrn_I.uLimpAirPosnOpenSens2 "Class instance of public class for offset learning / Variable to sum up voltage of sensor 2 at limp air position for mean value, open spring" UWORD spg_q1p221Em3_V 1 100 0.00 79.99878 FORMAT "%8.5" ECU_ADDRESS 0x6000CFB4 /end MEASUREMENT
/begin MEASUREMENT ThrVlv_OffsLrn_I.uLimpAirPosnRetSens1 "Class instance of public class for offset learning / Variable to sum up voltage of sensor 1 at limp air position for mean value, open spring" UWORD spg_q1p221Em3_V 1 100 0.00 79.99878 FORMAT "%8.5" ECU_ADDRESS 0x6000CFB6 /end MEASUREMENT
/begin MEASUREMENT ThrVlv_OffsLrn_I.uLimpAirPosnRetSens2 "Class instance of public class for offset learning / Variable to sum up voltage of sensor 2 at limp air position for mean value, open spring" UWORD spg_q1p221Em3_V 1 100 0.00 79.99878 FORMAT "%8.5" ECU_ADDRESS 0x6000CFB8 /end MEASUREMENT
/begin MEASUREMENT ThrVlv_OffsLrn_I.uLongTermClsdSens1 "Class instance of public class for offset learning / Long term adaptation value of lower electrical stop sensor 1" UWORD spg_q1p221Em3_V 1 100 0.00 79.99878 FORMAT "%8.5" ECU_ADDRESS 0x6000CFC2 /end MEASUREMENT
/begin MEASUREMENT ThrVlv_OffsLrn_I.uSens1DeltaOldAct "Class instance of public class for offset learning / Sensor voltage difference during mean value calculation at mechanical stop in case of voltage direction turns away from mechanical stop, position sensor 1" SWORD spg_q1p221Em3_V 1 100 -40.00000 39.99878 FORMAT "%8.5" ECU_ADDRESS 0x6000CFC4 /end MEASUREMENT
/begin MEASUREMENT ThrVlv_OffsLrn_I.uSens1LimpAirPosnTmp "Class instance of public class for offset learning / Actual learned sensor voltage of sensor 1 at limp air position after mean value calculation" UWORD spg_q1p221Em3_V 1 100 0.00 79.99878 FORMAT "%8.5" ECU_ADDRESS 0x6000CFC6 /end MEASUREMENT
/begin MEASUREMENT ThrVlv_OffsLrn_I.uSens1LwrLHPref "Class instance of public class for offset learning / Nominal sensor 1 voltage at limp home position" UWORD spg_q1p221Em3_V 1 100 0.00 79.99878 FORMAT "%8.5" ECU_ADDRESS 0x60036320 /end MEASUREMENT
/begin MEASUREMENT ThrVlv_OffsLrn_I.uSens1OffsLrnCalcnOld "Class instance of public class for offset learning / voltage of sensor 1 read in previous calculation cycle during mean value calculation of sensor voltage at the mechanical stop" UWORD spg_q1p221Em3_V 1 100 0.00 79.99878 FORMAT "%8.5" ECU_ADDRESS 0x6000CFC8 /end MEASUREMENT
/begin MEASUREMENT ThrVlv_OffsLrn_I.uSens1OffsLrnTmp "Class instance of public class for offset learning / Variable for mean value calculation of actual learned sensor voltage of sensor 1 at the mechanical stop" UWORD spg_q1p221Em3_V 1 100 0.00 79.99878 FORMAT "%8.5" ECU_ADDRESS 0x6000CFCA /end MEASUREMENT
/begin MEASUREMENT ThrVlv_OffsLrn_I.uSens2DeltaOldAct "Class instance of public class for offset learning / Sensor voltage difference during mean value calculation at mechanical stop in case of voltage direction turns away from mechanical stop, position sensor 2" SWORD spg_q1p221Em3_V 1 100 -40.00000 39.99878 FORMAT "%8.5" ECU_ADDRESS 0x6000CFD0 /end MEASUREMENT
/begin MEASUREMENT ThrVlv_OffsLrn_I.uSens2LimpAirPosnTmp "Class instance of public class for offset learning / Actual learned sensor voltage of sensor 2 at limp air position after mean value calculation" UWORD spg_q1p221Em3_V 1 100 0.00 79.99878 FORMAT "%8.5" ECU_ADDRESS 0x6000CFD2 /end MEASUREMENT
/begin MEASUREMENT ThrVlv_OffsLrn_I.uSens2LwrLHPref "Class instance of public class for offset learning / Nominal sensor 2 voltage at limp home position" UWORD spg_q1p221Em3_V 1 100 0.00 79.99878 FORMAT "%8.5" ECU_ADDRESS 0x60036322 /end MEASUREMENT
/begin MEASUREMENT ThrVlv_OffsLrn_I.uSens2OffsLrnCalcnOld "Class instance of public class for offset learning / voltage of sensor 2 read in previous calculation cycle during mean value calculation of sensor voltage at the mechanical stop" UWORD spg_q1p221Em3_V 1 100 0.00 79.99878 FORMAT "%8.5" ECU_ADDRESS 0x6000CFD4 /end MEASUREMENT
/begin MEASUREMENT ThrVlv_OffsLrn_I.uSens2OffsLrnTmp "Class instance of public class for offset learning / Variable for mean value calculation of actual learned sensor voltage of sensor 2 at the mechanical stop" UWORD spg_q1p221Em3_V 1 100 0.00 79.99878 FORMAT "%8.5" ECU_ADDRESS 0x6000CFD6 /end MEASUREMENT
/begin MEASUREMENT ThrVlv_OffsLrn_I.uSensLwrLHPref_Temp "Class instance of public class for offset learning / Temporary value for the voltage of sensor 1 for the reference position" UWORD spg_q1p221Em3_V 1 100 0.00 79.99878 FORMAT "%8.5" ECU_ADDRESS 0x6000CFDC /end MEASUREMENT
/begin MEASUREMENT ThrVlv_OffsLrn_I.uShoTermClsdSens1 "Class instance of public class for offset learning / Short term adaptation value of lower electrical stop sensor 1" UWORD spg_q1p221Em3_V 1 100 0.00 79.99878 FORMAT "%8.5" ECU_ADDRESS 0x6000CFDE /end MEASUREMENT
/begin MEASUREMENT ThrVlv_OffsLrn_I.uSnsr1TDriftOffs "Class instance of public class for offset learning / Calculated offset compared to reference value for sensor 1 voltage at the actual temperature" SWORD spg_q1p221Em3_V 1 100 -40.00000 39.99878 FORMAT "%8.5" ECU_ADDRESS 0x6000CFE0 /end MEASUREMENT
/begin MEASUREMENT ThrVlv_OffsLrn_I.uSnsr1TDriftOffsLimd "Class instance of public class for offset learning / Limited offset for sensor 1" SWORD spg_q1p221Em3_V 1 100 -40.00000 39.99878 FORMAT "%8.5" ECU_ADDRESS 0x6000CFE2 /end MEASUREMENT
/begin MEASUREMENT ThrVlv_OffsLrn_I.uSnsr2TDriftOffs "Class instance of public class for offset learning / Calculated offset compared to reference value for sensor 2 voltage at the actual temperature" SWORD spg_q1p221Em3_V 1 100 -40.00000 39.99878 FORMAT "%8.5" ECU_ADDRESS 0x6000CFE4 /end MEASUREMENT
/begin MEASUREMENT ThrVlv_OffsLrn_I.uSnsr2TDriftOffsLimd "Class instance of public class for offset learning / Limited offset for sensor 2" SWORD spg_q1p221Em3_V 1 100 -40.00000 39.99878 FORMAT "%8.5" ECU_ADDRESS 0x6000CFE6 /end MEASUREMENT
/begin MEASUREMENT ThrVlv_OffsLrn_I.uStopColdCdnSens1 "Class instance of public class for offset learning / Calculated offset at cold temperature conditions for actual learned sensor voltage of sensor 1" SWORD spg_q1p221Em3_V 1 100 -40.00000 39.99878 FORMAT "%8.5" ECU_ADDRESS 0x6000CFE8 /end MEASUREMENT
/begin MEASUREMENT ThrVlv_OffsLrn_I.uStopColdCdnSens2 "Class instance of public class for offset learning / Calculated offset at cold temperature conditions for actual learned sensor voltage of sensor 2" SWORD spg_q1p221Em3_V 1 100 -40.00000 39.99878 FORMAT "%8.5" ECU_ADDRESS 0x6000CFEA /end MEASUREMENT
/begin MEASUREMENT ThrVlv_OffsLrn_I.uStopIceChkEngRunSens1 "Class instance of public class for offset learning / Calculated offset for ice check at engine running for actual learned sensor voltage of sensor 1" SWORD spg_q1p221Em3_V 1 100 -40.00000 39.99878 FORMAT "%8.5" ECU_ADDRESS 0x6000CFEC /end MEASUREMENT
/begin MEASUREMENT ThrVlv_OffsLrn_I.uStopIceChkEngRunSens2 "Class instance of public class for offset learning / Calculated offset for ice check at engine running for actual learned sensor voltage of sensor 2" SWORD spg_q1p221Em3_V 1 100 -40.00000 39.99878 FORMAT "%8.5" ECU_ADDRESS 0x6000CFEE /end MEASUREMENT
/begin MEASUREMENT ThrVlv_OffsLrn_I.uSumSens1 "Class instance of public class for offset learning / Sum of sensor 1 during the calculation of an average value" ULONG spg_q1p221Em3_V 1 100 0.00 5242879.99878 FORMAT "%13.5" ECU_ADDRESS 0x6000CFF0 /end MEASUREMENT
/begin MEASUREMENT ThrVlv_OffsLrn_I.uSumSens2 "Class instance of public class for offset learning / Sum of sensor 2 during the calculation of an average value" ULONG spg_q1p221Em3_V 1 100 0.00 5242879.99878 FORMAT "%13.5" ECU_ADDRESS 0x6000CFF4 /end MEASUREMENT
/begin MEASUREMENT ThrVlv_OffsLrn_I.uTAdjmtColdClsdSens1 "Class instance of public class for offset learning / Adaptation value of lower electrical stop sensor 1 bank 1, learned at low temperatures" UWORD spg_q1p221Em3_V 1 100 0.00 79.99878 FORMAT "%8.5" ECU_ADDRESS 0x6000CFF8 /end MEASUREMENT
/begin MEASUREMENT ThrVlv_OffsLrn_I.uTmpStopClsdSens1 "Class instance of public class for offset learning / Temporary learned offset for actual learned sensor voltage of sensor 1" SWORD spg_q1p221Em3_V 1 100 -40.00000 39.99878 FORMAT "%8.5" ECU_ADDRESS 0x6000CFFA /end MEASUREMENT
/begin MEASUREMENT ThrVlv_OffsLrn_I.uTmpStopClsdSens2 "Class instance of public class for offset learning / Temporary learned offset for actual learned sensor voltage of sensor 2" SWORD spg_q1p221Em3_V 1 100 -40.00000 39.99878 FORMAT "%8.5" ECU_ADDRESS 0x6000CFFC /end MEASUREMENT
/begin MEASUREMENT ThrVlv_ratAdpnB1 "Desired value for adaptation of throttle valve of motor bench one" SWORD rel_q0p0078125 1 100 -256.0000 255.9922 FORMAT "%8.4" ECU_ADDRESS 0x60005388 /end MEASUREMENT
/begin MEASUREMENT ThrVlv_ratLimpAirPosnB1 "Limp home position of the throttle valve" SWORD rel_q0p0078125 1 100 -256.0000 255.9922 FORMAT "%8.4" ECU_ADDRESS 0x60005380 /end MEASUREMENT
/begin MEASUREMENT ThrVlv_ratOffsClsdPosnB1 "Offset for the lower mechanical stop because of dirt" SWORD rel_q0p0078125 1 100 -256.0000 255.9922 FORMAT "%8.4" ECU_ADDRESS 0x6000537E /end MEASUREMENT
/begin MEASUREMENT ThrVlv_ratOpenPosnMaxB1 "Upper limitation of the desired value" SWORD rel_q0p0078125 1 100 -256.0000 255.9922 FORMAT "%8.4" ECU_ADDRESS 0x6000537C /end MEASUREMENT
/begin MEASUREMENT ThrVlv_stCmbTyp_MP "measurement point combustion type" UBYTE OneToOne 1 100 0.00 255.0 FORMAT "%5.1" ECU_ADDRESS 0x700089CA /end MEASUREMENT
/begin MEASUREMENT ThrVlv_stMonClsdPosnOffsLrnB1 "Offset learning monitoring status for lower mechanical stop" UBYTE OneToOne 1 100 0.00 255.0 FORMAT "%5.1" ECU_ADDRESS 0x70002DA2 /end MEASUREMENT
/begin MEASUREMENT ThrVlv_stMonIceDetdB1 "Monitoring status for ice breaking" UBYTE OneToOne 1 100 0.00 255.0 FORMAT "%5.1" ECU_ADDRESS 0x70002DA3 /end MEASUREMENT
/begin MEASUREMENT ThrVlv_stMonLimpAirPosnLrnB1 "Offset learning monitoring status for limp air position" UBYTE OneToOne 1 100 0.00 255.0 FORMAT "%5.1" ECU_ADDRESS 0x70002DA4 /end MEASUREMENT
/begin MEASUREMENT ThrVlv_stMonOpenSprgChkB1 "Monitoring status for opening spring check" UBYTE OneToOne 1 100 0.00 255.0 FORMAT "%5.1" ECU_ADDRESS 0x70002DA5 /end MEASUREMENT
/begin MEASUREMENT ThrVlv_stMonRetSprgChkB1 "Monitoring status for return spring check" UBYTE OneToOne 1 100 0.00 255.0 FORMAT "%5.1" ECU_ADDRESS 0x70002DA6 /end MEASUREMENT
/begin MEASUREMENT ThrVlv_stOffsLrnAbortCaseB1 "Bitmask with abortion cases of offset learning" UBYTE OneToOne 1 100 0.00 255.0 FORMAT "%5.1" ECU_ADDRESS 0x6000A6E9 /end MEASUREMENT
/begin MEASUREMENT ThrVlv_stOffsLrnOperB1 "Status of offset learning process" UBYTE OneToOne 1 100 0.00 255.0 FORMAT "%5.1" ECU_ADDRESS 0x70002DA7 /end MEASUREMENT
/begin MEASUREMENT ThrVlv_stOffsLrnStB1 "status bit list of offset learning" UWORD OneToOne 1 100 0.00 65535.00 FORMAT "%8.2" ECU_ADDRESS 0x60005310 /end MEASUREMENT
/begin MEASUREMENT ThrVlv_uElStopClsdSens1B1 "Actual learned sensor voltage of sensor 1 at the lower mechanical stop" UWORD spg_q1p221Em3_V 1 100 0.00 79.99878 FORMAT "%8.5" ECU_ADDRESS 0x70002C92 /end MEASUREMENT
/begin MEASUREMENT ThrVlv_uElStopClsdSens1FrstB1 "Learned reference sensor voltage of sensor 1 at the lower mechanical stop" UWORD spg_q1p221Em3_V 1 100 0.00 79.99878 FORMAT "%8.5" ECU_ADDRESS 0x6000530E /end MEASUREMENT
/begin MEASUREMENT ThrVlv_uElStopClsdSens2B1 "Actual learned sensor voltage of sensor 2 at the lower mechanical stop" UWORD spg_q1p221Em3_V 1 100 0.00 79.99878 FORMAT "%8.5" ECU_ADDRESS 0x70002C94 /end MEASUREMENT
/begin MEASUREMENT ThrVlv_uElStopClsdSens2FrstB1 "Learned reference sensor voltage of sensor 2 at the lower mechanical stop" UWORD spg_q1p221Em3_V 1 100 0.00 79.99878 FORMAT "%8.5" ECU_ADDRESS 0x6000530C /end MEASUREMENT
/begin MEASUREMENT ThrVlv_uLimpAirPosnSens1B1 "Learned sensor voltage of sensor 1 at limp air position, bank 1" UWORD spg_q1p221Em3_V 1 100 0.00 79.99878 FORMAT "%8.5" ECU_ADDRESS 0x70002C96 /end MEASUREMENT
/begin MEASUREMENT ThrVlv_uLimpAirPosnSens1FrstB1_MP "Learned reference sensor voltage of sensor 1 at limp air position" UWORD spg_q1p221Em3_V 1 100 0.00 79.99878 FORMAT "%8.5" ECU_ADDRESS 0x700087C6 /end MEASUREMENT
/begin MEASUREMENT ThrVlv_uLimpAirPosnSens2B1 "Learned sensor voltage of sensor 2 at limp air position, bank 1" UWORD spg_q1p221Em3_V 1 100 0.00 79.99878 FORMAT "%8.5" ECU_ADDRESS 0x70002C98 /end MEASUREMENT
/begin FUNCTION ThrVlv_OffsLrn "1.37.0    Adaptation of mechanical characteristic values"
 /begin DEF_CHARACTERISTIC ThrVlv_flgLimpAirPosnFctEnaB1_C ThrVlv_IfClsdOffsLrnPrm_IF.nrDcycOffsLrnExeRels_C ThrVlv_IfClsdOffsLrnPrm_IF.ratOffsLrnDutyCycThd_C ThrVlv_IfClsdOffsLrnPrm_IF.ratOffsLrnStep_C ThrVlv_IfClsdOffsLrnPrm_IF.ratOffsLrnStrtPosn_C ThrVlv_IfClsdOffsLrnPrm_IF.ratOffsLrnStrtRng_C ThrVlv_IfClsdOffsLrnPrm_IF.tiOffsLrnStopPosn_C ThrVlv_IfClsdOffsLrnPrm_IF.tiOffsLrnTout_C ThrVlv_IfClsdOffsLrnPrm_IF.uElecOffsStopPosn_C ThrVlv_IfClsdOffsLrnPrm_IF.uElecStopPosn_C ThrVlv_IfClsdOffsLrnPrm_IF.uElecStopSnsr1Max_C ThrVlv_IfClsdOffsLrnPrm_IF.uElecStopSnsr1Min_C ThrVlv_IfClsdOffsLrnPrm_IF.uOffsLrnCalcNotPlaus_C ThrVlv_IfColdCdnOffsPrm_IF.flgCalcColdCdnOffs_C ThrVlv_IfColdCdnOffsPrm_IF.flgColdCdnOffsMonRels_C ThrVlv_IfColdCdnOffsPrm_IF.flgColdCdnOffsSimn_C ThrVlv_IfColdCdnOffsPrm_IF.flgColdCdnT_MAP ThrVlv_IfColdCdnOffsPrm_IF.flgRvsColdCdnRampDwnCompl_C ThrVlv_IfColdCdnOffsPrm_IF.ratActGrdtColdCdnOffs_C ThrVlv_IfColdCdnOffsPrm_IF.ratColdCdnOffsDutyCycMax_C ThrVlv_IfColdCdnOffsPrm_IF.ratColdCdnOffsDutyCycMin_C ThrVlv_IfColdCdnOffsPrm_IF.ratColdCdnOffsPosnThd_C ThrVlv_IfColdCdnOffsPrm_IF.ratColdCdnRelActPosn_C ThrVlv_IfColdCdnOffsPrm_IF.tAirColdCdnMltd_C ThrVlv_IfColdCdnOffsPrm_IF.tEngColdCdnMltd_C ThrVlv_IfColdCdnOffsPrm_IF.tiDeltaRatActColdCdnOffsMin_C ThrVlv_IfColdCdnOffsPrm_IF.tiDutyCycColdCdnOffsDly_C ThrVlv_IfColdCdnOffsPrm_IF.tiDutyCycRvsColdCdnOffsDly_C ThrVlv_IfColdCdnOffsPrm_IF.uColdCdnOffsMax_C ThrVlv_IfColdCdnOffsPrm_IF.uColdCdnOffsMin_C ThrVlv_IfColdCdnOffsPrm_IF.uColdCdnOffsSimn_C ThrVlv_IfColdCdnOffsPrm_IF.uColdCdnOffsStep_C ThrVlv_IfColdCdnOffsPrm_IF.uColdCdnOffs_C ThrVlv_IfLimpAirPosnPrm_IF.numDetLimpAirPosnCyc_C ThrVlv_IfLimpAirPosnPrm_IF.tiLimpAirPosnCalc_C ThrVlv_IfLimpAirPosnPrm_IF.tiLimpAirPosnStabDly_C ThrVlv_IfLimpAirPosnPrm_IF.uLimpAirPosnDrift_C ThrVlv_IfLimpAirPosnPrm_IF.uLimpAirPosnMax_C ThrVlv_IfLimpAirPosnPrm_IF.uLimpAirPosnMin_C ThrVlv_IfLimpAirPosnPrm_IF.uLimpAirPosnPlaus_C ThrVlv_IfOffsLrnRels_IF.nEngSpdThd_C ThrVlv_IfOffsLrnRels_IF.stRlsMsk_C ThrVlv_IfOffsLrnRels_IF.tAirMax_C ThrVlv_IfOffsLrnRels_IF.tAirMin_C ThrVlv_IfOffsLrnRels_IF.tEngMax_C ThrVlv_IfOffsLrnRels_IF.tEngMin_C ThrVlv_IfOffsLrnRels_IF.uBattMax_C ThrVlv_IfOffsLrnRels_IF.uBattMin_C ThrVlv_IfOffsLrnRels_IF.vVehVThd_C ThrVlv_IfOffsLrnSnsr2Prm_IF.uElecStopSnsr2Max_C ThrVlv_IfOffsLrnSnsr2Prm_IF.uElecStopSnsr2Min_C ThrVlv_IfOpenSprgChk_IF.flgOpenSprgChk_C ThrVlv_IfPsDiagPrm_IF.tiOpenLoadDiagTout_C ThrVlv_IfRetSprgChkRels_IF.nEngSpdThd_C ThrVlv_IfRetSprgChkRels_IF.stRlsMsk_C ThrVlv_IfRetSprgChkRels_IF.tAirMax_C ThrVlv_IfRetSprgChkRels_IF.tAirMin_C ThrVlv_IfRetSprgChkRels_IF.tEngMax_C ThrVlv_IfRetSprgChkRels_IF.tEngMin_C ThrVlv_IfRetSprgChkRels_IF.uBattMax_C ThrVlv_IfRetSprgChkRels_IF.uBattMin_C ThrVlv_IfRetSprgChkRels_IF.vVehVThd_C ThrVlv_IfSprgChkPrm_IF.ratLimpAirRng_C ThrVlv_IfSprgChkPrm_IF.ratOpenSprgSprdRng_C ThrVlv_IfSprgChkPrm_IF.ratRetSprgSprdRng_C ThrVlv_IfSprgChkPrm_IF.ratRetSprgSprd_C ThrVlv_IfSprgChkPrm_IF.tiOpenSprgLimpAirPosn_C ThrVlv_IfSprgChkPrm_IF.tiOpenSprgSprd_C ThrVlv_IfSprgChkPrm_IF.tiRetSprgLimpAirPosn_C ThrVlv_IfSprgChkPrm_IF.tiRetSprgSprd_C ThrVlv_IfTmpOffsLrnPrm_IF.ratActGrdtTmpOffsLrn_C ThrVlv_IfTmpOffsLrnPrm_IF.ratDesActDe_C ThrVlv_IfTmpOffsLrnPrm_IF.ratTmpOffsLrnDutyCycMax_C ThrVlv_IfTmpOffsLrnPrm_IF.ratTmpOffsLrnDutyCycMin_C ThrVlv_IfTmpOffsLrnPrm_IF.ratTmpOffsLrnPosnThd_C ThrVlv_IfTmpOffsLrnPrm_IF.tEngTmpOffsMin_C ThrVlv_IfTmpOffsLrnPrm_IF.tiDeltaRatActTmpOffsMin_C ThrVlv_IfTmpOffsLrnPrm_IF.tiDutyCycTmpOffsLrnDly_C ThrVlv_IfTmpOffsLrnPrm_IF.tiTmpOffsLrnRvsAdpn_C ThrVlv_IfTmpOffsLrnPrm_IF.uTmpOffsLrnOffsMax_C ThrVlv_IfTmpOffsLrnPrm_IF.uTmpOffsLrnOffsMin_C ThrVlv_IfTmpOffsLrnPrm_IF.uTmpOffsLrnStep_C ThrVlv_OffsLrn_I.stOffsLrnSysStEnbl_C ThrVlv_OffsLrn_I.stOffsLrnTrig_C ThrVlv_OffsLrn_I.tiOffsLrnPostDriveDly_C ThrVlv_OffsLrn_I.tiOffsLrnT15OnDly_C ThrVlv_OffsLrn_I.tiPostDrivePwrStgOffDly_C ThrVlv_OffsLrn_I.uDiffEepStoreThres_C ThrVlv_OffsLrn_I.uMovZon_C ThrVlv_OffsLrn_I.uStopOpenSens1Max_C /end DEF_CHARACTERISTIC
 /begin IN_MEASUREMENT BattU_u EngDa_tEng Epm_nEng IntkAirT_tThrVlvUs SyC_stSub ThrVlv_facUBattB1 ThrVlv_flgActrOnB1 ThrVlv_flgLimpModeB1 ThrVlv_flgOpenLoadDiagFinshdB1 ThrVlv_flgRegTqRednB1 ThrVlv_flgReqFuCutOffB1 ThrVlv_flgUBattSuffB1 ThrVlv_ratActIntB1 ThrVlv_ratDesB1 ThrVlv_ratDutyCycB1 ThrVlv_stMonPsIfB1 ThrVlv_stPosnCtrlStB1 ThrVlv_uSens1B1 ThrVlv_uSens2B1 VehV_v /end IN_MEASUREMENT
 /begin OUT_MEASUREMENT ThrVlv_dRatPrVB1 ThrVlv_flgAdpnRelsB1 ThrVlv_flgColdCdnOffsActvB1 ThrVlv_flgColdCdnTB1 ThrVlv_flgDiInjB1 ThrVlv_flgLimpAirPosnFctEnaB1 ThrVlv_flgOffsLrnAbortB1 ThrVlv_flgOffsLrnPsOffB1 ThrVlv_flgOffsLrnSucB1 ThrVlv_nrOffsLrnStepB1 ThrVlv_ratAdpnB1 ThrVlv_ratLimpAirPosnB1 ThrVlv_ratOffsClsdPosnB1 ThrVlv_ratOpenPosnMaxB1 ThrVlv_stMonClsdPosnOffsLrnB1 ThrVlv_stMonIceDetdB1 ThrVlv_stMonLimpAirPosnLrnB1 ThrVlv_stMonOpenSprgChkB1 ThrVlv_stMonRetSprgChkB1 ThrVlv_stOffsLrnAbortCaseB1 ThrVlv_stOffsLrnOperB1 ThrVlv_stOffsLrnStB1 ThrVlv_uElStopClsdSens1B1 ThrVlv_uElStopClsdSens1FrstB1 ThrVlv_uElStopClsdSens2B1 ThrVlv_uElStopClsdSens2FrstB1 ThrVlv_uLimpAirPosnSens1B1 ThrVlv_uLimpAirPosnSens2B1 /end OUT_MEASUREMENT
 /begin LOC_MEASUREMENT ThrVlv_flgOffsLrnDsmClrDmdB1 ThrVlv_nrOffsLrnCycB1 ThrVlv_OffsLrn_I.Snsr1DriftCmpArr ThrVlv_OffsLrn_I.Snsr2DriftCmpArr ThrVlv_OffsLrn_I.USens1LWRLHPDif ThrVlv_OffsLrn_I.dratActGrdtColdCdn ThrVlv_OffsLrn_I.dratActGrdtColdCdn_PT1In ThrVlv_OffsLrn_I.dratActGrdtIceChk ThrVlv_OffsLrn_I.dratActGrdtIceChkEngRun ThrVlv_OffsLrn_I.dratActGrdtTempOffsLrn ThrVlv_OffsLrn_I.dratActGrdtTempOffsLrn_PT1In ThrVlv_OffsLrn_I.facUBatt ThrVlv_OffsLrn_I.facWghtSlopSnsr1DriftNew ThrVlv_OffsLrn_I.facWghtSlopSnsr1DriftOld ThrVlv_OffsLrn_I.facWghtSlopSnsr1DriftRng1 ThrVlv_OffsLrn_I.facWghtSlopSnsr1DriftRng2 ThrVlv_OffsLrn_I.facWghtSlopSnsr1DriftRng3 ThrVlv_OffsLrn_I.facWghtSlopSnsr2DriftNew ThrVlv_OffsLrn_I.facWghtSlopSnsr2DriftOld ThrVlv_OffsLrn_I.facWghtSlopSnsr2DriftRng1 ThrVlv_OffsLrn_I.facWghtSlopSnsr2DriftRng2 ThrVlv_OffsLrn_I.facWghtSlopSnsr2DriftRng3 ThrVlv_OffsLrn_I.facWghtSnsrDriftRng0Ref ThrVlv_OffsLrn_I.flgBrknLvrDetd ThrVlv_OffsLrn_I.flgClngActv ThrVlv_OffsLrn_I.flgClngCalc ThrVlv_OffsLrn_I.flgClngFinshd ThrVlv_OffsLrn_I.flgClngRampStartPosn ThrVlv_OffsLrn_I.flgClngRels ThrVlv_OffsLrn_I.flgColdCdnOffsActv ThrVlv_OffsLrn_I.flgColdCdnT ThrVlv_OffsLrn_I.flgDiInj ThrVlv_OffsLrn_I.flgDiStrtr ThrVlv_OffsLrn_I.flgExePsDiag ThrVlv_OffsLrn_I.flgExtOffsLrnTrig ThrVlv_OffsLrn_I.flgFrstLrnPrfm ThrVlv_OffsLrn_I.flgFrstSnsrDriftCmp ThrVlv_OffsLrn_I.flgIceChkActv ThrVlv_OffsLrn_I.flgIceChkClsdErr ThrVlv_OffsLrn_I.flgIceChkEngRunActv ThrVlv_OffsLrn_I.flgIceChkEngRunClsd ThrVlv_OffsLrn_I.flgIceChkEngRunClsdOffs ThrVlv_OffsLrn_I.flgIceChkEngRunClsdOffsRels ThrVlv_OffsLrn_I.flgIceChkEngRunExe ThrVlv_OffsLrn_I.flgIceChkEngRunOpen ThrVlv_OffsLrn_I.flgIceChkEngRunRamp ThrVlv_OffsLrn_I.flgIceChkEngRunT ThrVlv_OffsLrn_I.flgIceChkEngRunTog ThrVlv_OffsLrn_I.flgIceChkFinshd ThrVlv_OffsLrn_I.flgIceChkOpenErr ThrVlv_OffsLrn_I.flgIceChkRels ThrVlv_OffsLrn_I.flgIceChkWakeupDlyFinshd ThrVlv_OffsLrn_I.flgKeepColdCdnOffs ThrVlv_OffsLrn_I.flgKeepIceChkEngRunOffs ThrVlv_OffsLrn_I.flgLimpAirPosnNpl ThrVlv_OffsLrn_I.flgLimpAirPosnSuc ThrVlv_OffsLrn_I.flgLongShoTermAdpnCalc ThrVlv_OffsLrn_I.flgLongTermAdpnHist ThrVlv_OffsLrn_I.flgLongTermAdpnInhbn ThrVlv_OffsLrn_I.flgLongTermAdpnRst ThrVlv_OffsLrn_I.flgOffsLrnAbort ThrVlv_OffsLrn_I.flgOffsLrnActv ThrVlv_OffsLrn_I.flgOffsLrnClsdPosnSuc ThrVlv_OffsLrn_I.flgOffsLrnRepnDly ThrVlv_OffsLrn_I.flgOffsLrnSuc ThrVlv_OffsLrn_I.flgOpenSprgChkCalc ThrVlv_OffsLrn_I.flgPSOffSnsrDriftCmp ThrVlv_OffsLrn_I.flgPhyRngClsdExcd ThrVlv_OffsLrn_I.flgPhyRngOpenExcd ThrVlv_OffsLrn_I.flgPostDrivePwrStgOff ThrVlv_OffsLrn_I.flgPrmntOffsLrnActv ThrVlv_OffsLrn_I.flgPsDiagFinshd ThrVlv_OffsLrn_I.flgPsDiagOpenLoad ThrVlv_OffsLrn_I.flgReqSnsrDriftDesPosn ThrVlv_OffsLrn_I.flgRetSprgChkAbort ThrVlv_OffsLrn_I.flgRetSprgChkActv ThrVlv_OffsLrn_I.flgRetSprgChkCalc ThrVlv_OffsLrn_I.flgRetSprgChkPrfm ThrVlv_OffsLrn_I.flgRetSprgChkRls ThrVlv_OffsLrn_I.flgRetSprgChkSuc ThrVlv_OffsLrn_I.flgRlsSnsrDriftCmp ThrVlv_OffsLrn_I.flgSnsrDriftCmpPt1Ini ThrVlv_OffsLrn_I.flgSnsrDriftCmpSuc ThrVlv_OffsLrn_I.flgTAdjmtColdIni ThrVlv_OffsLrn_I.flgTAdjmtRels ThrVlv_OffsLrn_I.flgTmpOffsLrnActv ThrVlv_OffsLrn_I.flgUElStopCalcnNotPlaus ThrVlv_OffsLrn_I.nrClngCyc ThrVlv_OffsLrn_I.nrClngStep ThrVlv_OffsLrn_I.nrDcycClng ThrVlv_OffsLrn_I.nrIceChkEngRunTogCyc ThrVlv_OffsLrn_I.nrIceChkStep ThrVlv_OffsLrn_I.nrIceChkWakeupCyc ThrVlv_OffsLrn_I.nrIceRmvAtmpt ThrVlv_OffsLrn_I.nrOffsLrnCyc ThrVlv_OffsLrn_I.nrOffsLrnStep ThrVlv_OffsLrn_I.nrRetOpndSprgCyc ThrVlv_OffsLrn_I.nrRetSprgChkStep ThrVlv_OffsLrn_I.nrSnsrDriftCmpStep ThrVlv_OffsLrn_I.nrSnsrDriftIdx ThrVlv_OffsLrn_I.nrSnsrDriftRng ThrVlv_OffsLrn_I.nrSnsrDriftVldyChkCyc ThrVlv_OffsLrn_I.ratActOld ThrVlv_OffsLrn_I.ratActOldColdCdn ThrVlv_OffsLrn_I.ratActOldIceChk ThrVlv_OffsLrn_I.ratActOldIceChkEngRun ThrVlv_OffsLrn_I.ratDutyCycOffsLrnLim ThrVlv_OffsLrn_I.ratIceChkEngRun ThrVlv_OffsLrn_I.ratSnsr1DriftAct ThrVlv_OffsLrn_I.ratSnsr1DriftNew ThrVlv_OffsLrn_I.ratSnsr1DriftOld ThrVlv_OffsLrn_I.ratSnsr1DriftRng1 ThrVlv_OffsLrn_I.ratSnsr1DriftRng2 ThrVlv_OffsLrn_I.ratSnsr1DriftRng3 ThrVlv_OffsLrn_I.ratSnsr2DriftAct ThrVlv_OffsLrn_I.ratSnsr2DriftNew ThrVlv_OffsLrn_I.ratSnsr2DriftOld ThrVlv_OffsLrn_I.ratSnsr2DriftRng1 ThrVlv_OffsLrn_I.ratSnsr2DriftRng2 ThrVlv_OffsLrn_I.ratSnsr2DriftRng3 ThrVlv_OffsLrn_I.stClngRlsCond ThrVlv_OffsLrn_I.stDevTypSC ThrVlv_OffsLrn_I.stIceChkMod ThrVlv_OffsLrn_I.stIceChkRlsCond ThrVlv_OffsLrn_I.stLimpAirPosnLrn ThrVlv_OffsLrn_I.stLongShoTermAdpn ThrVlv_OffsLrn_I.stMonBrknLvrDetd ThrVlv_OffsLrn_I.stOffsLrnOper ThrVlv_OffsLrn_I.stOffsLrnRlsCond ThrVlv_OffsLrn_I.stOffsLrnSt ThrVlv_OffsLrn_I.stRetSprgChkRlsCond ThrVlv_OffsLrn_I.tExhMnfOld ThrVlv_OffsLrn_I.tExhMnfRef ThrVlv_OffsLrn_I.tSnsrDriftRngLst ThrVlv_OffsLrn_I.tSnsrEtcFil ThrVlv_OffsLrn_I.uAvgSnsr1LwrLHP ThrVlv_OffsLrn_I.uAvgSnsr2LwrLHP ThrVlv_OffsLrn_I.uDifElStopClsdActCold ThrVlv_OffsLrn_I.uDifTOffs ThrVlv_OffsLrn_I.uDifTOffsAct ThrVlv_OffsLrn_I.uDifTOffsRef ThrVlv_OffsLrn_I.uElStopClsdSens1 ThrVlv_OffsLrn_I.uElStopClsdSens1Old ThrVlv_OffsLrn_I.uElStopClsdSens2 ThrVlv_OffsLrn_I.uElStopOpenSens1 ThrVlv_OffsLrn_I.uElStopOpenSens1Frst ThrVlv_OffsLrn_I.uElStopOpenSens2 ThrVlv_OffsLrn_I.uElStopOpenSens2Frst ThrVlv_OffsLrn_I.uLimpAirPosnOpenSens1 ThrVlv_OffsLrn_I.uLimpAirPosnOpenSens2 ThrVlv_OffsLrn_I.uLimpAirPosnRetSens1 ThrVlv_OffsLrn_I.uLimpAirPosnRetSens2 ThrVlv_OffsLrn_I.uLongTermClsdSens1 ThrVlv_OffsLrn_I.uSens1DeltaOldAct ThrVlv_OffsLrn_I.uSens1LimpAirPosnTmp ThrVlv_OffsLrn_I.uSens1LwrLHPref ThrVlv_OffsLrn_I.uSens1OffsLrnCalcnOld ThrVlv_OffsLrn_I.uSens1OffsLrnTmp ThrVlv_OffsLrn_I.uSens2DeltaOldAct ThrVlv_OffsLrn_I.uSens2LimpAirPosnTmp ThrVlv_OffsLrn_I.uSens2LwrLHPref ThrVlv_OffsLrn_I.uSens2OffsLrnCalcnOld ThrVlv_OffsLrn_I.uSens2OffsLrnTmp ThrVlv_OffsLrn_I.uSensLwrLHPref_Temp ThrVlv_OffsLrn_I.uShoTermClsdSens1 ThrVlv_OffsLrn_I.uSnsr1TDriftOffs ThrVlv_OffsLrn_I.uSnsr1TDriftOffsLimd ThrVlv_OffsLrn_I.uSnsr2TDriftOffs ThrVlv_OffsLrn_I.uSnsr2TDriftOffsLimd ThrVlv_OffsLrn_I.uStopColdCdnSens1 ThrVlv_OffsLrn_I.uStopColdCdnSens2 ThrVlv_OffsLrn_I.uStopIceChkEngRunSens1 ThrVlv_OffsLrn_I.uStopIceChkEngRunSens2 ThrVlv_OffsLrn_I.uSumSens1 ThrVlv_OffsLrn_I.uSumSens2 ThrVlv_OffsLrn_I.uTAdjmtColdClsdSens1 ThrVlv_OffsLrn_I.uTmpStopClsdSens1 ThrVlv_OffsLrn_I.uTmpStopClsdSens2 ThrVlv_stCmbTyp_MP ThrVlv_uLimpAirPosnSens1FrstB1_MP /end LOC_MEASUREMENT
 FUNCTION_VERSION "1.37.0" /end FUNCTION
/begin COMPU_METHOD dez "" RAT_FUNC "%6.2" "" COEFFS 0 1 0 0 0 1 /end COMPU_METHOD
/begin COMPU_METHOD fak_q6p1035Em5 "" RAT_FUNC "%7.6" "-" COEFFS 0 65536 0 0 0 4 /end COMPU_METHOD
/begin COMPU_METHOD nmot_q0p5 "" RAT_FUNC "%6.3" "1/min" COEFFS 0 2 0 0 0 1 /end COMPU_METHOD
/begin COMPU_METHOD OneToOne "" RAT_FUNC "%6.2" "-" COEFFS 0 1 0 0 0 1 /end COMPU_METHOD
/begin COMPU_METHOD q0p0586_pc_DIV_s "" RAT_FUNC "%6.4" "%/s" COEFFS 0 256 0 0 0 15 /end COMPU_METHOD
/begin COMPU_METHOD q6p357Em6_V_DIV_K "" RAT_FUNC "%8.7" "V/K" COEFFS 0 786432 0 0 0 5 /end COMPU_METHOD
/begin COMPU_METHOD rel_q0p002441 "" RAT_FUNC "%6.4" "%/V" COEFFS 0 65536 0 0 0 160 /end COMPU_METHOD
/begin COMPU_METHOD rel_q0p0078125 "" RAT_FUNC "%6.4" "%" COEFFS 0 128 0 0 0 1 /end COMPU_METHOD
/begin COMPU_METHOD spg_q1p221Em3_V "" RAT_FUNC "%6.4" "V" COEFFS 0 65536 0 0 0 80 /end COMPU_METHOD
/begin COMPU_METHOD Temp_Cels "" RAT_FUNC "%6.1" "deg C" COEFFS 0 10 2731.4 0 0 1 /end COMPU_METHOD
/begin COMPU_METHOD Time_Dt "" RAT_FUNC "%9.8" "s" COEFFS 0 1000000 0 0 0 1 /end COMPU_METHOD
/begin COMPU_METHOD Time_s "" RAT_FUNC "%6.4" "s" COEFFS 0 100 0 0 0 1 /end COMPU_METHOD
/begin COMPU_METHOD TME_VIMMDL_SC_Compu "" TAB_VERB "%6.3" "" COMPU_TAB_REF TME_VIMMDL_SC_Compu /end COMPU_METHOD
/begin COMPU_VTAB TME_VIMMDL_SC_Compu "" TAB_VERB 3 0 "VIM_noMdl" 1 "VIM_basMdl" 2 "VIM_extMdl" /end COMPU_VTAB
/begin COMPU_METHOD TME_VIRTAPPSELN_SC_Compu "" TAB_VERB "%6.3" "" COMPU_TAB_REF TME_VIRTAPPSELN_SC_Compu /end COMPU_METHOD
/begin COMPU_VTAB TME_VIRTAPPSELN_SC_Compu "" TAB_VERB 2 0 "False" 1 "True" /end COMPU_VTAB
/begin COMPU_METHOD TME_VIRTIA_SC_Compu "" TAB_VERB "%6.3" "" COMPU_TAB_REF TME_VIRTIA_SC_Compu /end COMPU_METHOD
/begin COMPU_VTAB TME_VIRTIA_SC_Compu "" TAB_VERB 2 0 "False" 1 "True" /end COMPU_VTAB
/begin COMPU_METHOD t_q0p01 "" RAT_FUNC "%6.4" "s" COEFFS 0 100 0 0 0 1 /end COMPU_METHOD
/begin COMPU_METHOD Vel "" RAT_FUNC "%6.4" "km/h" COEFFS 0 100 0 0 0 1 /end COMPU_METHOD
/begin COMPU_METHOD Volt_Batt "" RAT_FUNC "%6.1" "mV" COEFFS 0 0.05 0 0 0 1 /end COMPU_METHOD
/begin RECORD_LAYOUT Map_Xs16Ys16Ws16 NO_AXIS_PTS_X 1 SWORD NO_AXIS_PTS_Y 2 SWORD AXIS_PTS_X 3 SWORD INDEX_INCR DIRECT AXIS_PTS_Y 4 SWORD INDEX_INCR DIRECT FNC_VALUES 5 SWORD COLUMN_DIR DIRECT /end RECORD_LAYOUT
/begin RECORD_LAYOUT Val_Ws16 FNC_VALUES 1 SWORD COLUMN_DIR DIRECT /end RECORD_LAYOUT
/begin RECORD_LAYOUT Val_Ws32 FNC_VALUES 1 SLONG COLUMN_DIR DIRECT /end RECORD_LAYOUT
/begin RECORD_LAYOUT Val_Wu16 FNC_VALUES 1 UWORD COLUMN_DIR DIRECT /end RECORD_LAYOUT
/begin RECORD_LAYOUT Val_Wu8 FNC_VALUES 1 UBYTE COLUMN_DIR DIRECT /end RECORD_LAYOUT
/end MODULE
/end PROJECT
