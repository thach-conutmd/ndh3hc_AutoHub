ASAP2_VERSION 1 60
/begin PROJECT MG1CA020 "MG1CA020"
/begin HEADER "" VERSION "MG1CA020_6SAY_V011_TPROT" PROJECT_NO MG1CA020 /end HEADER
/begin MODULE DIM ""
/begin MOD_COMMON "" BYTE_ORDER MSB_LAST ALIGNMENT_BYTE 1 ALIGNMENT_WORD 2 ALIGNMENT_LONG 4 ALIGNMENT_INT64 4 ALIGNMENT_FLOAT32_IEEE 4 ALIGNMENT_FLOAT64_IEEE 4 DATA_SIZE 32 /end MOD_COMMON
/begin CHARACTERISTIC EGSDCmn_Cat1B1Empty_I.duUMinOKParl_C "Calculation of the transition condition for switching to lean lambda phase / Minimum sensor voltage gradient for detection of catalyst acceptably empty from oxygen during pre-conditioning phase" VALUE 0x8051C2B0 RB_Val_Ws16 132.9980 spgg_q0p002029_V_DIV_s -66.50000 66.49797 FORMAT "%8.5" /end CHARACTERISTIC
/begin CHARACTERISTIC EGSDCmn_Cat1B1Empty_I.mO2CatEmptyOKParl_C "Calculation of the transition condition for switching to lean lambda phase / Integrated exhaust gas mass flow for detection if catalyst is sufficiently empty from oxygen during pre-conditioning phase" VALUE 0x8051C2B4 RB_Val_Wr32 50000.0000 m_q1_mg 0.00 50000.0000 FORMAT "%10.4" EXTENDED_LIMITS -3.40282347E+038 3.40282347E+038 /end CHARACTERISTIC
/begin CHARACTERISTIC EGSDCmn_Cat1B1Empty_I.uCatEmptyOKParl_C "Calculation of the transition condition for switching to lean lambda phase / Minimum sensor voltage for detection of catalyst acceptably empty from oxygen during pre-conditioning phase" VALUE 0x8051C2B8 RB_Val_Wu16 4.998779 spg_q1p221Em3_V 0.00 4.998779 FORMAT "%8.6" EXTENDED_LIMITS 0.00 79.99878 /end CHARACTERISTIC
/begin CHARACTERISTIC EGSDCmn_duCatEmptyMaxParl_C "Maximum acceptable voltage gradient for detection of catalyst is empty of oxygen" VALUE 0x8051C250 RB_Val_Ws16 132.9980 spgg_q0p002029_V_DIV_s -66.50000 66.49797 FORMAT "%8.5" /end CHARACTERISTIC
/begin CHARACTERISTIC EGSDCmn_duCatEmptyMinParl_C "Minimum acceptable voltage gradient for detection of catalyst is empty of oxygen" VALUE 0x8051C252 RB_Val_Ws16 132.9980 spgg_q0p002029_V_DIV_s -66.50000 66.49797 FORMAT "%8.5" /end CHARACTERISTIC
/begin CHARACTERISTIC EGSDCmn_duCatFullMaxParl_C "Maximum acceptable voltage gradient for detection of catalyst is full of oxygen" VALUE 0x8051C254 RB_Val_Ws16 132.9980 spgg_q0p002029_V_DIV_s -66.50000 66.49797 FORMAT "%8.5" /end CHARACTERISTIC
/begin CHARACTERISTIC EGSDCmn_duCatFullMinParl_C "Minimum acceptable voltage gradient for detection of catalyst is full of oxygen" VALUE 0x8051C256 RB_Val_Ws16 132.9980 spgg_q0p002029_V_DIV_s -66.50000 66.49797 FORMAT "%8.5" /end CHARACTERISTIC
/begin CHARACTERISTIC EGSDCmn_facRampParl_C "Gradient of the lambda ramp in ramp-test of range check of sensor voltage" VALUE 0x8051C258 RB_Val_Wu16 9.999084 k10ms_uw_b100 0.00 9.999084 FORMAT "%8.6" EXTENDED_LIMITS 0.00 99.99847 /end CHARACTERISTIC
/begin CHARACTERISTIC EGSDCmn_flgSymTranOnly_CW "Codebit: Dynamic Diagnosis for Symmetric Transition Fault Only" VALUE 0x8051C25A RB_Val_Wu8 1.00000000000 B_TRUE 0.00 1.00000000000 FORMAT "%13.11" /end CHARACTERISTIC
/begin CHARACTERISTIC EGSDCmn_flgVltgSymc_C "Enabling of symmetrization feature for first downstream sensor by calibration" VALUE 0x8051C25B RB_Val_Wu8 1.00000000000 B_TRUE 0.00 1.00000000000 FORMAT "%13.11" /end CHARACTERISTIC
/begin CHARACTERISTIC EGSDCmn_mCatEmptyGrdtParl_C "Amount of exhaust gas mass flow before start of recognition of catalyst 1 is empty from oxygen (based on sensor voltage gradient)" VALUE 0x8051C25C RB_Val_Wr32 50000.0000 m_q1_mg 0.00 50000.0000 FORMAT "%10.4" EXTENDED_LIMITS -3.40282347E+038 3.40282347E+038 /end CHARACTERISTIC
/begin CHARACTERISTIC EGSDCmn_mCatFullGrdtParl_C "Amount of exhaust gas mass flow before start of recognition of catalyst 1 is filled with oxygen (based on sensor voltage gradient)" VALUE 0x8051C260 RB_Val_Wr32 50000.0000 m_q1_mg 0.00 50000.0000 FORMAT "%10.4" EXTENDED_LIMITS -3.40282347E+038 3.40282347E+038 /end CHARACTERISTIC
/begin CHARACTERISTIC EGSDCmn_mEgLamWaitParl_C "amount of exhaust gas mass flow to wait for the system to settle after Lambda instability during diagnosis execution" VALUE 0x8051C264 RB_Val_Wu16 65.53500 m_q0p001_kg 0.00 65.53500 FORMAT "%8.5" /end CHARACTERISTIC
/begin CHARACTERISTIC EGSDCmn_mErrTarLeanParl_C "amount of oxygen mass flow before setting of a target-lean-error-suspicion" VALUE 0x8051C268 RB_Val_Wr32 50000.0000 m_q1_mg 0.00 50000.0000 FORMAT "%10.4" EXTENDED_LIMITS -3.40282347E+038 3.40282347E+038 /end CHARACTERISTIC
/begin CHARACTERISTIC EGSDCmn_mErrTarRichParl_C "amount of oxygen mass flow before setting of a target-rich-error-suspicion" VALUE 0x8051C26C RB_Val_Wr32 50000.0000 m_q1_mg 0.00 50000.0000 FORMAT "%10.4" EXTENDED_LIMITS -3.40282347E+038 3.40282347E+038 /end CHARACTERISTIC
/begin CHARACTERISTIC EGSDCmn_mLamStabParl_C "amount of exhaust gas to detect that lambda value is stable during the diagnosis" VALUE 0x8051C270 RB_Val_Wu16 65.53500 m_q0p001_kg 0.00 65.53500 FORMAT "%8.5" /end CHARACTERISTIC
/begin CHARACTERISTIC EGSDCmn_mO2IdnAdapnParl_C "Oxygen mass threshold for online adaption" VALUE 0x8051C274 RB_Val_Wr32 50000.0000 m_q1_mg 0.00 50000.0000 FORMAT "%10.4" EXTENDED_LIMITS -3.40282347E+038 3.40282347E+038 /end CHARACTERISTIC
/begin CHARACTERISTIC EGSDCmn_mRampDurParl_C "amount of exhaust gas mass flow to hold on the ramp during ramp-test" VALUE 0x8051C278 RB_Val_Wu16 65.53500 m_q0p001_kg 0.00 65.53500 FORMAT "%8.5" /end CHARACTERISTIC
/begin CHARACTERISTIC EGSDCmn_nrMaxIdnAdpnEnd_C "Number of maximum separate lambda changes for the adaptation for the lambda system" VALUE 0x8051C27A RB_Val_Wu8 255.0 OneToOne 0.00 255.0 FORMAT "%5.1" /end CHARACTERISTIC
/begin CHARACTERISTIC EGSDCmn_nrUGrdtParl_C "distance between voltage points for gradient calculation of sensor voltage lambda sensor downstream catalyst" VALUE 0x8051C27B RB_Val_Wu8 255.0 dez 0.00 255.0 FORMAT "%5.1" /end CHARACTERISTIC
/begin CHARACTERISTIC EGSDCmn_ratLamIdnLeanParl_C "Lean Lambda setpoint request for online identification for Dynamic adaptation purpose only" VALUE 0x8051C27C RB_Val_Wu16 15.99976 fak_uw_b16 0.00 15.99976 FORMAT "%8.5" /end CHARACTERISTIC
/begin CHARACTERISTIC EGSDCmn_ratLamIdnRichParl_C "Rich Lambda setpoint request for online identification for Dynamic adaptation purpose only" VALUE 0x8051C27E RB_Val_Wu16 15.99976 fak_uw_b16 0.00 15.99976 FORMAT "%8.5" /end CHARACTERISTIC
/begin CHARACTERISTIC EGSDCmn_ratLamLeanParl_C "Lean lambda setpoint request for parallelization" VALUE 0x8051C280 RB_Val_Wu16 15.99976 fak_uw_b16 0.00 15.99976 FORMAT "%8.5" /end CHARACTERISTIC
/begin CHARACTERISTIC EGSDCmn_ratLamLessLeanMonParl_C "range of tolerance towards lambda 1 between set value and actual value of lambda during lambda shifting in lean direction" VALUE 0x8051C282 RB_Val_Wu16 15.99976 fak_uw_b16 0.00 15.99976 FORMAT "%8.5" /end CHARACTERISTIC
/begin CHARACTERISTIC EGSDCmn_ratLamLessRichMonParl_C "range of tolerance towards lambda 1 between set value and actual value of lambda during lambda shifting in rich direction" VALUE 0x8051C284 RB_Val_Wu16 15.99976 fak_uw_b16 0.00 15.99976 FORMAT "%8.5" /end CHARACTERISTIC
/begin CHARACTERISTIC EGSDCmn_ratLamMoreLeanMonParl_C "range of tolerance towards lean between setpoint value and actual value of lambda during lambda shifting in lean direction" VALUE 0x8051C286 RB_Val_Wu16 15.99976 fak_uw_b16 0.00 15.99976 FORMAT "%8.5" /end CHARACTERISTIC
/begin CHARACTERISTIC EGSDCmn_ratLamMoreRichMonParl_C "range of tolerance towards rich between set value and actual value of lambda during lambda shifting in rich direction" VALUE 0x8051C288 RB_Val_Wu16 15.99976 fak_uw_b16 0.00 15.99976 FORMAT "%8.5" /end CHARACTERISTIC
/begin CHARACTERISTIC EGSDCmn_ratLamRampLeanParl_C "lambda limit in direction lean of ramp test for range check" VALUE 0x8051C28A RB_Val_Wu16 15.99976 fak_uw_b16 0.00 15.99976 FORMAT "%8.5" /end CHARACTERISTIC
/begin CHARACTERISTIC EGSDCmn_ratLamRampRichParl_C "lambda limit in direction rich of ramp test for range check" VALUE 0x8051C28C RB_Val_Wu16 15.99976 fak_uw_b16 0.00 15.99976 FORMAT "%8.5" /end CHARACTERISTIC
/begin CHARACTERISTIC EGSDCmn_ratLamRichParl_C "requested rich lambda for parallelization during check" VALUE 0x8051C28E RB_Val_Wu16 15.99976 fak_uw_b16 0.00 15.99976 FORMAT "%8.5" /end CHARACTERISTIC
/begin CHARACTERISTIC EGSDCmn_tiLamMonParl_C "Tolerance time for detection if lambda is stable during diagnosis execution" VALUE 0x8051C290 RB_Val_Wu8 2.550 t_q0p01 0.00 2.550 FORMAT "%5.3" /end CHARACTERISTIC
/begin CHARACTERISTIC EGSDCmn_tiS1DynWrstCaseParl_C "Worst case sensor 1 dynamic time which is assumed during Lambda stability check" VALUE 0x8051C292 RB_Val_Wu16 655.3500 t_q0p01 0.00 655.3500 FORMAT "%8.4" /end CHARACTERISTIC
/begin CHARACTERISTIC EGSDCmn_tiS2LtrDynWpaParl_C "Worst part acceptable dynamic time for the downstream sensor, lean to rich" VALUE 0x8051C294 RB_Val_Wu16 655.3500 t_q0p01 0.00 655.3500 FORMAT "%8.4" /end CHARACTERISTIC
/begin CHARACTERISTIC EGSDCmn_tiS2RtlDynWpaParl_C "Worst part acceptable dynamic time for the downstream sensor, rich to lean" VALUE 0x8051C296 RB_Val_Wu16 655.3500 t_q0p01 0.00 655.3500 FORMAT "%8.4" /end CHARACTERISTIC
/begin CHARACTERISTIC EGSDCmn_tiUCatFullParl_C "Waiting time for detection of catalyst is filled with oxygen (based on sensor voltage)" VALUE 0x8051C298 RB_Val_Wu16 655.3500 t_q0p01 0.00 655.3500 FORMAT "%8.4" /end CHARACTERISTIC
/begin CHARACTERISTIC EGSDCmn_tiUS2LtrParl_C "time for sensor dynamic lean-rich for IUMPR simulation" VALUE 0x8051C29A RB_Val_Wu16 655.3500 t_q0p01 0.00 655.3500 FORMAT "%8.4" /end CHARACTERISTIC
/begin CHARACTERISTIC EGSDCmn_tiUS2RtlParl_C "time for sensor dynamic rich-lean for IUMPR simulation" VALUE 0x8051C29C RB_Val_Wu16 655.3500 t_q0p01 0.00 655.3500 FORMAT "%8.4" /end CHARACTERISTIC
/begin CHARACTERISTIC EGSDCmn_tiVirtLamStabParl_C "assumed time for reaching the lambda stability criterion in the IUMPR of the upstream lambda sensor" VALUE 0x8051C29E RB_Val_Wu16 655.3500 t_q0p01 0.00 655.3500 FORMAT "%8.4" /end CHARACTERISTIC
/begin CHARACTERISTIC EGSDCmn_uCatEmptyGrdtParl_C "Minimum sensor voltage for detection of catalyst is empty of oxygen (based on sensor voltage gradient)" VALUE 0x8051C2A0 RB_Val_Wu16 4.998779 spg_q1p221Em3_V 0.00 4.998779 FORMAT "%8.6" EXTENDED_LIMITS 0.00 79.99878 /end CHARACTERISTIC
/begin CHARACTERISTIC EGSDCmn_uCatEmptyParl_C "Minimum voltage for detection of catalyst is empty of oxygen (based on sensor voltage)" VALUE 0x8051C2A2 RB_Val_Wu16 4.998779 spg_q1p221Em3_V 0.00 4.998779 FORMAT "%8.6" EXTENDED_LIMITS 0.00 79.99878 /end CHARACTERISTIC
/begin CHARACTERISTIC EGSDCmn_uCatFullGrdtParl_C "Maximum sensor voltage for detection of catalyst is filled with oxygen (based on sensor voltage gradient)" VALUE 0x8051C2A4 RB_Val_Wu16 4.998779 spg_q1p221Em3_V 0.00 4.998779 FORMAT "%8.6" EXTENDED_LIMITS 0.00 79.99878 /end CHARACTERISTIC
/begin CHARACTERISTIC EGSDCmn_uCatFullParl_C "Maximum sensor voltage for detection of catalyst is filled with oxygen (based on sensor voltage)" VALUE 0x8051C2A6 RB_Val_Wu16 4.998779 spg_q1p221Em3_V 0.00 4.998779 FORMAT "%8.6" EXTENDED_LIMITS 0.00 79.99878 /end CHARACTERISTIC
/begin CHARACTERISTIC EGSDCmn_uEnaLoEnghParl_C "maximum sensor voltage to enable a delay Lean to Rich check of downstream sensor" VALUE 0x8051C2A8 RB_Val_Wu16 4.998779 spg_q1p221Em3_V 0.00 4.998779 FORMAT "%8.6" EXTENDED_LIMITS 0.00 79.99878 /end CHARACTERISTIC
/begin CHARACTERISTIC EGSDCmn_uHiEnaParl_C "Rich Lambda threshold for the binary voltage of the parallelized sensors" VALUE 0x8051C2AA RB_Val_Wu16 4.998779 spg_q1p221Em3_V 0.00 4.998779 FORMAT "%8.6" EXTENDED_LIMITS 0.00 79.99878 /end CHARACTERISTIC
/begin MEASUREMENT EGSDCmn_B1LamStabParlIK_I.memory "Debouncing (by exhaust gas mass flow integration) before releasing the parallelized diagnoses, after an instable Lambda was detected / current integrator value" ULONG m_q1p5259Em8_kg 1 100 0.00 65.5359999847 FORMAT "%13.10" ECU_ADDRESS 0x600017A4 /end MEASUREMENT
/begin MEASUREMENT EGSDCmn_Cat1B1Empty_I.flgCatEmpty "Calculation of the transition condition for switching to lean lambda phase / Catalyst is empty from oxygen" UBYTE B_TRUE 1 100 0.00 1.00000000000 BIT_MASK 0x1 FORMAT "%13.11" ECU_ADDRESS 0x50001218 /end MEASUREMENT
/begin MEASUREMENT EGSDCmn_Cat1B1Empty_I.flgCatEmptyOK "Calculation of the transition condition for switching to lean lambda phase / Catalyst sufficiently free of oxygen for transition in second pre-conditioning phase" UBYTE B_TRUE 1 100 0.00 1.00000000000 BIT_MASK 0x1 FORMAT "%13.11" ECU_ADDRESS 0x50001219 /end MEASUREMENT
/begin MEASUREMENT EGSDCmn_Cat1B1Empty_I.flgCatEmptyTOut "Calculation of the transition condition for switching to lean lambda phase / Time Out Criterion while checking if catalyst is free of oxygen" UBYTE B_TRUE 1 100 0.00 1.00000000000 BIT_MASK 0x1 FORMAT "%13.11" ECU_ADDRESS 0x5000121A /end MEASUREMENT
/begin MEASUREMENT EGSDCmn_Cat1B1Empty_I.DynErrRampTONV_I.outbit "Calculation of the transition condition for switching to lean lambda phase / Representation of sensor dynmics in Time out calculation / return value" UBYTE B_TRUE 1 100 0.00 1.00000000000 BIT_MASK 0x1 FORMAT "%13.11" ECU_ADDRESS 0x5000121C /end MEASUREMENT
/begin MEASUREMENT EGSDCmn_Cat1B1Empty_I.DynErrRampTONV_I.time "Calculation of the transition condition for switching to lean lambda phase / Representation of sensor dynmics in Time out calculation / expired delay time" UWORD t_q0p01 1 100 0.00 655.3500 FORMAT "%8.4" ECU_ADDRESS 0x5000121E /end MEASUREMENT
/begin MEASUREMENT EGSDCmn_Cat1B1Empty_I.UGrdtTONV_I.outbit "Calculation of the transition condition for switching to lean lambda phase / Debouncing after detection of flat sensor voltage gradient due to signal symmetrization / return value" UBYTE B_TRUE 1 100 0.00 1.00000000000 BIT_MASK 0x1 FORMAT "%13.11" ECU_ADDRESS 0x50001220 /end MEASUREMENT
/begin MEASUREMENT EGSDCmn_Cat1B1Empty_I.UGrdtTONV_I.time "Calculation of the transition condition for switching to lean lambda phase / Debouncing after detection of flat sensor voltage gradient due to signal symmetrization / expired delay time" UWORD t_q0p01 1 100 0.00 655.3500 FORMAT "%8.4" ECU_ADDRESS 0x50001222 /end MEASUREMENT
/begin MEASUREMENT EGSDCmn_Cat1B1Empty_I.duUMinOKFF_I.status "Calculation of the transition condition for switching to lean lambda phase / Check of binary voltage and voltage gradient to proceed to second pre-conditioning phase / current value of RS-FF" UBYTE B_TRUE 1 100 0.00 1.00000000000 BIT_MASK 0x1 FORMAT "%13.11" ECU_ADDRESS 0x50001224 /end MEASUREMENT
/begin MEASUREMENT EGSDCmn_Cat1B1Empty_I.mO2CatEmptyOKIKL_I.memory "Calculation of the transition condition for switching to lean lambda phase / Integrated exhaust gas mass flow for detection if catalyst is sufficiently empty from oxygen / Current Integrator value" FLOAT32_IEEE m_q1_mg 1 100 -1.0000E+037 1.0000E+037 FORMAT "%10.4" ECU_ADDRESS 0x50001228 /end MEASUREMENT
/begin MEASUREMENT EGSDCmn_Cat1B1Empty_I.mO2EnaCatEmptyGrdtIKL_I.memory "Calculation of the transition condition for switching to lean lambda phase / Integrated exhaust gas mass flow for detection if catalyst is empty from oxygen (based on sensor voltage gradient) / Current Integrator value" FLOAT32_IEEE m_q1_mg 1 100 -1.0000E+037 1.0000E+037 FORMAT "%10.4" ECU_ADDRESS 0x5000122C /end MEASUREMENT
/begin MEASUREMENT EGSDCmn_Cat1B1Empty_I.mRSCCatCpIK_I.memory "Calculation of the transition condition for switching to lean lambda phase / Integrated rich gas mass flow for Time Out detection / current integrator value" FLOAT32_IEEE m_q1_mg 1 100 -1.0000E+037 1.0000E+037 FORMAT "%10.4" ECU_ADDRESS 0x50001230 /end MEASUREMENT
/begin MEASUREMENT EGSDCmn_Cat1B1Empty_I.mRichPrtIKL_I.memory "Calculation of the transition condition for switching to lean lambda phase / Integrated exhaust gas mass flow for detection if catalyst is empty from oxygen in partial Oxygen Storage Capacity measurement / Current Integrator value" FLOAT32_IEEE m_q1_mg 1 100 -1.0000E+037 1.0000E+037 FORMAT "%10.4" ECU_ADDRESS 0x50001234 /end MEASUREMENT
/begin MEASUREMENT EGSDCmn_Cat1B1Empty_I.uSnsrGrdtFF_I.status "Calculation of the transition condition for switching to lean lambda phase / Check of voltage value (based on sensor voltage gradient) / current value of RS-FF" UBYTE B_TRUE 1 100 0.00 1.00000000000 BIT_MASK 0x1 FORMAT "%13.11" ECU_ADDRESS 0x50001238 /end MEASUREMENT
/begin MEASUREMENT EGSDCmn_Cat1B1Full_I.flgCatFull "Calulation of the transition condition to rich / Catalyst is filled with oxygen" UBYTE B_TRUE 1 100 0.00 1.00000000000 BIT_MASK 0x1 FORMAT "%13.11" ECU_ADDRESS 0x5000123C /end MEASUREMENT
/begin MEASUREMENT EGSDCmn_Cat1B1Full_I.flgCatFullTOut "Calulation of the transition condition to rich / Time Out Criterion while checking if the catalyst is filled with oxygen" UBYTE B_TRUE 1 100 0.00 1.00000000000 BIT_MASK 0x1 FORMAT "%13.11" ECU_ADDRESS 0x5000123D /end MEASUREMENT
/begin MEASUREMENT EGSDCmn_Cat1B1Full_I.DynErrRampTONV_I.outbit "Calulation of the transition condition to rich / Representation of sensor dynmics in Time out calculation / return value" UBYTE B_TRUE 1 100 0.00 1.00000000000 BIT_MASK 0x1 FORMAT "%13.11" ECU_ADDRESS 0x5000123E /end MEASUREMENT
/begin MEASUREMENT EGSDCmn_Cat1B1Full_I.DynErrRampTONV_I.time "Calulation of the transition condition to rich / Representation of sensor dynmics in Time out calculation / expired delay time" UWORD t_q0p01 1 100 0.00 655.3500 FORMAT "%8.4" ECU_ADDRESS 0x50001240 /end MEASUREMENT
/begin MEASUREMENT EGSDCmn_Cat1B1Full_I.UGrdtTONV_I.outbit "Calulation of the transition condition to rich / Debouncing after detection of flat sensor voltage gradient due to signal symmetrization / return value" UBYTE B_TRUE 1 100 0.00 1.00000000000 BIT_MASK 0x1 FORMAT "%13.11" ECU_ADDRESS 0x50001242 /end MEASUREMENT
/begin MEASUREMENT EGSDCmn_Cat1B1Full_I.UGrdtTONV_I.time "Calulation of the transition condition to rich / Debouncing after detection of flat sensor voltage gradient due to signal symmetrization / expired delay time" UWORD t_q0p01 1 100 0.00 655.3500 FORMAT "%8.4" ECU_ADDRESS 0x50001244 /end MEASUREMENT
/begin MEASUREMENT EGSDCmn_Cat1B1Full_I.mO2EnaCatFullGrdtIKL_I.memory "Calulation of the transition condition to rich / Integrated exhaust gas mass flow for detection if catalyst is filled with oxygen (based on sensor voltage gradient) / Current Integrator value" FLOAT32_IEEE m_q1_mg 1 100 -1.0000E+037 1.0000E+037 FORMAT "%10.4" ECU_ADDRESS 0x50001248 /end MEASUREMENT
/begin MEASUREMENT EGSDCmn_Cat1B1Full_I.mOSCCatCpIK_I.memory "Calulation of the transition condition to rich / Integrated lean gas mass flow for Time Out detection / current integrator value" FLOAT32_IEEE m_q1_mg 1 100 -1.0000E+037 1.0000E+037 FORMAT "%10.4" ECU_ADDRESS 0x5000124C /end MEASUREMENT
/begin MEASUREMENT EGSDCmn_Cat1B1Full_I.uSnsrGrdtFF_I.status "Calulation of the transition condition to rich / Check of voltage value (based on sensor voltage gradient) / current value of RS-FF" UBYTE B_TRUE 1 100 0.00 1.00000000000 BIT_MASK 0x1 FORMAT "%13.11" ECU_ADDRESS 0x50001250 /end MEASUREMENT
/begin MEASUREMENT EGSDCmn_Cat1B1Full_I.uSnsrTONV_I.outbit "Calulation of the transition condition to rich / Debouncing for detection of sensor voltage level / return value" UBYTE B_TRUE 1 100 0.00 1.00000000000 BIT_MASK 0x1 FORMAT "%13.11" ECU_ADDRESS 0x50001252 /end MEASUREMENT
/begin MEASUREMENT EGSDCmn_Cat1B1Full_I.uSnsrTONV_I.time "Calulation of the transition condition to rich / Debouncing for detection of sensor voltage level / expired delay time" UWORD t_q0p01 1 100 0.00 655.3500 FORMAT "%8.4" ECU_ADDRESS 0x50001254 /end MEASUREMENT
/begin MEASUREMENT EGSDCmn_Cat1B1VirtParl_I.flgCatEmpty "state machine of virtual lambda shifting for IUMPR simulation of catalyst diagnosis, bank 1 / Check if catalyst is empty from oxygen" UBYTE B_TRUE 1 100 0.00 1.00000000000 BIT_MASK 0x1 FORMAT "%13.11" ECU_ADDRESS 0x60001758 /end MEASUREMENT
/begin MEASUREMENT EGSDCmn_Cat1B1VirtParl_I.flgCatFull "state machine of virtual lambda shifting for IUMPR simulation of catalyst diagnosis, bank 1 / Check if catalyst is filled with oxygen" UBYTE B_TRUE 1 100 0.00 1.00000000000 BIT_MASK 0x1 FORMAT "%13.11" ECU_ADDRESS 0x60001759 /end MEASUREMENT
/begin MEASUREMENT EGSDCmn_Cat1B1VirtParl_I.flgDynTripDneVirt "state machine of virtual lambda shifting for IUMPR simulation of catalyst diagnosis, bank 1 / Virtuell dynamic check for the upstream sensor" UBYTE B_TRUE 1 100 0.00 1.00000000000 BIT_MASK 0x1 FORMAT "%13.11" ECU_ADDRESS 0x6000175A /end MEASUREMENT
/begin MEASUREMENT EGSDCmn_Cat1B1VirtParl_I.flgIdnAdpnEnd "state machine of virtual lambda shifting for IUMPR simulation of catalyst diagnosis, bank 1 / Status of Online adaption" UBYTE B_TRUE 1 100 0.00 1.00000000000 BIT_MASK 0x1 FORMAT "%13.11" ECU_ADDRESS 0x6000175B /end MEASUREMENT
/begin MEASUREMENT EGSDCmn_Cat1B1VirtParl_I.flgIdnAdpnLean "state machine of virtual lambda shifting for IUMPR simulation of catalyst diagnosis, bank 1 / Status of Online adaptionfor lean lambda" UBYTE B_TRUE 1 100 0.00 1.00000000000 BIT_MASK 0x1 FORMAT "%13.11" ECU_ADDRESS 0x6000175C /end MEASUREMENT
/begin MEASUREMENT EGSDCmn_Cat1B1VirtParl_I.flgIdnAdpnRich "state machine of virtual lambda shifting for IUMPR simulation of catalyst diagnosis, bank 1 / Status of Online adaptionfor rich lambda" UBYTE B_TRUE 1 100 0.00 1.00000000000 BIT_MASK 0x1 FORMAT "%13.11" ECU_ADDRESS 0x6000175D /end MEASUREMENT
/begin MEASUREMENT EGSDCmn_Cat1B1VirtParl_I.flgReld "state machine of virtual lambda shifting for IUMPR simulation of catalyst diagnosis, bank 1 / lambda shifting is released" UBYTE B_TRUE 1 100 0.00 1.00000000000 BIT_MASK 0x1 FORMAT "%13.11" ECU_ADDRESS 0x6000175E /end MEASUREMENT
/begin MEASUREMENT EGSDCmn_Cat1B1VirtParl_I.flgUHiEnaParl "state machine of virtual lambda shifting for IUMPR simulation of catalyst diagnosis, bank 1 / Sensor voltage downstream is high" UBYTE B_TRUE 1 100 0.00 1.00000000000 BIT_MASK 0x1 FORMAT "%13.11" ECU_ADDRESS 0x6000175F /end MEASUREMENT
/begin MEASUREMENT EGSDCmn_Cat1B1VirtParl_I.flgUMid "state machine of virtual lambda shifting for IUMPR simulation of catalyst diagnosis, bank 1 / sensor voltage in medium range (two stage preconditioning required)" UBYTE B_TRUE 1 100 0.00 1.00000000000 BIT_MASK 0x1 FORMAT "%13.11" ECU_ADDRESS 0x60001760 /end MEASUREMENT
/begin MEASUREMENT EGSDCmn_Cat1B1VirtParl_I.flgVirtLamDyn "state machine of virtual lambda shifting for IUMPR simulation of catalyst diagnosis, bank 1 / Activation of IUMPR simulation for UEGO dynamic diagnosis" UBYTE B_TRUE 1 100 0.00 1.00000000000 BIT_MASK 0x1 FORMAT "%13.11" ECU_ADDRESS 0x60001761 /end MEASUREMENT
/begin MEASUREMENT EGSDCmn_Cat1B1VirtParl_I.mOSC "state machine of virtual lambda shifting for IUMPR simulation of catalyst diagnosis, bank 1 / Assumed oxygen storage capacity for first catalyst" FLOAT32_IEEE m_q1_mg 1 100 0.00 50000.0000 FORMAT "%10.4" ECU_ADDRESS 0x60001764 /end MEASUREMENT
/begin MEASUREMENT EGSDCmn_Cat1B1VirtParl_I.mRSC "state machine of virtual lambda shifting for IUMPR simulation of catalyst diagnosis, bank 1 / Assumed rich gas storage capacity for first catalyst" FLOAT32_IEEE m_q1_mg 1 100 0.00 50000.0000 FORMAT "%10.4" ECU_ADDRESS 0x60001768 /end MEASUREMENT
/begin MEASUREMENT EGSDCmn_Cat1B1VirtParl_I.mfVirtO2 "state machine of virtual lambda shifting for IUMPR simulation of catalyst diagnosis, bank 1 / Oxygen mass flow in catalyst 1, corrected by maximum possible mixture deviation in a fault free system" FLOAT32_IEEE mgrad_q1_mgdivs 1 100 0.00 50000.0000 FORMAT "%10.4" ECU_ADDRESS 0x6000176C /end MEASUREMENT
/begin MEASUREMENT EGSDCmn_Cat1B1VirtParl_I.mfVirtRich "state machine of virtual lambda shifting for IUMPR simulation of catalyst diagnosis, bank 1 / Rich Gas mass flow in catalyst 1, corrected by maximum possible mixture deviation in a fault free system" FLOAT32_IEEE mgrad_q1_mgdivs 1 100 0.00 50000.0000 FORMAT "%10.4" ECU_ADDRESS 0x60001770 /end MEASUREMENT
/begin MEASUREMENT EGSDCmn_Cat1B1VirtParl_I.sm "state machine of virtual lambda shifting for IUMPR simulation of catalyst diagnosis, bank 1 / State number" UBYTE EGSDCmn_VirtLamGenrParl_sm_VERB 1 100 0.00 7.00000000000 FORMAT "%13.11" ECU_ADDRESS 0x60001774 /end MEASUREMENT
/begin MEASUREMENT EGSDCmn_Cat1B1VirtParl_I.stLamGenr "state machine of virtual lambda shifting for IUMPR simulation of catalyst diagnosis, bank 1 / State number" UBYTE dez 1 100 0.00 255.0 FORMAT "%5.1" ECU_ADDRESS 0x60001775 /end MEASUREMENT
/begin MEASUREMENT EGSDCmn_Cat1B1VirtParl_I.tiGas "state machine of virtual lambda shifting for IUMPR simulation of catalyst diagnosis, bank 1 / gas propagation time till first Lambda sensor" UWORD t_q0p1 1 100 0.00 6553.500 FORMAT "%8.3" ECU_ADDRESS 0x60001776 /end MEASUREMENT
/begin MEASUREMENT EGSDCmn_Cat1B1VirtParl_I.tiLamDynLtr "state machine of virtual lambda shifting for IUMPR simulation of catalyst diagnosis, bank 1 / Dynamic time lambda signal of upstream sensor 1 Lean-Rich" UWORD t_q0p1 1 100 0.00 6553.500 FORMAT "%8.3" ECU_ADDRESS 0x60001778 /end MEASUREMENT
/begin MEASUREMENT EGSDCmn_Cat1B1VirtParl_I.tiLamDynRtl "state machine of virtual lambda shifting for IUMPR simulation of catalyst diagnosis, bank 1 / Dynamic time lambda signal of upstream sensor 1 Rich-Lean" UWORD t_q0p1 1 100 0.00 6553.500 FORMAT "%8.3" ECU_ADDRESS 0x6000177A /end MEASUREMENT
/begin MEASUREMENT EGSDCmn_Cat1B1VirtParl_I.tiUDynLtr "state machine of virtual lambda shifting for IUMPR simulation of catalyst diagnosis, bank 1 / Dynamic reaction time of downstream sensor, Lean-Rich" UWORD t_q0p1 1 100 0.00 6553.500 FORMAT "%8.3" ECU_ADDRESS 0x6000177C /end MEASUREMENT
/begin MEASUREMENT EGSDCmn_Cat1B1VirtParl_I.tiUDynRtl "state machine of virtual lambda shifting for IUMPR simulation of catalyst diagnosis, bank 1 / Dynamic reaction time of downstream sensor, Rich-Lean" UWORD t_q0p1 1 100 0.00 6553.500 FORMAT "%8.3" ECU_ADDRESS 0x6000177E /end MEASUREMENT
/begin MEASUREMENT EGSDCmn_Cat1B1VirtParl_I.u "state machine of virtual lambda shifting for IUMPR simulation of catalyst diagnosis, bank 1 / Sensor voltage of downstream sensor" UWORD spg_q1p221Em3_V 1 100 0.00 4.998779 FORMAT "%8.6" ECU_ADDRESS 0x60001780 /end MEASUREMENT
/begin MEASUREMENT EGSDCmn_Cat1B1VirtParl_I.EnaReldEF_I.buffer "state machine of virtual lambda shifting for IUMPR simulation of catalyst diagnosis, bank 1 / EdgeFalling: loss of enable condition / memory to detect falling edge" UBYTE B_TRUE 1 100 0.00 1.00000000000 BIT_MASK 0x1 FORMAT "%13.11" ECU_ADDRESS 0x60001782 /end MEASUREMENT
/begin MEASUREMENT EGSDCmn_Cat1B1VirtParl_I.EnaReldEF_I.oldSignal "state machine of virtual lambda shifting for IUMPR simulation of catalyst diagnosis, bank 1 / EdgeFalling: loss of enable condition / memory to detect falling edge" UBYTE B_TRUE 1 100 0.00 1.00000000000 BIT_MASK 0x1 FORMAT "%13.11" ECU_ADDRESS 0x60001783 /end MEASUREMENT
/begin MEASUREMENT EGSDCmn_Cat1B1VirtParl_I.IdnAdpnCTR_I.counter "state machine of virtual lambda shifting for IUMPR simulation of catalyst diagnosis, bank 1 / Counter for lambda jumps for online adaption purposes / current counter value" UWORD dez 1 100 0.00 65535.00 FORMAT "%8.2" ECU_ADDRESS 0x60001784 /end MEASUREMENT
/begin MEASUREMENT EGSDCmn_Cat1B1VirtParl_I.flgLeanLamStabTONV_I.outbit "state machine of virtual lambda shifting for IUMPR simulation of catalyst diagnosis, bank 1 / Waiting time for lean lambda stability criterion / return value" UBYTE B_TRUE 1 100 0.00 1.00000000000 BIT_MASK 0x1 FORMAT "%13.11" ECU_ADDRESS 0x60001786 /end MEASUREMENT
/begin MEASUREMENT EGSDCmn_Cat1B1VirtParl_I.flgLeanLamStabTONV_I.time "state machine of virtual lambda shifting for IUMPR simulation of catalyst diagnosis, bank 1 / Waiting time for lean lambda stability criterion / expired delay time" UWORD t_q0p1 1 100 0.00 6553.500 FORMAT "%8.3" ECU_ADDRESS 0x60001788 /end MEASUREMENT
/begin MEASUREMENT EGSDCmn_Cat1B1VirtParl_I.flgRichLamStabTONV_I.outbit "state machine of virtual lambda shifting for IUMPR simulation of catalyst diagnosis, bank 1 / Waiting time for rich lambda stability criterion / return value" UBYTE B_TRUE 1 100 0.00 1.00000000000 BIT_MASK 0x1 FORMAT "%13.11" ECU_ADDRESS 0x6000178A /end MEASUREMENT
/begin MEASUREMENT EGSDCmn_Cat1B1VirtParl_I.flgRichLamStabTONV_I.time "state machine of virtual lambda shifting for IUMPR simulation of catalyst diagnosis, bank 1 / Waiting time for rich lambda stability criterion / expired delay time" UWORD t_q0p1 1 100 0.00 6553.500 FORMAT "%8.3" ECU_ADDRESS 0x6000178C /end MEASUREMENT
/begin MEASUREMENT EGSDCmn_Cat1B1VirtParl_I.mO2EnaCatFullGrdtIK_I.memory "state machine of virtual lambda shifting for IUMPR simulation of catalyst diagnosis, bank 1 / Integrator for oxygen gas mass flow for detection if catalyst is filled with oxygen / current integrator value" FLOAT32_IEEE m_q1_mg 1 100 -1.0000E+037 1.0000E+037 FORMAT "%10.4" ECU_ADDRESS 0x60001790 /end MEASUREMENT
/begin MEASUREMENT EGSDCmn_Cat1B1VirtParl_I.mO2IdnAdpnIKL_I.memory "state machine of virtual lambda shifting for IUMPR simulation of catalyst diagnosis, bank 1 / Integrator for oxygen or rich gas mass flow for lambda jumps for online adaption purposes / Current Integrator value" FLOAT32_IEEE m_q1_mg 1 100 -1.0000E+037 1.0000E+037 FORMAT "%10.4" ECU_ADDRESS 0x60001794 /end MEASUREMENT
/begin MEASUREMENT EGSDCmn_Cat1B1VirtParl_I.mO2VirtEnaCatEmptyIK_I.memory "state machine of virtual lambda shifting for IUMPR simulation of catalyst diagnosis, bank 1 / Integrator for rich gas mass flow for detection if catalyst is emtpied from oxygen / current integrator value" FLOAT32_IEEE m_q1_mg 1 100 -1.0000E+037 1.0000E+037 FORMAT "%10.4" ECU_ADDRESS 0x60001798 /end MEASUREMENT
/begin MEASUREMENT EGSDCmn_Cat1B1VirtParl_I.tiGasRtlTONV_I.outbit "state machine of virtual lambda shifting for IUMPR simulation of catalyst diagnosis, bank 1 / Simulation of gas propagation till first Lambda sensor / return value" UBYTE B_TRUE 1 100 0.00 1.00000000000 BIT_MASK 0x1 FORMAT "%13.11" ECU_ADDRESS 0x6000179C /end MEASUREMENT
/begin MEASUREMENT EGSDCmn_Cat1B1VirtParl_I.tiGasRtlTONV_I.time "state machine of virtual lambda shifting for IUMPR simulation of catalyst diagnosis, bank 1 / Simulation of gas propagation till first Lambda sensor / expired delay time" UWORD t_q0p1 1 100 0.00 6553.500 FORMAT "%8.3" ECU_ADDRESS 0x6000179E /end MEASUREMENT
/begin MEASUREMENT EGSDCmn_Cat1B1VirtParl_I.tiUDynTONV_I.outbit "state machine of virtual lambda shifting for IUMPR simulation of catalyst diagnosis, bank 1 / simulation time for sensor dynamic of downstream sensor / return value" UBYTE B_TRUE 1 100 0.00 1.00000000000 BIT_MASK 0x1 FORMAT "%13.11" ECU_ADDRESS 0x600017A0 /end MEASUREMENT
/begin MEASUREMENT EGSDCmn_Cat1B1VirtParl_I.tiUDynTONV_I.time "state machine of virtual lambda shifting for IUMPR simulation of catalyst diagnosis, bank 1 / simulation time for sensor dynamic of downstream sensor / expired delay time" UWORD t_q0p1 1 100 0.00 6553.500 FORMAT "%8.3" ECU_ADDRESS 0x600017A2 /end MEASUREMENT
/begin MEASUREMENT EGSDCmn_ctReIni100msCoorrParl "counter for reinitialization trigger after PostDrive leave" UBYTE OneToOne 1 100 0.00 255.0 FORMAT "%5.1" ECU_ADDRESS 0x6000E398 /end MEASUREMENT
/begin MEASUREMENT EGSDCmn_ctReIni10msCoorrParl "counter for reinitialization trigger after PostDrive leave" UBYTE OneToOne 1 100 0.00 255.0 FORMAT "%5.1" ECU_ADDRESS 0x6000658E /end MEASUREMENT
/begin MEASUREMENT EGSDCmn_flgB1LamNotStabParl "time out for switching between rich and lean is triggered due to lambda stable criterion" UBYTE B_TRUE 1 100 0.00 1.00000000000 BIT_MASK 0x1 FORMAT "%13.11" ECU_ADDRESS 0x700008A5 /end MEASUREMENT
/begin MEASUREMENT EGSDCmn_flgB1LamStabParl "Debouncing after detection of unstable Lambda during active diagnosis is finished" UBYTE B_TRUE 1 100 0.00 1.00000000000 BIT_MASK 0x1 FORMAT "%13.11" ECU_ADDRESS 0x700002C6 /end MEASUREMENT
/begin MEASUREMENT EGSDCmn_flgB1TarLeanOk "Flag indicating that the downstream sensor has reached its Lean Target Voltage, Bank 1" UBYTE B_TRUE 1 100 0.00 1.00000000000 BIT_MASK 0x1 FORMAT "%13.11" ECU_ADDRESS 0x700002C5 /end MEASUREMENT
/begin MEASUREMENT EGSDCmn_flgB1TarRichOk "Flag indicating that the downstream sensor has reached its Rich Target Voltage, Bank 1" UBYTE B_TRUE 1 100 0.00 1.00000000000 BIT_MASK 0x1 FORMAT "%13.11" ECU_ADDRESS 0x700002C4 /end MEASUREMENT
/begin MEASUREMENT EGSDCmn_flgB1UHiEnaParl "Binary voltage of all parallelized sensors higher than a threshold" UBYTE B_TRUE 1 100 0.00 1.00000000000 BIT_MASK 0x1 FORMAT "%13.11" ECU_ADDRESS 0x700008A4 /end MEASUREMENT
/begin MEASUREMENT EGSDCmn_flgB1UMid "Flag indicating that the downstream sensor Voltage is towards the Rich Lambda, Bank 1" UBYTE B_TRUE 1 100 0.00 1.00000000000 BIT_MASK 0x1 FORMAT "%13.11" ECU_ADDRESS 0x700008A3 /end MEASUREMENT
/begin MEASUREMENT EGSDCmn_flgCat1EmptTOutParlB1 "Time-Out Criterion for recognition that catalyst is empty of oxygen" UBYTE B_TRUE 1 100 0.00 1.00000000000 BIT_MASK 0x1 FORMAT "%13.11" ECU_ADDRESS 0x7000089D /end MEASUREMENT
/begin MEASUREMENT EGSDCmn_flgCat1FullTOutParlB1 "Time-Out Criterion for recognition that catalyst is filled with oxygen" UBYTE B_TRUE 1 100 0.00 1.00000000000 BIT_MASK 0x1 FORMAT "%13.11" ECU_ADDRESS 0x7000089C /end MEASUREMENT
/begin MEASUREMENT EGSDCmn_flgDSMClrParlB1 "DSMClear is requested" UBYTE B_TRUE 1 100 0.00 1.00000000000 BIT_MASK 0x1 FORMAT "%13.11" ECU_ADDRESS 0x7000089B /end MEASUREMENT
/begin MEASUREMENT EGSDCmn_flgIdnAdpnEndParlS1B1 "Online adaption done" UBYTE B_TRUE 1 100 0.00 1.00000000000 BIT_MASK 0x1 FORMAT "%13.11" ECU_ADDRESS 0x70000894 /end MEASUREMENT
/begin MEASUREMENT EGSDCmn_flgIdnAdpnEndVirtParlS1B1 "Virtual online adaption done" UBYTE B_TRUE 1 100 0.00 1.00000000000 BIT_MASK 0x1 FORMAT "%13.11" ECU_ADDRESS 0x70000893 /end MEASUREMENT
/begin MEASUREMENT EGSDCmn_flgLamReqParlB1 "lambda request for parallelization is active, bank 1" UBYTE B_TRUE 1 100 0.00 1.00000000000 BIT_MASK 0x1 FORMAT "%13.11" ECU_ADDRESS 0x7000088E /end MEASUREMENT
/begin MEASUREMENT EGSDCmn_flgS1B1O2PlausResVirtParl "virtual lambda shifting in case of Lambda Signal offset error is done" UBYTE B_TRUE 1 100 0.00 1.00000000000 BIT_MASK 0x1 FORMAT "%13.11" ECU_ADDRESS 0x70000887 /end MEASUREMENT
/begin MEASUREMENT EGSDCmn_flgS2B1TarLeanErrParl "Error check for lean target voltage during parallelized exhaust sensor diagnosis, sensor 2" UBYTE B_TRUE 1 100 0.00 1.00000000000 BIT_MASK 0x1 FORMAT "%13.11" ECU_ADDRESS 0x70000885 /end MEASUREMENT
/begin MEASUREMENT EGSDCmn_flgS2B1TarLeanOkOnceParl "Check if lean target sensor voltage during active parallelization is once reached" UBYTE B_TRUE 1 100 0.00 1.00000000000 BIT_MASK 0x1 FORMAT "%13.11" ECU_ADDRESS 0x70000884 /end MEASUREMENT
/begin MEASUREMENT EGSDCmn_flgS2B1TarLeanResParl "range check of lean target sensor voltage is completed, sensor 2, bank 1" UBYTE B_TRUE 1 100 0.00 1.00000000000 BIT_MASK 0x1 FORMAT "%13.11" ECU_ADDRESS 0x70000883 /end MEASUREMENT
/begin MEASUREMENT EGSDCmn_flgS2B1TarLeanResParlER_I.buffer "Target Lean result triggered / rising edge detected" UBYTE B_TRUE 1 100 0.00 1.00000000000 BIT_MASK 0x1 FORMAT "%13.11" ECU_ADDRESS 0x60003BAE /end MEASUREMENT
/begin MEASUREMENT EGSDCmn_flgS2B1TarLeanResParlER_I.oldSignal "Target Lean result triggered / flag rising edge" UBYTE B_TRUE 1 100 0.00 1.00000000000 BIT_MASK 0x1 FORMAT "%13.11" ECU_ADDRESS 0x60003BAF /end MEASUREMENT
/begin MEASUREMENT EGSDCmn_flgS2B1TarLeanResVirtOffsParl "Virtual simulation of range check of lean target sensor voltage with Lambda Signal Offset is completed, sensor 2, bank 1" UBYTE B_TRUE 1 100 0.00 1.00000000000 BIT_MASK 0x1 FORMAT "%13.11" ECU_ADDRESS 0x70000882 /end MEASUREMENT
/begin MEASUREMENT EGSDCmn_flgS2B1TarLeanResVirtParl "Virtual simulation of range check of lean target sensor voltage is completed, sensor 2, bank 1" UBYTE B_TRUE 1 100 0.00 1.00000000000 BIT_MASK 0x1 FORMAT "%13.11" ECU_ADDRESS 0x70000881 /end MEASUREMENT
/begin MEASUREMENT EGSDCmn_flgS2B1TarRichErrParl "Error check for rich target voltage during parallelized exhaust sensor diagnosis, sensor 2" UBYTE B_TRUE 1 100 0.00 1.00000000000 BIT_MASK 0x1 FORMAT "%13.11" ECU_ADDRESS 0x70000880 /end MEASUREMENT
/begin MEASUREMENT EGSDCmn_flgS2B1TarRichOkOnceParl "Check if rich target sensor voltage during active parallelization is once reached" UBYTE B_TRUE 1 100 0.00 1.00000000000 BIT_MASK 0x1 FORMAT "%13.11" ECU_ADDRESS 0x7000087F /end MEASUREMENT
/begin MEASUREMENT EGSDCmn_flgS2B1TarRichResParl "range check of rich target sensor voltage is completed, sensor 2, bank 1" UBYTE B_TRUE 1 100 0.00 1.00000000000 BIT_MASK 0x1 FORMAT "%13.11" ECU_ADDRESS 0x7000087E /end MEASUREMENT
/begin MEASUREMENT EGSDCmn_flgS2B1TarRichResParlER_I.buffer "Target Lean result triggered / rising edge detected" UBYTE B_TRUE 1 100 0.00 1.00000000000 BIT_MASK 0x1 FORMAT "%13.11" ECU_ADDRESS 0x60003BAC /end MEASUREMENT
/begin MEASUREMENT EGSDCmn_flgS2B1TarRichResParlER_I.oldSignal "Target Lean result triggered / flag rising edge" UBYTE B_TRUE 1 100 0.00 1.00000000000 BIT_MASK 0x1 FORMAT "%13.11" ECU_ADDRESS 0x60003BAD /end MEASUREMENT
/begin MEASUREMENT EGSDCmn_flgS2B1TarRichResVirtOffsParl "Virtual simulation of range check of rich target sensor voltage with Lambda Signal Offset is completed, sensor 2, bank 1" UBYTE B_TRUE 1 100 0.00 1.00000000000 BIT_MASK 0x1 FORMAT "%13.11" ECU_ADDRESS 0x7000087D /end MEASUREMENT
/begin MEASUREMENT EGSDCmn_flgS2B1TarRichResVirtParl "Virtual simulation of range check of rich target sensor voltage is completed, sensor 2, bank 1" UBYTE B_TRUE 1 100 0.00 1.00000000000 BIT_MASK 0x1 FORMAT "%13.11" ECU_ADDRESS 0x7000087C /end MEASUREMENT
/begin MEASUREMENT EGSDCmn_flgTarLeanOkS2B1 "Flag Indicating if the downstream sensor has reached its Lean Target Voltage, Sensor 2,Bank 1" UBYTE B_TRUE 1 100 0.00 1.00000000000 BIT_MASK 0x1 FORMAT "%13.11" ECU_ADDRESS 0x700002C3 /end MEASUREMENT
/begin MEASUREMENT EGSDCmn_flgTarRichOkS2B1 "Flag Indicating if the downstream sensor has reached its Rich Target Voltage, Sensor 2, Bank 1" UBYTE B_TRUE 1 100 0.00 1.00000000000 BIT_MASK 0x1 FORMAT "%13.11" ECU_ADDRESS 0x700002C2 /end MEASUREMENT
/begin MEASUREMENT EGSDCmn_flgUS2B1Mid "Flag indicating that the downstream sensor Voltage is towards the Rich Lambda, Sensor 2, Bank 1" UBYTE B_TRUE 1 100 0.00 1.00000000000 BIT_MASK 0x1 FORMAT "%13.11" ECU_ADDRESS 0x700002C1 /end MEASUREMENT
/begin MEASUREMENT EGSDCmn_LamGenrParlB1_I.flgCat1EmptyTOut "state machine of lambda shifting from coordinator function of parallelization, bank 1 / Time out reached while checking for catalyst empty" UBYTE B_TRUE 1 100 0.00 1.00000000000 BIT_MASK 0x1 FORMAT "%13.11" ECU_ADDRESS 0x50001258 /end MEASUREMENT
/begin MEASUREMENT EGSDCmn_LamGenrParlB1_I.flgCat1FullTOut "state machine of lambda shifting from coordinator function of parallelization, bank 1 / Time out reached while checking for catalyst full" UBYTE B_TRUE 1 100 0.00 1.00000000000 BIT_MASK 0x1 FORMAT "%13.11" ECU_ADDRESS 0x50001259 /end MEASUREMENT
/begin MEASUREMENT EGSDCmn_LamGenrParlB1_I.flgCatEmpty "state machine of lambda shifting from coordinator function of parallelization, bank 1 / Flag active if oxygen storage empty in NOx storage catalyst" UBYTE B_TRUE 1 100 0.00 1.00000000000 BIT_MASK 0x1 FORMAT "%13.11" ECU_ADDRESS 0x5000125A /end MEASUREMENT
/begin MEASUREMENT EGSDCmn_LamGenrParlB1_I.flgCatEmptyOK "state machine of lambda shifting from coordinator function of parallelization, bank 1 / no unknown thin gas in cat" UBYTE B_TRUE 1 100 0.00 1.00000000000 BIT_MASK 0x1 FORMAT "%13.11" ECU_ADDRESS 0x5000125B /end MEASUREMENT
/begin MEASUREMENT EGSDCmn_LamGenrParlB1_I.flgCatFull "state machine of lambda shifting from coordinator function of parallelization, bank 1 / catalyst is full of oxygen" UBYTE B_TRUE 1 100 0.00 1.00000000000 BIT_MASK 0x1 FORMAT "%13.11" ECU_ADDRESS 0x5000125C /end MEASUREMENT
/begin MEASUREMENT EGSDCmn_LamGenrParlB1_I.flgDynTripDne "state machine of lambda shifting from coordinator function of parallelization, bank 1 / Dynamic check for the first sensor is done" UBYTE B_TRUE 1 100 0.00 1.00000000000 BIT_MASK 0x1 FORMAT "%13.11" ECU_ADDRESS 0x5000125D /end MEASUREMENT
/begin MEASUREMENT EGSDCmn_LamGenrParlB1_I.flgIdnAdpnEnd "state machine of lambda shifting from coordinator function of parallelization, bank 1 / Online adaption done" UBYTE B_TRUE 1 100 0.00 1.00000000000 BIT_MASK 0x1 FORMAT "%13.11" ECU_ADDRESS 0x5000125E /end MEASUREMENT
/begin MEASUREMENT EGSDCmn_LamGenrParlB1_I.flgIdnAdpnLean "state machine of lambda shifting from coordinator function of parallelization, bank 1 / Online adaption lean reached" UBYTE B_TRUE 1 100 0.00 1.00000000000 BIT_MASK 0x1 FORMAT "%13.11" ECU_ADDRESS 0x5000125F /end MEASUREMENT
/begin MEASUREMENT EGSDCmn_LamGenrParlB1_I.flgIdnAdpnRich "state machine of lambda shifting from coordinator function of parallelization, bank 1 / Online adaption rich reached" UBYTE B_TRUE 1 100 0.00 1.00000000000 BIT_MASK 0x1 FORMAT "%13.11" ECU_ADDRESS 0x50001260 /end MEASUREMENT
/begin MEASUREMENT EGSDCmn_LamGenrParlB1_I.flgLamNotStab "state machine of lambda shifting from coordinator function of parallelization, bank 1 / lambda value is not stable" UBYTE B_TRUE 1 100 0.00 1.00000000000 BIT_MASK 0x1 FORMAT "%13.11" ECU_ADDRESS 0x50001261 /end MEASUREMENT
/begin MEASUREMENT EGSDCmn_LamGenrParlB1_I.flgLamRels "state machine of lambda shifting from coordinator function of parallelization, bank 1 / Inhibiting by instable lambda value is abolished" UBYTE B_TRUE 1 100 0.00 1.00000000000 BIT_MASK 0x1 FORMAT "%13.11" ECU_ADDRESS 0x50001262 /end MEASUREMENT
/begin MEASUREMENT EGSDCmn_LamGenrParlB1_I.flgLamReq "state machine of lambda shifting from coordinator function of parallelization, bank 1 / lambda request is active" UBYTE B_TRUE 1 100 0.00 1.00000000000 BIT_MASK 0x1 FORMAT "%13.11" ECU_ADDRESS 0x50001263 /end MEASUREMENT
/begin MEASUREMENT EGSDCmn_LamGenrParlB1_I.flgLamStabLean "state machine of lambda shifting from coordinator function of parallelization, bank 1 / lambda value is not stable" UBYTE B_TRUE 1 100 0.00 1.00000000000 BIT_MASK 0x1 FORMAT "%13.11" ECU_ADDRESS 0x50001264 /end MEASUREMENT
/begin MEASUREMENT EGSDCmn_LamGenrParlB1_I.flgLamStabRich "state machine of lambda shifting from coordinator function of parallelization, bank 1 / lambda value in rich is stable" UBYTE B_TRUE 1 100 0.00 1.00000000000 BIT_MASK 0x1 FORMAT "%13.11" ECU_ADDRESS 0x50001265 /end MEASUREMENT
/begin MEASUREMENT EGSDCmn_LamGenrParlB1_I.flgLeanRampEnd "state machine of lambda shifting from coordinator function of parallelization, bank 1 / lean lambda ramp is expired" UBYTE B_TRUE 1 100 0.00 1.00000000000 BIT_MASK 0x1 FORMAT "%13.11" ECU_ADDRESS 0x50001266 /end MEASUREMENT
/begin MEASUREMENT EGSDCmn_LamGenrParlB1_I.flgOSCTestPassd "state machine of lambda shifting from coordinator function of parallelization, bank 1 / OSC partial measurement is complete" UBYTE B_TRUE 1 100 0.00 1.00000000000 BIT_MASK 0x1 FORMAT "%13.11" ECU_ADDRESS 0x50001267 /end MEASUREMENT
/begin MEASUREMENT EGSDCmn_LamGenrParlB1_I.flgQlyDeFltSuspc "state machine of lambda shifting from coordinator function of parallelization, bank 1 / Dynamic error suspicion from lossfunction" UBYTE B_TRUE 1 100 0.00 1.00000000000 BIT_MASK 0x1 FORMAT "%13.11" ECU_ADDRESS 0x50001268 /end MEASUREMENT
/begin MEASUREMENT EGSDCmn_LamGenrParlB1_I.flgRichRampEnd "state machine of lambda shifting from coordinator function of parallelization, bank 1 / rich lambda ramp is expired" UBYTE B_TRUE 1 100 0.00 1.00000000000 BIT_MASK 0x1 FORMAT "%13.11" ECU_ADDRESS 0x50001269 /end MEASUREMENT
/begin MEASUREMENT EGSDCmn_LamGenrParlB1_I.flgStMacReld "state machine of lambda shifting from coordinator function of parallelization, bank 1 / release condiiton for state machine" UBYTE B_TRUE 1 100 0.00 1.00000000000 BIT_MASK 0x1 FORMAT "%13.11" ECU_ADDRESS 0x5000126A /end MEASUREMENT
/begin MEASUREMENT EGSDCmn_LamGenrParlB1_I.flgTarLeanOK "state machine of lambda shifting from coordinator function of parallelization, bank 1 / Target sensor voltage in mager is reached" UBYTE B_TRUE 1 100 0.00 1.00000000000 BIT_MASK 0x1 FORMAT "%13.11" ECU_ADDRESS 0x5000126B /end MEASUREMENT
/begin MEASUREMENT EGSDCmn_LamGenrParlB1_I.flgTarRichOK "state machine of lambda shifting from coordinator function of parallelization, bank 1 / Target sensor voltage in rich is reached" UBYTE B_TRUE 1 100 0.00 1.00000000000 BIT_MASK 0x1 FORMAT "%13.11" ECU_ADDRESS 0x5000126C /end MEASUREMENT
/begin MEASUREMENT EGSDCmn_LamGenrParlB1_I.flgUHiEnaParl "state machine of lambda shifting from coordinator function of parallelization, bank 1 / sensor voltage is high" UBYTE B_TRUE 1 100 0.00 1.00000000000 BIT_MASK 0x1 FORMAT "%13.11" ECU_ADDRESS 0x5000126D /end MEASUREMENT
/begin MEASUREMENT EGSDCmn_LamGenrParlB1_I.flgUMid "state machine of lambda shifting from coordinator function of parallelization, bank 1 / Sensor Voltage at the Beginning of Parallelization in the middle range, preconditioning rich and lean" UBYTE B_TRUE 1 100 0.00 1.00000000000 BIT_MASK 0x1 FORMAT "%13.11" ECU_ADDRESS 0x5000126E /end MEASUREMENT
/begin MEASUREMENT EGSDCmn_LamGenrParlB1_I.mRampDurParl "state machine of lambda shifting from coordinator function of parallelization, bank 1 / amount of exhaust gas mass flow to hold on the ramp during ramp-test" UWORD m_q0p001_kg 1 100 0.00 65.53500 FORMAT "%8.5" ECU_ADDRESS 0x50001270 /end MEASUREMENT
/begin MEASUREMENT EGSDCmn_LamGenrParlB1_I.mfEg "state machine of lambda shifting from coordinator function of parallelization, bank 1 / Exhaust gas mass flow" UWORD m_q0p1 1 100 0.00 6553.500 FORMAT "%8.3" ECU_ADDRESS 0x50001272 /end MEASUREMENT
/begin MEASUREMENT EGSDCmn_LamGenrParlB1_I.mfO2 "state machine of lambda shifting from coordinator function of parallelization, bank 1 / Oxygen mass flow" FLOAT32_IEEE mgrad_q1_mgdivs 1 100 -50000.0000 50000.0000 FORMAT "%10.4" ECU_ADDRESS 0x50001274 /end MEASUREMENT
/begin MEASUREMENT EGSDCmn_LamGenrParlB1_I.ratLamAct "state machine of lambda shifting from coordinator function of parallelization, bank 1 / Lambda actual value of upstream sensor" UWORD fak_uw_b16 1 100 0.00 15.99976 FORMAT "%8.5" ECU_ADDRESS 0x50001278 /end MEASUREMENT
/begin MEASUREMENT EGSDCmn_LamGenrParlB1_I.ratLamCorr "state machine of lambda shifting from coordinator function of parallelization, bank 1 / lambda set point correction of lambda control downstream" SWORD fak_q3p0518Em5 1 100 -1.000000 0.999969 FORMAT "%8.6" ECU_ADDRESS 0x5000127A /end MEASUREMENT
/begin MEASUREMENT EGSDCmn_LamGenrParlB1_I.ratLamRampLeanParl "state machine of lambda shifting from coordinator function of parallelization, bank 1 / lambda limit in direction lean of ramp test for range check" UWORD fak_uw_b16 1 100 0.00 15.99976 FORMAT "%8.5" ECU_ADDRESS 0x5000127C /end MEASUREMENT
/begin MEASUREMENT EGSDCmn_LamGenrParlB1_I.ratLamRampRichParl "state machine of lambda shifting from coordinator function of parallelization, bank 1 / lambda limit in direction rich of ramp test for range check" UWORD fak_uw_b16 1 100 0.00 15.99976 FORMAT "%8.5" ECU_ADDRESS 0x5000127E /end MEASUREMENT
/begin MEASUREMENT EGSDCmn_LamGenrParlB1_I.ratLamReq "state machine of lambda shifting from coordinator function of parallelization, bank 1 / Requested lambda" UWORD fak_uw_b16 1 100 0.00 15.99976 FORMAT "%8.5" ECU_ADDRESS 0x50001280 /end MEASUREMENT
/begin MEASUREMENT EGSDCmn_LamGenrParlB1_I.ratLamSpNoDyn "state machine of lambda shifting from coordinator function of parallelization, bank 1 / Lambda setpoint at sensor position without dynamics" UWORD fak_q0p000244 1 100 0.00 15.99976 FORMAT "%8.5" ECU_ADDRESS 0x50001282 /end MEASUREMENT
/begin MEASUREMENT EGSDCmn_LamGenrParlB1_I.sm "state machine of lambda shifting from coordinator function of parallelization, bank 1 / State number" UBYTE EGSDCmn_LamGenrParl_sm_VERB 1 100 0.00 7.00000000000 FORMAT "%13.11" ECU_ADDRESS 0x50001284 /end MEASUREMENT
/begin MEASUREMENT EGSDCmn_LamGenrParlB1_I.stLamGenr "state machine of lambda shifting from coordinator function of parallelization, bank 1 / State number" UBYTE dez 1 100 0.00 255.0 FORMAT "%5.1" ECU_ADDRESS 0x50001285 /end MEASUREMENT
/begin MEASUREMENT EGSDCmn_LamGenrParlB1_I.EnaReldEFNM_I.oldSignal "state machine of lambda shifting from coordinator function of parallelization, bank 1 / Release condition / memory to detect falling edge" UBYTE B_TRUE 1 100 0.00 1.00000000000 BIT_MASK 0x1 FORMAT "%13.11" ECU_ADDRESS 0x50001286 /end MEASUREMENT
/begin MEASUREMENT EGSDCmn_LamGenrParlB1_I.IdnAdpnCTR_I.counter "state machine of lambda shifting from coordinator function of parallelization, bank 1 / Counter for online adaption changes / current counter value" UBYTE dez 1 100 0.00 255.0 FORMAT "%5.1" ECU_ADDRESS 0x50001287 /end MEASUREMENT
/begin MEASUREMENT EGSDCmn_LamGenrParlB1_I.LamLeanMonTOFFV_I.outbit "state machine of lambda shifting from coordinator function of parallelization, bank 1 / state machine of lambda shifting from coordinator function of parallelization / Output Bit" UBYTE B_TRUE 1 100 0.00 1.00000000000 BIT_MASK 0x1 FORMAT "%13.11" ECU_ADDRESS 0x50001288 /end MEASUREMENT
/begin MEASUREMENT EGSDCmn_LamGenrParlB1_I.LamLeanMonTOFFV_I.time "state machine of lambda shifting from coordinator function of parallelization, bank 1 / state machine of lambda shifting from coordinator function of parallelization / Occured Time" UBYTE t_q0p01 1 100 0.00 2.550 FORMAT "%5.3" ECU_ADDRESS 0x50001289 /end MEASUREMENT
/begin MEASUREMENT EGSDCmn_LamGenrParlB1_I.LamRampIKL_I.memory "state machine of lambda shifting from coordinator function of parallelization, bank 1 / lambda ramp / Current Integrator value" ULONG fak_q3p72529Em9 1 100 0.00 15.9999999963 FORMAT "%13.10" ECU_ADDRESS 0x5000128C /end MEASUREMENT
/begin MEASUREMENT EGSDCmn_LamGenrParlB1_I.LamRichMonTOFFV_I.outbit "state machine of lambda shifting from coordinator function of parallelization, bank 1 / state machine of lambda shifting from coordinator function of parallelization / Output Bit" UBYTE B_TRUE 1 100 0.00 1.00000000000 BIT_MASK 0x1 FORMAT "%13.11" ECU_ADDRESS 0x50001290 /end MEASUREMENT
/begin MEASUREMENT EGSDCmn_LamGenrParlB1_I.LamRichMonTOFFV_I.time "state machine of lambda shifting from coordinator function of parallelization, bank 1 / state machine of lambda shifting from coordinator function of parallelization / Occured Time" UBYTE t_q0p01 1 100 0.00 2.550 FORMAT "%5.3" ECU_ADDRESS 0x50001291 /end MEASUREMENT
/begin MEASUREMENT EGSDCmn_LamGenrParlB1_I.LamRichNotStabTONV_I.outbit "state machine of lambda shifting from coordinator function of parallelization, bank 1 / Wait for stable upstream Lambda when cat is empty / return value" UBYTE B_TRUE 1 100 0.00 1.00000000000 BIT_MASK 0x1 FORMAT "%13.11" ECU_ADDRESS 0x50001292 /end MEASUREMENT
/begin MEASUREMENT EGSDCmn_LamGenrParlB1_I.LamRichNotStabTONV_I.time "state machine of lambda shifting from coordinator function of parallelization, bank 1 / Wait for stable upstream Lambda when cat is empty / expired delay time" UWORD t_q0p01 1 100 0.00 655.3500 FORMAT "%8.4" ECU_ADDRESS 0x50001294 /end MEASUREMENT
/begin MEASUREMENT EGSDCmn_LamGenrParlB1_I.LamleanNotStabTONV_I.outbit "state machine of lambda shifting from coordinator function of parallelization, bank 1 / Wait for stable upstream Lambda when cat is full / return value" UBYTE B_TRUE 1 100 0.00 1.00000000000 BIT_MASK 0x1 FORMAT "%13.11" ECU_ADDRESS 0x50001296 /end MEASUREMENT
/begin MEASUREMENT EGSDCmn_LamGenrParlB1_I.LamleanNotStabTONV_I.time "state machine of lambda shifting from coordinator function of parallelization, bank 1 / Wait for stable upstream Lambda when cat is full / expired delay time" UWORD t_q0p01 1 100 0.00 655.3500 FORMAT "%8.4" ECU_ADDRESS 0x50001298 /end MEASUREMENT
/begin MEASUREMENT EGSDCmn_LamGenrParlB1_I.QlyDeFltSuspcER_I.buffer "state machine of lambda shifting from coordinator function of parallelization, bank 1 / Dynamic fault suspicion is detected / rising edge detected" UBYTE B_TRUE 1 100 0.00 1.00000000000 BIT_MASK 0x1 FORMAT "%13.11" ECU_ADDRESS 0x5000129A /end MEASUREMENT
/begin MEASUREMENT EGSDCmn_LamGenrParlB1_I.QlyDeFltSuspcER_I.oldSignal "state machine of lambda shifting from coordinator function of parallelization, bank 1 / Dynamic fault suspicion is detected / flag rising edge" UBYTE B_TRUE 1 100 0.00 1.00000000000 BIT_MASK 0x1 FORMAT "%13.11" ECU_ADDRESS 0x5000129B /end MEASUREMENT
/begin MEASUREMENT EGSDCmn_LamGenrParlB1_I.RampEndLimIK_I.memory "state machine of lambda shifting from coordinator function of parallelization, bank 1 / integrated exhaust gas mass flow during lambda rampe / current integrator value" ULONG m_q1p5259Em8_kg 1 100 0.00 65.5359999847 FORMAT "%13.10" ECU_ADDRESS 0x5000129C /end MEASUREMENT
/begin MEASUREMENT EGSDCmn_LamGenrParlB1_I.flgOSCTestPassdFF_I.status "state machine of lambda shifting from coordinator function of parallelization, bank 1 / OSC partial measurement is complete, waiting for lambda stability / current value of RS-FF" UBYTE B_TRUE 1 100 0.00 1.00000000000 BIT_MASK 0x1 FORMAT "%13.11" ECU_ADDRESS 0x500012A0 /end MEASUREMENT
/begin MEASUREMENT EGSDCmn_LamGenrParlB1_I.mO2IdnAdpnIKL_I.memory "state machine of lambda shifting from coordinator function of parallelization, bank 1 / Oxygenmassflow integral for the online adaption / Current Integrator value" FLOAT32_IEEE m_q1_mg 1 100 -1.0000E+037 1.0000E+037 FORMAT "%10.4" ECU_ADDRESS 0x500012A4 /end MEASUREMENT
/begin MEASUREMENT EGSDCmn_LamGenrParlB1_I.mfEgLeanLamStabIK_I.memory "state machine of lambda shifting from coordinator function of parallelization, bank 1 / Exhaust gas mass flow throughput for settiment criterium of lambda value in lean / current integrator value" ULONG m_q1p5259Em8_kg 1 100 0.00 65.5359999847 FORMAT "%13.10" ECU_ADDRESS 0x500012A8 /end MEASUREMENT
/begin MEASUREMENT EGSDCmn_LamGenrParlB1_I.mfEgRichLamStabIK_I.memory "state machine of lambda shifting from coordinator function of parallelization, bank 1 / Exhaust gas mass flow throughput for settiment criterium of lambda value in rich / current integrator value" ULONG m_q1p5259Em8_kg 1 100 0.00 65.5359999847 FORMAT "%13.10" ECU_ADDRESS 0x500012AC /end MEASUREMENT
/begin MEASUREMENT EGSDCmn_LamGenrParlB1_I.tiDynWpaRampTONVNM_I.time "state machine of lambda shifting from coordinator function of parallelization, bank 1 / turn on delay class instance for ramping lambda / Delay Time" UWORD t_q0p01 1 100 0.00 655.3500 FORMAT "%8.4" ECU_ADDRESS 0x500012B0 /end MEASUREMENT
/begin MEASUREMENT EGSDCmn_mCatEmptyGrdtParl "Rich gas mass for the detection if the catalyst is empty of oxygen" FLOAT32_IEEE m_q1_mg 1 100 0.00 50000.0000 FORMAT "%10.4" ECU_ADDRESS 0x50004C20 /end MEASUREMENT
/begin MEASUREMENT EGSDCmn_mCatFullGrdtParl "Oxygen mass for the detection if catalyst is filled with oxygen during measurement phase" FLOAT32_IEEE m_q1_mg 1 100 0.00 50000.0000 FORMAT "%10.4" ECU_ADDRESS 0x50004C28 /end MEASUREMENT
/begin MEASUREMENT EGSDCmn_mErrTarLeanS2Parl "Amount of oxygen mass flow before setting of a target- lean-error-suspicion for Sensor2" FLOAT32_IEEE m_q1_mg 1 100 0.00 50000.0000 FORMAT "%10.4" ECU_ADDRESS 0x50004C30 /end MEASUREMENT
/begin MEASUREMENT EGSDCmn_mErrTarRichS2Parl "Amount of oxygen mass flow before setting of a target- Rich error-suspicion for Sensor2" FLOAT32_IEEE m_q1_mg 1 100 0.00 50000.0000 FORMAT "%10.4" ECU_ADDRESS 0x60001DAC /end MEASUREMENT
/begin MEASUREMENT EGSDCmn_mRampDurParl "amount of exhaust gas mass flow to hold on the ramp during ramp-test" UWORD m_q0p001_kg 1 100 0.00 65.53500 FORMAT "%8.5" ECU_ADDRESS 0x6000E1AA /end MEASUREMENT
/begin MEASUREMENT EGSDCmn_mRSCNrmVirtParlB1 "Rich gas storage capacity of catalyst for IUMPR simulation in partial measurement, bank 1" ULONG m_q0p1_mg 1 100 0.0000 429496729.5000 FORMAT "%10.4" ECU_ADDRESS 0x600017A8 /end MEASUREMENT
/begin MEASUREMENT EGSDCmn_ratLamRampLeanParl "lambda limit in direction lean of ramp test for range check" UWORD fak_uw_b16 1 100 0.00 15.99976 FORMAT "%8.5" ECU_ADDRESS 0x6000E1AE /end MEASUREMENT
/begin MEASUREMENT EGSDCmn_ratLamRampRichParl "lambda limit in direction rich of ramp test for range check" UWORD fak_uw_b16 1 100 0.00 15.99976 FORMAT "%8.5" ECU_ADDRESS 0x6000E1B0 /end MEASUREMENT
/begin MEASUREMENT EGSDCmn_ratLamReqParlB1 "lambda request for parallelization during check, bank 1" UWORD fak_uw_b16 1 100 0.00 15.99976 FORMAT "%8.5" ECU_ADDRESS 0x60004D04 /end MEASUREMENT
/begin MEASUREMENT EGSDCmn_S1B1VirtLamDynParl_I.flgCatEmpty "state machine of virtual lambda shifting for IUMPR simulation of upstream sensor 1 dynamic diagnosis, bank 1 / Check if catalyst is empty from oxygen" UBYTE B_TRUE 1 100 0.00 1.00000000000 BIT_MASK 0x1 FORMAT "%13.11" ECU_ADDRESS 0x6000170C /end MEASUREMENT
/begin MEASUREMENT EGSDCmn_S1B1VirtLamDynParl_I.flgCatFull "state machine of virtual lambda shifting for IUMPR simulation of upstream sensor 1 dynamic diagnosis, bank 1 / Check if catalyst is filled with oxygen" UBYTE B_TRUE 1 100 0.00 1.00000000000 BIT_MASK 0x1 FORMAT "%13.11" ECU_ADDRESS 0x6000170D /end MEASUREMENT
/begin MEASUREMENT EGSDCmn_S1B1VirtLamDynParl_I.flgDynTripDneVirt "state machine of virtual lambda shifting for IUMPR simulation of upstream sensor 1 dynamic diagnosis, bank 1 / Virtuell dynamic check for the upstream sensor" UBYTE B_TRUE 1 100 0.00 1.00000000000 BIT_MASK 0x1 FORMAT "%13.11" ECU_ADDRESS 0x6000170E /end MEASUREMENT
/begin MEASUREMENT EGSDCmn_S1B1VirtLamDynParl_I.flgIdnAdpnEnd "state machine of virtual lambda shifting for IUMPR simulation of upstream sensor 1 dynamic diagnosis, bank 1 / Status of Online adaption" UBYTE B_TRUE 1 100 0.00 1.00000000000 BIT_MASK 0x1 FORMAT "%13.11" ECU_ADDRESS 0x6000170F /end MEASUREMENT
/begin MEASUREMENT EGSDCmn_S1B1VirtLamDynParl_I.flgIdnAdpnLean "state machine of virtual lambda shifting for IUMPR simulation of upstream sensor 1 dynamic diagnosis, bank 1 / Status of Online adaptionfor lean lambda" UBYTE B_TRUE 1 100 0.00 1.00000000000 BIT_MASK 0x1 FORMAT "%13.11" ECU_ADDRESS 0x60001710 /end MEASUREMENT
/begin MEASUREMENT EGSDCmn_S1B1VirtLamDynParl_I.flgIdnAdpnRich "state machine of virtual lambda shifting for IUMPR simulation of upstream sensor 1 dynamic diagnosis, bank 1 / Status of Online adaptionfor rich lambda" UBYTE B_TRUE 1 100 0.00 1.00000000000 BIT_MASK 0x1 FORMAT "%13.11" ECU_ADDRESS 0x60001711 /end MEASUREMENT
/begin MEASUREMENT EGSDCmn_S1B1VirtLamDynParl_I.flgReld "state machine of virtual lambda shifting for IUMPR simulation of upstream sensor 1 dynamic diagnosis, bank 1 / lambda shifting is released" UBYTE B_TRUE 1 100 0.00 1.00000000000 BIT_MASK 0x1 FORMAT "%13.11" ECU_ADDRESS 0x60001712 /end MEASUREMENT
/begin MEASUREMENT EGSDCmn_S1B1VirtLamDynParl_I.flgUHiEnaParl "state machine of virtual lambda shifting for IUMPR simulation of upstream sensor 1 dynamic diagnosis, bank 1 / Sensor voltage downstream is high" UBYTE B_TRUE 1 100 0.00 1.00000000000 BIT_MASK 0x1 FORMAT "%13.11" ECU_ADDRESS 0x60001713 /end MEASUREMENT
/begin MEASUREMENT EGSDCmn_S1B1VirtLamDynParl_I.flgUMid "state machine of virtual lambda shifting for IUMPR simulation of upstream sensor 1 dynamic diagnosis, bank 1 / sensor voltage in medium range (two stage preconditioning required)" UBYTE B_TRUE 1 100 0.00 1.00000000000 BIT_MASK 0x1 FORMAT "%13.11" ECU_ADDRESS 0x60001714 /end MEASUREMENT
/begin MEASUREMENT EGSDCmn_S1B1VirtLamDynParl_I.flgVirtLamDyn "state machine of virtual lambda shifting for IUMPR simulation of upstream sensor 1 dynamic diagnosis, bank 1 / Activation of IUMPR simulation for UEGO dynamic diagnosis" UBYTE B_TRUE 1 100 0.00 1.00000000000 BIT_MASK 0x1 FORMAT "%13.11" ECU_ADDRESS 0x60001715 /end MEASUREMENT
/begin MEASUREMENT EGSDCmn_S1B1VirtLamDynParl_I.mOSC "state machine of virtual lambda shifting for IUMPR simulation of upstream sensor 1 dynamic diagnosis, bank 1 / Assumed oxygen storage capacity for first catalyst" FLOAT32_IEEE m_q1_mg 1 100 0.00 50000.0000 FORMAT "%10.4" ECU_ADDRESS 0x60001718 /end MEASUREMENT
/begin MEASUREMENT EGSDCmn_S1B1VirtLamDynParl_I.mRSC "state machine of virtual lambda shifting for IUMPR simulation of upstream sensor 1 dynamic diagnosis, bank 1 / Assumed rich gas storage capacity for first catalyst" FLOAT32_IEEE m_q1_mg 1 100 0.00 50000.0000 FORMAT "%10.4" ECU_ADDRESS 0x6000171C /end MEASUREMENT
/begin MEASUREMENT EGSDCmn_S1B1VirtLamDynParl_I.mfVirtO2 "state machine of virtual lambda shifting for IUMPR simulation of upstream sensor 1 dynamic diagnosis, bank 1 / Oxygen mass flow in catalyst 1, corrected by maximum possible mixture deviation in a fault free system" FLOAT32_IEEE mgrad_q1_mgdivs 1 100 0.00 50000.0000 FORMAT "%10.4" ECU_ADDRESS 0x60001720 /end MEASUREMENT
/begin MEASUREMENT EGSDCmn_S1B1VirtLamDynParl_I.mfVirtRich "state machine of virtual lambda shifting for IUMPR simulation of upstream sensor 1 dynamic diagnosis, bank 1 / Rich Gas mass flow in catalyst 1, corrected by maximum possible mixture deviation in a fault free system" FLOAT32_IEEE mgrad_q1_mgdivs 1 100 0.00 50000.0000 FORMAT "%10.4" ECU_ADDRESS 0x60001724 /end MEASUREMENT
/begin MEASUREMENT EGSDCmn_S1B1VirtLamDynParl_I.sm "state machine of virtual lambda shifting for IUMPR simulation of upstream sensor 1 dynamic diagnosis, bank 1 / State number" UBYTE EGSDCmn_VirtLamGenrParl_sm_VERB 1 100 0.00 7.00000000000 FORMAT "%13.11" ECU_ADDRESS 0x60001728 /end MEASUREMENT
/begin MEASUREMENT EGSDCmn_S1B1VirtLamDynParl_I.stLamGenr "state machine of virtual lambda shifting for IUMPR simulation of upstream sensor 1 dynamic diagnosis, bank 1 / State number" UBYTE dez 1 100 0.00 255.0 FORMAT "%5.1" ECU_ADDRESS 0x60001729 /end MEASUREMENT
/begin MEASUREMENT EGSDCmn_S1B1VirtLamDynParl_I.tiGas "state machine of virtual lambda shifting for IUMPR simulation of upstream sensor 1 dynamic diagnosis, bank 1 / gas propagation time till first Lambda sensor" UWORD t_q0p1 1 100 0.00 6553.500 FORMAT "%8.3" ECU_ADDRESS 0x6000172A /end MEASUREMENT
/begin MEASUREMENT EGSDCmn_S1B1VirtLamDynParl_I.tiLamDynLtr "state machine of virtual lambda shifting for IUMPR simulation of upstream sensor 1 dynamic diagnosis, bank 1 / Dynamic time lambda signal of upstream sensor 1 Lean-Rich" UWORD t_q0p1 1 100 0.00 6553.500 FORMAT "%8.3" ECU_ADDRESS 0x6000172C /end MEASUREMENT
/begin MEASUREMENT EGSDCmn_S1B1VirtLamDynParl_I.tiLamDynRtl "state machine of virtual lambda shifting for IUMPR simulation of upstream sensor 1 dynamic diagnosis, bank 1 / Dynamic time lambda signal of upstream sensor 1 Rich-Lean" UWORD t_q0p1 1 100 0.00 6553.500 FORMAT "%8.3" ECU_ADDRESS 0x6000172E /end MEASUREMENT
/begin MEASUREMENT EGSDCmn_S1B1VirtLamDynParl_I.tiUDynLtr "state machine of virtual lambda shifting for IUMPR simulation of upstream sensor 1 dynamic diagnosis, bank 1 / Dynamic reaction time of downstream sensor, Lean-Rich" UWORD t_q0p1 1 100 0.00 6553.500 FORMAT "%8.3" ECU_ADDRESS 0x60001730 /end MEASUREMENT
/begin MEASUREMENT EGSDCmn_S1B1VirtLamDynParl_I.tiUDynRtl "state machine of virtual lambda shifting for IUMPR simulation of upstream sensor 1 dynamic diagnosis, bank 1 / Dynamic reaction time of downstream sensor, Rich-Lean" UWORD t_q0p1 1 100 0.00 6553.500 FORMAT "%8.3" ECU_ADDRESS 0x60001732 /end MEASUREMENT
/begin MEASUREMENT EGSDCmn_S1B1VirtLamDynParl_I.u "state machine of virtual lambda shifting for IUMPR simulation of upstream sensor 1 dynamic diagnosis, bank 1 / Sensor voltage of downstream sensor" UWORD spg_q1p221Em3_V 1 100 0.00 4.998779 FORMAT "%8.6" ECU_ADDRESS 0x60001734 /end MEASUREMENT
/begin MEASUREMENT EGSDCmn_S1B1VirtLamDynParl_I.EnaReldEF_I.buffer "state machine of virtual lambda shifting for IUMPR simulation of upstream sensor 1 dynamic diagnosis, bank 1 / EdgeFalling: loss of enable condition / memory to detect falling edge" UBYTE B_TRUE 1 100 0.00 1.00000000000 BIT_MASK 0x1 FORMAT "%13.11" ECU_ADDRESS 0x60001736 /end MEASUREMENT
/begin MEASUREMENT EGSDCmn_S1B1VirtLamDynParl_I.EnaReldEF_I.oldSignal "state machine of virtual lambda shifting for IUMPR simulation of upstream sensor 1 dynamic diagnosis, bank 1 / EdgeFalling: loss of enable condition / memory to detect falling edge" UBYTE B_TRUE 1 100 0.00 1.00000000000 BIT_MASK 0x1 FORMAT "%13.11" ECU_ADDRESS 0x60001737 /end MEASUREMENT
/begin MEASUREMENT EGSDCmn_S1B1VirtLamDynParl_I.IdnAdpnCTR_I.counter "state machine of virtual lambda shifting for IUMPR simulation of upstream sensor 1 dynamic diagnosis, bank 1 / Counter for lambda jumps for online adaption purposes / current counter value" UWORD dez 1 100 0.00 65535.00 FORMAT "%8.2" ECU_ADDRESS 0x60001738 /end MEASUREMENT
/begin MEASUREMENT EGSDCmn_S1B1VirtLamDynParl_I.flgLeanLamStabTONV_I.outbit "state machine of virtual lambda shifting for IUMPR simulation of upstream sensor 1 dynamic diagnosis, bank 1 / Waiting time for lean lambda stability criterion / return value" UBYTE B_TRUE 1 100 0.00 1.00000000000 BIT_MASK 0x1 FORMAT "%13.11" ECU_ADDRESS 0x6000173A /end MEASUREMENT
/begin MEASUREMENT EGSDCmn_S1B1VirtLamDynParl_I.flgLeanLamStabTONV_I.time "state machine of virtual lambda shifting for IUMPR simulation of upstream sensor 1 dynamic diagnosis, bank 1 / Waiting time for lean lambda stability criterion / expired delay time" UWORD t_q0p1 1 100 0.00 6553.500 FORMAT "%8.3" ECU_ADDRESS 0x6000173C /end MEASUREMENT
/begin MEASUREMENT EGSDCmn_S1B1VirtLamDynParl_I.flgRichLamStabTONV_I.outbit "state machine of virtual lambda shifting for IUMPR simulation of upstream sensor 1 dynamic diagnosis, bank 1 / Waiting time for rich lambda stability criterion / return value" UBYTE B_TRUE 1 100 0.00 1.00000000000 BIT_MASK 0x1 FORMAT "%13.11" ECU_ADDRESS 0x6000173E /end MEASUREMENT
/begin MEASUREMENT EGSDCmn_S1B1VirtLamDynParl_I.flgRichLamStabTONV_I.time "state machine of virtual lambda shifting for IUMPR simulation of upstream sensor 1 dynamic diagnosis, bank 1 / Waiting time for rich lambda stability criterion / expired delay time" UWORD t_q0p1 1 100 0.00 6553.500 FORMAT "%8.3" ECU_ADDRESS 0x60001740 /end MEASUREMENT
/begin MEASUREMENT EGSDCmn_S1B1VirtLamDynParl_I.mO2EnaCatFullGrdtIK_I.memory "state machine of virtual lambda shifting for IUMPR simulation of upstream sensor 1 dynamic diagnosis, bank 1 / Integrator for oxygen gas mass flow for detection if catalyst is filled with oxygen / current integrator value" FLOAT32_IEEE m_q1_mg 1 100 -1.0000E+037 1.0000E+037 FORMAT "%10.4" ECU_ADDRESS 0x60001744 /end MEASUREMENT
/begin MEASUREMENT EGSDCmn_S1B1VirtLamDynParl_I.mO2IdnAdpnIKL_I.memory "state machine of virtual lambda shifting for IUMPR simulation of upstream sensor 1 dynamic diagnosis, bank 1 / Integrator for oxygen or rich gas mass flow for lambda jumps for online adaption purposes / Current Integrator value" FLOAT32_IEEE m_q1_mg 1 100 -1.0000E+037 1.0000E+037 FORMAT "%10.4" ECU_ADDRESS 0x60001748 /end MEASUREMENT
/begin MEASUREMENT EGSDCmn_S1B1VirtLamDynParl_I.mO2VirtEnaCatEmptyIK_I.memory "state machine of virtual lambda shifting for IUMPR simulation of upstream sensor 1 dynamic diagnosis, bank 1 / Integrator for rich gas mass flow for detection if catalyst is emtpied from oxygen / current integrator value" FLOAT32_IEEE m_q1_mg 1 100 -1.0000E+037 1.0000E+037 FORMAT "%10.4" ECU_ADDRESS 0x6000174C /end MEASUREMENT
/begin MEASUREMENT EGSDCmn_S1B1VirtLamDynParl_I.tiGasRtlTONV_I.outbit "state machine of virtual lambda shifting for IUMPR simulation of upstream sensor 1 dynamic diagnosis, bank 1 / Simulation of gas propagation till first Lambda sensor / return value" UBYTE B_TRUE 1 100 0.00 1.00000000000 BIT_MASK 0x1 FORMAT "%13.11" ECU_ADDRESS 0x60001750 /end MEASUREMENT
/begin MEASUREMENT EGSDCmn_S1B1VirtLamDynParl_I.tiGasRtlTONV_I.time "state machine of virtual lambda shifting for IUMPR simulation of upstream sensor 1 dynamic diagnosis, bank 1 / Simulation of gas propagation till first Lambda sensor / expired delay time" UWORD t_q0p1 1 100 0.00 6553.500 FORMAT "%8.3" ECU_ADDRESS 0x60001752 /end MEASUREMENT
/begin MEASUREMENT EGSDCmn_S1B1VirtLamDynParl_I.tiUDynTONV_I.outbit "state machine of virtual lambda shifting for IUMPR simulation of upstream sensor 1 dynamic diagnosis, bank 1 / simulation time for sensor dynamic of downstream sensor / return value" UBYTE B_TRUE 1 100 0.00 1.00000000000 BIT_MASK 0x1 FORMAT "%13.11" ECU_ADDRESS 0x60001754 /end MEASUREMENT
/begin MEASUREMENT EGSDCmn_S1B1VirtLamDynParl_I.tiUDynTONV_I.time "state machine of virtual lambda shifting for IUMPR simulation of upstream sensor 1 dynamic diagnosis, bank 1 / simulation time for sensor dynamic of downstream sensor / expired delay time" UWORD t_q0p1 1 100 0.00 6553.500 FORMAT "%8.3" ECU_ADDRESS 0x60001756 /end MEASUREMENT
/begin MEASUREMENT EGSDCmn_S2B1AsymcToSymc_I.flgLtrDly "Symmetrization of first downstream sensor signal, Bank1 / lean-rich delay dynamic pattern identified" UBYTE B_TRUE 1 100 0.00 1.00000000000 BIT_MASK 0x1 FORMAT "%13.11" ECU_ADDRESS 0x500012B4 /end MEASUREMENT
/begin MEASUREMENT EGSDCmn_S2B1AsymcToSymc_I.flgLtrTran "Symmetrization of first downstream sensor signal, Bank1 / lean-rich transition dynamic pattern identified" UBYTE B_TRUE 1 100 0.00 1.00000000000 BIT_MASK 0x1 FORMAT "%13.11" ECU_ADDRESS 0x500012B5 /end MEASUREMENT
/begin MEASUREMENT EGSDCmn_S2B1AsymcToSymc_I.flgRtlDly "Symmetrization of first downstream sensor signal, Bank1 / rich-lean delay dynamic pattern identified" UBYTE B_TRUE 1 100 0.00 1.00000000000 BIT_MASK 0x1 FORMAT "%13.11" ECU_ADDRESS 0x500012B6 /end MEASUREMENT
/begin MEASUREMENT EGSDCmn_S2B1AsymcToSymc_I.flgRtlTran "Symmetrization of first downstream sensor signal, Bank1 / rich-lean transition dynamic pattern identified" UBYTE B_TRUE 1 100 0.00 1.00000000000 BIT_MASK 0x1 FORMAT "%13.11" ECU_ADDRESS 0x500012B7 /end MEASUREMENT
/begin MEASUREMENT EGSDCmn_S2B1AsymcToSymc_I.flgSymcEna "Symmetrization of first downstream sensor signal, Bank1 / Status of enabling" UBYTE B_TRUE 1 100 0.00 1.00000000000 BIT_MASK 0x1 FORMAT "%13.11" ECU_ADDRESS 0x500012B8 /end MEASUREMENT
/begin MEASUREMENT EGSDCmn_S2B1AsymcToSymc_I.tiLtrDlySymc "Symmetrization of first downstream sensor signal, Bank1 / lean-rich delay time for symmetrization" UWORD t_q0p01 1 100 0.00 655.3500 FORMAT "%8.4" ECU_ADDRESS 0x500012BA /end MEASUREMENT
/begin MEASUREMENT EGSDCmn_S2B1AsymcToSymc_I.tiLtrTranSymc "Symmetrization of first downstream sensor signal, Bank1 / lean-rich transition time for symmetrization" UWORD t_q0p01 1 100 0.00 655.3500 FORMAT "%8.4" ECU_ADDRESS 0x500012BC /end MEASUREMENT
/begin MEASUREMENT EGSDCmn_S2B1AsymcToSymc_I.tiRtlDlySymc "Symmetrization of first downstream sensor signal, Bank1 / rich-lean delay time for symmetrization" UWORD t_q0p01 1 100 0.00 655.3500 FORMAT "%8.4" ECU_ADDRESS 0x500012BE /end MEASUREMENT
/begin MEASUREMENT EGSDCmn_S2B1AsymcToSymc_I.tiRtlTranSymc "Symmetrization of first downstream sensor signal, Bank1 / rich-lean transition time for symmetrization" UWORD t_q0p01 1 100 0.00 655.3500 FORMAT "%8.4" ECU_ADDRESS 0x500012C0 /end MEASUREMENT
/begin MEASUREMENT EGSDCmn_S2B1AsymcToSymc_I.uFildParlSymc "Symmetrization of first downstream sensor signal, Bank1 / Symmetrized sensor voltage of downstream sensor for parallelized diagnoses" UWORD spg_q1p221Em3_V 1 100 0.00 4.998779 FORMAT "%8.6" ECU_ADDRESS 0x500012C2 /end MEASUREMENT
/begin MEASUREMENT EGSDCmn_S2B1AsymcToSymc_I.uNoSymcOld "Symmetrization of first downstream sensor signal, Bank1 / old sensor voltage value before symmetrization" UWORD spg_q1p221Em3_V 1 100 0.00 4.998779 FORMAT "%8.6" ECU_ADDRESS 0x500012C4 /end MEASUREMENT
/begin MEASUREMENT EGSDCmn_S2B1AsymcToSymc_I.USymcActvFF_I.status "Symmetrization of first downstream sensor signal, Bank1 / FlipFlop : Symmetrization activated / current value of RS-FF" UBYTE B_TRUE 1 100 0.00 1.00000000000 BIT_MASK 0x1 FORMAT "%13.11" ECU_ADDRESS 0x500012C6 /end MEASUREMENT
/begin MEASUREMENT EGSDCmn_S2B1AsymcToSymc_I.USymcEnaER_I.buffer "Symmetrization of first downstream sensor signal, Bank1 / EdgeRise : initialization of symmetrization elements / rising edge detected" UBYTE B_TRUE 1 100 0.00 1.00000000000 BIT_MASK 0x1 FORMAT "%13.11" ECU_ADDRESS 0x500012C8 /end MEASUREMENT
/begin MEASUREMENT EGSDCmn_S2B1AsymcToSymc_I.USymcEnaER_I.oldSignal "Symmetrization of first downstream sensor signal, Bank1 / EdgeRise : initialization of symmetrization elements / flag rising edge" UBYTE B_TRUE 1 100 0.00 1.00000000000 BIT_MASK 0x1 FORMAT "%13.11" ECU_ADDRESS 0x500012C9 /end MEASUREMENT
/begin MEASUREMENT EGSDCmn_S2B1AsymcToSymc_I.uDlyDTTtopt_I.buffer "Symmetrization of first downstream sensor signal, Bank1 / delay of sensor voltage signal / buffer for delay library element" UWORD spg_q1p221Em3_V 1 100 0.00 4.998779 FORMAT "%8.6" ARRAY_SIZE 21 ECU_ADDRESS 0x500012CA /end MEASUREMENT
/begin MEASUREMENT EGSDCmn_S2B1AsymcToSymc_I.uDlyDTTtopt_I.counter "Symmetrization of first downstream sensor signal, Bank1 / delay of sensor voltage signal / counter for delay library element" UWORD fak_uw_b2 1 100 0.00 1.000000 FORMAT "%8.6" ECU_ADDRESS 0x500012F4 /end MEASUREMENT
/begin MEASUREMENT EGSDCmn_S2B1AsymcToSymc_I.uDlyDTTtopt_I.pointer "Symmetrization of first downstream sensor signal, Bank1 / delay of sensor voltage signal / pointer for delay library element" UBYTE dez 1 100 0.00 255.0 FORMAT "%5.1" ECU_ADDRESS 0x500012F6 /end MEASUREMENT
/begin MEASUREMENT EGSDCmn_S2B1AsymcToSymc_I.uTranLT_I.memory "Symmetrization of first downstream sensor signal, Bank1 / filtering of sensor voltage signal / current lowpass value" ULONG spg_q1p8626Em8_V 1 100 0.00 4.99999998137 FORMAT "%13.11" ECU_ADDRESS 0x500012F8 /end MEASUREMENT
/begin MEASUREMENT EGSDCmn_S2B1VirtTarLeanOffsParl_I.flgCatEmptyTOut "Virtual lambda shifting for IUMPR simulation of range check of lean target sensor voltage with Lambda Offset, bank 1 / Time out while checking if catalyst is empty from oxygen" UBYTE B_TRUE 1 100 0.00 1.00000000000 BIT_MASK 0x1 FORMAT "%13.11" ECU_ADDRESS 0x500012FC /end MEASUREMENT
/begin MEASUREMENT EGSDCmn_S2B1VirtTarLeanOffsParl_I.flgCatFullTOut "Virtual lambda shifting for IUMPR simulation of range check of lean target sensor voltage with Lambda Offset, bank 1 / Time out while checking if catalyst is filled with oxygen" UBYTE B_TRUE 1 100 0.00 1.00000000000 BIT_MASK 0x1 FORMAT "%13.11" ECU_ADDRESS 0x500012FD /end MEASUREMENT
/begin MEASUREMENT EGSDCmn_S2B1VirtTarLeanOffsParl_I.flgReld "Virtual lambda shifting for IUMPR simulation of range check of lean target sensor voltage with Lambda Offset, bank 1 / lambda shifting is released" UBYTE B_TRUE 1 100 0.00 1.00000000000 BIT_MASK 0x1 FORMAT "%13.11" ECU_ADDRESS 0x500012FE /end MEASUREMENT
/begin MEASUREMENT EGSDCmn_S2B1VirtTarLeanOffsParl_I.flgTarLeanRes "Virtual lambda shifting for IUMPR simulation of range check of lean target sensor voltage with Lambda Offset, bank 1 / check of lean sensor voltage, result is available" UBYTE B_TRUE 1 100 0.00 1.00000000000 BIT_MASK 0x1 FORMAT "%13.11" ECU_ADDRESS 0x500012FF /end MEASUREMENT
/begin MEASUREMENT EGSDCmn_S2B1VirtTarLeanOffsParl_I.flgTarRich "Virtual lambda shifting for IUMPR simulation of range check of lean target sensor voltage with Lambda Offset, bank 1 / Target Rich check is activated" UBYTE B_TRUE 1 100 0.00 1.00000000000 BIT_MASK 0x1 FORMAT "%13.11" ECU_ADDRESS 0x50001300 /end MEASUREMENT
/begin MEASUREMENT EGSDCmn_S2B1VirtTarLeanOffsParl_I.flgTarRichRes "Virtual lambda shifting for IUMPR simulation of range check of lean target sensor voltage with Lambda Offset, bank 1 / check of rich sensor voltage, result is available" UBYTE B_TRUE 1 100 0.00 1.00000000000 BIT_MASK 0x1 FORMAT "%13.11" ECU_ADDRESS 0x50001301 /end MEASUREMENT
/begin MEASUREMENT EGSDCmn_S2B1VirtTarLeanOffsParl_I.flgUHiEnaParl "Virtual lambda shifting for IUMPR simulation of range check of lean target sensor voltage with Lambda Offset, bank 1 / Sensor voltage downstream is high" UBYTE B_TRUE 1 100 0.00 1.00000000000 BIT_MASK 0x1 FORMAT "%13.11" ECU_ADDRESS 0x50001302 /end MEASUREMENT
/begin MEASUREMENT EGSDCmn_S2B1VirtTarLeanOffsParl_I.mOSC "Virtual lambda shifting for IUMPR simulation of range check of lean target sensor voltage with Lambda Offset, bank 1 / Assumed oxygen storage capacity for first catalyst" FLOAT32_IEEE m_q1_mg 1 100 0.00 50000.0000 FORMAT "%10.4" ECU_ADDRESS 0x50001304 /end MEASUREMENT
/begin MEASUREMENT EGSDCmn_S2B1VirtTarLeanOffsParl_I.mRSC "Virtual lambda shifting for IUMPR simulation of range check of lean target sensor voltage with Lambda Offset, bank 1 / Assumed rich gas storage capacity for first catalyst" FLOAT32_IEEE m_q1_mg 1 100 0.00 50000.0000 FORMAT "%10.4" ECU_ADDRESS 0x50001308 /end MEASUREMENT
/begin MEASUREMENT EGSDCmn_S2B1VirtTarLeanOffsParl_I.mRampDurParl "Virtual lambda shifting for IUMPR simulation of range check of lean target sensor voltage with Lambda Offset, bank 1 / Needed amount of exhaust mass during ramp-test" UWORD m_q0p001_kg 1 100 0.00 65.53500 FORMAT "%8.5" ECU_ADDRESS 0x5000130C /end MEASUREMENT
/begin MEASUREMENT EGSDCmn_S2B1VirtTarLeanOffsParl_I.mfEg "Virtual lambda shifting for IUMPR simulation of range check of lean target sensor voltage with Lambda Offset, bank 1 / Exhaust gas mass flow" UWORD m_q0p1 1 100 0.00 6553.500 FORMAT "%8.3" ECU_ADDRESS 0x5000130E /end MEASUREMENT
/begin MEASUREMENT EGSDCmn_S2B1VirtTarLeanOffsParl_I.mfVirtO2 "Virtual lambda shifting for IUMPR simulation of range check of lean target sensor voltage with Lambda Offset, bank 1 / Oxygen mass flow in catalyst 1, corrected by maximum possible mixture deviation in a fault free system" FLOAT32_IEEE mgrad_q1_mgdivs 1 100 0.00 50000.0000 FORMAT "%10.4" ECU_ADDRESS 0x50001310 /end MEASUREMENT
/begin MEASUREMENT EGSDCmn_S2B1VirtTarLeanOffsParl_I.mfVirtRich "Virtual lambda shifting for IUMPR simulation of range check of lean target sensor voltage with Lambda Offset, bank 1 / Rich Gas mass flow in catalyst 1, corrected by maximum possible mixture deviation in a fault free system" FLOAT32_IEEE mgrad_q1_mgdivs 1 100 0.00 50000.0000 FORMAT "%10.4" ECU_ADDRESS 0x50001314 /end MEASUREMENT
/begin MEASUREMENT EGSDCmn_S2B1VirtTarLeanOffsParl_I.ratLamRampLeanParl "Virtual lambda shifting for IUMPR simulation of range check of lean target sensor voltage with Lambda Offset, bank 1 / Lean Lambda request setpoint during ramping" UWORD fak_uw_b16 1 100 0.00 15.99976 FORMAT "%8.5" ECU_ADDRESS 0x50001318 /end MEASUREMENT
/begin MEASUREMENT EGSDCmn_S2B1VirtTarLeanOffsParl_I.ratLamRampRichParl "Virtual lambda shifting for IUMPR simulation of range check of lean target sensor voltage with Lambda Offset, bank 1 / Rich Lambda request setpoint during ramping" UWORD fak_uw_b16 1 100 0.00 15.99976 FORMAT "%8.5" ECU_ADDRESS 0x5000131A /end MEASUREMENT
/begin MEASUREMENT EGSDCmn_S2B1VirtTarLeanOffsParl_I.ratLamReq "Virtual lambda shifting for IUMPR simulation of range check of lean target sensor voltage with Lambda Offset, bank 1 / Requested Lambda value" UWORD fak_uw_b16 1 100 0.00 15.99976 FORMAT "%8.5" ECU_ADDRESS 0x5000131C /end MEASUREMENT
/begin MEASUREMENT EGSDCmn_S2B1VirtTarLeanOffsParl_I.sm "Virtual lambda shifting for IUMPR simulation of range check of lean target sensor voltage with Lambda Offset, bank 1 / State number" UBYTE EGSDCmn_VirtTarPlausParl_sm_VERB 1 100 0.00 5.00000000000 FORMAT "%13.11" ECU_ADDRESS 0x5000131E /end MEASUREMENT
/begin MEASUREMENT EGSDCmn_S2B1VirtTarLeanOffsParl_I.stLamGenr "Virtual lambda shifting for IUMPR simulation of range check of lean target sensor voltage with Lambda Offset, bank 1 / State number" UBYTE dez 1 100 0.00 255.0 FORMAT "%5.1" ECU_ADDRESS 0x5000131F /end MEASUREMENT
/begin MEASUREMENT EGSDCmn_S2B1VirtTarLeanOffsParl_I.tiGasRt "Virtual lambda shifting for IUMPR simulation of range check of lean target sensor voltage with Lambda Offset, bank 1 / gas propagation time till first Lambda sensor" UWORD t_q0p1 1 100 0.00 6553.500 FORMAT "%8.3" ECU_ADDRESS 0x50001320 /end MEASUREMENT
/begin MEASUREMENT EGSDCmn_S2B1VirtTarLeanOffsParl_I.tiLamDynLtr "Virtual lambda shifting for IUMPR simulation of range check of lean target sensor voltage with Lambda Offset, bank 1 / Dynamic time lambda signal of upstream sensor 1 Lean-Rich" UWORD t_q0p1 1 100 0.00 6553.500 FORMAT "%8.3" ECU_ADDRESS 0x50001322 /end MEASUREMENT
/begin MEASUREMENT EGSDCmn_S2B1VirtTarLeanOffsParl_I.tiLamDynRtl "Virtual lambda shifting for IUMPR simulation of range check of lean target sensor voltage with Lambda Offset, bank 1 / Dynamic time lambda signal of upstream sensor 1 Rich-Lean" UWORD t_q0p1 1 100 0.00 6553.500 FORMAT "%8.3" ECU_ADDRESS 0x50001324 /end MEASUREMENT
/begin MEASUREMENT EGSDCmn_S2B1VirtTarLeanOffsParl_I.tiUDynLtr "Virtual lambda shifting for IUMPR simulation of range check of lean target sensor voltage with Lambda Offset, bank 1 / Dynamic reaction time of downstream sensor, Lean-Rich" UWORD t_q0p1 1 100 0.00 6553.500 FORMAT "%8.3" ECU_ADDRESS 0x50001326 /end MEASUREMENT
/begin MEASUREMENT EGSDCmn_S2B1VirtTarLeanOffsParl_I.tiUDynRtl "Virtual lambda shifting for IUMPR simulation of range check of lean target sensor voltage with Lambda Offset, bank 1 / Dynamic reaction time of downstream sensor, Rich-Lean" UWORD t_q0p1 1 100 0.00 6553.500 FORMAT "%8.3" ECU_ADDRESS 0x50001328 /end MEASUREMENT
/begin MEASUREMENT EGSDCmn_S2B1VirtTarLeanOffsParl_I.EnaReldEF_I.buffer "Virtual lambda shifting for IUMPR simulation of range check of lean target sensor voltage with Lambda Offset, bank 1 / EdgeFalling: loss of enable condition / memory to detect falling edge" UBYTE B_TRUE 1 100 0.00 1.00000000000 BIT_MASK 0x1 FORMAT "%13.11" ECU_ADDRESS 0x5000132A /end MEASUREMENT
/begin MEASUREMENT EGSDCmn_S2B1VirtTarLeanOffsParl_I.EnaReldEF_I.oldSignal "Virtual lambda shifting for IUMPR simulation of range check of lean target sensor voltage with Lambda Offset, bank 1 / EdgeFalling: loss of enable condition / memory to detect falling edge" UBYTE B_TRUE 1 100 0.00 1.00000000000 BIT_MASK 0x1 FORMAT "%13.11" ECU_ADDRESS 0x5000132B /end MEASUREMENT
/begin MEASUREMENT EGSDCmn_S2B1VirtTarLeanOffsParl_I.LamRampIKL_I.memory "Virtual lambda shifting for IUMPR simulation of range check of lean target sensor voltage with Lambda Offset, bank 1 / Integrator to create a ramp shaped lambda request / Current Integrator value" ULONG fak_q3p72529Em9 1 100 0.00 15.9999999963 FORMAT "%13.10" ECU_ADDRESS 0x5000132C /end MEASUREMENT
/begin MEASUREMENT EGSDCmn_S2B1VirtTarLeanOffsParl_I.RampEndLimIK_I.memory "Virtual lambda shifting for IUMPR simulation of range check of lean target sensor voltage with Lambda Offset, bank 1 / Integrator for calculation of amount of exhaust mass during ramp-test / current integrator value" ULONG m_q1p5259Em8_kg 1 100 0.00 65.5359999847 FORMAT "%13.10" ECU_ADDRESS 0x50001330 /end MEASUREMENT
/begin MEASUREMENT EGSDCmn_S2B1VirtTarLeanOffsParl_I.mO2EnaCatFullGrdtIK_I.memory "Virtual lambda shifting for IUMPR simulation of range check of lean target sensor voltage with Lambda Offset, bank 1 / Integrator for oxygen gas mass flow for detection if catalyst is filled with oxygen / current integrator value" FLOAT32_IEEE m_q1_mg 1 100 -1.0000E+037 1.0000E+037 FORMAT "%10.4" ECU_ADDRESS 0x50001334 /end MEASUREMENT
/begin MEASUREMENT EGSDCmn_S2B1VirtTarLeanOffsParl_I.mO2VirtEnaCatEmptyIK_I.memory "Virtual lambda shifting for IUMPR simulation of range check of lean target sensor voltage with Lambda Offset, bank 1 / Integrator for rich gas mass flow for detection if catalyst is emtpied from oxygen / current integrator value" FLOAT32_IEEE m_q1_mg 1 100 -1.0000E+037 1.0000E+037 FORMAT "%10.4" ECU_ADDRESS 0x50001338 /end MEASUREMENT
/begin MEASUREMENT EGSDCmn_S2B1VirtTarLeanOffsParl_I.tiDynWpaRampTONVNM_I.outbit "Virtual lambda shifting for IUMPR simulation of range check of lean target sensor voltage with Lambda Offset, bank 1 / Simulation of a sensor dynamics which corresponds to worst performing acceptable / return value" UBYTE B_TRUE 1 100 0.00 1.00000000000 BIT_MASK 0x1 FORMAT "%13.11" ECU_ADDRESS 0x5000133C /end MEASUREMENT
/begin MEASUREMENT EGSDCmn_S2B1VirtTarLeanOffsParl_I.tiDynWpaRampTONVNM_I.time "Virtual lambda shifting for IUMPR simulation of range check of lean target sensor voltage with Lambda Offset, bank 1 / Simulation of a sensor dynamics which corresponds to worst performing acceptable / expired delay time" UWORD t_q0p1 1 100 0.00 6553.500 FORMAT "%8.3" ECU_ADDRESS 0x5000133E /end MEASUREMENT
/begin MEASUREMENT EGSDCmn_S2B1VirtTarLeanOffsParl_I.tiLamDynTONV_I.outbit "Virtual lambda shifting for IUMPR simulation of range check of lean target sensor voltage with Lambda Offset, bank 1 / simulation time for sensor dynamic of upstream sensor 1 / return value" UBYTE B_TRUE 1 100 0.00 1.00000000000 BIT_MASK 0x1 FORMAT "%13.11" ECU_ADDRESS 0x50001340 /end MEASUREMENT
/begin MEASUREMENT EGSDCmn_S2B1VirtTarLeanOffsParl_I.tiLamDynTONV_I.time "Virtual lambda shifting for IUMPR simulation of range check of lean target sensor voltage with Lambda Offset, bank 1 / simulation time for sensor dynamic of upstream sensor 1 / expired delay time" UWORD t_q0p1 1 100 0.00 6553.500 FORMAT "%8.3" ECU_ADDRESS 0x50001342 /end MEASUREMENT
/begin MEASUREMENT EGSDCmn_S2B1VirtTarLeanOffsParl_I.tiUDynTONV_I.outbit "Virtual lambda shifting for IUMPR simulation of range check of lean target sensor voltage with Lambda Offset, bank 1 / simulation time for sensor dynamic of downstream sensor / return value" UBYTE B_TRUE 1 100 0.00 1.00000000000 BIT_MASK 0x1 FORMAT "%13.11" ECU_ADDRESS 0x50001344 /end MEASUREMENT
/begin MEASUREMENT EGSDCmn_S2B1VirtTarLeanOffsParl_I.tiUDynTONV_I.time "Virtual lambda shifting for IUMPR simulation of range check of lean target sensor voltage with Lambda Offset, bank 1 / simulation time for sensor dynamic of downstream sensor / expired delay time" UWORD t_q0p1 1 100 0.00 6553.500 FORMAT "%8.3" ECU_ADDRESS 0x50001346 /end MEASUREMENT
/begin MEASUREMENT EGSDCmn_S2B1VirtTarLeanParl_I.flgCatEmptyTOut "Virtual lambda shifting for IUMPR simulation of range check of lean target sensor voltage / Time out while checking if catalyst is empty from oxygen" UBYTE B_TRUE 1 100 0.00 1.00000000000 BIT_MASK 0x1 FORMAT "%13.11" ECU_ADDRESS 0x600016C0 /end MEASUREMENT
/begin MEASUREMENT EGSDCmn_S2B1VirtTarLeanParl_I.flgCatFullTOut "Virtual lambda shifting for IUMPR simulation of range check of lean target sensor voltage / Time out while checking if catalyst is filled with oxygen" UBYTE B_TRUE 1 100 0.00 1.00000000000 BIT_MASK 0x1 FORMAT "%13.11" ECU_ADDRESS 0x600016C1 /end MEASUREMENT
/begin MEASUREMENT EGSDCmn_S2B1VirtTarLeanParl_I.flgReld "Virtual lambda shifting for IUMPR simulation of range check of lean target sensor voltage / lambda shifting is released" UBYTE B_TRUE 1 100 0.00 1.00000000000 BIT_MASK 0x1 FORMAT "%13.11" ECU_ADDRESS 0x600016C2 /end MEASUREMENT
/begin MEASUREMENT EGSDCmn_S2B1VirtTarLeanParl_I.flgTarLeanRes "Virtual lambda shifting for IUMPR simulation of range check of lean target sensor voltage / check of lean sensor voltage, result is available" UBYTE B_TRUE 1 100 0.00 1.00000000000 BIT_MASK 0x1 FORMAT "%13.11" ECU_ADDRESS 0x600016C3 /end MEASUREMENT
/begin MEASUREMENT EGSDCmn_S2B1VirtTarLeanParl_I.flgTarRich "Virtual lambda shifting for IUMPR simulation of range check of lean target sensor voltage / Target Rich check is activated" UBYTE B_TRUE 1 100 0.00 1.00000000000 BIT_MASK 0x1 FORMAT "%13.11" ECU_ADDRESS 0x600016C4 /end MEASUREMENT
/begin MEASUREMENT EGSDCmn_S2B1VirtTarLeanParl_I.flgTarRichRes "Virtual lambda shifting for IUMPR simulation of range check of lean target sensor voltage / check of rich sensor voltage, result is available" UBYTE B_TRUE 1 100 0.00 1.00000000000 BIT_MASK 0x1 FORMAT "%13.11" ECU_ADDRESS 0x600016C5 /end MEASUREMENT
/begin MEASUREMENT EGSDCmn_S2B1VirtTarLeanParl_I.flgUHiEnaParl "Virtual lambda shifting for IUMPR simulation of range check of lean target sensor voltage / Sensor voltage downstream is high" UBYTE B_TRUE 1 100 0.00 1.00000000000 BIT_MASK 0x1 FORMAT "%13.11" ECU_ADDRESS 0x600016C6 /end MEASUREMENT
/begin MEASUREMENT EGSDCmn_S2B1VirtTarLeanParl_I.mOSC "Virtual lambda shifting for IUMPR simulation of range check of lean target sensor voltage / Assumed oxygen storage capacity for first catalyst" FLOAT32_IEEE m_q1_mg 1 100 0.00 50000.0000 FORMAT "%10.4" ECU_ADDRESS 0x600016C8 /end MEASUREMENT
/begin MEASUREMENT EGSDCmn_S2B1VirtTarLeanParl_I.mRSC "Virtual lambda shifting for IUMPR simulation of range check of lean target sensor voltage / Assumed rich gas storage capacity for first catalyst" FLOAT32_IEEE m_q1_mg 1 100 0.00 50000.0000 FORMAT "%10.4" ECU_ADDRESS 0x600016CC /end MEASUREMENT
/begin MEASUREMENT EGSDCmn_S2B1VirtTarLeanParl_I.mRampDurParl "Virtual lambda shifting for IUMPR simulation of range check of lean target sensor voltage / Needed amount of exhaust mass during ramp-test" UWORD m_q0p001_kg 1 100 0.00 65.53500 FORMAT "%8.5" ECU_ADDRESS 0x600016D0 /end MEASUREMENT
/begin MEASUREMENT EGSDCmn_S2B1VirtTarLeanParl_I.mfEg "Virtual lambda shifting for IUMPR simulation of range check of lean target sensor voltage / Exhaust gas mass flow" UWORD m_q0p1 1 100 0.00 6553.500 FORMAT "%8.3" ECU_ADDRESS 0x600016D2 /end MEASUREMENT
/begin MEASUREMENT EGSDCmn_S2B1VirtTarLeanParl_I.mfVirtO2 "Virtual lambda shifting for IUMPR simulation of range check of lean target sensor voltage / Oxygen mass flow in catalyst 1, corrected by maximum possible mixture deviation in a fault free system" FLOAT32_IEEE mgrad_q1_mgdivs 1 100 0.00 50000.0000 FORMAT "%10.4" ECU_ADDRESS 0x600016D4 /end MEASUREMENT
/begin MEASUREMENT EGSDCmn_S2B1VirtTarLeanParl_I.mfVirtRich "Virtual lambda shifting for IUMPR simulation of range check of lean target sensor voltage / Rich Gas mass flow in catalyst 1, corrected by maximum possible mixture deviation in a fault free system" FLOAT32_IEEE mgrad_q1_mgdivs 1 100 0.00 50000.0000 FORMAT "%10.4" ECU_ADDRESS 0x600016D8 /end MEASUREMENT
/begin MEASUREMENT EGSDCmn_S2B1VirtTarLeanParl_I.ratLamRampLeanParl "Virtual lambda shifting for IUMPR simulation of range check of lean target sensor voltage / Lean Lambda request setpoint during ramping" UWORD fak_uw_b16 1 100 0.00 15.99976 FORMAT "%8.5" ECU_ADDRESS 0x600016DC /end MEASUREMENT
/begin MEASUREMENT EGSDCmn_S2B1VirtTarLeanParl_I.ratLamRampRichParl "Virtual lambda shifting for IUMPR simulation of range check of lean target sensor voltage / Rich Lambda request setpoint during ramping" UWORD fak_uw_b16 1 100 0.00 15.99976 FORMAT "%8.5" ECU_ADDRESS 0x600016DE /end MEASUREMENT
/begin MEASUREMENT EGSDCmn_S2B1VirtTarLeanParl_I.ratLamReq "Virtual lambda shifting for IUMPR simulation of range check of lean target sensor voltage / Requested Lambda value" UWORD fak_uw_b16 1 100 0.00 15.99976 FORMAT "%8.5" ECU_ADDRESS 0x600016E0 /end MEASUREMENT
/begin MEASUREMENT EGSDCmn_S2B1VirtTarLeanParl_I.sm "Virtual lambda shifting for IUMPR simulation of range check of lean target sensor voltage / State number" UBYTE EGSDCmn_VirtTarPlausParl_sm_VERB 1 100 0.00 5.00000000000 FORMAT "%13.11" ECU_ADDRESS 0x600016E2 /end MEASUREMENT
/begin MEASUREMENT EGSDCmn_S2B1VirtTarLeanParl_I.stLamGenr "Virtual lambda shifting for IUMPR simulation of range check of lean target sensor voltage / State number" UBYTE dez 1 100 0.00 255.0 FORMAT "%5.1" ECU_ADDRESS 0x600016E3 /end MEASUREMENT
/begin MEASUREMENT EGSDCmn_S2B1VirtTarLeanParl_I.tiGasRt "Virtual lambda shifting for IUMPR simulation of range check of lean target sensor voltage / gas propagation time till first Lambda sensor" UWORD t_q0p1 1 100 0.00 6553.500 FORMAT "%8.3" ECU_ADDRESS 0x600016E4 /end MEASUREMENT
/begin MEASUREMENT EGSDCmn_S2B1VirtTarLeanParl_I.tiLamDynLtr "Virtual lambda shifting for IUMPR simulation of range check of lean target sensor voltage / Dynamic time lambda signal of upstream sensor 1 Lean-Rich" UWORD t_q0p1 1 100 0.00 6553.500 FORMAT "%8.3" ECU_ADDRESS 0x600016E6 /end MEASUREMENT
/begin MEASUREMENT EGSDCmn_S2B1VirtTarLeanParl_I.tiLamDynRtl "Virtual lambda shifting for IUMPR simulation of range check of lean target sensor voltage / Dynamic time lambda signal of upstream sensor 1 Rich-Lean" UWORD t_q0p1 1 100 0.00 6553.500 FORMAT "%8.3" ECU_ADDRESS 0x600016E8 /end MEASUREMENT
/begin MEASUREMENT EGSDCmn_S2B1VirtTarLeanParl_I.tiUDynLtr "Virtual lambda shifting for IUMPR simulation of range check of lean target sensor voltage / Dynamic reaction time of downstream sensor, Lean-Rich" UWORD t_q0p1 1 100 0.00 6553.500 FORMAT "%8.3" ECU_ADDRESS 0x600016EA /end MEASUREMENT
/begin MEASUREMENT EGSDCmn_S2B1VirtTarLeanParl_I.tiUDynRtl "Virtual lambda shifting for IUMPR simulation of range check of lean target sensor voltage / Dynamic reaction time of downstream sensor, Rich-Lean" UWORD t_q0p1 1 100 0.00 6553.500 FORMAT "%8.3" ECU_ADDRESS 0x600016EC /end MEASUREMENT
/begin MEASUREMENT EGSDCmn_S2B1VirtTarLeanParl_I.EnaReldEF_I.buffer "Virtual lambda shifting for IUMPR simulation of range check of lean target sensor voltage / EdgeFalling: loss of enable condition / memory to detect falling edge" UBYTE B_TRUE 1 100 0.00 1.00000000000 BIT_MASK 0x1 FORMAT "%13.11" ECU_ADDRESS 0x600016EE /end MEASUREMENT
/begin MEASUREMENT EGSDCmn_S2B1VirtTarLeanParl_I.EnaReldEF_I.oldSignal "Virtual lambda shifting for IUMPR simulation of range check of lean target sensor voltage / EdgeFalling: loss of enable condition / memory to detect falling edge" UBYTE B_TRUE 1 100 0.00 1.00000000000 BIT_MASK 0x1 FORMAT "%13.11" ECU_ADDRESS 0x600016EF /end MEASUREMENT
/begin MEASUREMENT EGSDCmn_S2B1VirtTarLeanParl_I.LamRampIKL_I.memory "Virtual lambda shifting for IUMPR simulation of range check of lean target sensor voltage / Integrator to create a ramp shaped lambda request / Current Integrator value" ULONG fak_q3p72529Em9 1 100 0.00 15.9999999963 FORMAT "%13.10" ECU_ADDRESS 0x600016F0 /end MEASUREMENT
/begin MEASUREMENT EGSDCmn_S2B1VirtTarLeanParl_I.RampEndLimIK_I.memory "Virtual lambda shifting for IUMPR simulation of range check of lean target sensor voltage / Integrator for calculation of amount of exhaust mass during ramp-test / current integrator value" ULONG m_q1p5259Em8_kg 1 100 0.00 65.5359999847 FORMAT "%13.10" ECU_ADDRESS 0x600016F4 /end MEASUREMENT
/begin MEASUREMENT EGSDCmn_S2B1VirtTarLeanParl_I.mO2EnaCatFullGrdtIK_I.memory "Virtual lambda shifting for IUMPR simulation of range check of lean target sensor voltage / Integrator for oxygen gas mass flow for detection if catalyst is filled with oxygen / current integrator value" FLOAT32_IEEE m_q1_mg 1 100 -1.0000E+037 1.0000E+037 FORMAT "%10.4" ECU_ADDRESS 0x600016F8 /end MEASUREMENT
/begin MEASUREMENT EGSDCmn_S2B1VirtTarLeanParl_I.mO2VirtEnaCatEmptyIK_I.memory "Virtual lambda shifting for IUMPR simulation of range check of lean target sensor voltage / Integrator for rich gas mass flow for detection if catalyst is emtpied from oxygen / current integrator value" FLOAT32_IEEE m_q1_mg 1 100 -1.0000E+037 1.0000E+037 FORMAT "%10.4" ECU_ADDRESS 0x600016FC /end MEASUREMENT
/begin MEASUREMENT EGSDCmn_S2B1VirtTarLeanParl_I.tiDynWpaRampTONVNM_I.outbit "Virtual lambda shifting for IUMPR simulation of range check of lean target sensor voltage / Simulation of a sensor dynamics which corresponds to worst performing acceptable / return value" UBYTE B_TRUE 1 100 0.00 1.00000000000 BIT_MASK 0x1 FORMAT "%13.11" ECU_ADDRESS 0x60001700 /end MEASUREMENT
/begin MEASUREMENT EGSDCmn_S2B1VirtTarLeanParl_I.tiDynWpaRampTONVNM_I.time "Virtual lambda shifting for IUMPR simulation of range check of lean target sensor voltage / Simulation of a sensor dynamics which corresponds to worst performing acceptable / expired delay time" UWORD t_q0p1 1 100 0.00 6553.500 FORMAT "%8.3" ECU_ADDRESS 0x60001702 /end MEASUREMENT
/begin MEASUREMENT EGSDCmn_S2B1VirtTarLeanParl_I.tiLamDynTONV_I.outbit "Virtual lambda shifting for IUMPR simulation of range check of lean target sensor voltage / simulation time for sensor dynamic of upstream sensor 1 / return value" UBYTE B_TRUE 1 100 0.00 1.00000000000 BIT_MASK 0x1 FORMAT "%13.11" ECU_ADDRESS 0x60001704 /end MEASUREMENT
/begin MEASUREMENT EGSDCmn_S2B1VirtTarLeanParl_I.tiLamDynTONV_I.time "Virtual lambda shifting for IUMPR simulation of range check of lean target sensor voltage / simulation time for sensor dynamic of upstream sensor 1 / expired delay time" UWORD t_q0p1 1 100 0.00 6553.500 FORMAT "%8.3" ECU_ADDRESS 0x60001706 /end MEASUREMENT
/begin MEASUREMENT EGSDCmn_S2B1VirtTarLeanParl_I.tiUDynTONV_I.outbit "Virtual lambda shifting for IUMPR simulation of range check of lean target sensor voltage / simulation time for sensor dynamic of downstream sensor / return value" UBYTE B_TRUE 1 100 0.00 1.00000000000 BIT_MASK 0x1 FORMAT "%13.11" ECU_ADDRESS 0x60001708 /end MEASUREMENT
/begin MEASUREMENT EGSDCmn_S2B1VirtTarLeanParl_I.tiUDynTONV_I.time "Virtual lambda shifting for IUMPR simulation of range check of lean target sensor voltage / simulation time for sensor dynamic of downstream sensor / expired delay time" UWORD t_q0p1 1 100 0.00 6553.500 FORMAT "%8.3" ECU_ADDRESS 0x6000170A /end MEASUREMENT
/begin MEASUREMENT EGSDCmn_S2B1VirtTarRichOffsParl_I.flgCatEmptyTOut "Virtual lambda shifting for IUMPR simulation of range check of rich target sensor voltage with Lambda Offset, bank 1 / Time out while checking if catalyst is empty from oxygen" UBYTE B_TRUE 1 100 0.00 1.00000000000 BIT_MASK 0x1 FORMAT "%13.11" ECU_ADDRESS 0x50001348 /end MEASUREMENT
/begin MEASUREMENT EGSDCmn_S2B1VirtTarRichOffsParl_I.flgCatFullTOut "Virtual lambda shifting for IUMPR simulation of range check of rich target sensor voltage with Lambda Offset, bank 1 / Time out while checking if catalyst is filled with oxygen" UBYTE B_TRUE 1 100 0.00 1.00000000000 BIT_MASK 0x1 FORMAT "%13.11" ECU_ADDRESS 0x50001349 /end MEASUREMENT
/begin MEASUREMENT EGSDCmn_S2B1VirtTarRichOffsParl_I.flgReld "Virtual lambda shifting for IUMPR simulation of range check of rich target sensor voltage with Lambda Offset, bank 1 / lambda shifting is released" UBYTE B_TRUE 1 100 0.00 1.00000000000 BIT_MASK 0x1 FORMAT "%13.11" ECU_ADDRESS 0x5000134A /end MEASUREMENT
/begin MEASUREMENT EGSDCmn_S2B1VirtTarRichOffsParl_I.flgTarLeanRes "Virtual lambda shifting for IUMPR simulation of range check of rich target sensor voltage with Lambda Offset, bank 1 / check of lean sensor voltage, result is available" UBYTE B_TRUE 1 100 0.00 1.00000000000 BIT_MASK 0x1 FORMAT "%13.11" ECU_ADDRESS 0x5000134B /end MEASUREMENT
/begin MEASUREMENT EGSDCmn_S2B1VirtTarRichOffsParl_I.flgTarRich "Virtual lambda shifting for IUMPR simulation of range check of rich target sensor voltage with Lambda Offset, bank 1 / Target Rich check is activated" UBYTE B_TRUE 1 100 0.00 1.00000000000 BIT_MASK 0x1 FORMAT "%13.11" ECU_ADDRESS 0x5000134C /end MEASUREMENT
/begin MEASUREMENT EGSDCmn_S2B1VirtTarRichOffsParl_I.flgTarRichRes "Virtual lambda shifting for IUMPR simulation of range check of rich target sensor voltage with Lambda Offset, bank 1 / check of rich sensor voltage, result is available" UBYTE B_TRUE 1 100 0.00 1.00000000000 BIT_MASK 0x1 FORMAT "%13.11" ECU_ADDRESS 0x5000134D /end MEASUREMENT
/begin MEASUREMENT EGSDCmn_S2B1VirtTarRichOffsParl_I.flgUHiEnaParl "Virtual lambda shifting for IUMPR simulation of range check of rich target sensor voltage with Lambda Offset, bank 1 / Sensor voltage downstream is high" UBYTE B_TRUE 1 100 0.00 1.00000000000 BIT_MASK 0x1 FORMAT "%13.11" ECU_ADDRESS 0x5000134E /end MEASUREMENT
/begin MEASUREMENT EGSDCmn_S2B1VirtTarRichOffsParl_I.mOSC "Virtual lambda shifting for IUMPR simulation of range check of rich target sensor voltage with Lambda Offset, bank 1 / Assumed oxygen storage capacity for first catalyst" FLOAT32_IEEE m_q1_mg 1 100 0.00 50000.0000 FORMAT "%10.4" ECU_ADDRESS 0x50001350 /end MEASUREMENT
/begin MEASUREMENT EGSDCmn_S2B1VirtTarRichOffsParl_I.mRSC "Virtual lambda shifting for IUMPR simulation of range check of rich target sensor voltage with Lambda Offset, bank 1 / Assumed rich gas storage capacity for first catalyst" FLOAT32_IEEE m_q1_mg 1 100 0.00 50000.0000 FORMAT "%10.4" ECU_ADDRESS 0x50001354 /end MEASUREMENT
/begin MEASUREMENT EGSDCmn_S2B1VirtTarRichOffsParl_I.mRampDurParl "Virtual lambda shifting for IUMPR simulation of range check of rich target sensor voltage with Lambda Offset, bank 1 / Needed amount of exhaust mass during ramp-test" UWORD m_q0p001_kg 1 100 0.00 65.53500 FORMAT "%8.5" ECU_ADDRESS 0x50001358 /end MEASUREMENT
/begin MEASUREMENT EGSDCmn_S2B1VirtTarRichOffsParl_I.mfEg "Virtual lambda shifting for IUMPR simulation of range check of rich target sensor voltage with Lambda Offset, bank 1 / Exhaust gas mass flow" UWORD m_q0p1 1 100 0.00 6553.500 FORMAT "%8.3" ECU_ADDRESS 0x5000135A /end MEASUREMENT
/begin MEASUREMENT EGSDCmn_S2B1VirtTarRichOffsParl_I.mfVirtO2 "Virtual lambda shifting for IUMPR simulation of range check of rich target sensor voltage with Lambda Offset, bank 1 / Oxygen mass flow in catalyst 1, corrected by maximum possible mixture deviation in a fault free system" FLOAT32_IEEE mgrad_q1_mgdivs 1 100 0.00 50000.0000 FORMAT "%10.4" ECU_ADDRESS 0x5000135C /end MEASUREMENT
/begin MEASUREMENT EGSDCmn_S2B1VirtTarRichOffsParl_I.mfVirtRich "Virtual lambda shifting for IUMPR simulation of range check of rich target sensor voltage with Lambda Offset, bank 1 / Rich Gas mass flow in catalyst 1, corrected by maximum possible mixture deviation in a fault free system" FLOAT32_IEEE mgrad_q1_mgdivs 1 100 0.00 50000.0000 FORMAT "%10.4" ECU_ADDRESS 0x50001360 /end MEASUREMENT
/begin MEASUREMENT EGSDCmn_S2B1VirtTarRichOffsParl_I.ratLamRampLeanParl "Virtual lambda shifting for IUMPR simulation of range check of rich target sensor voltage with Lambda Offset, bank 1 / Lean Lambda request setpoint during ramping" UWORD fak_uw_b16 1 100 0.00 15.99976 FORMAT "%8.5" ECU_ADDRESS 0x50001364 /end MEASUREMENT
/begin MEASUREMENT EGSDCmn_S2B1VirtTarRichOffsParl_I.ratLamRampRichParl "Virtual lambda shifting for IUMPR simulation of range check of rich target sensor voltage with Lambda Offset, bank 1 / Rich Lambda request setpoint during ramping" UWORD fak_uw_b16 1 100 0.00 15.99976 FORMAT "%8.5" ECU_ADDRESS 0x50001366 /end MEASUREMENT
/begin MEASUREMENT EGSDCmn_S2B1VirtTarRichOffsParl_I.ratLamReq "Virtual lambda shifting for IUMPR simulation of range check of rich target sensor voltage with Lambda Offset, bank 1 / Requested Lambda value" UWORD fak_uw_b16 1 100 0.00 15.99976 FORMAT "%8.5" ECU_ADDRESS 0x50001368 /end MEASUREMENT
/begin MEASUREMENT EGSDCmn_S2B1VirtTarRichOffsParl_I.sm "Virtual lambda shifting for IUMPR simulation of range check of rich target sensor voltage with Lambda Offset, bank 1 / State number" UBYTE EGSDCmn_VirtTarPlausParl_sm_VERB 1 100 0.00 5.00000000000 FORMAT "%13.11" ECU_ADDRESS 0x5000136A /end MEASUREMENT
/begin MEASUREMENT EGSDCmn_S2B1VirtTarRichOffsParl_I.stLamGenr "Virtual lambda shifting for IUMPR simulation of range check of rich target sensor voltage with Lambda Offset, bank 1 / State number" UBYTE dez 1 100 0.00 255.0 FORMAT "%5.1" ECU_ADDRESS 0x5000136B /end MEASUREMENT
/begin MEASUREMENT EGSDCmn_S2B1VirtTarRichOffsParl_I.tiGasRt "Virtual lambda shifting for IUMPR simulation of range check of rich target sensor voltage with Lambda Offset, bank 1 / gas propagation time till first Lambda sensor" UWORD t_q0p1 1 100 0.00 6553.500 FORMAT "%8.3" ECU_ADDRESS 0x5000136C /end MEASUREMENT
/begin MEASUREMENT EGSDCmn_S2B1VirtTarRichOffsParl_I.tiLamDynLtr "Virtual lambda shifting for IUMPR simulation of range check of rich target sensor voltage with Lambda Offset, bank 1 / Dynamic time lambda signal of upstream sensor 1 Lean-Rich" UWORD t_q0p1 1 100 0.00 6553.500 FORMAT "%8.3" ECU_ADDRESS 0x5000136E /end MEASUREMENT
/begin MEASUREMENT EGSDCmn_S2B1VirtTarRichOffsParl_I.tiLamDynRtl "Virtual lambda shifting for IUMPR simulation of range check of rich target sensor voltage with Lambda Offset, bank 1 / Dynamic time lambda signal of upstream sensor 1 Rich-Lean" UWORD t_q0p1 1 100 0.00 6553.500 FORMAT "%8.3" ECU_ADDRESS 0x50001370 /end MEASUREMENT
/begin MEASUREMENT EGSDCmn_S2B1VirtTarRichOffsParl_I.tiUDynLtr "Virtual lambda shifting for IUMPR simulation of range check of rich target sensor voltage with Lambda Offset, bank 1 / Dynamic reaction time of downstream sensor, Lean-Rich" UWORD t_q0p1 1 100 0.00 6553.500 FORMAT "%8.3" ECU_ADDRESS 0x50001372 /end MEASUREMENT
/begin MEASUREMENT EGSDCmn_S2B1VirtTarRichOffsParl_I.tiUDynRtl "Virtual lambda shifting for IUMPR simulation of range check of rich target sensor voltage with Lambda Offset, bank 1 / Dynamic reaction time of downstream sensor, Rich-Lean" UWORD t_q0p1 1 100 0.00 6553.500 FORMAT "%8.3" ECU_ADDRESS 0x50001374 /end MEASUREMENT
/begin MEASUREMENT EGSDCmn_S2B1VirtTarRichOffsParl_I.EnaReldEF_I.buffer "Virtual lambda shifting for IUMPR simulation of range check of rich target sensor voltage with Lambda Offset, bank 1 / EdgeFalling: loss of enable condition / memory to detect falling edge" UBYTE B_TRUE 1 100 0.00 1.00000000000 BIT_MASK 0x1 FORMAT "%13.11" ECU_ADDRESS 0x50001376 /end MEASUREMENT
/begin MEASUREMENT EGSDCmn_S2B1VirtTarRichOffsParl_I.EnaReldEF_I.oldSignal "Virtual lambda shifting for IUMPR simulation of range check of rich target sensor voltage with Lambda Offset, bank 1 / EdgeFalling: loss of enable condition / memory to detect falling edge" UBYTE B_TRUE 1 100 0.00 1.00000000000 BIT_MASK 0x1 FORMAT "%13.11" ECU_ADDRESS 0x50001377 /end MEASUREMENT
/begin MEASUREMENT EGSDCmn_S2B1VirtTarRichOffsParl_I.LamRampIKL_I.memory "Virtual lambda shifting for IUMPR simulation of range check of rich target sensor voltage with Lambda Offset, bank 1 / Integrator to create a ramp shaped lambda request / Current Integrator value" ULONG fak_q3p72529Em9 1 100 0.00 15.9999999963 FORMAT "%13.10" ECU_ADDRESS 0x50001378 /end MEASUREMENT
/begin MEASUREMENT EGSDCmn_S2B1VirtTarRichOffsParl_I.RampEndLimIK_I.memory "Virtual lambda shifting for IUMPR simulation of range check of rich target sensor voltage with Lambda Offset, bank 1 / Integrator for calculation of amount of exhaust mass during ramp-test / current integrator value" ULONG m_q1p5259Em8_kg 1 100 0.00 65.5359999847 FORMAT "%13.10" ECU_ADDRESS 0x5000137C /end MEASUREMENT
/begin MEASUREMENT EGSDCmn_S2B1VirtTarRichOffsParl_I.mO2EnaCatFullGrdtIK_I.memory "Virtual lambda shifting for IUMPR simulation of range check of rich target sensor voltage with Lambda Offset, bank 1 / Integrator for oxygen gas mass flow for detection if catalyst is filled with oxygen / current integrator value" FLOAT32_IEEE m_q1_mg 1 100 -1.0000E+037 1.0000E+037 FORMAT "%10.4" ECU_ADDRESS 0x50001380 /end MEASUREMENT
/begin MEASUREMENT EGSDCmn_S2B1VirtTarRichOffsParl_I.mO2VirtEnaCatEmptyIK_I.memory "Virtual lambda shifting for IUMPR simulation of range check of rich target sensor voltage with Lambda Offset, bank 1 / Integrator for rich gas mass flow for detection if catalyst is emtpied from oxygen / current integrator value" FLOAT32_IEEE m_q1_mg 1 100 -1.0000E+037 1.0000E+037 FORMAT "%10.4" ECU_ADDRESS 0x50001384 /end MEASUREMENT
/begin MEASUREMENT EGSDCmn_S2B1VirtTarRichOffsParl_I.tiDynWpaRampTONVNM_I.outbit "Virtual lambda shifting for IUMPR simulation of range check of rich target sensor voltage with Lambda Offset, bank 1 / Simulation of a sensor dynamics which corresponds to worst performing acceptable / return value" UBYTE B_TRUE 1 100 0.00 1.00000000000 BIT_MASK 0x1 FORMAT "%13.11" ECU_ADDRESS 0x50001388 /end MEASUREMENT
/begin MEASUREMENT EGSDCmn_S2B1VirtTarRichOffsParl_I.tiDynWpaRampTONVNM_I.time "Virtual lambda shifting for IUMPR simulation of range check of rich target sensor voltage with Lambda Offset, bank 1 / Simulation of a sensor dynamics which corresponds to worst performing acceptable / expired delay time" UWORD t_q0p1 1 100 0.00 6553.500 FORMAT "%8.3" ECU_ADDRESS 0x5000138A /end MEASUREMENT
/begin MEASUREMENT EGSDCmn_S2B1VirtTarRichOffsParl_I.tiLamDynTONV_I.outbit "Virtual lambda shifting for IUMPR simulation of range check of rich target sensor voltage with Lambda Offset, bank 1 / simulation time for sensor dynamic of upstream sensor 1 / return value" UBYTE B_TRUE 1 100 0.00 1.00000000000 BIT_MASK 0x1 FORMAT "%13.11" ECU_ADDRESS 0x5000138C /end MEASUREMENT
/begin MEASUREMENT EGSDCmn_S2B1VirtTarRichOffsParl_I.tiLamDynTONV_I.time "Virtual lambda shifting for IUMPR simulation of range check of rich target sensor voltage with Lambda Offset, bank 1 / simulation time for sensor dynamic of upstream sensor 1 / expired delay time" UWORD t_q0p1 1 100 0.00 6553.500 FORMAT "%8.3" ECU_ADDRESS 0x5000138E /end MEASUREMENT
/begin MEASUREMENT EGSDCmn_S2B1VirtTarRichOffsParl_I.tiUDynTONV_I.outbit "Virtual lambda shifting for IUMPR simulation of range check of rich target sensor voltage with Lambda Offset, bank 1 / simulation time for sensor dynamic of downstream sensor / return value" UBYTE B_TRUE 1 100 0.00 1.00000000000 BIT_MASK 0x1 FORMAT "%13.11" ECU_ADDRESS 0x50001390 /end MEASUREMENT
/begin MEASUREMENT EGSDCmn_S2B1VirtTarRichOffsParl_I.tiUDynTONV_I.time "Virtual lambda shifting for IUMPR simulation of range check of rich target sensor voltage with Lambda Offset, bank 1 / simulation time for sensor dynamic of downstream sensor / expired delay time" UWORD t_q0p1 1 100 0.00 6553.500 FORMAT "%8.3" ECU_ADDRESS 0x50001392 /end MEASUREMENT
/begin MEASUREMENT EGSDCmn_S2B1VirtTarRichParl_I.flgCatEmptyTOut "Virtual lambda shifting for IUMPR simulation of range check of rich target sensor voltage / Time out while checking if catalyst is empty from oxygen" UBYTE B_TRUE 1 100 0.00 1.00000000000 BIT_MASK 0x1 FORMAT "%13.11" ECU_ADDRESS 0x60001674 /end MEASUREMENT
/begin MEASUREMENT EGSDCmn_S2B1VirtTarRichParl_I.flgCatFullTOut "Virtual lambda shifting for IUMPR simulation of range check of rich target sensor voltage / Time out while checking if catalyst is filled with oxygen" UBYTE B_TRUE 1 100 0.00 1.00000000000 BIT_MASK 0x1 FORMAT "%13.11" ECU_ADDRESS 0x60001675 /end MEASUREMENT
/begin MEASUREMENT EGSDCmn_S2B1VirtTarRichParl_I.flgReld "Virtual lambda shifting for IUMPR simulation of range check of rich target sensor voltage / lambda shifting is released" UBYTE B_TRUE 1 100 0.00 1.00000000000 BIT_MASK 0x1 FORMAT "%13.11" ECU_ADDRESS 0x60001676 /end MEASUREMENT
/begin MEASUREMENT EGSDCmn_S2B1VirtTarRichParl_I.flgTarLeanRes "Virtual lambda shifting for IUMPR simulation of range check of rich target sensor voltage / check of lean sensor voltage, result is available" UBYTE B_TRUE 1 100 0.00 1.00000000000 BIT_MASK 0x1 FORMAT "%13.11" ECU_ADDRESS 0x60001677 /end MEASUREMENT
/begin MEASUREMENT EGSDCmn_S2B1VirtTarRichParl_I.flgTarRich "Virtual lambda shifting for IUMPR simulation of range check of rich target sensor voltage / Target Rich check is activated" UBYTE B_TRUE 1 100 0.00 1.00000000000 BIT_MASK 0x1 FORMAT "%13.11" ECU_ADDRESS 0x60001678 /end MEASUREMENT
/begin MEASUREMENT EGSDCmn_S2B1VirtTarRichParl_I.flgTarRichRes "Virtual lambda shifting for IUMPR simulation of range check of rich target sensor voltage / check of rich sensor voltage, result is available" UBYTE B_TRUE 1 100 0.00 1.00000000000 BIT_MASK 0x1 FORMAT "%13.11" ECU_ADDRESS 0x60001679 /end MEASUREMENT
/begin MEASUREMENT EGSDCmn_S2B1VirtTarRichParl_I.flgUHiEnaParl "Virtual lambda shifting for IUMPR simulation of range check of rich target sensor voltage / Sensor voltage downstream is high" UBYTE B_TRUE 1 100 0.00 1.00000000000 BIT_MASK 0x1 FORMAT "%13.11" ECU_ADDRESS 0x6000167A /end MEASUREMENT
/begin MEASUREMENT EGSDCmn_S2B1VirtTarRichParl_I.mOSC "Virtual lambda shifting for IUMPR simulation of range check of rich target sensor voltage / Assumed oxygen storage capacity for first catalyst" FLOAT32_IEEE m_q1_mg 1 100 0.00 50000.0000 FORMAT "%10.4" ECU_ADDRESS 0x6000167C /end MEASUREMENT
/begin MEASUREMENT EGSDCmn_S2B1VirtTarRichParl_I.mRSC "Virtual lambda shifting for IUMPR simulation of range check of rich target sensor voltage / Assumed rich gas storage capacity for first catalyst" FLOAT32_IEEE m_q1_mg 1 100 0.00 50000.0000 FORMAT "%10.4" ECU_ADDRESS 0x60001680 /end MEASUREMENT
/begin MEASUREMENT EGSDCmn_S2B1VirtTarRichParl_I.mRampDurParl "Virtual lambda shifting for IUMPR simulation of range check of rich target sensor voltage / Needed amount of exhaust mass during ramp-test" UWORD m_q0p001_kg 1 100 0.00 65.53500 FORMAT "%8.5" ECU_ADDRESS 0x60001684 /end MEASUREMENT
/begin MEASUREMENT EGSDCmn_S2B1VirtTarRichParl_I.mfEg "Virtual lambda shifting for IUMPR simulation of range check of rich target sensor voltage / Exhaust gas mass flow" UWORD m_q0p1 1 100 0.00 6553.500 FORMAT "%8.3" ECU_ADDRESS 0x60001686 /end MEASUREMENT
/begin MEASUREMENT EGSDCmn_S2B1VirtTarRichParl_I.mfVirtO2 "Virtual lambda shifting for IUMPR simulation of range check of rich target sensor voltage / Oxygen mass flow in catalyst 1, corrected by maximum possible mixture deviation in a fault free system" FLOAT32_IEEE mgrad_q1_mgdivs 1 100 0.00 50000.0000 FORMAT "%10.4" ECU_ADDRESS 0x60001688 /end MEASUREMENT
/begin MEASUREMENT EGSDCmn_S2B1VirtTarRichParl_I.mfVirtRich "Virtual lambda shifting for IUMPR simulation of range check of rich target sensor voltage / Rich Gas mass flow in catalyst 1, corrected by maximum possible mixture deviation in a fault free system" FLOAT32_IEEE mgrad_q1_mgdivs 1 100 0.00 50000.0000 FORMAT "%10.4" ECU_ADDRESS 0x6000168C /end MEASUREMENT
/begin MEASUREMENT EGSDCmn_S2B1VirtTarRichParl_I.ratLamRampLeanParl "Virtual lambda shifting for IUMPR simulation of range check of rich target sensor voltage / Lean Lambda request setpoint during ramping" UWORD fak_uw_b16 1 100 0.00 15.99976 FORMAT "%8.5" ECU_ADDRESS 0x60001690 /end MEASUREMENT
/begin MEASUREMENT EGSDCmn_S2B1VirtTarRichParl_I.ratLamRampRichParl "Virtual lambda shifting for IUMPR simulation of range check of rich target sensor voltage / Rich Lambda request setpoint during ramping" UWORD fak_uw_b16 1 100 0.00 15.99976 FORMAT "%8.5" ECU_ADDRESS 0x60001692 /end MEASUREMENT
/begin MEASUREMENT EGSDCmn_S2B1VirtTarRichParl_I.ratLamReq "Virtual lambda shifting for IUMPR simulation of range check of rich target sensor voltage / Requested Lambda value" UWORD fak_uw_b16 1 100 0.00 15.99976 FORMAT "%8.5" ECU_ADDRESS 0x60001694 /end MEASUREMENT
/begin MEASUREMENT EGSDCmn_S2B1VirtTarRichParl_I.sm "Virtual lambda shifting for IUMPR simulation of range check of rich target sensor voltage / State number" UBYTE EGSDCmn_VirtTarPlausParl_sm_VERB 1 100 0.00 5.00000000000 FORMAT "%13.11" ECU_ADDRESS 0x60001696 /end MEASUREMENT
/begin MEASUREMENT EGSDCmn_S2B1VirtTarRichParl_I.stLamGenr "Virtual lambda shifting for IUMPR simulation of range check of rich target sensor voltage / State number" UBYTE dez 1 100 0.00 255.0 FORMAT "%5.1" ECU_ADDRESS 0x60001697 /end MEASUREMENT
/begin MEASUREMENT EGSDCmn_S2B1VirtTarRichParl_I.tiGasRt "Virtual lambda shifting for IUMPR simulation of range check of rich target sensor voltage / gas propagation time till first Lambda sensor" UWORD t_q0p1 1 100 0.00 6553.500 FORMAT "%8.3" ECU_ADDRESS 0x60001698 /end MEASUREMENT
/begin MEASUREMENT EGSDCmn_S2B1VirtTarRichParl_I.tiLamDynLtr "Virtual lambda shifting for IUMPR simulation of range check of rich target sensor voltage / Dynamic time lambda signal of upstream sensor 1 Lean-Rich" UWORD t_q0p1 1 100 0.00 6553.500 FORMAT "%8.3" ECU_ADDRESS 0x6000169A /end MEASUREMENT
/begin MEASUREMENT EGSDCmn_S2B1VirtTarRichParl_I.tiLamDynRtl "Virtual lambda shifting for IUMPR simulation of range check of rich target sensor voltage / Dynamic time lambda signal of upstream sensor 1 Rich-Lean" UWORD t_q0p1 1 100 0.00 6553.500 FORMAT "%8.3" ECU_ADDRESS 0x6000169C /end MEASUREMENT
/begin MEASUREMENT EGSDCmn_S2B1VirtTarRichParl_I.tiUDynLtr "Virtual lambda shifting for IUMPR simulation of range check of rich target sensor voltage / Dynamic reaction time of downstream sensor, Lean-Rich" UWORD t_q0p1 1 100 0.00 6553.500 FORMAT "%8.3" ECU_ADDRESS 0x6000169E /end MEASUREMENT
/begin MEASUREMENT EGSDCmn_S2B1VirtTarRichParl_I.tiUDynRtl "Virtual lambda shifting for IUMPR simulation of range check of rich target sensor voltage / Dynamic reaction time of downstream sensor, Rich-Lean" UWORD t_q0p1 1 100 0.00 6553.500 FORMAT "%8.3" ECU_ADDRESS 0x600016A0 /end MEASUREMENT
/begin MEASUREMENT EGSDCmn_S2B1VirtTarRichParl_I.EnaReldEF_I.buffer "Virtual lambda shifting for IUMPR simulation of range check of rich target sensor voltage / EdgeFalling: loss of enable condition / memory to detect falling edge" UBYTE B_TRUE 1 100 0.00 1.00000000000 BIT_MASK 0x1 FORMAT "%13.11" ECU_ADDRESS 0x600016A2 /end MEASUREMENT
/begin MEASUREMENT EGSDCmn_S2B1VirtTarRichParl_I.EnaReldEF_I.oldSignal "Virtual lambda shifting for IUMPR simulation of range check of rich target sensor voltage / EdgeFalling: loss of enable condition / memory to detect falling edge" UBYTE B_TRUE 1 100 0.00 1.00000000000 BIT_MASK 0x1 FORMAT "%13.11" ECU_ADDRESS 0x600016A3 /end MEASUREMENT
/begin MEASUREMENT EGSDCmn_S2B1VirtTarRichParl_I.LamRampIKL_I.memory "Virtual lambda shifting for IUMPR simulation of range check of rich target sensor voltage / Integrator to create a ramp shaped lambda request / Current Integrator value" ULONG fak_q3p72529Em9 1 100 0.00 15.9999999963 FORMAT "%13.10" ECU_ADDRESS 0x600016A4 /end MEASUREMENT
/begin MEASUREMENT EGSDCmn_S2B1VirtTarRichParl_I.RampEndLimIK_I.memory "Virtual lambda shifting for IUMPR simulation of range check of rich target sensor voltage / Integrator for calculation of amount of exhaust mass during ramp-test / current integrator value" ULONG m_q1p5259Em8_kg 1 100 0.00 65.5359999847 FORMAT "%13.10" ECU_ADDRESS 0x600016A8 /end MEASUREMENT
/begin MEASUREMENT EGSDCmn_S2B1VirtTarRichParl_I.mO2EnaCatFullGrdtIK_I.memory "Virtual lambda shifting for IUMPR simulation of range check of rich target sensor voltage / Integrator for oxygen gas mass flow for detection if catalyst is filled with oxygen / current integrator value" FLOAT32_IEEE m_q1_mg 1 100 -1.0000E+037 1.0000E+037 FORMAT "%10.4" ECU_ADDRESS 0x600016AC /end MEASUREMENT
/begin MEASUREMENT EGSDCmn_S2B1VirtTarRichParl_I.mO2VirtEnaCatEmptyIK_I.memory "Virtual lambda shifting for IUMPR simulation of range check of rich target sensor voltage / Integrator for rich gas mass flow for detection if catalyst is emtpied from oxygen / current integrator value" FLOAT32_IEEE m_q1_mg 1 100 -1.0000E+037 1.0000E+037 FORMAT "%10.4" ECU_ADDRESS 0x600016B0 /end MEASUREMENT
/begin MEASUREMENT EGSDCmn_S2B1VirtTarRichParl_I.tiDynWpaRampTONVNM_I.outbit "Virtual lambda shifting for IUMPR simulation of range check of rich target sensor voltage / Simulation of a sensor dynamics which corresponds to worst performing acceptable / return value" UBYTE B_TRUE 1 100 0.00 1.00000000000 BIT_MASK 0x1 FORMAT "%13.11" ECU_ADDRESS 0x600016B4 /end MEASUREMENT
/begin MEASUREMENT EGSDCmn_S2B1VirtTarRichParl_I.tiDynWpaRampTONVNM_I.time "Virtual lambda shifting for IUMPR simulation of range check of rich target sensor voltage / Simulation of a sensor dynamics which corresponds to worst performing acceptable / expired delay time" UWORD t_q0p1 1 100 0.00 6553.500 FORMAT "%8.3" ECU_ADDRESS 0x600016B6 /end MEASUREMENT
/begin MEASUREMENT EGSDCmn_S2B1VirtTarRichParl_I.tiLamDynTONV_I.outbit "Virtual lambda shifting for IUMPR simulation of range check of rich target sensor voltage / simulation time for sensor dynamic of upstream sensor 1 / return value" UBYTE B_TRUE 1 100 0.00 1.00000000000 BIT_MASK 0x1 FORMAT "%13.11" ECU_ADDRESS 0x600016B8 /end MEASUREMENT
/begin MEASUREMENT EGSDCmn_S2B1VirtTarRichParl_I.tiLamDynTONV_I.time "Virtual lambda shifting for IUMPR simulation of range check of rich target sensor voltage / simulation time for sensor dynamic of upstream sensor 1 / expired delay time" UWORD t_q0p1 1 100 0.00 6553.500 FORMAT "%8.3" ECU_ADDRESS 0x600016BA /end MEASUREMENT
/begin MEASUREMENT EGSDCmn_S2B1VirtTarRichParl_I.tiUDynTONV_I.outbit "Virtual lambda shifting for IUMPR simulation of range check of rich target sensor voltage / simulation time for sensor dynamic of downstream sensor / return value" UBYTE B_TRUE 1 100 0.00 1.00000000000 BIT_MASK 0x1 FORMAT "%13.11" ECU_ADDRESS 0x600016BC /end MEASUREMENT
/begin MEASUREMENT EGSDCmn_S2B1VirtTarRichParl_I.tiUDynTONV_I.time "Virtual lambda shifting for IUMPR simulation of range check of rich target sensor voltage / simulation time for sensor dynamic of downstream sensor / expired delay time" UWORD t_q0p1 1 100 0.00 6553.500 FORMAT "%8.3" ECU_ADDRESS 0x600016BE /end MEASUREMENT
/begin MEASUREMENT EGSDCmn_S2B1VirtUDlyParl_I.flgCatEmpty "state machine of virtual lambda shifting for IUMPR simulation of measurement of delay time of sensor voltage from coordinator function of parallelization, bank 1 / Check if catalyst is empty from oxygen" UBYTE B_TRUE 1 100 0.00 1.00000000000 BIT_MASK 0x1 FORMAT "%13.11" ECU_ADDRESS 0x60001628 /end MEASUREMENT
/begin MEASUREMENT EGSDCmn_S2B1VirtUDlyParl_I.flgCatFull "state machine of virtual lambda shifting for IUMPR simulation of measurement of delay time of sensor voltage from coordinator function of parallelization, bank 1 / Check if catalyst is filled with oxygen" UBYTE B_TRUE 1 100 0.00 1.00000000000 BIT_MASK 0x1 FORMAT "%13.11" ECU_ADDRESS 0x60001629 /end MEASUREMENT
/begin MEASUREMENT EGSDCmn_S2B1VirtUDlyParl_I.flgDynTripDneVirt "state machine of virtual lambda shifting for IUMPR simulation of measurement of delay time of sensor voltage from coordinator function of parallelization, bank 1 / Virtuell dynamic check for the upstream sensor" UBYTE B_TRUE 1 100 0.00 1.00000000000 BIT_MASK 0x1 FORMAT "%13.11" ECU_ADDRESS 0x6000162A /end MEASUREMENT
/begin MEASUREMENT EGSDCmn_S2B1VirtUDlyParl_I.flgIdnAdpnEnd "state machine of virtual lambda shifting for IUMPR simulation of measurement of delay time of sensor voltage from coordinator function of parallelization, bank 1 / Status of Online adaption" UBYTE B_TRUE 1 100 0.00 1.00000000000 BIT_MASK 0x1 FORMAT "%13.11" ECU_ADDRESS 0x6000162B /end MEASUREMENT
/begin MEASUREMENT EGSDCmn_S2B1VirtUDlyParl_I.flgIdnAdpnLean "state machine of virtual lambda shifting for IUMPR simulation of measurement of delay time of sensor voltage from coordinator function of parallelization, bank 1 / Status of Online adaptionfor lean lambda" UBYTE B_TRUE 1 100 0.00 1.00000000000 BIT_MASK 0x1 FORMAT "%13.11" ECU_ADDRESS 0x6000162C /end MEASUREMENT
/begin MEASUREMENT EGSDCmn_S2B1VirtUDlyParl_I.flgIdnAdpnRich "state machine of virtual lambda shifting for IUMPR simulation of measurement of delay time of sensor voltage from coordinator function of parallelization, bank 1 / Status of Online adaptionfor rich lambda" UBYTE B_TRUE 1 100 0.00 1.00000000000 BIT_MASK 0x1 FORMAT "%13.11" ECU_ADDRESS 0x6000162D /end MEASUREMENT
/begin MEASUREMENT EGSDCmn_S2B1VirtUDlyParl_I.flgReld "state machine of virtual lambda shifting for IUMPR simulation of measurement of delay time of sensor voltage from coordinator function of parallelization, bank 1 / lambda shifting is released" UBYTE B_TRUE 1 100 0.00 1.00000000000 BIT_MASK 0x1 FORMAT "%13.11" ECU_ADDRESS 0x6000162E /end MEASUREMENT
/begin MEASUREMENT EGSDCmn_S2B1VirtUDlyParl_I.flgUHiEnaParl "state machine of virtual lambda shifting for IUMPR simulation of measurement of delay time of sensor voltage from coordinator function of parallelization, bank 1 / Sensor voltage downstream is high" UBYTE B_TRUE 1 100 0.00 1.00000000000 BIT_MASK 0x1 FORMAT "%13.11" ECU_ADDRESS 0x6000162F /end MEASUREMENT
/begin MEASUREMENT EGSDCmn_S2B1VirtUDlyParl_I.flgUMid "state machine of virtual lambda shifting for IUMPR simulation of measurement of delay time of sensor voltage from coordinator function of parallelization, bank 1 / sensor voltage in medium range (two stage preconditioning required)" UBYTE B_TRUE 1 100 0.00 1.00000000000 BIT_MASK 0x1 FORMAT "%13.11" ECU_ADDRESS 0x60001630 /end MEASUREMENT
/begin MEASUREMENT EGSDCmn_S2B1VirtUDlyParl_I.flgVirtLamDyn "state machine of virtual lambda shifting for IUMPR simulation of measurement of delay time of sensor voltage from coordinator function of parallelization, bank 1 / Activation of IUMPR simulation for UEGO dynamic diagnosis" UBYTE B_TRUE 1 100 0.00 1.00000000000 BIT_MASK 0x1 FORMAT "%13.11" ECU_ADDRESS 0x60001631 /end MEASUREMENT
/begin MEASUREMENT EGSDCmn_S2B1VirtUDlyParl_I.mOSC "state machine of virtual lambda shifting for IUMPR simulation of measurement of delay time of sensor voltage from coordinator function of parallelization, bank 1 / Assumed oxygen storage capacity for first catalyst" FLOAT32_IEEE m_q1_mg 1 100 0.00 50000.0000 FORMAT "%10.4" ECU_ADDRESS 0x60001634 /end MEASUREMENT
/begin MEASUREMENT EGSDCmn_S2B1VirtUDlyParl_I.mRSC "state machine of virtual lambda shifting for IUMPR simulation of measurement of delay time of sensor voltage from coordinator function of parallelization, bank 1 / Assumed rich gas storage capacity for first catalyst" FLOAT32_IEEE m_q1_mg 1 100 0.00 50000.0000 FORMAT "%10.4" ECU_ADDRESS 0x60001638 /end MEASUREMENT
/begin MEASUREMENT EGSDCmn_S2B1VirtUDlyParl_I.mfVirtO2 "state machine of virtual lambda shifting for IUMPR simulation of measurement of delay time of sensor voltage from coordinator function of parallelization, bank 1 / Oxygen mass flow in catalyst 1, corrected by maximum possible mixture deviation in a fault free system" FLOAT32_IEEE mgrad_q1_mgdivs 1 100 0.00 50000.0000 FORMAT "%10.4" ECU_ADDRESS 0x6000163C /end MEASUREMENT
/begin MEASUREMENT EGSDCmn_S2B1VirtUDlyParl_I.mfVirtRich "state machine of virtual lambda shifting for IUMPR simulation of measurement of delay time of sensor voltage from coordinator function of parallelization, bank 1 / Rich Gas mass flow in catalyst 1, corrected by maximum possible mixture deviation in a fault free system" FLOAT32_IEEE mgrad_q1_mgdivs 1 100 0.00 50000.0000 FORMAT "%10.4" ECU_ADDRESS 0x60001640 /end MEASUREMENT
/begin MEASUREMENT EGSDCmn_S2B1VirtUDlyParl_I.sm "state machine of virtual lambda shifting for IUMPR simulation of measurement of delay time of sensor voltage from coordinator function of parallelization, bank 1 / State number" UBYTE EGSDCmn_VirtLamGenrParl_sm_VERB 1 100 0.00 7.00000000000 FORMAT "%13.11" ECU_ADDRESS 0x60001644 /end MEASUREMENT
/begin MEASUREMENT EGSDCmn_S2B1VirtUDlyParl_I.stLamGenr "state machine of virtual lambda shifting for IUMPR simulation of measurement of delay time of sensor voltage from coordinator function of parallelization, bank 1 / State number" UBYTE dez 1 100 0.00 255.0 FORMAT "%5.1" ECU_ADDRESS 0x60001645 /end MEASUREMENT
/begin MEASUREMENT EGSDCmn_S2B1VirtUDlyParl_I.tiGas "state machine of virtual lambda shifting for IUMPR simulation of measurement of delay time of sensor voltage from coordinator function of parallelization, bank 1 / gas propagation time till first Lambda sensor" UWORD t_q0p1 1 100 0.00 6553.500 FORMAT "%8.3" ECU_ADDRESS 0x60001646 /end MEASUREMENT
/begin MEASUREMENT EGSDCmn_S2B1VirtUDlyParl_I.tiLamDynLtr "state machine of virtual lambda shifting for IUMPR simulation of measurement of delay time of sensor voltage from coordinator function of parallelization, bank 1 / Dynamic time lambda signal of upstream sensor 1 Lean-Rich" UWORD t_q0p1 1 100 0.00 6553.500 FORMAT "%8.3" ECU_ADDRESS 0x60001648 /end MEASUREMENT
/begin MEASUREMENT EGSDCmn_S2B1VirtUDlyParl_I.tiLamDynRtl "state machine of virtual lambda shifting for IUMPR simulation of measurement of delay time of sensor voltage from coordinator function of parallelization, bank 1 / Dynamic time lambda signal of upstream sensor 1 Rich-Lean" UWORD t_q0p1 1 100 0.00 6553.500 FORMAT "%8.3" ECU_ADDRESS 0x6000164A /end MEASUREMENT
/begin MEASUREMENT EGSDCmn_S2B1VirtUDlyParl_I.tiUDynLtr "state machine of virtual lambda shifting for IUMPR simulation of measurement of delay time of sensor voltage from coordinator function of parallelization, bank 1 / Dynamic reaction time of downstream sensor, Lean-Rich" UWORD t_q0p1 1 100 0.00 6553.500 FORMAT "%8.3" ECU_ADDRESS 0x6000164C /end MEASUREMENT
/begin MEASUREMENT EGSDCmn_S2B1VirtUDlyParl_I.tiUDynRtl "state machine of virtual lambda shifting for IUMPR simulation of measurement of delay time of sensor voltage from coordinator function of parallelization, bank 1 / Dynamic reaction time of downstream sensor, Rich-Lean" UWORD t_q0p1 1 100 0.00 6553.500 FORMAT "%8.3" ECU_ADDRESS 0x6000164E /end MEASUREMENT
/begin MEASUREMENT EGSDCmn_S2B1VirtUDlyParl_I.u "state machine of virtual lambda shifting for IUMPR simulation of measurement of delay time of sensor voltage from coordinator function of parallelization, bank 1 / Sensor voltage of downstream sensor" UWORD spg_q1p221Em3_V 1 100 0.00 4.998779 FORMAT "%8.6" ECU_ADDRESS 0x60001650 /end MEASUREMENT
/begin MEASUREMENT EGSDCmn_S2B1VirtUDlyParl_I.EnaReldEF_I.buffer "state machine of virtual lambda shifting for IUMPR simulation of measurement of delay time of sensor voltage from coordinator function of parallelization, bank 1 / EdgeFalling: loss of enable condition / memory to detect falling edge" UBYTE B_TRUE 1 100 0.00 1.00000000000 BIT_MASK 0x1 FORMAT "%13.11" ECU_ADDRESS 0x60001652 /end MEASUREMENT
/begin MEASUREMENT EGSDCmn_S2B1VirtUDlyParl_I.EnaReldEF_I.oldSignal "state machine of virtual lambda shifting for IUMPR simulation of measurement of delay time of sensor voltage from coordinator function of parallelization, bank 1 / EdgeFalling: loss of enable condition / memory to detect falling edge" UBYTE B_TRUE 1 100 0.00 1.00000000000 BIT_MASK 0x1 FORMAT "%13.11" ECU_ADDRESS 0x60001653 /end MEASUREMENT
/begin MEASUREMENT EGSDCmn_S2B1VirtUDlyParl_I.IdnAdpnCTR_I.counter "state machine of virtual lambda shifting for IUMPR simulation of measurement of delay time of sensor voltage from coordinator function of parallelization, bank 1 / Counter for lambda jumps for online adaption purposes / current counter value" UWORD dez 1 100 0.00 65535.00 FORMAT "%8.2" ECU_ADDRESS 0x60001654 /end MEASUREMENT
/begin MEASUREMENT EGSDCmn_S2B1VirtUDlyParl_I.flgLeanLamStabTONV_I.outbit "state machine of virtual lambda shifting for IUMPR simulation of measurement of delay time of sensor voltage from coordinator function of parallelization, bank 1 / Waiting time for lean lambda stability criterion / return value" UBYTE B_TRUE 1 100 0.00 1.00000000000 BIT_MASK 0x1 FORMAT "%13.11" ECU_ADDRESS 0x60001656 /end MEASUREMENT
/begin MEASUREMENT EGSDCmn_S2B1VirtUDlyParl_I.flgLeanLamStabTONV_I.time "state machine of virtual lambda shifting for IUMPR simulation of measurement of delay time of sensor voltage from coordinator function of parallelization, bank 1 / Waiting time for lean lambda stability criterion / expired delay time" UWORD t_q0p1 1 100 0.00 6553.500 FORMAT "%8.3" ECU_ADDRESS 0x60001658 /end MEASUREMENT
/begin MEASUREMENT EGSDCmn_S2B1VirtUDlyParl_I.flgRichLamStabTONV_I.outbit "state machine of virtual lambda shifting for IUMPR simulation of measurement of delay time of sensor voltage from coordinator function of parallelization, bank 1 / Waiting time for rich lambda stability criterion / return value" UBYTE B_TRUE 1 100 0.00 1.00000000000 BIT_MASK 0x1 FORMAT "%13.11" ECU_ADDRESS 0x6000165A /end MEASUREMENT
/begin MEASUREMENT EGSDCmn_S2B1VirtUDlyParl_I.flgRichLamStabTONV_I.time "state machine of virtual lambda shifting for IUMPR simulation of measurement of delay time of sensor voltage from coordinator function of parallelization, bank 1 / Waiting time for rich lambda stability criterion / expired delay time" UWORD t_q0p1 1 100 0.00 6553.500 FORMAT "%8.3" ECU_ADDRESS 0x6000165C /end MEASUREMENT
/begin MEASUREMENT EGSDCmn_S2B1VirtUDlyParl_I.mO2EnaCatFullGrdtIK_I.memory "state machine of virtual lambda shifting for IUMPR simulation of measurement of delay time of sensor voltage from coordinator function of parallelization, bank 1 / Integrator for oxygen gas mass flow for detection if catalyst is filled with oxygen / current integrator value" FLOAT32_IEEE m_q1_mg 1 100 -1.0000E+037 1.0000E+037 FORMAT "%10.4" ECU_ADDRESS 0x60001660 /end MEASUREMENT
/begin MEASUREMENT EGSDCmn_S2B1VirtUDlyParl_I.mO2IdnAdpnIKL_I.memory "state machine of virtual lambda shifting for IUMPR simulation of measurement of delay time of sensor voltage from coordinator function of parallelization, bank 1 / Integrator for oxygen or rich gas mass flow for lambda jumps for online adaption purposes / Current Integrator value" FLOAT32_IEEE m_q1_mg 1 100 -1.0000E+037 1.0000E+037 FORMAT "%10.4" ECU_ADDRESS 0x60001664 /end MEASUREMENT
/begin MEASUREMENT EGSDCmn_S2B1VirtUDlyParl_I.mO2VirtEnaCatEmptyIK_I.memory "state machine of virtual lambda shifting for IUMPR simulation of measurement of delay time of sensor voltage from coordinator function of parallelization, bank 1 / Integrator for rich gas mass flow for detection if catalyst is emtpied from oxygen / current integrator value" FLOAT32_IEEE m_q1_mg 1 100 -1.0000E+037 1.0000E+037 FORMAT "%10.4" ECU_ADDRESS 0x60001668 /end MEASUREMENT
/begin MEASUREMENT EGSDCmn_S2B1VirtUDlyParl_I.tiGasRtlTONV_I.outbit "state machine of virtual lambda shifting for IUMPR simulation of measurement of delay time of sensor voltage from coordinator function of parallelization, bank 1 / Simulation of gas propagation till first Lambda sensor / return value" UBYTE B_TRUE 1 100 0.00 1.00000000000 BIT_MASK 0x1 FORMAT "%13.11" ECU_ADDRESS 0x6000166C /end MEASUREMENT
/begin MEASUREMENT EGSDCmn_S2B1VirtUDlyParl_I.tiGasRtlTONV_I.time "state machine of virtual lambda shifting for IUMPR simulation of measurement of delay time of sensor voltage from coordinator function of parallelization, bank 1 / Simulation of gas propagation till first Lambda sensor / expired delay time" UWORD t_q0p1 1 100 0.00 6553.500 FORMAT "%8.3" ECU_ADDRESS 0x6000166E /end MEASUREMENT
/begin MEASUREMENT EGSDCmn_S2B1VirtUDlyParl_I.tiUDynTONV_I.outbit "state machine of virtual lambda shifting for IUMPR simulation of measurement of delay time of sensor voltage from coordinator function of parallelization, bank 1 / simulation time for sensor dynamic of downstream sensor / return value" UBYTE B_TRUE 1 100 0.00 1.00000000000 BIT_MASK 0x1 FORMAT "%13.11" ECU_ADDRESS 0x60001670 /end MEASUREMENT
/begin MEASUREMENT EGSDCmn_S2B1VirtUDlyParl_I.tiUDynTONV_I.time "state machine of virtual lambda shifting for IUMPR simulation of measurement of delay time of sensor voltage from coordinator function of parallelization, bank 1 / simulation time for sensor dynamic of downstream sensor / expired delay time" UWORD t_q0p1 1 100 0.00 6553.500 FORMAT "%8.3" ECU_ADDRESS 0x60001672 /end MEASUREMENT
/begin MEASUREMENT EGSDCmn_S2B1VirtUTranParl_I.flgCatEmpty "state machine of virtual lambda shifting for IUMPR simulation of measurement of transition time of sensor voltage from coordinator function of parallelization, bank 1 / Check if catalyst is empty from oxygen" UBYTE B_TRUE 1 100 0.00 1.00000000000 BIT_MASK 0x1 FORMAT "%13.11" ECU_ADDRESS 0x600015DC /end MEASUREMENT
/begin MEASUREMENT EGSDCmn_S2B1VirtUTranParl_I.flgCatFull "state machine of virtual lambda shifting for IUMPR simulation of measurement of transition time of sensor voltage from coordinator function of parallelization, bank 1 / Check if catalyst is filled with oxygen" UBYTE B_TRUE 1 100 0.00 1.00000000000 BIT_MASK 0x1 FORMAT "%13.11" ECU_ADDRESS 0x600015DD /end MEASUREMENT
/begin MEASUREMENT EGSDCmn_S2B1VirtUTranParl_I.flgDynTripDneVirt "state machine of virtual lambda shifting for IUMPR simulation of measurement of transition time of sensor voltage from coordinator function of parallelization, bank 1 / Virtuell dynamic check for the upstream sensor" UBYTE B_TRUE 1 100 0.00 1.00000000000 BIT_MASK 0x1 FORMAT "%13.11" ECU_ADDRESS 0x600015DE /end MEASUREMENT
/begin MEASUREMENT EGSDCmn_S2B1VirtUTranParl_I.flgIdnAdpnEnd "state machine of virtual lambda shifting for IUMPR simulation of measurement of transition time of sensor voltage from coordinator function of parallelization, bank 1 / Status of Online adaption" UBYTE B_TRUE 1 100 0.00 1.00000000000 BIT_MASK 0x1 FORMAT "%13.11" ECU_ADDRESS 0x600015DF /end MEASUREMENT
/begin MEASUREMENT EGSDCmn_S2B1VirtUTranParl_I.flgIdnAdpnLean "state machine of virtual lambda shifting for IUMPR simulation of measurement of transition time of sensor voltage from coordinator function of parallelization, bank 1 / Status of Online adaptionfor lean lambda" UBYTE B_TRUE 1 100 0.00 1.00000000000 BIT_MASK 0x1 FORMAT "%13.11" ECU_ADDRESS 0x600015E0 /end MEASUREMENT
/begin MEASUREMENT EGSDCmn_S2B1VirtUTranParl_I.flgIdnAdpnRich "state machine of virtual lambda shifting for IUMPR simulation of measurement of transition time of sensor voltage from coordinator function of parallelization, bank 1 / Status of Online adaptionfor rich lambda" UBYTE B_TRUE 1 100 0.00 1.00000000000 BIT_MASK 0x1 FORMAT "%13.11" ECU_ADDRESS 0x600015E1 /end MEASUREMENT
/begin MEASUREMENT EGSDCmn_S2B1VirtUTranParl_I.flgReld "state machine of virtual lambda shifting for IUMPR simulation of measurement of transition time of sensor voltage from coordinator function of parallelization, bank 1 / lambda shifting is released" UBYTE B_TRUE 1 100 0.00 1.00000000000 BIT_MASK 0x1 FORMAT "%13.11" ECU_ADDRESS 0x600015E2 /end MEASUREMENT
/begin MEASUREMENT EGSDCmn_S2B1VirtUTranParl_I.flgUHiEnaParl "state machine of virtual lambda shifting for IUMPR simulation of measurement of transition time of sensor voltage from coordinator function of parallelization, bank 1 / Sensor voltage downstream is high" UBYTE B_TRUE 1 100 0.00 1.00000000000 BIT_MASK 0x1 FORMAT "%13.11" ECU_ADDRESS 0x600015E3 /end MEASUREMENT
/begin MEASUREMENT EGSDCmn_S2B1VirtUTranParl_I.flgUMid "state machine of virtual lambda shifting for IUMPR simulation of measurement of transition time of sensor voltage from coordinator function of parallelization, bank 1 / sensor voltage in medium range (two stage preconditioning required)" UBYTE B_TRUE 1 100 0.00 1.00000000000 BIT_MASK 0x1 FORMAT "%13.11" ECU_ADDRESS 0x600015E4 /end MEASUREMENT
/begin MEASUREMENT EGSDCmn_S2B1VirtUTranParl_I.flgVirtLamDyn "state machine of virtual lambda shifting for IUMPR simulation of measurement of transition time of sensor voltage from coordinator function of parallelization, bank 1 / Activation of IUMPR simulation for UEGO dynamic diagnosis" UBYTE B_TRUE 1 100 0.00 1.00000000000 BIT_MASK 0x1 FORMAT "%13.11" ECU_ADDRESS 0x600015E5 /end MEASUREMENT
/begin MEASUREMENT EGSDCmn_S2B1VirtUTranParl_I.mOSC "state machine of virtual lambda shifting for IUMPR simulation of measurement of transition time of sensor voltage from coordinator function of parallelization, bank 1 / Assumed oxygen storage capacity for first catalyst" FLOAT32_IEEE m_q1_mg 1 100 0.00 50000.0000 FORMAT "%10.4" ECU_ADDRESS 0x600015E8 /end MEASUREMENT
/begin MEASUREMENT EGSDCmn_S2B1VirtUTranParl_I.mRSC "state machine of virtual lambda shifting for IUMPR simulation of measurement of transition time of sensor voltage from coordinator function of parallelization, bank 1 / Assumed rich gas storage capacity for first catalyst" FLOAT32_IEEE m_q1_mg 1 100 0.00 50000.0000 FORMAT "%10.4" ECU_ADDRESS 0x600015EC /end MEASUREMENT
/begin MEASUREMENT EGSDCmn_S2B1VirtUTranParl_I.mfVirtO2 "state machine of virtual lambda shifting for IUMPR simulation of measurement of transition time of sensor voltage from coordinator function of parallelization, bank 1 / Oxygen mass flow in catalyst 1, corrected by maximum possible mixture deviation in a fault free system" FLOAT32_IEEE mgrad_q1_mgdivs 1 100 0.00 50000.0000 FORMAT "%10.4" ECU_ADDRESS 0x600015F0 /end MEASUREMENT
/begin MEASUREMENT EGSDCmn_S2B1VirtUTranParl_I.mfVirtRich "state machine of virtual lambda shifting for IUMPR simulation of measurement of transition time of sensor voltage from coordinator function of parallelization, bank 1 / Rich Gas mass flow in catalyst 1, corrected by maximum possible mixture deviation in a fault free system" FLOAT32_IEEE mgrad_q1_mgdivs 1 100 0.00 50000.0000 FORMAT "%10.4" ECU_ADDRESS 0x600015F4 /end MEASUREMENT
/begin MEASUREMENT EGSDCmn_S2B1VirtUTranParl_I.sm "state machine of virtual lambda shifting for IUMPR simulation of measurement of transition time of sensor voltage from coordinator function of parallelization, bank 1 / State number" UBYTE EGSDCmn_VirtLamGenrParl_sm_VERB 1 100 0.00 7.00000000000 FORMAT "%13.11" ECU_ADDRESS 0x600015F8 /end MEASUREMENT
/begin MEASUREMENT EGSDCmn_S2B1VirtUTranParl_I.stLamGenr "state machine of virtual lambda shifting for IUMPR simulation of measurement of transition time of sensor voltage from coordinator function of parallelization, bank 1 / State number" UBYTE dez 1 100 0.00 255.0 FORMAT "%5.1" ECU_ADDRESS 0x600015F9 /end MEASUREMENT
/begin MEASUREMENT EGSDCmn_S2B1VirtUTranParl_I.tiGas "state machine of virtual lambda shifting for IUMPR simulation of measurement of transition time of sensor voltage from coordinator function of parallelization, bank 1 / gas propagation time till first Lambda sensor" UWORD t_q0p1 1 100 0.00 6553.500 FORMAT "%8.3" ECU_ADDRESS 0x600015FA /end MEASUREMENT
/begin MEASUREMENT EGSDCmn_S2B1VirtUTranParl_I.tiLamDynLtr "state machine of virtual lambda shifting for IUMPR simulation of measurement of transition time of sensor voltage from coordinator function of parallelization, bank 1 / Dynamic time lambda signal of upstream sensor 1 Lean-Rich" UWORD t_q0p1 1 100 0.00 6553.500 FORMAT "%8.3" ECU_ADDRESS 0x600015FC /end MEASUREMENT
/begin MEASUREMENT EGSDCmn_S2B1VirtUTranParl_I.tiLamDynRtl "state machine of virtual lambda shifting for IUMPR simulation of measurement of transition time of sensor voltage from coordinator function of parallelization, bank 1 / Dynamic time lambda signal of upstream sensor 1 Rich-Lean" UWORD t_q0p1 1 100 0.00 6553.500 FORMAT "%8.3" ECU_ADDRESS 0x600015FE /end MEASUREMENT
/begin MEASUREMENT EGSDCmn_S2B1VirtUTranParl_I.tiUDynLtr "state machine of virtual lambda shifting for IUMPR simulation of measurement of transition time of sensor voltage from coordinator function of parallelization, bank 1 / Dynamic reaction time of downstream sensor, Lean-Rich" UWORD t_q0p1 1 100 0.00 6553.500 FORMAT "%8.3" ECU_ADDRESS 0x60001600 /end MEASUREMENT
/begin MEASUREMENT EGSDCmn_S2B1VirtUTranParl_I.tiUDynRtl "state machine of virtual lambda shifting for IUMPR simulation of measurement of transition time of sensor voltage from coordinator function of parallelization, bank 1 / Dynamic reaction time of downstream sensor, Rich-Lean" UWORD t_q0p1 1 100 0.00 6553.500 FORMAT "%8.3" ECU_ADDRESS 0x60001602 /end MEASUREMENT
/begin MEASUREMENT EGSDCmn_S2B1VirtUTranParl_I.u "state machine of virtual lambda shifting for IUMPR simulation of measurement of transition time of sensor voltage from coordinator function of parallelization, bank 1 / Sensor voltage of downstream sensor" UWORD spg_q1p221Em3_V 1 100 0.00 4.998779 FORMAT "%8.6" ECU_ADDRESS 0x60001604 /end MEASUREMENT
/begin MEASUREMENT EGSDCmn_S2B1VirtUTranParl_I.EnaReldEF_I.buffer "state machine of virtual lambda shifting for IUMPR simulation of measurement of transition time of sensor voltage from coordinator function of parallelization, bank 1 / EdgeFalling: loss of enable condition / memory to detect falling edge" UBYTE B_TRUE 1 100 0.00 1.00000000000 BIT_MASK 0x1 FORMAT "%13.11" ECU_ADDRESS 0x60001606 /end MEASUREMENT
/begin MEASUREMENT EGSDCmn_S2B1VirtUTranParl_I.EnaReldEF_I.oldSignal "state machine of virtual lambda shifting for IUMPR simulation of measurement of transition time of sensor voltage from coordinator function of parallelization, bank 1 / EdgeFalling: loss of enable condition / memory to detect falling edge" UBYTE B_TRUE 1 100 0.00 1.00000000000 BIT_MASK 0x1 FORMAT "%13.11" ECU_ADDRESS 0x60001607 /end MEASUREMENT
/begin MEASUREMENT EGSDCmn_S2B1VirtUTranParl_I.IdnAdpnCTR_I.counter "state machine of virtual lambda shifting for IUMPR simulation of measurement of transition time of sensor voltage from coordinator function of parallelization, bank 1 / Counter for lambda jumps for online adaption purposes / current counter value" UWORD dez 1 100 0.00 65535.00 FORMAT "%8.2" ECU_ADDRESS 0x60001608 /end MEASUREMENT
/begin MEASUREMENT EGSDCmn_S2B1VirtUTranParl_I.flgLeanLamStabTONV_I.outbit "state machine of virtual lambda shifting for IUMPR simulation of measurement of transition time of sensor voltage from coordinator function of parallelization, bank 1 / Waiting time for lean lambda stability criterion / return value" UBYTE B_TRUE 1 100 0.00 1.00000000000 BIT_MASK 0x1 FORMAT "%13.11" ECU_ADDRESS 0x6000160A /end MEASUREMENT
/begin MEASUREMENT EGSDCmn_S2B1VirtUTranParl_I.flgLeanLamStabTONV_I.time "state machine of virtual lambda shifting for IUMPR simulation of measurement of transition time of sensor voltage from coordinator function of parallelization, bank 1 / Waiting time for lean lambda stability criterion / expired delay time" UWORD t_q0p1 1 100 0.00 6553.500 FORMAT "%8.3" ECU_ADDRESS 0x6000160C /end MEASUREMENT
/begin MEASUREMENT EGSDCmn_S2B1VirtUTranParl_I.flgRichLamStabTONV_I.outbit "state machine of virtual lambda shifting for IUMPR simulation of measurement of transition time of sensor voltage from coordinator function of parallelization, bank 1 / Waiting time for rich lambda stability criterion / return value" UBYTE B_TRUE 1 100 0.00 1.00000000000 BIT_MASK 0x1 FORMAT "%13.11" ECU_ADDRESS 0x6000160E /end MEASUREMENT
/begin MEASUREMENT EGSDCmn_S2B1VirtUTranParl_I.flgRichLamStabTONV_I.time "state machine of virtual lambda shifting for IUMPR simulation of measurement of transition time of sensor voltage from coordinator function of parallelization, bank 1 / Waiting time for rich lambda stability criterion / expired delay time" UWORD t_q0p1 1 100 0.00 6553.500 FORMAT "%8.3" ECU_ADDRESS 0x60001610 /end MEASUREMENT
/begin MEASUREMENT EGSDCmn_S2B1VirtUTranParl_I.mO2EnaCatFullGrdtIK_I.memory "state machine of virtual lambda shifting for IUMPR simulation of measurement of transition time of sensor voltage from coordinator function of parallelization, bank 1 / Integrator for oxygen gas mass flow for detection if catalyst is filled with oxygen / current integrator value" FLOAT32_IEEE m_q1_mg 1 100 -1.0000E+037 1.0000E+037 FORMAT "%10.4" ECU_ADDRESS 0x60001614 /end MEASUREMENT
/begin MEASUREMENT EGSDCmn_S2B1VirtUTranParl_I.mO2IdnAdpnIKL_I.memory "state machine of virtual lambda shifting for IUMPR simulation of measurement of transition time of sensor voltage from coordinator function of parallelization, bank 1 / Integrator for oxygen or rich gas mass flow for lambda jumps for online adaption purposes / Current Integrator value" FLOAT32_IEEE m_q1_mg 1 100 -1.0000E+037 1.0000E+037 FORMAT "%10.4" ECU_ADDRESS 0x60001618 /end MEASUREMENT
/begin MEASUREMENT EGSDCmn_S2B1VirtUTranParl_I.mO2VirtEnaCatEmptyIK_I.memory "state machine of virtual lambda shifting for IUMPR simulation of measurement of transition time of sensor voltage from coordinator function of parallelization, bank 1 / Integrator for rich gas mass flow for detection if catalyst is emtpied from oxygen / current integrator value" FLOAT32_IEEE m_q1_mg 1 100 -1.0000E+037 1.0000E+037 FORMAT "%10.4" ECU_ADDRESS 0x6000161C /end MEASUREMENT
/begin MEASUREMENT EGSDCmn_S2B1VirtUTranParl_I.tiGasRtlTONV_I.outbit "state machine of virtual lambda shifting for IUMPR simulation of measurement of transition time of sensor voltage from coordinator function of parallelization, bank 1 / Simulation of gas propagation till first Lambda sensor / return value" UBYTE B_TRUE 1 100 0.00 1.00000000000 BIT_MASK 0x1 FORMAT "%13.11" ECU_ADDRESS 0x60001620 /end MEASUREMENT
/begin MEASUREMENT EGSDCmn_S2B1VirtUTranParl_I.tiGasRtlTONV_I.time "state machine of virtual lambda shifting for IUMPR simulation of measurement of transition time of sensor voltage from coordinator function of parallelization, bank 1 / Simulation of gas propagation till first Lambda sensor / expired delay time" UWORD t_q0p1 1 100 0.00 6553.500 FORMAT "%8.3" ECU_ADDRESS 0x60001622 /end MEASUREMENT
/begin MEASUREMENT EGSDCmn_S2B1VirtUTranParl_I.tiUDynTONV_I.outbit "state machine of virtual lambda shifting for IUMPR simulation of measurement of transition time of sensor voltage from coordinator function of parallelization, bank 1 / simulation time for sensor dynamic of downstream sensor / return value" UBYTE B_TRUE 1 100 0.00 1.00000000000 BIT_MASK 0x1 FORMAT "%13.11" ECU_ADDRESS 0x60001624 /end MEASUREMENT
/begin MEASUREMENT EGSDCmn_S2B1VirtUTranParl_I.tiUDynTONV_I.time "state machine of virtual lambda shifting for IUMPR simulation of measurement of transition time of sensor voltage from coordinator function of parallelization, bank 1 / simulation time for sensor dynamic of downstream sensor / expired delay time" UWORD t_q0p1 1 100 0.00 6553.500 FORMAT "%8.3" ECU_ADDRESS 0x60001626 /end MEASUREMENT
/begin MEASUREMENT EGSDCmn_Seg1B1LamRampLeanVirtParl_I.flgLamReq "Class instance: virtual lean lambda ramp / lambda request is active" UBYTE B_TRUE 1 100 0.00 1.00000000000 BIT_MASK 0x1 FORMAT "%13.11" ECU_ADDRESS 0x50001394 /end MEASUREMENT
/begin MEASUREMENT EGSDCmn_Seg1B1LamRampLeanVirtParl_I.flgLeanRampEnd "Class instance: virtual lean lambda ramp / lean lambda ramp is expired" UBYTE B_TRUE 1 100 0.00 1.00000000000 BIT_MASK 0x1 FORMAT "%13.11" ECU_ADDRESS 0x50001395 /end MEASUREMENT
/begin MEASUREMENT EGSDCmn_Seg1B1LamRampLeanVirtParl_I.flgRampDurEnd "Class instance: virtual lean lambda ramp / lambda ramp is expired" UBYTE B_TRUE 1 100 0.00 1.00000000000 BIT_MASK 0x1 FORMAT "%13.11" ECU_ADDRESS 0x50001396 /end MEASUREMENT
/begin MEASUREMENT EGSDCmn_Seg1B1LamRampLeanVirtParl_I.flgRichRampEnd "Class instance: virtual lean lambda ramp / rich lambda ramp is expired" UBYTE B_TRUE 1 100 0.00 1.00000000000 BIT_MASK 0x1 FORMAT "%13.11" ECU_ADDRESS 0x50001397 /end MEASUREMENT
/begin MEASUREMENT EGSDCmn_Seg1B1LamRampLeanVirtParl_I.ratLamReq "Class instance: virtual lean lambda ramp / requested lambda" UWORD fak_uw_b16 1 100 0.00 15.99976 FORMAT "%8.5" ECU_ADDRESS 0x50001398 /end MEASUREMENT
/begin MEASUREMENT EGSDCmn_Seg1B1LamRampLeanVirtParl_I.DynErrRampTONVNM_I.time "Class instance: virtual lean lambda ramp / simulation time for sensor dynamic to calculation for ramp duration / Delay Time" UWORD t_q0p01 1 100 0.00 655.3500 FORMAT "%8.4" ECU_ADDRESS 0x5000139A /end MEASUREMENT
/begin MEASUREMENT EGSDCmn_Seg1B1LamRampLeanVirtParl_I.LamRampIKL_I.memory "Class instance: virtual lean lambda ramp / lambda ramp / Current Integrator value" ULONG fak_q3p72529Em9 1 100 0.00 15.9999999963 FORMAT "%13.10" ECU_ADDRESS 0x5000139C /end MEASUREMENT
/begin MEASUREMENT EGSDCmn_Seg1B1LamRampLeanVirtParl_I.RampEndLimIK_I.memory "Class instance: virtual lean lambda ramp / integrated exhaust gas mass flow during lambda rampe / current integrator value" ULONG m_q1p5259Em8_kg 1 100 0.00 65.5359999847 FORMAT "%13.10" ECU_ADDRESS 0x500013A0 /end MEASUREMENT
/begin MEASUREMENT EGSDCmn_Seg1B1LamRampParl_I.flgLamReq "Class instance: lambda ramp / lambda request is active" UBYTE B_TRUE 1 100 0.00 1.00000000000 BIT_MASK 0x1 FORMAT "%13.11" ECU_ADDRESS 0x6000CCE8 /end MEASUREMENT
/begin MEASUREMENT EGSDCmn_Seg1B1LamRampParl_I.flgLeanRampEnd "Class instance: lambda ramp / lean lambda ramp is expired" UBYTE B_TRUE 1 100 0.00 1.00000000000 BIT_MASK 0x1 FORMAT "%13.11" ECU_ADDRESS 0x6000CCE9 /end MEASUREMENT
/begin MEASUREMENT EGSDCmn_Seg1B1LamRampParl_I.flgRampDurEnd "Class instance: lambda ramp / lambda ramp is expired" UBYTE B_TRUE 1 100 0.00 1.00000000000 BIT_MASK 0x1 FORMAT "%13.11" ECU_ADDRESS 0x6000CCEA /end MEASUREMENT
/begin MEASUREMENT EGSDCmn_Seg1B1LamRampParl_I.flgRichRampEnd "Class instance: lambda ramp / rich lambda ramp is expired" UBYTE B_TRUE 1 100 0.00 1.00000000000 BIT_MASK 0x1 FORMAT "%13.11" ECU_ADDRESS 0x6000CCEB /end MEASUREMENT
/begin MEASUREMENT EGSDCmn_Seg1B1LamRampParl_I.ratLamReq "Class instance: lambda ramp / requested lambda" UWORD fak_uw_b16 1 100 0.00 15.99976 FORMAT "%8.5" ECU_ADDRESS 0x6000CCEC /end MEASUREMENT
/begin MEASUREMENT EGSDCmn_Seg1B1LamRampParl_I.DynErrRampTONVNM_I.time "Class instance: lambda ramp / simulation time for sensor dynamic to calculation for ramp duration / Delay Time" UWORD t_q0p01 1 100 0.00 655.3500 FORMAT "%8.4" ECU_ADDRESS 0x6000CCEE /end MEASUREMENT
/begin MEASUREMENT EGSDCmn_Seg1B1LamRampParl_I.LamRampIKL_I.memory "Class instance: lambda ramp / lambda ramp / Current Integrator value" ULONG fak_q3p72529Em9 1 100 0.00 15.9999999963 FORMAT "%13.10" ECU_ADDRESS 0x6000CCF0 /end MEASUREMENT
/begin MEASUREMENT EGSDCmn_Seg1B1LamRampParl_I.RampEndLimIK_I.memory "Class instance: lambda ramp / integrated exhaust gas mass flow during lambda rampe / current integrator value" ULONG m_q1p5259Em8_kg 1 100 0.00 65.5359999847 FORMAT "%13.10" ECU_ADDRESS 0x6000CCF4 /end MEASUREMENT
/begin MEASUREMENT EGSDCmn_Seg1B1LamRampRichVirtParl_I.flgLamReq "Class instance: virtual rich lambda ramp / lambda request is active" UBYTE B_TRUE 1 100 0.00 1.00000000000 BIT_MASK 0x1 FORMAT "%13.11" ECU_ADDRESS 0x500013A4 /end MEASUREMENT
/begin MEASUREMENT EGSDCmn_Seg1B1LamRampRichVirtParl_I.flgLeanRampEnd "Class instance: virtual rich lambda ramp / lean lambda ramp is expired" UBYTE B_TRUE 1 100 0.00 1.00000000000 BIT_MASK 0x1 FORMAT "%13.11" ECU_ADDRESS 0x500013A5 /end MEASUREMENT
/begin MEASUREMENT EGSDCmn_Seg1B1LamRampRichVirtParl_I.flgRampDurEnd "Class instance: virtual rich lambda ramp / lambda ramp is expired" UBYTE B_TRUE 1 100 0.00 1.00000000000 BIT_MASK 0x1 FORMAT "%13.11" ECU_ADDRESS 0x500013A6 /end MEASUREMENT
/begin MEASUREMENT EGSDCmn_Seg1B1LamRampRichVirtParl_I.flgRichRampEnd "Class instance: virtual rich lambda ramp / rich lambda ramp is expired" UBYTE B_TRUE 1 100 0.00 1.00000000000 BIT_MASK 0x1 FORMAT "%13.11" ECU_ADDRESS 0x500013A7 /end MEASUREMENT
/begin MEASUREMENT EGSDCmn_Seg1B1LamRampRichVirtParl_I.ratLamReq "Class instance: virtual rich lambda ramp / requested lambda" UWORD fak_uw_b16 1 100 0.00 15.99976 FORMAT "%8.5" ECU_ADDRESS 0x500013A8 /end MEASUREMENT
/begin MEASUREMENT EGSDCmn_Seg1B1LamRampRichVirtParl_I.DynErrRampTONVNM_I.time "Class instance: virtual rich lambda ramp / simulation time for sensor dynamic to calculation for ramp duration / Delay Time" UWORD t_q0p01 1 100 0.00 655.3500 FORMAT "%8.4" ECU_ADDRESS 0x500013AA /end MEASUREMENT
/begin MEASUREMENT EGSDCmn_Seg1B1LamRampRichVirtParl_I.LamRampIKL_I.memory "Class instance: virtual rich lambda ramp / lambda ramp / Current Integrator value" ULONG fak_q3p72529Em9 1 100 0.00 15.9999999963 FORMAT "%13.10" ECU_ADDRESS 0x500013AC /end MEASUREMENT
/begin MEASUREMENT EGSDCmn_Seg1B1LamRampRichVirtParl_I.RampEndLimIK_I.memory "Class instance: virtual rich lambda ramp / integrated exhaust gas mass flow during lambda rampe / current integrator value" ULONG m_q1p5259Em8_kg 1 100 0.00 65.5359999847 FORMAT "%13.10" ECU_ADDRESS 0x500013B0 /end MEASUREMENT
/begin MEASUREMENT EGSDCmn_stLamGenrParlB1 "status of state machine of lambda shifting from coordinator function of parallelization, bank 1" UBYTE dez 1 100 0.00 255.0 FORMAT "%5.1" ECU_ADDRESS 0x6000A3BE /end MEASUREMENT
/begin MEASUREMENT EGSDCmn_stVirtCatParlB1 "status of virtual lambda shifting for IUMPR simulation of catalyst diagnosis" UBYTE dez 1 100 0.00 255.0 FORMAT "%5.1" ECU_ADDRESS 0x6000A07A /end MEASUREMENT
/begin MEASUREMENT EGSDCmn_stVirtLamDynParlB1 "status of virtual lambda shifting for IUMPR simulation of Lambda signal dynamic diagnosis" UBYTE dez 1 100 0.00 255.0 FORMAT "%5.1" ECU_ADDRESS 0x6000A079 /end MEASUREMENT
/begin MEASUREMENT EGSDCmn_stVirtTarLeanOffsParlB1 "status of virtual lambda shifting for IUMPR simulation of range check of lean target sensor voltage with Lambda Offset, bank 1" UBYTE dez 1 100 0.00 255.0 FORMAT "%5.1" ECU_ADDRESS 0x6000E40A /end MEASUREMENT
/begin MEASUREMENT EGSDCmn_stVirtTarLeanParlB1 "status of virtual lambda shifting for IUMPR simulation of range check of lean target sensor voltage, bank 1" UBYTE dez 1 100 0.00 255.0 FORMAT "%5.1" ECU_ADDRESS 0x6000E40B /end MEASUREMENT
/begin MEASUREMENT EGSDCmn_stVirtTarRichOffsParlB1 "status of virtual lambda shifting for IUMPR simulation of range check of rich target sensor voltage with Lambda Offset, bank 1" UBYTE dez 1 100 0.00 255.0 FORMAT "%5.1" ECU_ADDRESS 0x6000E40C /end MEASUREMENT
/begin MEASUREMENT EGSDCmn_stVirtTarRichParlB1 "status of virtual lambda shifting for IUMPR simulation of range check of rich target sensor voltage, bank 1" UBYTE dez 1 100 0.00 255.0 FORMAT "%5.1" ECU_ADDRESS 0x6000E40D /end MEASUREMENT
/begin MEASUREMENT EGSDCmn_stVirtUDlyParlB1 "status of virtual lambda shifting for IUMPR simulation of measurement of delay time of sensor voltage, bank 1" UBYTE dez 1 100 0.00 255.0 FORMAT "%5.1" ECU_ADDRESS 0x6000A078 /end MEASUREMENT
/begin MEASUREMENT EGSDCmn_stVirtUTranParlB1 "status of virtual lambda shifting for IUMPR simulation of transition time of sensor voltage" UBYTE dez 1 100 0.00 255.0 FORMAT "%5.1" ECU_ADDRESS 0x6000A077 /end MEASUREMENT
/begin MEASUREMENT EGSDCmn_TarChkS2B1_I.flgTarLeanOK "Target check diagnosis / lean voltage reached" UBYTE B_TRUE 1 100 0.00 1.00000000000 BIT_MASK 0x1 FORMAT "%13.11" ECU_ADDRESS 0x500052C2 /end MEASUREMENT
/begin MEASUREMENT EGSDCmn_TarChkS2B1_I.flgTarRichOK "Target check diagnosis / Target sensor voltage in rich is reached" UBYTE B_TRUE 1 100 0.00 1.00000000000 BIT_MASK 0x1 FORMAT "%13.11" ECU_ADDRESS 0x500052C3 /end MEASUREMENT
/begin MEASUREMENT EGSDCmn_TarChkS2B1_I.stLamGenrParlOld "Target check diagnosis / Status of lambda shifting of parallelization (old value)" UBYTE dez 1 100 0.00 255.0 FORMAT "%5.1" ECU_ADDRESS 0x500052C4 /end MEASUREMENT
/begin MEASUREMENT EGSDCmn_TarChkS2B1_I.uCatEmptyMax "Target check diagnosis / highest reached sensor voltage" UWORD spg_q1p221Em3_V 1 100 0.00 4.998779 FORMAT "%8.6" ECU_ADDRESS 0x500052C6 /end MEASUREMENT
/begin MEASUREMENT EGSDCmn_TarChkS2B1_I.uCatFullMin "Target check diagnosis / lowest reached sensor voltage" UWORD spg_q1p221Em3_V 1 100 0.00 4.998779 FORMAT "%8.6" ECU_ADDRESS 0x500052C8 /end MEASUREMENT
/begin MEASUREMENT EGSDCmn_tiGasRtB1 "gas runtime" UWORD t_q0p1 1 100 0.00 6553.500 FORMAT "%8.3" ECU_ADDRESS 0x60003BB8 /end MEASUREMENT
/begin MEASUREMENT EGSDCmn_tiLamDynLtrParlB1 "Dynamic time of the first sensor lean to rich" UWORD t_q0p1 1 100 0.00 6553.500 FORMAT "%8.3" ECU_ADDRESS 0x60003BB6 /end MEASUREMENT
/begin MEASUREMENT EGSDCmn_tiLamDynRtlParlB1 "Dynamic time of the first sensor rich to lean" UWORD t_q0p1 1 100 0.00 6553.500 FORMAT "%8.3" ECU_ADDRESS 0x60003BB4 /end MEASUREMENT
/begin MEASUREMENT EGSDCmn_tiUS2DynLtrEvlnParlB1 "Dynamic time of the second sensor lean to rich" UWORD t_q0p1 1 100 0.00 6553.500 FORMAT "%8.3" ECU_ADDRESS 0x60003BB2 /end MEASUREMENT
/begin MEASUREMENT EGSDCmn_tiUS2DynRtlEvlnParlB1 "Dynamic time of the second sensor rich to lean" UWORD t_q0p1 1 100 0.00 6553.500 FORMAT "%8.3" ECU_ADDRESS 0x60003BB0 /end MEASUREMENT
/begin MEASUREMENT EGSDCmn_uCatEmptyGrdtParl "voltage threshold for the catalyst is empty of oxygen" UWORD spg_q1p221Em3_V 1 100 0.00 4.998779 FORMAT "%8.6" ECU_ADDRESS 0x60003BC2 /end MEASUREMENT
/begin MEASUREMENT EGSDCmn_uCatEmptyParl "voltage threshold for the catalyst is empty of oxygen" UWORD spg_q1p221Em3_V 1 100 0.00 4.998779 FORMAT "%8.6" ECU_ADDRESS 0x60003BC0 /end MEASUREMENT
/begin MEASUREMENT EGSDCmn_uCatFullGrdtParl "voltage threshold for the catalyst is full of oxygen" UWORD spg_q1p221Em3_V 1 100 0.00 4.998779 FORMAT "%8.6" ECU_ADDRESS 0x60003BBE /end MEASUREMENT
/begin MEASUREMENT EGSDCmn_uCatFullParl "voltage threshold for the catalyst is full of oxygen" UWORD spg_q1p221Em3_V 1 100 0.00 4.998779 FORMAT "%8.6" ECU_ADDRESS 0x60003BBC /end MEASUREMENT
/begin MEASUREMENT EGSDCmn_uS2B1CatEmptMaxParl "Maximum sensor voltage during lambda shifting to rich, sensor 2" UWORD spg_q1p221Em3_V 1 100 0.00 4.998779 FORMAT "%8.6" ECU_ADDRESS 0x6000E1B4 /end MEASUREMENT
/begin MEASUREMENT EGSDCmn_uS2B1CatFullMinParl "Minimum sensor voltage during lambda shifting to rich, sensor 2" UWORD spg_q1p221Em3_V 1 100 0.00 4.998779 FORMAT "%8.6" ECU_ADDRESS 0x6000E1B6 /end MEASUREMENT
/begin MEASUREMENT EGSDCmn_uS2B1Grdt_I.duSnsr "Calculation of the binary voltage gradient / voltage gradient" SWORD spgg_q0p002029_V_DIV_s 1 100 -66.50000 66.49797 FORMAT "%8.5" ECU_ADDRESS 0x500052CE /end MEASUREMENT
/begin MEASUREMENT EGSDCmn_uS2B1Grdt_I.idxInp "Calculation of the binary voltage gradient / Index" UBYTE dez 1 100 0.00 10.00 FORMAT "%5.2" ECU_ADDRESS 0x500052D0 /end MEASUREMENT
/begin MEASUREMENT EGSDCmn_uS2B1Grdt_I.idxOutp "Calculation of the binary voltage gradient / Index" UBYTE dez 1 100 0.00 10.00 FORMAT "%5.2" ECU_ADDRESS 0x500052D1 /end MEASUREMENT
/begin MEASUREMENT EGSDCmn_uS2B1Grdt_I.uOld_a "Calculation of the binary voltage gradient / old voltage value" UWORD spg_q1p221Em3_V 1 100 0.00 4.998779 FORMAT "%8.6" ARRAY_SIZE 11 ECU_ADDRESS 0x500052D2 /end MEASUREMENT
/begin MEASUREMENT EGSDCmn_uS2B1Grdt_I.FrzRiTOFFVNM_I.time "Calculation of the binary voltage gradient / Entprellung / delay time" UBYTE t_q0p01 1 100 0.00 2.550 FORMAT "%5.3" ECU_ADDRESS 0x500052E8 /end MEASUREMENT
/begin MEASUREMENT EGSDCmn_uS2B1Parl "filtered (and symmetrized, if required) sensor voltage of sensor 2, bank 1" UWORD spg_q1p221Em3_V 1 100 0.00 4.998779 FORMAT "%8.6" ECU_ADDRESS 0x60003BBA /end MEASUREMENT
/begin FUNCTION EGSDCmn_CoorrParl "1.50.0    Coordinator of parallelization of active exhaust gas sensor dynamic diagnosis and catalyst diagnosis"
 /begin DEF_CHARACTERISTIC EGSDCmn_Cat1B1Empty_I.duUMinOKParl_C EGSDCmn_Cat1B1Empty_I.mO2CatEmptyOKParl_C EGSDCmn_Cat1B1Empty_I.uCatEmptyOKParl_C EGSDCmn_duCatEmptyMaxParl_C EGSDCmn_duCatEmptyMinParl_C EGSDCmn_duCatFullMaxParl_C EGSDCmn_duCatFullMinParl_C EGSDCmn_facRampParl_C EGSDCmn_flgSymTranOnly_CW EGSDCmn_flgVltgSymc_C EGSDCmn_mCatEmptyGrdtParl_C EGSDCmn_mCatFullGrdtParl_C EGSDCmn_mEgLamWaitParl_C EGSDCmn_mErrTarLeanParl_C EGSDCmn_mErrTarRichParl_C EGSDCmn_mLamStabParl_C EGSDCmn_mO2IdnAdapnParl_C EGSDCmn_mRampDurParl_C EGSDCmn_nrMaxIdnAdpnEnd_C EGSDCmn_nrUGrdtParl_C EGSDCmn_ratLamIdnLeanParl_C EGSDCmn_ratLamIdnRichParl_C EGSDCmn_ratLamLeanParl_C EGSDCmn_ratLamLessLeanMonParl_C EGSDCmn_ratLamLessRichMonParl_C EGSDCmn_ratLamMoreLeanMonParl_C EGSDCmn_ratLamMoreRichMonParl_C EGSDCmn_ratLamRampLeanParl_C EGSDCmn_ratLamRampRichParl_C EGSDCmn_ratLamRichParl_C EGSDCmn_tiLamMonParl_C EGSDCmn_tiS1DynWrstCaseParl_C EGSDCmn_tiS2LtrDynWpaParl_C EGSDCmn_tiS2RtlDynWpaParl_C EGSDCmn_tiUCatFullParl_C EGSDCmn_tiUS2LtrParl_C EGSDCmn_tiUS2RtlParl_C EGSDCmn_tiVirtLamStabParl_C EGSDCmn_uCatEmptyGrdtParl_C EGSDCmn_uCatEmptyParl_C EGSDCmn_uCatFullGrdtParl_C EGSDCmn_uCatFullParl_C EGSDCmn_uEnaLoEnghParl_C EGSDCmn_uHiEnaParl_C /end DEF_CHARACTERISTIC
 /begin REF_CHARACTERISTIC EGSDO2_flgIdnDurgParl_CW EGSDO2_flgSeqDyn_C EGSDO2_flgLamOffsFastPreParl_CW EGSDU_tiToutLtrDly_C EGSDU_tiToutRtlDly_C TWCD_facOSCRSC_C /end REF_CHARACTERISTIC
 /begin IN_MEASUREMENT EGSDCmn_flgSeg1B1PhyEnaParl EGSDCmn_flgSeg1B1RampEnaParl EGSDCmn_flgSeg1B1ReldFinalParl EGSDCmn_flgSeg1B1VirtReldFinalParl EGSDCmn_flgShtrpParl EGSDCmn_flgTarLeanSuspcParlB1 EGSDCmn_flgTarRichSuspcParlB1 EGSDCmn_flgTarSuspcB1 EGSDCmn_flgTarSuspcVirtParlB1 EGSDCmn_mfEgCat1B1Parl EGSDCmn_mfO2Cat1B1Parl EGSDCmn_mfSeg1B1O2Parl EGSDCmn_mfSeg1B1RichParl EGSDCmn_mfSeg1B1VirtO2Parl EGSDCmn_mfSeg1B1VirtRichParl EGSDCmn_ratLamActS1B1 EGSDCmn_uS2B1FildParl EGSDO2_flgDynLtrTripDneS1B1 EGSDO2_flgDynLtrTripDneVirtS1B1 EGSDO2_flgDynRtlTripDneS1B1 EGSDO2_flgDynRtlTripDneVirtS1B1 EGSDO2_flgLamMonOkVirtB1 EGSDO2_flgLossEvlnDneB1 EGSDO2_flgQlyDeFltSuspcB1 EGSDO2_tiDlyLtrS1B1 EGSDO2_tiDlyRtlS1B1 EGSDO2_tiTranLtrS1B1 EGSDO2_tiTranRtlS1B1 EGSDU_flgS2B1AsymcFltEvln EGSDU_flgS2B1TarLeanResVirtEvln EGSDU_flgS2B1TarRichResVirtEvln EGSDU_flgS2B1TripVirtLtrDlyEvln EGSDU_flgS2B1TripVirtLtrTranEvln EGSDU_flgS2B1TripVirtRtlDlyEvln EGSDU_flgS2B1TripVirtRtlTranEvln EGSDU_tiS2B1LtrDlyEvln EGSDU_tiS2B1LtrDlySymcEvln EGSDU_tiS2B1LtrTranEvln EGSDU_tiS2B1LtrTranSymcEvln EGSDU_tiS2B1RtlDlyEvln EGSDU_tiS2B1RtlDlySymcEvln EGSDU_tiS2B1RtlTranEvln EGSDU_tiS2B1RtlTranSymcEvln HEGO_bS2B1FrzRi LamCtrl_ratLamSpNoDynS1B1 SyC_ctPostDrvLeave tlrslb_w_msg TWCC_rCtlPriB1 TWCD_flgMeasFinshdVirtTripB1 TWCD_mOscExtdCat1B1 TWCD_mOSCNrmDiumprExtdB1 TWCD_mRSCNrmDiumprExtdB1 zlrslb_w_msg /end IN_MEASUREMENT
 /begin OUT_MEASUREMENT EGSDCmn_flgB1LamNotStabParl EGSDCmn_flgCat1EmptTOutParlB1 EGSDCmn_flgCat1FullTOutParlB1 EGSDCmn_flgIdnAdpnEndParlS1B1 EGSDCmn_flgIdnAdpnEndVirtParlS1B1 EGSDCmn_flgLamReqParlB1 EGSDCmn_flgS1B1O2PlausResVirtParl EGSDCmn_flgS2B1TarLeanErrParl EGSDCmn_flgS2B1TarLeanOkOnceParl EGSDCmn_flgS2B1TarLeanResParl EGSDCmn_flgS2B1TarLeanResVirtOffsParl EGSDCmn_flgS2B1TarLeanResVirtParl EGSDCmn_flgS2B1TarRichErrParl EGSDCmn_flgS2B1TarRichOkOnceParl EGSDCmn_flgS2B1TarRichResParl EGSDCmn_flgS2B1TarRichResVirtOffsParl EGSDCmn_flgS2B1TarRichResVirtParl EGSDCmn_ratLamReqParlB1 EGSDCmn_stLamGenrParlB1 EGSDCmn_stVirtCatParlB1 EGSDCmn_stVirtLamDynParlB1 EGSDCmn_stVirtTarLeanOffsParlB1 EGSDCmn_stVirtTarLeanParlB1 EGSDCmn_stVirtTarRichOffsParlB1 EGSDCmn_stVirtTarRichParlB1 EGSDCmn_stVirtUDlyParlB1 EGSDCmn_stVirtUTranParlB1 EGSDCmn_uS2B1CatEmptMaxParl EGSDCmn_uS2B1CatFullMinParl /end OUT_MEASUREMENT
 /begin LOC_MEASUREMENT EGSDCmn_B1LamStabParlIK_I.memory EGSDCmn_Cat1B1Empty_I.flgCatEmpty EGSDCmn_Cat1B1Empty_I.flgCatEmptyOK EGSDCmn_Cat1B1Empty_I.flgCatEmptyTOut EGSDCmn_Cat1B1Empty_I.DynErrRampTONV_I.outbit EGSDCmn_Cat1B1Empty_I.DynErrRampTONV_I.time EGSDCmn_Cat1B1Empty_I.UGrdtTONV_I.outbit EGSDCmn_Cat1B1Empty_I.UGrdtTONV_I.time EGSDCmn_Cat1B1Empty_I.duUMinOKFF_I.status EGSDCmn_Cat1B1Empty_I.mO2CatEmptyOKIKL_I.memory EGSDCmn_Cat1B1Empty_I.mO2EnaCatEmptyGrdtIKL_I.memory EGSDCmn_Cat1B1Empty_I.mRSCCatCpIK_I.memory EGSDCmn_Cat1B1Empty_I.mRichPrtIKL_I.memory EGSDCmn_Cat1B1Empty_I.uSnsrGrdtFF_I.status EGSDCmn_Cat1B1Full_I.flgCatFull EGSDCmn_Cat1B1Full_I.flgCatFullTOut EGSDCmn_Cat1B1Full_I.DynErrRampTONV_I.outbit EGSDCmn_Cat1B1Full_I.DynErrRampTONV_I.time EGSDCmn_Cat1B1Full_I.UGrdtTONV_I.outbit EGSDCmn_Cat1B1Full_I.UGrdtTONV_I.time EGSDCmn_Cat1B1Full_I.mO2EnaCatFullGrdtIKL_I.memory EGSDCmn_Cat1B1Full_I.mOSCCatCpIK_I.memory EGSDCmn_Cat1B1Full_I.uSnsrGrdtFF_I.status EGSDCmn_Cat1B1Full_I.uSnsrTONV_I.outbit EGSDCmn_Cat1B1Full_I.uSnsrTONV_I.time EGSDCmn_Cat1B1VirtParl_I.flgCatEmpty EGSDCmn_Cat1B1VirtParl_I.flgCatFull EGSDCmn_Cat1B1VirtParl_I.flgDynTripDneVirt EGSDCmn_Cat1B1VirtParl_I.flgIdnAdpnEnd EGSDCmn_Cat1B1VirtParl_I.flgIdnAdpnLean EGSDCmn_Cat1B1VirtParl_I.flgIdnAdpnRich EGSDCmn_Cat1B1VirtParl_I.flgReld EGSDCmn_Cat1B1VirtParl_I.flgUHiEnaParl EGSDCmn_Cat1B1VirtParl_I.flgUMid EGSDCmn_Cat1B1VirtParl_I.flgVirtLamDyn EGSDCmn_Cat1B1VirtParl_I.mOSC EGSDCmn_Cat1B1VirtParl_I.mRSC EGSDCmn_Cat1B1VirtParl_I.mfVirtO2 EGSDCmn_Cat1B1VirtParl_I.mfVirtRich EGSDCmn_Cat1B1VirtParl_I.sm EGSDCmn_Cat1B1VirtParl_I.stLamGenr EGSDCmn_Cat1B1VirtParl_I.tiGas EGSDCmn_Cat1B1VirtParl_I.tiLamDynLtr EGSDCmn_Cat1B1VirtParl_I.tiLamDynRtl EGSDCmn_Cat1B1VirtParl_I.tiUDynLtr EGSDCmn_Cat1B1VirtParl_I.tiUDynRtl EGSDCmn_Cat1B1VirtParl_I.u EGSDCmn_Cat1B1VirtParl_I.EnaReldEF_I.buffer EGSDCmn_Cat1B1VirtParl_I.EnaReldEF_I.oldSignal EGSDCmn_Cat1B1VirtParl_I.IdnAdpnCTR_I.counter EGSDCmn_Cat1B1VirtParl_I.flgLeanLamStabTONV_I.outbit EGSDCmn_Cat1B1VirtParl_I.flgLeanLamStabTONV_I.time EGSDCmn_Cat1B1VirtParl_I.flgRichLamStabTONV_I.outbit EGSDCmn_Cat1B1VirtParl_I.flgRichLamStabTONV_I.time EGSDCmn_Cat1B1VirtParl_I.mO2EnaCatFullGrdtIK_I.memory EGSDCmn_Cat1B1VirtParl_I.mO2IdnAdpnIKL_I.memory EGSDCmn_Cat1B1VirtParl_I.mO2VirtEnaCatEmptyIK_I.memory EGSDCmn_Cat1B1VirtParl_I.tiGasRtlTONV_I.outbit EGSDCmn_Cat1B1VirtParl_I.tiGasRtlTONV_I.time EGSDCmn_Cat1B1VirtParl_I.tiUDynTONV_I.outbit EGSDCmn_Cat1B1VirtParl_I.tiUDynTONV_I.time EGSDCmn_ctReIni100msCoorrParl EGSDCmn_ctReIni10msCoorrParl EGSDCmn_flgB1LamStabParl EGSDCmn_flgB1TarLeanOk EGSDCmn_flgB1TarRichOk EGSDCmn_flgB1UHiEnaParl EGSDCmn_flgB1UMid EGSDCmn_flgDSMClrParlB1 EGSDCmn_flgS2B1TarLeanResParlER_I.buffer EGSDCmn_flgS2B1TarLeanResParlER_I.oldSignal EGSDCmn_flgS2B1TarRichResParlER_I.buffer EGSDCmn_flgS2B1TarRichResParlER_I.oldSignal EGSDCmn_flgTarLeanOkS2B1 EGSDCmn_flgTarRichOkS2B1 EGSDCmn_flgUS2B1Mid EGSDCmn_LamGenrParlB1_I.flgCat1EmptyTOut EGSDCmn_LamGenrParlB1_I.flgCat1FullTOut EGSDCmn_LamGenrParlB1_I.flgCatEmpty EGSDCmn_LamGenrParlB1_I.flgCatEmptyOK EGSDCmn_LamGenrParlB1_I.flgCatFull EGSDCmn_LamGenrParlB1_I.flgDynTripDne EGSDCmn_LamGenrParlB1_I.flgIdnAdpnEnd EGSDCmn_LamGenrParlB1_I.flgIdnAdpnLean EGSDCmn_LamGenrParlB1_I.flgIdnAdpnRich EGSDCmn_LamGenrParlB1_I.flgLamNotStab EGSDCmn_LamGenrParlB1_I.flgLamRels EGSDCmn_LamGenrParlB1_I.flgLamReq EGSDCmn_LamGenrParlB1_I.flgLamStabLean EGSDCmn_LamGenrParlB1_I.flgLamStabRich EGSDCmn_LamGenrParlB1_I.flgLeanRampEnd EGSDCmn_LamGenrParlB1_I.flgOSCTestPassd EGSDCmn_LamGenrParlB1_I.flgQlyDeFltSuspc EGSDCmn_LamGenrParlB1_I.flgRichRampEnd EGSDCmn_LamGenrParlB1_I.flgStMacReld EGSDCmn_LamGenrParlB1_I.flgTarLeanOK EGSDCmn_LamGenrParlB1_I.flgTarRichOK EGSDCmn_LamGenrParlB1_I.flgUHiEnaParl EGSDCmn_LamGenrParlB1_I.flgUMid EGSDCmn_LamGenrParlB1_I.mRampDurParl EGSDCmn_LamGenrParlB1_I.mfEg EGSDCmn_LamGenrParlB1_I.mfO2 EGSDCmn_LamGenrParlB1_I.ratLamAct EGSDCmn_LamGenrParlB1_I.ratLamCorr EGSDCmn_LamGenrParlB1_I.ratLamRampLeanParl EGSDCmn_LamGenrParlB1_I.ratLamRampRichParl EGSDCmn_LamGenrParlB1_I.ratLamReq EGSDCmn_LamGenrParlB1_I.ratLamSpNoDyn EGSDCmn_LamGenrParlB1_I.sm EGSDCmn_LamGenrParlB1_I.stLamGenr EGSDCmn_LamGenrParlB1_I.EnaReldEFNM_I.oldSignal EGSDCmn_LamGenrParlB1_I.IdnAdpnCTR_I.counter EGSDCmn_LamGenrParlB1_I.LamLeanMonTOFFV_I.outbit EGSDCmn_LamGenrParlB1_I.LamLeanMonTOFFV_I.time EGSDCmn_LamGenrParlB1_I.LamRampIKL_I.memory EGSDCmn_LamGenrParlB1_I.LamRichMonTOFFV_I.outbit EGSDCmn_LamGenrParlB1_I.LamRichMonTOFFV_I.time EGSDCmn_LamGenrParlB1_I.LamRichNotStabTONV_I.outbit EGSDCmn_LamGenrParlB1_I.LamRichNotStabTONV_I.time EGSDCmn_LamGenrParlB1_I.LamleanNotStabTONV_I.outbit EGSDCmn_LamGenrParlB1_I.LamleanNotStabTONV_I.time EGSDCmn_LamGenrParlB1_I.QlyDeFltSuspcER_I.buffer EGSDCmn_LamGenrParlB1_I.QlyDeFltSuspcER_I.oldSignal EGSDCmn_LamGenrParlB1_I.RampEndLimIK_I.memory EGSDCmn_LamGenrParlB1_I.flgOSCTestPassdFF_I.status EGSDCmn_LamGenrParlB1_I.mO2IdnAdpnIKL_I.memory EGSDCmn_LamGenrParlB1_I.mfEgLeanLamStabIK_I.memory EGSDCmn_LamGenrParlB1_I.mfEgRichLamStabIK_I.memory EGSDCmn_LamGenrParlB1_I.tiDynWpaRampTONVNM_I.time EGSDCmn_mCatEmptyGrdtParl EGSDCmn_mCatFullGrdtParl EGSDCmn_mErrTarLeanS2Parl EGSDCmn_mErrTarRichS2Parl EGSDCmn_mRampDurParl EGSDCmn_mRSCNrmVirtParlB1 EGSDCmn_ratLamRampLeanParl EGSDCmn_ratLamRampRichParl EGSDCmn_S1B1VirtLamDynParl_I.flgCatEmpty EGSDCmn_S1B1VirtLamDynParl_I.flgCatFull EGSDCmn_S1B1VirtLamDynParl_I.flgDynTripDneVirt EGSDCmn_S1B1VirtLamDynParl_I.flgIdnAdpnEnd EGSDCmn_S1B1VirtLamDynParl_I.flgIdnAdpnLean EGSDCmn_S1B1VirtLamDynParl_I.flgIdnAdpnRich EGSDCmn_S1B1VirtLamDynParl_I.flgReld EGSDCmn_S1B1VirtLamDynParl_I.flgUHiEnaParl EGSDCmn_S1B1VirtLamDynParl_I.flgUMid EGSDCmn_S1B1VirtLamDynParl_I.flgVirtLamDyn EGSDCmn_S1B1VirtLamDynParl_I.mOSC EGSDCmn_S1B1VirtLamDynParl_I.mRSC EGSDCmn_S1B1VirtLamDynParl_I.mfVirtO2 EGSDCmn_S1B1VirtLamDynParl_I.mfVirtRich EGSDCmn_S1B1VirtLamDynParl_I.sm EGSDCmn_S1B1VirtLamDynParl_I.stLamGenr EGSDCmn_S1B1VirtLamDynParl_I.tiGas EGSDCmn_S1B1VirtLamDynParl_I.tiLamDynLtr EGSDCmn_S1B1VirtLamDynParl_I.tiLamDynRtl EGSDCmn_S1B1VirtLamDynParl_I.tiUDynLtr EGSDCmn_S1B1VirtLamDynParl_I.tiUDynRtl EGSDCmn_S1B1VirtLamDynParl_I.u EGSDCmn_S1B1VirtLamDynParl_I.EnaReldEF_I.buffer EGSDCmn_S1B1VirtLamDynParl_I.EnaReldEF_I.oldSignal EGSDCmn_S1B1VirtLamDynParl_I.IdnAdpnCTR_I.counter EGSDCmn_S1B1VirtLamDynParl_I.flgLeanLamStabTONV_I.outbit EGSDCmn_S1B1VirtLamDynParl_I.flgLeanLamStabTONV_I.time EGSDCmn_S1B1VirtLamDynParl_I.flgRichLamStabTONV_I.outbit EGSDCmn_S1B1VirtLamDynParl_I.flgRichLamStabTONV_I.time EGSDCmn_S1B1VirtLamDynParl_I.mO2EnaCatFullGrdtIK_I.memory EGSDCmn_S1B1VirtLamDynParl_I.mO2IdnAdpnIKL_I.memory EGSDCmn_S1B1VirtLamDynParl_I.mO2VirtEnaCatEmptyIK_I.memory EGSDCmn_S1B1VirtLamDynParl_I.tiGasRtlTONV_I.outbit EGSDCmn_S1B1VirtLamDynParl_I.tiGasRtlTONV_I.time EGSDCmn_S1B1VirtLamDynParl_I.tiUDynTONV_I.outbit EGSDCmn_S1B1VirtLamDynParl_I.tiUDynTONV_I.time EGSDCmn_S2B1AsymcToSymc_I.flgLtrDly EGSDCmn_S2B1AsymcToSymc_I.flgLtrTran EGSDCmn_S2B1AsymcToSymc_I.flgRtlDly EGSDCmn_S2B1AsymcToSymc_I.flgRtlTran EGSDCmn_S2B1AsymcToSymc_I.flgSymcEna EGSDCmn_S2B1AsymcToSymc_I.tiLtrDlySymc EGSDCmn_S2B1AsymcToSymc_I.tiLtrTranSymc EGSDCmn_S2B1AsymcToSymc_I.tiRtlDlySymc EGSDCmn_S2B1AsymcToSymc_I.tiRtlTranSymc EGSDCmn_S2B1AsymcToSymc_I.uFildParlSymc EGSDCmn_S2B1AsymcToSymc_I.uNoSymcOld EGSDCmn_S2B1AsymcToSymc_I.USymcActvFF_I.status EGSDCmn_S2B1AsymcToSymc_I.USymcEnaER_I.buffer EGSDCmn_S2B1AsymcToSymc_I.USymcEnaER_I.oldSignal EGSDCmn_S2B1AsymcToSymc_I.uDlyDTTtopt_I.buffer EGSDCmn_S2B1AsymcToSymc_I.uDlyDTTtopt_I.counter EGSDCmn_S2B1AsymcToSymc_I.uDlyDTTtopt_I.pointer EGSDCmn_S2B1AsymcToSymc_I.uTranLT_I.memory EGSDCmn_S2B1VirtTarLeanOffsParl_I.flgCatEmptyTOut EGSDCmn_S2B1VirtTarLeanOffsParl_I.flgCatFullTOut EGSDCmn_S2B1VirtTarLeanOffsParl_I.flgReld EGSDCmn_S2B1VirtTarLeanOffsParl_I.flgTarLeanRes EGSDCmn_S2B1VirtTarLeanOffsParl_I.flgTarRich EGSDCmn_S2B1VirtTarLeanOffsParl_I.flgTarRichRes EGSDCmn_S2B1VirtTarLeanOffsParl_I.flgUHiEnaParl EGSDCmn_S2B1VirtTarLeanOffsParl_I.mOSC EGSDCmn_S2B1VirtTarLeanOffsParl_I.mRSC EGSDCmn_S2B1VirtTarLeanOffsParl_I.mRampDurParl EGSDCmn_S2B1VirtTarLeanOffsParl_I.mfEg EGSDCmn_S2B1VirtTarLeanOffsParl_I.mfVirtO2 EGSDCmn_S2B1VirtTarLeanOffsParl_I.mfVirtRich EGSDCmn_S2B1VirtTarLeanOffsParl_I.ratLamRampLeanParl EGSDCmn_S2B1VirtTarLeanOffsParl_I.ratLamRampRichParl EGSDCmn_S2B1VirtTarLeanOffsParl_I.ratLamReq EGSDCmn_S2B1VirtTarLeanOffsParl_I.sm EGSDCmn_S2B1VirtTarLeanOffsParl_I.stLamGenr EGSDCmn_S2B1VirtTarLeanOffsParl_I.tiGasRt EGSDCmn_S2B1VirtTarLeanOffsParl_I.tiLamDynLtr EGSDCmn_S2B1VirtTarLeanOffsParl_I.tiLamDynRtl EGSDCmn_S2B1VirtTarLeanOffsParl_I.tiUDynLtr EGSDCmn_S2B1VirtTarLeanOffsParl_I.tiUDynRtl EGSDCmn_S2B1VirtTarLeanOffsParl_I.EnaReldEF_I.buffer EGSDCmn_S2B1VirtTarLeanOffsParl_I.EnaReldEF_I.oldSignal EGSDCmn_S2B1VirtTarLeanOffsParl_I.LamRampIKL_I.memory EGSDCmn_S2B1VirtTarLeanOffsParl_I.RampEndLimIK_I.memory EGSDCmn_S2B1VirtTarLeanOffsParl_I.mO2EnaCatFullGrdtIK_I.memory EGSDCmn_S2B1VirtTarLeanOffsParl_I.mO2VirtEnaCatEmptyIK_I.memory EGSDCmn_S2B1VirtTarLeanOffsParl_I.tiDynWpaRampTONVNM_I.outbit EGSDCmn_S2B1VirtTarLeanOffsParl_I.tiDynWpaRampTONVNM_I.time EGSDCmn_S2B1VirtTarLeanOffsParl_I.tiLamDynTONV_I.outbit EGSDCmn_S2B1VirtTarLeanOffsParl_I.tiLamDynTONV_I.time EGSDCmn_S2B1VirtTarLeanOffsParl_I.tiUDynTONV_I.outbit EGSDCmn_S2B1VirtTarLeanOffsParl_I.tiUDynTONV_I.time EGSDCmn_S2B1VirtTarLeanParl_I.flgCatEmptyTOut EGSDCmn_S2B1VirtTarLeanParl_I.flgCatFullTOut EGSDCmn_S2B1VirtTarLeanParl_I.flgReld EGSDCmn_S2B1VirtTarLeanParl_I.flgTarLeanRes EGSDCmn_S2B1VirtTarLeanParl_I.flgTarRich EGSDCmn_S2B1VirtTarLeanParl_I.flgTarRichRes EGSDCmn_S2B1VirtTarLeanParl_I.flgUHiEnaParl EGSDCmn_S2B1VirtTarLeanParl_I.mOSC EGSDCmn_S2B1VirtTarLeanParl_I.mRSC EGSDCmn_S2B1VirtTarLeanParl_I.mRampDurParl EGSDCmn_S2B1VirtTarLeanParl_I.mfEg EGSDCmn_S2B1VirtTarLeanParl_I.mfVirtO2 EGSDCmn_S2B1VirtTarLeanParl_I.mfVirtRich EGSDCmn_S2B1VirtTarLeanParl_I.ratLamRampLeanParl EGSDCmn_S2B1VirtTarLeanParl_I.ratLamRampRichParl EGSDCmn_S2B1VirtTarLeanParl_I.ratLamReq EGSDCmn_S2B1VirtTarLeanParl_I.sm EGSDCmn_S2B1VirtTarLeanParl_I.stLamGenr EGSDCmn_S2B1VirtTarLeanParl_I.tiGasRt EGSDCmn_S2B1VirtTarLeanParl_I.tiLamDynLtr EGSDCmn_S2B1VirtTarLeanParl_I.tiLamDynRtl EGSDCmn_S2B1VirtTarLeanParl_I.tiUDynLtr EGSDCmn_S2B1VirtTarLeanParl_I.tiUDynRtl EGSDCmn_S2B1VirtTarLeanParl_I.EnaReldEF_I.buffer EGSDCmn_S2B1VirtTarLeanParl_I.EnaReldEF_I.oldSignal EGSDCmn_S2B1VirtTarLeanParl_I.LamRampIKL_I.memory EGSDCmn_S2B1VirtTarLeanParl_I.RampEndLimIK_I.memory EGSDCmn_S2B1VirtTarLeanParl_I.mO2EnaCatFullGrdtIK_I.memory EGSDCmn_S2B1VirtTarLeanParl_I.mO2VirtEnaCatEmptyIK_I.memory EGSDCmn_S2B1VirtTarLeanParl_I.tiDynWpaRampTONVNM_I.outbit EGSDCmn_S2B1VirtTarLeanParl_I.tiDynWpaRampTONVNM_I.time EGSDCmn_S2B1VirtTarLeanParl_I.tiLamDynTONV_I.outbit EGSDCmn_S2B1VirtTarLeanParl_I.tiLamDynTONV_I.time EGSDCmn_S2B1VirtTarLeanParl_I.tiUDynTONV_I.outbit EGSDCmn_S2B1VirtTarLeanParl_I.tiUDynTONV_I.time EGSDCmn_S2B1VirtTarRichOffsParl_I.flgCatEmptyTOut EGSDCmn_S2B1VirtTarRichOffsParl_I.flgCatFullTOut EGSDCmn_S2B1VirtTarRichOffsParl_I.flgReld EGSDCmn_S2B1VirtTarRichOffsParl_I.flgTarLeanRes EGSDCmn_S2B1VirtTarRichOffsParl_I.flgTarRich EGSDCmn_S2B1VirtTarRichOffsParl_I.flgTarRichRes EGSDCmn_S2B1VirtTarRichOffsParl_I.flgUHiEnaParl EGSDCmn_S2B1VirtTarRichOffsParl_I.mOSC EGSDCmn_S2B1VirtTarRichOffsParl_I.mRSC EGSDCmn_S2B1VirtTarRichOffsParl_I.mRampDurParl EGSDCmn_S2B1VirtTarRichOffsParl_I.mfEg EGSDCmn_S2B1VirtTarRichOffsParl_I.mfVirtO2 EGSDCmn_S2B1VirtTarRichOffsParl_I.mfVirtRich EGSDCmn_S2B1VirtTarRichOffsParl_I.ratLamRampLeanParl EGSDCmn_S2B1VirtTarRichOffsParl_I.ratLamRampRichParl EGSDCmn_S2B1VirtTarRichOffsParl_I.ratLamReq EGSDCmn_S2B1VirtTarRichOffsParl_I.sm EGSDCmn_S2B1VirtTarRichOffsParl_I.stLamGenr EGSDCmn_S2B1VirtTarRichOffsParl_I.tiGasRt EGSDCmn_S2B1VirtTarRichOffsParl_I.tiLamDynLtr EGSDCmn_S2B1VirtTarRichOffsParl_I.tiLamDynRtl EGSDCmn_S2B1VirtTarRichOffsParl_I.tiUDynLtr EGSDCmn_S2B1VirtTarRichOffsParl_I.tiUDynRtl EGSDCmn_S2B1VirtTarRichOffsParl_I.EnaReldEF_I.buffer EGSDCmn_S2B1VirtTarRichOffsParl_I.EnaReldEF_I.oldSignal EGSDCmn_S2B1VirtTarRichOffsParl_I.LamRampIKL_I.memory EGSDCmn_S2B1VirtTarRichOffsParl_I.RampEndLimIK_I.memory EGSDCmn_S2B1VirtTarRichOffsParl_I.mO2EnaCatFullGrdtIK_I.memory EGSDCmn_S2B1VirtTarRichOffsParl_I.mO2VirtEnaCatEmptyIK_I.memory EGSDCmn_S2B1VirtTarRichOffsParl_I.tiDynWpaRampTONVNM_I.outbit EGSDCmn_S2B1VirtTarRichOffsParl_I.tiDynWpaRampTONVNM_I.time EGSDCmn_S2B1VirtTarRichOffsParl_I.tiLamDynTONV_I.outbit EGSDCmn_S2B1VirtTarRichOffsParl_I.tiLamDynTONV_I.time EGSDCmn_S2B1VirtTarRichOffsParl_I.tiUDynTONV_I.outbit EGSDCmn_S2B1VirtTarRichOffsParl_I.tiUDynTONV_I.time EGSDCmn_S2B1VirtTarRichParl_I.flgCatEmptyTOut EGSDCmn_S2B1VirtTarRichParl_I.flgCatFullTOut EGSDCmn_S2B1VirtTarRichParl_I.flgReld EGSDCmn_S2B1VirtTarRichParl_I.flgTarLeanRes EGSDCmn_S2B1VirtTarRichParl_I.flgTarRich EGSDCmn_S2B1VirtTarRichParl_I.flgTarRichRes EGSDCmn_S2B1VirtTarRichParl_I.flgUHiEnaParl EGSDCmn_S2B1VirtTarRichParl_I.mOSC EGSDCmn_S2B1VirtTarRichParl_I.mRSC EGSDCmn_S2B1VirtTarRichParl_I.mRampDurParl EGSDCmn_S2B1VirtTarRichParl_I.mfEg EGSDCmn_S2B1VirtTarRichParl_I.mfVirtO2 EGSDCmn_S2B1VirtTarRichParl_I.mfVirtRich EGSDCmn_S2B1VirtTarRichParl_I.ratLamRampLeanParl EGSDCmn_S2B1VirtTarRichParl_I.ratLamRampRichParl EGSDCmn_S2B1VirtTarRichParl_I.ratLamReq EGSDCmn_S2B1VirtTarRichParl_I.sm EGSDCmn_S2B1VirtTarRichParl_I.stLamGenr EGSDCmn_S2B1VirtTarRichParl_I.tiGasRt EGSDCmn_S2B1VirtTarRichParl_I.tiLamDynLtr EGSDCmn_S2B1VirtTarRichParl_I.tiLamDynRtl EGSDCmn_S2B1VirtTarRichParl_I.tiUDynLtr EGSDCmn_S2B1VirtTarRichParl_I.tiUDynRtl EGSDCmn_S2B1VirtTarRichParl_I.EnaReldEF_I.buffer EGSDCmn_S2B1VirtTarRichParl_I.EnaReldEF_I.oldSignal EGSDCmn_S2B1VirtTarRichParl_I.LamRampIKL_I.memory EGSDCmn_S2B1VirtTarRichParl_I.RampEndLimIK_I.memory EGSDCmn_S2B1VirtTarRichParl_I.mO2EnaCatFullGrdtIK_I.memory EGSDCmn_S2B1VirtTarRichParl_I.mO2VirtEnaCatEmptyIK_I.memory EGSDCmn_S2B1VirtTarRichParl_I.tiDynWpaRampTONVNM_I.outbit EGSDCmn_S2B1VirtTarRichParl_I.tiDynWpaRampTONVNM_I.time EGSDCmn_S2B1VirtTarRichParl_I.tiLamDynTONV_I.outbit EGSDCmn_S2B1VirtTarRichParl_I.tiLamDynTONV_I.time EGSDCmn_S2B1VirtTarRichParl_I.tiUDynTONV_I.outbit EGSDCmn_S2B1VirtTarRichParl_I.tiUDynTONV_I.time EGSDCmn_S2B1VirtUDlyParl_I.flgCatEmpty EGSDCmn_S2B1VirtUDlyParl_I.flgCatFull EGSDCmn_S2B1VirtUDlyParl_I.flgDynTripDneVirt EGSDCmn_S2B1VirtUDlyParl_I.flgIdnAdpnEnd EGSDCmn_S2B1VirtUDlyParl_I.flgIdnAdpnLean EGSDCmn_S2B1VirtUDlyParl_I.flgIdnAdpnRich EGSDCmn_S2B1VirtUDlyParl_I.flgReld EGSDCmn_S2B1VirtUDlyParl_I.flgUHiEnaParl EGSDCmn_S2B1VirtUDlyParl_I.flgUMid EGSDCmn_S2B1VirtUDlyParl_I.flgVirtLamDyn EGSDCmn_S2B1VirtUDlyParl_I.mOSC EGSDCmn_S2B1VirtUDlyParl_I.mRSC EGSDCmn_S2B1VirtUDlyParl_I.mfVirtO2 EGSDCmn_S2B1VirtUDlyParl_I.mfVirtRich EGSDCmn_S2B1VirtUDlyParl_I.sm EGSDCmn_S2B1VirtUDlyParl_I.stLamGenr EGSDCmn_S2B1VirtUDlyParl_I.tiGas EGSDCmn_S2B1VirtUDlyParl_I.tiLamDynLtr EGSDCmn_S2B1VirtUDlyParl_I.tiLamDynRtl EGSDCmn_S2B1VirtUDlyParl_I.tiUDynLtr EGSDCmn_S2B1VirtUDlyParl_I.tiUDynRtl EGSDCmn_S2B1VirtUDlyParl_I.u EGSDCmn_S2B1VirtUDlyParl_I.EnaReldEF_I.buffer EGSDCmn_S2B1VirtUDlyParl_I.EnaReldEF_I.oldSignal EGSDCmn_S2B1VirtUDlyParl_I.IdnAdpnCTR_I.counter EGSDCmn_S2B1VirtUDlyParl_I.flgLeanLamStabTONV_I.outbit EGSDCmn_S2B1VirtUDlyParl_I.flgLeanLamStabTONV_I.time EGSDCmn_S2B1VirtUDlyParl_I.flgRichLamStabTONV_I.outbit EGSDCmn_S2B1VirtUDlyParl_I.flgRichLamStabTONV_I.time EGSDCmn_S2B1VirtUDlyParl_I.mO2EnaCatFullGrdtIK_I.memory EGSDCmn_S2B1VirtUDlyParl_I.mO2IdnAdpnIKL_I.memory EGSDCmn_S2B1VirtUDlyParl_I.mO2VirtEnaCatEmptyIK_I.memory EGSDCmn_S2B1VirtUDlyParl_I.tiGasRtlTONV_I.outbit EGSDCmn_S2B1VirtUDlyParl_I.tiGasRtlTONV_I.time EGSDCmn_S2B1VirtUDlyParl_I.tiUDynTONV_I.outbit EGSDCmn_S2B1VirtUDlyParl_I.tiUDynTONV_I.time EGSDCmn_S2B1VirtUTranParl_I.flgCatEmpty EGSDCmn_S2B1VirtUTranParl_I.flgCatFull EGSDCmn_S2B1VirtUTranParl_I.flgDynTripDneVirt EGSDCmn_S2B1VirtUTranParl_I.flgIdnAdpnEnd EGSDCmn_S2B1VirtUTranParl_I.flgIdnAdpnLean EGSDCmn_S2B1VirtUTranParl_I.flgIdnAdpnRich EGSDCmn_S2B1VirtUTranParl_I.flgReld EGSDCmn_S2B1VirtUTranParl_I.flgUHiEnaParl EGSDCmn_S2B1VirtUTranParl_I.flgUMid EGSDCmn_S2B1VirtUTranParl_I.flgVirtLamDyn EGSDCmn_S2B1VirtUTranParl_I.mOSC EGSDCmn_S2B1VirtUTranParl_I.mRSC EGSDCmn_S2B1VirtUTranParl_I.mfVirtO2 EGSDCmn_S2B1VirtUTranParl_I.mfVirtRich EGSDCmn_S2B1VirtUTranParl_I.sm EGSDCmn_S2B1VirtUTranParl_I.stLamGenr EGSDCmn_S2B1VirtUTranParl_I.tiGas EGSDCmn_S2B1VirtUTranParl_I.tiLamDynLtr EGSDCmn_S2B1VirtUTranParl_I.tiLamDynRtl EGSDCmn_S2B1VirtUTranParl_I.tiUDynLtr EGSDCmn_S2B1VirtUTranParl_I.tiUDynRtl EGSDCmn_S2B1VirtUTranParl_I.u EGSDCmn_S2B1VirtUTranParl_I.EnaReldEF_I.buffer EGSDCmn_S2B1VirtUTranParl_I.EnaReldEF_I.oldSignal EGSDCmn_S2B1VirtUTranParl_I.IdnAdpnCTR_I.counter EGSDCmn_S2B1VirtUTranParl_I.flgLeanLamStabTONV_I.outbit EGSDCmn_S2B1VirtUTranParl_I.flgLeanLamStabTONV_I.time EGSDCmn_S2B1VirtUTranParl_I.flgRichLamStabTONV_I.outbit EGSDCmn_S2B1VirtUTranParl_I.flgRichLamStabTONV_I.time EGSDCmn_S2B1VirtUTranParl_I.mO2EnaCatFullGrdtIK_I.memory EGSDCmn_S2B1VirtUTranParl_I.mO2IdnAdpnIKL_I.memory EGSDCmn_S2B1VirtUTranParl_I.mO2VirtEnaCatEmptyIK_I.memory EGSDCmn_S2B1VirtUTranParl_I.tiGasRtlTONV_I.outbit EGSDCmn_S2B1VirtUTranParl_I.tiGasRtlTONV_I.time EGSDCmn_S2B1VirtUTranParl_I.tiUDynTONV_I.outbit EGSDCmn_S2B1VirtUTranParl_I.tiUDynTONV_I.time EGSDCmn_Seg1B1LamRampLeanVirtParl_I.flgLamReq EGSDCmn_Seg1B1LamRampLeanVirtParl_I.flgLeanRampEnd EGSDCmn_Seg1B1LamRampLeanVirtParl_I.flgRampDurEnd EGSDCmn_Seg1B1LamRampLeanVirtParl_I.flgRichRampEnd EGSDCmn_Seg1B1LamRampLeanVirtParl_I.ratLamReq EGSDCmn_Seg1B1LamRampLeanVirtParl_I.DynErrRampTONVNM_I.time EGSDCmn_Seg1B1LamRampLeanVirtParl_I.LamRampIKL_I.memory EGSDCmn_Seg1B1LamRampLeanVirtParl_I.RampEndLimIK_I.memory EGSDCmn_Seg1B1LamRampParl_I.flgLamReq EGSDCmn_Seg1B1LamRampParl_I.flgLeanRampEnd EGSDCmn_Seg1B1LamRampParl_I.flgRampDurEnd EGSDCmn_Seg1B1LamRampParl_I.flgRichRampEnd EGSDCmn_Seg1B1LamRampParl_I.ratLamReq EGSDCmn_Seg1B1LamRampParl_I.DynErrRampTONVNM_I.time EGSDCmn_Seg1B1LamRampParl_I.LamRampIKL_I.memory EGSDCmn_Seg1B1LamRampParl_I.RampEndLimIK_I.memory EGSDCmn_Seg1B1LamRampRichVirtParl_I.flgLamReq EGSDCmn_Seg1B1LamRampRichVirtParl_I.flgLeanRampEnd EGSDCmn_Seg1B1LamRampRichVirtParl_I.flgRampDurEnd EGSDCmn_Seg1B1LamRampRichVirtParl_I.flgRichRampEnd EGSDCmn_Seg1B1LamRampRichVirtParl_I.ratLamReq EGSDCmn_Seg1B1LamRampRichVirtParl_I.DynErrRampTONVNM_I.time EGSDCmn_Seg1B1LamRampRichVirtParl_I.LamRampIKL_I.memory EGSDCmn_Seg1B1LamRampRichVirtParl_I.RampEndLimIK_I.memory EGSDCmn_TarChkS2B1_I.flgTarLeanOK EGSDCmn_TarChkS2B1_I.flgTarRichOK EGSDCmn_TarChkS2B1_I.stLamGenrParlOld EGSDCmn_TarChkS2B1_I.uCatEmptyMax EGSDCmn_TarChkS2B1_I.uCatFullMin EGSDCmn_tiGasRtB1 EGSDCmn_tiLamDynLtrParlB1 EGSDCmn_tiLamDynRtlParlB1 EGSDCmn_tiUS2DynLtrEvlnParlB1 EGSDCmn_tiUS2DynRtlEvlnParlB1 EGSDCmn_uCatEmptyGrdtParl EGSDCmn_uCatEmptyParl EGSDCmn_uCatFullGrdtParl EGSDCmn_uCatFullParl EGSDCmn_uS2B1Grdt_I.duSnsr EGSDCmn_uS2B1Grdt_I.idxInp EGSDCmn_uS2B1Grdt_I.idxOutp EGSDCmn_uS2B1Grdt_I.uOld_a EGSDCmn_uS2B1Grdt_I.FrzRiTOFFVNM_I.time EGSDCmn_uS2B1Parl /end LOC_MEASUREMENT
 FUNCTION_VERSION "1.50.0" /end FUNCTION
/begin COMPU_METHOD B_TRUE "" TAB_VERB "%6.3" "" COMPU_TAB_REF B_TRUE /end COMPU_METHOD
/begin COMPU_VTAB B_TRUE "" TAB_VERB 2 0 "FALSE" 1 "TRUE" /end COMPU_VTAB
/begin COMPU_METHOD dez "" RAT_FUNC "%6.2" "" COEFFS 0 1 0 0 0 1 /end COMPU_METHOD
/begin COMPU_METHOD EGSDCmn_LamGenrParl_sm_VERB "" TAB_VERB "%6.3" "" COMPU_TAB_REF EGSDCmn_LamGenrParl_sm_VERB /end COMPU_METHOD
/begin COMPU_VTAB EGSDCmn_LamGenrParl_sm_VERB "" TAB_VERB 8 0 "_0_Inactive" 1 "_1_InpCatEmptyCdng" 2 "_2_InpCatFullCdng" 3 "_3_TarCatFull" 4 "_4_TarCatEmpty" 5 "_6_LamRich" 6 "_7_LamLean" 7 "_99_hintergrund" /end COMPU_VTAB
/begin COMPU_METHOD EGSDCmn_VirtLamGenrParl_sm_VERB "" TAB_VERB "%6.3" "" COMPU_TAB_REF EGSDCmn_VirtLamGenrParl_sm_VERB /end COMPU_METHOD
/begin COMPU_VTAB EGSDCmn_VirtLamGenrParl_sm_VERB "" TAB_VERB 8 0 "_0_InactiveV" 1 "_1_InpCatEmptyCdngV" 2 "_2_InpCatFullCdngV" 3 "_3_TarCatFullV" 4 "_4_TarCatEmptyV" 5 "_6_LamRichV" 6 "_7_LamLeanV" 7 "_99_hintergrundV" /end COMPU_VTAB
/begin COMPU_METHOD EGSDCmn_VirtTarPlausParl_sm_VERB "" TAB_VERB "%6.3" "" COMPU_TAB_REF EGSDCmn_VirtTarPlausParl_sm_VERB /end COMPU_METHOD
/begin COMPU_VTAB EGSDCmn_VirtTarPlausParl_sm_VERB "" TAB_VERB 6 0 "_0_Inactive_V" 1 "_1_InpCatEmptyCdng_V" 2 "_2_InpCatFullCdng_V" 3 "_3_TarCatFull_V" 4 "_4_TarCatEmpty_V" 5 "_99_hintergrund_V" /end COMPU_VTAB
/begin COMPU_METHOD EXHMOD_B1B2SYM_SC_Compu "" TAB_VERB "%6.3" "" COMPU_TAB_REF EXHMOD_B1B2SYM_SC_Compu /end COMPU_METHOD
/begin COMPU_VTAB EXHMOD_B1B2SYM_SC_Compu "" TAB_VERB 2 0 "False" 1 "True" /end COMPU_VTAB
/begin COMPU_METHOD EXHMOD_BASCONLY_SC_Compu "" TAB_VERB "%6.3" "" COMPU_TAB_REF EXHMOD_BASCONLY_SC_Compu /end COMPU_METHOD
/begin COMPU_VTAB EXHMOD_BASCONLY_SC_Compu "" TAB_VERB 2 0 "False" 1 "True" /end COMPU_VTAB
/begin COMPU_METHOD EXHMOD_CALCNPDSLSTCAT_SC_Compu "" TAB_VERB "%6.3" "" COMPU_TAB_REF EXHMOD_CALCNPDSLSTCAT_SC_Compu /end COMPU_METHOD
/begin COMPU_VTAB EXHMOD_CALCNPDSLSTCAT_SC_Compu "" TAB_VERB 2 0 "calculation_disabled" 1 "calculation_enabled" /end COMPU_VTAB
/begin COMPU_METHOD fak_q0p000244 "" RAT_FUNC "%6.5" "-" COEFFS 0 65536 0 0 0 16 /end COMPU_METHOD
/begin COMPU_METHOD fak_q3p0518Em5 "" RAT_FUNC "%7.6" "" COEFFS 0 32768 0 0 0 1 /end COMPU_METHOD
/begin COMPU_METHOD fak_q3p72529Em9 "" RAT_FUNC "%11.10" "" COEFFS 0 268435456 0 0 0 1 /end COMPU_METHOD
/begin COMPU_METHOD fak_uw_b16 "" RAT_FUNC "%6.5" "-" COEFFS 0 65536 0 0 0 16 /end COMPU_METHOD
/begin COMPU_METHOD fak_uw_b2 "" RAT_FUNC "%7.6" "-" COEFFS 0 65536 0 0 0 2 /end COMPU_METHOD
/begin COMPU_METHOD k10ms_uw_b100 "" RAT_FUNC "%6.4" "1/s" COEFFS 0 65536 0 0 0 100 /end COMPU_METHOD
/begin COMPU_METHOD mgrad_q1_mgdivs "" RAT_FUNC "%6.2" "mg/s" COEFFS 0 1 0 0 0 1 /end COMPU_METHOD
/begin COMPU_METHOD m_q0p001_kg "" RAT_FUNC "%6.5" "kg" COEFFS 0 1000 0 0 0 1 /end COMPU_METHOD
/begin COMPU_METHOD m_q0p1 "" RAT_FUNC "%6.3" "kg/h" COEFFS 0 10 0 0 0 1 /end COMPU_METHOD
/begin COMPU_METHOD m_q0p1_mg "" RAT_FUNC "%6.3" "mg" COEFFS 0 1 0 0 0 0.1 /end COMPU_METHOD
/begin COMPU_METHOD m_q1p5259Em8_kg "" RAT_FUNC "%10.9" "kg" COEFFS 0 65536000 0 0 0 1 /end COMPU_METHOD
/begin COMPU_METHOD m_q1_mg "" RAT_FUNC "%6.2" "mg" COEFFS 0 1 0 0 0 1 /end COMPU_METHOD
/begin COMPU_METHOD OneToOne "" RAT_FUNC "%6.2" "-" COEFFS 0 1 0 0 0 1 /end COMPU_METHOD
/begin COMPU_METHOD spgg_q0p002029_V_DIV_s "" RAT_FUNC "%6.4" "V/s" COEFFS 0 65536 0 0 0 133 /end COMPU_METHOD
/begin COMPU_METHOD spg_q1p221Em3_V "" RAT_FUNC "%6.4" "V" COEFFS 0 65536 0 0 0 80 /end COMPU_METHOD
/begin COMPU_METHOD spg_q1p8626Em8_V "" RAT_FUNC "%10.9" "V" COEFFS 0 268435456 0 0 0 5 /end COMPU_METHOD
/begin COMPU_METHOD t_q0p01 "" RAT_FUNC "%6.4" "s" COEFFS 0 100 0 0 0 1 /end COMPU_METHOD
/begin COMPU_METHOD t_q0p1 "" RAT_FUNC "%6.3" "s" COEFFS 0 10 0 0 0 1 /end COMPU_METHOD
/begin RECORD_LAYOUT RB_Val_Wr32 FNC_VALUES 1 FLOAT32_IEEE COLUMN_DIR DIRECT /end RECORD_LAYOUT
/begin RECORD_LAYOUT RB_Val_Ws16 FNC_VALUES 1 SWORD COLUMN_DIR DIRECT /end RECORD_LAYOUT
/begin RECORD_LAYOUT RB_Val_Wu16 FNC_VALUES 1 UWORD COLUMN_DIR DIRECT /end RECORD_LAYOUT
/begin RECORD_LAYOUT RB_Val_Wu8 FNC_VALUES 1 UBYTE COLUMN_DIR DIRECT /end RECORD_LAYOUT
/end MODULE
/end PROJECT
