ASAP2_VERSION 1 60
/begin PROJECT MG1CA020 "MG1CA020"
/begin HEADER "" VERSION "MG1CA020_6SAY_V011_TPROT" PROJECT_NO MG1CA020 /end HEADER
/begin MODULE DIM ""
/begin MOD_COMMON "" BYTE_ORDER MSB_LAST ALIGNMENT_BYTE 1 ALIGNMENT_WORD 2 ALIGNMENT_LONG 4 ALIGNMENT_INT64 4 ALIGNMENT_FLOAT32_IEEE 4 ALIGNMENT_FLOAT64_IEEE 4 DATA_SIZE 32 /end MOD_COMMON
/begin CHARACTERISTIC Com_dIDASBMaxDiff_C "Frame Length of IDASB Frame" VALUE 0x8053B154 Val_Wu8 255.0 OneToOne 0.00 255.0 FORMAT "%5.1" /end CHARACTERISTIC
/begin CHARACTERISTIC Com_dIDASBMaxPer_C "Period for IDASB frame." VALUE 0x8053B155 Val_Wu8 255.0 OneToOne 0.00 255.0 FORMAT "%5.1" /end CHARACTERISTIC
/begin CHARACTERISTIC Com_stISABasSpd_C "ISA Base Speed Status Calibration" VALUE 0x8053B156 Val_Wu8 255.0 OneToOne 0.00 255.0 FORMAT "%5.1" /end CHARACTERISTIC
/begin CHARACTERISTIC CWKHMR "codeword for catalyst heating torque reserve" VALUE 0x80525D3E RB_Val_Wu16 65535.00 dez 0.00 65535.00 FORMAT "%8.2" /end CHARACTERISTIC
/begin CHARACTERISTIC CWKRDYE "code word for function KRDY (knock control dynamic)" VALUE 0x8052695C RB_Val_Wu8 255.0 dez 0.00 255.0 FORMAT "%5.1" /end CHARACTERISTIC
/begin CHARACTERISTIC CWVEVKRA "Codeword for restoring the variables of KRADAP before calculation" VALUE 0x8052694C RB_Val_Wu8 255.0 dez 0.00 255.0 FORMAT "%5.1" /end CHARACTERISTIC
/begin CHARACTERISTIC CWZUEAB "codeword ignition off" VALUE 0x80525C20 Val_Wu8 255.0 OneToOne 0.00 255.0 FORMAT "%5.1" /end CHARACTERISTIC
/begin CHARACTERISTIC DYADMAX "Knock control: max. retard of dynamic response" VAL_BLK 0x8052695D RB_ValA_Ws8 191.3 kw_q0p75 -96.00 95.25 FORMAT "%5.2" NUMBER 5 /end CHARACTERISTIC
/begin CHARACTERISTIC DYADS "additional retarding per cycle through adaptationat dynamics" VALUE 0x80526962 RB_Val_Ws8 24.00 kw_q0p75 -24.00 0.00 FORMAT "%5.2" EXTENDED_LIMITS -96.00 95.25 /end CHARACTERISTIC
/begin CHARACTERISTIC DYAFVS "advance step for deactivation of dynamic response" VALUE 0x80526963 RB_Val_Ws8 24.00 kw_q0p75 0.00 24.00 FORMAT "%5.2" EXTENDED_LIMITS -96.00 95.25 /end CHARACTERISTIC
/begin CHARACTERISTIC DYAMNV "min. value of dynamic response derivation" VALUE 0x80526964 RB_Val_Ws8 24.00 kw_q0p75 -24.00 0.00 FORMAT "%5.2" EXTENDED_LIMITS -96.00 95.25 /end CHARACTERISTIC
/begin CHARACTERISTIC ExhMgT_effCatHeatgLimMax_C "maximum limitation of the desired engine efficiency for catalyst heating" VALUE 0x80525D40 RB_Val_Ws16 3.999939 fak_sw_b2 -2.000000 1.999939 FORMAT "%8.6" /end CHARACTERISTIC
/begin CHARACTERISTIC ExhMgT_effCatHeatgLimMin_C "minimum limitation of the desired engine efficiency for catalyst heating" VALUE 0x80525D42 RB_Val_Ws16 3.999939 fak_sw_b2 -2.000000 1.999939 FORMAT "%8.6" /end CHARACTERISTIC
/begin CHARACTERISTIC ExhMgt_etaCatHeatgIdleMod_M "limitation of worsening of engine efficiency in case of a request for catalyst warming in idle" MAP 0x80525D44 RB_Map_S16U16_U16 1.999969 fak_uw_b2 0.00 1.999969 FORMAT "%8.6"
 /begin AXIS_DESCR STD_AXIS Epm_nEng EngN 3 -16384.00 16383.50 FORMAT "%8.2" DEPOSIT ABSOLUTE /end AXIS_DESCR
 /begin AXIS_DESCR STD_AXIS AirMod_ratChrgAirCyl rel_uw_q0p0234 3 0.00 1535.977 FORMAT "%8.3" DEPOSIT ABSOLUTE /end AXIS_DESCR
/end CHARACTERISTIC
/begin CHARACTERISTIC ExhMgt_etaCatHeatgPartLoadMod_M "limitation of worsening of engine efficiency in case of a request for catalyst warming in part load" MAP 0x80525D66 RB_Map_S16U16_U16 1.999969 fak_uw_b2 0.00 1.999969 FORMAT "%8.6"
 /begin AXIS_DESCR STD_AXIS Epm_nEng EngN 3 -16384.00 16383.50 FORMAT "%8.2" DEPOSIT ABSOLUTE /end AXIS_DESCR
 /begin AXIS_DESCR STD_AXIS AirMod_ratChrgAirCyl rel_uw_q0p0234 3 0.00 1535.977 FORMAT "%8.3" DEPOSIT ABSOLUTE /end AXIS_DESCR
/end CHARACTERISTIC
/begin CHARACTERISTIC ExhMgT_etaCatWrmIdleGearEngd_GM "map for desired engine efficiency for catalyst warming in idle with automatic gear box" MAP 0x80525D88 RB_MapGroup_U16 1.999969 fak_uw_b2 0.00 1.999969 FORMAT "%8.6"
 /begin AXIS_DESCR COM_AXIS NO_INPUT_QUANTITY rel_uw_b100 10 0.00 99.99847 FORMAT "%8.5" AXIS_PTS_REF SMG10KHUW /end AXIS_DESCR
 /begin AXIS_DESCR COM_AXIS Epm_nEng EngN 12 -16384.00 16383.50 FORMAT "%8.2" AXIS_PTS_REF SNM12KHUW /end AXIS_DESCR
/end CHARACTERISTIC
/begin CHARACTERISTIC ExhMgT_etaCatWrmIdle_GM "map for desired engine efficiency in case of catalyst warming in idle" MAP 0x80525E78 RB_MapGroup_U16 1.999969 fak_uw_b2 0.00 1.999969 FORMAT "%8.6"
 /begin AXIS_DESCR COM_AXIS NO_INPUT_QUANTITY rel_uw_b100 10 0.00 99.99847 FORMAT "%8.5" AXIS_PTS_REF SMG10KHUW /end AXIS_DESCR
 /begin AXIS_DESCR COM_AXIS Epm_nEng EngN 12 -16384.00 16383.50 FORMAT "%8.2" AXIS_PTS_REF SNM12KHUW /end AXIS_DESCR
/end CHARACTERISTIC
/begin CHARACTERISTIC ExhMgT_etaCatWrmPartLoad_GM "map for desired engine efficiency in case of catalyst warming during part load" MAP 0x80525F68 RB_MapGroup_U16 1.999969 fak_uw_b2 0.00 1.999969 FORMAT "%8.6"
 /begin AXIS_DESCR COM_AXIS NO_INPUT_QUANTITY rel_uw_b100 10 0.00 99.99847 FORMAT "%8.5" AXIS_PTS_REF SMG10KHUW /end AXIS_DESCR
 /begin AXIS_DESCR COM_AXIS Epm_nEng EngN 12 -16384.00 16383.50 FORMAT "%8.2" AXIS_PTS_REF SNM12KHUW /end AXIS_DESCR
/end CHARACTERISTIC
/begin CHARACTERISTIC ExhMgT_facCorrnEffOil_M "factor for correction of required worsening of engine efficiency for cold start catalyst heating in dependence of oil temperature and catalyst heat progress" MAP 0x80526058 RB_Map_S16U16_U16 1.992188 fak_ub_b2 0.00 1.992188 FORMAT "%8.6" EXTENDED_LIMITS 0.00 511.9922
 /begin AXIS_DESCR STD_AXIS ExhMgT_tOilMdlCatHeatg Temp_Cels 8 -3549.940 3003.560 FORMAT "%8.3" DEPOSIT ABSOLUTE /end AXIS_DESCR
 /begin AXIS_DESCR STD_AXIS ExhMgT_facCatHeatgProgs fak_uw_b1 8 0.00 0.9999847 FORMAT "%9.7" DEPOSIT ABSOLUTE /end AXIS_DESCR
/end CHARACTERISTIC
/begin CHARACTERISTIC ExhMgT_facEngEffTStrt_M "control factor for desired engine efficiency by catalyst heating in case of cold start in dependence of the engine temperature at start and of therelative amount of integrated air mass" MAP 0x805260FC RB_Map_S16U16_U16 1.992188 fak_ub_b2 0.00 1.992188 FORMAT "%8.6" EXTENDED_LIMITS 0.00 511.9922
 /begin AXIS_DESCR STD_AXIS ExhMgT_tEngCatHeatgFild Temp_Cels 8 -3549.940 3003.560 FORMAT "%8.3" DEPOSIT ABSOLUTE /end AXIS_DESCR
 /begin AXIS_DESCR STD_AXIS ExhMgT_facCatHeatgProgs fak_uw_b1 8 0.00 0.9999847 FORMAT "%9.7" DEPOSIT ABSOLUTE /end AXIS_DESCR
/end CHARACTERISTIC
/begin CHARACTERISTIC ExhMgT_facEtaCatWrmAltiT_M "map for control factor of desired engine efficiency by catalyst heating in case of catalyst warming depending on altitude and engine temperature" MAP 0x805261A0 RB_Map_S16U16_U16 1.992188 fak_ub_b2 0.00 1.992188 FORMAT "%8.6" EXTENDED_LIMITS 0.00 511.9922
 /begin AXIS_DESCR STD_AXIS ExhMgT_tEngCatHeatgFild Temp_Cels 8 -3549.940 3003.560 FORMAT "%8.3" DEPOSIT ABSOLUTE /end AXIS_DESCR
 /begin AXIS_DESCR STD_AXIS PEnv_facCorrAlti fak_uw_b4 4 0.00 3.999939 FORMAT "%8.6" DEPOSIT ABSOLUTE /end AXIS_DESCR
/end CHARACTERISTIC
/begin CHARACTERISTIC ExhMgT_facEtaEngCatHeatg_T "map for correction of weighting factor during catalyst heating" CURVE 0x805261FC RB_Curve_S16_U8_Static 1.992 fak_q0p00781 0.00 1.992 FORMAT "%5.3"
 /begin AXIS_DESCR STD_AXIS ExhMgT_tCat1Seln1 Temp_Cels 6 -3549.940 3003.560 FORMAT "%8.3" DEPOSIT ABSOLUTE /end AXIS_DESCR
/end CHARACTERISTIC
/begin CHARACTERISTIC ExhMgT_facEtaEngLoVlvLftAlti_T "weighing factor for desired engine efficiency for catalyst heating in case of a cold start cold engine in dependence on altitude" CURVE 0x80526210 RB_Curve_U16_U8_Static 1.000 fak_ub_q0p00392 0.00 1.000 FORMAT "%5.3"
 /begin AXIS_DESCR STD_AXIS PEnv_facCorrAlti fak_uw_b4 4 0.00 3.999939 FORMAT "%8.6" DEPOSIT ABSOLUTE /end AXIS_DESCR
/end CHARACTERISTIC
/begin CHARACTERISTIC ExhMgT_facTEngCatHeatgFilTn_T "time constant for filtering of the engine temperature in dependance of the rate of change of engine temperature" CURVE 0x8052621E RB_Curve_U16_U16 6553.400 t_q0p1 0.100 6553.500 FORMAT "%8.3" EXTENDED_LIMITS 0.00 6553.500
 /begin AXIS_DESCR STD_AXIS ExhMgT_tEngCatHeatgDif temp_q0p1_K 4 0.00 6553.500 FORMAT "%8.3" DEPOSIT ABSOLUTE /end AXIS_DESCR
/end CHARACTERISTIC
/begin CHARACTERISTIC ExhMgT_facWghCatWrmLimMax_C "maximum limitation of the weighting factor for catalyst warming" VALUE 0x80526230 RB_Val_Ws16 1.999939 fak_sw_b2 0.00 1.999939 FORMAT "%8.6" EXTENDED_LIMITS -2.000000 1.999939 /end CHARACTERISTIC
/begin CHARACTERISTIC ExhMgT_facWghCatWrmLimMin_C "minimum limitation of the weighting factor for catalyst warming" VALUE 0x80526232 RB_Val_Ws16 2.000000 fak_sw_b2 -2.000000 0.00 FORMAT "%8.6" EXTENDED_LIMITS -2.000000 1.999939 /end CHARACTERISTIC
/begin CHARACTERISTIC ExhMgT_iaCatWrmIdleGearEngd_GM "map for desired ignition-timing for catalyst warming in idle with engaged gear" MAP 0x80526234 RB_MapGroup_S8 191.3 zw_sb_q0p75 -96.00 95.25 FORMAT "%5.2"
 /begin AXIS_DESCR COM_AXIS NO_INPUT_QUANTITY rel_uw_b100 10 0.00 99.99847 FORMAT "%8.5" AXIS_PTS_REF SMG10KHUW /end AXIS_DESCR
 /begin AXIS_DESCR COM_AXIS Epm_nEng EngN 12 -16384.00 16383.50 FORMAT "%8.2" AXIS_PTS_REF SNM12KHUW /end AXIS_DESCR
/end CHARACTERISTIC
/begin CHARACTERISTIC ExhMgT_iaCatWrmIdle_GM "map for desired ignition-timing for catalyst warming in idle" MAP 0x805262AC RB_MapGroup_S8 191.3 zw_sb_q0p75 -96.00 95.25 FORMAT "%5.2"
 /begin AXIS_DESCR COM_AXIS NO_INPUT_QUANTITY rel_uw_b100 10 0.00 99.99847 FORMAT "%8.5" AXIS_PTS_REF SMG10KHUW /end AXIS_DESCR
 /begin AXIS_DESCR COM_AXIS Epm_nEng EngN 12 -16384.00 16383.50 FORMAT "%8.2" AXIS_PTS_REF SNM12KHUW /end AXIS_DESCR
/end CHARACTERISTIC
/begin CHARACTERISTIC ExhMgT_iaCatWrmPartLoad_GM "map for desired ignition-timing for catalyst warming during part load" MAP 0x80526324 RB_MapGroup_S8 191.3 zw_sb_q0p75 -96.00 95.25 FORMAT "%5.2"
 /begin AXIS_DESCR COM_AXIS NO_INPUT_QUANTITY rel_uw_b100 10 0.00 99.99847 FORMAT "%8.5" AXIS_PTS_REF SMG10KHUW /end AXIS_DESCR
 /begin AXIS_DESCR COM_AXIS Epm_nEng EngN 12 -16384.00 16383.50 FORMAT "%8.2" AXIS_PTS_REF SNM12KHUW /end AXIS_DESCR
/end CHARACTERISTIC
/begin CHARACTERISTIC ExhMgT_stEtaCatHeatg_C "codeword for efficiency worsening during catalyst heating" VALUE 0x8052639C RB_Val_Wu16 65535.00 dez 0.00 65535.00 FORMAT "%8.2" /end CHARACTERISTIC
/begin CHARACTERISTIC ExhMgt_tiCatHeatgIdle_C "time from idle to partload" VALUE 0x8052639E RB_Val_Wu8 25.4996 zk100msxs_ub_b25p5 0.1004 25.6000 FORMAT "%7.4" EXTENDED_LIMITS 0.100392 25.6000 /end CHARACTERISTIC
/begin CHARACTERISTIC ExhMgt_tiCatHeatgPartLoad_C "time for transition to partload" VALUE 0x8052639F RB_Val_Wu8 25.4996 zk100msxs_ub_b25p5 0.1004 25.6000 FORMAT "%7.4" EXTENDED_LIMITS 0.100392 25.6000 /end CHARACTERISTIC
/begin CHARACTERISTIC ExhMgT_tiEtaCatWrmFild_C "time delay for filtering of desired engine efficiency for catalyst warming" VALUE 0x805263A0 RB_Val_Wu16 6553.4999985 zk100msxs_uw_b6553p6 0.1000015 6553.6000000 FORMAT "%12.7" EXTENDED_LIMITS 0.10000152590 6553.6000000 /end CHARACTERISTIC
/begin CHARACTERISTIC ExhMgT_tStrtCorrnEffMin_C "minimal engine start temperature for release of consideration for correction of required worsening of engine efficiency for cold start catalyst heating in dependence of oil temperature and catalyst heat progress" VALUE 0x805263A2 RB_Val_Ws16 6553.500 Temp_Cels -3549.940 3003.560 FORMAT "%8.3" /end CHARACTERISTIC
/begin CHARACTERISTIC FETAKHKTKO "factor for reducing engine efficiency of catalyst heating in case of a cold start idue to active climate compressor" VALUE 0x805263A4 RB_Val_Wu8 1.187500 fak_ub_b2 0.804688 1.992188 FORMAT "%8.6" EXTENDED_LIMITS 0.00 1.992188 /end CHARACTERISTIC
/begin CHARACTERISTIC FETAKHLLAP "parameter for adaption of nominal engine efficiency for demonstration of a fault by idle" VALUE 0x805263A5 RB_Val_Wu8 1.992188 fak_ub_b2 0.00 1.992188 FORMAT "%8.6" /end CHARACTERISTIC
/begin CHARACTERISTIC FETAKHTLAP "parameter for adaption of nominal engine efficiency for demonstration of a fault by part load" VALUE 0x805263A6 RB_Val_Wu8 1.992188 fak_ub_b2 0.00 1.992188 FORMAT "%8.6" /end CHARACTERISTIC
/begin CHARACTERISTIC FKELDYA "Corrective factor for knock detection threshold for adaptation of load dynamic" VALUE 0x80526965 RB_Val_Wu8 15.94 fak_ub_b16 0.00 15.94 FORMAT "%5.2" /end CHARACTERISTIC
/begin CHARACTERISTIC FstRcvAftFco_C "Fast Recovery After Fuel CutOff" VALUE 0x804FA866 KwUb 255.0 dez 0.00 255.0 FORMAT "%5.1" /end CHARACTERISTIC
/begin CHARACTERISTIC IgCtl_diaLamBascIa_T "Air-fuel-ratio dependened, non-operation point weightend delta ignition angle to be considered in the basic ignition angle" CURVE 0x805251D8 RB_Curve_U16_S16_Static 191.3000 zw_q0p1 -96.00000 95.30000 FORMAT "%8.5" EXTENDED_LIMITS -3276.800 3276.700
 /begin AXIS_DESCR STD_AXIS IgCtl_ratLam fak_uw_b16 12 0.00 15.99976 FORMAT "%8.5" DEPOSIT ABSOLUTE /end AXIS_DESCR
/end CHARACTERISTIC
/begin CHARACTERISTIC IgCtl_diaLamBasc_M "Air-fuel-ratio dependened delta ignition angle to be considered in the basic ignition angle" MAP 0x8052520A RB_Map_S16U16_S16 191.3000 zw_q0p1 -96.00000 95.30000 FORMAT "%8.5" EXTENDED_LIMITS -3276.800 3276.700
 /begin AXIS_DESCR STD_AXIS Epm_nEng EngN 18 -16384.00 16383.50 FORMAT "%8.2" DEPOSIT ABSOLUTE /end AXIS_DESCR
 /begin AXIS_DESCR STD_AXIS IgCtl_ratLam fak_uw_b16 28 0.00 15.99976 FORMAT "%8.5" DEPOSIT ABSOLUTE /end AXIS_DESCR
/end CHARACTERISTIC
/begin CHARACTERISTIC IgCtl_diaLamLteIaLoResl_T "Air-fuel-ratio dependened, non-operation point weightend delta ignition angle to be considered in the late ignition angle" CURVE 0x8052565A RB_Curve_U16_S8_Static 191.3 kw_q0p75 -96.00 95.25 FORMAT "%5.2"
 /begin AXIS_DESCR STD_AXIS IgCtl_ratLam fak_uw_b16 8 0.00 15.99976 FORMAT "%8.5" DEPOSIT ABSOLUTE /end AXIS_DESCR
/end CHARACTERISTIC
/begin CHARACTERISTIC IgCtl_facBascLamOperPnt_M "Weighting factor of the delta ignition angle to be considered in the basic ignition angle" MAP 0x80525674 RB_Map_S16U16_S16 3.999939 RBPtCel_fac_6p10352em5_1 -2.000000 1.999939 FORMAT "%8.6"
 /begin AXIS_DESCR STD_AXIS Epm_nEng EngN 16 -16384.00 16383.50 FORMAT "%8.2" DEPOSIT ABSOLUTE /end AXIS_DESCR
 /begin AXIS_DESCR STD_AXIS NO_INPUT_QUANTITY rel_q0p0234 20 0.00 1535.977 FORMAT "%8.3" DEPOSIT ABSOLUTE /end AXIS_DESCR
/end CHARACTERISTIC
/begin CHARACTERISTIC IgCtl_facLteLamOperPnt_M "Weighting factor of the delta ignition angle to be considered in the late ignition angle" MAP 0x80525940 RB_Map_S16U16_S16 3.999939 RBPtCel_fac_6p10352em5_1 -2.000000 1.999939 FORMAT "%8.6"
 /begin AXIS_DESCR STD_AXIS Epm_nEng EngN 16 -16384.00 16383.50 FORMAT "%8.2" DEPOSIT ABSOLUTE /end AXIS_DESCR
 /begin AXIS_DESCR STD_AXIS NO_INPUT_QUANTITY rel_q0p0234 20 0.00 1535.977 FORMAT "%8.3" DEPOSIT ABSOLUTE /end AXIS_DESCR
/end CHARACTERISTIC
/begin CHARACTERISTIC IgCtl_flgOffsRefIgnAgLam_C "lambda dependent shift of reference ignition angle to be added to basic ignition angle" VALUE 0x80525C0C RB_Val_Wboolean 1.00000000000 B_TRUE 0.00 1.00000000000 FORMAT "%13.11" /end CHARACTERISTIC
/begin CHARACTERISTIC IgCtl_flgOperPntDpdt_C "Usage of the calibration variant forIgCtl_diaBascLam" VALUE 0x80525C0D RB_Val_Wboolean 1.00000000000 B_TRUE 0.00 1.00000000000 FORMAT "%13.11" /end CHARACTERISTIC
/begin CHARACTERISTIC IgnClPs_BattUmax_C "Maximum threshold VBat for diagnosis ignition powerstage fault evaluation" VALUE 0x80525C10 Val_Ws16 1310700. Volt_Batt -655360.0 655340.0 FORMAT "%8.1" /end CHARACTERISTIC
/begin CHARACTERISTIC IgnClPs_BattUmin_C "Minimum threshold VBat for ignition powerstage fault evaluation" VALUE 0x80525C12 Val_Ws16 1310700. Volt_Batt -655360.0 655340.0 FORMAT "%8.1" /end CHARACTERISTIC
/begin CHARACTERISTIC IgnClPs_Count "Counter threshold of number of ignitions from ignition counter until enabling of diagnosis at low engine speed" VALUE 0x80525C14 Val_Wu32 4294967295.00 dez 0.00 4294967295.00 FORMAT "%13.2" /end CHARACTERISTIC
/begin CHARACTERISTIC IgnClPs_enaAsgnLoglPhyCyl_C "activation HwCh assignment with EPM_numFireSeg_C" VALUE 0x80525C18 Val_Wu8 255.0 dez 0.00 255.0 FORMAT "%5.1" /end CHARACTERISTIC
/begin CHARACTERISTIC IgnClPs_mskInjOffBenchErr_CW "lock injection in case of ignition error on whole motor bench" VALUE 0x80525C19 Val_Wu8 255.0 dez 0.00 255.0 FORMAT "%5.1" /end CHARACTERISTIC
/begin CHARACTERISTIC IgnClPs_mskInjOff_CW "Codeword for Injection shutoff." VALUE 0x80525C1A Val_Wu8 255.0 dez 0.00 255.0 FORMAT "%5.1" /end CHARACTERISTIC
/begin CHARACTERISTIC IgnClPs_nEngDiaEna_C "Lower Engine Speed threshold for diagnosis enable" VALUE 0x80525C1C Val_Ws16 32767.50 EngN -16384.00 16383.50 FORMAT "%8.2" /end CHARACTERISTIC
/begin CHARACTERISTIC IgnDD_numIgnIAmaxOverride_C "number of ignitions, for which later abort angle is valid" VALUE 0x80525C21 Val_Wu8 255.0 OneToOne 0.00 255.0 FORMAT "%5.1" /end CHARACTERISTIC
/begin CHARACTERISTIC igndd_PercOffsDwlMax_T "Maximum Dwell calibration curve" CURVE 0x80525C22 Cur_Xu8Wu8 100.0 rel_ub_b127p5 0.00 100.0 FORMAT "%5.1" EXTENDED_LIMITS 0.00 127.5
 /begin AXIS_DESCR STD_AXIS Epm_nEngLRes EngN_LRes 4 0.00 10200. FORMAT "%5.0" DEPOSIT ABSOLUTE /end AXIS_DESCR
/end CHARACTERISTIC
/begin CHARACTERISTIC igndd_PercOffsDwlMin_T "Miniimum Dwell calibration curve" CURVE 0x80525C2B Cur_Xu8Wu8 100.0 rel_ub_b127p5 0.00 100.0 FORMAT "%5.1" EXTENDED_LIMITS 0.00 127.5
 /begin AXIS_DESCR STD_AXIS Epm_nEngLRes EngN_LRes 4 0.00 10200. FORMAT "%5.0" DEPOSIT ABSOLUTE /end AXIS_DESCR
/end CHARACTERISTIC
/begin CHARACTERISTIC IgnDD_tiPercDwellThd_C "Dwell Threshold -continue/ abort of dwell at loss of synchronization" VALUE 0x80525C34 Val_Wu8 100.0 rel_ub_b127p5 0.00 100.0 FORMAT "%5.1" EXTENDED_LIMITS 0.00 127.5 /end CHARACTERISTIC
/begin CHARACTERISTIC IgnH_SelnPinActvLvl_C "Active output state on uC output" VALUE 0x80525C36 RB_Val_Wu8 1.000 OneToOne 0.00 1.000 FORMAT "%5.3" EXTENDED_LIMITS 0.00 255.0 /end CHARACTERISTIC
/begin CHARACTERISTIC IKCtl_agAdpnRedn_C "Adaption reduction value (fine resolution)" VALUE 0x8052694E RB_Val_Ws16 10.00000 zw_q0p1 -10.00000 0.00 FORMAT "%8.5" EXTENDED_LIMITS -3276.800 3276.700 /end CHARACTERISTIC
/begin CHARACTERISTIC IKCtl_agAdvLrng_C "ignition advancing learning value for knock adaption" VALUE 0x80526950 RB_Val_Ws16 6.000000 zw_q0p1 0.00 6.000000 FORMAT "%8.6" EXTENDED_LIMITS -3276.800 3276.700 /end CHARACTERISTIC
/begin CHARACTERISTIC IKCtl_agMaxRtdAdjmt_C "maximum retard adjustment (for fine resolution)" VALUE 0x80526952 RB_Val_Ws16 30.00000 zw_q0p1 -30.00000 0.00 FORMAT "%8.5" EXTENDED_LIMITS -3276.800 3276.700 /end CHARACTERISTIC
/begin CHARACTERISTIC IKCtl_agMinDstAdpnLrng_C "minimum distance of current ignition angle to adaption value for advancing" VALUE 0x80526954 RB_Val_Ws16 3285.800 zw_q0p1 -3276.800 9.000 FORMAT "%8.3" EXTENDED_LIMITS -3276.800 3276.700 /end CHARACTERISTIC
/begin CHARACTERISTIC IKCtl_agRtdtLrng_C "ignition retardation learning value for knock adaption after knocking detected" VALUE 0x80526956 RB_Val_Ws16 18.00000 zw_q0p1 -9.000000 9.000000 FORMAT "%8.6" EXTENDED_LIMITS -3276.800 3276.700 /end CHARACTERISTIC
/begin CHARACTERISTIC IKCtl_facDynAdpn_M "dynamic response pre-control" MAP 0x80526966 RB_Map_S16U8_S8 191.3 kw_q0p75 -96.00 95.25 FORMAT "%5.2"
 /begin AXIS_DESCR STD_AXIS Epm_nEng EngN 6 -16384.00 16383.50 FORMAT "%8.2" DEPOSIT ABSOLUTE /end AXIS_DESCR
 /begin AXIS_DESCR STD_AXIS taevkr temp_ub_q0p75_o48 5 -48.0 143.3 FORMAT "%5.1" DEPOSIT ABSOLUTE /end AXIS_DESCR
/end CHARACTERISTIC
/begin CHARACTERISTIC IKCtl_facTipin_GT "delta ignition angle at tip-in" CURVE 0x8052699A RB_CurveGroup_S8 191.3 kw_q0p75 -96.00 95.25 FORMAT "%5.2"
 /begin AXIS_DESCR COM_AXIS Epm_nEng EngN 8 -16384.00 16383.50 FORMAT "%8.2" AXIS_PTS_REF IKCtl_nEng08_X_AX /end AXIS_DESCR
/end CHARACTERISTIC
/begin AXIS_PTS IKCtl_Load08_X_AX "datapoint distribution relative charge, 8 datapoints" 0x8052513A AirMod_ratChrgAirCyl RB_Axis_U16 1535.977 rel_uw_q0p0234 8 0.00 1535.977 FORMAT "%8.3" DEPOSIT ABSOLUTE /end AXIS_PTS
/begin AXIS_PTS IKCtl_LoadSyn08_X_AX "distribution for load (synchro task, 8 data points)" 0x8052514C AirMod_ratChrgAirCyl RB_Axis_U16 1535.977 rel_uw_q0p0234 8 0.00 1535.977 FORMAT "%8.3" DEPOSIT ABSOLUTE /end AXIS_PTS
/begin AXIS_PTS IKCtl_nEng08_X_AX "KC: Datapoint distribution engine speed of group B" 0x8052515E Epm_nEng RB_Axis_S16 32767.50 EngN 8 -16384.00 16383.50 FORMAT "%8.2" DEPOSIT ABSOLUTE /end AXIS_PTS
/begin AXIS_PTS IKCtl_nEng13_X_AX "KC: Datapoint distribution engine speed of group A" 0x80525170 Epm_nEng RB_Axis_S16 32767.50 EngN 13 -16384.00 16383.50 FORMAT "%8.2" DEPOSIT ABSOLUTE /end AXIS_PTS
/begin AXIS_PTS IKCtl_nEngVar13_X_AX "KC: Datapoint distribution engine speed of group A" 0x8052518C Epm_nEng RB_Axis_S16 32767.50 EngN 13 -16384.00 16383.50 FORMAT "%8.2" DEPOSIT ABSOLUTE /end AXIS_PTS
/begin AXIS_PTS IKCtl_nEngVarSyn13_X_AX "distribution for engine speed (synchro task, 13 data points)" 0x805251A8 Epm_nEng RB_Axis_S16 32767.50 EngN 13 -16384.00 16383.50 FORMAT "%8.2" DEPOSIT ABSOLUTE /end AXIS_PTS
/begin CHARACTERISTIC IKCtl_nrCmbPremDynOffs_M "number of combustions for reduction of retardation offset" CURVE 0x805269A2 RB_Curve_S16_U8_Static 255.0 dez 0.00 255.0 FORMAT "%5.1"
 /begin AXIS_DESCR STD_AXIS Epm_nEng EngN 8 -16384.00 16383.50 FORMAT "%8.2" DEPOSIT ABSOLUTE /end AXIS_DESCR
/end CHARACTERISTIC
/begin AXIS_PTS IKCtl_ratLoad04_X_AX "basepoint distribution of air charge , 4 basepoints" 0x805251C4 AirMod_ratChrgAirCyl RB_Axis_U16 1535.977 rel_uw_q0p0234 4 0.00 1535.977 FORMAT "%8.3" DEPOSIT ABSOLUTE /end AXIS_PTS
/begin AXIS_PTS IKCtl_ratLoadDy04_X_AX "basepoint distribution of rl, 4 basepoints" 0x805251CE AirMod_ratChrgAirCyl RB_Axis_U16 1535.977 rel_uw_q0p0234 4 0.00 1535.977 FORMAT "%8.3" DEPOSIT ABSOLUTE /end AXIS_PTS
/begin CHARACTERISTIC IntkAirT_cntrSTC1HiVld_C "stuck-check sensor 1: necessary number of high-phases" VALUE 0x80525CA4 RB_Val_Wu8 255.0 OneToOne 0.00 255.0 FORMAT "%5.1" /end CHARACTERISTIC
/begin CHARACTERISTIC IntkAirT_cntrSTC1LoVld_C "stuck-check sensor 1: necessary number of low-phases" VALUE 0x80525CA5 RB_Val_Wu8 255.0 OneToOne 0.00 255.0 FORMAT "%5.1" /end CHARACTERISTIC
/begin CHARACTERISTIC IntkAirT_cwSnsrFrzEna_C "Code word for intake air temperature sensor freez enable" VALUE 0x80525C3A RB_Val_Wu8 255.0 OneToOne 0.00 255.0 FORMAT "%5.1" /end CHARACTERISTIC
/begin CHARACTERISTIC IntkAirT_LnrwSnsr1_T "Characteristic line to linearize the intake air temperature of Snsr1 (word)" CURVE 0x80525C3C RB_Curve_U16_S16_Static 6553.500 Temp_Cels -3549.940 3003.560 FORMAT "%8.3"
 /begin AXIS_DESCR STD_AXIS IntkAirT_uSnsr1CrssSwtLoc Volt 20 0.00 5000.000 FORMAT "%8.3" EXTENDED_LIMITS 0.00 13107.00 DEPOSIT ABSOLUTE /end AXIS_DESCR
/end CHARACTERISTIC
/begin CHARACTERISTIC IntkAirT_mAirMflmaxSnsr1Enad_C "air-mass threshold used for limitation of intake air temperature sensor tfa1 after initialization" VALUE 0x80525C8E RB_Val_Wu16 23.30133 m_uw_b23p3 0.00 23.30133 FORMAT "%8.5" /end CHARACTERISTIC
/begin CHARACTERISTIC IntkAirT_mAirMfSnsrElecChk_C "Maximum air mass flow to enable the electrical diagnosis of the intake air temperature sensor" VALUE 0x80525C90 RB_Val_Wu8 1020. m_ub_b1020 0.00 1020. FORMAT "%5.0" /end CHARACTERISTIC
/begin CHARACTERISTIC IntkAirT_mHSC1MLMax_C "high-side-check sensor 1: threshold for physical diagnosis enabling" VALUE 0x80525CA6 RB_Val_Wu8 1020. m_ub_b1020 0.00 1020. FORMAT "%5.0" /end CHARACTERISTIC
/begin CHARACTERISTIC IntkAirT_mHSC1MLMin_C "high-side-check sensor 1: threshold for physical diagnosis enabling" VALUE 0x80525CA7 RB_Val_Wu8 1020. m_ub_b1020 0.00 1020. FORMAT "%5.0" /end CHARACTERISTIC
/begin CHARACTERISTIC IntkAirT_mSTC1HiMLInteg_T "stuck-check sensor 1: minimum air mass for detection of the high-phase" CURVE 0x80525CA8 RB_Curve_S16_U8_Static 23.21 m_ub_b23p3 0.00 23.21 FORMAT "%5.2"
 /begin AXIS_DESCR STD_AXIS CEngDsT_tStrtFrst Temp_Cels 3 -3549.940 3003.560 FORMAT "%8.3" DEPOSIT ABSOLUTE /end AXIS_DESCR
/end CHARACTERISTIC
/begin CHARACTERISTIC IntkAirT_mSTC1HiMLMax_C "stuck-check sensor 1: ml-threshold for high-phase" VALUE 0x80525CB4 RB_Val_Wu8 1020. m_ub_b1020 0.00 1020. FORMAT "%5.0" /end CHARACTERISTIC
/begin CHARACTERISTIC IntkAirT_mSTC1LoMLMax_C "stuck-check sensor 1: ml-threshold for low-phase" VALUE 0x80525CB5 RB_Val_Wu8 1020. m_ub_b1020 0.00 1020. FORMAT "%5.0" /end CHARACTERISTIC
/begin CHARACTERISTIC IntkAirT_mSTC1LoMLMin_C "stuck-check sensor 1: ml-threshold for low-phase" VALUE 0x80525CB6 RB_Val_Wu8 1020. m_ub_b1020 0.00 1020. FORMAT "%5.0" /end CHARACTERISTIC
/begin CHARACTERISTIC IntkAirT_SnsrLim_CW "Codeword: limitation of intake air temperature signal for sensors mounted in HFM" VALUE 0x80525C91 RB_Val_Wu8 255.0 OneToOne 0.00 255.0 FORMAT "%5.1" /end CHARACTERISTIC
/begin CHARACTERISTIC IntkAirT_SRCSnsrLim_CW "Configuration for SignalRangeCheck TFA-Sensor" VALUE 0x80525C92 RB_Val_Wu8 255.0 OneToOne 0.00 255.0 FORMAT "%5.1" /end CHARACTERISTIC
/begin CHARACTERISTIC IntkAirT_stCfgHSC1_C "Code word for the configuration of the High-Side-Check for the intake air temperature sensor 1" VALUE 0x80525CB7 RB_Val_Wu8 255.0 OneToOne 0.00 255.0 FORMAT "%5.1" /end CHARACTERISTIC
/begin CHARACTERISTIC IntkAirT_stCfgIntkMnfld_C "Code word to configure the intake air temperature in manifold IntkAirT_tThrVlvUs" VALUE 0x80525D34 RB_Val_Wu8 255.0 OneToOne 0.00 255.0 FORMAT "%5.1" /end CHARACTERISTIC
/begin CHARACTERISTIC IntkAirT_stCfgPRC1_C "Code word for the configuration of the Physical-Range-Check for the intake air temperature sensor 1" VALUE 0x80525CB8 RB_Val_Wu8 255.0 OneToOne 0.00 255.0 FORMAT "%5.1" /end CHARACTERISTIC
/begin CHARACTERISTIC IntkAirT_stCfgSTC1_C "Code word for the configuration of the Stuck-Check for the intake air temperature sensor 1" VALUE 0x80525CB9 RB_Val_Wu8 255.0 OneToOne 0.00 255.0 FORMAT "%5.1" /end CHARACTERISTIC
/begin CHARACTERISTIC IntkAirT_stCfgThrVlvUs_C "Code word to configure the intake air temperature upstream throttle IntkAirT_tThrVlvUs" VALUE 0x80525D3A RB_Val_Wu8 255.0 OneToOne 0.00 255.0 FORMAT "%5.1" /end CHARACTERISTIC
/begin CHARACTERISTIC IntkAirT_swtPID68hB_C "Selector switch for source of databyte B within PID68h" VALUE 0x80525132 RB_Val_Wu8 10.00 OneToOne 0.00 10.00 FORMAT "%5.2" EXTENDED_LIMITS 0.00 255.0 /end CHARACTERISTIC
/begin CHARACTERISTIC IntkAirT_swtPID68hC_C "Selector switch for source of databyte C within PID68h" VALUE 0x80525133 RB_Val_Wu8 10.00 OneToOne 0.00 10.00 FORMAT "%5.2" EXTENDED_LIMITS 0.00 255.0 /end CHARACTERISTIC
/begin CHARACTERISTIC IntkAirT_swtPID68hD_C "Selector switch for source of databyte D within PID68h" VALUE 0x80525134 RB_Val_Wu8 10.00 OneToOne 0.00 10.00 FORMAT "%5.2" EXTENDED_LIMITS 0.00 255.0 /end CHARACTERISTIC
/begin CHARACTERISTIC IntkAirT_swtPID68hE_C "Selector switch for source of databyte E within PID68h" VALUE 0x80525135 RB_Val_Wu8 10.00 OneToOne 0.00 10.00 FORMAT "%5.2" EXTENDED_LIMITS 0.00 255.0 /end CHARACTERISTIC
/begin CHARACTERISTIC IntkAirT_swtPID68hF_C "Selector switch for source of databyte F within PID68h" VALUE 0x80525136 RB_Val_Wu8 10.00 OneToOne 0.00 10.00 FORMAT "%5.2" EXTENDED_LIMITS 0.00 255.0 /end CHARACTERISTIC
/begin CHARACTERISTIC IntkAirT_swtPID68hG_C "Selector switch for source of databyte G within PID68h" VALUE 0x80525137 RB_Val_Wu8 10.00 OneToOne 0.00 10.00 FORMAT "%5.2" EXTENDED_LIMITS 0.00 255.0 /end CHARACTERISTIC
/begin CHARACTERISTIC IntkAirT_tDflValPID68_C "Default intake air temperature value for PID68 signal Tester" VALUE 0x80525138 RB_Val_Wu8 255.0 temp_ub_q1_o40 -40.0 215.0 FORMAT "%5.1" /end CHARACTERISTIC
/begin CHARACTERISTIC IntkAirT_tEngMinRelsElecDiag_C "Minimum engine temperature to enable the electrical check of the intake air temperature sensor" VALUE 0x80525C94 RB_Val_Ws16 6553.500 Temp_Cels -3549.940 3003.560 FORMAT "%8.3" /end CHARACTERISTIC
/begin CHARACTERISTIC IntkAirT_tEngMinRelsStrtElecDiag_C "engine temperature threshold for enabling the electrical check of TFA-sensor" VALUE 0x80525C96 RB_Val_Ws16 6553.500 Temp_Cels -3549.940 3003.560 FORMAT "%8.3" /end CHARACTERISTIC
/begin CHARACTERISTIC IntkAirT_tHSC1HealThd_C "high-side-check sensor 1: temperature threshold for healing" VALUE 0x80525CBA RB_Val_Ws16 6553.500 Temp_Cels -3549.940 3003.560 FORMAT "%8.3" /end CHARACTERISTIC
/begin CHARACTERISTIC IntkAirT_tHSC1Mdl_T "high-side-check sensor 1: characteristic line to calculate the model value for high-side-check" CURVE 0x80525CBC RB_Curve_S16_S16 6553.500 Temp_Cels -3549.940 3003.560 FORMAT "%8.3"
 /begin AXIS_DESCR STD_AXIS CEngDsT_t Temp_Cels 3 -3549.940 3003.560 FORMAT "%8.3" DEPOSIT ABSOLUTE /end AXIS_DESCR
/end CHARACTERISTIC
/begin CHARACTERISTIC IntkAirT_tiDebElecFaultSnsr1_C "debonce time for error detection (minmax) for intake air temperature sensor Snsr1" VALUE 0x80525C98 RB_Val_Wu8 2.500 t_q0p1 0.00 2.500 FORMAT "%5.3" EXTENDED_LIMITS 0.00 25.50 /end CHARACTERISTIC
/begin CHARACTERISTIC IntkAirT_tiDebHealElecFaultSnsr1_C "debonce time for healing of intake air temperature sensor Snsr1 (SY_TFAKON 0)" VALUE 0x80525C99 RB_Val_Wu8 25.50 t_q0p1 0.00 25.50 FORMAT "%5.2" /end CHARACTERISTIC
/begin CHARACTERISTIC IntkAirT_tiHSC1EnaDly_C "High-Side-Check sensor 1: debounce-time for physical diagnosis enabling" VALUE 0x80525CCA RB_Val_Wu8 255.0 t_q1 0.00 255.0 FORMAT "%5.1" /end CHARACTERISTIC
/begin CHARACTERISTIC IntkAirT_tiHSC1ErrDly_C "high-side-check sensor 1: debounce-time for error-entry" VALUE 0x80525CCB RB_Val_Wu8 255.0 t_q1 0.00 255.0 FORMAT "%5.1" /end CHARACTERISTIC
/begin CHARACTERISTIC IntkAirT_tiHSC1HealDly_C "high-side-check sensor 1: debounce time for error-healing" VALUE 0x80525CCC RB_Val_Wu8 255.0 t_q1 0.00 255.0 FORMAT "%5.1" /end CHARACTERISTIC
/begin CHARACTERISTIC IntkAirT_tiHSC1MLDly_C "High-Side-Check sensor 1: maximal interrupt time of the air-mass flow for diagnosis enabling" VALUE 0x80525CCD RB_Val_Wu8 255.0 t_q1 0.00 255.0 FORMAT "%5.1" /end CHARACTERISTIC
/begin CHARACTERISTIC IntkAirT_tiIntkMnfldFil_C "Time constant of lowpass for the intake air temperature in manifold" VALUE 0x80525D35 RB_Val_Wu8 25.40 t_q0p1 0.10 25.50 FORMAT "%5.2" EXTENDED_LIMITS 0.00 25.50 /end CHARACTERISTIC
/begin CHARACTERISTIC IntkAirT_tiIntkMnfldMeasdVldDly_C "Debouncing time of lowpass filter for the intake air temperature in manifold" VALUE 0x80525D36 RB_Val_Wu8 25.50 t_q0p1 0.00 25.50 FORMAT "%5.2" /end CHARACTERISTIC
/begin CHARACTERISTIC IntkAirT_tiPRC1ErrDly_C "Debouncing time for error entry (min/max) for Physical-Range-Check TFA1" VALUE 0x80525CCE RB_Val_Wu8 25.50 t_q0p1 0.00 25.50 FORMAT "%5.2" /end CHARACTERISTIC
/begin CHARACTERISTIC IntkAirT_tiPRC1HealDly_C "Debouncing time for error healing (min/max) for Physical-Range-Check TFA1" VALUE 0x80525CCF RB_Val_Wu8 25.50 t_q0p1 0.00 25.50 FORMAT "%5.2" /end CHARACTERISTIC
/begin CHARACTERISTIC IntkAirT_tiSnsr1DSMCycRprt_C "Freely adjustable IntkAirT Sensor1 specific repetition rate at which diagnostic result should be sent to the DSM" VALUE 0x80525CA2 RB_Val_Wu8 25.50 t_q0p1 0.00 25.50 FORMAT "%5.2" /end CHARACTERISTIC
/begin CHARACTERISTIC IntkAirT_tiSnsr1DSMFrstRprt_C "Time period at which diagnostic result should be sent to the DSM for the first time once DSM is ready (after new start or with DSM clear)" VALUE 0x80525CA3 RB_Val_Wu8 25.50 t_q0p1 0.00 25.50 FORMAT "%5.2" /end CHARACTERISTIC
/begin CHARACTERISTIC IntkAirT_tiSTC1HiOffDly_C "stuck-check sensor 1: maximum allowed time-duration outside high-phase" VALUE 0x80525CD0 RB_Val_Wu8 255.0 t_q1 0.00 255.0 FORMAT "%5.1" /end CHARACTERISTIC
/begin CHARACTERISTIC IntkAirT_tiSTC1HiOnDly_C "stuck-check sensor 1: minimum necessary time-duration for hig-phase-cycle" VALUE 0x80525CD1 RB_Val_Wu8 255.0 t_q1 0.00 255.0 FORMAT "%5.1" /end CHARACTERISTIC
/begin CHARACTERISTIC IntkAirT_tiSTC1LoOffDly_C "stuck-check sensor 1: maximum allowed time-duration outside low-phase" VALUE 0x80525CD2 RB_Val_Wu8 255.0 t_q1 0.00 255.0 FORMAT "%5.1" /end CHARACTERISTIC
/begin CHARACTERISTIC IntkAirT_tiSTC1LoOnDly_C "stuck-check sensor 1: minimum necessary time-duration for low-phase-cycle" VALUE 0x80525CD3 RB_Val_Wu8 255.0 t_q1 0.00 255.0 FORMAT "%5.1" /end CHARACTERISTIC
/begin CHARACTERISTIC IntkAirT_TnDebDiagSnsr_C "Debouncing time for enabling the electrical diagnosis of the intake air temperature sensor" VALUE 0x80525C9A RB_Val_Wu8 25.50 t_q0p1 0.00 25.50 FORMAT "%5.2" /end CHARACTERISTIC
/begin CHARACTERISTIC IntkAirT_TnPT1Snsr1_C "time constant for lowpass filter of SnSr1 lin" VALUE 0x80525C9B RB_Val_Wu8 25.40 t_q0p1 0.10 25.50 FORMAT "%5.2" EXTENDED_LIMITS 0.00 25.50 /end CHARACTERISTIC
/begin CHARACTERISTIC IntkAirT_tPRC1Max_C "Maximum permissible temperature for Physical-Range-Check intake air temperature sensor 1" VALUE 0x80525CD4 RB_Val_Ws16 6553.500 Temp_Cels -3549.940 3003.560 FORMAT "%8.3" /end CHARACTERISTIC
/begin CHARACTERISTIC IntkAirT_tPRC1Min_C "Minimum permissible temperature for Physical-Range-Check intake air temperature sensor 1" VALUE 0x80525CD6 RB_Val_Ws16 6553.500 Temp_Cels -3549.940 3003.560 FORMAT "%8.3" /end CHARACTERISTIC
/begin CHARACTERISTIC IntkAirT_tReplSnsr1Mdl_C "Replacement value of the intake air temperature sensor 1" VALUE 0x80525D38 RB_Val_Ws16 6553.500 Temp_Cels -3549.940 3003.560 FORMAT "%8.3" /end CHARACTERISTIC
/begin CHARACTERISTIC IntkAirT_tSTC1EnaThdMax_C "stuck-check sensor 1: threshold of the motor start temperature for enabling the diagnosis" VALUE 0x80525CD8 RB_Val_Ws16 6553.500 Temp_Cels -3549.940 3003.560 FORMAT "%8.3" /end CHARACTERISTIC
/begin CHARACTERISTIC IntkAirT_tSTC1ErrThd_T "stuck-check sensor 1: Threshold for error detection" CURVE 0x80525CDA RB_Curve_S16_S16 6553.500 Temp_Cels -3549.940 3003.560 FORMAT "%8.3"
 /begin AXIS_DESCR STD_AXIS IntkAirT_tSnsrFild1Min Temp_Cels 20 -3549.940 3003.560 FORMAT "%8.3" DEPOSIT ABSOLUTE /end AXIS_DESCR
/end CHARACTERISTIC
/begin CHARACTERISTIC IntkAirT_tSTC1HiTMotMin_C "stuck-check TFA1: Threshold of motor temperature for high-phase" VALUE 0x80525D2C RB_Val_Ws16 6553.500 Temp_Cels -3549.940 3003.560 FORMAT "%8.3" /end CHARACTERISTIC
/begin CHARACTERISTIC IntkAirT_tThrVlvUsTolrMax_C "Maximum tolerance of the intake air temperature before the throttle valve" VALUE 0x80525D3C RB_Val_Ws16 6553.500 Temp_Cels -3549.940 3003.560 FORMAT "%8.3" /end CHARACTERISTIC
/begin CHARACTERISTIC IntkAirT_UmaxSnsr1_C "maximum allowed voltage-signal of intake air temperature sensor SnSr1" VALUE 0x80525C9C RB_Val_Wu16 13107.00 Volt 0.00 13107.00 FORMAT "%8.2" /end CHARACTERISTIC
/begin CHARACTERISTIC IntkAirT_UminSnsr1_C "minimum allowed voltage-value of intake air temperature sensor SnSr1" VALUE 0x80525C9E RB_Val_Wu16 13107.00 Volt 0.00 13107.00 FORMAT "%8.2" /end CHARACTERISTIC
/begin CHARACTERISTIC IntkAirT_vHSC1VMin_C "high-side-check sensor 1: Threshold of vehicle speed for enabling diagnosis" VALUE 0x80525D2E RB_Val_Ws16 655.3500 Vel -327.6800 327.6700 FORMAT "%8.4" /end CHARACTERISTIC
/begin CHARACTERISTIC IntkAirT_vSTC1HiVMax_C "stuck-check sensor 1: Threshold of vehicle speed fr high-phase" VALUE 0x80525D30 RB_Val_Ws16 655.3500 Vel -327.6800 327.6700 FORMAT "%8.4" /end CHARACTERISTIC
/begin CHARACTERISTIC IntkAirT_vSTC1LoVMin_C "stuck-check sensor 1: Threshold of vehicle speed fr low-phase" VALUE 0x80525D32 RB_Val_Ws16 655.3500 Vel -327.6800 327.6700 FORMAT "%8.4" /end CHARACTERISTIC
/begin CHARACTERISTIC IntkAirT_vVehMaxRelsElecDiag_C "Maximum vehicle speed to enable the electrical check of the intake air temperature sensor" VALUE 0x80525CA0 RB_Val_Ws16 655.3500 Vel -327.6800 327.6700 FORMAT "%8.4" /end CHARACTERISTIC
/begin CHARACTERISTIC KFETAKHKTL "map for desired engine efficiency for catalyst heating in case of cold start by idle" MAP 0x805263A8 RB_MapGroup_U16 1.999969 fak_uw_b2 0.00 1.999969 FORMAT "%8.6"
 /begin AXIS_DESCR COM_AXIS NO_INPUT_QUANTITY rel_uw_b100 8 0.00 99.99847 FORMAT "%8.5" AXIS_PTS_REF SMG08KHUW /end AXIS_DESCR
 /begin AXIS_DESCR COM_AXIS NO_INPUT_QUANTITY EngN 8 -16384.00 16383.50 FORMAT "%8.2" AXIS_PTS_REF SNM08KHUW /end AXIS_DESCR
/end CHARACTERISTIC
/begin CHARACTERISTIC KFETAKHKTLVH "map for desired engine efficiency for catalyst heating in case of cold start by idle (big valve lift)" MAP 0x80526428 RB_MapGroup_U16 1.999969 fak_uw_b2 0.00 1.999969 FORMAT "%8.6"
 /begin AXIS_DESCR COM_AXIS NO_INPUT_QUANTITY rel_uw_b100 8 0.00 99.99847 FORMAT "%8.5" AXIS_PTS_REF SMG08KHUW /end AXIS_DESCR
 /begin AXIS_DESCR COM_AXIS NO_INPUT_QUANTITY EngN 8 -16384.00 16383.50 FORMAT "%8.2" AXIS_PTS_REF SNM08KHUW /end AXIS_DESCR
/end CHARACTERISTIC
/begin CHARACTERISTIC KFETAKHKTT "map for desired engine efficiency for catalyst heating in case of cold start by part load" MAP 0x805264A8 RB_MapGroup_U16 1.999969 fak_uw_b2 0.00 1.999969 FORMAT "%8.6"
 /begin AXIS_DESCR COM_AXIS NO_INPUT_QUANTITY rel_uw_b100 8 0.00 99.99847 FORMAT "%8.5" AXIS_PTS_REF SMG08KHUW /end AXIS_DESCR
 /begin AXIS_DESCR COM_AXIS NO_INPUT_QUANTITY EngN 8 -16384.00 16383.50 FORMAT "%8.2" AXIS_PTS_REF SNM08KHUW /end AXIS_DESCR
/end CHARACTERISTIC
/begin CHARACTERISTIC KFETAKHKTTVH "map for desired engine efficiency for catalyst heating in case of cold start by part load (big valve lift)" MAP 0x80526528 RB_MapGroup_U16 1.999969 fak_uw_b2 0.00 1.999969 FORMAT "%8.6"
 /begin AXIS_DESCR COM_AXIS NO_INPUT_QUANTITY rel_uw_b100 8 0.00 99.99847 FORMAT "%8.5" AXIS_PTS_REF SMG08KHUW /end AXIS_DESCR
 /begin AXIS_DESCR COM_AXIS NO_INPUT_QUANTITY EngN 8 -16384.00 16383.50 FORMAT "%8.2" AXIS_PTS_REF SNM08KHUW /end AXIS_DESCR
/end CHARACTERISTIC
/begin CHARACTERISTIC KFETAKTFSL "map for desired engine efficiency for catalyst heating in case of cold start with automatic gear box in drive-position" MAP 0x805265A8 RB_MapGroup_U16 1.999969 fak_uw_b2 0.00 1.999969 FORMAT "%8.6"
 /begin AXIS_DESCR COM_AXIS NO_INPUT_QUANTITY rel_uw_b100 8 0.00 99.99847 FORMAT "%8.5" AXIS_PTS_REF SMG08KHUW /end AXIS_DESCR
 /begin AXIS_DESCR COM_AXIS NO_INPUT_QUANTITY EngN 8 -16384.00 16383.50 FORMAT "%8.2" AXIS_PTS_REF SNM08KHUW /end AXIS_DESCR
/end CHARACTERISTIC
/begin CHARACTERISTIC KFETAKTFSLVH "map for desired engine efficiency for catalyst heating in case of cold start with automatic gear box in drive-position (big valve lift)" MAP 0x80526628 RB_MapGroup_U16 1.999969 fak_uw_b2 0.00 1.999969 FORMAT "%8.6"
 /begin AXIS_DESCR COM_AXIS NO_INPUT_QUANTITY rel_uw_b100 8 0.00 99.99847 FORMAT "%8.5" AXIS_PTS_REF SMG08KHUW /end AXIS_DESCR
 /begin AXIS_DESCR COM_AXIS NO_INPUT_QUANTITY EngN 8 -16384.00 16383.50 FORMAT "%8.2" AXIS_PTS_REF SNM08KHUW /end AXIS_DESCR
/end CHARACTERISTIC
/begin CHARACTERISTIC KFFKWTIVK "characteristic map of factor for exh. gas heat flow request to warm front catalyst" MAP 0x805266A8 RB_Map_S16U16_U16 1.999969 fak_uw_b2 0.00 1.999969 FORMAT "%8.6"
 /begin AXIS_DESCR STD_AXIS ExhMgT_tCatHeatgTCatSelnActn temp_q0p1_K 6 -3276.800 3276.700 FORMAT "%8.3" DEPOSIT ABSOLUTE /end AXIS_DESCR
 /begin AXIS_DESCR STD_AXIS ExhMgT_facWghtCatAge fak_uw_b2 4 0.00 1.999969 FORMAT "%8.6" DEPOSIT ABSOLUTE /end AXIS_DESCR
/end CHARACTERISTIC
/begin CHARACTERISTIC KFZWKHKTL "map for desired ignition-timing for catalyst heating in case of cold start by idle" MAP 0x805266F0 RB_MapGroup_S8 191.3 zw_sb_q0p75 -96.00 95.25 FORMAT "%5.2"
 /begin AXIS_DESCR COM_AXIS NO_INPUT_QUANTITY rel_uw_b100 8 0.00 99.99847 FORMAT "%8.5" AXIS_PTS_REF SMG08KHUW /end AXIS_DESCR
 /begin AXIS_DESCR COM_AXIS NO_INPUT_QUANTITY EngN 8 -16384.00 16383.50 FORMAT "%8.2" AXIS_PTS_REF SNM08KHUW /end AXIS_DESCR
/end CHARACTERISTIC
/begin CHARACTERISTIC KFZWKHKTLVH "map for desired ignition-timing for catalyst heating in case of cold start by idle (big valve lift)" MAP 0x80526730 RB_MapGroup_S8 191.3 zw_sb_q0p75 -96.00 95.25 FORMAT "%5.2"
 /begin AXIS_DESCR COM_AXIS NO_INPUT_QUANTITY rel_uw_b100 8 0.00 99.99847 FORMAT "%8.5" AXIS_PTS_REF SMG08KHUW /end AXIS_DESCR
 /begin AXIS_DESCR COM_AXIS NO_INPUT_QUANTITY EngN 8 -16384.00 16383.50 FORMAT "%8.2" AXIS_PTS_REF SNM08KHUW /end AXIS_DESCR
/end CHARACTERISTIC
/begin CHARACTERISTIC KFZWKHKTT "map for desired ignition-timing for catalyst heating in case of cold start by part load" MAP 0x80526770 RB_MapGroup_S8 191.3 zw_sb_q0p75 -96.00 95.25 FORMAT "%5.2"
 /begin AXIS_DESCR COM_AXIS NO_INPUT_QUANTITY rel_uw_b100 8 0.00 99.99847 FORMAT "%8.5" AXIS_PTS_REF SMG08KHUW /end AXIS_DESCR
 /begin AXIS_DESCR COM_AXIS NO_INPUT_QUANTITY EngN 8 -16384.00 16383.50 FORMAT "%8.2" AXIS_PTS_REF SNM08KHUW /end AXIS_DESCR
/end CHARACTERISTIC
/begin CHARACTERISTIC KFZWKHKTTVH "map for desired eignition-timing for catalyst heating in case of cold start by part load (big valve lift)" MAP 0x805267B0 RB_MapGroup_S8 191.3 zw_sb_q0p75 -96.00 95.25 FORMAT "%5.2"
 /begin AXIS_DESCR COM_AXIS NO_INPUT_QUANTITY rel_uw_b100 8 0.00 99.99847 FORMAT "%8.5" AXIS_PTS_REF SMG08KHUW /end AXIS_DESCR
 /begin AXIS_DESCR COM_AXIS NO_INPUT_QUANTITY EngN 8 -16384.00 16383.50 FORMAT "%8.2" AXIS_PTS_REF SNM08KHUW /end AXIS_DESCR
/end CHARACTERISTIC
/begin CHARACTERISTIC KFZWKTFSL "map for desired ignition-timing for catalyst heating in case of cold start with automatic gear box in drive-position" MAP 0x805267F0 RB_MapGroup_S8 191.3 zw_sb_q0p75 -96.00 95.25 FORMAT "%5.2"
 /begin AXIS_DESCR COM_AXIS NO_INPUT_QUANTITY rel_uw_b100 8 0.00 99.99847 FORMAT "%8.5" AXIS_PTS_REF SMG08KHUW /end AXIS_DESCR
 /begin AXIS_DESCR COM_AXIS NO_INPUT_QUANTITY EngN 8 -16384.00 16383.50 FORMAT "%8.2" AXIS_PTS_REF SNM08KHUW /end AXIS_DESCR
/end CHARACTERISTIC
/begin CHARACTERISTIC KFZWKTFSLVH "map for desired ignition-timing for catalyst heating in case of cold start with automatic gear box in drive-position (big valve lift)" MAP 0x80526830 RB_MapGroup_S8 191.3 zw_sb_q0p75 -96.00 95.25 FORMAT "%5.2"
 /begin AXIS_DESCR COM_AXIS NO_INPUT_QUANTITY rel_uw_b100 8 0.00 99.99847 FORMAT "%8.5" AXIS_PTS_REF SMG08KHUW /end AXIS_DESCR
 /begin AXIS_DESCR COM_AXIS NO_INPUT_QUANTITY EngN 8 -16384.00 16383.50 FORMAT "%8.2" AXIS_PTS_REF SNM08KHUW /end AXIS_DESCR
/end CHARACTERISTIC
/begin CHARACTERISTIC KLDETAKH "Minimum distance to minimal spark efficiency while spark retard for cat. heat." CURVE 0x80526870 RB_Curve_U16_U16 1.999969 fak_uw_b2 0.00 1.999969 FORMAT "%8.6"
 /begin AXIS_DESCR STD_AXIS NO_INPUT_QUANTITY fak_uw_b2 6 0.00 1.999969 FORMAT "%8.6" DEPOSIT ABSOLUTE /end AXIS_DESCR
/end CHARACTERISTIC
/begin CHARACTERISTIC KLDLUWSKH "line for weighting factor engine efficiency in case of catalyst heating by cold start in dependence on irregular running" CURVE 0x8052688A RB_Curve_S16_U8_Static 1.992188 fak_ub_b2 0.00 1.992188 FORMAT "%8.6"
 /begin AXIS_DESCR STD_AXIS dsdluts_w_msg lu_MEx 4 -232.8306 232.8235 FORMAT "%8.4" DEPOSIT ABSOLUTE /end AXIS_DESCR
/end CHARACTERISTIC
/begin CHARACTERISTIC KLFSTKTAGE "weighting factor for desired engine efficiency for catalyst heating by cold engine in dependence of catalyst ageing" CURVE 0x80526898 RB_Curve_U16_U8_Static 1.992188 fak_ub_b2 0.00 1.992188 FORMAT "%8.6"
 /begin AXIS_DESCR STD_AXIS ExhMgT_facWghtCatAge fak_uw_b2 4 0.00 1.999969 FORMAT "%8.6" DEPOSIT ABSOLUTE /end AXIS_DESCR
/end CHARACTERISTIC
/begin CHARACTERISTIC KLFSTKTFHO "weighting factor for desired engine efficiency for catalyst heating by cold engine in dependence of altitude" CURVE 0x805268A6 RB_Curve_U16_U8_Static 1.000 fak_ub_q0p00392 0.00 1.000 FORMAT "%5.3"
 /begin AXIS_DESCR STD_AXIS PEnv_facCorrAlti fak_uw_b4 4 0.00 3.999939 FORMAT "%8.6" DEPOSIT ABSOLUTE /end AXIS_DESCR
/end CHARACTERISTIC
/begin CHARACTERISTIC KLFSTKTMST "weighting factor for desired engine efficiency for catalyst heating by cold engine in dependence of engine start temperature" CURVE 0x805268B4 RB_Curve_S16_U16_Static 1.992188 fak_ub_b2 0.00 1.992188 FORMAT "%8.6" EXTENDED_LIMITS 0.00 511.9922
 /begin AXIS_DESCR STD_AXIS ExhMgT_tEngCatHeatgFild Temp_Cels 8 -3549.940 3003.560 FORMAT "%8.3" DEPOSIT ABSOLUTE /end AXIS_DESCR
/end CHARACTERISTIC
/begin CHARACTERISTIC KLFSTKTTNS "weighting factor for desired engine efficiency for catalyst heating by cold engine in dependence of time after start" CURVE 0x805268D6 RB_Curve_U16_U8_Static 1.992188 fak_ub_b2 0.00 1.992188 FORMAT "%8.6"
 /begin AXIS_DESCR STD_AXIS tnse_w_msg t100msxs_uw_b6553p5 8 0.00 6553.500 FORMAT "%8.3" DEPOSIT ABSOLUTE /end AXIS_DESCR
/end CHARACTERISTIC
/begin CHARACTERISTIC KnDet_CalMeasWin_C "code word measurement window output via application interface" VALUE 0x805271A0 RB_Val_Wu8 4.000 dez 0.00 4.000 FORMAT "%5.3" EXTENDED_LIMITS 0.00 255.0 /end CHARACTERISTIC
/begin CHARACTERISTIC KnDet_CfgRelsMeasWin_C "configuration enable check of measurement window length" VALUE 0x805271A1 RB_Val_Wu8 255.0 dez 0.00 255.0 FORMAT "%5.1" /end CHARACTERISTIC
/begin CHARACTERISTIC KnDet_CoefFlt_CA "filter coefficients for signal evaluation" VAL_BLK 0x805271B8 RB_ValA_Wu16 65535.00 dez 0.00 65535.00 FORMAT "%8.2" NUMBER 147 /end CHARACTERISTIC
/begin CHARACTERISTIC KnDet_GainRng0_C "Amplification stage range 0" VALUE 0x805271A2 RB_Val_Wu8 2.000 dez 0.00 2.000 FORMAT "%5.3" EXTENDED_LIMITS 0.00 255.0 /end CHARACTERISTIC
/begin CHARACTERISTIC KnDet_GainRng1_C "Amplification stage range 1" VALUE 0x805271A3 RB_Val_Wu8 2.000 dez 0.00 2.000 FORMAT "%5.3" EXTENDED_LIMITS 0.00 255.0 /end CHARACTERISTIC
/begin CHARACTERISTIC KnDet_GainRng2_C "Amplification stage range 2" VALUE 0x805271A4 RB_Val_Wu8 2.000 dez 0.00 2.000 FORMAT "%5.3" EXTENDED_LIMITS 0.00 255.0 /end CHARACTERISTIC
/begin CHARACTERISTIC KnDet_NThdGainRng1_C "threshold switch of amplification stage range 1" VALUE 0x805271A6 RB_Val_Ws16 16383.50 EngN 0.00 16383.50 FORMAT "%8.2" EXTENDED_LIMITS -16384.00 16383.50 /end CHARACTERISTIC
/begin CHARACTERISTIC KnDet_NThdGainRng2_C "threshold switch of amplification stage range 2" VALUE 0x805271A8 RB_Val_Ws16 16383.50 EngN 0.00 16383.50 FORMAT "%8.2" EXTENDED_LIMITS -16384.00 16383.50 /end CHARACTERISTIC
/begin CHARACTERISTIC KnDet_SnsrMaxErr_C "upper fault threshold short circuit detection" VALUE 0x805271B4 RB_Val_Ws16 10.51926 RBPtCel_u_1p60514em4_1 -5.259711 5.259551 FORMAT "%8.6" /end CHARACTERISTIC
/begin CHARACTERISTIC KnDet_SnsrMinErr_C "lower fault threshold short circuit detection" VALUE 0x805271B6 RB_Val_Ws16 10.51926 RBPtCel_u_1p60514em4_1 -5.259711 5.259551 FORMAT "%8.6" /end CHARACTERISTIC
/begin CHARACTERISTIC KnDet_ThresNGradMeasWin_C "speed gradient threshold release of check number of measurement values" VALUE 0x805271AA RB_Val_Ws16 5000.000 EngNGrd 0.00 5000.000 FORMAT "%8.3" EXTENDED_LIMITS -16384.00 16383.50 /end CHARACTERISTIC
/begin CHARACTERISTIC KnDet_ThresNMeasWin_C "speed threshold release of check number of measurement values" VALUE 0x805271AC RB_Val_Ws16 16383.50 EngN 0.00 16383.50 FORMAT "%8.2" EXTENDED_LIMITS -16384.00 16383.50 /end CHARACTERISTIC
/begin CHARACTERISTIC KnDet_ThresNumMeasWin_C "Threshold for check number of measurement values" VALUE 0x805271AE RB_Val_Ws8 50.00 dez 0.00 50.00 FORMAT "%5.2" EXTENDED_LIMITS -128.0 127.0 /end CHARACTERISTIC
/begin CHARACTERISTIC KnDet_ThresTiDiffMeasWin_C "threshold minmal measurement window distance" VALUE 0x805271B0 RB_Val_Wu32 20000.0000000 t_us_q1 0.00 20000.0000000 FORMAT "%13.7" EXTENDED_LIMITS 0.00 4294967295.00 /end CHARACTERISTIC
/begin CHARACTERISTIC KRTNSEO "Knock control: switch off time threshold" VALUE 0x80526958 RB_Val_Wu16 6553.500 t100msxs_uw_b6553p5 0.00 6553.500 FORMAT "%8.3" /end CHARACTERISTIC
/begin CHARACTERISTIC KRVFZGO "Knock control: vehicle speed threshold" VALUE 0x8052695A RB_Val_Ws16 655.3500 Vel -327.6800 327.6700 FORMAT "%8.4" /end CHARACTERISTIC
/begin CHARACTERISTIC PZWKRA "percentage frequency of ignition angle output by knock control during dynamic adaption" VALUE 0x805269BC RB_Val_Wu8 99.61 rel_q0p39 0.00 99.61 FORMAT "%5.2" /end CHARACTERISTIC
/begin AXIS_PTS SMG08KHUW "Distribution of breakpoints of requested torque after gear protection (miglsol_)" 0x805268F0 NO_INPUT_QUANTITY RB_Axis_U16 99.99847 rel_uw_b100 8 0.00 99.99847 FORMAT "%8.5" DEPOSIT ABSOLUTE /end AXIS_PTS
/begin AXIS_PTS SMG10KHUW "Distribution of breakpoints of reqested torque after gear protection in KHMR for OPF heating" 0x80526902 NO_INPUT_QUANTITY RB_Axis_U16 99.99847 rel_uw_b100 10 0.00 99.99847 FORMAT "%8.5" DEPOSIT ABSOLUTE /end AXIS_PTS
/begin AXIS_PTS SNM08KHUW "Datapoint distribution for engine speed in KHMR" 0x80526918 NO_INPUT_QUANTITY RB_Axis_S16 32767.50 EngN 8 -16384.00 16383.50 FORMAT "%8.2" DEPOSIT ABSOLUTE /end AXIS_PTS
/begin AXIS_PTS SNM12KHUW "Datapoint distribution for engine speed in KHMR for OPF heating" 0x8052692A Epm_nEng RB_Axis_S16 32767.50 EngN 12 -16384.00 16383.50 FORMAT "%8.2" DEPOSIT ABSOLUTE /end AXIS_PTS
/begin CHARACTERISTIC TANSDE "substitute value air temperature in case of fault" VALUE 0x80525C38 RB_Val_Wu8 191.3 temp_ub_q0p75_o48 -48.0 143.3 FORMAT "%5.1" /end CHARACTERISTIC
/begin CHARACTERISTIC TETAKHKT "time constant for filtering of engine efficency for catalyst heating as a result of a cold start" VALUE 0x80526944 RB_Val_Wu16 6553.4999985 zk100msxs_uw_b6553p6 0.1000015 6553.6000000 FORMAT "%12.7" EXTENDED_LIMITS 0.10000152590 6553.6000000 /end CHARACTERISTIC
/begin CHARACTERISTIC TETAKHKTLL "time constant for filtering of engine efficency for catalyst heating as a result of a cold start (during part load)" VALUE 0x80526946 RB_Val_Wu16 6553.4999985 zk100msxs_uw_b6553p6 0.1000015 6553.6000000 FORMAT "%12.7" EXTENDED_LIMITS 0.10000152590 6553.6000000 /end CHARACTERISTIC
/begin CHARACTERISTIC TTFANMOT "Delaytime for B_nmot." VALUE 0x80525C39 RB_Val_Wu8 25.50 t_q0p1 0.00 25.50 FORMAT "%5.2" /end CHARACTERISTIC
/begin CHARACTERISTIC VFZGKHKT "vehicle velocity to switch over part load to idle load maps in case of condition Engine Idle" VALUE 0x80526948 RB_Val_Ws16 655.3500 Vel -327.6800 327.6700 FORMAT "%8.4" /end CHARACTERISTIC
/begin CHARACTERISTIC ZKKHKTL "time constant for transition desired engine efficiency for catalyst heating from idle to part load" VALUE 0x8052694A RB_Val_Wu8 25.4996 zk100msxs_ub_b25p5 0.1004 25.6000 FORMAT "%7.4" EXTENDED_LIMITS 0.100392 25.6000 /end CHARACTERISTIC
/begin CHARACTERISTIC ZKKHKTT "time constant for transition desired engine efficiency for catalyst heating from part load to idle" VALUE 0x8052694B RB_Val_Wu8 25.4996 zk100msxs_ub_b25p5 0.1004 25.6000 FORMAT "%7.4" EXTENDED_LIMITS 0.100392 25.6000 /end CHARACTERISTIC
/begin MEASUREMENT abmznd_msg "cut off pattern on ignition circuit error" UBYTE dez 1 100 0.00 255.0 FORMAT "%5.1" ECU_ADDRESS 0x6000A001 /end MEASUREMENT
/begin MEASUREMENT AngZotTicks "Angletimervalue of the TDCs" ULONG AngleCrS 1 100 0.00 94371839.9781 FORMAT "%13.4" ARRAY_SIZE 4 ECU_ADDRESS 0x500000FC /end MEASUREMENT
/begin MEASUREMENT AngZotTicksInjA "Angletimervalue of the TDCs of Injector A" ULONG AngleCrS 1 100 0.00 94371839.9781 FORMAT "%13.4" ARRAY_SIZE 4 ECU_ADDRESS 0x70001974 /end MEASUREMENT
/begin MEASUREMENT anzesab_w_msg "Injection abortion counter" UWORD dez 1 100 0.00 65535.00 FORMAT "%8.2" ECU_ADDRESS 0x70001C8A /end MEASUREMENT
/begin MEASUREMENT anztib_msg "injection counter limited" UBYTE dez 1 100 0.00 255.0 FORMAT "%5.1" ECU_ADDRESS 0x600007B0 /end MEASUREMENT
/begin MEASUREMENT anztib_w_msg "injection counter with limit" UWORD dez 1 100 0.00 65535.00 FORMAT "%8.2" ECU_ADDRESS 0x600005BC /end MEASUREMENT
/begin MEASUREMENT anzti_msg "injection counter" UBYTE dez 1 100 0.00 255.0 FORMAT "%5.1" ECU_ADDRESS 0x500008B6 /end MEASUREMENT
/begin MEASUREMENT anzti_w_msg "injection counter" UWORD dez 1 100 0.00 65535.00 FORMAT "%8.2" ECU_ADDRESS 0x500007A0 /end MEASUREMENT
/begin MEASUREMENT azoffmsk_w_msg "Fade out mask ignition output" UWORD OneToOne 1 100 0.00 65535.00 FORMAT "%8.2" ECU_ADDRESS 0x600005C6 /end MEASUREMENT
/begin MEASUREMENT B_ctfa1fcl_msg "Condition: clear fault-path <E_TFA1CS>" UBYTE B_TRUE 1 100 0.00 1.00000000000 BIT_MASK 0x1 FORMAT "%13.11" ECU_ADDRESS 0x70000AA4 /end MEASUREMENT
/begin MEASUREMENT B_ctfa1prm_msg "Diagnosis enabling for tfa1-sensor at coldstart (FID)" UBYTE B_TRUE 1 100 0.00 1.00000000000 BIT_MASK 0x1 FORMAT "%13.11" ECU_ADDRESS 0x70000AA3 /end MEASUREMENT
/begin MEASUREMENT B_detakhap "correction of desired engine efficiency for catalyst heating" UBYTE B_TRUE 1 100 0.00 1.00000000000 BIT_MASK 0x1 FORMAT "%13.11" ECU_ADDRESS 0x700001E1 /end MEASUREMENT
/begin MEASUREMENT B_etfa1fcl_msg "Condition: clear fault-path <E_TFA1E>" UBYTE B_TRUE 1 100 0.00 1.00000000000 BIT_MASK 0x1 FORMAT "%13.11" ECU_ADDRESS 0x70000A70 /end MEASUREMENT
/begin MEASUREMENT B_firstSyn "Condition: First synchro after synchronization" UBYTE B_TRUE 1 100 0.00 1.00000000000 BIT_MASK 0x1 FORMAT "%13.11" ECU_ADDRESS 0x50000845 /end MEASUREMENT
/begin MEASUREMENT B_firstSynAftFco "Condition: First synchro after fuel cut-off" UBYTE B_TRUE 1 100 0.00 1.00000000000 BIT_MASK 0x1 FORMAT "%13.11" ECU_ADDRESS 0x600000E2 /end MEASUREMENT
/begin MEASUREMENT B_kldynrm "Condition normal knocking with adapted load dynamic" UBYTE B_TRUE 1 100 0.00 1.00000000000 BIT_MASK 0x1 FORMAT "%13.11" ECU_ADDRESS 0x700001C8 /end MEASUREMENT
/begin MEASUREMENT B_kldystk "Condition heavy knocking with adapted load dynamic" UBYTE B_TRUE 1 100 0.00 1.00000000000 BIT_MASK 0x1 FORMAT "%13.11" ECU_ADDRESS 0x700001C7 /end MEASUREMENT
/begin MEASUREMENT B_koevab_msg "injection valve cutoff active by function KOEVAB" UBYTE B_TRUE 1 100 0.00 1.00000000000 BIT_MASK 0x1 FORMAT "%13.11" ECU_ADDRESS 0x70000A1C /end MEASUREMENT
/begin MEASUREMENT B_ptfa1fcl_msg "request for clearing plaus-error of TFA1" UBYTE B_TRUE 1 100 0.00 1.00000000000 BIT_MASK 0x1 FORMAT "%13.11" ECU_ADDRESS 0x700009C7 /end MEASUREMENT
/begin MEASUREMENT B_ptfa1prm_msg "diagnosis-release (FID) for manifold-air temperature sensor TFA1" UBYTE B_TRUE 1 100 0.00 1.00000000000 BIT_MASK 0x1 FORMAT "%13.11" ECU_ADDRESS 0x700009C6 /end MEASUREMENT
/begin MEASUREMENT B_stfmf "" UBYTE B_TRUE 1 100 0.00 1.00000000000 BIT_MASK 0x1 FORMAT "%13.11" ECU_ADDRESS 0x700001D3 /end MEASUREMENT
/begin MEASUREMENT B_tansgg_msg "valid-flag for tfa1-sensor" UBYTE B_TRUE 1 100 0.00 1.00000000000 BIT_MASK 0x1 FORMAT "%13.11" ECU_ADDRESS 0x70000992 /end MEASUREMENT
/begin MEASUREMENT B_tansnmot "Local bit: value of turnOffDelay for B_nmot" UBYTE B_TRUE 1 100 0.00 1.00000000000 BIT_MASK 0x1 FORMAT "%13.11" ECU_ADDRESS 0x700001F7 /end MEASUREMENT
/begin MEASUREMENT B_tasrgg_msg "Intake air temperature tasrg_w is valid" UBYTE B_TRUE 1 100 0.00 1.00000000000 BIT_MASK 0x1 FORMAT "%13.11" ECU_ADDRESS 0x70000990 /end MEASUREMENT
/begin MEASUREMENT B_tasrg_msg "Condition tasr is valid" UBYTE B_TRUE 1 100 0.00 1.00000000000 BIT_MASK 0x1 FORMAT "%13.11" ECU_ADDRESS 0x70000991 /end MEASUREMENT
/begin MEASUREMENT B_tavdkg_msg "Condition temperature upstream throttle blade valid" UBYTE B_TRUE 1 100 0.00 1.00000000000 BIT_MASK 0x1 FORMAT "%13.11" ECU_ADDRESS 0x7000098E /end MEASUREMENT
/begin MEASUREMENT B_tfa1gg_msg "valid flag for TFA1-sensor" UBYTE B_TRUE 1 100 0.00 1.00000000000 BIT_MASK 0x1 FORMAT "%13.11" ECU_ADDRESS 0x70000984 /end MEASUREMENT
/begin MEASUREMENT B_tfa1rg_msg "sensor tfa1 is electrical valid" UBYTE B_TRUE 1 100 0.00 1.00000000000 BIT_MASK 0x1 FORMAT "%13.11" ECU_ADDRESS 0x70000983 /end MEASUREMENT
/begin MEASUREMENT B_tfastz "Intake air temperature: first start value of driving cycle is written" UBYTE B_TRUE 1 100 0.00 1.00000000000 BIT_MASK 0x1 FORMAT "%13.11" ECU_ADDRESS 0x700001F6 /end MEASUREMENT
/begin MEASUREMENT B_zesync_msg "Condition ignition synchronized" UBYTE B_TRUE 1 100 0.00 1.00000000000 BIT_MASK 0x1 FORMAT "%13.11" ECU_ADDRESS 0x6000E3F8 /end MEASUREMENT
/begin MEASUREMENT B_zwetakh "desired engine efficiency for catalyst heating over ignition timing" UBYTE B_TRUE 1 100 0.00 1.00000000000 BIT_MASK 0x1 FORMAT "%13.11" ECU_ADDRESS 0x700001E0 /end MEASUREMENT
/begin MEASUREMENT Com_flgIDASBNorm "IDASB Frame communication normal flag. (FId_ComIDASB is not inhibited)" UBYTE B_TRUE 1 100 0.00 1.00000000000 BIT_MASK 0x1 FORMAT "%13.11" ECU_ADDRESS 0x6000A1B4 /end MEASUREMENT
/begin MEASUREMENT CoVeh_stIgnLckTerm15 "Status Terminal 15" UBYTE OneToOne 1 100 0.00 255.0 FORMAT "%5.1" ECU_ADDRESS 0x6000A660 /end MEASUREMENT
/begin MEASUREMENT CoVeh_stIgnLckTerm50 "Status Terminal 50" UBYTE OneToOne 1 100 0.00 255.0 FORMAT "%5.1" ECU_ADDRESS 0x6000A65F /end MEASUREMENT
/begin MEASUREMENT dymntvs "Knock control: current min. additional dynamic reponse" SBYTE kw_q0p75 1 100 -96.00 95.25 FORMAT "%5.2" ECU_ADDRESS 0x70001952 /end MEASUREMENT
/begin MEASUREMENT etaaktsl_w_msg "desired engine efficiency for secondary air active diagnosis" UWORD fak_uw_b2 1 100 0.00 1.999969 FORMAT "%8.6" ECU_ADDRESS 0x60004848 /end MEASUREMENT
/begin MEASUREMENT etakhaw_w "choiced desired engine efficiency for catalyst heating" UWORD fak_uw_b2 1 100 0.00 1.999969 FORMAT "%8.6" ECU_ADDRESS 0x6000376A /end MEASUREMENT
/begin MEASUREMENT etakhbg_w "limitation of desired engine efficiency for catalyst heating in dependence of brake booster" UWORD fak_uw_b2 1 100 0.00 1.999969 FORMAT "%8.6" ECU_ADDRESS 0x60003768 /end MEASUREMENT
/begin MEASUREMENT etakhdia_w_msg "desired engine efficiency for catalyst heating (tester interface to diagnostic function)" UWORD fak_uw_b2 1 100 0.00 1.999969 FORMAT "%8.6" ECU_ADDRESS 0x60004844 /end MEASUREMENT
/begin MEASUREMENT etakhktd_w "desired engine efficiency for catalyst heating by cold start (for diagnosis)" UWORD fak_uw_b2 1 100 0.00 1.999969 FORMAT "%8.6" ECU_ADDRESS 0x60003766 /end MEASUREMENT
/begin MEASUREMENT etakhktl_w_msg "desired engine efficiency for catalyst heating by cold engine during idle speed" UWORD fak_uw_b2 1 100 0.00 1.999969 FORMAT "%8.6" ECU_ADDRESS 0x60004842 /end MEASUREMENT
/begin MEASUREMENT etakhktn_w "desired engine efficiency (nominal) for catalyst heating by cold start" UWORD fak_uw_b2 1 100 0.00 1.999969 FORMAT "%8.6" ECU_ADDRESS 0x60003764 /end MEASUREMENT
/begin MEASUREMENT etakhktt_w_msg "desired engine efficiency for catalyst heating by cold engine during part load" UWORD fak_uw_b2 1 100 0.00 1.999969 FORMAT "%8.6" ECU_ADDRESS 0x6000E308 /end MEASUREMENT
/begin MEASUREMENT etakhkt_w "desired engine efficiency for catalyst heating by cold start" UWORD fak_uw_b2 1 100 0.00 1.999969 FORMAT "%8.6" ECU_ADDRESS 0x60003762 /end MEASUREMENT
/begin MEASUREMENT etakhkw_w "desired engine efficiency for catalyst heating in case of catalyst warming" UWORD fak_uw_b2 1 100 0.00 1.999969 FORMAT "%8.6" ECU_ADDRESS 0x60003760 /end MEASUREMENT
/begin MEASUREMENT etakhsv_w "desired engine efficiency for catalyst heating (adaption over service tester)" UWORD fak_uw_b2 1 100 0.00 1.999969 FORMAT "%8.6" ECU_ADDRESS 0x6000375E /end MEASUREMENT
/begin MEASUREMENT etakh_w_msg "desired engine efficiency for catalyst heating" UWORD fak_uw_b2 1 100 0.00 1.999969 FORMAT "%8.6" ECU_ADDRESS 0x60004846 /end MEASUREMENT
/begin MEASUREMENT etaktlbg_w_msg "maximum allowed desired engine efficiency for catalyst heating by coldstart during idle" UWORD fak_uw_b2 1 100 0.00 1.999969 FORMAT "%8.6" ECU_ADDRESS 0x60004840 /end MEASUREMENT
/begin MEASUREMENT etakttbg_w_msg "maximum allowed desired engine efficiency for catalyst heating by coldstart during part load" UWORD fak_uw_b2 1 100 0.00 1.999969 FORMAT "%8.6" ECU_ADDRESS 0x6000483E /end MEASUREMENT
/begin MEASUREMENT etazwmnk_w "minimum ignition angle effectiveness by catalyst heating" UWORD fak_uw_b2 1 100 0.00 1.999969 FORMAT "%8.6" ECU_ADDRESS 0x6000375C /end MEASUREMENT
/begin MEASUREMENT ExhMgt_cntrIniDrvEngDgrdCatHeatg "Counter for IniDrive request for KHMR" UBYTE OneToOne 1 100 0.00 255.0 FORMAT "%5.1" ECU_ADDRESS 0x60006411 /end MEASUREMENT
/begin MEASUREMENT ExhMgt_cntrReIniEngDgrdCatHeatg "Counter for Re-Initialization request for HKMR, 1_100ms" UBYTE OneToOne 1 100 0.00 255.0 FORMAT "%5.1" ECU_ADDRESS 0x60006410 /end MEASUREMENT
/begin MEASUREMENT ExhMgt_cntrReIniEngDgrdCatHeatg10ms "Counter for Re-Initialization request for HKMR, 10ms" UBYTE OneToOne 1 100 0.00 255.0 FORMAT "%5.1" ECU_ADDRESS 0x60006412 /end MEASUREMENT
/begin MEASUREMENT ExhMgt_cntrReIniEngDgrdCatHeatg2 "Counter for Re-Initialization request for HKMR, 2_100ms" UBYTE OneToOne 1 100 0.00 255.0 FORMAT "%5.1" ECU_ADDRESS 0x6000640F /end MEASUREMENT
/begin MEASUREMENT ExhMgT_effCatHeatgLim "desired engine efficiency for catalyst heating" UWORD fak_uw_b2 1 100 0.00 1.999969 FORMAT "%8.6" ECU_ADDRESS 0x6000375A /end MEASUREMENT
/begin MEASUREMENT ExhMgT_effMinDeltaCatHeatg "distance to latest allowed ignition angle efficiency" UWORD fak_uw_b2 1 100 0.00 1.999969 FORMAT "%8.6" ECU_ADDRESS 0x60003758 /end MEASUREMENT
/begin MEASUREMENT ExhMgt_etaCatHeatg "eta catalyst heating idle" UWORD fak_uw_b2 1 100 0.00 1.999969 FORMAT "%8.6" ECU_ADDRESS 0x60003756 /end MEASUREMENT
/begin MEASUREMENT ExhMgT_etaCatHeatgNomFild "desired engine efficiency (nominal and filtered) for catalyst heating in case of catalyst warming" UWORD fak_uw_b2 1 100 0.00 1.999969 FORMAT "%8.6" ECU_ADDRESS 0x60003754 /end MEASUREMENT
/begin MEASUREMENT ExhMgT_etaCatHeatgWght "desired engine efficiency (nominal and weighted) for catalyst heating in case of catalyst warming" UWORD fak_uw_b2 1 100 0.00 1.999969 FORMAT "%8.6" ECU_ADDRESS 0x60003752 /end MEASUREMENT
/begin MEASUREMENT ExhMgT_etaSpCatWrm "desired engine efficiency for catalyst heatingin case of catalyst warming" UWORD fak_uw_b2 1 100 0.00 1.999969 FORMAT "%8.6" ECU_ADDRESS 0x60003750 /end MEASUREMENT
/begin MEASUREMENT ExhMgT_etaSpCatWrmIdle "desired engine efficiency for catalyst warming in idle" UWORD fak_uw_b2 1 100 0.00 1.999969 FORMAT "%8.6" ECU_ADDRESS 0x600048EA /end MEASUREMENT
/begin MEASUREMENT ExhMgT_etaSpCatWrmPartLoad "desired engine efficiency for catalyst warming during part load" UWORD fak_uw_b2 1 100 0.00 1.999969 FORMAT "%8.6" ECU_ADDRESS 0x600048E8 /end MEASUREMENT
/begin MEASUREMENT ExhMgT_facCatHeatgAge "control factor for desired engine efficiency for catalyst heating because of a cold start because of catalyst ageing" UBYTE fak_ub_b2 1 100 0.00 1.992188 FORMAT "%8.6" ECU_ADDRESS 0x6000640E /end MEASUREMENT
/begin MEASUREMENT ExhMgT_facCorrnEtaEngCatHeatg "correction factor for desired engine efficiency by catalyst heating in case of cold start" UWORD fak_q0p00781 1 100 0.00 16.00000 FORMAT "%8.5" ECU_ADDRESS 0x6000374E /end MEASUREMENT
/begin MEASUREMENT ExhMgT_facEngEffCorrnIdle "factor for correction of desired engine efficiency for catalyst heating during idle from the tester" UBYTE fak_ub_b2 1 100 0.00 1.992188 FORMAT "%8.6" ECU_ADDRESS 0x6000640D /end MEASUREMENT
/begin MEASUREMENT ExhMgT_facEngEffCorrnPartLoad "factor for correction of desired engine efficiency for catalyst heating during part load from the tester" UBYTE fak_ub_b2 1 100 0.00 1.992188 FORMAT "%8.6" ECU_ADDRESS 0x6000640C /end MEASUREMENT
/begin MEASUREMENT ExhMgT_facEtaCatAge "weighting factor during catalyst cold start heating depending on catalyst aging" UWORD fak_q0p00781 1 100 0.00 32.00000 FORMAT "%8.5" ECU_ADDRESS 0x6000374C /end MEASUREMENT
/begin MEASUREMENT ExhMgT_facEtaCatHeatg "control factor for desired engine efficiency by catalyst heating in case of cold start" UWORD fak_q0p00781 1 100 0.00 64.00000 FORMAT "%8.5" ECU_ADDRESS 0x6000374A /end MEASUREMENT
/begin MEASUREMENT ExhMgT_facEtaCatWrmAltiT "control factor for desired engine efficiency by catalyst heating in case of catalyst warming depending on altitude and engine temperature" UBYTE fak_ub_b2 1 100 0.00 1.992188 FORMAT "%8.6" ECU_ADDRESS 0x6000A066 /end MEASUREMENT
/begin MEASUREMENT ExhMgT_facEtaColdStrtHeatgAltiT "control factor for desired engine efficiency by catalyst heating in case of catalyst cold start depending on altitude and engine start temperature" UBYTE fak_ub_b2 1 100 0.00 1.992188 FORMAT "%8.6" ECU_ADDRESS 0x6000A065 /end MEASUREMENT
/begin MEASUREMENT ExhMgT_facEtaEngCatHeatg "control factor for desired engine efficiency by catalyst heating in case of cold start" UBYTE fak_ub_b2 1 100 0.00 1.992188 FORMAT "%8.6" ECU_ADDRESS 0x6000A064 /end MEASUREMENT
/begin MEASUREMENT ExhMgt_facIntrpnCatHeatgEta "Interpolation factor idle to partload" UBYTE fak_ub_b1 1 100 0.00 0.9961 ECU_ADDRESS 0x6000640B /end MEASUREMENT
/begin MEASUREMENT ExhMgT_facWghCatWrm "factor for weighting catalyst heating requested for catalyst warming" UWORD fak_uw_b2 1 100 0.00 1.999969 FORMAT "%8.6" ECU_ADDRESS 0x60003748 /end MEASUREMENT
/begin MEASUREMENT ExhMgT_facWghCatWrmLim "weighting factor for desired engine efficiency for catalyst warming (after change limitation)" UWORD fak_uw_b2 1 100 0.00 1.999969 FORMAT "%8.6" ECU_ADDRESS 0x60003746 /end MEASUREMENT
/begin MEASUREMENT ExhMgT_facWghCatWrmTwc "factor for weighting catalyst heating requested for three way catalyst heating (via catalyst warming measurement)" UWORD fak_uw_b2 1 100 0.00 1.999969 FORMAT "%8.6" ECU_ADDRESS 0x6000E202 /end MEASUREMENT
/begin MEASUREMENT ExhMgT_fetakhllfa_msg "factor for correction of desired engine efficiency for catalyst heating during idle" UBYTE fak_ub_b2 1 100 0.00 1.992188 FORMAT "%8.6" ECU_ADDRESS 0x6000A063 /end MEASUREMENT
/begin MEASUREMENT ExhMgT_fetakhtlfa_msg "factor for correction of desired engine efficiency for catalyst heating during part load" UBYTE fak_ub_b2 1 100 0.00 1.992188 FORMAT "%8.6" ECU_ADDRESS 0x6000A062 /end MEASUREMENT
/begin MEASUREMENT ExhMgT_flgActvAltiBasdCorrn "flag to calculate desired engine efficiency by catalyst heating in case of cold start is calculated by consideration of interpolation of high altitude and low altitude maps" UBYTE B_TRUE 1 100 0.00 1.00000000000 BIT_MASK 0x1 FORMAT "%13.11" ECU_ADDRESS 0x6000640A /end MEASUREMENT
/begin MEASUREMENT ExhMgT_flgAvsSetIdle "specification of the value of desired engine efficiencyfrom tester during idle" UBYTE B_TRUE 1 100 0.00 1.00000000000 BIT_MASK 0x1 FORMAT "%13.11" ECU_ADDRESS 0x700001DF /end MEASUREMENT
/begin MEASUREMENT ExhMgT_flgAvsSetPartLoad "specification of the value of desired engine efficiencyfrom tester during part load" UBYTE B_TRUE 1 100 0.00 1.00000000000 BIT_MASK 0x1 FORMAT "%13.11" ECU_ADDRESS 0x700001DE /end MEASUREMENT
/begin MEASUREMENT ExhMgT_flgCatHeatgBreak "enabling or disbling condition based on the catalyst heating request" UBYTE B_TRUE 1 100 0.00 1.00000000000 BIT_MASK 0x1 FORMAT "%13.11" ECU_ADDRESS 0x700001DD /end MEASUREMENT
/begin MEASUREMENT ExhMgT_flgCatHeatgRstCdn "reset condition catalyst cold start heating" UBYTE B_TRUE 1 100 0.00 1.00000000000 BIT_MASK 0x1 FORMAT "%13.11" ECU_ADDRESS 0x700001DC /end MEASUREMENT
/begin MEASUREMENT ExhMgT_flgCatWrmEngEffIa "calculation of engine efficiency worsening in dependence of ignition angle" UBYTE B_TRUE 1 100 0.00 1.00000000000 BIT_MASK 0x1 FORMAT "%13.11" ECU_ADDRESS 0x700001DB /end MEASUREMENT
/begin MEASUREMENT ExhMgT_flgfacWghCatWrmActv "weighting factor for desired engine efficiency for catalyst warming greater zero" UBYTE B_TRUE 1 100 0.00 1.00000000000 BIT_MASK 0x1 FORMAT "%13.11" ECU_ADDRESS 0x700001DA /end MEASUREMENT
/begin MEASUREMENT ExhMgT_iaCatWrmIdle "desired ignition-timing for catalyst warming in idle" SBYTE zw_sb_q0p75 1 100 -96.00 95.25 FORMAT "%5.2" ECU_ADDRESS 0x60006409 /end MEASUREMENT
/begin MEASUREMENT ExhMgT_iaCatWrmPartLoad "desired ignition-timing for catalyst warming during part load" SBYTE zw_sb_q0p75 1 100 -96.00 95.25 FORMAT "%5.2" ECU_ADDRESS 0x60006408 /end MEASUREMENT
/begin MEASUREMENT ExhMgT_tEngCatHeatgDif "rate of change of engine temperature" UWORD temp_q0p1_K 1 100 0.00 6553.500 FORMAT "%8.3" ECU_ADDRESS 0x60003744 /end MEASUREMENT
/begin MEASUREMENT ExhMgT_tEngCatHeatgFild "filtered engine temperature for catalyst heating" SWORD Temp_Cels 1 100 -3549.940 3003.560 FORMAT "%8.3" ECU_ADDRESS 0x60004A9A /end MEASUREMENT
/begin MEASUREMENT ExhMgT_tOilMdlCatHeatg "Modelled Oil temperature at the beginning of cold start heating" SWORD Temp_Cels 1 100 -3549.940 3003.560 FORMAT "%8.3" ECU_ADDRESS 0x60003742 /end MEASUREMENT
/begin MEASUREMENT firstSynAftFcoInjA "First synchro after fuel cut-off forInjector A" UBYTE OneToOne 1 100 0.00 255.0 FORMAT "%5.1" ECU_ADDRESS 0x60006436 /end MEASUREMENT
/begin MEASUREMENT firstSynInjA "First synchro after synchronization for injector A" UBYTE OneToOne 1 100 0.00 255.0 FORMAT "%5.1" ECU_ADDRESS 0x60006435 /end MEASUREMENT
/begin MEASUREMENT frstinjcyl "cylinder number first injection" UBYTE dez 1 100 0.00 255.0 FORMAT "%5.1" ECU_ADDRESS 0x50000876 /end MEASUREMENT
/begin MEASUREMENT frstinjcylAftFco "cylinder number first injection after fuel cutoff" UBYTE dez 1 100 0.00 255.0 FORMAT "%5.1" ECU_ADDRESS 0x7000195C /end MEASUREMENT
/begin MEASUREMENT frstinjcylAftFcoInjA "cylinder number first injection after fuel cut off for inj A" UBYTE dez 1 100 0.00 255.0 FORMAT "%5.1" ECU_ADDRESS 0x70001971 /end MEASUREMENT
/begin MEASUREMENT frstinjcylInjA "cylinder number first injection for Inj A" UBYTE dez 1 100 0.00 255.0 FORMAT "%5.1" ECU_ADDRESS 0x70001970 /end MEASUREMENT
/begin MEASUREMENT frstinjcyl_msg "cylinder number first injection" UBYTE dez 1 100 0.00 255.0 FORMAT "%5.1" ECU_ADDRESS 0x500008BB /end MEASUREMENT
/begin MEASUREMENT fstetakhkw "control factor for desired engine efficiency by catalyst heating in case of catalyst warming" UBYTE fak_ub_b2 1 100 0.00 1.992188 FORMAT "%8.6" ECU_ADDRESS 0x60006407 /end MEASUREMENT
/begin MEASUREMENT fstkttmsfh "control factor for desired engine efficiency by catalyst heating in case of cold start in dependence of engine start temperature and altitude" UBYTE fak_ub_b2 1 100 0.00 1.992188 FORMAT "%8.6" ECU_ADDRESS 0x60006406 /end MEASUREMENT
/begin MEASUREMENT fwetakhkt_msg "weighting factor for desired engine efficiency by catalyst heating in case of cold start" UBYTE fak_ub_b1 1 100 0.00 0.9961 ECU_ADDRESS 0x60009FF5 /end MEASUREMENT
/begin MEASUREMENT fwsanfdlut_msg "weighting factor for engine efficiency in case of catalyst heating by cold start in dependence on irregular running" UBYTE fak_ub_b2 1 100 0.00 1.992188 FORMAT "%8.6" ECU_ADDRESS 0x60009FF4 /end MEASUREMENT
/begin MEASUREMENT iats2sva_loc "PID68h, Data Byte A" UBYTE dez 1 100 0.00 255.0 FORMAT "%5.1" ECU_ADDRESS 0x6000644E /end MEASUREMENT
/begin MEASUREMENT iats2sva_msg "PID68h, Data Byte A" UBYTE dez 1 100 0.00 255.0 FORMAT "%5.1" ECU_ADDRESS 0x60009FF3 /end MEASUREMENT
/begin MEASUREMENT iats2svb_loc "PID68h, Data Byte B" UBYTE temp_ub_q1_o40 1 100 -40.0 215.0 FORMAT "%5.1" ECU_ADDRESS 0x6000644D /end MEASUREMENT
/begin MEASUREMENT iats2svb_msg "PID68h, Data Byte B" UBYTE temp_ub_q1_o40 1 100 -40.0 215.0 FORMAT "%5.1" ECU_ADDRESS 0x60009FF2 /end MEASUREMENT
/begin MEASUREMENT iats2svc_loc "PID68h, Data Byte C" UBYTE temp_ub_q1_o40 1 100 -40.0 215.0 FORMAT "%5.1" ECU_ADDRESS 0x6000644C /end MEASUREMENT
/begin MEASUREMENT iats2svc_msg "PID68h, Data Byte C" UBYTE temp_ub_q1_o40 1 100 -40.0 215.0 FORMAT "%5.1" ECU_ADDRESS 0x60009FF1 /end MEASUREMENT
/begin MEASUREMENT iats2svd_loc "PID68h, Data Byte D" UBYTE temp_ub_q1_o40 1 100 -40.0 215.0 FORMAT "%5.1" ECU_ADDRESS 0x6000644B /end MEASUREMENT
/begin MEASUREMENT iats2svd_msg "PID68h, Data Byte D" UBYTE temp_ub_q1_o40 1 100 -40.0 215.0 FORMAT "%5.1" ECU_ADDRESS 0x60009FF0 /end MEASUREMENT
/begin MEASUREMENT iats2sve_loc "PID68h, Data Byte E" UBYTE temp_ub_q1_o40 1 100 -40.0 215.0 FORMAT "%5.1" ECU_ADDRESS 0x6000644A /end MEASUREMENT
/begin MEASUREMENT iats2sve_msg "PID68h, Data Byte E" UBYTE temp_ub_q1_o40 1 100 -40.0 215.0 FORMAT "%5.1" ECU_ADDRESS 0x60009FEF /end MEASUREMENT
/begin MEASUREMENT iats2svf_loc "PID68h, Data Byte F" UBYTE temp_ub_q1_o40 1 100 -40.0 215.0 FORMAT "%5.1" ECU_ADDRESS 0x60006449 /end MEASUREMENT
/begin MEASUREMENT iats2svf_msg "PID68h, Data Byte F" UBYTE temp_ub_q1_o40 1 100 -40.0 215.0 FORMAT "%5.1" ECU_ADDRESS 0x60009FEE /end MEASUREMENT
/begin MEASUREMENT iats2svg_loc "PID68h, Data Byte G" UBYTE temp_ub_q1_o40 1 100 -40.0 215.0 FORMAT "%5.1" ECU_ADDRESS 0x60006448 /end MEASUREMENT
/begin MEASUREMENT iats2svg_msg "PID68h, Data Byte G" UBYTE temp_ub_q1_o40 1 100 -40.0 215.0 FORMAT "%5.1" ECU_ADDRESS 0x60009FED /end MEASUREMENT
/begin MEASUREMENT IgCtl_diaBascLam "lambda dependent delta ignition angle to be added on basic ignition angle" SWORD zw_q0p1 1 100 -96.00000 95.30000 FORMAT "%8.5" ECU_ADDRESS 0x70001D8E /end MEASUREMENT
/begin MEASUREMENT IgCtl_diaBascLamCptProtn "Basic ignition angle offset due to lambda for component protection" SWORD zw_q0p1 1 100 -96.00000 95.30000 FORMAT "%8.5" ECU_ADDRESS 0x70001D8C /end MEASUREMENT
/begin MEASUREMENT IgCtl_diaBascLamWoRefIa "Lambda dependent delta ignition angle without consideration of lambda dependent reference ignition angle offset from torque model (for example dzwol_w_msg)" SWORD zw_q0p1 1 100 -96.00000 95.30000 FORMAT "%8.5" ECU_ADDRESS 0x70001D8A /end MEASUREMENT
/begin MEASUREMENT IgCtl_diaLteLamLoResl "lambda dependend delta ignition angle to be added to the late border of the ignition angle" SBYTE kw_q0p75 1 100 -96.00 95.25 FORMAT "%5.2" ECU_ADDRESS 0x70001C47 /end MEASUREMENT
/begin MEASUREMENT IgCtl_facBascLamOperPnt "operation point dependent factor for basic ignition angle offset due to lambda" SWORD RBPtCel_fac_6p10352em5_1 1 100 -2.000000 1.999939 FORMAT "%8.6" ECU_ADDRESS 0x7000199A /end MEASUREMENT
/begin MEASUREMENT IgCtl_facLteLamOperPnt "operation point dependent factor for late ignition angle offset due to lambda" SWORD RBPtCel_fac_6p10352em5_1 1 100 -2.000000 1.999939 FORMAT "%8.6" ECU_ADDRESS 0x70001998 /end MEASUREMENT
/begin MEASUREMENT IgCtl_ratLam "air-fuel-ratio for the ignition" UWORD fak_uw_b16 1 100 0.00 15.99976 FORMAT "%8.5" ECU_ADDRESS 0x70001996 /end MEASUREMENT
/begin MEASUREMENT ignactf_w "Activity flag for ignition channels" UWORD OneToOne 1 100 0.00 65535.00 FORMAT "%8.2" ECU_ADDRESS 0x5000599E /end MEASUREMENT
/begin MEASUREMENT IgnClPsDD_DataRaw3 "Raw data 3" ULONG dez 1 100 0.00 4294967295.00 FORMAT "%13.2" ECU_ADDRESS 0x50001718 /end MEASUREMENT
/begin MEASUREMENT IgnClPs_DiaEnaIgn "bitmask activation ignition channel diagnosis" UWORD dez 1 100 0.00 65535.00 FORMAT "%8.2" ECU_ADDRESS 0x60003792 /end MEASUREMENT
/begin MEASUREMENT IgnClPs_flgDiagEnad "Flag ignition line diagnosis enabled" UBYTE B_TRUE 1 100 0.00 1.00000000000 BIT_MASK 0x1 FORMAT "%13.11" ECU_ADDRESS 0x6000A7C8 /end MEASUREMENT
/begin MEASUREMENT IgnClPs_IgnCntCurr "Diagnosis ignition counter current" UWORD dez 1 100 0.00 65535.00 FORMAT "%8.2" ECU_ADDRESS 0x60003790 /end MEASUREMENT
/begin MEASUREMENT IgnClPs_IgnCntOld "Diagnosis ignition counter old" UWORD dez 1 100 0.00 65535.00 FORMAT "%8.2" ECU_ADDRESS 0x6000378E /end MEASUREMENT
/begin MEASUREMENT IgnClPs_LineDiagErrMsk "Bitmask ignition line error" UWORD dez 1 100 0.00 65535.00 FORMAT "%8.2" ECU_ADDRESS 0x6000378C /end MEASUREMENT
/begin MEASUREMENT IgnClPs_LineDiagExec "Bitmask ignition line diagnosis executed" UWORD dez 1 100 0.00 65535.00 FORMAT "%8.2" ECU_ADDRESS 0x6000378A /end MEASUREMENT
/begin MEASUREMENT IgnClPs_ResLineDiag "result ignition line diagnosis" UBYTE IgnClPs_LineDiag_VERB 1 100 0.00 8.00000000000 FORMAT "%13.11" ARRAY_SIZE 4 ECU_ADDRESS 0x60006439 /end MEASUREMENT
/begin MEASUREMENT IgnClPs_valDiaRes "Ignition powerstage error flag word (debounced)" UWORD dez 1 100 0.00 65535.00 FORMAT "%8.2" ECU_ADDRESS 0x60003788 /end MEASUREMENT
/begin MEASUREMENT IgnDD_agIAmaxEffective "current abort angle" SWORD zw_q0p1 1 100 -3276.800 3276.700 FORMAT "%8.3" ECU_ADDRESS 0x50000624 /end MEASUREMENT
/begin MEASUREMENT igndd_cylFreeze "bitcoded cylinderno. with freezed paremeters" UBYTE OneToOne 1 100 0.00 255.0 FORMAT "%5.1" ECU_ADDRESS 0x50005D65 /end MEASUREMENT
/begin MEASUREMENT igndd_fdOutPattern_u16 "Current fade out pattern" UWORD OneToOne 1 100 0.00 65535.00 FORMAT "%8.2" ECU_ADDRESS 0x60000488 /end MEASUREMENT
/begin MEASUREMENT igndd_fdPatArray_u16 "Ausblendmuster (Feld indiziert nach Ausblendanfordererer)" UWORD OneToOne 1 100 0.00 65535.00 FORMAT "%8.2" ARRAY_SIZE 27 ECU_ADDRESS 0x500059A0 /end MEASUREMENT
/begin MEASUREMENT IgnDD_flgIAmaxDone "Flag maximum late angle == SY_WMIN" UBYTE B_TRUE 1 100 0.00 1.00000000000 BIT_MASK 0x1 FORMAT "%13.11" ECU_ADDRESS 0x600006FB /end MEASUREMENT
/begin MEASUREMENT igndd_flgWFSDetd "Immobalizer Request Detection Flag" UBYTE B_TRUE 1 100 0.00 1.00000000000 BIT_MASK 0x1 FORMAT "%13.11" ECU_ADDRESS 0x60006438 /end MEASUREMENT
/begin MEASUREMENT igndd_flgWFSDetd_Temp "Immobalizer Request Detection Flag Temporary" UBYTE B_TRUE 1 100 0.00 1.00000000000 BIT_MASK 0x1 FORMAT "%13.11" ECU_ADDRESS 0x60006437 /end MEASUREMENT
/begin MEASUREMENT IgnDD_nrCurrNxtCylInfo_a "cyl.numbers for which new ign.angle values are to be calculated in current early sync (message should be read as optimized)" UBYTE OneToOne 1 100 0.00 255.0 FORMAT "%5.1" ARRAY_SIZE 2 ECU_ADDRESS 0x70001BDD /end MEASUREMENT
/begin MEASUREMENT igndd_nrIgnCntrValOnWFSDetn "Immobalizer Request Detection Ignition counter" UWORD OneToOne 1 100 0.00 65535.00 FORMAT "%8.2" ECU_ADDRESS 0x70001994 /end MEASUREMENT
/begin MEASUREMENT IgnDD_nrOvlCntr_u8 "Start-Dwell overlap counter (message should be read as optimized)" UBYTE OneToOne 1 100 0.00 255.0 FORMAT "%5.1" ECU_ADDRESS 0x70001BDC /end MEASUREMENT
/begin MEASUREMENT igndd_oldIgnCntVal_u8 "Old value of the hardware driver ignition counter" UBYTE OneToOne 1 100 0.00 255.0 FORMAT "%5.1" ECU_ADDRESS 0x6000B981 /end MEASUREMENT
/begin MEASUREMENT igndd_ovl_u8 "Start-Dwell overlap counter" UBYTE OneToOne 1 100 0.00 255.0 FORMAT "%5.1" ECU_ADDRESS 0x50005D66 /end MEASUREMENT
/begin MEASUREMENT igndd_state "internal state IgnDD" SLONG OneToOne 1 100 -2147483648.00 2147483647.00 FORMAT "%13.2" ECU_ADDRESS 0x6000D6A0 /end MEASUREMENT
/begin MEASUREMENT igndd_TiDwlMax_u16 "Max dwell time for Ignition coil in angle mode." UWORD t_q0p001_ms 1 100 0.00 65.53500 FORMAT "%8.5" ECU_ADDRESS 0x70002BAE /end MEASUREMENT
/begin MEASUREMENT igndd_TiDwlMin_u16 "Min dwell time for Ignition coil in angle mode" UWORD t_q0p001_ms 1 100 0.00 65.53500 FORMAT "%8.5" ECU_ADDRESS 0x70002BB0 /end MEASUREMENT
/begin MEASUREMENT igndd_zwFreeze_w "freezed ignition angles (cyl.individual)" SWORD zw_q0p1 1 100 -3276.800 3276.700 FORMAT "%8.3" ARRAY_SIZE 4 ECU_ADDRESS 0x500059D6 /end MEASUREMENT
/begin MEASUREMENT ignFadeStatBits_u32 "Ignition fade out request status (which shows the fade out sources that currently request an fade out)" ULONG OneToOne 1 100 0.00 4294967295.00 FORMAT "%13.2" ECU_ADDRESS 0x500040F8 /end MEASUREMENT
/begin MEASUREMENT ignswofdly "Number of Ignitions in swith Off synchro" UBYTE OneToOne 1 100 0.00 255.0 FORMAT "%5.1" ECU_ADDRESS 0x70002D74 /end MEASUREMENT
/begin MEASUREMENT IKCtl_agAdpnCurr_s16 "Current Adaption value for fine resolution" SWORD zw_q0p1 1 100 -3276.800 3276.700 FORMAT "%8.3" ECU_ADDRESS 0x60000520 /end MEASUREMENT
/begin MEASUREMENT IKCtl_agAdpnVlvLft_as16 "stationary adaption map for valve lift switch depending on speed and load(fine resolution)" SWORD zw_q0p1 1 100 -3276.800 3276.700 FORMAT "%8.3" ARRAY_SIZE 20 ECU_ADDRESS 0x6003654A /end MEASUREMENT
/begin MEASUREMENT IKCtl_agAdpn_as16 "Stationary adaptation map depending on engine speed and load (fine resolution)" SWORD zw_q0p1 1 100 -3276.800 3276.700 FORMAT "%8.3" ARRAY_SIZE 20 ECU_ADDRESS 0x60036522 /end MEASUREMENT
/begin MEASUREMENT IKCtl_agDynAdpnOffs_s8 "ignition retard during dynamic function of knock control" SBYTE kw_q0p75 1 100 -96.00 95.25 FORMAT "%5.2" ECU_ADDRESS 0x60000786 /end MEASUREMENT
/begin MEASUREMENT IKCtl_agDynAdpn_as8 "Adapted ignition timing for knock control dynamic" SBYTE kw_q0p75 1 100 -96.00 95.25 FORMAT "%5.2" ARRAY_SIZE 5 ECU_ADDRESS 0x6003651C /end MEASUREMENT
/begin MEASUREMENT IKCtl_ctReIni100msKRADAP "Local counter in KRADAP for counting number of driving cycles (leave postdrive and enter drive) to enable reinitialization" UBYTE dez 1 100 0.00 255.0 FORMAT "%5.1" ECU_ADDRESS 0x60006401 /end MEASUREMENT
/begin MEASUREMENT IKCtl_ctReIni10msKRDY "Local counter in function KRDY for counting number of driving cycles (leave postdrive and enter drive) to enable reinitialization" UBYTE dez 1 100 0.00 255.0 FORMAT "%5.1" ECU_ADDRESS 0x6000E3B1 /end MEASUREMENT
/begin MEASUREMENT IKCtl_tmpReIniKRDY "Local variable in function KRDY to re-initialise the ASCET classes with no memory when entering drive from postdrive" UBYTE B_TRUE 1 100 0.00 1.00000000000 BIT_MASK 0x1 FORMAT "%13.11" ECU_ADDRESS 0x700001C6 /end MEASUREMENT
/begin MEASUREMENT injddpfiAnztis "injection counter for each cyl" UBYTE dez 1 100 0.00 255.0 FORMAT "%5.1" ARRAY_SIZE 4 ECU_ADDRESS 0x600003D8 /end MEASUREMENT
/begin MEASUREMENT injddpfi_agFrstTdc "TDC angletimervalue of the first injection" ULONG AngleCrS 1 100 0.00 94371839.9781 FORMAT "%13.4" ECU_ADDRESS 0x60000324 /end MEASUREMENT
/begin MEASUREMENT injddpfi_agFrstTdcInjA "TDC angletimervalue of the first injection for Inj A" ULONG AngleCrS 1 100 0.00 94371839.9781 FORMAT "%13.4" ECU_ADDRESS 0x7000196C /end MEASUREMENT
/begin MEASUREMENT injddpfi_frstinjcyl "raw value cylinder number first injection" UBYTE dez 1 100 0.00 255.0 FORMAT "%5.1" ECU_ADDRESS 0x6000073E /end MEASUREMENT
/begin MEASUREMENT injddpfi_frstinjcylInjA "raw value cylinder number first injection for Inj A" UBYTE dez 1 100 0.00 255.0 FORMAT "%5.1" ECU_ADDRESS 0x7000196A /end MEASUREMENT
/begin MEASUREMENT InjDDPfi_idxIMeasTrig "cylinder index of the active current measurement" UBYTE OneToOne 1 100 0.00 255.0 FORMAT "%5.1" ECU_ADDRESS 0x600006FC /end MEASUREMENT
/begin MEASUREMENT InjDDPfi_idxUMeasTrig "cylinder index of the active voltage measurement" UBYTE OneToOne 1 100 0.00 255.0 FORMAT "%5.1" ECU_ADDRESS 0x600006FD /end MEASUREMENT
/begin MEASUREMENT InjDDPfi_injEnadCylMskInjA "Bit mask: Injection or cut off delivered to hardware driver for Inj A" UWORD dez 1 100 0.00 65535.00 FORMAT "%8.2" ECU_ADDRESS 0x70001968 /end MEASUREMENT
/begin MEASUREMENT InjDDPfi_injEnadCylMsk_msg "Bit mask: Injection or cut off delivered to hardware driver" UWORD dez 1 100 0.00 65535.00 FORMAT "%8.2" ECU_ADDRESS 0x500006F8 /end MEASUREMENT
/begin MEASUREMENT InjDDPfi_injTrigCylMskInjA "Bit mask: Injection or cut off delivered to hardware driver for inj A" UWORD dez 1 100 0.00 65535.00 FORMAT "%8.2" ECU_ADDRESS 0x70001966 /end MEASUREMENT
/begin MEASUREMENT InjDDPfi_injTrigCylMskRdnt_msg "Bit mask: Injection or cut off delivered to hardware driver (redundancy)" UWORD dez 1 100 0.00 65535.00 FORMAT "%8.2" ECU_ADDRESS 0x500006FA /end MEASUREMENT
/begin MEASUREMENT InjDDPfi_injTrigCylMsk_msg "Bit mask: Injection or cut off delivered to hardware driver" UWORD dez 1 100 0.00 65535.00 FORMAT "%8.2" ECU_ADDRESS 0x500006FC /end MEASUREMENT
/begin MEASUREMENT InjDDPfi_injTrigCylMsk_rdntInjA "Injection driver Debug variable" UWORD dez 1 100 0.00 65535.00 FORMAT "%8.2" ECU_ADDRESS 0x70001964 /end MEASUREMENT
/begin MEASUREMENT Injddpfi_OldCvoSigAcqn_ctr "Value of the Acquisition counter when a new measurement is triggered." UWORD OneToOne 1 100 0.00 65535.00 FORMAT "%8.2" ECU_ADDRESS 0x60000422 /end MEASUREMENT
/begin MEASUREMENT injddpfi_postInjCtr "Counter for Post Injections" UWORD dez 1 100 0.00 65535.00 FORMAT "%8.2" ECU_ADDRESS 0x60000614 /end MEASUREMENT
/begin MEASUREMENT injddpfi_stfrstSyncEna "Variable showing whether the first syncro is valid for injection driver based on TDC positions" UBYTE OneToOne 1 100 0.00 255.0 FORMAT "%5.1" ECU_ADDRESS 0x60006434 /end MEASUREMENT
/begin MEASUREMENT injdd_tvub_w "Injection driver batter correction time internal variable" UWORD dez 1 100 0.00 65535.00 FORMAT "%8.2" ECU_ADDRESS 0x70001962 /end MEASUREMENT
/begin MEASUREMENT InjHGdi_ChlNumFinishedInj "channel specific counter for finished injections" ULONG DEZ 1 100 0.00 4294967295.00 FORMAT "%13.2" ARRAY_SIZE 4 ECU_ADDRESS 0x50004330 /end MEASUREMENT
/begin MEASUREMENT InjHGdi_ChlNumRequestedInj "channel specific counter for injections which are passed to the hardware" ULONG DEZ 1 100 0.00 4294967295.00 FORMAT "%13.2" ARRAY_SIZE 4 ECU_ADDRESS 0x50004340 /end MEASUREMENT
/begin MEASUREMENT InjHGdi_ChlNumStartedInj "channel specific counter for started injections" ULONG DEZ 1 100 0.00 4294967295.00 FORMAT "%13.2" ARRAY_SIZE 4 ECU_ADDRESS 0x50004350 /end MEASUREMENT
/begin MEASUREMENT InjHGdi_InfoFlgs "information flag value" UWORD DEZ 1 100 0.00 65535.00 FORMAT "%8.2" ECU_ADDRESS 0x600055DA /end MEASUREMENT
/begin MEASUREMENT InjHGdi_numAbortedInj "counter for injections aborted at the abort angle" ULONG DEZ 1 100 0.00 4294967295.00 FORMAT "%13.2" ECU_ADDRESS 0x50004AAC /end MEASUREMENT
/begin MEASUREMENT InjHGdi_numFinishedInj "counter for finished injections" ULONG DEZ 1 100 0.00 4294967295.00 FORMAT "%13.2" ECU_ADDRESS 0x50004AB0 /end MEASUREMENT
/begin MEASUREMENT InjHGdi_numRequestedInj "counter for injections which are passed to the hardware" ULONG DEZ 1 100 0.00 4294967295.00 FORMAT "%13.2" ECU_ADDRESS 0x6000D6A8 /end MEASUREMENT
/begin MEASUREMENT InjHGdi_numStartedInj "counter for started injections" ULONG DEZ 1 100 0.00 4294967295.00 FORMAT "%13.2" ECU_ADDRESS 0x6000D6AC /end MEASUREMENT
/begin MEASUREMENT InjHGdi_numWithdrawedInj "counter for withdrawed injections which are already passed to the hardware" ULONG DEZ 1 100 0.00 4294967295.00 FORMAT "%13.2" ECU_ADDRESS 0x60001F48 /end MEASUREMENT
/begin MEASUREMENT InjSys_flgCutOffReqTyp1 "Condition full cutoff request type 1" UBYTE B_TRUE 1 100 0.00 1.00000000000 BIT_MASK 0x1 FORMAT "%13.11" ECU_ADDRESS 0x70000732 /end MEASUREMENT
/begin MEASUREMENT IntkAirT_cntrSTC1HiVld "stuck-check sensor 1: counter for high-phase" UBYTE OneToOne 1 100 0.00 255.0 FORMAT "%5.1" ECU_ADDRESS 0x6000641B /end MEASUREMENT
/begin MEASUREMENT IntkAirT_cntrSTC1LoVld "stuck-check sensor 1: counter for low-phase" UBYTE OneToOne 1 100 0.00 255.0 FORMAT "%5.1" ECU_ADDRESS 0x6000641A /end MEASUREMENT
/begin MEASUREMENT IntkAirT_flgDSMClr1000msPlausDiagSnsr1 "DSM Clear requested for intake air temperature sensor 1" UBYTE B_TRUE 1 100 0.00 1.00000000000 BIT_MASK 0x1 FORMAT "%13.11" ECU_ADDRESS 0x60006419 /end MEASUREMENT
/begin MEASUREMENT IntkAirT_flgDSMClr100msPlausDiagSnsr1 "DSM Clear requested for intake air temperature sensor 1" UBYTE B_TRUE 1 100 0.00 1.00000000000 BIT_MASK 0x1 FORMAT "%13.11" ECU_ADDRESS 0x60006418 /end MEASUREMENT
/begin MEASUREMENT IntkAirT_flgDSMClrDevDrvrSnsr1 "local request for clearing electrical error of intake air temperature sensor 1" UBYTE B_TRUE 1 100 0.00 1.00000000000 BIT_MASK 0x1 FORMAT "%13.11" ECU_ADDRESS 0x60006433 /end MEASUREMENT
/begin MEASUREMENT IntkAirT_flgHSC1Ena "high-side-check sesnor 1: diagnosis (physically) enabled" UBYTE B_TRUE 1 100 0.00 1.00000000000 BIT_MASK 0x1 FORMAT "%13.11" ECU_ADDRESS 0x700001F5 /end MEASUREMENT
/begin MEASUREMENT IntkAirT_flgHSC1MaxErr "Error flag of the max.error of the High-Side-Check for sensor 1, debounced" UBYTE B_TRUE 1 100 0.00 1.00000000000 BIT_MASK 0x1 FORMAT "%13.11" ECU_ADDRESS 0x70000727 /end MEASUREMENT
/begin MEASUREMENT IntkAirT_flgHSC1MaxHeal "Healing flag of the max.error of the High-Side-Check for sensor 1, debounced" UBYTE B_TRUE 1 100 0.00 1.00000000000 BIT_MASK 0x1 FORMAT "%13.11" ECU_ADDRESS 0x70000726 /end MEASUREMENT
/begin MEASUREMENT IntkAirT_flgHSC1NumrInc "release iumpr-numerator for the High-Side-Check for intake air temperature sensor 1" UBYTE B_TRUE 1 100 0.00 1.00000000000 BIT_MASK 0x1 FORMAT "%13.11" ECU_ADDRESS 0x700001F4 /end MEASUREMENT
/begin MEASUREMENT IntkAirT_flgImps1Err "Error flag of the electrical error (non plausible signal) of intake air temperature sensor 1, debounced" UBYTE B_TRUE 1 100 0.00 1.00000000000 BIT_MASK 0x1 FORMAT "%13.11" ECU_ADDRESS 0x60009F90 /end MEASUREMENT
/begin MEASUREMENT IntkAirT_flgImps1Errloc "local copy of the error flag" UBYTE B_TRUE 1 100 0.00 1.00000000000 BIT_MASK 0x1 FORMAT "%13.11" ECU_ADDRESS 0x60006432 /end MEASUREMENT
/begin MEASUREMENT IntkAirT_flgImps1Heal "Healing flag of the electrical error (non plausible signal) of intake air temperature sensor 1, debounced" UBYTE B_TRUE 1 100 0.00 1.00000000000 BIT_MASK 0x1 FORMAT "%13.11" ECU_ADDRESS 0x60009F8F /end MEASUREMENT
/begin MEASUREMENT IntkAirT_flgImps1Healloc "local copy of the healing flag" UBYTE B_TRUE 1 100 0.00 1.00000000000 BIT_MASK 0x1 FORMAT "%13.11" ECU_ADDRESS 0x60006431 /end MEASUREMENT
/begin MEASUREMENT IntkAirT_flgIntkMnfldMeasdVld "Condition: measured intake air temperature in manifold is valid" UBYTE B_TRUE 1 100 0.00 1.00000000000 BIT_MASK 0x1 FORMAT "%13.11" ECU_ADDRESS 0x70000725 /end MEASUREMENT
/begin MEASUREMENT IntkAirT_flgIntkMnfldReplSnsrVld "Condition: Sensor value from the other bank as replacement value of the intake air temperature in manifold is valid" UBYTE B_TRUE 1 100 0.00 1.00000000000 BIT_MASK 0x1 FORMAT "%13.11" ECU_ADDRESS 0x700001E7 /end MEASUREMENT
/begin MEASUREMENT IntkAirT_flgIntkMnfldReplVld "Condition: replacement value of the intake air temperature in manifold is valid" UBYTE B_TRUE 1 100 0.00 1.00000000000 BIT_MASK 0x1 FORMAT "%13.11" ECU_ADDRESS 0x700001E6 /end MEASUREMENT
/begin MEASUREMENT IntkAirT_flgIntkMnfldSeln "Validity of the selected intake air temperature in manifold" UBYTE B_TRUE 1 100 0.00 1.00000000000 BIT_MASK 0x1 FORMAT "%13.11" ECU_ADDRESS 0x700001E5 /end MEASUREMENT
/begin MEASUREMENT IntkAirT_flgIntkMnfldSelnSwt "Trigger of the loe pass filter of the selected intake air temperature in manifold" UBYTE B_TRUE 1 100 0.00 1.00000000000 BIT_MASK 0x1 FORMAT "%13.11" ECU_ADDRESS 0x700001E4 /end MEASUREMENT
/begin MEASUREMENT IntkAirT_flgIntkMnfldVld "Condition: intake air temperature in manifold is valid" UBYTE B_TRUE 1 100 0.00 1.00000000000 BIT_MASK 0x1 FORMAT "%13.11" ECU_ADDRESS 0x70000724 /end MEASUREMENT
/begin MEASUREMENT IntkAirT_flgNormOp "Flag to indicate the vehicle with normal- or charge operation" UBYTE B_TRUE 1 100 0.00 1.00000000000 BIT_MASK 0x1 FORMAT "%13.11" ECU_ADDRESS 0x60006430 /end MEASUREMENT
/begin MEASUREMENT IntkAirT_flgPlausChk1NumrInc "release iumpr-numerator for the Plaus-Check for intake air temperature sensor 1" UBYTE B_TRUE 1 100 0.00 1.00000000000 BIT_MASK 0x1 FORMAT "%13.11" ECU_ADDRESS 0x7000071F /end MEASUREMENT
/begin MEASUREMENT IntkAirT_flgPRC1ErrDeb "Error flag of the the Physical-Range-Check for sensor 1, debounced" UBYTE B_TRUE 1 100 0.00 1.00000000000 BIT_MASK 0x1 FORMAT "%13.11" ECU_ADDRESS 0x700001F3 /end MEASUREMENT
/begin MEASUREMENT IntkAirT_flgPRC1ErrTmp "Error flag of the the Physical-Range-Check for sensor 1, temporary" UBYTE B_TRUE 1 100 0.00 1.00000000000 BIT_MASK 0x1 FORMAT "%13.11" ECU_ADDRESS 0x700001F2 /end MEASUREMENT
/begin MEASUREMENT IntkAirT_flgPRC1HealDeb "Healing flag of the Physical-Range-Check for sensor 1, debounced" UBYTE B_TRUE 1 100 0.00 1.00000000000 BIT_MASK 0x1 FORMAT "%13.11" ECU_ADDRESS 0x700001F1 /end MEASUREMENT
/begin MEASUREMENT IntkAirT_flgPRC1MaxErr "Error flag of the max.error of the Physical-Range-Check for sensor 1, debounced" UBYTE B_TRUE 1 100 0.00 1.00000000000 BIT_MASK 0x1 FORMAT "%13.11" ECU_ADDRESS 0x70000723 /end MEASUREMENT
/begin MEASUREMENT IntkAirT_flgPRC1MaxErrTmp "Error flag of the max.error of the Physical-Range-Check for sensor 1, temporary" UBYTE B_TRUE 1 100 0.00 1.00000000000 BIT_MASK 0x1 FORMAT "%13.11" ECU_ADDRESS 0x700001F0 /end MEASUREMENT
/begin MEASUREMENT IntkAirT_flgPRC1MaxHeal "Healing flag of the max.error of the Physical-Range-Check for sensor 1, debounced" UBYTE B_TRUE 1 100 0.00 1.00000000000 BIT_MASK 0x1 FORMAT "%13.11" ECU_ADDRESS 0x70000722 /end MEASUREMENT
/begin MEASUREMENT IntkAirT_flgPRC1MinErr "Error flag of the min.error of the Physical-Range-Check for sensor 1, debounced" UBYTE B_TRUE 1 100 0.00 1.00000000000 BIT_MASK 0x1 FORMAT "%13.11" ECU_ADDRESS 0x70000721 /end MEASUREMENT
/begin MEASUREMENT IntkAirT_flgPRC1MinErrTmp "Error flag of the min.error of the Physical-Range-Check for sensor 1, temporary" UBYTE B_TRUE 1 100 0.00 1.00000000000 BIT_MASK 0x1 FORMAT "%13.11" ECU_ADDRESS 0x700001EF /end MEASUREMENT
/begin MEASUREMENT IntkAirT_flgPRC1MinHeal "Healing flag of the min.error of the Physical-Range-Check for sensor 1, debounced" UBYTE B_TRUE 1 100 0.00 1.00000000000 BIT_MASK 0x1 FORMAT "%13.11" ECU_ADDRESS 0x70000720 /end MEASUREMENT
/begin MEASUREMENT IntkAirT_flgSnsr1CrssChkClr "request for clearing Cross-Check error of intake air temperature sensor 1" UBYTE B_TRUE 1 100 0.00 1.00000000000 BIT_MASK 0x1 FORMAT "%13.11" ECU_ADDRESS 0x7000071C /end MEASUREMENT
/begin MEASUREMENT IntkAirT_flgSnsr1CrssChkPrms "release of Cross-Check for intake air temperature sensor 1" UBYTE B_TRUE 1 100 0.00 1.00000000000 BIT_MASK 0x1 FORMAT "%13.11" ECU_ADDRESS 0x7000071B /end MEASUREMENT
/begin MEASUREMENT IntkAirT_flgSnsr1ElecChkClr "request for clearing elektrical error of intake air temperature sensor 1" UBYTE B_TRUE 1 100 0.00 1.00000000000 BIT_MASK 0x1 FORMAT "%13.11" ECU_ADDRESS 0x7000071A /end MEASUREMENT
/begin MEASUREMENT IntkAirT_flgSnsr1ElecEnag "unconfirmed electrical error (non plausible signal) for intake air temperature sensor tfa1" UBYTE B_TRUE 1 100 0.00 1.00000000000 BIT_MASK 0x1 FORMAT "%13.11" ECU_ADDRESS 0x6000642F /end MEASUREMENT
/begin MEASUREMENT IntkAirT_flgSnsr1ElecVld "Intak air temperature sensor 1 is electical valid" UBYTE B_TRUE 1 100 0.00 1.00000000000 BIT_MASK 0x1 FORMAT "%13.11" ECU_ADDRESS 0x70000719 /end MEASUREMENT
/begin MEASUREMENT IntkAirT_flgSnsr1MaxErr "unconfirmed electrical error (max) for intake air temperature sensor tfa1" UBYTE B_TRUE 1 100 0.00 1.00000000000 BIT_MASK 0x1 FORMAT "%13.11" ECU_ADDRESS 0x6000642E /end MEASUREMENT
/begin MEASUREMENT IntkAirT_flgSnsr1MeasdVld "measured intak air temperature from sensor 1 is valid" UBYTE B_TRUE 1 100 0.00 1.00000000000 BIT_MASK 0x1 FORMAT "%13.11" ECU_ADDRESS 0x70000718 /end MEASUREMENT
/begin MEASUREMENT IntkAirT_flgSnsr1MinErr "unconfirmed electrical error (min) for intake air temperature sensor tfa1" UBYTE B_TRUE 1 100 0.00 1.00000000000 BIT_MASK 0x1 FORMAT "%13.11" ECU_ADDRESS 0x6000642D /end MEASUREMENT
/begin MEASUREMENT IntkAirT_flgSnsr1PlausChkClr "request for clearing Plaus-Check error of intake air temperature sensor 1" UBYTE B_TRUE 1 100 0.00 1.00000000000 BIT_MASK 0x1 FORMAT "%13.11" ECU_ADDRESS 0x70000717 /end MEASUREMENT
/begin MEASUREMENT IntkAirT_flgSnsr1PlausChkPrms "release of Plaus-Check for intake air temperature sensor 1" UBYTE B_TRUE 1 100 0.00 1.00000000000 BIT_MASK 0x1 FORMAT "%13.11" ECU_ADDRESS 0x70000716 /end MEASUREMENT
/begin MEASUREMENT IntkAirT_flgSnsr1PwrSplyAvl "Flag to indicate the power supply error of the sensor 1" UBYTE B_TRUE 1 100 0.00 1.00000000000 BIT_MASK 0x1 FORMAT "%13.11" ECU_ADDRESS 0x6000642C /end MEASUREMENT
/begin MEASUREMENT IntkAirT_flgSRC1MaxErr "Error flag of the max.error of the elektrical check for sensor 1, debounced" UBYTE B_TRUE 1 100 0.00 1.00000000000 BIT_MASK 0x1 FORMAT "%13.11" ECU_ADDRESS 0x60009F8E /end MEASUREMENT
/begin MEASUREMENT IntkAirT_flgSRC1MaxErrloc "local copy of the error flag" UBYTE B_TRUE 1 100 0.00 1.00000000000 BIT_MASK 0x1 FORMAT "%13.11" ECU_ADDRESS 0x6000642B /end MEASUREMENT
/begin MEASUREMENT IntkAirT_flgSRC1MaxHeal "Healing flag of the max.error of the elektrical check for sensor 1, debounced" UBYTE B_TRUE 1 100 0.00 1.00000000000 BIT_MASK 0x1 FORMAT "%13.11" ECU_ADDRESS 0x60009F8D /end MEASUREMENT
/begin MEASUREMENT IntkAirT_flgSRC1MaxHealloc "local copy of the healing flag" UBYTE B_TRUE 1 100 0.00 1.00000000000 BIT_MASK 0x1 FORMAT "%13.11" ECU_ADDRESS 0x6000642A /end MEASUREMENT
/begin MEASUREMENT IntkAirT_flgSRC1MinErr "Error flag of the min.error of the elektrical check for sensor 1, debounced" UBYTE B_TRUE 1 100 0.00 1.00000000000 BIT_MASK 0x1 FORMAT "%13.11" ECU_ADDRESS 0x60009F8C /end MEASUREMENT
/begin MEASUREMENT IntkAirT_flgSRC1MinErrloc "local copy of the error flag" UBYTE B_TRUE 1 100 0.00 1.00000000000 BIT_MASK 0x1 FORMAT "%13.11" ECU_ADDRESS 0x60006429 /end MEASUREMENT
/begin MEASUREMENT IntkAirT_flgSRC1MinHeal "Healing flag of the min.error of the elektrical check for sensor 1, debounced" UBYTE B_TRUE 1 100 0.00 1.00000000000 BIT_MASK 0x1 FORMAT "%13.11" ECU_ADDRESS 0x60009F8B /end MEASUREMENT
/begin MEASUREMENT IntkAirT_flgSRC1MinHealloc "local copy of the healing flag" UBYTE B_TRUE 1 100 0.00 1.00000000000 BIT_MASK 0x1 FORMAT "%13.11" ECU_ADDRESS 0x60006428 /end MEASUREMENT
/begin MEASUREMENT IntkAirT_flgSRC1MinRels "enabling SRC_Min for TFA1-sensor" UBYTE B_TRUE 1 100 0.00 1.00000000000 BIT_MASK 0x1 FORMAT "%13.11" ECU_ADDRESS 0x60006427 /end MEASUREMENT
/begin MEASUREMENT IntkAirT_flgSRC2MinRels "enabling SRC_Min for TFA2-sensor" UBYTE B_TRUE 1 100 0.00 1.00000000000 BIT_MASK 0x1 FORMAT "%13.11" ECU_ADDRESS 0x60006426 /end MEASUREMENT
/begin MEASUREMENT IntkAirT_flgSRC3MinRels "enabling SRC_Min for TFA3-sensor" UBYTE B_TRUE 1 100 0.00 1.00000000000 BIT_MASK 0x1 FORMAT "%13.11" ECU_ADDRESS 0x60006425 /end MEASUREMENT
/begin MEASUREMENT IntkAirT_flgSRC4MinRels "enabling SRC_Min for TFA4-sensor" UBYTE B_TRUE 1 100 0.00 1.00000000000 BIT_MASK 0x1 FORMAT "%13.11" ECU_ADDRESS 0x60006424 /end MEASUREMENT
/begin MEASUREMENT IntkAirT_flgSRC5MinRels "enabling SRC_Min for TFA5-sensor" UBYTE B_TRUE 1 100 0.00 1.00000000000 BIT_MASK 0x1 FORMAT "%13.11" ECU_ADDRESS 0x60006423 /end MEASUREMENT
/begin MEASUREMENT IntkAirT_flgSRC6MinRels "enabling SRC_Min for TFA6-sensor" UBYTE B_TRUE 1 100 0.00 1.00000000000 BIT_MASK 0x1 FORMAT "%13.11" ECU_ADDRESS 0x60006422 /end MEASUREMENT
/begin MEASUREMENT IntkAirT_flgSRCMaxEna "Enable of the electrical diagnosis of the intake air temperature sensor" UBYTE B_TRUE 1 100 0.00 1.00000000000 BIT_MASK 0x1 FORMAT "%13.11" ECU_ADDRESS 0x60009F8A /end MEASUREMENT
/begin MEASUREMENT IntkAirT_flgSRCMinEna "Enable bit SRC (min) preliminarity" UBYTE B_TRUE 1 100 0.00 1.00000000000 BIT_MASK 0x1 FORMAT "%13.11" ECU_ADDRESS 0x60009F89 /end MEASUREMENT
/begin MEASUREMENT IntkAirT_flgSTC1Ena "stuck-check sesnor 1: diagnosis (physically) enabled" UBYTE B_TRUE 1 100 0.00 1.00000000000 BIT_MASK 0x1 FORMAT "%13.11" ECU_ADDRESS 0x700001EE /end MEASUREMENT
/begin MEASUREMENT IntkAirT_flgSTC1Err "Error flag of the Stuck-Check for sensor 1, debounced" UBYTE B_TRUE 1 100 0.00 1.00000000000 BIT_MASK 0x1 FORMAT "%13.11" ECU_ADDRESS 0x7000071E /end MEASUREMENT
/begin MEASUREMENT IntkAirT_flgSTC1ErrTmp "Error flag of the max.error of the stuck-check for sensor 1, temporary" UBYTE B_TRUE 1 100 0.00 1.00000000000 BIT_MASK 0x1 FORMAT "%13.11" ECU_ADDRESS 0x700001ED /end MEASUREMENT
/begin MEASUREMENT IntkAirT_flgSTC1Heal "Healing flag of the Stuck-Check for sensor 1, debounced" UBYTE B_TRUE 1 100 0.00 1.00000000000 BIT_MASK 0x1 FORMAT "%13.11" ECU_ADDRESS 0x7000071D /end MEASUREMENT
/begin MEASUREMENT IntkAirT_flgSTC1HiTmp "stuck-check sensor 1: condition for high-phase fulfilled" UBYTE B_TRUE 1 100 0.00 1.00000000000 BIT_MASK 0x1 FORMAT "%13.11" ECU_ADDRESS 0x700001EC /end MEASUREMENT
/begin MEASUREMENT IntkAirT_flgSTC1HiVld "stuck-check: release counter for high-phase" UBYTE B_TRUE 1 100 0.00 1.00000000000 BIT_MASK 0x1 FORMAT "%13.11" ECU_ADDRESS 0x700001EB /end MEASUREMENT
/begin MEASUREMENT IntkAirT_flgSTC1LoTmp "stuck-check sensor 1: condition for low-phase fulfilled" UBYTE B_TRUE 1 100 0.00 1.00000000000 BIT_MASK 0x1 FORMAT "%13.11" ECU_ADDRESS 0x700001EA /end MEASUREMENT
/begin MEASUREMENT IntkAirT_flgSTC1LoVld "stuck-check: release counter for low-phase" UBYTE B_TRUE 1 100 0.00 1.00000000000 BIT_MASK 0x1 FORMAT "%13.11" ECU_ADDRESS 0x700001E9 /end MEASUREMENT
/begin MEASUREMENT IntkAirT_flgSTC1NumrInc "release iumpr-numerator for the Stuck-Check for intake air temperature sensor 1" UBYTE B_TRUE 1 100 0.00 1.00000000000 BIT_MASK 0x1 FORMAT "%13.11" ECU_ADDRESS 0x700001E8 /end MEASUREMENT
/begin MEASUREMENT IntkAirT_flgThrVlvUsReplSnsrVld "Condition: Sensor value from the other bank as replacement value of the intake air temperature before throttle" UBYTE B_TRUE 1 100 0.00 1.00000000000 BIT_MASK 0x1 FORMAT "%13.11" ECU_ADDRESS 0x700001E3 /end MEASUREMENT
/begin MEASUREMENT IntkAirT_flgThrVlvUsReplVld "Condition: replacement value of the intake air temperature before throttle is valid" UBYTE B_TRUE 1 100 0.00 1.00000000000 BIT_MASK 0x1 FORMAT "%13.11" ECU_ADDRESS 0x700001E2 /end MEASUREMENT
/begin MEASUREMENT IntkAirT_flgThrVlvUsVld "Condition: intake air temperature before throttle is valid" UBYTE B_TRUE 1 100 0.00 1.00000000000 BIT_MASK 0x1 FORMAT "%13.11" ECU_ADDRESS 0x70000715 /end MEASUREMENT
/begin MEASUREMENT IntkAirT_mSTC1HiMLInteg "stuck-check sensor 1: air mass flow integrator output" UBYTE m_ub_b23p3 1 100 0.00 23.21 FORMAT "%5.2" ECU_ADDRESS 0x60006417 /end MEASUREMENT
/begin MEASUREMENT IntkAirT_stSnsr1 "State of the intake air temperature sensor 1" UBYTE OneToOne 1 100 0.00 255.0 FORMAT "%5.1" ECU_ADDRESS 0x6000A038 /end MEASUREMENT
/begin MEASUREMENT IntkAirT_stSnsr1ADC "State of the intake air temperature sensor 1 from ADC sensor" UBYTE OneToOne 1 100 0.00 255.0 FORMAT "%5.1" ECU_ADDRESS 0x6000A037 /end MEASUREMENT
/begin MEASUREMENT IntkAirT_stSnsr1ADCLoc "local copy of the State of the intake air temperature sensor 1 from ADC sensor" UBYTE OneToOne 1 100 0.00 255.0 FORMAT "%5.1" ECU_ADDRESS 0x60006421 /end MEASUREMENT
/begin MEASUREMENT IntkAirT_stSnsr1CycRprt1000ms "Status flag to enable cyclic reporting to DSM in 1000ms" UBYTE B_TRUE 1 100 0.00 1.00000000000 BIT_MASK 0x1 FORMAT "%13.11" ECU_ADDRESS 0x6000641F /end MEASUREMENT
/begin MEASUREMENT IntkAirT_stSnsr1CycRprt100ms "Status flag to enable cyclic reporting to DSM in 100ms" UBYTE B_TRUE 1 100 0.00 1.00000000000 BIT_MASK 0x1 FORMAT "%13.11" ECU_ADDRESS 0x6000641E /end MEASUREMENT
/begin MEASUREMENT IntkAirT_tAirFltDsBnk2Tstr "Intake air temperature after air filter bank 2 for tester output" UBYTE temp_ub_q1_o40 1 100 -40.0 215.0 FORMAT "%5.1" ECU_ADDRESS 0x60006447 /end MEASUREMENT
/begin MEASUREMENT IntkAirT_tAirFltDsTstr "Intake air temperature after air filter for tester output" UBYTE temp_ub_q1_o40 1 100 -40.0 215.0 FORMAT "%5.1" ECU_ADDRESS 0x60006446 /end MEASUREMENT
/begin MEASUREMENT IntkAirT_tCmprDsBnk2Tstr "intake air temperature after compressor bank 2 for tester output" UBYTE temp_ub_q1_o40 1 100 -40.0 215.0 FORMAT "%5.1" ECU_ADDRESS 0x60006445 /end MEASUREMENT
/begin MEASUREMENT IntkAirT_tCmprDsTstr "intake air temperature after compressor for tester output" UBYTE temp_ub_q1_o40 1 100 -40.0 215.0 FORMAT "%5.1" ECU_ADDRESS 0x60006444 /end MEASUREMENT
/begin MEASUREMENT IntkAirT_tHSC1Mdl "model value for high-side-check" SWORD Temp_Cels 1 100 -3549.940 3003.560 FORMAT "%8.3" ECU_ADDRESS 0x6000377E /end MEASUREMENT
/begin MEASUREMENT IntkAirT_tIntkMnfld "Intake air temperature in manifold" SWORD Temp_Cels 1 100 -3549.940 3003.560 FORMAT "%8.3" ECU_ADDRESS 0x6000E294 /end MEASUREMENT
/begin MEASUREMENT IntkAirT_tIntkMnfldBnk2Tstr "Intake air temperature in manifold bank 2 for tester output" UBYTE temp_ub_q1_o40 1 100 -40.0 215.0 FORMAT "%5.1" ECU_ADDRESS 0x60006443 /end MEASUREMENT
/begin MEASUREMENT IntkAirT_tIntkMnfldMdlInt "Model value from the TDev internal model for the intake air temperature in manifold" SWORD Temp_Cels 1 100 -3549.940 3003.560 FORMAT "%8.3" ECU_ADDRESS 0x60003778 /end MEASUREMENT
/begin MEASUREMENT IntkAirT_tIntkMnfldMeasd "measured intake air temperature in manifold" SWORD Temp_Cels 1 100 -3549.940 3003.560 FORMAT "%8.3" ECU_ADDRESS 0x600049CC /end MEASUREMENT
/begin MEASUREMENT IntkAirT_tIntkMnfldRepl "Replacement value of the intake air temperature in manifold" SWORD Temp_Cels 1 100 -3549.940 3003.560 FORMAT "%8.3" ECU_ADDRESS 0x60003776 /end MEASUREMENT
/begin MEASUREMENT IntkAirT_tIntkMnfldReplSnsr "Sensor value from the other bank as Replacement value of the intake air temperature in manifold" SWORD Temp_Cels 1 100 -3549.940 3003.560 FORMAT "%8.3" ECU_ADDRESS 0x60003774 /end MEASUREMENT
/begin MEASUREMENT IntkAirT_tIntkMnfldSeln "Selected intak air temperature in manifold" SWORD Temp_Cels 1 100 -3549.940 3003.560 FORMAT "%8.3" ECU_ADDRESS 0x60003772 /end MEASUREMENT
/begin MEASUREMENT IntkAirT_tIntkMnfldTstr "Intake air temperature in manifold for tester output" UBYTE temp_ub_q1_o40 1 100 -40.0 215.0 FORMAT "%5.1" ECU_ADDRESS 0x60006442 /end MEASUREMENT
/begin MEASUREMENT IntkAirT_tIntkMnfld_Sq "Signal quality of Intake air temperature in manifold" UBYTE SigQly_COMPU_VERB 1 100 0.00 15.0000000000 FORMAT "%13.10" ECU_ADDRESS 0x6000A036 /end MEASUREMENT
/begin MEASUREMENT IntkAirT_tiSnsr1CycRprt1000ms "Timer to evaluate cyclic reporting to DSM in 1000ms" UBYTE t_q1 1 100 0.00 255.0 FORMAT "%5.1" ECU_ADDRESS 0x6000641D /end MEASUREMENT
/begin MEASUREMENT IntkAirT_tiSnsr1CycRprt100ms "Timer to evaluate cyclic reporting to DSM in 100ms" UBYTE t_q0p1 1 100 0.00 25.50 FORMAT "%5.2" ECU_ADDRESS 0x6000641C /end MEASUREMENT
/begin MEASUREMENT IntkAirT_tiSTC1HiOff "stuck-check sensor 1: disruption time for high-phase" UBYTE t_q1 1 100 0.00 255.0 FORMAT "%5.1" ECU_ADDRESS 0x60006416 /end MEASUREMENT
/begin MEASUREMENT IntkAirT_tiSTC1HiOn "stuck-check sensor 1: time duration in high-phase" UBYTE t_q1 1 100 0.00 255.0 FORMAT "%5.1" ECU_ADDRESS 0x60006415 /end MEASUREMENT
/begin MEASUREMENT IntkAirT_tiSTC1LoOff "stuck-check sensor 1: disruption time for low-phase" UBYTE t_q1 1 100 0.00 255.0 FORMAT "%5.1" ECU_ADDRESS 0x60006414 /end MEASUREMENT
/begin MEASUREMENT IntkAirT_tiSTC1LoOn "stuck-check sensor 1: time duration in low-phase" UBYTE t_q1 1 100 0.00 255.0 FORMAT "%5.1" ECU_ADDRESS 0x60006413 /end MEASUREMENT
/begin MEASUREMENT IntkAirT_tMnfldIcoDsBnk2Tstr "intake air temperature after intercooler in manifold bank 2 for tester output" UBYTE temp_ub_q1_o40 1 100 -40.0 215.0 FORMAT "%5.1" ECU_ADDRESS 0x60006441 /end MEASUREMENT
/begin MEASUREMENT IntkAirT_tMnfldIcoDsTstr "intake air temperature after intercooler in manifold for tester output" UBYTE temp_ub_q1_o40 1 100 -40.0 215.0 FORMAT "%5.1" ECU_ADDRESS 0x60006440 /end MEASUREMENT
/begin MEASUREMENT IntkAirT_tSnsr1 "Temperature raw value of the intake air temperature sensor 1" SWORD Temp_Cels 1 100 -3549.940 3003.560 FORMAT "%8.3" ECU_ADDRESS 0x600049CA /end MEASUREMENT
/begin MEASUREMENT IntkAirT_tSnsr1ADC "Temperature raw value of the intake air temperature sensor 1 from ADC sensor" SWORD Temp_Cels 1 100 -3549.940 3003.560 FORMAT "%8.3" ECU_ADDRESS 0x600049C8 /end MEASUREMENT
/begin MEASUREMENT IntkAirT_tSnsr1ADCLoc "local copy of the Temperature raw value of the intake air temperature sensor 1 from ADC sensor" SWORD Temp_Cels 1 100 -3549.940 3003.560 FORMAT "%8.3" ECU_ADDRESS 0x60003786 /end MEASUREMENT
/begin MEASUREMENT IntkAirT_tSnsr1Mdl "model-value for intake air temperature sensor 1 (IntkAirT_tSnsr1, tfa1)" SWORD Temp_Cels 1 100 -3549.940 3003.560 FORMAT "%8.3" ECU_ADDRESS 0x600049C6 /end MEASUREMENT
/begin MEASUREMENT IntkAirT_tSnsr1Tstr "Intake Air Tempertaure for Scan Service" UBYTE temp_ub_q1_o40 1 100 -40.0 215.0 FORMAT "%5.1" ECU_ADDRESS 0x6000A035 /end MEASUREMENT
/begin MEASUREMENT IntkAirT_tSnsr1TstrADC "Intake Air Tempertaure for Scan Service from sensor 1 via ADC" UBYTE temp_ub_q1_o40 1 100 -40.0 215.0 FORMAT "%5.1" ECU_ADDRESS 0x6000A034 /end MEASUREMENT
/begin MEASUREMENT IntkAirT_tSnsr1TstrADCLoc "local copy of the Intake Air Tempertaure for Scan Service from sensor 1 via ADC" UBYTE temp_ub_q1_o40 1 100 -40.0 215.0 FORMAT "%5.1" ECU_ADDRESS 0x60006420 /end MEASUREMENT
/begin MEASUREMENT IntkAirT_tSnsr1TstrImprt "Intake Air Tempertaure for Scan Service (local copy)" UBYTE temp_ub_q1_o40 1 100 -40.0 215.0 FORMAT "%5.1" ECU_ADDRESS 0x6000643F /end MEASUREMENT
/begin MEASUREMENT IntkAirT_tSnsrFild1 "intake air temperature (value sensor 1) after lowpass filter" SWORD Temp_Cels 1 100 -3549.940 3003.560 FORMAT "%8.3" ECU_ADDRESS 0x600049C4 /end MEASUREMENT
/begin MEASUREMENT IntkAirT_tSnsrFild1ADC "intake air temperature (value from sensor 1 via ADC) after lowpass filter" SWORD Temp_Cels 1 100 -3549.940 3003.560 FORMAT "%8.3" ECU_ADDRESS 0x600049C2 /end MEASUREMENT
/begin MEASUREMENT IntkAirT_tSnsrFild1ADCLoc "local copy of the intake air temperature (value from sensor 1 via ADC) after lowpass filter" SWORD Temp_Cels 1 100 -3549.940 3003.560 FORMAT "%8.3" ECU_ADDRESS 0x60003784 /end MEASUREMENT
/begin MEASUREMENT IntkAirT_tSnsrFild1Max "maximum value IntkAirT_tSnsrFild1" SWORD Temp_Cels 1 100 -3549.940 3003.560 FORMAT "%8.3" ECU_ADDRESS 0x6000377C /end MEASUREMENT
/begin MEASUREMENT IntkAirT_tSnsrFild1Min "minimum value IntkAirT_tSnsrFild1" SWORD Temp_Cels 1 100 -3549.940 3003.560 FORMAT "%8.3" ECU_ADDRESS 0x6000377A /end MEASUREMENT
/begin MEASUREMENT IntkAirT_tSnsrFildLimd1 "Temperature of the intake air temperature sensor 1 after lowpass filter and the limitation of coolant temperature" SWORD Temp_Cels 1 100 -3549.940 3003.560 FORMAT "%8.3" ECU_ADDRESS 0x600049C0 /end MEASUREMENT
/begin MEASUREMENT IntkAirT_tSnsrFildLimd1ADC "Temperature of the intake air temperature sensor 1 via ADC, after lowpass filter and the limitation of coolant temperature" SWORD Temp_Cels 1 100 -3549.940 3003.560 FORMAT "%8.3" ECU_ADDRESS 0x600049BE /end MEASUREMENT
/begin MEASUREMENT IntkAirT_tSnsrFildLimd1ADCLoc "local copy of the Temperature of the intake air temperature sensor 1 via ADC, after lowpass filter and the limitation of coolant temperature" SWORD Temp_Cels 1 100 -3549.940 3003.560 FORMAT "%8.3" ECU_ADDRESS 0x60003782 /end MEASUREMENT
/begin MEASUREMENT IntkAirT_tSnsrTstr "Intake Air Tempertaure for Scan Service" SWORD Temp_Cels 1 100 -3549.940 3003.560 FORMAT "%8.3" ECU_ADDRESS 0x600049BC /end MEASUREMENT
/begin MEASUREMENT IntkAirT_tThrVlvUs "Before intake throttle" SWORD Temp_Cels 1 100 -3549.940 3003.560 FORMAT "%8.3" ECU_ADDRESS 0x50005AD6 /end MEASUREMENT
/begin MEASUREMENT IntkAirT_tThrVlvUsBnk2Tstr "intake air temperature upstream throttle valve bank 2 for tester output" UBYTE temp_ub_q1_o40 1 100 -40.0 215.0 FORMAT "%5.1" ECU_ADDRESS 0x6000643E /end MEASUREMENT
/begin MEASUREMENT IntkAirT_tThrVlvUsMax "Maximum intake air temperature upstream throttle valve" SWORD Temp_Cels 1 100 -3549.940 3003.560 FORMAT "%8.3" ECU_ADDRESS 0x600049BA /end MEASUREMENT
/begin MEASUREMENT IntkAirT_tThrVlvUsMdlInt "Model value from the TDev internal model for the intake air temperature bedore throttle" SWORD Temp_Cels 1 100 -3549.940 3003.560 FORMAT "%8.3" ECU_ADDRESS 0x60003770 /end MEASUREMENT
/begin MEASUREMENT IntkAirT_tThrVlvUsMin "Minimum intake air temperature upstream throttle valve" SWORD Temp_Cels 1 100 -3549.940 3003.560 FORMAT "%8.3" ECU_ADDRESS 0x600049B8 /end MEASUREMENT
/begin MEASUREMENT IntkAirT_tThrVlvUsRepl "Replacement value of the intake air temperature before throttle" SWORD Temp_Cels 1 100 -3549.940 3003.560 FORMAT "%8.3" ECU_ADDRESS 0x6000376E /end MEASUREMENT
/begin MEASUREMENT IntkAirT_tThrVlvUsReplSnsr "Sensor value from the other bank as Replacement value of the intake air temperature before throttle" SWORD Temp_Cels 1 100 -3549.940 3003.560 FORMAT "%8.3" ECU_ADDRESS 0x6000376C /end MEASUREMENT
/begin MEASUREMENT IntkAirT_tThrVlvUsTstr "intake air temperature upstream throttle valve for tester output" UBYTE temp_ub_q1_o40 1 100 -40.0 215.0 FORMAT "%5.1" ECU_ADDRESS 0x6000643D /end MEASUREMENT
/begin MEASUREMENT IntkAirT_tThrVlvUs_Sq "Signal quality of intake air temperature before throttle" UBYTE SigQly_COMPU_VERB 1 100 0.00 15.0000000000 FORMAT "%13.10" ECU_ADDRESS 0x6000A033 /end MEASUREMENT
/begin MEASUREMENT IntkAirT_uSnsr1CrssSwtLoc "voltage-signal from intake air temperature sensor Snsr1, local" UWORD Volt 1 100 0.00 5000.000 FORMAT "%8.3" ECU_ADDRESS 0x60003780 /end MEASUREMENT
/begin MEASUREMENT IntkAirT_uSnsr1Exprt "voltage-signal from intake air temperature sensor tfa1, export" UWORD Volt 1 100 0.00 13107.00 FORMAT "%8.2" ECU_ADDRESS 0x60004896 /end MEASUREMENT
/begin MEASUREMENT KnDet_bDiaDeb "diagnosis fault suspicion (debouncing active)" UBYTE B_TRUE 1 100 0.00 1.00000000000 BIT_MASK 0x1 FORMAT "%13.11" ECU_ADDRESS 0x700001D0 /end MEASUREMENT
/begin MEASUREMENT KnDet_bDiFctCall "Disable read of datat" UBYTE B_TRUE 1 100 0.00 1.00000000000 BIT_MASK 0x1 FORMAT "%13.11" ECU_ADDRESS 0x700001D9 /end MEASUREMENT
/begin MEASUREMENT KnDet_bEnaSigEval "Enable of signal evaluation" UBYTE B_TRUE 1 100 0.00 1.00000000000 BIT_MASK 0x1 FORMAT "%13.11" ECU_ADDRESS 0x700001CE /end MEASUREMENT
/begin MEASUREMENT KnDet_bNewEval "begin new signal evaluation" UBYTE B_TRUE 1 100 0.00 1.00000000000 BIT_MASK 0x1 FORMAT "%13.11" ECU_ADDRESS 0x700001CD /end MEASUREMENT
/begin MEASUREMENT KnDet_bStMeasWin "status measuring window output" UBYTE B_TRUE 1 100 0.00 1.00000000000 BIT_MASK 0x1 FORMAT "%13.11" ECU_ADDRESS 0x700001D8 /end MEASUREMENT
/begin MEASUREMENT KnDet_ctCyl "cylinder counter KnDet" UBYTE dez 1 100 0.00 255.0 FORMAT "%5.1" ECU_ADDRESS 0x60000707 /end MEASUREMENT
/begin MEASUREMENT KnDet_ctCylBuf0 "cylinder counter KnDet buffer 0" UBYTE dez 1 100 0.00 255.0 FORMAT "%5.1" ECU_ADDRESS 0x5000085A /end MEASUREMENT
/begin MEASUREMENT KnDet_ctCylBuf1 "cylinder counter KnDet buffer 2" UBYTE dez 1 100 0.00 255.0 FORMAT "%5.1" ECU_ADDRESS 0x5000085B /end MEASUREMENT
/begin MEASUREMENT KnDet_ctCylBuf2 "cylinder counter KnDet buffer 0" UBYTE dez 1 100 0.00 255.0 FORMAT "%5.1" ECU_ADDRESS 0x5000085C /end MEASUREMENT
/begin MEASUREMENT KnDet_ctCylTmp "KnDet: cylinder counter temporay" UBYTE dez 1 100 0.00 255.0 FORMAT "%5.1" ECU_ADDRESS 0x60000708 /end MEASUREMENT
/begin MEASUREMENT KnDet_ctDia "diagnosis counter short circuit detection" UBYTE dez 1 100 0.00 255.0 FORMAT "%5.1" ECU_ADDRESS 0x60000709 /end MEASUREMENT
/begin MEASUREMENT KnDet_ctInpBuf "Index write data" UBYTE dez 1 100 0.00 255.0 FORMAT "%5.1" ECU_ADDRESS 0x6000070A /end MEASUREMENT
/begin MEASUREMENT KnDet_ctIntegRsltInvld "counter integration results not valid" UBYTE dez 1 100 0.00 255.0 FORMAT "%5.1" ECU_ADDRESS 0x6000070B /end MEASUREMENT
/begin MEASUREMENT KnDet_ctMeasWin "counter number of measurement windows" ULONG dez 1 100 0.00 65535.0000000 FORMAT "%13.7" ECU_ADDRESS 0x5000020C /end MEASUREMENT
/begin MEASUREMENT KnDet_ctOutpBuf "index read data" UBYTE dez 1 100 0.00 255.0 FORMAT "%5.1" ECU_ADDRESS 0x5000085D /end MEASUREMENT
/begin MEASUREMENT KnDet_DebDiagVal1 "state debouncing value 1" ULONG dez 1 100 0.00 4294967295.00 FORMAT "%13.2" ECU_ADDRESS 0x6000138C /end MEASUREMENT
/begin MEASUREMENT KnDet_DebDiagVal2 "state debouncing value 2" ULONG dez 1 100 0.00 4294967295.00 FORMAT "%13.2" ECU_ADDRESS 0x60001388 /end MEASUREMENT
/begin MEASUREMENT KnDet_DiaRes "diagnosis result" UBYTE dez 1 100 0.00 255.0 FORMAT "%5.1" ECU_ADDRESS 0x60006402 /end MEASUREMENT
/begin MEASUREMENT KnDet_DiffMeasWinMeasd "distance between measurement wind end and begin" ULONG t_us_q1 1 100 0.00 4294967295.00 FORMAT "%13.2" ECU_ADDRESS 0x60000280 /end MEASUREMENT
/begin MEASUREMENT KnDet_facPolarityDiag "fctor polarity for line test" SBYTE dez 1 100 -128.0 127.0 FORMAT "%5.1" ECU_ADDRESS 0x6000070C /end MEASUREMENT
/begin MEASUREMENT KnDet_flgBufOvf "buffer overflow" UBYTE B_TRUE 1 100 0.00 1.00000000000 BIT_MASK 0x1 FORMAT "%13.11" ECU_ADDRESS 0x700001D7 /end MEASUREMENT
/begin MEASUREMENT KnDet_flgBufOvfTmp "buffer overflow, temp." UBYTE B_TRUE 1 100 0.00 1.00000000000 BIT_MASK 0x1 FORMAT "%13.11" ECU_ADDRESS 0x700001D6 /end MEASUREMENT
/begin MEASUREMENT KnDet_flgKnkSyncd "kncok detection synchronized" UBYTE B_TRUE 1 100 0.00 1.00000000000 BIT_MASK 0x1 FORMAT "%13.11" ECU_ADDRESS 0x700001D5 /end MEASUREMENT
/begin MEASUREMENT KnDet_flgReIni "ReIni detected" UBYTE B_TRUE 1 100 0.00 1.00000000000 BIT_MASK 0x1 FORMAT "%13.11" ECU_ADDRESS 0x700001D4 /end MEASUREMENT
/begin MEASUREMENT KnDet_flgScChkDiagAck "Acknowledge End of Line-Test" UBYTE B_TRUE 1 100 0.00 1.00000000000 BIT_MASK 0x1 FORMAT "%13.11" ECU_ADDRESS 0x700001CF /end MEASUREMENT
/begin MEASUREMENT KnDet_flgSnsrMaxErr "Max error at knock sensor line" UBYTE B_TRUE 1 100 0.00 1.00000000000 BIT_MASK 0x1 FORMAT "%13.11" ECU_ADDRESS 0x700001D2 /end MEASUREMENT
/begin MEASUREMENT KnDet_flgSnsrMinErr "Min error knock sensor line" UBYTE B_TRUE 1 100 0.00 1.00000000000 BIT_MASK 0x1 FORMAT "%13.11" ECU_ADDRESS 0x700001D1 /end MEASUREMENT
/begin MEASUREMENT KnDet_FltNewBuf0 "filter switched buffer 0" UBYTE B_TRUE 1 100 0.00 1.00000000000 BIT_MASK 0x1 FORMAT "%13.11" ECU_ADDRESS 0x50000854 /end MEASUREMENT
/begin MEASUREMENT KnDet_FltNewBuf1 "filter switched buffer 1" UBYTE B_TRUE 1 100 0.00 1.00000000000 BIT_MASK 0x1 FORMAT "%13.11" ECU_ADDRESS 0x50000855 /end MEASUREMENT
/begin MEASUREMENT KnDet_FltNewBuf2 "filter switched buffer 2" UBYTE B_TRUE 1 100 0.00 1.00000000000 BIT_MASK 0x1 FORMAT "%13.11" ECU_ADDRESS 0x50000856 /end MEASUREMENT
/begin MEASUREMENT KnDet_GainShift "Amplification stage" UBYTE dez 1 100 0.00 255.0 FORMAT "%5.1" ECU_ADDRESS 0x60000700 /end MEASUREMENT
/begin MEASUREMENT KnDet_GainShiftTmp "Amplification stage temporary" UBYTE dez 1 100 0.00 255.0 FORMAT "%5.1" ECU_ADDRESS 0x60000701 /end MEASUREMENT
/begin MEASUREMENT KnDet_HwDiaMode "HW: configuration for diagnosis mode" UBYTE dez 1 100 0.00 255.0 FORMAT "%5.1" ECU_ADDRESS 0x60000702 /end MEASUREMENT
/begin MEASUREMENT KnDet_IntegWinEndBuf0 "integrator value at the end of the measuring window buffer0" ULONG spg_q7p629Em7_V_ms 1 100 0.00 3276.79999924 FORMAT "%13.8" ARRAY_SIZE 1 ECU_ADDRESS 0x500001E4 /end MEASUREMENT
/begin MEASUREMENT KnDet_IntegWinEndBuf1 "integrator value at the end of the measuring window buffer1" ULONG spg_q7p629Em7_V_ms 1 100 0.00 3276.79999924 FORMAT "%13.8" ARRAY_SIZE 1 ECU_ADDRESS 0x500001E8 /end MEASUREMENT
/begin MEASUREMENT KnDet_IntegWinEndBuf2 "integrator value at the end of the measuring window buffer2" ULONG spg_q7p629Em7_V_ms 1 100 0.00 3276.79999924 FORMAT "%13.8" ARRAY_SIZE 1 ECU_ADDRESS 0x500001EC /end MEASUREMENT
/begin MEASUREMENT KnDet_KnKInvldBuf0 "result for knock detection invalid buffer 0" UBYTE B_TRUE 1 100 0.00 1.00000000000 BIT_MASK 0x1 FORMAT "%13.11" ECU_ADDRESS 0x50000857 /end MEASUREMENT
/begin MEASUREMENT KnDet_KnKInvldBuf1 "result for knock detection invalid buffer 1" UBYTE B_TRUE 1 100 0.00 1.00000000000 BIT_MASK 0x1 FORMAT "%13.11" ECU_ADDRESS 0x50000858 /end MEASUREMENT
/begin MEASUREMENT KnDet_KnKInvldBuf2 "result for knock detection invalid buffer 2" UBYTE B_TRUE 1 100 0.00 1.00000000000 BIT_MASK 0x1 FORMAT "%13.11" ECU_ADDRESS 0x50000859 /end MEASUREMENT
/begin MEASUREMENT KnDet_MeasWinEndMeasd "current value measurement window end" ULONG dez 1 100 0.00 4294967295.00 FORMAT "%13.2" ECU_ADDRESS 0x6000028C /end MEASUREMENT
/begin MEASUREMENT KnDet_NewDataBuf0 "new data available buffer 0" UBYTE dez 1 100 0.00 255.0 FORMAT "%5.1" ECU_ADDRESS 0x7000159D /end MEASUREMENT
/begin MEASUREMENT KnDet_NewDataBuf1 "new data available buffer 1" UBYTE dez 1 100 0.00 255.0 FORMAT "%5.1" ECU_ADDRESS 0x7000159E /end MEASUREMENT
/begin MEASUREMENT KnDet_NewDataBuf2 "new data available buffer 2" UBYTE dez 1 100 0.00 255.0 FORMAT "%5.1" ECU_ADDRESS 0x7000159F /end MEASUREMENT
/begin MEASUREMENT KnDet_NewDiagRes "result of diagnosis evaluation" SWORD RBPtCel_u_1p60514em4_1 1 100 -5.259711 5.259551 FORMAT "%8.6" ECU_ADDRESS 0x60000424 /end MEASUREMENT
/begin MEASUREMENT KnDet_nrDiffValMeasWinMeasdTmp "Difference number of values based on time and number of measured values" SWORD dez 1 100 -32768.00 32767.00 FORMAT "%8.2" ECU_ADDRESS 0x7000195A /end MEASUREMENT
/begin MEASUREMENT KnDet_nrValDly "number of delayed values" UWORD dez 1 100 0.00 65535.00 FORMAT "%8.2" ECU_ADDRESS 0x60000426 /end MEASUREMENT
/begin MEASUREMENT KnDet_nrValDlyBasc "number of delayed values, basic delay" UWORD dez 1 100 0.00 65535.00 FORMAT "%8.2" ECU_ADDRESS 0x60000428 /end MEASUREMENT
/begin MEASUREMENT KnDet_nrValMeasWinMeasd "number of values based on time" UWORD dez 1 100 0.00 65535.00 FORMAT "%8.2" ECU_ADDRESS 0x70001958 /end MEASUREMENT
/begin MEASUREMENT KnDet_numFltNew "filter selection for the next combustion" UWORD dez 1 100 0.00 65535.00 FORMAT "%8.2" ECU_ADDRESS 0x6000042A /end MEASUREMENT
/begin MEASUREMENT KnDet_numFltNewTmp "filter selection for the next combustion, temp." UWORD dez 1 100 0.00 65535.00 FORMAT "%8.2" ECU_ADDRESS 0x6000042C /end MEASUREMENT
/begin MEASUREMENT KnDet_numFltOldAry "filter selection, cylinder specific, old" UWORD dez 1 100 0.00 65535.00 FORMAT "%8.2" ARRAY_SIZE 4 ECU_ADDRESS 0x50000210 /end MEASUREMENT
/begin MEASUREMENT KnDet_numKnkSnsr "slected knock sensor" UBYTE dez 1 100 0.00 3.000 FORMAT "%5.3" ECU_ADDRESS 0x6000070D /end MEASUREMENT
/begin MEASUREMENT KnDet_numSensDia "sensor for diagnosis" UBYTE dez 1 100 0.00 255.0 FORMAT "%5.1" ECU_ADDRESS 0x6000070E /end MEASUREMENT
/begin MEASUREMENT KnDet_numValMeasWin "number of measuring values in the measuring window" ULONG dez 1 100 0.00 4294967295.00 FORMAT "%13.2" ECU_ADDRESS 0x50000218 /end MEASUREMENT
/begin MEASUREMENT KnDet_numValMeasWinEst "estimated number of measuring values in the measuring window" UWORD dez 1 100 0.00 65535.00 FORMAT "%8.2" ECU_ADDRESS 0x6000042E /end MEASUREMENT
/begin MEASUREMENT KnDet_numValMeasWinTmp "number of measuring values in the measuring window, temporay" UWORD dez 1 100 0.00 65535.00 FORMAT "%8.2" ECU_ADDRESS 0x60000430 /end MEASUREMENT
/begin MEASUREMENT KnDet_numValTmpMeasWin "number of measuring values in the measuring window, temporary" ULONG dez 1 100 0.00 4294967295.00 FORMAT "%13.2" ECU_ADDRESS 0x5000021C /end MEASUREMENT
/begin MEASUREMENT KnDet_phiMeasWinBgn "angle begin of measuring window with lead" SWORD kw_sw_q0p0219 1 100 -720.0000 719.9780 FORMAT "%8.4" ECU_ADDRESS 0x60000432 /end MEASUREMENT
/begin MEASUREMENT KnDet_phiMeasWinBgnKnk "angle knock measurement window begin" SWORD kw_sw_q0p0219 1 100 -720.0000 719.9780 FORMAT "%8.4" ECU_ADDRESS 0x60000434 /end MEASUREMENT
/begin MEASUREMENT KnDet_phiMeasWinLngth "angle length of measuring window with lead" SWORD kw_sw_q0p0219 1 100 -720.0000 719.9780 FORMAT "%8.4" ECU_ADDRESS 0x60000436 /end MEASUREMENT
/begin MEASUREMENT KnDet_phiMeasWinLngthKnk "angle length of measurement window (knock measurement window)" SWORD kw_sw_q0p0219 1 100 -720.0000 719.9780 FORMAT "%8.4" ECU_ADDRESS 0x60000438 /end MEASUREMENT
/begin MEASUREMENT KnDet_phiMeasWinLngthOld "angle length of measuring window old" SWORD kw_sw_q0p0219 1 100 -720.0000 719.9780 FORMAT "%8.4" ECU_ADDRESS 0x6000043A /end MEASUREMENT
/begin MEASUREMENT KnDet_ReqChk "line diagnosis requested" UBYTE dez 1 100 0.00 255.0 FORMAT "%5.1" ECU_ADDRESS 0x60000703 /end MEASUREMENT
/begin MEASUREMENT KnDet_ReqSigEvalMode "KnDet: Mode for signal evaluation" UBYTE dez 1 100 0.00 255.0 FORMAT "%5.1" ECU_ADDRESS 0x60000704 /end MEASUREMENT
/begin MEASUREMENT KnDet_RlsChkMeasWin "release measuring window plausibility check" UBYTE dez 1 100 0.00 255.0 FORMAT "%5.1" ECU_ADDRESS 0x60000705 /end MEASUREMENT
/begin MEASUREMENT KnDet_RlsChkWinMeas "release plausibility check measurement window" UBYTE dez 1 100 0.00 255.0 FORMAT "%5.1" ECU_ADDRESS 0x60006403 /end MEASUREMENT
/begin MEASUREMENT KnDet_SensMode "HW diagnosis mode" UBYTE dez 1 100 0.00 255.0 FORMAT "%5.1" ECU_ADDRESS 0x60000706 /end MEASUREMENT
/begin MEASUREMENT KnDet_stCalMeasWin "state measurement window at application interface" UBYTE dez 1 100 0.00 255.0 FORMAT "%5.1" ECU_ADDRESS 0x6000070F /end MEASUREMENT
/begin MEASUREMENT KnDet_stDiaBuf0 "result KnDet internal check buffer 0" UBYTE dez 1 100 0.00 255.0 FORMAT "%5.1" ECU_ADDRESS 0x5000085E /end MEASUREMENT
/begin MEASUREMENT KnDet_stDiaBuf1 "result KnDet internal check buffer 1" UBYTE dez 1 100 0.00 255.0 FORMAT "%5.1" ECU_ADDRESS 0x5000085F /end MEASUREMENT
/begin MEASUREMENT KnDet_stDiaBuf2 "result KnDet internal check buffer 2" UBYTE dez 1 100 0.00 255.0 FORMAT "%5.1" ECU_ADDRESS 0x50000860 /end MEASUREMENT
/begin MEASUREMENT KnDet_stDiaCtl "status diagnosis control" UBYTE dez 1 100 0.00 255.0 FORMAT "%5.1" ECU_ADDRESS 0x60000710 /end MEASUREMENT
/begin MEASUREMENT KnDet_stDiaCtlBuf0 "state diagnosis control buffer 0" UBYTE dez 1 100 0.00 255.0 FORMAT "%5.1" ECU_ADDRESS 0x50000861 /end MEASUREMENT
/begin MEASUREMENT KnDet_stDiaCtlBuf1 "state diagnosis control buffer 1" UBYTE dez 1 100 0.00 255.0 FORMAT "%5.1" ECU_ADDRESS 0x50000862 /end MEASUREMENT
/begin MEASUREMENT KnDet_stDiaCtlBuf2 "state diagnosis control buffer 2" UBYTE dez 1 100 0.00 255.0 FORMAT "%5.1" ECU_ADDRESS 0x50000863 /end MEASUREMENT
/begin MEASUREMENT KnDet_stGetDigRawVal "status data acquisition" ULONG dez 1 100 0.00 4294967295.00 FORMAT "%13.2" ECU_ADDRESS 0x60000294 /end MEASUREMENT
/begin MEASUREMENT KnDet_stMeasWin "status measuring window output" UBYTE dez 1 100 0.00 255.0 FORMAT "%5.1" ECU_ADDRESS 0x60000711 /end MEASUREMENT
/begin MEASUREMENT KnDet_stRlsDiaBuf0 "relase measurement window plaus. check buffer 0" UBYTE dez 1 100 0.00 255.0 FORMAT "%5.1" ECU_ADDRESS 0x50000864 /end MEASUREMENT
/begin MEASUREMENT KnDet_stRlsDiaBuf1 "relase measurement window plaus. check buffer 1" UBYTE dez 1 100 0.00 255.0 FORMAT "%5.1" ECU_ADDRESS 0x50000865 /end MEASUREMENT
/begin MEASUREMENT KnDet_stRlsDiaBuf2 "relase measurement window plaus. check buffer 2" UBYTE dez 1 100 0.00 255.0 FORMAT "%5.1" ECU_ADDRESS 0x50000866 /end MEASUREMENT
/begin MEASUREMENT KnDet_stSigEval "status of the signal evaluation" UBYTE dez 1 100 0.00 255.0 FORMAT "%5.1" ECU_ADDRESS 0x60000712 /end MEASUREMENT
/begin MEASUREMENT KnDet_stSigEvalCurrCmb "status Complex Driver KnDet current combustion" ULONG dez 1 100 0.00 4294967295.00 FORMAT "%13.2" ECU_ADDRESS 0x50000220 /end MEASUREMENT
/begin MEASUREMENT KnDet_stSigEvalCurrCmbLstEntry "Last reported error for the knock sensor signal evaluation" ULONG dez 1 100 0.00 4294967295.00 FORMAT "%13.2" ECU_ADDRESS 0x60000368 /end MEASUREMENT
/begin MEASUREMENT KnDet_tiLenMeasWinMeasd "Length of measurement window, measured" ULONG t_us_q1 1 100 0.00 4294967295.00 FORMAT "%13.2" ECU_ADDRESS 0x70001954 /end MEASUREMENT
/begin MEASUREMENT KnDet_vDiagVal "voltage for diagnosis" SWORD RBPtCel_u_1p60514em4_1 1 100 -5.259711 5.259551 FORMAT "%8.6" ECU_ADDRESS 0x6000373C /end MEASUREMENT
/begin MEASUREMENT KnDet_vNewIntegWinEnd "new integrator value at the end of the measuring window" ULONG dez 1 100 0.00 4294967295.00 FORMAT "%13.2" ARRAY_SIZE 1 ECU_ADDRESS 0x50000224 /end MEASUREMENT
/begin MEASUREMENT KnDet_vValOffs "DC voltage offset" SWORD RBPtCel_u_1p60514em4_1 1 100 -5.259711 5.259551 FORMAT "%8.6" ECU_ADDRESS 0x6000043C /end MEASUREMENT
/begin MEASUREMENT kradapred "Knock control: condition to reduce the adaption values" UBYTE dez 1 100 0.00 255.0 FORMAT "%5.1" ECU_ADDRESS 0x60006400 /end MEASUREMENT
/begin MEASUREMENT lastzylInjA "Last injected cylinder for injector A" UBYTE dez 1 100 0.00 255.0 FORMAT "%5.1" ECU_ADDRESS 0x70001960 /end MEASUREMENT
/begin MEASUREMENT lastzyl_msg "cylinder number with the last injection" UBYTE dez 1 100 0.00 255.0 FORMAT "%5.1" ECU_ADDRESS 0x500008BD /end MEASUREMENT
/begin MEASUREMENT mimxkhbk_w "maximum allowed desired torque of air path in case of brake booster" UWORD rel_uw_b100 1 100 0.00 99.99847 FORMAT "%8.5" ECU_ADDRESS 0x60003740 /end MEASUREMENT
/begin MEASUREMENT nexttizylInjA "Next cylinder to be injected" UBYTE dez 1 100 0.00 255.0 FORMAT "%5.1" ARRAY_SIZE 3 ECU_ADDRESS 0x7000195D /end MEASUREMENT
/begin MEASUREMENT nexttizyl_msg "pointer to next cylinders for injection" UBYTE dez 1 100 0.00 255.0 FORMAT "%5.1" ARRAY_SIZE 3 ECU_ADDRESS 0x500008BE /end MEASUREMENT
/begin MEASUREMENT ovlctr_msg "Overlap counter dwell-event" UBYTE OneToOne 1 100 0.00 255.0 FORMAT "%5.1" ECU_ADDRESS 0x70001C02 /end MEASUREMENT
/begin MEASUREMENT stuetz "engine speed adaptation range at load dynamics detection" UBYTE dez 1 100 0.00 255.0 FORMAT "%5.1" ECU_ADDRESS 0x60000747 /end MEASUREMENT
/begin MEASUREMENT TAB_NEXT_ZZYL "Array for next cylinder to be injected" UBYTE dez 1 100 0.00 255.0 FORMAT "%5.1" ARRAY_SIZE 4 ECU_ADDRESS 0x50000484 /end MEASUREMENT
/begin MEASUREMENT taevkr "air temperature at inlet valve KR internal" UBYTE temp_ub_q0p75_o48 1 100 -48.0 143.3 FORMAT "%5.1" ECU_ADDRESS 0x70001951 /end MEASUREMENT
/begin MEASUREMENT tansabz_msg "Intake air temperature: stop value of last driving cycle" UBYTE temp_ub_q0p75_o48 1 100 -48.0 143.3 FORMAT "%5.1" ECU_ADDRESS 0x6000A286 /end MEASUREMENT
/begin MEASUREMENT tansab_loc "Local copy of tansab" UBYTE temp_ub_q0p75_o48 1 100 -48.0 143.3 FORMAT "%5.1" ECU_ADDRESS 0x60036572 /end MEASUREMENT
/begin MEASUREMENT tansab_msg "Intake air temperature when engine is shut-off" UBYTE temp_ub_q0p75_o48 1 100 -48.0 143.3 FORMAT "%5.1" ECU_ADDRESS 0x6000A287 /end MEASUREMENT
/begin MEASUREMENT tansk_w_msg "Intake air temperature in degC, internally in Kelvin" UWORD temp_q0p0234_o273 1 100 -273.150 1262.827 FORMAT "%8.3" ECU_ADDRESS 0x600047F6 /end MEASUREMENT
/begin MEASUREMENT tanslin_msg "intake air temperature, linearised and calculated" UBYTE temp_ub_q0p75_o48 1 100 -48.0 143.3 FORMAT "%5.1" ECU_ADDRESS 0x60009FE5 /end MEASUREMENT
/begin MEASUREMENT tans_msg "intake air temperature" UBYTE temp_ub_q0p75_o48 1 100 -48.0 143.3 FORMAT "%5.1" ECU_ADDRESS 0x50005DD4 /end MEASUREMENT
/begin MEASUREMENT tasrg_w_msg "intake air temperatur, measured in manifold" UWORD temp_q0p0234_o273 1 100 -273.150 1262.827 FORMAT "%8.3" ECU_ADDRESS 0x6000E32E /end MEASUREMENT
/begin MEASUREMENT tasr_w_msg "air temperature in manifold" UWORD temp_q0p0234_o273 1 100 -273.150 1262.827 FORMAT "%8.3" ECU_ADDRESS 0x600047F4 /end MEASUREMENT
/begin MEASUREMENT tavdkmn_w_msg "Minimum intake air temperature at the throttle valve" UWORD temp_q0p0234_o273 1 100 -273.150 1262.827 FORMAT "%8.3" ECU_ADDRESS 0x600047F0 /end MEASUREMENT
/begin MEASUREMENT tavdkmx_w_msg "Maximum intake air temperature at the throttle valve" UWORD temp_q0p0234_o273 1 100 -273.150 1262.827 FORMAT "%8.3" ECU_ADDRESS 0x600047EE /end MEASUREMENT
/begin MEASUREMENT tavdk_w_msg "air temperature upstream throttle" UWORD temp_q0p0234_o273 1 100 -273.150 1262.827 FORMAT "%8.3" ECU_ADDRESS 0x600047F2 /end MEASUREMENT
/begin MEASUREMENT tmstchtr_w "engine temperature at start (eng. coolant or cyl. head), local copy" SWORD Temp_Cels 1 100 -3549.940 3003.560 FORMAT "%8.3" ECU_ADDRESS 0x6000373E /end MEASUREMENT
/begin MEASUREMENT wkrdyaa "adaptation part of dynamic ignition retard" SBYTE kw_q0p75 1 100 -96.00 95.25 FORMAT "%5.2" ECU_ADDRESS 0x6000074A /end MEASUREMENT
/begin MEASUREMENT wkrdyti "tip in part of dynamic ignition retard" SBYTE kw_q0p75 1 100 -96.00 95.25 FORMAT "%5.2" ECU_ADDRESS 0x70001950 /end MEASUREMENT
/begin MEASUREMENT zaldy "Ignition counter for deactivation of load dynamics" UBYTE dez 1 100 0.00 255.0 FORMAT "%5.1" ECU_ADDRESS 0x6000074E /end MEASUREMENT
/begin MEASUREMENT zwkhktl "desired ignition timing for catalyst heating by cold engine during idle" SBYTE zw_sb_q0p75 1 100 -96.00 95.25 FORMAT "%5.2" ECU_ADDRESS 0x60006405 /end MEASUREMENT
/begin MEASUREMENT zwkhktt "desired ignition timing for catalyst heating by cold engine during part load" SBYTE zw_sb_q0p75 1 100 -96.00 95.25 FORMAT "%5.2" ECU_ADDRESS 0x60006404 /end MEASUREMENT
/begin MEASUREMENT zwoutaktarCpl_w "data redundancy actual output ignition angle array" UWORD OneToOne 1 100 0.00 65535.00 FORMAT "%8.2" ARRAY_SIZE 4 ECU_ADDRESS 0x7000198C /end MEASUREMENT
/begin MEASUREMENT zwoutaktar_w "actual output ignition angle array(sint16)" SWORD zw_q0p1 1 100 -3276.800 3276.700 FORMAT "%8.3" ARRAY_SIZE 4 ECU_ADDRESS 0x500004A0 /end MEASUREMENT
/begin MEASUREMENT zwoutakt_w_msg "actual ignition angle array taking into account overlap(sint16)" SWORD zw_q0p1 1 100 -3276.800 3276.700 FORMAT "%8.3" ECU_ADDRESS 0x60004DB8 /end MEASUREMENT
/begin MEASUREMENT zzaehl_msg "Ignition counter(ref.%HT2KTIGNI / IGNDD)" UBYTE OneToOne 1 100 0.00 255.0 FORMAT "%5.1" ECU_ADDRESS 0x600007C7 /end MEASUREMENT
/begin MEASUREMENT zzaehl_w_msg "Ignition counter(ref.HT2KTIGNI IGNDD)" UWORD OneToOne 1 100 0.00 65535.00 FORMAT "%8.2" ECU_ADDRESS 0x600006C4 /end MEASUREMENT
/begin MEASUREMENT zzprz "percentage of ignitions with kc determined ign. angle during dynamics" UBYTE rel_q0p39 1 100 0.00 99.61 FORMAT "%5.2" ECU_ADDRESS 0x6000074F /end MEASUREMENT
/begin MEASUREMENT zzwdykr_w "ignition counter for knock control with used knock ignition retardation during knock control dynamic" UWORD dez 1 100 0.00 65535.00 FORMAT "%8.2" ECU_ADDRESS 0x600004A4 /end MEASUREMENT
/begin MEASUREMENT zzwdymd_w "ignition counter for knock control without used knock ignition retardation during knock control dynamic" UWORD dez 1 100 0.00 65535.00 FORMAT "%8.2" ECU_ADDRESS 0x600004A6 /end MEASUREMENT
/begin FUNCTION I15031_Srv8 "3.0.0     Request control of on-board system, test or component" FUNCTION_VERSION "3.0.0" /end FUNCTION
/begin FUNCTION I15031_srv9 "30000.30.0Request vehicle informations" FUNCTION_VERSION "30000.30.0" /end FUNCTION
/begin FUNCTION I15031_Std "30000.25.0Base subservices for emission relevant diagnosis" /begin IN_MEASUREMENT I15031_PIDSuppSrv1 T15_flgOn T15_st /end IN_MEASUREMENT FUNCTION_VERSION "30000.25.0" /end FUNCTION
/begin FUNCTION IATS2SV "2.0.0     ScanTool Service for Intake Air Temperature Sensors (PID$68h)"
 /begin DEF_CHARACTERISTIC IntkAirT_swtPID68hB_C IntkAirT_swtPID68hC_C IntkAirT_swtPID68hD_C IntkAirT_swtPID68hE_C IntkAirT_swtPID68hF_C IntkAirT_swtPID68hG_C IntkAirT_tDflValPID68_C /end DEF_CHARACTERISTIC
 /begin IN_MEASUREMENT IntkAirT_tSnsr1Tstr /end IN_MEASUREMENT
 /begin OUT_MEASUREMENT iats2sva_msg iats2svb_msg iats2svc_msg iats2svd_msg iats2sve_msg iats2svf_msg iats2svg_msg /end OUT_MEASUREMENT
 /begin LOC_MEASUREMENT iats2sva_loc iats2svb_loc iats2svc_loc iats2svd_loc iats2sve_loc iats2svf_loc iats2svg_loc IntkAirT_tAirFltDsBnk2Tstr IntkAirT_tAirFltDsTstr IntkAirT_tCmprDsBnk2Tstr IntkAirT_tCmprDsTstr IntkAirT_tIntkMnfldBnk2Tstr IntkAirT_tIntkMnfldTstr IntkAirT_tMnfldIcoDsBnk2Tstr IntkAirT_tMnfldIcoDsTstr IntkAirT_tSnsr1TstrImprt IntkAirT_tThrVlvUsBnk2Tstr IntkAirT_tThrVlvUsTstr /end LOC_MEASUREMENT
 FUNCTION_VERSION "2.0.0" /end FUNCTION
/begin FUNCTION IDASECU_IDASB "10.2.0_6SAASignal processing of CAN frame IDASB" /begin DEF_CHARACTERISTIC Com_dIDASBMaxDiff_C Com_dIDASBMaxPer_C Com_stISABasSpd_C /end DEF_CHARACTERISTIC
 /begin IN_MEASUREMENT Com_ctCRingIDASB Com_numCsumIDASB Com_stFrmRxEna Com_stISABasSpd Com_stMon /end IN_MEASUREMENT
 /begin OUT_MEASUREMENT Com_flgIDASBNorm /end OUT_MEASUREMENT
 FUNCTION_VERSION "10.2.0_6SAA" /end FUNCTION
/begin FUNCTION IgCtl_IaCorrnLam "2.4.0     Calculation of ignition angle corrections depending on Lambda-influence"
 /begin DEF_CHARACTERISTIC IgCtl_diaLamBascIa_T IgCtl_diaLamBasc_M IgCtl_diaLamLteIaLoResl_T IgCtl_facBascLamOperPnt_M IgCtl_facLteLamOperPnt_M IgCtl_flgOffsRefIgnAgLam_C IgCtl_flgOperPntDpdt_C /end DEF_CHARACTERISTIC
 /begin IN_MEASUREMENT dzwol_w_msg Epm_nEng ExhMgT_ratLamPreIgnCtlCptProtn Ign_ratChrgAirCyl lambas_w_msg /end IN_MEASUREMENT
 /begin OUT_MEASUREMENT IgCtl_diaBascLam IgCtl_diaBascLamCptProtn IgCtl_diaBascLamWoRefIa IgCtl_diaLteLamLoResl /end OUT_MEASUREMENT
 /begin LOC_MEASUREMENT IgCtl_facBascLamOperPnt IgCtl_facLteLamOperPnt IgCtl_ratLam /end LOC_MEASUREMENT
 FUNCTION_VERSION "2.4.0" /end FUNCTION
/begin FUNCTION IgnClPsDD "1000.6.0  Device driver for ignition coil power stage diagnosis" /begin IN_MEASUREMENT Epm_numCyl /end IN_MEASUREMENT /begin LOC_MEASUREMENT IgnClPsDD_DataRaw3 /end LOC_MEASUREMENT FUNCTION_VERSION "1000.6.0" /end FUNCTION
/begin FUNCTION IgnClPs_Dia "1000.9.0  Diagnosis of Powerstages for Ignition"
 /begin DEF_CHARACTERISTIC IgnClPs_BattUmax_C IgnClPs_BattUmin_C IgnClPs_Count IgnClPs_enaAsgnLoglPhyCyl_C IgnClPs_mskInjOffBenchErr_CW IgnClPs_mskInjOff_CW IgnClPs_nEngDiaEna_C /end DEF_CHARACTERISTIC
 /begin REF_CHARACTERISTIC Epm_numFireSeg_C /end REF_CHARACTERISTIC
 /begin IN_MEASUREMENT azoffmsk_w_msg BattU_u B_zesync_msg DSM_TripChgFinshd Epm_nEng Epm_numCyl SyC_stSub /end IN_MEASUREMENT
 /begin OUT_MEASUREMENT abmznd_msg IgnClPs_flgDiagEnad /end OUT_MEASUREMENT
 /begin LOC_MEASUREMENT IgnClPs_DiaEnaIgn IgnClPs_IgnCntCurr IgnClPs_IgnCntOld IgnClPs_LineDiagErrMsk IgnClPs_LineDiagExec IgnClPs_ResLineDiag IgnClPs_valDiaRes /end LOC_MEASUREMENT
 FUNCTION_VERSION "1000.9.0" /end FUNCTION
/begin FUNCTION IgnDD "1000.17.1 Componentdriver ignition"
 /begin DEF_CHARACTERISTIC CWZUEAB IgnDD_numIgnIAmaxOverride_C igndd_PercOffsDwlMax_T igndd_PercOffsDwlMin_T IgnDD_tiPercDwellThd_C /end DEF_CHARACTERISTIC
 /begin IN_MEASUREMENT Epm_ctCyl Epm_nEng Epm_nEngLRes Epm_numCyl Epm_stOpMode Epm_stSync frstinjcyl_msg IgCtl_dwlt_u16 MisfDet_maskMisfStiIgn MisfDet_stMisfGenrRunIgn SyC_stSub zwoutzyl_w_msg /end IN_MEASUREMENT
 /begin OUT_MEASUREMENT azoffmsk_w_msg B_zesync_msg ignactf_w igndd_fdOutPattern_u16 IgnDD_nrCurrNxtCylInfo_a IgnDD_nrOvlCntr_u8 ovlctr_msg zwoutaktarCpl_w zwoutaktar_w zwoutakt_w_msg zzaehl_msg zzaehl_w_msg /end OUT_MEASUREMENT
 /begin LOC_MEASUREMENT IgnDD_agIAmaxEffective igndd_cylFreeze igndd_fdPatArray_u16 IgnDD_flgIAmaxDone igndd_flgWFSDetd igndd_flgWFSDetd_Temp igndd_nrIgnCntrValOnWFSDetn igndd_oldIgnCntVal_u8 igndd_ovl_u8 igndd_state igndd_TiDwlMax_u16 igndd_TiDwlMin_u16 igndd_zwFreeze_w ignFadeStatBits_u32 ignswofdly /end LOC_MEASUREMENT
 FUNCTION_VERSION "1000.17.1" /end FUNCTION
/begin FUNCTION IgnH "1000.10.1_1.0.0Hardwaredriver Ignition" /begin DEF_CHARACTERISTIC IgnH_SelnPinActvLvl_C /end DEF_CHARACTERISTIC /begin IN_MEASUREMENT Epm_numCyl /end IN_MEASUREMENT FUNCTION_VERSION "1000.10.1_1.0.0" /end FUNCTION
/begin FUNCTION IgnLck_SetData "2.2.0     Ignition Lock" /begin IN_MEASUREMENT T15_st T50_st /end IN_MEASUREMENT /begin OUT_MEASUREMENT CoVeh_stIgnLckTerm15 CoVeh_stIgnLckTerm50 /end OUT_MEASUREMENT FUNCTION_VERSION "2.2.0" /end FUNCTION
/begin FUNCTION IKCDST "7.4.0     Base point distribution for knock control"
 /begin DEF_CHARACTERISTIC IKCtl_Load08_X_AX IKCtl_LoadSyn08_X_AX IKCtl_nEng08_X_AX IKCtl_nEng13_X_AX IKCtl_nEngVar13_X_AX IKCtl_nEngVarSyn13_X_AX IKCtl_ratLoad04_X_AX IKCtl_ratLoadDy04_X_AX /end DEF_CHARACTERISTIC
 /begin IN_MEASUREMENT AirMod_ratChrgAirCyl Epm_nEng SyC_stSub /end IN_MEASUREMENT
 FUNCTION_VERSION "7.4.0" /end FUNCTION
/begin FUNCTION InjDDPfi "1000.30.0 Device Driver Port Fuel Injection" /begin DEF_CHARACTERISTIC FstRcvAftFco_C /end DEF_CHARACTERISTIC /begin REF_CHARACTERISTIC EpmSeq_phiInt_CA Epm_phiGap2Zero_C /end REF_CHARACTERISTIC
 /begin IN_MEASUREMENT B_nsp_msg B_stendes_msg dtemnkt_w_msg Epm_ctCyl Epm_nEng Epm_numCyl Epm_stOpMode Epm_stSync evz_austot_msg MisfDet_maskMisfStiInj SyC_stSub tez_l_msg te_l_msg tvub_w_msg wea_msg weea_msg weestsim_msg wes_msg /end IN_MEASUREMENT
 /begin OUT_MEASUREMENT anzesab_w_msg anztib_msg anztib_w_msg anzti_msg anzti_w_msg frstinjcyl frstinjcylAftFco frstinjcyl_msg injddpfiAnztis injddpfi_agFrstTdc injddpfi_frstinjcyl InjDDPfi_injEnadCylMsk_msg InjDDPfi_injTrigCylMskRdnt_msg InjDDPfi_injTrigCylMsk_msg injddpfi_postInjCtr lastzyl_msg nexttizyl_msg /end OUT_MEASUREMENT
 /begin LOC_MEASUREMENT AngZotTicks AngZotTicksInjA B_firstSyn B_firstSynAftFco firstSynAftFcoInjA firstSynInjA frstinjcylAftFcoInjA frstinjcylInjA injddpfi_agFrstTdcInjA injddpfi_frstinjcylInjA InjDDPfi_idxIMeasTrig InjDDPfi_idxUMeasTrig InjDDPfi_injEnadCylMskInjA InjDDPfi_injTrigCylMskInjA InjDDPfi_injTrigCylMsk_rdntInjA Injddpfi_OldCvoSigAcqn_ctr injddpfi_stfrstSyncEna injdd_tvub_w lastzylInjA nexttizylInjA TAB_NEXT_ZZYL /end LOC_MEASUREMENT
 FUNCTION_VERSION "1000.30.0" /end FUNCTION
/begin FUNCTION InjHGdi "20.27.0   Injection Hardware Driver, Solenoid Injectors"
 /begin LOC_MEASUREMENT InjHGdi_ChlNumFinishedInj InjHGdi_ChlNumRequestedInj InjHGdi_ChlNumStartedInj InjHGdi_InfoFlgs InjHGdi_numAbortedInj InjHGdi_numFinishedInj InjHGdi_numRequestedInj InjHGdi_numStartedInj InjHGdi_numWithdrawedInj /end LOC_MEASUREMENT
 FUNCTION_VERSION "20.27.0" /end FUNCTION
/begin FUNCTION InjHGdi_Auto "" /end FUNCTION
/begin FUNCTION IntkAirT_AdprOutp "2.14.0    Export adapter for sensor-package IntkAirT" /begin DEF_CHARACTERISTIC TANSDE TTFANMOT /end DEF_CHARACTERISTIC
 /begin IN_MEASUREMENT Eep_EnvRamHist Eep_EnvRamInvld Epm_stSpd IntkAirT_flgIntkMnfldMeasdVld IntkAirT_flgIntkMnfldVld IntkAirT_flgSnsr1CrssChkClr IntkAirT_flgSnsr1CrssChkPrms IntkAirT_flgSnsr1ElecChkClr IntkAirT_flgSnsr1ElecVld IntkAirT_flgSnsr1MeasdVld IntkAirT_flgSnsr1PlausChkClr IntkAirT_flgSnsr1PlausChkPrms IntkAirT_flgThrVlvUsVld IntkAirT_tIntkMnfld IntkAirT_tIntkMnfldMeasd IntkAirT_tSnsr1 IntkAirT_tThrVlvUs IntkAirT_tThrVlvUsMax IntkAirT_tThrVlvUsMin SyC_stSub TiEngOff_bRst /end IN_MEASUREMENT
 /begin OUT_MEASUREMENT B_ctfa1fcl_msg B_ctfa1prm_msg B_etfa1fcl_msg B_ptfa1fcl_msg B_ptfa1prm_msg B_tansgg_msg B_tasrgg_msg B_tasrg_msg B_tavdkg_msg B_tfa1gg_msg B_tfa1rg_msg tansabz_msg tansab_msg tansk_w_msg tanslin_msg tans_msg tasrg_w_msg tasr_w_msg tavdkmn_w_msg tavdkmx_w_msg tavdk_w_msg /end OUT_MEASUREMENT
 /begin LOC_MEASUREMENT B_tansnmot B_tfastz tansab_loc /end LOC_MEASUREMENT
 FUNCTION_VERSION "2.14.0" /end FUNCTION
/begin FUNCTION IntkAirT_Dd "5.0.0     DeviceDriver for Intake Air Temperature Sensor"
 /begin DEF_CHARACTERISTIC IntkAirT_cwSnsrFrzEna_C IntkAirT_LnrwSnsr1_T IntkAirT_mAirMflmaxSnsr1Enad_C IntkAirT_mAirMfSnsrElecChk_C IntkAirT_SnsrLim_CW IntkAirT_SRCSnsrLim_CW IntkAirT_tEngMinRelsElecDiag_C IntkAirT_tEngMinRelsStrtElecDiag_C IntkAirT_tiDebElecFaultSnsr1_C IntkAirT_tiDebHealElecFaultSnsr1_C IntkAirT_TnDebDiagSnsr_C IntkAirT_TnPT1Snsr1_C IntkAirT_UmaxSnsr1_C IntkAirT_UminSnsr1_C IntkAirT_vVehMaxRelsElecDiag_C /end DEF_CHARACTERISTIC
 /begin IN_MEASUREMENT AirMod_mfAirCyl CEngDsT_t CEngDsT_tStrt CEngDsT_t_Sq ExhMod_mAirMfIntegEngStrt IntkAirT_flgSnsr1ElecChkClr SyC_stSub VehV_v /end IN_MEASUREMENT
 /begin OUT_MEASUREMENT IntkAirT_flgImps1Err IntkAirT_flgImps1Heal IntkAirT_flgSRC1MaxErr IntkAirT_flgSRC1MaxHeal IntkAirT_flgSRC1MinErr IntkAirT_flgSRC1MinHeal IntkAirT_flgSRCMaxEna IntkAirT_flgSRCMinEna IntkAirT_stSnsr1ADC IntkAirT_tSnsr1ADC IntkAirT_tSnsr1TstrADC IntkAirT_tSnsrFild1ADC IntkAirT_tSnsrFildLimd1ADC IntkAirT_tSnsrTstr IntkAirT_uSnsr1Exprt /end OUT_MEASUREMENT
 /begin LOC_MEASUREMENT IntkAirT_flgDSMClrDevDrvrSnsr1 IntkAirT_flgImps1Errloc IntkAirT_flgImps1Healloc IntkAirT_flgNormOp IntkAirT_flgSnsr1ElecEnag IntkAirT_flgSnsr1MaxErr IntkAirT_flgSnsr1MinErr IntkAirT_flgSnsr1PwrSplyAvl IntkAirT_flgSRC1MaxErrloc IntkAirT_flgSRC1MaxHealloc IntkAirT_flgSRC1MinErrloc IntkAirT_flgSRC1MinHealloc IntkAirT_flgSRC1MinRels IntkAirT_flgSRC2MinRels IntkAirT_flgSRC3MinRels IntkAirT_flgSRC4MinRels IntkAirT_flgSRC5MinRels IntkAirT_flgSRC6MinRels IntkAirT_stSnsr1ADCLoc IntkAirT_tSnsr1ADCLoc IntkAirT_tSnsr1TstrADCLoc IntkAirT_tSnsrFild1ADCLoc IntkAirT_tSnsrFildLimd1ADCLoc IntkAirT_uSnsr1CrssSwtLoc /end LOC_MEASUREMENT
 FUNCTION_VERSION "5.0.0" /end FUNCTION
/begin FUNCTION IntkAirT_DiagCoorrSnsr1 "1.15.0    Diagnosis coordinator of Intake Air Temperature Sensor 1" /begin DEF_CHARACTERISTIC IntkAirT_tiSnsr1DSMCycRprt_C IntkAirT_tiSnsr1DSMFrstRprt_C /end DEF_CHARACTERISTIC
 /begin IN_MEASUREMENT IntkAirT_flgCrss1MaxErr IntkAirT_flgCrss1MaxHeal IntkAirT_flgCrss1MinErr IntkAirT_flgCrss1MinHeal IntkAirT_flgCrssChk1NumrInc IntkAirT_flgHSC1MaxErr IntkAirT_flgHSC1MaxHeal IntkAirT_flgImps1Err IntkAirT_flgImps1Heal IntkAirT_flgPlausChk1NumrInc IntkAirT_flgPRC1MaxErr IntkAirT_flgPRC1MaxHeal IntkAirT_flgPRC1MinErr IntkAirT_flgPRC1MinHeal IntkAirT_flgSRC1MaxErr IntkAirT_flgSRC1MaxHeal IntkAirT_flgSRC1MinErr IntkAirT_flgSRC1MinHeal IntkAirT_flgSTC1Err IntkAirT_flgSTC1Heal IntkAirT_stSnsr1ADC IntkAirT_tSnsr1ADC IntkAirT_tSnsr1TstrADC IntkAirT_tSnsrFild1ADC IntkAirT_tSnsrFildLimd1ADC TDev_flgDSMRprt1000ms TDev_flgDSMRprt100ms /end IN_MEASUREMENT
 /begin OUT_MEASUREMENT IntkAirT_flgIntkMnfldMeasdVld IntkAirT_flgSnsr1CrssChkClr IntkAirT_flgSnsr1CrssChkPrms IntkAirT_flgSnsr1ElecChkClr IntkAirT_flgSnsr1ElecVld IntkAirT_flgSnsr1MeasdVld IntkAirT_flgSnsr1PlausChkClr IntkAirT_flgSnsr1PlausChkPrms IntkAirT_stSnsr1 IntkAirT_tIntkMnfldMeasd IntkAirT_tSnsr1 IntkAirT_tSnsr1Tstr IntkAirT_tSnsrFild1 IntkAirT_tSnsrFildLimd1 /end OUT_MEASUREMENT
 /begin LOC_MEASUREMENT IntkAirT_stSnsr1CycRprt1000ms IntkAirT_stSnsr1CycRprt100ms IntkAirT_tiSnsr1CycRprt1000ms IntkAirT_tiSnsr1CycRprt100ms /end LOC_MEASUREMENT
 FUNCTION_VERSION "1.15.0" /end FUNCTION
/begin FUNCTION IntkAirT_PlausDiagSnsr1 "1.7.0     Plausibility Check of the Intake Air Temperature sensor 1"
 /begin DEF_CHARACTERISTIC IntkAirT_cntrSTC1HiVld_C IntkAirT_cntrSTC1LoVld_C IntkAirT_mHSC1MLMax_C IntkAirT_mHSC1MLMin_C IntkAirT_mSTC1HiMLInteg_T IntkAirT_mSTC1HiMLMax_C IntkAirT_mSTC1LoMLMax_C IntkAirT_mSTC1LoMLMin_C IntkAirT_stCfgHSC1_C IntkAirT_stCfgPRC1_C IntkAirT_stCfgSTC1_C IntkAirT_tHSC1HealThd_C IntkAirT_tHSC1Mdl_T IntkAirT_tiHSC1EnaDly_C IntkAirT_tiHSC1ErrDly_C IntkAirT_tiHSC1HealDly_C IntkAirT_tiHSC1MLDly_C IntkAirT_tiPRC1ErrDly_C IntkAirT_tiPRC1HealDly_C IntkAirT_tiSTC1HiOffDly_C IntkAirT_tiSTC1HiOnDly_C IntkAirT_tiSTC1LoOffDly_C IntkAirT_tiSTC1LoOnDly_C IntkAirT_tPRC1Max_C IntkAirT_tPRC1Min_C IntkAirT_tSTC1EnaThdMax_C IntkAirT_tSTC1ErrThd_T IntkAirT_tSTC1HiTMotMin_C IntkAirT_vHSC1VMin_C IntkAirT_vSTC1HiVMax_C IntkAirT_vSTC1LoVMin_C /end DEF_CHARACTERISTIC
 /begin IN_MEASUREMENT AirMod_mfAirCyl CEngDsT_t CEngDsT_tStrtFrst Epm_stSpd IntkAirT_flgSnsr1PlausChkClr IntkAirT_flgSnsr1PlausChkPrms IntkAirT_flgSRCMaxEna IntkAirT_flgSRCMinEna IntkAirT_stSnsr1 IntkAirT_tSnsrFild1 SyC_stSub VehV_v /end IN_MEASUREMENT
 /begin OUT_MEASUREMENT IntkAirT_flgHSC1MaxErr IntkAirT_flgHSC1MaxHeal IntkAirT_flgPlausChk1NumrInc IntkAirT_flgPRC1MaxErr IntkAirT_flgPRC1MaxHeal IntkAirT_flgPRC1MinErr IntkAirT_flgPRC1MinHeal IntkAirT_flgSTC1Err IntkAirT_flgSTC1Heal /end OUT_MEASUREMENT
 /begin LOC_MEASUREMENT IntkAirT_cntrSTC1HiVld IntkAirT_cntrSTC1LoVld IntkAirT_flgDSMClr1000msPlausDiagSnsr1 IntkAirT_flgDSMClr100msPlausDiagSnsr1 IntkAirT_flgHSC1Ena IntkAirT_flgHSC1NumrInc IntkAirT_flgPRC1ErrDeb IntkAirT_flgPRC1ErrTmp IntkAirT_flgPRC1HealDeb IntkAirT_flgPRC1MaxErrTmp IntkAirT_flgPRC1MinErrTmp IntkAirT_flgSTC1Ena IntkAirT_flgSTC1ErrTmp IntkAirT_flgSTC1HiTmp IntkAirT_flgSTC1HiVld IntkAirT_flgSTC1LoTmp IntkAirT_flgSTC1LoVld IntkAirT_flgSTC1NumrInc IntkAirT_mSTC1HiMLInteg IntkAirT_tHSC1Mdl IntkAirT_tiSTC1HiOff IntkAirT_tiSTC1HiOn IntkAirT_tiSTC1LoOff IntkAirT_tiSTC1LoOn IntkAirT_tSnsrFild1Max IntkAirT_tSnsrFild1Min /end LOC_MEASUREMENT
 FUNCTION_VERSION "1.7.0" /end FUNCTION
/begin FUNCTION IntkAirT_VdIntkMnfld "1.9.0     Intake Air Temperature in Manifold before Intake Valve (after EGR)"
 /begin DEF_CHARACTERISTIC IntkAirT_stCfgIntkMnfld_C IntkAirT_tiIntkMnfldFil_C IntkAirT_tiIntkMnfldMeasdVldDly_C /end DEF_CHARACTERISTIC
 /begin IN_MEASUREMENT B_tasrmg_msg IntkAirT_flgIntkMnfldMeasdVld IntkAirT_stSnsr1 IntkAirT_tIntkMnfldMeasd IntkAirT_tSnsr1Mdl tasrm_w_msg /end IN_MEASUREMENT
 /begin OUT_MEASUREMENT IntkAirT_flgIntkMnfldVld IntkAirT_tIntkMnfld IntkAirT_tIntkMnfld_Sq /end OUT_MEASUREMENT
 /begin LOC_MEASUREMENT IntkAirT_flgIntkMnfldReplSnsrVld IntkAirT_flgIntkMnfldReplVld IntkAirT_flgIntkMnfldSeln IntkAirT_flgIntkMnfldSelnSwt IntkAirT_tIntkMnfldMdlInt IntkAirT_tIntkMnfldRepl IntkAirT_tIntkMnfldReplSnsr IntkAirT_tIntkMnfldSeln /end LOC_MEASUREMENT
 FUNCTION_VERSION "1.9.0" /end FUNCTION
/begin FUNCTION IntkAirT_VdReplMdlSnsr1 "1.1.0     Virtual Device: Replacement value for intake air temperature sensor 1" /begin DEF_CHARACTERISTIC IntkAirT_tReplSnsr1Mdl_C /end DEF_CHARACTERISTIC /begin IN_MEASUREMENT SyC_stSub /end IN_MEASUREMENT /begin OUT_MEASUREMENT IntkAirT_tSnsr1Mdl /end OUT_MEASUREMENT FUNCTION_VERSION "1.1.0" /end FUNCTION
/begin FUNCTION IntkAirT_VdThrVlvUs "1.9.0     Intake Air Temperature before Throttle Valve" /begin DEF_CHARACTERISTIC IntkAirT_stCfgThrVlvUs_C IntkAirT_tThrVlvUsTolrMax_C /end DEF_CHARACTERISTIC /begin IN_MEASUREMENT B_tavdkmg_msg tavdkm_w_msg /end IN_MEASUREMENT
 /begin OUT_MEASUREMENT IntkAirT_flgThrVlvUsVld IntkAirT_tThrVlvUs IntkAirT_tThrVlvUsMax IntkAirT_tThrVlvUsMin IntkAirT_tThrVlvUs_Sq /end OUT_MEASUREMENT
 /begin LOC_MEASUREMENT IntkAirT_flgThrVlvUsReplSnsrVld IntkAirT_flgThrVlvUsReplVld IntkAirT_tThrVlvUsMdlInt IntkAirT_tThrVlvUsRepl IntkAirT_tThrVlvUsReplSnsr /end LOC_MEASUREMENT
 FUNCTION_VERSION "1.9.0" /end FUNCTION
/begin FUNCTION KHMR "24.13.0_1.2.0required worsening of engine efficiency for catalyst heating"
 /begin DEF_CHARACTERISTIC CWKHMR ExhMgT_effCatHeatgLimMax_C ExhMgT_effCatHeatgLimMin_C ExhMgt_etaCatHeatgIdleMod_M ExhMgt_etaCatHeatgPartLoadMod_M ExhMgT_etaCatWrmIdleGearEngd_GM ExhMgT_etaCatWrmIdle_GM ExhMgT_etaCatWrmPartLoad_GM ExhMgT_facCorrnEffOil_M ExhMgT_facEngEffTStrt_M ExhMgT_facEtaCatWrmAltiT_M ExhMgT_facEtaEngCatHeatg_T ExhMgT_facEtaEngLoVlvLftAlti_T ExhMgT_facTEngCatHeatgFilTn_T ExhMgT_facWghCatWrmLimMax_C ExhMgT_facWghCatWrmLimMin_C ExhMgT_iaCatWrmIdleGearEngd_GM ExhMgT_iaCatWrmIdle_GM ExhMgT_iaCatWrmPartLoad_GM ExhMgT_stEtaCatHeatg_C ExhMgt_tiCatHeatgIdle_C ExhMgt_tiCatHeatgPartLoad_C ExhMgT_tiEtaCatWrmFild_C ExhMgT_tStrtCorrnEffMin_C FETAKHKTKO FETAKHLLAP FETAKHTLAP KFETAKHKTL KFETAKHKTLVH KFETAKHKTT KFETAKHKTTVH KFETAKTFSL KFETAKTFSLVH KFFKWTIVK KFZWKHKTL KFZWKHKTLVH KFZWKHKTT KFZWKHKTTVH KFZWKTFSL KFZWKTFSLVH KLDETAKH KLDLUWSKH KLFSTKTAGE KLFSTKTFHO KLFSTKTMST KLFSTKTTNS SMG08KHUW SMG10KHUW SNM08KHUW SNM12KHUW TETAKHKT TETAKHKTLL VFZGKHKT ZKKHKTL ZKKHKTT /end DEF_CHARACTERISTIC
 /begin REF_CHARACTERISTIC KFMIOP /end REF_CHARACTERISTIC
 /begin IN_MEASUREMENT AirC_stCmprAct AirMod_ratChrgAirCyl B_fs_msg B_khan_msg B_khmr_msg B_ll_msg B_vhegfe_msg B_vheg_msg CEngDsT_t dsdluts_w_msg EngStrt_bStrtEnd Epm_nEng etafue_w_msg etazwbm_w_msg etazwmn_w_msg ExhMgT_facCatHeatgFinshd ExhMgT_facCatHeatgProgs ExhMgT_facCatHeatgRamp ExhMgT_facWghtCatAge ExhMgT_flgCatHeatgColdStrtReq ExhMgT_flgCatHeatgUpActv ExhMgT_flgCatHeatgWrmReq ExhMgT_tCat1Seln1 ExhMgT_tCatHeatgTCatSelnActn mifal_w_msg OilSwmpT_tMdl PEnv_facCorrAlti rlmxbkv_w_msg SyC_ctDrvEnter SyC_ctPostDrvLeave SyC_stSub tnse_w_msg VehV_v zwopt_msg /end IN_MEASUREMENT
 /begin OUT_MEASUREMENT etaaktsl_w_msg etakhdia_w_msg etakhktl_w_msg etakhktt_w_msg etakh_w_msg etaktlbg_w_msg etakttbg_w_msg ExhMgT_etaSpCatWrmIdle ExhMgT_etaSpCatWrmPartLoad ExhMgT_facEtaCatWrmAltiT ExhMgT_facEtaColdStrtHeatgAltiT ExhMgT_facEtaEngCatHeatg ExhMgT_facWghCatWrmTwc ExhMgT_fetakhllfa_msg ExhMgT_fetakhtlfa_msg ExhMgT_tEngCatHeatgFild fwetakhkt_msg fwsanfdlut_msg /end OUT_MEASUREMENT
 /begin LOC_MEASUREMENT B_detakhap B_zwetakh etakhaw_w etakhbg_w etakhktd_w etakhktn_w etakhkt_w etakhkw_w etakhsv_w etazwmnk_w ExhMgt_cntrIniDrvEngDgrdCatHeatg ExhMgt_cntrReIniEngDgrdCatHeatg ExhMgt_cntrReIniEngDgrdCatHeatg10ms ExhMgt_cntrReIniEngDgrdCatHeatg2 ExhMgT_effCatHeatgLim ExhMgT_effMinDeltaCatHeatg ExhMgt_etaCatHeatg ExhMgT_etaCatHeatgNomFild ExhMgT_etaCatHeatgWght ExhMgT_etaSpCatWrm ExhMgT_facCatHeatgAge ExhMgT_facCorrnEtaEngCatHeatg ExhMgT_facEngEffCorrnIdle ExhMgT_facEngEffCorrnPartLoad ExhMgT_facEtaCatAge ExhMgT_facEtaCatHeatg ExhMgt_facIntrpnCatHeatgEta ExhMgT_facWghCatWrm ExhMgT_facWghCatWrmLim ExhMgT_flgActvAltiBasdCorrn ExhMgT_flgAvsSetIdle ExhMgT_flgAvsSetPartLoad ExhMgT_flgCatHeatgBreak ExhMgT_flgCatHeatgRstCdn ExhMgT_flgCatWrmEngEffIa ExhMgT_flgfacWghCatWrmActv ExhMgT_iaCatWrmIdle ExhMgT_iaCatWrmPartLoad ExhMgT_tEngCatHeatgDif ExhMgT_tOilMdlCatHeatg fstetakhkw fstkttmsfh mimxkhbk_w tmstchtr_w zwkhktl zwkhktt /end LOC_MEASUREMENT
 FUNCTION_VERSION "24.13.0_1.2.0" /end FUNCTION
/begin FUNCTION KnDetControl "18.13.0   MED17 Complex Driver KnDet"
 /begin DEF_CHARACTERISTIC KnDet_CalMeasWin_C KnDet_CfgRelsMeasWin_C KnDet_GainRng0_C KnDet_GainRng1_C KnDet_GainRng2_C KnDet_NThdGainRng1_C KnDet_NThdGainRng2_C KnDet_ThresNGradMeasWin_C KnDet_ThresNMeasWin_C KnDet_ThresNumMeasWin_C KnDet_ThresTiDiffMeasWin_C /end DEF_CHARACTERISTIC
 /begin IN_MEASUREMENT KnDet_IntegWinEndBuf0 KnDet_IntegWinEndBuf1 KnDet_IntegWinEndBuf2 Epm_ctCyl Epm_dnEng Epm_nEng Epm_numCyl Epm_stOpMode Epm_stSync evz_austot_msg IKCtl_nUsdKnKSnsr KnDet_bDiaDeb KnDet_flgScChkDiagAck KnDet_numValMeasWin KnDet_numValTmpMeasWin KnDet_stSigEval KnDet_vNewIntegWinEnd SyC_stSub /end IN_MEASUREMENT
 /begin OUT_MEASUREMENT B_stfmf KnDet_bDiFctCall KnDet_bStMeasWin KnDet_ctCylBuf0 KnDet_ctCylBuf1 KnDet_ctCylBuf2 KnDet_ctDia KnDet_ctInpBuf KnDet_ctIntegRsltInvld KnDet_ctOutpBuf KnDet_DiffMeasWinMeasd KnDet_facPolarityDiag KnDet_flgBufOvf KnDet_flgBufOvfTmp KnDet_flgKnkSyncd KnDet_flgReIni KnDet_FltNewBuf0 KnDet_FltNewBuf1 KnDet_FltNewBuf2 KnDet_IntegWinEndBuf0 KnDet_IntegWinEndBuf1 KnDet_IntegWinEndBuf2 KnDet_KnKInvldBuf0 KnDet_KnKInvldBuf1 KnDet_KnKInvldBuf2 KnDet_MeasWinEndMeasd KnDet_NewDataBuf0 KnDet_NewDataBuf1 KnDet_NewDataBuf2 KnDet_numFltNew KnDet_numFltOldAry KnDet_numSensDia KnDet_ReqSigEvalMode KnDet_RlsChkMeasWin KnDet_RlsChkWinMeas KnDet_SensMode KnDet_stDiaBuf0 KnDet_stDiaBuf1 KnDet_stDiaBuf2 KnDet_stDiaCtl KnDet_stDiaCtlBuf0 KnDet_stDiaCtlBuf1 KnDet_stDiaCtlBuf2 KnDet_stRlsDiaBuf0 KnDet_stRlsDiaBuf1 KnDet_stRlsDiaBuf2 KnDet_stSigEvalCurrCmb KnDet_stSigEvalCurrCmbLstEntry KnDet_tiLenMeasWinMeasd /end OUT_MEASUREMENT
 /begin LOC_MEASUREMENT KnDet_ctCyl KnDet_ctCylTmp KnDet_ctMeasWin KnDet_GainShift KnDet_GainShiftTmp KnDet_HwDiaMode KnDet_nrDiffValMeasWinMeasdTmp KnDet_nrValMeasWinMeasd KnDet_numFltNewTmp KnDet_numKnkSnsr KnDet_numValMeasWinEst KnDet_numValMeasWinTmp KnDet_phiMeasWinBgn KnDet_phiMeasWinBgnKnk KnDet_phiMeasWinLngth KnDet_phiMeasWinLngthKnk KnDet_phiMeasWinLngthOld KnDet_ReqChk KnDet_stCalMeasWin KnDet_stGetDigRawVal KnDet_stMeasWin /end LOC_MEASUREMENT
 FUNCTION_VERSION "18.13.0" /end FUNCTION
/begin FUNCTION KnDetLTest "18.5.0    knock sensor line diagnosis (short circuit detection)" /begin DEF_CHARACTERISTIC KnDet_SnsrMaxErr_C KnDet_SnsrMinErr_C /end DEF_CHARACTERISTIC
 /begin IN_MEASUREMENT DSM_TripChgFinshd KnDet_ctDia KnDet_facPolarityDiag KnDet_NewDiagRes KnDet_stDiaCtl SyC_stSub /end IN_MEASUREMENT
 /begin OUT_MEASUREMENT KnDet_bDiaDeb KnDet_DiaRes KnDet_flgScChkDiagAck /end OUT_MEASUREMENT
 /begin LOC_MEASUREMENT KnDet_DebDiagVal1 KnDet_DebDiagVal2 KnDet_flgSnsrMaxErr KnDet_flgSnsrMinErr KnDet_vDiagVal /end LOC_MEASUREMENT
 FUNCTION_VERSION "18.5.0" /end FUNCTION
/begin FUNCTION KnDetSigEval "18.12.0   MED17 Complex Driver KnDet" /begin DEF_CHARACTERISTIC KnDet_CoefFlt_CA /end DEF_CHARACTERISTIC /begin IN_MEASUREMENT KnDet_numFltNew KnDet_ReqSigEvalMode /end IN_MEASUREMENT
 /begin OUT_MEASUREMENT KnDet_bNewEval KnDet_NewDiagRes KnDet_numValMeasWin KnDet_numValTmpMeasWin KnDet_stSigEval KnDet_vNewIntegWinEnd KnDet_vValOffs /end OUT_MEASUREMENT
 /begin LOC_MEASUREMENT KnDet_bEnaSigEval KnDet_nrValDly KnDet_nrValDlyBasc /end LOC_MEASUREMENT
 FUNCTION_VERSION "18.12.0" /end FUNCTION
/begin FUNCTION KnDet_Conf "18.3.0    KnDet Configuration" FUNCTION_VERSION "18.3.0" /end FUNCTION
/begin FUNCTION KnDet_FadcCtl "18.11.0   KnDet A-D converter control" FUNCTION_VERSION "18.11.0" /end FUNCTION
/begin FUNCTION KnDet_MeasWinCtl "18.10.0   KnDet measuring window control" FUNCTION_VERSION "18.10.0" /end FUNCTION
/begin FUNCTION KnDet_MeasWinIntrSrv "18.7.0    KnDet measuring window interrupt" FUNCTION_VERSION "18.7.0" /end FUNCTION
/begin FUNCTION KnDet_SubBlockIntrSrv "18.6.0    KnDet signal evaluation interrupt" FUNCTION_VERSION "18.6.0" /end FUNCTION
/begin FUNCTION KOEVAB "15.11.0   Coordination of injection valve cutoff" /begin IN_MEASUREMENT B_dveada_msg EpmRRS_bEngSwOff /end IN_MEASUREMENT /begin OUT_MEASUREMENT B_koevab_msg InjSys_flgCutOffReqTyp1 /end OUT_MEASUREMENT FUNCTION_VERSION "15.11.0" /end FUNCTION
/begin FUNCTION KRADAP "16.2.0    Knock control: stationary adaptation"
 /begin DEF_CHARACTERISTIC CWVEVKRA IKCtl_agAdpnRedn_C IKCtl_agAdvLrng_C IKCtl_agMaxRtdAdjmt_C IKCtl_agMinDstAdpnLrng_C IKCtl_agRtdtLrng_C KRTNSEO KRVFZGO /end DEF_CHARACTERISTIC
 /begin IN_MEASUREMENT Eep_EnvRamHist Eep_EnvRamInvld Ign_bVlvLInNxtCmbs IKCtl_agKnkAvrg_s16 IKCtl_agKnkLimrAvrg_s16 IKCtl_agMaxRtdtCurr_s16 IKCtl_cntrCyl IKCtl_flgAdpnEna IKCtl_flgAdpnLrnEna IKCtl_flgAdvIa IKCtl_flgKnkDetn IKCtl_flgKnkEna IKCtl_flgSftyRtdt IKCtl_idxAdpn_u16 IKCtl_stVldnSnsrSig SyC_ctPostDrvLeave SyC_stSub tnsez_w_msg VehV_v /end IN_MEASUREMENT
 /begin OUT_MEASUREMENT IKCtl_agAdpnCurr_s16 IKCtl_agAdpnVlvLft_as16 IKCtl_agAdpn_as16 /end OUT_MEASUREMENT
 /begin LOC_MEASUREMENT IKCtl_ctReIni100msKRADAP kradapred /end LOC_MEASUREMENT
 FUNCTION_VERSION "16.2.0" /end FUNCTION
/begin FUNCTION KRDY "7.5.0     Knock control for load dynamics"
 /begin DEF_CHARACTERISTIC CWKRDYE DYADMAX DYADS DYAFVS DYAMNV FKELDYA IKCtl_facDynAdpn_M IKCtl_facTipin_GT IKCtl_nrCmbPremDynOffs_M PZWKRA /end DEF_CHARACTERISTIC
 /begin REF_CHARACTERISTIC IKCtl_nEng08_X_AX /end REF_CHARACTERISTIC
 /begin IN_MEASUREMENT B_eepwf_msg Epm_nEng IKCtl_cntrCyl IKCtl_facKnkInten_u8 IKCtl_flgDynAdpnEna IKCtl_flgDynAdpnRead IKCtl_flgKnkDetn IKCtl_flgLoadDynAdpn IKCtl_flgLoadDynAdpnAdv IKCtl_flgLoadDynCtrlEna IKCtl_flgRtdtUse IKCtl_flgTEna IKCtl_flgTipinDetn IKCtl_idxSpdAdpn_u8 IKCtl_wDetnThdCorr_au8 SyC_ctPostDrvLeave SyC_stSub taev_w_msg tans_msg /end IN_MEASUREMENT
 /begin OUT_MEASUREMENT IKCtl_agDynAdpnOffs_s8 IKCtl_agDynAdpn_as8 /end OUT_MEASUREMENT
 /begin LOC_MEASUREMENT B_kldynrm B_kldystk dymntvs IKCtl_ctReIni10msKRDY IKCtl_tmpReIniKRDY stuetz taevkr wkrdyaa wkrdyti zaldy zzprz zzwdykr_w zzwdymd_w /end LOC_MEASUREMENT
 FUNCTION_VERSION "7.5.0" /end FUNCTION
/begin COMPU_METHOD AngleCrS "" RAT_FUNC "%6.4" "deg CrS" COEFFS 0 45.5111111111 0 0 0 1 /end COMPU_METHOD
/begin COMPU_METHOD B_TRUE "" TAB_VERB "%6.3" "" COMPU_TAB_REF B_TRUE /end COMPU_METHOD
/begin COMPU_VTAB B_TRUE "" TAB_VERB 2 0 "FALSE" 1 "TRUE" /end COMPU_VTAB
/begin COMPU_METHOD DEZ "" RAT_FUNC "%6.2" "" COEFFS 0 1 0 0 0 1 /end COMPU_METHOD
/begin COMPU_METHOD dez "" RAT_FUNC "%6.2" "" COEFFS 0 1 0 0 0 1 /end COMPU_METHOD
/begin COMPU_METHOD EngN "" RAT_FUNC "%6.3" "rpm" COEFFS 0 2 0 0 0 1 /end COMPU_METHOD
/begin COMPU_METHOD EngNGrd "" RAT_FUNC "%6.3" "rpm/s" COEFFS 0 2 0 0 0 1 /end COMPU_METHOD
/begin COMPU_METHOD EngN_LRes "" RAT_FUNC "%6.1" "rpm" COEFFS 0 0.025 0 0 0 1 /end COMPU_METHOD
/begin COMPU_METHOD fak_q0p00781 "" RAT_FUNC "%6.4" "-" COEFFS 0 128 0 0 0 1 /end COMPU_METHOD
/begin COMPU_METHOD fak_sw_b2 "" RAT_FUNC "%7.6" "-" COEFFS 0 65536 0 0 0 4 /end COMPU_METHOD
/begin COMPU_METHOD fak_ub_b1 "" RAT_FUNC "%6.4" "-" COEFFS 0 256 0 0 0 1 /end COMPU_METHOD
/begin COMPU_METHOD fak_ub_b16 "" RAT_FUNC "%6.4" "-" COEFFS 0 256 0 0 0 16 /end COMPU_METHOD
/begin COMPU_METHOD fak_ub_b2 "" RAT_FUNC "%8.5" "-" COEFFS 0 256 0 0 0 2 /end COMPU_METHOD
/begin COMPU_METHOD fak_ub_q0p00392 "" RAT_FUNC "%6.4" "-" COEFFS 0 255 0 0 0 1 /end COMPU_METHOD
/begin COMPU_METHOD fak_uw_b1 "" RAT_FUNC "%7.6" "-" COEFFS 0 65536 0 0 0 1 /end COMPU_METHOD
/begin COMPU_METHOD fak_uw_b16 "" RAT_FUNC "%6.5" "-" COEFFS 0 65536 0 0 0 16 /end COMPU_METHOD
/begin COMPU_METHOD fak_uw_b2 "" RAT_FUNC "%7.6" "-" COEFFS 0 65536 0 0 0 2 /end COMPU_METHOD
/begin COMPU_METHOD fak_uw_b4 "" RAT_FUNC "%7.6" "-" COEFFS 0 65536 0 0 0 4 /end COMPU_METHOD
/begin COMPU_METHOD IgnClPs_LineDiag_VERB "" TAB_VERB "%6.3" "" COMPU_TAB_REF IgnClPs_LineDiag_VERB /end COMPU_METHOD
/begin COMPU_VTAB IgnClPs_LineDiag_VERB "" TAB_VERB 6 0 "IGNCLPS_LINEDIAGRES_SCTOGND" 1 "IGNCLPS_LINEDIAGRES_OPENLOAD" 2 "IGNCLPS_LINEDIAGRES_SCTOUBATT" 3 "IGNCLPS_LINEDIAGRES_OK" 4 "IGNCLPS_LINEDIAGRES_COMERROR" 8 "IGNCLPS_LINEDIAGRES_NOEXEC" /end COMPU_VTAB
/begin COMPU_METHOD kw_q0p75 "" RAT_FUNC "%6.3" "Grad KW" COEFFS 0 4 0 0 0 3 /end COMPU_METHOD
/begin COMPU_METHOD kw_sw_q0p0219 "" RAT_FUNC "%6.4" "Grad KW" COEFFS 0 32768 0 0 0 720 /end COMPU_METHOD
/begin COMPU_METHOD lu_MEx "" RAT_FUNC "%6.4" "(Umdr./sec)^2" COEFFS 0 140.7374884 0 0 0 1 /end COMPU_METHOD
/begin COMPU_METHOD m_ub_b1020 "" RAT_FUNC "%6.2" "kg/h" COEFFS 0 1 0 0 0 4 /end COMPU_METHOD
/begin COMPU_METHOD m_ub_b23p3 "" RAT_FUNC "%6.3" "kg" COEFFS 0 2812.5 0 0 0 256 /end COMPU_METHOD
/begin COMPU_METHOD m_uw_b23p3 "" RAT_FUNC "%6.5" "kg" COEFFS 0 2812.5 0 0 0 1 /end COMPU_METHOD
/begin COMPU_METHOD OneToOne "" RAT_FUNC "%6.2" "-" COEFFS 0 1 0 0 0 1 /end COMPU_METHOD
/begin COMPU_METHOD PEXHMNFPRS_SY_Compu "" TAB_VERB "%6.3" "" COMPU_TAB_REF PEXHMNFPRS_SY_Compu /end COMPU_METHOD
/begin COMPU_VTAB PEXHMNFPRS_SY_Compu "" TAB_VERB 2 0 "False" 1 "True" /end COMPU_VTAB
/begin COMPU_METHOD PFltPOpPrcPerSec_COMPU "" RAT_FUNC "%6.3" "%/s" COEFFS 0 10 0 0 0 1 /end COMPU_METHOD
/begin COMPU_METHOD PFLT_ACTV_SC_Compu "" TAB_VERB "%6.3" "" COMPU_TAB_REF PFLT_ACTV_SC_Compu /end COMPU_METHOD
/begin COMPU_VTAB PFLT_ACTV_SC_Compu "" TAB_VERB 2 0 "False" 1 "True" /end COMPU_VTAB
/begin COMPU_METHOD PFLT_BANKCFG_SC_Compu "" TAB_VERB "%6.3" "" COMPU_TAB_REF PFLT_BANKCFG_SC_Compu /end COMPU_METHOD
/begin COMPU_VTAB PFLT_BANKCFG_SC_Compu "" TAB_VERB 3 0 "ONE_BANK" 1 "Y_CONFIGURATION" 2 "TWO_BANKS" /end COMPU_VTAB
/begin COMPU_METHOD PFLT_INHOUSE_SC_Compu "" TAB_VERB "%6.3" "" COMPU_TAB_REF PFLT_INHOUSE_SC_Compu /end COMPU_METHOD
/begin COMPU_VTAB PFLT_INHOUSE_SC_Compu "" TAB_VERB 2 0 "False" 1 "True" /end COMPU_VTAB
/begin COMPU_METHOD PFUTANKLI_SC_Compu "" TAB_VERB "%6.3" "" COMPU_TAB_REF PFUTANKLI_SC_Compu /end COMPU_METHOD
/begin COMPU_VTAB PFUTANKLI_SC_Compu "" TAB_VERB 2 0 "False" 1 "True" /end COMPU_VTAB
/begin COMPU_METHOD PHYCYLCNTR_SC_Compu "" TAB_VERB "%6.3" "" COMPU_TAB_REF PHYCYLCNTR_SC_Compu /end COMPU_METHOD
/begin COMPU_VTAB PHYCYLCNTR_SC_Compu "" TAB_VERB 2 0 "False" 1 "True" /end COMPU_VTAB
/begin COMPU_METHOD PHYMOD_CLNTENTRY_SY_Compu "" TAB_VERB "%6.3" "" COMPU_TAB_REF PHYMOD_CLNTENTRY_SY_Compu /end COMPU_METHOD
/begin COMPU_VTAB PHYMOD_CLNTENTRY_SY_Compu "" TAB_VERB 3 0 "0" 1 "1" 2 "2" /end COMPU_VTAB
/begin COMPU_METHOD PIDA6_SRCODOVAL_SC_Compu "" TAB_VERB "%6.3" "" COMPU_TAB_REF PIDA6_SRCODOVAL_SC_Compu /end COMPU_METHOD
/begin COMPU_VTAB PIDA6_SRCODOVAL_SC_Compu "" TAB_VERB 4 0 "NONE" 1 "Host_ECU" 2 "Head_unit_ECU" 3 "CAN_Sync_Host_ECU" /end COMPU_VTAB
/begin COMPU_METHOD PiIClb_InjMassS32 "" RAT_FUNC "%9.8" "mg/hub" COEFFS 0 6553600 0 0 0 1 /end COMPU_METHOD
/begin COMPU_METHOD PINTKVUSPRS_SC_Compu "" TAB_VERB "%6.3" "" COMPU_TAB_REF PINTKVUSPRS_SC_Compu /end COMPU_METHOD
/begin COMPU_VTAB PINTKVUSPRS_SC_Compu "" TAB_VERB 2 0 "False" 1 "True" /end COMPU_VTAB
/begin COMPU_METHOD PINTKVUS_COMERRSNVTY_SC_Compu "" TAB_VERB "%6.3" "" COMPU_TAB_REF PINTKVUS_COMERRSNVTY_SC_Compu /end COMPU_METHOD
/begin COMPU_VTAB PINTKVUS_COMERRSNVTY_SC_Compu "" TAB_VERB 2 0 "standard" 1 "reducedSensitivity" /end COMPU_VTAB
/begin COMPU_METHOD PINTKVUS_PHYSRNGCHK_SY_Compu "" TAB_VERB "%6.3" "" COMPU_TAB_REF PINTKVUS_PHYSRNGCHK_SY_Compu /end COMPU_METHOD
/begin COMPU_VTAB PINTKVUS_PHYSRNGCHK_SY_Compu "" TAB_VERB 2 0 "PHYSRNGCHK_DISBL" 1 "PHYSRNGCHK_ENA" /end COMPU_VTAB
/begin COMPU_METHOD PINTKVUS_SNSR1PRSNT_SC_Compu "" TAB_VERB "%6.3" "" COMPU_TAB_REF PINTKVUS_SNSR1PRSNT_SC_Compu /end COMPU_METHOD
/begin COMPU_VTAB PINTKVUS_SNSR1PRSNT_SC_Compu "" TAB_VERB 2 0 "False" 1 "True" /end COMPU_VTAB
/begin COMPU_METHOD PINTKVUS_SNSR1VCC_SC_Compu "" TAB_VERB "%6.3" "" COMPU_TAB_REF PINTKVUS_SNSR1VCC_SC_Compu /end COMPU_METHOD
/begin COMPU_VTAB PINTKVUS_SNSR1VCC_SC_Compu "" TAB_VERB 4 0 "none" 1 "SSpMon1" 2 "SSpMon2" 3 "SSpMon3" /end COMPU_VTAB
/begin COMPU_METHOD PINTKVUS_SNSR2PRSNT_SC_Compu "" TAB_VERB "%6.3" "" COMPU_TAB_REF PINTKVUS_SNSR2PRSNT_SC_Compu /end COMPU_METHOD
/begin COMPU_VTAB PINTKVUS_SNSR2PRSNT_SC_Compu "" TAB_VERB 2 0 "False" 1 "True" /end COMPU_VTAB
/begin COMPU_METHOD PINTKVUS_SNSR2VCC_SC_Compu "" TAB_VERB "%6.3" "" COMPU_TAB_REF PINTKVUS_SNSR2VCC_SC_Compu /end COMPU_METHOD
/begin COMPU_VTAB PINTKVUS_SNSR2VCC_SC_Compu "" TAB_VERB 4 0 "none" 1 "SSpMon1" 2 "SSpMon2" 3 "SSpMon3" /end COMPU_VTAB
/begin COMPU_METHOD PINTKVUS_SNSRHWIF_SC_Compu "" TAB_VERB "%6.3" "" COMPU_TAB_REF PINTKVUS_SNSRHWIF_SC_Compu /end COMPU_METHOD
/begin COMPU_VTAB PINTKVUS_SNSRHWIF_SC_Compu "" TAB_VERB 4 0 "NO_Sensor" 1 "Analogous_Sensor" 2 "Digital_Sensor" 3 "Both_Sensor" /end COMPU_VTAB
/begin COMPU_METHOD PINTKVUS_SNSRWOULIMN_SC_Compu "" TAB_VERB "%6.3" "" COMPU_TAB_REF PINTKVUS_SNSRWOULIMN_SC_Compu /end COMPU_METHOD
/begin COMPU_VTAB PINTKVUS_SNSRWOULIMN_SC_Compu "" TAB_VERB 2 0 "False" 1 "True" /end COMPU_VTAB
/begin COMPU_METHOD PINTKVUS_TYPAVL_SY_Compu "" TAB_VERB "%6.3" "" COMPU_TAB_REF PINTKVUS_TYPAVL_SY_Compu /end COMPU_METHOD
/begin COMPU_VTAB PINTKVUS_TYPAVL_SY_Compu "" TAB_VERB 2 0 "False" 1 "True" /end COMPU_VTAB
/begin COMPU_METHOD PINTKVUS_UPDRATE_SC_Compu "" TAB_VERB "%6.3" "" COMPU_TAB_REF PINTKVUS_UPDRATE_SC_Compu /end COMPU_METHOD
/begin COMPU_VTAB PINTKVUS_UPDRATE_SC_Compu "" TAB_VERB 3 0 "Fullsegment" 1 "Halfsegment" 2 "Quartersegment" /end COMPU_VTAB
/begin COMPU_METHOD PINTVUS_SY_Compu "" TAB_VERB "%6.3" "" COMPU_TAB_REF PINTVUS_SY_Compu /end COMPU_METHOD
/begin COMPU_VTAB PINTVUS_SY_Compu "" TAB_VERB 2 0 "AirMod provides neutral value for PIntkVUs" 1 "AirDvP provides neutral value for PIntkVUs" /end COMPU_VTAB
/begin COMPU_METHOD PISTCOOLGVLVPRSNT_SC_Compu "" TAB_VERB "%6.3" "" COMPU_TAB_REF PISTCOOLGVLVPRSNT_SC_Compu /end COMPU_METHOD
/begin COMPU_VTAB PISTCOOLGVLVPRSNT_SC_Compu "" TAB_VERB 2 0 "not_present" 1 "present" /end COMPU_VTAB
/begin COMPU_METHOD PMaxCtlKi "" RAT_FUNC "%6.4" "deg CrS/(bar*s)" COEFFS 0 763.549741510925 0 0 0 1 /end COMPU_METHOD
/begin COMPU_METHOD PMaxCtlKp "" RAT_FUNC "%7.6" "deg CrS/bar" COEFFS 0 11650.8444444416 0 0 0 1 /end COMPU_METHOD
/begin COMPU_METHOD PMaxCtlKp_8 "" RAT_FUNC "%6.5" "deg CrS/bar" COEFFS 0 1456.3555555552 0 0 0 1 /end COMPU_METHOD
/begin COMPU_METHOD PMM_SWTCOORNPERPH_SC_Compu "" TAB_VERB "%6.3" "" COMPU_TAB_REF PMM_SWTCOORNPERPH_SC_Compu /end COMPU_METHOD
/begin COMPU_VTAB PMM_SWTCOORNPERPH_SC_Compu "" TAB_VERB 2 0 "False" 1 "True" /end COMPU_VTAB
/begin COMPU_METHOD PmpQnt "" RAT_FUNC "%6.3" "mm^3/rev" COEFFS 0 10 0 0 0 1 /end COMPU_METHOD
/begin COMPU_METHOD POFFSADPN_SC_Compu "" TAB_VERB "%6.3" "" COMPU_TAB_REF POFFSADPN_SC_Compu /end COMPU_METHOD
/begin COMPU_VTAB POFFSADPN_SC_Compu "" TAB_VERB 2 0 "False" 1 "True" /end COMPU_VTAB
/begin COMPU_METHOD POILVT_TYPAVL_SC_Compu "" TAB_VERB "%6.3" "" COMPU_TAB_REF POILVT_TYPAVL_SC_Compu /end COMPU_METHOD
/begin COMPU_VTAB POILVT_TYPAVL_SC_Compu "" TAB_VERB 2 0 "False" 1 "True" /end COMPU_VTAB
/begin COMPU_METHOD PosMCAirKi "" RAT_FUNC "%6.4" "(mg/str)/(%*s)" COEFFS 0 214.7483648 0 0 0 1 /end COMPU_METHOD
/begin COMPU_METHOD PosMCAirKp "" RAT_FUNC "%6.5" "(mg/str)/%" COEFFS 0 3276.8 0 0 0 1 /end COMPU_METHOD
/begin COMPU_METHOD PosMCAir_AMPC2Rat "" RAT_FUNC "%6.4" "1/mg/str" COEFFS 0 128 0 0 0 1 /end COMPU_METHOD
/begin COMPU_METHOD PosMCKd "" RAT_FUNC "%8.7" "%/AgCA" COEFFS 0 144000.000000035 0 0 0 1 /end COMPU_METHOD
/begin COMPU_METHOD PosMCKd_4 "" RAT_FUNC "%7.6" "%/AgCA" COEFFS 0 36000.0000000088 0 0 0 1 /end COMPU_METHOD
/begin COMPU_METHOD PosMCKi "" RAT_FUNC "%6.5" "%/(AgCA*s)" COEFFS 0 4718.59200000115 0 0 0 1 /end COMPU_METHOD
/begin COMPU_METHOD PosMCKi_2 "" RAT_FUNC "%6.5" "%/(AgCA*s)" COEFFS 0 2359.29600000058 0 0 0 1 /end COMPU_METHOD
/begin COMPU_METHOD PosMCKp "" RAT_FUNC "%7.6" "%/AgCA" COEFFS 0 72000.0000000176 0 0 0 1 /end COMPU_METHOD
/begin COMPU_METHOD PosMCKp_32 "" RAT_FUNC "%6.5" "%/AgCA" COEFFS 0 2250.00000000055 0 0 0 1 /end COMPU_METHOD
/begin COMPU_METHOD POSTDRV_SOFTRST_SY_Compu "" TAB_VERB "%6.3" "" COMPU_TAB_REF POSTDRV_SOFTRST_SY_Compu /end COMPU_METHOD
/begin COMPU_VTAB POSTDRV_SOFTRST_SY_Compu "" TAB_VERB 2 0 "false" 1 "true" /end COMPU_VTAB
/begin COMPU_METHOD POUTLVLVDSSNSRTYP_SC_Compu "" TAB_VERB "%6.3" "" COMPU_TAB_REF POUTLVLVDSSNSRTYP_SC_Compu /end COMPU_METHOD
/begin COMPU_VTAB POUTLVLVDSSNSRTYP_SC_Compu "" TAB_VERB 4 0 "P_SNSRABSNT" 1 "P_ABSLTSNSR" 2 "P_DFTLSNSR" 3 "P_ABSLTDFTLSNSR" /end COMPU_VTAB
/begin COMPU_METHOD POUTLVLVDS_ACTVTOFFSADPN_SC_Compu "" TAB_VERB "%6.3" "" COMPU_TAB_REF POUTLVLVDS_ACTVTOFFSADPN_SC_Compu /end COMPU_METHOD
/begin COMPU_VTAB POUTLVLVDS_ACTVTOFFSADPN_SC_Compu "" TAB_VERB 2 0 "DISABLED" 1 "ACTIVE" /end COMPU_VTAB
/begin COMPU_METHOD PPFILDIFSNSR_SC_Compu "" TAB_VERB "%6.3" "" COMPU_TAB_REF PPFILDIFSNSR_SC_Compu /end COMPU_METHOD
/begin COMPU_VTAB PPFILDIFSNSR_SC_Compu "" TAB_VERB 2 0 "False" 1 "True" /end COMPU_VTAB
/begin COMPU_METHOD PPFLTDIFFASICT_TYPAVL_SC_Compu "" TAB_VERB "%6.3" "" COMPU_TAB_REF PPFLTDIFFASICT_TYPAVL_SC_Compu /end COMPU_METHOD
/begin COMPU_VTAB PPFLTDIFFASICT_TYPAVL_SC_Compu "" TAB_VERB 2 0 "False" 1 "True" /end COMPU_VTAB
/begin COMPU_METHOD PPFLTDIFFCH1_TYPAVL_SC_Compu "" TAB_VERB "%6.3" "" COMPU_TAB_REF PPFLTDIFFCH1_TYPAVL_SC_Compu /end COMPU_METHOD
/begin COMPU_VTAB PPFLTDIFFCH1_TYPAVL_SC_Compu "" TAB_VERB 2 0 "False" 1 "True" /end COMPU_VTAB
/begin COMPU_METHOD PPFLTDIFFCH2_TYPAVL_SC_Compu "" TAB_VERB "%6.3" "" COMPU_TAB_REF PPFLTDIFFCH2_TYPAVL_SC_Compu /end COMPU_METHOD
/begin COMPU_VTAB PPFLTDIFFCH2_TYPAVL_SC_Compu "" TAB_VERB 2 0 "False" 1 "True" /end COMPU_VTAB
/begin COMPU_METHOD PPFLTDIFF_TYPAVL_SY_Compu "" TAB_VERB "%6.3" "" COMPU_TAB_REF PPFLTDIFF_TYPAVL_SY_Compu /end COMPU_METHOD
/begin COMPU_VTAB PPFLTDIFF_TYPAVL_SY_Compu "" TAB_VERB 2 0 "False" 1 "True" /end COMPU_VTAB
/begin COMPU_METHOD PPFLTDS_TYPAVL_SC_Compu "" TAB_VERB "%6.3" "" COMPU_TAB_REF PPFLTDS_TYPAVL_SC_Compu /end COMPU_METHOD
/begin COMPU_VTAB PPFLTDS_TYPAVL_SC_Compu "" TAB_VERB 2 0 "False" 1 "True" /end COMPU_VTAB
/begin COMPU_METHOD PPFLTUS_TYPAVL_SY_Compu "" TAB_VERB "%6.3" "" COMPU_TAB_REF PPFLTUS_TYPAVL_SY_Compu /end COMPU_METHOD
/begin COMPU_VTAB PPFLTUS_TYPAVL_SY_Compu "" TAB_VERB 2 0 "False" 1 "True" /end COMPU_VTAB
/begin COMPU_METHOD Prc2EffGrad "" RAT_FUNC "%7.6" "1/(%*s)" COEFFS 0 10000 0 0 0 1 /end COMPU_METHOD
/begin COMPU_METHOD PrcSlp "" RAT_FUNC "%6.4" "%/s" COEFFS 0 819.2 0 0 0 1 /end COMPU_METHOD
/begin COMPU_METHOD Prc_q0p1_COMPU "" RAT_FUNC "%6.3" "%" COEFFS 0 10 0 0 0 1 /end COMPU_METHOD
/begin COMPU_METHOD PRECRASHSFTYENA_SC_Compu "" TAB_VERB "%6.3" "" COMPU_TAB_REF PRECRASHSFTYENA_SC_Compu /end COMPU_METHOD
/begin COMPU_VTAB PRECRASHSFTYENA_SC_Compu "" TAB_VERB 2 0 "False" 1 "True" /end COMPU_VTAB
/begin COMPU_METHOD PreshPa_FnReso "" RAT_FUNC "%6.3" "hPa" COEFFS 0 10 0 0 0 1 /end COMPU_METHOD
/begin COMPU_METHOD PreshPa_HiRes "" RAT_FUNC "%6.4" "hPa" COEFFS 0 100 0 0 0 1 /end COMPU_METHOD
/begin COMPU_METHOD PresInv_hPa "" RAT_FUNC "%10.9" "1/hPa" COEFFS 0 10000000 0 0 0 1 /end COMPU_METHOD
/begin COMPU_METHOD PresRail_sec "" RAT_FUNC "%6.0" "hPa/s" COEFFS 0 0.0025 0 0 0 1 /end COMPU_METHOD
/begin COMPU_METHOD PresRail_Sec_HiRes_COMPU "" RAT_FUNC "%7.0" "hPa/s" COEFFS 0 0.000166666666666667 0 0 0 1 /end COMPU_METHOD
/begin COMPU_METHOD Pres_Rail "" RAT_FUNC "%6.0" "hPa" COEFFS 0 0.01 0 0 0 1 /end COMPU_METHOD
/begin COMPU_METHOD Pres_SI "" RAT_FUNC "%6.0" "Pa" COEFFS 0 0.01 0 0 0 1 /end COMPU_METHOD
/begin COMPU_METHOD PRODMODE_SY_Compu "" TAB_VERB "%6.3" "" COMPU_TAB_REF PRODMODE_SY_Compu /end COMPU_METHOD
/begin COMPU_VTAB PRODMODE_SY_Compu "" TAB_VERB 2 0 "False" 1 "True" /end COMPU_VTAB
/begin COMPU_METHOD PRTSHFTUPREQ_SY_Compu "" TAB_VERB "%6.3" "" COMPU_TAB_REF PRTSHFTUPREQ_SY_Compu /end COMPU_METHOD
/begin COMPU_VTAB PRTSHFTUPREQ_SY_Compu "" TAB_VERB 2 0 "False" 1 "True" /end COMPU_VTAB
/begin COMPU_METHOD PSC_Fact "" RAT_FUNC "%7.6" "-" COEFFS 0 32767 0 0 0 1 /end COMPU_METHOD
/begin COMPU_METHOD PSNSRCSTRPURGLINE_SC_Compu "" TAB_VERB "%6.3" "" COMPU_TAB_REF PSNSRCSTRPURGLINE_SC_Compu /end COMPU_METHOD
/begin COMPU_VTAB PSNSRCSTRPURGLINE_SC_Compu "" TAB_VERB 3 0 "No Pressure Sensor" 1 "Pressure Sensor after CPV" 2 "PSNSR_BEFORE_CPV" /end COMPU_VTAB
/begin COMPU_METHOD PSP_ATSINTVMOD_SY_Compu "" TAB_VERB "%6.3" "" COMPU_TAB_REF PSP_ATSINTVMOD_SY_Compu /end COMPU_METHOD
/begin COMPU_VTAB PSP_ATSINTVMOD_SY_Compu "" TAB_VERB 2 0 "False" 1 "True" /end COMPU_VTAB
/begin COMPU_METHOD PSP_SWTDIGORPWM_SY_Compu "" TAB_VERB "%6.3" "" COMPU_TAB_REF PSP_SWTDIGORPWM_SY_Compu /end COMPU_METHOD
/begin COMPU_VTAB PSP_SWTDIGORPWM_SY_Compu "" TAB_VERB 3 0 "PSP_DIGOUTPUT" 1 "PSP_PWMOUTPUT" 2 "PSP_DIGANDPWM" /end COMPU_VTAB
/begin COMPU_METHOD PSP_SWTMOCSOP_SY_Compu "" TAB_VERB "%6.3" "" COMPU_TAB_REF PSP_SWTMOCSOP_SY_Compu /end COMPU_METHOD
/begin COMPU_VTAB PSP_SWTMOCSOP_SY_Compu "" TAB_VERB 2 0 "NO_PSP_MOCSOP" 1 "PSP_MOCSOP" /end COMPU_VTAB
/begin COMPU_METHOD PSSC003D17162_SC_Compu "" TAB_VERB "%6.3" "" COMPU_TAB_REF PSSC003D17162_SC_Compu /end COMPU_METHOD
/begin COMPU_VTAB PSSC003D17162_SC_Compu "" TAB_VERB 10 0 "None" 1 "D17162_W12_TSI" 3 "D17162_VR6_TSI_MQB" 4 "D17162_VR6_FSI_MQB" 5 "D17162_VR6_FSI_MQB_RUS" 6 "D17162_W12_TSI_PL65" 7 "D17162_W12_TSI_MSB" 8 "D17162_W12_TSI_D4" 19 "D17162_VR6_TSI_C6" 20 "D17162_VR6_TSI_B6C_RDE" /end COMPU_VTAB
/begin COMPU_METHOD PSSC147GSHEV_SC_Compu "" TAB_VERB "%6.3" "" COMPU_TAB_REF PSSC147GSHEV_SC_Compu /end COMPU_METHOD
/begin COMPU_VTAB PSSC147GSHEV_SC_Compu "" TAB_VERB 2 0 "HEV_Disabled" 1 "HEV_Enabled" /end COMPU_VTAB
/begin COMPU_METHOD PSSC159MED1793TGDIVRNT_SC_Compu "" TAB_VERB "%6.3" "" COMPU_TAB_REF PSSC159MED1793TGDIVRNT_SC_Compu /end COMPU_METHOD
/begin COMPU_VTAB PSSC159MED1793TGDIVRNT_SC_Compu "" TAB_VERB 5 1 "2KR" 2 "2LX" 3 "2SV" 4 "EVA" 5 "CRIDER" /end COMPU_VTAB
/begin COMPU_METHOD PSSC159MED1793_SY_Compu "" TAB_VERB "%6.3" "" COMPU_TAB_REF PSSC159MED1793_SY_Compu /end COMPU_METHOD
/begin COMPU_VTAB PSSC159MED1793_SY_Compu "" TAB_VERB 3 1 "EVA (3-Cyl)" 2 "2LX (4-Cyl)" 3 "2SV (4-Cyl)" /end COMPU_VTAB
/begin COMPU_METHOD PS_NUMSENS_SY_Compu "" RAT_FUNC "%6.2" "" COEFFS 0 1 0 0 0 1 /end COMPU_METHOD
/begin COMPU_METHOD PTACTVN_SC_Compu "" TAB_VERB "%6.3" "" COMPU_TAB_REF PTACTVN_SC_Compu /end COMPU_METHOD
/begin COMPU_VTAB PTACTVN_SC_Compu "" TAB_VERB 2 0 "False" 1 "True" /end COMPU_VTAB
/begin COMPU_METHOD PTHRVLVDS_PDRPMDL_SC_Compu "" TAB_VERB "%6.3" "" COMPU_TAB_REF PTHRVLVDS_PDRPMDL_SC_Compu /end COMPU_METHOD
/begin COMPU_VTAB PTHRVLVDS_PDRPMDL_SC_Compu "" TAB_VERB 3 0 "NO_MDL" 1 "CNG_MDL" 2 "CAC_MDL" /end COMPU_VTAB
/begin COMPU_METHOD PTHRVLVDS_SNSR1PRSNT_SC_Compu "" TAB_VERB "%6.3" "" COMPU_TAB_REF PTHRVLVDS_SNSR1PRSNT_SC_Compu /end COMPU_METHOD
/begin COMPU_VTAB PTHRVLVDS_SNSR1PRSNT_SC_Compu "" TAB_VERB 2 0 "False" 1 "True" /end COMPU_VTAB
/begin COMPU_METHOD PTHRVLVDS_TYPAVL_SC_Compu "" TAB_VERB "%6.3" "" COMPU_TAB_REF PTHRVLVDS_TYPAVL_SC_Compu /end COMPU_METHOD
/begin COMPU_VTAB PTHRVLVDS_TYPAVL_SC_Compu "" TAB_VERB 2 0 "False" 1 "True" /end COMPU_VTAB
/begin COMPU_METHOD PTHRVLVUSPRS_SC_Compu "" TAB_VERB "%6.3" "" COMPU_TAB_REF PTHRVLVUSPRS_SC_Compu /end COMPU_METHOD
/begin COMPU_VTAB PTHRVLVUSPRS_SC_Compu "" TAB_VERB 2 0 "False" 1 "True" /end COMPU_VTAB
/begin COMPU_METHOD PTHRVLVUS_PDRPMDL_SC_Compu "" TAB_VERB "%6.3" "" COMPU_TAB_REF PTHRVLVUS_PDRPMDL_SC_Compu /end COMPU_METHOD
/begin COMPU_VTAB PTHRVLVUS_PDRPMDL_SC_Compu "" TAB_VERB 3 0 "NO_MDL" 1 "ADDLCPT_MDL" 2 "DYNPCORRN_MDL" /end COMPU_VTAB
/begin COMPU_METHOD PTHRVLVUS_SNSR1PRSNT_SC_Compu "" TAB_VERB "%6.3" "" COMPU_TAB_REF PTHRVLVUS_SNSR1PRSNT_SC_Compu /end COMPU_METHOD
/begin COMPU_VTAB PTHRVLVUS_SNSR1PRSNT_SC_Compu "" TAB_VERB 2 0 "False" 1 "True" /end COMPU_VTAB
/begin COMPU_METHOD PTHRVLVUS_SNSR2PRSNT_SC_Compu "" TAB_VERB "%6.3" "" COMPU_TAB_REF PTHRVLVUS_SNSR2PRSNT_SC_Compu /end COMPU_METHOD
/begin COMPU_VTAB PTHRVLVUS_SNSR2PRSNT_SC_Compu "" TAB_VERB 2 0 "False" 1 "True" /end COMPU_VTAB
/begin COMPU_METHOD PTLHC_SY_Compu "" TAB_VERB "%6.3" "" COMPU_TAB_REF PTLHC_SY_Compu /end COMPU_METHOD
/begin COMPU_VTAB PTLHC_SY_Compu "" TAB_VERB 2 0 "FALSE" 1 "TRUE" /end COMPU_VTAB
/begin COMPU_METHOD PTLLDOVHTNLIM_SC_Compu "" TAB_VERB "%6.3" "" COMPU_TAB_REF PTLLDOVHTNLIM_SC_Compu /end COMPU_METHOD
/begin COMPU_VTAB PTLLDOVHTNLIM_SC_Compu "" TAB_VERB 2 0 "False" 1 "True" /end COMPU_VTAB
/begin COMPU_METHOD PTO_SY_Compu "" TAB_VERB "%6.3" "" COMPU_TAB_REF PTO_SY_Compu /end COMPU_METHOD
/begin COMPU_VTAB PTO_SY_Compu "" TAB_VERB 2 0 "False" 1 "True" /end COMPU_VTAB
/begin COMPU_METHOD PTRBNABSLTUS_TYPAVL_SC_Compu "" TAB_VERB "%6.3" "" COMPU_TAB_REF PTRBNABSLTUS_TYPAVL_SC_Compu /end COMPU_METHOD
/begin COMPU_VTAB PTRBNABSLTUS_TYPAVL_SC_Compu "" TAB_VERB 2 0 "False" 1 "True" /end COMPU_VTAB
/begin COMPU_METHOD PTRBNDS_TYPAVL_SY_Compu "" TAB_VERB "%6.3" "" COMPU_TAB_REF PTRBNDS_TYPAVL_SY_Compu /end COMPU_METHOD
/begin COMPU_VTAB PTRBNDS_TYPAVL_SY_Compu "" TAB_VERB 2 0 "False" 1 "True" /end COMPU_VTAB
/begin COMPU_METHOD PTRBNUS_TYPAVL_SY_Compu "" TAB_VERB "%6.3" "" COMPU_TAB_REF PTRBNUS_TYPAVL_SY_Compu /end COMPU_METHOD
/begin COMPU_VTAB PTRBNUS_TYPAVL_SY_Compu "" TAB_VERB 2 0 "False" 1 "True" /end COMPU_VTAB
/begin COMPU_METHOD PT_SWGRIP_SY_Compu "" TAB_VERB "%6.3" "" COMPU_TAB_REF PT_SWGRIP_SY_Compu /end COMPU_METHOD
/begin COMPU_VTAB PT_SWGRIP_SY_Compu "" TAB_VERB 2 0 "0" 1 "1" /end COMPU_VTAB
/begin COMPU_METHOD PURGLINEISOVLV_SC_Compu "" TAB_VERB "%6.3" "" COMPU_TAB_REF PURGLINEISOVLV_SC_Compu /end COMPU_METHOD
/begin COMPU_VTAB PURGLINEISOVLV_SC_Compu "" TAB_VERB 2 0 "False" 1 "True" /end COMPU_VTAB
/begin COMPU_METHOD Pwr "" RAT_FUNC "%6.2" "W" COEFFS 0 0.10610329539459 0 0 0 1 /end COMPU_METHOD
/begin COMPU_METHOD Pwr2Temp_q0p001 "" RAT_FUNC "%6.4" "W/K" COEFFS 0 100 0 0 0 1 /end COMPU_METHOD
/begin COMPU_METHOD Pwr2Temp_q0p1 "" RAT_FUNC "%6.3" "W/K" COEFFS 0 10 0 0 0 1 /end COMPU_METHOD
/begin COMPU_METHOD PWRINTENGNLIM_SY_Compu "" TAB_VERB "%6.3" "" COMPU_TAB_REF PWRINTENGNLIM_SY_Compu /end COMPU_METHOD
/begin COMPU_VTAB PWRINTENGNLIM_SY_Compu "" TAB_VERB 2 0 "False" 1 "True" /end COMPU_VTAB
/begin COMPU_METHOD PwrSq2TempSq_q0p01 "" RAT_FUNC "%6.4" "W^2/K^2" COEFFS 0 100 0 0 0 1 /end COMPU_METHOD
/begin COMPU_METHOD PWRTRN_BELTSTRTRGENRAVL_SC_Compu "" TAB_VERB "%6.3" "" COMPU_TAB_REF PWRTRN_BELTSTRTRGENRAVL_SC_Compu /end COMPU_METHOD
/begin COMPU_VTAB PWRTRN_BELTSTRTRGENRAVL_SC_Compu "" TAB_VERB 2 0 "Disabled" 1 "Enabled" /end COMPU_VTAB
/begin COMPU_METHOD PWRTRN_ENAINDCCOGBXINTV_SC_Compu "" TAB_VERB "%6.3" "" COMPU_TAB_REF PWRTRN_ENAINDCCOGBXINTV_SC_Compu /end COMPU_METHOD
/begin COMPU_VTAB PWRTRN_ENAINDCCOGBXINTV_SC_Compu "" TAB_VERB 2 0 "False" 1 "True" /end COMPU_VTAB
/begin COMPU_METHOD Pwr_q1 "" RAT_FUNC "%6.2" "W" COEFFS 0 1 0 0 0 1 /end COMPU_METHOD
/begin COMPU_METHOD Pwr_W_q4p0_COMPU "" RAT_FUNC "%6.2" "W" COEFFS 0 1 0 0 0 4 /end COMPU_METHOD
/begin COMPU_METHOD P_hPa_q0p078125_COMPU "" RAT_FUNC "%6.4" "hPa" COEFFS 0 12.8 0 0 0 1 /end COMPU_METHOD
/begin COMPU_METHOD QCKSTRTSPCVERS_SC_Compu "" TAB_VERB "%6.3" "" COMPU_TAB_REF QCKSTRTSPCVERS_SC_Compu /end COMPU_METHOD
/begin COMPU_VTAB QCKSTRTSPCVERS_SC_Compu "" TAB_VERB 5 0 "SHTRP_ACTV" 1 "QUICKSTART_INITIAL" 2 "QUICKSTART_FULL" 3 "LH_31_V100_STEP1" 4 "LH_31_V100_FULL" /end COMPU_VTAB
/begin COMPU_METHOD QntR "" RAT_FUNC "%6.5" "-" COEFFS 0 1024 0 0 0 1 /end COMPU_METHOD
/begin COMPU_METHOD QNTSTMOT_SY_Compu "" TAB_VERB "%6.3" "" COMPU_TAB_REF QNTSTMOT_SY_Compu /end COMPU_METHOD
/begin COMPU_VTAB QNTSTMOT_SY_Compu "" TAB_VERB 2 0 "QNTSTMOT_SY == 0" 1 "QNTSTMOT_SY == 1" /end COMPU_VTAB
/begin COMPU_METHOD Qp_mm3_sec "" RAT_FUNC "%6.1" "mm3/s" COEFFS 0 0.1 0 0 0 1 /end COMPU_METHOD
/begin COMPU_METHOD QUICKSHIFT_SC_Compu "" TAB_VERB "%6.3" "" COMPU_TAB_REF QUICKSHIFT_SC_Compu /end COMPU_METHOD
/begin COMPU_VTAB QUICKSHIFT_SC_Compu "" TAB_VERB 2 0 "False" 1 "True" /end COMPU_VTAB
/begin COMPU_METHOD RADSHT_NRACTR_SC_Compu "" RAT_FUNC "%6.2" "" COEFFS 0 1 0 0 0 1 /end COMPU_METHOD
/begin COMPU_METHOD RADSHT_SY_Compu "" TAB_VERB "%6.3" "" COMPU_TAB_REF RADSHT_SY_Compu /end COMPU_METHOD
/begin COMPU_VTAB RADSHT_SY_Compu "" TAB_VERB 3 0 "OFF" 1 "HW" 2 "LIN" /end COMPU_VTAB
/begin COMPU_METHOD RailHrsEngOn "" RAT_FUNC "%6.0" "h" COEFFS 0 0.01 0 0 0 1 /end COMPU_METHOD
/begin COMPU_METHOD RatAirMass "" RAT_FUNC "%6.4" "-" COEFFS 0 100 0 0 0 1 /end COMPU_METHOD
/begin COMPU_METHOD RatAirMassHigh "" RAT_FUNC "%6.5" "-" COEFFS 0 1000 0 0 0 1 /end COMPU_METHOD
/begin COMPU_METHOD RatAirMassPerTime_COMPU "" RAT_FUNC "%6.3" "1/s" COEFFS 0 10 0 0 0 1 /end COMPU_METHOD
/begin COMPU_METHOD RatAirPres_COMPU "" RAT_FUNC "%6.5" "-" COEFFS 0 1000 0 0 0 1 /end COMPU_METHOD
/begin COMPU_METHOD RatAshMass "" RAT_FUNC "%8.7" "-" COEFFS 0 100000 0 0 0 1 /end COMPU_METHOD
/begin COMPU_METHOD RBPtCel_fac_6p10352em5_1 "" RAT_FUNC "%7.6" "-" COEFFS 0 65536 0 0 0 4 /end COMPU_METHOD
/begin COMPU_METHOD RBPtCel_u_1p60514em4_1 "" RAT_FUNC "%6.5" "V" COEFFS 0 6230 0 0 0 1 /end COMPU_METHOD
/begin COMPU_METHOD rel_q0p0234 "" RAT_FUNC "%6.4" "%" COEFFS 0 128 0 0 0 3 /end COMPU_METHOD
/begin COMPU_METHOD rel_q0p39 "" RAT_FUNC "%6.3" "%" COEFFS 0 256 0 0 0 100 /end COMPU_METHOD
/begin COMPU_METHOD rel_ub_b127p5 "" RAT_FUNC "%6.3" "%" COEFFS 0 2 0 0 0 1 /end COMPU_METHOD
/begin COMPU_METHOD rel_uw_b100 "" RAT_FUNC "%6.4" "%" COEFFS 0 65536 0 0 0 100 /end COMPU_METHOD
/begin COMPU_METHOD rel_uw_q0p0234 "" RAT_FUNC "%6.4" "%" COEFFS 0 32 0 0 0 0.75 /end COMPU_METHOD
/begin COMPU_METHOD SigQly_COMPU_VERB "" TAB_VERB "%6.3" "" COMPU_TAB_REF SigQly_COMPU_VERB /end COMPU_METHOD
/begin COMPU_VTAB SigQly_COMPU_VERB "" TAB_VERB 16 0 "SIGQLY_NOTCALC" 1 "SIGQLY_INIT" 2 "SIGQLY_OK" 3 "SIGQLY_MODEL" 4 "SIGQLY_REPLACEMENT" 5 "SIGQLY_FROZEN" 6 "SIGQLY_INVALID" 7 "SIGQLY_RESERVED_7" 8 "SIGQLY_RESERVED_8" 9 "SIGQLY_RESERVED_9" 10 "SIGQLY_RESERVED_10" 11 "SIGQLY_RESERVED_11" 12 "SIGQLY_RESERVED_12" 13 "SIGQLY_RESERVED_13" 14 "SIGQLY_RESERVED_14" 15 "SIGQLY_RESERVED_15" /end COMPU_VTAB
/begin COMPU_METHOD spg_q7p629Em7_V_ms "" RAT_FUNC "%9.8" "V*ms" COEFFS 0 65536 0 0 0 0.05 /end COMPU_METHOD
/begin COMPU_METHOD t100msxs_uw_b6553p5 "" RAT_FUNC "%6.3" "s" COEFFS 0 1 0 0 0 0.1 /end COMPU_METHOD
/begin COMPU_METHOD Temp_Cels "" RAT_FUNC "%6.1" "deg C" COEFFS 0 10 2731.4 0 0 1 /end COMPU_METHOD
/begin COMPU_METHOD temp_q0p0234_o273 "" RAT_FUNC "%6.1" "Grad C" COEFFS 0 1 273.15 0 0 0.0234375 /end COMPU_METHOD
/begin COMPU_METHOD temp_q0p1_K "" RAT_FUNC "%6.3" "K" COEFFS 0 10 0 0 0 1 /end COMPU_METHOD
/begin COMPU_METHOD temp_ub_q0p75_o48 "" RAT_FUNC "%6.2" "Grad C" COEFFS 0 1 48 0 0 0.75 /end COMPU_METHOD
/begin COMPU_METHOD temp_ub_q1_o40 "" RAT_FUNC "%6.2" "Grad C" COEFFS 0 1 40 0 0 1 /end COMPU_METHOD
/begin COMPU_METHOD t_q0p001_ms "" RAT_FUNC "%6.5" "ms" COEFFS 0 1 0 0 0 0.001 /end COMPU_METHOD
/begin COMPU_METHOD t_q0p1 "" RAT_FUNC "%6.3" "s" COEFFS 0 10 0 0 0 1 /end COMPU_METHOD
/begin COMPU_METHOD t_q1 "" RAT_FUNC "%6.2" "s" COEFFS 0 1 0 0 0 1 /end COMPU_METHOD
/begin COMPU_METHOD t_us_q1 "" RAT_FUNC "%6.2" "us" COEFFS 0 1 0 0 0 1 /end COMPU_METHOD
/begin COMPU_METHOD Vel "" RAT_FUNC "%6.4" "km/h" COEFFS 0 100 0 0 0 1 /end COMPU_METHOD
/begin COMPU_METHOD Volt "" RAT_FUNC "%6.3" "mV" COEFFS 0 5 0 0 0 1 /end COMPU_METHOD
/begin COMPU_METHOD Volt_Batt "" RAT_FUNC "%6.1" "mV" COEFFS 0 0.05 0 0 0 1 /end COMPU_METHOD
/begin COMPU_METHOD zk100msxs_ub_b25p5 "" RAT_FUNC "%6.3" "s" COEFFS 0 0 256 0 10 0 /end COMPU_METHOD
/begin COMPU_METHOD zk100msxs_uw_b6553p6 "" RAT_FUNC "%6.1" "s" COEFFS 0 0 65536 0 10 0 /end COMPU_METHOD
/begin COMPU_METHOD zw_q0p1 "" RAT_FUNC "%6.3" "Grad KW" COEFFS 0 10 0 0 0 1 /end COMPU_METHOD
/begin COMPU_METHOD zw_sb_q0p75 "" RAT_FUNC "%6.3" "Grad KW" COEFFS 0 255 0 0 0 191.25 /end COMPU_METHOD
/begin RECORD_LAYOUT Cur_Xu8Wu8 NO_AXIS_PTS_X 1 UBYTE AXIS_PTS_X 2 UBYTE INDEX_INCR DIRECT FNC_VALUES 3 UBYTE COLUMN_DIR DIRECT /end RECORD_LAYOUT
/begin RECORD_LAYOUT KwUb FNC_VALUES 1 UBYTE COLUMN_DIR DIRECT /end RECORD_LAYOUT
/begin RECORD_LAYOUT RB_Axis_S16 NO_AXIS_PTS_X 1 SWORD AXIS_PTS_X 2 SWORD INDEX_INCR DIRECT /end RECORD_LAYOUT
/begin RECORD_LAYOUT RB_Axis_U16 NO_AXIS_PTS_X 1 UWORD AXIS_PTS_X 2 UWORD INDEX_INCR DIRECT /end RECORD_LAYOUT
/begin RECORD_LAYOUT RB_CurveGroup_S8 FNC_VALUES 1 SBYTE COLUMN_DIR DIRECT /end RECORD_LAYOUT
/begin RECORD_LAYOUT RB_Curve_S16_S16 NO_AXIS_PTS_X 1 SWORD AXIS_PTS_X 2 SWORD INDEX_INCR DIRECT FNC_VALUES 3 SWORD COLUMN_DIR DIRECT /end RECORD_LAYOUT
/begin RECORD_LAYOUT RB_Curve_S16_U16_Static NO_AXIS_PTS_X 1 SWORD AXIS_PTS_X 2 SWORD INDEX_INCR DIRECT FNC_VALUES 3 UWORD COLUMN_DIR DIRECT STATIC_RECORD_LAYOUT /end RECORD_LAYOUT
/begin RECORD_LAYOUT RB_Curve_S16_U8_Static NO_AXIS_PTS_X 1 SWORD AXIS_PTS_X 2 SWORD INDEX_INCR DIRECT FNC_VALUES 3 UBYTE COLUMN_DIR DIRECT STATIC_RECORD_LAYOUT /end RECORD_LAYOUT
/begin RECORD_LAYOUT RB_Curve_U16_S16_Static NO_AXIS_PTS_X 1 UWORD AXIS_PTS_X 2 UWORD INDEX_INCR DIRECT FNC_VALUES 3 SWORD COLUMN_DIR DIRECT STATIC_RECORD_LAYOUT /end RECORD_LAYOUT
/begin RECORD_LAYOUT RB_Curve_U16_S8_Static NO_AXIS_PTS_X 1 UWORD AXIS_PTS_X 2 UWORD INDEX_INCR DIRECT FNC_VALUES 3 SBYTE COLUMN_DIR DIRECT STATIC_RECORD_LAYOUT /end RECORD_LAYOUT
/begin RECORD_LAYOUT RB_Curve_U16_U16 NO_AXIS_PTS_X 1 UWORD AXIS_PTS_X 2 UWORD INDEX_INCR DIRECT FNC_VALUES 3 UWORD COLUMN_DIR DIRECT /end RECORD_LAYOUT
/begin RECORD_LAYOUT RB_Curve_U16_U8_Static NO_AXIS_PTS_X 1 UWORD AXIS_PTS_X 2 UWORD INDEX_INCR DIRECT FNC_VALUES 3 UBYTE COLUMN_DIR DIRECT STATIC_RECORD_LAYOUT /end RECORD_LAYOUT
/begin RECORD_LAYOUT RB_MapGroup_S8 FNC_VALUES 1 SBYTE COLUMN_DIR DIRECT /end RECORD_LAYOUT
/begin RECORD_LAYOUT RB_MapGroup_U16 FNC_VALUES 1 UWORD COLUMN_DIR DIRECT /end RECORD_LAYOUT
/begin RECORD_LAYOUT RB_Map_S16U16_S16 NO_AXIS_PTS_X 1 SWORD NO_AXIS_PTS_Y 2 SWORD AXIS_PTS_X 3 SWORD INDEX_INCR DIRECT AXIS_PTS_Y 4 UWORD INDEX_INCR DIRECT FNC_VALUES 5 SWORD ROW_DIR DIRECT /end RECORD_LAYOUT
/begin RECORD_LAYOUT RB_Map_S16U16_U16 NO_AXIS_PTS_X 1 SWORD NO_AXIS_PTS_Y 2 SWORD AXIS_PTS_X 3 SWORD INDEX_INCR DIRECT AXIS_PTS_Y 4 UWORD INDEX_INCR DIRECT FNC_VALUES 5 UWORD ROW_DIR DIRECT /end RECORD_LAYOUT
/begin RECORD_LAYOUT RB_Map_S16U8_S8 NO_AXIS_PTS_X 1 SWORD NO_AXIS_PTS_Y 2 SWORD AXIS_PTS_X 3 SWORD INDEX_INCR DIRECT AXIS_PTS_Y 4 UBYTE INDEX_INCR DIRECT FNC_VALUES 5 SBYTE COLUMN_DIR DIRECT /end RECORD_LAYOUT
/begin RECORD_LAYOUT RB_ValA_Ws8 FNC_VALUES 1 SBYTE COLUMN_DIR DIRECT /end RECORD_LAYOUT
/begin RECORD_LAYOUT RB_ValA_Wu16 FNC_VALUES 1 UWORD COLUMN_DIR DIRECT /end RECORD_LAYOUT
/begin RECORD_LAYOUT RB_Val_Wboolean FNC_VALUES 1 UBYTE COLUMN_DIR DIRECT /end RECORD_LAYOUT
/begin RECORD_LAYOUT RB_Val_Ws16 FNC_VALUES 1 SWORD COLUMN_DIR DIRECT /end RECORD_LAYOUT
/begin RECORD_LAYOUT RB_Val_Ws8 FNC_VALUES 1 SBYTE COLUMN_DIR DIRECT /end RECORD_LAYOUT
/begin RECORD_LAYOUT RB_Val_Wu16 FNC_VALUES 1 UWORD COLUMN_DIR DIRECT /end RECORD_LAYOUT
/begin RECORD_LAYOUT RB_Val_Wu32 FNC_VALUES 1 ULONG COLUMN_DIR DIRECT /end RECORD_LAYOUT
/begin RECORD_LAYOUT RB_Val_Wu8 FNC_VALUES 1 UBYTE COLUMN_DIR DIRECT /end RECORD_LAYOUT
/begin RECORD_LAYOUT Val_Ws16 FNC_VALUES 1 SWORD COLUMN_DIR DIRECT /end RECORD_LAYOUT
/begin RECORD_LAYOUT Val_Wu32 FNC_VALUES 1 ULONG COLUMN_DIR DIRECT /end RECORD_LAYOUT
/begin RECORD_LAYOUT Val_Wu8 FNC_VALUES 1 UBYTE COLUMN_DIR DIRECT /end RECORD_LAYOUT
/end MODULE
/end PROJECT
