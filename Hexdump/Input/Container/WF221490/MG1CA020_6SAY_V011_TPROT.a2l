ASAP2_VERSION 1 60
/begin PROJECT MG1CA020 "MG1CA020"
/begin HEADER "" VERSION "MG1CA020_6SAY_V011_TPROT" PROJECT_NO MG1CA020 /end HEADER
/begin MODULE DIM ""
/begin MOD_COMMON "" BYTE_ORDER MSB_LAST ALIGNMENT_BYTE 1 ALIGNMENT_WORD 2 ALIGNMENT_LONG 4 ALIGNMENT_INT64 4 ALIGNMENT_FLOAT32_IEEE 4 ALIGNMENT_FLOAT64_IEEE 4 DATA_SIZE 32 /end MOD_COMMON
/begin CHARACTERISTIC Can_CanHwObject_AYCA_RXCanId_C "Calibration parameter for Can-Id of Message CanHwObject_AYCA_RX" VALUE 0x804D83CC DefaultValueRecordLayout_AUTOSAR_Platform_BaseTypes_uint32 2047.0 RB_RBA_Common_CentralElements_CompuMethods_Identical 0.0 2047. FORMAT "%5.0" /end CHARACTERISTIC
/begin CHARACTERISTIC Can_CanHwObject_AYCA_RXCanNod_C "Calibration parameter to calibrate Message CanHwObject_AYCA_RX on different Can Node." VALUE 0x804D85F2 DefaultValueRecordLayout_AUTOSAR_Platform_BaseTypes_uint8 2.0 Mcan_Can_CompuMethods_Can_CompuMethod_CtrlId 0.0 2. FORMAT "%5.0" /end CHARACTERISTIC
/begin CHARACTERISTIC Can_CanHwObject_AYCD_RXCanId_C "Calibration parameter for Can-Id of Message CanHwObject_AYCD_RX" VALUE 0x804D83C8 DefaultValueRecordLayout_AUTOSAR_Platform_BaseTypes_uint32 2047.0 RB_RBA_Common_CentralElements_CompuMethods_Identical 0.0 2047. FORMAT "%5.0" /end CHARACTERISTIC
/begin CHARACTERISTIC Can_CanHwObject_AYCD_RXCanNod_C "Calibration parameter to calibrate Message CanHwObject_AYCD_RX on different Can Node." VALUE 0x804D85F1 DefaultValueRecordLayout_AUTOSAR_Platform_BaseTypes_uint8 2.0 Mcan_Can_CompuMethods_Can_CompuMethod_CtrlId 0.0 2. FORMAT "%5.0" /end CHARACTERISTIC
/begin CHARACTERISTIC Can_CanHwObject_AYCF_RXCanId_C "Calibration parameter for Can-Id of Message CanHwObject_AYCF_RX" VALUE 0x804D83C4 DefaultValueRecordLayout_AUTOSAR_Platform_BaseTypes_uint32 2047.0 RB_RBA_Common_CentralElements_CompuMethods_Identical 0.0 2047. FORMAT "%5.0" /end CHARACTERISTIC
/begin CHARACTERISTIC Can_CanHwObject_AYCF_RXCanNod_C "Calibration parameter to calibrate Message CanHwObject_AYCF_RX on different Can Node." VALUE 0x804D85F0 DefaultValueRecordLayout_AUTOSAR_Platform_BaseTypes_uint8 2.0 Mcan_Can_CompuMethods_Can_CompuMethod_CtrlId 0.0 2. FORMAT "%5.0" /end CHARACTERISTIC
/begin CHARACTERISTIC Can_CanHwObject_AYCG_RXCanId_C "Calibration parameter for Can-Id of Message CanHwObject_AYCG_RX" VALUE 0x804D83C0 DefaultValueRecordLayout_AUTOSAR_Platform_BaseTypes_uint32 2047.0 RB_RBA_Common_CentralElements_CompuMethods_Identical 0.0 2047. FORMAT "%5.0" /end CHARACTERISTIC
/begin CHARACTERISTIC Can_CanHwObject_AYCG_RXCanNod_C "Calibration parameter to calibrate Message CanHwObject_AYCG_RX on different Can Node." VALUE 0x804D85EF DefaultValueRecordLayout_AUTOSAR_Platform_BaseTypes_uint8 2.0 Mcan_Can_CompuMethods_Can_CompuMethod_CtrlId 0.0 2. FORMAT "%5.0" /end CHARACTERISTIC
/begin CHARACTERISTIC Can_CanHwObject_AYCI_RXCanId_C "Calibration parameter for Can-Id of Message CanHwObject_AYCI_RX" VALUE 0x804D83BC DefaultValueRecordLayout_AUTOSAR_Platform_BaseTypes_uint32 2047.0 RB_RBA_Common_CentralElements_CompuMethods_Identical 0.0 2047. FORMAT "%5.0" /end CHARACTERISTIC
/begin CHARACTERISTIC Can_CanHwObject_AYCI_RXCanNod_C "Calibration parameter to calibrate Message CanHwObject_AYCI_RX on different Can Node." VALUE 0x804D85EE DefaultValueRecordLayout_AUTOSAR_Platform_BaseTypes_uint8 2.0 Mcan_Can_CompuMethods_Can_CompuMethod_CtrlId 0.0 2. FORMAT "%5.0" /end CHARACTERISTIC
/begin CHARACTERISTIC Can_CanHwObject_BCM1_RXCanId_C "Calibration parameter for Can-Id of Message CanHwObject_BCM1_RX" VALUE 0x804D83B8 DefaultValueRecordLayout_AUTOSAR_Platform_BaseTypes_uint32 2047.0 RB_RBA_Common_CentralElements_CompuMethods_Identical 0.0 2047. FORMAT "%5.0" /end CHARACTERISTIC
/begin CHARACTERISTIC Can_CanHwObject_BCM1_RXCanNod_C "Calibration parameter to calibrate Message CanHwObject_BCM1_RX on different Can Node." VALUE 0x804D85ED DefaultValueRecordLayout_AUTOSAR_Platform_BaseTypes_uint8 2.0 Mcan_Can_CompuMethods_Can_CompuMethod_CtrlId 0.0 2. FORMAT "%5.0" /end CHARACTERISTIC
/begin CHARACTERISTIC Can_CanHwObject_CGW1_RXCanId_C "Calibration parameter for Can-Id of Message CanHwObject_CGW1_RX" VALUE 0x804D83B4 DefaultValueRecordLayout_AUTOSAR_Platform_BaseTypes_uint32 2047.0 RB_RBA_Common_CentralElements_CompuMethods_Identical 0.0 2047. FORMAT "%5.0" /end CHARACTERISTIC
/begin CHARACTERISTIC Can_CanHwObject_CGW1_RXCanNod_C "Calibration parameter to calibrate Message CanHwObject_CGW1_RX on different Can Node." VALUE 0x804D85EC DefaultValueRecordLayout_AUTOSAR_Platform_BaseTypes_uint8 2.0 Mcan_Can_CompuMethods_Can_CompuMethod_CtrlId 0.0 2. FORMAT "%5.0" /end CHARACTERISTIC
/begin CHARACTERISTIC Can_CanHwObject_EAT10_RXCanId_C "Calibration parameter for Can-Id of Message CanHwObject_EAT10_RX" VALUE 0x804D83B0 DefaultValueRecordLayout_AUTOSAR_Platform_BaseTypes_uint32 2047.0 RB_RBA_Common_CentralElements_CompuMethods_Identical 0.0 2047. FORMAT "%5.0" /end CHARACTERISTIC
/begin CHARACTERISTIC Can_CanHwObject_EAT10_RXCanNod_C "Calibration parameter to calibrate Message CanHwObject_EAT10_RX on different Can Node." VALUE 0x804D85EB DefaultValueRecordLayout_AUTOSAR_Platform_BaseTypes_uint8 2.0 Mcan_Can_CompuMethods_Can_CompuMethod_CtrlId 0.0 2. FORMAT "%5.0" /end CHARACTERISTIC
/begin CHARACTERISTIC Can_CanHwObject_EAT11_RXCanId_C "Calibration parameter for Can-Id of Message CanHwObject_EAT11_RX" VALUE 0x804D83AC DefaultValueRecordLayout_AUTOSAR_Platform_BaseTypes_uint32 2047.0 RB_RBA_Common_CentralElements_CompuMethods_Identical 0.0 2047. FORMAT "%5.0" /end CHARACTERISTIC
/begin CHARACTERISTIC Can_CanHwObject_EAT11_RXCanNod_C "Calibration parameter to calibrate Message CanHwObject_EAT11_RX on different Can Node." VALUE 0x804D85EA DefaultValueRecordLayout_AUTOSAR_Platform_BaseTypes_uint8 2.0 Mcan_Can_CompuMethods_Can_CompuMethod_CtrlId 0.0 2. FORMAT "%5.0" /end CHARACTERISTIC
/begin CHARACTERISTIC Can_CanHwObject_EAT12_RXCanId_C "Calibration parameter for Can-Id of Message CanHwObject_EAT12_RX" VALUE 0x804D83A8 DefaultValueRecordLayout_AUTOSAR_Platform_BaseTypes_uint32 2047.0 RB_RBA_Common_CentralElements_CompuMethods_Identical 0.0 2047. FORMAT "%5.0" /end CHARACTERISTIC
/begin CHARACTERISTIC Can_CanHwObject_EAT12_RXCanNod_C "Calibration parameter to calibrate Message CanHwObject_EAT12_RX on different Can Node." VALUE 0x804D85E9 DefaultValueRecordLayout_AUTOSAR_Platform_BaseTypes_uint8 2.0 Mcan_Can_CompuMethods_Can_CompuMethod_CtrlId 0.0 2. FORMAT "%5.0" /end CHARACTERISTIC
/begin CHARACTERISTIC Can_CanHwObject_EAT13_RXCanId_C "Calibration parameter for Can-Id of Message CanHwObject_EAT13_RX" VALUE 0x804D83A4 DefaultValueRecordLayout_AUTOSAR_Platform_BaseTypes_uint32 2047.0 RB_RBA_Common_CentralElements_CompuMethods_Identical 0.0 2047. FORMAT "%5.0" /end CHARACTERISTIC
/begin CHARACTERISTIC Can_CanHwObject_EAT13_RXCanNod_C "Calibration parameter to calibrate Message CanHwObject_EAT13_RX on different Can Node." VALUE 0x804D85E8 DefaultValueRecordLayout_AUTOSAR_Platform_BaseTypes_uint8 2.0 Mcan_Can_CompuMethods_Can_CompuMethod_CtrlId 0.0 2. FORMAT "%5.0" /end CHARACTERISTIC
/begin CHARACTERISTIC Can_CanHwObject_EAT1_RXCanId_C "Calibration parameter for Can-Id of Message CanHwObject_EAT1_RX" VALUE 0x804D83A0 DefaultValueRecordLayout_AUTOSAR_Platform_BaseTypes_uint32 2047.0 RB_RBA_Common_CentralElements_CompuMethods_Identical 0.0 2047. FORMAT "%5.0" /end CHARACTERISTIC
/begin CHARACTERISTIC Can_CanHwObject_EAT1_RXCanNod_C "Calibration parameter to calibrate Message CanHwObject_EAT1_RX on different Can Node." VALUE 0x804D85E7 DefaultValueRecordLayout_AUTOSAR_Platform_BaseTypes_uint8 2.0 Mcan_Can_CompuMethods_Can_CompuMethod_CtrlId 0.0 2. FORMAT "%5.0" /end CHARACTERISTIC
/begin CHARACTERISTIC Can_CanHwObject_EAT2_RXCanId_C "Calibration parameter for Can-Id of Message CanHwObject_EAT2_RX" VALUE 0x804D839C DefaultValueRecordLayout_AUTOSAR_Platform_BaseTypes_uint32 2047.0 RB_RBA_Common_CentralElements_CompuMethods_Identical 0.0 2047. FORMAT "%5.0" /end CHARACTERISTIC
/begin CHARACTERISTIC Can_CanHwObject_EAT2_RXCanNod_C "Calibration parameter to calibrate Message CanHwObject_EAT2_RX on different Can Node." VALUE 0x804D85E6 DefaultValueRecordLayout_AUTOSAR_Platform_BaseTypes_uint8 2.0 Mcan_Can_CompuMethods_Can_CompuMethod_CtrlId 0.0 2. FORMAT "%5.0" /end CHARACTERISTIC
/begin CHARACTERISTIC Can_CanHwObject_EAT4_RXCanId_C "Calibration parameter for Can-Id of Message CanHwObject_EAT4_RX" VALUE 0x804D8398 DefaultValueRecordLayout_AUTOSAR_Platform_BaseTypes_uint32 2047.0 RB_RBA_Common_CentralElements_CompuMethods_Identical 0.0 2047. FORMAT "%5.0" /end CHARACTERISTIC
/begin CHARACTERISTIC Can_CanHwObject_EAT4_RXCanNod_C "Calibration parameter to calibrate Message CanHwObject_EAT4_RX on different Can Node." VALUE 0x804D85E5 DefaultValueRecordLayout_AUTOSAR_Platform_BaseTypes_uint8 2.0 Mcan_Can_CompuMethods_Can_CompuMethod_CtrlId 0.0 2. FORMAT "%5.0" /end CHARACTERISTIC
/begin CHARACTERISTIC Can_CanHwObject_EAT6_RXCanId_C "Calibration parameter for Can-Id of Message CanHwObject_EAT6_RX" VALUE 0x804D8394 DefaultValueRecordLayout_AUTOSAR_Platform_BaseTypes_uint32 2047.0 RB_RBA_Common_CentralElements_CompuMethods_Identical 0.0 2047. FORMAT "%5.0" /end CHARACTERISTIC
/begin CHARACTERISTIC Can_CanHwObject_EAT6_RXCanNod_C "Calibration parameter to calibrate Message CanHwObject_EAT6_RX on different Can Node." VALUE 0x804D85E4 DefaultValueRecordLayout_AUTOSAR_Platform_BaseTypes_uint8 2.0 Mcan_Can_CompuMethods_Can_CompuMethod_CtrlId 0.0 2. FORMAT "%5.0" /end CHARACTERISTIC
/begin CHARACTERISTIC Can_CanHwObject_EAT7_RXCanId_C "Calibration parameter for Can-Id of Message CanHwObject_EAT7_RX" VALUE 0x804D8390 DefaultValueRecordLayout_AUTOSAR_Platform_BaseTypes_uint32 2047.0 RB_RBA_Common_CentralElements_CompuMethods_Identical 0.0 2047. FORMAT "%5.0" /end CHARACTERISTIC
/begin CHARACTERISTIC Can_CanHwObject_EAT7_RXCanNod_C "Calibration parameter to calibrate Message CanHwObject_EAT7_RX on different Can Node." VALUE 0x804D85E3 DefaultValueRecordLayout_AUTOSAR_Platform_BaseTypes_uint8 2.0 Mcan_Can_CompuMethods_Can_CompuMethod_CtrlId 0.0 2. FORMAT "%5.0" /end CHARACTERISTIC
/begin CHARACTERISTIC Can_CanHwObject_EAT8_RXCanId_C "Calibration parameter for Can-Id of Message CanHwObject_EAT8_RX" VALUE 0x804D838C DefaultValueRecordLayout_AUTOSAR_Platform_BaseTypes_uint32 2047.0 RB_RBA_Common_CentralElements_CompuMethods_Identical 0.0 2047. FORMAT "%5.0" /end CHARACTERISTIC
/begin CHARACTERISTIC Can_CanHwObject_EAT8_RXCanNod_C "Calibration parameter to calibrate Message CanHwObject_EAT8_RX on different Can Node." VALUE 0x804D85E2 DefaultValueRecordLayout_AUTOSAR_Platform_BaseTypes_uint8 2.0 Mcan_Can_CompuMethods_Can_CompuMethod_CtrlId 0.0 2. FORMAT "%5.0" /end CHARACTERISTIC
/begin CHARACTERISTIC Can_CanHwObject_EATA_RXCanId_C "Calibration parameter for Can-Id of Message CanHwObject_EATA_RX" VALUE 0x804D8388 DefaultValueRecordLayout_AUTOSAR_Platform_BaseTypes_uint32 2047.0 RB_RBA_Common_CentralElements_CompuMethods_Identical 0.0 2047. FORMAT "%5.0" /end CHARACTERISTIC
/begin CHARACTERISTIC Can_CanHwObject_EATA_RXCanNod_C "Calibration parameter to calibrate Message CanHwObject_EATA_RX on different Can Node." VALUE 0x804D85E1 DefaultValueRecordLayout_AUTOSAR_Platform_BaseTypes_uint8 2.0 Mcan_Can_CompuMethods_Can_CompuMethod_CtrlId 0.0 2. FORMAT "%5.0" /end CHARACTERISTIC
/begin CHARACTERISTIC Can_CanHwObject_EATB_RXCanId_C "Calibration parameter for Can-Id of Message CanHwObject_EATB_RX" VALUE 0x804D8384 DefaultValueRecordLayout_AUTOSAR_Platform_BaseTypes_uint32 2047.0 RB_RBA_Common_CentralElements_CompuMethods_Identical 0.0 2047. FORMAT "%5.0" /end CHARACTERISTIC
/begin CHARACTERISTIC Can_CanHwObject_EATB_RXCanNod_C "Calibration parameter to calibrate Message CanHwObject_EATB_RX on different Can Node." VALUE 0x804D85E0 DefaultValueRecordLayout_AUTOSAR_Platform_BaseTypes_uint8 2.0 Mcan_Can_CompuMethods_Can_CompuMethod_CtrlId 0.0 2. FORMAT "%5.0" /end CHARACTERISTIC
/begin CHARACTERISTIC Can_CanHwObject_EATC_RXCanId_C "Calibration parameter for Can-Id of Message CanHwObject_EATC_RX" VALUE 0x804D8380 DefaultValueRecordLayout_AUTOSAR_Platform_BaseTypes_uint32 2047.0 RB_RBA_Common_CentralElements_CompuMethods_Identical 0.0 2047. FORMAT "%5.0" /end CHARACTERISTIC
/begin CHARACTERISTIC Can_CanHwObject_EATC_RXCanNod_C "Calibration parameter to calibrate Message CanHwObject_EATC_RX on different Can Node." VALUE 0x804D85DF DefaultValueRecordLayout_AUTOSAR_Platform_BaseTypes_uint8 2.0 Mcan_Can_CompuMethods_Can_CompuMethod_CtrlId 0.0 2. FORMAT "%5.0" /end CHARACTERISTIC
/begin CHARACTERISTIC Can_CanHwObject_EBBA_RXCanId_C "Calibration parameter for Can-Id of Message CanHwObject_EBBA_RX" VALUE 0x804D837C DefaultValueRecordLayout_AUTOSAR_Platform_BaseTypes_uint32 2047.0 RB_RBA_Common_CentralElements_CompuMethods_Identical 0.0 2047. FORMAT "%5.0" /end CHARACTERISTIC
/begin CHARACTERISTIC Can_CanHwObject_EBBA_RXCanNod_C "Calibration parameter to calibrate Message CanHwObject_EBBA_RX on different Can Node." VALUE 0x804D85DE DefaultValueRecordLayout_AUTOSAR_Platform_BaseTypes_uint8 2.0 Mcan_Can_CompuMethods_Can_CompuMethod_CtrlId 0.0 2. FORMAT "%5.0" /end CHARACTERISTIC
/begin CHARACTERISTIC Can_CanHwObject_ENG10_TXCanNod_C "Calibration parameter to calibrate Message CanHwObject_ENG10_TX on different Can Node." VALUE 0x804D85DD DefaultValueRecordLayout_AUTOSAR_Platform_BaseTypes_uint8 2.0 Mcan_Can_CompuMethods_Can_CompuMethod_CtrlId 0.0 2. FORMAT "%5.0" /end CHARACTERISTIC
/begin CHARACTERISTIC Can_CanHwObject_ENG11_TXCanNod_C "Calibration parameter to calibrate Message CanHwObject_ENG11_TX on different Can Node." VALUE 0x804D85DC DefaultValueRecordLayout_AUTOSAR_Platform_BaseTypes_uint8 2.0 Mcan_Can_CompuMethods_Can_CompuMethod_CtrlId 0.0 2. FORMAT "%5.0" /end CHARACTERISTIC
/begin CHARACTERISTIC Can_CanHwObject_ENG15_TXCanNod_C "Calibration parameter to calibrate Message CanHwObject_ENG15_TX on different Can Node." VALUE 0x804D85DB DefaultValueRecordLayout_AUTOSAR_Platform_BaseTypes_uint8 2.0 Mcan_Can_CompuMethods_Can_CompuMethod_CtrlId 0.0 2. FORMAT "%5.0" /end CHARACTERISTIC
/begin CHARACTERISTIC Can_CanHwObject_ENG16_TXCanNod_C "Calibration parameter to calibrate Message CanHwObject_ENG16_TX on different Can Node." VALUE 0x804D85DA DefaultValueRecordLayout_AUTOSAR_Platform_BaseTypes_uint8 2.0 Mcan_Can_CompuMethods_Can_CompuMethod_CtrlId 0.0 2. FORMAT "%5.0" /end CHARACTERISTIC
/begin CHARACTERISTIC Can_CanHwObject_ENG17_TXCanNod_C "Calibration parameter to calibrate Message CanHwObject_ENG17_TX on different Can Node." VALUE 0x804D85D9 DefaultValueRecordLayout_AUTOSAR_Platform_BaseTypes_uint8 2.0 Mcan_Can_CompuMethods_Can_CompuMethod_CtrlId 0.0 2. FORMAT "%5.0" /end CHARACTERISTIC
/begin CHARACTERISTIC Can_CanHwObject_ENG18_TXCanNod_C "Calibration parameter to calibrate Message CanHwObject_ENG18_TX on different Can Node." VALUE 0x804D85D8 DefaultValueRecordLayout_AUTOSAR_Platform_BaseTypes_uint8 2.0 Mcan_Can_CompuMethods_Can_CompuMethod_CtrlId 0.0 2. FORMAT "%5.0" /end CHARACTERISTIC
/begin CHARACTERISTIC Can_CanHwObject_ENG19_TXCanNod_C "Calibration parameter to calibrate Message CanHwObject_ENG19_TX on different Can Node." VALUE 0x804D85D7 DefaultValueRecordLayout_AUTOSAR_Platform_BaseTypes_uint8 2.0 Mcan_Can_CompuMethods_Can_CompuMethod_CtrlId 0.0 2. FORMAT "%5.0" /end CHARACTERISTIC
/begin CHARACTERISTIC Can_CanHwObject_ENG20_TXCanNod_C "Calibration parameter to calibrate Message CanHwObject_ENG20_TX on different Can Node." VALUE 0x804D85D6 DefaultValueRecordLayout_AUTOSAR_Platform_BaseTypes_uint8 2.0 Mcan_Can_CompuMethods_Can_CompuMethod_CtrlId 0.0 2. FORMAT "%5.0" /end CHARACTERISTIC
/begin CHARACTERISTIC Can_CanHwObject_ENG21_TXCanNod_C "Calibration parameter to calibrate Message CanHwObject_ENG21_TX on different Can Node." VALUE 0x804D85D5 DefaultValueRecordLayout_AUTOSAR_Platform_BaseTypes_uint8 2.0 Mcan_Can_CompuMethods_Can_CompuMethod_CtrlId 0.0 2. FORMAT "%5.0" /end CHARACTERISTIC
/begin CHARACTERISTIC Can_CanHwObject_ENG22_TXCanNod_C "Calibration parameter to calibrate Message CanHwObject_ENG22_TX on different Can Node." VALUE 0x804D85D4 DefaultValueRecordLayout_AUTOSAR_Platform_BaseTypes_uint8 2.0 Mcan_Can_CompuMethods_Can_CompuMethod_CtrlId 0.0 2. FORMAT "%5.0" /end CHARACTERISTIC
/begin CHARACTERISTIC Can_CanHwObject_ENG23_TXCanNod_C "Calibration parameter to calibrate Message CanHwObject_ENG23_TX on different Can Node." VALUE 0x804D85D3 DefaultValueRecordLayout_AUTOSAR_Platform_BaseTypes_uint8 2.0 Mcan_Can_CompuMethods_Can_CompuMethod_CtrlId 0.0 2. FORMAT "%5.0" /end CHARACTERISTIC
/begin CHARACTERISTIC Can_CanHwObject_ENG24_TXCanNod_C "Calibration parameter to calibrate Message CanHwObject_ENG24_TX on different Can Node." VALUE 0x804D85D2 DefaultValueRecordLayout_AUTOSAR_Platform_BaseTypes_uint8 2.0 Mcan_Can_CompuMethods_Can_CompuMethod_CtrlId 0.0 2. FORMAT "%5.0" /end CHARACTERISTIC
/begin CHARACTERISTIC Can_CanHwObject_ENG25_TXCanNod_C "Calibration parameter to calibrate Message CanHwObject_ENG25_TX on different Can Node." VALUE 0x804D85D1 DefaultValueRecordLayout_AUTOSAR_Platform_BaseTypes_uint8 2.0 Mcan_Can_CompuMethods_Can_CompuMethod_CtrlId 0.0 2. FORMAT "%5.0" /end CHARACTERISTIC
/begin CHARACTERISTIC Can_CanHwObject_ENG2_TXCanNod_C "Calibration parameter to calibrate Message CanHwObject_ENG2_TX on different Can Node." VALUE 0x804D85D0 DefaultValueRecordLayout_AUTOSAR_Platform_BaseTypes_uint8 2.0 Mcan_Can_CompuMethods_Can_CompuMethod_CtrlId 0.0 2. FORMAT "%5.0" /end CHARACTERISTIC
/begin CHARACTERISTIC Can_CanHwObject_ENG3_TXCanNod_C "Calibration parameter to calibrate Message CanHwObject_ENG3_TX on different Can Node." VALUE 0x804D85CF DefaultValueRecordLayout_AUTOSAR_Platform_BaseTypes_uint8 2.0 Mcan_Can_CompuMethods_Can_CompuMethod_CtrlId 0.0 2. FORMAT "%5.0" /end CHARACTERISTIC
/begin CHARACTERISTIC Can_CanHwObject_ENG4_TXCanNod_C "Calibration parameter to calibrate Message CanHwObject_ENG4_TX on different Can Node." VALUE 0x804D85CE DefaultValueRecordLayout_AUTOSAR_Platform_BaseTypes_uint8 2.0 Mcan_Can_CompuMethods_Can_CompuMethod_CtrlId 0.0 2. FORMAT "%5.0" /end CHARACTERISTIC
/begin CHARACTERISTIC Can_CanHwObject_ENG5_TXCanNod_C "Calibration parameter to calibrate Message CanHwObject_ENG5_TX on different Can Node." VALUE 0x804D85CD DefaultValueRecordLayout_AUTOSAR_Platform_BaseTypes_uint8 2.0 Mcan_Can_CompuMethods_Can_CompuMethod_CtrlId 0.0 2. FORMAT "%5.0" /end CHARACTERISTIC
/begin CHARACTERISTIC Can_CanHwObject_ENG6_TXCanNod_C "Calibration parameter to calibrate Message CanHwObject_ENG6_TX on different Can Node." VALUE 0x804D85CC DefaultValueRecordLayout_AUTOSAR_Platform_BaseTypes_uint8 2.0 Mcan_Can_CompuMethods_Can_CompuMethod_CtrlId 0.0 2. FORMAT "%5.0" /end CHARACTERISTIC
/begin CHARACTERISTIC Can_CanHwObject_ENGAE_TXCanNod_C "Calibration parameter to calibrate Message CanHwObject_ENGAE_TX on different Can Node." VALUE 0x804D85CB DefaultValueRecordLayout_AUTOSAR_Platform_BaseTypes_uint8 2.0 Mcan_Can_CompuMethods_Can_CompuMethod_CtrlId 0.0 2. FORMAT "%5.0" /end CHARACTERISTIC
/begin CHARACTERISTIC Can_CanHwObject_ENGA_TXCanNod_C "Calibration parameter to calibrate Message CanHwObject_ENGA_TX on different Can Node." VALUE 0x804D85CA DefaultValueRecordLayout_AUTOSAR_Platform_BaseTypes_uint8 2.0 Mcan_Can_CompuMethods_Can_CompuMethod_CtrlId 0.0 2. FORMAT "%5.0" /end CHARACTERISTIC
/begin CHARACTERISTIC Can_CanHwObject_ENGB_TXCanNod_C "Calibration parameter to calibrate Message CanHwObject_ENGB_TX on different Can Node." VALUE 0x804D85C9 DefaultValueRecordLayout_AUTOSAR_Platform_BaseTypes_uint8 2.0 Mcan_Can_CompuMethods_Can_CompuMethod_CtrlId 0.0 2. FORMAT "%5.0" /end CHARACTERISTIC
/begin CHARACTERISTIC Can_CanHwObject_ENGC_TXCanNod_C "Calibration parameter to calibrate Message CanHwObject_ENGC_TX on different Can Node." VALUE 0x804D85C8 DefaultValueRecordLayout_AUTOSAR_Platform_BaseTypes_uint8 2.0 Mcan_Can_CompuMethods_Can_CompuMethod_CtrlId 0.0 2. FORMAT "%5.0" /end CHARACTERISTIC
/begin CHARACTERISTIC Can_CanHwObject_ENGD_TXCanNod_C "Calibration parameter to calibrate Message CanHwObject_ENGD_TX on different Can Node." VALUE 0x804D85C7 DefaultValueRecordLayout_AUTOSAR_Platform_BaseTypes_uint8 2.0 Mcan_Can_CompuMethods_Can_CompuMethod_CtrlId 0.0 2. FORMAT "%5.0" /end CHARACTERISTIC
/begin CHARACTERISTIC Can_CanHwObject_ENGE_TXCanNod_C "Calibration parameter to calibrate Message CanHwObject_ENGE_TX on different Can Node." VALUE 0x804D85C6 DefaultValueRecordLayout_AUTOSAR_Platform_BaseTypes_uint8 2.0 Mcan_Can_CompuMethods_Can_CompuMethod_CtrlId 0.0 2. FORMAT "%5.0" /end CHARACTERISTIC
/begin CHARACTERISTIC Can_CanHwObject_ENGF_TXCanNod_C "Calibration parameter to calibrate Message CanHwObject_ENGF_TX on different Can Node." VALUE 0x804D85C5 DefaultValueRecordLayout_AUTOSAR_Platform_BaseTypes_uint8 2.0 Mcan_Can_CompuMethods_Can_CompuMethod_CtrlId 0.0 2. FORMAT "%5.0" /end CHARACTERISTIC
/begin CHARACTERISTIC Can_CanHwObject_ENGHIP1_TXCanNod_C "Calibration parameter to calibrate Message CanHwObject_ENGHIP1_TX on different Can Node." VALUE 0x804D85C4 DefaultValueRecordLayout_AUTOSAR_Platform_BaseTypes_uint8 2.0 Mcan_Can_CompuMethods_Can_CompuMethod_CtrlId 0.0 2. FORMAT "%5.0" /end CHARACTERISTIC
/begin CHARACTERISTIC Can_CanHwObject_ENGIMG1_TXCanNod_C "Calibration parameter to calibrate Message CanHwObject_ENGIMG1_TX on different Can Node." VALUE 0x804D85C3 DefaultValueRecordLayout_AUTOSAR_Platform_BaseTypes_uint8 2.0 Mcan_Can_CompuMethods_Can_CompuMethod_CtrlId 0.0 2. FORMAT "%5.0" /end CHARACTERISTIC
/begin CHARACTERISTIC Can_CanHwObject_ENGJ3_TXCanNod_C "Calibration parameter to calibrate Message CanHwObject_ENGJ3_TX on different Can Node." VALUE 0x804D85C2 DefaultValueRecordLayout_AUTOSAR_Platform_BaseTypes_uint8 2.0 Mcan_Can_CompuMethods_Can_CompuMethod_CtrlId 0.0 2. FORMAT "%5.0" /end CHARACTERISTIC
/begin CHARACTERISTIC Can_CanHwObject_ENGK3_TXCanNod_C "Calibration parameter to calibrate Message CanHwObject_ENGK3_TX on different Can Node." VALUE 0x804D85C1 DefaultValueRecordLayout_AUTOSAR_Platform_BaseTypes_uint8 2.0 Mcan_Can_CompuMethods_Can_CompuMethod_CtrlId 0.0 2. FORMAT "%5.0" /end CHARACTERISTIC
/begin CHARACTERISTIC Can_CanHwObject_ENGL_TXCanNod_C "Calibration parameter to calibrate Message CanHwObject_ENGL_TX on different Can Node." VALUE 0x804D85C0 DefaultValueRecordLayout_AUTOSAR_Platform_BaseTypes_uint8 2.0 Mcan_Can_CompuMethods_Can_CompuMethod_CtrlId 0.0 2. FORMAT "%5.0" /end CHARACTERISTIC
/begin CHARACTERISTIC Can_CanHwObject_ENGN_TXCanNod_C "Calibration parameter to calibrate Message CanHwObject_ENGN_TX on different Can Node." VALUE 0x804D85BF DefaultValueRecordLayout_AUTOSAR_Platform_BaseTypes_uint8 2.0 Mcan_Can_CompuMethods_Can_CompuMethod_CtrlId 0.0 2. FORMAT "%5.0" /end CHARACTERISTIC
/begin CHARACTERISTIC Can_CanHwObject_ENGQ_TXCanNod_C "Calibration parameter to calibrate Message CanHwObject_ENGQ_TX on different Can Node." VALUE 0x804D85BE DefaultValueRecordLayout_AUTOSAR_Platform_BaseTypes_uint8 2.0 Mcan_Can_CompuMethods_Can_CompuMethod_CtrlId 0.0 2. FORMAT "%5.0" /end CHARACTERISTIC
/begin CHARACTERISTIC Can_CanHwObject_ENGR_TXCanNod_C "Calibration parameter to calibrate Message CanHwObject_ENGR_TX on different Can Node." VALUE 0x804D85BD DefaultValueRecordLayout_AUTOSAR_Platform_BaseTypes_uint8 2.0 Mcan_Can_CompuMethods_Can_CompuMethod_CtrlId 0.0 2. FORMAT "%5.0" /end CHARACTERISTIC
/begin CHARACTERISTIC Can_CanHwObject_ENGT1_TXCanNod_C "Calibration parameter to calibrate Message CanHwObject_ENGT1_TX on different Can Node." VALUE 0x804D85BC DefaultValueRecordLayout_AUTOSAR_Platform_BaseTypes_uint8 2.0 Mcan_Can_CompuMethods_Can_CompuMethod_CtrlId 0.0 2. FORMAT "%5.0" /end CHARACTERISTIC
/begin CHARACTERISTIC Can_CanHwObject_ENGT2_TXCanNod_C "Calibration parameter to calibrate Message CanHwObject_ENGT2_TX on different Can Node." VALUE 0x804D85BB DefaultValueRecordLayout_AUTOSAR_Platform_BaseTypes_uint8 2.0 Mcan_Can_CompuMethods_Can_CompuMethod_CtrlId 0.0 2. FORMAT "%5.0" /end CHARACTERISTIC
/begin CHARACTERISTIC Can_CanHwObject_ENGT_TXCanNod_C "Calibration parameter to calibrate Message CanHwObject_ENGT_TX on different Can Node." VALUE 0x804D85BA DefaultValueRecordLayout_AUTOSAR_Platform_BaseTypes_uint8 2.0 Mcan_Can_CompuMethods_Can_CompuMethod_CtrlId 0.0 2. FORMAT "%5.0" /end CHARACTERISTIC
/begin CHARACTERISTIC Can_CanHwObject_ENGU_TXCanNod_C "Calibration parameter to calibrate Message CanHwObject_ENGU_TX on different Can Node." VALUE 0x804D85B9 DefaultValueRecordLayout_AUTOSAR_Platform_BaseTypes_uint8 2.0 Mcan_Can_CompuMethods_Can_CompuMethod_CtrlId 0.0 2. FORMAT "%5.0" /end CHARACTERISTIC
/begin CHARACTERISTIC Can_CanHwObject_ENGV_TXCanNod_C "Calibration parameter to calibrate Message CanHwObject_ENGV_TX on different Can Node." VALUE 0x804D85B8 DefaultValueRecordLayout_AUTOSAR_Platform_BaseTypes_uint8 2.0 Mcan_Can_CompuMethods_Can_CompuMethod_CtrlId 0.0 2. FORMAT "%5.0" /end CHARACTERISTIC
/begin CHARACTERISTIC Can_CanHwObject_ENGW_TXCanNod_C "Calibration parameter to calibrate Message CanHwObject_ENGW_TX on different Can Node." VALUE 0x804D85B7 DefaultValueRecordLayout_AUTOSAR_Platform_BaseTypes_uint8 2.0 Mcan_Can_CompuMethods_Can_CompuMethod_CtrlId 0.0 2. FORMAT "%5.0" /end CHARACTERISTIC
/begin CHARACTERISTIC Can_CanHwObject_ENGX2_TXCanNod_C "Calibration parameter to calibrate Message CanHwObject_ENGX2_TX on different Can Node." VALUE 0x804D85B6 DefaultValueRecordLayout_AUTOSAR_Platform_BaseTypes_uint8 2.0 Mcan_Can_CompuMethods_Can_CompuMethod_CtrlId 0.0 2. FORMAT "%5.0" /end CHARACTERISTIC
/begin CHARACTERISTIC Can_CanHwObject_ENGY2_TXCanNod_C "Calibration parameter to calibrate Message CanHwObject_ENGY2_TX on different Can Node." VALUE 0x804D85B5 DefaultValueRecordLayout_AUTOSAR_Platform_BaseTypes_uint8 2.0 Mcan_Can_CompuMethods_Can_CompuMethod_CtrlId 0.0 2. FORMAT "%5.0" /end CHARACTERISTIC
/begin CHARACTERISTIC Can_CanHwObject_ENGY_TXCanNod_C "Calibration parameter to calibrate Message CanHwObject_ENGY_TX on different Can Node." VALUE 0x804D85B4 DefaultValueRecordLayout_AUTOSAR_Platform_BaseTypes_uint8 2.0 Mcan_Can_CompuMethods_Can_CompuMethod_CtrlId 0.0 2. FORMAT "%5.0" /end CHARACTERISTIC
/begin CHARACTERISTIC Can_CanHwObject_ENGZ_TXCanNod_C "Calibration parameter to calibrate Message CanHwObject_ENGZ_TX on different Can Node." VALUE 0x804D85B3 DefaultValueRecordLayout_AUTOSAR_Platform_BaseTypes_uint8 2.0 Mcan_Can_CompuMethods_Can_CompuMethod_CtrlId 0.0 2. FORMAT "%5.0" /end CHARACTERISTIC
/begin CHARACTERISTIC Can_CanHwObject_EPS1_RXCanId_C "Calibration parameter for Can-Id of Message CanHwObject_EPS1_RX" VALUE 0x804D8378 DefaultValueRecordLayout_AUTOSAR_Platform_BaseTypes_uint32 2047.0 RB_RBA_Common_CentralElements_CompuMethods_Identical 0.0 2047. FORMAT "%5.0" /end CHARACTERISTIC
/begin CHARACTERISTIC Can_CanHwObject_EPS1_RXCanNod_C "Calibration parameter to calibrate Message CanHwObject_EPS1_RX on different Can Node." VALUE 0x804D85B2 DefaultValueRecordLayout_AUTOSAR_Platform_BaseTypes_uint8 2.0 Mcan_Can_CompuMethods_Can_CompuMethod_CtrlId 0.0 2. FORMAT "%5.0" /end CHARACTERISTIC
/begin CHARACTERISTIC Can_CanHwObject_GWIMG1_RXCanId_C "Calibration parameter for Can-Id of Message CanHwObject_GWIMG1_RX" VALUE 0x804D8374 DefaultValueRecordLayout_AUTOSAR_Platform_BaseTypes_uint32 2047.0 RB_RBA_Common_CentralElements_CompuMethods_Identical 0.0 2047. FORMAT "%5.0" /end CHARACTERISTIC
/begin CHARACTERISTIC Can_CanHwObject_GWIMG1_RXCanNod_C "Calibration parameter to calibrate Message CanHwObject_GWIMG1_RX on different Can Node." VALUE 0x804D85B1 DefaultValueRecordLayout_AUTOSAR_Platform_BaseTypes_uint8 2.0 Mcan_Can_CompuMethods_Can_CompuMethod_CtrlId 0.0 2. FORMAT "%5.0" /end CHARACTERISTIC
/begin CHARACTERISTIC Can_CanHwObject_GWIMG3_RXCanId_C "Calibration parameter for Can-Id of Message CanHwObject_GWIMG3_RX" VALUE 0x804D8370 DefaultValueRecordLayout_AUTOSAR_Platform_BaseTypes_uint32 2047.0 RB_RBA_Common_CentralElements_CompuMethods_Identical 0.0 2047. FORMAT "%5.0" /end CHARACTERISTIC
/begin CHARACTERISTIC Can_CanHwObject_GWIMG3_RXCanNod_C "Calibration parameter to calibrate Message CanHwObject_GWIMG3_RX on different Can Node." VALUE 0x804D85B0 DefaultValueRecordLayout_AUTOSAR_Platform_BaseTypes_uint8 2.0 Mcan_Can_CompuMethods_Can_CompuMethod_CtrlId 0.0 2. FORMAT "%5.0" /end CHARACTERISTIC
/begin CHARACTERISTIC Can_CanHwObject_GWIMG4_RXCanId_C "Calibration parameter for Can-Id of Message CanHwObject_GWIMG4_RX" VALUE 0x804D836C DefaultValueRecordLayout_AUTOSAR_Platform_BaseTypes_uint32 2047.0 RB_RBA_Common_CentralElements_CompuMethods_Identical 0.0 2047. FORMAT "%5.0" /end CHARACTERISTIC
/begin CHARACTERISTIC Can_CanHwObject_GWIMG4_RXCanNod_C "Calibration parameter to calibrate Message CanHwObject_GWIMG4_RX on different Can Node." VALUE 0x804D85AF DefaultValueRecordLayout_AUTOSAR_Platform_BaseTypes_uint8 2.0 Mcan_Can_CompuMethods_Can_CompuMethod_CtrlId 0.0 2. FORMAT "%5.0" /end CHARACTERISTIC
/begin CHARACTERISTIC Can_CanHwObject_GWIMG5_RXCanId_C "Calibration parameter for Can-Id of Message CanHwObject_GWIMG5_RX" VALUE 0x804D8368 DefaultValueRecordLayout_AUTOSAR_Platform_BaseTypes_uint32 2047.0 RB_RBA_Common_CentralElements_CompuMethods_Identical 0.0 2047. FORMAT "%5.0" /end CHARACTERISTIC
/begin CHARACTERISTIC Can_CanHwObject_GWIMG5_RXCanNod_C "Calibration parameter to calibrate Message CanHwObject_GWIMG5_RX on different Can Node." VALUE 0x804D85AE DefaultValueRecordLayout_AUTOSAR_Platform_BaseTypes_uint8 2.0 Mcan_Can_CompuMethods_Can_CompuMethod_CtrlId 0.0 2. FORMAT "%5.0" /end CHARACTERISTIC
/begin CHARACTERISTIC Can_CanHwObject_GWIMG6_RXCanId_C "Calibration parameter for Can-Id of Message CanHwObject_GWIMG6_RX" VALUE 0x804D8364 DefaultValueRecordLayout_AUTOSAR_Platform_BaseTypes_uint32 2047.0 RB_RBA_Common_CentralElements_CompuMethods_Identical 0.0 2047. FORMAT "%5.0" /end CHARACTERISTIC
/begin CHARACTERISTIC Can_CanHwObject_GWIMG6_RXCanNod_C "Calibration parameter to calibrate Message CanHwObject_GWIMG6_RX on different Can Node." VALUE 0x804D85AD DefaultValueRecordLayout_AUTOSAR_Platform_BaseTypes_uint8 2.0 Mcan_Can_CompuMethods_Can_CompuMethod_CtrlId 0.0 2. FORMAT "%5.0" /end CHARACTERISTIC
/begin CHARACTERISTIC Can_CanHwObject_IDASB_RXCanId_C "Calibration parameter for Can-Id of Message CanHwObject_IDASB_RX" VALUE 0x804D8360 DefaultValueRecordLayout_AUTOSAR_Platform_BaseTypes_uint32 2047.0 RB_RBA_Common_CentralElements_CompuMethods_Identical 0.0 2047. FORMAT "%5.0" /end CHARACTERISTIC
/begin CHARACTERISTIC Can_CanHwObject_IDASB_RXCanNod_C "Calibration parameter to calibrate Message CanHwObject_IDASB_RX on different Can Node." VALUE 0x804D85AC DefaultValueRecordLayout_AUTOSAR_Platform_BaseTypes_uint8 2.0 Mcan_Can_CompuMethods_Can_CompuMethod_CtrlId 0.0 2. FORMAT "%5.0" /end CHARACTERISTIC
/begin CHARACTERISTIC Can_CanHwObject_META_RXCanId_C "Calibration parameter for Can-Id of Message CanHwObject_META_RX" VALUE 0x804D835C DefaultValueRecordLayout_AUTOSAR_Platform_BaseTypes_uint32 2047.0 RB_RBA_Common_CentralElements_CompuMethods_Identical 0.0 2047. FORMAT "%5.0" /end CHARACTERISTIC
/begin CHARACTERISTIC Can_CanHwObject_META_RXCanNod_C "Calibration parameter to calibrate Message CanHwObject_META_RX on different Can Node." VALUE 0x804D85AB DefaultValueRecordLayout_AUTOSAR_Platform_BaseTypes_uint8 2.0 Mcan_Can_CompuMethods_Can_CompuMethod_CtrlId 0.0 2. FORMAT "%5.0" /end CHARACTERISTIC
/begin CHARACTERISTIC Can_CanHwObject_METC_RXCanId_C "Calibration parameter for Can-Id of Message CanHwObject_METC_RX" VALUE 0x804D8358 DefaultValueRecordLayout_AUTOSAR_Platform_BaseTypes_uint32 2047.0 RB_RBA_Common_CentralElements_CompuMethods_Identical 0.0 2047. FORMAT "%5.0" /end CHARACTERISTIC
/begin CHARACTERISTIC Can_CanHwObject_METC_RXCanNod_C "Calibration parameter to calibrate Message CanHwObject_METC_RX on different Can Node." VALUE 0x804D85AA DefaultValueRecordLayout_AUTOSAR_Platform_BaseTypes_uint8 2.0 Mcan_Can_CompuMethods_Can_CompuMethod_CtrlId 0.0 2. FORMAT "%5.0" /end CHARACTERISTIC
/begin CHARACTERISTIC Can_CanHwObject_METD2_RXCanId_C "Calibration parameter for Can-Id of Message CanHwObject_METD2_RX" VALUE 0x804D8354 DefaultValueRecordLayout_AUTOSAR_Platform_BaseTypes_uint32 2047.0 RB_RBA_Common_CentralElements_CompuMethods_Identical 0.0 2047. FORMAT "%5.0" /end CHARACTERISTIC
/begin CHARACTERISTIC Can_CanHwObject_METD2_RXCanNod_C "Calibration parameter to calibrate Message CanHwObject_METD2_RX on different Can Node." VALUE 0x804D85A9 DefaultValueRecordLayout_AUTOSAR_Platform_BaseTypes_uint8 2.0 Mcan_Can_CompuMethods_Can_CompuMethod_CtrlId 0.0 2. FORMAT "%5.0" /end CHARACTERISTIC
/begin CHARACTERISTIC Can_CanHwObject_METD_RXCanId_C "Calibration parameter for Can-Id of Message CanHwObject_METD_RX" VALUE 0x804D8350 DefaultValueRecordLayout_AUTOSAR_Platform_BaseTypes_uint32 2047.0 RB_RBA_Common_CentralElements_CompuMethods_Identical 0.0 2047. FORMAT "%5.0" /end CHARACTERISTIC
/begin CHARACTERISTIC Can_CanHwObject_METD_RXCanNod_C "Calibration parameter to calibrate Message CanHwObject_METD_RX on different Can Node." VALUE 0x804D85A8 DefaultValueRecordLayout_AUTOSAR_Platform_BaseTypes_uint8 2.0 Mcan_Can_CompuMethods_Can_CompuMethod_CtrlId 0.0 2. FORMAT "%5.0" /end CHARACTERISTIC
/begin CHARACTERISTIC Can_CanHwObject_METE2_RXCanId_C "Calibration parameter for Can-Id of Message CanHwObject_METE2_RX" VALUE 0x804D834C DefaultValueRecordLayout_AUTOSAR_Platform_BaseTypes_uint32 2047.0 RB_RBA_Common_CentralElements_CompuMethods_Identical 0.0 2047. FORMAT "%5.0" /end CHARACTERISTIC
/begin CHARACTERISTIC Can_CanHwObject_METE2_RXCanNod_C "Calibration parameter to calibrate Message CanHwObject_METE2_RX on different Can Node." VALUE 0x804D85A7 DefaultValueRecordLayout_AUTOSAR_Platform_BaseTypes_uint8 2.0 Mcan_Can_CompuMethods_Can_CompuMethod_CtrlId 0.0 2. FORMAT "%5.0" /end CHARACTERISTIC
/begin CHARACTERISTIC Can_CanHwObject_METF_RXCanId_C "Calibration parameter for Can-Id of Message CanHwObject_METF_RX" VALUE 0x804D8348 DefaultValueRecordLayout_AUTOSAR_Platform_BaseTypes_uint32 2047.0 RB_RBA_Common_CentralElements_CompuMethods_Identical 0.0 2047. FORMAT "%5.0" /end CHARACTERISTIC
/begin CHARACTERISTIC Can_CanHwObject_METF_RXCanNod_C "Calibration parameter to calibrate Message CanHwObject_METF_RX on different Can Node." VALUE 0x804D85A6 DefaultValueRecordLayout_AUTOSAR_Platform_BaseTypes_uint8 2.0 Mcan_Can_CompuMethods_Can_CompuMethod_CtrlId 0.0 2. FORMAT "%5.0" /end CHARACTERISTIC
/begin CHARACTERISTIC Can_CanHwObject_METG_RXCanId_C "Calibration parameter for Can-Id of Message CanHwObject_METG_RX" VALUE 0x804D8344 DefaultValueRecordLayout_AUTOSAR_Platform_BaseTypes_uint32 2047.0 RB_RBA_Common_CentralElements_CompuMethods_Identical 0.0 2047. FORMAT "%5.0" /end CHARACTERISTIC
/begin CHARACTERISTIC Can_CanHwObject_METG_RXCanNod_C "Calibration parameter to calibrate Message CanHwObject_METG_RX on different Can Node." VALUE 0x804D85A5 DefaultValueRecordLayout_AUTOSAR_Platform_BaseTypes_uint8 2.0 Mcan_Can_CompuMethods_Can_CompuMethod_CtrlId 0.0 2. FORMAT "%5.0" /end CHARACTERISTIC
/begin CHARACTERISTIC Can_CanHwObject_METH2_RXCanId_C "Calibration parameter for Can-Id of Message CanHwObject_METH2_RX" VALUE 0x804D8340 DefaultValueRecordLayout_AUTOSAR_Platform_BaseTypes_uint32 2047.0 RB_RBA_Common_CentralElements_CompuMethods_Identical 0.0 2047. FORMAT "%5.0" /end CHARACTERISTIC
/begin CHARACTERISTIC Can_CanHwObject_METH2_RXCanNod_C "Calibration parameter to calibrate Message CanHwObject_METH2_RX on different Can Node." VALUE 0x804D85A4 DefaultValueRecordLayout_AUTOSAR_Platform_BaseTypes_uint8 2.0 Mcan_Can_CompuMethods_Can_CompuMethod_CtrlId 0.0 2. FORMAT "%5.0" /end CHARACTERISTIC
/begin CHARACTERISTIC Can_CanHwObject_METH_RXCanId_C "Calibration parameter for Can-Id of Message CanHwObject_METH_RX" VALUE 0x804D833C DefaultValueRecordLayout_AUTOSAR_Platform_BaseTypes_uint32 2047.0 RB_RBA_Common_CentralElements_CompuMethods_Identical 0.0 2047. FORMAT "%5.0" /end CHARACTERISTIC
/begin CHARACTERISTIC Can_CanHwObject_METH_RXCanNod_C "Calibration parameter to calibrate Message CanHwObject_METH_RX on different Can Node." VALUE 0x804D85A3 DefaultValueRecordLayout_AUTOSAR_Platform_BaseTypes_uint8 2.0 Mcan_Can_CompuMethods_Can_CompuMethod_CtrlId 0.0 2. FORMAT "%5.0" /end CHARACTERISTIC
/begin CHARACTERISTIC Can_CanHwObject_METI_RXCanId_C "Calibration parameter for Can-Id of Message CanHwObject_METI_RX" VALUE 0x804D8338 DefaultValueRecordLayout_AUTOSAR_Platform_BaseTypes_uint32 2047.0 RB_RBA_Common_CentralElements_CompuMethods_Identical 0.0 2047. FORMAT "%5.0" /end CHARACTERISTIC
/begin CHARACTERISTIC Can_CanHwObject_METI_RXCanNod_C "Calibration parameter to calibrate Message CanHwObject_METI_RX on different Can Node." VALUE 0x804D85A2 DefaultValueRecordLayout_AUTOSAR_Platform_BaseTypes_uint8 2.0 Mcan_Can_CompuMethods_Can_CompuMethod_CtrlId 0.0 2. FORMAT "%5.0" /end CHARACTERISTIC
/begin CHARACTERISTIC Can_CanHwObject_METK_RXCanId_C "Calibration parameter for Can-Id of Message CanHwObject_METK_RX" VALUE 0x804D8334 DefaultValueRecordLayout_AUTOSAR_Platform_BaseTypes_uint32 2047.0 RB_RBA_Common_CentralElements_CompuMethods_Identical 0.0 2047. FORMAT "%5.0" /end CHARACTERISTIC
/begin CHARACTERISTIC Can_CanHwObject_METK_RXCanNod_C "Calibration parameter to calibrate Message CanHwObject_METK_RX on different Can Node." VALUE 0x804D85A1 DefaultValueRecordLayout_AUTOSAR_Platform_BaseTypes_uint8 2.0 Mcan_Can_CompuMethods_Can_CompuMethod_CtrlId 0.0 2. FORMAT "%5.0" /end CHARACTERISTIC
/begin CHARACTERISTIC Can_CanHwObject_METL_RXCanId_C "Calibration parameter for Can-Id of Message CanHwObject_METL_RX" VALUE 0x804D8330 DefaultValueRecordLayout_AUTOSAR_Platform_BaseTypes_uint32 2047.0 RB_RBA_Common_CentralElements_CompuMethods_Identical 0.0 2047. FORMAT "%5.0" /end CHARACTERISTIC
/begin CHARACTERISTIC Can_CanHwObject_METL_RXCanNod_C "Calibration parameter to calibrate Message CanHwObject_METL_RX on different Can Node." VALUE 0x804D85A0 DefaultValueRecordLayout_AUTOSAR_Platform_BaseTypes_uint8 2.0 Mcan_Can_CompuMethods_Can_CompuMethod_CtrlId 0.0 2. FORMAT "%5.0" /end CHARACTERISTIC
/begin CHARACTERISTIC Can_CanHwObject_METM_RXCanId_C "Calibration parameter for Can-Id of Message CanHwObject_METM_RX" VALUE 0x804D832C DefaultValueRecordLayout_AUTOSAR_Platform_BaseTypes_uint32 2047.0 RB_RBA_Common_CentralElements_CompuMethods_Identical 0.0 2047. FORMAT "%5.0" /end CHARACTERISTIC
/begin CHARACTERISTIC Can_CanHwObject_METM_RXCanNod_C "Calibration parameter to calibrate Message CanHwObject_METM_RX on different Can Node." VALUE 0x804D859F DefaultValueRecordLayout_AUTOSAR_Platform_BaseTypes_uint8 2.0 Mcan_Can_CompuMethods_Can_CompuMethod_CtrlId 0.0 2. FORMAT "%5.0" /end CHARACTERISTIC
/begin CHARACTERISTIC Can_CanHwObject_METN_RXCanId_C "Calibration parameter for Can-Id of Message CanHwObject_METN_RX" VALUE 0x804D8328 DefaultValueRecordLayout_AUTOSAR_Platform_BaseTypes_uint32 2047.0 RB_RBA_Common_CentralElements_CompuMethods_Identical 0.0 2047. FORMAT "%5.0" /end CHARACTERISTIC
/begin CHARACTERISTIC Can_CanHwObject_METN_RXCanNod_C "Calibration parameter to calibrate Message CanHwObject_METN_RX on different Can Node." VALUE 0x804D859E DefaultValueRecordLayout_AUTOSAR_Platform_BaseTypes_uint8 2.0 Mcan_Can_CompuMethods_Can_CompuMethod_CtrlId 0.0 2. FORMAT "%5.0" /end CHARACTERISTIC
/begin CHARACTERISTIC Can_CanHwObject_PCU_RXCanId_C "Calibration parameter for Can-Id of Message CanHwObject_PCU_RX" VALUE 0x804D8324 DefaultValueRecordLayout_AUTOSAR_Platform_BaseTypes_uint32 2047.0 RB_RBA_Common_CentralElements_CompuMethods_Identical 0.0 2047. FORMAT "%5.0" /end CHARACTERISTIC
/begin CHARACTERISTIC Can_CanHwObject_PCU_RXCanNod_C "Calibration parameter to calibrate Message CanHwObject_PCU_RX on different Can Node." VALUE 0x804D859D DefaultValueRecordLayout_AUTOSAR_Platform_BaseTypes_uint8 2.0 Mcan_Can_CompuMethods_Can_CompuMethod_CtrlId 0.0 2. FORMAT "%5.0" /end CHARACTERISTIC
/begin CHARACTERISTIC Can_CanHwObject_SRSA_RXCanId_C "Calibration parameter for Can-Id of Message CanHwObject_SRSA_RX" VALUE 0x804D8320 DefaultValueRecordLayout_AUTOSAR_Platform_BaseTypes_uint32 2047.0 RB_RBA_Common_CentralElements_CompuMethods_Identical 0.0 2047. FORMAT "%5.0" /end CHARACTERISTIC
/begin CHARACTERISTIC Can_CanHwObject_SRSA_RXCanNod_C "Calibration parameter to calibrate Message CanHwObject_SRSA_RX on different Can Node." VALUE 0x804D859C DefaultValueRecordLayout_AUTOSAR_Platform_BaseTypes_uint8 2.0 Mcan_Can_CompuMethods_Can_CompuMethod_CtrlId 0.0 2. FORMAT "%5.0" /end CHARACTERISTIC
/begin CHARACTERISTIC Can_CanHwObject_SRSB_RXCanId_C "Calibration parameter for Can-Id of Message CanHwObject_SRSB_RX" VALUE 0x804D831C DefaultValueRecordLayout_AUTOSAR_Platform_BaseTypes_uint32 2047.0 RB_RBA_Common_CentralElements_CompuMethods_Identical 0.0 2047. FORMAT "%5.0" /end CHARACTERISTIC
/begin CHARACTERISTIC Can_CanHwObject_SRSB_RXCanNod_C "Calibration parameter to calibrate Message CanHwObject_SRSB_RX on different Can Node." VALUE 0x804D859B DefaultValueRecordLayout_AUTOSAR_Platform_BaseTypes_uint8 2.0 Mcan_Can_CompuMethods_Can_CompuMethod_CtrlId 0.0 2. FORMAT "%5.0" /end CHARACTERISTIC
/begin CHARACTERISTIC Can_CanHwObject_SRS_RXCanId_C "Calibration parameter for Can-Id of Message CanHwObject_SRS_RX" VALUE 0x804D8318 DefaultValueRecordLayout_AUTOSAR_Platform_BaseTypes_uint32 2047.0 RB_RBA_Common_CentralElements_CompuMethods_Identical 0.0 2047. FORMAT "%5.0" /end CHARACTERISTIC
/begin CHARACTERISTIC Can_CanHwObject_SRS_RXCanNod_C "Calibration parameter to calibrate Message CanHwObject_SRS_RX on different Can Node." VALUE 0x804D859A DefaultValueRecordLayout_AUTOSAR_Platform_BaseTypes_uint8 2.0 Mcan_Can_CompuMethods_Can_CompuMethod_CtrlId 0.0 2. FORMAT "%5.0" /end CHARACTERISTIC
/begin CHARACTERISTIC Can_CanHwObject_eng1_TXCanNod_C "Calibration parameter to calibrate Message CanHwObject_eng1_TX on different Can Node." VALUE 0x804D8599 DefaultValueRecordLayout_AUTOSAR_Platform_BaseTypes_uint8 2.0 Mcan_Can_CompuMethods_Can_CompuMethod_CtrlId 0.0 2. FORMAT "%5.0" /end CHARACTERISTIC
/begin CHARACTERISTIC Can_CanHwObject_engo_TXCanNod_C "Calibration parameter to calibrate Message CanHwObject_engo_TX on different Can Node." VALUE 0x804D8598 DefaultValueRecordLayout_AUTOSAR_Platform_BaseTypes_uint8 2.0 Mcan_Can_CompuMethods_Can_CompuMethod_CtrlId 0.0 2. FORMAT "%5.0" /end CHARACTERISTIC
/begin CHARACTERISTIC Can_Can_APPLBaudrateCfgId_C "Calibration parameter for the Baudrate of Can Node Can_APPL" VALUE 0x804D8576 DefaultValueRecordLayout_AUTOSAR_Platform_BaseTypes_uint16 0.0 Mcan_Can_CompuMethods_Can_CompuMethod_CtrlBdRateId_Can_APPL 0.0 0.0 FORMAT "%5.0" /end CHARACTERISTIC
/begin CHARACTERISTIC Can_Can_CBaudrateCfgId_C "Calibration parameter for the Baudrate of Can Node Can_C" VALUE 0x804D8574 DefaultValueRecordLayout_AUTOSAR_Platform_BaseTypes_uint16 0.0 Mcan_Can_CompuMethods_Can_CompuMethod_CtrlBdRateId_Can_C 0.0 0.0 FORMAT "%5.0" /end CHARACTERISTIC
/begin CHARACTERISTIC Can_Can_VEHICLEBaudrateCfgId_C "Calibration parameter for the Baudrate of Can Node Can_VEHICLE" VALUE 0x804D8572 DefaultValueRecordLayout_AUTOSAR_Platform_BaseTypes_uint16 0.0 Mcan_Can_CompuMethods_Can_CompuMethod_CtrlBdRateId_Can_VEHICLE 0.0 0.0 FORMAT "%5.0" /end CHARACTERISTIC
/begin CHARACTERISTIC Can_OBD_ON_CAN_Rx_0x7DF_VEHICLECanId_C "Calibration parameter for Can-Id of Message OBD_ON_CAN_Rx_0x7DF_VEHICLE" VALUE 0x804D8314 DefaultValueRecordLayout_AUTOSAR_Platform_BaseTypes_uint32 2047.0 RB_RBA_Common_CentralElements_CompuMethods_Identical 0.0 2047. FORMAT "%5.0" /end CHARACTERISTIC
/begin CHARACTERISTIC Can_OBD_ON_CAN_Rx_0x7DF_VEHICLECanNod_C "Calibration parameter to calibrate Message OBD_ON_CAN_Rx_0x7DF_VEHICLE on different Can Node." VALUE 0x804D8597 DefaultValueRecordLayout_AUTOSAR_Platform_BaseTypes_uint8 2.0 Mcan_Can_CompuMethods_Can_CompuMethod_CtrlId 0.0 2. FORMAT "%5.0" /end CHARACTERISTIC
/begin CHARACTERISTIC Can_OBD_ON_CAN_Rx_0x7E0_VEHICLECanId_C "Calibration parameter for Can-Id of Message OBD_ON_CAN_Rx_0x7E0_VEHICLE" VALUE 0x804D8310 DefaultValueRecordLayout_AUTOSAR_Platform_BaseTypes_uint32 2047.0 RB_RBA_Common_CentralElements_CompuMethods_Identical 0.0 2047. FORMAT "%5.0" /end CHARACTERISTIC
/begin CHARACTERISTIC Can_OBD_ON_CAN_Rx_0x7E0_VEHICLECanNod_C "Calibration parameter to calibrate Message OBD_ON_CAN_Rx_0x7E0_VEHICLE on different Can Node." VALUE 0x804D8596 DefaultValueRecordLayout_AUTOSAR_Platform_BaseTypes_uint8 2.0 Mcan_Can_CompuMethods_Can_CompuMethod_CtrlId 0.0 2. FORMAT "%5.0" /end CHARACTERISTIC
/begin CHARACTERISTIC Can_OBD_ON_CAN_Tx_0x7E8_VEHICLECanNod_C "Calibration parameter to calibrate Message OBD_ON_CAN_Tx_0x7E8_VEHICLE on different Can Node." VALUE 0x804D8595 DefaultValueRecordLayout_AUTOSAR_Platform_BaseTypes_uint8 2.0 Mcan_Can_CompuMethods_Can_CompuMethod_CtrlId 0.0 2. FORMAT "%5.0" /end CHARACTERISTIC
/begin CHARACTERISTIC Can_T1_RXCanId_C "Calibration parameter for Can-Id of Message T1_RX" VALUE 0x804D830C DefaultValueRecordLayout_AUTOSAR_Platform_BaseTypes_uint32 2047.0 RB_RBA_Common_CentralElements_CompuMethods_Identical 0.0 2047. FORMAT "%5.0" /end CHARACTERISTIC
/begin CHARACTERISTIC Can_T1_RXCanNod_C "Calibration parameter to calibrate Message T1_RX on different Can Node." VALUE 0x804D8594 DefaultValueRecordLayout_AUTOSAR_Platform_BaseTypes_uint8 2.0 Mcan_Can_CompuMethods_Can_CompuMethod_CtrlId 0.0 2. FORMAT "%5.0" /end CHARACTERISTIC
/begin CHARACTERISTIC Can_T1_TXCanNod_C "Calibration parameter to calibrate Message T1_TX on different Can Node." VALUE 0x804D8593 DefaultValueRecordLayout_AUTOSAR_Platform_BaseTypes_uint8 2.0 Mcan_Can_CompuMethods_Can_CompuMethod_CtrlId 0.0 2. FORMAT "%5.0" /end CHARACTERISTIC
/begin CHARACTERISTIC Can_UDS_ON_CAN_Rx_0x18da10f1_VEHICLECanId_C "Calibration parameter for Can-Id of Message UDS_ON_CAN_Rx_0x18da10f1_VEHICLE" VALUE 0x804D8308 DefaultValueRecordLayout_AUTOSAR_Platform_BaseTypes_uint32 5.0E8 RB_RBA_Common_CentralElements_CompuMethods_Identical 0.0 5.E8 FORMAT "%5.0" /end CHARACTERISTIC
/begin CHARACTERISTIC Can_UDS_ON_CAN_Rx_0x18da10f1_VEHICLECanNod_C "Calibration parameter to calibrate Message UDS_ON_CAN_Rx_0x18da10f1_VEHICLE on different Can Node." VALUE 0x804D8592 DefaultValueRecordLayout_AUTOSAR_Platform_BaseTypes_uint8 2.0 Mcan_Can_CompuMethods_Can_CompuMethod_CtrlId 0.0 2. FORMAT "%5.0" /end CHARACTERISTIC
/begin CHARACTERISTIC Can_UDS_ON_CAN_Rx_0x18da10f2_VEHICLECanId_C "Calibration parameter for Can-Id of Message UDS_ON_CAN_Rx_0x18da10f2_VEHICLE" VALUE 0x804D8304 DefaultValueRecordLayout_AUTOSAR_Platform_BaseTypes_uint32 5.0E8 RB_RBA_Common_CentralElements_CompuMethods_Identical 0.0 5.E8 FORMAT "%5.0" /end CHARACTERISTIC
/begin CHARACTERISTIC Can_UDS_ON_CAN_Rx_0x18da10f2_VEHICLECanNod_C "Calibration parameter to calibrate Message UDS_ON_CAN_Rx_0x18da10f2_VEHICLE on different Can Node." VALUE 0x804D8591 DefaultValueRecordLayout_AUTOSAR_Platform_BaseTypes_uint8 2.0 Mcan_Can_CompuMethods_Can_CompuMethod_CtrlId 0.0 2. FORMAT "%5.0" /end CHARACTERISTIC
/begin CHARACTERISTIC Can_UDS_ON_CAN_Rx_0x18db2ff1_VEHICLECanId_C "Calibration parameter for Can-Id of Message UDS_ON_CAN_Rx_0x18db2ff1_VEHICLE" VALUE 0x804D8300 DefaultValueRecordLayout_AUTOSAR_Platform_BaseTypes_uint32 5.0E8 RB_RBA_Common_CentralElements_CompuMethods_Identical 0.0 5.E8 FORMAT "%5.0" /end CHARACTERISTIC
/begin CHARACTERISTIC Can_UDS_ON_CAN_Rx_0x18db2ff1_VEHICLECanNod_C "Calibration parameter to calibrate Message UDS_ON_CAN_Rx_0x18db2ff1_VEHICLE on different Can Node." VALUE 0x804D8590 DefaultValueRecordLayout_AUTOSAR_Platform_BaseTypes_uint8 2.0 Mcan_Can_CompuMethods_Can_CompuMethod_CtrlId 0.0 2. FORMAT "%5.0" /end CHARACTERISTIC
/begin CHARACTERISTIC Can_UDS_ON_CAN_Rx_0x18db33f1_VEHICLECanId_C "Calibration parameter for Can-Id of Message UDS_ON_CAN_Rx_0x18db33f1_VEHICLE" VALUE 0x804D82FC DefaultValueRecordLayout_AUTOSAR_Platform_BaseTypes_uint32 5.0E8 RB_RBA_Common_CentralElements_CompuMethods_Identical 0.0 5.E8 FORMAT "%5.0" /end CHARACTERISTIC
/begin CHARACTERISTIC Can_UDS_ON_CAN_Rx_0x18db33f1_VEHICLECanNod_C "Calibration parameter to calibrate Message UDS_ON_CAN_Rx_0x18db33f1_VEHICLE on different Can Node." VALUE 0x804D858F DefaultValueRecordLayout_AUTOSAR_Platform_BaseTypes_uint8 2.0 Mcan_Can_CompuMethods_Can_CompuMethod_CtrlId 0.0 2. FORMAT "%5.0" /end CHARACTERISTIC
/begin CHARACTERISTIC Can_UDS_ON_CAN_Rx_0x18dbeff1_VEHICLECanId_C "Calibration parameter for Can-Id of Message UDS_ON_CAN_Rx_0x18dbeff1_VEHICLE" VALUE 0x804D82F8 DefaultValueRecordLayout_AUTOSAR_Platform_BaseTypes_uint32 5.0E8 RB_RBA_Common_CentralElements_CompuMethods_Identical 0.0 5.E8 FORMAT "%5.0" /end CHARACTERISTIC
/begin CHARACTERISTIC Can_UDS_ON_CAN_Rx_0x18dbeff1_VEHICLECanNod_C "Calibration parameter to calibrate Message UDS_ON_CAN_Rx_0x18dbeff1_VEHICLE on different Can Node." VALUE 0x804D858E DefaultValueRecordLayout_AUTOSAR_Platform_BaseTypes_uint8 2.0 Mcan_Can_CompuMethods_Can_CompuMethod_CtrlId 0.0 2. FORMAT "%5.0" /end CHARACTERISTIC
/begin CHARACTERISTIC Can_UDS_ON_CAN_Tx_0x18daf110_VEHICLECanNod_C "Calibration parameter to calibrate Message UDS_ON_CAN_Tx_0x18daf110_VEHICLE on different Can Node." VALUE 0x804D858D DefaultValueRecordLayout_AUTOSAR_Platform_BaseTypes_uint8 2.0 Mcan_Can_CompuMethods_Can_CompuMethod_CtrlId 0.0 2. FORMAT "%5.0" /end CHARACTERISTIC
/begin CHARACTERISTIC Can_UDS_ON_CAN_Tx_0x18daf210_VEHICLECanNod_C "Calibration parameter to calibrate Message UDS_ON_CAN_Tx_0x18daf210_VEHICLE on different Can Node." VALUE 0x804D858C DefaultValueRecordLayout_AUTOSAR_Platform_BaseTypes_uint8 2.0 Mcan_Can_CompuMethods_Can_CompuMethod_CtrlId 0.0 2. FORMAT "%5.0" /end CHARACTERISTIC
/begin CHARACTERISTIC Can_XcpRx_Cmd_APPLCanId_C "Calibration parameter for Can-Id of Message XcpRx_Cmd_APPL" VALUE 0x804D82F4 DefaultValueRecordLayout_AUTOSAR_Platform_BaseTypes_uint32 2047.0 RB_RBA_Common_CentralElements_CompuMethods_Identical 0.0 2047. FORMAT "%5.0" /end CHARACTERISTIC
/begin CHARACTERISTIC Can_XcpRx_Cmd_APPLCanNod_C "Calibration parameter to calibrate Message XcpRx_Cmd_APPL on different Can Node." VALUE 0x804D858B DefaultValueRecordLayout_AUTOSAR_Platform_BaseTypes_uint8 2.0 Mcan_Can_CompuMethods_Can_CompuMethod_CtrlId 0.0 2. FORMAT "%5.0" /end CHARACTERISTIC
/begin CHARACTERISTIC Can_XcpRx_Cmd_CANCCanId_C "Calibration parameter for Can-Id of Message XcpRx_Cmd_CANC" VALUE 0x804D82F0 DefaultValueRecordLayout_AUTOSAR_Platform_BaseTypes_uint32 2047.0 RB_RBA_Common_CentralElements_CompuMethods_Identical 0.0 2047. FORMAT "%5.0" /end CHARACTERISTIC
/begin CHARACTERISTIC Can_XcpRx_Cmd_CANCCanNod_C "Calibration parameter to calibrate Message XcpRx_Cmd_CANC on different Can Node." VALUE 0x804D858A DefaultValueRecordLayout_AUTOSAR_Platform_BaseTypes_uint8 2.0 Mcan_Can_CompuMethods_Can_CompuMethod_CtrlId 0.0 2. FORMAT "%5.0" /end CHARACTERISTIC
/begin CHARACTERISTIC Can_XcpRx_Cmd_VEHICLECanId_C "Calibration parameter for Can-Id of Message XcpRx_Cmd_VEHICLE" VALUE 0x804D82EC DefaultValueRecordLayout_AUTOSAR_Platform_BaseTypes_uint32 2047.0 RB_RBA_Common_CentralElements_CompuMethods_Identical 0.0 2047. FORMAT "%5.0" /end CHARACTERISTIC
/begin CHARACTERISTIC Can_XcpRx_Cmd_VEHICLECanNod_C "Calibration parameter to calibrate Message XcpRx_Cmd_VEHICLE on different Can Node." VALUE 0x804D8589 DefaultValueRecordLayout_AUTOSAR_Platform_BaseTypes_uint8 2.0 Mcan_Can_CompuMethods_Can_CompuMethod_CtrlId 0.0 2. FORMAT "%5.0" /end CHARACTERISTIC
/begin CHARACTERISTIC Can_XcpTx_Var_APPLCanNod_C "Calibration parameter to calibrate Message XcpTx_Var_APPL on different Can Node." VALUE 0x804D8588 DefaultValueRecordLayout_AUTOSAR_Platform_BaseTypes_uint8 2.0 Mcan_Can_CompuMethods_Can_CompuMethod_CtrlId 0.0 2. FORMAT "%5.0" /end CHARACTERISTIC
/begin CHARACTERISTIC Can_XcpTx_Var_CANCCanNod_C "Calibration parameter to calibrate Message XcpTx_Var_CANC on different Can Node." VALUE 0x804D8587 DefaultValueRecordLayout_AUTOSAR_Platform_BaseTypes_uint8 2.0 Mcan_Can_CompuMethods_Can_CompuMethod_CtrlId 0.0 2. FORMAT "%5.0" /end CHARACTERISTIC
/begin CHARACTERISTIC Can_XcpTx_Var_VEHICLECanNod_C "Calibration parameter to calibrate Message XcpTx_Var_VEHICLE on different Can Node." VALUE 0x804D8586 DefaultValueRecordLayout_AUTOSAR_Platform_BaseTypes_uint8 2.0 Mcan_Can_CompuMethods_Can_CompuMethod_CtrlId 0.0 2. FORMAT "%5.0" /end CHARACTERISTIC
/begin CHARACTERISTIC rba_Etks_swt3rdPartySupp_C "Enable 3rd party tool support for Etks" VALUE 0x804D8585 DefaultValueRecordLayout_AUTOSAR_Platform_BaseTypes_uint8 255.0 RB_RBA_Common_CentralElements_CompuMethods_Identical 0.0 255. FORMAT "%5.0" /end CHARACTERISTIC
/begin CHARACTERISTIC rba_IoDiagPwr_Config_rba_IoExtCy329_SignalMrly_0_BattVltgThres_C "Calibration for Battey Voltage Threshold rba_IoExtCy329_SignalMrly_0 in the post build config set rba_IoDiagPwr_Config" VALUE 0x804D82E8 DefaultValueRecordLayout_AUTOSAR_Platform_BaseTypes_uint32 4.0E9 RB_RBA_rba_IoDiagPwr_CompuMethod_rba_DiagPwr_BatteryThreshold_millivolts_CompuMethod 0.0 4.E9 FORMAT "%9.0" /end CHARACTERISTIC
/begin CHARACTERISTIC rba_IoDiagPwr_Config_rba_IoExtCy329_SignalMrly_0_TimeBtwTst_C "Calibration for Time Between Test Pulse rba_IoExtCy329_SignalMrly_0 in the post build config setrba_IoDiagPwr_Config" VALUE 0x804D8584 DefaultValueRecordLayout_AUTOSAR_Platform_BaseTypes_uint8 255.0 RB_RBA_rba_IoDiagPwr_CompuMethod_rba_DiagPwr_DelayTest_100ms_CompuMethod 0.0 255. FORMAT "%9.0" /end CHARACTERISTIC
/begin CHARACTERISTIC rba_IoSigDio_BrkMn_I_D_C "HW signal path for signal BrkMn_I_D in the post build config set __DEFAULT_VARIANT__" VALUE 0x804D84A6 DefaultValueRecordLayout_AUTOSAR_Platform_BaseTypes_uint16 27.0 RB_RBA_rba_IoSigDio_CompuMethods_rba_IoSigDio_HWSigPathCompuMethod 0.0 27. FORMAT "%9.0" /end CHARACTERISTIC
/begin CHARACTERISTIC rba_IoSigDio_swtMrlyDCInv_C "Signal state inversion for signal MrlyDC in the post build config set __DEFAULT_VARIANT__" VALUE 0x804D8583 DefaultValueRecordLayout_AUTOSAR_Platform_BaseTypes_boolean 1.0 RB_RBA_rba_IoSigDio_CompuMethods_rba_IoSigDio_InvertCompuMethod 0.0 1. FORMAT "%9.0" /end CHARACTERISTIC
/begin CHARACTERISTIC rba_IoSigRtc_stDiagErrInject_StopCounter_C "error inject param for signal StopCounter" VALUE 0x804D84A4 DefaultValueRecordLayout_AUTOSAR_Platform_BaseTypes_uint16 8.0 RB_RBA_rba_IoSigRtc_CompuMethods_rba_IoSigRtc_DiagErrInjectCompuMethod 0.0 8. FORMAT "%9.0" /end CHARACTERISTIC
/begin CHARACTERISTIC rba_MRly_Diag_Stk_tiOkError_C "Debounce time of main relay sticky diagnosis for detecting an error" VALUE 0x804D82E4 DefaultValueRecordLayout_AUTOSAR_Platform_BaseTypes_uint32 3000.0 RB_RBA_rba_MRly_BswModuleDescriptions_rba_MRly_Calibration_Common_milliseconds_CompuMethod 0.0 3000. FORMAT "%5.0" /end CHARACTERISTIC
/begin CHARACTERISTIC rba_MRly_Sens_Measd_tiHiLo_C "Debounce time of main relay actual state measured. Time to open the main relay in ms" VALUE 0x804D82E0 DefaultValueRecordLayout_AUTOSAR_Platform_BaseTypes_uint32 200.0 RB_RBA_rba_MRly_BswModuleDescriptions_rba_MRly_Calibration_Common_milliseconds_CompuMethod 0.0 200. FORMAT "%5.0" /end CHARACTERISTIC
/begin CHARACTERISTIC rba_MRly_Sens_Measd_tiLoHi_C "Debounce time of main relay actual state measured. Time to close the main relay in ms" VALUE 0x804D82DC DefaultValueRecordLayout_AUTOSAR_Platform_BaseTypes_uint32 200.0 RB_RBA_rba_MRly_BswModuleDescriptions_rba_MRly_Calibration_Common_milliseconds_CompuMethod 0.0 200. FORMAT "%5.0" /end CHARACTERISTIC
/begin CHARACTERISTIC rba_MRly_Sens_Measd_uBattClosedThr_C "Battery voltage threshold to detect the main relay as closed" VALUE 0x804D82D8 DefaultValueRecordLayout_AUTOSAR_Platform_BaseTypes_uint32 30000.0 RB_RBA_rba_MRly_BswModuleDescriptions_rba_MRly_Sens_Measd_uBattClosedThr_millivolts_CompuMethod 0.0 30000. FORMAT "%5.0" /end CHARACTERISTIC
/begin CHARACTERISTIC rba_MultiStackTrace_ResetMaxValues "Reset max stack values saved in NvM" VALUE 0x804D8582 DefaultValueRecordLayout_AUTOSAR_Platform_BaseTypes_uint8 1.0 RB_RBA_Common_CentralElements_CompuMethods_Identical 0.0 1. FORMAT "%5.0" /end CHARACTERISTIC
/begin CHARACTERISTIC rba_MultiStackTrace_ThresholdSwitch "Select the Stack Limit Threshold Range from 0-5" VALUE 0x804D8581 DefaultValueRecordLayout_AUTOSAR_Platform_BaseTypes_uint8 5.0 RB_RBA_Common_CentralElements_CompuMethods_Identical 0.0 5. FORMAT "%5.0" /end CHARACTERISTIC
/begin CHARACTERISTIC rba_OsMeasmt_CoreLoadThresholdValue_C "Set a Threshold CoreLoad value for the dem event generation" VALUE 0x804D84A2 DefaultValueRecordLayout_AUTOSAR_Platform_BaseTypes_uint16 655.0 RB_RBA_rba_OsMeasmt_CompuMethods_rba_OsMeasmt_PercConversion 0.0 655.00 FORMAT "%5.2" /end CHARACTERISTIC
/begin CHARACTERISTIC rba_OsMeasmt_ResetMaxCoreLoadValues_C "Reset max core load values saved in NvM" VALUE 0x804D8580 DefaultValueRecordLayout_AUTOSAR_Platform_BaseTypes_uint8 1.0 RB_RBA_Common_CentralElements_CompuMethods_Identical 0.0 1. FORMAT "%5.0" /end CHARACTERISTIC
/begin CHARACTERISTIC rba_OsMeasmt_ResetResponseTimeValues_C "Reset max response time values saved in NvM" VALUE 0x804D857F DefaultValueRecordLayout_AUTOSAR_Platform_BaseTypes_uint8 1.0 RB_RBA_Common_CentralElements_CompuMethods_Identical 0.0 1. FORMAT "%5.0" /end CHARACTERISTIC
/begin CHARACTERISTIC rba_OsMeasmt_SwTrace_InitMode_C "Init mode which shall be used for the rba_SwTrace / Gliwa T1 initialization" VALUE 0x804D857E DefaultValueRecordLayout_AUTOSAR_Platform_BaseTypes_uint8 2.0 RB_RBA_rba_OsMeasmt_CompuMethods_rba_OsMeasmt_SwTrace_InitMode_CompuMethod 0.0 2. FORMAT "%5.0" /end CHARACTERISTIC
/begin MEASUREMENT rba_CanMcan_DriverState_MP "Flag to check if CAN driver is Initialized(CAN_READY(TRUE)) or Not Initialized (CAN_UNINIT(FALSE))" UBYTE RB_RBA_Common_CentralElements_CompuMethods_Identical 1 100 0.0 1. FORMAT "%5.0" ECU_ADDRESS 0x700025CE /end MEASUREMENT
/begin MEASUREMENT rba_CanMcan_MsgStatus_MP "This variable value describes the CAN message buffer status. The value is 1 if the message transmission is initiated and is reset(value 0) after the confirmation is given for the same." UBYTE RB_RBA_Common_CentralElements_CompuMethods_Identical 1 100 0.0 255. FORMAT "%5.0" ARRAY_SIZE 52 ECU_ADDRESS 0x6000AC1C /end MEASUREMENT
/begin MEASUREMENT rba_MRly_Ctrl_State_MP "Current control state of Main Relay" UBYTE RB_RBA_rba_MRly_BswModuleDescriptions_rba_MRly_Ctrl_States_CompuMethod 1 100 0.0 1.000 FORMAT "%8.3" ECU_ADDRESS 0x700093B7
 /begin ANNOTATION ANNOTATION_LABEL "Description (coming from AUTOSAR DESC field)" /begin ANNOTATION_TEXT "Current control state of Main Relay\r\n" /end ANNOTATION_TEXT /end ANNOTATION
/end MEASUREMENT
/begin MEASUREMENT rba_MultiStackTrace_CurrentCycleMaxUsage_CSA0 "Current Cycle Max Usage stack Csa0" UWORD RB_RBA_rba_OsMeasmt_CompuMethods_rba_OsMeasmt_PercConversion 1 100 0.0 655. FORMAT "%5.0" ECU_ADDRESS 0x6000571C /end MEASUREMENT
/begin MEASUREMENT rba_MultiStackTrace_CurrentCycleMaxUsage_CSA1 "Current Cycle Max Usage stack Csa1" UWORD RB_RBA_rba_OsMeasmt_CompuMethods_rba_OsMeasmt_PercConversion 1 100 0.0 655. FORMAT "%5.0" ECU_ADDRESS 0x6000571A /end MEASUREMENT
/begin MEASUREMENT rba_MultiStackTrace_CurrentCycleMaxUsage_CSA2 "Current Cycle Max Usage stack Csa2" UWORD RB_RBA_rba_OsMeasmt_CompuMethods_rba_OsMeasmt_PercConversion 1 100 0.0 655. FORMAT "%5.0" ECU_ADDRESS 0x60005718 /end MEASUREMENT
/begin MEASUREMENT rba_MultiStackTrace_CurrentCycleMaxUsage_User0 "Current Cycle Max Usage stack User0" UWORD RB_RBA_rba_OsMeasmt_CompuMethods_rba_OsMeasmt_PercConversion 1 100 0.0 655. FORMAT "%5.0" ECU_ADDRESS 0x60005722 /end MEASUREMENT
/begin MEASUREMENT rba_MultiStackTrace_CurrentCycleMaxUsage_User1 "Current Cycle Max Usage stack User1" UWORD RB_RBA_rba_OsMeasmt_CompuMethods_rba_OsMeasmt_PercConversion 1 100 0.0 655. FORMAT "%5.0" ECU_ADDRESS 0x60005720 /end MEASUREMENT
/begin MEASUREMENT rba_MultiStackTrace_CurrentCycleMaxUsage_User2 "Current Cycle Max Usage stack User2" UWORD RB_RBA_rba_OsMeasmt_CompuMethods_rba_OsMeasmt_PercConversion 1 100 0.0 655. FORMAT "%5.0" ECU_ADDRESS 0x6000571E /end MEASUREMENT
/begin MEASUREMENT rba_MultiStackTrace_LifeTimeMaxUsage_CSA0 "Life Time Max Usage stack CSA0" UWORD RB_RBA_rba_OsMeasmt_CompuMethods_rba_OsMeasmt_PercConversion 1 100 0.0 655. FORMAT "%5.0" ECU_ADDRESS 0x600340D6 /end MEASUREMENT
/begin MEASUREMENT rba_MultiStackTrace_LifeTimeMaxUsage_CSA1 "Life Time Max Usage stack CSA1" UWORD RB_RBA_rba_OsMeasmt_CompuMethods_rba_OsMeasmt_PercConversion 1 100 0.0 655. FORMAT "%5.0" ECU_ADDRESS 0x600340D4 /end MEASUREMENT
/begin MEASUREMENT rba_MultiStackTrace_LifeTimeMaxUsage_CSA2 "Life Time Max Usage stack CSA2" UWORD RB_RBA_rba_OsMeasmt_CompuMethods_rba_OsMeasmt_PercConversion 1 100 0.0 655. FORMAT "%5.0" ECU_ADDRESS 0x600340D2 /end MEASUREMENT
/begin MEASUREMENT rba_MultiStackTrace_LifeTimeMaxUsage_User0 "Life Time Max Usage stack User0" UWORD RB_RBA_rba_OsMeasmt_CompuMethods_rba_OsMeasmt_PercConversion 1 100 0.0 655. FORMAT "%5.0" ECU_ADDRESS 0x600340DC /end MEASUREMENT
/begin MEASUREMENT rba_MultiStackTrace_LifeTimeMaxUsage_User1 "Life Time Max Usage stack User1" UWORD RB_RBA_rba_OsMeasmt_CompuMethods_rba_OsMeasmt_PercConversion 1 100 0.0 655. FORMAT "%5.0" ECU_ADDRESS 0x600340DA /end MEASUREMENT
/begin MEASUREMENT rba_MultiStackTrace_LifeTimeMaxUsage_User2 "Life Time Max Usage stack User2" UWORD RB_RBA_rba_OsMeasmt_CompuMethods_rba_OsMeasmt_PercConversion 1 100 0.0 655. FORMAT "%5.0" ECU_ADDRESS 0x600340D8 /end MEASUREMENT
/begin MEASUREMENT rba_MultiStackTrace_ThresholdTable "Threshold table for Configured Limits" UWORD RB_RBA_Common_CentralElements_CompuMethods_Identical 1 100 0.0 65535. FORMAT "%5.0" ARRAY_SIZE 6 ECU_ADDRESS 0x700025BE /end MEASUREMENT
/begin MEASUREMENT rba_OsMeasmt_CoreLoad[0].current "Core load Os measurement for each core[0]/" UWORD RB_RBA_rba_OsMeasmt_CompuMethods_rba_OsMeasmt_PercConversion 1 100 0.0 655.00 FORMAT "%5.2" ECU_ADDRESS 0x500008DA /end MEASUREMENT
/begin MEASUREMENT rba_OsMeasmt_CoreLoad[1].current "Core load Os measurement for each core[1]/" UWORD RB_RBA_rba_OsMeasmt_CompuMethods_rba_OsMeasmt_PercConversion 1 100 0.0 655.00 FORMAT "%5.2" ECU_ADDRESS 0x500008E0 /end MEASUREMENT
/begin MEASUREMENT rba_OsMeasmt_CoreLoad[2].current "Core load Os measurement for each core[2]/" UWORD RB_RBA_rba_OsMeasmt_CompuMethods_rba_OsMeasmt_PercConversion 1 100 0.0 655.00 FORMAT "%5.2" ECU_ADDRESS 0x500008E6 /end MEASUREMENT
/begin MEASUREMENT rba_OsMeasmt_CoreLoad[0].curCycleMax "Core load Os measurement for each core[0]/" UWORD RB_RBA_rba_OsMeasmt_CompuMethods_rba_OsMeasmt_PercConversion 1 100 0.0 655.00 FORMAT "%5.2" ECU_ADDRESS 0x500008DC /end MEASUREMENT
/begin MEASUREMENT rba_OsMeasmt_CoreLoad[1].curCycleMax "Core load Os measurement for each core[1]/" UWORD RB_RBA_rba_OsMeasmt_CompuMethods_rba_OsMeasmt_PercConversion 1 100 0.0 655.00 FORMAT "%5.2" ECU_ADDRESS 0x500008E2 /end MEASUREMENT
/begin MEASUREMENT rba_OsMeasmt_CoreLoad[2].curCycleMax "Core load Os measurement for each core[2]/" UWORD RB_RBA_rba_OsMeasmt_CompuMethods_rba_OsMeasmt_PercConversion 1 100 0.0 655.00 FORMAT "%5.2" ECU_ADDRESS 0x500008E8 /end MEASUREMENT
/begin MEASUREMENT rba_OsMeasmt_CoreLoad[0].lifeTimeMax "Core load Os measurement for each core[0]/" UWORD RB_RBA_rba_OsMeasmt_CompuMethods_rba_OsMeasmt_PercConversion 1 100 0.0 655.00 FORMAT "%5.2" ECU_ADDRESS 0x500008DE /end MEASUREMENT
/begin MEASUREMENT rba_OsMeasmt_CoreLoad[1].lifeTimeMax "Core load Os measurement for each core[1]/" UWORD RB_RBA_rba_OsMeasmt_CompuMethods_rba_OsMeasmt_PercConversion 1 100 0.0 655.00 FORMAT "%5.2" ECU_ADDRESS 0x500008E4 /end MEASUREMENT
/begin MEASUREMENT rba_OsMeasmt_CoreLoad[2].lifeTimeMax "Core load Os measurement for each core[2]/" UWORD RB_RBA_rba_OsMeasmt_CompuMethods_rba_OsMeasmt_PercConversion 1 100 0.0 655.00 FORMAT "%5.2" ECU_ADDRESS 0x500008EA /end MEASUREMENT
/begin MEASUREMENT rba_OsMeasmt_OS_1000ms_Task.RespTimeCurrent "Task response time monitoring for OS_1000ms_Task/" ULONG RB_RBA_rba_OsMeasmt_CompuMethods_rba_OsMeasmt_TaskRespTime_CompuMethod 1 100 0.0 4.294967200E7 FORMAT "%13.9" ECU_ADDRESS 0x6000F3F8 /end MEASUREMENT
/begin MEASUREMENT rba_OsMeasmt_OS_1000ms_Task.RespTimeCycleMax "Task response time monitoring for OS_1000ms_Task/" ULONG RB_RBA_rba_OsMeasmt_CompuMethods_rba_OsMeasmt_TaskRespTime_CompuMethod 1 100 0.0 4.294967200E7 FORMAT "%13.9" ECU_ADDRESS 0x6000F3FC /end MEASUREMENT
/begin MEASUREMENT rba_OsMeasmt_OS_1000ms_Task.RespTimeLifetimeMax "Task response time monitoring for OS_1000ms_Task/" ULONG RB_RBA_rba_OsMeasmt_CompuMethods_rba_OsMeasmt_TaskRespTime_CompuMethod 1 100 0.0 4.294967200E7 FORMAT "%13.9" ECU_ADDRESS 0x6000F400 /end MEASUREMENT
/begin MEASUREMENT rba_OsMeasmt_OS_1000ms_Task.CETCurrent "Task response time monitoring for OS_1000ms_Task/" ULONG RB_RBA_rba_OsMeasmt_CompuMethods_rba_OsMeasmt_CET_T1_CompuMethod 1 100 0.0 4.294967200E7 FORMAT "%13.9" ECU_ADDRESS 0x6000F404 /end MEASUREMENT
/begin MEASUREMENT rba_OsMeasmt_OS_1000ms_Task.CETCycleMax "Task response time monitoring for OS_1000ms_Task/" ULONG RB_RBA_rba_OsMeasmt_CompuMethods_rba_OsMeasmt_CET_T1_CompuMethod 1 100 0.0 4.294967200E7 FORMAT "%13.9" ECU_ADDRESS 0x6000F408 /end MEASUREMENT
/begin MEASUREMENT rba_OsMeasmt_OS_1000ms_Task.CETCurrentLoad "Task response time monitoring for OS_1000ms_Task/" UWORD RB_RBA_rba_OsMeasmt_CompuMethods_rba_OsMeasmt_T1_PercConversion 1 100 0.0 655.00 FORMAT "%5.2" ECU_ADDRESS 0x6000F40C /end MEASUREMENT
/begin MEASUREMENT rba_OsMeasmt_OS_1000ms_Task.CETCurrentLoadMax "Task response time monitoring for OS_1000ms_Task/" UWORD RB_RBA_rba_OsMeasmt_CompuMethods_rba_OsMeasmt_T1_PercConversion 1 100 0.0 655.00 FORMAT "%5.2" ECU_ADDRESS 0x6000F40E /end MEASUREMENT
/begin MEASUREMENT rba_OsMeasmt_OS_100ms_Task.RespTimeCurrent "Task response time monitoring for OS_100ms_Task/" ULONG RB_RBA_rba_OsMeasmt_CompuMethods_rba_OsMeasmt_TaskRespTime_CompuMethod 1 100 0.0 4.294967200E7 FORMAT "%13.9" ECU_ADDRESS 0x6000F3E0 /end MEASUREMENT
/begin MEASUREMENT rba_OsMeasmt_OS_100ms_Task.RespTimeCycleMax "Task response time monitoring for OS_100ms_Task/" ULONG RB_RBA_rba_OsMeasmt_CompuMethods_rba_OsMeasmt_TaskRespTime_CompuMethod 1 100 0.0 4.294967200E7 FORMAT "%13.9" ECU_ADDRESS 0x6000F3E4 /end MEASUREMENT
/begin MEASUREMENT rba_OsMeasmt_OS_100ms_Task.RespTimeLifetimeMax "Task response time monitoring for OS_100ms_Task/" ULONG RB_RBA_rba_OsMeasmt_CompuMethods_rba_OsMeasmt_TaskRespTime_CompuMethod 1 100 0.0 4.294967200E7 FORMAT "%13.9" ECU_ADDRESS 0x6000F3E8 /end MEASUREMENT
/begin MEASUREMENT rba_OsMeasmt_OS_100ms_Task.CETCurrent "Task response time monitoring for OS_100ms_Task/" ULONG RB_RBA_rba_OsMeasmt_CompuMethods_rba_OsMeasmt_CET_T1_CompuMethod 1 100 0.0 4.294967200E7 FORMAT "%13.9" ECU_ADDRESS 0x6000F3EC /end MEASUREMENT
/begin MEASUREMENT rba_OsMeasmt_OS_100ms_Task.CETCycleMax "Task response time monitoring for OS_100ms_Task/" ULONG RB_RBA_rba_OsMeasmt_CompuMethods_rba_OsMeasmt_CET_T1_CompuMethod 1 100 0.0 4.294967200E7 FORMAT "%13.9" ECU_ADDRESS 0x6000F3F0 /end MEASUREMENT
/begin MEASUREMENT rba_OsMeasmt_OS_100ms_Task.CETCurrentLoad "Task response time monitoring for OS_100ms_Task/" UWORD RB_RBA_rba_OsMeasmt_CompuMethods_rba_OsMeasmt_T1_PercConversion 1 100 0.0 655.00 FORMAT "%5.2" ECU_ADDRESS 0x6000F3F4 /end MEASUREMENT
/begin MEASUREMENT rba_OsMeasmt_OS_100ms_Task.CETCurrentLoadMax "Task response time monitoring for OS_100ms_Task/" UWORD RB_RBA_rba_OsMeasmt_CompuMethods_rba_OsMeasmt_T1_PercConversion 1 100 0.0 655.00 FORMAT "%5.2" ECU_ADDRESS 0x6000F3F6 /end MEASUREMENT
/begin MEASUREMENT rba_OsMeasmt_OS_10ms_Task.RespTimeCurrent "Task response time monitoring for OS_10ms_Task/" ULONG RB_RBA_rba_OsMeasmt_CompuMethods_rba_OsMeasmt_TaskRespTime_CompuMethod 1 100 0.0 4.294967200E7 FORMAT "%13.9" ECU_ADDRESS 0x6000F3C8 /end MEASUREMENT
/begin MEASUREMENT rba_OsMeasmt_OS_10ms_Task.RespTimeCycleMax "Task response time monitoring for OS_10ms_Task/" ULONG RB_RBA_rba_OsMeasmt_CompuMethods_rba_OsMeasmt_TaskRespTime_CompuMethod 1 100 0.0 4.294967200E7 FORMAT "%13.9" ECU_ADDRESS 0x6000F3CC /end MEASUREMENT
/begin MEASUREMENT rba_OsMeasmt_OS_10ms_Task.RespTimeLifetimeMax "Task response time monitoring for OS_10ms_Task/" ULONG RB_RBA_rba_OsMeasmt_CompuMethods_rba_OsMeasmt_TaskRespTime_CompuMethod 1 100 0.0 4.294967200E7 FORMAT "%13.9" ECU_ADDRESS 0x6000F3D0 /end MEASUREMENT
/begin MEASUREMENT rba_OsMeasmt_OS_10ms_Task.CETCurrent "Task response time monitoring for OS_10ms_Task/" ULONG RB_RBA_rba_OsMeasmt_CompuMethods_rba_OsMeasmt_CET_T1_CompuMethod 1 100 0.0 4.294967200E7 FORMAT "%13.9" ECU_ADDRESS 0x6000F3D4 /end MEASUREMENT
/begin MEASUREMENT rba_OsMeasmt_OS_10ms_Task.CETCycleMax "Task response time monitoring for OS_10ms_Task/" ULONG RB_RBA_rba_OsMeasmt_CompuMethods_rba_OsMeasmt_CET_T1_CompuMethod 1 100 0.0 4.294967200E7 FORMAT "%13.9" ECU_ADDRESS 0x6000F3D8 /end MEASUREMENT
/begin MEASUREMENT rba_OsMeasmt_OS_10ms_Task.CETCurrentLoad "Task response time monitoring for OS_10ms_Task/" UWORD RB_RBA_rba_OsMeasmt_CompuMethods_rba_OsMeasmt_T1_PercConversion 1 100 0.0 655.00 FORMAT "%5.2" ECU_ADDRESS 0x6000F3DC /end MEASUREMENT
/begin MEASUREMENT rba_OsMeasmt_OS_10ms_Task.CETCurrentLoadMax "Task response time monitoring for OS_10ms_Task/" UWORD RB_RBA_rba_OsMeasmt_CompuMethods_rba_OsMeasmt_T1_PercConversion 1 100 0.0 655.00 FORMAT "%5.2" ECU_ADDRESS 0x6000F3DE /end MEASUREMENT
/begin MEASUREMENT rba_OsMeasmt_OS_1ms_Task.RespTimeCurrent "Task response time monitoring for OS_1ms_Task/" ULONG RB_RBA_rba_OsMeasmt_CompuMethods_rba_OsMeasmt_TaskRespTime_CompuMethod 1 100 0.0 4.294967200E7 FORMAT "%13.9" ECU_ADDRESS 0x6000F3B0 /end MEASUREMENT
/begin MEASUREMENT rba_OsMeasmt_OS_1ms_Task.RespTimeCycleMax "Task response time monitoring for OS_1ms_Task/" ULONG RB_RBA_rba_OsMeasmt_CompuMethods_rba_OsMeasmt_TaskRespTime_CompuMethod 1 100 0.0 4.294967200E7 FORMAT "%13.9" ECU_ADDRESS 0x6000F3B4 /end MEASUREMENT
/begin MEASUREMENT rba_OsMeasmt_OS_1ms_Task.RespTimeLifetimeMax "Task response time monitoring for OS_1ms_Task/" ULONG RB_RBA_rba_OsMeasmt_CompuMethods_rba_OsMeasmt_TaskRespTime_CompuMethod 1 100 0.0 4.294967200E7 FORMAT "%13.9" ECU_ADDRESS 0x6000F3B8 /end MEASUREMENT
/begin MEASUREMENT rba_OsMeasmt_OS_1ms_Task.CETCurrent "Task response time monitoring for OS_1ms_Task/" ULONG RB_RBA_rba_OsMeasmt_CompuMethods_rba_OsMeasmt_CET_T1_CompuMethod 1 100 0.0 4.294967200E7 FORMAT "%13.9" ECU_ADDRESS 0x6000F3BC /end MEASUREMENT
/begin MEASUREMENT rba_OsMeasmt_OS_1ms_Task.CETCycleMax "Task response time monitoring for OS_1ms_Task/" ULONG RB_RBA_rba_OsMeasmt_CompuMethods_rba_OsMeasmt_CET_T1_CompuMethod 1 100 0.0 4.294967200E7 FORMAT "%13.9" ECU_ADDRESS 0x6000F3C0 /end MEASUREMENT
/begin MEASUREMENT rba_OsMeasmt_OS_1ms_Task.CETCurrentLoad "Task response time monitoring for OS_1ms_Task/" UWORD RB_RBA_rba_OsMeasmt_CompuMethods_rba_OsMeasmt_T1_PercConversion 1 100 0.0 655.00 FORMAT "%5.2" ECU_ADDRESS 0x6000F3C4 /end MEASUREMENT
/begin MEASUREMENT rba_OsMeasmt_OS_1ms_Task.CETCurrentLoadMax "Task response time monitoring for OS_1ms_Task/" UWORD RB_RBA_rba_OsMeasmt_CompuMethods_rba_OsMeasmt_T1_PercConversion 1 100 0.0 655.00 FORMAT "%5.2" ECU_ADDRESS 0x6000F3C6 /end MEASUREMENT
/begin MEASUREMENT rba_OsMeasmt_OS_200ms_Task.RespTimeCurrent "Task response time monitoring for OS_200ms_Task/" ULONG RB_RBA_rba_OsMeasmt_CompuMethods_rba_OsMeasmt_TaskRespTime_CompuMethod 1 100 0.0 4.294967200E7 FORMAT "%13.9" ECU_ADDRESS 0x6000F398 /end MEASUREMENT
/begin MEASUREMENT rba_OsMeasmt_OS_200ms_Task.RespTimeCycleMax "Task response time monitoring for OS_200ms_Task/" ULONG RB_RBA_rba_OsMeasmt_CompuMethods_rba_OsMeasmt_TaskRespTime_CompuMethod 1 100 0.0 4.294967200E7 FORMAT "%13.9" ECU_ADDRESS 0x6000F39C /end MEASUREMENT
/begin MEASUREMENT rba_OsMeasmt_OS_200ms_Task.RespTimeLifetimeMax "Task response time monitoring for OS_200ms_Task/" ULONG RB_RBA_rba_OsMeasmt_CompuMethods_rba_OsMeasmt_TaskRespTime_CompuMethod 1 100 0.0 4.294967200E7 FORMAT "%13.9" ECU_ADDRESS 0x6000F3A0 /end MEASUREMENT
/begin MEASUREMENT rba_OsMeasmt_OS_200ms_Task.CETCurrent "Task response time monitoring for OS_200ms_Task/" ULONG RB_RBA_rba_OsMeasmt_CompuMethods_rba_OsMeasmt_CET_T1_CompuMethod 1 100 0.0 4.294967200E7 FORMAT "%13.9" ECU_ADDRESS 0x6000F3A4 /end MEASUREMENT
/begin MEASUREMENT rba_OsMeasmt_OS_200ms_Task.CETCycleMax "Task response time monitoring for OS_200ms_Task/" ULONG RB_RBA_rba_OsMeasmt_CompuMethods_rba_OsMeasmt_CET_T1_CompuMethod 1 100 0.0 4.294967200E7 FORMAT "%13.9" ECU_ADDRESS 0x6000F3A8 /end MEASUREMENT
/begin MEASUREMENT rba_OsMeasmt_OS_200ms_Task.CETCurrentLoad "Task response time monitoring for OS_200ms_Task/" UWORD RB_RBA_rba_OsMeasmt_CompuMethods_rba_OsMeasmt_T1_PercConversion 1 100 0.0 655.00 FORMAT "%5.2" ECU_ADDRESS 0x6000F3AC /end MEASUREMENT
/begin MEASUREMENT rba_OsMeasmt_OS_200ms_Task.CETCurrentLoadMax "Task response time monitoring for OS_200ms_Task/" UWORD RB_RBA_rba_OsMeasmt_CompuMethods_rba_OsMeasmt_T1_PercConversion 1 100 0.0 655.00 FORMAT "%5.2" ECU_ADDRESS 0x6000F3AE /end MEASUREMENT
/begin MEASUREMENT rba_OsMeasmt_OS_20ms_Task.RespTimeCurrent "Task response time monitoring for OS_20ms_Task/" ULONG RB_RBA_rba_OsMeasmt_CompuMethods_rba_OsMeasmt_TaskRespTime_CompuMethod 1 100 0.0 4.294967200E7 FORMAT "%13.9" ECU_ADDRESS 0x6000F380 /end MEASUREMENT
/begin MEASUREMENT rba_OsMeasmt_OS_20ms_Task.RespTimeCycleMax "Task response time monitoring for OS_20ms_Task/" ULONG RB_RBA_rba_OsMeasmt_CompuMethods_rba_OsMeasmt_TaskRespTime_CompuMethod 1 100 0.0 4.294967200E7 FORMAT "%13.9" ECU_ADDRESS 0x6000F384 /end MEASUREMENT
/begin MEASUREMENT rba_OsMeasmt_OS_20ms_Task.RespTimeLifetimeMax "Task response time monitoring for OS_20ms_Task/" ULONG RB_RBA_rba_OsMeasmt_CompuMethods_rba_OsMeasmt_TaskRespTime_CompuMethod 1 100 0.0 4.294967200E7 FORMAT "%13.9" ECU_ADDRESS 0x6000F388 /end MEASUREMENT
/begin MEASUREMENT rba_OsMeasmt_OS_20ms_Task.CETCurrent "Task response time monitoring for OS_20ms_Task/" ULONG RB_RBA_rba_OsMeasmt_CompuMethods_rba_OsMeasmt_CET_T1_CompuMethod 1 100 0.0 4.294967200E7 FORMAT "%13.9" ECU_ADDRESS 0x6000F38C /end MEASUREMENT
/begin MEASUREMENT rba_OsMeasmt_OS_20ms_Task.CETCycleMax "Task response time monitoring for OS_20ms_Task/" ULONG RB_RBA_rba_OsMeasmt_CompuMethods_rba_OsMeasmt_CET_T1_CompuMethod 1 100 0.0 4.294967200E7 FORMAT "%13.9" ECU_ADDRESS 0x6000F390 /end MEASUREMENT
/begin MEASUREMENT rba_OsMeasmt_OS_20ms_Task.CETCurrentLoad "Task response time monitoring for OS_20ms_Task/" UWORD RB_RBA_rba_OsMeasmt_CompuMethods_rba_OsMeasmt_T1_PercConversion 1 100 0.0 655.00 FORMAT "%5.2" ECU_ADDRESS 0x6000F394 /end MEASUREMENT
/begin MEASUREMENT rba_OsMeasmt_OS_20ms_Task.CETCurrentLoadMax "Task response time monitoring for OS_20ms_Task/" UWORD RB_RBA_rba_OsMeasmt_CompuMethods_rba_OsMeasmt_T1_PercConversion 1 100 0.0 655.00 FORMAT "%5.2" ECU_ADDRESS 0x6000F396 /end MEASUREMENT
/begin MEASUREMENT rba_OsMeasmt_OS_2ms_Task.RespTimeCurrent "Task response time monitoring for OS_2ms_Task/" ULONG RB_RBA_rba_OsMeasmt_CompuMethods_rba_OsMeasmt_TaskRespTime_CompuMethod 1 100 0.0 4.294967200E7 FORMAT "%13.9" ECU_ADDRESS 0x6000F368 /end MEASUREMENT
/begin MEASUREMENT rba_OsMeasmt_OS_2ms_Task.RespTimeCycleMax "Task response time monitoring for OS_2ms_Task/" ULONG RB_RBA_rba_OsMeasmt_CompuMethods_rba_OsMeasmt_TaskRespTime_CompuMethod 1 100 0.0 4.294967200E7 FORMAT "%13.9" ECU_ADDRESS 0x6000F36C /end MEASUREMENT
/begin MEASUREMENT rba_OsMeasmt_OS_2ms_Task.RespTimeLifetimeMax "Task response time monitoring for OS_2ms_Task/" ULONG RB_RBA_rba_OsMeasmt_CompuMethods_rba_OsMeasmt_TaskRespTime_CompuMethod 1 100 0.0 4.294967200E7 FORMAT "%13.9" ECU_ADDRESS 0x6000F370 /end MEASUREMENT
/begin MEASUREMENT rba_OsMeasmt_OS_2ms_Task.CETCurrent "Task response time monitoring for OS_2ms_Task/" ULONG RB_RBA_rba_OsMeasmt_CompuMethods_rba_OsMeasmt_CET_T1_CompuMethod 1 100 0.0 4.294967200E7 FORMAT "%13.9" ECU_ADDRESS 0x6000F374 /end MEASUREMENT
/begin MEASUREMENT rba_OsMeasmt_OS_2ms_Task.CETCycleMax "Task response time monitoring for OS_2ms_Task/" ULONG RB_RBA_rba_OsMeasmt_CompuMethods_rba_OsMeasmt_CET_T1_CompuMethod 1 100 0.0 4.294967200E7 FORMAT "%13.9" ECU_ADDRESS 0x6000F378 /end MEASUREMENT
/begin MEASUREMENT rba_OsMeasmt_OS_2ms_Task.CETCurrentLoad "Task response time monitoring for OS_2ms_Task/" UWORD RB_RBA_rba_OsMeasmt_CompuMethods_rba_OsMeasmt_T1_PercConversion 1 100 0.0 655.00 FORMAT "%5.2" ECU_ADDRESS 0x6000F37C /end MEASUREMENT
/begin MEASUREMENT rba_OsMeasmt_OS_2ms_Task.CETCurrentLoadMax "Task response time monitoring for OS_2ms_Task/" UWORD RB_RBA_rba_OsMeasmt_CompuMethods_rba_OsMeasmt_T1_PercConversion 1 100 0.0 655.00 FORMAT "%5.2" ECU_ADDRESS 0x6000F37E /end MEASUREMENT
/begin MEASUREMENT rba_OsMeasmt_OS_50ms_Task.RespTimeCurrent "Task response time monitoring for OS_50ms_Task/" ULONG RB_RBA_rba_OsMeasmt_CompuMethods_rba_OsMeasmt_TaskRespTime_CompuMethod 1 100 0.0 4.294967200E7 FORMAT "%13.9" ECU_ADDRESS 0x6000F350 /end MEASUREMENT
/begin MEASUREMENT rba_OsMeasmt_OS_50ms_Task.RespTimeCycleMax "Task response time monitoring for OS_50ms_Task/" ULONG RB_RBA_rba_OsMeasmt_CompuMethods_rba_OsMeasmt_TaskRespTime_CompuMethod 1 100 0.0 4.294967200E7 FORMAT "%13.9" ECU_ADDRESS 0x6000F354 /end MEASUREMENT
/begin MEASUREMENT rba_OsMeasmt_OS_50ms_Task.RespTimeLifetimeMax "Task response time monitoring for OS_50ms_Task/" ULONG RB_RBA_rba_OsMeasmt_CompuMethods_rba_OsMeasmt_TaskRespTime_CompuMethod 1 100 0.0 4.294967200E7 FORMAT "%13.9" ECU_ADDRESS 0x6000F358 /end MEASUREMENT
/begin MEASUREMENT rba_OsMeasmt_OS_50ms_Task.CETCurrent "Task response time monitoring for OS_50ms_Task/" ULONG RB_RBA_rba_OsMeasmt_CompuMethods_rba_OsMeasmt_CET_T1_CompuMethod 1 100 0.0 4.294967200E7 FORMAT "%13.9" ECU_ADDRESS 0x6000F35C /end MEASUREMENT
/begin MEASUREMENT rba_OsMeasmt_OS_50ms_Task.CETCycleMax "Task response time monitoring for OS_50ms_Task/" ULONG RB_RBA_rba_OsMeasmt_CompuMethods_rba_OsMeasmt_CET_T1_CompuMethod 1 100 0.0 4.294967200E7 FORMAT "%13.9" ECU_ADDRESS 0x6000F360 /end MEASUREMENT
/begin MEASUREMENT rba_OsMeasmt_OS_50ms_Task.CETCurrentLoad "Task response time monitoring for OS_50ms_Task/" UWORD RB_RBA_rba_OsMeasmt_CompuMethods_rba_OsMeasmt_T1_PercConversion 1 100 0.0 655.00 FORMAT "%5.2" ECU_ADDRESS 0x6000F364 /end MEASUREMENT
/begin MEASUREMENT rba_OsMeasmt_OS_50ms_Task.CETCurrentLoadMax "Task response time monitoring for OS_50ms_Task/" UWORD RB_RBA_rba_OsMeasmt_CompuMethods_rba_OsMeasmt_T1_PercConversion 1 100 0.0 655.00 FORMAT "%5.2" ECU_ADDRESS 0x6000F366 /end MEASUREMENT
/begin MEASUREMENT rba_OsMeasmt_OS_5ms_Task.RespTimeCurrent "Task response time monitoring for OS_5ms_Task/" ULONG RB_RBA_rba_OsMeasmt_CompuMethods_rba_OsMeasmt_TaskRespTime_CompuMethod 1 100 0.0 4.294967200E7 FORMAT "%13.9" ECU_ADDRESS 0x70005C68 /end MEASUREMENT
/begin MEASUREMENT rba_OsMeasmt_OS_5ms_Task.RespTimeCycleMax "Task response time monitoring for OS_5ms_Task/" ULONG RB_RBA_rba_OsMeasmt_CompuMethods_rba_OsMeasmt_TaskRespTime_CompuMethod 1 100 0.0 4.294967200E7 FORMAT "%13.9" ECU_ADDRESS 0x70005C6C /end MEASUREMENT
/begin MEASUREMENT rba_OsMeasmt_OS_5ms_Task.RespTimeLifetimeMax "Task response time monitoring for OS_5ms_Task/" ULONG RB_RBA_rba_OsMeasmt_CompuMethods_rba_OsMeasmt_TaskRespTime_CompuMethod 1 100 0.0 4.294967200E7 FORMAT "%13.9" ECU_ADDRESS 0x70005C70 /end MEASUREMENT
/begin MEASUREMENT rba_OsMeasmt_OS_5ms_Task.CETCurrent "Task response time monitoring for OS_5ms_Task/" ULONG RB_RBA_rba_OsMeasmt_CompuMethods_rba_OsMeasmt_CET_T1_CompuMethod 1 100 0.0 4.294967200E7 FORMAT "%13.9" ECU_ADDRESS 0x70005C74 /end MEASUREMENT
/begin MEASUREMENT rba_OsMeasmt_OS_5ms_Task.CETCycleMax "Task response time monitoring for OS_5ms_Task/" ULONG RB_RBA_rba_OsMeasmt_CompuMethods_rba_OsMeasmt_CET_T1_CompuMethod 1 100 0.0 4.294967200E7 FORMAT "%13.9" ECU_ADDRESS 0x70005C78 /end MEASUREMENT
/begin MEASUREMENT rba_OsMeasmt_OS_5ms_Task.CETCurrentLoad "Task response time monitoring for OS_5ms_Task/" UWORD RB_RBA_rba_OsMeasmt_CompuMethods_rba_OsMeasmt_T1_PercConversion 1 100 0.0 655.00 FORMAT "%5.2" ECU_ADDRESS 0x70005C7C /end MEASUREMENT
/begin MEASUREMENT rba_OsMeasmt_OS_5ms_Task.CETCurrentLoadMax "Task response time monitoring for OS_5ms_Task/" UWORD RB_RBA_rba_OsMeasmt_CompuMethods_rba_OsMeasmt_T1_PercConversion 1 100 0.0 655.00 FORMAT "%5.2" ECU_ADDRESS 0x70005C7E /end MEASUREMENT
/begin MEASUREMENT rba_OsMeasmt_T1_CoreLoad[0].current "Core load T1 measurement for each core[0]/" UWORD RB_RBA_rba_OsMeasmt_CompuMethods_rba_OsMeasmt_T1_PercConversion 1 100 0.0 655.00 FORMAT "%5.2" ECU_ADDRESS 0x500008CE /end MEASUREMENT
/begin MEASUREMENT rba_OsMeasmt_T1_CoreLoad[1].current "Core load T1 measurement for each core[1]/" UWORD RB_RBA_rba_OsMeasmt_CompuMethods_rba_OsMeasmt_T1_PercConversion 1 100 0.0 655.00 FORMAT "%5.2" ECU_ADDRESS 0x500008D2 /end MEASUREMENT
/begin MEASUREMENT rba_OsMeasmt_T1_CoreLoad[2].current "Core load T1 measurement for each core[2]/" UWORD RB_RBA_rba_OsMeasmt_CompuMethods_rba_OsMeasmt_T1_PercConversion 1 100 0.0 655.00 FORMAT "%5.2" ECU_ADDRESS 0x500008D6 /end MEASUREMENT
/begin MEASUREMENT rba_OsMeasmt_T1_CoreLoad[0].curCycleMax "Core load T1 measurement for each core[0]/" UWORD RB_RBA_rba_OsMeasmt_CompuMethods_rba_OsMeasmt_T1_PercConversion 1 100 0.0 655.00 FORMAT "%5.2" ECU_ADDRESS 0x500008D0 /end MEASUREMENT
/begin MEASUREMENT rba_OsMeasmt_T1_CoreLoad[1].curCycleMax "Core load T1 measurement for each core[1]/" UWORD RB_RBA_rba_OsMeasmt_CompuMethods_rba_OsMeasmt_T1_PercConversion 1 100 0.0 655.00 FORMAT "%5.2" ECU_ADDRESS 0x500008D4 /end MEASUREMENT
/begin MEASUREMENT rba_OsMeasmt_T1_CoreLoad[2].curCycleMax "Core load T1 measurement for each core[2]/" UWORD RB_RBA_rba_OsMeasmt_CompuMethods_rba_OsMeasmt_T1_PercConversion 1 100 0.0 655.00 FORMAT "%5.2" ECU_ADDRESS 0x500008D8 /end MEASUREMENT
/begin FUNCTION Can "McFunction Can Created by MCFunctionUpdater"
 /begin DEF_CHARACTERISTIC Can_CanHwObject_AYCA_RXCanId_C Can_CanHwObject_AYCA_RXCanNod_C Can_CanHwObject_AYCD_RXCanId_C Can_CanHwObject_AYCD_RXCanNod_C Can_CanHwObject_AYCF_RXCanId_C Can_CanHwObject_AYCF_RXCanNod_C Can_CanHwObject_AYCG_RXCanId_C Can_CanHwObject_AYCG_RXCanNod_C Can_CanHwObject_AYCI_RXCanId_C Can_CanHwObject_AYCI_RXCanNod_C Can_CanHwObject_BCM1_RXCanId_C Can_CanHwObject_BCM1_RXCanNod_C Can_CanHwObject_CGW1_RXCanId_C Can_CanHwObject_CGW1_RXCanNod_C Can_CanHwObject_EAT10_RXCanId_C Can_CanHwObject_EAT10_RXCanNod_C Can_CanHwObject_EAT11_RXCanId_C Can_CanHwObject_EAT11_RXCanNod_C Can_CanHwObject_EAT12_RXCanId_C Can_CanHwObject_EAT12_RXCanNod_C Can_CanHwObject_EAT13_RXCanId_C Can_CanHwObject_EAT13_RXCanNod_C Can_CanHwObject_EAT1_RXCanId_C Can_CanHwObject_EAT1_RXCanNod_C Can_CanHwObject_EAT2_RXCanId_C Can_CanHwObject_EAT2_RXCanNod_C Can_CanHwObject_EAT4_RXCanId_C Can_CanHwObject_EAT4_RXCanNod_C Can_CanHwObject_EAT6_RXCanId_C Can_CanHwObject_EAT6_RXCanNod_C Can_CanHwObject_EAT7_RXCanId_C Can_CanHwObject_EAT7_RXCanNod_C Can_CanHwObject_EAT8_RXCanId_C Can_CanHwObject_EAT8_RXCanNod_C Can_CanHwObject_EATA_RXCanId_C Can_CanHwObject_EATA_RXCanNod_C Can_CanHwObject_EATB_RXCanId_C Can_CanHwObject_EATB_RXCanNod_C Can_CanHwObject_EATC_RXCanId_C Can_CanHwObject_EATC_RXCanNod_C Can_CanHwObject_EBBA_RXCanId_C Can_CanHwObject_EBBA_RXCanNod_C Can_CanHwObject_ENG10_TXCanNod_C Can_CanHwObject_ENG11_TXCanNod_C Can_CanHwObject_ENG15_TXCanNod_C Can_CanHwObject_ENG16_TXCanNod_C Can_CanHwObject_ENG17_TXCanNod_C Can_CanHwObject_ENG18_TXCanNod_C Can_CanHwObject_ENG19_TXCanNod_C Can_CanHwObject_ENG20_TXCanNod_C Can_CanHwObject_ENG21_TXCanNod_C Can_CanHwObject_ENG22_TXCanNod_C Can_CanHwObject_ENG23_TXCanNod_C Can_CanHwObject_ENG24_TXCanNod_C Can_CanHwObject_ENG25_TXCanNod_C Can_CanHwObject_ENG2_TXCanNod_C Can_CanHwObject_ENG3_TXCanNod_C Can_CanHwObject_ENG4_TXCanNod_C Can_CanHwObject_ENG5_TXCanNod_C Can_CanHwObject_ENG6_TXCanNod_C Can_CanHwObject_ENGAE_TXCanNod_C Can_CanHwObject_ENGA_TXCanNod_C Can_CanHwObject_ENGB_TXCanNod_C Can_CanHwObject_ENGC_TXCanNod_C Can_CanHwObject_ENGD_TXCanNod_C Can_CanHwObject_ENGE_TXCanNod_C Can_CanHwObject_ENGF_TXCanNod_C Can_CanHwObject_ENGHIP1_TXCanNod_C Can_CanHwObject_ENGIMG1_TXCanNod_C Can_CanHwObject_ENGJ3_TXCanNod_C Can_CanHwObject_ENGK3_TXCanNod_C Can_CanHwObject_ENGL_TXCanNod_C Can_CanHwObject_ENGN_TXCanNod_C Can_CanHwObject_ENGQ_TXCanNod_C Can_CanHwObject_ENGR_TXCanNod_C Can_CanHwObject_ENGT1_TXCanNod_C Can_CanHwObject_ENGT2_TXCanNod_C Can_CanHwObject_ENGT_TXCanNod_C Can_CanHwObject_ENGU_TXCanNod_C Can_CanHwObject_ENGV_TXCanNod_C Can_CanHwObject_ENGW_TXCanNod_C Can_CanHwObject_ENGX2_TXCanNod_C Can_CanHwObject_ENGY2_TXCanNod_C Can_CanHwObject_ENGY_TXCanNod_C Can_CanHwObject_ENGZ_TXCanNod_C Can_CanHwObject_EPS1_RXCanId_C Can_CanHwObject_EPS1_RXCanNod_C Can_CanHwObject_GWIMG1_RXCanId_C Can_CanHwObject_GWIMG1_RXCanNod_C Can_CanHwObject_GWIMG3_RXCanId_C Can_CanHwObject_GWIMG3_RXCanNod_C Can_CanHwObject_GWIMG4_RXCanId_C Can_CanHwObject_GWIMG4_RXCanNod_C Can_CanHwObject_GWIMG5_RXCanId_C Can_CanHwObject_GWIMG5_RXCanNod_C Can_CanHwObject_GWIMG6_RXCanId_C Can_CanHwObject_GWIMG6_RXCanNod_C Can_CanHwObject_IDASB_RXCanId_C Can_CanHwObject_IDASB_RXCanNod_C Can_CanHwObject_META_RXCanId_C Can_CanHwObject_META_RXCanNod_C Can_CanHwObject_METC_RXCanId_C Can_CanHwObject_METC_RXCanNod_C Can_CanHwObject_METD2_RXCanId_C Can_CanHwObject_METD2_RXCanNod_C Can_CanHwObject_METD_RXCanId_C Can_CanHwObject_METD_RXCanNod_C Can_CanHwObject_METE2_RXCanId_C Can_CanHwObject_METE2_RXCanNod_C Can_CanHwObject_METF_RXCanId_C Can_CanHwObject_METF_RXCanNod_C Can_CanHwObject_METG_RXCanId_C Can_CanHwObject_METG_RXCanNod_C Can_CanHwObject_METH2_RXCanId_C Can_CanHwObject_METH2_RXCanNod_C Can_CanHwObject_METH_RXCanId_C Can_CanHwObject_METH_RXCanNod_C Can_CanHwObject_METI_RXCanId_C Can_CanHwObject_METI_RXCanNod_C Can_CanHwObject_METK_RXCanId_C Can_CanHwObject_METK_RXCanNod_C Can_CanHwObject_METL_RXCanId_C Can_CanHwObject_METL_RXCanNod_C Can_CanHwObject_METM_RXCanId_C Can_CanHwObject_METM_RXCanNod_C Can_CanHwObject_METN_RXCanId_C Can_CanHwObject_METN_RXCanNod_C Can_CanHwObject_PCU_RXCanId_C Can_CanHwObject_PCU_RXCanNod_C Can_CanHwObject_SRSA_RXCanId_C Can_CanHwObject_SRSA_RXCanNod_C Can_CanHwObject_SRSB_RXCanId_C Can_CanHwObject_SRSB_RXCanNod_C Can_CanHwObject_SRS_RXCanId_C Can_CanHwObject_SRS_RXCanNod_C Can_CanHwObject_eng1_TXCanNod_C Can_CanHwObject_engo_TXCanNod_C Can_Can_APPLBaudrateCfgId_C Can_Can_CBaudrateCfgId_C Can_Can_VEHICLEBaudrateCfgId_C Can_OBD_ON_CAN_Rx_0x7DF_VEHICLECanId_C Can_OBD_ON_CAN_Rx_0x7DF_VEHICLECanNod_C Can_OBD_ON_CAN_Rx_0x7E0_VEHICLECanId_C Can_OBD_ON_CAN_Rx_0x7E0_VEHICLECanNod_C Can_OBD_ON_CAN_Tx_0x7E8_VEHICLECanNod_C Can_T1_RXCanId_C Can_T1_RXCanNod_C Can_T1_TXCanNod_C Can_UDS_ON_CAN_Rx_0x18da10f1_VEHICLECanId_C Can_UDS_ON_CAN_Rx_0x18da10f1_VEHICLECanNod_C Can_UDS_ON_CAN_Rx_0x18da10f2_VEHICLECanId_C Can_UDS_ON_CAN_Rx_0x18da10f2_VEHICLECanNod_C Can_UDS_ON_CAN_Rx_0x18db2ff1_VEHICLECanId_C Can_UDS_ON_CAN_Rx_0x18db2ff1_VEHICLECanNod_C Can_UDS_ON_CAN_Rx_0x18db33f1_VEHICLECanId_C Can_UDS_ON_CAN_Rx_0x18db33f1_VEHICLECanNod_C Can_UDS_ON_CAN_Rx_0x18dbeff1_VEHICLECanId_C Can_UDS_ON_CAN_Rx_0x18dbeff1_VEHICLECanNod_C Can_UDS_ON_CAN_Tx_0x18daf110_VEHICLECanNod_C Can_UDS_ON_CAN_Tx_0x18daf210_VEHICLECanNod_C Can_XcpRx_Cmd_APPLCanId_C Can_XcpRx_Cmd_APPLCanNod_C Can_XcpRx_Cmd_CANCCanId_C Can_XcpRx_Cmd_CANCCanNod_C Can_XcpRx_Cmd_VEHICLECanId_C Can_XcpRx_Cmd_VEHICLECanNod_C Can_XcpTx_Var_APPLCanNod_C Can_XcpTx_Var_CANCCanNod_C Can_XcpTx_Var_VEHICLECanNod_C /end DEF_CHARACTERISTIC
 /begin LOC_MEASUREMENT rba_CanMcan_DriverState_MP rba_CanMcan_MsgStatus_MP /end LOC_MEASUREMENT
/end FUNCTION
/begin FUNCTION rba_Etks "1.45.0  McFunction rba_Etks Created by MCFunctionUpdater" /begin DEF_CHARACTERISTIC rba_Etks_swt3rdPartySupp_C /end DEF_CHARACTERISTIC FUNCTION_VERSION "1.45.0" /end FUNCTION
/begin FUNCTION rba_IoDiagPwr "1.21.0    IO Diagnose Power"
 /begin DEF_CHARACTERISTIC rba_IoDiagPwr_Config_rba_IoExtCy329_SignalMrly_0_BattVltgThres_C rba_IoDiagPwr_Config_rba_IoExtCy329_SignalMrly_0_TimeBtwTst_C /end DEF_CHARACTERISTIC
 FUNCTION_VERSION "1.21.0" /end FUNCTION
/begin FUNCTION rba_IoSigDio "2.32.0  McFunction rba_IoSigDio Created by MCFunctionUpdater" /begin DEF_CHARACTERISTIC rba_IoSigDio_BrkMn_I_D_C rba_IoSigDio_swtMrlyDCInv_C /end DEF_CHARACTERISTIC FUNCTION_VERSION "2.32.0" /end FUNCTION
/begin FUNCTION rba_IoSigRtc "1.32.1    IO Signals: Real Time Clocks" /begin DEF_CHARACTERISTIC rba_IoSigRtc_stDiagErrInject_StopCounter_C /end DEF_CHARACTERISTIC FUNCTION_VERSION "1.32.1" /end FUNCTION
/begin FUNCTION rba_MRly "1.34.0    Main Relay"
 /begin DEF_CHARACTERISTIC rba_MRly_Diag_Stk_tiOkError_C rba_MRly_Sens_Measd_tiHiLo_C rba_MRly_Sens_Measd_tiLoHi_C rba_MRly_Sens_Measd_uBattClosedThr_C /end DEF_CHARACTERISTIC
 /begin LOC_MEASUREMENT rba_MRly_Ctrl_State_MP /end LOC_MEASUREMENT
 FUNCTION_VERSION "1.34.0" /end FUNCTION
/begin FUNCTION rba_OsMeasmt "1.15.0    Os Runtime Measurement"
 /begin DEF_CHARACTERISTIC rba_MultiStackTrace_ResetMaxValues rba_MultiStackTrace_ThresholdSwitch rba_OsMeasmt_CoreLoadThresholdValue_C rba_OsMeasmt_ResetMaxCoreLoadValues_C rba_OsMeasmt_ResetResponseTimeValues_C rba_OsMeasmt_SwTrace_InitMode_C /end DEF_CHARACTERISTIC
 /begin LOC_MEASUREMENT rba_MultiStackTrace_CurrentCycleMaxUsage_CSA0 rba_MultiStackTrace_CurrentCycleMaxUsage_CSA1 rba_MultiStackTrace_CurrentCycleMaxUsage_CSA2 rba_MultiStackTrace_CurrentCycleMaxUsage_User0 rba_MultiStackTrace_CurrentCycleMaxUsage_User1 rba_MultiStackTrace_CurrentCycleMaxUsage_User2 rba_MultiStackTrace_LifeTimeMaxUsage_CSA0 rba_MultiStackTrace_LifeTimeMaxUsage_CSA1 rba_MultiStackTrace_LifeTimeMaxUsage_CSA2 rba_MultiStackTrace_LifeTimeMaxUsage_User0 rba_MultiStackTrace_LifeTimeMaxUsage_User1 rba_MultiStackTrace_LifeTimeMaxUsage_User2 rba_MultiStackTrace_ThresholdTable rba_OsMeasmt_CoreLoad[0].curCycleMax rba_OsMeasmt_CoreLoad[0].current rba_OsMeasmt_CoreLoad[0].lifeTimeMax rba_OsMeasmt_CoreLoad[1].curCycleMax rba_OsMeasmt_CoreLoad[1].current rba_OsMeasmt_CoreLoad[1].lifeTimeMax rba_OsMeasmt_CoreLoad[2].curCycleMax rba_OsMeasmt_CoreLoad[2].current rba_OsMeasmt_CoreLoad[2].lifeTimeMax rba_OsMeasmt_OS_1000ms_Task.CETCurrent rba_OsMeasmt_OS_1000ms_Task.CETCurrentLoad rba_OsMeasmt_OS_1000ms_Task.CETCurrentLoadMax rba_OsMeasmt_OS_1000ms_Task.CETCycleMax rba_OsMeasmt_OS_1000ms_Task.RespTimeCurrent rba_OsMeasmt_OS_1000ms_Task.RespTimeCycleMax rba_OsMeasmt_OS_1000ms_Task.RespTimeLifetimeMax rba_OsMeasmt_OS_100ms_Task.CETCurrent rba_OsMeasmt_OS_100ms_Task.CETCurrentLoad rba_OsMeasmt_OS_100ms_Task.CETCurrentLoadMax rba_OsMeasmt_OS_100ms_Task.CETCycleMax rba_OsMeasmt_OS_100ms_Task.RespTimeCurrent rba_OsMeasmt_OS_100ms_Task.RespTimeCycleMax rba_OsMeasmt_OS_100ms_Task.RespTimeLifetimeMax rba_OsMeasmt_OS_10ms_Task.CETCurrent rba_OsMeasmt_OS_10ms_Task.CETCurrentLoad rba_OsMeasmt_OS_10ms_Task.CETCurrentLoadMax rba_OsMeasmt_OS_10ms_Task.CETCycleMax rba_OsMeasmt_OS_10ms_Task.RespTimeCurrent rba_OsMeasmt_OS_10ms_Task.RespTimeCycleMax rba_OsMeasmt_OS_10ms_Task.RespTimeLifetimeMax rba_OsMeasmt_OS_1ms_Task.CETCurrent rba_OsMeasmt_OS_1ms_Task.CETCurrentLoad rba_OsMeasmt_OS_1ms_Task.CETCurrentLoadMax rba_OsMeasmt_OS_1ms_Task.CETCycleMax rba_OsMeasmt_OS_1ms_Task.RespTimeCurrent rba_OsMeasmt_OS_1ms_Task.RespTimeCycleMax rba_OsMeasmt_OS_1ms_Task.RespTimeLifetimeMax rba_OsMeasmt_OS_200ms_Task.CETCurrent rba_OsMeasmt_OS_200ms_Task.CETCurrentLoad rba_OsMeasmt_OS_200ms_Task.CETCurrentLoadMax rba_OsMeasmt_OS_200ms_Task.CETCycleMax rba_OsMeasmt_OS_200ms_Task.RespTimeCurrent rba_OsMeasmt_OS_200ms_Task.RespTimeCycleMax rba_OsMeasmt_OS_200ms_Task.RespTimeLifetimeMax rba_OsMeasmt_OS_20ms_Task.CETCurrent rba_OsMeasmt_OS_20ms_Task.CETCurrentLoad rba_OsMeasmt_OS_20ms_Task.CETCurrentLoadMax rba_OsMeasmt_OS_20ms_Task.CETCycleMax rba_OsMeasmt_OS_20ms_Task.RespTimeCurrent rba_OsMeasmt_OS_20ms_Task.RespTimeCycleMax rba_OsMeasmt_OS_20ms_Task.RespTimeLifetimeMax rba_OsMeasmt_OS_2ms_Task.CETCurrent rba_OsMeasmt_OS_2ms_Task.CETCurrentLoad rba_OsMeasmt_OS_2ms_Task.CETCurrentLoadMax rba_OsMeasmt_OS_2ms_Task.CETCycleMax rba_OsMeasmt_OS_2ms_Task.RespTimeCurrent rba_OsMeasmt_OS_2ms_Task.RespTimeCycleMax rba_OsMeasmt_OS_2ms_Task.RespTimeLifetimeMax rba_OsMeasmt_OS_50ms_Task.CETCurrent rba_OsMeasmt_OS_50ms_Task.CETCurrentLoad rba_OsMeasmt_OS_50ms_Task.CETCurrentLoadMax rba_OsMeasmt_OS_50ms_Task.CETCycleMax rba_OsMeasmt_OS_50ms_Task.RespTimeCurrent rba_OsMeasmt_OS_50ms_Task.RespTimeCycleMax rba_OsMeasmt_OS_50ms_Task.RespTimeLifetimeMax rba_OsMeasmt_OS_5ms_Task.CETCurrent rba_OsMeasmt_OS_5ms_Task.CETCurrentLoad rba_OsMeasmt_OS_5ms_Task.CETCurrentLoadMax rba_OsMeasmt_OS_5ms_Task.CETCycleMax rba_OsMeasmt_OS_5ms_Task.RespTimeCurrent rba_OsMeasmt_OS_5ms_Task.RespTimeCycleMax rba_OsMeasmt_OS_5ms_Task.RespTimeLifetimeMax rba_OsMeasmt_T1_CoreLoad[0].curCycleMax rba_OsMeasmt_T1_CoreLoad[0].current rba_OsMeasmt_T1_CoreLoad[1].curCycleMax rba_OsMeasmt_T1_CoreLoad[1].current rba_OsMeasmt_T1_CoreLoad[2].curCycleMax rba_OsMeasmt_T1_CoreLoad[2].current /end LOC_MEASUREMENT
 FUNCTION_VERSION "1.15.0" /end FUNCTION
/*********** Start of merged COMPU_METHOD blocks ***********/
/begin COMPU_METHOD RB_RBA_Common_CentralElements_CompuMethods_Identical "The internal value and the physical one are identical. No physical unit available" RAT_FUNC "%10.5" "noUnit" COEFFS 0.0 1.0 0.0 0.0 0.0 1.0 REF_UNIT RB_RBA_Common_CentralElements_Units_NoUnit /end COMPU_METHOD
/begin COMPU_METHOD Mcan_Can_CompuMethods_Can_CompuMethod_CtrlId "Compu Method for Can controllers" TAB_VERB "%10.5" "noUnit" COMPU_TAB_REF Mcan_Can_CompuMethods_Can_CompuMethod_CtrlId REF_UNIT Mcan_Can_Units_NoUnit /end COMPU_METHOD
/begin COMPU_METHOD Mcan_Can_CompuMethods_Can_CompuMethod_CtrlBdRateId_Can_APPL "Compu Method for Can controller Baudrate Id" TAB_VERB "%10.5" "noUnit" COMPU_TAB_REF Mcan_Can_CompuMethods_Can_CompuMethod_CtrlBdRateId_Can_APPL REF_UNIT Mcan_Can_Units_NoUnit /end COMPU_METHOD
/begin COMPU_METHOD Mcan_Can_CompuMethods_Can_CompuMethod_CtrlBdRateId_Can_C "Compu Method for Can controller Baudrate Id" TAB_VERB "%10.5" "noUnit" COMPU_TAB_REF Mcan_Can_CompuMethods_Can_CompuMethod_CtrlBdRateId_Can_C REF_UNIT Mcan_Can_Units_NoUnit /end COMPU_METHOD
/begin COMPU_METHOD Mcan_Can_CompuMethods_Can_CompuMethod_CtrlBdRateId_Can_VEHICLE "Compu Method for Can controller Baudrate Id" TAB_VERB "%10.5" "noUnit" COMPU_TAB_REF Mcan_Can_CompuMethods_Can_CompuMethod_CtrlBdRateId_Can_VEHICLE REF_UNIT Mcan_Can_Units_NoUnit /end COMPU_METHOD
/begin COMPU_METHOD RB_RBA_rba_IoDiagPwr_CompuMethod_rba_DiagPwr_BatteryThreshold_millivolts_CompuMethod "CompuMethod for battery voltage threshold" RAT_FUNC "%10.5" "mV" COEFFS 0.0 -1.0 0.0 0.0 0.0 -20.0 REF_UNIT RB_RBA_rba_IoDiagPwr_Units_rba_IoDiagPwr_mV /end COMPU_METHOD
/begin COMPU_METHOD RB_RBA_rba_IoDiagPwr_CompuMethod_rba_DiagPwr_DelayTest_100ms_CompuMethod "CompuMethod for delay time between test in 100ms" RAT_FUNC "%10.5" "100ms" COEFFS 0.0 -1.0 0.0 0.0 0.0 -1.0 REF_UNIT RB_RBA_rba_IoDiagPwr_Units_rba_IoDiagPwr_100ms /end COMPU_METHOD
/begin COMPU_METHOD RB_RBA_rba_IoSigDio_CompuMethods_rba_IoSigDio_HWSigPathCompuMethod "CompuMethod used for calibration parameters for signals in the post build data set __DEFAULT_VARIANT__" TAB_VERB "%10.5" "noUnit" COMPU_TAB_REF RB_RBA_rba_IoSigDio_CompuMethods_rba_IoSigDio_HWSigPathCompuMethod REF_UNIT RB_RBA_rba_IoSigDio_Units_NoUnit /end COMPU_METHOD
/begin COMPU_METHOD RB_RBA_rba_IoSigDio_CompuMethods_rba_IoSigDio_InvertCompuMethod "CompuMethod used for signal state calibration parameters" TAB_VERB "%10.5" "noUnit" COMPU_TAB_REF RB_RBA_rba_IoSigDio_CompuMethods_rba_IoSigDio_InvertCompuMethod REF_UNIT RB_RBA_rba_IoSigDio_Units_NoUnit /end COMPU_METHOD
/begin COMPU_METHOD RB_RBA_rba_IoSigRtc_CompuMethods_rba_IoSigRtc_DiagErrInjectCompuMethod "CompuMethod used for error injection parametersof rba_IoSigRtc" TAB_VERB "%10.5" "noUnit" COMPU_TAB_REF RB_RBA_rba_IoSigRtc_CompuMethods_rba_IoSigRtc_DiagErrInjectCompuMethod REF_UNIT RB_RBA_rba_IoSigRtc_Units_NoUnit /end COMPU_METHOD
/begin COMPU_METHOD RB_RBA_rba_MRly_BswModuleDescriptions_rba_MRly_Ctrl_States_CompuMethod "CompuMethod for control states of Main Relay" TAB_VERB "%10.5" "nounit" COMPU_TAB_REF RB_RBA_rba_MRly_BswModuleDescriptions_rba_MRly_Ctrl_States_CompuMethod REF_UNIT RB_RBA_rba_MRly_Units_NoUnit /end COMPU_METHOD
/begin COMPU_METHOD RB_RBA_rba_MRly_BswModuleDescriptions_rba_MRly_Calibration_Common_milliseconds_CompuMethod "CompuMethod for calibration in milliseconds of Main Relay" RAT_FUNC "%10.5" "ms" COEFFS 0.0 -1.0 0.0 0.0 0.0 -1.0 REF_UNIT RB_RBA_rba_MRly_Units_ms /end COMPU_METHOD
/begin COMPU_METHOD RB_RBA_rba_MRly_BswModuleDescriptions_rba_MRly_Sens_Measd_uBattClosedThr_millivolts_CompuMethod "CompuMethod for measured threshold voltage of the battery to set the status of Main Relay" RAT_FUNC "%10.5" "mV" COEFFS 0.0 -1.0 0.0 0.0 0.0 -20.0 REF_UNIT RB_RBA_rba_MRly_Units_mV /end COMPU_METHOD
/begin COMPU_METHOD RB_RBA_rba_OsMeasmt_CompuMethods_rba_OsMeasmt_PercConversion "Os measurement conversion factor for percent" RAT_FUNC "%10.5" "%" COEFFS 0.0 -1.0 0.0 0.0 0.0 -0.01 REF_UNIT RB_RBA_rba_OsMeasmt_Units_Perc /end COMPU_METHOD
/begin COMPU_METHOD RB_RBA_rba_OsMeasmt_CompuMethods_rba_OsMeasmt_TaskRespTime_CompuMethod "Task response time computation method" RAT_FUNC "%10.5" "us" COEFFS 0.0 -1.0 0.0 0.0 0.0 -0.01 REF_UNIT RB_RBA_rba_OsMeasmt_Units_MicroSec /end COMPU_METHOD
/begin COMPU_METHOD RB_RBA_rba_OsMeasmt_CompuMethods_rba_OsMeasmt_CET_T1_CompuMethod "Task CET computation method for T1" RAT_FUNC "%10.5" "us" COEFFS 0.0 -1.0 0.0 0.0 0.0 -0.16 REF_UNIT RB_RBA_rba_OsShell_Units_MicroSec /end COMPU_METHOD
/begin COMPU_METHOD RB_RBA_rba_OsMeasmt_CompuMethods_rba_OsMeasmt_T1_PercConversion "Os measurement conversion factor for T1 percent" RAT_FUNC "%10.5" "%" COEFFS 0.0 -1.0 0.0 0.0 0.0 -1.0 REF_UNIT RB_RBA_rba_OsMeasmt_Units_Perc /end COMPU_METHOD
/begin COMPU_METHOD RB_RBA_rba_OsMeasmt_CompuMethods_rba_OsMeasmt_SwTrace_InitMode_CompuMethod "Enum for different Gliwa Init Modes" TAB_VERB "%10.5" "noUnit" COMPU_TAB_REF RB_RBA_rba_OsMeasmt_CompuMethods_rba_OsMeasmt_SwTrace_InitMode_CompuMethod REF_UNIT RB_RBA_rba_OsMeasmt_Units_NoUnit /end COMPU_METHOD
/begin COMPU_VTAB Mcan_Can_CompuMethods_Can_CompuMethod_CtrlId "Compu Method for Can controllers" TAB_VERB 3 0 "Can_APPL" 1 "Can_C" 2 "Can_VEHICLE" /end COMPU_VTAB
/begin COMPU_VTAB Mcan_Can_CompuMethods_Can_CompuMethod_CtrlBdRateId_Can_APPL "Compu Method for Can controller Baudrate Id" TAB_VERB 1 0 "CanControllerBaudrateConfig" /end COMPU_VTAB
/begin COMPU_VTAB Mcan_Can_CompuMethods_Can_CompuMethod_CtrlBdRateId_Can_C "Compu Method for Can controller Baudrate Id" TAB_VERB 1 0 "CanControllerBaudrateConfig" /end COMPU_VTAB
/begin COMPU_VTAB Mcan_Can_CompuMethods_Can_CompuMethod_CtrlBdRateId_Can_VEHICLE "Compu Method for Can controller Baudrate Id" TAB_VERB 1 0 "CanControllerBaudrateConfig" /end COMPU_VTAB
/begin COMPU_VTAB RB_RBA_rba_IoSigDio_CompuMethods_rba_IoSigDio_HWSigPathCompuMethod "CompuMethod used for calibration parameters for signals in the post build data set __DEFAULT_VARIANT__" TAB_VERB 1 2 "HWSigPath_DIO_33_00" /end COMPU_VTAB
/begin COMPU_VTAB RB_RBA_rba_IoSigDio_CompuMethods_rba_IoSigDio_InvertCompuMethod "CompuMethod used for signal state calibration parameters" TAB_VERB 2 0 "NonInvert" 1 "Invert" /end COMPU_VTAB
/begin COMPU_VTAB RB_RBA_rba_IoSigRtc_CompuMethods_rba_IoSigRtc_DiagErrInjectCompuMethod "CompuMethod used for error injection parametersof rba_IoSigRtc" TAB_VERB 9 0 "Idle State: No error is injected in diagnosis" 1 "Error State: Simulates counter is running way too fast (single step error)" 2 "Error State: Simulates counter is running way too slow (single step error)" 3 "Error State: Simulates counter is running too fast (overall accuracy)" 4 "Error State: Simulates counter is running too slow (overall accuracy)" 5 "Error State: Simulates not all counter bits are able to change their value" 6 "Error State: Simulates communication error with device driver" 7 "Error State: Simulates error while reading from NvM (during Initialization)" 8 "Error State: Simulates counter is stuck during accuracy diagnosis" /end COMPU_VTAB
/begin COMPU_VTAB RB_RBA_rba_MRly_BswModuleDescriptions_rba_MRly_Ctrl_States_CompuMethod "CompuMethod for control states of Main Relay" TAB_VERB 2 0 "rba_MRly_Ctrl_Open_e" 1 "rba_MRly_Ctrl_Close_e" /end COMPU_VTAB
/begin COMPU_VTAB RB_RBA_rba_OsMeasmt_CompuMethods_rba_OsMeasmt_SwTrace_InitMode_CompuMethod "Enum for different Gliwa Init Modes" TAB_VERB 3 0 "GLIWA_T1_PRODUCTIVE" 1 "GLIWA_T1_DEVELOPMENT" 2 "GLIWA_T1_OFF" /end COMPU_VTAB
/begin COMPU_METHOD ACCLNTP_SENSTYP_SY_Compu "" TAB_VERB "%6.3" "" COMPU_TAB_REF ACCLNTP_SENSTYP_SY_Compu /end COMPU_METHOD
/begin COMPU_VTAB ACCLNTP_SENSTYP_SY_Compu "" TAB_VERB 4 0 "ADCIN" 1 "PWMOUT" 2 "ADCIN_PWMOUT" 3 "CONNECT_NONE" /end COMPU_VTAB
/begin COMPU_METHOD ACCMPR_CODAVL_SC_Compu "" TAB_VERB "%6.3" "" COMPU_TAB_REF ACCMPR_CODAVL_SC_Compu /end COMPU_METHOD
/begin COMPU_VTAB ACCMPR_CODAVL_SC_Compu "" TAB_VERB 2 0 "False" 1 "True" /end COMPU_VTAB
/begin COMPU_METHOD ACCPED_EXTDGEAR_SC_Compu "" TAB_VERB "%6.3" "" COMPU_TAB_REF ACCPED_EXTDGEAR_SC_Compu /end COMPU_METHOD
/begin COMPU_VTAB ACCPED_EXTDGEAR_SC_Compu "" TAB_VERB 3 0 "SNGMAPSELN" 1 "LOMEDHIGEARMAPSELN" 2 "GEARBASEDMAPSELN" /end COMPU_VTAB
/begin COMPU_METHOD ACCTL_DEMANDTQDWNENA_SC_Compu "" TAB_VERB "%6.3" "" COMPU_TAB_REF ACCTL_DEMANDTQDWNENA_SC_Compu /end COMPU_METHOD
/begin COMPU_VTAB ACCTL_DEMANDTQDWNENA_SC_Compu "" TAB_VERB 2 0 "False" 1 "True" /end COMPU_VTAB
/begin COMPU_METHOD ACC_SY_Compu "" TAB_VERB "%6.3" "" COMPU_TAB_REF ACC_SY_Compu /end COMPU_METHOD
/begin COMPU_VTAB ACC_SY_Compu "" TAB_VERB 2 0 "FALSE" 1 "TRUE" /end COMPU_VTAB
/begin COMPU_METHOD ACEVPT_PHYSRNGCHK_SC_Compu "" TAB_VERB "%6.3" "" COMPU_TAB_REF ACEVPT_PHYSRNGCHK_SC_Compu /end COMPU_METHOD
/begin COMPU_VTAB ACEVPT_PHYSRNGCHK_SC_Compu "" TAB_VERB 2 0 "False" 1 "True" /end COMPU_VTAB
/begin COMPU_METHOD ACSWT_ATS_SY_Compu "" TAB_VERB "%6.3" "" COMPU_TAB_REF ACSWT_ATS_SY_Compu /end COMPU_METHOD
/begin COMPU_VTAB ACSWT_ATS_SY_Compu "" TAB_VERB 2 0 "False" 1 "True" /end COMPU_VTAB
/begin COMPU_METHOD ACSYEMAC_SC_Compu "" TAB_VERB "%6.3" "" COMPU_TAB_REF ACSYEMAC_SC_Compu /end COMPU_METHOD
/begin COMPU_VTAB ACSYEMAC_SC_Compu "" TAB_VERB 2 0 "False" 1 "True" /end COMPU_VTAB
/begin COMPU_METHOD ActAngle "" RAT_FUNC "%6.4" "deg" COEFFS 0 20 0 0 0 1 /end COMPU_METHOD
/begin COMPU_METHOD ACTRLIB_DSQSET_SY_Compu "" TAB_VERB "%6.3" "" COMPU_TAB_REF ACTRLIB_DSQSET_SY_Compu /end COMPU_METHOD
/begin COMPU_VTAB ACTRLIB_DSQSET_SY_Compu "" TAB_VERB 2 0 "FALSE" 1 "TRUE" /end COMPU_VTAB
/begin COMPU_METHOD ACTRLIB_IINITSPEZIAL_SY_Compu "" TAB_VERB "%6.3" "" COMPU_TAB_REF ACTRLIB_IINITSPEZIAL_SY_Compu /end COMPU_METHOD
/begin COMPU_VTAB ACTRLIB_IINITSPEZIAL_SY_Compu "" TAB_VERB 2 0 "FALSE" 1 "TRUE" /end COMPU_VTAB
/begin COMPU_METHOD ACTTRQCO_SY_Compu "" TAB_VERB "%6.3" "" COMPU_TAB_REF ACTTRQCO_SY_Compu /end COMPU_METHOD
/begin COMPU_VTAB ACTTRQCO_SY_Compu "" TAB_VERB 2 0 "FALSE" 1 "TRUE" /end COMPU_VTAB
/begin COMPU_METHOD ACTYP_SY_Compu "" TAB_VERB "%6.3" "" COMPU_TAB_REF ACTYP_SY_Compu /end COMPU_METHOD
/begin COMPU_VTAB ACTYP_SY_Compu "" TAB_VERB 5 0 "NO_AC" 1 "ACTYP_MECH_FIX" 2 "ACTYP_MECH_VAR" 3 "ACTYP_ELEC" 4 "ACTYP_MECHELEC" /end COMPU_VTAB
/begin COMPU_METHOD AC_DEMAND_SY_Compu "" TAB_VERB "%6.3" "" COMPU_TAB_REF AC_DEMAND_SY_Compu /end COMPU_METHOD
/begin COMPU_VTAB AC_DEMAND_SY_Compu "" TAB_VERB 2 0 "False" 1 "True" /end COMPU_VTAB
/begin COMPU_METHOD ADDLEONV_SC_Compu "" TAB_VERB "%6.3" "" COMPU_TAB_REF ADDLEONV_SC_Compu /end COMPU_METHOD
/begin COMPU_VTAB ADDLEONV_SC_Compu "" TAB_VERB 2 0 "False" 1 "True" /end COMPU_VTAB
/begin COMPU_METHOD ADDLNMAXLVL_SC_Compu "" TAB_VERB "%6.3" "" COMPU_TAB_REF ADDLNMAXLVL_SC_Compu /end COMPU_METHOD
/begin COMPU_VTAB ADDLNMAXLVL_SC_Compu "" TAB_VERB 2 0 "False" 1 "True" /end COMPU_VTAB
/begin COMPU_METHOD ADVREQIDLENGCATHEATG_SC_Compu "" TAB_VERB "%6.3" "" COMPU_TAB_REF ADVREQIDLENGCATHEATG_SC_Compu /end COMPU_METHOD
/begin COMPU_VTAB ADVREQIDLENGCATHEATG_SC_Compu "" TAB_VERB 2 0 "False" 1 "True" /end COMPU_VTAB
/begin COMPU_METHOD AFSP_MNTPOSN_SC_Compu "" TAB_VERB "%6.3" "" COMPU_TAB_REF AFSP_MNTPOSN_SC_Compu /end COMPU_METHOD
/begin COMPU_VTAB AFSP_MNTPOSN_SC_Compu "" TAB_VERB 5 0 "Disabled" 1 "AfsPSnsrMntPosIcoDs" 2 "AfsPSnsrMntPosIcoUs" 3 "AfsPSnsrMntPosEgrCoolrDs" 4 "AfsPSnsrMntPosAirFilDs" /end COMPU_VTAB
/begin COMPU_METHOD AFSP_TYPAVL_SC_Compu "" TAB_VERB "%6.3" "" COMPU_TAB_REF AFSP_TYPAVL_SC_Compu /end COMPU_METHOD
/begin COMPU_VTAB AFSP_TYPAVL_SC_Compu "" TAB_VERB 2 0 "False" 1 "True" /end COMPU_VTAB
/begin COMPU_METHOD AFSSLDGAVRG_SC_Compu "" TAB_VERB "%6.3" "" COMPU_TAB_REF AFSSLDGAVRG_SC_Compu /end COMPU_METHOD
/begin COMPU_VTAB AFSSLDGAVRG_SC_Compu "" TAB_VERB 2 0 "False" 1 "True" /end COMPU_VTAB
/begin COMPU_METHOD AFST_SY_Compu "" TAB_VERB "%6.3" "" COMPU_TAB_REF AFST_SY_Compu /end COMPU_METHOD
/begin COMPU_VTAB AFST_SY_Compu "" TAB_VERB 2 0 "False" 1 "True" /end COMPU_VTAB
/begin COMPU_METHOD AFST_TYPAVL_SY_Compu "" TAB_VERB "%6.3" "" COMPU_TAB_REF AFST_TYPAVL_SY_Compu /end COMPU_METHOD
/begin COMPU_VTAB AFST_TYPAVL_SY_Compu "" TAB_VERB 2 0 "False" 1 "True" /end COMPU_VTAB
/*********** Start of merged RECORD_LAYOUT blocks ***********/
/begin RECORD_LAYOUT DefaultValueRecordLayout_AUTOSAR_Platform_BaseTypes_uint8 FNC_VALUES 1 UBYTE COLUMN_DIR DIRECT STATIC_RECORD_LAYOUT /end RECORD_LAYOUT
/begin RECORD_LAYOUT DefaultValueRecordLayout_AUTOSAR_Platform_BaseTypes_uint32 FNC_VALUES 1 ULONG COLUMN_DIR DIRECT STATIC_RECORD_LAYOUT /end RECORD_LAYOUT
/begin RECORD_LAYOUT DefaultValueRecordLayout_AUTOSAR_Platform_BaseTypes_uint16 FNC_VALUES 1 UWORD COLUMN_DIR DIRECT STATIC_RECORD_LAYOUT /end RECORD_LAYOUT
/begin RECORD_LAYOUT DefaultValueRecordLayout_AUTOSAR_Platform_BaseTypes_boolean FNC_VALUES 1 UBYTE COLUMN_DIR DIRECT STATIC_RECORD_LAYOUT /end RECORD_LAYOUT
/*********** Start of merged UNIT blocks ***********/
/begin UNIT RB_RBA_Common_CentralElements_Units_NoUnit "No Unit" "noUnit" EXTENDED_SI SI_EXPONENTS 0 0 0 0 0 0 0 /end UNIT
/begin UNIT Mcan_Can_Units_NoUnit "No Unit" "noUnit" EXTENDED_SI SI_EXPONENTS 0 0 0 0 0 0 0 /end UNIT
/begin UNIT RB_RBA_rba_IoDiagPwr_Units_rba_IoDiagPwr_mV "Millivolt" "mV" EXTENDED_SI SI_EXPONENTS 0 0 0 0 0 0 0 /end UNIT
/begin UNIT RB_RBA_rba_IoDiagPwr_Units_rba_IoDiagPwr_100ms "Millisecond" "100ms" EXTENDED_SI SI_EXPONENTS 0 0 0 0 0 0 0 /end UNIT
/begin UNIT RB_RBA_rba_IoSigDio_Units_NoUnit "No Unit" "noUnit" EXTENDED_SI SI_EXPONENTS 0 0 0 0 0 0 0 /end UNIT
/begin UNIT RB_RBA_rba_IoSigRtc_Units_NoUnit "No Unit" "noUnit" EXTENDED_SI SI_EXPONENTS 0 0 0 0 0 0 0 /end UNIT
/begin UNIT RB_RBA_rba_MRly_Units_NoUnit "No Unit" "nounit" EXTENDED_SI SI_EXPONENTS 0 0 0 0 0 0 0 /end UNIT
/begin UNIT RB_RBA_rba_MRly_Units_ms "Millisecond" "ms" EXTENDED_SI SI_EXPONENTS 0 0 1 0 0 0 0 /end UNIT
/begin UNIT RB_RBA_rba_MRly_Units_mV "Millivolt" "mV" EXTENDED_SI SI_EXPONENTS 0 0 0 0 0 0 0 /end UNIT
/begin UNIT RB_RBA_rba_OsMeasmt_Units_Perc "Percent" "%" EXTENDED_SI /end UNIT
/begin UNIT RB_RBA_rba_OsMeasmt_Units_MicroSec "Micro Second" "us" EXTENDED_SI /end UNIT
/begin UNIT RB_RBA_rba_OsShell_Units_MicroSec "Micro Second" "us" EXTENDED_SI /end UNIT
/begin UNIT RB_RBA_rba_OsMeasmt_Units_NoUnit "No Unit" "noUnit" EXTENDED_SI SI_EXPONENTS 0 0 0 0 0 0 0 /end UNIT
/end MODULE
/end PROJECT
