ASAP2_VERSION 1 60
/begin PROJECT MG1CA020 "MG1CA020"
/begin HEADER "" VERSION "MG1CA020_6SAY_V011_TPROT" PROJECT_NO MG1CA020 /end HEADER
/begin MODULE DIM ""
/begin MOD_COMMON "" BYTE_ORDER MSB_LAST ALIGNMENT_BYTE 1 ALIGNMENT_WORD 2 ALIGNMENT_LONG 4 ALIGNMENT_INT64 4 ALIGNMENT_FLOAT32_IEEE 4 ALIGNMENT_FLOAT64_IEEE 4 DATA_SIZE 32 /end MOD_COMMON
/begin CHARACTERISTIC AHENSADMX "misfire frequency to switch off afterstart adaptation" VALUE 0x805052C8 RB_Val_Wu16 65535.00 dez 0.00 65535.00 FORMAT "%8.2" /end CHARACTERISTIC
/begin CHARACTERISTIC AirMod_tiDebCdnLeakMflowAdpn_C "Debounce time of flag for leakage massflow adaptation" VALUE 0x80505302 RB_Val_Wu16 13107.00 t_q0p2 0.00 13107.00 FORMAT "%8.2" /end CHARACTERISTIC
/begin CHARACTERISTIC ANZTIMNSAD "threshold: number of injections til begin of evaluation ""engine roughness with warm engine""" VALUE 0x805052CA RB_Val_Wu16 65535.00 dez 0.00 65535.00 FORMAT "%8.2" /end CHARACTERISTIC
/begin CHARACTERISTIC Batt_chStopEnaThres_C "Threshold of the battery charge to enable a stopping engine" VALUE 0x805079D4 RB_Val_Ws16 32767.50 RBPtCel_Perc_0p5_1 -16384.00 16383.50 FORMAT "%8.2" /end CHARACTERISTIC
/begin CHARACTERISTIC Batt_chStrtReqThres_C "threshold of the battery charge to request a starting engine" VALUE 0x805079D6 RB_Val_Ws16 16383.50 RBPtCel_Perc_0p5_1 0.00 16383.50 FORMAT "%8.2" EXTENDED_LIMITS -16384.00 16383.50 /end CHARACTERISTIC
/begin CHARACTERISTIC Batt_cntrOCVThd_C "Counter Threshold for number of occurences of Low open circuit voltage to initiate rough estimation of battery SOC again" VALUE 0x805079D8 RB_Val_Wu8 255.0 OneToOne 0.00 255.0 FORMAT "%5.1" /end CHARACTERISTIC
/begin CHARACTERISTIC Batt_facHiChrgnEff_T "Curve to determine the High charge efficiency of battery based on battery temperature" CURVE 0x805079DA RB_Curve_S16_S16 2.550000 Fact1000 0.00 2.550000 FORMAT "%8.6" EXTENDED_LIMITS -32.76800 32.76700
 /begin AXIS_DESCR STD_AXIS Ebs_tBattFild SCR_TEMP_CELS_float 6 -32768.00 32767.00 FORMAT "%8.2" DEPOSIT ABSOLUTE /end AXIS_DESCR
/end CHARACTERISTIC
/begin CHARACTERISTIC Batt_facLoChrgnEff_T "Curve to determine the Low charge efficiency of battery based on battery temperature" CURVE 0x805079F4 RB_Curve_S16_S16 2.550000 Fact1000 0.00 2.550000 FORMAT "%8.6" EXTENDED_LIMITS -32.76800 32.76700
 /begin AXIS_DESCR STD_AXIS Ebs_tBattFild SCR_TEMP_CELS_float 6 -32768.00 32767.00 FORMAT "%8.2" DEPOSIT ABSOLUTE /end AXIS_DESCR
/end CHARACTERISTIC
/begin CHARACTERISTIC Batt_facSOCStdy_C "Correction factor for steady SOC of UWABURE judgement" VALUE 0x80507A0E RB_Val_Wu16 65.53500 Fact1000 0.00 65.53500 FORMAT "%8.5" /end CHARACTERISTIC
/begin CHARACTERISTIC Batt_flgDarkIAllw_C "Calibration to prohibit use of unsteady dark current" VALUE 0x80507A10 RB_Val_Wboolean 1.00000000000 B_TRUE 0.00 1.00000000000 FORMAT "%13.11" /end CHARACTERISTIC
/begin CHARACTERISTIC Batt_flgSt5ChrgModDi_C "Calibration to disable usage of battery management state 5 for checking if battery is in charging mode" VALUE 0x80507A11 RB_Val_Wboolean 1.00000000000 B_TRUE 0.00 1.00000000000 FORMAT "%13.11" /end CHARACTERISTIC
/begin CHARACTERISTIC Batt_flgSwtBattSeln_C "Switch to select the souce of battery SOC calculation" VALUE 0x80507A12 RB_Val_Wboolean 1.00000000000 B_TRUE 0.00 1.00000000000 FORMAT "%13.11" /end CHARACTERISTIC
/begin CHARACTERISTIC Batt_flgSwtSOCSeln_C "Switch to select the source of battery SOC" VALUE 0x80507B50 RB_Val_Wu8 1.00000000000 B_TRUE 0.00 1.00000000000 FORMAT "%13.11" /end CHARACTERISTIC
/begin CHARACTERISTIC Batt_iChrgnThdDelta_C "Hysteresis delta thresold for determining battery charge completed based on battery current from the sensor" VALUE 0x80507A14 RB_Val_Ws16 655.3500 Curr_A -327.6800 327.6700 FORMAT "%8.4" /end CHARACTERISTIC
/begin CHARACTERISTIC Batt_iChrgnThd_M "Charging current threshold for start stop judgement" MAP 0x80507A16 RB_Map_S16S16_S16 655.3500 Curr_A -327.6800 327.6700 FORMAT "%8.4"
 /begin AXIS_DESCR STD_AXIS Ebs_tBattFild SCR_TEMP_CELS_float 6 -32768.00 32767.00 FORMAT "%8.2" DEPOSIT ABSOLUTE /end AXIS_DESCR
 /begin AXIS_DESCR STD_AXIS Ebs_uBattFild U_mV_q0p9765625_COMPU 6 -32000.00 31999.02 FORMAT "%8.2" DEPOSIT ABSOLUTE /end AXIS_DESCR
/end CHARACTERISTIC
/begin CHARACTERISTIC Batt_iOCVDchaThd_C "Current threshold to confirm OCV detection during dischage" VALUE 0x80507A7A RB_Val_Ws16 655.3500 Curr_A -327.6800 327.6700 FORMAT "%8.4" /end CHARACTERISTIC
/begin CHARACTERISTIC Batt_iOCVDetnThd_C "Battery Current threshold to confirm OCV detection" VALUE 0x80507A7C RB_Val_Ws16 655.3500 Curr_A -327.6800 327.6700 FORMAT "%8.4" /end CHARACTERISTIC
/begin CHARACTERISTIC Batt_iOCVThd_C "Alternator Current threshold to confirm OCV detection" VALUE 0x80507A7E RB_Val_Ws16 655.3500 Curr_A -327.6800 327.6700 FORMAT "%8.4" /end CHARACTERISTIC
/begin CHARACTERISTIC Batt_qAdjCnsChk_C "The adjustment quantity for consumption check" VALUE 0x80507A80 RB_Val_Ws32 4294967.29500 RBPtCel_q_0p001_1 -2147483.64800 2147483.64700 FORMAT "%13.5" /end CHARACTERISTIC
/begin CHARACTERISTIC Batt_qBliChrgLim_C "Threshold to detect blind charge during ignition off" VALUE 0x80507A84 RB_Val_Ws32 2147483.64700 RBPtCel_q_0p001_1 0.00 2147483.64700 FORMAT "%13.5" EXTENDED_LIMITS -2147483.64800 2147483.64700 /end CHARACTERISTIC
/begin CHARACTERISTIC Batt_qCap20_C "Calibration to convert dark current threshold in percentage to ampere second unit" VALUE 0x80507A88 RB_Val_Wu16 327.6700 q0p01_A_h_1 0.00 327.6700 FORMAT "%8.4" EXTENDED_LIMITS 0.00 655.3500 /end CHARACTERISTIC
/begin CHARACTERISTIC Batt_qChgCap20_C "Charge capacity" VALUE 0x80507A8C RB_Val_Ws32 4294967.29500 RBPtCel_q_0p001_1 -2147483.64800 2147483.64700 FORMAT "%13.5" /end CHARACTERISTIC
/begin CHARACTERISTIC Batt_qDeltaDchaCmpl_C "Delta discharge limit to move to batter management state 3" VALUE 0x80507A90 RB_Val_Ws32 4294967.29500 RBPtCel_q_0p001_1 -2147483.64800 2147483.64700 FORMAT "%13.5" /end CHARACTERISTIC
/begin CHARACTERISTIC Batt_qDodLimHi_C "Hysterisis upper threshold for start request based on depth of discharge" VALUE 0x80507A94 RB_Val_Ws32 4294967.29500 RBPtCel_q_0p001_1 -2147483.64800 2147483.64700 FORMAT "%13.5" /end CHARACTERISTIC
/begin CHARACTERISTIC Batt_qDodLimLo_C "Hysterisis lower threshold for start request based on depth of discharge" VALUE 0x80507A98 RB_Val_Ws32 4294967.29500 RBPtCel_q_0p001_1 -2147483.64800 2147483.64700 FORMAT "%13.5" /end CHARACTERISTIC
/begin CHARACTERISTIC Batt_qDodStopEnaLim_C "The DOD limit for stop enable" VALUE 0x80507A9C RB_Val_Ws32 2147483.64800 RBPtCel_q_0p001_1 -2147483.64800 0.00 FORMAT "%13.5" EXTENDED_LIMITS -2147483.64800 2147483.64700 /end CHARACTERISTIC
/begin CHARACTERISTIC Batt_qDodStrtReqLim_C "The DOD limit for start request" VALUE 0x80507AA0 RB_Val_Ws32 2147483.64800 RBPtCel_q_0p001_1 -2147483.64800 0.00 FORMAT "%13.5" EXTENDED_LIMITS -2147483.64800 2147483.64700 /end CHARACTERISTIC
/begin CHARACTERISTIC Batt_qNrm1_C "This indicates the normalized battery state of health balue based on battery type indicated by ID1" VALUE 0x80507AA4 RB_Val_Ws16 8191.875 RBPtCel_q_0p125_1 -4096.000 4095.875 FORMAT "%8.3" /end CHARACTERISTIC
/begin CHARACTERISTIC Batt_qNrm2_C "Callibration for battery state of health with respect to charge capacity" VALUE 0x80507AA6 RB_Val_Ws16 8191.875 RBPtCel_q_0p125_1 -4096.000 4095.875 FORMAT "%8.3" /end CHARACTERISTIC
/begin CHARACTERISTIC Batt_qSumHiRcv_C "Battery current integral recovery (hi charge efficiency)" VALUE 0x80507AA8 RB_Val_Ws32 4294967.29500 RBPtCel_q_0p001_1 -2147483.64800 2147483.64700 FORMAT "%13.5" /end CHARACTERISTIC
/begin CHARACTERISTIC Batt_qSumHiThd_C "Maximum value allowed for Battery current integral ( hi charge efficiency )" VALUE 0x80507AAC RB_Val_Ws32 4294967.29500 RBPtCel_q_0p001_1 -2147483.64800 2147483.64700 FORMAT "%13.5" /end CHARACTERISTIC
/begin CHARACTERISTIC Batt_qSumLoLimThd_C "Maximum value allowed for Battery current integral ( low charge efficiency )" VALUE 0x80507AB0 RB_Val_Ws32 4294967.29500 RBPtCel_q_0p001_1 -2147483.64800 2147483.64700 FORMAT "%13.5" /end CHARACTERISTIC
/begin CHARACTERISTIC Batt_qSumLoLim_C "IBSUML threshold for restricting the reading of battery internal resistance" VALUE 0x80507B54 RB_Val_Ws32 4294967.29500 RBPtCel_q_0p001_1 -2147483.64800 2147483.64700 FORMAT "%13.5" /end CHARACTERISTIC
/begin CHARACTERISTIC Batt_qSumLoLmt_C "Threshold for battery fully charged confirmation" VALUE 0x80507AB4 RB_Val_Ws32 4294967.29500 RBPtCel_q_0p001_1 -2147483.64800 2147483.64700 FORMAT "%13.5" /end CHARACTERISTIC
/begin CHARACTERISTIC Batt_qSumLoRcv_C "Battery current integral recovery (low charge efficiency)" VALUE 0x80507AB8 RB_Val_Ws32 4294967.29500 RBPtCel_q_0p001_1 -2147483.64800 2147483.64700 FORMAT "%13.5" /end CHARACTERISTIC
/begin CHARACTERISTIC Batt_qSumLoThd_C "Threshold below which battery management state exits normal control to SOC judgement state" VALUE 0x80507ABC RB_Val_Ws32 4294967.29500 RBPtCel_q_0p001_1 -2147483.64800 2147483.64700 FORMAT "%13.5" /end CHARACTERISTIC
/begin CHARACTERISTIC Batt_qSumRCThd1_C "IBSUMRCINI threshold for transiting to state 7 from state 8" VALUE 0x80507AC0 RB_Val_Ws32 2147483.64700 RBPtCel_q_0p001_1 0.00 2147483.64700 FORMAT "%13.5" EXTENDED_LIMITS -2147483.64800 2147483.64700 /end CHARACTERISTIC
/begin CHARACTERISTIC Batt_qSumRCThd2_C "IBSUMRCINI threshold for transiting to state 1 from state 8" VALUE 0x80507AC4 RB_Val_Ws32 2147483.64700 RBPtCel_q_0p001_1 0.00 2147483.64700 FORMAT "%13.5" EXTENDED_LIMITS -2147483.64800 2147483.64700 /end CHARACTERISTIC
/begin CHARACTERISTIC Batt_qSumSOCRawThd_C "IBSUMRAW threshold for UWABURE judgement" VALUE 0x80507AC8 RB_Val_Ws32 4294967.29500 RBPtCel_q_0p001_1 -2147483.64800 2147483.64700 FORMAT "%13.5" /end CHARACTERISTIC
/begin CHARACTERISTIC Batt_qSumSOCThd_C "IBSUMH threshold for UWABURE judgement" VALUE 0x80507ACC RB_Val_Ws32 4294967.29500 RBPtCel_q_0p001_1 -2147483.64800 2147483.64700 FORMAT "%13.5" /end CHARACTERISTIC
/begin CHARACTERISTIC Batt_qTotDChaCmpl_C "Total discharge limit to move to batter management state 4 from state 2" VALUE 0x80507AD0 RB_Val_Ws32 4294967.29500 RBPtCel_q_0p001_1 -2147483.64800 2147483.64700 FORMAT "%13.5" /end CHARACTERISTIC
/begin CHARACTERISTIC Batt_ratAcptdLowSoc_C "Accepted Low SOC" VALUE 0x80507AD4 RB_Val_Wu8 127.5 rel_ub_b127p5 0.00 127.5 FORMAT "%5.1" /end CHARACTERISTIC
/begin CHARACTERISTIC Batt_ratLowSocChrgFinsh_C "Low SOC charge finish" VALUE 0x80507AD5 RB_Val_Wu8 127.5 rel_ub_b127p5 0.00 127.5 FORMAT "%5.1" /end CHARACTERISTIC
/begin CHARACTERISTIC Batt_ratMinSocRBatt_C "The minimum battery SOC that has to be present to proceed with reading the battery internal resistance and hence battery degradation judgement." VALUE 0x80507B58 RB_Val_Wu8 127.5 RBPtCel_Perc_0p5_1 0.00 127.5 FORMAT "%5.1" /end CHARACTERISTIC
/begin CHARACTERISTIC Batt_ratSocTgt_C "Traget SOC" VALUE 0x80507AD6 RB_Val_Wu16 32767.50 RBPtCel_Perc_0p5_1 0.00 32767.50 FORMAT "%8.2" /end CHARACTERISTIC
/begin CHARACTERISTIC Batt_ratSocThdStopEna_C "Battery SOC threshold level for stop enable judgement" VALUE 0x80507AD8 RB_Val_Ws16 32767.50 RBPtCel_Perc_0p5_1 -16384.00 16383.50 FORMAT "%8.2" /end CHARACTERISTIC
/begin CHARACTERISTIC Batt_ratSoh4SofLim_C "SOH limit for SOF_V precision" VALUE 0x80507ADA RB_Val_Ws16 399.9878 Prc 0.00 399.9878 FORMAT "%8.4" EXTENDED_LIMITS -400.0000 399.9878 /end CHARACTERISTIC
/begin CHARACTERISTIC Batt_ratSohStopEnaLim_C "SOH limit for stop enable" VALUE 0x80507ADC RB_Val_Ws16 399.9878 Prc 0.00 399.9878 FORMAT "%8.4" EXTENDED_LIMITS -400.0000 399.9878 /end CHARACTERISTIC
/begin CHARACTERISTIC Batt_ratSohThres_C "Threshold SOH" VALUE 0x80507ADE RB_Val_Ws16 399.9878 Prc 0.00 399.9878 FORMAT "%8.4" EXTENDED_LIMITS -400.0000 399.9878 /end CHARACTERISTIC
/begin CHARACTERISTIC Batt_rBattDgrdLim_C "Limit for battery internal resistance for battery degradation" VALUE 0x80507B5A RB_Val_Ws16 0.6553500 RBPtCel_r_0p00001_1 -0.3276800 0.3276700 FORMAT "%9.7" /end CHARACTERISTIC
/begin CHARACTERISTIC Batt_rBattExchJudgThd_C "Battery resistance threshold to judge that battery has been exchanged" VALUE 0x80507B5C RB_Val_Ws16 655.3500 Resist_mOhm_q0p01 -327.6800 327.6700 FORMAT "%8.4" /end CHARACTERISTIC
/begin CHARACTERISTIC Batt_rDarkIAllwCondBThdHi_C "Hysterisis upper threshold for dark current allow judgement condition B" VALUE 0x80507AE0 RB_Val_Ws32 42949672.9500 Prc_Fact100 -21474836.4800 21474836.4700 FORMAT "%13.4" /end CHARACTERISTIC
/begin CHARACTERISTIC Batt_rDarkIAllwCondBThdLo_C "Hysterisis Lower threshold for dark current allow judgement condition B" VALUE 0x80507AE4 RB_Val_Ws32 42949672.9500 Prc_Fact100 -21474836.4800 21474836.4700 FORMAT "%13.4" /end CHARACTERISTIC
/begin CHARACTERISTIC Batt_rDarkIThdCondAHi_C "Hysterisis upper threshold for dark current allow judgement condition A" VALUE 0x80507AE8 RB_Val_Ws32 42949672.9500 Prc_Fact100 -21474836.4800 21474836.4700 FORMAT "%13.4" /end CHARACTERISTIC
/begin CHARACTERISTIC Batt_rDarkIThdCondALo_C "Hysterisis Lower threshold for dark current allow judgement condition A" VALUE 0x80507AEC RB_Val_Ws32 42949672.9500 Prc_Fact100 -21474836.4800 21474836.4700 FORMAT "%13.4" /end CHARACTERISTIC
/begin CHARACTERISTIC Batt_rLimSysFailrHi_C "High threshold limit for battery system fault" VALUE 0x80507B5E RB_Val_Ws16 0.6553500 RBPtCel_r_0p00001_1 -0.3276800 0.3276700 FORMAT "%9.7" /end CHARACTERISTIC
/begin CHARACTERISTIC Batt_rLimSysFailrLo_C "Low threshold limit for battery system fault" VALUE 0x80507B60 RB_Val_Ws16 0.6553500 RBPtCel_r_0p00001_1 -0.3276800 0.3276700 FORMAT "%9.7" /end CHARACTERISTIC
/begin CHARACTERISTIC Batt_rSlopBattDgrd_T "Slope for battery internal resistance for battery degradation" CURVE 0x80507B62 RB_Curve_S16_S16 0.6553500 RBPtCel_r_0p00001_1 -0.3276800 0.3276700 FORMAT "%9.7"
 /begin AXIS_DESCR STD_AXIS Ebs_tBattFild SCR_TEMP_CELS_float 6 -32768.00 32767.00 FORMAT "%8.2" DEPOSIT ABSOLUTE /end AXIS_DESCR
/end CHARACTERISTIC
/begin CHARACTERISTIC Batt_rSlopISSEna_T "Slope for battery internal resistance for ISS enable" CURVE 0x80507B7C RB_Curve_S16_S16 0.6553500 RBPtCel_r_0p00001_1 -0.3276800 0.3276700 FORMAT "%9.7"
 /begin AXIS_DESCR STD_AXIS Ebs_tBattFild SCR_TEMP_CELS_float 6 -32768.00 32767.00 FORMAT "%8.2" DEPOSIT ABSOLUTE /end AXIS_DESCR
/end CHARACTERISTIC
/begin CHARACTERISTIC Batt_SofCorrn_T "SOF_V precision offse" CURVE 0x80507AF0 RB_Curve_S16_S16 4095.938 spg_q0p0625_V -2048.000 2047.938 FORMAT "%8.3"
 /begin AXIS_DESCR STD_AXIS Batt_cntrStrtIn dez 2 0.00 32767.00 FORMAT "%8.2" EXTENDED_LIMITS -32768.00 32767.00 DEPOSIT ABSOLUTE /end AXIS_DESCR
/end CHARACTERISTIC
/begin CHARACTERISTIC Batt_stLoSocDetn_C "Low SOC detection" VALUE 0x80507AFA RB_Val_Wu8 255.0 OneToOne 0.00 255.0 FORMAT "%5.1" /end CHARACTERISTIC
/begin CHARACTERISTIC Batt_stSigSeln_C "Calibration for selection of source of signals relating to battery condition" VALUE 0x80507AFB RB_Val_Wu8 255.0 OneToOne 0.00 255.0 FORMAT "%5.1" /end CHARACTERISTIC
/begin CHARACTERISTIC Batt_stSocErrSel_C "Battery SOC error bits" VALUE 0x80507AFC RB_Val_Wu8 255.0 OneToOne 0.00 255.0 FORMAT "%5.1" /end CHARACTERISTIC
/begin CHARACTERISTIC Batt_stSocRlbtJdg_C "SOC reliability judgment" VALUE 0x80507AFE RB_Val_Wu16 65535.00 OneToOne 0.00 65535.00 FORMAT "%8.2" /end CHARACTERISTIC
/begin CHARACTERISTIC Batt_stStartErrMsk_C "Error mask for engine request" VALUE 0x80507B00 RB_Val_Wu8 255.0 OneToOne 0.00 255.0 FORMAT "%5.1" /end CHARACTERISTIC
/begin CHARACTERISTIC Batt_stStopErrMsk_C "Error mask for stop enable" VALUE 0x80507B01 RB_Val_Wu8 255.0 OneToOne 0.00 255.0 FORMAT "%5.1" /end CHARACTERISTIC
/begin CHARACTERISTIC Batt_swtDataSrcSel_C "Switch to read battery sensors from LIN or from EEM module" VALUE 0x80507B02 RB_Val_Wboolean 1.00000000000 B_TRUE 0.00 1.00000000000 FORMAT "%13.11" /end CHARACTERISTIC
/begin CHARACTERISTIC Batt_tBattStopEnaHiLim_C "The temperature high threshold for stop enable" VALUE 0x80507B04 RB_Val_Ws16 65535.00 SCR_TEMP_CELS_float -32768.00 32767.00 FORMAT "%8.2" /end CHARACTERISTIC
/begin CHARACTERISTIC Batt_tBattStopEnaLim_C "Minimum battery temperature for stop enable" VALUE 0x80507B06 RB_Val_Ws16 65535.00 SCR_TEMP_CELS_float -32768.00 32767.00 FORMAT "%8.2" /end CHARACTERISTIC
/begin CHARACTERISTIC Batt_tBattStrtReqLim_C "Minimum battery temperature for start request" VALUE 0x80507B08 RB_Val_Ws16 65535.00 SCR_TEMP_CELS_float -32768.00 32767.00 FORMAT "%8.2" /end CHARACTERISTIC
/begin CHARACTERISTIC Batt_tBattThres_C "Threshold for battery temperature" VALUE 0x80507B0A RB_Val_Ws16 65535.00 SCR_TEMP_CELS_float -32768.00 32767.00 FORMAT "%8.2" /end CHARACTERISTIC
/begin CHARACTERISTIC Batt_tiBattCodChgID1_C "Turn on delay time to detect change of battery code to ID1" VALUE 0x80507B0C RB_Val_Wu16 655.3500 Time_s 0.00 655.3500 FORMAT "%8.4" /end CHARACTERISTIC
/begin CHARACTERISTIC Batt_tiBattCodChgID2_C "Turn on delay time to detect change of battery code to ID2" VALUE 0x80507B0E RB_Val_Wu16 655.3500 Time_s 0.00 655.3500 FORMAT "%8.4" /end CHARACTERISTIC
/begin CHARACTERISTIC Batt_tiChrgnIThd_C "Battery charging current threshold time" VALUE 0x80507B10 RB_Val_Wu16 655.3500 Time_s 0.00 655.3500 FORMAT "%8.4" /end CHARACTERISTIC
/begin CHARACTERISTIC Batt_tiCum1_C "Cumulative Time 1" VALUE 0x80507B14 RB_Val_Wu32 429496729.500 Time_sec_1 0.00 429496729.500 FORMAT "%13.3" /end CHARACTERISTIC
/begin CHARACTERISTIC Batt_tiCum2_C "Cumulative Time 2" VALUE 0x80507B18 RB_Val_Wu32 429496729.500 Time_sec_1 0.00 429496729.500 FORMAT "%13.3" /end CHARACTERISTIC
/begin CHARACTERISTIC Batt_tiCurrThd_C "Delay time threshold to confirm OCV detection based on battery current and alternator current" VALUE 0x80507B1C RB_Val_Wu16 655.3500 Time_s 0.00 655.3500 FORMAT "%8.4" /end CHARACTERISTIC
/begin CHARACTERISTIC Batt_tiDchaThd_C "Delay time threshold to confirm OCV detection based on battery voltage and alternator desired voltage" VALUE 0x80507B1E RB_Val_Wu16 655.3500 Time_s 0.00 655.3500 FORMAT "%8.4" /end CHARACTERISTIC
/begin CHARACTERISTIC Batt_tiOCVDetnThd_C "Delay time threshold to confirm OCV detection based on battery current" VALUE 0x80507B20 RB_Val_Wu16 655.3500 Time_s 0.00 655.3500 FORMAT "%8.4" /end CHARACTERISTIC
/begin CHARACTERISTIC Batt_tiOCVVoltThd_C "Delay time threshold to confirm OCV detection based on battery voltage" VALUE 0x80507B22 RB_Val_Wu16 655.3500 Time_s 0.00 655.3500 FORMAT "%8.4" /end CHARACTERISTIC
/begin CHARACTERISTIC Batt_tISSProhbModChg_C "ISS prohibition mode change temperature" VALUE 0x80507B96 RB_Val_Ws16 65535.00 SCR_TEMP_CELS_float -32768.00 32767.00 FORMAT "%8.2" /end CHARACTERISTIC
/begin CHARACTERISTIC Batt_tISSProhb_C "ISS prohibition temperature" VALUE 0x80507B98 RB_Val_Ws16 65535.00 SCR_TEMP_CELS_float -32768.00 32767.00 FORMAT "%8.2" /end CHARACTERISTIC
/begin CHARACTERISTIC Batt_tiStopDurMin_C "time spend in stop before starting the engine" VALUE 0x80507B24 RB_Val_Ws16 10485.60 TimeRed -5242.880 5242.720 FORMAT "%8.3" /end CHARACTERISTIC
/begin CHARACTERISTIC Batt_uChrgThd_C "The voltage of charge threshold" VALUE 0x80507B26 RB_Val_Ws16 63999.02 U_mV_q0p9765625_COMPU -32000.00 31999.02 FORMAT "%8.2" /end CHARACTERISTIC
/begin CHARACTERISTIC Batt_uOCVDchaThd_C "Voltage threshold for OCV detection based on battery voltage discharge" VALUE 0x80507B28 RB_Val_Ws16 63999.02 U_mV_q0p9765625_COMPU -32000.00 31999.02 FORMAT "%8.2" /end CHARACTERISTIC
/begin CHARACTERISTIC Batt_uOCVDetnThd_T "Curve to determine Voltage threshold for OCV detection based on battery SOC" CURVE 0x80507B2A RB_Curve_S16_S16 63999.02 U_mV_q0p9765625_COMPU -32000.00 31999.02 FORMAT "%8.2"
 /begin AXIS_DESCR STD_AXIS NO_INPUT_QUANTITY Ampsec100 4 -3276800. 3276700. FORMAT "%8.0" DEPOSIT ABSOLUTE /end AXIS_DESCR
/end CHARACTERISTIC
/begin CHARACTERISTIC Batt_uOCVLimThd_C "Voltage threshold for OCV detection based on alternator desired voltage" VALUE 0x80507B3C RB_Val_Ws16 1310700. Volt_Batt -655360.0 655340.0 FORMAT "%8.1" /end CHARACTERISTIC
/begin CHARACTERISTIC Batt_uSofStopEnaLim_C "Low limit of supply voltage in cranking for stop enable" VALUE 0x80507B3E RB_Val_Ws16 4095.938 spg_q0p0625_V -2048.000 2047.938 FORMAT "%8.3" /end CHARACTERISTIC
/begin CHARACTERISTIC Batt_uSofStrtReqLim_C "Low limit of supply voltage in cranking for start request" VALUE 0x80507B40 RB_Val_Ws16 4095.938 spg_q0p0625_V -2048.000 2047.938 FORMAT "%8.3" /end CHARACTERISTIC
/begin CHARACTERISTIC Batt_uSofThres_C "Threshold of supply voltage in cranking" VALUE 0x80507B42 RB_Val_Ws16 4095.938 spg_q0p0625_V -2048.000 2047.938 FORMAT "%8.3" /end CHARACTERISTIC
/begin CHARACTERISTIC BBSTNSAD_uBatt_C "ow battery voltage threshold for BattU_u variable" VALUE 0x805052CC RB_Val_Ws16 1310700. Volt_Batt -655360.0 655340.0 FORMAT "%8.1" /end CHARACTERISTIC
/begin CHARACTERISTIC BdInt_stPCU_C "Calibration for upadting Panel control unit availability status" VALUE 0x80507B9C RB_Val_Wu8 1.000 OneToOne 0.00 1.000 FORMAT "%5.3" EXTENDED_LIMITS 0.00 255.0 /end CHARACTERISTIC
/begin CHARACTERISTIC BdInt_swtEngStopEna_C "Selection condition switch to enable engine stop" VALUE 0x80507B9D RB_Val_Wu8 255.0 OneToOne 0.00 255.0 FORMAT "%5.1" /end CHARACTERISTIC
/begin CHARACTERISTIC BdInt_swtEngStrtEna_C "Select condition switch ot enable engine start" VALUE 0x80507B9E RB_Val_Wu8 255.0 OneToOne 0.00 255.0 FORMAT "%5.1" /end CHARACTERISTIC
/begin CHARACTERISTIC BdInt_swtRstrtNoPtdEna_C "Select condition switch to enable engine start permission" VALUE 0x80507B9F RB_Val_Wu8 255.0 OneToOne 0.00 255.0 FORMAT "%5.1" /end CHARACTERISTIC
/begin CHARACTERISTIC BdInt_swtStrtEnaClthSel_C "switch for selecting clutch signal for start enable condition" VALUE 0x80507BA0 RB_Val_Wu8 1.000 OneToOne 0.00 1.000 FORMAT "%5.3" EXTENDED_LIMITS 0.00 255.0 /end CHARACTERISTIC
/begin CHARACTERISTIC BdInt_tiAutoRstrtReqGr1_C "Delay time for engine restart permit 1" VALUE 0x80507BA2 RB_Val_Ws16 655350.0 Time_ms -327680.0 327670.0 FORMAT "%8.1" /end CHARACTERISTIC
/begin CHARACTERISTIC BdInt_tiAutoRstrtReqGr2_C "Delay time for engine restart permit 2" VALUE 0x80507BA4 RB_Val_Ws16 655350.0 Time_ms -327680.0 327670.0 FORMAT "%8.1" /end CHARACTERISTIC
/begin CHARACTERISTIC BdInt_tiClthOnDspReqDly_C "Delay time for clutch on display request" VALUE 0x80507BA8 RB_Val_Ws32 4294.96729500 Time_Dt -2147.48364800 2147.48364700 FORMAT "%13.8" /end CHARACTERISTIC
/begin CHARACTERISTIC BdInt_tiEngHoodOpen_C "Delay time for detection of engine Hood Open Condition" VALUE 0x80507BAC RB_Val_Ws16 655350.0 Time_ms -327680.0 327670.0 FORMAT "%8.1" /end CHARACTERISTIC
/begin CHARACTERISTIC BdInt_tiRstrtNoPtdCdn_C "Delay time requesting for seat belt off to on when there is a auto restart request" VALUE 0x80507BAE RB_Val_Ws16 655350.0 Time_ms -327680.0 327670.0 FORMAT "%8.1" /end CHARACTERISTIC
/begin CHARACTERISTIC BdInt_tiSeatBltOff_C "Delay timer for seat belt off" VALUE 0x80507BB0 RB_Val_Ws32 4294.96729500 Time_Dt -2147.48364800 2147.48364700 FORMAT "%13.8" /end CHARACTERISTIC
/begin CHARACTERISTIC BrkS_mfIntegIniVal_C "Initial value of integrator for brake pumping" VALUE 0x80505320 RB_Val_Wu16 6553.500 m_q0p1 0.00 6553.500 FORMAT "%8.3" /end CHARACTERISTIC
/begin CHARACTERISTIC BrkS_mfIntegLowrThd_C "Lower thresholf of integrated mass flow" VALUE 0x80505322 RB_Val_Ws16 6553.500 m_q0p1 -3276.800 3276.700 FORMAT "%8.3" /end CHARACTERISTIC
/begin CHARACTERISTIC BrkS_mfIntegUpprThd_T "Tabel for Upper threshold of integrated air mass flow based on Ambient pressure" CURVE 0x80505324 RB_Curve_U16_S16_Static 6553.500 m_q0p1 -3276.800 3276.700 FORMAT "%8.3"
 /begin AXIS_DESCR STD_AXIS PEnv_p p_q0p039 5 0.00 2559.961 FORMAT "%8.3" DEPOSIT ABSOLUTE /end AXIS_DESCR
/end CHARACTERISTIC
/begin CHARACTERISTIC BrkS_mfLimBrkPmpgActvDetn_C "Air mass flow limit beyond which brake pumping is detected as active" VALUE 0x8050533A RB_Val_Wu16 6553.500 m_q0p1 0.00 6553.500 FORMAT "%8.3" /end CHARACTERISTIC
/begin CHARACTERISTIC BrkS_mfLimBrkPmpgInactvDetn_C "Air mass flow limit below which brake pumping is detected as inactive" VALUE 0x8050533C RB_Val_Ws16 6553.500 m_q0p1 -3276.800 3276.700 FORMAT "%8.3" /end CHARACTERISTIC
/begin CHARACTERISTIC BrkS_nEngThd_C "Threshold for Engine speed" VALUE 0x8050533E RB_Val_Ws16 32767.50 EngN -16384.00 16383.50 FORMAT "%8.2" /end CHARACTERISTIC
/begin CHARACTERISTIC BrkS_pIntegDbndLowrThd_C "Lower deadband threshold of integrator" VALUE 0x80505340 RB_Val_Ws16 5119.922 p_q0p078 -2560.000 2559.922 FORMAT "%8.3" /end CHARACTERISTIC
/begin CHARACTERISTIC BrkS_pIntegDbndUpprThd_C "Upper deadband threshold of integrator" VALUE 0x80505342 RB_Val_Ws16 5119.922 p_q0p078 -2560.000 2559.922 FORMAT "%8.3" /end CHARACTERISTIC
/begin CHARACTERISTIC BrkS_stEnaCdn_C "Codeword in BrkS" VALUE 0x80505344 RB_Val_Wu16 65535.00 OneToOne 0.00 65535.00 FORMAT "%8.2" /end CHARACTERISTIC
/begin CHARACTERISTIC BrkS_tiDlyEngStrtFinshd_C "Debounce to detect engine start finished" VALUE 0x80505346 RB_Val_Ws16 25.50000 Time_s 0.00 25.50000 FORMAT "%8.5" EXTENDED_LIMITS -327.6800 327.6700 /end CHARACTERISTIC
/begin CHARACTERISTIC BrkS_tiInteg_C "Reset time of integrator" VALUE 0x80505348 RB_Val_Ws32 4294.9672940000000 TimeDelay_s 0.0000020000000 4294.9672959999998 FORMAT "%19.14" EXTENDED_LIMITS 0.000002000000001 4294.9672959999998 /end CHARACTERISTIC
/begin CHARACTERISTIC BrkS_vVehVThd_C "Threshold for Vehicle speed" VALUE 0x8050534C RB_Val_Ws16 655.3500 Vel -327.6800 327.6700 FORMAT "%8.4" /end CHARACTERISTIC
/begin CHARACTERISTIC CES_CVTNRstrt_GCUR "Fuel restart-speed at transmission intervention" CURVE 0x80504E14 RB_CurveGroup_U8 10200. nmot_ub_q40 0.00 10200. FORMAT "%5.0"
 /begin AXIS_DESCR COM_AXIS CEngDsT_t temp_q0p1_o273 5 -3549.940 3003.560 FORMAT "%8.3" AXIS_PTS_REF CES_tEng_AXIS /end AXIS_DESCR
/end CHARACTERISTIC
/begin AXIS_PTS CES_Gear_AXIS "base point distribution for Tra_numGear smaller than 7" 0x80504E19 CoEng_numGearFcoLoc RB_Axis_S8 255.0 dez 12 -128.0 127.0 FORMAT "%5.1" DEPOSIT ABSOLUTE /end AXIS_PTS
/begin AXIS_PTS CES_nEngGrdt_AXIS "base point distribution for engine speed gradient" 0x80504E26 Epm_dnEngFlt RB_Axis_S16 32767.50 EngNGrd 8 -16384.00 16383.50 FORMAT "%8.2" DEPOSIT ABSOLUTE /end AXIS_PTS
/begin CHARACTERISTIC CES_nRstrtConvSlip_GMAP "Engine-speed for fuel cut-in - converter in slip mode" MAP 0x80504E38 RB_MapGroup_S16 16383.50 nmot_q0p5 0.00 16383.50 FORMAT "%8.2" EXTENDED_LIMITS -16384.00 16383.50
 /begin AXIS_DESCR COM_AXIS CEngDsT_t temp_q0p1_o273 5 -3549.940 3003.560 FORMAT "%8.3" AXIS_PTS_REF CES_tEng_AXIS /end AXIS_DESCR
 /begin AXIS_DESCR COM_AXIS CoEng_numGearFcoLoc dez 12 -128.0 127.0 FORMAT "%5.1" AXIS_PTS_REF CES_Gear_AXIS /end AXIS_DESCR
/end CHARACTERISTIC
/begin CHARACTERISTIC CES_nRstrt_GMAP "Engine-speed for fuel cut-in" MAP 0x80504EB0 RB_MapGroup_S16 16383.50 nmot_q0p5 0.00 16383.50 FORMAT "%8.2" EXTENDED_LIMITS -16384.00 16383.50
 /begin AXIS_DESCR COM_AXIS CEngDsT_t temp_q0p1_o273 5 -3549.940 3003.560 FORMAT "%8.3" AXIS_PTS_REF CES_tEng_AXIS /end AXIS_DESCR
 /begin AXIS_DESCR COM_AXIS CoEng_numGearFcoLoc dez 12 -128.0 127.0 FORMAT "%5.1" AXIS_PTS_REF CES_Gear_AXIS /end AXIS_DESCR
/end CHARACTERISTIC
/begin CHARACTERISTIC CES_rGrip_C "Overrun and Restart: grip threshold for switching to separate calibration labels" VALUE 0x80504F28 RB_Val_Ws16 327.6700 Fact100 0.00 327.6700 FORMAT "%8.4" EXTENDED_LIMITS -327.6800 327.6700 /end CHARACTERISTIC
/begin AXIS_PTS CES_tEng_AXIS "Datapoint distribution, engine temperature, 5 datapoints" 0x80504F2A CEngDsT_t RB_Axis_S16 6553.500 temp_q0p1_o273 5 -3549.940 3003.560 FORMAT "%8.3" DEPOSIT ABSOLUTE /end AXIS_PTS
/begin AXIS_PTS CES_V_AXIS "base point distribution for vehicle velocity" 0x80504F36 VehV_v RB_Axis_S16 655.3500 vel_q0p01 5 -327.6800 327.6700 FORMAT "%8.4" DEPOSIT ABSOLUTE /end AXIS_PTS
/begin CHARACTERISTIC CLUTWMENMN "Threshold for counter clutwmen_w to reset the engine roughness enable condtion with warm engine" VALUE 0x805052CE RB_Val_Wu16 65535.00 dez 0.00 65535.00 FORMAT "%8.2" /end CHARACTERISTIC
/begin CHARACTERISTIC CnvSet_stDiEnchmtMsk_C "Calibratable bit mask for GlbDa_stTrqDem to disable fuel enrichment during torque interventions" VALUE 0x805057B0 RB_Val_Wu16 65535.00 dez 0.00 65535.00 FORMAT "%8.2" /end CHARACTERISTIC
/begin CHARACTERISTIC CoEng_flgFcoRelsCatHeatg_C "Release fuel cutoff in catalyst heating" VALUE 0x80504F42 RB_Val_Wboolean 1.00000000000 B_TRUE 0.00 1.00000000000 FORMAT "%13.11" /end CHARACTERISTIC
/begin CHARACTERISTIC CoEng_flgSwtInhbnFcoFuSysErr_C "An error in the fuel system inhibits fuel cutoff" VALUE 0x80504F43 RB_Val_Wboolean 1.00000000000 B_TRUE 0.00 1.00000000000 FORMAT "%13.11" /end CHARACTERISTIC
/begin CHARACTERISTIC CoEng_flgUseCatWrmReq_C "Cutoff inhibition also for catalyst warming" VALUE 0x80504F44 RB_Val_Wboolean 1.00000000000 B_TRUE 0.00 1.00000000000 FORMAT "%13.11" /end CHARACTERISTIC
/begin CHARACTERISTIC CoEng_idxGearDetnSelnFco_C "Index to choose the gear signal" VALUE 0x80504F45 RB_Val_Wu8 255.0 OneToOne 0.00 255.0 FORMAT "%5.1" /end CHARACTERISTIC
/begin CHARACTERISTIC CoEng_nDeltaNVEngTemp_M "Increase of the engine speed limit for fuel cut-off for a certain vehicle speed range." MAP 0x80504F46 RB_Map_S16S16_S16 16383.50 nmot_q0p5 0.00 16383.50 FORMAT "%8.2" EXTENDED_LIMITS -16384.00 16383.50
 /begin AXIS_DESCR STD_AXIS VehV_v vel_q0p01 5 -327.6800 327.6700 FORMAT "%8.4" DEPOSIT ABSOLUTE /end AXIS_DESCR
 /begin AXIS_DESCR STD_AXIS CEngDsT_t Temp_Cels 5 -3549.940 3003.560 FORMAT "%8.3" DEPOSIT ABSOLUTE /end AXIS_DESCR
/end CHARACTERISTIC
/begin CHARACTERISTIC CoEng_nDeltaNVGear_M "Increase of the engine speed limit for fuel cut-off for low gears." MAP 0x80504F90 RB_Map_S16S8_S16 16383.50 nmot_q0p5 0.00 16383.50 FORMAT "%8.2" EXTENDED_LIMITS -16384.00 16383.50
 /begin AXIS_DESCR STD_AXIS VehV_v vel_q0p01 5 -327.6800 327.6700 FORMAT "%8.4" DEPOSIT ABSOLUTE /end AXIS_DESCR
 /begin AXIS_DESCR STD_AXIS CoEng_numGearFcoLoc OneToOne 12 -128.0 127.0 FORMAT "%5.1" DEPOSIT ABSOLUTE /end AXIS_DESCR
/end CHARACTERISTIC
/begin CHARACTERISTIC CoEng_nDeltaRstrtClimaV_T "Offset dependent on vehicle velocity for restart speed with clima compressor on." CURVE 0x80505022 RB_Curve_S16_U8_Static 10200. nmot_ub_q40 0.00 10200. FORMAT "%5.0"
 /begin AXIS_DESCR STD_AXIS VehV_v vel_q0p01 5 -327.6800 327.6700 FORMAT "%8.4" DEPOSIT ABSOLUTE /end AXIS_DESCR
/end CHARACTERISTIC
/begin CHARACTERISTIC CoEng_nDeltaRstrtClima_GMAP "Offset to the restart speed due to the air conditioning compressor load" MAP 0x80505034 RB_MapGroup_U8 10200. nmot_ub_q40 0.00 10200. FORMAT "%5.0"
 /begin AXIS_DESCR COM_AXIS CEngDsT_t temp_q0p1_o273 5 -3549.940 3003.560 FORMAT "%8.3" AXIS_PTS_REF CES_tEng_AXIS /end AXIS_DESCR
 /begin AXIS_DESCR COM_AXIS CoEng_numGearFcoLoc dez 12 -128.0 127.0 FORMAT "%5.1" AXIS_PTS_REF CES_Gear_AXIS /end AXIS_DESCR
/end CHARACTERISTIC
/begin CHARACTERISTIC CoEng_nDeltaRstrtEngSpdGrdAtLockExtdMod_M "An offset for engine speed limit based on CVT lock up is extended by Alt_flgLockUpCluExtnReq." MAP 0x80505070 RB_Map_S16S16_U8 10200. nmot_ub_q40 0.00 10200. FORMAT "%5.0"
 /begin AXIS_DESCR STD_AXIS Epm_dnEngFlt EngNGrd 5 -16384.00 16383.50 FORMAT "%8.2" DEPOSIT ABSOLUTE /end AXIS_DESCR
 /begin AXIS_DESCR STD_AXIS VehV_v vel_q0p01 5 -327.6800 327.6700 FORMAT "%8.4" DEPOSIT ABSOLUTE /end AXIS_DESCR
/end CHARACTERISTIC
/begin CHARACTERISTIC CoEng_nDeltaRstrtEngSpdGrdAt_M "An offset for engine speed limit based on CVT lock up is not extended by Alt_flgLockUpCluExtnReq." MAP 0x805050A2 RB_Map_S16S16_U8 10200. nmot_ub_q40 0.00 10200. FORMAT "%5.0"
 /begin AXIS_DESCR STD_AXIS Epm_dnEngFlt EngNGrd 5 -16384.00 16383.50 FORMAT "%8.2" DEPOSIT ABSOLUTE /end AXIS_DESCR
 /begin AXIS_DESCR STD_AXIS VehV_v vel_q0p01 5 -327.6800 327.6700 FORMAT "%8.4" DEPOSIT ABSOLUTE /end AXIS_DESCR
/end CHARACTERISTIC
/begin CHARACTERISTIC CoEng_nDeltaRstrtNGrdt_M "An offset for engine speed limit based on neutral gear position" MAP 0x805050D4 RB_Map_S16S16_U8 10200. nmot_ub_q40 0.00 10200. FORMAT "%5.0"
 /begin AXIS_DESCR STD_AXIS Epm_dnEngFlt EngNGrd 8 -16384.00 16383.50 FORMAT "%8.2" DEPOSIT ABSOLUTE /end AXIS_DESCR
 /begin AXIS_DESCR STD_AXIS VehV_v vel_q0p01 5 -327.6800 327.6700 FORMAT "%8.4" DEPOSIT ABSOLUTE /end AXIS_DESCR
/end CHARACTERISTIC
/begin CHARACTERISTIC CoEng_nRstrtAirCdng_C "Delta speed to restart fuel feed if air conditioning has just been switched on" VALUE 0x8050511A RB_Val_Wu8 10200. nmot_ub_q40 0.00 10200. FORMAT "%5.0" /end CHARACTERISTIC
/begin CHARACTERISTIC CoEng_nSpLoOffs_T "Value to increase the engine speed for retsart" CURVE 0x8050511C RB_Curve_S16_S16 16383.50 nmot_sw_q0p5 0.00 16383.50 FORMAT "%8.2" EXTENDED_LIMITS -16384.00 16383.50
 /begin AXIS_DESCR STD_AXIS HLSDem_nSetPLo nmot_sw_q0p5 6 -16384.00 16383.50 FORMAT "%8.2" DEPOSIT ABSOLUTE /end AXIS_DESCR
/end CHARACTERISTIC
/begin CHARACTERISTIC CoEng_nThdRstrtABSFailr_C "Engine speed threshold for engine restart during ABS failure" VALUE 0x80505136 RB_Val_Ws16 32767.50 nmot_q0p5 -16384.00 16383.50 FORMAT "%8.2" /end CHARACTERISTIC
/begin CHARACTERISTIC CoEng_stFcoGearCatHeatg_T "Fuel cut-off status of the gear catalyst heating." CURVE 0x80505138 RB_Curve_S8_S8 127.0 dez 0.00 127.0 FORMAT "%5.1" EXTENDED_LIMITS -128.0 127.0
 /begin AXIS_DESCR STD_AXIS Tra_numGear dez 11 -128.0 127.0 FORMAT "%5.1" DEPOSIT ABSOLUTE /end AXIS_DESCR
/end CHARACTERISTIC
/begin CHARACTERISTIC CoEng_stTqDmdFcoInhbnMask_C "Thershold for torque demand Fuel-cut off inhibition" VALUE 0x80505150 RB_Val_Wu32 4294967295.00 OneToOne 0.00 4294967295.00 FORMAT "%13.2" /end CHARACTERISTIC
/begin CHARACTERISTIC CoEng_tEngMinFco_C "Engine temperature lower threshold for fuel cutoff" VALUE 0x80505154 RB_Val_Ws16 6553.500 Temp_Cels -3549.940 3003.560 FORMAT "%8.3" /end CHARACTERISTIC
/begin CHARACTERISTIC CoEng_tiRstrtAirCdng_C "Time to retain delta speed for restarting fuel feed after air conditioning is switched on" VALUE 0x80505156 RB_Val_Wu16 655.3500 t_q0p01 0.00 655.3500 FORMAT "%8.4" /end CHARACTERISTIC
/begin CHARACTERISTIC CoEng_vThdVehStop_C "Threshold for vehicle standstill detection" VALUE 0x80505158 RB_Val_Ws16 10.00000 vel_q0p01 0.00 10.00000 FORMAT "%8.5" EXTENDED_LIMITS -327.6800 327.6700 /end CHARACTERISTIC
/begin CHARACTERISTIC Com_aLatGA_C "Default value of Lattitude_G information" VALUE 0x8053A680 Val_Wu16 48.95205 Com_aLgtG_Compu -24.49995 24.45210 FORMAT "%8.5" EXTENDED_LIMITS -24.49995 3111.446 /end CHARACTERISTIC
/begin CHARACTERISTIC Com_aLgtG_C "Default value parameter for Com_aLgtG message" VALUE 0x8053A682 Val_Wu16 48.95205 Com_aLgtG_Compu -24.49995 24.45210 FORMAT "%8.5" EXTENDED_LIMITS -24.49995 3111.446 /end CHARACTERISTIC
/begin CHARACTERISTIC Com_ctCRingSRSA_C "Default value parameter for Com_ctCRingSRSA message" VALUE 0x8053A684 Val_Wu8 3.000 OneToOne 0.00 3.000 FORMAT "%5.3" EXTENDED_LIMITS 0.00 255.0 /end CHARACTERISTIC
/begin CHARACTERISTIC Com_ctCRingSRSB_C "Default application value for Com_ctCRingSRSB in case of defective reception" VALUE 0x80507BC0 RB_Val_Wu8 3.000 OneToOne 0.00 3.000 FORMAT "%5.3" EXTENDED_LIMITS 0.00 255.0 /end CHARACTERISTIC
/begin CHARACTERISTIC Com_ctCRingSRS_C "Default application value for Com_ctCRingSRS in case of defective reception" VALUE 0x80507BB6 RB_Val_Wu8 3.000 OneToOne 0.00 3.000 FORMAT "%5.3" EXTENDED_LIMITS 0.00 255.0 /end CHARACTERISTIC
/begin CHARACTERISTIC Com_ctSRSReWrThres_C "Threshold of receiving counter of SRS reprogramming start flag" VALUE 0x80507BC1 RB_Val_Wu8 25.00 OneToOne 0.00 25.00 FORMAT "%5.2" EXTENDED_LIMITS 0.00 255.0 /end CHARACTERISTIC
/begin CHARACTERISTIC Com_dBCM1MaxDiff_C "BCM1 calibration for max difference" VALUE 0x80507BB4 RB_Val_Wu8 255.0 OneToOne 0.00 255.0 FORMAT "%5.1" /end CHARACTERISTIC
/begin CHARACTERISTIC Com_dBCM1MaxPer_C "BCM1 calibration for max period" VALUE 0x80507BB5 RB_Val_Wu8 255.0 OneToOne 0.00 255.0 FORMAT "%5.1" /end CHARACTERISTIC
/begin CHARACTERISTIC Com_dSRSAMaxDiff_C "Maximum value of period for detection of SRSA stopped message counter" VALUE 0x8053A685 Val_Wu8 255.0 OneToOne 0.00 255.0 FORMAT "%5.1" /end CHARACTERISTIC
/begin CHARACTERISTIC Com_dSRSAMaxPer_C "Maximum value of period for detection of SRSA stopped message counter" VALUE 0x8053A686 Val_Wu8 255.0 OneToOne 0.00 255.0 FORMAT "%5.1" /end CHARACTERISTIC
/begin CHARACTERISTIC Com_dSRSASigSel_C "Signal selection data for SRSA frame" VALUE 0x80507BBC RB_Val_Wu8 255.0 OneToOne 0.00 255.0 FORMAT "%5.1" /end CHARACTERISTIC
/begin CHARACTERISTIC Com_dSRSBMaxDiff_C "Application constant for Maximum difference between the counter values for SRSB frame." VALUE 0x80507BC2 RB_Val_Wu8 255.0 OneToOne 0.00 255.0 FORMAT "%5.1" /end CHARACTERISTIC
/begin CHARACTERISTIC Com_dSRSBMaxPer_C "Period for SRSB frame" VALUE 0x80507BC3 RB_Val_Wu8 255.0 OneToOne 0.00 255.0 FORMAT "%5.1" /end CHARACTERISTIC
/begin CHARACTERISTIC Com_dSRSMaxDiff_C "Application constant for Maximum difference between the counter values for SRS frame." VALUE 0x80507BB7 RB_Val_Wu8 255.0 OneToOne 0.00 255.0 FORMAT "%5.1" /end CHARACTERISTIC
/begin CHARACTERISTIC Com_dSRSMaxPer_C "Period for SRS frame." VALUE 0x80507BB8 RB_Val_Wu8 255.0 OneToOne 0.00 255.0 FORMAT "%5.1" /end CHARACTERISTIC
/begin CHARACTERISTIC Com_numCsumSRSA_C "default value parameter for Com_numCsumSRSA message" VALUE 0x8053A687 Val_Wu8 15.00 OneToOne 0.00 15.00 FORMAT "%5.2" EXTENDED_LIMITS 0.00 255.0 /end CHARACTERISTIC
/begin CHARACTERISTIC Com_numCsumSRSB_C "Default application value for Com_numCsumSRSB in case of defective reception" VALUE 0x80507BC4 RB_Val_Wu8 15.00 OneToOne 0.00 15.00 FORMAT "%5.2" EXTENDED_LIMITS 0.00 255.0 /end CHARACTERISTIC
/begin CHARACTERISTIC Com_numCsumSRS_C "Default application value for Com_numCsumSRS in case of defective reception." VALUE 0x80507BB9 RB_Val_Wu8 15.00 OneToOne 0.00 15.00 FORMAT "%5.2" EXTENDED_LIMITS 0.00 255.0 /end CHARACTERISTIC
/begin CHARACTERISTIC Com_nYaw1UpprData_C "YAW1 Upper Data parameter" VALUE 0x8053A688 Val_Wu16 249.7559 YawRate_q0p2441_om125 -125.0000 124.7559 FORMAT "%8.4" EXTENDED_LIMITS -125.0000 15874.76 /end CHARACTERISTIC
/begin CHARACTERISTIC Com_stAbnormCpu_C "Default value parameter for Com_stAbnormCpu message" VALUE 0x8053A68A Val_Wu8 1.000 OneToOne 0.00 1.000 FORMAT "%5.3" EXTENDED_LIMITS 0.00 255.0 /end CHARACTERISTIC
/begin CHARACTERISTIC Com_stAbnormVcc_C "Default value parameter for Com_stAbnormVcc message" VALUE 0x8053A68B Val_Wu8 1.000 OneToOne 0.00 1.000 FORMAT "%5.3" EXTENDED_LIMITS 0.00 255.0 /end CHARACTERISTIC
/begin CHARACTERISTIC Com_stCalCmplLatG_C "Default value of Lateral_G calibration complete" VALUE 0x80507BBD RB_Val_Wu8 255.0 OneToOne 0.00 255.0 FORMAT "%5.1" /end CHARACTERISTIC
/begin CHARACTERISTIC Com_stCalCmplLgtG_C "Default value parameter for Com_stCalCmplLgtG message" VALUE 0x80507BBE RB_Val_Wu8 255.0 OneToOne 0.00 255.0 FORMAT "%5.1" /end CHARACTERISTIC
/begin CHARACTERISTIC Com_stFailrLatG_C "Default value of Lateral_G failure" VALUE 0x8053A68C Val_Wu8 1.000 OneToOne 0.00 1.000 FORMAT "%5.3" EXTENDED_LIMITS 0.00 255.0 /end CHARACTERISTIC
/begin CHARACTERISTIC Com_stFailrLgtG_C "Default value parameter for Com_stFailrLgtG message" VALUE 0x8053A68D Val_Wu8 1.000 OneToOne 0.00 1.000 FORMAT "%5.3" EXTENDED_LIMITS 0.00 255.0 /end CHARACTERISTIC
/begin CHARACTERISTIC Com_stPrmntErrYaw1_C "YAW1 Permanent Error Parameter" VALUE 0x8053A68E Val_Wu8 255.0 OneToOne 0.00 255.0 FORMAT "%5.1" /end CHARACTERISTIC
/begin CHARACTERISTIC Com_stSeatBltInfo_C "Default application value for Com_stSeatBltInfoin case of defective reception." VALUE 0x80507BBA RB_Val_Wu8 3.00000000000 Com_stSeatBltInfo_COMPU_VERB 0.00 3.00000000000 FORMAT "%13.11" /end CHARACTERISTIC
/begin CHARACTERISTIC Com_stStrtupProc_C "Default value parameter for Com_stStrtupProc message" VALUE 0x8053A68F Val_Wu8 1.000 OneToOne 0.00 1.000 FORMAT "%5.3" EXTENDED_LIMITS 0.00 255.0 /end CHARACTERISTIC
/begin CHARACTERISTIC Com_stTempAbnormLatG_C "Default value of Temporarily abnormal Lateral-G" VALUE 0x8053A690 Val_Wu8 1.000 OneToOne 0.00 1.000 FORMAT "%5.3" EXTENDED_LIMITS 0.00 255.0 /end CHARACTERISTIC
/begin CHARACTERISTIC Com_stTempAbnormLgtG_C "Default value parameter for Com_stTempAbnormLgtG message" VALUE 0x8053A691 Val_Wu8 1.000 OneToOne 0.00 1.000 FORMAT "%5.3" EXTENDED_LIMITS 0.00 255.0 /end CHARACTERISTIC
/begin CHARACTERISTIC Com_stTmpErrYaw1_C "YAW1 Temporary Error Parameter" VALUE 0x8053A692 Val_Wu8 3.000 OneToOne 0.00 3.000 FORMAT "%5.3" EXTENDED_LIMITS 0.00 255.0 /end CHARACTERISTIC
/begin CHARACTERISTIC CWBBKHFES "Codeword: request on air charge control in due of catalyst heating" VALUE 0x80504AC4 RB_Val_Wu16 65535.00 dez 0.00 65535.00 FORMAT "%8.2" /end CHARACTERISTIC
/begin CHARACTERISTIC CWBBSTNSAD "Codeword for operation condition of start- afterstart adaptation" VALUE 0x805052D0 RB_Val_Wu8 255.0 dez 0.00 255.0 FORMAT "%5.1" /end CHARACTERISTIC
/begin CHARACTERISTIC CWBBSTNSAD2 "Codeword for operation condition of start- afterstart adaptation" VALUE 0x805052D1 RB_Val_Wu8 255.0 dez 0.00 255.0 FORMAT "%5.1" /end CHARACTERISTIC
/begin CHARACTERISTIC CWBBSTNSAD3 "Codeword for operation condition of start- afterstart adaptation" VALUE 0x805052D2 RB_Val_Wu8 255.0 dez 0.00 255.0 FORMAT "%5.1" /end CHARACTERISTIC
/begin CHARACTERISTIC CWBGADAP "code word for BGADAP" VALUE 0x80505304 RB_Val_Wu8 255.0 dez 0.00 255.0 FORMAT "%5.1" /end CHARACTERISTIC
/begin CHARACTERISTIC CWBH "cw for configuration of %BGBH" VALUE 0x8050531A RB_Val_Wu8 255.0 dez 0.00 255.0 FORMAT "%5.1" /end CHARACTERISTIC
/begin CHARACTERISTIC CWLAMFAW "Configuration of LAMFAW" VALUE 0x805057B2 RB_Val_Wu8 255.0 dez 0.00 255.0 FORMAT "%5.1" /end CHARACTERISTIC
/begin CHARACTERISTIC CWNWEGTR "Code word: resume speed at transmission-shift control" VALUE 0x8050515A RB_Val_Wu8 255.0 dez 0.00 255.0 FORMAT "%5.1" /end CHARACTERISTIC
/begin CHARACTERISTIC CWSAWE "code word to enable fuel cut off - fuel restart" VALUE 0x8050515C RB_Val_Wu16 65535.00 dez 0.00 65535.00 FORMAT "%8.2" /end CHARACTERISTIC
/begin CHARACTERISTIC CWTIPIN "Codeword for tip in function" VALUE 0x80504C1A RB_Val_Wu8 255.0 dez 0.00 255.0 FORMAT "%5.1" /end CHARACTERISTIC
/begin CHARACTERISTIC DFKMSDELSR "allowed delta between fkmsdks and 1 for detection of leakage to manifold" VALUE 0x80505306 RB_Val_Wu16 0.2000122 fak_q6p1035Em5 0.00 0.2000122 FORMAT "%9.7" EXTENDED_LIMITS 0.00 3.999939 /end CHARACTERISTIC
/begin CHARACTERISTIC DLAMFAW "Threshold value for activation of mixture enrichment by driver command" VALUE 0x805057B4 RB_Val_Wu16 15.99976 fak_uw_b16 0.00 15.99976 FORMAT "%8.5" /end CHARACTERISTIC
/begin CHARACTERISTIC DNSAH "Delta n overrun cut-off high with reference to n reinstatement" VALUE 0x8050515E RB_Val_Ws16 8191.750 nmot_sw_q0p25 0.00 8191.750 FORMAT "%8.3" EXTENDED_LIMITS -8192.000 8191.750 /end CHARACTERISTIC
/begin CHARACTERISTIC DNSAHS "Delta n overrun cut-off high with reference to n reinstatement - converter in slip mode" VALUE 0x80505160 RB_Val_Ws16 8191.750 nmot_sw_q0p25 0.00 8191.750 FORMAT "%8.3" EXTENDED_LIMITS -8192.000 8191.750 /end CHARACTERISTIC
/begin CHARACTERISTIC DNSAL "Delta n overrun cut-off low with reference to n reinstatement" VALUE 0x80505162 RB_Val_Ws16 8191.750 nmot_sw_q0p25 0.00 8191.750 FORMAT "%8.3" EXTENDED_LIMITS -8192.000 8191.750 /end CHARACTERISTIC
/begin CHARACTERISTIC DNSALH "Delta n overrun cut-off high with reference to n reinstatement at idle" VALUE 0x80505164 RB_Val_Ws16 8191.750 nmot_sw_q0p25 0.00 8191.750 FORMAT "%8.3" EXTENDED_LIMITS -8192.000 8191.750 /end CHARACTERISTIC
/begin CHARACTERISTIC DNSALHS "Delta n overrun cut-off high with reference to n reinstatement at idle - converter in slip mode" VALUE 0x80505166 RB_Val_Ws16 8191.750 nmot_sw_q0p25 0.00 8191.750 FORMAT "%8.3" EXTENDED_LIMITS -8192.000 8191.750 /end CHARACTERISTIC
/begin CHARACTERISTIC DNSALS "Delta n overrun cut-off low with reference to n reinstatement - converter in slip mode" VALUE 0x80505168 RB_Val_Ws16 8191.750 nmot_sw_q0p25 0.00 8191.750 FORMAT "%8.3" EXTENDED_LIMITS -8192.000 8191.750 /end CHARACTERISTIC
/begin CHARACTERISTIC DNSATIP "cut off engine speed increase at tip gutter" VALUE 0x8050516A RB_Val_Ws16 16383.50 nmot_q0p5 0.00 16383.50 FORMAT "%8.2" EXTENDED_LIMITS -16384.00 16383.50 /end CHARACTERISTIC
/begin CHARACTERISTIC DNSLL "Overrun cut-off hysteresis for reinstatement at idle" VALUE 0x8050516C RB_Val_Ws16 8191.750 nmot_sw_q0p25 0.00 8191.750 FORMAT "%8.3" EXTENDED_LIMITS -8192.000 8191.750 /end CHARACTERISTIC
/begin CHARACTERISTIC DNSLLK "Overrun cut-off hysteresis for reinstatement at idle and disengaged clutch" VALUE 0x8050516E RB_Val_Ws16 16383.50 nmot_q0p5 0.00 16383.50 FORMAT "%8.2" EXTENDED_LIMITS -16384.00 16383.50 /end CHARACTERISTIC
/begin CHARACTERISTIC DNSLLS "Overrun cut-off hysteresis for reinstatement at idle - converter in slip mode" VALUE 0x80505170 RB_Val_Ws16 8191.750 nmot_sw_q0p25 0.00 8191.750 FORMAT "%8.3" EXTENDED_LIMITS -8192.000 8191.750 /end CHARACTERISTIC
/begin CHARACTERISTIC DOFMSNDK "Threshold for difference between actual and old leakage air massflow throttle valve" VALUE 0x80505308 RB_Val_Ws16 6553.500 m_q0p1 -3276.800 3276.700 FORMAT "%8.3" /end CHARACTERISTIC
/begin CHARACTERISTIC DSDLUTSR "Number of synchros lead for calculation of standard deviation of engine roughness" VALUE 0x805052D3 RB_Val_Wu8 255.0 dez 0.00 255.0 FORMAT "%5.1" /end CHARACTERISTIC
/begin CHARACTERISTIC DTMSRT "difference of engine cool.temp.to starttemp.for retriggering models (blockheater" VALUE 0x8050531B RB_Val_Wu8 191.3 temp_ub_q0p75_o48 -48.0 143.3 FORMAT "%5.1" /end CHARACTERISTIC
/begin CHARACTERISTIC DZWETAI "Delta ignition angle from efficiency" CURVE 0x80505358 RB_Curve_U16_S16_Static 95.99707 zw_q2p9297Em3_deg_KW 0.00 95.99707 FORMAT "%8.5" EXTENDED_LIMITS -96.00000 95.99707
 /begin AXIS_DESCR STD_AXIS NO_INPUT_QUANTITY fak_uw_b2 41 0.00 1.000000 FORMAT "%8.6" EXTENDED_LIMITS 0.00 1.999969 DEPOSIT ABSOLUTE /end AXIS_DESCR
/end CHARACTERISTIC
/begin CHARACTERISTIC EngStrt_cntrAftStrtDly_C "Caliberation to set delay in stopping afterstart adaptation" VALUE 0x805052D4 RB_Val_Wu8 255.0 OneToOne 0.00 255.0 FORMAT "%5.1" /end CHARACTERISTIC
/begin CHARACTERISTIC EngStrt_swtAftStopInhb_C "Codeword for enabling condition of After stop inhibition" VALUE 0x805052D5 RB_Val_Wu8 255.0 OneToOne 0.00 255.0 FORMAT "%5.1" /end CHARACTERISTIC
/begin CHARACTERISTIC EngStrt_SwtTankEmptyResvEna_C "Code word to enable disabling b_tal." VALUE 0x805052D6 RB_Val_Wu8 255.0 dez 0.00 255.0 FORMAT "%5.1" /end CHARACTERISTIC
/begin CHARACTERISTIC EngStrt_tAftStrtSwtOff_C "Time delay switch off afterstart adaptation by active lambda control" VALUE 0x805052D8 RB_Val_Wu16 60.00000 t100msxs_uw_b6553p5 0.00 60.00000 FORMAT "%8.5" EXTENDED_LIMITS 0.00 6553.500 /end CHARACTERISTIC
/begin CHARACTERISTIC EngStrt_tiFallDebStOfClu_C "stopping time after release clutch" VALUE 0x805052DA RB_Val_Wu8 25.50 t100msxs_ub_b25p5 0.00 25.50 FORMAT "%5.2" /end CHARACTERISTIC
/begin CHARACTERISTIC EngStrt_tiRiseDebStOfClu_C "stopping time after step on clutch" VALUE 0x805052DB RB_Val_Wu8 25.50 t100msxs_ub_b25p5 0.00 25.50 FORMAT "%5.2" /end CHARACTERISTIC
/begin CHARACTERISTIC EngStrt_vVehInhb_C "Characterictic Value for the vehicle speed inhibition" VALUE 0x805052DC RB_Val_Ws16 655.3500 Vel -327.6800 327.6700 FORMAT "%8.4" /end CHARACTERISTIC
/begin CHARACTERISTIC ENSAD "Number of exceeding e. roughness th. for activation afterstart adaption" VALUE 0x805052DE RB_Val_Wu8 255.0 dez 0.00 255.0 FORMAT "%5.1" /end CHARACTERISTIC
/begin CHARACTERISTIC ESDLUTS "Number of synchros for calculation of standard dev. of engine roughness" VALUE 0x805052DF RB_Val_Wu8 255.0 dez 0.00 255.0 FORMAT "%5.1" /end CHARACTERISTIC
/begin CHARACTERISTIC ETADZWI "ignition efficiency depending on delta ignition angle" CURVE 0x805053FE RB_Curve_S16_U16_Static 1.000000 fak_uw_b2 0.00 1.000000 FORMAT "%8.6" EXTENDED_LIMITS 0.00 1.999969
 /begin AXIS_DESCR STD_AXIS NO_INPUT_QUANTITY zw_q2p9297Em3_deg_KW 41 -96.00000 95.99707 FORMAT "%8.5" DEPOSIT ABSOLUTE /end AXIS_DESCR
/end CHARACTERISTIC
/begin CHARACTERISTIC ExhMgT_facLamAltiCatHeatgAirm_GM "factor for the control lambda during cold start in altitude in dependence of heating progress and engine temperature" MAP 0x80504AC6 RB_MapGroup_U8 1.000000 fak_ub_b2 0.00 1.000000 FORMAT "%8.6" EXTENDED_LIMITS 0.00 1.992188
 /begin AXIS_DESCR COM_AXIS ExhMgT_tEngCatHeatgFild Temp_Cels 8 -3549.940 3003.560 FORMAT "%8.3" AXIS_PTS_REF STCS08KHSW /end AXIS_DESCR
 /begin AXIS_DESCR COM_AXIS ExhMgT_facCatHeatgProgs fak_uw_b1 8 0.00 0.9999847 FORMAT "%9.7" AXIS_PTS_REF SIM08KHUW /end AXIS_DESCR
/end CHARACTERISTIC
/begin CHARACTERISTIC ExhMgT_facLamCatHeatgAirm_GM "weighting factor for lambda during catalyst heating in dependence of heating progress" MAP 0x80504B06 RB_MapGroup_U8 1.000000 fak_ub_b2 0.00 1.000000 FORMAT "%8.6" EXTENDED_LIMITS 0.00 1.992188
 /begin AXIS_DESCR COM_AXIS ExhMgT_tEngCatHeatgFild Temp_Cels 8 -3549.940 3003.560 FORMAT "%8.3" AXIS_PTS_REF STCS08KHSW /end AXIS_DESCR
 /begin AXIS_DESCR COM_AXIS ExhMgT_facCatHeatgProgs fak_uw_b1 8 0.00 0.9999847 FORMAT "%9.7" AXIS_PTS_REF SIM08KHUW /end AXIS_DESCR
/end CHARACTERISTIC
/begin CHARACTERISTIC ExhMgT_facLamCatHeatgRamp_M "Correction factor for the lambda weighinh factor in case of cold start catalyst heating" MAP 0x80504B46 RB_Map_S16U16_U8 0.9961 fak_ub_b1 0.00 0.9961
 /begin AXIS_DESCR STD_AXIS ExhMgT_tCatHeatgTCatSelnFild temp_q0p1_K 8 -3276.800 3276.700 FORMAT "%8.3" DEPOSIT ABSOLUTE /end AXIS_DESCR
 /begin AXIS_DESCR STD_AXIS ExhMgT_mfExhCat1B1Fild m_uw_b6553p5 8 0.00 6553.500 FORMAT "%8.3" DEPOSIT ABSOLUTE /end AXIS_DESCR
/end CHARACTERISTIC
/begin CHARACTERISTIC ExhMgT_facLamCatWrm_T "control factor for lambda during catalyst warming" CURVE 0x80504BAA RB_Curve_S16_U8_Static 1.000000 fak_ub_b2 0.00 1.000000 FORMAT "%8.6" EXTENDED_LIMITS 0.00 1.992188
 /begin AXIS_DESCR STD_AXIS ExhMgT_tCatHeatgTCatSelnActn temp_q0p1_K 8 -3276.800 3276.700 FORMAT "%8.3" DEPOSIT ABSOLUTE /end AXIS_DESCR
/end CHARACTERISTIC
/begin CHARACTERISTIC ExhMgT_facLamCtrlAlti_T "altitude correction factor curve for the control lambda during cold start" CURVE 0x80504BC4 RB_Curve_U16_U8_Static 0.9961 fak_ub_b1 0.00 0.9961
 /begin AXIS_DESCR STD_AXIS PEnv_facCorrAlti fak_uw_b4 4 0.00 3.999939 FORMAT "%8.6" DEPOSIT ABSOLUTE /end AXIS_DESCR
/end CHARACTERISTIC
/begin CHARACTERISTIC ExhMgT_tiFilMfExhCat1B1_T "Filtertime for exhaust mass flow catalyst 1 bank 1" CURVE 0x80504BD2 RB_Curve_U16_U16 6553.400 t_q0p1 0.100 6553.500 FORMAT "%8.3" EXTENDED_LIMITS 0.00 6553.500
 /begin AXIS_DESCR STD_AXIS ExhMgT_mfExhCat1B1Dif m_uw_b6553p5 4 0.00 6553.500 FORMAT "%8.3" DEPOSIT ABSOLUTE /end AXIS_DESCR
/end CHARACTERISTIC
/begin CHARACTERISTIC ExhMgT_tiFilTCat_T "Filtertime for catalst temperature" CURVE 0x80504BE4 RB_Curve_U16_U16 6553.400 t_q0p1 0.100 6553.500 FORMAT "%8.3" EXTENDED_LIMITS 0.00 6553.500
 /begin AXIS_DESCR STD_AXIS ExhMgT_tCatHeatgTCatSelnActnDif temp_q0p1_K 4 0.00 6553.500 FORMAT "%8.3" DEPOSIT ABSOLUTE /end AXIS_DESCR
/end CHARACTERISTIC
/begin CHARACTERISTIC FSDLUSOL "Factor desired value standard deviation engine roughness" VALUE 0x805052E0 RB_Val_Wu8 1.992188 fak_ub_b2 0.00 1.992188 FORMAT "%8.6" /end CHARACTERISTIC
/begin CHARACTERISTIC IBSUMH.Batt_qSumHiLim_C "Class instance for calculation of Battery current integral ( hi charge efficiency ) / Battery current integral ( hi charge efficiency limit" VALUE 0x80507B44 RB_Val_Ws32 4294967.29500 RBPtCel_q_0p001_1 -2147483.64800 2147483.64700 FORMAT "%13.5" /end CHARACTERISTIC
/begin CHARACTERISTIC IBSUMHNR.Batt_qSumHiNRLim_C "Battery current integral wo reset / Battery current integral wo reset" VALUE 0x80507B48 RB_Val_Ws32 4294967.29500 RBPtCel_q_0p001_1 -2147483.64800 2147483.64700 FORMAT "%13.5" /end CHARACTERISTIC
/begin CHARACTERISTIC IBSUML.Batt_qSumLoLim_C "Class instance for calculation of Battery current integral ( Low charge efficiency ) / Battery current integral ( Low charge efficiency) limit" VALUE 0x80507B4C RB_Val_Ws32 4294967.29500 RBPtCel_q_0p001_1 -2147483.64800 2147483.64700 FORMAT "%13.5" /end CHARACTERISTIC
/begin CHARACTERISTIC IKCtl_cntrStrtEnd_C "number of combustions to deactivate knock control after start end" VALUE 0x80504C1B RB_Val_Wu8 254.0 dez 1.0 255.0 FORMAT "%5.1" EXTENDED_LIMITS 0.00 255.0 /end CHARACTERISTIC
/begin CHARACTERISTIC IKCtl_DlyTnKnkEna_T "Time delay for Condition knock control active" CURVE 0x80504C1C RB_Curve_S16_U8_Static 2.550 t_q0p01 0.00 2.550 FORMAT "%5.3"
 /begin AXIS_DESCR STD_AXIS Epm_nEng EngN 6 -16384.00 16383.50 FORMAT "%8.2" DEPOSIT ABSOLUTE /end AXIS_DESCR
/end CHARACTERISTIC
/begin CHARACTERISTIC IKCtl_dnSelnFildGrdt_C "Codeword for selection of filtered gradient" VALUE 0x80504C30 RB_Val_Wu8 255.0 dez 0.00 255.0 FORMAT "%5.1" /end CHARACTERISTIC
/begin CHARACTERISTIC IKCtl_facDlyAdpn_T "IKC: dynamic dalay for the steady state adaptation enable" CURVE 0x80504C32 RB_Curve_S16_U8_Static 2.550 t_q0p01 0.00 2.550 FORMAT "%5.3"
 /begin AXIS_DESCR STD_AXIS Epm_nEng EngN 4 -16384.00 16383.50 FORMAT "%8.2" DEPOSIT ABSOLUTE /end AXIS_DESCR
/end CHARACTERISTIC
/begin CHARACTERISTIC IKCtl_facDlyLoadDynDetn_GT "Knock control: delay for dynamic detection" CURVE 0x80504C40 RB_CurveGroup_U8 32.00 dez 0.00 32.00 FORMAT "%5.2" EXTENDED_LIMITS 0.00 255.0
 /begin AXIS_DESCR COM_AXIS Epm_nEng EngN 8 -16384.00 16383.50 FORMAT "%8.2" AXIS_PTS_REF IKCtl_nEng08_X_AX /end AXIS_DESCR
/end CHARACTERISTIC
/begin CHARACTERISTIC IKCtl_facFildNGrdt_C "Gain constant for the filtered engine-speed gradient" VALUE 0x80504C48 RB_Val_Wu16 0.9999695 fak_uw_b1 0.0000153 0.9999847 FORMAT "%9.7" EXTENDED_LIMITS 0.00 0.9999847 /end CHARACTERISTIC
/begin CHARACTERISTIC IKCtl_facKnkEna_C "engine speed threshold to enable knock control" VALUE 0x80504C4A RB_Val_Ws16 32767.50 EngN -16384.00 16383.50 FORMAT "%8.2" /end CHARACTERISTIC
/begin CHARACTERISTIC IKCtl_facOffsLoadDynDetn_GT "Knock control: dynamic detection offset factor" CURVE 0x80504C4C RB_CurveGroup_U8 2.984 fak_ub_b4 1.000 3.984 FORMAT "%5.3" EXTENDED_LIMITS 0.00 3.984
 /begin AXIS_DESCR COM_AXIS AirMod_ratChrgAirCyl rel_uw_q0p0234 4 0.00 1535.977 FORMAT "%8.3" AXIS_PTS_REF IKCtl_ratLoadDy04_X_AX /end AXIS_DESCR
/end CHARACTERISTIC
/begin CHARACTERISTIC IKCtl_facSpdAdpn1_C "speed range for adaption maps, Stützstelle 1" VALUE 0x80504C50 RB_Val_Ws16 32767.50 EngN -16384.00 16383.50 FORMAT "%8.2" /end CHARACTERISTIC
/begin CHARACTERISTIC IKCtl_facSpdAdpn2_C "speed range for adaption maps, Stützstelle 2" VALUE 0x80504C52 RB_Val_Ws16 32767.50 EngN -16384.00 16383.50 FORMAT "%8.2" /end CHARACTERISTIC
/begin CHARACTERISTIC IKCtl_facSpdAdpn3_C "speed range for adaption maps, Stützstelle 3" VALUE 0x80504C54 RB_Val_Ws16 32767.50 EngN -16384.00 16383.50 FORMAT "%8.2" /end CHARACTERISTIC
/begin CHARACTERISTIC IKCtl_facSpdAdpn4_C "speed range for adaption maps, Stützstelle 4" VALUE 0x80504C56 RB_Val_Ws16 32767.50 EngN -16384.00 16383.50 FORMAT "%8.2" /end CHARACTERISTIC
/begin CHARACTERISTIC IKCtl_facTAdapEna_C "engine temperature threshold for adaptive knock control" VALUE 0x80504C58 RB_Val_Ws16 6553.500 Temp_Cels -3549.940 3003.560 FORMAT "%8.3" /end CHARACTERISTIC
/begin CHARACTERISTIC IKCtl_facThdLoadDynDetnAirChrg_GM "Threshold for dynamic presetting values based on relative air charge in the cylinder" MAP 0x80504C5A RB_MapGroup_U16 1535.977 rel_uw_q0p0234 0.00 1535.977 FORMAT "%8.3"
 /begin AXIS_DESCR COM_AXIS Epm_nEng EngN 13 -16384.00 16383.50 FORMAT "%8.2" AXIS_PTS_REF IKCtl_nEngVar13_X_AX /end AXIS_DESCR
 /begin AXIS_DESCR COM_AXIS AirMod_ratChrgAirCyl rel_uw_q0p0234 4 0.00 1535.977 FORMAT "%8.3" AXIS_PTS_REF IKCtl_ratLoadDy04_X_AX /end AXIS_DESCR
/end CHARACTERISTIC
/begin CHARACTERISTIC IKCtl_facThdLoadDynDetn_GT "Threshold for dynamic presetting values" MAP 0x80504CC2 RB_MapGroup_S8 1270. p_q10 0.00 1270. FORMAT "%5.0" EXTENDED_LIMITS -1280. 1270.
 /begin AXIS_DESCR COM_AXIS Epm_nEng EngN 13 -16384.00 16383.50 FORMAT "%8.2" AXIS_PTS_REF IKCtl_nEngVar13_X_AX /end AXIS_DESCR
 /begin AXIS_DESCR COM_AXIS AirMod_ratChrgAirCyl rel_uw_q0p0234 4 0.00 1535.977 FORMAT "%8.3" AXIS_PTS_REF IKCtl_ratLoadDy04_X_AX /end AXIS_DESCR
/end CHARACTERISTIC
/begin CHARACTERISTIC IKCtl_facThdNDynDetn_GT "threshold revolution gradient for dynamics detection" CURVE 0x80504CF6 RB_CurveGroup_S8 25500. nmotg_sb_q100 -12800. 12700. FORMAT "%5.0"
 /begin AXIS_DESCR COM_AXIS Epm_nEng EngN 13 -16384.00 16383.50 FORMAT "%8.2" AXIS_PTS_REF IKCtl_nEngVar13_X_AX /end AXIS_DESCR
/end CHARACTERISTIC
/begin CHARACTERISTIC IKCtl_facTiLoadDynDetn_GT "Knock control: time for load-dynamic action on knock detection" CURVE 0x80504D03 RB_CurveGroup_U8 2.540 t_q0p01 0.010 2.550 FORMAT "%5.3" EXTENDED_LIMITS 0.00 2.550
 /begin AXIS_DESCR COM_AXIS Epm_nEng EngN 8 -16384.00 16383.50 FORMAT "%8.2" AXIS_PTS_REF IKCtl_nEng08_X_AX /end AXIS_DESCR
/end CHARACTERISTIC
/begin CHARACTERISTIC IKCtl_facTiNDynDetn_GT "Knock control: time for engine speed dynamic action on knock detection" CURVE 0x80504D0B RB_CurveGroup_U8 2.540 t_q0p01 0.010 2.550 FORMAT "%5.3" EXTENDED_LIMITS 0.00 2.550
 /begin AXIS_DESCR COM_AXIS Epm_nEng EngN 8 -16384.00 16383.50 FORMAT "%8.2" AXIS_PTS_REF IKCtl_nEng08_X_AX /end AXIS_DESCR
/end CHARACTERISTIC
/begin CHARACTERISTIC IKCtl_facTLoadDynAdpn_GT "Knock control: time for dynamic adaptation" CURVE 0x80504D13 RB_CurveGroup_U8 2.540 t_q0p01 0.010 2.550 FORMAT "%5.3" EXTENDED_LIMITS 0.00 2.550
 /begin AXIS_DESCR COM_AXIS Epm_nEng EngN 8 -16384.00 16383.50 FORMAT "%8.2" AXIS_PTS_REF IKCtl_nEng08_X_AX /end AXIS_DESCR
/end CHARACTERISTIC
/begin CHARACTERISTIC IKCtl_facTThdDyn_C "engine temperature threshold to enable load dynamic adaptation" VALUE 0x80504D1C RB_Val_Wu16 191.5000 Temp_Cels -48.0400 143.4600 FORMAT "%8.4" EXTENDED_LIMITS -273.1400 6280.360 /end CHARACTERISTIC
/begin CHARACTERISTIC IKCtl_facTThdKnk_C "engine-temperature threshold to enable knock control" VALUE 0x80504D1E RB_Val_Ws16 6553.500 Temp_Cels -3549.940 3003.560 FORMAT "%8.3" /end CHARACTERISTIC
/begin CHARACTERISTIC IKCtl_nAdapEna_C "speed below which KC-adaptation is freezed" VALUE 0x80504D20 RB_Val_Ws16 32767.50 EngN -16384.00 16383.50 FORMAT "%8.2" /end CHARACTERISTIC
/begin AXIS_PTS IKCtl_nEng08_X_AX "KC: Datapoint distribution engine speed of group B" 0x8052515E Epm_nEng RB_Axis_S16 32767.50 EngN 8 -16384.00 16383.50 FORMAT "%8.2" DEPOSIT ABSOLUTE /end AXIS_PTS
/begin AXIS_PTS IKCtl_nEngVar13_X_AX "KC: Datapoint distribution engine speed of group A" 0x8052518C Epm_nEng RB_Axis_S16 32767.50 EngN 13 -16384.00 16383.50 FORMAT "%8.2" DEPOSIT ABSOLUTE /end AXIS_PTS
/begin CHARACTERISTIC IKCtl_nSpdHys_C "n hysterisis for adaptation maps" VALUE 0x80504D22 RB_Val_Ws16 32767.50 EngN -16384.00 16383.50 FORMAT "%8.2" /end CHARACTERISTIC
/begin CHARACTERISTIC IKCtl_ratAirLoadThdN_GT "Air load treshold based on engine speed for fast ignition advance" CURVE 0x80504D24 RB_CurveGroup_U16 1535.977 rel_uw_q0p0234 0.00 1535.977 FORMAT "%8.3"
 /begin AXIS_DESCR COM_AXIS Epm_nEng EngN 8 -16384.00 16383.50 FORMAT "%8.2" AXIS_PTS_REF IKCtl_nEng08_X_AX /end AXIS_DESCR
/end CHARACTERISTIC
/begin CHARACTERISTIC IKCtl_ratHysLoad_C "load hysterisis for adaptation maps" VALUE 0x80504D34 RB_Val_Wu16 1535.977 rel_uw_q0p0234 0.00 1535.977 FORMAT "%8.3" /end CHARACTERISTIC
/begin AXIS_PTS IKCtl_ratLoadDy04_X_AX "basepoint distribution of rl, 4 basepoints" 0x805251CE AirMod_ratChrgAirCyl RB_Axis_U16 1535.977 rel_uw_q0p0234 4 0.00 1535.977 FORMAT "%8.3" DEPOSIT ABSOLUTE /end AXIS_PTS
/begin CHARACTERISTIC IKCtl_ratLoadDynDetnThd_GM "Threshold for filtered gradient of the desired air-charge" MAP 0x80504D36 RB_MapGroup_U16 1535.977 rel_uw_q0p0234 0.00 1535.977 FORMAT "%8.3"
 /begin AXIS_DESCR COM_AXIS Epm_nEng EngN 13 -16384.00 16383.50 FORMAT "%8.2" AXIS_PTS_REF IKCtl_nEngVar13_X_AX /end AXIS_DESCR
 /begin AXIS_DESCR COM_AXIS AirMod_ratChrgAirCyl rel_uw_q0p0234 4 0.00 1535.977 FORMAT "%8.3" AXIS_PTS_REF IKCtl_ratLoadDy04_X_AX /end AXIS_DESCR
/end CHARACTERISTIC
/begin CHARACTERISTIC IKCtl_ratLoadRngAdpnM1_GT "load range for adaption maps 1" CURVE 0x80504D9E RB_CurveGroup_U16 1535.977 rel_uw_q0p0234 0.00 1535.977 FORMAT "%8.3"
 /begin AXIS_DESCR COM_AXIS Epm_nEng EngN 13 -16384.00 16383.50 FORMAT "%8.2" AXIS_PTS_REF IKCtl_nEngVar13_X_AX /end AXIS_DESCR
/end CHARACTERISTIC
/begin CHARACTERISTIC IKCtl_ratLoadRngAdpnM2_GT "load range for adaption maps 2" CURVE 0x80504DB8 RB_CurveGroup_U16 1535.977 rel_uw_q0p0234 0.00 1535.977 FORMAT "%8.3"
 /begin AXIS_DESCR COM_AXIS Epm_nEng EngN 13 -16384.00 16383.50 FORMAT "%8.2" AXIS_PTS_REF IKCtl_nEngVar13_X_AX /end AXIS_DESCR
/end CHARACTERISTIC
/begin CHARACTERISTIC IKCtl_ratLoadRngAdpnM3_GT "load range for adaption maps 3" CURVE 0x80504DD2 RB_CurveGroup_U16 1535.977 rel_uw_q0p0234 0.00 1535.977 FORMAT "%8.3"
 /begin AXIS_DESCR COM_AXIS Epm_nEng EngN 13 -16384.00 16383.50 FORMAT "%8.2" AXIS_PTS_REF IKCtl_nEngVar13_X_AX /end AXIS_DESCR
/end CHARACTERISTIC
/begin CHARACTERISTIC IKCtl_ratLoadThd_GT "load-signal threshold knock control" CURVE 0x80504DEC RB_CurveGroup_U16 1535.977 rel_uw_q0p0234 0.00 1535.977 FORMAT "%8.3"
 /begin AXIS_DESCR COM_AXIS Epm_nEng EngN 13 -16384.00 16383.50 FORMAT "%8.2" AXIS_PTS_REF IKCtl_nEngVar13_X_AX /end AXIS_DESCR
/end CHARACTERISTIC
/begin CHARACTERISTIC IKCtl_stSelnDesLoadFilGrdt_C "Codeword for selection of the desired load-filtered-gradient" VALUE 0x80504E06 RB_Val_Wu8 255.0 OneToOne 0.00 255.0 FORMAT "%5.1" /end CHARACTERISTIC
/begin CHARACTERISTIC IKCtl_stSelnFildAirChrgGrdt_C "Codeword for selection of filtered relative air-charge gradient" VALUE 0x80504E07 RB_Val_Wu8 255.0 OneToOne 0.00 255.0 FORMAT "%5.1" /end CHARACTERISTIC
/begin CHARACTERISTIC IKCtl_tInltVlvAirTThd_C "threshold for temperature at inlet valve for tipin detection" VALUE 0x80504E08 RB_Val_Wu16 1535.977 temp_q0p0234_o273 -273.150 1262.827 FORMAT "%8.3" /end CHARACTERISTIC
/begin CHARACTERISTIC IKCtl_tiVVlvLftDynDetn_GT "Knock control: time for variable valve lift dynamic action on knock detection" CURVE 0x80504E0A RB_CurveGroup_U8 2.540 t_q0p01 0.010 2.550 FORMAT "%5.3" EXTENDED_LIMITS 0.00 2.550
 /begin AXIS_DESCR COM_AXIS Epm_nEng EngN 8 -16384.00 16383.50 FORMAT "%8.2" AXIS_PTS_REF IKCtl_nEng08_X_AX /end AXIS_DESCR
/end CHARACTERISTIC
/begin CHARACTERISTIC KFIFDZW "stretching factor of spark efficiency curve" MAP 0x805054A4 RB_Map_U16U16_U8 3.984 fak_ub_b4 0.00 3.984 FORMAT "%5.3"
 /begin AXIS_DESCR STD_AXIS NO_INPUT_QUANTITY nmot_uw_q0p25 16 0.00 16383.75 FORMAT "%8.2" DEPOSIT ABSOLUTE /end AXIS_DESCR
 /begin AXIS_DESCR STD_AXIS NO_INPUT_QUANTITY rel_q0p02344 12 0.00 1535.977 FORMAT "%8.3" DEPOSIT ABSOLUTE /end AXIS_DESCR
/end CHARACTERISTIC
/begin CHARACTERISTIC KFTNSEADMX "Maximal time for afterstart adaptation" MAP 0x805052E1 RB_Map_U8U8_U8 1020. t_q4_s 0.00 1020. FORMAT "%5.0"
 /begin AXIS_DESCR STD_AXIS tmstbstnsd temp_ub_q0p75_o48 4 -48.0 143.3 FORMAT "%5.1" DEPOSIT ABSOLUTE /end AXIS_DESCR
 /begin AXIS_DESCR STD_AXIS fvapskstaa fak_ub_b2 2 0.00 1.992188 FORMAT "%8.6" DEPOSIT ABSOLUTE /end AXIS_DESCR
/end CHARACTERISTIC
/begin CHARACTERISTIC KFTVSA "Retard time for overrun fuel cut-off" MAP 0x80505172 RB_MapGroup_U8 2.550 t_q0p01 0.00 2.550 FORMAT "%5.3"
 /begin AXIS_DESCR COM_AXIS CEngDsT_t temp_q0p1_o273 5 -3549.940 3003.560 FORMAT "%8.3" AXIS_PTS_REF CES_tEng_AXIS /end AXIS_DESCR
 /begin AXIS_DESCR COM_AXIS Epm_nEng EngN 8 -16384.00 16383.50 FORMAT "%8.2" AXIS_PTS_REF SNM08SAUB /end AXIS_DESCR
/end CHARACTERISTIC
/begin CHARACTERISTIC KFTVSAGNG "map delay time fuel cutoff depend on gear step" MAP 0x8050519A RB_Map_S16S16_S16 327.6700 t_q0p01 0.00 327.6700 FORMAT "%8.4" EXTENDED_LIMITS -327.6800 327.6700
 /begin AXIS_DESCR STD_AXIS Tra_numGear dez 12 -128.0000 127.0000 FORMAT "%8.4" EXTENDED_LIMITS -32768.00 32767.00 DEPOSIT ABSOLUTE /end AXIS_DESCR
 /begin AXIS_DESCR STD_AXIS Epm_nEng nmot_q0p5 3 -16384.00 16383.50 FORMAT "%8.2" DEPOSIT ABSOLUTE /end AXIS_DESCR
/end CHARACTERISTIC
/begin CHARACTERISTIC KFTVSAKAT "delay time for fuel cut-off at high speeds and high catalyst temperatures" MAP 0x80505204 RB_MapGroup_U8 10.20 t_q0p04 0.00 10.20 FORMAT "%5.2"
 /begin AXIS_DESCR COM_AXIS Epm_nEng EngN 8 -16384.00 16383.50 FORMAT "%8.2" AXIS_PTS_REF SNM08SAUB /end AXIS_DESCR
 /begin AXIS_DESCR COM_AXIS tkattmp temp_q0p1_o273 4 -3549.940 3003.560 FORMAT "%8.3" AXIS_PTS_REF STK04SAUB /end AXIS_DESCR
/end CHARACTERISTIC
/begin CHARACTERISTIC KFTVSAVG "Delay time for Fuel Cut Off at gear shifting" MAP 0x80505224 RB_MapGroup_U8 10.20 t_q0p04 0.00 10.20 FORMAT "%5.2"
 /begin AXIS_DESCR COM_AXIS CEngDsT_t temp_q0p1_o273 5 -3549.940 3003.560 FORMAT "%8.3" AXIS_PTS_REF CES_tEng_AXIS /end AXIS_DESCR
 /begin AXIS_DESCR COM_AXIS Epm_nEng EngN 8 -16384.00 16383.50 FORMAT "%8.2" AXIS_PTS_REF SNM08SAUB /end AXIS_DESCR
/end CHARACTERISTIC
/begin CHARACTERISTIC KFTVSAVGV0 "Delay time for Fuel Cut Off at gear shifting in vehicle standstill" MAP 0x8050524C RB_MapGroup_U8 10.20 t_q0p04 0.00 10.20 FORMAT "%5.2"
 /begin AXIS_DESCR COM_AXIS CEngDsT_t temp_q0p1_o273 5 -3549.940 3003.560 FORMAT "%8.3" AXIS_PTS_REF CES_tEng_AXIS /end AXIS_DESCR
 /begin AXIS_DESCR COM_AXIS Epm_nEng EngN 8 -16384.00 16383.50 FORMAT "%8.2" AXIS_PTS_REF SNM08SAUB /end AXIS_DESCR
/end CHARACTERISTIC
/begin CHARACTERISTIC KRLNMDY "Read if change of load / speed range: always or only if dynamics conditions" VALUE 0x80504E12 RB_Val_Wu8 255.0 dez 0.00 255.0 FORMAT "%5.1" /end CHARACTERISTIC
/begin CHARACTERISTIC KSTANSAD "Threshold factor start adaptation for activation of afterstart adaptation" VALUE 0x805052F1 RB_Val_Wu8 1.992188 fak_ub_b2 0.00 1.992188 FORMAT "%8.6" /end CHARACTERISTIC
/begin CHARACTERISTIC LAMFA "Lambda driver demand" MAP 0x805057B6 RB_Map_S16U16_U8 1.000000 fak_ub_b2 0.00 1.000000 FORMAT "%8.6" EXTENDED_LIMITS 0.00 1.992188
 /begin AXIS_DESCR STD_AXIS Epm_nEng EngN 12 -16384.00 16383.50 FORMAT "%8.2" DEPOSIT ABSOLUTE /end AXIS_DESCR
 /begin AXIS_DESCR STD_AXIS mrfa_w_msg rel_uw_b200 4 0.00 199.9969 FORMAT "%8.4" DEPOSIT ABSOLUTE /end AXIS_DESCR
/end CHARACTERISTIC
/begin CHARACTERISTIC LAMFACHRSM "Lambda driver demand when Efficiency mode is active" MAP 0x8050580A RB_Map_S16U16_U8 1.000000 fak_ub_b2 0.00 1.000000 FORMAT "%8.6" EXTENDED_LIMITS 0.00 1.992188
 /begin AXIS_DESCR STD_AXIS Epm_nEng EngN 12 -16384.00 16383.50 FORMAT "%8.2" DEPOSIT ABSOLUTE /end AXIS_DESCR
 /begin AXIS_DESCR STD_AXIS mrfa_w_msg rel_uw_b200 4 0.00 199.9969 FORMAT "%8.4" DEPOSIT ABSOLUTE /end AXIS_DESCR
/end CHARACTERISTIC
/begin CHARACTERISTIC LAMFASPORT "Lambda driver demand in sport mode" MAP 0x8050585E RB_Map_S16U16_U8 1.992188 fak_ub_b2 0.00 1.992188 FORMAT "%8.6"
 /begin AXIS_DESCR STD_AXIS Epm_nEng EngN 12 -16384.00 16383.50 FORMAT "%8.2" DEPOSIT ABSOLUTE /end AXIS_DESCR
 /begin AXIS_DESCR STD_AXIS mrfa_w_msg rel_uw_b200 4 0.00 199.9969 FORMAT "%8.4" DEPOSIT ABSOLUTE /end AXIS_DESCR
/end CHARACTERISTIC
/begin CHARACTERISTIC LZSRPUMN "min. threshold for ambient pressure to enable leakage detection via ofmsndkp_w" VALUE 0x8050530A RB_Val_Wu16 2559.961 p_q0p039 0.00 2559.961 FORMAT "%8.3" /end CHARACTERISTIC
/begin CHARACTERISTIC LZSRTMOTMN "min. threshold for engine temperature to enable leakage detection via ofmsndkp_w" VALUE 0x8050530C RB_Val_Ws16 6553.500 Temp_Cels -3549.940 3003.560 FORMAT "%8.3" /end CHARACTERISTIC
/begin CHARACTERISTIC LZSRTMOTMX "max. threshold for engine temperature to enable leakage detection via ofmsndkp_w" VALUE 0x8050530E RB_Val_Ws16 6553.500 Temp_Cels -3549.940 3003.560 FORMAT "%8.3" /end CHARACTERISTIC
/begin CHARACTERISTIC MNCLUTWM "Threshold to reset the engine roughness enable condtion with warm engine" VALUE 0x805052F2 RB_Val_Wu16 65535.00 dez 0.00 65535.00 FORMAT "%8.2" /end CHARACTERISTIC
/begin CHARACTERISTIC MXCLUTWM "max-threshold: combustions with engine roughness at warm engine" VALUE 0x805052F4 RB_Val_Wu16 65535.00 dez 0.00 65535.00 FORMAT "%8.2" /end CHARACTERISTIC
/begin CHARACTERISTIC NGDNSA "Engine speed gradient during decreasing the cut-off hysteresis" VALUE 0x80505274 RB_Val_Ws16 16383.75 nmotd_sw_q0p25 -8192.000 8191.750 FORMAT "%8.3" /end CHARACTERISTIC
/begin CHARACTERISTIC NGDNSAL "Engine speed gradient during decreasing the cut-off hysteresis at idle" VALUE 0x80505276 RB_Val_Ws16 16383.75 nmotd_sw_q0p25 -8192.000 8191.750 FORMAT "%8.3" /end CHARACTERISTIC
/begin CHARACTERISTIC NGDNSALS "Engine speed gradient during decreasing the cut-off hysteresis at idle - converter in slip mode" VALUE 0x80505278 RB_Val_Ws16 16383.75 nmotd_sw_q0p25 -8192.000 8191.750 FORMAT "%8.3" /end CHARACTERISTIC
/begin CHARACTERISTIC NGDNSAS "Engine speed gradient during decreasing the cut-off hysteresis - converter in slip mode" VALUE 0x8050527A RB_Val_Ws16 16383.75 nmotd_sw_q0p25 -8192.000 8191.750 FORMAT "%8.3" /end CHARACTERISTIC
/begin CHARACTERISTIC NMOTTHASYN "Threshold value for engine speed to switch between time synchronous or speed synchronous interfaces" VALUE 0x8050527C RB_Val_Ws16 32767.50 EngN -16384.00 16383.50 FORMAT "%8.2" /end CHARACTERISTIC
/begin CHARACTERISTIC NMXNSAD "Max. engine speed for afterstart adaptation" VALUE 0x805052F6 RB_Val_Wu8 10200. nmot_ub_q40 0.00 10200. FORMAT "%5.0" /end CHARACTERISTIC
/begin CHARACTERISTIC OMSNDKGLSMX "threshold for detection of big leakage in intake manifold based leakage of throttle blade" VALUE 0x80505310 RB_Val_Wu16 3276.800 m_uw_b6553p5 0.00 3276.800 FORMAT "%8.3" EXTENDED_LIMITS 0.00 6553.500 /end CHARACTERISTIC
/begin CHARACTERISTIC OMSNDKLSMX "Threshold f. detect. of a leak in the intake manifold" VALUE 0x80505312 RB_Val_Wu16 3276.800 m_uw_b6553p5 0.00 3276.800 FORMAT "%8.3" EXTENDED_LIMITS 0.00 6553.500 /end CHARACTERISTIC
/begin CHARACTERISTIC SAVGANGIKL "gear dependent delay time switch" CURVE 0x8050527E RB_FixCurve_S8_S8 127.0 dez 0.00 127.0 FORMAT "%5.1" EXTENDED_LIMITS -128.0 127.0
 /begin AXIS_DESCR FIX_AXIS Tra_numGear dez 12 -1.00 10.00 FORMAT "%5.2" FIX_AXIS_PAR -1 0 12 /end AXIS_DESCR
/end CHARACTERISTIC
/begin CHARACTERISTIC SF_DKVS "Sum Fault DKVS" VAL_BLK 0x80505350 RB_ValA_Wu16 58.0000000000 dfp_verbal 0.00 58.0000000000 FORMAT "%13.10" READ_ONLY NUMBER 4 /end CHARACTERISTIC
/begin AXIS_PTS SIM08KHUW "Distribution of breakpoints of catalyst heating progress (imlpr_w)" 0x80504BF6 ExhMgT_facCatHeatgProgs RB_Axis_U16 0.9999847 fak_uw_b1 8 0.00 0.9999847 FORMAT "%9.7" DEPOSIT ABSOLUTE /end AXIS_PTS
/begin AXIS_PTS SNM08SAUB "Base point distribution" 0x8050528A Epm_nEng RB_Axis_S16 32767.50 EngN 8 -16384.00 16383.50 FORMAT "%8.2" DEPOSIT ABSOLUTE /end AXIS_PTS
/begin AXIS_PTS STCS08KHSW "Distribution of breakpoints of engine temperature by start (tmstrk_w)" 0x80504C08 ExhMgT_tEngCatHeatgFild RB_Axis_S16 6553.500 Temp_Cels 8 -3549.940 3003.560 FORMAT "%8.3" DEPOSIT ABSOLUTE /end AXIS_PTS
/begin AXIS_PTS STK04SAUB "base point distribution catalyst temperature for function SAWE" 0x8050529C tkattmp RB_Axis_S16 6553.500 temp_q0p1_o273 4 -3549.940 3003.560 FORMAT "%8.3" DEPOSIT ABSOLUTE /end AXIS_PTS
/begin CHARACTERISTIC TATIPIN "intake air temperature threshold to enable tip-in function" VALUE 0x80504E13 RB_Val_Wu8 191.3 temp_ub_q0p75_o48 -48.0 143.3 FORMAT "%5.1" /end CHARACTERISTIC
/begin CHARACTERISTIC TDGLSR "debounce time for error path big leak to manifold" VALUE 0x80505314 RB_Val_Wu8 51.00 t_q0p2 0.00 51.00 FORMAT "%5.2" /end CHARACTERISTIC
/begin CHARACTERISTIC TDLZSR "debounce time for error path leak to manifold" VALUE 0x80505315 RB_Val_Wu8 51.00 t_q0p2 0.00 51.00 FORMAT "%5.2" /end CHARACTERISTIC
/begin CHARACTERISTIC TENGSDECR "minimum soak time needed to allow decrementing start adaption facto" VALUE 0x805052F8 RB_Val_Wu16 65535.00 t1sxs_uw_q1 0.00 65535.00 FORMAT "%8.2" /end CHARACTERISTIC
/begin CHARACTERISTIC TLAFA "delay time for activation of lambda demand by driver" VALUE 0x805058B2 RB_Val_Wu8 25.50 t_q0p1 0.00 25.50 FORMAT "%5.2" /end CHARACTERISTIC
/begin CHARACTERISTIC TMECmb_facDiaInert_T "stretching factor curve of spark efficiency in dependency of residual inert gas" CURVE 0x805055A0 RB_Curve_U16_U16 3.999939 fak_uw_b4 0.00 3.999939 FORMAT "%8.6"
 /begin AXIS_DESCR STD_AXIS NO_INPUT_QUANTITY rel_uw_b100 10 0.00 99.99847 FORMAT "%8.5" DEPOSIT ABSOLUTE /end AXIS_DESCR
/end CHARACTERISTIC
/begin CHARACTERISTIC TMECmb_facDiaLamNEngChrgAir_M "stretching factor map of spark efficiency in dependency of engine output power" MAP 0x805055CA RB_Map_U16U16_U16 3.999939 fak_uw_b4 0.00 3.999939 FORMAT "%8.6"
 /begin AXIS_DESCR STD_AXIS NO_INPUT_QUANTITY nmot_uw_q0p25 16 0.00 16383.75 FORMAT "%8.2" DEPOSIT ABSOLUTE /end AXIS_DESCR
 /begin AXIS_DESCR STD_AXIS NO_INPUT_QUANTITY rel_q0p02344 12 0.00 1535.977 FORMAT "%8.3" DEPOSIT ABSOLUTE /end AXIS_DESCR
/end CHARACTERISTIC
/begin CHARACTERISTIC TMECmb_facDiaLam_T "stretching factor curve of spark efficiency in dependency of lambda" CURVE 0x80505786 RB_Curve_U16_U16 3.999939 fak_uw_b4 0.00 3.999939 FORMAT "%8.6"
 /begin AXIS_DESCR STD_AXIS NO_INPUT_QUANTITY fak_uw_b16 10 0.00 15.99976 FORMAT "%8.5" DEPOSIT ABSOLUTE /end AXIS_DESCR
/end CHARACTERISTIC
/begin CHARACTERISTIC TMMXRT "max. engine cool.temp. for retriggering models (blockheater-detection)" VALUE 0x8050531C RB_Val_Wu8 191.3 temp_ub_q0p75_o48 -48.0 143.3 FORMAT "%5.1" /end CHARACTERISTIC
/begin CHARACTERISTIC TMNSADMN "Minimal engine temperature for afterstart adaptation" VALUE 0x805052FA RB_Val_Wu8 191.3 temp_ub_q0p75_o48 -48.0 143.3 FORMAT "%5.1" /end CHARACTERISTIC
/begin CHARACTERISTIC TMNSADMX "Maximal engine temperature for afterstart adaptation" VALUE 0x805052FB RB_Val_Wu8 191.3 temp_ub_q0p75_o48 -48.0 143.3 FORMAT "%5.1" /end CHARACTERISTIC
/begin CHARACTERISTIC TMOTMNSAD "engine temperature threshold for evaluation ""engine roughness with warm engine""" VALUE 0x805052FC RB_Val_Wu8 191.3 temp_q0p75_om48 -48.0 143.3 FORMAT "%5.1" /end CHARACTERISTIC
/begin CHARACTERISTIC TNSRT "max. time after start to retrigger calculation of engine temperature model" VALUE 0x8050531D RB_Val_Wu8 255.0 t_q1 0.00 255.0 FORMAT "%5.1" /end CHARACTERISTIC
/begin CHARACTERISTIC TOMSZCGLSRI "maximum duration of ofmsndkp_w adaptation to ensure, that an error(big leak to manifold) could have been found under all boundary conditions" VALUE 0x80505316 RB_Val_Wu16 13107.00 t_q0p2 0.00 13107.00 FORMAT "%8.2" /end CHARACTERISTIC
/begin CHARACTERISTIC TOMSZLZSRI "duration time of ofmsndkp_w adaptation to ensure an error LZSR detection under worst case conditions" VALUE 0x80505318 RB_Val_Wu16 13107.00 t_q0p2 0.00 13107.00 FORMAT "%8.2" /end CHARACTERISTIC
/begin CHARACTERISTIC TVBGSCH "Delay time after detected gearshift" VALUE 0x805052A6 RB_Val_Wu8 2.550 t_q0p01 0.00 2.550 FORMAT "%5.3" /end CHARACTERISTIC
/begin CHARACTERISTIC TVNSKUPPEF "stopping time after release clutch" VALUE 0x805052FD RB_Val_Wu8 25.50 t100msxs_ub_b25p5 0.00 25.50 FORMAT "%5.2" /end CHARACTERISTIC
/begin CHARACTERISTIC TVNSKUPPER "stopping time after step on clutch" VALUE 0x805052FE RB_Val_Wu8 25.50 t100msxs_ub_b25p5 0.00 25.50 FORMAT "%5.2" /end CHARACTERISTIC
/begin CHARACTERISTIC TVSABFA "Fuel-cutoff delay time at function request in gear 0" VALUE 0x805052A8 RB_Val_Wu16 655.3500 t_q0p01 0.00 655.3500 FORMAT "%8.4" /end CHARACTERISTIC
/begin CHARACTERISTIC TVSABTE "Delay time for closing the canister purge valve before fuel-cutoff" VALUE 0x805052AA RB_Val_Wu16 655.3500 t_q0p01 0.00 655.3500 FORMAT "%8.4" /end CHARACTERISTIC
/begin CHARACTERISTIC TVSAGSCH "Delay time during detected gearshift" VALUE 0x805052AC RB_Val_Wu16 655.3500 t_q0p01 0.00 655.3500 FORMAT "%8.4" /end CHARACTERISTIC
/begin CHARACTERISTIC TVSATM "delay time after cranking for fuel cut off" CURVE 0x805052AE RB_Curve_S16_U16_Static 655.3500 t_q0p01 0.00 655.3500 FORMAT "%8.4"
 /begin AXIS_DESCR STD_AXIS CEngDsT_t temp_q0p1_o273 6 -3549.940 3003.560 FORMAT "%8.3" DEPOSIT ABSOLUTE /end AXIS_DESCR
/end CHARACTERISTIC
/begin CHARACTERISTIC TVTOFLUT "Debounce engine roughness quality" VALUE 0x805052FF RB_Val_Wu8 25.50 t100msxs_ub_b25p5 0.00 25.50 FORMAT "%5.2" /end CHARACTERISTIC
/begin CHARACTERISTIC UBKSTMX "Threshold number of Ubat measurements lower than UBKST for adaptation blocking" VALUE 0x80505300 RB_Val_Wu8 255.0 dez 0.00 255.0 FORMAT "%5.1" /end CHARACTERISTIC
/begin CHARACTERISTIC ZKLAMFAW "time konstant of filter for enrichment by driver" VALUE 0x805058B4 RB_Val_Wu16 6553.4999985 zk100msxs_uw_b6553p6 0.1000015 6553.6000000 FORMAT "%12.7" EXTENDED_LIMITS 0.10000152590 6553.6000000 /end CHARACTERISTIC
/begin MEASUREMENT actkeldyn "Knock control: actual value of characteristic ZKRKELDYN" UBYTE t_q0p01 1 100 0.00 2.550 FORMAT "%5.3" ECU_ADDRESS 0x6000E3B9 /end MEASUREMENT
/begin MEASUREMENT actkendyn "Knock control: actual value of characteristic ZKRKENDYN" UBYTE t_q0p01 1 100 0.00 2.550 FORMAT "%5.3" ECU_ADDRESS 0x6000E3BA /end MEASUREMENT
/begin MEASUREMENT actldyn "Knock control: actual value of characteristic ZKREGLDYN" UBYTE t_q0p01 1 100 0.00 2.550 FORMAT "%5.3" ECU_ADDRESS 0x6000E3BB /end MEASUREMENT
/begin MEASUREMENT AirMon_flgBigLeakIntkMnfldEmiInflReld_mp "DFC_BigLeakIntkMnfldEmiInfl disabled by DisblMsk" UBYTE B_TRUE 1 100 0.00 1.00000000000 BIT_MASK 0x1 FORMAT "%13.11" ECU_ADDRESS 0x70009271 /end MEASUREMENT
/begin MEASUREMENT AirMon_flgLeakIntkMnfldEmiInflReld_mp "DFC_LeakIntkMnfldEmiInfl disabled by DisblMsk" UBYTE B_TRUE 1 100 0.00 1.00000000000 BIT_MASK 0x1 FORMAT "%13.11" ECU_ADDRESS 0x70009270 /end MEASUREMENT
/begin MEASUREMENT Batt_bEngStopEna "stop enable by battery sensor" UBYTE B_TRUE 1 100 0.00 1.00000000000 BIT_MASK 0x1 FORMAT "%13.11" ECU_ADDRESS 0x6000A223 /end MEASUREMENT
/begin MEASUREMENT Batt_bEngStrtReq "start request by battery sensor" UBYTE B_TRUE 1 100 0.00 1.00000000000 BIT_MASK 0x1 FORMAT "%13.11" ECU_ADDRESS 0x6000A222 /end MEASUREMENT
/begin MEASUREMENT Batt_cntrIniDrv100ms "Drive enter counter 100ms" UBYTE OneToOne 1 100 0.00 255.0 FORMAT "%5.1" ECU_ADDRESS 0x60009C30 /end MEASUREMENT
/begin MEASUREMENT Batt_cntrIniDrv10ms "Drive enter counter 10ms" UBYTE OneToOne 1 100 0.00 255.0 FORMAT "%5.1" ECU_ADDRESS 0x60009C2F /end MEASUREMENT
/begin MEASUREMENT Batt_cntrOCV "Counter for number of occurences of Low open circuit voltage" UBYTE OneToOne 1 100 0.00 255.0 FORMAT "%5.1" ECU_ADDRESS 0x60009C2E /end MEASUREMENT
/begin MEASUREMENT Batt_cntrStrt "Start counter" UBYTE dez 1 100 0.00 255.0 FORMAT "%5.1" ECU_ADDRESS 0x60037EAF /end MEASUREMENT
/begin MEASUREMENT Batt_cntrStrtIn "Start counter for INKA display" SWORD dez 1 100 0.00 32767.00 FORMAT "%8.2" ECU_ADDRESS 0x60003FA0 /end MEASUREMENT
/begin MEASUREMENT Batt_facHiChrgnEff "High charge efficiency of battery" SWORD Fact1000 1 100 0.00 2.550000 FORMAT "%8.6" ECU_ADDRESS 0x60003F9E /end MEASUREMENT
/begin MEASUREMENT Batt_facLoChrgnEff "Low charge efficiency of battery" SWORD Fact1000 1 100 0.00 2.550000 FORMAT "%8.6" ECU_ADDRESS 0x60003F9C /end MEASUREMENT
/begin MEASUREMENT Batt_flgAltFailr "Alternator related failure status information" UBYTE B_TRUE 1 100 0.00 1.00000000000 BIT_MASK 0x1 FORMAT "%13.11" ECU_ADDRESS 0x60009C1E /end MEASUREMENT
/begin MEASUREMENT Batt_flgBattExch "Battery exchange judgement flag" UBYTE B_TRUE 1 100 0.00 1.00000000000 BIT_MASK 0x1 FORMAT "%13.11" ECU_ADDRESS 0x60037E99 /end MEASUREMENT
/begin MEASUREMENT Batt_flgChrgChartcDgrtDetn "Battery charge charactaristic degradation detection" UBYTE B_TRUE 1 100 0.00 1.00000000000 BIT_MASK 0x1 FORMAT "%13.11" ECU_ADDRESS 0x60037EF9 /end MEASUREMENT
/begin MEASUREMENT Batt_flgChrgCmpl "Rough estimation of Battery SOC completed information" UBYTE B_TRUE 1 100 0.00 1.00000000000 BIT_MASK 0x1 FORMAT "%13.11" ECU_ADDRESS 0x6000A221 /end MEASUREMENT
/begin MEASUREMENT Batt_flgChrgILo "Battery charge checking flag" UBYTE B_TRUE 1 100 0.00 1.00000000000 BIT_MASK 0x1 FORMAT "%13.11" ECU_ADDRESS 0x60037EF8 /end MEASUREMENT
/begin MEASUREMENT Batt_flgChrgMod "Battery is in charging mode state" UBYTE B_TRUE 1 100 0.00 1.00000000000 BIT_MASK 0x1 FORMAT "%13.11" ECU_ADDRESS 0x6000A220 /end MEASUREMENT
/begin MEASUREMENT Batt_flgCnsChkEna "Consumption check enable flag" UBYTE B_TRUE 1 100 0.00 1.00000000000 BIT_MASK 0x1 FORMAT "%13.11" ECU_ADDRESS 0x60009C2D /end MEASUREMENT
/begin MEASUREMENT Batt_flgCntrExcd "Battery management status 8 completed more than a threshold number of times" UBYTE B_TRUE 1 100 0.00 1.00000000000 BIT_MASK 0x1 FORMAT "%13.11" ECU_ADDRESS 0x60037EAE /end MEASUREMENT
/begin MEASUREMENT Batt_flgDarkIAllwCdnAHys "Hysteresis of condition A for Permission to use unsteady dark current status" UBYTE B_TRUE 1 100 0.00 1.00000000000 BIT_MASK 0x1 FORMAT "%13.11" ECU_ADDRESS 0x60037EAD /end MEASUREMENT
/begin MEASUREMENT Batt_flgDarkIAllwCdnBHys "Hysteresis of condition B for Permission to use unsteady dark current status" UBYTE B_TRUE 1 100 0.00 1.00000000000 BIT_MASK 0x1 FORMAT "%13.11" ECU_ADDRESS 0x60037EAC /end MEASUREMENT
/begin MEASUREMENT Batt_flgDarkIAllwCondA "Condition A for Permission to use unsteady dark current status" UBYTE B_TRUE 1 100 0.00 1.00000000000 BIT_MASK 0x1 FORMAT "%13.11" ECU_ADDRESS 0x60009FC6 /end MEASUREMENT
/begin MEASUREMENT Batt_flgDarkIAllwCondB "Condition B for Permission to use unsteady dark current status" UBYTE B_TRUE 1 100 0.00 1.00000000000 BIT_MASK 0x1 FORMAT "%13.11" ECU_ADDRESS 0x60009FC5 /end MEASUREMENT
/begin MEASUREMENT Batt_flgDarkIJudgLo "Flag to indicate if IBSUML or IBSUMH has to be used for judgment of permission to use unsteady dark current" UBYTE B_TRUE 1 100 0.00 1.00000000000 BIT_MASK 0x1 FORMAT "%13.11" ECU_ADDRESS 0x60037EAB /end MEASUREMENT
/begin MEASUREMENT Batt_flgDarkIProhb "Precondition to prohibit use of unsteady dark current" UBYTE B_TRUE 1 100 0.00 1.00000000000 BIT_MASK 0x1 FORMAT "%13.11" ECU_ADDRESS 0x6000A21F /end MEASUREMENT
/begin MEASUREMENT Batt_flgDarkIUpd "Flag to indicate dark current value during ignition off is reflected in IBSUMH and IBSUML" UBYTE B_TRUE 1 100 0.00 1.00000000000 BIT_MASK 0x1 FORMAT "%13.11" ECU_ADDRESS 0x60009C2C /end MEASUREMENT
/begin MEASUREMENT Batt_flgDeternDetd "Battery deterioration detected" UBYTE B_TRUE 1 100 0.00 1.00000000000 BIT_MASK 0x1 FORMAT "%13.11" ECU_ADDRESS 0x60009FC4 /end MEASUREMENT
/begin MEASUREMENT Batt_flgDoDLimStrtReq "Start request based on DoD of battery charge" UBYTE B_TRUE 1 100 0.00 1.00000000000 BIT_MASK 0x1 FORMAT "%13.11" ECU_ADDRESS 0x60009C1D /end MEASUREMENT
/begin MEASUREMENT Batt_flgDodStopDisbl "Stop disable on DOD" UBYTE B_TRUE 1 100 0.00 1.00000000000 BIT_MASK 0x1 FORMAT "%13.11" ECU_ADDRESS 0x60009C2B /end MEASUREMENT
/begin MEASUREMENT Batt_flgDodStrtReq "Start request on DOD" UBYTE B_TRUE 1 100 0.00 1.00000000000 BIT_MASK 0x1 FORMAT "%13.11" ECU_ADDRESS 0x60009C2A /end MEASUREMENT
/begin MEASUREMENT Batt_flgDrkDchaRst "Dark charge reset from IBSUMHNR" UBYTE B_TRUE 1 100 0.00 1.00000000000 BIT_MASK 0x1 FORMAT "%13.11" ECU_ADDRESS 0x60009C1C /end MEASUREMENT
/begin MEASUREMENT Batt_flgExchJudgCmpl "Flag to indicate Battery exchange judgement is completed in current driving cycle" UBYTE B_TRUE 1 100 0.00 1.00000000000 BIT_MASK 0x1 FORMAT "%13.11" ECU_ADDRESS 0x60009C1A /end MEASUREMENT
/begin MEASUREMENT Batt_flgFullChrg "Battery fuly charged information" UBYTE B_TRUE 1 100 0.00 1.00000000000 BIT_MASK 0x1 FORMAT "%13.11" ECU_ADDRESS 0x60009C29 /end MEASUREMENT
/begin MEASUREMENT Batt_flgIdxUpd "Index of buffer updated for current driving cycle" UBYTE B_TRUE 1 100 0.00 1.00000000000 BIT_MASK 0x1 FORMAT "%13.11" ECU_ADDRESS 0x60009C1B /end MEASUREMENT
/begin MEASUREMENT Batt_flgInhbSpst "Inhibit StopStart from extern" UBYTE B_TRUE 1 100 0.00 1.00000000000 BIT_MASK 0x1 FORMAT "%13.11" ECU_ADDRESS 0x60009FC3 /end MEASUREMENT
/begin MEASUREMENT Batt_flgISSInhbDcyc "Inhibit ISS for current driving cycle based on battery internal resistance without correction for temperature" UBYTE B_TRUE 1 100 0.00 1.00000000000 BIT_MASK 0x1 FORMAT "%13.11" ECU_ADDRESS 0x60009C19 /end MEASUREMENT
/begin MEASUREMENT Batt_flgJSOrFailr "Flag to indicate a jump start or battery related failure was detected" UBYTE B_TRUE 1 100 0.00 1.00000000000 BIT_MASK 0x1 FORMAT "%13.11" ECU_ADDRESS 0x60009C28 /end MEASUREMENT
/begin MEASUREMENT Batt_flgLimSysFailr "Failure battery system flag" UBYTE B_TRUE 1 100 0.00 1.00000000000 BIT_MASK 0x1 FORMAT "%13.11" ECU_ADDRESS 0x60037E98 /end MEASUREMENT
/begin MEASUREMENT Batt_flgLoSocJdgAftEngRun "Low SOC judgement after engine run" UBYTE B_TRUE 1 100 0.00 1.00000000000 BIT_MASK 0x1 FORMAT "%13.11" ECU_ADDRESS 0x60037EF7 /end MEASUREMENT
/begin MEASUREMENT Batt_flgOCV "Low OCV detection" UBYTE B_TRUE 1 100 0.00 1.00000000000 BIT_MASK 0x1 FORMAT "%13.11" ECU_ADDRESS 0x60037EF6 /end MEASUREMENT
/begin MEASUREMENT Batt_flgRawCorrnCmpl "Flag to indicate Dark current correction of IBSUMRAW is completed" UBYTE B_TRUE 1 100 0.00 1.00000000000 BIT_MASK 0x1 FORMAT "%13.11" ECU_ADDRESS 0x60009C27 /end MEASUREMENT
/begin MEASUREMENT Batt_flgRawExe "IBSUMRAW calculation completed status flag" UBYTE B_TRUE 1 100 0.00 1.00000000000 BIT_MASK 0x1 FORMAT "%13.11" ECU_ADDRESS 0x60037EAA /end MEASUREMENT
/begin MEASUREMENT Batt_flgRcvChrgCmpl "Battery recovery charge complete" UBYTE B_TRUE 1 100 0.00 1.00000000000 BIT_MASK 0x1 FORMAT "%13.11" ECU_ADDRESS 0x60009FC2 /end MEASUREMENT
/begin MEASUREMENT Batt_flgRcvChrgNotCmpl "Battery recovery charge not complete" UBYTE B_TRUE 1 100 0.00 1.00000000000 BIT_MASK 0x1 FORMAT "%13.11" ECU_ADDRESS 0x60037EA9 /end MEASUREMENT
/begin MEASUREMENT Batt_flgRInhbISSLoc "Local variable for ISS inhibit based on battery internal resistance without correction for temperature" UBYTE B_TRUE 1 100 0.00 1.00000000000 BIT_MASK 0x1 FORMAT "%13.11" ECU_ADDRESS 0x60009C18 /end MEASUREMENT
/begin MEASUREMENT Batt_flgSetSt8 "Flag to indicate battery management state has entered state 8 before IS" UBYTE B_TRUE 1 100 0.00 1.00000000000 BIT_MASK 0x1 FORMAT "%13.11" ECU_ADDRESS 0x60037EA8 /end MEASUREMENT
/begin MEASUREMENT Batt_flgSocCalcn "SOC calculation status" UBYTE B_TRUE 1 100 0.00 1.00000000000 BIT_MASK 0x1 FORMAT "%13.11" ECU_ADDRESS 0x60009FC1 /end MEASUREMENT
/begin MEASUREMENT Batt_flgSOCDiffDetd "UWABURE detection status flag" UBYTE B_TRUE 1 100 0.00 1.00000000000 BIT_MASK 0x1 FORMAT "%13.11" ECU_ADDRESS 0x60037EF5 /end MEASUREMENT
/begin MEASUREMENT Batt_flgSOCDiffExcd "Difference between Battery estimated SOC and battery actual SOC exceeds a threshold value" UBYTE B_TRUE 1 100 0.00 1.00000000000 BIT_MASK 0x1 FORMAT "%13.11" ECU_ADDRESS 0x60037EF4 /end MEASUREMENT
/begin MEASUREMENT Batt_flgSt1Cmpl "Battery management state 1 completed status flag" UBYTE B_TRUE 1 100 0.00 1.00000000000 BIT_MASK 0x1 FORMAT "%13.11" ECU_ADDRESS 0x60037EF3 /end MEASUREMENT
/begin MEASUREMENT Batt_flgSt1Hist "Flag updates the history of State Transition from ST0 to ST1" UBYTE B_TRUE 1 100 0.00 1.00000000000 BIT_MASK 0x1 FORMAT "%13.11" ECU_ADDRESS 0x60009C26 /end MEASUREMENT
/begin MEASUREMENT Batt_flgSt7Tran "Flag to indicate battery management state has entered state 7" UBYTE B_TRUE 1 100 0.00 1.00000000000 BIT_MASK 0x1 FORMAT "%13.11" ECU_ADDRESS 0x60037EF2 /end MEASUREMENT
/begin MEASUREMENT Batt_flgSt8Rec "Flag to indicate Transition to BMSTATUS8 in position definition" UBYTE B_TRUE 1 100 0.00 1.00000000000 BIT_MASK 0x1 FORMAT "%13.11" ECU_ADDRESS 0x60037EA7 /end MEASUREMENT
/begin MEASUREMENT Batt_flgStalEng "Engine stall detected" UBYTE B_TRUE 1 100 0.00 1.00000000000 BIT_MASK 0x1 FORMAT "%13.11" ECU_ADDRESS 0x60009C25 /end MEASUREMENT
/begin MEASUREMENT Batt_flgStdyCorrnCmpl "Flag to indicate Dark current correction of IBSUMSTDY is completed" UBYTE B_TRUE 1 100 0.00 1.00000000000 BIT_MASK 0x1 FORMAT "%13.11" ECU_ADDRESS 0x60009C24 /end MEASUREMENT
/begin MEASUREMENT Batt_flgTransReas1 "Flag to identify the reason for transition to state 1 from state 0" UBYTE B_TRUE 1 100 0.00 1.00000000000 BIT_MASK 0x1 FORMAT "%13.11" ECU_ADDRESS 0x60037EA6 /end MEASUREMENT
/begin MEASUREMENT Batt_idxRDcyc "Internal index for driving cycle buffer" UBYTE OneToOne 1 100 0.00 4.000 FORMAT "%5.3" ECU_ADDRESS 0x60037F04 /end MEASUREMENT
/begin MEASUREMENT Batt_lMaxCnsChk "Record point of maximum amount for factory inspection" UWORD OilMlg 1 100 0.00 65535.00 FORMAT "%8.2" ECU_ADDRESS 0x60037F14 /end MEASUREMENT
/begin MEASUREMENT Batt_lMinCnsChk "Record point of minimum amount for factory inspection" UWORD OilMlg 1 100 0.00 65535.00 FORMAT "%8.2" ECU_ADDRESS 0x60037F12 /end MEASUREMENT
/begin MEASUREMENT Batt_qBattDoD "The DOD of battery during idle stop" SLONG RBPtCel_q_0p001_1 1 100 -2147483.64800 0.00 FORMAT "%13.5" ECU_ADDRESS 0x50001040 /end MEASUREMENT
/begin MEASUREMENT Batt_qBattFild "Quantity of sensor value battery current" SLONG q0p001_A_s_1 1 100 -2147483.64800 2147483.64700 FORMAT "%13.5" ECU_ADDRESS 0x6000197C /end MEASUREMENT
/begin MEASUREMENT Batt_qCap20 "Battery capacity (20-hour rate)" UWORD q0p01_A_h_1 1 100 0.00 327.6700 FORMAT "%8.4" ECU_ADDRESS 0x60004DB2 /end MEASUREMENT
/begin MEASUREMENT Batt_qChrgCnsChk "Battery charge amount for factory inspection" SLONG q0p001_A_s_1 1 100 -2147483.64800 2147483.64700 FORMAT "%13.5" ECU_ADDRESS 0x60037F78 /end MEASUREMENT
/begin MEASUREMENT Batt_qChrgCnsChkAH "Battery discharge amount for factory inspection" SLONG q0p01_A_h_1 1 100 -21474836.4800 21474836.4700 FORMAT "%13.4" ECU_ADDRESS 0x60037F74 /end MEASUREMENT
/begin MEASUREMENT Batt_qCnsChk "The total of battery charge and discharge quantity for factory inspection" SLONG q0p001_A_s_1 1 100 -2147483.64800 2147483.64700 FORMAT "%13.5" ECU_ADDRESS 0x60037F70 /end MEASUREMENT
/begin MEASUREMENT Batt_qCnsChkAH "The total of battery charge and discharge quantity for factory inspection in Ah" SLONG q0p01_A_h_1 1 100 -21474836.4800 21474836.4700 FORMAT "%13.4" ECU_ADDRESS 0x60037F6C /end MEASUREMENT
/begin MEASUREMENT Batt_qDarkIJudgVal "Judgement value for permission to use unsteady dark current" SLONG RBPtCel_q_0p001_1 1 100 -2147483.64800 2147483.64700 FORMAT "%13.5" ECU_ADDRESS 0x600001B0 /end MEASUREMENT
/begin MEASUREMENT Batt_qDarkJudgValAHi "Hysterisis Upper threshold for dark current allow judgement condition A" SLONG RBPtCel_q_0p001_1 1 100 -2147483.64800 2147483.64700 FORMAT "%13.5" ECU_ADDRESS 0x600001B4 /end MEASUREMENT
/begin MEASUREMENT Batt_qDarkJudgValALo "Hysterisis Lower threshold for dark current allow judgement condition A" SLONG RBPtCel_q_0p001_1 1 100 -2147483.64800 2147483.64700 FORMAT "%13.5" ECU_ADDRESS 0x600001B8 /end MEASUREMENT
/begin MEASUREMENT Batt_qDarkJudgValBHi "Hysterisis Upper threshold for dark current allow judgement condition B" SLONG RBPtCel_q_0p001_1 1 100 -2147483.64800 2147483.64700 FORMAT "%13.5" ECU_ADDRESS 0x600001BC /end MEASUREMENT
/begin MEASUREMENT Batt_qDarkJudgValBLo "Hysterisis Lower threshold for dark current allow judgement condition B" SLONG RBPtCel_q_0p001_1 1 100 -2147483.64800 2147483.64700 FORMAT "%13.5" ECU_ADDRESS 0x600001C0 /end MEASUREMENT
/begin MEASUREMENT Batt_qDchaCnsChk "Battery discharge amount for factory inspection" SLONG q0p001_A_s_1 1 100 -2147483.64800 2147483.64700 FORMAT "%13.5" ECU_ADDRESS 0x60037F68 /end MEASUREMENT
/begin MEASUREMENT Batt_qDchaCnsChkAH "Battery discharge amount for factory inspection in Ah" SLONG q0p01_A_h_1 1 100 -21474836.4800 21474836.4700 FORMAT "%13.4" ECU_ADDRESS 0x60037F64 /end MEASUREMENT
/begin MEASUREMENT Batt_qMaxCnsChk "The maximum value of amount for factory inspection" SLONG q0p001_A_s_1 1 100 -2147483.64800 2147483.64700 FORMAT "%13.5" ECU_ADDRESS 0x60037F60 /end MEASUREMENT
/begin MEASUREMENT Batt_qMaxCnsChkAH "The maximum value of amount for factory inspection in Ah" SLONG q0p01_A_h_1 1 100 -21474836.4800 21474836.4700 FORMAT "%13.4" ECU_ADDRESS 0x60037F5C /end MEASUREMENT
/begin MEASUREMENT Batt_qMinCnsChk "The minimum value of amount for factory inspection" SLONG q0p001_A_s_1 1 100 -2147483.64800 2147483.64700 FORMAT "%13.5" ECU_ADDRESS 0x60037F58 /end MEASUREMENT
/begin MEASUREMENT Batt_qMinCnsChkAH "The minimum value of amount for factory inspection in Ah" SLONG q0p01_A_h_1 1 100 -21474836.4800 21474836.4700 FORMAT "%13.4" ECU_ADDRESS 0x60037F54 /end MEASUREMENT
/begin MEASUREMENT Batt_qSohTmp1_MP "Temporary calculation 1 of battery state of charge based on SOH" SLONG RBPtCel_q_0p125_1 1 100 -268435456.000 268435455.875 FORMAT "%13.3" ECU_ADDRESS 0x70009288 /end MEASUREMENT
/begin MEASUREMENT Batt_qSohTmp2_MP "Temporary calculation 2 of battery SOC based on SOH" SLONG RBPtCel_q_0p125_1 1 100 -268435456.000 268435455.875 FORMAT "%13.3" ECU_ADDRESS 0x70009284 /end MEASUREMENT
/begin MEASUREMENT Batt_qSohTmp3_MP "Temporary calculation 3 of battery state of charge based on SOH" SLONG RBPtCel_q_0p125_1 1 100 -268435456.000 268435455.875 FORMAT "%13.3" ECU_ADDRESS 0x70009280 /end MEASUREMENT
/begin MEASUREMENT Batt_qSumHi "Battery current integral ( hi charge efficiency )" SLONG RBPtCel_q_0p001_1 1 100 -2147483.64800 2147483.64700 FORMAT "%13.5" ECU_ADDRESS 0x60037F50 /end MEASUREMENT
/begin MEASUREMENT Batt_qSumHiNR "Battery current integral wo reset" SLONG RBPtCel_q_0p001_1 1 100 -2147483.64800 2147483.64700 FORMAT "%13.5" ECU_ADDRESS 0x60037F4C /end MEASUREMENT
/begin MEASUREMENT Batt_qSumLo "Battery current integral ( low charge efficiency )" SLONG RBPtCel_q_0p001_1 1 100 -2147483.64800 2147483.64700 FORMAT "%13.5" ECU_ADDRESS 0x60037F48 /end MEASUREMENT
/begin MEASUREMENT Batt_qSumRaw "Battery current integral after position definition state of UWABURE detection" SLONG RBPtCel_q_0p001_1 1 100 -2147483.64800 2147483.64700 FORMAT "%13.5" ECU_ADDRESS 0x60037F40 /end MEASUREMENT
/begin MEASUREMENT Batt_qSumRCINI "Battery current integral for low OCV detection" SLONG RBPtCel_q_0p001_1 1 100 -2147483.64800 2147483.64700 FORMAT "%13.5" ECU_ADDRESS 0x60037F44 /end MEASUREMENT
/begin MEASUREMENT Batt_qSumStdy "Battery current integral in position definition state of UWABURE detection" SLONG RBPtCel_q_0p001_1 1 100 -2147483.64800 2147483.64700 FORMAT "%13.5" ECU_ADDRESS 0x60037F3C /end MEASUREMENT
/begin MEASUREMENT Batt_ratSoc "SOC based on nominal capacity" UBYTE RBPtCel_Perc_0p5_1 1 100 0.00 127.5 FORMAT "%5.1" ECU_ADDRESS 0x6000A6A8 /end MEASUREMENT
/begin MEASUREMENT Batt_ratSOCCalc "Battery SOC calculated from Battery current integral" UBYTE RBPtCel_Perc_0p5_1 1 100 0.00 127.5 FORMAT "%5.1" ECU_ADDRESS 0x6000A0FF /end MEASUREMENT
/begin MEASUREMENT Batt_ratSoc_MP "Measuring point to view Battery State of Charge" SWORD RBPtCel_Perc_0p5_1 1 100 -16384.00 16383.50 FORMAT "%8.2" ECU_ADDRESS 0x7000927C /end MEASUREMENT
/begin MEASUREMENT Batt_rBattExchJudg "Resistance for battery exchange judgement" SWORD Resist_mOhm_q0p01 1 100 -327.6800 327.6700 FORMAT "%8.4" ECU_ADDRESS 0x60003F98 /end MEASUREMENT
/begin MEASUREMENT Batt_rBattOld "Internal copy of last battery resistance" SWORD RBPtCel_r_0p00001_1 1 100 -0.3276800 0.3276700 FORMAT "%9.7" ECU_ADDRESS 0x60003F96 /end MEASUREMENT
/begin MEASUREMENT Batt_rDcyc "Internal" SWORD RBPtCel_r_0p00001_1 1 100 -0.3276800 0.3276700 FORMAT "%9.7" ARRAY_SIZE 4 ECU_ADDRESS 0x60037E90 /end MEASUREMENT
/begin MEASUREMENT Batt_rExch "Temporary resistance during battery exchange judgement" SWORD Resist_mOhm_q0p01 1 100 -327.6800 327.6700 FORMAT "%8.4" ECU_ADDRESS 0x60037E8E /end MEASUREMENT
/begin MEASUREMENT Batt_rMean "Mean battery resistance over driving cycle" SWORD RBPtCel_r_0p00001_1 1 100 -0.3276800 0.3276700 FORMAT "%9.7" ECU_ADDRESS 0x60037E8C /end MEASUREMENT
/begin MEASUREMENT Batt_rSlopBattDgrd "Slope for battery internal resistance for battery degradation" SWORD RBPtCel_r_0p00001_1 1 100 -0.3276800 0.3276700 FORMAT "%9.7" ECU_ADDRESS 0x60003F94 /end MEASUREMENT
/begin MEASUREMENT Batt_rSlopISSEna "Slope for battery internal resistance for ISS enable" SWORD RBPtCel_r_0p00001_1 1 100 -0.3276800 0.3276700 FORMAT "%9.7" ECU_ADDRESS 0x60003F92 /end MEASUREMENT
/begin MEASUREMENT Batt_stBattCodChgID1 "Status of change of battery code to ID1" UBYTE B_TRUE 1 100 0.00 1.00000000000 BIT_MASK 0x1 FORMAT "%13.11" ECU_ADDRESS 0x60009C23 /end MEASUREMENT
/begin MEASUREMENT Batt_stBattCodChgID2 "Status of change of battery code to ID2" UBYTE B_TRUE 1 100 0.00 1.00000000000 BIT_MASK 0x1 FORMAT "%13.11" ECU_ADDRESS 0x60009C22 /end MEASUREMENT
/begin MEASUREMENT Batt_stCalc "Battery SOC calculation state" UBYTE OneToOne 1 100 0.00 255.0 FORMAT "%5.1" ECU_ADDRESS 0x60037F03 /end MEASUREMENT
/begin MEASUREMENT Batt_stCalcPrev "Previous Battery SOC calculation state" UBYTE OneToOne 1 100 0.00 255.0 FORMAT "%5.1" ECU_ADDRESS 0x60037F02 /end MEASUREMENT
/begin MEASUREMENT Batt_stChrgnIStopEna "Stop enable judgement based on charging current" UBYTE B_TRUE 1 100 0.00 1.00000000000 BIT_MASK 0x1 FORMAT "%13.11" ECU_ADDRESS 0x60009C21 /end MEASUREMENT
/begin MEASUREMENT Batt_stDod "State engine DOD" UBYTE OneToOne 1 100 0.00 255.0 FORMAT "%5.1" ECU_ADDRESS 0x60009C20 /end MEASUREMENT
/begin MEASUREMENT Batt_stEbsBattCod "Status indicating need for battery coding" UBYTE B_TRUE 1 100 0.00 1.00000000000 BIT_MASK 0x1 FORMAT "%13.11" ECU_ADDRESS 0x6000A21E /end MEASUREMENT
/begin MEASUREMENT Batt_stEbsBattCodLoc "Local value for status indicating need for battery coding" UBYTE OneToOne 1 100 0.00 3.000 FORMAT "%5.3" ECU_ADDRESS 0x60037EA5 /end MEASUREMENT
/begin MEASUREMENT Batt_stEngStopInhbn "Reason for stop inhibit (Bit coded)" UWORD OneToOne 1 100 0.00 65535.00 FORMAT "%8.2" ECU_ADDRESS 0x60004DB0 /end MEASUREMENT
/begin MEASUREMENT Batt_stREBSInhbSpst "Inhibit ISS request due to battery resistance measured by EBS during key-start is invalid" UBYTE B_TRUE 1 100 0.00 1.00000000000 BIT_MASK 0x1 FORMAT "%13.11" ECU_ADDRESS 0x60009C17 /end MEASUREMENT
/begin MEASUREMENT Batt_StrtEnbl_MP "Measurement point for start enable by battery sensor" UBYTE B_TRUE 1 100 0.00 1.00000000000 BIT_MASK 0x1 FORMAT "%13.11" ECU_ADDRESS 0x7000927B /end MEASUREMENT
/begin MEASUREMENT Batt_stSix "Substate information in battery management state 6" UBYTE OneToOne 1 100 0.00 255.0 FORMAT "%5.1" ECU_ADDRESS 0x60037EA4 /end MEASUREMENT
/begin MEASUREMENT Batt_stSoc_MP "Measuring point for Battery SOC received from sensor" UBYTE OneToOne 1 100 0.00 255.0 FORMAT "%5.1" ECU_ADDRESS 0x7000927A /end MEASUREMENT
/begin MEASUREMENT Batt_stZero "Substate information in battery management state 0" UBYTE OneToOne 1 100 0.00 255.0 FORMAT "%5.1" ECU_ADDRESS 0x60009C1F /end MEASUREMENT
/begin MEASUREMENT Batt_tiCumTi1 "Cumulative time 1" ULONG Time_sec_1 1 100 0.00 429496729.500 FORMAT "%13.3" ECU_ADDRESS 0x60037EA0 /end MEASUREMENT
/begin MEASUREMENT Batt_tiCumTi2 "Cumulative time 2" ULONG Time_sec_1 1 100 0.00 429496729.500 FORMAT "%13.3" ECU_ADDRESS 0x60037E9C /end MEASUREMENT
/begin MEASUREMENT Batt_uSofOffs "SOF_V precision offset" SWORD spg_q0p0625_V 1 100 -2048.000 2047.938 FORMAT "%8.3" ECU_ADDRESS 0x60003F9A /end MEASUREMENT
/begin MEASUREMENT BBKHFES_ctReIni "local drive cycle counter which is incremented when system state postdrive is left" UBYTE dez 1 100 0.00 255.0 FORMAT "%5.1" ECU_ADDRESS 0x60009C16 /end MEASUREMENT
/begin MEASUREMENT BdInt_bClthOnDspReqPreCond "clutch on display request" UBYTE OneToOne 1 100 0.00 255.0 FORMAT "%5.1" ECU_ADDRESS 0x6000A6A7 /end MEASUREMENT
/begin MEASUREMENT BdInt_bEngStopEna "stop release driver physical presence detection and engine bonnet" UBYTE OneToOne 1 100 0.00 255.0 BIT_MASK 0x1 FORMAT "%5.1" ECU_ADDRESS 0x6000A21D /end MEASUREMENT
/begin MEASUREMENT BdInt_bEngStrtEna "start release driver physical presence detection and engine bonnet" UBYTE OneToOne 1 100 0.00 255.0 BIT_MASK 0x1 FORMAT "%5.1" ECU_ADDRESS 0x6000A21C /end MEASUREMENT
/begin MEASUREMENT BdInt_bRstrtNoPtd "Engine restart not permitted condition" UBYTE OneToOne 1 100 0.00 255.0 FORMAT "%5.1" ECU_ADDRESS 0x6000A6A6 /end MEASUREMENT
/begin MEASUREMENT BdInt_cntrIniDrv "ReIni drive counter" UBYTE OneToOne 1 100 0.00 255.0 FORMAT "%5.1" ECU_ADDRESS 0x60009BF8 /end MEASUREMENT
/begin MEASUREMENT BdInt_stDCDCCdn "status of idle stop permitteddconditions depending on DCDC" UBYTE OneToOne 1 100 0.00 255.0 FORMAT "%5.1" ECU_ADDRESS 0x6000A6A5 /end MEASUREMENT
/begin MEASUREMENT BdInt_stEngHoodOpen_MP "Engine Hood Open status" UBYTE OneToOne 1 100 0.00 255.0 FORMAT "%5.1" ECU_ADDRESS 0x70009279 /end MEASUREMENT
/begin MEASUREMENT BdInt_stEngStrtCdn "Engine start condition" UBYTE OneToOne 1 100 0.00 255.0 FORMAT "%5.1" ECU_ADDRESS 0x6000A6A4 /end MEASUREMENT
/begin MEASUREMENT BdInt_stEngStrtEna_mp "Engine start enable status" UBYTE OneToOne 1 100 0.00 255.0 FORMAT "%5.1" ECU_ADDRESS 0x70009278 /end MEASUREMENT
/begin MEASUREMENT BdInt_stFrEngStrtCdn_mp "Forced engine start condition" UBYTE OneToOne 1 100 0.00 255.0 FORMAT "%5.1" ECU_ADDRESS 0x70009277 /end MEASUREMENT
/begin MEASUREMENT BdInt_stHoodOpenDurgEngStrt "Engine Hood Open During Engine Starting" UBYTE OneToOne 1 100 0.00 255.0 FORMAT "%5.1" ECU_ADDRESS 0x6000A6A3 /end MEASUREMENT
/begin MEASUREMENT BdInt_stInhbReas "ISS Inhibit reason" UBYTE OneToOne 1 100 0.00 255.0 FORMAT "%5.1" ECU_ADDRESS 0x6000A6A2 /end MEASUREMENT
/begin MEASUREMENT BdInt_stPCU "Panel control unit availability status" UBYTE OneToOne 1 100 0.00 255.0 FORMAT "%5.1" ECU_ADDRESS 0x6000A6A1 /end MEASUREMENT
/begin MEASUREMENT BdInt_stRstrtNoPtdCdn_mp "Condition of engine restart permission" UBYTE OneToOne 1 100 0.00 255.0 FORMAT "%5.1" ECU_ADDRESS 0x70009276 /end MEASUREMENT
/begin MEASUREMENT BdyECU_ctBCM1RngCnt_MP "Alive counter measurement point" UBYTE OneToOne 1 100 0.00 3.000 FORMAT "%5.3" ECU_ADDRESS 0x70009275 /end MEASUREMENT
/begin MEASUREMENT BdyECU_ctRngSRSA_MP "SRSA frame counter information" UBYTE OneToOne 1 100 0.00 255.0 FORMAT "%5.1" ECU_ADDRESS 0x70009273 /end MEASUREMENT
/begin MEASUREMENT BdyECU_ctRngSRSB_MP "Alive counter measurent point for SRSB frame" UBYTE OneToOne 1 100 0.00 255.0 FORMAT "%5.1" ECU_ADDRESS 0x70009272 /end MEASUREMENT
/begin MEASUREMENT BdyECU_ctRngSRS_MP "Alive counter mersurent point for SRS frame" UBYTE OneToOne 1 100 0.00 255.0 FORMAT "%5.1" ECU_ADDRESS 0x70009274 /end MEASUREMENT
/begin MEASUREMENT BrkS_cntrReIni "counter for state re-initialization" UBYTE OneToOne 1 100 0.00 255.0 FORMAT "%5.1" ECU_ADDRESS 0x60009BF5 /end MEASUREMENT
/begin MEASUREMENT BrkS_flgBrkPmpgActv "Flag to indicate if brake pumping is active" UBYTE B_TRUE 1 100 0.00 1.00000000000 BIT_MASK 0x1 FORMAT "%13.11" ECU_ADDRESS 0x6000A20C /end MEASUREMENT
/begin MEASUREMENT BrkS_flgBrkPmpgDetd "Brake Pumping Detected" UBYTE B_TRUE 1 100 0.00 1.00000000000 BIT_MASK 0x1 FORMAT "%13.11" ECU_ADDRESS 0x6000A20B /end MEASUREMENT
/begin MEASUREMENT BrkS_flgIdle "Flag for Idle condition" UBYTE B_TRUE 1 100 0.00 1.00000000000 BIT_MASK 0x1 FORMAT "%13.11" ECU_ADDRESS 0x6000A20A /end MEASUREMENT
/begin MEASUREMENT BrkS_mfBrkPmpg "Integrated mass flow at brake pumping" UWORD m_q0p1 1 100 0.00 6553.500 FORMAT "%8.3" ECU_ADDRESS 0x60003F66 /end MEASUREMENT
/begin MEASUREMENT BrkS_mfBrkPmpgCnvn "Pressure difference in intake manifold converted to mass flow" SLONG m_q0p1 1 100 -214748364.800 214748364.700 FORMAT "%13.3" ECU_ADDRESS 0x60001978 /end MEASUREMENT
/begin MEASUREMENT BrkS_mfIntegUpprThd "Upper thresholf of integrated mass flow" SWORD m_q0p1 1 100 -3276.800 3276.700 FORMAT "%8.3" ECU_ADDRESS 0x60003F64 /end MEASUREMENT
/begin MEASUREMENT BrkS_pDifBrkPmpg "Pressure difference between measured and modelled intake manifold pressure" SLONG p_q0p078 1 100 -167772160.000 167772159.922 FORMAT "%13.3" ECU_ADDRESS 0x60001974 /end MEASUREMENT
/begin MEASUREMENT B_adneusyn "new synchronisation triggered during STADAP" UBYTE B_TRUE 1 100 0.00 1.00000000000 BIT_MASK 0x1 FORMAT "%13.11" ECU_ADDRESS 0x70000374 /end MEASUREMENT
/begin MEASUREMENT B_adstopnd "Low pressure start causes cancel of starting fuel adaptation" UBYTE B_TRUE 1 100 0.00 1.00000000000 BIT_MASK 0x1 FORMAT "%13.11" ECU_ADDRESS 0x70000373 /end MEASUREMENT
/begin MEASUREMENT B_apslmdse_msg "condition: adaptation modelled to measured manifold pressure stationary" UBYTE B_TRUE 1 100 0.00 1.00000000000 BIT_MASK 0x1 FORMAT "%13.11" ECU_ADDRESS 0x60000167 /end MEASUREMENT
/begin MEASUREMENT B_apslmds_msg "condition: adaptation modelled to measured manifold pressure run" UBYTE B_TRUE 1 100 0.00 1.00000000000 BIT_MASK 0x1 FORMAT "%13.11" ECU_ADDRESS 0x60000168 /end MEASUREMENT
/begin MEASUREMENT B_bevab_msg "Condition: Injection valve cut off on Bank 1" UBYTE B_TRUE 1 100 0.00 1.00000000000 BIT_MASK 0x1 FORMAT "%13.11" ECU_ADDRESS 0x70000AAC /end MEASUREMENT
/begin MEASUREMENT B_clcbh "condition: blockheater-detection active" UBYTE B_TRUE 1 100 0.00 1.00000000000 BIT_MASK 0x1 FORMAT "%13.11" ECU_ADDRESS 0x70000366 /end MEASUREMENT
/begin MEASUREMENT B_delayhld "IKC: condition to hold the delay for dynamic" UBYTE B_TRUE 1 100 0.00 1.00000000000 BIT_MASK 0x1 FORMAT "%13.11" ECU_ADDRESS 0x7000037D /end MEASUREMENT
/begin MEASUREMENT B_dmdadap "Bit to indicate the type of signal processing for misfire detection" UBYTE B_TRUE 1 100 0.00 1.00000000000 BIT_MASK 0x1 FORMAT "%13.11" ECU_ADDRESS 0x50000844 /end MEASUREMENT
/begin MEASUREMENT B_dnsll "condition fuel cut off engine speed hysteresis DNSLL" UBYTE B_TRUE 1 100 0.00 1.00000000000 BIT_MASK 0x1 FORMAT "%13.11" ECU_ADDRESS 0x60009C08 /end MEASUREMENT
/begin MEASUREMENT B_eks "condition knock sensor defect detected" UBYTE B_TRUE 1 100 0.00 1.00000000000 BIT_MASK 0x1 FORMAT "%13.11" ECU_ADDRESS 0x7000037C /end MEASUREMENT
/begin MEASUREMENT B_enbhtr_msg "BlockHeater-Detection is enabled" UBYTE B_TRUE 1 100 0.00 1.00000000000 BIT_MASK 0x1 FORMAT "%13.11" ECU_ADDRESS 0x70000A7E /end MEASUREMENT
/begin MEASUREMENT B_engroads "condition ""rough engine run with warm engine"" as criterium for stop of ""bad fuel adaptions""" UBYTE B_TRUE 1 100 0.00 1.00000000000 BIT_MASK 0x1 FORMAT "%13.11" ECU_ADDRESS 0x60034992 /end MEASUREMENT
/begin MEASUREMENT B_engroold """old value"" of B_engroads" UBYTE B_TRUE 1 100 0.00 1.00000000000 BIT_MASK 0x1 FORMAT "%13.11" ECU_ADDRESS 0x70000372 /end MEASUREMENT
/begin MEASUREMENT B_ensad "Condition enable afterstart adaptation" UBYTE B_TRUE 1 100 0.00 1.00000000000 BIT_MASK 0x1 FORMAT "%13.11" ECU_ADDRESS 0x70000371 /end MEASUREMENT
/begin MEASUREMENT B_esdluts "Condition enable calculation of standard deviation of engine roughness" UBYTE B_TRUE 1 100 0.00 1.00000000000 BIT_MASK 0x1 FORMAT "%13.11" ECU_ADDRESS 0x70000370 /end MEASUREMENT
/begin MEASUREMENT B_evakt_msg "Condition all injection valves active" UBYTE B_TRUE 1 100 0.00 1.00000000000 BIT_MASK 0x1 FORMAT "%13.11" ECU_ADDRESS 0x70000A6E /end MEASUREMENT
/begin MEASUREMENT B_evloc_msg "Condition all injection valves are activated, two camshaft revolutions delayed after fuel cutoff" UBYTE B_TRUE 1 100 0.00 1.00000000000 BIT_MASK 0x1 FORMAT "%13.11" ECU_ADDRESS 0x70000A6C /end MEASUREMENT
/begin MEASUREMENT B_fgdlzsr "Conditiion: Enable conditon of LZSR diagnosis" UBYTE B_TRUE 1 100 0.00 1.00000000000 BIT_MASK 0x1 FORMAT "%13.11" ECU_ADDRESS 0x60000153 /end MEASUREMENT
/begin MEASUREMENT B_glsr_msg "error flag for big leak in the intake manifold" UBYTE B_TRUE 1 100 0.00 1.00000000000 BIT_MASK 0x1 FORMAT "%13.11" ECU_ADDRESS 0x6000014E /end MEASUREMENT
/begin MEASUREMENT B_inhbadst "inhibit condition ""bad start is not caused by bad fuel""" UBYTE B_TRUE 1 100 0.00 1.00000000000 BIT_MASK 0x1 FORMAT "%13.11" ECU_ADDRESS 0x7000036F /end MEASUREMENT
/begin MEASUREMENT B_inhengro "inhibit condition ""rough engine run is not caused by bad fuel""" UBYTE B_TRUE 1 100 0.00 1.00000000000 BIT_MASK 0x1 FORMAT "%13.11" ECU_ADDRESS 0x7000036E /end MEASUREMENT
/begin MEASUREMENT B_inhronu "inhibit condition ""do not use engine roughness information at the moment""" UBYTE B_TRUE 1 100 0.00 1.00000000000 BIT_MASK 0x1 FORMAT "%13.11" ECU_ADDRESS 0x7000036D /end MEASUREMENT
/begin MEASUREMENT B_koe_loc "Condition for AC (air condition) compressor on" UBYTE B_TRUE 1 100 0.00 1.00000000000 BIT_MASK 0x1 FORMAT "%13.11" ECU_ADDRESS 0x60009C07 /end MEASUREMENT
/begin MEASUREMENT B_krenfadi "IKC: fast advance ignition due to B_wkral" UBYTE B_TRUE 1 100 0.00 1.00000000000 BIT_MASK 0x1 FORMAT "%13.11" ECU_ADDRESS 0x7000037B /end MEASUREMENT
/begin MEASUREMENT B_krsyne "knock control synchronisation error at phase error" UBYTE B_TRUE 1 100 0.00 1.00000000000 BIT_MASK 0x1 FORMAT "%13.11" ECU_ADDRESS 0x7000037A /end MEASUREMENT
/begin MEASUREMENT B_krvhdy_msg "condition variable valve lift dynamics for knock detection active" UBYTE B_TRUE 1 100 0.00 1.00000000000 BIT_MASK 0x1 FORMAT "%13.11" ECU_ADDRESS 0x6000A238 /end MEASUREMENT
/begin MEASUREMENT B_lamfas_msg "disable of activtion lambda driver" UBYTE B_TRUE 1 100 0.00 1.00000000000 BIT_MASK 0x1 FORMAT "%13.11" ECU_ADDRESS 0x70000A14 /end MEASUREMENT
/begin MEASUREMENT B_lamfa_msg "desired lambda activated by driver" UBYTE B_TRUE 1 100 0.00 1.00000000000 BIT_MASK 0x1 FORMAT "%13.11" ECU_ADDRESS 0x70000A15 /end MEASUREMENT
/begin MEASUREMENT B_lzsrhfmp "condition: leakage detetction in intake manifold dependent on MAF and MAP" UBYTE B_TRUE 1 100 0.00 1.00000000000 BIT_MASK 0x1 FORMAT "%13.11" ECU_ADDRESS 0x600000F6 /end MEASUREMENT
/begin MEASUREMENT B_mdfasfk_msg "Condition: AS request to torque structure to control the torque (actual to desired) with pay attention to the driveability" UBYTE B_TRUE 1 100 0.00 1.00000000000 BIT_MASK 0x1 FORMAT "%13.11" ECU_ADDRESS 0x60000149 /end MEASUREMENT
/begin MEASUREMENT B_mdfasnl_msg "Condition: AS request to torque structure to control the torque (actual to desired) without pay attention to the driveability (limp home)" UBYTE B_TRUE 1 100 0.00 1.00000000000 BIT_MASK 0x1 FORMAT "%13.11" ECU_ADDRESS 0x60000148 /end MEASUREMENT
/begin MEASUREMENT B_nbhtr_msg "condition: no blockheater has been detected" UBYTE B_TRUE 1 100 0.00 1.00000000000 BIT_MASK 0x1 FORMAT "%13.11" ECU_ADDRESS 0x700009E2 /end MEASUREMENT
/begin MEASUREMENT B_nibhtr_msg "condition: blockheater-detection not possible" UBYTE B_TRUE 1 100 0.00 1.00000000000 BIT_MASK 0x1 FORMAT "%13.11" ECU_ADDRESS 0x700009E1 /end MEASUREMENT
/begin MEASUREMENT B_nsadend_msg "Condition finish afterstart adaptation" UBYTE B_TRUE 1 100 0.00 1.00000000000 BIT_MASK 0x1 FORMAT "%13.11" ECU_ADDRESS 0x700009D9 /end MEASUREMENT
/begin MEASUREMENT B_nsadh_msg "Condition hold afterstart adaptation" UBYTE B_TRUE 1 100 0.00 1.00000000000 BIT_MASK 0x1 FORMAT "%13.11" ECU_ADDRESS 0x700009D8 /end MEASUREMENT
/begin MEASUREMENT B_nsadstp "Condition stop afterstart adaptation" UBYTE B_TRUE 1 100 0.00 1.00000000000 BIT_MASK 0x1 FORMAT "%13.11" ECU_ADDRESS 0x7000036C /end MEASUREMENT
/begin MEASUREMENT B_nsad_msg "Condition afterstart adaptation active" UBYTE B_TRUE 1 100 0.00 1.00000000000 BIT_MASK 0x1 FORMAT "%13.11" ECU_ADDRESS 0x700009DA /end MEASUREMENT
/begin MEASUREMENT B_nwemg "Condition: switch-over of the resume speed at 'clutch opens'" UBYTE B_TRUE 1 100 0.00 1.00000000000 BIT_MASK 0x1 FORMAT "%13.11" ECU_ADDRESS 0x60009C06 /end MEASUREMENT
/begin MEASUREMENT B_pnbhtr "condition: no blockheater has been detected (provisionally)" UBYTE B_TRUE 1 100 0.00 1.00000000000 BIT_MASK 0x1 FORMAT "%13.11" ECU_ADDRESS 0x70000365 /end MEASUREMENT
/begin MEASUREMENT B_sabvorLoc "Fuel-cutoff prerelease" UBYTE B_TRUE 1 100 0.00 1.00000000000 BIT_MASK 0x1 FORMAT "%13.11" ECU_ADDRESS 0x60009C05 /end MEASUREMENT
/begin MEASUREMENT B_saen_msg "Overrun fuel cutoff is fundamentally released." UBYTE B_TRUE 1 100 0.00 1.00000000000 BIT_MASK 0x1 FORMAT "%13.11" ECU_ADDRESS 0x6000A230 /end MEASUREMENT
/begin MEASUREMENT B_sccnsad "FID: Fault Identity Detection afterstart adaptation" UBYTE B_TRUE 1 100 0.00 1.00000000000 BIT_MASK 0x1 FORMAT "%13.11" ECU_ADDRESS 0x7000036B /end MEASUREMENT
/begin MEASUREMENT B_sccnsad2 "FID: Fault Identity Detection afterstart adaptation" UBYTE B_TRUE 1 100 0.00 1.00000000000 BIT_MASK 0x1 FORMAT "%13.11" ECU_ADDRESS 0x7000036A /end MEASUREMENT
/begin MEASUREMENT B_sdlutsr_msg "Condition calculation standard deviation engine roughnessis ready" UBYTE B_TRUE 1 100 0.00 1.00000000000 BIT_MASK 0x1 FORMAT "%13.11" ECU_ADDRESS 0x700009AF /end MEASUREMENT
/begin MEASUREMENT B_sdluts_msg "Condition calculation standard deviation engine roughness" UBYTE B_TRUE 1 100 0.00 1.00000000000 BIT_MASK 0x1 FORMAT "%13.11" ECU_ADDRESS 0x700009B0 /end MEASUREMENT
/begin MEASUREMENT B_staclr_msg "cond. start adaption: clear adaption values" UBYTE B_TRUE 1 100 0.00 1.00000000000 BIT_MASK 0x1 FORMAT "%13.11" ECU_ADDRESS 0x700009A9 /end MEASUREMENT
/begin MEASUREMENT B_staneut_msg "condition start adaption: output neutral value" UBYTE B_TRUE 1 100 0.00 1.00000000000 BIT_MASK 0x1 FORMAT "%13.11" ECU_ADDRESS 0x700009A7 /end MEASUREMENT
/begin MEASUREMENT B_stanodec_msg "cond. startadaption: forbid decrementation" UBYTE B_TRUE 1 100 0.00 1.00000000000 BIT_MASK 0x1 FORMAT "%13.11" ECU_ADDRESS 0x700009A6 /end MEASUREMENT
/begin MEASUREMENT B_stanoinc_msg "cond. startadaption: forbid incrementation" UBYTE B_TRUE 1 100 0.00 1.00000000000 BIT_MASK 0x1 FORMAT "%13.11" ECU_ADDRESS 0x700009A5 /end MEASUREMENT
/begin MEASUREMENT B_stanosav_msg "cond. startadaption: forbid store of ad. values" UBYTE B_TRUE 1 100 0.00 1.00000000000 BIT_MASK 0x1 FORMAT "%13.11" ECU_ADDRESS 0x700009A4 /end MEASUREMENT
/begin MEASUREMENT B_stareset_msg "reset ESS start request" UBYTE B_TRUE 1 100 0.00 1.00000000000 BIT_MASK 0x1 FORMAT "%13.11" ECU_ADDRESS 0x700009A3 /end MEASUREMENT
/begin MEASUREMENT B_tmmn_msg "Condition: blockheater detected" UBYTE B_TRUE 1 100 0.00 1.00000000000 BIT_MASK 0x1 FORMAT "%13.11" ECU_ADDRESS 0x70000980 /end MEASUREMENT
/begin MEASUREMENT B_tmsrt_msg "condition: retriggering engine temperature model after start" UBYTE B_TRUE 1 100 0.00 1.00000000000 BIT_MASK 0x1 FORMAT "%13.11" ECU_ADDRESS 0x7000097F /end MEASUREMENT
/begin MEASUREMENT B_ubkst "Battery-voltage below limit for ZUBKSTMX times" UBYTE B_TRUE 1 100 0.00 1.00000000000 BIT_MASK 0x1 FORMAT "%13.11" ECU_ADDRESS 0x70000369 /end MEASUREMENT
/begin MEASUREMENT CEngDsT_flgBlkHeatrActvd "condittion: Blockheater influence" UBYTE B_TRUE 1 100 0.00 1.00000000000 BIT_MASK 0x1 FORMAT "%13.11" ECU_ADDRESS 0x70000946 /end MEASUREMENT
/begin MEASUREMENT censad_msg "Counter enable afterstart adaptation" UBYTE dez 1 100 0.00 255.0 FORMAT "%5.1" ECU_ADDRESS 0x600007B2 /end MEASUREMENT
/begin MEASUREMENT cesdluts "Counter enable calculation standard deviation engine roughness" UBYTE dez 1 100 0.00 255.0 FORMAT "%5.1" ECU_ADDRESS 0x50000874 /end MEASUREMENT
/begin MEASUREMENT cesdlutsr "counter of synchros since %ESDSDLUT is active" UBYTE dez 1 100 0.00 255.0 FORMAT "%5.1" ECU_ADDRESS 0x50000875 /end MEASUREMENT
/begin MEASUREMENT clutwmen_w_msg "counter for enable condition for counter engine roughness with warm engine" UWORD dez 1 100 0.00 65535.00 FORMAT "%8.2" ECU_ADDRESS 0x500007A6 /end MEASUREMENT
/begin MEASUREMENT clutwm_w_msg "counter engine roughness with warm engine" UWORD dez 1 100 0.00 65535.00 FORMAT "%8.2" ECU_ADDRESS 0x500007A4 /end MEASUREMENT
/begin MEASUREMENT CoEng_bCtOffConDel "delayed release condition for Cut Off" UBYTE B_TRUE 1 100 0.00 1.00000000000 BIT_MASK 0x1 FORMAT "%13.11" ECU_ADDRESS 0x6000A207 /end MEASUREMENT
/begin MEASUREMENT CoEng_FcoRelsDlyTONV_I.outbit "Delay of fuel-cutoff release / return value" UBYTE B_TRUE 1 100 0.00 1.00000000000 BIT_MASK 0x1 FORMAT "%13.11" ECU_ADDRESS 0x60003F68 /end MEASUREMENT
/begin MEASUREMENT CoEng_FcoRelsDlyTONV_I.time "Delay of fuel-cutoff release / expired delay time" UWORD t_q0p01 1 100 0.00 655.3500 FORMAT "%8.4" ECU_ADDRESS 0x60003F6A /end MEASUREMENT
/begin MEASUREMENT CoEng_flgCpvClsForFco "Flag: close canister purge valve for fuel cut-off." UBYTE B_TRUE 1 100 0.00 1.00000000000 BIT_MASK 0x1 FORMAT "%13.11" ECU_ADDRESS 0x6000A205 /end MEASUREMENT
/begin MEASUREMENT CoEng_flgFcoRdnBasc "Flag: Overrun fuel cutoff is fundamentally allowed and meaningful." UBYTE B_TRUE 1 100 0.00 1.00000000000 BIT_MASK 0x1 FORMAT "%13.11" ECU_ADDRESS 0x6000A204 /end MEASUREMENT
/begin MEASUREMENT CoEng_flgFcoRdnEF_I.buffer "Fuel-cutoff readiness, falling edge / memory to detect falling edge" UBYTE B_TRUE 1 100 0.00 1.00000000000 BIT_MASK 0x1 FORMAT "%13.11" ECU_ADDRESS 0x60000CE6 /end MEASUREMENT
/begin MEASUREMENT CoEng_flgFcoRdnEF_I.oldSignal "Fuel-cutoff readiness, falling edge / memory to detect falling edge" UBYTE B_TRUE 1 100 0.00 1.00000000000 BIT_MASK 0x1 FORMAT "%13.11" ECU_ADDRESS 0x60000CE7 /end MEASUREMENT
/begin MEASUREMENT CoEng_flgFcoRelsEng "Release of fuel cutoff from engine" UBYTE B_TRUE 1 100 0.00 1.00000000000 BIT_MASK 0x1 FORMAT "%13.11" ECU_ADDRESS 0x60009C04 /end MEASUREMENT
/begin MEASUREMENT CoEng_flgFcoRelsVeh "Release of fuel cutoff from vehicle functions" UBYTE B_TRUE 1 100 0.00 1.00000000000 BIT_MASK 0x1 FORMAT "%13.11" ECU_ADDRESS 0x60009C03 /end MEASUREMENT
/begin MEASUREMENT CoEng_flgFcoTrsm "Condition fuel cut-off enabled" UBYTE B_TRUE 1 100 0.00 1.00000000000 BIT_MASK 0x1 FORMAT "%13.11" ECU_ADDRESS 0x6000A203 /end MEASUREMENT
/begin MEASUREMENT CoEng_flgNRstrtMinAbsFailr "ABS failure detected, restart speed limited to a minimum value" UBYTE B_TRUE 1 100 0.00 1.00000000000 BIT_MASK 0x1 FORMAT "%13.11" ECU_ADDRESS 0x60009C02 /end MEASUREMENT
/begin MEASUREMENT CoEng_flgRelsFco "Flag: overrun fuel cutoff is released." UBYTE B_TRUE 1 100 0.00 1.00000000000 BIT_MASK 0x1 FORMAT "%13.11" ECU_ADDRESS 0x6000A202 /end MEASUREMENT
/begin MEASUREMENT CoEng_flgTiDpdtOverrunHysRst "Overrun hysteresis reset flag" UBYTE B_TRUE 1 100 0.00 1.00000000000 BIT_MASK 0x1 FORMAT "%13.11" ECU_ADDRESS 0x60009C01 /end MEASUREMENT
/begin MEASUREMENT CoEng_nDeltaRstrtClimaTot "Increase of the restart speed due to AC compressor" UBYTE nmot_ub_q40 1 100 0.00 10200. FORMAT "%5.0" ECU_ADDRESS 0x70002D49 /end MEASUREMENT
/begin MEASUREMENT CoEng_nDeltaRstrtNGrdt "Increase of the restart speed due to high engine speed gradient" UBYTE nmot_ub_q40 1 100 0.00 10200. FORMAT "%5.0" ECU_ADDRESS 0x60009C00 /end MEASUREMENT
/begin MEASUREMENT CoEng_nFco "Engine speed for fuel cut-off." SWORD EngN 1 100 0.00 16383.50 FORMAT "%8.2" ECU_ADDRESS 0x6000E150 /end MEASUREMENT
/begin MEASUREMENT CoEng_nRstrt "engine speed for fuel cut-in" SWORD nmot_q0p5 1 100 0.00 16383.50 FORMAT "%8.2" ECU_ADDRESS 0x6000E152 /end MEASUREMENT
/begin MEASUREMENT CoEng_nRstrtBasc "Fundamental value of the fuel cut-in speed." SWORD EngN 1 100 -16384.00 16383.50 FORMAT "%8.2" ECU_ADDRESS 0x70002B68 /end MEASUREMENT
/begin MEASUREMENT CoEng_nRstrtBascTrsm "Fundamental value of the fuel cut-in speed from transmission" SWORD EngN 1 100 -16384.00 16383.50 FORMAT "%8.2" ECU_ADDRESS 0x60003F7E /end MEASUREMENT
/begin MEASUREMENT CoEng_numGearFcoLoc "Gear for the fuel-cutoff release" SBYTE OneToOne 1 100 -128.0 127.0 FORMAT "%5.1" ECU_ADDRESS 0x60009BFF /end MEASUREMENT
/begin MEASUREMENT Com_stRxSRSA "Status of SRSA Frame Reception" UBYTE OneToOne 1 100 0.00 255.0 FORMAT "%5.1" ECU_ADDRESS 0x6000A4AD /end MEASUREMENT
/begin MEASUREMENT Com_stRxSRSAChkSumOk "Status of Checksum Error of SRSA frame" UBYTE OneToOne 1 100 0.00 255.0 FORMAT "%5.1" ECU_ADDRESS 0x6000A4AC /end MEASUREMENT
/begin MEASUREMENT Com_stRxSRSADeb "Debounced Status of SRSA Frame Reception" UBYTE OneToOne 1 100 0.00 255.0 FORMAT "%5.1" ECU_ADDRESS 0x6000A4AB /end MEASUREMENT
/begin MEASUREMENT Com_stRxSRSAOk "Error Status of SRSA Frame Reception" UBYTE OneToOne 1 100 0.00 255.0 FORMAT "%5.1" ECU_ADDRESS 0x6000A4AA /end MEASUREMENT
/begin MEASUREMENT Com_stRxSRSARingCntOk "Ring Counter Error Status of SRSA Frame" UBYTE OneToOne 1 100 0.00 255.0 FORMAT "%5.1" ECU_ADDRESS 0x6000A4A9 /end MEASUREMENT
/begin MEASUREMENT Com_stSRSActvDlyd "SRS Active after delay status" UBYTE OneToOne 1 100 0.00 255.0 FORMAT "%5.1" ECU_ADDRESS 0x6000A4A7 /end MEASUREMENT
/begin MEASUREMENT CoPOM_bCtOffDem "Cut-Off demand" UBYTE B_TRUE 1 100 0.00 1.00000000000 BIT_MASK 0x1 FORMAT "%13.11" ECU_ADDRESS 0x6000A1F1 /end MEASUREMENT
/begin MEASUREMENT dnsavg "Delta engine speed from velocity and gear" SWORD nmot_q0p5 1 100 0.00 16383.50 FORMAT "%8.2" ECU_ADDRESS 0x60003F7C /end MEASUREMENT
/begin MEASUREMENT dnsavt "Delta engine speed from velocity and engine temperature" SWORD nmot_q0p5 1 100 0.00 16383.50 FORMAT "%8.2" ECU_ADDRESS 0x60003F7A /end MEASUREMENT
/begin MEASUREMENT dnsa_w "time depending overrun hysteresis" SWORD nmot_q0p5 1 100 0.00 16383.50 FORMAT "%8.2" ECU_ADDRESS 0x60003F78 /end MEASUREMENT
/begin MEASUREMENT dyespfv "Knock control: current value of load dynamic detection threshold" SBYTE p_q10 1 100 -1280. 1270. FORMAT "%5.0" ECU_ADDRESS 0x60009C0C /end MEASUREMENT
/begin MEASUREMENT dyespof "Actual offset value for load dynamics detection threshold" SBYTE p_q10 1 100 -1280. 1270. FORMAT "%5.0" ECU_ADDRESS 0x60009C0B /end MEASUREMENT
/begin MEASUREMENT EngStrt_cntrAftStrtDly "Counter to delay in stopping afterstart adaptation" UBYTE OneToOne 1 100 0.00 255.0 FORMAT "%5.1" ECU_ADDRESS 0x50000849 /end MEASUREMENT
/begin MEASUREMENT EngStrt_ctDrvEntrBBSTNSAD100ms "Local variable to store the global drive enter counter(SyC_ctDrvEnter)" UBYTE OneToOne 1 100 0.00 255.0 FORMAT "%5.1" ECU_ADDRESS 0x6000E39F /end MEASUREMENT
/begin MEASUREMENT EngStrt_ctDrvEntrBBSTNSAD20ms "Local variable to store the global drive enter counter(SyC_ctDrvEnter)" UBYTE OneToOne 1 100 0.00 255.0 FORMAT "%5.1" ECU_ADDRESS 0x60009BFB /end MEASUREMENT
/begin MEASUREMENT EngStrt_ctDrvEntrBBSTNSADSyncS0 "Local variable to store the global drive enter counter(SyC_ctDrvEnter)" UBYTE OneToOne 1 100 0.00 255.0 FORMAT "%5.1" ECU_ADDRESS 0x5000084A /end MEASUREMENT
/begin MEASUREMENT EngStrt_flgAftStopInhb "Flag to inhibit stopping of afterstart adaptation" UBYTE B_TRUE 1 100 0.00 1.00000000000 BIT_MASK 0x1 FORMAT "%13.11" ECU_ADDRESS 0x70000368 /end MEASUREMENT
/begin MEASUREMENT EngStrt_flgAftStopInhbHld "Flag to Hold the inhibition condition for stopping afterstart adaptation" UBYTE B_TRUE 1 100 0.00 1.00000000000 BIT_MASK 0x1 FORMAT "%13.11" ECU_ADDRESS 0x70000367 /end MEASUREMENT
/begin MEASUREMENT ESS_uBatt "Application parameter for Battery voltage" SWORD Volt_Batt 1 100 -655360.0 655340.0 FORMAT "%8.1" ECU_ADDRESS 0x600050E0 /end MEASUREMENT
/begin MEASUREMENT evz_ausold "injection cut off pattern total at time t-1" UBYTE dez 1 100 0.00 255.0 FORMAT "%5.1" ECU_ADDRESS 0x60009BF4 /end MEASUREMENT
/begin MEASUREMENT ExhMgT_facCamsftCatHeatg "correction of weighting factor for camshaft nominal angle by catalyst heating in case of a repeated start of combustion engine" UBYTE fak_ub_b2 1 100 0.00 1.000000 FORMAT "%8.6" ECU_ADDRESS 0x60009C15 /end MEASUREMENT
/begin MEASUREMENT ExhMgT_facCatHeatgIntkCamsft "correction factor for ramping up the intake camshaft measure during catalyst heating" UBYTE fak_ub_b2 1 100 0.00 1.000000 FORMAT "%8.6" ECU_ADDRESS 0x60009C14 /end MEASUREMENT
/begin MEASUREMENT ExhMgT_facCatHeatgOutlCamsft "correction factor for ramping up the outlet camshaft measure during catalyst heating" UBYTE fak_ub_b2 1 100 0.00 1.000000 FORMAT "%8.6" ECU_ADDRESS 0x60009C13 /end MEASUREMENT
/begin MEASUREMENT ExhMgT_facLamCatHeatgRamp "correction factor in dependence on the integrated air mass for the lambda control factor in case of a cold start" UBYTE fak_ub_b1 1 100 0.00 0.9961 ECU_ADDRESS 0x60009C12 /end MEASUREMENT
/begin MEASUREMENT ExhMgT_facLamCtrl "weighting factor for control lambda" UBYTE fak_ub_b1 1 100 0.00 0.9961 ECU_ADDRESS 0x60009C11 /end MEASUREMENT
/begin MEASUREMENT ExhMgT_facLamCtrlCatHeatg "weighting factor for control lambda during cold start" UBYTE fak_ub_b1 1 100 0.00 0.9961 ECU_ADDRESS 0x60009C10 /end MEASUREMENT
/begin MEASUREMENT ExhMgT_facLamCtrlCatWrm "weighting factor for control lambda during catalyst warming" UBYTE fak_ub_b1 1 100 0.00 0.9961 ECU_ADDRESS 0x60009C0F /end MEASUREMENT
/begin MEASUREMENT ExhMgT_facRatLamCatHeatg "correction of factor control lambda by catalyst heating in case of a repeated start of combustion engine" UBYTE fak_ub_b2 1 100 0.00 1.000000 FORMAT "%8.6" ECU_ADDRESS 0x60009C0E /end MEASUREMENT
/begin MEASUREMENT ExhMgT_mfExhCat1B1Dif "Gradient of the exhaust mass flow catalyst 1 bank 1" UWORD m_uw_b6553p5 1 100 0.00 6553.500 FORMAT "%8.3" ECU_ADDRESS 0x60003F90 /end MEASUREMENT
/begin MEASUREMENT ExhMgT_mfExhCat1B1Fild "Exhaust mass flow catalyst 1 bank 1" UWORD m_uw_b6553p5 1 100 0.00 6553.500 FORMAT "%8.3" ECU_ADDRESS 0x60003F8E /end MEASUREMENT
/begin MEASUREMENT ExhMgT_mfExhCat1B1Loc "Exhaust mass flow catalyst 1 bank 1" UWORD m_uw_b6553p5 1 100 0.00 6553.500 FORMAT "%8.3" ECU_ADDRESS 0x60003F8C /end MEASUREMENT
/begin MEASUREMENT ExhMgT_tCatHeatgTCatSelnActnDif "Gradient of the catalyst temperature" UWORD temp_q0p1_K 1 100 0.00 6553.500 FORMAT "%8.3" ECU_ADDRESS 0x60003F8A /end MEASUREMENT
/begin MEASUREMENT ExhMgT_tCatHeatgTCatSelnFild "Filtered catalyst temperature" SWORD temp_q0p1_K 1 100 -3276.800 3276.700 FORMAT "%8.3" ECU_ADDRESS 0x60003F88 /end MEASUREMENT
/begin MEASUREMENT ExhMgT_tCatSelnActnLoc "Catalyst temperature" SWORD temp_q0p1_K 1 100 -3276.800 3276.700 FORMAT "%8.3" ECU_ADDRESS 0x60003F86 /end MEASUREMENT
/begin MEASUREMENT flakh_msg "Factor control lambda at catalyst heating" UBYTE fak_ub_b1 1 100 0.00 0.9961 ECU_ADDRESS 0x60009FF8 /end MEASUREMENT
/begin MEASUREMENT flbkkh_msg "Factor swirl-control valve request at catalyst heating" UBYTE fak_ub_b1 1 100 0.00 0.9961 ECU_ADDRESS 0x6000E44D /end MEASUREMENT
/begin MEASUREMENT fnwkha_msg "weighting factor for nominal angle by catalyst heating (outlet)" UBYTE fak_ub_b2 1 100 0.00 1.000000 FORMAT "%8.6" ECU_ADDRESS 0x6000E44F /end MEASUREMENT
/begin MEASUREMENT fnwkhe_msg "weighting factor for nominal angle of intake camshaft during catalyst heating" UBYTE fak_ub_b2 1 100 0.00 1.000000 FORMAT "%8.6" ECU_ADDRESS 0x6000E450 /end MEASUREMENT
/begin MEASUREMENT fnwkhnga_msg "weighting factor for nominal angle by catalyst heating in Compressed natural gas mode (outlet)" UBYTE fak_ub_b2 1 100 0.00 1.992188 FORMAT "%8.6" ECU_ADDRESS 0x6000E451 /end MEASUREMENT
/begin MEASUREMENT fnwkhnge_msg "weighting factor for nominal angle of intake camshaft during catalyst heating in Compressed natural gas mode" UBYTE fak_ub_b2 1 100 0.00 1.992188 FORMAT "%8.6" ECU_ADDRESS 0x6000E452 /end MEASUREMENT
/begin MEASUREMENT fvapskstaa "Enrichment factor kstaa or fuelvaps_w afterstart adaptation" UBYTE fak_ub_b2 1 100 0.00 1.992188 FORMAT "%8.6" ECU_ADDRESS 0x6000073C /end MEASUREMENT
/begin MEASUREMENT IKCtl_cntrVVlvLftDynDetn "counter for variable valve lift dynamic" UBYTE t_q0p01 1 100 0.00 2.550 FORMAT "%5.3" ECU_ADDRESS 0x60009C0D /end MEASUREMENT
/begin MEASUREMENT IKCtl_ctReIni10msBBKR "Local counter in BBKR to hold number of postdrive exit to track Syc postdrive leave" UBYTE dez 1 100 0.00 255.0 FORMAT "%5.1" ECU_ADDRESS 0x600006F6 /end MEASUREMENT
/begin MEASUREMENT IKCtl_dnFildGrdt_s16 "KC: engine speed gradient during one working cycle (filtered value)" SWORD EngNGrd 1 100 -16384.00 16383.50 FORMAT "%8.2" ECU_ADDRESS 0x70002C66 /end MEASUREMENT
/begin MEASUREMENT IKCtl_flgAdpnEna "condition for active knock control adaptation" UBYTE B_TRUE 1 100 0.00 1.00000000000 BIT_MASK 0x1 FORMAT "%13.11" ECU_ADDRESS 0x7000074F /end MEASUREMENT
/begin MEASUREMENT IKCtl_flgAdpnLrnEna "condition enable stationary adaptation" UBYTE B_TRUE 1 100 0.00 1.00000000000 BIT_MASK 0x1 FORMAT "%13.11" ECU_ADDRESS 0x7000074E /end MEASUREMENT
/begin MEASUREMENT IKCtl_flgAdpnWrEna "condition to read knock ignition retardation from knock control adaption map" UBYTE B_TRUE 1 100 0.00 1.00000000000 BIT_MASK 0x1 FORMAT "%13.11" ECU_ADDRESS 0x7000074D /end MEASUREMENT
/begin MEASUREMENT IKCtl_flgDiagEna "condition enable knock sensor diagnosis" UBYTE B_TRUE 1 100 0.00 1.00000000000 BIT_MASK 0x1 FORMAT "%13.11" ECU_ADDRESS 0x70000749 /end MEASUREMENT
/begin MEASUREMENT IKCtl_flgDynAdpnEna "knock control: dynamic adaptation enable" UBYTE B_TRUE 1 100 0.00 1.00000000000 BIT_MASK 0x1 FORMAT "%13.11" ECU_ADDRESS 0x70000748 /end MEASUREMENT
/begin MEASUREMENT IKCtl_flgDynAdpnRead "condition entering load dynamics adaptation" UBYTE B_TRUE 1 100 0.00 1.00000000000 BIT_MASK 0x1 FORMAT "%13.11" ECU_ADDRESS 0x70000747 /end MEASUREMENT
/begin MEASUREMENT IKCtl_flgFastAdvIa "flag: fast ignition advance knock control" UBYTE B_TRUE 1 100 0.00 1.00000000000 BIT_MASK 0x1 FORMAT "%13.11" ECU_ADDRESS 0x70000746 /end MEASUREMENT
/begin MEASUREMENT IKCtl_flgGdCyl "Filled cylinder" UBYTE B_TRUE 1 100 0.00 1.00000000000 BIT_MASK 0x1 FORMAT "%13.11" ECU_ADDRESS 0x70000744 /end MEASUREMENT
/begin MEASUREMENT IKCtl_flgInjD "injection valve of current cylinder switched off" UBYTE B_TRUE 1 100 0.00 1.00000000000 BIT_MASK 0x1 FORMAT "%13.11" ECU_ADDRESS 0x70000743 /end MEASUREMENT
/begin MEASUREMENT IKCtl_flgKnkEna "Condition for knock control active" UBYTE B_TRUE 1 100 0.00 1.00000000000 BIT_MASK 0x1 FORMAT "%13.11" ECU_ADDRESS 0x70000741 /end MEASUREMENT
/begin MEASUREMENT IKCtl_flgKnkLimp "emergency operation of knock detection for emergency operation of phase sensor" UBYTE B_TRUE 1 100 0.00 1.00000000000 BIT_MASK 0x1 FORMAT "%13.11" ECU_ADDRESS 0x70000740 /end MEASUREMENT
/begin MEASUREMENT IKCtl_flgKnkLoc "Condition for knock control active bevor time delay" UBYTE B_TRUE 1 100 0.00 1.00000000000 BIT_MASK 0x1 FORMAT "%13.11" ECU_ADDRESS 0x70000379 /end MEASUREMENT
/begin MEASUREMENT IKCtl_flgLoadDynAdpn "Condition load dynamics retard and dynamics adaptation active" UBYTE B_TRUE 1 100 0.00 1.00000000000 BIT_MASK 0x1 FORMAT "%13.11" ECU_ADDRESS 0x7000073F /end MEASUREMENT
/begin MEASUREMENT IKCtl_flgLoadDynAdpnAdv "condition adaptation load dynamics retard towards advance released" UBYTE B_TRUE 1 100 0.00 1.00000000000 BIT_MASK 0x1 FORMAT "%13.11" ECU_ADDRESS 0x7000073E /end MEASUREMENT
/begin MEASUREMENT IKCtl_flgLoadDynAdpnTmp "Condition load dynamics retard and dynamics adaptation active" UBYTE B_TRUE 1 100 0.00 1.00000000000 BIT_MASK 0x1 FORMAT "%13.11" ECU_ADDRESS 0x70000378 /end MEASUREMENT
/begin MEASUREMENT IKCtl_flgLoadDynCtrlEna "condition threshold for additional load dynamics retard exceeded" UBYTE B_TRUE 1 100 0.00 1.00000000000 BIT_MASK 0x1 FORMAT "%13.11" ECU_ADDRESS 0x7000073D /end MEASUREMENT
/begin MEASUREMENT IKCtl_flgLoadDynDetn "Condition load dynamics for knock detection active" UBYTE B_TRUE 1 100 0.00 1.00000000000 BIT_MASK 0x1 FORMAT "%13.11" ECU_ADDRESS 0x7000073C /end MEASUREMENT
/begin MEASUREMENT IKCtl_flgRtdtUse "condition ignition angle of the knock control is given" UBYTE B_TRUE 1 100 0.00 1.00000000000 BIT_MASK 0x1 FORMAT "%13.11" ECU_ADDRESS 0x7000073B /end MEASUREMENT
/begin MEASUREMENT IKCtl_flgSftyRtdt "Knock control safety ignition retarding" UBYTE B_TRUE 1 100 0.00 1.00000000000 BIT_MASK 0x1 FORMAT "%13.11" ECU_ADDRESS 0x7000073A /end MEASUREMENT
/begin MEASUREMENT IKCtl_flgSftyRtdtReq "request saftey ignition retardation" UBYTE B_TRUE 1 100 0.00 1.00000000000 BIT_MASK 0x1 FORMAT "%13.11" ECU_ADDRESS 0x70000377 /end MEASUREMENT
/begin MEASUREMENT IKCtl_flgSftyRtdtTmp "knock control saftey ignition retardation temporary variable" UBYTE B_TRUE 1 100 0.00 1.00000000000 BIT_MASK 0x1 FORMAT "%13.11" ECU_ADDRESS 0x70000376 /end MEASUREMENT
/begin MEASUREMENT IKCtl_flgSpdDynDetn "condition speed dynamics for knock detection active" UBYTE B_TRUE 1 100 0.00 1.00000000000 BIT_MASK 0x1 FORMAT "%13.11" ECU_ADDRESS 0x70000738 /end MEASUREMENT
/begin MEASUREMENT IKCtl_flgTEna "Condition temperature for knock control achieved" UBYTE B_TRUE 1 100 0.00 1.00000000000 BIT_MASK 0x1 FORMAT "%13.11" ECU_ADDRESS 0x70000737 /end MEASUREMENT
/begin MEASUREMENT IKCtl_flgTipinDetn "Tip-in detected" UBYTE B_TRUE 1 100 0.00 1.00000000000 BIT_MASK 0x1 FORMAT "%13.11" ECU_ADDRESS 0x70000736 /end MEASUREMENT
/begin MEASUREMENT IKCtl_idxAdpn_u16 "index for knock control stationary adaptation map" UWORD dez 1 100 0.00 65535.00 FORMAT "%8.2" ECU_ADDRESS 0x500006EA /end MEASUREMENT
/begin MEASUREMENT IKCtl_idxSpdAdpn_u8 "speed range adaption map knock control" UBYTE dez 1 100 0.00 255.0 FORMAT "%5.1" ECU_ADDRESS 0x60000789 /end MEASUREMENT
/begin MEASUREMENT IKCtl_ofsDesLoadDynThd_u16 "offset, threshold for filtered gradient of the desired air-charge" UWORD rel_uw_q0p0234 1 100 0.00 1535.977 FORMAT "%8.3" ECU_ADDRESS 0x6000D920 /end MEASUREMENT
/begin MEASUREMENT IKCtl_pPfiSp "Knock control: filtered gradient of the desired manifold pressure" SBYTE p_q10 1 100 -1280. 1270. FORMAT "%5.0" ECU_ADDRESS 0x5000088E /end MEASUREMENT
/begin MEASUREMENT IKCtl_ratAirLoadThdFastAdvIa "upper load threshold for fast igniton angle advancing" UWORD rel_uw_q0p0234 1 100 0.00 1535.977 FORMAT "%8.3" ECU_ADDRESS 0x6000D922 /end MEASUREMENT
/begin MEASUREMENT IKCtl_ratCurrLoadDynDetnThd "Current value of load dynamic detection threshold" UWORD rel_uw_q0p0234 1 100 0.00 1535.977 FORMAT "%8.3" ECU_ADDRESS 0x60003F84 /end MEASUREMENT
/begin MEASUREMENT IKCtl_ratFilGrdtDesAirChrg_u16 "Filtered-gradient of the desired air-charge" SWORD rel_uw_q0p0234 1 100 -768.0000 767.9766 FORMAT "%8.4" ECU_ADDRESS 0x70001D90 /end MEASUREMENT
/begin MEASUREMENT IKCtl_ratLoadDynDetnThd_u16 "Threshold for filtered gradient of the desired air-charge" UWORD rel_uw_q0p0234 1 100 0.00 1535.977 FORMAT "%8.3" ECU_ADDRESS 0x60003F82 /end MEASUREMENT
/begin MEASUREMENT IKCtl_ratLoadRngAdpn1 "Knock control: current value load adaptation range 1" UWORD rel_uw_q0p0234 1 100 0.00 1535.977 FORMAT "%8.3" ECU_ADDRESS 0x6000D924 /end MEASUREMENT
/begin MEASUREMENT IKCtl_ratLoadRngAdpn2 "Knock control: current value load adaptation range 2" UWORD rel_uw_q0p0234 1 100 0.00 1535.977 FORMAT "%8.3" ECU_ADDRESS 0x6000D926 /end MEASUREMENT
/begin MEASUREMENT IKCtl_ratLoadRngAdpn3 "Knock control: current value load adaptation range 3" UWORD rel_uw_q0p0234 1 100 0.00 1535.977 FORMAT "%8.3" ECU_ADDRESS 0x6000D928 /end MEASUREMENT
/begin MEASUREMENT IKCtl_ratLoadThd "current value of load threshold knock control in homogeneous operation" UWORD rel_uw_q0p0234 1 100 0.00 1535.977 FORMAT "%8.3" ECU_ADDRESS 0x6000D92A /end MEASUREMENT
/begin MEASUREMENT IKCtl_ratOffsLoadDynDetnThd "Actual offset value for load dynamics detection threshold" UWORD rel_uw_q0p0234 1 100 0.00 1535.977 FORMAT "%8.3" ECU_ADDRESS 0x6000D92C /end MEASUREMENT
/begin MEASUREMENT IKCtl_ratRelAirChrg "Filtered gradient of the relative air-charge in the cylinder" UWORD rel_uw_q0p0234 1 100 0.00 1535.977 FORMAT "%8.3" ECU_ADDRESS 0x70001CEE /end MEASUREMENT
/begin MEASUREMENT IKCtl_stInjDTot_b8 "knock control: copy of mask injection cut off pattern total" UBYTE dez 1 100 0.00 255.0 FORMAT "%5.1" ECU_ADDRESS 0x6000A03B /end MEASUREMENT
/begin MEASUREMENT IKCtl_stSnsrErr_u8 "knock control: state knock sensor/line error" UBYTE dez 1 100 0.00 255.0 FORMAT "%5.1" ECU_ADDRESS 0x6000A039 /end MEASUREMENT
/begin MEASUREMENT IKCtl_tEna "temperature used for knock control" SWORD Temp_Cels 1 100 -3549.940 3003.560 FORMAT "%8.3" ECU_ADDRESS 0x60003F80 /end MEASUREMENT
/begin MEASUREMENT IKCtl_tiVVlvLftDynDetn "actual value of characteristic IKCtl_tiVVlvLftDynDetn_GT" UBYTE t_q0p01 1 100 0.00 2.550 FORMAT "%5.3" ECU_ADDRESS 0x60009C0A /end MEASUREMENT
/begin MEASUREMENT IKCtl_tmpReIniBBKR "Local variable in BBKR to re-initialise the ASCET classes with no memory when entering drive from postdrive" UBYTE B_TRUE 1 100 0.00 1.00000000000 BIT_MASK 0x1 FORMAT "%13.11" ECU_ADDRESS 0x70000375 /end MEASUREMENT
/begin MEASUREMENT InjSys_bInjVlvActv "Condition all injection valves active" UBYTE B_TRUE 1 100 0.00 1.00000000000 BIT_MASK 0x1 FORMAT "%13.11" ECU_ADDRESS 0x70000734 /end MEASUREMENT
/begin MEASUREMENT InjSys_flgFcoBnk "Condition total fuel cut-off in BankBank1" UBYTE B_TRUE 1 100 0.00 1.00000000000 BIT_MASK 0x1 FORMAT "%13.11" ECU_ADDRESS 0x70000730 /end MEASUREMENT
/begin MEASUREMENT InjSys_flgFuEngOperActv "Fueled engine operation active" UBYTE B_TRUE 1 100 0.00 1.00000000000 BIT_MASK 0x1 FORMAT "%13.11" ECU_ADDRESS 0x7000072F /end MEASUREMENT
/begin MEASUREMENT InjSys_stActRedStg "Real cylinder cut-off step" UBYTE dez 1 100 0.00 255.0 FORMAT "%5.1" ECU_ADDRESS 0x50005D8C /end MEASUREMENT
/begin MEASUREMENT krdydlyd_l "Knock control: buffer for delayed exceed dynamic load threshold." ULONG dez 1 100 0.00 4294967295.00 FORMAT "%13.2" ECU_ADDRESS 0x60000328 /end MEASUREMENT
/begin MEASUREMENT krdyndelay "IKC: current delay for the dynamic signals" UBYTE dez 1 100 0.00 31.00 FORMAT "%5.2" ECU_ADDRESS 0x60000741 /end MEASUREMENT
/begin MEASUREMENT krdyofdd_l "Knock control: buffer for delayed exceed dynamic load offset." ULONG dez 1 100 0.00 4294967295.00 FORMAT "%13.2" ECU_ADDRESS 0x6000032C /end MEASUREMENT
/begin MEASUREMENT lamfaw_w "required lambda, driver request part of map LAMFA" UWORD fak_uw_b16 1 100 0.00 15.99976 FORMAT "%8.5" ECU_ADDRESS 0x60003F60 /end MEASUREMENT
/begin MEASUREMENT lamfa_w_msg "required lambda, driver request" UWORD fak_uw_b16 1 100 0.00 15.99976 FORMAT "%8.5" ECU_ADDRESS 0x60004822 /end MEASUREMENT
/begin MEASUREMENT LAS_a "Longitudinal Acceleration" SWORD Acc 1 100 -32.76800 32.76700 FORMAT "%8.5" ECU_ADDRESS 0x60005014 /end MEASUREMENT
/begin MEASUREMENT msbkvsr_w_msg "Modeled extra air from brake booster" UWORD m_q0p1 1 100 0.00 6553.500 FORMAT "%8.3" ECU_ADDRESS 0x60003F62 /end MEASUREMENT
/begin MEASUREMENT ngkrv "Knock control: instantaneous value of threshold speed dynamics" SBYTE nmotg_sb_q100 1 100 -12800. 12700. FORMAT "%5.0" ECU_ADDRESS 0x60009C09 /end MEASUREMENT
/begin MEASUREMENT nwecvt "engine speed fuel restart at CVT" SWORD nmot_q0p5 1 100 0.00 16383.50 FORMAT "%8.2" ECU_ADDRESS 0x60003F76 /end MEASUREMENT
/begin MEASUREMENT nwema "engine speed fuel restart" SWORD nmot_q0p5 1 100 0.00 16383.50 FORMAT "%8.2" ECU_ADDRESS 0x60003F74 /end MEASUREMENT
/begin MEASUREMENT nwemas "engine speed fuel restart - converter in slip mode" SWORD nmot_q0p5 1 100 0.00 16383.50 FORMAT "%8.2" ECU_ADDRESS 0x60003F72 /end MEASUREMENT
/begin MEASUREMENT redistb1_msg "Real cut off step bank 1" UBYTE dez 1 100 0.00 126.0 FORMAT "%5.1" ECU_ADDRESS 0x6000A28A /end MEASUREMENT
/begin MEASUREMENT redist_msg "real cylinder cut-off step" UBYTE dez 1 100 0.00 255.0 FORMAT "%5.1" ECU_ADDRESS 0x6000A28B /end MEASUREMENT
/begin MEASUREMENT sdlutact_w "Threshold desired value standard deviation engine roughness corrected" SWORD lu_MEx 1 100 -232.8306 232.8235 FORMAT "%8.4" ECU_ADDRESS 0x60000494 /end MEASUREMENT
/begin MEASUREMENT stkrlx "load range adaption map KC" UBYTE dez 1 100 0.00 255.0 FORMAT "%5.1" ECU_ADDRESS 0x60000746 /end MEASUREMENT
/begin MEASUREMENT TAS_a "Output value of Transversal Acceleration" SWORD AccGrv 1 100 -327.6800 327.6700 FORMAT "%8.4" ECU_ADDRESS 0x60004F04 /end MEASUREMENT
/begin MEASUREMENT tbhsw "threshold for blockheater-detection" UBYTE temp_ub_q0p75_o48 1 100 -48.0 143.3 FORMAT "%5.1" ECU_ADDRESS 0x60009BF7 /end MEASUREMENT
/begin MEASUREMENT tkattmp "Catalyst temperature" SWORD temp_q0p1_o273 1 100 -3549.940 3003.560 FORMAT "%8.3" ECU_ADDRESS 0x60003F70 /end MEASUREMENT
/begin MEASUREMENT TMECmb_IfEtaIaGnrl_I.HSPActv "general combustion dataset next ignition calculation / Combustion dataset: condition GDI-operating mode for actual ignition cylinder is homogeneous-split" UBYTE dez 1 100 0.00 255.0 FORMAT "%5.1" ECU_ADDRESS 0x70001A7C /end MEASUREMENT
/begin MEASUREMENT TMECmb_IfEtaIaGnrl_I.f2kazw "general combustion dataset next ignition calculation / combustion data set" UBYTE fak_ub_b1 1 100 0.00 0.9961 ECU_ADDRESS 0x70001A7D /end MEASUREMENT
/begin MEASUREMENT TMECmb_IfEtaIaGnrl_I.flb "general combustion dataset next ignition calculation / Combustion dataset: Factor charge-movement" UBYTE fak_ub_b1 1 100 0.00 0.9961 ECU_ADDRESS 0x70001A7E /end MEASUREMENT
/begin MEASUREMENT TMECmb_IfEtaIaGnrl_I.lamsbg "general combustion dataset next ignition calculation / lambda input for interface class" UWORD fak_uw_b16 1 100 0.00 15.99976 FORMAT "%8.5" ECU_ADDRESS 0x70001A80 /end MEASUREMENT
/begin MEASUREMENT TMECmb_IfEtaIaGnrl_I.nEng "general combustion dataset next ignition calculation / Combustion dataset: Average engine speed of one cylinder segment" UWORD nmot_uw_q0p25 1 100 0.00 16383.75 FORMAT "%8.2" ECU_ADDRESS 0x70001A82 /end MEASUREMENT
/begin MEASUREMENT TMECmb_IfEtaIaGnrl_I.rl "general combustion dataset next ignition calculation / Combustion dataset: Relative air charge" UWORD rel_uw_q0p0234 1 100 0.00 1535.977 FORMAT "%8.3" ECU_ADDRESS 0x70001A84 /end MEASUREMENT
/begin MEASUREMENT TMECmb_IfEtaIaGnrl_I.rri "general combustion dataset next ignition calculation / inert gas rate input for interface class" UWORD rel_uw_b100 1 100 0.00 99.99847 FORMAT "%8.5" ECU_ADDRESS 0x70001A86 /end MEASUREMENT
/begin MEASUREMENT TMECmb_IfEtaIaGnrl_I.split2ka "general combustion dataset next ignition calculation / Combustion dataset: Factor for splitting CNG and Gasoline" UWORD fak_uw_b2 1 100 0.00 1.000000 FORMAT "%8.6" ECU_ADDRESS 0x70001A88 /end MEASUREMENT
/begin MEASUREMENT tmmxbh "interim signal for blockheater-detection" UBYTE temp_ub_q0p75_o48 1 100 -48.0 143.3 FORMAT "%5.1" ECU_ADDRESS 0x60009BF6 /end MEASUREMENT
/begin MEASUREMENT tmotbstnsd "local copy of engine temperature in %BBSTNSAD (either tmot or CHdT_t)" UBYTE temp_q0p75_om48 1 100 -48.0 143.3 FORMAT "%5.1" ECU_ADDRESS 0x50005D2E /end MEASUREMENT
/begin MEASUREMENT tmstbstnsd "temperature of engine after checking CHDT_SY > 0." UBYTE temp_q0p75_om48 1 100 -48.0 143.3 FORMAT "%5.1" ECU_ADDRESS 0x60009BF9 /end MEASUREMENT
/begin MEASUREMENT tofmsndkpcg_w "duration of ofmsndkp_w adaptation for calcuation of virtual cylce flaf for IUMPR for LZSR (big leakage)" UWORD t_q0p2 1 100 0.00 13107.00 FORMAT "%8.2" ECU_ADDRESS 0x60000CE4 /end MEASUREMENT
/begin MEASUREMENT tofmsndkp_w "duration of ofmsndkp_w adaptation for calcuation of virtual cylce flaf for IUMPR for LZSR" UWORD t_q0p2 1 100 0.00 13107.00 FORMAT "%8.2" ECU_ADDRESS 0x60000CE2 /end MEASUREMENT
/begin MEASUREMENT tvsaa "delay fuel cut-off" UBYTE t_q0p01 1 100 0.00 2.550 FORMAT "%5.3" ECU_ADDRESS 0x60009BFE /end MEASUREMENT
/begin MEASUREMENT tvsab_w "delay time fuel cut-off requested" UWORD t_q0p01 1 100 0.00 655.3500 FORMAT "%8.4" ECU_ADDRESS 0x60003F6C /end MEASUREMENT
/begin MEASUREMENT tvsab_w_msg "Delay time fuel cut-off requested." UWORD t_q0p01 1 100 0.00 655.3500 FORMAT "%8.4" ECU_ADDRESS 0x70002D12 /end MEASUREMENT
/begin MEASUREMENT tvsag_w "delay time fuel cutoff depend on gear step" UWORD t_q0p01 1 100 0.00 655.3500 FORMAT "%8.4" ECU_ADDRESS 0x60003F6E /end MEASUREMENT
/begin MEASUREMENT tvsakat "delay time for fuel cut-off at high speed and at high catalyst temperature" UBYTE t_q0p04 1 100 0.00 10.20 FORMAT "%5.2" ECU_ADDRESS 0x60009BFD /end MEASUREMENT
/begin MEASUREMENT tvsavg "Delay time for fuel-cutoff during gearshift" UBYTE t_q0p04 1 100 0.00 10.20 FORMAT "%5.2" ECU_ADDRESS 0x60009BFC /end MEASUREMENT
/begin MEASUREMENT zaeldy "Knock control: counter for dynamic adaption" UBYTE t_q0p01 1 100 0.00 2.550 FORMAT "%5.3" ECU_ADDRESS 0x6000074B /end MEASUREMENT
/begin MEASUREMENT zaeldyke "Knock control: counter for load dynamic" UBYTE t_q0p01 1 100 0.00 2.550 FORMAT "%5.3" ECU_ADDRESS 0x6000074C /end MEASUREMENT
/begin MEASUREMENT zaendy "Knock control: counter for engine speed dynamic" UBYTE t_q0p01 1 100 0.00 2.550 FORMAT "%5.3" ECU_ADDRESS 0x6000074D /end MEASUREMENT
/begin MEASUREMENT zubkst "counter: Ub < UBKST" UBYTE dez 1 100 0.00 255.0 FORMAT "%5.1" ECU_ADDRESS 0x60009BFA /end MEASUREMENT
/begin MEASUREMENT zylzg "corresponds to the product of Real number of cylinders and Number of ECUs in a multiple ECU system" UBYTE dez 1 100 0.00 255.0 FORMAT "%5.1" ECU_ADDRESS 0x70001A8A /end MEASUREMENT
/begin FUNCTION Batt_DataAcq "22.21.0   Battery"
 /begin DEF_CHARACTERISTIC Batt_chStopEnaThres_C Batt_chStrtReqThres_C Batt_cntrOCVThd_C Batt_facHiChrgnEff_T Batt_facLoChrgnEff_T Batt_facSOCStdy_C Batt_flgDarkIAllw_C Batt_flgSt5ChrgModDi_C Batt_flgSwtBattSeln_C Batt_iChrgnThdDelta_C Batt_iChrgnThd_M Batt_iOCVDchaThd_C Batt_iOCVDetnThd_C Batt_iOCVThd_C Batt_qAdjCnsChk_C Batt_qBliChrgLim_C Batt_qCap20_C Batt_qChgCap20_C Batt_qDeltaDchaCmpl_C Batt_qDodLimHi_C Batt_qDodLimLo_C Batt_qDodStopEnaLim_C Batt_qDodStrtReqLim_C Batt_qNrm1_C Batt_qNrm2_C Batt_qSumHiRcv_C Batt_qSumHiThd_C Batt_qSumLoLimThd_C Batt_qSumLoLmt_C Batt_qSumLoRcv_C Batt_qSumLoThd_C Batt_qSumRCThd1_C Batt_qSumRCThd2_C Batt_qSumSOCRawThd_C Batt_qSumSOCThd_C Batt_qTotDChaCmpl_C Batt_ratAcptdLowSoc_C Batt_ratLowSocChrgFinsh_C Batt_ratSocTgt_C Batt_ratSocThdStopEna_C Batt_ratSoh4SofLim_C Batt_ratSohStopEnaLim_C Batt_ratSohThres_C Batt_rDarkIAllwCondBThdHi_C Batt_rDarkIAllwCondBThdLo_C Batt_rDarkIThdCondAHi_C Batt_rDarkIThdCondALo_C Batt_SofCorrn_T Batt_stLoSocDetn_C Batt_stSigSeln_C Batt_stSocErrSel_C Batt_stSocRlbtJdg_C Batt_stStartErrMsk_C Batt_stStopErrMsk_C Batt_swtDataSrcSel_C Batt_tBattStopEnaHiLim_C Batt_tBattStopEnaLim_C Batt_tBattStrtReqLim_C Batt_tBattThres_C Batt_tiBattCodChgID1_C Batt_tiBattCodChgID2_C Batt_tiChrgnIThd_C Batt_tiCum1_C Batt_tiCum2_C Batt_tiCurrThd_C Batt_tiDchaThd_C Batt_tiOCVDetnThd_C Batt_tiOCVVoltThd_C Batt_tiStopDurMin_C Batt_uChrgThd_C Batt_uOCVDchaThd_C Batt_uOCVDetnThd_T Batt_uOCVLimThd_C Batt_uSofStopEnaLim_C Batt_uSofStrtReqLim_C Batt_uSofThres_C IBSUMH.Batt_qSumHiLim_C IBSUMHNR.Batt_qSumHiNRLim_C IBSUML.Batt_qSumLoLim_C /end DEF_CHARACTERISTIC
 /begin IN_MEASUREMENT Alt_flgTBattMin Alt_iBattSetIn Alt_uDes BattU_stPwrFail BattU_u Batt_flgDeternDetd Batt_flgInhbSpst BdInt_stHoodOpenDurgEngStrt CoEng_st CoEng_tiStartRed ComEBS_stBattSizeDetc Com_bBliChrg Com_lDst Com_qSoh Com_ratSoc Com_stSensErr Com_stSoc Com_tBattEBS CoVOM_bSSEEngStopPassed CoVOM_stSSE Ebs_flgBliChrgCalcnCmpl Ebs_flgRst Ebs_flgSOCFlt Ebs_iBattFild Ebs_qBliChrg Ebs_qBliDcha Ebs_qSohFild Ebs_qTotBliDcha Ebs_ratSocFild Ebs_ratSohFild Ebs_stBattInvld Ebs_stBattRVld Ebs_stEbsPlausyChk Ebs_stErr Ebs_stSocErrChk Ebs_tBattFild Ebs_uBattFild Ebs_uSofFild EEM_chBatt EEM_stBattChAc Eep_EnvRamInvld Epm_nEng SyC_ctPostDrvLeave T15_st /end IN_MEASUREMENT
 /begin OUT_MEASUREMENT Batt_bEngStopEna Batt_bEngStrtReq Batt_flgChrgChartcDgrtDetn Batt_flgChrgILo Batt_flgChrgMod Batt_flgDarkIAllwCondA Batt_flgDarkIAllwCondB Batt_flgDarkIProhb Batt_flgLoSocJdgAftEngRun Batt_flgOCV Batt_flgRcvChrgCmpl Batt_flgSocCalcn Batt_flgSt1Cmpl Batt_flgSt7Tran Batt_lMaxCnsChk Batt_lMinCnsChk Batt_qCap20 Batt_qChrgCnsChkAH Batt_qCnsChk Batt_qCnsChkAH Batt_qDchaCnsChkAH Batt_qMaxCnsChk Batt_qMaxCnsChkAH Batt_qMinCnsChk Batt_qMinCnsChkAH Batt_qSumHi Batt_qSumHiNR Batt_qSumLo Batt_qSumRaw Batt_qSumRCINI Batt_qSumStdy Batt_ratSoc Batt_ratSOCCalc Batt_stCalc Batt_stCalcPrev Batt_stEbsBattCod Batt_stEngStopInhbn Batt_stZero ESS_uBatt /end OUT_MEASUREMENT
 /begin LOC_MEASUREMENT Batt_cntrIniDrv100ms Batt_cntrIniDrv10ms Batt_cntrOCV Batt_cntrStrt Batt_cntrStrtIn Batt_facHiChrgnEff Batt_facLoChrgnEff Batt_flgAltFailr Batt_flgChrgCmpl Batt_flgCnsChkEna Batt_flgCntrExcd Batt_flgDarkIAllwCdnAHys Batt_flgDarkIAllwCdnBHys Batt_flgDarkIJudgLo Batt_flgDarkIUpd Batt_flgDoDLimStrtReq Batt_flgDodStopDisbl Batt_flgDodStrtReq Batt_flgDrkDchaRst Batt_flgFullChrg Batt_flgJSOrFailr Batt_flgRawCorrnCmpl Batt_flgRawExe Batt_flgRcvChrgNotCmpl Batt_flgSetSt8 Batt_flgSOCDiffDetd Batt_flgSOCDiffExcd Batt_flgSt1Hist Batt_flgSt8Rec Batt_flgStalEng Batt_flgStdyCorrnCmpl Batt_flgTransReas1 Batt_qBattDoD Batt_qBattFild Batt_qChrgCnsChk Batt_qDarkIJudgVal Batt_qDarkJudgValAHi Batt_qDarkJudgValALo Batt_qDarkJudgValBHi Batt_qDarkJudgValBLo Batt_qDchaCnsChk Batt_qSohTmp1_MP Batt_qSohTmp2_MP Batt_qSohTmp3_MP Batt_ratSoc_MP Batt_stBattCodChgID1 Batt_stBattCodChgID2 Batt_stChrgnIStopEna Batt_stDod Batt_stEbsBattCodLoc Batt_StrtEnbl_MP Batt_stSix Batt_stSoc_MP Batt_tiCumTi1 Batt_tiCumTi2 Batt_uSofOffs /end LOC_MEASUREMENT
 FUNCTION_VERSION "22.21.0" /end FUNCTION
/begin FUNCTION Batt_Detern "1.8.0     Indicate Battery Deterioration"
 /begin DEF_CHARACTERISTIC Batt_flgSwtSOCSeln_C Batt_qSumLoLim_C Batt_ratMinSocRBatt_C Batt_rBattDgrdLim_C Batt_rBattExchJudgThd_C Batt_rLimSysFailrHi_C Batt_rLimSysFailrLo_C Batt_rSlopBattDgrd_T Batt_rSlopISSEna_T Batt_tISSProhbModChg_C Batt_tISSProhb_C /end DEF_CHARACTERISTIC
 /begin IN_MEASUREMENT Batt_flgSt1Cmpl Batt_qSumLo Ebs_ratSocFild Ebs_rBatt Ebs_rBattAct Ebs_rBattMeasd Ebs_stRInhbSpst Ebs_tBattFild Eep_EnvRamInvld T15_st /end IN_MEASUREMENT
 /begin OUT_MEASUREMENT Batt_flgDeternDetd Batt_flgInhbSpst Batt_idxRDcyc Batt_rExch Batt_rMean /end OUT_MEASUREMENT
 /begin LOC_MEASUREMENT Batt_flgBattExch Batt_flgExchJudgCmpl Batt_flgIdxUpd Batt_flgISSInhbDcyc Batt_flgLimSysFailr Batt_flgRInhbISSLoc Batt_rBattExchJudg Batt_rBattOld Batt_rDcyc Batt_rSlopBattDgrd Batt_rSlopISSEna Batt_stREBSInhbSpst /end LOC_MEASUREMENT
 FUNCTION_VERSION "1.8.0" /end FUNCTION
/begin FUNCTION BBKHFES "11.2.0    specif. of desired factors for air charge cont. actors in case of cat.heating"
 /begin DEF_CHARACTERISTIC CWBBKHFES ExhMgT_facLamAltiCatHeatgAirm_GM ExhMgT_facLamCatHeatgAirm_GM ExhMgT_facLamCatHeatgRamp_M ExhMgT_facLamCatWrm_T ExhMgT_facLamCtrlAlti_T ExhMgT_tiFilMfExhCat1B1_T ExhMgT_tiFilTCat_T SIM08KHUW STCS08KHSW /end DEF_CHARACTERISTIC
 /begin IN_MEASUREMENT ExhMgT_facCatHeatgFinshd ExhMgT_facCatHeatgProgs ExhMgT_facCatHeatgRamp ExhMgT_flgCatHeatgColdStrtReq ExhMgT_flgCatHeatgUpActv ExhMgT_flgCatHeatgWrmReq ExhMgT_tCatHeatgTCatSelnActn ExhMgT_tEngCatHeatgFild ExhMod_mfExhCat1B1 PEnv_facCorrAlti SyC_ctPostDrvLeave SyC_stSub /end IN_MEASUREMENT
 /begin OUT_MEASUREMENT flakh_msg flbkkh_msg fnwkha_msg fnwkhe_msg fnwkhnga_msg fnwkhnge_msg /end OUT_MEASUREMENT
 /begin LOC_MEASUREMENT BBKHFES_ctReIni ExhMgT_facCamsftCatHeatg ExhMgT_facCatHeatgIntkCamsft ExhMgT_facCatHeatgOutlCamsft ExhMgT_facLamCatHeatgRamp ExhMgT_facLamCtrl ExhMgT_facLamCtrlCatHeatg ExhMgT_facLamCtrlCatWrm ExhMgT_facRatLamCatHeatg ExhMgT_mfExhCat1B1Dif ExhMgT_mfExhCat1B1Fild ExhMgT_mfExhCat1B1Loc ExhMgT_tCatHeatgTCatSelnActnDif ExhMgT_tCatHeatgTCatSelnFild ExhMgT_tCatSelnActnLoc /end LOC_MEASUREMENT
 FUNCTION_VERSION "11.2.0" /end FUNCTION
/begin FUNCTION BBKR "45.0.0    operation conditions knock control"
 /begin DEF_CHARACTERISTIC CWTIPIN IKCtl_cntrStrtEnd_C IKCtl_DlyTnKnkEna_T IKCtl_dnSelnFildGrdt_C IKCtl_facDlyAdpn_T IKCtl_facDlyLoadDynDetn_GT IKCtl_facFildNGrdt_C IKCtl_facKnkEna_C IKCtl_facOffsLoadDynDetn_GT IKCtl_facSpdAdpn1_C IKCtl_facSpdAdpn2_C IKCtl_facSpdAdpn3_C IKCtl_facSpdAdpn4_C IKCtl_facTAdapEna_C IKCtl_facThdLoadDynDetnAirChrg_GM IKCtl_facThdLoadDynDetn_GT IKCtl_facThdNDynDetn_GT IKCtl_facTiLoadDynDetn_GT IKCtl_facTiNDynDetn_GT IKCtl_facTLoadDynAdpn_GT IKCtl_facTThdDyn_C IKCtl_facTThdKnk_C IKCtl_nAdapEna_C IKCtl_nSpdHys_C IKCtl_ratAirLoadThdN_GT IKCtl_ratHysLoad_C IKCtl_ratLoadDynDetnThd_GM IKCtl_ratLoadRngAdpnM1_GT IKCtl_ratLoadRngAdpnM2_GT IKCtl_ratLoadRngAdpnM3_GT IKCtl_ratLoadThd_GT IKCtl_stSelnDesLoadFilGrdt_C IKCtl_stSelnFildAirChrgGrdt_C IKCtl_tInltVlvAirTThd_C IKCtl_tiVVlvLftDynDetn_GT KRLNMDY TATIPIN /end DEF_CHARACTERISTIC
 /begin REF_CHARACTERISTIC IKCtl_nEng08_X_AX IKCtl_nEngVar13_X_AX IKCtl_ratLoadDy04_X_AX IKCtl_stLimp_C /end REF_CHARACTERISTIC
 /begin IN_MEASUREMENT AirMod_ratChrgAirCyl B_ll_msg B_nmax_msg B_sa_msg B_vhegabgn_msg CEngDsT_t Clth_st DSM_TripChgFinshd EngStrt_bStrtEnd Epm_dnEngAvg Epm_nEng Epm_stOpMode Epm_stSync evz_austot_msg Ign_stiaBasKnk IKCtl_agDynAdpnOffs_s8 IKCtl_cntrCyl IKCtl_flgAdpnWrEnaCopy IKCtl_flgKnkDetn IKCtl_flgSftyRtdtGdCyl IKCtl_nFildGrad_s8 IKCtl_stMaskGdCly_b8 IKCtl_stVldnSnsrSig psrs_w_msg rlsol_w_msg SyC_ctPostDrvLeave SyC_stSub taev_w_msg tans_msg Tra_numGear VehV_flgStandStill /end IN_MEASUREMENT
 /begin OUT_MEASUREMENT B_krvhdy_msg IKCtl_dnFildGrdt_s16 IKCtl_flgAdpnEna IKCtl_flgAdpnLrnEna IKCtl_flgAdpnWrEna IKCtl_flgDiagEna IKCtl_flgDynAdpnEna IKCtl_flgDynAdpnRead IKCtl_flgFastAdvIa IKCtl_flgGdCyl IKCtl_flgInjD IKCtl_flgKnkEna IKCtl_flgKnkLimp IKCtl_flgLoadDynAdpn IKCtl_flgLoadDynAdpnAdv IKCtl_flgLoadDynCtrlEna IKCtl_flgLoadDynDetn IKCtl_flgRtdtUse IKCtl_flgSftyRtdt IKCtl_flgSpdDynDetn IKCtl_flgTEna IKCtl_flgTipinDetn IKCtl_idxAdpn_u16 IKCtl_idxSpdAdpn_u8 IKCtl_pPfiSp IKCtl_ratFilGrdtDesAirChrg_u16 IKCtl_ratRelAirChrg IKCtl_stInjDTot_b8 IKCtl_stSnsrErr_u8 /end OUT_MEASUREMENT
 /begin LOC_MEASUREMENT actkeldyn actkendyn actldyn B_delayhld B_eks B_krenfadi B_krsyne dyespfv dyespof IKCtl_cntrVVlvLftDynDetn IKCtl_ctReIni10msBBKR IKCtl_flgKnkLoc IKCtl_flgLoadDynAdpnTmp IKCtl_flgSftyRtdtReq IKCtl_flgSftyRtdtTmp IKCtl_ofsDesLoadDynThd_u16 IKCtl_ratAirLoadThdFastAdvIa IKCtl_ratCurrLoadDynDetnThd IKCtl_ratLoadDynDetnThd_u16 IKCtl_ratLoadRngAdpn1 IKCtl_ratLoadRngAdpn2 IKCtl_ratLoadRngAdpn3 IKCtl_ratLoadThd IKCtl_ratOffsLoadDynDetnThd IKCtl_tEna IKCtl_tiVVlvLftDynDetn IKCtl_tmpReIniBBKR krdydlyd_l krdyndelay krdyofdd_l ngkrv stkrlx zaeldy zaeldyke zaendy /end LOC_MEASUREMENT
 FUNCTION_VERSION "45.0.0" /end FUNCTION
/begin FUNCTION BBSAFG "1.48.0_1.3.0Operation condition fuel cut-off release"
 /begin DEF_CHARACTERISTIC CES_CVTNRstrt_GCUR CES_Gear_AXIS CES_nEngGrdt_AXIS CES_nRstrtConvSlip_GMAP CES_nRstrt_GMAP CES_rGrip_C CES_tEng_AXIS CES_V_AXIS CoEng_flgFcoRelsCatHeatg_C CoEng_flgSwtInhbnFcoFuSysErr_C CoEng_flgUseCatWrmReq_C CoEng_idxGearDetnSelnFco_C CoEng_nDeltaNVEngTemp_M CoEng_nDeltaNVGear_M CoEng_nDeltaRstrtClimaV_T CoEng_nDeltaRstrtClima_GMAP CoEng_nDeltaRstrtEngSpdGrdAtLockExtdMod_M CoEng_nDeltaRstrtEngSpdGrdAt_M CoEng_nDeltaRstrtNGrdt_M CoEng_nRstrtAirCdng_C CoEng_nSpLoOffs_T CoEng_nThdRstrtABSFailr_C CoEng_stFcoGearCatHeatg_T CoEng_stTqDmdFcoInhbnMask_C CoEng_tEngMinFco_C CoEng_tiRstrtAirCdng_C CoEng_vThdVehStop_C CWNWEGTR CWSAWE DNSAH DNSAHS DNSAL DNSALH DNSALHS DNSALS DNSATIP DNSLL DNSLLK DNSLLS KFTVSA KFTVSAGNG KFTVSAKAT KFTVSAVG KFTVSAVGV0 NGDNSA NGDNSAL NGDNSALS NGDNSAS NMOTTHASYN SAVGANGIKL SNM08SAUB STK04SAUB TVBGSCH TVSABFA TVSABTE TVSAGSCH TVSATM /end DEF_CHARACTERISTIC
 /begin IN_MEASUREMENT ACCtl_stOut Alt_flgLockUpCluExtnReq B_cvt_msg B_fa_msg B_fs_msg B_gsch_msg B_invlvbcd_msg B_khakt_msg B_khakw_msg B_kh_msg B_koe_msg B_kuppl_msg B_ll_msg B_sabbts_msg B_tatmsa_msg B_te_msg B_tippg_msg CEngDsT_t CoEng_bFrstStrtEnd Com_stABSWrn EGSys_bFCORdnCoPr EngStrt_bStrtEnd Epm_dnEngFlt Epm_nEng Epm_nEng10ms ExhMod_tCat2B1 Gbx_bOvrRstrtActv Gbx_numGearTrgt GlbDa_stTrqDem HLSDem_nSetPLo I14229_stABSFailCnclActv LLim_bFcoDes_msg PthSet_bOvrRun PthSet_stOvrRunEna PT_bCtOffPhd PT_bNoGrip Pt_flgFcoInhb PT_rGrip PT_stTraType SpdGov_nSetPLo SyC_stSub SysDiag_flgCModJdg Tra_numGear VehMot_stCtOffPhd VehV_v /end IN_MEASUREMENT
 /begin OUT_MEASUREMENT B_saen_msg CoEng_bCtOffConDel CoEng_flgCpvClsForFco CoEng_flgFcoRdnBasc CoEng_flgFcoTrsm CoEng_flgRelsFco CoEng_nFco CoEng_nRstrt CoPOM_bCtOffDem tvsab_w tvsab_w_msg /end OUT_MEASUREMENT
 /begin LOC_MEASUREMENT B_dnsll B_koe_loc B_nwemg B_sabvorLoc CoEng_FcoRelsDlyTONV_I.outbit CoEng_FcoRelsDlyTONV_I.time CoEng_flgFcoRdnEF_I.buffer CoEng_flgFcoRdnEF_I.oldSignal CoEng_flgFcoRelsEng CoEng_flgFcoRelsVeh CoEng_flgNRstrtMinAbsFailr CoEng_flgTiDpdtOverrunHysRst CoEng_nDeltaRstrtClimaTot CoEng_nDeltaRstrtNGrdt CoEng_nRstrtBasc CoEng_nRstrtBascTrsm CoEng_numGearFcoLoc dnsavg dnsavt dnsa_w nwecvt nwema nwemas tkattmp tvsaa tvsag_w tvsakat tvsavg /end LOC_MEASUREMENT
 FUNCTION_VERSION "1.48.0_1.3.0" /end FUNCTION
/begin FUNCTION BBSTNSAD "5.20.0    Operation condition start-/ afterstart adaptation"
 /begin DEF_CHARACTERISTIC AHENSADMX ANZTIMNSAD BBSTNSAD_uBatt_C CLUTWMENMN CWBBSTNSAD CWBBSTNSAD2 CWBBSTNSAD3 DSDLUTSR EngStrt_cntrAftStrtDly_C EngStrt_swtAftStopInhb_C EngStrt_SwtTankEmptyResvEna_C EngStrt_tAftStrtSwtOff_C EngStrt_tiFallDebStOfClu_C EngStrt_tiRiseDebStOfClu_C EngStrt_vVehInhb_C ENSAD ESDLUTS FSDLUSOL KFTNSEADMX KSTANSAD MNCLUTWM MXCLUTWM NMXNSAD TENGSDECR TMNSADMN TMNSADMX TMOTMNSAD TVNSKUPPEF TVNSKUPPER TVTOFLUT UBKSTMX /end DEF_CHARACTERISTIC
 /begin IN_MEASUREMENT anztib_w_msg AuxHtg_bActv BattU_u B_ad_msg B_edkvs_msg B_evloc_msg B_gsch_msg B_ll_msg B_lr_msg B_pug_msg B_tal_msg B_vbmg_msg B_vheg_msg B_wkr_msg B_wst_msg CEngDsT_t CEngDsT_tStrt Clth_st EngStrt_bStrtEnd EngStrt_flgShDwnTiVld Epm_nEngLRes Epm_numCyl Epm_stOpMode Epm_stSpd kstaa_msg MisfDet_flgRoughRoad MisfDet_maskRelsStc MisfDet_stcEmiMisfCntrSum MisfDet_stDet MisfDet_stSegTiAdpnRdy MisfDet_stSegTiVld MisfDet_stTqZero sdlutsol_w_msg sdluts_w_msg SyC_ctDrvEnter TiOff_tiStrtEndOff tnse_w_msg VehV_v /end IN_MEASUREMENT
 /begin OUT_MEASUREMENT B_nsadend_msg B_nsadh_msg B_nsad_msg B_sdlutsr_msg B_sdluts_msg B_staclr_msg B_staneut_msg B_stanodec_msg B_stanoinc_msg B_stanosav_msg B_stareset_msg censad_msg clutwmen_w_msg clutwm_w_msg /end OUT_MEASUREMENT
 /begin LOC_MEASUREMENT B_adneusyn B_adstopnd B_dmdadap B_engroads B_engroold B_ensad B_esdluts B_inhbadst B_inhengro B_inhronu B_nsadstp B_sccnsad B_sccnsad2 B_ubkst cesdluts cesdlutsr EngStrt_cntrAftStrtDly EngStrt_ctDrvEntrBBSTNSAD100ms EngStrt_ctDrvEntrBBSTNSAD20ms EngStrt_ctDrvEntrBBSTNSADSyncS0 EngStrt_flgAftStopInhb EngStrt_flgAftStopInhbHld fvapskstaa sdlutact_w tmotbstnsd tmstbstnsd zubkst zylzg /end LOC_MEASUREMENT
 FUNCTION_VERSION "5.20.0" /end FUNCTION
/begin FUNCTION BdInt_SetData "2.0.0     Body interior Set Data"
 /begin DEF_CHARACTERISTIC BdInt_stPCU_C BdInt_swtEngStopEna_C BdInt_swtEngStrtEna_C BdInt_swtRstrtNoPtdEna_C BdInt_swtStrtEnaClthSel_C BdInt_tiAutoRstrtReqGr1_C BdInt_tiAutoRstrtReqGr2_C BdInt_tiClthOnDspReqDly_C BdInt_tiEngHoodOpen_C BdInt_tiRstrtNoPtdCdn_C BdInt_tiSeatBltOff_C /end DEF_CHARACTERISTIC
 /begin IN_MEASUREMENT Clth3_st Clth4_st CoEng_st ComDCDC_stDiagCirc1 ComDCDC_stDiagCirc2 ComDCDC_stRxErr Com_stEngHoodOpn Com_stSeatBltInfo CoVOM_stAutoRstrtReq CoVOM_stAutoRstrtReqGr1 CoVOM_stAutoRstrtReqGr2 I14229_stABSFailCnclActv I14229_stIdlStopCdn PT_bAutoStrtRls StrtCtl_stClthForStrtReqJdg SyC_ctPostDrvLeave SysDiag_flgCModJdg T15_st T50_st /end IN_MEASUREMENT
 /begin OUT_MEASUREMENT BdInt_bClthOnDspReqPreCond BdInt_bEngStopEna BdInt_bEngStrtEna BdInt_bRstrtNoPtd BdInt_stDCDCCdn BdInt_stEngStrtCdn BdInt_stHoodOpenDurgEngStrt BdInt_stInhbReas BdInt_stPCU /end OUT_MEASUREMENT
 /begin LOC_MEASUREMENT BdInt_cntrIniDrv BdInt_stEngHoodOpen_MP BdInt_stEngStrtEna_mp BdInt_stFrEngStrtCdn_mp BdInt_stRstrtNoPtdCdn_mp /end LOC_MEASUREMENT
 FUNCTION_VERSION "2.0.0" /end FUNCTION
/begin FUNCTION BdyECU_BCM1 "8.3.0_6SAAReception process for the CAN frame BCM1" /begin DEF_CHARACTERISTIC Com_dBCM1MaxDiff_C Com_dBCM1MaxPer_C /end DEF_CHARACTERISTIC
 /begin IN_MEASUREMENT Com_ctCRingBCM1 Com_numCsumBCM1 Com_stBCANReprogm Com_stFrmRxEna Com_stMon Com_stRemEngStrtr /end IN_MEASUREMENT
 /begin LOC_MEASUREMENT BdyECU_ctBCM1RngCnt_MP /end LOC_MEASUREMENT
 FUNCTION_VERSION "8.3.0_6SAA" /end FUNCTION
/begin FUNCTION BdyECU_SRS "5.2.0_6SAACAN messages of the Body ECU (SRS)"
 /begin DEF_CHARACTERISTIC Com_ctCRingSRS_C Com_dSRSMaxDiff_C Com_dSRSMaxPer_C Com_numCsumSRS_C Com_stSeatBltInfo_C /end DEF_CHARACTERISTIC
 /begin IN_MEASUREMENT Com_ctCRingSRS Com_numCsumSRS Com_stFrmRxEna Com_stMon Com_stSeatBltInfo /end IN_MEASUREMENT
 /begin LOC_MEASUREMENT BdyECU_ctRngSRS_MP /end LOC_MEASUREMENT
 FUNCTION_VERSION "5.2.0_6SAA" /end FUNCTION
/begin FUNCTION BdyECU_SRSA "4.5.0_6SAACAN messages of the Body ECU (SRSA)"
 /begin DEF_CHARACTERISTIC Com_aLatGA_C Com_aLgtG_C Com_ctCRingSRSA_C Com_dSRSAMaxDiff_C Com_dSRSAMaxPer_C Com_dSRSASigSel_C Com_numCsumSRSA_C Com_nYaw1UpprData_C Com_stAbnormCpu_C Com_stAbnormVcc_C Com_stCalCmplLatG_C Com_stCalCmplLgtG_C Com_stFailrLatG_C Com_stFailrLgtG_C Com_stPrmntErrYaw1_C Com_stStrtupProc_C Com_stTempAbnormLatG_C Com_stTempAbnormLgtG_C Com_stTmpErrYaw1_C /end DEF_CHARACTERISTIC
 /begin IN_MEASUREMENT Com_aLatGA Com_aLgtG Com_ctCRingSRSA Com_numCsumSRSA Com_nYaw1UpprData Com_stAbnormCpu Com_stAbnormVcc Com_stCalCmplLatG Com_stCalCmplLgtG Com_stCANANoBusOff Com_stFailrLatG Com_stFailrLgtG Com_stFrmRxEna Com_stMon Com_stPrmntErrYaw1 Com_stStrtupProc Com_stTempAbnormLatG Com_stTempAbnormLgtG Com_stTmpErrYaw1 T15_st /end IN_MEASUREMENT
 /begin OUT_MEASUREMENT Com_stRxSRSA Com_stRxSRSAChkSumOk Com_stRxSRSADeb Com_stRxSRSAOk Com_stRxSRSARingCntOk LAS_a TAS_a /end OUT_MEASUREMENT
 /begin LOC_MEASUREMENT BdyECU_ctRngSRSA_MP /end LOC_MEASUREMENT
 FUNCTION_VERSION "4.5.0_6SAA" /end FUNCTION
/begin FUNCTION BdyECU_SRSB "6.2.0_6SAACAN messages of the Body ECU (SRSB)"
 /begin DEF_CHARACTERISTIC Com_ctCRingSRSB_C Com_ctSRSReWrThres_C Com_dSRSBMaxDiff_C Com_dSRSBMaxPer_C Com_numCsumSRSB_C /end DEF_CHARACTERISTIC
 /begin IN_MEASUREMENT Com_ctCRingSRSB Com_numCsumSRSB Com_stCllsnDetn Com_stFrmRxEna Com_stMon /end IN_MEASUREMENT
 /begin OUT_MEASUREMENT Com_stSRSActvDlyd /end OUT_MEASUREMENT
 /begin LOC_MEASUREMENT BdyECU_ctRngSRSB_MP /end LOC_MEASUREMENT
 FUNCTION_VERSION "6.2.0_6SAA" /end FUNCTION
/begin FUNCTION BGADAP "7.10.0    Alignment of measuring and modeling intake manifold pressure"
 /begin DEF_CHARACTERISTIC AirMod_tiDebCdnLeakMflowAdpn_C CWBGADAP DFKMSDELSR DOFMSNDK LZSRPUMN LZSRTMOTMN LZSRTMOTMX OMSNDKGLSMX OMSNDKLSMX TDGLSR TDLZSR TOMSZCGLSRI TOMSZLZSRI /end DEF_CHARACTERISTIC
 /begin IN_MEASUREMENT B_adkose_msg B_fkpvdkp_msg B_ofmsndkp_msg B_psrgg_msg B_psrmhg_msg CEngDsT_t fkmsdksp_w_msg ofmsndap_w_msg ofmsndkp_w_msg PEnv_p SyC_stSub /end IN_MEASUREMENT
 /begin OUT_MEASUREMENT B_apslmdse_msg B_apslmds_msg B_fgdlzsr B_glsr_msg /end OUT_MEASUREMENT
 /begin LOC_MEASUREMENT AirMon_flgBigLeakIntkMnfldEmiInflReld_mp AirMon_flgLeakIntkMnfldEmiInflReld_mp B_lzsrhfmp tofmsndkpcg_w tofmsndkp_w /end LOC_MEASUREMENT
 FUNCTION_VERSION "7.10.0" /end FUNCTION
/begin FUNCTION BGASMDF "4.1.0     Calculation of air sysem values to torque structure"
 /begin IN_MEASUREMENT B_wdksg_msg B_zwfdka_msg B_zwfrlmin_msg SyC_stSub ThrVlv_flgLimpModeB1 ThrVlv_flgReqFuCutOffB1 /end IN_MEASUREMENT
 /begin OUT_MEASUREMENT B_mdfasfk_msg B_mdfasnl_msg /end OUT_MEASUREMENT
 FUNCTION_VERSION "4.1.0" /end FUNCTION
/begin FUNCTION BGBH "1.9.0     Calculated variable block heater (detection)" /begin DEF_CHARACTERISTIC CWBH DTMSRT TMMXRT TNSRT /end DEF_CHARACTERISTIC /begin IN_MEASUREMENT CEngDsT_flgSnsrVld CEngDsT_tSnsrFild Epm_stSpd SyC_stSub /end IN_MEASUREMENT
 /begin OUT_MEASUREMENT B_enbhtr_msg B_nbhtr_msg B_nibhtr_msg B_tmmn_msg B_tmsrt_msg CEngDsT_flgBlkHeatrActvd /end OUT_MEASUREMENT
 /begin LOC_MEASUREMENT B_clcbh B_pnbhtr tbhsw tmmxbh /end LOC_MEASUREMENT
 FUNCTION_VERSION "1.9.0" /end FUNCTION
/begin FUNCTION BGBKVMSISR "11.1.0    Calculation of mass flow from brake booster to intake manifold"
 /begin DEF_CHARACTERISTIC BrkS_mfIntegIniVal_C BrkS_mfIntegLowrThd_C BrkS_mfIntegUpprThd_T BrkS_mfLimBrkPmpgActvDetn_C BrkS_mfLimBrkPmpgInactvDetn_C BrkS_nEngThd_C BrkS_pIntegDbndLowrThd_C BrkS_pIntegDbndUpprThd_C BrkS_stEnaCdn_C BrkS_tiDlyEngStrtFinshd_C BrkS_tiInteg_C BrkS_vVehVThd_C /end DEF_CHARACTERISTIC
 /begin IN_MEASUREMENT B_ll_msg EngStrt_bStrtEnd Epm_nEng fupsrl_w_msg LIGov_bInactv PEnv_p psrg_w_msg psrmh_w_msg SyC_ctPostDrvLeave SyC_stSub umsrln_w_msg VehV_v /end IN_MEASUREMENT
 /begin OUT_MEASUREMENT BrkS_flgBrkPmpgActv BrkS_flgBrkPmpgDetd BrkS_flgIdle msbkvsr_w_msg /end OUT_MEASUREMENT
 /begin LOC_MEASUREMENT BrkS_cntrReIni BrkS_mfBrkPmpg BrkS_mfBrkPmpgCnvn BrkS_mfIntegUpprThd BrkS_pDifBrkPmpg /end LOC_MEASUREMENT
 FUNCTION_VERSION "11.1.0" /end FUNCTION
/begin FUNCTION BGEDKVS "7.3.1     Determination of error DKVS (adapter)" /begin DEF_CHARACTERISTIC SF_DKVS /end DEF_CHARACTERISTIC /begin IN_MEASUREMENT SyC_stSub /end IN_MEASUREMENT FUNCTION_VERSION "7.3.1" /end FUNCTION
/begin FUNCTION BGETADZW "4.7.0     computation methods for spark efficiency"
 /begin DEF_CHARACTERISTIC DZWETAI ETADZWI KFIFDZW TMECmb_facDiaInert_T TMECmb_facDiaLamNEngChrgAir_M TMECmb_facDiaLam_T /end DEF_CHARACTERISTIC
 /begin IN_MEASUREMENT AirMod_ratChrgAirCylAdv_a AirMod_ratInertCylAdv_a Epm_nEng Gen_ctCylAdv lamsbg_w_msg /end IN_MEASUREMENT
 /begin OUT_MEASUREMENT TMECmb_IfEtaIaGnrl_I.HSPActv TMECmb_IfEtaIaGnrl_I.f2kazw TMECmb_IfEtaIaGnrl_I.flb TMECmb_IfEtaIaGnrl_I.lamsbg TMECmb_IfEtaIaGnrl_I.nEng TMECmb_IfEtaIaGnrl_I.rl TMECmb_IfEtaIaGnrl_I.rri TMECmb_IfEtaIaGnrl_I.split2ka /end OUT_MEASUREMENT
 FUNCTION_VERSION "4.7.0" /end FUNCTION
/begin FUNCTION BGEVAB "7.5.0     Calculation of the actual reduction stage by ignition-valve cut-off" /begin IN_MEASUREMENT anztib_msg evz_austot_msg stateaevab_msg zzbank_msg /end IN_MEASUREMENT
 /begin OUT_MEASUREMENT B_bevab_msg B_evakt_msg B_evloc_msg InjSys_bInjVlvActv InjSys_flgFcoBnk InjSys_flgFuEngOperActv InjSys_stActRedStg redistb1_msg redist_msg /end OUT_MEASUREMENT
 /begin LOC_MEASUREMENT evz_ausold /end LOC_MEASUREMENT
 FUNCTION_VERSION "7.5.0" /end FUNCTION
/begin FUNCTION BGFAWU "10.9.0    Calculated value of driver command"
 /begin DEF_CHARACTERISTIC CnvSet_stDiEnchmtMsk_C CWLAMFAW DLAMFAW LAMFA LAMFACHRSM LAMFASPORT TLAFA ZKLAMFAW /end DEF_CHARACTERISTIC
 /begin IN_MEASUREMENT APP_r B_kh_msg CoETS_bEngLimActvLead DrvPrgSwt_bSprt DrvPrgSwt_stEffModReqd Epm_nEng GlbDa_stTrqDem mrfa_w_msg PthLead_stActvMonLim SyC_stSub /end IN_MEASUREMENT
 /begin OUT_MEASUREMENT B_lamfas_msg B_lamfa_msg lamfa_w_msg /end OUT_MEASUREMENT
 /begin LOC_MEASUREMENT lamfaw_w /end LOC_MEASUREMENT
 FUNCTION_VERSION "10.9.0" /end FUNCTION
/begin COMPU_METHOD Acc "" RAT_FUNC "%6.5" "m/s^2" COEFFS 0 1000 0 0 0 1 /end COMPU_METHOD
/begin COMPU_METHOD AccGrv "" RAT_FUNC "%6.4" "g" COEFFS 0 100 0 0 0 1 /end COMPU_METHOD
/begin COMPU_METHOD Ampsec100 "" RAT_FUNC "%6.0" "As" COEFFS 0 1 0 0 0 100 /end COMPU_METHOD
/begin COMPU_METHOD B_TRUE "" TAB_VERB "%6.3" "" COMPU_TAB_REF B_TRUE /end COMPU_METHOD
/begin COMPU_VTAB B_TRUE "" TAB_VERB 2 0 "FALSE" 1 "TRUE" /end COMPU_VTAB
/begin COMPU_METHOD CDSHDG_PMTTYP_SC_Compu "" TAB_VERB "%6.3" "" COMPU_TAB_REF CDSHDG_PMTTYP_SC_Compu /end COMPU_METHOD
/begin COMPU_VTAB CDSHDG_PMTTYP_SC_Compu "" TAB_VERB 4 0 "PMT_OFF" 1 "PMT_HW_GTM" 2 "PMT_SW_MCS" 3 "PMT_SW_CPU" /end COMPU_VTAB
/begin COMPU_METHOD CELPRJ_SIMPLEMDLENA_SC_Compu "" TAB_VERB "%6.3" "" COMPU_TAB_REF CELPRJ_SIMPLEMDLENA_SC_Compu /end COMPU_METHOD
/begin COMPU_VTAB CELPRJ_SIMPLEMDLENA_SC_Compu "" TAB_VERB 2 0 "FALSE" 1 "TRUE" /end COMPU_VTAB
/begin COMPU_METHOD CENGBLKT_COLDSTRTDIAG_SC_Compu "" TAB_VERB "%6.3" "" COMPU_TAB_REF CENGBLKT_COLDSTRTDIAG_SC_Compu /end COMPU_METHOD
/begin COMPU_VTAB CENGBLKT_COLDSTRTDIAG_SC_Compu "" TAB_VERB 3 0 "DISABLE" 1 "OTHER_MODULE" 2 "CENTRAL_DIAG" /end COMPU_VTAB
/begin COMPU_METHOD CENGBLKT_SY_Compu "" TAB_VERB "%6.3" "" COMPU_TAB_REF CENGBLKT_SY_Compu /end COMPU_METHOD
/begin COMPU_VTAB CENGBLKT_SY_Compu "" TAB_VERB 2 0 "False" 1 "True" /end COMPU_VTAB
/begin COMPU_METHOD CENGDST_CFG_SC_Compu "" TAB_VERB "%6.3" "" COMPU_TAB_REF CENGDST_CFG_SC_Compu /end COMPU_METHOD
/begin COMPU_VTAB CENGDST_CFG_SC_Compu "" TAB_VERB 4 0 "no CEngDsT-sensor" 1 "CEngDsT_ADC" 2 "CEngDsT_CAN" 3 "CEngDsT_Sent" /end COMPU_VTAB
/begin COMPU_METHOD CENGDST_CMBTYP_SC_Compu "" TAB_VERB "%6.3" "" COMPU_TAB_REF CENGDST_CMBTYP_SC_Compu /end COMPU_METHOD
/begin COMPU_VTAB CENGDST_CMBTYP_SC_Compu "" TAB_VERB 3 0 "GS" 1 "DS" 2 "DGS" /end COMPU_VTAB
/begin COMPU_METHOD CENGDST_COLDCHKCFG_SC_Compu "" TAB_VERB "%6.3" "" COMPU_TAB_REF CENGDST_COLDCHKCFG_SC_Compu /end COMPU_METHOD
/begin COMPU_VTAB CENGDST_COLDCHKCFG_SC_Compu "" TAB_VERB 2 0 "Deactivated" 1 "Cnfg1" /end COMPU_VTAB
/begin COMPU_METHOD CENGDST_EXTHEATGWTRPMP_SC_Compu "" TAB_VERB "%6.3" "" COMPU_TAB_REF CENGDST_EXTHEATGWTRPMP_SC_Compu /end COMPU_METHOD
/begin COMPU_VTAB CENGDST_EXTHEATGWTRPMP_SC_Compu "" TAB_VERB 2 0 "CENGDST_HEATGWTRPMPCORRN_NOTAVL" 1 "CENGDST_HEATGWTRPMPCORRN_AVL" /end COMPU_VTAB
/begin COMPU_METHOD CENGDST_LOOSECONNCHK_SC_Compu "" TAB_VERB "%6.3" "" COMPU_TAB_REF CENGDST_LOOSECONNCHK_SC_Compu /end COMPU_METHOD
/begin COMPU_VTAB CENGDST_LOOSECONNCHK_SC_Compu "" TAB_VERB 2 0 "False" 1 "True" /end COMPU_VTAB
/begin COMPU_METHOD CENGDST_PHYSRNGCHK_SY_Compu "" TAB_VERB "%6.3" "" COMPU_TAB_REF CENGDST_PHYSRNGCHK_SY_Compu /end COMPU_METHOD
/begin COMPU_VTAB CENGDST_PHYSRNGCHK_SY_Compu "" TAB_VERB 2 0 "False" 1 "True" /end COMPU_VTAB
/begin COMPU_METHOD CENGDST_PLAUSDIAGLSCHK_SC_Compu "" TAB_VERB "%6.3" "" COMPU_TAB_REF CENGDST_PLAUSDIAGLSCHK_SC_Compu /end COMPU_METHOD
/begin COMPU_VTAB CENGDST_PLAUSDIAGLSCHK_SC_Compu "" TAB_VERB 2 0 "Disable" 1 "Enable" /end COMPU_VTAB
/begin COMPU_METHOD CENGDST_PLAUSDIAGSTUCKCHK_SC_Compu "" TAB_VERB "%6.3" "" COMPU_TAB_REF CENGDST_PLAUSDIAGSTUCKCHK_SC_Compu /end COMPU_METHOD
/begin COMPU_VTAB CENGDST_PLAUSDIAGSTUCKCHK_SC_Compu "" TAB_VERB 2 0 "False" 1 "True" /end COMPU_VTAB
/begin COMPU_METHOD CENGDST_REPLMDLEXT_SC_Compu "" TAB_VERB "%6.3" "" COMPU_TAB_REF CENGDST_REPLMDLEXT_SC_Compu /end COMPU_METHOD
/begin COMPU_VTAB CENGDST_REPLMDLEXT_SC_Compu "" TAB_VERB 2 0 "False" 1 "True" /end COMPU_VTAB
/begin COMPU_METHOD CENGDST_SWTHWORCAN_SY_Compu "" TAB_VERB "%6.3" "" COMPU_TAB_REF CENGDST_SWTHWORCAN_SY_Compu /end COMPU_METHOD
/begin COMPU_VTAB CENGDST_SWTHWORCAN_SY_Compu "" TAB_VERB 3 0 "0" 1 "1" 2 "2" /end COMPU_VTAB
/begin COMPU_METHOD CENGDST_TYPAVL_SY_Compu "" TAB_VERB "%6.3" "" COMPU_TAB_REF CENGDST_TYPAVL_SY_Compu /end COMPU_METHOD
/begin COMPU_VTAB CENGDST_TYPAVL_SY_Compu "" TAB_VERB 2 0 "False" 1 "True" /end COMPU_VTAB
/begin COMPU_METHOD CENGUST2_TYPAVL_SC_Compu "" TAB_VERB "%6.3" "" COMPU_TAB_REF CENGUST2_TYPAVL_SC_Compu /end COMPU_METHOD
/begin COMPU_VTAB CENGUST2_TYPAVL_SC_Compu "" TAB_VERB 2 0 "False" 1 "True" /end COMPU_VTAB
/begin COMPU_METHOD CENGUST_CFGHSC_SC_Compu "" TAB_VERB "%6.3" "" COMPU_TAB_REF CENGUST_CFGHSC_SC_Compu /end COMPU_METHOD
/begin COMPU_VTAB CENGUST_CFGHSC_SC_Compu "" TAB_VERB 2 0 "False" 1 "True" /end COMPU_VTAB
/begin COMPU_METHOD CENGUST_CFGLSC_SC_Compu "" TAB_VERB "%6.3" "" COMPU_TAB_REF CENGUST_CFGLSC_SC_Compu /end COMPU_METHOD
/begin COMPU_VTAB CENGUST_CFGLSC_SC_Compu "" TAB_VERB 2 0 "False" 1 "True" /end COMPU_VTAB
/begin COMPU_METHOD CENGUST_CFGSTUCKCHK_SC_Compu "" TAB_VERB "%6.3" "" COMPU_TAB_REF CENGUST_CFGSTUCKCHK_SC_Compu /end COMPU_METHOD
/begin COMPU_VTAB CENGUST_CFGSTUCKCHK_SC_Compu "" TAB_VERB 2 0 "False" 1 "True" /end COMPU_VTAB
/begin COMPU_METHOD CENGUST_COLDSTRTDIAG_SC_Compu "" TAB_VERB "%6.3" "" COMPU_TAB_REF CENGUST_COLDSTRTDIAG_SC_Compu /end COMPU_METHOD
/begin COMPU_VTAB CENGUST_COLDSTRTDIAG_SC_Compu "" TAB_VERB 2 0 "False" 1 "True" /end COMPU_VTAB
/begin COMPU_METHOD CENGUST_GRDTCHKCFG_SC_Compu "" TAB_VERB "%6.3" "" COMPU_TAB_REF CENGUST_GRDTCHKCFG_SC_Compu /end COMPU_METHOD
/begin COMPU_VTAB CENGUST_GRDTCHKCFG_SC_Compu "" TAB_VERB 2 0 "GradientChk_Disabled" 1 "GradientChk_Enabled" /end COMPU_VTAB
/begin COMPU_METHOD CENGUST_LOOSECNCTNCHK_SC_Compu "" TAB_VERB "%6.3" "" COMPU_TAB_REF CENGUST_LOOSECNCTNCHK_SC_Compu /end COMPU_METHOD
/begin COMPU_VTAB CENGUST_LOOSECNCTNCHK_SC_Compu "" TAB_VERB 2 0 "False" 1 "True" /end COMPU_VTAB
/begin COMPU_METHOD CENGUST_PHYRNGCHK_SC_Compu "" TAB_VERB "%6.3" "" COMPU_TAB_REF CENGUST_PHYRNGCHK_SC_Compu /end COMPU_METHOD
/begin COMPU_VTAB CENGUST_PHYRNGCHK_SC_Compu "" TAB_VERB 2 0 "False" 1 "True" /end COMPU_VTAB
/begin COMPU_METHOD CENGUST_SNSRPRSNT_SC_Compu "" TAB_VERB "%6.3" "" COMPU_TAB_REF CENGUST_SNSRPRSNT_SC_Compu /end COMPU_METHOD
/begin COMPU_VTAB CENGUST_SNSRPRSNT_SC_Compu "" TAB_VERB 2 0 "False" 1 "True" /end COMPU_VTAB
/begin COMPU_METHOD CENGUST_SNSRTYP_SC_Compu "" TAB_VERB "%6.3" "" COMPU_TAB_REF CENGUST_SNSRTYP_SC_Compu /end COMPU_METHOD
/begin COMPU_VTAB CENGUST_SNSRTYP_SC_Compu "" TAB_VERB 4 0 "ADC" 1 "CAN" 2 "ADCCAN" 255 "ApplicationParameter" /end COMPU_VTAB
/begin COMPU_METHOD CENGUST_TYPAVL_SY_Compu "" TAB_VERB "%6.3" "" COMPU_TAB_REF CENGUST_TYPAVL_SY_Compu /end COMPU_METHOD
/begin COMPU_VTAB CENGUST_TYPAVL_SY_Compu "" TAB_VERB 2 0 "False" 1 "True" /end COMPU_VTAB
/begin COMPU_METHOD CFGMTGRIP_SY_Compu "" TAB_VERB "%6.3" "" COMPU_TAB_REF CFGMTGRIP_SY_Compu /end COMPU_METHOD
/begin COMPU_VTAB CFGMTGRIP_SY_Compu "" TAB_VERB 3 0 "0" 1 "1" 2 "2" /end COMPU_VTAB
/begin COMPU_METHOD CHDT_PLAUSCOLD_SY_Compu "" TAB_VERB "%6.3" "" COMPU_TAB_REF CHDT_PLAUSCOLD_SY_Compu /end COMPU_METHOD
/begin COMPU_VTAB CHDT_PLAUSCOLD_SY_Compu "" TAB_VERB 2 0 "No_CHDT_CrossCheck" 1 "CHDT_CrossCheck_Enabled" /end COMPU_VTAB
/begin COMPU_METHOD CHDT_SENS_SY_Compu "" TAB_VERB "%6.3" "" COMPU_TAB_REF CHDT_SENS_SY_Compu /end COMPU_METHOD
/begin COMPU_VTAB CHDT_SENS_SY_Compu "" TAB_VERB 3 0 "CHDTNO" 1 "CHDTMOD" 2 "CHDTADC" /end COMPU_VTAB
/begin COMPU_METHOD CHDT_SY_Compu "" TAB_VERB "%6.3" "" COMPU_TAB_REF CHDT_SY_Compu /end COMPU_METHOD
/begin COMPU_VTAB CHDT_SY_Compu "" TAB_VERB 2 0 "False" 1 "True" /end COMPU_VTAB
/begin COMPU_METHOD CHDT_TYPAVL_SC_Compu "" TAB_VERB "%6.3" "" COMPU_TAB_REF CHDT_TYPAVL_SC_Compu /end COMPU_METHOD
/begin COMPU_VTAB CHDT_TYPAVL_SC_Compu "" TAB_VERB 2 0 "False" 1 "True" /end COMPU_VTAB
/begin COMPU_METHOD CHRCTL_BASCONLY_SC_Compu "" TAB_VERB "%6.3" "" COMPU_TAB_REF CHRCTL_BASCONLY_SC_Compu /end COMPU_METHOD
/begin COMPU_VTAB CHRCTL_BASCONLY_SC_Compu "" TAB_VERB 2 0 "False" 1 "True" /end COMPU_VTAB
/begin COMPU_METHOD CHRCTL_EIAECD_SY_Compu "" TAB_VERB "%6.3" "" COMPU_TAB_REF CHRCTL_EIAECD_SY_Compu /end COMPU_METHOD
/begin COMPU_VTAB CHRCTL_EIAECD_SY_Compu "" TAB_VERB 2 0 "False" 1 "True" /end COMPU_VTAB
/begin COMPU_METHOD CHRCTL_LIMTHRAGAFSPLST_SC_Compu "" TAB_VERB "%6.3" "" COMPU_TAB_REF CHRCTL_LIMTHRAGAFSPLST_SC_Compu /end COMPU_METHOD
/begin COMPU_VTAB CHRCTL_LIMTHRAGAFSPLST_SC_Compu "" TAB_VERB 2 0 "False" 1 "True" /end COMPU_VTAB
/begin COMPU_METHOD CHRCTL_OPNGEGRVLVUNTHRCDN_SC_Compu "" TAB_VERB "%6.3" "" COMPU_TAB_REF CHRCTL_OPNGEGRVLVUNTHRCDN_SC_Compu /end COMPU_METHOD
/begin COMPU_VTAB CHRCTL_OPNGEGRVLVUNTHRCDN_SC_Compu "" TAB_VERB 2 0 "no_unthrottled_EGR" 1 "unthrottled_EGR" /end COMPU_VTAB
/begin COMPU_METHOD CHRCTL_STMONEXTD_SC_Compu "" TAB_VERB "%6.3" "" COMPU_TAB_REF CHRCTL_STMONEXTD_SC_Compu /end COMPU_METHOD
/begin COMPU_VTAB CHRCTL_STMONEXTD_SC_Compu "" TAB_VERB 2 0 "False" 1 "True" /end COMPU_VTAB
/begin COMPU_METHOD CHRCTL_VAR_SY_Compu "" TAB_VERB "%6.3" "" COMPU_TAB_REF CHRCTL_VAR_SY_Compu /end COMPU_METHOD
/begin COMPU_VTAB CHRCTL_VAR_SY_Compu "" TAB_VERB 57 0 "kein Kundenbezug" 1 "DAI" 3 "VWW" 4 "POR" 5 "AUD" 6 "OPE" 9 "FIA" 11 "BMW" 14 "PSA" 15 "REN" 17 "ALF" 18 "SAB" 19 "VOL" 20 "NIS" 21 "GMU" 22 "FOR" 26 "IMJ" 36 "MAN" 51 "SEA" 53 "CHR" 54 "JAG" 55 "ROL" 69 "FER" 72 "TOY" 123 "MIT" 147 "HYU" 159 "HON" 160 "MAZ" 183 "CU" 190 "LRG" 204 "VVW" 214 "AVT" 242 "Iveco" 243 "DMC" 248 "SUZ" 267 "SSANGYONG" 270 "KEF" 289 "AMG" 308 "TAT" 319 "MVM" 327 "OTOSAN" 328 "Mahindra" 385 "UAES" 578 "AL" 590 "Scania" 609 "Deutz" 760 "WEICHAI" 788 "Saic_motors" 828 "RBCD" 898 "MFTBC" 936 "Anhui_Quanchai" 944 "DOOSAN Infracore" 966 "International" 984 "FAW - Wuxi" 999 "ALL" 2887 "NONOX" 9454 "Fuso" /end COMPU_VTAB
/begin COMPU_METHOD CHRGCTRLVLVSWTCAMSFTAG_SC_Compu "" TAB_VERB "%6.3" "" COMPU_TAB_REF CHRGCTRLVLVSWTCAMSFTAG_SC_Compu /end COMPU_METHOD
/begin COMPU_VTAB CHRGCTRLVLVSWTCAMSFTAG_SC_Compu "" TAB_VERB 2 0 "Desired_cam_angle" 1 "Steady_state_cam_angle" /end COMPU_VTAB
/begin COMPU_METHOD CHRGEXCHMDLFSTCALCN_SC_Compu "" TAB_VERB "%6.3" "" COMPU_TAB_REF CHRGEXCHMDLFSTCALCN_SC_Compu /end COMPU_METHOD
/begin COMPU_VTAB CHRGEXCHMDLFSTCALCN_SC_Compu "" TAB_VERB 2 0 "False" 1 "True" /end COMPU_VTAB
/begin COMPU_METHOD CHRGEXCHMDLPROCCALCN_SC_Compu "" TAB_VERB "%6.3" "" COMPU_TAB_REF CHRGEXCHMDLPROCCALCN_SC_Compu /end COMPU_METHOD
/begin COMPU_VTAB CHRGEXCHMDLPROCCALCN_SC_Compu "" TAB_VERB 3 0 "default" 1 "10ms" 2 "synchro" /end COMPU_VTAB
/begin COMPU_METHOD CHRGGOVRBASP_SC_Compu "" TAB_VERB "%6.3" "" COMPU_TAB_REF CHRGGOVRBASP_SC_Compu /end COMPU_METHOD
/begin COMPU_VTAB CHRGGOVRBASP_SC_Compu "" TAB_VERB 2 0 "0" 1 "1" /end COMPU_VTAB
/begin COMPU_METHOD CHRGPRDCUSEAGCAMSFTPRDC_SC_Compu "" TAB_VERB "%6.3" "" COMPU_TAB_REF CHRGPRDCUSEAGCAMSFTPRDC_SC_Compu /end COMPU_METHOD
/begin COMPU_VTAB CHRGPRDCUSEAGCAMSFTPRDC_SC_Compu "" TAB_VERB 2 0 "False" 1 "True" /end COMPU_VTAB
/begin COMPU_METHOD CHRSET_VAR_SY_Compu "" TAB_VERB "%6.3" "" COMPU_TAB_REF CHRSET_VAR_SY_Compu /end COMPU_METHOD
/begin COMPU_VTAB CHRSET_VAR_SY_Compu "" TAB_VERB 57 0 "kein Kundenbezug" 1 "DAI" 3 "VWW" 4 "POR" 5 "AUD" 6 "OPE" 9 "FIA" 11 "BMW" 14 "PSA" 15 "REN" 17 "ALF" 18 "SAB" 19 "VOL" 20 "NIS" 21 "GMU" 22 "FOR" 26 "IMJ" 36 "MAN" 51 "SEA" 53 "CHR" 54 "JAG" 55 "ROL" 69 "FER" 72 "TOY" 123 "MIT" 147 "HYU" 159 "HON" 160 "MAZ" 183 "CU" 190 "LRG" 204 "VVW" 214 "AVT" 242 "Iveco" 243 "DMC" 248 "SUZ" 267 "SSANGYONG" 270 "KEF" 289 "AMG" 308 "TAT" 319 "MVM" 327 "OTOSAN" 328 "MM" 385 "UAES" 590 "Scania" 609 "Deutz" 720 "Greatwall" 745 "JMC Ford" 788 "Saic Motor" 828 "RBCD" 898 "MFTBC" 936 "Anhui_Quanchai" 944 "DOOSAN Infracore" 984 "FAW - Wuxi" 999 "ALL" 2887 "Nonox" 9454 "Fuso" 9707 "Hatz" /end COMPU_VTAB
/begin COMPU_METHOD CIB_AFIMVIRTDFCOPTN_SC_Compu "" TAB_VERB "%6.3" "" COMPU_TAB_REF CIB_AFIMVIRTDFCOPTN_SC_Compu /end COMPU_METHOD
/begin COMPU_VTAB CIB_AFIMVIRTDFCOPTN_SC_Compu "" TAB_VERB 4 0 "NO_INHIBIT" 1 "INHIBIT_BY_DAFIM" 2 "INHIBIT_BY_DAFIMRAW" 3 "INHIBIT_ALL" /end COMPU_VTAB
/begin COMPU_METHOD CILCN_DPIADPN_SC_Compu "" TAB_VERB "%6.3" "" COMPU_TAB_REF CILCN_DPIADPN_SC_Compu /end COMPU_METHOD
/begin COMPU_VTAB CILCN_DPIADPN_SC_Compu "" TAB_VERB 2 0 "Disabled" 1 "Cyl_Lam_Imbal" /end COMPU_VTAB
/begin COMPU_METHOD CILCN_SELNSEGPOSN_SC_Compu "" TAB_VERB "%6.3" "" COMPU_TAB_REF CILCN_SELNSEGPOSN_SC_Compu /end COMPU_METHOD
/begin COMPU_VTAB CILCN_SELNSEGPOSN_SC_Compu "" TAB_VERB 3 1 "CMNSEGPOSN" 2 "SEPSEGPOSN" 3 "SEPSEGPOSNWITHSEGADPN" /end COMPU_VTAB
/begin COMPU_METHOD CIVVL_SY_Compu "" TAB_VERB "%6.3" "" COMPU_TAB_REF CIVVL_SY_Compu /end COMPU_METHOD
/begin COMPU_VTAB CIVVL_SY_Compu "" TAB_VERB 3 0 "NO_CIVVL" 1 "CIVVL_INLET" 2 "CIVVL_OUTLET" /end COMPU_VTAB
/begin COMPU_METHOD CJ135_SC_Compu "" TAB_VERB "%6.3" "" COMPU_TAB_REF CJ135_SC_Compu /end COMPU_METHOD
/begin COMPU_VTAB CJ135_SC_Compu "" TAB_VERB 5 0 "no_CJ135" 1 "one_CJ135" 2 "two_CJ135" 3 "three_CJ135" 4 "four_CJ135" /end COMPU_VTAB
/begin COMPU_METHOD CJ721_SC_Compu "" TAB_VERB "%6.3" "" COMPU_TAB_REF CJ721_SC_Compu /end COMPU_METHOD
/begin COMPU_VTAB CJ721_SC_Compu "" TAB_VERB 2 0 "no_Cj721" 1 "one_Cj721" /end COMPU_VTAB
/begin COMPU_METHOD CJ722_SC_Compu "" TAB_VERB "%6.3" "" COMPU_TAB_REF CJ722_SC_Compu /end COMPU_METHOD
/begin COMPU_VTAB CJ722_SC_Compu "" TAB_VERB 2 0 "no_Cj722" 1 "one_Cj722" /end COMPU_VTAB
/begin COMPU_METHOD CJ930_SY_Compu "" TAB_VERB "%6.3" "" COMPU_TAB_REF CJ930_SY_Compu /end COMPU_METHOD
/begin COMPU_VTAB CJ930_SY_Compu "" TAB_VERB 2 0 "no CJ930" 1 "one CJ930" /end COMPU_VTAB
/begin COMPU_METHOD CJ950_SY_Compu "" TAB_VERB "%6.3" "" COMPU_TAB_REF CJ950_SY_Compu /end COMPU_METHOD
/begin COMPU_VTAB CJ950_SY_Compu "" TAB_VERB 5 0 "NO_CJ950" 1 "1_CJ950" 2 "2_CJ950" 3 "3_CJ950" 4 "4_CJ950" /end COMPU_VTAB
/begin COMPU_METHOD CJ960_SC_Compu "" TAB_VERB "%6.3" "" COMPU_TAB_REF CJ960_SC_Compu /end COMPU_METHOD
/begin COMPU_VTAB CJ960_SC_Compu "" TAB_VERB 11 0 "No CJ960" 1 "1 CJ960" 2 "2 CJ960" 3 "3 CJ960" 4 "4 CJ960" 5 "5 CJ960" 6 "6 CJ960" 7 "7 CJ960" 8 "8 CJ960" 9 "9 CJ960" 10 "10 CJ960" /end COMPU_VTAB
/begin COMPU_METHOD CJ970_SC_Compu "" TAB_VERB "%6.3" "" COMPU_TAB_REF CJ970_SC_Compu /end COMPU_METHOD
/begin COMPU_VTAB CJ970_SC_Compu "" TAB_VERB 6 0 "0" 1 "1" 2 "2" 3 "3" 4 "4" 5 "5" /end COMPU_VTAB
/begin COMPU_METHOD CLTH_ATS_SY_Compu "" TAB_VERB "%6.3" "" COMPU_TAB_REF CLTH_ATS_SY_Compu /end COMPU_METHOD
/begin COMPU_VTAB CLTH_ATS_SY_Compu "" TAB_VERB 2 0 "ATS_Disabled" 1 "ATS_Enabled" /end COMPU_VTAB
/begin COMPU_METHOD CLUINTLCK_SC_Compu "" TAB_VERB "%6.3" "" COMPU_TAB_REF CLUINTLCK_SC_Compu /end COMPU_METHOD
/begin COMPU_VTAB CLUINTLCK_SC_Compu "" TAB_VERB 5 0 "CLUINTLCK_NOINTLCK" 1 "CLUINTLCK_MT" 2 "CLUINTLCK_AT" 3 "CLUINTLCK_ATNOINTLCK" 255 "CLUINTLCK_ALL" /end COMPU_VTAB
/begin COMPU_METHOD CLUSTRTTYP_SC_Compu "" TAB_VERB "%6.3" "" COMPU_TAB_REF CLUSTRTTYP_SC_Compu /end COMPU_METHOD
/begin COMPU_VTAB CLUSTRTTYP_SC_Compu "" TAB_VERB 3 0 "NO_CLU_STRT" 1 "CLU_STRT_SPD" 2 "CLU_STRT_TQ" /end COMPU_VTAB
/begin COMPU_METHOD CMBENGSLFRUN_SY_Compu "" TAB_VERB "%6.3" "" COMPU_TAB_REF CMBENGSLFRUN_SY_Compu /end COMPU_METHOD
/begin COMPU_VTAB CMBENGSLFRUN_SY_Compu "" TAB_VERB 2 0 "False" 1 "True" /end COMPU_VTAB
/begin COMPU_METHOD CmbNoi "" RAT_FUNC "%6.5" "-" COEFFS 0 1024 0 0 0 1 /end COMPU_METHOD
/begin COMPU_METHOD CMBTYP_SC_Compu "" TAB_VERB "%6.3" "" COMPU_TAB_REF CMBTYP_SC_Compu /end COMPU_METHOD
/begin COMPU_VTAB CMBTYP_SC_Compu "" TAB_VERB 2 0 "CMBTYP_DS" 1 "CMBTYP_GS" /end COMPU_VTAB
/begin COMPU_METHOD CMBTYP_SY_Compu "" TAB_VERB "%6.3" "" COMPU_TAB_REF CMBTYP_SY_Compu /end COMPU_METHOD
/begin COMPU_VTAB CMBTYP_SY_Compu "" TAB_VERB 2 0 "CMBTYP_DS" 1 "CMBTYP_GS" /end COMPU_VTAB
/begin COMPU_METHOD Com_aLgtG_Compu "" RAT_FUNC "%6.2" "Mtr_per_sec2" COEFFS 0 208980 5120000 0 0 10000 /end COMPU_METHOD
/begin COMPU_METHOD Com_stSeatBltInfo_COMPU_VERB "" TAB_VERB "%6.3" "" COMPU_TAB_REF Com_stSeatBltInfo_COMPU_VERB /end COMPU_METHOD
/begin COMPU_VTAB Com_stSeatBltInfo_COMPU_VERB "" TAB_VERB 4 0 "UNABLE_TO_CONFIRM" 1 "SEATBELT_NOT_WEARING" 2 "SEATBELT_WEARING" 3 "SEATBELT_BUCKLESW_ERROR" /end COMPU_VTAB
/begin COMPU_METHOD Curr_A "" RAT_FUNC "%6.4" "A" COEFFS 0 100 0 0 0 1 /end COMPU_METHOD
/begin COMPU_METHOD dez "" RAT_FUNC "%6.2" "" COEFFS 0 1 0 0 0 1 /end COMPU_METHOD
/begin COMPU_METHOD dfp_verbal "" TAB_VERB "%6.3" "-" COMPU_TAB_REF dfp_verbal /end COMPU_METHOD
/begin COMPU_VTAB dfp_verbal "" TAB_VERB 59 0 "DFP_AAA" 1 "DFP_AGRE" 2 "DFP_AGRL" 3 "DFP_DK" 4 "DFP_DK1P" 5 "DFP_DK2P" 6 "DFP_DKVS" 7 "DFP_DSS" 8 "DFP_DSU" 9 "DFP_DVEE" 10 "DFP_DVEF" 11 "DFP_DVEFO" 12 "DFP_DVEL" 13 "DFP_DVEN" 14 "DFP_DVER" 15 "DFP_DVEU" 16 "DFP_DVEUB" 17 "DFP_DVEUW" 18 "DFP_DYLSU" 19 "DFP_FP1P" 20 "DFP_FP2P" 21 "DFP_FRA" 22 "DFP_HSH" 23 "DFP_HSHE" 24 "DFP_KAT" 25 "DFP_KPE" 26 "DFP_KS1" 27 "DFP_LASH" 28 "DFP_LLR" 29 "DFP_LLRKH" 30 "DFP_LM" 31 "DFP_LSH" 32 "DFP_LZSR" 33 "DFP_MD" 34 "DFP_ORA" 35 "DFP_PLLSU" 36 "DFP_PS2E" 37 "DFP_PSR" 38 "DFP_PSR1" 39 "DFP_PSRB" 40 "DFP_PSRE" 41 "DFP_PSRP" 42 "DFP_PU" 43 "DFP_PUE" 44 "DFP_PUPL" 45 "DFP_PUR" 46 "DFP_TA" 47 "DFP_TASRCS" 48 "DFP_TASRE" 49 "DFP_TASRPRC" 50 "DFP_TASRR" 51 "DFP_TEVE" 52 "DFP_TM" 53 "DFP_TMCS" 54 "DFP_TME" 55 "DFP_TMP" 56 "DFP_UB" 57 "DFP_VFZ" 58 "DFP_ZZZ" DEFAULT_VALUE "---" /end COMPU_VTAB
/begin COMPU_METHOD EngN "" RAT_FUNC "%6.3" "rpm" COEFFS 0 2 0 0 0 1 /end COMPU_METHOD
/begin COMPU_METHOD EngNGrd "" RAT_FUNC "%6.3" "rpm/s" COEFFS 0 2 0 0 0 1 /end COMPU_METHOD
/begin COMPU_METHOD Fact100 "" RAT_FUNC "%6.4" "-" COEFFS 0 100 0 0 0 1 /end COMPU_METHOD
/begin COMPU_METHOD Fact1000 "" RAT_FUNC "%6.5" "-" COEFFS 0 1000 0 0 0 1 /end COMPU_METHOD
/begin COMPU_METHOD fak_q6p1035Em5 "" RAT_FUNC "%7.6" "-" COEFFS 0 65536 0 0 0 4 /end COMPU_METHOD
/begin COMPU_METHOD fak_ub_b1 "" RAT_FUNC "%6.4" "-" COEFFS 0 256 0 0 0 1 /end COMPU_METHOD
/begin COMPU_METHOD fak_ub_b2 "" RAT_FUNC "%8.5" "-" COEFFS 0 256 0 0 0 2 /end COMPU_METHOD
/begin COMPU_METHOD fak_ub_b4 "" RAT_FUNC "%6.4" "-" COEFFS 0 256 0 0 0 4 /end COMPU_METHOD
/begin COMPU_METHOD fak_uw_b1 "" RAT_FUNC "%7.6" "-" COEFFS 0 65536 0 0 0 1 /end COMPU_METHOD
/begin COMPU_METHOD fak_uw_b16 "" RAT_FUNC "%6.5" "-" COEFFS 0 65536 0 0 0 16 /end COMPU_METHOD
/begin COMPU_METHOD fak_uw_b2 "" RAT_FUNC "%7.6" "-" COEFFS 0 65536 0 0 0 2 /end COMPU_METHOD
/begin COMPU_METHOD fak_uw_b4 "" RAT_FUNC "%7.6" "-" COEFFS 0 65536 0 0 0 4 /end COMPU_METHOD
/begin COMPU_METHOD lu_MEx "" RAT_FUNC "%6.4" "(Umdr./sec)^2" COEFFS 0 140.7374884 0 0 0 1 /end COMPU_METHOD
/begin COMPU_METHOD m_q0p1 "" RAT_FUNC "%6.3" "kg/h" COEFFS 0 10 0 0 0 1 /end COMPU_METHOD
/begin COMPU_METHOD m_uw_b6553p5 "" RAT_FUNC "%6.3" "kg/h" COEFFS 0 1 0 0 0 0.1 /end COMPU_METHOD
/begin COMPU_METHOD nmotd_sw_q0p25 "" RAT_FUNC "%6.3" "1/min" COEFFS 0 1 0 0 0 0.25 /end COMPU_METHOD
/begin COMPU_METHOD nmotg_sb_q100 "" RAT_FUNC "%6.0" "1/min/s" COEFFS 0 1 0 0 0 100 /end COMPU_METHOD
/begin COMPU_METHOD nmot_q0p5 "" RAT_FUNC "%6.3" "1/min" COEFFS 0 2 0 0 0 1 /end COMPU_METHOD
/begin COMPU_METHOD nmot_sw_q0p25 "" RAT_FUNC "%6.3" "1/min" COEFFS 0 1 0 0 0 0.25 /end COMPU_METHOD
/begin COMPU_METHOD nmot_sw_q0p5 "" RAT_FUNC "%6.3" "1/min" COEFFS 0 2 0 0 0 1 /end COMPU_METHOD
/begin COMPU_METHOD nmot_ub_q40 "" RAT_FUNC "%6.1" "1/min" COEFFS 0 1 0 0 0 40 /end COMPU_METHOD
/begin COMPU_METHOD nmot_uw_q0p25 "" RAT_FUNC "%6.3" "1/min" COEFFS 0 1 0 0 0 0.25 /end COMPU_METHOD
/begin COMPU_METHOD OilMlg "" RAT_FUNC "%6.2" "km" COEFFS 0 1 0 0 0 1 /end COMPU_METHOD
/begin COMPU_METHOD OneToOne "" RAT_FUNC "%6.2" "-" COEFFS 0 1 0 0 0 1 /end COMPU_METHOD
/begin COMPU_METHOD Prc "" RAT_FUNC "%6.4" "%" COEFFS 0 81.92 0 0 0 1 /end COMPU_METHOD
/begin COMPU_METHOD Prc_Fact100 "" RAT_FUNC "%6.4" "%" COEFFS 0 100 0 0 0 1 /end COMPU_METHOD
/begin COMPU_METHOD p_q0p039 "" RAT_FUNC "%6.4" "hPa" COEFFS 0 256 0 0 0 10 /end COMPU_METHOD
/begin COMPU_METHOD p_q0p078 "" RAT_FUNC "%6.4" "hPa" COEFFS 0 64 0 0 0 5 /end COMPU_METHOD
/begin COMPU_METHOD p_q10 "" RAT_FUNC "%6.1" "hPa" COEFFS 0 1 0 0 0 10 /end COMPU_METHOD
/begin COMPU_METHOD q0p001_A_s_1 "" RAT_FUNC "%6.5" "As" COEFFS 0 1000 0 0 0 1 /end COMPU_METHOD
/begin COMPU_METHOD q0p01_A_h_1 "" RAT_FUNC "%6.4" "Ah" COEFFS 0 100 0 0 0 1 /end COMPU_METHOD
/begin COMPU_METHOD RBPtCel_Perc_0p5_1 "" RAT_FUNC "%6.3" "%" COEFFS 0 2 0 0 0 1 /end COMPU_METHOD
/begin COMPU_METHOD RBPtCel_q_0p001_1 "" RAT_FUNC "%6.5" "As" COEFFS 0 1000 0 0 0 1 /end COMPU_METHOD
/begin COMPU_METHOD RBPtCel_q_0p125_1 "" RAT_FUNC "%6.3" "Ah" COEFFS 0 8 0 0 0 1 /end COMPU_METHOD
/begin COMPU_METHOD RBPtCel_r_0p00001_1 "" RAT_FUNC "%8.7" "Ohm" COEFFS 0 100000 0 0 0 1 /end COMPU_METHOD
/begin COMPU_METHOD rel_q0p02344 "" RAT_FUNC "%6.4" "%" COEFFS 0 32 0 0 0 0.75 /end COMPU_METHOD
/begin COMPU_METHOD rel_ub_b127p5 "" RAT_FUNC "%6.3" "%" COEFFS 0 2 0 0 0 1 /end COMPU_METHOD
/begin COMPU_METHOD rel_uw_b100 "" RAT_FUNC "%6.4" "%" COEFFS 0 65536 0 0 0 100 /end COMPU_METHOD
/begin COMPU_METHOD rel_uw_b200 "" RAT_FUNC "%6.4" "%" COEFFS 0 65536 0 0 0 200 /end COMPU_METHOD
/begin COMPU_METHOD rel_uw_q0p0234 "" RAT_FUNC "%6.4" "%" COEFFS 0 32 0 0 0 0.75 /end COMPU_METHOD
/begin COMPU_METHOD Resist_mOhm_q0p01 "" RAT_FUNC "%6.4" "mOhm" COEFFS 0 100 0 0 0 1 /end COMPU_METHOD
/begin COMPU_METHOD SCR_TEMP_CELS_float "" RAT_FUNC "%6.2" "deg C" COEFFS 0 1 0 0 0 1 /end COMPU_METHOD
/begin COMPU_METHOD spg_q0p0625_V "" RAT_FUNC "%6.4" "V" COEFFS 0 16 0 0 0 1 /end COMPU_METHOD
/begin COMPU_METHOD t100msxs_ub_b25p5 "" RAT_FUNC "%6.3" "s" COEFFS 0 1 0 0 0 0.1 /end COMPU_METHOD
/begin COMPU_METHOD t100msxs_uw_b6553p5 "" RAT_FUNC "%6.3" "s" COEFFS 0 1 0 0 0 0.1 /end COMPU_METHOD
/begin COMPU_METHOD t1sxs_uw_q1 "" RAT_FUNC "%6.2" "s" COEFFS 0 1 0 0 0 1 /end COMPU_METHOD
/begin COMPU_METHOD Temp_Cels "" RAT_FUNC "%6.1" "deg C" COEFFS 0 10 2731.4 0 0 1 /end COMPU_METHOD
/begin COMPU_METHOD temp_q0p0234_o273 "" RAT_FUNC "%6.1" "Grad C" COEFFS 0 1 273.15 0 0 0.0234375 /end COMPU_METHOD
/begin COMPU_METHOD temp_q0p1_K "" RAT_FUNC "%6.3" "K" COEFFS 0 10 0 0 0 1 /end COMPU_METHOD
/begin COMPU_METHOD temp_q0p1_o273 "" RAT_FUNC "%6.1" "Grad C" COEFFS 0 10 2731.4 0 0 1 /end COMPU_METHOD
/begin COMPU_METHOD temp_q0p75_om48 "" RAT_FUNC "%6.2" "Grad C" COEFFS 0 4 192 0 0 3 /end COMPU_METHOD
/begin COMPU_METHOD temp_ub_q0p75_o48 "" RAT_FUNC "%6.2" "Grad C" COEFFS 0 1 48 0 0 0.75 /end COMPU_METHOD
/begin COMPU_METHOD TimeDelay_s "" RAT_FUNC "%6.1" "s" COEFFS 0 0 1 0 0.00023283064365387 0 /end COMPU_METHOD
/begin COMPU_METHOD TimeRed "" RAT_FUNC "%6.3" "s" COEFFS 0 6.25 0 0 0 1 /end COMPU_METHOD
/begin COMPU_METHOD Time_Dt "" RAT_FUNC "%9.8" "s" COEFFS 0 1000000 0 0 0 1 /end COMPU_METHOD
/begin COMPU_METHOD Time_ms "" RAT_FUNC "%6.1" "ms" COEFFS 0 0.1 0 0 0 1 /end COMPU_METHOD
/begin COMPU_METHOD Time_s "" RAT_FUNC "%6.4" "s" COEFFS 0 100 0 0 0 1 /end COMPU_METHOD
/begin COMPU_METHOD Time_sec_1 "" RAT_FUNC "%6.3" "s" COEFFS 0 10 0 0 0 1 /end COMPU_METHOD
/begin COMPU_METHOD t_q0p01 "" RAT_FUNC "%6.4" "s" COEFFS 0 100 0 0 0 1 /end COMPU_METHOD
/begin COMPU_METHOD t_q0p04 "" RAT_FUNC "%6.4" "s" COEFFS 0 100 0 0 0 4 /end COMPU_METHOD
/begin COMPU_METHOD t_q0p1 "" RAT_FUNC "%6.3" "s" COEFFS 0 10 0 0 0 1 /end COMPU_METHOD
/begin COMPU_METHOD t_q0p2 "" RAT_FUNC "%6.3" "s" COEFFS 0 10 0 0 0 2 /end COMPU_METHOD
/begin COMPU_METHOD t_q1 "" RAT_FUNC "%6.2" "s" COEFFS 0 1 0 0 0 1 /end COMPU_METHOD
/begin COMPU_METHOD t_q4_s "" RAT_FUNC "%6.2" "s" COEFFS 0 1 0 0 0 4 /end COMPU_METHOD
/begin COMPU_METHOD U_mV_q0p9765625_COMPU "" RAT_FUNC "%6.2" "mV" COEFFS 0 1.024 0 0 0 1 /end COMPU_METHOD
/begin COMPU_METHOD Vel "" RAT_FUNC "%6.4" "km/h" COEFFS 0 100 0 0 0 1 /end COMPU_METHOD
/begin COMPU_METHOD vel_q0p01 "" RAT_FUNC "%6.4" "km/h" COEFFS 0 100 0 0 0 1 /end COMPU_METHOD
/begin COMPU_METHOD Volt_Batt "" RAT_FUNC "%6.1" "mV" COEFFS 0 0.05 0 0 0 1 /end COMPU_METHOD
/begin COMPU_METHOD YawRate_q0p2441_om125 "" RAT_FUNC "%6.3" "Deg/s" COEFFS 0 1023 127875 0 0 249.7559 /end COMPU_METHOD
/begin COMPU_METHOD zk100msxs_uw_b6553p6 "" RAT_FUNC "%6.1" "s" COEFFS 0 0 65536 0 10 0 /end COMPU_METHOD
/begin COMPU_METHOD zw_q2p9297Em3_deg_KW "" RAT_FUNC "%6.4" "deg KW" COEFFS 0 1024 0 0 0 3 /end COMPU_METHOD
/begin RECORD_LAYOUT RB_Axis_S16 NO_AXIS_PTS_X 1 SWORD AXIS_PTS_X 2 SWORD INDEX_INCR DIRECT /end RECORD_LAYOUT
/begin RECORD_LAYOUT RB_Axis_S8 NO_AXIS_PTS_X 1 SBYTE AXIS_PTS_X 2 SBYTE INDEX_INCR DIRECT /end RECORD_LAYOUT
/begin RECORD_LAYOUT RB_Axis_U16 NO_AXIS_PTS_X 1 UWORD AXIS_PTS_X 2 UWORD INDEX_INCR DIRECT /end RECORD_LAYOUT
/begin RECORD_LAYOUT RB_CurveGroup_S8 FNC_VALUES 1 SBYTE COLUMN_DIR DIRECT /end RECORD_LAYOUT
/begin RECORD_LAYOUT RB_CurveGroup_U16 FNC_VALUES 1 UWORD COLUMN_DIR DIRECT /end RECORD_LAYOUT
/begin RECORD_LAYOUT RB_CurveGroup_U8 FNC_VALUES 1 UBYTE COLUMN_DIR DIRECT /end RECORD_LAYOUT
/begin RECORD_LAYOUT RB_Curve_S16_S16 NO_AXIS_PTS_X 1 SWORD AXIS_PTS_X 2 SWORD INDEX_INCR DIRECT FNC_VALUES 3 SWORD COLUMN_DIR DIRECT /end RECORD_LAYOUT
/begin RECORD_LAYOUT RB_Curve_S16_U16_Static NO_AXIS_PTS_X 1 SWORD AXIS_PTS_X 2 SWORD INDEX_INCR DIRECT FNC_VALUES 3 UWORD COLUMN_DIR DIRECT STATIC_RECORD_LAYOUT /end RECORD_LAYOUT
/begin RECORD_LAYOUT RB_Curve_S16_U8_Static NO_AXIS_PTS_X 1 SWORD AXIS_PTS_X 2 SWORD INDEX_INCR DIRECT FNC_VALUES 3 UBYTE COLUMN_DIR DIRECT STATIC_RECORD_LAYOUT /end RECORD_LAYOUT
/begin RECORD_LAYOUT RB_Curve_S8_S8 NO_AXIS_PTS_X 1 SBYTE AXIS_PTS_X 2 SBYTE INDEX_INCR DIRECT FNC_VALUES 3 SBYTE COLUMN_DIR DIRECT /end RECORD_LAYOUT
/begin RECORD_LAYOUT RB_Curve_U16_S16_Static NO_AXIS_PTS_X 1 UWORD AXIS_PTS_X 2 UWORD INDEX_INCR DIRECT FNC_VALUES 3 SWORD COLUMN_DIR DIRECT STATIC_RECORD_LAYOUT /end RECORD_LAYOUT
/begin RECORD_LAYOUT RB_Curve_U16_U16 NO_AXIS_PTS_X 1 UWORD AXIS_PTS_X 2 UWORD INDEX_INCR DIRECT FNC_VALUES 3 UWORD COLUMN_DIR DIRECT /end RECORD_LAYOUT
/begin RECORD_LAYOUT RB_Curve_U16_U8_Static NO_AXIS_PTS_X 1 UWORD AXIS_PTS_X 2 UWORD INDEX_INCR DIRECT FNC_VALUES 3 UBYTE COLUMN_DIR DIRECT STATIC_RECORD_LAYOUT /end RECORD_LAYOUT
/begin RECORD_LAYOUT RB_FixCurve_S8_S8 FNC_VALUES 1 SBYTE COLUMN_DIR DIRECT /end RECORD_LAYOUT
/begin RECORD_LAYOUT RB_MapGroup_S16 FNC_VALUES 1 SWORD COLUMN_DIR DIRECT /end RECORD_LAYOUT
/begin RECORD_LAYOUT RB_MapGroup_S8 FNC_VALUES 1 SBYTE COLUMN_DIR DIRECT /end RECORD_LAYOUT
/begin RECORD_LAYOUT RB_MapGroup_U16 FNC_VALUES 1 UWORD COLUMN_DIR DIRECT /end RECORD_LAYOUT
/begin RECORD_LAYOUT RB_MapGroup_U8 FNC_VALUES 1 UBYTE COLUMN_DIR DIRECT /end RECORD_LAYOUT
/begin RECORD_LAYOUT RB_Map_S16S16_S16 NO_AXIS_PTS_X 1 SWORD NO_AXIS_PTS_Y 2 SWORD AXIS_PTS_X 3 SWORD INDEX_INCR DIRECT AXIS_PTS_Y 4 SWORD INDEX_INCR DIRECT FNC_VALUES 5 SWORD COLUMN_DIR DIRECT /end RECORD_LAYOUT
/begin RECORD_LAYOUT RB_Map_S16S16_U8 NO_AXIS_PTS_X 1 SWORD NO_AXIS_PTS_Y 2 SWORD AXIS_PTS_X 3 SWORD INDEX_INCR DIRECT AXIS_PTS_Y 4 SWORD INDEX_INCR DIRECT FNC_VALUES 5 UBYTE COLUMN_DIR DIRECT /end RECORD_LAYOUT
/begin RECORD_LAYOUT RB_Map_S16S8_S16 NO_AXIS_PTS_X 1 SWORD NO_AXIS_PTS_Y 2 SWORD AXIS_PTS_X 3 SWORD INDEX_INCR DIRECT AXIS_PTS_Y 4 SBYTE INDEX_INCR DIRECT FNC_VALUES 5 SWORD COLUMN_DIR DIRECT /end RECORD_LAYOUT
/begin RECORD_LAYOUT RB_Map_S16U16_U8 NO_AXIS_PTS_X 1 SWORD NO_AXIS_PTS_Y 2 SWORD AXIS_PTS_X 3 SWORD INDEX_INCR DIRECT AXIS_PTS_Y 4 UWORD INDEX_INCR DIRECT FNC_VALUES 5 UBYTE ROW_DIR DIRECT /end RECORD_LAYOUT
/begin RECORD_LAYOUT RB_Map_U16U16_U16 NO_AXIS_PTS_X 1 UWORD NO_AXIS_PTS_Y 2 UWORD AXIS_PTS_X 3 UWORD INDEX_INCR DIRECT AXIS_PTS_Y 4 UWORD INDEX_INCR DIRECT FNC_VALUES 5 UWORD COLUMN_DIR DIRECT /end RECORD_LAYOUT
/begin RECORD_LAYOUT RB_Map_U16U16_U8 NO_AXIS_PTS_X 1 UWORD NO_AXIS_PTS_Y 2 UWORD AXIS_PTS_X 3 UWORD INDEX_INCR DIRECT AXIS_PTS_Y 4 UWORD INDEX_INCR DIRECT FNC_VALUES 5 UBYTE COLUMN_DIR DIRECT /end RECORD_LAYOUT
/begin RECORD_LAYOUT RB_Map_U8U8_U8 NO_AXIS_PTS_X 1 UBYTE NO_AXIS_PTS_Y 2 UBYTE AXIS_PTS_X 3 UBYTE INDEX_INCR DIRECT AXIS_PTS_Y 4 UBYTE INDEX_INCR DIRECT FNC_VALUES 5 UBYTE COLUMN_DIR DIRECT /end RECORD_LAYOUT
/begin RECORD_LAYOUT RB_ValA_Wu16 FNC_VALUES 1 UWORD COLUMN_DIR DIRECT /end RECORD_LAYOUT
/begin RECORD_LAYOUT RB_Val_Wboolean FNC_VALUES 1 UBYTE COLUMN_DIR DIRECT /end RECORD_LAYOUT
/begin RECORD_LAYOUT RB_Val_Ws16 FNC_VALUES 1 SWORD COLUMN_DIR DIRECT /end RECORD_LAYOUT
/begin RECORD_LAYOUT RB_Val_Ws32 FNC_VALUES 1 SLONG COLUMN_DIR DIRECT /end RECORD_LAYOUT
/begin RECORD_LAYOUT RB_Val_Wu16 FNC_VALUES 1 UWORD COLUMN_DIR DIRECT /end RECORD_LAYOUT
/begin RECORD_LAYOUT RB_Val_Wu32 FNC_VALUES 1 ULONG COLUMN_DIR DIRECT /end RECORD_LAYOUT
/begin RECORD_LAYOUT RB_Val_Wu8 FNC_VALUES 1 UBYTE COLUMN_DIR DIRECT /end RECORD_LAYOUT
/begin RECORD_LAYOUT Val_Wu16 FNC_VALUES 1 UWORD COLUMN_DIR DIRECT /end RECORD_LAYOUT
/begin RECORD_LAYOUT Val_Wu8 FNC_VALUES 1 UBYTE COLUMN_DIR DIRECT /end RECORD_LAYOUT
/end MODULE
/end PROJECT
