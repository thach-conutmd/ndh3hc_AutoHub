ASAP2_VERSION 1 60
/begin PROJECT MG1CA020 "MG1CA020"
/begin HEADER "" VERSION "MG1CA020_6SAY_V011_TPROT" PROJECT_NO MG1CA020 /end HEADER
/begin MODULE DIM ""
/begin MOD_COMMON "" BYTE_ORDER MSB_LAST ALIGNMENT_BYTE 1 ALIGNMENT_WORD 2 ALIGNMENT_LONG 4 ALIGNMENT_INT64 4 ALIGNMENT_FLOAT32_IEEE 4 ALIGNMENT_FLOAT64_IEEE 4 DATA_SIZE 32 /end MOD_COMMON
/begin CHARACTERISTIC CatH_TempSelnCat1B1_I.ExhMgT_idxBrick1Cat_C "class instance for catalyst heating temperature selection for catalyst 1 bank1 / index first brick catalyst 1 for catalyst heating calibration" VALUE 0x8051F640 RB_Val_Wu8 255.0 OneToOne 0.00 255.0 FORMAT "%5.1" /end CHARACTERISTIC
/begin CHARACTERISTIC CatH_TempSelnCat1B1_I.ExhMgT_idxBrick2Cat_C "class instance for catalyst heating temperature selection for catalyst 1 bank1 / index second brick catalyst 1 for catalyst heating calibration" VALUE 0x8051F641 RB_Val_Wu8 255.0 OneToOne 0.00 255.0 FORMAT "%5.1" /end CHARACTERISTIC
/begin CHARACTERISTIC CatH_TempSelnCat1B1_I.ExhMgT_idxBrick3Cat_C "class instance for catalyst heating temperature selection for catalyst 1 bank1 / index third brick catalyst 1 for catalyst heating calibration" VALUE 0x8051F642 RB_Val_Wu8 255.0 OneToOne 0.00 255.0 FORMAT "%5.1" /end CHARACTERISTIC
/begin CHARACTERISTIC CatH_TempSelnCat2B1_I.ExhMgT_idxBrick1Cat_C "class instance for catalyst heating temperature selection for catalyst 2 bank1 / index first brick catalyst 2 for catalyst heating calibration" VALUE 0x8051F648 RB_Val_Wu8 255.0 OneToOne 0.00 255.0 FORMAT "%5.1" /end CHARACTERISTIC
/begin CHARACTERISTIC CatH_TempSelnCat2B1_I.ExhMgT_idxBrick2Cat_C "class instance for catalyst heating temperature selection for catalyst 2 bank1 / index second brick catalyst 2 for catalyst heating calibration" VALUE 0x8051F649 RB_Val_Wu8 255.0 OneToOne 0.00 255.0 FORMAT "%5.1" /end CHARACTERISTIC
/begin CHARACTERISTIC CatH_TempSelnCat2B1_I.ExhMgT_idxBrick3Cat_C "class instance for catalyst heating temperature selection for catalyst 2 bank1 / index third brick catalyst 2 for catalyst heating calibration" VALUE 0x8051F64A RB_Val_Wu8 255.0 OneToOne 0.00 255.0 FORMAT "%5.1" /end CHARACTERISTIC
/begin CHARACTERISTIC CWESSTT "code word setting variables B_vbemg and B_wks" VALUE 0x8051D14E RB_Val_Wu8 255.0 dez 0.00 255.0 FORMAT "%5.1" /end CHARACTERISTIC
/begin CHARACTERISTIC CWESUK "Code word transient compensation" VALUE 0x8051D5E0 RB_Val_Wu8 255.0 dez 0.00 255.0 FORMAT "%5.1" /end CHARACTERISTIC
/begin CHARACTERISTIC CWESWE "Codeword %CWESWE configuration" VALUE 0x8051E2AE RB_Val_Wu8 255.0 dez 0.00 255.0 FORMAT "%5.1" /end CHARACTERISTIC
/begin CHARACTERISTIC DN10BURN "minimum engine-speed difference for acckn. combustion" VALUE 0x8051D150 RB_Val_Ws16 16383.75 nmotd_sw_q0p25 -8192.000 8191.750 FORMAT "%8.3" /end CHARACTERISTIC
/begin CHARACTERISTIC DUKK "threshold for short term portion" VALUE 0x8051D5E2 RB_Val_Ws16 3071.953 rel_sw_q0p0468 -1536.000 1535.953 FORMAT "%8.3" /end CHARACTERISTIC
/begin CHARACTERISTIC DWEEMX "max. change of ""angle end of injection"" per ignition" VALUE 0x8051E0F2 RB_Val_Wu8 1530. kw_q6 0.00 1530. FORMAT "%5.0" /end CHARACTERISTIC
/begin AXIS_PTS EngStrt_cntrInjLim12_AX "Distribution for the limited injection counter anztib_w" 0x8051CAF2 anztib_w_msg RB_Axis_U16 65535.00 dez 12 0.00 65535.00 FORMAT "%8.2" DEPOSIT ABSOLUTE /end AXIS_PTS
/begin CHARACTERISTIC EngStrt_facAftStrtCorrnStrtAdapAirChrg "afterstart correction with start adaptation and relativ air charge" MAP 0x8051CB0C RB_MapGroup_U8 3.984 fak_ub_b4 0.00 3.984 FORMAT "%5.3"
 /begin AXIS_DESCR COM_AXIS kstaa_msg fak_ub_b2 6 0.00 1.992188 FORMAT "%8.6" AXIS_PTS_REF EngStrt_facStrtMixAdap6_AX /end AXIS_DESCR
 /begin AXIS_DESCR COM_AXIS rlp_w_msg rel_uw_q0p0234 6 0.00 1535.977 FORMAT "%8.3" AXIS_PTS_REF EngStrt_mRelAirChPred6_AX /end AXIS_DESCR
/end CHARACTERISTIC
/begin CHARACTERISTIC EngStrt_facAftStrtEnchmt "weighting of afterstart enrichment" MAP 0x8051CB30 RB_MapGroup_U8 1.992188 fak_ub_b2 0.00 1.992188 FORMAT "%8.6"
 /begin AXIS_DESCR COM_AXIS EngStrt_tEngTStrtLoc temp_ub_q0p75_o48 8 -48.0 143.3 FORMAT "%5.1" AXIS_PTS_REF EngStrt_tEngStrt8_AX /end AXIS_DESCR
 /begin AXIS_DESCR COM_AXIS rlp_w_msg rel_uw_q0p0234 6 0.00 1535.977 FORMAT "%8.3" AXIS_PTS_REF EngStrt_mRelAirChPred6_AX /end AXIS_DESCR
/end CHARACTERISTIC
/begin CHARACTERISTIC EngStrt_facAftStrtEnchmtVlvLft "weighting of afterstart enrichment for SY_HEV0" MAP 0x8051CB60 RB_MapGroup_U8 1.992188 fak_ub_b2 0.00 1.992188 FORMAT "%8.6"
 /begin AXIS_DESCR COM_AXIS EngStrt_tEngTStrtLoc temp_ub_q0p75_o48 8 -48.0 143.3 FORMAT "%5.1" AXIS_PTS_REF EngStrt_tEngStrt8_AX /end AXIS_DESCR
 /begin AXIS_DESCR COM_AXIS rlp_w_msg rel_uw_q0p0234 6 0.00 1535.977 FORMAT "%8.3" AXIS_PTS_REF EngStrt_mRelAirChPred6_AX /end AXIS_DESCR
/end CHARACTERISTIC
/begin AXIS_PTS EngStrt_facAltiCorrn4_AX "Distribution for factor altitude" 0x8051CB90 EngStrt_facAltiCorrnLoc RB_Axis_U8 3.984 fak_ub_b4 4 0.00 3.984 FORMAT "%5.3" DEPOSIT ABSOLUTE /end AXIS_PTS
/begin CHARACTERISTIC EngStrt_facEngStrtAlti_M "weighting of engine start-factor depending of altitude" MAP 0x8051D152 RB_Map_S16U16_U8 1.992188 fak_ub_b2 0.00 1.992188 FORMAT "%8.6"
 /begin AXIS_DESCR STD_AXIS CEngDsT_tStrt Temp_Cels 6 -3549.940 3003.560 FORMAT "%8.3" DEPOSIT ABSOLUTE /end AXIS_DESCR
 /begin AXIS_DESCR STD_AXIS PEnv_facCorrAlti fak_uw_b4 4 0.00 3.999939 FORMAT "%8.6" DEPOSIT ABSOLUTE /end AXIS_DESCR
/end CHARACTERISTIC
/begin AXIS_PTS EngStrt_facStrtMixAdap6_AX "Distribution for the start adaption factor kstaa" 0x8051CB95 kstaa_msg RB_Axis_U8 1.992188 fak_ub_b2 6 0.00 1.992188 FORMAT "%8.6" DEPOSIT ABSOLUTE /end AXIS_PTS
/begin CHARACTERISTIC EngStrt_facWrmLoadDpdtFrctVlvLft "map warm-up factor load dependent fraction for SY_VHE" MAP 0x8051CB9C RB_MapGroup_U8 1.992188 fak_ub_b2 0.00 1.992188 FORMAT "%8.6"
 /begin AXIS_DESCR COM_AXIS EngStrt_tEngTStrtLoc temp_ub_q0p75_o48 8 -48.0 143.3 FORMAT "%5.1" AXIS_PTS_REF EngStrt_tEngStrt8_AX /end AXIS_DESCR
 /begin AXIS_DESCR COM_AXIS rlp_w_msg rel_uw_q0p0234 6 0.00 1535.977 FORMAT "%8.3" AXIS_PTS_REF EngStrt_mRelAirChPred6_AX /end AXIS_DESCR
/end CHARACTERISTIC
/begin CHARACTERISTIC EngStrt_facWrmUpLoadDpdtFrct "map warm-up factor load dependent fraction" MAP 0x8051CBCC RB_MapGroup_U8 1.992188 fak_ub_b2 0.00 1.992188 FORMAT "%8.6"
 /begin AXIS_DESCR COM_AXIS EngStrt_tEngTStrtLoc temp_ub_q0p75_o48 8 -48.0 143.3 FORMAT "%5.1" AXIS_PTS_REF EngStrt_tEngStrt8_AX /end AXIS_DESCR
 /begin AXIS_DESCR COM_AXIS rlp_w_msg rel_uw_q0p0234 6 0.00 1535.977 FORMAT "%8.3" AXIS_PTS_REF EngStrt_mRelAirChPred6_AX /end AXIS_DESCR
/end CHARACTERISTIC
/begin AXIS_PTS EngStrt_mAirMfIntegEngStrt6_AX "Distribution for integrated air massflow since end of start" 0x8051CBFC ExhMod_mAirMfIntegEngStrt RB_Axis_U16 23.30133 m_uw_b23p3 6 0.00 23.30133 FORMAT "%8.5" DEPOSIT ABSOLUTE /end AXIS_PTS
/begin AXIS_PTS EngStrt_mRelAirCh12_AX "Distribution for warmup factor" 0x8051CC0A rl_w_msg RB_Axis_U16 1535.977 rel_uw_q0p0234 12 0.00 1535.977 FORMAT "%8.3" DEPOSIT ABSOLUTE /end AXIS_PTS
/begin AXIS_PTS EngStrt_mRelAirCh4_AX "datapoint distribution relative charge, 4 datapoints" 0x8051CC24 rl_w_msg RB_Axis_U16 1535.977 rel_uw_q0p0234 4 0.00 1535.977 FORMAT "%8.3" DEPOSIT ABSOLUTE /end AXIS_PTS
/begin AXIS_PTS EngStrt_mRelAirChPred6_AX "Distribution for relative air charge prediction" 0x8051CC2E rlp_w_msg RB_Axis_U16 1535.977 rel_uw_q0p0234 6 0.00 1535.977 FORMAT "%8.3" DEPOSIT ABSOLUTE /end AXIS_PTS
/begin AXIS_PTS EngStrt_nEngLoRes12_AX "Distribution for the engine speed nmot" 0x8051CC3C EngStrt_nLoReslEngSpdLocal RB_Axis_U8 10200. nmot_ub_q40 12 0.00 10200. FORMAT "%5.0" DEPOSIT ABSOLUTE /end AXIS_PTS
/begin AXIS_PTS EngStrt_nEngLoRes16_AX "datapoint distribution engine speed, 16 datapoints" 0x8051CC49 EngStrt_nLoReslEngSpdLocal RB_Axis_U8 10200. nmot_ub_q40 16 0.00 10200. FORMAT "%5.0" DEPOSIT ABSOLUTE /end AXIS_PTS
/begin AXIS_PTS EngStrt_nEngLoRes6_AX "Distribution for engine speed" 0x8051CC5A EngStrt_nLoReslEngSpdLocal RB_Axis_U8 10200. nmot_ub_q40 6 0.00 10200. FORMAT "%5.0" DEPOSIT ABSOLUTE /end AXIS_PTS
/begin CHARACTERISTIC EngStrt_stCfgShDwnTi "code word to define the used configuration of shut down time" VALUE 0x8051D182 RB_Val_Wu8 255.0 dez 0.00 255.0 FORMAT "%5.1" /end CHARACTERISTIC
/begin AXIS_PTS EngStrt_tEng12_AX "Distribution for the engine coolant temperature tmot" 0x8051CC61 EngStrt_tEngTLoc RB_Axis_U8 191.3 temp_ub_q0p75_o48 12 -48.0 143.3 FORMAT "%5.1" DEPOSIT ABSOLUTE /end AXIS_PTS
/begin AXIS_PTS EngStrt_tEngStrt12_AX "Distribution for engine coolant temperature at start" 0x8051CC6E EngStrt_tEngTStrtLoc RB_Axis_U8 191.3 temp_ub_q0p75_o48 12 -48.0 143.3 FORMAT "%5.1" DEPOSIT ABSOLUTE /end AXIS_PTS
/begin AXIS_PTS EngStrt_tEngStrt8_AX "Distribution for engine coolant temperature at start" 0x8051CC7B EngStrt_tEngTStrtLoc RB_Axis_U8 191.3 temp_ub_q0p75_o48 8 -48.0 143.3 FORMAT "%5.1" DEPOSIT ABSOLUTE /end AXIS_PTS
/begin AXIS_PTS EngStrt_tIntkAir6_AX "Distribution for the air temperature in the intake manifold" 0x8051CC84 tans_msg RB_Axis_U8 191.3 temp_ub_q0p75_o48 6 -48.0 143.3 FORMAT "%5.1" DEPOSIT ABSOLUTE /end AXIS_PTS
/begin CHARACTERISTIC Etc_MaxReqTO_C "Maximum time between 2 engine test requests. Value is applicated on 10ms time base (Value of 500 means 5s), but the smallest possible resolution is 100ms. Active tests will be stopped if this times has run out." VALUE 0x8053AD46 Val_Wu16 32767.00 OneToOne 0.00 32767.00 FORMAT "%8.2" EXTENDED_LIMITS 0.00 65535.00 /end CHARACTERISTIC
/begin CHARACTERISTIC ExhCo_swtTSelnCatHeatgGpf_C "An application switch to select either Sensor or modelled temperature from exhaust modules" VALUE 0x8051F4FE RB_Val_Wu8 1.00000000000 B_TRUE 0.00 1.00000000000 FORMAT "%13.11" /end CHARACTERISTIC
/begin CHARACTERISTIC ExhMgT_facCorrnTempCatHeatgMax_C "Parameter for maximum factor to calculate temperature correction factor for catalyst heating" VALUE 0x8051F5A8 RB_Val_Wu16 1.999969 fak_uw_b2 0.00 1.999969 FORMAT "%8.6" /end CHARACTERISTIC
/begin CHARACTERISTIC ExhMgT_facCorrnTempCatHeatgMin_C "Parameter for minimum factor to calculate temperature correction factor for catalyst heating" VALUE 0x8051F5AA RB_Val_Wu16 1.999969 fak_uw_b2 0.00 1.999969 FORMAT "%8.6" /end CHARACTERISTIC
/begin CHARACTERISTIC ExhMgT_facInvnHeatgDmdHeatgProgs_T "Characteristic Curve for linearisation from factor catalyst heating demand to factor catalyst heating progress" CURVE 0x8051F5BA RB_Curve_U16_U16 0.9999847 fak_uw_b1 0.00 0.9999847 FORMAT "%9.7"
 /begin AXIS_DESCR STD_AXIS ExhMgT_facHeatgDmdCat fak_uw_b1 4 0.00 0.9999847 FORMAT "%9.7" DEPOSIT ABSOLUTE /end AXIS_DESCR
/end CHARACTERISTIC
/begin CHARACTERISTIC ExhMgT_facThdCatHeatgColdFinshdGpf_C "Threshold for the cooling-off factor catalyst heating to reset the catalyst heating request after cold start and direct switch to GPF heating" VALUE 0x8051F5CC RB_Val_Wu8 1.000000 fak_ub_b2 0.00 1.000000 FORMAT "%8.6" EXTENDED_LIMITS 0.00 1.992188 /end CHARACTERISTIC
/begin CHARACTERISTIC ExhMgT_facThdCatHeatgFinshd_C "Threshold for the cooling-off factor catalyst heating to reset the catalyst heating request" VALUE 0x8051F5CD RB_Val_Wu8 1.000000 fak_ub_b2 0.00 1.000000 FORMAT "%8.6" EXTENDED_LIMITS 0.00 1.992188 /end CHARACTERISTIC
/begin CHARACTERISTIC ExhMgT_facThdEtaCatWrm_C "Threshold for resetting the request for catalyst warming as a function of the engine temperature and the altitude" VALUE 0x8051F5CE RB_Val_Wu8 1.992188 fak_ub_b2 0.00 1.992188 FORMAT "%8.6" /end CHARACTERISTIC
/begin CHARACTERISTIC ExhMgT_facThdEtaColdStrtHeatg_C "Threshold for resetting the request for cold start catalyst heating as a function of the engine temperature and the altitude" VALUE 0x8051F5CF RB_Val_Wu8 1.992188 fak_ub_b2 0.00 1.992188 FORMAT "%8.6" /end CHARACTERISTIC
/begin CHARACTERISTIC ExhMgT_nrBrickTCat1Avrg_C "number of bricks catalyst 1 to calculate average catalyst temperature for release of catalyst heating" VALUE 0x8051F5B4 RB_Val_Wu8 255.0 OneToOne 0.00 255.0 FORMAT "%5.1" /end CHARACTERISTIC
/begin CHARACTERISTIC ExhMgT_nrBrickTCat1Max_C "" VALUE 0x8051F5B5 RB_Val_Wu8 255.0 OneToOne 0.00 255.0 FORMAT "%5.1" /end CHARACTERISTIC
/begin CHARACTERISTIC ExhMgT_nrBrickTCat1Min_C "" VALUE 0x8051F5B6 RB_Val_Wu8 255.0 OneToOne 0.00 255.0 FORMAT "%5.1" /end CHARACTERISTIC
/begin CHARACTERISTIC ExhMgT_nrBrickTCat2Avrg_C "number of bricks catalyst 2 to calculate average catalyst temperature for release of catalyst heating" VALUE 0x8051F5B7 RB_Val_Wu8 255.0 OneToOne 0.00 255.0 FORMAT "%5.1" /end CHARACTERISTIC
/begin CHARACTERISTIC ExhMgT_nrBrickTCat2Max_C "" VALUE 0x8051F5B8 RB_Val_Wu8 255.0 OneToOne 0.00 255.0 FORMAT "%5.1" /end CHARACTERISTIC
/begin CHARACTERISTIC ExhMgT_nrBrickTCat2Min_C "" VALUE 0x8051F5B9 RB_Val_Wu8 255.0 OneToOne 0.00 255.0 FORMAT "%5.1" /end CHARACTERISTIC
/begin CHARACTERISTIC ExhMgT_nrCatHighPrio_C "Defining the priority for heating the catalysts" VALUE 0x8051F5D0 RB_Val_Wu8 255.0 dez 0.00 255.0 FORMAT "%5.1" /end CHARACTERISTIC
/begin CHARACTERISTIC ExhMgT_nrTCat1Seln1_C "Temperature selection between Brick or Min, Max, Average of catalyst 1 for duration of catalyst heating" VALUE 0x8051F5D1 RB_Val_Wu8 255.0 dez 0.00 255.0 FORMAT "%5.1" /end CHARACTERISTIC
/begin CHARACTERISTIC ExhMgT_nrTCat1Seln2_C "Temperature selection between Brick or Min, Max, Average of catalyst 1 for release of catalyst heating" VALUE 0x8051F5D2 RB_Val_Wu8 255.0 dez 0.00 255.0 FORMAT "%5.1" /end CHARACTERISTIC
/begin CHARACTERISTIC ExhMgT_nrTCat2Seln1_C "Temperature selection between Brick or Min, Max, Average of catalyst 2 for duration of catalyst heating" VALUE 0x8051F5D3 RB_Val_Wu8 255.0 dez 0.00 255.0 FORMAT "%5.1" /end CHARACTERISTIC
/begin CHARACTERISTIC ExhMgT_nrTCat2Seln2_C "Temperature selection between Brick or Min, Max, Average of catalyst 2 for release of catalyst heating" VALUE 0x8051F5D4 RB_Val_Wu8 255.0 dez 0.00 255.0 FORMAT "%5.1" /end CHARACTERISTIC
/begin CHARACTERISTIC ExhMgT_nrTDesMinCatEngOff_C "Selection of minimal temperature for catalyst heating mode at engine start" VALUE 0x8051F5D5 RB_Val_Wu8 255.0 dez 0.00 255.0 FORMAT "%5.1" /end CHARACTERISTIC
/begin CHARACTERISTIC ExhMgT_nrTWallArySeldB1_C "choice of wall temperature from array ExhMod_tWallAryB1" VALUE 0x8051F500 RB_Val_Wu8 12.00 dez 0.00 12.00 FORMAT "%5.2" EXTENDED_LIMITS 0.00 255.0 /end CHARACTERISTIC
/begin CHARACTERISTIC ExhMgT_ratLamCptProtnLimpCamsft_C "additional enrichment for component protection due to implausible exhaust gas temperature model by camshaft error" VALUE 0x8051F502 RB_Val_Ws16 0.2001953 fak_sw_b8 -0.1000977 0.1000977 FORMAT "%9.7" EXTENDED_LIMITS -8.000000 7.999756 /end CHARACTERISTIC
/begin CHARACTERISTIC ExhMgT_ratLamCptProtnLimpExh_C "additional enrichment for component protection due to implausible exhaust gas temperature model" VALUE 0x8051F504 RB_Val_Ws16 0.2001953 fak_sw_b8 -0.1000977 0.1000977 FORMAT "%9.7" EXTENDED_LIMITS -8.000000 7.999756 /end CHARACTERISTIC
/begin CHARACTERISTIC ExhMgT_ratLamCptProtnLimpUego_C "additional enrichment for component protection due to implausible exhaust gas temperature model by error of oxygen sensor" VALUE 0x8051F506 RB_Val_Ws16 0.2001953 fak_sw_b8 -0.1000977 0.1000977 FORMAT "%9.7" EXTENDED_LIMITS -8.000000 7.999756 /end CHARACTERISTIC
/begin CHARACTERISTIC ExhMgT_stActvnCptProtnTExh1_C "code word: activation of dynamic temperature threshold" VALUE 0x8051F508 RB_Val_Wu8 255.0 dez 0.00 255.0 FORMAT "%5.1" /end CHARACTERISTIC
/begin CHARACTERISTIC ExhMgT_stActvnCptProtnTExh_C "code word: activation of component protection because of the exhaust gas temperature" VALUE 0x8051F509 RB_Val_Wu8 255.0 dez 0.00 255.0 FORMAT "%5.1" /end CHARACTERISTIC
/begin CHARACTERISTIC ExhMgT_stCatHeatgCold3_C "Codeword3: request catalyst heating by cold engine" VALUE 0x8051F5AC RB_Val_Wu16 65535.00 OneToOne 0.00 65535.00 FORMAT "%8.2" /end CHARACTERISTIC
/begin CHARACTERISTIC ExhMgT_stCatHeatgUpReq2_C "codeword for the catalyst heating trigger function" VALUE 0x8051F5D6 RB_Val_Wu16 65535.00 dez 0.00 65535.00 FORMAT "%8.2" /end CHARACTERISTIC
/begin CHARACTERISTIC ExhMgT_stCatHeatgUpReq_C "codeword for the catalyst heating trigger function" VALUE 0x8051F5D8 RB_Val_Wu16 65535.00 dez 0.00 65535.00 FORMAT "%8.2" /end CHARACTERISTIC
/begin CHARACTERISTIC ExhMgT_stHeatgModeFacProgsAry_CA "Array factor catalyst heating demand or factor catalyst heating progress" VAL_BLK 0x8051F5DA RB_ValA_Wu8 255.0 OneToOne 0.00 255.0 FORMAT "%5.1" NUMBER 4 /end CHARACTERISTIC
/begin CHARACTERISTIC ExhMgT_stOperModDmd_C "parameter for demand operating mode status" VALUE 0x8051F5AE RB_Val_Wu16 65535.00 dez 0.00 65535.00 FORMAT "%8.2" /end CHARACTERISTIC
/begin CHARACTERISTIC ExhMgT_tCat1CptProtnMax_C "maximal allowed temperature inside catalyst 1 for component protection" VALUE 0x8051F50A RB_Val_Ws16 6553.500 temp_q0p1_o273 -3549.940 3003.560 FORMAT "%8.3" /end CHARACTERISTIC
/begin CHARACTERISTIC ExhMgT_tCat1MaxCptProtnMax_C "maximal allowed maximum temperature inside catalyst 1 for component protection" VALUE 0x8051F50C RB_Val_Ws16 6553.500 temp_q0p1_o273 -3549.940 3003.560 FORMAT "%8.3" /end CHARACTERISTIC
/begin CHARACTERISTIC ExhMgT_tCat2CptProtnMax_C "maximal allowed temperature inside catalyst 2 for component protection" VALUE 0x8051F50E RB_Val_Ws16 6553.500 temp_q0p1_o273 -3549.940 3003.560 FORMAT "%8.3" /end CHARACTERISTIC
/begin CHARACTERISTIC ExhMgT_tCat2MaxCptProtnMax_C "maximal allowed maximum temperature inside catalyst 2 for component protection" VALUE 0x8051F510 RB_Val_Ws16 6553.500 temp_q0p1_o273 -3549.940 3003.560 FORMAT "%8.3" /end CHARACTERISTIC
/begin CHARACTERISTIC ExhMgT_tCatHeatgMax_C "parameter for maximum temperaure for catalyst heatinng" VALUE 0x8051F5B0 RB_Val_Ws16 6553.500 Temp_Cels -3549.940 3003.560 FORMAT "%8.3" /end CHARACTERISTIC
/begin CHARACTERISTIC ExhMgT_tDelta2CatHeatgCatHiPrio_C "hysteresis of catalyst temperature2 of the high prio cat which must be reached with catalyst heating" VALUE 0x8051F5DE RB_Val_Wu16 6553.500 Temp_Kelv 0.00 6553.500 FORMAT "%8.3" /end CHARACTERISTIC
/begin CHARACTERISTIC ExhMgT_tDeltaCat1_C "additional delta temperature to the initial threshold catalyst 1" VALUE 0x8051F512 RB_Val_Ws16 6553.500 temp_q0p1_K -3276.800 3276.700 FORMAT "%8.3" /end CHARACTERISTIC
/begin CHARACTERISTIC ExhMgT_tDeltaCat2_C "additional delta temperature to the initial threshold catalyst 2" VALUE 0x8051F514 RB_Val_Ws16 6553.500 temp_q0p1_K -3276.800 3276.700 FORMAT "%8.3" /end CHARACTERISTIC
/begin CHARACTERISTIC ExhMgT_tDeltaCatHeatgCatHiPrio_C "hysteresis of catalyst temperature of the high prio cat which must be reached with catalyst heating" VALUE 0x8051F5E0 RB_Val_Wu16 6553.500 Temp_Kelv 0.00 6553.500 FORMAT "%8.3" /end CHARACTERISTIC
/begin CHARACTERISTIC ExhMgT_tDeltaCatHeatgCatLoPrio_C "hysteresis of catalyst temperature of the low prio cat which must be reached with catalyst heating" VALUE 0x8051F5E2 RB_Val_Wu16 6553.500 Temp_Kelv 0.00 6553.500 FORMAT "%8.3" /end CHARACTERISTIC
/begin CHARACTERISTIC ExhMgT_tDeltaEngStopCatCoolgMax_C "Maximum temperature difference of catalyst while cooling at engine stop" VALUE 0x8051F5E4 RB_Val_Ws16 6553.500 temp_q0p1_K -3276.800 3276.700 FORMAT "%8.3" /end CHARACTERISTIC
/begin CHARACTERISTIC ExhMgT_tDeltaMinCatAge_T "delta temperature depending on catalyst ageing on tDesMIn for catheating demand factor" CURVE 0x8051F5E6 RB_Curve_U16_S16_Static 6553.500 q0p1_K -3276.800 3276.700 FORMAT "%8.3"
 /begin AXIS_DESCR STD_AXIS ExhMgT_facWghtCatAge fak_uw_b2 4 0.00 1.999969 FORMAT "%8.6" DEPOSIT ABSOLUTE /end AXIS_DESCR
/end CHARACTERISTIC
/begin CHARACTERISTIC ExhMgT_tDeltaMnfB1_T "dynamic delta temperature to the initial threshold manifold" CURVE 0x8051F516 RB_Curve_S16_S16 6553.500 temp_q0p1_K -3276.800 3276.700 FORMAT "%8.3"
 /begin AXIS_DESCR STD_AXIS ExhMgT_tExhMnfFildGrdtB1 temp_q0p1_K 8 -3276.800 3276.700 FORMAT "%8.3" DEPOSIT ABSOLUTE /end AXIS_DESCR
/end CHARACTERISTIC
/begin CHARACTERISTIC ExhMgT_tDeltaMnf_C "additional delta temperature to the initial threshold manifold" VALUE 0x8051F538 RB_Val_Wr32 3000.00000 TempK_float -1500.00000 1500.00000 FORMAT "%10.5" EXTENDED_LIMITS -3.40282347E+038 3.40282347E+038 /end CHARACTERISTIC
/begin CHARACTERISTIC ExhMgT_tDeltaWallActvnCptProtn_C "hysteresis for maximal wall temperature inside exhaust system for deactivation of component protection" VALUE 0x8051F53C RB_Val_Ws16 6553.500 temp_q0p1_K -3276.800 3276.700 FORMAT "%8.3" /end CHARACTERISTIC
/begin CHARACTERISTIC ExhMgT_tDesMinCatDmd_C "minimum desired temperature of catalyst demand" VALUE 0x8051F5F8 RB_Val_Ws16 6553.500 Temp_Cels -3549.940 3003.560 FORMAT "%8.3" /end CHARACTERISTIC
/begin CHARACTERISTIC ExhMgT_tDesMinCatEngOff_C "minimum desired temperature of catalyst during engine start" VALUE 0x8051F5FA RB_Val_Ws16 6553.500 Temp_Cels -3549.940 3003.560 FORMAT "%8.3" /end CHARACTERISTIC
/begin CHARACTERISTIC ExhMgT_tDesMinLoPrioCatDmd_C "minimum desired catalyst temperature of the low prio catalyst demand factor" VALUE 0x8051F5FC RB_Val_Ws16 6553.500 Temp_Cels -3549.940 3003.560 FORMAT "%8.3" /end CHARACTERISTIC
/begin CHARACTERISTIC ExhMgT_tDiffActvTi_C "delta temperature threshold in order to reset the dynamic threshold component protection" VALUE 0x8051F53E RB_Val_Ws16 6553.500 temp_q0p1_K -3276.800 3276.700 FORMAT "%8.3" /end CHARACTERISTIC
/begin CHARACTERISTIC ExhMgT_tExhCat1CptProtnDsMax_C "maximal allowed exhaust temperature downstream of catalyst 1 for component protection" VALUE 0x8051F540 RB_Val_Ws16 6553.500 temp_q0p1_o273 -3549.940 3003.560 FORMAT "%8.3" /end CHARACTERISTIC
/begin CHARACTERISTIC ExhMgT_tExhCat1CptProtnUsMax_C "maximal allowed exhaust temperature in front of catalyst 1 for component protection" VALUE 0x8051F542 RB_Val_Ws16 6553.500 temp_q0p1_o273 -3549.940 3003.560 FORMAT "%8.3" /end CHARACTERISTIC
/begin CHARACTERISTIC ExhMgT_tExhCat2CptProtnDsMax_C "maximal allowed exhaust temperature downstream of catalyst 2 for component protection" VALUE 0x8051F544 RB_Val_Ws16 6553.500 temp_q0p1_o273 -3549.940 3003.560 FORMAT "%8.3" /end CHARACTERISTIC
/begin CHARACTERISTIC ExhMgT_tExhCat2CptProtnUsMax_C "maximal allowed exhaust temperature in front of catalyst 2 for component protection" VALUE 0x8051F546 RB_Val_Ws16 6553.500 temp_q0p1_o273 -3549.940 3003.560 FORMAT "%8.3" /end CHARACTERISTIC
/begin CHARACTERISTIC ExhMgT_tExhDsVlvCptProtnMax_C "Exhaust gas temperature downstream exhaust valve (modeled) for component protection" VALUE 0x8051F548 RB_Val_Ws16 6553.500 temp_q0p1_o273 -3549.940 3003.560 FORMAT "%8.3" /end CHARACTERISTIC
/begin CHARACTERISTIC ExhMgT_tExhFrtPipCptProtnMax_C "maximal allowed Exhaust gas temperature downstream manifold for component protection" VALUE 0x8051F54A RB_Val_Ws16 6553.500 temp_q0p1_o273 -3549.940 3003.560 FORMAT "%8.3" /end CHARACTERISTIC
/begin CHARACTERISTIC ExhMgT_tExhMnfMaxDyn_C "Reset temperature value of the dynamic manifold threshold" VALUE 0x8051F54C RB_Val_Ws16 6553.500 temp_q0p1_o273 -3549.940 3003.560 FORMAT "%8.3" /end CHARACTERISTIC
/begin CHARACTERISTIC ExhMgT_tiActvnCptProtn_C "Time constant lambda component protection" VALUE 0x8051F54E RB_Val_Wu16 6553.4999985 zk100msxs_uw_b6553p6 0.1000015 6553.6000000 FORMAT "%12.7" EXTENDED_LIMITS 0.10000152590 6553.6000000 /end CHARACTERISTIC
/begin CHARACTERISTIC ExhMgT_tiCat1MaxDec_C "time constant for down-integration of component protection temperature threshold of cat 1" VALUE 0x8051F550 RB_Val_Wu16 6553.4999985 zk100msxs_uw_b6553p6 0.1000015 6553.6000000 FORMAT "%12.7" EXTENDED_LIMITS 0.10000152590 6553.6000000 /end CHARACTERISTIC
/begin CHARACTERISTIC ExhMgT_tiCat1MaxInc_C "time constant for up-integration of component protection temperature threshold of catalyst 1" VALUE 0x8051F552 RB_Val_Wu16 6553.4999985 zk100msxs_uw_b6553p6 0.1000015 6553.6000000 FORMAT "%12.7" EXTENDED_LIMITS 0.10000152590 6553.6000000 /end CHARACTERISTIC
/begin CHARACTERISTIC ExhMgT_tiCat2MaxDec_C "time constant for down-integration of component protection temperature threshold of cat 2" VALUE 0x8051F554 RB_Val_Wu16 6553.4999985 zk100msxs_uw_b6553p6 0.1000015 6553.6000000 FORMAT "%12.7" EXTENDED_LIMITS 0.10000152590 6553.6000000 /end CHARACTERISTIC
/begin CHARACTERISTIC ExhMgT_tiCat2MaxInc_C "time constant for up-integration of component protection temperature threshold of catalyst 2" VALUE 0x8051F556 RB_Val_Wu16 6553.4999985 zk100msxs_uw_b6553p6 0.1000015 6553.6000000 FORMAT "%12.7" EXTENDED_LIMITS 0.10000152590 6553.6000000 /end CHARACTERISTIC
/begin CHARACTERISTIC ExhMgT_tiCatHeatgFacColdFinshGpf_C "Time constant for down ramping of catalyst heating measures by finisching cold start heating with direct switch to GPF heating" VALUE 0x8051F5FE RB_Val_Wu8 25.4996 zk100msxs_ub_b25p5 0.1004 25.6000 FORMAT "%7.4" EXTENDED_LIMITS 0.100392 25.6000 /end CHARACTERISTIC
/begin CHARACTERISTIC ExhMgT_tiCatHeatgFacFinsh_C "Time constant for down ramping of catalyst heating measures by finisching cold start heating" VALUE 0x8051F5FF RB_Val_Wu8 25.4996 zk100msxs_ub_b25p5 0.1004 25.6000 FORMAT "%7.4" EXTENDED_LIMITS 0.100392 25.6000 /end CHARACTERISTIC
/begin CHARACTERISTIC ExhMgT_tiCatHeatgFacRampDown_C "time constant for down ramping of catalyst heating measures by finishing catalyst heating" VALUE 0x8051F600 RB_Val_Wu8 25.4996 zk100msxs_ub_b25p5 0.1004 25.6000 FORMAT "%7.4" EXTENDED_LIMITS 0.100392 25.6000 /end CHARACTERISTIC
/begin CHARACTERISTIC ExhMgT_tiCatHeatgFacRampUp_C "time constant for up ramping of catalyst heating measures by start of catalyst heating" VALUE 0x8051F601 RB_Val_Wu8 25.4996 zk100msxs_ub_b25p5 0.1004 25.6000 FORMAT "%7.4" EXTENDED_LIMITS 0.100392 25.6000 /end CHARACTERISTIC
/begin CHARACTERISTIC ExhMgT_tiCdnDnyThd_C "maximal Delay time to ramp down the dynamic threshold of the manifold" VALUE 0x8051F558 RB_Val_Wu16 6553.500 t_q0p1 0.00 6553.500 FORMAT "%8.3" /end CHARACTERISTIC
/begin CHARACTERISTIC ExhMgT_tiDeActvnCptProtn_C "Time constant to deactivate lambda component protection" VALUE 0x8051F55A RB_Val_Wu16 6553.4999985 zk100msxs_uw_b6553p6 0.1000015 6553.6000000 FORMAT "%12.7" EXTENDED_LIMITS 0.10000152590 6553.6000000 /end CHARACTERISTIC
/begin CHARACTERISTIC ExhMgT_tiDifCdnDyn_C "Reset threshold of the dynamic manifold threshold" VALUE 0x8051F55C RB_Val_Wu16 6553.500 t_q0p1 0.00 6553.500 FORMAT "%8.3" /end CHARACTERISTIC
/begin CHARACTERISTIC ExhMgT_tiDlyCatActvCptProtn_C "time delay for activating component protection due to critical exhaust gas temperatures of catalysts" VALUE 0x8051F55E RB_Val_Wu8 25.50 t100msxs_ub_b25p5 0.00 25.50 FORMAT "%5.2" /end CHARACTERISTIC
/begin CHARACTERISTIC ExhMgT_tiDlyCatHeatgCptPrtn_C "Delay time component protection for calculation condition catalyst heating" VALUE 0x8051F602 RB_Val_Wu16 6553.500 t_q0p1 0.00 6553.500 FORMAT "%8.3" /end CHARACTERISTIC
/begin CHARACTERISTIC ExhMgT_tiDlyExhActvCptProtn_C "time delay for activating component protection due to critical exhaust gas temperatures upstream of catalysts" VALUE 0x8051F55F RB_Val_Wu8 25.50 t100msxs_ub_b25p5 0.00 25.50 FORMAT "%5.2" /end CHARACTERISTIC
/begin CHARACTERISTIC ExhMgT_tiMaxCat1B1_C "duration of the exceedance of the initial threshold catalyst 1" VALUE 0x8051F560 RB_Val_Wu16 6553.500 t_q0p1 0.00 6553.500 FORMAT "%8.3" /end CHARACTERISTIC
/begin CHARACTERISTIC ExhMgT_tiMaxCat2B1_C "duration of the exceedance of the initial threshold catalyst 2" VALUE 0x8051F562 RB_Val_Wu16 6553.500 t_q0p1 0.00 6553.500 FORMAT "%8.3" /end CHARACTERISTIC
/begin CHARACTERISTIC ExhMgT_tiMnfldMaxDec_C "time constant for down-integration of component protection temperature threshold of exhaust manifold" VALUE 0x8051F564 RB_Val_Wu16 6553.4999985 zk100msxs_uw_b6553p6 0.1000015 6553.6000000 FORMAT "%12.7" EXTENDED_LIMITS 0.10000152590 6553.6000000 /end CHARACTERISTIC
/begin CHARACTERISTIC ExhMgT_tiMnfldMaxInc_C "time constant for up-integration of component protection temperature threshold of exhaust manifold" VALUE 0x8051F566 RB_Val_Wu16 6553.4999985 zk100msxs_uw_b6553p6 0.1000015 6553.6000000 FORMAT "%12.7" EXTENDED_LIMITS 0.10000152590 6553.6000000 /end CHARACTERISTIC
/begin CHARACTERISTIC ExhMgT_tiWallActvnCptProtn_C "time delay for activation of component protection in dependence of wall temperature inside of exhaust system" VALUE 0x8051F568 RB_Val_Wu16 100.0000 t_q0p1 0.00 100.0000 FORMAT "%8.4" EXTENDED_LIMITS 0.00 6553.500 /end CHARACTERISTIC
/begin CHARACTERISTIC ExhMgT_tMinCatDelta_C "Exhaust temperature hysteresis for shut-off of component protection because of catalyst temperatures" VALUE 0x8051F56A RB_Val_Ws16 500.0000 temp_q0p1_K 0.00 500.0000 FORMAT "%8.4" EXTENDED_LIMITS -3276.800 3276.700 /end CHARACTERISTIC
/begin CHARACTERISTIC ExhMgT_tMinCatLo_C "Minimum distance to critical limits of temperatures near catalysts from where component protection active" VALUE 0x8051F56C RB_Val_Ws16 500.0000 temp_q0p1_K 0.00 500.0000 FORMAT "%8.4" EXTENDED_LIMITS -3276.800 3276.700 /end CHARACTERISTIC
/begin CHARACTERISTIC ExhMgT_tMinExhDelta_C "Exhaust temperature hysteresis for shut-off of component protection because of gas temperatures" VALUE 0x8051F56E RB_Val_Ws16 500.0000 temp_q0p1_K 0.00 500.0000 FORMAT "%8.4" EXTENDED_LIMITS -3276.800 3276.700 /end CHARACTERISTIC
/begin CHARACTERISTIC ExhMgT_tMinExhLo_C "Minimum distance to critical limits of exhaust gas temperatures upstream of catalysts where component protection active" VALUE 0x8051F570 RB_Val_Ws16 500.0000 temp_q0p1_K 0.00 500.0000 FORMAT "%8.4" EXTENDED_LIMITS -3276.800 3276.700 /end CHARACTERISTIC
/begin CHARACTERISTIC ExhMgT_tOffsCptProtnLimpCamsft_C "Additional distance to critical limits of exhaust temperatures for component protection due to implausible exhaust gas temperature model by error of camshaft" VALUE 0x8051F572 RB_Val_Wu16 500.0000 temp_q0p1 0.00 500.0000 FORMAT "%8.4" EXTENDED_LIMITS 0.00 6553.500 /end CHARACTERISTIC
/begin CHARACTERISTIC ExhMgT_tOffsCptProtnLimpExh_C "Additional distance to critical limits of exhaust temperatures for component protection due to implausible exhaust gas temperature model" VALUE 0x8051F574 RB_Val_Wu16 500.0000 temp_q0p1 0.00 500.0000 FORMAT "%8.4" EXTENDED_LIMITS 0.00 6553.500 /end CHARACTERISTIC
/begin CHARACTERISTIC ExhMgT_tOffsCptProtnLimpUego_C "Additional distance to critical limits of exhaust temperatures for component protection due to implausible exhaust gas temperature model by error of oxygen sensor" VALUE 0x8051F576 RB_Val_Wu16 500.0000 temp_q0p1 0.00 500.0000 FORMAT "%8.4" EXTENDED_LIMITS 0.00 6553.500 /end CHARACTERISTIC
/begin CHARACTERISTIC ExhMgT_tThd2CatHeatgCatHiPrio_T "Temperature threshold2 for catalyst heating for the high prio catalyst" CURVE 0x8051F604 RB_Curve_U16_S16_Static 6553.500 Temp_Cels -3549.940 3003.560 FORMAT "%8.3"
 /begin AXIS_DESCR STD_AXIS ExhMgT_facWghtCatAge fak_uw_b2 4 0.00 1.999969 FORMAT "%8.6" DEPOSIT ABSOLUTE /end AXIS_DESCR
/end CHARACTERISTIC
/begin CHARACTERISTIC ExhMgT_tThdCatHeatgCatHiPrio_T "Temperature threshold for catalyst heating for the high prio catalyst" CURVE 0x8051F616 RB_Curve_U16_S16_Static 6553.500 Temp_Cels -3549.940 3003.560 FORMAT "%8.3"
 /begin AXIS_DESCR STD_AXIS ExhMgT_facWghtCatAge fak_uw_b2 4 0.00 1.999969 FORMAT "%8.6" DEPOSIT ABSOLUTE /end AXIS_DESCR
/end CHARACTERISTIC
/begin CHARACTERISTIC ExhMgT_tThdCatHeatgCatLoPrio_T "Temperature threshold for catalyst heating for the low prio catalyst" CURVE 0x8051F628 RB_Curve_U16_S16_Static 6553.500 Temp_Cels -3549.940 3003.560 FORMAT "%8.3"
 /begin AXIS_DESCR STD_AXIS ExhMgT_facWghtCatAge fak_uw_b2 4 0.00 1.999969 FORMAT "%8.6" DEPOSIT ABSOLUTE /end AXIS_DESCR
/end CHARACTERISTIC
/begin CHARACTERISTIC ExhMgT_tWallActvnCptProtnMax_C "maximal wall temperature inside exhaust system for activation of component protection" VALUE 0x8051F578 RB_Val_Ws16 6553.500 Temp_Cels -3549.940 3003.560 FORMAT "%8.3" /end CHARACTERISTIC
/begin CHARACTERISTIC ExhMgT_tWallActvnCptProtnMax_T "curve for maximal wall temperature inside exhaust system for activation of component protection" CURVE 0x8051F57A RB_Curve_U16_S16_Static 6553.500 Temp_Cels -3549.940 3003.560 FORMAT "%8.3"
 /begin AXIS_DESCR STD_AXIS NO_INPUT_QUANTITY vfzg_uw_b512 6 0.00 511.9922 FORMAT "%8.4" DEPOSIT ABSOLUTE /end AXIS_DESCR
/end CHARACTERISTIC
/begin CHARACTERISTIC ExhMgT_tWallMnfCptProtnMax_C "threshold wall temperature manifold for component protection" VALUE 0x8051F594 RB_Val_Ws16 6553.500 temp_q0p1_o273 -3549.940 3003.560 FORMAT "%8.3" /end CHARACTERISTIC
/begin CHARACTERISTIC ExhMgT_tWallMnfldCptProtn_T "maximal allowed temperature at exhaust manifold for component temperature in dependence of wall temperature" CURVE 0x8051F596 RB_Curve_S16_S16 6553.500 temp_q0p1_o273 -3549.940 3003.560 FORMAT "%8.3"
 /begin AXIS_DESCR STD_AXIS NO_INPUT_QUANTITY temp_q0p1_o273 4 -3549.940 3003.560 FORMAT "%8.3" DEPOSIT ABSOLUTE /end AXIS_DESCR
/end CHARACTERISTIC
/begin CHARACTERISTIC FKSTT "factor cold start" CURVE 0x8051D184 RB_Curve_U8_U16_Static 63.99902 fak_uw_b64 0.00 63.99902 FORMAT "%8.5"
 /begin AXIS_DESCR STD_AXIS ESSTT_tmst temp_ub_q0p75_o48 12 -48.0 143.3 FORMAT "%5.1" DEPOSIT ABSOLUTE /end AXIS_DESCR
/end CHARACTERISTIC
/begin CHARACTERISTIC FNSSM "after start increase" CURVE 0x8051CC8B RB_CurveGroup_U8 3.984 fak_ub_b4 0.00 3.984 FORMAT "%5.3"
 /begin AXIS_DESCR COM_AXIS EngStrt_tEngTStrtLoc temp_ub_q0p75_o48 12 -48.0 143.3 FORMAT "%5.1" AXIS_PTS_REF EngStrt_tEngStrt12_AX /end AXIS_DESCR
/end CHARACTERISTIC
/begin CHARACTERISTIC FUKNSTHO "altitude dependent transient control post cranking factor" CURVE 0x8051D5E4 RB_Curve_U16_U8_Static 1.992188 fak_ub_b2 0.00 1.992188 FORMAT "%8.6"
 /begin AXIS_DESCR STD_AXIS PEnv_facCorrAlti fak_uw_b4 6 0.00 3.999939 FORMAT "%8.6" DEPOSIT ABSOLUTE /end AXIS_DESCR
/end CHARACTERISTIC
/begin CHARACTERISTIC FUKNSTRM "initial value of transient control post-start factor" CURVE 0x8051D5F8 RB_Curve_U8_U16_Static 19.99969 fak_q0p000305 0.00 19.99969 FORMAT "%8.5"
 /begin AXIS_DESCR STD_AXIS InjSys_tTraCmp10ms temp_ub_q0p75_o48 9 -48.0 143.3 FORMAT "%5.1" DEPOSIT ABSOLUTE /end AXIS_DESCR
/end CHARACTERISTIC
/begin CHARACTERISTIC FUKTINEO "Crv. factor: injection time after intake valve opens" CURVE 0x8051D614 RB_Curve_U16_U16 1.999969 fak_uw_b2 0.00 1.999969 FORMAT "%8.6"
 /begin AXIS_DESCR STD_AXIS vti_w fak_uw_b2 6 0.00 1.999969 FORMAT "%8.6" DEPOSIT ABSOLUTE /end AXIS_DESCR
/end CHARACTERISTIC
/begin CHARACTERISTIC FVANST "weighting factor of deceleration during post-cranking" VALUE 0x8051D62E RB_Val_Wu8 1.992188 fak_ub_b2 0.00 1.992188 FORMAT "%8.6" /end CHARACTERISTIC
/begin CHARACTERISTIC FWEEMRFAM "weighting factor f. angle injection-end at max. torque request by driver" CURVE 0x8051E0F3 RB_CurveGroup_U8 1.992 fak_q0p0078 0.00 1.992 FORMAT "%5.3"
 /begin AXIS_DESCR COM_AXIS InjSys_tEngESVW temp_q0p75_om48 8 -48.0 143.3 FORMAT "%5.1" AXIS_PTS_REF STM08FSUB /end AXIS_DESCR
/end CHARACTERISTIC
/begin CHARACTERISTIC FWEMRFA "factor restart fuel mass dependent of desired torque" CURVE 0x8051E2B0 RB_Curve_U16_U8_Static 1.992188 fak_ub_b2 0.00 1.992188 FORMAT "%8.6"
 /begin AXIS_DESCR STD_AXIS mrfa_w_msg rel_uw_b200 6 0.00 199.9969 FORMAT "%8.4" DEPOSIT ABSOLUTE /end AXIS_DESCR
/end CHARACTERISTIC
/begin CHARACTERISTIC FWET "factor temperature restart fuel mass" CURVE 0x8051E2C4 RB_Curve_U8_U8 1.992188 fak_ub_b2 0.00 1.992188 FORMAT "%8.6"
 /begin AXIS_DESCR STD_AXIS tmeswe temp_ub_q0p75_o48 9 -48.0 143.3 FORMAT "%5.1" DEPOSIT ABSOLUTE /end AXIS_DESCR
/end CHARACTERISTIC
/begin CHARACTERISTIC FWSTAB "weighting afterstart decrease" CURVE 0x8051CC97 RB_CurveGroup_U8 1.992188 fak_ub_b2 0.00 1.992188 FORMAT "%8.6"
 /begin AXIS_DESCR COM_AXIS kstaa_msg fak_ub_b2 6 0.00 1.992188 FORMAT "%8.6" AXIS_PTS_REF EngStrt_facStrtMixAdap6_AX /end AXIS_DESCR
/end CHARACTERISTIC
/begin CHARACTERISTIC FZANSSA1 "factor for ignition synchronous decreasing of afterstart enrichment at hot start range 1" CURVE 0x8051CC9D RB_CurveGroup_U8 0.249023438 fak_ub_b0p25 0.00 0.249023438 FORMAT "%11.9"
 /begin AXIS_DESCR COM_AXIS tans_msg temp_ub_q0p75_o48 6 -48.0 143.3 FORMAT "%5.1" AXIS_PTS_REF EngStrt_tIntkAir6_AX /end AXIS_DESCR
/end CHARACTERISTIC
/begin CHARACTERISTIC FZANSSA2 "factor for ignition synchronous decreasing of afterstart enrichment at hot start range 2" CURVE 0x8051CCA3 RB_CurveGroup_U8 0.249023438 fak_ub_b0p25 0.00 0.249023438 FORMAT "%11.9"
 /begin AXIS_DESCR COM_AXIS tans_msg temp_ub_q0p75_o48 6 -48.0 143.3 FORMAT "%5.1" AXIS_PTS_REF EngStrt_tIntkAir6_AX /end AXIS_DESCR
/end CHARACTERISTIC
/begin CHARACTERISTIC FZANSSM1 "factor for ign. sync. decreasing of afterstart enrichment above SZANSSM" CURVE 0x8051CCA9 RB_CurveGroup_U8 0.249023438 fak_ub_b0p25 0.00 0.249023438 FORMAT "%11.9"
 /begin AXIS_DESCR COM_AXIS EngStrt_tEngTStrtLoc temp_ub_q0p75_o48 12 -48.0 143.3 FORMAT "%5.1" AXIS_PTS_REF EngStrt_tEngStrt12_AX /end AXIS_DESCR
/end CHARACTERISTIC
/begin CHARACTERISTIC FZANSSM2 "factor for ign. sync. decreasing of afterstart enrichment below SZANSSM" CURVE 0x8051CCB5 RB_CurveGroup_U8 0.249023438 fak_ub_b0p25 0.00 0.249023438 FORMAT "%11.9"
 /begin AXIS_DESCR COM_AXIS EngStrt_tEngTStrtLoc temp_ub_q0p75_o48 12 -48.0 143.3 FORMAT "%5.1" AXIS_PTS_REF EngStrt_tEngStrt12_AX /end AXIS_DESCR
/end CHARACTERISTIC
/begin CHARACTERISTIC FZANSSM3 "factor for ign. sync. decreasing of afterstart enrichment in range 3" CURVE 0x8051CCC1 RB_CurveGroup_U8 0.249023438 fak_ub_b0p25 0.00 0.249023438 FORMAT "%11.9"
 /begin AXIS_DESCR COM_AXIS EngStrt_tEngTStrtLoc temp_ub_q0p75_o48 12 -48.0 143.3 FORMAT "%5.1" AXIS_PTS_REF EngStrt_tEngStrt12_AX /end AXIS_DESCR
/end CHARACTERISTIC
/begin CHARACTERISTIC IMLHS "integrated flow of air-mass at hot start" VALUE 0x8051D1AA RB_Val_Wu8 23.21 m_ub_b23p3 0.00 23.21 FORMAT "%5.2" /end CHARACTERISTIC
/begin CHARACTERISTIC InjSyG_ACTqThd_C "Threshold for AC compressor torque" VALUE 0x8051E2D8 RB_Val_Ws16 6553.500 Trq -3276.800 3276.700 FORMAT "%8.3" /end CHARACTERISTIC
/begin CHARACTERISTIC InjSys_agDeltaInjEndAftStrt_T "Delta angle injection end at cold after start" MAP 0x8051E0FC RB_Map_U16U16_S16 1530.000 zw_sb_q6 -768.0000 762.0000 FORMAT "%8.4" EXTENDED_LIMITS -196608.0 196602.0
 /begin AXIS_DESCR STD_AXIS InjSys_tStrtESVW temp_ub_q0p75_o48 8 -48.0000 143.2500 FORMAT "%8.4" EXTENDED_LIMITS -48.00000 49103.25 DEPOSIT ABSOLUTE /end AXIS_DESCR
 /begin AXIS_DESCR STD_AXIS anztib1_w_msg dez 8 0.00 65535.00 FORMAT "%8.2" DEPOSIT ABSOLUTE /end AXIS_DESCR
/end CHARACTERISTIC
/begin CHARACTERISTIC InjSys_facBadFuMAEnchmtKMem_M "ShortTerm-memory reduction factor for bad fuel correction for acceleration enrichment." MAP 0x8051D62F RB_Map_U8U8_U8 0.9961 fak_q0p0039 0.00 0.9961
 /begin AXIS_DESCR STD_AXIS InjSys_tTraCmp10ms temp_ub_q0p75_o48 9 -48.0 143.3 FORMAT "%5.1" DEPOSIT ABSOLUTE /end AXIS_DESCR
 /begin AXIS_DESCR STD_AXIS InjSys_facBadFuM fak_ub_b1 6 0.00 0.9961 DEPOSIT ABSOLUTE /end AXIS_DESCR
/end CHARACTERISTIC
/begin CHARACTERISTIC InjSys_facBadFuMAEnchmtLMem_M "LongTerm-memory reduction factor for bad fuel correction for acceleration enrichment." MAP 0x8051D676 RB_Map_U8U8_U8 0.1245 fak_ub_b0p125 0.00 0.1245 FORMAT "%6.4"
 /begin AXIS_DESCR STD_AXIS InjSys_tTraCmp10ms temp_ub_q0p75_o48 9 -48.0 143.3 FORMAT "%5.1" DEPOSIT ABSOLUTE /end AXIS_DESCR
 /begin AXIS_DESCR STD_AXIS InjSys_facBadFuM fak_ub_b1 6 0.00 0.9961 DEPOSIT ABSOLUTE /end AXIS_DESCR
/end CHARACTERISTIC
/begin CHARACTERISTIC InjSys_facBadFuMDecelEnlnmtKMem_M "ShortTerm-memory reduction factor for bad fuel correction for deceleration enleanment." MAP 0x8051D6BD RB_Map_U8U8_U8 0.9961 fak_q0p0039 0.00 0.9961
 /begin AXIS_DESCR STD_AXIS InjSys_tTraCmp10ms temp_ub_q0p75_o48 9 -48.0 143.3 FORMAT "%5.1" DEPOSIT ABSOLUTE /end AXIS_DESCR
 /begin AXIS_DESCR STD_AXIS InjSys_facBadFuM fak_ub_b1 6 0.00 0.9961 DEPOSIT ABSOLUTE /end AXIS_DESCR
/end CHARACTERISTIC
/begin CHARACTERISTIC InjSys_facBadFuMDecelEnlnmtLMem_M "LongTerm-memory reduction factor for bad fuel correction for deceleration enleanment." MAP 0x8051D704 RB_Map_U8U8_U8 0.1245 fak_ub_b0p125 0.00 0.1245 FORMAT "%6.4"
 /begin AXIS_DESCR STD_AXIS InjSys_tTraCmp10ms temp_ub_q0p75_o48 9 -48.0 143.3 FORMAT "%5.1" DEPOSIT ABSOLUTE /end AXIS_DESCR
 /begin AXIS_DESCR STD_AXIS InjSys_facBadFuM fak_ub_b1 6 0.00 0.9961 DEPOSIT ABSOLUTE /end AXIS_DESCR
/end CHARACTERISTIC
/begin CHARACTERISTIC InjSys_facTraCmpBadfuAftStrt_M "factor bad fuel for transient compensation based on afterstart adaptation factor fnsad_w" MAP 0x8051D74C RB_Map_S16U16_U8 0.9961 fak_ub_b1 0.00 0.9961
 /begin AXIS_DESCR STD_AXIS CEngDsT_tStrt Temp_Cels 8 -3549.940 3003.560 FORMAT "%8.3" DEPOSIT ABSOLUTE /end AXIS_DESCR
 /begin AXIS_DESCR STD_AXIS fnsad_w_msg fak_uw_b2 6 0.00 1.999969 FORMAT "%8.6" DEPOSIT ABSOLUTE /end AXIS_DESCR
/end CHARACTERISTIC
/begin CHARACTERISTIC InjSys_facTraCmpBadfuStrt_M "factor bad fuel for transient compensation based on currently used start mixture adaptation factor kstaa" MAP 0x8051D79C RB_Map_S16U8_U8 0.9961 fak_ub_b1 0.00 0.9961
 /begin AXIS_DESCR STD_AXIS CEngDsT_tStrt Temp_Cels 8 -3549.940 3003.560 FORMAT "%8.3" DEPOSIT ABSOLUTE /end AXIS_DESCR
 /begin AXIS_DESCR STD_AXIS kstaa_msg fak_ub_b2 6 0.00 1.992188 FORMAT "%8.6" DEPOSIT ABSOLUTE /end AXIS_DESCR
/end CHARACTERISTIC
/begin CHARACTERISTIC InjSys_facWghtBadFuel_M "Weighting factor bad fuel" MAP 0x8051E2DA RB_Map_U8U8_U16 4.999924 fak_uw_b5 0.00 4.999924 FORMAT "%8.6"
 /begin AXIS_DESCR STD_AXIS kstaa_msg fak_ub_b2 4 0.00 1.992188 FORMAT "%8.6" DEPOSIT ABSOLUTE /end AXIS_DESCR
 /begin AXIS_DESCR STD_AXIS tmeswe temp_ub_q0p75_o48 6 -48.0 143.3 FORMAT "%5.1" DEPOSIT ABSOLUTE /end AXIS_DESCR
/end CHARACTERISTIC
/begin CHARACTERISTIC KFABAK "share factor wall wetting for acceleration enrichment" MAP 0x8051D7E6 RB_MapGroup_U8 0.9961 fak_ub_b1 0.00 0.9961
 /begin AXIS_DESCR COM_AXIS InjSys_tTraCmp10ms temp_ub_q0p75_o48 9 -48.0 143.3 FORMAT "%5.1" AXIS_PTS_REF STM09ESUB /end AXIS_DESCR
 /begin AXIS_DESCR COM_AXIS Epm_nEngLRes EngN_LRes 7 0.00 10200. FORMAT "%5.0" AXIS_PTS_REF SNM07ESUB /end AXIS_DESCR
/end CHARACTERISTIC
/begin CHARACTERISTIC KFABAKHI "Share factor wall wetting for acceleration enrichment with intake valve in hi-lift profile" MAP 0x8051D825 RB_MapGroup_U8 0.9961 fak_ub_b1 0.00 0.9961
 /begin AXIS_DESCR COM_AXIS InjSys_tTraCmp10ms temp_ub_q0p75_o48 9 -48.0 143.3 FORMAT "%5.1" AXIS_PTS_REF STM09ESUB /end AXIS_DESCR
 /begin AXIS_DESCR COM_AXIS Epm_nEngLRes EngN_LRes 7 0.00 10200. FORMAT "%5.0" AXIS_PTS_REF SNM07ESUB /end AXIS_DESCR
/end CHARACTERISTIC
/begin CHARACTERISTIC KFAVAK "share factor wall wetting for deceleration enleanment" MAP 0x8051D864 RB_MapGroup_U8 0.9961 fak_ub_b1 0.00 0.9961
 /begin AXIS_DESCR COM_AXIS InjSys_tTraCmp10ms temp_ub_q0p75_o48 9 -48.0 143.3 FORMAT "%5.1" AXIS_PTS_REF STM09ESUB /end AXIS_DESCR
 /begin AXIS_DESCR COM_AXIS Epm_nEngLRes EngN_LRes 7 0.00 10200. FORMAT "%5.0" AXIS_PTS_REF SNM07ESUB /end AXIS_DESCR
/end CHARACTERISTIC
/begin CHARACTERISTIC KFAVAKHI "share factor wall wetting for deceleration enleanment with intake valve in hi-lift profile" MAP 0x8051D8A3 RB_MapGroup_U8 0.9961 fak_ub_b1 0.00 0.9961
 /begin AXIS_DESCR COM_AXIS InjSys_tTraCmp10ms temp_ub_q0p75_o48 9 -48.0 143.3 FORMAT "%5.1" AXIS_PTS_REF STM09ESUB /end AXIS_DESCR
 /begin AXIS_DESCR COM_AXIS Epm_nEngLRes EngN_LRes 7 0.00 10200. FORMAT "%5.0" AXIS_PTS_REF SNM07ESUB /end AXIS_DESCR
/end CHARACTERISTIC
/begin CHARACTERISTIC KFBADE "factor acceleration enrichment direct injection" MAP 0x8051D8E2 RB_MapGroup_U16 31.99951 fak_uw_b32 0.00 31.99951 FORMAT "%8.5"
 /begin AXIS_DESCR COM_AXIS InjSys_tTraCmp10ms temp_ub_q0p75_o48 9 -48.0 143.3 FORMAT "%5.1" AXIS_PTS_REF STM09ESUB /end AXIS_DESCR
 /begin AXIS_DESCR COM_AXIS Epm_nEngLRes EngN_LRes 9 0.00 10200. FORMAT "%5.0" AXIS_PTS_REF SNM09ESUB /end AXIS_DESCR
/end CHARACTERISTIC
/begin CHARACTERISTIC KFBADESS "factor acceleration enrichment direct injection for bad fuel" MAP 0x8051D984 RB_MapGroup_U16 31.99951 fak_uw_b32 0.00 31.99951 FORMAT "%8.5"
 /begin AXIS_DESCR COM_AXIS InjSys_tTraCmp10ms temp_ub_q0p75_o48 9 -48.0 143.3 FORMAT "%5.1" AXIS_PTS_REF STM09ESUB /end AXIS_DESCR
 /begin AXIS_DESCR COM_AXIS Epm_nEngLRes EngN_LRes 9 0.00 10200. FORMAT "%5.0" AXIS_PTS_REF SNM09ESUB /end AXIS_DESCR
/end CHARACTERISTIC
/begin CHARACTERISTIC KFBAKLHI "factor accel. enrichment (short- and long-time part) with intake valve in hi-lift profile" MAP 0x8051DA26 RB_MapGroup_U16 31.99951 fak_uw_b32 0.00 31.99951 FORMAT "%8.5"
 /begin AXIS_DESCR COM_AXIS InjSys_tTraCmp10ms temp_ub_q0p75_o48 9 -48.0 143.3 FORMAT "%5.1" AXIS_PTS_REF STM09ESUB /end AXIS_DESCR
 /begin AXIS_DESCR COM_AXIS Epm_nEngLRes EngN_LRes 7 0.00 10200. FORMAT "%5.0" AXIS_PTS_REF SNM07ESUB /end AXIS_DESCR
/end CHARACTERISTIC
/begin CHARACTERISTIC KFCVTKOR "." MAP 0x8051DAA4 RB_Map_U16U16_S16 15.99976 fak_sw_b8 -8.000000 7.999756 FORMAT "%8.6"
 /begin AXIS_DESCR STD_AXIS InjSys_nEngTraCmp10ms nmot_uw_q0p25 5 0.00 16383.75 FORMAT "%8.2" DEPOSIT ABSOLUTE /end AXIS_DESCR
 /begin AXIS_DESCR STD_AXIS rlp_w_msg rel_uw_q0p0234 5 0.00 1535.977 FORMAT "%8.3" DEPOSIT ABSOLUTE /end AXIS_DESCR
/end CHARACTERISTIC
/begin CHARACTERISTIC KFCVTUKNM "." MAP 0x8051DAEE RB_Map_S16U8_S16 3071.953 rel_sw_q0p0468 -1536.000 1535.953 FORMAT "%8.3"
 /begin AXIS_DESCR STD_AXIS nmotuk_w nmot_uw_q0p25 8 -8192.000 8191.750 FORMAT "%8.3" DEPOSIT ABSOLUTE /end AXIS_DESCR
 /begin AXIS_DESCR STD_AXIS InjSys_tTraCmp10ms temp_ub_q0p75_o48 6 -48.0 143.3 FORMAT "%5.1" DEPOSIT ABSOLUTE /end AXIS_DESCR
/end CHARACTERISTIC
/begin CHARACTERISTIC KFFNSHO "weighting of afterstart enrichment" MAP 0x8051CCCD RB_Map_U8U8_U8 1.992188 fak_ub_b2 0.00 1.992188 FORMAT "%8.6"
 /begin AXIS_DESCR STD_AXIS EngStrt_tEngTStrtLoc temp_ub_q0p75_o48 6 -48.0 143.3 FORMAT "%5.1" DEPOSIT ABSOLUTE /end AXIS_DESCR
 /begin AXIS_DESCR STD_AXIS EngStrt_facAltiCorrnLoc fak_ub_b4 4 0.00 3.984 FORMAT "%5.3" DEPOSIT ABSOLUTE /end AXIS_DESCR
/end CHARACTERISTIC
/begin CHARACTERISTIC KFFWET "Factor temperature restart fuel mass considering ethanol concentration" MAP 0x8051E316 RB_Map_U8U8_U8 1.992188 fak_ub_b2 0.00 1.992188 FORMAT "%8.6"
 /begin AXIS_DESCR STD_AXIS anzwe dez 16 0.00 255.0 FORMAT "%5.1" DEPOSIT ABSOLUTE /end AXIS_DESCR
 /begin AXIS_DESCR STD_AXIS tmeswe temp_ub_q0p75_o48 8 -48.0 143.3 FORMAT "%5.1" DEPOSIT ABSOLUTE /end AXIS_DESCR
/end CHARACTERISTIC
/begin CHARACTERISTIC KFFWL "map warm-up factor" MAP 0x8051CCF1 RB_MapGroup_U8 1.992188 fak_ub_b2 0.00 1.992188 FORMAT "%8.6"
 /begin AXIS_DESCR COM_AXIS EngStrt_tEngTLoc temp_ub_q0p75_o48 12 -48.0 143.3 FORMAT "%5.1" AXIS_PTS_REF EngStrt_tEng12_AX /end AXIS_DESCR
 /begin AXIS_DESCR COM_AXIS EngStrt_tEngTStrtLoc temp_ub_q0p75_o48 12 -48.0 143.3 FORMAT "%5.1" AXIS_PTS_REF EngStrt_tEngStrt12_AX /end AXIS_DESCR
/end CHARACTERISTIC
/begin CHARACTERISTIC KFFWLVHG "map warm-up factor for SY_VHE" MAP 0x8051CD81 RB_MapGroup_U8 1.992188 fak_ub_b2 0.00 1.992188 FORMAT "%8.6"
 /begin AXIS_DESCR COM_AXIS EngStrt_tEngTLoc temp_ub_q0p75_o48 12 -48.0 143.3 FORMAT "%5.1" AXIS_PTS_REF EngStrt_tEng12_AX /end AXIS_DESCR
 /begin AXIS_DESCR COM_AXIS EngStrt_tEngTStrtLoc temp_ub_q0p75_o48 12 -48.0 143.3 FORMAT "%5.1" AXIS_PTS_REF EngStrt_tEngStrt12_AX /end AXIS_DESCR
/end CHARACTERISTIC
/begin CHARACTERISTIC KFHSTT "factor hot start" MAP 0x8051D1AB RB_Map_U8U8_U8 63.75 fak_ub_b64 0.00 63.75 FORMAT "%5.2"
 /begin AXIS_DESCR STD_AXIS ESSTT_tans temp_ub_q0p75_o48 6 -48.0 143.3 FORMAT "%5.1" DEPOSIT ABSOLUTE /end AXIS_DESCR
 /begin AXIS_DESCR STD_AXIS ESSTT_tmst temp_ub_q0p75_o48 3 -48.0 143.3 FORMAT "%5.1" DEPOSIT ABSOLUTE /end AXIS_DESCR
/end CHARACTERISTIC
/begin CHARACTERISTIC KFKNSTWST "Caracteristical map weighting for the factor after start by restart" MAP 0x8051CE12 RB_Map_U8U16_U8 1.992188 fak_ub_b2 0.00 1.992188 FORMAT "%8.6"
 /begin AXIS_DESCR STD_AXIS EngStrt_tEngTStrtLoc temp_ub_q0p75_o48 4 -48.0 143.3 FORMAT "%5.1" DEPOSIT ABSOLUTE /end AXIS_DESCR
 /begin AXIS_DESCR STD_AXIS tengsq1_w_msg dez 4 0.00 65535.00 FORMAT "%8.2" DEPOSIT ABSOLUTE /end AXIS_DESCR
/end CHARACTERISTIC
/begin CHARACTERISTIC KFKSTTWST "Weighing factor for Restart (Start-Stop)" MAP 0x8051D1C8 RB_Map_U16U16_U16 1.992188 fak_ub_b2 0.00 1.992188 FORMAT "%8.6" EXTENDED_LIMITS 0.00 511.9922
 /begin AXIS_DESCR STD_AXIS tengsq1_w_msg t_q1 6 0.00 65535.00 FORMAT "%8.2" DEPOSIT ABSOLUTE /end AXIS_DESCR
 /begin AXIS_DESCR STD_AXIS ESSTT_tmst temp_ub_q0p75_o48 6 -48.0000 143.2500 FORMAT "%8.4" EXTENDED_LIMITS -48.00000 49103.25 DEPOSIT ABSOLUTE /end AXIS_DESCR
/end CHARACTERISTIC
/begin CHARACTERISTIC KFLRST "Map Time Delay" MAP 0x8051CF6C RB_MapGroup_U16 327.67499992 zk5msxs_uw_b327p68 0.00500008 327.68000000 FORMAT "%12.8" EXTENDED_LIMITS 0.0050000762951 327.68000000
 /begin AXIS_DESCR COM_AXIS LamCtrl_nEngESPLANT nmot_uw_q0p25 7 0.00 16383.75 FORMAT "%8.2" AXIS_PTS_REF SNM07LSUW /end AXIS_DESCR
 /begin AXIS_DESCR COM_AXIS LamCtrl_ratFillgPlaPrm rel_uw_q0p0234 8 0.00 1535.977 FORMAT "%8.3" AXIS_PTS_REF SRL08LSUW /end AXIS_DESCR
/end CHARACTERISTIC
/begin CHARACTERISTIC KFLRSTV "Map Time Delay (for small valve lift)" MAP 0x8051CFDC RB_MapGroup_U16 327.67499992 zk5msxs_uw_b327p68 0.00500008 327.68000000 FORMAT "%12.8" EXTENDED_LIMITS 0.0050000762951 327.68000000
 /begin AXIS_DESCR COM_AXIS LamCtrl_nEngESPLANT nmot_uw_q0p25 7 0.00 16383.75 FORMAT "%8.2" AXIS_PTS_REF SNM07LSUW /end AXIS_DESCR
 /begin AXIS_DESCR COM_AXIS LamCtrl_ratFillgPlaPrm rel_uw_q0p0234 8 0.00 1535.977 FORMAT "%8.3" AXIS_PTS_REF SRL08LSUW /end AXIS_DESCR
/end CHARACTERISTIC
/begin CHARACTERISTIC KFLRSZ "Characteristic map time constant of the LRS, 16-bit" MAP 0x8051D04C RB_MapGroup_U16 655.34999985 zk10msxs_uw_b655p36 0.01000015 655.36000000 FORMAT "%12.8" EXTENDED_LIMITS 0.010000152590 655.36000000
 /begin AXIS_DESCR COM_AXIS LamCtrl_nEngESPLANT nmot_uw_q0p25 7 0.00 16383.75 FORMAT "%8.2" AXIS_PTS_REF SNM07LSUW /end AXIS_DESCR
 /begin AXIS_DESCR COM_AXIS LamCtrl_ratFillgPlaPrm rel_uw_q0p0234 8 0.00 1535.977 FORMAT "%8.3" AXIS_PTS_REF SRL08LSUW /end AXIS_DESCR
/end CHARACTERISTIC
/begin CHARACTERISTIC KFLRSZV "Characteristic map time constant (for small valve lift)" MAP 0x8051D0BC RB_MapGroup_U16 655.34999985 zk10msxs_uw_b655p36 0.01000015 655.36000000 FORMAT "%12.8" EXTENDED_LIMITS 0.010000152590 655.36000000
 /begin AXIS_DESCR COM_AXIS LamCtrl_nEngESPLANT nmot_uw_q0p25 7 0.00 16383.75 FORMAT "%8.2" AXIS_PTS_REF SNM07LSUW /end AXIS_DESCR
 /begin AXIS_DESCR COM_AXIS LamCtrl_ratFillgPlaPrm rel_uw_q0p0234 8 0.00 1535.977 FORMAT "%8.3" AXIS_PTS_REF SRL08LSUW /end AXIS_DESCR
/end CHARACTERISTIC
/begin CHARACTERISTIC KFNSA "after start increase" MAP 0x8051CE30 RB_Map_U8U16_U8 1.992188 fak_ub_b2 0.00 1.992188 FORMAT "%8.6"
 /begin AXIS_DESCR STD_AXIS tans_msg temp_ub_q0p75_o48 6 -48.0 143.3 FORMAT "%5.1" DEPOSIT ABSOLUTE /end AXIS_DESCR
 /begin AXIS_DESCR STD_AXIS NO_INPUT_QUANTITY dez 3 0.00 65535.00 FORMAT "%8.2" DEPOSIT ABSOLUTE /end AXIS_DESCR
/end CHARACTERISTIC
/begin CHARACTERISTIC KFNSAVHG "after start increase for SY_VHE" MAP 0x8051CE50 RB_Map_U8U16_U8 1.992188 fak_ub_b2 0.00 1.992188 FORMAT "%8.6"
 /begin AXIS_DESCR STD_AXIS tans_msg temp_ub_q0p75_o48 6 -48.0 143.3 FORMAT "%5.1" DEPOSIT ABSOLUTE /end AXIS_DESCR
 /begin AXIS_DESCR STD_AXIS NO_INPUT_QUANTITY dez 3 0.00 65535.00 FORMAT "%8.2" DEPOSIT ABSOLUTE /end AXIS_DESCR
/end CHARACTERISTIC
/begin CHARACTERISTIC KFVADE "factor deceleration enleanment direct injection" MAP 0x8051DB68 RB_MapGroup_U16 31.99951 fak_uw_b32 0.00 31.99951 FORMAT "%8.5"
 /begin AXIS_DESCR COM_AXIS InjSys_tTraCmp10ms temp_ub_q0p75_o48 9 -48.0 143.3 FORMAT "%5.1" AXIS_PTS_REF STM09ESUB /end AXIS_DESCR
 /begin AXIS_DESCR COM_AXIS Epm_nEngLRes EngN_LRes 9 0.00 10200. FORMAT "%5.0" AXIS_PTS_REF SNM09ESUB /end AXIS_DESCR
/end CHARACTERISTIC
/begin CHARACTERISTIC KFVADESS "factor deceleration enleanent direct injection for bad fuel" MAP 0x8051DC0A RB_MapGroup_U16 31.99951 fak_uw_b32 0.00 31.99951 FORMAT "%8.5"
 /begin AXIS_DESCR COM_AXIS InjSys_tTraCmp10ms temp_ub_q0p75_o48 9 -48.0 143.3 FORMAT "%5.1" AXIS_PTS_REF STM09ESUB /end AXIS_DESCR
 /begin AXIS_DESCR COM_AXIS Epm_nEngLRes EngN_LRes 9 0.00 10200. FORMAT "%5.0" AXIS_PTS_REF SNM09ESUB /end AXIS_DESCR
/end CHARACTERISTIC
/begin CHARACTERISTIC KFVAKLHI "Factor decel. enleanment (short- and long-time part) with intake valve in hi-lift profile" MAP 0x8051DCAC RB_MapGroup_U16 31.99951 fak_uw_b32 0.00 31.99951 FORMAT "%8.5"
 /begin AXIS_DESCR COM_AXIS InjSys_tTraCmp10ms temp_ub_q0p75_o48 9 -48.0 143.3 FORMAT "%5.1" AXIS_PTS_REF STM09ESUB /end AXIS_DESCR
 /begin AXIS_DESCR COM_AXIS Epm_nEngLRes EngN_LRes 7 0.00 10200. FORMAT "%5.0" AXIS_PTS_REF SNM07ESUB /end AXIS_DESCR
/end CHARACTERISTIC
/begin CHARACTERISTIC KFWEE "characteristic map angle end of injection" MAP 0x8051E1A0 RB_MapGroup_U8 1530. zw_q6 0.00 1530. FORMAT "%5.0"
 /begin AXIS_DESCR COM_AXIS InjSys_nEngESVW nmot_q0p25 8 0.00 16383.75 FORMAT "%8.2" AXIS_PTS_REF SNM08GKUW /end AXIS_DESCR
 /begin AXIS_DESCR COM_AXIS rl_msg rel_q0p75 8 0.00 191.3 FORMAT "%5.1" AXIS_PTS_REF SRL08GKUB /end AXIS_DESCR
/end CHARACTERISTIC
/begin CHARACTERISTIC KFWEEST "characteristic map angle end of injection during start" MAP 0x8051E1E0 RB_Map_U8U8_U8 720.0 zw_q6 0.00 720.0 FORMAT "%5.1" EXTENDED_LIMITS 0.00 1530.
 /begin AXIS_DESCR STD_AXIS InjSys_tEngESVW temp_q0p75_om48 8 -48.0 143.3 FORMAT "%5.1" DEPOSIT ABSOLUTE /end AXIS_DESCR
 /begin AXIS_DESCR STD_AXIS anztibj dez 6 0.00 255.0 FORMAT "%5.1" DEPOSIT ABSOLUTE /end AXIS_DESCR
/end CHARACTERISTIC
/begin CHARACTERISTIC KFWEETM "Injection angle correction depending on engine temperature" MAP 0x8051E220 RB_MapGroup_S8 1524. zw_q6 -762.0 762.0 FORMAT "%5.1" EXTENDED_LIMITS -768.0 762.0
 /begin AXIS_DESCR COM_AXIS InjSys_tEngESVW temp_q0p75_om48 8 -48.0 143.3 FORMAT "%5.1" AXIS_PTS_REF STM08FSUB /end AXIS_DESCR
 /begin AXIS_DESCR COM_AXIS rl_msg rel_q0p75 8 0.00 191.3 FORMAT "%5.1" AXIS_PTS_REF SRL08GKUB /end AXIS_DESCR
/end CHARACTERISTIC
/begin CHARACTERISTIC KFWFRLI "Wall film fuel map (interpolated)" MAP 0x8051DD2A RB_Map_U16U8_U16 6143.906 rel_q0p09375 0.00 6143.906 FORMAT "%8.3"
 /begin AXIS_DESCR STD_AXIS rlp_w_msg rel_uw_q0p0234 24 0.00 1535.977 FORMAT "%8.3" DEPOSIT ABSOLUTE /end AXIS_DESCR
 /begin AXIS_DESCR STD_AXIS InjSys_tTraCmp10ms temp_ub_q0p75_o48 7 -48.0 143.3 FORMAT "%5.1" DEPOSIT ABSOLUTE /end AXIS_DESCR
/end CHARACTERISTIC
/begin CHARACTERISTIC KFWFRLIHI "Wall film fuel map (interpolated)" MAP 0x8051DEB6 RB_Map_U16U8_U16 6143.906 rel_q0p09375 0.00 6143.906 FORMAT "%8.3"
 /begin AXIS_DESCR STD_AXIS rlp_w_msg rel_uw_q0p0234 24 0.00 1535.977 FORMAT "%8.3" DEPOSIT ABSOLUTE /end AXIS_DESCR
 /begin AXIS_DESCR STD_AXIS InjSys_tTraCmp10ms temp_ub_q0p75_o48 7 -48.0 143.3 FORMAT "%5.1" DEPOSIT ABSOLUTE /end AXIS_DESCR
/end CHARACTERISTIC
/begin CHARACTERISTIC KFWHSTT "map weighting of hot start factor" MAP 0x8051D22C RB_Map_U8U8_U8 1.992188 fak_ub_b2 0.00 1.992188 FORMAT "%8.6"
 /begin AXIS_DESCR STD_AXIS ESSTT_tans temp_ub_q0p75_o48 6 -48.0 143.3 FORMAT "%5.1" DEPOSIT ABSOLUTE /end AXIS_DESCR
 /begin AXIS_DESCR STD_AXIS anztist dez 8 0.00 255.0 FORMAT "%5.1" DEPOSIT ABSOLUTE /end AXIS_DESCR
/end CHARACTERISTIC
/begin CHARACTERISTIC KFWKSTAB "factor cold re-start for reduction of starting fuel" MAP 0x8051D26C RB_Map_U16U16_U16 1.992188 fak_ub_b2 0.00 1.992188 FORMAT "%8.6" EXTENDED_LIMITS 0.00 511.9922
 /begin AXIS_DESCR STD_AXIS tengsq1_w_msg t_q1 6 0.00 65535.00 FORMAT "%8.2" DEPOSIT ABSOLUTE /end AXIS_DESCR
 /begin AXIS_DESCR STD_AXIS ESSTT_tmst temp_ub_q0p75_o48 6 -48.0000 143.2500 FORMAT "%8.4" EXTENDED_LIMITS -48.00000 49103.25 DEPOSIT ABSOLUTE /end AXIS_DESCR
/end CHARACTERISTIC
/begin CHARACTERISTIC KFWKSTN "map weighting of factor cold start" MAP 0x8051D2D0 RB_Map_U8U8_U8 0.9961 fak_ub_b1 0.00 0.9961
 /begin AXIS_DESCR STD_AXIS ESSTT_tmst temp_ub_q0p75_o48 6 -48.0 143.3 FORMAT "%5.1" DEPOSIT ABSOLUTE /end AXIS_DESCR
 /begin AXIS_DESCR STD_AXIS ESSTT_nmot nmot_ub_q40 6 0.00 10200. FORMAT "%5.0" DEPOSIT ABSOLUTE /end AXIS_DESCR
/end CHARACTERISTIC
/begin CHARACTERISTIC KFWKSTT "map weighting of factor cold start" MAP 0x8051D302 RB_Map_U8U8_U8 1.992188 fak_ub_b2 0.00 1.992188 FORMAT "%8.6"
 /begin AXIS_DESCR STD_AXIS ESSTT_tmst temp_ub_q0p75_o48 12 -48.0 143.3 FORMAT "%5.1" DEPOSIT ABSOLUTE /end AXIS_DESCR
 /begin AXIS_DESCR STD_AXIS anztist dez 24 0.00 255.0 FORMAT "%5.1" DEPOSIT ABSOLUTE /end AXIS_DESCR
/end CHARACTERISTIC
/begin CHARACTERISTIC KFWKSTTSPI "map weighting of factor cold start with preinjection" MAP 0x8051D448 RB_Map_U8U8_U8 1.992188 fak_ub_b2 0.00 1.992188 FORMAT "%8.6"
 /begin AXIS_DESCR STD_AXIS ESSTT_tmst temp_ub_q0p75_o48 12 -48.0 143.3 FORMAT "%5.1" DEPOSIT ABSOLUTE /end AXIS_DESCR
 /begin AXIS_DESCR STD_AXIS anztist dez 24 0.00 255.0 FORMAT "%5.1" DEPOSIT ABSOLUTE /end AXIS_DESCR
/end CHARACTERISTIC
/begin CHARACTERISTIC KFWWLML "map weighting warm-up factor" MAP 0x8051CE70 RB_MapGroup_U8 1.992188 fak_ub_b2 0.00 1.992188 FORMAT "%8.6"
 /begin AXIS_DESCR COM_AXIS ExhMod_mAirMfIntegEngStrt m_uw_b23p3 6 0.00 23.30133 FORMAT "%8.5" AXIS_PTS_REF EngStrt_mAirMfIntegEngStrt6_AX /end AXIS_DESCR
 /begin AXIS_DESCR COM_AXIS EngStrt_tEngTStrtLoc temp_ub_q0p75_o48 8 -48.0 143.3 FORMAT "%5.1" AXIS_PTS_REF EngStrt_tEngStrt8_AX /end AXIS_DESCR
/end CHARACTERISTIC
/begin CHARACTERISTIC KFWWLMLVHG "map weighting warm-up factor for SY_VHE" MAP 0x8051CEA0 RB_MapGroup_U8 1.992188 fak_ub_b2 0.00 1.992188 FORMAT "%8.6"
 /begin AXIS_DESCR COM_AXIS ExhMod_mAirMfIntegEngStrt m_uw_b23p3 6 0.00 23.30133 FORMAT "%8.5" AXIS_PTS_REF EngStrt_mAirMfIntegEngStrt6_AX /end AXIS_DESCR
 /begin AXIS_DESCR COM_AXIS EngStrt_tEngTStrtLoc temp_ub_q0p75_o48 8 -48.0 143.3 FORMAT "%5.1" AXIS_PTS_REF EngStrt_tEngStrt8_AX /end AXIS_DESCR
/end CHARACTERISTIC
/begin CHARACTERISTIC KFWWNS "repeated start time factor" MAP 0x8051CED0 RB_Map_U8U16_U8 1.992188 fak_ub_b2 0.00 1.992188 FORMAT "%8.6"
 /begin AXIS_DESCR STD_AXIS EngStrt_tEngTStrtLoc temp_ub_q0p75_o48 8 -48.0 143.3 FORMAT "%5.1" DEPOSIT ABSOLUTE /end AXIS_DESCR
 /begin AXIS_DESCR STD_AXIS tengsq1_w_msg dez 8 0.00 65535.00 FORMAT "%8.2" DEPOSIT ABSOLUTE /end AXIS_DESCR
/end CHARACTERISTIC
/begin CHARACTERISTIC KLFIMHU "Factor pulse abrupt" CURVE 0x8051E3B0 RB_Curve_U8_U8 1.992188 fak_ub_b2 0.00 1.992188 FORMAT "%8.6"
 /begin AXIS_DESCR STD_AXIS anzwe dez 16 0.00 255.0 FORMAT "%5.1" DEPOSIT ABSOLUTE /end AXIS_DESCR
/end CHARACTERISTIC
/begin CHARACTERISTIC KLFIMWU "Factor pulse smooth" CURVE 0x8051E3D1 RB_Curve_U8_U8 1.992188 fak_ub_b2 0.00 1.992188 FORMAT "%8.6"
 /begin AXIS_DESCR STD_AXIS anzwe dez 16 0.00 255.0 FORMAT "%5.1" DEPOSIT ABSOLUTE /end AXIS_DESCR
/end CHARACTERISTIC
/begin CHARACTERISTIC KLFIMWUAC "Factor pulse smooth for AC compressor torque" CURVE 0x8051E3F2 RB_Curve_U8_U8 1.992188 fak_ub_b2 0.00 1.992188 FORMAT "%8.6"
 /begin AXIS_DESCR STD_AXIS anzwe dez 16 0.00 255.0 FORMAT "%5.1" DEPOSIT ABSOLUTE /end AXIS_DESCR
/end CHARACTERISTIC
/begin CHARACTERISTIC KLFNSKH "afterstart correction dependent of temperature for HK Mode" CURVE 0x8051CF2A RB_Curve_U8_U8 3.984 fak_ub_b4 0.00 3.984 FORMAT "%5.3"
 /begin AXIS_DESCR STD_AXIS EngStrt_tEngTStrtLoc temp_ub_q0p75_o48 4 -48.0 143.3 FORMAT "%5.1" DEPOSIT ABSOLUTE /end AXIS_DESCR
/end CHARACTERISTIC
/begin CHARACTERISTIC KLFWENM "factor temperature restart fuel mass depending of engine speed" CURVE 0x8051E413 RB_Curve_U8_U8 1.992188 fak_ub_b2 0.00 1.992188 FORMAT "%8.6"
 /begin AXIS_DESCR STD_AXIS Epm_nEngLRes EngN_LRes 4 0.00 10200. FORMAT "%5.0" DEPOSIT ABSOLUTE /end AXIS_DESCR
/end CHARACTERISTIC
/begin CHARACTERISTIC KLFWLN "characteristic line weighting warm-up factor" CURVE 0x8051CF33 RB_Curve_U8_U8 1.992188 fak_ub_b2 0.00 1.992188 FORMAT "%8.6"
 /begin AXIS_DESCR STD_AXIS Engstrt_nLoReslTypEngSpdLoc nmot_ub_q40 6 0.00 10200. FORMAT "%5.0" DEPOSIT ABSOLUTE /end AXIS_DESCR
/end CHARACTERISTIC
/begin CHARACTERISTIC KLTMOTDIFF "Difference of engine temperature during ecu-afterrun for condition hot start" CURVE 0x8051D58E RB_Curve_U8_U8 191.3 temp_ub_b191p25 0.00 191.3 FORMAT "%5.1"
 /begin AXIS_DESCR STD_AXIS ESSTT_tmotab temp_ub_q0p75_o48 6 -48.0 143.3 FORMAT "%5.1" DEPOSIT ABSOLUTE /end AXIS_DESCR
/end CHARACTERISTIC
/begin CHARACTERISTIC KLTNSUUK "Disabling time of transient control during post-cranking" CURVE 0x8051E042 RB_Curve_U8_U16_Static 655.3500 t10msxs_uw_b655p35 0.00 655.3500 FORMAT "%8.4"
 /begin AXIS_DESCR STD_AXIS InjSys_tStrtTraCmp10ms temp_ub_q0p75_o48 4 -48.0 143.3 FORMAT "%5.1" DEPOSIT ABSOLUTE /end AXIS_DESCR
/end CHARACTERISTIC
/begin CHARACTERISTIC KLVATNST "characteristic curve VA depending of the time after end of start" CURVE 0x8051E050 RB_Curve_U16_U8_Static 1.992188 fak_ub_b2 0.00 1.992188 FORMAT "%8.6"
 /begin AXIS_DESCR STD_AXIS tnst_w_msg t10msxs_uw_b655p35 4 0.00 655.3500 FORMAT "%8.4" DEPOSIT ABSOLUTE /end AXIS_DESCR
/end CHARACTERISTIC
/begin CHARACTERISTIC KLZANSFHO "characteristic line for weighting of high for afterstart deactivation" CURVE 0x8051CF40 RB_Curve_U8_U8 3.984 fak_ub_b4 0.00 3.984 FORMAT "%5.3"
 /begin AXIS_DESCR STD_AXIS EngStrt_facAltiCorrnLoc fak_ub_b4 8 0.00 3.984 FORMAT "%5.3" DEPOSIT ABSOLUTE /end AXIS_DESCR
/end CHARACTERISTIC
/begin CHARACTERISTIC KLZKWEE "line for time constant wee-filter" CURVE 0x8051E05E RB_Curve_U8_U16_Static 655.3400 t_q0p01 0.0100 655.3500 FORMAT "%8.4" EXTENDED_LIMITS 0.00 655.3500
 /begin AXIS_DESCR STD_AXIS wdwee kw_q6 2 0.00 1530. FORMAT "%5.0" DEPOSIT ABSOLUTE /end AXIS_DESCR
/end CHARACTERISTIC
/begin CHARACTERISTIC KLZYKSA "Characteristic curve for offset in pointer on cut-in factors curve" CURVE 0x8051E41C RB_FixCurve_U8_U8 255.0 dez 0.00 255.0 FORMAT "%5.1"
 /begin AXIS_DESCR FIX_AXIS anzzyksa_msg dez 5 0.00 4.000 FORMAT "%5.3" FIX_AXIS_PAR 0 0 5 /end AXIS_DESCR
/end CHARACTERISTIC
/begin CHARACTERISTIC MRFAVW "threshold to switch end of injection angle at max. driver request" CURVE 0x8051E260 RB_CurveGroup_U16 199.9969 rel_q0p003052 0.00 199.9969 FORMAT "%8.4"
 /begin AXIS_DESCR COM_AXIS InjSys_nEngESVW nmot_q0p25 8 0.00 16383.75 FORMAT "%8.2" AXIS_PTS_REF SNM08GKUW /end AXIS_DESCR
/end CHARACTERISTIC
/begin CHARACTERISTIC RKBAUM "rk-threshold for acceleration enrichment display" CURVE 0x8051E066 RB_CurveGroup_S16 1535.953 rel_sw_q0p0468 0.00 1535.953 FORMAT "%8.3" EXTENDED_LIMITS -1536.000 1535.953
 /begin AXIS_DESCR COM_AXIS InjSys_tTraCmp10ms temp_ub_q0p75_o48 9 -48.0 143.3 FORMAT "%5.1" AXIS_PTS_REF STM09ESUB /end AXIS_DESCR
/end CHARACTERISTIC
/begin CHARACTERISTIC RKUKKLU "threshold sum of long-/short term" VALUE 0x8051E078 RB_Val_Wu16 1535.953 rel_sw_b1536 0.00 1535.953 FORMAT "%8.3" EXTENDED_LIMITS 0.00 3071.953 /end CHARACTERISTIC
/begin CHARACTERISTIC RKVAUM "rk-threshold for deceleration enleanment display" CURVE 0x8051E07A RB_CurveGroup_S16 1536.000 rel_sw_q0p0468 -1536.000 0.00 FORMAT "%8.3" EXTENDED_LIMITS -1536.000 1535.953
 /begin AXIS_DESCR COM_AXIS InjSys_tTraCmp10ms temp_ub_q0p75_o48 9 -48.0 143.3 FORMAT "%5.1" AXIS_PTS_REF STM09ESUB /end AXIS_DESCR
/end CHARACTERISTIC
/begin AXIS_PTS SNM07ESUB "Base point distribution of engine speed, 14 base pts." 0x8051E08C Epm_nEngLRes RB_Axis_U8 10200. EngN_LRes 7 0.00 10200. FORMAT "%5.0" DEPOSIT ABSOLUTE /end AXIS_PTS
/begin AXIS_PTS SNM07LSUW "Base point distribution for LRS controller parameters" 0x8051D12C LamCtrl_nEngESPLANT RB_Axis_U16 16383.75 nmot_uw_q0p25 7 0.00 16383.75 FORMAT "%8.2" DEPOSIT ABSOLUTE /end AXIS_PTS
/begin AXIS_PTS SNM08GKUW "Datapoint distribution mixture control" 0x8051E270 InjSys_nEngESVW RB_Axis_U16 16383.75 nmot_q0p25 8 0.00 16383.75 FORMAT "%8.2" DEPOSIT ABSOLUTE /end AXIS_PTS
/begin AXIS_PTS SNM09ESUB "Base point distribution of engine speed, 9 base pts." 0x8051E094 Epm_nEngLRes RB_Axis_U8 10200. EngN_LRes 9 0.00 10200. FORMAT "%5.0" DEPOSIT ABSOLUTE /end AXIS_PTS
/begin AXIS_PTS SRL08GKUB "Datapoint distribution mixture control 8 rl datapoints" 0x8051E282 rl_msg RB_Axis_U8 191.3 rel_q0p75 8 0.00 191.3 FORMAT "%5.1" DEPOSIT ABSOLUTE /end AXIS_PTS
/begin AXIS_PTS SRL08LSUW "air charge set points for the controller parameters" 0x8051D13C LamCtrl_ratFillgPlaPrm RB_Axis_U16 1535.977 rel_uw_q0p0234 8 0.00 1535.977 FORMAT "%8.3" DEPOSIT ABSOLUTE /end AXIS_PTS
/begin AXIS_PTS STM08FSUB "Grid-point distribution of temperature of engine at start" 0x8051E28B InjSys_tEngESVW RB_Axis_U8 191.3 temp_q0p75_om48 8 -48.0 143.3 FORMAT "%5.1" DEPOSIT ABSOLUTE /end AXIS_PTS
/begin AXIS_PTS STM09ESUB "Base point distribution of engine temperature, 9 base pts." 0x8051E09E InjSys_tTraCmp10ms RB_Axis_U8 191.3 temp_ub_q0p75_o48 9 -48.0 143.3 FORMAT "%5.1" DEPOSIT ABSOLUTE /end AXIS_PTS
/begin CHARACTERISTIC SZANSSM1 "switching level 1 of afterstart enrichment" CURVE 0x8051CF51 RB_CurveGroup_U8 1.000000 fak_ub_b2 0.00 1.000000 FORMAT "%8.6" EXTENDED_LIMITS 0.00 1.992188
 /begin AXIS_DESCR COM_AXIS EngStrt_tEngTStrtLoc temp_ub_q0p75_o48 12 -48.0 143.3 FORMAT "%5.1" AXIS_PTS_REF EngStrt_tEngStrt12_AX /end AXIS_DESCR
/end CHARACTERISTIC
/begin CHARACTERISTIC SZANSSM2 "switching level 2 of afterstart enrichment" CURVE 0x8051CF5D RB_CurveGroup_U8 1.000000 fak_ub_b2 0.00 1.000000 FORMAT "%8.6" EXTENDED_LIMITS 0.00 1.992188
 /begin AXIS_DESCR COM_AXIS EngStrt_tEngTStrtLoc temp_ub_q0p75_o48 12 -48.0 143.3 FORMAT "%5.1" AXIS_PTS_REF EngStrt_tEngStrt12_AX /end AXIS_DESCR
/end CHARACTERISTIC
/begin CHARACTERISTIC TANDT "threshold difference intake air temperature for hot start" CURVE 0x8051D59B RB_Curve_U8_U8 191.3 temp_ub_b191p25 0.00 191.3 FORMAT "%5.1"
 /begin AXIS_DESCR STD_AXIS ESSTT_tansab temp_ub_q0p75_o48 8 -48.0 143.3 FORMAT "%5.1" DEPOSIT ABSOLUTE /end AXIS_DESCR
/end CHARACTERISTIC
/begin CHARACTERISTIC TANH "intake air temperature - threshold warm" VALUE 0x8051D5AC RB_Val_Wu8 191.3 temp_ub_q0p75_o48 -48.0 143.3 FORMAT "%5.1" /end CHARACTERISTIC
/begin CHARACTERISTIC TKRF "Fuel delay time fr. injection valve to intake valve" VALUE 0x8051E0A8 RB_Val_Wu8 25.50 txms_uw_q0p1 0.00 25.50 FORMAT "%5.2" /end CHARACTERISTIC
/begin CHARACTERISTIC TMH "engine-temperature - threshold warm" VALUE 0x8051D5AD RB_Val_Wu8 191.3 temp_ub_q0p75_o48 -48.0 143.3 FORMAT "%5.1" /end CHARACTERISTIC
/begin CHARACTERISTIC TMHSG "engine temp. hot-start limit" VALUE 0x8051D5AE RB_Val_Wu8 191.3 temp_ub_q0p75_o48 -48.0 143.3 FORMAT "%5.1" /end CHARACTERISTIC
/begin CHARACTERISTIC TMK "engine-temperature - threshold cold" VALUE 0x8051D5AF RB_Val_Wu8 191.3 temp_ub_q0p75_o48 -48.0 143.3 FORMAT "%5.1" /end CHARACTERISTIC
/begin CHARACTERISTIC TMODT "Threshold difference coolant temperature for hot start" CURVE 0x8051D5B0 RB_Curve_U8_U8 191.3 temp_ub_b191p25 0.00 191.3 FORMAT "%5.1"
 /begin AXIS_DESCR STD_AXIS ESSTT_tmotab temp_ub_q0p75_o48 3 -48.0 143.3 FORMAT "%5.1" DEPOSIT ABSOLUTE /end AXIS_DESCR
/end CHARACTERISTIC
/begin CHARACTERISTIC TWSTT "threshold soak time for re-start" CURVE 0x8051D5B8 RB_Curve_U8_U16_Static 65535.00 t1sxs_uw_q1 0.00 65535.00 FORMAT "%8.2"
 /begin AXIS_DESCR STD_AXIS ESSTT_tmotab temp_ub_q0p75_o48 12 -48.0 143.3 FORMAT "%5.1" DEPOSIT ABSOLUTE /end AXIS_DESCR
/end CHARACTERISTIC
/begin CHARACTERISTIC WEAN "angle injection break off" CURVE 0x8051E294 RB_CurveGroup_U8 1530. zw_q6 0.00 1530. FORMAT "%5.0"
 /begin AXIS_DESCR COM_AXIS InjSys_nEngESVW nmot_q0p25 8 0.00 16383.75 FORMAT "%8.2" AXIS_PTS_REF SNM08GKUW /end AXIS_DESCR
/end CHARACTERISTIC
/begin CHARACTERISTIC WEEMRFAN "end of injection angle at max relative driver request" CURVE 0x8051E29C RB_CurveGroup_U8 1530. zw_q6 0.00 1530. FORMAT "%5.0"
 /begin AXIS_DESCR COM_AXIS InjSys_nEngESVW nmot_q0p25 8 0.00 16383.75 FORMAT "%8.2" AXIS_PTS_REF SNM08GKUW /end AXIS_DESCR
/end CHARACTERISTIC
/begin CHARACTERISTIC WEESTSM "angle end of injection for simultaneous pulses during start, f(tmot)" CURVE 0x8051E2A4 RB_CurveGroup_U8 1530. zw_q6 0.00 1530. FORMAT "%5.0"
 /begin AXIS_DESCR COM_AXIS InjSys_tEngESVW temp_q0p75_om48 8 -48.0 143.3 FORMAT "%5.1" AXIS_PTS_REF STM08FSUB /end AXIS_DESCR
/end CHARACTERISTIC
/begin CHARACTERISTIC WESSOT "Angle: intake closes late until TDC" VALUE 0x8051E2AC RB_Val_Wu8 717.2 kw_q2p8125 0.00 717.2 FORMAT "%5.1" /end CHARACTERISTIC
/begin CHARACTERISTIC ZBAKMHI "reduction factor K-memory (tmot) for decel. enleanment with intake valve in hi-lift profile" CURVE 0x8051E0A9 RB_CurveGroup_U8 0.9961 fak_q0p0039 0.00 0.9961
 /begin AXIS_DESCR COM_AXIS InjSys_tTraCmp10ms temp_ub_q0p75_o48 9 -48.0 143.3 FORMAT "%5.1" AXIS_PTS_REF STM09ESUB /end AXIS_DESCR
/end CHARACTERISTIC
/begin CHARACTERISTIC ZBALMHI "reduction factor L-memory (tmot) for accel. enrichment with intake valve in hi-lift profile" CURVE 0x8051E0B2 RB_CurveGroup_U8 0.1245 fak_ub_b0p125 0.00 0.1245 FORMAT "%6.4"
 /begin AXIS_DESCR COM_AXIS InjSys_tTraCmp10ms temp_ub_q0p75_o48 9 -48.0 143.3 FORMAT "%5.1" AXIS_PTS_REF STM09ESUB /end AXIS_DESCR
/end CHARACTERISTIC
/begin CHARACTERISTIC ZBURNLIM "threshold detected combustions for re-start" VALUE 0x8051D5DE RB_Val_Wu8 255.0 dez 0.00 255.0 FORMAT "%5.1" /end CHARACTERISTIC
/begin CHARACTERISTIC ZDGZA1 "Number of ignitions for decrease in range 1" VALUE 0x8051CF69 RB_Val_Wu8 255.0 dez 0.00 255.0 FORMAT "%5.1" /end CHARACTERISTIC
/begin CHARACTERISTIC ZDGZA2 "Number of ignitions for decrease in range 2" VALUE 0x8051CF6A RB_Val_Wu8 255.0 dez 0.00 255.0 FORMAT "%5.1" /end CHARACTERISTIC
/begin CHARACTERISTIC ZDGZA3 "Number of ignitions for decrease in range 3" VALUE 0x8051CF6B RB_Val_Wu8 255.0 dez 0.00 255.0 FORMAT "%5.1" /end CHARACTERISTIC
/begin CHARACTERISTIC ZUKNM "Time constant transient control direct injection, tmot dependent" CURVE 0x8051E0BC RB_CurveGroup_U16 655.3400 t_q0p01 0.0100 655.3500 FORMAT "%8.4" EXTENDED_LIMITS 0.00 655.3500
 /begin AXIS_DESCR COM_AXIS InjSys_tTraCmp10ms temp_ub_q0p75_o48 9 -48.0 143.3 FORMAT "%5.1" AXIS_PTS_REF STM09ESUB /end AXIS_DESCR
/end CHARACTERISTIC
/begin CHARACTERISTIC ZUKNSTM "time constant of transient control post cranking factor dependent on engine temperature" CURVE 0x8051E0CE RB_CurveGroup_U16 6553.400 t_q0p1 0.100 6553.500 FORMAT "%8.3" EXTENDED_LIMITS 0.00 6553.500
 /begin AXIS_DESCR COM_AXIS InjSys_tTraCmp10ms temp_ub_q0p75_o48 9 -48.0 143.3 FORMAT "%5.1" AXIS_PTS_REF STM09ESUB /end AXIS_DESCR
/end CHARACTERISTIC
/begin CHARACTERISTIC ZVAKMHI "reduction factor K-memory (tmot) for decel. enleanment with intake valve in hi-lift profile" CURVE 0x8051E0E0 RB_CurveGroup_U8 0.9961 fak_q0p0039 0.00 0.9961
 /begin AXIS_DESCR COM_AXIS InjSys_tTraCmp10ms temp_ub_q0p75_o48 9 -48.0 143.3 FORMAT "%5.1" AXIS_PTS_REF STM09ESUB /end AXIS_DESCR
/end CHARACTERISTIC
/begin CHARACTERISTIC ZVALMHI "reduction factor L-memory (tmot) for decel. enleanment with intake valve in hi-lift profile" CURVE 0x8051E0E9 RB_CurveGroup_U8 0.1245 fak_ub_b0p125 0.00 0.1245 FORMAT "%6.4"
 /begin AXIS_DESCR COM_AXIS InjSys_tTraCmp10ms temp_ub_q0p75_o48 9 -48.0 143.3 FORMAT "%5.1" AXIS_PTS_REF STM09ESUB /end AXIS_DESCR
/end CHARACTERISTIC
/*********** End of merged MEASUREMENT blocks ***********/
/begin MEASUREMENT abak "share factor wall wetting for acceleration enrichment" UBYTE fak_ub_b1 1 100 0.00 0.9961 ECU_ADDRESS 0x50000F7D /end MEASUREMENT
/begin MEASUREMENT anztibj "injection counter limited, increased for triple calculation" UBYTE dez 1 100 0.00 255.0 FORMAT "%5.1" ECU_ADDRESS 0x60000737 /end MEASUREMENT
/begin MEASUREMENT anztist "ti-counter at start" UBYTE dez 1 100 0.00 255.0 FORMAT "%5.1" ECU_ADDRESS 0x60000738 /end MEASUREMENT
/begin MEASUREMENT anzwe "Number of processed cut-in factor after compensation" UBYTE dez 1 100 0.00 255.0 FORMAT "%5.1" ECU_ADDRESS 0x60000739 /end MEASUREMENT
/begin MEASUREMENT anzwefim "number of processed fuel cut-in factors" UBYTE dez 1 100 0.00 255.0 FORMAT "%5.1" ECU_ADDRESS 0x700019D4 /end MEASUREMENT
/begin MEASUREMENT anzzyksa_msg "Number of working cycles with full cut-off" UBYTE dez 1 100 0.00 255.0 FORMAT "%5.1" ECU_ADDRESS 0x70001C0E /end MEASUREMENT
/begin MEASUREMENT avak "share factor wall wetting for deceleration enleanment" UBYTE fak_ub_b1 1 100 0.00 0.9961 ECU_ADDRESS 0x50000F7E /end MEASUREMENT
/begin MEASUREMENT avatnst "reduction of VA for the time after end of start" UBYTE fak_ub_b2 1 100 0.00 1.992188 FORMAT "%8.6" ECU_ADDRESS 0x60000C4E /end MEASUREMENT
/begin MEASUREMENT azylwe "number of processed cut-in cylinders" UBYTE dez 1 100 0.00 255.0 FORMAT "%5.1" ECU_ADDRESS 0x6000073B /end MEASUREMENT
/begin MEASUREMENT BBSTVE_stvsetFF "Trigger simultaneous preinjection flip flop" UBYTE B_TRUE 1 100 0.00 1.00000000000 BIT_MASK 0x1 FORMAT "%13.11" ECU_ADDRESS 0x70000262 /end MEASUREMENT
/begin MEASUREMENT bdemodkw_msg "GDI desired mode catalyst warming." UBYTE dez 1 100 0.00 255.0 FORMAT "%5.1" ECU_ADDRESS 0x6000A000 /end MEASUREMENT
/begin MEASUREMENT B_afwe "flag number of restart fuel feed factors" UBYTE B_TRUE 1 100 0.00 1.00000000000 BIT_MASK 0x1 FORMAT "%13.11" ECU_ADDRESS 0x70000255 /end MEASUREMENT
/begin MEASUREMENT B_anfhsgkw_msg "Requirement HOS mode throttled for catalyst warming." UBYTE B_TRUE 1 100 0.00 1.00000000000 BIT_MASK 0x1 FORMAT "%13.11" ECU_ADDRESS 0x70000AC1 /end MEASUREMENT
/begin MEASUREMENT B_anfscgkw_msg "Requirement stratified mode throttled for catalyst warming." UBYTE B_TRUE 1 100 0.00 1.00000000000 BIT_MASK 0x1 FORMAT "%13.11" ECU_ADDRESS 0x70000AC0 /end MEASUREMENT
/begin MEASUREMENT B_bag_msg "Condition large acceleration enrichment" UBYTE B_TRUE 1 100 0.00 1.00000000000 BIT_MASK 0x1 FORMAT "%13.11" ECU_ADDRESS 0x60000165 /end MEASUREMENT
/begin MEASUREMENT B_ba_msg "Condition acceleration enrichment (display)" UBYTE B_TRUE 1 100 0.00 1.00000000000 BIT_MASK 0x1 FORMAT "%13.11" ECU_ADDRESS 0x60000166 /end MEASUREMENT
/begin MEASUREMENT B_bbmrkh_msg "Operation condition for catalyst heating by spark retard (torque reserve)" UBYTE B_TRUE 1 100 0.00 1.00000000000 BIT_MASK 0x1 FORMAT "%13.11" ECU_ADDRESS 0x70000AB4 /end MEASUREMENT
/begin MEASUREMENT B_eepesstt "Condition Powerfail EEPROM %ESSTT" UBYTE B_TRUE 1 100 0.00 1.00000000000 BIT_MASK 0x1 FORMAT "%13.11" ECU_ADDRESS 0x6003498A /end MEASUREMENT
/begin MEASUREMENT B_flbtskat_msg "Condition component protection regarding catalyst temperature" UBYTE B_TRUE 1 100 0.00 1.00000000000 BIT_MASK 0x1 FORMAT "%13.11" ECU_ADDRESS 0x60009FCD /end MEASUREMENT
/begin MEASUREMENT B_fnsoff_msg "Condition switch off calculation of afterstart" UBYTE B_TRUE 1 100 0.00 1.00000000000 BIT_MASK 0x1 FORMAT "%13.11" ECU_ADDRESS 0x70000A62 /end MEASUREMENT
/begin MEASUREMENT B_fwe_msg "Condition factor fuel cut-in" UBYTE B_TRUE 1 100 0.00 1.00000000000 BIT_MASK 0x1 FORMAT "%13.11" ECU_ADDRESS 0x70000A53 /end MEASUREMENT
/begin MEASUREMENT B_fwloff_msg "Condition switch off calculation of warm-up" UBYTE B_TRUE 1 100 0.00 1.00000000000 BIT_MASK 0x1 FORMAT "%13.11" ECU_ADDRESS 0x70000A52 /end MEASUREMENT
/begin MEASUREMENT B_hstnl_msg "condition hot start caused by engine temperature during ecu-afterrun" UBYTE B_TRUE 1 100 0.00 1.00000000000 BIT_MASK 0x1 FORMAT "%13.11" ECU_ADDRESS 0x70000A2C /end MEASUREMENT
/begin MEASUREMENT B_hst_msg "condition hot start" UBYTE B_TRUE 1 100 0.00 1.00000000000 BIT_MASK 0x1 FORMAT "%13.11" ECU_ADDRESS 0x600349A1 /end MEASUREMENT
/begin MEASUREMENT B_khakt_msg "request catalyst heating by cold engine" UBYTE B_TRUE 1 100 0.00 1.00000000000 BIT_MASK 0x1 FORMAT "%13.11" ECU_ADDRESS 0x70000A27 /end MEASUREMENT
/begin MEASUREMENT B_khakw_msg "request catalyst heating in case of warming catalyst" UBYTE B_TRUE 1 100 0.00 1.00000000000 BIT_MASK 0x1 FORMAT "%13.11" ECU_ADDRESS 0x70000A26 /end MEASUREMENT
/begin MEASUREMENT B_khan_msg "request of activated catalyst heating in connection with the condition when the engine speed is greated than a minimum threshold" UBYTE B_TRUE 1 100 0.00 1.00000000000 BIT_MASK 0x1 FORMAT "%13.11" ECU_ADDRESS 0x70000A25 /end MEASUREMENT
/begin MEASUREMENT B_khasuhsp_msg "request for catalyst heating for desulphurisation with homogenous spliten zur Entschwefelung mit HSP" UBYTE B_TRUE 1 100 0.00 1.00000000000 BIT_MASK 0x1 FORMAT "%13.11" ECU_ADDRESS 0x70000A24 /end MEASUREMENT
/begin MEASUREMENT B_khat_msg "request of activated catalyst heating (transmitted to CAN)" UBYTE B_TRUE 1 100 0.00 1.00000000000 BIT_MASK 0x1 FORMAT "%13.11" ECU_ADDRESS 0x70000A23 /end MEASUREMENT
/begin MEASUREMENT B_kha_msg "request of activated catalyst heating" UBYTE B_TRUE 1 100 0.00 1.00000000000 BIT_MASK 0x1 FORMAT "%13.11" ECU_ADDRESS 0x70000A28 /end MEASUREMENT
/begin MEASUREMENT B_kherr_msg "error caused disable condition for bit B_kh" UBYTE B_TRUE 1 100 0.00 1.00000000000 BIT_MASK 0x1 FORMAT "%13.11" ECU_ADDRESS 0x70000A21 /end MEASUREMENT
/begin MEASUREMENT B_khmr_msg "condition catalyst heating with torque reserve" UBYTE B_TRUE 1 100 0.00 1.00000000000 BIT_MASK 0x1 FORMAT "%13.11" ECU_ADDRESS 0x70000A20 /end MEASUREMENT
/begin MEASUREMENT B_kh_msg "condition catalyst heating activated" UBYTE B_TRUE 1 100 0.00 1.00000000000 BIT_MASK 0x1 FORMAT "%13.11" ECU_ADDRESS 0x70000A29 /end MEASUREMENT
/begin MEASUREMENT B_kw_msg "Condition catalyst warming" UBYTE B_TRUE 1 100 0.00 1.00000000000 BIT_MASK 0x1 FORMAT "%13.11" ECU_ADDRESS 0x70000A19 /end MEASUREMENT
/begin MEASUREMENT B_laspkt_msg "condition lambda split for catalyst heating in case of a cold start" UBYTE B_TRUE 1 100 0.00 1.00000000000 BIT_MASK 0x1 FORMAT "%13.11" ECU_ADDRESS 0x70000A0D /end MEASUREMENT
/begin MEASUREMENT B_laspkw_msg "condition lambda split for catalyst warming" UBYTE B_TRUE 1 100 0.00 1.00000000000 BIT_MASK 0x1 FORMAT "%13.11" ECU_ADDRESS 0x70000A0C /end MEASUREMENT
/begin MEASUREMENT B_mdein_msg "Condition actions on the torque are active" UBYTE B_TRUE 1 100 0.00 1.00000000000 BIT_MASK 0x1 FORMAT "%13.11" ECU_ADDRESS 0x700009F2 /end MEASUREMENT
/begin MEASUREMENT B_mibeg_msg "condition torque limit active" UBYTE B_TRUE 1 100 0.00 1.00000000000 BIT_MASK 0x1 FORMAT "%13.11" ECU_ADDRESS 0x700009EF /end MEASUREMENT
/begin MEASUREMENT B_mrfamx "angle injection-end activated by maximum desired driver request torque" UBYTE B_TRUE 1 100 0.00 1.00000000000 BIT_MASK 0x1 FORMAT "%13.11" ECU_ADDRESS 0x70000256 /end MEASUREMENT
/begin MEASUREMENT B_redkl "Enable reduction of K- and L-Memory" UBYTE B_TRUE 1 100 0.00 1.00000000000 BIT_MASK 0x1 FORMAT "%13.11" ECU_ADDRESS 0x7000025C /end MEASUREMENT
/begin MEASUREMENT B_sa_msg "Fuel cut-off" UBYTE B_TRUE 1 100 0.00 1.00000000000 BIT_MASK 0x1 FORMAT "%13.11" ECU_ADDRESS 0x700009B9 /end MEASUREMENT
/begin MEASUREMENT B_trkh_msg "Flag for catalyst fast heating" UBYTE B_TRUE 1 100 0.00 1.00000000000 BIT_MASK 0x1 FORMAT "%13.11" ECU_ADDRESS 0x70000977 /end MEASUREMENT
/begin MEASUREMENT B_trkonz2_msg "condition catalyst heating is realising with thermo reactor concept (Bank2)" UBYTE B_TRUE 1 100 0.00 1.00000000000 BIT_MASK 0x1 FORMAT "%13.11" ECU_ADDRESS 0x70000976 /end MEASUREMENT
/begin MEASUREMENT B_trkonz_msg "condition catalyst heating is realising with thermo reactor concept" UBYTE B_TRUE 1 100 0.00 1.00000000000 BIT_MASK 0x1 FORMAT "%13.11" ECU_ADDRESS 0x70000975 /end MEASUREMENT
/begin MEASUREMENT B_uk1 "Enable condition for transient control" UBYTE B_TRUE 1 100 0.00 1.00000000000 BIT_MASK 0x1 FORMAT "%13.11" ECU_ADDRESS 0x7000025B /end MEASUREMENT
/begin MEASUREMENT B_ukg_msg "condition transient control activated" UBYTE B_TRUE 1 100 0.00 1.00000000000 BIT_MASK 0x1 FORMAT "%13.11" ECU_ADDRESS 0x7000096B /end MEASUREMENT
/begin MEASUREMENT B_ukk "Enable condition short time part of transient control" UBYTE B_TRUE 1 100 0.00 1.00000000000 BIT_MASK 0x1 FORMAT "%13.11" ECU_ADDRESS 0x7000025A /end MEASUREMENT
/begin MEASUREMENT B_ukns "Enable condition transient contr. after cranking" UBYTE B_TRUE 1 100 0.00 1.00000000000 BIT_MASK 0x1 FORMAT "%13.11" ECU_ADDRESS 0x600000E6 /end MEASUREMENT
/begin MEASUREMENT B_vaau "Condition decel. enleanment for partition of fuel film" UBYTE B_TRUE 1 100 0.00 1.00000000000 BIT_MASK 0x1 FORMAT "%13.11" ECU_ADDRESS 0x70000259 /end MEASUREMENT
/begin MEASUREMENT B_vacvt "." UBYTE B_TRUE 1 100 0.00 1.00000000000 BIT_MASK 0x1 FORMAT "%13.11" ECU_ADDRESS 0x70000258 /end MEASUREMENT
/begin MEASUREMENT B_vag_msg "Condition large deceleration enleanment" UBYTE B_TRUE 1 100 0.00 1.00000000000 BIT_MASK 0x1 FORMAT "%13.11" ECU_ADDRESS 0x60000125 /end MEASUREMENT
/begin MEASUREMENT B_vakl "Condition decel. enleanment L- and K-part" UBYTE B_TRUE 1 100 0.00 1.00000000000 BIT_MASK 0x1 FORMAT "%13.11" ECU_ADDRESS 0x70000257 /end MEASUREMENT
/begin MEASUREMENT B_va_msg "Condition deceleration enleanment (display)" UBYTE B_TRUE 1 100 0.00 1.00000000000 BIT_MASK 0x1 FORMAT "%13.11" ECU_ADDRESS 0x60000126 /end MEASUREMENT
/begin MEASUREMENT B_vbmg_msg "condition combustion possible" UBYTE B_TRUE 1 100 0.00 1.00000000000 BIT_MASK 0x1 FORMAT "%13.11" ECU_ADDRESS 0x70000967 /end MEASUREMENT
/begin MEASUREMENT B_wf "Condition wall wetting calculation" UBYTE B_TRUE 1 100 0.00 1.00000000000 BIT_MASK 0x1 FORMAT "%13.11" ECU_ADDRESS 0x600000E5 /end MEASUREMENT
/begin MEASUREMENT B_wks_msg "Condition cold restart" UBYTE B_TRUE 1 100 0.00 1.00000000000 BIT_MASK 0x1 FORMAT "%13.11" ECU_ADDRESS 0x70000956 /end MEASUREMENT
/begin MEASUREMENT B_wst0 "Condition restart (part 1: combustions detected)" UBYTE B_TRUE 1 100 0.00 1.00000000000 BIT_MASK 0x1 FORMAT "%13.11" ECU_ADDRESS 0x60034989 /end MEASUREMENT
/begin MEASUREMENT B_wst1 "Condition restart (part 2: soak time)" UBYTE B_TRUE 1 100 0.00 1.00000000000 BIT_MASK 0x1 FORMAT "%13.11" ECU_ADDRESS 0x70000261 /end MEASUREMENT
/begin MEASUREMENT B_wst2 "Condition restart (part1: combustions detected in last cycle)" UBYTE B_TRUE 1 100 0.00 1.00000000000 BIT_MASK 0x1 FORMAT "%13.11" ECU_ADDRESS 0x70000260 /end MEASUREMENT
/begin MEASUREMENT B_wst_msg "condition for restart" UBYTE B_TRUE 1 100 0.00 1.00000000000 BIT_MASK 0x1 FORMAT "%13.11" ECU_ADDRESS 0x70000955 /end MEASUREMENT
/begin MEASUREMENT B_zwsol_msg "Condition for computation of desired ignition angle" UBYTE B_TRUE 1 100 0.00 1.00000000000 BIT_MASK 0x1 FORMAT "%13.11" ECU_ADDRESS 0x7000094B /end MEASUREMENT
/begin MEASUREMENT CatH_TempSelnCat1B1_I.tCatAvrg "class instance for catalyst heating temperature selection for catalyst 1 bank1 / Average temperature catalyst 1" SWORD Temp_Cels 1 100 -3549.940 3003.560 FORMAT "%8.3" ECU_ADDRESS 0x6000393E /end MEASUREMENT
/begin MEASUREMENT CatH_TempSelnCat1B1_I.tCatBrick1 "class instance for catalyst heating temperature selection for catalyst 1 bank1 / Temperature Brick 1 Catalyst 1" SWORD Temp_Cels 1 100 -3549.940 3003.560 FORMAT "%8.3" ECU_ADDRESS 0x60003940 /end MEASUREMENT
/begin MEASUREMENT CatH_TempSelnCat1B1_I.tCatBrick2 "class instance for catalyst heating temperature selection for catalyst 1 bank1 / Temperature Brick 2 Catalyst 1" SWORD Temp_Cels 1 100 -3549.940 3003.560 FORMAT "%8.3" ECU_ADDRESS 0x60003942 /end MEASUREMENT
/begin MEASUREMENT CatH_TempSelnCat1B1_I.tCatBrick3 "class instance for catalyst heating temperature selection for catalyst 1 bank1 / Temperature Brick 3 Catalyst 1" SWORD Temp_Cels 1 100 -3549.940 3003.560 FORMAT "%8.3" ECU_ADDRESS 0x60003944 /end MEASUREMENT
/begin MEASUREMENT CatH_TempSelnCat1B1_I.tCatMax "class instance for catalyst heating temperature selection for catalyst 1 bank1 / Temperature maximum catalyst 1" SWORD Temp_Cels 1 100 -3549.940 3003.560 FORMAT "%8.3" ECU_ADDRESS 0x60003946 /end MEASUREMENT
/begin MEASUREMENT CatH_TempSelnCat1B1_I.tCatMin "class instance for catalyst heating temperature selection for catalyst 1 bank1 / Temperature minimum catalyst 1" SWORD Temp_Cels 1 100 -3549.940 3003.560 FORMAT "%8.3" ECU_ADDRESS 0x60003948 /end MEASUREMENT
/begin MEASUREMENT CatH_TempSelnCat1B1_I.tCatSeln1 "class instance for catalyst heating temperature selection for catalyst 1 bank1 / selected catalyst temperature catalyst 1 for controlling the heating measures (selection1)" SWORD Temp_Cels 1 100 -3549.940 3003.560 FORMAT "%8.3" ECU_ADDRESS 0x6000394A /end MEASUREMENT
/begin MEASUREMENT CatH_TempSelnCat1B1_I.tCatSeln2 "class instance for catalyst heating temperature selection for catalyst 1 bank1 / selected catalyst temperature catalyst 1 for controlling the heating measures (selection2)" SWORD Temp_Cels 1 100 -3549.940 3003.560 FORMAT "%8.3" ECU_ADDRESS 0x6000394C /end MEASUREMENT
/begin MEASUREMENT CatH_TempSelnCat2B1_I.tCatAvrg "class instance for catalyst heating temperature selection for catalyst 2 bank1 / Average temperature catalyst 2" SWORD Temp_Cels 1 100 -3549.940 3003.560 FORMAT "%8.3" ECU_ADDRESS 0x6000392E /end MEASUREMENT
/begin MEASUREMENT CatH_TempSelnCat2B1_I.tCatBrick1 "class instance for catalyst heating temperature selection for catalyst 2 bank1 / Temperature Brick 1 Catalyst 2" SWORD Temp_Cels 1 100 -3549.940 3003.560 FORMAT "%8.3" ECU_ADDRESS 0x60003930 /end MEASUREMENT
/begin MEASUREMENT CatH_TempSelnCat2B1_I.tCatBrick2 "class instance for catalyst heating temperature selection for catalyst 2 bank1 / Temperature Brick 2 Catalyst 2" SWORD Temp_Cels 1 100 -3549.940 3003.560 FORMAT "%8.3" ECU_ADDRESS 0x60003932 /end MEASUREMENT
/begin MEASUREMENT CatH_TempSelnCat2B1_I.tCatBrick3 "class instance for catalyst heating temperature selection for catalyst 2 bank1 / Temperature Brick 3 Catalyst 2" SWORD Temp_Cels 1 100 -3549.940 3003.560 FORMAT "%8.3" ECU_ADDRESS 0x60003934 /end MEASUREMENT
/begin MEASUREMENT CatH_TempSelnCat2B1_I.tCatMax "class instance for catalyst heating temperature selection for catalyst 2 bank1 / Temperature maximum catalyst 2" SWORD Temp_Cels 1 100 -3549.940 3003.560 FORMAT "%8.3" ECU_ADDRESS 0x60003936 /end MEASUREMENT
/begin MEASUREMENT CatH_TempSelnCat2B1_I.tCatMin "class instance for catalyst heating temperature selection for catalyst 2 bank1 / Temperature minimum catalyst 2" SWORD Temp_Cels 1 100 -3549.940 3003.560 FORMAT "%8.3" ECU_ADDRESS 0x60003938 /end MEASUREMENT
/begin MEASUREMENT CatH_TempSelnCat2B1_I.tCatSeln1 "class instance for catalyst heating temperature selection for catalyst 2 bank1 / selected catalyst temperature catalyst 2 for controlling the heating measures (selection1)" SWORD Temp_Cels 1 100 -3549.940 3003.560 FORMAT "%8.3" ECU_ADDRESS 0x6000393A /end MEASUREMENT
/begin MEASUREMENT CatH_TempSelnCat2B1_I.tCatSeln2 "class instance for catalyst heating temperature selection for catalyst 2 bank1 / selected catalyst temperature catalyst 2 for controlling the heating measures (selection2)" SWORD Temp_Cels 1 100 -3549.940 3003.560 FORMAT "%8.3" ECU_ADDRESS 0x6000393C /end MEASUREMENT
/begin MEASUREMENT danzwefim_msg "offset on the number of processed fuel cut-in factors" UBYTE dez 1 100 0.00 255.0 FORMAT "%5.1" ECU_ADDRESS 0x70001C0D /end MEASUREMENT
/begin MEASUREMENT dmrmx_w_msg "delta torque for charge by torque reserve" UWORD rel_uw_b100 1 100 0.00 99.99847 FORMAT "%8.5" ECU_ADDRESS 0x6000E300 /end MEASUREMENT
/begin MEASUREMENT dtbtgsmx_w_msg "Distance to critical limits of exhaust gas temperatures upstream of catalysts (maximum choice bewteen bench1 and 2)" SWORD temp_q0p0468_K 1 100 -1536.000 1535.953 FORMAT "%8.3" ECU_ADDRESS 0x6000E304 /end MEASUREMENT
/begin MEASUREMENT dtbtkamx_w "Distance to critical limits of temperatures near catalysts (minimum choice between bench1 and 2)" SWORD temp_q0p0468_K 1 100 -1536.000 1535.953 FORMAT "%8.3" ECU_ADDRESS 0x60003968 /end MEASUREMENT
/begin MEASUREMENT dwfk_w "delta wall wetting quantity short term" SWORD rel_q0p09375 1 100 -3072.000 3071.906 FORMAT "%8.3" ECU_ADDRESS 0x700019E4 /end MEASUREMENT
/begin MEASUREMENT dwfl_w "delta wall wetting quantity long term" SWORD rel_q0p09375 1 100 -3072.000 3071.906 FORMAT "%8.3" ECU_ADDRESS 0x700019E2 /end MEASUREMENT
/begin MEASUREMENT dwf_w_msg "Delta wall hang-up quantity" SWORD rel_q0p09375 1 100 -3072.000 3071.906 FORMAT "%8.3" ECU_ADDRESS 0x500007B8 /end MEASUREMENT
/begin MEASUREMENT EngStrt_facAltiCorrnLoc "Altitude correction factor local" UBYTE fak_ub_b4 1 100 0.00 3.984 FORMAT "%5.3" ECU_ADDRESS 0x600064D7 /end MEASUREMENT
/begin MEASUREMENT EngStrt_facEthLoc "local variable for repreasenting Factor interpolation betwenn E85 (or E100) and E0 for injection functions" UBYTE fak_ub_b2 1 100 0.00 1.992188 FORMAT "%8.6" ECU_ADDRESS 0x600064D6 /end MEASUREMENT
/begin MEASUREMENT EngStrt_facWrmUpLoc "local variable representing weighting warm-up factor" UBYTE fak_ub_b2 1 100 0.00 1.992188 FORMAT "%8.6" ECU_ADDRESS 0x600064D5 /end MEASUREMENT
/begin MEASUREMENT EngStrt_flgNegPStrtInhbn "Negative Pressure Start Inhibition happened" UBYTE B_TRUE 1 100 0.00 1.00000000000 BIT_MASK 0x1 FORMAT "%13.11" ECU_ADDRESS 0x7000025F /end MEASUREMENT
/begin MEASUREMENT EngStrt_flgShDwnTiVld "shut-down time valid" UBYTE B_TRUE 1 100 0.00 1.00000000000 BIT_MASK 0x1 FORMAT "%13.11" ECU_ADDRESS 0x700007F9 /end MEASUREMENT
/begin MEASUREMENT EngStrt_nLoReslEngSpdLocal "Low resolution engsine speed local" UBYTE nmot_ub_q40 1 100 0.00 10200. FORMAT "%5.0" ECU_ADDRESS 0x600064DA /end MEASUREMENT
/begin MEASUREMENT Engstrt_nLoReslTypEngSpdLoc "Low resolution engine speed local" UBYTE nmot_ub_q40 1 100 0.00 10200. FORMAT "%5.0" ECU_ADDRESS 0x600064D4 /end MEASUREMENT
/begin MEASUREMENT EngStrt_tEngTLoc "Engine temperature local" UBYTE temp_ub_q0p75_o48 1 100 -48.0 143.3 FORMAT "%5.1" ECU_ADDRESS 0x600064D3 /end MEASUREMENT
/begin MEASUREMENT EngStrt_tEngTStrtLoc "Engine temperature start local" UBYTE temp_ub_q0p75_o48 1 100 -48.0 143.3 FORMAT "%5.1" ECU_ADDRESS 0x600064D2 /end MEASUREMENT
/begin MEASUREMENT EngStrt_tiFuCutNegPStrtInhbn "Injection Cutoff time during Negative Pressure Start Inhibition" UWORD t10msxs_uw_b655p35 1 100 0.00 655.3500 FORMAT "%8.4" ECU_ADDRESS 0x600039A8 /end MEASUREMENT
/begin MEASUREMENT EngStrt_tThdDifCooltStrt "local variable for difference in the thershold coolant temperature during start." UBYTE B_TRUE 1 100 0.00 1.00000000000 BIT_MASK 0x1 FORMAT "%13.11" ECU_ADDRESS 0x7000025E /end MEASUREMENT
/begin MEASUREMENT EngStrt_tThdDifStrt "local variable for difference in the thershold temperature during start." UBYTE B_TRUE 1 100 0.00 1.00000000000 BIT_MASK 0x1 FORMAT "%13.11" ECU_ADDRESS 0x7000025D /end MEASUREMENT
/begin MEASUREMENT ESSTT_nmot "Low resolution Engine speed" UBYTE nmot_ub_q40 1 100 0.00 10200. FORMAT "%5.0" ECU_ADDRESS 0x600006D4 /end MEASUREMENT
/begin MEASUREMENT ESSTT_tans "intake air temperature" UBYTE temp_ub_q0p75_o48 1 100 -48.0 143.3 FORMAT "%5.1" ECU_ADDRESS 0x600006D5 /end MEASUREMENT
/begin MEASUREMENT ESSTT_tansab "Intake air temperature when engine is shut-off" UBYTE temp_ub_q0p75_o48 1 100 -48.0 143.3 FORMAT "%5.1" ECU_ADDRESS 0x600064C9 /end MEASUREMENT
/begin MEASUREMENT ESSTT_tmotab "engine coolant temperature at engine stop or cut-off cranking" UBYTE temp_ub_q0p75_o48 1 100 -48.0 143.3 FORMAT "%5.1" ECU_ADDRESS 0x600064C8 /end MEASUREMENT
/begin MEASUREMENT ESSTT_tmst "Engine temp at Start" UBYTE temp_ub_q0p75_o48 1 100 -48.0 143.3 FORMAT "%5.1" ECU_ADDRESS 0x600006D6 /end MEASUREMENT
/begin MEASUREMENT Etc_ctCurRunTst "Stores the number of actual running engine tests" UBYTE OneToOne 1 100 0.00 255.0 FORMAT "%5.1" ECU_ADDRESS 0x6000A754 /end MEASUREMENT
/begin MEASUREMENT ExhCo_swtTSelnCatHeatgGpf "An application switch to select either Sensor or modelled temperature from exhaust module" UBYTE B_TRUE 1 100 0.00 1.00000000000 BIT_MASK 0x1 FORMAT "%13.11" ECU_ADDRESS 0x700007E7 /end MEASUREMENT
/begin MEASUREMENT ExhMgT_CatHeatgUpReqIf_ctReIni "counter reini for ExhMgT_CatHeatgUpReqIf" UBYTE dez 1 100 0.00 255.0 FORMAT "%5.1" ECU_ADDRESS 0x600064B8 /end MEASUREMENT
/begin MEASUREMENT ExhMgT_CatHeatgUpReq_ctReIni "Counter for recognizing the re-initialization of variables and parameters" UBYTE dez 1 100 0.00 255.0 FORMAT "%5.1" ECU_ADDRESS 0x600064B6 /end MEASUREMENT
/begin MEASUREMENT ExhMgT_facCatHeatgFinshd "terminating factor catalyst heating" UBYTE fak_ub_b1 1 100 0.00 0.9961 ECU_ADDRESS 0x6000A069 /end MEASUREMENT
/begin MEASUREMENT ExhMgT_facCatHeatgProgs "relative amount of integrated air mass at catalyst heating" UWORD fak_uw_b1 1 100 0.00 0.9999847 FORMAT "%9.7" ECU_ADDRESS 0x6000E200 /end MEASUREMENT
/begin MEASUREMENT ExhMgT_facCatHeatgRamp "factor for raising and lowering the heating measures" UBYTE fak_ub_b2 1 100 0.00 1.000000 FORMAT "%8.6" ECU_ADDRESS 0x6000A068 /end MEASUREMENT
/begin MEASUREMENT ExhMgT_facCorrnMAirCatHeatg "Air mass correction factor for catalyst heating" UWORD fak_uw_b2 1 100 0.00 1.999969 FORMAT "%8.6" ECU_ADDRESS 0x600048E6 /end MEASUREMENT
/begin MEASUREMENT ExhMgT_facCorrnTempCatHeatg "factor to calculate temperature correction factor for catalyst heating" UWORD fak_uw_b2 1 100 0.00 1.999969 FORMAT "%8.6" ECU_ADDRESS 0x600048E4 /end MEASUREMENT
/begin MEASUREMENT ExhMgT_facHeatgDmdCat "factor for demand of catalyst heating" UWORD fak_uw_b1 1 100 0.00 0.9999847 FORMAT "%9.7" ECU_ADDRESS 0x600048DE /end MEASUREMENT
/begin MEASUREMENT ExhMgT_facHeatgDmdCat1B1 "heating demand factor of catalyst1 bank1" SWORD Fact 1 100 -4.000000 3.999878 FORMAT "%8.6" ECU_ADDRESS 0x60004AE0 /end MEASUREMENT
/begin MEASUREMENT ExhMgT_facHeatgDmdCat2B1 "heating demand factor of catalyst2 bank1" SWORD Fact 1 100 -4.000000 3.999878 FORMAT "%8.6" ECU_ADDRESS 0x60004ADE /end MEASUREMENT
/begin MEASUREMENT ExhMgT_facHeatgDmdCatLoPrio "heating demand factor of catalyst with low prio" UWORD fak_uw_b1 1 100 0.00 0.9999847 FORMAT "%9.7" ECU_ADDRESS 0x600048DC /end MEASUREMENT
/begin MEASUREMENT ExhMgT_facIntrpnTCat1 "factor for interpolation for dynamic threshold cat 1" UWORD fak_uw_b2 1 100 0.00 1.000000 FORMAT "%8.6" ECU_ADDRESS 0x600039A4 /end MEASUREMENT
/begin MEASUREMENT ExhMgT_facIntrpnTCat2 "factor for interpolation for dynamic threshold cat 2" UWORD fak_uw_b2 1 100 0.00 1.000000 FORMAT "%8.6" ECU_ADDRESS 0x600039A2 /end MEASUREMENT
/begin MEASUREMENT ExhMgT_facIntrpnTMnf "factor for interpolation for dynamic threshold manifold" UWORD fak_uw_b2 1 100 0.00 1.000000 FORMAT "%8.6" ECU_ADDRESS 0x600039A0 /end MEASUREMENT
/begin MEASUREMENT ExhMgT_facLamCptProtnTExh "enabling factor for component protection dependent on modeled exhaust gas temperatures" UWORD fak_uw_b2 1 100 0.00 1.999969 FORMAT "%8.6" ECU_ADDRESS 0x600048DA /end MEASUREMENT
/begin MEASUREMENT ExhMgT_facWghtCat1Age "factor for correction of catalyst 1 parameters in dependence of catalyst ageing" UWORD fak_uw_b2 1 100 0.00 1.999969 FORMAT "%8.6" ECU_ADDRESS 0x600048D6 /end MEASUREMENT
/begin MEASUREMENT ExhMgT_facWghtCatAge "factor for correction of catalyst parameters in dependence of catalyst ageing" UWORD fak_uw_b2 1 100 0.00 1.999969 FORMAT "%8.6" ECU_ADDRESS 0x600048D4 /end MEASUREMENT
/begin MEASUREMENT ExhMgT_flgActvCptProtn "Condition to activate component protection based on exhaust temperatures" UBYTE B_TRUE 1 100 0.00 1.00000000000 BIT_MASK 0x1 FORMAT "%13.11" ECU_ADDRESS 0x60009FA7 /end MEASUREMENT
/begin MEASUREMENT ExhMgT_flgActvCptProtnTExh "Component protection by exhaust gas temperature model activated" UBYTE B_TRUE 1 100 0.00 1.00000000000 BIT_MASK 0x1 FORMAT "%13.11" ECU_ADDRESS 0x60009FA6 /end MEASUREMENT
/begin MEASUREMENT ExhMgT_flgCatActvCptProtnTExh "Component protection by exhaust gas temperature model of tht catalysts activated" UBYTE B_TRUE 1 100 0.00 1.00000000000 BIT_MASK 0x1 FORMAT "%13.11" ECU_ADDRESS 0x60009FA5 /end MEASUREMENT
/begin MEASUREMENT ExhMgT_flgCatHeatFinshd "cold catalyst heating finished" UBYTE B_TRUE 1 100 0.00 1.00000000000 BIT_MASK 0x1 FORMAT "%13.11" ECU_ADDRESS 0x700007E6 /end MEASUREMENT
/begin MEASUREMENT ExhMgT_flgCatHeatgColdStrtAltiRst "condition catalyst heating cold start is reseted due to hight and engine start temperature" UBYTE B_TRUE 1 100 0.00 1.00000000000 BIT_MASK 0x1 FORMAT "%13.11" ECU_ADDRESS 0x70000254 /end MEASUREMENT
/begin MEASUREMENT ExhMgT_flgCatHeatgColdStrtDmd "Demand for cold start catalyst heating without prioritization by the operaton mode coordinator" UBYTE B_TRUE 1 100 0.00 1.00000000000 BIT_MASK 0x1 FORMAT "%13.11" ECU_ADDRESS 0x700007E2 /end MEASUREMENT
/begin MEASUREMENT ExhMgT_flgCatHeatgColdStrtLamSplitReq "request catalyst heating by cold engine because of lambda split" UBYTE B_TRUE 1 100 0.00 1.00000000000 BIT_MASK 0x1 FORMAT "%13.11" ECU_ADDRESS 0x700007E1 /end MEASUREMENT
/begin MEASUREMENT ExhMgT_flgCatHeatgColdStrtReq "request catalyst heating by cold engine" UBYTE B_TRUE 1 100 0.00 1.00000000000 BIT_MASK 0x1 FORMAT "%13.11" ECU_ADDRESS 0x700007E0 /end MEASUREMENT
/begin MEASUREMENT ExhMgT_flgCatHeatgColdStrtRst "resetting the request for cold start catalyst heating" UBYTE B_TRUE 1 100 0.00 1.00000000000 BIT_MASK 0x1 FORMAT "%13.11" ECU_ADDRESS 0x70000253 /end MEASUREMENT
/begin MEASUREMENT ExhMgT_flgCatHeatgColdStrtWoFIdReq "request for catalyst heating due to cold start without consideration of the Fault Identifier release" UBYTE B_TRUE 1 100 0.00 1.00000000000 BIT_MASK 0x1 FORMAT "%13.11" ECU_ADDRESS 0x700007DF /end MEASUREMENT
/begin MEASUREMENT ExhMgT_flgCatHeatgEolTest "request catalyst heating for end of line test" UBYTE B_TRUE 1 100 0.00 1.00000000000 BIT_MASK 0x1 FORMAT "%13.11" ECU_ADDRESS 0x700007DD /end MEASUREMENT
/begin MEASUREMENT ExhMgT_flgCatHeatgFinshdReq "flag for terminating factor catalyst heating" UBYTE B_TRUE 1 100 0.00 1.00000000000 BIT_MASK 0x1 FORMAT "%13.11" ECU_ADDRESS 0x70000252 /end MEASUREMENT
/begin MEASUREMENT ExhMgT_flgCatHeatgFirstStrt "request catalyst heating in case of first start of combustion engine" UBYTE B_TRUE 1 100 0.00 1.00000000000 BIT_MASK 0x1 FORMAT "%13.11" ECU_ADDRESS 0x700007DC /end MEASUREMENT
/begin MEASUREMENT ExhMgT_flgCatHeatgFirstStrtFinshd "cold catalyst heating in case of first start of combustion engine regular finished" UBYTE B_TRUE 1 100 0.00 1.00000000000 BIT_MASK 0x1 FORMAT "%13.11" ECU_ADDRESS 0x700007DB /end MEASUREMENT
/begin MEASUREMENT ExhMgT_flgCatHeatgFolwStrt "following starts of combustion engine in the same driving cycle would be interpreted as a follow start for catalyst heating" UBYTE B_TRUE 1 100 0.00 1.00000000000 BIT_MASK 0x1 FORMAT "%13.11" ECU_ADDRESS 0x700007DA /end MEASUREMENT
/begin MEASUREMENT ExhMgT_flgCatHeatgFolwStrtWoStop "Triggering of catalyst heating during the driving cycle using the cold start parameterization without the internal combustion engine has to be switched off" UBYTE B_TRUE 1 100 0.00 1.00000000000 BIT_MASK 0x1 FORMAT "%13.11" ECU_ADDRESS 0x700007D9 /end MEASUREMENT
/begin MEASUREMENT ExhMgT_flgCatHeatgGpfRgnReq "request of catalyst heating for Gasoline Particulate Filter regeneration" UBYTE B_TRUE 1 100 0.00 1.00000000000 BIT_MASK 0x1 FORMAT "%13.11" ECU_ADDRESS 0x700007D8 /end MEASUREMENT
/begin MEASUREMENT ExhMgT_flgCatHeatgRed "condition for active catalyst heating with cold start parameters (reduced duration of catalyst heating)" UBYTE B_TRUE 1 100 0.00 1.00000000000 BIT_MASK 0x1 FORMAT "%13.11" ECU_ADDRESS 0x700007D6 /end MEASUREMENT
/begin MEASUREMENT ExhMgT_flgCatHeatgRepStrt "catalyst heating with cold start parameters in case of a repeated start of combustion engine in the same driving cycle" UBYTE B_TRUE 1 100 0.00 1.00000000000 BIT_MASK 0x1 FORMAT "%13.11" ECU_ADDRESS 0x700007D5 /end MEASUREMENT
/begin MEASUREMENT ExhMgT_flgCatHeatgReqActv "request catalyst heating in dependence of the current operation mode" UBYTE B_TRUE 1 100 0.00 1.00000000000 BIT_MASK 0x1 FORMAT "%13.11" ECU_ADDRESS 0x700007D4 /end MEASUREMENT
/begin MEASUREMENT ExhMgT_flgCatHeatgReqRstSnd "condition catalyst heating terminating send by CAN" UBYTE B_TRUE 1 100 0.00 1.00000000000 BIT_MASK 0x1 FORMAT "%13.11" ECU_ADDRESS 0x700007D3 /end MEASUREMENT
/begin MEASUREMENT ExhMgT_flgCatHeatgTWin2 "Condition for 2nd temperature window for catalyst heating" UBYTE B_TRUE 1 100 0.00 1.00000000000 BIT_MASK 0x1 FORMAT "%13.11" ECU_ADDRESS 0x70000251 /end MEASUREMENT
/begin MEASUREMENT ExhMgT_flgCatHeatgUpActv "Condition for requesting a catalyst heating measure with running combustion engine" UBYTE B_TRUE 1 100 0.00 1.00000000000 BIT_MASK 0x1 FORMAT "%13.11" ECU_ADDRESS 0x700007D2 /end MEASUREMENT
/begin MEASUREMENT ExhMgT_flgCatHeatgWrm "catalyst warming" UBYTE B_TRUE 1 100 0.00 1.00000000000 BIT_MASK 0x1 FORMAT "%13.11" ECU_ADDRESS 0x700007D1 /end MEASUREMENT
/begin MEASUREMENT ExhMgT_flgCatHeatgWrmAltiRst "condition catalyst warming is reseted due to hight and engine start temperature" UBYTE B_TRUE 1 100 0.00 1.00000000000 BIT_MASK 0x1 FORMAT "%13.11" ECU_ADDRESS 0x70000250 /end MEASUREMENT
/begin MEASUREMENT ExhMgT_flgCatHeatgWrmDmd "demand for catalyst heating in case of warming catalyst" UBYTE B_TRUE 1 100 0.00 1.00000000000 BIT_MASK 0x1 FORMAT "%13.11" ECU_ADDRESS 0x700007D0 /end MEASUREMENT
/begin MEASUREMENT ExhMgT_flgCatHeatgWrmReq "flag for the request of catalyst warming" UBYTE B_TRUE 1 100 0.00 1.00000000000 BIT_MASK 0x1 FORMAT "%13.11" ECU_ADDRESS 0x700007CF /end MEASUREMENT
/begin MEASUREMENT ExhMgT_flgCatHeatgWrmRst "catalyst heating request with running combustion engine (catalyst warming) based on the catalyst temperature is reset" UBYTE B_TRUE 1 100 0.00 1.00000000000 BIT_MASK 0x1 FORMAT "%13.11" ECU_ADDRESS 0x7000024F /end MEASUREMENT
/begin MEASUREMENT ExhMgT_flgCatHeatgWrmWoFIdReq "request for catalyst warming without consideration of the FId release" UBYTE B_TRUE 1 100 0.00 1.00000000000 BIT_MASK 0x1 FORMAT "%13.11" ECU_ADDRESS 0x700007CE /end MEASUREMENT
/begin MEASUREMENT ExhMgT_flgCatHeatNormFinshd "cold catalyst heating regular finished" UBYTE B_TRUE 1 100 0.00 1.00000000000 BIT_MASK 0x1 FORMAT "%13.11" ECU_ADDRESS 0x700007E5 /end MEASUREMENT
/begin MEASUREMENT ExhMgT_flgCatHeatWrmLamSplitReq "request catalyst warming because of lambda split" UBYTE B_TRUE 1 100 0.00 1.00000000000 BIT_MASK 0x1 FORMAT "%13.11" ECU_ADDRESS 0x700007E4 /end MEASUREMENT
/begin MEASUREMENT ExhMgT_flgCatHeatWrmReq "request catalyst heating by catalyst warming" UBYTE B_TRUE 1 100 0.00 1.00000000000 BIT_MASK 0x1 FORMAT "%13.11" ECU_ADDRESS 0x700007E3 /end MEASUREMENT
/begin MEASUREMENT ExhMgT_flgEngStopTCatCoolg "request for cold start catalyst heating during startstop condition" UBYTE B_TRUE 1 100 0.00 1.00000000000 BIT_MASK 0x1 FORMAT "%13.11" ECU_ADDRESS 0x7000024E /end MEASUREMENT
/begin MEASUREMENT ExhMgT_flgEngStrt "first start of combustion in driving cycle" UBYTE B_TRUE 1 100 0.00 1.00000000000 BIT_MASK 0x1 FORMAT "%13.11" ECU_ADDRESS 0x7000024D /end MEASUREMENT
/begin MEASUREMENT ExhMgT_flgEpmSpdZr "Condition for catalyst heating engine has stopped" UBYTE B_TRUE 1 100 0.00 1.00000000000 BIT_MASK 0x1 FORMAT "%13.11" ECU_ADDRESS 0x7000024C /end MEASUREMENT
/begin MEASUREMENT ExhMgT_flgExhActvCptProtnTExh "component protection by exhaust gas temperature model of the manifold activated" UBYTE B_TRUE 1 100 0.00 1.00000000000 BIT_MASK 0x1 FORMAT "%13.11" ECU_ADDRESS 0x600064C5 /end MEASUREMENT
/begin MEASUREMENT ExhMgT_flgFirstCatHeatg "Condition first catalyst heating in driving cycle" UBYTE B_TRUE 1 100 0.00 1.00000000000 BIT_MASK 0x1 FORMAT "%13.11" ECU_ADDRESS 0x7000024B /end MEASUREMENT
/begin MEASUREMENT ExhMgT_flgLimpCptProtn "Limp home of lambda for component protection because of failling of sensors of actors bench 1" UBYTE B_TRUE 1 100 0.00 1.00000000000 BIT_MASK 0x1 FORMAT "%13.11" ECU_ADDRESS 0x60009FA3 /end MEASUREMENT
/begin MEASUREMENT ExhMgT_flgNoCatHeatgDmd "There is no requirement for heating" UBYTE B_TRUE 1 100 0.00 1.00000000000 BIT_MASK 0x1 FORMAT "%13.11" ECU_ADDRESS 0x700007C5 /end MEASUREMENT
/begin MEASUREMENT ExhMgT_flgOffTemp "Condition for additional distance to critical limits of exhaust temperatures for component protection" UBYTE B_TRUE 1 100 0.00 1.00000000000 BIT_MASK 0x1 FORMAT "%13.11" ECU_ADDRESS 0x600064C4 /end MEASUREMENT
/begin MEASUREMENT ExhMgT_flgOverTCat1Max "temperature of the catalyst 1 is higher as initial threshold" UBYTE B_TRUE 1 100 0.00 1.00000000000 BIT_MASK 0x1 FORMAT "%13.11" ECU_ADDRESS 0x600064C3 /end MEASUREMENT
/begin MEASUREMENT ExhMgT_flgOverTCat2Max "temperature of the catalyst 2 is higher as initial threshold" UBYTE B_TRUE 1 100 0.00 1.00000000000 BIT_MASK 0x1 FORMAT "%13.11" ECU_ADDRESS 0x600064C2 /end MEASUREMENT
/begin MEASUREMENT ExhMgT_flgOverTMnflMax "temperature of the manifold is higher as initial threshold" UBYTE B_TRUE 1 100 0.00 1.00000000000 BIT_MASK 0x1 FORMAT "%13.11" ECU_ADDRESS 0x600064C1 /end MEASUREMENT
/begin MEASUREMENT ExhMgT_flgReqHosThd "condition for request of GDI mode HOS throttled" UBYTE B_TRUE 1 100 0.00 1.00000000000 BIT_MASK 0x1 FORMAT "%13.11" ECU_ADDRESS 0x700007C1 /end MEASUREMENT
/begin MEASUREMENT ExhMgT_flgReqLamSplitTMin "Condition for the reduction of the efficiency degradation due to the temperature reached in the catalyst for requesting Lambda Split" UBYTE B_TRUE 1 100 0.00 1.00000000000 BIT_MASK 0x1 FORMAT "%13.11" ECU_ADDRESS 0x700007C0 /end MEASUREMENT
/begin MEASUREMENT ExhMgT_flgTBlwLowrThd2HiPrio "Catalyst temperature of the higher priority catalyst is lower than the light off temperature threshold2" UBYTE B_TRUE 1 100 0.00 1.00000000000 BIT_MASK 0x1 FORMAT "%13.11" ECU_ADDRESS 0x7000024A /end MEASUREMENT
/begin MEASUREMENT ExhMgT_flgTBlwLowrThdHiPrio "Catalyst temperature of the higher priority catalyst is lower than the light off temperature threshold" UBYTE B_TRUE 1 100 0.00 1.00000000000 BIT_MASK 0x1 FORMAT "%13.11" ECU_ADDRESS 0x70000249 /end MEASUREMENT
/begin MEASUREMENT ExhMgT_flgtExhMnfMaxB1 "activation of ramping down of the dynamic manifold threshold" UBYTE B_TRUE 1 100 0.00 1.00000000000 BIT_MASK 0x1 FORMAT "%13.11" ECU_ADDRESS 0x600064C0 /end MEASUREMENT
/begin MEASUREMENT ExhMgT_flgThdCatLo "activation of component protection related to the catalyst temperature based on the system value" UBYTE B_TRUE 1 100 0.00 1.00000000000 BIT_MASK 0x1 FORMAT "%13.11" ECU_ADDRESS 0x600064BF /end MEASUREMENT
/begin MEASUREMENT ExhMgT_flgThdExhLo "activation of component protection related to the gas temperature based on the system value" UBYTE B_TRUE 1 100 0.00 1.00000000000 BIT_MASK 0x1 FORMAT "%13.11" ECU_ADDRESS 0x600064BE /end MEASUREMENT
/begin MEASUREMENT ExhMgT_flgTiCdnDynThd "activation of ramping down of the dynamic manifold threshold related to the time" UBYTE B_TRUE 1 100 0.00 1.00000000000 BIT_MASK 0x1 FORMAT "%13.11" ECU_ADDRESS 0x600064BD /end MEASUREMENT
/begin MEASUREMENT ExhMgT_flgTiCdnDynThdRst "Reset of of ramping down of the dynamic manifold threshold related to the time" UBYTE B_TRUE 1 100 0.00 1.00000000000 BIT_MASK 0x1 FORMAT "%13.11" ECU_ADDRESS 0x600064BC /end MEASUREMENT
/begin MEASUREMENT ExhMgT_flgTiCdnDynThdSet "Aktivierung des Abrampens der dynamischen Krümmertemperaturschwelle bezogen auf Zeitfaktor" UBYTE B_TRUE 1 100 0.00 1.00000000000 BIT_MASK 0x1 FORMAT "%13.11" ECU_ADDRESS 0x600064BB /end MEASUREMENT
/begin MEASUREMENT ExhMgT_flgTiOverMaxCat1 "duration of the exceedance of the initial threshold catalyst 1 is finished" UBYTE B_TRUE 1 100 0.00 1.00000000000 BIT_MASK 0x1 FORMAT "%13.11" ECU_ADDRESS 0x600064BA /end MEASUREMENT
/begin MEASUREMENT ExhMgT_flgTiOverMaxCat2 "duration of the exceedance of the initial threshold catalyst 2 is finished" UBYTE B_TRUE 1 100 0.00 1.00000000000 BIT_MASK 0x1 FORMAT "%13.11" ECU_ADDRESS 0x600064B9 /end MEASUREMENT
/begin MEASUREMENT ExhMgT_flgTLightOffOnceRea "Condition light off temperature at least once reached" UBYTE B_TRUE 1 100 0.00 1.00000000000 BIT_MASK 0x1 FORMAT "%13.11" ECU_ADDRESS 0x70000248 /end MEASUREMENT
/begin MEASUREMENT ExhMgT_flgTUpprThd2HiPrio "Catalyst temperature of the higher priority catalyst is greater than the setpoint2 plus the hysteresis threshold" UBYTE B_TRUE 1 100 0.00 1.00000000000 BIT_MASK 0x1 FORMAT "%13.11" ECU_ADDRESS 0x70000247 /end MEASUREMENT
/begin MEASUREMENT ExhMgT_flgTUpprThdHiPrio "Catalyst temperature of the higher priority catalyst is greater than the setpoint plus the hysteresis threshold" UBYTE B_TRUE 1 100 0.00 1.00000000000 BIT_MASK 0x1 FORMAT "%13.11" ECU_ADDRESS 0x70000246 /end MEASUREMENT
/begin MEASUREMENT ExhMgT_flgTUpprThdLoPrio "Catalyst temperature of the lower priority catalyst is greater than the setpoint plus the hysteresis threshold" UBYTE B_TRUE 1 100 0.00 1.00000000000 BIT_MASK 0x1 FORMAT "%13.11" ECU_ADDRESS 0x70000245 /end MEASUREMENT
/begin MEASUREMENT ExhMgT_flgTWallActvnCptProtn "condition of activation of component protection in dependence of wall temperature inside of exhaust system" UBYTE B_TRUE 1 100 0.00 1.00000000000 BIT_MASK 0x1 FORMAT "%13.11" ECU_ADDRESS 0x60009FA0 /end MEASUREMENT
/begin MEASUREMENT ExhMgT_nrColdStrt "number of engine starts" UBYTE dez 1 100 0.00 255.0 FORMAT "%5.1" ECU_ADDRESS 0x600064B7 /end MEASUREMENT
/begin MEASUREMENT ExhMgT_numCatHeatg "number catalyst heating in case of a first start of combustion chamber" UBYTE dez 1 100 0.00 255.0 FORMAT "%5.1" ECU_ADDRESS 0x6000A05E /end MEASUREMENT
/begin MEASUREMENT ExhMgT_ratDeltaLamLimp "additional enrichment for component protection in case of a not valid entry value" SWORD fak_sw_b8 1 100 -8.000000 7.999756 FORMAT "%8.6" ECU_ADDRESS 0x60004AD8 /end MEASUREMENT
/begin MEASUREMENT ExhMgT_stCatHeatg "catalyst heating status" UBYTE dez 1 100 0.00 1.000 FORMAT "%5.3" ECU_ADDRESS 0x600064B5 /end MEASUREMENT
/begin MEASUREMENT ExhMgT_stCatHeatgMode "catalyst heating mode" UBYTE dez 1 100 0.00 3.000 FORMAT "%5.3" ECU_ADDRESS 0x6000A05B /end MEASUREMENT
/begin MEASUREMENT ExhMgT_stEquPrioCat "Catalysts have the same priority with regard to heating" UBYTE dez 1 100 0.00 1.000 FORMAT "%5.3" ECU_ADDRESS 0x600064B4 /end MEASUREMENT
/begin MEASUREMENT ExhMgT_stOperModDmd "request of an operation state of the power train to the hybrid coordinator" UWORD dez 1 100 0.00 65535.00 FORMAT "%8.2" ECU_ADDRESS 0x600048CC /end MEASUREMENT
/begin MEASUREMENT ExhMgT_stTHiPrioCat "catalyst heating status of catalyst with higher priority" UBYTE dez 1 100 0.00 2.000 FORMAT "%5.3" ECU_ADDRESS 0x600064B3 /end MEASUREMENT
/begin MEASUREMENT ExhMgT_stTLoPrioCat "catalyst heating status of catalyst with lower priority" UBYTE dez 1 100 0.00 2.000 FORMAT "%5.3" ECU_ADDRESS 0x600064B2 /end MEASUREMENT
/begin MEASUREMENT ExhMgT_tCat1B1 "Temperature in catalyst 1 Bank 1" SWORD temp_q0p1_o273 1 100 -3549.940 3003.560 FORMAT "%8.3" ECU_ADDRESS 0x60004AD4 /end MEASUREMENT
/begin MEASUREMENT ExhMgT_tCat1B1Min "Minimum temperature catalyst 1 bank 1" SWORD Temp_Cels 1 100 -3549.940 3003.560 FORMAT "%8.3" ECU_ADDRESS 0x60004AD2 /end MEASUREMENT
/begin MEASUREMENT ExhMgT_tCat1CptProtnMax "maximal allowed temperature inside catalyst 1 for component protection" SWORD temp_q0p1_o273 1 100 -3549.940 3003.560 FORMAT "%8.3" ECU_ADDRESS 0x60004AD0 /end MEASUREMENT
/begin MEASUREMENT ExhMgT_tCat1MaxB1 "maximum temperature inside catalyst 1 for component protection bench 1" SWORD temp_q0p1_o273 1 100 -3549.940 3003.560 FORMAT "%8.3" ECU_ADDRESS 0x60004ACA /end MEASUREMENT
/begin MEASUREMENT ExhMgT_tCat1MaxCptProtnMax "maximal allowed maximum temperature inside catalyst 1 for component protection" SWORD temp_q0p1_o273 1 100 -3549.940 3003.560 FORMAT "%8.3" ECU_ADDRESS 0x6000399E /end MEASUREMENT
/begin MEASUREMENT ExhMgT_tCat1MaxCptProtnMaxThd "maximal allowed maximum temperature inside catalyst 1 for component protection" SWORD temp_q0p1_o273 1 100 -3549.940 3003.560 FORMAT "%8.3" ECU_ADDRESS 0x60004AC8 /end MEASUREMENT
/begin MEASUREMENT ExhMgT_tCat1Min "minimum temperature inside of first upstream catalyst (max.choice between bank1 and bank2)" SWORD Temp_Cels 1 100 -3549.940 3003.560 FORMAT "%8.3" ECU_ADDRESS 0x6000E204 /end MEASUREMENT
/begin MEASUREMENT ExhMgT_tCat1Seln1 "selected catalyst temperature catalyst 1 for controlling the heating measures (first selection)" SWORD Temp_Cels 1 100 -3549.940 3003.560 FORMAT "%8.3" ECU_ADDRESS 0x60004AC2 /end MEASUREMENT
/begin MEASUREMENT ExhMgT_tCat1Seln1B1 "selection1 catalyst temperature cat1 in the dependence of the catalyst heating requirement" SWORD Temp_Cels 1 100 -3549.940 3003.560 FORMAT "%8.3" ECU_ADDRESS 0x60004AC0 /end MEASUREMENT
/begin MEASUREMENT ExhMgT_tCat1Seln2 "selected catalyst temperature catalyst 1 for controlling the heating measures (second selection)" SWORD Temp_Cels 1 100 -3549.940 3003.560 FORMAT "%8.3" ECU_ADDRESS 0x60004ABE /end MEASUREMENT
/begin MEASUREMENT ExhMgT_tCat1SelnStrt "selected catalyst temperature in the dependence of a catalyst heating requirement is triggered" SWORD Temp_Cels 1 100 -3549.940 3003.560 FORMAT "%8.3" ECU_ADDRESS 0x60004ABC /end MEASUREMENT
/begin MEASUREMENT ExhMgT_tCat2B1Min "Minimum temperature catalyst 2 bank 1" SWORD Temp_Cels 1 100 -3549.940 3003.560 FORMAT "%8.3" ECU_ADDRESS 0x60004AB8 /end MEASUREMENT
/begin MEASUREMENT ExhMgT_tCat2CptProtnMax "maximal allowed temperature inside catalyst 2 for component protection" SWORD temp_q0p1_o273 1 100 -3549.940 3003.560 FORMAT "%8.3" ECU_ADDRESS 0x6000399C /end MEASUREMENT
/begin MEASUREMENT ExhMgT_tCat2MaxB1 "maximum temperature inside catalyst 2 for component protection bench 1" SWORD temp_q0p1_o273 1 100 -3549.940 3003.560 FORMAT "%8.3" ECU_ADDRESS 0x6000399A /end MEASUREMENT
/begin MEASUREMENT ExhMgT_tCat2MaxMaxThd "maximal allowed maximum temperature inside catalyst 2 for component protection" SWORD temp_q0p1_o273 1 100 -3549.940 3003.560 FORMAT "%8.3" ECU_ADDRESS 0x60003998 /end MEASUREMENT
/begin MEASUREMENT ExhMgT_tCat2Seln1 "selected catalyst temperature catalyst 2 for controlling the heating measures (first selection)" SWORD Temp_Cels 1 100 -3549.940 3003.560 FORMAT "%8.3" ECU_ADDRESS 0x60004AAE /end MEASUREMENT
/begin MEASUREMENT ExhMgT_tCat2Seln1B1 "selection1 catalyst temperature cat2 in the dependence of the catalyst heating requirement" SWORD Temp_Cels 1 100 -3549.940 3003.560 FORMAT "%8.3" ECU_ADDRESS 0x60004AAC /end MEASUREMENT
/begin MEASUREMENT ExhMgT_tCat2Seln2 "selected catalyst temperature catalyst 2 for controlling the heating measures (second selection)" SWORD Temp_Cels 1 100 -3549.940 3003.560 FORMAT "%8.3" ECU_ADDRESS 0x60004AAA /end MEASUREMENT
/begin MEASUREMENT ExhMgT_tCatColdStrt "catalyst temperature for release of catalyst heating in case of a first start" SWORD Temp_Cels 1 100 -3549.940 3003.560 FORMAT "%8.3" ECU_ADDRESS 0x60004AA8 /end MEASUREMENT
/begin MEASUREMENT ExhMgT_tCatHeatgTCatSelnActn "Catalyst temperature in the dependence of the heating measures are controlled" SWORD temp_q0p1_K 1 100 -3276.800 3276.700 FORMAT "%8.3" ECU_ADDRESS 0x60004AA6 /end MEASUREMENT
/begin MEASUREMENT ExhMgT_tCatHeatgWrmThd "threshold of catalyst temperature due to of catalyst warming from which the heating request is reset" SWORD Temp_Cels 1 100 -3549.940 3003.560 FORMAT "%8.3" ECU_ADDRESS 0x60004AA4 /end MEASUREMENT
/begin MEASUREMENT ExhMgT_tCatHiPrioEngRunStop "Catalyst temperature in dependence of the heating measure during start stop condition" SWORD Temp_Cels 1 100 -3549.940 3003.560 FORMAT "%8.3" ECU_ADDRESS 0x60003966 /end MEASUREMENT
/begin MEASUREMENT ExhMgT_tCatHiPrioSeln1 "selection of catalyst temperature of the high prio catalyst" SWORD Temp_Cels 1 100 -3549.940 3003.560 FORMAT "%8.3" ECU_ADDRESS 0x60003964 /end MEASUREMENT
/begin MEASUREMENT ExhMgT_tCatLoPrioSeln1 "selection of catalyst temperature of the low prio catalyst" SWORD Temp_Cels 1 100 -3549.940 3003.560 FORMAT "%8.3" ECU_ADDRESS 0x60003962 /end MEASUREMENT
/begin MEASUREMENT ExhMgT_tCatThdMin "minimum catalyst threshold component protection" SWORD temp_q0p1_o273 1 100 -3549.940 3003.560 FORMAT "%8.3" ECU_ADDRESS 0x60003996 /end MEASUREMENT
/begin MEASUREMENT ExhMgT_tDeltaEngStopCatCoolg "Temperature difference of cat temperatrue while cooling at engine stop" SWORD temp_q0p1_K 1 100 -3276.800 3276.700 FORMAT "%8.3" ECU_ADDRESS 0x60003960 /end MEASUREMENT
/begin MEASUREMENT ExhMgT_tDesMinCatHiPrio "minimum desired catalyst temperature of the high prio catalyst" SWORD Temp_Cels 1 100 -3549.940 3003.560 FORMAT "%8.3" ECU_ADDRESS 0x6000395E /end MEASUREMENT
/begin MEASUREMENT ExhMgT_tDesMinCatLoPrio "minimum desired catalyst temperature of the low prio catalyst" SWORD Temp_Cels 1 100 -3549.940 3003.560 FORMAT "%8.3" ECU_ADDRESS 0x6000395C /end MEASUREMENT
/begin MEASUREMENT ExhMgT_tDifCat1B1 "Distance to critical temperature threshold for catalyst 1 bank 1" SWORD temp_q0p1_K 1 100 -3276.800 3276.700 FORMAT "%8.3" ECU_ADDRESS 0x60004AA2 /end MEASUREMENT
/begin MEASUREMENT ExhMgT_tDifCat1MaxB1 "Distance of the maximum temperature of cat 1 to maximum allowed temperature threshold for catalyst 1 Bank 1" SWORD temp_q0p1_K 1 100 -3276.800 3276.700 FORMAT "%8.3" ECU_ADDRESS 0x60004AA0 /end MEASUREMENT
/begin MEASUREMENT ExhMgT_tDifCatHeatgDmd "Temperature difference catalyst between upper temperature threshold and acutal temperature for catalyst heating demand" SWORD temp_q0p1_K 1 100 -3276.800 3276.700 FORMAT "%8.3" ECU_ADDRESS 0x6000395A /end MEASUREMENT
/begin MEASUREMENT ExhMgT_tDifCatHiPrioCatStrt "Difference between the set point of the catalyst temperature and the catalyst temperature at the start of catalyst heating" SWORD temp_q0p1_K 1 100 -3276.800 3276.700 FORMAT "%8.3" ECU_ADDRESS 0x60003958 /end MEASUREMENT
/begin MEASUREMENT ExhMgT_tDifCatSelnCatStrt "Difference between the current catalyst temperature and the catalyst temperature at the start of catalyst heating" SWORD temp_q0p1_K 1 100 -3276.800 3276.700 FORMAT "%8.3" ECU_ADDRESS 0x60003956 /end MEASUREMENT
/begin MEASUREMENT ExhMgT_tDifCatThd "temperature value for activation of component protection related to the catalyst temperature based on the system value" SWORD temp_q0p1_o273 1 100 -3549.940 3003.560 FORMAT "%8.3" ECU_ADDRESS 0x60003994 /end MEASUREMENT
/begin MEASUREMENT ExhMgT_tDifExhMnfB1 "Distance to the maximum allowed temeprature threshold for exhaust manifold Bank 1" SWORD temp_q0p1_K 1 100 -3276.800 3276.700 FORMAT "%8.3" ECU_ADDRESS 0x60004A9E /end MEASUREMENT
/begin MEASUREMENT ExhMgT_tDifExhThd "temperature value for activation of component protection related to the gas temperature based on the system value" SWORD temp_q0p1_o273 1 100 -3549.940 3003.560 FORMAT "%8.3" ECU_ADDRESS 0x60003992 /end MEASUREMENT
/begin MEASUREMENT ExhMgT_tDiffTCatHeatgFolwStrt "temperature difference between the current catalyst temperature and the temperature threshold for request of catalyst heating cold start parameters (no first start)" SWORD temp_q0p1_K 1 100 -3276.800 3276.700 FORMAT "%8.3" ECU_ADDRESS 0x60004A9C /end MEASUREMENT
/begin MEASUREMENT ExhMgT_tDifThdCatHeatgDmd "Temperature difference catalyst between upper temperature threshold and lightoff temperature for catalyst heating demand" SWORD temp_q0p1_K 1 100 -3276.800 3276.700 FORMAT "%8.3" ECU_ADDRESS 0x60003954 /end MEASUREMENT
/begin MEASUREMENT ExhMgT_tExhCat1CptProtnUsMax "maximal allowed exhaust temperature in front of catalyst 1 for component protection" SWORD temp_q0p1_o273 1 100 -3549.940 3003.560 FORMAT "%8.3" ECU_ADDRESS 0x60003990 /end MEASUREMENT
/begin MEASUREMENT ExhMgT_tExhCat2CptProtnUsMax "maximal allowed exhaust temperature in front of catalyst 2 for component protection" SWORD temp_q0p1_o273 1 100 -3549.940 3003.560 FORMAT "%8.3" ECU_ADDRESS 0x6000398E /end MEASUREMENT
/begin MEASUREMENT ExhMgT_tExhDsVlvB1 "Exhaust gas temperature downstream exhaust valve, modelled, for component protection" SWORD temp_q0p1_o273 1 100 -3549.940 3003.560 FORMAT "%8.3" ECU_ADDRESS 0x60004A98 /end MEASUREMENT
/begin MEASUREMENT ExhMgT_tExhDsVlvCptProtnMax "Exhaust gas temperature downstream exhaust valve (modeled) for component protection" SWORD temp_q0p1_o273 1 100 -3549.940 3003.560 FORMAT "%8.3" ECU_ADDRESS 0x6000398C /end MEASUREMENT
/begin MEASUREMENT ExhMgT_tExhFrtPipCptProtnMax "maximal allowed Exhaust gas temperature downstream manifold for component protection" SWORD temp_q0p1_o273 1 100 -3549.940 3003.560 FORMAT "%8.3" ECU_ADDRESS 0x6000398A /end MEASUREMENT
/begin MEASUREMENT ExhMgT_tExhMnfB1 "Exhaust gas temperature manifold for component protection" SWORD temp_q0p1_o273 1 100 -3549.940 3003.560 FORMAT "%8.3" ECU_ADDRESS 0x60004A94 /end MEASUREMENT
/begin MEASUREMENT ExhMgT_tExhMnfMaxB1 "maximal allowed Exhaustgas temperature manifold for component temperature bench 1" SWORD temp_q0p1_o273 1 100 -3549.940 3003.560 FORMAT "%8.3" ECU_ADDRESS 0x60004A8C /end MEASUREMENT
/begin MEASUREMENT ExhMgT_tExhMnfMaxThd "maximal allowed Exhaustgas temperature manifold for component temperature" SWORD temp_q0p1_o273 1 100 -3549.940 3003.560 FORMAT "%8.3" ECU_ADDRESS 0x60003988 /end MEASUREMENT
/begin MEASUREMENT ExhMgT_tExhThdMin "minimum exhaust gas threshold component protection" SWORD temp_q0p1_o273 1 100 -3549.940 3003.560 FORMAT "%8.3" ECU_ADDRESS 0x60003986 /end MEASUREMENT
/begin MEASUREMENT ExhMgT_tiCatHeatgFolwStrtDiff "Time from start-up of catalyst heating due to a repeated catalyst heating in the current driving cycle with cold start parameters" UWORD t_q0p1 1 100 0.00 6553.500 FORMAT "%8.3" ECU_ADDRESS 0x600048CA /end MEASUREMENT
/begin MEASUREMENT ExhMgT_tiCdnDnyThd "Delay time for ramping down the dynamic threshold of the manifold" UWORD t_q0p1 1 100 0.00 6553.500 FORMAT "%8.3" ECU_ADDRESS 0x60003984 /end MEASUREMENT
/begin MEASUREMENT ExhMgT_tiDifCdnDyn "Time, in which the manifold temperature is below the reset threshold" UWORD t_q0p1 1 100 0.00 6553.500 FORMAT "%8.3" ECU_ADDRESS 0x60003982 /end MEASUREMENT
/begin MEASUREMENT ExhMgT_tIntglCatSelnCatStrt "integrated difference between the current catalyst temperature and the catalyst temperature at the start of catalyst heating" UWORD temp_q0p1_K 1 100 0.00 3276.700 FORMAT "%8.3" ECU_ADDRESS 0x60003952 /end MEASUREMENT
/begin MEASUREMENT ExhMgT_tMinCat1B1 "minmal delta exhaust temperature for 1.catalyst for activation of component protection (bench1)" SWORD temp_q0p1_K 1 100 -3276.800 3276.700 FORMAT "%8.3" ECU_ADDRESS 0x60003980 /end MEASUREMENT
/begin MEASUREMENT ExhMgT_tMinCat2B1 "minmal delta exhaust temperature for 2.catalyst for activation of component protection (bench1)" SWORD temp_q0p1_K 1 100 -3276.800 3276.700 FORMAT "%8.3" ECU_ADDRESS 0x6000397E /end MEASUREMENT
/begin MEASUREMENT ExhMgT_tMinCatB1 "minmal delta exhaust temperature of all catalyst for activation of component protection (bench1)" SWORD temp_q0p1_K 1 100 -3276.800 3276.700 FORMAT "%8.3" ECU_ADDRESS 0x60004A8A /end MEASUREMENT
/begin MEASUREMENT ExhMgT_tMinCatB1B2 "minmal delta exhaust temperature of all catalyst for activation of component protection (bench1 and bench2)" SWORD temp_q0p1_K 1 100 -3276.800 3276.700 FORMAT "%8.3" ECU_ADDRESS 0x6000E206 /end MEASUREMENT
/begin MEASUREMENT ExhMgT_tMinCatDelta "Exhaust temperature hysteresis for shut-off of component protection because of catalyst temperatures" SWORD temp_q0p1_K 1 100 -3276.800 3276.700 FORMAT "%8.3" ECU_ADDRESS 0x60004A88 /end MEASUREMENT
/begin MEASUREMENT ExhMgT_tMinCatDeltaCorrd "Exhaust temperature hysteresis for shut-off of component protection because of catalyst temperatures" SWORD temp_q0p1_K 1 100 0.00 1500.000 FORMAT "%8.3" ECU_ADDRESS 0x6000397C /end MEASUREMENT
/begin MEASUREMENT ExhMgT_tMinCatLo "Minimum distance to critical limits of temperatures near catalysts from where component protection active" SWORD temp_q0p1_K 1 100 0.00 500.0000 FORMAT "%8.4" ECU_ADDRESS 0x60004A86 /end MEASUREMENT
/begin MEASUREMENT ExhMgT_tMinCatLoCorrd "System threshold plus safety distance for component protection related to catalyst temperature" SWORD temp_q0p1_K 1 100 -3276.800 3276.700 FORMAT "%8.3" ECU_ADDRESS 0x6000397A /end MEASUREMENT
/begin MEASUREMENT ExhMgT_tMinExhB1 "Distance to critical limits of exhaust gas temperatures upstream of catalysts (maximum choice between bench1)" SWORD temp_q0p1_K 1 100 -3276.800 3276.700 FORMAT "%8.3" ECU_ADDRESS 0x6000E208 /end MEASUREMENT
/begin MEASUREMENT ExhMgT_tMinExhB1B2 "Distance to critical limits of exhaust gas temperatures upstream of catalysts (maximum choice between bench1 and 2)" SWORD temp_q0p1_K 1 100 -3276.800 3276.700 FORMAT "%8.3" ECU_ADDRESS 0x6000E20A /end MEASUREMENT
/begin MEASUREMENT ExhMgT_tMinExhDelta "Exhaust temperature hysteresis for shut-off of component protection because of gas temperatures" SWORD temp_q0p1_K 1 100 -3276.800 3276.700 FORMAT "%8.3" ECU_ADDRESS 0x60004A84 /end MEASUREMENT
/begin MEASUREMENT ExhMgT_tMinExhDeltaCorrd "Exhaust temperature hysteresis for shut-off of component protection because of exhaust gas temperature" SWORD temp_q0p1_K 1 100 0.00 1500.000 FORMAT "%8.3" ECU_ADDRESS 0x60003978 /end MEASUREMENT
/begin MEASUREMENT ExhMgT_tMinExhLo "Minimum distance to critical limits of exhaust gas temperatures upstream of catalysts where component protection active" SWORD temp_q0p1_K 1 100 0.00 500.0000 FORMAT "%8.4" ECU_ADDRESS 0x60004A82 /end MEASUREMENT
/begin MEASUREMENT ExhMgT_tMinExhLoCorrd "System threshold plus safety distance for component protection related to exhaust gas" SWORD temp_q0p1_K 1 100 -3276.800 3276.700 FORMAT "%8.3" ECU_ADDRESS 0x60003976 /end MEASUREMENT
/begin MEASUREMENT ExhMgT_tMinTExhCptProtnB1 "minimum difference of exhaust temperature of manifold and of all catalysts from the respective critical threshold of bank 1" SWORD temp_q0p1_K 1 100 -3276.800 3276.700 FORMAT "%8.3" ECU_ADDRESS 0x6000E20C /end MEASUREMENT
/begin MEASUREMENT ExhMgT_tMinTExhCptProtnGlb "minimum difference of exhaust temperature of manifold and of all catalysts from the respective critical threshold" SWORD temp_q0p1_K 1 100 -3276.800 3276.700 FORMAT "%8.3" ECU_ADDRESS 0x60004A80 /end MEASUREMENT
/begin MEASUREMENT ExhMgT_tMinThd "local minimal temperature threshold per exhaust unit" SWORD temp_q0p1_o273 1 100 -3549.940 3003.560 FORMAT "%8.3" ECU_ADDRESS 0x60003974 /end MEASUREMENT
/begin MEASUREMENT ExhMgT_tMinTWallCptProtnB1 "distance of the mat temperature from critical temperatures of components, bench 1" SWORD temp_q0p1_K 1 100 -3276.800 3276.700 FORMAT "%8.3" ECU_ADDRESS 0x60004A7A /end MEASUREMENT
/begin MEASUREMENT ExhMgT_tOffsCptPrtnLimpB1 "additional distance to critical limits of exhaust temperatures for component protection, bench 1" SWORD temp_q0p1_K 1 100 0.00 3276.700 FORMAT "%8.3" ECU_ADDRESS 0x6000E20E /end MEASUREMENT
/begin MEASUREMENT ExhMgT_tRstDynThd "temperature threshold in order to reset the dynamic threshold component protection" SWORD temp_q0p1_o273 1 100 -3549.940 3003.560 FORMAT "%8.3" ECU_ADDRESS 0x60003972 /end MEASUREMENT
/begin MEASUREMENT ExhMgT_tThdCatHeatg "Temperature threshold for catalyst heating" SWORD Temp_Cels 1 100 -3549.940 3003.560 FORMAT "%8.3" ECU_ADDRESS 0x60004A78 /end MEASUREMENT
/begin MEASUREMENT ExhMgT_tThdCatHeatgCatHiPrio "selection of temperature threshould for high prio catalyst heating" SWORD Temp_Cels 1 100 -3549.940 3003.560 FORMAT "%8.3" ECU_ADDRESS 0x60003950 /end MEASUREMENT
/begin MEASUREMENT ExhMgT_tUpprThd2HiPrio "catalyst temperature2 of the high priority catalyst which must be reached with catalyst heating" SWORD Temp_Cels 1 100 -3549.940 3003.560 FORMAT "%8.3" ECU_ADDRESS 0x60004A76 /end MEASUREMENT
/begin MEASUREMENT ExhMgT_tUpprThdCatHeatgHiPrio "selection of temperature threshould for high prio catalyst heating" SWORD Temp_Cels 1 100 -3549.940 3003.560 FORMAT "%8.3" ECU_ADDRESS 0x6000394E /end MEASUREMENT
/begin MEASUREMENT ExhMgT_tUpprThdDiagEtaIa "catalyst temperature threshold for diagnosis of ignition timing efficiency" SWORD Temp_Cels 1 100 -3549.940 3003.560 FORMAT "%8.3" ECU_ADDRESS 0x60004A74 /end MEASUREMENT
/begin MEASUREMENT ExhMgT_tUpprThdHiPrio "catalyst temperature of the high priority catalyst which must be reached with catalyst heating" SWORD Temp_Cels 1 100 -3549.940 3003.560 FORMAT "%8.3" ECU_ADDRESS 0x60004A72 /end MEASUREMENT
/begin MEASUREMENT ExhMgT_tUpprThdLoPrio "catalyst temperature of the low priority catalyst which must be reached with catalyst heating" SWORD Temp_Cels 1 100 -3549.940 3003.560 FORMAT "%8.3" ECU_ADDRESS 0x60004A70 /end MEASUREMENT
/begin MEASUREMENT ExhMgT_tWallAryMin "maximal wall temperature inside exhaust system for activation of component protection" SWORD Temp_Cels 1 100 -3549.940 3003.560 FORMAT "%8.3" ECU_ADDRESS 0x60003970 /end MEASUREMENT
/begin MEASUREMENT ExhMgT_tWallCptProtnB1 "Wall temperature for calculating the maximum allowed temperature in the manifold for component protection, Bank 1" SWORD temp_q0p1_o273 1 100 -3549.940 3003.560 FORMAT "%8.3" ECU_ADDRESS 0x6000396E /end MEASUREMENT
/begin MEASUREMENT ExhMgT_tWallMnfldCptProtn "maximal allowed temperature at exhaust manifold for component temperature in dependence of wall temperature" SWORD temp_q0p1_o273 1 100 -3549.940 3003.560 FORMAT "%8.3" ECU_ADDRESS 0x6000396C /end MEASUREMENT
/begin MEASUREMENT ExhMgT_tWallMnfldCptProtnSnsr "maximal allowed temperature at exhaust manifold for component temperature" SWORD temp_q0p1_o273 1 100 -3549.940 3003.560 FORMAT "%8.3" ECU_ADDRESS 0x6000396A /end MEASUREMENT
/begin MEASUREMENT fanfkw_w_msg "factor for weighting catalyst heating request for catalysator warming" UWORD fak_uw_b2 1 100 0.00 1.999969 FORMAT "%8.6" ECU_ADDRESS 0x6000483C /end MEASUREMENT
/begin MEASUREMENT fbakl_w_msg "factor shortlong time part of trans.control during acceleration" SWORD fak_sw_b256 1 100 -256.0000 255.9922 FORMAT "%8.4" ECU_ADDRESS 0x50000F3C /end MEASUREMENT
/begin MEASUREMENT fbansi_w "initial value of transient control post cranking factor" UWORD fak_q0p000305 1 100 0.00 19.99969 FORMAT "%8.5" ECU_ADDRESS 0x60000C4C /end MEASUREMENT
/begin MEASUREMENT fbavst_w "factor ÜK-adjustment at acceleration enrichment" SWORD fak_sw_b256 1 100 -256.0000 255.9922 FORMAT "%8.4" ECU_ADDRESS 0x60000C4A /end MEASUREMENT
/begin MEASUREMENT fkhab_msg "terminating factor catalyst heating" UBYTE fak_ub_b1 1 100 0.00 0.9961 ECU_ADDRESS 0x6000E44C /end MEASUREMENT
/begin MEASUREMENT fksthaus_w "Precontrolled start factor 16 bit" UWORD fak_uw_b64 1 100 0.00 63.99902 FORMAT "%8.5" ECU_ADDRESS 0x6000047A /end MEASUREMENT
/begin MEASUREMENT fksttaus_w "Precontrolled start factor 16 bit" UWORD fak_uw_b64 1 100 0.00 63.99902 FORMAT "%8.5" ECU_ADDRESS 0x6000047C /end MEASUREMENT
/begin MEASUREMENT fktns_w_msg "after start enrichment" UWORD fak_uw_b16 1 100 0.00 15.99976 FORMAT "%8.5" ECU_ADDRESS 0x600005FA /end MEASUREMENT
/begin MEASUREMENT fnstba_w "factor after start BA" UWORD fak_q0p000305 1 100 0.00 19.99969 FORMAT "%8.5" ECU_ADDRESS 0x60000C48 /end MEASUREMENT
/begin MEASUREMENT fnstva_w "factor after start VA" UWORD fak_q0p000305 1 100 0.00 19.99969 FORMAT "%8.5" ECU_ADDRESS 0x60000C46 /end MEASUREMENT
/begin MEASUREMENT fnswkstaa "factor post-start weighting over start-adaptation factor" UBYTE fak_ub_b4 1 100 0.00 3.984 FORMAT "%5.3" ECU_ADDRESS 0x600064D9 /end MEASUREMENT
/begin MEASUREMENT fnswlst_w_msg "Factor afterstart and warm-up for max. selection at start" UWORD fak_uw_b16 1 100 0.00 15.99976 FORMAT "%8.5" ECU_ADDRESS 0x70001C84 /end MEASUREMENT
/begin MEASUREMENT fnswl_w_msg "Factor afterstart and warm-up" UWORD fak_uw_b16 1 100 0.00 15.99976 FORMAT "%8.5" ECU_ADDRESS 0x600005FE /end MEASUREMENT
/begin MEASUREMENT fns_w_msg "after start factor" UWORD fak_uw_b16 1 100 0.00 15.99976 FORMAT "%8.5" ECU_ADDRESS 0x500007D2 /end MEASUREMENT
/begin MEASUREMENT fst0_w "precontrolled start factor 16 bit" UWORD fak_uw_b64 1 100 0.00 63.99902 FORMAT "%8.5" ECU_ADDRESS 0x60000482 /end MEASUREMENT
/begin MEASUREMENT fsta_w_msg "start-injection factor array" UWORD fak_uw_b64 1 100 0.00 63.99902 FORMAT "%8.5" ARRAY_SIZE 3 ECU_ADDRESS 0x500007DC /end MEASUREMENT
/begin MEASUREMENT fstgrund_w "Basic value start factor" UWORD fak_uw_b64 1 100 0.00 63.99902 FORMAT "%8.5" ECU_ADDRESS 0x60000484 /end MEASUREMENT
/begin MEASUREMENT fst_w_msg "start-injection factor" UWORD fak_uw_b64 1 100 0.00 63.99902 FORMAT "%8.5" ECU_ADDRESS 0x60000606 /end MEASUREMENT
/begin MEASUREMENT ftineo_w "Factor: injection time after intake valve opens" UWORD fak_uw_b2 1 100 0.00 1.999969 FORMAT "%8.6" ECU_ADDRESS 0x50000F2E /end MEASUREMENT
/begin MEASUREMENT fvakl_w_msg "factor shortlong-time part of trans.control at deceleration" SWORD fak_sw_b256 1 100 -256.0000 255.9922 FORMAT "%8.4" ECU_ADDRESS 0x60000DD6 /end MEASUREMENT
/begin MEASUREMENT fvavst_w "factor ÜK-adjustment at deceleration enleanment" SWORD fak_sw_b256 1 100 -256.0000 255.9922 FORMAT "%8.4" ECU_ADDRESS 0x60000C44 /end MEASUREMENT
/begin MEASUREMENT fwetm_msg "temperature dependent reinjection factor from curve FWET(factor restart fuel mass)" UBYTE fak_ub_b2 1 100 0.00 1.992188 FORMAT "%8.6" ECU_ADDRESS 0x50005DCE /end MEASUREMENT
/begin MEASUREMENT fwe_msg "reinjection factor" UBYTE fak_ub_b2 1 100 0.00 1.992188 FORMAT "%8.6" ECU_ADDRESS 0x500008BC /end MEASUREMENT
/begin MEASUREMENT fwkswst_w "weighting faktor for (cold) restart" UBYTE fak_ub_b2 1 100 0.00 1.992188 FORMAT "%8.6" ECU_ADDRESS 0x6000073D /end MEASUREMENT
/begin MEASUREMENT fwlrl "Factor warm-up load-dependent fraction" UBYTE fak_ub_b2 1 100 0.00 1.992188 FORMAT "%8.6" ECU_ADDRESS 0x600064D8 /end MEASUREMENT
/begin MEASUREMENT fwlroh_msg "warm up factor" UWORD fak_ub_b2 1 100 0.00 511.9922 FORMAT "%8.4" ECU_ADDRESS 0x60004C00 /end MEASUREMENT
/begin MEASUREMENT fwl_msg "Warm up factor" UBYTE fak_ub_b2 1 100 0.00 1.992188 FORMAT "%8.6" ECU_ADDRESS 0x50005DCF /end MEASUREMENT
/begin MEASUREMENT fwnsnaus_w "Precontrolled after-start and warm-up factor 16 bit" UWORD fak_uw_b16 1 100 0.00 15.99976 FORMAT "%8.5" ECU_ADDRESS 0x700019FE /end MEASUREMENT
/begin MEASUREMENT gkfkffwl "Output for combined maps KFFWL / KFFWLAL (falkg)" UBYTE fak_ub_b2 1 100 0.00 1.992188 FORMAT "%8.6" ECU_ADDRESS 0x600064D1 /end MEASUREMENT
/begin MEASUREMENT gkfkfwwlml "Weighting of the warm-up ramp-down factor" UBYTE fak_ub_b2 1 100 0.00 1.992188 FORMAT "%8.6" ECU_ADDRESS 0x600064D0 /end MEASUREMENT
/begin MEASUREMENT gklfzansh1 "Factor for ign. sync. decreasing of afterstart enrichment in range 1 for HOM" UBYTE fak_ub_b0p25 1 100 0.00 0.249023438 FORMAT "%11.9" ECU_ADDRESS 0x600064CF /end MEASUREMENT
/begin MEASUREMENT gklfzansh2 "Factor for ign. sync. decreasing of afterstart enrichment in range 2 for HOM" UBYTE fak_ub_b0p25 1 100 0.00 0.249023438 FORMAT "%11.9" ECU_ADDRESS 0x600064CE /end MEASUREMENT
/begin MEASUREMENT gklfzansh3 "Factor for ign. sync. decreasing of afterstart enrichment in range 3 for HOM" UBYTE fak_ub_b0p25 1 100 0.00 0.249023438 FORMAT "%11.9" ECU_ADDRESS 0x600064CD /end MEASUREMENT
/begin MEASUREMENT gklszansh1 "Switching level 1 of afterstart enrichment for HOM" UBYTE fak_ub_b2 1 100 0.00 1.000000 FORMAT "%8.6" ECU_ADDRESS 0x600064CC /end MEASUREMENT
/begin MEASUREMENT gklszansh2 "Switching level 2 of afterstart enrichment for HOM" UBYTE fak_ub_b2 1 100 0.00 1.000000 FORMAT "%8.6" ECU_ADDRESS 0x600064CB /end MEASUREMENT
/begin MEASUREMENT imlpr_w_msg "relative amount of integrated air mass at catalyst heating (word)" UWORD fak_uw_b1 1 100 0.00 0.9999847 FORMAT "%9.7" ECU_ADDRESS 0x6000E310 /end MEASUREMENT
/begin MEASUREMENT InjSys_facBadFuM "Factor for bad fuel correction." UBYTE fak_ub_b1 1 100 0.00 0.9961 ECU_ADDRESS 0x60000C58 /end MEASUREMENT
/begin MEASUREMENT InjSys_nEngESVW "Average engine speed of one cylinder segment in ESVW" UWORD nmot_q0p25 1 100 0.00 16383.75 FORMAT "%8.2" ECU_ADDRESS 0x50000626 /end MEASUREMENT
/begin MEASUREMENT InjSys_nEngTraCmp10ms "Average engine speed of one cylinder segment" UWORD nmot_uw_q0p25 1 100 0.00 16383.75 FORMAT "%8.2" ECU_ADDRESS 0x60000C56 /end MEASUREMENT
/begin MEASUREMENT InjSys_nEngTraCmpSyn "Average engine speed of one cylinder segment" UWORD nmot_uw_q0p25 1 100 0.00 16383.75 FORMAT "%8.2" ECU_ADDRESS 0x700019E0 /end MEASUREMENT
/begin MEASUREMENT InjSys_tEngESVW "Coolant temperature at engine output in ESVW" UBYTE temp_q0p75_om48 1 100 -48.0 143.3 FORMAT "%5.1" ECU_ADDRESS 0x50000852 /end MEASUREMENT
/begin MEASUREMENT InjSys_tStrtESVW "Starting value of downstream engine coolant temperature in ESVW" UBYTE temp_ub_q0p75_o48 1 100 -48.0 143.3 FORMAT "%5.1" ECU_ADDRESS 0x50000853 /end MEASUREMENT
/begin MEASUREMENT InjSys_tStrtTraCmp10ms "Starting value of downstream engine coolant temperature" UBYTE temp_ub_q0p75_o48 1 100 -48.0 143.3 FORMAT "%5.1" ECU_ADDRESS 0x60000C54 /end MEASUREMENT
/begin MEASUREMENT InjSys_tTraCmp10ms "Temperatur der Kühlflussigkeit am Motoraustritt" UBYTE temp_ub_q0p75_o48 1 100 -48.0 143.3 FORMAT "%5.1" ECU_ADDRESS 0x50000F7C /end MEASUREMENT
/begin MEASUREMENT kfkfwwns "output of map KFWWNS (decrease of afterstart enrichment in case of cold restart)" UBYTE fak_ub_b2 1 100 0.00 1.992188 FORMAT "%8.6" ECU_ADDRESS 0x600064CA /end MEASUREMENT
/begin MEASUREMENT kl_twstt_w "output characteristic line TWSTT" UWORD t1sxs_uw_q1 1 100 0.00 65535.00 FORMAT "%8.2" ECU_ADDRESS 0x600039A6 /end MEASUREMENT
/begin MEASUREMENT LamCtrl_nEngESPLANT "Engine speed (in FC ESPLANT)" UWORD nmot_uw_q0p25 1 100 0.00 16383.75 FORMAT "%8.2" ECU_ADDRESS 0x60004CA8 /end MEASUREMENT
/begin MEASUREMENT LamCtrl_ratFillgPlaPrm "Relative air charge (in FC ESPLANT)" UWORD rel_uw_q0p0234 1 100 0.00 1535.977 FORMAT "%8.3" ECU_ADDRESS 0x60004CA6 /end MEASUREMENT
/begin MEASUREMENT mifab_w_msg "limited desired indicated engine torque" UWORD rel_uw_b100 1 100 0.00 99.99847 FORMAT "%8.5" ECU_ADDRESS 0x70002D00 /end MEASUREMENT
/begin MEASUREMENT mifal_w_msg "Indicated drivers wish torque for torque coordination cylinder filling" UWORD rel_uw_b100 1 100 0.00 99.99847 FORMAT "%8.5" ECU_ADDRESS 0x70002D02 /end MEASUREMENT
/begin MEASUREMENT mifa_msg "desired indicated engine torque" UBYTE rel_ub_b100 1 100 0.00 99.61 FORMAT "%5.2" ECU_ADDRESS 0x70002DB2 /end MEASUREMENT
/begin MEASUREMENT mifa_w_msg "desired indicated engine torque" UWORD rel_uw_b100 1 100 0.00 99.99847 FORMAT "%8.5" ECU_ADDRESS 0x60004BF0 /end MEASUREMENT
/begin MEASUREMENT milsol_w_msg "coordinated torque request for charge" UWORD rel_uw_b100 1 100 0.00 99.99847 FORMAT "%8.5" ECU_ADDRESS 0x60004BEC /end MEASUREMENT
/begin MEASUREMENT misolv_w_msg "indicated resultant nominal torque before torque limitation" UWORD rel_uw_b100 1 100 0.00 99.99847 FORMAT "%8.5" ECU_ADDRESS 0x70002D06 /end MEASUREMENT
/begin MEASUREMENT misol_msg "indexed resultant nominal torque" UBYTE rel_ub_b100 1 100 0.00 99.61 FORMAT "%5.2" ECU_ADDRESS 0x70002DB3 /end MEASUREMENT
/begin MEASUREMENT misol_w_msg "indexed resultant nominal torque" UWORD rel_uw_b100 1 100 0.00 99.99847 FORMAT "%8.5" ECU_ADDRESS 0x70002D04 /end MEASUREMENT
/begin MEASUREMENT nmotf_w "." UWORD nmot_uw_q0p25 1 100 0.00 16383.75 FORMAT "%8.2" ECU_ADDRESS 0x60000C52 /end MEASUREMENT
/begin MEASUREMENT nmotuk_w "." SWORD nmot_uw_q0p25 1 100 -8192.000 8191.750 FORMAT "%8.3" ECU_ADDRESS 0x60000C50 /end MEASUREMENT
/begin MEASUREMENT nsactr "afterstart counter/filter" UBYTE fak_ub_b2 1 100 0.00 1.992188 FORMAT "%8.6" ECU_ADDRESS 0x6003476D /end MEASUREMENT
/begin MEASUREMENT nsactrho "afterstart counter for HOM" UBYTE fak_ub_b2 1 100 0.00 1.992188 FORMAT "%8.6" ECU_ADDRESS 0x50000878 /end MEASUREMENT
/begin MEASUREMENT NST_ABR_0.B_fnsb1 "Calculation of the afterstart factor ramp-down by HOM in a class / bit fnsb1" UBYTE B_TRUE 1 100 0.00 1.00000000000 BIT_MASK 0x1 FORMAT "%13.11" ECU_ADDRESS 0x50000435 /end MEASUREMENT
/begin MEASUREMENT NST_ABR_0.B_fnsb2 "Calculation of the afterstart factor ramp-down by HOM in a class / b fnsb2" UBYTE B_TRUE 1 100 0.00 1.00000000000 BIT_MASK 0x2 FORMAT "%13.11" ECU_ADDRESS 0x50000435 /end MEASUREMENT
/begin MEASUREMENT NST_ABR_0.B_fnsb3 "Calculation of the afterstart factor ramp-down by HOM in a class / b fnsb3" UBYTE B_TRUE 1 100 0.00 1.00000000000 BIT_MASK 0x4 FORMAT "%13.11" ECU_ADDRESS 0x50000435 /end MEASUREMENT
/begin MEASUREMENT NST_ABR_0.abr1_count "Calculation of the afterstart factor ramp-down by HOM in a class / Counter of ignitions for downward regulation of afterstart and warmup enrichment" UBYTE dez 1 100 0.00 255.0 FORMAT "%5.1" ECU_ADDRESS 0x50000434 /end MEASUREMENT
/begin MEASUREMENT rkukgp_w "rel. fuel mass transition compensation without adjustment for VVT" SWORD rel_sw_q0p0468 1 100 -1536.000 1535.953 FORMAT "%8.3" ECU_ADDRESS 0x500006B8 /end MEASUREMENT
/begin MEASUREMENT rkukg_w_msg "relative fuel mass transition compensation" SWORD rel_sw_q0p0468 1 100 -1536.000 1535.953 FORMAT "%8.3" ECU_ADDRESS 0x5000081C /end MEASUREMENT
/begin MEASUREMENT rkukkl_w "sum of short and long term parts of transient control" SWORD rel_sw_q0p0468 1 100 -1536.000 1535.953 FORMAT "%8.3" ECU_ADDRESS 0x700019DE /end MEASUREMENT
/begin MEASUREMENT rkukk_w_msg "rk short term part of transient control" SWORD rel_sw_q0p0468 1 100 -1536.000 1535.953 FORMAT "%8.3" ECU_ADDRESS 0x5000081E /end MEASUREMENT
/begin MEASUREMENT rkukl_w "rk long term part of transient control" SWORD rel_sw_q0p0468 1 100 -1536.000 1535.953 FORMAT "%8.3" ECU_ADDRESS 0x500006BA /end MEASUREMENT
/begin MEASUREMENT rkuknmg_w "." SWORD rel_sw_q0p0468 1 100 -1536.000 1535.953 FORMAT "%8.3" ECU_ADDRESS 0x700019DC /end MEASUREMENT
/begin MEASUREMENT rkuknm_w "rel. fuel mass transition compensation nmot without adjustment" SWORD rel_sw_q0p0468 1 100 -1536.000 1535.953 FORMAT "%8.3" ECU_ADDRESS 0x50000F32 /end MEASUREMENT
/begin MEASUREMENT rkuk_w "relative fuel mass transition compensation without adjustment" SWORD rel_sw_q0p0468 1 100 -1536.000 1535.953 FORMAT "%8.3" ECU_ADDRESS 0x500006B6 /end MEASUREMENT
/begin MEASUREMENT rlinterp_w_msg "Unified interface for either rl_w or rl_w multiplied by secondary air correction" UWORD rel_uw_q0p0234 1 100 0.00 1535.977 FORMAT "%8.3" ECU_ADDRESS 0x6000E328 /end MEASUREMENT
/begin MEASUREMENT sdwfk_w "memory content of the wall wetting difference for short term portion" SWORD rel_q0p09375 1 100 -3072.000 3071.906 FORMAT "%8.3" ECU_ADDRESS 0x500006C2 /end MEASUREMENT
/begin MEASUREMENT sdwfl_w "memory content of the wall wetting difference for long term portion" SWORD rel_q0p09375 1 100 -3072.000 3071.906 FORMAT "%8.3" ECU_ADDRESS 0x700019DA /end MEASUREMENT
/begin MEASUREMENT tlrsb_w_msg "Time delay for lambda-control model, base value" UWORD zk5msxs_uw_b327p68 1 100 0.00500008 327.68000000 FORMAT "%12.8" ECU_ADDRESS 0x6000E336 /end MEASUREMENT
/begin MEASUREMENT tlrslb_w_msg "Deadtime of plant for continuous lambda control; base value; linear quantization; bank 1" UWORD t_q0p01 1 100 0.0100 655.3500 FORMAT "%8.4" ECU_ADDRESS 0x60004BA0 /end MEASUREMENT
/begin MEASUREMENT tlrsl_w_msg "Deadtime of plant for continuous lambda control; linear quantization" UWORD t_q0p01 1 100 0.0100 655.3500 FORMAT "%8.4" ECU_ADDRESS 0x60004BA2 /end MEASUREMENT
/begin MEASUREMENT tlrs_w_msg "Time delay for lambda-control model" UWORD zk5msxs_uw_b327p68 1 100 0.00500008 327.68000000 FORMAT "%12.8" ECU_ADDRESS 0x6000E334 /end MEASUREMENT
/begin MEASUREMENT tmeswe "relevant engine temperature used in ESWE" UBYTE temp_ub_q0p75_o48 1 100 -48.0 143.3 FORMAT "%5.1" ECU_ADDRESS 0x600064C6 /end MEASUREMENT
/begin MEASUREMENT tmotnldiff "difference of engine temperature during ecu-afterrun" UBYTE temp_ub_b191p25 1 100 0.00 191.3 FORMAT "%5.1" ECU_ADDRESS 0x600064C7 /end MEASUREMENT
/begin MEASUREMENT tmotnlmx "max engine temperature during ecu-afterrun" UBYTE temp_ub_q0p75_o48 1 100 -48.0 143.3 FORMAT "%5.1" ECU_ADDRESS 0x600365CE /end MEASUREMENT
/begin MEASUREMENT vti_w "Ratio: inject. time after intake valve opens / total injection time" UWORD fak_uw_b2 1 100 0.00 1.999969 FORMAT "%8.6" ECU_ADDRESS 0x6000049E /end MEASUREMENT
/begin MEASUREMENT wdwee "angle difference between wee and filtered wee" UBYTE kw_q6 1 100 0.00 1530. FORMAT "%5.0" ECU_ADDRESS 0x60000C4F /end MEASUREMENT
/begin MEASUREMENT wea_msg "anglemark injection break off" UBYTE kw_q6 1 100 0.00 1530. FORMAT "%5.0" ECU_ADDRESS 0x600007BD /end MEASUREMENT
/begin MEASUREMENT weea_msg "angle injection-end in normal operation (array dim 3x1)" UBYTE kw_q6 1 100 0.00 1530. FORMAT "%5.0" ARRAY_SIZE 3 ECU_ADDRESS 0x500008C5 /end MEASUREMENT
/begin MEASUREMENT weemrfa "angle injection-end at maximum of desired driver request torque" UBYTE kw_q6 1 100 0.00 1530. FORMAT "%5.0" ECU_ADDRESS 0x60000749 /end MEASUREMENT
/begin MEASUREMENT weemrfabg "angle injection-end after consideration of desired driver request torque limited" UBYTE kw_q6 1 100 0.00 1530. FORMAT "%5.0" ECU_ADDRESS 0x700019D6 /end MEASUREMENT
/begin MEASUREMENT weenst "angle injection-end after end of start" UBYTE kw_q6 1 100 0.00 1530. FORMAT "%5.0" ECU_ADDRESS 0x700019D5 /end MEASUREMENT
/begin MEASUREMENT weenws "angle injection-end offset for camshaft" SBYTE kw_q6 1 100 -768.0 762.0 FORMAT "%5.1" ECU_ADDRESS 0x50000879 /end MEASUREMENT
/begin MEASUREMENT weeotkrf_w_msg "angle injection-end in normal operation without flight time" UWORD kw_q0p0234 1 100 0.00 1535.977 FORMAT "%8.3" ECU_ADDRESS 0x60000DE0 /end MEASUREMENT
/begin MEASUREMENT weestsim_msg "Offset angle injection end for simultaneous injections at start" UBYTE kw_q6 1 100 0.00 1530. FORMAT "%5.0" ECU_ADDRESS 0x600007C1 /end MEASUREMENT
/begin MEASUREMENT wee_msg "angle injection-end in normal operation" UBYTE kw_q6 1 100 0.00 1530. FORMAT "%5.0" ECU_ADDRESS 0x600007BF /end MEASUREMENT
/begin MEASUREMENT wes_msg "angle mark, inlet, closes relative to ignition TDC cylinder 1" UBYTE kw_q6 1 100 0.00 1530. FORMAT "%5.0" ECU_ADDRESS 0x500008C8 /end MEASUREMENT
/begin MEASUREMENT wf_w "wall wetting quantity" SWORD rel_q0p09375 1 100 -3072.000 3071.906 FORMAT "%8.3" ECU_ADDRESS 0x700019D8 /end MEASUREMENT
/begin MEASUREMENT wistr_w_msg "Relative heating progress for catalyst by exhaust gas since cranking" UWORD fak_uw_b1 1 100 0.00 0.9999847 FORMAT "%9.7" ECU_ADDRESS 0x600047D8 /end MEASUREMENT
/begin MEASUREMENT zbake "reduction factor during acceleration" UBYTE fak_q0p0039 1 100 0.00 0.9961 ECU_ADDRESS 0x50000F7F /end MEASUREMENT
/begin MEASUREMENT zbale "reduction factor during acceleration" UBYTE fak_ub_b0p125 1 100 0.00 0.1245 FORMAT "%6.4" ECU_ADDRESS 0x50000F80 /end MEASUREMENT
/begin MEASUREMENT zburnsum "sum of detected combustions during start" UBYTE dez 1 100 0.00 255.0 FORMAT "%5.1" ECU_ADDRESS 0x5000087A /end MEASUREMENT
/begin MEASUREMENT zlrsb_w_msg "plant time constant of continuous air-fuel control, base value" UWORD zk10msxs_uw_b655p36 1 100 0.01000015 655.36000000 FORMAT "%12.8" ECU_ADDRESS 0x60004B8C /end MEASUREMENT
/begin MEASUREMENT zlrslb_w_msg "Plant time constant of continuous lambda control, base value, linear quantization" UWORD t_q0p01 1 100 0.0100 655.3500 FORMAT "%8.4" ECU_ADDRESS 0x60004B88 /end MEASUREMENT
/begin MEASUREMENT zlrsl_w_msg "Plant time constant of continuous lambda control, linear quantization" UWORD t_q0p01 1 100 0.0100 655.3500 FORMAT "%8.4" ECU_ADDRESS 0x60004B8A /end MEASUREMENT
/begin MEASUREMENT zlrs_w_msg "Time constant for lambda control model, 16 bit" UWORD zk10msxs_uw_b655p36 1 100 0.01000015 655.36000000 FORMAT "%12.8" ECU_ADDRESS 0x6000E344 /end MEASUREMENT
/begin MEASUREMENT zuknm_w "Time constant transient control direct injection, tmot dependent" UWORD t_q0p01 1 100 0.0100 655.3500 FORMAT "%8.4" ECU_ADDRESS 0x60000C42 /end MEASUREMENT
/begin MEASUREMENT zuknstm_w "time constant of transient control post cranking factor dependent on engine temperature" UWORD t_q0p1 1 100 0.100 6553.500 FORMAT "%8.3" ECU_ADDRESS 0x60000C40 /end MEASUREMENT
/begin MEASUREMENT zvake "reduction factor during deceleration enleanment" UBYTE fak_q0p0039 1 100 0.00 0.9961 ECU_ADDRESS 0x50000F81 /end MEASUREMENT
/begin MEASUREMENT zvale "reduction factor during deceleration enleanment" UBYTE fak_ub_b0p125 1 100 0.00 0.1245 FORMAT "%6.4" ECU_ADDRESS 0x60000C3E /end MEASUREMENT
/begin FUNCTION ESNSWL "3.27.1    injection during afterstart and warm-up"
 /begin DEF_CHARACTERISTIC EngStrt_cntrInjLim12_AX EngStrt_facAftStrtCorrnStrtAdapAirChrg EngStrt_facAftStrtEnchmt EngStrt_facAftStrtEnchmtVlvLft EngStrt_facAltiCorrn4_AX EngStrt_facStrtMixAdap6_AX EngStrt_facWrmLoadDpdtFrctVlvLft EngStrt_facWrmUpLoadDpdtFrct EngStrt_mAirMfIntegEngStrt6_AX EngStrt_mRelAirCh12_AX EngStrt_mRelAirCh4_AX EngStrt_mRelAirChPred6_AX EngStrt_nEngLoRes12_AX EngStrt_nEngLoRes16_AX EngStrt_nEngLoRes6_AX EngStrt_tEng12_AX EngStrt_tEngStrt12_AX EngStrt_tEngStrt8_AX EngStrt_tIntkAir6_AX FNSSM FWSTAB FZANSSA1 FZANSSA2 FZANSSM1 FZANSSM2 FZANSSM3 KFFNSHO KFFWL KFFWLVHG KFKNSTWST KFNSA KFNSAVHG KFWWLML KFWWLMLVHG KFWWNS KLFNSKH KLFWLN KLZANSFHO SZANSSM1 SZANSSM2 ZDGZA1 ZDGZA2 ZDGZA3 /end DEF_CHARACTERISTIC
 /begin IN_MEASUREMENT anztib_w_msg B_hst_msg B_kh_msg B_staa_msg B_stendes_msg B_vheg_msg B_wks_msg B_wst_msg CEngDsT_t CEngDsT_tStrt Epm_nEngLRes ExhMod_mAirMfIntegEngStrt fnsad_w_msg kstaa_msg PEnv_facCorrAlti rlp_w_msg rl_w_msg SyC_stSub tans_msg tengsq1_w_msg TiEngOff_stTi /end IN_MEASUREMENT
 /begin OUT_MEASUREMENT B_fnsoff_msg B_fwloff_msg fktns_w_msg fnswlst_w_msg fnswl_w_msg fns_w_msg fwlroh_msg fwl_msg /end OUT_MEASUREMENT
 /begin LOC_MEASUREMENT EngStrt_facAltiCorrnLoc EngStrt_facEthLoc EngStrt_facWrmUpLoc EngStrt_nLoReslEngSpdLocal Engstrt_nLoReslTypEngSpdLoc EngStrt_tEngTLoc EngStrt_tEngTStrtLoc fnswkstaa fwlrl fwnsnaus_w gkfkffwl gkfkfwwlml gklfzansh1 gklfzansh2 gklfzansh3 gklszansh1 gklszansh2 kfkfwwns nsactr nsactrho NST_ABR_0.B_fnsb1 NST_ABR_0.B_fnsb2 NST_ABR_0.B_fnsb3 NST_ABR_0.abr1_count /end LOC_MEASUREMENT
 FUNCTION_VERSION "3.27.1" /end FUNCTION
/begin FUNCTION ESPLANT "1.28.0    Plant parameters of air/fuel control" /begin DEF_CHARACTERISTIC KFLRST KFLRSTV KFLRSZ KFLRSZV SNM07LSUW SRL08LSUW /end DEF_CHARACTERISTIC
 /begin IN_MEASUREMENT B_vheg_msg EGSDO2_tiDlyAdpnS1B1 EGSDO2_tiTranAdpnS1B1 Epm_nEng rl_w_msg SyC_stSub /end IN_MEASUREMENT
 /begin OUT_MEASUREMENT rlinterp_w_msg tlrsb_w_msg tlrslb_w_msg tlrsl_w_msg tlrs_w_msg zlrsb_w_msg zlrslb_w_msg zlrsl_w_msg zlrs_w_msg /end OUT_MEASUREMENT
 /begin LOC_MEASUREMENT LamCtrl_nEngESPLANT LamCtrl_ratFillgPlaPrm /end LOC_MEASUREMENT
 FUNCTION_VERSION "1.28.0" /end FUNCTION
/begin FUNCTION ESSTT "21.10.0   Injection duration at start"
 /begin DEF_CHARACTERISTIC CWESSTT DN10BURN EngStrt_facEngStrtAlti_M EngStrt_stCfgShDwnTi FKSTT IMLHS KFHSTT KFKSTTWST KFWHSTT KFWKSTAB KFWKSTN KFWKSTT KFWKSTTSPI KLTMOTDIFF TANDT TANH TMH TMHSG TMK TMODT TWSTT ZBURNLIM /end DEF_CHARACTERISTIC
 /begin REF_CHARACTERISTIC CWWL /end REF_CHARACTERISTIC
 /begin IN_MEASUREMENT anztib_msg B_nachl_msg B_stendes_msg B_stveset_msg B_zesync_msg CEngDsT_t CEngDsT_tStop CEngDsT_tStrt Eep_EnvRamHist Eep_EnvRamInvld EngStrt_bFrstStrtEnd Epm_nEngDiff Epm_nEngLRes Epm_stSpd ExhMod_mAirMfIntegEngStrt kstaa_msg PEnv_facCorrAlti Strt_stStaActv SyC_stSub tansab_msg tans_msg tengsq1_w_msg TiEngOff_stTi /end IN_MEASUREMENT
 /begin OUT_MEASUREMENT B_hstnl_msg B_hst_msg B_vbmg_msg B_wks_msg B_wst_msg EngStrt_flgShDwnTiVld fsta_w_msg fst_w_msg /end OUT_MEASUREMENT
 /begin LOC_MEASUREMENT anztist BBSTVE_stvsetFF B_eepesstt B_wst0 B_wst1 B_wst2 EngStrt_flgNegPStrtInhbn EngStrt_tiFuCutNegPStrtInhbn EngStrt_tThdDifCooltStrt EngStrt_tThdDifStrt ESSTT_nmot ESSTT_tans ESSTT_tansab ESSTT_tmotab ESSTT_tmst fksthaus_w fksttaus_w fst0_w fstgrund_w fwkswst_w kl_twstt_w tmotnldiff tmotnlmx zburnsum /end LOC_MEASUREMENT
 FUNCTION_VERSION "21.10.0" /end FUNCTION
/begin FUNCTION ESUK "28.6.0    Injection: transient compensation"
 /begin DEF_CHARACTERISTIC CWESUK DUKK FUKNSTHO FUKNSTRM FUKTINEO FVANST InjSys_facBadFuMAEnchmtKMem_M InjSys_facBadFuMAEnchmtLMem_M InjSys_facBadFuMDecelEnlnmtKMem_M InjSys_facBadFuMDecelEnlnmtLMem_M InjSys_facTraCmpBadfuAftStrt_M InjSys_facTraCmpBadfuStrt_M KFABAK KFABAKHI KFAVAK KFAVAKHI KFBADE KFBADESS KFBAKLHI KFCVTKOR KFCVTUKNM KFVADE KFVADESS KFVAKLHI KFWFRLI KFWFRLIHI KLTNSUUK KLVATNST KLZKWEE RKBAUM RKUKKLU RKVAUM SNM07ESUB SNM09ESUB STM09ESUB TKRF ZBAKMHI ZBALMHI ZUKNM ZUKNSTM ZVAKMHI ZVALMHI /end DEF_CHARACTERISTIC
 /begin REF_CHARACTERISTIC GEVCtl_agWidthCamProfIntk_C /end REF_CHARACTERISTIC
 /begin IN_MEASUREMENT anzti_msg B_fs_msg B_ll_msg B_nswo2_msg B_sa_msg B_vhefeps_msg B_vhegfe_msg CEngDsT_t CEngDsT_tStrt drlp_w_msg EngStrt_bStrtEnd Epm_ctCyl Epm_nEng Epm_nEngLRes fnsad_w_msg kstaa_msg PEnv_facCorrAlti rlp_w_msg SyC_stSub tef_w_msg tnst_w_msg vwkw_msg wee_msg /end IN_MEASUREMENT
 /begin OUT_MEASUREMENT B_bag_msg B_ba_msg B_ukg_msg B_vag_msg B_va_msg dwf_w_msg fbakl_w_msg fvakl_w_msg rkukg_w_msg rkukk_w_msg weeotkrf_w_msg /end OUT_MEASUREMENT
 /begin LOC_MEASUREMENT abak avak avatnst B_redkl B_uk1 B_ukk B_ukns B_vaau B_vacvt B_vakl B_wf dwfk_w dwfl_w fbansi_w fbavst_w fnstba_w fnstva_w ftineo_w fvavst_w InjSys_facBadFuM InjSys_nEngTraCmp10ms InjSys_nEngTraCmpSyn InjSys_tStrtTraCmp10ms InjSys_tTraCmp10ms nmotf_w nmotuk_w rkukgp_w rkukkl_w rkukl_w rkuknmg_w rkuknm_w rkuk_w sdwfk_w sdwfl_w vti_w wdwee wf_w zbake zbale zuknm_w zuknstm_w zvake zvale /end LOC_MEASUREMENT
 FUNCTION_VERSION "28.6.0" /end FUNCTION
/begin FUNCTION ESVW "9.5.0     Injection : calculation of injection angle"
 /begin DEF_CHARACTERISTIC DWEEMX FWEEMRFAM InjSys_agDeltaInjEndAftStrt_T KFWEE KFWEEST KFWEETM MRFAVW SNM08GKUW SRL08GKUB STM08FSUB WEAN WEEMRFAN WEESTSM WESSOT /end DEF_CHARACTERISTIC
 /begin IN_MEASUREMENT anztib1_w_msg anztib_msg B_stendes_msg B_vheg_msg CEngDsT_t CEngDsT_tStrt dwgvsge_w_msg Epm_nEng mrfa_w_msg rl_msg /end IN_MEASUREMENT
 /begin OUT_MEASUREMENT wea_msg weea_msg weestsim_msg wee_msg wes_msg /end OUT_MEASUREMENT
 /begin LOC_MEASUREMENT anztibj B_mrfamx InjSys_nEngESVW InjSys_tEngESVW InjSys_tStrtESVW weemrfa weemrfabg weenst weenws /end LOC_MEASUREMENT
 FUNCTION_VERSION "9.5.0" /end FUNCTION
/begin FUNCTION ESWE "8.6.0     Injection, resumption of overrun fuel cut-off"
 /begin DEF_CHARACTERISTIC CWESWE FWEMRFA FWET InjSyG_ACTqThd_C InjSys_facWghtBadFuel_M KFFWET KLFIMHU KLFIMWU KLFIMWUAC KLFWENM KLZYKSA /end DEF_CHARACTERISTIC
 /begin IN_MEASUREMENT AC_trqDes anzti_msg B_ll_msg B_stendes_msg CEngDsT_t Epm_nEngLRes evz_austot_msg kstaa_msg mrfa_w_msg ThrVlv_flgLimpModeB1 ThrVlv_flgReqFuCutOffB1 /end IN_MEASUREMENT
 /begin OUT_MEASUREMENT anzzyksa_msg B_fwe_msg danzwefim_msg fwetm_msg fwe_msg /end OUT_MEASUREMENT
 /begin LOC_MEASUREMENT anzwe anzwefim azylwe B_afwe tmeswe /end LOC_MEASUREMENT
 FUNCTION_VERSION "8.6.0" /end FUNCTION
/begin FUNCTION ETC_Std "30000.17.0Engine Test Coordinator" /begin DEF_CHARACTERISTIC Etc_MaxReqTO_C /end DEF_CHARACTERISTIC /begin OUT_MEASUREMENT Etc_ctCurRunTst /end OUT_MEASUREMENT FUNCTION_VERSION "30000.17.0" /end FUNCTION
/begin FUNCTION ETSPTH2ME "9.0.0_159.0.0Interface adapter ETSPth to ME"
 /begin IN_MEASUREMENT CoETS_bIntvActvDes CoETS_trqInrSetCo ftrq2mi_w_msg mimax_w_msg PthLead_stActvMonLim PthLead_trqInrLead PthLead_trqResv PthSet_bIAIntv PthSet_bOvrRun PthSet_stActvMonLim PthSet_trqInrCtOff /end IN_MEASUREMENT
 /begin OUT_MEASUREMENT B_mdein_msg B_mibeg_msg B_sa_msg B_zwsol_msg dmrmx_w_msg mifab_w_msg mifal_w_msg mifa_msg mifa_w_msg milsol_w_msg misolv_w_msg misol_msg misol_w_msg /end OUT_MEASUREMENT
 FUNCTION_VERSION "9.0.0_159.0.0" /end FUNCTION
/begin FUNCTION ExhCo_Adpr "1.0.0     Adapter function for Exhaust modules" /begin DEF_CHARACTERISTIC ExhCo_swtTSelnCatHeatgGpf_C /end DEF_CHARACTERISTIC /begin OUT_MEASUREMENT ExhCo_swtTSelnCatHeatgGpf /end OUT_MEASUREMENT FUNCTION_VERSION "1.0.0" /end FUNCTION
/begin FUNCTION ExhMgT_ActvnCptProtnTExh "1.13.0_1.1.0activation of component protection because of the exhaust temperature"
 /begin DEF_CHARACTERISTIC ExhMgT_nrTWallArySeldB1_C ExhMgT_ratLamCptProtnLimpCamsft_C ExhMgT_ratLamCptProtnLimpExh_C ExhMgT_ratLamCptProtnLimpUego_C ExhMgT_stActvnCptProtnTExh1_C ExhMgT_stActvnCptProtnTExh_C ExhMgT_tCat1CptProtnMax_C ExhMgT_tCat1MaxCptProtnMax_C ExhMgT_tCat2CptProtnMax_C ExhMgT_tCat2MaxCptProtnMax_C ExhMgT_tDeltaCat1_C ExhMgT_tDeltaCat2_C ExhMgT_tDeltaMnfB1_T ExhMgT_tDeltaMnf_C ExhMgT_tDeltaWallActvnCptProtn_C ExhMgT_tDiffActvTi_C ExhMgT_tExhCat1CptProtnDsMax_C ExhMgT_tExhCat1CptProtnUsMax_C ExhMgT_tExhCat2CptProtnDsMax_C ExhMgT_tExhCat2CptProtnUsMax_C ExhMgT_tExhDsVlvCptProtnMax_C ExhMgT_tExhFrtPipCptProtnMax_C ExhMgT_tExhMnfMaxDyn_C ExhMgT_tiActvnCptProtn_C ExhMgT_tiCat1MaxDec_C ExhMgT_tiCat1MaxInc_C ExhMgT_tiCat2MaxDec_C ExhMgT_tiCat2MaxInc_C ExhMgT_tiCdnDnyThd_C ExhMgT_tiDeActvnCptProtn_C ExhMgT_tiDifCdnDyn_C ExhMgT_tiDlyCatActvCptProtn_C ExhMgT_tiDlyExhActvCptProtn_C ExhMgT_tiMaxCat1B1_C ExhMgT_tiMaxCat2B1_C ExhMgT_tiMnfldMaxDec_C ExhMgT_tiMnfldMaxInc_C ExhMgT_tiWallActvnCptProtn_C ExhMgT_tMinCatDelta_C ExhMgT_tMinCatLo_C ExhMgT_tMinExhDelta_C ExhMgT_tMinExhLo_C ExhMgT_tOffsCptProtnLimpCamsft_C ExhMgT_tOffsCptProtnLimpExh_C ExhMgT_tOffsCptProtnLimpUego_C ExhMgT_tWallActvnCptProtnMax_C ExhMgT_tWallActvnCptProtnMax_T ExhMgT_tWallMnfCptProtnMax_C ExhMgT_tWallMnfldCptProtn_T /end DEF_CHARACTERISTIC
 /begin IN_MEASUREMENT EngStrt_bStrtEnd ExhMgT_tCat1FildB1 ExhMgT_tCat1MaxFildB1 ExhMgT_tExhDsVlvFildB1 ExhMgT_tExhMnfFildB1 ExhMgT_tExhMnfFildGrdtB1 ExhMod_tCat1B1 ExhMod_tCat1MaxB1 ExhMod_tCat2B1 ExhMod_tCat2MaxB1 ExhMod_tExhCat1DsB1 ExhMod_tExhCat1UsB1 ExhMod_tExhCat2DsB1 ExhMod_tExhCat2UsB1 ExhMod_tExhDsVlvB1 ExhMod_tExhFrtPipB1 ExhMod_tExhMnfB1 ExhMod_tWallAryB1 ExhMod_tWallMnfB1 SyC_stSub VehV_v /end IN_MEASUREMENT
 /begin OUT_MEASUREMENT B_flbtskat_msg dtbtgsmx_w_msg dtbtkamx_w ExhMgT_facLamCptProtnTExh ExhMgT_flgActvCptProtn ExhMgT_flgActvCptProtnTExh ExhMgT_flgCatActvCptProtnTExh ExhMgT_flgLimpCptProtn ExhMgT_flgTWallActvnCptProtn ExhMgT_ratDeltaLamLimp ExhMgT_tCat1B1 ExhMgT_tCat1CptProtnMax ExhMgT_tCat1MaxB1 ExhMgT_tCat1MaxCptProtnMaxThd ExhMgT_tDifCat1B1 ExhMgT_tDifCat1MaxB1 ExhMgT_tDifExhMnfB1 ExhMgT_tExhDsVlvB1 ExhMgT_tExhMnfB1 ExhMgT_tExhMnfMaxB1 ExhMgT_tMinCatB1 ExhMgT_tMinCatB1B2 ExhMgT_tMinCatDelta ExhMgT_tMinCatLo ExhMgT_tMinExhB1 ExhMgT_tMinExhB1B2 ExhMgT_tMinExhDelta ExhMgT_tMinExhLo ExhMgT_tMinTExhCptProtnB1 ExhMgT_tMinTExhCptProtnGlb ExhMgT_tMinTWallCptProtnB1 ExhMgT_tOffsCptPrtnLimpB1 /end OUT_MEASUREMENT
 /begin LOC_MEASUREMENT ExhMgT_facIntrpnTCat1 ExhMgT_facIntrpnTCat2 ExhMgT_facIntrpnTMnf ExhMgT_flgExhActvCptProtnTExh ExhMgT_flgOffTemp ExhMgT_flgOverTCat1Max ExhMgT_flgOverTCat2Max ExhMgT_flgOverTMnflMax ExhMgT_flgtExhMnfMaxB1 ExhMgT_flgThdCatLo ExhMgT_flgThdExhLo ExhMgT_flgTiCdnDynThd ExhMgT_flgTiCdnDynThdRst ExhMgT_flgTiCdnDynThdSet ExhMgT_flgTiOverMaxCat1 ExhMgT_flgTiOverMaxCat2 ExhMgT_tCat1MaxCptProtnMax ExhMgT_tCat2CptProtnMax ExhMgT_tCat2MaxB1 ExhMgT_tCat2MaxMaxThd ExhMgT_tCatThdMin ExhMgT_tDifCatThd ExhMgT_tDifExhThd ExhMgT_tExhCat1CptProtnUsMax ExhMgT_tExhCat2CptProtnUsMax ExhMgT_tExhDsVlvCptProtnMax ExhMgT_tExhFrtPipCptProtnMax ExhMgT_tExhMnfMaxThd ExhMgT_tExhThdMin ExhMgT_tiCdnDnyThd ExhMgT_tiDifCdnDyn ExhMgT_tMinCat1B1 ExhMgT_tMinCat2B1 ExhMgT_tMinCatDeltaCorrd ExhMgT_tMinCatLoCorrd ExhMgT_tMinExhDeltaCorrd ExhMgT_tMinExhLoCorrd ExhMgT_tMinThd ExhMgT_tRstDynThd ExhMgT_tWallAryMin ExhMgT_tWallCptProtnB1 ExhMgT_tWallMnfldCptProtn ExhMgT_tWallMnfldCptProtnSnsr /end LOC_MEASUREMENT
 FUNCTION_VERSION "1.13.0_1.1.0" /end FUNCTION
/begin FUNCTION ExhMgT_CatHeatgUpIf "2.8.0     interface function operating conditions for catalyst heating request"
 /begin DEF_CHARACTERISTIC ExhMgT_facCorrnTempCatHeatgMax_C ExhMgT_facCorrnTempCatHeatgMin_C ExhMgT_stCatHeatgCold3_C ExhMgT_stOperModDmd_C ExhMgT_tCatHeatgMax_C /end DEF_CHARACTERISTIC
 /begin IN_MEASUREMENT EngStrt_bStrtEnd Epm_stSpd ExhMgT_facCatHeatgFinshd ExhMgT_facCatHeatgProgs ExhMgT_facHeatgDmdCat ExhMgT_flgCatHeatgColdStrtReq ExhMgT_flgCatHeatgReqActv ExhMgT_flgCatHeatgUpActv ExhMgT_flgCatHeatgWrmReq ExhMgT_flgNoCatHeatgDmd ExhMgT_tCat1B1Min ExhMgT_tCat1Seln1 ExhMgT_tThdCatHeatg SyC_ctPostDrvLeave SyC_stSub /end IN_MEASUREMENT
 /begin OUT_MEASUREMENT bdemodkw_msg B_anfhsgkw_msg B_anfscgkw_msg B_bbmrkh_msg B_khakt_msg B_khakw_msg B_khan_msg B_khasuhsp_msg B_khat_msg B_kha_msg B_kherr_msg B_khmr_msg B_kh_msg B_kw_msg B_laspkt_msg B_laspkw_msg B_trkh_msg B_trkonz2_msg B_trkonz_msg ExhMgT_facCorrnMAirCatHeatg ExhMgT_facCorrnTempCatHeatg ExhMgT_flgCatHeatFinshd ExhMgT_flgCatHeatgColdStrtLamSplitReq ExhMgT_flgCatHeatgEolTest ExhMgT_flgCatHeatgFirstStrt ExhMgT_flgCatHeatgFirstStrtFinshd ExhMgT_flgCatHeatgFolwStrt ExhMgT_flgCatHeatgFolwStrtWoStop ExhMgT_flgCatHeatgRed ExhMgT_flgCatHeatgRepStrt ExhMgT_flgCatHeatgReqRstSnd ExhMgT_flgCatHeatgWrm ExhMgT_flgCatHeatNormFinshd ExhMgT_flgCatHeatWrmLamSplitReq ExhMgT_flgCatHeatWrmReq ExhMgT_flgReqHosThd ExhMgT_flgReqLamSplitTMin ExhMgT_numCatHeatg ExhMgT_stOperModDmd ExhMgT_tCat1Min ExhMgT_tCat1SelnStrt ExhMgT_tCatHeatgWrmThd ExhMgT_tDiffTCatHeatgFolwStrt ExhMgT_tiCatHeatgFolwStrtDiff fanfkw_w_msg fkhab_msg imlpr_w_msg wistr_w_msg /end OUT_MEASUREMENT
 /begin LOC_MEASUREMENT ExhMgT_CatHeatgUpReqIf_ctReIni ExhMgT_nrColdStrt /end LOC_MEASUREMENT
 FUNCTION_VERSION "2.8.0" /end FUNCTION
/begin FUNCTION ExhMgT_CatHeatgUpReq "1.23.0    operating conditions for catalyst heating request"
 /begin DEF_CHARACTERISTIC ExhMgT_nrBrickTCat1Avrg_C ExhMgT_nrBrickTCat1Max_C ExhMgT_nrBrickTCat1Min_C ExhMgT_nrBrickTCat2Avrg_C ExhMgT_nrBrickTCat2Max_C ExhMgT_nrBrickTCat2Min_C CatH_TempSelnCat1B1_I.ExhMgT_idxBrick1Cat_C CatH_TempSelnCat1B1_I.ExhMgT_idxBrick2Cat_C CatH_TempSelnCat1B1_I.ExhMgT_idxBrick3Cat_C CatH_TempSelnCat2B1_I.ExhMgT_idxBrick1Cat_C CatH_TempSelnCat2B1_I.ExhMgT_idxBrick2Cat_C CatH_TempSelnCat2B1_I.ExhMgT_idxBrick3Cat_C ExhMgT_facInvnHeatgDmdHeatgProgs_T ExhMgT_facThdCatHeatgColdFinshdGpf_C ExhMgT_facThdCatHeatgFinshd_C ExhMgT_facThdEtaCatWrm_C ExhMgT_facThdEtaColdStrtHeatg_C ExhMgT_nrCatHighPrio_C ExhMgT_nrTCat1Seln1_C ExhMgT_nrTCat1Seln2_C ExhMgT_nrTCat2Seln1_C ExhMgT_nrTCat2Seln2_C ExhMgT_nrTDesMinCatEngOff_C ExhMgT_stCatHeatgUpReq2_C ExhMgT_stCatHeatgUpReq_C ExhMgT_stHeatgModeFacProgsAry_CA ExhMgT_tDelta2CatHeatgCatHiPrio_C ExhMgT_tDeltaCatHeatgCatHiPrio_C ExhMgT_tDeltaCatHeatgCatLoPrio_C ExhMgT_tDeltaEngStopCatCoolgMax_C ExhMgT_tDeltaMinCatAge_T ExhMgT_tDesMinCatDmd_C ExhMgT_tDesMinCatEngOff_C ExhMgT_tDesMinLoPrioCatDmd_C ExhMgT_tiCatHeatgFacColdFinshGpf_C ExhMgT_tiCatHeatgFacFinsh_C ExhMgT_tiCatHeatgFacRampDown_C ExhMgT_tiCatHeatgFacRampUp_C ExhMgT_tiDlyCatHeatgCptPrtn_C ExhMgT_tThd2CatHeatgCatHiPrio_T ExhMgT_tThdCatHeatgCatHiPrio_T ExhMgT_tThdCatHeatgCatLoPrio_T /end DEF_CHARACTERISTIC
 /begin IN_MEASUREMENT EngStrt_bStrtEnd Epm_stSpd ExhMgT_facEtaCatWrmAltiT ExhMgT_facEtaColdStrtHeatgAltiT ExhMgT_flgActvCptProtn ExhMgT_flgCatHeatgEolTest ExhMod_ratO2StorgCatB1_a ExhMod_ratO2StrCat1MinBnk ExhMod_tCatBrickAryB1 SyC_ctPostDrvLeave SyC_stSub /end IN_MEASUREMENT
 /begin OUT_MEASUREMENT ExhMgT_facCatHeatgFinshd ExhMgT_facCatHeatgProgs ExhMgT_facCatHeatgRamp ExhMgT_facHeatgDmdCat ExhMgT_facHeatgDmdCat1B1 ExhMgT_facHeatgDmdCat2B1 ExhMgT_facHeatgDmdCatLoPrio ExhMgT_facWghtCat1Age ExhMgT_facWghtCatAge ExhMgT_flgCatHeatgColdStrtDmd ExhMgT_flgCatHeatgColdStrtReq ExhMgT_flgCatHeatgColdStrtWoFIdReq ExhMgT_flgCatHeatgGpfRgnReq ExhMgT_flgCatHeatgReqActv ExhMgT_flgCatHeatgUpActv ExhMgT_flgCatHeatgWrmDmd ExhMgT_flgCatHeatgWrmReq ExhMgT_flgCatHeatgWrmWoFIdReq ExhMgT_flgNoCatHeatgDmd ExhMgT_stCatHeatgMode ExhMgT_tCat1B1Min ExhMgT_tCat1Seln1 ExhMgT_tCat1Seln1B1 ExhMgT_tCat1Seln2 ExhMgT_tCat2B1Min ExhMgT_tCat2Seln1 ExhMgT_tCat2Seln1B1 ExhMgT_tCat2Seln2 ExhMgT_tCatColdStrt ExhMgT_tCatHeatgTCatSelnActn ExhMgT_tThdCatHeatg ExhMgT_tUpprThd2HiPrio ExhMgT_tUpprThdDiagEtaIa ExhMgT_tUpprThdHiPrio ExhMgT_tUpprThdLoPrio /end OUT_MEASUREMENT
 /begin LOC_MEASUREMENT CatH_TempSelnCat1B1_I.tCatAvrg CatH_TempSelnCat1B1_I.tCatBrick1 CatH_TempSelnCat1B1_I.tCatBrick2 CatH_TempSelnCat1B1_I.tCatBrick3 CatH_TempSelnCat1B1_I.tCatMax CatH_TempSelnCat1B1_I.tCatMin CatH_TempSelnCat1B1_I.tCatSeln1 CatH_TempSelnCat1B1_I.tCatSeln2 CatH_TempSelnCat2B1_I.tCatAvrg CatH_TempSelnCat2B1_I.tCatBrick1 CatH_TempSelnCat2B1_I.tCatBrick2 CatH_TempSelnCat2B1_I.tCatBrick3 CatH_TempSelnCat2B1_I.tCatMax CatH_TempSelnCat2B1_I.tCatMin CatH_TempSelnCat2B1_I.tCatSeln1 CatH_TempSelnCat2B1_I.tCatSeln2 ExhMgT_CatHeatgUpReq_ctReIni ExhMgT_flgCatHeatgColdStrtAltiRst ExhMgT_flgCatHeatgColdStrtRst ExhMgT_flgCatHeatgFinshdReq ExhMgT_flgCatHeatgTWin2 ExhMgT_flgCatHeatgWrmAltiRst ExhMgT_flgCatHeatgWrmRst ExhMgT_flgEngStopTCatCoolg ExhMgT_flgEngStrt ExhMgT_flgEpmSpdZr ExhMgT_flgFirstCatHeatg ExhMgT_flgTBlwLowrThd2HiPrio ExhMgT_flgTBlwLowrThdHiPrio ExhMgT_flgTLightOffOnceRea ExhMgT_flgTUpprThd2HiPrio ExhMgT_flgTUpprThdHiPrio ExhMgT_flgTUpprThdLoPrio ExhMgT_stCatHeatg ExhMgT_stEquPrioCat ExhMgT_stTHiPrioCat ExhMgT_stTLoPrioCat ExhMgT_tCatHiPrioEngRunStop ExhMgT_tCatHiPrioSeln1 ExhMgT_tCatLoPrioSeln1 ExhMgT_tDeltaEngStopCatCoolg ExhMgT_tDesMinCatHiPrio ExhMgT_tDesMinCatLoPrio ExhMgT_tDifCatHeatgDmd ExhMgT_tDifCatHiPrioCatStrt ExhMgT_tDifCatSelnCatStrt ExhMgT_tDifThdCatHeatgDmd ExhMgT_tIntglCatSelnCatStrt ExhMgT_tThdCatHeatgCatHiPrio ExhMgT_tUpprThdCatHeatgHiPrio /end LOC_MEASUREMENT
 FUNCTION_VERSION "1.23.0" /end FUNCTION
/begin COMPU_METHOD B_TRUE "" TAB_VERB "%6.3" "" COMPU_TAB_REF B_TRUE /end COMPU_METHOD
/begin COMPU_VTAB B_TRUE "" TAB_VERB 2 0 "FALSE" 1 "TRUE" /end COMPU_VTAB
/begin COMPU_METHOD dez "" RAT_FUNC "%6.2" "" COEFFS 0 1 0 0 0 1 /end COMPU_METHOD
/begin COMPU_METHOD EngN_LRes "" RAT_FUNC "%6.1" "rpm" COEFFS 0 0.025 0 0 0 1 /end COMPU_METHOD
/begin COMPU_METHOD Fact "" RAT_FUNC "%6.5" "-" COEFFS 0 8192 0 0 0 1 /end COMPU_METHOD
/begin COMPU_METHOD fak_q0p000305 "" RAT_FUNC "%6.5" "-" COEFFS 0 65536 0 0 0 20 /end COMPU_METHOD
/begin COMPU_METHOD fak_q0p0039 "" RAT_FUNC "%6.4" "-" COEFFS 0 256 0 0 0 1 /end COMPU_METHOD
/begin COMPU_METHOD fak_q0p0078 "" RAT_FUNC "%6.4" "-" COEFFS 0 128 0 0 0 1 /end COMPU_METHOD
/begin COMPU_METHOD fak_sw_b256 "" RAT_FUNC "%6.4" "-" COEFFS 0 65536 0 0 0 512 /end COMPU_METHOD
/begin COMPU_METHOD fak_sw_b8 "" RAT_FUNC "%6.5" "-" COEFFS 0 65536 0 0 0 16 /end COMPU_METHOD
/begin COMPU_METHOD fak_ub_b0p125 "" RAT_FUNC "%6.5" "-" COEFFS 0 256 0 0 0 0.125 /end COMPU_METHOD
/begin COMPU_METHOD fak_ub_b0p25 "" RAT_FUNC "%10.7" "-" COEFFS 0 256 0 0 0 0.25 /end COMPU_METHOD
/begin COMPU_METHOD fak_ub_b1 "" RAT_FUNC "%6.4" "-" COEFFS 0 256 0 0 0 1 /end COMPU_METHOD
/begin COMPU_METHOD fak_ub_b2 "" RAT_FUNC "%8.5" "-" COEFFS 0 256 0 0 0 2 /end COMPU_METHOD
/begin COMPU_METHOD fak_ub_b4 "" RAT_FUNC "%6.4" "-" COEFFS 0 256 0 0 0 4 /end COMPU_METHOD
/begin COMPU_METHOD fak_ub_b64 "" RAT_FUNC "%6.3" "-" COEFFS 0 256 0 0 0 64 /end COMPU_METHOD
/begin COMPU_METHOD fak_uw_b1 "" RAT_FUNC "%7.6" "-" COEFFS 0 65536 0 0 0 1 /end COMPU_METHOD
/begin COMPU_METHOD fak_uw_b16 "" RAT_FUNC "%6.5" "-" COEFFS 0 65536 0 0 0 16 /end COMPU_METHOD
/begin COMPU_METHOD fak_uw_b2 "" RAT_FUNC "%7.6" "-" COEFFS 0 65536 0 0 0 2 /end COMPU_METHOD
/begin COMPU_METHOD fak_uw_b32 "" RAT_FUNC "%6.5" "-" COEFFS 0 65536 0 0 0 32 /end COMPU_METHOD
/begin COMPU_METHOD fak_uw_b4 "" RAT_FUNC "%7.6" "-" COEFFS 0 65536 0 0 0 4 /end COMPU_METHOD
/begin COMPU_METHOD fak_uw_b5 "" RAT_FUNC "%7.6" "-" COEFFS 0 65536 0 0 0 5 /end COMPU_METHOD
/begin COMPU_METHOD fak_uw_b64 "" RAT_FUNC "%6.5" "-" COEFFS 0 65536 0 0 0 64 /end COMPU_METHOD
/begin COMPU_METHOD INTKAIRT_SNSR4COLDCRSSCHK_SC_Compu "" TAB_VERB "%6.3" "" COMPU_TAB_REF INTKAIRT_SNSR4COLDCRSSCHK_SC_Compu /end COMPU_METHOD
/begin COMPU_VTAB INTKAIRT_SNSR4COLDCRSSCHK_SC_Compu "" TAB_VERB 2 0 "Disabled" 1 "Enabled" /end COMPU_VTAB
/begin COMPU_METHOD INTKAIRT_SNSR4PLAUSCHK_SC_Compu "" TAB_VERB "%6.3" "" COMPU_TAB_REF INTKAIRT_SNSR4PLAUSCHK_SC_Compu /end COMPU_METHOD
/begin COMPU_VTAB INTKAIRT_SNSR4PLAUSCHK_SC_Compu "" TAB_VERB 2 0 "Disabled" 1 "Enabled" /end COMPU_VTAB
/begin COMPU_METHOD INTKAIRT_SNSR4PLAUSPRC_SC_Compu "" TAB_VERB "%6.3" "" COMPU_TAB_REF INTKAIRT_SNSR4PLAUSPRC_SC_Compu /end COMPU_METHOD
/begin COMPU_VTAB INTKAIRT_SNSR4PLAUSPRC_SC_Compu "" TAB_VERB 3 0 "Disabled" 1 "Sensor_Voltage" 2 "Sensor_Temperature" /end COMPU_VTAB
/begin COMPU_METHOD INTKAIRT_SNSR4PLAUSSTUCKCHK_SC_Compu "" TAB_VERB "%6.3" "" COMPU_TAB_REF INTKAIRT_SNSR4PLAUSSTUCKCHK_SC_Compu /end COMPU_METHOD
/begin COMPU_VTAB INTKAIRT_SNSR4PLAUSSTUCKCHK_SC_Compu "" TAB_VERB 2 0 "Disabled" 1 "Enabled" /end COMPU_VTAB
/begin COMPU_METHOD INTKAIRT_SNSR4POS_SC_Compu "" TAB_VERB "%6.3" "" COMPU_TAB_REF INTKAIRT_SNSR4POS_SC_Compu /end COMPU_METHOD
/begin COMPU_VTAB INTKAIRT_SNSR4POS_SC_Compu "" TAB_VERB 7 0 "no_sensor" 1 "IntkMnfld" 2 "MnfldIcoDs" 3 "ThrVlvUs" 4 "CmprDs" 5 "AirFltDs" 6 "Cmpr2Us" /end COMPU_VTAB
/begin COMPU_METHOD INTKAIRT_SNSR4PWRSPLY_SC_Compu "" TAB_VERB "%6.3" "" COMPU_TAB_REF INTKAIRT_SNSR4PWRSPLY_SC_Compu /end COMPU_METHOD
/begin COMPU_VTAB INTKAIRT_SNSR4PWRSPLY_SC_Compu "" TAB_VERB 4 0 "PWRSPLY_DEACTIVATE" 1 "PWRSPLY1" 2 "PWRSPLY2" 3 "PWRSPLY3" /end COMPU_VTAB
/begin COMPU_METHOD INTKAIRT_SNSR5BNK_SC_Compu "" TAB_VERB "%6.3" "" COMPU_TAB_REF INTKAIRT_SNSR5BNK_SC_Compu /end COMPU_METHOD
/begin COMPU_VTAB INTKAIRT_SNSR5BNK_SC_Compu "" TAB_VERB 3 0 "no_sensor" 1 "Bank_1" 2 "Bank_2" /end COMPU_VTAB
/begin COMPU_METHOD INTKAIRT_SNSR5PLAUSCHK_SC_Compu "" TAB_VERB "%6.3" "" COMPU_TAB_REF INTKAIRT_SNSR5PLAUSCHK_SC_Compu /end COMPU_METHOD
/begin COMPU_VTAB INTKAIRT_SNSR5PLAUSCHK_SC_Compu "" TAB_VERB 2 0 "Disabled" 1 "Enabled" /end COMPU_VTAB
/begin COMPU_METHOD INTKAIRT_SNSR5PLAUSPRC_SC_Compu "" TAB_VERB "%6.3" "" COMPU_TAB_REF INTKAIRT_SNSR5PLAUSPRC_SC_Compu /end COMPU_METHOD
/begin COMPU_VTAB INTKAIRT_SNSR5PLAUSPRC_SC_Compu "" TAB_VERB 3 0 "Disabled" 1 "Sensor_Voltage" 2 "Sensor_Temperature" /end COMPU_VTAB
/begin COMPU_METHOD INTKAIRT_SNSR5PLAUSSTUCKCHK_SC_Compu "" TAB_VERB "%6.3" "" COMPU_TAB_REF INTKAIRT_SNSR5PLAUSSTUCKCHK_SC_Compu /end COMPU_METHOD
/begin COMPU_VTAB INTKAIRT_SNSR5PLAUSSTUCKCHK_SC_Compu "" TAB_VERB 2 0 "Disabled" 1 "Enabled" /end COMPU_VTAB
/begin COMPU_METHOD INTKAIRT_SNSR5POS_SC_Compu "" TAB_VERB "%6.3" "" COMPU_TAB_REF INTKAIRT_SNSR5POS_SC_Compu /end COMPU_METHOD
/begin COMPU_VTAB INTKAIRT_SNSR5POS_SC_Compu "" TAB_VERB 7 0 "no_sensor" 1 "IntkMnfld" 2 "MnfldIcoDs" 3 "ThrVlvUs" 4 "CmprDs" 5 "AirFltDs" 6 "Cmpr2Us" /end COMPU_VTAB
/begin COMPU_METHOD INTKAIRT_SNSR5PWRSPLY_SC_Compu "" TAB_VERB "%6.3" "" COMPU_TAB_REF INTKAIRT_SNSR5PWRSPLY_SC_Compu /end COMPU_METHOD
/begin COMPU_VTAB INTKAIRT_SNSR5PWRSPLY_SC_Compu "" TAB_VERB 4 0 "PWRSPLY_DEACTIVATE" 1 "PWRSPLY1" 2 "PWRSPLY2" 3 "PWRSPLY3" /end COMPU_VTAB
/begin COMPU_METHOD INTKAIRT_SNSR6BNK_SC_Compu "" TAB_VERB "%6.3" "" COMPU_TAB_REF INTKAIRT_SNSR6BNK_SC_Compu /end COMPU_METHOD
/begin COMPU_VTAB INTKAIRT_SNSR6BNK_SC_Compu "" TAB_VERB 3 0 "no_sensor" 1 "Bank_1" 2 "Bank_2" /end COMPU_VTAB
/begin COMPU_METHOD INTKAIRT_SNSR6PLAUSCHK_SC_Compu "" TAB_VERB "%6.3" "" COMPU_TAB_REF INTKAIRT_SNSR6PLAUSCHK_SC_Compu /end COMPU_METHOD
/begin COMPU_VTAB INTKAIRT_SNSR6PLAUSCHK_SC_Compu "" TAB_VERB 2 0 "Disabled" 1 "Enabled" /end COMPU_VTAB
/begin COMPU_METHOD INTKAIRT_SNSR6PLAUSPRC_SC_Compu "" TAB_VERB "%6.3" "" COMPU_TAB_REF INTKAIRT_SNSR6PLAUSPRC_SC_Compu /end COMPU_METHOD
/begin COMPU_VTAB INTKAIRT_SNSR6PLAUSPRC_SC_Compu "" TAB_VERB 3 0 "Disabled" 1 "Sensor_Voltage" 2 "Sensor_Temperature" /end COMPU_VTAB
/begin COMPU_METHOD INTKAIRT_SNSR6PLAUSSTUCKCHK_SC_Compu "" TAB_VERB "%6.3" "" COMPU_TAB_REF INTKAIRT_SNSR6PLAUSSTUCKCHK_SC_Compu /end COMPU_METHOD
/begin COMPU_VTAB INTKAIRT_SNSR6PLAUSSTUCKCHK_SC_Compu "" TAB_VERB 2 0 "Disabled" 1 "Enabled" /end COMPU_VTAB
/begin COMPU_METHOD INTKAIRT_SNSR6POS_SC_Compu "" TAB_VERB "%6.3" "" COMPU_TAB_REF INTKAIRT_SNSR6POS_SC_Compu /end COMPU_METHOD
/begin COMPU_VTAB INTKAIRT_SNSR6POS_SC_Compu "" TAB_VERB 7 0 "no_sensor" 1 "IntkMnfld" 2 "MnfldIcoDs" 3 "ThrVlvUs" 4 "CmprDs" 5 "AirFltDs" 6 "Cmpr2Us" /end COMPU_VTAB
/begin COMPU_METHOD INTKAIRT_SNSR6PWRSPLY_SC_Compu "" TAB_VERB "%6.3" "" COMPU_TAB_REF INTKAIRT_SNSR6PWRSPLY_SC_Compu /end COMPU_METHOD
/begin COMPU_VTAB INTKAIRT_SNSR6PWRSPLY_SC_Compu "" TAB_VERB 4 0 "PWRSPLY_DEACTIVATE" 1 "PWRSPLY1" 2 "PWRSPLY2" 3 "PWRSPLY3" /end COMPU_VTAB
/begin COMPU_METHOD INTKAIRT_THRVLVUSB2_SC_Compu "" TAB_VERB "%6.3" "" COMPU_TAB_REF INTKAIRT_THRVLVUSB2_SC_Compu /end COMPU_METHOD
/begin COMPU_VTAB INTKAIRT_THRVLVUSB2_SC_Compu "" TAB_VERB 3 0 "no_signal" 1 "sensor" 2 "model" /end COMPU_VTAB
/begin COMPU_METHOD INTKAIRT_THRVLVUS_SC_Compu "" TAB_VERB "%6.3" "" COMPU_TAB_REF INTKAIRT_THRVLVUS_SC_Compu /end COMPU_METHOD
/begin COMPU_VTAB INTKAIRT_THRVLVUS_SC_Compu "" TAB_VERB 3 0 "no_signal" 1 "sensor" 2 "model" /end COMPU_VTAB
/begin COMPU_METHOD INTKAIRT_TYPAVL_SC_Compu "" TAB_VERB "%6.3" "" COMPU_TAB_REF INTKAIRT_TYPAVL_SC_Compu /end COMPU_METHOD
/begin COMPU_VTAB INTKAIRT_TYPAVL_SC_Compu "" TAB_VERB 2 0 "False" 1 "True" /end COMPU_VTAB
/begin COMPU_METHOD IOEXTDEV_CJ260_SC_Compu "" RAT_FUNC "%6.2" "" COEFFS 0 1 0 0 0 1 /end COMPU_METHOD
/begin COMPU_METHOD IOEXTDEV_PORTEXP_SC_Compu "" TAB_VERB "%6.3" "" COMPU_TAB_REF IOEXTDEV_PORTEXP_SC_Compu /end COMPU_METHOD
/begin COMPU_VTAB IOEXTDEV_PORTEXP_SC_Compu "" TAB_VERB 2 0 "No_Port_Expander" 1 "Port_Expander_I2C" /end COMPU_VTAB
/begin COMPU_METHOD IPDUM_SC_Compu "" TAB_VERB "%6.3" "" COMPU_TAB_REF IPDUM_SC_Compu /end COMPU_METHOD
/begin COMPU_VTAB IPDUM_SC_Compu "" TAB_VERB 2 0 "False" 1 "True" /end COMPU_VTAB
/begin COMPU_METHOD IUMPR_SY_Compu "" TAB_VERB "%6.3" "" COMPU_TAB_REF IUMPR_SY_Compu /end COMPU_METHOD
/begin COMPU_VTAB IUMPR_SY_Compu "" TAB_VERB 2 0 "NO_IUMPR_ACTIVE" 1 "IUMPR_ACTIVE" /end COMPU_VTAB
/begin COMPU_METHOD IUMPR_VERS_SY_Compu "" TAB_VERB "%6.3" "" COMPU_TAB_REF IUMPR_VERS_SY_Compu /end COMPU_METHOD
/begin COMPU_VTAB IUMPR_VERS_SY_Compu "" TAB_VERB 4 0 "IUMPR_2005" 1 "IUMPR_2007" 2 "IUMPR_2009" 3 "IUMPR_2016" /end COMPU_VTAB
/begin COMPU_METHOD IVPFIPS_TESTPLSENA_SC_Compu "" TAB_VERB "%6.3" "" COMPU_TAB_REF IVPFIPS_TESTPLSENA_SC_Compu /end COMPU_METHOD
/begin COMPU_VTAB IVPFIPS_TESTPLSENA_SC_Compu "" TAB_VERB 2 0 "False" 1 "True" /end COMPU_VTAB
/begin COMPU_METHOD J1939NM_SC_Compu "" TAB_VERB "%6.3" "" COMPU_TAB_REF J1939NM_SC_Compu /end COMPU_METHOD
/begin COMPU_VTAB J1939NM_SC_Compu "" TAB_VERB 2 0 "False" 1 "True" /end COMPU_VTAB
/begin COMPU_METHOD J1939RM_SC_Compu "" TAB_VERB "%6.3" "" COMPU_TAB_REF J1939RM_SC_Compu /end COMPU_METHOD
/begin COMPU_VTAB J1939RM_SC_Compu "" TAB_VERB 2 0 "False" 1 "True" /end COMPU_VTAB
/begin COMPU_METHOD J1939TP_SC_Compu "" TAB_VERB "%6.3" "" COMPU_TAB_REF J1939TP_SC_Compu /end COMPU_METHOD
/begin COMPU_VTAB J1939TP_SC_Compu "" TAB_VERB 2 0 "False" 1 "True" /end COMPU_VTAB
/begin COMPU_METHOD Kd_1 "" RAT_FUNC "%6.4" "1/1" COEFFS 0 512 0 0 0 1 /end COMPU_METHOD
/begin COMPU_METHOD Kd_Lin_16 "" RAT_FUNC "%7.6" "1/1" COEFFS 0 32767 0 0 0 1 /end COMPU_METHOD
/begin COMPU_METHOD Kd_pRail2Q_1 "" RAT_FUNC "%7.6" "mm^3/s/hPa" COEFFS 0 40960 0 0 0 1 /end COMPU_METHOD
/begin COMPU_METHOD Kd_Prc_COMPU "" RAT_FUNC "%6.5" "%" COEFFS 0 8000 0 0 0 1 /end COMPU_METHOD
/begin COMPU_METHOD KHTRIP_SY_Compu "" TAB_VERB "%6.3" "" COMPU_TAB_REF KHTRIP_SY_Compu /end COMPU_METHOD
/begin COMPU_VTAB KHTRIP_SY_Compu "" TAB_VERB 2 0 "False" 1 "True" /end COMPU_VTAB
/begin COMPU_METHOD Ki "" RAT_FUNC "%6.5" "1/s" COEFFS 0 2147.483648 0 0 0 1 /end COMPU_METHOD
/begin COMPU_METHOD Ki_1 "" RAT_FUNC "%6.4" "1/s" COEFFS 0 67.108864 0 0 0 1 /end COMPU_METHOD
/begin COMPU_METHOD Ki_pRail2Q_1 "" RAT_FUNC "%7.6" "mm^3/s^2/hPa" COEFFS 0 10737.41824 0 0 0 1 /end COMPU_METHOD
/begin COMPU_METHOD Ki_Temp2EGTFact "" RAT_FUNC "%8.7" "-" COEFFS 0 429496.7296 0 0 0 1 /end COMPU_METHOD
/begin COMPU_METHOD kw_q0p0234 "" RAT_FUNC "%6.4" "Grad KW" COEFFS 0 32768 0 0 0 768 /end COMPU_METHOD
/begin COMPU_METHOD kw_q2p8125 "" RAT_FUNC "%6.2" "deg KW" COEFFS 0 1 0 0 0 2.8125 /end COMPU_METHOD
/begin COMPU_METHOD kw_q6 "" RAT_FUNC "%6.2" "Grad KW" COEFFS 0 1 0 0 0 6 /end COMPU_METHOD
/begin COMPU_METHOD m_ub_b23p3 "" RAT_FUNC "%6.3" "kg" COEFFS 0 2812.5 0 0 0 256 /end COMPU_METHOD
/begin COMPU_METHOD m_uw_b23p3 "" RAT_FUNC "%6.5" "kg" COEFFS 0 2812.5 0 0 0 1 /end COMPU_METHOD
/begin COMPU_METHOD nmotd_sw_q0p25 "" RAT_FUNC "%6.3" "1/min" COEFFS 0 1 0 0 0 0.25 /end COMPU_METHOD
/begin COMPU_METHOD nmot_q0p25 "" RAT_FUNC "%6.3" "1/min" COEFFS 0 4 0 0 0 1 /end COMPU_METHOD
/begin COMPU_METHOD nmot_ub_q40 "" RAT_FUNC "%6.1" "1/min" COEFFS 0 1 0 0 0 40 /end COMPU_METHOD
/begin COMPU_METHOD nmot_uw_q0p25 "" RAT_FUNC "%6.3" "1/min" COEFFS 0 1 0 0 0 0.25 /end COMPU_METHOD
/begin COMPU_METHOD OneToOne "" RAT_FUNC "%6.2" "-" COEFFS 0 1 0 0 0 1 /end COMPU_METHOD
/begin COMPU_METHOD q0p1_K "" RAT_FUNC "%6.3" "K" COEFFS 0 100 0 0 0 10 /end COMPU_METHOD
/begin COMPU_METHOD rel_q0p003052 "" RAT_FUNC "%6.4" "%" COEFFS 0 65536 0 0 0 200 /end COMPU_METHOD
/begin COMPU_METHOD rel_q0p09375 "" RAT_FUNC "%6.3" "%" COEFFS 0 1 0 0 0 0.09375 /end COMPU_METHOD
/begin COMPU_METHOD rel_q0p75 "" RAT_FUNC "%6.3" "%" COEFFS 0 4 0 0 0 3 /end COMPU_METHOD
/begin COMPU_METHOD rel_sw_b1536 "" RAT_FUNC "%6.4" "%" COEFFS 0 65536 0 0 0 3072 /end COMPU_METHOD
/begin COMPU_METHOD rel_sw_q0p0468 "" RAT_FUNC "%6.4" "%" COEFFS 0 65536 0 0 0 3072 /end COMPU_METHOD
/begin COMPU_METHOD rel_ub_b100 "" RAT_FUNC "%6.3" "%" COEFFS 0 256 0 0 0 100 /end COMPU_METHOD
/begin COMPU_METHOD rel_uw_b100 "" RAT_FUNC "%6.4" "%" COEFFS 0 65536 0 0 0 100 /end COMPU_METHOD
/begin COMPU_METHOD rel_uw_b200 "" RAT_FUNC "%6.4" "%" COEFFS 0 65536 0 0 0 200 /end COMPU_METHOD
/begin COMPU_METHOD rel_uw_q0p0234 "" RAT_FUNC "%6.4" "%" COEFFS 0 32 0 0 0 0.75 /end COMPU_METHOD
/begin COMPU_METHOD t100msxs_ub_b25p5 "" RAT_FUNC "%6.3" "s" COEFFS 0 1 0 0 0 0.1 /end COMPU_METHOD
/begin COMPU_METHOD t10msxs_uw_b655p35 "" RAT_FUNC "%6.4" "s" COEFFS 0 1 0 0 0 0.01 /end COMPU_METHOD
/begin COMPU_METHOD t1sxs_uw_q1 "" RAT_FUNC "%6.2" "s" COEFFS 0 1 0 0 0 1 /end COMPU_METHOD
/begin COMPU_METHOD TempK_float "" RAT_FUNC "%6.2" "K" COEFFS 0 1 0 0 0 1 /end COMPU_METHOD
/begin COMPU_METHOD Temp_Cels "" RAT_FUNC "%6.1" "deg C" COEFFS 0 10 2731.4 0 0 1 /end COMPU_METHOD
/begin COMPU_METHOD Temp_Kelv "" RAT_FUNC "%6.3" "K" COEFFS 0 10 0 0 0 1 /end COMPU_METHOD
/begin COMPU_METHOD temp_q0p0468_K "" RAT_FUNC "%6.4" "Grad K" COEFFS 0 256 0 0 0 12 /end COMPU_METHOD
/begin COMPU_METHOD temp_q0p1 "" RAT_FUNC "%6.3" "Grad C" COEFFS 0 10 0 0 0 1 /end COMPU_METHOD
/begin COMPU_METHOD temp_q0p1_K "" RAT_FUNC "%6.3" "K" COEFFS 0 10 0 0 0 1 /end COMPU_METHOD
/begin COMPU_METHOD temp_q0p1_o273 "" RAT_FUNC "%6.1" "Grad C" COEFFS 0 10 2731.4 0 0 1 /end COMPU_METHOD
/begin COMPU_METHOD temp_q0p75_om48 "" RAT_FUNC "%6.2" "Grad C" COEFFS 0 4 192 0 0 3 /end COMPU_METHOD
/begin COMPU_METHOD temp_ub_b191p25 "" RAT_FUNC "%6.3" "Grad C" COEFFS 0 1 0 0 0 0.75 /end COMPU_METHOD
/begin COMPU_METHOD temp_ub_q0p75_o48 "" RAT_FUNC "%6.2" "Grad C" COEFFS 0 1 48 0 0 0.75 /end COMPU_METHOD
/begin COMPU_METHOD Trq "" RAT_FUNC "%6.3" "Nm" COEFFS 0 10 0 0 0 1 /end COMPU_METHOD
/begin COMPU_METHOD txms_uw_q0p1 "" RAT_FUNC "%6.3" "ms" COEFFS 0 10 0 0 0 1 /end COMPU_METHOD
/begin COMPU_METHOD t_q0p01 "" RAT_FUNC "%6.4" "s" COEFFS 0 100 0 0 0 1 /end COMPU_METHOD
/begin COMPU_METHOD t_q0p1 "" RAT_FUNC "%6.3" "s" COEFFS 0 10 0 0 0 1 /end COMPU_METHOD
/begin COMPU_METHOD t_q1 "" RAT_FUNC "%6.2" "s" COEFFS 0 1 0 0 0 1 /end COMPU_METHOD
/begin COMPU_METHOD vfzg_uw_b512 "" RAT_FUNC "%6.4" "km/h" COEFFS 0 65536 0 0 0 512 /end COMPU_METHOD
/begin COMPU_METHOD zk100msxs_ub_b25p5 "" RAT_FUNC "%6.3" "s" COEFFS 0 0 256 0 10 0 /end COMPU_METHOD
/begin COMPU_METHOD zk100msxs_uw_b6553p6 "" RAT_FUNC "%6.1" "s" COEFFS 0 0 65536 0 10 0 /end COMPU_METHOD
/begin COMPU_METHOD zk10msxs_uw_b655p36 "" RAT_FUNC "%6.2" "s" COEFFS 0 0 65536 0 100 0 /end COMPU_METHOD
/begin COMPU_METHOD zk5msxs_uw_b327p68 "" RAT_FUNC "%6.2" "s" COEFFS 0 0 65536 0 200 0 /end COMPU_METHOD
/begin COMPU_METHOD zw_q6 "" RAT_FUNC "%6.2" "Grad KW" COEFFS 0 1 0 0 0 6 /end COMPU_METHOD
/begin COMPU_METHOD zw_sb_q6 "" RAT_FUNC "%6.2" "Grad KW" COEFFS 0 1 0 0 0 6 /end COMPU_METHOD
/begin RECORD_LAYOUT RB_Axis_U16 NO_AXIS_PTS_X 1 UWORD AXIS_PTS_X 2 UWORD INDEX_INCR DIRECT /end RECORD_LAYOUT
/begin RECORD_LAYOUT RB_Axis_U8 NO_AXIS_PTS_X 1 UBYTE AXIS_PTS_X 2 UBYTE INDEX_INCR DIRECT /end RECORD_LAYOUT
/begin RECORD_LAYOUT RB_CurveGroup_S16 FNC_VALUES 1 SWORD COLUMN_DIR DIRECT /end RECORD_LAYOUT
/begin RECORD_LAYOUT RB_CurveGroup_U16 FNC_VALUES 1 UWORD COLUMN_DIR DIRECT /end RECORD_LAYOUT
/begin RECORD_LAYOUT RB_CurveGroup_U8 FNC_VALUES 1 UBYTE COLUMN_DIR DIRECT /end RECORD_LAYOUT
/begin RECORD_LAYOUT RB_Curve_S16_S16 NO_AXIS_PTS_X 1 SWORD AXIS_PTS_X 2 SWORD INDEX_INCR DIRECT FNC_VALUES 3 SWORD COLUMN_DIR DIRECT /end RECORD_LAYOUT
/begin RECORD_LAYOUT RB_Curve_U16_S16_Static NO_AXIS_PTS_X 1 UWORD AXIS_PTS_X 2 UWORD INDEX_INCR DIRECT FNC_VALUES 3 SWORD COLUMN_DIR DIRECT STATIC_RECORD_LAYOUT /end RECORD_LAYOUT
/begin RECORD_LAYOUT RB_Curve_U16_U16 NO_AXIS_PTS_X 1 UWORD AXIS_PTS_X 2 UWORD INDEX_INCR DIRECT FNC_VALUES 3 UWORD COLUMN_DIR DIRECT /end RECORD_LAYOUT
/begin RECORD_LAYOUT RB_Curve_U16_U8_Static NO_AXIS_PTS_X 1 UWORD AXIS_PTS_X 2 UWORD INDEX_INCR DIRECT FNC_VALUES 3 UBYTE COLUMN_DIR DIRECT STATIC_RECORD_LAYOUT /end RECORD_LAYOUT
/begin RECORD_LAYOUT RB_Curve_U8_U16_Static NO_AXIS_PTS_X 1 UBYTE AXIS_PTS_X 2 UBYTE INDEX_INCR DIRECT FNC_VALUES 3 UWORD COLUMN_DIR DIRECT STATIC_RECORD_LAYOUT /end RECORD_LAYOUT
/begin RECORD_LAYOUT RB_Curve_U8_U8 NO_AXIS_PTS_X 1 UBYTE AXIS_PTS_X 2 UBYTE INDEX_INCR DIRECT FNC_VALUES 3 UBYTE COLUMN_DIR DIRECT /end RECORD_LAYOUT
/begin RECORD_LAYOUT RB_FixCurve_U8_U8 FNC_VALUES 1 UBYTE COLUMN_DIR DIRECT /end RECORD_LAYOUT
/begin RECORD_LAYOUT RB_MapGroup_S8 FNC_VALUES 1 SBYTE COLUMN_DIR DIRECT /end RECORD_LAYOUT
/begin RECORD_LAYOUT RB_MapGroup_U16 FNC_VALUES 1 UWORD COLUMN_DIR DIRECT /end RECORD_LAYOUT
/begin RECORD_LAYOUT RB_MapGroup_U8 FNC_VALUES 1 UBYTE COLUMN_DIR DIRECT /end RECORD_LAYOUT
/begin RECORD_LAYOUT RB_Map_S16U16_U8 NO_AXIS_PTS_X 1 SWORD NO_AXIS_PTS_Y 2 SWORD AXIS_PTS_X 3 SWORD INDEX_INCR DIRECT AXIS_PTS_Y 4 UWORD INDEX_INCR DIRECT FNC_VALUES 5 UBYTE ROW_DIR DIRECT /end RECORD_LAYOUT
/begin RECORD_LAYOUT RB_Map_S16U8_S16 NO_AXIS_PTS_X 1 SWORD NO_AXIS_PTS_Y 2 SWORD AXIS_PTS_X 3 SWORD INDEX_INCR DIRECT AXIS_PTS_Y 4 UBYTE INDEX_INCR DIRECT FNC_VALUES 5 SWORD COLUMN_DIR DIRECT /end RECORD_LAYOUT
/begin RECORD_LAYOUT RB_Map_S16U8_U8 NO_AXIS_PTS_X 1 SWORD NO_AXIS_PTS_Y 2 SWORD AXIS_PTS_X 3 SWORD INDEX_INCR DIRECT AXIS_PTS_Y 4 UBYTE INDEX_INCR DIRECT FNC_VALUES 5 UBYTE COLUMN_DIR DIRECT /end RECORD_LAYOUT
/begin RECORD_LAYOUT RB_Map_U16U16_S16 NO_AXIS_PTS_X 1 UWORD NO_AXIS_PTS_Y 2 UWORD AXIS_PTS_X 3 UWORD INDEX_INCR DIRECT AXIS_PTS_Y 4 UWORD INDEX_INCR DIRECT FNC_VALUES 5 SWORD COLUMN_DIR DIRECT /end RECORD_LAYOUT
/begin RECORD_LAYOUT RB_Map_U16U16_U16 NO_AXIS_PTS_X 1 UWORD NO_AXIS_PTS_Y 2 UWORD AXIS_PTS_X 3 UWORD INDEX_INCR DIRECT AXIS_PTS_Y 4 UWORD INDEX_INCR DIRECT FNC_VALUES 5 UWORD COLUMN_DIR DIRECT /end RECORD_LAYOUT
/begin RECORD_LAYOUT RB_Map_U16U8_U16 NO_AXIS_PTS_X 1 UWORD NO_AXIS_PTS_Y 2 UWORD AXIS_PTS_X 3 UWORD INDEX_INCR DIRECT AXIS_PTS_Y 4 UBYTE INDEX_INCR DIRECT FNC_VALUES 5 UWORD COLUMN_DIR DIRECT /end RECORD_LAYOUT
/begin RECORD_LAYOUT RB_Map_U8U16_U8 NO_AXIS_PTS_X 1 UBYTE NO_AXIS_PTS_Y 2 UBYTE AXIS_PTS_X 3 UBYTE INDEX_INCR DIRECT AXIS_PTS_Y 4 UWORD INDEX_INCR DIRECT FNC_VALUES 5 UBYTE ROW_DIR DIRECT /end RECORD_LAYOUT
/begin RECORD_LAYOUT RB_Map_U8U8_U16 NO_AXIS_PTS_X 1 UBYTE NO_AXIS_PTS_Y 2 UBYTE AXIS_PTS_X 3 UBYTE INDEX_INCR DIRECT AXIS_PTS_Y 4 UBYTE INDEX_INCR DIRECT FNC_VALUES 5 UWORD COLUMN_DIR DIRECT /end RECORD_LAYOUT
/begin RECORD_LAYOUT RB_Map_U8U8_U8 NO_AXIS_PTS_X 1 UBYTE NO_AXIS_PTS_Y 2 UBYTE AXIS_PTS_X 3 UBYTE INDEX_INCR DIRECT AXIS_PTS_Y 4 UBYTE INDEX_INCR DIRECT FNC_VALUES 5 UBYTE COLUMN_DIR DIRECT /end RECORD_LAYOUT
/begin RECORD_LAYOUT RB_ValA_Wu8 FNC_VALUES 1 UBYTE COLUMN_DIR DIRECT /end RECORD_LAYOUT
/begin RECORD_LAYOUT RB_Val_Wr32 FNC_VALUES 1 FLOAT32_IEEE COLUMN_DIR DIRECT /end RECORD_LAYOUT
/begin RECORD_LAYOUT RB_Val_Ws16 FNC_VALUES 1 SWORD COLUMN_DIR DIRECT /end RECORD_LAYOUT
/begin RECORD_LAYOUT RB_Val_Wu16 FNC_VALUES 1 UWORD COLUMN_DIR DIRECT /end RECORD_LAYOUT
/begin RECORD_LAYOUT RB_Val_Wu8 FNC_VALUES 1 UBYTE COLUMN_DIR DIRECT /end RECORD_LAYOUT
/begin RECORD_LAYOUT Val_Wu16 FNC_VALUES 1 UWORD COLUMN_DIR DIRECT /end RECORD_LAYOUT
/end MODULE
/end PROJECT
