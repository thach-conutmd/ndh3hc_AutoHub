ASAP2_VERSION 1 60
/begin PROJECT MG1CA020 "MG1CA020"
/begin HEADER "" VERSION "MG1CA020_6SAY_V011_TPROT" PROJECT_NO MG1CA020 /end HEADER
/begin MODULE DIM ""
/begin MOD_COMMON "" BYTE_ORDER MSB_LAST ALIGNMENT_BYTE 1 ALIGNMENT_WORD 2 ALIGNMENT_LONG 4 ALIGNMENT_INT64 4 ALIGNMENT_FLOAT32_IEEE 4 ALIGNMENT_FLOAT64_IEEE 4 DATA_SIZE 32 /end MOD_COMMON
/begin CHARACTERISTIC ChrCtl_facTCorrnHfmPlst_T "correction of HFM pulsation depending on intake air temperature" CURVE 0x805237FC RB_Curve_S16_U8_Static 1.992188 fak_ub_b2 0.00 1.992188 FORMAT "%8.6"
 /begin AXIS_DESCR STD_AXIS IntkAirT_tIntkMnfld Temp_Cels 8 -3549.940 3003.560 FORMAT "%8.3" DEPOSIT ABSOLUTE /end AXIS_DESCR
/end CHARACTERISTIC
/begin CHARACTERISTIC ChrCtl_ratThrAgLimnAvdHfmPlst_M "Throttle angle limitation to avoid HFM pulsations" MAP 0x80523816 RB_Map_S16S16_U16 99.99847 rel_uw_b100 0.00 99.99847 FORMAT "%8.5"
 /begin AXIS_DESCR STD_AXIS ChrCtl_nEngHfmPlst EngN 8 -16384.00 16383.50 FORMAT "%8.2" DEPOSIT ABSOLUTE /end AXIS_DESCR
 /begin AXIS_DESCR STD_AXIS ChrCtl_agCamsftLimnHfmPlst kw_q0p0156 8 -512.0000 511.9844 FORMAT "%8.4" DEPOSIT ABSOLUTE /end AXIS_DESCR
/end CHARACTERISTIC
/begin CHARACTERISTIC Com_bTSCIntvSlowTrsmFail_C "Fail safe calibration value for Com_bTSCIntvSlowTrsmFail" VALUE 0x80523E0C RB_Val_Wu8 1.000 OneToOne 0.00 1.000 FORMAT "%5.3" EXTENDED_LIMITS 0.00 255.0 /end CHARACTERISTIC
/begin CHARACTERISTIC Com_bTSCIntvSlow_C "Calibration value for Com_bTSCIntvSlow" VALUE 0x80523E0D RB_Val_Wu8 1.000 OneToOne 0.00 1.000 FORMAT "%5.3" EXTENDED_LIMITS 0.00 255.0 /end CHARACTERISTIC
/begin CHARACTERISTIC Com_ctCRingEAT1_C "Default application constant ring counter for EAT1 frame" VALUE 0x80523DD4 RB_Val_Wu8 3.000 OneToOne 0.00 3.000 FORMAT "%5.3" EXTENDED_LIMITS 0.00 255.0 /end CHARACTERISTIC
/begin CHARACTERISTIC Com_ctCRingEAT2_C "Default application constant for Com_ctCRingEAT2 in case of defective reception" VALUE 0x80523E04 RB_Val_Wu8 3.000 OneToOne 0.00 3.000 FORMAT "%5.3" EXTENDED_LIMITS 0.00 255.0 /end CHARACTERISTIC
/begin CHARACTERISTIC Com_ctCRingEAT4_C "Default value for the message counter for frame EAT4 in case of system error" VALUE 0x80523E0E RB_Val_Wu8 3.000 OneToOne 0.00 3.000 FORMAT "%5.3" EXTENDED_LIMITS 0.00 255.0 /end CHARACTERISTIC
/begin CHARACTERISTIC Com_ctCRingEAT7_C "Calibration Ini value for the EAT7 frame ring counter" VALUE 0x80523E28 RB_Val_Wu8 3.000 OneToOne 0.00 3.000 FORMAT "%5.3" EXTENDED_LIMITS 0.00 255.0 /end CHARACTERISTIC
/begin CHARACTERISTIC Com_dCGW1MaxDiff_C "CGW1 Ring counter MAX Difference value" VALUE 0x80523F64 RB_Val_Wu8 255.0 OneToOne 0.00 255.0 FORMAT "%5.1" /end CHARACTERISTIC
/begin CHARACTERISTIC Com_dCGW1MaxPer_C "CGW1 Ring counter MAX Period value" VALUE 0x80523F65 RB_Val_Wu8 255.0 OneToOne 0.00 255.0 FORMAT "%5.1" /end CHARACTERISTIC
/begin CHARACTERISTIC Com_dEAT10MaxDiff_C "Maximum difference between 2 message counters of EAT10 for error detection" VALUE 0x80523DE0 RB_Val_Wu8 255.0 OneToOne 0.00 255.0 FORMAT "%5.1" /end CHARACTERISTIC
/begin CHARACTERISTIC Com_dEAT10MaxPer_C "Maximum period count for the detection of EAT10 stopped message counter" VALUE 0x80523DE1 RB_Val_Wu8 255.0 OneToOne 0.00 255.0 FORMAT "%5.1" /end CHARACTERISTIC
/begin CHARACTERISTIC Com_dEAT11MaxDiff_C "Maximum difference between 2 message counters of EAT11 for error detection" VALUE 0x80523DE8 RB_Val_Wu8 255.0 OneToOne 0.00 255.0 FORMAT "%5.1" /end CHARACTERISTIC
/begin CHARACTERISTIC Com_dEAT11MaxPer_C "Maximum period count for the detection of EAT11 stopped message counter" VALUE 0x80523DE9 RB_Val_Wu8 255.0 OneToOne 0.00 255.0 FORMAT "%5.1" /end CHARACTERISTIC
/begin CHARACTERISTIC Com_dEAT12MaxDiff_C "EAT12 Ring counter max diff calibration" VALUE 0x80523DEC RB_Val_Wu8 255.0 OneToOne 0.00 255.0 FORMAT "%5.1" /end CHARACTERISTIC
/begin CHARACTERISTIC Com_dEAT12MaxPer_C "EAT12 Ring counter Max Period calibration" VALUE 0x80523DED RB_Val_Wu8 255.0 OneToOne 0.00 255.0 FORMAT "%5.1" /end CHARACTERISTIC
/begin CHARACTERISTIC Com_dEAT12SigSel_C "Signal selection data for EAT12 frame" VALUE 0x80523DEE RB_Val_Wu8 255.0 OneToOne 0.00 255.0 FORMAT "%5.1" /end CHARACTERISTIC
/begin CHARACTERISTIC Com_dEAT13MaxDiff_C "Ring counter max diff calibartion" VALUE 0x80523DF8 RB_Val_Wu8 255.0 OneToOne 0.00 255.0 FORMAT "%5.1" /end CHARACTERISTIC
/begin CHARACTERISTIC Com_dEAT13MaxPer_C "EAT13 ring counter max period" VALUE 0x80523DF9 RB_Val_Wu8 255.0 OneToOne 0.00 255.0 FORMAT "%5.1" /end CHARACTERISTIC
/begin CHARACTERISTIC Com_dEAT13SigSel_C "Signal selection data for EAT13 frame" VALUE 0x80523DFA RB_Val_Wu8 255.0 OneToOne 0.00 255.0 FORMAT "%5.1" /end CHARACTERISTIC
/begin CHARACTERISTIC Com_dEAT1MaxDiff_C "Application constant for Maximum difference for EAT1 frame" VALUE 0x80523DD5 RB_Val_Wu8 255.0 OneToOne 0.00 255.0 FORMAT "%5.1" /end CHARACTERISTIC
/begin CHARACTERISTIC Com_dEAT1MaxPer_C "Period for EAT1 frame." VALUE 0x80523DD6 RB_Val_Wu8 255.0 OneToOne 0.00 255.0 FORMAT "%5.1" /end CHARACTERISTIC
/begin CHARACTERISTIC Com_dEAT2MaxDiff_C "Application constant for Maximum difference for EAT2 frame" VALUE 0x80523E05 RB_Val_Wu8 255.0 OneToOne 0.00 255.0 FORMAT "%5.1" /end CHARACTERISTIC
/begin CHARACTERISTIC Com_dEAT2MaxPer_C "Period for EAT2 frame." VALUE 0x80523E06 RB_Val_Wu8 255.0 OneToOne 0.00 255.0 FORMAT "%5.1" /end CHARACTERISTIC
/begin CHARACTERISTIC Com_dEAT4MaxDiff_C "Maximum difference between 2 message counters of EAT2 for error detection" VALUE 0x80523E0F RB_Val_Wu8 255.0 OneToOne 0.00 255.0 FORMAT "%5.1" /end CHARACTERISTIC
/begin CHARACTERISTIC Com_dEAT4MaxPer_C "Maximum period count for the detection of EAT2 stopped message counter" VALUE 0x80523E10 RB_Val_Wu8 255.0 OneToOne 0.00 255.0 FORMAT "%5.1" /end CHARACTERISTIC
/begin CHARACTERISTIC Com_dEAT6MaxDiff_C "Maximum difference between 2 message counters of EAT6 for error detection" VALUE 0x80523E24 RB_Val_Wu8 255.0 OneToOne 0.00 255.0 FORMAT "%5.1" /end CHARACTERISTIC
/begin CHARACTERISTIC Com_dEAT6MaxPer_C "Maximum period count for the detection of EAT6 stopped message counter" VALUE 0x80523E25 RB_Val_Wu8 255.0 OneToOne 0.00 255.0 FORMAT "%5.1" /end CHARACTERISTIC
/begin CHARACTERISTIC Com_dEAT6SigSel_C "Signal selection data for EAT6 frame" VALUE 0x80523E26 RB_Val_Wu8 255.0 OneToOne 0.00 255.0 FORMAT "%5.1" /end CHARACTERISTIC
/begin CHARACTERISTIC Com_dEAT7MaxDiff_C "Maximum difference between 2 message counters of EAT7 for error detection" VALUE 0x80523E29 RB_Val_Wu8 255.0 OneToOne 0.00 255.0 FORMAT "%5.1" /end CHARACTERISTIC
/begin CHARACTERISTIC Com_dEAT7MaxPer_C "Maximum period count for the detection of EAT7 stopped message counter" VALUE 0x80523E2A RB_Val_Wu8 255.0 OneToOne 0.00 255.0 FORMAT "%5.1" /end CHARACTERISTIC
/begin CHARACTERISTIC Com_dEAT8MaxDiff_C "Maximum difference between 2 message counters of EAT8 for error detection" VALUE 0x80523E48 RB_Val_Wu8 255.0 OneToOne 0.00 255.0 FORMAT "%5.1" /end CHARACTERISTIC
/begin CHARACTERISTIC Com_dEAT8MaxPer_C "Maximum period count for the detection of EAT8 stopped message counter" VALUE 0x80523E49 RB_Val_Wu8 255.0 OneToOne 0.00 255.0 FORMAT "%5.1" /end CHARACTERISTIC
/begin CHARACTERISTIC Com_dEATAMaxDiff_C "Application constant for Maximum difference for EATA frame" VALUE 0x80523EA2 RB_Val_Wu8 255.0 OneToOne 0.00 255.0 FORMAT "%5.1" /end CHARACTERISTIC
/begin CHARACTERISTIC Com_dEATAMaxPer_C "Period for EATA frame." VALUE 0x80523EA3 RB_Val_Wu8 255.0 OneToOne 0.00 255.0 FORMAT "%5.1" /end CHARACTERISTIC
/begin CHARACTERISTIC Com_dEATASigSel_C "Signal selection data for EATA frame" VALUE 0x80523EA4 RB_Val_Wu8 255.0 OneToOne 0.00 255.0 FORMAT "%5.1" /end CHARACTERISTIC
/begin CHARACTERISTIC Com_dEATBMaxDiff_C "calibration for Max difference between reception for EATB frame" VALUE 0x80523EA6 RB_Val_Wu8 255.0 OneToOne 0.00 255.0 FORMAT "%5.1" /end CHARACTERISTIC
/begin CHARACTERISTIC Com_dEATBMaxPer_C "calibration for error for EATB frame" VALUE 0x80523EA7 RB_Val_Wu8 255.0 OneToOne 0.00 255.0 FORMAT "%5.1" /end CHARACTERISTIC
/begin CHARACTERISTIC Com_dEATCMaxDiff_C "Ring Counter Diff for EATC" VALUE 0x80523ECC RB_Val_Wu8 255.0 OneToOne 0.00 255.0 FORMAT "%5.1" /end CHARACTERISTIC
/begin CHARACTERISTIC Com_dEATCMaxPer_C "Ring Counter period for EATC" VALUE 0x80523ECD RB_Val_Wu8 255.0 OneToOne 0.00 255.0 FORMAT "%5.1" /end CHARACTERISTIC
/begin CHARACTERISTIC Com_dGwCGW1SigSel_C "Signal selection data for CGW1 Rx frame" VALUE 0x80523F66 RB_Val_Wu8 255.0 OneToOne 0.00 255.0 FORMAT "%5.1" /end CHARACTERISTIC
/begin CHARACTERISTIC Com_dGwIMG1MaxDiff_C "GwIMG1 calibration for max difference" VALUE 0x80523F68 RB_Val_Wu8 255.0 OneToOne 0.00 255.0 FORMAT "%5.1" /end CHARACTERISTIC
/begin CHARACTERISTIC Com_dGwIMG1MaxPer_C "GwIMG1 calibration for max period" VALUE 0x80523F69 RB_Val_Wu8 255.0 OneToOne 0.00 255.0 FORMAT "%5.1" /end CHARACTERISTIC
/begin CHARACTERISTIC Com_dGwIMG3MaxDiff_C "GwIMG3 calibration for max difference" VALUE 0x80523F6A RB_Val_Wu8 255.0 OneToOne 0.00 255.0 FORMAT "%5.1" /end CHARACTERISTIC
/begin CHARACTERISTIC Com_dGwIMG3MaxPer_C "GwIMG3 calibration for max period" VALUE 0x80523F6B RB_Val_Wu8 255.0 OneToOne 0.00 255.0 FORMAT "%5.1" /end CHARACTERISTIC
/begin CHARACTERISTIC Com_dGwIMG4MaxDiff_C "GwIMG4 calibration for max difference" VALUE 0x80523F6E RB_Val_Wu8 255.0 OneToOne 0.00 255.0 FORMAT "%5.1" /end CHARACTERISTIC
/begin CHARACTERISTIC Com_dGwIMG4MaxPer_C "GwIMG4 calibration for max period" VALUE 0x80523F6F RB_Val_Wu8 255.0 OneToOne 0.00 255.0 FORMAT "%5.1" /end CHARACTERISTIC
/begin CHARACTERISTIC Com_dGwIMG5MaxDiff_C "IMG5 calibartion for Max difference" VALUE 0x80523F70 RB_Val_Wu8 255.0 OneToOne 0.00 255.0 FORMAT "%5.1" /end CHARACTERISTIC
/begin CHARACTERISTIC Com_dGwIMG5MaxPer_C "IMG5 calibration for maximum period" VALUE 0x80523F71 RB_Val_Wu8 255.0 OneToOne 0.00 255.0 FORMAT "%5.1" /end CHARACTERISTIC
/begin CHARACTERISTIC Com_dGwIMG6MaxDiff_C "GwIMG6 calibartion for max difference" VALUE 0x80523F72 RB_Val_Wu8 255.0 OneToOne 0.00 255.0 FORMAT "%5.1" /end CHARACTERISTIC
/begin CHARACTERISTIC Com_dGwIMG6MaxPer_C "GwIMG6 calibration for max period" VALUE 0x80523F73 RB_Val_Wu8 255.0 OneToOne 0.00 255.0 FORMAT "%5.1" /end CHARACTERISTIC
/begin CHARACTERISTIC Com_ErrDeb_FailSafeA_TmrEAT4_C "Timer Calibration for fail safe handling after which fail safe A values would be assigned to messages when error is in DEBOUNCING state" VALUE 0x80523E14 RB_Val_Ws32 21474836470.0 Time_ms 0.00 21474836470.0 FORMAT "%13.1" EXTENDED_LIMITS -21474836480.0 21474836470.0 /end CHARACTERISTIC
/begin CHARACTERISTIC Com_ErrDeb_FailSafeA_TmrEAT7_C "Timer Calibration after which Fail Safe A values would be assigned to messages when error is in DEBOUNCING state" VALUE 0x80523E2C RB_Val_Ws32 21474836470.0 Time_ms 0.00 21474836470.0 FORMAT "%13.1" EXTENDED_LIMITS -21474836480.0 21474836470.0 /end CHARACTERISTIC
/begin CHARACTERISTIC Com_nTrbn_C "calibration for Gbx_nTrbn" VALUE 0x80523E30 RB_Val_Wu16 16383.75 DFES_nPID0C 0.00 16383.75 FORMAT "%8.2" /end CHARACTERISTIC
/begin CHARACTERISTIC Com_numCsumEAT1_C "Default value for checksum for EAT1 frame" VALUE 0x80523DD7 RB_Val_Wu8 15.00 OneToOne 0.00 15.00 FORMAT "%5.2" EXTENDED_LIMITS 0.00 255.0 /end CHARACTERISTIC
/begin CHARACTERISTIC Com_numCsumEAT2_C "Checksum value in case of system errors for EAT2 frame" VALUE 0x80523E07 RB_Val_Wu8 15.00 OneToOne 0.00 15.00 FORMAT "%5.2" EXTENDED_LIMITS 0.00 255.0 /end CHARACTERISTIC
/begin CHARACTERISTIC Com_numCsumEAT4_C "Default value for checksum for frame EAT4 in case of system error" VALUE 0x80523E18 RB_Val_Wu8 15.00 OneToOne 0.00 15.00 FORMAT "%5.2" EXTENDED_LIMITS 0.00 255.0 /end CHARACTERISTIC
/begin CHARACTERISTIC Com_numCsumEAT7_C "Calibration Ini value for the EAT7 frame ring counterChecksum" VALUE 0x80523E32 RB_Val_Wu8 15.00 OneToOne 0.00 15.00 FORMAT "%5.2" EXTENDED_LIMITS 0.00 255.0 /end CHARACTERISTIC
/begin CHARACTERISTIC Com_rConvBoostErr_C "Torque Converter Boost Ratio Error Calibration" VALUE 0x80523DD8 RB_Val_Wu16 3.999939 Com_Fact_b0p00006 0.00 3.999939 FORMAT "%8.6" /end CHARACTERISTIC
/begin CHARACTERISTIC Com_rConvBoost_C "torque converter boost information calibration" VALUE 0x80523DDA RB_Val_Wu16 3.999939 Com_Fact_b0p00006 0.00 3.999939 FORMAT "%8.6" /end CHARACTERISTIC
/begin CHARACTERISTIC Com_rConvSlipHiLimHysHi_C "High limit hysteresis high of Torque convertor slip ratio" VALUE 0x80523E4A RB_Val_Wu16 327.6750 CrCtlSlipRat 0.00 327.6750 FORMAT "%8.4" /end CHARACTERISTIC
/begin CHARACTERISTIC Com_rConvSlipHiLimHysLo_C "High limit hysteresis low of Torque convertor slip ratio" VALUE 0x80523E4C RB_Val_Wu16 327.6750 CrCtlSlipRat 0.00 327.6750 FORMAT "%8.4" /end CHARACTERISTIC
/begin CHARACTERISTIC Com_rConvSlipLoLimHysHi_C "Low limit hysteresis high of Torque convertor slip ratio" VALUE 0x80523E4E RB_Val_Wu16 327.6750 CrCtlSlipRat 0.00 327.6750 FORMAT "%8.4" /end CHARACTERISTIC
/begin CHARACTERISTIC Com_rConvSlipLoLimHysLo_C "Low limit hysteresis low of Torque convertor slip ratio" VALUE 0x80523E50 RB_Val_Wu16 327.6750 CrCtlSlipRat 0.00 327.6750 FORMAT "%8.4" /end CHARACTERISTIC
/begin CHARACTERISTIC Com_rTarInfo_C "default calibration value for Target ratio information" VALUE 0x80523EA8 RB_Val_Wu8 3.984 TransR_COMPU 0.00 3.984 FORMAT "%5.3" /end CHARACTERISTIC
/begin CHARACTERISTIC Com_rTarPllyEAT7_C "Calibration for Target pulley ratio" VALUE 0x80523E33 RB_Val_Wu8 3.984 TransR_COMPU 0.00 3.984 FORMAT "%5.3" /end CHARACTERISTIC
/begin CHARACTERISTIC Com_rTarPlly_C "Calibration for target pulley ratio" VALUE 0x8053A4C8 KwWS16 1023.984 TransR_COMPU -512.0000 511.9844 FORMAT "%8.4" /end CHARACTERISTIC
/begin CHARACTERISTIC Com_rTrqCnvBoostDef_C "default value of VSA Torque Accuracy Improvement" VALUE 0x80523E52 RB_Val_Wu16 655.3500 TransR 0.00 655.3500 FORMAT "%8.4" /end CHARACTERISTIC
/begin CHARACTERISTIC Com_rTrsmTotFild_C "Calibration for Filtered TM overall ratio" VALUE 0x80523DE2 RB_Val_Wu16 31.99951 Fact_2pwr11 0.00 31.99951 FORMAT "%8.5" /end CHARACTERISTIC
/begin CHARACTERISTIC Com_stATFailr_C "default calibration value for AT Failure" VALUE 0x80523EA9 RB_Val_Wu8 255.0 OneToOne 0.00 255.0 FORMAT "%5.1" /end CHARACTERISTIC
/begin CHARACTERISTIC Com_stConvClth_C "calibration for Hydrodynamic converter clutch value" VALUE 0x8053A4CA KwWU8 255.0 OneToOne 0.00 255.0 FORMAT "%5.1" /end CHARACTERISTIC
/begin CHARACTERISTIC Com_stConvrClth_T "Curve for Com_stConvrClth" CURVE 0x8053A4CC KlAxU8SstxU16WU16 65535.00 OneToOne 0.00 65535.00 FORMAT "%8.2"
 /begin AXIS_DESCR STD_AXIS Com_rConvSlip CrCtlSlipRat 10 0.00 327.6750 FORMAT "%8.4" DEPOSIT ABSOLUTE /end AXIS_DESCR
/end CHARACTERISTIC
/begin CHARACTERISTIC Com_stCVTDsplGear_C "Calibration for Com_stCVTDsplGear" VALUE 0x80523EAA RB_Val_Wu8 255.0 OneToOne 0.00 255.0 FORMAT "%5.1" /end CHARACTERISTIC
/begin CHARACTERISTIC Com_stCVTEngmtInfo_C "Default value for Drive train engagement information for ISAB ( CVT PT engagement information )" VALUE 0x80523DDC RB_Val_Wu8 255.0 OneToOne 0.00 255.0 FORMAT "%5.1" /end CHARACTERISTIC
/begin CHARACTERISTIC Com_stCVTFailrInfo_C "default calibration value for CVT failur information" VALUE 0x80523EAB RB_Val_Wu8 255.0 OneToOne 0.00 255.0 FORMAT "%5.1" /end CHARACTERISTIC
/begin CHARACTERISTIC Com_stCVTFailr_C "default calibration value for CVT failure" VALUE 0x80523EAC RB_Val_Wu8 255.0 OneToOne 0.00 255.0 FORMAT "%5.1" /end CHARACTERISTIC
/begin CHARACTERISTIC Com_stCVTShiftActv_C "default calibration value forCVT Shift Active status" VALUE 0x80523EAD RB_Val_Wu8 255.0 OneToOne 0.00 255.0 FORMAT "%5.1" /end CHARACTERISTIC
/begin CHARACTERISTIC Com_stDFailrIndcn_C "default calibration value for blinking D for failure code indication" VALUE 0x80523EAE RB_Val_Wu8 255.0 OneToOne 0.00 255.0 FORMAT "%5.1" /end CHARACTERISTIC
/begin CHARACTERISTIC Com_stEATBCrkMask_C "Cranking Mask information of EATB information" VALUE 0x80523EAF RB_Val_Wu8 255.0 OneToOne 0.00 255.0 FORMAT "%5.1" /end CHARACTERISTIC
/begin CHARACTERISTIC Com_stIdleStrtStopDispFct_C "default calibration value of Idle startstop display function" VALUE 0x80523DDD RB_Val_Wu8 1.000 OneToOne 0.00 1.000 FORMAT "%5.3" EXTENDED_LIMITS 0.00 255.0 /end CHARACTERISTIC
/begin CHARACTERISTIC Com_stLCClth_C "status LLC clucth" VALUE 0x8053A4F6 KwWU8 255.0 OneToOne 0.00 255.0 FORMAT "%5.1" /end CHARACTERISTIC
/begin CHARACTERISTIC Com_stLuckUpOpn_C "status luck up open calibaration" VALUE 0x8053A4F7 KwWU8 1.00000000000 B_TRUE 0.00 1.00000000000 FORMAT "%13.11" /end CHARACTERISTIC
/begin CHARACTERISTIC Com_stMilLtgReq_C "default calibration value for MIL lighting request from transmission" VALUE 0x80523EB0 RB_Val_Wu8 255.0 OneToOne 0.00 255.0 FORMAT "%5.1" /end CHARACTERISTIC
/begin CHARACTERISTIC Com_stMissSnsrFlg_C "default calibration value for Missing Sensor Flag" VALUE 0x80523EB1 RB_Val_Wu8 255.0 OneToOne 0.00 255.0 FORMAT "%5.1" /end CHARACTERISTIC
/begin CHARACTERISTIC Com_stMLtgInfo_C "default calibration value for M lighting information for S-MATIC vehicle/meter indication" VALUE 0x80523EB2 RB_Val_Wu8 255.0 OneToOne 0.00 255.0 FORMAT "%5.1" /end CHARACTERISTIC
/begin CHARACTERISTIC Com_stNoShftSel_C "Calibration for NO SHIFT selection" VALUE 0x80523EB3 RB_Val_Wu8 1.000 OneToOne 0.00 1.000 FORMAT "%5.3" EXTENDED_LIMITS 0.00 255.0 /end CHARACTERISTIC
/begin CHARACTERISTIC Com_stShftInNeutr_C "Actual transmission position for N-range in case of system errors for TCU02 frame" VALUE 0x80523EB4 RB_Val_Wu8 1.000 OneToOne 0.00 1.000 FORMAT "%5.3" EXTENDED_LIMITS 0.00 255.0 /end CHARACTERISTIC
/begin CHARACTERISTIC Com_stShftInPark_C "Actual transmission position for P-range in case of system errors for TCU02 frame" VALUE 0x80523EB5 RB_Val_Wu8 1.000 OneToOne 0.00 1.000 FORMAT "%5.3" EXTENDED_LIMITS 0.00 255.0 /end CHARACTERISTIC
/begin CHARACTERISTIC Com_stShftSel0_C "Calibration for shift detection priority to check if bit0 of Com_stEATBByte0Info is set" VALUE 0x80523EB6 RB_Val_Wu8 255.0 OneToOne 0.00 255.0 FORMAT "%5.1" /end CHARACTERISTIC
/begin CHARACTERISTIC Com_stShftSel1_C "Calibration for shift detection priority to check bit1 of Com_stEATBByte0Info is set" VALUE 0x80523EB7 RB_Val_Wu8 255.0 OneToOne 0.00 255.0 FORMAT "%5.1" /end CHARACTERISTIC
/begin CHARACTERISTIC Com_stShftSel2_C "Calibration for shift detection priority to check bit2 of Com_stEATBByte0Info is set" VALUE 0x80523EB8 RB_Val_Wu8 255.0 OneToOne 0.00 255.0 FORMAT "%5.1" /end CHARACTERISTIC
/begin CHARACTERISTIC Com_stShftSel3_C "Calibration for shift detection priority to check bit3 of Com_stEATBByte0Info is set" VALUE 0x80523EB9 RB_Val_Wu8 255.0 OneToOne 0.00 255.0 FORMAT "%5.1" /end CHARACTERISTIC
/begin CHARACTERISTIC Com_stShftSel4_C "Calibration for shift detection priority to check bit4 of Com_stEATBByte0Info is set" VALUE 0x80523EBA RB_Val_Wu8 255.0 OneToOne 0.00 255.0 FORMAT "%5.1" /end CHARACTERISTIC
/begin CHARACTERISTIC Com_stShftSel5_C "Calibration for shift detection priority to check bit5 of Com_stEATBByte0Info is set" VALUE 0x80523EBB RB_Val_Wu8 255.0 OneToOne 0.00 255.0 FORMAT "%5.1" /end CHARACTERISTIC
/begin CHARACTERISTIC Com_stShiftPosnIndcn_C "default calibration value for Shift position indication for S-Matic" VALUE 0x80523EBC RB_Val_Wu8 255.0 OneToOne 0.00 255.0 FORMAT "%5.1" /end CHARACTERISTIC
/begin CHARACTERISTIC Com_stSpdSnsrFailr_C "default calibration value for Speed Sensor Failure" VALUE 0x80523EBD RB_Val_Wu8 255.0 OneToOne 0.00 255.0 FORMAT "%5.1" /end CHARACTERISTIC
/begin CHARACTERISTIC Com_stVehSpdSnsr_C "default calibration value for CVT vehicle speed sensor" VALUE 0x80523EBE RB_Val_Wu8 255.0 OneToOne 0.00 255.0 FORMAT "%5.1" /end CHARACTERISTIC
/begin CHARACTERISTIC Com_swtCrkCdn_C "calibration switch Auto Manual cranking" VALUE 0x80523EBF RB_Val_Wu8 255.0 OneToOne 0.00 255.0 FORMAT "%5.1" /end CHARACTERISTIC
/begin CHARACTERISTIC Com_swtEAT10MonEna_C "EAT10 error monitoring enable switch" VALUE 0x80523DE4 RB_Val_Wu8 1.000 OneToOne 0.00 1.000 FORMAT "%5.3" EXTENDED_LIMITS 0.00 255.0 /end CHARACTERISTIC
/begin CHARACTERISTIC Com_swtEAT1MonEna_C "EAT1 error monitoring enable switch" VALUE 0x80523DDE RB_Val_Wu8 1.000 OneToOne 0.00 1.000 FORMAT "%5.3" EXTENDED_LIMITS 0.00 255.0 /end CHARACTERISTIC
/begin CHARACTERISTIC Com_swtEAT2MonEna_C "EAT2 error monitoring enable switch" VALUE 0x80523E08 RB_Val_Wu8 1.000 OneToOne 0.00 1.000 FORMAT "%5.3" EXTENDED_LIMITS 0.00 255.0 /end CHARACTERISTIC
/begin CHARACTERISTIC Com_swtEAT4MonEna_C "EAT4 error monitoring enable switch" VALUE 0x80523E19 RB_Val_Wu8 1.000 OneToOne 0.00 1.000 FORMAT "%5.3" EXTENDED_LIMITS 0.00 255.0 /end CHARACTERISTIC
/begin CHARACTERISTIC Com_swtEAT6MonEna_C "EAT6 error monitoring enable switch" VALUE 0x80523E27 RB_Val_Wu8 1.000 OneToOne 0.00 1.000 FORMAT "%5.3" EXTENDED_LIMITS 0.00 255.0 /end CHARACTERISTIC
/begin CHARACTERISTIC Com_swtEAT7MonEna_C "EAT7 error monitoring enable switch" VALUE 0x80523E34 RB_Val_Wu8 1.000 OneToOne 0.00 1.000 FORMAT "%5.3" EXTENDED_LIMITS 0.00 255.0 /end CHARACTERISTIC
/begin CHARACTERISTIC Com_swtEAT8MonEna_C "EAT8 error monitoring enable switch" VALUE 0x80523E54 RB_Val_Wu8 1.000 OneToOne 0.00 1.000 FORMAT "%5.3" EXTENDED_LIMITS 0.00 255.0 /end CHARACTERISTIC
/begin CHARACTERISTIC Com_swtEATAMonEna_C "EATA error monitoring enable switch" VALUE 0x80523EA5 RB_Val_Wu8 1.000 OneToOne 0.00 1.000 FORMAT "%5.3" EXTENDED_LIMITS 0.00 255.0 /end CHARACTERISTIC
/begin CHARACTERISTIC Com_swtEATBMonEna_C "EATB error monitoring enable switch" VALUE 0x80523EC0 RB_Val_Wu8 1.000 OneToOne 0.00 1.000 FORMAT "%5.3" EXTENDED_LIMITS 0.00 255.0 /end CHARACTERISTIC
/begin CHARACTERISTIC Com_swtGbxConvClth_C "swicth convert clucth" VALUE 0x8053A4F8 KwWU8 1.00000000000 B_TRUE 0.00 1.00000000000 FORMAT "%13.11" /end CHARACTERISTIC
/begin CHARACTERISTIC Com_swtPTRatTrqCnv_C "switch value of Com_swtPTRatTrqCnv_C" VALUE 0x80523E55 RB_Val_Wu8 255.0 OneToOne 0.00 255.0 FORMAT "%5.1" /end CHARACTERISTIC
/begin CHARACTERISTIC Com_swtShiftPosn_C "calibration used for status of gear position" VALUE 0x80523EC1 RB_Val_Wu8 255.0 OneToOne 0.00 255.0 FORMAT "%5.1" /end CHARACTERISTIC
/begin CHARACTERISTIC Com_tiCanDebTmr_C "Calibration to recognize CAN disconnection error" VALUE 0x80523EC2 RB_Val_Ws16 32770.00 Time_ms 0.00 32770.00 FORMAT "%8.2" EXTENDED_LIMITS -327680.0 327670.0 /end CHARACTERISTIC
/begin CHARACTERISTIC Com_tiEAT12BusOffTOutDly_C "Timer of EAT12 with respect to bus Off and timeout Error" VALUE 0x80523DF0 RB_Val_Ws32 42949672.9500 Time_s -21474836.4800 21474836.4700 FORMAT "%13.4" /end CHARACTERISTIC
/begin CHARACTERISTIC Com_tiEAT12RingCntChkSumDly_C "Time for EAT12 with respect Ring Counter or Checksum" VALUE 0x80523DF4 RB_Val_Ws32 42949672.9500 Time_s -21474836.4800 21474836.4700 FORMAT "%13.4" /end CHARACTERISTIC
/begin CHARACTERISTIC Com_tiEAT13BusOffTOutDly_C "Timer of EAT13 with respect to bus Off and timeout Error" VALUE 0x80523DFC RB_Val_Ws32 42949672.9500 Time_s -21474836.4800 21474836.4700 FORMAT "%13.4" /end CHARACTERISTIC
/begin CHARACTERISTIC Com_tiEAT13RingCntChkSumDly_C "Time for EAT13 with respect Ring Counter or Checksum" VALUE 0x80523E00 RB_Val_Ws32 42949672.9500 Time_s -21474836.4800 21474836.4700 FORMAT "%13.4" /end CHARACTERISTIC
/begin CHARACTERISTIC Com_tiEAT4PreErr_C "Time for EAT4 frame preliminary error check" VALUE 0x80523E1A RB_Val_Ws16 327670.0 Time_ms 0.00 327670.0 FORMAT "%8.1" EXTENDED_LIMITS -327680.0 327670.0 /end CHARACTERISTIC
/begin CHARACTERISTIC Com_tiEngTrq_CUR "Time delay after enable anti-jerk torque convertor slip flag" CURVE 0x80523E56 RB_Curve_S16_U16_Static 655.3500 t_q0p01 0.00 655.3500 FORMAT "%8.4"
 /begin AXIS_DESCR STD_AXIS Com_trqEngTrq md_q0p1 8 -3276.800 3276.700 FORMAT "%8.3" DEPOSIT ABSOLUTE /end AXIS_DESCR
/end CHARACTERISTIC
/begin CHARACTERISTIC Com_tqIMGSuppReq_C "IMG Request Suppression Torque parameter" VALUE 0x80523F6C RB_Val_Ws16 65535.00 Trq_float -32768.00 32767.00 FORMAT "%8.2" /end CHARACTERISTIC
/begin CHARACTERISTIC Com_TqTMClutch_C_RP "application-switch for switching calculation of torque loss absolute (Prototype)" VALUE 0x8053A4F9 KwWU8 255.0 OneToOne 0.00 255.0 FORMAT "%5.1" /end CHARACTERISTIC
/begin CHARACTERISTIC Com_trqBoost_CUR "curve for VSA Torque Accuracy Improvement" CURVE 0x80523E78 RB_Curve_U16_U16 327.6800 TransR 0.00 327.6800 FORMAT "%8.4" EXTENDED_LIMITS 0.00 655.3500
 /begin AXIS_DESCR STD_AXIS Com_rConvSlip CrCtlSlipRat 10 0.00 327.6750 FORMAT "%8.4" DEPOSIT ABSOLUTE /end AXIS_DESCR
/end CHARACTERISTIC
/begin CHARACTERISTIC Com_vVehTcu_C "Calibration for default value of FI control used vehicle speed" VALUE 0x80523DE6 RB_Val_Wu16 255.9961 Vel_CrCtl 0.00 255.9961 FORMAT "%8.4" /end CHARACTERISTIC
/begin CHARACTERISTIC CVT_SHFT_IN_D_C "Calibration for status of position D for shifting operation." VALUE 0x80523EC4 RB_Val_Wu8 255.0 OneToOne 0.00 255.0 FORMAT "%5.1" /end CHARACTERISTIC
/begin CHARACTERISTIC CVT_SHFT_IN_L_C "Calibration for status of position L for shifting operation." VALUE 0x80523EC5 RB_Val_Wu8 255.0 OneToOne 0.00 255.0 FORMAT "%5.1" /end CHARACTERISTIC
/begin CHARACTERISTIC CVT_SHFT_IN_NEUTRAL_C "Calibration for Shift in Neutral Parking" VALUE 0x80523EC6 RB_Val_Wu8 255.0 OneToOne 0.00 255.0 FORMAT "%5.1" /end CHARACTERISTIC
/begin CHARACTERISTIC CVT_SHFT_IN_NO_C "calibration for NO shift in parking" VALUE 0x80523EC7 RB_Val_Wu8 255.0 OneToOne 0.00 255.0 FORMAT "%5.1" /end CHARACTERISTIC
/begin CHARACTERISTIC CVT_SHFT_IN_PARKING_C "Calibration for Shift in Parking" VALUE 0x80523EC8 RB_Val_Wu8 255.0 OneToOne 0.00 255.0 FORMAT "%5.1" /end CHARACTERISTIC
/begin CHARACTERISTIC CVT_SHFT_IN_REVERSE_C "Calibration for Shift in Reverse Parking" VALUE 0x80523EC9 RB_Val_Wu8 255.0 OneToOne 0.00 255.0 FORMAT "%5.1" /end CHARACTERISTIC
/begin CHARACTERISTIC CVT_SHFT_IN_S_C "Calibration for status of position S for shifting operation." VALUE 0x80523ECA RB_Val_Wu8 255.0 OneToOne 0.00 255.0 FORMAT "%5.1" /end CHARACTERISTIC
/begin CHARACTERISTIC CWFUEDK "codeword FUEDK" VALUE 0x805238BA RB_Val_Wu16 65535.00 dez 0.00 65535.00 FORMAT "%8.2" /end CHARACTERISTIC
/begin CHARACTERISTIC DKNOTBEGR "Limtation of set value as f(nmot) if B_dknot = true" CURVE 0x80523A7C RB_Curve_S16_U16_Static 99.99847 rel_uw_b100 0.00 99.99847 FORMAT "%8.5"
 /begin AXIS_DESCR STD_AXIS Epm_nEng EngN 8 -16384.00 16383.50 FORMAT "%8.2" DEPOSIT ABSOLUTE /end AXIS_DESCR
/end CHARACTERISTIC
/begin CHARACTERISTIC DRLSOLMF "threshold delta rlsol for Medianfilter" VALUE 0x80523A9E RB_Val_Wu16 49.99219 rel_uw_q0p0234 0.00 49.99219 FORMAT "%8.5" EXTENDED_LIMITS 0.00 1535.977 /end CHARACTERISTIC
/begin CHARACTERISTIC DWGVOKE "Offset: gas exch. valve intake opens 1mm -> 0.5mm for low cam stroke" VALUE 0x80523C08 RB_Val_Ws16 1023.984 kw_q0p0156 -512.0000 511.9844 FORMAT "%8.4" /end CHARACTERISTIC
/begin CHARACTERISTIC DWOGVKE "Open angle: gas exch. vlv. intake closes to intake opens low cam stroke" VALUE 0x80523C0A RB_Val_Ws16 1023.984 kw_q0p0156 -512.0000 511.9844 FORMAT "%8.4" /end CHARACTERISTIC
/begin CHARACTERISTIC FanDig0_ATS.LimitTypeMsk_C "Actuator test FanDig0_ATS / Tester demand monitoring enable mask for actuators" VALUE 0x8053A5F0 Val_Wu8 255.0 OneToOne 0.00 255.0 FORMAT "%5.1" /end CHARACTERISTIC
/begin CHARACTERISTIC FanDig0_ATS.CnvNorm_C "Actuator test FanDig0_ATS / Conversion norm used for conversion to/from internal scaling" VALUE 0x8053A5F1 Val_Wu8 255.0 OneToOne 0.00 255.0 FORMAT "%5.1" /end CHARACTERISTIC
/begin CHARACTERISTIC FanDig0_ATS.LowLim_C "Actuator test FanDig0_ATS / Lower limit for monitoring" VALUE 0x8053A5F2 Val_Ws16 65535.00 OneToOne -32768.00 32767.00 FORMAT "%8.2" /end CHARACTERISTIC
/begin CHARACTERISTIC FanDig0_ATS.UpLim_C "Actuator test FanDig0_ATS / Upper limit for monitoring" VALUE 0x8053A5F4 Val_Ws16 65535.00 OneToOne -32768.00 32767.00 FORMAT "%8.2" /end CHARACTERISTIC
/begin CHARACTERISTIC FanDig0_ATS.CnvFac_C "Actuator test FanDig0_ATS / Factor used for conversion to/from internal scaling" VALUE 0x8053A5F8 Val_Ws32 4294967295.00 OneToOne -2147483648.00 2147483647.00 FORMAT "%13.2" /end CHARACTERISTIC
/begin CHARACTERISTIC FanDig0_ATS.CnvOfs_C "Actuator test FanDig0_ATS / Offset used for conversion to/from internal scaling" VALUE 0x8053A5FC Val_Ws16 65535.00 OneToOne -32768.00 32767.00 FORMAT "%8.2" /end CHARACTERISTIC
/begin CHARACTERISTIC FanDig0_ATS.DfltVal_C "Actuator test FanDig0_ATS / Default value for standbytest" VALUE 0x8053A5FE Val_Ws16 65535.00 OneToOne -32768.00 32767.00 FORMAT "%8.2" /end CHARACTERISTIC
/begin CHARACTERISTIC FanDig1_ATS.LimitTypeMsk_C "Actuator test FanDig1_ATS / Tester demand monitoring enable mask for actuators" VALUE 0x8053A600 Val_Wu8 255.0 OneToOne 0.00 255.0 FORMAT "%5.1" /end CHARACTERISTIC
/begin CHARACTERISTIC FanDig1_ATS.CnvNorm_C "Actuator test FanDig1_ATS / Conversion norm used for conversion to/from internal scaling" VALUE 0x8053A601 Val_Wu8 255.0 OneToOne 0.00 255.0 FORMAT "%5.1" /end CHARACTERISTIC
/begin CHARACTERISTIC FanDig1_ATS.LowLim_C "Actuator test FanDig1_ATS / Lower limit for monitoring" VALUE 0x8053A602 Val_Ws16 65535.00 OneToOne -32768.00 32767.00 FORMAT "%8.2" /end CHARACTERISTIC
/begin CHARACTERISTIC FanDig1_ATS.UpLim_C "Actuator test FanDig1_ATS / Upper limit for monitoring" VALUE 0x8053A604 Val_Ws16 65535.00 OneToOne -32768.00 32767.00 FORMAT "%8.2" /end CHARACTERISTIC
/begin CHARACTERISTIC FanDig1_ATS.CnvFac_C "Actuator test FanDig1_ATS / Factor used for conversion to/from internal scaling" VALUE 0x8053A608 Val_Ws32 4294967295.00 OneToOne -2147483648.00 2147483647.00 FORMAT "%13.2" /end CHARACTERISTIC
/begin CHARACTERISTIC FanDig1_ATS.CnvOfs_C "Actuator test FanDig1_ATS / Offset used for conversion to/from internal scaling" VALUE 0x8053A60C Val_Ws16 65535.00 OneToOne -32768.00 32767.00 FORMAT "%8.2" /end CHARACTERISTIC
/begin CHARACTERISTIC FanDig1_ATS.DfltVal_C "Actuator test FanDig1_ATS / Default value for standbytest" VALUE 0x8053A60E Val_Ws16 65535.00 OneToOne -32768.00 32767.00 FORMAT "%8.2" /end CHARACTERISTIC
/begin CHARACTERISTIC Fan_DigOut0.tiBtwTstSCB_C "Structure containing parameters for Digital output power stage error handling for Fan / Time between tests for SCB error" VALUE 0x8053B0E0 Kw_Ws16 1000.000 Time_ms 0.00 1000.000 FORMAT "%8.3" EXTENDED_LIMITS -327680.0 327670.0 /end CHARACTERISTIC
/begin CHARACTERISTIC Fan_DigOut0.tiBtwTstOT_C "Structure containing parameters for Digital output power stage error handling for Fan / Time between tests for OT error" VALUE 0x8053B0E2 Kw_Ws16 100.0000 Time_s 0.00 100.0000 FORMAT "%8.4" EXTENDED_LIMITS -327.6800 327.6700 /end CHARACTERISTIC
/begin CHARACTERISTIC Fan_DigOut0.numTstMax_C "Structure containing parameters for Digital output power stage error handling for Fan / Maximum number of tests allowed on permanent defect" VALUE 0x8053B0E4 Kw_Wu16 65535.00 OneToOne 0.00 65535.00 FORMAT "%8.2" /end CHARACTERISTIC
/begin CHARACTERISTIC Fan_DigOut1.tiBtwTstSCB_C "Structure containing parameters for Digital output power stage error handling for Fan / Time between tests for SCB error" VALUE 0x8053B0E6 Kw_Ws16 1000.000 Time_ms 0.00 1000.000 FORMAT "%8.3" EXTENDED_LIMITS -327680.0 327670.0 /end CHARACTERISTIC
/begin CHARACTERISTIC Fan_DigOut1.tiBtwTstOT_C "Structure containing parameters for Digital output power stage error handling for Fan / Time between tests for OT error" VALUE 0x8053B0E8 Kw_Ws16 100.0000 Time_s 0.00 100.0000 FORMAT "%8.4" EXTENDED_LIMITS -327.6800 327.6700 /end CHARACTERISTIC
/begin CHARACTERISTIC Fan_DigOut1.numTstMax_C "Structure containing parameters for Digital output power stage error handling for Fan / Maximum number of tests allowed on permanent defect" VALUE 0x8053B0EA Kw_Wu16 65535.00 OneToOne 0.00 65535.00 FORMAT "%8.2" /end CHARACTERISTIC
/begin CHARACTERISTIC Fan_rHysHi_CA "High threshold of hysterisis to set digital fan power stage output to true" VAL_BLK 0x8053B0EC ValA_Ws16 799.9878 Prc -400.0000 399.9878 FORMAT "%8.4" NUMBER 2 /end CHARACTERISTIC
/begin CHARACTERISTIC Fan_rHysLo_CA "Low threshold of hysterisis to set digital fan power stage output to true" VAL_BLK 0x8053B0F0 ValA_Ws16 799.9878 Prc -400.0000 399.9878 FORMAT "%8.4" NUMBER 2 /end CHARACTERISTIC
/begin CHARACTERISTIC Fan_stPsDiaDisblDIO_CA "aplication array for disabling the digital fan compressor powerstage diagnosis" VAL_BLK 0x8053B0F4 ValA_Wu16 65535.00 OneToOne 0.00 65535.00 FORMAT "%8.2" NUMBER 2 /end CHARACTERISTIC
/begin CHARACTERISTIC Fan_stPsDisDIO_CA "aplication array for disabling the digital fan compressor powerstage" VAL_BLK 0x8053B0F8 ValA_Wu16 65535.00 OneToOne 0.00 65535.00 FORMAT "%8.2" NUMBER 2 /end CHARACTERISTIC
/begin CHARACTERISTIC FKLAFUGD "Output of KLAF in event of PSPVDKUG" VALUE 0x805238BC RB_Val_Wu16 1.000000 fak_q3p0518Em5 0.00 1.000000 FORMAT "%8.6" EXTENDED_LIMITS 0.00 1.999969 READ_ONLY /end CHARACTERISTIC
/begin CHARACTERISTIC FMFKRZN "filter selection knock control" MAP 0x80523C42 RB_Map_U8U8_S16 4096.000 dez 0.00 4096.000 FORMAT "%8.3" EXTENDED_LIMITS -32768.00 32767.00
 /begin AXIS_DESCR STD_AXIS stkrfmf_tmp dez 5 0.00 255.0 FORMAT "%5.1" DEPOSIT ABSOLUTE /end AXIS_DESCR
 /begin AXIS_DESCR STD_AXIS NO_INPUT_QUANTITY dez 8 0.00 255.0 FORMAT "%5.1" DEPOSIT ABSOLUTE /end AXIS_DESCR
/end CHARACTERISTIC
/begin CHARACTERISTIC FPWDKAPP "throttle angle dependent on accelerator pedal position, only for calibration" CURVE 0x805238BE RB_Curve_S16_U16_Static 99.99847 rel_uw_b100 0.00 99.99847 FORMAT "%8.5"
 /begin AXIS_DESCR STD_AXIS APP_r Prc 8 -400.0000 399.9878 FORMAT "%8.4" DEPOSIT ABSOLUTE /end AXIS_DESCR
/end CHARACTERISTIC
/begin CHARACTERISTIC GbxPNPos_stPNSwtInv_C "Invert Calibration to chose between the debounced ST pin status." VALUE 0x80523F20 RB_Val_Wboolean 1.00000000000 B_TRUE 0.00 1.00000000000 FORMAT "%13.11" /end CHARACTERISTIC
/begin CHARACTERISTIC GbxPNPos_tiDebHiLo_C "High to Low debouncing time for PN Position raw signal" VALUE 0x80523F22 RB_Val_Ws16 655.3500 Time_s -327.6800 327.6700 FORMAT "%8.4" /end CHARACTERISTIC
/begin CHARACTERISTIC GbxPNPos_tiDebLoHi_C "Low to High debouncing time for PN Position raw signal" VALUE 0x80523F24 RB_Val_Ws16 655.3500 Time_s -327.6800 327.6700 FORMAT "%8.4" /end CHARACTERISTIC
/begin CHARACTERISTIC Gbx_cntrNeutPosnCANPlausErr_C "Maximum threshold Counter for the no.of times the plausibility error happened" VALUE 0x80523ECE RB_Val_Wu16 65535.00 OneToOne 0.00 65535.00 FORMAT "%8.2" /end CHARACTERISTIC
/begin CHARACTERISTIC GBX_CONVCLTH_CLSDC_RP "Application Value of Status of the Gearbox converter clutch for closed clutch (PROTOTYPE)" VALUE 0x8053A4FA KwWU8 255.0 OneToOne 0.00 255.0 FORMAT "%5.1" /end CHARACTERISTIC
/begin CHARACTERISTIC GBX_CONVCLTH_CTL_C_RP "Application Value of Status of the Gearbox converter clutch for clutch in motion(PROTOTYPE)" VALUE 0x8053A4FB KwWU8 255.0 OneToOne 0.00 255.0 FORMAT "%5.1" /end CHARACTERISTIC
/begin CHARACTERISTIC GBX_CONVCLTH_ERROR_C_RP "Application Value of Status of the Gearbox converter clutch for error clutch-state (PROTOTYPE)" VALUE 0x8053A4FC KwWU8 255.0 OneToOne 0.00 255.0 FORMAT "%5.1" /end CHARACTERISTIC
/begin CHARACTERISTIC GBX_CONVCLTH_OPN_C_RP "Application Value of Status of the Gearbox converter clutch for open clutch (PROTOTYPE)" VALUE 0x8053A4FD KwWU8 255.0 OneToOne 0.00 255.0 FORMAT "%5.1" /end CHARACTERISTIC
/begin CHARACTERISTIC Gbx_facCorrlnAnaNPos_C "Factor for the correlation of neutral position analog sensor 1" VALUE 0x80523ED0 RB_Val_Ws16 7.999878 Fact -4.000000 3.999878 FORMAT "%8.6" /end CHARACTERISTIC
/begin CHARACTERISTIC Gbx_lDiffDst_C "Threshold of distance after detection of reverse switch ON stuck error" VALUE 0x80523F34 RB_Val_Wu16 3276.700 LengthKm_q0p1 0.00 3276.700 FORMAT "%8.3" EXTENDED_LIMITS 0.00 6553.500 /end CHARACTERISTIC
/begin CHARACTERISTIC Gbx_nIdlDesTrsmFail_C "Calibration for transmission fail safe value of synchronized desired engine speed" VALUE 0x80523E36 RB_Val_Ws16 32767.50 EngN -16384.00 16383.50 FORMAT "%8.2" /end CHARACTERISTIC
/begin CHARACTERISTIC Gbx_nIdlDes_FailSafeA_C "Fail Safe A calibration value assigned to Gbx_nIdlDes when error is in DEBOUNCING state" VALUE 0x80523E38 RB_Val_Ws16 32767.50 EngN -16384.00 16383.50 FORMAT "%8.2" /end CHARACTERISTIC
/begin CHARACTERISTIC Gbx_nIdlDes_FailSafeB_C "Fail Safe B calibration value assigned to Gbx_nIdlDes when error is in DEBOUNCING state" VALUE 0x80523E3A RB_Val_Ws16 32767.50 EngN -16384.00 16383.50 FORMAT "%8.2" /end CHARACTERISTIC
/begin CHARACTERISTIC Gbx_nMaxEngFcoTrsmFail_C "Calibration for transmission fail safe value of maximum engine speed limitation request (FuelCut Control)" VALUE 0x80523E3C RB_Val_Ws16 32767.50 EngN -16384.00 16383.50 FORMAT "%8.2" /end CHARACTERISTIC
/begin CHARACTERISTIC Gbx_nMaxEngFco_FailSafeA_C "Fail Safe A calibration value assigned to Gbx_nMaxEngFco when error is in DEBOUNCING state" VALUE 0x80523E3E RB_Val_Ws16 32767.50 EngN -16384.00 16383.50 FORMAT "%8.2" /end CHARACTERISTIC
/begin CHARACTERISTIC Gbx_nMaxEngFco_FailSafeB_C "Fail Safe B calibration value assigned to Gbx_nMaxEngFco when error is in DEBOUNCING state" VALUE 0x80523E40 RB_Val_Ws16 32767.50 EngN -16384.00 16383.50 FORMAT "%8.2" /end CHARACTERISTIC
/begin CHARACTERISTIC Gbx_nMaxEngTrqLimTrsmFail_C "Calibration for transmission fail safe value of maximum engine speed limitation request (Torque Control)" VALUE 0x80523E42 RB_Val_Ws16 32767.50 EngN -16384.00 16383.50 FORMAT "%8.2" /end CHARACTERISTIC
/begin CHARACTERISTIC Gbx_nMaxEngTrqLim_FailSafeA_C "Fail Safe A calibration value assigned to Gbx_nMaxEngTrqLim when error is in DEBOUNCING state" VALUE 0x80523E44 RB_Val_Ws16 32767.50 EngN -16384.00 16383.50 FORMAT "%8.2" /end CHARACTERISTIC
/begin CHARACTERISTIC Gbx_nMaxEngTrqLim_FailSafeB_C "Fail Safe B calibration value assigned to Gbx_nMaxEngTrqLim when error is in DEBOUNCING state" VALUE 0x80523E46 RB_Val_Ws16 32767.50 EngN -16384.00 16383.50 FORMAT "%8.2" /end CHARACTERISTIC
/begin CHARACTERISTIC Gbx_nPNPosnDiagDrvCdnThd_C "Engine speed threshold for Park Neutral Switch diagnosis in vehicle drive condition" VALUE 0x80523F26 RB_Val_Ws16 32767.50 EngN -16384.00 16383.50 FORMAT "%8.2" /end CHARACTERISTIC
/begin CHARACTERISTIC Gbx_nPNPosnDiagPlausyThd_C "Engine speed threshold for Park Neutral Switch plausibility diagnosis" VALUE 0x80523F28 RB_Val_Ws16 32767.50 EngN -16384.00 16383.50 FORMAT "%8.2" /end CHARACTERISTIC
/begin CHARACTERISTIC Gbx_numMaxNPosAlv_C "Counter threshold for alive check" VALUE 0x80523ED2 RB_Val_Wu8 255.0 OneToOne 0.00 255.0 FORMAT "%5.1" /end CHARACTERISTIC
/begin CHARACTERISTIC Gbx_rPNPosnDiagAccPedlThd_C "Accelerator Pedal Position threshold for Park Neutral Switch diagnosis in vehicle drive condition" VALUE 0x80523F2A RB_Val_Ws16 799.9878 Prc -400.0000 399.9878 FORMAT "%8.4" /end CHARACTERISTIC
/begin CHARACTERISTIC Gbx_RvsPosDeb.tiHiLo_C "Debouncing Parameters structure for Gearbox reverse position switch / Time for a High to Low transition" VALUE 0x8053B0FC Kw_Ws16 655350.0 TimeDeb -327680.0 327670.0 FORMAT "%8.1" /end CHARACTERISTIC
/begin CHARACTERISTIC Gbx_RvsPosDeb.tiLoHi_C "Debouncing Parameters structure for Gearbox reverse position switch / Time for a Low to High transition" VALUE 0x8053B0FE Kw_Ws16 655350.0 TimeDeb -327680.0 327670.0 FORMAT "%8.1" /end CHARACTERISTIC
/begin CHARACTERISTIC Gbx_stNeut_C "Calibratable parameter- Neutral inserted" VALUE 0x80523ED3 RB_Val_Wu8 255.0 OneToOne 0.00 255.0 FORMAT "%5.1" /end CHARACTERISTIC
/begin CHARACTERISTIC Gbx_stNotNeut_C "Calibratable parameter- Neutral not inserted" VALUE 0x80523ED4 RB_Val_Wu8 255.0 OneToOne 0.00 255.0 FORMAT "%5.1" /end CHARACTERISTIC
/begin CHARACTERISTIC Gbx_stSwtCfgNeutPosn_C "Neutral position configuration switch status" VALUE 0x80523ED5 RB_Val_Wu8 255.0 OneToOne 0.00 255.0 FORMAT "%5.1" /end CHARACTERISTIC
/begin CHARACTERISTIC Gbx_swtRvsPosPrs_C "Gearbox Reverse Position selection switch" VALUE 0x80523F36 RB_Val_Wu8 1.000 OneToOne 0.00 1.000 FORMAT "%5.3" EXTENDED_LIMITS 0.00 255.0 /end CHARACTERISTIC
/begin CHARACTERISTIC Gbx_swtRvsSwtStkEna_C "Selection switch for reverse switch ON stuck error" VALUE 0x80523F37 RB_Val_Wu8 1.000 OneToOne 0.00 1.000 FORMAT "%5.3" EXTENDED_LIMITS 0.00 255.0 /end CHARACTERISTIC
/begin CHARACTERISTIC Gbx_swtSigInpLogic_C "Calibration to select the inversion logic for digital input" VALUE 0x80523ED6 RB_Val_Wu8 255.0 OneToOne 0.00 255.0 FORMAT "%5.1" /end CHARACTERISTIC
/begin CHARACTERISTIC Gbx_swtSigNeutPosn_C "Switch to select either from CAN input, Digital and CAN input OR Analog inputs." VALUE 0x80523ED7 RB_Val_Wu8 255.0 OneToOne 0.00 255.0 FORMAT "%5.1" /end CHARACTERISTIC
/begin CHARACTERISTIC Gbx_tiDigNeutPosnOffDeb_C "High to Low debounce parameter for digital input signal" VALUE 0x80523ED8 RB_Val_Wu16 655350.0 TimeDeb 0.00 655350.0 FORMAT "%8.1" /end CHARACTERISTIC
/begin CHARACTERISTIC Gbx_tiDigNeutPosnOnDeb_C "Low to High debounce parameter for digital input signal" VALUE 0x80523EDA RB_Val_Wu16 655350.0 TimeDeb 0.00 655350.0 FORMAT "%8.1" /end CHARACTERISTIC
/begin CHARACTERISTIC Gbx_tiNeutInsertedDly_C "Time after which CAN signal is checked if it matches with digital signal which already shows neutral inserted" VALUE 0x80523EDC RB_Val_Wu16 655.3500 Time_s 0.00 655.3500 FORMAT "%8.4" /end CHARACTERISTIC
/begin CHARACTERISTIC Gbx_tiNeutNotInsertedDly_C "Time after which CAN signal is checked if it matches with digital signal which already shows neutral not inserted" VALUE 0x80523EDE RB_Val_Wu16 655.3500 Time_s 0.00 655.3500 FORMAT "%8.4" /end CHARACTERISTIC
/begin CHARACTERISTIC Gbx_tiNeutPosnDebHiLo_C "High to Low debounce for analog sensor if it is within upper and lower thresholds" VALUE 0x80523EE0 RB_Val_Wu16 655350.0 TimeDeb 0.00 655350.0 FORMAT "%8.1" /end CHARACTERISTIC
/begin CHARACTERISTIC Gbx_tiNeutPosnDebLoHi_C "Low to High debounce for analog sensor if it is within upper and lower thresholds" VALUE 0x80523EE2 RB_Val_Wu16 655350.0 TimeDeb 0.00 655350.0 FORMAT "%8.1" /end CHARACTERISTIC
/begin CHARACTERISTIC Gbx_tiRvsSwtStk_C "Delay time for detection of normal behaviour of reverse switch" VALUE 0x80523F38 RB_Val_Ws16 327670.0 Time_ms 0.00 327670.0 FORMAT "%8.1" EXTENDED_LIMITS -327680.0 327670.0 /end CHARACTERISTIC
/begin CHARACTERISTIC Gbx_trqOilPmpLos_C "Default Calibration for Gbx_trqOilPmplos_C" VALUE 0x80523E1C RB_Val_Ws16 6553.500 Trq -3276.800 3276.700 FORMAT "%8.3" /end CHARACTERISTIC
/begin CHARACTERISTIC Gbx_trqPNPosnDiagTqThd_C "Engine torque threshold for Park Neutral Switch diagnosis in vehicle drive condition" VALUE 0x80523F2C RB_Val_Ws16 6553.500 Trq -3276.800 3276.700 FORMAT "%8.3" /end CHARACTERISTIC
/begin CHARACTERISTIC Gbx_trqTSCIntvSlowTrsmFail_C "Fail safe calibration vlaue for Gbx_trqTSCIntvSlow" VALUE 0x80523E1E RB_Val_Ws16 6553.500 Trq -3276.800 3276.700 FORMAT "%8.3" /end CHARACTERISTIC
/begin CHARACTERISTIC Gbx_trqTSCIntvSlow_FailSafeA_C "FailSafeA calibration for Engine torque amount (by Air) when error is in DEBOUNCING state" VALUE 0x80523E20 RB_Val_Ws16 6553.500 Trq -3276.800 3276.700 FORMAT "%8.3" /end CHARACTERISTIC
/begin CHARACTERISTIC Gbx_trqTSCIntvSlow_FailSafeB_C "FailSafeB calibration for Engine torque amount (by Air) when error is in DEBOUNCED state" VALUE 0x80523E22 RB_Val_Ws16 6553.500 Trq -3276.800 3276.700 FORMAT "%8.3" /end CHARACTERISTIC
/begin CHARACTERISTIC Gbx_uAn1NeutPosnRawTmp_C "Init value for Analog voltage raw value from sensor1" VALUE 0x80523EE4 RB_Val_Ws16 13107.00 Volt -6553.600 6553.400 FORMAT "%8.3" /end CHARACTERISTIC
/begin CHARACTERISTIC Gbx_uAn1SRCMax_C "Analog sensor1 max SRC threshold" VALUE 0x80523EE6 RB_Val_Ws16 13107.00 Volt -6553.600 6553.400 FORMAT "%8.3" /end CHARACTERISTIC
/begin CHARACTERISTIC Gbx_uAn1SRCMin_C "Analog sensor1 min SRC threshold" VALUE 0x80523EE8 RB_Val_Ws16 13107.00 Volt -6553.600 6553.400 FORMAT "%8.3" /end CHARACTERISTIC
/begin CHARACTERISTIC Gbx_uAn2SRCMax_C "Analog sensor2 max SRC threshold" VALUE 0x80523EEA RB_Val_Ws16 13107.00 Volt -6553.600 6553.400 FORMAT "%8.3" /end CHARACTERISTIC
/begin CHARACTERISTIC Gbx_uAn2SRCMin_C "Analog sensor2 max SRC threshold" VALUE 0x80523EEC RB_Val_Ws16 13107.00 Volt -6553.600 6553.400 FORMAT "%8.3" /end CHARACTERISTIC
/begin CHARACTERISTIC Gbx_uCorrlnMaxDiffAnSnsr_CUR "Maximum allowed difference of analog sensors 1 and 2" CURVE 0x80523EEE RB_Curve_S16_S16 13107.00 Volt -6553.600 6553.400 FORMAT "%8.3"
 /begin AXIS_DESCR STD_AXIS Gbx_uAna1NPosRaw Volt 11 -6553.600 6553.400 FORMAT "%8.3" DEPOSIT ABSOLUTE /end AXIS_DESCR
/end CHARACTERISTIC
/begin CHARACTERISTIC Gbx_uNeutPosnRngHi_C "Analog sensor higher threshold range" VALUE 0x80523F1C RB_Val_Ws16 13107.00 Volt -6553.600 6553.400 FORMAT "%8.3" /end CHARACTERISTIC
/begin CHARACTERISTIC Gbx_uNeutPosnRngLo_C "Analog sensor lower threshold range" VALUE 0x80523F1E RB_Val_Ws16 13107.00 Volt -6553.600 6553.400 FORMAT "%8.3" /end CHARACTERISTIC
/begin CHARACTERISTIC Gbx_uPNPosnDiagThdHi_C "Battery upper threshold for all Park Neutral Switch diagnosis" VALUE 0x80523F2E RB_Val_Ws16 1310700. Volt_Batt -655360.0 655340.0 FORMAT "%8.1" /end CHARACTERISTIC
/begin CHARACTERISTIC Gbx_uPNPosnDiagThdLo_C "Battery lower threshold for all Park Neutral Switch diagnosis" VALUE 0x80523F30 RB_Val_Ws16 1310700. Volt_Batt -655360.0 655340.0 FORMAT "%8.1" /end CHARACTERISTIC
/begin CHARACTERISTIC Gbx_uRvsSwtStk_C "Battery voltage threshold for reverse switch ON stuck error" VALUE 0x80523F3A RB_Val_Ws16 655340.0 Volt_Batt 0.00 655340.0 FORMAT "%8.1" EXTENDED_LIMITS -655360.0 655340.0 /end CHARACTERISTIC
/begin CHARACTERISTIC Gbx_vPNPosnDiagVThd_C "Vehicle speed threshold for Park Neutral Switch diagnosis in vehicle drive condition" VALUE 0x80523F32 RB_Val_Ws16 655.3500 Vel -327.6800 327.6700 FORMAT "%8.4" /end CHARACTERISTIC
/begin CHARACTERISTIC GEVCtl_agClsdOutl_C "Angle outlet valve closes at 0.5mm lift" VALUE 0x80523C30 RB_Val_Ws16 1023.984 kw_q0p0156 -512.0000 511.9844 FORMAT "%8.4" /end CHARACTERISTIC
/begin CHARACTERISTIC GEVCtl_agClsdSpclLftOutl_C "Angle outlet valve closes at 0.5mm lift for special cam profile" VALUE 0x80523C32 RB_Val_Ws16 1023.984 kw_q0p0156 -512.0000 511.9844 FORMAT "%8.4" /end CHARACTERISTIC
/begin CHARACTERISTIC GEVCtl_agOffsVlvOpenIntk_C "Offset of the angle system to the intake valve opening point (0.5mm lift)" VALUE 0x80523C34 RB_Val_Ws16 1023.984 kw_q0p0156 -512.0000 511.9844 FORMAT "%8.4" /end CHARACTERISTIC
/begin CHARACTERISTIC GEVCtl_agOffsVlvOpenSpclLftIntk_C "Offset of the angle system to the intake valve opening point (0.5mm lift) for the special cam profile" VALUE 0x80523C36 RB_Val_Ws16 1023.984 kw_q0p0156 -512.0000 511.9844 FORMAT "%8.4" /end CHARACTERISTIC
/begin CHARACTERISTIC GEVCtl_agOpenIntk_C "Angle intake valve opens at 0.5mm lift" VALUE 0x80523C38 RB_Val_Ws16 1023.984 kw_q0p0156 -512.0000 511.9844 FORMAT "%8.4" /end CHARACTERISTIC
/begin CHARACTERISTIC GEVCtl_agOpenSpclLftIntk_C "Angle intake valve opens at 0.5mm lift for special cam profile" VALUE 0x80523C3A RB_Val_Ws16 1023.984 kw_q0p0156 -512.0000 511.9844 FORMAT "%8.4" /end CHARACTERISTIC
/begin CHARACTERISTIC GEVCtl_agWidthCamProfIntk_C "Width of the intake valve cam profile referred to 0.5mm lift" VALUE 0x80523C3C RB_Val_Ws16 1023.984 kw_q0p0156 -512.0000 511.9844 FORMAT "%8.4" /end CHARACTERISTIC
/begin CHARACTERISTIC GEVCtl_agWidthCamProfOutl_C "Width of the outlet valve cam profile referred to 0.5mm lift" VALUE 0x80523C3E RB_Val_Ws16 1023.984 kw_q0p0156 -512.0000 511.9844 FORMAT "%8.4" /end CHARACTERISTIC
/begin CHARACTERISTIC GEVCtl_agWidthCamProfSpclLftIntk_C "Width of the intake valve cam profile (special cam profile) referred to 0.5mm lift" VALUE 0x80523C40 RB_Val_Ws16 1023.984 kw_q0p0156 -512.0000 511.9844 FORMAT "%8.4" /end CHARACTERISTIC
/begin CHARACTERISTIC GEVCtl_cntrDlyChrgDetrmIntkNegDif_C "Number of segments for shifting the trigger when the valve lift is switched for negative expected charge difference" VALUE 0x80523C12 RB_Val_Ws8 255.0 OneToOne -128.0 127.0 FORMAT "%5.1" /end CHARACTERISTIC
/begin CHARACTERISTIC GEVCtl_cntrDlyChrgDetrmIntkPosDif_C "Number of segments for shifting the trigger when the valve lift is switched for positive expected charge difference." VALUE 0x80523C13 RB_Val_Ws8 255.0 OneToOne -128.0 127.0 FORMAT "%5.1" /end CHARACTERISTIC
/begin CHARACTERISTIC GEVCtl_nEngMaxVlvLftEnaHys_C "Hysteresis for the engine speed threshold for cam profile switching" VALUE 0x80523C16 RB_Val_Wu8 10200. EngN_LRes 0.00 10200. FORMAT "%5.0" /end CHARACTERISTIC
/begin CHARACTERISTIC GEVCtl_nEngMaxVlvLftEna_C "Maximum permitted engine speed for cam profile switching" VALUE 0x80523C17 RB_Val_Wu8 10200. EngN_LRes 0.00 10200. FORMAT "%5.0" /end CHARACTERISTIC
/begin CHARACTERISTIC GEVCtl_pOilMinVlvLftEnaHigh_C "Treshols for enable valve lift depends on oil pressure (high lift)" VALUE 0x80523C18 RB_Val_Ws16 3276.700 Pres 0.00 3276.700 FORMAT "%8.3" EXTENDED_LIMITS -3276.800 3276.700 /end CHARACTERISTIC
/begin CHARACTERISTIC GEVCtl_pOilMinVlvLftEnaLow_C "Treshols for enable valve lift depends on oil pressure (high lift)" VALUE 0x80523C1A RB_Val_Ws16 3276.700 Pres 0.00 3276.700 FORMAT "%8.3" EXTENDED_LIMITS -3276.800 3276.700 /end CHARACTERISTIC
/begin CHARACTERISTIC GEVCtl_ratLoadDeltaVlvLftIntkThd_C "Threshold under which a charge change after valve lift switching is considered a negative charge change." VALUE 0x80523C14 RB_Val_Ws16 1535.977 rel_q0p02344 -768.0000 767.9766 FORMAT "%8.4" /end CHARACTERISTIC
/begin CHARACTERISTIC GEVCtl_stOperModSim_C "Codeword for simulation of operating mode" VALUE 0x80523C10 RB_Val_Wu8 255.0 OneToOne 0.00 255.0 FORMAT "%5.1" /end CHARACTERISTIC
/begin CHARACTERISTIC GEVCtl_stVlvLftEna_C "Codeword for the configuration of cam profile switching" VALUE 0x80523C1C RB_Val_Wu8 255.0 dez 0.00 255.0 FORMAT "%5.1" /end CHARACTERISTIC
/begin CHARACTERISTIC GEVCtl_tEngMaxVlvLftEna_C "Maximum permitted engine temperature for the release of cam profile switching" VALUE 0x80523C1E RB_Val_Ws16 6553.500 Temp_Cels -3549.940 3003.560 FORMAT "%8.3" /end CHARACTERISTIC
/begin CHARACTERISTIC GEVCtl_tEngMinVlvLftEna_C "Minimum permitted engine temperature for the release of cam profile switching" VALUE 0x80523C20 RB_Val_Ws16 6553.500 Temp_Cels -3549.940 3003.560 FORMAT "%8.3" /end CHARACTERISTIC
/begin CHARACTERISTIC GEVCtl_tiDlyNormStrtVlvLftEna_C "Delay time after normal engine start to release cam profile switching so that oil pressure is stabalised" VALUE 0x80523C22 RB_Val_Wu16 1310.700 t_q0p02 0.00 1310.700 FORMAT "%8.3" /end CHARACTERISTIC
/begin CHARACTERISTIC GEVCtl_tOilMaxVlvLftEna_C "Maximum permitted oil temperature for the release of cam profile switching" VALUE 0x80523C24 RB_Val_Ws16 6553.500 Temp_Cels -3549.940 3003.560 FORMAT "%8.3" /end CHARACTERISTIC
/begin CHARACTERISTIC GEVCtl_tOilMinVlvLftEna_C "Minimum permitted oil temperature for the release of cam profile switching" VALUE 0x80523C26 RB_Val_Ws16 6553.500 Temp_Cels -3549.940 3003.560 FORMAT "%8.3" /end CHARACTERISTIC
/begin CHARACTERISTIC GEVCtl_tOilSwmpMaxVlvLftEna_C "Maximum temperature in Oil swamp to release the cam profile switching." VALUE 0x80523C28 RB_Val_Ws16 6553.500 Temp_Cels -3549.940 3003.560 FORMAT "%8.3" /end CHARACTERISTIC
/begin CHARACTERISTIC GEVCtl_tOilSwmpMinVlvLftEna_C "Minimum temperature in Oil swamp to release the cam profile switching." VALUE 0x80523C2A RB_Val_Ws16 6553.500 Temp_Cels -3549.940 3003.560 FORMAT "%8.3" /end CHARACTERISTIC
/begin CHARACTERISTIC GEVCtl_uBattMaxVlvLftEna_C "Maximum permissible battery voltage for cam profile switching" VALUE 0x80523C2C RB_Val_Ws16 1310700. Volt_Batt -655360.0 655340.0 FORMAT "%8.1" /end CHARACTERISTIC
/begin CHARACTERISTIC GEVCtl_uBattMinVlvLftEna_C "Minimum permissible battery voltage for cam profile switching" VALUE 0x80523C2E RB_Val_Ws16 1310700. Volt_Batt -655360.0 655340.0 FORMAT "%8.1" /end CHARACTERISTIC
/begin CHARACTERISTIC GlbDa_aX_C "parameter for vehicle longitudinal acceleration" VALUE 0x80523F44 RB_Val_Ws16 65.53500 Acc -32.76800 32.76700 FORMAT "%8.5" /end CHARACTERISTIC
/begin CHARACTERISTIC GlbDa_dlyTiDrvgCycCntr_C "Turn on delay that will allow the global driving cycle counter to stabilize before incrementing the counter" VALUE 0x80523F3C RB_Val_Ws32 4294.96729500 Time_Dt -2147.48364800 2147.48364700 FORMAT "%13.8" /end CHARACTERISTIC
/begin CHARACTERISTIC GlbDa_lDstLim_C "travelled distance, after which value will be written into EEPROM" VALUE 0x80523F40 RB_Val_Ws32 2147473647.00 Length 10000.00 2147483647.00 FORMAT "%13.2" EXTENDED_LIMITS -2147483648.00 2147483647.00 /end CHARACTERISTIC
/begin CHARACTERISTIC GlbDa_lWhlCirc_C "parameter for wheel circumference" VALUE 0x80523F46 RB_Val_Ws16 65.53500 Length_fine -32.76800 32.76700 FORMAT "%8.5" /end CHARACTERISTIC
/begin CHARACTERISTIC GlbDa_pEnv_C "parameter for environment pressure" VALUE 0x80523F48 RB_Val_Ws16 65535.00 Pres_hPa -32768.00 32767.00 FORMAT "%8.2" /end CHARACTERISTIC
/begin CHARACTERISTIC GlbDa_rTrqDfl_C "Default value for total ratio of the power train" VALUE 0x80523F4A RB_Val_Ws16 655.3500 TransR -327.6800 327.6700 FORMAT "%8.4" /end CHARACTERISTIC
/begin CHARACTERISTIC GlbDa_tEnv_C "parameter for environment temperature" VALUE 0x80523F4C RB_Val_Ws16 6553.500 Temp_Cels -3549.940 3003.560 FORMAT "%8.3" /end CHARACTERISTIC
/begin CHARACTERISTIC GlbDa_tiFltAX_C "Filter time constant for longitudinal vehicle acceleration" VALUE 0x80523F50 RB_Val_Ws32 4294.9672940000000 TimeDelay_s 0.0000020000000 4294.9672959999998 FORMAT "%19.14" EXTENDED_LIMITS 0.000002000000001 4294.9672959999998 /end CHARACTERISTIC
/begin CHARACTERISTIC GlbDa_tiFltVX_C "Filter time constant for the vehicle longitudinal speed" VALUE 0x80523F54 RB_Val_Ws32 4294.9672940000000 TimeDelay_s 0.0000020000000 4294.9672959999998 FORMAT "%19.14" EXTENDED_LIMITS 0.000002000000001 4294.9672959999998 /end CHARACTERISTIC
/begin CHARACTERISTIC GlbDa_tIndAir_C "parameter for induction air temperature" VALUE 0x80523F58 RB_Val_Ws16 6553.500 Temp_Cels -3549.940 3003.560 FORMAT "%8.3" /end CHARACTERISTIC
/begin CHARACTERISTIC GlbDa_tiWhlSpdFlt_C "PT1 delay parameter for wheel speed over CAN" VALUE 0x80523F5C RB_Val_Ws32 4294967.3 TimeDelay_ms 0.0 4294967.3 FORMAT "%12.1" /end CHARACTERISTIC
/begin CHARACTERISTIC GlbDa_vWhlSpdMin_C "Minimum speed threshold for filtered wheel speed." VALUE 0x80523F60 RB_Val_Ws16 655.3500 Vel -327.6800 327.6700 FORMAT "%8.4" /end CHARACTERISTIC
/begin CHARACTERISTIC GlbDa_vX_C "parameter for vehicle longitudinal velocity" VALUE 0x80523F62 RB_Val_Ws16 655.3500 Vel -327.6800 327.6700 FORMAT "%8.4" /end CHARACTERISTIC
/begin CHARACTERISTIC IKCtl_agOffsNInltAirTempKnkMeasWin_M "Offset angle map for start of knock measurement window based on inlet air temperature and engine speed" MAP 0x80523CA2 RB_Map_S16U8_S8 191.3 kw_q0p75 -96.00 95.25 FORMAT "%5.2"
 /begin AXIS_DESCR STD_AXIS Epm_nEng EngN 6 -16384.00 16383.50 FORMAT "%8.2" DEPOSIT ABSOLUTE /end AXIS_DESCR
 /begin AXIS_DESCR STD_AXIS tans_msg temp_ub_q0p75_o48 5 -48.0 143.3 FORMAT "%5.1" DEPOSIT ABSOLUTE /end AXIS_DESCR
/end CHARACTERISTIC
/begin CHARACTERISTIC IKCtl_facDgnsSnsr "knock control: engine speed threshold anbale short circuit diagnosis" VALUE 0x80523CD6 RB_Val_Ws16 32767.50 EngN -16384.00 16383.50 FORMAT "%8.2" /end CHARACTERISTIC
/begin CHARACTERISTIC IKCtl_facFilSwt1 "revolution threshold for filter mean frequency area 1" VALUE 0x80523CD8 RB_Val_Ws16 32767.50 EngN -16384.00 16383.50 FORMAT "%8.2" /end CHARACTERISTIC
/begin CHARACTERISTIC IKCtl_facFilSwt2 "revolution threshold for filter mean frequency area 2" VALUE 0x80523CDA RB_Val_Ws16 32767.50 EngN -16384.00 16383.50 FORMAT "%8.2" /end CHARACTERISTIC
/begin CHARACTERISTIC IKCtl_facFilSwt3 "revolution threshold for filter mean frequency area 3" VALUE 0x80523CDC RB_Val_Ws16 32767.50 EngN -16384.00 16383.50 FORMAT "%8.2" /end CHARACTERISTIC
/begin CHARACTERISTIC IKCtl_facFilSwt4 "revolution threshold for filter mean frequency area 4" VALUE 0x80523CDE RB_Val_Ws16 32767.50 EngN -16384.00 16383.50 FORMAT "%8.2" /end CHARACTERISTIC
/begin CHARACTERISTIC IKCtl_facMeasWinBgnHiRtdtIgn_GM "measuring window begin map at high retard ignition" MAP 0x80523CE0 RB_MapGroup_S8 39.75 kw_q0p75 0.75 40.50 FORMAT "%5.2" EXTENDED_LIMITS -96.00 95.25
 /begin AXIS_DESCR COM_AXIS Epm_nEng EngN 13 -16384.00 16383.50 FORMAT "%8.2" AXIS_PTS_REF IKCtl_nEngVar13_X_AX /end AXIS_DESCR
 /begin AXIS_DESCR COM_AXIS AirMod_ratChrgAirCyl rel_uw_q0p0234 8 0.00 1535.977 FORMAT "%8.3" AXIS_PTS_REF IKCtl_Load08_X_AX /end AXIS_DESCR
/end CHARACTERISTIC
/begin CHARACTERISTIC IKCtl_facMeasWinBgnLoRtdtIgn_GM "measuring window begin map at low retard ignition" MAP 0x80523D48 RB_MapGroup_S8 39.75 kw_q0p75 0.75 40.50 FORMAT "%5.2" EXTENDED_LIMITS -96.00 95.25
 /begin AXIS_DESCR COM_AXIS Epm_nEng EngN 13 -16384.00 16383.50 FORMAT "%8.2" AXIS_PTS_REF IKCtl_nEngVar13_X_AX /end AXIS_DESCR
 /begin AXIS_DESCR COM_AXIS AirMod_ratChrgAirCyl rel_uw_q0p0234 8 0.00 1535.977 FORMAT "%8.3" AXIS_PTS_REF IKCtl_Load08_X_AX /end AXIS_DESCR
/end CHARACTERISTIC
/begin CHARACTERISTIC IKCtl_facMeasWinBgnMax_T "characteristic curve for high ignition retardation for the knock measurement window interpolation" CURVE 0x80523DB0 RB_Curve_S16_S8_Static 96.00 kw_q0p75 -96.00 0.00 FORMAT "%5.2" EXTENDED_LIMITS -96.00 95.25
 /begin AXIS_DESCR STD_AXIS Epm_nEng EngN 4 -16384.00 16383.50 FORMAT "%8.2" DEPOSIT ABSOLUTE /end AXIS_DESCR
/end CHARACTERISTIC
/begin CHARACTERISTIC IKCtl_facMeasWinLngth_GT "length of the sampling window for knock control" CURVE 0x80523DBE RB_CurveGroup_S8 60.00 zw_sb_q0p75 9.75 69.75 FORMAT "%5.2" EXTENDED_LIMITS -96.00 95.25
 /begin AXIS_DESCR COM_AXIS Epm_nEng EngN 13 -16384.00 16383.50 FORMAT "%8.2" AXIS_PTS_REF IKCtl_nEngVar13_X_AX /end AXIS_DESCR
/end CHARACTERISTIC
/begin CHARACTERISTIC IKCtl_idxAsgnSnsr_CA "knock sensors for sw-cylinder counter 0-7" VAL_BLK 0x80523DCB RB_ValA_Wu8 3.000 dezsub1 1.000 4.000 FORMAT "%5.3" EXTENDED_LIMITS 1.000 256.0 NUMBER 4 /end CHARACTERISTIC
/begin AXIS_PTS IKCtl_Load08_X_AX "datapoint distribution relative charge, 8 datapoints" 0x8052513A AirMod_ratChrgAirCyl RB_Axis_U16 1535.977 rel_uw_q0p0234 8 0.00 1535.977 FORMAT "%8.3" DEPOSIT ABSOLUTE /end AXIS_PTS
/begin CHARACTERISTIC IKCtl_MeasWinCorr_C "measurement window begin ccorrection behaviour" VALUE 0x80523DCF RB_Val_Wu8 255.0 OneToOne 0.00 255.0 FORMAT "%5.1" /end CHARACTERISTIC
/begin AXIS_PTS IKCtl_nEngVar13_X_AX "KC: Datapoint distribution engine speed of group A" 0x8052518C Epm_nEng RB_Axis_S16 32767.50 EngN 13 -16384.00 16383.50 FORMAT "%8.2" DEPOSIT ABSOLUTE /end AXIS_PTS
/begin CHARACTERISTIC IKCtl_SpdHys_C "n hysterisis for adaptation maps" VALUE 0x80523DD0 RB_Val_Ws16 32767.50 EngN -16384.00 16383.50 FORMAT "%8.2" /end CHARACTERISTIC
/begin CHARACTERISTIC KFWDKMSMXN "throttle angle at max. mass flow (depends on engine speed and engine temperature)" MAP 0x805238E0 RB_Map_S16S16_U16 99.99847 rel_uw_b100 0.00 99.99847 FORMAT "%8.5"
 /begin AXIS_DESCR STD_AXIS Epm_nEng EngN 5 -16384.00 16383.50 FORMAT "%8.2" DEPOSIT ABSOLUTE /end AXIS_DESCR
 /begin AXIS_DESCR STD_AXIS CEngDsT_t Temp_Cels 2 -3549.940 3003.560 FORMAT "%8.3" DEPOSIT ABSOLUTE /end AXIS_DESCR
/end CHARACTERISTIC
/begin CHARACTERISTIC KFWDKMSNVP "desired throttle angle" MAP 0x80523906 RB_Map_U16U16_U16 99.99847 rel_uw_b100 0.00 99.99847 FORMAT "%8.5"
 /begin AXIS_DESCR STD_AXIS msndkoos_w m_uw_b6553p5 18 0.00 6553.500 FORMAT "%8.3" DEPOSIT ABSOLUTE /end AXIS_DESCR
 /begin AXIS_DESCR STD_AXIS vpsrvdb_w_msg fak_q3p0518Em5 8 0.00 1.999969 FORMAT "%8.6" DEPOSIT ABSOLUTE /end AXIS_DESCR
/end CHARACTERISTIC
/begin CHARACTERISTIC NMOTCVWDK "max. rpm, when throttle position demand is because of tester" VALUE 0x80523A5E RB_Val_Wu8 10200. nmot_ub_q40 0.00 10200. FORMAT "%5.0" /end CHARACTERISTIC
/begin CHARACTERISTIC OFMSNWDKHF "leakage of throttle blade for calculation of wdkhf" VALUE 0x80523A60 RB_Val_Ws16 6553.500 m_q0p1 -3276.800 3276.700 FORMAT "%8.3" /end CHARACTERISTIC
/begin CHARACTERISTIC TAVDKMNDK "min. temperature of offset-addition to DK-map (if nmot=0)" VALUE 0x80523A62 RB_Val_Wu16 1535.977 temp_q0p0234_o273 -273.150 1262.827 FORMAT "%8.3" /end CHARACTERISTIC
/begin CHARACTERISTIC TFWDKPSPV "filtering time of desired throttle angle" CURVE 0x80523A64 RB_Curve_U16_U16 655.3400 t_q0p01 0.0100 655.3500 FORMAT "%8.4" EXTENDED_LIMITS 0.00 655.3500
 /begin AXIS_DESCR STD_AXIS vpsrvdk_w_msg fak_uw_b2 4 0.00 1.999969 FORMAT "%8.6" DEPOSIT ABSOLUTE /end AXIS_DESCR
/end CHARACTERISTIC
/begin CHARACTERISTIC TVWDKVFZGMX "throshold of vehicle speed to adjust Throtthle valve actuation delay" VALUE 0x80523AA0 RB_Val_Ws16 655.3500 Vel -327.6800 327.6700 FORMAT "%8.4" /end CHARACTERISTIC
/begin CHARACTERISTIC VPSRSVDRDU "pressure ratio at thottle blade for disable WOT if no request for WOT (hysterese)" VALUE 0x80523A76 RB_Val_Wu16 0.05001831 fak_uw_b1 0.8999939 0.9500122 FORMAT "%9.7" EXTENDED_LIMITS 0.00 0.9999847 /end CHARACTERISTIC
/begin CHARACTERISTIC WDKSAPP "throttle angle for calibration tasks" VALUE 0x80523A78 RB_Val_Wu16 99.99847 rel_uw_b100 0.00 99.99847 FORMAT "%8.5" /end CHARACTERISTIC
/begin CHARACTERISTIC WDKSOFS "Offset added to appl. value of desired throttle position at low temperature" VALUE 0x80523A7A RB_Val_Wu16 99.99847 rel_uw_b100 0.00 99.99847 FORMAT "%8.5" /end CHARACTERISTIC
/begin CHARACTERISTIC WDKSWE "Throttle-valve nominal-value threshold for predicted de-jittering" VALUE 0x80523AA2 RB_Val_Wu16 99.99847 rel_uw_b100 0.00 99.99847 FORMAT "%8.5" /end CHARACTERISTIC
/begin CHARACTERISTIC WNWRAS "angle outlet valve closed in reference position relative to TDC" VALUE 0x80523C0C RB_Val_Ws16 511.9922 kw_q0p0078 -256.0000 255.9922 FORMAT "%8.4" /end CHARACTERISTIC
/begin CHARACTERISTIC WNWREO "angle inlet valve opened in reference position relative to TDC" VALUE 0x80523C0E RB_Val_Ws16 511.9922 kw_q0p0078 -256.0000 255.9922 FORMAT "%8.4" /end CHARACTERISTIC
/begin CHARACTERISTIC ZWRETKRMN "lower threshold for knock window begin interpolation for low ignition retardation" VALUE 0x80523DD2 RB_Val_Wu8 12.00 kw_q0p75 0.00 12.00 FORMAT "%5.2" EXTENDED_LIMITS 0.00 191.3 /end CHARACTERISTIC
/begin MEASUREMENT B_dkstrl_msg "Condition: throttle blade controls charge" UBYTE B_TRUE 1 100 0.00 1.00000000000 BIT_MASK 0x1 FORMAT "%13.11" ECU_ADDRESS 0x60000163 /end MEASUREMENT
/begin MEASUREMENT B_dwdksugd "difference of desired throttle angle refered at 95% to 100% charge active" UBYTE B_TRUE 1 100 0.00 1.00000000000 BIT_MASK 0x1 FORMAT "%13.11" ECU_ADDRESS 0x600000E4 /end MEASUREMENT
/begin MEASUREMENT B_dwdkugdf "Condition: enable WOT area" UBYTE B_TRUE 1 100 0.00 1.00000000000 BIT_MASK 0x1 FORMAT "%13.11" ECU_ADDRESS 0x600000E3 /end MEASUREMENT
/begin MEASUREMENT B_fgdkabgs_msg "Condition: enable throtttle adaption from desired calculation" UBYTE B_TRUE 1 100 0.00 1.00000000000 BIT_MASK 0x1 FORMAT "%13.11" ECU_ADDRESS 0x60000154 /end MEASUREMENT
/begin MEASUREMENT B_msdksg_msg "Condition:desired mass flow is valid" UBYTE B_TRUE 1 100 0.00 1.00000000000 BIT_MASK 0x1 FORMAT "%13.11" ECU_ADDRESS 0x60000142 /end MEASUREMENT
/begin MEASUREMENT B_wdkap_msg "Condition: desired throttle position from appl. characteristic line or at start" UBYTE B_TRUE 1 100 0.00 1.00000000000 BIT_MASK 0x1 FORMAT "%13.11" ECU_ADDRESS 0x60000123 /end MEASUREMENT
/begin MEASUREMENT B_wdkhfg_msg "Condition throttle angle calculated from main charging sensor (wdkhf_w) is valid" UBYTE B_TRUE 1 100 0.00 1.00000000000 BIT_MASK 0x1 FORMAT "%13.11" ECU_ADDRESS 0x60000122 /end MEASUREMENT
/begin MEASUREMENT B_wdkhfu_msg "cond: wide opened throttle angle calculated from main charging sensor" UBYTE B_TRUE 1 100 0.00 1.00000000000 BIT_MASK 0x1 FORMAT "%13.11" ECU_ADDRESS 0x60000121 /end MEASUREMENT
/begin MEASUREMENT B_wdksugd_msg "Condition: WOT area active" UBYTE B_TRUE 1 100 0.00 1.00000000000 BIT_MASK 0x1 FORMAT "%13.11" ECU_ADDRESS 0x60000120 /end MEASUREMENT
/begin MEASUREMENT B_wgvsvheg_msg "desired angles of inlet camshaft is computed for big lobe" UBYTE B_TRUE 1 100 0.00 1.00000000000 BIT_MASK 0x1 FORMAT "%13.11" ECU_ADDRESS 0x6000A22B /end MEASUREMENT
/begin MEASUREMENT ChrCtl_agCamsftLimnHfmPlst "Camshaft angle as input for calculating limiting throttle angle to avoid HFM pulsation." SWORD kw_q0p0156 1 100 -512.0000 511.9844 FORMAT "%8.4" ECU_ADDRESS 0x60000C3C /end MEASUREMENT
/begin MEASUREMENT ChrCtl_agDeltaTqToStrt "Delta throttle angle between desired throttle angle and its filtered value" SWORD rel_sw_b100 1 100 -100.0000 99.9969 FORMAT "%8.4" ECU_ADDRESS 0x70002998 /end MEASUREMENT
/begin MEASUREMENT ChrCtl_nEngHfmPlst "Engine speed for the calculation of throttle angle limitation to avoid HFM pulsation" SWORD EngN 1 100 -16384.00 16383.50 FORMAT "%8.2" ECU_ADDRESS 0x60000C3A /end MEASUREMENT
/begin MEASUREMENT ChrCtl_ratThrVlvWoMdnFilLimd "Throttle valve angle without median filter limited" UWORD rel_uw_b100 1 100 0.00 99.99847 FORMAT "%8.5" ECU_ADDRESS 0x60000C38 /end MEASUREMENT
/begin MEASUREMENT ChtCtl_ratThrAgLimnAvdHfmPlst "Throttle angle limitation to avoid HFM pulsations" UWORD rel_uw_b100 1 100 0.00 99.99847 FORMAT "%8.5" ECU_ADDRESS 0x60000C36 /end MEASUREMENT
/begin MEASUREMENT Com_bTSCIntvFast "TM torque down request by ignition" UBYTE OneToOne 1 100 0.00 255.0 FORMAT "%5.1" ECU_ADDRESS 0x6000A638 /end MEASUREMENT
/begin MEASUREMENT Com_ctReIni10msCGW1 "ReInit Counter for CGW1 frame" UBYTE OneToOne 1 100 0.00 255.0 FORMAT "%5.1" ECU_ADDRESS 0x60006465 /end MEASUREMENT
/begin MEASUREMENT Com_ctReIni10msEATB "ReInit Counter for EATB frame" UBYTE OneToOne 1 100 0.00 255.0 FORMAT "%5.1" ECU_ADDRESS 0x60006473 /end MEASUREMENT
/begin MEASUREMENT Com_ctReIni10msEATC "ReInit Counter for EATC frame" UBYTE OneToOne 1 100 0.00 255.0 FORMAT "%5.1" ECU_ADDRESS 0x60006471 /end MEASUREMENT
/begin MEASUREMENT Com_ctReIni10msGwIMG6 "ReInit Counter for GwIMG6 frame" UBYTE OneToOne 1 100 0.00 255.0 FORMAT "%5.1" ECU_ADDRESS 0x60006464 /end MEASUREMENT
/begin MEASUREMENT Com_flgAntiJerkCnvrSlipEna "anti jerk compensation for CVT activ" UBYTE B_TRUE 1 100 0.00 1.00000000000 BIT_MASK 0x1 FORMAT "%13.11" ECU_ADDRESS 0x6000A1BB /end MEASUREMENT
/begin MEASUREMENT Com_flgAntiJerkCnvrSlipEnaNoDly "Enable Anti-jerk Torque convertor slip flag without delay" UBYTE B_TRUE 1 100 0.00 1.00000000000 BIT_MASK 0x1 FORMAT "%13.11" ECU_ADDRESS 0x6000A1BA /end MEASUREMENT
/begin MEASUREMENT Com_flgAutCrkActv "Auto crancking status" UBYTE OneToOne 1 100 0.00 255.0 FORMAT "%5.1" ECU_ADDRESS 0x6000A5EC /end MEASUREMENT
/begin MEASUREMENT Com_flgCVTPNPos "Neutral of Parking position status" UBYTE OneToOne 1 100 0.00 255.0 FORMAT "%5.1" ECU_ADDRESS 0x6000A5EB /end MEASUREMENT
/begin MEASUREMENT Com_flgDFCSrv7VisClrInProgs "DFC Service7 Visibility Clear in-Progress Flag" UBYTE B_TRUE 1 100 0.00 1.00000000000 BIT_MASK 0x1 FORMAT "%13.11" ECU_ADDRESS 0x60006472 /end MEASUREMENT
/begin MEASUREMENT Com_flgEATANorm "EATA Frame communication normal flag. (FId_ComEATA is not inhibited)" UBYTE B_TRUE 1 100 0.00 1.00000000000 BIT_MASK 0x1 FORMAT "%13.11" ECU_ADDRESS 0x6000A1B8 /end MEASUREMENT
/begin MEASUREMENT Com_flgGwIMG3Norm "ComGwIMG3 Frame communication normal flag. (FId_ComGwIMG3 is not inhibited)" UBYTE B_TRUE 1 100 0.00 1.00000000000 BIT_MASK 0x1 FORMAT "%13.11" ECU_ADDRESS 0x6000A1B5 /end MEASUREMENT
/begin MEASUREMENT Com_flgManCrkFCANEna "Manual cranking based on F-CAN" UBYTE OneToOne 1 100 0.00 255.0 FORMAT "%5.1" ECU_ADDRESS 0x6000A5E5 /end MEASUREMENT
/begin MEASUREMENT Com_rConvBoost "Torque Converter Boost Ratio" UWORD Com_Fact_b0p00006 1 100 0.00 3.999939 FORMAT "%8.6" ECU_ADDRESS 0x60004D6C /end MEASUREMENT
/begin MEASUREMENT Com_rTarPlly "Target pulley ratio" SWORD TransR_COMPU 1 100 -512.0000 511.9844 FORMAT "%8.4" ECU_ADDRESS 0x60005190 /end MEASUREMENT
/begin MEASUREMENT Com_rTrqCnvBoost "Trorque Conversion value" UWORD TransR 1 100 0.00 655.3500 FORMAT "%8.4" ECU_ADDRESS 0x60004D68 /end MEASUREMENT
/begin MEASUREMENT Com_stAntiJerkCtrlInhb "Anti jerk control inhibit status" UBYTE OneToOne 1 100 0.00 255.0 FORMAT "%5.1" ECU_ADDRESS 0x6000A570 /end MEASUREMENT
/begin MEASUREMENT Com_stCanChkFlg_MP "status of CAN check completion flag" UBYTE OneToOne 1 100 0.00 255.0 FORMAT "%5.1" ECU_ADDRESS 0x70008D49 /end MEASUREMENT
/begin MEASUREMENT Com_stCanErr "Status variable for CAN Error" UBYTE OneToOne 1 100 0.00 255.0 FORMAT "%5.1" ECU_ADDRESS 0x6000A55B /end MEASUREMENT
/begin MEASUREMENT Com_stComEAT4 "EAT4 Preliminary error timer value" UBYTE OneToOne 1 100 0.00 255.0 FORMAT "%5.1" ECU_ADDRESS 0x6000A550 /end MEASUREMENT
/begin MEASUREMENT Com_stConvSlip "status torque converter slip" UBYTE OneToOne 1 100 0.00 255.0 FORMAT "%5.1" ECU_ADDRESS 0x6000A54E /end MEASUREMENT
/begin MEASUREMENT Com_stCrkCdn "Status cranking condition" UBYTE OneToOne 1 100 0.00 255.0 FORMAT "%5.1" ECU_ADDRESS 0x6000A54D /end MEASUREMENT
/begin MEASUREMENT Com_stCrkCdn_MP "Status message for internal cranking condition" UBYTE OneToOne 1 100 0.00 255.0 FORMAT "%5.1" ECU_ADDRESS 0x70008D48 /end MEASUREMENT
/begin MEASUREMENT Com_stCvtShiftNeut "Neutral shift info from CAN" UBYTE OneToOne 1 100 0.00 255.0 FORMAT "%5.1" ECU_ADDRESS 0x6000A54B /end MEASUREMENT
/begin MEASUREMENT Com_stCvtShiftRvs "Reverse shift info from CAN" UBYTE OneToOne 1 100 0.00 255.0 FORMAT "%5.1" ECU_ADDRESS 0x6000A54A /end MEASUREMENT
/begin MEASUREMENT Com_stEAT10Mon "Status for EAT10 error monitoring" UBYTE OneToOne 1 100 0.00 255.0 FORMAT "%5.1" ECU_ADDRESS 0x6000A545 /end MEASUREMENT
/begin MEASUREMENT Com_stEAT12RingCntChkSumErr "Ring counter and Checksum Error for EAt12 frame" UBYTE OneToOne 1 100 0.00 255.0 FORMAT "%5.1" ECU_ADDRESS 0x6000A544 /end MEASUREMENT
/begin MEASUREMENT Com_stEAT12TOutBusOffErr "Bus off and Timeout Check with respect to EAT12 frame" UBYTE OneToOne 1 100 0.00 255.0 FORMAT "%5.1" ECU_ADDRESS 0x6000A543 /end MEASUREMENT
/begin MEASUREMENT Com_stEAT13RingCntChkSumErr "Ring conter and checksum error for EAt13 frame." UBYTE OneToOne 1 100 0.00 255.0 FORMAT "%5.1" ECU_ADDRESS 0x6000A099 /end MEASUREMENT
/begin MEASUREMENT Com_stEAT13TOutBusOffErr "Bus off and Timeout Check with respect to EAT13 frame" UBYTE OneToOne 1 100 0.00 255.0 FORMAT "%5.1" ECU_ADDRESS 0x6000A098 /end MEASUREMENT
/begin MEASUREMENT Com_stEAT1Mon "Status for EAT1 error monitoring" UBYTE OneToOne 1 100 0.00 255.0 FORMAT "%5.1" ECU_ADDRESS 0x6000A542 /end MEASUREMENT
/begin MEASUREMENT Com_stEAT2Mon "Status for EAT2 error monitoring" UBYTE OneToOne 1 100 0.00 255.0 FORMAT "%5.1" ECU_ADDRESS 0x6000A541 /end MEASUREMENT
/begin MEASUREMENT Com_stEAT4Mon "Status for EAT4 error monitoring" UBYTE OneToOne 1 100 0.00 255.0 FORMAT "%5.1" ECU_ADDRESS 0x6000A53F /end MEASUREMENT
/begin MEASUREMENT Com_stEAT6Mon "Status for EAT6 error monitoring" UBYTE OneToOne 1 100 0.00 255.0 FORMAT "%5.1" ECU_ADDRESS 0x6000A53E /end MEASUREMENT
/begin MEASUREMENT Com_stEAT7Mon "Status for EAT7 error monitoring" UBYTE OneToOne 1 100 0.00 255.0 FORMAT "%5.1" ECU_ADDRESS 0x6000A53D /end MEASUREMENT
/begin MEASUREMENT Com_stEAT8Mon "Status for EAT8 error monitoring" UBYTE OneToOne 1 100 0.00 255.0 FORMAT "%5.1" ECU_ADDRESS 0x6000A53C /end MEASUREMENT
/begin MEASUREMENT Com_stEATAMon "Status for EATA error monitoring" UBYTE OneToOne 1 100 0.00 255.0 FORMAT "%5.1" ECU_ADDRESS 0x6000A53B /end MEASUREMENT
/begin MEASUREMENT Com_stEATBByte0Info "Message for Byte0 of EATB frame" UBYTE OneToOne 1 100 0.00 255.0 FORMAT "%5.1" ECU_ADDRESS 0x6000A53A /end MEASUREMENT
/begin MEASUREMENT Com_stEATBMon "Status for EATB error monitoring" UBYTE OneToOne 1 100 0.00 255.0 FORMAT "%5.1" ECU_ADDRESS 0x6000A539 /end MEASUREMENT
/begin MEASUREMENT Com_stLowVoltFCan "FCAN status For Low Voltage" UBYTE OneToOne 1 100 0.00 255.0 FORMAT "%5.1" ECU_ADDRESS 0x6000A4E1 /end MEASUREMENT
/begin MEASUREMENT Com_stLowVoltPCan "PCAN Status for low voltage" UBYTE OneToOne 1 100 0.00 255.0 FORMAT "%5.1" ECU_ADDRESS 0x6000A4E0 /end MEASUREMENT
/begin MEASUREMENT Com_stNeutInfo "Neutral information" UBYTE OneToOne 1 100 0.00 255.0 FORMAT "%5.1" ECU_ADDRESS 0x6000A4CD /end MEASUREMENT
/begin MEASUREMENT Com_stRxEAT12ChkSumOk "EAT12 Checksum OK status" UBYTE B_TRUE 1 100 0.00 1.00000000000 BIT_MASK 0x1 FORMAT "%13.11" ECU_ADDRESS 0x6000A1A5 /end MEASUREMENT
/begin MEASUREMENT Com_stRxEAT12Deb "EAT12 Timeout Status" UBYTE B_TRUE 1 100 0.00 1.00000000000 BIT_MASK 0x1 FORMAT "%13.11" ECU_ADDRESS 0x6000A1A4 /end MEASUREMENT
/begin MEASUREMENT Com_stRxEAT12RingCntOk "EAT12 Ring counter status" UBYTE B_TRUE 1 100 0.00 1.00000000000 BIT_MASK 0x1 FORMAT "%13.11" ECU_ADDRESS 0x6000A1A3 /end MEASUREMENT
/begin MEASUREMENT Com_stRxEAT13ChkSumOk "EAT13 Checksum status" UBYTE B_TRUE 1 100 0.00 1.00000000000 BIT_MASK 0x1 FORMAT "%13.11" ECU_ADDRESS 0x60009FBA /end MEASUREMENT
/begin MEASUREMENT Com_stRxEAT13Deb "EAT13 Timeout status" UBYTE B_TRUE 1 100 0.00 1.00000000000 BIT_MASK 0x1 FORMAT "%13.11" ECU_ADDRESS 0x60009FB9 /end MEASUREMENT
/begin MEASUREMENT Com_stRxEAT13RingCntOk "EAT13 Ring counter Status" UBYTE B_TRUE 1 100 0.00 1.00000000000 BIT_MASK 0x1 FORMAT "%13.11" ECU_ADDRESS 0x60009FB8 /end MEASUREMENT
/begin MEASUREMENT Com_stRxEATBChkSumOk "CheckSum Status message" UBYTE OneToOne 1 100 0.00 255.0 FORMAT "%5.1" ECU_ADDRESS 0x6000A4B6 /end MEASUREMENT
/begin MEASUREMENT Com_stRxEATBDeb "EATB frame reception status after debouncing" UBYTE OneToOne 1 100 0.00 255.0 FORMAT "%5.1" ECU_ADDRESS 0x6000A4B5 /end MEASUREMENT
/begin MEASUREMENT Com_stRxEATBRingCntOk "Ring Counter Status Message" UBYTE OneToOne 1 100 0.00 255.0 FORMAT "%5.1" ECU_ADDRESS 0x6000A4B4 /end MEASUREMENT
/begin MEASUREMENT Com_stShftNP "Status message to indicate the position of NEUTRAL or PARKING is enabled" UBYTE OneToOne 1 100 0.00 255.0 FORMAT "%5.1" ECU_ADDRESS 0x6000A49F /end MEASUREMENT
/begin MEASUREMENT Com_stShftRev "Status message to indicate the position of REVERSE is enabled" UBYTE OneToOne 1 100 0.00 255.0 FORMAT "%5.1" ECU_ADDRESS 0x6000A49E /end MEASUREMENT
/begin MEASUREMENT Com_stShiftPosnIndcn "Shift position indication for S-Matic" UBYTE OneToOne 1 100 0.00 255.0 FORMAT "%5.1" ECU_ADDRESS 0x6000A49C /end MEASUREMENT
/begin MEASUREMENT Com_tiCanChkTmr_MP "measurement point" SWORD Time_ms 1 100 -327680.0 327670.0 FORMAT "%8.1" ECU_ADDRESS 0x70008D46 /end MEASUREMENT
/begin MEASUREMENT Com_tiEAT4PreErr_MP "measurement point" SWORD Time_ms 1 100 -327680.0 327670.0 FORMAT "%8.1" ECU_ADDRESS 0x70008D50 /end MEASUREMENT
/begin MEASUREMENT Com_trqEngTrq "Antijerk clutch torque" SWORD md_q0p1 1 100 -3276.800 3276.700 FORMAT "%8.3" ECU_ADDRESS 0x6000515E /end MEASUREMENT
/begin MEASUREMENT drlsolmf_w "delta desired relative air charge for medianfilter" UWORD rel_uw_q0p0234 1 100 0.00 1535.977 FORMAT "%8.3" ECU_ADDRESS 0x70002988 /end MEASUREMENT
/begin MEASUREMENT dwdksumx_w "difference of desired throttle angle between 95% and 100% charge" UWORD rel_uw_b100 1 100 0.00 99.99847 FORMAT "%8.5" ECU_ADDRESS 0x60000AA8 /end MEASUREMENT
/begin MEASUREMENT dwdksuofna1_w "Delta Sollwinkel Drosselklappe ab Beginn ungedrosselt ohne Filterung" UWORD rel_uw_b100 1 100 0.00 99.99847 FORMAT "%8.5" ECU_ADDRESS 0x60000C34 /end MEASUREMENT
/begin MEASUREMENT dwdksuofna2_w "Delta Sollwinkel Drosselklappe ab Beginn ungedrosselt ohne Filterung" UWORD rel_uw_b100 1 100 0.00 99.99847 FORMAT "%8.5" ECU_ADDRESS 0x60000C32 /end MEASUREMENT
/begin MEASUREMENT dwdksuofnasum_w "Delta Sollwinkel Drosselklappe ab Beginn ungedrosselt ohne Filterung" UWORD rel_uw_b100 1 100 0.00 99.99847 FORMAT "%8.5" ECU_ADDRESS 0x60000C30 /end MEASUREMENT
/begin MEASUREMENT dwdksuof_w "difference of desired throttle angle refered to 95% charge without filtering" UWORD rel_uw_b100 1 100 0.00 99.99847 FORMAT "%8.5" ECU_ADDRESS 0x60000C2E /end MEASUREMENT
/begin MEASUREMENT dwgvsge_w_msg "difference gas exch. valve inlet closes on switched valve lift between high cam and low cam profile" SWORD kw_q0p0078 1 100 -256.0000 255.9922 FORMAT "%8.4" ECU_ADDRESS 0x50005C5C /end MEASUREMENT
/begin MEASUREMENT Fan_r "Actuator setpoint value for the first fan output." SWORD Prc 1 100 -400.0000 399.9878 FORMAT "%8.4" ECU_ADDRESS 0x60005392 /end MEASUREMENT
/begin MEASUREMENT Fan_r2 "set point duty cycle for Pulse Width Modulation fan power stage 2" SWORD Prc 1 100 -400.0000 399.9878 FORMAT "%8.4" ECU_ADDRESS 0x60005394 /end MEASUREMENT
/begin MEASUREMENT Fan_stPs "Output status to the the fan actuators" UBYTE OneToOne 1 100 0.00 255.0 FORMAT "%5.1" ARRAY_SIZE 2 ECU_ADDRESS 0x6000A752 /end MEASUREMENT
/begin MEASUREMENT GbxECU_ctEAT10RngCnt_MP "Alive counter measurement point" UBYTE OneToOne 1 100 0.00 255.0 FORMAT "%5.1" ECU_ADDRESS 0x70008D56 /end MEASUREMENT
/begin MEASUREMENT GbxECU_ctEAT11RngCnt_MP "Ring Counter Measuring Point for EAT11" UBYTE OneToOne 1 100 0.00 3.000 FORMAT "%5.3" ECU_ADDRESS 0x70008D55 /end MEASUREMENT
/begin MEASUREMENT GbxECU_ctEAT12RngCnt_MP "EAT 12 Ring conter Measuring point" UBYTE OneToOne 1 100 0.00 3.000 FORMAT "%5.3" ECU_ADDRESS 0x70008D54 /end MEASUREMENT
/begin MEASUREMENT GbxECU_ctEAT13RngCnt_MP "EAT 13 ring counter Measuring point" UBYTE OneToOne 1 100 0.00 3.000 FORMAT "%5.3" ECU_ADDRESS 0x70008D53 /end MEASUREMENT
/begin MEASUREMENT GbxECU_ctEAT1RngCnt_MP "Measuring Point for Ring counter of EAT1 Frame" UBYTE OneToOne 1 100 0.00 255.0 FORMAT "%5.1" ECU_ADDRESS 0x70008D57 /end MEASUREMENT
/begin MEASUREMENT GbxECU_ctEAT2RngCnt_MP "Alive counter measurement point" UBYTE OneToOne 1 100 0.00 255.0 FORMAT "%5.1" ECU_ADDRESS 0x70008D52 /end MEASUREMENT
/begin MEASUREMENT GbxECU_ctEAT4RngCnt_MP "Alive counter measurement point" UBYTE OneToOne 1 100 0.00 255.0 FORMAT "%5.1" ECU_ADDRESS 0x70008D4E /end MEASUREMENT
/begin MEASUREMENT GbxECU_ctEAT6RngCnt_MP "Alive counter measurement point" UBYTE OneToOne 1 100 0.00 255.0 FORMAT "%5.1" ECU_ADDRESS 0x70008D4D /end MEASUREMENT
/begin MEASUREMENT GbxECU_ctEAT7RngCnt_MP "Alive counter measurement point" UBYTE OneToOne 1 100 0.00 255.0 FORMAT "%5.1" ECU_ADDRESS 0x70008D4C /end MEASUREMENT
/begin MEASUREMENT GbxECU_ctEAT8RngCnt_MP "Measurement point for EAT8 frame ring counter" UBYTE OneToOne 1 100 0.00 255.0 FORMAT "%5.1" ECU_ADDRESS 0x70008D4B /end MEASUREMENT
/begin MEASUREMENT GbxECU_ctEATARngCnt_MP "Alive counter measurement point" UBYTE OneToOne 1 100 0.00 255.0 FORMAT "%5.1" ECU_ADDRESS 0x70008D4A /end MEASUREMENT
/begin MEASUREMENT GbxECU_ctEATBRngCnt_MP "Alive counter measurement point" UBYTE OneToOne 1 100 0.00 255.0 FORMAT "%5.1" ECU_ADDRESS 0x70008D44 /end MEASUREMENT
/begin MEASUREMENT GbxECU_ctEATCRngCnt "Indicated for Measurement point for EATC frame ring counter" UBYTE OneToOne 1 100 0.00 255.0 FORMAT "%5.1" ECU_ADDRESS 0x60006470 /end MEASUREMENT
/begin MEASUREMENT GbxPNPos_cntrReIni "control ReIni" UBYTE OneToOne 1 100 0.00 255.0 FORMAT "%5.1" ECU_ADDRESS 0x6000646F /end MEASUREMENT
/begin MEASUREMENT GbxPNPos_stPNPosnDiagEna "Park Neutral Switch diagnosis enable conditions" UBYTE OneToOne 1 100 0.00 255.0 FORMAT "%5.1" ECU_ADDRESS 0x6000A3AC /end MEASUREMENT
/begin MEASUREMENT Gbx_bLuckUpOpn "status luck up open" UBYTE B_TRUE 1 100 0.00 1.00000000000 BIT_MASK 0x1 FORMAT "%13.11" ECU_ADDRESS 0x6000A189 /end MEASUREMENT
/begin MEASUREMENT Gbx_cntrNeutPosnCANPlausErr "Counter for the no.of times the plausibility error happened" UWORD OneToOne 1 100 0.00 65535.00 FORMAT "%8.2" ECU_ADDRESS 0x6000041A /end MEASUREMENT
/begin MEASUREMENT Gbx_ctRvsSwtReIni "Post drive state counter" UBYTE OneToOne 1 100 0.00 255.0 FORMAT "%5.1" ECU_ADDRESS 0x6000646E /end MEASUREMENT
/begin MEASUREMENT Gbx_flgAn1NeutPosnSRCMax "Flag indicating SRC max error for analog sensor1" UBYTE B_TRUE 1 100 0.00 1.00000000000 BIT_MASK 0x1 FORMAT "%13.11" ECU_ADDRESS 0x600006E9 /end MEASUREMENT
/begin MEASUREMENT Gbx_flgAn1NeutPosnSRCMin "Flag indicating SRC min error for analog sensor1" UBYTE B_TRUE 1 100 0.00 1.00000000000 BIT_MASK 0x1 FORMAT "%13.11" ECU_ADDRESS 0x600006EA /end MEASUREMENT
/begin MEASUREMENT Gbx_flgAn2NeutPosnSRCMax "Flag indicating SRC max error for analog sensor2" UBYTE B_TRUE 1 100 0.00 1.00000000000 BIT_MASK 0x1 FORMAT "%13.11" ECU_ADDRESS 0x600006EB /end MEASUREMENT
/begin MEASUREMENT Gbx_flgAn2NeutPosnSRCMin "Flag indicating SRC min error for analog sensor2" UBYTE B_TRUE 1 100 0.00 1.00000000000 BIT_MASK 0x1 FORMAT "%13.11" ECU_ADDRESS 0x600006EC /end MEASUREMENT
/begin MEASUREMENT Gbx_flgAnaNPosSyncErr "Flag indicating analog neutral position syncronicity error" UBYTE B_TRUE 1 100 0.00 1.00000000000 BIT_MASK 0x1 FORMAT "%13.11" ECU_ADDRESS 0x600006ED /end MEASUREMENT
/begin MEASUREMENT Gbx_flgNeutChk "Flag to indicate if it was in neutral position" UBYTE B_TRUE 1 100 0.00 1.00000000000 BIT_MASK 0x1 FORMAT "%13.11" ECU_ADDRESS 0x600006EE /end MEASUREMENT
/begin MEASUREMENT Gbx_flgNeutErr1 "Error flag- Digital signal shows ON, which doesnt match with CAN signal" UBYTE B_TRUE 1 100 0.00 1.00000000000 BIT_MASK 0x1 FORMAT "%13.11" ECU_ADDRESS 0x600006EF /end MEASUREMENT
/begin MEASUREMENT Gbx_flgNeutErr2 "Error flag- Digital signal shows OFF, which doesnt match with CAN signal" UBYTE B_TRUE 1 100 0.00 1.00000000000 BIT_MASK 0x1 FORMAT "%13.11" ECU_ADDRESS 0x600006F0 /end MEASUREMENT
/begin MEASUREMENT Gbx_flgNeutPosnCANPlausErr "Mismatch between digital signal and CAN signal" UBYTE B_TRUE 1 100 0.00 1.00000000000 BIT_MASK 0x1 FORMAT "%13.11" ECU_ADDRESS 0x600006F1 /end MEASUREMENT
/begin MEASUREMENT Gbx_flgNeutSig "Neutral signal from digital input after inversion logic" UBYTE B_TRUE 1 100 0.00 1.00000000000 BIT_MASK 0x1 FORMAT "%13.11" ECU_ADDRESS 0x600006F2 /end MEASUREMENT
/begin MEASUREMENT Gbx_flgNonNeutChk "Flag to indicate if it was in non neutral position" UBYTE B_TRUE 1 100 0.00 1.00000000000 BIT_MASK 0x1 FORMAT "%13.11" ECU_ADDRESS 0x600006F3 /end MEASUREMENT
/begin MEASUREMENT Gbx_lDiffDst "Distance[Km] after detection of reverse switch ON stuck error" SWORD LengthKm_q0p1 1 100 -3276.800 3276.700 FORMAT "%8.3" ECU_ADDRESS 0x6000380E /end MEASUREMENT
/begin MEASUREMENT Gbx_lDiffDstM "Distance[m] after detection of reverse switch ON stuck error" SLONG Length 1 100 -2147483648.00 2147483647.00 FORMAT "%13.2" ECU_ADDRESS 0x60001414 /end MEASUREMENT
/begin MEASUREMENT Gbx_lTotDstOld "Total distance travelled with the current ECU when reverse switch ON stuck error is detected" SLONG Length 1 100 -2147483648.00 2147483647.00 FORMAT "%13.2" ECU_ADDRESS 0x60001410 /end MEASUREMENT
/begin MEASUREMENT Gbx_nIdlDes "Synchronized desired engine speed" SWORD EngN 1 100 -16384.00 16383.50 FORMAT "%8.2" ECU_ADDRESS 0x60005072 /end MEASUREMENT
/begin MEASUREMENT Gbx_nTrbn "Turbine speed" SWORD EngN 1 100 -16384.00 16383.50 FORMAT "%8.2" ECU_ADDRESS 0x6000506C /end MEASUREMENT
/begin MEASUREMENT Gbx_numNeutPosnAlv "Counter for alive check" UBYTE OneToOne 1 100 0.00 255.0 FORMAT "%5.1" ECU_ADDRESS 0x600006F4 /end MEASUREMENT
/begin MEASUREMENT Gbx_stActvNPos "Active live check status for neutral position sensor for 1 driving cycle" UBYTE OneToOne 1 100 0.00 255.0 FORMAT "%5.1" ECU_ADDRESS 0x6000077B /end MEASUREMENT
/begin MEASUREMENT Gbx_stAlvChk "State variable for alive check." UBYTE OneToOne 1 100 0.00 255.0 FORMAT "%5.1" ECU_ADDRESS 0x600006F5 /end MEASUREMENT
/begin MEASUREMENT Gbx_stAnaNPos "Status message of neutral position for analog neutral sensor" UBYTE OneToOne 1 100 0.00 255.0 FORMAT "%5.1" ECU_ADDRESS 0x70001C2B /end MEASUREMENT
/begin MEASUREMENT Gbx_stAnaNPosBrkHld "Neutral flag for brake hold control" UBYTE OneToOne 1 100 0.00 255.0 FORMAT "%5.1" ECU_ADDRESS 0x70001C2A /end MEASUREMENT
/begin MEASUREMENT Gbx_stAnaNPosnWoAlvChk "Neutral position without alive-check from Analog signal" UBYTE OneToOne 1 100 0.00 255.0 FORMAT "%5.1" ECU_ADDRESS 0x6000077E /end MEASUREMENT
/begin MEASUREMENT Gbx_stAnNeutPosnFlt "Status showing if the analog sensor voltage is within Low and High thresholds, after debouncing" UBYTE B_TRUE 1 100 0.00 1.00000000000 BIT_MASK 0x1 FORMAT "%13.11" ECU_ADDRESS 0x6000077C /end MEASUREMENT
/begin MEASUREMENT Gbx_stAnNeutPosnRaw "Status showing if the analog sensor voltage is within Low and High thresholds, before debouncing" UBYTE B_TRUE 1 100 0.00 1.00000000000 BIT_MASK 0x1 FORMAT "%13.11" ECU_ADDRESS 0x6000077D /end MEASUREMENT
/begin MEASUREMENT Gbx_stConvClth "Gearbox converter clutch" UBYTE OneToOne 1 100 0.00 255.0 FORMAT "%5.1" ECU_ADDRESS 0x6000A3AB /end MEASUREMENT
/begin MEASUREMENT Gbx_stGearLvr "Selected gear position in case of automatic transmission system" UBYTE OneToOne 1 100 0.00 255.0 FORMAT "%5.1" ECU_ADDRESS 0x6000A3AA /end MEASUREMENT
/begin MEASUREMENT Gbx_stNPos "State of Gearbox Neutral Position" UBYTE OneToOne 1 100 0.00 255.0 FORMAT "%5.1" ECU_ADDRESS 0x60000780 /end MEASUREMENT
/begin MEASUREMENT Gbx_stNPosErr "Start-Stop System Error of the Neutral Gear Sensor" UBYTE B_TRUE 1 100 0.00 1.00000000000 BIT_MASK 0x1 FORMAT "%13.11" ECU_ADDRESS 0x60000781 /end MEASUREMENT
/begin MEASUREMENT Gbx_stNPosRaw "Raw signal from the digital gearbox neutral position sensor." UBYTE OneToOne 1 100 0.00 255.0 FORMAT "%5.1" ECU_ADDRESS 0x60000782 /end MEASUREMENT
/begin MEASUREMENT Gbx_stPNPos "Park Neutral Switch status" UBYTE B_TRUE 1 100 0.00 1.00000000000 BIT_MASK 0x1 FORMAT "%13.11" ECU_ADDRESS 0x6000A187 /end MEASUREMENT
/begin MEASUREMENT Gbx_stPNPosnDeb "Debounced Park Neutral Switch status" UBYTE B_TRUE 1 100 0.00 1.00000000000 BIT_MASK 0x1 FORMAT "%13.11" ECU_ADDRESS 0x6000A186 /end MEASUREMENT
/begin MEASUREMENT Gbx_stPNPosnRaw "Park Neutral Switch raw signal" UBYTE B_TRUE 1 100 0.00 1.00000000000 BIT_MASK 0x1 FORMAT "%13.11" ECU_ADDRESS 0x6000A185 /end MEASUREMENT
/begin MEASUREMENT Gbx_stPPos "Gearbox parking position status signal." UBYTE OneToOne 1 100 0.00 255.0 FORMAT "%5.1" ECU_ADDRESS 0x6000A751 /end MEASUREMENT
/begin MEASUREMENT Gbx_stRvsPos "Debounced Gearbox Reverse Position Switch Raw Value" UBYTE OneToOne 1 100 0.00 255.0 FORMAT "%5.1" ECU_ADDRESS 0x6000A3A9 /end MEASUREMENT
/begin MEASUREMENT Gbx_stRvsPosRaw "Gearbox Reverse Position Switch Raw Value" UBYTE OneToOne 1 100 0.00 255.0 FORMAT "%5.1" ECU_ADDRESS 0x6000A3A8 /end MEASUREMENT
/begin MEASUREMENT Gbx_stRvsSwtCnd "Condition of reverse switch ON stuck error" UBYTE OneToOne 1 100 0.00 255.0 FORMAT "%5.1" ECU_ADDRESS 0x6000646D /end MEASUREMENT
/begin MEASUREMENT Gbx_stRvsSwtErr "Status of reverse switch ON stuck error" UBYTE OneToOne 1 100 0.00 255.0 FORMAT "%5.1" ECU_ADDRESS 0x6000646C /end MEASUREMENT
/begin MEASUREMENT Gbx_trqConvLos "Gear box transmission torque loss absolute" SWORD Trq 1 100 -3276.800 3276.700 FORMAT "%8.3" ECU_ADDRESS 0x6000505E /end MEASUREMENT
/begin MEASUREMENT Gbx_trqTSCIntvFast "TM requested torque (ignition)" SWORD Trq 1 100 -3276.800 3276.700 FORMAT "%8.3" ECU_ADDRESS 0x6000505A /end MEASUREMENT
/begin MEASUREMENT Gbx_uAn1NeutPosnRawTmp "Analog voltage raw value from sensor1" SWORD Volt 1 100 -6553.600 6553.400 FORMAT "%8.3" ECU_ADDRESS 0x6000041C /end MEASUREMENT
/begin MEASUREMENT Gbx_uAna1NPosRaw "Raw voltage value from analog neutral sensor-A" SWORD Volt 1 100 -6553.600 6553.400 FORMAT "%8.3" ECU_ADDRESS 0x6000051C /end MEASUREMENT
/begin MEASUREMENT Gbx_uAna2NPosRaw "Raw voltage value from analog neutral sensor-B" SWORD Volt 1 100 -6553.600 6553.400 FORMAT "%8.3" ECU_ADDRESS 0x6000051E /end MEASUREMENT
/begin MEASUREMENT GEVCtl_agClsdIntkSpclOutl "Outlet camshaft closing angle for special lift" SWORD kw_q0p0156 1 100 -512.0000 511.9844 FORMAT "%8.4" ECU_ADDRESS 0x600049F8 /end MEASUREMENT
/begin MEASUREMENT GEVCtl_agClsdIntkStdOutl "Outlet camshaft closing angle for standard lift" SWORD kw_q0p0156 1 100 -512.0000 511.9844 FORMAT "%8.4" ECU_ADDRESS 0x600049F6 /end MEASUREMENT
/begin MEASUREMENT GEVCtl_agClsdOutl "Message for angle outlet valve closes at 0.5mm lift" SWORD kw_q0p0156 1 100 -512.0000 511.9844 FORMAT "%8.4" ECU_ADDRESS 0x6000508C /end MEASUREMENT
/begin MEASUREMENT GEVCtl_agDifStdSpclLftClsdIntk "Angle difference between the intake valve closing points of the two cam profiles" SWORD kw_q0p0156 1 100 -512.0000 511.9844 FORMAT "%8.4" ECU_ADDRESS 0x600049F4 /end MEASUREMENT
/begin MEASUREMENT GEVCtl_agDifStdSpclLftOffsIntk "Difference gas exch. valve inlet opens on switched valve lift between standard cam and special cam profile" SWORD kw_q0p0156 1 100 -512.0000 511.9844 FORMAT "%8.4" ECU_ADDRESS 0x6000508A /end MEASUREMENT
/begin MEASUREMENT GEVCtl_agDifStdSpclLftOpenIntk "angle delta of gas intake valve inlet close on switched valve lift between standard cam and special cam profile" SWORD kw_q0p0156 1 100 -512.0000 511.9844 FORMAT "%8.4" ECU_ADDRESS 0x60005088 /end MEASUREMENT
/begin MEASUREMENT GEVCtl_agIntkClsd "Actual position intake valve closed" SWORD kw_q0p0156 1 100 -512.0000 511.9844 FORMAT "%8.4" ECU_ADDRESS 0x6000E256 /end MEASUREMENT
/begin MEASUREMENT GEVCtl_agIntkClsd_a "Actual position intake valve closed (0.5 mm cylinder individuel)" SWORD kw_q0p0156 1 100 -512.0000 511.9844 FORMAT "%8.4" ARRAY_SIZE 4 ECU_ADDRESS 0x500004F0 /end MEASUREMENT
/begin MEASUREMENT GEVCtl_agIntkOpen "Actual position intake valve opening" SWORD kw_q0p0156 1 100 -512.0000 511.9844 FORMAT "%8.4" ECU_ADDRESS 0x6000E258 /end MEASUREMENT
/begin MEASUREMENT GEVCtl_agIntkOpen_a "Actual position intake valve opening (0.5 mm cylinder individuel)" SWORD kw_q0p0156 1 100 -512.0000 511.9844 FORMAT "%8.4" ARRAY_SIZE 4 ECU_ADDRESS 0x500004F8 /end MEASUREMENT
/begin MEASUREMENT GEVCtl_agOpenIntk "Message for angle intake valve opens at 0.5mm lift" SWORD kw_q0p0156 1 100 -512.0000 511.9844 FORMAT "%8.4" ECU_ADDRESS 0x70001DA2 /end MEASUREMENT
/begin MEASUREMENT GEVCtl_agOpenPredIntk "Message for angle of predicted intake valve opens at 0.5mm lift" SWORD kw_q0p0156 1 100 -512.0000 511.9844 FORMAT "%8.4" ECU_ADDRESS 0x70001DA0 /end MEASUREMENT
/begin MEASUREMENT GEVCtl_agOutlClsd "Actual position outlet valve closed" SWORD kw_q0p0156 1 100 -512.0000 511.9844 FORMAT "%8.4" ECU_ADDRESS 0x6000E25A /end MEASUREMENT
/begin MEASUREMENT GEVCtl_agOutlClsd_a "Actual position outlet valve closed (0.5 mm and cylinder individuel)" SWORD kw_q0p0156 1 100 -512.0000 511.9844 FORMAT "%8.4" ARRAY_SIZE 4 ECU_ADDRESS 0x50000500 /end MEASUREMENT
/begin MEASUREMENT GEVCtl_agOutlOpen "Actual position outlet valve opening" SWORD kw_q0p0156 1 100 -512.0000 511.9844 FORMAT "%8.4" ECU_ADDRESS 0x6000E25C /end MEASUREMENT
/begin MEASUREMENT GEVCtl_agSpclLftIntkClsd "Actual angle Special Lift Intake Closed" SWORD kw_q0p0156 1 100 -512.0000 511.9844 FORMAT "%8.4" ECU_ADDRESS 0x600049EA /end MEASUREMENT
/begin MEASUREMENT GEVCtl_agSpclLftIntkOpen "Actual angle Special Lift Intake open" SWORD kw_q0p0156 1 100 -512.0000 511.9844 FORMAT "%8.4" ECU_ADDRESS 0x600049E8 /end MEASUREMENT
/begin MEASUREMENT GEVCtl_agSpHomIntkClsd "value: des. angle gas exch. valve closes intake hom.mode" SWORD kw_q0p0156 1 100 -512.0000 511.9844 FORMAT "%8.4" ECU_ADDRESS 0x600049F2 /end MEASUREMENT
/begin MEASUREMENT GEVCtl_agSpHomIntkOpen "value: des. angle gas exch. valve opens intake hom.mode" SWORD kw_q0p0156 1 100 -512.0000 511.9844 FORMAT "%8.4" ECU_ADDRESS 0x600049F0 /end MEASUREMENT
/begin MEASUREMENT GEVCtl_agSpHomOutlClsd "value: des. angle gas exch. valve closes exhaust hom.mode" SWORD kw_q0p0156 1 100 -512.0000 511.9844 FORMAT "%8.4" ECU_ADDRESS 0x600049EE /end MEASUREMENT
/begin MEASUREMENT GEVCtl_agSpHomOutlOpen "value: des. angle gas exch. valve opens exhaust homogen. mode" SWORD kw_q0p0156 1 100 -512.0000 511.9844 FORMAT "%8.4" ECU_ADDRESS 0x600049EC /end MEASUREMENT
/begin MEASUREMENT GEVCtl_agSpIntkClsd "Setpoint angle intake valve closes" SWORD kw_q0p0156 1 100 -512.0000 511.9844 FORMAT "%8.4" ECU_ADDRESS 0x6000E25E /end MEASUREMENT
/begin MEASUREMENT GEVCtl_agSpIntkHiLftIntkClsd "Desired angle inlet gas exchange valve closes for VHE big cam profile" SWORD kw_q0p0156 1 100 -512.0000 511.9844 FORMAT "%8.4" ECU_ADDRESS 0x60005086 /end MEASUREMENT
/begin MEASUREMENT GEVCtl_agSpIntkHiLftIntkOpen "Desired angle intake gas exchange valve opens for VHE big cam profile" SWORD kw_q0p0156 1 100 -512.0000 511.9844 FORMAT "%8.4" ECU_ADDRESS 0x60005084 /end MEASUREMENT
/begin MEASUREMENT GEVCtl_agSpIntkHiLftOutlClsd "Desired angle outlet gas exchange valve closes for VHE big cam profile" SWORD kw_q0p0156 1 100 -512.0000 511.9844 FORMAT "%8.4" ECU_ADDRESS 0x60005082 /end MEASUREMENT
/begin MEASUREMENT GEVCtl_agSpIntkHiLftOutlOpen "Desired angle outlet gas exchange valve opens for VHE big cam profile" SWORD kw_q0p0156 1 100 -512.0000 511.9844 FORMAT "%8.4" ECU_ADDRESS 0x60005080 /end MEASUREMENT
/begin MEASUREMENT GEVCtl_agSpIntkLoLftIntkClsd "desired angle inlet gas exchange valve closes for VHE small cam profile" SWORD kw_q0p0156 1 100 -512.0000 511.9844 FORMAT "%8.4" ECU_ADDRESS 0x6000507E /end MEASUREMENT
/begin MEASUREMENT GEVCtl_agSpIntkLoLftIntkOpen "Desired angle intake gas exchange valve opens for VHE small cam profile" SWORD kw_q0p0156 1 100 -512.0000 511.9844 FORMAT "%8.4" ECU_ADDRESS 0x6000507C /end MEASUREMENT
/begin MEASUREMENT GEVCtl_agSpIntkLoLftOutlClsd "Desired angle outlet gas exchange valve closes for VHE small cam profile" SWORD kw_q0p0156 1 100 -512.0000 511.9844 FORMAT "%8.4" ECU_ADDRESS 0x6000507A /end MEASUREMENT
/begin MEASUREMENT GEVCtl_agSpIntkLoLftOutlOpen "Desired angle outlet gas exchange valve opens for VHE small cam profile" SWORD kw_q0p0156 1 100 -512.0000 511.9844 FORMAT "%8.4" ECU_ADDRESS 0x60005078 /end MEASUREMENT
/begin MEASUREMENT GEVCtl_agSpIntkOpen "Setpoint angle intake valve opens" SWORD kw_q0p0156 1 100 -512.0000 511.9844 FORMAT "%8.4" ECU_ADDRESS 0x6000E260 /end MEASUREMENT
/begin MEASUREMENT GEVCtl_agSpOutlClsd "Setpoint angle outlet valve closes" SWORD kw_q0p0156 1 100 -512.0000 511.9844 FORMAT "%8.4" ECU_ADDRESS 0x6000E262 /end MEASUREMENT
/begin MEASUREMENT GEVCtl_agSpOutlOpen "Des. angle: gas exch. valve opens exhaust" SWORD kw_q0p0156 1 100 -512.0000 511.9844 FORMAT "%8.4" ECU_ADDRESS 0x6000E264 /end MEASUREMENT
/begin MEASUREMENT GEVCtl_agStdLftIntkClsd "Actual angle Standard Lift Intake Closed" SWORD kw_q0p0156 1 100 -512.0000 511.9844 FORMAT "%8.4" ECU_ADDRESS 0x600049E6 /end MEASUREMENT
/begin MEASUREMENT GEVCtl_agStdLftIntkOpen "Actual angle Standard Lift Intake open" SWORD kw_q0p0156 1 100 -512.0000 511.9844 FORMAT "%8.4" ECU_ADDRESS 0x600049E4 /end MEASUREMENT
/begin MEASUREMENT GEVCtl_agWidthCamPredIntk "Message for width of the predicted intake valve cam profile referred to 0.5mm lift" SWORD kw_q0p0156 1 100 -512.0000 511.9844 FORMAT "%8.4" ECU_ADDRESS 0x70001D9E /end MEASUREMENT
/begin MEASUREMENT GEVCtl_agWidthCamProfIntk "Width of valve cam profile referred to 0.5mm lift intake" SWORD kw_q0p0156 1 100 -512.0000 511.9844 FORMAT "%8.4" ECU_ADDRESS 0x70001D9C /end MEASUREMENT
/begin MEASUREMENT GEVCtl_agWidthCamProfOutl "Width of valve cam profile referred to 0.5mm lift outlet" SWORD kw_q0p0156 1 100 -512.0000 511.9844 FORMAT "%8.4" ECU_ADDRESS 0x60005076 /end MEASUREMENT
/begin MEASUREMENT GEVCtl_cntrDlyChrgDetrmIntkVlvLftSwt "Counter for the number of segments after inlet valve lift was switched." SBYTE OneToOne 1 100 -128.0 127.0 FORMAT "%5.1" ECU_ADDRESS 0x5000084F /end MEASUREMENT
/begin MEASUREMENT GEVCtl_flgActAgStdLftIntk "actual angles of inlet camshaft is computed for big lobe" UBYTE B_TRUE 1 100 0.00 1.00000000000 BIT_MASK 0x1 FORMAT "%13.11" ECU_ADDRESS 0x6000A18D /end MEASUREMENT
/begin MEASUREMENT GEVCtl_flgCalcSpIntkHiLft "Desired angles are computed for big cam profile intake valve lift VHE" UBYTE B_TRUE 1 100 0.00 1.00000000000 BIT_MASK 0x1 FORMAT "%13.11" ECU_ADDRESS 0x6000A18C /end MEASUREMENT
/begin MEASUREMENT GEVCtl_flgEngStrtCdnVlvLftEna "flag to release cam profile switching after oil pressure is stabalised based on time since engine start" UBYTE B_TRUE 1 100 0.00 1.00000000000 BIT_MASK 0x1 FORMAT "%13.11" ECU_ADDRESS 0x7000020B /end MEASUREMENT
/begin MEASUREMENT GEVCtl_flgIntkVlvLftEna "Release condition of intake camshaft profile switching" UBYTE B_TRUE 1 100 0.00 1.00000000000 BIT_MASK 0x1 FORMAT "%13.11" ECU_ADDRESS 0x70000795 /end MEASUREMENT
/begin MEASUREMENT GEVCtl_flgLftLimpNLim "Engine speed limitation based valve lift system request" UBYTE B_TRUE 1 100 0.00 1.00000000000 BIT_MASK 0x1 FORMAT "%13.11" ECU_ADDRESS 0x70000794 /end MEASUREMENT
/begin MEASUREMENT GEVCtl_flgPredStdVlvLft "Selection of angle for predicted valve lift" UBYTE B_TRUE 1 100 0.00 1.00000000000 BIT_MASK 0x1 FORMAT "%13.11" ECU_ADDRESS 0x6000A18B /end MEASUREMENT
/begin MEASUREMENT GEVCtl_flgSimCsersDiag "Condition simulation of CSERS diagnosis" UBYTE B_TRUE 1 100 0.00 1.00000000000 BIT_MASK 0x1 FORMAT "%13.11" ECU_ADDRESS 0x70000792 /end MEASUREMENT
/begin MEASUREMENT GEVCtl_flgStdLftChrgDetrmIntk "Intake valve lift for charge determination equals standard lift" UBYTE B_TRUE 1 100 0.00 1.00000000000 BIT_MASK 0x1 FORMAT "%13.11" ECU_ADDRESS 0x70000790 /end MEASUREMENT
/begin MEASUREMENT GEVCtl_flgStdLftHwIntk "Confirmation of hardware switching: intake valve lift equals standard lift" UBYTE B_TRUE 1 100 0.00 1.00000000000 BIT_MASK 0x1 FORMAT "%13.11" ECU_ADDRESS 0x7000078F /end MEASUREMENT
/begin MEASUREMENT GEVCtl_flgStdLftSyncIntk "Synchronization: intake valve lift equals standard lift" UBYTE B_TRUE 1 100 0.00 1.00000000000 BIT_MASK 0x1 FORMAT "%13.11" ECU_ADDRESS 0x7000078E /end MEASUREMENT
/begin MEASUREMENT GEVCtl_nrCylSyncVlvLftIntk "Cylinder index for first cylinder to be switched (intake)" UBYTE OneToOne 1 100 0.00 255.0 FORMAT "%5.1" ECU_ADDRESS 0x50000889 /end MEASUREMENT
/begin MEASUREMENT GlbDa_aX "vehicle longitudinal acceleration" SWORD Acc 1 100 -32.76800 32.76700 FORMAT "%8.5" ECU_ADDRESS 0x60005054 /end MEASUREMENT
/begin MEASUREMENT GlbDa_aXFlt "vehicle longitudinal acceleration filtered" SWORD Acc 1 100 -32.76800 32.76700 FORMAT "%8.5" ECU_ADDRESS 0x60005052 /end MEASUREMENT
/begin MEASUREMENT GlbDa_cntrDrvgCyc "Counter for storing the global driving cycle happened during the lifecycle of the ECU" ULONG OneToOne 1 100 0.00 4294967295.00 FORMAT "%13.2" ECU_ADDRESS 0x60001BE4 /end MEASUREMENT
/begin MEASUREMENT GlbDa_cntrReIni "ReIni counter" UBYTE OneToOne 1 100 0.00 255.0 FORMAT "%5.1" ECU_ADDRESS 0x60006468 /end MEASUREMENT
/begin MEASUREMENT GlbDa_flgDrvgCycCntr "Flag for global driving cycle counter message when incremented by one unit" UBYTE B_TRUE 1 100 0.00 1.00000000000 BIT_MASK 0x1 FORMAT "%13.11" ECU_ADDRESS 0x6000646B /end MEASUREMENT
/begin MEASUREMENT GlbDa_lDst "total travelled distance" SLONG Length 1 100 -2147483648.00 2147483647.00 FORMAT "%13.2" ECU_ADDRESS 0x6000D72C /end MEASUREMENT
/begin MEASUREMENT GlbDa_lDstLstStored "last value of total distance in EEP" SLONG Length 1 100 -2147483648.00 2147483647.00 FORMAT "%13.2" ECU_ADDRESS 0x6000CD74 /end MEASUREMENT
/begin MEASUREMENT GlbDa_lDstLstStoredProtd "last value of total distance in EEP" SLONG Length 1 100 -2147483648.00 2147483647.00 FORMAT "%13.2" ECU_ADDRESS 0x60034768 /end MEASUREMENT
/begin MEASUREMENT GlbDa_lenTotDstDcyc "Total distance travelled in the current driving cycle" SLONG LengthKm1 1 100 -2147483648.00 2147483647.00 FORMAT "%13.2" ECU_ADDRESS 0x60001CF0 /end MEASUREMENT
/begin MEASUREMENT GlbDa_lenTotDstDcycHiResl "Total distance travelled in the current driving cycle with a high resolution" UWORD Length_10m 1 100 0.00 655350.0 FORMAT "%8.1" ECU_ADDRESS 0x60004CC0 /end MEASUREMENT
/begin MEASUREMENT GlbDa_lenTotDstPrevDcyc "Total distance travelled till the previous driving cycle" SLONG Length 1 100 -2147483648.00 2147483647.00 FORMAT "%13.2" ECU_ADDRESS 0x6000140C /end MEASUREMENT
/begin MEASUREMENT GlbDa_lTotDst "total distance since first start" SLONG Length 1 100 -2147483648.00 2147483647.00 FORMAT "%13.2" ECU_ADDRESS 0x50004D24 /end MEASUREMENT
/begin MEASUREMENT GlbDa_lTotDstProtd "total distance since first start" SLONG Length 1 100 -2147483648.00 2147483647.00 FORMAT "%13.2" ECU_ADDRESS 0x60034764 /end MEASUREMENT
/begin MEASUREMENT GlbDa_lWhlCirc "wheel circumference" SWORD Length_fine 1 100 -32.76800 32.76700 FORMAT "%8.5" ECU_ADDRESS 0x60005050 /end MEASUREMENT
/begin MEASUREMENT GlbDa_nrWhlSpdAryIdx1 "Number loop array index 1 for value of wheel speed" UBYTE OneToOne 1 100 0.00 255.0 FORMAT "%5.1" ECU_ADDRESS 0x60006467 /end MEASUREMENT
/begin MEASUREMENT GlbDa_nrWhlSpdAryIdx2 "Number loop array index 2 for value of wheel speed" UBYTE OneToOne 1 100 0.00 255.0 FORMAT "%5.1" ECU_ADDRESS 0x60006466 /end MEASUREMENT
/begin MEASUREMENT GlbDa_pEnv "environmental pressure" SWORD Pres_hPa 1 100 -32768.00 32767.00 FORMAT "%8.2" ECU_ADDRESS 0x6000504E /end MEASUREMENT
/begin MEASUREMENT GlbDa_rTrqTot "total ratio of the power train inclusive the differential and the converter torque ratio" SWORD TransR 1 100 -327.6800 327.6700 FORMAT "%8.4" ECU_ADDRESS 0x70002C58 /end MEASUREMENT
/begin MEASUREMENT GlbDa_rTrqTotWoConvRat "total ratio of the power train inclusive the differential ratio and without the converter torque ratio" SWORD TransR 1 100 -327.6800 327.6700 FORMAT "%8.4" ECU_ADDRESS 0x70002C5A /end MEASUREMENT
/begin MEASUREMENT GlbDa_stEepOrder "return value of EEP write function" UBYTE OneToOne 1 100 0.00 255.0 FORMAT "%5.1" ECU_ADDRESS 0x6000646A /end MEASUREMENT
/begin MEASUREMENT GlbDa_stEepWrite "state machine for direct write to EEP" UBYTE OneToOne 1 100 0.00 255.0 FORMAT "%5.1" ECU_ADDRESS 0x60006469 /end MEASUREMENT
/begin MEASUREMENT GlbDa_stTrqDem "contains highest prior function with torque demand" UWORD OneToOne 1 100 0.00 65535.00 FORMAT "%8.2" ECU_ADDRESS 0x6000E26E /end MEASUREMENT
/begin MEASUREMENT GlbDa_tEnv "environment temperature" SWORD Temp_Cels 1 100 -3549.940 3003.560 FORMAT "%8.3" ECU_ADDRESS 0x6000504C /end MEASUREMENT
/begin MEASUREMENT GlbDa_tIndAir "induction air temperature" SWORD Temp_Cels 1 100 -3549.940 3003.560 FORMAT "%8.3" ECU_ADDRESS 0x6000504A /end MEASUREMENT
/begin MEASUREMENT GlbDa_vAvrgWhlSpd "Average processed Wheel speeds." SWORD Vel 1 100 -327.6800 327.6700 FORMAT "%8.4" ECU_ADDRESS 0x60005046 /end MEASUREMENT
/begin MEASUREMENT GlbDa_vWhlSpdFlt "Filtered value of wheel speed." SWORD Vel 1 100 -327.6800 327.6700 FORMAT "%8.4" ARRAY_SIZE 4 ECU_ADDRESS 0x5000542A /end MEASUREMENT
/begin MEASUREMENT GlbDa_vWhlSpdFltAryVal "Value for Filtered value of wheel speed" SWORD Vel 1 100 -327.6800 327.6700 FORMAT "%8.4" ECU_ADDRESS 0x6000380A /end MEASUREMENT
/begin MEASUREMENT GlbDa_vX "vehicle longitudinal velocity" SWORD Vel 1 100 -327.6800 327.6700 FORMAT "%8.4" ECU_ADDRESS 0x60005044 /end MEASUREMENT
/begin MEASUREMENT GlbDa_vXFlt "vehicle velocity filtered" SWORD Vel 1 100 -327.6800 327.6700 FORMAT "%8.4" ECU_ADDRESS 0x60005042 /end MEASUREMENT
/begin MEASUREMENT GwECU_ctCGW1RngCnt_MP "Alive counter measurement point" UBYTE OneToOne 1 100 0.00 255.0 FORMAT "%5.1" ECU_ADDRESS 0x70008D43 /end MEASUREMENT
/begin MEASUREMENT GwECU_ctGwIMG1RngCnt_MP "IMG! Ring counter Mesuring Point" UBYTE OneToOne 1 100 0.00 3.000 FORMAT "%5.3" ECU_ADDRESS 0x70008D42 /end MEASUREMENT
/begin MEASUREMENT GwECU_ctGwIMG4RngCnt_MP "GWIMG4 Ring counter measuring point" UBYTE OneToOne 1 100 0.00 3.000 FORMAT "%5.3" ECU_ADDRESS 0x70008D41 /end MEASUREMENT
/begin MEASUREMENT GwECU_ctGwIMG5RngCnt_MP "Alive counter measurement point" UBYTE OneToOne 1 100 0.00 3.000 FORMAT "%5.3" ECU_ADDRESS 0x70008D40 /end MEASUREMENT
/begin MEASUREMENT GwECU_ctGwIMG6RngCnt "Indicated for Measurement point for GWIMG6 frame ring counter" UBYTE OneToOne 1 100 0.00 255.0 FORMAT "%5.1" ECU_ADDRESS 0x60006463 /end MEASUREMENT
/begin MEASUREMENT IKCtl_cntrCyl "cylinder counter of knock control" UBYTE dez 1 100 0.00 255.0 FORMAT "%5.1" ECU_ADDRESS 0x5000088B /end MEASUREMENT
/begin MEASUREMENT IKCtl_ctReIniGGKR "Local counter in GGKR for number of driving cycles (leave postdrive) to enable reinitialization" UBYTE OneToOne 1 100 0.00 255.0 FORMAT "%5.1" ECU_ADDRESS 0x6000E3B3 /end MEASUREMENT
/begin MEASUREMENT IKCtl_flgFilSwt "filter mean frequency is switched" UBYTE B_TRUE 1 100 0.00 1.00000000000 BIT_MASK 0x1 FORMAT "%13.11" ECU_ADDRESS 0x70000745 /end MEASUREMENT
/begin MEASUREMENT IKCtl_iaMeasWinBgn_s8 "beginning of measurement window in degree crank angle" SBYTE zw_sb_q0p75 1 100 -96.00 95.25 FORMAT "%5.2" ECU_ADDRESS 0x50005D88 /end MEASUREMENT
/begin MEASUREMENT IKCtl_iaMeasWinLngth_s8 "duration of measurement window in degree crank angle" SBYTE zw_sb_q0p75 1 100 -96.00 95.25 FORMAT "%5.2" ECU_ADDRESS 0x50005D89 /end MEASUREMENT
/begin MEASUREMENT IKCtl_iaMeasWin_s8 "IKC: effective retard ignition" SBYTE kw_q0p75 1 100 -96.00 95.25 FORMAT "%5.2" ECU_ADDRESS 0x50005D8A /end MEASUREMENT
/begin MEASUREMENT IKCtl_idxFilSwt "index of nmot-specific filter mean frequency" UBYTE dez 1 100 0.00 255.0 FORMAT "%5.1" ECU_ADDRESS 0x6000E425 /end MEASUREMENT
/begin MEASUREMENT IKCtl_IntglCh1_au32 "Integration value channel 1" ULONG spg_q7p629Em7_V_ms 1 100 0.00 3276.79999924 FORMAT "%13.8" ARRAY_SIZE 4 ECU_ADDRESS 0x50000508 /end MEASUREMENT
/begin MEASUREMENT IKCtl_nUsdKnKSnsr "Number of actual used knock sensors" UBYTE dez 1 100 1.000 4.000 FORMAT "%5.3" ECU_ADDRESS 0x6000A03C /end MEASUREMENT
/begin MEASUREMENT IKCtl_stDgnsSnsrReq "knock control: knock sensor diagnosis request" UBYTE dez 1 100 0.00 255.0 FORMAT "%5.1" ECU_ADDRESS 0x600006F9 /end MEASUREMENT
/begin MEASUREMENT IKCtl_stVldnSnsrSig "activation of knock control functions" UBYTE dez 1 100 0.00 255.0 FORMAT "%5.1" ECU_ADDRESS 0x50000890 /end MEASUREMENT
/begin MEASUREMENT InjSys_facPc "factor mixture precontrol" UWORD fak_uw_b64 1 100 0.00 63.99902 FORMAT "%8.5" ECU_ADDRESS 0x70001CEA /end MEASUREMENT
/begin MEASUREMENT InjSys_ratFuM "Relative fuel mass" UWORD rel_uw_b3072 1 100 0.00 3071.953 FORMAT "%8.3" ECU_ADDRESS 0x60000524 /end MEASUREMENT
/begin MEASUREMENT InjSys_ratFuMBnk "Bank specific relative fuel mass" UWORD rel_uw_b3072 1 100 0.00 3071.953 FORMAT "%8.3" ECU_ADDRESS 0x70001CE8 /end MEASUREMENT
/begin MEASUREMENT InjSys_ratFuMBnkLong "Bank specific relative fuel mass long" ULONG rel_uw_b3072 1 100 0.00 201326591.953 FORMAT "%13.3" ECU_ADDRESS 0x70001DB4 /end MEASUREMENT
/begin MEASUREMENT InjSys_ratFuMTot "relative fuel mass total" UWORD rel_uw_b3072 1 100 0.00 3071.953 FORMAT "%8.3" ECU_ADDRESS 0x60000526 /end MEASUREMENT
/begin MEASUREMENT InjSys_ratPrdcAirLamDes "relative air mass for computation of desired lambda" UWORD rel_uw_q0p0234 1 100 0.00 1535.977 FORMAT "%8.3" ECU_ADDRESS 0x60000532 /end MEASUREMENT
/begin MEASUREMENT krinterg_l "integration value channel 1-3" ULONG spg_q7p629Em7_V_ms 1 100 0.00 3276.79999924 FORMAT "%13.8" ARRAY_SIZE 1 ECU_ADDRESS 0x50000498 /end MEASUREMENT
/begin MEASUREMENT msndkoos_w "normed air mass flow for desired value of throttle blade" UWORD m_uw_b6553p5 1 100 0.00 6553.500 FORMAT "%8.3" ECU_ADDRESS 0x7000298A /end MEASUREMENT
/begin MEASUREMENT msndks_w_msg "normed set air mass flow through throttling valve" UWORD m_uw_b6553p5 1 100 0.00 6553.500 FORMAT "%8.3" ECU_ADDRESS 0x7000299C /end MEASUREMENT
/begin MEASUREMENT rkmeeff_w_msg "Mean value of effective relative (incl. real cylinder cut-off step) injected fuel mass between two banks (STERVK)" UWORD rel_uw_b3072 1 100 0.00 3071.953 FORMAT "%8.3" ECU_ADDRESS 0x60000E26 /end MEASUREMENT
/begin MEASUREMENT rkme_w_msg "Mean value of relative injected fuel mass between two banks (STERVK)" UWORD rel_uw_b3072 1 100 0.00 3071.953 FORMAT "%8.3" ECU_ADDRESS 0x60000E28 /end MEASUREMENT
/begin MEASUREMENT rkvmeeff_w_msg "Mean value of effective relative (including real cylinder cut-off step) volumetric injected fuel mass between two banks" UWORD rel_uw_b3072 1 100 0.00 3071.953 FORMAT "%8.3" ECU_ADDRESS 0x60000E24 /end MEASUREMENT
/begin MEASUREMENT rk_l_msg "Relative fuel mass (long)" ULONG rel_uw_b3072 1 100 0.00 201326591.953 FORMAT "%13.3" ECU_ADDRESS 0x500005E4 /end MEASUREMENT
/begin MEASUREMENT rlsnw_w "selection between rlsol_w and rlshk for map KFNW" UWORD rel_uw_q0p0234 1 100 0.00 1535.977 FORMAT "%8.3" ECU_ADDRESS 0x6000380C /end MEASUREMENT
/begin MEASUREMENT stkrfmf_tmp "index of nmot-specific filter mean frequency" UBYTE dez 1 100 0.00 255.0 FORMAT "%5.1" ECU_ADDRESS 0x6000E3C1 /end MEASUREMENT
/begin MEASUREMENT tmp_misra "Temp variable to get the return value of the DSM check." UWORD OneToOne 1 100 0.00 65535.00 FORMAT "%8.2" ECU_ADDRESS 0x700019A6 /end MEASUREMENT
/begin MEASUREMENT umsnmsok_w "Conversion of standardized mass flow into mass flow at throttle blade without KLAF-correction" UWORD fak_uw_b8 1 100 0.00 7.999878 FORMAT "%8.6" ECU_ADDRESS 0x7000298C /end MEASUREMENT
/begin MEASUREMENT umsnmsug_w "Conversion of standardized mass flow into mass flow at throttle blade (UGD)" UWORD fak_uw_b8 1 100 0.00 7.999878 FORMAT "%8.6" ECU_ADDRESS 0x7000298E /end MEASUREMENT
/begin MEASUREMENT wdkhfu_w "throttle <) calculated from unthrottled mass flow of main charging sensor" UWORD rel_uw_b100 1 100 0.00 99.99847 FORMAT "%8.5" ECU_ADDRESS 0x70002990 /end MEASUREMENT
/begin MEASUREMENT wdkhf_w_msg "throttle angle calculated from main charging sensor" UWORD rel_uw_b100 1 100 0.00 99.99847 FORMAT "%8.5" ECU_ADDRESS 0x60000DF0 /end MEASUREMENT
/begin MEASUREMENT wdkobugs_w "nominal throttle angle from torque structure not imited by unthrottled angle" UWORD rel_uw_b100 1 100 0.00 99.99847 FORMAT "%8.5" ECU_ADDRESS 0x70002992 /end MEASUREMENT
/begin MEASUREMENT wdkoufs_w "desired throttle valve angle without WOT filter" UWORD rel_uw_b100 1 100 0.00 99.99847 FORMAT "%8.5" ECU_ADDRESS 0x70002994 /end MEASUREMENT
/begin MEASUREMENT wdkrohs_w_msg "desired throttle position" UWORD rel_uw_b100 1 100 0.00 99.99847 FORMAT "%8.5" ECU_ADDRESS 0x60000DEC /end MEASUREMENT
/begin MEASUREMENT wdksba2_w "Throttle-valve target angle after limiting, value from computing schedule n-2" UWORD rel_uw_b100 1 100 0.00 99.99847 FORMAT "%8.5" ECU_ADDRESS 0x60000C2C /end MEASUREMENT
/begin MEASUREMENT wdksba_w "Throttle-valve target angle after limiting, value from computing schedule n-1" UWORD rel_uw_b100 1 100 0.00 99.99847 FORMAT "%8.5" ECU_ADDRESS 0x60000C2A /end MEASUREMENT
/begin MEASUREMENT wdksb_w "Throttle-valve target angle after limiting" UWORD rel_uw_b100 1 100 0.00 99.99847 FORMAT "%8.5" ECU_ADDRESS 0x60000C28 /end MEASUREMENT
/begin MEASUREMENT wdksgvin_w "nominal throttle valve angle - entrance in low pass filter" UWORD rel_uw_b100 1 100 0.00 99.99847 FORMAT "%8.5" ECU_ADDRESS 0x60000C26 /end MEASUREMENT
/begin MEASUREMENT wdksgv_w_msg "desired throttle blade before application interface( filtered)" UWORD rel_uw_b100 1 100 0.00 99.99847 FORMAT "%8.5" ECU_ADDRESS 0x700029AA /end MEASUREMENT
/begin MEASUREMENT wdksof_w_msg "nominal throttle valve angle without median filter" UWORD rel_uw_b100 1 100 0.00 99.99847 FORMAT "%8.5" ECU_ADDRESS 0x700029AC /end MEASUREMENT
/begin MEASUREMENT wdkspverz_w "Praedizierter Drosselklappen-Sollwinkel nach der Verzögerung" UWORD rel_uw_b100 1 100 0.00 99.99847 FORMAT "%8.5" ECU_ADDRESS 0x70002996 /end MEASUREMENT
/begin MEASUREMENT wdksp_w_msg "predicted desired throttle angle" UWORD rel_uw_b100 1 100 0.00 99.99847 FORMAT "%8.5" ECU_ADDRESS 0x60000DE6 /end MEASUREMENT
/begin MEASUREMENT wdks_msg "desired throttle angle w.r.t. to lower mechanical stop" UBYTE relDK_ub_b100 1 100 0.00 100.0 FORMAT "%5.1" ECU_ADDRESS 0x700029AF /end MEASUREMENT
/begin MEASUREMENT wdks_w_msg "desired throttle angle w.r.t. to lower mechanical stop" UWORD relDK_uw_b100 1 100 0.00 100.0000 FORMAT "%8.4" ECU_ADDRESS 0x60000DEA /end MEASUREMENT
/begin MEASUREMENT wdkugd_w_msg "Throttle valve angle during which 95% charge is reached" UWORD rel_uw_b100 1 100 0.00 99.99847 FORMAT "%8.5" ECU_ADDRESS 0x60000B08 /end MEASUREMENT
/begin MEASUREMENT wdkugtn_w_msg "throttle valve angle at which the 95 charge is through minimum tolerance" UWORD rel_uw_b100 1 100 0.00 99.99847 FORMAT "%8.5" ECU_ADDRESS 0x60000DE4 /end MEASUREMENT
/begin MEASUREMENT wdkugtx_w_msg "throttle valve angle at which the 95% charge is through maximum tolerance" UWORD rel_uw_b100 1 100 0.00 99.99847 FORMAT "%8.5" ECU_ADDRESS 0x60000DE2 /end MEASUREMENT
/begin MEASUREMENT wgvoma_w "Average value: gas exch. valve opens exhaust" SWORD kw_q0p0156 1 100 -512.0000 511.9844 FORMAT "%8.4" ECU_ADDRESS 0x60004DCE /end MEASUREMENT
/begin MEASUREMENT wgvome_w "Center value angle gas change valve opens intake" SWORD kw_q0p0156 1 100 -512.0000 511.9844 FORMAT "%8.4" ECU_ADDRESS 0x60004DCC /end MEASUREMENT
/begin MEASUREMENT wgvose_w "Des. angle: gas exch. valve opens intake" SWORD kw_q0p0156 1 100 -512.0000 511.9844 FORMAT "%8.4" ECU_ADDRESS 0x60004DCA /end MEASUREMENT
/begin MEASUREMENT wgvshsma_w_msg "Av.value: des. angle gas exch. valve closes exhaust hom.mode" SWORD kw_q0p0156 1 100 -512.0000 511.9844 FORMAT "%8.4" ECU_ADDRESS 0x60004DC8 /end MEASUREMENT
/begin MEASUREMENT wgvsma_w "Center value angle gas change value closes outlet" SWORD kw_q0p0156 1 100 -512.0000 511.9844 FORMAT "%8.4" ECU_ADDRESS 0x60004DC6 /end MEASUREMENT
/begin MEASUREMENT wgvsme_w "Center value angle gas change valve closes intake" SWORD kw_q0p0156 1 100 -512.0000 511.9844 FORMAT "%8.4" ECU_ADDRESS 0x60004DC4 /end MEASUREMENT
/begin MEASUREMENT wgvssa_w "Des. angle: gas exch. valve closes exhaust" SWORD kw_q0p0156 1 100 -512.0000 511.9844 FORMAT "%8.4" ECU_ADDRESS 0x60004DC2 /end MEASUREMENT
/begin MEASUREMENT wgvsse_w "Des. angle: gas exch. valve closes intake" SWORD kw_q0p0156 1 100 -512.0000 511.9844 FORMAT "%8.4" ECU_ADDRESS 0x60004DC0 /end MEASUREMENT
/begin MEASUREMENT wgvsvgesma_w_msg "Average value desired angle outlet gas exchange valve closes for VHE big cam profile" SWORD kw_q0p0156 1 100 -512.0000 511.9844 FORMAT "%8.4" ECU_ADDRESS 0x60004DBE /end MEASUREMENT
/begin MEASUREMENT wgvsvkesma_w_msg "Average value desired angle outlet gas exchange valve closes for VHE small cam profile" SWORD kw_q0p0156 1 100 -512.0000 511.9844 FORMAT "%8.4" ECU_ADDRESS 0x60004DBC /end MEASUREMENT
/begin MEASUREMENT wmfa_tmp "beginning of measurement window in degree crank angle" SBYTE zw_sb_q0p75 1 100 -96.00 95.25 FORMAT "%5.2" ECU_ADDRESS 0x6000E3C2 /end MEASUREMENT
/begin MEASUREMENT wmfl_tmp "duration of measurement window in degree crank angle" SBYTE zw_sb_q0p75 1 100 -96.00 95.25 FORMAT "%5.2" ECU_ADDRESS 0x6000E3C3 /end MEASUREMENT
/begin MEASUREMENT zkrksdf "counter knock control: enable knock sensors short circuit detection" UBYTE dez 1 100 0.00 255.0 FORMAT "%5.1" ECU_ADDRESS 0x5000087B /end MEASUREMENT
/begin MEASUREMENT zzylkr_dia "cylinder counter of knock control for diagnosis" UBYTE dez 1 100 0.00 255.0 FORMAT "%5.1" ECU_ADDRESS 0x5000087E /end MEASUREMENT
/begin MEASUREMENT _uNeutTmp "Analog sensor1 voltage" SWORD Volt 1 100 -6553.600 6553.400 FORMAT "%8.3" ECU_ADDRESS 0x700019A4 /end MEASUREMENT
/begin FUNCTION Fan_DD "4.12.0    Fan Device Driver"
 /begin DEF_CHARACTERISTIC FanDig0_ATS.LimitTypeMsk_C FanDig0_ATS.CnvNorm_C FanDig0_ATS.LowLim_C FanDig0_ATS.UpLim_C FanDig0_ATS.CnvFac_C FanDig0_ATS.CnvOfs_C FanDig0_ATS.DfltVal_C FanDig1_ATS.LimitTypeMsk_C FanDig1_ATS.CnvNorm_C FanDig1_ATS.LowLim_C FanDig1_ATS.UpLim_C FanDig1_ATS.CnvFac_C FanDig1_ATS.CnvOfs_C FanDig1_ATS.DfltVal_C Fan_DigOut0.tiBtwTstSCB_C Fan_DigOut0.tiBtwTstOT_C Fan_DigOut0.numTstMax_C Fan_DigOut1.tiBtwTstSCB_C Fan_DigOut1.tiBtwTstOT_C Fan_DigOut1.numTstMax_C Fan_rHysHi_CA Fan_rHysLo_CA Fan_stPsDiaDisblDIO_CA Fan_stPsDisDIO_CA /end DEF_CHARACTERISTIC
 /begin IN_MEASUREMENT DevLib_stPwrStgEnaCond /end IN_MEASUREMENT
 /begin OUT_MEASUREMENT Fan_r Fan_r2 Fan_stPs /end OUT_MEASUREMENT
 FUNCTION_VERSION "4.12.0" /end FUNCTION
/begin FUNCTION FEL2InfoTyp "101.0.0   Adapter tank leak diagnosis to InfoType" FUNCTION_VERSION "101.0.0" /end FUNCTION
/begin FUNCTION FUEDK "28.10.1   Charge control (calculation of nominal throttle-valve angle)"
 /begin DEF_CHARACTERISTIC ChrCtl_facTCorrnHfmPlst_T ChrCtl_ratThrAgLimnAvdHfmPlst_M CWFUEDK FKLAFUGD FPWDKAPP KFWDKMSMXN KFWDKMSNVP NMOTCVWDK OFMSNWDKHF TAVDKMNDK TFWDKPSPV VPSRSVDRDU WDKSAPP WDKSOFS /end DEF_CHARACTERISTIC
 /begin REF_CHARACTERISTIC FKVDVP OFMSNDKTN OFMSNDKTX VPSRVDUGD /end REF_CHARACTERISTIC
 /begin IN_MEASUREMENT APP_r B_cwdk_msg B_fpwdkap_msg B_msdkhfsg_msg B_msudksom_msg B_tfwdksom_msg B_vpdkugd_msg B_wdksap_msg B_wdksg_msg CEngDsT_t cvwdk_msg dfuelsan_w_msg dkpsrmh_w_msg EngStrt_bFrstStrtEnd EngStrt_bStrtEnd Epm_nEng Epm_nEngLRes Epm_stSpd ftpavdn_w_msg ftpavdx_w_msg ftpavd_w_msg ftpvd_w_msg IntkAirT_tIntkMnfld IntkAirT_tThrVlvUs msdkhfs_w_msg msdkmx_w_msg msdks_w_msg msdkugd_w_msg msdkugtn_w_msg msdkugtx_w_msg msdstats_w_msg msudksom_w_msg ofmsndk_w_msg psrdkugd_w_msg psrsldr_w_msg psr_w_msg PthSet_flgCritTqIncPhd pvd_w_msg SyC_stSub tfwdksom_w_msg ummsnms_w_msg vpsrvdb_w_msg vpsrvdk_w_msg wdkmsmx_w_msg wnwve_w_msg wnwvu_w_msg /end IN_MEASUREMENT
 /begin OUT_MEASUREMENT B_dkstrl_msg B_fgdkabgs_msg B_msdksg_msg B_wdkap_msg B_wdkhfg_msg B_wdkhfu_msg B_wdksugd_msg ChrCtl_agDeltaTqToStrt msndks_w_msg wdkhf_w_msg wdkrohs_w_msg wdksgv_w_msg wdksof_w_msg wdkugd_w_msg wdkugtn_w_msg wdkugtx_w_msg /end OUT_MEASUREMENT
 /begin LOC_MEASUREMENT B_dwdksugd B_dwdkugdf ChrCtl_agCamsftLimnHfmPlst ChrCtl_nEngHfmPlst ChrCtl_ratThrVlvWoMdnFilLimd ChtCtl_ratThrAgLimnAvdHfmPlst dwdksumx_w dwdksuofna1_w dwdksuofna2_w dwdksuofnasum_w dwdksuof_w msndkoos_w umsnmsok_w umsnmsug_w wdkhfu_w wdkobugs_w wdkoufs_w /end LOC_MEASUREMENT
 FUNCTION_VERSION "28.10.1" /end FUNCTION
/begin FUNCTION FUEDKSA "11.15.0   Influence of air charge by throttle blade, processing throttle-valve angle" /begin DEF_CHARACTERISTIC DKNOTBEGR DRLSOLMF TVWDKVFZGMX WDKSWE /end DEF_CHARACTERISTIC
 /begin IN_MEASUREMENT B_ll_msg Epm_nEng rlfgks_w_msg SyC_stSub ThrVlv_flgSngSensErrB1 tvwdkprs_msg VehV_v wdkrohs_w_msg /end IN_MEASUREMENT
 /begin OUT_MEASUREMENT wdksp_w_msg wdks_msg wdks_w_msg /end OUT_MEASUREMENT
 /begin LOC_MEASUREMENT drlsolmf_w wdksba2_w wdksba_w wdksb_w wdksgvin_w wdkspverz_w /end LOC_MEASUREMENT
 FUNCTION_VERSION "11.15.0" /end FUNCTION
/begin FUNCTION GbxECU_Co "118.2.0_6SAACoordinator for received CAN messages gearbox"
 /begin DEF_CHARACTERISTIC Com_rTarPlly_C Com_stConvClth_C Com_stConvrClth_T Com_stLCClth_C Com_stLuckUpOpn_C Com_swtGbxConvClth_C Com_TqTMClutch_C_RP GBX_CONVCLTH_CLSDC_RP GBX_CONVCLTH_CTL_C_RP GBX_CONVCLTH_ERROR_C_RP GBX_CONVCLTH_OPN_C_RP /end DEF_CHARACTERISTIC
 /begin IN_MEASUREMENT Com_rConvSlip Com_rTrsmTotFild Com_stFwdRvsCluInfo Com_stLCZone Gbx_stPNPos Gbx_trqOilPmpLos PT_stTraType /end IN_MEASUREMENT
 /begin OUT_MEASUREMENT Com_rTarPlly Com_stConvSlip Gbx_bLuckUpOpn Gbx_stConvClth Gbx_trqConvLos /end OUT_MEASUREMENT
 FUNCTION_VERSION "118.2.0_6SAA" /end FUNCTION
/begin FUNCTION GbxECU_EAT1 "6.2.0_6SAAReception process for the CAN frame EAT1"
 /begin DEF_CHARACTERISTIC Com_ctCRingEAT1_C Com_dEAT1MaxDiff_C Com_dEAT1MaxPer_C Com_numCsumEAT1_C Com_rConvBoostErr_C Com_rConvBoost_C Com_stCVTEngmtInfo_C Com_stIdleStrtStopDispFct_C Com_swtEAT1MonEna_C /end DEF_CHARACTERISTIC
 /begin IN_MEASUREMENT Com_ctCRingEAT1 Com_numCsumEAT1 Com_rConvBoostRaw Com_stCVTEngmtInfo Com_stFrmRxEna Com_stIdleStrtStopDispFct Com_stMon Com_stPreStop Com_stTranStop /end IN_MEASUREMENT
 /begin OUT_MEASUREMENT Com_rConvBoost Com_stEAT1Mon /end OUT_MEASUREMENT
 /begin LOC_MEASUREMENT GbxECU_ctEAT1RngCnt_MP /end LOC_MEASUREMENT
 FUNCTION_VERSION "6.2.0_6SAA" /end FUNCTION
/begin FUNCTION GbxECU_EAT10 "5.2.0_6SAAReception process for the CAN frame EAT10"
 /begin DEF_CHARACTERISTIC Com_dEAT10MaxDiff_C Com_dEAT10MaxPer_C Com_rTrsmTotFild_C Com_swtEAT10MonEna_C Com_vVehTcu_C /end DEF_CHARACTERISTIC
 /begin IN_MEASUREMENT Com_ctCRingEAT10 Com_numCsumEAT10 Com_rTrsmTotFild Com_stFrmRxEna Com_stMon Com_vVehTcu /end IN_MEASUREMENT
 /begin OUT_MEASUREMENT Com_stEAT10Mon /end OUT_MEASUREMENT
 /begin LOC_MEASUREMENT GbxECU_ctEAT10RngCnt_MP /end LOC_MEASUREMENT
 FUNCTION_VERSION "5.2.0_6SAA" /end FUNCTION
/begin FUNCTION GbxECU_EAT11 "3.2.0_6SAAReception process for the CAN frame EAT11" /begin DEF_CHARACTERISTIC Com_dEAT11MaxDiff_C Com_dEAT11MaxPer_C /end DEF_CHARACTERISTIC
 /begin IN_MEASUREMENT Com_ctCRingEAT11 Com_numCsumEAT11 Com_stFrmRxEna Com_stMon Com_vVehSpdCVTCtrl /end IN_MEASUREMENT
 /begin LOC_MEASUREMENT GbxECU_ctEAT11RngCnt_MP /end LOC_MEASUREMENT
 FUNCTION_VERSION "3.2.0_6SAA" /end FUNCTION
/begin FUNCTION GbxECU_EAT12 "2.3.0_6SAAReception process for the CAN frame EAT12"
 /begin DEF_CHARACTERISTIC Com_dEAT12MaxDiff_C Com_dEAT12MaxPer_C Com_dEAT12SigSel_C Com_tiEAT12BusOffTOutDly_C Com_tiEAT12RingCntChkSumDly_C /end DEF_CHARACTERISTIC
 /begin IN_MEASUREMENT Com_ctCRingEAT12 Com_numCsumEAT12 Com_stCANANoBusOff Com_stCfmdNPosn Com_stCfmdPPosnFCAN Com_stFrmRxEna Com_stMon Com_stNotTxDrvgFFCAN /end IN_MEASUREMENT
 /begin OUT_MEASUREMENT Com_stEAT12RingCntChkSumErr Com_stEAT12TOutBusOffErr Com_stRxEAT12ChkSumOk Com_stRxEAT12Deb Com_stRxEAT12RingCntOk /end OUT_MEASUREMENT
 /begin LOC_MEASUREMENT GbxECU_ctEAT12RngCnt_MP /end LOC_MEASUREMENT
 FUNCTION_VERSION "2.3.0_6SAA" /end FUNCTION
/begin FUNCTION GbxECU_EAT13 "3.4.0_6SAAReception process for the CAN frame EAT13"
 /begin DEF_CHARACTERISTIC Com_dEAT13MaxDiff_C Com_dEAT13MaxPer_C Com_dEAT13SigSel_C Com_tiEAT13BusOffTOutDly_C Com_tiEAT13RingCntChkSumDly_C /end DEF_CHARACTERISTIC
 /begin IN_MEASUREMENT Com_ctCRingEAT13 Com_numCsumEAT13 Com_stCANBNoBusOff Com_stCfmdPPosnPTCAN Com_stFrmRxEna Com_stGearPPosnReqPTCAN Com_stMon Com_stNotTxDrvgFPTCAN /end IN_MEASUREMENT
 /begin OUT_MEASUREMENT Com_stEAT13RingCntChkSumErr Com_stEAT13TOutBusOffErr Com_stRxEAT13ChkSumOk Com_stRxEAT13Deb Com_stRxEAT13RingCntOk /end OUT_MEASUREMENT
 /begin LOC_MEASUREMENT GbxECU_ctEAT13RngCnt_MP /end LOC_MEASUREMENT
 FUNCTION_VERSION "3.4.0_6SAA" /end FUNCTION
/begin FUNCTION GbxECU_EAT2 "6.3.0_6SAAReception process for the CAN frame EAT2"
 /begin DEF_CHARACTERISTIC Com_ctCRingEAT2_C Com_dEAT2MaxDiff_C Com_dEAT2MaxPer_C Com_numCsumEAT2_C Com_swtEAT2MonEna_C /end DEF_CHARACTERISTIC
 /begin IN_MEASUREMENT Com_ctCRingEAT2 Com_flgExecdManMod Com_numCsumEAT2 Com_stFrmRxEna Com_stLCZone Com_stMon Com_stVSAInh /end IN_MEASUREMENT
 /begin OUT_MEASUREMENT Com_stEAT2Mon /end OUT_MEASUREMENT
 /begin LOC_MEASUREMENT GbxECU_ctEAT2RngCnt_MP /end LOC_MEASUREMENT
 FUNCTION_VERSION "6.3.0_6SAA" /end FUNCTION
/begin FUNCTION GbxECU_EAT4 "13.3.0_6SAAReception process for the CAN frame EAT4"
 /begin DEF_CHARACTERISTIC Com_bTSCIntvSlowTrsmFail_C Com_bTSCIntvSlow_C Com_ctCRingEAT4_C Com_dEAT4MaxDiff_C Com_dEAT4MaxPer_C Com_ErrDeb_FailSafeA_TmrEAT4_C Com_numCsumEAT4_C Com_swtEAT4MonEna_C Com_tiEAT4PreErr_C Gbx_trqOilPmpLos_C Gbx_trqTSCIntvSlowTrsmFail_C Gbx_trqTSCIntvSlow_FailSafeA_C Gbx_trqTSCIntvSlow_FailSafeB_C /end DEF_CHARACTERISTIC
 /begin IN_MEASUREMENT Com_bTSCIntvSlow Com_ctCRingEAT4 Com_numCsumEAT4 Com_stFrmRxEna Com_stMon Com_stTMTqDwnReq Com_stTrsmFailMod Com_trqEATReq Gbx_trqOilPmpLos Gbx_trqTSCIntvSlow /end IN_MEASUREMENT
 /begin OUT_MEASUREMENT Com_bTSCIntvFast Com_stComEAT4 Com_stEAT4Mon Gbx_trqTSCIntvFast /end OUT_MEASUREMENT
 /begin LOC_MEASUREMENT Com_tiEAT4PreErr_MP GbxECU_ctEAT4RngCnt_MP /end LOC_MEASUREMENT
 FUNCTION_VERSION "13.3.0_6SAA" /end FUNCTION
/begin FUNCTION GbxECU_EAT6 "5.3.0_6SAAReception process for the CAN frame EAT6"
 /begin DEF_CHARACTERISTIC Com_dEAT6MaxDiff_C Com_dEAT6MaxPer_C Com_dEAT6SigSel_C Com_swtEAT6MonEna_C /end DEF_CHARACTERISTIC
 /begin IN_MEASUREMENT Com_ctCRingEAT6 Com_numCsumEAT6 Com_stATFTVal Com_stFrmRxEna Com_stMon Gbx_tOilConv /end IN_MEASUREMENT
 /begin OUT_MEASUREMENT Com_stEAT6Mon /end OUT_MEASUREMENT
 /begin LOC_MEASUREMENT GbxECU_ctEAT6RngCnt_MP /end LOC_MEASUREMENT
 FUNCTION_VERSION "5.3.0_6SAA" /end FUNCTION
/begin FUNCTION GbxECU_EAT7 "10.5.0_6SAAReception process for the CAN frame EAT7"
 /begin DEF_CHARACTERISTIC Com_ctCRingEAT7_C Com_dEAT7MaxDiff_C Com_dEAT7MaxPer_C Com_ErrDeb_FailSafeA_TmrEAT7_C Com_nTrbn_C Com_numCsumEAT7_C Com_rTarPllyEAT7_C Com_swtEAT7MonEna_C Gbx_nIdlDesTrsmFail_C Gbx_nIdlDes_FailSafeA_C Gbx_nIdlDes_FailSafeB_C Gbx_nMaxEngFcoTrsmFail_C Gbx_nMaxEngFco_FailSafeA_C Gbx_nMaxEngFco_FailSafeB_C Gbx_nMaxEngTrqLimTrsmFail_C Gbx_nMaxEngTrqLim_FailSafeA_C Gbx_nMaxEngTrqLim_FailSafeB_C /end DEF_CHARACTERISTIC
 /begin IN_MEASUREMENT Com_ctCRingEAT7 Com_flgACCutDurgAtCvt Com_nIdlDes Com_nTrbn Com_numCsumEAT7 Com_rTarPllyEAT7 Com_stAmbLmpPrms Com_stFrmRxEna Com_stHvyDecelFlg Com_stMon Com_stShiftDwnReco Com_stShiftUpReco Com_stTrsmFailMod Com_stVINWrClrDone Gbx_nMaxEngFco Gbx_nMaxEngTrqLim /end IN_MEASUREMENT
 /begin OUT_MEASUREMENT Com_stEAT7Mon Gbx_nIdlDes Gbx_nTrbn /end OUT_MEASUREMENT
 /begin LOC_MEASUREMENT GbxECU_ctEAT7RngCnt_MP /end LOC_MEASUREMENT
 FUNCTION_VERSION "10.5.0_6SAA" /end FUNCTION
/begin FUNCTION GbxECU_EAT8 "6.3.0_6SAAReception process for the CAN frame EAT8"
 /begin DEF_CHARACTERISTIC Com_dEAT8MaxDiff_C Com_dEAT8MaxPer_C Com_rConvSlipHiLimHysHi_C Com_rConvSlipHiLimHysLo_C Com_rConvSlipLoLimHysHi_C Com_rConvSlipLoLimHysLo_C Com_rTrqCnvBoostDef_C Com_swtEAT8MonEna_C Com_swtPTRatTrqCnv_C Com_tiEngTrq_CUR Com_trqBoost_CUR /end DEF_CHARACTERISTIC
 /begin IN_MEASUREMENT ActMod_trqCrSWoDstC Com_ctCRingEAT8 Com_flgCvtFcoPrms Com_numCsumEAT8 Com_numCvtGearShiftMap Com_rConvBoost Com_rConvSlip Com_stATMILReqEAT8 Com_stCvtPosnPrms Com_stFrmRxEna Com_stFwdRvsCluInfo Com_stGearChgCtrlMod Com_stLCInfo Com_stMon Com_stVehSpdSensErr CoVeh_trqAcs Gbx_stGearLvr /end IN_MEASUREMENT
 /begin OUT_MEASUREMENT Com_flgAntiJerkCnvrSlipEna Com_flgAntiJerkCnvrSlipEnaNoDly Com_rTrqCnvBoost Com_stAntiJerkCtrlInhb Com_stEAT8Mon Com_trqEngTrq /end OUT_MEASUREMENT
 /begin LOC_MEASUREMENT GbxECU_ctEAT8RngCnt_MP /end LOC_MEASUREMENT
 FUNCTION_VERSION "6.3.0_6SAA" /end FUNCTION
/begin FUNCTION GbxECU_EATA "8.5.0_6SAAReception process for the CAN frame EATA"
 /begin DEF_CHARACTERISTIC Com_dEATAMaxDiff_C Com_dEATAMaxPer_C Com_dEATASigSel_C Com_swtEATAMonEna_C /end DEF_CHARACTERISTIC
 /begin IN_MEASUREMENT Com_ctCRingEATA Com_lTotRingEATA Com_nTrsmMaiShaft Com_numCsumEATA Com_stFrmRxEna Com_stMon Com_vVehCtl Com_vVehInstPnl /end IN_MEASUREMENT
 /begin OUT_MEASUREMENT Com_flgEATANorm Com_stEATAMon /end OUT_MEASUREMENT
 /begin LOC_MEASUREMENT GbxECU_ctEATARngCnt_MP /end LOC_MEASUREMENT
 FUNCTION_VERSION "8.5.0_6SAA" /end FUNCTION
/begin FUNCTION GbxECU_EATB "16.1.0_1.1.0Reception process for the CAN frame EATB"
 /begin DEF_CHARACTERISTIC Com_dEATBMaxDiff_C Com_dEATBMaxPer_C Com_rTarInfo_C Com_stATFailr_C Com_stCVTDsplGear_C Com_stCVTFailrInfo_C Com_stCVTFailr_C Com_stCVTShiftActv_C Com_stDFailrIndcn_C Com_stEATBCrkMask_C Com_stMilLtgReq_C Com_stMissSnsrFlg_C Com_stMLtgInfo_C Com_stNoShftSel_C Com_stShftInNeutr_C Com_stShftInPark_C Com_stShftSel0_C Com_stShftSel1_C Com_stShftSel2_C Com_stShftSel3_C Com_stShftSel4_C Com_stShftSel5_C Com_stShiftPosnIndcn_C Com_stSpdSnsrFailr_C Com_stVehSpdSnsr_C Com_swtCrkCdn_C Com_swtEATBMonEna_C Com_swtShiftPosn_C Com_tiCanDebTmr_C CVT_SHFT_IN_D_C CVT_SHFT_IN_L_C CVT_SHFT_IN_NEUTRAL_C CVT_SHFT_IN_NO_C CVT_SHFT_IN_PARKING_C CVT_SHFT_IN_REVERSE_C CVT_SHFT_IN_S_C /end DEF_CHARACTERISTIC
 /begin IN_MEASUREMENT Com_ctCRingEATB Com_numCsumEATB Com_rCVTAct Com_rTarInfo Com_stATFailr Com_stCANANoBusOff Com_stCVTDsplGear Com_stCVTFailr Com_stCVTFailrInfo Com_stCVTShiftActv Com_stDFailrIndcn Com_stFrmRxEna Com_stFwdRvsCluInfo Com_stMilLtgReq Com_stMissSnsrFlg Com_stMLtgInfo Com_stMon Com_stShftInD Com_stShftInL Com_stShftInNeutr Com_stShftInPark Com_stShftInRev Com_stShftInS Com_stShiftPosnIndcnRaw Com_stSpdSnsrFailr Com_stVehSpdSnsr Gbx_stPNPos SyC_ctPostDrvLeave SyC_stSub T15_st /end IN_MEASUREMENT
 /begin OUT_MEASUREMENT Com_flgAutCrkActv Com_flgCVTPNPos Com_flgManCrkFCANEna Com_stCanErr Com_stCrkCdn Com_stCvtShiftNeut Com_stCvtShiftRvs Com_stEATBByte0Info Com_stEATBMon Com_stLowVoltFCan Com_stLowVoltPCan Com_stNeutInfo Com_stRxEATBChkSumOk Com_stRxEATBDeb Com_stRxEATBRingCntOk Com_stShftNP Com_stShftRev Com_stShiftPosnIndcn Gbx_stGearLvr /end OUT_MEASUREMENT
 /begin LOC_MEASUREMENT Com_ctReIni10msEATB Com_flgDFCSrv7VisClrInProgs Com_stCanChkFlg_MP Com_stCrkCdn_MP Com_tiCanChkTmr_MP GbxECU_ctEATBRngCnt_MP /end LOC_MEASUREMENT
 FUNCTION_VERSION "16.1.0_1.1.0" /end FUNCTION
/begin FUNCTION GbxECU_EATC "714.1.0_1.0.0Reception process for the CAN frame EATC" /begin DEF_CHARACTERISTIC Com_dEATCMaxDiff_C Com_dEATCMaxPer_C /end DEF_CHARACTERISTIC
 /begin IN_MEASUREMENT Com_ctCRingEATC Com_numCsumEATC Com_stFrmRxEna Com_stMon Com_stTCUECUIG1 Com_uBattDetnTCUECU Com_uIG1DetnTCUECU SyC_ctPostDrvLeave T15_st /end IN_MEASUREMENT
 /begin LOC_MEASUREMENT Com_ctReIni10msEATC GbxECU_ctEATCRngCnt /end LOC_MEASUREMENT
 FUNCTION_VERSION "714.1.0_1.0.0" /end FUNCTION
/begin FUNCTION GbxNPos_DD "44.0.0    Neutral position sensor for gearbox device driver"
 /begin DEF_CHARACTERISTIC Gbx_cntrNeutPosnCANPlausErr_C Gbx_facCorrlnAnaNPos_C Gbx_numMaxNPosAlv_C Gbx_stNeut_C Gbx_stNotNeut_C Gbx_stSwtCfgNeutPosn_C Gbx_swtSigInpLogic_C Gbx_swtSigNeutPosn_C Gbx_tiDigNeutPosnOffDeb_C Gbx_tiDigNeutPosnOnDeb_C Gbx_tiNeutInsertedDly_C Gbx_tiNeutNotInsertedDly_C Gbx_tiNeutPosnDebHiLo_C Gbx_tiNeutPosnDebLoHi_C Gbx_uAn1NeutPosnRawTmp_C Gbx_uAn1SRCMax_C Gbx_uAn1SRCMin_C Gbx_uAn2SRCMax_C Gbx_uAn2SRCMin_C Gbx_uCorrlnMaxDiffAnSnsr_CUR Gbx_uNeutPosnRngHi_C Gbx_uNeutPosnRngLo_C /end DEF_CHARACTERISTIC
 /begin IN_MEASUREMENT Com_stGbxNPos Com_stShftNP T15_st /end IN_MEASUREMENT
 /begin OUT_MEASUREMENT Gbx_stActvNPos Gbx_stAnaNPos Gbx_stAnaNPosnWoAlvChk Gbx_stAnNeutPosnFlt Gbx_stAnNeutPosnRaw Gbx_stNPos Gbx_stNPosErr Gbx_stNPosRaw Gbx_uAna1NPosRaw Gbx_uAna2NPosRaw /end OUT_MEASUREMENT
 /begin LOC_MEASUREMENT Gbx_cntrNeutPosnCANPlausErr Gbx_flgAn1NeutPosnSRCMax Gbx_flgAn1NeutPosnSRCMin Gbx_flgAn2NeutPosnSRCMax Gbx_flgAn2NeutPosnSRCMin Gbx_flgAnaNPosSyncErr Gbx_flgNeutChk Gbx_flgNeutErr1 Gbx_flgNeutErr2 Gbx_flgNeutPosnCANPlausErr Gbx_flgNeutSig Gbx_flgNonNeutChk Gbx_numNeutPosnAlv Gbx_stAlvChk Gbx_stAnaNPosBrkHld Gbx_uAn1NeutPosnRawTmp tmp_misra _uNeutTmp /end LOC_MEASUREMENT
 FUNCTION_VERSION "44.0.0" /end FUNCTION
/begin FUNCTION GbxPNPos_DD "8.0.0     Gearbox Park Neutral position sensor device driver"
 /begin DEF_CHARACTERISTIC GbxPNPos_stPNSwtInv_C GbxPNPos_tiDebHiLo_C GbxPNPos_tiDebLoHi_C Gbx_nPNPosnDiagDrvCdnThd_C Gbx_nPNPosnDiagPlausyThd_C Gbx_rPNPosnDiagAccPedlThd_C Gbx_trqPNPosnDiagTqThd_C Gbx_uPNPosnDiagThdHi_C Gbx_uPNPosnDiagThdLo_C Gbx_vPNPosnDiagVThd_C /end DEF_CHARACTERISTIC
 /begin IN_MEASUREMENT ActMod_trqCrS APP_r BattU_u Epm_nEng Gbx_stGearLvr PT_stTraType SyC_ctPostDrvLeave VehV_v /end IN_MEASUREMENT
 /begin OUT_MEASUREMENT Gbx_stPNPos Gbx_stPNPosnDeb Gbx_stPNPosnRaw /end OUT_MEASUREMENT
 /begin LOC_MEASUREMENT GbxPNPos_cntrReIni GbxPNPos_stPNPosnDiagEna /end LOC_MEASUREMENT
 FUNCTION_VERSION "8.0.0" /end FUNCTION
/begin FUNCTION GbxPPos_Vd "1.2.0     Gearbox park position (P) Virtual driver" /begin IN_MEASUREMENT Com_stPPos /end IN_MEASUREMENT /begin OUT_MEASUREMENT Gbx_stPPos /end OUT_MEASUREMENT FUNCTION_VERSION "1.2.0" /end FUNCTION
/begin FUNCTION GbxRvsSwt_DD "17.0.0    Device Driver for Reverse Position Switch"
 /begin DEF_CHARACTERISTIC Gbx_lDiffDst_C Gbx_RvsPosDeb.tiHiLo_C Gbx_RvsPosDeb.tiLoHi_C Gbx_swtRvsPosPrs_C Gbx_swtRvsSwtStkEna_C Gbx_tiRvsSwtStk_C Gbx_uRvsSwtStk_C /end DEF_CHARACTERISTIC
 /begin IN_MEASUREMENT BattU_u GlbDa_lTotDst SyC_ctPostDrvLeave T15_st /end IN_MEASUREMENT
 /begin OUT_MEASUREMENT Gbx_stRvsPos Gbx_stRvsPosRaw /end OUT_MEASUREMENT
 /begin LOC_MEASUREMENT Gbx_ctRvsSwtReIni Gbx_lDiffDst Gbx_lDiffDstM Gbx_lTotDstOld Gbx_stRvsSwtCnd Gbx_stRvsSwtErr /end LOC_MEASUREMENT
 FUNCTION_VERSION "17.0.0" /end FUNCTION
/begin FUNCTION GConf_Sy "MG1CA020_6SAY_V011_TPROT" FUNCTION_VERSION "MG1CA020_6SAY_V011_TPROT" /end FUNCTION
/begin FUNCTION GEVCtl_AVCAdpr "10.2.1    Adaptor for AVC-Functions" /begin DEF_CHARACTERISTIC DWGVOKE DWOGVKE WNWRAS WNWREO /end DEF_CHARACTERISTIC /begin REF_CHARACTERISTIC GEVCtl_stPhaAdpr_C /end REF_CHARACTERISTIC
 /begin IN_MEASUREMENT GEVCtl_agDifStdSpclLftClsdIntk GEVCtl_agIntkClsd GEVCtl_agIntkOpen GEVCtl_agOutlClsd GEVCtl_agOutlOpen GEVCtl_agSpHomOutlClsd GEVCtl_agSpIntkClsd GEVCtl_agSpIntkHiLftOutlClsd GEVCtl_agSpIntkLoLftOutlClsd GEVCtl_agSpIntkOpen GEVCtl_agSpOutlClsd GEVCtl_flgCalcSpIntkHiLft GEVCtl_ratLoad SyC_stSub /end IN_MEASUREMENT
 /begin OUT_MEASUREMENT B_wgvsvheg_msg dwgvsge_w_msg rlsnw_w wgvoma_w wgvome_w wgvose_w wgvshsma_w_msg wgvsma_w wgvsme_w wgvssa_w wgvsse_w wgvsvgesma_w_msg wgvsvkesma_w_msg /end OUT_MEASUREMENT
 FUNCTION_VERSION "10.2.1" /end FUNCTION
/begin FUNCTION GEVCtl_CalSuprt "1.0.0     Camshaft calibration support" /begin DEF_CHARACTERISTIC GEVCtl_stOperModSim_C /end DEF_CHARACTERISTIC /begin OUT_MEASUREMENT GEVCtl_flgSimCsersDiag /end OUT_MEASUREMENT FUNCTION_VERSION "1.0.0" /end FUNCTION
/begin FUNCTION GEVCtl_LftLimp "5.1.0     Limp home coordinator for valve lift system" /begin IN_MEASUREMENT VlvLft_flgFbVlvStIntk /end IN_MEASUREMENT /begin OUT_MEASUREMENT GEVCtl_flgLftLimpNLim /end OUT_MEASUREMENT FUNCTION_VERSION "5.1.0" /end FUNCTION
/begin FUNCTION GEVCtl_VlvLftCoorn "3.4.0     Coordination of Valve Lift Switching"
 /begin DEF_CHARACTERISTIC GEVCtl_cntrDlyChrgDetrmIntkNegDif_C GEVCtl_cntrDlyChrgDetrmIntkPosDif_C GEVCtl_ratLoadDeltaVlvLftIntkThd_C /end DEF_CHARACTERISTIC
 /begin REF_CHARACTERISTIC GEVCtl_stPhaAdpr_C /end REF_CHARACTERISTIC
 /begin IN_MEASUREMENT B_vhegfe_msg drldvls_w_msg VlvLft_nrCylSyncIntk_msg /end IN_MEASUREMENT
 /begin OUT_MEASUREMENT GEVCtl_flgStdLftChrgDetrmIntk GEVCtl_flgStdLftHwIntk GEVCtl_flgStdLftSyncIntk GEVCtl_nrCylSyncVlvLftIntk /end OUT_MEASUREMENT
 /begin LOC_MEASUREMENT GEVCtl_cntrDlyChrgDetrmIntkVlvLftSwt /end LOC_MEASUREMENT
 FUNCTION_VERSION "3.4.0" /end FUNCTION
/begin FUNCTION GEVCtl_VlvLftEna "1.5.0     Enable Conditions Valve Lift"
 /begin DEF_CHARACTERISTIC GEVCtl_nEngMaxVlvLftEnaHys_C GEVCtl_nEngMaxVlvLftEna_C GEVCtl_pOilMinVlvLftEnaHigh_C GEVCtl_pOilMinVlvLftEnaLow_C GEVCtl_stVlvLftEna_C GEVCtl_tEngMaxVlvLftEna_C GEVCtl_tEngMinVlvLftEna_C GEVCtl_tiDlyNormStrtVlvLftEna_C GEVCtl_tOilMaxVlvLftEna_C GEVCtl_tOilMinVlvLftEna_C GEVCtl_tOilSwmpMaxVlvLftEna_C GEVCtl_tOilSwmpMinVlvLftEna_C GEVCtl_uBattMaxVlvLftEna_C GEVCtl_uBattMinVlvLftEna_C /end DEF_CHARACTERISTIC
 /begin IN_MEASUREMENT BattU_u B_vheg_msg CEngDsT_t CoEng_stMai Epm_nEngLRes GEVCtl_flgPhaEnaPOil GEVCtl_tOilCylHd OilP_p OilSwmpT_t SyC_stSub /end IN_MEASUREMENT
 /begin OUT_MEASUREMENT GEVCtl_flgIntkVlvLftEna /end OUT_MEASUREMENT
 /begin LOC_MEASUREMENT GEVCtl_flgEngStrtCdnVlvLftEna /end LOC_MEASUREMENT
 FUNCTION_VERSION "1.5.0" /end FUNCTION
/begin FUNCTION GEVCtl_VlvOpenClsd "13.2.2    Calculation of the Opening and Closing Angles for the Intake and Outlet Valves"
 /begin DEF_CHARACTERISTIC GEVCtl_agClsdOutl_C GEVCtl_agClsdSpclLftOutl_C GEVCtl_agOffsVlvOpenIntk_C GEVCtl_agOffsVlvOpenSpclLftIntk_C GEVCtl_agOpenIntk_C GEVCtl_agOpenSpclLftIntk_C GEVCtl_agWidthCamProfIntk_C GEVCtl_agWidthCamProfOutl_C GEVCtl_agWidthCamProfSpclLftIntk_C /end DEF_CHARACTERISTIC
 /begin REF_CHARACTERISTIC GEVCtl_stPhaAdpr_C /end REF_CHARACTERISTIC
 /begin IN_MEASUREMENT B_vhefeps_msg B_vhegs_msg GEVCtl_flgSpSpclIntkVlvLft GEVCtl_flgStdLftChrgDetrmIntk SyC_stSub /end IN_MEASUREMENT
 /begin OUT_MEASUREMENT GEVCtl_agClsdIntkSpclOutl GEVCtl_agClsdIntkStdOutl GEVCtl_agDifStdSpclLftClsdIntk GEVCtl_agDifStdSpclLftOffsIntk GEVCtl_agDifStdSpclLftOpenIntk GEVCtl_agIntkClsd GEVCtl_agIntkClsd_a GEVCtl_agIntkOpen GEVCtl_agIntkOpen_a GEVCtl_agOutlClsd GEVCtl_agOutlClsd_a GEVCtl_agOutlOpen GEVCtl_agSpclLftIntkClsd GEVCtl_agSpclLftIntkOpen GEVCtl_agSpHomIntkClsd GEVCtl_agSpHomIntkOpen GEVCtl_agSpHomOutlClsd GEVCtl_agSpHomOutlOpen GEVCtl_agSpIntkClsd GEVCtl_agSpIntkHiLftIntkClsd GEVCtl_agSpIntkHiLftIntkOpen GEVCtl_agSpIntkHiLftOutlClsd GEVCtl_agSpIntkHiLftOutlOpen GEVCtl_agSpIntkLoLftIntkClsd GEVCtl_agSpIntkLoLftIntkOpen GEVCtl_agSpIntkLoLftOutlClsd GEVCtl_agSpIntkLoLftOutlOpen GEVCtl_agSpIntkOpen GEVCtl_agSpOutlClsd GEVCtl_agSpOutlOpen GEVCtl_agStdLftIntkClsd GEVCtl_agStdLftIntkOpen GEVCtl_flgActAgStdLftIntk GEVCtl_flgCalcSpIntkHiLft /end OUT_MEASUREMENT
 /begin LOC_MEASUREMENT GEVCtl_agClsdOutl GEVCtl_agOpenIntk GEVCtl_agOpenPredIntk GEVCtl_agWidthCamPredIntk GEVCtl_agWidthCamProfIntk GEVCtl_agWidthCamProfOutl GEVCtl_flgPredStdVlvLft /end LOC_MEASUREMENT
 FUNCTION_VERSION "13.2.2" /end FUNCTION
/begin FUNCTION GGKR "13.7.0    Sensor signal knock control"
 /begin DEF_CHARACTERISTIC FMFKRZN IKCtl_agOffsNInltAirTempKnkMeasWin_M IKCtl_facDgnsSnsr IKCtl_facFilSwt1 IKCtl_facFilSwt2 IKCtl_facFilSwt3 IKCtl_facFilSwt4 IKCtl_facMeasWinBgnHiRtdtIgn_GM IKCtl_facMeasWinBgnLoRtdtIgn_GM IKCtl_facMeasWinBgnMax_T IKCtl_facMeasWinLngth_GT IKCtl_idxAsgnSnsr_CA IKCtl_MeasWinCorr_C IKCtl_SpdHys_C ZWRETKRMN /end DEF_CHARACTERISTIC
 /begin REF_CHARACTERISTIC IKCtl_Load08_X_AX IKCtl_nEngVar13_X_AX /end REF_CHARACTERISTIC
 /begin IN_MEASUREMENT AirMod_ratChrgAirCyl dzwwl_msg Epm_nEng Epm_stOpMode Ign_diaKP_s8 IKCtl_agKnkAvrgGen_s8 IKCtl_flgLoadDynDetn IKCtl_flgSpdDynDetn SyC_ctPostDrvLeave SyC_stSub tans_msg /end IN_MEASUREMENT
 /begin OUT_MEASUREMENT IKCtl_cntrCyl IKCtl_flgFilSwt IKCtl_iaMeasWinBgn_s8 IKCtl_iaMeasWinLngth_s8 IKCtl_iaMeasWin_s8 IKCtl_idxFilSwt IKCtl_IntglCh1_au32 IKCtl_nUsdKnKSnsr IKCtl_stDgnsSnsrReq IKCtl_stVldnSnsrSig stkrfmf_tmp wmfa_tmp wmfl_tmp /end OUT_MEASUREMENT
 /begin LOC_MEASUREMENT IKCtl_ctReIniGGKR krinterg_l zkrksdf zzylkr_dia /end LOC_MEASUREMENT
 FUNCTION_VERSION "13.7.0" /end FUNCTION
/begin FUNCTION GK "32.7.0    Mixture control"
 /begin IN_MEASUREMENT B_stendes_msg Epm_numCyl fgru_msg fnswl_w_msg fra_w_msg fr_w_msg fst_w_msg fwe_msg InjSys_stActRedStg lamsbg_w_msg rkakapb_w_msg rka_w_msg rkte_w_msg rkukg_w_msg rlp_w_msg SyC_stSub /end IN_MEASUREMENT
 /begin OUT_MEASUREMENT InjSys_facPc InjSys_ratFuM InjSys_ratFuMBnk InjSys_ratFuMBnkLong InjSys_ratFuMTot InjSys_ratPrdcAirLamDes rkmeeff_w_msg rkme_w_msg rkvmeeff_w_msg rk_l_msg /end OUT_MEASUREMENT
 FUNCTION_VERSION "32.7.0" /end FUNCTION
/begin FUNCTION GlbDa_DrvgCycCntr "1.0.0     Global driving cycle counter" /begin DEF_CHARACTERISTIC GlbDa_dlyTiDrvgCycCntr_C /end DEF_CHARACTERISTIC /begin IN_MEASUREMENT CoEng_st SyC_stSub T15_st /end IN_MEASUREMENT /begin OUT_MEASUREMENT GlbDa_cntrDrvgCyc /end OUT_MEASUREMENT /begin LOC_MEASUREMENT GlbDa_flgDrvgCycCntr /end LOC_MEASUREMENT FUNCTION_VERSION "1.0.0" /end FUNCTION
/begin FUNCTION GlbDa_LSum "64.0.0    Global Data Total Distance" /begin DEF_CHARACTERISTIC GlbDa_lDstLim_C /end DEF_CHARACTERISTIC /begin IN_MEASUREMENT CoEng_st VehV_v /end IN_MEASUREMENT
 /begin OUT_MEASUREMENT GlbDa_lDst GlbDa_lenTotDstDcyc GlbDa_lenTotDstDcycHiResl GlbDa_lTotDst /end OUT_MEASUREMENT
 /begin LOC_MEASUREMENT GlbDa_lDstLstStored GlbDa_lDstLstStoredProtd GlbDa_lenTotDstPrevDcyc GlbDa_lTotDstProtd GlbDa_stEepOrder GlbDa_stEepWrite /end LOC_MEASUREMENT
 FUNCTION_VERSION "64.0.0" /end FUNCTION
/begin FUNCTION GlbDa_SetData "38.1.0    Global Data Set Data"
 /begin DEF_CHARACTERISTIC GlbDa_aX_C GlbDa_lWhlCirc_C GlbDa_pEnv_C GlbDa_rTrqDfl_C GlbDa_tEnv_C GlbDa_tiFltAX_C GlbDa_tiFltVX_C GlbDa_tIndAir_C GlbDa_tiWhlSpdFlt_C GlbDa_vWhlSpdMin_C GlbDa_vX_C /end DEF_CHARACTERISTIC
 /begin IN_MEASUREMENT Air_tCACDs EnvP_p EnvT_t PT_rTrq PT_rTrqWoConvRat StbIntv_vWhlSpd SyC_ctPostDrvLeave VehMot_rTrqDfftl VehV_a VehV_v /end IN_MEASUREMENT
 /begin OUT_MEASUREMENT GlbDa_aX GlbDa_aXFlt GlbDa_lWhlCirc GlbDa_pEnv GlbDa_rTrqTot GlbDa_rTrqTotWoConvRat GlbDa_tEnv GlbDa_tIndAir GlbDa_vAvrgWhlSpd GlbDa_vWhlSpdFlt GlbDa_vX GlbDa_vXFlt /end OUT_MEASUREMENT
 /begin LOC_MEASUREMENT GlbDa_cntrReIni GlbDa_nrWhlSpdAryIdx1 GlbDa_nrWhlSpdAryIdx2 GlbDa_vWhlSpdFltAryVal /end LOC_MEASUREMENT
 FUNCTION_VERSION "38.1.0" /end FUNCTION
/begin FUNCTION GlbDa_TrqDem "24.0.0    Global Data Torque Demand" /begin IN_MEASUREMENT PT_stTqDem /end IN_MEASUREMENT /begin OUT_MEASUREMENT GlbDa_stTrqDem /end OUT_MEASUREMENT FUNCTION_VERSION "24.0.0" /end FUNCTION
/begin FUNCTION GwECU_CGW1 "15.2.0_1.0.0Receive frame CGW1" /begin DEF_CHARACTERISTIC Com_dCGW1MaxDiff_C Com_dCGW1MaxPer_C Com_dGwCGW1SigSel_C /end DEF_CHARACTERISTIC
 /begin IN_MEASUREMENT Com_ctCRingCGW1 Com_numCsumCGW1 Com_stFrmRxEna Com_stIMGMILReq Com_stMon SyC_ctPostDrvLeave T15_st /end IN_MEASUREMENT
 /begin LOC_MEASUREMENT Com_ctReIni10msCGW1 GwECU_ctCGW1RngCnt_MP /end LOC_MEASUREMENT
 FUNCTION_VERSION "15.2.0_1.0.0" /end FUNCTION
/begin FUNCTION GwECU_GwIMG1 "2.2.0_6SAAReception process for the CAN frame GwIMG1" /begin DEF_CHARACTERISTIC Com_dGwIMG1MaxDiff_C Com_dGwIMG1MaxPer_C /end DEF_CHARACTERISTIC
 /begin IN_MEASUREMENT Com_ctCRingGwIMG1 Com_numCsumGwIMG1 Com_stFrmRxEna Com_stIMGIDSDrvMod Com_stMon /end IN_MEASUREMENT
 /begin LOC_MEASUREMENT GwECU_ctGwIMG1RngCnt_MP /end LOC_MEASUREMENT
 FUNCTION_VERSION "2.2.0_6SAA" /end FUNCTION
/begin FUNCTION GwECU_GwIMG3 "5.3.0_6SAAReception process for the CAN frame GwIMG3"
 /begin DEF_CHARACTERISTIC Com_dGwIMG3MaxDiff_C Com_dGwIMG3MaxPer_C Com_tqIMGSuppReq_C /end DEF_CHARACTERISTIC
 /begin IN_MEASUREMENT Com_ctCRingGwIMG3 Com_numCsumGwIMG3 Com_stFrmRxEna Com_stIMGACCBrkReq Com_stIMGDrvTq Com_stIMGISBrkCntrADAS Com_stIMGISRlsReq Com_stIMGLimTq Com_stIMGShiftReq Com_stMon Com_tqIMGReqDrv Com_tqIMGSuppReq /end IN_MEASUREMENT
 /begin OUT_MEASUREMENT Com_flgGwIMG3Norm /end OUT_MEASUREMENT
 FUNCTION_VERSION "5.3.0_6SAA" /end FUNCTION
/begin FUNCTION GwECU_GwIMG4 "4.2.0_6SAAReception process for the CAN frame GwIMG4" /begin DEF_CHARACTERISTIC Com_dGwIMG4MaxDiff_C Com_dGwIMG4MaxPer_C /end DEF_CHARACTERISTIC
 /begin IN_MEASUREMENT Com_ctCRingGwIMG4 Com_numCsumGwIMG4 Com_stEngCanRxErr Com_stFrmRxEna Com_stIMGISBrkHldActv Com_stIMGISBrkHldStb Com_stIMGISInhbBrk Com_stIMGISRstrtInhbBrk Com_stIMGISShiftInhbBrk Com_stIMGISSysOffBrk Com_stMon /end IN_MEASUREMENT
 /begin LOC_MEASUREMENT GwECU_ctGwIMG4RngCnt_MP /end LOC_MEASUREMENT
 FUNCTION_VERSION "4.2.0_6SAA" /end FUNCTION
/begin FUNCTION GwECU_GwIMG5 "3.2.0_6SAAReception process for the CAN frame GwIMG5" /begin DEF_CHARACTERISTIC Com_dGwIMG5MaxDiff_C Com_dGwIMG5MaxPer_C /end DEF_CHARACTERISTIC
 /begin IN_MEASUREMENT Com_ctCRingGwIMG5 Com_numCsumGwIMG5 Com_stClrCmplInfoVINRegst Com_stFrmRxEna Com_stMon /end IN_MEASUREMENT
 /begin LOC_MEASUREMENT GwECU_ctGwIMG5RngCnt_MP /end LOC_MEASUREMENT
 FUNCTION_VERSION "3.2.0_6SAA" /end FUNCTION
/begin FUNCTION GwECU_GwIMG6 "714.1.0_1.0.0Reception process for the CAN frame GwIMG6" /begin DEF_CHARACTERISTIC Com_dGwIMG6MaxDiff_C Com_dGwIMG6MaxPer_C /end DEF_CHARACTERISTIC
 /begin IN_MEASUREMENT Com_ctCRingGwIMG6 Com_numCsumGwIMG6 Com_stFrmRxEna Com_stIMGECUIG1 Com_stMon Com_uBattDetnIMGECU Com_uIG1DetnIMGECU SyC_ctPostDrvLeave T15_st /end IN_MEASUREMENT
 /begin LOC_MEASUREMENT Com_ctReIni10msGwIMG6 GwECU_ctGwIMG6RngCnt /end LOC_MEASUREMENT
 FUNCTION_VERSION "714.1.0_1.0.0" /end FUNCTION
/begin COMPU_METHOD Acc "" RAT_FUNC "%6.5" "m/s^2" COEFFS 0 1000 0 0 0 1 /end COMPU_METHOD
/begin COMPU_METHOD B_TRUE "" TAB_VERB "%6.3" "" COMPU_TAB_REF B_TRUE /end COMPU_METHOD
/begin COMPU_VTAB B_TRUE "" TAB_VERB 2 0 "FALSE" 1 "TRUE" /end COMPU_VTAB
/begin COMPU_METHOD Com_Fact_b0p00006 "" RAT_FUNC "%7.6" "-" COEFFS 0 16384 0 0 0 1 /end COMPU_METHOD
/begin COMPU_METHOD CrCtlSlipRat "" RAT_FUNC "%6.4" "%" COEFFS 0 200 0 0 0 1 /end COMPU_METHOD
/begin COMPU_METHOD dez "" RAT_FUNC "%6.2" "" COEFFS 0 1 0 0 0 1 /end COMPU_METHOD
/begin COMPU_METHOD dezsub1 "" RAT_FUNC "%6.2" "-" COEFFS 0 1 -1 0 0 1 /end COMPU_METHOD
/begin COMPU_METHOD DFES_nPID0C "" RAT_FUNC "%6.3" "rpm" COEFFS 0 4 0 0 0 1 /end COMPU_METHOD
/begin COMPU_METHOD EngN "" RAT_FUNC "%6.3" "rpm" COEFFS 0 2 0 0 0 1 /end COMPU_METHOD
/begin COMPU_METHOD EngN_LRes "" RAT_FUNC "%6.1" "rpm" COEFFS 0 0.025 0 0 0 1 /end COMPU_METHOD
/begin COMPU_METHOD Fact "" RAT_FUNC "%6.5" "-" COEFFS 0 8192 0 0 0 1 /end COMPU_METHOD
/begin COMPU_METHOD Fact_2pwr11 "" RAT_FUNC "%6.5" "-" COEFFS 0 2048 0 0 0 1 /end COMPU_METHOD
/begin COMPU_METHOD fak_q3p0518Em5 "" RAT_FUNC "%7.6" "" COEFFS 0 32768 0 0 0 1 /end COMPU_METHOD
/begin COMPU_METHOD fak_ub_b2 "" RAT_FUNC "%8.5" "-" COEFFS 0 256 0 0 0 2 /end COMPU_METHOD
/begin COMPU_METHOD fak_uw_b1 "" RAT_FUNC "%7.6" "-" COEFFS 0 65536 0 0 0 1 /end COMPU_METHOD
/begin COMPU_METHOD fak_uw_b2 "" RAT_FUNC "%7.6" "-" COEFFS 0 65536 0 0 0 2 /end COMPU_METHOD
/begin COMPU_METHOD fak_uw_b64 "" RAT_FUNC "%6.5" "-" COEFFS 0 65536 0 0 0 64 /end COMPU_METHOD
/begin COMPU_METHOD fak_uw_b8 "" RAT_FUNC "%6.5" "-" COEFFS 0 65536 0 0 0 8 /end COMPU_METHOD
/begin COMPU_METHOD kw_q0p0078 "" RAT_FUNC "%6.4" "Grad KW" COEFFS 0 128 0 0 0 1 /end COMPU_METHOD
/begin COMPU_METHOD kw_q0p0156 "" RAT_FUNC "%6.4" "Grad KW" COEFFS 0 64 0 0 0 1 /end COMPU_METHOD
/begin COMPU_METHOD kw_q0p75 "" RAT_FUNC "%6.3" "Grad KW" COEFFS 0 4 0 0 0 3 /end COMPU_METHOD
/begin COMPU_METHOD Length "" RAT_FUNC "%6.2" "m" COEFFS 0 1 0 0 0 1 /end COMPU_METHOD
/begin COMPU_METHOD LengthKm1 "" RAT_FUNC "%6.2" "Km" COEFFS 0 1 0 0 0 1 /end COMPU_METHOD
/begin COMPU_METHOD LengthKm_q0p1 "" RAT_FUNC "%6.3" "km" COEFFS 0 10 0 0 0 1 /end COMPU_METHOD
/begin COMPU_METHOD Length_10m "" RAT_FUNC "%6.1" "m" COEFFS 0 0.1 0 0 0 1 /end COMPU_METHOD
/begin COMPU_METHOD Length_fine "" RAT_FUNC "%6.5" "m" COEFFS 0 1000 0 0 0 1 /end COMPU_METHOD
/begin COMPU_METHOD MAX_NUM_MAININJ_SY_Compu "" TAB_VERB "%6.3" "" COMPU_TAB_REF MAX_NUM_MAININJ_SY_Compu /end COMPU_METHOD
/begin COMPU_VTAB MAX_NUM_MAININJ_SY_Compu "" TAB_VERB 7 2 "2" 3 "3" 4 "4" 5 "5" 6 "6" 7 "7" 8 "8" /end COMPU_VTAB
/begin COMPU_METHOD MDG1CPUDEVICE_SC_Compu "" TAB_VERB "%6.3" "" COMPU_TAB_REF MDG1CPUDEVICE_SC_Compu /end COMPU_METHOD
/begin COMPU_VTAB MDG1CPUDEVICE_SC_Compu "" TAB_VERB 9 0 "None" 1 "Device1" 2 "Device2" 3 "Device3" 4 "Device4" 5 "Device5" 13 "Device3+" 14 "Device4+" 15 "Device5+" /end COMPU_VTAB
/begin COMPU_METHOD MDG1CPUSTEP_SC_Compu "" TAB_VERB "%6.3" "" COMPU_TAB_REF MDG1CPUSTEP_SC_Compu /end COMPU_METHOD
/begin COMPU_VTAB MDG1CPUSTEP_SC_Compu "" TAB_VERB 11 0 "None" 1 "1" 2 "2" 110 "110" 120 "120" 130 "130" 140 "140" 210 "210" 220 "220" 230 "230" 232 "232" /end COMPU_VTAB
/begin COMPU_METHOD MDG1CPUVENDOR_SC_Compu "" TAB_VERB "%6.3" "" COMPU_TAB_REF MDG1CPUVENDOR_SC_Compu /end COMPU_METHOD
/begin COMPU_VTAB MDG1CPUVENDOR_SC_Compu "" TAB_VERB 4 0 "None" 1 "IFX" 2 "JDP" 3 "ST" /end COMPU_VTAB
/begin COMPU_METHOD MDG1MSGCNCPT_SC_Compu "" TAB_VERB "%6.3" "" COMPU_TAB_REF MDG1MSGCNCPT_SC_Compu /end COMPU_METHOD
/begin COMPU_VTAB MDG1MSGCNCPT_SC_Compu "" TAB_VERB 2 0 "MSGCNCPT_DISABLED" 1 "MSGCNCPT_ENABLED" /end COMPU_VTAB
/begin COMPU_METHOD md_q0p1 "" RAT_FUNC "%6.3" "Nm" COEFFS 0 10 0 0 0 1 /end COMPU_METHOD
/begin COMPU_METHOD MEM_CENDIAGACTVD_SC_Compu "" TAB_VERB "%6.3" "" COMPU_TAB_REF MEM_CENDIAGACTVD_SC_Compu /end COMPU_METHOD
/begin COMPU_VTAB MEM_CENDIAGACTVD_SC_Compu "" TAB_VERB 2 0 "False" 1 "True" /end COMPU_VTAB
/begin COMPU_METHOD MEM_DIAGACTVDEXTD_SC_Compu "" TAB_VERB "%6.3" "" COMPU_TAB_REF MEM_DIAGACTVDEXTD_SC_Compu /end COMPU_METHOD
/begin COMPU_VTAB MEM_DIAGACTVDEXTD_SC_Compu "" TAB_VERB 2 0 "False" 1 "True" /end COMPU_VTAB
/begin COMPU_METHOD MESCTRLR_AXISPNTSNRPRMSET_SC_Compu "" RAT_FUNC "%6.2" "" COEFFS 0 1 0 0 0 1 /end COMPU_METHOD
/begin COMPU_METHOD MESCTRLR_AXISPNTSTSELD_SC_Compu "" RAT_FUNC "%6.2" "" COEFFS 0 1 0 0 0 1 /end COMPU_METHOD
/begin COMPU_METHOD MESCTRLR_PFAVL_SC_Compu "" TAB_VERB "%6.3" "" COMPU_TAB_REF MESCTRLR_PFAVL_SC_Compu /end COMPU_METHOD
/begin COMPU_VTAB MESCTRLR_PFAVL_SC_Compu "" TAB_VERB 2 0 "MESCtrlr_NotAvl" 1 "MESCtrlr_Avl" /end COMPU_VTAB
/begin COMPU_METHOD MFCORRNEVAPSYS_SC_Compu "" TAB_VERB "%6.3" "" COMPU_TAB_REF MFCORRNEVAPSYS_SC_Compu /end COMPU_METHOD
/begin COMPU_VTAB MFCORRNEVAPSYS_SC_Compu "" TAB_VERB 2 0 "False" 1 "True" /end COMPU_VTAB
/begin COMPU_METHOD MFLOWCRKCSTINTKMNFMDL_SC_Compu "" TAB_VERB "%6.3" "" COMPU_TAB_REF MFLOWCRKCSTINTKMNFMDL_SC_Compu /end COMPU_METHOD
/begin COMPU_VTAB MFLOWCRKCSTINTKMNFMDL_SC_Compu "" TAB_VERB 3 0 "NONE" 1 "PRESSURE" 2 "DELTA" /end COMPU_VTAB
/begin COMPU_METHOD MFVLV_PQNTSVAL_SC_Compu "" TAB_VERB "%6.3" "" COMPU_TAB_REF MFVLV_PQNTSVAL_SC_Compu /end COMPU_METHOD
/begin COMPU_VTAB MFVLV_PQNTSVAL_SC_Compu "" TAB_VERB 3 0 "5mbar" 1 "20mbar" 2 "greater than 20mbar" /end COMPU_VTAB
/begin COMPU_METHOD MFVLV_PSIC_SC_Compu "" TAB_VERB "%6.3" "" COMPU_TAB_REF MFVLV_PSIC_SC_Compu /end COMPU_METHOD
/begin COMPU_VTAB MFVLV_PSIC_SC_Compu "" TAB_VERB 4 0 "discrete" 1 "R2S2" 2 "CY202" 3 "SC900685" /end COMPU_VTAB
/begin COMPU_METHOD MgPerHubSec "" RAT_FUNC "%6.3" "mg/(Hub*sec)" COEFFS 0 10 0 0 0 1 /end COMPU_METHOD
/begin COMPU_METHOD MILDHEV_SC_Compu "" TAB_VERB "%6.3" "" COMPU_TAB_REF MILDHEV_SC_Compu /end COMPU_METHOD
/begin COMPU_VTAB MILDHEV_SC_Compu "" TAB_VERB 3 0 "NOMILDHEV" 1 "MILDHEV48V" 2 "MILDHEV12V" /end COMPU_VTAB
/begin COMPU_METHOD MILLMP_2HZBLINK_SC_Compu "" TAB_VERB "%6.3" "" COMPU_TAB_REF MILLMP_2HZBLINK_SC_Compu /end COMPU_METHOD
/begin COMPU_VTAB MILLMP_2HZBLINK_SC_Compu "" TAB_VERB 2 0 "False" 1 "True" /end COMPU_VTAB
/begin COMPU_METHOD MILLMP_ENGSTRTWITH2SECCDN_SC_Compu "" TAB_VERB "%6.3" "" COMPU_TAB_REF MILLMP_ENGSTRTWITH2SECCDN_SC_Compu /end COMPU_METHOD
/begin COMPU_VTAB MILLMP_ENGSTRTWITH2SECCDN_SC_Compu "" TAB_VERB 2 0 "False" 1 "True" /end COMPU_VTAB
/begin COMPU_METHOD MILLMP_PWRSTG_SY_Compu "" TAB_VERB "%6.3" "" COMPU_TAB_REF MILLMP_PWRSTG_SY_Compu /end COMPU_METHOD
/begin COMPU_VTAB MILLMP_PWRSTG_SY_Compu "" TAB_VERB 2 0 "False" 1 "True" /end COMPU_VTAB
/begin COMPU_METHOD MILLMP_SUPRT_ATS_SY_Compu "" TAB_VERB "%6.3" "" COMPU_TAB_REF MILLMP_SUPRT_ATS_SY_Compu /end COMPU_METHOD
/begin COMPU_VTAB MILLMP_SUPRT_ATS_SY_Compu "" TAB_VERB 2 0 "False" 1 "True" /end COMPU_VTAB
/begin COMPU_METHOD MISFDETD_AVL_SY_Compu "" TAB_VERB "%6.3" "" COMPU_TAB_REF MISFDETD_AVL_SY_Compu /end COMPU_METHOD
/begin COMPU_VTAB MISFDETD_AVL_SY_Compu "" TAB_VERB 2 0 "False" 1 "True" /end COMPU_VTAB
/begin COMPU_METHOD MISFDET_ACTVTESTSUSPCMISFCNTR_SC_Compu "" TAB_VERB "%6.3" "" COMPU_TAB_REF MISFDET_ACTVTESTSUSPCMISFCNTR_SC_Compu /end COMPU_METHOD
/begin COMPU_VTAB MISFDET_ACTVTESTSUSPCMISFCNTR_SC_Compu "" TAB_VERB 2 0 "no_cntr" 1 "wi_cntr" /end COMPU_VTAB
/begin COMPU_METHOD MISFDET_ACTVTEST_SC_Compu "" TAB_VERB "%6.3" "" COMPU_TAB_REF MISFDET_ACTVTEST_SC_Compu /end COMPU_METHOD
/begin COMPU_VTAB MISFDET_ACTVTEST_SC_Compu "" TAB_VERB 2 0 "actvTest_notUsed" 1 "actvTest_used" /end COMPU_VTAB
/begin COMPU_METHOD MISFDET_ADPNDATAEEP_SC_Compu "" TAB_VERB "%6.3" "" COMPU_TAB_REF MISFDET_ADPNDATAEEP_SC_Compu /end COMPU_METHOD
/begin COMPU_VTAB MISFDET_ADPNDATAEEP_SC_Compu "" TAB_VERB 2 0 "data_in_NVRAM" 1 "data_in_EEP" /end COMPU_VTAB
/begin COMPU_METHOD MISFDET_BNKIMBAL_SC_Compu "" TAB_VERB "%6.3" "" COMPU_TAB_REF MISFDET_BNKIMBAL_SC_Compu /end COMPU_METHOD
/begin COMPU_VTAB MISFDET_BNKIMBAL_SC_Compu "" TAB_VERB 2 0 "noBnkImbalDetn" 1 "wiBankImbalDetn" /end COMPU_VTAB
/begin COMPU_METHOD MISFDET_DMFDSTBC_SC_Compu "" TAB_VERB "%6.3" "" COMPU_TAB_REF MISFDET_DMFDSTBC_SC_Compu /end COMPU_METHOD
/begin COMPU_VTAB MISFDET_DMFDSTBC_SC_Compu "" TAB_VERB 2 0 "Deactive" 1 "Active" /end COMPU_VTAB
/begin COMPU_METHOD MISFDET_DNADPNNRRNGNENG_SC_Compu "" RAT_FUNC "%6.2" "" COEFFS 0 1 0 0 0 1 /end COMPU_METHOD
/begin COMPU_METHOD MISFDET_DNADPNNRRNGTQ_SC_Compu "" RAT_FUNC "%6.2" "" COEFFS 0 1 0 0 0 1 /end COMPU_METHOD
/begin COMPU_METHOD MISFDET_DNADPN_SC_Compu "" TAB_VERB "%6.3" "" COMPU_TAB_REF MISFDET_DNADPN_SC_Compu /end COMPU_METHOD
/begin COMPU_VTAB MISFDET_DNADPN_SC_Compu "" TAB_VERB 3 0 "no_adpn" 1 "adpn_pos_tq" 2 "adpn_pos_tq_fco" /end COMPU_VTAB
/begin COMPU_METHOD MISFDET_DNCALCNTQBAL_SC_Compu "" TAB_VERB "%6.3" "" COMPU_TAB_REF MISFDET_DNCALCNTQBAL_SC_Compu /end COMPU_METHOD
/begin COMPU_VTAB MISFDET_DNCALCNTQBAL_SC_Compu "" TAB_VERB 3 0 "no_dncalcntqbal" 1 "wi_dncalcntqbal" 2 "wi_dncalcntqbalsegadpn" /end COMPU_VTAB
/begin COMPU_METHOD MISFDET_DNDIFSIG_SC_Compu "" TAB_VERB "%6.3" "" COMPU_TAB_REF MISFDET_DNDIFSIG_SC_Compu /end COMPU_METHOD
/begin COMPU_VTAB MISFDET_DNDIFSIG_SC_Compu "" TAB_VERB 2 0 "False" 1 "True" /end COMPU_VTAB
/begin COMPU_METHOD MISFDET_DNPRECTRL_SC_Compu "" TAB_VERB "%6.3" "" COMPU_TAB_REF MISFDET_DNPRECTRL_SC_Compu /end COMPU_METHOD
/begin COMPU_VTAB MISFDET_DNPRECTRL_SC_Compu "" TAB_VERB 2 0 "no_preCtrl" 1 "wi_preCtrl" /end COMPU_VTAB
/begin COMPU_METHOD MISFDET_DUALINJTEST_SC_Compu "" TAB_VERB "%6.3" "" COMPU_TAB_REF MISFDET_DUALINJTEST_SC_Compu /end COMPU_METHOD
/begin COMPU_VTAB MISFDET_DUALINJTEST_SC_Compu "" TAB_VERB 2 0 "False" 1 "True" /end COMPU_VTAB
/begin COMPU_METHOD MISFDET_EXHGASPBASDDETN_SC_Compu "" TAB_VERB "%6.3" "" COMPU_TAB_REF MISFDET_EXHGASPBASDDETN_SC_Compu /end COMPU_METHOD
/begin COMPU_VTAB MISFDET_EXHGASPBASDDETN_SC_Compu "" TAB_VERB 2 0 "noExhGasPBasdDetn" 1 "wiExhGasPBasdDetn" /end COMPU_VTAB
/begin COMPU_METHOD MISFDET_FUREACVN_SC_Compu "" TAB_VERB "%6.3" "" COMPU_TAB_REF MISFDET_FUREACVN_SC_Compu /end COMPU_METHOD
/begin COMPU_VTAB MISFDET_FUREACVN_SC_Compu "" TAB_VERB 2 0 "Deactive" 1 "Active" /end COMPU_VTAB
/begin COMPU_METHOD MISFDET_LAMBASDDETN_SC_Compu "" TAB_VERB "%6.3" "" COMPU_TAB_REF MISFDET_LAMBASDDETN_SC_Compu /end COMPU_METHOD
/begin COMPU_VTAB MISFDET_LAMBASDDETN_SC_Compu "" TAB_VERB 2 0 "noLamBasdDetn" 1 "wiLamBasdDetn" /end COMPU_VTAB
/begin COMPU_METHOD MISFDET_NOTEQUIDIGN_SC_Compu "" TAB_VERB "%6.3" "" COMPU_TAB_REF MISFDET_NOTEQUIDIGN_SC_Compu /end COMPU_METHOD
/begin COMPU_VTAB MISFDET_NOTEQUIDIGN_SC_Compu "" TAB_VERB 2 0 "not_supported" 1 "supported" /end COMPU_VTAB
/begin COMPU_METHOD MISFDET_NREOMMASK_SC_Compu "" RAT_FUNC "%6.2" "" COEFFS 0 1 0 0 0 1 /end COMPU_METHOD
/begin COMPU_METHOD MISFDET_NRTRSMTYP_SC_Compu "" TAB_VERB "%6.3" "" COMPU_TAB_REF MISFDET_NRTRSMTYP_SC_Compu /end COMPU_METHOD
/begin COMPU_VTAB MISFDET_NRTRSMTYP_SC_Compu "" TAB_VERB 3 0 "oneTraTyp" 1 "twoTraTyp" 2 "threeTraTyp" /end COMPU_VTAB
/begin COMPU_METHOD MISFDET_PATDETNTOOTHBASD_SC_Compu "" TAB_VERB "%6.3" "" COMPU_TAB_REF MISFDET_PATDETNTOOTHBASD_SC_Compu /end COMPU_METHOD
/begin COMPU_VTAB MISFDET_PATDETNTOOTHBASD_SC_Compu "" TAB_VERB 2 0 "dnBasd" 1 "toothBasd" /end COMPU_VTAB
/begin COMPU_METHOD MISFDET_PATDETN_SC_Compu "" TAB_VERB "%6.3" "" COMPU_TAB_REF MISFDET_PATDETN_SC_Compu /end COMPU_METHOD
/begin COMPU_VTAB MISFDET_PATDETN_SC_Compu "" TAB_VERB 2 0 "Deactive" 1 "Active" /end COMPU_VTAB
/begin COMPU_METHOD MISFDET_REDFCT_SC_Compu "" RAT_FUNC "%6.2" "" COEFFS 0 1 0 0 0 1 /end COMPU_METHOD
/begin COMPU_METHOD MISFDET_ROUGHROADDIAG_SC_Compu "" TAB_VERB "%6.3" "" COMPU_TAB_REF MISFDET_ROUGHROADDIAG_SC_Compu /end COMPU_METHOD
/begin COMPU_VTAB MISFDET_ROUGHROADDIAG_SC_Compu "" TAB_VERB 2 0 "no_diag" 1 "with_diag" /end COMPU_VTAB
/begin COMPU_METHOD MISFDET_ROUGHROADTYP_SC_Compu "" TAB_VERB "%6.3" "" COMPU_TAB_REF MISFDET_ROUGHROADTYP_SC_Compu /end COMPU_METHOD
/begin COMPU_VTAB MISFDET_ROUGHROADTYP_SC_Compu "" TAB_VERB 8 0 "none" 1 "whlSpdDgs" 2 "whlSpd" 3 "engRoughns" 4 "body" 5 "ABS" 6 "whlSpdOrABS" 7 "whlSpd2Whl" /end COMPU_VTAB
/begin COMPU_METHOD MISFDET_SEGPOSNCYL_SC_Compu "" TAB_VERB "%6.3" "" COMPU_TAB_REF MISFDET_SEGPOSNCYL_SC_Compu /end COMPU_METHOD
/begin COMPU_VTAB MISFDET_SEGPOSNCYL_SC_Compu "" TAB_VERB 2 0 "cmn_seg" 1 "cyl_ind_seg" /end COMPU_VTAB
/begin COMPU_METHOD MISFDET_SEGSHIFTGPFRGN_SC_Compu "" TAB_VERB "%6.3" "" COMPU_TAB_REF MISFDET_SEGSHIFTGPFRGN_SC_Compu /end COMPU_METHOD
/begin COMPU_VTAB MISFDET_SEGSHIFTGPFRGN_SC_Compu "" TAB_VERB 2 0 "no_seg_shift_gpfrgn" 1 "seg_shift_gpfrgn" /end COMPU_VTAB
/begin COMPU_METHOD MISFDET_SEGSHIFTIDLE_SC_Compu "" TAB_VERB "%6.3" "" COMPU_TAB_REF MISFDET_SEGSHIFTIDLE_SC_Compu /end COMPU_METHOD
/begin COMPU_VTAB MISFDET_SEGSHIFTIDLE_SC_Compu "" TAB_VERB 2 0 "no_seg_shift_idle" 1 "seg_shift_idle" /end COMPU_VTAB
/begin COMPU_METHOD MISFDET_SEGSHIFT_SC_Compu "" TAB_VERB "%6.3" "" COMPU_TAB_REF MISFDET_SEGSHIFT_SC_Compu /end COMPU_METHOD
/begin COMPU_VTAB MISFDET_SEGSHIFT_SC_Compu "" TAB_VERB 3 0 "no_seg_shift" 1 "two_pos" 2 "mpl_pos" /end COMPU_VTAB
/begin COMPU_METHOD MISFDET_SEGTIADPN_SC_Compu "" TAB_VERB "%6.3" "" COMPU_TAB_REF MISFDET_SEGTIADPN_SC_Compu /end COMPU_METHOD
/begin COMPU_VTAB MISFDET_SEGTIADPN_SC_Compu "" TAB_VERB 3 0 "woAdpn" 1 "wiAdpn" 2 "wiAdpnEnhd" /end COMPU_VTAB
/begin COMPU_METHOD MISFDET_SEGTICALCNTYP_SC_Compu "" TAB_VERB "%6.3" "" COMPU_TAB_REF MISFDET_SEGTICALCNTYP_SC_Compu /end COMPU_METHOD
/begin COMPU_VTAB MISFDET_SEGTICALCNTYP_SC_Compu "" TAB_VERB 2 0 "Std" 1 "ToothTi" /end COMPU_VTAB
/begin COMPU_METHOD MISFDET_SUSPCEMIEXCDC_SC_Compu "" TAB_VERB "%6.3" "" COMPU_TAB_REF MISFDET_SUSPCEMIEXCDC_SC_Compu /end COMPU_METHOD
/begin COMPU_VTAB MISFDET_SUSPCEMIEXCDC_SC_Compu "" TAB_VERB 2 0 "no_supsc_emi" 1 "wi_supsc_emi" /end COMPU_VTAB
/begin COMPU_METHOD MISFDET_TWOWHLIF_SC_Compu "" TAB_VERB "%6.3" "" COMPU_TAB_REF MISFDET_TWOWHLIF_SC_Compu /end COMPU_METHOD
/begin COMPU_VTAB MISFDET_TWOWHLIF_SC_Compu "" TAB_VERB 3 0 "No input interface adaptation" 1 "MSE_PF" 2 "Power Sports PF" /end COMPU_VTAB
/begin COMPU_METHOD MISFDET_TYP_SC_Compu "" TAB_VERB "%6.3" "" COMPU_TAB_REF MISFDET_TYP_SC_Compu /end COMPU_METHOD
/begin COMPU_VTAB MISFDET_TYP_SC_Compu "" TAB_VERB 5 0 "none" 1 "DS_classic" 2 "DS_enhanced" 3 "GS_DMD" 4 "DGS" /end COMPU_VTAB
/begin COMPU_METHOD MISFDET_VAR_SY_Compu "" TAB_VERB "%6.3" "" COMPU_TAB_REF MISFDET_VAR_SY_Compu /end COMPU_METHOD
/begin COMPU_VTAB MISFDET_VAR_SY_Compu "" TAB_VERB 48 1 "DAI" 3 "VWW" 4 "POR" 5 "AUD" 6 "OPE" 9 "FIA" 11 "BMW" 14 "PSA" 15 "REN" 17 "ALF" 18 "SAB" 19 "VOL" 20 "NIS" 21 "GMU" 22 "FOR" 26 "IMJ" 51 "SEA" 53 "CHR" 54 "JAG" 55 "ROL" 69 "FER" 72 "TOY" 112 "BMWMotorradAG" 123 "MIT" 147 "HYU" 159 "HON" 160 "MAZ" 183 "CU" 190 "LRG" 204 "VVW" 214 "AVT" 242 "Iveco" 243 "DMC" 248 "SUZ" 267 "SSANGYONG" 268 "BRP-Rotax" 270 "KEF" 289 "AMG" 308 "TAT" 319 "MVM" 385 "UAES" 425 "Polaris" 590 "Scania" 828 "RBCD" 898 "MFTBC" 999 "ALL" 2887 "Nonox" 9454 "Fuso" /end COMPU_VTAB
/begin COMPU_METHOD MIXADPNACTVPSETI_SC_Compu "" TAB_VERB "%6.3" "" COMPU_TAB_REF MIXADPNACTVPSETI_SC_Compu /end COMPU_METHOD
/begin COMPU_VTAB MIXADPNACTVPSETI_SC_Compu "" TAB_VERB 2 0 "False" 1 "True" /end COMPU_VTAB
/begin COMPU_METHOD MIXADPNCATHEAT_SC_Compu "" TAB_VERB "%6.3" "" COMPU_TAB_REF MIXADPNCATHEAT_SC_Compu /end COMPU_METHOD
/begin COMPU_VTAB MIXADPNCATHEAT_SC_Compu "" TAB_VERB 2 0 "False" 1 "True" /end COMPU_VTAB
/begin COMPU_METHOD MIXADPNLOADHI_SC_Compu "" TAB_VERB "%6.3" "" COMPU_TAB_REF MIXADPNLOADHI_SC_Compu /end COMPU_METHOD
/begin COMPU_VTAB MIXADPNLOADHI_SC_Compu "" TAB_VERB 2 0 "False" 1 "True" /end COMPU_VTAB
/begin COMPU_METHOD MIXADPNRNGNRPNTS_SC_Compu "" RAT_FUNC "%6.2" "" COEFFS 0 1 0 0 0 1 /end COMPU_METHOD
/begin COMPU_METHOD MIXADPNSPDVBL_SC_Compu "" TAB_VERB "%6.3" "" COMPU_TAB_REF MIXADPNSPDVBL_SC_Compu /end COMPU_METHOD
/begin COMPU_VTAB MIXADPNSPDVBL_SC_Compu "" TAB_VERB 2 0 "False" 1 "True" /end COMPU_VTAB
/begin COMPU_METHOD MIXCORRNTQ_SC_Compu "" TAB_VERB "%6.3" "" COMPU_TAB_REF MIXCORRNTQ_SC_Compu /end COMPU_METHOD
/begin COMPU_VTAB MIXCORRNTQ_SC_Compu "" TAB_VERB 2 0 "0" 1 "1" /end COMPU_VTAB
/begin COMPU_METHOD MMSBKVSR_SY_Compu "" TAB_VERB "%6.3" "" COMPU_TAB_REF MMSBKVSR_SY_Compu /end COMPU_METHOD
/begin COMPU_VTAB MMSBKVSR_SY_Compu "" TAB_VERB 2 0 "False" 1 "True" /end COMPU_VTAB
/begin COMPU_METHOD MOCCPU_IT_SY_Compu "" TAB_VERB "%6.3" "" COMPU_TAB_REF MOCCPU_IT_SY_Compu /end COMPU_METHOD
/begin COMPU_VTAB MOCCPU_IT_SY_Compu "" TAB_VERB 7 0 "CHISTE" 1 "FIT" 2 "OTCG" 3 "CHISTEundOTCG" 4 "FITundOTCG" 5 "Lock-Step" 6 "HW_CMPBL_SOLN" /end COMPU_VTAB
/begin COMPU_METHOD MOCFC_GTMCLKMON_SC_Compu "" TAB_VERB "%6.3" "" COMPU_TAB_REF MOCFC_GTMCLKMON_SC_Compu /end COMPU_METHOD
/begin COMPU_VTAB MOCFC_GTMCLKMON_SC_Compu "" TAB_VERB 2 0 "False" 1 "True" /end COMPU_VTAB
/begin COMPU_METHOD MOCFC_GTMCONNTYP_SC_Compu "" TAB_VERB "%6.3" "" COMPU_TAB_REF MOCFC_GTMCONNTYP_SC_Compu /end COMPU_METHOD
/begin COMPU_VTAB MOCFC_GTMCONNTYP_SC_Compu "" TAB_VERB 2 0 "PORT" 1 "AUX_IN" /end COMPU_VTAB
/begin COMPU_METHOD MOCFC_NRCYCBLK_SC_Compu "" RAT_FUNC "%6.2" "" COEFFS 0 1 0 0 0 1 /end COMPU_METHOD
/begin COMPU_METHOD MOCFC_NRFASTCYCBLK_SC_Compu "" RAT_FUNC "%6.2" "" COEFFS 0 1 0 0 0 1 /end COMPU_METHOD
/begin COMPU_METHOD MOCFC_POSTBLDCHKS_SC_Compu "" TAB_VERB "%6.3" "" COMPU_TAB_REF MOCFC_POSTBLDCHKS_SC_Compu /end COMPU_METHOD
/begin COMPU_VTAB MOCFC_POSTBLDCHKS_SC_Compu "" TAB_VERB 2 0 "False" 1 "True" /end COMPU_VTAB
/begin COMPU_METHOD MOCFC_SCCERRREACTN_SC_Compu "" TAB_VERB "%6.3" "" COMPU_TAB_REF MOCFC_SCCERRREACTN_SC_Compu /end COMPU_METHOD
/begin COMPU_VTAB MOCFC_SCCERRREACTN_SC_Compu "" TAB_VERB 2 0 "Disable" 1 "Enable" /end COMPU_VTAB
/begin COMPU_METHOD MOCMM_ABESHTOFFPAHTESTENA_SC_Compu "" TAB_VERB "%6.3" "" COMPU_TAB_REF MOCMM_ABESHTOFFPAHTESTENA_SC_Compu /end COMPU_METHOD
/begin COMPU_VTAB MOCMM_ABESHTOFFPAHTESTENA_SC_Compu "" TAB_VERB 2 0 "False" 1 "True" /end COMPU_VTAB
/begin COMPU_METHOD MOCMM_CANSHOFFPAHTESTENA_SC_Compu "" TAB_VERB "%6.3" "" COMPU_TAB_REF MOCMM_CANSHOFFPAHTESTENA_SC_Compu /end COMPU_METHOD
/begin COMPU_VTAB MOCMM_CANSHOFFPAHTESTENA_SC_Compu "" TAB_VERB 2 0 "Disabled" 1 "Enabled" /end COMPU_VTAB
/begin COMPU_METHOD MOCMM_FRSHOFFPAHTESTENA_SC_Compu "" TAB_VERB "%6.3" "" COMPU_TAB_REF MOCMM_FRSHOFFPAHTESTENA_SC_Compu /end COMPU_METHOD
/begin COMPU_VTAB MOCMM_FRSHOFFPAHTESTENA_SC_Compu "" TAB_VERB 2 0 "Disabled" 1 "Enabled" /end COMPU_VTAB
/begin COMPU_METHOD MOCMM_MCUINJSHTOFFPAHTESTENA_SC_Compu "" TAB_VERB "%6.3" "" COMPU_TAB_REF MOCMM_MCUINJSHTOFFPAHTESTENA_SC_Compu /end COMPU_METHOD
/begin COMPU_VTAB MOCMM_MCUINJSHTOFFPAHTESTENA_SC_Compu "" TAB_VERB 2 0 "False" 1 "True" /end COMPU_VTAB
/begin COMPU_METHOD MOCMM_NRTRCV_SC_Compu "" RAT_FUNC "%6.2" "" COEFFS 0 1 0 0 0 1 /end COMPU_METHOD
/begin COMPU_METHOD MOCMM_UCHIP_SC_Compu "" TAB_VERB "%6.3" "" COMPU_TAB_REF MOCMM_UCHIP_SC_Compu /end COMPU_METHOD
/begin COMPU_VTAB MOCMM_UCHIP_SC_Compu "" TAB_VERB 2 0 "False" 1 "True" /end COMPU_VTAB
/begin COMPU_METHOD mOilAsh_g "" RAT_FUNC "%6.4" "g" COEFFS 0 100 0 0 0 1 /end COMPU_METHOD
/begin COMPU_METHOD Molmass "" RAT_FUNC "%6.4" "g/mol" COEFFS 0 100 0 0 0 1 /end COMPU_METHOD
/begin COMPU_METHOD MO_AUXHTRPRS_SY_Compu "" RAT_FUNC "%6.2" "" COEFFS 0 1 0 0 0 1 /end COMPU_METHOD
/begin COMPU_METHOD MO_CMNDSLGSLSW_SC_Compu "" TAB_VERB "%6.3" "" COMPU_TAB_REF MO_CMNDSLGSLSW_SC_Compu /end COMPU_METHOD
/begin COMPU_VTAB MO_CMNDSLGSLSW_SC_Compu "" TAB_VERB 2 0 "False" 1 "True" /end COMPU_VTAB
/begin COMPU_METHOD MO_COMCUST_SC_Compu "" TAB_VERB "%6.3" "" COMPU_TAB_REF MO_COMCUST_SC_Compu /end COMPU_METHOD
/begin COMPU_VTAB MO_COMCUST_SC_Compu "" TAB_VERB 24 1 "PSA" 2 "HMC" 3 "CVP" 4 "NEVS" 5 "BMW" 6 "STREETSCOOTER" 7 "VOLVO" 8 "VW" 9 "JLR" 10 "DAIMLER" 11 "SUZUKI" 12 "EGO" 13 "BYTON" 14 "FCCU" 15 "RBCD" 16 "ISUZU" 17 "KAMAZ" 18 "TOGG" 19 "NAVISTAR" 20 "HONDA" 21 "MAN" 22 "NISSAN" 23 "RSA" 24 "NIKOLA" /end COMPU_VTAB
/begin COMPU_METHOD MO_EXTDTSK_SC_Compu "" TAB_VERB "%6.3" "" COMPU_TAB_REF MO_EXTDTSK_SC_Compu /end COMPU_METHOD
/begin COMPU_VTAB MO_EXTDTSK_SC_Compu "" TAB_VERB 4 0 "Disabled" 2 "2ms" 4 "4ms" 5 "5ms" /end COMPU_VTAB
/begin COMPU_METHOD MO_FRDMINTFRMETHOD_SC_Compu "" TAB_VERB "%6.3" "" COMPU_TAB_REF MO_FRDMINTFRMETHOD_SC_Compu /end COMPU_METHOD
/begin COMPU_VTAB MO_FRDMINTFRMETHOD_SC_Compu "" TAB_VERB 3 0 "CPL" 1 "MPU" 2 "CPL_MPU" /end COMPU_VTAB
/begin COMPU_METHOD MO_LBISTENA_SC_Compu "" TAB_VERB "%6.3" "" COMPU_TAB_REF MO_LBISTENA_SC_Compu /end COMPU_METHOD
/begin COMPU_VTAB MO_LBISTENA_SC_Compu "" TAB_VERB 2 0 "Disabled" 1 "Enabled" /end COMPU_VTAB
/begin COMPU_METHOD MO_MAXVALINDCR_SC_Compu "" TAB_VERB "%6.3" "" COMPU_TAB_REF MO_MAXVALINDCR_SC_Compu /end COMPU_METHOD
/begin COMPU_VTAB MO_MAXVALINDCR_SC_Compu "" TAB_VERB 2 0 "Disabled" 1 "Enabled" /end COMPU_VTAB
/begin COMPU_METHOD MO_NRSLOTS_SC_Compu "" RAT_FUNC "%6.2" "" COEFFS 0 1 0 0 0 1 /end COMPU_METHOD
/begin COMPU_METHOD MO_NRUSEDCORESFTY_SC_Compu "" TAB_VERB "%6.3" "" COMPU_TAB_REF MO_NRUSEDCORESFTY_SC_Compu /end COMPU_METHOD
/begin COMPU_VTAB MO_NRUSEDCORESFTY_SC_Compu "" TAB_VERB 8 1 "Core0" 2 "Core1" 3 "Core0_and_Core1" 4 "Core2" 5 "Core0_and_Core2" 6 "Core1_and_Core2" 7 "Core0_Core1_and_Core2" 8 "Core3" /end COMPU_VTAB
/begin COMPU_METHOD MO_RAMCHKTYP_SC_Compu "" TAB_VERB "%6.3" "" COMPU_TAB_REF MO_RAMCHKTYP_SC_Compu /end COMPU_METHOD
/begin COMPU_VTAB MO_RAMCHKTYP_SC_Compu "" TAB_VERB 2 1 "Default" 2 "MBIST" /end COMPU_VTAB
/begin COMPU_METHOD MO_ROM_SY_Compu "" TAB_VERB "%6.3" "" COMPU_TAB_REF MO_ROM_SY_Compu /end COMPU_METHOD
/begin COMPU_VTAB MO_ROM_SY_Compu "" TAB_VERB 2 0 "False" 1 "True" /end COMPU_VTAB
/begin COMPU_METHOD MO_VDD5MONHWTYP_SC_Compu "" TAB_VERB "%6.3" "" COMPU_TAB_REF MO_VDD5MONHWTYP_SC_Compu /end COMPU_METHOD
/begin COMPU_VTAB MO_VDD5MONHWTYP_SC_Compu "" TAB_VERB 2 0 "ASIC" 1 "DIPO_CIRC" /end COMPU_VTAB
/begin COMPU_METHOD MRLY_STACTDSQENA_SC_Compu "" TAB_VERB "%6.3" "" COMPU_TAB_REF MRLY_STACTDSQENA_SC_Compu /end COMPU_METHOD
/begin COMPU_VTAB MRLY_STACTDSQENA_SC_Compu "" TAB_VERB 2 0 "Disabled" 1 "Enabled" /end COMPU_VTAB
/begin COMPU_METHOD MSAPP1_SY_Compu "" TAB_VERB "%6.3" "" COMPU_TAB_REF MSAPP1_SY_Compu /end COMPU_METHOD
/begin COMPU_VTAB MSAPP1_SY_Compu "" TAB_VERB 3 0 "Switch connected to master" 1 "Switch connected to slave1" 2 "Switch connected to slave2" /end COMPU_VTAB
/begin COMPU_METHOD MSAPP2_SY_Compu "" TAB_VERB "%6.3" "" COMPU_TAB_REF MSAPP2_SY_Compu /end COMPU_METHOD
/begin COMPU_VTAB MSAPP2_SY_Compu "" TAB_VERB 3 0 "Switch connected to master" 1 "Switch connected to slave1" 2 "Switch connected to slave2" /end COMPU_VTAB
/begin COMPU_METHOD MSBRKADC_SY_Compu "" TAB_VERB "%6.3" "" COMPU_TAB_REF MSBRKADC_SY_Compu /end COMPU_METHOD
/begin COMPU_VTAB MSBRKADC_SY_Compu "" TAB_VERB 3 0 "Switch connected to master" 1 "Switch connected to slave1" 2 "Switch connected to slave2" /end COMPU_VTAB
/begin COMPU_METHOD MSI_SC_Compu "" TAB_VERB "%6.3" "" COMPU_TAB_REF MSI_SC_Compu /end COMPU_METHOD
/begin COMPU_VTAB MSI_SC_Compu "" TAB_VERB 3 0 "0" 1 "1" 2 "2" /end COMPU_VTAB
/begin COMPU_METHOD MSI_TMPR_SY_Compu "" TAB_VERB "%6.3" "" COMPU_TAB_REF MSI_TMPR_SY_Compu /end COMPU_METHOD
/begin COMPU_VTAB MSI_TMPR_SY_Compu "" TAB_VERB 2 0 "False" 1 "True" /end COMPU_VTAB
/begin COMPU_METHOD mSoot_g "" RAT_FUNC "%6.4" "g" COEFFS 0 100 0 0 0 1 /end COMPU_METHOD
/begin COMPU_METHOD MsPerVol "" RAT_FUNC "%6.5" "g/l" COEFFS 0 1000 0 0 0 1 /end COMPU_METHOD
/begin COMPU_METHOD MsPrTime_mgprsec_q0p1_COMPU "" RAT_FUNC "%6.3" "mg/s" COEFFS 0 10 0 0 0 1 /end COMPU_METHOD
/begin COMPU_METHOD Ms_g_q0p001_COMPU "" RAT_FUNC "%6.5" "g" COEFFS 0 1000 0 0 0 1 /end COMPU_METHOD
/begin COMPU_METHOD Ms_kg_COMPU "" RAT_FUNC "%6.4" "kg" COEFFS 0 100 0 0 0 1 /end COMPU_METHOD
/begin COMPU_METHOD Ms_O2 "" RAT_FUNC "%6.5" "g" COEFFS 0 1000 0 0 0 1 /end COMPU_METHOD
/begin COMPU_METHOD Ms_SOx "" RAT_FUNC "%6.5" "g" COEFFS 0 3278.68852459016 0 0 0 1 /end COMPU_METHOD
/begin COMPU_METHOD Ms_SOxLdTot "" RAT_FUNC "%6.3" "mg" COEFFS 0 2 0 0 0 1 /end COMPU_METHOD
/begin COMPU_METHOD Ms_SOxNOx "" RAT_FUNC "%8.7" "g" COEFFS 0 100000 0 0 0 1 /end COMPU_METHOD
/begin COMPU_METHOD MUDMOD_SC_Compu "" TAB_VERB "%6.3" "" COMPU_TAB_REF MUDMOD_SC_Compu /end COMPU_METHOD
/begin COMPU_VTAB MUDMOD_SC_Compu "" TAB_VERB 2 0 "False" 1 "True" /end COMPU_VTAB
/begin COMPU_METHOD MULTIHSS_SC_Compu "" TAB_VERB "%6.3" "" COMPU_TAB_REF MULTIHSS_SC_Compu /end COMPU_METHOD
/begin COMPU_VTAB MULTIHSS_SC_Compu "" TAB_VERB 7 0 "no_MultiHss" 1 "one_MultiHss" 2 "two_MultiHss" 3 "three_MultiHss" 4 "four_MultiHss" 5 "five_MultiHss" 6 "six_MultiHss" /end COMPU_VTAB
/begin COMPU_METHOD MVBTYP_SC_Compu "" TAB_VERB "%6.3" "" COMPU_TAB_REF MVBTYP_SC_Compu /end COMPU_METHOD
/begin COMPU_VTAB MVBTYP_SC_Compu "" TAB_VERB 4 0 "Bosch" 1 "A123" 2 "Other" 3 "HMC" /end COMPU_VTAB
/begin COMPU_METHOD M_NOxLd_LoRes "" RAT_FUNC "%6.4" "g" COEFFS 0 250 0 0 0 1 /end COMPU_METHOD
/begin COMPU_METHOD m_q0p1 "" RAT_FUNC "%6.3" "kg/h" COEFFS 0 10 0 0 0 1 /end COMPU_METHOD
/begin COMPU_METHOD m_q5p4253Em7_g "" RAT_FUNC "%9.8" "g" COEFFS 0 1843200 0 0 0 1 /end COMPU_METHOD
/begin COMPU_METHOD m_uw_b6553p5 "" RAT_FUNC "%6.3" "kg/h" COEFFS 0 1 0 0 0 0.1 /end COMPU_METHOD
/begin COMPU_METHOD m_uw_bn6553p5 "" RAT_FUNC "%6.5" "kg/h" COEFFS 0 -1 0 0 0 0.1 /end COMPU_METHOD
/begin COMPU_METHOD NEOFUNCTYP_SC_Compu "" TAB_VERB "%6.3" "" COMPU_TAB_REF NEOFUNCTYP_SC_Compu /end COMPU_METHOD
/begin COMPU_VTAB NEOFUNCTYP_SC_Compu "" TAB_VERB 3 0 "Deactvd" 1 "PLL" 2 "RRS" /end COMPU_VTAB
/begin COMPU_METHOD NGINJRLYPRSNT_SC_Compu "" TAB_VERB "%6.3" "" COMPU_TAB_REF NGINJRLYPRSNT_SC_Compu /end COMPU_METHOD
/begin COMPU_VTAB NGINJRLYPRSNT_SC_Compu "" TAB_VERB 2 0 "False" 1 "True" /end COMPU_VTAB
/begin COMPU_METHOD NLKO_SY_Compu "" TAB_VERB "%6.3" "" COMPU_TAB_REF NLKO_SY_Compu /end COMPU_METHOD
/begin COMPU_VTAB NLKO_SY_Compu "" TAB_VERB 5 0 "0" 1 "1" 2 "2" 3 "3" 4 "4" /end COMPU_VTAB
/begin COMPU_METHOD NMAXDSPL_ALTDCOR_SY_Compu "" TAB_VERB "%6.3" "" COMPU_TAB_REF NMAXDSPL_ALTDCOR_SY_Compu /end COMPU_METHOD
/begin COMPU_VTAB NMAXDSPL_ALTDCOR_SY_Compu "" TAB_VERB 2 0 "False" 1 "True" /end COMPU_VTAB
/begin COMPU_METHOD NMAXDSPL_SY_Compu "" TAB_VERB "%6.3" "" COMPU_TAB_REF NMAXDSPL_SY_Compu /end COMPU_METHOD
/begin COMPU_VTAB NMAXDSPL_SY_Compu "" TAB_VERB 3 0 "0" 1 "1" 2 "2" /end COMPU_VTAB
/begin COMPU_METHOD NMAXENGEXT_SC_Compu "" TAB_VERB "%6.3" "" COMPU_TAB_REF NMAXENGEXT_SC_Compu /end COMPU_METHOD
/begin COMPU_VTAB NMAXENGEXT_SC_Compu "" TAB_VERB 2 0 "False" 1 "True" /end COMPU_VTAB
/begin COMPU_METHOD NMINENG_SC_Compu "" TAB_VERB "%6.3" "" COMPU_TAB_REF NMINENG_SC_Compu /end COMPU_METHOD
/begin COMPU_VTAB NMINENG_SC_Compu "" TAB_VERB 2 0 "False" 1 "True" /end COMPU_VTAB
/begin COMPU_METHOD nmot_ub_q40 "" RAT_FUNC "%6.1" "1/min" COEFFS 0 1 0 0 0 40 /end COMPU_METHOD
/begin COMPU_METHOD NOINIDRV_SC_Compu "" TAB_VERB "%6.3" "" COMPU_TAB_REF NOINIDRV_SC_Compu /end COMPU_METHOD
/begin COMPU_VTAB NOINIDRV_SC_Compu "" TAB_VERB 2 0 "IniDrv" 1 "NoIniDrv" /end COMPU_VTAB
/begin COMPU_METHOD NOMIDLSPD_ATS_SY_Compu "" RAT_FUNC "%6.2" "" COEFFS 0 1 0 0 0 1 /end COMPU_METHOD
/begin COMPU_METHOD NOREINI_SC_Compu "" TAB_VERB "%6.3" "" COMPU_TAB_REF NOREINI_SC_Compu /end COMPU_METHOD
/begin COMPU_VTAB NOREINI_SC_Compu "" TAB_VERB 2 0 "Reini" 1 "NoReini" /end COMPU_VTAB
/begin COMPU_METHOD NOSTSPSWT_SY_Compu "" TAB_VERB "%6.3" "" COMPU_TAB_REF NOSTSPSWT_SY_Compu /end COMPU_METHOD
/begin COMPU_VTAB NOSTSPSWT_SY_Compu "" TAB_VERB 2 0 "False" 1 "True" /end COMPU_VTAB
/begin COMPU_METHOD nox "" RAT_FUNC "%6.2" "ppm" COEFFS 0 1 0 0 0 1 /end COMPU_METHOD
/begin COMPU_METHOD NOxFlwEG "" RAT_FUNC "%6.4" "Gram/s" COEFFS 0 40 0 0 0 1 /end COMPU_METHOD
/begin COMPU_METHOD NOxLdPerFl "" RAT_FUNC "%6.5" "1/l" COEFFS 0 8192 0 0 0 1 /end COMPU_METHOD
/begin COMPU_METHOD NOxMassFlw "" RAT_FUNC "%6.5" "mg/s" COEFFS 0 1000 0 0 0 1 /end COMPU_METHOD
/begin COMPU_METHOD NOxMassPerTime "" RAT_FUNC "%6.3" "mg/s" COEFFS 0 10 0 0 0 1 /end COMPU_METHOD
/begin COMPU_METHOD NRADCKNKSIG_SC_Compu "" TAB_VERB "%6.3" "" COMPU_TAB_REF NRADCKNKSIG_SC_Compu /end COMPU_METHOD
/begin COMPU_VTAB NRADCKNKSIG_SC_Compu "" TAB_VERB 4 1 "1ADC" 2 "2ADC" 3 "3ADC" 4 "4ADC" /end COMPU_VTAB
/begin COMPU_METHOD NRGEARTRSM_SC_Compu "" TAB_VERB "%6.3" "" COMPU_TAB_REF NRGEARTRSM_SC_Compu /end COMPU_METHOD
/begin COMPU_VTAB NRGEARTRSM_SC_Compu "" TAB_VERB 2 0 "PT_rTrq" 1 "Tra_numGear" /end COMPU_VTAB
/begin COMPU_METHOD NRKNKSNSRMAX_SC_Compu "" TAB_VERB "%6.3" "" COMPU_TAB_REF NRKNKSNSRMAX_SC_Compu /end COMPU_METHOD
/begin COMPU_VTAB NRKNKSNSRMAX_SC_Compu "" TAB_VERB 5 0 "0" 1 "1" 2 "2" 3 "3" 4 "4" /end COMPU_VTAB
/begin COMPU_METHOD NRTELLTLLAMP_SC_Compu "" TAB_VERB "%6.3" "" COMPU_TAB_REF NRTELLTLLAMP_SC_Compu /end COMPU_METHOD
/begin COMPU_VTAB NRTELLTLLAMP_SC_Compu "" TAB_VERB 3 0 "None" 1 "Single" 2 "Two" /end COMPU_VTAB
/begin COMPU_METHOD NSC1B1_SC_Compu "" TAB_VERB "%6.3" "" COMPU_TAB_REF NSC1B1_SC_Compu /end COMPU_METHOD
/begin COMPU_VTAB NSC1B1_SC_Compu "" TAB_VERB 2 0 "False" 1 "True" /end COMPU_VTAB
/begin COMPU_METHOD NSC1B2_SC_Compu "" TAB_VERB "%6.3" "" COMPU_TAB_REF NSC1B2_SC_Compu /end COMPU_METHOD
/begin COMPU_VTAB NSC1B2_SC_Compu "" TAB_VERB 2 0 "False" 1 "True" /end COMPU_VTAB
/begin COMPU_METHOD NSC2B1_SC_Compu "" TAB_VERB "%6.3" "" COMPU_TAB_REF NSC2B1_SC_Compu /end COMPU_METHOD
/begin COMPU_VTAB NSC2B1_SC_Compu "" TAB_VERB 2 0 "False" 1 "True" /end COMPU_VTAB
/begin COMPU_METHOD OneToOne "" RAT_FUNC "%6.2" "-" COEFFS 0 1 0 0 0 1 /end COMPU_METHOD
/begin COMPU_METHOD Prc "" RAT_FUNC "%6.4" "%" COEFFS 0 81.92 0 0 0 1 /end COMPU_METHOD
/begin COMPU_METHOD Pres "" RAT_FUNC "%6.3" "kPa" COEFFS 0 10 0 0 0 1 /end COMPU_METHOD
/begin COMPU_METHOD Pres_hPa "" RAT_FUNC "%6.2" "hPa" COEFFS 0 1 0 0 0 1 /end COMPU_METHOD
/begin COMPU_METHOD relDK_ub_b100 "" RAT_FUNC "%6.3" "%DK" COEFFS 0 255 0 0 0 100 /end COMPU_METHOD
/begin COMPU_METHOD relDK_uw_b100 "" RAT_FUNC "%6.4" "%DK" COEFFS 0 65535 0 0 0 100 /end COMPU_METHOD
/begin COMPU_METHOD rel_q0p02344 "" RAT_FUNC "%6.4" "%" COEFFS 0 32 0 0 0 0.75 /end COMPU_METHOD
/begin COMPU_METHOD rel_sw_b100 "" RAT_FUNC "%6.4" "%" COEFFS 0 32768 0 0 0 100 /end COMPU_METHOD
/begin COMPU_METHOD rel_uw_b100 "" RAT_FUNC "%6.4" "%" COEFFS 0 65536 0 0 0 100 /end COMPU_METHOD
/begin COMPU_METHOD rel_uw_b3072 "" RAT_FUNC "%6.4" "%" COEFFS 0 65536 0 0 0 3072 /end COMPU_METHOD
/begin COMPU_METHOD rel_uw_q0p0234 "" RAT_FUNC "%6.4" "%" COEFFS 0 32 0 0 0 0.75 /end COMPU_METHOD
/begin COMPU_METHOD spg_q7p629Em7_V_ms "" RAT_FUNC "%9.8" "V*ms" COEFFS 0 65536 0 0 0 0.05 /end COMPU_METHOD
/begin COMPU_METHOD Temp_Cels "" RAT_FUNC "%6.1" "deg C" COEFFS 0 10 2731.4 0 0 1 /end COMPU_METHOD
/begin COMPU_METHOD temp_q0p0234_o273 "" RAT_FUNC "%6.1" "Grad C" COEFFS 0 1 273.15 0 0 0.0234375 /end COMPU_METHOD
/begin COMPU_METHOD temp_ub_q0p75_o48 "" RAT_FUNC "%6.2" "Grad C" COEFFS 0 1 48 0 0 0.75 /end COMPU_METHOD
/begin COMPU_METHOD TimeDeb "" RAT_FUNC "%6.1" "ms" COEFFS 0 0.1 0 0 0 1 /end COMPU_METHOD
/begin COMPU_METHOD TimeDelay_ms "" RAT_FUNC "%13.2" "ms" COEFFS 0 0 1 0 2.3283064365387e-007 0 /end COMPU_METHOD
/begin COMPU_METHOD TimeDelay_s "" RAT_FUNC "%6.1" "s" COEFFS 0 0 1 0 0.00023283064365387 0 /end COMPU_METHOD
/begin COMPU_METHOD Time_Dt "" RAT_FUNC "%9.8" "s" COEFFS 0 1000000 0 0 0 1 /end COMPU_METHOD
/begin COMPU_METHOD Time_ms "" RAT_FUNC "%6.1" "ms" COEFFS 0 0.1 0 0 0 1 /end COMPU_METHOD
/begin COMPU_METHOD Time_s "" RAT_FUNC "%6.4" "s" COEFFS 0 100 0 0 0 1 /end COMPU_METHOD
/begin COMPU_METHOD TransR "" RAT_FUNC "%6.4" "-" COEFFS 0 100 0 0 0 1 /end COMPU_METHOD
/begin COMPU_METHOD TransR_COMPU "" RAT_FUNC "%6.4" "" COEFFS 0 64 0 0 0 1 /end COMPU_METHOD
/begin COMPU_METHOD Trq "" RAT_FUNC "%6.3" "Nm" COEFFS 0 10 0 0 0 1 /end COMPU_METHOD
/begin COMPU_METHOD Trq_float "" RAT_FUNC "%6.2" "Nm" COEFFS 0 1 0 0 0 1 /end COMPU_METHOD
/begin COMPU_METHOD t_q0p01 "" RAT_FUNC "%6.4" "s" COEFFS 0 100 0 0 0 1 /end COMPU_METHOD
/begin COMPU_METHOD t_q0p02 "" RAT_FUNC "%6.4" "s" COEFFS 0 100 0 0 0 2 /end COMPU_METHOD
/begin COMPU_METHOD Vel "" RAT_FUNC "%6.4" "km/h" COEFFS 0 100 0 0 0 1 /end COMPU_METHOD
/begin COMPU_METHOD Vel_CrCtl "" RAT_FUNC "%6.4" "km/h" COEFFS 0 256 0 0 0 1 /end COMPU_METHOD
/begin COMPU_METHOD Volt "" RAT_FUNC "%6.3" "mV" COEFFS 0 5 0 0 0 1 /end COMPU_METHOD
/begin COMPU_METHOD Volt_Batt "" RAT_FUNC "%6.1" "mV" COEFFS 0 0.05 0 0 0 1 /end COMPU_METHOD
/begin COMPU_METHOD zw_sb_q0p75 "" RAT_FUNC "%6.3" "Grad KW" COEFFS 0 255 0 0 0 191.25 /end COMPU_METHOD
/begin RECORD_LAYOUT KlAxU8SstxU16WU16 NO_AXIS_PTS_X 1 UWORD AXIS_PTS_X 2 UWORD INDEX_INCR DIRECT FNC_VALUES 3 UWORD COLUMN_DIR DIRECT /end RECORD_LAYOUT
/begin RECORD_LAYOUT KwWS16 FNC_VALUES 1 SWORD COLUMN_DIR DIRECT /end RECORD_LAYOUT
/begin RECORD_LAYOUT KwWU8 FNC_VALUES 1 UBYTE COLUMN_DIR DIRECT /end RECORD_LAYOUT
/begin RECORD_LAYOUT Kw_Ws16 FNC_VALUES 1 SWORD COLUMN_DIR DIRECT /end RECORD_LAYOUT
/begin RECORD_LAYOUT Kw_Wu16 FNC_VALUES 1 UWORD COLUMN_DIR DIRECT /end RECORD_LAYOUT
/begin RECORD_LAYOUT RB_Axis_S16 NO_AXIS_PTS_X 1 SWORD AXIS_PTS_X 2 SWORD INDEX_INCR DIRECT /end RECORD_LAYOUT
/begin RECORD_LAYOUT RB_Axis_U16 NO_AXIS_PTS_X 1 UWORD AXIS_PTS_X 2 UWORD INDEX_INCR DIRECT /end RECORD_LAYOUT
/begin RECORD_LAYOUT RB_CurveGroup_S8 FNC_VALUES 1 SBYTE COLUMN_DIR DIRECT /end RECORD_LAYOUT
/begin RECORD_LAYOUT RB_Curve_S16_S16 NO_AXIS_PTS_X 1 SWORD AXIS_PTS_X 2 SWORD INDEX_INCR DIRECT FNC_VALUES 3 SWORD COLUMN_DIR DIRECT /end RECORD_LAYOUT
/begin RECORD_LAYOUT RB_Curve_S16_S8_Static NO_AXIS_PTS_X 1 SWORD AXIS_PTS_X 2 SWORD INDEX_INCR DIRECT FNC_VALUES 3 SBYTE COLUMN_DIR DIRECT STATIC_RECORD_LAYOUT /end RECORD_LAYOUT
/begin RECORD_LAYOUT RB_Curve_S16_U16_Static NO_AXIS_PTS_X 1 SWORD AXIS_PTS_X 2 SWORD INDEX_INCR DIRECT FNC_VALUES 3 UWORD COLUMN_DIR DIRECT STATIC_RECORD_LAYOUT /end RECORD_LAYOUT
/begin RECORD_LAYOUT RB_Curve_S16_U8_Static NO_AXIS_PTS_X 1 SWORD AXIS_PTS_X 2 SWORD INDEX_INCR DIRECT FNC_VALUES 3 UBYTE COLUMN_DIR DIRECT STATIC_RECORD_LAYOUT /end RECORD_LAYOUT
/begin RECORD_LAYOUT RB_Curve_U16_U16 NO_AXIS_PTS_X 1 UWORD AXIS_PTS_X 2 UWORD INDEX_INCR DIRECT FNC_VALUES 3 UWORD COLUMN_DIR DIRECT /end RECORD_LAYOUT
/begin RECORD_LAYOUT RB_MapGroup_S8 FNC_VALUES 1 SBYTE COLUMN_DIR DIRECT /end RECORD_LAYOUT
/begin RECORD_LAYOUT RB_Map_S16S16_U16 NO_AXIS_PTS_X 1 SWORD NO_AXIS_PTS_Y 2 SWORD AXIS_PTS_X 3 SWORD INDEX_INCR DIRECT AXIS_PTS_Y 4 SWORD INDEX_INCR DIRECT FNC_VALUES 5 UWORD COLUMN_DIR DIRECT /end RECORD_LAYOUT
/begin RECORD_LAYOUT RB_Map_S16U8_S8 NO_AXIS_PTS_X 1 SWORD NO_AXIS_PTS_Y 2 SWORD AXIS_PTS_X 3 SWORD INDEX_INCR DIRECT AXIS_PTS_Y 4 UBYTE INDEX_INCR DIRECT FNC_VALUES 5 SBYTE COLUMN_DIR DIRECT /end RECORD_LAYOUT
/begin RECORD_LAYOUT RB_Map_U16U16_U16 NO_AXIS_PTS_X 1 UWORD NO_AXIS_PTS_Y 2 UWORD AXIS_PTS_X 3 UWORD INDEX_INCR DIRECT AXIS_PTS_Y 4 UWORD INDEX_INCR DIRECT FNC_VALUES 5 UWORD COLUMN_DIR DIRECT /end RECORD_LAYOUT
/begin RECORD_LAYOUT RB_Map_U8U8_S16 NO_AXIS_PTS_X 1 UBYTE NO_AXIS_PTS_Y 2 UBYTE AXIS_PTS_X 3 UBYTE INDEX_INCR DIRECT AXIS_PTS_Y 4 UBYTE INDEX_INCR DIRECT FNC_VALUES 5 SWORD COLUMN_DIR DIRECT /end RECORD_LAYOUT
/begin RECORD_LAYOUT RB_ValA_Wu8 FNC_VALUES 1 UBYTE COLUMN_DIR DIRECT /end RECORD_LAYOUT
/begin RECORD_LAYOUT RB_Val_Wboolean FNC_VALUES 1 UBYTE COLUMN_DIR DIRECT /end RECORD_LAYOUT
/begin RECORD_LAYOUT RB_Val_Ws16 FNC_VALUES 1 SWORD COLUMN_DIR DIRECT /end RECORD_LAYOUT
/begin RECORD_LAYOUT RB_Val_Ws32 FNC_VALUES 1 SLONG COLUMN_DIR DIRECT /end RECORD_LAYOUT
/begin RECORD_LAYOUT RB_Val_Ws8 FNC_VALUES 1 SBYTE COLUMN_DIR DIRECT /end RECORD_LAYOUT
/begin RECORD_LAYOUT RB_Val_Wu16 FNC_VALUES 1 UWORD COLUMN_DIR DIRECT /end RECORD_LAYOUT
/begin RECORD_LAYOUT RB_Val_Wu8 FNC_VALUES 1 UBYTE COLUMN_DIR DIRECT /end RECORD_LAYOUT
/begin RECORD_LAYOUT ValA_Ws16 FNC_VALUES 1 SWORD COLUMN_DIR DIRECT /end RECORD_LAYOUT
/begin RECORD_LAYOUT ValA_Wu16 FNC_VALUES 1 UWORD COLUMN_DIR DIRECT /end RECORD_LAYOUT
/begin RECORD_LAYOUT Val_Ws16 FNC_VALUES 1 SWORD COLUMN_DIR DIRECT /end RECORD_LAYOUT
/begin RECORD_LAYOUT Val_Ws32 FNC_VALUES 1 SLONG COLUMN_DIR DIRECT /end RECORD_LAYOUT
/begin RECORD_LAYOUT Val_Wu8 FNC_VALUES 1 UBYTE COLUMN_DIR DIRECT /end RECORD_LAYOUT
/end MODULE
/end PROJECT
