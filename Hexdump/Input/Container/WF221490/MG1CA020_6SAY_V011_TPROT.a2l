ASAP2_VERSION 1 60
/begin PROJECT MG1CA020 "MG1CA020"
/begin HEADER "" VERSION "MG1CA020_6SAY_V011_TPROT" PROJECT_NO MG1CA020 /end HEADER
/begin MODULE DIM ""
/begin MOD_COMMON "" BYTE_ORDER MSB_LAST ALIGNMENT_BYTE 1 ALIGNMENT_WORD 2 ALIGNMENT_LONG 4 ALIGNMENT_INT64 4 ALIGNMENT_FLOAT32_IEEE 4 ALIGNMENT_FLOAT64_IEEE 4 DATA_SIZE 32 /end MOD_COMMON
/begin CHARACTERISTIC TWCC_drIDLaH2Pri_C "maximum threshold of delta lambda gradient (H2), primary control enable" VALUE 0x80535BDA RB_Val_Ws16 0.1999969 fak_q3p0518Em6 -0.1000000 0.0999969 FORMAT "%9.7" EXTENDED_LIMITS -0.1000000 0.09999695 /end CHARACTERISTIC
/begin CHARACTERISTIC TWCC_facFltActPTPri_C "factor filter actual value with PT1 primary control continuous" VALUE 0x80535840 RB_Val_Wu16 1.999969 fak_uw_b2 0.00 1.999969 FORMAT "%8.6" /end CHARACTERISTIC
/begin CHARACTERISTIC TWCC_facIGnCtlPriB1_CUR "factor i-part gain controller primary control continuous" CURVE 0x80535842 RB_Curve_S16_U16_Static 9.999847 fak_q0p00015259 0.00 9.999847 FORMAT "%8.6"
 /begin AXIS_DESCR STD_AXIS ExhMod_dmExhS2B1 m_q0p1 8 -3276.800 3276.700 FORMAT "%8.3" DEPOSIT ABSOLUTE /end AXIS_DESCR
/end CHARACTERISTIC
/begin CHARACTERISTIC TWCC_facILamLinPri_CUR "curve for weighting of I part control error, primary control continuous" CURVE 0x80535864 RB_Curve_S16_S16 1.999969 fak_sw_b1 -1.000000 0.999969 FORMAT "%8.6" EXTENDED_LIMITS -1.000000 0.9999695
 /begin AXIS_DESCR STD_AXIS NO_INPUT_QUANTITY fak_sw_b1 9 -1.000000 0.999969 FORMAT "%8.6" EXTENDED_LIMITS -1.000000 0.9999695 DEPOSIT ABSOLUTE /end AXIS_DESCR
/end CHARACTERISTIC
/begin CHARACTERISTIC TWCC_facIOSCAbsPriB1_CUR "factor i-part absolute OSC primary control continuous" CURVE 0x8053588A RB_Curve_U16_U8_Static 0.9961 fak_ub_b1 0.00 0.9961
 /begin AXIS_DESCR STD_AXIS NO_INPUT_QUANTITY m_q1_mg 4 0.00 65535.00 FORMAT "%8.2" DEPOSIT ABSOLUTE /end AXIS_DESCR
/end CHARACTERISTIC
/begin CHARACTERISTIC TWCC_facIOSCPriB1_CUR "factor i-part OSC primary control continuous" CURVE 0x80535898 RB_Curve_U8_U8 0.9961 fak_ub_b1 0.00 0.9961
 /begin AXIS_DESCR STD_AXIS fcoscxk fak_q0p0078 4 0.00 1.992 FORMAT "%5.3" DEPOSIT ABSOLUTE /end AXIS_DESCR
/end CHARACTERISTIC
/begin CHARACTERISTIC TWCC_facIOSCRlsH2Pri_C "oxygen storage capacity ageing factor threshold for activating H2 debouncing of primary control enable" VALUE 0x80535BDC RB_Val_Wu16 1.999969 fak_uw_b2 0.00 1.999969 FORMAT "%8.6" /end CHARACTERISTIC
/begin AXIS_PTS TWCC_facOSCPri_GCUR "group curve node based on catalyst OSC ageing factor, primary control enable" 0x80535BDE TWCC_facOSCPriGCURWpDisp RB_Axis_U16 1.999969 fak_uw_b2 2 0.00 1.999969 FORMAT "%8.6" DEPOSIT ABSOLUTE /end AXIS_PTS
/begin CHARACTERISTIC TWCC_facPGnCtlPriB1_CUR "factor p-part gain controller primary control continuous" CURVE 0x805358A2 RB_Curve_U16_U8_Static 3.984 fak_ub_b4 0.00 3.984 FORMAT "%5.3"
 /begin AXIS_DESCR STD_AXIS NO_INPUT_QUANTITY m_uw_b6553p5 8 0.00 6553.500 FORMAT "%8.3" DEPOSIT ABSOLUTE /end AXIS_DESCR
/end CHARACTERISTIC
/begin CHARACTERISTIC TWCC_facPLamLinPri_CUR "curve for weighting of P part control error, primary control continuous" CURVE 0x805358BC RB_Curve_S16_S16 1.999969 fak_sw_b1 -1.000000 0.999969 FORMAT "%8.6" EXTENDED_LIMITS -1.000000 0.9999695
 /begin AXIS_DESCR STD_AXIS NO_INPUT_QUANTITY fak_sw_b1 9 -1.000000 0.999969 FORMAT "%8.6" EXTENDED_LIMITS -1.000000 0.9999695 DEPOSIT ABSOLUTE /end AXIS_DESCR
/end CHARACTERISTIC
/begin CHARACTERISTIC TWCC_facPOSCAbsPriB1_CUR "factor p-part absolute OSC primary control continuous" CURVE 0x805358E2 RB_Curve_U16_U8_Static 0.9961 fak_ub_b1 0.00 0.9961
 /begin AXIS_DESCR STD_AXIS NO_INPUT_QUANTITY m_q1_mg 4 0.00 65535.00 FORMAT "%8.2" DEPOSIT ABSOLUTE /end AXIS_DESCR
/end CHARACTERISTIC
/begin CHARACTERISTIC TWCC_facPOSCPriB1_CUR "factor p-part OSC primary control continuous" CURVE 0x805358F0 RB_Curve_U8_U8 0.9961 fak_ub_b1 0.00 0.9961
 /begin AXIS_DESCR STD_AXIS fcoscxk fak_q0p0078 4 0.00 1.992 FORMAT "%5.3" DEPOSIT ABSOLUTE /end AXIS_DESCR
/end CHARACTERISTIC
/begin CHARACTERISTIC TWCC_facTempGslCorrnPri_T "Characteristic curve for downstream sensor voltage based on temperature of the main catalyst" CURVE 0x805358FA RB_Curve_S16_U8_Static 0.9961 fak_ub_b1 0.00 0.9961
 /begin AXIS_DESCR STD_AXIS NO_INPUT_QUANTITY Temp_Cels 6 -3549.940 3003.560 FORMAT "%8.3" DEPOSIT ABSOLUTE /end AXIS_DESCR
/end CHARACTERISTIC
/begin CHARACTERISTIC TWCC_flgCtrlrRstDSMPri_CW "Code bit for resetting the controller in fault memory clearing irrespective of a check if faults are present which can lead to a false learning of the controller" VALUE 0x8053590E RB_Val_Wu8 1.00000000000 B_TRUE 0.00 1.00000000000 FORMAT "%13.11" /end CHARACTERISTIC
/begin CHARACTERISTIC TWCC_flgCtrlrRstInitPri_CW "Codebit only for calibration purpose: By reset (Ini): Resetting the controller with the value TWCC_rICtlI- nitPriB1(2)." VALUE 0x8053590F RB_Val_Wu8 1.00000000000 B_TRUE 0.00 1.00000000000 FORMAT "%13.11" /end CHARACTERISTIC
/begin CHARACTERISTIC TWCC_flgCtrlrRstPri_CW "Codebit only for calibration purpose: By reset (by deletion of fault memory): Resetting the controller with the value TWCC_rICtlInitPriB1(2)." VALUE 0x80535910 RB_Val_Wu8 1.00000000000 B_TRUE 0.00 1.00000000000 FORMAT "%13.11" /end CHARACTERISTIC
/begin CHARACTERISTIC TWCC_flgCtrlrRstSelnInitPri_CW "Codebit to enable resetting the controller during initialization." VALUE 0x80535911 RB_Val_Wu8 1.00000000000 B_TRUE 0.00 1.00000000000 FORMAT "%13.11" /end CHARACTERISTIC
/begin CHARACTERISTIC TWCC_flgDiPGlbBalPriCatHeatgEnad_C "Flag to disable p-part debouncing when catalyst heating is enabled, primary control" VALUE 0x80535BE4 RB_Val_Wu8 1.00000000000 B_TRUE 0.00 1.00000000000 FORMAT "%13.11" /end CHARACTERISTIC
/begin CHARACTERISTIC TWCC_flgEnaSpFilPri_C "flag to activate setpoint-filter, primary continuous TWC-Control" VALUE 0x80535912 RB_Val_Wu8 1.00000000000 B_TRUE 0.00 1.00000000000 FORMAT "%13.11" /end CHARACTERISTIC
/begin CHARACTERISTIC TWCC_flgPGlbRlNmotPri_CW "Disabling of P component based on current engine speed and air charge" VALUE 0x80535BE5 RB_Val_Wu8 1.00000000000 B_TRUE 0.00 1.00000000000 FORMAT "%13.11" /end CHARACTERISTIC
/begin CHARACTERISTIC TWCC_flgUCorrnActv_C "Activation of the sensor correction with catalyst temperature and age" VALUE 0x80535913 RB_Val_Wu8 1.00000000000 B_TRUE 0.00 1.00000000000 FORMAT "%13.11" /end CHARACTERISTIC
/begin CHARACTERISTIC TWCC_flguSetPApplPri_CW "Calibration flag to activate a constant voltage setpoint of primary catalyst control" VALUE 0x80535914 RB_Val_Wu8 1.00000000000 B_TRUE 0.00 1.00000000000 FORMAT "%13.11" /end CHARACTERISTIC
/begin CHARACTERISTIC TWCC_mIBalFirstStrtPri_T "mass i-part first start balanced primary control enable" CURVE 0x80535BE6 RB_CurveGroup_U16 46602.67 m_q0p711_g 0.00 46602.67 FORMAT "%8.2"
 /begin AXIS_DESCR COM_AXIS TWCC_facOSCPriGCURWpDisp fak_uw_b2 2 0.00 1.999969 FORMAT "%8.6" AXIS_PTS_REF TWCC_facOSCPri_GCUR /end AXIS_DESCR
/end CHARACTERISTIC
/begin CHARACTERISTIC TWCC_mIBalPPri_CUR "Exhaust mass threshold for I-part release based on P-part debounce integral" CURVE 0x80535BEA RB_CurveGroup_U16 7281.667 m_uw_b7281 0.00 7281.667 FORMAT "%8.3"
 /begin AXIS_DESCR COM_AXIS TWCC_facOSCPriGCURWpDisp fak_uw_b2 2 0.00 1.999969 FORMAT "%8.6" AXIS_PTS_REF TWCC_facOSCPri_GCUR /end AXIS_DESCR
/end CHARACTERISTIC
/begin CHARACTERISTIC TWCC_mIBalReStrtPri_T "mass i-part restart balanced primary control enable" CURVE 0x80535BEE RB_CurveGroup_U16 46602.67 m_q0p711_g 0.00 46602.67 FORMAT "%8.2"
 /begin AXIS_DESCR COM_AXIS TWCC_facOSCPriGCURWpDisp fak_uw_b2 2 0.00 1.999969 FORMAT "%8.6" AXIS_PTS_REF TWCC_facOSCPri_GCUR /end AXIS_DESCR
/end CHARACTERISTIC
/begin CHARACTERISTIC TWCC_mIOscRlsH2Pri_C "threshold for O2 model of H2 based I-part release, primary control" VALUE 0x80535BF2 RB_Val_Wu16 1310.700 m_q0p02_mgO2 0.00 1310.700 FORMAT "%8.3" /end CHARACTERISTIC
/begin CHARACTERISTIC TWCC_mPBalPri_CUR "Exhaust mass threshold of debouncing of P-part release, primary control" CURVE 0x80535BF4 RB_CurveGroup_U16 46602.67 m_q0p711_g 0.00 46602.67 FORMAT "%8.2"
 /begin AXIS_DESCR COM_AXIS TWCC_facOSCPriGCURWpDisp fak_uw_b2 2 0.00 1.999969 FORMAT "%8.6" AXIS_PTS_REF TWCC_facOSCPri_GCUR /end AXIS_DESCR
/end CHARACTERISTIC
/begin CHARACTERISTIC TWCC_nIMaxPri_C "Maximum engine speed, I-part release, primary control" VALUE 0x80535BF8 RB_Val_Wu16 32767.50 EngN 0.00 32767.50 FORMAT "%8.2" /end CHARACTERISTIC
/begin CHARACTERISTIC TWCC_nIMinPri_C "Minimum engine speed, I-part release, primary control" VALUE 0x80535BFA RB_Val_Wu16 32767.50 EngN 0.00 32767.50 FORMAT "%8.2" /end CHARACTERISTIC
/begin CHARACTERISTIC TWCC_nPMaxPri_C "Maximum engine speed, P-part release, primary control" VALUE 0x80535BFC RB_Val_Wu16 32767.50 EngN 0.00 32767.50 FORMAT "%8.2" /end CHARACTERISTIC
/begin CHARACTERISTIC TWCC_nPMinPri_C "Minimum engine speed, P-part release, primary control" VALUE 0x80535BFE RB_Val_Wu16 32767.50 EngN 0.00 32767.50 FORMAT "%8.2" /end CHARACTERISTIC
/begin CHARACTERISTIC TWCC_rDynSetPIniPri_CUR "Initial value of relative dynamic set point correction of primary catalyst control continuous" CURVE 0x80535916 RB_Curve_S16_S16 1.999969 fak_sw_b1 -1.000000 0.999969 FORMAT "%8.6" EXTENDED_LIMITS -1.000000 0.9999695
 /begin AXIS_DESCR STD_AXIS NO_INPUT_QUANTITY fak_q0p0078 2 0.00 1.992188 FORMAT "%8.6" EXTENDED_LIMITS -256.0000 255.9922 DEPOSIT ABSOLUTE /end AXIS_DESCR
/end CHARACTERISTIC
/begin CHARACTERISTIC TWCC_rICtlInitPriB1_C "relative i-part control value initialize primary control continuous" VALUE 0x80535920 RB_Val_Ws16 1.999969 fak_sw_b1 -1.000000 0.999969 FORMAT "%8.6" EXTENDED_LIMITS -1.000000 0.9999695 /end CHARACTERISTIC
/begin CHARACTERISTIC TWCC_rIDecLdPri_C "maximum decreasing load, I-part release, primary control" VALUE 0x80535C00 RB_Val_Ws16 1535.977 rel_q0p02344 -768.0000 767.9766 FORMAT "%8.4" /end CHARACTERISTIC
/begin CHARACTERISTIC TWCC_rIDLaH2Pri_C "delta lambda threshold for reset O2 model, i-part inhibit based on H2, primary control" VALUE 0x80535C02 RB_Val_Ws16 1.999969 fak_q3p0518Em5 -1.000000 0.999969 FORMAT "%8.6" EXTENDED_LIMITS -1.000000 0.9999695 /end CHARACTERISTIC
/begin CHARACTERISTIC TWCC_rIFlCPPri_C "relative fuel threshold by canister purge, i-part primary control enable" VALUE 0x80535C04 RB_Val_Wu16 0.9999847 fak_uw_b1 0.00 0.9999847 FORMAT "%9.7" /end CHARACTERISTIC
/begin CHARACTERISTIC TWCC_rIIncLdPri_C "maximum increasing load, I-part release, primary control" VALUE 0x80535C06 RB_Val_Ws16 1535.977 rel_q0p02344 -768.0000 767.9766 FORMAT "%8.4" /end CHARACTERISTIC
/begin CHARACTERISTIC TWCC_rILamMaxPri_C "relative i-part lambda maximum limit primary control" VALUE 0x80535922 RB_Val_Ws16 1.999969 fak_sw_b1 -1.000000 0.999969 FORMAT "%8.6" EXTENDED_LIMITS -1.000000 0.9999695 /end CHARACTERISTIC
/begin CHARACTERISTIC TWCC_rILamMinPri_C "relative i-part lambda minimum limit primary control" VALUE 0x80535924 RB_Val_Ws16 1.999969 fak_sw_b1 -1.000000 0.999969 FORMAT "%8.6" EXTENDED_LIMITS -1.000000 0.9999695 /end CHARACTERISTIC
/begin CHARACTERISTIC TWCC_rILdMaxPri_CUR "relative load maximum i-part primary control enable" CURVE 0x80535C08 RB_Curve_U16_U16 1535.977 rel_q0p02344 0.00 1535.977 FORMAT "%8.3"
 /begin AXIS_DESCR STD_AXIS Epm_nEng EngN 8 0.00 32767.50 FORMAT "%8.2" DEPOSIT ABSOLUTE /end AXIS_DESCR
/end CHARACTERISTIC
/begin CHARACTERISTIC TWCC_rILdMinPri_CUR "relative load minimum i-part primary control enable" CURVE 0x80535C2A RB_Curve_U16_U16 1535.977 rel_q0p02344 0.00 1535.977 FORMAT "%8.3"
 /begin AXIS_DESCR STD_AXIS Epm_nEng EngN 8 0.00 32767.50 FORMAT "%8.2" DEPOSIT ABSOLUTE /end AXIS_DESCR
/end CHARACTERISTIC
/begin CHARACTERISTIC TWCC_rLamCtlMaxPri_C "Maximum of relative lambda control value of primary catalyst control continuous" VALUE 0x80535926 RB_Val_Ws16 1.999969 fak_sw_b1 -1.000000 0.999969 FORMAT "%8.6" EXTENDED_LIMITS -1.000000 0.9999695 /end CHARACTERISTIC
/begin CHARACTERISTIC TWCC_rLamCtlMinPri_C "Minimum of relative lambda control value of primary catalyst control continuous" VALUE 0x80535928 RB_Val_Ws16 1.999969 fak_sw_b1 -1.000000 0.999969 FORMAT "%8.6" EXTENDED_LIMITS -1.000000 0.9999695 /end CHARACTERISTIC
/begin CHARACTERISTIC TWCC_rPBalDLaPri_MAP "relative p-part balancing delta lambda primary control continuous" MAP 0x8053592A RB_Map_S16S16_S16 1.999969 fak_sw_b1 -1.000000 0.999969 FORMAT "%8.6" EXTENDED_LIMITS -1.000000 0.9999695
 /begin AXIS_DESCR STD_AXIS NO_INPUT_QUANTITY fak_sw_b1 7 -1.000000 0.999969 FORMAT "%8.6" EXTENDED_LIMITS -1.000000 0.9999695 DEPOSIT ABSOLUTE /end AXIS_DESCR
 /begin AXIS_DESCR STD_AXIS NO_INPUT_QUANTITY fak_sw_b1 7 -1.000000 0.999969 FORMAT "%8.6" EXTENDED_LIMITS -1.000000 0.9999695 DEPOSIT ABSOLUTE /end AXIS_DESCR
/end CHARACTERISTIC
/begin CHARACTERISTIC TWCC_rPBalHysDLaPri_C "relative p-part balancing hysteresis delta lambda primary control continuous" VALUE 0x805359AC RB_Val_Ws16 1.999969 fak_sw_b1 -1.000000 0.999969 FORMAT "%8.6" EXTENDED_LIMITS -1.000000 0.9999695 /end CHARACTERISTIC
/begin CHARACTERISTIC TWCC_rPCoUsPri_C "Hysteresis threshold P-part release based on lambda controller status" VALUE 0x80535C4C RB_Val_Wu8 100.5 rel_ub_q0p75 0.00 100.5 FORMAT "%5.1" EXTENDED_LIMITS 0.00 191.3 /end CHARACTERISTIC
/begin CHARACTERISTIC TWCC_rPLdMaxPri_CUR "relative load maximum p-part primary control enable" CURVE 0x80535C4E RB_Curve_U16_U16 1535.977 rel_q0p02344 0.00 1535.977 FORMAT "%8.3"
 /begin AXIS_DESCR STD_AXIS Epm_nEng EngN 8 0.00 32767.50 FORMAT "%8.2" DEPOSIT ABSOLUTE /end AXIS_DESCR
/end CHARACTERISTIC
/begin CHARACTERISTIC TWCC_rPLdMinPri_CUR "relative load minimum p-part primary control enable" CURVE 0x80535C70 RB_Curve_U16_U16 1535.977 rel_q0p02344 0.00 1535.977 FORMAT "%8.3"
 /begin AXIS_DESCR STD_AXIS Epm_nEng EngN 8 0.00 32767.50 FORMAT "%8.2" DEPOSIT ABSOLUTE /end AXIS_DESCR
/end CHARACTERISTIC
/begin CHARACTERISTIC TWCC_stPriCont_CW "code word primary lambda control continuous" VALUE 0x805359AE RB_Val_Wu16 65535.00 dez 0.00 65535.00 FORMAT "%8.2" /end CHARACTERISTIC
/begin CHARACTERISTIC TWCC_stPriEna_CW "configuration code word of enable conditions of primary control" VALUE 0x80535C92 RB_Val_Wu16 65535.00 dez 0.00 65535.00 FORMAT "%8.2" /end CHARACTERISTIC
/begin CHARACTERISTIC TWCC_tiDynSetPPri_CUR "filter time constant of relative dynamic set point correction of primary catalyst control continuous" CURVE 0x805359B0 RB_Curve_S16_U16_Static 3276.700 t_q0p05 0.050 3276.750 FORMAT "%8.3" EXTENDED_LIMITS 0.00 3276.750
 /begin AXIS_DESCR STD_AXIS NO_INPUT_QUANTITY m_q0p1 4 -3276.800 3276.700 FORMAT "%8.3" DEPOSIT ABSOLUTE /end AXIS_DESCR
/end CHARACTERISTIC
/begin CHARACTERISTIC TWCC_tIEngPri_C "minimum engine temperature for I-part release, primary control enable" VALUE 0x80535C94 RB_Val_Ws16 6553.500 Temp_Cels -3549.940 3003.560 FORMAT "%8.3" /end CHARACTERISTIC
/begin CHARACTERISTIC TWCC_tiFltSetPPriMap_T "curve for time constant of filter for voltage setpoint primary control from map" CURVE 0x805359C2 RB_Curve_S16_U8_Static 25.50 t_q0p1 0.00 25.50 FORMAT "%5.2"
 /begin AXIS_DESCR STD_AXIS TWCC_dmExhSpFil m_q0p1 6 -3276.800 3276.700 FORMAT "%8.3" DEPOSIT ABSOLUTE /end AXIS_DESCR
/end CHARACTERISTIC
/begin CHARACTERISTIC TWCC_tiIDebFlCutPri_C "time debounce of flag fuel cut off for reset of i-part inhibit in deceleration without fuel cut off" VALUE 0x80535C96 RB_Val_Wu8 25.50 t_q0p1 0.00 25.50 FORMAT "%5.2" /end CHARACTERISTIC
/begin CHARACTERISTIC TWCC_tiIDebIdlSpdPri_C "debounce time of flag idle speed for activating i-part inhibit in deceleration without fuel cut off" VALUE 0x80535C97 RB_Val_Wu8 25.50 t_q0p1 0.00 25.50 FORMAT "%5.2" /end CHARACTERISTIC
/begin CHARACTERISTIC TWCC_tiIDebLdGradPri_C "hold time of release of I-part based on engine load gradient" VALUE 0x80535C98 RB_Val_Wu8 25.50 t_q0p1 0.00 25.50 FORMAT "%5.2" /end CHARACTERISTIC
/begin CHARACTERISTIC TWCC_tiIDebNLdPri_C "debounce time engine rotation speed and engine load for I-part primary control enable" VALUE 0x80535C99 RB_Val_Wu8 25.50 t_q0p1 0.00 25.50 FORMAT "%5.2" /end CHARACTERISTIC
/begin CHARACTERISTIC TWCC_tiILamGradH2Pri_C "time constant of lowpass of delta lambda for H2 based inhibit of I-part, primary control enable" VALUE 0x80535C9A RB_Val_Wu16 65534.000000 zk1sxs_uw_b65535 1.000000 65535.000000 FORMAT "%12.6" /end CHARACTERISTIC
/begin CHARACTERISTIC TWCC_tiILamSwtH2Pri_C "Delay of edge falling for lambda sign switch detection, H2 based inhibit of I-part, primary control" VALUE 0x80535C9C RB_Val_Wu8 255.0 t_q1 0.00 255.0 FORMAT "%5.1" /end CHARACTERISTIC
/begin CHARACTERISTIC TWCC_tiILckDecelPri_C "Time period for withdrawal of inhibit after reaching the timeout, i-part inhibit due to deceleration without fuel cut" VALUE 0x80535C9E RB_Val_Wu16 6553.500 t_q0p1 0.00 6553.500 FORMAT "%8.3" /end CHARACTERISTIC
/begin CHARACTERISTIC TWCC_tiILpLdGradPri_C "time low pass load gradient second fuel primary control enable" VALUE 0x80535CA0 RB_Val_Wu16 655.34999985 zk10msxs_uw_b655p36 0.01000015 655.36000000 FORMAT "%12.8" EXTENDED_LIMITS 0.010000152590 655.36000000 /end CHARACTERISTIC
/begin CHARACTERISTIC TWCC_tiLpActPri_CUR "time low pass actual value primary control continuous" CURVE 0x805359D6 RB_Curve_S16_U16_Static 1310.6999997 zk20msxs_uw_b1310p72 0.0200003 1310.7200000 FORMAT "%12.7" EXTENDED_LIMITS 0.020000305180 1310.7200000
 /begin AXIS_DESCR STD_AXIS NO_INPUT_QUANTITY m_q0p1 4 -3276.800 3276.700 FORMAT "%8.3" DEPOSIT ABSOLUTE /end AXIS_DESCR
/end CHARACTERISTIC
/begin CHARACTERISTIC TWCC_tiLpTCatGslPri_T "Filter time constant of the catalyst temperature dependent on the exhaust gas mass flow during gasoline operation mode" CURVE 0x805359E8 RB_Curve_S16_U16_Static 1310.6999997 zk20msxs_uw_b1310p72 0.0200003 1310.7200000 FORMAT "%12.7" EXTENDED_LIMITS 0.020000305180 1310.7200000
 /begin AXIS_DESCR STD_AXIS TWCC_dmExhSpFil m_q0p1 6 -3276.800 3276.700 FORMAT "%8.3" DEPOSIT ABSOLUTE /end AXIS_DESCR
/end CHARACTERISTIC
/begin CHARACTERISTIC TWCC_tIMaxPri_C "maximum catalyst temperature for I-part release, primary control enable" VALUE 0x80535CA2 RB_Val_Ws16 6553.500 Temp_Cels -3549.940 3003.560 FORMAT "%8.3" /end CHARACTERISTIC
/begin CHARACTERISTIC TWCC_tIMinPri_CUR "minimum catalyst temperature for I-part release, primary control enable" CURVE 0x80535CA4 RB_CurveGroup_S16 6553.500 Temp_Cels -3549.940 3003.560 FORMAT "%8.3"
 /begin AXIS_DESCR COM_AXIS TWCC_facOSCPriGCURWpDisp fak_uw_b2 2 0.00 1.999969 FORMAT "%8.6" AXIS_PTS_REF TWCC_facOSCPri_GCUR /end AXIS_DESCR
/end CHARACTERISTIC
/begin CHARACTERISTIC TWCC_tIMinTstReqPri_C "minimum catalyst temperature for I-part release during service test, primary control enable" VALUE 0x80535CA8 RB_Val_Ws16 6553.500 Temp_Cels -3549.940 3003.560 FORMAT "%8.3" /end CHARACTERISTIC
/begin CHARACTERISTIC TWCC_tiPDebCoUsPri_C "Turn off delay time P-part release based on lambda controller status" VALUE 0x80535CAA RB_Val_Wu8 25.50 t_q0p1 0.00 25.50 FORMAT "%5.2" /end CHARACTERISTIC
/begin CHARACTERISTIC TWCC_tiPDebLam1DrctPri_C "hold time for direct evaluation lambda 1 condition, p-part release, primary control enable" VALUE 0x80535CAB RB_Val_Wu8 25.50 t_q0p1 0.00 25.50 FORMAT "%5.2" /end CHARACTERISTIC
/begin CHARACTERISTIC TWCC_tiPDebLam1ErrPri_C "time for bypassing lambda 1 deviation, p-part release, primary control enable" VALUE 0x80535CAC RB_Val_Wu8 25.50 t_q0p1 0.00 25.50 FORMAT "%5.2" /end CHARACTERISTIC
/begin CHARACTERISTIC TWCC_tiPDebNLdPri_C "Debounce time rotation speed and load for P-part primary control enable" VALUE 0x80535CAD RB_Val_Wu8 255.0 t_q1 0.00 255.0 FORMAT "%5.1" /end CHARACTERISTIC
/begin CHARACTERISTIC TWCC_tiPLpCoUsPri_C "lowpass time constant P-part release based on lambda controller status" VALUE 0x80535CAE RB_Val_Wu8 25.4996 zk100msxs_ub_b25p5 0.1004 25.6000 FORMAT "%7.4" EXTENDED_LIMITS 0.100392 25.6000 /end CHARACTERISTIC
/begin CHARACTERISTIC TWCC_tPMaxPri_C "maximum catalyst temperature for P-part release, primary control enable" VALUE 0x80535CB0 RB_Val_Ws16 6553.500 Temp_Cels -3549.940 3003.560 FORMAT "%8.3" /end CHARACTERISTIC
/begin CHARACTERISTIC TWCC_tPMinPri_CUR "minimum catalyst temperature for P-part release, primary control enable" CURVE 0x80535CB2 RB_CurveGroup_S16 6553.500 Temp_Cels -3549.940 3003.560 FORMAT "%8.3"
 /begin AXIS_DESCR COM_AXIS TWCC_facOSCPriGCURWpDisp fak_uw_b2 2 0.00 1.999969 FORMAT "%8.6" AXIS_PTS_REF TWCC_facOSCPri_GCUR /end AXIS_DESCR
/end CHARACTERISTIC
/begin CHARACTERISTIC TWCC_tPMinTstReqPri_C "minimum catalyst temperature for P-part release during service test, primary control enable" VALUE 0x80535CB6 RB_Val_Ws16 6553.500 Temp_Cels -3549.940 3003.560 FORMAT "%8.3" /end CHARACTERISTIC
/begin CHARACTERISTIC TWCC_uActHiLimGslCorrnPri_M "Characteristic map for downstream sensor voltage based on OSC correction factor of the main catalyst high threshold" MAP 0x80535A02 RB_Map_U16U16_U16 4.998779 spg_q1p221Em3_V 0.00 4.998779 FORMAT "%8.6" EXTENDED_LIMITS 0.00 79.99878
 /begin AXIS_DESCR STD_AXIS TWCC_uS2B1Lam spg_q1p221Em3_V 15 0.00 4.998779 FORMAT "%8.6" EXTENDED_LIMITS 0.00 79.99878 DEPOSIT ABSOLUTE /end AXIS_DESCR
 /begin AXIS_DESCR STD_AXIS TWCC_ratO2StrB1WpDisp fak_uw_b2 5 0.00 1.999969 FORMAT "%8.6" DEPOSIT ABSOLUTE /end AXIS_DESCR
/end CHARACTERISTIC
/begin CHARACTERISTIC TWCC_uActLoLimGslCorrnPri_M "Characteristic map for downstream sensor voltage based on OSC correction factor of the main catalyst low threshold" MAP 0x80535AC4 RB_Map_U16U16_U16 4.998779 spg_q1p221Em3_V 0.00 4.998779 FORMAT "%8.6" EXTENDED_LIMITS 0.00 79.99878
 /begin AXIS_DESCR STD_AXIS TWCC_uS2B1Lam spg_q1p221Em3_V 15 0.00 4.998779 FORMAT "%8.6" EXTENDED_LIMITS 0.00 79.99878 DEPOSIT ABSOLUTE /end AXIS_DESCR
 /begin AXIS_DESCR STD_AXIS TWCC_ratO2StrB1WpDisp fak_uw_b2 5 0.00 1.999969 FORMAT "%8.6" DEPOSIT ABSOLUTE /end AXIS_DESCR
/end CHARACTERISTIC
/begin CHARACTERISTIC TWCC_uSetPApplPriB1_C "constant voltage setpoint of primary catalyst control" VALUE 0x80535B86 RB_Val_Wu8 1.245 spg_q0p00488 0.00 1.245 FORMAT "%5.3" /end CHARACTERISTIC
/begin CHARACTERISTIC TWCC_uSetPPriB1_MAP "voltage set point map primary control" MAP 0x80535B87 RB_Map_U8U8_U8 1.245 spg_q0p00488 0.00 1.245 FORMAT "%5.3"
 /begin AXIS_DESCR STD_AXIS Epm_nEngLRes nmot_ub_q40 8 0.00 10200. FORMAT "%5.0" DEPOSIT ABSOLUTE /end AXIS_DESCR
 /begin AXIS_DESCR STD_AXIS NO_INPUT_QUANTITY rel_ub_q0p75 8 0.00 191.3 FORMAT "%5.1" DEPOSIT ABSOLUTE /end AXIS_DESCR
/end CHARACTERISTIC
/begin CHARACTERISTIC TWCD_facCorrDlyB1_M "Correction factor (exhaust gas mass flow, delay time) of LSU dynamic corrected lambda before catalyst (Bank 1)" MAP 0x80535CB8 RB_Map_S16U16_U8 1.000000 fak_ub_b2 0.00 1.000000 FORMAT "%8.6" EXTENDED_LIMITS 0.00 1.992188
 /begin AXIS_DESCR STD_AXIS ExhMod_dmExhCat1B1 m_q0p1 4 -3276.800 3276.700 FORMAT "%8.3" DEPOSIT ABSOLUTE /end AXIS_DESCR
 /begin AXIS_DESCR STD_AXIS EGSDO2_tiDlyAdpnS1B1 t_q0p01 4 0.00 655.3500 FORMAT "%8.4" DEPOSIT ABSOLUTE /end AXIS_DESCR
/end CHARACTERISTIC
/begin CHARACTERISTIC TWCD_facCorrTranB1_M "Correction factor (exhaust gas mass flow, transition time) of LSU dynamic corrected lambda before catalyst (Bank 1)" MAP 0x80535CDC RB_Map_S16U16_U8 1.000000 fak_ub_b2 0.00 1.000000 FORMAT "%8.6" EXTENDED_LIMITS 0.00 1.992188
 /begin AXIS_DESCR STD_AXIS ExhMod_dmExhCat1B1 m_q0p1 4 -3276.800 3276.700 FORMAT "%8.3" DEPOSIT ABSOLUTE /end AXIS_DESCR
 /begin AXIS_DESCR STD_AXIS EGSDO2_tiTranAdpnS1B1 t_q0p01 4 0.00 655.3500 FORMAT "%8.4" DEPOSIT ABSOLUTE /end AXIS_DESCR
/end CHARACTERISTIC
/begin CHARACTERISTIC TWCD_facMLeanIR_C "Factor enleanment for IUMPR simulation of catalyst monitoring" VALUE 0x80535D00 RB_Val_Wu8 15.94 fak_ub_b16 0.00 15.94 FORMAT "%5.2" /end CHARACTERISTIC
/begin CHARACTERISTIC TWCD_facMRichIR_C "Factor enrichment for IUMPR simulation of catalyst monitoring" VALUE 0x80535D01 RB_Val_Wu8 15.94 fak_ub_b16 0.00 15.94 FORMAT "%5.2" /end CHARACTERISTIC
/begin CHARACTERISTIC TWCD_facOSCRSC_C "Ratio between oxygen storage capacity and reverse measured oxygen storage capacity" VALUE 0x80535D02 RB_Val_Wu8 15.94 fak_ub_b16 0.00 15.94 FORMAT "%5.2" /end CHARACTERISTIC
/begin CHARACTERISTIC TWCD_flgArthFltPassTstActvd_CW "CodeBit: Pass Test for arithmetic filter activated" VALUE 0x80535F50 RB_Val_Wu8 1.00000000000 B_TRUE 0.00 1.00000000000 FORMAT "%13.11" /end CHARACTERISTIC
/begin CHARACTERISTIC TWCD_flgCatDiagActvCat1B1_C "Switch for activating catalyst diagnosis catalyst 1 bank 1" VALUE 0x80535F51 RB_Val_Wu8 1.00000000000 B_TRUE 0.00 1.00000000000 FORMAT "%13.11" /end CHARACTERISTIC
/begin CHARACTERISTIC TWCD_flgEwma_CW "Codeword for activation of Moving average for catalyst diagnosis for several trips (EWMA-Filter)" VALUE 0x80535F52 RB_Val_Wu8 1.00000000000 B_TRUE 0.00 1.00000000000 FORMAT "%13.11" /end CHARACTERISTIC
/begin CHARACTERISTIC TWCD_flgOSCCorActv_CW "Codebit: Correction of OSC-measurement depending on the sensordynamics of oxygensensor downstream catayst" VALUE 0x80535D03 RB_Val_Wu8 1.00000000000 B_TRUE 0.00 1.00000000000 FORMAT "%13.11" /end CHARACTERISTIC
/begin CHARACTERISTIC TWCD_flgOSCMaxRng_CW "Codebit: upper limit of normalized OSC value is active" VALUE 0x80535F53 RB_Val_Wu8 1.00000000000 B_TRUE 0.00 1.00000000000 FORMAT "%13.11" /end CHARACTERISTIC
/begin CHARACTERISTIC TWCD_flgRSCCorActv_CW "Codebit: Correction of RSC-measurement depending on the sensordynamics of oxygensensor downstream catayst" VALUE 0x80535D04 RB_Val_Wu8 1.00000000000 B_TRUE 0.00 1.00000000000 FORMAT "%13.11" /end CHARACTERISTIC
/begin CHARACTERISTIC TWCD_FltDsEval_B1.rOfsRmnProdModParl_C "Filter class for catalyt diagnosis / calibration offset production mode" VALUE 0x80535F70 RB_Val_Wu16 15.99976 fak_uw_b16 0.00 15.99976 FORMAT "%8.5" /end CHARACTERISTIC
/begin CHARACTERISTIC TWCD_mOscIni_C "Initial Osc after power fail or DSM clear" VALUE 0x80535D08 RB_Val_Wu32 429496729.500 m_q0p1_mg 0.00 429496729.500 FORMAT "%13.3" /end CHARACTERISTIC
/begin CHARACTERISTIC TWCD_NewOscPriB1_I.OSCNrm_MAP "Calculation of the Osc of the new catalyst, Cat1B1 / map of end of life catalyst" MAP 0x80535DDC RB_Map_S16U16_U16 65535.0000 m_q1_mg 0.0000 65535.0000 FORMAT "%10.4"
 /begin AXIS_DESCR STD_AXIS TWCD_NewOscPriB1_I.tBrick Temp_Cels 8 -3549.940 3003.560 FORMAT "%8.3" DEPOSIT ABSOLUTE /end AXIS_DESCR
 /begin AXIS_DESCR STD_AXIS TWCD_NewOscPriB1_I.dmGas m_uw_b6553p5 8 0.00 6553.500 FORMAT "%8.3" DEPOSIT ABSOLUTE /end AXIS_DESCR
/end CHARACTERISTIC
/begin CHARACTERISTIC TWCD_NewOscPriB1_I.mOSCNrmShtrp_T "Calculation of the Osc of the new catalyst, Cat1B1 / OSC curve of end of life catalyst in short trip" CURVE 0x80535E80 RB_Curve_S16_U16_Static 65535.0000 m_q1_mg 0.0000 65535.0000 FORMAT "%10.4"
 /begin AXIS_DESCR STD_AXIS TWCD_NewOscPriB1_I.tBrick Temp_Cels 4 -3549.940 3003.560 FORMAT "%8.3" DEPOSIT ABSOLUTE /end AXIS_DESCR
/end CHARACTERISTIC
/begin CHARACTERISTIC TWCD_NrMeasStepChg_C "Number of measurements for Stepchange evaluation" VALUE 0x80535F54 RB_Val_Wu8 255.0 dez 0.00 255.0 FORMAT "%5.1" /end CHARACTERISTIC
/begin CHARACTERISTIC TWCD_NrmOSCPriB1_I.OSCNrm_MAP "calculation of borderline OSC, 1st cat. bank 1 / map of end of life catalyst" MAP 0x80535E98 RB_Map_S16U16_U16 65535.0000 m_q1_mg 0.0000 65535.0000 FORMAT "%10.4"
 /begin AXIS_DESCR STD_AXIS TWCD_NrmOSCPriB1_I.tBrick Temp_Cels 8 -3549.940 3003.560 FORMAT "%8.3" DEPOSIT ABSOLUTE /end AXIS_DESCR
 /begin AXIS_DESCR STD_AXIS TWCD_NrmOSCPriB1_I.dmGas m_uw_b6553p5 8 0.00 6553.500 FORMAT "%8.3" DEPOSIT ABSOLUTE /end AXIS_DESCR
/end CHARACTERISTIC
/begin CHARACTERISTIC TWCD_NrmOSCPriB1_I.mOSCNrmShtrp_T "calculation of borderline OSC, 1st cat. bank 1 / OSC curve of end of life catalyst in short trip" CURVE 0x80535F3C RB_Curve_S16_U16_Static 65535.0000 m_q1_mg 0.0000 65535.0000 FORMAT "%10.4"
 /begin AXIS_DESCR STD_AXIS TWCD_NrmOSCPriB1_I.tBrick Temp_Cels 4 -3549.940 3003.560 FORMAT "%8.3" DEPOSIT ABSOLUTE /end AXIS_DESCR
/end CHARACTERISTIC
/begin CHARACTERISTIC TWCD_numMeasShtrp_C "Number of measurements in short trip" VALUE 0x80535F55 RB_Val_Wu8 255.0 dez 0.00 255.0 FORMAT "%5.1" /end CHARACTERISTIC
/begin CHARACTERISTIC TWCD_numMeas_C "Number of measurements per DCY" VALUE 0x80535F56 RB_Val_Wu8 255.0 dez 0.00 255.0 FORMAT "%5.1" /end CHARACTERISTIC
/begin CHARACTERISTIC TWCD_ratStepChgCnf_C "Relative change to confirm EWMA step chance" VALUE 0x80535F57 RB_Val_Wu8 1.992188 fak_ub_b2 0.00 1.992188 FORMAT "%8.6" /end CHARACTERISTIC
/begin CHARACTERISTIC TWCD_ratStepChgSus_C "Relative change to trigger EWMA step chance" VALUE 0x80535F58 RB_Val_Wu8 1.992188 fak_ub_b2 0.00 1.992188 FORMAT "%8.6" /end CHARACTERISTIC
/begin CHARACTERISTIC TWCD_rOSCMaxRng_C "Upper limit of normalized OSC value" VALUE 0x80535F5A RB_Val_Wu16 15.99976 fak_uw_b16 0.00 15.99976 FORMAT "%8.5" /end CHARACTERISTIC
/begin CHARACTERISTIC TWCD_rOSCThresB1_C "OSC catalyst monitoring threshold, bank 1" VALUE 0x80535F5C RB_Val_Wu16 15.99976 fak_uw_b16 0.00 15.99976 FORMAT "%8.5" /end CHARACTERISTIC
/begin CHARACTERISTIC TWCD_rOSCThresBPUB1_C "Mean value of Best Performance Unacceptable Catalyst (Borderline catalyst)" VALUE 0x80535F5E RB_Val_Wu16 15.99976 fak_uw_b16 0.00 15.99976 FORMAT "%8.5" /end CHARACTERISTIC
/begin CHARACTERISTIC TWCD_swtEolTstRls_C "Switch to release EOL-Test result" VALUE 0x80535F60 RB_Val_Wu8 1.00000000000 B_TRUE 0.00 1.00000000000 FORMAT "%13.11" /end CHARACTERISTIC
/begin CHARACTERISTIC TWCD_tiCorLtrHEGO_M "Correction map for transition and delay time LeanToRich" MAP 0x80535D0C RB_Map_S16S16_S16 655.3400 t_q0p02 0.00 655.3400 FORMAT "%8.4" EXTENDED_LIMITS -655.3600 655.3400
 /begin AXIS_DESCR STD_AXIS NO_INPUT_QUANTITY t_q0p01 6 -327.6800 327.6700 FORMAT "%8.4" DEPOSIT ABSOLUTE /end AXIS_DESCR
 /begin AXIS_DESCR STD_AXIS NO_INPUT_QUANTITY t_q0p01 6 -327.6800 327.6700 FORMAT "%8.4" DEPOSIT ABSOLUTE /end AXIS_DESCR
/end CHARACTERISTIC
/begin CHARACTERISTIC TWCD_tiCorRtlHEGO_M "Correction map for transition and delay time RichToLean" MAP 0x80535D70 RB_Map_S16S16_S16 655.3400 t_q0p02 0.00 655.3400 FORMAT "%8.4" EXTENDED_LIMITS -655.3600 655.3400
 /begin AXIS_DESCR STD_AXIS NO_INPUT_QUANTITY t_q0p01 6 -327.6800 327.6700 FORMAT "%8.4" DEPOSIT ABSOLUTE /end AXIS_DESCR
 /begin AXIS_DESCR STD_AXIS NO_INPUT_QUANTITY t_q0p01 6 -327.6800 327.6700 FORMAT "%8.4" DEPOSIT ABSOLUTE /end AXIS_DESCR
/end CHARACTERISTIC
/begin CHARACTERISTIC TWCD_uLeanFinThres_C "Lean threshold for downstream sensor signal to end lean phase of cat monitoring" VALUE 0x80535DD4 RB_Val_Wu16 4.998779 spg_q1p221Em3_V 0.00 4.998779 FORMAT "%8.6" EXTENDED_LIMITS 0.00 79.99878 /end CHARACTERISTIC
/begin CHARACTERISTIC TWCD_uRichFinThres_C "Rich threshold for downstream sensor signal to end phase of RSC measuring" VALUE 0x80535DD6 RB_Val_Wu16 4.998779 spg_q1p221Em3_V 0.00 4.998779 FORMAT "%8.6" EXTENDED_LIMITS 0.00 79.99878 /end CHARACTERISTIC
/begin CHARACTERISTIC TWCD_valEwmaIni_C "Initialization value of EWMA-Filter after power fail" VALUE 0x80535F62 RB_Val_Wu16 15.99976 fak_uw_b16 0.00 15.99976 FORMAT "%8.5" /end CHARACTERISTIC
/begin CHARACTERISTIC TWCD_valEwma_C "Filter constant for EWMA filter catalyst diagnosis" VALUE 0x80535F64 RB_Val_Wu16 0.9999847 fak_uw_b1 0.00 0.9999847 FORMAT "%9.7" /end CHARACTERISTIC
/begin CHARACTERISTIC UEGO_CJ135CtrlS1B1_I.stNotRdyIPmpSwtOnMask_C "CJ135 ASIC control Class / Bit mask for selecting the transition conditions from mode Normal to mode Switchon" VALUE 0x80537650 RB_Val_Wu8 255.0 dez 0.00 255.0 FORMAT "%5.1" /end CHARACTERISTIC
/begin CHARACTERISTIC UEGO_CJ135CtrlS1B1_I.stNotRdyIPmpWrmUpMask_C "CJ135 ASIC control Class / Bit mask for selecting the transition conditions from mode Normal to mode Warmup" VALUE 0x80537651 RB_Val_Wu8 255.0 dez 0.00 255.0 FORMAT "%5.1" /end CHARACTERISTIC
/begin CHARACTERISTIC UEGO_CJ135CtrlS1B1_I.stRdyIPmpSwtOnMask_C "CJ135 ASIC control Class / Bit mask for selecting the transition conditions from mode Switchon to mode Normal" VALUE 0x80537652 RB_Val_Wu8 255.0 dez 0.00 255.0 FORMAT "%5.1" /end CHARACTERISTIC
/begin CHARACTERISTIC UEGO_CJ135CtrlS1B1_I.stRdyIPmpWrmUpMask_C "CJ135 ASIC control Class / Bit mask for selecting the transition conditions from mode Warmup to mode Normal" VALUE 0x80537653 RB_Val_Wu8 255.0 dez 0.00 255.0 FORMAT "%5.1" /end CHARACTERISTIC
/begin CHARACTERISTIC UEGO_CJ135CtrlS1B1_I.stRvsChrgEndMask_C "CJ135 ASIC control Class / Bit mask for selecting the transition conditions from mode RvsChrg to mode Normal_Std" VALUE 0x80537654 RB_Val_Wu8 255.0 dez 0.00 255.0 FORMAT "%5.1" /end CHARACTERISTIC
/begin CHARACTERISTIC UEGO_CJ135CtrlS1B1_I.stRvsChrgStartMask_C "CJ135 ASIC control Class / Bit mask for selecting the transition conditions from mode Normal_Std to mode RvsChrg" VALUE 0x80537655 RB_Val_Wu8 255.0 dez 0.00 255.0 FORMAT "%5.1" /end CHARACTERISTIC
/begin CHARACTERISTIC UEGO_CJ135CtrlS1B1_I.stSwtOnWrmUpMask_C "CJ135 ASIC control Class / Bit mask for selecting the transition conditions from mode Switchon to mode Warmup" VALUE 0x80537656 RB_Val_Wu8 255.0 dez 0.00 255.0 FORMAT "%5.1" /end CHARACTERISTIC
/begin CHARACTERISTIC UEGO_CJ135CtrlS1B1_I.stWrmUpSwtOnMask_C "CJ135 ASIC control Class / Bit mask for selecting the transition conditions from mode Warmup to mode Switchon" VALUE 0x80537657 RB_Val_Wu8 255.0 dez 0.00 255.0 FORMAT "%5.1" /end CHARACTERISTIC
/begin CHARACTERISTIC UEGO_idxHWES1B1_C "Assignment sensor specific data to HWE sensor 1 bank 1" VALUE 0x80537B2E RB_Val_Wu8 255.0 dez 0.00 255.0 FORMAT "%5.1" /end CHARACTERISTIC
/begin CHARACTERISTIC UEGO_iIsqChgPrimStep_C "Small deviation threshold around the ISQ set point" VALUE 0x805375C8 RB_Val_Ws16 0.04369000 i_q6p6667Em7_A -0.02184533 0.02184467 FORMAT "%10.8" /end CHARACTERISTIC
/begin CHARACTERISTIC UEGO_iIsqChgSecStep_C "Large deviation threshold around the ISQ set point." VALUE 0x805375CA RB_Val_Ws16 0.04369000 i_q6p6667Em7_A -0.02184533 0.02184467 FORMAT "%10.8" /end CHARACTERISTIC
/begin CHARACTERISTIC UEGO_iIsqRef_C "reference Isq value for calculation of digital PID parameters" VALUE 0x805375CC RB_Val_Ws16 0.02184467 i_q6p6667Em7_A 0.00 0.02184467 FORMAT "%10.8" EXTENDED_LIMITS -0.02184533 0.02184467 /end CHARACTERISTIC
/begin CHARACTERISTIC UEGO_numIsqChg_C "The maximum waiting time (counter threshold multiplied by raster time duration) to set an updated Isq value." VALUE 0x805375CE RB_Val_Wu8 255.0 dez 0.00 255.0 FORMAT "%5.1" /end CHARACTERISTIC
/begin CHARACTERISTIC UEGO_numRefPlsStd_C "number of reference pulse started" VALUE 0x805375CF RB_Val_Wu8 15.00 dez 0.00 15.00 FORMAT "%5.2" EXTENDED_LIMITS 0.00 255.0 /end CHARACTERISTIC
/begin CHARACTERISTIC UEGO_numRefPlsStop_C "number of reference pulse stopped" VALUE 0x805375D0 RB_Val_Wu8 15.00 dez 0.00 15.00 FORMAT "%5.2" EXTENDED_LIMITS 0.00 255.0 /end CHARACTERISTIC
/begin CHARACTERISTIC UEGO_numRefPlsStrt_C "number of reference pulse started" VALUE 0x805375D1 RB_Val_Wu8 15.00 dez 0.00 15.00 FORMAT "%5.2" EXTENDED_LIMITS 0.00 255.0 /end CHARACTERISTIC
/begin CHARACTERISTIC UEGO_numRegDspDiagDis_C "disable DSP diagnosis" VALUE 0x805375D2 RB_Val_Wu8 1.000 dez 0.00 1.000 FORMAT "%5.3" EXTENDED_LIMITS 0.00 255.0 /end CHARACTERISTIC
/begin CHARACTERISTIC UEGO_numRegEnSP_C "engine setpoint" VALUE 0x805375D3 RB_Val_Wu8 3.000 dez 0.00 3.000 FORMAT "%5.3" EXTENDED_LIMITS 0.00 255.0 /end CHARACTERISTIC
/begin CHARACTERISTIC UEGO_numRegFu0hys_C "converted set value for CJ135 register (part) FU0HYS" VALUE 0x805375D4 RB_Val_Wu8 1.200 spg_q0p08_V 0.00 1.200 FORMAT "%5.3" EXTENDED_LIMITS 0.00 20.40 /end CHARACTERISTIC
/begin CHARACTERISTIC UEGO_numRegFusks_C "converted set value for CJ135 register (part) FUsks" VALUE 0x805375D5 RB_Val_Wu8 3.450 spg_q0p23_V 0.00 3.450 FORMAT "%5.3" EXTENDED_LIMITS 0.00 58.65 /end CHARACTERISTIC
/begin CHARACTERISTIC UEGO_numRegIpblackRat_C "converted set value for CJ135 register (part) ipblack" VALUE 0x805375D6 RB_Val_Ws16 1.444324 fak_q1p201Em4 -0.7221622 0.7221622 FORMAT "%9.7" EXTENDED_LIMITS -3.936096 3.935976 /end CHARACTERISTIC
/begin CHARACTERISTIC UEGO_numRegIpoffRatIpPulse_C "register setting for IPOFF during ip pulses" VALUE 0x805375D8 RB_Val_Ws16 1.444324 fak_q1p201Em4 -0.7221622 0.7221622 FORMAT "%9.7" EXTENDED_LIMITS -3.936096 3.935976 /end CHARACTERISTIC
/begin CHARACTERISTIC UEGO_numRegIpoffRat_C "converted set value for CJ135 register (part) ipoff" VALUE 0x805375DA RB_Val_Ws16 1.444324 fak_q1p201Em4 -0.7221622 0.7221622 FORMAT "%9.7" EXTENDED_LIMITS -3.936096 3.935976 /end CHARACTERISTIC
/begin CHARACTERISTIC UEGO_numRegIpsetRat_C "converted set value for CJ135 register (part) ipset" VALUE 0x805375DC RB_Val_Ws16 1.444324 fak_q1p201Em4 -0.7221622 0.7221622 FORMAT "%9.7" EXTENDED_LIMITS -3.936096 3.935976 /end CHARACTERISTIC
/begin CHARACTERISTIC UEGO_numRegIpsm_C "converted set value for CJ135 register (part) ipsm" VALUE 0x805375DE RB_Val_Wu8 1.000 dez 0.00 1.000 FORMAT "%5.3" EXTENDED_LIMITS 0.00 255.0 /end CHARACTERISTIC
/begin CHARACTERISTIC UEGO_numRegIsqDiag_C "converted set value for CJ135 register (part) isq diag" VALUE 0x805375DF RB_Val_Wu8 0.01588 i_q1p25Em4_o0p004_A 0.00400 0.01988 FORMAT "%7.5" EXTENDED_LIMITS 0.004000 0.03587 /end CHARACTERISTIC
/begin CHARACTERISTIC UEGO_numRegIsqrDiaNorm1_C "converted set value for CJ135 register (part) isq diag" VALUE 0x805375E0 RB_Val_Wu8 0.0007747 i_q6p1Em6_o0p00036_A 0.000360 0.001135 FORMAT "%8.6" EXTENDED_LIMITS 0.0003600 0.001916 /end CHARACTERISTIC
/begin CHARACTERISTIC UEGO_numRegIsqrDiaSwton_C "converted set value for CJ135 register (part) isq diag" VALUE 0x805375E1 RB_Val_Wu8 0.0007747 i_q6p1Em6_o0p00036_A 0.000360 0.001135 FORMAT "%8.6" EXTENDED_LIMITS 0.0003600 0.001916 /end CHARACTERISTIC
/begin CHARACTERISTIC UEGO_numRegIsqrDiaWrmup_C "converted set value for CJ135 register (part) isq diag" VALUE 0x805375E2 RB_Val_Wu8 0.0007747 i_q6p1Em6_o0p00036_A 0.000360 0.001135 FORMAT "%8.6" EXTENDED_LIMITS 0.0003600 0.001916 /end CHARACTERISTIC
/begin CHARACTERISTIC UEGO_numRegIsqr_C "converted set value for CJ135 register (part) TRIMSQr for standard operation" VALUE 0x80537638 RB_Val_Wu8 0.0007747 i_q6p1Em6_o0p00036_A 0.000360 0.001135 FORMAT "%8.6" EXTENDED_LIMITS 0.0003600 0.001916 /end CHARACTERISTIC
/begin CHARACTERISTIC UEGO_numRegIsqStd_C "converted set value for CJ135 register (part) TRIMSQ for standard operation" VALUE 0x80537639 RB_Val_Wu8 0.01588 i_q1p25Em4_o0p004_A 0.00400 0.01988 FORMAT "%7.5" EXTENDED_LIMITS 0.004000 0.03587 /end CHARACTERISTIC
/begin CHARACTERISTIC UEGO_numRegIsqStrt_C "converted set value for CJ135 register (part) TRIMSQ for standard operation" VALUE 0x805375E3 RB_Val_Wu8 0.01588 i_q1p25Em4_o0p004_A 0.00400 0.01988 FORMAT "%7.5" EXTENDED_LIMITS 0.004000 0.03587 /end CHARACTERISTIC
/begin CHARACTERISTIC UEGO_numRegMkStd_C "direct set value for CJ135 register (part) MK for a not-cold sensor" VALUE 0x805375E4 RB_Val_Wu8 3.000 dez 0.00 3.000 FORMAT "%5.3" EXTENDED_LIMITS 0.00 255.0 /end CHARACTERISTIC
/begin CHARACTERISTIC UEGO_numRegMkStrt_C "direct set value for CJ135 register (part) MK for a cold sensor" VALUE 0x805375E5 RB_Val_Wu8 3.000 dez 0.00 3.000 FORMAT "%5.3" EXTENDED_LIMITS 0.00 255.0 /end CHARACTERISTIC
/begin CHARACTERISTIC UEGO_numRegPattern_C "direct set value for CJ135 register (part) PATTERN" VALUE 0x805375E6 RB_Val_Wu16 32767.00 dez 0.00 32767.00 FORMAT "%8.2" EXTENDED_LIMITS 0.00 65535.00 /end CHARACTERISTIC
/begin CHARACTERISTIC UEGO_numRegRefpatDiaNorm1_C "direct set value for CJ135 register (part) REFPAT for mode Normal1 in diagnosis loop" VALUE 0x805375E8 RB_Val_Wu16 32767.00 dez 0.00 32767.00 FORMAT "%8.2" EXTENDED_LIMITS 0.00 65535.00 /end CHARACTERISTIC
/begin CHARACTERISTIC UEGO_numRegRefpatDiaWrmup_C "direct set value for CJ135 register (part) REFPAT for mode WarmUp in diagnosis loop" VALUE 0x805375EA RB_Val_Wu16 32767.00 dez 0.00 32767.00 FORMAT "%8.2" EXTENDED_LIMITS 0.00 65535.00 /end CHARACTERISTIC
/begin CHARACTERISTIC UEGO_numRegUnsetStd_C "converted set value for CJ135 register (part) UNSET for standard operation" VALUE 0x8053763A RB_Val_Ws16 20.97120 spg_q3p2Em4_V -10.48576 10.48544 FORMAT "%8.5" /end CHARACTERISTIC
/begin CHARACTERISTIC UEGO_numRegUnsetStrt_C "converted set value for CJ135 register (part) UNSET before switching" VALUE 0x8053763C RB_Val_Ws16 20.97120 spg_q3p2Em4_V -10.48576 10.48544 FORMAT "%8.5" /end CHARACTERISTIC
/begin CHARACTERISTIC UEGO_numRegUp0lean_C "converted set value for CJ135 register (part) UP0LEAN" VALUE 0x805375EC RB_Val_Ws16 20.97120 spg_q3p2Em4_V -10.48576 10.48544 FORMAT "%8.5" /end CHARACTERISTIC
/begin CHARACTERISTIC UEGO_numRegUp0rich_C "converted set value for CJ135 register (part) UP0RICH" VALUE 0x805375EE RB_Val_Ws16 20.97120 spg_q3p2Em4_V -10.48576 10.48544 FORMAT "%8.5" /end CHARACTERISTIC
/begin CHARACTERISTIC UEGO_numRegUriaSwtOn_C "direct set value for CJ135 register (part) URIA" VALUE 0x805375F0 RB_Val_Wu8 1.000 dez 0.00 1.000 FORMAT "%5.3" EXTENDED_LIMITS 0.00 255.0 /end CHARACTERISTIC
/begin CHARACTERISTIC UEGO_numRegUria_C "direct set value for CJ135 register (part) URIA" VALUE 0x805375F1 RB_Val_Wu8 1.000 dez 0.00 1.000 FORMAT "%5.3" EXTENDED_LIMITS 0.00 255.0 /end CHARACTERISTIC
/begin CHARACTERISTIC UEGO_numUnCtlStdD_C "physical controller parameter D for standard case" VALUE 0x805375F2 RB_Val_Wu16 3872.705 q0p4728_mA_DIV_V 0.00 3872.705 FORMAT "%8.3" EXTENDED_LIMITS 0.00 30984.95 /end CHARACTERISTIC
/begin CHARACTERISTIC UEGO_numUnCtlStdI_C "physical controller parameter I for standard case" VALUE 0x805375F4 RB_Val_Wu16 121.0220 q0p014775_mA_DIV_V 0.00 121.0220 FORMAT "%8.4" EXTENDED_LIMITS 0.00 968.2796 /end CHARACTERISTIC
/begin CHARACTERISTIC UEGO_numUnCtlStdP_C "physical controller parameter P for standard case" VALUE 0x805375F6 RB_Val_Wu16 968.1762 q0p1182_mA_DIV_V 0.00 968.1762 FORMAT "%8.4" EXTENDED_LIMITS 0.00 7746.237 /end CHARACTERISTIC
/begin CHARACTERISTIC UEGO_numUnCtlStdRF_C "physical controller parameter RF for standard case" VALUE 0x805375F8 RB_Val_Wu16 0.9921875 fak_uw_b512 0.00 0.9921875 FORMAT "%9.7" EXTENDED_LIMITS 0.00 511.9922 /end CHARACTERISTIC
/begin CHARACTERISTIC UEGO_numUnCtlStrtD_C "physical controller parameter D for start set if activated" VALUE 0x805375FA RB_Val_Wu16 3872.705 q0p4728_mA_DIV_V 0.00 3872.705 FORMAT "%8.3" EXTENDED_LIMITS 0.00 30984.95 /end CHARACTERISTIC
/begin CHARACTERISTIC UEGO_numUnCtlStrtI_C "physical controller parameter I for start set if activated" VALUE 0x805375FC RB_Val_Wu16 121.0220 q0p014775_mA_DIV_V 0.00 121.0220 FORMAT "%8.4" EXTENDED_LIMITS 0.00 968.2796 /end CHARACTERISTIC
/begin CHARACTERISTIC UEGO_numUnCtlStrtP_C "direct set value for CJ135 register (part) Un Control" VALUE 0x805375FE RB_Val_Wu16 968.1762 q0p1182_mA_DIV_V 0.00 968.1762 FORMAT "%8.4" EXTENDED_LIMITS 0.00 7746.237 /end CHARACTERISTIC
/begin CHARACTERISTIC UEGO_numUnCtlStrtRF_C "physical controller parameter RF for start set if activated" VALUE 0x80537600 RB_Val_Wu16 0.9921875 fak_uw_b512 0.00 0.9921875 FORMAT "%9.7" EXTENDED_LIMITS 0.00 511.9922 /end CHARACTERISTIC
/begin CHARACTERISTIC UEGO_resRieMaxMKOff_C "maximum inner resistance Rie for MK swicthing during WarmUp" VALUE 0x80537602 RB_Val_Wu16 6553.500 r_q0p1_Ohm 0.00 6553.500 FORMAT "%8.3" /end CHARACTERISTIC
/begin CHARACTERISTIC UEGO_stCJ135CtlS1B1_C "Codeword for Feauture activation function UEGO_CJ135Ctl for Bank 1 Sensor 1" VALUE 0x8053763E RB_Val_Wu8 255.0 dez 0.00 255.0 FORMAT "%5.1" /end CHARACTERISTIC
/begin CHARACTERISTIC UEGO_stCJ135Ctl_C "Codeword for Feauture activation of function UEGO_CJ135Ctl" VALUE 0x80537640 RB_Val_Wu16 65535.00 dez 0.00 65535.00 FORMAT "%8.2" /end CHARACTERISTIC
/begin CHARACTERISTIC UEGO_stCJ135PIDCtrl_C "code word for PIDSwitch" VALUE 0x80537604 RB_Val_Wu16 65535.00 dez 0.00 65535.00 FORMAT "%8.2" /end CHARACTERISTIC
/begin CHARACTERISTIC UEGO_stIPmpPrmsMaskS1B1_C "Bit mask for selecting pump current release conditions (sensor 1, bank 1)" VALUE 0x80537642 RB_Val_Wu8 255.0 dez 0.00 255.0 FORMAT "%5.1" /end CHARACTERISTIC
/begin CHARACTERISTIC UEGO_stIsqCtrl_C "Codeword to enable ISQ regulation" VALUE 0x80537643 RB_Val_Wu8 255.0 dez 0.00 255.0 FORMAT "%5.1" /end CHARACTERISTIC
/begin CHARACTERISTIC UEGO_stOperPrmsMaskS1B1_C "Bit mask for selecting operating release conditions (sensor 1, bank 1)" VALUE 0x80537644 RB_Val_Wu8 255.0 dez 0.00 255.0 FORMAT "%5.1" /end CHARACTERISTIC
/begin CHARACTERISTIC UEGO_swtSendPID_C "switch to send PID" VALUE 0x80537606 RB_Val_Wu8 1.00000000000 B_TRUE 0.00 1.00000000000 FORMAT "%13.11" /end CHARACTERISTIC
/begin CHARACTERISTIC UEGO_swtStrtIpPulse_C "calibration switch for starting ip pulses" VALUE 0x80537607 RB_Val_Wu8 1.00000000000 B_TRUE 0.00 1.00000000000 FORMAT "%13.11" /end CHARACTERISTIC
/begin CHARACTERISTIC UEGO_tiCalib_C "cycle period for switching of CJ135 registers OFF and REF" VALUE 0x80537608 RB_Val_Wu8 2.550 t_q0p01 0.00 2.550 FORMAT "%5.3" /end CHARACTERISTIC
/begin CHARACTERISTIC UEGO_tiDiagNoRefpatNorm1_C "time for diagnosis no refpat norm1" VALUE 0x80537609 RB_Val_Wu8 2.550 t_q0p01 0.00 2.550 FORMAT "%5.3" /end CHARACTERISTIC
/begin CHARACTERISTIC UEGO_tiDlyCtlOutOfOp_C "time for contol out of operaion" VALUE 0x8053760A RB_Val_Wu16 655.3500 t_q0p01 0.00 655.3500 FORMAT "%8.4" /end CHARACTERISTIC
/begin CHARACTERISTIC UEGO_tiDlyDeltaUn_C "Duration of Turn On delays for Delta-Un conditions (CJ135Ctl)" VALUE 0x8053760C RB_Val_Wu16 655.3500 t_q0p01 0.00 655.3500 FORMAT "%8.4" /end CHARACTERISTIC
/begin CHARACTERISTIC UEGO_tiDlyIpmpDiAftEngStopS1B1_C "Time delay for disable of pump current after engine stop for sensor 1, Bank 1" VALUE 0x80537646 RB_Val_Wu16 655.3500 t_q0p01 0.00 655.3500 FORMAT "%8.4" /end CHARACTERISTIC
/begin CHARACTERISTIC UEGO_tiDlyPIDCtl_C "minimum duration of start PID parameter set before switch to standard set" VALUE 0x8053760E RB_Val_Wu16 655.3500 t_q0p01 0.00 655.3500 FORMAT "%8.4" /end CHARACTERISTIC
/begin CHARACTERISTIC UEGO_tiDlyPIDRngReachd_C "delay time before switching to standard PID parameter set after reaching of activation conditions" VALUE 0x80537610 RB_Val_Wu8 2.550 t_q0p01 0.00 2.550 FORMAT "%5.3" /end CHARACTERISTIC
/begin CHARACTERISTIC UEGO_tiDlySwtOn_C "time delay for switch ON" VALUE 0x80537612 RB_Val_Wu16 655.3500 t_q0p01 0.00 655.3500 FORMAT "%8.4" /end CHARACTERISTIC
/begin CHARACTERISTIC UEGO_tiDlyTMinIpEnaDwn_C "Duration of the Turn On delay for detecting low sensor temperature" VALUE 0x80537614 RB_Val_Wu16 655.3500 t_q0p01 0.00 655.3500 FORMAT "%8.4" /end CHARACTERISTIC
/begin CHARACTERISTIC UEGO_tiIpPulse_C "duration time in each state during ip pulses" VALUE 0x80537616 RB_Val_Wu8 2.550 t_q0p01 0.00 2.550 FORMAT "%5.3" /end CHARACTERISTIC
/begin CHARACTERISTIC UEGO_tiIpRefStrt_C "time delay for start of reference pump current." VALUE 0x80537618 RB_Val_Wu16 655.3500 t_q0p01 0.00 655.3500 FORMAT "%8.4" /end CHARACTERISTIC
/begin CHARACTERISTIC UEGO_tiOptLon_C "cycle period 1 for switching of register part OPT" VALUE 0x8053761A RB_Val_Wu8 2.550 t_q0p01 0.00 2.550 FORMAT "%5.3" /end CHARACTERISTIC
/begin CHARACTERISTIC UEGO_tiOptShrt_C "cycle period 2 for switching of register part OPT" VALUE 0x8053761B RB_Val_Wu8 2.550 t_q0p01 0.00 2.550 FORMAT "%5.3" /end CHARACTERISTIC
/begin CHARACTERISTIC UEGO_tiRegReclc_C "time for regester reclc" VALUE 0x8053761C RB_Val_Wu16 655.3500 t_q0p01 0.00 655.3500 FORMAT "%8.4" /end CHARACTERISTIC
/begin CHARACTERISTIC UEGO_tMinIpEnaDwn_C "minimum temperature for enabling pump current" VALUE 0x8053761E RB_Val_Wu16 1535.977 temp_q0p0234_o273 -273.150 1262.827 FORMAT "%8.3" /end CHARACTERISTIC
/begin CHARACTERISTIC UEGO_tMinIpEnaUpLoPrcsn_C "Minimum temperature required for Normal mode if the temperature measurement does not have high precision" VALUE 0x80537620 RB_Val_Wu16 1535.977 temp_q0p0234_o273 -273.150 1262.827 FORMAT "%8.3" /end CHARACTERISTIC
/begin CHARACTERISTIC UEGO_tMinIpEnaUp_C "minimum temperature for enabling pump current" VALUE 0x80537622 RB_Val_Wu16 1535.977 temp_q0p0234_o273 -273.150 1262.827 FORMAT "%8.3" /end CHARACTERISTIC
/begin CHARACTERISTIC UEGO_tPIDSwtUp_C "PID activation time" VALUE 0x80537624 RB_Val_Wu16 1535.977 temp_q0p0234_o273 -273.150 1262.827 FORMAT "%8.3" /end CHARACTERISTIC
/begin CHARACTERISTIC UEGO_tSwtOnWrmUp_C "Temperature threshold for transition from mode Switchon to mode Warmup" VALUE 0x80537626 RB_Val_Wu16 1535.977 temp_q0p0234_o273 -273.150 1262.827 FORMAT "%8.3" /end CHARACTERISTIC
/begin CHARACTERISTIC UEGO_tUnSwtDwn_C "activation temperature of standard UNSET register" VALUE 0x80537628 RB_Val_Wu16 1535.977 temp_q0p0234_o273 -273.150 1262.827 FORMAT "%8.3" /end CHARACTERISTIC
/begin CHARACTERISTIC UEGO_tUnSwtUp_C "reset temperature (hysteresis) for start UNSET register" VALUE 0x8053762A RB_Val_Wu16 1535.977 temp_q0p0234_o273 -273.150 1262.827 FORMAT "%8.3" /end CHARACTERISTIC
/begin CHARACTERISTIC UEGO_uDeltaUn_C "Delta-Un threshold for switching flgUnsetStdDes" VALUE 0x8053762C RB_Val_Ws16 20.97120 spg_q3p2Em4_V -10.48576 10.48544 FORMAT "%8.5" /end CHARACTERISTIC
/begin CHARACTERISTIC UEGO_uFkal1Ref_C "reference uFkal1 value for calculation of digital PID parameters" VALUE 0x8053762E RB_Val_Wu16 0.01562476 spg_q2p3842Em7_V 0.00 0.01562476 FORMAT "%10.8" /end CHARACTERISTIC
/begin CHARACTERISTIC UEGO_uLnEnaDown_C "activation voltage of loupe LN" VALUE 0x80537630 RB_Val_Ws16 20.97120 spg_q3p2Em4_V -10.48576 10.48544 FORMAT "%8.5" /end CHARACTERISTIC
/begin CHARACTERISTIC UEGO_uLnEnaUp_C "deactivation voltage (hysteresis) of loupe LN" VALUE 0x80537632 RB_Val_Ws16 20.97120 spg_q3p2Em4_V -10.48576 10.48544 FORMAT "%8.5" /end CHARACTERISTIC
/begin CHARACTERISTIC UEGO_uLpEnaDown_C "activation voltage of loupe LP" VALUE 0x80537634 RB_Val_Ws16 20.97120 spg_q3p2Em4_V -10.48576 10.48544 FORMAT "%8.5" /end CHARACTERISTIC
/begin CHARACTERISTIC UEGO_uLpEnaUp_C "deactivation voltage (hysteresis) of loupe LP" VALUE 0x80537636 RB_Val_Ws16 20.97120 spg_q3p2Em4_V -10.48576 10.48544 FORMAT "%8.5" /end CHARACTERISTIC
/begin MEASUREMENT fcoscxk "Oxygen storage capacity correction factor" UBYTE fak_q0p0078 1 100 0.00 1.992 FORMAT "%5.3" ECU_ADDRESS 0x60006238 /end MEASUREMENT
/begin MEASUREMENT flgCmbEngStopS1B1TONVNM_I.time "Turn on delay with out memory. / Delay Time" UWORD t_q0p01 1 100 0.00 655.3500 FORMAT "%8.4" ECU_ADDRESS 0x70002BAC /end MEASUREMENT
/begin MEASUREMENT TWCC_bCtlLimMaxPriB1 "bit controller limited maximum primary control" UBYTE B_TRUE 1 100 0.00 1.00000000000 BIT_MASK 0x1 FORMAT "%13.11" ECU_ADDRESS 0x7000065A /end MEASUREMENT
/begin MEASUREMENT TWCC_bCtlLimMinPriB1 "bit controller limited minimum primary control" UBYTE B_TRUE 1 100 0.00 1.00000000000 BIT_MASK 0x1 FORMAT "%13.11" ECU_ADDRESS 0x70000659 /end MEASUREMENT
/begin MEASUREMENT TWCC_bEnaRichPriB1 "Bit rich catalyst purge" UBYTE B_TRUE 1 100 0.00 1.00000000000 BIT_MASK 0x1 FORMAT "%13.11" ECU_ADDRESS 0x70000658 /end MEASUREMENT
/begin MEASUREMENT TWCC_bEnaRichPriB1FF_I.status "flip-flop bit rich catalyst purge / current value of RS-FF" UBYTE B_TRUE 1 100 0.00 1.00000000000 BIT_MASK 0x1 FORMAT "%13.11" ECU_ADDRESS 0x60006231 /end MEASUREMENT
/begin MEASUREMENT TWCC_BFlSignEB_I.buffer "Edge-bi fuel sign, banK1 / EdgeBi.buffer" UBYTE B_TRUE 1 100 0.00 1.00000000000 BIT_MASK 0x1 FORMAT "%13.11" ECU_ADDRESS 0x600034A0 /end MEASUREMENT
/begin MEASUREMENT TWCC_BFlSignEB_I.oldSignal "Edge-bi fuel sign, banK1 / EdgeBi.odlSignal" UBYTE B_TRUE 1 100 0.00 1.00000000000 BIT_MASK 0x1 FORMAT "%13.11" ECU_ADDRESS 0x600034A1 /end MEASUREMENT
/begin MEASUREMENT TWCC_bIBalPriB1 "bit i-part system conditions debounced primary control enable" UBYTE B_TRUE 1 100 0.00 1.00000000000 BIT_MASK 0x1 FORMAT "%13.11" ECU_ADDRESS 0x700000F1 /end MEASUREMENT
/begin MEASUREMENT TWCC_bICoPriB1 "bit i-part controller conditions primary control enable" UBYTE B_TRUE 1 100 0.00 1.00000000000 BIT_MASK 0x1 FORMAT "%13.11" ECU_ADDRESS 0x700000F0 /end MEASUREMENT
/begin MEASUREMENT TWCC_bIGlbBalPri "bit i-part global conditions, debounce release, primary control enable" UBYTE B_TRUE 1 100 0.00 1.00000000000 BIT_MASK 0x1 FORMAT "%13.11" ECU_ADDRESS 0x700000EF /end MEASUREMENT
/begin MEASUREMENT TWCC_bIGlbCPPri "bit i-part global canister purge primary control enable" UBYTE B_TRUE 1 100 0.00 1.00000000000 BIT_MASK 0x1 FORMAT "%13.11" ECU_ADDRESS 0x700000EE /end MEASUREMENT
/begin MEASUREMENT TWCC_bIGlbLckErrPri "bit i-part global locked with error primary control enable" UBYTE B_TRUE 1 100 0.00 1.00000000000 BIT_MASK 0x1 FORMAT "%13.11" ECU_ADDRESS 0x700000ED /end MEASUREMENT
/begin MEASUREMENT TWCC_bIGlbPri "bit i-part global primary control enable" UBYTE B_TRUE 1 100 0.00 1.00000000000 BIT_MASK 0x1 FORMAT "%13.11" ECU_ADDRESS 0x700000EC /end MEASUREMENT
/begin MEASUREMENT TWCC_bIGLbRlNmotPri "bit I-part global load and engine speed control enable" UBYTE B_TRUE 1 100 0.00 1.00000000000 BIT_MASK 0x1 FORMAT "%13.11" ECU_ADDRESS 0x70000654 /end MEASUREMENT
/begin MEASUREMENT TWCC_bIH2DLaPriB1 "bit i-part inhibit delta lambda gradient (H2) primary control enable" UBYTE B_TRUE 1 100 0.00 1.00000000000 BIT_MASK 0x1 FORMAT "%13.11" ECU_ADDRESS 0x700000EB /end MEASUREMENT
/begin MEASUREMENT TWCC_bIH2LckPriB1 "bit i-part locked due to H2 primary control enable" UBYTE B_TRUE 1 100 0.00 1.00000000000 BIT_MASK 0x1 FORMAT "%13.11" ECU_ADDRESS 0x70000653 /end MEASUREMENT
/begin MEASUREMENT TWCC_bILckErrPriB1 "bit i-part locked with error primary control enable" UBYTE B_TRUE 1 100 0.00 1.00000000000 BIT_MASK 0x1 FORMAT "%13.11" ECU_ADDRESS 0x70000652 /end MEASUREMENT
/begin MEASUREMENT TWCC_bIPriB1 "bit i-part released, primary control enable" UBYTE B_TRUE 1 100 0.00 1.00000000000 BIT_MASK 0x1 FORMAT "%13.11" ECU_ADDRESS 0x70000651 /end MEASUREMENT
/begin MEASUREMENT TWCC_bISysPriB1 "bit i-part system conditions released, primary control enable" UBYTE B_TRUE 1 100 0.00 1.00000000000 BIT_MASK 0x1 FORMAT "%13.11" ECU_ADDRESS 0x700000EA /end MEASUREMENT
/begin MEASUREMENT TWCC_bITempPriB1 "bit i-part release based on catalyst temperature, primary control enable" UBYTE B_TRUE 1 100 0.00 1.00000000000 BIT_MASK 0x1 FORMAT "%13.11" ECU_ADDRESS 0x700000E9 /end MEASUREMENT
/begin MEASUREMENT TWCC_bLimpCoPriB1 "bit control conditions for p-part limp mode, primary control enable" UBYTE B_TRUE 1 100 0.00 1.00000000000 BIT_MASK 0x1 FORMAT "%13.11" ECU_ADDRESS 0x700000E8 /end MEASUREMENT
/begin MEASUREMENT TWCC_bLimpPriB1 "bit p-part limp home active, primary control enable" UBYTE B_TRUE 1 100 0.00 1.00000000000 BIT_MASK 0x1 FORMAT "%13.11" ECU_ADDRESS 0x7000064E /end MEASUREMENT
/begin MEASUREMENT TWCC_bPBalPriB1 "bit p-part system conditions debounced primary control enable" UBYTE B_TRUE 1 100 0.00 1.00000000000 BIT_MASK 0x1 FORMAT "%13.11" ECU_ADDRESS 0x700000E7 /end MEASUREMENT
/begin MEASUREMENT TWCC_bPCoBalPriB1 "bit p-part controller conditions, for debounce release, primary control enable" UBYTE B_TRUE 1 100 0.00 1.00000000000 BIT_MASK 0x1 FORMAT "%13.11" ECU_ADDRESS 0x700000E6 /end MEASUREMENT
/begin MEASUREMENT TWCC_bPCoPriB1 "bit p-part controller conditions primary control enable" UBYTE B_TRUE 1 100 0.00 1.00000000000 BIT_MASK 0x1 FORMAT "%13.11" ECU_ADDRESS 0x700000E5 /end MEASUREMENT
/begin MEASUREMENT TWCC_bPDynTempPriB1 "Condition P-part active based on temperature and dynamic diagnosis" UBYTE B_TRUE 1 100 0.00 1.00000000000 BIT_MASK 0x1 FORMAT "%13.11" ECU_ADDRESS 0x700000E4 /end MEASUREMENT
/begin MEASUREMENT TWCC_bPGlbBalPri "bit p-part global conditions, debounce release, primary control enable" UBYTE B_TRUE 1 100 0.00 1.00000000000 BIT_MASK 0x1 FORMAT "%13.11" ECU_ADDRESS 0x700000E3 /end MEASUREMENT
/begin MEASUREMENT TWCC_bPGlbLckDiaPri "bit p-part global locked by diagnosis primary control enable" UBYTE B_TRUE 1 100 0.00 1.00000000000 BIT_MASK 0x1 FORMAT "%13.11" ECU_ADDRESS 0x700000E2 /end MEASUREMENT
/begin MEASUREMENT TWCC_bPGlbLckErrPri "bit p-part global locked with error primary control enable" UBYTE B_TRUE 1 100 0.00 1.00000000000 BIT_MASK 0x1 FORMAT "%13.11" ECU_ADDRESS 0x700000E1 /end MEASUREMENT
/begin MEASUREMENT TWCC_bPGlbPri "bit p-part global primary control enable" UBYTE B_TRUE 1 100 0.00 1.00000000000 BIT_MASK 0x1 FORMAT "%13.11" ECU_ADDRESS 0x700000E0 /end MEASUREMENT
/begin MEASUREMENT TWCC_bPGLbRlNmotPri "bit P-part global load and engine speed control enable" UBYTE B_TRUE 1 100 0.00 1.00000000000 BIT_MASK 0x1 FORMAT "%13.11" ECU_ADDRESS 0x7000064D /end MEASUREMENT
/begin MEASUREMENT TWCC_bPLckErrPriB1 "bit p-part locked with error primary control enable" UBYTE B_TRUE 1 100 0.00 1.00000000000 BIT_MASK 0x1 FORMAT "%13.11" ECU_ADDRESS 0x7000064C /end MEASUREMENT
/begin MEASUREMENT TWCC_bPPriB1 "bit p-part released, primary control enable, bank 1" UBYTE B_TRUE 1 100 0.00 1.00000000000 BIT_MASK 0x1 FORMAT "%13.11" ECU_ADDRESS 0x7000064B /end MEASUREMENT
/begin MEASUREMENT TWCC_bPSysPriB1 "bit p-part system conditions released, primary control enable" UBYTE B_TRUE 1 100 0.00 1.00000000000 BIT_MASK 0x1 FORMAT "%13.11" ECU_ADDRESS 0x700000DF /end MEASUREMENT
/begin MEASUREMENT TWCC_bPTempPriB1 "bit p-part release based on catalyst temperature, primary control enable" UBYTE B_TRUE 1 100 0.00 1.00000000000 BIT_MASK 0x1 FORMAT "%13.11" ECU_ADDRESS 0x700000DE /end MEASUREMENT
/begin MEASUREMENT TWCC_bReStrtEndEF_I.buffer "edge falling of engine start end for restart detection / memory to detect falling edge" UBYTE B_TRUE 1 100 0.00 1.00000000000 BIT_MASK 0x1 FORMAT "%13.11" ECU_ADDRESS 0x6000347A /end MEASUREMENT
/begin MEASUREMENT TWCC_bReStrtEndEF_I.oldSignal "edge falling of engine start end for restart detection / memory to detect falling edge" UBYTE B_TRUE 1 100 0.00 1.00000000000 BIT_MASK 0x1 FORMAT "%13.11" ECU_ADDRESS 0x6000347B /end MEASUREMENT
/begin MEASUREMENT TWCC_dmExhSpFil "Exhaust mass flow for setpoint filter, primary control" SWORD m_q0p1 1 100 -3276.800 3276.700 FORMAT "%8.3" ECU_ADDRESS 0x60004960 /end MEASUREMENT
/begin MEASUREMENT TWCC_dtPMsO2BalPriB1 "dt p-part O2 mass balanced primary control continuous" FLOAT32_IEEE m_q1_mg 1 100 -1.0000E+037 1.0000E+037 FORMAT "%10.4" ECU_ADDRESS 0x50001954 /end MEASUREMENT
/begin MEASUREMENT TWCC_facIGnCtlPriB1 "factor i-part gain controller primary control continuous" UWORD fak_q0p00015259 1 100 0.00 9.999847 FORMAT "%8.6" ECU_ADDRESS 0x60004884 /end MEASUREMENT
/begin MEASUREMENT TWCC_facIOSCPriB1 "factor i-part OSC primary control continuous bank 1" UBYTE fak_ub_b1 1 100 0.00 0.9961 ECU_ADDRESS 0x6000A00F /end MEASUREMENT
/begin MEASUREMENT TWCC_facOSCPriB1 "catalyst ageing factor based on oxygen storage capacity, bank 1" UWORD fak_uw_b2 1 100 0.00 1.999969 FORMAT "%8.6" ECU_ADDRESS 0x60003498 /end MEASUREMENT
/begin MEASUREMENT TWCC_facOSCPriGCURWpDisp "catalyst ageing factor for Group Curve working point display" UWORD fak_uw_b2 1 100 0.00 1.999969 FORMAT "%8.6" ECU_ADDRESS 0x60003496 /end MEASUREMENT
/begin MEASUREMENT TWCC_facPGnCtlPriB1 "factor p-part gain controller primary control continuous" UBYTE fak_ub_b4 1 100 0.00 3.984 FORMAT "%5.3" ECU_ADDRESS 0x6000E431 /end MEASUREMENT
/begin MEASUREMENT TWCC_facPOSCPriB1 "factor p-part OSC primary control continuous bank 1" UBYTE fak_ub_b1 1 100 0.00 0.9961 ECU_ADDRESS 0x6000A00E /end MEASUREMENT
/begin MEASUREMENT TWCC_fcoscxkEB_I.buffer "Edge-bi OSC / EdgeBi.buffer" UBYTE B_TRUE 1 100 0.00 1.00000000000 BIT_MASK 0x1 FORMAT "%13.11" ECU_ADDRESS 0x6000349E /end MEASUREMENT
/begin MEASUREMENT TWCC_fcoscxkEB_I.oldSignal "Edge-bi OSC / EdgeBi.odlSignal" UBYTE B_TRUE 1 100 0.00 1.00000000000 BIT_MASK 0x1 FORMAT "%13.11" ECU_ADDRESS 0x6000349F /end MEASUREMENT
/begin MEASUREMENT TWCC_flgEnaIGpfRgnNotActv "flag enabling I-part of catalyst control when gasoline particle filter regeneration mode not active" UBYTE B_TRUE 1 100 0.00 1.00000000000 BIT_MASK 0x1 FORMAT "%13.11" ECU_ADDRESS 0x700000DD /end MEASUREMENT
/begin MEASUREMENT TWCC_flgEnaPGpfRgnNotActv "flag enabling P-part of catalyst-control when gasoline particle filter regeneration mode not active" UBYTE B_TRUE 1 100 0.00 1.00000000000 BIT_MASK 0x1 FORMAT "%13.11" ECU_ADDRESS 0x700000DC /end MEASUREMENT
/begin MEASUREMENT TWCC_flgEnaRichPurgB1EF_I.buffer "Falling edge:bit catalyst Purge / memory to detect falling edge" UBYTE B_TRUE 1 100 0.00 1.00000000000 BIT_MASK 0x1 FORMAT "%13.11" ECU_ADDRESS 0x6000349C /end MEASUREMENT
/begin MEASUREMENT TWCC_flgEnaRichPurgB1EF_I.oldSignal "Falling edge:bit catalyst Purge / memory to detect falling edge" UBYTE B_TRUE 1 100 0.00 1.00000000000 BIT_MASK 0x1 FORMAT "%13.11" ECU_ADDRESS 0x6000349D /end MEASUREMENT
/begin MEASUREMENT TWCC_flgFCMClrReqd100PriB1 "Fault code memory clear requested for 100 ms task" UBYTE B_TRUE 1 100 0.00 1.00000000000 BIT_MASK 0x1 FORMAT "%13.11" ECU_ADDRESS 0x60009F87 /end MEASUREMENT
/begin MEASUREMENT TWCC_flgLstStrtB1FF_I.status "flip flop indicating last start is first start or restart primary control enable / current value of RS-FF" UBYTE B_TRUE 1 100 0.00 1.00000000000 BIT_MASK 0x1 FORMAT "%13.11" ECU_ADDRESS 0x60006230 /end MEASUREMENT
/begin MEASUREMENT TWCC_IBalPriB1IK_I.memory "i-part balanced primary control enable / current integrator value" ULONG q1p08505Em5_g 1 100 0.00 46602.6666645 FORMAT "%13.7" ECU_ADDRESS 0x50001938 /end MEASUREMENT
/begin MEASUREMENT TWCC_IDecelWoFlCutPriEF_I.buffer "EdgeFalling:Inhibit of I part due to deceleration without fuel cut / memory to detect falling edge" UBYTE B_TRUE 1 100 0.00 1.00000000000 BIT_MASK 0x1 FORMAT "%13.11" ECU_ADDRESS 0x60003492 /end MEASUREMENT
/begin MEASUREMENT TWCC_IDecelWoFlCutPriEF_I.oldSignal "EdgeFalling:Inhibit of I part due to deceleration without fuel cut / memory to detect falling edge" UBYTE B_TRUE 1 100 0.00 1.00000000000 BIT_MASK 0x1 FORMAT "%13.11" ECU_ADDRESS 0x60003493 /end MEASUREMENT
/begin MEASUREMENT TWCC_IDecelWoFlCutPriFF_I.status "FilpFlop: Inhibit of I part due to deceleration without fuel cut / current value of RS-FF" UBYTE B_TRUE 1 100 0.00 1.00000000000 BIT_MASK 0x1 FORMAT "%13.11" ECU_ADDRESS 0x60006234 /end MEASUREMENT
/begin MEASUREMENT TWCC_IDecelWoFlCutPriTRE_I.inOld "TimeRetrigger:Inhibit of I part due to deceleration without fuel cut / Previous state of input value" UBYTE B_TRUE 1 100 0.00 1.00000000000 BIT_MASK 0x1 FORMAT "%13.11" ECU_ADDRESS 0x500054C6 /end MEASUREMENT
/begin MEASUREMENT TWCC_IDecelWoFlCutPriTRE_I.timeCounter "TimeRetrigger:Inhibit of I part due to deceleration without fuel cut / Remaining time of the timer" UWORD t_q0p1 1 100 0.00 6553.500 FORMAT "%8.3" ECU_ADDRESS 0x500054C8 /end MEASUREMENT
/begin MEASUREMENT TWCC_IDLaH2PriB1LT_I.memory "lowpass of delta lambda for H2 based inhibit of I-part, primary control enable / current lowpass value" SLONG fak_q4p6566Em11 1 100 -0.100000000000 0.099999999953 FORMAT "%14.12" ECU_ADDRESS 0x600012D8 /end MEASUREMENT
/begin MEASUREMENT TWCC_IFlCutTONV_I.outbit "Turn on delay: Fuel cut-off / return value" UBYTE B_TRUE 1 100 0.00 1.00000000000 BIT_MASK 0x1 FORMAT "%13.11" ECU_ADDRESS 0x60003490 /end MEASUREMENT
/begin MEASUREMENT TWCC_IFlCutTONV_I.time "Turn on delay: Fuel cut-off / expired delay time" UBYTE t_q0p1 1 100 0.00 25.50 FORMAT "%5.2" ECU_ADDRESS 0x60003491 /end MEASUREMENT
/begin MEASUREMENT TWCC_IIdlSpdTONV_I.outbit "Turn on delay: Idle speed from drivers sight / return value" UBYTE B_TRUE 1 100 0.00 1.00000000000 BIT_MASK 0x1 FORMAT "%13.11" ECU_ADDRESS 0x6000348E /end MEASUREMENT
/begin MEASUREMENT TWCC_IIdlSpdTONV_I.time "Turn on delay: Idle speed from drivers sight / expired delay time" UBYTE t_q0p1 1 100 0.00 25.50 FORMAT "%5.2" ECU_ADDRESS 0x6000348F /end MEASUREMENT
/begin MEASUREMENT TWCC_ILamSwtH2PriB1EF_I.buffer "Edge falling for lambda sign switch detection, H2 based inhibit of I-part, primary control / memory to detect falling edge" UBYTE B_TRUE 1 100 0.00 1.00000000000 BIT_MASK 0x1 FORMAT "%13.11" ECU_ADDRESS 0x6000348C /end MEASUREMENT
/begin MEASUREMENT TWCC_ILamSwtH2PriB1EF_I.oldSignal "Edge falling for lambda sign switch detection, H2 based inhibit of I-part, primary control / memory to detect falling edge" UBYTE B_TRUE 1 100 0.00 1.00000000000 BIT_MASK 0x1 FORMAT "%13.11" ECU_ADDRESS 0x6000348D /end MEASUREMENT
/begin MEASUREMENT TWCC_ILamSwtH2PriB1T_I.timeCounter "Delay of edge falling for lambda sign switch detection, H2 based inhibit of I-part, primary control / Remaining time of the timer" UBYTE t_q1 1 100 0.00 255.0 FORMAT "%5.1" ECU_ADDRESS 0x60006233 /end MEASUREMENT
/begin MEASUREMENT TWCC_ILdGradPriLT_I.memory "lowpass of engine load gradient / current lowpass value" SLONG rel_q3p576Em7 1 100 -768.000000000 767.999999642 FORMAT "%13.9" ECU_ADDRESS 0x6000CE7C /end MEASUREMENT
/begin MEASUREMENT TWCC_ILdGradPriTOFFV_I.outbit "Turn off delay of release of I-part based on engine load gradient / Output Bit" UBYTE B_TRUE 1 100 0.00 1.00000000000 BIT_MASK 0x1 FORMAT "%13.11" ECU_ADDRESS 0x6000348A /end MEASUREMENT
/begin MEASUREMENT TWCC_ILdGradPriTOFFV_I.time "Turn off delay of release of I-part based on engine load gradient / Occured Time" UBYTE t_q0p1 1 100 0.00 25.50 FORMAT "%5.2" ECU_ADDRESS 0x6000348B /end MEASUREMENT
/begin MEASUREMENT TWCC_INLdPriTOFFV_I.outbit "turn off delay of release I-part based on engine speed and load / Output Bit" UBYTE B_TRUE 1 100 0.00 1.00000000000 BIT_MASK 0x1 FORMAT "%13.11" ECU_ADDRESS 0x60003488 /end MEASUREMENT
/begin MEASUREMENT TWCC_INLdPriTOFFV_I.time "turn off delay of release I-part based on engine speed and load / Occured Time" UBYTE t_q0p1 1 100 0.00 25.50 FORMAT "%5.2" ECU_ADDRESS 0x60003489 /end MEASUREMENT
/begin MEASUREMENT TWCC_IOSCRlsH2PriB1IK_I.memory "O2 model of H2 based I-part release, primary control / current integrator value" ULONG m_q3p0518Em7_mgO2 1 100 0.00 1310.71999969 FORMAT "%13.8" ECU_ADDRESS 0x5000193C /end MEASUREMENT
/begin MEASUREMENT TWCC_mIBalPThresPriB1 "Exhaust mass threshold for I-part release based on P-part debounce integral" UWORD m_uw_b7281 1 100 0.00 7281.667 FORMAT "%8.3" ECU_ADDRESS 0x60004882 /end MEASUREMENT
/begin MEASUREMENT TWCC_mIBalThresPriB1 "exhaust mass threshold of I-part debouncing, primary control enable" UWORD m_q0p711_g 1 100 0.00 46602.67 FORMAT "%8.2" ECU_ADDRESS 0x60004880 /end MEASUREMENT
/begin MEASUREMENT TWCC_mPBalThresPriB1 "Exhaust mass threshold of debouncing of P-part release, primary control" UWORD m_q0p711_g 1 100 0.00 46602.67 FORMAT "%8.2" ECU_ADDRESS 0x6000487E /end MEASUREMENT
/begin MEASUREMENT TWCC_PBalPriB1IK_I.memory "p-part balanced primary control enable / current integrator value" ULONG q1p08505Em5_g 1 100 0.00 46602.6666645 FORMAT "%13.7" ECU_ADDRESS 0x50001940 /end MEASUREMENT
/begin MEASUREMENT TWCC_PCoUsPriB1HDR_I.hysterese "Hysteresis P-part release based on lambda controller status / Current value of the hysteresis" UBYTE B_TRUE 1 100 0.00 1.00000000000 BIT_MASK 0x1 FORMAT "%13.11" ECU_ADDRESS 0x60006232 /end MEASUREMENT
/begin MEASUREMENT TWCC_PCoUsPriB1LT_I.memory "lowpass P-part release based on lambda controller status / current lowpass value" UWORD rel_q2p929Em3 1 100 0.00 191.9971 FORMAT "%8.4" ECU_ADDRESS 0x60003486 /end MEASUREMENT
/begin MEASUREMENT TWCC_PCoUsPriB1TOFFV_I.outbit "Turn off delay P-part release based on lambda controller status / Output Bit" UBYTE B_TRUE 1 100 0.00 1.00000000000 BIT_MASK 0x1 FORMAT "%13.11" ECU_ADDRESS 0x60003484 /end MEASUREMENT
/begin MEASUREMENT TWCC_PCoUsPriB1TOFFV_I.time "Turn off delay P-part release based on lambda controller status / Occured Time" UBYTE t_q0p1 1 100 0.00 25.50 FORMAT "%5.2" ECU_ADDRESS 0x60003485 /end MEASUREMENT
/begin MEASUREMENT TWCC_PhSyncB1_I.rActPer "state-machine phase-synchronous average / relative lambda actual value in actual half-period" UWORD fak_uw_b2 1 100 0.00 1.999969 FORMAT "%8.6" ECU_ADDRESS 0x50001944 /end MEASUREMENT
/begin MEASUREMENT TWCC_PhSyncB1_I.rPhAvrg "state-machine phase-synchronous average / releative phase-synchronous average" SWORD fak_sw_b1 1 100 -1.000000 0.999969 FORMAT "%8.6" ECU_ADDRESS 0x50001946 /end MEASUREMENT
/begin MEASUREMENT TWCC_PhSyncB1_I.rPrevPer "state-machine phase-synchronous average / relative lambda actual value in previous half-period" UWORD fak_uw_b2 1 100 0.00 1.999969 FORMAT "%8.6" ECU_ADDRESS 0x50001948 /end MEASUREMENT
/begin MEASUREMENT TWCC_PhSyncB1_I.sm "state-machine phase-synchronous average / state-index of state-machine for phase-synchronous average" UBYTE TWCC_PhSyncZA_sm_VERB 1 100 0.00 2.00000000000 FORMAT "%13.11" ECU_ADDRESS 0x5000194A /end MEASUREMENT
/begin MEASUREMENT TWCC_PhSyncB1_I.mExhA_I.memory "state-machine phase-synchronous average / mass exhaust gas flow / Accumulator" UWORD m_q0p017778_g 1 100 0.00 1165.067 FORMAT "%8.3" ECU_ADDRESS 0x50001950 /end MEASUREMENT
/begin MEASUREMENT TWCC_PIDPriB1 "PID interface TWCC_PriB1 data byte B" SBYTE fak_q0p0078 1 100 -1.000 0.992 FORMAT "%5.3" ECU_ADDRESS 0x6000A109 /end MEASUREMENT
/begin MEASUREMENT TWCC_PLam1DrctPriB1TOFFV_I.outbit "Turn off delay for direct evaluation lambda 1 condition, p-part release, primary control enable / Output Bit" UBYTE B_TRUE 1 100 0.00 1.00000000000 BIT_MASK 0x1 FORMAT "%13.11" ECU_ADDRESS 0x60003482 /end MEASUREMENT
/begin MEASUREMENT TWCC_PLam1DrctPriB1TOFFV_I.time "Turn off delay for direct evaluation lambda 1 condition, p-part release, primary control enable / Occured Time" UBYTE t_q0p1 1 100 0.00 25.50 FORMAT "%5.2" ECU_ADDRESS 0x60003483 /end MEASUREMENT
/begin MEASUREMENT TWCC_PLam1ErrPriB1TOFFV_I.outbit "Turn off delay for bypassing lambda 1 deviation, p-part release, primary control enable / Output Bit" UBYTE B_TRUE 1 100 0.00 1.00000000000 BIT_MASK 0x1 FORMAT "%13.11" ECU_ADDRESS 0x60003480 /end MEASUREMENT
/begin MEASUREMENT TWCC_PLam1ErrPriB1TOFFV_I.time "Turn off delay for bypassing lambda 1 deviation, p-part release, primary control enable / Occured Time" UBYTE t_q0p1 1 100 0.00 25.50 FORMAT "%5.2" ECU_ADDRESS 0x60003481 /end MEASUREMENT
/begin MEASUREMENT TWCC_PLam1PriB1ER_I.buffer "p-part lambda1 primary control enable / rising edge detected" UBYTE B_TRUE 1 100 0.00 1.00000000000 BIT_MASK 0x1 FORMAT "%13.11" ECU_ADDRESS 0x6000347E /end MEASUREMENT
/begin MEASUREMENT TWCC_PLam1PriB1ER_I.oldSignal "p-part lambda1 primary control enable / flag rising edge" UBYTE B_TRUE 1 100 0.00 1.00000000000 BIT_MASK 0x1 FORMAT "%13.11" ECU_ADDRESS 0x6000347F /end MEASUREMENT
/begin MEASUREMENT TWCC_PMsO2BalPriB1IKL_I.memory "p-part O2 mass balanced primary control continuous / Current Integrator value" FLOAT32_IEEE m_q1_mg 1 100 -1.00000000E+037 1.00000000E+037 FORMAT "%13.3" ECU_ADDRESS 0x600012E8 /end MEASUREMENT
/begin MEASUREMENT TWCC_PNLdPriTOFFV_I.outbit "turn off delay of release P-part based on engine speed and load / Output Bit" UBYTE B_TRUE 1 100 0.00 1.00000000000 BIT_MASK 0x1 FORMAT "%13.11" ECU_ADDRESS 0x6000347C /end MEASUREMENT
/begin MEASUREMENT TWCC_PNLdPriTOFFV_I.time "turn off delay of release P-part based on engine speed and load / Occured Time" UBYTE t_q1 1 100 0.00 255.0 FORMAT "%5.1" ECU_ADDRESS 0x6000347D /end MEASUREMENT
/begin MEASUREMENT TWCC_ratO2StrB1WpDisp "working point display of catalyst oxygen storage capacity correction factor" UWORD fak_uw_b2 1 100 0.00 1.999969 FORMAT "%8.6" ECU_ADDRESS 0x600034AE /end MEASUREMENT
/begin MEASUREMENT TWCC_rCtlErrBalPriB1 "relative control error balanced primary control continuous" SWORD fak_sw_b1 1 100 -1.000000 0.999969 FORMAT "%8.6" ECU_ADDRESS 0x600034A8 /end MEASUREMENT
/begin MEASUREMENT TWCC_rCtlErrPriB1 "relative control error primary control enable" SWORD fak_sw_b1 1 100 -1.000000 0.999969 FORMAT "%8.6" ECU_ADDRESS 0x6000495E /end MEASUREMENT
/begin MEASUREMENT TWCC_rCtlErrPriB1HMD_I.hysterese "hysteresis relative control error primary control enable / Current value of the hysteresis" UBYTE B_TRUE 1 100 0.00 1.00000000000 BIT_MASK 0x1 FORMAT "%13.11" ECU_ADDRESS 0x60006235 /end MEASUREMENT
/begin MEASUREMENT TWCC_rCtlPriB1 "relative control value primary control" SWORD fak_sw_b1 1 100 -1.000000 0.999969 FORMAT "%8.6" ECU_ADDRESS 0x6000495C /end MEASUREMENT
/begin MEASUREMENT TWCC_rDynSetPIniPriB1 "Initial value of relative dynamic set point correction of primary catalyst control continuous" SWORD fak_sw_b1 1 100 -1.000000 0.999969 FORMAT "%8.6" ECU_ADDRESS 0x6000495A /end MEASUREMENT
/begin MEASUREMENT TWCC_rDynSetPPriB1 "relative dynamic set point correction of primary catalyst control continuous" SWORD fak_sw_b1 1 100 -1.000000 0.999969 FORMAT "%8.6" ECU_ADDRESS 0x60004958 /end MEASUREMENT
/begin MEASUREMENT TWCC_rDynSetPPriB1LT_I.memory "relative dynamic set point correction of primary catalyst control continuous / current lowpass value" SLONG fak_q4p6566Em10 1 100 -1.000000000000000 0.999999999534339 FORMAT "%17.15" ECU_ADDRESS 0x600012E4 /end MEASUREMENT
/begin MEASUREMENT TWCC_rICtlErrFltPriB1 "relative i-part control error filtered primary control continuous" SWORD fak_sw_b1 1 100 -1.000000 0.999969 FORMAT "%8.6" ECU_ADDRESS 0x6000E2CE /end MEASUREMENT
/begin MEASUREMENT TWCC_rICtlErrPriB1 "relative i-part control error primary control continuous" SWORD fak_sw_b1 1 100 -1.000000 0.999969 FORMAT "%8.6" ECU_ADDRESS 0x600034A6 /end MEASUREMENT
/begin MEASUREMENT TWCC_rICtlHiReslPriB1 "relative i-part control value primary control, high resolution" SLONG fak_sl_b1 1 100 -1.00000000000 0.99999999953 FORMAT "%13.11" ECU_ADDRESS 0x60001C04 /end MEASUREMENT
/begin MEASUREMENT TWCC_rICtlIntPriB1 "relative i-part control value internal primary control" SLONG fak_sl_b1 1 100 -1.00000000000 0.99999999953 FORMAT "%13.11" ECU_ADDRESS 0x600362C0 /end MEASUREMENT
/begin MEASUREMENT TWCC_rICtlPriB1 "relative i-part control value primary control" SWORD fak_sw_b1 1 100 -1.000000 0.999969 FORMAT "%8.6" ECU_ADDRESS 0x6000E2D0 /end MEASUREMENT
/begin MEASUREMENT TWCC_rICtlPriB1_I.memory_l "relative i-part control value primary control continuous / integrated relative i-part control error primary control continuous" SLONG fak_sl_b1 1 100 -1.00000000000 0.99999999953 FORMAT "%13.11" ECU_ADDRESS 0x600012E0 /end MEASUREMENT
/begin MEASUREMENT TWCC_rIFlCPPri "relative fuel by canister purge, i-part primary control enable" UWORD fak_uw_b1 1 100 0.00 0.9999847 FORMAT "%9.7" ECU_ADDRESS 0x60003494 /end MEASUREMENT
/begin MEASUREMENT TWCC_rLamActFltPriB1LT_I.memory "low-pass relative i-part lambda actual value filtered primary control continuous / current lowpass value" ULONG fak_q4p6566Em10 1 100 0.00 1.999999999534339 FORMAT "%17.15" ECU_ADDRESS 0x6000CE8C /end MEASUREMENT
/begin MEASUREMENT TWCC_rLamActPriB1 "relative lambda actual value primary control" UWORD fak_uw_b2 1 100 0.00 1.999969 FORMAT "%8.6" ECU_ADDRESS 0x60004C50 /end MEASUREMENT
/begin MEASUREMENT TWCC_rLamSetPMapPriB1 "relative lambda set point from map primary control" UWORD fak_uw_b2 1 100 0.00 1.999969 FORMAT "%8.6" ECU_ADDRESS 0x6000E2D4 /end MEASUREMENT
/begin MEASUREMENT TWCC_rLamSetPPriB1 "relative lambda set point primary control" UWORD fak_uw_b2 1 100 0.00 1.999969 FORMAT "%8.6" ECU_ADDRESS 0x6000487C /end MEASUREMENT
/begin MEASUREMENT TWCC_rPCtlErrFltPriB1 "relative p-part control error filtered primary control continuous" SWORD fak_sw_b1 1 100 -1.000000 0.999969 FORMAT "%8.6" ECU_ADDRESS 0x60004EF6 /end MEASUREMENT
/begin MEASUREMENT TWCC_rPCtlErrPriB1 "relative p-part control error primary control continuous" SWORD fak_sw_b1 1 100 -1.000000 0.999969 FORMAT "%8.6" ECU_ADDRESS 0x600034A4 /end MEASUREMENT
/begin MEASUREMENT TWCC_rPCtlPriB1 "relative p-part control value primary control" SWORD fak_sw_b1 1 100 -1.000000 0.999969 FORMAT "%8.6" ECU_ADDRESS 0x60004956 /end MEASUREMENT
/begin MEASUREMENT TWCC_rPMsO2BalPriB1 "relative p-part (normiert) mass O2 balanced primary control continuous" SWORD fak_sw_b1 1 100 -1.000000 0.999969 FORMAT "%8.6" ECU_ADDRESS 0x600034A2 /end MEASUREMENT
/begin MEASUREMENT TWCC_stOpModePri "Actual engine operation mode" UBYTE OneToOne 1 100 0.00 255.0 FORMAT "%5.1" ECU_ADDRESS 0x60006237 /end MEASUREMENT
/begin MEASUREMENT TWCC_tCatLamCorrnGslPriB1LT_I.memory "Filtering of the catalyst temperature in gasoline operation mode / current lowpass value" SLONG temp_q1p5259Em6_om273 1 100 -3549.94000000 3003.65999847 FORMAT "%13.8" ECU_ADDRESS 0x600012DC /end MEASUREMENT
/begin MEASUREMENT TWCC_tiDynSetPPriB1 "filter time constant of relative dynamic set point correction of primary catalyst control continuous" UWORD t_q0p05 1 100 0.050 3276.750 FORMAT "%8.3" ECU_ADDRESS 0x6000E2D6 /end MEASUREMENT
/begin MEASUREMENT TWCC_tIMinPriB1 "minimum catalyst temperature for I-part release, primary control enable" SWORD Temp_Cels 1 100 -3549.940 3003.560 FORMAT "%8.3" ECU_ADDRESS 0x60004952 /end MEASUREMENT
/begin MEASUREMENT TWCC_tPMinPriB1 "minimum catalyst temperature for P-part release, primary control enable" SWORD Temp_Cels 1 100 -3549.940 3003.560 FORMAT "%8.3" ECU_ADDRESS 0x60004950 /end MEASUREMENT
/begin MEASUREMENT TWCC_uS2B1Lam "binary sensor voltage downstream catalyst for primary catalyst control" UWORD spg_q1p221Em3_V 1 100 0.00 4.998779 FORMAT "%8.6" ECU_ADDRESS 0x60004C4C /end MEASUREMENT
/begin MEASUREMENT TWCC_uS2B1LamCorrnGslPri "Corrected binary voltage during gasoline operation mode" UWORD spg_q1p221Em3_V 1 100 0.00 4.998779 FORMAT "%8.6" ECU_ADDRESS 0x600034AC /end MEASUREMENT
/begin MEASUREMENT TWCC_uS2B1LamCorrnPri "Corrected binary voltage" UWORD spg_q1p221Em3_V 1 100 0.00 4.998779 FORMAT "%8.6" ECU_ADDRESS 0x600034AA /end MEASUREMENT
/begin MEASUREMENT TWCC_uSetPPriB1 "voltage set point primary control" UBYTE spg_q0p00488 1 100 0.00 1.245 FORMAT "%5.3" ECU_ADDRESS 0x6000A00D /end MEASUREMENT
/begin MEASUREMENT TWCC_uSetPPriMapB1 "voltage set point primary control from map bank 1" UBYTE spg_q0p00488 1 100 0.00 1.245 FORMAT "%5.3" ECU_ADDRESS 0x60006236 /end MEASUREMENT
/begin MEASUREMENT TWCC_uSetPPriMapB1LT_I.memory "filter for voltage setpoint primary control from map Bank1 / current lowpass value" UWORD spg_q1p9073Em5 1 100 0.00 1.249981 FORMAT "%8.6" ECU_ADDRESS 0x6000349A /end MEASUREMENT
/begin MEASUREMENT TWCD_CatMeasSMB1_I.arg_Syc_stSub "Instance of TWCD_CatMeasSM, Bank 1 / Argument: ECU system state" UWORD ExeCon_State_02 1 100 0.00 6.00000000000 FORMAT "%13.11" ECU_ADDRESS 0x50001964 /end MEASUREMENT
/begin MEASUREMENT TWCD_CatMeasSMB1_I.arg_flgOSCMeasmtStart "Instance of TWCD_CatMeasSM, Bank 1 / Condition start of the OSC measurement" UBYTE B_TRUE 1 100 0.00 1.00000000000 BIT_MASK 0x1 FORMAT "%13.11" ECU_ADDRESS 0x50001966 /end MEASUREMENT
/begin MEASUREMENT TWCD_CatMeasSMB1_I.arg_mOSCNrm "Instance of TWCD_CatMeasSM, Bank 1 / Temperature corrected borderline Oxygen storage capacity (OSC) of catalyst" ULONG m_q0p1_mg 1 100 0.00 429496729.500 FORMAT "%13.3" ECU_ADDRESS 0x50001968 /end MEASUREMENT
/begin MEASUREMENT TWCD_CatMeasSMB1_I.arg_mOscNew "Instance of TWCD_CatMeasSM, Bank 1 / Argument OSC of new catalyst" ULONG m_q0p1_mg 1 100 0.00 429496729.500 FORMAT "%13.3" ECU_ADDRESS 0x5000196C /end MEASUREMENT
/begin MEASUREMENT TWCD_CatMeasSMB1_I.arg_mRSCNrm "Instance of TWCD_CatMeasSM, Bank 1 / Temperature corrected borderline Rich gas storage capacity (RSC) of catalyst" ULONG m_q0p1_mg 1 100 0.00 429496729.500 FORMAT "%13.3" ECU_ADDRESS 0x50001970 /end MEASUREMENT
/begin MEASUREMENT TWCD_CatMeasSMB1_I.arg_mfO2Cat "Instance of TWCD_CatMeasSM, Bank 1 / Argument oxygen mass flow" FLOAT32_IEEE mgrad_q1_mgdivs 1 100 -1.00000000E+037 1.00000000E+037 FORMAT "%13.3" ECU_ADDRESS 0x50001974 /end MEASUREMENT
/begin MEASUREMENT TWCD_CatMeasSMB1_I.arg_mfO2LsuDynCorrd "Instance of TWCD_CatMeasSM, Bank 1 / Argument oxygen mass flow LSU dynamic corrected" FLOAT32_IEEE mgrad_q1_mgdivs 1 100 -1.00000000E+037 1.00000000E+037 FORMAT "%13.3" ECU_ADDRESS 0x50001978 /end MEASUREMENT
/begin MEASUREMENT TWCD_CatMeasSMB1_I.arg_stLamGenrParl "Instance of TWCD_CatMeasSM, Bank 1 / Argument: Status of state machine of lambda shifting from coordinator function of parallelization" UBYTE dez 1 100 0.00 255.0 FORMAT "%5.1" ECU_ADDRESS 0x5000197C /end MEASUREMENT
/begin MEASUREMENT TWCD_CatMeasSMB1_I.arg_stVirtCatParl "Instance of TWCD_CatMeasSM, Bank 1 / Argument: Status of virtual state machine of lambda shifting from coordinator function of parallelization" UBYTE dez 1 100 0.00 255.0 FORMAT "%5.1" ECU_ADDRESS 0x5000197D /end MEASUREMENT
/begin MEASUREMENT TWCD_CatMeasSMB1_I.arg_tiLtrNrmDly "Instance of TWCD_CatMeasSM, Bank 1 / Normalized delay time (single measuremement) of sensor voltage at transition lean to rich" SWORD t_q0p01 1 100 -327.6800 327.6700 FORMAT "%8.4" ECU_ADDRESS 0x5000197E /end MEASUREMENT
/begin MEASUREMENT TWCD_CatMeasSMB1_I.arg_tiLtrTran "Instance of TWCD_CatMeasSM, Bank 1 / Transition Time O2Sensor Lean2Rich" SWORD t_q0p01 1 100 -327.6800 327.6700 FORMAT "%8.4" ECU_ADDRESS 0x50001980 /end MEASUREMENT
/begin MEASUREMENT TWCD_CatMeasSMB1_I.arg_tiRtlNrmDly "Instance of TWCD_CatMeasSM, Bank 1 / Normalized delay time (single measuremement) of sensor voltage at transition rich to lean" SWORD t_q0p01 1 100 -327.6800 327.6700 FORMAT "%8.4" ECU_ADDRESS 0x50001982 /end MEASUREMENT
/begin MEASUREMENT TWCD_CatMeasSMB1_I.arg_tiRtlTran "Instance of TWCD_CatMeasSM, Bank 1 / Transition Time O2Sensor Rich2Lean" SWORD t_q0p01 1 100 -327.6800 327.6700 FORMAT "%8.4" ECU_ADDRESS 0x50001984 /end MEASUREMENT
/begin MEASUREMENT TWCD_CatMeasSMB1_I.arg_uDs "Instance of TWCD_CatMeasSM, Bank 1 / Argument voltage of HEGO sensor downstream catalyst" UWORD spg_q1p221Em3_V 1 100 0.00 4.998779 FORMAT "%8.6" ECU_ADDRESS 0x50001986 /end MEASUREMENT
/begin MEASUREMENT TWCD_CatMeasSMB1_I.arg_uLeanFinThres "Instance of TWCD_CatMeasSM, Bank 1 / Lean threshold for downstream sensor signal to end lean phase of cat monitoring" UWORD spg_q1p221Em3_V 1 100 0.00 4.998779 FORMAT "%8.6" ECU_ADDRESS 0x50001988 /end MEASUREMENT
/begin MEASUREMENT TWCD_CatMeasSMB1_I.arg_uRichFinThres "Instance of TWCD_CatMeasSM, Bank 1 / Rich threshold for downstream sensor signal to end phase of RSC measuring" UWORD spg_q1p221Em3_V 1 100 0.00 4.998779 FORMAT "%8.6" ECU_ADDRESS 0x5000198A /end MEASUREMENT
/begin MEASUREMENT TWCD_CatMeasSMB1_I.dmOscCorr "Instance of TWCD_CatMeasSM, Bank 1 / OSC correction by HEGO dynamic" ULONG m_q0p1_mg 1 100 0.00 429496729.500 FORMAT "%13.3" ECU_ADDRESS 0x5000198C /end MEASUREMENT
/begin MEASUREMENT TWCD_CatMeasSMB1_I.flgMeasFin "Instance of TWCD_CatMeasSM, Bank 1 / Flag measurement of catalyst availible" UBYTE B_TRUE 1 100 0.00 1.00000000000 BIT_MASK 0x1 FORMAT "%13.11" ECU_ADDRESS 0x50001991 /end MEASUREMENT
/begin MEASUREMENT TWCD_CatMeasSMB1_I.flgMeasmtFinshd200ms "Instance of TWCD_CatMeasSM, Bank 1 / Flag measurement of catalyst availible, 200ms" UBYTE B_TRUE 1 100 0.00 1.00000000000 BIT_MASK 0x1 FORMAT "%13.11" ECU_ADDRESS 0x60003474 /end MEASUREMENT
/begin MEASUREMENT TWCD_CatMeasSMB1_I.flgMeasmtFinshdVirt "Instance of TWCD_CatMeasSM, Bank 1 / Flag virtual measurement of catalyst available" UBYTE B_TRUE 1 100 0.00 1.00000000000 BIT_MASK 0x1 FORMAT "%13.11" ECU_ADDRESS 0x50001992 /end MEASUREMENT
/begin MEASUREMENT TWCD_CatMeasSMB1_I.flgMeasmtFinshdVirt200ms "Instance of TWCD_CatMeasSM, Bank 1 / Flag virtual measurement of catalyst availible, 200ms" UBYTE B_TRUE 1 100 0.00 1.00000000000 BIT_MASK 0x1 FORMAT "%13.11" ECU_ADDRESS 0x60003475 /end MEASUREMENT
/begin MEASUREMENT TWCD_CatMeasSMB1_I.flgPtlMeasOSCFin "Instance of TWCD_CatMeasSM, Bank 1 / OSC Partial result completed" UBYTE B_TRUE 1 100 0.00 1.00000000000 BIT_MASK 0x1 FORMAT "%13.11" ECU_ADDRESS 0x50001993 /end MEASUREMENT
/begin MEASUREMENT TWCD_CatMeasSMB1_I.flgPtlMeasRSCFin "Instance of TWCD_CatMeasSM, Bank 1 / ROSC Partial result completed" UBYTE B_TRUE 1 100 0.00 1.00000000000 BIT_MASK 0x1 FORMAT "%13.11" ECU_ADDRESS 0x50001994 /end MEASUREMENT
/begin MEASUREMENT TWCD_CatMeasSMB1_I.flgPtlMeasRSCFinTmp "Instance of TWCD_CatMeasSM, Bank 1 / ROSC Partial result completed, preliminary" UBYTE B_TRUE 1 100 0.00 1.00000000000 BIT_MASK 0x1 FORMAT "%13.11" ECU_ADDRESS 0x50001995 /end MEASUREMENT
/begin MEASUREMENT TWCD_CatMeasSMB1_I.mOSC "Instance of TWCD_CatMeasSM, Bank 1 / Result of OSC measurement" ULONG m_q0p1_mg 1 100 0.00 429496729.500 FORMAT "%13.3" ECU_ADDRESS 0x50001998 /end MEASUREMENT
/begin MEASUREMENT TWCD_CatMeasSMB1_I.mOSCraw "Instance of TWCD_CatMeasSM, Bank 1 / Uncorrected OSC-result" ULONG m_q0p1_mg 1 100 0.00 429496729.500 FORMAT "%13.3" ECU_ADDRESS 0x5000199C /end MEASUREMENT
/begin MEASUREMENT TWCD_CatMeasSMB1_I.mOscLsuDynCorrd "Instance of TWCD_CatMeasSM, Bank 1 / OSC measurement with LSU dynamic correction" ULONG m_q0p1_mg 1 100 0.00 429496729.500 FORMAT "%13.3" ECU_ADDRESS 0x500019A0 /end MEASUREMENT
/begin MEASUREMENT TWCD_CatMeasSMB1_I.mOscNv "Instance of TWCD_CatMeasSM, Bank 1 / OSC measurement, non volatile" ULONG m_q0p1_mg 1 100 0.00 429496729.500 FORMAT "%13.3" ECU_ADDRESS 0x600362BC /end MEASUREMENT
/begin MEASUREMENT TWCD_CatMeasSMB1_I.mOscRawLsuDynCorrd "Instance of TWCD_CatMeasSM, Bank 1 / uncorrected OSC measurement with LSU dynamic correction" ULONG m_q0p1_mg 1 100 0.00 429496729.500 FORMAT "%13.3" ECU_ADDRESS 0x500019A4 /end MEASUREMENT
/begin MEASUREMENT TWCD_CatMeasSMB1_I.mOscRawTmp "Instance of TWCD_CatMeasSM, Bank 1 / Uncorrected OSC-result, temporary" ULONG m_q0p1_mg 1 100 0.00 429496729.500 FORMAT "%13.3" ECU_ADDRESS 0x500019A8 /end MEASUREMENT
/begin MEASUREMENT TWCD_CatMeasSMB1_I.mRoscLsuDynCorrd "Instance of TWCD_CatMeasSM, Bank 1 / RSC measurement with LSU dynamic correction" ULONG m_q0p1_mg 1 100 0.00 429496729.500 FORMAT "%13.3" ECU_ADDRESS 0x500019AC /end MEASUREMENT
/begin MEASUREMENT TWCD_CatMeasSMB1_I.mRoscRawLsuDynCorrd "Instance of TWCD_CatMeasSM, Bank 1 / uncorrected RSC measurement with LSU dynamic correction" ULONG m_q0p1_mg 1 100 0.00 429496729.500 FORMAT "%13.3" ECU_ADDRESS 0x500019B0 /end MEASUREMENT
/begin MEASUREMENT TWCD_CatMeasSMB1_I.ratOsc "Instance of TWCD_CatMeasSM, Bank 1 / normalized OSC" UWORD fak_uw_b16 1 100 0.00 15.99976 FORMAT "%8.5" ECU_ADDRESS 0x500019B4 /end MEASUREMENT
/begin MEASUREMENT TWCD_CatMeasSMB1_I.sm "Instance of TWCD_CatMeasSM, Bank 1 / Active State of statemachine" UBYTE TWCD_CatMeasSM_sm_VERB 1 100 0.00 8.00000000000 FORMAT "%13.11" ECU_ADDRESS 0x500019B6 /end MEASUREMENT
/begin MEASUREMENT TWCD_CatMeasSMB1_I.tiCorLeanRich "Instance of TWCD_CatMeasSM, Bank 1 / Correction for transition and delay time LeanToRich" UWORD t_q0p02 1 100 0.00 1310.700 FORMAT "%8.3" ECU_ADDRESS 0x500019B8 /end MEASUREMENT
/begin MEASUREMENT TWCD_CatMeasSMB1_I.tiCorRichLean "Instance of TWCD_CatMeasSM, Bank 1 / Correction for transition and delay time RichToLean" UWORD t_q0p02 1 100 0.00 1310.700 FORMAT "%8.3" ECU_ADDRESS 0x500019BA /end MEASUREMENT
/begin MEASUREMENT TWCD_CatMeasSMB1_I.DynCorrnOscLsuDyn_I.dmO2Corrn "Instance of TWCD_CatMeasSM, Bank 1 / class inst. for OSC correction with HEGO dynamic time, OSC with LSU dynamic correction / Deduction amount of HEGO dynamic correction" ULONG m_q0p1_mg 1 100 0.00 429496729.500 FORMAT "%13.3" ECU_ADDRESS 0x500019BC /end MEASUREMENT
/begin MEASUREMENT TWCD_CatMeasSMB1_I.DynCorrnOscLsuDyn_I.dmO2Grdt "Instance of TWCD_CatMeasSM, Bank 1 / class inst. for OSC correction with HEGO dynamic time, OSC with LSU dynamic correction / OSC gradient during OSC measurement for HEGO dynamic correction" ULONG m_q0p1_mgs 1 100 0.00 429496729.500 FORMAT "%13.3" ECU_ADDRESS 0x500019C0 /end MEASUREMENT
/begin MEASUREMENT TWCD_CatMeasSMB1_I.DynCorrnOscLsuDyn_I.mO2CorSlp "Instance of TWCD_CatMeasSM, Bank 1 / class inst. for OSC correction with HEGO dynamic time, OSC with LSU dynamic correction / Temporary variable f. OSC gradient calculation" ULONG m_q0p1_mg 1 100 0.00 429496729.500 FORMAT "%13.3" ECU_ADDRESS 0x500019C4 /end MEASUREMENT
/begin MEASUREMENT TWCD_CatMeasSMB1_I.DynCorrnOscLsuDyn_I.mO2Corrd "Instance of TWCD_CatMeasSM, Bank 1 / class inst. for OSC correction with HEGO dynamic time, OSC with LSU dynamic correction / OSC with HEGO dynamic correction" ULONG m_q0p1_mg 1 100 0.00 429496729.500 FORMAT "%13.3" ECU_ADDRESS 0x500019C8 /end MEASUREMENT
/begin MEASUREMENT TWCD_CatMeasSMB1_I.DynCorrnOscLsuDyn_I.tiCorSlp "Instance of TWCD_CatMeasSM, Bank 1 / class inst. for OSC correction with HEGO dynamic time, OSC with LSU dynamic correction / Time base f. OSC gradient calculation" UWORD t_q0p02 1 100 0.00 1310.700 FORMAT "%8.3" ECU_ADDRESS 0x500019CC /end MEASUREMENT
/begin MEASUREMENT TWCD_CatMeasSMB1_I.DynCorrnOsc_I.dmO2Corrn "Instance of TWCD_CatMeasSM, Bank 1 / class inst. for OSC correction with HEGO dynamic time / Deduction amount of HEGO dynamic correction" ULONG m_q0p1_mg 1 100 0.00 429496729.500 FORMAT "%13.3" ECU_ADDRESS 0x500019D0 /end MEASUREMENT
/begin MEASUREMENT TWCD_CatMeasSMB1_I.DynCorrnOsc_I.dmO2Grdt "Instance of TWCD_CatMeasSM, Bank 1 / class inst. for OSC correction with HEGO dynamic time / OSC gradient during OSC measurement for HEGO dynamic correction" ULONG m_q0p1_mgs 1 100 0.00 429496729.500 FORMAT "%13.3" ECU_ADDRESS 0x500019D4 /end MEASUREMENT
/begin MEASUREMENT TWCD_CatMeasSMB1_I.DynCorrnOsc_I.mO2CorSlp "Instance of TWCD_CatMeasSM, Bank 1 / class inst. for OSC correction with HEGO dynamic time / Temporary variable f. OSC gradient calculation" ULONG m_q0p1_mg 1 100 0.00 429496729.500 FORMAT "%13.3" ECU_ADDRESS 0x500019D8 /end MEASUREMENT
/begin MEASUREMENT TWCD_CatMeasSMB1_I.DynCorrnOsc_I.mO2Corrd "Instance of TWCD_CatMeasSM, Bank 1 / class inst. for OSC correction with HEGO dynamic time / OSC with HEGO dynamic correction" ULONG m_q0p1_mg 1 100 0.00 429496729.500 FORMAT "%13.3" ECU_ADDRESS 0x500019DC /end MEASUREMENT
/begin MEASUREMENT TWCD_CatMeasSMB1_I.DynCorrnOsc_I.tiCorSlp "Instance of TWCD_CatMeasSM, Bank 1 / class inst. for OSC correction with HEGO dynamic time / Time base f. OSC gradient calculation" UWORD t_q0p02 1 100 0.00 1310.700 FORMAT "%8.3" ECU_ADDRESS 0x500019E0 /end MEASUREMENT
/begin MEASUREMENT TWCD_CatMeasSMB1_I.DynCorrnRosc_I.dmO2Corrn "Instance of TWCD_CatMeasSM, Bank 1 / class inst. for RSC correction with HEGO dynamic time / Deduction amount of HEGO dynamic correction" ULONG m_q0p1_mg 1 100 0.00 429496729.500 FORMAT "%13.3" ECU_ADDRESS 0x500019E4 /end MEASUREMENT
/begin MEASUREMENT TWCD_CatMeasSMB1_I.DynCorrnRosc_I.dmO2Grdt "Instance of TWCD_CatMeasSM, Bank 1 / class inst. for RSC correction with HEGO dynamic time / OSC gradient during OSC measurement for HEGO dynamic correction" ULONG m_q0p1_mgs 1 100 0.00 429496729.500 FORMAT "%13.3" ECU_ADDRESS 0x500019E8 /end MEASUREMENT
/begin MEASUREMENT TWCD_CatMeasSMB1_I.DynCorrnRosc_I.mO2CorSlp "Instance of TWCD_CatMeasSM, Bank 1 / class inst. for RSC correction with HEGO dynamic time / Temporary variable f. OSC gradient calculation" ULONG m_q0p1_mg 1 100 0.00 429496729.500 FORMAT "%13.3" ECU_ADDRESS 0x500019EC /end MEASUREMENT
/begin MEASUREMENT TWCD_CatMeasSMB1_I.DynCorrnRosc_I.mO2Corrd "Instance of TWCD_CatMeasSM, Bank 1 / class inst. for RSC correction with HEGO dynamic time / OSC with HEGO dynamic correction" ULONG m_q0p1_mg 1 100 0.00 429496729.500 FORMAT "%13.3" ECU_ADDRESS 0x500019F0 /end MEASUREMENT
/begin MEASUREMENT TWCD_CatMeasSMB1_I.DynCorrnRosc_I.tiCorSlp "Instance of TWCD_CatMeasSM, Bank 1 / class inst. for RSC correction with HEGO dynamic time / Time base f. OSC gradient calculation" UWORD t_q0p02 1 100 0.00 1310.700 FORMAT "%8.3" ECU_ADDRESS 0x500019F4 /end MEASUREMENT
/begin MEASUREMENT TWCD_CatMeasSMB1_I.O2LsuDynCorrdIKL_I.memory "Instance of TWCD_CatMeasSM, Bank 1 / oxygen integrator using LSU dynamic corrected oxygen mass flow / Current Integrator value" FLOAT32_IEEE m_q1_mg 1 100 0.0000 1.0000E+037 FORMAT "%10.4" ECU_ADDRESS 0x500019F8 /end MEASUREMENT
/begin MEASUREMENT TWCD_CatMeasSMB1_I.O2MsIKL_I.memory "Instance of TWCD_CatMeasSM, Bank 1 / oxygen integrator / Current Integrator value" FLOAT32_IEEE m_q1_mg 1 100 0.0000 1.0000E+037 FORMAT "%10.4" ECU_ADDRESS 0x500019FC /end MEASUREMENT
/begin MEASUREMENT TWCD_CatMeasSMB1_I.flgMeasmtFinshdFF_I.status "Instance of TWCD_CatMeasSM, Bank 1 / flip flop for flag measurement of catalyst availible / current value of RS-FF" UBYTE B_TRUE 1 100 0.00 1.00000000000 BIT_MASK 0x1 FORMAT "%13.11" ECU_ADDRESS 0x50001A00 /end MEASUREMENT
/begin MEASUREMENT TWCD_CatMeasSMB1_I.flgMeasmtFinshdVirtFF_I.status "Instance of TWCD_CatMeasSM, Bank 1 / flip flop for virtual flag measurement of catalyst available / current value of RS-FF" UBYTE B_TRUE 1 100 0.00 1.00000000000 BIT_MASK 0x1 FORMAT "%13.11" ECU_ADDRESS 0x50001A01 /end MEASUREMENT
/begin MEASUREMENT TWCD_CatMeasSMB1_I.flgVirtMeasmtER_I.buffer "Instance of TWCD_CatMeasSM, Bank 1 / Edge rising f. virtual measurement of catalyst available / rising edge detected" UBYTE B_TRUE 1 100 0.00 1.00000000000 BIT_MASK 0x1 FORMAT "%13.11" ECU_ADDRESS 0x50001A02 /end MEASUREMENT
/begin MEASUREMENT TWCD_CatMeasSMB1_I.flgVirtMeasmtER_I.oldSignal "Instance of TWCD_CatMeasSM, Bank 1 / Edge rising f. virtual measurement of catalyst available / flag rising edge" UBYTE B_TRUE 1 100 0.00 1.00000000000 BIT_MASK 0x1 FORMAT "%13.11" ECU_ADDRESS 0x50001A03 /end MEASUREMENT
/begin MEASUREMENT TWCD_ctReIniEval "ReInitialization counter" UBYTE OneToOne 1 100 0.00 255.0 FORMAT "%5.1" ECU_ADDRESS 0x6000622F /end MEASUREMENT
/begin MEASUREMENT TWCD_dmGasB1 "exhaust mass flow catalyst, local" UWORD m_uw_b6553p5 1 100 0.00 6553.500 FORMAT "%8.3" ECU_ADDRESS 0x60003476 /end MEASUREMENT
/begin MEASUREMENT TWCD_DsmIfCat1B1_I.flgErr "TWCD_Eval: class for DSM interface - Cat1B1 / Flag error" UBYTE B_TRUE 1 100 0.00 1.00000000000 BIT_MASK 0x1 FORMAT "%13.11" ECU_ADDRESS 0x500054CA /end MEASUREMENT
/begin MEASUREMENT TWCD_DsmIfCat1B1_I.flgErrSus "TWCD_Eval: class for DSM interface - Cat1B1 / Flag suspected error" UBYTE B_TRUE 1 100 0.00 1.00000000000 BIT_MASK 0x1 FORMAT "%13.11" ECU_ADDRESS 0x500054CB /end MEASUREMENT
/begin MEASUREMENT TWCD_DsmIfCat1B1_I.flgHeal "TWCD_Eval: class for DSM interface - Cat1B1 / Flag healing (ok result)" UBYTE B_TRUE 1 100 0.00 1.00000000000 BIT_MASK 0x1 FORMAT "%13.11" ECU_ADDRESS 0x500054CC /end MEASUREMENT
/begin MEASUREMENT TWCD_DsmIfCat1B1_I.flgVldnFin "TWCD_Eval: class for DSM interface - Cat1B1 / Flag validation finished" UBYTE B_TRUE 1 100 0.00 1.00000000000 BIT_MASK 0x1 FORMAT "%13.11" ECU_ADDRESS 0x500054CD /end MEASUREMENT
/begin MEASUREMENT TWCD_DsmIfCat1B1_I.rDiagRslt "TWCD_Eval: class for DSM interface - Cat1B1 / quantitative diagnosis result" UWORD fak_uw_b16 1 100 0.00 15.99976 FORMAT "%8.5" ECU_ADDRESS 0x500054CE /end MEASUREMENT
/begin MEASUREMENT TWCD_DsmIfCat1B1_I.RsltER_I.buffer "TWCD_Eval: class for DSM interface - Cat1B1 / diagnosis result edge rising / rising edge detected" UBYTE B_TRUE 1 100 0.00 1.00000000000 BIT_MASK 0x1 FORMAT "%13.11" ECU_ADDRESS 0x500054D0 /end MEASUREMENT
/begin MEASUREMENT TWCD_DsmIfCat1B1_I.RsltER_I.oldSignal "TWCD_Eval: class for DSM interface - Cat1B1 / diagnosis result edge rising / flag rising edge" UBYTE B_TRUE 1 100 0.00 1.00000000000 BIT_MASK 0x1 FORMAT "%13.11" ECU_ADDRESS 0x500054D1 /end MEASUREMENT
/begin MEASUREMENT TWCD_DsmIfCat1B1_I.flgErrSusERNM_I.oldSignal "TWCD_Eval: class for DSM interface - Cat1B1 / edge rising suspected error / value of input signal last calculation" UBYTE B_TRUE 1 100 0.00 1.00000000000 BIT_MASK 0x1 FORMAT "%13.11" ECU_ADDRESS 0x500054D2 /end MEASUREMENT
/begin MEASUREMENT TWCD_flgErrSusB1 "Error suspected in catalyst diagnosis, bank1" UBYTE B_TRUE 1 100 0.00 1.00000000000 BIT_MASK 0x1 FORMAT "%13.11" ECU_ADDRESS 0x70000647 /end MEASUREMENT
/begin MEASUREMENT TWCD_flgEvalDsmTripChgFinshd "flag for dsm trip charge finished in TWCD_Eval" UBYTE B_TRUE 1 100 0.00 1.00000000000 BIT_MASK 0x1 FORMAT "%13.11" ECU_ADDRESS 0x700000DB /end MEASUREMENT
/begin MEASUREMENT TWCD_flgFCMClrReqdCatMeasCat1B1 "FCM-Clear requested Cat1 Bank1" UBYTE B_TRUE 1 100 0.00 1.00000000000 BIT_MASK 0x1 FORMAT "%13.11" ECU_ADDRESS 0x70000646 /end MEASUREMENT
/begin MEASUREMENT TWCD_flgFCMClrReqdEvalCat1B1 "FCM-Clear requested Cat1 Bank1" UBYTE B_TRUE 1 100 0.00 1.00000000000 BIT_MASK 0x1 FORMAT "%13.11" ECU_ADDRESS 0x700000DA /end MEASUREMENT
/begin MEASUREMENT TWCD_flgMeasFinB1 "Flag measurement of catalyst availible" UBYTE B_TRUE 1 100 0.00 1.00000000000 BIT_MASK 0x1 FORMAT "%13.11" ECU_ADDRESS 0x70000645 /end MEASUREMENT
/begin MEASUREMENT TWCD_flgMeasFinshdTripB1 "completed catalyst diagnosis measurements for current driving cycle" UBYTE B_TRUE 1 100 0.00 1.00000000000 BIT_MASK 0x1 FORMAT "%13.11" ECU_ADDRESS 0x70000643 /end MEASUREMENT
/begin MEASUREMENT TWCD_flgMeasFinshdVirtTripB1 "Flag virtual measurements complete for this driving cycle" UBYTE B_TRUE 1 100 0.00 1.00000000000 BIT_MASK 0x1 FORMAT "%13.11" ECU_ADDRESS 0x70000642 /end MEASUREMENT
/begin MEASUREMENT TWCD_flgMeasFinVirtB1 "Flag virtual measurement of catalyst availible" UBYTE B_TRUE 1 100 0.00 1.00000000000 BIT_MASK 0x1 FORMAT "%13.11" ECU_ADDRESS 0x70000644 /end MEASUREMENT
/begin MEASUREMENT TWCD_flgOSCQPFaildPriB1 "Flag QuickPass not passed with actual measurement" UBYTE B_TRUE 1 100 0.00 1.00000000000 BIT_MASK 0x1 FORMAT "%13.11" ECU_ADDRESS 0x70000641 /end MEASUREMENT
/begin MEASUREMENT TWCD_flgOSCStepChgPriB1 "StepChange for OSC-measurement active" UBYTE B_TRUE 1 100 0.00 1.00000000000 BIT_MASK 0x1 FORMAT "%13.11" ECU_ADDRESS 0x70000640 /end MEASUREMENT
/begin MEASUREMENT TWCD_flgPtlMeasOSCFinB1 "OSC Partial result completed, bank 1" UBYTE B_TRUE 1 100 0.00 1.00000000000 BIT_MASK 0x1 FORMAT "%13.11" ECU_ADDRESS 0x7000063F /end MEASUREMENT
/begin MEASUREMENT TWCD_flgPtlMeasRSCFinB1 "ROSC Partial result completed, bank 1" UBYTE B_TRUE 1 100 0.00 1.00000000000 BIT_MASK 0x1 FORMAT "%13.11" ECU_ADDRESS 0x7000063E /end MEASUREMENT
/begin MEASUREMENT TWCD_flgResOSCPriB1 "OSC-result of catalyst diagnosis available (not validated)" UBYTE B_TRUE 1 100 0.00 1.00000000000 BIT_MASK 0x1 FORMAT "%13.11" ECU_ADDRESS 0x7000063D /end MEASUREMENT
/begin MEASUREMENT TWCD_flgResVirtOSCPriB1 "OSC-result of catalyst diagnosis for IUMPR-simulation available (not validated)" UBYTE B_TRUE 1 100 0.00 1.00000000000 BIT_MASK 0x1 FORMAT "%13.11" ECU_ADDRESS 0x7000063C /end MEASUREMENT
/begin MEASUREMENT TWCD_FltDsEval_B1.flgMeasFinshdTrip "Filter class for catalyt diagnosis / Flag measurements complete for this driving cycle" UBYTE B_TRUE 1 100 0.00 1.00000000000 BIT_MASK 0x1 FORMAT "%13.11" ECU_ADDRESS 0x50001A04 /end MEASUREMENT
/begin MEASUREMENT TWCD_FltDsEval_B1.flgNumTemp "Filter class for catalyt diagnosis / Flag activ if the number of virtual measurement is bigger than a threshold" UBYTE B_TRUE 1 100 0.00 1.00000000000 BIT_MASK 0x1 FORMAT "%13.11" ECU_ADDRESS 0x50001A05 /end MEASUREMENT
/begin MEASUREMENT TWCD_FltDsEval_B1.flgOSCQPFaild "Filter class for catalyt diagnosis / Flag QuickPass with current measurement not successful" UBYTE B_TRUE 1 100 0.00 1.00000000000 BIT_MASK 0x1 FORMAT "%13.11" ECU_ADDRESS 0x50001A06 /end MEASUREMENT
/begin MEASUREMENT TWCD_FltDsEval_B1.flgOSCStepChgPri "Filter class for catalyt diagnosis / StepChange for OSC- Measurement active" UBYTE B_TRUE 1 100 0.00 1.00000000000 BIT_MASK 0x1 FORMAT "%13.11" ECU_ADDRESS 0x600362B2 /end MEASUREMENT
/begin MEASUREMENT TWCD_FltDsEval_B1.flgQPFaild "Filter class for catalyt diagnosis / Condition: diagnosis has not achieved Quickpass" UBYTE B_TRUE 1 100 0.00 1.00000000000 BIT_MASK 0x1 FORMAT "%13.11" ECU_ADDRESS 0x50001A07 /end MEASUREMENT
/begin MEASUREMENT TWCD_FltDsEval_B1.flgQckPassd "Filter class for catalyt diagnosis / Condition: diagnosis has achieved Quickpass" UBYTE B_TRUE 1 100 0.00 1.00000000000 BIT_MASK 0x1 FORMAT "%13.11" ECU_ADDRESS 0x50001A08 /end MEASUREMENT
/begin MEASUREMENT TWCD_FltDsEval_B1.flgResOSCPri "Filter class for catalyt diagnosis / OSC Result of catalyst diagnosis present" UBYTE B_TRUE 1 100 0.00 1.00000000000 BIT_MASK 0x1 FORMAT "%13.11" ECU_ADDRESS 0x50001A09 /end MEASUREMENT
/begin MEASUREMENT TWCD_FltDsEval_B1.flgResVirtOSCPri "Filter class for catalyt diagnosis / OSC Result of catalyst diagnosis for IUMPR- Simulation present" UBYTE B_TRUE 1 100 0.00 1.00000000000 BIT_MASK 0x1 FORMAT "%13.11" ECU_ADDRESS 0x50001A0A /end MEASUREMENT
/begin MEASUREMENT TWCD_FltDsEval_B1.flgStepChg "Filter class for catalyt diagnosis / Condition: Step-change logic active" UBYTE B_TRUE 1 100 0.00 1.00000000000 BIT_MASK 0x1 FORMAT "%13.11" ECU_ADDRESS 0x600362B3 /end MEASUREMENT
/begin MEASUREMENT TWCD_FltDsEval_B1.flgVirtMeasFinshdTrip "Filter class for catalyt diagnosis / Flag virtual measurements complete for this driving cycle" UBYTE B_TRUE 1 100 0.00 1.00000000000 BIT_MASK 0x1 FORMAT "%13.11" ECU_ADDRESS 0x50001A0B /end MEASUREMENT
/begin MEASUREMENT TWCD_FltDsEval_B1.numMeas "Filter class for catalyt diagnosis / Number of measurements" UBYTE dez 1 100 0.00 255.0 FORMAT "%5.1" ECU_ADDRESS 0x600362B4 /end MEASUREMENT
/begin MEASUREMENT TWCD_FltDsEval_B1.numMeasShrtp "Filter class for catalyt diagnosis / Number of measurements - Short trip" UBYTE dez 1 100 0.00 255.0 FORMAT "%5.1" ECU_ADDRESS 0x50001A0C /end MEASUREMENT
/begin MEASUREMENT TWCD_FltDsEval_B1.numMeasTrip "Filter class for catalyt diagnosis / Number of measurements in DCY" UBYTE dez 1 100 0.00 255.0 FORMAT "%5.1" ECU_ADDRESS 0x50001A0D /end MEASUREMENT
/begin MEASUREMENT TWCD_FltDsEval_B1.numVirtMeas "Filter class for catalyt diagnosis / Number of virtual measurements (IUMPR)" UBYTE dez 1 100 0.00 255.0 FORMAT "%5.1" ECU_ADDRESS 0x600362B5 /end MEASUREMENT
/begin MEASUREMENT TWCD_FltDsEval_B1.numVirtMeasTrip "Filter class for catalyt diagnosis / Number of virtual measurements (IUMPR) in DCY" UBYTE dez 1 100 0.00 255.0 FORMAT "%5.1" ECU_ADDRESS 0x50001A0E /end MEASUREMENT
/begin MEASUREMENT TWCD_FltDsEval_B1.rOSCAvrgPri "Filter class for catalyt diagnosis / Oxygen storage capacity of catalyst, filtered value" UWORD fak_uw_b16 1 100 0.00 15.99976 FORMAT "%8.5" ECU_ADDRESS 0x600362B6 /end MEASUREMENT
/begin MEASUREMENT TWCD_FltDsEval_B1.val "Filter class for catalyt diagnosis / Result of catalyst diagnosis" UWORD fak_uw_b16 1 100 0.00 15.99976 FORMAT "%8.5" ECU_ADDRESS 0x50001A10 /end MEASUREMENT
/begin MEASUREMENT TWCD_FltDsEval_B1.valArth "Filter class for catalyt diagnosis / Arithmetically filtered result of catalyst diagnosis" UWORD fak_uw_b16 1 100 0.00 15.99976 FORMAT "%8.5" ECU_ADDRESS 0x600362B8 /end MEASUREMENT
/begin MEASUREMENT TWCD_FltDsEval_B1.valEwma "Filter class for catalyt diagnosis / EWMA filtered result of catalyst diagnosis" UWORD fak_uw_b16 1 100 0.00 15.99976 FORMAT "%8.5" ECU_ADDRESS 0x600362BA /end MEASUREMENT
/begin MEASUREMENT TWCD_FltDsEval_B1.valQuickPass "Filter class for catalyt diagnosis / Quickpass result of catalyst diagnosis" UWORD fak_uw_b16 1 100 0.00 15.99976 FORMAT "%8.5" ECU_ADDRESS 0x50001A12 /end MEASUREMENT
/begin MEASUREMENT TWCD_FltDsEval_B1.valArthDL_I.memory "Filter class for catalyt diagnosis / Low pass: Arithmetically filtered result of catalyst diagnosis / current lowpass value" ULONG fak_q3p72529Em9 1 100 0.00 15.9999999963 FORMAT "%13.10" ECU_ADDRESS 0x50001A18 /end MEASUREMENT
/begin MEASUREMENT TWCD_FltDsEval_B1.valArthShrtpDL_I.memory "Filter class for catalyt diagnosis / Filter class for catalyt diagnosis Low pass: Arithmetically filtered result of catalyst diagnosis (short trip) / current lowpass value" ULONG fak_q3p72529Em9 1 100 0.00 15.9999999963 FORMAT "%13.10" ECU_ADDRESS 0x50001A1C /end MEASUREMENT
/begin MEASUREMENT TWCD_FltDsEval_B1.valEwmaDL_I.memory "Filter class for catalyt diagnosis / Low pass: EWMA filtered result of catalyst diagnosis / current lowpass value" ULONG fak_q3p72529Em9 1 100 0.00 15.9999999963 FORMAT "%13.10" ECU_ADDRESS 0x50001A20 /end MEASUREMENT
/begin MEASUREMENT TWCD_mfO2LSUDynB1 "O2 massflow based on lambda value adjusted by LSU-dynamics, Bank 1" FLOAT32_IEEE mgrad_q1_mgdivs 1 100 -1.0000E+037 1.0000E+037 FORMAT "%10.4" ECU_ADDRESS 0x600012D4 /end MEASUREMENT
/begin MEASUREMENT TWCD_mOscExtdCat1B1 "Oxygen storage capacity of the catalyst for diagnosis, high range, catalyst 1 bank 1" ULONG m_q0p1_mg 1 100 0.00 429496729.500 FORMAT "%13.3" ECU_ADDRESS 0x6000D744 /end MEASUREMENT
/begin MEASUREMENT TWCD_mOscNewCat1B1 "Osc of the new catalyst, Cat1B1" ULONG m_q0p1_mg 1 100 0.00 429496729.500 FORMAT "%13.3" ECU_ADDRESS 0x60001BC0 /end MEASUREMENT
/begin MEASUREMENT TWCD_mOSCNrmDiumprExtdB1 "Temperature corrected borderline Oxygen storage capacity (OSC) of catalyst for IUMPR simulation, high range" ULONG m_q0p1_mg 1 100 0.00 429496729.500 FORMAT "%13.3" ECU_ADDRESS 0x6000D740 /end MEASUREMENT
/begin MEASUREMENT TWCD_mOSCNrmExtdB1 "Temperature corrected borderline Oxygen storage capacity (OSC) of catalyst, high range" ULONG m_q0p1_mg 1 100 0.00 429496729.500 FORMAT "%13.3" ECU_ADDRESS 0x60001BC4 /end MEASUREMENT
/begin MEASUREMENT TWCD_mOscPtlCorrdCat1B1 "Corrected partial OSC-result depending on LSU sensor dynamics, Cat1B1" UWORD m_q0p1_mg 1 100 0.00 6553.500 FORMAT "%8.3" ECU_ADDRESS 0x6000E2D8 /end MEASUREMENT
/begin MEASUREMENT TWCD_mOscPtlCorrdExtdCat1B1 "Corrected partial OSC-result depending on LSU sensor dynamics, Cat1B1" ULONG m_q0p1_mg 1 100 0.00 429496729.500 FORMAT "%13.3" ECU_ADDRESS 0x6000D748 /end MEASUREMENT
/begin MEASUREMENT TWCD_mRSCNrmDiumprExtdB1 "Temperature corrected borderline Rich gas storage capacity (RSC) of catalyst for IUMPR simulation, high range" ULONG m_q0p1_mg 1 100 0.00 429496729.500 FORMAT "%13.3" ECU_ADDRESS 0x6000D74C /end MEASUREMENT
/begin MEASUREMENT TWCD_mRSCNrmExtdB1 "Temperature corrected borderline Rich gas storage capacity (RSC) of catalyst, high range" ULONG m_q0p1_mg 1 100 0.00 429496729.500 FORMAT "%13.3" ECU_ADDRESS 0x60001BBC /end MEASUREMENT
/begin MEASUREMENT TWCD_mRscPtlCorrdCat1B1 "Corrected partial RSC-result depending on LSU sensor dynamics, Cat1B1" UWORD m_q0p1_mg 1 100 0.00 6553.500 FORMAT "%8.3" ECU_ADDRESS 0x6000E2DA /end MEASUREMENT
/begin MEASUREMENT TWCD_mRscPtlCorrdExtdCat1B1 "Corrected partial RSC-result depending on LSU sensor dynamics high-range, Cat1B1" ULONG m_q0p1_mg 1 100 0.00 429496729.500 FORMAT "%13.3" ECU_ADDRESS 0x6000D750 /end MEASUREMENT
/begin MEASUREMENT TWCD_NewOscPriB1_I.ctBrick "Calculation of the Osc of the new catalyst, Cat1B1 / counter for catalyst bricks" UBYTE dez 1 100 0.00 255.0 FORMAT "%5.1" ECU_ADDRESS 0x50001A24 /end MEASUREMENT
/begin MEASUREMENT TWCD_NewOscPriB1_I.dmGas "Calculation of the Osc of the new catalyst, Cat1B1 / massenstrom für grenzkatalysator" UWORD m_uw_b6553p5 1 100 0.00 6553.500 FORMAT "%8.3" ECU_ADDRESS 0x50001A26 /end MEASUREMENT
/begin MEASUREMENT TWCD_NewOscPriB1_I.mOsc "Calculation of the Osc of the new catalyst, Cat1B1 / oxygen storage capacity" ULONG m_q0p1_mg 1 100 0.00 429496729.500 FORMAT "%13.3" ECU_ADDRESS 0x50001A28 /end MEASUREMENT
/begin MEASUREMENT TWCD_NewOscPriB1_I.tBrick "Calculation of the Osc of the new catalyst, Cat1B1 / catalyst brick temperature" SWORD Temp_Cels 1 100 -3549.940 3003.560 FORMAT "%8.3" ECU_ADDRESS 0x50001A2C /end MEASUREMENT
/begin MEASUREMENT TWCD_NrmOSCPriB1_I.ctBrick "calculation of borderline OSC, 1st cat. bank 1 / counter for catalyst bricks" UBYTE dez 1 100 0.00 255.0 FORMAT "%5.1" ECU_ADDRESS 0x50001A30 /end MEASUREMENT
/begin MEASUREMENT TWCD_NrmOSCPriB1_I.dmGas "calculation of borderline OSC, 1st cat. bank 1 / massenstrom für grenzkatalysator" UWORD m_uw_b6553p5 1 100 0.00 6553.500 FORMAT "%8.3" ECU_ADDRESS 0x50001A32 /end MEASUREMENT
/begin MEASUREMENT TWCD_NrmOSCPriB1_I.mOsc "calculation of borderline OSC, 1st cat. bank 1 / oxygen storage capacity" ULONG m_q0p1_mg 1 100 0.00 429496729.500 FORMAT "%13.3" ECU_ADDRESS 0x50001A34 /end MEASUREMENT
/begin MEASUREMENT TWCD_NrmOSCPriB1_I.tBrick "calculation of borderline OSC, 1st cat. bank 1 / catalyst brick temperature" SWORD Temp_Cels 1 100 -3549.940 3003.560 FORMAT "%8.3" ECU_ADDRESS 0x50001A38 /end MEASUREMENT
/begin MEASUREMENT TWCD_numMeasB1 "Number of measurements for B1" UBYTE dez 1 100 0.00 255.0 FORMAT "%5.1" ECU_ADDRESS 0x6000A00C /end MEASUREMENT
/begin MEASUREMENT TWCD_ratLamLSUDynB1 "Modeled lambda value adjusted by LSU-dynamics, Bank 1" UWORD fak_uw_b16 1 100 0.00 15.99976 FORMAT "%8.5" ECU_ADDRESS 0x6000D97C /end MEASUREMENT
/begin MEASUREMENT TWCD_ratLamLsuDynCorrdCat1B1 "Modeled lambda value adjusted by LSU-dynamics and gas transport delay, Bank 1" UWORD fak_uw_b16 1 100 0.00 15.99976 FORMAT "%8.5" ECU_ADDRESS 0x60003478 /end MEASUREMENT
/begin MEASUREMENT TWCD_rDiagRsltB1 "Result catalyst diagnosis, bank 1" UWORD fak_uw_b16 1 100 0.00 15.99976 FORMAT "%8.5" ECU_ADDRESS 0x6000487A /end MEASUREMENT
/begin MEASUREMENT TWCD_rOSCAvrgPriB1 "Oxygen storage capacity of the primary catalyst, catalyst monitoring, filtered value, bank 1" UWORD fak_uw_b16 1 100 0.00 15.99976 FORMAT "%8.5" ECU_ADDRESS 0x60004878 /end MEASUREMENT
/begin MEASUREMENT TWCD_rOSCPriB1 "Result diagnosis primary catalyst, bank 1" UWORD fak_uw_b16 1 100 0.00 15.99976 FORMAT "%8.5" ECU_ADDRESS 0x60004C4A /end MEASUREMENT
/begin MEASUREMENT UEGO_CJ135Ctl_cntrReini "Number of transitions from PostDrive to Drive" UBYTE OneToOne 1 100 0.00 255.0 FORMAT "%5.1" ECU_ADDRESS 0x6000622E /end MEASUREMENT
/begin MEASUREMENT UEGO_CJ135CtrlS1B1_I.A1UN "CJ135 ASIC control Class / A1UN" UBYTE B_TRUE 1 100 0.00 1.00000000000 BIT_MASK 0x80 FORMAT "%13.11" ECU_ADDRESS 0x500054FC /end MEASUREMENT
/begin MEASUREMENT UEGO_CJ135CtrlS1B1_I.CJ135ModDes "CJ135 ASIC control Class / CJ135 desired mode" UBYTE dez 1 100 0.00 255.0 FORMAT "%5.1" ECU_ADDRESS 0x500054F2 /end MEASUREMENT
/begin MEASUREMENT UEGO_CJ135CtrlS1B1_I.KD "CJ135 ASIC control Class / gain of filter" SWORD q0p4728 1 100 0.00 3872.705 FORMAT "%8.3" ECU_ADDRESS 0x500054F4 /end MEASUREMENT
/begin MEASUREMENT UEGO_CJ135CtrlS1B1_I.KI "CJ135 ASIC control Class / gain of filter" SWORD q0p014775 1 100 0.00 121.0220 FORMAT "%8.4" ECU_ADDRESS 0x500054F6 /end MEASUREMENT
/begin MEASUREMENT UEGO_CJ135CtrlS1B1_I.KP "CJ135 ASIC control Class / gain of filter" SWORD q0p1182 1 100 0.00 968.1762 FORMAT "%8.4" ECU_ADDRESS 0x500054F8 /end MEASUREMENT
/begin MEASUREMENT UEGO_CJ135CtrlS1B1_I.KRF "CJ135 ASIC control Class / gain of filter" UWORD fak_uw_b512 1 100 0.00 0.9921875 FORMAT "%9.7" ECU_ADDRESS 0x500054FA /end MEASUREMENT
/begin MEASUREMENT UEGO_CJ135CtrlS1B1_I.UNB0 "CJ135 ASIC control Class / UNB0" SWORD q0p1182_mA_DIV_V 1 100 0.00 968.1762 FORMAT "%8.4" ECU_ADDRESS 0x50005500 /end MEASUREMENT
/begin MEASUREMENT UEGO_CJ135CtrlS1B1_I.UNB1 "CJ135 ASIC control Class / UNB1" SWORD q0p1182_mA_DIV_V 1 100 -968.2944 968.1762 FORMAT "%8.4" ECU_ADDRESS 0x50005502 /end MEASUREMENT
/begin MEASUREMENT UEGO_CJ135CtrlS1B1_I.UNB2 "CJ135 ASIC control Class / UNB2" SWORD q0p1182_mA_DIV_V 1 100 0.00 968.1762 FORMAT "%8.4" ECU_ADDRESS 0x50005504 /end MEASUREMENT
/begin MEASUREMENT UEGO_CJ135CtrlS1B1_I.UNBChkSum "CJ135 ASIC control Class / UNBChkSum" SWORD q0p1182_mA_DIV_V 1 100 -3873.178 3873.059 FORMAT "%8.3" ECU_ADDRESS 0x50005506 /end MEASUREMENT
/begin MEASUREMENT UEGO_CJ135CtrlS1B1_I.flgBlcknProtnActvd "CJ135 ASIC control Class / Flag indicating activation status of blackening protection" UBYTE B_TRUE 1 100 0.00 1.00000000000 BIT_MASK 0x80 FORMAT "%13.11" ECU_ADDRESS 0x500054FE /end MEASUREMENT
/begin MEASUREMENT UEGO_CJ135CtrlS1B1_I.flgNernstCellPenActv "CJ135 ASIC control Class / flag nernst cell penetration active" UBYTE B_TRUE 1 100 0.00 1.00000000000 BIT_MASK 0x80 FORMAT "%13.11" ECU_ADDRESS 0x500054FD /end MEASUREMENT
/begin MEASUREMENT UEGO_CJ135CtrlS1B1_I.flgNernstCellPenPsbl "CJ135 ASIC control Class / flag nernst cell penetration possible" UBYTE B_TRUE 1 100 0.00 1.00000000000 BIT_MASK 0x40 FORMAT "%13.11" ECU_ADDRESS 0x500054FD /end MEASUREMENT
/begin MEASUREMENT UEGO_CJ135CtrlS1B1_I.flgNormalStdDes "CJ135 ASIC control Class / Status info if, in pump current mode, the normal operation is requested" UBYTE B_TRUE 1 100 0.00 1.00000000000 BIT_MASK 0x4 FORMAT "%13.11" ECU_ADDRESS 0x500054FF /end MEASUREMENT
/begin MEASUREMENT UEGO_CJ135CtrlS1B1_I.flgOptNotStaticOld "CJ135 ASIC control Class / flag optimal not static old" UBYTE B_TRUE 1 100 0.00 1.00000000000 BIT_MASK 0x1 FORMAT "%13.11" ECU_ADDRESS 0x500054FC /end MEASUREMENT
/begin MEASUREMENT UEGO_CJ135CtrlS1B1_I.flgPIDCtlActvd "CJ135 ASIC control Class / activation status for PID control" UBYTE B_TRUE 1 100 0.00 1.00000000000 BIT_MASK 0x2 FORMAT "%13.11" ECU_ADDRESS 0x500054FD /end MEASUREMENT
/begin MEASUREMENT UEGO_CJ135CtrlS1B1_I.flgPIDCtlStdCur "CJ135 ASIC control Class / PID control started" UBYTE B_TRUE 1 100 0.00 1.00000000000 BIT_MASK 0x4 FORMAT "%13.11" ECU_ADDRESS 0x500054FD /end MEASUREMENT
/begin MEASUREMENT UEGO_CJ135CtrlS1B1_I.flgPIDCtlStdDes "CJ135 ASIC control Class / Desired status of PID control." UBYTE B_TRUE 1 100 0.00 1.00000000000 BIT_MASK 0x8 FORMAT "%13.11" ECU_ADDRESS 0x500054FD /end MEASUREMENT
/begin MEASUREMENT UEGO_CJ135CtrlS1B1_I.flgPIDRngReachd "CJ135 ASIC control Class / PID range reached" UBYTE B_TRUE 1 100 0.00 1.00000000000 BIT_MASK 0x1 FORMAT "%13.11" ECU_ADDRESS 0x500054FD /end MEASUREMENT
/begin MEASUREMENT UEGO_CJ135CtrlS1B1_I.flgParmsChgUnNeeded "CJ135 ASIC control Class / change of parameters for nernst voltage needed" UBYTE B_TRUE 1 100 0.00 1.00000000000 BIT_MASK 0x20 FORMAT "%13.11" ECU_ADDRESS 0x500054FE /end MEASUREMENT
/begin MEASUREMENT UEGO_CJ135CtrlS1B1_I.flgParmsChgUpNeeded "CJ135 ASIC control Class / change of parameter for pump cell voltage needed" UBYTE B_TRUE 1 100 0.00 1.00000000000 BIT_MASK 0x40 FORMAT "%13.11" ECU_ADDRESS 0x500054FE /end MEASUREMENT
/begin MEASUREMENT UEGO_CJ135CtrlS1B1_I.flgRefPmpStd "CJ135 ASIC control Class / reference pump current started status" UBYTE B_TRUE 1 100 0.00 1.00000000000 BIT_MASK 0x2 FORMAT "%13.11" ECU_ADDRESS 0x500054FC /end MEASUREMENT
/begin MEASUREMENT UEGO_CJ135CtrlS1B1_I.flgRefPmpStop "CJ135 ASIC control Class / reference pump current stoppedstatus" UBYTE B_TRUE 1 100 0.00 1.00000000000 BIT_MASK 0x10 FORMAT "%13.11" ECU_ADDRESS 0x500054FC /end MEASUREMENT
/begin MEASUREMENT UEGO_CJ135CtrlS1B1_I.flgRefPmpStrt "CJ135 ASIC control Class / reference pump current started status" UBYTE B_TRUE 1 100 0.00 1.00000000000 BIT_MASK 0x20 FORMAT "%13.11" ECU_ADDRESS 0x500054FC /end MEASUREMENT
/begin MEASUREMENT UEGO_CJ135CtrlS1B1_I.flgRegLnCur "CJ135 ASIC control Class / Register ln current status" UBYTE B_TRUE 1 100 0.00 1.00000000000 BIT_MASK 0x1 FORMAT "%13.11" ECU_ADDRESS 0x500054FE /end MEASUREMENT
/begin MEASUREMENT UEGO_CJ135CtrlS1B1_I.flgRegLnDes "CJ135 ASIC control Class / Register ln desired status" UBYTE B_TRUE 1 100 0.00 1.00000000000 BIT_MASK 0x2 FORMAT "%13.11" ECU_ADDRESS 0x500054FE /end MEASUREMENT
/begin MEASUREMENT UEGO_CJ135CtrlS1B1_I.flgRegLpCur "CJ135 ASIC control Class / current Lp" UBYTE B_TRUE 1 100 0.00 1.00000000000 BIT_MASK 0x4 FORMAT "%13.11" ECU_ADDRESS 0x500054FE /end MEASUREMENT
/begin MEASUREMENT UEGO_CJ135CtrlS1B1_I.flgRegLpDes "CJ135 ASIC control Class / Desired Lp" UBYTE B_TRUE 1 100 0.00 1.00000000000 BIT_MASK 0x8 FORMAT "%13.11" ECU_ADDRESS 0x500054FE /end MEASUREMENT
/begin MEASUREMENT UEGO_CJ135CtrlS1B1_I.flgRpcDes "CJ135 ASIC control Class / indication for requested pump current reversion" UBYTE B_TRUE 1 100 0.00 1.00000000000 BIT_MASK 0x1 FORMAT "%13.11" ECU_ADDRESS 0x500054FF /end MEASUREMENT
/begin MEASUREMENT UEGO_CJ135CtrlS1B1_I.flgRvsChrgCMeas "CJ135 ASIC control Class / reverse charge capacitance measure." UBYTE B_TRUE 1 100 0.00 1.00000000000 BIT_MASK 0x2 FORMAT "%13.11" ECU_ADDRESS 0x500054FF /end MEASUREMENT
/begin MEASUREMENT UEGO_CJ135CtrlS1B1_I.flgSetRegOk "CJ135 ASIC control Class / set register OK" UBYTE B_TRUE 1 100 0.00 1.00000000000 BIT_MASK 0x4 FORMAT "%13.11" ECU_ADDRESS 0x500054FC /end MEASUREMENT
/begin MEASUREMENT UEGO_CJ135CtrlS1B1_I.flgSetTrimSqOk "CJ135 ASIC control Class / Set TRIMSQ register OK" UBYTE B_TRUE 1 100 0.00 1.00000000000 BIT_MASK 0x10 FORMAT "%13.11" ECU_ADDRESS 0x500054FF /end MEASUREMENT
/begin MEASUREMENT UEGO_CJ135CtrlS1B1_I.flgSnsrHot "CJ135 ASIC control Class / flag if sensor is hot" UBYTE B_TRUE 1 100 0.00 1.00000000000 BIT_MASK 0x8 FORMAT "%13.11" ECU_ADDRESS 0x500054FC /end MEASUREMENT
/begin MEASUREMENT UEGO_CJ135CtrlS1B1_I.flgSwtOnFin "CJ135 ASIC control Class / Switch ON finished" UBYTE B_TRUE 1 100 0.00 1.00000000000 BIT_MASK 0x40 FORMAT "%13.11" ECU_ADDRESS 0x500054FC /end MEASUREMENT
/begin MEASUREMENT UEGO_CJ135CtrlS1B1_I.flgTCerLo "CJ135 ASIC control Class / Flag indicating a low sensor temperature" UBYTE B_TRUE 1 100 0.00 1.00000000000 BIT_MASK 0x8 FORMAT "%13.11" ECU_ADDRESS 0x500054FF /end MEASUREMENT
/begin MEASUREMENT UEGO_CJ135CtrlS1B1_I.flgUnsetStdCur "CJ135 ASIC control Class / unset standard current" UBYTE B_TRUE 1 100 0.00 1.00000000000 BIT_MASK 0x10 FORMAT "%13.11" ECU_ADDRESS 0x500054FD /end MEASUREMENT
/begin MEASUREMENT UEGO_CJ135CtrlS1B1_I.flgUnsetStdDes "CJ135 ASIC control Class / unset standard desired" UBYTE B_TRUE 1 100 0.00 1.00000000000 BIT_MASK 0x20 FORMAT "%13.11" ECU_ADDRESS 0x500054FD /end MEASUREMENT
/begin MEASUREMENT UEGO_CJ135CtrlS1B1_I.iIsqChngHiThd "CJ135 ASIC control Class / Isq regulation higher deviation threshold" SWORD i_q6p6667Em7_A 1 100 -0.02184533 0.02184467 FORMAT "%10.8" ECU_ADDRESS 0x50005508 /end MEASUREMENT
/begin MEASUREMENT UEGO_CJ135CtrlS1B1_I.iIsqChngLoThd "CJ135 ASIC control Class / Isq regulation lower deviation threshold" SWORD i_q6p6667Em7_A 1 100 -0.02184533 0.02184467 FORMAT "%10.8" ECU_ADDRESS 0x5000550A /end MEASUREMENT
/begin MEASUREMENT UEGO_CJ135CtrlS1B1_I.iIsqDes "CJ135 ASIC control Class / desired amplitude of the reference pump current source" UBYTE i_q1p25Em4_o0p004_A 1 100 0.00400 0.01988 FORMAT "%7.5" ECU_ADDRESS 0x5000550C /end MEASUREMENT
/begin MEASUREMENT UEGO_CJ135CtrlS1B1_I.iIsqrDes "CJ135 ASIC control Class / desired amplitude of the reference pump current source" UBYTE i_q6p1Em6_o0p00036_A 1 100 0.000360 0.001135 FORMAT "%8.6" ECU_ADDRESS 0x5000550D /end MEASUREMENT
/begin MEASUREMENT UEGO_CJ135CtrlS1B1_I.numCalibCntr "CJ135 ASIC control Class / calib counter" UBYTE dez 1 100 0.00 255.0 FORMAT "%5.1" ECU_ADDRESS 0x5000550E /end MEASUREMENT
/begin MEASUREMENT UEGO_CJ135CtrlS1B1_I.numIsqCtrlCntr "CJ135 ASIC control Class / Waiting time counter to set an updated ISQ value." UBYTE dez 1 100 0.00 255.0 FORMAT "%5.1" ECU_ADDRESS 0x5000550F /end MEASUREMENT
/begin MEASUREMENT UEGO_CJ135CtrlS1B1_I.numModIsqCtrl "CJ135 ASIC control Class / Internal mode used for Isq regulation." UBYTE dez 1 100 0.00 255.0 FORMAT "%5.1" ECU_ADDRESS 0x50005510 /end MEASUREMENT
/begin MEASUREMENT UEGO_CJ135CtrlS1B1_I.numModIsqCtrlOld "CJ135 ASIC control Class / Internal mode of previous raster used for Isq regulation." UBYTE dez 1 100 0.00 255.0 FORMAT "%5.1" ECU_ADDRESS 0x50005511 /end MEASUREMENT
/begin MEASUREMENT UEGO_CJ135CtrlS1B1_I.numOptCnt "CJ135 ASIC control Class / optimal counter" UBYTE dez 1 100 0.00 255.0 FORMAT "%5.1" ECU_ADDRESS 0x50005512 /end MEASUREMENT
/begin MEASUREMENT UEGO_CJ135CtrlS1B1_I.numRegIsq "CJ135 ASIC control Class / Digital set value for CJ135 register (part) TRIMSQ to regulate Isq." UBYTE OneToOne 1 100 0.00 127.0 FORMAT "%5.1" ECU_ADDRESS 0x600362B0 /end MEASUREMENT
/begin MEASUREMENT UEGO_CJ135CtrlS1B1_I.numRegSetCntr "CJ135 ASIC control Class / register set counter" UBYTE dez 1 100 0.00 255.0 FORMAT "%5.1" ECU_ADDRESS 0x50005513 /end MEASUREMENT
/begin MEASUREMENT UEGO_CJ135CtrlS1B1_I.sm "CJ135 ASIC control Class / state machine" UBYTE UEGO_CJ135Ctl_SM_sm_VERB 1 100 0.00 13.0000000000 FORMAT "%13.10" ECU_ADDRESS 0x50005514 /end MEASUREMENT
/begin MEASUREMENT UEGO_CJ135CtrlS1B1_I.stIpPulseReq "CJ135 ASIC control Class / Current state of ip pulses" UBYTE dez 1 100 0.00 255.0 FORMAT "%5.1" ECU_ADDRESS 0x50005515 /end MEASUREMENT
/begin MEASUREMENT UEGO_CJ135CtrlS1B1_I.stNotRdyIPmpSwtOn "CJ135 ASIC control Class / Status word displaying the transition conditions from mode Normal to mode Switchon" UBYTE dez 1 100 0.00 255.0 FORMAT "%5.1" ECU_ADDRESS 0x50005516 /end MEASUREMENT
/begin MEASUREMENT UEGO_CJ135CtrlS1B1_I.stNotRdyIPmpWrmUp "CJ135 ASIC control Class / Status word displaying the transition conditions from mode Normal to mode Warmup" UBYTE dez 1 100 0.00 255.0 FORMAT "%5.1" ECU_ADDRESS 0x50005517 /end MEASUREMENT
/begin MEASUREMENT UEGO_CJ135CtrlS1B1_I.stRdyIPmpSwtOn "CJ135 ASIC control Class / Status word displaying the transition conditions from mode Switchon to mode Normal" UBYTE dez 1 100 0.00 255.0 FORMAT "%5.1" ECU_ADDRESS 0x50005518 /end MEASUREMENT
/begin MEASUREMENT UEGO_CJ135CtrlS1B1_I.stRdyIPmpWrmUp "CJ135 ASIC control Class / Status word displaying the transition conditions from mode Warmup to mode Normal" UBYTE dez 1 100 0.00 255.0 FORMAT "%5.1" ECU_ADDRESS 0x50005519 /end MEASUREMENT
/begin MEASUREMENT UEGO_CJ135CtrlS1B1_I.stRefPatStdNorm "CJ135 ASIC control Class / refpat register started normal" UWORD dez 1 100 0.00 65535.00 FORMAT "%8.2" ECU_ADDRESS 0x5000551A /end MEASUREMENT
/begin MEASUREMENT UEGO_CJ135CtrlS1B1_I.stRefPatStdWrmUp "CJ135 ASIC control Class / refpat register started warm up" UWORD dez 1 100 0.00 65535.00 FORMAT "%8.2" ECU_ADDRESS 0x5000551C /end MEASUREMENT
/begin MEASUREMENT UEGO_CJ135CtrlS1B1_I.stRefPatStopNorm "CJ135 ASIC control Class / refpat register stop normal" UWORD dez 1 100 0.00 65535.00 FORMAT "%8.2" ECU_ADDRESS 0x5000551E /end MEASUREMENT
/begin MEASUREMENT UEGO_CJ135CtrlS1B1_I.stRefPatStopWrmUp "CJ135 ASIC control Class / refpat register stop warm up" UWORD dez 1 100 0.00 65535.00 FORMAT "%8.2" ECU_ADDRESS 0x50005520 /end MEASUREMENT
/begin MEASUREMENT UEGO_CJ135CtrlS1B1_I.stRefPatStrtNorm "CJ135 ASIC control Class / refpat register started normal" UWORD dez 1 100 0.00 65535.00 FORMAT "%8.2" ECU_ADDRESS 0x50005522 /end MEASUREMENT
/begin MEASUREMENT UEGO_CJ135CtrlS1B1_I.stRefPatStrtWrmUp "CJ135 ASIC control Class / refpat register started warm up" UWORD dez 1 100 0.00 65535.00 FORMAT "%8.2" ECU_ADDRESS 0x50005524 /end MEASUREMENT
/begin MEASUREMENT UEGO_CJ135CtrlS1B1_I.stRpcEnd "CJ135 ASIC control Class / Status word displaying the transition conditions from mode Rpc to mode Normal_Std" UBYTE dez 1 100 0.00 255.0 FORMAT "%5.1" ECU_ADDRESS 0x50005526 /end MEASUREMENT
/begin MEASUREMENT UEGO_CJ135CtrlS1B1_I.stRpcStart "CJ135 ASIC control Class / Status word displaying the transition conditions from mode Normal_Std to mode Rpc" UBYTE dez 1 100 0.00 255.0 FORMAT "%5.1" ECU_ADDRESS 0x50005527 /end MEASUREMENT
/begin MEASUREMENT UEGO_CJ135CtrlS1B1_I.stRvsChrgEnd "CJ135 ASIC control Class / Status word displaying the transition conditions from mode RvsChrg to mode Normal_Std" UBYTE dez 1 100 0.00 255.0 FORMAT "%5.1" ECU_ADDRESS 0x50005528 /end MEASUREMENT
/begin MEASUREMENT UEGO_CJ135CtrlS1B1_I.stRvsChrgStart "CJ135 ASIC control Class / Status word displaying the transition conditions from mode Normal_Std to mode RvsChrg" UBYTE dez 1 100 0.00 255.0 FORMAT "%5.1" ECU_ADDRESS 0x50005529 /end MEASUREMENT
/begin MEASUREMENT UEGO_CJ135CtrlS1B1_I.stSwtOnWrmUp "CJ135 ASIC control Class / Status word displaying the transition conditions from mode Switchon to mode Warmup" UBYTE dez 1 100 0.00 255.0 FORMAT "%5.1" ECU_ADDRESS 0x5000552A /end MEASUREMENT
/begin MEASUREMENT UEGO_CJ135CtrlS1B1_I.stWrmUpSwtOn "CJ135 ASIC control Class / Status word displaying the transition conditions from mode Warmup to mode Switchon" UBYTE dez 1 100 0.00 255.0 FORMAT "%5.1" ECU_ADDRESS 0x5000552B /end MEASUREMENT
/begin MEASUREMENT UEGO_CJ135CtrlS1B1_I.CalibTR_I.timeCounter "CJ135 ASIC control Class / timer retigger / Remaining time of the timer" UBYTE t_q0p01 1 100 0.00 2.550 FORMAT "%5.3" ECU_ADDRESS 0x5000552C /end MEASUREMENT
/begin MEASUREMENT UEGO_CJ135CtrlS1B1_I.DiaNoRefpatTR_I.timeCounter "CJ135 ASIC control Class / timer retigger if diagnosis no refpat / Remaining time of the timer" UBYTE t_q0p01 1 100 0.00 2.550 FORMAT "%5.3" ECU_ADDRESS 0x5000552D /end MEASUREMENT
/begin MEASUREMENT UEGO_CJ135CtrlS1B1_I.EdgeRisingNoMemIpPulseERNM_I.oldSignal "CJ135 ASIC control Class / Switch-on recognition for request for Ip pulses / value of input signal last calculation" UBYTE B_TRUE 1 100 0.00 1.00000000000 BIT_MASK 0x1 FORMAT "%13.11" ECU_ADDRESS 0x5000552E /end MEASUREMENT
/begin MEASUREMENT UEGO_CJ135CtrlS1B1_I.EdgeRisingNoMemSendPIDERNM_I.oldSignal "CJ135 ASIC control Class / Edge rising no memory sent to PID / value of input signal last calculation" UBYTE B_TRUE 1 100 0.00 1.00000000000 BIT_MASK 0x1 FORMAT "%13.11" ECU_ADDRESS 0x5000552F /end MEASUREMENT
/begin MEASUREMENT UEGO_CJ135CtrlS1B1_I.IpPulseTR_I.timeCounter "CJ135 ASIC control Class / Timer for state-duration during ip pulsing / Remaining time of the timer" UBYTE t_q0p01 1 100 0.00 2.550 FORMAT "%5.3" ECU_ADDRESS 0x50005530 /end MEASUREMENT
/begin MEASUREMENT UEGO_CJ135CtrlS1B1_I.IpRefStrtTR_I.timeCounter "CJ135 ASIC control Class / timer retrigger for reference pump current start. / Remaining time of the timer" UWORD t_q0p01 1 100 0.00 655.3500 FORMAT "%8.4" ECU_ADDRESS 0x50005532 /end MEASUREMENT
/begin MEASUREMENT UEGO_CJ135CtrlS1B1_I.OptTR_I.timeCounter "CJ135 ASIC control Class / timer retrigger / Remaining time of the timer" UBYTE t_q0p01 1 100 0.00 2.550 FORMAT "%5.3" ECU_ADDRESS 0x50005534 /end MEASUREMENT
/begin MEASUREMENT UEGO_CJ135CtrlS1B1_I.OutOfOpTR_I.timeCounter "CJ135 ASIC control Class / timer retrigger / Remaining time of the timer" UWORD t_q0p01 1 100 0.00 655.3500 FORMAT "%8.4" ECU_ADDRESS 0x50005536 /end MEASUREMENT
/begin MEASUREMENT UEGO_CJ135CtrlS1B1_I.PIDCtlTR_I.timeCounter "CJ135 ASIC control Class / timer retrigger / Remaining time of the timer" UWORD t_q0p01 1 100 0.00 655.3500 FORMAT "%8.4" ECU_ADDRESS 0x50005538 /end MEASUREMENT
/begin MEASUREMENT UEGO_CJ135CtrlS1B1_I.RegReclcTR_I.timeCounter "CJ135 ASIC control Class / timer retrigger / Remaining time of the timer" UWORD t_q0p01 1 100 0.00 655.3500 FORMAT "%8.4" ECU_ADDRESS 0x5000553A /end MEASUREMENT
/begin MEASUREMENT UEGO_CJ135CtrlS1B1_I.SwtOnTR_I.timeCounter "CJ135 ASIC control Class / timer retrigger / Remaining time of the timer" UWORD t_q0p01 1 100 0.00 655.3500 FORMAT "%8.4" ECU_ADDRESS 0x5000553C /end MEASUREMENT
/begin MEASUREMENT UEGO_CJ135CtrlS1B1_I.TOnDelayVarNMRngReachdTONVNM_I.time "CJ135 ASIC control Class / turn on delay for PID range reached. / Delay Time" UBYTE t_q0p01 1 100 0.00 2.550 FORMAT "%5.3" ECU_ADDRESS 0x5000553E /end MEASUREMENT
/begin MEASUREMENT UEGO_CJ135CtrlS1B1_I.TOnDelayVarTCerLoTONV_I.outbit "CJ135 ASIC control Class / Turn On delay for detecting low sensor temperature / return value" UBYTE B_TRUE 1 100 0.00 1.00000000000 BIT_MASK 0x1 FORMAT "%13.11" ECU_ADDRESS 0x50005540 /end MEASUREMENT
/begin MEASUREMENT UEGO_CJ135CtrlS1B1_I.TOnDelayVarTCerLoTONV_I.time "CJ135 ASIC control Class / Turn On delay for detecting low sensor temperature / expired delay time" UWORD t_q0p01 1 100 0.00 655.3500 FORMAT "%8.4" ECU_ADDRESS 0x50005542 /end MEASUREMENT
/begin MEASUREMENT UEGO_CJ135CtrlS1B1_I.TOnDelayVarUnDwnTONV_I.outbit "CJ135 ASIC control Class / Turn On delay for Delta-Un condition (down) / return value" UBYTE B_TRUE 1 100 0.00 1.00000000000 BIT_MASK 0x1 FORMAT "%13.11" ECU_ADDRESS 0x50005544 /end MEASUREMENT
/begin MEASUREMENT UEGO_CJ135CtrlS1B1_I.TOnDelayVarUnDwnTONV_I.time "CJ135 ASIC control Class / Turn On delay for Delta-Un condition (down) / expired delay time" UWORD t_q0p01 1 100 0.00 655.3500 FORMAT "%8.4" ECU_ADDRESS 0x50005546 /end MEASUREMENT
/begin MEASUREMENT UEGO_CJ135CtrlS1B1_I.TOnDelayVarUnUpTONV_I.outbit "CJ135 ASIC control Class / Turn On delay for Delta-Un condition (up) / return value" UBYTE B_TRUE 1 100 0.00 1.00000000000 BIT_MASK 0x1 FORMAT "%13.11" ECU_ADDRESS 0x50005548 /end MEASUREMENT
/begin MEASUREMENT UEGO_CJ135CtrlS1B1_I.TOnDelayVarUnUpTONV_I.time "CJ135 ASIC control Class / Turn On delay for Delta-Un condition (up) / expired delay time" UWORD t_q0p01 1 100 0.00 655.3500 FORMAT "%8.4" ECU_ADDRESS 0x5000554A /end MEASUREMENT
/begin MEASUREMENT UEGO_flgChpSuprtdS1B1 "Indication, if mounted ASIC(Application Specific Integrated Chip) is supported by software for S1B1" UBYTE B_TRUE 1 100 0.00 1.00000000000 BIT_MASK 0x1 FORMAT "%13.11" ECU_ADDRESS 0x700000D9 /end MEASUREMENT
/begin MEASUREMENT UEGO_flgCJ135CtlReini "Flag to re-initialise this FC" UBYTE B_TRUE 1 100 0.00 1.00000000000 BIT_MASK 0x1 FORMAT "%13.11" ECU_ADDRESS 0x6000622D /end MEASUREMENT
/begin MEASUREMENT UEGO_flgCj135RevC1S1B1 "Indication, if mounted ASIC features C1 functionality for S1B1" UBYTE B_TRUE 1 100 0.00 1.00000000000 BIT_MASK 0x1 FORMAT "%13.11" ECU_ADDRESS 0x700000D8 /end MEASUREMENT
/begin MEASUREMENT UEGO_flgIPmpCtrlDsbcS1B1 "condition disturbance on pump current control sensor 1 bank 1" UBYTE B_TRUE 1 100 0.00 1.00000000000 BIT_MASK 0x1 FORMAT "%13.11" ECU_ADDRESS 0x7000060A /end MEASUREMENT
/begin MEASUREMENT UEGO_flgIPmpDiCond "Indication of deactivation for the pumping current through motor state" UBYTE B_TRUE 1 100 0.00 1.00000000000 BIT_MASK 0x1 FORMAT "%13.11" ECU_ADDRESS 0x700000D7 /end MEASUREMENT
/begin MEASUREMENT UEGO_flgIPmpDiS1B1 "Indication of deactivation for the pump current of UEGO sensor 1 Bank 1" UBYTE B_TRUE 1 100 0.00 1.00000000000 BIT_MASK 0x1 FORMAT "%13.11" ECU_ADDRESS 0x70000609 /end MEASUREMENT
/begin MEASUREMENT UEGO_flgRpcReqdS1B1 "indication for sent request to CJ135 for pump current reversion for sensor 1 bank 1" UBYTE B_TRUE 1 100 0.00 1.00000000000 BIT_MASK 0x1 FORMAT "%13.11" ECU_ADDRESS 0x700005C4 /end MEASUREMENT
/begin MEASUREMENT UEGO_flgUartPrsntS1B1 "Indication, if for mounted ASIC Uart interface is existing for S1B1" UBYTE B_TRUE 1 100 0.00 1.00000000000 BIT_MASK 0x1 FORMAT "%13.11" ECU_ADDRESS 0x700000D6 /end MEASUREMENT
/begin MEASUREMENT UEGO_iIsqRegDesS1B1 "Requested amplitude of the pump current source of UEGO sensor 1 Bank 1" SWORD i_q6p6667Em7_A 1 100 -0.02184533 0.02184467 FORMAT "%10.8" ECU_ADDRESS 0x60004EA2 /end MEASUREMENT
/begin MEASUREMENT UEGO_iIsqrRegDesS1B1 "Requested amplitude of the reference pump current source of UEGO sensor 1 Bank 1" SWORD i_q6p667Em8_A 1 100 -0.002184533 0.002184467 FORMAT "%11.9" ECU_ADDRESS 0x60004E9E /end MEASUREMENT
/begin MEASUREMENT UEGO_numIsqDesS1B1 "Register value of desired Isq sensor 1 bank 1" UBYTE dez 1 100 0.00 255.0 FORMAT "%5.1" ECU_ADDRESS 0x6000A2CB /end MEASUREMENT
/begin MEASUREMENT UEGO_numIsqrDesS1B1 "Register value of desired Isqr sensor 1 bank 1" UBYTE dez 1 100 0.00 255.0 FORMAT "%5.1" ECU_ADDRESS 0x6000A2CA /end MEASUREMENT
/begin MEASUREMENT UEGO_numModDesS1B1 "Requested mode of UEGO sensor 1 Bank 1" UBYTE dez 1 100 0.00 255.0 FORMAT "%5.1" ECU_ADDRESS 0x6000A2C7 /end MEASUREMENT
/begin MEASUREMENT UEGO_numRegSetCntrS1B1 "Counter for request rejection of HWE in register request for UEGO sensor 1 Bank 1" UBYTE dez 1 100 0.00 255.0 FORMAT "%5.1" ECU_ADDRESS 0x6000A2C4 /end MEASUREMENT
/begin MEASUREMENT UEGO_numRegUnsetOpm1S1B1 "CJ135 register set value for UNSET in case of OPM=1 for S1B1" SWORD dez 1 100 -32768.00 32767.00 FORMAT "%8.2" ECU_ADDRESS 0x70002B9E /end MEASUREMENT
/begin MEASUREMENT UEGO_numRegUnsetOpm2S1B1 "CJ135 register set value for UNSET in case of OPM=2 for S1B1" SWORD dez 1 100 -32768.00 32767.00 FORMAT "%8.2" ECU_ADDRESS 0x70002BA0 /end MEASUREMENT
/begin MEASUREMENT UEGO_numStateCrntS1B1 "Internal info about current state of state machine of S1B1" UBYTE dez 1 100 0.00 255.0 FORMAT "%5.1" ECU_ADDRESS 0x6000622C /end MEASUREMENT
/begin MEASUREMENT UEGO_numStateCtrS1B1 "Internal info about dwell time in current state of state machine of S1B1" UWORD dez 1 100 0.00 65535.00 FORMAT "%8.2" ECU_ADDRESS 0x60003472 /end MEASUREMENT
/begin MEASUREMENT UEGO_stIPmpPrmsS1B1 "Status word displaying pump current release conditions (sensor 1, bank 1)" UBYTE dez 1 100 0.00 255.0 FORMAT "%5.1" ECU_ADDRESS 0x6000622B /end MEASUREMENT
/begin MEASUREMENT UEGO_stOperPrmsS1B1 "Status word displaying operating release conditions (sensor 1, bank 1)" UBYTE dez 1 100 0.00 255.0 FORMAT "%5.1" ECU_ADDRESS 0x6000622A /end MEASUREMENT
/begin FUNCTION TWCC_PriCont "1.39.0    Primary Feedback Control of TWC - Continuous"
 /begin DEF_CHARACTERISTIC TWCC_facFltActPTPri_C TWCC_facIGnCtlPriB1_CUR TWCC_facILamLinPri_CUR TWCC_facIOSCAbsPriB1_CUR TWCC_facIOSCPriB1_CUR TWCC_facPGnCtlPriB1_CUR TWCC_facPLamLinPri_CUR TWCC_facPOSCAbsPriB1_CUR TWCC_facPOSCPriB1_CUR TWCC_facTempGslCorrnPri_T TWCC_flgCtrlrRstDSMPri_CW TWCC_flgCtrlrRstInitPri_CW TWCC_flgCtrlrRstPri_CW TWCC_flgCtrlrRstSelnInitPri_CW TWCC_flgEnaSpFilPri_C TWCC_flgUCorrnActv_C TWCC_flguSetPApplPri_CW TWCC_rDynSetPIniPri_CUR TWCC_rICtlInitPriB1_C TWCC_rILamMaxPri_C TWCC_rILamMinPri_C TWCC_rLamCtlMaxPri_C TWCC_rLamCtlMinPri_C TWCC_rPBalDLaPri_MAP TWCC_rPBalHysDLaPri_C TWCC_stPriCont_CW TWCC_tiDynSetPPri_CUR TWCC_tiFltSetPPriMap_T TWCC_tiLpActPri_CUR TWCC_tiLpTCatGslPri_T TWCC_uActHiLimGslCorrnPri_M TWCC_uActLoLimGslCorrnPri_M TWCC_uSetPApplPriB1_C TWCC_uSetPPriB1_MAP /end DEF_CHARACTERISTIC
 /begin REF_CHARACTERISTIC HEGO_flgVltgSymc_C HEGO_rS2LamLinHiRes_CUR HEGO_uS2InvLamLinHiRes_CUR /end REF_CHARACTERISTIC
 /begin IN_MEASUREMENT EGSDCmn_flgRmnProdModParl EGSDO2_ralLamOffsDeltaExchS1B1_s32 Epm_nEngLRes ExhMod_dmExhS1B1 ExhMod_dmExhS2B1 ExhMod_mO2StrExtdCat1B1 ExhMod_ratO2StrCat1B1 ExhMod_tCat1B1 HEGO_bS2B1Vld HEGO_uS2B1LamHiRes HEGO_uS2B1SymcHiRes rl_msg SyC_stSub TWCC_bEnaRichPurgB1 TWCC_bFlModlnB1 TWCC_bFlSignCtlModlnB1 TWCC_bIPriB1 TWCC_bPPriB1 TWCC_rSetPUsGlbB1 /end IN_MEASUREMENT
 /begin OUT_MEASUREMENT TWCC_bCtlLimMaxPriB1 TWCC_bCtlLimMinPriB1 TWCC_facIGnCtlPriB1 TWCC_rCtlErrPriB1 TWCC_rCtlPriB1 TWCC_rDynSetPPriB1 TWCC_rICtlHiReslPriB1 TWCC_rICtlPriB1 TWCC_rLamActPriB1 TWCC_rPCtlPriB1 TWCC_uSetPPriB1 /end OUT_MEASUREMENT
 /begin LOC_MEASUREMENT fcoscxk TWCC_BFlSignEB_I.buffer TWCC_BFlSignEB_I.oldSignal TWCC_dmExhSpFil TWCC_dtPMsO2BalPriB1 TWCC_facIOSCPriB1 TWCC_facPGnCtlPriB1 TWCC_facPOSCPriB1 TWCC_fcoscxkEB_I.buffer TWCC_fcoscxkEB_I.oldSignal TWCC_flgEnaRichPurgB1EF_I.buffer TWCC_flgEnaRichPurgB1EF_I.oldSignal TWCC_flgFCMClrReqd100PriB1 TWCC_PhSyncB1_I.rActPer TWCC_PhSyncB1_I.rPhAvrg TWCC_PhSyncB1_I.rPrevPer TWCC_PhSyncB1_I.sm TWCC_PhSyncB1_I.mExhA_I.memory TWCC_PMsO2BalPriB1IKL_I.memory TWCC_ratO2StrB1WpDisp TWCC_rCtlErrBalPriB1 TWCC_rCtlErrPriB1HMD_I.hysterese TWCC_rDynSetPIniPriB1 TWCC_rDynSetPPriB1LT_I.memory TWCC_rICtlErrFltPriB1 TWCC_rICtlErrPriB1 TWCC_rICtlIntPriB1 TWCC_rICtlPriB1_I.memory_l TWCC_rLamActFltPriB1LT_I.memory TWCC_rLamSetPMapPriB1 TWCC_rLamSetPPriB1 TWCC_rPCtlErrFltPriB1 TWCC_rPCtlErrPriB1 TWCC_rPMsO2BalPriB1 TWCC_stOpModePri TWCC_tCatLamCorrnGslPriB1LT_I.memory TWCC_tiDynSetPPriB1 TWCC_uS2B1Lam TWCC_uS2B1LamCorrnGslPri TWCC_uS2B1LamCorrnPri TWCC_uSetPPriMapB1 TWCC_uSetPPriMapB1LT_I.memory /end LOC_MEASUREMENT
 FUNCTION_VERSION "1.39.0" /end FUNCTION
/begin FUNCTION TWCC_PriEna "1.41.0    Primary Feedback Control of TWC - Enable Condition"
 /begin DEF_CHARACTERISTIC TWCC_drIDLaH2Pri_C TWCC_facIOSCRlsH2Pri_C TWCC_facOSCPri_GCUR TWCC_flgDiPGlbBalPriCatHeatgEnad_C TWCC_flgPGlbRlNmotPri_CW TWCC_mIBalFirstStrtPri_T TWCC_mIBalPPri_CUR TWCC_mIBalReStrtPri_T TWCC_mIOscRlsH2Pri_C TWCC_mPBalPri_CUR TWCC_nIMaxPri_C TWCC_nIMinPri_C TWCC_nPMaxPri_C TWCC_nPMinPri_C TWCC_rIDecLdPri_C TWCC_rIDLaH2Pri_C TWCC_rIFlCPPri_C TWCC_rIIncLdPri_C TWCC_rILdMaxPri_CUR TWCC_rILdMinPri_CUR TWCC_rPCoUsPri_C TWCC_rPLdMaxPri_CUR TWCC_rPLdMinPri_CUR TWCC_stPriEna_CW TWCC_tIEngPri_C TWCC_tiIDebFlCutPri_C TWCC_tiIDebIdlSpdPri_C TWCC_tiIDebLdGradPri_C TWCC_tiIDebNLdPri_C TWCC_tiILamGradH2Pri_C TWCC_tiILamSwtH2Pri_C TWCC_tiILckDecelPri_C TWCC_tiILpLdGradPri_C TWCC_tIMaxPri_C TWCC_tIMinPri_CUR TWCC_tIMinTstReqPri_C TWCC_tiPDebCoUsPri_C TWCC_tiPDebLam1DrctPri_C TWCC_tiPDebLam1ErrPri_C TWCC_tiPDebNLdPri_C TWCC_tiPLpCoUsPri_C TWCC_tPMaxPri_C TWCC_tPMinPri_CUR TWCC_tPMinTstReqPri_C /end DEF_CHARACTERISTIC
 /begin IN_MEASUREMENT B_dtes_msg B_eev_msg B_kh_msg B_lasostc_msg B_ll_msg B_lrseta_msg B_lrs_msg B_sa_msg B_sbblsu_msg CEngDsT_t CEngDsT_tReplMdl CoEng_nFco drlas_w_msg EngStrt_bStrtEnd Epm_nEng ExhMod_dmExhS2B1 ExhMod_flgDewPntEndS2B1 ExhMod_ratO2StrCat1B1 ExhMod_tCat1B1 HEGO_bS2B1Vld HEGO_flgS2B1EnaLamCtlColdOper InjSys_bMinPtdInjDurActv InjSys_ratFuMTot rkte_w_msg rl_w_msg SyC_stSub TWCC_rCtlErrPriB1 zlamko_msg /end IN_MEASUREMENT
 /begin OUT_MEASUREMENT TWCC_bILckErrPriB1 TWCC_bIPriB1 TWCC_bLimpPriB1 TWCC_bPLckErrPriB1 TWCC_bPPriB1 /end OUT_MEASUREMENT
 /begin LOC_MEASUREMENT TWCC_bEnaRichPriB1 TWCC_bEnaRichPriB1FF_I.status TWCC_bIBalPriB1 TWCC_bICoPriB1 TWCC_bIGlbBalPri TWCC_bIGlbCPPri TWCC_bIGlbLckErrPri TWCC_bIGlbPri TWCC_bIGLbRlNmotPri TWCC_bIH2DLaPriB1 TWCC_bIH2LckPriB1 TWCC_bISysPriB1 TWCC_bITempPriB1 TWCC_bLimpCoPriB1 TWCC_bPBalPriB1 TWCC_bPCoBalPriB1 TWCC_bPCoPriB1 TWCC_bPDynTempPriB1 TWCC_bPGlbBalPri TWCC_bPGlbLckDiaPri TWCC_bPGlbLckErrPri TWCC_bPGlbPri TWCC_bPGLbRlNmotPri TWCC_bPSysPriB1 TWCC_bPTempPriB1 TWCC_bReStrtEndEF_I.buffer TWCC_bReStrtEndEF_I.oldSignal TWCC_facOSCPriB1 TWCC_facOSCPriGCURWpDisp TWCC_flgEnaIGpfRgnNotActv TWCC_flgEnaPGpfRgnNotActv TWCC_flgLstStrtB1FF_I.status TWCC_IBalPriB1IK_I.memory TWCC_IDecelWoFlCutPriEF_I.buffer TWCC_IDecelWoFlCutPriEF_I.oldSignal TWCC_IDecelWoFlCutPriFF_I.status TWCC_IDecelWoFlCutPriTRE_I.inOld TWCC_IDecelWoFlCutPriTRE_I.timeCounter TWCC_IDLaH2PriB1LT_I.memory TWCC_IFlCutTONV_I.outbit TWCC_IFlCutTONV_I.time TWCC_IIdlSpdTONV_I.outbit TWCC_IIdlSpdTONV_I.time TWCC_ILamSwtH2PriB1EF_I.buffer TWCC_ILamSwtH2PriB1EF_I.oldSignal TWCC_ILamSwtH2PriB1T_I.timeCounter TWCC_ILdGradPriLT_I.memory TWCC_ILdGradPriTOFFV_I.outbit TWCC_ILdGradPriTOFFV_I.time TWCC_INLdPriTOFFV_I.outbit TWCC_INLdPriTOFFV_I.time TWCC_IOSCRlsH2PriB1IK_I.memory TWCC_mIBalPThresPriB1 TWCC_mIBalThresPriB1 TWCC_mPBalThresPriB1 TWCC_PBalPriB1IK_I.memory TWCC_PCoUsPriB1HDR_I.hysterese TWCC_PCoUsPriB1LT_I.memory TWCC_PCoUsPriB1TOFFV_I.outbit TWCC_PCoUsPriB1TOFFV_I.time TWCC_PLam1DrctPriB1TOFFV_I.outbit TWCC_PLam1DrctPriB1TOFFV_I.time TWCC_PLam1ErrPriB1TOFFV_I.outbit TWCC_PLam1ErrPriB1TOFFV_I.time TWCC_PLam1PriB1ER_I.buffer TWCC_PLam1PriB1ER_I.oldSignal TWCC_PNLdPriTOFFV_I.outbit TWCC_PNLdPriTOFFV_I.time TWCC_rIFlCPPri TWCC_tIMinPriB1 TWCC_tPMinPriB1 /end LOC_MEASUREMENT
 FUNCTION_VERSION "1.41.0" /end FUNCTION
/begin FUNCTION TWCC_TstCom "1.10.0    TWC Tester Communication Interface" /begin OUT_MEASUREMENT TWCC_PIDPriB1 /end OUT_MEASUREMENT FUNCTION_VERSION "1.10.0" /end FUNCTION
/begin FUNCTION TWCD_CatMeas "1.29.0    Catalyst Diagnosis by Determination of Storage Capacity"
 /begin DEF_CHARACTERISTIC TWCD_facCorrDlyB1_M TWCD_facCorrTranB1_M TWCD_facMLeanIR_C TWCD_facMRichIR_C TWCD_facOSCRSC_C TWCD_flgOSCCorActv_CW TWCD_flgRSCCorActv_CW TWCD_mOscIni_C TWCD_NewOscPriB1_I.OSCNrm_MAP TWCD_NewOscPriB1_I.mOSCNrmShtrp_T TWCD_NrmOSCPriB1_I.OSCNrm_MAP TWCD_NrmOSCPriB1_I.mOSCNrmShtrp_T TWCD_tiCorLtrHEGO_M TWCD_tiCorRtlHEGO_M TWCD_uLeanFinThres_C TWCD_uRichFinThres_C /end DEF_CHARACTERISTIC
 /begin REF_CHARACTERISTIC EGSDCmn_flgSymTranOnly_CW TWCD_flgCatDiagActvCat1B1_C /end REF_CHARACTERISTIC
 /begin IN_MEASUREMENT Eep_EnvRamInvld EGSDCmn_flgShtrpParl EGSDCmn_stLamGenrParlB1 EGSDCmn_stVirtCatParlB1 EGSDCmn_uS2B1FildParl EGSDO2_tiDlyAdpnS1B1 EGSDO2_tiTranAdpnS1B1 EGSDU_tiS2B1LtrNrmDly EGSDU_tiS2B1LtrTran EGSDU_tiS2B1RtlNrmDly EGSDU_tiS2B1RtlTran ExhMod_dmExhCat1B1 ExhMod_dmExhWoFuUsCat1B1 ExhMod_idxFirstBrickCat1B1 ExhMod_mfO2Cat1B1 ExhMod_nrBrickCat1B1 ExhMod_tExhAryB1 ExhMod_tiBtwLS1Cat1B1 LamCtrl_ratLamSpS1B1 lamsons_w_msg SyC_stSub UEGO_ratLamSymS1B1 /end IN_MEASUREMENT
 /begin OUT_MEASUREMENT TWCD_flgFCMClrReqdCatMeasCat1B1 TWCD_flgMeasFinB1 TWCD_flgMeasFinVirtB1 TWCD_flgPtlMeasOSCFinB1 TWCD_flgPtlMeasRSCFinB1 TWCD_mOscExtdCat1B1 TWCD_mOSCNrmDiumprExtdB1 TWCD_mOSCNrmExtdB1 TWCD_mOscPtlCorrdCat1B1 TWCD_mOscPtlCorrdExtdCat1B1 TWCD_mRSCNrmDiumprExtdB1 TWCD_mRscPtlCorrdCat1B1 TWCD_mRscPtlCorrdExtdCat1B1 TWCD_rOSCPriB1 /end OUT_MEASUREMENT
 /begin LOC_MEASUREMENT TWCD_CatMeasSMB1_I.arg_Syc_stSub TWCD_CatMeasSMB1_I.arg_flgOSCMeasmtStart TWCD_CatMeasSMB1_I.arg_mOSCNrm TWCD_CatMeasSMB1_I.arg_mOscNew TWCD_CatMeasSMB1_I.arg_mRSCNrm TWCD_CatMeasSMB1_I.arg_mfO2Cat TWCD_CatMeasSMB1_I.arg_mfO2LsuDynCorrd TWCD_CatMeasSMB1_I.arg_stLamGenrParl TWCD_CatMeasSMB1_I.arg_stVirtCatParl TWCD_CatMeasSMB1_I.arg_tiLtrNrmDly TWCD_CatMeasSMB1_I.arg_tiLtrTran TWCD_CatMeasSMB1_I.arg_tiRtlNrmDly TWCD_CatMeasSMB1_I.arg_tiRtlTran TWCD_CatMeasSMB1_I.arg_uDs TWCD_CatMeasSMB1_I.arg_uLeanFinThres TWCD_CatMeasSMB1_I.arg_uRichFinThres TWCD_CatMeasSMB1_I.dmOscCorr TWCD_CatMeasSMB1_I.flgMeasFin TWCD_CatMeasSMB1_I.flgMeasmtFinshd200ms TWCD_CatMeasSMB1_I.flgMeasmtFinshdVirt TWCD_CatMeasSMB1_I.flgMeasmtFinshdVirt200ms TWCD_CatMeasSMB1_I.flgPtlMeasOSCFin TWCD_CatMeasSMB1_I.flgPtlMeasRSCFin TWCD_CatMeasSMB1_I.flgPtlMeasRSCFinTmp TWCD_CatMeasSMB1_I.mOSC TWCD_CatMeasSMB1_I.mOSCraw TWCD_CatMeasSMB1_I.mOscLsuDynCorrd TWCD_CatMeasSMB1_I.mOscNv TWCD_CatMeasSMB1_I.mOscRawLsuDynCorrd TWCD_CatMeasSMB1_I.mOscRawTmp TWCD_CatMeasSMB1_I.mRoscLsuDynCorrd TWCD_CatMeasSMB1_I.mRoscRawLsuDynCorrd TWCD_CatMeasSMB1_I.ratOsc TWCD_CatMeasSMB1_I.sm TWCD_CatMeasSMB1_I.tiCorLeanRich TWCD_CatMeasSMB1_I.tiCorRichLean TWCD_CatMeasSMB1_I.DynCorrnOscLsuDyn_I.dmO2Corrn TWCD_CatMeasSMB1_I.DynCorrnOscLsuDyn_I.dmO2Grdt TWCD_CatMeasSMB1_I.DynCorrnOscLsuDyn_I.mO2CorSlp TWCD_CatMeasSMB1_I.DynCorrnOscLsuDyn_I.mO2Corrd TWCD_CatMeasSMB1_I.DynCorrnOscLsuDyn_I.tiCorSlp TWCD_CatMeasSMB1_I.DynCorrnOsc_I.dmO2Corrn TWCD_CatMeasSMB1_I.DynCorrnOsc_I.dmO2Grdt TWCD_CatMeasSMB1_I.DynCorrnOsc_I.mO2CorSlp TWCD_CatMeasSMB1_I.DynCorrnOsc_I.mO2Corrd TWCD_CatMeasSMB1_I.DynCorrnOsc_I.tiCorSlp TWCD_CatMeasSMB1_I.DynCorrnRosc_I.dmO2Corrn TWCD_CatMeasSMB1_I.DynCorrnRosc_I.dmO2Grdt TWCD_CatMeasSMB1_I.DynCorrnRosc_I.mO2CorSlp TWCD_CatMeasSMB1_I.DynCorrnRosc_I.mO2Corrd TWCD_CatMeasSMB1_I.DynCorrnRosc_I.tiCorSlp TWCD_CatMeasSMB1_I.O2LsuDynCorrdIKL_I.memory TWCD_CatMeasSMB1_I.O2MsIKL_I.memory TWCD_CatMeasSMB1_I.flgMeasmtFinshdFF_I.status TWCD_CatMeasSMB1_I.flgMeasmtFinshdVirtFF_I.status TWCD_CatMeasSMB1_I.flgVirtMeasmtER_I.buffer TWCD_CatMeasSMB1_I.flgVirtMeasmtER_I.oldSignal TWCD_dmGasB1 TWCD_mfO2LSUDynB1 TWCD_mOscNewCat1B1 TWCD_mRSCNrmExtdB1 TWCD_NewOscPriB1_I.ctBrick TWCD_NewOscPriB1_I.dmGas TWCD_NewOscPriB1_I.mOsc TWCD_NewOscPriB1_I.tBrick TWCD_NrmOSCPriB1_I.ctBrick TWCD_NrmOSCPriB1_I.dmGas TWCD_NrmOSCPriB1_I.mOsc TWCD_NrmOSCPriB1_I.tBrick TWCD_ratLamLSUDynB1 TWCD_ratLamLsuDynCorrdCat1B1 /end LOC_MEASUREMENT
 FUNCTION_VERSION "1.29.0" /end FUNCTION
/begin FUNCTION TWCD_DSMCfg "4.31.0    DSM configuration for catalyst monitoring" FUNCTION_VERSION "4.31.0" /end FUNCTION
/begin FUNCTION TWCD_Eval "3.20.0    Evaluation of catalyst diagnosis measurements"
 /begin DEF_CHARACTERISTIC TWCD_flgArthFltPassTstActvd_CW TWCD_flgCatDiagActvCat1B1_C TWCD_flgEwma_CW TWCD_flgOSCMaxRng_CW TWCD_FltDsEval_B1.rOfsRmnProdModParl_C TWCD_NrMeasStepChg_C TWCD_numMeasShtrp_C TWCD_numMeas_C TWCD_ratStepChgCnf_C TWCD_ratStepChgSus_C TWCD_rOSCMaxRng_C TWCD_rOSCThresB1_C TWCD_rOSCThresBPUB1_C TWCD_swtEolTstRls_C TWCD_valEwmaIni_C TWCD_valEwma_C /end DEF_CHARACTERISTIC
 /begin IN_MEASUREMENT Eep_EnvRamInvld EGSDCmn_flgEnvtlDiPID41Parl EGSDCmn_flgProdModParl EGSDCmn_flgRmnProdModParl EGSDCmn_flgShtrpParl SyC_ctPostDrvLeave SyC_stSub TWCD_flgMeasFinB1 TWCD_flgMeasFinVirtB1 TWCD_rOSCPriB1 /end IN_MEASUREMENT
 /begin OUT_MEASUREMENT TWCD_flgErrSusB1 TWCD_flgFCMClrReqdEvalCat1B1 TWCD_flgMeasFinshdTripB1 TWCD_flgMeasFinshdVirtTripB1 TWCD_flgOSCQPFaildPriB1 TWCD_flgOSCStepChgPriB1 TWCD_flgResOSCPriB1 TWCD_flgResVirtOSCPriB1 TWCD_numMeasB1 TWCD_rDiagRsltB1 TWCD_rOSCAvrgPriB1 /end OUT_MEASUREMENT
 /begin LOC_MEASUREMENT TWCD_ctReIniEval TWCD_DsmIfCat1B1_I.flgErr TWCD_DsmIfCat1B1_I.flgErrSus TWCD_DsmIfCat1B1_I.flgHeal TWCD_DsmIfCat1B1_I.flgVldnFin TWCD_DsmIfCat1B1_I.rDiagRslt TWCD_DsmIfCat1B1_I.RsltER_I.buffer TWCD_DsmIfCat1B1_I.RsltER_I.oldSignal TWCD_DsmIfCat1B1_I.flgErrSusERNM_I.oldSignal TWCD_flgEvalDsmTripChgFinshd TWCD_FltDsEval_B1.flgMeasFinshdTrip TWCD_FltDsEval_B1.flgNumTemp TWCD_FltDsEval_B1.flgOSCQPFaild TWCD_FltDsEval_B1.flgOSCStepChgPri TWCD_FltDsEval_B1.flgQPFaild TWCD_FltDsEval_B1.flgQckPassd TWCD_FltDsEval_B1.flgResOSCPri TWCD_FltDsEval_B1.flgResVirtOSCPri TWCD_FltDsEval_B1.flgStepChg TWCD_FltDsEval_B1.flgVirtMeasFinshdTrip TWCD_FltDsEval_B1.numMeas TWCD_FltDsEval_B1.numMeasShrtp TWCD_FltDsEval_B1.numMeasTrip TWCD_FltDsEval_B1.numVirtMeas TWCD_FltDsEval_B1.numVirtMeasTrip TWCD_FltDsEval_B1.rOSCAvrgPri TWCD_FltDsEval_B1.val TWCD_FltDsEval_B1.valArth TWCD_FltDsEval_B1.valEwma TWCD_FltDsEval_B1.valQuickPass TWCD_FltDsEval_B1.valArthDL_I.memory TWCD_FltDsEval_B1.valArthShrtpDL_I.memory TWCD_FltDsEval_B1.valEwmaDL_I.memory /end LOC_MEASUREMENT
 FUNCTION_VERSION "3.20.0" /end FUNCTION
/begin FUNCTION UEGO_Chp "2.0.0     UEGO Chip Identification" /begin DEF_CHARACTERISTIC UEGO_idxHWES1B1_C /end DEF_CHARACTERISTIC FUNCTION_VERSION "2.0.0" /end FUNCTION
/begin FUNCTION UEGO_CJ135Ctl "2.20.0    UEGO CJ135 operation control"
 /begin DEF_CHARACTERISTIC UEGO_iIsqChgPrimStep_C UEGO_iIsqChgSecStep_C UEGO_iIsqRef_C UEGO_numIsqChg_C UEGO_numRefPlsStd_C UEGO_numRefPlsStop_C UEGO_numRefPlsStrt_C UEGO_numRegDspDiagDis_C UEGO_numRegEnSP_C UEGO_numRegFu0hys_C UEGO_numRegFusks_C UEGO_numRegIpblackRat_C UEGO_numRegIpoffRatIpPulse_C UEGO_numRegIpoffRat_C UEGO_numRegIpsetRat_C UEGO_numRegIpsm_C UEGO_numRegIsqDiag_C UEGO_numRegIsqrDiaNorm1_C UEGO_numRegIsqrDiaSwton_C UEGO_numRegIsqrDiaWrmup_C UEGO_numRegIsqStrt_C UEGO_numRegMkStd_C UEGO_numRegMkStrt_C UEGO_numRegPattern_C UEGO_numRegRefpatDiaNorm1_C UEGO_numRegRefpatDiaWrmup_C UEGO_numRegUp0lean_C UEGO_numRegUp0rich_C UEGO_numRegUriaSwtOn_C UEGO_numRegUria_C UEGO_numUnCtlStdD_C UEGO_numUnCtlStdI_C UEGO_numUnCtlStdP_C UEGO_numUnCtlStdRF_C UEGO_numUnCtlStrtD_C UEGO_numUnCtlStrtI_C UEGO_numUnCtlStrtP_C UEGO_numUnCtlStrtRF_C UEGO_resRieMaxMKOff_C UEGO_stCJ135PIDCtrl_C UEGO_swtSendPID_C UEGO_swtStrtIpPulse_C UEGO_tiCalib_C UEGO_tiDiagNoRefpatNorm1_C UEGO_tiDlyCtlOutOfOp_C UEGO_tiDlyDeltaUn_C UEGO_tiDlyPIDCtl_C UEGO_tiDlyPIDRngReachd_C UEGO_tiDlySwtOn_C UEGO_tiDlyTMinIpEnaDwn_C UEGO_tiIpPulse_C UEGO_tiIpRefStrt_C UEGO_tiOptLon_C UEGO_tiOptShrt_C UEGO_tiRegReclc_C UEGO_tMinIpEnaDwn_C UEGO_tMinIpEnaUpLoPrcsn_C UEGO_tMinIpEnaUp_C UEGO_tPIDSwtUp_C UEGO_tSwtOnWrmUp_C UEGO_tUnSwtDwn_C UEGO_tUnSwtUp_C UEGO_uDeltaUn_C UEGO_uFkal1Ref_C UEGO_uLnEnaDown_C UEGO_uLnEnaUp_C UEGO_uLpEnaDown_C UEGO_uLpEnaUp_C UEGO_CJ135CtrlS1B1_I.stNotRdyIPmpSwtOnMask_C UEGO_CJ135CtrlS1B1_I.stNotRdyIPmpWrmUpMask_C UEGO_CJ135CtrlS1B1_I.stRdyIPmpSwtOnMask_C UEGO_CJ135CtrlS1B1_I.stRdyIPmpWrmUpMask_C UEGO_CJ135CtrlS1B1_I.stRvsChrgEndMask_C UEGO_CJ135CtrlS1B1_I.stRvsChrgStartMask_C UEGO_CJ135CtrlS1B1_I.stSwtOnWrmUpMask_C UEGO_CJ135CtrlS1B1_I.stWrmUpSwtOnMask_C UEGO_numRegIsqr_C UEGO_numRegIsqStd_C UEGO_numRegUnsetStd_C UEGO_numRegUnsetStrt_C UEGO_stCJ135CtlS1B1_C UEGO_stCJ135Ctl_C UEGO_stIPmpPrmsMaskS1B1_C UEGO_stIsqCtrl_C UEGO_stOperPrmsMaskS1B1_C UEGO_tiDlyIpmpDiAftEngStopS1B1_C /end DEF_CHARACTERISTIC
 /begin REF_CHARACTERISTIC UEGO_numRegIpoffCMeas_C UEGO_numRegIpoffUi23Ui24Meas_C UEGO_numRegIpsmRvsChrg_C UEGO_numRegIsqCMeas_C UEGO_numRegPatCMeas_C UEGO_numRegPatUiMeas_C UEGO_idxHWES1B1_C /end REF_CHARACTERISTIC
 /begin IN_MEASUREMENT Eep_EnvRamInvld SyC_ctPostDrvLeave UEGO_CJ135CalcElecCorrnS1B1.flgFKal1Strtd UEGO_CJ135CalcElecCorrnS1B1.flgFKal2Strtd UEGO_CJ135CalcElecCorrnS1B1.flgFKal3Strtd UEGO_CJ135CalcElecCorrnS1B1.flgnCmnMod1Strtd UEGO_CJ135CalcElecCorrnS1B1.flgnCmnMod2Strtd UEGO_CJ135CalcElecCorrnS1B1.flgnumUref22Strtd UEGO_CJ135CalcElecCorrnS1B1.numUref1Corrd UEGO_CJ135CalcElecCorrnS1B1.numUref21Corrd UEGO_CJ135CalcElecCorrnS1B1.numUref22Corrd UEGO_CJ135CalcElecCorrnS1B1.numUref3Corrd UEGO_CJ135CalcElecCorrnS1B1.uCmnMod1 UEGO_CJ135CalcElecCorrnS1B1.uCmnMod2 UEGO_CJ135CalcElecCorrnS1B1.uVCC1Corrd UEGO_CJ135CalcElecCorrnS1B1.uVCC3MeasRef UEGO_CJ135CalcElecCorrnS1B1.uFkal1Flt_DL_I.memory UEGO_CJ135CalcElecCorrnS1B1.uFkal2Flt_DL_I.memory UEGO_CJ135CalcElecCorrnS1B1.uFkal3Flt_DL_I.memory UEGO_flgCmbEngTmpStop UEGO_flgCMeasS1B1 UEGO_flgDiagRprtRelsS1B1 UEGO_flgDsmTripChgFinshd UEGO_flgHeatrCtrlErrS1B1 UEGO_flgIsqrVldS1B1 UEGO_flgOperRelsS1B1 UEGO_flgTCerHiPrcsnS1B1 UEGO_flgTCerVldS1B1 UEGO_flgTrmSqVldS1B1 UEGO_flgUiAllMeasS1B1 UEGO_flgUnBaseCorrnPrsntS1B1 UEGO_idxTypS1B1 UEGO_iIsqMeasS1B1 UEGO_numModCtrlS1B1 UEGO_numModCurrS1B1 UEGO_numTrmSqS1B1 UEGO_numUoffvcc1S1B1 UEGO_numUoffvcc2S1B1 UEGO_numUoffvcc3S1B1 UEGO_rRieRawS1B1 UEGO_stIPmpTM2RS1B1 UEGO_tCerS1B1 UEGO_uDeltaUnS1B1 UEGO_uUMeasMaxLNS1B1 UEGO_uUMeasMaxLPS1B1 /end IN_MEASUREMENT
 /begin OUT_MEASUREMENT UEGO_flgIPmpCtrlDsbcS1B1 UEGO_flgIPmpDiS1B1 UEGO_flgRpcReqdS1B1 UEGO_iIsqRegDesS1B1 UEGO_iIsqrRegDesS1B1 UEGO_numIsqDesS1B1 UEGO_numIsqrDesS1B1 UEGO_numModDesS1B1 UEGO_numRegSetCntrS1B1 /end OUT_MEASUREMENT
 /begin LOC_MEASUREMENT flgCmbEngStopS1B1TONVNM_I.time UEGO_CJ135Ctl_cntrReini UEGO_CJ135CtrlS1B1_I.A1UN UEGO_CJ135CtrlS1B1_I.CJ135ModDes UEGO_CJ135CtrlS1B1_I.KD UEGO_CJ135CtrlS1B1_I.KI UEGO_CJ135CtrlS1B1_I.KP UEGO_CJ135CtrlS1B1_I.KRF UEGO_CJ135CtrlS1B1_I.UNB0 UEGO_CJ135CtrlS1B1_I.UNB1 UEGO_CJ135CtrlS1B1_I.UNB2 UEGO_CJ135CtrlS1B1_I.UNBChkSum UEGO_CJ135CtrlS1B1_I.flgBlcknProtnActvd UEGO_CJ135CtrlS1B1_I.flgNernstCellPenActv UEGO_CJ135CtrlS1B1_I.flgNernstCellPenPsbl UEGO_CJ135CtrlS1B1_I.flgNormalStdDes UEGO_CJ135CtrlS1B1_I.flgOptNotStaticOld UEGO_CJ135CtrlS1B1_I.flgPIDCtlActvd UEGO_CJ135CtrlS1B1_I.flgPIDCtlStdCur UEGO_CJ135CtrlS1B1_I.flgPIDCtlStdDes UEGO_CJ135CtrlS1B1_I.flgPIDRngReachd UEGO_CJ135CtrlS1B1_I.flgParmsChgUnNeeded UEGO_CJ135CtrlS1B1_I.flgParmsChgUpNeeded UEGO_CJ135CtrlS1B1_I.flgRefPmpStd UEGO_CJ135CtrlS1B1_I.flgRefPmpStop UEGO_CJ135CtrlS1B1_I.flgRefPmpStrt UEGO_CJ135CtrlS1B1_I.flgRegLnCur UEGO_CJ135CtrlS1B1_I.flgRegLnDes UEGO_CJ135CtrlS1B1_I.flgRegLpCur UEGO_CJ135CtrlS1B1_I.flgRegLpDes UEGO_CJ135CtrlS1B1_I.flgRpcDes UEGO_CJ135CtrlS1B1_I.flgRvsChrgCMeas UEGO_CJ135CtrlS1B1_I.flgSetRegOk UEGO_CJ135CtrlS1B1_I.flgSetTrimSqOk UEGO_CJ135CtrlS1B1_I.flgSnsrHot UEGO_CJ135CtrlS1B1_I.flgSwtOnFin UEGO_CJ135CtrlS1B1_I.flgTCerLo UEGO_CJ135CtrlS1B1_I.flgUnsetStdCur UEGO_CJ135CtrlS1B1_I.flgUnsetStdDes UEGO_CJ135CtrlS1B1_I.iIsqChngHiThd UEGO_CJ135CtrlS1B1_I.iIsqChngLoThd UEGO_CJ135CtrlS1B1_I.iIsqDes UEGO_CJ135CtrlS1B1_I.iIsqrDes UEGO_CJ135CtrlS1B1_I.numCalibCntr UEGO_CJ135CtrlS1B1_I.numIsqCtrlCntr UEGO_CJ135CtrlS1B1_I.numModIsqCtrl UEGO_CJ135CtrlS1B1_I.numModIsqCtrlOld UEGO_CJ135CtrlS1B1_I.numOptCnt UEGO_CJ135CtrlS1B1_I.numRegIsq UEGO_CJ135CtrlS1B1_I.numRegSetCntr UEGO_CJ135CtrlS1B1_I.sm UEGO_CJ135CtrlS1B1_I.stIpPulseReq UEGO_CJ135CtrlS1B1_I.stNotRdyIPmpSwtOn UEGO_CJ135CtrlS1B1_I.stNotRdyIPmpWrmUp UEGO_CJ135CtrlS1B1_I.stRdyIPmpSwtOn UEGO_CJ135CtrlS1B1_I.stRdyIPmpWrmUp UEGO_CJ135CtrlS1B1_I.stRefPatStdNorm UEGO_CJ135CtrlS1B1_I.stRefPatStdWrmUp UEGO_CJ135CtrlS1B1_I.stRefPatStopNorm UEGO_CJ135CtrlS1B1_I.stRefPatStopWrmUp UEGO_CJ135CtrlS1B1_I.stRefPatStrtNorm UEGO_CJ135CtrlS1B1_I.stRefPatStrtWrmUp UEGO_CJ135CtrlS1B1_I.stRpcEnd UEGO_CJ135CtrlS1B1_I.stRpcStart UEGO_CJ135CtrlS1B1_I.stRvsChrgEnd UEGO_CJ135CtrlS1B1_I.stRvsChrgStart UEGO_CJ135CtrlS1B1_I.stSwtOnWrmUp UEGO_CJ135CtrlS1B1_I.stWrmUpSwtOn UEGO_CJ135CtrlS1B1_I.CalibTR_I.timeCounter UEGO_CJ135CtrlS1B1_I.DiaNoRefpatTR_I.timeCounter UEGO_CJ135CtrlS1B1_I.EdgeRisingNoMemIpPulseERNM_I.oldSignal UEGO_CJ135CtrlS1B1_I.EdgeRisingNoMemSendPIDERNM_I.oldSignal UEGO_CJ135CtrlS1B1_I.IpPulseTR_I.timeCounter UEGO_CJ135CtrlS1B1_I.IpRefStrtTR_I.timeCounter UEGO_CJ135CtrlS1B1_I.OptTR_I.timeCounter UEGO_CJ135CtrlS1B1_I.OutOfOpTR_I.timeCounter UEGO_CJ135CtrlS1B1_I.PIDCtlTR_I.timeCounter UEGO_CJ135CtrlS1B1_I.RegReclcTR_I.timeCounter UEGO_CJ135CtrlS1B1_I.SwtOnTR_I.timeCounter UEGO_CJ135CtrlS1B1_I.TOnDelayVarNMRngReachdTONVNM_I.time UEGO_CJ135CtrlS1B1_I.TOnDelayVarTCerLoTONV_I.outbit UEGO_CJ135CtrlS1B1_I.TOnDelayVarTCerLoTONV_I.time UEGO_CJ135CtrlS1B1_I.TOnDelayVarUnDwnTONV_I.outbit UEGO_CJ135CtrlS1B1_I.TOnDelayVarUnDwnTONV_I.time UEGO_CJ135CtrlS1B1_I.TOnDelayVarUnUpTONV_I.outbit UEGO_CJ135CtrlS1B1_I.TOnDelayVarUnUpTONV_I.time UEGO_flgChpSuprtdS1B1 UEGO_flgCJ135CtlReini UEGO_flgCj135RevC1S1B1 UEGO_flgIPmpDiCond UEGO_flgUartPrsntS1B1 UEGO_numRegUnsetOpm1S1B1 UEGO_numRegUnsetOpm2S1B1 UEGO_numStateCrntS1B1 UEGO_numStateCtrS1B1 UEGO_stIPmpPrmsS1B1 UEGO_stOperPrmsS1B1 /end LOC_MEASUREMENT
 FUNCTION_VERSION "2.20.0" /end FUNCTION
/begin COMPU_METHOD B_TRUE "" TAB_VERB "%6.3" "" COMPU_TAB_REF B_TRUE /end COMPU_METHOD
/begin COMPU_VTAB B_TRUE "" TAB_VERB 2 0 "FALSE" 1 "TRUE" /end COMPU_VTAB
/begin COMPU_METHOD dez "" RAT_FUNC "%6.2" "" COEFFS 0 1 0 0 0 1 /end COMPU_METHOD
/begin COMPU_METHOD EngN "" RAT_FUNC "%6.3" "rpm" COEFFS 0 2 0 0 0 1 /end COMPU_METHOD
/begin COMPU_METHOD ExeCon_State_02 "" TAB_VERB "%6.3" "" COMPU_TAB_REF ExeCon_State_02 /end COMPU_METHOD
/begin COMPU_VTAB ExeCon_State_02 "" TAB_VERB 7 0 "SYC_INI" 1 "SYC_INISYN" 2 "SYC_INIEND" 3 "SYC_PREDRIVE" 4 "SYC_DRIVE" 5 "SYC_POSTDRIVE" 6 "SYC_POST_OS_EXIT" /end COMPU_VTAB
/begin COMPU_METHOD fak_q0p00015259 "" RAT_FUNC "%6.5" "" COEFFS 0 32768 0 0 0 5 /end COMPU_METHOD
/begin COMPU_METHOD fak_q0p0078 "" RAT_FUNC "%6.4" "-" COEFFS 0 128 0 0 0 1 /end COMPU_METHOD
/begin COMPU_METHOD fak_q1p201Em4 "" RAT_FUNC "%6.5" "-" COEFFS 0 8325 0 0 0 1 /end COMPU_METHOD
/begin COMPU_METHOD fak_q3p0518Em5 "" RAT_FUNC "%7.6" "" COEFFS 0 32768 0 0 0 1 /end COMPU_METHOD
/begin COMPU_METHOD fak_q3p0518Em6 "" RAT_FUNC "%8.7" "" COEFFS 0 65536 0 0 0 0.2 /end COMPU_METHOD
/begin COMPU_METHOD fak_q3p72529Em9 "" RAT_FUNC "%11.10" "" COEFFS 0 268435456 0 0 0 1 /end COMPU_METHOD
/begin COMPU_METHOD fak_q4p6566Em10 "" RAT_FUNC "%18.17" "" COEFFS 0 2147483648 0 0 0 1 /end COMPU_METHOD
/begin COMPU_METHOD fak_q4p6566Em11 "" RAT_FUNC "%13.12" "-" COEFFS 0 214748364.8 0 0 0 0.01 /end COMPU_METHOD
/begin COMPU_METHOD fak_sl_b1 "" RAT_FUNC "%12.11" "-" COEFFS 0 4294967296 0 0 0 2 /end COMPU_METHOD
/begin COMPU_METHOD fak_sw_b1 "" RAT_FUNC "%7.6" "-" COEFFS 0 65536 0 0 0 2 /end COMPU_METHOD
/begin COMPU_METHOD fak_ub_b1 "" RAT_FUNC "%6.4" "-" COEFFS 0 256 0 0 0 1 /end COMPU_METHOD
/begin COMPU_METHOD fak_ub_b16 "" RAT_FUNC "%6.4" "-" COEFFS 0 256 0 0 0 16 /end COMPU_METHOD
/begin COMPU_METHOD fak_ub_b2 "" RAT_FUNC "%8.5" "-" COEFFS 0 256 0 0 0 2 /end COMPU_METHOD
/begin COMPU_METHOD fak_ub_b4 "" RAT_FUNC "%6.4" "-" COEFFS 0 256 0 0 0 4 /end COMPU_METHOD
/begin COMPU_METHOD fak_uw_b1 "" RAT_FUNC "%7.6" "-" COEFFS 0 65536 0 0 0 1 /end COMPU_METHOD
/begin COMPU_METHOD fak_uw_b16 "" RAT_FUNC "%6.5" "-" COEFFS 0 65536 0 0 0 16 /end COMPU_METHOD
/begin COMPU_METHOD fak_uw_b2 "" RAT_FUNC "%7.6" "-" COEFFS 0 65536 0 0 0 2 /end COMPU_METHOD
/begin COMPU_METHOD fak_uw_b512 "" RAT_FUNC "%6.4" "-" COEFFS 0 65536 0 0 0 512 /end COMPU_METHOD
/begin COMPU_METHOD i_q1p25Em4_o0p004_A "" RAT_FUNC "%6.5" "A" COEFFS 0 1000000 -4000 0 0 125 /end COMPU_METHOD
/begin COMPU_METHOD i_q6p1Em6_o0p00036_A "" RAT_FUNC "%7.6" "A" COEFFS 0 10000000 -3600 0 0 61 /end COMPU_METHOD
/begin COMPU_METHOD i_q6p6667Em7_A "" RAT_FUNC "%9.8" "A" COEFFS 0 1500000 0 0 0 1 /end COMPU_METHOD
/begin COMPU_METHOD i_q6p667Em8_A "" RAT_FUNC "%10.9" "A" COEFFS 0 15000000 0 0 0 1 /end COMPU_METHOD
/begin COMPU_METHOD mgrad_q1_mgdivs "" RAT_FUNC "%6.2" "mg/s" COEFFS 0 1 0 0 0 1 /end COMPU_METHOD
/begin COMPU_METHOD m_q0p017778_g "" RAT_FUNC "%6.4" "g" COEFFS 0 225 0 0 0 4 /end COMPU_METHOD
/begin COMPU_METHOD m_q0p02_mgO2 "" RAT_FUNC "%6.4" "mgO2" COEFFS 0 50 0 0 0 1 /end COMPU_METHOD
/begin COMPU_METHOD m_q0p1 "" RAT_FUNC "%6.3" "kg/h" COEFFS 0 10 0 0 0 1 /end COMPU_METHOD
/begin COMPU_METHOD m_q0p1_mg "" RAT_FUNC "%6.3" "mg" COEFFS 0 1 0 0 0 0.1 /end COMPU_METHOD
/begin COMPU_METHOD m_q0p1_mgs "" RAT_FUNC "%6.3" "mg/s" COEFFS 0 1 0 0 0 0.1 /end COMPU_METHOD
/begin COMPU_METHOD m_q0p711_g "" RAT_FUNC "%6.3" "g" COEFFS 0 36 0 0 0 25.6 /end COMPU_METHOD
/begin COMPU_METHOD m_q1_mg "" RAT_FUNC "%6.2" "mg" COEFFS 0 1 0 0 0 1 /end COMPU_METHOD
/begin COMPU_METHOD m_q3p0518Em7_mgO2 "" RAT_FUNC "%9.8" "mgO2" COEFFS 0 3276800 0 0 0 1 /end COMPU_METHOD
/begin COMPU_METHOD m_uw_b6553p5 "" RAT_FUNC "%6.3" "kg/h" COEFFS 0 1 0 0 0 0.1 /end COMPU_METHOD
/begin COMPU_METHOD m_uw_b7281 "" RAT_FUNC "%6.3" "g" COEFFS 0 9 0 0 0 1 /end COMPU_METHOD
/begin COMPU_METHOD nmot_ub_q40 "" RAT_FUNC "%6.1" "1/min" COEFFS 0 1 0 0 0 40 /end COMPU_METHOD
/begin COMPU_METHOD OneToOne "" RAT_FUNC "%6.2" "-" COEFFS 0 1 0 0 0 1 /end COMPU_METHOD
/begin COMPU_METHOD q0p014775 "" RAT_FUNC "%6.4" "" COEFFS 0 1 0 0 0 0.014775 /end COMPU_METHOD
/begin COMPU_METHOD q0p014775_mA_DIV_V "" RAT_FUNC "%6.4" "mA/V" COEFFS 0 1 0 0 0 0.014775 /end COMPU_METHOD
/begin COMPU_METHOD q0p1182 "" RAT_FUNC "%6.3" "" COEFFS 0 1 0 0 0 0.1182 /end COMPU_METHOD
/begin COMPU_METHOD q0p1182_mA_DIV_V "" RAT_FUNC "%6.3" "mA/V" COEFFS 0 1 0 0 0 0.1182 /end COMPU_METHOD
/begin COMPU_METHOD q0p4728 "" RAT_FUNC "%6.3" "" COEFFS 0 1 0 0 0 0.4728 /end COMPU_METHOD
/begin COMPU_METHOD q0p4728_mA_DIV_V "" RAT_FUNC "%6.3" "mA/V" COEFFS 0 1 0 0 0 0.4728 /end COMPU_METHOD
/begin COMPU_METHOD q1p08505Em5_g "" RAT_FUNC "%7.6" "g" COEFFS 0 100000000 0 0 0 1085.0528878 /end COMPU_METHOD
/begin COMPU_METHOD rel_q0p02344 "" RAT_FUNC "%6.4" "%" COEFFS 0 32 0 0 0 0.75 /end COMPU_METHOD
/begin COMPU_METHOD rel_q2p929Em3 "" RAT_FUNC "%6.4" "%" COEFFS 0 1024 0 0 0 3 /end COMPU_METHOD
/begin COMPU_METHOD rel_q3p576Em7 "" RAT_FUNC "%9.8" "%" COEFFS 0 8388608 0 0 0 3 /end COMPU_METHOD
/begin COMPU_METHOD rel_ub_q0p75 "" RAT_FUNC "%6.3" "%" COEFFS 0 1 0 0 0 0.75 /end COMPU_METHOD
/begin COMPU_METHOD r_q0p1_Ohm "" RAT_FUNC "%6.3" "Ohm" COEFFS 0 10 0 0 0 1 /end COMPU_METHOD
/begin COMPU_METHOD spg_q0p00488 "" RAT_FUNC "%6.4" "V" COEFFS 0 1024 0 0 0 5 /end COMPU_METHOD
/begin COMPU_METHOD spg_q0p08_V "" RAT_FUNC "%6.3" "V" COEFFS 0 1 0 0 0 0.08 /end COMPU_METHOD
/begin COMPU_METHOD spg_q0p23_V "" RAT_FUNC "%6.3" "V" COEFFS 0 1000 0 0 0 230 /end COMPU_METHOD
/begin COMPU_METHOD spg_q1p221Em3_V "" RAT_FUNC "%6.4" "V" COEFFS 0 65536 0 0 0 80 /end COMPU_METHOD
/begin COMPU_METHOD spg_q1p9073Em5 "" RAT_FUNC "%7.6" "V" COEFFS 0 262144 0 0 0 5 /end COMPU_METHOD
/begin COMPU_METHOD spg_q2p3842Em7_V "" RAT_FUNC "%9.8" "V" COEFFS 0 4194304 0 0 0 1 /end COMPU_METHOD
/begin COMPU_METHOD spg_q3p2Em4_V "" RAT_FUNC "%6.5" "V" COEFFS 0 32768 0 0 0 10.48576 /end COMPU_METHOD
/begin COMPU_METHOD Temp_Cels "" RAT_FUNC "%6.1" "deg C" COEFFS 0 10 2731.4 0 0 1 /end COMPU_METHOD
/begin COMPU_METHOD temp_q0p0234_o273 "" RAT_FUNC "%6.1" "Grad C" COEFFS 0 1 273.15 0 0 0.0234375 /end COMPU_METHOD
/begin COMPU_METHOD temp_q1p5259Em6_om273 "" RAT_FUNC "%6.1" "°C" COEFFS 0 65536 17900503.04 0 0 0.1 /end COMPU_METHOD
/begin COMPU_METHOD TWCC_PhSyncZA_sm_VERB "" TAB_VERB "%6.3" "" COMPU_TAB_REF TWCC_PhSyncZA_sm_VERB /end COMPU_METHOD
/begin COMPU_VTAB TWCC_PhSyncZA_sm_VERB "" TAB_VERB 3 0 "_0_reset" 1 "_1_pending" 2 "_2_steady" /end COMPU_VTAB
/begin COMPU_METHOD TWCDOSCPAPRIB1_SY_Compu "" TAB_VERB "%6.3" "" COMPU_TAB_REF TWCDOSCPAPRIB1_SY_Compu /end COMPU_METHOD
/begin COMPU_VTAB TWCDOSCPAPRIB1_SY_Compu "" TAB_VERB 2 0 "False" 1 "True" /end COMPU_VTAB
/begin COMPU_METHOD TWCDOSCPAPRIB2_SY_Compu "" TAB_VERB "%6.3" "" COMPU_TAB_REF TWCDOSCPAPRIB2_SY_Compu /end COMPU_METHOD
/begin COMPU_VTAB TWCDOSCPAPRIB2_SY_Compu "" TAB_VERB 2 0 "False" 1 "True" /end COMPU_VTAB
/begin COMPU_METHOD TWCDOSCPASCNDB1_SY_Compu "" TAB_VERB "%6.3" "" COMPU_TAB_REF TWCDOSCPASCNDB1_SY_Compu /end COMPU_METHOD
/begin COMPU_VTAB TWCDOSCPASCNDB1_SY_Compu "" TAB_VERB 2 0 "False" 1 "True" /end COMPU_VTAB
/begin COMPU_METHOD TWCDOSCPASCNDB2_SY_Compu "" TAB_VERB "%6.3" "" COMPU_TAB_REF TWCDOSCPASCNDB2_SY_Compu /end COMPU_METHOD
/begin COMPU_VTAB TWCDOSCPASCNDB2_SY_Compu "" TAB_VERB 2 0 "False" 1 "True" /end COMPU_VTAB
/begin COMPU_METHOD TWCDOSCPATST_SY_Compu "" TAB_VERB "%6.3" "" COMPU_TAB_REF TWCDOSCPATST_SY_Compu /end COMPU_METHOD
/begin COMPU_VTAB TWCDOSCPATST_SY_Compu "" TAB_VERB 2 0 "False" 1 "True" /end COMPU_VTAB
/begin COMPU_METHOD TWCDOSCPRIB1_SY_Compu "" TAB_VERB "%6.3" "" COMPU_TAB_REF TWCDOSCPRIB1_SY_Compu /end COMPU_METHOD
/begin COMPU_VTAB TWCDOSCPRIB1_SY_Compu "" TAB_VERB 2 0 "False" 1 "True" /end COMPU_VTAB
/begin COMPU_METHOD TWCDOSCPRIB2_SY_Compu "" TAB_VERB "%6.3" "" COMPU_TAB_REF TWCDOSCPRIB2_SY_Compu /end COMPU_METHOD
/begin COMPU_VTAB TWCDOSCPRIB2_SY_Compu "" TAB_VERB 2 0 "False" 1 "True" /end COMPU_VTAB
/begin COMPU_METHOD TWCDOSCSCNDB1_SY_Compu "" TAB_VERB "%6.3" "" COMPU_TAB_REF TWCDOSCSCNDB1_SY_Compu /end COMPU_METHOD
/begin COMPU_VTAB TWCDOSCSCNDB1_SY_Compu "" TAB_VERB 2 0 "False" 1 "True" /end COMPU_VTAB
/begin COMPU_METHOD TWCDOSCSCNDB2_SY_Compu "" TAB_VERB "%6.3" "" COMPU_TAB_REF TWCDOSCSCNDB2_SY_Compu /end COMPU_METHOD
/begin COMPU_VTAB TWCDOSCSCNDB2_SY_Compu "" TAB_VERB 2 0 "False" 1 "True" /end COMPU_VTAB
/begin COMPU_METHOD TWCDPATST_SY_Compu "" TAB_VERB "%6.3" "" COMPU_TAB_REF TWCDPATST_SY_Compu /end COMPU_METHOD
/begin COMPU_VTAB TWCDPATST_SY_Compu "" TAB_VERB 2 0 "not active" 1 "active" /end COMPU_VTAB
/begin COMPU_METHOD TWCDRSCFRTHB1_SC_Compu "" TAB_VERB "%6.3" "" COMPU_TAB_REF TWCDRSCFRTHB1_SC_Compu /end COMPU_METHOD
/begin COMPU_VTAB TWCDRSCFRTHB1_SC_Compu "" TAB_VERB 2 0 "False" 1 "True" /end COMPU_VTAB
/begin COMPU_METHOD TWCDRSCFRTHB2_SC_Compu "" TAB_VERB "%6.3" "" COMPU_TAB_REF TWCDRSCFRTHB2_SC_Compu /end COMPU_METHOD
/begin COMPU_VTAB TWCDRSCFRTHB2_SC_Compu "" TAB_VERB 2 0 "False" 1 "True" /end COMPU_VTAB
/begin COMPU_METHOD TWCDRSCPATST_SY_Compu "" TAB_VERB "%6.3" "" COMPU_TAB_REF TWCDRSCPATST_SY_Compu /end COMPU_METHOD
/begin COMPU_VTAB TWCDRSCPATST_SY_Compu "" TAB_VERB 2 0 "False" 1 "True" /end COMPU_VTAB
/begin COMPU_METHOD TWCDRSCPRIB1_SY_Compu "" TAB_VERB "%6.3" "" COMPU_TAB_REF TWCDRSCPRIB1_SY_Compu /end COMPU_METHOD
/begin COMPU_VTAB TWCDRSCPRIB1_SY_Compu "" TAB_VERB 2 0 "False" 1 "True" /end COMPU_VTAB
/begin COMPU_METHOD TWCDRSCPRIB2_SY_Compu "" TAB_VERB "%6.3" "" COMPU_TAB_REF TWCDRSCPRIB2_SY_Compu /end COMPU_METHOD
/begin COMPU_VTAB TWCDRSCPRIB2_SY_Compu "" TAB_VERB 2 0 "False" 1 "True" /end COMPU_VTAB
/begin COMPU_METHOD TWCDRSCSCNDB1_SY_Compu "" TAB_VERB "%6.3" "" COMPU_TAB_REF TWCDRSCSCNDB1_SY_Compu /end COMPU_METHOD
/begin COMPU_VTAB TWCDRSCSCNDB1_SY_Compu "" TAB_VERB 2 0 "False" 1 "True" /end COMPU_VTAB
/begin COMPU_METHOD TWCDRSCSCNDB2_SY_Compu "" TAB_VERB "%6.3" "" COMPU_TAB_REF TWCDRSCSCNDB2_SY_Compu /end COMPU_METHOD
/begin COMPU_VTAB TWCDRSCSCNDB2_SY_Compu "" TAB_VERB 2 0 "False" 1 "True" /end COMPU_VTAB
/begin COMPU_METHOD TWCDRSCTHRDB1_SY_Compu "" TAB_VERB "%6.3" "" COMPU_TAB_REF TWCDRSCTHRDB1_SY_Compu /end COMPU_METHOD
/begin COMPU_VTAB TWCDRSCTHRDB1_SY_Compu "" TAB_VERB 2 0 "False" 1 "True" /end COMPU_VTAB
/begin COMPU_METHOD TWCDRSCTHRDB2_SY_Compu "" TAB_VERB "%6.3" "" COMPU_TAB_REF TWCDRSCTHRDB2_SY_Compu /end COMPU_METHOD
/begin COMPU_VTAB TWCDRSCTHRDB2_SY_Compu "" TAB_VERB 2 0 "False" 1 "True" /end COMPU_VTAB
/begin COMPU_METHOD TWCD_CatMeasSM_sm_VERB "" TAB_VERB "%6.3" "" COMPU_TAB_REF TWCD_CatMeasSM_sm_VERB /end COMPU_METHOD
/begin COMPU_VTAB TWCD_CatMeasSM_sm_VERB "" TAB_VERB 9 0 "A_0_inactive" 1 "A_1_rsc_measure" 2 "A_2_wait" 3 "A_3_osc_measure" 4 "A_4_wait" 5 "A_5_osc_measure" 6 "A_6_wait" 7 "A_7_rsc_measure" 8 "A_8_wait" /end COMPU_VTAB
/begin COMPU_METHOD TWCD_OSCCAT2BNK1PARL_SC_Compu "" TAB_VERB "%6.3" "" COMPU_TAB_REF TWCD_OSCCAT2BNK1PARL_SC_Compu /end COMPU_METHOD
/begin COMPU_VTAB TWCD_OSCCAT2BNK1PARL_SC_Compu "" TAB_VERB 2 0 "not_active" 1 "active" /end COMPU_VTAB
/begin COMPU_METHOD TWCD_OSCCAT2BNK2PARL_SC_Compu "" TAB_VERB "%6.3" "" COMPU_TAB_REF TWCD_OSCCAT2BNK2PARL_SC_Compu /end COMPU_METHOD
/begin COMPU_VTAB TWCD_OSCCAT2BNK2PARL_SC_Compu "" TAB_VERB 2 0 "not_active" 1 "active" /end COMPU_VTAB
/begin COMPU_METHOD TWCD_PTLMEASMTPARL_SC_Compu "" TAB_VERB "%6.3" "" COMPU_TAB_REF TWCD_PTLMEASMTPARL_SC_Compu /end COMPU_METHOD
/begin COMPU_VTAB TWCD_PTLMEASMTPARL_SC_Compu "" TAB_VERB 2 0 "False" 1 "True" /end COMPU_VTAB
/begin COMPU_METHOD TWCD_STRATIUMPRSIMN_SC_Compu "" TAB_VERB "%6.3" "" COMPU_TAB_REF TWCD_STRATIUMPRSIMN_SC_Compu /end COMPU_METHOD
/begin COMPU_VTAB TWCD_STRATIUMPRSIMN_SC_Compu "" TAB_VERB 2 0 "False" 1 "True" /end COMPU_VTAB
/begin COMPU_METHOD TWCOR_HIRES_SC_Compu "" TAB_VERB "%6.3" "" COMPU_TAB_REF TWCOR_HIRES_SC_Compu /end COMPU_METHOD
/begin COMPU_VTAB TWCOR_HIRES_SC_Compu "" TAB_VERB 2 0 "RES_S8" 1 "RES_S16" /end COMPU_VTAB
/begin COMPU_METHOD TWC_VAR_SY_Compu "" TAB_VERB "%6.3" "" COMPU_TAB_REF TWC_VAR_SY_Compu /end COMPU_METHOD
/begin COMPU_VTAB TWC_VAR_SY_Compu "" TAB_VERB 44 1 "DAI" 3 "VWW" 4 "POR" 5 "AUD" 6 "OPE" 9 "FIA" 11 "BMW" 14 "PSA" 15 "REN" 17 "ALF" 18 "SAB" 19 "VOL" 20 "NIS" 21 "GMU" 22 "FOR" 26 "IMJ" 51 "SEA" 53 "CHR" 54 "JAG" 55 "ROL" 69 "FER" 72 "TOY" 112 "BMWMotorradAG" 123 "MIT" 147 "HYU" 159 "HON" 160 "MAZ" 183 "CU" 190 "LRG" 204 "VVW" 214 "AVT" 242 "Iveco" 243 "DMC" 248 "SUZ" 267 "SSANGYONG" 270 "KEF" 289 "AMG" 308 "TAT" 319 "MVM" 385 "UAES" 590 "Scania" 828 "RBCD" 999 "ALL" 2887 "Nonox" /end COMPU_VTAB
/begin COMPU_METHOD TWTRCOOLRDS_TYPAVL_SC_Compu "" TAB_VERB "%6.3" "" COMPU_TAB_REF TWTRCOOLRDS_TYPAVL_SC_Compu /end COMPU_METHOD
/begin COMPU_VTAB TWTRCOOLRDS_TYPAVL_SC_Compu "" TAB_VERB 2 0 "False" 1 "True" /end COMPU_VTAB
/begin COMPU_METHOD t_q0p01 "" RAT_FUNC "%6.4" "s" COEFFS 0 100 0 0 0 1 /end COMPU_METHOD
/begin COMPU_METHOD t_q0p02 "" RAT_FUNC "%6.4" "s" COEFFS 0 100 0 0 0 2 /end COMPU_METHOD
/begin COMPU_METHOD t_q0p05 "" RAT_FUNC "%6.4" "s" COEFFS 0 100 0 0 0 5 /end COMPU_METHOD
/begin COMPU_METHOD t_q0p1 "" RAT_FUNC "%6.3" "s" COEFFS 0 10 0 0 0 1 /end COMPU_METHOD
/begin COMPU_METHOD t_q1 "" RAT_FUNC "%6.2" "s" COEFFS 0 1 0 0 0 1 /end COMPU_METHOD
/begin COMPU_METHOD UEGO_CJ135Ctl_SM_sm_VERB "" TAB_VERB "%6.3" "" COMPU_TAB_REF UEGO_CJ135Ctl_SM_sm_VERB /end COMPU_METHOD
/begin COMPU_VTAB UEGO_CJ135Ctl_SM_sm_VERB "" TAB_VERB 14 0 "IDLE" 1 "DIA_NORMAL1" 10 "OP_WARMUP" 11 "DIAGNOSIS" 12 "OP_NORMAL" 13 "OPERATION" 2 "DIA_SWITCHON" 3 "DIA_WARMUP" 4 "OP_NORMAL_IP_DOWN" 5 "OP_NORMAL_IP_UP" 6 "OP_NORMAL_STD" 7 "OP_RPC" 8 "OP_RVSCHRG" 9 "OP_SWITCHON" /end COMPU_VTAB
/begin COMPU_METHOD zk100msxs_ub_b25p5 "" RAT_FUNC "%6.3" "s" COEFFS 0 0 256 0 10 0 /end COMPU_METHOD
/begin COMPU_METHOD zk10msxs_uw_b655p36 "" RAT_FUNC "%6.2" "s" COEFFS 0 0 65536 0 100 0 /end COMPU_METHOD
/begin COMPU_METHOD zk1sxs_uw_b65535 "" RAT_FUNC "%6.0" "s" COEFFS 0 0 65535 0 1 0 /end COMPU_METHOD
/begin COMPU_METHOD zk20msxs_uw_b1310p72 "" RAT_FUNC "%6.1" "s" COEFFS 0 0 65536 0 50 0 /end COMPU_METHOD
/begin RECORD_LAYOUT RB_Axis_U16 NO_AXIS_PTS_X 1 UWORD AXIS_PTS_X 2 UWORD INDEX_INCR DIRECT /end RECORD_LAYOUT
/begin RECORD_LAYOUT RB_CurveGroup_S16 FNC_VALUES 1 SWORD COLUMN_DIR DIRECT /end RECORD_LAYOUT
/begin RECORD_LAYOUT RB_CurveGroup_U16 FNC_VALUES 1 UWORD COLUMN_DIR DIRECT /end RECORD_LAYOUT
/begin RECORD_LAYOUT RB_Curve_S16_S16 NO_AXIS_PTS_X 1 SWORD AXIS_PTS_X 2 SWORD INDEX_INCR DIRECT FNC_VALUES 3 SWORD COLUMN_DIR DIRECT /end RECORD_LAYOUT
/begin RECORD_LAYOUT RB_Curve_S16_U16_Static NO_AXIS_PTS_X 1 SWORD AXIS_PTS_X 2 SWORD INDEX_INCR DIRECT FNC_VALUES 3 UWORD COLUMN_DIR DIRECT STATIC_RECORD_LAYOUT /end RECORD_LAYOUT
/begin RECORD_LAYOUT RB_Curve_S16_U8_Static NO_AXIS_PTS_X 1 SWORD AXIS_PTS_X 2 SWORD INDEX_INCR DIRECT FNC_VALUES 3 UBYTE COLUMN_DIR DIRECT STATIC_RECORD_LAYOUT /end RECORD_LAYOUT
/begin RECORD_LAYOUT RB_Curve_U16_U16 NO_AXIS_PTS_X 1 UWORD AXIS_PTS_X 2 UWORD INDEX_INCR DIRECT FNC_VALUES 3 UWORD COLUMN_DIR DIRECT /end RECORD_LAYOUT
/begin RECORD_LAYOUT RB_Curve_U16_U8_Static NO_AXIS_PTS_X 1 UWORD AXIS_PTS_X 2 UWORD INDEX_INCR DIRECT FNC_VALUES 3 UBYTE COLUMN_DIR DIRECT STATIC_RECORD_LAYOUT /end RECORD_LAYOUT
/begin RECORD_LAYOUT RB_Curve_U8_U8 NO_AXIS_PTS_X 1 UBYTE AXIS_PTS_X 2 UBYTE INDEX_INCR DIRECT FNC_VALUES 3 UBYTE COLUMN_DIR DIRECT /end RECORD_LAYOUT
/begin RECORD_LAYOUT RB_Map_S16S16_S16 NO_AXIS_PTS_X 1 SWORD NO_AXIS_PTS_Y 2 SWORD AXIS_PTS_X 3 SWORD INDEX_INCR DIRECT AXIS_PTS_Y 4 SWORD INDEX_INCR DIRECT FNC_VALUES 5 SWORD COLUMN_DIR DIRECT /end RECORD_LAYOUT
/begin RECORD_LAYOUT RB_Map_S16U16_U16 NO_AXIS_PTS_X 1 SWORD NO_AXIS_PTS_Y 2 SWORD AXIS_PTS_X 3 SWORD INDEX_INCR DIRECT AXIS_PTS_Y 4 UWORD INDEX_INCR DIRECT FNC_VALUES 5 UWORD ROW_DIR DIRECT /end RECORD_LAYOUT
/begin RECORD_LAYOUT RB_Map_S16U16_U8 NO_AXIS_PTS_X 1 SWORD NO_AXIS_PTS_Y 2 SWORD AXIS_PTS_X 3 SWORD INDEX_INCR DIRECT AXIS_PTS_Y 4 UWORD INDEX_INCR DIRECT FNC_VALUES 5 UBYTE ROW_DIR DIRECT /end RECORD_LAYOUT
/begin RECORD_LAYOUT RB_Map_U16U16_U16 NO_AXIS_PTS_X 1 UWORD NO_AXIS_PTS_Y 2 UWORD AXIS_PTS_X 3 UWORD INDEX_INCR DIRECT AXIS_PTS_Y 4 UWORD INDEX_INCR DIRECT FNC_VALUES 5 UWORD COLUMN_DIR DIRECT /end RECORD_LAYOUT
/begin RECORD_LAYOUT RB_Map_U8U8_U8 NO_AXIS_PTS_X 1 UBYTE NO_AXIS_PTS_Y 2 UBYTE AXIS_PTS_X 3 UBYTE INDEX_INCR DIRECT AXIS_PTS_Y 4 UBYTE INDEX_INCR DIRECT FNC_VALUES 5 UBYTE COLUMN_DIR DIRECT /end RECORD_LAYOUT
/begin RECORD_LAYOUT RB_Val_Ws16 FNC_VALUES 1 SWORD COLUMN_DIR DIRECT /end RECORD_LAYOUT
/begin RECORD_LAYOUT RB_Val_Wu16 FNC_VALUES 1 UWORD COLUMN_DIR DIRECT /end RECORD_LAYOUT
/begin RECORD_LAYOUT RB_Val_Wu32 FNC_VALUES 1 ULONG COLUMN_DIR DIRECT /end RECORD_LAYOUT
/begin RECORD_LAYOUT RB_Val_Wu8 FNC_VALUES 1 UBYTE COLUMN_DIR DIRECT /end RECORD_LAYOUT
/end MODULE
/end PROJECT
