ASAP2_VERSION 1 60
/begin PROJECT MG1CA020 "MG1CA020"
/begin HEADER "" VERSION "MG1CA020_6SAY_V011_TPROT" PROJECT_NO MG1CA020 /end HEADER
/begin MODULE DIM ""
/begin MOD_COMMON "" BYTE_ORDER MSB_LAST ALIGNMENT_BYTE 1 ALIGNMENT_WORD 2 ALIGNMENT_LONG 4 ALIGNMENT_INT64 4 ALIGNMENT_FLOAT32_IEEE 4 ALIGNMENT_FLOAT64_IEEE 4 DATA_SIZE 32 /end MOD_COMMON
/begin CHARACTERISTIC CoVMD_cntrIDASFailDetn_C "Threshold counter for IDAS failure detection" VALUE 0x80509B3C RB_Val_Wu16 65535.00 OneToOne 0.00 65535.00 FORMAT "%8.2" /end CHARACTERISTIC
/begin CHARACTERISTIC CoVMD_drIDASReqNeg_C "Negative delta ratio for IDAS Cruise Control and Speed limiter request" VALUE 0x80509B3E RB_Val_Ws16 799.9878 Prc -400.0000 399.9878 FORMAT "%8.4" /end CHARACTERISTIC
/begin CHARACTERISTIC CoVMD_drIDASReqPos_C "Possible delta ratio for IDAS Cruise Control and Speed limiter request" VALUE 0x80509B40 RB_Val_Ws16 799.9878 Prc -400.0000 399.9878 FORMAT "%8.4" /end CHARACTERISTIC
/begin CHARACTERISTIC CoVMD_facIDASFailDetn_C "Factor is used to determine the torque threshold for IDAS failure detection" VALUE 0x80509B42 RB_Val_Ws16 7.999878 Fact -4.000000 3.999878 FORMAT "%8.6" /end CHARACTERISTIC
/begin CHARACTERISTIC CoVMD_flgIDASMTCluOffEna_C "IDAS MT clutch Off calculation enable calibration" VALUE 0x80509B44 RB_Val_Wboolean 1.00000000000 B_TRUE 0.00 1.00000000000 FORMAT "%13.11" /end CHARACTERISTIC
/begin CHARACTERISTIC CoVMD_flgSwtRatSelnTqPull_C "Switch to select the ratio for desired torque after Pull behaviour" VALUE 0x80509B45 RB_Val_Wboolean 1.00000000000 B_TRUE 0.00 1.00000000000 FORMAT "%13.11" /end CHARACTERISTIC
/begin AXIS_PTS CoVMD_nAPPReqChg_AXIS "Axis for Gear Change APP request group curve." 0x80509B46 CoVMD_nDesVal RB_Axis_S16 65535.00 EngNCrCtl 6 -32768.00 32767.00 FORMAT "%8.2" DEPOSIT ABSOLUTE /end AXIS_PTS
/begin CHARACTERISTIC CoVMD_ratACCCVTMinWoRamp_C "Minimum ratio difference for activating ramping for CVT variant" VALUE 0x80509B54 RB_Val_Ws16 799.9878 Prc -400.0000 399.9878 FORMAT "%8.4" /end CHARACTERISTIC
/begin CHARACTERISTIC CoVMD_ratACCMinWoRamp_C "Minimum ratio difference for activating ramping" VALUE 0x80509B56 RB_Val_Ws16 799.9878 Prc -400.0000 399.9878 FORMAT "%8.4" /end CHARACTERISTIC
/begin CHARACTERISTIC CoVMD_ratIDASReqLoLim_C "Low ratio limit for IDAS Cruise control and Speed limiter Request" VALUE 0x80509B58 RB_Val_Ws16 799.9878 Prc -400.0000 399.9878 FORMAT "%8.4" /end CHARACTERISTIC
/begin CHARACTERISTIC CoVMD_ratLLimCVTMinWoRamp_C "Minimum ratio difference for activating ramping for CVT variant" VALUE 0x80509B5A RB_Val_Ws16 799.9878 Prc -400.0000 399.9878 FORMAT "%8.4" /end CHARACTERISTIC
/begin CHARACTERISTIC CoVMD_ratLLimMinWoRamp_C "Minimum ratio difference for activating ramping" VALUE 0x80509B5C RB_Val_Ws16 799.9878 Prc -400.0000 399.9878 FORMAT "%8.4" /end CHARACTERISTIC
/begin CHARACTERISTIC CoVMD_ratVirtMaxThd_C "Maximum accelerator ratio threshold for calculated IDAS ratio" VALUE 0x80509B5E RB_Val_Ws16 799.9878 Prc -400.0000 399.9878 FORMAT "%8.4" /end CHARACTERISTIC
/begin CHARACTERISTIC CoVMD_rReqChng_GT "Curve for Gear Change APP request value" CURVE 0x80509B60 RB_CurveGroup_S16 163.8350 APPCrCtl1 0.00 163.8350 FORMAT "%8.4" EXTENDED_LIMITS -163.8400 163.8350
 /begin AXIS_DESCR COM_AXIS CoVMD_nDesVal EngNCrCtl 6 -32768.00 32767.00 FORMAT "%8.2" AXIS_PTS_REF CoVMD_nAPPReqChg_AXIS /end AXIS_DESCR
/end CHARACTERISTIC
/begin CHARACTERISTIC CoVMD_rSptReqChng_GT "Curve for Gear Change APP request value for sport mode" CURVE 0x80509B6C RB_CurveGroup_S16 163.8350 APPCrCtl1 0.00 163.8350 FORMAT "%8.4" EXTENDED_LIMITS -163.8400 163.8350
 /begin AXIS_DESCR COM_AXIS CoVMD_nDesVal EngNCrCtl 6 -32768.00 32767.00 FORMAT "%8.2" AXIS_PTS_REF CoVMD_nAPPReqChg_AXIS /end AXIS_DESCR
/end CHARACTERISTIC
/begin CHARACTERISTIC CoVMD_stSwtAPMapSeln_C "AP selection Switch between CVT with and without ratio" VALUE 0x80509B78 RB_Val_Wu8 255.0 OneToOne 0.00 255.0 FORMAT "%5.1" /end CHARACTERISTIC
/begin CHARACTERISTIC CoVMD_swtCCASLTrqSeln_C "Switch to select if driving assistance functions are calculated in Engine ECU" VALUE 0x80509B79 RB_Val_Wu8 255.0 OneToOne 0.00 255.0 FORMAT "%5.1" /end CHARACTERISTIC
/begin CHARACTERISTIC CoVMD_swtCCSelVal_C "Switch for Cruise Control Selection" VALUE 0x80509B7A RB_Val_Wu8 255.0 OneToOne 0.00 255.0 FORMAT "%5.1" /end CHARACTERISTIC
/begin CHARACTERISTIC CoVMD_swtCrCtlDemSel_C "Switch to Select CrCtl demand" VALUE 0x80509B7B RB_Val_Wu8 1.000 OneToOne 0.00 1.000 FORMAT "%5.3" EXTENDED_LIMITS 0.00 255.0 /end CHARACTERISTIC
/begin CHARACTERISTIC CoVMD_swtMoFSel_C "Switch for MoF selection" VALUE 0x80509B7C RB_Val_Wu8 1.000 OneToOne 0.00 1.000 FORMAT "%5.3" EXTENDED_LIMITS 0.00 255.0 /end CHARACTERISTIC
/begin CHARACTERISTIC CoVMD_tiACCCVTRampSlop_CA "Parameter array time period within which ramping of APP raito should be finished for CVT variant" VAL_BLK 0x80509B7E RB_ValA_Ws16 655.3500 Time_s -327.6800 327.6700 FORMAT "%8.4" NUMBER 11 /end CHARACTERISTIC
/begin CHARACTERISTIC CoVMD_tiACCRampSlop_CA "Parameter array time period within which ramping of APP raito should be finished" VAL_BLK 0x80509B94 RB_ValA_Ws16 655.3500 Time_s -327.6800 327.6700 FORMAT "%8.4" NUMBER 11 /end CHARACTERISTIC
/begin CHARACTERISTIC CoVMD_tiBrkFailDeb_C "Threshold to determine brake is operated for IDAS failure detection" VALUE 0x80509BAA RB_Val_Wu16 655350.0 Time_ms 0.00 655350.0 FORMAT "%8.1" /end CHARACTERISTIC
/begin CHARACTERISTIC CoVMD_tiIDASFailBrkDetn_C "Delay time to determine brake is operated" VALUE 0x80509BAC RB_Val_Ws16 655350.0 Time_ms -327680.0 327670.0 FORMAT "%8.1" /end CHARACTERISTIC
/begin CHARACTERISTIC CoVMD_tiIDASReqLim_T "Application CUR to calculate time constant of PT1" CURVE 0x80509BAE RB_Curve_S16_S16 655.3500 Time_s -327.6800 327.6700 FORMAT "%8.4"
 /begin AXIS_DESCR STD_AXIS CoVMD_rVirtApp Prc 6 -400.0000 399.9878 FORMAT "%8.4" DEPOSIT ABSOLUTE /end AXIS_DESCR
/end CHARACTERISTIC
/begin CHARACTERISTIC CoVMD_tiLLimCVTRampSlop_CA "Parameter array time period within which ramping of APP raito should be finished for CVT variant" VAL_BLK 0x80509BC8 RB_ValA_Ws16 655.3500 Time_s -327.6800 327.6700 FORMAT "%8.4" NUMBER 11 /end CHARACTERISTIC
/begin CHARACTERISTIC CoVMD_tiLLimRampSlop_CA "Parameter array time period within which ramping of APP raito should be finished" VAL_BLK 0x80509BDE RB_ValA_Ws16 655.3500 Time_s -327.6800 327.6700 FORMAT "%8.4" NUMBER 11 /end CHARACTERISTIC
/begin CHARACTERISTIC CoVMD_tiTqFild_T "The CUR to calculate time constant of PT1" CURVE 0x80509BF4 RB_Curve_S16_S16 655.3500 Time_s -327.6800 327.6700 FORMAT "%8.4"
 /begin AXIS_DESCR STD_AXIS CoVMD_rVirtApp Prc 12 -400.0000 399.9878 FORMAT "%8.4" DEPOSIT ABSOLUTE /end AXIS_DESCR
/end CHARACTERISTIC
/begin CHARACTERISTIC CoVMD_tqCrCtlReqDft_C "Default value of cruise control torque request when cruise control is not active" VALUE 0x80509C28 RB_Val_Ws32 429496729.500 TrqPrpHigh -214748364.800 214748364.700 FORMAT "%13.3" /end CHARACTERISTIC
/begin CHARACTERISTIC CoVMD_tqCvtEcoATMod1_M "Conversion MAP 1 for AT condition in Eco Mode" MAP 0x80509C2C RB_Map_S16S16_S16 6553.500 TrqPrpHigh -3276.800 3276.700 FORMAT "%8.3"
 /begin AXIS_DESCR STD_AXIS VehV_v Vel 16 -327.6800 327.6700 FORMAT "%8.4" DEPOSIT ABSOLUTE /end AXIS_DESCR
 /begin AXIS_DESCR STD_AXIS CoVMD_ratVirtMax Prc 16 -400.0000 399.9878 FORMAT "%8.4" DEPOSIT ABSOLUTE /end AXIS_DESCR
/end CHARACTERISTIC
/begin CHARACTERISTIC CoVMD_tqCvtEcoATMod2_M "Conversion MAP 2 for AT condition in Eco Mode" MAP 0x80509E70 RB_Map_S16S16_S16 6553.500 TrqPrpHigh -3276.800 3276.700 FORMAT "%8.3"
 /begin AXIS_DESCR STD_AXIS VehV_v Vel 16 -327.6800 327.6700 FORMAT "%8.4" DEPOSIT ABSOLUTE /end AXIS_DESCR
 /begin AXIS_DESCR STD_AXIS CoVMD_ratVirtMax Prc 16 -400.0000 399.9878 FORMAT "%8.4" DEPOSIT ABSOLUTE /end AXIS_DESCR
/end CHARACTERISTIC
/begin CHARACTERISTIC CoVMD_tqCvtEcoATMod3_M "Conversion MAP 3 for AT condition in Eco Mode" MAP 0x8050A0B4 RB_Map_S16S16_S16 6553.500 TrqPrpHigh -3276.800 3276.700 FORMAT "%8.3"
 /begin AXIS_DESCR STD_AXIS VehV_v Vel 16 -327.6800 327.6700 FORMAT "%8.4" DEPOSIT ABSOLUTE /end AXIS_DESCR
 /begin AXIS_DESCR STD_AXIS CoVMD_ratVirtMax Prc 16 -400.0000 399.9878 FORMAT "%8.4" DEPOSIT ABSOLUTE /end AXIS_DESCR
/end CHARACTERISTIC
/begin CHARACTERISTIC CoVMD_tqCvtEcoATMod4_M "Conversion MAP 4 for AT condition in Eco Mode" MAP 0x8050A2F8 RB_Map_S16S16_S16 6553.500 TrqPrpHigh -3276.800 3276.700 FORMAT "%8.3"
 /begin AXIS_DESCR STD_AXIS VehV_v Vel 16 -327.6800 327.6700 FORMAT "%8.4" DEPOSIT ABSOLUTE /end AXIS_DESCR
 /begin AXIS_DESCR STD_AXIS CoVMD_ratVirtMax Prc 16 -400.0000 399.9878 FORMAT "%8.4" DEPOSIT ABSOLUTE /end AXIS_DESCR
/end CHARACTERISTIC
/begin CHARACTERISTIC CoVMD_tqCvtEcoATMod5_M "Conversion MAP 5 for AT condition in Eco Mode" MAP 0x8050A53C RB_Map_S16S16_S16 6553.500 TrqPrpHigh -3276.800 3276.700 FORMAT "%8.3"
 /begin AXIS_DESCR STD_AXIS VehV_v Vel 16 -327.6800 327.6700 FORMAT "%8.4" DEPOSIT ABSOLUTE /end AXIS_DESCR
 /begin AXIS_DESCR STD_AXIS CoVMD_ratVirtMax Prc 16 -400.0000 399.9878 FORMAT "%8.4" DEPOSIT ABSOLUTE /end AXIS_DESCR
/end CHARACTERISTIC
/begin CHARACTERISTIC CoVMD_tqCvtEcoATMod6_M "Conversion MAP 6 for AT condition in Eco Mode" MAP 0x8050A780 RB_Map_S16S16_S16 6553.500 TrqPrpHigh -3276.800 3276.700 FORMAT "%8.3"
 /begin AXIS_DESCR STD_AXIS VehV_v Vel 16 -327.6800 327.6700 FORMAT "%8.4" DEPOSIT ABSOLUTE /end AXIS_DESCR
 /begin AXIS_DESCR STD_AXIS CoVMD_ratVirtMax Prc 16 -400.0000 399.9878 FORMAT "%8.4" DEPOSIT ABSOLUTE /end AXIS_DESCR
/end CHARACTERISTIC
/begin CHARACTERISTIC CoVMD_tqCvtEcoATMod7_M "Conversion MAP 7 for AT condition in Eco Mode" MAP 0x8050A9C4 RB_Map_S16S16_S16 6553.500 TrqPrpHigh -3276.800 3276.700 FORMAT "%8.3"
 /begin AXIS_DESCR STD_AXIS VehV_v Vel 16 -327.6800 327.6700 FORMAT "%8.4" DEPOSIT ABSOLUTE /end AXIS_DESCR
 /begin AXIS_DESCR STD_AXIS CoVMD_ratVirtMax Prc 16 -400.0000 399.9878 FORMAT "%8.4" DEPOSIT ABSOLUTE /end AXIS_DESCR
/end CHARACTERISTIC
/begin CHARACTERISTIC CoVMD_tqCvtEcoDwnHill1_M "Conversion MAP 1 for down-hill condition in Eco Mode" MAP 0x8050AC08 RB_Map_S16S16_S16 6553.500 TrqPrpHigh -3276.800 3276.700 FORMAT "%8.3"
 /begin AXIS_DESCR STD_AXIS VehV_v Vel 16 -327.6800 327.6700 FORMAT "%8.4" DEPOSIT ABSOLUTE /end AXIS_DESCR
 /begin AXIS_DESCR STD_AXIS CoVMD_ratVirtMax Prc 16 -400.0000 399.9878 FORMAT "%8.4" DEPOSIT ABSOLUTE /end AXIS_DESCR
/end CHARACTERISTIC
/begin CHARACTERISTIC CoVMD_tqCvtEcoDwnHill2_M "Conversion MAP 2 for down-hill condition in Eco Mode" MAP 0x8050AE4C RB_Map_S16S16_S16 6553.500 TrqPrpHigh -3276.800 3276.700 FORMAT "%8.3"
 /begin AXIS_DESCR STD_AXIS VehV_v Vel 16 -327.6800 327.6700 FORMAT "%8.4" DEPOSIT ABSOLUTE /end AXIS_DESCR
 /begin AXIS_DESCR STD_AXIS CoVMD_ratVirtMax Prc 16 -400.0000 399.9878 FORMAT "%8.4" DEPOSIT ABSOLUTE /end AXIS_DESCR
/end CHARACTERISTIC
/begin CHARACTERISTIC CoVMD_tqCvtEcoDwnHill3_M "Conversion MAP 3 for down-hill condition in Eco Mode" MAP 0x8050B090 RB_Map_S16S16_S16 6553.500 TrqPrpHigh -3276.800 3276.700 FORMAT "%8.3"
 /begin AXIS_DESCR STD_AXIS VehV_v Vel 16 -327.6800 327.6700 FORMAT "%8.4" DEPOSIT ABSOLUTE /end AXIS_DESCR
 /begin AXIS_DESCR STD_AXIS CoVMD_ratVirtMax Prc 16 -400.0000 399.9878 FORMAT "%8.4" DEPOSIT ABSOLUTE /end AXIS_DESCR
/end CHARACTERISTIC
/begin CHARACTERISTIC CoVMD_tqCvtEcoDwnHill4_M "Conversion MAP 4 for down-hill condition in Eco Mode" MAP 0x8050B2D4 RB_Map_S16S16_S16 6553.500 TrqPrpHigh -3276.800 3276.700 FORMAT "%8.3"
 /begin AXIS_DESCR STD_AXIS VehV_v Vel 16 -327.6800 327.6700 FORMAT "%8.4" DEPOSIT ABSOLUTE /end AXIS_DESCR
 /begin AXIS_DESCR STD_AXIS CoVMD_ratVirtMax Prc 16 -400.0000 399.9878 FORMAT "%8.4" DEPOSIT ABSOLUTE /end AXIS_DESCR
/end CHARACTERISTIC
/begin CHARACTERISTIC CoVMD_tqCvtEcoDwnHill5_M "Conversion MAP 5 for down-hill condition in Eco Mode" MAP 0x8050B518 RB_Map_S16S16_S16 6553.500 TrqPrpHigh -3276.800 3276.700 FORMAT "%8.3"
 /begin AXIS_DESCR STD_AXIS VehV_v Vel 16 -327.6800 327.6700 FORMAT "%8.4" DEPOSIT ABSOLUTE /end AXIS_DESCR
 /begin AXIS_DESCR STD_AXIS CoVMD_ratVirtMax Prc 16 -400.0000 399.9878 FORMAT "%8.4" DEPOSIT ABSOLUTE /end AXIS_DESCR
/end CHARACTERISTIC
/begin CHARACTERISTIC CoVMD_tqCvtEcoDwnHill6_M "Conversion MAP 6 for down-hill condition in Eco Mode" MAP 0x8050B75C RB_Map_S16S16_S16 6553.500 TrqPrpHigh -3276.800 3276.700 FORMAT "%8.3"
 /begin AXIS_DESCR STD_AXIS VehV_v Vel 16 -327.6800 327.6700 FORMAT "%8.4" DEPOSIT ABSOLUTE /end AXIS_DESCR
 /begin AXIS_DESCR STD_AXIS CoVMD_ratVirtMax Prc 16 -400.0000 399.9878 FORMAT "%8.4" DEPOSIT ABSOLUTE /end AXIS_DESCR
/end CHARACTERISTIC
/begin CHARACTERISTIC CoVMD_tqCvtEcoLModOff_M "Conversion MAP Mode-Off for L condition in Eco Mode" MAP 0x8050B9A0 RB_Map_S16S16_S16 6553.500 TrqPrpHigh -3276.800 3276.700 FORMAT "%8.3"
 /begin AXIS_DESCR STD_AXIS VehV_v Vel 16 -327.6800 327.6700 FORMAT "%8.4" DEPOSIT ABSOLUTE /end AXIS_DESCR
 /begin AXIS_DESCR STD_AXIS CoVMD_ratVirtMax Prc 16 -400.0000 399.9878 FORMAT "%8.4" DEPOSIT ABSOLUTE /end AXIS_DESCR
/end CHARACTERISTIC
/begin CHARACTERISTIC CoVMD_tqCvtEcoLModOn_M "Conversion MAP Mode-On for L condition in Eco Mode" MAP 0x8050BBE4 RB_Map_S16S16_S16 6553.500 TrqPrpHigh -3276.800 3276.700 FORMAT "%8.3"
 /begin AXIS_DESCR STD_AXIS VehV_v Vel 16 -327.6800 327.6700 FORMAT "%8.4" DEPOSIT ABSOLUTE /end AXIS_DESCR
 /begin AXIS_DESCR STD_AXIS CoVMD_ratVirtMax Prc 16 -400.0000 399.9878 FORMAT "%8.4" DEPOSIT ABSOLUTE /end AXIS_DESCR
/end CHARACTERISTIC
/begin CHARACTERISTIC CoVMD_tqCvtEcoLnchD_M "Conversion MAP D for Launch condition in Eco Mode" MAP 0x8050BE28 RB_Map_S16S16_S16 6553.500 TrqPrpHigh -3276.800 3276.700 FORMAT "%8.3"
 /begin AXIS_DESCR STD_AXIS VehV_v Vel 16 -327.6800 327.6700 FORMAT "%8.4" DEPOSIT ABSOLUTE /end AXIS_DESCR
 /begin AXIS_DESCR STD_AXIS CoVMD_ratVirtMax Prc 16 -400.0000 399.9878 FORMAT "%8.4" DEPOSIT ABSOLUTE /end AXIS_DESCR
/end CHARACTERISTIC
/begin CHARACTERISTIC CoVMD_tqCvtEcoLnchE_M "Conversion MAP E for Launch condition in Eco Mode" MAP 0x8050C06C RB_Map_S16S16_S16 6553.500 TrqPrpHigh -3276.800 3276.700 FORMAT "%8.3"
 /begin AXIS_DESCR STD_AXIS VehV_v Vel 16 -327.6800 327.6700 FORMAT "%8.4" DEPOSIT ABSOLUTE /end AXIS_DESCR
 /begin AXIS_DESCR STD_AXIS CoVMD_ratVirtMax Prc 16 -400.0000 399.9878 FORMAT "%8.4" DEPOSIT ABSOLUTE /end AXIS_DESCR
/end CHARACTERISTIC
/begin CHARACTERISTIC CoVMD_tqCvtEcoLnchL_M "Conversion MAP L for Launch condition in Eco Mode" MAP 0x8050C2B0 RB_Map_S16S16_S16 6553.500 TrqPrpHigh -3276.800 3276.700 FORMAT "%8.3"
 /begin AXIS_DESCR STD_AXIS VehV_v Vel 16 -327.6800 327.6700 FORMAT "%8.4" DEPOSIT ABSOLUTE /end AXIS_DESCR
 /begin AXIS_DESCR STD_AXIS CoVMD_ratVirtMax Prc 16 -400.0000 399.9878 FORMAT "%8.4" DEPOSIT ABSOLUTE /end AXIS_DESCR
/end CHARACTERISTIC
/begin CHARACTERISTIC CoVMD_tqCvtEcoLnchS_M "Conversion MAP S for Launch condition in Eco Mode" MAP 0x8050C4F4 RB_Map_S16S16_S16 6553.500 TrqPrpHigh -3276.800 3276.700 FORMAT "%8.3"
 /begin AXIS_DESCR STD_AXIS VehV_v Vel 16 -327.6800 327.6700 FORMAT "%8.4" DEPOSIT ABSOLUTE /end AXIS_DESCR
 /begin AXIS_DESCR STD_AXIS CoVMD_ratVirtMax Prc 16 -400.0000 399.9878 FORMAT "%8.4" DEPOSIT ABSOLUTE /end AXIS_DESCR
/end CHARACTERISTIC
/begin CHARACTERISTIC CoVMD_tqCvtEcoNormD12_M "Conversion MAP D12 for normal condition in Eco Mode" MAP 0x8050C738 RB_Map_S16S16_S16 6553.500 TrqPrpHigh -3276.800 3276.700 FORMAT "%8.3"
 /begin AXIS_DESCR STD_AXIS VehV_v Vel 16 -327.6800 327.6700 FORMAT "%8.4" DEPOSIT ABSOLUTE /end AXIS_DESCR
 /begin AXIS_DESCR STD_AXIS CoVMD_ratVirtMax Prc 16 -400.0000 399.9878 FORMAT "%8.4" DEPOSIT ABSOLUTE /end AXIS_DESCR
/end CHARACTERISTIC
/begin CHARACTERISTIC CoVMD_tqCvtEcoNormD2_M "Conversion MAP D2 for normal condition in Eco Mode" MAP 0x8050C97C RB_Map_S16S16_S16 6553.500 TrqPrpHigh -3276.800 3276.700 FORMAT "%8.3"
 /begin AXIS_DESCR STD_AXIS VehV_v Vel 16 -327.6800 327.6700 FORMAT "%8.4" DEPOSIT ABSOLUTE /end AXIS_DESCR
 /begin AXIS_DESCR STD_AXIS CoVMD_ratVirtMax Prc 16 -400.0000 399.9878 FORMAT "%8.4" DEPOSIT ABSOLUTE /end AXIS_DESCR
/end CHARACTERISTIC
/begin CHARACTERISTIC CoVMD_tqCvtEcoNormD_M "Conversion MAP D for normal condition in Eco Mode" MAP 0x8050CBC0 RB_Map_S16S16_S16 6553.500 TrqPrpHigh -3276.800 3276.700 FORMAT "%8.3"
 /begin AXIS_DESCR STD_AXIS VehV_v Vel 16 -327.6800 327.6700 FORMAT "%8.4" DEPOSIT ABSOLUTE /end AXIS_DESCR
 /begin AXIS_DESCR STD_AXIS CoVMD_ratVirtMax Prc 16 -400.0000 399.9878 FORMAT "%8.4" DEPOSIT ABSOLUTE /end AXIS_DESCR
/end CHARACTERISTIC
/begin CHARACTERISTIC CoVMD_tqCvtEcoNormE12_M "Conversion MAP E12 for normal condition in Eco Mode" MAP 0x8050CE04 RB_Map_S16S16_S16 6553.500 TrqPrpHigh -3276.800 3276.700 FORMAT "%8.3"
 /begin AXIS_DESCR STD_AXIS VehV_v Vel 16 -327.6800 327.6700 FORMAT "%8.4" DEPOSIT ABSOLUTE /end AXIS_DESCR
 /begin AXIS_DESCR STD_AXIS CoVMD_ratVirtMax Prc 16 -400.0000 399.9878 FORMAT "%8.4" DEPOSIT ABSOLUTE /end AXIS_DESCR
/end CHARACTERISTIC
/begin CHARACTERISTIC CoVMD_tqCvtEcoNormE1_M "Conversion MAP E1 for normal condition in Eco Mode" MAP 0x8050D048 RB_Map_S16S16_S16 6553.500 TrqPrpHigh -3276.800 3276.700 FORMAT "%8.3"
 /begin AXIS_DESCR STD_AXIS VehV_v Vel 16 -327.6800 327.6700 FORMAT "%8.4" DEPOSIT ABSOLUTE /end AXIS_DESCR
 /begin AXIS_DESCR STD_AXIS CoVMD_ratVirtMax Prc 16 -400.0000 399.9878 FORMAT "%8.4" DEPOSIT ABSOLUTE /end AXIS_DESCR
/end CHARACTERISTIC
/begin CHARACTERISTIC CoVMD_tqCvtEcoNormE2_M "Conversion MAP E2 for normal condition in Eco Mode" MAP 0x8050D28C RB_Map_S16S16_S16 6553.500 TrqPrpHigh -3276.800 3276.700 FORMAT "%8.3"
 /begin AXIS_DESCR STD_AXIS VehV_v Vel 16 -327.6800 327.6700 FORMAT "%8.4" DEPOSIT ABSOLUTE /end AXIS_DESCR
 /begin AXIS_DESCR STD_AXIS CoVMD_ratVirtMax Prc 16 -400.0000 399.9878 FORMAT "%8.4" DEPOSIT ABSOLUTE /end AXIS_DESCR
/end CHARACTERISTIC
/begin CHARACTERISTIC CoVMD_tqCvtEcoNormE_M "Conversion MAP E for normal condition in Eco Mode" MAP 0x8050D4D0 RB_Map_S16S16_S16 6553.500 TrqPrpHigh -3276.800 3276.700 FORMAT "%8.3"
 /begin AXIS_DESCR STD_AXIS VehV_v Vel 16 -327.6800 327.6700 FORMAT "%8.4" DEPOSIT ABSOLUTE /end AXIS_DESCR
 /begin AXIS_DESCR STD_AXIS CoVMD_ratVirtMax Prc 16 -400.0000 399.9878 FORMAT "%8.4" DEPOSIT ABSOLUTE /end AXIS_DESCR
/end CHARACTERISTIC
/begin CHARACTERISTIC CoVMD_tqCvtEcoNormS0_M "Conversion MAP S0 for normal condition in Eco Mode" MAP 0x8050D714 RB_Map_S16S16_S16 6553.500 TrqPrpHigh -3276.800 3276.700 FORMAT "%8.3"
 /begin AXIS_DESCR STD_AXIS VehV_v Vel 16 -327.6800 327.6700 FORMAT "%8.4" DEPOSIT ABSOLUTE /end AXIS_DESCR
 /begin AXIS_DESCR STD_AXIS CoVMD_ratVirtMax Prc 16 -400.0000 399.9878 FORMAT "%8.4" DEPOSIT ABSOLUTE /end AXIS_DESCR
/end CHARACTERISTIC
/begin CHARACTERISTIC CoVMD_tqCvtEcoNormS1_M "Conversion MAP S1 for normal condition in Eco Mode" MAP 0x8050D958 RB_Map_S16S16_S16 6553.500 TrqPrpHigh -3276.800 3276.700 FORMAT "%8.3"
 /begin AXIS_DESCR STD_AXIS VehV_v Vel 16 -327.6800 327.6700 FORMAT "%8.4" DEPOSIT ABSOLUTE /end AXIS_DESCR
 /begin AXIS_DESCR STD_AXIS CoVMD_ratVirtMax Prc 16 -400.0000 399.9878 FORMAT "%8.4" DEPOSIT ABSOLUTE /end AXIS_DESCR
/end CHARACTERISTIC
/begin CHARACTERISTIC CoVMD_tqCvtEcoNormS2_M "Conversion MAP S2 for normal condition in Eco Mode" MAP 0x8050DB9C RB_Map_S16S16_S16 6553.500 TrqPrpHigh -3276.800 3276.700 FORMAT "%8.3"
 /begin AXIS_DESCR STD_AXIS VehV_v Vel 16 -327.6800 327.6700 FORMAT "%8.4" DEPOSIT ABSOLUTE /end AXIS_DESCR
 /begin AXIS_DESCR STD_AXIS CoVMD_ratVirtMax Prc 16 -400.0000 399.9878 FORMAT "%8.4" DEPOSIT ABSOLUTE /end AXIS_DESCR
/end CHARACTERISTIC
/begin CHARACTERISTIC CoVMD_tqCvtEcoNormSP_M "Conversion MAP SP for normal condition in Eco Mode" MAP 0x8050DDE0 RB_Map_S16S16_S16 6553.500 TrqPrpHigh -3276.800 3276.700 FORMAT "%8.3"
 /begin AXIS_DESCR STD_AXIS VehV_v Vel 16 -327.6800 327.6700 FORMAT "%8.4" DEPOSIT ABSOLUTE /end AXIS_DESCR
 /begin AXIS_DESCR STD_AXIS CoVMD_ratVirtMax Prc 16 -400.0000 399.9878 FORMAT "%8.4" DEPOSIT ABSOLUTE /end AXIS_DESCR
/end CHARACTERISTIC
/begin CHARACTERISTIC CoVMD_tqCvtEcoTipMod1_M "Conversion MAP 1 for Tip condition in Eco Mode" MAP 0x8050E024 RB_Map_S16S16_S16 6553.500 TrqPrpHigh -3276.800 3276.700 FORMAT "%8.3"
 /begin AXIS_DESCR STD_AXIS VehV_v Vel 16 -327.6800 327.6700 FORMAT "%8.4" DEPOSIT ABSOLUTE /end AXIS_DESCR
 /begin AXIS_DESCR STD_AXIS CoVMD_ratVirtMax Prc 16 -400.0000 399.9878 FORMAT "%8.4" DEPOSIT ABSOLUTE /end AXIS_DESCR
/end CHARACTERISTIC
/begin CHARACTERISTIC CoVMD_tqCvtEcoTipMod2_M "Conversion MAP 2 for Tip condition in Eco Mode" MAP 0x8050E268 RB_Map_S16S16_S16 6553.500 TrqPrpHigh -3276.800 3276.700 FORMAT "%8.3"
 /begin AXIS_DESCR STD_AXIS VehV_v Vel 16 -327.6800 327.6700 FORMAT "%8.4" DEPOSIT ABSOLUTE /end AXIS_DESCR
 /begin AXIS_DESCR STD_AXIS CoVMD_ratVirtMax Prc 16 -400.0000 399.9878 FORMAT "%8.4" DEPOSIT ABSOLUTE /end AXIS_DESCR
/end CHARACTERISTIC
/begin CHARACTERISTIC CoVMD_tqCvtEcoTipMod3_M "Conversion MAP 3 for Tip condition in Eco Mode" MAP 0x8050E4AC RB_Map_S16S16_S16 6553.500 TrqPrpHigh -3276.800 3276.700 FORMAT "%8.3"
 /begin AXIS_DESCR STD_AXIS VehV_v Vel 16 -327.6800 327.6700 FORMAT "%8.4" DEPOSIT ABSOLUTE /end AXIS_DESCR
 /begin AXIS_DESCR STD_AXIS CoVMD_ratVirtMax Prc 16 -400.0000 399.9878 FORMAT "%8.4" DEPOSIT ABSOLUTE /end AXIS_DESCR
/end CHARACTERISTIC
/begin CHARACTERISTIC CoVMD_tqCvtEcoTipMod4_M "Conversion MAP 4 for Tip condition in Eco Mode" MAP 0x8050E6F0 RB_Map_S16S16_S16 6553.500 TrqPrpHigh -3276.800 3276.700 FORMAT "%8.3"
 /begin AXIS_DESCR STD_AXIS VehV_v Vel 16 -327.6800 327.6700 FORMAT "%8.4" DEPOSIT ABSOLUTE /end AXIS_DESCR
 /begin AXIS_DESCR STD_AXIS CoVMD_ratVirtMax Prc 16 -400.0000 399.9878 FORMAT "%8.4" DEPOSIT ABSOLUTE /end AXIS_DESCR
/end CHARACTERISTIC
/begin CHARACTERISTIC CoVMD_tqCvtEcoTipMod5_M "Conversion MAP 5 for Tip condition in Eco Mode" MAP 0x8050E934 RB_Map_S16S16_S16 6553.500 TrqPrpHigh -3276.800 3276.700 FORMAT "%8.3"
 /begin AXIS_DESCR STD_AXIS VehV_v Vel 16 -327.6800 327.6700 FORMAT "%8.4" DEPOSIT ABSOLUTE /end AXIS_DESCR
 /begin AXIS_DESCR STD_AXIS CoVMD_ratVirtMax Prc 16 -400.0000 399.9878 FORMAT "%8.4" DEPOSIT ABSOLUTE /end AXIS_DESCR
/end CHARACTERISTIC
/begin CHARACTERISTIC CoVMD_tqCvtEcoTipMod6_M "Conversion MAP 6 for Tip condition in Eco Mode" MAP 0x8050EB78 RB_Map_S16S16_S16 6553.500 TrqPrpHigh -3276.800 3276.700 FORMAT "%8.3"
 /begin AXIS_DESCR STD_AXIS VehV_v Vel 16 -327.6800 327.6700 FORMAT "%8.4" DEPOSIT ABSOLUTE /end AXIS_DESCR
 /begin AXIS_DESCR STD_AXIS CoVMD_ratVirtMax Prc 16 -400.0000 399.9878 FORMAT "%8.4" DEPOSIT ABSOLUTE /end AXIS_DESCR
/end CHARACTERISTIC
/begin CHARACTERISTIC CoVMD_tqCvtEcoTipMod7_M "Conversion MAP 7 for Tip condition in Eco Mode" MAP 0x8050EDBC RB_Map_S16S16_S16 6553.500 TrqPrpHigh -3276.800 3276.700 FORMAT "%8.3"
 /begin AXIS_DESCR STD_AXIS VehV_v Vel 16 -327.6800 327.6700 FORMAT "%8.4" DEPOSIT ABSOLUTE /end AXIS_DESCR
 /begin AXIS_DESCR STD_AXIS CoVMD_ratVirtMax Prc 16 -400.0000 399.9878 FORMAT "%8.4" DEPOSIT ABSOLUTE /end AXIS_DESCR
/end CHARACTERISTIC
/begin CHARACTERISTIC CoVMD_tqCvtNormATMod1_M "Conversion MAP 1 for AT condition in Normal Mode" MAP 0x8050F000 RB_Map_S16S16_S16 6553.500 TrqPrpHigh -3276.800 3276.700 FORMAT "%8.3"
 /begin AXIS_DESCR STD_AXIS VehV_v Vel 16 -327.6800 327.6700 FORMAT "%8.4" DEPOSIT ABSOLUTE /end AXIS_DESCR
 /begin AXIS_DESCR STD_AXIS CoVMD_ratVirtMax Prc 16 -400.0000 399.9878 FORMAT "%8.4" DEPOSIT ABSOLUTE /end AXIS_DESCR
/end CHARACTERISTIC
/begin CHARACTERISTIC CoVMD_tqCvtNormATMod2_M "Conversion MAP 2 for AT condition in Normal Mode" MAP 0x8050F244 RB_Map_S16S16_S16 6553.500 TrqPrpHigh -3276.800 3276.700 FORMAT "%8.3"
 /begin AXIS_DESCR STD_AXIS VehV_v Vel 16 -327.6800 327.6700 FORMAT "%8.4" DEPOSIT ABSOLUTE /end AXIS_DESCR
 /begin AXIS_DESCR STD_AXIS CoVMD_ratVirtMax Prc 16 -400.0000 399.9878 FORMAT "%8.4" DEPOSIT ABSOLUTE /end AXIS_DESCR
/end CHARACTERISTIC
/begin CHARACTERISTIC CoVMD_tqCvtNormATMod3_M "Conversion MAP 3 for AT condition in Normal Mode" MAP 0x8050F488 RB_Map_S16S16_S16 6553.500 TrqPrpHigh -3276.800 3276.700 FORMAT "%8.3"
 /begin AXIS_DESCR STD_AXIS VehV_v Vel 16 -327.6800 327.6700 FORMAT "%8.4" DEPOSIT ABSOLUTE /end AXIS_DESCR
 /begin AXIS_DESCR STD_AXIS CoVMD_ratVirtMax Prc 16 -400.0000 399.9878 FORMAT "%8.4" DEPOSIT ABSOLUTE /end AXIS_DESCR
/end CHARACTERISTIC
/begin CHARACTERISTIC CoVMD_tqCvtNormATMod4_M "Conversion MAP 4 for AT condition in Normal Mode" MAP 0x8050F6CC RB_Map_S16S16_S16 6553.500 TrqPrpHigh -3276.800 3276.700 FORMAT "%8.3"
 /begin AXIS_DESCR STD_AXIS VehV_v Vel 16 -327.6800 327.6700 FORMAT "%8.4" DEPOSIT ABSOLUTE /end AXIS_DESCR
 /begin AXIS_DESCR STD_AXIS CoVMD_ratVirtMax Prc 16 -400.0000 399.9878 FORMAT "%8.4" DEPOSIT ABSOLUTE /end AXIS_DESCR
/end CHARACTERISTIC
/begin CHARACTERISTIC CoVMD_tqCvtNormATMod5_M "Conversion MAP 5 for AT condition in Normal Mode" MAP 0x8050F910 RB_Map_S16S16_S16 6553.500 TrqPrpHigh -3276.800 3276.700 FORMAT "%8.3"
 /begin AXIS_DESCR STD_AXIS VehV_v Vel 16 -327.6800 327.6700 FORMAT "%8.4" DEPOSIT ABSOLUTE /end AXIS_DESCR
 /begin AXIS_DESCR STD_AXIS CoVMD_ratVirtMax Prc 16 -400.0000 399.9878 FORMAT "%8.4" DEPOSIT ABSOLUTE /end AXIS_DESCR
/end CHARACTERISTIC
/begin CHARACTERISTIC CoVMD_tqCvtNormATMod6_M "Conversion MAP 6 for AT condition in Normal Mode" MAP 0x8050FB54 RB_Map_S16S16_S16 6553.500 TrqPrpHigh -3276.800 3276.700 FORMAT "%8.3"
 /begin AXIS_DESCR STD_AXIS VehV_v Vel 16 -327.6800 327.6700 FORMAT "%8.4" DEPOSIT ABSOLUTE /end AXIS_DESCR
 /begin AXIS_DESCR STD_AXIS CoVMD_ratVirtMax Prc 16 -400.0000 399.9878 FORMAT "%8.4" DEPOSIT ABSOLUTE /end AXIS_DESCR
/end CHARACTERISTIC
/begin CHARACTERISTIC CoVMD_tqCvtNormATMod7_M "Conversion MAP 7 for AT condition in Normal Mode" MAP 0x8050FD98 RB_Map_S16S16_S16 6553.500 TrqPrpHigh -3276.800 3276.700 FORMAT "%8.3"
 /begin AXIS_DESCR STD_AXIS VehV_v Vel 16 -327.6800 327.6700 FORMAT "%8.4" DEPOSIT ABSOLUTE /end AXIS_DESCR
 /begin AXIS_DESCR STD_AXIS CoVMD_ratVirtMax Prc 16 -400.0000 399.9878 FORMAT "%8.4" DEPOSIT ABSOLUTE /end AXIS_DESCR
/end CHARACTERISTIC
/begin CHARACTERISTIC CoVMD_tqCvtNormDwnHill1_M "Conversion MAP 1 for down-hill condition in Normal Mode" MAP 0x8050FFDC RB_Map_S16S16_S16 6553.500 TrqPrpHigh -3276.800 3276.700 FORMAT "%8.3"
 /begin AXIS_DESCR STD_AXIS VehV_v Vel 16 -327.6800 327.6700 FORMAT "%8.4" DEPOSIT ABSOLUTE /end AXIS_DESCR
 /begin AXIS_DESCR STD_AXIS CoVMD_ratVirtMax Prc 16 -400.0000 399.9878 FORMAT "%8.4" DEPOSIT ABSOLUTE /end AXIS_DESCR
/end CHARACTERISTIC
/begin CHARACTERISTIC CoVMD_tqCvtNormDwnHill2_M "Conversion MAP 2 for down-hill condition in Normal Mode" MAP 0x80510220 RB_Map_S16S16_S16 6553.500 TrqPrpHigh -3276.800 3276.700 FORMAT "%8.3"
 /begin AXIS_DESCR STD_AXIS VehV_v Vel 16 -327.6800 327.6700 FORMAT "%8.4" DEPOSIT ABSOLUTE /end AXIS_DESCR
 /begin AXIS_DESCR STD_AXIS CoVMD_ratVirtMax Prc 16 -400.0000 399.9878 FORMAT "%8.4" DEPOSIT ABSOLUTE /end AXIS_DESCR
/end CHARACTERISTIC
/begin CHARACTERISTIC CoVMD_tqCvtNormDwnHill3_M "Conversion MAP 3 for down-hill condition in Normal Mode" MAP 0x80510464 RB_Map_S16S16_S16 6553.500 TrqPrpHigh -3276.800 3276.700 FORMAT "%8.3"
 /begin AXIS_DESCR STD_AXIS VehV_v Vel 16 -327.6800 327.6700 FORMAT "%8.4" DEPOSIT ABSOLUTE /end AXIS_DESCR
 /begin AXIS_DESCR STD_AXIS CoVMD_ratVirtMax Prc 16 -400.0000 399.9878 FORMAT "%8.4" DEPOSIT ABSOLUTE /end AXIS_DESCR
/end CHARACTERISTIC
/begin CHARACTERISTIC CoVMD_tqCvtNormDwnHill4_M "Conversion MAP 4 for down-hill condition in Normal Mode" MAP 0x805106A8 RB_Map_S16S16_S16 6553.500 TrqPrpHigh -3276.800 3276.700 FORMAT "%8.3"
 /begin AXIS_DESCR STD_AXIS VehV_v Vel 16 -327.6800 327.6700 FORMAT "%8.4" DEPOSIT ABSOLUTE /end AXIS_DESCR
 /begin AXIS_DESCR STD_AXIS CoVMD_ratVirtMax Prc 16 -400.0000 399.9878 FORMAT "%8.4" DEPOSIT ABSOLUTE /end AXIS_DESCR
/end CHARACTERISTIC
/begin CHARACTERISTIC CoVMD_tqCvtNormDwnHill5_M "Conversion MAP 5 for down-hill condition in Normal Mode" MAP 0x805108EC RB_Map_S16S16_S16 6553.500 TrqPrpHigh -3276.800 3276.700 FORMAT "%8.3"
 /begin AXIS_DESCR STD_AXIS VehV_v Vel 16 -327.6800 327.6700 FORMAT "%8.4" DEPOSIT ABSOLUTE /end AXIS_DESCR
 /begin AXIS_DESCR STD_AXIS CoVMD_ratVirtMax Prc 16 -400.0000 399.9878 FORMAT "%8.4" DEPOSIT ABSOLUTE /end AXIS_DESCR
/end CHARACTERISTIC
/begin CHARACTERISTIC CoVMD_tqCvtNormDwnHill6_M "Conversion MAP 6 for down-hill condition in Normal Mode" MAP 0x80510B30 RB_Map_S16S16_S16 6553.500 TrqPrpHigh -3276.800 3276.700 FORMAT "%8.3"
 /begin AXIS_DESCR STD_AXIS VehV_v Vel 16 -327.6800 327.6700 FORMAT "%8.4" DEPOSIT ABSOLUTE /end AXIS_DESCR
 /begin AXIS_DESCR STD_AXIS CoVMD_ratVirtMax Prc 16 -400.0000 399.9878 FORMAT "%8.4" DEPOSIT ABSOLUTE /end AXIS_DESCR
/end CHARACTERISTIC
/begin CHARACTERISTIC CoVMD_tqCvtNormLModOff_M "Conversion MAP Mode-On for L condition in Normal Mode" MAP 0x80510D74 RB_Map_S16S16_S16 6553.500 TrqPrpHigh -3276.800 3276.700 FORMAT "%8.3"
 /begin AXIS_DESCR STD_AXIS VehV_v Vel 16 -327.6800 327.6700 FORMAT "%8.4" DEPOSIT ABSOLUTE /end AXIS_DESCR
 /begin AXIS_DESCR STD_AXIS CoVMD_ratVirtMax Prc 16 -400.0000 399.9878 FORMAT "%8.4" DEPOSIT ABSOLUTE /end AXIS_DESCR
/end CHARACTERISTIC
/begin CHARACTERISTIC CoVMD_tqCvtNormLModOn_M "Conversion MAP Mode-Off for L condition in Normal Mode" MAP 0x80510FB8 RB_Map_S16S16_S16 6553.500 TrqPrpHigh -3276.800 3276.700 FORMAT "%8.3"
 /begin AXIS_DESCR STD_AXIS VehV_v Vel 16 -327.6800 327.6700 FORMAT "%8.4" DEPOSIT ABSOLUTE /end AXIS_DESCR
 /begin AXIS_DESCR STD_AXIS CoVMD_ratVirtMax Prc 16 -400.0000 399.9878 FORMAT "%8.4" DEPOSIT ABSOLUTE /end AXIS_DESCR
/end CHARACTERISTIC
/begin CHARACTERISTIC CoVMD_tqCvtNormLnchD_M "Conversion MAP D for Launch condition in Normal Mode" MAP 0x805111FC RB_Map_S16S16_S16 6553.500 TrqPrpHigh -3276.800 3276.700 FORMAT "%8.3"
 /begin AXIS_DESCR STD_AXIS VehV_v Vel 16 -327.6800 327.6700 FORMAT "%8.4" DEPOSIT ABSOLUTE /end AXIS_DESCR
 /begin AXIS_DESCR STD_AXIS CoVMD_ratVirtMax Prc 16 -400.0000 399.9878 FORMAT "%8.4" DEPOSIT ABSOLUTE /end AXIS_DESCR
/end CHARACTERISTIC
/begin CHARACTERISTIC CoVMD_tqCvtNormLnchE_M "Conversion MAP E for Launch condition in Normal Mode" MAP 0x80511440 RB_Map_S16S16_S16 6553.500 TrqPrpHigh -3276.800 3276.700 FORMAT "%8.3"
 /begin AXIS_DESCR STD_AXIS VehV_v Vel 16 -327.6800 327.6700 FORMAT "%8.4" DEPOSIT ABSOLUTE /end AXIS_DESCR
 /begin AXIS_DESCR STD_AXIS CoVMD_ratVirtMax Prc 16 -400.0000 399.9878 FORMAT "%8.4" DEPOSIT ABSOLUTE /end AXIS_DESCR
/end CHARACTERISTIC
/begin CHARACTERISTIC CoVMD_tqCvtNormLnchL_M "Conversion MAP L for Launch condition in Normal Mode" MAP 0x80511684 RB_Map_S16S16_S16 6553.500 TrqPrpHigh -3276.800 3276.700 FORMAT "%8.3"
 /begin AXIS_DESCR STD_AXIS VehV_v Vel 16 -327.6800 327.6700 FORMAT "%8.4" DEPOSIT ABSOLUTE /end AXIS_DESCR
 /begin AXIS_DESCR STD_AXIS CoVMD_ratVirtMax Prc 16 -400.0000 399.9878 FORMAT "%8.4" DEPOSIT ABSOLUTE /end AXIS_DESCR
/end CHARACTERISTIC
/begin CHARACTERISTIC CoVMD_tqCvtNormLnchS_M "Conversion MAP S for Launch condition in Normal Mode" MAP 0x805118C8 RB_Map_S16S16_S16 6553.500 TrqPrpHigh -3276.800 3276.700 FORMAT "%8.3"
 /begin AXIS_DESCR STD_AXIS VehV_v Vel 16 -327.6800 327.6700 FORMAT "%8.4" DEPOSIT ABSOLUTE /end AXIS_DESCR
 /begin AXIS_DESCR STD_AXIS CoVMD_ratVirtMax Prc 16 -400.0000 399.9878 FORMAT "%8.4" DEPOSIT ABSOLUTE /end AXIS_DESCR
/end CHARACTERISTIC
/begin CHARACTERISTIC CoVMD_tqCvtNormNormD12_M "Conversion MAP D12 for normal condition in Normal Mode" MAP 0x80511B0C RB_Map_S16S16_S16 6553.500 TrqPrpHigh -3276.800 3276.700 FORMAT "%8.3"
 /begin AXIS_DESCR STD_AXIS VehV_v Vel 16 -327.6800 327.6700 FORMAT "%8.4" DEPOSIT ABSOLUTE /end AXIS_DESCR
 /begin AXIS_DESCR STD_AXIS CoVMD_ratVirtMax Prc 16 -400.0000 399.9878 FORMAT "%8.4" DEPOSIT ABSOLUTE /end AXIS_DESCR
/end CHARACTERISTIC
/begin CHARACTERISTIC CoVMD_tqCvtNormNormD2_M "Conversion MAP D2 for normal condition in Normal Mode" MAP 0x80511D50 RB_Map_S16S16_S16 6553.500 TrqPrpHigh -3276.800 3276.700 FORMAT "%8.3"
 /begin AXIS_DESCR STD_AXIS VehV_v Vel 16 -327.6800 327.6700 FORMAT "%8.4" DEPOSIT ABSOLUTE /end AXIS_DESCR
 /begin AXIS_DESCR STD_AXIS CoVMD_ratVirtMax Prc 16 -400.0000 399.9878 FORMAT "%8.4" DEPOSIT ABSOLUTE /end AXIS_DESCR
/end CHARACTERISTIC
/begin CHARACTERISTIC CoVMD_tqCvtNormNormD_M "Conversion MAP D for normal condition in Normal Mode" MAP 0x80511F94 RB_Map_S16S16_S16 6553.500 TrqPrpHigh -3276.800 3276.700 FORMAT "%8.3"
 /begin AXIS_DESCR STD_AXIS VehV_v Vel 16 -327.6800 327.6700 FORMAT "%8.4" DEPOSIT ABSOLUTE /end AXIS_DESCR
 /begin AXIS_DESCR STD_AXIS CoVMD_ratVirtMax Prc 16 -400.0000 399.9878 FORMAT "%8.4" DEPOSIT ABSOLUTE /end AXIS_DESCR
/end CHARACTERISTIC
/begin CHARACTERISTIC CoVMD_tqCvtNormNormE12_M "Conversion MAP E12 for normal condition in Normal Mode" MAP 0x805121D8 RB_Map_S16S16_S16 6553.500 TrqPrpHigh -3276.800 3276.700 FORMAT "%8.3"
 /begin AXIS_DESCR STD_AXIS VehV_v Vel 16 -327.6800 327.6700 FORMAT "%8.4" DEPOSIT ABSOLUTE /end AXIS_DESCR
 /begin AXIS_DESCR STD_AXIS CoVMD_ratVirtMax Prc 16 -400.0000 399.9878 FORMAT "%8.4" DEPOSIT ABSOLUTE /end AXIS_DESCR
/end CHARACTERISTIC
/begin CHARACTERISTIC CoVMD_tqCvtNormNormE1_M "Conversion MAP E1 for normal condition in Normal Mode" MAP 0x8051241C RB_Map_S16S16_S16 6553.500 TrqPrpHigh -3276.800 3276.700 FORMAT "%8.3"
 /begin AXIS_DESCR STD_AXIS VehV_v Vel 16 -327.6800 327.6700 FORMAT "%8.4" DEPOSIT ABSOLUTE /end AXIS_DESCR
 /begin AXIS_DESCR STD_AXIS CoVMD_ratVirtMax Prc 16 -400.0000 399.9878 FORMAT "%8.4" DEPOSIT ABSOLUTE /end AXIS_DESCR
/end CHARACTERISTIC
/begin CHARACTERISTIC CoVMD_tqCvtNormNormE2_M "Conversion MAP E2 for normal condition in Normal Mode" MAP 0x80512660 RB_Map_S16S16_S16 6553.500 TrqPrpHigh -3276.800 3276.700 FORMAT "%8.3"
 /begin AXIS_DESCR STD_AXIS VehV_v Vel 16 -327.6800 327.6700 FORMAT "%8.4" DEPOSIT ABSOLUTE /end AXIS_DESCR
 /begin AXIS_DESCR STD_AXIS CoVMD_ratVirtMax Prc 16 -400.0000 399.9878 FORMAT "%8.4" DEPOSIT ABSOLUTE /end AXIS_DESCR
/end CHARACTERISTIC
/begin CHARACTERISTIC CoVMD_tqCvtNormNormE_M "Conversion MAP E for normal condition in Normal Mode" MAP 0x805128A4 RB_Map_S16S16_S16 6553.500 TrqPrpHigh -3276.800 3276.700 FORMAT "%8.3"
 /begin AXIS_DESCR STD_AXIS VehV_v Vel 16 -327.6800 327.6700 FORMAT "%8.4" DEPOSIT ABSOLUTE /end AXIS_DESCR
 /begin AXIS_DESCR STD_AXIS CoVMD_ratVirtMax Prc 16 -400.0000 399.9878 FORMAT "%8.4" DEPOSIT ABSOLUTE /end AXIS_DESCR
/end CHARACTERISTIC
/begin CHARACTERISTIC CoVMD_tqCvtNormNormS0_M "Conversion MAP S0 for normal condition in Normal Mode" MAP 0x80512AE8 RB_Map_S16S16_S16 6553.500 TrqPrpHigh -3276.800 3276.700 FORMAT "%8.3"
 /begin AXIS_DESCR STD_AXIS VehV_v Vel 16 -327.6800 327.6700 FORMAT "%8.4" DEPOSIT ABSOLUTE /end AXIS_DESCR
 /begin AXIS_DESCR STD_AXIS CoVMD_ratVirtMax Prc 16 -400.0000 399.9878 FORMAT "%8.4" DEPOSIT ABSOLUTE /end AXIS_DESCR
/end CHARACTERISTIC
/begin CHARACTERISTIC CoVMD_tqCvtNormNormS1_M "Conversion MAP S1 for normal condition in Normal Mode" MAP 0x80512D2C RB_Map_S16S16_S16 6553.500 TrqPrpHigh -3276.800 3276.700 FORMAT "%8.3"
 /begin AXIS_DESCR STD_AXIS VehV_v Vel 16 -327.6800 327.6700 FORMAT "%8.4" DEPOSIT ABSOLUTE /end AXIS_DESCR
 /begin AXIS_DESCR STD_AXIS CoVMD_ratVirtMax Prc 16 -400.0000 399.9878 FORMAT "%8.4" DEPOSIT ABSOLUTE /end AXIS_DESCR
/end CHARACTERISTIC
/begin CHARACTERISTIC CoVMD_tqCvtNormNormS2_M "Conversion MAP S2 for normal condition in Normal Mode" MAP 0x80512F70 RB_Map_S16S16_S16 6553.500 TrqPrpHigh -3276.800 3276.700 FORMAT "%8.3"
 /begin AXIS_DESCR STD_AXIS VehV_v Vel 16 -327.6800 327.6700 FORMAT "%8.4" DEPOSIT ABSOLUTE /end AXIS_DESCR
 /begin AXIS_DESCR STD_AXIS CoVMD_ratVirtMax Prc 16 -400.0000 399.9878 FORMAT "%8.4" DEPOSIT ABSOLUTE /end AXIS_DESCR
/end CHARACTERISTIC
/begin CHARACTERISTIC CoVMD_tqCvtNormNormSP_M "Conversion MAP SP for normal condition in Normal Mode" MAP 0x805131B4 RB_Map_S16S16_S16 6553.500 TrqPrpHigh -3276.800 3276.700 FORMAT "%8.3"
 /begin AXIS_DESCR STD_AXIS VehV_v Vel 16 -327.6800 327.6700 FORMAT "%8.4" DEPOSIT ABSOLUTE /end AXIS_DESCR
 /begin AXIS_DESCR STD_AXIS CoVMD_ratVirtMax Prc 16 -400.0000 399.9878 FORMAT "%8.4" DEPOSIT ABSOLUTE /end AXIS_DESCR
/end CHARACTERISTIC
/begin CHARACTERISTIC CoVMD_tqCvtNormTipMod1_M "Conversion MAP 1 for Tip condition in Normal Mode" MAP 0x805133F8 RB_Map_S16S16_S16 6553.500 TrqPrpHigh -3276.800 3276.700 FORMAT "%8.3"
 /begin AXIS_DESCR STD_AXIS VehV_v Vel 16 -327.6800 327.6700 FORMAT "%8.4" DEPOSIT ABSOLUTE /end AXIS_DESCR
 /begin AXIS_DESCR STD_AXIS CoVMD_ratVirtMax Prc 16 -400.0000 399.9878 FORMAT "%8.4" DEPOSIT ABSOLUTE /end AXIS_DESCR
/end CHARACTERISTIC
/begin CHARACTERISTIC CoVMD_tqCvtNormTipMod2_M "Conversion MAP 2 for Tip condition in Normal Mode" MAP 0x8051363C RB_Map_S16S16_S16 6553.500 TrqPrpHigh -3276.800 3276.700 FORMAT "%8.3"
 /begin AXIS_DESCR STD_AXIS VehV_v Vel 16 -327.6800 327.6700 FORMAT "%8.4" DEPOSIT ABSOLUTE /end AXIS_DESCR
 /begin AXIS_DESCR STD_AXIS CoVMD_ratVirtMax Prc 16 -400.0000 399.9878 FORMAT "%8.4" DEPOSIT ABSOLUTE /end AXIS_DESCR
/end CHARACTERISTIC
/begin CHARACTERISTIC CoVMD_tqCvtNormTipMod3_M "Conversion MAP 3 for Tip condition in Normal Mode" MAP 0x80513880 RB_Map_S16S16_S16 6553.500 TrqPrpHigh -3276.800 3276.700 FORMAT "%8.3"
 /begin AXIS_DESCR STD_AXIS VehV_v Vel 16 -327.6800 327.6700 FORMAT "%8.4" DEPOSIT ABSOLUTE /end AXIS_DESCR
 /begin AXIS_DESCR STD_AXIS CoVMD_ratVirtMax Prc 16 -400.0000 399.9878 FORMAT "%8.4" DEPOSIT ABSOLUTE /end AXIS_DESCR
/end CHARACTERISTIC
/begin CHARACTERISTIC CoVMD_tqCvtNormTipMod4_M "Conversion MAP 4 for Tip condition in Normal Mode" MAP 0x80513AC4 RB_Map_S16S16_S16 6553.500 TrqPrpHigh -3276.800 3276.700 FORMAT "%8.3"
 /begin AXIS_DESCR STD_AXIS VehV_v Vel 16 -327.6800 327.6700 FORMAT "%8.4" DEPOSIT ABSOLUTE /end AXIS_DESCR
 /begin AXIS_DESCR STD_AXIS CoVMD_ratVirtMax Prc 16 -400.0000 399.9878 FORMAT "%8.4" DEPOSIT ABSOLUTE /end AXIS_DESCR
/end CHARACTERISTIC
/begin CHARACTERISTIC CoVMD_tqCvtNormTipMod5_M "Conversion MAP 5 for Tip condition in Normal Mode" MAP 0x80513D08 RB_Map_S16S16_S16 6553.500 TrqPrpHigh -3276.800 3276.700 FORMAT "%8.3"
 /begin AXIS_DESCR STD_AXIS VehV_v Vel 16 -327.6800 327.6700 FORMAT "%8.4" DEPOSIT ABSOLUTE /end AXIS_DESCR
 /begin AXIS_DESCR STD_AXIS CoVMD_ratVirtMax Prc 16 -400.0000 399.9878 FORMAT "%8.4" DEPOSIT ABSOLUTE /end AXIS_DESCR
/end CHARACTERISTIC
/begin CHARACTERISTIC CoVMD_tqCvtNormTipMod6_M "Conversion MAP 6 for Tip condition in Normal Mode" MAP 0x80513F4C RB_Map_S16S16_S16 6553.500 TrqPrpHigh -3276.800 3276.700 FORMAT "%8.3"
 /begin AXIS_DESCR STD_AXIS VehV_v Vel 16 -327.6800 327.6700 FORMAT "%8.4" DEPOSIT ABSOLUTE /end AXIS_DESCR
 /begin AXIS_DESCR STD_AXIS CoVMD_ratVirtMax Prc 16 -400.0000 399.9878 FORMAT "%8.4" DEPOSIT ABSOLUTE /end AXIS_DESCR
/end CHARACTERISTIC
/begin CHARACTERISTIC CoVMD_tqCvtNormTipMod7_M "Conversion MAP 7 for Tip condition in Normal Mode" MAP 0x80514190 RB_Map_S16S16_S16 6553.500 TrqPrpHigh -3276.800 3276.700 FORMAT "%8.3"
 /begin AXIS_DESCR STD_AXIS VehV_v Vel 16 -327.6800 327.6700 FORMAT "%8.4" DEPOSIT ABSOLUTE /end AXIS_DESCR
 /begin AXIS_DESCR STD_AXIS CoVMD_ratVirtMax Prc 16 -400.0000 399.9878 FORMAT "%8.4" DEPOSIT ABSOLUTE /end AXIS_DESCR
/end CHARACTERISTIC
/begin CHARACTERISTIC CoVMD_tqIDASFailOffs_C "Offset value is used to determine the torque threshold for IDAS failure detection" VALUE 0x805143D4 RB_Val_Ws16 65535.00 RBPtCel_tq_1p0_1 -32768.00 32767.00 FORMAT "%8.2" /end CHARACTERISTIC
/begin CHARACTERISTIC CoVMD_tqIDASTarThd_C "Threshold of IDAS target torque to detect torque failure" VALUE 0x805143D6 RB_Val_Ws16 65535.00 TrqPerSec -32768.00 32767.00 FORMAT "%8.2" /end CHARACTERISTIC
/begin CHARACTERISTIC CoVMD_TrqDesCoord_CW "codeword for CoVMD_TrqDesCoord" VALUE 0x805143E4 RB_Val_Wu8 255.0 OneToOne 0.00 255.0 FORMAT "%5.1" /end CHARACTERISTIC
/begin CHARACTERISTIC CoVMD_trqThresCrCtlL_C "Lower threshold for CrCtl Status" VALUE 0x805143E8 RB_Val_Ws32 429496729.500 TrqPrpHigh -214748364.800 214748364.700 FORMAT "%13.3" /end CHARACTERISTIC
/begin CHARACTERISTIC CoVMD_trqThresCrCtlR_C "Upper threshold for CrCtl Status" VALUE 0x805143EC RB_Val_Ws32 429496729.500 TrqPrpHigh -214748364.800 214748364.700 FORMAT "%13.3" /end CHARACTERISTIC
/begin CHARACTERISTIC CoVMD_trqThresCtOffLo_C "Lower threshold for fuel cut off" VALUE 0x805143D8 RB_Val_Ws32 429496729.500 TrqPrpHigh -214748364.800 214748364.700 FORMAT "%13.3" /end CHARACTERISTIC
/begin CHARACTERISTIC CoVMD_trqThresCtOffUp_C "Upper threshold for fuel cut off" VALUE 0x805143DC RB_Val_Ws32 429496729.500 TrqPrpHigh -214748364.800 214748364.700 FORMAT "%13.3" /end CHARACTERISTIC
/begin CHARACTERISTIC CoVMD_trqThresLLimL_C "Lower threshold for LLim Status" VALUE 0x805143F0 RB_Val_Ws32 429496729.500 TrqPrpHigh -214748364.800 214748364.700 FORMAT "%13.3" /end CHARACTERISTIC
/begin CHARACTERISTIC CoVMD_trqThresLLimR_C "Upper threshold for LLim Status" VALUE 0x805143F4 RB_Val_Ws32 429496729.500 TrqPrpHigh -214748364.800 214748364.700 FORMAT "%13.3" /end CHARACTERISTIC
/begin CHARACTERISTIC CoVMD_vIDASFailDetn_C "Vehicle speed threshold for IDAS failure detection" VALUE 0x805143E0 RB_Val_Ws16 655.3500 Vel -327.6800 327.6700 FORMAT "%8.4" /end CHARACTERISTIC
/begin CHARACTERISTIC CoVOM_bClthPTRls_C "0= start release condition only with engaged neutral gear 1= start release condition with pressed clutch or engaged neutral gear" VALUE 0x805143F8 RB_Val_Wu8 1.00000000000 B_TRUE 0.00 1.00000000000 FORMAT "%13.11" /end CHARACTERISTIC
/begin CHARACTERISTIC CoVOM_bRstvXMaxCOM_C "Calibration parameter to decide whether the maximum reached velocity threshold should be reset in case of ""Change Of Mind""" VALUE 0x805143F9 RB_Val_Wu8 1.00000000000 B_TRUE 0.00 1.00000000000 FORMAT "%13.11" /end CHARACTERISTIC
/begin CHARACTERISTIC CoVOM_bSSEEngStrtWoFrstStrt_C "Switch to allows engine start trough coordinator even if first start was not carried out" VALUE 0x805143FA RB_Val_Wu8 1.00000000000 B_TRUE 0.00 1.00000000000 FORMAT "%13.11" /end CHARACTERISTIC
/begin CHARACTERISTIC CoVOM_bSSEEngStrtWoStSp_C "Switch to allow engine start with coordinator even if the stop was not due to coordinator" VALUE 0x805143FB RB_Val_Wu8 1.00000000000 B_TRUE 0.00 1.00000000000 FORMAT "%13.11" /end CHARACTERISTIC
/begin CHARACTERISTIC CoVOM_bSSERstrtEng_C "Calibration to enable restart engine request" VALUE 0x805143FC RB_Val_Wu8 1.00000000000 B_TRUE 0.00 1.00000000000 FORMAT "%13.11" /end CHARACTERISTIC
/begin CHARACTERISTIC CoVOM_bSSEUIStrtReq_C "A deactivated Start/Stop switch should request a engine start immediately depending on this parameter." VALUE 0x805143FD RB_Val_Wu8 1.00000000000 B_TRUE 0.00 1.00000000000 FORMAT "%13.11" /end CHARACTERISTIC
/begin CHARACTERISTIC COVOM_cntTotRlyOperMax_C "Maximum number of starter relay operations permitted in order to allow start-stop operation" VALUE 0x80514400 RB_Val_Wu32 4294967295.00 OneToOne 0.00 4294967295.00 FORMAT "%13.2" /end CHARACTERISTIC
/begin CHARACTERISTIC CoVOM_ctStopEngMax_C "Maximum engine stop counter for engine stop release" VALUE 0x80514404 RB_Val_Wu32 4294967295.00 OneToOne 0.00 4294967295.00 FORMAT "%13.2" /end CHARACTERISTIC
/begin CHARACTERISTIC CoVOM_flgCoMEna_C "this is to indicate CoM enable" VALUE 0x80514408 RB_Val_Wu8 1.00000000000 B_TRUE 0.00 1.00000000000 FORMAT "%13.11" /end CHARACTERISTIC
/begin CHARACTERISTIC CoVOM_flgEngRunDetCoM_C "Flag to enable engine state detection based on change of mind status" VALUE 0x80514409 RB_Val_Wu8 1.00000000000 B_TRUE 0.00 1.00000000000 FORMAT "%13.11" /end CHARACTERISTIC
/begin CHARACTERISTIC CoVOM_flgStrtrChkDi_C "Calibration to disable crank abort during re-start only when starter is engaged" VALUE 0x8051440A RB_Val_Wu8 1.00000000000 B_TRUE 0.00 1.00000000000 FORMAT "%13.11" /end CHARACTERISTIC
/begin CHARACTERISTIC CoVOM_flgSwtBrkHldAvl_C "Calibration switch to enable Brake hold feature" VALUE 0x8051440B RB_Val_Wu8 1.00000000000 B_TRUE 0.00 1.00000000000 FORMAT "%13.11" /end CHARACTERISTIC
/begin CHARACTERISTIC CoVOM_flgSwtEngSpdChkEna_C "Switch to consider engine speed for determining engine stall condition" VALUE 0x8051440C RB_Val_Wu8 1.00000000000 B_TRUE 0.00 1.00000000000 FORMAT "%13.11" /end CHARACTERISTIC
/begin CHARACTERISTIC CoVOM_flgSwtLSFAvl_C "Calibration switch to enable LSF feature" VALUE 0x8051440D RB_Val_Wu8 1.00000000000 B_TRUE 0.00 1.00000000000 FORMAT "%13.11" /end CHARACTERISTIC
/begin CHARACTERISTIC CoVOM_flgSwtStrtReqBrkFldP_C "Switch for starter request by Brake fluid pressure" VALUE 0x8051440E RB_Val_Wu8 1.00000000000 B_TRUE 0.00 1.00000000000 FORMAT "%13.11" /end CHARACTERISTIC
/begin CHARACTERISTIC CoVOM_nEngRstrtEngStallThd_C "Engine speed threshold for determining engine stall condition" VALUE 0x80514410 RB_Val_Ws16 32767.50 EngN -16384.00 16383.50 FORMAT "%8.2" /end CHARACTERISTIC
/begin CHARACTERISTIC CoVOM_nEngStopDelta_C "Engine speed delta threshold for Idle Stop release" VALUE 0x80514412 RB_Val_Ws16 32767.50 EngN -16384.00 16383.50 FORMAT "%8.2" /end CHARACTERISTIC
/begin CHARACTERISTIC CoVOM_nEngStsDetnBefIdleSpd_C "Engine speed to detect engine status before reach to idle speed." VALUE 0x80514414 RB_Val_Ws16 32767.50 EngN -16384.00 16383.50 FORMAT "%8.2" /end CHARACTERISTIC
/begin CHARACTERISTIC CoVOM_numEngStrtAbrtMax_C "Maximum allowed number of start abortions" VALUE 0x80514416 RB_Val_Ws16 32767.00 OneToOne 0.00 32767.00 FORMAT "%8.2" EXTENDED_LIMITS -32768.00 32767.00 /end CHARACTERISTIC
/begin CHARACTERISTIC COVOM_pAtmPThdDelta_C "Delta value of threshold for enviromental pressure check for determination of high altitude condition" VALUE 0x80514418 RB_Val_Ws16 32767.00 Pres_hPa 0.00 32767.00 FORMAT "%8.2" EXTENDED_LIMITS -32768.00 32767.00 /end CHARACTERISTIC
/begin CHARACTERISTIC COVOM_pAtmPThd_C "Environmental pressure threshold for determination of high altitude condition" VALUE 0x8051441A RB_Val_Ws16 32767.00 Pres_hPa 0.00 32767.00 FORMAT "%8.2" EXTENDED_LIMITS -32768.00 32767.00 /end CHARACTERISTIC
/begin CHARACTERISTIC CoVOM_pRelChgThd_C "Offset calibration for judgment of negative pressure change in the vacuum chamber after ISAB comes into operation and give a start request" VALUE 0x8051441C RB_Val_Ws16 65535.00 Pres_hPa -32768.00 32767.00 FORMAT "%8.2" /end CHARACTERISTIC
/begin CHARACTERISTIC CoVOM_rAPPHysHi_C "Accelaration pedal position upper hystheresis threshold for a stop request" VALUE 0x8051441E RB_Val_Ws16 799.9878 Prc -400.0000 399.9878 FORMAT "%8.4" /end CHARACTERISTIC
/begin CHARACTERISTIC CoVOM_rAPPHysLo_C "Accelarator pedal position lower hystheresis threshold for a stop request." VALUE 0x80514420 RB_Val_Ws16 799.9878 Prc -400.0000 399.9878 FORMAT "%8.4" /end CHARACTERISTIC
/begin CHARACTERISTIC CoVOM_rAPPOnThres_C "Ratio from which accelerator pedal pressed is detected for indication of request for restart of starter during Level2 starter inhibition." VALUE 0x80514422 RB_Val_Ws16 799.9878 Prc -400.0000 399.9878 FORMAT "%8.4" /end CHARACTERISTIC
/begin CHARACTERISTIC CoVOM_rAPPStrtMin_C "Acceleration pedal ratio that leads to engine start" VALUE 0x80514424 RB_Val_Ws16 799.9878 Prc -400.0000 399.9878 FORMAT "%8.4" /end CHARACTERISTIC
/begin CHARACTERISTIC CoVOM_stAutoRstrtReqMsk_C "Parameter to enable status of auto restart request" VALUE 0x80514428 RB_Val_Wu32 4294967295.00 OneToOne 0.00 4294967295.00 FORMAT "%13.2" /end CHARACTERISTIC
/begin CHARACTERISTIC CoVOM_stClthSigSel_C "Clutch signal selection calibration based on the sensors present" VALUE 0x8051442C RB_Val_Wu8 1.00000000000 B_TRUE 0.00 1.00000000000 FORMAT "%13.11" /end CHARACTERISTIC
/begin CHARACTERISTIC CoVOM_stDrvMod1_C "Drive mode 1 in which idle start-stop function is disabled" VALUE 0x8051442D RB_Val_Wu8 255.0 OneToOne 0.00 255.0 FORMAT "%5.1" /end CHARACTERISTIC
/begin CHARACTERISTIC CoVOM_stDrvMod2_C "Drive mode 2 in which idle start-stop function is disabled" VALUE 0x8051442E RB_Val_Wu8 255.0 OneToOne 0.00 255.0 FORMAT "%5.1" /end CHARACTERISTIC
/begin CHARACTERISTIC CoVOM_stDrvMod3_C "Drive mode 3 in which idle start-stop function is disabled" VALUE 0x8051442F RB_Val_Wu8 255.0 OneToOne 0.00 255.0 FORMAT "%5.1" /end CHARACTERISTIC
/begin CHARACTERISTIC CoVOM_stEngStallReasMask_C "Mask for engine stall reason" VALUE 0x80514430 RB_Val_Wu8 255.0 OneToOne 0.00 255.0 FORMAT "%5.1" /end CHARACTERISTIC
/begin CHARACTERISTIC CoVOM_stIgrBrkPedStrtReq_C "Ignore Brake Pedal from Start request" VALUE 0x80514431 RB_Val_Wu8 1.00000000000 B_TRUE 0.00 1.00000000000 FORMAT "%13.11" /end CHARACTERISTIC
/begin CHARACTERISTIC CoVOM_stISGoStbMask_C "Mask for standby condition" VALUE 0x80514434 RB_Val_Wu32 4294967295.00 OneToOne 0.00 4294967295.00 FORMAT "%13.2" /end CHARACTERISTIC
/begin CHARACTERISTIC CoVOM_stStopRelsMask_C "Stop release mask" VALUE 0x80514438 RB_Val_Wu32 4294967295.00 OneToOne 0.00 4294967295.00 FORMAT "%13.2" /end CHARACTERISTIC
/begin CHARACTERISTIC CoVOM_stStopReqMask_C "Bit mask for Idle stop request condition." VALUE 0x8051443C RB_Val_Wu32 4294967295.00 OneToOne 0.00 4294967295.00 FORMAT "%13.2" /end CHARACTERISTIC
/begin CHARACTERISTIC CoVOM_stStrtEnaMask_C "Start enable mask" VALUE 0x80514440 RB_Val_Wu32 4294967295.00 OneToOne 0.00 4294967295.00 FORMAT "%13.2" /end CHARACTERISTIC
/begin CHARACTERISTIC CoVOM_stStrtReqMask_C "Start request mask" VALUE 0x80514444 RB_Val_Wu32 4294967295.00 OneToOne 0.00 4294967295.00 FORMAT "%13.2" /end CHARACTERISTIC
/begin CHARACTERISTIC CoVOM_stSysOffRelsMask_C "System off release mask" VALUE 0x80514448 RB_Val_Wu8 255.0 OneToOne 0.00 255.0 FORMAT "%5.1" /end CHARACTERISTIC
/begin CHARACTERISTIC CoVOM_stSysOffTrigMask_C "System off trigger mask calibration" VALUE 0x8051444A RB_Val_Wu16 65535.00 OneToOne 0.00 65535.00 FORMAT "%8.2" /end CHARACTERISTIC
/begin CHARACTERISTIC CoVOM_stVehMktSelSwt_C "Vehicle market selection switch" VALUE 0x8051444C RB_Val_Wu8 1.00000000000 B_TRUE 0.00 1.00000000000 FORMAT "%13.11" /end CHARACTERISTIC
/begin CHARACTERISTIC CoVOM_swtACType_C "Calibration to select AC logic or Defogger logic." VALUE 0x8051444D RB_Val_Wu8 1.00000000000 B_TRUE 0.00 1.00000000000 FORMAT "%13.11" /end CHARACTERISTIC
/begin CHARACTERISTIC CoVOM_swtCluBasdRstrtRels_C "Switch to select clutch based restart release" VALUE 0x8051444E RB_Val_Wu8 1.00000000000 B_TRUE 0.00 1.00000000000 FORMAT "%13.11" /end CHARACTERISTIC
/begin CHARACTERISTIC CoVOM_swtDrvModSeln_C "Drive mode selection between variant MT and AT,CVT" VALUE 0x8051444F RB_Val_Wu8 1.00000000000 B_TRUE 0.00 1.00000000000 FORMAT "%13.11" /end CHARACTERISTIC
/begin CHARACTERISTIC CoVOM_swtSSEEna_C "Application to enable or disable the StartStop coordinator" VALUE 0x80514450 RB_Val_Wu8 255.0 OneToOne 0.00 255.0 FORMAT "%5.1" /end CHARACTERISTIC
/begin CHARACTERISTIC CoVOM_swtTrigCamsftRefEna_C "Calibration switch to enable the trigger camshaft to the reference position calculation" VALUE 0x80514451 RB_Val_Wu8 1.00000000000 B_TRUE 0.00 1.00000000000 FORMAT "%13.11" /end CHARACTERISTIC
/begin CHARACTERISTIC CoVOM_tiACISSInhbReqDeb_C "Debounce Delay METER Enable." VALUE 0x80514452 RB_Val_Ws16 655350.0 TimeDeb -327680.0 327670.0 FORMAT "%8.1" /end CHARACTERISTIC
/begin CHARACTERISTIC CoVOM_tiAPPMoF_C "Threshold value for turn off delay when APP is released" VALUE 0x80514454 RB_Val_Ws16 655.3500 Time_s -327.6800 327.6700 FORMAT "%8.4" /end CHARACTERISTIC
/begin CHARACTERISTIC CoVOM_tiBdIntStopEnaDeb_C "Debounce time for stop release (Body Interior)" VALUE 0x80514456 RB_Val_Ws16 327670.0 TimeDeb 0.00 327670.0 FORMAT "%8.1" EXTENDED_LIMITS -327680.0 327670.0 /end CHARACTERISTIC
/begin CHARACTERISTIC CoVOM_tiBrkHldMoF_C "Threshold value for turn off delay when Brake hold is released" VALUE 0x80514458 RB_Val_Ws16 655.3500 Time_s -327.6800 327.6700 FORMAT "%8.4" /end CHARACTERISTIC
/begin CHARACTERISTIC CoVOM_tiBrkHldStbyOff_C "Delay time for brake hold system off detection" VALUE 0x8051445A RB_Val_Wu8 2550. Time_ms 0.00 2550. FORMAT "%5.0" /end CHARACTERISTIC
/begin CHARACTERISTIC CoVOM_tiBrkMaxMoF_C "Secondary Threshold value for turn off delay when brake pedal is released" VALUE 0x8051445C RB_Val_Ws16 655.3500 Time_s -327.6800 327.6700 FORMAT "%8.4" /end CHARACTERISTIC
/begin CHARACTERISTIC CoVOM_tiBrkMoF_C "Primary Threshold value for turn off delay when brake pedal is released" VALUE 0x8051445E RB_Val_Ws16 655.3500 Time_s -327.6800 327.6700 FORMAT "%8.4" /end CHARACTERISTIC
/begin CHARACTERISTIC CoVOM_tiBrkPedStopEnaDeb_C "Debounce time for the release condition (Brake system)" VALUE 0x80514460 RB_Val_Ws16 327670.0 TimeDeb 0.00 327670.0 FORMAT "%8.1" EXTENDED_LIMITS -327680.0 327670.0 /end CHARACTERISTIC
/begin CHARACTERISTIC CoVOM_tiBrkRstrtAllw_C "Brake on restart delay time at P range" VALUE 0x80514462 RB_Val_Ws16 327.6700 Time_s 0.00 327.6700 FORMAT "%8.4" EXTENDED_LIMITS -327.6800 327.6700 /end CHARACTERISTIC
/begin CHARACTERISTIC CoVOM_tiCoEngStopEnaDeb_C "Stop release debounce time engine coordinator" VALUE 0x80514464 RB_Val_Ws16 327670.0 TimeDeb 0.00 327670.0 FORMAT "%8.1" EXTENDED_LIMITS -327680.0 327670.0 /end CHARACTERISTIC
/begin CHARACTERISTIC CoVOM_tiDrvStopReqDeb_C "Debounce time for the driver stop request" VALUE 0x80514466 RB_Val_Ws16 327670.0 TimeDeb 0.00 327670.0 FORMAT "%8.1" EXTENDED_LIMITS -327680.0 327670.0 /end CHARACTERISTIC
/begin CHARACTERISTIC CoVOM_tiEngCrkAbortThd_C "threshold time to abort the engine crank" VALUE 0x80514468 RB_Val_Ws16 327.6700 Time_s 0.00 327.6700 FORMAT "%8.4" EXTENDED_LIMITS -327.6800 327.6700 /end CHARACTERISTIC
/begin CHARACTERISTIC CoVOM_tiEngInhbReqDeb_C "Debounce Delay for MVCPA Enalbe" VALUE 0x8051446A RB_Val_Ws16 655350.0 TimeDeb -327680.0 327670.0 FORMAT "%8.1" /end CHARACTERISTIC
/begin CHARACTERISTIC CoVOM_tiEngRstrtOrdDly_C "delay time for engine restart request from engine stall" VALUE 0x8051446C RB_Val_Wu8 2550. Time_ms 0.00 2550. FORMAT "%5.0" /end CHARACTERISTIC
/begin CHARACTERISTIC CoVOM_tiEngRstrtReqHiLo_C "debounce time for engine restart request high to low transition" VALUE 0x8051446E RB_Val_Ws16 327670.0 TimeDeb 0.00 327670.0 FORMAT "%8.1" EXTENDED_LIMITS -327680.0 327670.0 /end CHARACTERISTIC
/begin CHARACTERISTIC CoVOM_tiEngRstrtReqLoHi_C "debounce time for engine restart request low to high transition" VALUE 0x80514470 RB_Val_Ws16 327670.0 TimeDeb 0.00 327670.0 FORMAT "%8.1" EXTENDED_LIMITS -327680.0 327670.0 /end CHARACTERISTIC
/begin CHARACTERISTIC CoVOM_tiEngStall_C "Calibration to check Engine stall time" VALUE 0x80514472 RB_Val_Ws16 327.6700 Time_s 0.00 327.6700 FORMAT "%8.4" EXTENDED_LIMITS -327.6800 327.6700 /end CHARACTERISTIC
/begin CHARACTERISTIC CoVOM_tiEngStrtOrdDly_C "engine start order delay" VALUE 0x80514474 RB_Val_Wu8 150.0 Time_ms 0.00 150.0 FORMAT "%5.1" EXTENDED_LIMITS 0.00 2550. /end CHARACTERISTIC
/begin CHARACTERISTIC CoVOM_tiEPSStopReqDeb_C "Debounce time for EPS stop request" VALUE 0x80514476 RB_Val_Ws16 327670.0 TimeDeb 0.00 327670.0 FORMAT "%8.1" EXTENDED_LIMITS -327680.0 327670.0 /end CHARACTERISTIC
/begin CHARACTERISTIC CoVOM_tiESSStopEnaDeb_C "Debounce time for the stop release of electrical supply system" VALUE 0x80514478 RB_Val_Ws16 327670.0 TimeDeb 0.00 327670.0 FORMAT "%8.1" EXTENDED_LIMITS -327680.0 327670.0 /end CHARACTERISTIC
/begin CHARACTERISTIC CoVOM_tiESSStrtReqDly_C "Delay time for start request from Battery system" VALUE 0x8051447A RB_Val_Ws16 655.3500 Time_s -327.6800 327.6700 FORMAT "%8.4" /end CHARACTERISTIC
/begin CHARACTERISTIC CoVOM_tiFrntDefrstSwtDeb_C "Front Defogger Switch Debounce time for Start Request." VALUE 0x8051447C RB_Val_Ws16 655350.0 TimeDeb -327680.0 327670.0 FORMAT "%8.1" /end CHARACTERISTIC
/begin CHARACTERISTIC CoVOM_tiFwdGearDly_C "Time delay to reset Reverse gear status when Forward gear is engaged" VALUE 0x8051447E RB_Val_Ws16 655.3500 Time_s -327.6800 327.6700 FORMAT "%8.4" /end CHARACTERISTIC
/begin CHARACTERISTIC CoVOM_tiMaxStopReq_C "Time window in which an engine stop is possible if the stop release are given." VALUE 0x80514480 RB_Val_Ws32 42949672950.0 Time_ms -21474836480.0 21474836470.0 FORMAT "%13.1" /end CHARACTERISTIC
/begin CHARACTERISTIC CoVOM_tiNEngStopReqDeb_C "Debounce time for stop request, if the engine speed is below than calibratable threshold" VALUE 0x80514484 RB_Val_Ws16 327670.0 TimeDeb 0.00 327670.0 FORMAT "%8.1" EXTENDED_LIMITS -327680.0 327670.0 /end CHARACTERISTIC
/begin CHARACTERISTIC CoVOM_tiPTStopEnaDeb_C "Debounce time for the stop release of powertrain" VALUE 0x80514486 RB_Val_Ws16 655350.0 TimeDeb -327680.0 327670.0 FORMAT "%8.1" /end CHARACTERISTIC
/begin CHARACTERISTIC CoVOM_tiPTStopReqDeb_C "Debounce time for the stop request of powertrain" VALUE 0x80514488 RB_Val_Ws16 327670.0 TimeDeb 0.00 327670.0 FORMAT "%8.1" EXTENDED_LIMITS -327680.0 327670.0 /end CHARACTERISTIC
/begin CHARACTERISTIC CoVOM_tiRstrtRelsPtd_C "Restart release inhibition delay when change from Neutral" VALUE 0x8051448A RB_Val_Ws16 327.6700 Time_s 0.00 327.6700 FORMAT "%8.4" EXTENDED_LIMITS -327.6800 327.6700 /end CHARACTERISTIC
/begin CHARACTERISTIC CoVOM_tiSeatBltOffDly_C "Time delay to goto System off after seatbelt is unfastened during idle stop" VALUE 0x8051448C RB_Val_Ws16 655.3500 Time_s -327.6800 327.6700 FORMAT "%8.4" /end CHARACTERISTIC
/begin CHARACTERISTIC CoVOM_tiStrtReq_C "Delay time for start request detection" VALUE 0x8051448E RB_Val_Wu8 2550. Time_ms 0.00 2550. FORMAT "%5.0" /end CHARACTERISTIC
/begin CHARACTERISTIC CoVOM_tiSysOffAutRstrt_C "System off auto restart time" VALUE 0x80514490 RB_Val_Ws16 655.3500 Time_s -327.6800 327.6700 FORMAT "%8.4" /end CHARACTERISTIC
/begin CHARACTERISTIC CoVOM_tiTraGearStopEnaDeb_C "Debounce time for the stop release condition, if the reverse gear is not engaged." VALUE 0x80514492 RB_Val_Ws16 327670.0 TimeDeb 0.00 327670.0 FORMAT "%8.1" EXTENDED_LIMITS -327680.0 327670.0 /end CHARACTERISTIC
/begin CHARACTERISTIC CoVOM_tiTranDly_C "Transition delay time to inhibit Idle stop when brake from ACC is off" VALUE 0x80514494 RB_Val_Ws16 327.6700 Time_s 0.00 327.6700 FORMAT "%8.4" EXTENDED_LIMITS -327.6800 327.6700 /end CHARACTERISTIC
/begin CHARACTERISTIC CoVOM_tiTranISSEngRunng_C "Delay timer to be given in only the transition from COVOM_ST_STSP_START_PROGS to COVOM_ST_STSP_ENG_RUNNG of CoVOM_stISSEng" VALUE 0x80514496 RB_Val_Wu8 2550. Time_ms 0.00 2550. FORMAT "%5.0" /end CHARACTERISTIC
/begin CHARACTERISTIC CoVOM_tiTraStopReqDeb_C "Debounce time for transmission stop request" VALUE 0x80514498 RB_Val_Ws16 327670.0 TimeDeb 0.00 327670.0 FORMAT "%8.1" EXTENDED_LIMITS -327680.0 327670.0 /end CHARACTERISTIC
/begin CHARACTERISTIC CoVOM_tiTSStopEnaDeb_C "Debounce time for the stop release of the thermal system" VALUE 0x8051449A RB_Val_Ws16 327670.0 TimeDeb 0.00 327670.0 FORMAT "%8.1" EXTENDED_LIMITS -327680.0 327670.0 /end CHARACTERISTIC
/begin CHARACTERISTIC CoVOM_tiUpDwnSpdLim_C "The continuation time for Idle Stop frequency restriction requirement judgment" VALUE 0x8051449C RB_Val_Wu32 42949672.9500 Time_s 0.00 42949672.9500 FORMAT "%13.4" /end CHARACTERISTIC
/begin CHARACTERISTIC CoVOM_tiVehCdnStopTrigDly_C "Time delay to check Idle stop release conditions once trigger conditions are available" VALUE 0x805144A0 RB_Val_Ws16 327.6700 Time_s 0.00 327.6700 FORMAT "%8.4" EXTENDED_LIMITS -327.6800 327.6700 /end CHARACTERISTIC
/begin CHARACTERISTIC CoVOM_tiVehVCondDeb_C "Debounce the vehicle velocity for idle stop" VALUE 0x805144A2 RB_Val_Ws16 655350.0 TimeDeb -327680.0 327670.0 FORMAT "%8.1" /end CHARACTERISTIC
/begin CHARACTERISTIC CoVOM_tiVSAStopReqDeb_C "Debounce time for VSA stop request" VALUE 0x805144A4 RB_Val_Ws16 327670.0 TimeDeb 0.00 327670.0 FORMAT "%8.1" EXTENDED_LIMITS -327680.0 327670.0 /end CHARACTERISTIC
/begin CHARACTERISTIC CoVOM_tiWaitStrtAbrt_C "Time for start abortion recognition" VALUE 0x805144A6 RB_Val_Ws16 655350.0 TimeDeb -327680.0 327670.0 FORMAT "%8.1" /end CHARACTERISTIC
/begin CHARACTERISTIC CoVOM_vDurgRToDTran_C "Vehicle speed threshold to clear reverse history" VALUE 0x805144A8 RB_Val_Ws16 655.3500 Vel -327.6800 327.6700 FORMAT "%8.4" /end CHARACTERISTIC
/begin CHARACTERISTIC CoVOM_vISSuppSpdThd_C "Pulled up vehcile speed during idle stop suppression" VALUE 0x805144AA RB_Val_Ws16 655.3500 Vel -327.6800 327.6700 FORMAT "%8.4" /end CHARACTERISTIC
/begin CHARACTERISTIC CoVOM_vWhlSpdThresHi_C "Idling stop carriage return vehicle speed" VALUE 0x805144AC RB_Val_Ws16 655.3500 Vel -327.6800 327.6700 FORMAT "%8.4" /end CHARACTERISTIC
/begin CHARACTERISTIC CoVOM_vWhlSpdThresLo_C "Idling stop permission vehicle speed" VALUE 0x805144AE RB_Val_Ws16 655.3500 Vel -327.6800 327.6700 FORMAT "%8.4" /end CHARACTERISTIC
/begin CHARACTERISTIC CoVOM_vXMaxEngStop_C "Vehicle speed threshold that is necessary for a stop request" VALUE 0x805144B0 RB_Val_Ws16 655.3500 Vel -327.6800 327.6700 FORMAT "%8.4" /end CHARACTERISTIC
/begin CHARACTERISTIC CoVOM_vXMaxSinceStrtMin_C "Minimum vehicle speed for release of engine stop that has to be reached" VALUE 0x805144B2 RB_Val_Ws16 655.3500 Vel -327.6800 327.6700 FORMAT "%8.4" /end CHARACTERISTIC
/begin CHARACTERISTIC CoVOM_vXMaxSinceStrt_C "Maximum of vehicle velocity since start" VALUE 0x805144B4 RB_Val_Ws16 655.3500 Vel -327.6800 327.6700 FORMAT "%8.4" /end CHARACTERISTIC
/begin CHARACTERISTIC CoVOM_vXSpdDiff_C "The Low side hysteresis width of the vehicle speed for IS frequency restriction judgment." VALUE 0x805144B6 RB_Val_Ws16 655.3500 Vel -327.6800 327.6700 FORMAT "%8.4" /end CHARACTERISTIC
/begin MEASUREMENT CoVeh_stEngStopOrd "Stop order to the combustion engine" UBYTE OneToOne 1 100 0.00 255.0 FORMAT "%5.1" ECU_ADDRESS 0x6000A662 /end MEASUREMENT
/begin MEASUREMENT CoVeh_stEngStrtOrd "Order to Eng for engine start" UBYTE OneToOne 1 100 0.00 255.0 FORMAT "%5.1" ECU_ADDRESS 0x6000A661 /end MEASUREMENT
/begin MEASUREMENT CoVMD_bCtOffPhdCrCtl "Status fuel cut off prohibited by cruise control" UBYTE B_TRUE 1 100 0.00 1.00000000000 BIT_MASK 0x1 FORMAT "%13.11" ECU_ADDRESS 0x6000A1EF /end MEASUREMENT
/begin MEASUREMENT CoVMD_bCtOffPhdLLim "Status fuel cut off prohibited by longitudinal limiter (LLim)" UBYTE B_TRUE 1 100 0.00 1.00000000000 BIT_MASK 0x1 FORMAT "%13.11" ECU_ADDRESS 0x6000A1EE /end MEASUREMENT
/begin MEASUREMENT CoVMD_cntrAryRst "Reset array counter" UBYTE OneToOne 1 100 0.00 255.0 FORMAT "%5.1" ECU_ADDRESS 0x60009B9C /end MEASUREMENT
/begin MEASUREMENT CoVMD_cntrIDASFailDetn "IDAS failure times" UWORD OneToOne 1 100 0.00 65535.00 FORMAT "%8.2" ECU_ADDRESS 0x60003E36 /end MEASUREMENT
/begin MEASUREMENT CoVMD_cntrReIni "Local counter to signal the execution of ReIni task" UBYTE OneToOne 1 100 0.00 255.0 FORMAT "%5.1" ECU_ADDRESS 0x60009B9B /end MEASUREMENT
/begin MEASUREMENT CoVMD_facACC "Factor for ramping APP ratio for cruise control" SLONG Fact 1 100 -262144.000000 262143.999878 FORMAT "%13.6" ECU_ADDRESS 0x600018F0 /end MEASUREMENT
/begin MEASUREMENT CoVMD_facACCStep "Factor for step change in slope used for ramping" SLONG Fact 1 100 -262144.000000 262143.999878 FORMAT "%13.6" ECU_ADDRESS 0x600018EC /end MEASUREMENT
/begin MEASUREMENT CoVMD_facAppMaxCmp "App max compensation factor" SWORD Fact 1 100 -4.000000 3.999878 FORMAT "%8.6" ECU_ADDRESS 0x60003E34 /end MEASUREMENT
/begin MEASUREMENT CoVMD_facCompAcs "Accessory compensation factor" SWORD Fact 1 100 -4.000000 3.999878 FORMAT "%8.6" ECU_ADDRESS 0x600051EC /end MEASUREMENT
/begin MEASUREMENT CoVMD_facCompAcsCrCtl "Factor of accessory compensation by CrCtl" SWORD Fact 1 100 -4.000000 3.999878 FORMAT "%8.6" ECU_ADDRESS 0x600051EA /end MEASUREMENT
/begin MEASUREMENT CoVMD_facCompAcsLLim "Factor of accessory compensation by LLim" SWORD Fact 1 100 -4.000000 3.999878 FORMAT "%8.6" ECU_ADDRESS 0x600051E8 /end MEASUREMENT
/begin MEASUREMENT CoVMD_facLLim "Factor for ramping APP ratio for Speed limiter" SLONG Fact 1 100 -262144.000000 262143.999878 FORMAT "%13.6" ECU_ADDRESS 0x600018E8 /end MEASUREMENT
/begin MEASUREMENT CoVMD_facLLimStep "Factor for step change in slope used for ramping" SLONG Fact 1 100 -262144.000000 262143.999878 FORMAT "%13.6" ECU_ADDRESS 0x600018E4 /end MEASUREMENT
/begin MEASUREMENT CoVMD_facModSwt "Factor for ramping of torque value during change in drive mode" SLONG Fact 1 100 -262144.000000 262143.999878 FORMAT "%13.6" ECU_ADDRESS 0x600018E0 /end MEASUREMENT
/begin MEASUREMENT CoVMD_facModSwtStep "Factor for step change in slope used for ramping of torque during change in drive mode" SLONG Fact 1 100 -262144.000000 262143.999878 FORMAT "%13.6" ECU_ADDRESS 0x600018DC /end MEASUREMENT
/begin MEASUREMENT CoVMD_flgACCRampActv "Status of APP ratio for cruise control ramping" UBYTE B_TRUE 1 100 0.00 1.00000000000 BIT_MASK 0x1 FORMAT "%13.11" ECU_ADDRESS 0x60009B9A /end MEASUREMENT
/begin MEASUREMENT CoVMD_flgBrkDetn "Flag indicates brake detection" UBYTE B_TRUE 1 100 0.00 1.00000000000 BIT_MASK 0x1 FORMAT "%13.11" ECU_ADDRESS 0x60009B99 /end MEASUREMENT
/begin MEASUREMENT CoVMD_flgBrkFailDeb "Flag indicates brake failure detected" UBYTE B_TRUE 1 100 0.00 1.00000000000 BIT_MASK 0x1 FORMAT "%13.11" ECU_ADDRESS 0x60009B98 /end MEASUREMENT
/begin MEASUREMENT CoVMD_flgDrvActv "Drive active status based on CoVMD_r" UBYTE B_TRUE 1 100 0.00 1.00000000000 BIT_MASK 0x1 FORMAT "%13.11" ECU_ADDRESS 0x60009B97 /end MEASUREMENT
/begin MEASUREMENT CoVMD_flgIDASCntrRst "Flag indicates counter is requested to reset" UBYTE B_TRUE 1 100 0.00 1.00000000000 BIT_MASK 0x1 FORMAT "%13.11" ECU_ADDRESS 0x60009B96 /end MEASUREMENT
/begin MEASUREMENT CoVMD_flgIDASFailBrkCdn "Flag indicates brake is pressed under certain vehicle speed condition" UBYTE B_TRUE 1 100 0.00 1.00000000000 BIT_MASK 0x1 FORMAT "%13.11" ECU_ADDRESS 0x60009B95 /end MEASUREMENT
/begin MEASUREMENT CoVMD_flgIDASFailDetn "Flag indicates IDAS faillure is detected" UBYTE B_TRUE 1 100 0.00 1.00000000000 BIT_MASK 0x1 FORMAT "%13.11" ECU_ADDRESS 0x6000A1ED /end MEASUREMENT
/begin MEASUREMENT CoVMD_flgIDASFailTqCdn "Flag indicates high torque is detected" UBYTE B_TRUE 1 100 0.00 1.00000000000 BIT_MASK 0x1 FORMAT "%13.11" ECU_ADDRESS 0x60009B94 /end MEASUREMENT
/begin MEASUREMENT CoVMD_flgIDASMTCluOffEna "IDAS MT clutch Off calculation enable flag" UBYTE B_TRUE 1 100 0.00 1.00000000000 BIT_MASK 0x1 FORMAT "%13.11" ECU_ADDRESS 0x6000A1EC /end MEASUREMENT
/begin MEASUREMENT CoVMD_flgRampLLimActv "Status of APP ratio for speed limiter ramping" UBYTE B_TRUE 1 100 0.00 1.00000000000 BIT_MASK 0x1 FORMAT "%13.11" ECU_ADDRESS 0x60009B93 /end MEASUREMENT
/begin MEASUREMENT CoVMD_nDesVal "IDAS MT Clutch Off desired engine speed" SWORD EngNCrCtl 1 100 -32768.00 32767.00 FORMAT "%8.2" ECU_ADDRESS 0x60003E32 /end MEASUREMENT
/begin MEASUREMENT CoVMD_nTrqOffLimA "ACC Brake off engine speed limitation" SWORD EngNCrCtl 1 100 -32768.00 32767.00 FORMAT "%8.2" ECU_ADDRESS 0x60003E30 /end MEASUREMENT
/begin MEASUREMENT CoVMD_nTrqOffLimB "ACC Brake on engine speed limitation" UWORD EngNCrCtl 1 100 0.00 65535.00 FORMAT "%8.2" ECU_ADDRESS 0x60003E2E /end MEASUREMENT
/begin MEASUREMENT CoVMD_r "Conversion ratio for LLim or CrCtl" SWORD Prc 1 100 -400.0000 399.9878 FORMAT "%8.4" ECU_ADDRESS 0x600051E6 /end MEASUREMENT
/begin MEASUREMENT CoVMD_ratCrsCtrlLLimIDASReq "Maximum possible IDAS Cruise control and Speed limiter ratio" SWORD Prc 1 100 -400.0000 399.9878 FORMAT "%8.4" ECU_ADDRESS 0x600051DA /end MEASUREMENT
/begin MEASUREMENT CoVMD_ratCvtEco2 "CVT ECO 2 mode ratio" SWORD Prc 1 100 -400.0000 399.9878 FORMAT "%8.4" ECU_ADDRESS 0x60003E2C /end MEASUREMENT
/begin MEASUREMENT CoVMD_ratIDASCVTEco "IDAS CVT ECO mode ratio" SWORD Prc 1 100 -400.0000 399.9878 FORMAT "%8.4" ECU_ADDRESS 0x60003E2A /end MEASUREMENT
/begin MEASUREMENT CoVMD_ratIDASCVTNorm "IDAS CVT normal mode ratio" SWORD Prc 1 100 -400.0000 399.9878 FORMAT "%8.4" ECU_ADDRESS 0x60003E28 /end MEASUREMENT
/begin MEASUREMENT CoVMD_ratIDASCvtNorm2 "IDAS CVT normal mode 2 ratio" SWORD Prc 1 100 -400.0000 399.9878 FORMAT "%8.4" ECU_ADDRESS 0x60003E26 /end MEASUREMENT
/begin MEASUREMENT CoVMD_ratIDASMTEco "IDAS MT Eco mode ratio" SWORD Prc 1 100 -400.0000 399.9878 FORMAT "%8.4" ECU_ADDRESS 0x60003E24 /end MEASUREMENT
/begin MEASUREMENT CoVMD_ratIDASMTNorm "IDAS MT normal mode ratio" SWORD Prc 1 100 -400.0000 399.9878 FORMAT "%8.4" ECU_ADDRESS 0x60003E22 /end MEASUREMENT
/begin MEASUREMENT CoVMD_ratIDASReq "Maximum possible IDAS Cruise control and Speed limiter ratio" SWORD Prc 1 100 -400.0000 399.9878 FORMAT "%8.4" ECU_ADDRESS 0x60003E20 /end MEASUREMENT
/begin MEASUREMENT CoVMD_ratIDASReqLim "Ratio for IDAS Cruise control and Speed limiter Request" SWORD Prc 1 100 -400.0000 399.9878 FORMAT "%8.4" ECU_ADDRESS 0x60003E1E /end MEASUREMENT
/begin MEASUREMENT CoVMD_ratIDASReqMax "Maximum IDAS request accelerator ratio" SWORD Prc 1 100 -400.0000 399.9878 FORMAT "%8.4" ECU_ADDRESS 0x60003E1C /end MEASUREMENT
/begin MEASUREMENT CoVMD_ratIDASReqNewTmp "Temporary value of APP ratio for IDAS cruise control based on target ratio" SWORD Prc 1 100 -400.0000 399.9878 FORMAT "%8.4" ECU_ADDRESS 0x60003E1A /end MEASUREMENT
/begin MEASUREMENT CoVMD_ratIDASReqOld "Old value of maximum possible IDAS Cruise control and Speed limiter ratio" SWORD Prc 1 100 -400.0000 399.9878 FORMAT "%8.4" ECU_ADDRESS 0x60003E18 /end MEASUREMENT
/begin MEASUREMENT CoVMD_ratIDASReqOldTmp "Temporary value of APP ratio for IDAS cruise control based on current ratio" SWORD Prc 1 100 -400.0000 399.9878 FORMAT "%8.4" ECU_ADDRESS 0x60003E16 /end MEASUREMENT
/begin MEASUREMENT CoVMD_ratIDASReqTmp "IDAS request template ratio" SWORD Prc 1 100 -400.0000 399.9878 FORMAT "%8.4" ECU_ADDRESS 0x60003E14 /end MEASUREMENT
/begin MEASUREMENT CoVMD_ratVirtMax "Maximum virtual accelerator ratio" SWORD Prc 1 100 -400.0000 399.9878 FORMAT "%8.4" ECU_ADDRESS 0x60003E12 /end MEASUREMENT
/begin MEASUREMENT CoVMD_rCrCtl "APP request of cruise control" SWORD Prc 1 100 -400.0000 399.9878 FORMAT "%8.4" ECU_ADDRESS 0x600051E4 /end MEASUREMENT
/begin MEASUREMENT CoVMD_rCrCtlACCReq "Acc pedal position for CC/ACC" SWORD Prc 1 100 -400.0000 399.9878 FORMAT "%8.4" ECU_ADDRESS 0x600051E2 /end MEASUREMENT
/begin MEASUREMENT CoVMD_rIDASCrsCluOffReq "IDAS MT Clutch off target ratio" SWORD APPCrCtl1 1 100 0.00 163.8350 FORMAT "%8.4" ECU_ADDRESS 0x60003E10 /end MEASUREMENT
/begin MEASUREMENT CoVMD_rLLimACCReq "Acc pedal position for ASL" SWORD Prc 1 100 -400.0000 399.9878 FORMAT "%8.4" ECU_ADDRESS 0x600051E0 /end MEASUREMENT
/begin MEASUREMENT CoVMD_rReqChg "Variable for Gear Change APP request value" SWORD APPCrCtl1 1 100 0.00 163.8350 FORMAT "%8.4" ECU_ADDRESS 0x600051DE /end MEASUREMENT
/begin MEASUREMENT CoVMD_rSptReqChg "Variable for Gear Change APP request value for sport mode" SWORD APPCrCtl1 1 100 0.00 163.8350 FORMAT "%8.4" ECU_ADDRESS 0x600051DC /end MEASUREMENT
/begin MEASUREMENT CoVMD_rTq "IDAS Filtered torque ratio" SWORD TransR 1 100 -327.6800 327.6700 FORMAT "%8.4" ECU_ADDRESS 0x60003E0E /end MEASUREMENT
/begin MEASUREMENT CoVMD_rTqFild "Total drive train ratio of engine - wheel after filtering" SWORD TransR 1 100 -327.6800 327.6700 FORMAT "%8.4" ECU_ADDRESS 0x60003E0C /end MEASUREMENT
/begin MEASUREMENT CoVMD_rVirtApp "Virtual App using to calculate time constant of PT1" SWORD Prc 1 100 -400.0000 399.9878 FORMAT "%8.4" ECU_ADDRESS 0x60003E0A /end MEASUREMENT
/begin MEASUREMENT CoVMD_stRampActv "Status of torque ramp during mode change" UBYTE B_TRUE 1 100 0.00 1.00000000000 BIT_MASK 0x1 FORMAT "%13.11" ECU_ADDRESS 0x60009B92 /end MEASUREMENT
/begin MEASUREMENT CoVMD_stReqCrCtl "Coordinated status of acceleration request." UBYTE B_TRUE 1 100 0.00 1.00000000000 BIT_MASK 0x1 FORMAT "%13.11" ECU_ADDRESS 0x6000A1EB /end MEASUREMENT
/begin MEASUREMENT CoVMD_stSwtCCASLTqSeln "Switch to select if driving assistance functions are calculated in Engine ECU" UBYTE OneToOne 1 100 0.00 255.0 FORMAT "%5.1" ECU_ADDRESS 0x6000A668 /end MEASUREMENT
/begin MEASUREMENT CoVMD_swtCCSel "Switch for Cruise Control Selection" UBYTE OneToOne 1 100 0.00 255.0 FORMAT "%5.1" ECU_ADDRESS 0x6000A667 /end MEASUREMENT
/begin MEASUREMENT CoVMD_tiACCRampSlop "Time period within which ramping of APP raito should be finished" SWORD Time_s 1 100 -327.6800 327.6700 FORMAT "%8.4" ECU_ADDRESS 0x60003E08 /end MEASUREMENT
/begin MEASUREMENT CoVMD_tiBrkFailDeb "Delay time to determine brake is operated for IDAS failure detection" UWORD t_q0p01 1 100 0.00 655.3500 FORMAT "%8.4" ECU_ADDRESS 0x60003E06 /end MEASUREMENT
/begin MEASUREMENT CoVMD_tiIDASReqLim "Filter time constant for IDAS Cruise control and Speed Request Ratio" SWORD Time_s 1 100 -327.6800 327.6700 FORMAT "%8.4" ECU_ADDRESS 0x60003E04 /end MEASUREMENT
/begin MEASUREMENT CoVMD_tiLLimRampSlop "Time period within which ramping of APP raito should be finished" SWORD Time_s 1 100 -327.6800 327.6700 FORMAT "%8.4" ECU_ADDRESS 0x60003E02 /end MEASUREMENT
/begin MEASUREMENT CoVMD_tiTqFild "Filter time constant for drive train ratio of engine - wheel" SWORD Time_s 1 100 -327.6800 327.6700 FORMAT "%8.4" ECU_ADDRESS 0x60003E00 /end MEASUREMENT
/begin MEASUREMENT CoVMD_tqACCReq "IDAS wheel torque request for CrCtl and LLim" SLONG TrqPrpHigh 1 100 -214748364.800 214748364.700 FORMAT "%13.3" ECU_ADDRESS 0x600018D8 /end MEASUREMENT
/begin MEASUREMENT CoVMD_tqBasDif "Torque base difference" SWORD Trq 1 100 -3276.800 3276.700 FORMAT "%8.3" ECU_ADDRESS 0x60003DFE /end MEASUREMENT
/begin MEASUREMENT CoVMD_tqBasFild "Torque base filtered" SWORD Trq 1 100 -3276.800 3276.700 FORMAT "%8.3" ECU_ADDRESS 0x60003DFC /end MEASUREMENT
/begin MEASUREMENT CoVMD_tqBasMod1 "Torque base 1" SWORD Trq 1 100 -3276.800 3276.700 FORMAT "%8.3" ECU_ADDRESS 0x60003DFA /end MEASUREMENT
/begin MEASUREMENT CoVMD_tqBasMod1MT "Torque base 1 MT" SWORD Trq 1 100 -3276.800 3276.700 FORMAT "%8.3" ECU_ADDRESS 0x60003DF8 /end MEASUREMENT
/begin MEASUREMENT CoVMD_tqBasMod2 "Torque base 2" SWORD Trq 1 100 -3276.800 3276.700 FORMAT "%8.3" ECU_ADDRESS 0x60003DF6 /end MEASUREMENT
/begin MEASUREMENT CoVMD_tqBasModNew "Torque base new" SWORD Trq 1 100 -3276.800 3276.700 FORMAT "%8.3" ECU_ADDRESS 0x60003DF4 /end MEASUREMENT
/begin MEASUREMENT CoVMD_tqBasModOld "Torque base old" SWORD Trq 1 100 -3276.800 3276.700 FORMAT "%8.3" ECU_ADDRESS 0x60003DF2 /end MEASUREMENT
/begin MEASUREMENT CoVMD_tqBasPrev "Previous calculation of basic request desired torque" SWORD Trq 1 100 -3276.800 3276.700 FORMAT "%8.3" ECU_ADDRESS 0x60003DF0 /end MEASUREMENT
/begin MEASUREMENT CoVMD_tqBasUnfild "Torque base unfiltered" SWORD Trq 1 100 -3276.800 3276.700 FORMAT "%8.3" ECU_ADDRESS 0x60003DEE /end MEASUREMENT
/begin MEASUREMENT CoVMD_tqCmpLossSum "Sum of compensation loss" SWORD Trq 1 100 -3276.800 3276.700 FORMAT "%8.3" ECU_ADDRESS 0x60003DEC /end MEASUREMENT
/begin MEASUREMENT CoVMD_tqCmpLossSumWoFac "Sum of compensation loss without factor" SWORD Trq 1 100 -3276.800 3276.700 FORMAT "%8.3" ECU_ADDRESS 0x60003DEA /end MEASUREMENT
/begin MEASUREMENT CoVMD_tqCmpNotSwilLoss "Loss compensated non-switchable losses" SLONG TrqPrpHigh 1 100 -214748364.800 214748364.700 FORMAT "%13.3" ECU_ADDRESS 0x600018D4 /end MEASUREMENT
/begin MEASUREMENT CoVMD_tqCmpNotSwilLossWoFac "Loss compensated non-switchable losses without factor" SLONG TrqPrpHigh 1 100 -214748364.800 214748364.700 FORMAT "%13.3" ECU_ADDRESS 0x600018D0 /end MEASUREMENT
/begin MEASUREMENT CoVMD_tqCmpSwilLoss "Loss compensated switchable losses" SLONG TrqPrpHigh 1 100 -214748364.800 214748364.700 FORMAT "%13.3" ECU_ADDRESS 0x600018CC /end MEASUREMENT
/begin MEASUREMENT CoVMD_tqCmpSwilLossWoFac "Loss compensated switchable losses without factor" SLONG Trq 1 100 -214748364.800 214748364.700 FORMAT "%13.3" ECU_ADDRESS 0x600018C8 /end MEASUREMENT
/begin MEASUREMENT CoVMD_tqCrCtlACCReq "Maximum possible adjustable torque" SLONG TrqPrpHigh 1 100 -214748364.800 214748364.700 FORMAT "%13.3" ECU_ADDRESS 0x60001D58 /end MEASUREMENT
/begin MEASUREMENT CoVMD_tqCrCtlWiLimn "Cruise control torque with limitation" SLONG TrqPrpHigh 1 100 -214748364.800 214748364.700 FORMAT "%13.3" ECU_ADDRESS 0x600018C4 /end MEASUREMENT
/begin MEASUREMENT CoVMD_tqCrsCtrlLLimIDASReq "Maximum possible adjustable IDAS torque" SWORD TrqPrpHigh 1 100 -3276.800 3276.700 FORMAT "%8.3" ECU_ADDRESS 0x600051D8 /end MEASUREMENT
/begin MEASUREMENT CoVMD_tqCvtEcoEng0 "CVT ECO mode engine torque gear 0" SWORD Trq 1 100 -3276.800 3276.700 FORMAT "%8.3" ECU_ADDRESS 0x60003DE8 /end MEASUREMENT
/begin MEASUREMENT CoVMD_tqCvtEcoEng1 "CVT ECO mode engine torque gear 1" SWORD Trq 1 100 -3276.800 3276.700 FORMAT "%8.3" ECU_ADDRESS 0x60003DE6 /end MEASUREMENT
/begin MEASUREMENT CoVMD_tqCvtEcoEng12 "CVT ECO mode engine torque gear 1 to 2" SWORD Trq 1 100 -3276.800 3276.700 FORMAT "%8.3" ECU_ADDRESS 0x60003DE4 /end MEASUREMENT
/begin MEASUREMENT CoVMD_tqCvtEcoEng2 "CVT ECO mode engine torque gear 2" SWORD Trq 1 100 -3276.800 3276.700 FORMAT "%8.3" ECU_ADDRESS 0x60003DE2 /end MEASUREMENT
/begin MEASUREMENT CoVMD_tqCvtEcoEng23 "CVT ECO mode engine torque gear 2 to 3" SWORD Trq 1 100 -3276.800 3276.700 FORMAT "%8.3" ECU_ADDRESS 0x60003DE0 /end MEASUREMENT
/begin MEASUREMENT CoVMD_tqCvtEcoEng3 "CVT ECO mode engine torque gear 3" SWORD Trq 1 100 -3276.800 3276.700 FORMAT "%8.3" ECU_ADDRESS 0x60003DDE /end MEASUREMENT
/begin MEASUREMENT CoVMD_tqCvtEcoEng34 "CVT ECO mode engine torque gear 3 to 4" SWORD Trq 1 100 -3276.800 3276.700 FORMAT "%8.3" ECU_ADDRESS 0x60003DDC /end MEASUREMENT
/begin MEASUREMENT CoVMD_tqCvtEcoEng4 "CVT ECO mode engine torque gear 4" SWORD Trq 1 100 -3276.800 3276.700 FORMAT "%8.3" ECU_ADDRESS 0x60003DDA /end MEASUREMENT
/begin MEASUREMENT CoVMD_tqCvtEcoEng45 "CVT ECO mode engine torque gear 4 to 5" SWORD Trq 1 100 -3276.800 3276.700 FORMAT "%8.3" ECU_ADDRESS 0x60003DD8 /end MEASUREMENT
/begin MEASUREMENT CoVMD_tqCvtEcoEng5 "CVT ECO mode engine torque gear 5" SWORD Trq 1 100 -3276.800 3276.700 FORMAT "%8.3" ECU_ADDRESS 0x60003DD6 /end MEASUREMENT
/begin MEASUREMENT CoVMD_tqCvtEcoEng56 "CVT ECO mode engine torque gear 5 to 6" SWORD Trq 1 100 -3276.800 3276.700 FORMAT "%8.3" ECU_ADDRESS 0x60003DD4 /end MEASUREMENT
/begin MEASUREMENT CoVMD_tqCvtEcoEng6 "CVT ECO mode engine torque gear 6" SWORD Trq 1 100 -3276.800 3276.700 FORMAT "%8.3" ECU_ADDRESS 0x60003DD2 /end MEASUREMENT
/begin MEASUREMENT CoVMD_tqCvtEcoEng67 "CVT ECO mode engine torque gear 6 to 7" SWORD Trq 1 100 -3276.800 3276.700 FORMAT "%8.3" ECU_ADDRESS 0x60003DD0 /end MEASUREMENT
/begin MEASUREMENT CoVMD_tqCvtEcoEng7 "CVT ECO mode engine torque gear 7" SWORD Trq 1 100 -3276.800 3276.700 FORMAT "%8.3" ECU_ADDRESS 0x60003DCE /end MEASUREMENT
/begin MEASUREMENT CoVMD_tqCvtEcoEng78 "CVT ECO mode engine torque gear 7 to 8" SWORD Trq 1 100 -3276.800 3276.700 FORMAT "%8.3" ECU_ADDRESS 0x60003DCC /end MEASUREMENT
/begin MEASUREMENT CoVMD_tqCvtEcoEng8 "CVT ECO mode engine torque gear 8" SWORD Trq 1 100 -3276.800 3276.700 FORMAT "%8.3" ECU_ADDRESS 0x60003DCA /end MEASUREMENT
/begin MEASUREMENT CoVMD_tqCVTEng0 "CVT normal mode engine torque gear 0" SWORD Trq 1 100 -3276.800 3276.700 FORMAT "%8.3" ECU_ADDRESS 0x60003DC8 /end MEASUREMENT
/begin MEASUREMENT CoVMD_tqCVTEng1 "CVT normal mode engine torque gear 1" SWORD Trq 1 100 -3276.800 3276.700 FORMAT "%8.3" ECU_ADDRESS 0x60003DC6 /end MEASUREMENT
/begin MEASUREMENT CoVMD_tqCVTEng12 "CVT normal mode engine torque gear 1 to 2" SWORD Trq 1 100 -3276.800 3276.700 FORMAT "%8.3" ECU_ADDRESS 0x60003DC4 /end MEASUREMENT
/begin MEASUREMENT CoVMD_tqCVTEng2 "CVT normal mode engine torque gear 2" SWORD Trq 1 100 -3276.800 3276.700 FORMAT "%8.3" ECU_ADDRESS 0x60003DC2 /end MEASUREMENT
/begin MEASUREMENT CoVMD_tqCVTEng23 "CVT normal mode engine torque gear 2 to 3" SWORD Trq 1 100 -3276.800 3276.700 FORMAT "%8.3" ECU_ADDRESS 0x60003DC0 /end MEASUREMENT
/begin MEASUREMENT CoVMD_tqCVTEng3 "CVT normal mode engine torque gear 3" SWORD Trq 1 100 -3276.800 3276.700 FORMAT "%8.3" ECU_ADDRESS 0x60003DBE /end MEASUREMENT
/begin MEASUREMENT CoVMD_tqCVTEng34 "CVT normal mode engine torque gear 3 to 4" SWORD Trq 1 100 -3276.800 3276.700 FORMAT "%8.3" ECU_ADDRESS 0x60003DBC /end MEASUREMENT
/begin MEASUREMENT CoVMD_tqCVTEng4 "CVT normal mode engine torque gear 4" SWORD Trq 1 100 -3276.800 3276.700 FORMAT "%8.3" ECU_ADDRESS 0x60003DBA /end MEASUREMENT
/begin MEASUREMENT CoVMD_tqCVTEng45 "CVT normal mode engine torque gear 4 to 5" SWORD Trq 1 100 -3276.800 3276.700 FORMAT "%8.3" ECU_ADDRESS 0x60003DB8 /end MEASUREMENT
/begin MEASUREMENT CoVMD_tqCVTEng5 "CVT normal mode engine torque gear 5" SWORD Trq 1 100 -3276.800 3276.700 FORMAT "%8.3" ECU_ADDRESS 0x60003DB6 /end MEASUREMENT
/begin MEASUREMENT CoVMD_tqCVTEng56 "CVT normal mode engine torque gear 5 to 6" SWORD Trq 1 100 -3276.800 3276.700 FORMAT "%8.3" ECU_ADDRESS 0x60003DB4 /end MEASUREMENT
/begin MEASUREMENT CoVMD_tqCVTEng6 "CVT normal mode engine torque gear 6" SWORD Trq 1 100 -3276.800 3276.700 FORMAT "%8.3" ECU_ADDRESS 0x60003DB2 /end MEASUREMENT
/begin MEASUREMENT CoVMD_tqCVTEng67 "CVT normal mode engine torque gear 6 to 7" SWORD Trq 1 100 -3276.800 3276.700 FORMAT "%8.3" ECU_ADDRESS 0x60003DB0 /end MEASUREMENT
/begin MEASUREMENT CoVMD_tqCVTEng7 "CVT normal mode engine torque gear 7" SWORD Trq 1 100 -3276.800 3276.700 FORMAT "%8.3" ECU_ADDRESS 0x60003DAE /end MEASUREMENT
/begin MEASUREMENT CoVMD_tqCVTEng78 "CVT normal mode engine torque gear 7 to 8" SWORD Trq 1 100 -3276.800 3276.700 FORMAT "%8.3" ECU_ADDRESS 0x60003DAC /end MEASUREMENT
/begin MEASUREMENT CoVMD_tqCVTEng8 "CVT normal mode engine torque gear 8" SWORD Trq 1 100 -3276.800 3276.700 FORMAT "%8.3" ECU_ADDRESS 0x60003DAA /end MEASUREMENT
/begin MEASUREMENT CoVMD_tqDesInnrWoCmp "Desired inner torque without compensation" SLONG TrqPrpHigh 1 100 -214748364.800 214748364.700 FORMAT "%13.3" ECU_ADDRESS 0x600018C0 /end MEASUREMENT
/begin MEASUREMENT CoVMD_tqDesTmp "Temporary desire torque" SLONG TrqPrpHigh 1 100 -214748364.800 214748364.700 FORMAT "%13.3" ECU_ADDRESS 0x600018BC /end MEASUREMENT
/begin MEASUREMENT CoVMD_tqDesTmpWhl "Temporary desired wheel torque" SLONG TrqPrpHigh 1 100 -214748364.800 214748364.700 FORMAT "%13.3" ECU_ADDRESS 0x600018B8 /end MEASUREMENT
/begin MEASUREMENT CoVMD_tqDesWhlWoCmp "Desured wheel torque without compensation" SLONG TrqPrpHigh 1 100 -214748364.800 214748364.700 FORMAT "%13.3" ECU_ADDRESS 0x60001D54 /end MEASUREMENT
/begin MEASUREMENT CoVMD_tqDrgWhlLvl "Drag torque at wheel level" SLONG TrqPrpHigh 1 100 -214748364.800 214748364.700 FORMAT "%13.3" ECU_ADDRESS 0x600018B4 /end MEASUREMENT
/begin MEASUREMENT CoVMD_tqEcoMaxIDAS "Maximum requested torque from IDAS unit for Eco Mode" SWORD TrqPrpHigh 1 100 -3276.800 3276.700 FORMAT "%8.3" ECU_ADDRESS 0x60003DA8 /end MEASUREMENT
/begin MEASUREMENT CoVMD_tqGearDesCVT "Desired CVT gear torque" SWORD Trq 1 100 -3276.800 3276.700 FORMAT "%8.3" ECU_ADDRESS 0x60003DA6 /end MEASUREMENT
/begin MEASUREMENT CoVMD_tqGearDesMT "Desired MT gear torque" SWORD Trq 1 100 -3276.800 3276.700 FORMAT "%8.3" ECU_ADDRESS 0x60003DA4 /end MEASUREMENT
/begin MEASUREMENT CoVMD_tqGearMod1CVT "Mode 1 CVT gear torque" SWORD Trq 1 100 -3276.800 3276.700 FORMAT "%8.3" ECU_ADDRESS 0x60003DA2 /end MEASUREMENT
/begin MEASUREMENT CoVMD_tqIDASFailOffs1 "IDAS torque failure offset threshold" SLONG RBPtCel_tq_1p0_1 1 100 -2147483648.00 2147483647.00 FORMAT "%13.2" ECU_ADDRESS 0x600018B0 /end MEASUREMENT
/begin MEASUREMENT CoVMD_tqIDASFailThd1 "IDAS torque failure detection threshold" SLONG RBPtCel_tq_1p0_1 1 100 -2147483648.00 2147483647.00 FORMAT "%13.2" ECU_ADDRESS 0x600018AC /end MEASUREMENT
/begin MEASUREMENT CoVMD_tqIDASFailThd2 "IDAS torque failure detection threshold" SLONG RBPtCel_tq_1p0_1 1 100 -2147483648.00 2147483647.00 FORMAT "%13.2" ECU_ADDRESS 0x600018A8 /end MEASUREMENT
/begin MEASUREMENT CoVMD_tqInnrLvlIDASReq "IDAS torque request at Inner level" SLONG TrqPrpHigh 1 100 -214748364.800 214748364.700 FORMAT "%13.3" ECU_ADDRESS 0x600018A4 /end MEASUREMENT
/begin MEASUREMENT CoVMD_tqIntrpnCvt2EcoAry "New CVT2 torque interpolation array in Eco mode" SWORD TrqPrpHigh 1 100 -3276.800 3276.700 FORMAT "%8.3" ARRAY_SIZE 16 ECU_ADDRESS 0x60003D78 /end MEASUREMENT
/begin MEASUREMENT CoVMD_tqIntrpnCvt2NormAry "New CVT2 torque interpolation array in Normal mode" SWORD TrqPrpHigh 1 100 -3276.800 3276.700 FORMAT "%8.3" ARRAY_SIZE 16 ECU_ADDRESS 0x60003D58 /end MEASUREMENT
/begin MEASUREMENT CoVMD_tqIntrpnEco1Ary "New torque interpolation array for eco mode 1" SWORD TrqPrpHigh 1 100 -3276.800 3276.700 FORMAT "%8.3" ARRAY_SIZE 16 ECU_ADDRESS 0x60003D38 /end MEASUREMENT
/begin MEASUREMENT CoVMD_tqIntrpnEco2Ary "New torque interpolation array for eco mode 2" SWORD TrqPrpHigh 1 100 -3276.800 3276.700 FORMAT "%8.3" ARRAY_SIZE 16 ECU_ADDRESS 0x60003D18 /end MEASUREMENT
/begin MEASUREMENT CoVMD_tqIntrpnEcoAry "Final torque interpolation array for eco mode" SWORD TrqPrpHigh 1 100 -3276.800 3276.700 FORMAT "%8.3" ARRAY_SIZE 16 ECU_ADDRESS 0x60003CF8 /end MEASUREMENT
/begin MEASUREMENT CoVMD_tqIntrpnEcoMTAry "Interpolated array of torque values for MT Eco Mode" SWORD TrqPrpHigh 1 100 -3276.800 3276.700 FORMAT "%8.3" ARRAY_SIZE 16 ECU_ADDRESS 0x60003CD8 /end MEASUREMENT
/begin MEASUREMENT CoVMD_tqIntrpnNorm1Ary "New torque interpolation array for normal mode 1" SWORD TrqPrpHigh 1 100 -3276.800 3276.700 FORMAT "%8.3" ARRAY_SIZE 16 ECU_ADDRESS 0x60003CB8 /end MEASUREMENT
/begin MEASUREMENT CoVMD_tqIntrpnNorm2Ary "New torque interpolation array for normal mode 2" SWORD TrqPrpHigh 1 100 -3276.800 3276.700 FORMAT "%8.3" ARRAY_SIZE 16 ECU_ADDRESS 0x60003C98 /end MEASUREMENT
/begin MEASUREMENT CoVMD_tqIntrpnNormAry "Final torque interpolation array for normal mode" SWORD TrqPrpHigh 1 100 -3276.800 3276.700 FORMAT "%8.3" ARRAY_SIZE 16 ECU_ADDRESS 0x60003C78 /end MEASUREMENT
/begin MEASUREMENT CoVMD_tqIntrpnNormMTAry "Interpolated array of torque values for MT Normal Mode" SWORD TrqPrpHigh 1 100 -3276.800 3276.700 FORMAT "%8.3" ARRAY_SIZE 16 ECU_ADDRESS 0x60003C58 /end MEASUREMENT
/begin MEASUREMENT CoVMD_tqLLim "Speed limiter torque" SLONG TrqPrpHigh 1 100 -214748364.800 214748364.700 FORMAT "%13.3" ECU_ADDRESS 0x600018A0 /end MEASUREMENT
/begin MEASUREMENT CoVMD_tqLLimACCReq "Minimum possible adjustable torque" SLONG TrqPrpHigh 1 100 -214748364.800 214748364.700 FORMAT "%13.3" ECU_ADDRESS 0x60001D50 /end MEASUREMENT
/begin MEASUREMENT CoVMD_tqLossSum "Sum of total loss torque" SLONG TrqPrpHigh 1 100 -214748364.800 214748364.700 FORMAT "%13.3" ECU_ADDRESS 0x6000189C /end MEASUREMENT
/begin MEASUREMENT CoVMD_tqMapBasd "Based map torque" SWORD Trq 1 100 -3276.800 3276.700 FORMAT "%8.3" ECU_ADDRESS 0x60003DA0 /end MEASUREMENT
/begin MEASUREMENT CoVMD_tqMaxAllwdIDAS "Maximum requested torque from IDAS unit" SLONG TrqPrpHigh 1 100 -214748364.800 214748364.700 FORMAT "%13.3" ECU_ADDRESS 0x60001D4C /end MEASUREMENT
/begin MEASUREMENT CoVMD_tqMinAbslt "Absolutely value of minimum torque" SLONG RBPtCel_tq_1p0_1 1 100 -2147483648.00 2147483647.00 FORMAT "%13.2" ECU_ADDRESS 0x60001898 /end MEASUREMENT
/begin MEASUREMENT CoVMD_tqMinAllwdIDAS "Minimum requested torque for IDAS unit" SLONG TrqPrpHigh 1 100 -214748364.800 214748364.700 FORMAT "%13.3" ECU_ADDRESS 0x60001D48 /end MEASUREMENT
/begin MEASUREMENT CoVMD_tqNewTmp "Temporary value of torque based on current drive mode" SWORD Trq 1 100 -3276.800 3276.700 FORMAT "%8.3" ECU_ADDRESS 0x60003D9E /end MEASUREMENT
/begin MEASUREMENT CoVMD_tqNormMaxIDAS "Maximum requested torque from IDAS unit for Normal Mode" SWORD TrqPrpHigh 1 100 -3276.800 3276.700 FORMAT "%8.3" ECU_ADDRESS 0x60003D9C /end MEASUREMENT
/begin MEASUREMENT CoVMD_tqNotSwilLoss "Not swapable torque loss" SLONG TrqPrpHigh 1 100 -214748364.800 214748364.700 FORMAT "%13.3" ECU_ADDRESS 0x60001894 /end MEASUREMENT
/begin MEASUREMENT CoVMD_tqOldTmp "Temporary value of torque based on previous drive mode" SWORD Trq 1 100 -3276.800 3276.700 FORMAT "%8.3" ECU_ADDRESS 0x60003D9A /end MEASUREMENT
/begin MEASUREMENT CoVMD_tqPrpnCrCtlLLim "Cruise control and Speed limiter Propulsion torque" SLONG TrqPrpHigh 1 100 -214748364.800 214748364.700 FORMAT "%13.3" ECU_ADDRESS 0x60001890 /end MEASUREMENT
/begin MEASUREMENT CoVMD_tqWhlCmpTmp "Temporary IDAS wheel torque with compensation" SLONG TrqPrpHigh 1 100 -214748364.800 214748364.700 FORMAT "%13.3" ECU_ADDRESS 0x6000188C /end MEASUREMENT
/begin MEASUREMENT CoVMD_tqWhlMax "Torque wheel max" SLONG TrqPrpHigh 1 100 -214748364.800 214748364.700 FORMAT "%13.3" ECU_ADDRESS 0x60001888 /end MEASUREMENT
/begin MEASUREMENT CoVMD_tqWhlMinEng "Torque wheel min" SLONG TrqPrpHigh 1 100 -214748364.800 214748364.700 FORMAT "%13.3" ECU_ADDRESS 0x60001884 /end MEASUREMENT
/begin MEASUREMENT CoVMD_tqWhlMinWoFco "Torque wheel min without fuel cut-off" SLONG TrqPrpHigh 1 100 -214748364.800 214748364.700 FORMAT "%13.3" ECU_ADDRESS 0x60001880 /end MEASUREMENT
/begin MEASUREMENT CoVMD_tqWhlWithLoss "Wheel torque with losses" SLONG TrqPrpHigh 1 100 -214748364.800 214748364.700 FORMAT "%13.3" ECU_ADDRESS 0x6000187C /end MEASUREMENT
/begin MEASUREMENT CoVMD_tqWoCtOff "torque without cut-off" SWORD Trq 1 100 -3276.800 3276.700 FORMAT "%8.3" ECU_ADDRESS 0x60003D98 /end MEASUREMENT
/begin MEASUREMENT CoVMD_trqCrCtl "Propulsion torque of cruise control" SLONG TrqPrpHigh 1 100 -214748364.800 214748364.700 FORMAT "%13.3" ECU_ADDRESS 0x60001D44 /end MEASUREMENT
/begin MEASUREMENT CoVMD_trqLLim "Propulsion torque of longitudinal limiter" SLONG TrqPrpHigh 1 100 -214748364.800 214748364.700 FORMAT "%13.3" ECU_ADDRESS 0x60001D40 /end MEASUREMENT
/begin MEASUREMENT CoVOM_bAbortedStopReq "A stop request will be aborted after a calibratable time, if the stop releases are not given." UBYTE B_TRUE 1 100 0.00 1.00000000000 BIT_MASK 0x1 FORMAT "%13.11" ECU_ADDRESS 0x6000A1EA /end MEASUREMENT
/begin MEASUREMENT CoVOM_bACStopReqTimeout "AC stop request time out during idle stop" UBYTE B_TRUE 1 100 0.00 1.00000000000 BIT_MASK 0x1 FORMAT "%13.11" ECU_ADDRESS 0x700008CB /end MEASUREMENT
/begin MEASUREMENT CoVOM_bAutoRstrtReq "Auto restart request" UBYTE B_TRUE 1 100 0.00 1.00000000000 BIT_MASK 0x1 FORMAT "%13.11" ECU_ADDRESS 0x6000A1E9 /end MEASUREMENT
/begin MEASUREMENT CoVOM_bChangeOfMind "Status which indicates that change of mind is active" UBYTE B_TRUE 1 100 0.00 1.00000000000 BIT_MASK 0x1 FORMAT "%13.11" ECU_ADDRESS 0x6000A1E6 /end MEASUREMENT
/begin MEASUREMENT CoVOM_bCVTIdleStop "Status of idle stop request" UBYTE B_TRUE 1 100 0.00 1.00000000000 BIT_MASK 0x1 FORMAT "%13.11" ECU_ADDRESS 0x6000A1E8 /end MEASUREMENT
/begin MEASUREMENT CoVOM_bCVTStopEna "Status of Preparation for Idle Stop" UBYTE B_TRUE 1 100 0.00 1.00000000000 BIT_MASK 0x1 FORMAT "%13.11" ECU_ADDRESS 0x6000A1E7 /end MEASUREMENT
/begin MEASUREMENT CoVOM_bDEFInhbReqIndcn "Status which indicates Stop Inhibition Request from Front Defogger Switch" UBYTE B_TRUE 1 100 0.00 1.00000000000 BIT_MASK 0x1 FORMAT "%13.11" ECU_ADDRESS 0x6000A1E5 /end MEASUREMENT
/begin MEASUREMENT CoVOM_bEngFrstStrtPassed "Status which indicates that the first start has occured" UBYTE B_TRUE 1 100 0.00 1.00000000000 BIT_MASK 0x1 FORMAT "%13.11" ECU_ADDRESS 0x6000A1E4 /end MEASUREMENT
/begin MEASUREMENT CoVOM_bEngPreStrtOrd "Pre-order to engine for engine start" UBYTE OneToOne 1 100 0.00 255.0 FORMAT "%5.1" ECU_ADDRESS 0x6000A666 /end MEASUREMENT
/begin MEASUREMENT CoVOM_bNeutBasdRstrt "Restart release extension when shift from Neutral" UBYTE B_TRUE 1 100 0.00 1.00000000000 BIT_MASK 0x1 FORMAT "%13.11" ECU_ADDRESS 0x6000A1E3 /end MEASUREMENT
/begin MEASUREMENT CoVOM_bRvsGearTran "Flag to check the transition of reverse gear to neutral" UBYTE B_TRUE 1 100 0.00 1.00000000000 BIT_MASK 0x1 FORMAT "%13.11" ECU_ADDRESS 0x60009B91 /end MEASUREMENT
/begin MEASUREMENT CoVOM_bRvsHist "Reverse history flag" UBYTE B_TRUE 1 100 0.00 1.00000000000 BIT_MASK 0x1 FORMAT "%13.11" ECU_ADDRESS 0x6000A1E2 /end MEASUREMENT
/begin MEASUREMENT CoVOM_bSeatBltBasdRstrt "Seat belt based restart release" UBYTE B_TRUE 1 100 0.00 1.00000000000 BIT_MASK 0x1 FORMAT "%13.11" ECU_ADDRESS 0x60009B90 /end MEASUREMENT
/begin MEASUREMENT CoVOM_bSSEEna "Stop Start enabled based on application parameter" UBYTE B_TRUE 1 100 0.00 1.00000000000 BIT_MASK 0x1 FORMAT "%13.11" ECU_ADDRESS 0x6000A1E1 /end MEASUREMENT
/begin MEASUREMENT CoVOM_bSSEEngStopPassed "Status which indicates that the engine was stopped by the coordinator" UBYTE B_TRUE 1 100 0.00 1.00000000000 BIT_MASK 0x1 FORMAT "%13.11" ECU_ADDRESS 0x6000A1E0 /end MEASUREMENT
/begin MEASUREMENT CoVOM_bSSEUIStrtReq "An engine start has been requested, because of the deactivating Start/Stop- button." UBYTE B_TRUE 1 100 0.00 1.00000000000 BIT_MASK 0x1 FORMAT "%13.11" ECU_ADDRESS 0x70002D80 /end MEASUREMENT
/begin MEASUREMENT CoVOM_bStopDrvReq "Status of driver stop request" UBYTE B_TRUE 1 100 0.00 1.00000000000 BIT_MASK 0x1 FORMAT "%13.11" ECU_ADDRESS 0x6000A1DF /end MEASUREMENT
/begin MEASUREMENT CoVOM_bStopEna "An Autostop has been released." UBYTE B_TRUE 1 100 0.00 1.00000000000 BIT_MASK 0x1 FORMAT "%13.11" ECU_ADDRESS 0x700008CA /end MEASUREMENT
/begin MEASUREMENT CoVOM_bStopReq "Stop request is given by the stop request conditions" UBYTE B_TRUE 1 100 0.00 1.00000000000 BIT_MASK 0x1 FORMAT "%13.11" ECU_ADDRESS 0x700008C9 /end MEASUREMENT
/begin MEASUREMENT CoVOM_bStopTraReq "Status of Transmission stop request" UBYTE B_TRUE 1 100 0.00 1.00000000000 BIT_MASK 0x1 FORMAT "%13.11" ECU_ADDRESS 0x6000A1DE /end MEASUREMENT
/begin MEASUREMENT CoVOM_bStrtEna "Start release is given." UBYTE B_TRUE 1 100 0.00 1.00000000000 BIT_MASK 0x1 FORMAT "%13.11" ECU_ADDRESS 0x700008C8 /end MEASUREMENT
/begin MEASUREMENT CoVOM_bStrtReq "Start request is given by start request conditions" UBYTE B_TRUE 1 100 0.00 1.00000000000 BIT_MASK 0x1 FORMAT "%13.11" ECU_ADDRESS 0x700008C7 /end MEASUREMENT
/begin MEASUREMENT CoVOM_bSysOff "System off mode from idle stop" UBYTE B_TRUE 1 100 0.00 1.00000000000 BIT_MASK 0x1 FORMAT "%13.11" ECU_ADDRESS 0x6000A1DD /end MEASUREMENT
/begin MEASUREMENT CoVOM_bVehCdnStopTrig "Idle Stop trigger from driver" UBYTE B_TRUE 1 100 0.00 1.00000000000 BIT_MASK 0x1 FORMAT "%13.11" ECU_ADDRESS 0x6000A1DB /end MEASUREMENT
/begin MEASUREMENT CoVOM_bVXEngStopRea_mp "This variable indicates reached minimum velocity after the stop phase" UBYTE B_TRUE 1 100 0.00 1.00000000000 BIT_MASK 0x1 FORMAT "%13.11" ECU_ADDRESS 0x70009206 /end MEASUREMENT
/begin MEASUREMENT CoVOM_bVXSinceStrtDeb "Vehicle velocity since start of vehicle" UBYTE B_TRUE 1 100 0.00 1.00000000000 BIT_MASK 0x1 FORMAT "%13.11" ECU_ADDRESS 0x6000A1DC /end MEASUREMENT
/begin MEASUREMENT CoVOM_ctFirstVldChk "Count to allow IS suppression logic time check" UBYTE OneToOne 1 100 0.00 255.0 FORMAT "%5.1" ECU_ADDRESS 0x60009B8F /end MEASUREMENT
/begin MEASUREMENT CoVOM_flgAllwRstrtBrk "Flag allow restart by brake on" UBYTE B_TRUE 1 100 0.00 1.00000000000 BIT_MASK 0x1 FORMAT "%13.11" ECU_ADDRESS 0x60009B8E /end MEASUREMENT
/begin MEASUREMENT CoVOM_flgBrkHldStbyOff "Flag to indicate that the brake hold switch is turned off" UBYTE B_TRUE 1 100 0.00 1.00000000000 BIT_MASK 0x1 FORMAT "%13.11" ECU_ADDRESS 0x60009B8D /end MEASUREMENT
/begin MEASUREMENT CoVOM_flgBrkOffMoFPrmt "Flag to indicate Brake status with delayed turn off" UBYTE B_TRUE 1 100 0.00 1.00000000000 BIT_MASK 0x1 FORMAT "%13.11" ECU_ADDRESS 0x6000A1DA /end MEASUREMENT
/begin MEASUREMENT CoVOM_flgChgOfMndReq "Flag to indicate change of mind request" UBYTE B_TRUE 1 100 0.00 1.00000000000 BIT_MASK 0x1 FORMAT "%13.11" ECU_ADDRESS 0x60009B8C /end MEASUREMENT
/begin MEASUREMENT CoVOM_flgEngRstrtInhb "Restart from idle stop inhibit condition" UBYTE B_TRUE 1 100 0.00 1.00000000000 BIT_MASK 0x1 FORMAT "%13.11" ECU_ADDRESS 0x6000A1D9 /end MEASUREMENT
/begin MEASUREMENT CoVOM_flgEngStallAftDly "Engine stall delay after 3 secs" UBYTE B_TRUE 1 100 0.00 1.00000000000 BIT_MASK 0x1 FORMAT "%13.11" ECU_ADDRESS 0x6000A1D8 /end MEASUREMENT
/begin MEASUREMENT CoVOM_flgLSFActvStrtReq_MP "Status of Start request from ACC LSF active stop" UBYTE B_TRUE 1 100 0.00 1.00000000000 BIT_MASK 0x1 FORMAT "%13.11" ECU_ADDRESS 0x70009205 /end MEASUREMENT
/begin MEASUREMENT CoVOM_flgMoFPrmt "flag to indicate MoF permit time" UBYTE B_TRUE 1 100 0.00 1.00000000000 BIT_MASK 0x1 FORMAT "%13.11" ECU_ADDRESS 0x6000A1D7 /end MEASUREMENT
/begin MEASUREMENT CoVOM_flgRstrtReqBrkOn "Restart request flag by brake on" UBYTE B_TRUE 1 100 0.00 1.00000000000 BIT_MASK 0x1 FORMAT "%13.11" ECU_ADDRESS 0x60009B8B /end MEASUREMENT
/begin MEASUREMENT CoVOM_flgSeatBltOff "Seat belt unlatched during idle stop" UBYTE B_TRUE 1 100 0.00 1.00000000000 BIT_MASK 0x1 FORMAT "%13.11" ECU_ADDRESS 0x6000A1D6 /end MEASUREMENT
/begin MEASUREMENT CoVOM_flgStrtAbortMoF "Flag to indicate starter abort at level 2" UBYTE B_TRUE 1 100 0.00 1.00000000000 BIT_MASK 0x1 FORMAT "%13.11" ECU_ADDRESS 0x6000A1D5 /end MEASUREMENT
/begin MEASUREMENT CoVOM_flgTrigCamsftRefPosn "status flag indicating the trigger camshaft to reference position" UBYTE B_TRUE 1 100 0.00 1.00000000000 BIT_MASK 0x1 FORMAT "%13.11" ECU_ADDRESS 0x6000E403 /end MEASUREMENT
/begin MEASUREMENT CoVOM_numEngStrtAbrt "Number of start abortions" ULONG OneToOne 1 100 0.00 4294967295.00 FORMAT "%13.2" ECU_ADDRESS 0x60001C84 /end MEASUREMENT
/begin MEASUREMENT CoVOM_pRelThdForStrtReq "Threshold for judgment of negative pressure change in the vacuum chamber after ISAB comes into operation and give a start request" SLONG Pres_hPa 1 100 -2147483648.00 2147483647.00 FORMAT "%13.2" ECU_ADDRESS 0x60001878 /end MEASUREMENT
/begin MEASUREMENT CoVOM_stEngCrkAbort "staus of engine crank abort" UBYTE B_TRUE 1 100 0.00 1.00000000000 BIT_MASK 0x1 FORMAT "%13.11" ECU_ADDRESS 0x6000A1D1 /end MEASUREMENT
/begin MEASUREMENT CoVOM_stEngCrkAbortReqd "status of engine crank abort requested" UBYTE B_TRUE 1 100 0.00 1.00000000000 BIT_MASK 0x1 FORMAT "%13.11" ECU_ADDRESS 0x60009B8A /end MEASUREMENT
/begin MEASUREMENT CoVOM_stEngInhbReqEna "MVCPA enable status" UBYTE B_TRUE 1 100 0.00 1.00000000000 BIT_MASK 0x1 FORMAT "%13.11" ECU_ADDRESS 0x60009B89 /end MEASUREMENT
/begin MEASUREMENT CoVOM_stEngRstrtEnaCdn "status of the engine restart enable condition" UBYTE B_TRUE 1 100 0.00 1.00000000000 BIT_MASK 0x1 FORMAT "%13.11" ECU_ADDRESS 0x60009B88 /end MEASUREMENT
/begin MEASUREMENT CoVOM_stEngRstrtPreReq "Engine stall restart enable conditions" UBYTE B_TRUE 1 100 0.00 1.00000000000 BIT_MASK 0x1 FORMAT "%13.11" ECU_ADDRESS 0x700008C6 /end MEASUREMENT
/begin MEASUREMENT CoVOM_stEngRstrtReq "Engine stall restart Request" UBYTE B_TRUE 1 100 0.00 1.00000000000 BIT_MASK 0x1 FORMAT "%13.11" ECU_ADDRESS 0x6000A1D0 /end MEASUREMENT
/begin MEASUREMENT CoVOM_stEngRstrtReqd "status of engine restart requested" UBYTE B_TRUE 1 100 0.00 1.00000000000 BIT_MASK 0x1 FORMAT "%13.11" ECU_ADDRESS 0x60009B87 /end MEASUREMENT
/begin MEASUREMENT CoVOM_stEngRstrtTrigReq "Engine stall restart trigger condition" UBYTE B_TRUE 1 100 0.00 1.00000000000 BIT_MASK 0x1 FORMAT "%13.11" ECU_ADDRESS 0x700002F9 /end MEASUREMENT
/begin MEASUREMENT CoVOM_stEngStall "status indicating engine stall happend" UBYTE B_TRUE 1 100 0.00 1.00000000000 BIT_MASK 0x1 FORMAT "%13.11" ECU_ADDRESS 0x60009B86 /end MEASUREMENT
/begin MEASUREMENT CoVOM_stEngStopPreCdn "Engine stop pre-condition satisfied" UBYTE B_TRUE 1 100 0.00 1.00000000000 BIT_MASK 0x1 FORMAT "%13.11" ECU_ADDRESS 0x6000A1CF /end MEASUREMENT
/begin MEASUREMENT CoVOM_stEngStrtdOnce "status of the enigne started at least once" UBYTE B_TRUE 1 100 0.00 1.00000000000 BIT_MASK 0x1 FORMAT "%13.11" ECU_ADDRESS 0x60009B85 /end MEASUREMENT
/begin MEASUREMENT CoVOM_stISGoJud "Idling stop judgment" UBYTE B_TRUE 1 100 0.00 1.00000000000 BIT_MASK 0x1 FORMAT "%13.11" ECU_ADDRESS 0x6000A1CE /end MEASUREMENT
/begin MEASUREMENT CoVOM_stISGoStb "Standby conditions for IS" UBYTE B_TRUE 1 100 0.00 1.00000000000 BIT_MASK 0x1 FORMAT "%13.11" ECU_ADDRESS 0x6000A1CD /end MEASUREMENT
/begin MEASUREMENT CoVOM_stISSEng "Status of ISS for AT vehicle" UBYTE OneToOne 1 100 0.00 255.0 FORMAT "%5.1" ECU_ADDRESS 0x6000A665 /end MEASUREMENT
/begin MEASUREMENT CoVOM_stISSEngTemp "Temp Status of ISS for AT vehicle" UBYTE OneToOne 1 100 0.00 255.0 FORMAT "%5.1" ECU_ADDRESS 0x60009B84 /end MEASUREMENT
/begin MEASUREMENT CoVOM_stISSEngTempOld "Temp Old Value of ISS Engine State" UBYTE OneToOne 1 100 0.00 255.0 FORMAT "%5.1" ECU_ADDRESS 0x60009B83 /end MEASUREMENT
/begin MEASUREMENT CoVOM_stISStopInhb "Stop Inhibit status" UBYTE B_TRUE 1 100 0.00 1.00000000000 BIT_MASK 0x1 FORMAT "%13.11" ECU_ADDRESS 0x6000A1CC /end MEASUREMENT
/begin MEASUREMENT CoVOM_stISSuppVehSpd "Is suppression based on vehicle speed" UBYTE B_TRUE 1 100 0.00 1.00000000000 BIT_MASK 0x1 FORMAT "%13.11" ECU_ADDRESS 0x6000A1CB /end MEASUREMENT
/begin MEASUREMENT CoVOM_stMaxNrStrtOperExcdd "Number of starter operations exceeded maximum permitted" UBYTE B_TRUE 1 100 0.00 1.00000000000 BIT_MASK 0x1 FORMAT "%13.11" ECU_ADDRESS 0x6000A1CA /end MEASUREMENT
/begin MEASUREMENT COVOM_stNotHiAlti "Status of high altitude condition" UBYTE B_TRUE 1 100 0.00 1.00000000000 BIT_MASK 0x1 FORMAT "%13.11" ECU_ADDRESS 0x60009B82 /end MEASUREMENT
/begin MEASUREMENT CoVOM_stPrkgPosn "Parking position certainly status" UBYTE B_TRUE 1 100 0.00 1.00000000000 BIT_MASK 0x1 FORMAT "%13.11" ECU_ADDRESS 0x60009B81 /end MEASUREMENT
/begin MEASUREMENT CoVOM_stRstrtReqByVehCdn "Restart request based on vehicle speed conditions" UBYTE B_TRUE 1 100 0.00 1.00000000000 BIT_MASK 0x1 FORMAT "%13.11" ECU_ADDRESS 0x6000A1C9 /end MEASUREMENT
/begin MEASUREMENT CoVOM_stSSE "Internal state of the coordinator state machine" UBYTE OneToOne 1 100 0.00 255.0 FORMAT "%5.1" ECU_ADDRESS 0x6000A664 /end MEASUREMENT
/begin MEASUREMENT CoVOM_stStop "The kind of Autostopp" UWORD OneToOne 1 100 0.00 65535.00 FORMAT "%8.2" ECU_ADDRESS 0x60004DA2 /end MEASUREMENT
/begin MEASUREMENT CoVOM_stStopEnaBit8Excl "Stop Release message excluding bit 8(vehicle velocity condition)." UBYTE B_TRUE 1 100 0.00 1.00000000000 BIT_MASK 0x1 FORMAT "%13.11" ECU_ADDRESS 0x6000A1C8 /end MEASUREMENT
/begin MEASUREMENT CoVOM_stStopEnaDspl "Stop releases display message" ULONG OneToOne 1 100 0.00 4294967295.00 FORMAT "%13.2" ECU_ADDRESS 0x50004BD4 /end MEASUREMENT
/begin MEASUREMENT CoVOM_stStopEnblByVehCdn "Idle Stop enable based on vehicle speed conditions" UBYTE B_TRUE 1 100 0.00 1.00000000000 BIT_MASK 0x1 FORMAT "%13.11" ECU_ADDRESS 0x6000A1C7 /end MEASUREMENT
/begin MEASUREMENT CoVOM_stStopReqCdn "Stop request condition" ULONG OneToOne 1 100 0.00 4294967295.00 FORMAT "%13.2" ECU_ADDRESS 0x60001C7C /end MEASUREMENT
/begin MEASUREMENT CoVOM_stStopReqDspl "Stop requests as a display message" ULONG OneToOne 1 100 0.00 4294967295.00 FORMAT "%13.2" ECU_ADDRESS 0x6000D704 /end MEASUREMENT
/begin MEASUREMENT CoVOM_stStopRls "Start Stop ready lamp flag" ULONG OneToOne 1 100 0.00 4294967295.00 FORMAT "%13.2" ECU_ADDRESS 0x50004BDC /end MEASUREMENT
/begin MEASUREMENT CoVOM_stStrt "The kind of start. Power start or comfort start" UWORD OneToOne 1 100 0.00 65535.00 FORMAT "%8.2" ECU_ADDRESS 0x60004DA0 /end MEASUREMENT
/begin MEASUREMENT CoVOM_stStrtAbort "Status indicating long cranking detetction used as a condition for start abortion" UBYTE B_TRUE 1 100 0.00 1.00000000000 BIT_MASK 0x1 FORMAT "%13.11" ECU_ADDRESS 0x60009B80 /end MEASUREMENT
/begin MEASUREMENT CoVOM_stStrtEnaCdn "Start enable condition" ULONG OneToOne 1 100 0.00 4294967295.00 FORMAT "%13.2" ECU_ADDRESS 0x60001C74 /end MEASUREMENT
/begin MEASUREMENT CoVOM_stStrtEnaDspl "Start releases as a display message" ULONG OneToOne 1 100 0.00 4294967295.00 FORMAT "%13.2" ECU_ADDRESS 0x50004BE4 /end MEASUREMENT
/begin MEASUREMENT CoVOM_stStrtReqBefMsk "Start request before masking for start from idle stop" ULONG OneToOne 1 100 0.00 4294967295.00 FORMAT "%13.2" ECU_ADDRESS 0x60001C70 /end MEASUREMENT
/begin MEASUREMENT CoVOM_stStrtReqCdn "Start request condition" ULONG OneToOne 1 100 0.00 4294967295.00 FORMAT "%13.2" ECU_ADDRESS 0x50004BE8 /end MEASUREMENT
/begin MEASUREMENT CoVOM_stStrtReqCluPosn "Start request based on clutch position" UBYTE B_TRUE 1 100 0.00 1.00000000000 BIT_MASK 0x1 FORMAT "%13.11" ECU_ADDRESS 0x6000A1C6 /end MEASUREMENT
/begin MEASUREMENT CoVOM_stStrtReqDspl "Start requests as a display messages" ULONG OneToOne 1 100 0.00 4294967295.00 FORMAT "%13.2" ECU_ADDRESS 0x50004BEC /end MEASUREMENT
/begin MEASUREMENT CoVOM_stSysOffRelsCdn "System off release condition" UBYTE OneToOne 1 100 0.00 255.0 FORMAT "%5.1" ECU_ADDRESS 0x60009B7F /end MEASUREMENT
/begin MEASUREMENT CoVOM_stSysOffTrigAftMsk "System off trigger After Masking" UWORD OneToOne 1 100 0.00 65535.00 FORMAT "%8.2" ECU_ADDRESS 0x60004D9E /end MEASUREMENT
/begin MEASUREMENT CoVOM_stSysOffTrigBefMsk "System off trigger before masking" UWORD OneToOne 1 100 0.00 65535.00 FORMAT "%8.2" ECU_ADDRESS 0x60004D9C /end MEASUREMENT
/begin MEASUREMENT CoVOM_stSysOffTrigMask "System off trigger mask" UBYTE OneToOne 1 100 0.00 255.0 FORMAT "%5.1" ECU_ADDRESS 0x6000A663 /end MEASUREMENT
/begin MEASUREMENT CoVOM_stTraStrtReq_MP "Status of Transmission start request" UBYTE OneToOne 1 100 0.00 255.0 FORMAT "%5.1" ECU_ADDRESS 0x70009204 /end MEASUREMENT
/begin MEASUREMENT CoVOM_tiEngRstrtAbort "time since the engine restart requested when the engine stalled" SWORD Time_s 1 100 0.00 327.6700 FORMAT "%8.4" ECU_ADDRESS 0x60003C56 /end MEASUREMENT
/begin MEASUREMENT CoVOM_tiSpdBlwChk "Time update when vehicle speed more than threshold" SLONG Time_s 1 100 -21474836.4800 21474836.4700 FORMAT "%13.4" ECU_ADDRESS 0x50001194 /end MEASUREMENT
/begin MEASUREMENT CoVOM_tiSpdBlwTmr "Timer when vehicle speed less than threshold" SLONG Time_s 1 100 -21474836.4800 21474836.4700 FORMAT "%13.4" ECU_ADDRESS 0x60001874 /end MEASUREMENT
/begin MEASUREMENT CoVOM_tiSpdExcdChk "Time update when vehicle speed less than threshold" SLONG Time_s 1 100 -21474836.4800 21474836.4700 FORMAT "%13.4" ECU_ADDRESS 0x60001870 /end MEASUREMENT
/begin MEASUREMENT CoVOM_tiSpdExcdTmr "Timer when vehicle speed more than threshold" SLONG Time_s 1 100 -21474836.4800 21474836.4700 FORMAT "%13.4" ECU_ADDRESS 0x50001198 /end MEASUREMENT
/begin MEASUREMENT CoVOM_tiStopReqWoEna_mp "Elapsed time with a stop request without stop releases" SLONG Time_ms 1 100 -21474836480.0 21474836470.0 FORMAT "%13.1" ECU_ADDRESS 0x70009200 /end MEASUREMENT
/begin MEASUREMENT CoVOM_tiUpDwnSpdHist "Elapsed time of up and down in speed history" SLONG Time_s 1 100 -21474836.4800 21474836.4700 FORMAT "%13.4" ECU_ADDRESS 0x5000119C /end MEASUREMENT
/begin MEASUREMENT CoVOM_vISFrqRstrcnSpd "IS frequency restriction speed" SWORD Vel 1 100 -327.6800 327.6700 FORMAT "%8.4" ECU_ADDRESS 0x60003C54 /end MEASUREMENT
/begin MEASUREMENT CoVOM_vWhlSpdMax "Maximum wheel speed calculated based on the 4 wheel speeds obtained" SWORD Vel 1 100 -327.6800 327.6700 FORMAT "%8.4" ECU_ADDRESS 0x60003C52 /end MEASUREMENT
/begin MEASUREMENT CoVOM_vWhlSpdMedian "Median value of wheel speed" SWORD Vel 1 100 -327.6800 327.6700 FORMAT "%8.4" ECU_ADDRESS 0x60003C50 /end MEASUREMENT
/begin MEASUREMENT CoVOM_vWhlSpdMin "Minimum wheel speed calculated based on the 4 wheel speeds obtained" SWORD Vel 1 100 -327.6800 327.6700 FORMAT "%8.4" ECU_ADDRESS 0x60003C4E /end MEASUREMENT
/begin MEASUREMENT CoVOM_vWhlSpdSum "Sum of the minimum and maximum wheel speeds calculated" SLONG Vel 1 100 -21474836.4800 21474836.4700 FORMAT "%13.4" ECU_ADDRESS 0x6000186C /end MEASUREMENT
/begin MEASUREMENT VehMot_facCompAcs "Coordinated factor of accessory compensation" SWORD Fact 1 100 -4.000000 3.999878 FORMAT "%8.6" ECU_ADDRESS 0x60004E0E /end MEASUREMENT
/begin MEASUREMENT VehMot_stCtOffPhd "Status fuel cut off prohibited by driving assistance functions" UBYTE B_TRUE 1 100 0.00 1.00000000000 BIT_MASK 0x1 FORMAT "%13.11" ECU_ADDRESS 0x6000A10F /end MEASUREMENT
/begin MEASUREMENT VehMot_stPrpCrCtl "Status cruise control overrides acceleration pedal" UBYTE OneToOne 1 100 0.00 255.0 FORMAT "%5.1" ECU_ADDRESS 0x6000A2B0 /end MEASUREMENT
/begin MEASUREMENT VehMot_stPrpLLim "Status longitudinal limiter controls propulsion torque" UBYTE OneToOne 1 100 0.00 255.0 FORMAT "%5.1" ECU_ADDRESS 0x6000A2AF /end MEASUREMENT
/begin MEASUREMENT VMD_tqCluDes "Propulsion torque at clutch level after driving assistance coordination" SWORD Trq 1 100 -3276.800 3276.700 FORMAT "%8.3" ECU_ADDRESS 0x60004E20 /end MEASUREMENT
/begin MEASUREMENT VMD_trqDes "Propulsion torque after driving assistance coordination" SLONG TrqPrpHigh 1 100 -214748364.800 214748364.700 FORMAT "%13.3" ECU_ADDRESS 0x60001CA4 /end MEASUREMENT
/begin FUNCTION CoVMD_TrqCalc "142.4.0   Torque Calculation of Vehicle Motion Demand"
 /begin DEF_CHARACTERISTIC CoVMD_cntrIDASFailDetn_C CoVMD_drIDASReqNeg_C CoVMD_drIDASReqPos_C CoVMD_facIDASFailDetn_C CoVMD_flgIDASMTCluOffEna_C CoVMD_flgSwtRatSelnTqPull_C CoVMD_nAPPReqChg_AXIS CoVMD_ratACCCVTMinWoRamp_C CoVMD_ratACCMinWoRamp_C CoVMD_ratIDASReqLoLim_C CoVMD_ratLLimCVTMinWoRamp_C CoVMD_ratLLimMinWoRamp_C CoVMD_ratVirtMaxThd_C CoVMD_rReqChng_GT CoVMD_rSptReqChng_GT CoVMD_stSwtAPMapSeln_C CoVMD_swtCCASLTrqSeln_C CoVMD_swtCCSelVal_C CoVMD_swtCrCtlDemSel_C CoVMD_swtMoFSel_C CoVMD_tiACCCVTRampSlop_CA CoVMD_tiACCRampSlop_CA CoVMD_tiBrkFailDeb_C CoVMD_tiIDASFailBrkDetn_C CoVMD_tiIDASReqLim_T CoVMD_tiLLimCVTRampSlop_CA CoVMD_tiLLimRampSlop_CA CoVMD_tiTqFild_T CoVMD_tqCrCtlReqDft_C CoVMD_tqCvtEcoATMod1_M CoVMD_tqCvtEcoATMod2_M CoVMD_tqCvtEcoATMod3_M CoVMD_tqCvtEcoATMod4_M CoVMD_tqCvtEcoATMod5_M CoVMD_tqCvtEcoATMod6_M CoVMD_tqCvtEcoATMod7_M CoVMD_tqCvtEcoDwnHill1_M CoVMD_tqCvtEcoDwnHill2_M CoVMD_tqCvtEcoDwnHill3_M CoVMD_tqCvtEcoDwnHill4_M CoVMD_tqCvtEcoDwnHill5_M CoVMD_tqCvtEcoDwnHill6_M CoVMD_tqCvtEcoLModOff_M CoVMD_tqCvtEcoLModOn_M CoVMD_tqCvtEcoLnchD_M CoVMD_tqCvtEcoLnchE_M CoVMD_tqCvtEcoLnchL_M CoVMD_tqCvtEcoLnchS_M CoVMD_tqCvtEcoNormD12_M CoVMD_tqCvtEcoNormD2_M CoVMD_tqCvtEcoNormD_M CoVMD_tqCvtEcoNormE12_M CoVMD_tqCvtEcoNormE1_M CoVMD_tqCvtEcoNormE2_M CoVMD_tqCvtEcoNormE_M CoVMD_tqCvtEcoNormS0_M CoVMD_tqCvtEcoNormS1_M CoVMD_tqCvtEcoNormS2_M CoVMD_tqCvtEcoNormSP_M CoVMD_tqCvtEcoTipMod1_M CoVMD_tqCvtEcoTipMod2_M CoVMD_tqCvtEcoTipMod3_M CoVMD_tqCvtEcoTipMod4_M CoVMD_tqCvtEcoTipMod5_M CoVMD_tqCvtEcoTipMod6_M CoVMD_tqCvtEcoTipMod7_M CoVMD_tqCvtNormATMod1_M CoVMD_tqCvtNormATMod2_M CoVMD_tqCvtNormATMod3_M CoVMD_tqCvtNormATMod4_M CoVMD_tqCvtNormATMod5_M CoVMD_tqCvtNormATMod6_M CoVMD_tqCvtNormATMod7_M CoVMD_tqCvtNormDwnHill1_M CoVMD_tqCvtNormDwnHill2_M CoVMD_tqCvtNormDwnHill3_M CoVMD_tqCvtNormDwnHill4_M CoVMD_tqCvtNormDwnHill5_M CoVMD_tqCvtNormDwnHill6_M CoVMD_tqCvtNormLModOff_M CoVMD_tqCvtNormLModOn_M CoVMD_tqCvtNormLnchD_M CoVMD_tqCvtNormLnchE_M CoVMD_tqCvtNormLnchL_M CoVMD_tqCvtNormLnchS_M CoVMD_tqCvtNormNormD12_M CoVMD_tqCvtNormNormD2_M CoVMD_tqCvtNormNormD_M CoVMD_tqCvtNormNormE12_M CoVMD_tqCvtNormNormE1_M CoVMD_tqCvtNormNormE2_M CoVMD_tqCvtNormNormE_M CoVMD_tqCvtNormNormS0_M CoVMD_tqCvtNormNormS1_M CoVMD_tqCvtNormNormS2_M CoVMD_tqCvtNormNormSP_M CoVMD_tqCvtNormTipMod1_M CoVMD_tqCvtNormTipMod2_M CoVMD_tqCvtNormTipMod3_M CoVMD_tqCvtNormTipMod4_M CoVMD_tqCvtNormTipMod5_M CoVMD_tqCvtNormTipMod6_M CoVMD_tqCvtNormTipMod7_M CoVMD_tqIDASFailOffs_C CoVMD_tqIDASTarThd_C CoVMD_trqThresCtOffLo_C CoVMD_trqThresCtOffUp_C CoVMD_vIDASFailDetn_C /end DEF_CHARACTERISTIC
 /begin REF_CHARACTERISTIC AccPed_flgNotSwilLossCmp_C AccPed_flgSelFacCmpAcs_C AccPed_rAPPHysHi_C AccPed_rAPPHysLo_C AccPed_rThdMaxCmp_C AccPed_rThdNoCmp_C AccPed_swtFilActvn_C AccPed_tiGearFildFil_CA AccPed_tiGearFildRmp_CA AccPed_tqCvtEcoEng0_M AccPed_tqCvtEcoEng1_M AccPed_tqCvtEcoEng2_M AccPed_tqCvtEcoEng3_M AccPed_tqCvtEcoEng4_M AccPed_tqCvtEcoEng5_M AccPed_tqCvtEcoEng6_M AccPed_tqCvtEcoEng7_M AccPed_tqCvtEcoEng8_M AccPed_tqCvtEng0_M AccPed_tqCvtEng1_M AccPed_tqCvtEng2_M AccPed_tqCvtEng3_M AccPed_tqCvtEng4_M AccPed_tqCvtEng5_M AccPed_tqCvtEng6_M AccPed_tqCvtEng7_M AccPed_tqCvtEng8_M AccPed_tqFilSwtOffLim_C AccPed_tqMinWoRamp_C AccPed_tqMTGear1_M AccPed_tqMTGear2_M AccPed_tqMTGear3_M AccPed_tqMTGear4_M AccPed_tqMTGear5_M AccPed_tqMTGear6_M AccPed_trqMod1Gear1_M AccPed_trqMod1Gear2_M AccPed_trqMod1Gear3_M AccPed_trqMod1Gear4_M AccPed_trqMod1Gear5_M AccPed_trqMod1Gear6_M /end REF_CHARACTERISTIC
 /begin IN_MEASUREMENT AccPed_flgChgGearDetn AccPed_flgDrvModChg AccPed_nrGearFildTmp AccPed_rTrq AccPed_swtDrvMod ACC_bBrkReq APP_r Brk_st Brk_stEBBBrkDetn CoME_trqDesComp Com_bBrkPedON Com_numCvtGearShiftMap Com_rTrqCnvBoost Com_rVirtAPP Com_stACCActv Com_stIDASEngFail Com_stIDASInhb Com_tqIDASTar Com_trq2IDASTar CoVeh_trqAcs CrCtl_nTrqOffChkAdd CrCtl_nTrqOffReqChk CrCtl_numATType CrCtl_rACCBrkReqChg CrCtl_rDes CrCtl_rGearNo0 CrCtl_rGearNo1 CrCtl_rGearNo2 CrCtl_rGearNo3 CrCtl_stActive CrCtl_stIdasbCanErr CrCtl_tiACCInfo CrCtl_tiAutoBrkHold CrCUI_nEngSpd CrCUI_stACCClthOn CrCUI_stGearDownNo Epm_nEng LLim_aReq LLim_rDes LLim_stActive LLim_stASLIdasbCanErr LLim_stMSLActv LLim_stReq LsComp_bLossCmpActvd MoFDrAs_stPtdMsg PT_nClth PT_rTrq PT_stTraType PT_trqLos RngMod_trqComp RngMod_trqCrSMax RngMod_trqCrSMin RngMod_trqCrSMinWoCtOff RngMod_trqDiffAdap RngMod_trqInrMinWoCtOff RngMod_trqLosEng SpdGov_facComp SyC_ctPostDrvLeave T15_st Tra_rGearCVT1Hi Tra_rGearCVT1Lo Tra_rGearCVT2Hi Tra_rGearCVT2Lo Tra_rGearCVT3Hi Tra_rGearCVT3Lo Tra_rGearCVT4Hi Tra_rGearCVT4Lo Tra_rGearCVT5Hi Tra_rGearCVT5Lo Tra_rGearCVT6Hi Tra_rGearCVT6Lo Tra_rGearCVT7Hi Tra_rGearCVT7Lo Tra_trqLos VehMot_a2trq VehMot_rTrqDfftl VehMot_trqDrag VehV_v /end IN_MEASUREMENT
 /begin OUT_MEASUREMENT CoVMD_bCtOffPhdCrCtl CoVMD_bCtOffPhdLLim CoVMD_facCompAcs CoVMD_facCompAcsCrCtl CoVMD_facCompAcsLLim CoVMD_flgIDASFailDetn CoVMD_flgIDASMTCluOffEna CoVMD_r CoVMD_ratCrsCtrlLLimIDASReq CoVMD_rCrCtl CoVMD_rCrCtlACCReq CoVMD_rLLimACCReq CoVMD_rReqChg CoVMD_rSptReqChg CoVMD_stReqCrCtl CoVMD_stSwtCCASLTqSeln CoVMD_swtCCSel CoVMD_tqCrCtlACCReq CoVMD_tqCrsCtrlLLimIDASReq CoVMD_tqDesWhlWoCmp CoVMD_tqIntrpnCvt2EcoAry CoVMD_tqIntrpnCvt2NormAry CoVMD_tqIntrpnEco1Ary CoVMD_tqIntrpnEco2Ary CoVMD_tqIntrpnEcoAry CoVMD_tqIntrpnEcoMTAry CoVMD_tqIntrpnNorm1Ary CoVMD_tqIntrpnNorm2Ary CoVMD_tqIntrpnNormAry CoVMD_tqIntrpnNormMTAry CoVMD_tqLLimACCReq CoVMD_tqMaxAllwdIDAS CoVMD_tqMinAllwdIDAS CoVMD_trqCrCtl CoVMD_trqLLim /end OUT_MEASUREMENT
 /begin LOC_MEASUREMENT CoVMD_cntrAryRst CoVMD_cntrIDASFailDetn CoVMD_cntrReIni CoVMD_facACC CoVMD_facACCStep CoVMD_facAppMaxCmp CoVMD_facLLim CoVMD_facLLimStep CoVMD_facModSwt CoVMD_facModSwtStep CoVMD_flgACCRampActv CoVMD_flgBrkDetn CoVMD_flgBrkFailDeb CoVMD_flgDrvActv CoVMD_flgIDASCntrRst CoVMD_flgIDASFailBrkCdn CoVMD_flgIDASFailTqCdn CoVMD_flgRampLLimActv CoVMD_nDesVal CoVMD_nTrqOffLimA CoVMD_nTrqOffLimB CoVMD_ratCvtEco2 CoVMD_ratIDASCVTEco CoVMD_ratIDASCVTNorm CoVMD_ratIDASCvtNorm2 CoVMD_ratIDASMTEco CoVMD_ratIDASMTNorm CoVMD_ratIDASReq CoVMD_ratIDASReqLim CoVMD_ratIDASReqMax CoVMD_ratIDASReqNewTmp CoVMD_ratIDASReqOld CoVMD_ratIDASReqOldTmp CoVMD_ratIDASReqTmp CoVMD_ratVirtMax CoVMD_rIDASCrsCluOffReq CoVMD_rTq CoVMD_rTqFild CoVMD_rVirtApp CoVMD_stRampActv CoVMD_tiACCRampSlop CoVMD_tiBrkFailDeb CoVMD_tiIDASReqLim CoVMD_tiLLimRampSlop CoVMD_tiTqFild CoVMD_tqACCReq CoVMD_tqBasDif CoVMD_tqBasFild CoVMD_tqBasMod1 CoVMD_tqBasMod1MT CoVMD_tqBasMod2 CoVMD_tqBasModNew CoVMD_tqBasModOld CoVMD_tqBasPrev CoVMD_tqBasUnfild CoVMD_tqCmpLossSum CoVMD_tqCmpLossSumWoFac CoVMD_tqCmpNotSwilLoss CoVMD_tqCmpNotSwilLossWoFac CoVMD_tqCmpSwilLoss CoVMD_tqCmpSwilLossWoFac CoVMD_tqCrCtlWiLimn CoVMD_tqCvtEcoEng0 CoVMD_tqCvtEcoEng1 CoVMD_tqCvtEcoEng12 CoVMD_tqCvtEcoEng2 CoVMD_tqCvtEcoEng23 CoVMD_tqCvtEcoEng3 CoVMD_tqCvtEcoEng34 CoVMD_tqCvtEcoEng4 CoVMD_tqCvtEcoEng45 CoVMD_tqCvtEcoEng5 CoVMD_tqCvtEcoEng56 CoVMD_tqCvtEcoEng6 CoVMD_tqCvtEcoEng67 CoVMD_tqCvtEcoEng7 CoVMD_tqCvtEcoEng78 CoVMD_tqCvtEcoEng8 CoVMD_tqCVTEng0 CoVMD_tqCVTEng1 CoVMD_tqCVTEng12 CoVMD_tqCVTEng2 CoVMD_tqCVTEng23 CoVMD_tqCVTEng3 CoVMD_tqCVTEng34 CoVMD_tqCVTEng4 CoVMD_tqCVTEng45 CoVMD_tqCVTEng5 CoVMD_tqCVTEng56 CoVMD_tqCVTEng6 CoVMD_tqCVTEng67 CoVMD_tqCVTEng7 CoVMD_tqCVTEng78 CoVMD_tqCVTEng8 CoVMD_tqDesInnrWoCmp CoVMD_tqDesTmp CoVMD_tqDesTmpWhl CoVMD_tqDrgWhlLvl CoVMD_tqEcoMaxIDAS CoVMD_tqGearDesCVT CoVMD_tqGearDesMT CoVMD_tqGearMod1CVT CoVMD_tqIDASFailOffs1 CoVMD_tqIDASFailThd1 CoVMD_tqIDASFailThd2 CoVMD_tqInnrLvlIDASReq CoVMD_tqLLim CoVMD_tqLossSum CoVMD_tqMapBasd CoVMD_tqMinAbslt CoVMD_tqNewTmp CoVMD_tqNormMaxIDAS CoVMD_tqNotSwilLoss CoVMD_tqOldTmp CoVMD_tqPrpnCrCtlLLim CoVMD_tqWhlCmpTmp CoVMD_tqWhlMax CoVMD_tqWhlMinEng CoVMD_tqWhlMinWoFco CoVMD_tqWhlWithLoss CoVMD_tqWoCtOff /end LOC_MEASUREMENT
 FUNCTION_VERSION "142.4.0" /end FUNCTION
/begin FUNCTION CoVMD_TrqDesCoord "142.1.0   Coordination of propulsion torque in vehicle motion demand"
 /begin DEF_CHARACTERISTIC CoVMD_TrqDesCoord_CW CoVMD_trqThresCrCtlL_C CoVMD_trqThresCrCtlR_C CoVMD_trqThresLLimL_C CoVMD_trqThresLLimR_C /end DEF_CHARACTERISTIC
 /begin IN_MEASUREMENT ACCI_bACCPrs AccPed_facCompAcs AccPed_rTrq AccPed_trqDes CoVMD_bCtOffPhdCrCtl CoVMD_bCtOffPhdLLim CoVMD_facCompAcs CoVMD_stReqCrCtl CoVMD_trqCrCtl CoVMD_trqLLim CrCtl_bCtOffPhd CrCtl_stActive LLim_stActive LLim_stReq PT_trqLos /end IN_MEASUREMENT
 /begin OUT_MEASUREMENT VehMot_facCompAcs VehMot_stCtOffPhd VehMot_stPrpCrCtl VehMot_stPrpLLim VMD_tqCluDes VMD_trqDes /end OUT_MEASUREMENT
 FUNCTION_VERSION "142.1.0" /end FUNCTION
/begin FUNCTION CoVOM_SSE "65.2.0    Coordinator Vehicle Operation Mode_Stop Start Engine"
 /begin DEF_CHARACTERISTIC CoVOM_bClthPTRls_C CoVOM_bRstvXMaxCOM_C CoVOM_bSSEEngStrtWoFrstStrt_C CoVOM_bSSEEngStrtWoStSp_C CoVOM_bSSERstrtEng_C CoVOM_bSSEUIStrtReq_C COVOM_cntTotRlyOperMax_C CoVOM_ctStopEngMax_C CoVOM_flgCoMEna_C CoVOM_flgEngRunDetCoM_C CoVOM_flgStrtrChkDi_C CoVOM_flgSwtBrkHldAvl_C CoVOM_flgSwtEngSpdChkEna_C CoVOM_flgSwtLSFAvl_C CoVOM_flgSwtStrtReqBrkFldP_C CoVOM_nEngRstrtEngStallThd_C CoVOM_nEngStopDelta_C CoVOM_nEngStsDetnBefIdleSpd_C CoVOM_numEngStrtAbrtMax_C COVOM_pAtmPThdDelta_C COVOM_pAtmPThd_C CoVOM_pRelChgThd_C CoVOM_rAPPHysHi_C CoVOM_rAPPHysLo_C CoVOM_rAPPOnThres_C CoVOM_rAPPStrtMin_C CoVOM_stAutoRstrtReqMsk_C CoVOM_stClthSigSel_C CoVOM_stDrvMod1_C CoVOM_stDrvMod2_C CoVOM_stDrvMod3_C CoVOM_stEngStallReasMask_C CoVOM_stIgrBrkPedStrtReq_C CoVOM_stISGoStbMask_C CoVOM_stStopRelsMask_C CoVOM_stStopReqMask_C CoVOM_stStrtEnaMask_C CoVOM_stStrtReqMask_C CoVOM_stSysOffRelsMask_C CoVOM_stSysOffTrigMask_C CoVOM_stVehMktSelSwt_C CoVOM_swtACType_C CoVOM_swtCluBasdRstrtRels_C CoVOM_swtDrvModSeln_C CoVOM_swtSSEEna_C CoVOM_swtTrigCamsftRefEna_C CoVOM_tiACISSInhbReqDeb_C CoVOM_tiAPPMoF_C CoVOM_tiBdIntStopEnaDeb_C CoVOM_tiBrkHldMoF_C CoVOM_tiBrkHldStbyOff_C CoVOM_tiBrkMaxMoF_C CoVOM_tiBrkMoF_C CoVOM_tiBrkPedStopEnaDeb_C CoVOM_tiBrkRstrtAllw_C CoVOM_tiCoEngStopEnaDeb_C CoVOM_tiDrvStopReqDeb_C CoVOM_tiEngCrkAbortThd_C CoVOM_tiEngInhbReqDeb_C CoVOM_tiEngRstrtOrdDly_C CoVOM_tiEngRstrtReqHiLo_C CoVOM_tiEngRstrtReqLoHi_C CoVOM_tiEngStall_C CoVOM_tiEngStrtOrdDly_C CoVOM_tiEPSStopReqDeb_C CoVOM_tiESSStopEnaDeb_C CoVOM_tiESSStrtReqDly_C CoVOM_tiFrntDefrstSwtDeb_C CoVOM_tiFwdGearDly_C CoVOM_tiMaxStopReq_C CoVOM_tiNEngStopReqDeb_C CoVOM_tiPTStopEnaDeb_C CoVOM_tiPTStopReqDeb_C CoVOM_tiRstrtRelsPtd_C CoVOM_tiSeatBltOffDly_C CoVOM_tiStrtReq_C CoVOM_tiSysOffAutRstrt_C CoVOM_tiTraGearStopEnaDeb_C CoVOM_tiTranDly_C CoVOM_tiTranISSEngRunng_C CoVOM_tiTraStopReqDeb_C CoVOM_tiTSStopEnaDeb_C CoVOM_tiUpDwnSpdLim_C CoVOM_tiVehCdnStopTrigDly_C CoVOM_tiVehVCondDeb_C CoVOM_tiVSAStopReqDeb_C CoVOM_tiWaitStrtAbrt_C CoVOM_vDurgRToDTran_C CoVOM_vISSuppSpdThd_C CoVOM_vWhlSpdThresHi_C CoVOM_vWhlSpdThresLo_C CoVOM_vXMaxEngStop_C CoVOM_vXMaxSinceStrtMin_C CoVOM_vXMaxSinceStrt_C CoVOM_vXSpdDiff_C /end DEF_CHARACTERISTIC
 /begin IN_MEASUREMENT ACC_bBrkReq APP_r BdInt_bEngStopEna BrkPed_bEngStopEna BrkPed_bEngStrtReq BrkPed_flgEBBEngSysOff BrkPed_flgISABBrkPSuffVehStill BrkPed_flgSlopeExcd BrkPed_flgSwtISABAvl BrkPed_flgVehStandStill BrkPed_pRel BrkPed_tqIMGISABIdleStop Brk_stEBBBrkDetn B_vhegfe Clth3_st Clth4_st Clth_st CoEng_bStalEng CoEng_bStopEna CoEng_bStrtDes CoEng_st CoEng_stMai CoEng_stOld CoEng_stStalEngReas Com_bBrkPedON Com_stACISSInhbReqRes Com_stBrkHldSys Com_stCfmdPPosnPTCAN Com_stCVTShiftActv Com_stDrvModSwt Com_stEngHoodOpn Com_stEngInhibReq Com_stEPBStInfo Com_stEPSISSInhbReq Com_stEPSISSRstrtReq Com_stFrntDfrstSwtInfoRes Com_stIMGISBrkHldActv Com_stIMGISBrkHldStb Com_stIMGISRlsReq Com_stIMGISRstrtInhbBrk Com_stIMGISShiftInhbBrk Com_stISABAct Com_stISABEna Com_stPCUEngStrtInhb Com_stSeatBltInfo Com_stShftInPark Com_stSptSwtDeb Com_tqBrkOper CoVeh_stIgnLckTerm15 Eep_stISSStorgDiagActv EngStrt_nEngRstrtStgy2ThdLo EnvP_p Epm_nEng10ms Epm_nEngTooth10ms ESS_bEngStopEna ESS_bEngStrtEna ESS_bEngStrtReq Gbx_stActvNPos Gbx_stGearLvr Gbx_stNPos Gbx_stPNPosnDeb Gbx_stRvsPos GlbDa_vAvrgWhlSpd GlbDa_vWhlSpdFlt GlbDa_vX HLSDem_nSetPLo I14229_stABSFailCnclActv I14229_stIdlStopCdn I14229_stIdlStopPhd MoF_stStrtMsg MoF_stStrtStopEnaMsg PT_bEngStopEna PT_bEngStopReq PT_bEngStrtEna PT_bEngStrtReq PT_stTraType SSEUI_stCANErrMask StrtCtl_stIdleSpStTiLimHist Strt_cntTotRlyOper Strt_ctStopEngTot Strt_st StSpSwt_st SysDiag_flgCModJdg T15_st Tra_numGear TS_bEngStopEna TS_bEngStrtReq VehMot_stBrkPed /end IN_MEASUREMENT
 /begin OUT_MEASUREMENT CoVeh_stEngStopOrd CoVeh_stEngStrtOrd CoVOM_bAbortedStopReq CoVOM_bACStopReqTimeout CoVOM_bAutoRstrtReq CoVOM_bChangeOfMind CoVOM_bCVTIdleStop CoVOM_bCVTStopEna CoVOM_bDEFInhbReqIndcn CoVOM_bEngFrstStrtPassed CoVOM_bEngPreStrtOrd CoVOM_bRvsHist CoVOM_bSSEEna CoVOM_bSSEEngStopPassed CoVOM_bSSEUIStrtReq CoVOM_bStopDrvReq CoVOM_bStopEna CoVOM_bStopReq CoVOM_bStopTraReq CoVOM_bStrtEna CoVOM_bStrtReq CoVOM_bSysOff CoVOM_bVehCdnStopTrig CoVOM_bVXSinceStrtDeb CoVOM_flgEngRstrtInhb CoVOM_flgEngStallAftDly CoVOM_flgSeatBltOff CoVOM_flgTrigCamsftRefPosn CoVOM_numEngStrtAbrt CoVOM_stEngCrkAbort CoVOM_stEngRstrtPreReq CoVOM_stEngRstrtReq CoVOM_stEngStopPreCdn CoVOM_stISGoJud CoVOM_stISGoStb CoVOM_stISSEng CoVOM_stISStopInhb CoVOM_stISSuppVehSpd CoVOM_stMaxNrStrtOperExcdd CoVOM_stSSE CoVOM_stStop CoVOM_stStopEnaBit8Excl CoVOM_stStopEnaDspl CoVOM_stStopEnblByVehCdn CoVOM_stStopReqCdn CoVOM_stStopReqDspl CoVOM_stStopRls CoVOM_stStrt CoVOM_stStrtEnaCdn CoVOM_stStrtEnaDspl CoVOM_stStrtReqBefMsk CoVOM_stStrtReqCdn CoVOM_stStrtReqCluPosn CoVOM_stStrtReqDspl CoVOM_stSysOffTrigAftMsk CoVOM_stSysOffTrigBefMsk CoVOM_stSysOffTrigMask /end OUT_MEASUREMENT
 /begin LOC_MEASUREMENT CoVOM_bNeutBasdRstrt CoVOM_bRvsGearTran CoVOM_bSeatBltBasdRstrt CoVOM_bVXEngStopRea_mp CoVOM_ctFirstVldChk CoVOM_flgAllwRstrtBrk CoVOM_flgBrkHldStbyOff CoVOM_flgBrkOffMoFPrmt CoVOM_flgChgOfMndReq CoVOM_flgLSFActvStrtReq_MP CoVOM_flgMoFPrmt CoVOM_flgRstrtReqBrkOn CoVOM_flgStrtAbortMoF CoVOM_pRelThdForStrtReq CoVOM_stEngCrkAbortReqd CoVOM_stEngInhbReqEna CoVOM_stEngRstrtEnaCdn CoVOM_stEngRstrtReqd CoVOM_stEngRstrtTrigReq CoVOM_stEngStall CoVOM_stEngStrtdOnce CoVOM_stISSEngTemp CoVOM_stISSEngTempOld COVOM_stNotHiAlti CoVOM_stPrkgPosn CoVOM_stRstrtReqByVehCdn CoVOM_stStrtAbort CoVOM_stSysOffRelsCdn CoVOM_stTraStrtReq_MP CoVOM_tiEngRstrtAbort CoVOM_tiSpdBlwChk CoVOM_tiSpdBlwTmr CoVOM_tiSpdExcdChk CoVOM_tiSpdExcdTmr CoVOM_tiStopReqWoEna_mp CoVOM_tiUpDwnSpdHist CoVOM_vISFrqRstrcnSpd CoVOM_vWhlSpdMax CoVOM_vWhlSpdMedian CoVOM_vWhlSpdMin CoVOM_vWhlSpdSum /end LOC_MEASUREMENT
 FUNCTION_VERSION "65.2.0" /end FUNCTION
/begin FUNCTION CrCtl_Lib "3.0.0     Cruise Control Library functions" FUNCTION_VERSION "3.0.0" /end FUNCTION
/begin COMPU_METHOD APPCrCtl1 "" RAT_FUNC "%6.4" "%" COEFFS 0 200 0 0 0 1 /end COMPU_METHOD
/begin COMPU_METHOD B_TRUE "" TAB_VERB "%6.3" "" COMPU_TAB_REF B_TRUE /end COMPU_METHOD
/begin COMPU_VTAB B_TRUE "" TAB_VERB 2 0 "FALSE" 1 "TRUE" /end COMPU_VTAB
/begin COMPU_METHOD DSM_TESTMODDIAGCODLAMP_SC_Compu "" TAB_VERB "%6.3" "" COMPU_TAB_REF DSM_TESTMODDIAGCODLAMP_SC_Compu /end COMPU_METHOD
/begin COMPU_VTAB DSM_TESTMODDIAGCODLAMP_SC_Compu "" TAB_VERB 2 0 "Disabled" 1 "Enabled" /end COMPU_VTAB
/begin COMPU_METHOD DSM_WUCDET_SY_Compu "" TAB_VERB "%6.3" "" COMPU_TAB_REF DSM_WUCDET_SY_Compu /end COMPU_METHOD
/begin COMPU_VTAB DSM_WUCDET_SY_Compu "" TAB_VERB 7 0 "0" 1 "1" 2 "2" 3 "3" 4 "4" 5 "5" 255 "255" /end COMPU_VTAB
/begin COMPU_METHOD DTERSV_SC_Compu "" TAB_VERB "%6.3" "" COMPU_TAB_REF DTERSV_SC_Compu /end COMPU_METHOD
/begin COMPU_VTAB DTERSV_SC_Compu "" TAB_VERB 2 0 "False" 1 "True" /end COMPU_VTAB
/begin COMPU_METHOD dTrq "" RAT_FUNC "%6.3" "Nm/s" COEFFS 0 10 0 0 0 1 /end COMPU_METHOD
/begin COMPU_METHOD DTR_LEGIFC_SY_Compu "" TAB_VERB "%6.3" "" COMPU_TAB_REF DTR_LEGIFC_SY_Compu /end COMPU_METHOD
/begin COMPU_VTAB DTR_LEGIFC_SY_Compu "" TAB_VERB 2 0 "DISABLED" 1 "ENABLED" /end COMPU_VTAB
/begin COMPU_METHOD DtTemp_KPerSec_q0p01_COMPU "" RAT_FUNC "%6.4" "K/s" COEFFS 0 100 0 0 0 1 /end COMPU_METHOD
/begin COMPU_METHOD DtyCycSlp "" RAT_FUNC "%6.5" "%/s" COEFFS 0 1000 0 0 0 1 /end COMPU_METHOD
/begin COMPU_METHOD dt_TempKelv_p_s "" RAT_FUNC "%6.3" "K/s" COEFFS 0 10 0 0 0 1 /end COMPU_METHOD
/begin COMPU_METHOD DVE_VERS_SY_Compu "" TAB_VERB "%6.3" "" COMPU_TAB_REF DVE_VERS_SY_Compu /end COMPU_METHOD
/begin COMPU_VTAB DVE_VERS_SY_Compu "" TAB_VERB 2 1 "DV-E powered by main relay" 2 "DV-E powered by injection relay" /end COMPU_VTAB
/begin COMPU_METHOD DYNDMDCHRGCTRLCAMSFT_SC_Compu "" TAB_VERB "%6.3" "" COMPU_TAB_REF DYNDMDCHRGCTRLCAMSFT_SC_Compu /end COMPU_METHOD
/begin COMPU_VTAB DYNDMDCHRGCTRLCAMSFT_SC_Compu "" TAB_VERB 3 0 "no special charge control by camshaft" 1 "charge control by camshaft (map based)" 2 "charge control during naturally-aspirated area wit" /end COMPU_VTAB
/begin COMPU_METHOD ECAT_NRBRICK_SC_Compu "" TAB_VERB "%6.3" "" COMPU_TAB_REF ECAT_NRBRICK_SC_Compu /end COMPU_METHOD
/begin COMPU_VTAB ECAT_NRBRICK_SC_Compu "" TAB_VERB 3 0 "0" 1 "1" 2 "2" /end COMPU_VTAB
/begin COMPU_METHOD ECBVLV_TYPAVL_SY_Compu "" TAB_VERB "%6.3" "" COMPU_TAB_REF ECBVLV_TYPAVL_SY_Compu /end COMPU_METHOD
/begin COMPU_VTAB ECBVLV_TYPAVL_SY_Compu "" TAB_VERB 2 0 "FALSE" 1 "TRUE" /end COMPU_VTAB
/begin COMPU_METHOD ECLTYP_SY_Compu "" TAB_VERB "%6.3" "" COMPU_TAB_REF ECLTYP_SY_Compu /end COMPU_METHOD
/begin COMPU_VTAB ECLTYP_SY_Compu "" TAB_VERB 3 0 "ECLTYP_NOCLTH" 1 "ECLTYP_IMPCLTH" 2 "ECLTYP_PROPCLTH" /end COMPU_VTAB
/begin COMPU_METHOD EngN "" RAT_FUNC "%6.3" "rpm" COEFFS 0 2 0 0 0 1 /end COMPU_METHOD
/begin COMPU_METHOD EngNCrCtl "" RAT_FUNC "%6.2" "rpm" COEFFS 0 1 0 0 0 1 /end COMPU_METHOD
/begin COMPU_METHOD Fact "" RAT_FUNC "%6.5" "-" COEFFS 0 8192 0 0 0 1 /end COMPU_METHOD
/begin COMPU_METHOD OneToOne "" RAT_FUNC "%6.2" "-" COEFFS 0 1 0 0 0 1 /end COMPU_METHOD
/begin COMPU_METHOD Prc "" RAT_FUNC "%6.4" "%" COEFFS 0 81.92 0 0 0 1 /end COMPU_METHOD
/begin COMPU_METHOD Pres_hPa "" RAT_FUNC "%6.2" "hPa" COEFFS 0 1 0 0 0 1 /end COMPU_METHOD
/begin COMPU_METHOD RBPtCel_tq_1p0_1 "" RAT_FUNC "%6.2" "Nm" COEFFS 0 1 0 0 0 1 /end COMPU_METHOD
/begin COMPU_METHOD TimeDeb "" RAT_FUNC "%6.1" "ms" COEFFS 0 0.1 0 0 0 1 /end COMPU_METHOD
/begin COMPU_METHOD Time_ms "" RAT_FUNC "%6.1" "ms" COEFFS 0 0.1 0 0 0 1 /end COMPU_METHOD
/begin COMPU_METHOD Time_s "" RAT_FUNC "%6.4" "s" COEFFS 0 100 0 0 0 1 /end COMPU_METHOD
/begin COMPU_METHOD TransR "" RAT_FUNC "%6.4" "-" COEFFS 0 100 0 0 0 1 /end COMPU_METHOD
/begin COMPU_METHOD Trq "" RAT_FUNC "%6.3" "Nm" COEFFS 0 10 0 0 0 1 /end COMPU_METHOD
/begin COMPU_METHOD TrqPerSec "" RAT_FUNC "%6.2" "Nm/s" COEFFS 0 1 0 0 0 1 /end COMPU_METHOD
/begin COMPU_METHOD TrqPrpHigh "" RAT_FUNC "%6.3" "Nm" COEFFS 0 10 0 0 0 1 /end COMPU_METHOD
/begin COMPU_METHOD t_q0p01 "" RAT_FUNC "%6.4" "s" COEFFS 0 100 0 0 0 1 /end COMPU_METHOD
/begin COMPU_METHOD Vel "" RAT_FUNC "%6.4" "km/h" COEFFS 0 100 0 0 0 1 /end COMPU_METHOD
/begin RECORD_LAYOUT RB_Axis_S16 NO_AXIS_PTS_X 1 SWORD AXIS_PTS_X 2 SWORD INDEX_INCR DIRECT /end RECORD_LAYOUT
/begin RECORD_LAYOUT RB_CurveGroup_S16 FNC_VALUES 1 SWORD COLUMN_DIR DIRECT /end RECORD_LAYOUT
/begin RECORD_LAYOUT RB_Curve_S16_S16 NO_AXIS_PTS_X 1 SWORD AXIS_PTS_X 2 SWORD INDEX_INCR DIRECT FNC_VALUES 3 SWORD COLUMN_DIR DIRECT /end RECORD_LAYOUT
/begin RECORD_LAYOUT RB_Map_S16S16_S16 NO_AXIS_PTS_X 1 SWORD NO_AXIS_PTS_Y 2 SWORD AXIS_PTS_X 3 SWORD INDEX_INCR DIRECT AXIS_PTS_Y 4 SWORD INDEX_INCR DIRECT FNC_VALUES 5 SWORD COLUMN_DIR DIRECT /end RECORD_LAYOUT
/begin RECORD_LAYOUT RB_ValA_Ws16 FNC_VALUES 1 SWORD COLUMN_DIR DIRECT /end RECORD_LAYOUT
/begin RECORD_LAYOUT RB_Val_Wboolean FNC_VALUES 1 UBYTE COLUMN_DIR DIRECT /end RECORD_LAYOUT
/begin RECORD_LAYOUT RB_Val_Ws16 FNC_VALUES 1 SWORD COLUMN_DIR DIRECT /end RECORD_LAYOUT
/begin RECORD_LAYOUT RB_Val_Ws32 FNC_VALUES 1 SLONG COLUMN_DIR DIRECT /end RECORD_LAYOUT
/begin RECORD_LAYOUT RB_Val_Wu16 FNC_VALUES 1 UWORD COLUMN_DIR DIRECT /end RECORD_LAYOUT
/begin RECORD_LAYOUT RB_Val_Wu32 FNC_VALUES 1 ULONG COLUMN_DIR DIRECT /end RECORD_LAYOUT
/begin RECORD_LAYOUT RB_Val_Wu8 FNC_VALUES 1 UBYTE COLUMN_DIR DIRECT /end RECORD_LAYOUT
/end MODULE
/end PROJECT
