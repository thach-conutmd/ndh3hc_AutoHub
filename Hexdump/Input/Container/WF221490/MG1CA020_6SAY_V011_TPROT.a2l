ASAP2_VERSION 1 60
/begin PROJECT MG1CA020 "MG1CA020"
/begin HEADER "" VERSION "MG1CA020_6SAY_V011_TPROT" PROJECT_NO MG1CA020 /end HEADER
/begin MODULE DIM ""
/begin MOD_COMMON "" BYTE_ORDER MSB_LAST ALIGNMENT_BYTE 1 ALIGNMENT_WORD 2 ALIGNMENT_LONG 4 ALIGNMENT_INT64 4 ALIGNMENT_FLOAT32_IEEE 4 ALIGNMENT_FLOAT64_IEEE 4 DATA_SIZE 32 /end MOD_COMMON
/begin CHARACTERISTIC DINH_Lim.DFC_ComEAT12RingCnt_CA "inhibit conditions / inhibit limit conditions for inhibit source DFC_ComEAT12RingCnt" VAL_BLK 0x804EF967 ValA_Wu8 17.0000000000 DINH_LimDFCVerb 0.00 17.0000000000 FORMAT "%13.10" NUMBER 53 /end CHARACTERISTIC
/begin CHARACTERISTIC DINH_Lim.DFC_ComEAT12TOut_CA "inhibit conditions / inhibit limit conditions for inhibit source DFC_ComEAT12TOut" VAL_BLK 0x804EF99C ValA_Wu8 17.0000000000 DINH_LimDFCVerb 0.00 17.0000000000 FORMAT "%13.10" NUMBER 53 /end CHARACTERISTIC
/begin CHARACTERISTIC DINH_Lim.DFC_ComEAT13ChkSum_CA "inhibit conditions / inhibit limit conditions for inhibit source DFC_ComEAT13ChkSum" VAL_BLK 0x804EF9D1 ValA_Wu8 17.0000000000 DINH_LimDFCVerb 0.00 17.0000000000 FORMAT "%13.10" NUMBER 57 /end CHARACTERISTIC
/begin CHARACTERISTIC DINH_Lim.DFC_ComEAT13RingCnt_CA "inhibit conditions / inhibit limit conditions for inhibit source DFC_ComEAT13RingCnt" VAL_BLK 0x804EFA0A ValA_Wu8 17.0000000000 DINH_LimDFCVerb 0.00 17.0000000000 FORMAT "%13.10" NUMBER 57 /end CHARACTERISTIC
/begin CHARACTERISTIC DINH_Lim.DFC_ComEAT13TOut_CA "inhibit conditions / inhibit limit conditions for inhibit source DFC_ComEAT13TOut" VAL_BLK 0x804EFA43 ValA_Wu8 17.0000000000 DINH_LimDFCVerb 0.00 17.0000000000 FORMAT "%13.10" NUMBER 57 /end CHARACTERISTIC
/begin CHARACTERISTIC DINH_Lim.DFC_ComEAT1Chksum_CA "inhibit conditions / inhibit limit conditions for inhibit source DFC_ComEAT1Chksum" VAL_BLK 0x804EFA7C ValA_Wu8 17.0000000000 DINH_LimDFCVerb 0.00 17.0000000000 FORMAT "%13.10" NUMBER 57 /end CHARACTERISTIC
/begin CHARACTERISTIC DINH_Lim.DFC_ComEAT1RingCnt_CA "inhibit conditions / inhibit limit conditions for inhibit source DFC_ComEAT1RingCnt" VAL_BLK 0x804EFAB5 ValA_Wu8 17.0000000000 DINH_LimDFCVerb 0.00 17.0000000000 FORMAT "%13.10" NUMBER 57 /end CHARACTERISTIC
/begin CHARACTERISTIC DINH_Lim.DFC_ComEAT1TOut_CA "inhibit conditions / inhibit limit conditions for inhibit source DFC_ComEAT1TOut" VAL_BLK 0x804EFAEE ValA_Wu8 17.0000000000 DINH_LimDFCVerb 0.00 17.0000000000 FORMAT "%13.10" NUMBER 57 /end CHARACTERISTIC
/begin CHARACTERISTIC DINH_Lim.DFC_ComEAT2ChkSum_CA "inhibit conditions / inhibit limit conditions for inhibit source DFC_ComEAT2ChkSum" VAL_BLK 0x804EFB27 ValA_Wu8 17.0000000000 DINH_LimDFCVerb 0.00 17.0000000000 FORMAT "%13.10" NUMBER 58 /end CHARACTERISTIC
/begin CHARACTERISTIC DINH_Lim.DFC_ComEAT2RingCnt_CA "inhibit conditions / inhibit limit conditions for inhibit source DFC_ComEAT2RingCnt" VAL_BLK 0x804EFB61 ValA_Wu8 17.0000000000 DINH_LimDFCVerb 0.00 17.0000000000 FORMAT "%13.10" NUMBER 58 /end CHARACTERISTIC
/begin CHARACTERISTIC DINH_Lim.DFC_ComEAT2TOut_CA "inhibit conditions / inhibit limit conditions for inhibit source DFC_ComEAT2TOut" VAL_BLK 0x804EFB9B ValA_Wu8 17.0000000000 DINH_LimDFCVerb 0.00 17.0000000000 FORMAT "%13.10" NUMBER 58 /end CHARACTERISTIC
/begin CHARACTERISTIC DINH_Lim.DFC_ComEAT4ChkSum_CA "inhibit conditions / inhibit limit conditions for inhibit source DFC_ComEAT4ChkSum" VAL_BLK 0x804EFBD5 ValA_Wu8 17.0000000000 DINH_LimDFCVerb 0.00 17.0000000000 FORMAT "%13.10" NUMBER 58 /end CHARACTERISTIC
/begin CHARACTERISTIC DINH_Lim.DFC_ComEAT4RingCnt_CA "inhibit conditions / inhibit limit conditions for inhibit source DFC_ComEAT4RingCnt" VAL_BLK 0x804EFC0F ValA_Wu8 17.0000000000 DINH_LimDFCVerb 0.00 17.0000000000 FORMAT "%13.10" NUMBER 58 /end CHARACTERISTIC
/begin CHARACTERISTIC DINH_Lim.DFC_ComEAT4TOut_CA "inhibit conditions / inhibit limit conditions for inhibit source DFC_ComEAT4TOut" VAL_BLK 0x804EFC49 ValA_Wu8 17.0000000000 DINH_LimDFCVerb 0.00 17.0000000000 FORMAT "%13.10" NUMBER 58 /end CHARACTERISTIC
/begin CHARACTERISTIC DINH_Lim.DFC_ComEAT6Chksum_CA "inhibit conditions / inhibit limit conditions for inhibit source DFC_ComEAT6Chksum" VAL_BLK 0x804EFC83 ValA_Wu8 17.0000000000 DINH_LimDFCVerb 0.00 17.0000000000 FORMAT "%13.10" NUMBER 59 /end CHARACTERISTIC
/begin CHARACTERISTIC DINH_Lim.DFC_ComEAT6RingCnt_CA "inhibit conditions / inhibit limit conditions for inhibit source DFC_ComEAT6RingCnt" VAL_BLK 0x804EFCBE ValA_Wu8 17.0000000000 DINH_LimDFCVerb 0.00 17.0000000000 FORMAT "%13.10" NUMBER 59 /end CHARACTERISTIC
/begin CHARACTERISTIC DINH_Lim.DFC_ComEAT6TOut_CA "inhibit conditions / inhibit limit conditions for inhibit source DFC_ComEAT6TOut" VAL_BLK 0x804EFCF9 ValA_Wu8 17.0000000000 DINH_LimDFCVerb 0.00 17.0000000000 FORMAT "%13.10" NUMBER 59 /end CHARACTERISTIC
/begin CHARACTERISTIC DINH_Lim.DFC_ComEAT7Chksum_CA "inhibit conditions / inhibit limit conditions for inhibit source DFC_ComEAT7Chksum" VAL_BLK 0x804EFD34 ValA_Wu8 17.0000000000 DINH_LimDFCVerb 0.00 17.0000000000 FORMAT "%13.10" NUMBER 58 /end CHARACTERISTIC
/begin CHARACTERISTIC DINH_Lim.DFC_ComEAT7RingCnt_CA "inhibit conditions / inhibit limit conditions for inhibit source DFC_ComEAT7RingCnt" VAL_BLK 0x804EFD6E ValA_Wu8 17.0000000000 DINH_LimDFCVerb 0.00 17.0000000000 FORMAT "%13.10" NUMBER 58 /end CHARACTERISTIC
/begin CHARACTERISTIC DINH_Lim.DFC_ComEAT7TOut_CA "inhibit conditions / inhibit limit conditions for inhibit source DFC_ComEAT7TOut" VAL_BLK 0x804EFDA8 ValA_Wu8 17.0000000000 DINH_LimDFCVerb 0.00 17.0000000000 FORMAT "%13.10" NUMBER 58 /end CHARACTERISTIC
/begin CHARACTERISTIC DINH_Lim.DFC_ComEAT8Chksum_CA "inhibit conditions / inhibit limit conditions for inhibit source DFC_ComEAT8Chksum" VAL_BLK 0x804EFDE2 ValA_Wu8 17.0000000000 DINH_LimDFCVerb 0.00 17.0000000000 FORMAT "%13.10" NUMBER 59 /end CHARACTERISTIC
/begin CHARACTERISTIC DINH_Lim.DFC_ComEAT8RingCnt_CA "inhibit conditions / inhibit limit conditions for inhibit source DFC_ComEAT8RingCnt" VAL_BLK 0x804EFE1D ValA_Wu8 17.0000000000 DINH_LimDFCVerb 0.00 17.0000000000 FORMAT "%13.10" NUMBER 59 /end CHARACTERISTIC
/begin CHARACTERISTIC DINH_Lim.DFC_ComEAT8TOut_CA "inhibit conditions / inhibit limit conditions for inhibit source DFC_ComEAT8TOut" VAL_BLK 0x804EFE58 ValA_Wu8 17.0000000000 DINH_LimDFCVerb 0.00 17.0000000000 FORMAT "%13.10" NUMBER 59 /end CHARACTERISTIC
/begin CHARACTERISTIC DINH_Lim.DFC_ComEATAChksum_CA "inhibit conditions / inhibit limit conditions for inhibit source DFC_ComEATAChksum" VAL_BLK 0x804EFE93 ValA_Wu8 17.0000000000 DINH_LimDFCVerb 0.00 17.0000000000 FORMAT "%13.10" NUMBER 59 /end CHARACTERISTIC
/begin CHARACTERISTIC DINH_Lim.DFC_ComEATARingCnt_CA "inhibit conditions / inhibit limit conditions for inhibit source DFC_ComEATARingCnt" VAL_BLK 0x804EFECE ValA_Wu8 17.0000000000 DINH_LimDFCVerb 0.00 17.0000000000 FORMAT "%13.10" NUMBER 59 /end CHARACTERISTIC
/begin CHARACTERISTIC DINH_Lim.DFC_ComEATATOut_CA "inhibit conditions / inhibit limit conditions for inhibit source DFC_ComEATATOut" VAL_BLK 0x804EFF09 ValA_Wu8 17.0000000000 DINH_LimDFCVerb 0.00 17.0000000000 FORMAT "%13.10" NUMBER 59 /end CHARACTERISTIC
/begin CHARACTERISTIC DINH_Lim.DFC_ComEATBChkSum_CA "inhibit conditions / inhibit limit conditions for inhibit source DFC_ComEATBChkSum" VAL_BLK 0x804EFF44 ValA_Wu8 17.0000000000 DINH_LimDFCVerb 0.00 17.0000000000 FORMAT "%13.10" NUMBER 65 /end CHARACTERISTIC
/begin CHARACTERISTIC DINH_Lim.DFC_ComEATBRingCnt_CA "inhibit conditions / inhibit limit conditions for inhibit source DFC_ComEATBRingCnt" VAL_BLK 0x804EFF85 ValA_Wu8 17.0000000000 DINH_LimDFCVerb 0.00 17.0000000000 FORMAT "%13.10" NUMBER 65 /end CHARACTERISTIC
/begin CHARACTERISTIC DINH_Lim.DFC_ComEATBTOut_CA "inhibit conditions / inhibit limit conditions for inhibit source DFC_ComEATBTOut" VAL_BLK 0x804EFFC6 ValA_Wu8 17.0000000000 DINH_LimDFCVerb 0.00 17.0000000000 FORMAT "%13.10" NUMBER 65 /end CHARACTERISTIC
/begin CHARACTERISTIC DINH_Lim.DFC_ComEATCChksum_CA "inhibit conditions / inhibit limit conditions for inhibit source DFC_ComEATCChksum" VAL_BLK 0x804F0007 ValA_Wu8 17.0000000000 DINH_LimDFCVerb 0.00 17.0000000000 FORMAT "%13.10" NUMBER 4 /end CHARACTERISTIC
/begin CHARACTERISTIC DINH_Lim.DFC_ComEATCRingCnt_CA "inhibit conditions / inhibit limit conditions for inhibit source DFC_ComEATCRingCnt" VAL_BLK 0x804F000B ValA_Wu8 17.0000000000 DINH_LimDFCVerb 0.00 17.0000000000 FORMAT "%13.10" NUMBER 4 /end CHARACTERISTIC
/begin CHARACTERISTIC DINH_Lim.DFC_ComEATCTOut_CA "inhibit conditions / inhibit limit conditions for inhibit source DFC_ComEATCTOut" VAL_BLK 0x804F000F ValA_Wu8 17.0000000000 DINH_LimDFCVerb 0.00 17.0000000000 FORMAT "%13.10" NUMBER 4 /end CHARACTERISTIC
/begin CHARACTERISTIC DINH_Lim.DFC_ComEBBAChksum_CA "inhibit conditions / inhibit limit conditions for inhibit source DFC_ComEBBAChksum" VAL_BLK 0x804F0013 ValA_Wu8 17.0000000000 DINH_LimDFCVerb 0.00 17.0000000000 FORMAT "%13.10" NUMBER 55 /end CHARACTERISTIC
/begin CHARACTERISTIC DINH_Lim.DFC_ComEBBARingCnt_CA "inhibit conditions / inhibit limit conditions for inhibit source DFC_ComEBBARingCnt" VAL_BLK 0x804F004A ValA_Wu8 17.0000000000 DINH_LimDFCVerb 0.00 17.0000000000 FORMAT "%13.10" NUMBER 55 /end CHARACTERISTIC
/begin CHARACTERISTIC DINH_Lim.DFC_ComEBBATOut_CA "inhibit conditions / inhibit limit conditions for inhibit source DFC_ComEBBATOut" VAL_BLK 0x804F0081 ValA_Wu8 17.0000000000 DINH_LimDFCVerb 0.00 17.0000000000 FORMAT "%13.10" NUMBER 55 /end CHARACTERISTIC
/begin CHARACTERISTIC DINH_Lim.DFC_ComEPS1Chksum_CA "inhibit conditions / inhibit limit conditions for inhibit source DFC_ComEPS1Chksum" VAL_BLK 0x804F00B8 ValA_Wu8 17.0000000000 DINH_LimDFCVerb 0.00 17.0000000000 FORMAT "%13.10" NUMBER 57 /end CHARACTERISTIC
/begin CHARACTERISTIC DINH_Lim.DFC_ComEPS1RingCnt_CA "inhibit conditions / inhibit limit conditions for inhibit source DFC_ComEPS1RingCnt" VAL_BLK 0x804F00F1 ValA_Wu8 17.0000000000 DINH_LimDFCVerb 0.00 17.0000000000 FORMAT "%13.10" NUMBER 57 /end CHARACTERISTIC
/begin CHARACTERISTIC DINH_Lim.DFC_ComEPS1TOut_CA "inhibit conditions / inhibit limit conditions for inhibit source DFC_ComEPS1TOut" VAL_BLK 0x804F012A ValA_Wu8 17.0000000000 DINH_LimDFCVerb 0.00 17.0000000000 FORMAT "%13.10" NUMBER 57 /end CHARACTERISTIC
/begin CHARACTERISTIC DINH_Lim.DFC_ComEngCanRxErr_CA "inhibit conditions / inhibit limit conditions for inhibit source DFC_ComEngCanRxErr" VAL_BLK 0x804F0163 ValA_Wu8 17.0000000000 DINH_LimDFCVerb 0.00 17.0000000000 FORMAT "%13.10" NUMBER 53 /end CHARACTERISTIC
/begin CHARACTERISTIC DINH_Lim.DFC_ComGrvySnsrErr_CA "inhibit conditions / inhibit limit conditions for inhibit source DFC_ComGrvySnsrErr" VAL_BLK 0x804F0198 ValA_Wu8 17.0000000000 DINH_LimDFCVerb 0.00 17.0000000000 FORMAT "%13.10" NUMBER 50 /end CHARACTERISTIC
/begin CHARACTERISTIC DINH_Lim.DFC_ComGwIMG1ChkSum_CA "inhibit conditions / inhibit limit conditions for inhibit source DFC_ComGwIMG1ChkSum" VAL_BLK 0x804F01CA ValA_Wu8 17.0000000000 DINH_LimDFCVerb 0.00 17.0000000000 FORMAT "%13.10" NUMBER 56 /end CHARACTERISTIC
/begin CHARACTERISTIC DINH_Lim.DFC_ComGwIMG1RingCnt_CA "inhibit conditions / inhibit limit conditions for inhibit source DFC_ComGwIMG1RingCnt" VAL_BLK 0x804F0202 ValA_Wu8 17.0000000000 DINH_LimDFCVerb 0.00 17.0000000000 FORMAT "%13.10" NUMBER 56 /end CHARACTERISTIC
/begin CHARACTERISTIC DINH_Lim.DFC_ComGwIMG1TOut_CA "inhibit conditions / inhibit limit conditions for inhibit source DFC_ComGwIMG1TOut" VAL_BLK 0x804F023A ValA_Wu8 17.0000000000 DINH_LimDFCVerb 0.00 17.0000000000 FORMAT "%13.10" NUMBER 56 /end CHARACTERISTIC
/begin CHARACTERISTIC DINH_Lim.DFC_ComGwIMG3ChkSum_CA "inhibit conditions / inhibit limit conditions for inhibit source DFC_ComGwIMG3ChkSum" VAL_BLK 0x804F0272 ValA_Wu8 17.0000000000 DINH_LimDFCVerb 0.00 17.0000000000 FORMAT "%13.10" NUMBER 57 /end CHARACTERISTIC
/begin CHARACTERISTIC DINH_Lim.DFC_ComGwIMG3RingCnt_CA "inhibit conditions / inhibit limit conditions for inhibit source DFC_ComGwIMG3RingCnt" VAL_BLK 0x804F02AB ValA_Wu8 17.0000000000 DINH_LimDFCVerb 0.00 17.0000000000 FORMAT "%13.10" NUMBER 57 /end CHARACTERISTIC
/begin CHARACTERISTIC DINH_Lim.DFC_ComGwIMG3TOut_CA "inhibit conditions / inhibit limit conditions for inhibit source DFC_ComGwIMG3TOut" VAL_BLK 0x804F02E4 ValA_Wu8 17.0000000000 DINH_LimDFCVerb 0.00 17.0000000000 FORMAT "%13.10" NUMBER 57 /end CHARACTERISTIC
/begin CHARACTERISTIC DINH_Lim.DFC_ComGwIMG4ChkSum_CA "inhibit conditions / inhibit limit conditions for inhibit source DFC_ComGwIMG4ChkSum" VAL_BLK 0x804F031D ValA_Wu8 17.0000000000 DINH_LimDFCVerb 0.00 17.0000000000 FORMAT "%13.10" NUMBER 56 /end CHARACTERISTIC
/begin CHARACTERISTIC DINH_Lim.DFC_ComGwIMG4RingCnt_CA "inhibit conditions / inhibit limit conditions for inhibit source DFC_ComGwIMG4RingCnt" VAL_BLK 0x804F0355 ValA_Wu8 17.0000000000 DINH_LimDFCVerb 0.00 17.0000000000 FORMAT "%13.10" NUMBER 56 /end CHARACTERISTIC
/begin CHARACTERISTIC DINH_Lim.DFC_ComGwIMG4TOut_CA "inhibit conditions / inhibit limit conditions for inhibit source DFC_ComGwIMG4TOut" VAL_BLK 0x804F038D ValA_Wu8 17.0000000000 DINH_LimDFCVerb 0.00 17.0000000000 FORMAT "%13.10" NUMBER 56 /end CHARACTERISTIC
/begin CHARACTERISTIC DINH_Lim.DFC_ComGwIMG5ChkSum_CA "inhibit conditions / inhibit limit conditions for inhibit source DFC_ComGwIMG5ChkSum" VAL_BLK 0x804F03C5 ValA_Wu8 17.0000000000 DINH_LimDFCVerb 0.00 17.0000000000 FORMAT "%13.10" NUMBER 55 /end CHARACTERISTIC
/begin CHARACTERISTIC DINH_Lim.DFC_ComGwIMG5RingCnt_CA "inhibit conditions / inhibit limit conditions for inhibit source DFC_ComGwIMG5RingCnt" VAL_BLK 0x804F03FC ValA_Wu8 17.0000000000 DINH_LimDFCVerb 0.00 17.0000000000 FORMAT "%13.10" NUMBER 55 /end CHARACTERISTIC
/begin CHARACTERISTIC DINH_Lim.DFC_ComGwIMG5TOut_CA "inhibit conditions / inhibit limit conditions for inhibit source DFC_ComGwIMG5TOut" VAL_BLK 0x804F0433 ValA_Wu8 17.0000000000 DINH_LimDFCVerb 0.00 17.0000000000 FORMAT "%13.10" NUMBER 55 /end CHARACTERISTIC
/begin CHARACTERISTIC DINH_Lim.DFC_ComGwIMG6ChkSum_CA "inhibit conditions / inhibit limit conditions for inhibit source DFC_ComGwIMG6ChkSum" VAL_BLK 0x804F046A ValA_Wu8 17.0000000000 DINH_LimDFCVerb 0.00 17.0000000000 FORMAT "%13.10" NUMBER 4 /end CHARACTERISTIC
/begin CHARACTERISTIC DINH_Lim.DFC_ComGwIMG6RingCnt_CA "inhibit conditions / inhibit limit conditions for inhibit source DFC_ComGwIMG6RingCnt" VAL_BLK 0x804F046E ValA_Wu8 17.0000000000 DINH_LimDFCVerb 0.00 17.0000000000 FORMAT "%13.10" NUMBER 4 /end CHARACTERISTIC
/begin CHARACTERISTIC DINH_Lim.DFC_ComGwIMG6TOut_CA "inhibit conditions / inhibit limit conditions for inhibit source DFC_ComGwIMG6TOut" VAL_BLK 0x804F0472 ValA_Wu8 17.0000000000 DINH_LimDFCVerb 0.00 17.0000000000 FORMAT "%13.10" NUMBER 4 /end CHARACTERISTIC
/begin CHARACTERISTIC DINH_Lim.DFC_ComIDASBChksum_CA "inhibit conditions / inhibit limit conditions for inhibit source DFC_ComIDASBChksum" VAL_BLK 0x804F0476 ValA_Wu8 17.0000000000 DINH_LimDFCVerb 0.00 17.0000000000 FORMAT "%13.10" NUMBER 52 /end CHARACTERISTIC
/begin CHARACTERISTIC DINH_Lim.DFC_ComIDASBRingCnt_CA "inhibit conditions / inhibit limit conditions for inhibit source DFC_ComIDASBRingCnt" VAL_BLK 0x804F04AA ValA_Wu8 17.0000000000 DINH_LimDFCVerb 0.00 17.0000000000 FORMAT "%13.10" NUMBER 52 /end CHARACTERISTIC
/begin CHARACTERISTIC DINH_Lim.DFC_ComIDASBTOut_CA "inhibit conditions / inhibit limit conditions for inhibit source DFC_ComIDASBTOut" VAL_BLK 0x804F04DE ValA_Wu8 17.0000000000 DINH_LimDFCVerb 0.00 17.0000000000 FORMAT "%13.10" NUMBER 52 /end CHARACTERISTIC
/begin CHARACTERISTIC DINH_Lim.DFC_ComIMGMILReq_CA "inhibit conditions / inhibit limit conditions for inhibit source DFC_ComIMGMILReq" VAL_BLK 0x804F0512 ValA_Wu8 17.0000000000 DINH_LimDFCVerb 0.00 17.0000000000 FORMAT "%13.10" NUMBER 2 /end CHARACTERISTIC
/begin CHARACTERISTIC DINH_Lim.DFC_ComISSPrms_CA "inhibit conditions / inhibit limit conditions for inhibit source DFC_ComISSPrms" VAL_BLK 0x804F0514 ValA_Wu8 17.0000000000 DINH_LimDFCVerb 0.00 17.0000000000 FORMAT "%13.10" NUMBER 51 /end CHARACTERISTIC
/begin CHARACTERISTIC DINH_Lim.DFC_ComMETAChksum_CA "inhibit conditions / inhibit limit conditions for inhibit source DFC_ComMETAChksum" VAL_BLK 0x804F0547 ValA_Wu8 17.0000000000 DINH_LimDFCVerb 0.00 17.0000000000 FORMAT "%13.10" NUMBER 59 /end CHARACTERISTIC
/begin CHARACTERISTIC DINH_Lim.DFC_ComMETARingCnt_CA "inhibit conditions / inhibit limit conditions for inhibit source DFC_ComMETARingCnt" VAL_BLK 0x804F0582 ValA_Wu8 17.0000000000 DINH_LimDFCVerb 0.00 17.0000000000 FORMAT "%13.10" NUMBER 59 /end CHARACTERISTIC
/begin CHARACTERISTIC DINH_Lim.DFC_ComMETATOut_CA "inhibit conditions / inhibit limit conditions for inhibit source DFC_ComMETATOut" VAL_BLK 0x804F05BD ValA_Wu8 17.0000000000 DINH_LimDFCVerb 0.00 17.0000000000 FORMAT "%13.10" NUMBER 59 /end CHARACTERISTIC
/begin CHARACTERISTIC DINH_Lim.DFC_ComMETCChksum_CA "inhibit conditions / inhibit limit conditions for inhibit source DFC_ComMETCChksum" VAL_BLK 0x804F05F8 ValA_Wu8 17.0000000000 DINH_LimDFCVerb 0.00 17.0000000000 FORMAT "%13.10" NUMBER 61 /end CHARACTERISTIC
/begin CHARACTERISTIC DINH_Lim.DFC_ComMETCRingCnt_CA "inhibit conditions / inhibit limit conditions for inhibit source DFC_ComMETCRingCnt" VAL_BLK 0x804F0635 ValA_Wu8 17.0000000000 DINH_LimDFCVerb 0.00 17.0000000000 FORMAT "%13.10" NUMBER 61 /end CHARACTERISTIC
/begin CHARACTERISTIC DINH_Lim.DFC_ComMETCTOut_CA "inhibit conditions / inhibit limit conditions for inhibit source DFC_ComMETCTOut" VAL_BLK 0x804F0672 ValA_Wu8 17.0000000000 DINH_LimDFCVerb 0.00 17.0000000000 FORMAT "%13.10" NUMBER 61 /end CHARACTERISTIC
/begin CHARACTERISTIC DINH_Lim.DFC_ComMETDChksum_CA "inhibit conditions / inhibit limit conditions for inhibit source DFC_ComMETDChksum" VAL_BLK 0x804F06AF ValA_Wu8 17.0000000000 DINH_LimDFCVerb 0.00 17.0000000000 FORMAT "%13.10" NUMBER 60 /end CHARACTERISTIC
/begin CHARACTERISTIC DINH_Lim.DFC_ComMETDRingCnt_CA "inhibit conditions / inhibit limit conditions for inhibit source DFC_ComMETDRingCnt" VAL_BLK 0x804F06EB ValA_Wu8 17.0000000000 DINH_LimDFCVerb 0.00 17.0000000000 FORMAT "%13.10" NUMBER 60 /end CHARACTERISTIC
/begin CHARACTERISTIC DINH_Lim.DFC_ComMETDTOut_CA "inhibit conditions / inhibit limit conditions for inhibit source DFC_ComMETDTOut" VAL_BLK 0x804F0727 ValA_Wu8 17.0000000000 DINH_LimDFCVerb 0.00 17.0000000000 FORMAT "%13.10" NUMBER 60 /end CHARACTERISTIC
/begin CHARACTERISTIC DINH_Lim.DFC_ComMETE2Chksum_CA "inhibit conditions / inhibit limit conditions for inhibit source DFC_ComMETE2Chksum" VAL_BLK 0x804F0763 ValA_Wu8 17.0000000000 DINH_LimDFCVerb 0.00 17.0000000000 FORMAT "%13.10" NUMBER 59 /end CHARACTERISTIC
/begin CHARACTERISTIC DINH_Lim.DFC_ComMETE2RingCnt_CA "inhibit conditions / inhibit limit conditions for inhibit source DFC_ComMETE2RingCnt" VAL_BLK 0x804F079E ValA_Wu8 17.0000000000 DINH_LimDFCVerb 0.00 17.0000000000 FORMAT "%13.10" NUMBER 59 /end CHARACTERISTIC
/begin CHARACTERISTIC DINH_Lim.DFC_ComMETE2TOut_CA "inhibit conditions / inhibit limit conditions for inhibit source DFC_ComMETE2TOut" VAL_BLK 0x804F07D9 ValA_Wu8 17.0000000000 DINH_LimDFCVerb 0.00 17.0000000000 FORMAT "%13.10" NUMBER 59 /end CHARACTERISTIC
/begin CHARACTERISTIC DINH_Lim.DFC_ComMETFChksum_CA "inhibit conditions / inhibit limit conditions for inhibit source DFC_ComMETFChksum" VAL_BLK 0x804F0814 ValA_Wu8 17.0000000000 DINH_LimDFCVerb 0.00 17.0000000000 FORMAT "%13.10" NUMBER 59 /end CHARACTERISTIC
/begin CHARACTERISTIC DINH_Lim.DFC_ComMETFRingCnt_CA "inhibit conditions / inhibit limit conditions for inhibit source DFC_ComMETFRingCnt" VAL_BLK 0x804F084F ValA_Wu8 17.0000000000 DINH_LimDFCVerb 0.00 17.0000000000 FORMAT "%13.10" NUMBER 59 /end CHARACTERISTIC
/begin CHARACTERISTIC DINH_Lim.DFC_ComMETFTOut_CA "inhibit conditions / inhibit limit conditions for inhibit source DFC_ComMETFTOut" VAL_BLK 0x804F088A ValA_Wu8 17.0000000000 DINH_LimDFCVerb 0.00 17.0000000000 FORMAT "%13.10" NUMBER 59 /end CHARACTERISTIC
/begin CHARACTERISTIC DINH_Lim.DFC_ComMETGChksum_CA "inhibit conditions / inhibit limit conditions for inhibit source DFC_ComMETGChksum" VAL_BLK 0x804F08C5 ValA_Wu8 17.0000000000 DINH_LimDFCVerb 0.00 17.0000000000 FORMAT "%13.10" NUMBER 59 /end CHARACTERISTIC
/begin CHARACTERISTIC DINH_Lim.DFC_ComMETGRingCnt_CA "inhibit conditions / inhibit limit conditions for inhibit source DFC_ComMETGRingCnt" VAL_BLK 0x804F0900 ValA_Wu8 17.0000000000 DINH_LimDFCVerb 0.00 17.0000000000 FORMAT "%13.10" NUMBER 59 /end CHARACTERISTIC
/begin CHARACTERISTIC DINH_Lim.DFC_ComMETGTOut_CA "inhibit conditions / inhibit limit conditions for inhibit source DFC_ComMETGTOut" VAL_BLK 0x804F093B ValA_Wu8 17.0000000000 DINH_LimDFCVerb 0.00 17.0000000000 FORMAT "%13.10" NUMBER 59 /end CHARACTERISTIC
/begin CHARACTERISTIC DINH_Lim.DFC_ComMETH2Chksum_CA "inhibit conditions / inhibit limit conditions for inhibit source DFC_ComMETH2Chksum" VAL_BLK 0x804F0976 ValA_Wu8 17.0000000000 DINH_LimDFCVerb 0.00 17.0000000000 FORMAT "%13.10" NUMBER 59 /end CHARACTERISTIC
/begin CHARACTERISTIC DINH_Lim.DFC_ComMETH2RingCnt_CA "inhibit conditions / inhibit limit conditions for inhibit source DFC_ComMETH2RingCnt" VAL_BLK 0x804F09B1 ValA_Wu8 17.0000000000 DINH_LimDFCVerb 0.00 17.0000000000 FORMAT "%13.10" NUMBER 59 /end CHARACTERISTIC
/begin CHARACTERISTIC DINH_Lim.DFC_ComMETH2TOut_CA "inhibit conditions / inhibit limit conditions for inhibit source DFC_ComMETH2TOut" VAL_BLK 0x804F09EC ValA_Wu8 17.0000000000 DINH_LimDFCVerb 0.00 17.0000000000 FORMAT "%13.10" NUMBER 59 /end CHARACTERISTIC
/begin CHARACTERISTIC DINH_Lim.DFC_ComMETHChksum_CA "inhibit conditions / inhibit limit conditions for inhibit source DFC_ComMETHChksum" VAL_BLK 0x804F0A27 ValA_Wu8 17.0000000000 DINH_LimDFCVerb 0.00 17.0000000000 FORMAT "%13.10" NUMBER 59 /end CHARACTERISTIC
/begin CHARACTERISTIC DINH_Lim.DFC_ComMETHRingCnt_CA "inhibit conditions / inhibit limit conditions for inhibit source DFC_ComMETHRingCnt" VAL_BLK 0x804F0A62 ValA_Wu8 17.0000000000 DINH_LimDFCVerb 0.00 17.0000000000 FORMAT "%13.10" NUMBER 59 /end CHARACTERISTIC
/begin CHARACTERISTIC DINH_Lim.DFC_ComMETHTOut_CA "inhibit conditions / inhibit limit conditions for inhibit source DFC_ComMETHTOut" VAL_BLK 0x804F0A9D ValA_Wu8 17.0000000000 DINH_LimDFCVerb 0.00 17.0000000000 FORMAT "%13.10" NUMBER 59 /end CHARACTERISTIC
/begin CHARACTERISTIC DINH_Lim.DFC_ComMETIChksum_CA "inhibit conditions / inhibit limit conditions for inhibit source DFC_ComMETIChksum" VAL_BLK 0x804F0AD8 ValA_Wu8 17.0000000000 DINH_LimDFCVerb 0.00 17.0000000000 FORMAT "%13.10" NUMBER 66 /end CHARACTERISTIC
/begin CHARACTERISTIC DINH_Lim.DFC_ComMETIRingCnt_CA "inhibit conditions / inhibit limit conditions for inhibit source DFC_ComMETIRingCnt" VAL_BLK 0x804F0B1A ValA_Wu8 17.0000000000 DINH_LimDFCVerb 0.00 17.0000000000 FORMAT "%13.10" NUMBER 66 /end CHARACTERISTIC
/begin CHARACTERISTIC DINH_Lim.DFC_ComMETITOut_CA "inhibit conditions / inhibit limit conditions for inhibit source DFC_ComMETITOut" VAL_BLK 0x804F0B5C ValA_Wu8 17.0000000000 DINH_LimDFCVerb 0.00 17.0000000000 FORMAT "%13.10" NUMBER 66 /end CHARACTERISTIC
/begin CHARACTERISTIC DINH_Lim.DFC_ComMETKChksum_CA "inhibit conditions / inhibit limit conditions for inhibit source DFC_ComMETKChksum" VAL_BLK 0x804F0B9E ValA_Wu8 17.0000000000 DINH_LimDFCVerb 0.00 17.0000000000 FORMAT "%13.10" NUMBER 60 /end CHARACTERISTIC
/begin CHARACTERISTIC DINH_Lim.DFC_ComMETKRingCnt_CA "inhibit conditions / inhibit limit conditions for inhibit source DFC_ComMETKRingCnt" VAL_BLK 0x804F0BDA ValA_Wu8 17.0000000000 DINH_LimDFCVerb 0.00 17.0000000000 FORMAT "%13.10" NUMBER 60 /end CHARACTERISTIC
/begin CHARACTERISTIC DINH_Lim.DFC_ComMETKTOut_CA "inhibit conditions / inhibit limit conditions for inhibit source DFC_ComMETKTOut" VAL_BLK 0x804F0C16 ValA_Wu8 17.0000000000 DINH_LimDFCVerb 0.00 17.0000000000 FORMAT "%13.10" NUMBER 60 /end CHARACTERISTIC
/begin CHARACTERISTIC DINH_Lim.DFC_ComMETLChksum_CA "inhibit conditions / inhibit limit conditions for inhibit source DFC_ComMETLChksum" VAL_BLK 0x804F0C52 ValA_Wu8 17.0000000000 DINH_LimDFCVerb 0.00 17.0000000000 FORMAT "%13.10" NUMBER 59 /end CHARACTERISTIC
/begin CHARACTERISTIC DINH_Lim.DFC_ComMETLRingCnt_CA "inhibit conditions / inhibit limit conditions for inhibit source DFC_ComMETLRingCnt" VAL_BLK 0x804F0C8D ValA_Wu8 17.0000000000 DINH_LimDFCVerb 0.00 17.0000000000 FORMAT "%13.10" NUMBER 59 /end CHARACTERISTIC
/begin CHARACTERISTIC DINH_Lim.DFC_ComMETLTOut_CA "inhibit conditions / inhibit limit conditions for inhibit source DFC_ComMETLTOut" VAL_BLK 0x804F0CC8 ValA_Wu8 17.0000000000 DINH_LimDFCVerb 0.00 17.0000000000 FORMAT "%13.10" NUMBER 59 /end CHARACTERISTIC
/begin CHARACTERISTIC DINH_Lim.DFC_ComMETMChksum_CA "inhibit conditions / inhibit limit conditions for inhibit source DFC_ComMETMChksum" VAL_BLK 0x804F0D03 ValA_Wu8 17.0000000000 DINH_LimDFCVerb 0.00 17.0000000000 FORMAT "%13.10" NUMBER 58 /end CHARACTERISTIC
/begin CHARACTERISTIC DINH_Lim.DFC_ComMETMRingCnt_CA "inhibit conditions / inhibit limit conditions for inhibit source DFC_ComMETMRingCnt" VAL_BLK 0x804F0D3D ValA_Wu8 17.0000000000 DINH_LimDFCVerb 0.00 17.0000000000 FORMAT "%13.10" NUMBER 58 /end CHARACTERISTIC
/begin CHARACTERISTIC DINH_Lim.DFC_ComMETMTOut_CA "inhibit conditions / inhibit limit conditions for inhibit source DFC_ComMETMTOut" VAL_BLK 0x804F0D77 ValA_Wu8 17.0000000000 DINH_LimDFCVerb 0.00 17.0000000000 FORMAT "%13.10" NUMBER 58 /end CHARACTERISTIC
/begin CHARACTERISTIC DINH_Lim.DFC_ComMETNChksum_CA "inhibit conditions / inhibit limit conditions for inhibit source DFC_ComMETNChksum" VAL_BLK 0x804F0DB1 ValA_Wu8 17.0000000000 DINH_LimDFCVerb 0.00 17.0000000000 FORMAT "%13.10" NUMBER 59 /end CHARACTERISTIC
/begin CHARACTERISTIC DINH_Lim.DFC_ComMETNRingCnt_CA "inhibit conditions / inhibit limit conditions for inhibit source DFC_ComMETNRingCnt" VAL_BLK 0x804F0DEC ValA_Wu8 17.0000000000 DINH_LimDFCVerb 0.00 17.0000000000 FORMAT "%13.10" NUMBER 59 /end CHARACTERISTIC
/begin CHARACTERISTIC DINH_Lim.DFC_ComMETNTOut_CA "inhibit conditions / inhibit limit conditions for inhibit source DFC_ComMETNTOut" VAL_BLK 0x804F0E27 ValA_Wu8 17.0000000000 DINH_LimDFCVerb 0.00 17.0000000000 FORMAT "%13.10" NUMBER 59 /end CHARACTERISTIC
/begin CHARACTERISTIC DINH_Lim.DFC_ComMtrCom_CA "inhibit conditions / inhibit limit conditions for inhibit source DFC_ComMtrCom" VAL_BLK 0x804F0E62 ValA_Wu8 17.0000000000 DINH_LimDFCVerb 0.00 17.0000000000 FORMAT "%13.10" NUMBER 51 /end CHARACTERISTIC
/begin CHARACTERISTIC DINH_Lim.DFC_ComPCUChkSum_CA "inhibit conditions / inhibit limit conditions for inhibit source DFC_ComPCUChkSum" VAL_BLK 0x804F0E95 ValA_Wu8 17.0000000000 DINH_LimDFCVerb 0.00 17.0000000000 FORMAT "%13.10" NUMBER 56 /end CHARACTERISTIC
/begin CHARACTERISTIC DINH_Lim.DFC_ComPCURingCnt_CA "inhibit conditions / inhibit limit conditions for inhibit source DFC_ComPCURingCnt" VAL_BLK 0x804F0ECD ValA_Wu8 17.0000000000 DINH_LimDFCVerb 0.00 17.0000000000 FORMAT "%13.10" NUMBER 56 /end CHARACTERISTIC
/begin CHARACTERISTIC DINH_Lim.DFC_ComPCUTOut_CA "inhibit conditions / inhibit limit conditions for inhibit source DFC_ComPCUTOut" VAL_BLK 0x804F0F05 ValA_Wu8 17.0000000000 DINH_LimDFCVerb 0.00 17.0000000000 FORMAT "%13.10" NUMBER 56 /end CHARACTERISTIC
/begin CHARACTERISTIC DINH_Lim.DFC_ComSRSAChksum_CA "inhibit conditions / inhibit limit conditions for inhibit source DFC_ComSRSAChksum" VAL_BLK 0x804F0F3D ValA_Wu8 17.0000000000 DINH_LimDFCVerb 0.00 17.0000000000 FORMAT "%13.10" NUMBER 56 /end CHARACTERISTIC
/begin CHARACTERISTIC DINH_Lim.DFC_ComSRSARingCnt_CA "inhibit conditions / inhibit limit conditions for inhibit source DFC_ComSRSARingCnt" VAL_BLK 0x804F0F75 ValA_Wu8 17.0000000000 DINH_LimDFCVerb 0.00 17.0000000000 FORMAT "%13.10" NUMBER 56 /end CHARACTERISTIC
/begin CHARACTERISTIC DINH_Lim.DFC_ComSRSATOut_CA "inhibit conditions / inhibit limit conditions for inhibit source DFC_ComSRSATOut" VAL_BLK 0x804F0FAD ValA_Wu8 17.0000000000 DINH_LimDFCVerb 0.00 17.0000000000 FORMAT "%13.10" NUMBER 56 /end CHARACTERISTIC
/begin CHARACTERISTIC DINH_Lim.DFC_ComSRSBChksum_CA "inhibit conditions / inhibit limit conditions for inhibit source DFC_ComSRSBChksum" VAL_BLK 0x804F0FE5 ValA_Wu8 17.0000000000 DINH_LimDFCVerb 0.00 17.0000000000 FORMAT "%13.10" NUMBER 55 /end CHARACTERISTIC
/begin CHARACTERISTIC DINH_Lim.DFC_ComSRSBRingCnt_CA "inhibit conditions / inhibit limit conditions for inhibit source DFC_ComSRSBRingCnt" VAL_BLK 0x804F101C ValA_Wu8 17.0000000000 DINH_LimDFCVerb 0.00 17.0000000000 FORMAT "%13.10" NUMBER 55 /end CHARACTERISTIC
/begin CHARACTERISTIC DINH_Lim.DFC_ComSRSBTOut_CA "inhibit conditions / inhibit limit conditions for inhibit source DFC_ComSRSBTOut" VAL_BLK 0x804F1053 ValA_Wu8 17.0000000000 DINH_LimDFCVerb 0.00 17.0000000000 FORMAT "%13.10" NUMBER 55 /end CHARACTERISTIC
/begin CHARACTERISTIC DINH_Lim.DFC_ComSRSChksum_CA "inhibit conditions / inhibit limit conditions for inhibit source DFC_ComSRSChksum" VAL_BLK 0x804F108A ValA_Wu8 17.0000000000 DINH_LimDFCVerb 0.00 17.0000000000 FORMAT "%13.10" NUMBER 55 /end CHARACTERISTIC
/begin CHARACTERISTIC DINH_Lim.DFC_ComSRSErr_CA "inhibit conditions / inhibit limit conditions for inhibit source DFC_ComSRSErr" VAL_BLK 0x804F10C1 ValA_Wu8 17.0000000000 DINH_LimDFCVerb 0.00 17.0000000000 FORMAT "%13.10" NUMBER 50 /end CHARACTERISTIC
/begin CHARACTERISTIC DINH_Lim.DFC_ComSRSRingCnt_CA "inhibit conditions / inhibit limit conditions for inhibit source DFC_ComSRSRingCnt" VAL_BLK 0x804F10F3 ValA_Wu8 17.0000000000 DINH_LimDFCVerb 0.00 17.0000000000 FORMAT "%13.10" NUMBER 55 /end CHARACTERISTIC
/begin CHARACTERISTIC DINH_Lim.DFC_ComSRSTOut_CA "inhibit conditions / inhibit limit conditions for inhibit source DFC_ComSRSTOut" VAL_BLK 0x804F112A ValA_Wu8 17.0000000000 DINH_LimDFCVerb 0.00 17.0000000000 FORMAT "%13.10" NUMBER 55 /end CHARACTERISTIC
/begin CHARACTERISTIC DINH_Lim.DFC_ComVehSpdPndFltTCU_CA "inhibit conditions / inhibit limit conditions for inhibit source DFC_ComVehSpdPndFltTCU" VAL_BLK 0x804F1161 ValA_Wu8 17.0000000000 DINH_LimDFCVerb 0.00 17.0000000000 FORMAT "%13.10" NUMBER 2 /end CHARACTERISTIC
/begin CHARACTERISTIC DINH_Lim.DFC_EbsChartcCurrErr_CA "inhibit conditions / inhibit limit conditions for inhibit source DFC_EbsChartcCurrErr" VAL_BLK 0x804F1163 ValA_Wu8 17.0000000000 DINH_LimDFCVerb 0.00 17.0000000000 FORMAT "%13.10" NUMBER 61 /end CHARACTERISTIC
/begin CHARACTERISTIC DINH_Lim.DFC_EbsSelfDiagErr_CA "inhibit conditions / inhibit limit conditions for inhibit source DFC_EbsSelfDiagErr" VAL_BLK 0x804F11A0 ValA_Wu8 17.0000000000 DINH_LimDFCVerb 0.00 17.0000000000 FORMAT "%13.10" NUMBER 61 /end CHARACTERISTIC
/begin CHARACTERISTIC DINH_Lim.DFC_GbxCANDigPlausErr_CA "inhibit conditions / inhibit limit conditions for inhibit source DFC_GbxCANDigPlausErr" VAL_BLK 0x804F11DD ValA_Wu8 17.0000000000 DINH_LimDFCVerb 0.00 17.0000000000 FORMAT "%13.10" NUMBER 52 /end CHARACTERISTIC
/begin CHARACTERISTIC DINH_Lim.DFC_GbxNPos1SRCMax_CA "inhibit conditions / inhibit limit conditions for inhibit source DFC_GbxNPos1SRCMax" VAL_BLK 0x804F1211 ValA_Wu8 17.0000000000 DINH_LimDFCVerb 0.00 17.0000000000 FORMAT "%13.10" NUMBER 59 /end CHARACTERISTIC
/begin CHARACTERISTIC DINH_Lim.DFC_GbxNPos1SRCMin_CA "inhibit conditions / inhibit limit conditions for inhibit source DFC_GbxNPos1SRCMin" VAL_BLK 0x804F124C ValA_Wu8 17.0000000000 DINH_LimDFCVerb 0.00 17.0000000000 FORMAT "%13.10" NUMBER 59 /end CHARACTERISTIC
/begin CHARACTERISTIC DINH_Lim.DFC_GbxNPos2SRCMax_CA "inhibit conditions / inhibit limit conditions for inhibit source DFC_GbxNPos2SRCMax" VAL_BLK 0x804F1287 ValA_Wu8 17.0000000000 DINH_LimDFCVerb 0.00 17.0000000000 FORMAT "%13.10" NUMBER 59 /end CHARACTERISTIC
/begin CHARACTERISTIC DINH_Lim.DFC_GbxNPos2SRCMin_CA "inhibit conditions / inhibit limit conditions for inhibit source DFC_GbxNPos2SRCMin" VAL_BLK 0x804F12C2 ValA_Wu8 17.0000000000 DINH_LimDFCVerb 0.00 17.0000000000 FORMAT "%13.10" NUMBER 59 /end CHARACTERISTIC
/begin CHARACTERISTIC DINH_Lim.DFC_GbxNPosAlvChk_CA "inhibit conditions / inhibit limit conditions for inhibit source DFC_GbxNPosAlvChk" VAL_BLK 0x804F12FD ValA_Wu8 17.0000000000 DINH_LimDFCVerb 0.00 17.0000000000 FORMAT "%13.10" NUMBER 50 /end CHARACTERISTIC
/begin CHARACTERISTIC DINH_Lim.DFC_GbxNPosSyncErr_CA "inhibit conditions / inhibit limit conditions for inhibit source DFC_GbxNPosSyncErr" VAL_BLK 0x804F132F ValA_Wu8 17.0000000000 DINH_LimDFCVerb 0.00 17.0000000000 FORMAT "%13.10" NUMBER 57 /end CHARACTERISTIC
/begin CHARACTERISTIC DINH_Lim.DFC_HEGOS2B1HtrPsMax_CA "inhibit conditions / inhibit limit conditions for inhibit source DFC_HEGOS2B1HtrPsMax" VAL_BLK 0x804F1368 ValA_Wu8 17.0000000000 DINH_LimDFCVerb 0.00 17.0000000000 FORMAT "%13.10" NUMBER 68 /end CHARACTERISTIC
/begin CHARACTERISTIC DINH_Lim.DFC_HEGOS2B1HtrPsMin_CA "inhibit conditions / inhibit limit conditions for inhibit source DFC_HEGOS2B1HtrPsMin" VAL_BLK 0x804F13AC ValA_Wu8 17.0000000000 DINH_LimDFCVerb 0.00 17.0000000000 FORMAT "%13.10" NUMBER 68 /end CHARACTERISTIC
/begin CHARACTERISTIC DINH_Lim.DFC_HEGOS2B1HtrPsSig_CA "inhibit conditions / inhibit limit conditions for inhibit source DFC_HEGOS2B1HtrPsSig" VAL_BLK 0x804F13F0 ValA_Wu8 17.0000000000 DINH_LimDFCVerb 0.00 17.0000000000 FORMAT "%13.10" NUMBER 68 /end CHARACTERISTIC
/begin CHARACTERISTIC DINH_Lim.DFC_LinCSErrACG_CA "inhibit conditions / inhibit limit conditions for inhibit source DFC_LinCSErrACG" VAL_BLK 0x804F1434 ValA_Wu8 17.0000000000 DINH_LimDFCVerb 0.00 17.0000000000 FORMAT "%13.10" NUMBER 63 /end CHARACTERISTIC
/begin CHARACTERISTIC DINH_Lim.DFC_LinCSErrEBS_CA "inhibit conditions / inhibit limit conditions for inhibit source DFC_LinCSErrEBS" VAL_BLK 0x804F1473 ValA_Wu8 17.0000000000 DINH_LimDFCVerb 0.00 17.0000000000 FORMAT "%13.10" NUMBER 63 /end CHARACTERISTIC
/begin CHARACTERISTIC DINH_Lim.DFC_LinHdrTimeoutErrACG_CA "inhibit conditions / inhibit limit conditions for inhibit source DFC_LinHdrTimeoutErrACG" VAL_BLK 0x804F14B2 ValA_Wu8 17.0000000000 DINH_LimDFCVerb 0.00 17.0000000000 FORMAT "%13.10" NUMBER 63 /end CHARACTERISTIC
/begin CHARACTERISTIC DINH_Lim.DFC_LinHdrTimeoutErrEBS_CA "inhibit conditions / inhibit limit conditions for inhibit source DFC_LinHdrTimeoutErrEBS" VAL_BLK 0x804F14F1 ValA_Wu8 17.0000000000 DINH_LimDFCVerb 0.00 17.0000000000 FORMAT "%13.10" NUMBER 63 /end CHARACTERISTIC
/begin CHARACTERISTIC DINH_Lim.DFC_LinMsgTimeoutErrACG_CA "inhibit conditions / inhibit limit conditions for inhibit source DFC_LinMsgTimeoutErrACG" VAL_BLK 0x804F1530 ValA_Wu8 17.0000000000 DINH_LimDFCVerb 0.00 17.0000000000 FORMAT "%13.10" NUMBER 63 /end CHARACTERISTIC
/begin CHARACTERISTIC DINH_Lim.DFC_LinMsgTimeoutErrEBS_CA "inhibit conditions / inhibit limit conditions for inhibit source DFC_LinMsgTimeoutErrEBS" VAL_BLK 0x804F156F ValA_Wu8 17.0000000000 DINH_LimDFCVerb 0.00 17.0000000000 FORMAT "%13.10" NUMBER 63 /end CHARACTERISTIC
/begin CHARACTERISTIC DINH_Lim.DFC_LinNoStrtComErr_CA "inhibit conditions / inhibit limit conditions for inhibit source DFC_LinNoStrtComErr" VAL_BLK 0x804F15AE ValA_Wu8 17.0000000000 DINH_LimDFCVerb 0.00 17.0000000000 FORMAT "%13.10" NUMBER 50 /end CHARACTERISTIC
/begin CHARACTERISTIC DINH_Lim.DFC_MisfDetVWhlFrntLeOORHi_CA "inhibit conditions / inhibit limit conditions for inhibit source DFC_MisfDetVWhlFrntLeOORHi" VAL_BLK 0x804F15E0 ValA_Wu8 17.0000000000 DINH_LimDFCVerb 0.00 17.0000000000 FORMAT "%13.10" NUMBER 50 /end CHARACTERISTIC
/begin CHARACTERISTIC DINH_Lim.DFC_MisfDetVWhlFrntLeRatyHi_CA "inhibit conditions / inhibit limit conditions for inhibit source DFC_MisfDetVWhlFrntLeRatyHi" VAL_BLK 0x804F1612 ValA_Wu8 17.0000000000 DINH_LimDFCVerb 0.00 17.0000000000 FORMAT "%13.10" NUMBER 50 /end CHARACTERISTIC
/begin CHARACTERISTIC DINH_Lim.DFC_MisfDetVWhlFrntLeRatyLo_CA "inhibit conditions / inhibit limit conditions for inhibit source DFC_MisfDetVWhlFrntLeRatyLo" VAL_BLK 0x804F1644 ValA_Wu8 17.0000000000 DINH_LimDFCVerb 0.00 17.0000000000 FORMAT "%13.10" NUMBER 50 /end CHARACTERISTIC
/begin CHARACTERISTIC DINH_Lim.DFC_MisfDetVWhlFrntLeStuck_CA "inhibit conditions / inhibit limit conditions for inhibit source DFC_MisfDetVWhlFrntLeStuck" VAL_BLK 0x804F1676 ValA_Wu8 17.0000000000 DINH_LimDFCVerb 0.00 17.0000000000 FORMAT "%13.10" NUMBER 50 /end CHARACTERISTIC
/begin CHARACTERISTIC DINH_Lim.DFC_MisfDetVWhlFrntRiOORHi_CA "inhibit conditions / inhibit limit conditions for inhibit source DFC_MisfDetVWhlFrntRiOORHi" VAL_BLK 0x804F16A8 ValA_Wu8 17.0000000000 DINH_LimDFCVerb 0.00 17.0000000000 FORMAT "%13.10" NUMBER 50 /end CHARACTERISTIC
/begin CHARACTERISTIC DINH_Lim.DFC_MisfDetVWhlFrntRiRatyHi_CA "inhibit conditions / inhibit limit conditions for inhibit source DFC_MisfDetVWhlFrntRiRatyHi" VAL_BLK 0x804F16DA ValA_Wu8 17.0000000000 DINH_LimDFCVerb 0.00 17.0000000000 FORMAT "%13.10" NUMBER 50 /end CHARACTERISTIC
/begin CHARACTERISTIC DINH_Lim.DFC_MisfDetVWhlFrntRiRatyLo_CA "inhibit conditions / inhibit limit conditions for inhibit source DFC_MisfDetVWhlFrntRiRatyLo" VAL_BLK 0x804F170C ValA_Wu8 17.0000000000 DINH_LimDFCVerb 0.00 17.0000000000 FORMAT "%13.10" NUMBER 50 /end CHARACTERISTIC
/begin CHARACTERISTIC DINH_Lim.DFC_MisfDetVWhlFrntRiStuck_CA "inhibit conditions / inhibit limit conditions for inhibit source DFC_MisfDetVWhlFrntRiStuck" VAL_BLK 0x804F173E ValA_Wu8 17.0000000000 DINH_LimDFCVerb 0.00 17.0000000000 FORMAT "%13.10" NUMBER 50 /end CHARACTERISTIC
/begin CHARACTERISTIC DINH_Lim.DFC_MisfDetVWhlReLeOORHi_CA "inhibit conditions / inhibit limit conditions for inhibit source DFC_MisfDetVWhlReLeOORHi" VAL_BLK 0x804F1770 ValA_Wu8 17.0000000000 DINH_LimDFCVerb 0.00 17.0000000000 FORMAT "%13.10" NUMBER 50 /end CHARACTERISTIC
/begin CHARACTERISTIC DINH_Lim.DFC_MisfDetVWhlReLeRatyHi_CA "inhibit conditions / inhibit limit conditions for inhibit source DFC_MisfDetVWhlReLeRatyHi" VAL_BLK 0x804F17A2 ValA_Wu8 17.0000000000 DINH_LimDFCVerb 0.00 17.0000000000 FORMAT "%13.10" NUMBER 50 /end CHARACTERISTIC
/begin CHARACTERISTIC DINH_Lim.DFC_MisfDetVWhlReLeRatyLo_CA "inhibit conditions / inhibit limit conditions for inhibit source DFC_MisfDetVWhlReLeRatyLo" VAL_BLK 0x804F17D4 ValA_Wu8 17.0000000000 DINH_LimDFCVerb 0.00 17.0000000000 FORMAT "%13.10" NUMBER 50 /end CHARACTERISTIC
/begin CHARACTERISTIC DINH_Lim.DFC_MisfDetVWhlReLeStuck_CA "inhibit conditions / inhibit limit conditions for inhibit source DFC_MisfDetVWhlReLeStuck" VAL_BLK 0x804F1806 ValA_Wu8 17.0000000000 DINH_LimDFCVerb 0.00 17.0000000000 FORMAT "%13.10" NUMBER 50 /end CHARACTERISTIC
/begin CHARACTERISTIC DINH_Lim.DFC_MisfDetVWhlReRiOORHi_CA "inhibit conditions / inhibit limit conditions for inhibit source DFC_MisfDetVWhlReRiOORHi" VAL_BLK 0x804F1838 ValA_Wu8 17.0000000000 DINH_LimDFCVerb 0.00 17.0000000000 FORMAT "%13.10" NUMBER 50 /end CHARACTERISTIC
/begin CHARACTERISTIC DINH_Lim.DFC_MisfDetVWhlReRiRatyHi_CA "inhibit conditions / inhibit limit conditions for inhibit source DFC_MisfDetVWhlReRiRatyHi" VAL_BLK 0x804F186A ValA_Wu8 17.0000000000 DINH_LimDFCVerb 0.00 17.0000000000 FORMAT "%13.10" NUMBER 50 /end CHARACTERISTIC
/begin CHARACTERISTIC DINH_Lim.DFC_MisfDetVWhlReRiRatyLo_CA "inhibit conditions / inhibit limit conditions for inhibit source DFC_MisfDetVWhlReRiRatyLo" VAL_BLK 0x804F189C ValA_Wu8 17.0000000000 DINH_LimDFCVerb 0.00 17.0000000000 FORMAT "%13.10" NUMBER 50 /end CHARACTERISTIC
/begin CHARACTERISTIC DINH_Lim.DFC_MisfDetVWhlReRiStuck_CA "inhibit conditions / inhibit limit conditions for inhibit source DFC_MisfDetVWhlReRiStuck" VAL_BLK 0x804F18CE ValA_Wu8 17.0000000000 DINH_LimDFCVerb 0.00 17.0000000000 FORMAT "%13.10" NUMBER 50 /end CHARACTERISTIC
/begin CHARACTERISTIC DINH_Lim.DFC_MisfDetdVWhlFrntLePlaus_CA "inhibit conditions / inhibit limit conditions for inhibit source DFC_MisfDetdVWhlFrntLePlaus" VAL_BLK 0x804F1900 ValA_Wu8 17.0000000000 DINH_LimDFCVerb 0.00 17.0000000000 FORMAT "%13.10" NUMBER 50 /end CHARACTERISTIC
/begin CHARACTERISTIC DINH_Lim.DFC_MisfDetdVWhlFrntRiPlaus_CA "inhibit conditions / inhibit limit conditions for inhibit source DFC_MisfDetdVWhlFrntRiPlaus" VAL_BLK 0x804F1932 ValA_Wu8 17.0000000000 DINH_LimDFCVerb 0.00 17.0000000000 FORMAT "%13.10" NUMBER 50 /end CHARACTERISTIC
/begin CHARACTERISTIC DINH_Lim.DFC_MisfDetdVWhlReLePlaus_CA "inhibit conditions / inhibit limit conditions for inhibit source DFC_MisfDetdVWhlReLePlaus" VAL_BLK 0x804F1964 ValA_Wu8 17.0000000000 DINH_LimDFCVerb 0.00 17.0000000000 FORMAT "%13.10" NUMBER 50 /end CHARACTERISTIC
/begin CHARACTERISTIC DINH_Lim.DFC_MisfDetdVWhlReRiPlaus_CA "inhibit conditions / inhibit limit conditions for inhibit source DFC_MisfDetdVWhlReRiPlaus" VAL_BLK 0x804F1996 ValA_Wu8 17.0000000000 DINH_LimDFCVerb 0.00 17.0000000000 FORMAT "%13.10" NUMBER 50 /end CHARACTERISTIC
/begin CHARACTERISTIC DINH_Lim.DFC_PEnvSigRngMax_CA "inhibit conditions / inhibit limit conditions for inhibit source DFC_PEnvSigRngMax" VAL_BLK 0x804F19C8 ValA_Wu8 17.0000000000 DINH_LimDFCVerb 0.00 17.0000000000 FORMAT "%13.10" NUMBER 75 /end CHARACTERISTIC
/begin CHARACTERISTIC DINH_Lim.DFC_PEnvSigRngMin_CA "inhibit conditions / inhibit limit conditions for inhibit source DFC_PEnvSigRngMin" VAL_BLK 0x804F1A13 ValA_Wu8 17.0000000000 DINH_LimDFCVerb 0.00 17.0000000000 FORMAT "%13.10" NUMBER 75 /end CHARACTERISTIC
/begin CHARACTERISTIC DINH_Lim.DFC_StmFault_CA "inhibit conditions / inhibit limit conditions for inhibit source DFC_StmFault" VAL_BLK 0x804F1A5E ValA_Wu8 17.0000000000 DINH_LimDFCVerb 0.00 17.0000000000 FORMAT "%13.10" NUMBER 53 /end CHARACTERISTIC
/begin CHARACTERISTIC DINH_Lim.DFC_StrtCtOffPth_CA "inhibit conditions / inhibit limit conditions for inhibit source DFC_StrtCtOffPth" VAL_BLK 0x804F1A93 ValA_Wu8 17.0000000000 DINH_LimDFCVerb 0.00 17.0000000000 FORMAT "%13.10" NUMBER 58 /end CHARACTERISTIC
/begin CHARACTERISTIC DINH_Lim.DFC_StrtCtlErr_CA "inhibit conditions / inhibit limit conditions for inhibit source DFC_StrtCtlErr" VAL_BLK 0x804F1ACD ValA_Wu8 17.0000000000 DINH_LimDFCVerb 0.00 17.0000000000 FORMAT "%13.10" NUMBER 51 /end CHARACTERISTIC
/begin CHARACTERISTIC DINH_Lim.DFC_StrtFault_CA "inhibit conditions / inhibit limit conditions for inhibit source DFC_StrtFault" VAL_BLK 0x804F1B00 ValA_Wu8 17.0000000000 DINH_LimDFCVerb 0.00 17.0000000000 FORMAT "%13.10" NUMBER 52 /end CHARACTERISTIC
/begin CHARACTERISTIC DINH_Lim.DFC_StrtLckJudg1_CA "inhibit conditions / inhibit limit conditions for inhibit source DFC_StrtLckJudg1" VAL_BLK 0x804F1B34 ValA_Wu8 17.0000000000 DINH_LimDFCVerb 0.00 17.0000000000 FORMAT "%13.10" NUMBER 57 /end CHARACTERISTIC
/begin CHARACTERISTIC DINH_Lim.DFC_StrtLckJudg2_CA "inhibit conditions / inhibit limit conditions for inhibit source DFC_StrtLckJudg2" VAL_BLK 0x804F1B6D ValA_Wu8 17.0000000000 DINH_LimDFCVerb 0.00 17.0000000000 FORMAT "%13.10" NUMBER 57 /end CHARACTERISTIC
/begin CHARACTERISTIC DINH_Lim.DFC_StrtOL_CA "inhibit conditions / inhibit limit conditions for inhibit source DFC_StrtOL" VAL_BLK 0x804F1BA6 ValA_Wu8 17.0000000000 DINH_LimDFCVerb 0.00 17.0000000000 FORMAT "%13.10" NUMBER 57 /end CHARACTERISTIC
/begin CHARACTERISTIC DINH_Lim.DFC_StrtOL2_CA "inhibit conditions / inhibit limit conditions for inhibit source DFC_StrtOL2" VAL_BLK 0x804F1BDF ValA_Wu8 17.0000000000 DINH_LimDFCVerb 0.00 17.0000000000 FORMAT "%13.10" NUMBER 57 /end CHARACTERISTIC
/begin CHARACTERISTIC DINH_Lim.DFC_StrtSCB_CA "inhibit conditions / inhibit limit conditions for inhibit source DFC_StrtSCB" VAL_BLK 0x804F1C18 ValA_Wu8 17.0000000000 DINH_LimDFCVerb 0.00 17.0000000000 FORMAT "%13.10" NUMBER 58 /end CHARACTERISTIC
/begin CHARACTERISTIC DINH_Lim.DFC_StrtSCB2_CA "inhibit conditions / inhibit limit conditions for inhibit source DFC_StrtSCB2" VAL_BLK 0x804F1C52 ValA_Wu8 17.0000000000 DINH_LimDFCVerb 0.00 17.0000000000 FORMAT "%13.10" NUMBER 58 /end CHARACTERISTIC
/begin CHARACTERISTIC DINH_Lim.DFC_StrtSCG_CA "inhibit conditions / inhibit limit conditions for inhibit source DFC_StrtSCG" VAL_BLK 0x804F1C8C ValA_Wu8 17.0000000000 DINH_LimDFCVerb 0.00 17.0000000000 FORMAT "%13.10" NUMBER 58 /end CHARACTERISTIC
/begin CHARACTERISTIC DINH_Lim.DFC_StrtSCG2_CA "inhibit conditions / inhibit limit conditions for inhibit source DFC_StrtSCG2" VAL_BLK 0x804F1CC6 ValA_Wu8 17.0000000000 DINH_LimDFCVerb 0.00 17.0000000000 FORMAT "%13.10" NUMBER 58 /end CHARACTERISTIC
/begin CHARACTERISTIC DINH_Lim.DFC_StrtStkRly1_CA "inhibit conditions / inhibit limit conditions for inhibit source DFC_StrtStkRly1" VAL_BLK 0x804F1D00 ValA_Wu8 17.0000000000 DINH_LimDFCVerb 0.00 17.0000000000 FORMAT "%13.10" NUMBER 56 /end CHARACTERISTIC
/begin CHARACTERISTIC DINH_Lim.DFC_StrtStkRly2_CA "inhibit conditions / inhibit limit conditions for inhibit source DFC_StrtStkRly2" VAL_BLK 0x804F1D38 ValA_Wu8 17.0000000000 DINH_LimDFCVerb 0.00 17.0000000000 FORMAT "%13.10" NUMBER 56 /end CHARACTERISTIC
/begin CHARACTERISTIC DINH_Lim.DFC_TEVEmax_CA "inhibit conditions / inhibit limit conditions for inhibit source DFC_TEVEmax" VAL_BLK 0x804F1D70 ValA_Wu8 17.0000000000 DINH_LimDFCVerb 0.00 17.0000000000 FORMAT "%13.10" NUMBER 78 /end CHARACTERISTIC
/begin CHARACTERISTIC DINH_Lim.DFC_TEVEmin_CA "inhibit conditions / inhibit limit conditions for inhibit source DFC_TEVEmin" VAL_BLK 0x804F1DBE ValA_Wu8 17.0000000000 DINH_LimDFCVerb 0.00 17.0000000000 FORMAT "%13.10" NUMBER 78 /end CHARACTERISTIC
/begin CHARACTERISTIC DINH_Lim.DFC_TEVEsig_CA "inhibit conditions / inhibit limit conditions for inhibit source DFC_TEVEsig" VAL_BLK 0x804F1E0C ValA_Wu8 17.0000000000 DINH_LimDFCVerb 0.00 17.0000000000 FORMAT "%13.10" NUMBER 78 /end CHARACTERISTIC
/begin CHARACTERISTIC DINH_Lim.DFC_VehVAllPlaus_CA "inhibit conditions / inhibit limit conditions for inhibit source DFC_VehVAllPlaus" VAL_BLK 0x804F1E5A ValA_Wu8 17.0000000000 DINH_LimDFCVerb 0.00 17.0000000000 FORMAT "%13.10" NUMBER 62 /end CHARACTERISTIC
/begin CHARACTERISTIC DINH_Lim.DFC_VehVNCSnsrElecFailr_CA "inhibit conditions / inhibit limit conditions for inhibit source DFC_VehVNCSnsrElecFailr" VAL_BLK 0x804F1E98 ValA_Wu8 17.0000000000 DINH_LimDFCVerb 0.00 17.0000000000 FORMAT "%13.10" NUMBER 55 /end CHARACTERISTIC
/begin CHARACTERISTIC DINH_Lim.DFC_VehVPlausCan_CA "inhibit conditions / inhibit limit conditions for inhibit source DFC_VehVPlausCan" VAL_BLK 0x804F1ECF ValA_Wu8 17.0000000000 DINH_LimDFCVerb 0.00 17.0000000000 FORMAT "%13.10" NUMBER 79 /end CHARACTERISTIC
/begin CHARACTERISTIC DINH_Lim.DFC_VehVPlausFco_CA "inhibit conditions / inhibit limit conditions for inhibit source DFC_VehVPlausFco" VAL_BLK 0x804F1F1E ValA_Wu8 17.0000000000 DINH_LimDFCVerb 0.00 17.0000000000 FORMAT "%13.10" NUMBER 84 /end CHARACTERISTIC
/begin CHARACTERISTIC DINH_Lim.DFC_VehVPlausPwr_CA "inhibit conditions / inhibit limit conditions for inhibit source DFC_VehVPlausPwr" VAL_BLK 0x804F1F72 ValA_Wu8 17.0000000000 DINH_LimDFCVerb 0.00 17.0000000000 FORMAT "%13.10" NUMBER 71 /end CHARACTERISTIC
/begin CHARACTERISTIC DINH_Lim.DFC_VehVPlausV2N_CA "inhibit conditions / inhibit limit conditions for inhibit source DFC_VehVPlausV2N" VAL_BLK 0x804F1FB9 ValA_Wu8 17.0000000000 DINH_LimDFCVerb 0.00 17.0000000000 FORMAT "%13.10" NUMBER 71 /end CHARACTERISTIC
/begin CHARACTERISTIC DINH_Lim.DFC_VehVSpdSnsrAElecFailr_CA "inhibit conditions / inhibit limit conditions for inhibit source DFC_VehVSpdSnsrAElecFailr" VAL_BLK 0x804F2000 ValA_Wu8 17.0000000000 DINH_LimDFCVerb 0.00 17.0000000000 FORMAT "%13.10" NUMBER 54 /end CHARACTERISTIC
/begin CHARACTERISTIC DINH_Lim.DFC_VehVSpdSnsrBElecFailr_CA "inhibit conditions / inhibit limit conditions for inhibit source DFC_VehVSpdSnsrBElecFailr" VAL_BLK 0x804F2036 ValA_Wu8 17.0000000000 DINH_LimDFCVerb 0.00 17.0000000000 FORMAT "%13.10" NUMBER 54 /end CHARACTERISTIC
/begin CHARACTERISTIC DINH_Lim.DFC_ClthMax_CA "inhibit conditions / inhibit limit conditions for inhibit source DFC_ClthMax" VAL_BLK 0x804F206C ValA_Wu8 17.0000000000 DINH_LimDFCVerb 0.00 17.0000000000 FORMAT "%13.10" NUMBER 65 /end CHARACTERISTIC
/begin CHARACTERISTIC DINH_Lim.DFC_IgnClPs_DevComErr_CA "inhibit conditions / inhibit limit conditions for inhibit source DFC_IgnClPs_DevComErr" VAL_BLK 0x804F20AD ValA_Wu8 17.0000000000 DINH_LimDFCVerb 0.00 17.0000000000 FORMAT "%13.10" NUMBER 51 /end CHARACTERISTIC
/begin CHARACTERISTIC DINH_Lim.DFC_IgnClPs_LineOl_0_CA "inhibit conditions / inhibit limit conditions for inhibit source DFC_IgnClPs_LineOl_0" VAL_BLK 0x804F20E0 ValA_Wu8 17.0000000000 DINH_LimDFCVerb 0.00 17.0000000000 FORMAT "%13.10" NUMBER 55 /end CHARACTERISTIC
/begin CHARACTERISTIC DINH_Lim.DFC_IgnClPs_LineOl_1_CA "inhibit conditions / inhibit limit conditions for inhibit source DFC_IgnClPs_LineOl_1" VAL_BLK 0x804F2117 ValA_Wu8 17.0000000000 DINH_LimDFCVerb 0.00 17.0000000000 FORMAT "%13.10" NUMBER 55 /end CHARACTERISTIC
/begin CHARACTERISTIC DINH_Lim.DFC_IgnClPs_LineOl_2_CA "inhibit conditions / inhibit limit conditions for inhibit source DFC_IgnClPs_LineOl_2" VAL_BLK 0x804F214E ValA_Wu8 17.0000000000 DINH_LimDFCVerb 0.00 17.0000000000 FORMAT "%13.10" NUMBER 55 /end CHARACTERISTIC
/begin CHARACTERISTIC DINH_Lim.DFC_IgnClPs_LineOl_3_CA "inhibit conditions / inhibit limit conditions for inhibit source DFC_IgnClPs_LineOl_3" VAL_BLK 0x804F2185 ValA_Wu8 17.0000000000 DINH_LimDFCVerb 0.00 17.0000000000 FORMAT "%13.10" NUMBER 55 /end CHARACTERISTIC
/begin CHARACTERISTIC DINH_Lim.DFC_IgnClPs_LineScb_0_CA "inhibit conditions / inhibit limit conditions for inhibit source DFC_IgnClPs_LineScb_0" VAL_BLK 0x804F21BC ValA_Wu8 17.0000000000 DINH_LimDFCVerb 0.00 17.0000000000 FORMAT "%13.10" NUMBER 55 /end CHARACTERISTIC
/begin CHARACTERISTIC DINH_Lim.DFC_IgnClPs_LineScb_1_CA "inhibit conditions / inhibit limit conditions for inhibit source DFC_IgnClPs_LineScb_1" VAL_BLK 0x804F21F3 ValA_Wu8 17.0000000000 DINH_LimDFCVerb 0.00 17.0000000000 FORMAT "%13.10" NUMBER 55 /end CHARACTERISTIC
/begin CHARACTERISTIC DINH_Lim.DFC_IgnClPs_LineScb_2_CA "inhibit conditions / inhibit limit conditions for inhibit source DFC_IgnClPs_LineScb_2" VAL_BLK 0x804F222A ValA_Wu8 17.0000000000 DINH_LimDFCVerb 0.00 17.0000000000 FORMAT "%13.10" NUMBER 55 /end CHARACTERISTIC
/begin CHARACTERISTIC DINH_Lim.DFC_IgnClPs_LineScb_3_CA "inhibit conditions / inhibit limit conditions for inhibit source DFC_IgnClPs_LineScb_3" VAL_BLK 0x804F2261 ValA_Wu8 17.0000000000 DINH_LimDFCVerb 0.00 17.0000000000 FORMAT "%13.10" NUMBER 55 /end CHARACTERISTIC
/begin CHARACTERISTIC DINH_Lim.DFC_IgnClPs_LineScg_0_CA "inhibit conditions / inhibit limit conditions for inhibit source DFC_IgnClPs_LineScg_0" VAL_BLK 0x804F2298 ValA_Wu8 17.0000000000 DINH_LimDFCVerb 0.00 17.0000000000 FORMAT "%13.10" NUMBER 55 /end CHARACTERISTIC
/begin CHARACTERISTIC DINH_Lim.DFC_IgnClPs_LineScg_1_CA "inhibit conditions / inhibit limit conditions for inhibit source DFC_IgnClPs_LineScg_1" VAL_BLK 0x804F22CF ValA_Wu8 17.0000000000 DINH_LimDFCVerb 0.00 17.0000000000 FORMAT "%13.10" NUMBER 55 /end CHARACTERISTIC
/begin CHARACTERISTIC DINH_Lim.DFC_IgnClPs_LineScg_2_CA "inhibit conditions / inhibit limit conditions for inhibit source DFC_IgnClPs_LineScg_2" VAL_BLK 0x804F2306 ValA_Wu8 17.0000000000 DINH_LimDFCVerb 0.00 17.0000000000 FORMAT "%13.10" NUMBER 55 /end CHARACTERISTIC
/begin CHARACTERISTIC DINH_Lim.DFC_IgnClPs_LineScg_3_CA "inhibit conditions / inhibit limit conditions for inhibit source DFC_IgnClPs_LineScg_3" VAL_BLK 0x804F233D ValA_Wu8 17.0000000000 DINH_LimDFCVerb 0.00 17.0000000000 FORMAT "%13.10" NUMBER 55 /end CHARACTERISTIC
/begin CHARACTERISTIC DINH_Lim.DFC_UEGOASICS1B1_CA "inhibit conditions / inhibit limit conditions for inhibit source DFC_UEGOASICS1B1" VAL_BLK 0x804F2374 ValA_Wu8 17.0000000000 DINH_LimDFCVerb 0.00 17.0000000000 FORMAT "%13.10" NUMBER 76 /end CHARACTERISTIC
/begin CHARACTERISTIC DINH_Lim.DFC_UEGOOLIPES1B1_CA "inhibit conditions / inhibit limit conditions for inhibit source DFC_UEGOOLIPES1B1" VAL_BLK 0x804F23C0 ValA_Wu8 17.0000000000 DINH_LimDFCVerb 0.00 17.0000000000 FORMAT "%13.10" NUMBER 81 /end CHARACTERISTIC
/begin CHARACTERISTIC DINH_Lim.DFC_UEGOOLRES1B1_CA "inhibit conditions / inhibit limit conditions for inhibit source DFC_UEGOOLRES1B1" VAL_BLK 0x804F2411 ValA_Wu8 17.0000000000 DINH_LimDFCVerb 0.00 17.0000000000 FORMAT "%13.10" NUMBER 81 /end CHARACTERISTIC
/begin CHARACTERISTIC DINH_Lim.DFC_UEGOSCBS1B1_CA "inhibit conditions / inhibit limit conditions for inhibit source DFC_UEGOSCBS1B1" VAL_BLK 0x804F2462 ValA_Wu8 17.0000000000 DINH_LimDFCVerb 0.00 17.0000000000 FORMAT "%13.10" NUMBER 76 /end CHARACTERISTIC
/begin CHARACTERISTIC DINH_Lim.DFC_UEGOSCGS1B1_CA "inhibit conditions / inhibit limit conditions for inhibit source DFC_UEGOSCGS1B1" VAL_BLK 0x804F24AE ValA_Wu8 17.0000000000 DINH_LimDFCVerb 0.00 17.0000000000 FORMAT "%13.10" NUMBER 76 /end CHARACTERISTIC
/begin CHARACTERISTIC DINH_Lim.DFC_UEGOSPIS1B1_CA "inhibit conditions / inhibit limit conditions for inhibit source DFC_UEGOSPIS1B1" VAL_BLK 0x804F24FA ValA_Wu8 17.0000000000 DINH_LimDFCVerb 0.00 17.0000000000 FORMAT "%13.10" NUMBER 76 /end CHARACTERISTIC
/begin CHARACTERISTIC DINH_Lim.DFC_UEGOSnsrS1B1_CA "inhibit conditions / inhibit limit conditions for inhibit source DFC_UEGOSnsrS1B1" VAL_BLK 0x804F2546 ValA_Wu8 17.0000000000 DINH_LimDFCVerb 0.00 17.0000000000 FORMAT "%13.10" NUMBER 70 /end CHARACTERISTIC
/begin CHARACTERISTIC DINH_Lim.DFC_UegoOlApesS1B1_CA "inhibit conditions / inhibit limit conditions for inhibit source DFC_UegoOlApesS1B1" VAL_BLK 0x804F258C ValA_Wu8 17.0000000000 DINH_LimDFCVerb 0.00 17.0000000000 FORMAT "%13.10" NUMBER 79 /end CHARACTERISTIC
/begin CHARACTERISTIC DINH_Lim.DFC_UegoOlRCmpS1B1_CA "inhibit conditions / inhibit limit conditions for inhibit source DFC_UegoOlRCmpS1B1" VAL_BLK 0x804F25DB ValA_Wu8 17.0000000000 DINH_LimDFCVerb 0.00 17.0000000000 FORMAT "%13.10" NUMBER 80 /end CHARACTERISTIC
/begin CHARACTERISTIC DINH_Lim.DFC_AirCCmprOL_CA "inhibit conditions / inhibit limit conditions for inhibit source DFC_AirCCmprOL" VAL_BLK 0x804F262B ValA_Wu8 17.0000000000 DINH_LimDFCVerb 0.00 17.0000000000 FORMAT "%13.10" NUMBER 50 /end CHARACTERISTIC
/begin CHARACTERISTIC DINH_Lim.DFC_AirCCmprOvrTemp_CA "inhibit conditions / inhibit limit conditions for inhibit source DFC_AirCCmprOvrTemp" VAL_BLK 0x804F265D ValA_Wu8 17.0000000000 DINH_LimDFCVerb 0.00 17.0000000000 FORMAT "%13.10" NUMBER 50 /end CHARACTERISTIC
/begin CHARACTERISTIC DINH_Lim.DFC_AirCCmprSCB_CA "inhibit conditions / inhibit limit conditions for inhibit source DFC_AirCCmprSCB" VAL_BLK 0x804F268F ValA_Wu8 17.0000000000 DINH_LimDFCVerb 0.00 17.0000000000 FORMAT "%13.10" NUMBER 50 /end CHARACTERISTIC
/begin CHARACTERISTIC DINH_Lim.DFC_AirCCmprSCG_CA "inhibit conditions / inhibit limit conditions for inhibit source DFC_AirCCmprSCG" VAL_BLK 0x804F26C1 ValA_Wu8 17.0000000000 DINH_LimDFCVerb 0.00 17.0000000000 FORMAT "%13.10" NUMBER 50 /end CHARACTERISTIC
/begin CHARACTERISTIC DINH_Lim.DFC_AltErr_CA "inhibit conditions / inhibit limit conditions for inhibit source DFC_AltErr" VAL_BLK 0x804F26F3 ValA_Wu8 17.0000000000 DINH_LimDFCVerb 0.00 17.0000000000 FORMAT "%13.10" NUMBER 51 /end CHARACTERISTIC
/begin CHARACTERISTIC DINH_Lim.DFC_BattUSRCMax_CA "inhibit conditions / inhibit limit conditions for inhibit source DFC_BattUSRCMax" VAL_BLK 0x804F2726 ValA_Wu8 17.0000000000 DINH_LimDFCVerb 0.00 17.0000000000 FORMAT "%13.10" NUMBER 53 /end CHARACTERISTIC
/begin CHARACTERISTIC DINH_Lim.DFC_BattUSRCMin_CA "inhibit conditions / inhibit limit conditions for inhibit source DFC_BattUSRCMin" VAL_BLK 0x804F275B ValA_Wu8 17.0000000000 DINH_LimDFCVerb 0.00 17.0000000000 FORMAT "%13.10" NUMBER 53 /end CHARACTERISTIC
/begin CHARACTERISTIC DINH_Lim.DFC_ComChksTCU1_CA "inhibit conditions / inhibit limit conditions for inhibit source DFC_ComChksTCU1" VAL_BLK 0x804F2790 ValA_Wu8 17.0000000000 DINH_LimDFCVerb 0.00 17.0000000000 FORMAT "%13.10" NUMBER 50 /end CHARACTERISTIC
/begin CHARACTERISTIC DINH_Lim.DFC_ComChksTCU11_CA "inhibit conditions / inhibit limit conditions for inhibit source DFC_ComChksTCU11" VAL_BLK 0x804F27C2 ValA_Wu8 17.0000000000 DINH_LimDFCVerb 0.00 17.0000000000 FORMAT "%13.10" NUMBER 51 /end CHARACTERISTIC
/begin CHARACTERISTIC DINH_Lim.DFC_ComChksTCU12_CA "inhibit conditions / inhibit limit conditions for inhibit source DFC_ComChksTCU12" VAL_BLK 0x804F27F5 ValA_Wu8 17.0000000000 DINH_LimDFCVerb 0.00 17.0000000000 FORMAT "%13.10" NUMBER 52 /end CHARACTERISTIC
/begin CHARACTERISTIC DINH_Lim.DFC_ComChksTCU13_CA "inhibit conditions / inhibit limit conditions for inhibit source DFC_ComChksTCU13" VAL_BLK 0x804F2829 ValA_Wu8 17.0000000000 DINH_LimDFCVerb 0.00 17.0000000000 FORMAT "%13.10" NUMBER 52 /end CHARACTERISTIC
/begin CHARACTERISTIC DINH_Lim.DFC_ComChksTCU2_CA "inhibit conditions / inhibit limit conditions for inhibit source DFC_ComChksTCU2" VAL_BLK 0x804F285D ValA_Wu8 17.0000000000 DINH_LimDFCVerb 0.00 17.0000000000 FORMAT "%13.10" NUMBER 50 /end CHARACTERISTIC
/begin CHARACTERISTIC DINH_Lim.DFC_ComChksTCU3_CA "inhibit conditions / inhibit limit conditions for inhibit source DFC_ComChksTCU3" VAL_BLK 0x804F288F ValA_Wu8 17.0000000000 DINH_LimDFCVerb 0.00 17.0000000000 FORMAT "%13.10" NUMBER 50 /end CHARACTERISTIC
/begin CHARACTERISTIC DINH_Lim.DFC_ComChksTCU4_CA "inhibit conditions / inhibit limit conditions for inhibit source DFC_ComChksTCU4" VAL_BLK 0x804F28C1 ValA_Wu8 17.0000000000 DINH_LimDFCVerb 0.00 17.0000000000 FORMAT "%13.10" NUMBER 50 /end CHARACTERISTIC
/begin CHARACTERISTIC DINH_Lim.DFC_ComCntTCU1_CA "inhibit conditions / inhibit limit conditions for inhibit source DFC_ComCntTCU1" VAL_BLK 0x804F28F3 ValA_Wu8 17.0000000000 DINH_LimDFCVerb 0.00 17.0000000000 FORMAT "%13.10" NUMBER 50 /end CHARACTERISTIC
/begin CHARACTERISTIC DINH_Lim.DFC_ComCntTCU11_CA "inhibit conditions / inhibit limit conditions for inhibit source DFC_ComCntTCU11" VAL_BLK 0x804F2925 ValA_Wu8 17.0000000000 DINH_LimDFCVerb 0.00 17.0000000000 FORMAT "%13.10" NUMBER 51 /end CHARACTERISTIC
/begin CHARACTERISTIC DINH_Lim.DFC_ComCntTCU12_CA "inhibit conditions / inhibit limit conditions for inhibit source DFC_ComCntTCU12" VAL_BLK 0x804F2958 ValA_Wu8 17.0000000000 DINH_LimDFCVerb 0.00 17.0000000000 FORMAT "%13.10" NUMBER 52 /end CHARACTERISTIC
/begin CHARACTERISTIC DINH_Lim.DFC_ComCntTCU13_CA "inhibit conditions / inhibit limit conditions for inhibit source DFC_ComCntTCU13" VAL_BLK 0x804F298C ValA_Wu8 17.0000000000 DINH_LimDFCVerb 0.00 17.0000000000 FORMAT "%13.10" NUMBER 52 /end CHARACTERISTIC
/begin CHARACTERISTIC DINH_Lim.DFC_ComCntTCU2_CA "inhibit conditions / inhibit limit conditions for inhibit source DFC_ComCntTCU2" VAL_BLK 0x804F29C0 ValA_Wu8 17.0000000000 DINH_LimDFCVerb 0.00 17.0000000000 FORMAT "%13.10" NUMBER 50 /end CHARACTERISTIC
/begin CHARACTERISTIC DINH_Lim.DFC_ComCntTCU3_CA "inhibit conditions / inhibit limit conditions for inhibit source DFC_ComCntTCU3" VAL_BLK 0x804F29F2 ValA_Wu8 17.0000000000 DINH_LimDFCVerb 0.00 17.0000000000 FORMAT "%13.10" NUMBER 50 /end CHARACTERISTIC
/begin CHARACTERISTIC DINH_Lim.DFC_ComCntTCU4_CA "inhibit conditions / inhibit limit conditions for inhibit source DFC_ComCntTCU4" VAL_BLK 0x804F2A24 ValA_Wu8 17.0000000000 DINH_LimDFCVerb 0.00 17.0000000000 FORMAT "%13.10" NUMBER 50 /end CHARACTERISTIC
/begin CHARACTERISTIC DINH_Lim.DFC_ComTOutTCU01_CA "inhibit conditions / inhibit limit conditions for inhibit source DFC_ComTOutTCU01" VAL_BLK 0x804F2A56 ValA_Wu8 17.0000000000 DINH_LimDFCVerb 0.00 17.0000000000 FORMAT "%13.10" NUMBER 51 /end CHARACTERISTIC
/begin CHARACTERISTIC DINH_Lim.DFC_ComTOutTCU02_CA "inhibit conditions / inhibit limit conditions for inhibit source DFC_ComTOutTCU02" VAL_BLK 0x804F2A89 ValA_Wu8 17.0000000000 DINH_LimDFCVerb 0.00 17.0000000000 FORMAT "%13.10" NUMBER 51 /end CHARACTERISTIC
/begin CHARACTERISTIC DINH_Lim.DFC_ComTOutTCU1_CA "inhibit conditions / inhibit limit conditions for inhibit source DFC_ComTOutTCU1" VAL_BLK 0x804F2ABC ValA_Wu8 17.0000000000 DINH_LimDFCVerb 0.00 17.0000000000 FORMAT "%13.10" NUMBER 55 /end CHARACTERISTIC
/begin CHARACTERISTIC DINH_Lim.DFC_ComTOutTCU11_CA "inhibit conditions / inhibit limit conditions for inhibit source DFC_ComTOutTCU11" VAL_BLK 0x804F2AF3 ValA_Wu8 17.0000000000 DINH_LimDFCVerb 0.00 17.0000000000 FORMAT "%13.10" NUMBER 54 /end CHARACTERISTIC
/begin CHARACTERISTIC DINH_Lim.DFC_ComTOutTCU12_CA "inhibit conditions / inhibit limit conditions for inhibit source DFC_ComTOutTCU12" VAL_BLK 0x804F2B29 ValA_Wu8 17.0000000000 DINH_LimDFCVerb 0.00 17.0000000000 FORMAT "%13.10" NUMBER 52 /end CHARACTERISTIC
/begin CHARACTERISTIC DINH_Lim.DFC_ComTOutTCU13_CA "inhibit conditions / inhibit limit conditions for inhibit source DFC_ComTOutTCU13" VAL_BLK 0x804F2B5D ValA_Wu8 17.0000000000 DINH_LimDFCVerb 0.00 17.0000000000 FORMAT "%13.10" NUMBER 52 /end CHARACTERISTIC
/begin CHARACTERISTIC DINH_Lim.DFC_ComTOutTCU14_CA "inhibit conditions / inhibit limit conditions for inhibit source DFC_ComTOutTCU14" VAL_BLK 0x804F2B91 ValA_Wu8 17.0000000000 DINH_LimDFCVerb 0.00 17.0000000000 FORMAT "%13.10" NUMBER 51 /end CHARACTERISTIC
/begin CHARACTERISTIC DINH_Lim.DFC_ComTOutTCU2_CA "inhibit conditions / inhibit limit conditions for inhibit source DFC_ComTOutTCU2" VAL_BLK 0x804F2BC4 ValA_Wu8 17.0000000000 DINH_LimDFCVerb 0.00 17.0000000000 FORMAT "%13.10" NUMBER 52 /end CHARACTERISTIC
/begin CHARACTERISTIC DINH_Lim.DFC_ComTOutTCU3_CA "inhibit conditions / inhibit limit conditions for inhibit source DFC_ComTOutTCU3" VAL_BLK 0x804F2BF8 ValA_Wu8 17.0000000000 DINH_LimDFCVerb 0.00 17.0000000000 FORMAT "%13.10" NUMBER 52 /end CHARACTERISTIC
/begin CHARACTERISTIC DINH_Lim.DFC_ComTOutTCU4_CA "inhibit conditions / inhibit limit conditions for inhibit source DFC_ComTOutTCU4" VAL_BLK 0x804F2C2C ValA_Wu8 17.0000000000 DINH_LimDFCVerb 0.00 17.0000000000 FORMAT "%13.10" NUMBER 51 /end CHARACTERISTIC
/begin CHARACTERISTIC DINH_Lim.DFC_DevLibBattUHi_CA "inhibit conditions / inhibit limit conditions for inhibit source DFC_DevLibBattUHi" VAL_BLK 0x804F2C5F ValA_Wu8 17.0000000000 DINH_LimDFCVerb 0.00 17.0000000000 FORMAT "%13.10" NUMBER 50 /end CHARACTERISTIC
/begin CHARACTERISTIC DINH_Lim.DFC_DevLibBattULo_CA "inhibit conditions / inhibit limit conditions for inhibit source DFC_DevLibBattULo" VAL_BLK 0x804F2C91 ValA_Wu8 17.0000000000 DINH_LimDFCVerb 0.00 17.0000000000 FORMAT "%13.10" NUMBER 50 /end CHARACTERISTIC
/begin CHARACTERISTIC DINH_Lim.DFC_FanDIOOL_0_CA "inhibit conditions / inhibit limit conditions for inhibit source DFC_FanDIOOL_0" VAL_BLK 0x804F2CC3 ValA_Wu8 17.0000000000 DINH_LimDFCVerb 0.00 17.0000000000 FORMAT "%13.10" NUMBER 51 /end CHARACTERISTIC
/begin CHARACTERISTIC DINH_Lim.DFC_FanDIOOL_1_CA "inhibit conditions / inhibit limit conditions for inhibit source DFC_FanDIOOL_1" VAL_BLK 0x804F2CF6 ValA_Wu8 17.0000000000 DINH_LimDFCVerb 0.00 17.0000000000 FORMAT "%13.10" NUMBER 51 /end CHARACTERISTIC
/begin CHARACTERISTIC DINH_Lim.DFC_FanDIOOvrTemp_0_CA "inhibit conditions / inhibit limit conditions for inhibit source DFC_FanDIOOvrTemp_0" VAL_BLK 0x804F2D29 ValA_Wu8 17.0000000000 DINH_LimDFCVerb 0.00 17.0000000000 FORMAT "%13.10" NUMBER 50 /end CHARACTERISTIC
/begin CHARACTERISTIC DINH_Lim.DFC_FanDIOOvrTemp_1_CA "inhibit conditions / inhibit limit conditions for inhibit source DFC_FanDIOOvrTemp_1" VAL_BLK 0x804F2D5B ValA_Wu8 17.0000000000 DINH_LimDFCVerb 0.00 17.0000000000 FORMAT "%13.10" NUMBER 50 /end CHARACTERISTIC
/begin CHARACTERISTIC DINH_Lim.DFC_FanDIOSCB_0_CA "inhibit conditions / inhibit limit conditions for inhibit source DFC_FanDIOSCB_0" VAL_BLK 0x804F2D8D ValA_Wu8 17.0000000000 DINH_LimDFCVerb 0.00 17.0000000000 FORMAT "%13.10" NUMBER 51 /end CHARACTERISTIC
/begin CHARACTERISTIC DINH_Lim.DFC_FanDIOSCB_1_CA "inhibit conditions / inhibit limit conditions for inhibit source DFC_FanDIOSCB_1" VAL_BLK 0x804F2DC0 ValA_Wu8 17.0000000000 DINH_LimDFCVerb 0.00 17.0000000000 FORMAT "%13.10" NUMBER 51 /end CHARACTERISTIC
/begin CHARACTERISTIC DINH_Lim.DFC_FanDIOSCG_0_CA "inhibit conditions / inhibit limit conditions for inhibit source DFC_FanDIOSCG_0" VAL_BLK 0x804F2DF3 ValA_Wu8 17.0000000000 DINH_LimDFCVerb 0.00 17.0000000000 FORMAT "%13.10" NUMBER 51 /end CHARACTERISTIC
/begin CHARACTERISTIC DINH_Lim.DFC_FanDIOSCG_1_CA "inhibit conditions / inhibit limit conditions for inhibit source DFC_FanDIOSCG_1" VAL_BLK 0x804F2E26 ValA_Wu8 17.0000000000 DINH_LimDFCVerb 0.00 17.0000000000 FORMAT "%13.10" NUMBER 51 /end CHARACTERISTIC
/begin CHARACTERISTIC DINH_Lim.DFC_MRlyDcOL_CA "inhibit conditions / inhibit limit conditions for inhibit source DFC_MRlyDcOL" VAL_BLK 0x804F2E59 ValA_Wu8 17.0000000000 DINH_LimDFCVerb 0.00 17.0000000000 FORMAT "%13.10" NUMBER 50 /end CHARACTERISTIC
/begin CHARACTERISTIC DINH_Lim.DFC_MRlyDcSCB_CA "inhibit conditions / inhibit limit conditions for inhibit source DFC_MRlyDcSCB" VAL_BLK 0x804F2E8B ValA_Wu8 17.0000000000 DINH_LimDFCVerb 0.00 17.0000000000 FORMAT "%13.10" NUMBER 50 /end CHARACTERISTIC
/begin CHARACTERISTIC DINH_Lim.DFC_MRlyDcSCG_CA "inhibit conditions / inhibit limit conditions for inhibit source DFC_MRlyDcSCG" VAL_BLK 0x804F2EBD ValA_Wu8 17.0000000000 DINH_LimDFCVerb 0.00 17.0000000000 FORMAT "%13.10" NUMBER 50 /end CHARACTERISTIC
/begin CHARACTERISTIC DINH_Lim.DFC_PSPOL_CA "inhibit conditions / inhibit limit conditions for inhibit source DFC_PSPOL" VAL_BLK 0x804F2EEF ValA_Wu8 17.0000000000 DINH_LimDFCVerb 0.00 17.0000000000 FORMAT "%13.10" NUMBER 50 /end CHARACTERISTIC
/begin CHARACTERISTIC DINH_Lim.DFC_PSPOvrTemp_CA "inhibit conditions / inhibit limit conditions for inhibit source DFC_PSPOvrTemp" VAL_BLK 0x804F2F21 ValA_Wu8 17.0000000000 DINH_LimDFCVerb 0.00 17.0000000000 FORMAT "%13.10" NUMBER 50 /end CHARACTERISTIC
/begin CHARACTERISTIC DINH_Lim.DFC_PSPSCB_CA "inhibit conditions / inhibit limit conditions for inhibit source DFC_PSPSCB" VAL_BLK 0x804F2F53 ValA_Wu8 17.0000000000 DINH_LimDFCVerb 0.00 17.0000000000 FORMAT "%13.10" NUMBER 50 /end CHARACTERISTIC
/begin CHARACTERISTIC DINH_Lim.DFC_PSPSCG_CA "inhibit conditions / inhibit limit conditions for inhibit source DFC_PSPSCG" VAL_BLK 0x804F2F85 ValA_Wu8 17.0000000000 DINH_LimDFCVerb 0.00 17.0000000000 FORMAT "%13.10" NUMBER 50 /end CHARACTERISTIC
/begin CHARACTERISTIC DINH_Lim.DFC_T50Err_CA "inhibit conditions / inhibit limit conditions for inhibit source DFC_T50Err" VAL_BLK 0x804F2FB7 ValA_Wu8 17.0000000000 DINH_LimDFCVerb 0.00 17.0000000000 FORMAT "%13.10" NUMBER 51 /end CHARACTERISTIC
/begin CHARACTERISTIC DINH_Lim.DFC_ThrVlvLoBattB1_CA "inhibit conditions / inhibit limit conditions for inhibit source DFC_ThrVlvLoBattB1" VAL_BLK 0x804F2FEA ValA_Wu8 17.0000000000 DINH_LimDFCVerb 0.00 17.0000000000 FORMAT "%13.10" NUMBER 50 /end CHARACTERISTIC
/begin CHARACTERISTIC DINH_Lim.DFC_VehVPhysRngHi_CA "inhibit conditions / inhibit limit conditions for inhibit source DFC_VehVPhysRngHi" VAL_BLK 0x804F301C ValA_Wu8 17.0000000000 DINH_LimDFCVerb 0.00 17.0000000000 FORMAT "%13.10" NUMBER 88 /end CHARACTERISTIC
/begin CHARACTERISTIC DINH_Lim.DFC_VehVSclOutOL_CA "inhibit conditions / inhibit limit conditions for inhibit source DFC_VehVSclOutOL" VAL_BLK 0x804F3074 ValA_Wu8 17.0000000000 DINH_LimDFCVerb 0.00 17.0000000000 FORMAT "%13.10" NUMBER 50 /end CHARACTERISTIC
/begin CHARACTERISTIC DINH_Lim.DFC_VehVSclOutOT_CA "inhibit conditions / inhibit limit conditions for inhibit source DFC_VehVSclOutOT" VAL_BLK 0x804F30A6 ValA_Wu8 17.0000000000 DINH_LimDFCVerb 0.00 17.0000000000 FORMAT "%13.10" NUMBER 50 /end CHARACTERISTIC
/begin CHARACTERISTIC DINH_Lim.DFC_VehVSclOutSCB_CA "inhibit conditions / inhibit limit conditions for inhibit source DFC_VehVSclOutSCB" VAL_BLK 0x804F30D8 ValA_Wu8 17.0000000000 DINH_LimDFCVerb 0.00 17.0000000000 FORMAT "%13.10" NUMBER 50 /end CHARACTERISTIC
/begin CHARACTERISTIC DINH_Lim.DFC_VehVSclOutSCG_CA "inhibit conditions / inhibit limit conditions for inhibit source DFC_VehVSclOutSCG" VAL_BLK 0x804F310A ValA_Wu8 17.0000000000 DINH_LimDFCVerb 0.00 17.0000000000 FORMAT "%13.10" NUMBER 50 /end CHARACTERISTIC
/begin CHARACTERISTIC DINH_Lim.DFC_VehVSnsrARngHi_CA "inhibit conditions / inhibit limit conditions for inhibit source DFC_VehVSnsrARngHi" VAL_BLK 0x804F313C ValA_Wu8 17.0000000000 DINH_LimDFCVerb 0.00 17.0000000000 FORMAT "%13.10" NUMBER 50 /end CHARACTERISTIC
/begin CHARACTERISTIC DINH_Lim.DFC_VehVSnsrBRngHi_CA "inhibit conditions / inhibit limit conditions for inhibit source DFC_VehVSnsrBRngHi" VAL_BLK 0x804F316E ValA_Wu8 17.0000000000 DINH_LimDFCVerb 0.00 17.0000000000 FORMAT "%13.10" NUMBER 50 /end CHARACTERISTIC
/begin CHARACTERISTIC DINH_Lim.DFC_VehVSpdRtyDiag_CA "inhibit conditions / inhibit limit conditions for inhibit source DFC_VehVSpdRtyDiag" VAL_BLK 0x804F31A0 ValA_Wu8 17.0000000000 DINH_LimDFCVerb 0.00 17.0000000000 FORMAT "%13.10" NUMBER 51 /end CHARACTERISTIC
/begin CHARACTERISTIC DINH_Lim.DFC_VehVWhlErr_CA "inhibit conditions / inhibit limit conditions for inhibit source DFC_VehVWhlErr" VAL_BLK 0x804F31D3 ValA_Wu8 17.0000000000 DINH_LimDFCVerb 0.00 17.0000000000 FORMAT "%13.10" NUMBER 54 /end CHARACTERISTIC
/begin CHARACTERISTIC DINH_Lim.DFC_ACEvpTSRCMax_CA "inhibit conditions / inhibit limit conditions for inhibit source DFC_ACEvpTSRCMax" VAL_BLK 0x804F3209 ValA_Wu8 17.0000000000 DINH_LimDFCVerb 0.00 17.0000000000 FORMAT "%13.10" NUMBER 52 /end CHARACTERISTIC
/begin CHARACTERISTIC DINH_Lim.DFC_ACEvpTSRCMin_CA "inhibit conditions / inhibit limit conditions for inhibit source DFC_ACEvpTSRCMin" VAL_BLK 0x804F323D ValA_Wu8 17.0000000000 DINH_LimDFCVerb 0.00 17.0000000000 FORMAT "%13.10" NUMBER 52 /end CHARACTERISTIC
/begin CHARACTERISTIC DINH_Lim.DFC_AirCClntPAnaSRCMax_CA "inhibit conditions / inhibit limit conditions for inhibit source DFC_AirCClntPAnaSRCMax" VAL_BLK 0x804F3271 ValA_Wu8 17.0000000000 DINH_LimDFCVerb 0.00 17.0000000000 FORMAT "%13.10" NUMBER 56 /end CHARACTERISTIC
/begin CHARACTERISTIC DINH_Lim.DFC_AirCClntPAnaSRCMin_CA "inhibit conditions / inhibit limit conditions for inhibit source DFC_AirCClntPAnaSRCMin" VAL_BLK 0x804F32A9 ValA_Wu8 17.0000000000 DINH_LimDFCVerb 0.00 17.0000000000 FORMAT "%13.10" NUMBER 56 /end CHARACTERISTIC
/begin CHARACTERISTIC DINH_Lim.DFC_AirCSwtNpl_CA "inhibit conditions / inhibit limit conditions for inhibit source DFC_AirCSwtNpl" VAL_BLK 0x804F32E1 ValA_Wu8 17.0000000000 DINH_LimDFCVerb 0.00 17.0000000000 FORMAT "%13.10" NUMBER 51 /end CHARACTERISTIC
/begin CHARACTERISTIC DINH_Lim.DFC_AirCSwtSig_CA "inhibit conditions / inhibit limit conditions for inhibit source DFC_AirCSwtSig" VAL_BLK 0x804F3314 ValA_Wu8 17.0000000000 DINH_LimDFCVerb 0.00 17.0000000000 FORMAT "%13.10" NUMBER 51 /end CHARACTERISTIC
/begin CHARACTERISTIC DINH_Lim.DFC_Brk_CA "inhibit conditions / inhibit limit conditions for inhibit source DFC_Brk" VAL_BLK 0x804F3347 ValA_Wu8 17.0000000000 DINH_LimDFCVerb 0.00 17.0000000000 FORMAT "%13.10" NUMBER 50 /end CHARACTERISTIC
/begin CHARACTERISTIC DINH_Lim.DFC_BrkSig_CA "inhibit conditions / inhibit limit conditions for inhibit source DFC_BrkSig" VAL_BLK 0x804F3379 ValA_Wu8 17.0000000000 DINH_LimDFCVerb 0.00 17.0000000000 FORMAT "%13.10" NUMBER 54 /end CHARACTERISTIC
/begin CHARACTERISTIC DINH_Lim.DFC_ClthSig_CA "inhibit conditions / inhibit limit conditions for inhibit source DFC_ClthSig" VAL_BLK 0x804F33AF ValA_Wu8 17.0000000000 DINH_LimDFCVerb 0.00 17.0000000000 FORMAT "%13.10" NUMBER 63 /end CHARACTERISTIC
/begin CHARACTERISTIC DINH_Lim.DFC_HLSDemOvhtEngLim_CA "inhibit conditions / inhibit limit conditions for inhibit source DFC_HLSDemOvhtEngLim" VAL_BLK 0x804F33EE ValA_Wu8 17.0000000000 DINH_LimDFCVerb 0.00 17.0000000000 FORMAT "%13.10" NUMBER 50 /end CHARACTERISTIC
/begin CHARACTERISTIC DINH_Lim.DFC_OilPNpl_CA "inhibit conditions / inhibit limit conditions for inhibit source DFC_OilPNpl" VAL_BLK 0x804F3420 ValA_Wu8 17.0000000000 DINH_LimDFCVerb 0.00 17.0000000000 FORMAT "%13.10" NUMBER 50 /end CHARACTERISTIC
/begin CHARACTERISTIC DINH_Lim.DFC_PIntkVUsLineHiB1_CA "inhibit conditions / inhibit limit conditions for inhibit source DFC_PIntkVUsLineHiB1" VAL_BLK 0x804F3452 ValA_Wu8 17.0000000000 DINH_LimDFCVerb 0.00 17.0000000000 FORMAT "%13.10" NUMBER 91 /end CHARACTERISTIC
/begin CHARACTERISTIC DINH_Lim.DFC_PIntkVUsLineLoB1_CA "inhibit conditions / inhibit limit conditions for inhibit source DFC_PIntkVUsLineLoB1" VAL_BLK 0x804F34AD ValA_Wu8 17.0000000000 DINH_LimDFCVerb 0.00 17.0000000000 FORMAT "%13.10" NUMBER 91 /end CHARACTERISTIC
/begin CHARACTERISTIC DINH_Lim.DFC_VehVPhysRngLo_CA "inhibit conditions / inhibit limit conditions for inhibit source DFC_VehVPhysRngLo" VAL_BLK 0x804F3508 ValA_Wu8 17.0000000000 DINH_LimDFCVerb 0.00 17.0000000000 FORMAT "%13.10" NUMBER 74 /end CHARACTERISTIC
/begin CHARACTERISTIC DINH_Lim.DFC_VehVSigCan_CA "inhibit conditions / inhibit limit conditions for inhibit source DFC_VehVSigCan" VAL_BLK 0x804F3552 ValA_Wu8 17.0000000000 DINH_LimDFCVerb 0.00 17.0000000000 FORMAT "%13.10" NUMBER 53 /end CHARACTERISTIC
/begin CHARACTERISTIC DINH_Lim.DFC_VehVSigCanSafe_CA "inhibit conditions / inhibit limit conditions for inhibit source DFC_VehVSigCanSafe" VAL_BLK 0x804F3587 ValA_Wu8 17.0000000000 DINH_LimDFCVerb 0.00 17.0000000000 FORMAT "%13.10" NUMBER 57 /end CHARACTERISTIC
/begin CHARACTERISTIC DINH_Lim.DFC_VlvLftFbOilPSnsrIntk11SRCMax_CA "inhibit conditions / inhibit limit conditions for inhibit source DFC_VlvLftFbOilPSnsrIntk11SRCMax" VAL_BLK 0x804F35C0 ValA_Wu8 17.0000000000 DINH_LimDFCVerb 0.00 17.0000000000 FORMAT "%13.10" NUMBER 73 /end CHARACTERISTIC
/begin CHARACTERISTIC DINH_Lim.DFC_VlvLftFbOilPSnsrIntk11SRCMin_CA "inhibit conditions / inhibit limit conditions for inhibit source DFC_VlvLftFbOilPSnsrIntk11SRCMin" VAL_BLK 0x804F3609 ValA_Wu8 17.0000000000 DINH_LimDFCVerb 0.00 17.0000000000 FORMAT "%13.10" NUMBER 73 /end CHARACTERISTIC
/begin CHARACTERISTIC DINH_Lim.DFC_ClthNpl_CA "inhibit conditions / inhibit limit conditions for inhibit source DFC_ClthNpl" VAL_BLK 0x804F3652 ValA_Wu8 17.0000000000 DINH_LimDFCVerb 0.00 17.0000000000 FORMAT "%13.10" NUMBER 64 /end CHARACTERISTIC
/begin CHARACTERISTIC DINH_Lim.DFC_EV1max_CA "inhibit conditions / inhibit limit conditions for inhibit source DFC_EV1max" VAL_BLK 0x804F3692 ValA_Wu8 17.0000000000 DINH_LimDFCVerb 0.00 17.0000000000 FORMAT "%13.10" NUMBER 57 /end CHARACTERISTIC
/begin CHARACTERISTIC DINH_Lim.DFC_EV1min_CA "inhibit conditions / inhibit limit conditions for inhibit source DFC_EV1min" VAL_BLK 0x804F36CB ValA_Wu8 17.0000000000 DINH_LimDFCVerb 0.00 17.0000000000 FORMAT "%13.10" NUMBER 59 /end CHARACTERISTIC
/begin CHARACTERISTIC DINH_Lim.DFC_EV1sig_CA "inhibit conditions / inhibit limit conditions for inhibit source DFC_EV1sig" VAL_BLK 0x804F3706 ValA_Wu8 17.0000000000 DINH_LimDFCVerb 0.00 17.0000000000 FORMAT "%13.10" NUMBER 57 /end CHARACTERISTIC
/begin CHARACTERISTIC DINH_Lim.DFC_EV2max_CA "inhibit conditions / inhibit limit conditions for inhibit source DFC_EV2max" VAL_BLK 0x804F373F ValA_Wu8 17.0000000000 DINH_LimDFCVerb 0.00 17.0000000000 FORMAT "%13.10" NUMBER 57 /end CHARACTERISTIC
/begin CHARACTERISTIC DINH_Lim.DFC_EV2min_CA "inhibit conditions / inhibit limit conditions for inhibit source DFC_EV2min" VAL_BLK 0x804F3778 ValA_Wu8 17.0000000000 DINH_LimDFCVerb 0.00 17.0000000000 FORMAT "%13.10" NUMBER 59 /end CHARACTERISTIC
/begin CHARACTERISTIC DINH_Lim.DFC_EV2sig_CA "inhibit conditions / inhibit limit conditions for inhibit source DFC_EV2sig" VAL_BLK 0x804F37B3 ValA_Wu8 17.0000000000 DINH_LimDFCVerb 0.00 17.0000000000 FORMAT "%13.10" NUMBER 57 /end CHARACTERISTIC
/begin CHARACTERISTIC DINH_Lim.DFC_EV3max_CA "inhibit conditions / inhibit limit conditions for inhibit source DFC_EV3max" VAL_BLK 0x804F37EC ValA_Wu8 17.0000000000 DINH_LimDFCVerb 0.00 17.0000000000 FORMAT "%13.10" NUMBER 57 /end CHARACTERISTIC
/begin CHARACTERISTIC DINH_Lim.DFC_EV3min_CA "inhibit conditions / inhibit limit conditions for inhibit source DFC_EV3min" VAL_BLK 0x804F3825 ValA_Wu8 17.0000000000 DINH_LimDFCVerb 0.00 17.0000000000 FORMAT "%13.10" NUMBER 59 /end CHARACTERISTIC
/begin CHARACTERISTIC DINH_Lim.DFC_EV3sig_CA "inhibit conditions / inhibit limit conditions for inhibit source DFC_EV3sig" VAL_BLK 0x804F3860 ValA_Wu8 17.0000000000 DINH_LimDFCVerb 0.00 17.0000000000 FORMAT "%13.10" NUMBER 57 /end CHARACTERISTIC
/begin CHARACTERISTIC DINH_Lim.DFC_EV4max_CA "inhibit conditions / inhibit limit conditions for inhibit source DFC_EV4max" VAL_BLK 0x804F3899 ValA_Wu8 17.0000000000 DINH_LimDFCVerb 0.00 17.0000000000 FORMAT "%13.10" NUMBER 57 /end CHARACTERISTIC
/begin CHARACTERISTIC DINH_Lim.DFC_EV4min_CA "inhibit conditions / inhibit limit conditions for inhibit source DFC_EV4min" VAL_BLK 0x804F38D2 ValA_Wu8 17.0000000000 DINH_LimDFCVerb 0.00 17.0000000000 FORMAT "%13.10" NUMBER 59 /end CHARACTERISTIC
/begin CHARACTERISTIC DINH_Lim.DFC_EV4sig_CA "inhibit conditions / inhibit limit conditions for inhibit source DFC_EV4sig" VAL_BLK 0x804F390D ValA_Wu8 17.0000000000 DINH_LimDFCVerb 0.00 17.0000000000 FORMAT "%13.10" NUMBER 57 /end CHARACTERISTIC
/begin CHARACTERISTIC DINH_Lim.DFC_GbxPNPosnDrvCdn_CA "inhibit conditions / inhibit limit conditions for inhibit source DFC_GbxPNPosnDrvCdn" VAL_BLK 0x804F3946 ValA_Wu8 17.0000000000 DINH_LimDFCVerb 0.00 17.0000000000 FORMAT "%13.10" NUMBER 61 /end CHARACTERISTIC
/begin CHARACTERISTIC DINH_Lim.DFC_GbxPNPosnPlausy_CA "inhibit conditions / inhibit limit conditions for inhibit source DFC_GbxPNPosnPlausy" VAL_BLK 0x804F3983 ValA_Wu8 17.0000000000 DINH_LimDFCVerb 0.00 17.0000000000 FORMAT "%13.10" NUMBER 55 /end CHARACTERISTIC
/begin CHARACTERISTIC DINH_Lim.DFC_PEnvCcMax_CA "inhibit conditions / inhibit limit conditions for inhibit source DFC_PEnvCcMax" VAL_BLK 0x804F39BA ValA_Wu8 17.0000000000 DINH_LimDFCVerb 0.00 17.0000000000 FORMAT "%13.10" NUMBER 71 /end CHARACTERISTIC
/begin CHARACTERISTIC DINH_Lim.DFC_PEnvCcMin_CA "inhibit conditions / inhibit limit conditions for inhibit source DFC_PEnvCcMin" VAL_BLK 0x804F3A01 ValA_Wu8 17.0000000000 DINH_LimDFCVerb 0.00 17.0000000000 FORMAT "%13.10" NUMBER 71 /end CHARACTERISTIC
/begin CHARACTERISTIC DINH_Lim.DFC_PEnvRngChkMax_CA "inhibit conditions / inhibit limit conditions for inhibit source DFC_PEnvRngChkMax" VAL_BLK 0x804F3A48 ValA_Wu8 17.0000000000 DINH_LimDFCVerb 0.00 17.0000000000 FORMAT "%13.10" NUMBER 72 /end CHARACTERISTIC
/begin CHARACTERISTIC DINH_Lim.DFC_PEnvRngChkMin_CA "inhibit conditions / inhibit limit conditions for inhibit source DFC_PEnvRngChkMin" VAL_BLK 0x804F3A90 ValA_Wu8 17.0000000000 DINH_LimDFCVerb 0.00 17.0000000000 FORMAT "%13.10" NUMBER 72 /end CHARACTERISTIC
/begin CHARACTERISTIC DINH_Lim.DFC_PEnvSnsrPlaus_CA "inhibit conditions / inhibit limit conditions for inhibit source DFC_PEnvSnsrPlaus" VAL_BLK 0x804F3AD8 ValA_Wu8 17.0000000000 DINH_LimDFCVerb 0.00 17.0000000000 FORMAT "%13.10" NUMBER 68 /end CHARACTERISTIC
/begin CHARACTERISTIC DINH_Lim.DFC_UEGOHeatrPsS1B1Max_CA "inhibit conditions / inhibit limit conditions for inhibit source DFC_UEGOHeatrPsS1B1Max" VAL_BLK 0x804F3B1C ValA_Wu8 17.0000000000 DINH_LimDFCVerb 0.00 17.0000000000 FORMAT "%13.10" NUMBER 75 /end CHARACTERISTIC
/begin CHARACTERISTIC DINH_Lim.DFC_UEGOHeatrPsS1B1Min_CA "inhibit conditions / inhibit limit conditions for inhibit source DFC_UEGOHeatrPsS1B1Min" VAL_BLK 0x804F3B67 ValA_Wu8 17.0000000000 DINH_LimDFCVerb 0.00 17.0000000000 FORMAT "%13.10" NUMBER 74 /end CHARACTERISTIC
/begin CHARACTERISTIC DINH_Lim.DFC_UEGOHeatrPsS1B1Sig_CA "inhibit conditions / inhibit limit conditions for inhibit source DFC_UEGOHeatrPsS1B1Sig" VAL_BLK 0x804F3BB1 ValA_Wu8 17.0000000000 DINH_LimDFCVerb 0.00 17.0000000000 FORMAT "%13.10" NUMBER 74 /end CHARACTERISTIC
/begin CHARACTERISTIC DINH_Lim.DFC_UEGOHeatrRlyPsOLS1B1_CA "inhibit conditions / inhibit limit conditions for inhibit source DFC_UEGOHeatrRlyPsOLS1B1" VAL_BLK 0x804F3BFB ValA_Wu8 17.0000000000 DINH_LimDFCVerb 0.00 17.0000000000 FORMAT "%13.10" NUMBER 52 /end CHARACTERISTIC
/begin CHARACTERISTIC DINH_Lim.DFC_UEGOHeatrRlyPsSCBS1B1_CA "inhibit conditions / inhibit limit conditions for inhibit source DFC_UEGOHeatrRlyPsSCBS1B1" VAL_BLK 0x804F3C2F ValA_Wu8 17.0000000000 DINH_LimDFCVerb 0.00 17.0000000000 FORMAT "%13.10" NUMBER 53 /end CHARACTERISTIC
/begin CHARACTERISTIC DINH_Lim.DFC_UEGOHeatrRlyPsSCGS1B1_CA "inhibit conditions / inhibit limit conditions for inhibit source DFC_UEGOHeatrRlyPsSCGS1B1" VAL_BLK 0x804F3C64 ValA_Wu8 17.0000000000 DINH_LimDFCVerb 0.00 17.0000000000 FORMAT "%13.10" NUMBER 52 /end CHARACTERISTIC
/begin CHARACTERISTIC DINH_Lim.DFC_KnDetSens1PortAMax_CA "inhibit conditions / inhibit limit conditions for inhibit source DFC_KnDetSens1PortAMax" VAL_BLK 0x804F3C98 ValA_Wu8 17.0000000000 DINH_LimDFCVerb 0.00 17.0000000000 FORMAT "%13.10" NUMBER 55 /end CHARACTERISTIC
/begin CHARACTERISTIC DINH_Lim.DFC_KnDetSens1PortAMin_CA "inhibit conditions / inhibit limit conditions for inhibit source DFC_KnDetSens1PortAMin" VAL_BLK 0x804F3CCF ValA_Wu8 17.0000000000 DINH_LimDFCVerb 0.00 17.0000000000 FORMAT "%13.10" NUMBER 55 /end CHARACTERISTIC
/begin CHARACTERISTIC DINH_Lim.DFC_KnDetSens1PortBMax_CA "inhibit conditions / inhibit limit conditions for inhibit source DFC_KnDetSens1PortBMax" VAL_BLK 0x804F3D06 ValA_Wu8 17.0000000000 DINH_LimDFCVerb 0.00 17.0000000000 FORMAT "%13.10" NUMBER 55 /end CHARACTERISTIC
/begin CHARACTERISTIC DINH_Lim.DFC_KnDetSens1PortBMin_CA "inhibit conditions / inhibit limit conditions for inhibit source DFC_KnDetSens1PortBMin" VAL_BLK 0x804F3D3D ValA_Wu8 17.0000000000 DINH_LimDFCVerb 0.00 17.0000000000 FORMAT "%13.10" NUMBER 55 /end CHARACTERISTIC
/begin CHARACTERISTIC DINH_Lim.DFC_Clth2ONStuck_CA "inhibit conditions / inhibit limit conditions for inhibit source DFC_Clth2ONStuck" VAL_BLK 0x804F3D74 ValA_Wu8 17.0000000000 DINH_LimDFCVerb 0.00 17.0000000000 FORMAT "%13.10" NUMBER 52 /end CHARACTERISTIC
/begin CHARACTERISTIC DINH_Lim.DFC_Clth2ONStuckLdc_CA "inhibit conditions / inhibit limit conditions for inhibit source DFC_Clth2ONStuckLdc" VAL_BLK 0x804F3DA8 ValA_Wu8 17.0000000000 DINH_LimDFCVerb 0.00 17.0000000000 FORMAT "%13.10" NUMBER 52 /end CHARACTERISTIC
/begin CHARACTERISTIC DINH_Lim.DFC_Clth3ONStuckLdc_CA "inhibit conditions / inhibit limit conditions for inhibit source DFC_Clth3ONStuckLdc" VAL_BLK 0x804F3DDC ValA_Wu8 17.0000000000 DINH_LimDFCVerb 0.00 17.0000000000 FORMAT "%13.10" NUMBER 53 /end CHARACTERISTIC
/begin CHARACTERISTIC DINH_Lim.DFC_Clth3ONStuckPostDrv_CA "inhibit conditions / inhibit limit conditions for inhibit source DFC_Clth3ONStuckPostDrv" VAL_BLK 0x804F3E11 ValA_Wu8 17.0000000000 DINH_LimDFCVerb 0.00 17.0000000000 FORMAT "%13.10" NUMBER 52 /end CHARACTERISTIC
/begin CHARACTERISTIC DINH_Lim.DFC_Clth4ONStuck_CA "inhibit conditions / inhibit limit conditions for inhibit source DFC_Clth4ONStuck" VAL_BLK 0x804F3E45 ValA_Wu8 17.0000000000 DINH_LimDFCVerb 0.00 17.0000000000 FORMAT "%13.10" NUMBER 51 /end CHARACTERISTIC
/begin CHARACTERISTIC DINH_Lim.DFC_Clth4ONStuckLdc_CA "inhibit conditions / inhibit limit conditions for inhibit source DFC_Clth4ONStuckLdc" VAL_BLK 0x804F3E78 ValA_Wu8 17.0000000000 DINH_LimDFCVerb 0.00 17.0000000000 FORMAT "%13.10" NUMBER 59 /end CHARACTERISTIC
/begin CHARACTERISTIC DINH_Lim.DFC_ComDLCTCU01_CA "inhibit conditions / inhibit limit conditions for inhibit source DFC_ComDLCTCU01" VAL_BLK 0x804F3EB3 ValA_Wu8 17.0000000000 DINH_LimDFCVerb 0.00 17.0000000000 FORMAT "%13.10" NUMBER 51 /end CHARACTERISTIC
/begin CHARACTERISTIC DINH_Lim.DFC_ComDLCTCU02_CA "inhibit conditions / inhibit limit conditions for inhibit source DFC_ComDLCTCU02" VAL_BLK 0x804F3EE6 ValA_Wu8 17.0000000000 DINH_LimDFCVerb 0.00 17.0000000000 FORMAT "%13.10" NUMBER 51 /end CHARACTERISTIC
/begin CHARACTERISTIC DINH_Lim.DFC_ComDLCTCU1_CA "inhibit conditions / inhibit limit conditions for inhibit source DFC_ComDLCTCU1" VAL_BLK 0x804F3F19 ValA_Wu8 17.0000000000 DINH_LimDFCVerb 0.00 17.0000000000 FORMAT "%13.10" NUMBER 55 /end CHARACTERISTIC
/begin CHARACTERISTIC DINH_Lim.DFC_ComDLCTCU11_CA "inhibit conditions / inhibit limit conditions for inhibit source DFC_ComDLCTCU11" VAL_BLK 0x804F3F50 ValA_Wu8 17.0000000000 DINH_LimDFCVerb 0.00 17.0000000000 FORMAT "%13.10" NUMBER 54 /end CHARACTERISTIC
/begin CHARACTERISTIC DINH_Lim.DFC_ComDLCTCU12_CA "inhibit conditions / inhibit limit conditions for inhibit source DFC_ComDLCTCU12" VAL_BLK 0x804F3F86 ValA_Wu8 17.0000000000 DINH_LimDFCVerb 0.00 17.0000000000 FORMAT "%13.10" NUMBER 52 /end CHARACTERISTIC
/begin CHARACTERISTIC DINH_Lim.DFC_ComDLCTCU13_CA "inhibit conditions / inhibit limit conditions for inhibit source DFC_ComDLCTCU13" VAL_BLK 0x804F3FBA ValA_Wu8 17.0000000000 DINH_LimDFCVerb 0.00 17.0000000000 FORMAT "%13.10" NUMBER 52 /end CHARACTERISTIC
/begin CHARACTERISTIC DINH_Lim.DFC_ComDLCTCU14_CA "inhibit conditions / inhibit limit conditions for inhibit source DFC_ComDLCTCU14" VAL_BLK 0x804F3FEE ValA_Wu8 17.0000000000 DINH_LimDFCVerb 0.00 17.0000000000 FORMAT "%13.10" NUMBER 51 /end CHARACTERISTIC
/begin CHARACTERISTIC DINH_Lim.DFC_ComDLCTCU2_CA "inhibit conditions / inhibit limit conditions for inhibit source DFC_ComDLCTCU2" VAL_BLK 0x804F4021 ValA_Wu8 17.0000000000 DINH_LimDFCVerb 0.00 17.0000000000 FORMAT "%13.10" NUMBER 52 /end CHARACTERISTIC
/begin CHARACTERISTIC DINH_Lim.DFC_ComDLCTCU3_CA "inhibit conditions / inhibit limit conditions for inhibit source DFC_ComDLCTCU3" VAL_BLK 0x804F4055 ValA_Wu8 17.0000000000 DINH_LimDFCVerb 0.00 17.0000000000 FORMAT "%13.10" NUMBER 52 /end CHARACTERISTIC
/begin CHARACTERISTIC DINH_Lim.DFC_ComDLCTCU4_CA "inhibit conditions / inhibit limit conditions for inhibit source DFC_ComDLCTCU4" VAL_BLK 0x804F4089 ValA_Wu8 17.0000000000 DINH_LimDFCVerb 0.00 17.0000000000 FORMAT "%13.10" NUMBER 51 /end CHARACTERISTIC
/begin CHARACTERISTIC DINH_Lim.DFC_EVX_CA "inhibit conditions / inhibit limit conditions for inhibit source DFC_EVX" VAL_BLK 0x804F40BC ValA_Wu8 17.0000000000 DINH_LimDFCVerb 0.00 17.0000000000 FORMAT "%13.10" NUMBER 55 /end CHARACTERISTIC
/begin CHARACTERISTIC DINH_Lim.DFC_EbsSocFlt_CA "inhibit conditions / inhibit limit conditions for inhibit source DFC_EbsSocFlt" VAL_BLK 0x804F40F3 ValA_Wu8 17.0000000000 DINH_LimDFCVerb 0.00 17.0000000000 FORMAT "%13.10" NUMBER 50 /end CHARACTERISTIC
/begin CHARACTERISTIC DINH_Lim.DFC_I14229VINErr_CA "inhibit conditions / inhibit limit conditions for inhibit source DFC_I14229VINErr" VAL_BLK 0x804F4125 ValA_Wu8 17.0000000000 DINH_LimDFCVerb 0.00 17.0000000000 FORMAT "%13.10" NUMBER 50 /end CHARACTERISTIC
/begin CHARACTERISTIC DINH_Lim.DFC_LLRKHmax_CA "inhibit conditions / inhibit limit conditions for inhibit source DFC_LLRKHmax" VAL_BLK 0x804F4157 ValA_Wu8 17.0000000000 DINH_LimDFCVerb 0.00 17.0000000000 FORMAT "%13.10" NUMBER 50 /end CHARACTERISTIC
/begin CHARACTERISTIC DINH_Lim.DFC_LLRKHmin_CA "inhibit conditions / inhibit limit conditions for inhibit source DFC_LLRKHmin" VAL_BLK 0x804F4189 ValA_Wu8 17.0000000000 DINH_LimDFCVerb 0.00 17.0000000000 FORMAT "%13.10" NUMBER 50 /end CHARACTERISTIC
/begin CHARACTERISTIC DINH_Lim.DFC_LLRmax_CA "inhibit conditions / inhibit limit conditions for inhibit source DFC_LLRmax" VAL_BLK 0x804F41BB ValA_Wu8 17.0000000000 DINH_LimDFCVerb 0.00 17.0000000000 FORMAT "%13.10" NUMBER 50 /end CHARACTERISTIC
/begin CHARACTERISTIC DINH_Lim.DFC_LLRmin_CA "inhibit conditions / inhibit limit conditions for inhibit source DFC_LLRmin" VAL_BLK 0x804F41ED ValA_Wu8 17.0000000000 DINH_LimDFCVerb 0.00 17.0000000000 FORMAT "%13.10" NUMBER 50 /end CHARACTERISTIC
/begin CHARACTERISTIC DINH_Lim.DFC_RoughRoad_CA "inhibit conditions / inhibit limit conditions for inhibit source DFC_RoughRoad" VAL_BLK 0x804F421F ValA_Wu8 17.0000000000 DINH_LimDFCVerb 0.00 17.0000000000 FORMAT "%13.10" NUMBER 54 /end CHARACTERISTIC
/begin CHARACTERISTIC DINH_Lim.DFC_SiaEEPRdErr_CA "inhibit conditions / inhibit limit conditions for inhibit source DFC_SiaEEPRdErr" VAL_BLK 0x804F4255 ValA_Wu8 17.0000000000 DINH_LimDFCVerb 0.00 17.0000000000 FORMAT "%13.10" NUMBER 51 /end CHARACTERISTIC
/begin CHARACTERISTIC DINH_Lim.DFC_SiaEEPWrngCod_CA "inhibit conditions / inhibit limit conditions for inhibit source DFC_SiaEEPWrngCod" VAL_BLK 0x804F4288 ValA_Wu8 17.0000000000 DINH_LimDFCVerb 0.00 17.0000000000 FORMAT "%13.10" NUMBER 51 /end CHARACTERISTIC
/begin CHARACTERISTIC DINH_Lim.DFC_UegoDummy_CA "inhibit conditions / inhibit limit conditions for inhibit source DFC_UegoDummy" VAL_BLK 0x804F42BB ValA_Wu8 17.0000000000 DINH_LimDFCVerb 0.00 17.0000000000 FORMAT "%13.10" NUMBER 50 /end CHARACTERISTIC
/begin CHARACTERISTIC DINH_Lim.DFC_BusDiagCANAPPLBusOff_CA "inhibit conditions / inhibit limit conditions for inhibit source DFC_BusDiagCANAPPLBusOff" VAL_BLK 0x804F42ED ValA_Wu8 17.0000000000 DINH_LimDFCVerb 0.00 17.0000000000 FORMAT "%13.10" NUMBER 50 /end CHARACTERISTIC
/begin CHARACTERISTIC DINH_Lim.DFC_BusDiagCANCANCBusOff_CA "inhibit conditions / inhibit limit conditions for inhibit source DFC_BusDiagCANCANCBusOff" VAL_BLK 0x804F431F ValA_Wu8 17.0000000000 DINH_LimDFCVerb 0.00 17.0000000000 FORMAT "%13.10" NUMBER 50 /end CHARACTERISTIC
/begin CHARACTERISTIC DINH_Lim.DFC_BusDiagCANVEHICLEBusOff_CA "inhibit conditions / inhibit limit conditions for inhibit source DFC_BusDiagCANVEHICLEBusOff" VAL_BLK 0x804F4351 ValA_Wu8 17.0000000000 DINH_LimDFCVerb 0.00 17.0000000000 FORMAT "%13.10" NUMBER 61 /end CHARACTERISTIC
/begin CHARACTERISTIC DINH_Lim.DFC_RBA_IODIAGPWR_rba_IoExtCy329_SignalVltSply_0_CA "inhibit conditions / inhibit limit conditions for inhibit source DFC_RBA_IODIAGPWR_rba_IoExtCy329_SignalVltSply_0" VAL_BLK 0x804F438E ValA_Wu8 17.0000000000 DINH_LimDFCVerb 0.00 17.0000000000 FORMAT "%13.10" NUMBER 200 /end CHARACTERISTIC
/begin CHARACTERISTIC DINH_Lim.DFC_RBA_IODIAGPWR_rba_IoExtCy329_SignalVltSply_0OT_CA "inhibit conditions / inhibit limit conditions for inhibit source DFC_RBA_IODIAGPWR_rba_IoExtCy329_SignalVltSply_0OT" VAL_BLK 0x804F4456 ValA_Wu8 17.0000000000 DINH_LimDFCVerb 0.00 17.0000000000 FORMAT "%13.10" NUMBER 50 /end CHARACTERISTIC
/begin CHARACTERISTIC DINH_Lim.DFC_RBA_IODIAGPWR_rba_IoExtCy329_SignalVltSply_0OV_CA "inhibit conditions / inhibit limit conditions for inhibit source DFC_RBA_IODIAGPWR_rba_IoExtCy329_SignalVltSply_0OV" VAL_BLK 0x804F4488 ValA_Wu8 17.0000000000 DINH_LimDFCVerb 0.00 17.0000000000 FORMAT "%13.10" NUMBER 50 /end CHARACTERISTIC
/begin CHARACTERISTIC DINH_Lim.DFC_RBA_IODIAGPWR_rba_IoExtCy329_SignalVltSply_0SCG_CA "inhibit conditions / inhibit limit conditions for inhibit source DFC_RBA_IODIAGPWR_rba_IoExtCy329_SignalVltSply_0SCG" VAL_BLK 0x804F44BA ValA_Wu8 17.0000000000 DINH_LimDFCVerb 0.00 17.0000000000 FORMAT "%13.10" NUMBER 50 /end CHARACTERISTIC
/begin CHARACTERISTIC DINH_Lim.DFC_RBA_IODIAGPWR_rba_IoExtCy329_SignalVltSply_0UV_CA "inhibit conditions / inhibit limit conditions for inhibit source DFC_RBA_IODIAGPWR_rba_IoExtCy329_SignalVltSply_0UV" VAL_BLK 0x804F44EC ValA_Wu8 17.0000000000 DINH_LimDFCVerb 0.00 17.0000000000 FORMAT "%13.10" NUMBER 50 /end CHARACTERISTIC
/begin CHARACTERISTIC DINH_Lim.DFC_RBA_IODIAGPWR_rba_IoExtCy329_SignalVltSply_1_CA "inhibit conditions / inhibit limit conditions for inhibit source DFC_RBA_IODIAGPWR_rba_IoExtCy329_SignalVltSply_1" VAL_BLK 0x804F451E ValA_Wu8 17.0000000000 DINH_LimDFCVerb 0.00 17.0000000000 FORMAT "%13.10" NUMBER 200 /end CHARACTERISTIC
/begin CHARACTERISTIC DINH_Lim.DFC_RBA_IODIAGPWR_rba_IoExtCy329_SignalVltSply_1OT_CA "inhibit conditions / inhibit limit conditions for inhibit source DFC_RBA_IODIAGPWR_rba_IoExtCy329_SignalVltSply_1OT" VAL_BLK 0x804F45E6 ValA_Wu8 17.0000000000 DINH_LimDFCVerb 0.00 17.0000000000 FORMAT "%13.10" NUMBER 50 /end CHARACTERISTIC
/begin CHARACTERISTIC DINH_Lim.DFC_RBA_IODIAGPWR_rba_IoExtCy329_SignalVltSply_1OV_CA "inhibit conditions / inhibit limit conditions for inhibit source DFC_RBA_IODIAGPWR_rba_IoExtCy329_SignalVltSply_1OV" VAL_BLK 0x804F4618 ValA_Wu8 17.0000000000 DINH_LimDFCVerb 0.00 17.0000000000 FORMAT "%13.10" NUMBER 50 /end CHARACTERISTIC
/begin CHARACTERISTIC DINH_Lim.DFC_RBA_IODIAGPWR_rba_IoExtCy329_SignalVltSply_1SCG_CA "inhibit conditions / inhibit limit conditions for inhibit source DFC_RBA_IODIAGPWR_rba_IoExtCy329_SignalVltSply_1SCG" VAL_BLK 0x804F464A ValA_Wu8 17.0000000000 DINH_LimDFCVerb 0.00 17.0000000000 FORMAT "%13.10" NUMBER 50 /end CHARACTERISTIC
/begin CHARACTERISTIC DINH_Lim.DFC_RBA_IODIAGPWR_rba_IoExtCy329_SignalVltSply_1UV_CA "inhibit conditions / inhibit limit conditions for inhibit source DFC_RBA_IODIAGPWR_rba_IoExtCy329_SignalVltSply_1UV" VAL_BLK 0x804F467C ValA_Wu8 17.0000000000 DINH_LimDFCVerb 0.00 17.0000000000 FORMAT "%13.10" NUMBER 50 /end CHARACTERISTIC
/begin CHARACTERISTIC DINH_Lim.DFC_RBA_IODIAGPWR_rba_IoExtCy329_SignalVltSply_2_CA "inhibit conditions / inhibit limit conditions for inhibit source DFC_RBA_IODIAGPWR_rba_IoExtCy329_SignalVltSply_2" VAL_BLK 0x804F46AE ValA_Wu8 17.0000000000 DINH_LimDFCVerb 0.00 17.0000000000 FORMAT "%13.10" NUMBER 100 /end CHARACTERISTIC
/begin CHARACTERISTIC DINH_Lim.DFC_RBA_IODIAGPWR_rba_IoExtCy329_SignalVltSply_2OT_CA "inhibit conditions / inhibit limit conditions for inhibit source DFC_RBA_IODIAGPWR_rba_IoExtCy329_SignalVltSply_2OT" VAL_BLK 0x804F4712 ValA_Wu8 17.0000000000 DINH_LimDFCVerb 0.00 17.0000000000 FORMAT "%13.10" NUMBER 50 /end CHARACTERISTIC
/begin CHARACTERISTIC DINH_Lim.DFC_RBA_IODIAGPWR_rba_IoExtCy329_SignalVltSply_2OV_CA "inhibit conditions / inhibit limit conditions for inhibit source DFC_RBA_IODIAGPWR_rba_IoExtCy329_SignalVltSply_2OV" VAL_BLK 0x804F4744 ValA_Wu8 17.0000000000 DINH_LimDFCVerb 0.00 17.0000000000 FORMAT "%13.10" NUMBER 50 /end CHARACTERISTIC
/begin CHARACTERISTIC DINH_Lim.DFC_RBA_IODIAGPWR_rba_IoExtCy329_SignalVltSply_2SCG_CA "inhibit conditions / inhibit limit conditions for inhibit source DFC_RBA_IODIAGPWR_rba_IoExtCy329_SignalVltSply_2SCG" VAL_BLK 0x804F4776 ValA_Wu8 17.0000000000 DINH_LimDFCVerb 0.00 17.0000000000 FORMAT "%13.10" NUMBER 50 /end CHARACTERISTIC
/begin CHARACTERISTIC DINH_Lim.DFC_RBA_IODIAGPWR_rba_IoExtCy329_SignalVltSply_2UV_CA "inhibit conditions / inhibit limit conditions for inhibit source DFC_RBA_IODIAGPWR_rba_IoExtCy329_SignalVltSply_2UV" VAL_BLK 0x804F47A8 ValA_Wu8 17.0000000000 DINH_LimDFCVerb 0.00 17.0000000000 FORMAT "%13.10" NUMBER 50 /end CHARACTERISTIC
/begin CHARACTERISTIC DINH_Lim.DFC_CAN_E_TIMEOUT_CA "inhibit conditions / inhibit limit conditions for inhibit source DFC_CAN_E_TIMEOUT" VAL_BLK 0x804F47DA ValA_Wu8 17.0000000000 DINH_LimDFCVerb 0.00 17.0000000000 FORMAT "%13.10" NUMBER 50 /end CHARACTERISTIC
/begin CHARACTERISTIC DINH_Lim.DFC_LIN_E_TIMEOUT_CA "inhibit conditions / inhibit limit conditions for inhibit source DFC_LIN_E_TIMEOUT" VAL_BLK 0x804F480C ValA_Wu8 17.0000000000 DINH_LimDFCVerb 0.00 17.0000000000 FORMAT "%13.10" NUMBER 50 /end CHARACTERISTIC
/begin CHARACTERISTIC DINH_Lim.DFC_MRlyOL_CA "inhibit conditions / inhibit limit conditions for inhibit source DFC_MRlyOL" VAL_BLK 0x804F483E ValA_Wu8 17.0000000000 DINH_LimDFCVerb 0.00 17.0000000000 FORMAT "%13.10" NUMBER 50 /end CHARACTERISTIC
/begin CHARACTERISTIC DINH_Lim.DFC_MRlySCB_CA "inhibit conditions / inhibit limit conditions for inhibit source DFC_MRlySCB" VAL_BLK 0x804F4870 ValA_Wu8 17.0000000000 DINH_LimDFCVerb 0.00 17.0000000000 FORMAT "%13.10" NUMBER 50 /end CHARACTERISTIC
/begin CHARACTERISTIC DINH_Lim.DFC_MRlySCG_CA "inhibit conditions / inhibit limit conditions for inhibit source DFC_MRlySCG" VAL_BLK 0x804F48A2 ValA_Wu8 17.0000000000 DINH_LimDFCVerb 0.00 17.0000000000 FORMAT "%13.10" NUMBER 51 /end CHARACTERISTIC
/begin CHARACTERISTIC DINH_Lim.DFC_rba_MultiStackTrace_Threshold_CA "inhibit conditions / inhibit limit conditions for inhibit source DFC_rba_MultiStackTrace_Threshold" VAL_BLK 0x804F48D5 ValA_Wu8 17.0000000000 DINH_LimDFCVerb 0.00 17.0000000000 FORMAT "%13.10" NUMBER 50 /end CHARACTERISTIC
/begin CHARACTERISTIC DINH_Lim.DFC_BSWM_E_ACTION_FAILED_CA "inhibit conditions / inhibit limit conditions for inhibit source DFC_BSWM_E_ACTION_FAILED" VAL_BLK 0x804F4907 ValA_Wu8 17.0000000000 DINH_LimDFCVerb 0.00 17.0000000000 FORMAT "%13.10" NUMBER 50 /end CHARACTERISTIC
/begin CHARACTERISTIC DINH_Lim.DFC_BSWM_E_INTRPTQUEUE_FULL_CA "inhibit conditions / inhibit limit conditions for inhibit source DFC_BSWM_E_INTRPTQUEUE_FULL" VAL_BLK 0x804F4939 ValA_Wu8 17.0000000000 DINH_LimDFCVerb 0.00 17.0000000000 FORMAT "%13.10" NUMBER 50 /end CHARACTERISTIC
/begin CHARACTERISTIC DINH_Lim.DFC_RBA_IOEXTLIB_KEEPALIVE_DRV_CA "inhibit conditions / inhibit limit conditions for inhibit source DFC_RBA_IOEXTLIB_KEEPALIVE_DRV" VAL_BLK 0x804F496B ValA_Wu8 17.0000000000 DINH_LimDFCVerb 0.00 17.0000000000 FORMAT "%13.10" NUMBER 51 /end CHARACTERISTIC
/begin CHARACTERISTIC DINH_Lim.DFC_RBA_IOEXTLIB_KEEPALIVE_INI_CA "inhibit conditions / inhibit limit conditions for inhibit source DFC_RBA_IOEXTLIB_KEEPALIVE_INI" VAL_BLK 0x804F499E ValA_Wu8 17.0000000000 DINH_LimDFCVerb 0.00 17.0000000000 FORMAT "%13.10" NUMBER 51 /end CHARACTERISTIC
/begin CHARACTERISTIC DINH_Lim.DFC_rba_IoSigRtc_StopCounter_CA "inhibit conditions / inhibit limit conditions for inhibit source DFC_rba_IoSigRtc_StopCounter" VAL_BLK 0x804F49D1 ValA_Wu8 17.0000000000 DINH_LimDFCVerb 0.00 17.0000000000 FORMAT "%13.10" NUMBER 53 /end CHARACTERISTIC
/begin CHARACTERISTIC DINH_Lim.DFC_rba_MRly_Diag_Stk_Event_CA "inhibit conditions / inhibit limit conditions for inhibit source DFC_rba_MRly_Diag_Stk_Event" VAL_BLK 0x804F4A06 ValA_Wu8 17.0000000000 DINH_LimDFCVerb 0.00 17.0000000000 FORMAT "%13.10" NUMBER 50 /end CHARACTERISTIC
/begin CHARACTERISTIC DINH_Lim.DFC_rba_MemDiag_MemReadErr_CA "inhibit conditions / inhibit limit conditions for inhibit source DFC_rba_MemDiag_MemReadErr" VAL_BLK 0x804F4A38 ValA_Wu8 17.0000000000 DINH_LimDFCVerb 0.00 17.0000000000 FORMAT "%13.10" NUMBER 60 /end CHARACTERISTIC
/begin CHARACTERISTIC DINH_Lim.DFC_rba_MemDiag_MemWrErr_CA "inhibit conditions / inhibit limit conditions for inhibit source DFC_rba_MemDiag_MemWrErr" VAL_BLK 0x804F4A74 ValA_Wu8 17.0000000000 DINH_LimDFCVerb 0.00 17.0000000000 FORMAT "%13.10" NUMBER 59 /end CHARACTERISTIC
/begin CHARACTERISTIC DINH_Lim.DFC_rba_SyC_IrrSwOffTrigEngRun_Event_CA "inhibit conditions / inhibit limit conditions for inhibit source DFC_rba_SyC_IrrSwOffTrigEngRun_Event" VAL_BLK 0x804F4AAF ValA_Wu8 17.0000000000 DINH_LimDFCVerb 0.00 17.0000000000 FORMAT "%13.10" NUMBER 50 /end CHARACTERISTIC
/begin CHARACTERISTIC DINH_Lim.DFC_rba_T15_Diag_ComInVld_Event_CA "inhibit conditions / inhibit limit conditions for inhibit source DFC_rba_T15_Diag_ComInVld_Event" VAL_BLK 0x804F4AE1 ValA_Wu8 17.0000000000 DINH_LimDFCVerb 0.00 17.0000000000 FORMAT "%13.10" NUMBER 50 /end CHARACTERISTIC
/begin CHARACTERISTIC DINH_Lim.DFC_rba_T15_Diag_ComOff_HwOn_Event_CA "inhibit conditions / inhibit limit conditions for inhibit source DFC_rba_T15_Diag_ComOff_HwOn_Event" VAL_BLK 0x804F4B13 ValA_Wu8 17.0000000000 DINH_LimDFCVerb 0.00 17.0000000000 FORMAT "%13.10" NUMBER 50 /end CHARACTERISTIC
/begin CHARACTERISTIC DINH_Lim.DFC_rba_T15_Diag_ComOn_HwOff_Event_CA "inhibit conditions / inhibit limit conditions for inhibit source DFC_rba_T15_Diag_ComOn_HwOff_Event" VAL_BLK 0x804F4B45 ValA_Wu8 17.0000000000 DINH_LimDFCVerb 0.00 17.0000000000 FORMAT "%13.10" NUMBER 50 /end CHARACTERISTIC
/begin CHARACTERISTIC DINH_Lim.DFC_AppAllSnsrDfct_CA "inhibit conditions / inhibit limit conditions for inhibit source DFC_AppAllSnsrDfct" VAL_BLK 0x804F4B77 ValA_Wu8 17.0000000000 DINH_LimDFCVerb 0.00 17.0000000000 FORMAT "%13.10" NUMBER 51 /end CHARACTERISTIC
/begin CHARACTERISTIC DINH_Lim.DFC_BattUStdbyDiaOL_CA "inhibit conditions / inhibit limit conditions for inhibit source DFC_BattUStdbyDiaOL" VAL_BLK 0x804F4BAA ValA_Wu8 17.0000000000 DINH_LimDFCVerb 0.00 17.0000000000 FORMAT "%13.10" NUMBER 50 /end CHARACTERISTIC
/begin CHARACTERISTIC DINH_Lim.DFC_BigLeakIntkMnfldEmiInfl_CA "inhibit conditions / inhibit limit conditions for inhibit source DFC_BigLeakIntkMnfldEmiInfl" VAL_BLK 0x804F4BDC ValA_Wu8 17.0000000000 DINH_LimDFCVerb 0.00 17.0000000000 FORMAT "%13.10" NUMBER 54 /end CHARACTERISTIC
/begin CHARACTERISTIC DINH_Lim.DFC_BrkMnSwtContOnWarnLmp_CA "inhibit conditions / inhibit limit conditions for inhibit source DFC_BrkMnSwtContOnWarnLmp" VAL_BLK 0x804F4C12 ValA_Wu8 17.0000000000 DINH_LimDFCVerb 0.00 17.0000000000 FORMAT "%13.10" NUMBER 50 /end CHARACTERISTIC
/begin CHARACTERISTIC DINH_Lim.DFC_BrkMnSwtNotStpWarnLmp_CA "inhibit conditions / inhibit limit conditions for inhibit source DFC_BrkMnSwtNotStpWarnLmp" VAL_BLK 0x804F4C44 ValA_Wu8 17.0000000000 DINH_LimDFCVerb 0.00 17.0000000000 FORMAT "%13.10" NUMBER 50 /end CHARACTERISTIC
/begin CHARACTERISTIC DINH_Lim.DFC_BrkRdntSwtContOnWarnLmp_CA "inhibit conditions / inhibit limit conditions for inhibit source DFC_BrkRdntSwtContOnWarnLmp" VAL_BLK 0x804F4C76 ValA_Wu8 17.0000000000 DINH_LimDFCVerb 0.00 17.0000000000 FORMAT "%13.10" NUMBER 50 /end CHARACTERISTIC
/begin CHARACTERISTIC DINH_Lim.DFC_BrkRdntSwtNotStpWarnLmp_CA "inhibit conditions / inhibit limit conditions for inhibit source DFC_BrkRdntSwtNotStpWarnLmp" VAL_BLK 0x804F4CA8 ValA_Wu8 17.0000000000 DINH_LimDFCVerb 0.00 17.0000000000 FORMAT "%13.10" NUMBER 50 /end CHARACTERISTIC
/begin CHARACTERISTIC DINH_Lim.DFC_CEngDsTColdStrtMax_CA "inhibit conditions / inhibit limit conditions for inhibit source DFC_CEngDsTColdStrtMax" VAL_BLK 0x804F4CDA ValA_Wu8 17.0000000000 DINH_LimDFCVerb 0.00 17.0000000000 FORMAT "%13.10" NUMBER 97 /end CHARACTERISTIC
/begin CHARACTERISTIC DINH_Lim.DFC_CEngDsTColdStrtMin_CA "inhibit conditions / inhibit limit conditions for inhibit source DFC_CEngDsTColdStrtMin" VAL_BLK 0x804F4D3B ValA_Wu8 17.0000000000 DINH_LimDFCVerb 0.00 17.0000000000 FORMAT "%13.10" NUMBER 97 /end CHARACTERISTIC
/begin CHARACTERISTIC DINH_Lim.DFC_CEngDsTImps_CA "inhibit conditions / inhibit limit conditions for inhibit source DFC_CEngDsTImps" VAL_BLK 0x804F4D9C ValA_Wu8 17.0000000000 DINH_LimDFCVerb 0.00 17.0000000000 FORMAT "%13.10" NUMBER 100 /end CHARACTERISTIC
/begin CHARACTERISTIC DINH_Lim.DFC_CEngDsTPlausLSC_CA "inhibit conditions / inhibit limit conditions for inhibit source DFC_CEngDsTPlausLSC" VAL_BLK 0x804F4E00 ValA_Wu8 17.0000000000 DINH_LimDFCVerb 0.00 17.0000000000 FORMAT "%13.10" NUMBER 97 /end CHARACTERISTIC
/begin CHARACTERISTIC DINH_Lim.DFC_CEngDsTPlausSTC_CA "inhibit conditions / inhibit limit conditions for inhibit source DFC_CEngDsTPlausSTC" VAL_BLK 0x804F4E61 ValA_Wu8 17.0000000000 DINH_LimDFCVerb 0.00 17.0000000000 FORMAT "%13.10" NUMBER 96 /end CHARACTERISTIC
/begin CHARACTERISTIC DINH_Lim.DFC_CEngDsTSRCMax_CA "inhibit conditions / inhibit limit conditions for inhibit source DFC_CEngDsTSRCMax" VAL_BLK 0x804F4EC1 ValA_Wu8 17.0000000000 DINH_LimDFCVerb 0.00 17.0000000000 FORMAT "%13.10" NUMBER 111 /end CHARACTERISTIC
/begin CHARACTERISTIC DINH_Lim.DFC_CEngDsTSRCMin_CA "inhibit conditions / inhibit limit conditions for inhibit source DFC_CEngDsTSRCMin" VAL_BLK 0x804F4F30 ValA_Wu8 17.0000000000 DINH_LimDFCVerb 0.00 17.0000000000 FORMAT "%13.10" NUMBER 111 /end CHARACTERISTIC
/begin CHARACTERISTIC DINH_Lim.DFC_CEngDsTSig_CA "inhibit conditions / inhibit limit conditions for inhibit source DFC_CEngDsTSig" VAL_BLK 0x804F4F9F ValA_Wu8 17.0000000000 DINH_LimDFCVerb 0.00 17.0000000000 FORMAT "%13.10" NUMBER 99 /end CHARACTERISTIC
/begin CHARACTERISTIC DINH_Lim.DFC_CEngUsTSRCMax_CA "inhibit conditions / inhibit limit conditions for inhibit source DFC_CEngUsTSRCMax" VAL_BLK 0x804F5002 ValA_Wu8 17.0000000000 DINH_LimDFCVerb 0.00 17.0000000000 FORMAT "%13.10" NUMBER 56 /end CHARACTERISTIC
/begin CHARACTERISTIC DINH_Lim.DFC_CEngUsTSRCMin_CA "inhibit conditions / inhibit limit conditions for inhibit source DFC_CEngUsTSRCMin" VAL_BLK 0x804F503A ValA_Wu8 17.0000000000 DINH_LimDFCVerb 0.00 17.0000000000 FORMAT "%13.10" NUMBER 56 /end CHARACTERISTIC
/begin CHARACTERISTIC DINH_Lim.DFC_DCDCFltDet_CA "inhibit conditions / inhibit limit conditions for inhibit source DFC_DCDCFltDet" VAL_BLK 0x804F5072 ValA_Wu8 17.0000000000 DINH_LimDFCVerb 0.00 17.0000000000 FORMAT "%13.10" NUMBER 58 /end CHARACTERISTIC
/begin CHARACTERISTIC DINH_Lim.DFC_DKRSA_CA "inhibit conditions / inhibit limit conditions for inhibit source DFC_DKRSA" VAL_BLK 0x804F50AC ValA_Wu8 17.0000000000 DINH_LimDFCVerb 0.00 17.0000000000 FORMAT "%13.10" NUMBER 55 /end CHARACTERISTIC
/begin CHARACTERISTIC DINH_Lim.DFC_DKVSmax_CA "inhibit conditions / inhibit limit conditions for inhibit source DFC_DKVSmax" VAL_BLK 0x804F50E3 ValA_Wu8 17.0000000000 DINH_LimDFCVerb 0.00 17.0000000000 FORMAT "%13.10" NUMBER 50 /end CHARACTERISTIC
/begin CHARACTERISTIC DINH_Lim.DFC_DKnpl_CA "inhibit conditions / inhibit limit conditions for inhibit source DFC_DKnpl" VAL_BLK 0x804F5115 ValA_Wu8 17.0000000000 DINH_LimDFCVerb 0.00 17.0000000000 FORMAT "%13.10" NUMBER 50 /end CHARACTERISTIC
/begin CHARACTERISTIC DINH_Lim.DFC_DSSmax_CA "inhibit conditions / inhibit limit conditions for inhibit source DFC_DSSmax" VAL_BLK 0x804F5147 ValA_Wu8 17.0000000000 DINH_LimDFCVerb 0.00 17.0000000000 FORMAT "%13.10" NUMBER 50 /end CHARACTERISTIC
/begin CHARACTERISTIC DINH_Lim.DFC_DSTTI_CA "inhibit conditions / inhibit limit conditions for inhibit source DFC_DSTTI" VAL_BLK 0x804F5179 ValA_Wu8 17.0000000000 DINH_LimDFCVerb 0.00 17.0000000000 FORMAT "%13.10" NUMBER 51 /end CHARACTERISTIC
/begin CHARACTERISTIC DINH_Lim.DFC_DSUmax_CA "inhibit conditions / inhibit limit conditions for inhibit source DFC_DSUmax" VAL_BLK 0x804F51AC ValA_Wu8 17.0000000000 DINH_LimDFCVerb 0.00 17.0000000000 FORMAT "%13.10" NUMBER 50 /end CHARACTERISTIC
/begin CHARACTERISTIC DINH_Lim.DFC_EGRVlvOL_CA "inhibit conditions / inhibit limit conditions for inhibit source DFC_EGRVlvOL" VAL_BLK 0x804F51DE ValA_Wu8 17.0000000000 DINH_LimDFCVerb 0.00 17.0000000000 FORMAT "%13.10" NUMBER 50 /end CHARACTERISTIC
/begin CHARACTERISTIC DINH_Lim.DFC_EGRVlvSCB_CA "inhibit conditions / inhibit limit conditions for inhibit source DFC_EGRVlvSCB" VAL_BLK 0x804F5210 ValA_Wu8 17.0000000000 DINH_LimDFCVerb 0.00 17.0000000000 FORMAT "%13.10" NUMBER 50 /end CHARACTERISTIC
/begin CHARACTERISTIC DINH_Lim.DFC_EGRVlvSCG_CA "inhibit conditions / inhibit limit conditions for inhibit source DFC_EGRVlvSCG" VAL_BLK 0x804F5242 ValA_Wu8 17.0000000000 DINH_LimDFCVerb 0.00 17.0000000000 FORMAT "%13.10" NUMBER 50 /end CHARACTERISTIC
/begin CHARACTERISTIC DINH_Lim.DFC_EGSDUS2B1LtrDly_CA "inhibit conditions / inhibit limit conditions for inhibit source DFC_EGSDUS2B1LtrDly" VAL_BLK 0x804F5274 ValA_Wu8 17.0000000000 DINH_LimDFCVerb 0.00 17.0000000000 FORMAT "%13.10" NUMBER 58 /end CHARACTERISTIC
/begin CHARACTERISTIC DINH_Lim.DFC_EGSDUS2B1LtrPT1_CA "inhibit conditions / inhibit limit conditions for inhibit source DFC_EGSDUS2B1LtrPT1" VAL_BLK 0x804F52AE ValA_Wu8 17.0000000000 DINH_LimDFCVerb 0.00 17.0000000000 FORMAT "%13.10" NUMBER 58 /end CHARACTERISTIC
/begin CHARACTERISTIC DINH_Lim.DFC_EGSDUS2B1RtlDly_CA "inhibit conditions / inhibit limit conditions for inhibit source DFC_EGSDUS2B1RtlDly" VAL_BLK 0x804F52E8 ValA_Wu8 17.0000000000 DINH_LimDFCVerb 0.00 17.0000000000 FORMAT "%13.10" NUMBER 58 /end CHARACTERISTIC
/begin CHARACTERISTIC DINH_Lim.DFC_EGSDUS2B1RtlPT1_CA "inhibit conditions / inhibit limit conditions for inhibit source DFC_EGSDUS2B1RtlPT1" VAL_BLK 0x804F5322 ValA_Wu8 17.0000000000 DINH_LimDFCVerb 0.00 17.0000000000 FORMAT "%13.10" NUMBER 58 /end CHARACTERISTIC
/begin CHARACTERISTIC DINH_Lim.DFC_EGSDUS2B1TarLean_CA "inhibit conditions / inhibit limit conditions for inhibit source DFC_EGSDUS2B1TarLean" VAL_BLK 0x804F535C ValA_Wu8 17.0000000000 DINH_LimDFCVerb 0.00 17.0000000000 FORMAT "%13.10" NUMBER 66 /end CHARACTERISTIC
/begin CHARACTERISTIC DINH_Lim.DFC_EGSDUS2B1TarRich_CA "inhibit conditions / inhibit limit conditions for inhibit source DFC_EGSDUS2B1TarRich" VAL_BLK 0x804F539E ValA_Wu8 17.0000000000 DINH_LimDFCVerb 0.00 17.0000000000 FORMAT "%13.10" NUMBER 66 /end CHARACTERISTIC
/begin CHARACTERISTIC DINH_Lim.DFC_ETAKHLmax_CA "inhibit conditions / inhibit limit conditions for inhibit source DFC_ETAKHLmax" VAL_BLK 0x804F53E0 ValA_Wu8 17.0000000000 DINH_LimDFCVerb 0.00 17.0000000000 FORMAT "%13.10" NUMBER 50 /end CHARACTERISTIC
/begin CHARACTERISTIC DINH_Lim.DFC_ETAKHTmax_CA "inhibit conditions / inhibit limit conditions for inhibit source DFC_ETAKHTmax" VAL_BLK 0x804F5412 ValA_Wu8 17.0000000000 DINH_LimDFCVerb 0.00 17.0000000000 FORMAT "%13.10" NUMBER 50 /end CHARACTERISTIC
/begin CHARACTERISTIC DINH_Lim.DFC_EngICO_CA "inhibit conditions / inhibit limit conditions for inhibit source DFC_EngICO" VAL_BLK 0x804F5444 ValA_Wu8 17.0000000000 DINH_LimDFCVerb 0.00 17.0000000000 FORMAT "%13.10" NUMBER 50 /end CHARACTERISTIC
/begin CHARACTERISTIC DINH_Lim.DFC_EngPrtOvrSpdMon_CA "inhibit conditions / inhibit limit conditions for inhibit source DFC_EngPrtOvrSpdMon" VAL_BLK 0x804F5476 ValA_Wu8 17.0000000000 DINH_LimDFCVerb 0.00 17.0000000000 FORMAT "%13.10" NUMBER 50 /end CHARACTERISTIC
/begin CHARACTERISTIC DINH_Lim.DFC_EpmCaSI1ErrSig_CA "inhibit conditions / inhibit limit conditions for inhibit source DFC_EpmCaSI1ErrSig" VAL_BLK 0x804F54A8 ValA_Wu8 17.0000000000 DINH_LimDFCVerb 0.00 17.0000000000 FORMAT "%13.10" NUMBER 66 /end CHARACTERISTIC
/begin CHARACTERISTIC DINH_Lim.DFC_EpmCaSI1NoSig_CA "inhibit conditions / inhibit limit conditions for inhibit source DFC_EpmCaSI1NoSig" VAL_BLK 0x804F54EA ValA_Wu8 17.0000000000 DINH_LimDFCVerb 0.00 17.0000000000 FORMAT "%13.10" NUMBER 57 /end CHARACTERISTIC
/begin CHARACTERISTIC DINH_Lim.DFC_EpmCaSI1OfsErr_CA "inhibit conditions / inhibit limit conditions for inhibit source DFC_EpmCaSI1OfsErr" VAL_BLK 0x804F5523 ValA_Wu8 17.0000000000 DINH_LimDFCVerb 0.00 17.0000000000 FORMAT "%13.10" NUMBER 72 /end CHARACTERISTIC
/begin CHARACTERISTIC DINH_Lim.DFC_EpmCrSErrSig_CA "inhibit conditions / inhibit limit conditions for inhibit source DFC_EpmCrSErrSig" VAL_BLK 0x804F556B ValA_Wu8 17.0000000000 DINH_LimDFCVerb 0.00 17.0000000000 FORMAT "%13.10" NUMBER 83 /end CHARACTERISTIC
/begin CHARACTERISTIC DINH_Lim.DFC_EpmCrSNoSig_CA "inhibit conditions / inhibit limit conditions for inhibit source DFC_EpmCrSNoSig" VAL_BLK 0x804F55BE ValA_Wu8 17.0000000000 DINH_LimDFCVerb 0.00 17.0000000000 FORMAT "%13.10" NUMBER 88 /end CHARACTERISTIC
/begin CHARACTERISTIC DINH_Lim.DFC_EtaEngIdleNonCsers_CA "inhibit conditions / inhibit limit conditions for inhibit source DFC_EtaEngIdleNonCsers" VAL_BLK 0x804F5616 ValA_Wu8 17.0000000000 DINH_LimDFCVerb 0.00 17.0000000000 FORMAT "%13.10" NUMBER 50 /end CHARACTERISTIC
/begin CHARACTERISTIC DINH_Lim.DFC_EtaEngPtlNonCsers_CA "inhibit conditions / inhibit limit conditions for inhibit source DFC_EtaEngPtlNonCsers" VAL_BLK 0x804F5648 ValA_Wu8 17.0000000000 DINH_LimDFCVerb 0.00 17.0000000000 FORMAT "%13.10" NUMBER 50 /end CHARACTERISTIC
/begin CHARACTERISTIC DINH_Lim.DFC_FRAmax_CA "inhibit conditions / inhibit limit conditions for inhibit source DFC_FRAmax" VAL_BLK 0x804F567A ValA_Wu8 17.0000000000 DINH_LimDFCVerb 0.00 17.0000000000 FORMAT "%13.10" NUMBER 69 /end CHARACTERISTIC
/begin CHARACTERISTIC DINH_Lim.DFC_FRAmin_CA "inhibit conditions / inhibit limit conditions for inhibit source DFC_FRAmin" VAL_BLK 0x804F56BF ValA_Wu8 17.0000000000 DINH_LimDFCVerb 0.00 17.0000000000 FORMAT "%13.10" NUMBER 69 /end CHARACTERISTIC
/begin CHARACTERISTIC DINH_Lim.DFC_GbxRvsSwtStk_CA "inhibit conditions / inhibit limit conditions for inhibit source DFC_GbxRvsSwtStk" VAL_BLK 0x804F5704 ValA_Wu8 17.0000000000 DINH_LimDFCVerb 0.00 17.0000000000 FORMAT "%13.10" NUMBER 54 /end CHARACTERISTIC
/begin CHARACTERISTIC DINH_Lim.DFC_HDRmax_CA "inhibit conditions / inhibit limit conditions for inhibit source DFC_HDRmax" VAL_BLK 0x804F573A ValA_Wu8 17.0000000000 DINH_LimDFCVerb 0.00 17.0000000000 FORMAT "%13.10" NUMBER 59 /end CHARACTERISTIC
/begin CHARACTERISTIC DINH_Lim.DFC_HEGOS2B1ElecMax_CA "inhibit conditions / inhibit limit conditions for inhibit source DFC_HEGOS2B1ElecMax" VAL_BLK 0x804F5775 ValA_Wu8 17.0000000000 DINH_LimDFCVerb 0.00 17.0000000000 FORMAT "%13.10" NUMBER 66 /end CHARACTERISTIC
/begin CHARACTERISTIC DINH_Lim.DFC_HEGOS2B1ElecMin_CA "inhibit conditions / inhibit limit conditions for inhibit source DFC_HEGOS2B1ElecMin" VAL_BLK 0x804F57B7 ValA_Wu8 17.0000000000 DINH_LimDFCVerb 0.00 17.0000000000 FORMAT "%13.10" NUMBER 66 /end CHARACTERISTIC
/begin CHARACTERISTIC DINH_Lim.DFC_HEGOS2B1ElecSig_CA "inhibit conditions / inhibit limit conditions for inhibit source DFC_HEGOS2B1ElecSig" VAL_BLK 0x804F57F9 ValA_Wu8 17.0000000000 DINH_LimDFCVerb 0.00 17.0000000000 FORMAT "%13.10" NUMBER 66 /end CHARACTERISTIC
/begin CHARACTERISTIC DINH_Lim.DFC_HEGOS2B1HtgNpl_CA "inhibit conditions / inhibit limit conditions for inhibit source DFC_HEGOS2B1HtgNpl" VAL_BLK 0x804F583B ValA_Wu8 17.0000000000 DINH_LimDFCVerb 0.00 17.0000000000 FORMAT "%13.10" NUMBER 64 /end CHARACTERISTIC
/begin CHARACTERISTIC DINH_Lim.DFC_IntkAirTIntkMnfldCrssMax_CA "inhibit conditions / inhibit limit conditions for inhibit source DFC_IntkAirTIntkMnfldCrssMax" VAL_BLK 0x804F587B ValA_Wu8 17.0000000000 DINH_LimDFCVerb 0.00 17.0000000000 FORMAT "%13.10" NUMBER 72 /end CHARACTERISTIC
/begin CHARACTERISTIC DINH_Lim.DFC_IntkAirTIntkMnfldCrssMin_CA "inhibit conditions / inhibit limit conditions for inhibit source DFC_IntkAirTIntkMnfldCrssMin" VAL_BLK 0x804F58C3 ValA_Wu8 17.0000000000 DINH_LimDFCVerb 0.00 17.0000000000 FORMAT "%13.10" NUMBER 72 /end CHARACTERISTIC
/begin CHARACTERISTIC DINH_Lim.DFC_IntkAirTIntkMnfldHSCMax_CA "inhibit conditions / inhibit limit conditions for inhibit source DFC_IntkAirTIntkMnfldHSCMax" VAL_BLK 0x804F590B ValA_Wu8 17.0000000000 DINH_LimDFCVerb 0.00 17.0000000000 FORMAT "%13.10" NUMBER 69 /end CHARACTERISTIC
/begin CHARACTERISTIC DINH_Lim.DFC_IntkAirTIntkMnfldImps_CA "inhibit conditions / inhibit limit conditions for inhibit source DFC_IntkAirTIntkMnfldImps" VAL_BLK 0x804F5950 ValA_Wu8 17.0000000000 DINH_LimDFCVerb 0.00 17.0000000000 FORMAT "%13.10" NUMBER 78 /end CHARACTERISTIC
/begin CHARACTERISTIC DINH_Lim.DFC_IntkAirTIntkMnfldPRCMax_CA "inhibit conditions / inhibit limit conditions for inhibit source DFC_IntkAirTIntkMnfldPRCMax" VAL_BLK 0x804F599E ValA_Wu8 17.0000000000 DINH_LimDFCVerb 0.00 17.0000000000 FORMAT "%13.10" NUMBER 69 /end CHARACTERISTIC
/begin CHARACTERISTIC DINH_Lim.DFC_IntkAirTIntkMnfldPRCMin_CA "inhibit conditions / inhibit limit conditions for inhibit source DFC_IntkAirTIntkMnfldPRCMin" VAL_BLK 0x804F59E3 ValA_Wu8 17.0000000000 DINH_LimDFCVerb 0.00 17.0000000000 FORMAT "%13.10" NUMBER 68 /end CHARACTERISTIC
/begin CHARACTERISTIC DINH_Lim.DFC_IntkAirTIntkMnfldSRCMax_CA "inhibit conditions / inhibit limit conditions for inhibit source DFC_IntkAirTIntkMnfldSRCMax" VAL_BLK 0x804F5A27 ValA_Wu8 17.0000000000 DINH_LimDFCVerb 0.00 17.0000000000 FORMAT "%13.10" NUMBER 79 /end CHARACTERISTIC
/begin CHARACTERISTIC DINH_Lim.DFC_IntkAirTIntkMnfldSRCMin_CA "inhibit conditions / inhibit limit conditions for inhibit source DFC_IntkAirTIntkMnfldSRCMin" VAL_BLK 0x804F5A76 ValA_Wu8 17.0000000000 DINH_LimDFCVerb 0.00 17.0000000000 FORMAT "%13.10" NUMBER 79 /end CHARACTERISTIC
/begin CHARACTERISTIC DINH_Lim.DFC_IntkAirTIntkMnfldSTC_CA "inhibit conditions / inhibit limit conditions for inhibit source DFC_IntkAirTIntkMnfldSTC" VAL_BLK 0x804F5AC5 ValA_Wu8 17.0000000000 DINH_LimDFCVerb 0.00 17.0000000000 FORMAT "%13.10" NUMBER 69 /end CHARACTERISTIC
/begin CHARACTERISTIC DINH_Lim.DFC_KS1max_CA "inhibit conditions / inhibit limit conditions for inhibit source DFC_KS1max" VAL_BLK 0x804F5B0A ValA_Wu8 17.0000000000 DINH_LimDFCVerb 0.00 17.0000000000 FORMAT "%13.10" NUMBER 55 /end CHARACTERISTIC
/begin CHARACTERISTIC DINH_Lim.DFC_KS1min_CA "inhibit conditions / inhibit limit conditions for inhibit source DFC_KS1min" VAL_BLK 0x804F5B41 ValA_Wu8 17.0000000000 DINH_LimDFCVerb 0.00 17.0000000000 FORMAT "%13.10" NUMBER 55 /end CHARACTERISTIC
/begin CHARACTERISTIC DINH_Lim.DFC_LMmax_CA "inhibit conditions / inhibit limit conditions for inhibit source DFC_LMmax" VAL_BLK 0x804F5B78 ValA_Wu8 17.0000000000 DINH_LimDFCVerb 0.00 17.0000000000 FORMAT "%13.10" NUMBER 58 /end CHARACTERISTIC
/begin CHARACTERISTIC DINH_Lim.DFC_LZSRnpl_CA "inhibit conditions / inhibit limit conditions for inhibit source DFC_LZSRnpl" VAL_BLK 0x804F5BB2 ValA_Wu8 17.0000000000 DINH_LimDFCVerb 0.00 17.0000000000 FORMAT "%13.10" NUMBER 54 /end CHARACTERISTIC
/begin CHARACTERISTIC DINH_Lim.DFC_LamDynDiagS1B1_CA "inhibit conditions / inhibit limit conditions for inhibit source DFC_LamDynDiagS1B1" VAL_BLK 0x804F5BE8 ValA_Wu8 17.0000000000 DINH_LimDFCVerb 0.00 17.0000000000 FORMAT "%13.10" NUMBER 70 /end CHARACTERISTIC
/begin CHARACTERISTIC DINH_Lim.DFC_LeakIntkMnfldEmiInfl_CA "inhibit conditions / inhibit limit conditions for inhibit source DFC_LeakIntkMnfldEmiInfl" VAL_BLK 0x804F5C2E ValA_Wu8 17.0000000000 DINH_LimDFCVerb 0.00 17.0000000000 FORMAT "%13.10" NUMBER 51 /end CHARACTERISTIC
/begin CHARACTERISTIC DINH_Lim.DFC_MD00max_CA "inhibit conditions / inhibit limit conditions for inhibit source DFC_MD00max" VAL_BLK 0x804F5C61 ValA_Wu8 17.0000000000 DINH_LimDFCVerb 0.00 17.0000000000 FORMAT "%13.10" NUMBER 50 /end CHARACTERISTIC
/begin CHARACTERISTIC DINH_Lim.DFC_MDBmax_CA "inhibit conditions / inhibit limit conditions for inhibit source DFC_MDBmax" VAL_BLK 0x804F5C93 ValA_Wu8 17.0000000000 DINH_LimDFCVerb 0.00 17.0000000000 FORMAT "%13.10" NUMBER 57 /end CHARACTERISTIC
/begin CHARACTERISTIC DINH_Lim.DFC_MDCat_CA "inhibit conditions / inhibit limit conditions for inhibit source DFC_MDCat" VAL_BLK 0x804F5CCC ValA_Wu8 17.0000000000 DINH_LimDFCVerb 0.00 17.0000000000 FORMAT "%13.10" NUMBER 50 /end CHARACTERISTIC
/begin CHARACTERISTIC DINH_Lim.DFC_MDCatCrit_CA "inhibit conditions / inhibit limit conditions for inhibit source DFC_MDCatCrit" VAL_BLK 0x804F5CFE ValA_Wu8 17.0000000000 DINH_LimDFCVerb 0.00 17.0000000000 FORMAT "%13.10" NUMBER 50 /end CHARACTERISTIC
/begin CHARACTERISTIC DINH_Lim.DFC_MDCatCurr_CA "inhibit conditions / inhibit limit conditions for inhibit source DFC_MDCatCurr" VAL_BLK 0x804F5D30 ValA_Wu8 17.0000000000 DINH_LimDFCVerb 0.00 17.0000000000 FORMAT "%13.10" NUMBER 53 /end CHARACTERISTIC
/begin CHARACTERISTIC DINH_Lim.DFC_MDCyl_0_CA "inhibit conditions / inhibit limit conditions for inhibit source DFC_MDCyl_0" VAL_BLK 0x804F5D65 ValA_Wu8 17.0000000000 DINH_LimDFCVerb 0.00 17.0000000000 FORMAT "%13.10" NUMBER 76 /end CHARACTERISTIC
/begin CHARACTERISTIC DINH_Lim.DFC_MDCyl_1_CA "inhibit conditions / inhibit limit conditions for inhibit source DFC_MDCyl_1" VAL_BLK 0x804F5DB1 ValA_Wu8 17.0000000000 DINH_LimDFCVerb 0.00 17.0000000000 FORMAT "%13.10" NUMBER 76 /end CHARACTERISTIC
/begin CHARACTERISTIC DINH_Lim.DFC_MDCyl_2_CA "inhibit conditions / inhibit limit conditions for inhibit source DFC_MDCyl_2" VAL_BLK 0x804F5DFD ValA_Wu8 17.0000000000 DINH_LimDFCVerb 0.00 17.0000000000 FORMAT "%13.10" NUMBER 76 /end CHARACTERISTIC
/begin CHARACTERISTIC DINH_Lim.DFC_MDCyl_3_CA "inhibit conditions / inhibit limit conditions for inhibit source DFC_MDCyl_3" VAL_BLK 0x804F5E49 ValA_Wu8 17.0000000000 DINH_LimDFCVerb 0.00 17.0000000000 FORMAT "%13.10" NUMBER 76 /end CHARACTERISTIC
/begin CHARACTERISTIC DINH_Lim.DFC_MDEmi_CA "inhibit conditions / inhibit limit conditions for inhibit source DFC_MDEmi" VAL_BLK 0x804F5E95 ValA_Wu8 17.0000000000 DINH_LimDFCVerb 0.00 17.0000000000 FORMAT "%13.10" NUMBER 50 /end CHARACTERISTIC
/begin CHARACTERISTIC DINH_Lim.DFC_MDEmiStrt_CA "inhibit conditions / inhibit limit conditions for inhibit source DFC_MDEmiStrt" VAL_BLK 0x804F5EC7 ValA_Wu8 17.0000000000 DINH_LimDFCVerb 0.00 17.0000000000 FORMAT "%13.10" NUMBER 50 /end CHARACTERISTIC
/begin CHARACTERISTIC DINH_Lim.DFC_MDFco_CA "inhibit conditions / inhibit limit conditions for inhibit source DFC_MDFco" VAL_BLK 0x804F5EF9 ValA_Wu8 17.0000000000 DINH_LimDFCVerb 0.00 17.0000000000 FORMAT "%13.10" NUMBER 54 /end CHARACTERISTIC
/begin CHARACTERISTIC DINH_Lim.DFC_MDMpl_CA "inhibit conditions / inhibit limit conditions for inhibit source DFC_MDMpl" VAL_BLK 0x804F5F2F ValA_Wu8 17.0000000000 DINH_LimDFCVerb 0.00 17.0000000000 FORMAT "%13.10" NUMBER 76 /end CHARACTERISTIC
/begin CHARACTERISTIC DINH_Lim.DFC_MDSegTiAdpn_CA "inhibit conditions / inhibit limit conditions for inhibit source DFC_MDSegTiAdpn" VAL_BLK 0x804F5F7B ValA_Wu8 17.0000000000 DINH_LimDFCVerb 0.00 17.0000000000 FORMAT "%13.10" NUMBER 50 /end CHARACTERISTIC
/begin CHARACTERISTIC DINH_Lim.DFC_MDmax_CA "inhibit conditions / inhibit limit conditions for inhibit source DFC_MDmax" VAL_BLK 0x804F5FAD ValA_Wu8 17.0000000000 DINH_LimDFCVerb 0.00 17.0000000000 FORMAT "%13.10" NUMBER 50 /end CHARACTERISTIC
/begin CHARACTERISTIC DINH_Lim.DFC_MOXEMM_SMU_ALM0_0_CA "inhibit conditions / inhibit limit conditions for inhibit source DFC_MOXEMM_SMU_ALM0_0" VAL_BLK 0x804F5FDF ValA_Wu8 17.0000000000 DINH_LimDFCVerb 0.00 17.0000000000 FORMAT "%13.10" NUMBER 50 /end CHARACTERISTIC
/begin CHARACTERISTIC DINH_Lim.DFC_MOXEMM_SMU_ALM0_1_CA "inhibit conditions / inhibit limit conditions for inhibit source DFC_MOXEMM_SMU_ALM0_1" VAL_BLK 0x804F6011 ValA_Wu8 17.0000000000 DINH_LimDFCVerb 0.00 17.0000000000 FORMAT "%13.10" NUMBER 50 /end CHARACTERISTIC
/begin CHARACTERISTIC DINH_Lim.DFC_MOXEMM_SMU_ALM0_10_CA "inhibit conditions / inhibit limit conditions for inhibit source DFC_MOXEMM_SMU_ALM0_10" VAL_BLK 0x804F6043 ValA_Wu8 17.0000000000 DINH_LimDFCVerb 0.00 17.0000000000 FORMAT "%13.10" NUMBER 50 /end CHARACTERISTIC
/begin CHARACTERISTIC DINH_Lim.DFC_MOXEMM_SMU_ALM0_11_CA "inhibit conditions / inhibit limit conditions for inhibit source DFC_MOXEMM_SMU_ALM0_11" VAL_BLK 0x804F6075 ValA_Wu8 17.0000000000 DINH_LimDFCVerb 0.00 17.0000000000 FORMAT "%13.10" NUMBER 50 /end CHARACTERISTIC
/begin CHARACTERISTIC DINH_Lim.DFC_MOXEMM_SMU_ALM0_13_CA "inhibit conditions / inhibit limit conditions for inhibit source DFC_MOXEMM_SMU_ALM0_13" VAL_BLK 0x804F60A7 ValA_Wu8 17.0000000000 DINH_LimDFCVerb 0.00 17.0000000000 FORMAT "%13.10" NUMBER 50 /end CHARACTERISTIC
/begin CHARACTERISTIC DINH_Lim.DFC_MOXEMM_SMU_ALM0_14_CA "inhibit conditions / inhibit limit conditions for inhibit source DFC_MOXEMM_SMU_ALM0_14" VAL_BLK 0x804F60D9 ValA_Wu8 17.0000000000 DINH_LimDFCVerb 0.00 17.0000000000 FORMAT "%13.10" NUMBER 50 /end CHARACTERISTIC
/begin CHARACTERISTIC DINH_Lim.DFC_MOXEMM_SMU_ALM0_2_CA "inhibit conditions / inhibit limit conditions for inhibit source DFC_MOXEMM_SMU_ALM0_2" VAL_BLK 0x804F610B ValA_Wu8 17.0000000000 DINH_LimDFCVerb 0.00 17.0000000000 FORMAT "%13.10" NUMBER 50 /end CHARACTERISTIC
/begin CHARACTERISTIC DINH_Lim.DFC_MOXEMM_SMU_ALM0_22_CA "inhibit conditions / inhibit limit conditions for inhibit source DFC_MOXEMM_SMU_ALM0_22" VAL_BLK 0x804F613D ValA_Wu8 17.0000000000 DINH_LimDFCVerb 0.00 17.0000000000 FORMAT "%13.10" NUMBER 50 /end CHARACTERISTIC
/begin CHARACTERISTIC DINH_Lim.DFC_MOXEMM_SMU_ALM0_23_CA "inhibit conditions / inhibit limit conditions for inhibit source DFC_MOXEMM_SMU_ALM0_23" VAL_BLK 0x804F616F ValA_Wu8 17.0000000000 DINH_LimDFCVerb 0.00 17.0000000000 FORMAT "%13.10" NUMBER 50 /end CHARACTERISTIC
/begin CHARACTERISTIC DINH_Lim.DFC_MOXEMM_SMU_ALM0_4_CA "inhibit conditions / inhibit limit conditions for inhibit source DFC_MOXEMM_SMU_ALM0_4" VAL_BLK 0x804F61A1 ValA_Wu8 17.0000000000 DINH_LimDFCVerb 0.00 17.0000000000 FORMAT "%13.10" NUMBER 50 /end CHARACTERISTIC
/begin CHARACTERISTIC DINH_Lim.DFC_MOXEMM_SMU_ALM0_5_CA "inhibit conditions / inhibit limit conditions for inhibit source DFC_MOXEMM_SMU_ALM0_5" VAL_BLK 0x804F61D3 ValA_Wu8 17.0000000000 DINH_LimDFCVerb 0.00 17.0000000000 FORMAT "%13.10" NUMBER 50 /end CHARACTERISTIC
/begin CHARACTERISTIC DINH_Lim.DFC_MOXEMM_SMU_ALM0_7_CA "inhibit conditions / inhibit limit conditions for inhibit source DFC_MOXEMM_SMU_ALM0_7" VAL_BLK 0x804F6205 ValA_Wu8 17.0000000000 DINH_LimDFCVerb 0.00 17.0000000000 FORMAT "%13.10" NUMBER 50 /end CHARACTERISTIC
/begin CHARACTERISTIC DINH_Lim.DFC_MOXEMM_SMU_ALM0_8_CA "inhibit conditions / inhibit limit conditions for inhibit source DFC_MOXEMM_SMU_ALM0_8" VAL_BLK 0x804F6237 ValA_Wu8 17.0000000000 DINH_LimDFCVerb 0.00 17.0000000000 FORMAT "%13.10" NUMBER 50 /end CHARACTERISTIC
/begin CHARACTERISTIC DINH_Lim.DFC_MOXEMM_SMU_ALM10_16_CA "inhibit conditions / inhibit limit conditions for inhibit source DFC_MOXEMM_SMU_ALM10_16" VAL_BLK 0x804F6269 ValA_Wu8 17.0000000000 DINH_LimDFCVerb 0.00 17.0000000000 FORMAT "%13.10" NUMBER 50 /end CHARACTERISTIC
/begin CHARACTERISTIC DINH_Lim.DFC_MOXEMM_SMU_ALM10_17_CA "inhibit conditions / inhibit limit conditions for inhibit source DFC_MOXEMM_SMU_ALM10_17" VAL_BLK 0x804F629B ValA_Wu8 17.0000000000 DINH_LimDFCVerb 0.00 17.0000000000 FORMAT "%13.10" NUMBER 50 /end CHARACTERISTIC
/begin CHARACTERISTIC DINH_Lim.DFC_MOXEMM_SMU_ALM10_21_CA "inhibit conditions / inhibit limit conditions for inhibit source DFC_MOXEMM_SMU_ALM10_21" VAL_BLK 0x804F62CD ValA_Wu8 17.0000000000 DINH_LimDFCVerb 0.00 17.0000000000 FORMAT "%13.10" NUMBER 50 /end CHARACTERISTIC
/begin CHARACTERISTIC DINH_Lim.DFC_MOXEMM_SMU_ALM11_0_CA "inhibit conditions / inhibit limit conditions for inhibit source DFC_MOXEMM_SMU_ALM11_0" VAL_BLK 0x804F62FF ValA_Wu8 17.0000000000 DINH_LimDFCVerb 0.00 17.0000000000 FORMAT "%13.10" NUMBER 50 /end CHARACTERISTIC
/begin CHARACTERISTIC DINH_Lim.DFC_MOXEMM_SMU_ALM11_1_CA "inhibit conditions / inhibit limit conditions for inhibit source DFC_MOXEMM_SMU_ALM11_1" VAL_BLK 0x804F6331 ValA_Wu8 17.0000000000 DINH_LimDFCVerb 0.00 17.0000000000 FORMAT "%13.10" NUMBER 50 /end CHARACTERISTIC
/begin CHARACTERISTIC DINH_Lim.DFC_MOXEMM_SMU_ALM11_2_CA "inhibit conditions / inhibit limit conditions for inhibit source DFC_MOXEMM_SMU_ALM11_2" VAL_BLK 0x804F6363 ValA_Wu8 17.0000000000 DINH_LimDFCVerb 0.00 17.0000000000 FORMAT "%13.10" NUMBER 50 /end CHARACTERISTIC
/begin CHARACTERISTIC DINH_Lim.DFC_MOXEMM_SMU_ALM11_3_CA "inhibit conditions / inhibit limit conditions for inhibit source DFC_MOXEMM_SMU_ALM11_3" VAL_BLK 0x804F6395 ValA_Wu8 17.0000000000 DINH_LimDFCVerb 0.00 17.0000000000 FORMAT "%13.10" NUMBER 50 /end CHARACTERISTIC
/begin CHARACTERISTIC DINH_Lim.DFC_MOXEMM_SMU_ALM11_4_CA "inhibit conditions / inhibit limit conditions for inhibit source DFC_MOXEMM_SMU_ALM11_4" VAL_BLK 0x804F63C7 ValA_Wu8 17.0000000000 DINH_LimDFCVerb 0.00 17.0000000000 FORMAT "%13.10" NUMBER 50 /end CHARACTERISTIC
/begin CHARACTERISTIC DINH_Lim.DFC_MOXEMM_SMU_ALM11_5_CA "inhibit conditions / inhibit limit conditions for inhibit source DFC_MOXEMM_SMU_ALM11_5" VAL_BLK 0x804F63F9 ValA_Wu8 17.0000000000 DINH_LimDFCVerb 0.00 17.0000000000 FORMAT "%13.10" NUMBER 50 /end CHARACTERISTIC
/begin CHARACTERISTIC DINH_Lim.DFC_MOXEMM_SMU_ALM11_8_CA "inhibit conditions / inhibit limit conditions for inhibit source DFC_MOXEMM_SMU_ALM11_8" VAL_BLK 0x804F642B ValA_Wu8 17.0000000000 DINH_LimDFCVerb 0.00 17.0000000000 FORMAT "%13.10" NUMBER 50 /end CHARACTERISTIC
/begin CHARACTERISTIC DINH_Lim.DFC_MOXEMM_SMU_ALM11_9_CA "inhibit conditions / inhibit limit conditions for inhibit source DFC_MOXEMM_SMU_ALM11_9" VAL_BLK 0x804F645D ValA_Wu8 17.0000000000 DINH_LimDFCVerb 0.00 17.0000000000 FORMAT "%13.10" NUMBER 50 /end CHARACTERISTIC
/begin CHARACTERISTIC DINH_Lim.DFC_MOXEMM_SMU_ALM1_0_CA "inhibit conditions / inhibit limit conditions for inhibit source DFC_MOXEMM_SMU_ALM1_0" VAL_BLK 0x804F648F ValA_Wu8 17.0000000000 DINH_LimDFCVerb 0.00 17.0000000000 FORMAT "%13.10" NUMBER 50 /end CHARACTERISTIC
/begin CHARACTERISTIC DINH_Lim.DFC_MOXEMM_SMU_ALM1_1_CA "inhibit conditions / inhibit limit conditions for inhibit source DFC_MOXEMM_SMU_ALM1_1" VAL_BLK 0x804F64C1 ValA_Wu8 17.0000000000 DINH_LimDFCVerb 0.00 17.0000000000 FORMAT "%13.10" NUMBER 50 /end CHARACTERISTIC
/begin CHARACTERISTIC DINH_Lim.DFC_MOXEMM_SMU_ALM1_10_CA "inhibit conditions / inhibit limit conditions for inhibit source DFC_MOXEMM_SMU_ALM1_10" VAL_BLK 0x804F64F3 ValA_Wu8 17.0000000000 DINH_LimDFCVerb 0.00 17.0000000000 FORMAT "%13.10" NUMBER 50 /end CHARACTERISTIC
/begin CHARACTERISTIC DINH_Lim.DFC_MOXEMM_SMU_ALM1_11_CA "inhibit conditions / inhibit limit conditions for inhibit source DFC_MOXEMM_SMU_ALM1_11" VAL_BLK 0x804F6525 ValA_Wu8 17.0000000000 DINH_LimDFCVerb 0.00 17.0000000000 FORMAT "%13.10" NUMBER 50 /end CHARACTERISTIC
/begin CHARACTERISTIC DINH_Lim.DFC_MOXEMM_SMU_ALM1_13_CA "inhibit conditions / inhibit limit conditions for inhibit source DFC_MOXEMM_SMU_ALM1_13" VAL_BLK 0x804F6557 ValA_Wu8 17.0000000000 DINH_LimDFCVerb 0.00 17.0000000000 FORMAT "%13.10" NUMBER 50 /end CHARACTERISTIC
/begin CHARACTERISTIC DINH_Lim.DFC_MOXEMM_SMU_ALM1_14_CA "inhibit conditions / inhibit limit conditions for inhibit source DFC_MOXEMM_SMU_ALM1_14" VAL_BLK 0x804F6589 ValA_Wu8 17.0000000000 DINH_LimDFCVerb 0.00 17.0000000000 FORMAT "%13.10" NUMBER 50 /end CHARACTERISTIC
/begin CHARACTERISTIC DINH_Lim.DFC_MOXEMM_SMU_ALM1_2_CA "inhibit conditions / inhibit limit conditions for inhibit source DFC_MOXEMM_SMU_ALM1_2" VAL_BLK 0x804F65BB ValA_Wu8 17.0000000000 DINH_LimDFCVerb 0.00 17.0000000000 FORMAT "%13.10" NUMBER 50 /end CHARACTERISTIC
/begin CHARACTERISTIC DINH_Lim.DFC_MOXEMM_SMU_ALM1_22_CA "inhibit conditions / inhibit limit conditions for inhibit source DFC_MOXEMM_SMU_ALM1_22" VAL_BLK 0x804F65ED ValA_Wu8 17.0000000000 DINH_LimDFCVerb 0.00 17.0000000000 FORMAT "%13.10" NUMBER 50 /end CHARACTERISTIC
/begin CHARACTERISTIC DINH_Lim.DFC_MOXEMM_SMU_ALM1_23_CA "inhibit conditions / inhibit limit conditions for inhibit source DFC_MOXEMM_SMU_ALM1_23" VAL_BLK 0x804F661F ValA_Wu8 17.0000000000 DINH_LimDFCVerb 0.00 17.0000000000 FORMAT "%13.10" NUMBER 50 /end CHARACTERISTIC
/begin CHARACTERISTIC DINH_Lim.DFC_MOXEMM_SMU_ALM1_4_CA "inhibit conditions / inhibit limit conditions for inhibit source DFC_MOXEMM_SMU_ALM1_4" VAL_BLK 0x804F6651 ValA_Wu8 17.0000000000 DINH_LimDFCVerb 0.00 17.0000000000 FORMAT "%13.10" NUMBER 50 /end CHARACTERISTIC
/begin CHARACTERISTIC DINH_Lim.DFC_MOXEMM_SMU_ALM1_5_CA "inhibit conditions / inhibit limit conditions for inhibit source DFC_MOXEMM_SMU_ALM1_5" VAL_BLK 0x804F6683 ValA_Wu8 17.0000000000 DINH_LimDFCVerb 0.00 17.0000000000 FORMAT "%13.10" NUMBER 50 /end CHARACTERISTIC
/begin CHARACTERISTIC DINH_Lim.DFC_MOXEMM_SMU_ALM1_7_CA "inhibit conditions / inhibit limit conditions for inhibit source DFC_MOXEMM_SMU_ALM1_7" VAL_BLK 0x804F66B5 ValA_Wu8 17.0000000000 DINH_LimDFCVerb 0.00 17.0000000000 FORMAT "%13.10" NUMBER 50 /end CHARACTERISTIC
/begin CHARACTERISTIC DINH_Lim.DFC_MOXEMM_SMU_ALM1_8_CA "inhibit conditions / inhibit limit conditions for inhibit source DFC_MOXEMM_SMU_ALM1_8" VAL_BLK 0x804F66E7 ValA_Wu8 17.0000000000 DINH_LimDFCVerb 0.00 17.0000000000 FORMAT "%13.10" NUMBER 50 /end CHARACTERISTIC
/begin CHARACTERISTIC DINH_Lim.DFC_MOXEMM_SMU_ALM21_0_CA "inhibit conditions / inhibit limit conditions for inhibit source DFC_MOXEMM_SMU_ALM21_0" VAL_BLK 0x804F6719 ValA_Wu8 17.0000000000 DINH_LimDFCVerb 0.00 17.0000000000 FORMAT "%13.10" NUMBER 50 /end CHARACTERISTIC
/begin CHARACTERISTIC DINH_Lim.DFC_MOXEMM_SMU_ALM21_16_CA "inhibit conditions / inhibit limit conditions for inhibit source DFC_MOXEMM_SMU_ALM21_16" VAL_BLK 0x804F674B ValA_Wu8 17.0000000000 DINH_LimDFCVerb 0.00 17.0000000000 FORMAT "%13.10" NUMBER 50 /end CHARACTERISTIC
/begin CHARACTERISTIC DINH_Lim.DFC_MOXEMM_SMU_ALM21_3_CA "inhibit conditions / inhibit limit conditions for inhibit source DFC_MOXEMM_SMU_ALM21_3" VAL_BLK 0x804F677D ValA_Wu8 17.0000000000 DINH_LimDFCVerb 0.00 17.0000000000 FORMAT "%13.10" NUMBER 50 /end CHARACTERISTIC
/begin CHARACTERISTIC DINH_Lim.DFC_MOXEMM_SMU_ALM2_1_CA "inhibit conditions / inhibit limit conditions for inhibit source DFC_MOXEMM_SMU_ALM2_1" VAL_BLK 0x804F67AF ValA_Wu8 17.0000000000 DINH_LimDFCVerb 0.00 17.0000000000 FORMAT "%13.10" NUMBER 50 /end CHARACTERISTIC
/begin CHARACTERISTIC DINH_Lim.DFC_MOXEMM_SMU_ALM2_10_CA "inhibit conditions / inhibit limit conditions for inhibit source DFC_MOXEMM_SMU_ALM2_10" VAL_BLK 0x804F67E1 ValA_Wu8 17.0000000000 DINH_LimDFCVerb 0.00 17.0000000000 FORMAT "%13.10" NUMBER 50 /end CHARACTERISTIC
/begin CHARACTERISTIC DINH_Lim.DFC_MOXEMM_SMU_ALM2_11_CA "inhibit conditions / inhibit limit conditions for inhibit source DFC_MOXEMM_SMU_ALM2_11" VAL_BLK 0x804F6813 ValA_Wu8 17.0000000000 DINH_LimDFCVerb 0.00 17.0000000000 FORMAT "%13.10" NUMBER 50 /end CHARACTERISTIC
/begin CHARACTERISTIC DINH_Lim.DFC_MOXEMM_SMU_ALM2_13_CA "inhibit conditions / inhibit limit conditions for inhibit source DFC_MOXEMM_SMU_ALM2_13" VAL_BLK 0x804F6845 ValA_Wu8 17.0000000000 DINH_LimDFCVerb 0.00 17.0000000000 FORMAT "%13.10" NUMBER 50 /end CHARACTERISTIC
/begin CHARACTERISTIC DINH_Lim.DFC_MOXEMM_SMU_ALM2_14_CA "inhibit conditions / inhibit limit conditions for inhibit source DFC_MOXEMM_SMU_ALM2_14" VAL_BLK 0x804F6877 ValA_Wu8 17.0000000000 DINH_LimDFCVerb 0.00 17.0000000000 FORMAT "%13.10" NUMBER 50 /end CHARACTERISTIC
/begin CHARACTERISTIC DINH_Lim.DFC_MOXEMM_SMU_ALM2_22_CA "inhibit conditions / inhibit limit conditions for inhibit source DFC_MOXEMM_SMU_ALM2_22" VAL_BLK 0x804F68A9 ValA_Wu8 17.0000000000 DINH_LimDFCVerb 0.00 17.0000000000 FORMAT "%13.10" NUMBER 50 /end CHARACTERISTIC
/begin CHARACTERISTIC DINH_Lim.DFC_MOXEMM_SMU_ALM2_23_CA "inhibit conditions / inhibit limit conditions for inhibit source DFC_MOXEMM_SMU_ALM2_23" VAL_BLK 0x804F68DB ValA_Wu8 17.0000000000 DINH_LimDFCVerb 0.00 17.0000000000 FORMAT "%13.10" NUMBER 50 /end CHARACTERISTIC
/begin CHARACTERISTIC DINH_Lim.DFC_MOXEMM_SMU_ALM2_4_CA "inhibit conditions / inhibit limit conditions for inhibit source DFC_MOXEMM_SMU_ALM2_4" VAL_BLK 0x804F690D ValA_Wu8 17.0000000000 DINH_LimDFCVerb 0.00 17.0000000000 FORMAT "%13.10" NUMBER 50 /end CHARACTERISTIC
/begin CHARACTERISTIC DINH_Lim.DFC_MOXEMM_SMU_ALM2_5_CA "inhibit conditions / inhibit limit conditions for inhibit source DFC_MOXEMM_SMU_ALM2_5" VAL_BLK 0x804F693F ValA_Wu8 17.0000000000 DINH_LimDFCVerb 0.00 17.0000000000 FORMAT "%13.10" NUMBER 50 /end CHARACTERISTIC
/begin CHARACTERISTIC DINH_Lim.DFC_MOXEMM_SMU_ALM2_7_CA "inhibit conditions / inhibit limit conditions for inhibit source DFC_MOXEMM_SMU_ALM2_7" VAL_BLK 0x804F6971 ValA_Wu8 17.0000000000 DINH_LimDFCVerb 0.00 17.0000000000 FORMAT "%13.10" NUMBER 50 /end CHARACTERISTIC
/begin CHARACTERISTIC DINH_Lim.DFC_MOXEMM_SMU_ALM2_8_CA "inhibit conditions / inhibit limit conditions for inhibit source DFC_MOXEMM_SMU_ALM2_8" VAL_BLK 0x804F69A3 ValA_Wu8 17.0000000000 DINH_LimDFCVerb 0.00 17.0000000000 FORMAT "%13.10" NUMBER 50 /end CHARACTERISTIC
/begin CHARACTERISTIC DINH_Lim.DFC_MOXEMM_SMU_ALM6_0_CA "inhibit conditions / inhibit limit conditions for inhibit source DFC_MOXEMM_SMU_ALM6_0" VAL_BLK 0x804F69D5 ValA_Wu8 17.0000000000 DINH_LimDFCVerb 0.00 17.0000000000 FORMAT "%13.10" NUMBER 50 /end CHARACTERISTIC
/begin CHARACTERISTIC DINH_Lim.DFC_MOXEMM_SMU_ALM6_11_CA "inhibit conditions / inhibit limit conditions for inhibit source DFC_MOXEMM_SMU_ALM6_11" VAL_BLK 0x804F6A07 ValA_Wu8 17.0000000000 DINH_LimDFCVerb 0.00 17.0000000000 FORMAT "%13.10" NUMBER 50 /end CHARACTERISTIC
/begin CHARACTERISTIC DINH_Lim.DFC_MOXEMM_SMU_ALM6_12_CA "inhibit conditions / inhibit limit conditions for inhibit source DFC_MOXEMM_SMU_ALM6_12" VAL_BLK 0x804F6A39 ValA_Wu8 17.0000000000 DINH_LimDFCVerb 0.00 17.0000000000 FORMAT "%13.10" NUMBER 50 /end CHARACTERISTIC
/begin CHARACTERISTIC DINH_Lim.DFC_MOXEMM_SMU_ALM6_14_CA "inhibit conditions / inhibit limit conditions for inhibit source DFC_MOXEMM_SMU_ALM6_14" VAL_BLK 0x804F6A6B ValA_Wu8 17.0000000000 DINH_LimDFCVerb 0.00 17.0000000000 FORMAT "%13.10" NUMBER 50 /end CHARACTERISTIC
/begin CHARACTERISTIC DINH_Lim.DFC_MOXEMM_SMU_ALM6_15_CA "inhibit conditions / inhibit limit conditions for inhibit source DFC_MOXEMM_SMU_ALM6_15" VAL_BLK 0x804F6A9D ValA_Wu8 17.0000000000 DINH_LimDFCVerb 0.00 17.0000000000 FORMAT "%13.10" NUMBER 50 /end CHARACTERISTIC
/begin CHARACTERISTIC DINH_Lim.DFC_MOXEMM_SMU_ALM6_17_CA "inhibit conditions / inhibit limit conditions for inhibit source DFC_MOXEMM_SMU_ALM6_17" VAL_BLK 0x804F6ACF ValA_Wu8 17.0000000000 DINH_LimDFCVerb 0.00 17.0000000000 FORMAT "%13.10" NUMBER 50 /end CHARACTERISTIC
/begin CHARACTERISTIC DINH_Lim.DFC_MOXEMM_SMU_ALM6_18_CA "inhibit conditions / inhibit limit conditions for inhibit source DFC_MOXEMM_SMU_ALM6_18" VAL_BLK 0x804F6B01 ValA_Wu8 17.0000000000 DINH_LimDFCVerb 0.00 17.0000000000 FORMAT "%13.10" NUMBER 50 /end CHARACTERISTIC
/begin CHARACTERISTIC DINH_Lim.DFC_MOXEMM_SMU_ALM6_20_CA "inhibit conditions / inhibit limit conditions for inhibit source DFC_MOXEMM_SMU_ALM6_20" VAL_BLK 0x804F6B33 ValA_Wu8 17.0000000000 DINH_LimDFCVerb 0.00 17.0000000000 FORMAT "%13.10" NUMBER 50 /end CHARACTERISTIC
/begin CHARACTERISTIC DINH_Lim.DFC_MOXEMM_SMU_ALM6_21_CA "inhibit conditions / inhibit limit conditions for inhibit source DFC_MOXEMM_SMU_ALM6_21" VAL_BLK 0x804F6B65 ValA_Wu8 17.0000000000 DINH_LimDFCVerb 0.00 17.0000000000 FORMAT "%13.10" NUMBER 50 /end CHARACTERISTIC
/begin CHARACTERISTIC DINH_Lim.DFC_MOXEMM_SMU_ALM6_25_CA "inhibit conditions / inhibit limit conditions for inhibit source DFC_MOXEMM_SMU_ALM6_25" VAL_BLK 0x804F6B97 ValA_Wu8 17.0000000000 DINH_LimDFCVerb 0.00 17.0000000000 FORMAT "%13.10" NUMBER 50 /end CHARACTERISTIC
/begin CHARACTERISTIC DINH_Lim.DFC_MOXEMM_SMU_ALM6_4_CA "inhibit conditions / inhibit limit conditions for inhibit source DFC_MOXEMM_SMU_ALM6_4" VAL_BLK 0x804F6BC9 ValA_Wu8 17.0000000000 DINH_LimDFCVerb 0.00 17.0000000000 FORMAT "%13.10" NUMBER 50 /end CHARACTERISTIC
/begin CHARACTERISTIC DINH_Lim.DFC_MOXEMM_SMU_ALM6_5_CA "inhibit conditions / inhibit limit conditions for inhibit source DFC_MOXEMM_SMU_ALM6_5" VAL_BLK 0x804F6BFB ValA_Wu8 17.0000000000 DINH_LimDFCVerb 0.00 17.0000000000 FORMAT "%13.10" NUMBER 50 /end CHARACTERISTIC
/begin CHARACTERISTIC DINH_Lim.DFC_MOXEMM_SMU_ALM6_7_CA "inhibit conditions / inhibit limit conditions for inhibit source DFC_MOXEMM_SMU_ALM6_7" VAL_BLK 0x804F6C2D ValA_Wu8 17.0000000000 DINH_LimDFCVerb 0.00 17.0000000000 FORMAT "%13.10" NUMBER 50 /end CHARACTERISTIC
/begin CHARACTERISTIC DINH_Lim.DFC_MOXEMM_SMU_ALM6_8_CA "inhibit conditions / inhibit limit conditions for inhibit source DFC_MOXEMM_SMU_ALM6_8" VAL_BLK 0x804F6C5F ValA_Wu8 17.0000000000 DINH_LimDFCVerb 0.00 17.0000000000 FORMAT "%13.10" NUMBER 50 /end CHARACTERISTIC
/begin CHARACTERISTIC DINH_Lim.DFC_MOXEMM_SMU_ALM7_1_CA "inhibit conditions / inhibit limit conditions for inhibit source DFC_MOXEMM_SMU_ALM7_1" VAL_BLK 0x804F6C91 ValA_Wu8 17.0000000000 DINH_LimDFCVerb 0.00 17.0000000000 FORMAT "%13.10" NUMBER 50 /end CHARACTERISTIC
/begin CHARACTERISTIC DINH_Lim.DFC_MOXEMM_SMU_ALM7_12_CA "inhibit conditions / inhibit limit conditions for inhibit source DFC_MOXEMM_SMU_ALM7_12" VAL_BLK 0x804F6CC3 ValA_Wu8 17.0000000000 DINH_LimDFCVerb 0.00 17.0000000000 FORMAT "%13.10" NUMBER 50 /end CHARACTERISTIC
/begin CHARACTERISTIC DINH_Lim.DFC_MOXEMM_SMU_ALM7_13_CA "inhibit conditions / inhibit limit conditions for inhibit source DFC_MOXEMM_SMU_ALM7_13" VAL_BLK 0x804F6CF5 ValA_Wu8 17.0000000000 DINH_LimDFCVerb 0.00 17.0000000000 FORMAT "%13.10" NUMBER 50 /end CHARACTERISTIC
/begin CHARACTERISTIC DINH_Lim.DFC_MOXEMM_SMU_ALM7_14_CA "inhibit conditions / inhibit limit conditions for inhibit source DFC_MOXEMM_SMU_ALM7_14" VAL_BLK 0x804F6D27 ValA_Wu8 17.0000000000 DINH_LimDFCVerb 0.00 17.0000000000 FORMAT "%13.10" NUMBER 50 /end CHARACTERISTIC
/begin CHARACTERISTIC DINH_Lim.DFC_MOXEMM_SMU_ALM7_15_CA "inhibit conditions / inhibit limit conditions for inhibit source DFC_MOXEMM_SMU_ALM7_15" VAL_BLK 0x804F6D59 ValA_Wu8 17.0000000000 DINH_LimDFCVerb 0.00 17.0000000000 FORMAT "%13.10" NUMBER 50 /end CHARACTERISTIC
/begin CHARACTERISTIC DINH_Lim.DFC_MOXEMM_SMU_ALM7_16_CA "inhibit conditions / inhibit limit conditions for inhibit source DFC_MOXEMM_SMU_ALM7_16" VAL_BLK 0x804F6D8B ValA_Wu8 17.0000000000 DINH_LimDFCVerb 0.00 17.0000000000 FORMAT "%13.10" NUMBER 50 /end CHARACTERISTIC
/begin CHARACTERISTIC DINH_Lim.DFC_MOXEMM_SMU_ALM7_17_CA "inhibit conditions / inhibit limit conditions for inhibit source DFC_MOXEMM_SMU_ALM7_17" VAL_BLK 0x804F6DBD ValA_Wu8 17.0000000000 DINH_LimDFCVerb 0.00 17.0000000000 FORMAT "%13.10" NUMBER 50 /end CHARACTERISTIC
/begin CHARACTERISTIC DINH_Lim.DFC_MOXEMM_SMU_ALM7_2_CA "inhibit conditions / inhibit limit conditions for inhibit source DFC_MOXEMM_SMU_ALM7_2" VAL_BLK 0x804F6DEF ValA_Wu8 17.0000000000 DINH_LimDFCVerb 0.00 17.0000000000 FORMAT "%13.10" NUMBER 50 /end CHARACTERISTIC
/begin CHARACTERISTIC DINH_Lim.DFC_MOXEMM_SMU_ALM7_20_CA "inhibit conditions / inhibit limit conditions for inhibit source DFC_MOXEMM_SMU_ALM7_20" VAL_BLK 0x804F6E21 ValA_Wu8 17.0000000000 DINH_LimDFCVerb 0.00 17.0000000000 FORMAT "%13.10" NUMBER 50 /end CHARACTERISTIC
/begin CHARACTERISTIC DINH_Lim.DFC_MOXEMM_SMU_ALM7_25_CA "inhibit conditions / inhibit limit conditions for inhibit source DFC_MOXEMM_SMU_ALM7_25" VAL_BLK 0x804F6E53 ValA_Wu8 17.0000000000 DINH_LimDFCVerb 0.00 17.0000000000 FORMAT "%13.10" NUMBER 50 /end CHARACTERISTIC
/begin CHARACTERISTIC DINH_Lim.DFC_MOXEMM_SMU_ALM7_26_CA "inhibit conditions / inhibit limit conditions for inhibit source DFC_MOXEMM_SMU_ALM7_26" VAL_BLK 0x804F6E85 ValA_Wu8 17.0000000000 DINH_LimDFCVerb 0.00 17.0000000000 FORMAT "%13.10" NUMBER 50 /end CHARACTERISTIC
/begin CHARACTERISTIC DINH_Lim.DFC_MOXEMM_SMU_ALM7_28_CA "inhibit conditions / inhibit limit conditions for inhibit source DFC_MOXEMM_SMU_ALM7_28" VAL_BLK 0x804F6EB7 ValA_Wu8 17.0000000000 DINH_LimDFCVerb 0.00 17.0000000000 FORMAT "%13.10" NUMBER 50 /end CHARACTERISTIC
/begin CHARACTERISTIC DINH_Lim.DFC_MOXEMM_SMU_ALM7_29_CA "inhibit conditions / inhibit limit conditions for inhibit source DFC_MOXEMM_SMU_ALM7_29" VAL_BLK 0x804F6EE9 ValA_Wu8 17.0000000000 DINH_LimDFCVerb 0.00 17.0000000000 FORMAT "%13.10" NUMBER 50 /end CHARACTERISTIC
/begin CHARACTERISTIC DINH_Lim.DFC_MOXEMM_SMU_ALM7_30_CA "inhibit conditions / inhibit limit conditions for inhibit source DFC_MOXEMM_SMU_ALM7_30" VAL_BLK 0x804F6F1B ValA_Wu8 17.0000000000 DINH_LimDFCVerb 0.00 17.0000000000 FORMAT "%13.10" NUMBER 50 /end CHARACTERISTIC
/begin CHARACTERISTIC DINH_Lim.DFC_MOXEMM_SMU_ALM7_31_CA "inhibit conditions / inhibit limit conditions for inhibit source DFC_MOXEMM_SMU_ALM7_31" VAL_BLK 0x804F6F4D ValA_Wu8 17.0000000000 DINH_LimDFCVerb 0.00 17.0000000000 FORMAT "%13.10" NUMBER 50 /end CHARACTERISTIC
/begin CHARACTERISTIC DINH_Lim.DFC_MOXEMM_SMU_ALM8_0_CA "inhibit conditions / inhibit limit conditions for inhibit source DFC_MOXEMM_SMU_ALM8_0" VAL_BLK 0x804F6F7F ValA_Wu8 17.0000000000 DINH_LimDFCVerb 0.00 17.0000000000 FORMAT "%13.10" NUMBER 50 /end CHARACTERISTIC
/begin CHARACTERISTIC DINH_Lim.DFC_MOXEMM_SMU_ALM8_1_CA "inhibit conditions / inhibit limit conditions for inhibit source DFC_MOXEMM_SMU_ALM8_1" VAL_BLK 0x804F6FB1 ValA_Wu8 17.0000000000 DINH_LimDFCVerb 0.00 17.0000000000 FORMAT "%13.10" NUMBER 50 /end CHARACTERISTIC
/begin CHARACTERISTIC DINH_Lim.DFC_MOXEMM_SMU_ALM8_10_CA "inhibit conditions / inhibit limit conditions for inhibit source DFC_MOXEMM_SMU_ALM8_10" VAL_BLK 0x804F6FE3 ValA_Wu8 17.0000000000 DINH_LimDFCVerb 0.00 17.0000000000 FORMAT "%13.10" NUMBER 50 /end CHARACTERISTIC
/begin CHARACTERISTIC DINH_Lim.DFC_MOXEMM_SMU_ALM8_11_CA "inhibit conditions / inhibit limit conditions for inhibit source DFC_MOXEMM_SMU_ALM8_11" VAL_BLK 0x804F7015 ValA_Wu8 17.0000000000 DINH_LimDFCVerb 0.00 17.0000000000 FORMAT "%13.10" NUMBER 50 /end CHARACTERISTIC
/begin CHARACTERISTIC DINH_Lim.DFC_MOXEMM_SMU_ALM8_12_CA "inhibit conditions / inhibit limit conditions for inhibit source DFC_MOXEMM_SMU_ALM8_12" VAL_BLK 0x804F7047 ValA_Wu8 17.0000000000 DINH_LimDFCVerb 0.00 17.0000000000 FORMAT "%13.10" NUMBER 50 /end CHARACTERISTIC
/begin CHARACTERISTIC DINH_Lim.DFC_MOXEMM_SMU_ALM8_16_CA "inhibit conditions / inhibit limit conditions for inhibit source DFC_MOXEMM_SMU_ALM8_16" VAL_BLK 0x804F7079 ValA_Wu8 17.0000000000 DINH_LimDFCVerb 0.00 17.0000000000 FORMAT "%13.10" NUMBER 50 /end CHARACTERISTIC
/begin CHARACTERISTIC DINH_Lim.DFC_MOXEMM_SMU_ALM8_18_CA "inhibit conditions / inhibit limit conditions for inhibit source DFC_MOXEMM_SMU_ALM8_18" VAL_BLK 0x804F70AB ValA_Wu8 17.0000000000 DINH_LimDFCVerb 0.00 17.0000000000 FORMAT "%13.10" NUMBER 50 /end CHARACTERISTIC
/begin CHARACTERISTIC DINH_Lim.DFC_MOXEMM_SMU_ALM8_2_CA "inhibit conditions / inhibit limit conditions for inhibit source DFC_MOXEMM_SMU_ALM8_2" VAL_BLK 0x804F70DD ValA_Wu8 17.0000000000 DINH_LimDFCVerb 0.00 17.0000000000 FORMAT "%13.10" NUMBER 50 /end CHARACTERISTIC
/begin CHARACTERISTIC DINH_Lim.DFC_MOXEMM_SMU_ALM8_3_CA "inhibit conditions / inhibit limit conditions for inhibit source DFC_MOXEMM_SMU_ALM8_3" VAL_BLK 0x804F710F ValA_Wu8 17.0000000000 DINH_LimDFCVerb 0.00 17.0000000000 FORMAT "%13.10" NUMBER 50 /end CHARACTERISTIC
/begin CHARACTERISTIC DINH_Lim.DFC_MOXEMM_SMU_ALM8_31_CA "inhibit conditions / inhibit limit conditions for inhibit source DFC_MOXEMM_SMU_ALM8_31" VAL_BLK 0x804F7141 ValA_Wu8 17.0000000000 DINH_LimDFCVerb 0.00 17.0000000000 FORMAT "%13.10" NUMBER 50 /end CHARACTERISTIC
/begin CHARACTERISTIC DINH_Lim.DFC_MOXEMM_SMU_ALM8_4_CA "inhibit conditions / inhibit limit conditions for inhibit source DFC_MOXEMM_SMU_ALM8_4" VAL_BLK 0x804F7173 ValA_Wu8 17.0000000000 DINH_LimDFCVerb 0.00 17.0000000000 FORMAT "%13.10" NUMBER 50 /end CHARACTERISTIC
/begin CHARACTERISTIC DINH_Lim.DFC_MOXEMM_SMU_ALM9_0_CA "inhibit conditions / inhibit limit conditions for inhibit source DFC_MOXEMM_SMU_ALM9_0" VAL_BLK 0x804F71A5 ValA_Wu8 17.0000000000 DINH_LimDFCVerb 0.00 17.0000000000 FORMAT "%13.10" NUMBER 50 /end CHARACTERISTIC
/begin CHARACTERISTIC DINH_Lim.DFC_MOXEMM_SMU_ALM9_15_CA "inhibit conditions / inhibit limit conditions for inhibit source DFC_MOXEMM_SMU_ALM9_15" VAL_BLK 0x804F71D7 ValA_Wu8 17.0000000000 DINH_LimDFCVerb 0.00 17.0000000000 FORMAT "%13.10" NUMBER 50 /end CHARACTERISTIC
/begin CHARACTERISTIC DINH_Lim.DFC_MOXEMM_SMU_ALM9_3_CA "inhibit conditions / inhibit limit conditions for inhibit source DFC_MOXEMM_SMU_ALM9_3" VAL_BLK 0x804F7209 ValA_Wu8 17.0000000000 DINH_LimDFCVerb 0.00 17.0000000000 FORMAT "%13.10" NUMBER 50 /end CHARACTERISTIC
/begin CHARACTERISTIC DINH_Lim.DFC_MoCADCNTP_CA "inhibit conditions / inhibit limit conditions for inhibit source DFC_MoCADCNTP" VAL_BLK 0x804F723B ValA_Wu8 17.0000000000 DINH_LimDFCVerb 0.00 17.0000000000 FORMAT "%13.10" NUMBER 65 /end CHARACTERISTIC
/begin CHARACTERISTIC DINH_Lim.DFC_MoCADCTst_CA "inhibit conditions / inhibit limit conditions for inhibit source DFC_MoCADCTst" VAL_BLK 0x804F727C ValA_Wu8 17.0000000000 DINH_LimDFCVerb 0.00 17.0000000000 FORMAT "%13.10" NUMBER 65 /end CHARACTERISTIC
/begin CHARACTERISTIC DINH_Lim.DFC_MoCSOPICO_CA "inhibit conditions / inhibit limit conditions for inhibit source DFC_MoCSOPICO" VAL_BLK 0x804F72BD ValA_Wu8 17.0000000000 DINH_LimDFCVerb 0.00 17.0000000000 FORMAT "%13.10" NUMBER 51 /end CHARACTERISTIC
/begin CHARACTERISTIC DINH_Lim.DFC_MoFAPP_CA "inhibit conditions / inhibit limit conditions for inhibit source DFC_MoFAPP" VAL_BLK 0x804F72F0 ValA_Wu8 17.0000000000 DINH_LimDFCVerb 0.00 17.0000000000 FORMAT "%13.10" NUMBER 65 /end CHARACTERISTIC
/begin CHARACTERISTIC DINH_Lim.DFC_MoFAirFilgPrdc_CA "inhibit conditions / inhibit limit conditions for inhibit source DFC_MoFAirFilgPrdc" VAL_BLK 0x804F7331 ValA_Wu8 17.0000000000 DINH_LimDFCVerb 0.00 17.0000000000 FORMAT "%13.10" NUMBER 64 /end CHARACTERISTIC
/begin CHARACTERISTIC DINH_Lim.DFC_MoFAirFlCtOffPfi_CA "inhibit conditions / inhibit limit conditions for inhibit source DFC_MoFAirFlCtOffPfi" VAL_BLK 0x804F7371 ValA_Wu8 17.0000000000 DINH_LimDFCVerb 0.00 17.0000000000 FORMAT "%13.10" NUMBER 52 /end CHARACTERISTIC
/begin CHARACTERISTIC DINH_Lim.DFC_MoFAirFlCylPfi_CA "inhibit conditions / inhibit limit conditions for inhibit source DFC_MoFAirFlCylPfi" VAL_BLK 0x804F73A5 ValA_Wu8 17.0000000000 DINH_LimDFCVerb 0.00 17.0000000000 FORMAT "%13.10" NUMBER 52 /end CHARACTERISTIC
/begin CHARACTERISTIC DINH_Lim.DFC_MoFAirFlIn_CA "inhibit conditions / inhibit limit conditions for inhibit source DFC_MoFAirFlIn" VAL_BLK 0x804F73D9 ValA_Wu8 17.0000000000 DINH_LimDFCVerb 0.00 17.0000000000 FORMAT "%13.10" NUMBER 51 /end CHARACTERISTIC
/begin CHARACTERISTIC DINH_Lim.DFC_MoFAirFlMixCtlPfiChkAirFl_CA "inhibit conditions / inhibit limit conditions for inhibit source DFC_MoFAirFlMixCtlPfiChkAirFl" VAL_BLK 0x804F740C ValA_Wu8 17.0000000000 DINH_LimDFCVerb 0.00 17.0000000000 FORMAT "%13.10" NUMBER 52 /end CHARACTERISTIC
/begin CHARACTERISTIC DINH_Lim.DFC_MoFAirFlMixCtlPfiChkCtrl_CA "inhibit conditions / inhibit limit conditions for inhibit source DFC_MoFAirFlMixCtlPfiChkCtrl" VAL_BLK 0x804F7440 ValA_Wu8 17.0000000000 DINH_LimDFCVerb 0.00 17.0000000000 FORMAT "%13.10" NUMBER 52 /end CHARACTERISTIC
/begin CHARACTERISTIC DINH_Lim.DFC_MoFAirFlMode_CA "inhibit conditions / inhibit limit conditions for inhibit source DFC_MoFAirFlMode" VAL_BLK 0x804F7474 ValA_Wu8 17.0000000000 DINH_LimDFCVerb 0.00 17.0000000000 FORMAT "%13.10" NUMBER 52 /end CHARACTERISTIC
/begin CHARACTERISTIC DINH_Lim.DFC_MoFESpd_CA "inhibit conditions / inhibit limit conditions for inhibit source DFC_MoFESpd" VAL_BLK 0x804F74A8 ValA_Wu8 17.0000000000 DINH_LimDFCVerb 0.00 17.0000000000 FORMAT "%13.10" NUMBER 65 /end CHARACTERISTIC
/begin CHARACTERISTIC DINH_Lim.DFC_MoFIACo_CA "inhibit conditions / inhibit limit conditions for inhibit source DFC_MoFIACo" VAL_BLK 0x804F74E9 ValA_Wu8 17.0000000000 DINH_LimDFCVerb 0.00 17.0000000000 FORMAT "%13.10" NUMBER 52 /end CHARACTERISTIC
/begin CHARACTERISTIC DINH_Lim.DFC_MoFICOL1_CA "inhibit conditions / inhibit limit conditions for inhibit source DFC_MoFICOL1" VAL_BLK 0x804F751D ValA_Wu8 17.0000000000 DINH_LimDFCVerb 0.00 17.0000000000 FORMAT "%13.10" NUMBER 63 /end CHARACTERISTIC
/begin CHARACTERISTIC DINH_Lim.DFC_MoFICOL2_CA "inhibit conditions / inhibit limit conditions for inhibit source DFC_MoFICOL2" VAL_BLK 0x804F755C ValA_Wu8 17.0000000000 DINH_LimDFCVerb 0.00 17.0000000000 FORMAT "%13.10" NUMBER 59 /end CHARACTERISTIC
/begin CHARACTERISTIC DINH_Lim.DFC_MoFStrt_CA "inhibit conditions / inhibit limit conditions for inhibit source DFC_MoFStrt" VAL_BLK 0x804F7597 ValA_Wu8 17.0000000000 DINH_LimDFCVerb 0.00 17.0000000000 FORMAT "%13.10" NUMBER 60 /end CHARACTERISTIC
/begin CHARACTERISTIC DINH_Lim.DFC_MoFTrqCmp_CA "inhibit conditions / inhibit limit conditions for inhibit source DFC_MoFTrqCmp" VAL_BLK 0x804F75D3 ValA_Wu8 17.0000000000 DINH_LimDFCVerb 0.00 17.0000000000 FORMAT "%13.10" NUMBER 64 /end CHARACTERISTIC
/begin CHARACTERISTIC DINH_Lim.DFC_MoFTrqCmpMax_CA "inhibit conditions / inhibit limit conditions for inhibit source DFC_MoFTrqCmpMax" VAL_BLK 0x804F7613 ValA_Wu8 17.0000000000 DINH_LimDFCVerb 0.00 17.0000000000 FORMAT "%13.10" NUMBER 50 /end CHARACTERISTIC
/begin CHARACTERISTIC DINH_Lim.DFC_MoFTrqCmpMin_CA "inhibit conditions / inhibit limit conditions for inhibit source DFC_MoFTrqCmpMin" VAL_BLK 0x804F7645 ValA_Wu8 17.0000000000 DINH_LimDFCVerb 0.00 17.0000000000 FORMAT "%13.10" NUMBER 50 /end CHARACTERISTIC
/begin CHARACTERISTIC DINH_Lim.DFC_MoFVarPostBldSel_CA "inhibit conditions / inhibit limit conditions for inhibit source DFC_MoFVarPostBldSel" VAL_BLK 0x804F7677 ValA_Wu8 17.0000000000 DINH_LimDFCVerb 0.00 17.0000000000 FORMAT "%13.10" NUMBER 50 /end CHARACTERISTIC
/begin CHARACTERISTIC DINH_Lim.DFC_MoXEMMHwLTMCUFW_CA "inhibit conditions / inhibit limit conditions for inhibit source DFC_MoXEMMHwLTMCUFW" VAL_BLK 0x804F76A9 ValA_Wu8 17.0000000000 DINH_LimDFCVerb 0.00 17.0000000000 FORMAT "%13.10" NUMBER 50 /end CHARACTERISTIC
/begin CHARACTERISTIC DINH_Lim.DFC_MoXEMMHwLTMonBIST_CA "inhibit conditions / inhibit limit conditions for inhibit source DFC_MoXEMMHwLTMonBIST" VAL_BLK 0x804F76DB ValA_Wu8 17.0000000000 DINH_LimDFCVerb 0.00 17.0000000000 FORMAT "%13.10" NUMBER 50 /end CHARACTERISTIC
/begin CHARACTERISTIC DINH_Lim.DFC_MoXEMMHwLTRegMonTest_CA "inhibit conditions / inhibit limit conditions for inhibit source DFC_MoXEMMHwLTRegMonTest" VAL_BLK 0x804F770D ValA_Wu8 17.0000000000 DINH_LimDFCVerb 0.00 17.0000000000 FORMAT "%13.10" NUMBER 50 /end CHARACTERISTIC
/begin CHARACTERISTIC DINH_Lim.DFC_MoXEMMHwLTStbySMUAlvTest_CA "inhibit conditions / inhibit limit conditions for inhibit source DFC_MoXEMMHwLTStbySMUAlvTest" VAL_BLK 0x804F773F ValA_Wu8 17.0000000000 DINH_LimDFCVerb 0.00 17.0000000000 FORMAT "%13.10" NUMBER 50 /end CHARACTERISTIC
/begin CHARACTERISTIC DINH_Lim.DFC_MoXEMMHwLTTempSens_CA "inhibit conditions / inhibit limit conditions for inhibit source DFC_MoXEMMHwLTTempSens" VAL_BLK 0x804F7771 ValA_Wu8 17.0000000000 DINH_LimDFCVerb 0.00 17.0000000000 FORMAT "%13.10" NUMBER 50 /end CHARACTERISTIC
/begin CHARACTERISTIC DINH_Lim.DFC_MoXEMMHwLTUCBCfg_CA "inhibit conditions / inhibit limit conditions for inhibit source DFC_MoXEMMHwLTUCBCfg" VAL_BLK 0x804F77A3 ValA_Wu8 17.0000000000 DINH_LimDFCVerb 0.00 17.0000000000 FORMAT "%13.10" NUMBER 50 /end CHARACTERISTIC
/begin CHARACTERISTIC DINH_Lim.DFC_OCWDAABEActv_CA "inhibit conditions / inhibit limit conditions for inhibit source DFC_OCWDAABEActv" VAL_BLK 0x804F77D5 ValA_Wu8 17.0000000000 DINH_LimDFCVerb 0.00 17.0000000000 FORMAT "%13.10" NUMBER 51 /end CHARACTERISTIC
/begin CHARACTERISTIC DINH_Lim.DFC_OCWDACom_CA "inhibit conditions / inhibit limit conditions for inhibit source DFC_OCWDACom" VAL_BLK 0x804F7808 ValA_Wu8 17.0000000000 DINH_LimDFCVerb 0.00 17.0000000000 FORMAT "%13.10" NUMBER 53 /end CHARACTERISTIC
/begin CHARACTERISTIC DINH_Lim.DFC_OCWDAErrPin_CA "inhibit conditions / inhibit limit conditions for inhibit source DFC_OCWDAErrPin" VAL_BLK 0x804F783D ValA_Wu8 17.0000000000 DINH_LimDFCVerb 0.00 17.0000000000 FORMAT "%13.10" NUMBER 51 /end CHARACTERISTIC
/begin CHARACTERISTIC DINH_Lim.DFC_OCWDAOvrVltg_CA "inhibit conditions / inhibit limit conditions for inhibit source DFC_OCWDAOvrVltg" VAL_BLK 0x804F7870 ValA_Wu8 17.0000000000 DINH_LimDFCVerb 0.00 17.0000000000 FORMAT "%13.10" NUMBER 51 /end CHARACTERISTIC
/begin CHARACTERISTIC DINH_Lim.DFC_ORAmax_CA "inhibit conditions / inhibit limit conditions for inhibit source DFC_ORAmax" VAL_BLK 0x804F78A3 ValA_Wu8 17.0000000000 DINH_LimDFCVerb 0.00 17.0000000000 FORMAT "%13.10" NUMBER 69 /end CHARACTERISTIC
/begin CHARACTERISTIC DINH_Lim.DFC_ORAmin_CA "inhibit conditions / inhibit limit conditions for inhibit source DFC_ORAmin" VAL_BLK 0x804F78E8 ValA_Wu8 17.0000000000 DINH_LimDFCVerb 0.00 17.0000000000 FORMAT "%13.10" NUMBER 69 /end CHARACTERISTIC
/begin CHARACTERISTIC DINH_Lim.DFC_PLLSUmax_CA "inhibit conditions / inhibit limit conditions for inhibit source DFC_PLLSUmax" VAL_BLK 0x804F792D ValA_Wu8 17.0000000000 DINH_LimDFCVerb 0.00 17.0000000000 FORMAT "%13.10" NUMBER 70 /end CHARACTERISTIC
/begin CHARACTERISTIC DINH_Lim.DFC_PLLSUmin_CA "inhibit conditions / inhibit limit conditions for inhibit source DFC_PLLSUmin" VAL_BLK 0x804F7973 ValA_Wu8 17.0000000000 DINH_LimDFCVerb 0.00 17.0000000000 FORMAT "%13.10" NUMBER 70 /end CHARACTERISTIC
/begin CHARACTERISTIC DINH_Lim.DFC_PSR1max_CA "inhibit conditions / inhibit limit conditions for inhibit source DFC_PSR1max" VAL_BLK 0x804F79B9 ValA_Wu8 17.0000000000 DINH_LimDFCVerb 0.00 17.0000000000 FORMAT "%13.10" NUMBER 50 /end CHARACTERISTIC
/begin CHARACTERISTIC DINH_Lim.DFC_PSRBmax_CA "inhibit conditions / inhibit limit conditions for inhibit source DFC_PSRBmax" VAL_BLK 0x804F79EB ValA_Wu8 17.0000000000 DINH_LimDFCVerb 0.00 17.0000000000 FORMAT "%13.10" NUMBER 90 /end CHARACTERISTIC
/begin CHARACTERISTIC DINH_Lim.DFC_PSRBmin_CA "inhibit conditions / inhibit limit conditions for inhibit source DFC_PSRBmin" VAL_BLK 0x804F7A45 ValA_Wu8 17.0000000000 DINH_LimDFCVerb 0.00 17.0000000000 FORMAT "%13.10" NUMBER 90 /end CHARACTERISTIC
/begin CHARACTERISTIC DINH_Lim.DFC_PSRPmax_CA "inhibit conditions / inhibit limit conditions for inhibit source DFC_PSRPmax" VAL_BLK 0x804F7A9F ValA_Wu8 17.0000000000 DINH_LimDFCVerb 0.00 17.0000000000 FORMAT "%13.10" NUMBER 89 /end CHARACTERISTIC
/begin CHARACTERISTIC DINH_Lim.DFC_PSRPmin_CA "inhibit conditions / inhibit limit conditions for inhibit source DFC_PSRPmin" VAL_BLK 0x804F7AF8 ValA_Wu8 17.0000000000 DINH_LimDFCVerb 0.00 17.0000000000 FORMAT "%13.10" NUMBER 89 /end CHARACTERISTIC
/begin CHARACTERISTIC DINH_Lim.DFC_PSRPsig_CA "inhibit conditions / inhibit limit conditions for inhibit source DFC_PSRPsig" VAL_BLK 0x804F7B51 ValA_Wu8 17.0000000000 DINH_LimDFCVerb 0.00 17.0000000000 FORMAT "%13.10" NUMBER 83 /end CHARACTERISTIC
/begin CHARACTERISTIC DINH_Lim.DFC_PSRmax_CA "inhibit conditions / inhibit limit conditions for inhibit source DFC_PSRmax" VAL_BLK 0x804F7BA4 ValA_Wu8 17.0000000000 DINH_LimDFCVerb 0.00 17.0000000000 FORMAT "%13.10" NUMBER 50 /end CHARACTERISTIC
/begin CHARACTERISTIC DINH_Lim.DFC_PUmax_CA "inhibit conditions / inhibit limit conditions for inhibit source DFC_PUmax" VAL_BLK 0x804F7BD6 ValA_Wu8 17.0000000000 DINH_LimDFCVerb 0.00 17.0000000000 FORMAT "%13.10" NUMBER 50 /end CHARACTERISTIC
/begin CHARACTERISTIC DINH_Lim.DFC_P_VSE11_OL_CA "inhibit conditions / inhibit limit conditions for inhibit source DFC_P_VSE11_OL" VAL_BLK 0x804F7C08 ValA_Wu8 17.0000000000 DINH_LimDFCVerb 0.00 17.0000000000 FORMAT "%13.10" NUMBER 76 /end CHARACTERISTIC
/begin CHARACTERISTIC DINH_Lim.DFC_P_VSE11_SCB_CA "inhibit conditions / inhibit limit conditions for inhibit source DFC_P_VSE11_SCB" VAL_BLK 0x804F7C54 ValA_Wu8 17.0000000000 DINH_LimDFCVerb 0.00 17.0000000000 FORMAT "%13.10" NUMBER 76 /end CHARACTERISTIC
/begin CHARACTERISTIC DINH_Lim.DFC_P_VSE11_SCG_CA "inhibit conditions / inhibit limit conditions for inhibit source DFC_P_VSE11_SCG" VAL_BLK 0x804F7CA0 ValA_Wu8 17.0000000000 DINH_LimDFCVerb 0.00 17.0000000000 FORMAT "%13.10" NUMBER 76 /end CHARACTERISTIC
/begin CHARACTERISTIC DINH_Lim.DFC_PhyHighAPP1_CA "inhibit conditions / inhibit limit conditions for inhibit source DFC_PhyHighAPP1" VAL_BLK 0x804F7CEC ValA_Wu8 17.0000000000 DINH_LimDFCVerb 0.00 17.0000000000 FORMAT "%13.10" NUMBER 57 /end CHARACTERISTIC
/begin CHARACTERISTIC DINH_Lim.DFC_PhyHighAPP2_CA "inhibit conditions / inhibit limit conditions for inhibit source DFC_PhyHighAPP2" VAL_BLK 0x804F7D25 ValA_Wu8 17.0000000000 DINH_LimDFCVerb 0.00 17.0000000000 FORMAT "%13.10" NUMBER 56 /end CHARACTERISTIC
/begin CHARACTERISTIC DINH_Lim.DFC_PhyLowAPP1_CA "inhibit conditions / inhibit limit conditions for inhibit source DFC_PhyLowAPP1" VAL_BLK 0x804F7D5D ValA_Wu8 17.0000000000 DINH_LimDFCVerb 0.00 17.0000000000 FORMAT "%13.10" NUMBER 57 /end CHARACTERISTIC
/begin CHARACTERISTIC DINH_Lim.DFC_PhyLowAPP2_CA "inhibit conditions / inhibit limit conditions for inhibit source DFC_PhyLowAPP2" VAL_BLK 0x804F7D96 ValA_Wu8 17.0000000000 DINH_LimDFCVerb 0.00 17.0000000000 FORMAT "%13.10" NUMBER 56 /end CHARACTERISTIC
/begin CHARACTERISTIC DINH_Lim.DFC_SRCHighAPP1_CA "inhibit conditions / inhibit limit conditions for inhibit source DFC_SRCHighAPP1" VAL_BLK 0x804F7DCE ValA_Wu8 17.0000000000 DINH_LimDFCVerb 0.00 17.0000000000 FORMAT "%13.10" NUMBER 69 /end CHARACTERISTIC
/begin CHARACTERISTIC DINH_Lim.DFC_SRCHighAPP2_CA "inhibit conditions / inhibit limit conditions for inhibit source DFC_SRCHighAPP2" VAL_BLK 0x804F7E13 ValA_Wu8 17.0000000000 DINH_LimDFCVerb 0.00 17.0000000000 FORMAT "%13.10" NUMBER 68 /end CHARACTERISTIC
/begin CHARACTERISTIC DINH_Lim.DFC_SRCLowAPP1_CA "inhibit conditions / inhibit limit conditions for inhibit source DFC_SRCLowAPP1" VAL_BLK 0x804F7E57 ValA_Wu8 17.0000000000 DINH_LimDFCVerb 0.00 17.0000000000 FORMAT "%13.10" NUMBER 70 /end CHARACTERISTIC
/begin CHARACTERISTIC DINH_Lim.DFC_SRCLowAPP2_CA "inhibit conditions / inhibit limit conditions for inhibit source DFC_SRCLowAPP2" VAL_BLK 0x804F7E9D ValA_Wu8 17.0000000000 DINH_LimDFCVerb 0.00 17.0000000000 FORMAT "%13.10" NUMBER 69 /end CHARACTERISTIC
/begin CHARACTERISTIC DINH_Lim.DFC_SSpMon2_CA "inhibit conditions / inhibit limit conditions for inhibit source DFC_SSpMon2" VAL_BLK 0x804F7EE2 ValA_Wu8 17.0000000000 DINH_LimDFCVerb 0.00 17.0000000000 FORMAT "%13.10" NUMBER 88 /end CHARACTERISTIC
/begin CHARACTERISTIC DINH_Lim.DFC_SWReset_0_CA "inhibit conditions / inhibit limit conditions for inhibit source DFC_SWReset_0" VAL_BLK 0x804F7F3A ValA_Wu8 17.0000000000 DINH_LimDFCVerb 0.00 17.0000000000 FORMAT "%13.10" NUMBER 50 /end CHARACTERISTIC
/begin CHARACTERISTIC DINH_Lim.DFC_SWReset_1_CA "inhibit conditions / inhibit limit conditions for inhibit source DFC_SWReset_1" VAL_BLK 0x804F7F6C ValA_Wu8 17.0000000000 DINH_LimDFCVerb 0.00 17.0000000000 FORMAT "%13.10" NUMBER 50 /end CHARACTERISTIC
/begin CHARACTERISTIC DINH_Lim.DFC_SWReset_2_CA "inhibit conditions / inhibit limit conditions for inhibit source DFC_SWReset_2" VAL_BLK 0x804F7F9E ValA_Wu8 17.0000000000 DINH_LimDFCVerb 0.00 17.0000000000 FORMAT "%13.10" NUMBER 50 /end CHARACTERISTIC
/begin CHARACTERISTIC DINH_Lim.DFC_SyncAPP_CA "inhibit conditions / inhibit limit conditions for inhibit source DFC_SyncAPP" VAL_BLK 0x804F7FD0 ValA_Wu8 17.0000000000 DINH_LimDFCVerb 0.00 17.0000000000 FORMAT "%13.10" NUMBER 73 /end CHARACTERISTIC
/begin CHARACTERISTIC DINH_Lim.DFC_TAmax_Dummy_CA "inhibit conditions / inhibit limit conditions for inhibit source DFC_TAmax_Dummy" VAL_BLK 0x804F8019 ValA_Wu8 17.0000000000 DINH_LimDFCVerb 0.00 17.0000000000 FORMAT "%13.10" NUMBER 50 /end CHARACTERISTIC
/begin CHARACTERISTIC DINH_Lim.DFC_TKAEmax_CA "inhibit conditions / inhibit limit conditions for inhibit source DFC_TKAEmax" VAL_BLK 0x804F804B ValA_Wu8 17.0000000000 DINH_LimDFCVerb 0.00 17.0000000000 FORMAT "%13.10" NUMBER 50 /end CHARACTERISTIC
/begin CHARACTERISTIC DINH_Lim.DFC_TKAEmin_CA "inhibit conditions / inhibit limit conditions for inhibit source DFC_TKAEmin" VAL_BLK 0x804F807D ValA_Wu8 17.0000000000 DINH_LimDFCVerb 0.00 17.0000000000 FORMAT "%13.10" NUMBER 50 /end CHARACTERISTIC
/begin CHARACTERISTIC DINH_Lim.DFC_TKARmax_CA "inhibit conditions / inhibit limit conditions for inhibit source DFC_TKARmax" VAL_BLK 0x804F80AF ValA_Wu8 17.0000000000 DINH_LimDFCVerb 0.00 17.0000000000 FORMAT "%13.10" NUMBER 50 /end CHARACTERISTIC
/begin CHARACTERISTIC DINH_Lim.DFC_TKARnpl_CA "inhibit conditions / inhibit limit conditions for inhibit source DFC_TKARnpl" VAL_BLK 0x804F80E1 ValA_Wu8 17.0000000000 DINH_LimDFCVerb 0.00 17.0000000000 FORMAT "%13.10" NUMBER 50 /end CHARACTERISTIC
/begin CHARACTERISTIC DINH_Lim.DFC_TMmax_Dummy_CA "inhibit conditions / inhibit limit conditions for inhibit source DFC_TMmax_Dummy" VAL_BLK 0x804F8113 ValA_Wu8 17.0000000000 DINH_LimDFCVerb 0.00 17.0000000000 FORMAT "%13.10" NUMBER 50 /end CHARACTERISTIC
/begin CHARACTERISTIC DINH_Lim.DFC_TUMmax_Dummy_CA "inhibit conditions / inhibit limit conditions for inhibit source DFC_TUMmax_Dummy" VAL_BLK 0x804F8145 ValA_Wu8 17.0000000000 DINH_LimDFCVerb 0.00 17.0000000000 FORMAT "%13.10" NUMBER 50 /end CHARACTERISTIC
/begin CHARACTERISTIC DINH_Lim.DFC_TWCDPriCatB1_CA "inhibit conditions / inhibit limit conditions for inhibit source DFC_TWCDPriCatB1" VAL_BLK 0x804F8177 ValA_Wu8 17.0000000000 DINH_LimDFCVerb 0.00 17.0000000000 FORMAT "%13.10" NUMBER 54 /end CHARACTERISTIC
/begin CHARACTERISTIC DINH_Lim.DFC_ThrVlvClsdPosnFirstOffsLrnImpoB1_CA "inhibit conditions / inhibit limit conditions for inhibit source DFC_ThrVlvClsdPosnFirstOffsLrnImpoB1" VAL_BLK 0x804F81AD ValA_Wu8 17.0000000000 DINH_LimDFCVerb 0.00 17.0000000000 FORMAT "%13.10" NUMBER 69 /end CHARACTERISTIC
/begin CHARACTERISTIC DINH_Lim.DFC_ThrVlvClsdPosnOffsLrnImpoB1_CA "inhibit conditions / inhibit limit conditions for inhibit source DFC_ThrVlvClsdPosnOffsLrnImpoB1" VAL_BLK 0x804F81F2 ValA_Wu8 17.0000000000 DINH_LimDFCVerb 0.00 17.0000000000 FORMAT "%13.10" NUMBER 59 /end CHARACTERISTIC
/begin CHARACTERISTIC DINH_Lim.DFC_ThrVlvClsdPosnOffsLrnMaxB1_CA "inhibit conditions / inhibit limit conditions for inhibit source DFC_ThrVlvClsdPosnOffsLrnMaxB1" VAL_BLK 0x804F822D ValA_Wu8 17.0000000000 DINH_LimDFCVerb 0.00 17.0000000000 FORMAT "%13.10" NUMBER 59 /end CHARACTERISTIC
/begin CHARACTERISTIC DINH_Lim.DFC_ThrVlvClsdPosnOffsLrnMinB1_CA "inhibit conditions / inhibit limit conditions for inhibit source DFC_ThrVlvClsdPosnOffsLrnMinB1" VAL_BLK 0x804F8268 ValA_Wu8 17.0000000000 DINH_LimDFCVerb 0.00 17.0000000000 FORMAT "%13.10" NUMBER 59 /end CHARACTERISTIC
/begin CHARACTERISTIC DINH_Lim.DFC_ThrVlvCtrlDeB1_CA "inhibit conditions / inhibit limit conditions for inhibit source DFC_ThrVlvCtrlDeB1" VAL_BLK 0x804F82A3 ValA_Wu8 17.0000000000 DINH_LimDFCVerb 0.00 17.0000000000 FORMAT "%13.10" NUMBER 66 /end CHARACTERISTIC
/begin CHARACTERISTIC DINH_Lim.DFC_ThrVlvDycB1_CA "inhibit conditions / inhibit limit conditions for inhibit source DFC_ThrVlvDycB1" VAL_BLK 0x804F82E5 ValA_Wu8 17.0000000000 DINH_LimDFCVerb 0.00 17.0000000000 FORMAT "%13.10" NUMBER 66 /end CHARACTERISTIC
/begin CHARACTERISTIC DINH_Lim.DFC_ThrVlvLimpAirPosnMaxAbsltDriftB1_CA "inhibit conditions / inhibit limit conditions for inhibit source DFC_ThrVlvLimpAirPosnMaxAbsltDriftB1" VAL_BLK 0x804F8327 ValA_Wu8 17.0000000000 DINH_LimDFCVerb 0.00 17.0000000000 FORMAT "%13.10" NUMBER 54 /end CHARACTERISTIC
/begin CHARACTERISTIC DINH_Lim.DFC_ThrVlvLimpAirPosnMaxB1_CA "inhibit conditions / inhibit limit conditions for inhibit source DFC_ThrVlvLimpAirPosnMaxB1" VAL_BLK 0x804F835D ValA_Wu8 17.0000000000 DINH_LimDFCVerb 0.00 17.0000000000 FORMAT "%13.10" NUMBER 54 /end CHARACTERISTIC
/begin CHARACTERISTIC DINH_Lim.DFC_ThrVlvLimpAirPosnMaxRelDriftB1_CA "inhibit conditions / inhibit limit conditions for inhibit source DFC_ThrVlvLimpAirPosnMaxRelDriftB1" VAL_BLK 0x804F8393 ValA_Wu8 17.0000000000 DINH_LimDFCVerb 0.00 17.0000000000 FORMAT "%13.10" NUMBER 54 /end CHARACTERISTIC
/begin CHARACTERISTIC DINH_Lim.DFC_ThrVlvLimpAirPosnMinB1_CA "inhibit conditions / inhibit limit conditions for inhibit source DFC_ThrVlvLimpAirPosnMinB1" VAL_BLK 0x804F83C9 ValA_Wu8 17.0000000000 DINH_LimDFCVerb 0.00 17.0000000000 FORMAT "%13.10" NUMBER 54 /end CHARACTERISTIC
/begin CHARACTERISTIC DINH_Lim.DFC_ThrVlvOpenLoadB1_CA "inhibit conditions / inhibit limit conditions for inhibit source DFC_ThrVlvOpenLoadB1" VAL_BLK 0x804F83FF ValA_Wu8 17.0000000000 DINH_LimDFCVerb 0.00 17.0000000000 FORMAT "%13.10" NUMBER 65 /end CHARACTERISTIC
/begin CHARACTERISTIC DINH_Lim.DFC_ThrVlvOpenSprgB1_CA "inhibit conditions / inhibit limit conditions for inhibit source DFC_ThrVlvOpenSprgB1" VAL_BLK 0x804F8440 ValA_Wu8 17.0000000000 DINH_LimDFCVerb 0.00 17.0000000000 FORMAT "%13.10" NUMBER 65 /end CHARACTERISTIC
/begin CHARACTERISTIC DINH_Lim.DFC_ThrVlvOpenSprgSprdB1_CA "inhibit conditions / inhibit limit conditions for inhibit source DFC_ThrVlvOpenSprgSprdB1" VAL_BLK 0x804F8481 ValA_Wu8 17.0000000000 DINH_LimDFCVerb 0.00 17.0000000000 FORMAT "%13.10" NUMBER 54 /end CHARACTERISTIC
/begin CHARACTERISTIC DINH_Lim.DFC_ThrVlvOpenSprgTwnB1_CA "inhibit conditions / inhibit limit conditions for inhibit source DFC_ThrVlvOpenSprgTwnB1" VAL_BLK 0x804F84B7 ValA_Wu8 17.0000000000 DINH_LimDFCVerb 0.00 17.0000000000 FORMAT "%13.10" NUMBER 52 /end CHARACTERISTIC
/begin CHARACTERISTIC DINH_Lim.DFC_ThrVlvOverTB1_CA "inhibit conditions / inhibit limit conditions for inhibit source DFC_ThrVlvOverTB1" VAL_BLK 0x804F84EB ValA_Wu8 17.0000000000 DINH_LimDFCVerb 0.00 17.0000000000 FORMAT "%13.10" NUMBER 65 /end CHARACTERISTIC
/begin CHARACTERISTIC DINH_Lim.DFC_ThrVlvRetSprgB1_CA "inhibit conditions / inhibit limit conditions for inhibit source DFC_ThrVlvRetSprgB1" VAL_BLK 0x804F852C ValA_Wu8 17.0000000000 DINH_LimDFCVerb 0.00 17.0000000000 FORMAT "%13.10" NUMBER 64 /end CHARACTERISTIC
/begin CHARACTERISTIC DINH_Lim.DFC_ThrVlvRetSprgSprdB1_CA "inhibit conditions / inhibit limit conditions for inhibit source DFC_ThrVlvRetSprgSprdB1" VAL_BLK 0x804F856C ValA_Wu8 17.0000000000 DINH_LimDFCVerb 0.00 17.0000000000 FORMAT "%13.10" NUMBER 51 /end CHARACTERISTIC
/begin CHARACTERISTIC DINH_Lim.DFC_ThrVlvRetSprgTwnB1_CA "inhibit conditions / inhibit limit conditions for inhibit source DFC_ThrVlvRetSprgTwnB1" VAL_BLK 0x804F859F ValA_Wu8 17.0000000000 DINH_LimDFCVerb 0.00 17.0000000000 FORMAT "%13.10" NUMBER 52 /end CHARACTERISTIC
/begin CHARACTERISTIC DINH_Lim.DFC_ThrVlvSens1MaxB1_CA "inhibit conditions / inhibit limit conditions for inhibit source DFC_ThrVlvSens1MaxB1" VAL_BLK 0x804F85D3 ValA_Wu8 17.0000000000 DINH_LimDFCVerb 0.00 17.0000000000 FORMAT "%13.10" NUMBER 89 /end CHARACTERISTIC
/begin CHARACTERISTIC DINH_Lim.DFC_ThrVlvSens1NplB1_CA "inhibit conditions / inhibit limit conditions for inhibit source DFC_ThrVlvSens1NplB1" VAL_BLK 0x804F862C ValA_Wu8 17.0000000000 DINH_LimDFCVerb 0.00 17.0000000000 FORMAT "%13.10" NUMBER 89 /end CHARACTERISTIC
/begin CHARACTERISTIC DINH_Lim.DFC_ThrVlvSens2MaxB1_CA "inhibit conditions / inhibit limit conditions for inhibit source DFC_ThrVlvSens2MaxB1" VAL_BLK 0x804F8685 ValA_Wu8 17.0000000000 DINH_LimDFCVerb 0.00 17.0000000000 FORMAT "%13.10" NUMBER 89 /end CHARACTERISTIC
/begin CHARACTERISTIC DINH_Lim.DFC_ThrVlvSens2MinB1_CA "inhibit conditions / inhibit limit conditions for inhibit source DFC_ThrVlvSens2MinB1" VAL_BLK 0x804F86DE ValA_Wu8 17.0000000000 DINH_LimDFCVerb 0.00 17.0000000000 FORMAT "%13.10" NUMBER 89 /end CHARACTERISTIC
/begin CHARACTERISTIC DINH_Lim.DFC_ThrVlvSens2NplB1_CA "inhibit conditions / inhibit limit conditions for inhibit source DFC_ThrVlvSens2NplB1" VAL_BLK 0x804F8737 ValA_Wu8 17.0000000000 DINH_LimDFCVerb 0.00 17.0000000000 FORMAT "%13.10" NUMBER 89 /end CHARACTERISTIC
/begin CHARACTERISTIC DINH_Lim.DFC_ThrVlvShoCircB1_CA "inhibit conditions / inhibit limit conditions for inhibit source DFC_ThrVlvShoCircB1" VAL_BLK 0x804F8790 ValA_Wu8 17.0000000000 DINH_LimDFCVerb 0.00 17.0000000000 FORMAT "%13.10" NUMBER 65 /end CHARACTERISTIC
/begin CHARACTERISTIC DINH_Lim.DFC_ThrVlvSpiErrB1_CA "inhibit conditions / inhibit limit conditions for inhibit source DFC_ThrVlvSpiErrB1" VAL_BLK 0x804F87D1 ValA_Wu8 17.0000000000 DINH_LimDFCVerb 0.00 17.0000000000 FORMAT "%13.10" NUMBER 65 /end CHARACTERISTIC
/begin CHARACTERISTIC DINH_Lim.DFC_ThrvlvSens1MinB1_CA "inhibit conditions / inhibit limit conditions for inhibit source DFC_ThrvlvSens1MinB1" VAL_BLK 0x804F8812 ValA_Wu8 17.0000000000 DINH_LimDFCVerb 0.00 17.0000000000 FORMAT "%13.10" NUMBER 89 /end CHARACTERISTIC
/begin CHARACTERISTIC DINH_Lim.DFC_TiOffTBasdChkFast_CA "inhibit conditions / inhibit limit conditions for inhibit source DFC_TiOffTBasdChkFast" VAL_BLK 0x804F886B ValA_Wu8 17.0000000000 DINH_LimDFCVerb 0.00 17.0000000000 FORMAT "%13.10" NUMBER 51 /end CHARACTERISTIC
/begin CHARACTERISTIC DINH_Lim.DFC_TiOffTBasdChkSlow_CA "inhibit conditions / inhibit limit conditions for inhibit source DFC_TiOffTBasdChkSlow" VAL_BLK 0x804F889E ValA_Wu8 17.0000000000 DINH_LimDFCVerb 0.00 17.0000000000 FORMAT "%13.10" NUMBER 51 /end CHARACTERISTIC
/begin CHARACTERISTIC DINH_Lim.DFC_UEGOHeatrCtlS1B1_CA "inhibit conditions / inhibit limit conditions for inhibit source DFC_UEGOHeatrCtlS1B1" VAL_BLK 0x804F88D1 ValA_Wu8 17.0000000000 DINH_LimDFCVerb 0.00 17.0000000000 FORMAT "%13.10" NUMBER 72 /end CHARACTERISTIC
/begin CHARACTERISTIC DINH_Lim.DFC_UEGOSnsrMntdS1B1_CA "inhibit conditions / inhibit limit conditions for inhibit source DFC_UEGOSnsrMntdS1B1" VAL_BLK 0x804F8919 ValA_Wu8 17.0000000000 DINH_LimDFCVerb 0.00 17.0000000000 FORMAT "%13.10" NUMBER 66 /end CHARACTERISTIC
/begin CHARACTERISTIC DINH_Lim.DFC_VehVSig_CA "inhibit conditions / inhibit limit conditions for inhibit source DFC_VehVSig" VAL_BLK 0x804F895B ValA_Wu8 17.0000000000 DINH_LimDFCVerb 0.00 17.0000000000 FORMAT "%13.10" NUMBER 75 /end CHARACTERISTIC
/begin CHARACTERISTIC DINH_Lim.DFC_VlvLftFbSwtIntk11SpclFail_CA "inhibit conditions / inhibit limit conditions for inhibit source DFC_VlvLftFbSwtIntk11SpclFail" VAL_BLK 0x804F89A6 ValA_Wu8 17.0000000000 DINH_LimDFCVerb 0.00 17.0000000000 FORMAT "%13.10" NUMBER 77 /end CHARACTERISTIC
/begin CHARACTERISTIC DINH_Lim.DFC_VlvLftFbSwtIntk11StdFail_CA "inhibit conditions / inhibit limit conditions for inhibit source DFC_VlvLftFbSwtIntk11StdFail" VAL_BLK 0x804F89F3 ValA_Wu8 17.0000000000 DINH_LimDFCVerb 0.00 17.0000000000 FORMAT "%13.10" NUMBER 77 /end CHARACTERISTIC
/begin CHARACTERISTIC DINH_Lim.DSQ_ACClntP_CA "inhibit conditions / inhibit limit conditions for inhibit source DSQ_ACClntP" VAL_BLK 0x804F8A40 ValA_Wu8 16.0000000000 DINH_LimDSQVerb 0.00 16.0000000000 FORMAT "%13.10" NUMBER 50 /end CHARACTERISTIC
/begin CHARACTERISTIC DINH_Lim.DSQ_ACEvpT_CA "inhibit conditions / inhibit limit conditions for inhibit source DSQ_ACEvpT" VAL_BLK 0x804F8A72 ValA_Wu8 16.0000000000 DINH_LimDSQVerb 0.00 16.0000000000 FORMAT "%13.10" NUMBER 50 /end CHARACTERISTIC
/begin CHARACTERISTIC DINH_Lim.DSQ_AirCCmprActr_CA "inhibit conditions / inhibit limit conditions for inhibit source DSQ_AirCCmprActr" VAL_BLK 0x804F8AA4 ValA_Wu8 16.0000000000 DINH_LimDSQVerb 0.00 16.0000000000 FORMAT "%13.10" NUMBER 50 /end CHARACTERISTIC
/begin CHARACTERISTIC DINH_Lim.DSQ_BattU_CA "inhibit conditions / inhibit limit conditions for inhibit source DSQ_BattU" VAL_BLK 0x804F8AD6 ValA_Wu8 16.0000000000 DINH_LimDSQVerb 0.00 16.0000000000 FORMAT "%13.10" NUMBER 51 /end CHARACTERISTIC
/begin CHARACTERISTIC DINH_Lim.DSQ_BattULo_CA "inhibit conditions / inhibit limit conditions for inhibit source DSQ_BattULo" VAL_BLK 0x804F8B09 ValA_Wu8 16.0000000000 DINH_LimDSQVerb 0.00 16.0000000000 FORMAT "%13.10" NUMBER 50 /end CHARACTERISTIC
/begin CHARACTERISTIC DINH_Lim.DSQ_CoVMDIDASFail_CA "inhibit conditions / inhibit limit conditions for inhibit source DSQ_CoVMDIDASFail" VAL_BLK 0x804F8B3B ValA_Wu8 16.0000000000 DINH_LimDSQVerb 0.00 16.0000000000 FORMAT "%13.10" NUMBER 50 /end CHARACTERISTIC
/begin CHARACTERISTIC DINH_Lim.DSQ_DSMInhibitAlways_CA "inhibit conditions / inhibit limit conditions for inhibit source DSQ_DSMInhibitAlways" VAL_BLK 0x804F8B6D ValA_Wu8 16.0000000000 DINH_LimDSQVerb 0.00 16.0000000000 FORMAT "%13.10" NUMBER 51 /end CHARACTERISTIC
/begin CHARACTERISTIC DINH_Lim.DSQ_ElecLd_CA "inhibit conditions / inhibit limit conditions for inhibit source DSQ_ElecLd" VAL_BLK 0x804F8BA0 ValA_Wu8 16.0000000000 DINH_LimDSQVerb 0.00 16.0000000000 FORMAT "%13.10" NUMBER 51 /end CHARACTERISTIC
/begin CHARACTERISTIC DINH_Lim.DSQ_EngICO_CA "inhibit conditions / inhibit limit conditions for inhibit source DSQ_EngICO" VAL_BLK 0x804F8BD3 ValA_Wu8 16.0000000000 DINH_LimDSQVerb 0.00 16.0000000000 FORMAT "%13.10" NUMBER 50 /end CHARACTERISTIC
/begin CHARACTERISTIC DINH_Lim.DSQ_EpmCaSSigQuality_CA "inhibit conditions / inhibit limit conditions for inhibit source DSQ_EpmCaSSigQuality" VAL_BLK 0x804F8C05 ValA_Wu8 16.0000000000 DINH_LimDSQVerb 0.00 16.0000000000 FORMAT "%13.10" NUMBER 55 /end CHARACTERISTIC
/begin CHARACTERISTIC DINH_Lim.DSQ_EpmReverseRun_CA "inhibit conditions / inhibit limit conditions for inhibit source DSQ_EpmReverseRun" VAL_BLK 0x804F8C3C ValA_Wu8 16.0000000000 DINH_LimDSQVerb 0.00 16.0000000000 FORMAT "%13.10" NUMBER 52 /end CHARACTERISTIC
/begin CHARACTERISTIC DINH_Lim.DSQ_FanDIO_0_CA "inhibit conditions / inhibit limit conditions for inhibit source DSQ_FanDIO_0" VAL_BLK 0x804F8C70 ValA_Wu8 16.0000000000 DINH_LimDSQVerb 0.00 16.0000000000 FORMAT "%13.10" NUMBER 50 /end CHARACTERISTIC
/begin CHARACTERISTIC DINH_Lim.DSQ_FanDIO_1_CA "inhibit conditions / inhibit limit conditions for inhibit source DSQ_FanDIO_1" VAL_BLK 0x804F8CA2 ValA_Wu8 16.0000000000 DINH_LimDSQVerb 0.00 16.0000000000 FORMAT "%13.10" NUMBER 50 /end CHARACTERISTIC
/begin CHARACTERISTIC DINH_Lim.DSQ_FuelP_CA "inhibit conditions / inhibit limit conditions for inhibit source DSQ_FuelP" VAL_BLK 0x804F8CD4 ValA_Wu8 16.0000000000 DINH_LimDSQVerb 0.00 16.0000000000 FORMAT "%13.10" NUMBER 50 /end CHARACTERISTIC
/begin CHARACTERISTIC DINH_Lim.DSQ_FuelT_CA "inhibit conditions / inhibit limit conditions for inhibit source DSQ_FuelT" VAL_BLK 0x804F8D06 ValA_Wu8 16.0000000000 DINH_LimDSQVerb 0.00 16.0000000000 FORMAT "%13.10" NUMBER 50 /end CHARACTERISTIC
/begin CHARACTERISTIC DINH_Lim.DSQ_GbxPNPos_CA "inhibit conditions / inhibit limit conditions for inhibit source DSQ_GbxPNPos" VAL_BLK 0x804F8D38 ValA_Wu8 16.0000000000 DINH_LimDSQVerb 0.00 16.0000000000 FORMAT "%13.10" NUMBER 51 /end CHARACTERISTIC
/begin FUNCTION DINH "30000.27.0_1.0.0Diagnostic Inhibit Handler"
 /begin DEF_CHARACTERISTIC DINH_Lim.DFC_ComEAT12RingCnt_CA DINH_Lim.DFC_ComEAT12TOut_CA DINH_Lim.DFC_ComEAT13ChkSum_CA DINH_Lim.DFC_ComEAT13RingCnt_CA DINH_Lim.DFC_ComEAT13TOut_CA DINH_Lim.DFC_ComEAT1Chksum_CA DINH_Lim.DFC_ComEAT1RingCnt_CA DINH_Lim.DFC_ComEAT1TOut_CA DINH_Lim.DFC_ComEAT2ChkSum_CA DINH_Lim.DFC_ComEAT2RingCnt_CA DINH_Lim.DFC_ComEAT2TOut_CA DINH_Lim.DFC_ComEAT4ChkSum_CA DINH_Lim.DFC_ComEAT4RingCnt_CA DINH_Lim.DFC_ComEAT4TOut_CA DINH_Lim.DFC_ComEAT6Chksum_CA DINH_Lim.DFC_ComEAT6RingCnt_CA DINH_Lim.DFC_ComEAT6TOut_CA DINH_Lim.DFC_ComEAT7Chksum_CA DINH_Lim.DFC_ComEAT7RingCnt_CA DINH_Lim.DFC_ComEAT7TOut_CA DINH_Lim.DFC_ComEAT8Chksum_CA DINH_Lim.DFC_ComEAT8RingCnt_CA DINH_Lim.DFC_ComEAT8TOut_CA DINH_Lim.DFC_ComEATAChksum_CA DINH_Lim.DFC_ComEATARingCnt_CA DINH_Lim.DFC_ComEATATOut_CA DINH_Lim.DFC_ComEATBChkSum_CA DINH_Lim.DFC_ComEATBRingCnt_CA DINH_Lim.DFC_ComEATBTOut_CA DINH_Lim.DFC_ComEATCChksum_CA DINH_Lim.DFC_ComEATCRingCnt_CA DINH_Lim.DFC_ComEATCTOut_CA DINH_Lim.DFC_ComEBBAChksum_CA DINH_Lim.DFC_ComEBBARingCnt_CA DINH_Lim.DFC_ComEBBATOut_CA DINH_Lim.DFC_ComEPS1Chksum_CA DINH_Lim.DFC_ComEPS1RingCnt_CA DINH_Lim.DFC_ComEPS1TOut_CA DINH_Lim.DFC_ComEngCanRxErr_CA DINH_Lim.DFC_ComGrvySnsrErr_CA DINH_Lim.DFC_ComGwIMG1ChkSum_CA DINH_Lim.DFC_ComGwIMG1RingCnt_CA DINH_Lim.DFC_ComGwIMG1TOut_CA DINH_Lim.DFC_ComGwIMG3ChkSum_CA DINH_Lim.DFC_ComGwIMG3RingCnt_CA DINH_Lim.DFC_ComGwIMG3TOut_CA DINH_Lim.DFC_ComGwIMG4ChkSum_CA DINH_Lim.DFC_ComGwIMG4RingCnt_CA DINH_Lim.DFC_ComGwIMG4TOut_CA DINH_Lim.DFC_ComGwIMG5ChkSum_CA DINH_Lim.DFC_ComGwIMG5RingCnt_CA DINH_Lim.DFC_ComGwIMG5TOut_CA DINH_Lim.DFC_ComGwIMG6ChkSum_CA DINH_Lim.DFC_ComGwIMG6RingCnt_CA DINH_Lim.DFC_ComGwIMG6TOut_CA DINH_Lim.DFC_ComIDASBChksum_CA DINH_Lim.DFC_ComIDASBRingCnt_CA DINH_Lim.DFC_ComIDASBTOut_CA DINH_Lim.DFC_ComIMGMILReq_CA DINH_Lim.DFC_ComISSPrms_CA DINH_Lim.DFC_ComMETAChksum_CA DINH_Lim.DFC_ComMETARingCnt_CA DINH_Lim.DFC_ComMETATOut_CA DINH_Lim.DFC_ComMETCChksum_CA DINH_Lim.DFC_ComMETCRingCnt_CA DINH_Lim.DFC_ComMETCTOut_CA DINH_Lim.DFC_ComMETDChksum_CA DINH_Lim.DFC_ComMETDRingCnt_CA DINH_Lim.DFC_ComMETDTOut_CA DINH_Lim.DFC_ComMETE2Chksum_CA DINH_Lim.DFC_ComMETE2RingCnt_CA DINH_Lim.DFC_ComMETE2TOut_CA DINH_Lim.DFC_ComMETFChksum_CA DINH_Lim.DFC_ComMETFRingCnt_CA DINH_Lim.DFC_ComMETFTOut_CA DINH_Lim.DFC_ComMETGChksum_CA DINH_Lim.DFC_ComMETGRingCnt_CA DINH_Lim.DFC_ComMETGTOut_CA DINH_Lim.DFC_ComMETH2Chksum_CA DINH_Lim.DFC_ComMETH2RingCnt_CA DINH_Lim.DFC_ComMETH2TOut_CA DINH_Lim.DFC_ComMETHChksum_CA DINH_Lim.DFC_ComMETHRingCnt_CA DINH_Lim.DFC_ComMETHTOut_CA DINH_Lim.DFC_ComMETIChksum_CA DINH_Lim.DFC_ComMETIRingCnt_CA DINH_Lim.DFC_ComMETITOut_CA DINH_Lim.DFC_ComMETKChksum_CA DINH_Lim.DFC_ComMETKRingCnt_CA DINH_Lim.DFC_ComMETKTOut_CA DINH_Lim.DFC_ComMETLChksum_CA DINH_Lim.DFC_ComMETLRingCnt_CA DINH_Lim.DFC_ComMETLTOut_CA DINH_Lim.DFC_ComMETMChksum_CA DINH_Lim.DFC_ComMETMRingCnt_CA DINH_Lim.DFC_ComMETMTOut_CA DINH_Lim.DFC_ComMETNChksum_CA DINH_Lim.DFC_ComMETNRingCnt_CA DINH_Lim.DFC_ComMETNTOut_CA DINH_Lim.DFC_ComMtrCom_CA DINH_Lim.DFC_ComPCUChkSum_CA DINH_Lim.DFC_ComPCURingCnt_CA DINH_Lim.DFC_ComPCUTOut_CA DINH_Lim.DFC_ComSRSAChksum_CA DINH_Lim.DFC_ComSRSARingCnt_CA DINH_Lim.DFC_ComSRSATOut_CA DINH_Lim.DFC_ComSRSBChksum_CA DINH_Lim.DFC_ComSRSBRingCnt_CA DINH_Lim.DFC_ComSRSBTOut_CA DINH_Lim.DFC_ComSRSChksum_CA DINH_Lim.DFC_ComSRSErr_CA DINH_Lim.DFC_ComSRSRingCnt_CA DINH_Lim.DFC_ComSRSTOut_CA DINH_Lim.DFC_ComVehSpdPndFltTCU_CA DINH_Lim.DFC_EbsChartcCurrErr_CA DINH_Lim.DFC_EbsSelfDiagErr_CA DINH_Lim.DFC_GbxCANDigPlausErr_CA DINH_Lim.DFC_GbxNPos1SRCMax_CA DINH_Lim.DFC_GbxNPos1SRCMin_CA DINH_Lim.DFC_GbxNPos2SRCMax_CA DINH_Lim.DFC_GbxNPos2SRCMin_CA DINH_Lim.DFC_GbxNPosAlvChk_CA DINH_Lim.DFC_GbxNPosSyncErr_CA DINH_Lim.DFC_HEGOS2B1HtrPsMax_CA DINH_Lim.DFC_HEGOS2B1HtrPsMin_CA DINH_Lim.DFC_HEGOS2B1HtrPsSig_CA DINH_Lim.DFC_LinCSErrACG_CA DINH_Lim.DFC_LinCSErrEBS_CA DINH_Lim.DFC_LinHdrTimeoutErrACG_CA DINH_Lim.DFC_LinHdrTimeoutErrEBS_CA DINH_Lim.DFC_LinMsgTimeoutErrACG_CA DINH_Lim.DFC_LinMsgTimeoutErrEBS_CA DINH_Lim.DFC_LinNoStrtComErr_CA DINH_Lim.DFC_MisfDetVWhlFrntLeOORHi_CA DINH_Lim.DFC_MisfDetVWhlFrntLeRatyHi_CA DINH_Lim.DFC_MisfDetVWhlFrntLeRatyLo_CA DINH_Lim.DFC_MisfDetVWhlFrntLeStuck_CA DINH_Lim.DFC_MisfDetVWhlFrntRiOORHi_CA DINH_Lim.DFC_MisfDetVWhlFrntRiRatyHi_CA DINH_Lim.DFC_MisfDetVWhlFrntRiRatyLo_CA DINH_Lim.DFC_MisfDetVWhlFrntRiStuck_CA DINH_Lim.DFC_MisfDetVWhlReLeOORHi_CA DINH_Lim.DFC_MisfDetVWhlReLeRatyHi_CA DINH_Lim.DFC_MisfDetVWhlReLeRatyLo_CA DINH_Lim.DFC_MisfDetVWhlReLeStuck_CA DINH_Lim.DFC_MisfDetVWhlReRiOORHi_CA DINH_Lim.DFC_MisfDetVWhlReRiRatyHi_CA DINH_Lim.DFC_MisfDetVWhlReRiRatyLo_CA DINH_Lim.DFC_MisfDetVWhlReRiStuck_CA DINH_Lim.DFC_MisfDetdVWhlFrntLePlaus_CA DINH_Lim.DFC_MisfDetdVWhlFrntRiPlaus_CA DINH_Lim.DFC_MisfDetdVWhlReLePlaus_CA DINH_Lim.DFC_MisfDetdVWhlReRiPlaus_CA DINH_Lim.DFC_PEnvSigRngMax_CA DINH_Lim.DFC_PEnvSigRngMin_CA DINH_Lim.DFC_StmFault_CA DINH_Lim.DFC_StrtCtOffPth_CA DINH_Lim.DFC_StrtCtlErr_CA DINH_Lim.DFC_StrtFault_CA DINH_Lim.DFC_StrtLckJudg1_CA DINH_Lim.DFC_StrtLckJudg2_CA DINH_Lim.DFC_StrtOL_CA DINH_Lim.DFC_StrtOL2_CA DINH_Lim.DFC_StrtSCB_CA DINH_Lim.DFC_StrtSCB2_CA DINH_Lim.DFC_StrtSCG_CA DINH_Lim.DFC_StrtSCG2_CA DINH_Lim.DFC_StrtStkRly1_CA DINH_Lim.DFC_StrtStkRly2_CA DINH_Lim.DFC_TEVEmax_CA DINH_Lim.DFC_TEVEmin_CA DINH_Lim.DFC_TEVEsig_CA DINH_Lim.DFC_VehVAllPlaus_CA DINH_Lim.DFC_VehVNCSnsrElecFailr_CA DINH_Lim.DFC_VehVPlausCan_CA DINH_Lim.DFC_VehVPlausFco_CA DINH_Lim.DFC_VehVPlausPwr_CA DINH_Lim.DFC_VehVPlausV2N_CA DINH_Lim.DFC_VehVSpdSnsrAElecFailr_CA DINH_Lim.DFC_VehVSpdSnsrBElecFailr_CA DINH_Lim.DFC_ClthMax_CA DINH_Lim.DFC_IgnClPs_DevComErr_CA DINH_Lim.DFC_IgnClPs_LineOl_0_CA DINH_Lim.DFC_IgnClPs_LineOl_1_CA DINH_Lim.DFC_IgnClPs_LineOl_2_CA DINH_Lim.DFC_IgnClPs_LineOl_3_CA DINH_Lim.DFC_IgnClPs_LineScb_0_CA DINH_Lim.DFC_IgnClPs_LineScb_1_CA DINH_Lim.DFC_IgnClPs_LineScb_2_CA DINH_Lim.DFC_IgnClPs_LineScb_3_CA DINH_Lim.DFC_IgnClPs_LineScg_0_CA DINH_Lim.DFC_IgnClPs_LineScg_1_CA DINH_Lim.DFC_IgnClPs_LineScg_2_CA DINH_Lim.DFC_IgnClPs_LineScg_3_CA DINH_Lim.DFC_UEGOASICS1B1_CA DINH_Lim.DFC_UEGOOLIPES1B1_CA DINH_Lim.DFC_UEGOOLRES1B1_CA DINH_Lim.DFC_UEGOSCBS1B1_CA DINH_Lim.DFC_UEGOSCGS1B1_CA DINH_Lim.DFC_UEGOSPIS1B1_CA DINH_Lim.DFC_UEGOSnsrS1B1_CA DINH_Lim.DFC_UegoOlApesS1B1_CA DINH_Lim.DFC_UegoOlRCmpS1B1_CA DINH_Lim.DFC_AirCCmprOL_CA DINH_Lim.DFC_AirCCmprOvrTemp_CA DINH_Lim.DFC_AirCCmprSCB_CA DINH_Lim.DFC_AirCCmprSCG_CA DINH_Lim.DFC_AltErr_CA DINH_Lim.DFC_BattUSRCMax_CA DINH_Lim.DFC_BattUSRCMin_CA DINH_Lim.DFC_ComChksTCU1_CA DINH_Lim.DFC_ComChksTCU11_CA DINH_Lim.DFC_ComChksTCU12_CA DINH_Lim.DFC_ComChksTCU13_CA DINH_Lim.DFC_ComChksTCU2_CA DINH_Lim.DFC_ComChksTCU3_CA DINH_Lim.DFC_ComChksTCU4_CA DINH_Lim.DFC_ComCntTCU1_CA DINH_Lim.DFC_ComCntTCU11_CA DINH_Lim.DFC_ComCntTCU12_CA DINH_Lim.DFC_ComCntTCU13_CA DINH_Lim.DFC_ComCntTCU2_CA DINH_Lim.DFC_ComCntTCU3_CA DINH_Lim.DFC_ComCntTCU4_CA DINH_Lim.DFC_ComTOutTCU01_CA DINH_Lim.DFC_ComTOutTCU02_CA DINH_Lim.DFC_ComTOutTCU1_CA DINH_Lim.DFC_ComTOutTCU11_CA DINH_Lim.DFC_ComTOutTCU12_CA DINH_Lim.DFC_ComTOutTCU13_CA DINH_Lim.DFC_ComTOutTCU14_CA DINH_Lim.DFC_ComTOutTCU2_CA DINH_Lim.DFC_ComTOutTCU3_CA DINH_Lim.DFC_ComTOutTCU4_CA DINH_Lim.DFC_DevLibBattUHi_CA DINH_Lim.DFC_DevLibBattULo_CA DINH_Lim.DFC_FanDIOOL_0_CA DINH_Lim.DFC_FanDIOOL_1_CA DINH_Lim.DFC_FanDIOOvrTemp_0_CA DINH_Lim.DFC_FanDIOOvrTemp_1_CA DINH_Lim.DFC_FanDIOSCB_0_CA DINH_Lim.DFC_FanDIOSCB_1_CA DINH_Lim.DFC_FanDIOSCG_0_CA DINH_Lim.DFC_FanDIOSCG_1_CA DINH_Lim.DFC_MRlyDcOL_CA DINH_Lim.DFC_MRlyDcSCB_CA DINH_Lim.DFC_MRlyDcSCG_CA DINH_Lim.DFC_PSPOL_CA DINH_Lim.DFC_PSPOvrTemp_CA DINH_Lim.DFC_PSPSCB_CA DINH_Lim.DFC_PSPSCG_CA DINH_Lim.DFC_T50Err_CA DINH_Lim.DFC_ThrVlvLoBattB1_CA DINH_Lim.DFC_VehVPhysRngHi_CA DINH_Lim.DFC_VehVSclOutOL_CA DINH_Lim.DFC_VehVSclOutOT_CA DINH_Lim.DFC_VehVSclOutSCB_CA DINH_Lim.DFC_VehVSclOutSCG_CA DINH_Lim.DFC_VehVSnsrARngHi_CA DINH_Lim.DFC_VehVSnsrBRngHi_CA DINH_Lim.DFC_VehVSpdRtyDiag_CA DINH_Lim.DFC_VehVWhlErr_CA DINH_Lim.DFC_ACEvpTSRCMax_CA DINH_Lim.DFC_ACEvpTSRCMin_CA DINH_Lim.DFC_AirCClntPAnaSRCMax_CA DINH_Lim.DFC_AirCClntPAnaSRCMin_CA DINH_Lim.DFC_AirCSwtNpl_CA DINH_Lim.DFC_AirCSwtSig_CA DINH_Lim.DFC_Brk_CA DINH_Lim.DFC_BrkSig_CA DINH_Lim.DFC_ClthSig_CA DINH_Lim.DFC_HLSDemOvhtEngLim_CA DINH_Lim.DFC_OilPNpl_CA DINH_Lim.DFC_PIntkVUsLineHiB1_CA DINH_Lim.DFC_PIntkVUsLineLoB1_CA DINH_Lim.DFC_VehVPhysRngLo_CA DINH_Lim.DFC_VehVSigCan_CA DINH_Lim.DFC_VehVSigCanSafe_CA DINH_Lim.DFC_VlvLftFbOilPSnsrIntk11SRCMax_CA DINH_Lim.DFC_VlvLftFbOilPSnsrIntk11SRCMin_CA DINH_Lim.DFC_ClthNpl_CA DINH_Lim.DFC_EV1max_CA DINH_Lim.DFC_EV1min_CA DINH_Lim.DFC_EV1sig_CA DINH_Lim.DFC_EV2max_CA DINH_Lim.DFC_EV2min_CA DINH_Lim.DFC_EV2sig_CA DINH_Lim.DFC_EV3max_CA DINH_Lim.DFC_EV3min_CA DINH_Lim.DFC_EV3sig_CA DINH_Lim.DFC_EV4max_CA DINH_Lim.DFC_EV4min_CA DINH_Lim.DFC_EV4sig_CA DINH_Lim.DFC_GbxPNPosnDrvCdn_CA DINH_Lim.DFC_GbxPNPosnPlausy_CA DINH_Lim.DFC_PEnvCcMax_CA DINH_Lim.DFC_PEnvCcMin_CA DINH_Lim.DFC_PEnvRngChkMax_CA DINH_Lim.DFC_PEnvRngChkMin_CA DINH_Lim.DFC_PEnvSnsrPlaus_CA DINH_Lim.DFC_UEGOHeatrPsS1B1Max_CA DINH_Lim.DFC_UEGOHeatrPsS1B1Min_CA DINH_Lim.DFC_UEGOHeatrPsS1B1Sig_CA DINH_Lim.DFC_UEGOHeatrRlyPsOLS1B1_CA DINH_Lim.DFC_UEGOHeatrRlyPsSCBS1B1_CA DINH_Lim.DFC_UEGOHeatrRlyPsSCGS1B1_CA DINH_Lim.DFC_KnDetSens1PortAMax_CA DINH_Lim.DFC_KnDetSens1PortAMin_CA DINH_Lim.DFC_KnDetSens1PortBMax_CA DINH_Lim.DFC_KnDetSens1PortBMin_CA DINH_Lim.DFC_Clth2ONStuck_CA DINH_Lim.DFC_Clth2ONStuckLdc_CA DINH_Lim.DFC_Clth3ONStuckLdc_CA DINH_Lim.DFC_Clth3ONStuckPostDrv_CA DINH_Lim.DFC_Clth4ONStuck_CA DINH_Lim.DFC_Clth4ONStuckLdc_CA DINH_Lim.DFC_ComDLCTCU01_CA DINH_Lim.DFC_ComDLCTCU02_CA DINH_Lim.DFC_ComDLCTCU1_CA DINH_Lim.DFC_ComDLCTCU11_CA DINH_Lim.DFC_ComDLCTCU12_CA DINH_Lim.DFC_ComDLCTCU13_CA DINH_Lim.DFC_ComDLCTCU14_CA DINH_Lim.DFC_ComDLCTCU2_CA DINH_Lim.DFC_ComDLCTCU3_CA DINH_Lim.DFC_ComDLCTCU4_CA DINH_Lim.DFC_EVX_CA DINH_Lim.DFC_EbsSocFlt_CA DINH_Lim.DFC_I14229VINErr_CA DINH_Lim.DFC_LLRKHmax_CA DINH_Lim.DFC_LLRKHmin_CA DINH_Lim.DFC_LLRmax_CA DINH_Lim.DFC_LLRmin_CA DINH_Lim.DFC_RoughRoad_CA DINH_Lim.DFC_SiaEEPRdErr_CA DINH_Lim.DFC_SiaEEPWrngCod_CA DINH_Lim.DFC_UegoDummy_CA DINH_Lim.DFC_BusDiagCANAPPLBusOff_CA DINH_Lim.DFC_BusDiagCANCANCBusOff_CA DINH_Lim.DFC_BusDiagCANVEHICLEBusOff_CA DINH_Lim.DFC_RBA_IODIAGPWR_rba_IoExtCy329_SignalVltSply_0_CA DINH_Lim.DFC_RBA_IODIAGPWR_rba_IoExtCy329_SignalVltSply_0OT_CA DINH_Lim.DFC_RBA_IODIAGPWR_rba_IoExtCy329_SignalVltSply_0OV_CA DINH_Lim.DFC_RBA_IODIAGPWR_rba_IoExtCy329_SignalVltSply_0SCG_CA DINH_Lim.DFC_RBA_IODIAGPWR_rba_IoExtCy329_SignalVltSply_0UV_CA DINH_Lim.DFC_RBA_IODIAGPWR_rba_IoExtCy329_SignalVltSply_1_CA DINH_Lim.DFC_RBA_IODIAGPWR_rba_IoExtCy329_SignalVltSply_1OT_CA DINH_Lim.DFC_RBA_IODIAGPWR_rba_IoExtCy329_SignalVltSply_1OV_CA DINH_Lim.DFC_RBA_IODIAGPWR_rba_IoExtCy329_SignalVltSply_1SCG_CA DINH_Lim.DFC_RBA_IODIAGPWR_rba_IoExtCy329_SignalVltSply_1UV_CA DINH_Lim.DFC_RBA_IODIAGPWR_rba_IoExtCy329_SignalVltSply_2_CA DINH_Lim.DFC_RBA_IODIAGPWR_rba_IoExtCy329_SignalVltSply_2OT_CA DINH_Lim.DFC_RBA_IODIAGPWR_rba_IoExtCy329_SignalVltSply_2OV_CA DINH_Lim.DFC_RBA_IODIAGPWR_rba_IoExtCy329_SignalVltSply_2SCG_CA DINH_Lim.DFC_RBA_IODIAGPWR_rba_IoExtCy329_SignalVltSply_2UV_CA DINH_Lim.DFC_CAN_E_TIMEOUT_CA DINH_Lim.DFC_LIN_E_TIMEOUT_CA DINH_Lim.DFC_MRlyOL_CA DINH_Lim.DFC_MRlySCB_CA DINH_Lim.DFC_MRlySCG_CA DINH_Lim.DFC_rba_MultiStackTrace_Threshold_CA DINH_Lim.DFC_BSWM_E_ACTION_FAILED_CA DINH_Lim.DFC_BSWM_E_INTRPTQUEUE_FULL_CA DINH_Lim.DFC_RBA_IOEXTLIB_KEEPALIVE_DRV_CA DINH_Lim.DFC_RBA_IOEXTLIB_KEEPALIVE_INI_CA DINH_Lim.DFC_rba_IoSigRtc_StopCounter_CA DINH_Lim.DFC_rba_MRly_Diag_Stk_Event_CA DINH_Lim.DFC_rba_MemDiag_MemReadErr_CA DINH_Lim.DFC_rba_MemDiag_MemWrErr_CA DINH_Lim.DFC_rba_SyC_IrrSwOffTrigEngRun_Event_CA DINH_Lim.DFC_rba_T15_Diag_ComInVld_Event_CA DINH_Lim.DFC_rba_T15_Diag_ComOff_HwOn_Event_CA DINH_Lim.DFC_rba_T15_Diag_ComOn_HwOff_Event_CA DINH_Lim.DFC_AppAllSnsrDfct_CA DINH_Lim.DFC_BattUStdbyDiaOL_CA DINH_Lim.DFC_BigLeakIntkMnfldEmiInfl_CA DINH_Lim.DFC_BrkMnSwtContOnWarnLmp_CA DINH_Lim.DFC_BrkMnSwtNotStpWarnLmp_CA DINH_Lim.DFC_BrkRdntSwtContOnWarnLmp_CA DINH_Lim.DFC_BrkRdntSwtNotStpWarnLmp_CA DINH_Lim.DFC_CEngDsTColdStrtMax_CA DINH_Lim.DFC_CEngDsTColdStrtMin_CA DINH_Lim.DFC_CEngDsTImps_CA DINH_Lim.DFC_CEngDsTPlausLSC_CA DINH_Lim.DFC_CEngDsTPlausSTC_CA DINH_Lim.DFC_CEngDsTSRCMax_CA DINH_Lim.DFC_CEngDsTSRCMin_CA DINH_Lim.DFC_CEngDsTSig_CA DINH_Lim.DFC_CEngUsTSRCMax_CA DINH_Lim.DFC_CEngUsTSRCMin_CA DINH_Lim.DFC_DCDCFltDet_CA DINH_Lim.DFC_DKRSA_CA DINH_Lim.DFC_DKVSmax_CA DINH_Lim.DFC_DKnpl_CA DINH_Lim.DFC_DSSmax_CA DINH_Lim.DFC_DSTTI_CA DINH_Lim.DFC_DSUmax_CA DINH_Lim.DFC_EGRVlvOL_CA DINH_Lim.DFC_EGRVlvSCB_CA DINH_Lim.DFC_EGRVlvSCG_CA DINH_Lim.DFC_EGSDUS2B1LtrDly_CA DINH_Lim.DFC_EGSDUS2B1LtrPT1_CA DINH_Lim.DFC_EGSDUS2B1RtlDly_CA DINH_Lim.DFC_EGSDUS2B1RtlPT1_CA DINH_Lim.DFC_EGSDUS2B1TarLean_CA DINH_Lim.DFC_EGSDUS2B1TarRich_CA DINH_Lim.DFC_ETAKHLmax_CA DINH_Lim.DFC_ETAKHTmax_CA DINH_Lim.DFC_EngICO_CA DINH_Lim.DFC_EngPrtOvrSpdMon_CA DINH_Lim.DFC_EpmCaSI1ErrSig_CA DINH_Lim.DFC_EpmCaSI1NoSig_CA DINH_Lim.DFC_EpmCaSI1OfsErr_CA DINH_Lim.DFC_EpmCrSErrSig_CA DINH_Lim.DFC_EpmCrSNoSig_CA DINH_Lim.DFC_EtaEngIdleNonCsers_CA DINH_Lim.DFC_EtaEngPtlNonCsers_CA DINH_Lim.DFC_FRAmax_CA DINH_Lim.DFC_FRAmin_CA DINH_Lim.DFC_GbxRvsSwtStk_CA DINH_Lim.DFC_HDRmax_CA DINH_Lim.DFC_HEGOS2B1ElecMax_CA DINH_Lim.DFC_HEGOS2B1ElecMin_CA DINH_Lim.DFC_HEGOS2B1ElecSig_CA DINH_Lim.DFC_HEGOS2B1HtgNpl_CA DINH_Lim.DFC_IntkAirTIntkMnfldCrssMax_CA DINH_Lim.DFC_IntkAirTIntkMnfldCrssMin_CA DINH_Lim.DFC_IntkAirTIntkMnfldHSCMax_CA DINH_Lim.DFC_IntkAirTIntkMnfldImps_CA DINH_Lim.DFC_IntkAirTIntkMnfldPRCMax_CA DINH_Lim.DFC_IntkAirTIntkMnfldPRCMin_CA DINH_Lim.DFC_IntkAirTIntkMnfldSRCMax_CA DINH_Lim.DFC_IntkAirTIntkMnfldSRCMin_CA DINH_Lim.DFC_IntkAirTIntkMnfldSTC_CA DINH_Lim.DFC_KS1max_CA DINH_Lim.DFC_KS1min_CA DINH_Lim.DFC_LMmax_CA DINH_Lim.DFC_LZSRnpl_CA DINH_Lim.DFC_LamDynDiagS1B1_CA DINH_Lim.DFC_LeakIntkMnfldEmiInfl_CA DINH_Lim.DFC_MD00max_CA DINH_Lim.DFC_MDBmax_CA DINH_Lim.DFC_MDCat_CA DINH_Lim.DFC_MDCatCrit_CA DINH_Lim.DFC_MDCatCurr_CA DINH_Lim.DFC_MDCyl_0_CA DINH_Lim.DFC_MDCyl_1_CA DINH_Lim.DFC_MDCyl_2_CA DINH_Lim.DFC_MDCyl_3_CA DINH_Lim.DFC_MDEmi_CA DINH_Lim.DFC_MDEmiStrt_CA DINH_Lim.DFC_MDFco_CA DINH_Lim.DFC_MDMpl_CA DINH_Lim.DFC_MDSegTiAdpn_CA DINH_Lim.DFC_MDmax_CA DINH_Lim.DFC_MOXEMM_SMU_ALM0_0_CA DINH_Lim.DFC_MOXEMM_SMU_ALM0_1_CA DINH_Lim.DFC_MOXEMM_SMU_ALM0_10_CA DINH_Lim.DFC_MOXEMM_SMU_ALM0_11_CA DINH_Lim.DFC_MOXEMM_SMU_ALM0_13_CA DINH_Lim.DFC_MOXEMM_SMU_ALM0_14_CA DINH_Lim.DFC_MOXEMM_SMU_ALM0_2_CA DINH_Lim.DFC_MOXEMM_SMU_ALM0_22_CA DINH_Lim.DFC_MOXEMM_SMU_ALM0_23_CA DINH_Lim.DFC_MOXEMM_SMU_ALM0_4_CA DINH_Lim.DFC_MOXEMM_SMU_ALM0_5_CA DINH_Lim.DFC_MOXEMM_SMU_ALM0_7_CA DINH_Lim.DFC_MOXEMM_SMU_ALM0_8_CA DINH_Lim.DFC_MOXEMM_SMU_ALM10_16_CA DINH_Lim.DFC_MOXEMM_SMU_ALM10_17_CA DINH_Lim.DFC_MOXEMM_SMU_ALM10_21_CA DINH_Lim.DFC_MOXEMM_SMU_ALM11_0_CA DINH_Lim.DFC_MOXEMM_SMU_ALM11_1_CA DINH_Lim.DFC_MOXEMM_SMU_ALM11_2_CA DINH_Lim.DFC_MOXEMM_SMU_ALM11_3_CA DINH_Lim.DFC_MOXEMM_SMU_ALM11_4_CA DINH_Lim.DFC_MOXEMM_SMU_ALM11_5_CA DINH_Lim.DFC_MOXEMM_SMU_ALM11_8_CA DINH_Lim.DFC_MOXEMM_SMU_ALM11_9_CA DINH_Lim.DFC_MOXEMM_SMU_ALM1_0_CA DINH_Lim.DFC_MOXEMM_SMU_ALM1_1_CA DINH_Lim.DFC_MOXEMM_SMU_ALM1_10_CA DINH_Lim.DFC_MOXEMM_SMU_ALM1_11_CA DINH_Lim.DFC_MOXEMM_SMU_ALM1_13_CA DINH_Lim.DFC_MOXEMM_SMU_ALM1_14_CA DINH_Lim.DFC_MOXEMM_SMU_ALM1_2_CA DINH_Lim.DFC_MOXEMM_SMU_ALM1_22_CA DINH_Lim.DFC_MOXEMM_SMU_ALM1_23_CA DINH_Lim.DFC_MOXEMM_SMU_ALM1_4_CA DINH_Lim.DFC_MOXEMM_SMU_ALM1_5_CA DINH_Lim.DFC_MOXEMM_SMU_ALM1_7_CA DINH_Lim.DFC_MOXEMM_SMU_ALM1_8_CA DINH_Lim.DFC_MOXEMM_SMU_ALM21_0_CA DINH_Lim.DFC_MOXEMM_SMU_ALM21_16_CA DINH_Lim.DFC_MOXEMM_SMU_ALM21_3_CA DINH_Lim.DFC_MOXEMM_SMU_ALM2_1_CA DINH_Lim.DFC_MOXEMM_SMU_ALM2_10_CA DINH_Lim.DFC_MOXEMM_SMU_ALM2_11_CA DINH_Lim.DFC_MOXEMM_SMU_ALM2_13_CA DINH_Lim.DFC_MOXEMM_SMU_ALM2_14_CA DINH_Lim.DFC_MOXEMM_SMU_ALM2_22_CA DINH_Lim.DFC_MOXEMM_SMU_ALM2_23_CA DINH_Lim.DFC_MOXEMM_SMU_ALM2_4_CA DINH_Lim.DFC_MOXEMM_SMU_ALM2_5_CA DINH_Lim.DFC_MOXEMM_SMU_ALM2_7_CA DINH_Lim.DFC_MOXEMM_SMU_ALM2_8_CA DINH_Lim.DFC_MOXEMM_SMU_ALM6_0_CA DINH_Lim.DFC_MOXEMM_SMU_ALM6_11_CA DINH_Lim.DFC_MOXEMM_SMU_ALM6_12_CA DINH_Lim.DFC_MOXEMM_SMU_ALM6_14_CA DINH_Lim.DFC_MOXEMM_SMU_ALM6_15_CA DINH_Lim.DFC_MOXEMM_SMU_ALM6_17_CA DINH_Lim.DFC_MOXEMM_SMU_ALM6_18_CA DINH_Lim.DFC_MOXEMM_SMU_ALM6_20_CA DINH_Lim.DFC_MOXEMM_SMU_ALM6_21_CA DINH_Lim.DFC_MOXEMM_SMU_ALM6_25_CA DINH_Lim.DFC_MOXEMM_SMU_ALM6_4_CA DINH_Lim.DFC_MOXEMM_SMU_ALM6_5_CA DINH_Lim.DFC_MOXEMM_SMU_ALM6_7_CA DINH_Lim.DFC_MOXEMM_SMU_ALM6_8_CA DINH_Lim.DFC_MOXEMM_SMU_ALM7_1_CA DINH_Lim.DFC_MOXEMM_SMU_ALM7_12_CA DINH_Lim.DFC_MOXEMM_SMU_ALM7_13_CA DINH_Lim.DFC_MOXEMM_SMU_ALM7_14_CA DINH_Lim.DFC_MOXEMM_SMU_ALM7_15_CA DINH_Lim.DFC_MOXEMM_SMU_ALM7_16_CA DINH_Lim.DFC_MOXEMM_SMU_ALM7_17_CA DINH_Lim.DFC_MOXEMM_SMU_ALM7_2_CA DINH_Lim.DFC_MOXEMM_SMU_ALM7_20_CA DINH_Lim.DFC_MOXEMM_SMU_ALM7_25_CA DINH_Lim.DFC_MOXEMM_SMU_ALM7_26_CA DINH_Lim.DFC_MOXEMM_SMU_ALM7_28_CA DINH_Lim.DFC_MOXEMM_SMU_ALM7_29_CA DINH_Lim.DFC_MOXEMM_SMU_ALM7_30_CA DINH_Lim.DFC_MOXEMM_SMU_ALM7_31_CA DINH_Lim.DFC_MOXEMM_SMU_ALM8_0_CA DINH_Lim.DFC_MOXEMM_SMU_ALM8_1_CA DINH_Lim.DFC_MOXEMM_SMU_ALM8_10_CA DINH_Lim.DFC_MOXEMM_SMU_ALM8_11_CA DINH_Lim.DFC_MOXEMM_SMU_ALM8_12_CA DINH_Lim.DFC_MOXEMM_SMU_ALM8_16_CA DINH_Lim.DFC_MOXEMM_SMU_ALM8_18_CA DINH_Lim.DFC_MOXEMM_SMU_ALM8_2_CA DINH_Lim.DFC_MOXEMM_SMU_ALM8_3_CA DINH_Lim.DFC_MOXEMM_SMU_ALM8_31_CA DINH_Lim.DFC_MOXEMM_SMU_ALM8_4_CA DINH_Lim.DFC_MOXEMM_SMU_ALM9_0_CA DINH_Lim.DFC_MOXEMM_SMU_ALM9_15_CA DINH_Lim.DFC_MOXEMM_SMU_ALM9_3_CA DINH_Lim.DFC_MoCADCNTP_CA DINH_Lim.DFC_MoCADCTst_CA DINH_Lim.DFC_MoCSOPICO_CA DINH_Lim.DFC_MoFAPP_CA DINH_Lim.DFC_MoFAirFilgPrdc_CA DINH_Lim.DFC_MoFAirFlCtOffPfi_CA DINH_Lim.DFC_MoFAirFlCylPfi_CA DINH_Lim.DFC_MoFAirFlIn_CA DINH_Lim.DFC_MoFAirFlMixCtlPfiChkAirFl_CA DINH_Lim.DFC_MoFAirFlMixCtlPfiChkCtrl_CA DINH_Lim.DFC_MoFAirFlMode_CA DINH_Lim.DFC_MoFESpd_CA DINH_Lim.DFC_MoFIACo_CA DINH_Lim.DFC_MoFICOL1_CA DINH_Lim.DFC_MoFICOL2_CA DINH_Lim.DFC_MoFStrt_CA DINH_Lim.DFC_MoFTrqCmp_CA DINH_Lim.DFC_MoFTrqCmpMax_CA DINH_Lim.DFC_MoFTrqCmpMin_CA DINH_Lim.DFC_MoFVarPostBldSel_CA DINH_Lim.DFC_MoXEMMHwLTMCUFW_CA DINH_Lim.DFC_MoXEMMHwLTMonBIST_CA DINH_Lim.DFC_MoXEMMHwLTRegMonTest_CA DINH_Lim.DFC_MoXEMMHwLTStbySMUAlvTest_CA DINH_Lim.DFC_MoXEMMHwLTTempSens_CA DINH_Lim.DFC_MoXEMMHwLTUCBCfg_CA DINH_Lim.DFC_OCWDAABEActv_CA DINH_Lim.DFC_OCWDACom_CA DINH_Lim.DFC_OCWDAErrPin_CA DINH_Lim.DFC_OCWDAOvrVltg_CA DINH_Lim.DFC_ORAmax_CA DINH_Lim.DFC_ORAmin_CA DINH_Lim.DFC_PLLSUmax_CA DINH_Lim.DFC_PLLSUmin_CA DINH_Lim.DFC_PSR1max_CA DINH_Lim.DFC_PSRBmax_CA DINH_Lim.DFC_PSRBmin_CA DINH_Lim.DFC_PSRPmax_CA DINH_Lim.DFC_PSRPmin_CA DINH_Lim.DFC_PSRPsig_CA DINH_Lim.DFC_PSRmax_CA DINH_Lim.DFC_PUmax_CA DINH_Lim.DFC_P_VSE11_OL_CA DINH_Lim.DFC_P_VSE11_SCB_CA DINH_Lim.DFC_P_VSE11_SCG_CA DINH_Lim.DFC_PhyHighAPP1_CA DINH_Lim.DFC_PhyHighAPP2_CA DINH_Lim.DFC_PhyLowAPP1_CA DINH_Lim.DFC_PhyLowAPP2_CA DINH_Lim.DFC_SRCHighAPP1_CA DINH_Lim.DFC_SRCHighAPP2_CA DINH_Lim.DFC_SRCLowAPP1_CA DINH_Lim.DFC_SRCLowAPP2_CA DINH_Lim.DFC_SSpMon2_CA DINH_Lim.DFC_SWReset_0_CA DINH_Lim.DFC_SWReset_1_CA DINH_Lim.DFC_SWReset_2_CA DINH_Lim.DFC_SyncAPP_CA DINH_Lim.DFC_TAmax_Dummy_CA DINH_Lim.DFC_TKAEmax_CA DINH_Lim.DFC_TKAEmin_CA DINH_Lim.DFC_TKARmax_CA DINH_Lim.DFC_TKARnpl_CA DINH_Lim.DFC_TMmax_Dummy_CA DINH_Lim.DFC_TUMmax_Dummy_CA DINH_Lim.DFC_TWCDPriCatB1_CA DINH_Lim.DFC_ThrVlvClsdPosnFirstOffsLrnImpoB1_CA DINH_Lim.DFC_ThrVlvClsdPosnOffsLrnImpoB1_CA DINH_Lim.DFC_ThrVlvClsdPosnOffsLrnMaxB1_CA DINH_Lim.DFC_ThrVlvClsdPosnOffsLrnMinB1_CA DINH_Lim.DFC_ThrVlvCtrlDeB1_CA DINH_Lim.DFC_ThrVlvDycB1_CA DINH_Lim.DFC_ThrVlvLimpAirPosnMaxAbsltDriftB1_CA DINH_Lim.DFC_ThrVlvLimpAirPosnMaxB1_CA DINH_Lim.DFC_ThrVlvLimpAirPosnMaxRelDriftB1_CA DINH_Lim.DFC_ThrVlvLimpAirPosnMinB1_CA DINH_Lim.DFC_ThrVlvOpenLoadB1_CA DINH_Lim.DFC_ThrVlvOpenSprgB1_CA DINH_Lim.DFC_ThrVlvOpenSprgSprdB1_CA DINH_Lim.DFC_ThrVlvOpenSprgTwnB1_CA DINH_Lim.DFC_ThrVlvOverTB1_CA DINH_Lim.DFC_ThrVlvRetSprgB1_CA DINH_Lim.DFC_ThrVlvRetSprgSprdB1_CA DINH_Lim.DFC_ThrVlvRetSprgTwnB1_CA DINH_Lim.DFC_ThrVlvSens1MaxB1_CA DINH_Lim.DFC_ThrVlvSens1NplB1_CA DINH_Lim.DFC_ThrVlvSens2MaxB1_CA DINH_Lim.DFC_ThrVlvSens2MinB1_CA DINH_Lim.DFC_ThrVlvSens2NplB1_CA DINH_Lim.DFC_ThrVlvShoCircB1_CA DINH_Lim.DFC_ThrVlvSpiErrB1_CA DINH_Lim.DFC_ThrvlvSens1MinB1_CA DINH_Lim.DFC_TiOffTBasdChkFast_CA DINH_Lim.DFC_TiOffTBasdChkSlow_CA DINH_Lim.DFC_UEGOHeatrCtlS1B1_CA DINH_Lim.DFC_UEGOSnsrMntdS1B1_CA DINH_Lim.DFC_VehVSig_CA DINH_Lim.DFC_VlvLftFbSwtIntk11SpclFail_CA DINH_Lim.DFC_VlvLftFbSwtIntk11StdFail_CA DINH_Lim.DSQ_ACClntP_CA DINH_Lim.DSQ_ACEvpT_CA DINH_Lim.DSQ_AirCCmprActr_CA DINH_Lim.DSQ_BattU_CA DINH_Lim.DSQ_BattULo_CA DINH_Lim.DSQ_CoVMDIDASFail_CA DINH_Lim.DSQ_DSMInhibitAlways_CA DINH_Lim.DSQ_ElecLd_CA DINH_Lim.DSQ_EngICO_CA DINH_Lim.DSQ_EpmCaSSigQuality_CA DINH_Lim.DSQ_EpmReverseRun_CA DINH_Lim.DSQ_FanDIO_0_CA DINH_Lim.DSQ_FanDIO_1_CA DINH_Lim.DSQ_FuelP_CA DINH_Lim.DSQ_FuelT_CA DINH_Lim.DSQ_GbxPNPos_CA /end DEF_CHARACTERISTIC
 FUNCTION_VERSION "30000.27.0_1.0.0" /end FUNCTION
/begin COMPU_METHOD DINH_LimDFCVerb "" TAB_VERB "%6.3" "-" COMPU_TAB_REF DINH_LimDFCVerb /end COMPU_METHOD
/begin COMPU_VTAB DINH_LimDFCVerb "" TAB_VERB 18 0 "No_Inhibit" 1 "Def50_Deb100" 2 "Def100_Deb100" 3 "Def50_Deb100_Tst" 4 "Def100_Deb100_Tst" 5 "Def50_Deb100_or_NTst" 6 "Def100_Deb100_or_NTst" 7 "Tested" 8 "NotTested" 9 "Def100_Deb0" 10 "Def50_Deb0" 11 "Def25_Deb0" 12 "Def0_Deb0" 13 "Def50_Deb100_Tst_Trip" 14 "Def100_Deb100_Tst_Trip" 15 "Def50_Deb100_MILOn" 16 "Def50_Deb100_Trip" 17 "Def100_Deb100_Trip" /end COMPU_VTAB
/begin COMPU_METHOD DINH_LimDSQVerb "" TAB_VERB "%6.3" "-" COMPU_TAB_REF DINH_LimDSQVerb /end COMPU_METHOD
/begin COMPU_VTAB DINH_LimDSQVerb "" TAB_VERB 17 0 "Qual_AllOk_0" 1 "Qual_1" 2 "Qual_Meas_2" 3 "Qual_PremFrozen_3" 4 "Qual_Model_4" 5 "Qual_5" 6 "Qual_6" 7 "Qual_7" 8 "Qual_Frozen_8" 9 "Qual_9" 10 "Qual_10" 11 "Qual_Tester_11" 12 "Qual_Default_12" 13 "Qual_13" 14 "Qual_14" 15 "Qual_Invalid_15" 16 "No_Inhibit" /end COMPU_VTAB
/begin RECORD_LAYOUT ValA_Wu8 FNC_VALUES 1 UBYTE COLUMN_DIR DIRECT /end RECORD_LAYOUT
/end MODULE
/end PROJECT
