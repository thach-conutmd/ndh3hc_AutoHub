ASAP2_VERSION 1 60
/begin PROJECT MG1CA020 "MG1CA020"
/begin HEADER "" VERSION "MG1CA020_6SAY_V011_TPROT" PROJECT_NO MG1CA020 /end HEADER
/begin MODULE DIM ""
/begin MOD_COMMON "" BYTE_ORDER MSB_LAST ALIGNMENT_BYTE 1 ALIGNMENT_WORD 2 ALIGNMENT_LONG 4 ALIGNMENT_INT64 4 ALIGNMENT_FLOAT32_IEEE 4 ALIGNMENT_FLOAT64_IEEE 4 DATA_SIZE 32 /end MOD_COMMON
/begin CHARACTERISTIC MoFAirFl_cntrComNEngDynMin_C "Correction expected value minimum count of syncs dependent on speed dynamics in function monitoring" VALUE 0x8053B786 Val_Wu8 255.0 OneToOne 0.00 255.0 FORMAT "%5.1" /end CHARACTERISTIC
/begin CHARACTERISTIC MoFAirFl_cntrErrDebMaxFilgPrdc_C "Max. allowed error debounce time in function MoFAir_FilgPrdc" VALUE 0x8053B79A Val_Wu8 255.0 OneToOne 0.00 255.0 FORMAT "%5.1" /end CHARACTERISTIC
/begin CHARACTERISTIC MoFAirFl_cntrErrDebMaxInCom_C "Max. allowed error debounce time in function MoFAirFl_In" VALUE 0x8053B787 Val_Wu8 255.0 OneToOne 0.00 255.0 FORMAT "%5.1" /end CHARACTERISTIC
/begin CHARACTERISTIC MoFAirFl_cntrErrDebMaxMixCtlPfiChkAirFl_C "Max. allowed error debounce time in function MoFAirFl_MixCtlPfi (AirFl)" VALUE 0x8053B78C Val_Wu8 255.0 OneToOne 0.00 255.0 FORMAT "%5.1" /end CHARACTERISTIC
/begin CHARACTERISTIC MoFAirFl_cntrErrDebMaxMixCtlPfiChkCtrl_C "Max. allowed error debounce time in function MoFAirFl_MixCtlPfi (Ctrl)" VALUE 0x8053B78D Val_Wu8 255.0 OneToOne 0.00 255.0 FORMAT "%5.1" /end CHARACTERISTIC
/begin CHARACTERISTIC MoFAirFl_cntrErrDebMaxMode_C "Max. allowed error debounce time in function MoFAirFl_Mode" VALUE 0x8053B796 Val_Wu8 255.0 OneToOne 0.00 255.0 FORMAT "%5.1" /end CHARACTERISTIC
/begin CHARACTERISTIC MoFAirFl_cntrFillgHiDeDlyMax_C "Max. allowed counter for high deviation of charge in function monitoring" VALUE 0x8053B79B Val_Wu8 255.0 OneToOne 0.00 255.0 FORMAT "%5.1" /end CHARACTERISTIC
/begin CHARACTERISTIC MoFAirFl_cntrRstMaxFilgPrdc_C "Maximum number of Pre-ICO-Resets in function MoFAirFl_FilgPrdc" VALUE 0x8053B79C Val_Wu8 255.0 OneToOne 0.00 255.0 FORMAT "%5.1" /end CHARACTERISTIC
/begin CHARACTERISTIC MoFAirFl_cntrRstMaxInCom_C "Maximum number of Pre-ICO-Resets in function MoFAirFl_In" VALUE 0x8053B788 Val_Wu8 255.0 OneToOne 0.00 255.0 FORMAT "%5.1" /end CHARACTERISTIC
/begin CHARACTERISTIC MoFAirFl_cntrRstMaxMixCtlPfiChkAirFl_C "Maximum number of Pre-ICO-Resets in function MoFAirFl_MixCtlPfi (AirFl)" VALUE 0x8053B78E Val_Wu8 255.0 OneToOne 0.00 255.0 FORMAT "%5.1" /end CHARACTERISTIC
/begin CHARACTERISTIC MoFAirFl_cntrRstMaxMixCtlPfiChkCtrl_C "Maximum number of Pre-ICO-Resets in function MoFAirFl_MixCtlPfi (Ctrl)" VALUE 0x8053B78F Val_Wu8 255.0 OneToOne 0.00 255.0 FORMAT "%5.1" /end CHARACTERISTIC
/begin CHARACTERISTIC MoFAirFl_cntrRstMaxMode_C "Maximum number of Pre-ICO-Resets in function MoFAirFl_Mode" VALUE 0x8053B797 Val_Wu8 255.0 OneToOne 0.00 255.0 FORMAT "%5.1" /end CHARACTERISTIC
/begin CHARACTERISTIC MoFAirFl_facAftStrtCorrnPfiMax_T "Maximum after-start adaption value in function monitoring (PFI)" CURVE 0x8053BE0A ValA_Wu16 63.99902 fak_uw_b64 0.00 63.99902 FORMAT "%8.5"
 /begin AXIS_DESCR COM_AXIS MoF_tEng temp_ub_q0p75_o48 8 -48.0 143.3 FORMAT "%5.1" AXIS_PTS_REF MoF_tEng_DST /end AXIS_DESCR
/end CHARACTERISTIC
/begin CHARACTERISTIC MoFAirFl_facBnkMaxPfi_C "Max. allowed distribution factor (bank selective) in function monitoring PFI path" VALUE 0x8053BE1A Val_Wu16 1.999969 fak_uw_b2 0.00 1.999969 FORMAT "%8.6" /end CHARACTERISTIC
/begin CHARACTERISTIC MoFAirFl_facBnkMinPfi_C "Min. allowed distribution factor (bank selective) in function monitoring PFI path" VALUE 0x8053BE1C Val_Wu16 1.999969 fak_uw_b2 0.00 1.999969 FORMAT "%8.6" /end CHARACTERISTIC
/begin CHARACTERISTIC MoFAirFl_facCnvnRatFillgMFlow_C "Factor conversion charge into mass flow in function monitoring" VALUE 0x8053B79D Val_Wu8 0.003984 q1p5625Em5_kg_DIV_h_min_pc 0.00 0.003984 FORMAT "%8.6" /end CHARACTERISTIC
/begin CHARACTERISTIC MoFAirFl_facLamAdpnMax_T "maximal permissible air-fuel-ratio adaption in monitoring function" CURVE 0x8053BE1E Mo_DataCurveSstU16WU16 1.999969 fak_uw_b2 0.00 1.999969 FORMAT "%8.6"
 /begin AXIS_DESCR STD_AXIS MoFAirFlMixCtlPfi_nEng nmot_q40 4 0.00 2621400. FORMAT "%8.0" DEPOSIT ABSOLUTE /end AXIS_DESCR
/end CHARACTERISTIC
/begin CHARACTERISTIC MoFAirFl_facLamCtrlMax_C "Max. allowed value lambda control in function monitoring" VALUE 0x8053BE30 Val_Wu16 1.999969 fak_uw_b2 0.00 1.999969 FORMAT "%8.6" /end CHARACTERISTIC
/begin CHARACTERISTIC MoFAirFl_facTolrChkCpv_C "Factor tolerance in check of canister purge in function monitoring" VALUE 0x8053BE32 Val_Ws16 1.999969 fak_sw_b1 -1.000000 0.999969 FORMAT "%8.6" EXTENDED_LIMITS -1.000000 0.9999695 /end CHARACTERISTIC
/begin CHARACTERISTIC MoFAirFl_facTolrRatFuMPfiChkMax_C "Factor maximum tolerance in check of bank selective fuel in function monitoring (PFI)" VALUE 0x8053B790 Val_Wu8 1.992188 fak_ub_b2 0.00 1.992188 FORMAT "%8.6" /end CHARACTERISTIC
/begin CHARACTERISTIC MoFAirFl_facTolrRatFuMPfiChkMin_C "Factor minimum tolerance in check of bank selective fuel in function monitoring (PFI)" VALUE 0x8053B791 Val_Wu8 1.992188 fak_ub_b2 0.00 1.992188 FORMAT "%8.6" /end CHARACTERISTIC
/begin CHARACTERISTIC MoFAirFl_nEngThdFuEvapChk_C "Speed threshold for the check of evaporating fuel in function monitoring" VALUE 0x8053B792 Val_Wu8 10200. nmot_q40 0.00 10200. FORMAT "%5.0" /end CHARACTERISTIC
/begin CHARACTERISTIC MoFAirFl_nErrHndlgActvnFilgPrdc_C "Engine speed threshold for activation of error handling in function MoFAir_FilgPrdc" VALUE 0x8053B79E Val_Wu8 10200. nmot_q40 0.00 10200. FORMAT "%5.0" /end CHARACTERISTIC
/begin CHARACTERISTIC MoFAirFl_nErrHndlgActvnInCom_C "Engine speed threshold for activation of error handling in function MoFAirFl_In" VALUE 0x8053B789 Val_Wu8 10200. nmot_q40 0.00 10200. FORMAT "%5.0" /end CHARACTERISTIC
/begin CHARACTERISTIC MoFAirFl_nErrHndlgActvnMixCtlPfi_C "Engine speed threshold for activation of error handling in function MoFAirFl_MixCtlPfi" VALUE 0x8053B793 Val_Wu8 10200. nmot_q40 0.00 10200. FORMAT "%5.0" /end CHARACTERISTIC
/begin CHARACTERISTIC MoFAirFl_nErrHndlgActvnMode_C "Engine speed threshold for activation of error handling in function MoFAirFl_Mode" VALUE 0x8053B798 Val_Wu8 10200. nmot_q40 0.00 10200. FORMAT "%5.0" /end CHARACTERISTIC
/begin CHARACTERISTIC MoFAirFl_nrCylTot_C "Total count of cylinders in function monitoring" VALUE 0x8053B78A Val_Wu8 8.000 OneToOne 0.00 8.000 FORMAT "%5.3" EXTENDED_LIMITS 0.00 255.0 /end CHARACTERISTIC
/begin CHARACTERISTIC MoFAirFl_ofsRatFillgPrdc_C "Offset in check of predicted air charge in function monitoring" VALUE 0x8053B79F Val_Wu8 191.3 rel_ub_q0p75 0.00 191.3 FORMAT "%5.1" /end CHARACTERISTIC
/begin CHARACTERISTIC MoFAirFl_ofsTolrChkCpv_C "Offset tolerance in check of canister purge in function monitoring" VALUE 0x8053BE34 Val_Wu16 1535.953 rel_uw_b3072 0.00 1535.953 FORMAT "%8.3" EXTENDED_LIMITS 0.00 3071.953 /end CHARACTERISTIC
/begin CHARACTERISTIC MoFAirFl_ofsTolrRatFuMPfiChk_C "Offset tolerance in check of fuel in function monitoring (PFI)" VALUE 0x8053B794 Val_Wu8 191.3 rel_ub_q0p75 0.00 191.3 FORMAT "%5.1" /end CHARACTERISTIC
/begin AXIS_PTS MoFAirFl_ratFillg_Ax "Axis grid distribution for air charge in function monitoring" 0x8053BE40 MoFAirFl_ratFillg Axis_Xu16 1535.977 rel_uw_q0p0234 8 0.00 1535.977 FORMAT "%8.3" DEPOSIT ABSOLUTE /end AXIS_PTS
/begin CHARACTERISTIC MoFAirFl_ratFuEvapMinHiEngSpd_C "Minimum permitted value of evaporating fuel at high engine speeds in function monitoring" VALUE 0x8053BE36 Val_Ws16 3071.953 rel_sw_b1536 -1536.000 1535.953 FORMAT "%8.3" /end CHARACTERISTIC
/begin CHARACTERISTIC MoFAirFl_ratFuEvapMinLoEngSpd_C "Minimum permitted value of evaporating fuel at low engine speeds in function monitoring" VALUE 0x8053BE38 Val_Ws16 3071.953 rel_sw_b1536 -1536.000 1535.953 FORMAT "%8.3" /end CHARACTERISTIC
/begin CHARACTERISTIC MoFAirFl_ratFuMLamAdpnPfiMax_C "Max. allowed value lambda adaption additive on PFI path in function monitoring" VALUE 0x8053BE3A Val_Ws16 3071.953 rel_sw_b1536 -1536.000 1535.953 FORMAT "%8.3" /end CHARACTERISTIC
/begin CHARACTERISTIC MoFAirFl_ratLamExpdMaxStoi_C "Max. lambda in homogeneous operation in function monitoring" VALUE 0x8053BE3C Val_Wu16 15.99976 fak_uw_b16 0.00 15.99976 FORMAT "%8.5" /end CHARACTERISTIC
/begin CHARACTERISTIC MoFAirFl_ratLamExpdMinStoi_C "Min. lambda in homogeneous operation in function monitoring" VALUE 0x8053BE3E Val_Wu16 15.99976 fak_uw_b16 0.00 15.99976 FORMAT "%8.5" /end CHARACTERISTIC
/begin CHARACTERISTIC MoFAirFl_ratLamMaxMFlow_C "Max. lambda for calculation of mass flow in function monitoring" VALUE 0x8053BE52 Val_Wu16 15.99951 fak_q0p000244 0.00024 15.99976 FORMAT "%8.5" EXTENDED_LIMITS 0.00 15.99976 /end CHARACTERISTIC
/begin CHARACTERISTIC MoFAirFl_ratLamMinMFlow_C "Min. lambda for calculation of mass flow in function monitoring" VALUE 0x8053BE54 Val_Wu16 15.99951 fak_q0p000244 0.00024 15.99976 FORMAT "%8.5" EXTENDED_LIMITS 0.00 15.99976 /end CHARACTERISTIC
/begin CHARACTERISTIC MoFAirFl_stCfgMoFAirFl_C "Central codeword for configuration of actual torque monitoring" VALUE 0x8053BE08 Val_Wu16 65535.00 OneToOne 0.00 65535.00 FORMAT "%8.2" /end CHARACTERISTIC
/begin CHARACTERISTIC MoFAPP_cntrDeb_C "Error time for pedal signals which are implausible to each other during the monitoring" VALUE 0x8053B69C Val_Wu8 255.0 OneToOne 0.00 255.0 FORMAT "%5.1" /end CHARACTERISTIC
/begin CHARACTERISTIC MoFAPP_cntrRst_C "Number of permissible resets in case of plausibility error between the two APP sensors" VALUE 0x8053B69D Val_Wu8 255.0 OneToOne 0.00 255.0 FORMAT "%5.1" /end CHARACTERISTIC
/begin CHARACTERISTIC MoFAPP_cntrTestAPP_C "Counter limit for setting test flag in diagnosis MoFAPP in function monitoring" VALUE 0x8053CD14 Val_Wu8 255.0 OneToOne 0.00 255.0 FORMAT "%5.1" /end CHARACTERISTIC
/begin AXIS_PTS MoFAPP_ratApp_DST "Accelerator pedal position distribution in function monitoring" 0x8053B6A0 MoF_rAPP Axis_Xu8 99.61 rel_q0p39 8 0.00 99.61 FORMAT "%5.2" DEPOSIT ABSOLUTE /end AXIS_PTS
/begin AXIS_PTS MoFAPP_ratHiResl_DST "Distribution for relative high resolution pedal position in monitoring" 0x8053BD9E MoFAPP_ratHiResl Axis_Xu16 1599.976 relPED_q0p02441 8 0.00 1599.976 FORMAT "%8.3" DEPOSIT ABSOLUTE /end AXIS_PTS
/begin CHARACTERISTIC MoFAPP_swtMinSel_C "Switch to enable Minimum value selection between APP1 and APP2" VALUE 0x8053B69E Val_Wu8 1.00000000000 B_TRUE 0.00 1.00000000000 FORMAT "%13.11" /end CHARACTERISTIC
/begin CHARACTERISTIC MoFAPP_uFL_C "Full throttle- set value- threshold" VALUE 0x8053BD96 Val_Wu16 319.9951 spg_q0p00488 0.00 319.9951 FORMAT "%8.4" /end CHARACTERISTIC
/begin CHARACTERISTIC MoFAPP_uHiReslMaxLimp_C "maximum App voltage threshold in case of Limp home mode in function monitoring" VALUE 0x8053BDB0 Val_Wu16 319.9951 spg_q0p00488 0.00 319.9951 FORMAT "%8.4" /end CHARACTERISTIC
/begin CHARACTERISTIC MoFAPP_uHiReslMax_C "maximal value of driving pedal signal in the function monitoring" VALUE 0x8053BDB2 Val_Wu16 319.9951 spg_q0p00488 0.00 319.9951 FORMAT "%8.4" /end CHARACTERISTIC
/begin CHARACTERISTIC MoFAPP_uHiReslMinLimp_C "Minimum App voltage threshold in case of Limp home mode in function monitoring" VALUE 0x8053BDB4 Val_Wu16 319.9951 spg_q0p00488 0.00 319.9951 FORMAT "%8.4" /end CHARACTERISTIC
/begin CHARACTERISTIC MoFAPP_uHiReslMin_C "minimal value of driving pedal signal in the function monitoring" VALUE 0x8053BDB6 Val_Wu16 319.9951 spg_q0p00488 0.00 319.9951 FORMAT "%8.4" /end CHARACTERISTIC
/begin CHARACTERISTIC MoFAPP_uLoLim_C "Lower threshold of the APP voltages for plausibility test" VALUE 0x8053BD98 Val_Wu16 319.9951 spg_q0p00488 0.00 319.9951 FORMAT "%8.4" /end CHARACTERISTIC
/begin CHARACTERISTIC MoFAPP_uMaxDiffFL_C "Maximum permitted difference between the accelerator pedal signals above the full throttle threshold" VALUE 0x8053BD9A Val_Wu16 319.9951 spg_q0p00488 0.00 319.9951 FORMAT "%8.4" /end CHARACTERISTIC
/begin CHARACTERISTIC MoFAPP_uMaxDiffPL_C "Maximum permitted difference between the accelerator pedal signals beneath full throttle threshold" VALUE 0x8053BD9C Val_Wu16 319.9951 spg_q0p00488 0.00 319.9951 FORMAT "%8.4" /end CHARACTERISTIC
/begin CHARACTERISTIC MoFBrk_cntrBrkAcc_C "Debounce time for the brake signal for ACC deactivation in function monitoring" VALUE 0x8053B7AA Val_Wu8 255.0 OneToOne 0.00 255.0 FORMAT "%5.1" /end CHARACTERISTIC
/begin CHARACTERISTIC MoFBrk_cntrBrkApp_C "Debounce time for the brake signal for APP limp-home-mode in function monitoring" VALUE 0x8053B7AB Val_Wu8 255.0 OneToOne 0.00 255.0 FORMAT "%5.1" /end CHARACTERISTIC
/begin CHARACTERISTIC MoFBrk_cntrBrkCrsCtrl_C "Debounce time for the brake signal for cruise control deactivation in function monitoring" VALUE 0x8053B7AC Val_Wu8 255.0 OneToOne 0.00 255.0 FORMAT "%5.1" /end CHARACTERISTIC
/begin CHARACTERISTIC MoFBrk_cntrBrkMai_C "Debounce time for main brake signal in function monitoring" VALUE 0x8053B7AD Val_Wu8 255.0 OneToOne 0.00 255.0 FORMAT "%5.1" /end CHARACTERISTIC
/begin CHARACTERISTIC MoFBrk_cntrBrkRdnt_C "Debounce time for redundant brake signal in function monitoring" VALUE 0x8053B7AE Val_Wu8 255.0 OneToOne 0.00 255.0 FORMAT "%5.1" /end CHARACTERISTIC
/begin CHARACTERISTIC MoFBrk_flgEnaFrmEBBA_C "Flag to enable EBBA CAN frame in level2" VALUE 0x8053B7AF Val_Wu8 1.000 OneToOne 0.00 1.000 FORMAT "%5.3" EXTENDED_LIMITS 0.00 255.0 /end CHARACTERISTIC
/begin CHARACTERISTIC MoFCCtl_cntrCrsCtrlActvDeb_C "Maximum Threshold for Cruise Control Active Debounce" VALUE 0x8053B7B0 Val_Wu8 255.0 OneToOne 0.00 255.0 FORMAT "%5.1" /end CHARACTERISTIC
/begin CHARACTERISTIC MoFCCtl_ratAppPsd_C "Accelerator pedal ratio above which LSF is permitted by Level 2" VALUE 0x8053BE56 Val_Wu16 1599.976 relPED_q0p02441 0.00 1599.976 FORMAT "%8.3" /end CHARACTERISTIC
/begin CHARACTERISTIC MoFCCtl_swtEnaAppPsd_C "Switch to enable LSF activation by Accelerator Pedal press" VALUE 0x8053B7B1 Val_Wu8 255.0 OneToOne 0.00 255.0 FORMAT "%5.1" /end CHARACTERISTIC
/begin CHARACTERISTIC MoFCCtl_swtEnblMon_C "Bit to enable different function in cruise control monitoring" VALUE 0x8053B7B2 Val_Wu8 255.0 OneToOne 0.00 255.0 FORMAT "%5.1" /end CHARACTERISTIC
/begin CHARACTERISTIC MoFClth_cntrBotmCluTurnOffDly_C "debounce time for detecting 90 percent clutch released" VALUE 0x8053B7B4 Val_Wu8 255.0 OneToOne 0.00 255.0 FORMAT "%5.1" /end CHARACTERISTIC
/begin CHARACTERISTIC MoFClth_cntrBotmCluTurnOnDly_C "debounce time for detecting 90 percent clutch pressed" VALUE 0x8053B7B5 Val_Wu8 255.0 OneToOne 0.00 255.0 FORMAT "%5.1" /end CHARACTERISTIC
/begin CHARACTERISTIC MoFClth_cntrT15OnDeb_C "Debounce time since kl15 after which the evaluation" VALUE 0x8053B7B6 Val_Wu8 255.0 OneToOne 0.00 255.0 FORMAT "%5.1" /end CHARACTERISTIC
/begin CHARACTERISTIC MoFClth_cntrTopCluTurnOffDly_C "debounce time for detecting 10 percent clutch released" VALUE 0x8053B7B7 Val_Wu8 255.0 OneToOne 0.00 255.0 FORMAT "%5.1" /end CHARACTERISTIC
/begin CHARACTERISTIC MoFClth_cntrTopCluTurnOnDly_C "debounce time for detecting 10 percent clutch pressed" VALUE 0x8053B7B8 Val_Wu8 255.0 OneToOne 0.00 255.0 FORMAT "%5.1" /end CHARACTERISTIC
/begin CHARACTERISTIC MoFClth_flgSwt_C "Calibration switch for Clutch signal selection" VALUE 0x8053B7B9 Val_Wu8 1.000 OneToOne 0.00 1.000 FORMAT "%5.3" EXTENDED_LIMITS 0.00 255.0 /end CHARACTERISTIC
/begin CHARACTERISTIC MoFDCS_cntrDebDCSDeactv_C "Threshold for DCS deactivation counter" VALUE 0x8053B7BC Val_Wu8 255.0 OneToOne 0.00 255.0 FORMAT "%5.1" /end CHARACTERISTIC
/begin CHARACTERISTIC MoFDCS_cntrStbErrDeb_C "debounce-threshold stabilizer unit error" VALUE 0x8053B7BD Val_Wu8 255.0 OneToOne 0.00 255.0 FORMAT "%5.1" /end CHARACTERISTIC
/begin CHARACTERISTIC MoFDCS_rTqBoostMinLim_C "Minimum Boost Ratio Value" VALUE 0x8053BE82 Val_Wu16 655.3500 TransR 0.00 655.3500 FORMAT "%8.4" /end CHARACTERISTIC
/begin CHARACTERISTIC MoFDCS_tqLimDCSNorm_C "Maximum Torque Permissible" VALUE 0x8053BE84 Val_Ws16 6553.500 Mo_trq_nm_q0p1 -3276.800 3276.700 FORMAT "%8.3" /end CHARACTERISTIC
/begin CHARACTERISTIC MoFDCS_tqLimDCSPlus_C "Maximum Torque Permissible when DCS Plus is Set" VALUE 0x8053BE86 Val_Ws16 6553.500 Mo_trq_nm_q0p1 -3276.800 3276.700 FORMAT "%8.3" /end CHARACTERISTIC
/begin CHARACTERISTIC MoFDrAs_cntrACC_C "delay time for Turn on Delay ACC" VALUE 0x8053B7BE Val_Wu8 255.0 OneToOne 0.00 255.0 FORMAT "%5.1" /end CHARACTERISTIC
/begin CHARACTERISTIC MoFDrAs_cntrCrsCtrl_C "delay time for Turn on Delay cruise control" VALUE 0x8053B7BF Val_Wu8 255.0 OneToOne 0.00 255.0 FORMAT "%5.1" /end CHARACTERISTIC
/begin CHARACTERISTIC MoFDrAs_swtEBB_C "Switch to read driver brake pressed information from EBB" VALUE 0x8053B7C0 Val_Wu8 1.00000000000 B_TRUE 0.00 1.00000000000 FORMAT "%13.11" /end CHARACTERISTIC
/begin CHARACTERISTIC MoFDrAs_vACCMin_C "Comparative value minimum speed ACC" VALUE 0x8053BE88 Val_Ws16 655.3500 vfzg_q0p01 -327.6800 327.6700 FORMAT "%8.4" /end CHARACTERISTIC
/begin CHARACTERISTIC MoFDrAs_vCrsCtrlMin_C "vehicle speed threshold for cruise control activation in the function monitoring" VALUE 0x8053BE8A Val_Ws16 655.3500 vfzg_q0p01 -327.6800 327.6700 FORMAT "%8.4" /end CHARACTERISTIC
/begin CHARACTERISTIC MoFTrqPtd_cntrDebRecupFrbdn_C "Debounce counter threshold to inhibit recuperation in case of an active vehicle stability intervention" VALUE 0x8053B7BA Val_Wu8 255.0 OneToOne 0.00 255.0 FORMAT "%5.1" /end CHARACTERISTIC
/begin CHARACTERISTIC MoFTrqPtd_tiFltTqPtdVehMax_C "PT1 filter constant for permitted sum torque (ASDrf filter emulation in L2)" VALUE 0x8053BE58 Val_Wu16 655.34999985 zk10msxs_uw_b655p36PT1 0.00000015 655.35000000 FORMAT "%12.8" EXTENDED_LIMITS 0.000000152590219 655.35000000 /end CHARACTERISTIC
/begin CHARACTERISTIC MoFTrqPtd_tiFltTqPtdVehMin_C "PT1 filter constant for permitted minimum torque (ASDrf filter emulation in L2)" VALUE 0x8053BE5A Val_Wu16 655.34999985 zk10msxs_uw_b655p36PT1 0.00000015 655.35000000 FORMAT "%12.8" EXTENDED_LIMITS 0.000000152590219 655.35000000 /end CHARACTERISTIC
/begin CHARACTERISTIC MoFTrqPtd_tqAltMaxABSErr_C "permitted remaining recuperation torque, if recuperation is inhibited" VALUE 0x8053BE5C Val_Ws16 6553.500 md_q0p1 -3276.800 3276.700 FORMAT "%8.3" /end CHARACTERISTIC
/begin CHARACTERISTIC MoFTrqPtd_tqAltTqMaxErr_T "Engine speed dependent curve to adjust typical alternator torque (1-3 KW)" CURVE 0x8053BE5E Mo_DataCurveSstS16WS16 3276.800 md_q0p1 -3276.800 0.00 FORMAT "%8.3" EXTENDED_LIMITS -3276.800 3276.700
 /begin AXIS_DESCR STD_AXIS MoFESpd_nEng nmot_q40 8 0.00 10200.00 FORMAT "%8.2" EXTENDED_LIMITS -1310720. 1310680. DEPOSIT ABSOLUTE /end AXIS_DESCR
/end CHARACTERISTIC
/begin CHARACTERISTIC MoFTrqPtd_tqDecExtIntOffsMax_C "Maximum additional recuperation torque while external intervention" VALUE 0x8053BE80 Val_Wu16 6553.500 Trq 0.00 6553.500 FORMAT "%8.3" /end CHARACTERISTIC
/begin CHARACTERISTIC MoFTrqPtd_tqRecupInhibOffs_C "Offset for recuperation inhibit condition" VALUE 0x8053B7BB Val_Wu8 25.50 md_q0p1 0.00 25.50 FORMAT "%5.2" /end CHARACTERISTIC
/begin AXIS_PTS MoF_rAPP_DST "accelerator pedal position distribution in function monitoring" 0x8053B6A9 MoF_rAPP Axis_Xu8 99.61 rel_q0p39 8 0.00 99.61 FORMAT "%5.2" DEPOSIT ABSOLUTE /end AXIS_PTS
/begin AXIS_PTS MoF_tEng_DST "interpolation node distribution for engine temperature in the function monitoring" 0x8053BA5F MoF_tEng Axis_Xu8 191.3 temp_ub_q0p75_o48 8 -48.0 143.3 FORMAT "%5.1" DEPOSIT ABSOLUTE /end AXIS_PTS
/begin AXIS_PTS RLV08_UM "Datapoint distribution for load information in function monitoring" 0x8053B7A0 rl_um Axis_Xu8 191.3 rel_ub_q0p75 8 0.00 191.3 FORMAT "%5.1" DEPOSIT ABSOLUTE /end AXIS_PTS
/begin MEASUREMENT MoFAirFilgPrdc_flgClr "Condition clear FCM in function MoFAir_FilgPrdc" UBYTE B_TRUE 1 100 0.00 1.00000000000 BIT_MASK 0x1 FORMAT "%13.11" ECU_ADDRESS 0x70000183 /end MEASUREMENT
/begin MEASUREMENT MoFAirFlIn_bbOut1Cpl "Ram data redundancy for MoFAirFlIn_bbOut1" UBYTE OneToOne 1 100 0.00 255.0 FORMAT "%5.1" ECU_ADDRESS 0x60011C00 /end MEASUREMENT
/begin MEASUREMENT MoFAirFlIn_flgClr "Condition clear FCM in function MoFAirFl_In" UBYTE B_TRUE 1 100 0.00 1.00000000000 BIT_MASK 0x1 FORMAT "%13.11" ECU_ADDRESS 0x70000187 /end MEASUREMENT
/begin MEASUREMENT MoFAirFlMixCtlPfiChkAirFl_flgClr "Condition clear FCM in function MoFAirFl_MixCtlPfi (AirFl)" UBYTE B_TRUE 1 100 0.00 1.00000000000 BIT_MASK 0x1 FORMAT "%13.11" ECU_ADDRESS 0x70000186 /end MEASUREMENT
/begin MEASUREMENT MoFAirFlMixCtlPfiChkCtrl_flgClr "Condition clear FCM in function MoFAirFl_MixCtlPfi (Ctrl)" UBYTE B_TRUE 1 100 0.00 1.00000000000 BIT_MASK 0x1 FORMAT "%13.11" ECU_ADDRESS 0x70000185 /end MEASUREMENT
/begin MEASUREMENT MoFAirFlMixCtlPfi_nEng "engine speed in function MoFAirFl_MixCtlPfi" UWORD nmot_q40 1 100 0.00 2621400. FORMAT "%8.0" ECU_ADDRESS 0x6001219A /end MEASUREMENT
/begin MEASUREMENT MoFAirFlMode_flgClr "Condition clear FCM in function MoFAirFl_Mode" UBYTE B_TRUE 1 100 0.00 1.00000000000 BIT_MASK 0x1 FORMAT "%13.11" ECU_ADDRESS 0x70000184 /end MEASUREMENT
/begin MEASUREMENT MoFAirFl_calcFuMkfbs_MP "Measuring point for fuel mass with consideration of the bank specific factor correction and precontrol" ULONG rel_uw_b3072 1 100 0.00 201326591.953 FORMAT "%13.3" ECU_ADDRESS 0x70008C24 /end MEASUREMENT
/begin MEASUREMENT MoFAirFl_cntrComCntrS0Stat "Counter for extension of measure frame of communication S0 in function monitoring" UBYTE OneToOne 1 100 0.00 255.0 FORMAT "%5.1" ECU_ADDRESS 0x600122E6 /end MEASUREMENT
/begin MEASUREMENT MoFAirFl_cntrComCntrS0StatCpl "Ram data redundancy for MoFAirFl_cntrComCntrS0Stat" UBYTE OneToOne 1 100 0.00 255.0 FORMAT "%5.1" ECU_ADDRESS 0x60011BFF /end MEASUREMENT
/begin MEASUREMENT MoFAirFl_cntrComCntrS1Stat "Counter for extension of measure frame of communication S1 in function monitoring" UBYTE OneToOne 1 100 0.00 255.0 FORMAT "%5.1" ECU_ADDRESS 0x600122E5 /end MEASUREMENT
/begin MEASUREMENT MoFAirFl_cntrComCntrS1StatCpl "Ram data redundancy for MoFAirFl_cntrComCntrS1Stat" UBYTE OneToOne 1 100 0.00 255.0 FORMAT "%5.1" ECU_ADDRESS 0x60011BFE /end MEASUREMENT
/begin MEASUREMENT MoFAirFl_cntrComS0 "Counter syncs S0 in function monitoring" UWORD OneToOne 1 100 0.00 65535.00 FORMAT "%8.2" ECU_ADDRESS 0x600122E0 /end MEASUREMENT
/begin MEASUREMENT MoFAirFl_cntrComS0Cpl "Ram data redundancy for MoFAirFl_cntrComS0" UWORD OneToOne 1 100 0.00 65535.00 FORMAT "%8.2" ECU_ADDRESS 0x60011BFA /end MEASUREMENT
/begin MEASUREMENT MoFAirFl_cntrComS0Old "Counter (old value) syncs S0 in function monitoring" UWORD OneToOne 1 100 0.00 65535.00 FORMAT "%8.2" ECU_ADDRESS 0x600122DE /end MEASUREMENT
/begin MEASUREMENT MoFAirFl_cntrComS0OldCpl "Ram data redundancy for MoFAirFl_cntrComS0Old" UWORD OneToOne 1 100 0.00 65535.00 FORMAT "%8.2" ECU_ADDRESS 0x60011BF8 /end MEASUREMENT
/begin MEASUREMENT MoFAirFl_cntrComS0Rdnt "Redundancy of Counter syncs S0 in function monitoring" UWORD OneToOne 1 100 0.00 65535.00 FORMAT "%8.2" ECU_ADDRESS 0x600122DC /end MEASUREMENT
/begin MEASUREMENT MoFAirFl_cntrComS0RdntCpl "Ram data redundancy of MoFAirFl_cntrComS0Rdnt" UWORD OneToOne 1 100 0.00 65535.00 FORMAT "%8.2" ECU_ADDRESS 0x60011BF6 /end MEASUREMENT
/begin MEASUREMENT MoFAirFl_cntrComS1 "Counter syncs S1 in function monitoring" UWORD OneToOne 1 100 0.00 65535.00 FORMAT "%8.2" ECU_ADDRESS 0x600122DA /end MEASUREMENT
/begin MEASUREMENT MoFAirFl_cntrComS1Cpl "Ram data redundancy for MoFAirFl_cntrComS1" UWORD OneToOne 1 100 0.00 65535.00 FORMAT "%8.2" ECU_ADDRESS 0x60011BF4 /end MEASUREMENT
/begin MEASUREMENT MoFAirFl_cntrComS1Old "Counter (old value) syncs S1 in function monitoring" UWORD OneToOne 1 100 0.00 65535.00 FORMAT "%8.2" ECU_ADDRESS 0x600122D8 /end MEASUREMENT
/begin MEASUREMENT MoFAirFl_cntrComS1OldCpl "Ram data redundancy for MoFAirFl_cntrComS1Old" UWORD OneToOne 1 100 0.00 65535.00 FORMAT "%8.2" ECU_ADDRESS 0x60011BF2 /end MEASUREMENT
/begin MEASUREMENT MoFAirFl_cntrComS1Rdnt "Redundancy of Counter syncs S1 in function monitoring" UWORD OneToOne 1 100 0.00 65535.00 FORMAT "%8.2" ECU_ADDRESS 0x600122D6 /end MEASUREMENT
/begin MEASUREMENT MoFAirFl_cntrComS1RdntCpl "Ram data redundancy of MoFAirFl_cntrComS1Rdnt" UWORD OneToOne 1 100 0.00 65535.00 FORMAT "%8.2" ECU_ADDRESS 0x60011BF0 /end MEASUREMENT
/begin MEASUREMENT MoFAirFl_cntrDiagDebFilgPrdc "Diagnosis counter in function MoFAir_FilgPrdc" UBYTE OneToOne 1 100 0.00 255.0 FORMAT "%5.1" ECU_ADDRESS 0x60006389 /end MEASUREMENT
/begin MEASUREMENT MoFAirFl_cntrDiagDebIn "Diagnosis counter in function MoFAirFl_In" UBYTE OneToOne 1 100 0.00 255.0 FORMAT "%5.1" ECU_ADDRESS 0x6000638D /end MEASUREMENT
/begin MEASUREMENT MoFAirFl_cntrDiagDebMixCtlPfiChkAirFl "Diagnosis counter in function MoFAirFl_MixCtlPfi (AirFl)" UBYTE OneToOne 1 100 0.00 255.0 FORMAT "%5.1" ECU_ADDRESS 0x6000638C /end MEASUREMENT
/begin MEASUREMENT MoFAirFl_cntrDiagDebMixCtlPfiChkCtrl "Diagnosis counter in function MoFAirFl_MixCtlPfi (Ctrl)" UBYTE OneToOne 1 100 0.00 255.0 FORMAT "%5.1" ECU_ADDRESS 0x6000638B /end MEASUREMENT
/begin MEASUREMENT MoFAirFl_cntrDiagDebMode "Diagnosis counter in function MoFAirFl_Mode" UBYTE OneToOne 1 100 0.00 255.0 FORMAT "%5.1" ECU_ADDRESS 0x6000638A /end MEASUREMENT
/begin MEASUREMENT MoFAirFl_cntrErrDebFilgPrdc "Error debounce counter in function MoFAir_FilgPrdc" UBYTE OneToOne 1 100 0.00 255.0 FORMAT "%5.1" ECU_ADDRESS 0x6001218F /end MEASUREMENT
/begin MEASUREMENT MoFAirFl_cntrErrDebFilgPrdcCpl "Ram data redundancy for MoFAirFl_cntrErrDebFilgPrdc" UBYTE OneToOne 1 100 0.00 255.0 FORMAT "%5.1" ECU_ADDRESS 0x60011AAF /end MEASUREMENT
/begin MEASUREMENT MoFAirFl_cntrErrDebInCom "Error debounce counter in function MoFAirFl_In" UBYTE OneToOne 1 100 0.00 255.0 FORMAT "%5.1" ECU_ADDRESS 0x600122E4 /end MEASUREMENT
/begin MEASUREMENT MoFAirFl_cntrErrDebInComCpl "Ram data redundancy MoFAirFl_cntrErrDebInCom" UBYTE OneToOne 1 100 0.00 255.0 FORMAT "%5.1" ECU_ADDRESS 0x60011BFD /end MEASUREMENT
/begin MEASUREMENT MoFAirFl_cntrErrDebMixCtlPfiChkAirFl "Error debounce counter in function MoFAirFl_MixCtlPfi (AirFl)" UBYTE OneToOne 1 100 0.00 255.0 FORMAT "%5.1" ECU_ADDRESS 0x6001219D /end MEASUREMENT
/begin MEASUREMENT MoFAirFl_cntrErrDebMixCtlPfiChkAirFlCpl "Ram data redundancy for MoFAirFl_cntrErrDebMixCtlPfiChkAirFl" UBYTE OneToOne 1 100 0.00 255.0 FORMAT "%5.1" ECU_ADDRESS 0x60011ABB /end MEASUREMENT
/begin MEASUREMENT MoFAirFl_cntrErrDebMixCtlPfiChkCtrl "Error debounce counter in function MoFAirFl_MixCtlPfi (Ctrl)" UBYTE OneToOne 1 100 0.00 255.0 FORMAT "%5.1" ECU_ADDRESS 0x6001219C /end MEASUREMENT
/begin MEASUREMENT MoFAirFl_cntrErrDebMixCtlPfiChkCtrlCpl "Ram data redundancy for MoFAirFl_cntrErrDebMixCtlPfiChkCtrl" UBYTE OneToOne 1 100 0.00 255.0 FORMAT "%5.1" ECU_ADDRESS 0x60011ABA /end MEASUREMENT
/begin MEASUREMENT MoFAirFl_cntrErrDebMode "Error debounce counter in function MoFAirFl_Mode" UBYTE OneToOne 1 100 0.00 255.0 FORMAT "%5.1" ECU_ADDRESS 0x60012190 /end MEASUREMENT
/begin MEASUREMENT MoFAirFl_cntrErrDebModeCpl "Ram data redundancy for MoFAirFl_cntrErrDebMode" UBYTE OneToOne 1 100 0.00 255.0 FORMAT "%5.1" ECU_ADDRESS 0x60011AB0 /end MEASUREMENT
/begin MEASUREMENT MoFAirFl_cntrFillgHiDeDly "Counter for high deviation of charge in function monitoring" UBYTE OneToOne 1 100 0.00 255.0 FORMAT "%5.1" ECU_ADDRESS 0x6001218E /end MEASUREMENT
/begin MEASUREMENT MoFAirFl_cntrFillgHiDeDlyCpl "RAM data redundancy for MoFAirFl_cntrFillgHiDeDly" UBYTE OneToOne 1 100 0.00 255.0 FORMAT "%5.1" ECU_ADDRESS 0x60011AAE /end MEASUREMENT
/begin MEASUREMENT MoFAirFl_CtOffCplIfClass_V13I.evz_auscplCpl "Instance of data class for redundant quantities in connection with injection cut-off in function monitoring / Instance of data class for ram data redundancy of MoFAirFl_CtOffIfClass Member Variable" UBYTE OneToOne 1 100 0.00 255.0 FORMAT "%5.1" ECU_ADDRESS 0x60011BB0 /end MEASUREMENT
/begin MEASUREMENT MoFAirFl_CtOffCplIfClass_V13I.evz_auscpl_memCpl "Instance of data class for redundant quantities in connection with injection cut-off in function monitoring / Instance of data class for ram data redundancy of MoFAirFl_CtOffIfClass Member Variable" UBYTE OneToOne 1 100 0.00 255.0 FORMAT "%5.1" ARRAY_SIZE 4 ECU_ADDRESS 0x60011BB1 /end MEASUREMENT
/begin MEASUREMENT MoFAirFl_CtOffCplIfClass_V13I.evz_austotCpl "Instance of data class for redundant quantities in connection with injection cut-off in function monitoring / Instance of data class for ram data redundancy of MoFAirFl_CtOffIfClass Member Variable" UBYTE OneToOne 1 100 0.00 255.0 FORMAT "%5.1" ECU_ADDRESS 0x60011BB5 /end MEASUREMENT
/begin MEASUREMENT MoFAirFl_CtOffCplIfClass_V13I.evz_austot_memCpl "Instance of data class for redundant quantities in connection with injection cut-off in function monitoring / Instance of data class for ram data redundancy of MoFAirFl_CtOffIfClass Member Variable" UBYTE OneToOne 1 100 0.00 255.0 FORMAT "%5.1" ARRAY_SIZE 4 ECU_ADDRESS 0x60011BB6 /end MEASUREMENT
/begin MEASUREMENT MoFAirFl_CtOffCplIfClass_V13I.flgInjEnadCpl "Instance of data class for redundant quantities in connection with injection cut-off in function monitoring / Instance of data class for ram data redundancy of MoFAirFl_CtOffIfClass Member Variable" UBYTE OneToOne 1 100 0.00 255.0 FORMAT "%5.1" ECU_ADDRESS 0x60011BBA /end MEASUREMENT
/begin MEASUREMENT MoFAirFl_CtOffCplIfClass_V13I.injTrigCylMskCpl "Instance of data class for redundant quantities in connection with injection cut-off in function monitoring / Instance of data class for ram data redundancy of MoFAirFl_CtOffIfClass Member Variable" UWORD OneToOne 1 100 0.00 65535.00 FORMAT "%8.2" ECU_ADDRESS 0x60011BBC /end MEASUREMENT
/begin MEASUREMENT MoFAirFl_CtOffCplIfClass_V13I.injTrigCylMskRdntCpl "Instance of data class for redundant quantities in connection with injection cut-off in function monitoring / Instance of data class for ram data redundancy of MoFAirFl_CtOffIfClass Member Variable" UWORD OneToOne 1 100 0.00 65535.00 FORMAT "%8.2" ECU_ADDRESS 0x60011BBE /end MEASUREMENT
/begin MEASUREMENT MoFAirFl_CtOffCplIfClass_V13I.injmode_zzylhCpl "Instance of data class for redundant quantities in connection with injection cut-off in function monitoring / Instance of data class for ram data redundancy of MoFAirFl_CtOffIfClass Member Variable" ULONG OneToOne 1 100 0.00 4294967295.00 FORMAT "%13.2" ECU_ADDRESS 0x60011BC0 /end MEASUREMENT
/begin MEASUREMENT MoFAirFl_CtOffCplIfClass_V13I.injmode_zzylh_rdntCpl "Instance of data class for redundant quantities in connection with injection cut-off in function monitoring / Instance of data class for ram data redundancy of MoFAirFl_CtOffIfClass Member Variable" ULONG OneToOne 1 100 0.00 4294967295.00 FORMAT "%13.2" ECU_ADDRESS 0x60011BC4 /end MEASUREMENT
/begin MEASUREMENT MoFAirFl_CtOffCplIfClass_V13I.injmode_zzylnCpl "Instance of data class for redundant quantities in connection with injection cut-off in function monitoring / Instance of data class for ram data redundancy of MoFAirFl_CtOffIfClass Member Variable" ULONG OneToOne 1 100 0.00 4294967295.00 FORMAT "%13.2" ECU_ADDRESS 0x60011BC8 /end MEASUREMENT
/begin MEASUREMENT MoFAirFl_CtOffCplIfClass_V13I.injmode_zzyln_rdntCpl "Instance of data class for redundant quantities in connection with injection cut-off in function monitoring / Instance of data class for ram data redundancy of MoFAirFl_CtOffIfClass Member Variable" ULONG OneToOne 1 100 0.00 4294967295.00 FORMAT "%13.2" ECU_ADDRESS 0x60011BCC /end MEASUREMENT
/begin MEASUREMENT MoFAirFl_CtOffCplIfClass_V13I.injmode_zzylsCpl "Instance of data class for redundant quantities in connection with injection cut-off in function monitoring / Instance of data class for ram data redundancy of MoFAirFl_CtOffIfClass Member Variable" ULONG OneToOne 1 100 0.00 4294967295.00 FORMAT "%13.2" ECU_ADDRESS 0x60011BD0 /end MEASUREMENT
/begin MEASUREMENT MoFAirFl_CtOffCplIfClass_V13I.injmode_zzyls_rdntCpl "Instance of data class for redundant quantities in connection with injection cut-off in function monitoring / Instance of data class for ram data redundancy of MoFAirFl_CtOffIfClass Member Variable" ULONG OneToOne 1 100 0.00 4294967295.00 FORMAT "%13.2" ECU_ADDRESS 0x60011BD4 /end MEASUREMENT
/begin MEASUREMENT MoFAirFl_CtOffCplIfClass_V13I.stInjPfiDeactvAryCpl "Instance of data class for redundant quantities in connection with injection cut-off in function monitoring / Instance of data class for ram data redundancy of MoFAirFl_CtOffIfClass Member Variable" UBYTE OneToOne 1 100 0.00 255.0 FORMAT "%5.1" ARRAY_SIZE 4 ECU_ADDRESS 0x60011BD8 /end MEASUREMENT
/begin MEASUREMENT MoFAirFl_CtOffCplIfClass_V13I.stInjPfiDeactvAryRdntCpl "Instance of data class for redundant quantities in connection with injection cut-off in function monitoring / Instance of data class for ram data redundancy of MoFAirFl_CtOffIfClass Member Variable" UBYTE OneToOne 1 100 0.00 255.0 FORMAT "%5.1" ARRAY_SIZE 4 ECU_ADDRESS 0x60011BDC /end MEASUREMENT
/begin MEASUREMENT MoFAirFl_CtOffCplIfClass_V13I.stInjPfiDeactvBkupAryCpl "Instance of data class for redundant quantities in connection with injection cut-off in function monitoring / Instance of data class for ram data redundancy of MoFAirFl_CtOffIfClass Member Variable" UBYTE OneToOne 1 100 0.00 255.0 FORMAT "%5.1" ARRAY_SIZE 4 ECU_ADDRESS 0x60011BE0 /end MEASUREMENT
/begin MEASUREMENT MoFAirFl_CtOffCplIfClass_V13I.stInjTiPfi1InjrACpl "Instance of data class for redundant quantities in connection with injection cut-off in function monitoring / Instance of data class for ram data redundancy of MoFAirFl_CtOffIfClass_V13I Member Variable" UBYTE OneToOne 1 100 0.00 255.0 FORMAT "%5.1" ECU_ADDRESS 0x60011BE4 /end MEASUREMENT
/begin MEASUREMENT MoFAirFl_CtOffCplIfClass_V13I.stInjTiPfi1InjrARdntCpl "Instance of data class for redundant quantities in connection with injection cut-off in function monitoring / Instance of data class for ram data redundancy of MoFAirFl_CtOffIfClass_V13I Member Variable" UBYTE OneToOne 1 100 0.00 255.0 FORMAT "%5.1" ECU_ADDRESS 0x60011BE5 /end MEASUREMENT
/begin MEASUREMENT MoFAirFl_CtOffCplIfClass_V13I.stInjTiPfi1InjrBCpl "Instance of data class for redundant quantities in connection with injection cut-off in function monitoring / Instance of data class for ram data redundancy of MoFAirFl_CtOffIfClass_V13I Member Variable" UBYTE OneToOne 1 100 0.00 255.0 FORMAT "%5.1" ECU_ADDRESS 0x60011BE6 /end MEASUREMENT
/begin MEASUREMENT MoFAirFl_CtOffCplIfClass_V13I.stInjTiPfi1InjrBRdntCpl "Instance of data class for redundant quantities in connection with injection cut-off in function monitoring / Instance of data class for ram data redundancy of MoFAirFl_CtOffIfClass_V13I Member Variable" UBYTE OneToOne 1 100 0.00 255.0 FORMAT "%5.1" ECU_ADDRESS 0x60011BE7 /end MEASUREMENT
/begin MEASUREMENT MoFAirFl_CtOffCplIfClass_V13I.stInjTiPfi2InjrACpl "Instance of data class for redundant quantities in connection with injection cut-off in function monitoring / Instance of data class for ram data redundancy of MoFAirFl_CtOffIfClass_V13I Member Variable" UBYTE OneToOne 1 100 0.00 255.0 FORMAT "%5.1" ECU_ADDRESS 0x60011BE8 /end MEASUREMENT
/begin MEASUREMENT MoFAirFl_CtOffCplIfClass_V13I.stInjTiPfi2InjrARdntCpl "Instance of data class for redundant quantities in connection with injection cut-off in function monitoring / Instance of data class for ram data redundancy of MoFAirFl_CtOffIfClass_V13I Member Variable" UBYTE OneToOne 1 100 0.00 255.0 FORMAT "%5.1" ECU_ADDRESS 0x60011BE9 /end MEASUREMENT
/begin MEASUREMENT MoFAirFl_CtOffCplIfClass_V13I.stInjTiPfi2InjrBCpl "Instance of data class for redundant quantities in connection with injection cut-off in function monitoring / Instance of data class for ram data redundancy of MoFAirFl_CtOffIfClass_V13I Member Variable" UBYTE OneToOne 1 100 0.00 255.0 FORMAT "%5.1" ECU_ADDRESS 0x60011BEA /end MEASUREMENT
/begin MEASUREMENT MoFAirFl_CtOffCplIfClass_V13I.stInjTiPfi2InjrBRdntCpl "Instance of data class for redundant quantities in connection with injection cut-off in function monitoring / Instance of data class for ram data redundancy of MoFAirFl_CtOffIfClass_V13I Member Variable" UBYTE OneToOne 1 100 0.00 255.0 FORMAT "%5.1" ECU_ADDRESS 0x60011BEB /end MEASUREMENT
/begin MEASUREMENT MoFAirFl_CtOffCplIfClass_V13I.stInjTiPfiCpl "Instance of data class for redundant quantities in connection with injection cut-off in function monitoring / Instance of data class for ram data redundancy of MoFAirFl_CtOffIfClass Member Variable" UBYTE OneToOne 1 100 0.00 255.0 FORMAT "%5.1" ECU_ADDRESS 0x60011BEC /end MEASUREMENT
/begin MEASUREMENT MoFAirFl_CtOffCplIfClass_V13I.stInjTiPfiRdntCpl "Instance of data class for redundant quantities in connection with injection cut-off in function monitoring / Instance of data class for ram data redundancy of MoFAirFl_CtOffIfClass Member Variable" UBYTE OneToOne 1 100 0.00 255.0 FORMAT "%5.1" ECU_ADDRESS 0x60011BED /end MEASUREMENT
/begin MEASUREMENT MoFAirFl_CtOffIfClass_V13I.evz_auscpl "Instance of data class for quantities in connection with injection cut-off in function monitoring / Instance of data class for quantities in connection with injection cut-off in function monitoring Member Variable" UBYTE OneToOne 1 100 0.00 255.0 FORMAT "%5.1" ECU_ADDRESS 0x60012294 /end MEASUREMENT
/begin MEASUREMENT MoFAirFl_CtOffIfClass_V13I.evz_auscpl_mem "Instance of data class for quantities in connection with injection cut-off in function monitoring / Instance of data class for quantities in connection with injection cut-off in function monitoring Member Variable" UBYTE OneToOne 1 100 0.00 255.0 FORMAT "%5.1" ARRAY_SIZE 4 ECU_ADDRESS 0x60012295 /end MEASUREMENT
/begin MEASUREMENT MoFAirFl_CtOffIfClass_V13I.evz_austot "Instance of data class for quantities in connection with injection cut-off in function monitoring / Instance of data class for quantities in connection with injection cut-off in function monitoring Member Variable" UBYTE OneToOne 1 100 0.00 255.0 FORMAT "%5.1" ECU_ADDRESS 0x60012299 /end MEASUREMENT
/begin MEASUREMENT MoFAirFl_CtOffIfClass_V13I.evz_austot_mem "Instance of data class for quantities in connection with injection cut-off in function monitoring / Instance of data class for quantities in connection with injection cut-off in function monitoring Member Variable" UBYTE OneToOne 1 100 0.00 255.0 FORMAT "%5.1" ARRAY_SIZE 4 ECU_ADDRESS 0x6001229A /end MEASUREMENT
/begin MEASUREMENT MoFAirFl_CtOffIfClass_V13I.flgInjEnad "Instance of data class for quantities in connection with injection cut-off in function monitoring / Instance of data class for quantities in connection with injection cut-off in function monitoring Member Variable" UBYTE OneToOne 1 100 0.00 255.0 FORMAT "%5.1" ECU_ADDRESS 0x6001229E /end MEASUREMENT
/begin MEASUREMENT MoFAirFl_CtOffIfClass_V13I.injTrigCylMsk "Instance of data class for quantities in connection with injection cut-off in function monitoring / Instance of data class for quantities in connection with injection cut-off in function monitoring Member Variable" UWORD OneToOne 1 100 0.00 65535.00 FORMAT "%8.2" ECU_ADDRESS 0x600122A0 /end MEASUREMENT
/begin MEASUREMENT MoFAirFl_CtOffIfClass_V13I.injmode_zzylh "Instance of data class for quantities in connection with injection cut-off in function monitoring / Instance of data class for quantities in connection with injection cut-off in function monitoring Member Variable" ULONG OneToOne 1 100 0.00 4294967295.00 FORMAT "%13.2" ECU_ADDRESS 0x600122A4 /end MEASUREMENT
/begin MEASUREMENT MoFAirFl_CtOffIfClass_V13I.injmode_zzylh_rdnt "Instance of data class for quantities in connection with injection cut-off in function monitoring / Instance of data class for quantities in connection with injection cut-off in function monitoring Member Variable" ULONG OneToOne 1 100 0.00 4294967295.00 FORMAT "%13.2" ECU_ADDRESS 0x600122A8 /end MEASUREMENT
/begin MEASUREMENT MoFAirFl_CtOffIfClass_V13I.injmode_zzyln "Instance of data class for quantities in connection with injection cut-off in function monitoring / Instance of data class for quantities in connection with injection cut-off in function monitoring Member Variable" ULONG OneToOne 1 100 0.00 4294967295.00 FORMAT "%13.2" ECU_ADDRESS 0x600122AC /end MEASUREMENT
/begin MEASUREMENT MoFAirFl_CtOffIfClass_V13I.injmode_zzyln_rdnt "Instance of data class for quantities in connection with injection cut-off in function monitoring / Instance of data class for quantities in connection with injection cut-off in function monitoring Member Variable" ULONG OneToOne 1 100 0.00 4294967295.00 FORMAT "%13.2" ECU_ADDRESS 0x600122B0 /end MEASUREMENT
/begin MEASUREMENT MoFAirFl_CtOffIfClass_V13I.injmode_zzyls "Instance of data class for quantities in connection with injection cut-off in function monitoring / Instance of data class for quantities in connection with injection cut-off in function monitoring Member Variable" ULONG OneToOne 1 100 0.00 4294967295.00 FORMAT "%13.2" ECU_ADDRESS 0x600122B4 /end MEASUREMENT
/begin MEASUREMENT MoFAirFl_CtOffIfClass_V13I.injmode_zzyls_rdnt "Instance of data class for quantities in connection with injection cut-off in function monitoring / Instance of data class for quantities in connection with injection cut-off in function monitoring Member Variable" ULONG OneToOne 1 100 0.00 4294967295.00 FORMAT "%13.2" ECU_ADDRESS 0x600122B8 /end MEASUREMENT
/begin MEASUREMENT MoFAirFl_CtOffIfClass_V13I.stInjPfiDeactvAry "Instance of data class for quantities in connection with injection cut-off in function monitoring / Instance of data class for quantities in connection with injection cut-off in function monitoring Member Variable" UBYTE OneToOne 1 100 0.00 255.0 FORMAT "%5.1" ARRAY_SIZE 4 ECU_ADDRESS 0x600122BC /end MEASUREMENT
/begin MEASUREMENT MoFAirFl_CtOffIfClass_V13I.stInjPfiDeactvAryRdnt "Instance of data class for quantities in connection with injection cut-off in function monitoring / Instance of data class for quantities in connection with injection cut-off in function monitoring Member Variable" UBYTE OneToOne 1 100 0.00 255.0 FORMAT "%5.1" ARRAY_SIZE 4 ECU_ADDRESS 0x600122C0 /end MEASUREMENT
/begin MEASUREMENT MoFAirFl_CtOffIfClass_V13I.stInjPfiDeactvBkupAry "Instance of data class for quantities in connection with injection cut-off in function monitoring / Instance of data class for quantities in connection with injection cut-off in function monitoring Member Variable" UBYTE OneToOne 1 100 0.00 255.0 FORMAT "%5.1" ARRAY_SIZE 4 ECU_ADDRESS 0x600122C4 /end MEASUREMENT
/begin MEASUREMENT MoFAirFl_CtOffIfClass_V13I.stInjTiPfi "Instance of data class for quantities in connection with injection cut-off in function monitoring / Instance of data class for quantities in connection with injection cut-off in function monitoring Member Variable" UBYTE OneToOne 1 100 0.00 255.0 FORMAT "%5.1" ECU_ADDRESS 0x600122C8 /end MEASUREMENT
/begin MEASUREMENT MoFAirFl_CtOffIfClass_V13I.stInjTiPfi1InjrA "Instance of data class for quantities in connection with injection cut-off in function monitoring / Instance of data class for quantities in connection with injection cut-off in function monitoring Member Variable" UBYTE OneToOne 1 100 0.00 255.0 FORMAT "%5.1" ECU_ADDRESS 0x600122C9 /end MEASUREMENT
/begin MEASUREMENT MoFAirFl_CtOffIfClass_V13I.stInjTiPfi1InjrARdnt "Instance of data class for quantities in connection with injection cut-off in function monitoring / Instance of data class for quantities in connection with injection cut-off in function monitoring Member Variable" UBYTE OneToOne 1 100 0.00 255.0 FORMAT "%5.1" ECU_ADDRESS 0x600122CA /end MEASUREMENT
/begin MEASUREMENT MoFAirFl_CtOffIfClass_V13I.stInjTiPfi1InjrB "Instance of data class for quantities in connection with injection cut-off in function monitoring / Instance of data class for quantities in connection with injection cut-off in function monitoring Member Variable" UBYTE OneToOne 1 100 0.00 255.0 FORMAT "%5.1" ECU_ADDRESS 0x600122CB /end MEASUREMENT
/begin MEASUREMENT MoFAirFl_CtOffIfClass_V13I.stInjTiPfi1InjrBRdnt "Instance of data class for quantities in connection with injection cut-off in function monitoring / Instance of data class for quantities in connection with injection cut-off in function monitoring Member Variable" UBYTE OneToOne 1 100 0.00 255.0 FORMAT "%5.1" ECU_ADDRESS 0x600122CC /end MEASUREMENT
/begin MEASUREMENT MoFAirFl_CtOffIfClass_V13I.stInjTiPfi2InjrA "Instance of data class for quantities in connection with injection cut-off in function monitoring / Instance of data class for quantities in connection with injection cut-off in function monitoring Member Variable" UBYTE OneToOne 1 100 0.00 255.0 FORMAT "%5.1" ECU_ADDRESS 0x600122CD /end MEASUREMENT
/begin MEASUREMENT MoFAirFl_CtOffIfClass_V13I.stInjTiPfi2InjrARdnt "Instance of data class for quantities in connection with injection cut-off in function monitoring / Instance of data class for quantities in connection with injection cut-off in function monitoring Member Variable" UBYTE OneToOne 1 100 0.00 255.0 FORMAT "%5.1" ECU_ADDRESS 0x600122CE /end MEASUREMENT
/begin MEASUREMENT MoFAirFl_CtOffIfClass_V13I.stInjTiPfi2InjrB "Instance of data class for quantities in connection with injection cut-off in function monitoring / Instance of data class for quantities in connection with injection cut-off in function monitoring Member Variable" UBYTE OneToOne 1 100 0.00 255.0 FORMAT "%5.1" ECU_ADDRESS 0x600122CF /end MEASUREMENT
/begin MEASUREMENT MoFAirFl_CtOffIfClass_V13I.stInjTiPfi2InjrBRdnt "Instance of data class for quantities in connection with injection cut-off in function monitoring / Instance of data class for quantities in connection with injection cut-off in function monitoring Member Variable" UBYTE OneToOne 1 100 0.00 255.0 FORMAT "%5.1" ECU_ADDRESS 0x600122D0 /end MEASUREMENT
/begin MEASUREMENT MoFAirFl_CtOffIfClass_V13I.stInjTiPfiRdnt "Instance of data class for quantities in connection with injection cut-off in function monitoring / Instance of data class for quantities in connection with injection cut-off in function monitoring Member Variable" UBYTE OneToOne 1 100 0.00 255.0 FORMAT "%5.1" ECU_ADDRESS 0x600122D1 /end MEASUREMENT
/begin MEASUREMENT MoFAirFl_facPcPfi_MP "Measurement point pre control factor in function monitoring" UWORD fak_uw_b64 1 100 0.00 63.99902 FORMAT "%8.5" ECU_ADDRESS 0x70008C20 /end MEASUREMENT
/begin MEASUREMENT MoFAirFl_flgErrCom "Information error in communication with level1" UBYTE B_TRUE 1 100 0.00 1.00000000000 BIT_MASK 0x1 FORMAT "%13.11" ECU_ADDRESS 0x600122E2 /end MEASUREMENT
/begin MEASUREMENT MoFAirFl_flgIrrvErrFilgPrdcMsg "Irreversible error bit in function MoFAirFl_FilgPrdc" UBYTE B_TRUE 1 100 0.00 1.00000000000 BIT_MASK 0x1 FORMAT "%13.11" ECU_ADDRESS 0x700006D7 /end MEASUREMENT
/begin MEASUREMENT MoFAirFl_flgIrrvErrInMsg "Irreversible error bit in function MoFAirFl_In" UBYTE B_TRUE 1 100 0.00 1.00000000000 BIT_MASK 0x1 FORMAT "%13.11" ECU_ADDRESS 0x700006D6 /end MEASUREMENT
/begin MEASUREMENT MoFAirFl_flgIrrvErrMixCtlPfiChkAirFlMsg "Irreversible error bit in function MoFAirFl_MixCtlPfi (AirFl)" UBYTE B_TRUE 1 100 0.00 1.00000000000 BIT_MASK 0x1 FORMAT "%13.11" ECU_ADDRESS 0x700006D5 /end MEASUREMENT
/begin MEASUREMENT MoFAirFl_flgIrrvErrMixCtlPfiChkCtrlMsg "Irreversible error bit in function MoFAirFl_MixCtlPfi (Ctrl)" UBYTE B_TRUE 1 100 0.00 1.00000000000 BIT_MASK 0x1 FORMAT "%13.11" ECU_ADDRESS 0x700006D4 /end MEASUREMENT
/begin MEASUREMENT MoFAirFl_flgIrrvErrModeMsg "Irreversible error bit in function MoFAirFl_Mode" UBYTE B_TRUE 1 100 0.00 1.00000000000 BIT_MASK 0x1 FORMAT "%13.11" ECU_ADDRESS 0x700006D3 /end MEASUREMENT
/begin MEASUREMENT MoFAirFl_flgTestFilgPrdcMsg "Bit test conditions for diagnosis in function MoFAirFl_FilgPrdc" UBYTE B_TRUE 1 100 0.00 1.00000000000 BIT_MASK 0x1 FORMAT "%13.11" ECU_ADDRESS 0x700006D0 /end MEASUREMENT
/begin MEASUREMENT MoFAirFl_flgTestInMsg "Bit test conditions for diagnosis in function MoFAirFl_In" UBYTE B_TRUE 1 100 0.00 1.00000000000 BIT_MASK 0x1 FORMAT "%13.11" ECU_ADDRESS 0x700006CF /end MEASUREMENT
/begin MEASUREMENT MoFAirFl_flgTestMixCtlPfiChkAirFlMsg "Bit test conditions for diagnosis in function MoFAirFl_MixCtlPfi (AirFl)" UBYTE B_TRUE 1 100 0.00 1.00000000000 BIT_MASK 0x1 FORMAT "%13.11" ECU_ADDRESS 0x700006CE /end MEASUREMENT
/begin MEASUREMENT MoFAirFl_flgTestMixCtlPfiChkCtrlMsg "Bit test conditions for diagnosis in function MoFAirFl_MixCtlPfi (Ctrl)" UBYTE B_TRUE 1 100 0.00 1.00000000000 BIT_MASK 0x1 FORMAT "%13.11" ECU_ADDRESS 0x700006CD /end MEASUREMENT
/begin MEASUREMENT MoFAirFl_flgTestModeMsg "Bit test conditions for diagnosis in function MoFAirFl_Mode" UBYTE B_TRUE 1 100 0.00 1.00000000000 BIT_MASK 0x1 FORMAT "%13.11" ECU_ADDRESS 0x700006CC /end MEASUREMENT
/begin MEASUREMENT MoFAirFl_MixMngtCplIfClass_V13I.B_afimreqCpl "Instance of data class for redundant quantities in connection with mixture management in function monitoring / Instance of data class for ram data redundancy of MoFAirFl_MixMngIfClass Member Variable" UBYTE OneToOne 1 100 0.00 255.0 FORMAT "%5.1" ECU_ADDRESS 0x60011AD4 /end MEASUREMENT
/begin MEASUREMENT MoFAirFl_MixMngtCplIfClass_V13I.facBnk2PfiCpl "Instance of data class for redundant quantities in connection with mixture management in function monitoring / Instance of data class for ram data redundancy of MoFAirFl_MixMngIfClass Member Variable" UWORD OneToOne 1 100 0.00 65535.00 FORMAT "%8.2" ECU_ADDRESS 0x60011AD6 /end MEASUREMENT
/begin MEASUREMENT MoFAirFl_MixMngtCplIfClass_V13I.facBnkCpl "Instance of data class for redundant quantities in connection with mixture management in function monitoring / Instance of data class for ram data redundancy of MoFAirFl_MixMngIfClass Member Variable" UWORD OneToOne 1 100 0.00 65535.00 FORMAT "%8.2" ECU_ADDRESS 0x60011AD8 /end MEASUREMENT
/begin MEASUREMENT MoFAirFl_MixMngtCplIfClass_V13I.facBnkPfiCpl "Instance of data class for redundant quantities in connection with mixture management in function monitoring / Instance of data class for ram data redundancy of MoFAirFl_MixMngIfClass Member Variable" UWORD OneToOne 1 100 0.00 65535.00 FORMAT "%8.2" ECU_ADDRESS 0x60011ADA /end MEASUREMENT
/begin MEASUREMENT MoFAirFl_MixMngtCplIfClass_V13I.facLamCtlPfiAryCpl "Instance of data class for redundant quantities in connection with mixture management in function monitoring / Instance of data class for ram data redundancy of MoFAirFl_MixMngIfClass Member Variable" UWORD OneToOne 1 100 0.00 65535.00 FORMAT "%8.2" ARRAY_SIZE 4 ECU_ADDRESS 0x60011ADC /end MEASUREMENT
/begin MEASUREMENT MoFAirFl_MixMngtCplIfClass_V13I.facLamCtlPfiAryRdntCpl "Instance of data class for redundant quantities in connection with mixture management in function monitoring / Instance of data class for ram data redundancy of MoFAirFl_MixMngIfClass Member Variable" UWORD OneToOne 1 100 0.00 65535.00 FORMAT "%8.2" ARRAY_SIZE 4 ECU_ADDRESS 0x60011AE4 /end MEASUREMENT
/begin MEASUREMENT MoFAirFl_MixMngtCplIfClass_V13I.facLamCtlPfiBkupAryCpl "Instance of data class for redundant quantities in connection with mixture management in function monitoring / Instance of data class for ram data redundancy of MoFAirFl_MixMngIfClass Member Variable" UWORD OneToOne 1 100 0.00 65535.00 FORMAT "%8.2" ARRAY_SIZE 4 ECU_ADDRESS 0x60011AEC /end MEASUREMENT
/begin MEASUREMENT MoFAirFl_MixMngtCplIfClass_V13I.facPcPfiRestBnk2Cpl "Instance of data class for redundant quantities in connection with mixture management in function monitoring / Instance of data class for quantities in connection with mixture management in function monitoring Member Variable" UWORD OneToOne 1 100 0.00 65535.00 FORMAT "%8.2" ECU_ADDRESS 0x60011AF4 /end MEASUREMENT
/begin MEASUREMENT MoFAirFl_MixMngtCplIfClass_V13I.facPcPfiRestCpl "Instance of data class for redundant quantities in connection with mixture management in function monitoring / Instance of data class for ram data redundancy of MoFAirFl_MixMngIfClass Member Variable" UWORD OneToOne 1 100 0.00 65535.00 FORMAT "%8.2" ECU_ADDRESS 0x60011AF6 /end MEASUREMENT
/begin MEASUREMENT MoFAirFl_MixMngtCplIfClass_V13I.facPcRestCpl "Instance of data class for redundant quantities in connection with mixture management in function monitoring / Instance of data class for ram data redundancy of MoFAirFl_MixMngIfClass Member Variable" UWORD OneToOne 1 100 0.00 65535.00 FORMAT "%8.2" ECU_ADDRESS 0x60011AF8 /end MEASUREMENT
/begin MEASUREMENT MoFAirFl_MixMngtCplIfClass_V13I.facPrtnPfiAryCpl "Instance of data class for redundant quantities in connection with mixture management in function monitoring / Instance of data class for ram data redundancy of MoFAirFl_MixMngIfClass Member Variable" UBYTE OneToOne 1 100 0.00 255.0 FORMAT "%5.1" ARRAY_SIZE 4 ECU_ADDRESS 0x60011AFA /end MEASUREMENT
/begin MEASUREMENT MoFAirFl_MixMngtCplIfClass_V13I.facPrtnPfiAryRdntCpl "Instance of data class for redundant quantities in connection with mixture management in function monitoring / Instance of data class for ram data redundancy of MoFAirFl_MixMngIfClass Member Variable" UBYTE OneToOne 1 100 0.00 255.0 FORMAT "%5.1" ARRAY_SIZE 4 ECU_ADDRESS 0x60011AFE /end MEASUREMENT
/begin MEASUREMENT MoFAirFl_MixMngtCplIfClass_V13I.facPrtnPfiBkupAryCpl "Instance of data class for redundant quantities in connection with mixture management in function monitoring / Instance of data class for ram data redundancy of MoFAirFl_MixMngIfClass Member Variable" UBYTE OneToOne 1 100 0.00 255.0 FORMAT "%5.1" ARRAY_SIZE 4 ECU_ADDRESS 0x60011B02 /end MEASUREMENT
/begin MEASUREMENT MoFAirFl_MixMngtCplIfClass_V13I.facPrtnPfiCpl "Instance of data class for redundant quantities in connection with mixture management in function monitoring / Instance of data class for ram data redundancy of MoFAirFl_MixMngIfClass Member Variable" UBYTE OneToOne 1 100 0.00 255.0 FORMAT "%5.1" ECU_ADDRESS 0x60011B06 /end MEASUREMENT
/begin MEASUREMENT MoFAirFl_MixMngtCplIfClass_V13I.fakeslsaCpl "Instance of data class for redundant quantities in connection with mixture management in function monitoring / Instance of data class for ram data redundancy of MoFAirFl_MixMngIfClass Member Variable" UWORD OneToOne 1 100 0.00 65535.00 FORMAT "%8.2" ARRAY_SIZE 4 ECU_ADDRESS 0x60011B08 /end MEASUREMENT
/begin MEASUREMENT MoFAirFl_MixMngtCplIfClass_V13I.ffuevaliCpl "Instance of data class for redundant quantities in connection with mixture management in function monitoring / Instance of data class for ram data redundancy of MoFAirFl_MixMngIfClass Member Variable" UWORD OneToOne 1 100 0.00 65535.00 FORMAT "%8.2" ECU_ADDRESS 0x60011B10 /end MEASUREMENT
/begin MEASUREMENT MoFAirFl_MixMngtCplIfClass_V13I.ffuevalipfiCpl "Instance of data class for redundant quantities in connection with mixture management in function monitoring / Instance of data class for ram data redundancy of MoFAirFl_MixMngIfClass Member Variable" UWORD OneToOne 1 100 0.00 65535.00 FORMAT "%8.2" ECU_ADDRESS 0x60011B12 /end MEASUREMENT
/begin MEASUREMENT MoFAirFl_MixMngtCplIfClass_V13I.fkrkAryCpl "Instance of data class for redundant quantities in connection with mixture management in function monitoring / Instance of data class for ram data redundancy of MoFAirFl_MixMngIfClass Member Variable" UWORD OneToOne 1 100 0.00 65535.00 FORMAT "%8.2" ARRAY_SIZE 4 ECU_ADDRESS 0x60011B14 /end MEASUREMENT
/begin MEASUREMENT MoFAirFl_MixMngtCplIfClass_V13I.fkrkPfiAryCpl "Instance of data class for redundant quantities in connection with mixture management in function monitoring / Instance of data class for ram data redundancy of MoFAirFl_MixMngIfClass Member Variable" UWORD OneToOne 1 100 0.00 65535.00 FORMAT "%8.2" ARRAY_SIZE 4 ECU_ADDRESS 0x60011B1C /end MEASUREMENT
/begin MEASUREMENT MoFAirFl_MixMngtCplIfClass_V13I.fkrkPfiAryRdntCpl "Instance of data class for redundant quantities in connection with mixture management in function monitoring / Instance of data class for ram data redundancy of MoFAirFl_MixMngIfClass Member Variable" UWORD OneToOne 1 100 0.00 65535.00 FORMAT "%8.2" ARRAY_SIZE 4 ECU_ADDRESS 0x60011B24 /end MEASUREMENT
/begin MEASUREMENT MoFAirFl_MixMngtCplIfClass_V13I.flgLamSplitActvCpl "Instance of data class for redundant quantities in connection with mixture management in function monitoring / Instance of data class for ram data redundancy of MoFAirFl_MixMngIfClass Member Variable" UBYTE OneToOne 1 100 0.00 255.0 FORMAT "%5.1" ECU_ADDRESS 0x60011B2C /end MEASUREMENT
/begin MEASUREMENT MoFAirFl_MixMngtCplIfClass_V13I.fnsadCpl "Instance of data class for redundant quantities in connection with mixture management in function monitoring / Instance of data class for ram data redundancy of MoFAirFl_MixMngIfClass Member Variable" UWORD OneToOne 1 100 0.00 65535.00 FORMAT "%8.2" ECU_ADDRESS 0x60011B2E /end MEASUREMENT
/begin MEASUREMENT MoFAirFl_MixMngtCplIfClass_V13I.fr2Cpl "Instance of data class for redundant quantities in connection with mixture management in function monitoring / Instance of data class for ram data redundancy of MoFAirFl_MixMngIfClass Member Variable" UWORD OneToOne 1 100 0.00 65535.00 FORMAT "%8.2" ECU_ADDRESS 0x60011B30 /end MEASUREMENT
/begin MEASUREMENT MoFAirFl_MixMngtCplIfClass_V13I.frCpl "Instance of data class for redundant quantities in connection with mixture management in function monitoring / Instance of data class for ram data redundancy of MoFAirFl_MixMngIfClass Member Variable" UWORD OneToOne 1 100 0.00 65535.00 FORMAT "%8.2" ECU_ADDRESS 0x60011B32 /end MEASUREMENT
/begin MEASUREMENT MoFAirFl_MixMngtCplIfClass_V13I.fragdi2Cpl "Instance of data class for redundant quantities in connection with mixture management in function monitoring / Instance of data class for ram data redundancy of MoFAirFl_MixMngIfClass Member Variable" UWORD OneToOne 1 100 0.00 65535.00 FORMAT "%8.2" ECU_ADDRESS 0x60011B34 /end MEASUREMENT
/begin MEASUREMENT MoFAirFl_MixMngtCplIfClass_V13I.fragdiCpl "Instance of data class for redundant quantities in connection with mixture management in function monitoring / Instance of data class for ram data redundancy of MoFAirFl_MixMngIfClass Member Variable" UWORD OneToOne 1 100 0.00 65535.00 FORMAT "%8.2" ECU_ADDRESS 0x60011B36 /end MEASUREMENT
/begin MEASUREMENT MoFAirFl_MixMngtCplIfClass_V13I.frapfi2Cpl "Instance of data class for redundant quantities in connection with mixture management in function monitoring / Instance of data class for ram data redundancy of MoFAirFl_MixMngIfClass Member Variable" UWORD OneToOne 1 100 0.00 65535.00 FORMAT "%8.2" ECU_ADDRESS 0x60011B38 /end MEASUREMENT
/begin MEASUREMENT MoFAirFl_MixMngtCplIfClass_V13I.frapfiCpl "Instance of data class for redundant quantities in connection with mixture management in function monitoring / Instance of data class for ram data redundancy of MoFAirFl_MixMngIfClass Member Variable" UWORD OneToOne 1 100 0.00 65535.00 FORMAT "%8.2" ECU_ADDRESS 0x60011B3A /end MEASUREMENT
/begin MEASUREMENT MoFAirFl_MixMngtCplIfClass_V13I.lamsbg2Cpl "Instance of data class for redundant quantities in connection with mixture management in function monitoring / Instance of data class for ram data redundancy of MoFAirFl_MixMngIfClass Member Variable" UWORD OneToOne 1 100 0.00 65535.00 FORMAT "%8.2" ECU_ADDRESS 0x60011B3C /end MEASUREMENT
/begin MEASUREMENT MoFAirFl_MixMngtCplIfClass_V13I.lamsbgCpl "Instance of data class for redundant quantities in connection with mixture management in function monitoring / Instance of data class for ram data redundancy of MoFAirFl_MixMngIfClass Member Variable" UWORD OneToOne 1 100 0.00 65535.00 FORMAT "%8.2" ECU_ADDRESS 0x60011B3E /end MEASUREMENT
/begin MEASUREMENT MoFAirFl_MixMngtCplIfClass_V13I.larils2Cpl "Instance of data class for redundant quantities in connection with mixture management in function monitoring / Instance of data class for ram data redundancy of MoFAirFl_MixMngIfClass Member Variable" UWORD OneToOne 1 100 0.00 65535.00 FORMAT "%8.2" ECU_ADDRESS 0x60011B40 /end MEASUREMENT
/begin MEASUREMENT MoFAirFl_MixMngtCplIfClass_V13I.larilsCpl "Instance of data class for redundant quantities in connection with mixture management in function monitoring / Instance of data class for ram data redundancy of MoFAirFl_MixMngIfClass Member Variable" UWORD OneToOne 1 100 0.00 65535.00 FORMAT "%8.2" ECU_ADDRESS 0x60011B42 /end MEASUREMENT
/begin MEASUREMENT MoFAirFl_MixMngtCplIfClass_V13I.rCtlPriB1Cpl "Instance of data class for redundant quantities in connection with mixture management in function monitoring / Instance of data class for ram data redundancy of MoFAirFl_MixMngIfClass Member Variable" UWORD OneToOne 1 100 0.00 65535.00 FORMAT "%8.2" ECU_ADDRESS 0x60011B44 /end MEASUREMENT
/begin MEASUREMENT MoFAirFl_MixMngtCplIfClass_V13I.rCtlPriB2Cpl "Instance of data class for redundant quantities in connection with mixture management in function monitoring / Instance of data class for ram data redundancy of MoFAirFl_MixMngIfClass Member Variable" UWORD OneToOne 1 100 0.00 65535.00 FORMAT "%8.2" ECU_ADDRESS 0x60011B46 /end MEASUREMENT
/begin MEASUREMENT MoFAirFl_MixMngtCplIfClass_V13I.ratChrgAirCylPredPfiCpl "Instance of data class for redundant quantities in connection with mixture management in function monitoring / Instance of data class for ram data redundancy of MoFAirFl_MixMngIfClass Member Variable" UWORD OneToOne 1 100 0.00 65535.00 FORMAT "%8.2" ECU_ADDRESS 0x60011B48 /end MEASUREMENT
/begin MEASUREMENT MoFAirFl_MixMngtCplIfClass_V13I.ratFuMCylIndCpl "Instance of data class for redundant quantities in connection with mixture management in function monitoring / Instance of data class for ram data redundancy of MoFAirFl_MixMngIfClass Member Variable" UWORD OneToOne 1 100 0.00 65535.00 FORMAT "%8.2" ECU_ADDRESS 0x60011B4A /end MEASUREMENT
/begin MEASUREMENT MoFAirFl_MixMngtCplIfClass_V13I.ratFuMGdiBnk2Cpl "Instance of data class for redundant quantities in connection with mixture management in function monitoring / Instance of data class for ram data redundancy of MoFAirFl_MixMngIfClass Member Variable" UWORD OneToOne 1 100 0.00 65535.00 FORMAT "%8.2" ECU_ADDRESS 0x60011B4C /end MEASUREMENT
/begin MEASUREMENT MoFAirFl_MixMngtCplIfClass_V13I.ratFuMGdiCpl "Instance of data class for redundant quantities in connection with mixture management in function monitoring / Instance of data class for ram data redundancy of MoFAirFl_MixMngIfClass Member Variable" UWORD OneToOne 1 100 0.00 65535.00 FORMAT "%8.2" ECU_ADDRESS 0x60011B4E /end MEASUREMENT
/begin MEASUREMENT MoFAirFl_MixMngtCplIfClass_V13I.ratFuMPfiBnk2Cpl "Instance of data class for redundant quantities in connection with mixture management in function monitoring / Instance of data class for ram data redundancy of MoFAirFl_MixMngIfClass Member Variable" UWORD OneToOne 1 100 0.00 65535.00 FORMAT "%8.2" ECU_ADDRESS 0x60011B50 /end MEASUREMENT
/begin MEASUREMENT MoFAirFl_MixMngtCplIfClass_V13I.ratFuMPfiCpl "Instance of data class for redundant quantities in connection with mixture management in function monitoring / Instance of data class for ram data redundancy of MoFAirFl_MixMngIfClass Member Variable" UWORD OneToOne 1 100 0.00 65535.00 FORMAT "%8.2" ECU_ADDRESS 0x60011B52 /end MEASUREMENT
/begin MEASUREMENT MoFAirFl_MixMngtCplIfClass_V13I.ratFuPrtnPfiInjAryCpl "Instance of data class for redundant quantities in connection with mixture management in function monitoring / Instance of data class for ram data redundancy of MoFAirFl_MixMngIfClass Member Variable" UWORD OneToOne 1 100 0.00 65535.00 FORMAT "%8.2" ARRAY_SIZE 4 ECU_ADDRESS 0x60011B54 /end MEASUREMENT
/begin MEASUREMENT MoFAirFl_MixMngtCplIfClass_V13I.ratFuPrtnPfiInjAryRdntCpl "Instance of data class for redundant quantities in connection with mixture management in function monitoring / Instance of data class for ram data redundancy of MoFAirFl_MixMngIfClass Member Variable" UWORD OneToOne 1 100 0.00 65535.00 FORMAT "%8.2" ARRAY_SIZE 4 ECU_ADDRESS 0x60011B5C /end MEASUREMENT
/begin MEASUREMENT MoFAirFl_MixMngtCplIfClass_V13I.ratFuPrtnPfiInjBkupAryCpl "Instance of data class for redundant quantities in connection with mixture management in function monitoring / Instance of data class for ram data redundancy of MoFAirFl_MixMngIfClass Member Variable" UWORD OneToOne 1 100 0.00 65535.00 FORMAT "%8.2" ARRAY_SIZE 4 ECU_ADDRESS 0x60011B64 /end MEASUREMENT
/begin MEASUREMENT MoFAirFl_MixMngtCplIfClass_V13I.ratPrdcAirPrtnPfiAryCpl "Instance of data class for redundant quantities in connection with mixture management in function monitoring / Instance of data class for ram data redundancy of MoFAirFl_MixMngIfClass Member Variable" UWORD OneToOne 1 100 0.00 65535.00 FORMAT "%8.2" ARRAY_SIZE 4 ECU_ADDRESS 0x60011B6C /end MEASUREMENT
/begin MEASUREMENT MoFAirFl_MixMngtCplIfClass_V13I.ratPrdcAirPrtnPfiAryRdntCpl "Instance of data class for redundant quantities in connection with mixture management in function monitoring / Instance of data class for ram data redundancy of MoFAirFl_MixMngIfClass Member Variable" UWORD OneToOne 1 100 0.00 65535.00 FORMAT "%8.2" ARRAY_SIZE 4 ECU_ADDRESS 0x60011B74 /end MEASUREMENT
/begin MEASUREMENT MoFAirFl_MixMngtCplIfClass_V13I.ratPrdcAirPrtnPfiBkupAryCpl "Instance of data class for redundant quantities in connection with mixture management in function monitoring / Instance of data class for ram data redundancy of MoFAirFl_MixMngIfClass Member Variable" UWORD OneToOne 1 100 0.00 65535.00 FORMAT "%8.2" ARRAY_SIZE 4 ECU_ADDRESS 0x60011B7C /end MEASUREMENT
/begin MEASUREMENT MoFAirFl_MixMngtCplIfClass_V13I.rkagdi2Cpl "Instance of data class for redundant quantities in connection with mixture management in function monitoring / Instance of data class for ram data redundancy of MoFAirFl_MixMngIfClass Member Variable" UWORD OneToOne 1 100 0.00 65535.00 FORMAT "%8.2" ECU_ADDRESS 0x60011B84 /end MEASUREMENT
/begin MEASUREMENT MoFAirFl_MixMngtCplIfClass_V13I.rkagdiCpl "Instance of data class for redundant quantities in connection with mixture management in function monitoring / Instance of data class for ram data redundancy of MoFAirFl_MixMngIfClass Member Variable" UWORD OneToOne 1 100 0.00 65535.00 FORMAT "%8.2" ECU_ADDRESS 0x60011B86 /end MEASUREMENT
/begin MEASUREMENT MoFAirFl_MixMngtCplIfClass_V13I.rkapfi2Cpl "Instance of data class for redundant quantities in connection with mixture management in function monitoring / Instance of data class for ram data redundancy of MoFAirFl_MixMngIfClass Member Variable" UWORD OneToOne 1 100 0.00 65535.00 FORMAT "%8.2" ECU_ADDRESS 0x60011B88 /end MEASUREMENT
/begin MEASUREMENT MoFAirFl_MixMngtCplIfClass_V13I.rkapfiCpl "Instance of data class for redundant quantities in connection with mixture management in function monitoring / Instance of data class for ram data redundancy of MoFAirFl_MixMngIfClass Member Variable" UWORD OneToOne 1 100 0.00 65535.00 FORMAT "%8.2" ECU_ADDRESS 0x60011B8A /end MEASUREMENT
/begin MEASUREMENT MoFAirFl_MixMngtCplIfClass_V13I.rkausgCpl "Instance of data class for redundant quantities in connection with mixture management in function monitoring / Instance of data class for ram data redundancy of MoFAirFl_MixMngIfClass Member Variable" UWORD OneToOne 1 100 0.00 65535.00 FORMAT "%8.2" ECU_ADDRESS 0x60011B8C /end MEASUREMENT
/begin MEASUREMENT MoFAirFl_MixMngtCplIfClass_V13I.rkteBnk1Cpl "Instance of data class for redundant quantities in connection with mixture management in function monitoring / Instance of data class for ram data redundancy of MoFAirFl_MixMngIfClass Member Variable" UWORD OneToOne 1 100 0.00 65535.00 FORMAT "%8.2" ECU_ADDRESS 0x60011B8E /end MEASUREMENT
/begin MEASUREMENT MoFAirFl_MixMngtCplIfClass_V13I.rkteBnk2Cpl "Instance of data class for redundant quantities in connection with mixture management in function monitoring / Instance of data class for ram data redundancy of MoFAirFl_MixMngIfClass Member Variable" UWORD OneToOne 1 100 0.00 65535.00 FORMAT "%8.2" ECU_ADDRESS 0x60011B90 /end MEASUREMENT
/begin MEASUREMENT MoFAirFl_MixMngtCplIfClass_V13I.rkteCpl "Instance of data class for redundant quantities in connection with mixture management in function monitoring / Instance of data class for ram data redundancy of MoFAirFl_MixMngIfClass Member Variable" UWORD OneToOne 1 100 0.00 65535.00 FORMAT "%8.2" ECU_ADDRESS 0x60011B92 /end MEASUREMENT
/begin MEASUREMENT MoFAirFl_MixMngtCplIfClass_V13I.rkukgCpl "Instance of data class for redundant quantities in connection with mixture management in function monitoring / Instance of data class for ram data redundancy of MoFAirFl_MixMngIfClass Member Variable" UWORD OneToOne 1 100 0.00 65535.00 FORMAT "%8.2" ECU_ADDRESS 0x60011B94 /end MEASUREMENT
/begin MEASUREMENT MoFAirFl_MixMngtCplIfClass_V13I.rkukgpfiCpl "Instance of data class for redundant quantities in connection with mixture management in function monitoring / Instance of data class for ram data redundancy of MoFAirFl_MixMngIfClass Member Variable" UWORD OneToOne 1 100 0.00 65535.00 FORMAT "%8.2" ECU_ADDRESS 0x60011B96 /end MEASUREMENT
/begin MEASUREMENT MoFAirFl_MixMngtCplIfClass_V13I.rlfgBnk1Cpl "Instance of data class for redundant quantities in connection with mixture management in function monitoring / Instance of data class for ram data redundancy of MoFAirFl_MixMngIfClass Member Variable" UWORD OneToOne 1 100 0.00 65535.00 FORMAT "%8.2" ECU_ADDRESS 0x60011B98 /end MEASUREMENT
/begin MEASUREMENT MoFAirFl_MixMngtCplIfClass_V13I.rlfgBnk2Cpl "Instance of data class for redundant quantities in connection with mixture management in function monitoring / Instance of data class for ram data redundancy of MoFAirFl_MixMngIfClass Member Variable" UWORD OneToOne 1 100 0.00 65535.00 FORMAT "%8.2" ECU_ADDRESS 0x60011B9A /end MEASUREMENT
/begin MEASUREMENT MoFAirFl_MixMngtCplIfClass_V13I.rlfgCpl "Instance of data class for redundant quantities in connection with mixture management in function monitoring / Instance of data class for ram data redundancy of MoFAirFl_MixMngIfClass Member Variable" UWORD OneToOne 1 100 0.00 65535.00 FORMAT "%8.2" ECU_ADDRESS 0x60011B9C /end MEASUREMENT
/begin MEASUREMENT MoFAirFl_MixMngtCplIfClass_V13I.rlpBnk1Cpl "Instance of data class for redundant quantities in connection with mixture management in function monitoring / Instance of data class for ram data redundancy of MoFAirFl_MixMngIfClass Member Variable" UWORD OneToOne 1 100 0.00 65535.00 FORMAT "%8.2" ECU_ADDRESS 0x60011B9E /end MEASUREMENT
/begin MEASUREMENT MoFAirFl_MixMngtCplIfClass_V13I.rlpBnk2Cpl "Instance of data class for redundant quantities in connection with mixture management in function monitoring / Instance of data class for ram data redundancy of MoFAirFl_MixMngIfClass Member Variable" UWORD OneToOne 1 100 0.00 65535.00 FORMAT "%8.2" ECU_ADDRESS 0x60011BA0 /end MEASUREMENT
/begin MEASUREMENT MoFAirFl_MixMngtCplIfClass_V13I.rlpCpl "Instance of data class for redundant quantities in connection with mixture management in function monitoring / Instance of data class for ram data redundancy of MoFAirFl_MixMngIfClass Member Variable" UWORD OneToOne 1 100 0.00 65535.00 FORMAT "%8.2" ECU_ADDRESS 0x60011BA2 /end MEASUREMENT
/begin MEASUREMENT MoFAirFl_MixMngtCplIfClass_V13I.rlrextBnk1Cpl "Instance of data class for redundant quantities in connection with mixture management in function monitoring / Instance of data class for ram data redundancy of MoFAirFl_MixMngIfClass Member Variable" UWORD OneToOne 1 100 0.00 65535.00 FORMAT "%8.2" ECU_ADDRESS 0x60011BA4 /end MEASUREMENT
/begin MEASUREMENT MoFAirFl_MixMngtCplIfClass_V13I.rlrextBnk2Cpl "Instance of data class for redundant quantities in connection with mixture management in function monitoring / Instance of data class for ram data redundancy of MoFAirFl_MixMngIfClass Member Variable" UWORD OneToOne 1 100 0.00 65535.00 FORMAT "%8.2" ECU_ADDRESS 0x60011BA6 /end MEASUREMENT
/begin MEASUREMENT MoFAirFl_MixMngtCplIfClass_V13I.rlrextCpl "Instance of data class for redundant quantities in connection with mixture management in function monitoring / Instance of data class for ram data redundancy of MoFAirFl_MixMngIfClass Member Variable" UWORD OneToOne 1 100 0.00 65535.00 FORMAT "%8.2" ECU_ADDRESS 0x60011BA8 /end MEASUREMENT
/begin MEASUREMENT MoFAirFl_MixMngtCplIfClass_V13I.rlrintBnk1Cpl "Instance of data class for redundant quantities in connection with mixture management in function monitoring / Instance of data class for ram data redundancy of MoFAirFl_MixMngIfClass Member Variable" UWORD OneToOne 1 100 0.00 65535.00 FORMAT "%8.2" ECU_ADDRESS 0x60011BAA /end MEASUREMENT
/begin MEASUREMENT MoFAirFl_MixMngtCplIfClass_V13I.rlrintBnk2Cpl "Instance of data class for redundant quantities in connection with mixture management in function monitoring / Instance of data class for ram data redundancy of MoFAirFl_MixMngIfClass Member Variable" UWORD OneToOne 1 100 0.00 65535.00 FORMAT "%8.2" ECU_ADDRESS 0x60011BAC /end MEASUREMENT
/begin MEASUREMENT MoFAirFl_MixMngtCplIfClass_V13I.rlrintCpl "Instance of data class for redundant quantities in connection with mixture management in function monitoring / Instance of data class for ram data redundancy of MoFAirFl_MixMngIfClass Member Variable" UWORD OneToOne 1 100 0.00 65535.00 FORMAT "%8.2" ECU_ADDRESS 0x60011BAE /end MEASUREMENT
/begin MEASUREMENT MoFAirFl_MixMngtIfClass_V13I.B_afimreq "Instance of data class for quantities in connection with mixture management in function monitoring / Instance of data class for quantities in connection with mixture management in function monitoring Member Variable" UBYTE OneToOne 1 100 0.00 255.0 FORMAT "%5.1" ECU_ADDRESS 0x600121B6 /end MEASUREMENT
/begin MEASUREMENT MoFAirFl_MixMngtIfClass_V13I.facBnk "Instance of data class for quantities in connection with mixture management in function monitoring / Instance of data class for quantities in connection with mixture management in function monitoring Member Variable" UWORD fak_uw_b2 1 100 0.00 1.999969 FORMAT "%8.6" ECU_ADDRESS 0x600121B8 /end MEASUREMENT
/begin MEASUREMENT MoFAirFl_MixMngtIfClass_V13I.facBnk2Pfi "Instance of data class for quantities in connection with mixture management in function monitoring / Instance of data class for quantities in connection with mixture management in function monitoring Member Variable" UWORD fak_uw_b2 1 100 0.00 1.999969 FORMAT "%8.6" ECU_ADDRESS 0x600121BA /end MEASUREMENT
/begin MEASUREMENT MoFAirFl_MixMngtIfClass_V13I.facBnkPfi "Instance of data class for quantities in connection with mixture management in function monitoring / Instance of data class for quantities in connection with mixture management in function monitoring Member Variable" UWORD fak_uw_b2 1 100 0.00 1.999969 FORMAT "%8.6" ECU_ADDRESS 0x600121BC /end MEASUREMENT
/begin MEASUREMENT MoFAirFl_MixMngtIfClass_V13I.facLamCtlPfiAry "Instance of data class for quantities in connection with mixture management in function monitoring / Instance of data class for quantities in connection with mixture management in function monitoring Member Variable" UWORD fak_uw_b2 1 100 0.00 1.999969 FORMAT "%8.6" ARRAY_SIZE 4 ECU_ADDRESS 0x600121BE /end MEASUREMENT
/begin MEASUREMENT MoFAirFl_MixMngtIfClass_V13I.facLamCtlPfiAryRdnt "Instance of data class for quantities in connection with mixture management in function monitoring / Instance of data class for quantities in connection with mixture management in function monitoring Member Variable" UWORD OneToOne 1 100 0.00 65535.00 FORMAT "%8.2" ARRAY_SIZE 4 ECU_ADDRESS 0x600121C6 /end MEASUREMENT
/begin MEASUREMENT MoFAirFl_MixMngtIfClass_V13I.facLamCtlPfiBkupAry "Instance of data class for quantities in connection with mixture management in function monitoring / Instance of data class for quantities in connection with mixture management in function monitoring Member Variable" UWORD fak_uw_b2 1 100 0.00 1.999969 FORMAT "%8.6" ARRAY_SIZE 4 ECU_ADDRESS 0x600121CE /end MEASUREMENT
/begin MEASUREMENT MoFAirFl_MixMngtIfClass_V13I.facPcPfiRest "Instance of data class for quantities in connection with mixture management in function monitoring / Instance of data class for quantities in connection with mixture management in function monitoring Member Variable" UWORD fak_uw_b64 1 100 0.00 63.99902 FORMAT "%8.5" ECU_ADDRESS 0x600121D6 /end MEASUREMENT
/begin MEASUREMENT MoFAirFl_MixMngtIfClass_V13I.facPcPfiRestBnk2 "Instance of data class for quantities in connection with mixture management in function monitoring / Instance of data class for quantities in connection with mixture management in function monitoring Member Variable" UWORD fak_uw_b64 1 100 0.00 63.99902 FORMAT "%8.5" ECU_ADDRESS 0x600121D8 /end MEASUREMENT
/begin MEASUREMENT MoFAirFl_MixMngtIfClass_V13I.facPcRest "Instance of data class for quantities in connection with mixture management in function monitoring / Instance of data class for quantities in connection with mixture management in function monitoring Member Variable" UWORD fak_uw_b64 1 100 0.00 63.99902 FORMAT "%8.5" ECU_ADDRESS 0x600121DA /end MEASUREMENT
/begin MEASUREMENT MoFAirFl_MixMngtIfClass_V13I.facPrtnPfi "Instance of data class for quantities in connection with mixture management in function monitoring / Instance of data class for quantities in connection with mixture management in function monitoring Member Variable" UBYTE fak_ub_b1 1 100 0.00 0.9961 ECU_ADDRESS 0x600121DC /end MEASUREMENT
/begin MEASUREMENT MoFAirFl_MixMngtIfClass_V13I.facPrtnPfiAry "Instance of data class for quantities in connection with mixture management in function monitoring / Instance of data class for quantities in connection with mixture management in function monitoring Member Variable" UBYTE fak_ub_b1 1 100 0.00 0.9961 ARRAY_SIZE 4 ECU_ADDRESS 0x600121DD /end MEASUREMENT
/begin MEASUREMENT MoFAirFl_MixMngtIfClass_V13I.facPrtnPfiAryRdnt "Instance of data class for quantities in connection with mixture management in function monitoring / Instance of data class for quantities in connection with mixture management in function monitoring Member Variable" UBYTE OneToOne 1 100 0.00 255.0 FORMAT "%5.1" ARRAY_SIZE 4 ECU_ADDRESS 0x600121E1 /end MEASUREMENT
/begin MEASUREMENT MoFAirFl_MixMngtIfClass_V13I.facPrtnPfiBkupAry "Instance of data class for quantities in connection with mixture management in function monitoring / Instance of data class for quantities in connection with mixture management in function monitoring Member Variable" UBYTE fak_ub_b1 1 100 0.00 0.9961 ARRAY_SIZE 4 ECU_ADDRESS 0x600121E5 /end MEASUREMENT
/begin MEASUREMENT MoFAirFl_MixMngtIfClass_V13I.fakeslsa "Instance of data class for quantities in connection with mixture management in function monitoring / Instance of data class for quantities in connection with mixture management in function monitoring Member Variable" UWORD fak_uw_b2 1 100 0.00 1.999969 FORMAT "%8.6" ARRAY_SIZE 4 ECU_ADDRESS 0x600121EA /end MEASUREMENT
/begin MEASUREMENT MoFAirFl_MixMngtIfClass_V13I.ffuevali "Instance of data class for quantities in connection with mixture management in function monitoring / Instance of data class for quantities in connection with mixture management in function monitoring Member Variable" UWORD fak_uw_b64 1 100 0.00 63.99902 FORMAT "%8.5" ECU_ADDRESS 0x600121F2 /end MEASUREMENT
/begin MEASUREMENT MoFAirFl_MixMngtIfClass_V13I.ffuevalipfi "Instance of data class for quantities in connection with mixture management in function monitoring / Instance of data class for quantities in connection with mixture management in function monitoring Member Variable" UWORD fak_uw_b64 1 100 0.00 63.99902 FORMAT "%8.5" ECU_ADDRESS 0x600121F4 /end MEASUREMENT
/begin MEASUREMENT MoFAirFl_MixMngtIfClass_V13I.fkrkAry "Instance of data class for quantities in connection with mixture management in function monitoring / Instance of data class for quantities in connection with mixture management in function monitoring Member Variable" UWORD fak_uw_b2 1 100 0.00 1.999969 FORMAT "%8.6" ARRAY_SIZE 4 ECU_ADDRESS 0x600121F6 /end MEASUREMENT
/begin MEASUREMENT MoFAirFl_MixMngtIfClass_V13I.fkrkPfiAry "Instance of data class for quantities in connection with mixture management in function monitoring / Instance of data class for quantities in connection with mixture management in function monitoring Member Variable" UWORD fak_uw_b2 1 100 0.00 1.999969 FORMAT "%8.6" ARRAY_SIZE 4 ECU_ADDRESS 0x600121FE /end MEASUREMENT
/begin MEASUREMENT MoFAirFl_MixMngtIfClass_V13I.fkrkPfiAryRdnt "Instance of data class for quantities in connection with mixture management in function monitoring / Instance of data class for quantities in connection with mixture management in function monitoring Member Variable" UWORD OneToOne 1 100 0.00 65535.00 FORMAT "%8.2" ARRAY_SIZE 4 ECU_ADDRESS 0x60012206 /end MEASUREMENT
/begin MEASUREMENT MoFAirFl_MixMngtIfClass_V13I.flgLamSplitActv "Instance of data class for quantities in connection with mixture management in function monitoring / Instance of data class for quantities in connection with mixture management in function monitoring Member Variable" UBYTE OneToOne 1 100 0.00 255.0 FORMAT "%5.1" ECU_ADDRESS 0x6001220E /end MEASUREMENT
/begin MEASUREMENT MoFAirFl_MixMngtIfClass_V13I.fnsad "Instance of data class for quantities in connection with mixture management in function monitoring / Instance of data class for quantities in connection with mixture management in function monitoring Member Variable" UWORD fak_uw_b2 1 100 0.00 1.999969 FORMAT "%8.6" ECU_ADDRESS 0x60012210 /end MEASUREMENT
/begin MEASUREMENT MoFAirFl_MixMngtIfClass_V13I.fr "Instance of data class for quantities in connection with mixture management in function monitoring / Instance of data class for quantities in connection with mixture management in function monitoring Member Variable" UWORD fak_uw_b2 1 100 0.00 1.999969 FORMAT "%8.6" ECU_ADDRESS 0x60012212 /end MEASUREMENT
/begin MEASUREMENT MoFAirFl_MixMngtIfClass_V13I.fr2 "Instance of data class for quantities in connection with mixture management in function monitoring / Instance of data class for quantities in connection with mixture management in function monitoring Member Variable" UWORD fak_uw_b2 1 100 0.00 1.999969 FORMAT "%8.6" ECU_ADDRESS 0x60012214 /end MEASUREMENT
/begin MEASUREMENT MoFAirFl_MixMngtIfClass_V13I.fragdi "Instance of data class for quantities in connection with mixture management in function monitoring / Instance of data class for quantities in connection with mixture management in function monitoring Member Variable" UWORD fak_uw_b2 1 100 0.00 1.999969 FORMAT "%8.6" ECU_ADDRESS 0x60012216 /end MEASUREMENT
/begin MEASUREMENT MoFAirFl_MixMngtIfClass_V13I.fragdi2 "Instance of data class for quantities in connection with mixture management in function monitoring / Instance of data class for quantities in connection with mixture management in function monitoring Member Variable" UWORD fak_uw_b2 1 100 0.00 1.999969 FORMAT "%8.6" ECU_ADDRESS 0x60012218 /end MEASUREMENT
/begin MEASUREMENT MoFAirFl_MixMngtIfClass_V13I.frapfi "Instance of data class for quantities in connection with mixture management in function monitoring / Instance of data class for quantities in connection with mixture management in function monitoring Member Variable" UWORD fak_uw_b2 1 100 0.00 1.999969 FORMAT "%8.6" ECU_ADDRESS 0x6001221A /end MEASUREMENT
/begin MEASUREMENT MoFAirFl_MixMngtIfClass_V13I.frapfi2 "Instance of data class for quantities in connection with mixture management in function monitoring / Instance of data class for quantities in connection with mixture management in function monitoring Member Variable" UWORD fak_uw_b2 1 100 0.00 1.999969 FORMAT "%8.6" ECU_ADDRESS 0x6001221C /end MEASUREMENT
/begin MEASUREMENT MoFAirFl_MixMngtIfClass_V13I.lamsbg "Instance of data class for quantities in connection with mixture management in function monitoring / Instance of data class for quantities in connection with mixture management in function monitoring Member Variable" UWORD fak_uw_b16 1 100 0.00 15.99976 FORMAT "%8.5" ECU_ADDRESS 0x6001221E /end MEASUREMENT
/begin MEASUREMENT MoFAirFl_MixMngtIfClass_V13I.lamsbg2 "Instance of data class for quantities in connection with mixture management in function monitoring / Instance of data class for quantities in connection with mixture management in function monitoring Member Variable" UWORD fak_uw_b16 1 100 0.00 15.99976 FORMAT "%8.5" ECU_ADDRESS 0x60012220 /end MEASUREMENT
/begin MEASUREMENT MoFAirFl_MixMngtIfClass_V13I.larils "Instance of data class for quantities in connection with mixture management in function monitoring / Instance of data class for quantities in connection with mixture management in function monitoring Member Variable" UWORD fak_q0p000244 1 100 0.00 15.99976 FORMAT "%8.5" ECU_ADDRESS 0x60012222 /end MEASUREMENT
/begin MEASUREMENT MoFAirFl_MixMngtIfClass_V13I.larils2 "Instance of data class for quantities in connection with mixture management in function monitoring / Instance of data class for quantities in connection with mixture management in function monitoring Member Variable" UWORD fak_q0p000244 1 100 0.00 15.99976 FORMAT "%8.5" ECU_ADDRESS 0x60012224 /end MEASUREMENT
/begin MEASUREMENT MoFAirFl_MixMngtIfClass_V13I.rCtlPriB1 "Instance of data class for quantities in connection with mixture management in function monitoring / Instance of data class for quantities in connection with mixture management in function monitoring Member Variable" SWORD fak_sw_b1 1 100 -1.000000 0.999969 FORMAT "%8.6" ECU_ADDRESS 0x60012226 /end MEASUREMENT
/begin MEASUREMENT MoFAirFl_MixMngtIfClass_V13I.rCtlPriB2 "Instance of data class for quantities in connection with mixture management in function monitoring / Instance of data class for quantities in connection with mixture management in function monitoring Member Variable" SWORD fak_sw_b1 1 100 -1.000000 0.999969 FORMAT "%8.6" ECU_ADDRESS 0x60012228 /end MEASUREMENT
/begin MEASUREMENT MoFAirFl_MixMngtIfClass_V13I.ratChrgAirCylPredPfi "Instance of data class for quantities in connection with mixture management in function monitoring / Instance of data class for quantities in connection with mixture management in function monitoring Member Variable" UWORD rel_uw_q0p0234 1 100 0.00 1535.977 FORMAT "%8.3" ECU_ADDRESS 0x6001222A /end MEASUREMENT
/begin MEASUREMENT MoFAirFl_MixMngtIfClass_V13I.ratFuMCylInd "Instance of data class for quantities in connection with mixture management in function monitoring / Instance of data class for quantities in connection with mixture management in function monitoring Member Variable" UWORD rel_uw_b3072 1 100 0.00 3071.953 FORMAT "%8.3" ECU_ADDRESS 0x6001222C /end MEASUREMENT
/begin MEASUREMENT MoFAirFl_MixMngtIfClass_V13I.ratFuMGdi "Instance of data class for quantities in connection with mixture management in function monitoring / Instance of data class for quantities in connection with mixture management in function monitoring Member Variable" UWORD rel_uw_b3072 1 100 0.00 3071.953 FORMAT "%8.3" ECU_ADDRESS 0x6001222E /end MEASUREMENT
/begin MEASUREMENT MoFAirFl_MixMngtIfClass_V13I.ratFuMGdiBnk2 "Instance of data class for quantities in connection with mixture management in function monitoring / Instance of data class for quantities in connection with mixture management in function monitoring Member Variable" UWORD rel_uw_b3072 1 100 0.00 3071.953 FORMAT "%8.3" ECU_ADDRESS 0x60012230 /end MEASUREMENT
/begin MEASUREMENT MoFAirFl_MixMngtIfClass_V13I.ratFuMPfi "Instance of data class for quantities in connection with mixture management in function monitoring / Instance of data class for quantities in connection with mixture management in function monitoring Member Variable" UWORD rel_uw_b3072 1 100 0.00 3071.953 FORMAT "%8.3" ECU_ADDRESS 0x60012232 /end MEASUREMENT
/begin MEASUREMENT MoFAirFl_MixMngtIfClass_V13I.ratFuMPfiBnk2 "Instance of data class for quantities in connection with mixture management in function monitoring / Instance of data class for quantities in connection with mixture management in function monitoring Member Variable" UWORD rel_uw_b3072 1 100 0.00 3071.953 FORMAT "%8.3" ECU_ADDRESS 0x60012234 /end MEASUREMENT
/begin MEASUREMENT MoFAirFl_MixMngtIfClass_V13I.ratFuPrtnPfiInjAry "Instance of data class for quantities in connection with mixture management in function monitoring / Instance of data class for quantities in connection with mixture management in function monitoring Member Variable" UWORD rel_uw_b3072 1 100 0.00 3071.953 FORMAT "%8.3" ARRAY_SIZE 4 ECU_ADDRESS 0x60012236 /end MEASUREMENT
/begin MEASUREMENT MoFAirFl_MixMngtIfClass_V13I.ratFuPrtnPfiInjAryRdnt "Instance of data class for quantities in connection with mixture management in function monitoring / Instance of data class for quantities in connection with mixture management in function monitoring Member Variable" UWORD OneToOne 1 100 0.00 65535.00 FORMAT "%8.2" ARRAY_SIZE 4 ECU_ADDRESS 0x6001223E /end MEASUREMENT
/begin MEASUREMENT MoFAirFl_MixMngtIfClass_V13I.ratFuPrtnPfiInjBkupAry "Instance of data class for quantities in connection with mixture management in function monitoring / Instance of data class for quantities in connection with mixture management in function monitoring Member Variable" UWORD rel_uw_b3072 1 100 0.00 3071.953 FORMAT "%8.3" ARRAY_SIZE 4 ECU_ADDRESS 0x60012246 /end MEASUREMENT
/begin MEASUREMENT MoFAirFl_MixMngtIfClass_V13I.ratPrdcAirPrtnPfiAry "Instance of data class for quantities in connection with mixture management in function monitoring / Instance of data class for quantities in connection with mixture management in function monitoring Member Variable" UWORD rel_uw_q0p0234 1 100 0.00 1535.977 FORMAT "%8.3" ARRAY_SIZE 4 ECU_ADDRESS 0x6001224E /end MEASUREMENT
/begin MEASUREMENT MoFAirFl_MixMngtIfClass_V13I.ratPrdcAirPrtnPfiAryRdnt "Instance of data class for quantities in connection with mixture management in function monitoring / Instance of data class for quantities in connection with mixture management in function monitoring Member Variable" UWORD OneToOne 1 100 0.00 65535.00 FORMAT "%8.2" ARRAY_SIZE 4 ECU_ADDRESS 0x60012256 /end MEASUREMENT
/begin MEASUREMENT MoFAirFl_MixMngtIfClass_V13I.ratPrdcAirPrtnPfiBkupAry "Instance of data class for quantities in connection with mixture management in function monitoring / Instance of data class for quantities in connection with mixture management in function monitoring Member Variable" UWORD rel_uw_q0p0234 1 100 0.00 1535.977 FORMAT "%8.3" ARRAY_SIZE 4 ECU_ADDRESS 0x6001225E /end MEASUREMENT
/begin MEASUREMENT MoFAirFl_MixMngtIfClass_V13I.rkagdi "Instance of data class for quantities in connection with mixture management in function monitoring / Instance of data class for quantities in connection with mixture management in function monitoring Member Variable" SWORD rel_sw_b1536 1 100 -1536.000 1535.953 FORMAT "%8.3" ECU_ADDRESS 0x60012266 /end MEASUREMENT
/begin MEASUREMENT MoFAirFl_MixMngtIfClass_V13I.rkagdi2 "Instance of data class for quantities in connection with mixture management in function monitoring / Instance of data class for quantities in connection with mixture management in function monitoring Member Variable" SWORD rel_sw_b1536 1 100 -1536.000 1535.953 FORMAT "%8.3" ECU_ADDRESS 0x60012268 /end MEASUREMENT
/begin MEASUREMENT MoFAirFl_MixMngtIfClass_V13I.rkapfi "Instance of data class for quantities in connection with mixture management in function monitoring / Instance of data class for quantities in connection with mixture management in function monitoring Member Variable" SWORD rel_sw_b1536 1 100 -1536.000 1535.953 FORMAT "%8.3" ECU_ADDRESS 0x6001226A /end MEASUREMENT
/begin MEASUREMENT MoFAirFl_MixMngtIfClass_V13I.rkapfi2 "Instance of data class for quantities in connection with mixture management in function monitoring / Instance of data class for quantities in connection with mixture management in function monitoring Member Variable" SWORD rel_sw_b1536 1 100 -1536.000 1535.953 FORMAT "%8.3" ECU_ADDRESS 0x6001226C /end MEASUREMENT
/begin MEASUREMENT MoFAirFl_MixMngtIfClass_V13I.rkausg "Instance of data class for quantities in connection with mixture management in function monitoring / Instance of data class for quantities in connection with mixture management in function monitoring Member Variable" SWORD rel_sw_b1536 1 100 -1536.000 1535.953 FORMAT "%8.3" ECU_ADDRESS 0x6001226E /end MEASUREMENT
/begin MEASUREMENT MoFAirFl_MixMngtIfClass_V13I.rkte "Instance of data class for quantities in connection with mixture management in function monitoring / Instance of data class for quantities in connection with mixture management in function monitoring Member Variable" SWORD rel_sw_b1536 1 100 -1536.000 1535.953 FORMAT "%8.3" ECU_ADDRESS 0x60012270 /end MEASUREMENT
/begin MEASUREMENT MoFAirFl_MixMngtIfClass_V13I.rkteBnk1 "Instance of data class for quantities in connection with mixture management in function monitoring / Instance of data class for quantities in connection with mixture management in function monitoring Member Variable" SWORD rel_sw_b1536 1 100 -1536.000 1535.953 FORMAT "%8.3" ECU_ADDRESS 0x60012272 /end MEASUREMENT
/begin MEASUREMENT MoFAirFl_MixMngtIfClass_V13I.rkteBnk2 "Instance of data class for quantities in connection with mixture management in function monitoring / Instance of data class for quantities in connection with mixture management in function monitoring Member Variable" SWORD rel_sw_b1536 1 100 -1536.000 1535.953 FORMAT "%8.3" ECU_ADDRESS 0x60012274 /end MEASUREMENT
/begin MEASUREMENT MoFAirFl_MixMngtIfClass_V13I.rkukg "Instance of data class for quantities in connection with mixture management in function monitoring / Instance of data class for quantities in connection with mixture management in function monitoring Member Variable" SWORD rel_sw_b1536 1 100 -1536.000 1535.953 FORMAT "%8.3" ECU_ADDRESS 0x60012276 /end MEASUREMENT
/begin MEASUREMENT MoFAirFl_MixMngtIfClass_V13I.rkukgpfi "Instance of data class for quantities in connection with mixture management in function monitoring / Instance of data class for quantities in connection with mixture management in function monitoring Member Variable" SWORD rel_sw_b1536 1 100 -1536.000 1535.953 FORMAT "%8.3" ECU_ADDRESS 0x60012278 /end MEASUREMENT
/begin MEASUREMENT MoFAirFl_MixMngtIfClass_V13I.rlfg "Instance of data class for quantities in connection with mixture management in function monitoring / Instance of data class for quantities in connection with mixture management in function monitoring Member Variable" UWORD rel_uw_q0p0234 1 100 0.00 1535.977 FORMAT "%8.3" ECU_ADDRESS 0x6001227A /end MEASUREMENT
/begin MEASUREMENT MoFAirFl_MixMngtIfClass_V13I.rlfgBnk1 "Instance of data class for quantities in connection with mixture management in function monitoring / Instance of data class for quantities in connection with mixture management in function monitoring Member Variable" UWORD rel_uw_q0p0234 1 100 0.00 1535.977 FORMAT "%8.3" ECU_ADDRESS 0x6001227C /end MEASUREMENT
/begin MEASUREMENT MoFAirFl_MixMngtIfClass_V13I.rlfgBnk2 "Instance of data class for quantities in connection with mixture management in function monitoring / Instance of data class for quantities in connection with mixture management in function monitoring Member Variable" UWORD rel_uw_q0p0234 1 100 0.00 1535.977 FORMAT "%8.3" ECU_ADDRESS 0x6001227E /end MEASUREMENT
/begin MEASUREMENT MoFAirFl_MixMngtIfClass_V13I.rlp "Instance of data class for quantities in connection with mixture management in function monitoring / Instance of data class for quantities in connection with mixture management in function monitoring Member Variable" UWORD rel_uw_q0p0234 1 100 0.00 1535.977 FORMAT "%8.3" ECU_ADDRESS 0x60012280 /end MEASUREMENT
/begin MEASUREMENT MoFAirFl_MixMngtIfClass_V13I.rlpBnk1 "Instance of data class for quantities in connection with mixture management in function monitoring / Instance of data class for quantities in connection with mixture management in function monitoring Member Variable" UWORD rel_uw_q0p0234 1 100 0.00 1535.977 FORMAT "%8.3" ECU_ADDRESS 0x60012282 /end MEASUREMENT
/begin MEASUREMENT MoFAirFl_MixMngtIfClass_V13I.rlpBnk2 "Instance of data class for quantities in connection with mixture management in function monitoring / Instance of data class for quantities in connection with mixture management in function monitoring Member Variable" UWORD rel_uw_q0p0234 1 100 0.00 1535.977 FORMAT "%8.3" ECU_ADDRESS 0x60012284 /end MEASUREMENT
/begin MEASUREMENT MoFAirFl_MixMngtIfClass_V13I.rlrext "Instance of data class for quantities in connection with mixture management in function monitoring / Instance of data class for quantities in connection with mixture management in function monitoring Member Variable" UWORD rel_uw_q0p0234 1 100 0.00 1535.977 FORMAT "%8.3" ECU_ADDRESS 0x60012286 /end MEASUREMENT
/begin MEASUREMENT MoFAirFl_MixMngtIfClass_V13I.rlrextBnk1 "Instance of data class for quantities in connection with mixture management in function monitoring / Instance of data class for quantities in connection with mixture management in function monitoring Member Variable" UWORD rel_uw_q0p0234 1 100 0.00 1535.977 FORMAT "%8.3" ECU_ADDRESS 0x60012288 /end MEASUREMENT
/begin MEASUREMENT MoFAirFl_MixMngtIfClass_V13I.rlrextBnk2 "Instance of data class for quantities in connection with mixture management in function monitoring / Instance of data class for quantities in connection with mixture management in function monitoring Member Variable" UWORD rel_uw_q0p0234 1 100 0.00 1535.977 FORMAT "%8.3" ECU_ADDRESS 0x6001228A /end MEASUREMENT
/begin MEASUREMENT MoFAirFl_MixMngtIfClass_V13I.rlrint "Instance of data class for quantities in connection with mixture management in function monitoring / Instance of data class for quantities in connection with mixture management in function monitoring Member Variable" UWORD rel_uw_q0p0234 1 100 0.00 1535.977 FORMAT "%8.3" ECU_ADDRESS 0x6001228C /end MEASUREMENT
/begin MEASUREMENT MoFAirFl_MixMngtIfClass_V13I.rlrintBnk1 "Instance of data class for quantities in connection with mixture management in function monitoring / Instance of data class for quantities in connection with mixture management in function monitoring Member Variable" UWORD rel_uw_q0p0234 1 100 0.00 1535.977 FORMAT "%8.3" ECU_ADDRESS 0x6001228E /end MEASUREMENT
/begin MEASUREMENT MoFAirFl_MixMngtIfClass_V13I.rlrintBnk2 "Instance of data class for quantities in connection with mixture management in function monitoring / Instance of data class for quantities in connection with mixture management in function monitoring Member Variable" UWORD rel_uw_q0p0234 1 100 0.00 1535.977 FORMAT "%8.3" ECU_ADDRESS 0x60012290 /end MEASUREMENT
/begin MEASUREMENT MoFAirFl_nEngOld "Engine speed (pld value) in function MoFAirFl_In" UBYTE nmot_q40 1 100 0.00 10200. FORMAT "%5.0" ECU_ADDRESS 0x600122E3 /end MEASUREMENT
/begin MEASUREMENT MoFAirFl_nEngOldCpl "Ram data redundancy for MoFAirFl_nEngOld" UBYTE OneToOne 1 100 0.00 255.0 FORMAT "%5.1" ECU_ADDRESS 0x60011BFC /end MEASUREMENT
/begin MEASUREMENT MoFAirFl_ratFillg "Relative air charge in function monitoring" UWORD rel_uw_q0p0234 1 100 0.00 1535.977 FORMAT "%8.3" ECU_ADDRESS 0x60012180 /end MEASUREMENT
/begin MEASUREMENT MoFAirFl_ratFillgCpl "RAM data redundancy of MoFAirFl_ratFillg" UWORD OneToOne 1 100 0.00 65535.00 FORMAT "%8.2" ECU_ADDRESS 0x60011AA0 /end MEASUREMENT
/begin MEASUREMENT MoFAirFl_ratFillgFrsh "Relative air charge (fresh air) in function monitoring" UWORD rel_uw_q0p0234 1 100 0.00 1535.977 FORMAT "%8.3" ECU_ADDRESS 0x6001217E /end MEASUREMENT
/begin MEASUREMENT MoFAirFl_ratFillgFrshCpl "RAM data redundancy of MoFAirFl_ratFillgFrsh" UWORD OneToOne 1 100 0.00 65535.00 FORMAT "%8.2" ECU_ADDRESS 0x60011A9E /end MEASUREMENT
/begin MEASUREMENT MoFAirFl_ratFillgTot "Relative air charge (total) in function monitoring" UWORD rel_uw_q0p0234 1 100 0.00 1535.977 FORMAT "%8.3" ECU_ADDRESS 0x6001217C /end MEASUREMENT
/begin MEASUREMENT MoFAirFl_ratFillgTotCpl "RAM data redundancy of MoFAirFl_ratFillgTot" UWORD OneToOne 1 100 0.00 65535.00 FORMAT "%8.2" ECU_ADDRESS 0x60011A9C /end MEASUREMENT
/begin MEASUREMENT MoFAirFl_ratFillg_Ax_result "Result of grid search for air charge in function monitoring" SLONG dez 1 100 -2147483648.00 2147483647.00 FORMAT "%13.2" ECU_ADDRESS 0x60012188 /end MEASUREMENT
/begin MEASUREMENT MoFAirFl_ratFillg_Ax_result_Cpl "RAM data redundancy of MoFAirFl_ratFillg_Ax_result" ULONG OneToOne 1 100 0.00 4294967295.00 FORMAT "%13.2" ECU_ADDRESS 0x60011AA8 /end MEASUREMENT
/begin MEASUREMENT MoFAirFl_ratFuMPfiExpt "Expected value for relative fuel mass in function monitoring (PFI)" UWORD rel_uw_b3072 1 100 0.00 3071.953 FORMAT "%8.3" ECU_ADDRESS 0x60012198 /end MEASUREMENT
/begin MEASUREMENT MoFAirFl_ratFuMPfiExptBnk2 "Expected value for relative fuel mass bank 2 in function monitoring (PFI)" UWORD rel_uw_b3072 1 100 0.00 3071.953 FORMAT "%8.3" ECU_ADDRESS 0x60012196 /end MEASUREMENT
/begin MEASUREMENT MoFAirFl_ratFuMPfiExptBnk2Cpl "RAM data redundancy for MoFAirFl_ratFuMPfiExptBnk2" UWORD OneToOne 1 100 0.00 65535.00 FORMAT "%8.2" ECU_ADDRESS 0x60011AB8 /end MEASUREMENT
/begin MEASUREMENT MoFAirFl_ratFuMPfiExptCpl "RAM data redundancy for MoFAirFl_ratFuMPfiExpt" UWORD OneToOne 1 100 0.00 65535.00 FORMAT "%8.2" ECU_ADDRESS 0x60011AB6 /end MEASUREMENT
/begin MEASUREMENT MoFAirFl_ratFuMTotPfiExpt "Expected value for relative fuel mass total in function monitoring (PFI)" UWORD rel_uw_b3072 1 100 0.00 3071.953 FORMAT "%8.3" ECU_ADDRESS 0x60012194 /end MEASUREMENT
/begin MEASUREMENT MoFAirFl_ratFuMTotPfiExptBnk2 "Expected value for relative fuel mass total bank 2 in function monitoring (PFI)" UWORD rel_uw_b3072 1 100 0.00 3071.953 FORMAT "%8.3" ECU_ADDRESS 0x60012192 /end MEASUREMENT
/begin MEASUREMENT MoFAirFl_ratFuMTotPfiExptBnk2Cpl "RAM data redundancy for MoFAirFl_ratFuMTotPfiExptBnk2" UWORD OneToOne 1 100 0.00 65535.00 FORMAT "%8.2" ECU_ADDRESS 0x60011AB4 /end MEASUREMENT
/begin MEASUREMENT MoFAirFl_ratFuMTotPfiExptCpl "RAM data redundancy for MoFAirFl_ratFuMTotPfiExpt" UWORD OneToOne 1 100 0.00 65535.00 FORMAT "%8.2" ECU_ADDRESS 0x60011AB2 /end MEASUREMENT
/begin MEASUREMENT MoFAirFl_rktechk_ratFumTotPfi_MP "Measuring point for rkte check in function monitoring" ULONG rel_uw_b3072 1 100 0.00 201326591.953 FORMAT "%13.3" ECU_ADDRESS 0x70008C1C /end MEASUREMENT
/begin MEASUREMENT MoFAirFl_stErrCplIn "Status error information" UWORD OneToOne 1 100 0.00 65535.00 FORMAT "%8.2" ECU_ADDRESS 0x600122D4 /end MEASUREMENT
/begin MEASUREMENT MoFAirFl_stErrMixCtlPfiChkAirFlMsg "State error information from MoFAirFl_MixCtlPfi (AirFl, exported)" UBYTE OneToOne 1 100 0.00 255.0 FORMAT "%5.1" ECU_ADDRESS 0x6000A336 /end MEASUREMENT
/begin MEASUREMENT MoFAirFl_stErrMixCtlPfiChkAirFl_MP "State error information from MoFAirFl_MixCtlPfi (AirFl)" UBYTE OneToOne 1 100 0.00 255.0 FORMAT "%5.1" ECU_ADDRESS 0x70008C1A /end MEASUREMENT
/begin MEASUREMENT MoFAirFl_stErrMixCtlPfiChkCtrlMsg "State error information from MoFAirFl_MixCtlPfi (Ctrl, exported)" UBYTE OneToOne 1 100 0.00 255.0 FORMAT "%5.1" ECU_ADDRESS 0x6000A335 /end MEASUREMENT
/begin MEASUREMENT MoFAirFl_stErrMixCtlPfiChkCtrl_MP "State error information from MoFAirFl_MixCtlPfi (Ctrl)" UBYTE OneToOne 1 100 0.00 255.0 FORMAT "%5.1" ECU_ADDRESS 0x70008C19 /end MEASUREMENT
/begin MEASUREMENT MoFAirFl_stErrModeMsg "State error information from MoFAirFl_Mode (exported)" UBYTE OneToOne 1 100 0.00 255.0 FORMAT "%5.1" ECU_ADDRESS 0x6000A334 /end MEASUREMENT
/begin MEASUREMENT MoFAirFl_stErrMode_MP "State error information from MoFAirFl_Mode" UBYTE OneToOne 1 100 0.00 255.0 FORMAT "%5.1" ECU_ADDRESS 0x70008C18 /end MEASUREMENT
/begin MEASUREMENT MoFAirFl_TrqActCplIfClass_V13I.agIntkClsdCpl "Instance of data class for redundant quantities in connection with actual torque in function monitoring / Instance of data class for ram data redundancy of MoFAirFl_TrqActIfClass Member Variable" UWORD OneToOne 1 100 0.00 65535.00 FORMAT "%8.2" ECU_ADDRESS 0x60011ABC /end MEASUREMENT
/begin MEASUREMENT MoFAirFl_TrqActCplIfClass_V13I.dzworriCpl "Instance of data class for redundant quantities in connection with actual torque in function monitoring / Instance of data class for ram data redundancy of MoFAirFl_TrqActIfClass Member Variable" UBYTE OneToOne 1 100 0.00 255.0 FORMAT "%5.1" ECU_ADDRESS 0x60011ABE /end MEASUREMENT
/begin MEASUREMENT MoFAirFl_TrqActCplIfClass_V13I.etaaufteCpl "Instance of data class for redundant quantities in connection with actual torque in function monitoring / Instance of data class for ram data redundancy of MoFAirFl_TrqActIfClass Member Variable" UWORD OneToOne 1 100 0.00 65535.00 FORMAT "%8.2" ECU_ADDRESS 0x60011AC0 /end MEASUREMENT
/begin MEASUREMENT MoFAirFl_TrqActCplIfClass_V13I.etazwistCpl "Instance of data class for redundant quantities in connection with actual torque in function monitoring / Instance of data class for ram data redundancy of MoFAirFl_TrqActIfClass Member Variable" UWORD OneToOne 1 100 0.00 65535.00 FORMAT "%8.2" ECU_ADDRESS 0x60011AC2 /end MEASUREMENT
/begin MEASUREMENT MoFAirFl_TrqActCplIfClass_V13I.ratInertCylCpl "Instance of data class for redundant quantities in connection with actual torque in function monitoring / Instance of data class for ram data redundancy of MoFAirFl_TrqActIfClass Member Variable" UWORD OneToOne 1 100 0.00 65535.00 FORMAT "%8.2" ECU_ADDRESS 0x60011AC4 /end MEASUREMENT
/begin MEASUREMENT MoFAirFl_TrqActCplIfClass_V13I.ratInertEgrExtCylCpl "Instance of data class for redundant quantities in connection with actual torque in function monitoring / Instance of data class for ram data redundancy of MoFAirFl_TrqActIfClass Member Variable" UWORD OneToOne 1 100 0.00 65535.00 FORMAT "%8.2" ECU_ADDRESS 0x60011AC6 /end MEASUREMENT
/begin MEASUREMENT MoFAirFl_TrqActCplIfClass_V13I.ratInertEgrIntCylCpl "Instance of data class for redundant quantities in connection with actual torque in function monitoring / Instance of data class for ram data redundancy of MoFAirFl_TrqActIfClass Member Variable" UWORD OneToOne 1 100 0.00 65535.00 FORMAT "%8.2" ECU_ADDRESS 0x60011AC8 /end MEASUREMENT
/begin MEASUREMENT MoFAirFl_TrqActCplIfClass_V13I.zwcalcar_zzylzueCpl "Instance of data class for redundant quantities in connection with actual torque in function monitoring / Instance of data class for ram data redundancy of MoFAirFl_TrqActIfClass Member Variable" UBYTE OneToOne 1 100 0.00 255.0 FORMAT "%5.1" ECU_ADDRESS 0x60011ACA /end MEASUREMENT
/begin MEASUREMENT MoFAirFl_TrqActCplIfClass_V13I.zwoptCpl "Instance of data class for redundant quantities in connection with actual torque in function monitoring / Instance of data class for ram data redundancy of MoFAirFl_TrqActIfClass Member Variable" UBYTE OneToOne 1 100 0.00 255.0 FORMAT "%5.1" ECU_ADDRESS 0x60011ACB /end MEASUREMENT
/begin MEASUREMENT MoFAirFl_TrqActCplIfClass_V13I.zwoutCpl "Instance of data class for redundant quantities in connection with actual torque in function monitoring / Instance of data class for ram data redundancy of MoFAirFl_TrqActIfClass Member Variable" UBYTE OneToOne 1 100 0.00 255.0 FORMAT "%5.1" ECU_ADDRESS 0x60011ACC /end MEASUREMENT
/begin MEASUREMENT MoFAirFl_TrqActCplIfClass_V13I.zwoutcplCpl "Instance of data class for redundant quantities in connection with actual torque in function monitoring / Instance of data class for ram data redundancy of MoFAirFl_TrqActIfClass Member Variable" UBYTE OneToOne 1 100 0.00 255.0 FORMAT "%5.1" ECU_ADDRESS 0x60011ACD /end MEASUREMENT
/begin MEASUREMENT MoFAirFl_TrqActCplIfClass_V13I.zwouthireslAry_zzylzueCpl "Instance of data class for redundant quantities in connection with actual torque in function monitoring / Instance of data class for redundant quantities in connection with actual torque in function monitoring Instance of data class for ram data redundancy of MoFAirFl_TrqActIfClass Member Variable" UWORD OneToOne 1 100 0.00 65535.00 FORMAT "%8.2" ECU_ADDRESS 0x60011ACE /end MEASUREMENT
/begin MEASUREMENT MoFAirFl_TrqActCplIfClass_V13I.zwouthireslCpl "Instance of data class for redundant quantities in connection with actual torque in function monitoring / Instance of data class for redundant quantities in connection with actual torque in function monitoring Instance of data class for ram data redundancy of MoFAirFl_TrqActIfClass Member Variable" UWORD OneToOne 1 100 0.00 65535.00 FORMAT "%8.2" ECU_ADDRESS 0x60011AD0 /end MEASUREMENT
/begin MEASUREMENT MoFAirFl_TrqActCplIfClass_V13I.zwouthireslRdntCpl "Instance of data class for redundant quantities in connection with actual torque in function monitoring / Instance of data class for redundant quantities in connection with actual torque in function monitoring Instance of data class for ram data redundancy of MoFAirFl_TrqActIfClass Member Variable" UWORD OneToOne 1 100 0.00 65535.00 FORMAT "%8.2" ECU_ADDRESS 0x60011AD2 /end MEASUREMENT
/begin MEASUREMENT MoFAirFl_TrqActIfClass_V13I.agIntkClsd "Instance of data class for quantities in connection with actual torque in function monitoring / Instance of data class for quantities in connection with actual torque in function monitoring Member Variable" SWORD kw_q0p0156 1 100 -512.0000 511.9844 FORMAT "%8.4" ECU_ADDRESS 0x6001219E /end MEASUREMENT
/begin MEASUREMENT MoFAirFl_TrqActIfClass_V13I.dzworri "Instance of data class for quantities in connection with actual torque in function monitoring / Instance of data class for quantities in connection with actual torque in function monitoring Member Variable" SBYTE zw_sb_q0p75 1 100 -96.00 95.25 FORMAT "%5.2" ECU_ADDRESS 0x600121A0 /end MEASUREMENT
/begin MEASUREMENT MoFAirFl_TrqActIfClass_V13I.etaaufte "Instance of data class for quantities in connection with actual torque in function monitoring / Instance of data class for quantities in connection with actual torque in function monitoring Member Variable" UWORD fak_uw_b2 1 100 0.00 1.999969 FORMAT "%8.6" ECU_ADDRESS 0x600121A2 /end MEASUREMENT
/begin MEASUREMENT MoFAirFl_TrqActIfClass_V13I.etazwist "Instance of data class for quantities in connection with actual torque in function monitoring / Instance of data class for quantities in connection with actual torque in function monitoring Member Variable" UWORD fak_uw_b2 1 100 0.00 1.999969 FORMAT "%8.6" ECU_ADDRESS 0x600121A4 /end MEASUREMENT
/begin MEASUREMENT MoFAirFl_TrqActIfClass_V13I.ratInertCyl "Instance of data class for quantities in connection with actual torque in function monitoring / Instance of data class for quantities in connection with actual torque in function monitoring Member Variable" UWORD rel_uw_b100 1 100 0.00 99.99847 FORMAT "%8.5" ECU_ADDRESS 0x600121A6 /end MEASUREMENT
/begin MEASUREMENT MoFAirFl_TrqActIfClass_V13I.ratInertEgrExtCyl "Instance of data class for quantities in connection with actual torque in function monitoring / Instance of data class for quantities in connection with actual torque in function monitoring Member Variable" UWORD rel_uw_b100 1 100 0.00 99.99847 FORMAT "%8.5" ECU_ADDRESS 0x600121A8 /end MEASUREMENT
/begin MEASUREMENT MoFAirFl_TrqActIfClass_V13I.ratInertEgrIntCyl "Instance of data class for quantities in connection with actual torque in function monitoring / Instance of data class for quantities in connection with actual torque in function monitoring Member Variable" UWORD rel_uw_b100 1 100 0.00 99.99847 FORMAT "%8.5" ECU_ADDRESS 0x600121AA /end MEASUREMENT
/begin MEASUREMENT MoFAirFl_TrqActIfClass_V13I.zwcalcar_zzylzue "Instance of data class for quantities in connection with actual torque in function monitoring / Instance of data class for quantities in connection with actual torque in function monitoring Member Variable" SBYTE zw_sb_q0p75 1 100 -96.00 95.25 FORMAT "%5.2" ECU_ADDRESS 0x600121AC /end MEASUREMENT
/begin MEASUREMENT MoFAirFl_TrqActIfClass_V13I.zwopt "Instance of data class for quantities in connection with actual torque in function monitoring / Instance of data class for quantities in connection with actual torque in function monitoring Member Variable" SBYTE zw_sb_q0p75 1 100 -96.00 95.25 FORMAT "%5.2" ECU_ADDRESS 0x600121AD /end MEASUREMENT
/begin MEASUREMENT MoFAirFl_TrqActIfClass_V13I.zwout "Instance of data class for quantities in connection with actual torque in function monitoring / Instance of data class for quantities in connection with actual torque in function monitoring Member Variable" SBYTE zw_sb_q0p75 1 100 -96.00 95.25 FORMAT "%5.2" ECU_ADDRESS 0x600121AE /end MEASUREMENT
/begin MEASUREMENT MoFAirFl_TrqActIfClass_V13I.zwoutcpl "Instance of data class for quantities in connection with actual torque in function monitoring / Instance of data class for quantities in connection with actual torque in function monitoring Member Variable" UBYTE OneToOne 1 100 0.00 255.0 FORMAT "%5.1" ECU_ADDRESS 0x600121AF /end MEASUREMENT
/begin MEASUREMENT MoFAirFl_TrqActIfClass_V13I.zwouthiresl "Instance of data class for quantities in connection with actual torque in function monitoring / Instance of data class for quantities in connection with actual torque in function monitoring Instance of data class for quantities in connection with actual torque in function monitoring Member Variable" SWORD zw_q0p1 1 100 -3276.800 3276.700 FORMAT "%8.3" ECU_ADDRESS 0x600121B0 /end MEASUREMENT
/begin MEASUREMENT MoFAirFl_TrqActIfClass_V13I.zwouthireslAry_zzylzue "Instance of data class for quantities in connection with actual torque in function monitoring / Instance of data class for quantities in connection with actual torque in function monitoring Instance of data class for quantities in connection with actual torque in function monitoring Member Variable" SWORD zw_q0p1 1 100 -3276.800 3276.700 FORMAT "%8.3" ECU_ADDRESS 0x600121B2 /end MEASUREMENT
/begin MEASUREMENT MoFAirFl_TrqActIfClass_V13I.zwouthireslRdnt "Instance of data class for quantities in connection with actual torque in function monitoring / Instance of data class for quantities in connection with actual torque in function monitoring Instance of data class for quantities in connection with actual torque in function monitoring Member Variable" UWORD OneToOne 1 100 0.00 65535.00 FORMAT "%8.2" ECU_ADDRESS 0x600121B4 /end MEASUREMENT
/begin MEASUREMENT MoFAPPCo_bbLoc1Cpl "Complement for bit basis MoFAPPCo_bbLoc1" UBYTE OneToOne 1 100 0.00 255.0 FORMAT "%5.1" ECU_ADDRESS 0x60011A9B /end MEASUREMENT
/begin MEASUREMENT MoFAPPCo_bbOut1Cpl "Complement variable for MoFAPPCo_bbOut1." UBYTE OneToOne 1 100 0.00 255.0 FORMAT "%5.1" ECU_ADDRESS 0x60011A9A /end MEASUREMENT
/begin MEASUREMENT MoFAPP_cntrDeb "Debounce counter for Error time for pedal signals which are implausible to each other during the monitoring" UBYTE OneToOne 1 100 0.00 255.0 FORMAT "%5.1" ECU_ADDRESS 0x6001217A /end MEASUREMENT
/begin MEASUREMENT MoFAPP_cntrDebCpl "Complement of Debounce counter for Error time for pedal signals which are implausible to each other during the monitoring" UBYTE OneToOne 1 100 0.00 255.0 FORMAT "%5.1" ECU_ADDRESS 0x60011A99 /end MEASUREMENT
/begin MEASUREMENT MoFAPP_cntrTestAPP "counter of testflag in diagnosis for monitoring of accelerator pedal position in function monitoring" UBYTE OneToOne 1 100 0.00 255.0 FORMAT "%5.1" ECU_ADDRESS 0x60006388 /end MEASUREMENT
/begin MEASUREMENT MoFAPP_flgAdcErr1 "Error while reading ADC value for APP1 in level 2" UBYTE B_TRUE 1 100 0.00 1.00000000000 BIT_MASK 0x8 FORMAT "%13.11" ECU_ADDRESS 0x6001217B /end MEASUREMENT
/begin MEASUREMENT MoFAPP_flgAdcErr2 "Error while reading ADC value for APP2 in level 2" UBYTE B_TRUE 1 100 0.00 1.00000000000 BIT_MASK 0x10 FORMAT "%13.11" ECU_ADDRESS 0x6001217B /end MEASUREMENT
/begin MEASUREMENT MoFAPP_flgClr "Diagnosis fault clear bit for the diagnosis monitoring" UBYTE B_TRUE 1 100 0.00 1.00000000000 BIT_MASK 0x1 FORMAT "%13.11" ECU_ADDRESS 0x70000182 /end MEASUREMENT
/begin MEASUREMENT MoFAPP_flgExtErr "Flag indicates the external error status of the accelerator pedal for the function monitoring" UBYTE B_TRUE 1 100 0.00 1.00000000000 BIT_MASK 0x2 FORMAT "%13.11" ECU_ADDRESS 0x6001217B /end MEASUREMENT
/begin MEASUREMENT MoFAPP_flgIrrvErrMsg "Irreversible error status for level1 in function monitoring." UBYTE B_TRUE 1 100 0.00 1.00000000000 BIT_MASK 0x1 FORMAT "%13.11" ECU_ADDRESS 0x700006DB /end MEASUREMENT
/begin MEASUREMENT MoFAPP_flgNTPRel "Flag for extension of the no load test pulse (NTP)" UBYTE B_TRUE 1 100 0.00 1.00000000000 BIT_MASK 0x4 FORMAT "%13.11" ECU_ADDRESS 0x6001217B /end MEASUREMENT
/begin MEASUREMENT MoFAPP_flgPlausErr "Plausibility error of the accelerator pedal signals in function monitoring" UBYTE B_TRUE 1 100 0.00 1.00000000000 BIT_MASK 0x1 FORMAT "%13.11" ECU_ADDRESS 0x6001217B /end MEASUREMENT
/begin MEASUREMENT MoFAPP_flgPlausErrDeb "Flag debounced error in APP" UBYTE B_TRUE 1 100 0.00 1.00000000000 BIT_MASK 0x1 FORMAT "%13.11" ECU_ADDRESS 0x60012179 /end MEASUREMENT
/begin MEASUREMENT MoFAPP_flgTestMsg "status of tested flag for App Diagnosis monitoring" UBYTE B_TRUE 1 100 0.00 1.00000000000 BIT_MASK 0x1 FORMAT "%13.11" ECU_ADDRESS 0x700006DA /end MEASUREMENT
/begin MEASUREMENT MoFAPP_ratApp_DST_result "Result of distribution search in MoFAPP_ratApp_DST" SLONG dez 1 100 -2147483648.00 2147483647.00 FORMAT "%13.2" ECU_ADDRESS 0x6001216C /end MEASUREMENT
/begin MEASUREMENT MoFAPP_ratApp_DST_resultCpl "Complement of MoFAPP_ratApp_DST_result in monitoring." ULONG OneToOne 1 100 0.00 4294967295.00 FORMAT "%13.2" ECU_ADDRESS 0x60011A8C /end MEASUREMENT
/begin MEASUREMENT MoFAPP_ratHiResl "Position of accelerator pedal in high resolution for the function monitoring" UWORD relPED_q0p02441 1 100 0.00 1599.976 FORMAT "%8.3" ECU_ADDRESS 0x60012160 /end MEASUREMENT
/begin MEASUREMENT MoFAPP_ratHiReslCpl "RAM data redundancy for MoFAPP_ratHiResl" UWORD OneToOne 1 100 0.00 65535.00 FORMAT "%8.2" ECU_ADDRESS 0x60011A80 /end MEASUREMENT
/begin MEASUREMENT MoFAPP_ratHiResl_DST_result "Result of distribution search in MoFAPP_ratHiResl_DST" SLONG dez 1 100 -2147483648.00 2147483647.00 FORMAT "%13.2" ECU_ADDRESS 0x60012168 /end MEASUREMENT
/begin MEASUREMENT MoFAPP_ratHiResl_DST_resultCpl "Complement of MoFAPP_ratHiResl_DST_result in monitoring" ULONG OneToOne 1 100 0.00 4294967295.00 FORMAT "%13.2" ECU_ADDRESS 0x60011A88 /end MEASUREMENT
/begin MEASUREMENT MoFAPP_stAPPMsg "State of APP signal in monitoring" UBYTE OneToOne 1 100 0.00 255.0 FORMAT "%5.1" ECU_ADDRESS 0x6000A33A /end MEASUREMENT
/begin MEASUREMENT MoFAPP_stLimpMsg "Info for level 1: Error reaction from level 2 is requested" UBYTE OneToOne 1 100 0.00 255.0 FORMAT "%5.1" ECU_ADDRESS 0x6000A339 /end MEASUREMENT
/begin MEASUREMENT MoFAPP_stSigSrc "Status of accelerator pedal in level 2" UBYTE OneToOne 1 100 0.00 255.0 FORMAT "%5.1" ECU_ADDRESS 0x60012178 /end MEASUREMENT
/begin MEASUREMENT MoFAPP_stSigSrcCpl "Double storage of Status of accelerator pedal in level 2" UBYTE OneToOne 1 100 0.00 255.0 FORMAT "%5.1" ECU_ADDRESS 0x60011A98 /end MEASUREMENT
/begin MEASUREMENT MoFAPP_uApp1 "Current voltage at Signal 1 from accelerator pedal" UWORD spg_q0p00488 1 100 0.00 319.9951 FORMAT "%8.4" ECU_ADDRESS 0x60012176 /end MEASUREMENT
/begin MEASUREMENT MoFAPP_uApp1Cpl "Complement of current voltage at Signal 1 from accelerator pedal" UWORD OneToOne 1 100 0.00 65535.00 FORMAT "%8.2" ECU_ADDRESS 0x60011A96 /end MEASUREMENT
/begin MEASUREMENT MoFAPP_uApp2 "Current voltage at Signal 2 from accelerator pedal" UWORD spg_q0p00488 1 100 0.00 319.9951 FORMAT "%8.4" ECU_ADDRESS 0x60012174 /end MEASUREMENT
/begin MEASUREMENT MoFAPP_uApp2Cpl "Complement of current voltage at Signal 2 from accelerator pedal" UWORD OneToOne 1 100 0.00 65535.00 FORMAT "%8.2" ECU_ADDRESS 0x60011A94 /end MEASUREMENT
/begin MEASUREMENT MoFAPP_uHiResl "High resolution accelerator pedal voltage in the function monitoring" UWORD spg_q0p00488 1 100 0.00 319.9951 FORMAT "%8.4" ECU_ADDRESS 0x60012172 /end MEASUREMENT
/begin MEASUREMENT MoFAPP_uHiReslCpl "Complement of High resolution accelerator pedal voltage in the function monitoring" UWORD OneToOne 1 100 0.00 65535.00 FORMAT "%8.2" ECU_ADDRESS 0x60011A92 /end MEASUREMENT
/begin MEASUREMENT MoFBrkCo_bbLoc1Cpl "RAM data redundancy for MoFBrkCo_bbLoc1" UBYTE OneToOne 1 100 0.00 255.0 FORMAT "%5.1" ECU_ADDRESS 0x60011A7F /end MEASUREMENT
/begin MEASUREMENT MoFBrkCo_bbOut1Cpl "RAM data redundancy for MoFBrkCo_bbOut1" UBYTE OneToOne 1 100 0.00 255.0 FORMAT "%5.1" ECU_ADDRESS 0x60011A7E /end MEASUREMENT
/begin MEASUREMENT MoFBrk_cntrBrkDeb "Debounce counter for the brake signal in function monitoring" UBYTE OneToOne 1 100 0.00 255.0 FORMAT "%5.1" ECU_ADDRESS 0x6001215E /end MEASUREMENT
/begin MEASUREMENT MoFBrk_cntrBrkDebCpl "RAM data redundancy for MoF_ctBrkDeb" UBYTE OneToOne 1 100 0.00 255.0 FORMAT "%5.1" ECU_ADDRESS 0x60011A7D /end MEASUREMENT
/begin MEASUREMENT MoFBrk_cntrBrkMaiDeb "Debounce counter for main brake signal in function monitoring" UBYTE OneToOne 1 100 0.00 255.0 FORMAT "%5.1" ECU_ADDRESS 0x6001215D /end MEASUREMENT
/begin MEASUREMENT MoFBrk_cntrBrkMaiDebCpl "RAM data redundancy for MoFBrk_cntrBrkMaiDeb" UBYTE OneToOne 1 100 0.00 255.0 FORMAT "%5.1" ECU_ADDRESS 0x60011A7C /end MEASUREMENT
/begin MEASUREMENT MoFBrk_cntrBrkRdntDeb "Debounce counter for redundant brake signal in function monitoring" UBYTE OneToOne 1 100 0.00 255.0 FORMAT "%5.1" ECU_ADDRESS 0x6001215C /end MEASUREMENT
/begin MEASUREMENT MoFBrk_cntrBrkRdntDebCpl "RAM data redundancy for MoFBrk_cntrBrkRdntDeb" UBYTE OneToOne 1 100 0.00 255.0 FORMAT "%5.1" ECU_ADDRESS 0x60011A7B /end MEASUREMENT
/begin MEASUREMENT MoFBrk_flgBrk "Brake status in Level2 Function monitoring" UBYTE B_TRUE 1 100 0.00 1.00000000000 BIT_MASK 0x1 FORMAT "%13.11" ECU_ADDRESS 0x6001215B /end MEASUREMENT
/begin MEASUREMENT MoFBrk_flgBrkAcc "Brake pressed signal for adaptive cruise control (ACC)" UBYTE B_TRUE 1 100 0.00 1.00000000000 BIT_MASK 0x4 FORMAT "%13.11" ECU_ADDRESS 0x6001215B /end MEASUREMENT
/begin MEASUREMENT MoFBrk_flgBrkApp "Brake pressed signal for APP in funcion monitoring" UBYTE B_TRUE 1 100 0.00 1.00000000000 BIT_MASK 0x2 FORMAT "%13.11" ECU_ADDRESS 0x6001215B /end MEASUREMENT
/begin MEASUREMENT MoFBrk_flgBrkCrsCtrl "Brake pressed signal for cruise control" UBYTE B_TRUE 1 100 0.00 1.00000000000 BIT_MASK 0x8 FORMAT "%13.11" ECU_ADDRESS 0x6001215B /end MEASUREMENT
/begin MEASUREMENT MoFBrk_flgDioMaiBrkErr "Error while reading Main Brake DIO in level 2" UBYTE B_TRUE 1 100 0.00 1.00000000000 BIT_MASK 0x1 FORMAT "%13.11" ECU_ADDRESS 0x6001215F /end MEASUREMENT
/begin MEASUREMENT MoFBrk_flgDioRdntBrkErr "Error while reading Redundant Brake DIO in level 2" UBYTE B_TRUE 1 100 0.00 1.00000000000 BIT_MASK 0x2 FORMAT "%13.11" ECU_ADDRESS 0x6001215F /end MEASUREMENT
/begin MEASUREMENT MoFBrk_flgEBBBrkPedlOn "Brake Pedal On Flag. Indicates that driver pressing brake pedal" UBYTE B_TRUE 1 100 0.00 1.00000000000 BIT_MASK 0x40 FORMAT "%13.11" ECU_ADDRESS 0x6001215B /end MEASUREMENT
/begin MEASUREMENT MoFBrk_flgMaiBrk "Brake Main switch status in Function Monitoring" UBYTE B_TRUE 1 100 0.00 1.00000000000 BIT_MASK 0x10 FORMAT "%13.11" ECU_ADDRESS 0x6001215B /end MEASUREMENT
/begin MEASUREMENT MoFBrk_flgRdntBrk "Brake Redundant switch status in Function Monitoring" UBYTE B_TRUE 1 100 0.00 1.00000000000 BIT_MASK 0x20 FORMAT "%13.11" ECU_ADDRESS 0x6001215B /end MEASUREMENT
/begin MEASUREMENT MoFCCtlCo_bbLoc1Cpl "Complement of MoFCCtlCo_bbLoc1Cpl" UBYTE OneToOne 1 100 0.00 255.0 FORMAT "%5.1" ECU_ADDRESS 0x60011A7A /end MEASUREMENT
/begin MEASUREMENT MoFCCtlCo_bbLoc2Cpl "Complement of MoFCCtlCo_bbLoc2Cpl" UBYTE OneToOne 1 100 0.00 255.0 FORMAT "%5.1" ECU_ADDRESS 0x60011A79 /end MEASUREMENT
/begin MEASUREMENT MoFCCtlCo_bbOut1Cpl "Complement of MoFCCtlCo_bbOut1Cpl" UBYTE OneToOne 1 100 0.00 255.0 FORMAT "%5.1" ECU_ADDRESS 0x60011A78 /end MEASUREMENT
/begin MEASUREMENT MoFCCtl_cntrCrsCtrlActvDeb "Debounce Counter for Cruise Control Active" UBYTE OneToOne 1 100 0.00 255.0 FORMAT "%5.1" ECU_ADDRESS 0x60012158 /end MEASUREMENT
/begin MEASUREMENT MoFCCtl_cntrCrsCtrlActvDebCpl "Double Storage for Cruise Control Active Debounce" UBYTE OneToOne 1 100 0.00 255.0 FORMAT "%5.1" ECU_ADDRESS 0x60011A77 /end MEASUREMENT
/begin MEASUREMENT MoFCCtl_flgAct "Activation flag for cruise control" UBYTE B_TRUE 1 100 0.00 1.00000000000 BIT_MASK 0x1 FORMAT "%13.11" ECU_ADDRESS 0x60012157 /end MEASUREMENT
/begin MEASUREMENT MoFCCtl_flgAppLoDetn "Flag is active when Accelerator pedal is not pressed" UBYTE B_TRUE 1 100 0.00 1.00000000000 BIT_MASK 0x40 FORMAT "%13.11" ECU_ADDRESS 0x6001215A /end MEASUREMENT
/begin MEASUREMENT MoFCCtl_flgAppPsdDetn "Flag is active when Accelerator pedal is pressed" UBYTE B_TRUE 1 100 0.00 1.00000000000 BIT_MASK 0x80 FORMAT "%13.11" ECU_ADDRESS 0x6001215A /end MEASUREMENT
/begin MEASUREMENT MoFCCtl_flgBtnActvResu "Flag activation by Resume" UBYTE B_TRUE 1 100 0.00 1.00000000000 BIT_MASK 0x1 FORMAT "%13.11" ECU_ADDRESS 0x60012159 /end MEASUREMENT
/begin MEASUREMENT MoFCCtl_flgBtnActvSet "Flag activation by Set" UBYTE B_TRUE 1 100 0.00 1.00000000000 BIT_MASK 0x2 FORMAT "%13.11" ECU_ADDRESS 0x60012159 /end MEASUREMENT
/begin MEASUREMENT MoFCCtl_flgBtnLoDetnResu "Rising Edge Recognised Resume" UBYTE B_TRUE 1 100 0.00 1.00000000000 BIT_MASK 0x4 FORMAT "%13.11" ECU_ADDRESS 0x60012159 /end MEASUREMENT
/begin MEASUREMENT MoFCCtl_flgBtnLoDetnSet "Rising Edge Recognised Set" UBYTE B_TRUE 1 100 0.00 1.00000000000 BIT_MASK 0x40 FORMAT "%13.11" ECU_ADDRESS 0x60012159 /end MEASUREMENT
/begin MEASUREMENT MoFCCtl_flgCnclSwt "Flag activation by Cancel switch" UBYTE B_TRUE 1 100 0.00 1.00000000000 BIT_MASK 0x1 FORMAT "%13.11" ECU_ADDRESS 0x6001215A /end MEASUREMENT
/begin MEASUREMENT MoFCCtl_flgCrsCtrlVldSig "Flag valid CrCtl activation recognized" UBYTE B_TRUE 1 100 0.00 1.00000000000 BIT_MASK 0x8 FORMAT "%13.11" ECU_ADDRESS 0x60012159 /end MEASUREMENT
/begin MEASUREMENT MoFCCtl_flgErrHw "Hardware error flag (via CAN)" UBYTE B_TRUE 1 100 0.00 1.00000000000 BIT_MASK 0x80 FORMAT "%13.11" ECU_ADDRESS 0x60012159 /end MEASUREMENT
/begin MEASUREMENT MoFCCtl_flgFallEdgeResu "detected falling edge at cruise control lever set switch in function monitoring" UBYTE B_TRUE 1 100 0.00 1.00000000000 BIT_MASK 0x10 FORMAT "%13.11" ECU_ADDRESS 0x60012159 /end MEASUREMENT
/begin MEASUREMENT MoFCCtl_flgFallEdgeSet "detected falling edge at cruise control lever resume switch in function monitoring" UBYTE B_TRUE 1 100 0.00 1.00000000000 BIT_MASK 0x20 FORMAT "%13.11" ECU_ADDRESS 0x60012159 /end MEASUREMENT
/begin MEASUREMENT MoFCCtl_flgMaiSwt "cruise control main switch information in function monitoring" UBYTE B_TRUE 1 100 0.00 1.00000000000 BIT_MASK 0x2 FORMAT "%13.11" ECU_ADDRESS 0x6001215A /end MEASUREMENT
/begin MEASUREMENT MoFCCtl_flgResuSwt "Flag activation by Resume switch" UBYTE B_TRUE 1 100 0.00 1.00000000000 BIT_MASK 0x10 FORMAT "%13.11" ECU_ADDRESS 0x6001215A /end MEASUREMENT
/begin MEASUREMENT MoFCCtl_flgSetSwt "Flag activation by Set switch" UBYTE B_TRUE 1 100 0.00 1.00000000000 BIT_MASK 0x20 FORMAT "%13.11" ECU_ADDRESS 0x6001215A /end MEASUREMENT
/begin MEASUREMENT MoFCCtl_flgShOff "L2 cruise control shutoff value" UBYTE B_TRUE 1 100 0.00 1.00000000000 BIT_MASK 0x2 FORMAT "%13.11" ECU_ADDRESS 0x60012157 /end MEASUREMENT
/begin MEASUREMENT MoFCCtl_flgTipDwnLo "detected low level at FGR control lever switch tip-down in function monitoring" UBYTE B_TRUE 1 100 0.00 1.00000000000 BIT_MASK 0x4 FORMAT "%13.11" ECU_ADDRESS 0x6001215A /end MEASUREMENT
/begin MEASUREMENT MoFCCtl_flgTipUpLo "detected low level at FGR control lever switch tip-up in function monitoring" UBYTE B_TRUE 1 100 0.00 1.00000000000 BIT_MASK 0x8 FORMAT "%13.11" ECU_ADDRESS 0x6001215A /end MEASUREMENT
/begin MEASUREMENT MoFClthCo_bbLoc1Cpl "Complement for bit basis MoFClthCo_bbLoc1" UBYTE OneToOne 1 100 0.00 255.0 FORMAT "%5.1" ECU_ADDRESS 0x60011A76 /end MEASUREMENT
/begin MEASUREMENT MoFClthCo_bbOut1Cpl "complement value" UBYTE OneToOne 1 100 0.00 255.0 FORMAT "%5.1" ECU_ADDRESS 0x60011A75 /end MEASUREMENT
/begin MEASUREMENT MoFClth_cntrBotmCluDeb "Debounce counter for bottom clutch" UBYTE OneToOne 1 100 0.00 255.0 FORMAT "%5.1" ECU_ADDRESS 0x60012155 /end MEASUREMENT
/begin MEASUREMENT MoFClth_cntrBotmCluDebCpl "Complement of debounce counter for bottom clutch" UBYTE OneToOne 1 100 0.00 255.0 FORMAT "%5.1" ECU_ADDRESS 0x60011A74 /end MEASUREMENT
/begin MEASUREMENT MoFClth_cntrT15OnDeb "Debounce counter since kl15 after which the evaluation of the Clutch signal is aktiv" UBYTE OneToOne 1 100 0.00 255.0 FORMAT "%5.1" ECU_ADDRESS 0x60012154 /end MEASUREMENT
/begin MEASUREMENT MoFClth_cntrT15OnDebCpl "complement of Debounce counter since kl15 after which the evaluation of the Clutch signal is aktiv" UBYTE OneToOne 1 100 0.00 255.0 FORMAT "%5.1" ECU_ADDRESS 0x60011A73 /end MEASUREMENT
/begin MEASUREMENT MoFClth_cntrTopCluDeb "Debounce counter for top clutch" UBYTE OneToOne 1 100 0.00 255.0 FORMAT "%5.1" ECU_ADDRESS 0x60012153 /end MEASUREMENT
/begin MEASUREMENT MoFClth_cntrTopCluDebCpl "Complement of debounce counter for top clutch" UBYTE OneToOne 1 100 0.00 255.0 FORMAT "%5.1" ECU_ADDRESS 0x60011A72 /end MEASUREMENT
/begin MEASUREMENT MoFClth_flgClthBot "Flag for top clutch info" UBYTE B_TRUE 1 100 0.00 1.00000000000 BIT_MASK 0x1 FORMAT "%13.11" ECU_ADDRESS 0x60012152 /end MEASUREMENT
/begin MEASUREMENT MoFClth_flgClthTop "Flag for bottom clutch info" UBYTE B_TRUE 1 100 0.00 1.00000000000 BIT_MASK 0x2 FORMAT "%13.11" ECU_ADDRESS 0x60012152 /end MEASUREMENT
/begin MEASUREMENT MoFClth_flgCluBotRaw "Top clucth status read from DIO pin" UBYTE B_TRUE 1 100 0.00 1.00000000000 BIT_MASK 0x1 FORMAT "%13.11" ECU_ADDRESS 0x60012156 /end MEASUREMENT
/begin MEASUREMENT MoFClth_flgCluTopRaw "Bottom Clucth status read from DIO pin" UBYTE B_TRUE 1 100 0.00 1.00000000000 BIT_MASK 0x2 FORMAT "%13.11" ECU_ADDRESS 0x60012156 /end MEASUREMENT
/begin MEASUREMENT MoFCoVehCo_bbOut1Cpl "RAM data redundancy of MoFCoVehCo_bbOut1" UBYTE OneToOne 1 100 0.00 255.0 FORMAT "%5.1" ECU_ADDRESS 0x60011A71 /end MEASUREMENT
/begin MEASUREMENT MoFDCSCo_bbOut1Cpl "Complement variable for MoFDCSCo_bbOut1." UBYTE OneToOne 1 100 0.00 255.0 FORMAT "%5.1" ECU_ADDRESS 0x60011A56 /end MEASUREMENT
/begin MEASUREMENT MoFDCS_cntrDebDCSDeactv "DCS deactivation counter from L2" UBYTE OneToOne 1 100 0.00 255.0 FORMAT "%5.1" ECU_ADDRESS 0x60012136 /end MEASUREMENT
/begin MEASUREMENT MoFDCS_cntrDebDCSDeactvCpl "Double Storage for DCS deactiavtion counter" UBYTE OneToOne 1 100 0.00 255.0 FORMAT "%5.1" ECU_ADDRESS 0x60011A55 /end MEASUREMENT
/begin MEASUREMENT MoFDCS_cntrStbErrDeb "debounce-counter Stabili. Unit Error" UBYTE OneToOne 1 100 0.00 255.0 FORMAT "%5.1" ECU_ADDRESS 0x60012135 /end MEASUREMENT
/begin MEASUREMENT MoFDCS_cntrStbErrDebCpl "Complement variable for MoFDCS_cntrStbErrDeb" UBYTE OneToOne 1 100 0.00 255.0 FORMAT "%5.1" ECU_ADDRESS 0x60011A54 /end MEASUREMENT
/begin MEASUREMENT MoFDCS_flgComErrESP "Flag communication with the ESP error detected" UBYTE B_TRUE 1 100 0.00 1.00000000000 BIT_MASK 0x1 FORMAT "%13.11" ECU_ADDRESS 0x60012134 /end MEASUREMENT
/begin MEASUREMENT MoFDCS_flgDecIntvActv "Decreasing torque request of ESP (DCS) is active" UBYTE B_TRUE 1 100 0.00 1.00000000000 BIT_MASK 0x2 FORMAT "%13.11" ECU_ADDRESS 0x60012134 /end MEASUREMENT
/begin MEASUREMENT MoFDCS_flgIntvActv "Flag indicating DCS Activation status" UBYTE B_TRUE 1 100 0.00 1.00000000000 BIT_MASK 0x4 FORMAT "%13.11" ECU_ADDRESS 0x60012134 /end MEASUREMENT
/begin MEASUREMENT MoFDCS_flgPtd "condition DCS permitted in in function monitoring" UBYTE B_TRUE 1 100 0.00 1.00000000000 BIT_MASK 0x8 FORMAT "%13.11" ECU_ADDRESS 0x60012134 /end MEASUREMENT
/begin MEASUREMENT MoFDCS_flgStbErr "stabilizer unit error status" UBYTE B_TRUE 1 100 0.00 1.00000000000 BIT_MASK 0x10 FORMAT "%13.11" ECU_ADDRESS 0x60012134 /end MEASUREMENT
/begin MEASUREMENT MoFDCS_tqCluPtd "Permitted increasing intervention of brake system on clutch level" SWORD md_q0p1 1 100 -3276.800 3276.700 FORMAT "%8.3" ECU_ADDRESS 0x60012130 /end MEASUREMENT
/begin MEASUREMENT MoFDCS_tqCluPtdCpl "Complement variable for Permitted increasing intervention of brake system on clutch level" UWORD OneToOne 1 100 0.00 65535.00 FORMAT "%8.2" ECU_ADDRESS 0x60011A52 /end MEASUREMENT
/begin MEASUREMENT MoFDCS_tqDesWhl "Desired Wheel Torque" SWORD md_q0p1 1 100 -3276.800 3276.700 FORMAT "%8.3" ECU_ADDRESS 0x60012132 /end MEASUREMENT
/begin MEASUREMENT MoFDCS_tqDesWhlCpl "Double Storage for Desired Wheel Torque" UWORD OneToOne 1 100 0.00 65535.00 FORMAT "%8.2" ECU_ADDRESS 0x60011A50 /end MEASUREMENT
/begin MEASUREMENT MoFDCS_tqWhlPtd "Permitted torque of DCS" SWORD md_q1p6 1 100 -52428.80 52427.20 FORMAT "%8.2" ECU_ADDRESS 0x6001212E /end MEASUREMENT
/begin MEASUREMENT MoFDCS_tqWhlPtdCpl "Complement variable for MoFDCS_tqWhlPtd" UWORD OneToOne 1 100 0.00 65535.00 FORMAT "%8.2" ECU_ADDRESS 0x60011A4E /end MEASUREMENT
/begin MEASUREMENT MoFDCS_trqDem "Demanded engine torque from MRS control" SWORD md_q0p1 1 100 -3276.800 3276.700 FORMAT "%8.3" ECU_ADDRESS 0x6001212C /end MEASUREMENT
/begin MEASUREMENT MoFDCS_trqDemCpl "Double storage for demanded engine torque from MSR control" UWORD OneToOne 1 100 0.00 65535.00 FORMAT "%8.2" ECU_ADDRESS 0x60011A4C /end MEASUREMENT
/begin MEASUREMENT MoFDrAsCo_bbLocCpl "Bit basis complement for local flags" UBYTE OneToOne 1 100 0.00 255.0 FORMAT "%5.1" ECU_ADDRESS 0x60011A4A /end MEASUREMENT
/begin MEASUREMENT MoFDrAs_cntrACC "counter for Turn on Delay ACC (brake operated)" UBYTE OneToOne 1 100 0.00 255.0 FORMAT "%5.1" ECU_ADDRESS 0x60012129 /end MEASUREMENT
/begin MEASUREMENT MoFDrAs_cntrACCCpl "RAM data redundancy for MoFDrAs_cntrACC" UBYTE OneToOne 1 100 0.00 255.0 FORMAT "%5.1" ECU_ADDRESS 0x60011A49 /end MEASUREMENT
/begin MEASUREMENT MoFDrAs_cntrCrsCtrl "counter for Turn on Delay cruise control (brake operated)" UBYTE OneToOne 1 100 0.00 255.0 FORMAT "%5.1" ECU_ADDRESS 0x60012128 /end MEASUREMENT
/begin MEASUREMENT MoFDrAs_cntrCrsCtrlCpl "RAM data redundancy for MoFDrAs_cntrCrsCtrl" UBYTE OneToOne 1 100 0.00 255.0 FORMAT "%5.1" ECU_ADDRESS 0x60011A48 /end MEASUREMENT
/begin MEASUREMENT MoFDrAs_flgACCPtd "ACC permitted information of driver assistance" UBYTE B_TRUE 1 100 0.00 1.00000000000 BIT_MASK 0x10 FORMAT "%13.11" ECU_ADDRESS 0x6001212A /end MEASUREMENT
/begin MEASUREMENT MoFDrAs_flgActv "Condition for DrAS active from L2" UBYTE B_TRUE 1 100 0.00 1.00000000000 BIT_MASK 0x8 FORMAT "%13.11" ECU_ADDRESS 0x6001212A /end MEASUREMENT
/begin MEASUREMENT MoFDrAs_flgBrkACC "break status for ACC active in function monitoring." UBYTE B_TRUE 1 100 0.00 1.00000000000 BIT_MASK 0x2 FORMAT "%13.11" ECU_ADDRESS 0x6001212A /end MEASUREMENT
/begin MEASUREMENT MoFDrAs_flgBrkCrCtl "brake status for CrCtl active" UBYTE B_TRUE 1 100 0.00 1.00000000000 BIT_MASK 0x4 FORMAT "%13.11" ECU_ADDRESS 0x6001212A /end MEASUREMENT
/begin MEASUREMENT MoFDrAs_flgCrsCtrlPtd "Condition Cruise control enabled" UBYTE B_TRUE 1 100 0.00 1.00000000000 BIT_MASK 0x1 FORMAT "%13.11" ECU_ADDRESS 0x6001212A /end MEASUREMENT
/begin MEASUREMENT MoFDrAs_stACCPtdMsg "ACC from sight of the monitoring released" UBYTE OneToOne 1 100 0.00 255.0 FORMAT "%5.1" ECU_ADDRESS 0x6000A333 /end MEASUREMENT
/begin MEASUREMENT MoFDrAs_stCCtlPtdMsg "cruise control from sight of the monitoring released" UBYTE OneToOne 1 100 0.00 255.0 FORMAT "%5.1" ECU_ADDRESS 0x6000A332 /end MEASUREMENT
/begin MEASUREMENT MoFDrAs_stPtdMsg "driver's assistant from sight of the monitoring released." UBYTE OneToOne 1 100 0.00 255.0 FORMAT "%5.1" ECU_ADDRESS 0x6000A331 /end MEASUREMENT
/begin MEASUREMENT MoFDrAs_trqPtd "Permissible wheel torque of driver assistant systems" SWORD md_q1p6 1 100 -52428.80 52427.20 FORMAT "%8.2" ECU_ADDRESS 0x60012126 /end MEASUREMENT
/begin MEASUREMENT MoFDrAs_trqPtdCpl "complement of permissible wheel torque of driver assistant systems" UWORD OneToOne 1 100 0.00 65535.00 FORMAT "%8.2" ECU_ADDRESS 0x60011A46 /end MEASUREMENT
/begin MEASUREMENT MoFTrqPtd_cntrDebRecupFrbdn "Debounce counter to inhibit recuperation in case of an active vehicle stability control intervention" UBYTE OneToOne 1 100 0.00 255.0 FORMAT "%5.1" ECU_ADDRESS 0x60012151 /end MEASUREMENT
/begin MEASUREMENT MoFTrqPtd_cntrDebRecupFrbdnCpl "RAM data redundancy of MoFTrqPtd_cntrDebRecupFrbdn" UBYTE OneToOne 1 100 0.00 255.0 FORMAT "%5.1" ECU_ADDRESS 0x60011A70 /end MEASUREMENT
/begin MEASUREMENT MoFTrqPtd_flgOperModRecupFrbdn "Recuperation in the function monitoring prohibited" UBYTE B_TRUE 1 100 0.00 1.00000000000 BIT_MASK 0x1 FORMAT "%13.11" ECU_ADDRESS 0x60012150 /end MEASUREMENT
/begin MEASUREMENT MoFTrqPtd_flgSelAltMod "Flag to reduce recuperation torque to a typical alternator mode" UBYTE B_TRUE 1 100 0.00 1.00000000000 BIT_MASK 0x2 FORMAT "%13.11" ECU_ADDRESS 0x60012150 /end MEASUREMENT
/begin MEASUREMENT MoFTrqPtd_tqAltTqMaxErr "Currently permitted typical alternator torque of e-machine (1-3 KW power)" SWORD md_q0p1 1 100 -3276.800 0.00 FORMAT "%8.3" ECU_ADDRESS 0x6001214E /end MEASUREMENT
/begin MEASUREMENT MoFTrqPtd_tqAltTqMaxErrCpl "RAM data redundancy of MoFTrqPtd_tqAltTqMaxErr" UWORD OneToOne 1 100 0.00 65535.00 FORMAT "%8.2" ECU_ADDRESS 0x60011A6E /end MEASUREMENT
/begin MEASUREMENT MoFTrqPtd_tqDecExtIntOffs "permitted additional recuperation torque while external intervention" SWORD md_q0p1 1 100 -3276.800 3276.700 FORMAT "%8.3" ECU_ADDRESS 0x6001214C /end MEASUREMENT
/begin MEASUREMENT MoFTrqPtd_tqDecExtIntOffsCpl "RAM redundancy of MoFTrqPtd_tqDecExtIntOffs" UWORD OneToOne 1 100 0.00 65535.00 FORMAT "%8.2" ECU_ADDRESS 0x60011A6C /end MEASUREMENT
/begin MEASUREMENT MoFTrqPtd_tqMinSeld "Filtered permitted minimum e-machine torque including possible limitations, debounced errors or inhibited recuperation." SWORD md_q0p1 1 100 -3276.800 3276.700 FORMAT "%8.3" ECU_ADDRESS 0x6001214A /end MEASUREMENT
/begin MEASUREMENT MoFTrqPtd_tqMinSeldCpl "RAM data redundancy of MoFTrqPtd_tqMinSeld" UWORD OneToOne 1 100 0.00 65535.00 FORMAT "%8.2" ECU_ADDRESS 0x60011A6A /end MEASUREMENT
/begin MEASUREMENT MoFTrqPtd_tqMinSeldUnfild "Unfiltered permitted e-machine torque including possible limitations due to e-machine communication errors or already exceeded torque limits from L2" SWORD md_q0p1 1 100 -3276.800 0.00 FORMAT "%8.3" ECU_ADDRESS 0x60012148 /end MEASUREMENT
/begin MEASUREMENT MoFTrqPtd_tqMinSeldUnfildCpl "RAM data redundancy of MoFTrqPtd_tqMinSeldUnfild" UWORD OneToOne 1 100 0.00 65535.00 FORMAT "%8.2" ECU_ADDRESS 0x60011A68 /end MEASUREMENT
/begin MEASUREMENT MoFTrqPtd_tqRecupInhibDem "torque, used for ESP recuperation inhibit condition, based on driver demand" SWORD md_q0p1 1 100 -3276.800 3276.700 FORMAT "%8.3" ECU_ADDRESS 0x60012146 /end MEASUREMENT
/begin MEASUREMENT MoFTrqPtd_tqRecupInhibDemCpl "RAM redundancy of MoFTrqPtd_tqRecupInhibDem" UWORD OneToOne 1 100 0.00 65535.00 FORMAT "%8.2" ECU_ADDRESS 0x60011A66 /end MEASUREMENT
/begin MEASUREMENT MoFTrqPtd_tqVehPtdMinRaw "filtered permitted minimum e-machine torque on crankshaft level (inhibited recuperation not considered)" SWORD md_q0p1 1 100 -3276.800 3276.700 FORMAT "%8.3" ECU_ADDRESS 0x6001213C /end MEASUREMENT
/begin MEASUREMENT MoFTrqPtd_tqVehPtdMinRawCpl "RAM data redundancy of MoFTrqPtd_tqVehPtdMinRaw" UWORD OneToOne 1 100 0.00 65535.00 FORMAT "%8.2" ECU_ADDRESS 0x60011A64 /end MEASUREMENT
/begin MEASUREMENT MoFTrqPtd_tqVehPtdMinRawLo "Intermediate result of filtered permitted minimum torque (lower 16 bit)" UWORD OneToOne 1 100 0.00 65535.00 FORMAT "%8.2" ECU_ADDRESS 0x60012144 /end MEASUREMENT
/begin MEASUREMENT MoFTrqPtd_tqVehPtdMinRawLoCpl "RAM data redundancy of MoFTrqPtd_tqVehPtdMinRawLo" UWORD OneToOne 1 100 0.00 65535.00 FORMAT "%8.2" ECU_ADDRESS 0x60011A62 /end MEASUREMENT
/begin MEASUREMENT MoFTrqPtd_tqVehPtdWoInt "Permitted propulsion demand of the vehicle, without external interventions" SWORD md_q0p1 1 100 -3276.800 3276.700 FORMAT "%8.3" ECU_ADDRESS 0x6001213A /end MEASUREMENT
/begin MEASUREMENT MoFTrqPtd_tqVehPtdWoIntCpl "RAM data redundancy for MoFCoVeh_tqVehPtdWoInt" UWORD OneToOne 1 100 0.00 65535.00 FORMAT "%8.2" ECU_ADDRESS 0x60011A60 /end MEASUREMENT
/begin MEASUREMENT MoFTrqPtd_tqVehPtdWoIntvMin "Filtered permitted minimum e-machine torque without interventions" SWORD md_q0p1 1 100 -3276.800 3276.700 FORMAT "%8.3" ECU_ADDRESS 0x60012138 /end MEASUREMENT
/begin MEASUREMENT MoFTrqPtd_tqVehPtdWoIntvMinCpl "RAM data redundancy of MoFTrqPtd_tqVehPtdWoIntvMin" UWORD OneToOne 1 100 0.00 65535.00 FORMAT "%8.2" ECU_ADDRESS 0x60011A5E /end MEASUREMENT
/begin MEASUREMENT MoFTrqPtd_tqVehPtdWoIntvMinMsg "Filtered permitted minimum e-machine torque without interventions sent from Function monitoring to Level 1" SWORD md_q0p1 1 100 -3276.800 3276.700 FORMAT "%8.3" ECU_ADDRESS 0x60004FE6 /end MEASUREMENT
/begin MEASUREMENT MoFTrqPtd_tqVehPtdWoIntvMsg "filtered permitted sum torque without interventions in L2 on clutch level" SWORD md_q0p1 1 100 -3276.800 3276.700 FORMAT "%8.3" ECU_ADDRESS 0x60004FE4 /end MEASUREMENT
/begin MEASUREMENT MoFTrqPtd_tqVehPtdWoIntvRaw "Filtered permitted sum torque on clutch level without interventions in L2 as upper limit for L1 reference filter output" SWORD md_q0p1 1 100 -3276.800 3276.700 FORMAT "%8.3" ECU_ADDRESS 0x60012142 /end MEASUREMENT
/begin MEASUREMENT MoFTrqPtd_tqVehPtdWoIntvRawCpl "RAM data redundancy of MoFTrqPtd_tqVehPtdWoIntvRaw" UWORD OneToOne 1 100 0.00 65535.00 FORMAT "%8.2" ECU_ADDRESS 0x60011A5C /end MEASUREMENT
/begin MEASUREMENT MoFTrqPtd_tqVehPtdWoIntvRawFildLo "intermediate result of filtered permitted sum torque (lower 16 bit)" UWORD OneToOne 1 100 0.00 65535.00 FORMAT "%8.2" ECU_ADDRESS 0x60012140 /end MEASUREMENT
/begin MEASUREMENT MoFTrqPtd_tqVehPtdWoIntvRawFildLoCpl "RAM data redundancy of MoFTrqPtd_tqVehPtdWoIntvRawFildLo" UWORD OneToOne 1 100 0.00 65535.00 FORMAT "%8.2" ECU_ADDRESS 0x60011A5A /end MEASUREMENT
/begin MEASUREMENT MoFTrqPtd_tqVehPtdWoIntvRawUnfild "unfiltered permitted sum torque without interventions in L2 on clutch level" SWORD md_q0p1 1 100 -3276.800 3276.700 FORMAT "%8.3" ECU_ADDRESS 0x6001213E /end MEASUREMENT
/begin MEASUREMENT MoFTrqPtd_tqVehPtdWoIntvRawUnfildCpl "RAM data redundancy of MoFTrqPtd_tqVehPtdWoIntvRawUnfild" UWORD OneToOne 1 100 0.00 65535.00 FORMAT "%8.2" ECU_ADDRESS 0x60011A58 /end MEASUREMENT
/begin MEASUREMENT MoF_rAMPTLam "Lambda divided by air mass flow in the function monitoring" UBYTE m_ub_b1020 1 100 0.00 1020. FORMAT "%5.0" ECU_ADDRESS 0x6001218D /end MEASUREMENT
/begin MEASUREMENT MoF_rAMPTLamCpl "RAM data redundancy for MoF_rAMPTLam" UBYTE OneToOne 1 100 0.00 255.0 FORMAT "%5.1" ECU_ADDRESS 0x60011AAD /end MEASUREMENT
/begin MEASUREMENT MoF_rAPP "relative pedal position in function monitoring" UBYTE rel_q0p39 1 100 0.00 99.61 FORMAT "%5.2" ECU_ADDRESS 0x60012170 /end MEASUREMENT
/begin MEASUREMENT MoF_rAPPCpl "RAM data redundancy for MoF_rAPP" UBYTE OneToOne 1 100 0.00 255.0 FORMAT "%5.1" ECU_ADDRESS 0x60011A90 /end MEASUREMENT
/begin MEASUREMENT MoF_rAPP_DST_result "result of distribution search in MoF_rAPP_DST" SLONG dez 1 100 -2147483648.00 2147483647.00 FORMAT "%13.2" ECU_ADDRESS 0x60012164 /end MEASUREMENT
/begin MEASUREMENT MoF_rAPP_DST_resultCpl "Double storage for MoF_rAPP_DST_result" ULONG OneToOne 1 100 0.00 4294967295.00 FORMAT "%13.2" ECU_ADDRESS 0x60011A84 /end MEASUREMENT
/begin MEASUREMENT RLV08_UM_result "Result of grid search for air charge in function monitoring" SLONG dez 1 100 -2147483648.00 2147483647.00 FORMAT "%13.2" ECU_ADDRESS 0x60012184 /end MEASUREMENT
/begin MEASUREMENT RLV08_UM_result_Cpl "RAM data redundancy of RLV08_UM_result" ULONG OneToOne 1 100 0.00 4294967295.00 FORMAT "%13.2" ECU_ADDRESS 0x60011AA4 /end MEASUREMENT
/begin MEASUREMENT rl_um "Relative air charge in function monitoring" UBYTE rel_ub_q0p75 1 100 0.00 191.3 FORMAT "%5.1" ECU_ADDRESS 0x6001218C /end MEASUREMENT
/begin MEASUREMENT rl_ur "RAM data redundancy for RL_UM" UBYTE OneToOne 1 100 0.00 255.0 FORMAT "%5.1" ECU_ADDRESS 0x60011AAC /end MEASUREMENT
/begin FUNCTION MoFAirFl_In "51.2.0    Function Monitoring: Input signals for air and fuel"
 /begin DEF_CHARACTERISTIC MoFAirFl_cntrComNEngDynMin_C MoFAirFl_cntrErrDebMaxInCom_C MoFAirFl_cntrRstMaxInCom_C MoFAirFl_nErrHndlgActvnInCom_C MoFAirFl_nrCylTot_C MoFAirFl_stCfgMoFAirFl_C /end DEF_CHARACTERISTIC
 /begin IN_MEASUREMENT MoFESpd_nEng MoF_bAirFlChkDisbl MoXAirFl_cntrComS0 MoXAirFl_cntrComS0Rdnt MoXAirFl_cntrComS1 MoXAirFl_cntrComS1Rdnt MoXAirFl_CtOffIfClass_V13I.evz_auscpl MoXAirFl_CtOffIfClass_V13I.evz_auscpl_mem MoXAirFl_CtOffIfClass_V13I.evz_austot MoXAirFl_CtOffIfClass_V13I.evz_austot_mem MoXAirFl_CtOffIfClass_V13I.flgInjEnad MoXAirFl_CtOffIfClass_V13I.injTrigCylMsk MoXAirFl_CtOffIfClass_V13I.injTrigCylMskRdnt MoXAirFl_CtOffIfClass_V13I.injmode_zzylh MoXAirFl_CtOffIfClass_V13I.injmode_zzylh_rdnt MoXAirFl_CtOffIfClass_V13I.injmode_zzyln MoXAirFl_CtOffIfClass_V13I.injmode_zzyln_rdnt MoXAirFl_CtOffIfClass_V13I.injmode_zzyls MoXAirFl_CtOffIfClass_V13I.injmode_zzyls_rdnt MoXAirFl_CtOffIfClass_V13I.stInjPfiDeactvAry MoXAirFl_CtOffIfClass_V13I.stInjPfiDeactvAryRdnt MoXAirFl_CtOffIfClass_V13I.stInjPfiDeactvBkupAry MoXAirFl_CtOffIfClass_V13I.stInjTiPfi MoXAirFl_CtOffIfClass_V13I.stInjTiPfi1InjrA MoXAirFl_CtOffIfClass_V13I.stInjTiPfi1InjrARdnt MoXAirFl_CtOffIfClass_V13I.stInjTiPfi1InjrB MoXAirFl_CtOffIfClass_V13I.stInjTiPfi1InjrBRdnt MoXAirFl_CtOffIfClass_V13I.stInjTiPfi2InjrA MoXAirFl_CtOffIfClass_V13I.stInjTiPfi2InjrARdnt MoXAirFl_CtOffIfClass_V13I.stInjTiPfi2InjrB MoXAirFl_CtOffIfClass_V13I.stInjTiPfi2InjrBRdnt MoXAirFl_CtOffIfClass_V13I.stInjTiPfiRdnt MoXAirFl_MixMngtIfClass_V13I.B_afimreq MoXAirFl_MixMngtIfClass_V13I.facBnk MoXAirFl_MixMngtIfClass_V13I.facBnk2Pfi MoXAirFl_MixMngtIfClass_V13I.facBnkPfi MoXAirFl_MixMngtIfClass_V13I.facLamCtlPfiAry MoXAirFl_MixMngtIfClass_V13I.facLamCtlPfiAryRdnt MoXAirFl_MixMngtIfClass_V13I.facLamCtlPfiBkupAry MoXAirFl_MixMngtIfClass_V13I.facPcPfiRest MoXAirFl_MixMngtIfClass_V13I.facPcPfiRestBnk2 MoXAirFl_MixMngtIfClass_V13I.facPcRest MoXAirFl_MixMngtIfClass_V13I.facPrtnPfi MoXAirFl_MixMngtIfClass_V13I.facPrtnPfiAry MoXAirFl_MixMngtIfClass_V13I.facPrtnPfiAryRdnt MoXAirFl_MixMngtIfClass_V13I.facPrtnPfiBkupAry MoXAirFl_MixMngtIfClass_V13I.fakeslsa MoXAirFl_MixMngtIfClass_V13I.ffuevali MoXAirFl_MixMngtIfClass_V13I.ffuevalipfi MoXAirFl_MixMngtIfClass_V13I.fkrkAry MoXAirFl_MixMngtIfClass_V13I.fkrkPfiAry MoXAirFl_MixMngtIfClass_V13I.fkrkPfiAryRdnt MoXAirFl_MixMngtIfClass_V13I.flgLamSplitActv MoXAirFl_MixMngtIfClass_V13I.fnsad MoXAirFl_MixMngtIfClass_V13I.fr MoXAirFl_MixMngtIfClass_V13I.fr2 MoXAirFl_MixMngtIfClass_V13I.fragdi MoXAirFl_MixMngtIfClass_V13I.fragdi2 MoXAirFl_MixMngtIfClass_V13I.frapfi MoXAirFl_MixMngtIfClass_V13I.frapfi2 MoXAirFl_MixMngtIfClass_V13I.lamsbg MoXAirFl_MixMngtIfClass_V13I.lamsbg2 MoXAirFl_MixMngtIfClass_V13I.larils MoXAirFl_MixMngtIfClass_V13I.larils2 MoXAirFl_MixMngtIfClass_V13I.rCtlPriB1 MoXAirFl_MixMngtIfClass_V13I.rCtlPriB2 MoXAirFl_MixMngtIfClass_V13I.ratChrgAirCylPredPfi MoXAirFl_MixMngtIfClass_V13I.ratFuMCylInd MoXAirFl_MixMngtIfClass_V13I.ratFuMGdi MoXAirFl_MixMngtIfClass_V13I.ratFuMGdiBnk2 MoXAirFl_MixMngtIfClass_V13I.ratFuMPfi MoXAirFl_MixMngtIfClass_V13I.ratFuMPfiBnk2 MoXAirFl_MixMngtIfClass_V13I.ratFuPrtnPfiInjAry MoXAirFl_MixMngtIfClass_V13I.ratFuPrtnPfiInjAryRdnt MoXAirFl_MixMngtIfClass_V13I.ratFuPrtnPfiInjBkupAry MoXAirFl_MixMngtIfClass_V13I.ratPrdcAirPrtnPfiAry MoXAirFl_MixMngtIfClass_V13I.ratPrdcAirPrtnPfiAryRdnt MoXAirFl_MixMngtIfClass_V13I.ratPrdcAirPrtnPfiBkupAry MoXAirFl_MixMngtIfClass_V13I.rkagdi MoXAirFl_MixMngtIfClass_V13I.rkagdi2 MoXAirFl_MixMngtIfClass_V13I.rkapfi MoXAirFl_MixMngtIfClass_V13I.rkapfi2 MoXAirFl_MixMngtIfClass_V13I.rkausg MoXAirFl_MixMngtIfClass_V13I.rkte MoXAirFl_MixMngtIfClass_V13I.rkteBnk1 MoXAirFl_MixMngtIfClass_V13I.rkteBnk2 MoXAirFl_MixMngtIfClass_V13I.rkukg MoXAirFl_MixMngtIfClass_V13I.rkukgpfi MoXAirFl_MixMngtIfClass_V13I.rlfg MoXAirFl_MixMngtIfClass_V13I.rlfgBnk1 MoXAirFl_MixMngtIfClass_V13I.rlfgBnk2 MoXAirFl_MixMngtIfClass_V13I.rlp MoXAirFl_MixMngtIfClass_V13I.rlpBnk1 MoXAirFl_MixMngtIfClass_V13I.rlpBnk2 MoXAirFl_MixMngtIfClass_V13I.rlrext MoXAirFl_MixMngtIfClass_V13I.rlrextBnk1 MoXAirFl_MixMngtIfClass_V13I.rlrextBnk2 MoXAirFl_MixMngtIfClass_V13I.rlrint MoXAirFl_MixMngtIfClass_V13I.rlrintBnk1 MoXAirFl_MixMngtIfClass_V13I.rlrintBnk2 MoXAirFl_TrqActIfClass_V13I.agIntkClsd MoXAirFl_TrqActIfClass_V13I.dzworri MoXAirFl_TrqActIfClass_V13I.etaaufte MoXAirFl_TrqActIfClass_V13I.etazwist MoXAirFl_TrqActIfClass_V13I.ratInertCyl MoXAirFl_TrqActIfClass_V13I.ratInertEgrExtCyl MoXAirFl_TrqActIfClass_V13I.ratInertEgrIntCyl MoXAirFl_TrqActIfClass_V13I.zwcalcar_zzylzue MoXAirFl_TrqActIfClass_V13I.zwopt MoXAirFl_TrqActIfClass_V13I.zwout MoXAirFl_TrqActIfClass_V13I.zwoutcpl MoXAirFl_TrqActIfClass_V13I.zwouthiresl MoXAirFl_TrqActIfClass_V13I.zwouthireslAry_zzylzue MoXAirFl_TrqActIfClass_V13I.zwouthireslRdnt Mo_bPostDrv Mo_bPreDrv Mo_ctRst Mo_ctRstCpl Mo_stCplChk Mo_stMoC Mo_stMoCCpl Mo_stMoF Mo_stMoFCpl /end IN_MEASUREMENT
 /begin OUT_MEASUREMENT MoFAirFl_CtOffIfClass_V13I.evz_auscpl MoFAirFl_CtOffIfClass_V13I.evz_auscpl_mem MoFAirFl_CtOffIfClass_V13I.evz_austot MoFAirFl_CtOffIfClass_V13I.evz_austot_mem MoFAirFl_CtOffIfClass_V13I.flgInjEnad MoFAirFl_CtOffIfClass_V13I.injTrigCylMsk MoFAirFl_CtOffIfClass_V13I.injmode_zzylh MoFAirFl_CtOffIfClass_V13I.injmode_zzylh_rdnt MoFAirFl_CtOffIfClass_V13I.injmode_zzyln MoFAirFl_CtOffIfClass_V13I.injmode_zzyln_rdnt MoFAirFl_CtOffIfClass_V13I.injmode_zzyls MoFAirFl_CtOffIfClass_V13I.injmode_zzyls_rdnt MoFAirFl_CtOffIfClass_V13I.stInjPfiDeactvAry MoFAirFl_CtOffIfClass_V13I.stInjPfiDeactvAryRdnt MoFAirFl_CtOffIfClass_V13I.stInjPfiDeactvBkupAry MoFAirFl_CtOffIfClass_V13I.stInjTiPfi MoFAirFl_CtOffIfClass_V13I.stInjTiPfi1InjrA MoFAirFl_CtOffIfClass_V13I.stInjTiPfi1InjrARdnt MoFAirFl_CtOffIfClass_V13I.stInjTiPfi1InjrB MoFAirFl_CtOffIfClass_V13I.stInjTiPfi1InjrBRdnt MoFAirFl_CtOffIfClass_V13I.stInjTiPfi2InjrA MoFAirFl_CtOffIfClass_V13I.stInjTiPfi2InjrARdnt MoFAirFl_CtOffIfClass_V13I.stInjTiPfi2InjrB MoFAirFl_CtOffIfClass_V13I.stInjTiPfi2InjrBRdnt MoFAirFl_CtOffIfClass_V13I.stInjTiPfiRdnt MoFAirFl_flgErrCom MoFAirFl_flgIrrvErrInMsg MoFAirFl_flgTestInMsg MoFAirFl_MixMngtIfClass_V13I.B_afimreq MoFAirFl_MixMngtIfClass_V13I.facBnk MoFAirFl_MixMngtIfClass_V13I.facBnk2Pfi MoFAirFl_MixMngtIfClass_V13I.facBnkPfi MoFAirFl_MixMngtIfClass_V13I.facLamCtlPfiAry MoFAirFl_MixMngtIfClass_V13I.facLamCtlPfiAryRdnt MoFAirFl_MixMngtIfClass_V13I.facLamCtlPfiBkupAry MoFAirFl_MixMngtIfClass_V13I.facPcPfiRest MoFAirFl_MixMngtIfClass_V13I.facPcPfiRestBnk2 MoFAirFl_MixMngtIfClass_V13I.facPcRest MoFAirFl_MixMngtIfClass_V13I.facPrtnPfi MoFAirFl_MixMngtIfClass_V13I.facPrtnPfiAry MoFAirFl_MixMngtIfClass_V13I.facPrtnPfiAryRdnt MoFAirFl_MixMngtIfClass_V13I.facPrtnPfiBkupAry MoFAirFl_MixMngtIfClass_V13I.fakeslsa MoFAirFl_MixMngtIfClass_V13I.ffuevali MoFAirFl_MixMngtIfClass_V13I.ffuevalipfi MoFAirFl_MixMngtIfClass_V13I.fkrkAry MoFAirFl_MixMngtIfClass_V13I.fkrkPfiAry MoFAirFl_MixMngtIfClass_V13I.fkrkPfiAryRdnt MoFAirFl_MixMngtIfClass_V13I.flgLamSplitActv MoFAirFl_MixMngtIfClass_V13I.fnsad MoFAirFl_MixMngtIfClass_V13I.fr MoFAirFl_MixMngtIfClass_V13I.fr2 MoFAirFl_MixMngtIfClass_V13I.fragdi MoFAirFl_MixMngtIfClass_V13I.fragdi2 MoFAirFl_MixMngtIfClass_V13I.frapfi MoFAirFl_MixMngtIfClass_V13I.frapfi2 MoFAirFl_MixMngtIfClass_V13I.lamsbg MoFAirFl_MixMngtIfClass_V13I.lamsbg2 MoFAirFl_MixMngtIfClass_V13I.larils MoFAirFl_MixMngtIfClass_V13I.larils2 MoFAirFl_MixMngtIfClass_V13I.rCtlPriB1 MoFAirFl_MixMngtIfClass_V13I.rCtlPriB2 MoFAirFl_MixMngtIfClass_V13I.ratChrgAirCylPredPfi MoFAirFl_MixMngtIfClass_V13I.ratFuMCylInd MoFAirFl_MixMngtIfClass_V13I.ratFuMGdi MoFAirFl_MixMngtIfClass_V13I.ratFuMGdiBnk2 MoFAirFl_MixMngtIfClass_V13I.ratFuMPfi MoFAirFl_MixMngtIfClass_V13I.ratFuMPfiBnk2 MoFAirFl_MixMngtIfClass_V13I.ratFuPrtnPfiInjAry MoFAirFl_MixMngtIfClass_V13I.ratFuPrtnPfiInjAryRdnt MoFAirFl_MixMngtIfClass_V13I.ratFuPrtnPfiInjBkupAry MoFAirFl_MixMngtIfClass_V13I.ratPrdcAirPrtnPfiAry MoFAirFl_MixMngtIfClass_V13I.ratPrdcAirPrtnPfiAryRdnt MoFAirFl_MixMngtIfClass_V13I.ratPrdcAirPrtnPfiBkupAry MoFAirFl_MixMngtIfClass_V13I.rkagdi MoFAirFl_MixMngtIfClass_V13I.rkagdi2 MoFAirFl_MixMngtIfClass_V13I.rkapfi MoFAirFl_MixMngtIfClass_V13I.rkapfi2 MoFAirFl_MixMngtIfClass_V13I.rkausg MoFAirFl_MixMngtIfClass_V13I.rkte MoFAirFl_MixMngtIfClass_V13I.rkteBnk1 MoFAirFl_MixMngtIfClass_V13I.rkteBnk2 MoFAirFl_MixMngtIfClass_V13I.rkukg MoFAirFl_MixMngtIfClass_V13I.rkukgpfi MoFAirFl_MixMngtIfClass_V13I.rlfg MoFAirFl_MixMngtIfClass_V13I.rlfgBnk1 MoFAirFl_MixMngtIfClass_V13I.rlfgBnk2 MoFAirFl_MixMngtIfClass_V13I.rlp MoFAirFl_MixMngtIfClass_V13I.rlpBnk1 MoFAirFl_MixMngtIfClass_V13I.rlpBnk2 MoFAirFl_MixMngtIfClass_V13I.rlrext MoFAirFl_MixMngtIfClass_V13I.rlrextBnk1 MoFAirFl_MixMngtIfClass_V13I.rlrextBnk2 MoFAirFl_MixMngtIfClass_V13I.rlrint MoFAirFl_MixMngtIfClass_V13I.rlrintBnk1 MoFAirFl_MixMngtIfClass_V13I.rlrintBnk2 MoFAirFl_TrqActIfClass_V13I.agIntkClsd MoFAirFl_TrqActIfClass_V13I.dzworri MoFAirFl_TrqActIfClass_V13I.etaaufte MoFAirFl_TrqActIfClass_V13I.etazwist MoFAirFl_TrqActIfClass_V13I.ratInertCyl MoFAirFl_TrqActIfClass_V13I.ratInertEgrExtCyl MoFAirFl_TrqActIfClass_V13I.ratInertEgrIntCyl MoFAirFl_TrqActIfClass_V13I.zwcalcar_zzylzue MoFAirFl_TrqActIfClass_V13I.zwopt MoFAirFl_TrqActIfClass_V13I.zwout MoFAirFl_TrqActIfClass_V13I.zwoutcpl MoFAirFl_TrqActIfClass_V13I.zwouthiresl MoFAirFl_TrqActIfClass_V13I.zwouthireslAry_zzylzue MoFAirFl_TrqActIfClass_V13I.zwouthireslRdnt /end OUT_MEASUREMENT
 /begin LOC_MEASUREMENT MoFAirFlIn_bbOut1Cpl MoFAirFlIn_flgClr MoFAirFl_cntrComCntrS0Stat MoFAirFl_cntrComCntrS0StatCpl MoFAirFl_cntrComCntrS1Stat MoFAirFl_cntrComCntrS1StatCpl MoFAirFl_cntrComS0 MoFAirFl_cntrComS0Cpl MoFAirFl_cntrComS0Old MoFAirFl_cntrComS0OldCpl MoFAirFl_cntrComS0Rdnt MoFAirFl_cntrComS0RdntCpl MoFAirFl_cntrComS1 MoFAirFl_cntrComS1Cpl MoFAirFl_cntrComS1Old MoFAirFl_cntrComS1OldCpl MoFAirFl_cntrComS1Rdnt MoFAirFl_cntrComS1RdntCpl MoFAirFl_cntrDiagDebIn MoFAirFl_cntrErrDebInCom MoFAirFl_cntrErrDebInComCpl MoFAirFl_CtOffCplIfClass_V13I.evz_auscplCpl MoFAirFl_CtOffCplIfClass_V13I.evz_auscpl_memCpl MoFAirFl_CtOffCplIfClass_V13I.evz_austotCpl MoFAirFl_CtOffCplIfClass_V13I.evz_austot_memCpl MoFAirFl_CtOffCplIfClass_V13I.flgInjEnadCpl MoFAirFl_CtOffCplIfClass_V13I.injTrigCylMskCpl MoFAirFl_CtOffCplIfClass_V13I.injTrigCylMskRdntCpl MoFAirFl_CtOffCplIfClass_V13I.injmode_zzylhCpl MoFAirFl_CtOffCplIfClass_V13I.injmode_zzylh_rdntCpl MoFAirFl_CtOffCplIfClass_V13I.injmode_zzylnCpl MoFAirFl_CtOffCplIfClass_V13I.injmode_zzyln_rdntCpl MoFAirFl_CtOffCplIfClass_V13I.injmode_zzylsCpl MoFAirFl_CtOffCplIfClass_V13I.injmode_zzyls_rdntCpl MoFAirFl_CtOffCplIfClass_V13I.stInjPfiDeactvAryCpl MoFAirFl_CtOffCplIfClass_V13I.stInjPfiDeactvAryRdntCpl MoFAirFl_CtOffCplIfClass_V13I.stInjPfiDeactvBkupAryCpl MoFAirFl_CtOffCplIfClass_V13I.stInjTiPfi1InjrACpl MoFAirFl_CtOffCplIfClass_V13I.stInjTiPfi1InjrARdntCpl MoFAirFl_CtOffCplIfClass_V13I.stInjTiPfi1InjrBCpl MoFAirFl_CtOffCplIfClass_V13I.stInjTiPfi1InjrBRdntCpl MoFAirFl_CtOffCplIfClass_V13I.stInjTiPfi2InjrACpl MoFAirFl_CtOffCplIfClass_V13I.stInjTiPfi2InjrARdntCpl MoFAirFl_CtOffCplIfClass_V13I.stInjTiPfi2InjrBCpl MoFAirFl_CtOffCplIfClass_V13I.stInjTiPfi2InjrBRdntCpl MoFAirFl_CtOffCplIfClass_V13I.stInjTiPfiCpl MoFAirFl_CtOffCplIfClass_V13I.stInjTiPfiRdntCpl MoFAirFl_MixMngtCplIfClass_V13I.B_afimreqCpl MoFAirFl_MixMngtCplIfClass_V13I.facBnk2PfiCpl MoFAirFl_MixMngtCplIfClass_V13I.facBnkCpl MoFAirFl_MixMngtCplIfClass_V13I.facBnkPfiCpl MoFAirFl_MixMngtCplIfClass_V13I.facLamCtlPfiAryCpl MoFAirFl_MixMngtCplIfClass_V13I.facLamCtlPfiAryRdntCpl MoFAirFl_MixMngtCplIfClass_V13I.facLamCtlPfiBkupAryCpl MoFAirFl_MixMngtCplIfClass_V13I.facPcPfiRestBnk2Cpl MoFAirFl_MixMngtCplIfClass_V13I.facPcPfiRestCpl MoFAirFl_MixMngtCplIfClass_V13I.facPcRestCpl MoFAirFl_MixMngtCplIfClass_V13I.facPrtnPfiAryCpl MoFAirFl_MixMngtCplIfClass_V13I.facPrtnPfiAryRdntCpl MoFAirFl_MixMngtCplIfClass_V13I.facPrtnPfiBkupAryCpl MoFAirFl_MixMngtCplIfClass_V13I.facPrtnPfiCpl MoFAirFl_MixMngtCplIfClass_V13I.fakeslsaCpl MoFAirFl_MixMngtCplIfClass_V13I.ffuevaliCpl MoFAirFl_MixMngtCplIfClass_V13I.ffuevalipfiCpl MoFAirFl_MixMngtCplIfClass_V13I.fkrkAryCpl MoFAirFl_MixMngtCplIfClass_V13I.fkrkPfiAryCpl MoFAirFl_MixMngtCplIfClass_V13I.fkrkPfiAryRdntCpl MoFAirFl_MixMngtCplIfClass_V13I.flgLamSplitActvCpl MoFAirFl_MixMngtCplIfClass_V13I.fnsadCpl MoFAirFl_MixMngtCplIfClass_V13I.fr2Cpl MoFAirFl_MixMngtCplIfClass_V13I.frCpl MoFAirFl_MixMngtCplIfClass_V13I.fragdi2Cpl MoFAirFl_MixMngtCplIfClass_V13I.fragdiCpl MoFAirFl_MixMngtCplIfClass_V13I.frapfi2Cpl MoFAirFl_MixMngtCplIfClass_V13I.frapfiCpl MoFAirFl_MixMngtCplIfClass_V13I.lamsbg2Cpl MoFAirFl_MixMngtCplIfClass_V13I.lamsbgCpl MoFAirFl_MixMngtCplIfClass_V13I.larils2Cpl MoFAirFl_MixMngtCplIfClass_V13I.larilsCpl MoFAirFl_MixMngtCplIfClass_V13I.rCtlPriB1Cpl MoFAirFl_MixMngtCplIfClass_V13I.rCtlPriB2Cpl MoFAirFl_MixMngtCplIfClass_V13I.ratChrgAirCylPredPfiCpl MoFAirFl_MixMngtCplIfClass_V13I.ratFuMCylIndCpl MoFAirFl_MixMngtCplIfClass_V13I.ratFuMGdiBnk2Cpl MoFAirFl_MixMngtCplIfClass_V13I.ratFuMGdiCpl MoFAirFl_MixMngtCplIfClass_V13I.ratFuMPfiBnk2Cpl MoFAirFl_MixMngtCplIfClass_V13I.ratFuMPfiCpl MoFAirFl_MixMngtCplIfClass_V13I.ratFuPrtnPfiInjAryCpl MoFAirFl_MixMngtCplIfClass_V13I.ratFuPrtnPfiInjAryRdntCpl MoFAirFl_MixMngtCplIfClass_V13I.ratFuPrtnPfiInjBkupAryCpl MoFAirFl_MixMngtCplIfClass_V13I.ratPrdcAirPrtnPfiAryCpl MoFAirFl_MixMngtCplIfClass_V13I.ratPrdcAirPrtnPfiAryRdntCpl MoFAirFl_MixMngtCplIfClass_V13I.ratPrdcAirPrtnPfiBkupAryCpl MoFAirFl_MixMngtCplIfClass_V13I.rkagdi2Cpl MoFAirFl_MixMngtCplIfClass_V13I.rkagdiCpl MoFAirFl_MixMngtCplIfClass_V13I.rkapfi2Cpl MoFAirFl_MixMngtCplIfClass_V13I.rkapfiCpl MoFAirFl_MixMngtCplIfClass_V13I.rkausgCpl MoFAirFl_MixMngtCplIfClass_V13I.rkteBnk1Cpl MoFAirFl_MixMngtCplIfClass_V13I.rkteBnk2Cpl MoFAirFl_MixMngtCplIfClass_V13I.rkteCpl MoFAirFl_MixMngtCplIfClass_V13I.rkukgCpl MoFAirFl_MixMngtCplIfClass_V13I.rkukgpfiCpl MoFAirFl_MixMngtCplIfClass_V13I.rlfgBnk1Cpl MoFAirFl_MixMngtCplIfClass_V13I.rlfgBnk2Cpl MoFAirFl_MixMngtCplIfClass_V13I.rlfgCpl MoFAirFl_MixMngtCplIfClass_V13I.rlpBnk1Cpl MoFAirFl_MixMngtCplIfClass_V13I.rlpBnk2Cpl MoFAirFl_MixMngtCplIfClass_V13I.rlpCpl MoFAirFl_MixMngtCplIfClass_V13I.rlrextBnk1Cpl MoFAirFl_MixMngtCplIfClass_V13I.rlrextBnk2Cpl MoFAirFl_MixMngtCplIfClass_V13I.rlrextCpl MoFAirFl_MixMngtCplIfClass_V13I.rlrintBnk1Cpl MoFAirFl_MixMngtCplIfClass_V13I.rlrintBnk2Cpl MoFAirFl_MixMngtCplIfClass_V13I.rlrintCpl MoFAirFl_nEngOld MoFAirFl_nEngOldCpl MoFAirFl_stErrCplIn MoFAirFl_TrqActCplIfClass_V13I.agIntkClsdCpl MoFAirFl_TrqActCplIfClass_V13I.dzworriCpl MoFAirFl_TrqActCplIfClass_V13I.etaaufteCpl MoFAirFl_TrqActCplIfClass_V13I.etazwistCpl MoFAirFl_TrqActCplIfClass_V13I.ratInertCylCpl MoFAirFl_TrqActCplIfClass_V13I.ratInertEgrExtCylCpl MoFAirFl_TrqActCplIfClass_V13I.ratInertEgrIntCylCpl MoFAirFl_TrqActCplIfClass_V13I.zwcalcar_zzylzueCpl MoFAirFl_TrqActCplIfClass_V13I.zwoptCpl MoFAirFl_TrqActCplIfClass_V13I.zwoutCpl MoFAirFl_TrqActCplIfClass_V13I.zwoutcplCpl MoFAirFl_TrqActCplIfClass_V13I.zwouthireslAry_zzylzueCpl MoFAirFl_TrqActCplIfClass_V13I.zwouthireslCpl MoFAirFl_TrqActCplIfClass_V13I.zwouthireslRdntCpl /end LOC_MEASUREMENT
 FUNCTION_VERSION "51.2.0" /end FUNCTION
/begin FUNCTION MoFAirFl_MixCtlPfi "13.0.0    Function Monitoring: Mixture control PFI"
 /begin DEF_CHARACTERISTIC MoFAirFl_cntrErrDebMaxMixCtlPfiChkAirFl_C MoFAirFl_cntrErrDebMaxMixCtlPfiChkCtrl_C MoFAirFl_cntrRstMaxMixCtlPfiChkAirFl_C MoFAirFl_cntrRstMaxMixCtlPfiChkCtrl_C MoFAirFl_facAftStrtCorrnPfiMax_T MoFAirFl_facBnkMaxPfi_C MoFAirFl_facBnkMinPfi_C MoFAirFl_facLamAdpnMax_T MoFAirFl_facLamCtrlMax_C MoFAirFl_facTolrChkCpv_C MoFAirFl_facTolrRatFuMPfiChkMax_C MoFAirFl_facTolrRatFuMPfiChkMin_C MoFAirFl_nEngThdFuEvapChk_C MoFAirFl_nErrHndlgActvnMixCtlPfi_C MoFAirFl_ofsTolrChkCpv_C MoFAirFl_ofsTolrRatFuMPfiChk_C MoFAirFl_ratFuEvapMinHiEngSpd_C MoFAirFl_ratFuEvapMinLoEngSpd_C MoFAirFl_ratFuMLamAdpnPfiMax_C /end DEF_CHARACTERISTIC
 /begin REF_CHARACTERISTIC MoFAirFl_stCfgMoFAirFl_C MoF_tEng_DST /end REF_CHARACTERISTIC
 /begin IN_MEASUREMENT MoFAirFl_MixMngtIfClass_V13I.B_afimreq MoFAirFl_MixMngtIfClass_V13I.facBnk MoFAirFl_MixMngtIfClass_V13I.facBnk2Pfi MoFAirFl_MixMngtIfClass_V13I.facBnkPfi MoFAirFl_MixMngtIfClass_V13I.facLamCtlPfiAry MoFAirFl_MixMngtIfClass_V13I.facLamCtlPfiAryRdnt MoFAirFl_MixMngtIfClass_V13I.facLamCtlPfiBkupAry MoFAirFl_MixMngtIfClass_V13I.facPcPfiRest MoFAirFl_MixMngtIfClass_V13I.facPcPfiRestBnk2 MoFAirFl_MixMngtIfClass_V13I.facPcRest MoFAirFl_MixMngtIfClass_V13I.facPrtnPfi MoFAirFl_MixMngtIfClass_V13I.facPrtnPfiAry MoFAirFl_MixMngtIfClass_V13I.facPrtnPfiAryRdnt MoFAirFl_MixMngtIfClass_V13I.facPrtnPfiBkupAry MoFAirFl_MixMngtIfClass_V13I.fakeslsa MoFAirFl_MixMngtIfClass_V13I.ffuevali MoFAirFl_MixMngtIfClass_V13I.ffuevalipfi MoFAirFl_MixMngtIfClass_V13I.fkrkAry MoFAirFl_MixMngtIfClass_V13I.fkrkPfiAry MoFAirFl_MixMngtIfClass_V13I.fkrkPfiAryRdnt MoFAirFl_MixMngtIfClass_V13I.flgLamSplitActv MoFAirFl_MixMngtIfClass_V13I.fnsad MoFAirFl_MixMngtIfClass_V13I.fr MoFAirFl_MixMngtIfClass_V13I.fr2 MoFAirFl_MixMngtIfClass_V13I.fragdi MoFAirFl_MixMngtIfClass_V13I.fragdi2 MoFAirFl_MixMngtIfClass_V13I.frapfi MoFAirFl_MixMngtIfClass_V13I.frapfi2 MoFAirFl_MixMngtIfClass_V13I.lamsbg MoFAirFl_MixMngtIfClass_V13I.lamsbg2 MoFAirFl_MixMngtIfClass_V13I.larils MoFAirFl_MixMngtIfClass_V13I.larils2 MoFAirFl_MixMngtIfClass_V13I.rCtlPriB1 MoFAirFl_MixMngtIfClass_V13I.rCtlPriB2 MoFAirFl_MixMngtIfClass_V13I.ratChrgAirCylPredPfi MoFAirFl_MixMngtIfClass_V13I.ratFuMCylInd MoFAirFl_MixMngtIfClass_V13I.ratFuMGdi MoFAirFl_MixMngtIfClass_V13I.ratFuMGdiBnk2 MoFAirFl_MixMngtIfClass_V13I.ratFuMPfi MoFAirFl_MixMngtIfClass_V13I.ratFuMPfiBnk2 MoFAirFl_MixMngtIfClass_V13I.ratFuPrtnPfiInjAry MoFAirFl_MixMngtIfClass_V13I.ratFuPrtnPfiInjAryRdnt MoFAirFl_MixMngtIfClass_V13I.ratFuPrtnPfiInjBkupAry MoFAirFl_MixMngtIfClass_V13I.ratPrdcAirPrtnPfiAry MoFAirFl_MixMngtIfClass_V13I.ratPrdcAirPrtnPfiAryRdnt MoFAirFl_MixMngtIfClass_V13I.ratPrdcAirPrtnPfiBkupAry MoFAirFl_MixMngtIfClass_V13I.rkagdi MoFAirFl_MixMngtIfClass_V13I.rkagdi2 MoFAirFl_MixMngtIfClass_V13I.rkapfi MoFAirFl_MixMngtIfClass_V13I.rkapfi2 MoFAirFl_MixMngtIfClass_V13I.rkausg MoFAirFl_MixMngtIfClass_V13I.rkte MoFAirFl_MixMngtIfClass_V13I.rkteBnk1 MoFAirFl_MixMngtIfClass_V13I.rkteBnk2 MoFAirFl_MixMngtIfClass_V13I.rkukg MoFAirFl_MixMngtIfClass_V13I.rkukgpfi MoFAirFl_MixMngtIfClass_V13I.rlfg MoFAirFl_MixMngtIfClass_V13I.rlfgBnk1 MoFAirFl_MixMngtIfClass_V13I.rlfgBnk2 MoFAirFl_MixMngtIfClass_V13I.rlp MoFAirFl_MixMngtIfClass_V13I.rlpBnk1 MoFAirFl_MixMngtIfClass_V13I.rlpBnk2 MoFAirFl_MixMngtIfClass_V13I.rlrext MoFAirFl_MixMngtIfClass_V13I.rlrextBnk1 MoFAirFl_MixMngtIfClass_V13I.rlrextBnk2 MoFAirFl_MixMngtIfClass_V13I.rlrint MoFAirFl_MixMngtIfClass_V13I.rlrintBnk1 MoFAirFl_MixMngtIfClass_V13I.rlrintBnk2 MoFESpd_nEng MoF_bAirFlChkDisbl MoF_tEng MoF_tEng_DST_result Mo_bPostDrv Mo_bPreDrv Mo_ctRst Mo_ctRstCpl Mo_stCplChk Mo_stMoC Mo_stMoCCpl Mo_stMoF Mo_stMoFCpl /end IN_MEASUREMENT
 /begin OUT_MEASUREMENT MoFAirFl_flgIrrvErrMixCtlPfiChkAirFlMsg MoFAirFl_flgIrrvErrMixCtlPfiChkCtrlMsg MoFAirFl_flgTestMixCtlPfiChkAirFlMsg MoFAirFl_flgTestMixCtlPfiChkCtrlMsg MoFAirFl_ratFuMTotPfiExpt MoFAirFl_ratFuMTotPfiExptBnk2 MoFAirFl_stErrMixCtlPfiChkAirFlMsg MoFAirFl_stErrMixCtlPfiChkCtrlMsg /end OUT_MEASUREMENT
 /begin LOC_MEASUREMENT MoFAirFlMixCtlPfiChkAirFl_flgClr MoFAirFlMixCtlPfiChkCtrl_flgClr MoFAirFlMixCtlPfi_nEng MoFAirFl_calcFuMkfbs_MP MoFAirFl_cntrDiagDebMixCtlPfiChkAirFl MoFAirFl_cntrDiagDebMixCtlPfiChkCtrl MoFAirFl_cntrErrDebMixCtlPfiChkAirFl MoFAirFl_cntrErrDebMixCtlPfiChkAirFlCpl MoFAirFl_cntrErrDebMixCtlPfiChkCtrl MoFAirFl_cntrErrDebMixCtlPfiChkCtrlCpl MoFAirFl_facPcPfi_MP MoFAirFl_ratFuMPfiExpt MoFAirFl_ratFuMPfiExptBnk2 MoFAirFl_ratFuMPfiExptBnk2Cpl MoFAirFl_ratFuMPfiExptCpl MoFAirFl_ratFuMTotPfiExptBnk2Cpl MoFAirFl_ratFuMTotPfiExptCpl MoFAirFl_rktechk_ratFumTotPfi_MP MoFAirFl_stErrMixCtlPfiChkAirFl_MP MoFAirFl_stErrMixCtlPfiChkCtrl_MP /end LOC_MEASUREMENT
 FUNCTION_VERSION "13.0.0" /end FUNCTION
/begin FUNCTION MoFAirFl_Mode "35.0.0    Function Monitoring: Operation mode"
 /begin DEF_CHARACTERISTIC MoFAirFl_cntrErrDebMaxMode_C MoFAirFl_cntrRstMaxMode_C MoFAirFl_nErrHndlgActvnMode_C MoFAirFl_ratLamExpdMaxStoi_C MoFAirFl_ratLamExpdMinStoi_C /end DEF_CHARACTERISTIC
 /begin REF_CHARACTERISTIC MoFAirFl_stCfgMoFAirFl_C /end REF_CHARACTERISTIC
 /begin IN_MEASUREMENT MoFAirFl_MixMngtIfClass_V13I.B_afimreq MoFAirFl_MixMngtIfClass_V13I.facBnk MoFAirFl_MixMngtIfClass_V13I.facBnk2Pfi MoFAirFl_MixMngtIfClass_V13I.facBnkPfi MoFAirFl_MixMngtIfClass_V13I.facLamCtlPfiAry MoFAirFl_MixMngtIfClass_V13I.facLamCtlPfiAryRdnt MoFAirFl_MixMngtIfClass_V13I.facLamCtlPfiBkupAry MoFAirFl_MixMngtIfClass_V13I.facPcPfiRest MoFAirFl_MixMngtIfClass_V13I.facPcPfiRestBnk2 MoFAirFl_MixMngtIfClass_V13I.facPcRest MoFAirFl_MixMngtIfClass_V13I.facPrtnPfi MoFAirFl_MixMngtIfClass_V13I.facPrtnPfiAry MoFAirFl_MixMngtIfClass_V13I.facPrtnPfiAryRdnt MoFAirFl_MixMngtIfClass_V13I.facPrtnPfiBkupAry MoFAirFl_MixMngtIfClass_V13I.fakeslsa MoFAirFl_MixMngtIfClass_V13I.ffuevali MoFAirFl_MixMngtIfClass_V13I.ffuevalipfi MoFAirFl_MixMngtIfClass_V13I.fkrkAry MoFAirFl_MixMngtIfClass_V13I.fkrkPfiAry MoFAirFl_MixMngtIfClass_V13I.fkrkPfiAryRdnt MoFAirFl_MixMngtIfClass_V13I.flgLamSplitActv MoFAirFl_MixMngtIfClass_V13I.fnsad MoFAirFl_MixMngtIfClass_V13I.fr MoFAirFl_MixMngtIfClass_V13I.fr2 MoFAirFl_MixMngtIfClass_V13I.fragdi MoFAirFl_MixMngtIfClass_V13I.fragdi2 MoFAirFl_MixMngtIfClass_V13I.frapfi MoFAirFl_MixMngtIfClass_V13I.frapfi2 MoFAirFl_MixMngtIfClass_V13I.lamsbg MoFAirFl_MixMngtIfClass_V13I.lamsbg2 MoFAirFl_MixMngtIfClass_V13I.larils MoFAirFl_MixMngtIfClass_V13I.larils2 MoFAirFl_MixMngtIfClass_V13I.rCtlPriB1 MoFAirFl_MixMngtIfClass_V13I.rCtlPriB2 MoFAirFl_MixMngtIfClass_V13I.ratChrgAirCylPredPfi MoFAirFl_MixMngtIfClass_V13I.ratFuMCylInd MoFAirFl_MixMngtIfClass_V13I.ratFuMGdi MoFAirFl_MixMngtIfClass_V13I.ratFuMGdiBnk2 MoFAirFl_MixMngtIfClass_V13I.ratFuMPfi MoFAirFl_MixMngtIfClass_V13I.ratFuMPfiBnk2 MoFAirFl_MixMngtIfClass_V13I.ratFuPrtnPfiInjAry MoFAirFl_MixMngtIfClass_V13I.ratFuPrtnPfiInjAryRdnt MoFAirFl_MixMngtIfClass_V13I.ratFuPrtnPfiInjBkupAry MoFAirFl_MixMngtIfClass_V13I.ratPrdcAirPrtnPfiAry MoFAirFl_MixMngtIfClass_V13I.ratPrdcAirPrtnPfiAryRdnt MoFAirFl_MixMngtIfClass_V13I.ratPrdcAirPrtnPfiBkupAry MoFAirFl_MixMngtIfClass_V13I.rkagdi MoFAirFl_MixMngtIfClass_V13I.rkagdi2 MoFAirFl_MixMngtIfClass_V13I.rkapfi MoFAirFl_MixMngtIfClass_V13I.rkapfi2 MoFAirFl_MixMngtIfClass_V13I.rkausg MoFAirFl_MixMngtIfClass_V13I.rkte MoFAirFl_MixMngtIfClass_V13I.rkteBnk1 MoFAirFl_MixMngtIfClass_V13I.rkteBnk2 MoFAirFl_MixMngtIfClass_V13I.rkukg MoFAirFl_MixMngtIfClass_V13I.rkukgpfi MoFAirFl_MixMngtIfClass_V13I.rlfg MoFAirFl_MixMngtIfClass_V13I.rlfgBnk1 MoFAirFl_MixMngtIfClass_V13I.rlfgBnk2 MoFAirFl_MixMngtIfClass_V13I.rlp MoFAirFl_MixMngtIfClass_V13I.rlpBnk1 MoFAirFl_MixMngtIfClass_V13I.rlpBnk2 MoFAirFl_MixMngtIfClass_V13I.rlrext MoFAirFl_MixMngtIfClass_V13I.rlrextBnk1 MoFAirFl_MixMngtIfClass_V13I.rlrextBnk2 MoFAirFl_MixMngtIfClass_V13I.rlrint MoFAirFl_MixMngtIfClass_V13I.rlrintBnk1 MoFAirFl_MixMngtIfClass_V13I.rlrintBnk2 MoFESpd_nEng MoF_bAirFlChkDisbl Mo_bPostDrv Mo_bPreDrv Mo_ctRst Mo_ctRstCpl Mo_stCplChk Mo_stMoC Mo_stMoCCpl Mo_stMoF Mo_stMoFCpl /end IN_MEASUREMENT
 /begin OUT_MEASUREMENT MoFAirFl_flgIrrvErrModeMsg MoFAirFl_flgTestModeMsg MoFAirFl_stErrModeMsg /end OUT_MEASUREMENT
 /begin LOC_MEASUREMENT MoFAirFlMode_flgClr MoFAirFl_cntrDiagDebMode MoFAirFl_cntrErrDebMode MoFAirFl_cntrErrDebModeCpl MoFAirFl_stErrMode_MP /end LOC_MEASUREMENT
 FUNCTION_VERSION "35.0.0" /end FUNCTION
/begin FUNCTION MoFAir_FilgPrdc "43.0.0    Function Monitoring: Relative air charge predicted"
 /begin DEF_CHARACTERISTIC MoFAirFl_cntrErrDebMaxFilgPrdc_C MoFAirFl_cntrFillgHiDeDlyMax_C MoFAirFl_cntrRstMaxFilgPrdc_C MoFAirFl_facCnvnRatFillgMFlow_C MoFAirFl_nErrHndlgActvnFilgPrdc_C MoFAirFl_ofsRatFillgPrdc_C MoFAirFl_ratFillg_Ax MoFAirFl_ratLamMaxMFlow_C MoFAirFl_ratLamMinMFlow_C RLV08_UM /end DEF_CHARACTERISTIC
 /begin IN_MEASUREMENT MoFAirFl_etaInjCtOff MoFAirFl_MixMngtIfClass_V13I.B_afimreq MoFAirFl_MixMngtIfClass_V13I.facBnk MoFAirFl_MixMngtIfClass_V13I.facBnk2Pfi MoFAirFl_MixMngtIfClass_V13I.facBnkPfi MoFAirFl_MixMngtIfClass_V13I.facLamCtlPfiAry MoFAirFl_MixMngtIfClass_V13I.facLamCtlPfiAryRdnt MoFAirFl_MixMngtIfClass_V13I.facLamCtlPfiBkupAry MoFAirFl_MixMngtIfClass_V13I.facPcPfiRest MoFAirFl_MixMngtIfClass_V13I.facPcPfiRestBnk2 MoFAirFl_MixMngtIfClass_V13I.facPcRest MoFAirFl_MixMngtIfClass_V13I.facPrtnPfi MoFAirFl_MixMngtIfClass_V13I.facPrtnPfiAry MoFAirFl_MixMngtIfClass_V13I.facPrtnPfiAryRdnt MoFAirFl_MixMngtIfClass_V13I.facPrtnPfiBkupAry MoFAirFl_MixMngtIfClass_V13I.fakeslsa MoFAirFl_MixMngtIfClass_V13I.ffuevali MoFAirFl_MixMngtIfClass_V13I.ffuevalipfi MoFAirFl_MixMngtIfClass_V13I.fkrkAry MoFAirFl_MixMngtIfClass_V13I.fkrkPfiAry MoFAirFl_MixMngtIfClass_V13I.fkrkPfiAryRdnt MoFAirFl_MixMngtIfClass_V13I.flgLamSplitActv MoFAirFl_MixMngtIfClass_V13I.fnsad MoFAirFl_MixMngtIfClass_V13I.fr MoFAirFl_MixMngtIfClass_V13I.fr2 MoFAirFl_MixMngtIfClass_V13I.fragdi MoFAirFl_MixMngtIfClass_V13I.fragdi2 MoFAirFl_MixMngtIfClass_V13I.frapfi MoFAirFl_MixMngtIfClass_V13I.frapfi2 MoFAirFl_MixMngtIfClass_V13I.lamsbg MoFAirFl_MixMngtIfClass_V13I.lamsbg2 MoFAirFl_MixMngtIfClass_V13I.larils MoFAirFl_MixMngtIfClass_V13I.larils2 MoFAirFl_MixMngtIfClass_V13I.rCtlPriB1 MoFAirFl_MixMngtIfClass_V13I.rCtlPriB2 MoFAirFl_MixMngtIfClass_V13I.ratChrgAirCylPredPfi MoFAirFl_MixMngtIfClass_V13I.ratFuMCylInd MoFAirFl_MixMngtIfClass_V13I.ratFuMGdi MoFAirFl_MixMngtIfClass_V13I.ratFuMGdiBnk2 MoFAirFl_MixMngtIfClass_V13I.ratFuMPfi MoFAirFl_MixMngtIfClass_V13I.ratFuMPfiBnk2 MoFAirFl_MixMngtIfClass_V13I.ratFuPrtnPfiInjAry MoFAirFl_MixMngtIfClass_V13I.ratFuPrtnPfiInjAryRdnt MoFAirFl_MixMngtIfClass_V13I.ratFuPrtnPfiInjBkupAry MoFAirFl_MixMngtIfClass_V13I.ratPrdcAirPrtnPfiAry MoFAirFl_MixMngtIfClass_V13I.ratPrdcAirPrtnPfiAryRdnt MoFAirFl_MixMngtIfClass_V13I.ratPrdcAirPrtnPfiBkupAry MoFAirFl_MixMngtIfClass_V13I.rkagdi MoFAirFl_MixMngtIfClass_V13I.rkagdi2 MoFAirFl_MixMngtIfClass_V13I.rkapfi MoFAirFl_MixMngtIfClass_V13I.rkapfi2 MoFAirFl_MixMngtIfClass_V13I.rkausg MoFAirFl_MixMngtIfClass_V13I.rkte MoFAirFl_MixMngtIfClass_V13I.rkteBnk1 MoFAirFl_MixMngtIfClass_V13I.rkteBnk2 MoFAirFl_MixMngtIfClass_V13I.rkukg MoFAirFl_MixMngtIfClass_V13I.rkukgpfi MoFAirFl_MixMngtIfClass_V13I.rlfg MoFAirFl_MixMngtIfClass_V13I.rlfgBnk1 MoFAirFl_MixMngtIfClass_V13I.rlfgBnk2 MoFAirFl_MixMngtIfClass_V13I.rlp MoFAirFl_MixMngtIfClass_V13I.rlpBnk1 MoFAirFl_MixMngtIfClass_V13I.rlpBnk2 MoFAirFl_MixMngtIfClass_V13I.rlrext MoFAirFl_MixMngtIfClass_V13I.rlrextBnk1 MoFAirFl_MixMngtIfClass_V13I.rlrextBnk2 MoFAirFl_MixMngtIfClass_V13I.rlrint MoFAirFl_MixMngtIfClass_V13I.rlrintBnk1 MoFAirFl_MixMngtIfClass_V13I.rlrintBnk2 MoFESpd_nEng MoF_bAirFlChkDisbl Mo_bPostDrv Mo_bPreDrv Mo_ctRst Mo_ctRstCpl Mo_stCplChk Mo_stMoC Mo_stMoCCpl Mo_stMoF Mo_stMoFCpl /end IN_MEASUREMENT
 /begin OUT_MEASUREMENT MoFAirFl_flgIrrvErrFilgPrdcMsg MoFAirFl_flgTestFilgPrdcMsg MoFAirFl_ratFillg MoFAirFl_ratFillgFrsh MoFAirFl_ratFillgTot MoFAirFl_ratFillg_Ax_result MoF_rAMPTLam RLV08_UM_result rl_um /end OUT_MEASUREMENT
 /begin LOC_MEASUREMENT MoFAirFilgPrdc_flgClr MoFAirFl_cntrDiagDebFilgPrdc MoFAirFl_cntrErrDebFilgPrdc MoFAirFl_cntrErrDebFilgPrdcCpl MoFAirFl_cntrFillgHiDeDly MoFAirFl_cntrFillgHiDeDlyCpl MoFAirFl_ratFillgCpl MoFAirFl_ratFillgFrshCpl MoFAirFl_ratFillgTotCpl MoFAirFl_ratFillg_Ax_result_Cpl MoF_rAMPTLamCpl RLV08_UM_result_Cpl rl_ur /end LOC_MEASUREMENT
 FUNCTION_VERSION "43.0.0" /end FUNCTION
/begin FUNCTION MoFAPP_Co "120.0.0   Function Monitoring: Accelerator pedal position"
 /begin DEF_CHARACTERISTIC MoFAPP_cntrDeb_C MoFAPP_cntrRst_C MoFAPP_cntrTestAPP_C MoFAPP_swtMinSel_C MoFAPP_uFL_C MoFAPP_uLoLim_C MoFAPP_uMaxDiffFL_C MoFAPP_uMaxDiffPL_C /end DEF_CHARACTERISTIC
 /begin IN_MEASUREMENT APP_stSigSrc MoCADC_bDef MoCADC_bNTPActv MoFBrk_flgBrkApp Mo_ctRst Mo_ctRstCpl Mo_stCplChk Mo_stMoC Mo_stMoCCpl Mo_stMoF Mo_stMoFCpl /end IN_MEASUREMENT
 /begin OUT_MEASUREMENT MoFAPP_flgIrrvErrMsg MoFAPP_flgPlausErrDeb MoFAPP_flgTestMsg MoFAPP_stAPPMsg MoFAPP_stLimpMsg MoFAPP_stSigSrc MoFAPP_uHiResl /end OUT_MEASUREMENT
 /begin LOC_MEASUREMENT MoFAPPCo_bbLoc1Cpl MoFAPPCo_bbOut1Cpl MoFAPP_cntrDeb MoFAPP_cntrDebCpl MoFAPP_cntrTestAPP MoFAPP_flgAdcErr1 MoFAPP_flgAdcErr2 MoFAPP_flgClr MoFAPP_flgExtErr MoFAPP_flgNTPRel MoFAPP_flgPlausErr MoFAPP_stSigSrcCpl MoFAPP_uApp1 MoFAPP_uApp1Cpl MoFAPP_uApp2 MoFAPP_uApp2Cpl MoFAPP_uHiReslCpl /end LOC_MEASUREMENT
 FUNCTION_VERSION "120.0.0" /end FUNCTION
/begin FUNCTION MoFAPP_Rel "28.0.0    Function Monitoring: Relative accelerator pedal position"
 /begin DEF_CHARACTERISTIC MoFAPP_ratApp_DST MoFAPP_ratHiResl_DST MoFAPP_uHiReslMaxLimp_C MoFAPP_uHiReslMax_C MoFAPP_uHiReslMinLimp_C MoFAPP_uHiReslMin_C MoF_rAPP_DST /end DEF_CHARACTERISTIC
 /begin IN_MEASUREMENT MoFAPP_stSigSrc MoFAPP_uHiResl Mo_stCplChk Mo_stMoC Mo_stMoCCpl /end IN_MEASUREMENT
 /begin OUT_MEASUREMENT MoFAPP_ratApp_DST_result MoFAPP_ratHiResl MoFAPP_ratHiResl_DST_result MoF_rAPP MoF_rAPP_DST_result /end OUT_MEASUREMENT
 /begin LOC_MEASUREMENT MoFAPP_ratApp_DST_resultCpl MoFAPP_ratHiReslCpl MoFAPP_ratHiResl_DST_resultCpl MoF_rAPPCpl MoF_rAPP_DST_resultCpl /end LOC_MEASUREMENT
 FUNCTION_VERSION "28.0.0" /end FUNCTION
/begin FUNCTION MoFBrk_Co "179.0.1   Function Monitoring: Brake"
 /begin DEF_CHARACTERISTIC MoFBrk_cntrBrkAcc_C MoFBrk_cntrBrkApp_C MoFBrk_cntrBrkCrsCtrl_C MoFBrk_cntrBrkMai_C MoFBrk_cntrBrkRdnt_C MoFBrk_flgEnaFrmEBBA_C /end DEF_CHARACTERISTIC
 /begin IN_MEASUREMENT MoFFrm_flgEBBBrkPedlOn Mo_stCplChk Mo_stMoC Mo_stMoCCpl /end IN_MEASUREMENT
 /begin OUT_MEASUREMENT MoFBrk_flgBrk MoFBrk_flgBrkAcc MoFBrk_flgBrkApp MoFBrk_flgBrkCrsCtrl MoFBrk_flgEBBBrkPedlOn MoFBrk_flgMaiBrk MoFBrk_flgRdntBrk /end OUT_MEASUREMENT
 /begin LOC_MEASUREMENT MoFBrkCo_bbLoc1Cpl MoFBrkCo_bbOut1Cpl MoFBrk_cntrBrkDeb MoFBrk_cntrBrkDebCpl MoFBrk_cntrBrkMaiDeb MoFBrk_cntrBrkMaiDebCpl MoFBrk_cntrBrkRdntDeb MoFBrk_cntrBrkRdntDebCpl MoFBrk_flgDioMaiBrkErr MoFBrk_flgDioRdntBrkErr /end LOC_MEASUREMENT
 FUNCTION_VERSION "179.0.1" /end FUNCTION
/begin FUNCTION MoFCCtl_Co "131.0.0   Function Monitoring: Cruise control"
 /begin DEF_CHARACTERISTIC MoFCCtl_cntrCrsCtrlActvDeb_C MoFCCtl_ratAppPsd_C MoFCCtl_swtEnaAppPsd_C MoFCCtl_swtEnblMon_C /end DEF_CHARACTERISTIC
 /begin IN_MEASUREMENT MoFAPP_ratHiResl MoFFrm_flgCrsCtrlMaiSwt MoFFrm_stCrsCtrlSwt MoFStrt_flgBrkHldActv Mo_stCplChk Mo_stMoC Mo_stMoCCpl /end IN_MEASUREMENT
 /begin OUT_MEASUREMENT MoFCCtl_flgAct MoFCCtl_flgShOff /end OUT_MEASUREMENT
 /begin LOC_MEASUREMENT MoFCCtlCo_bbLoc1Cpl MoFCCtlCo_bbLoc2Cpl MoFCCtlCo_bbOut1Cpl MoFCCtl_cntrCrsCtrlActvDeb MoFCCtl_cntrCrsCtrlActvDebCpl MoFCCtl_flgAppLoDetn MoFCCtl_flgAppPsdDetn MoFCCtl_flgBtnActvResu MoFCCtl_flgBtnActvSet MoFCCtl_flgBtnLoDetnResu MoFCCtl_flgBtnLoDetnSet MoFCCtl_flgCnclSwt MoFCCtl_flgCrsCtrlVldSig MoFCCtl_flgErrHw MoFCCtl_flgFallEdgeResu MoFCCtl_flgFallEdgeSet MoFCCtl_flgMaiSwt MoFCCtl_flgResuSwt MoFCCtl_flgSetSwt MoFCCtl_flgTipDwnLo MoFCCtl_flgTipUpLo /end LOC_MEASUREMENT
 FUNCTION_VERSION "131.0.0" /end FUNCTION
/begin FUNCTION MoFClth_Co "84.0.0    Function Monitoring: Clutch"
 /begin DEF_CHARACTERISTIC MoFClth_cntrBotmCluTurnOffDly_C MoFClth_cntrBotmCluTurnOnDly_C MoFClth_cntrT15OnDeb_C MoFClth_cntrTopCluTurnOffDly_C MoFClth_cntrTopCluTurnOnDly_C MoFClth_flgSwt_C /end DEF_CHARACTERISTIC
 /begin IN_MEASUREMENT Mo_stCplChk Mo_stMoC Mo_stMoCCpl /end IN_MEASUREMENT
 /begin OUT_MEASUREMENT MoFClth_flgClthBot MoFClth_flgClthTop /end OUT_MEASUREMENT
 /begin LOC_MEASUREMENT MoFClthCo_bbLoc1Cpl MoFClthCo_bbOut1Cpl MoFClth_cntrBotmCluDeb MoFClth_cntrBotmCluDebCpl MoFClth_cntrT15OnDeb MoFClth_cntrT15OnDebCpl MoFClth_cntrTopCluDeb MoFClth_cntrTopCluDebCpl MoFClth_flgCluBotRaw MoFClth_flgCluTopRaw /end LOC_MEASUREMENT
 FUNCTION_VERSION "84.0.0" /end FUNCTION
/begin FUNCTION MoFCoVeh_Co "50.1.0    Function Monitoring: Torque coordination vehicle"
 /begin DEF_CHARACTERISTIC MoFTrqPtd_cntrDebRecupFrbdn_C MoFTrqPtd_tiFltTqPtdVehMax_C MoFTrqPtd_tiFltTqPtdVehMin_C MoFTrqPtd_tqAltMaxABSErr_C MoFTrqPtd_tqAltTqMaxErr_T MoFTrqPtd_tqDecExtIntOffsMax_C MoFTrqPtd_tqRecupInhibOffs_C /end DEF_CHARACTERISTIC
 /begin IN_MEASUREMENT ASDrf_trqClthFlt LsComp_tqSwilLossNotFild MoFDCS_flgComErrESP MoFDCS_flgDecIntvActv MoFDCS_flgIntvActv MoFDCS_tqCluPtd MoFDrAs_trqPtd MoFESpd_nEng MoFSpdG_tqPtd MoFTra_flgDecIntvActv MoFTrqCmp_flgIrrvErrMax MoFTrqCmp_flgIrrvErrMin MoFTrqPtd_facCmpSpdGovr MoFTrqPtd_tqCmpSwilLoss MoFTrqPtd_tqWhlDrvDem MoFTrqPtd_tqWhlMin MoFTrqRat_ratTqPTPlaus MoFTrqRat_rTrqPT MoF_trqLos MoF_trqLosPT Mo_stCplChk Mo_stMoC Mo_stMoCCpl Mo_stMoF PTDist_tqCrksftSet /end IN_MEASUREMENT
 /begin OUT_MEASUREMENT MoFTrqPtd_flgOperModRecupFrbdn MoFTrqPtd_flgSelAltMod MoFTrqPtd_tqVehPtdMinRaw MoFTrqPtd_tqVehPtdWoInt MoFTrqPtd_tqVehPtdWoIntvMin MoFTrqPtd_tqVehPtdWoIntvMinMsg MoFTrqPtd_tqVehPtdWoIntvMsg /end OUT_MEASUREMENT
 /begin LOC_MEASUREMENT MoFCoVehCo_bbOut1Cpl MoFTrqPtd_cntrDebRecupFrbdn MoFTrqPtd_cntrDebRecupFrbdnCpl MoFTrqPtd_tqAltTqMaxErr MoFTrqPtd_tqAltTqMaxErrCpl MoFTrqPtd_tqDecExtIntOffs MoFTrqPtd_tqDecExtIntOffsCpl MoFTrqPtd_tqMinSeld MoFTrqPtd_tqMinSeldCpl MoFTrqPtd_tqMinSeldUnfild MoFTrqPtd_tqMinSeldUnfildCpl MoFTrqPtd_tqRecupInhibDem MoFTrqPtd_tqRecupInhibDemCpl MoFTrqPtd_tqVehPtdMinRawCpl MoFTrqPtd_tqVehPtdMinRawLo MoFTrqPtd_tqVehPtdMinRawLoCpl MoFTrqPtd_tqVehPtdWoIntCpl MoFTrqPtd_tqVehPtdWoIntvMinCpl MoFTrqPtd_tqVehPtdWoIntvRaw MoFTrqPtd_tqVehPtdWoIntvRawCpl MoFTrqPtd_tqVehPtdWoIntvRawFildLo MoFTrqPtd_tqVehPtdWoIntvRawFildLoCpl MoFTrqPtd_tqVehPtdWoIntvRawUnfild MoFTrqPtd_tqVehPtdWoIntvRawUnfildCpl /end LOC_MEASUREMENT
 FUNCTION_VERSION "50.1.0" /end FUNCTION
/begin FUNCTION MoFDCS_Co "143.0.0   Function Monitoring: Drag-torque control system"
 /begin DEF_CHARACTERISTIC MoFDCS_cntrDebDCSDeactv_C MoFDCS_cntrStbErrDeb_C MoFDCS_rTqBoostMinLim_C MoFDCS_tqLimDCSNorm_C MoFDCS_tqLimDCSPlus_C /end DEF_CHARACTERISTIC
 /begin IN_MEASUREMENT MoFFrm_flgComErrDCS MoFFrm_flgDCSPlus MoFFrm_flgDecIntvActvDCS MoFFrm_flgStbErr MoFFrm_flgTqUpReqDCS MoFFrm_tqWhlDCS MoFTra_rTqCnvrBoost MoF_rTrqPT MoF_trqLosPT Mo_stCplChk Mo_stMoC Mo_stMoCCpl VMSI_trqMin /end IN_MEASUREMENT
 /begin OUT_MEASUREMENT MoFDCS_flgComErrESP MoFDCS_flgDecIntvActv MoFDCS_flgIntvActv MoFDCS_flgPtd MoFDCS_flgStbErr MoFDCS_tqCluPtd MoFDCS_tqWhlPtd MoFDCS_trqDem /end OUT_MEASUREMENT
 /begin LOC_MEASUREMENT MoFDCSCo_bbOut1Cpl MoFDCS_cntrDebDCSDeactv MoFDCS_cntrDebDCSDeactvCpl MoFDCS_cntrStbErrDeb MoFDCS_cntrStbErrDebCpl MoFDCS_tqCluPtdCpl MoFDCS_tqDesWhl MoFDCS_tqDesWhlCpl MoFDCS_tqWhlPtdCpl MoFDCS_trqDemCpl /end LOC_MEASUREMENT
 FUNCTION_VERSION "143.0.0" /end FUNCTION
/begin FUNCTION MoFDrAs_Co "126.1.0   Function Monitoring: Driver assistance systems (ACC/CCtl)"
 /begin DEF_CHARACTERISTIC MoFDrAs_cntrACC_C MoFDrAs_cntrCrsCtrl_C MoFDrAs_swtEBB_C MoFDrAs_vACCMin_C MoFDrAs_vCrsCtrlMin_C /end DEF_CHARACTERISTIC
 /begin IN_MEASUREMENT CoVMD_trqCrCtl CrCtl_stPtd MoFACC_flgPtd MoFBrk_flgBrkAcc MoFBrk_flgBrkCrsCtrl MoFBrk_flgEBBBrkPedlOn MoFCCtl_flgAct MoFCCtl_flgShOff MoFVSS_v Mo_stCplChk Mo_stMoC Mo_stMoCCpl VehMot_stPrpCrCtl /end IN_MEASUREMENT
 /begin OUT_MEASUREMENT MoFDrAs_stACCPtdMsg MoFDrAs_stCCtlPtdMsg MoFDrAs_stPtdMsg MoFDrAs_trqPtd /end OUT_MEASUREMENT
 /begin LOC_MEASUREMENT MoFDrAsCo_bbLocCpl MoFDrAs_cntrACC MoFDrAs_cntrACCCpl MoFDrAs_cntrCrsCtrl MoFDrAs_cntrCrsCtrlCpl MoFDrAs_flgACCPtd MoFDrAs_flgActv MoFDrAs_flgBrkACC MoFDrAs_flgBrkCrCtl MoFDrAs_flgCrsCtrlPtd MoFDrAs_trqPtdCpl /end LOC_MEASUREMENT
 FUNCTION_VERSION "126.1.0" /end FUNCTION
/begin COMPU_METHOD B_TRUE "" TAB_VERB "%6.3" "" COMPU_TAB_REF B_TRUE /end COMPU_METHOD
/begin COMPU_VTAB B_TRUE "" TAB_VERB 2 0 "FALSE" 1 "TRUE" /end COMPU_VTAB
/begin COMPU_METHOD dez "" RAT_FUNC "%6.2" "" COEFFS 0 1 0 0 0 1 /end COMPU_METHOD
/begin COMPU_METHOD fak_q0p000244 "" RAT_FUNC "%6.5" "-" COEFFS 0 65536 0 0 0 16 /end COMPU_METHOD
/begin COMPU_METHOD fak_sw_b1 "" RAT_FUNC "%7.6" "-" COEFFS 0 65536 0 0 0 2 /end COMPU_METHOD
/begin COMPU_METHOD fak_ub_b1 "" RAT_FUNC "%6.4" "-" COEFFS 0 256 0 0 0 1 /end COMPU_METHOD
/begin COMPU_METHOD fak_ub_b2 "" RAT_FUNC "%8.5" "-" COEFFS 0 256 0 0 0 2 /end COMPU_METHOD
/begin COMPU_METHOD fak_uw_b16 "" RAT_FUNC "%6.5" "-" COEFFS 0 65536 0 0 0 16 /end COMPU_METHOD
/begin COMPU_METHOD fak_uw_b2 "" RAT_FUNC "%7.6" "-" COEFFS 0 65536 0 0 0 2 /end COMPU_METHOD
/begin COMPU_METHOD fak_uw_b64 "" RAT_FUNC "%6.5" "-" COEFFS 0 65536 0 0 0 64 /end COMPU_METHOD
/begin COMPU_METHOD kw_q0p0156 "" RAT_FUNC "%6.4" "Grad KW" COEFFS 0 64 0 0 0 1 /end COMPU_METHOD
/begin COMPU_METHOD md_q0p1 "" RAT_FUNC "%6.3" "Nm" COEFFS 0 10 0 0 0 1 /end COMPU_METHOD
/begin COMPU_METHOD md_q1p6 "" RAT_FUNC "%6.2" "Nm" COEFFS 0 10 0 0 0 16 /end COMPU_METHOD
/begin COMPU_METHOD Mo_trq_nm_q0p1 "" RAT_FUNC "%6.3" "Nm" COEFFS 0 10 0 0 0 1 /end COMPU_METHOD
/begin COMPU_METHOD m_ub_b1020 "" RAT_FUNC "%6.2" "kg/h" COEFFS 0 1 0 0 0 4 /end COMPU_METHOD
/begin COMPU_METHOD nmot_q40 "" RAT_FUNC "%6.1" "1/min" COEFFS 0 1 0 0 0 40 /end COMPU_METHOD
/begin COMPU_METHOD OneToOne "" RAT_FUNC "%6.2" "-" COEFFS 0 1 0 0 0 1 /end COMPU_METHOD
/begin COMPU_METHOD q1p5625Em5_kg_DIV_h_min_pc "" RAT_FUNC "%7.6" "(kg/h)/(1/min*%)" COEFFS 0 64000 0 0 0 1 /end COMPU_METHOD
/begin COMPU_METHOD relPED_q0p02441 "" RAT_FUNC "%6.4" "% PED" COEFFS 0 4096 0 0 0 100 /end COMPU_METHOD
/begin COMPU_METHOD rel_q0p39 "" RAT_FUNC "%6.3" "%" COEFFS 0 256 0 0 0 100 /end COMPU_METHOD
/begin COMPU_METHOD rel_sw_b1536 "" RAT_FUNC "%6.4" "%" COEFFS 0 65536 0 0 0 3072 /end COMPU_METHOD
/begin COMPU_METHOD rel_ub_q0p75 "" RAT_FUNC "%6.3" "%" COEFFS 0 1 0 0 0 0.75 /end COMPU_METHOD
/begin COMPU_METHOD rel_uw_b100 "" RAT_FUNC "%6.4" "%" COEFFS 0 65536 0 0 0 100 /end COMPU_METHOD
/begin COMPU_METHOD rel_uw_b3072 "" RAT_FUNC "%6.4" "%" COEFFS 0 65536 0 0 0 3072 /end COMPU_METHOD
/begin COMPU_METHOD rel_uw_q0p0234 "" RAT_FUNC "%6.4" "%" COEFFS 0 32 0 0 0 0.75 /end COMPU_METHOD
/begin COMPU_METHOD spg_q0p00488 "" RAT_FUNC "%6.4" "V" COEFFS 0 1024 0 0 0 5 /end COMPU_METHOD
/begin COMPU_METHOD SY_DSLSLS_Compu "" TAB_VERB "%6.3" "" COMPU_TAB_REF SY_DSLSLS_Compu /end COMPU_METHOD
/begin COMPU_VTAB SY_DSLSLS_Compu "" TAB_VERB 2 0 "DSLSLS_NO" 1 "DSLSLS_POSSIBLE" /end COMPU_VTAB
/begin COMPU_METHOD SY_DSLSPS_Compu "" TAB_VERB "%6.3" "" COMPU_TAB_REF SY_DSLSPS_Compu /end COMPU_METHOD
/begin COMPU_VTAB SY_DSLSPS_Compu "" TAB_VERB 2 0 "DSLSPS_NO" 1 "DSLSPS_POSSIBLE" /end COMPU_VTAB
/begin COMPU_METHOD SY_DSLS_Compu "" TAB_VERB "%6.3" "" COMPU_TAB_REF SY_DSLS_Compu /end COMPU_METHOD
/begin COMPU_VTAB SY_DSLS_Compu "" TAB_VERB 5 0 "keine Sekundärluftdiagnose" 1 "Sekundärluftdiagnose basierend auf Lambdasonde" 2 "Sekundärluftdiagose mittels eines separaten SL_HFM" 3 "Sekundärluftdiagnose basierend auf Sensorik zur FE" 4 "Sekundärluftdiagnose mit Drucksensor" /end COMPU_VTAB
/begin COMPU_METHOD SY_DSMSUS_Compu "" TAB_VERB "%6.3" "" COMPU_TAB_REF SY_DSMSUS_Compu /end COMPU_METHOD
/begin COMPU_VTAB SY_DSMSUS_Compu "" TAB_VERB 2 0 "False" 1 "True" /end COMPU_VTAB
/begin COMPU_METHOD SY_DSM_Compu "" TAB_VERB "%6.3" "" COMPU_TAB_REF SY_DSM_Compu /end COMPU_METHOD
/begin COMPU_VTAB SY_DSM_Compu "" TAB_VERB 2 0 "kein DSM vorhanden" 1 "DSM vorhanden" /end COMPU_VTAB
/begin COMPU_METHOD SY_DSNDK_Compu "" TAB_VERB "%6.3" "" COMPU_TAB_REF SY_DSNDK_Compu /end COMPU_METHOD
/begin COMPU_VTAB SY_DSNDK_Compu "" TAB_VERB 2 0 "no pressure sensor downstream throttle valve insta" 1 "pressure sensor downstream throttle valve installe" /end COMPU_VTAB
/begin COMPU_METHOD SY_DSPACE_Compu "" TAB_VERB "%6.3" "" COMPU_TAB_REF SY_DSPACE_Compu /end COMPU_METHOD
/begin COMPU_VTAB SY_DSPACE_Compu "" TAB_VERB 2 0 "False" 1 "True" /end COMPU_VTAB
/begin COMPU_METHOD SY_DSS2_Compu "" TAB_VERB "%6.3" "" COMPU_TAB_REF SY_DSS2_Compu /end COMPU_METHOD
/begin COMPU_VTAB SY_DSS2_Compu "" TAB_VERB 2 0 "kein zweiter Drucksensor im Saugrohr verbaut" 1 "zweiter Drucksensor im Saugrohr verbaut" /end COMPU_VTAB
/begin COMPU_METHOD SY_DSS_Compu "" TAB_VERB "%6.3" "" COMPU_TAB_REF SY_DSS_Compu /end COMPU_METHOD
/begin COMPU_VTAB SY_DSS_Compu "" TAB_VERB 2 0 "kein Drucksensor im Saugrohr verbaut" 1 "Drucksensor im Saugrohr verbaut" /end COMPU_VTAB
/begin COMPU_METHOD SY_DSU_Compu "" TAB_VERB "%6.3" "" COMPU_TAB_REF SY_DSU_Compu /end COMPU_METHOD
/begin COMPU_VTAB SY_DSU_Compu "" TAB_VERB 2 0 "kein Umgebungsdrucksensor verbaut" 1 "Umgebungsdrucksensor verbaut" /end COMPU_VTAB
/begin COMPU_METHOD SY_DSV2V_Compu "" TAB_VERB "%6.3" "" COMPU_TAB_REF SY_DSV2V_Compu /end COMPU_METHOD
/begin COMPU_VTAB SY_DSV2V_Compu "" TAB_VERB 2 0 "kein Drucksensor vor zweitem Verdichter vorhanden" 1 "Drucksensor vor zweitem Verdichter vorhanden" /end COMPU_VTAB
/begin COMPU_METHOD SY_DSVDK2_Compu "" TAB_VERB "%6.3" "" COMPU_TAB_REF SY_DSVDK2_Compu /end COMPU_METHOD
/begin COMPU_VTAB SY_DSVDK2_Compu "" TAB_VERB 2 0 "kein zweiter Drucksensor vor Drosselklappe verbaut" 1 "zweiter Drucksensor vor Drosselklappe verbaut" /end COMPU_VTAB
/begin COMPU_METHOD SY_DSVDK_Compu "" TAB_VERB "%6.3" "" COMPU_TAB_REF SY_DSVDK_Compu /end COMPU_METHOD
/begin COMPU_VTAB SY_DSVDK_Compu "" TAB_VERB 2 0 "FALSE" 1 "TRUE" /end COMPU_VTAB
/begin COMPU_METHOD SY_DSVV_Compu "" TAB_VERB "%6.3" "" COMPU_TAB_REF SY_DSVV_Compu /end COMPU_METHOD
/begin COMPU_VTAB SY_DSVV_Compu "" TAB_VERB 2 0 "kein Drucksensor vor Verdichter vorhanden" 1 "Drucksensor vor Verdichter vorhanden" /end COMPU_VTAB
/begin COMPU_METHOD SY_DTANKL_Compu "" TAB_VERB "%6.3" "" COMPU_TAB_REF SY_DTANKL_Compu /end COMPU_METHOD
/begin COMPU_VTAB SY_DTANKL_Compu "" TAB_VERB 2 0 "FALSE" 1 "TRUE" /end COMPU_VTAB
/begin COMPU_METHOD SY_DTCWCS_Compu "" TAB_VERB "%6.3" "" COMPU_TAB_REF SY_DTCWCS_Compu /end COMPU_METHOD
/begin COMPU_VTAB SY_DTCWCS_Compu "" TAB_VERB 3 0 "DISABL" 1 "NO_TABST_COUNT" 2 "TABST_COUNT" /end COMPU_VTAB
/begin COMPU_METHOD SY_DTCWHSC_Compu "" TAB_VERB "%6.3" "" COMPU_TAB_REF SY_DTCWHSC_Compu /end COMPU_METHOD
/begin COMPU_VTAB SY_DTCWHSC_Compu "" TAB_VERB 2 0 "False" 1 "True" /end COMPU_VTAB
/begin COMPU_METHOD SY_DTHM_Compu "" TAB_VERB "%6.3" "" COMPU_TAB_REF SY_DTHM_Compu /end COMPU_METHOD
/begin COMPU_VTAB SY_DTHM_Compu "" TAB_VERB 2 0 "False" 1 "True" /end COMPU_VTAB
/begin COMPU_METHOD SY_DVEADA_Compu "" TAB_VERB "%6.3" "" COMPU_TAB_REF SY_DVEADA_Compu /end COMPU_METHOD
/begin COMPU_VTAB SY_DVEADA_Compu "" TAB_VERB 2 0 "kein Sperren der Einspritzung durch DVE Adaptio er" 1 "Sperren der Einspritzung durch DVE Adaptio erlaubt" /end COMPU_VTAB
/begin COMPU_METHOD SY_DVEAMP_Compu "" TAB_VERB "%6.3" "" COMPU_TAB_REF SY_DVEAMP_Compu /end COMPU_METHOD
/begin COMPU_VTAB SY_DVEAMP_Compu "" TAB_VERB 2 0 "= kein Verstärker vorhanden" 1 "= Verstärker vorhanden" /end COMPU_VTAB
/begin COMPU_METHOD SY_DVEANZ_Compu "" RAT_FUNC "%6.2" "" COEFFS 0 1 0 0 0 1 /end COMPU_METHOD
/begin COMPU_METHOD SY_DVEFO_Compu "" TAB_VERB "%6.3" "" COMPU_TAB_REF SY_DVEFO_Compu /end COMPU_METHOD
/begin COMPU_VTAB SY_DVEFO_Compu "" TAB_VERB 2 0 "0 = DVE öffnede Federprüfung nicht vorhanden" 1 "1 = DVE öffnede Federprüfung kann eingeschaltet we" /end COMPU_VTAB
/begin COMPU_METHOD SY_DVEKOMP_Compu "" TAB_VERB "%6.3" "" COMPU_TAB_REF SY_DVEKOMP_Compu /end COMPU_METHOD
/begin COMPU_VTAB SY_DVEKOMP_Compu "" TAB_VERB 4 1 "Limp home position in control range (DV-E5)" 2 "Limp home position out of ctrl range (DV-E8.1nc)" 3 "Limp home position out of control range (DV-E8.1c)" 4 "Like 1, but programmed sensor" /end COMPU_VTAB
/begin COMPU_METHOD SY_DVEKOOR_Compu "" TAB_VERB "%6.3" "" COMPU_TAB_REF SY_DVEKOOR_Compu /end COMPU_METHOD
/begin COMPU_VTAB SY_DVEKOOR_Compu "" TAB_VERB 2 0 "kein eigenes DVE-Koordinatensystem" 1 "eigenes DVE-Koordinatensystem" /end COMPU_VTAB
/begin COMPU_METHOD SY_DYCOP_Compu "" TAB_VERB "%6.3" "" COMPU_TAB_REF SY_DYCOP_Compu /end COMPU_METHOD
/begin COMPU_VTAB SY_DYCOP_Compu "" TAB_VERB 2 0 "disabled" 1 "enabled" /end COMPU_VTAB
/begin COMPU_METHOD SY_DYLSEVAL_Compu "" TAB_VERB "%6.3" "" COMPU_TAB_REF SY_DYLSEVAL_Compu /end COMPU_METHOD
/begin COMPU_VTAB SY_DYLSEVAL_Compu "" TAB_VERB 2 0 "False" 1 "True" /end COMPU_VTAB
/begin COMPU_METHOD SY_DYLSF_Compu "" TAB_VERB "%6.3" "" COMPU_TAB_REF SY_DYLSF_Compu /end COMPU_METHOD
/begin COMPU_VTAB SY_DYLSF_Compu "" TAB_VERB 2 0 "False" 1 "True" /end COMPU_VTAB
/begin COMPU_METHOD SY_DYLSH_Compu "" TAB_VERB "%6.3" "" COMPU_TAB_REF SY_DYLSH_Compu /end COMPU_METHOD
/begin COMPU_VTAB SY_DYLSH_Compu "" TAB_VERB 2 0 "False" 1 "True" /end COMPU_VTAB
/begin COMPU_METHOD SY_DZWB2_Compu "" TAB_VERB "%6.3" "" COMPU_TAB_REF SY_DZWB2_Compu /end COMPU_METHOD
/begin COMPU_VTAB SY_DZWB2_Compu "" TAB_VERB 3 0 "no" 1 "earliest possible" 2 "output" /end COMPU_VTAB
/begin COMPU_METHOD SY_DZWKS_Compu "" TAB_VERB "%6.3" "" COMPU_TAB_REF SY_DZWKS_Compu /end COMPU_METHOD
/begin COMPU_VTAB SY_DZWKS_Compu "" TAB_VERB 2 0 "false" 1 "true" /end COMPU_VTAB
/begin COMPU_METHOD SY_EAOMSDK_Compu "" TAB_VERB "%6.3" "" COMPU_TAB_REF SY_EAOMSDK_Compu /end COMPU_METHOD
/begin COMPU_VTAB SY_EAOMSDK_Compu "" TAB_VERB 2 0 "first adaptation disabled" 1 "first adaptation enabled" /end COMPU_VTAB
/begin COMPU_METHOD SY_EBFMOD_Compu "" TAB_VERB "%6.3" "" COMPU_TAB_REF SY_EBFMOD_Compu /end COMPU_METHOD
/begin COMPU_VTAB SY_EBFMOD_Compu "" TAB_VERB 4 0 "Kein Erstbefüllungsmodus des Kraftstoffsystems" 1 "Erstbefüllung ohne Berücksichtigung Urstartsperre" 2 "Erstbefüllung mit Berücksichtigung Urstartsperre" 3 "Automatische Erstbefüllung" /end COMPU_VTAB
/begin COMPU_METHOD SY_ECTPS1_Compu "" TAB_VERB "%6.3" "" COMPU_TAB_REF SY_ECTPS1_Compu /end COMPU_METHOD
/begin COMPU_VTAB SY_ECTPS1_Compu "" TAB_VERB 5 0 "no_sensor" 1 "CEngDsT" 2 "CHdT" 3 "CEngUsT" 4 "CEngBlkT" /end COMPU_VTAB
/begin COMPU_METHOD SY_ECTPS2_Compu "" TAB_VERB "%6.3" "" COMPU_TAB_REF SY_ECTPS2_Compu /end COMPU_METHOD
/begin COMPU_VTAB SY_ECTPS2_Compu "" TAB_VERB 5 0 "no_sensor" 1 "CEngDsT" 2 "CHdT" 3 "CEngUsT" 4 "CEngBlkT" /end COMPU_VTAB
/begin COMPU_METHOD SY_EDMMILA_Compu "" RAT_FUNC "%6.2" "" COEFFS 0 1 0 0 0 1 /end COMPU_METHOD
/begin COMPU_METHOD SY_EGAS_Compu "" TAB_VERB "%6.3" "" COMPU_TAB_REF SY_EGAS_Compu /end COMPU_METHOD
/begin COMPU_VTAB SY_EGAS_Compu "" TAB_VERB 2 0 "kein E-GAS System" 1 "E-GAS System" /end COMPU_VTAB
/begin COMPU_METHOD SY_EKPRMK_Compu "" TAB_VERB "%6.3" "" COMPU_TAB_REF SY_EKPRMK_Compu /end COMPU_METHOD
/begin COMPU_VTAB SY_EKPRMK_Compu "" TAB_VERB 2 0 "keine anderen mitversorgten Komponenten oder ME9" 1 "nur ME7: mit anderen mitversorgten Komponenten" /end COMPU_VTAB
/begin COMPU_METHOD SY_EOLT_Compu "" TAB_VERB "%6.3" "" COMPU_TAB_REF SY_EOLT_Compu /end COMPU_METHOD
/begin COMPU_VTAB SY_EOLT_Compu "" TAB_VERB 2 0 "keine Klopfsensordiagnose am Bandende" 1 "Klopfsensordiagnose am Bandende" /end COMPU_VTAB
/begin COMPU_METHOD SY_ESNSNA_Compu "" TAB_VERB "%6.3" "" COMPU_TAB_REF SY_ESNSNA_Compu /end COMPU_METHOD
/begin COMPU_VTAB SY_ESNSNA_Compu "" TAB_VERB 2 0 "False" 1 "True" /end COMPU_VTAB
/begin COMPU_METHOD SY_ESNWS_Compu "" TAB_VERB "%6.3" "" COMPU_TAB_REF SY_ESNWS_Compu /end COMPU_METHOD
/begin COMPU_VTAB SY_ESNWS_Compu "" TAB_VERB 2 0 "False" 1 "True" /end COMPU_VTAB
/begin COMPU_METHOD temp_ub_q0p75_o48 "" RAT_FUNC "%6.2" "Grad C" COEFFS 0 1 48 0 0 0.75 /end COMPU_METHOD
/begin COMPU_METHOD TransR "" RAT_FUNC "%6.4" "-" COEFFS 0 100 0 0 0 1 /end COMPU_METHOD
/begin COMPU_METHOD Trq "" RAT_FUNC "%6.3" "Nm" COEFFS 0 10 0 0 0 1 /end COMPU_METHOD
/begin COMPU_METHOD vfzg_q0p01 "" RAT_FUNC "%6.4" "km/h" COEFFS 0 1 0 0 0 0.01 /end COMPU_METHOD
/begin COMPU_METHOD zk10msxs_uw_b655p36PT1 "" RAT_FUNC "%6.2" "s" COEFFS 0 0 65536 0 100 1 /end COMPU_METHOD
/begin COMPU_METHOD zw_q0p1 "" RAT_FUNC "%6.3" "Grad KW" COEFFS 0 10 0 0 0 1 /end COMPU_METHOD
/begin COMPU_METHOD zw_sb_q0p75 "" RAT_FUNC "%6.3" "Grad KW" COEFFS 0 255 0 0 0 191.25 /end COMPU_METHOD
/begin RECORD_LAYOUT Axis_Xu16 NO_AXIS_PTS_X 1 UWORD AXIS_PTS_X 2 UWORD INDEX_INCR DIRECT /end RECORD_LAYOUT
/begin RECORD_LAYOUT Axis_Xu8 NO_AXIS_PTS_X 1 UBYTE AXIS_PTS_X 2 UBYTE INDEX_INCR DIRECT /end RECORD_LAYOUT
/begin RECORD_LAYOUT Mo_DataCurveSstS16WS16 NO_AXIS_PTS_X 1 SWORD AXIS_PTS_X 2 SWORD INDEX_INCR DIRECT FNC_VALUES 3 SWORD COLUMN_DIR DIRECT /end RECORD_LAYOUT
/begin RECORD_LAYOUT Mo_DataCurveSstU16WU16 NO_AXIS_PTS_X 1 UWORD AXIS_PTS_X 2 UWORD INDEX_INCR DIRECT FNC_VALUES 3 UWORD COLUMN_DIR DIRECT /end RECORD_LAYOUT
/begin RECORD_LAYOUT ValA_Wu16 FNC_VALUES 1 UWORD COLUMN_DIR DIRECT /end RECORD_LAYOUT
/begin RECORD_LAYOUT Val_Ws16 FNC_VALUES 1 SWORD COLUMN_DIR DIRECT /end RECORD_LAYOUT
/begin RECORD_LAYOUT Val_Wu16 FNC_VALUES 1 UWORD COLUMN_DIR DIRECT /end RECORD_LAYOUT
/begin RECORD_LAYOUT Val_Wu8 FNC_VALUES 1 UBYTE COLUMN_DIR DIRECT /end RECORD_LAYOUT
/end MODULE
/end PROJECT
