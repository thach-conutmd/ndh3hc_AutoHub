ASAP2_VERSION 1 60
/begin PROJECT MG1CA020 "MG1CA020"
/begin HEADER "" VERSION "MG1CA020_6SAY_V011_TPROT" PROJECT_NO MG1CA020 /end HEADER
/begin MODULE DIM ""
/begin MOD_COMMON "" BYTE_ORDER MSB_LAST ALIGNMENT_BYTE 1 ALIGNMENT_WORD 2 ALIGNMENT_LONG 4 ALIGNMENT_INT64 4 ALIGNMENT_FLOAT32_IEEE 4 ALIGNMENT_FLOAT64_IEEE 4 DATA_SIZE 32 /end MOD_COMMON
/begin CHARACTERISTIC DINH_FId.DFC_ComVehSpdPndFltTCU_CA "inhibitable FIds / FIds to be inhibited by inhibit source DFC_ComVehSpdPndFltTCU" VAL_BLK 0x804DE26A ValA_Wu16 732.000000000 DINH_FIdVerb 0.00 732.000000000 FORMAT "%13.9" NUMBER 2 /end CHARACTERISTIC
/begin CHARACTERISTIC DINH_FId.DFC_EbsChartcCurrErr_CA "inhibitable FIds / FIds to be inhibited by inhibit source DFC_EbsChartcCurrErr" VAL_BLK 0x804DE26E ValA_Wu16 732.000000000 DINH_FIdVerb 0.00 732.000000000 FORMAT "%13.9" NUMBER 61 /end CHARACTERISTIC
/begin CHARACTERISTIC DINH_FId.DFC_EbsSelfDiagErr_CA "inhibitable FIds / FIds to be inhibited by inhibit source DFC_EbsSelfDiagErr" VAL_BLK 0x804DE2E8 ValA_Wu16 732.000000000 DINH_FIdVerb 0.00 732.000000000 FORMAT "%13.9" NUMBER 61 /end CHARACTERISTIC
/begin CHARACTERISTIC DINH_FId.DFC_GbxCANDigPlausErr_CA "inhibitable FIds / FIds to be inhibited by inhibit source DFC_GbxCANDigPlausErr" VAL_BLK 0x804DE362 ValA_Wu16 732.000000000 DINH_FIdVerb 0.00 732.000000000 FORMAT "%13.9" NUMBER 52 /end CHARACTERISTIC
/begin CHARACTERISTIC DINH_FId.DFC_GbxNPos1SRCMax_CA "inhibitable FIds / FIds to be inhibited by inhibit source DFC_GbxNPos1SRCMax" VAL_BLK 0x804DE3CA ValA_Wu16 732.000000000 DINH_FIdVerb 0.00 732.000000000 FORMAT "%13.9" NUMBER 59 /end CHARACTERISTIC
/begin CHARACTERISTIC DINH_FId.DFC_GbxNPos1SRCMin_CA "inhibitable FIds / FIds to be inhibited by inhibit source DFC_GbxNPos1SRCMin" VAL_BLK 0x804DE440 ValA_Wu16 732.000000000 DINH_FIdVerb 0.00 732.000000000 FORMAT "%13.9" NUMBER 59 /end CHARACTERISTIC
/begin CHARACTERISTIC DINH_FId.DFC_GbxNPos2SRCMax_CA "inhibitable FIds / FIds to be inhibited by inhibit source DFC_GbxNPos2SRCMax" VAL_BLK 0x804DE4B6 ValA_Wu16 732.000000000 DINH_FIdVerb 0.00 732.000000000 FORMAT "%13.9" NUMBER 59 /end CHARACTERISTIC
/begin CHARACTERISTIC DINH_FId.DFC_GbxNPos2SRCMin_CA "inhibitable FIds / FIds to be inhibited by inhibit source DFC_GbxNPos2SRCMin" VAL_BLK 0x804DE52C ValA_Wu16 732.000000000 DINH_FIdVerb 0.00 732.000000000 FORMAT "%13.9" NUMBER 59 /end CHARACTERISTIC
/begin CHARACTERISTIC DINH_FId.DFC_GbxNPosAlvChk_CA "inhibitable FIds / FIds to be inhibited by inhibit source DFC_GbxNPosAlvChk" VAL_BLK 0x804DE5A2 ValA_Wu16 732.000000000 DINH_FIdVerb 0.00 732.000000000 FORMAT "%13.9" NUMBER 50 /end CHARACTERISTIC
/begin CHARACTERISTIC DINH_FId.DFC_GbxNPosSyncErr_CA "inhibitable FIds / FIds to be inhibited by inhibit source DFC_GbxNPosSyncErr" VAL_BLK 0x804DE606 ValA_Wu16 732.000000000 DINH_FIdVerb 0.00 732.000000000 FORMAT "%13.9" NUMBER 57 /end CHARACTERISTIC
/begin CHARACTERISTIC DINH_FId.DFC_HEGOS2B1HtrPsMax_CA "inhibitable FIds / FIds to be inhibited by inhibit source DFC_HEGOS2B1HtrPsMax" VAL_BLK 0x804DE678 ValA_Wu16 732.000000000 DINH_FIdVerb 0.00 732.000000000 FORMAT "%13.9" NUMBER 68 /end CHARACTERISTIC
/begin CHARACTERISTIC DINH_FId.DFC_HEGOS2B1HtrPsMin_CA "inhibitable FIds / FIds to be inhibited by inhibit source DFC_HEGOS2B1HtrPsMin" VAL_BLK 0x804DE700 ValA_Wu16 732.000000000 DINH_FIdVerb 0.00 732.000000000 FORMAT "%13.9" NUMBER 68 /end CHARACTERISTIC
/begin CHARACTERISTIC DINH_FId.DFC_HEGOS2B1HtrPsSig_CA "inhibitable FIds / FIds to be inhibited by inhibit source DFC_HEGOS2B1HtrPsSig" VAL_BLK 0x804DE788 ValA_Wu16 732.000000000 DINH_FIdVerb 0.00 732.000000000 FORMAT "%13.9" NUMBER 68 /end CHARACTERISTIC
/begin CHARACTERISTIC DINH_FId.DFC_LinCSErrACG_CA "inhibitable FIds / FIds to be inhibited by inhibit source DFC_LinCSErrACG" VAL_BLK 0x804DE810 ValA_Wu16 732.000000000 DINH_FIdVerb 0.00 732.000000000 FORMAT "%13.9" NUMBER 63 /end CHARACTERISTIC
/begin CHARACTERISTIC DINH_FId.DFC_LinCSErrEBS_CA "inhibitable FIds / FIds to be inhibited by inhibit source DFC_LinCSErrEBS" VAL_BLK 0x804DE88E ValA_Wu16 732.000000000 DINH_FIdVerb 0.00 732.000000000 FORMAT "%13.9" NUMBER 63 /end CHARACTERISTIC
/begin CHARACTERISTIC DINH_FId.DFC_LinHdrTimeoutErrACG_CA "inhibitable FIds / FIds to be inhibited by inhibit source DFC_LinHdrTimeoutErrACG" VAL_BLK 0x804DE90C ValA_Wu16 732.000000000 DINH_FIdVerb 0.00 732.000000000 FORMAT "%13.9" NUMBER 63 /end CHARACTERISTIC
/begin CHARACTERISTIC DINH_FId.DFC_LinHdrTimeoutErrEBS_CA "inhibitable FIds / FIds to be inhibited by inhibit source DFC_LinHdrTimeoutErrEBS" VAL_BLK 0x804DE98A ValA_Wu16 732.000000000 DINH_FIdVerb 0.00 732.000000000 FORMAT "%13.9" NUMBER 63 /end CHARACTERISTIC
/begin CHARACTERISTIC DINH_FId.DFC_LinMsgTimeoutErrACG_CA "inhibitable FIds / FIds to be inhibited by inhibit source DFC_LinMsgTimeoutErrACG" VAL_BLK 0x804DEA08 ValA_Wu16 732.000000000 DINH_FIdVerb 0.00 732.000000000 FORMAT "%13.9" NUMBER 63 /end CHARACTERISTIC
/begin CHARACTERISTIC DINH_FId.DFC_LinMsgTimeoutErrEBS_CA "inhibitable FIds / FIds to be inhibited by inhibit source DFC_LinMsgTimeoutErrEBS" VAL_BLK 0x804DEA86 ValA_Wu16 732.000000000 DINH_FIdVerb 0.00 732.000000000 FORMAT "%13.9" NUMBER 63 /end CHARACTERISTIC
/begin CHARACTERISTIC DINH_FId.DFC_LinNoStrtComErr_CA "inhibitable FIds / FIds to be inhibited by inhibit source DFC_LinNoStrtComErr" VAL_BLK 0x804DEB04 ValA_Wu16 732.000000000 DINH_FIdVerb 0.00 732.000000000 FORMAT "%13.9" NUMBER 50 /end CHARACTERISTIC
/begin CHARACTERISTIC DINH_FId.DFC_MisfDetVWhlFrntLeOORHi_CA "inhibitable FIds / FIds to be inhibited by inhibit source DFC_MisfDetVWhlFrntLeOORHi" VAL_BLK 0x804DEB68 ValA_Wu16 732.000000000 DINH_FIdVerb 0.00 732.000000000 FORMAT "%13.9" NUMBER 50 /end CHARACTERISTIC
/begin CHARACTERISTIC DINH_FId.DFC_MisfDetVWhlFrntLeRatyHi_CA "inhibitable FIds / FIds to be inhibited by inhibit source DFC_MisfDetVWhlFrntLeRatyHi" VAL_BLK 0x804DEBCC ValA_Wu16 732.000000000 DINH_FIdVerb 0.00 732.000000000 FORMAT "%13.9" NUMBER 50 /end CHARACTERISTIC
/begin CHARACTERISTIC DINH_FId.DFC_MisfDetVWhlFrntLeRatyLo_CA "inhibitable FIds / FIds to be inhibited by inhibit source DFC_MisfDetVWhlFrntLeRatyLo" VAL_BLK 0x804DEC30 ValA_Wu16 732.000000000 DINH_FIdVerb 0.00 732.000000000 FORMAT "%13.9" NUMBER 50 /end CHARACTERISTIC
/begin CHARACTERISTIC DINH_FId.DFC_MisfDetVWhlFrntLeStuck_CA "inhibitable FIds / FIds to be inhibited by inhibit source DFC_MisfDetVWhlFrntLeStuck" VAL_BLK 0x804DEC94 ValA_Wu16 732.000000000 DINH_FIdVerb 0.00 732.000000000 FORMAT "%13.9" NUMBER 50 /end CHARACTERISTIC
/begin CHARACTERISTIC DINH_FId.DFC_MisfDetVWhlFrntRiOORHi_CA "inhibitable FIds / FIds to be inhibited by inhibit source DFC_MisfDetVWhlFrntRiOORHi" VAL_BLK 0x804DECF8 ValA_Wu16 732.000000000 DINH_FIdVerb 0.00 732.000000000 FORMAT "%13.9" NUMBER 50 /end CHARACTERISTIC
/begin CHARACTERISTIC DINH_FId.DFC_MisfDetVWhlFrntRiRatyHi_CA "inhibitable FIds / FIds to be inhibited by inhibit source DFC_MisfDetVWhlFrntRiRatyHi" VAL_BLK 0x804DED5C ValA_Wu16 732.000000000 DINH_FIdVerb 0.00 732.000000000 FORMAT "%13.9" NUMBER 50 /end CHARACTERISTIC
/begin CHARACTERISTIC DINH_FId.DFC_MisfDetVWhlFrntRiRatyLo_CA "inhibitable FIds / FIds to be inhibited by inhibit source DFC_MisfDetVWhlFrntRiRatyLo" VAL_BLK 0x804DEDC0 ValA_Wu16 732.000000000 DINH_FIdVerb 0.00 732.000000000 FORMAT "%13.9" NUMBER 50 /end CHARACTERISTIC
/begin CHARACTERISTIC DINH_FId.DFC_MisfDetVWhlFrntRiStuck_CA "inhibitable FIds / FIds to be inhibited by inhibit source DFC_MisfDetVWhlFrntRiStuck" VAL_BLK 0x804DEE24 ValA_Wu16 732.000000000 DINH_FIdVerb 0.00 732.000000000 FORMAT "%13.9" NUMBER 50 /end CHARACTERISTIC
/begin CHARACTERISTIC DINH_FId.DFC_MisfDetVWhlReLeOORHi_CA "inhibitable FIds / FIds to be inhibited by inhibit source DFC_MisfDetVWhlReLeOORHi" VAL_BLK 0x804DEE88 ValA_Wu16 732.000000000 DINH_FIdVerb 0.00 732.000000000 FORMAT "%13.9" NUMBER 50 /end CHARACTERISTIC
/begin CHARACTERISTIC DINH_FId.DFC_MisfDetVWhlReLeRatyHi_CA "inhibitable FIds / FIds to be inhibited by inhibit source DFC_MisfDetVWhlReLeRatyHi" VAL_BLK 0x804DEEEC ValA_Wu16 732.000000000 DINH_FIdVerb 0.00 732.000000000 FORMAT "%13.9" NUMBER 50 /end CHARACTERISTIC
/begin CHARACTERISTIC DINH_FId.DFC_MisfDetVWhlReLeRatyLo_CA "inhibitable FIds / FIds to be inhibited by inhibit source DFC_MisfDetVWhlReLeRatyLo" VAL_BLK 0x804DEF50 ValA_Wu16 732.000000000 DINH_FIdVerb 0.00 732.000000000 FORMAT "%13.9" NUMBER 50 /end CHARACTERISTIC
/begin CHARACTERISTIC DINH_FId.DFC_MisfDetVWhlReLeStuck_CA "inhibitable FIds / FIds to be inhibited by inhibit source DFC_MisfDetVWhlReLeStuck" VAL_BLK 0x804DEFB4 ValA_Wu16 732.000000000 DINH_FIdVerb 0.00 732.000000000 FORMAT "%13.9" NUMBER 50 /end CHARACTERISTIC
/begin CHARACTERISTIC DINH_FId.DFC_MisfDetVWhlReRiOORHi_CA "inhibitable FIds / FIds to be inhibited by inhibit source DFC_MisfDetVWhlReRiOORHi" VAL_BLK 0x804DF018 ValA_Wu16 732.000000000 DINH_FIdVerb 0.00 732.000000000 FORMAT "%13.9" NUMBER 50 /end CHARACTERISTIC
/begin CHARACTERISTIC DINH_FId.DFC_MisfDetVWhlReRiRatyHi_CA "inhibitable FIds / FIds to be inhibited by inhibit source DFC_MisfDetVWhlReRiRatyHi" VAL_BLK 0x804DF07C ValA_Wu16 732.000000000 DINH_FIdVerb 0.00 732.000000000 FORMAT "%13.9" NUMBER 50 /end CHARACTERISTIC
/begin CHARACTERISTIC DINH_FId.DFC_MisfDetVWhlReRiRatyLo_CA "inhibitable FIds / FIds to be inhibited by inhibit source DFC_MisfDetVWhlReRiRatyLo" VAL_BLK 0x804DF0E0 ValA_Wu16 732.000000000 DINH_FIdVerb 0.00 732.000000000 FORMAT "%13.9" NUMBER 50 /end CHARACTERISTIC
/begin CHARACTERISTIC DINH_FId.DFC_MisfDetVWhlReRiStuck_CA "inhibitable FIds / FIds to be inhibited by inhibit source DFC_MisfDetVWhlReRiStuck" VAL_BLK 0x804DF144 ValA_Wu16 732.000000000 DINH_FIdVerb 0.00 732.000000000 FORMAT "%13.9" NUMBER 50 /end CHARACTERISTIC
/begin CHARACTERISTIC DINH_FId.DFC_MisfDetdVWhlFrntLePlaus_CA "inhibitable FIds / FIds to be inhibited by inhibit source DFC_MisfDetdVWhlFrntLePlaus" VAL_BLK 0x804DF1A8 ValA_Wu16 732.000000000 DINH_FIdVerb 0.00 732.000000000 FORMAT "%13.9" NUMBER 50 /end CHARACTERISTIC
/begin CHARACTERISTIC DINH_FId.DFC_MisfDetdVWhlFrntRiPlaus_CA "inhibitable FIds / FIds to be inhibited by inhibit source DFC_MisfDetdVWhlFrntRiPlaus" VAL_BLK 0x804DF20C ValA_Wu16 732.000000000 DINH_FIdVerb 0.00 732.000000000 FORMAT "%13.9" NUMBER 50 /end CHARACTERISTIC
/begin CHARACTERISTIC DINH_FId.DFC_MisfDetdVWhlReLePlaus_CA "inhibitable FIds / FIds to be inhibited by inhibit source DFC_MisfDetdVWhlReLePlaus" VAL_BLK 0x804DF270 ValA_Wu16 732.000000000 DINH_FIdVerb 0.00 732.000000000 FORMAT "%13.9" NUMBER 50 /end CHARACTERISTIC
/begin CHARACTERISTIC DINH_FId.DFC_MisfDetdVWhlReRiPlaus_CA "inhibitable FIds / FIds to be inhibited by inhibit source DFC_MisfDetdVWhlReRiPlaus" VAL_BLK 0x804DF2D4 ValA_Wu16 732.000000000 DINH_FIdVerb 0.00 732.000000000 FORMAT "%13.9" NUMBER 50 /end CHARACTERISTIC
/begin CHARACTERISTIC DINH_FId.DFC_PEnvSigRngMax_CA "inhibitable FIds / FIds to be inhibited by inhibit source DFC_PEnvSigRngMax" VAL_BLK 0x804DF338 ValA_Wu16 732.000000000 DINH_FIdVerb 0.00 732.000000000 FORMAT "%13.9" NUMBER 75 /end CHARACTERISTIC
/begin CHARACTERISTIC DINH_FId.DFC_PEnvSigRngMin_CA "inhibitable FIds / FIds to be inhibited by inhibit source DFC_PEnvSigRngMin" VAL_BLK 0x804DF3CE ValA_Wu16 732.000000000 DINH_FIdVerb 0.00 732.000000000 FORMAT "%13.9" NUMBER 75 /end CHARACTERISTIC
/begin CHARACTERISTIC DINH_FId.DFC_StmFault_CA "inhibitable FIds / FIds to be inhibited by inhibit source DFC_StmFault" VAL_BLK 0x804DF464 ValA_Wu16 732.000000000 DINH_FIdVerb 0.00 732.000000000 FORMAT "%13.9" NUMBER 53 /end CHARACTERISTIC
/begin CHARACTERISTIC DINH_FId.DFC_StrtCtOffPth_CA "inhibitable FIds / FIds to be inhibited by inhibit source DFC_StrtCtOffPth" VAL_BLK 0x804DF4CE ValA_Wu16 732.000000000 DINH_FIdVerb 0.00 732.000000000 FORMAT "%13.9" NUMBER 58 /end CHARACTERISTIC
/begin CHARACTERISTIC DINH_FId.DFC_StrtCtlErr_CA "inhibitable FIds / FIds to be inhibited by inhibit source DFC_StrtCtlErr" VAL_BLK 0x804DF542 ValA_Wu16 732.000000000 DINH_FIdVerb 0.00 732.000000000 FORMAT "%13.9" NUMBER 51 /end CHARACTERISTIC
/begin CHARACTERISTIC DINH_FId.DFC_StrtFault_CA "inhibitable FIds / FIds to be inhibited by inhibit source DFC_StrtFault" VAL_BLK 0x804DF5A8 ValA_Wu16 732.000000000 DINH_FIdVerb 0.00 732.000000000 FORMAT "%13.9" NUMBER 52 /end CHARACTERISTIC
/begin CHARACTERISTIC DINH_FId.DFC_StrtLckJudg1_CA "inhibitable FIds / FIds to be inhibited by inhibit source DFC_StrtLckJudg1" VAL_BLK 0x804DF610 ValA_Wu16 732.000000000 DINH_FIdVerb 0.00 732.000000000 FORMAT "%13.9" NUMBER 57 /end CHARACTERISTIC
/begin CHARACTERISTIC DINH_FId.DFC_StrtLckJudg2_CA "inhibitable FIds / FIds to be inhibited by inhibit source DFC_StrtLckJudg2" VAL_BLK 0x804DF682 ValA_Wu16 732.000000000 DINH_FIdVerb 0.00 732.000000000 FORMAT "%13.9" NUMBER 57 /end CHARACTERISTIC
/begin CHARACTERISTIC DINH_FId.DFC_StrtOL_CA "inhibitable FIds / FIds to be inhibited by inhibit source DFC_StrtOL" VAL_BLK 0x804DF6F4 ValA_Wu16 732.000000000 DINH_FIdVerb 0.00 732.000000000 FORMAT "%13.9" NUMBER 57 /end CHARACTERISTIC
/begin CHARACTERISTIC DINH_FId.DFC_StrtOL2_CA "inhibitable FIds / FIds to be inhibited by inhibit source DFC_StrtOL2" VAL_BLK 0x804DF766 ValA_Wu16 732.000000000 DINH_FIdVerb 0.00 732.000000000 FORMAT "%13.9" NUMBER 57 /end CHARACTERISTIC
/begin CHARACTERISTIC DINH_FId.DFC_StrtSCB_CA "inhibitable FIds / FIds to be inhibited by inhibit source DFC_StrtSCB" VAL_BLK 0x804DF7D8 ValA_Wu16 732.000000000 DINH_FIdVerb 0.00 732.000000000 FORMAT "%13.9" NUMBER 58 /end CHARACTERISTIC
/begin CHARACTERISTIC DINH_FId.DFC_StrtSCB2_CA "inhibitable FIds / FIds to be inhibited by inhibit source DFC_StrtSCB2" VAL_BLK 0x804DF84C ValA_Wu16 732.000000000 DINH_FIdVerb 0.00 732.000000000 FORMAT "%13.9" NUMBER 58 /end CHARACTERISTIC
/begin CHARACTERISTIC DINH_FId.DFC_StrtSCG_CA "inhibitable FIds / FIds to be inhibited by inhibit source DFC_StrtSCG" VAL_BLK 0x804DF8C0 ValA_Wu16 732.000000000 DINH_FIdVerb 0.00 732.000000000 FORMAT "%13.9" NUMBER 58 /end CHARACTERISTIC
/begin CHARACTERISTIC DINH_FId.DFC_StrtSCG2_CA "inhibitable FIds / FIds to be inhibited by inhibit source DFC_StrtSCG2" VAL_BLK 0x804DF934 ValA_Wu16 732.000000000 DINH_FIdVerb 0.00 732.000000000 FORMAT "%13.9" NUMBER 58 /end CHARACTERISTIC
/begin CHARACTERISTIC DINH_FId.DFC_StrtStkRly1_CA "inhibitable FIds / FIds to be inhibited by inhibit source DFC_StrtStkRly1" VAL_BLK 0x804DF9A8 ValA_Wu16 732.000000000 DINH_FIdVerb 0.00 732.000000000 FORMAT "%13.9" NUMBER 56 /end CHARACTERISTIC
/begin CHARACTERISTIC DINH_FId.DFC_StrtStkRly2_CA "inhibitable FIds / FIds to be inhibited by inhibit source DFC_StrtStkRly2" VAL_BLK 0x804DFA18 ValA_Wu16 732.000000000 DINH_FIdVerb 0.00 732.000000000 FORMAT "%13.9" NUMBER 56 /end CHARACTERISTIC
/begin CHARACTERISTIC DINH_FId.DFC_TEVEmax_CA "inhibitable FIds / FIds to be inhibited by inhibit source DFC_TEVEmax" VAL_BLK 0x804DFA88 ValA_Wu16 732.000000000 DINH_FIdVerb 0.00 732.000000000 FORMAT "%13.9" NUMBER 78 /end CHARACTERISTIC
/begin CHARACTERISTIC DINH_FId.DFC_TEVEmin_CA "inhibitable FIds / FIds to be inhibited by inhibit source DFC_TEVEmin" VAL_BLK 0x804DFB24 ValA_Wu16 732.000000000 DINH_FIdVerb 0.00 732.000000000 FORMAT "%13.9" NUMBER 78 /end CHARACTERISTIC
/begin CHARACTERISTIC DINH_FId.DFC_TEVEsig_CA "inhibitable FIds / FIds to be inhibited by inhibit source DFC_TEVEsig" VAL_BLK 0x804DFBC0 ValA_Wu16 732.000000000 DINH_FIdVerb 0.00 732.000000000 FORMAT "%13.9" NUMBER 78 /end CHARACTERISTIC
/begin CHARACTERISTIC DINH_FId.DFC_VehVAllPlaus_CA "inhibitable FIds / FIds to be inhibited by inhibit source DFC_VehVAllPlaus" VAL_BLK 0x804DFC5C ValA_Wu16 732.000000000 DINH_FIdVerb 0.00 732.000000000 FORMAT "%13.9" NUMBER 62 /end CHARACTERISTIC
/begin CHARACTERISTIC DINH_FId.DFC_VehVNCSnsrElecFailr_CA "inhibitable FIds / FIds to be inhibited by inhibit source DFC_VehVNCSnsrElecFailr" VAL_BLK 0x804DFCD8 ValA_Wu16 732.000000000 DINH_FIdVerb 0.00 732.000000000 FORMAT "%13.9" NUMBER 55 /end CHARACTERISTIC
/begin CHARACTERISTIC DINH_FId.DFC_VehVPlausCan_CA "inhibitable FIds / FIds to be inhibited by inhibit source DFC_VehVPlausCan" VAL_BLK 0x804DFD46 ValA_Wu16 732.000000000 DINH_FIdVerb 0.00 732.000000000 FORMAT "%13.9" NUMBER 79 /end CHARACTERISTIC
/begin CHARACTERISTIC DINH_FId.DFC_VehVPlausFco_CA "inhibitable FIds / FIds to be inhibited by inhibit source DFC_VehVPlausFco" VAL_BLK 0x804DFDE4 ValA_Wu16 732.000000000 DINH_FIdVerb 0.00 732.000000000 FORMAT "%13.9" NUMBER 84 /end CHARACTERISTIC
/begin CHARACTERISTIC DINH_FId.DFC_VehVPlausPwr_CA "inhibitable FIds / FIds to be inhibited by inhibit source DFC_VehVPlausPwr" VAL_BLK 0x804DFE8C ValA_Wu16 732.000000000 DINH_FIdVerb 0.00 732.000000000 FORMAT "%13.9" NUMBER 71 /end CHARACTERISTIC
/begin CHARACTERISTIC DINH_FId.DFC_VehVPlausV2N_CA "inhibitable FIds / FIds to be inhibited by inhibit source DFC_VehVPlausV2N" VAL_BLK 0x804DFF1A ValA_Wu16 732.000000000 DINH_FIdVerb 0.00 732.000000000 FORMAT "%13.9" NUMBER 71 /end CHARACTERISTIC
/begin CHARACTERISTIC DINH_FId.DFC_VehVSpdSnsrAElecFailr_CA "inhibitable FIds / FIds to be inhibited by inhibit source DFC_VehVSpdSnsrAElecFailr" VAL_BLK 0x804DFFA8 ValA_Wu16 732.000000000 DINH_FIdVerb 0.00 732.000000000 FORMAT "%13.9" NUMBER 54 /end CHARACTERISTIC
/begin CHARACTERISTIC DINH_FId.DFC_VehVSpdSnsrBElecFailr_CA "inhibitable FIds / FIds to be inhibited by inhibit source DFC_VehVSpdSnsrBElecFailr" VAL_BLK 0x804E0014 ValA_Wu16 732.000000000 DINH_FIdVerb 0.00 732.000000000 FORMAT "%13.9" NUMBER 54 /end CHARACTERISTIC
/begin CHARACTERISTIC DINH_FId.DFC_ClthMax_CA "inhibitable FIds / FIds to be inhibited by inhibit source DFC_ClthMax" VAL_BLK 0x804E0080 ValA_Wu16 732.000000000 DINH_FIdVerb 0.00 732.000000000 FORMAT "%13.9" NUMBER 65 /end CHARACTERISTIC
/begin CHARACTERISTIC DINH_FId.DFC_IgnClPs_DevComErr_CA "inhibitable FIds / FIds to be inhibited by inhibit source DFC_IgnClPs_DevComErr" VAL_BLK 0x804E0102 ValA_Wu16 732.000000000 DINH_FIdVerb 0.00 732.000000000 FORMAT "%13.9" NUMBER 51 /end CHARACTERISTIC
/begin CHARACTERISTIC DINH_FId.DFC_IgnClPs_LineOl_0_CA "inhibitable FIds / FIds to be inhibited by inhibit source DFC_IgnClPs_LineOl_0" VAL_BLK 0x804E0168 ValA_Wu16 732.000000000 DINH_FIdVerb 0.00 732.000000000 FORMAT "%13.9" NUMBER 55 /end CHARACTERISTIC
/begin CHARACTERISTIC DINH_FId.DFC_IgnClPs_LineOl_1_CA "inhibitable FIds / FIds to be inhibited by inhibit source DFC_IgnClPs_LineOl_1" VAL_BLK 0x804E01D6 ValA_Wu16 732.000000000 DINH_FIdVerb 0.00 732.000000000 FORMAT "%13.9" NUMBER 55 /end CHARACTERISTIC
/begin CHARACTERISTIC DINH_FId.DFC_IgnClPs_LineOl_2_CA "inhibitable FIds / FIds to be inhibited by inhibit source DFC_IgnClPs_LineOl_2" VAL_BLK 0x804E0244 ValA_Wu16 732.000000000 DINH_FIdVerb 0.00 732.000000000 FORMAT "%13.9" NUMBER 55 /end CHARACTERISTIC
/begin CHARACTERISTIC DINH_FId.DFC_IgnClPs_LineOl_3_CA "inhibitable FIds / FIds to be inhibited by inhibit source DFC_IgnClPs_LineOl_3" VAL_BLK 0x804E02B2 ValA_Wu16 732.000000000 DINH_FIdVerb 0.00 732.000000000 FORMAT "%13.9" NUMBER 55 /end CHARACTERISTIC
/begin CHARACTERISTIC DINH_FId.DFC_IgnClPs_LineScb_0_CA "inhibitable FIds / FIds to be inhibited by inhibit source DFC_IgnClPs_LineScb_0" VAL_BLK 0x804E0320 ValA_Wu16 732.000000000 DINH_FIdVerb 0.00 732.000000000 FORMAT "%13.9" NUMBER 55 /end CHARACTERISTIC
/begin CHARACTERISTIC DINH_FId.DFC_IgnClPs_LineScb_1_CA "inhibitable FIds / FIds to be inhibited by inhibit source DFC_IgnClPs_LineScb_1" VAL_BLK 0x804E038E ValA_Wu16 732.000000000 DINH_FIdVerb 0.00 732.000000000 FORMAT "%13.9" NUMBER 55 /end CHARACTERISTIC
/begin CHARACTERISTIC DINH_FId.DFC_IgnClPs_LineScb_2_CA "inhibitable FIds / FIds to be inhibited by inhibit source DFC_IgnClPs_LineScb_2" VAL_BLK 0x804E03FC ValA_Wu16 732.000000000 DINH_FIdVerb 0.00 732.000000000 FORMAT "%13.9" NUMBER 55 /end CHARACTERISTIC
/begin CHARACTERISTIC DINH_FId.DFC_IgnClPs_LineScb_3_CA "inhibitable FIds / FIds to be inhibited by inhibit source DFC_IgnClPs_LineScb_3" VAL_BLK 0x804E046A ValA_Wu16 732.000000000 DINH_FIdVerb 0.00 732.000000000 FORMAT "%13.9" NUMBER 55 /end CHARACTERISTIC
/begin CHARACTERISTIC DINH_FId.DFC_IgnClPs_LineScg_0_CA "inhibitable FIds / FIds to be inhibited by inhibit source DFC_IgnClPs_LineScg_0" VAL_BLK 0x804E04D8 ValA_Wu16 732.000000000 DINH_FIdVerb 0.00 732.000000000 FORMAT "%13.9" NUMBER 55 /end CHARACTERISTIC
/begin CHARACTERISTIC DINH_FId.DFC_IgnClPs_LineScg_1_CA "inhibitable FIds / FIds to be inhibited by inhibit source DFC_IgnClPs_LineScg_1" VAL_BLK 0x804E0546 ValA_Wu16 732.000000000 DINH_FIdVerb 0.00 732.000000000 FORMAT "%13.9" NUMBER 55 /end CHARACTERISTIC
/begin CHARACTERISTIC DINH_FId.DFC_IgnClPs_LineScg_2_CA "inhibitable FIds / FIds to be inhibited by inhibit source DFC_IgnClPs_LineScg_2" VAL_BLK 0x804E05B4 ValA_Wu16 732.000000000 DINH_FIdVerb 0.00 732.000000000 FORMAT "%13.9" NUMBER 55 /end CHARACTERISTIC
/begin CHARACTERISTIC DINH_FId.DFC_IgnClPs_LineScg_3_CA "inhibitable FIds / FIds to be inhibited by inhibit source DFC_IgnClPs_LineScg_3" VAL_BLK 0x804E0622 ValA_Wu16 732.000000000 DINH_FIdVerb 0.00 732.000000000 FORMAT "%13.9" NUMBER 55 /end CHARACTERISTIC
/begin CHARACTERISTIC DINH_FId.DFC_UEGOASICS1B1_CA "inhibitable FIds / FIds to be inhibited by inhibit source DFC_UEGOASICS1B1" VAL_BLK 0x804E0690 ValA_Wu16 732.000000000 DINH_FIdVerb 0.00 732.000000000 FORMAT "%13.9" NUMBER 76 /end CHARACTERISTIC
/begin CHARACTERISTIC DINH_FId.DFC_UEGOOLIPES1B1_CA "inhibitable FIds / FIds to be inhibited by inhibit source DFC_UEGOOLIPES1B1" VAL_BLK 0x804E0728 ValA_Wu16 732.000000000 DINH_FIdVerb 0.00 732.000000000 FORMAT "%13.9" NUMBER 81 /end CHARACTERISTIC
/begin CHARACTERISTIC DINH_FId.DFC_UEGOOLRES1B1_CA "inhibitable FIds / FIds to be inhibited by inhibit source DFC_UEGOOLRES1B1" VAL_BLK 0x804E07CA ValA_Wu16 732.000000000 DINH_FIdVerb 0.00 732.000000000 FORMAT "%13.9" NUMBER 81 /end CHARACTERISTIC
/begin CHARACTERISTIC DINH_FId.DFC_UEGOSCBS1B1_CA "inhibitable FIds / FIds to be inhibited by inhibit source DFC_UEGOSCBS1B1" VAL_BLK 0x804E086C ValA_Wu16 732.000000000 DINH_FIdVerb 0.00 732.000000000 FORMAT "%13.9" NUMBER 76 /end CHARACTERISTIC
/begin CHARACTERISTIC DINH_FId.DFC_UEGOSCGS1B1_CA "inhibitable FIds / FIds to be inhibited by inhibit source DFC_UEGOSCGS1B1" VAL_BLK 0x804E0904 ValA_Wu16 732.000000000 DINH_FIdVerb 0.00 732.000000000 FORMAT "%13.9" NUMBER 76 /end CHARACTERISTIC
/begin CHARACTERISTIC DINH_FId.DFC_UEGOSPIS1B1_CA "inhibitable FIds / FIds to be inhibited by inhibit source DFC_UEGOSPIS1B1" VAL_BLK 0x804E099C ValA_Wu16 732.000000000 DINH_FIdVerb 0.00 732.000000000 FORMAT "%13.9" NUMBER 76 /end CHARACTERISTIC
/begin CHARACTERISTIC DINH_FId.DFC_UEGOSnsrS1B1_CA "inhibitable FIds / FIds to be inhibited by inhibit source DFC_UEGOSnsrS1B1" VAL_BLK 0x804E0A34 ValA_Wu16 732.000000000 DINH_FIdVerb 0.00 732.000000000 FORMAT "%13.9" NUMBER 70 /end CHARACTERISTIC
/begin CHARACTERISTIC DINH_FId.DFC_UegoOlApesS1B1_CA "inhibitable FIds / FIds to be inhibited by inhibit source DFC_UegoOlApesS1B1" VAL_BLK 0x804E0AC0 ValA_Wu16 732.000000000 DINH_FIdVerb 0.00 732.000000000 FORMAT "%13.9" NUMBER 79 /end CHARACTERISTIC
/begin CHARACTERISTIC DINH_FId.DFC_UegoOlRCmpS1B1_CA "inhibitable FIds / FIds to be inhibited by inhibit source DFC_UegoOlRCmpS1B1" VAL_BLK 0x804E0B5E ValA_Wu16 732.000000000 DINH_FIdVerb 0.00 732.000000000 FORMAT "%13.9" NUMBER 80 /end CHARACTERISTIC
/begin CHARACTERISTIC DINH_FId.DFC_AirCCmprOL_CA "inhibitable FIds / FIds to be inhibited by inhibit source DFC_AirCCmprOL" VAL_BLK 0x804E0BFE ValA_Wu16 732.000000000 DINH_FIdVerb 0.00 732.000000000 FORMAT "%13.9" NUMBER 50 /end CHARACTERISTIC
/begin CHARACTERISTIC DINH_FId.DFC_AirCCmprOvrTemp_CA "inhibitable FIds / FIds to be inhibited by inhibit source DFC_AirCCmprOvrTemp" VAL_BLK 0x804E0C62 ValA_Wu16 732.000000000 DINH_FIdVerb 0.00 732.000000000 FORMAT "%13.9" NUMBER 50 /end CHARACTERISTIC
/begin CHARACTERISTIC DINH_FId.DFC_AirCCmprSCB_CA "inhibitable FIds / FIds to be inhibited by inhibit source DFC_AirCCmprSCB" VAL_BLK 0x804E0CC6 ValA_Wu16 732.000000000 DINH_FIdVerb 0.00 732.000000000 FORMAT "%13.9" NUMBER 50 /end CHARACTERISTIC
/begin CHARACTERISTIC DINH_FId.DFC_AirCCmprSCG_CA "inhibitable FIds / FIds to be inhibited by inhibit source DFC_AirCCmprSCG" VAL_BLK 0x804E0D2A ValA_Wu16 732.000000000 DINH_FIdVerb 0.00 732.000000000 FORMAT "%13.9" NUMBER 50 /end CHARACTERISTIC
/begin CHARACTERISTIC DINH_FId.DFC_AltErr_CA "inhibitable FIds / FIds to be inhibited by inhibit source DFC_AltErr" VAL_BLK 0x804E0D8E ValA_Wu16 732.000000000 DINH_FIdVerb 0.00 732.000000000 FORMAT "%13.9" NUMBER 51 /end CHARACTERISTIC
/begin CHARACTERISTIC DINH_FId.DFC_BattUSRCMax_CA "inhibitable FIds / FIds to be inhibited by inhibit source DFC_BattUSRCMax" VAL_BLK 0x804E0DF4 ValA_Wu16 732.000000000 DINH_FIdVerb 0.00 732.000000000 FORMAT "%13.9" NUMBER 53 /end CHARACTERISTIC
/begin CHARACTERISTIC DINH_FId.DFC_BattUSRCMin_CA "inhibitable FIds / FIds to be inhibited by inhibit source DFC_BattUSRCMin" VAL_BLK 0x804E0E5E ValA_Wu16 732.000000000 DINH_FIdVerb 0.00 732.000000000 FORMAT "%13.9" NUMBER 53 /end CHARACTERISTIC
/begin CHARACTERISTIC DINH_FId.DFC_ComChksTCU1_CA "inhibitable FIds / FIds to be inhibited by inhibit source DFC_ComChksTCU1" VAL_BLK 0x804E0EC8 ValA_Wu16 732.000000000 DINH_FIdVerb 0.00 732.000000000 FORMAT "%13.9" NUMBER 50 /end CHARACTERISTIC
/begin CHARACTERISTIC DINH_FId.DFC_ComChksTCU11_CA "inhibitable FIds / FIds to be inhibited by inhibit source DFC_ComChksTCU11" VAL_BLK 0x804E0F2C ValA_Wu16 732.000000000 DINH_FIdVerb 0.00 732.000000000 FORMAT "%13.9" NUMBER 51 /end CHARACTERISTIC
/begin CHARACTERISTIC DINH_FId.DFC_ComChksTCU12_CA "inhibitable FIds / FIds to be inhibited by inhibit source DFC_ComChksTCU12" VAL_BLK 0x804E0F92 ValA_Wu16 732.000000000 DINH_FIdVerb 0.00 732.000000000 FORMAT "%13.9" NUMBER 52 /end CHARACTERISTIC
/begin CHARACTERISTIC DINH_FId.DFC_ComChksTCU13_CA "inhibitable FIds / FIds to be inhibited by inhibit source DFC_ComChksTCU13" VAL_BLK 0x804E0FFA ValA_Wu16 732.000000000 DINH_FIdVerb 0.00 732.000000000 FORMAT "%13.9" NUMBER 52 /end CHARACTERISTIC
/begin CHARACTERISTIC DINH_FId.DFC_ComChksTCU2_CA "inhibitable FIds / FIds to be inhibited by inhibit source DFC_ComChksTCU2" VAL_BLK 0x804E1062 ValA_Wu16 732.000000000 DINH_FIdVerb 0.00 732.000000000 FORMAT "%13.9" NUMBER 50 /end CHARACTERISTIC
/begin CHARACTERISTIC DINH_FId.DFC_ComChksTCU3_CA "inhibitable FIds / FIds to be inhibited by inhibit source DFC_ComChksTCU3" VAL_BLK 0x804E10C6 ValA_Wu16 732.000000000 DINH_FIdVerb 0.00 732.000000000 FORMAT "%13.9" NUMBER 50 /end CHARACTERISTIC
/begin CHARACTERISTIC DINH_FId.DFC_ComChksTCU4_CA "inhibitable FIds / FIds to be inhibited by inhibit source DFC_ComChksTCU4" VAL_BLK 0x804E112A ValA_Wu16 732.000000000 DINH_FIdVerb 0.00 732.000000000 FORMAT "%13.9" NUMBER 50 /end CHARACTERISTIC
/begin CHARACTERISTIC DINH_FId.DFC_ComCntTCU1_CA "inhibitable FIds / FIds to be inhibited by inhibit source DFC_ComCntTCU1" VAL_BLK 0x804E118E ValA_Wu16 732.000000000 DINH_FIdVerb 0.00 732.000000000 FORMAT "%13.9" NUMBER 50 /end CHARACTERISTIC
/begin CHARACTERISTIC DINH_FId.DFC_ComCntTCU11_CA "inhibitable FIds / FIds to be inhibited by inhibit source DFC_ComCntTCU11" VAL_BLK 0x804E11F2 ValA_Wu16 732.000000000 DINH_FIdVerb 0.00 732.000000000 FORMAT "%13.9" NUMBER 51 /end CHARACTERISTIC
/begin CHARACTERISTIC DINH_FId.DFC_ComCntTCU12_CA "inhibitable FIds / FIds to be inhibited by inhibit source DFC_ComCntTCU12" VAL_BLK 0x804E1258 ValA_Wu16 732.000000000 DINH_FIdVerb 0.00 732.000000000 FORMAT "%13.9" NUMBER 52 /end CHARACTERISTIC
/begin CHARACTERISTIC DINH_FId.DFC_ComCntTCU13_CA "inhibitable FIds / FIds to be inhibited by inhibit source DFC_ComCntTCU13" VAL_BLK 0x804E12C0 ValA_Wu16 732.000000000 DINH_FIdVerb 0.00 732.000000000 FORMAT "%13.9" NUMBER 52 /end CHARACTERISTIC
/begin CHARACTERISTIC DINH_FId.DFC_ComCntTCU2_CA "inhibitable FIds / FIds to be inhibited by inhibit source DFC_ComCntTCU2" VAL_BLK 0x804E1328 ValA_Wu16 732.000000000 DINH_FIdVerb 0.00 732.000000000 FORMAT "%13.9" NUMBER 50 /end CHARACTERISTIC
/begin CHARACTERISTIC DINH_FId.DFC_ComCntTCU3_CA "inhibitable FIds / FIds to be inhibited by inhibit source DFC_ComCntTCU3" VAL_BLK 0x804E138C ValA_Wu16 732.000000000 DINH_FIdVerb 0.00 732.000000000 FORMAT "%13.9" NUMBER 50 /end CHARACTERISTIC
/begin CHARACTERISTIC DINH_FId.DFC_ComCntTCU4_CA "inhibitable FIds / FIds to be inhibited by inhibit source DFC_ComCntTCU4" VAL_BLK 0x804E13F0 ValA_Wu16 732.000000000 DINH_FIdVerb 0.00 732.000000000 FORMAT "%13.9" NUMBER 50 /end CHARACTERISTIC
/begin CHARACTERISTIC DINH_FId.DFC_ComTOutTCU01_CA "inhibitable FIds / FIds to be inhibited by inhibit source DFC_ComTOutTCU01" VAL_BLK 0x804E1454 ValA_Wu16 732.000000000 DINH_FIdVerb 0.00 732.000000000 FORMAT "%13.9" NUMBER 51 /end CHARACTERISTIC
/begin CHARACTERISTIC DINH_FId.DFC_ComTOutTCU02_CA "inhibitable FIds / FIds to be inhibited by inhibit source DFC_ComTOutTCU02" VAL_BLK 0x804E14BA ValA_Wu16 732.000000000 DINH_FIdVerb 0.00 732.000000000 FORMAT "%13.9" NUMBER 51 /end CHARACTERISTIC
/begin CHARACTERISTIC DINH_FId.DFC_ComTOutTCU1_CA "inhibitable FIds / FIds to be inhibited by inhibit source DFC_ComTOutTCU1" VAL_BLK 0x804E1520 ValA_Wu16 732.000000000 DINH_FIdVerb 0.00 732.000000000 FORMAT "%13.9" NUMBER 55 /end CHARACTERISTIC
/begin CHARACTERISTIC DINH_FId.DFC_ComTOutTCU11_CA "inhibitable FIds / FIds to be inhibited by inhibit source DFC_ComTOutTCU11" VAL_BLK 0x804E158E ValA_Wu16 732.000000000 DINH_FIdVerb 0.00 732.000000000 FORMAT "%13.9" NUMBER 54 /end CHARACTERISTIC
/begin CHARACTERISTIC DINH_FId.DFC_ComTOutTCU12_CA "inhibitable FIds / FIds to be inhibited by inhibit source DFC_ComTOutTCU12" VAL_BLK 0x804E15FA ValA_Wu16 732.000000000 DINH_FIdVerb 0.00 732.000000000 FORMAT "%13.9" NUMBER 52 /end CHARACTERISTIC
/begin CHARACTERISTIC DINH_FId.DFC_ComTOutTCU13_CA "inhibitable FIds / FIds to be inhibited by inhibit source DFC_ComTOutTCU13" VAL_BLK 0x804E1662 ValA_Wu16 732.000000000 DINH_FIdVerb 0.00 732.000000000 FORMAT "%13.9" NUMBER 52 /end CHARACTERISTIC
/begin CHARACTERISTIC DINH_FId.DFC_ComTOutTCU14_CA "inhibitable FIds / FIds to be inhibited by inhibit source DFC_ComTOutTCU14" VAL_BLK 0x804E16CA ValA_Wu16 732.000000000 DINH_FIdVerb 0.00 732.000000000 FORMAT "%13.9" NUMBER 51 /end CHARACTERISTIC
/begin CHARACTERISTIC DINH_FId.DFC_ComTOutTCU2_CA "inhibitable FIds / FIds to be inhibited by inhibit source DFC_ComTOutTCU2" VAL_BLK 0x804E1730 ValA_Wu16 732.000000000 DINH_FIdVerb 0.00 732.000000000 FORMAT "%13.9" NUMBER 52 /end CHARACTERISTIC
/begin CHARACTERISTIC DINH_FId.DFC_ComTOutTCU3_CA "inhibitable FIds / FIds to be inhibited by inhibit source DFC_ComTOutTCU3" VAL_BLK 0x804E1798 ValA_Wu16 732.000000000 DINH_FIdVerb 0.00 732.000000000 FORMAT "%13.9" NUMBER 52 /end CHARACTERISTIC
/begin CHARACTERISTIC DINH_FId.DFC_ComTOutTCU4_CA "inhibitable FIds / FIds to be inhibited by inhibit source DFC_ComTOutTCU4" VAL_BLK 0x804E1800 ValA_Wu16 732.000000000 DINH_FIdVerb 0.00 732.000000000 FORMAT "%13.9" NUMBER 51 /end CHARACTERISTIC
/begin CHARACTERISTIC DINH_FId.DFC_DevLibBattUHi_CA "inhibitable FIds / FIds to be inhibited by inhibit source DFC_DevLibBattUHi" VAL_BLK 0x804E1866 ValA_Wu16 732.000000000 DINH_FIdVerb 0.00 732.000000000 FORMAT "%13.9" NUMBER 50 /end CHARACTERISTIC
/begin CHARACTERISTIC DINH_FId.DFC_DevLibBattULo_CA "inhibitable FIds / FIds to be inhibited by inhibit source DFC_DevLibBattULo" VAL_BLK 0x804E18CA ValA_Wu16 732.000000000 DINH_FIdVerb 0.00 732.000000000 FORMAT "%13.9" NUMBER 50 /end CHARACTERISTIC
/begin CHARACTERISTIC DINH_FId.DFC_FanDIOOL_0_CA "inhibitable FIds / FIds to be inhibited by inhibit source DFC_FanDIOOL_0" VAL_BLK 0x804E192E ValA_Wu16 732.000000000 DINH_FIdVerb 0.00 732.000000000 FORMAT "%13.9" NUMBER 51 /end CHARACTERISTIC
/begin CHARACTERISTIC DINH_FId.DFC_FanDIOOL_1_CA "inhibitable FIds / FIds to be inhibited by inhibit source DFC_FanDIOOL_1" VAL_BLK 0x804E1994 ValA_Wu16 732.000000000 DINH_FIdVerb 0.00 732.000000000 FORMAT "%13.9" NUMBER 51 /end CHARACTERISTIC
/begin CHARACTERISTIC DINH_FId.DFC_FanDIOOvrTemp_0_CA "inhibitable FIds / FIds to be inhibited by inhibit source DFC_FanDIOOvrTemp_0" VAL_BLK 0x804E19FA ValA_Wu16 732.000000000 DINH_FIdVerb 0.00 732.000000000 FORMAT "%13.9" NUMBER 50 /end CHARACTERISTIC
/begin CHARACTERISTIC DINH_FId.DFC_FanDIOOvrTemp_1_CA "inhibitable FIds / FIds to be inhibited by inhibit source DFC_FanDIOOvrTemp_1" VAL_BLK 0x804E1A5E ValA_Wu16 732.000000000 DINH_FIdVerb 0.00 732.000000000 FORMAT "%13.9" NUMBER 50 /end CHARACTERISTIC
/begin CHARACTERISTIC DINH_FId.DFC_FanDIOSCB_0_CA "inhibitable FIds / FIds to be inhibited by inhibit source DFC_FanDIOSCB_0" VAL_BLK 0x804E1AC2 ValA_Wu16 732.000000000 DINH_FIdVerb 0.00 732.000000000 FORMAT "%13.9" NUMBER 51 /end CHARACTERISTIC
/begin CHARACTERISTIC DINH_FId.DFC_FanDIOSCB_1_CA "inhibitable FIds / FIds to be inhibited by inhibit source DFC_FanDIOSCB_1" VAL_BLK 0x804E1B28 ValA_Wu16 732.000000000 DINH_FIdVerb 0.00 732.000000000 FORMAT "%13.9" NUMBER 51 /end CHARACTERISTIC
/begin CHARACTERISTIC DINH_FId.DFC_FanDIOSCG_0_CA "inhibitable FIds / FIds to be inhibited by inhibit source DFC_FanDIOSCG_0" VAL_BLK 0x804E1B8E ValA_Wu16 732.000000000 DINH_FIdVerb 0.00 732.000000000 FORMAT "%13.9" NUMBER 51 /end CHARACTERISTIC
/begin CHARACTERISTIC DINH_FId.DFC_FanDIOSCG_1_CA "inhibitable FIds / FIds to be inhibited by inhibit source DFC_FanDIOSCG_1" VAL_BLK 0x804E1BF4 ValA_Wu16 732.000000000 DINH_FIdVerb 0.00 732.000000000 FORMAT "%13.9" NUMBER 51 /end CHARACTERISTIC
/begin CHARACTERISTIC DINH_FId.DFC_MRlyDcOL_CA "inhibitable FIds / FIds to be inhibited by inhibit source DFC_MRlyDcOL" VAL_BLK 0x804E1C5A ValA_Wu16 732.000000000 DINH_FIdVerb 0.00 732.000000000 FORMAT "%13.9" NUMBER 50 /end CHARACTERISTIC
/begin CHARACTERISTIC DINH_FId.DFC_MRlyDcSCB_CA "inhibitable FIds / FIds to be inhibited by inhibit source DFC_MRlyDcSCB" VAL_BLK 0x804E1CBE ValA_Wu16 732.000000000 DINH_FIdVerb 0.00 732.000000000 FORMAT "%13.9" NUMBER 50 /end CHARACTERISTIC
/begin CHARACTERISTIC DINH_FId.DFC_MRlyDcSCG_CA "inhibitable FIds / FIds to be inhibited by inhibit source DFC_MRlyDcSCG" VAL_BLK 0x804E1D22 ValA_Wu16 732.000000000 DINH_FIdVerb 0.00 732.000000000 FORMAT "%13.9" NUMBER 50 /end CHARACTERISTIC
/begin CHARACTERISTIC DINH_FId.DFC_PSPOL_CA "inhibitable FIds / FIds to be inhibited by inhibit source DFC_PSPOL" VAL_BLK 0x804E1D86 ValA_Wu16 732.000000000 DINH_FIdVerb 0.00 732.000000000 FORMAT "%13.9" NUMBER 50 /end CHARACTERISTIC
/begin CHARACTERISTIC DINH_FId.DFC_PSPOvrTemp_CA "inhibitable FIds / FIds to be inhibited by inhibit source DFC_PSPOvrTemp" VAL_BLK 0x804E1DEA ValA_Wu16 732.000000000 DINH_FIdVerb 0.00 732.000000000 FORMAT "%13.9" NUMBER 50 /end CHARACTERISTIC
/begin CHARACTERISTIC DINH_FId.DFC_PSPSCB_CA "inhibitable FIds / FIds to be inhibited by inhibit source DFC_PSPSCB" VAL_BLK 0x804E1E4E ValA_Wu16 732.000000000 DINH_FIdVerb 0.00 732.000000000 FORMAT "%13.9" NUMBER 50 /end CHARACTERISTIC
/begin CHARACTERISTIC DINH_FId.DFC_PSPSCG_CA "inhibitable FIds / FIds to be inhibited by inhibit source DFC_PSPSCG" VAL_BLK 0x804E1EB2 ValA_Wu16 732.000000000 DINH_FIdVerb 0.00 732.000000000 FORMAT "%13.9" NUMBER 50 /end CHARACTERISTIC
/begin CHARACTERISTIC DINH_FId.DFC_T50Err_CA "inhibitable FIds / FIds to be inhibited by inhibit source DFC_T50Err" VAL_BLK 0x804E1F16 ValA_Wu16 732.000000000 DINH_FIdVerb 0.00 732.000000000 FORMAT "%13.9" NUMBER 51 /end CHARACTERISTIC
/begin CHARACTERISTIC DINH_FId.DFC_ThrVlvLoBattB1_CA "inhibitable FIds / FIds to be inhibited by inhibit source DFC_ThrVlvLoBattB1" VAL_BLK 0x804E1F7C ValA_Wu16 732.000000000 DINH_FIdVerb 0.00 732.000000000 FORMAT "%13.9" NUMBER 50 /end CHARACTERISTIC
/begin CHARACTERISTIC DINH_FId.DFC_VehVPhysRngHi_CA "inhibitable FIds / FIds to be inhibited by inhibit source DFC_VehVPhysRngHi" VAL_BLK 0x804E1FE0 ValA_Wu16 732.000000000 DINH_FIdVerb 0.00 732.000000000 FORMAT "%13.9" NUMBER 88 /end CHARACTERISTIC
/begin CHARACTERISTIC DINH_FId.DFC_VehVSclOutOL_CA "inhibitable FIds / FIds to be inhibited by inhibit source DFC_VehVSclOutOL" VAL_BLK 0x804E2090 ValA_Wu16 732.000000000 DINH_FIdVerb 0.00 732.000000000 FORMAT "%13.9" NUMBER 50 /end CHARACTERISTIC
/begin CHARACTERISTIC DINH_FId.DFC_VehVSclOutOT_CA "inhibitable FIds / FIds to be inhibited by inhibit source DFC_VehVSclOutOT" VAL_BLK 0x804E20F4 ValA_Wu16 732.000000000 DINH_FIdVerb 0.00 732.000000000 FORMAT "%13.9" NUMBER 50 /end CHARACTERISTIC
/begin CHARACTERISTIC DINH_FId.DFC_VehVSclOutSCB_CA "inhibitable FIds / FIds to be inhibited by inhibit source DFC_VehVSclOutSCB" VAL_BLK 0x804E2158 ValA_Wu16 732.000000000 DINH_FIdVerb 0.00 732.000000000 FORMAT "%13.9" NUMBER 50 /end CHARACTERISTIC
/begin CHARACTERISTIC DINH_FId.DFC_VehVSclOutSCG_CA "inhibitable FIds / FIds to be inhibited by inhibit source DFC_VehVSclOutSCG" VAL_BLK 0x804E21BC ValA_Wu16 732.000000000 DINH_FIdVerb 0.00 732.000000000 FORMAT "%13.9" NUMBER 50 /end CHARACTERISTIC
/begin CHARACTERISTIC DINH_FId.DFC_VehVSnsrARngHi_CA "inhibitable FIds / FIds to be inhibited by inhibit source DFC_VehVSnsrARngHi" VAL_BLK 0x804E2220 ValA_Wu16 732.000000000 DINH_FIdVerb 0.00 732.000000000 FORMAT "%13.9" NUMBER 50 /end CHARACTERISTIC
/begin CHARACTERISTIC DINH_FId.DFC_VehVSnsrBRngHi_CA "inhibitable FIds / FIds to be inhibited by inhibit source DFC_VehVSnsrBRngHi" VAL_BLK 0x804E2284 ValA_Wu16 732.000000000 DINH_FIdVerb 0.00 732.000000000 FORMAT "%13.9" NUMBER 50 /end CHARACTERISTIC
/begin CHARACTERISTIC DINH_FId.DFC_VehVSpdRtyDiag_CA "inhibitable FIds / FIds to be inhibited by inhibit source DFC_VehVSpdRtyDiag" VAL_BLK 0x804E22E8 ValA_Wu16 732.000000000 DINH_FIdVerb 0.00 732.000000000 FORMAT "%13.9" NUMBER 51 /end CHARACTERISTIC
/begin CHARACTERISTIC DINH_FId.DFC_VehVWhlErr_CA "inhibitable FIds / FIds to be inhibited by inhibit source DFC_VehVWhlErr" VAL_BLK 0x804E234E ValA_Wu16 732.000000000 DINH_FIdVerb 0.00 732.000000000 FORMAT "%13.9" NUMBER 54 /end CHARACTERISTIC
/begin CHARACTERISTIC DINH_FId.DFC_ACEvpTSRCMax_CA "inhibitable FIds / FIds to be inhibited by inhibit source DFC_ACEvpTSRCMax" VAL_BLK 0x804E23BA ValA_Wu16 732.000000000 DINH_FIdVerb 0.00 732.000000000 FORMAT "%13.9" NUMBER 52 /end CHARACTERISTIC
/begin CHARACTERISTIC DINH_FId.DFC_ACEvpTSRCMin_CA "inhibitable FIds / FIds to be inhibited by inhibit source DFC_ACEvpTSRCMin" VAL_BLK 0x804E2422 ValA_Wu16 732.000000000 DINH_FIdVerb 0.00 732.000000000 FORMAT "%13.9" NUMBER 52 /end CHARACTERISTIC
/begin CHARACTERISTIC DINH_FId.DFC_AirCClntPAnaSRCMax_CA "inhibitable FIds / FIds to be inhibited by inhibit source DFC_AirCClntPAnaSRCMax" VAL_BLK 0x804E248A ValA_Wu16 732.000000000 DINH_FIdVerb 0.00 732.000000000 FORMAT "%13.9" NUMBER 56 /end CHARACTERISTIC
/begin CHARACTERISTIC DINH_FId.DFC_AirCClntPAnaSRCMin_CA "inhibitable FIds / FIds to be inhibited by inhibit source DFC_AirCClntPAnaSRCMin" VAL_BLK 0x804E24FA ValA_Wu16 732.000000000 DINH_FIdVerb 0.00 732.000000000 FORMAT "%13.9" NUMBER 56 /end CHARACTERISTIC
/begin CHARACTERISTIC DINH_FId.DFC_AirCSwtNpl_CA "inhibitable FIds / FIds to be inhibited by inhibit source DFC_AirCSwtNpl" VAL_BLK 0x804E256A ValA_Wu16 732.000000000 DINH_FIdVerb 0.00 732.000000000 FORMAT "%13.9" NUMBER 51 /end CHARACTERISTIC
/begin CHARACTERISTIC DINH_FId.DFC_AirCSwtSig_CA "inhibitable FIds / FIds to be inhibited by inhibit source DFC_AirCSwtSig" VAL_BLK 0x804E25D0 ValA_Wu16 732.000000000 DINH_FIdVerb 0.00 732.000000000 FORMAT "%13.9" NUMBER 51 /end CHARACTERISTIC
/begin CHARACTERISTIC DINH_FId.DFC_Brk_CA "inhibitable FIds / FIds to be inhibited by inhibit source DFC_Brk" VAL_BLK 0x804E2636 ValA_Wu16 732.000000000 DINH_FIdVerb 0.00 732.000000000 FORMAT "%13.9" NUMBER 50 /end CHARACTERISTIC
/begin CHARACTERISTIC DINH_FId.DFC_BrkSig_CA "inhibitable FIds / FIds to be inhibited by inhibit source DFC_BrkSig" VAL_BLK 0x804E269A ValA_Wu16 732.000000000 DINH_FIdVerb 0.00 732.000000000 FORMAT "%13.9" NUMBER 54 /end CHARACTERISTIC
/begin CHARACTERISTIC DINH_FId.DFC_ClthSig_CA "inhibitable FIds / FIds to be inhibited by inhibit source DFC_ClthSig" VAL_BLK 0x804E2706 ValA_Wu16 732.000000000 DINH_FIdVerb 0.00 732.000000000 FORMAT "%13.9" NUMBER 63 /end CHARACTERISTIC
/begin CHARACTERISTIC DINH_FId.DFC_HLSDemOvhtEngLim_CA "inhibitable FIds / FIds to be inhibited by inhibit source DFC_HLSDemOvhtEngLim" VAL_BLK 0x804E2784 ValA_Wu16 732.000000000 DINH_FIdVerb 0.00 732.000000000 FORMAT "%13.9" NUMBER 50 /end CHARACTERISTIC
/begin CHARACTERISTIC DINH_FId.DFC_OilPNpl_CA "inhibitable FIds / FIds to be inhibited by inhibit source DFC_OilPNpl" VAL_BLK 0x804E27E8 ValA_Wu16 732.000000000 DINH_FIdVerb 0.00 732.000000000 FORMAT "%13.9" NUMBER 50 /end CHARACTERISTIC
/begin CHARACTERISTIC DINH_FId.DFC_PIntkVUsLineHiB1_CA "inhibitable FIds / FIds to be inhibited by inhibit source DFC_PIntkVUsLineHiB1" VAL_BLK 0x804E284C ValA_Wu16 732.000000000 DINH_FIdVerb 0.00 732.000000000 FORMAT "%13.9" NUMBER 91 /end CHARACTERISTIC
/begin CHARACTERISTIC DINH_FId.DFC_PIntkVUsLineLoB1_CA "inhibitable FIds / FIds to be inhibited by inhibit source DFC_PIntkVUsLineLoB1" VAL_BLK 0x804E2902 ValA_Wu16 732.000000000 DINH_FIdVerb 0.00 732.000000000 FORMAT "%13.9" NUMBER 91 /end CHARACTERISTIC
/begin CHARACTERISTIC DINH_FId.DFC_VehVPhysRngLo_CA "inhibitable FIds / FIds to be inhibited by inhibit source DFC_VehVPhysRngLo" VAL_BLK 0x804E29B8 ValA_Wu16 732.000000000 DINH_FIdVerb 0.00 732.000000000 FORMAT "%13.9" NUMBER 74 /end CHARACTERISTIC
/begin CHARACTERISTIC DINH_FId.DFC_VehVSigCan_CA "inhibitable FIds / FIds to be inhibited by inhibit source DFC_VehVSigCan" VAL_BLK 0x804E2A4C ValA_Wu16 732.000000000 DINH_FIdVerb 0.00 732.000000000 FORMAT "%13.9" NUMBER 53 /end CHARACTERISTIC
/begin CHARACTERISTIC DINH_FId.DFC_VehVSigCanSafe_CA "inhibitable FIds / FIds to be inhibited by inhibit source DFC_VehVSigCanSafe" VAL_BLK 0x804E2AB6 ValA_Wu16 732.000000000 DINH_FIdVerb 0.00 732.000000000 FORMAT "%13.9" NUMBER 57 /end CHARACTERISTIC
/begin CHARACTERISTIC DINH_FId.DFC_VlvLftFbOilPSnsrIntk11SRCMax_CA "inhibitable FIds / FIds to be inhibited by inhibit source DFC_VlvLftFbOilPSnsrIntk11SRCMax" VAL_BLK 0x804E2B28 ValA_Wu16 732.000000000 DINH_FIdVerb 0.00 732.000000000 FORMAT "%13.9" NUMBER 73 /end CHARACTERISTIC
/begin CHARACTERISTIC DINH_FId.DFC_VlvLftFbOilPSnsrIntk11SRCMin_CA "inhibitable FIds / FIds to be inhibited by inhibit source DFC_VlvLftFbOilPSnsrIntk11SRCMin" VAL_BLK 0x804E2BBA ValA_Wu16 732.000000000 DINH_FIdVerb 0.00 732.000000000 FORMAT "%13.9" NUMBER 73 /end CHARACTERISTIC
/begin CHARACTERISTIC DINH_FId.DFC_ClthNpl_CA "inhibitable FIds / FIds to be inhibited by inhibit source DFC_ClthNpl" VAL_BLK 0x804E2C4C ValA_Wu16 732.000000000 DINH_FIdVerb 0.00 732.000000000 FORMAT "%13.9" NUMBER 64 /end CHARACTERISTIC
/begin CHARACTERISTIC DINH_FId.DFC_EV1max_CA "inhibitable FIds / FIds to be inhibited by inhibit source DFC_EV1max" VAL_BLK 0x804E2CCC ValA_Wu16 732.000000000 DINH_FIdVerb 0.00 732.000000000 FORMAT "%13.9" NUMBER 57 /end CHARACTERISTIC
/begin CHARACTERISTIC DINH_FId.DFC_EV1min_CA "inhibitable FIds / FIds to be inhibited by inhibit source DFC_EV1min" VAL_BLK 0x804E2D3E ValA_Wu16 732.000000000 DINH_FIdVerb 0.00 732.000000000 FORMAT "%13.9" NUMBER 59 /end CHARACTERISTIC
/begin CHARACTERISTIC DINH_FId.DFC_EV1sig_CA "inhibitable FIds / FIds to be inhibited by inhibit source DFC_EV1sig" VAL_BLK 0x804E2DB4 ValA_Wu16 732.000000000 DINH_FIdVerb 0.00 732.000000000 FORMAT "%13.9" NUMBER 57 /end CHARACTERISTIC
/begin CHARACTERISTIC DINH_FId.DFC_EV2max_CA "inhibitable FIds / FIds to be inhibited by inhibit source DFC_EV2max" VAL_BLK 0x804E2E26 ValA_Wu16 732.000000000 DINH_FIdVerb 0.00 732.000000000 FORMAT "%13.9" NUMBER 57 /end CHARACTERISTIC
/begin CHARACTERISTIC DINH_FId.DFC_EV2min_CA "inhibitable FIds / FIds to be inhibited by inhibit source DFC_EV2min" VAL_BLK 0x804E2E98 ValA_Wu16 732.000000000 DINH_FIdVerb 0.00 732.000000000 FORMAT "%13.9" NUMBER 59 /end CHARACTERISTIC
/begin CHARACTERISTIC DINH_FId.DFC_EV2sig_CA "inhibitable FIds / FIds to be inhibited by inhibit source DFC_EV2sig" VAL_BLK 0x804E2F0E ValA_Wu16 732.000000000 DINH_FIdVerb 0.00 732.000000000 FORMAT "%13.9" NUMBER 57 /end CHARACTERISTIC
/begin CHARACTERISTIC DINH_FId.DFC_EV3max_CA "inhibitable FIds / FIds to be inhibited by inhibit source DFC_EV3max" VAL_BLK 0x804E2F80 ValA_Wu16 732.000000000 DINH_FIdVerb 0.00 732.000000000 FORMAT "%13.9" NUMBER 57 /end CHARACTERISTIC
/begin CHARACTERISTIC DINH_FId.DFC_EV3min_CA "inhibitable FIds / FIds to be inhibited by inhibit source DFC_EV3min" VAL_BLK 0x804E2FF2 ValA_Wu16 732.000000000 DINH_FIdVerb 0.00 732.000000000 FORMAT "%13.9" NUMBER 59 /end CHARACTERISTIC
/begin CHARACTERISTIC DINH_FId.DFC_EV3sig_CA "inhibitable FIds / FIds to be inhibited by inhibit source DFC_EV3sig" VAL_BLK 0x804E3068 ValA_Wu16 732.000000000 DINH_FIdVerb 0.00 732.000000000 FORMAT "%13.9" NUMBER 57 /end CHARACTERISTIC
/begin CHARACTERISTIC DINH_FId.DFC_EV4max_CA "inhibitable FIds / FIds to be inhibited by inhibit source DFC_EV4max" VAL_BLK 0x804E30DA ValA_Wu16 732.000000000 DINH_FIdVerb 0.00 732.000000000 FORMAT "%13.9" NUMBER 57 /end CHARACTERISTIC
/begin CHARACTERISTIC DINH_FId.DFC_EV4min_CA "inhibitable FIds / FIds to be inhibited by inhibit source DFC_EV4min" VAL_BLK 0x804E314C ValA_Wu16 732.000000000 DINH_FIdVerb 0.00 732.000000000 FORMAT "%13.9" NUMBER 59 /end CHARACTERISTIC
/begin CHARACTERISTIC DINH_FId.DFC_EV4sig_CA "inhibitable FIds / FIds to be inhibited by inhibit source DFC_EV4sig" VAL_BLK 0x804E31C2 ValA_Wu16 732.000000000 DINH_FIdVerb 0.00 732.000000000 FORMAT "%13.9" NUMBER 57 /end CHARACTERISTIC
/begin CHARACTERISTIC DINH_FId.DFC_GbxPNPosnDrvCdn_CA "inhibitable FIds / FIds to be inhibited by inhibit source DFC_GbxPNPosnDrvCdn" VAL_BLK 0x804E3234 ValA_Wu16 732.000000000 DINH_FIdVerb 0.00 732.000000000 FORMAT "%13.9" NUMBER 61 /end CHARACTERISTIC
/begin CHARACTERISTIC DINH_FId.DFC_GbxPNPosnPlausy_CA "inhibitable FIds / FIds to be inhibited by inhibit source DFC_GbxPNPosnPlausy" VAL_BLK 0x804E32AE ValA_Wu16 732.000000000 DINH_FIdVerb 0.00 732.000000000 FORMAT "%13.9" NUMBER 55 /end CHARACTERISTIC
/begin CHARACTERISTIC DINH_FId.DFC_PEnvCcMax_CA "inhibitable FIds / FIds to be inhibited by inhibit source DFC_PEnvCcMax" VAL_BLK 0x804E331C ValA_Wu16 732.000000000 DINH_FIdVerb 0.00 732.000000000 FORMAT "%13.9" NUMBER 71 /end CHARACTERISTIC
/begin CHARACTERISTIC DINH_FId.DFC_PEnvCcMin_CA "inhibitable FIds / FIds to be inhibited by inhibit source DFC_PEnvCcMin" VAL_BLK 0x804E33AA ValA_Wu16 732.000000000 DINH_FIdVerb 0.00 732.000000000 FORMAT "%13.9" NUMBER 71 /end CHARACTERISTIC
/begin CHARACTERISTIC DINH_FId.DFC_PEnvRngChkMax_CA "inhibitable FIds / FIds to be inhibited by inhibit source DFC_PEnvRngChkMax" VAL_BLK 0x804E3438 ValA_Wu16 732.000000000 DINH_FIdVerb 0.00 732.000000000 FORMAT "%13.9" NUMBER 72 /end CHARACTERISTIC
/begin CHARACTERISTIC DINH_FId.DFC_PEnvRngChkMin_CA "inhibitable FIds / FIds to be inhibited by inhibit source DFC_PEnvRngChkMin" VAL_BLK 0x804E34C8 ValA_Wu16 732.000000000 DINH_FIdVerb 0.00 732.000000000 FORMAT "%13.9" NUMBER 72 /end CHARACTERISTIC
/begin CHARACTERISTIC DINH_FId.DFC_PEnvSnsrPlaus_CA "inhibitable FIds / FIds to be inhibited by inhibit source DFC_PEnvSnsrPlaus" VAL_BLK 0x804E3558 ValA_Wu16 732.000000000 DINH_FIdVerb 0.00 732.000000000 FORMAT "%13.9" NUMBER 68 /end CHARACTERISTIC
/begin CHARACTERISTIC DINH_FId.DFC_UEGOHeatrPsS1B1Max_CA "inhibitable FIds / FIds to be inhibited by inhibit source DFC_UEGOHeatrPsS1B1Max" VAL_BLK 0x804E35E0 ValA_Wu16 732.000000000 DINH_FIdVerb 0.00 732.000000000 FORMAT "%13.9" NUMBER 75 /end CHARACTERISTIC
/begin CHARACTERISTIC DINH_FId.DFC_UEGOHeatrPsS1B1Min_CA "inhibitable FIds / FIds to be inhibited by inhibit source DFC_UEGOHeatrPsS1B1Min" VAL_BLK 0x804E3676 ValA_Wu16 732.000000000 DINH_FIdVerb 0.00 732.000000000 FORMAT "%13.9" NUMBER 74 /end CHARACTERISTIC
/begin CHARACTERISTIC DINH_FId.DFC_UEGOHeatrPsS1B1Sig_CA "inhibitable FIds / FIds to be inhibited by inhibit source DFC_UEGOHeatrPsS1B1Sig" VAL_BLK 0x804E370A ValA_Wu16 732.000000000 DINH_FIdVerb 0.00 732.000000000 FORMAT "%13.9" NUMBER 74 /end CHARACTERISTIC
/begin CHARACTERISTIC DINH_FId.DFC_UEGOHeatrRlyPsOLS1B1_CA "inhibitable FIds / FIds to be inhibited by inhibit source DFC_UEGOHeatrRlyPsOLS1B1" VAL_BLK 0x804E379E ValA_Wu16 732.000000000 DINH_FIdVerb 0.00 732.000000000 FORMAT "%13.9" NUMBER 52 /end CHARACTERISTIC
/begin CHARACTERISTIC DINH_FId.DFC_UEGOHeatrRlyPsSCBS1B1_CA "inhibitable FIds / FIds to be inhibited by inhibit source DFC_UEGOHeatrRlyPsSCBS1B1" VAL_BLK 0x804E3806 ValA_Wu16 732.000000000 DINH_FIdVerb 0.00 732.000000000 FORMAT "%13.9" NUMBER 53 /end CHARACTERISTIC
/begin CHARACTERISTIC DINH_FId.DFC_UEGOHeatrRlyPsSCGS1B1_CA "inhibitable FIds / FIds to be inhibited by inhibit source DFC_UEGOHeatrRlyPsSCGS1B1" VAL_BLK 0x804E3870 ValA_Wu16 732.000000000 DINH_FIdVerb 0.00 732.000000000 FORMAT "%13.9" NUMBER 52 /end CHARACTERISTIC
/begin CHARACTERISTIC DINH_FId.DFC_KnDetSens1PortAMax_CA "inhibitable FIds / FIds to be inhibited by inhibit source DFC_KnDetSens1PortAMax" VAL_BLK 0x804E38D8 ValA_Wu16 732.000000000 DINH_FIdVerb 0.00 732.000000000 FORMAT "%13.9" NUMBER 55 /end CHARACTERISTIC
/begin CHARACTERISTIC DINH_FId.DFC_KnDetSens1PortAMin_CA "inhibitable FIds / FIds to be inhibited by inhibit source DFC_KnDetSens1PortAMin" VAL_BLK 0x804E3946 ValA_Wu16 732.000000000 DINH_FIdVerb 0.00 732.000000000 FORMAT "%13.9" NUMBER 55 /end CHARACTERISTIC
/begin CHARACTERISTIC DINH_FId.DFC_KnDetSens1PortBMax_CA "inhibitable FIds / FIds to be inhibited by inhibit source DFC_KnDetSens1PortBMax" VAL_BLK 0x804E39B4 ValA_Wu16 732.000000000 DINH_FIdVerb 0.00 732.000000000 FORMAT "%13.9" NUMBER 55 /end CHARACTERISTIC
/begin CHARACTERISTIC DINH_FId.DFC_KnDetSens1PortBMin_CA "inhibitable FIds / FIds to be inhibited by inhibit source DFC_KnDetSens1PortBMin" VAL_BLK 0x804E3A22 ValA_Wu16 732.000000000 DINH_FIdVerb 0.00 732.000000000 FORMAT "%13.9" NUMBER 55 /end CHARACTERISTIC
/begin CHARACTERISTIC DINH_FId.DFC_Clth2ONStuck_CA "inhibitable FIds / FIds to be inhibited by inhibit source DFC_Clth2ONStuck" VAL_BLK 0x804E3A90 ValA_Wu16 732.000000000 DINH_FIdVerb 0.00 732.000000000 FORMAT "%13.9" NUMBER 52 /end CHARACTERISTIC
/begin CHARACTERISTIC DINH_FId.DFC_Clth2ONStuckLdc_CA "inhibitable FIds / FIds to be inhibited by inhibit source DFC_Clth2ONStuckLdc" VAL_BLK 0x804E3AF8 ValA_Wu16 732.000000000 DINH_FIdVerb 0.00 732.000000000 FORMAT "%13.9" NUMBER 52 /end CHARACTERISTIC
/begin CHARACTERISTIC DINH_FId.DFC_Clth3ONStuckLdc_CA "inhibitable FIds / FIds to be inhibited by inhibit source DFC_Clth3ONStuckLdc" VAL_BLK 0x804E3B60 ValA_Wu16 732.000000000 DINH_FIdVerb 0.00 732.000000000 FORMAT "%13.9" NUMBER 53 /end CHARACTERISTIC
/begin CHARACTERISTIC DINH_FId.DFC_Clth3ONStuckPostDrv_CA "inhibitable FIds / FIds to be inhibited by inhibit source DFC_Clth3ONStuckPostDrv" VAL_BLK 0x804E3BCA ValA_Wu16 732.000000000 DINH_FIdVerb 0.00 732.000000000 FORMAT "%13.9" NUMBER 52 /end CHARACTERISTIC
/begin CHARACTERISTIC DINH_FId.DFC_Clth4ONStuck_CA "inhibitable FIds / FIds to be inhibited by inhibit source DFC_Clth4ONStuck" VAL_BLK 0x804E3C32 ValA_Wu16 732.000000000 DINH_FIdVerb 0.00 732.000000000 FORMAT "%13.9" NUMBER 51 /end CHARACTERISTIC
/begin CHARACTERISTIC DINH_FId.DFC_Clth4ONStuckLdc_CA "inhibitable FIds / FIds to be inhibited by inhibit source DFC_Clth4ONStuckLdc" VAL_BLK 0x804E3C98 ValA_Wu16 732.000000000 DINH_FIdVerb 0.00 732.000000000 FORMAT "%13.9" NUMBER 59 /end CHARACTERISTIC
/begin CHARACTERISTIC DINH_FId.DFC_ComDLCTCU01_CA "inhibitable FIds / FIds to be inhibited by inhibit source DFC_ComDLCTCU01" VAL_BLK 0x804E3D0E ValA_Wu16 732.000000000 DINH_FIdVerb 0.00 732.000000000 FORMAT "%13.9" NUMBER 51 /end CHARACTERISTIC
/begin CHARACTERISTIC DINH_FId.DFC_ComDLCTCU02_CA "inhibitable FIds / FIds to be inhibited by inhibit source DFC_ComDLCTCU02" VAL_BLK 0x804E3D74 ValA_Wu16 732.000000000 DINH_FIdVerb 0.00 732.000000000 FORMAT "%13.9" NUMBER 51 /end CHARACTERISTIC
/begin CHARACTERISTIC DINH_FId.DFC_ComDLCTCU1_CA "inhibitable FIds / FIds to be inhibited by inhibit source DFC_ComDLCTCU1" VAL_BLK 0x804E3DDA ValA_Wu16 732.000000000 DINH_FIdVerb 0.00 732.000000000 FORMAT "%13.9" NUMBER 55 /end CHARACTERISTIC
/begin CHARACTERISTIC DINH_FId.DFC_ComDLCTCU11_CA "inhibitable FIds / FIds to be inhibited by inhibit source DFC_ComDLCTCU11" VAL_BLK 0x804E3E48 ValA_Wu16 732.000000000 DINH_FIdVerb 0.00 732.000000000 FORMAT "%13.9" NUMBER 54 /end CHARACTERISTIC
/begin CHARACTERISTIC DINH_FId.DFC_ComDLCTCU12_CA "inhibitable FIds / FIds to be inhibited by inhibit source DFC_ComDLCTCU12" VAL_BLK 0x804E3EB4 ValA_Wu16 732.000000000 DINH_FIdVerb 0.00 732.000000000 FORMAT "%13.9" NUMBER 52 /end CHARACTERISTIC
/begin CHARACTERISTIC DINH_FId.DFC_ComDLCTCU13_CA "inhibitable FIds / FIds to be inhibited by inhibit source DFC_ComDLCTCU13" VAL_BLK 0x804E3F1C ValA_Wu16 732.000000000 DINH_FIdVerb 0.00 732.000000000 FORMAT "%13.9" NUMBER 52 /end CHARACTERISTIC
/begin CHARACTERISTIC DINH_FId.DFC_ComDLCTCU14_CA "inhibitable FIds / FIds to be inhibited by inhibit source DFC_ComDLCTCU14" VAL_BLK 0x804E3F84 ValA_Wu16 732.000000000 DINH_FIdVerb 0.00 732.000000000 FORMAT "%13.9" NUMBER 51 /end CHARACTERISTIC
/begin CHARACTERISTIC DINH_FId.DFC_ComDLCTCU2_CA "inhibitable FIds / FIds to be inhibited by inhibit source DFC_ComDLCTCU2" VAL_BLK 0x804E3FEA ValA_Wu16 732.000000000 DINH_FIdVerb 0.00 732.000000000 FORMAT "%13.9" NUMBER 52 /end CHARACTERISTIC
/begin CHARACTERISTIC DINH_FId.DFC_ComDLCTCU3_CA "inhibitable FIds / FIds to be inhibited by inhibit source DFC_ComDLCTCU3" VAL_BLK 0x804E4052 ValA_Wu16 732.000000000 DINH_FIdVerb 0.00 732.000000000 FORMAT "%13.9" NUMBER 52 /end CHARACTERISTIC
/begin CHARACTERISTIC DINH_FId.DFC_ComDLCTCU4_CA "inhibitable FIds / FIds to be inhibited by inhibit source DFC_ComDLCTCU4" VAL_BLK 0x804E40BA ValA_Wu16 732.000000000 DINH_FIdVerb 0.00 732.000000000 FORMAT "%13.9" NUMBER 51 /end CHARACTERISTIC
/begin CHARACTERISTIC DINH_FId.DFC_EVX_CA "inhibitable FIds / FIds to be inhibited by inhibit source DFC_EVX" VAL_BLK 0x804E4120 ValA_Wu16 732.000000000 DINH_FIdVerb 0.00 732.000000000 FORMAT "%13.9" NUMBER 55 /end CHARACTERISTIC
/begin CHARACTERISTIC DINH_FId.DFC_EbsSocFlt_CA "inhibitable FIds / FIds to be inhibited by inhibit source DFC_EbsSocFlt" VAL_BLK 0x804E418E ValA_Wu16 732.000000000 DINH_FIdVerb 0.00 732.000000000 FORMAT "%13.9" NUMBER 50 /end CHARACTERISTIC
/begin CHARACTERISTIC DINH_FId.DFC_I14229VINErr_CA "inhibitable FIds / FIds to be inhibited by inhibit source DFC_I14229VINErr" VAL_BLK 0x804E41F2 ValA_Wu16 732.000000000 DINH_FIdVerb 0.00 732.000000000 FORMAT "%13.9" NUMBER 50 /end CHARACTERISTIC
/begin CHARACTERISTIC DINH_FId.DFC_LLRKHmax_CA "inhibitable FIds / FIds to be inhibited by inhibit source DFC_LLRKHmax" VAL_BLK 0x804E4256 ValA_Wu16 732.000000000 DINH_FIdVerb 0.00 732.000000000 FORMAT "%13.9" NUMBER 50 /end CHARACTERISTIC
/begin CHARACTERISTIC DINH_FId.DFC_LLRKHmin_CA "inhibitable FIds / FIds to be inhibited by inhibit source DFC_LLRKHmin" VAL_BLK 0x804E42BA ValA_Wu16 732.000000000 DINH_FIdVerb 0.00 732.000000000 FORMAT "%13.9" NUMBER 50 /end CHARACTERISTIC
/begin CHARACTERISTIC DINH_FId.DFC_LLRmax_CA "inhibitable FIds / FIds to be inhibited by inhibit source DFC_LLRmax" VAL_BLK 0x804E431E ValA_Wu16 732.000000000 DINH_FIdVerb 0.00 732.000000000 FORMAT "%13.9" NUMBER 50 /end CHARACTERISTIC
/begin CHARACTERISTIC DINH_FId.DFC_LLRmin_CA "inhibitable FIds / FIds to be inhibited by inhibit source DFC_LLRmin" VAL_BLK 0x804E4382 ValA_Wu16 732.000000000 DINH_FIdVerb 0.00 732.000000000 FORMAT "%13.9" NUMBER 50 /end CHARACTERISTIC
/begin CHARACTERISTIC DINH_FId.DFC_RoughRoad_CA "inhibitable FIds / FIds to be inhibited by inhibit source DFC_RoughRoad" VAL_BLK 0x804E43E6 ValA_Wu16 732.000000000 DINH_FIdVerb 0.00 732.000000000 FORMAT "%13.9" NUMBER 54 /end CHARACTERISTIC
/begin CHARACTERISTIC DINH_FId.DFC_SiaEEPRdErr_CA "inhibitable FIds / FIds to be inhibited by inhibit source DFC_SiaEEPRdErr" VAL_BLK 0x804E4452 ValA_Wu16 732.000000000 DINH_FIdVerb 0.00 732.000000000 FORMAT "%13.9" NUMBER 51 /end CHARACTERISTIC
/begin CHARACTERISTIC DINH_FId.DFC_SiaEEPWrngCod_CA "inhibitable FIds / FIds to be inhibited by inhibit source DFC_SiaEEPWrngCod" VAL_BLK 0x804E44B8 ValA_Wu16 732.000000000 DINH_FIdVerb 0.00 732.000000000 FORMAT "%13.9" NUMBER 51 /end CHARACTERISTIC
/begin CHARACTERISTIC DINH_FId.DFC_UegoDummy_CA "inhibitable FIds / FIds to be inhibited by inhibit source DFC_UegoDummy" VAL_BLK 0x804E451E ValA_Wu16 732.000000000 DINH_FIdVerb 0.00 732.000000000 FORMAT "%13.9" NUMBER 50 /end CHARACTERISTIC
/begin CHARACTERISTIC DINH_FId.DFC_BusDiagCANAPPLBusOff_CA "inhibitable FIds / FIds to be inhibited by inhibit source DFC_BusDiagCANAPPLBusOff" VAL_BLK 0x804E4582 ValA_Wu16 732.000000000 DINH_FIdVerb 0.00 732.000000000 FORMAT "%13.9" NUMBER 50 /end CHARACTERISTIC
/begin CHARACTERISTIC DINH_FId.DFC_BusDiagCANCANCBusOff_CA "inhibitable FIds / FIds to be inhibited by inhibit source DFC_BusDiagCANCANCBusOff" VAL_BLK 0x804E45E6 ValA_Wu16 732.000000000 DINH_FIdVerb 0.00 732.000000000 FORMAT "%13.9" NUMBER 50 /end CHARACTERISTIC
/begin CHARACTERISTIC DINH_FId.DFC_BusDiagCANVEHICLEBusOff_CA "inhibitable FIds / FIds to be inhibited by inhibit source DFC_BusDiagCANVEHICLEBusOff" VAL_BLK 0x804E464A ValA_Wu16 732.000000000 DINH_FIdVerb 0.00 732.000000000 FORMAT "%13.9" NUMBER 61 /end CHARACTERISTIC
/begin CHARACTERISTIC DINH_FId.DFC_RBA_IODIAGPWR_rba_IoExtCy329_SignalVltSply_0_CA "inhibitable FIds / FIds to be inhibited by inhibit source DFC_RBA_IODIAGPWR_rba_IoExtCy329_SignalVltSply_0" VAL_BLK 0x804E46C4 ValA_Wu16 732.000000000 DINH_FIdVerb 0.00 732.000000000 FORMAT "%13.9" NUMBER 200 /end CHARACTERISTIC
/begin CHARACTERISTIC DINH_FId.DFC_RBA_IODIAGPWR_rba_IoExtCy329_SignalVltSply_0OT_CA "inhibitable FIds / FIds to be inhibited by inhibit source DFC_RBA_IODIAGPWR_rba_IoExtCy329_SignalVltSply_0OT" VAL_BLK 0x804E4854 ValA_Wu16 732.000000000 DINH_FIdVerb 0.00 732.000000000 FORMAT "%13.9" NUMBER 50 /end CHARACTERISTIC
/begin CHARACTERISTIC DINH_FId.DFC_RBA_IODIAGPWR_rba_IoExtCy329_SignalVltSply_0OV_CA "inhibitable FIds / FIds to be inhibited by inhibit source DFC_RBA_IODIAGPWR_rba_IoExtCy329_SignalVltSply_0OV" VAL_BLK 0x804E48B8 ValA_Wu16 732.000000000 DINH_FIdVerb 0.00 732.000000000 FORMAT "%13.9" NUMBER 50 /end CHARACTERISTIC
/begin CHARACTERISTIC DINH_FId.DFC_RBA_IODIAGPWR_rba_IoExtCy329_SignalVltSply_0SCG_CA "inhibitable FIds / FIds to be inhibited by inhibit source DFC_RBA_IODIAGPWR_rba_IoExtCy329_SignalVltSply_0SCG" VAL_BLK 0x804E491C ValA_Wu16 732.000000000 DINH_FIdVerb 0.00 732.000000000 FORMAT "%13.9" NUMBER 50 /end CHARACTERISTIC
/begin CHARACTERISTIC DINH_FId.DFC_RBA_IODIAGPWR_rba_IoExtCy329_SignalVltSply_0UV_CA "inhibitable FIds / FIds to be inhibited by inhibit source DFC_RBA_IODIAGPWR_rba_IoExtCy329_SignalVltSply_0UV" VAL_BLK 0x804E4980 ValA_Wu16 732.000000000 DINH_FIdVerb 0.00 732.000000000 FORMAT "%13.9" NUMBER 50 /end CHARACTERISTIC
/begin CHARACTERISTIC DINH_FId.DFC_RBA_IODIAGPWR_rba_IoExtCy329_SignalVltSply_1_CA "inhibitable FIds / FIds to be inhibited by inhibit source DFC_RBA_IODIAGPWR_rba_IoExtCy329_SignalVltSply_1" VAL_BLK 0x804E49E4 ValA_Wu16 732.000000000 DINH_FIdVerb 0.00 732.000000000 FORMAT "%13.9" NUMBER 200 /end CHARACTERISTIC
/begin CHARACTERISTIC DINH_FId.DFC_RBA_IODIAGPWR_rba_IoExtCy329_SignalVltSply_1OT_CA "inhibitable FIds / FIds to be inhibited by inhibit source DFC_RBA_IODIAGPWR_rba_IoExtCy329_SignalVltSply_1OT" VAL_BLK 0x804E4B74 ValA_Wu16 732.000000000 DINH_FIdVerb 0.00 732.000000000 FORMAT "%13.9" NUMBER 50 /end CHARACTERISTIC
/begin CHARACTERISTIC DINH_FId.DFC_RBA_IODIAGPWR_rba_IoExtCy329_SignalVltSply_1OV_CA "inhibitable FIds / FIds to be inhibited by inhibit source DFC_RBA_IODIAGPWR_rba_IoExtCy329_SignalVltSply_1OV" VAL_BLK 0x804E4BD8 ValA_Wu16 732.000000000 DINH_FIdVerb 0.00 732.000000000 FORMAT "%13.9" NUMBER 50 /end CHARACTERISTIC
/begin CHARACTERISTIC DINH_FId.DFC_RBA_IODIAGPWR_rba_IoExtCy329_SignalVltSply_1SCG_CA "inhibitable FIds / FIds to be inhibited by inhibit source DFC_RBA_IODIAGPWR_rba_IoExtCy329_SignalVltSply_1SCG" VAL_BLK 0x804E4C3C ValA_Wu16 732.000000000 DINH_FIdVerb 0.00 732.000000000 FORMAT "%13.9" NUMBER 50 /end CHARACTERISTIC
/begin CHARACTERISTIC DINH_FId.DFC_RBA_IODIAGPWR_rba_IoExtCy329_SignalVltSply_1UV_CA "inhibitable FIds / FIds to be inhibited by inhibit source DFC_RBA_IODIAGPWR_rba_IoExtCy329_SignalVltSply_1UV" VAL_BLK 0x804E4CA0 ValA_Wu16 732.000000000 DINH_FIdVerb 0.00 732.000000000 FORMAT "%13.9" NUMBER 50 /end CHARACTERISTIC
/begin CHARACTERISTIC DINH_FId.DFC_RBA_IODIAGPWR_rba_IoExtCy329_SignalVltSply_2_CA "inhibitable FIds / FIds to be inhibited by inhibit source DFC_RBA_IODIAGPWR_rba_IoExtCy329_SignalVltSply_2" VAL_BLK 0x804E4D04 ValA_Wu16 732.000000000 DINH_FIdVerb 0.00 732.000000000 FORMAT "%13.9" NUMBER 100 /end CHARACTERISTIC
/begin CHARACTERISTIC DINH_FId.DFC_RBA_IODIAGPWR_rba_IoExtCy329_SignalVltSply_2OT_CA "inhibitable FIds / FIds to be inhibited by inhibit source DFC_RBA_IODIAGPWR_rba_IoExtCy329_SignalVltSply_2OT" VAL_BLK 0x804E4DCC ValA_Wu16 732.000000000 DINH_FIdVerb 0.00 732.000000000 FORMAT "%13.9" NUMBER 50 /end CHARACTERISTIC
/begin CHARACTERISTIC DINH_FId.DFC_RBA_IODIAGPWR_rba_IoExtCy329_SignalVltSply_2OV_CA "inhibitable FIds / FIds to be inhibited by inhibit source DFC_RBA_IODIAGPWR_rba_IoExtCy329_SignalVltSply_2OV" VAL_BLK 0x804E4E30 ValA_Wu16 732.000000000 DINH_FIdVerb 0.00 732.000000000 FORMAT "%13.9" NUMBER 50 /end CHARACTERISTIC
/begin CHARACTERISTIC DINH_FId.DFC_RBA_IODIAGPWR_rba_IoExtCy329_SignalVltSply_2SCG_CA "inhibitable FIds / FIds to be inhibited by inhibit source DFC_RBA_IODIAGPWR_rba_IoExtCy329_SignalVltSply_2SCG" VAL_BLK 0x804E4E94 ValA_Wu16 732.000000000 DINH_FIdVerb 0.00 732.000000000 FORMAT "%13.9" NUMBER 50 /end CHARACTERISTIC
/begin CHARACTERISTIC DINH_FId.DFC_RBA_IODIAGPWR_rba_IoExtCy329_SignalVltSply_2UV_CA "inhibitable FIds / FIds to be inhibited by inhibit source DFC_RBA_IODIAGPWR_rba_IoExtCy329_SignalVltSply_2UV" VAL_BLK 0x804E4EF8 ValA_Wu16 732.000000000 DINH_FIdVerb 0.00 732.000000000 FORMAT "%13.9" NUMBER 50 /end CHARACTERISTIC
/begin CHARACTERISTIC DINH_FId.DFC_CAN_E_TIMEOUT_CA "inhibitable FIds / FIds to be inhibited by inhibit source DFC_CAN_E_TIMEOUT" VAL_BLK 0x804E4F5C ValA_Wu16 732.000000000 DINH_FIdVerb 0.00 732.000000000 FORMAT "%13.9" NUMBER 50 /end CHARACTERISTIC
/begin CHARACTERISTIC DINH_FId.DFC_LIN_E_TIMEOUT_CA "inhibitable FIds / FIds to be inhibited by inhibit source DFC_LIN_E_TIMEOUT" VAL_BLK 0x804E4FC0 ValA_Wu16 732.000000000 DINH_FIdVerb 0.00 732.000000000 FORMAT "%13.9" NUMBER 50 /end CHARACTERISTIC
/begin CHARACTERISTIC DINH_FId.DFC_MRlyOL_CA "inhibitable FIds / FIds to be inhibited by inhibit source DFC_MRlyOL" VAL_BLK 0x804E5024 ValA_Wu16 732.000000000 DINH_FIdVerb 0.00 732.000000000 FORMAT "%13.9" NUMBER 50 /end CHARACTERISTIC
/begin CHARACTERISTIC DINH_FId.DFC_MRlySCB_CA "inhibitable FIds / FIds to be inhibited by inhibit source DFC_MRlySCB" VAL_BLK 0x804E5088 ValA_Wu16 732.000000000 DINH_FIdVerb 0.00 732.000000000 FORMAT "%13.9" NUMBER 50 /end CHARACTERISTIC
/begin CHARACTERISTIC DINH_FId.DFC_MRlySCG_CA "inhibitable FIds / FIds to be inhibited by inhibit source DFC_MRlySCG" VAL_BLK 0x804E50EC ValA_Wu16 732.000000000 DINH_FIdVerb 0.00 732.000000000 FORMAT "%13.9" NUMBER 51 /end CHARACTERISTIC
/begin CHARACTERISTIC DINH_FId.DFC_rba_MultiStackTrace_Threshold_CA "inhibitable FIds / FIds to be inhibited by inhibit source DFC_rba_MultiStackTrace_Threshold" VAL_BLK 0x804E5152 ValA_Wu16 732.000000000 DINH_FIdVerb 0.00 732.000000000 FORMAT "%13.9" NUMBER 50 /end CHARACTERISTIC
/begin CHARACTERISTIC DINH_FId.DFC_BSWM_E_ACTION_FAILED_CA "inhibitable FIds / FIds to be inhibited by inhibit source DFC_BSWM_E_ACTION_FAILED" VAL_BLK 0x804E51B6 ValA_Wu16 732.000000000 DINH_FIdVerb 0.00 732.000000000 FORMAT "%13.9" NUMBER 50 /end CHARACTERISTIC
/begin CHARACTERISTIC DINH_FId.DFC_BSWM_E_INTRPTQUEUE_FULL_CA "inhibitable FIds / FIds to be inhibited by inhibit source DFC_BSWM_E_INTRPTQUEUE_FULL" VAL_BLK 0x804E521A ValA_Wu16 732.000000000 DINH_FIdVerb 0.00 732.000000000 FORMAT "%13.9" NUMBER 50 /end CHARACTERISTIC
/begin CHARACTERISTIC DINH_FId.DFC_RBA_IOEXTLIB_KEEPALIVE_DRV_CA "inhibitable FIds / FIds to be inhibited by inhibit source DFC_RBA_IOEXTLIB_KEEPALIVE_DRV" VAL_BLK 0x804E527E ValA_Wu16 732.000000000 DINH_FIdVerb 0.00 732.000000000 FORMAT "%13.9" NUMBER 51 /end CHARACTERISTIC
/begin CHARACTERISTIC DINH_FId.DFC_RBA_IOEXTLIB_KEEPALIVE_INI_CA "inhibitable FIds / FIds to be inhibited by inhibit source DFC_RBA_IOEXTLIB_KEEPALIVE_INI" VAL_BLK 0x804E52E4 ValA_Wu16 732.000000000 DINH_FIdVerb 0.00 732.000000000 FORMAT "%13.9" NUMBER 51 /end CHARACTERISTIC
/begin CHARACTERISTIC DINH_FId.DFC_rba_IoSigRtc_StopCounter_CA "inhibitable FIds / FIds to be inhibited by inhibit source DFC_rba_IoSigRtc_StopCounter" VAL_BLK 0x804E534A ValA_Wu16 732.000000000 DINH_FIdVerb 0.00 732.000000000 FORMAT "%13.9" NUMBER 53 /end CHARACTERISTIC
/begin CHARACTERISTIC DINH_FId.DFC_rba_MRly_Diag_Stk_Event_CA "inhibitable FIds / FIds to be inhibited by inhibit source DFC_rba_MRly_Diag_Stk_Event" VAL_BLK 0x804E53B4 ValA_Wu16 732.000000000 DINH_FIdVerb 0.00 732.000000000 FORMAT "%13.9" NUMBER 50 /end CHARACTERISTIC
/begin CHARACTERISTIC DINH_FId.DFC_rba_MemDiag_MemReadErr_CA "inhibitable FIds / FIds to be inhibited by inhibit source DFC_rba_MemDiag_MemReadErr" VAL_BLK 0x804E5418 ValA_Wu16 732.000000000 DINH_FIdVerb 0.00 732.000000000 FORMAT "%13.9" NUMBER 60 /end CHARACTERISTIC
/begin CHARACTERISTIC DINH_FId.DFC_rba_MemDiag_MemWrErr_CA "inhibitable FIds / FIds to be inhibited by inhibit source DFC_rba_MemDiag_MemWrErr" VAL_BLK 0x804E5490 ValA_Wu16 732.000000000 DINH_FIdVerb 0.00 732.000000000 FORMAT "%13.9" NUMBER 59 /end CHARACTERISTIC
/begin CHARACTERISTIC DINH_FId.DFC_rba_SyC_IrrSwOffTrigEngRun_Event_CA "inhibitable FIds / FIds to be inhibited by inhibit source DFC_rba_SyC_IrrSwOffTrigEngRun_Event" VAL_BLK 0x804E5506 ValA_Wu16 732.000000000 DINH_FIdVerb 0.00 732.000000000 FORMAT "%13.9" NUMBER 50 /end CHARACTERISTIC
/begin CHARACTERISTIC DINH_FId.DFC_rba_T15_Diag_ComInVld_Event_CA "inhibitable FIds / FIds to be inhibited by inhibit source DFC_rba_T15_Diag_ComInVld_Event" VAL_BLK 0x804E556A ValA_Wu16 732.000000000 DINH_FIdVerb 0.00 732.000000000 FORMAT "%13.9" NUMBER 50 /end CHARACTERISTIC
/begin CHARACTERISTIC DINH_FId.DFC_rba_T15_Diag_ComOff_HwOn_Event_CA "inhibitable FIds / FIds to be inhibited by inhibit source DFC_rba_T15_Diag_ComOff_HwOn_Event" VAL_BLK 0x804E55CE ValA_Wu16 732.000000000 DINH_FIdVerb 0.00 732.000000000 FORMAT "%13.9" NUMBER 50 /end CHARACTERISTIC
/begin CHARACTERISTIC DINH_FId.DFC_rba_T15_Diag_ComOn_HwOff_Event_CA "inhibitable FIds / FIds to be inhibited by inhibit source DFC_rba_T15_Diag_ComOn_HwOff_Event" VAL_BLK 0x804E5632 ValA_Wu16 732.000000000 DINH_FIdVerb 0.00 732.000000000 FORMAT "%13.9" NUMBER 50 /end CHARACTERISTIC
/begin CHARACTERISTIC DINH_FId.DFC_AppAllSnsrDfct_CA "inhibitable FIds / FIds to be inhibited by inhibit source DFC_AppAllSnsrDfct" VAL_BLK 0x804E5696 ValA_Wu16 732.000000000 DINH_FIdVerb 0.00 732.000000000 FORMAT "%13.9" NUMBER 51 /end CHARACTERISTIC
/begin CHARACTERISTIC DINH_FId.DFC_BattUStdbyDiaOL_CA "inhibitable FIds / FIds to be inhibited by inhibit source DFC_BattUStdbyDiaOL" VAL_BLK 0x804E56FC ValA_Wu16 732.000000000 DINH_FIdVerb 0.00 732.000000000 FORMAT "%13.9" NUMBER 50 /end CHARACTERISTIC
/begin CHARACTERISTIC DINH_FId.DFC_BigLeakIntkMnfldEmiInfl_CA "inhibitable FIds / FIds to be inhibited by inhibit source DFC_BigLeakIntkMnfldEmiInfl" VAL_BLK 0x804E5760 ValA_Wu16 732.000000000 DINH_FIdVerb 0.00 732.000000000 FORMAT "%13.9" NUMBER 54 /end CHARACTERISTIC
/begin CHARACTERISTIC DINH_FId.DFC_BrkMnSwtContOnWarnLmp_CA "inhibitable FIds / FIds to be inhibited by inhibit source DFC_BrkMnSwtContOnWarnLmp" VAL_BLK 0x804E57CC ValA_Wu16 732.000000000 DINH_FIdVerb 0.00 732.000000000 FORMAT "%13.9" NUMBER 50 /end CHARACTERISTIC
/begin CHARACTERISTIC DINH_FId.DFC_BrkMnSwtNotStpWarnLmp_CA "inhibitable FIds / FIds to be inhibited by inhibit source DFC_BrkMnSwtNotStpWarnLmp" VAL_BLK 0x804E5830 ValA_Wu16 732.000000000 DINH_FIdVerb 0.00 732.000000000 FORMAT "%13.9" NUMBER 50 /end CHARACTERISTIC
/begin CHARACTERISTIC DINH_FId.DFC_BrkRdntSwtContOnWarnLmp_CA "inhibitable FIds / FIds to be inhibited by inhibit source DFC_BrkRdntSwtContOnWarnLmp" VAL_BLK 0x804E5894 ValA_Wu16 732.000000000 DINH_FIdVerb 0.00 732.000000000 FORMAT "%13.9" NUMBER 50 /end CHARACTERISTIC
/begin CHARACTERISTIC DINH_FId.DFC_BrkRdntSwtNotStpWarnLmp_CA "inhibitable FIds / FIds to be inhibited by inhibit source DFC_BrkRdntSwtNotStpWarnLmp" VAL_BLK 0x804E58F8 ValA_Wu16 732.000000000 DINH_FIdVerb 0.00 732.000000000 FORMAT "%13.9" NUMBER 50 /end CHARACTERISTIC
/begin CHARACTERISTIC DINH_FId.DFC_CEngDsTColdStrtMax_CA "inhibitable FIds / FIds to be inhibited by inhibit source DFC_CEngDsTColdStrtMax" VAL_BLK 0x804E595C ValA_Wu16 732.000000000 DINH_FIdVerb 0.00 732.000000000 FORMAT "%13.9" NUMBER 97 /end CHARACTERISTIC
/begin CHARACTERISTIC DINH_FId.DFC_CEngDsTColdStrtMin_CA "inhibitable FIds / FIds to be inhibited by inhibit source DFC_CEngDsTColdStrtMin" VAL_BLK 0x804E5A1E ValA_Wu16 732.000000000 DINH_FIdVerb 0.00 732.000000000 FORMAT "%13.9" NUMBER 97 /end CHARACTERISTIC
/begin CHARACTERISTIC DINH_FId.DFC_CEngDsTImps_CA "inhibitable FIds / FIds to be inhibited by inhibit source DFC_CEngDsTImps" VAL_BLK 0x804E5AE0 ValA_Wu16 732.000000000 DINH_FIdVerb 0.00 732.000000000 FORMAT "%13.9" NUMBER 100 /end CHARACTERISTIC
/begin CHARACTERISTIC DINH_FId.DFC_CEngDsTPlausLSC_CA "inhibitable FIds / FIds to be inhibited by inhibit source DFC_CEngDsTPlausLSC" VAL_BLK 0x804E5BA8 ValA_Wu16 732.000000000 DINH_FIdVerb 0.00 732.000000000 FORMAT "%13.9" NUMBER 97 /end CHARACTERISTIC
/begin CHARACTERISTIC DINH_FId.DFC_CEngDsTPlausSTC_CA "inhibitable FIds / FIds to be inhibited by inhibit source DFC_CEngDsTPlausSTC" VAL_BLK 0x804E5C6A ValA_Wu16 732.000000000 DINH_FIdVerb 0.00 732.000000000 FORMAT "%13.9" NUMBER 96 /end CHARACTERISTIC
/begin CHARACTERISTIC DINH_FId.DFC_CEngDsTSRCMax_CA "inhibitable FIds / FIds to be inhibited by inhibit source DFC_CEngDsTSRCMax" VAL_BLK 0x804E5D2A ValA_Wu16 732.000000000 DINH_FIdVerb 0.00 732.000000000 FORMAT "%13.9" NUMBER 111 /end CHARACTERISTIC
/begin CHARACTERISTIC DINH_FId.DFC_CEngDsTSRCMin_CA "inhibitable FIds / FIds to be inhibited by inhibit source DFC_CEngDsTSRCMin" VAL_BLK 0x804E5E08 ValA_Wu16 732.000000000 DINH_FIdVerb 0.00 732.000000000 FORMAT "%13.9" NUMBER 111 /end CHARACTERISTIC
/begin CHARACTERISTIC DINH_FId.DFC_CEngDsTSig_CA "inhibitable FIds / FIds to be inhibited by inhibit source DFC_CEngDsTSig" VAL_BLK 0x804E5EE6 ValA_Wu16 732.000000000 DINH_FIdVerb 0.00 732.000000000 FORMAT "%13.9" NUMBER 99 /end CHARACTERISTIC
/begin CHARACTERISTIC DINH_FId.DFC_CEngUsTSRCMax_CA "inhibitable FIds / FIds to be inhibited by inhibit source DFC_CEngUsTSRCMax" VAL_BLK 0x804E5FAC ValA_Wu16 732.000000000 DINH_FIdVerb 0.00 732.000000000 FORMAT "%13.9" NUMBER 56 /end CHARACTERISTIC
/begin CHARACTERISTIC DINH_FId.DFC_CEngUsTSRCMin_CA "inhibitable FIds / FIds to be inhibited by inhibit source DFC_CEngUsTSRCMin" VAL_BLK 0x804E601C ValA_Wu16 732.000000000 DINH_FIdVerb 0.00 732.000000000 FORMAT "%13.9" NUMBER 56 /end CHARACTERISTIC
/begin CHARACTERISTIC DINH_FId.DFC_DCDCFltDet_CA "inhibitable FIds / FIds to be inhibited by inhibit source DFC_DCDCFltDet" VAL_BLK 0x804E608C ValA_Wu16 732.000000000 DINH_FIdVerb 0.00 732.000000000 FORMAT "%13.9" NUMBER 58 /end CHARACTERISTIC
/begin CHARACTERISTIC DINH_FId.DFC_DKRSA_CA "inhibitable FIds / FIds to be inhibited by inhibit source DFC_DKRSA" VAL_BLK 0x804E6100 ValA_Wu16 732.000000000 DINH_FIdVerb 0.00 732.000000000 FORMAT "%13.9" NUMBER 55 /end CHARACTERISTIC
/begin CHARACTERISTIC DINH_FId.DFC_DKVSmax_CA "inhibitable FIds / FIds to be inhibited by inhibit source DFC_DKVSmax" VAL_BLK 0x804E616E ValA_Wu16 732.000000000 DINH_FIdVerb 0.00 732.000000000 FORMAT "%13.9" NUMBER 50 /end CHARACTERISTIC
/begin CHARACTERISTIC DINH_FId.DFC_DKnpl_CA "inhibitable FIds / FIds to be inhibited by inhibit source DFC_DKnpl" VAL_BLK 0x804E61D2 ValA_Wu16 732.000000000 DINH_FIdVerb 0.00 732.000000000 FORMAT "%13.9" NUMBER 50 /end CHARACTERISTIC
/begin CHARACTERISTIC DINH_FId.DFC_DSSmax_CA "inhibitable FIds / FIds to be inhibited by inhibit source DFC_DSSmax" VAL_BLK 0x804E6236 ValA_Wu16 732.000000000 DINH_FIdVerb 0.00 732.000000000 FORMAT "%13.9" NUMBER 50 /end CHARACTERISTIC
/begin CHARACTERISTIC DINH_FId.DFC_DSTTI_CA "inhibitable FIds / FIds to be inhibited by inhibit source DFC_DSTTI" VAL_BLK 0x804E629A ValA_Wu16 732.000000000 DINH_FIdVerb 0.00 732.000000000 FORMAT "%13.9" NUMBER 51 /end CHARACTERISTIC
/begin CHARACTERISTIC DINH_FId.DFC_DSUmax_CA "inhibitable FIds / FIds to be inhibited by inhibit source DFC_DSUmax" VAL_BLK 0x804E6300 ValA_Wu16 732.000000000 DINH_FIdVerb 0.00 732.000000000 FORMAT "%13.9" NUMBER 50 /end CHARACTERISTIC
/begin CHARACTERISTIC DINH_FId.DFC_EGRVlvOL_CA "inhibitable FIds / FIds to be inhibited by inhibit source DFC_EGRVlvOL" VAL_BLK 0x804E6364 ValA_Wu16 732.000000000 DINH_FIdVerb 0.00 732.000000000 FORMAT "%13.9" NUMBER 50 /end CHARACTERISTIC
/begin CHARACTERISTIC DINH_FId.DFC_EGRVlvSCB_CA "inhibitable FIds / FIds to be inhibited by inhibit source DFC_EGRVlvSCB" VAL_BLK 0x804E63C8 ValA_Wu16 732.000000000 DINH_FIdVerb 0.00 732.000000000 FORMAT "%13.9" NUMBER 50 /end CHARACTERISTIC
/begin CHARACTERISTIC DINH_FId.DFC_EGRVlvSCG_CA "inhibitable FIds / FIds to be inhibited by inhibit source DFC_EGRVlvSCG" VAL_BLK 0x804E642C ValA_Wu16 732.000000000 DINH_FIdVerb 0.00 732.000000000 FORMAT "%13.9" NUMBER 50 /end CHARACTERISTIC
/begin CHARACTERISTIC DINH_FId.DFC_EGSDUS2B1LtrDly_CA "inhibitable FIds / FIds to be inhibited by inhibit source DFC_EGSDUS2B1LtrDly" VAL_BLK 0x804E6490 ValA_Wu16 732.000000000 DINH_FIdVerb 0.00 732.000000000 FORMAT "%13.9" NUMBER 58 /end CHARACTERISTIC
/begin CHARACTERISTIC DINH_FId.DFC_EGSDUS2B1LtrPT1_CA "inhibitable FIds / FIds to be inhibited by inhibit source DFC_EGSDUS2B1LtrPT1" VAL_BLK 0x804E6504 ValA_Wu16 732.000000000 DINH_FIdVerb 0.00 732.000000000 FORMAT "%13.9" NUMBER 58 /end CHARACTERISTIC
/begin CHARACTERISTIC DINH_FId.DFC_EGSDUS2B1RtlDly_CA "inhibitable FIds / FIds to be inhibited by inhibit source DFC_EGSDUS2B1RtlDly" VAL_BLK 0x804E6578 ValA_Wu16 732.000000000 DINH_FIdVerb 0.00 732.000000000 FORMAT "%13.9" NUMBER 58 /end CHARACTERISTIC
/begin CHARACTERISTIC DINH_FId.DFC_EGSDUS2B1RtlPT1_CA "inhibitable FIds / FIds to be inhibited by inhibit source DFC_EGSDUS2B1RtlPT1" VAL_BLK 0x804E65EC ValA_Wu16 732.000000000 DINH_FIdVerb 0.00 732.000000000 FORMAT "%13.9" NUMBER 58 /end CHARACTERISTIC
/begin CHARACTERISTIC DINH_FId.DFC_EGSDUS2B1TarLean_CA "inhibitable FIds / FIds to be inhibited by inhibit source DFC_EGSDUS2B1TarLean" VAL_BLK 0x804E6660 ValA_Wu16 732.000000000 DINH_FIdVerb 0.00 732.000000000 FORMAT "%13.9" NUMBER 66 /end CHARACTERISTIC
/begin CHARACTERISTIC DINH_FId.DFC_EGSDUS2B1TarRich_CA "inhibitable FIds / FIds to be inhibited by inhibit source DFC_EGSDUS2B1TarRich" VAL_BLK 0x804E66E4 ValA_Wu16 732.000000000 DINH_FIdVerb 0.00 732.000000000 FORMAT "%13.9" NUMBER 66 /end CHARACTERISTIC
/begin CHARACTERISTIC DINH_FId.DFC_ETAKHLmax_CA "inhibitable FIds / FIds to be inhibited by inhibit source DFC_ETAKHLmax" VAL_BLK 0x804E6768 ValA_Wu16 732.000000000 DINH_FIdVerb 0.00 732.000000000 FORMAT "%13.9" NUMBER 50 /end CHARACTERISTIC
/begin CHARACTERISTIC DINH_FId.DFC_ETAKHTmax_CA "inhibitable FIds / FIds to be inhibited by inhibit source DFC_ETAKHTmax" VAL_BLK 0x804E67CC ValA_Wu16 732.000000000 DINH_FIdVerb 0.00 732.000000000 FORMAT "%13.9" NUMBER 50 /end CHARACTERISTIC
/begin CHARACTERISTIC DINH_FId.DFC_EngICO_CA "inhibitable FIds / FIds to be inhibited by inhibit source DFC_EngICO" VAL_BLK 0x804E6830 ValA_Wu16 732.000000000 DINH_FIdVerb 0.00 732.000000000 FORMAT "%13.9" NUMBER 50 /end CHARACTERISTIC
/begin CHARACTERISTIC DINH_FId.DFC_EngPrtOvrSpdMon_CA "inhibitable FIds / FIds to be inhibited by inhibit source DFC_EngPrtOvrSpdMon" VAL_BLK 0x804E6894 ValA_Wu16 732.000000000 DINH_FIdVerb 0.00 732.000000000 FORMAT "%13.9" NUMBER 50 /end CHARACTERISTIC
/begin CHARACTERISTIC DINH_FId.DFC_EpmCaSI1ErrSig_CA "inhibitable FIds / FIds to be inhibited by inhibit source DFC_EpmCaSI1ErrSig" VAL_BLK 0x804E68F8 ValA_Wu16 732.000000000 DINH_FIdVerb 0.00 732.000000000 FORMAT "%13.9" NUMBER 66 /end CHARACTERISTIC
/begin CHARACTERISTIC DINH_FId.DFC_EpmCaSI1NoSig_CA "inhibitable FIds / FIds to be inhibited by inhibit source DFC_EpmCaSI1NoSig" VAL_BLK 0x804E697C ValA_Wu16 732.000000000 DINH_FIdVerb 0.00 732.000000000 FORMAT "%13.9" NUMBER 57 /end CHARACTERISTIC
/begin CHARACTERISTIC DINH_FId.DFC_EpmCaSI1OfsErr_CA "inhibitable FIds / FIds to be inhibited by inhibit source DFC_EpmCaSI1OfsErr" VAL_BLK 0x804E69EE ValA_Wu16 732.000000000 DINH_FIdVerb 0.00 732.000000000 FORMAT "%13.9" NUMBER 72 /end CHARACTERISTIC
/begin CHARACTERISTIC DINH_FId.DFC_EpmCrSErrSig_CA "inhibitable FIds / FIds to be inhibited by inhibit source DFC_EpmCrSErrSig" VAL_BLK 0x804E6A7E ValA_Wu16 732.000000000 DINH_FIdVerb 0.00 732.000000000 FORMAT "%13.9" NUMBER 83 /end CHARACTERISTIC
/begin CHARACTERISTIC DINH_FId.DFC_EpmCrSNoSig_CA "inhibitable FIds / FIds to be inhibited by inhibit source DFC_EpmCrSNoSig" VAL_BLK 0x804E6B24 ValA_Wu16 732.000000000 DINH_FIdVerb 0.00 732.000000000 FORMAT "%13.9" NUMBER 88 /end CHARACTERISTIC
/begin CHARACTERISTIC DINH_FId.DFC_EtaEngIdleNonCsers_CA "inhibitable FIds / FIds to be inhibited by inhibit source DFC_EtaEngIdleNonCsers" VAL_BLK 0x804E6BD4 ValA_Wu16 732.000000000 DINH_FIdVerb 0.00 732.000000000 FORMAT "%13.9" NUMBER 50 /end CHARACTERISTIC
/begin CHARACTERISTIC DINH_FId.DFC_EtaEngPtlNonCsers_CA "inhibitable FIds / FIds to be inhibited by inhibit source DFC_EtaEngPtlNonCsers" VAL_BLK 0x804E6C38 ValA_Wu16 732.000000000 DINH_FIdVerb 0.00 732.000000000 FORMAT "%13.9" NUMBER 50 /end CHARACTERISTIC
/begin CHARACTERISTIC DINH_FId.DFC_FRAmax_CA "inhibitable FIds / FIds to be inhibited by inhibit source DFC_FRAmax" VAL_BLK 0x804E6C9C ValA_Wu16 732.000000000 DINH_FIdVerb 0.00 732.000000000 FORMAT "%13.9" NUMBER 69 /end CHARACTERISTIC
/begin CHARACTERISTIC DINH_FId.DFC_FRAmin_CA "inhibitable FIds / FIds to be inhibited by inhibit source DFC_FRAmin" VAL_BLK 0x804E6D26 ValA_Wu16 732.000000000 DINH_FIdVerb 0.00 732.000000000 FORMAT "%13.9" NUMBER 69 /end CHARACTERISTIC
/begin CHARACTERISTIC DINH_FId.DFC_GbxRvsSwtStk_CA "inhibitable FIds / FIds to be inhibited by inhibit source DFC_GbxRvsSwtStk" VAL_BLK 0x804E6DB0 ValA_Wu16 732.000000000 DINH_FIdVerb 0.00 732.000000000 FORMAT "%13.9" NUMBER 54 /end CHARACTERISTIC
/begin CHARACTERISTIC DINH_FId.DFC_HDRmax_CA "inhibitable FIds / FIds to be inhibited by inhibit source DFC_HDRmax" VAL_BLK 0x804E6E1C ValA_Wu16 732.000000000 DINH_FIdVerb 0.00 732.000000000 FORMAT "%13.9" NUMBER 59 /end CHARACTERISTIC
/begin CHARACTERISTIC DINH_FId.DFC_HEGOS2B1ElecMax_CA "inhibitable FIds / FIds to be inhibited by inhibit source DFC_HEGOS2B1ElecMax" VAL_BLK 0x804E6E92 ValA_Wu16 732.000000000 DINH_FIdVerb 0.00 732.000000000 FORMAT "%13.9" NUMBER 66 /end CHARACTERISTIC
/begin CHARACTERISTIC DINH_FId.DFC_HEGOS2B1ElecMin_CA "inhibitable FIds / FIds to be inhibited by inhibit source DFC_HEGOS2B1ElecMin" VAL_BLK 0x804E6F16 ValA_Wu16 732.000000000 DINH_FIdVerb 0.00 732.000000000 FORMAT "%13.9" NUMBER 66 /end CHARACTERISTIC
/begin CHARACTERISTIC DINH_FId.DFC_HEGOS2B1ElecSig_CA "inhibitable FIds / FIds to be inhibited by inhibit source DFC_HEGOS2B1ElecSig" VAL_BLK 0x804E6F9A ValA_Wu16 732.000000000 DINH_FIdVerb 0.00 732.000000000 FORMAT "%13.9" NUMBER 66 /end CHARACTERISTIC
/begin CHARACTERISTIC DINH_FId.DFC_HEGOS2B1HtgNpl_CA "inhibitable FIds / FIds to be inhibited by inhibit source DFC_HEGOS2B1HtgNpl" VAL_BLK 0x804E701E ValA_Wu16 732.000000000 DINH_FIdVerb 0.00 732.000000000 FORMAT "%13.9" NUMBER 64 /end CHARACTERISTIC
/begin CHARACTERISTIC DINH_FId.DFC_IntkAirTIntkMnfldCrssMax_CA "inhibitable FIds / FIds to be inhibited by inhibit source DFC_IntkAirTIntkMnfldCrssMax" VAL_BLK 0x804E709E ValA_Wu16 732.000000000 DINH_FIdVerb 0.00 732.000000000 FORMAT "%13.9" NUMBER 72 /end CHARACTERISTIC
/begin CHARACTERISTIC DINH_FId.DFC_IntkAirTIntkMnfldCrssMin_CA "inhibitable FIds / FIds to be inhibited by inhibit source DFC_IntkAirTIntkMnfldCrssMin" VAL_BLK 0x804E712E ValA_Wu16 732.000000000 DINH_FIdVerb 0.00 732.000000000 FORMAT "%13.9" NUMBER 72 /end CHARACTERISTIC
/begin CHARACTERISTIC DINH_FId.DFC_IntkAirTIntkMnfldHSCMax_CA "inhibitable FIds / FIds to be inhibited by inhibit source DFC_IntkAirTIntkMnfldHSCMax" VAL_BLK 0x804E71BE ValA_Wu16 732.000000000 DINH_FIdVerb 0.00 732.000000000 FORMAT "%13.9" NUMBER 69 /end CHARACTERISTIC
/begin CHARACTERISTIC DINH_FId.DFC_IntkAirTIntkMnfldImps_CA "inhibitable FIds / FIds to be inhibited by inhibit source DFC_IntkAirTIntkMnfldImps" VAL_BLK 0x804E7248 ValA_Wu16 732.000000000 DINH_FIdVerb 0.00 732.000000000 FORMAT "%13.9" NUMBER 78 /end CHARACTERISTIC
/begin CHARACTERISTIC DINH_FId.DFC_IntkAirTIntkMnfldPRCMax_CA "inhibitable FIds / FIds to be inhibited by inhibit source DFC_IntkAirTIntkMnfldPRCMax" VAL_BLK 0x804E72E4 ValA_Wu16 732.000000000 DINH_FIdVerb 0.00 732.000000000 FORMAT "%13.9" NUMBER 69 /end CHARACTERISTIC
/begin CHARACTERISTIC DINH_FId.DFC_IntkAirTIntkMnfldPRCMin_CA "inhibitable FIds / FIds to be inhibited by inhibit source DFC_IntkAirTIntkMnfldPRCMin" VAL_BLK 0x804E736E ValA_Wu16 732.000000000 DINH_FIdVerb 0.00 732.000000000 FORMAT "%13.9" NUMBER 68 /end CHARACTERISTIC
/begin CHARACTERISTIC DINH_FId.DFC_IntkAirTIntkMnfldSRCMax_CA "inhibitable FIds / FIds to be inhibited by inhibit source DFC_IntkAirTIntkMnfldSRCMax" VAL_BLK 0x804E73F6 ValA_Wu16 732.000000000 DINH_FIdVerb 0.00 732.000000000 FORMAT "%13.9" NUMBER 79 /end CHARACTERISTIC
/begin CHARACTERISTIC DINH_FId.DFC_IntkAirTIntkMnfldSRCMin_CA "inhibitable FIds / FIds to be inhibited by inhibit source DFC_IntkAirTIntkMnfldSRCMin" VAL_BLK 0x804E7494 ValA_Wu16 732.000000000 DINH_FIdVerb 0.00 732.000000000 FORMAT "%13.9" NUMBER 79 /end CHARACTERISTIC
/begin CHARACTERISTIC DINH_FId.DFC_IntkAirTIntkMnfldSTC_CA "inhibitable FIds / FIds to be inhibited by inhibit source DFC_IntkAirTIntkMnfldSTC" VAL_BLK 0x804E7532 ValA_Wu16 732.000000000 DINH_FIdVerb 0.00 732.000000000 FORMAT "%13.9" NUMBER 69 /end CHARACTERISTIC
/begin CHARACTERISTIC DINH_FId.DFC_KS1max_CA "inhibitable FIds / FIds to be inhibited by inhibit source DFC_KS1max" VAL_BLK 0x804E75BC ValA_Wu16 732.000000000 DINH_FIdVerb 0.00 732.000000000 FORMAT "%13.9" NUMBER 55 /end CHARACTERISTIC
/begin CHARACTERISTIC DINH_FId.DFC_KS1min_CA "inhibitable FIds / FIds to be inhibited by inhibit source DFC_KS1min" VAL_BLK 0x804E762A ValA_Wu16 732.000000000 DINH_FIdVerb 0.00 732.000000000 FORMAT "%13.9" NUMBER 55 /end CHARACTERISTIC
/begin CHARACTERISTIC DINH_FId.DFC_LMmax_CA "inhibitable FIds / FIds to be inhibited by inhibit source DFC_LMmax" VAL_BLK 0x804E7698 ValA_Wu16 732.000000000 DINH_FIdVerb 0.00 732.000000000 FORMAT "%13.9" NUMBER 58 /end CHARACTERISTIC
/begin CHARACTERISTIC DINH_FId.DFC_LZSRnpl_CA "inhibitable FIds / FIds to be inhibited by inhibit source DFC_LZSRnpl" VAL_BLK 0x804E770C ValA_Wu16 732.000000000 DINH_FIdVerb 0.00 732.000000000 FORMAT "%13.9" NUMBER 54 /end CHARACTERISTIC
/begin CHARACTERISTIC DINH_FId.DFC_LamDynDiagS1B1_CA "inhibitable FIds / FIds to be inhibited by inhibit source DFC_LamDynDiagS1B1" VAL_BLK 0x804E7778 ValA_Wu16 732.000000000 DINH_FIdVerb 0.00 732.000000000 FORMAT "%13.9" NUMBER 70 /end CHARACTERISTIC
/begin CHARACTERISTIC DINH_FId.DFC_LeakIntkMnfldEmiInfl_CA "inhibitable FIds / FIds to be inhibited by inhibit source DFC_LeakIntkMnfldEmiInfl" VAL_BLK 0x804E7804 ValA_Wu16 732.000000000 DINH_FIdVerb 0.00 732.000000000 FORMAT "%13.9" NUMBER 51 /end CHARACTERISTIC
/begin CHARACTERISTIC DINH_FId.DFC_MD00max_CA "inhibitable FIds / FIds to be inhibited by inhibit source DFC_MD00max" VAL_BLK 0x804E786A ValA_Wu16 732.000000000 DINH_FIdVerb 0.00 732.000000000 FORMAT "%13.9" NUMBER 50 /end CHARACTERISTIC
/begin CHARACTERISTIC DINH_FId.DFC_MDBmax_CA "inhibitable FIds / FIds to be inhibited by inhibit source DFC_MDBmax" VAL_BLK 0x804E78CE ValA_Wu16 732.000000000 DINH_FIdVerb 0.00 732.000000000 FORMAT "%13.9" NUMBER 57 /end CHARACTERISTIC
/begin CHARACTERISTIC DINH_FId.DFC_MDCat_CA "inhibitable FIds / FIds to be inhibited by inhibit source DFC_MDCat" VAL_BLK 0x804E7940 ValA_Wu16 732.000000000 DINH_FIdVerb 0.00 732.000000000 FORMAT "%13.9" NUMBER 50 /end CHARACTERISTIC
/begin CHARACTERISTIC DINH_FId.DFC_MDCatCrit_CA "inhibitable FIds / FIds to be inhibited by inhibit source DFC_MDCatCrit" VAL_BLK 0x804E79A4 ValA_Wu16 732.000000000 DINH_FIdVerb 0.00 732.000000000 FORMAT "%13.9" NUMBER 50 /end CHARACTERISTIC
/begin CHARACTERISTIC DINH_FId.DFC_MDCatCurr_CA "inhibitable FIds / FIds to be inhibited by inhibit source DFC_MDCatCurr" VAL_BLK 0x804E7A08 ValA_Wu16 732.000000000 DINH_FIdVerb 0.00 732.000000000 FORMAT "%13.9" NUMBER 53 /end CHARACTERISTIC
/begin CHARACTERISTIC DINH_FId.DFC_MDCyl_0_CA "inhibitable FIds / FIds to be inhibited by inhibit source DFC_MDCyl_0" VAL_BLK 0x804E7A72 ValA_Wu16 732.000000000 DINH_FIdVerb 0.00 732.000000000 FORMAT "%13.9" NUMBER 76 /end CHARACTERISTIC
/begin CHARACTERISTIC DINH_FId.DFC_MDCyl_1_CA "inhibitable FIds / FIds to be inhibited by inhibit source DFC_MDCyl_1" VAL_BLK 0x804E7B0A ValA_Wu16 732.000000000 DINH_FIdVerb 0.00 732.000000000 FORMAT "%13.9" NUMBER 76 /end CHARACTERISTIC
/begin CHARACTERISTIC DINH_FId.DFC_MDCyl_2_CA "inhibitable FIds / FIds to be inhibited by inhibit source DFC_MDCyl_2" VAL_BLK 0x804E7BA2 ValA_Wu16 732.000000000 DINH_FIdVerb 0.00 732.000000000 FORMAT "%13.9" NUMBER 76 /end CHARACTERISTIC
/begin CHARACTERISTIC DINH_FId.DFC_MDCyl_3_CA "inhibitable FIds / FIds to be inhibited by inhibit source DFC_MDCyl_3" VAL_BLK 0x804E7C3A ValA_Wu16 732.000000000 DINH_FIdVerb 0.00 732.000000000 FORMAT "%13.9" NUMBER 76 /end CHARACTERISTIC
/begin CHARACTERISTIC DINH_FId.DFC_MDEmi_CA "inhibitable FIds / FIds to be inhibited by inhibit source DFC_MDEmi" VAL_BLK 0x804E7CD2 ValA_Wu16 732.000000000 DINH_FIdVerb 0.00 732.000000000 FORMAT "%13.9" NUMBER 50 /end CHARACTERISTIC
/begin CHARACTERISTIC DINH_FId.DFC_MDEmiStrt_CA "inhibitable FIds / FIds to be inhibited by inhibit source DFC_MDEmiStrt" VAL_BLK 0x804E7D36 ValA_Wu16 732.000000000 DINH_FIdVerb 0.00 732.000000000 FORMAT "%13.9" NUMBER 50 /end CHARACTERISTIC
/begin CHARACTERISTIC DINH_FId.DFC_MDFco_CA "inhibitable FIds / FIds to be inhibited by inhibit source DFC_MDFco" VAL_BLK 0x804E7D9A ValA_Wu16 732.000000000 DINH_FIdVerb 0.00 732.000000000 FORMAT "%13.9" NUMBER 54 /end CHARACTERISTIC
/begin CHARACTERISTIC DINH_FId.DFC_MDMpl_CA "inhibitable FIds / FIds to be inhibited by inhibit source DFC_MDMpl" VAL_BLK 0x804E7E06 ValA_Wu16 732.000000000 DINH_FIdVerb 0.00 732.000000000 FORMAT "%13.9" NUMBER 76 /end CHARACTERISTIC
/begin CHARACTERISTIC DINH_FId.DFC_MDSegTiAdpn_CA "inhibitable FIds / FIds to be inhibited by inhibit source DFC_MDSegTiAdpn" VAL_BLK 0x804E7E9E ValA_Wu16 732.000000000 DINH_FIdVerb 0.00 732.000000000 FORMAT "%13.9" NUMBER 50 /end CHARACTERISTIC
/begin CHARACTERISTIC DINH_FId.DFC_MDmax_CA "inhibitable FIds / FIds to be inhibited by inhibit source DFC_MDmax" VAL_BLK 0x804E7F02 ValA_Wu16 732.000000000 DINH_FIdVerb 0.00 732.000000000 FORMAT "%13.9" NUMBER 50 /end CHARACTERISTIC
/begin CHARACTERISTIC DINH_FId.DFC_MOXEMM_SMU_ALM0_0_CA "inhibitable FIds / FIds to be inhibited by inhibit source DFC_MOXEMM_SMU_ALM0_0" VAL_BLK 0x804E7F66 ValA_Wu16 732.000000000 DINH_FIdVerb 0.00 732.000000000 FORMAT "%13.9" NUMBER 50 /end CHARACTERISTIC
/begin CHARACTERISTIC DINH_FId.DFC_MOXEMM_SMU_ALM0_1_CA "inhibitable FIds / FIds to be inhibited by inhibit source DFC_MOXEMM_SMU_ALM0_1" VAL_BLK 0x804E7FCA ValA_Wu16 732.000000000 DINH_FIdVerb 0.00 732.000000000 FORMAT "%13.9" NUMBER 50 /end CHARACTERISTIC
/begin CHARACTERISTIC DINH_FId.DFC_MOXEMM_SMU_ALM0_10_CA "inhibitable FIds / FIds to be inhibited by inhibit source DFC_MOXEMM_SMU_ALM0_10" VAL_BLK 0x804E802E ValA_Wu16 732.000000000 DINH_FIdVerb 0.00 732.000000000 FORMAT "%13.9" NUMBER 50 /end CHARACTERISTIC
/begin CHARACTERISTIC DINH_FId.DFC_MOXEMM_SMU_ALM0_11_CA "inhibitable FIds / FIds to be inhibited by inhibit source DFC_MOXEMM_SMU_ALM0_11" VAL_BLK 0x804E8092 ValA_Wu16 732.000000000 DINH_FIdVerb 0.00 732.000000000 FORMAT "%13.9" NUMBER 50 /end CHARACTERISTIC
/begin CHARACTERISTIC DINH_FId.DFC_MOXEMM_SMU_ALM0_13_CA "inhibitable FIds / FIds to be inhibited by inhibit source DFC_MOXEMM_SMU_ALM0_13" VAL_BLK 0x804E80F6 ValA_Wu16 732.000000000 DINH_FIdVerb 0.00 732.000000000 FORMAT "%13.9" NUMBER 50 /end CHARACTERISTIC
/begin CHARACTERISTIC DINH_FId.DFC_MOXEMM_SMU_ALM0_14_CA "inhibitable FIds / FIds to be inhibited by inhibit source DFC_MOXEMM_SMU_ALM0_14" VAL_BLK 0x804E815A ValA_Wu16 732.000000000 DINH_FIdVerb 0.00 732.000000000 FORMAT "%13.9" NUMBER 50 /end CHARACTERISTIC
/begin CHARACTERISTIC DINH_FId.DFC_MOXEMM_SMU_ALM0_2_CA "inhibitable FIds / FIds to be inhibited by inhibit source DFC_MOXEMM_SMU_ALM0_2" VAL_BLK 0x804E81BE ValA_Wu16 732.000000000 DINH_FIdVerb 0.00 732.000000000 FORMAT "%13.9" NUMBER 50 /end CHARACTERISTIC
/begin CHARACTERISTIC DINH_FId.DFC_MOXEMM_SMU_ALM0_22_CA "inhibitable FIds / FIds to be inhibited by inhibit source DFC_MOXEMM_SMU_ALM0_22" VAL_BLK 0x804E8222 ValA_Wu16 732.000000000 DINH_FIdVerb 0.00 732.000000000 FORMAT "%13.9" NUMBER 50 /end CHARACTERISTIC
/begin CHARACTERISTIC DINH_FId.DFC_MOXEMM_SMU_ALM0_23_CA "inhibitable FIds / FIds to be inhibited by inhibit source DFC_MOXEMM_SMU_ALM0_23" VAL_BLK 0x804E8286 ValA_Wu16 732.000000000 DINH_FIdVerb 0.00 732.000000000 FORMAT "%13.9" NUMBER 50 /end CHARACTERISTIC
/begin CHARACTERISTIC DINH_FId.DFC_MOXEMM_SMU_ALM0_4_CA "inhibitable FIds / FIds to be inhibited by inhibit source DFC_MOXEMM_SMU_ALM0_4" VAL_BLK 0x804E82EA ValA_Wu16 732.000000000 DINH_FIdVerb 0.00 732.000000000 FORMAT "%13.9" NUMBER 50 /end CHARACTERISTIC
/begin CHARACTERISTIC DINH_FId.DFC_MOXEMM_SMU_ALM0_5_CA "inhibitable FIds / FIds to be inhibited by inhibit source DFC_MOXEMM_SMU_ALM0_5" VAL_BLK 0x804E834E ValA_Wu16 732.000000000 DINH_FIdVerb 0.00 732.000000000 FORMAT "%13.9" NUMBER 50 /end CHARACTERISTIC
/begin CHARACTERISTIC DINH_FId.DFC_MOXEMM_SMU_ALM0_7_CA "inhibitable FIds / FIds to be inhibited by inhibit source DFC_MOXEMM_SMU_ALM0_7" VAL_BLK 0x804E83B2 ValA_Wu16 732.000000000 DINH_FIdVerb 0.00 732.000000000 FORMAT "%13.9" NUMBER 50 /end CHARACTERISTIC
/begin CHARACTERISTIC DINH_FId.DFC_MOXEMM_SMU_ALM0_8_CA "inhibitable FIds / FIds to be inhibited by inhibit source DFC_MOXEMM_SMU_ALM0_8" VAL_BLK 0x804E8416 ValA_Wu16 732.000000000 DINH_FIdVerb 0.00 732.000000000 FORMAT "%13.9" NUMBER 50 /end CHARACTERISTIC
/begin CHARACTERISTIC DINH_FId.DFC_MOXEMM_SMU_ALM10_16_CA "inhibitable FIds / FIds to be inhibited by inhibit source DFC_MOXEMM_SMU_ALM10_16" VAL_BLK 0x804E847A ValA_Wu16 732.000000000 DINH_FIdVerb 0.00 732.000000000 FORMAT "%13.9" NUMBER 50 /end CHARACTERISTIC
/begin CHARACTERISTIC DINH_FId.DFC_MOXEMM_SMU_ALM10_17_CA "inhibitable FIds / FIds to be inhibited by inhibit source DFC_MOXEMM_SMU_ALM10_17" VAL_BLK 0x804E84DE ValA_Wu16 732.000000000 DINH_FIdVerb 0.00 732.000000000 FORMAT "%13.9" NUMBER 50 /end CHARACTERISTIC
/begin CHARACTERISTIC DINH_FId.DFC_MOXEMM_SMU_ALM10_21_CA "inhibitable FIds / FIds to be inhibited by inhibit source DFC_MOXEMM_SMU_ALM10_21" VAL_BLK 0x804E8542 ValA_Wu16 732.000000000 DINH_FIdVerb 0.00 732.000000000 FORMAT "%13.9" NUMBER 50 /end CHARACTERISTIC
/begin CHARACTERISTIC DINH_FId.DFC_MOXEMM_SMU_ALM11_0_CA "inhibitable FIds / FIds to be inhibited by inhibit source DFC_MOXEMM_SMU_ALM11_0" VAL_BLK 0x804E85A6 ValA_Wu16 732.000000000 DINH_FIdVerb 0.00 732.000000000 FORMAT "%13.9" NUMBER 50 /end CHARACTERISTIC
/begin CHARACTERISTIC DINH_FId.DFC_MOXEMM_SMU_ALM11_1_CA "inhibitable FIds / FIds to be inhibited by inhibit source DFC_MOXEMM_SMU_ALM11_1" VAL_BLK 0x804E860A ValA_Wu16 732.000000000 DINH_FIdVerb 0.00 732.000000000 FORMAT "%13.9" NUMBER 50 /end CHARACTERISTIC
/begin CHARACTERISTIC DINH_FId.DFC_MOXEMM_SMU_ALM11_2_CA "inhibitable FIds / FIds to be inhibited by inhibit source DFC_MOXEMM_SMU_ALM11_2" VAL_BLK 0x804E866E ValA_Wu16 732.000000000 DINH_FIdVerb 0.00 732.000000000 FORMAT "%13.9" NUMBER 50 /end CHARACTERISTIC
/begin CHARACTERISTIC DINH_FId.DFC_MOXEMM_SMU_ALM11_3_CA "inhibitable FIds / FIds to be inhibited by inhibit source DFC_MOXEMM_SMU_ALM11_3" VAL_BLK 0x804E86D2 ValA_Wu16 732.000000000 DINH_FIdVerb 0.00 732.000000000 FORMAT "%13.9" NUMBER 50 /end CHARACTERISTIC
/begin CHARACTERISTIC DINH_FId.DFC_MOXEMM_SMU_ALM11_4_CA "inhibitable FIds / FIds to be inhibited by inhibit source DFC_MOXEMM_SMU_ALM11_4" VAL_BLK 0x804E8736 ValA_Wu16 732.000000000 DINH_FIdVerb 0.00 732.000000000 FORMAT "%13.9" NUMBER 50 /end CHARACTERISTIC
/begin CHARACTERISTIC DINH_FId.DFC_MOXEMM_SMU_ALM11_5_CA "inhibitable FIds / FIds to be inhibited by inhibit source DFC_MOXEMM_SMU_ALM11_5" VAL_BLK 0x804E879A ValA_Wu16 732.000000000 DINH_FIdVerb 0.00 732.000000000 FORMAT "%13.9" NUMBER 50 /end CHARACTERISTIC
/begin CHARACTERISTIC DINH_FId.DFC_MOXEMM_SMU_ALM11_8_CA "inhibitable FIds / FIds to be inhibited by inhibit source DFC_MOXEMM_SMU_ALM11_8" VAL_BLK 0x804E87FE ValA_Wu16 732.000000000 DINH_FIdVerb 0.00 732.000000000 FORMAT "%13.9" NUMBER 50 /end CHARACTERISTIC
/begin CHARACTERISTIC DINH_FId.DFC_MOXEMM_SMU_ALM11_9_CA "inhibitable FIds / FIds to be inhibited by inhibit source DFC_MOXEMM_SMU_ALM11_9" VAL_BLK 0x804E8862 ValA_Wu16 732.000000000 DINH_FIdVerb 0.00 732.000000000 FORMAT "%13.9" NUMBER 50 /end CHARACTERISTIC
/begin CHARACTERISTIC DINH_FId.DFC_MOXEMM_SMU_ALM1_0_CA "inhibitable FIds / FIds to be inhibited by inhibit source DFC_MOXEMM_SMU_ALM1_0" VAL_BLK 0x804E88C6 ValA_Wu16 732.000000000 DINH_FIdVerb 0.00 732.000000000 FORMAT "%13.9" NUMBER 50 /end CHARACTERISTIC
/begin CHARACTERISTIC DINH_FId.DFC_MOXEMM_SMU_ALM1_1_CA "inhibitable FIds / FIds to be inhibited by inhibit source DFC_MOXEMM_SMU_ALM1_1" VAL_BLK 0x804E892A ValA_Wu16 732.000000000 DINH_FIdVerb 0.00 732.000000000 FORMAT "%13.9" NUMBER 50 /end CHARACTERISTIC
/begin CHARACTERISTIC DINH_FId.DFC_MOXEMM_SMU_ALM1_10_CA "inhibitable FIds / FIds to be inhibited by inhibit source DFC_MOXEMM_SMU_ALM1_10" VAL_BLK 0x804E898E ValA_Wu16 732.000000000 DINH_FIdVerb 0.00 732.000000000 FORMAT "%13.9" NUMBER 50 /end CHARACTERISTIC
/begin CHARACTERISTIC DINH_FId.DFC_MOXEMM_SMU_ALM1_11_CA "inhibitable FIds / FIds to be inhibited by inhibit source DFC_MOXEMM_SMU_ALM1_11" VAL_BLK 0x804E89F2 ValA_Wu16 732.000000000 DINH_FIdVerb 0.00 732.000000000 FORMAT "%13.9" NUMBER 50 /end CHARACTERISTIC
/begin CHARACTERISTIC DINH_FId.DFC_MOXEMM_SMU_ALM1_13_CA "inhibitable FIds / FIds to be inhibited by inhibit source DFC_MOXEMM_SMU_ALM1_13" VAL_BLK 0x804E8A56 ValA_Wu16 732.000000000 DINH_FIdVerb 0.00 732.000000000 FORMAT "%13.9" NUMBER 50 /end CHARACTERISTIC
/begin CHARACTERISTIC DINH_FId.DFC_MOXEMM_SMU_ALM1_14_CA "inhibitable FIds / FIds to be inhibited by inhibit source DFC_MOXEMM_SMU_ALM1_14" VAL_BLK 0x804E8ABA ValA_Wu16 732.000000000 DINH_FIdVerb 0.00 732.000000000 FORMAT "%13.9" NUMBER 50 /end CHARACTERISTIC
/begin CHARACTERISTIC DINH_FId.DFC_MOXEMM_SMU_ALM1_2_CA "inhibitable FIds / FIds to be inhibited by inhibit source DFC_MOXEMM_SMU_ALM1_2" VAL_BLK 0x804E8B1E ValA_Wu16 732.000000000 DINH_FIdVerb 0.00 732.000000000 FORMAT "%13.9" NUMBER 50 /end CHARACTERISTIC
/begin CHARACTERISTIC DINH_FId.DFC_MOXEMM_SMU_ALM1_22_CA "inhibitable FIds / FIds to be inhibited by inhibit source DFC_MOXEMM_SMU_ALM1_22" VAL_BLK 0x804E8B82 ValA_Wu16 732.000000000 DINH_FIdVerb 0.00 732.000000000 FORMAT "%13.9" NUMBER 50 /end CHARACTERISTIC
/begin CHARACTERISTIC DINH_FId.DFC_MOXEMM_SMU_ALM1_23_CA "inhibitable FIds / FIds to be inhibited by inhibit source DFC_MOXEMM_SMU_ALM1_23" VAL_BLK 0x804E8BE6 ValA_Wu16 732.000000000 DINH_FIdVerb 0.00 732.000000000 FORMAT "%13.9" NUMBER 50 /end CHARACTERISTIC
/begin CHARACTERISTIC DINH_FId.DFC_MOXEMM_SMU_ALM1_4_CA "inhibitable FIds / FIds to be inhibited by inhibit source DFC_MOXEMM_SMU_ALM1_4" VAL_BLK 0x804E8C4A ValA_Wu16 732.000000000 DINH_FIdVerb 0.00 732.000000000 FORMAT "%13.9" NUMBER 50 /end CHARACTERISTIC
/begin CHARACTERISTIC DINH_FId.DFC_MOXEMM_SMU_ALM1_5_CA "inhibitable FIds / FIds to be inhibited by inhibit source DFC_MOXEMM_SMU_ALM1_5" VAL_BLK 0x804E8CAE ValA_Wu16 732.000000000 DINH_FIdVerb 0.00 732.000000000 FORMAT "%13.9" NUMBER 50 /end CHARACTERISTIC
/begin CHARACTERISTIC DINH_FId.DFC_MOXEMM_SMU_ALM1_7_CA "inhibitable FIds / FIds to be inhibited by inhibit source DFC_MOXEMM_SMU_ALM1_7" VAL_BLK 0x804E8D12 ValA_Wu16 732.000000000 DINH_FIdVerb 0.00 732.000000000 FORMAT "%13.9" NUMBER 50 /end CHARACTERISTIC
/begin CHARACTERISTIC DINH_FId.DFC_MOXEMM_SMU_ALM1_8_CA "inhibitable FIds / FIds to be inhibited by inhibit source DFC_MOXEMM_SMU_ALM1_8" VAL_BLK 0x804E8D76 ValA_Wu16 732.000000000 DINH_FIdVerb 0.00 732.000000000 FORMAT "%13.9" NUMBER 50 /end CHARACTERISTIC
/begin CHARACTERISTIC DINH_FId.DFC_MOXEMM_SMU_ALM21_0_CA "inhibitable FIds / FIds to be inhibited by inhibit source DFC_MOXEMM_SMU_ALM21_0" VAL_BLK 0x804E8DDA ValA_Wu16 732.000000000 DINH_FIdVerb 0.00 732.000000000 FORMAT "%13.9" NUMBER 50 /end CHARACTERISTIC
/begin CHARACTERISTIC DINH_FId.DFC_MOXEMM_SMU_ALM21_16_CA "inhibitable FIds / FIds to be inhibited by inhibit source DFC_MOXEMM_SMU_ALM21_16" VAL_BLK 0x804E8E3E ValA_Wu16 732.000000000 DINH_FIdVerb 0.00 732.000000000 FORMAT "%13.9" NUMBER 50 /end CHARACTERISTIC
/begin CHARACTERISTIC DINH_FId.DFC_MOXEMM_SMU_ALM21_3_CA "inhibitable FIds / FIds to be inhibited by inhibit source DFC_MOXEMM_SMU_ALM21_3" VAL_BLK 0x804E8EA2 ValA_Wu16 732.000000000 DINH_FIdVerb 0.00 732.000000000 FORMAT "%13.9" NUMBER 50 /end CHARACTERISTIC
/begin CHARACTERISTIC DINH_FId.DFC_MOXEMM_SMU_ALM2_1_CA "inhibitable FIds / FIds to be inhibited by inhibit source DFC_MOXEMM_SMU_ALM2_1" VAL_BLK 0x804E8F06 ValA_Wu16 732.000000000 DINH_FIdVerb 0.00 732.000000000 FORMAT "%13.9" NUMBER 50 /end CHARACTERISTIC
/begin CHARACTERISTIC DINH_FId.DFC_MOXEMM_SMU_ALM2_10_CA "inhibitable FIds / FIds to be inhibited by inhibit source DFC_MOXEMM_SMU_ALM2_10" VAL_BLK 0x804E8F6A ValA_Wu16 732.000000000 DINH_FIdVerb 0.00 732.000000000 FORMAT "%13.9" NUMBER 50 /end CHARACTERISTIC
/begin CHARACTERISTIC DINH_FId.DFC_MOXEMM_SMU_ALM2_11_CA "inhibitable FIds / FIds to be inhibited by inhibit source DFC_MOXEMM_SMU_ALM2_11" VAL_BLK 0x804E8FCE ValA_Wu16 732.000000000 DINH_FIdVerb 0.00 732.000000000 FORMAT "%13.9" NUMBER 50 /end CHARACTERISTIC
/begin CHARACTERISTIC DINH_FId.DFC_MOXEMM_SMU_ALM2_13_CA "inhibitable FIds / FIds to be inhibited by inhibit source DFC_MOXEMM_SMU_ALM2_13" VAL_BLK 0x804E9032 ValA_Wu16 732.000000000 DINH_FIdVerb 0.00 732.000000000 FORMAT "%13.9" NUMBER 50 /end CHARACTERISTIC
/begin CHARACTERISTIC DINH_FId.DFC_MOXEMM_SMU_ALM2_14_CA "inhibitable FIds / FIds to be inhibited by inhibit source DFC_MOXEMM_SMU_ALM2_14" VAL_BLK 0x804E9096 ValA_Wu16 732.000000000 DINH_FIdVerb 0.00 732.000000000 FORMAT "%13.9" NUMBER 50 /end CHARACTERISTIC
/begin CHARACTERISTIC DINH_FId.DFC_MOXEMM_SMU_ALM2_22_CA "inhibitable FIds / FIds to be inhibited by inhibit source DFC_MOXEMM_SMU_ALM2_22" VAL_BLK 0x804E90FA ValA_Wu16 732.000000000 DINH_FIdVerb 0.00 732.000000000 FORMAT "%13.9" NUMBER 50 /end CHARACTERISTIC
/begin CHARACTERISTIC DINH_FId.DFC_MOXEMM_SMU_ALM2_23_CA "inhibitable FIds / FIds to be inhibited by inhibit source DFC_MOXEMM_SMU_ALM2_23" VAL_BLK 0x804E915E ValA_Wu16 732.000000000 DINH_FIdVerb 0.00 732.000000000 FORMAT "%13.9" NUMBER 50 /end CHARACTERISTIC
/begin CHARACTERISTIC DINH_FId.DFC_MOXEMM_SMU_ALM2_4_CA "inhibitable FIds / FIds to be inhibited by inhibit source DFC_MOXEMM_SMU_ALM2_4" VAL_BLK 0x804E91C2 ValA_Wu16 732.000000000 DINH_FIdVerb 0.00 732.000000000 FORMAT "%13.9" NUMBER 50 /end CHARACTERISTIC
/begin CHARACTERISTIC DINH_FId.DFC_MOXEMM_SMU_ALM2_5_CA "inhibitable FIds / FIds to be inhibited by inhibit source DFC_MOXEMM_SMU_ALM2_5" VAL_BLK 0x804E9226 ValA_Wu16 732.000000000 DINH_FIdVerb 0.00 732.000000000 FORMAT "%13.9" NUMBER 50 /end CHARACTERISTIC
/begin CHARACTERISTIC DINH_FId.DFC_MOXEMM_SMU_ALM2_7_CA "inhibitable FIds / FIds to be inhibited by inhibit source DFC_MOXEMM_SMU_ALM2_7" VAL_BLK 0x804E928A ValA_Wu16 732.000000000 DINH_FIdVerb 0.00 732.000000000 FORMAT "%13.9" NUMBER 50 /end CHARACTERISTIC
/begin CHARACTERISTIC DINH_FId.DFC_MOXEMM_SMU_ALM2_8_CA "inhibitable FIds / FIds to be inhibited by inhibit source DFC_MOXEMM_SMU_ALM2_8" VAL_BLK 0x804E92EE ValA_Wu16 732.000000000 DINH_FIdVerb 0.00 732.000000000 FORMAT "%13.9" NUMBER 50 /end CHARACTERISTIC
/begin CHARACTERISTIC DINH_FId.DFC_MOXEMM_SMU_ALM6_0_CA "inhibitable FIds / FIds to be inhibited by inhibit source DFC_MOXEMM_SMU_ALM6_0" VAL_BLK 0x804E9352 ValA_Wu16 732.000000000 DINH_FIdVerb 0.00 732.000000000 FORMAT "%13.9" NUMBER 50 /end CHARACTERISTIC
/begin CHARACTERISTIC DINH_FId.DFC_MOXEMM_SMU_ALM6_11_CA "inhibitable FIds / FIds to be inhibited by inhibit source DFC_MOXEMM_SMU_ALM6_11" VAL_BLK 0x804E93B6 ValA_Wu16 732.000000000 DINH_FIdVerb 0.00 732.000000000 FORMAT "%13.9" NUMBER 50 /end CHARACTERISTIC
/begin CHARACTERISTIC DINH_FId.DFC_MOXEMM_SMU_ALM6_12_CA "inhibitable FIds / FIds to be inhibited by inhibit source DFC_MOXEMM_SMU_ALM6_12" VAL_BLK 0x804E941A ValA_Wu16 732.000000000 DINH_FIdVerb 0.00 732.000000000 FORMAT "%13.9" NUMBER 50 /end CHARACTERISTIC
/begin CHARACTERISTIC DINH_FId.DFC_MOXEMM_SMU_ALM6_14_CA "inhibitable FIds / FIds to be inhibited by inhibit source DFC_MOXEMM_SMU_ALM6_14" VAL_BLK 0x804E947E ValA_Wu16 732.000000000 DINH_FIdVerb 0.00 732.000000000 FORMAT "%13.9" NUMBER 50 /end CHARACTERISTIC
/begin CHARACTERISTIC DINH_FId.DFC_MOXEMM_SMU_ALM6_15_CA "inhibitable FIds / FIds to be inhibited by inhibit source DFC_MOXEMM_SMU_ALM6_15" VAL_BLK 0x804E94E2 ValA_Wu16 732.000000000 DINH_FIdVerb 0.00 732.000000000 FORMAT "%13.9" NUMBER 50 /end CHARACTERISTIC
/begin CHARACTERISTIC DINH_FId.DFC_MOXEMM_SMU_ALM6_17_CA "inhibitable FIds / FIds to be inhibited by inhibit source DFC_MOXEMM_SMU_ALM6_17" VAL_BLK 0x804E9546 ValA_Wu16 732.000000000 DINH_FIdVerb 0.00 732.000000000 FORMAT "%13.9" NUMBER 50 /end CHARACTERISTIC
/begin CHARACTERISTIC DINH_FId.DFC_MOXEMM_SMU_ALM6_18_CA "inhibitable FIds / FIds to be inhibited by inhibit source DFC_MOXEMM_SMU_ALM6_18" VAL_BLK 0x804E95AA ValA_Wu16 732.000000000 DINH_FIdVerb 0.00 732.000000000 FORMAT "%13.9" NUMBER 50 /end CHARACTERISTIC
/begin CHARACTERISTIC DINH_FId.DFC_MOXEMM_SMU_ALM6_20_CA "inhibitable FIds / FIds to be inhibited by inhibit source DFC_MOXEMM_SMU_ALM6_20" VAL_BLK 0x804E960E ValA_Wu16 732.000000000 DINH_FIdVerb 0.00 732.000000000 FORMAT "%13.9" NUMBER 50 /end CHARACTERISTIC
/begin CHARACTERISTIC DINH_FId.DFC_MOXEMM_SMU_ALM6_21_CA "inhibitable FIds / FIds to be inhibited by inhibit source DFC_MOXEMM_SMU_ALM6_21" VAL_BLK 0x804E9672 ValA_Wu16 732.000000000 DINH_FIdVerb 0.00 732.000000000 FORMAT "%13.9" NUMBER 50 /end CHARACTERISTIC
/begin CHARACTERISTIC DINH_FId.DFC_MOXEMM_SMU_ALM6_25_CA "inhibitable FIds / FIds to be inhibited by inhibit source DFC_MOXEMM_SMU_ALM6_25" VAL_BLK 0x804E96D6 ValA_Wu16 732.000000000 DINH_FIdVerb 0.00 732.000000000 FORMAT "%13.9" NUMBER 50 /end CHARACTERISTIC
/begin CHARACTERISTIC DINH_FId.DFC_MOXEMM_SMU_ALM6_4_CA "inhibitable FIds / FIds to be inhibited by inhibit source DFC_MOXEMM_SMU_ALM6_4" VAL_BLK 0x804E973A ValA_Wu16 732.000000000 DINH_FIdVerb 0.00 732.000000000 FORMAT "%13.9" NUMBER 50 /end CHARACTERISTIC
/begin CHARACTERISTIC DINH_FId.DFC_MOXEMM_SMU_ALM6_5_CA "inhibitable FIds / FIds to be inhibited by inhibit source DFC_MOXEMM_SMU_ALM6_5" VAL_BLK 0x804E979E ValA_Wu16 732.000000000 DINH_FIdVerb 0.00 732.000000000 FORMAT "%13.9" NUMBER 50 /end CHARACTERISTIC
/begin CHARACTERISTIC DINH_FId.DFC_MOXEMM_SMU_ALM6_7_CA "inhibitable FIds / FIds to be inhibited by inhibit source DFC_MOXEMM_SMU_ALM6_7" VAL_BLK 0x804E9802 ValA_Wu16 732.000000000 DINH_FIdVerb 0.00 732.000000000 FORMAT "%13.9" NUMBER 50 /end CHARACTERISTIC
/begin CHARACTERISTIC DINH_FId.DFC_MOXEMM_SMU_ALM6_8_CA "inhibitable FIds / FIds to be inhibited by inhibit source DFC_MOXEMM_SMU_ALM6_8" VAL_BLK 0x804E9866 ValA_Wu16 732.000000000 DINH_FIdVerb 0.00 732.000000000 FORMAT "%13.9" NUMBER 50 /end CHARACTERISTIC
/begin CHARACTERISTIC DINH_FId.DFC_MOXEMM_SMU_ALM7_1_CA "inhibitable FIds / FIds to be inhibited by inhibit source DFC_MOXEMM_SMU_ALM7_1" VAL_BLK 0x804E98CA ValA_Wu16 732.000000000 DINH_FIdVerb 0.00 732.000000000 FORMAT "%13.9" NUMBER 50 /end CHARACTERISTIC
/begin CHARACTERISTIC DINH_FId.DFC_MOXEMM_SMU_ALM7_12_CA "inhibitable FIds / FIds to be inhibited by inhibit source DFC_MOXEMM_SMU_ALM7_12" VAL_BLK 0x804E992E ValA_Wu16 732.000000000 DINH_FIdVerb 0.00 732.000000000 FORMAT "%13.9" NUMBER 50 /end CHARACTERISTIC
/begin CHARACTERISTIC DINH_FId.DFC_MOXEMM_SMU_ALM7_13_CA "inhibitable FIds / FIds to be inhibited by inhibit source DFC_MOXEMM_SMU_ALM7_13" VAL_BLK 0x804E9992 ValA_Wu16 732.000000000 DINH_FIdVerb 0.00 732.000000000 FORMAT "%13.9" NUMBER 50 /end CHARACTERISTIC
/begin CHARACTERISTIC DINH_FId.DFC_MOXEMM_SMU_ALM7_14_CA "inhibitable FIds / FIds to be inhibited by inhibit source DFC_MOXEMM_SMU_ALM7_14" VAL_BLK 0x804E99F6 ValA_Wu16 732.000000000 DINH_FIdVerb 0.00 732.000000000 FORMAT "%13.9" NUMBER 50 /end CHARACTERISTIC
/begin CHARACTERISTIC DINH_FId.DFC_MOXEMM_SMU_ALM7_15_CA "inhibitable FIds / FIds to be inhibited by inhibit source DFC_MOXEMM_SMU_ALM7_15" VAL_BLK 0x804E9A5A ValA_Wu16 732.000000000 DINH_FIdVerb 0.00 732.000000000 FORMAT "%13.9" NUMBER 50 /end CHARACTERISTIC
/begin CHARACTERISTIC DINH_FId.DFC_MOXEMM_SMU_ALM7_16_CA "inhibitable FIds / FIds to be inhibited by inhibit source DFC_MOXEMM_SMU_ALM7_16" VAL_BLK 0x804E9ABE ValA_Wu16 732.000000000 DINH_FIdVerb 0.00 732.000000000 FORMAT "%13.9" NUMBER 50 /end CHARACTERISTIC
/begin CHARACTERISTIC DINH_FId.DFC_MOXEMM_SMU_ALM7_17_CA "inhibitable FIds / FIds to be inhibited by inhibit source DFC_MOXEMM_SMU_ALM7_17" VAL_BLK 0x804E9B22 ValA_Wu16 732.000000000 DINH_FIdVerb 0.00 732.000000000 FORMAT "%13.9" NUMBER 50 /end CHARACTERISTIC
/begin CHARACTERISTIC DINH_FId.DFC_MOXEMM_SMU_ALM7_2_CA "inhibitable FIds / FIds to be inhibited by inhibit source DFC_MOXEMM_SMU_ALM7_2" VAL_BLK 0x804E9B86 ValA_Wu16 732.000000000 DINH_FIdVerb 0.00 732.000000000 FORMAT "%13.9" NUMBER 50 /end CHARACTERISTIC
/begin CHARACTERISTIC DINH_FId.DFC_MOXEMM_SMU_ALM7_20_CA "inhibitable FIds / FIds to be inhibited by inhibit source DFC_MOXEMM_SMU_ALM7_20" VAL_BLK 0x804E9BEA ValA_Wu16 732.000000000 DINH_FIdVerb 0.00 732.000000000 FORMAT "%13.9" NUMBER 50 /end CHARACTERISTIC
/begin CHARACTERISTIC DINH_FId.DFC_MOXEMM_SMU_ALM7_25_CA "inhibitable FIds / FIds to be inhibited by inhibit source DFC_MOXEMM_SMU_ALM7_25" VAL_BLK 0x804E9C4E ValA_Wu16 732.000000000 DINH_FIdVerb 0.00 732.000000000 FORMAT "%13.9" NUMBER 50 /end CHARACTERISTIC
/begin CHARACTERISTIC DINH_FId.DFC_MOXEMM_SMU_ALM7_26_CA "inhibitable FIds / FIds to be inhibited by inhibit source DFC_MOXEMM_SMU_ALM7_26" VAL_BLK 0x804E9CB2 ValA_Wu16 732.000000000 DINH_FIdVerb 0.00 732.000000000 FORMAT "%13.9" NUMBER 50 /end CHARACTERISTIC
/begin CHARACTERISTIC DINH_FId.DFC_MOXEMM_SMU_ALM7_28_CA "inhibitable FIds / FIds to be inhibited by inhibit source DFC_MOXEMM_SMU_ALM7_28" VAL_BLK 0x804E9D16 ValA_Wu16 732.000000000 DINH_FIdVerb 0.00 732.000000000 FORMAT "%13.9" NUMBER 50 /end CHARACTERISTIC
/begin CHARACTERISTIC DINH_FId.DFC_MOXEMM_SMU_ALM7_29_CA "inhibitable FIds / FIds to be inhibited by inhibit source DFC_MOXEMM_SMU_ALM7_29" VAL_BLK 0x804E9D7A ValA_Wu16 732.000000000 DINH_FIdVerb 0.00 732.000000000 FORMAT "%13.9" NUMBER 50 /end CHARACTERISTIC
/begin CHARACTERISTIC DINH_FId.DFC_MOXEMM_SMU_ALM7_30_CA "inhibitable FIds / FIds to be inhibited by inhibit source DFC_MOXEMM_SMU_ALM7_30" VAL_BLK 0x804E9DDE ValA_Wu16 732.000000000 DINH_FIdVerb 0.00 732.000000000 FORMAT "%13.9" NUMBER 50 /end CHARACTERISTIC
/begin CHARACTERISTIC DINH_FId.DFC_MOXEMM_SMU_ALM7_31_CA "inhibitable FIds / FIds to be inhibited by inhibit source DFC_MOXEMM_SMU_ALM7_31" VAL_BLK 0x804E9E42 ValA_Wu16 732.000000000 DINH_FIdVerb 0.00 732.000000000 FORMAT "%13.9" NUMBER 50 /end CHARACTERISTIC
/begin CHARACTERISTIC DINH_FId.DFC_MOXEMM_SMU_ALM8_0_CA "inhibitable FIds / FIds to be inhibited by inhibit source DFC_MOXEMM_SMU_ALM8_0" VAL_BLK 0x804E9EA6 ValA_Wu16 732.000000000 DINH_FIdVerb 0.00 732.000000000 FORMAT "%13.9" NUMBER 50 /end CHARACTERISTIC
/begin CHARACTERISTIC DINH_FId.DFC_MOXEMM_SMU_ALM8_1_CA "inhibitable FIds / FIds to be inhibited by inhibit source DFC_MOXEMM_SMU_ALM8_1" VAL_BLK 0x804E9F0A ValA_Wu16 732.000000000 DINH_FIdVerb 0.00 732.000000000 FORMAT "%13.9" NUMBER 50 /end CHARACTERISTIC
/begin CHARACTERISTIC DINH_FId.DFC_MOXEMM_SMU_ALM8_10_CA "inhibitable FIds / FIds to be inhibited by inhibit source DFC_MOXEMM_SMU_ALM8_10" VAL_BLK 0x804E9F6E ValA_Wu16 732.000000000 DINH_FIdVerb 0.00 732.000000000 FORMAT "%13.9" NUMBER 50 /end CHARACTERISTIC
/begin CHARACTERISTIC DINH_FId.DFC_MOXEMM_SMU_ALM8_11_CA "inhibitable FIds / FIds to be inhibited by inhibit source DFC_MOXEMM_SMU_ALM8_11" VAL_BLK 0x804E9FD2 ValA_Wu16 732.000000000 DINH_FIdVerb 0.00 732.000000000 FORMAT "%13.9" NUMBER 50 /end CHARACTERISTIC
/begin CHARACTERISTIC DINH_FId.DFC_MOXEMM_SMU_ALM8_12_CA "inhibitable FIds / FIds to be inhibited by inhibit source DFC_MOXEMM_SMU_ALM8_12" VAL_BLK 0x804EA036 ValA_Wu16 732.000000000 DINH_FIdVerb 0.00 732.000000000 FORMAT "%13.9" NUMBER 50 /end CHARACTERISTIC
/begin CHARACTERISTIC DINH_FId.DFC_MOXEMM_SMU_ALM8_16_CA "inhibitable FIds / FIds to be inhibited by inhibit source DFC_MOXEMM_SMU_ALM8_16" VAL_BLK 0x804EA09A ValA_Wu16 732.000000000 DINH_FIdVerb 0.00 732.000000000 FORMAT "%13.9" NUMBER 50 /end CHARACTERISTIC
/begin CHARACTERISTIC DINH_FId.DFC_MOXEMM_SMU_ALM8_18_CA "inhibitable FIds / FIds to be inhibited by inhibit source DFC_MOXEMM_SMU_ALM8_18" VAL_BLK 0x804EA0FE ValA_Wu16 732.000000000 DINH_FIdVerb 0.00 732.000000000 FORMAT "%13.9" NUMBER 50 /end CHARACTERISTIC
/begin CHARACTERISTIC DINH_FId.DFC_MOXEMM_SMU_ALM8_2_CA "inhibitable FIds / FIds to be inhibited by inhibit source DFC_MOXEMM_SMU_ALM8_2" VAL_BLK 0x804EA162 ValA_Wu16 732.000000000 DINH_FIdVerb 0.00 732.000000000 FORMAT "%13.9" NUMBER 50 /end CHARACTERISTIC
/begin CHARACTERISTIC DINH_FId.DFC_MOXEMM_SMU_ALM8_3_CA "inhibitable FIds / FIds to be inhibited by inhibit source DFC_MOXEMM_SMU_ALM8_3" VAL_BLK 0x804EA1C6 ValA_Wu16 732.000000000 DINH_FIdVerb 0.00 732.000000000 FORMAT "%13.9" NUMBER 50 /end CHARACTERISTIC
/begin CHARACTERISTIC DINH_FId.DFC_MOXEMM_SMU_ALM8_31_CA "inhibitable FIds / FIds to be inhibited by inhibit source DFC_MOXEMM_SMU_ALM8_31" VAL_BLK 0x804EA22A ValA_Wu16 732.000000000 DINH_FIdVerb 0.00 732.000000000 FORMAT "%13.9" NUMBER 50 /end CHARACTERISTIC
/begin CHARACTERISTIC DINH_FId.DFC_MOXEMM_SMU_ALM8_4_CA "inhibitable FIds / FIds to be inhibited by inhibit source DFC_MOXEMM_SMU_ALM8_4" VAL_BLK 0x804EA28E ValA_Wu16 732.000000000 DINH_FIdVerb 0.00 732.000000000 FORMAT "%13.9" NUMBER 50 /end CHARACTERISTIC
/begin CHARACTERISTIC DINH_FId.DFC_MOXEMM_SMU_ALM9_0_CA "inhibitable FIds / FIds to be inhibited by inhibit source DFC_MOXEMM_SMU_ALM9_0" VAL_BLK 0x804EA2F2 ValA_Wu16 732.000000000 DINH_FIdVerb 0.00 732.000000000 FORMAT "%13.9" NUMBER 50 /end CHARACTERISTIC
/begin CHARACTERISTIC DINH_FId.DFC_MOXEMM_SMU_ALM9_15_CA "inhibitable FIds / FIds to be inhibited by inhibit source DFC_MOXEMM_SMU_ALM9_15" VAL_BLK 0x804EA356 ValA_Wu16 732.000000000 DINH_FIdVerb 0.00 732.000000000 FORMAT "%13.9" NUMBER 50 /end CHARACTERISTIC
/begin CHARACTERISTIC DINH_FId.DFC_MOXEMM_SMU_ALM9_3_CA "inhibitable FIds / FIds to be inhibited by inhibit source DFC_MOXEMM_SMU_ALM9_3" VAL_BLK 0x804EA3BA ValA_Wu16 732.000000000 DINH_FIdVerb 0.00 732.000000000 FORMAT "%13.9" NUMBER 50 /end CHARACTERISTIC
/begin CHARACTERISTIC DINH_FId.DFC_MoCADCNTP_CA "inhibitable FIds / FIds to be inhibited by inhibit source DFC_MoCADCNTP" VAL_BLK 0x804EA41E ValA_Wu16 732.000000000 DINH_FIdVerb 0.00 732.000000000 FORMAT "%13.9" NUMBER 65 /end CHARACTERISTIC
/begin CHARACTERISTIC DINH_FId.DFC_MoCADCTst_CA "inhibitable FIds / FIds to be inhibited by inhibit source DFC_MoCADCTst" VAL_BLK 0x804EA4A0 ValA_Wu16 732.000000000 DINH_FIdVerb 0.00 732.000000000 FORMAT "%13.9" NUMBER 65 /end CHARACTERISTIC
/begin CHARACTERISTIC DINH_FId.DFC_MoCSOPICO_CA "inhibitable FIds / FIds to be inhibited by inhibit source DFC_MoCSOPICO" VAL_BLK 0x804EA522 ValA_Wu16 732.000000000 DINH_FIdVerb 0.00 732.000000000 FORMAT "%13.9" NUMBER 51 /end CHARACTERISTIC
/begin CHARACTERISTIC DINH_FId.DFC_MoFAPP_CA "inhibitable FIds / FIds to be inhibited by inhibit source DFC_MoFAPP" VAL_BLK 0x804EA588 ValA_Wu16 732.000000000 DINH_FIdVerb 0.00 732.000000000 FORMAT "%13.9" NUMBER 65 /end CHARACTERISTIC
/begin CHARACTERISTIC DINH_FId.DFC_MoFAirFilgPrdc_CA "inhibitable FIds / FIds to be inhibited by inhibit source DFC_MoFAirFilgPrdc" VAL_BLK 0x804EA60A ValA_Wu16 732.000000000 DINH_FIdVerb 0.00 732.000000000 FORMAT "%13.9" NUMBER 64 /end CHARACTERISTIC
/begin CHARACTERISTIC DINH_FId.DFC_MoFAirFlCtOffPfi_CA "inhibitable FIds / FIds to be inhibited by inhibit source DFC_MoFAirFlCtOffPfi" VAL_BLK 0x804EA68A ValA_Wu16 732.000000000 DINH_FIdVerb 0.00 732.000000000 FORMAT "%13.9" NUMBER 52 /end CHARACTERISTIC
/begin CHARACTERISTIC DINH_FId.DFC_MoFAirFlCylPfi_CA "inhibitable FIds / FIds to be inhibited by inhibit source DFC_MoFAirFlCylPfi" VAL_BLK 0x804EA6F2 ValA_Wu16 732.000000000 DINH_FIdVerb 0.00 732.000000000 FORMAT "%13.9" NUMBER 52 /end CHARACTERISTIC
/begin CHARACTERISTIC DINH_FId.DFC_MoFAirFlIn_CA "inhibitable FIds / FIds to be inhibited by inhibit source DFC_MoFAirFlIn" VAL_BLK 0x804EA75A ValA_Wu16 732.000000000 DINH_FIdVerb 0.00 732.000000000 FORMAT "%13.9" NUMBER 51 /end CHARACTERISTIC
/begin CHARACTERISTIC DINH_FId.DFC_MoFAirFlMixCtlPfiChkAirFl_CA "inhibitable FIds / FIds to be inhibited by inhibit source DFC_MoFAirFlMixCtlPfiChkAirFl" VAL_BLK 0x804EA7C0 ValA_Wu16 732.000000000 DINH_FIdVerb 0.00 732.000000000 FORMAT "%13.9" NUMBER 52 /end CHARACTERISTIC
/begin CHARACTERISTIC DINH_FId.DFC_MoFAirFlMixCtlPfiChkCtrl_CA "inhibitable FIds / FIds to be inhibited by inhibit source DFC_MoFAirFlMixCtlPfiChkCtrl" VAL_BLK 0x804EA828 ValA_Wu16 732.000000000 DINH_FIdVerb 0.00 732.000000000 FORMAT "%13.9" NUMBER 52 /end CHARACTERISTIC
/begin CHARACTERISTIC DINH_FId.DFC_MoFAirFlMode_CA "inhibitable FIds / FIds to be inhibited by inhibit source DFC_MoFAirFlMode" VAL_BLK 0x804EA890 ValA_Wu16 732.000000000 DINH_FIdVerb 0.00 732.000000000 FORMAT "%13.9" NUMBER 52 /end CHARACTERISTIC
/begin CHARACTERISTIC DINH_FId.DFC_MoFESpd_CA "inhibitable FIds / FIds to be inhibited by inhibit source DFC_MoFESpd" VAL_BLK 0x804EA8F8 ValA_Wu16 732.000000000 DINH_FIdVerb 0.00 732.000000000 FORMAT "%13.9" NUMBER 65 /end CHARACTERISTIC
/begin CHARACTERISTIC DINH_FId.DFC_MoFIACo_CA "inhibitable FIds / FIds to be inhibited by inhibit source DFC_MoFIACo" VAL_BLK 0x804EA97A ValA_Wu16 732.000000000 DINH_FIdVerb 0.00 732.000000000 FORMAT "%13.9" NUMBER 52 /end CHARACTERISTIC
/begin CHARACTERISTIC DINH_FId.DFC_MoFICOL1_CA "inhibitable FIds / FIds to be inhibited by inhibit source DFC_MoFICOL1" VAL_BLK 0x804EA9E2 ValA_Wu16 732.000000000 DINH_FIdVerb 0.00 732.000000000 FORMAT "%13.9" NUMBER 63 /end CHARACTERISTIC
/begin CHARACTERISTIC DINH_FId.DFC_MoFICOL2_CA "inhibitable FIds / FIds to be inhibited by inhibit source DFC_MoFICOL2" VAL_BLK 0x804EAA60 ValA_Wu16 732.000000000 DINH_FIdVerb 0.00 732.000000000 FORMAT "%13.9" NUMBER 59 /end CHARACTERISTIC
/begin CHARACTERISTIC DINH_FId.DFC_MoFStrt_CA "inhibitable FIds / FIds to be inhibited by inhibit source DFC_MoFStrt" VAL_BLK 0x804EAAD6 ValA_Wu16 732.000000000 DINH_FIdVerb 0.00 732.000000000 FORMAT "%13.9" NUMBER 60 /end CHARACTERISTIC
/begin CHARACTERISTIC DINH_FId.DFC_MoFTrqCmp_CA "inhibitable FIds / FIds to be inhibited by inhibit source DFC_MoFTrqCmp" VAL_BLK 0x804EAB4E ValA_Wu16 732.000000000 DINH_FIdVerb 0.00 732.000000000 FORMAT "%13.9" NUMBER 64 /end CHARACTERISTIC
/begin CHARACTERISTIC DINH_FId.DFC_MoFTrqCmpMax_CA "inhibitable FIds / FIds to be inhibited by inhibit source DFC_MoFTrqCmpMax" VAL_BLK 0x804EABCE ValA_Wu16 732.000000000 DINH_FIdVerb 0.00 732.000000000 FORMAT "%13.9" NUMBER 50 /end CHARACTERISTIC
/begin CHARACTERISTIC DINH_FId.DFC_MoFTrqCmpMin_CA "inhibitable FIds / FIds to be inhibited by inhibit source DFC_MoFTrqCmpMin" VAL_BLK 0x804EAC32 ValA_Wu16 732.000000000 DINH_FIdVerb 0.00 732.000000000 FORMAT "%13.9" NUMBER 50 /end CHARACTERISTIC
/begin CHARACTERISTIC DINH_FId.DFC_MoFVarPostBldSel_CA "inhibitable FIds / FIds to be inhibited by inhibit source DFC_MoFVarPostBldSel" VAL_BLK 0x804EAC96 ValA_Wu16 732.000000000 DINH_FIdVerb 0.00 732.000000000 FORMAT "%13.9" NUMBER 50 /end CHARACTERISTIC
/begin CHARACTERISTIC DINH_FId.DFC_MoXEMMHwLTMCUFW_CA "inhibitable FIds / FIds to be inhibited by inhibit source DFC_MoXEMMHwLTMCUFW" VAL_BLK 0x804EACFA ValA_Wu16 732.000000000 DINH_FIdVerb 0.00 732.000000000 FORMAT "%13.9" NUMBER 50 /end CHARACTERISTIC
/begin CHARACTERISTIC DINH_FId.DFC_MoXEMMHwLTMonBIST_CA "inhibitable FIds / FIds to be inhibited by inhibit source DFC_MoXEMMHwLTMonBIST" VAL_BLK 0x804EAD5E ValA_Wu16 732.000000000 DINH_FIdVerb 0.00 732.000000000 FORMAT "%13.9" NUMBER 50 /end CHARACTERISTIC
/begin CHARACTERISTIC DINH_FId.DFC_MoXEMMHwLTRegMonTest_CA "inhibitable FIds / FIds to be inhibited by inhibit source DFC_MoXEMMHwLTRegMonTest" VAL_BLK 0x804EADC2 ValA_Wu16 732.000000000 DINH_FIdVerb 0.00 732.000000000 FORMAT "%13.9" NUMBER 50 /end CHARACTERISTIC
/begin CHARACTERISTIC DINH_FId.DFC_MoXEMMHwLTStbySMUAlvTest_CA "inhibitable FIds / FIds to be inhibited by inhibit source DFC_MoXEMMHwLTStbySMUAlvTest" VAL_BLK 0x804EAE26 ValA_Wu16 732.000000000 DINH_FIdVerb 0.00 732.000000000 FORMAT "%13.9" NUMBER 50 /end CHARACTERISTIC
/begin CHARACTERISTIC DINH_FId.DFC_MoXEMMHwLTTempSens_CA "inhibitable FIds / FIds to be inhibited by inhibit source DFC_MoXEMMHwLTTempSens" VAL_BLK 0x804EAE8A ValA_Wu16 732.000000000 DINH_FIdVerb 0.00 732.000000000 FORMAT "%13.9" NUMBER 50 /end CHARACTERISTIC
/begin CHARACTERISTIC DINH_FId.DFC_MoXEMMHwLTUCBCfg_CA "inhibitable FIds / FIds to be inhibited by inhibit source DFC_MoXEMMHwLTUCBCfg" VAL_BLK 0x804EAEEE ValA_Wu16 732.000000000 DINH_FIdVerb 0.00 732.000000000 FORMAT "%13.9" NUMBER 50 /end CHARACTERISTIC
/begin CHARACTERISTIC DINH_FId.DFC_OCWDAABEActv_CA "inhibitable FIds / FIds to be inhibited by inhibit source DFC_OCWDAABEActv" VAL_BLK 0x804EAF52 ValA_Wu16 732.000000000 DINH_FIdVerb 0.00 732.000000000 FORMAT "%13.9" NUMBER 51 /end CHARACTERISTIC
/begin CHARACTERISTIC DINH_FId.DFC_OCWDACom_CA "inhibitable FIds / FIds to be inhibited by inhibit source DFC_OCWDACom" VAL_BLK 0x804EAFB8 ValA_Wu16 732.000000000 DINH_FIdVerb 0.00 732.000000000 FORMAT "%13.9" NUMBER 53 /end CHARACTERISTIC
/begin CHARACTERISTIC DINH_FId.DFC_OCWDAErrPin_CA "inhibitable FIds / FIds to be inhibited by inhibit source DFC_OCWDAErrPin" VAL_BLK 0x804EB022 ValA_Wu16 732.000000000 DINH_FIdVerb 0.00 732.000000000 FORMAT "%13.9" NUMBER 51 /end CHARACTERISTIC
/begin CHARACTERISTIC DINH_FId.DFC_OCWDAOvrVltg_CA "inhibitable FIds / FIds to be inhibited by inhibit source DFC_OCWDAOvrVltg" VAL_BLK 0x804EB088 ValA_Wu16 732.000000000 DINH_FIdVerb 0.00 732.000000000 FORMAT "%13.9" NUMBER 51 /end CHARACTERISTIC
/begin CHARACTERISTIC DINH_FId.DFC_ORAmax_CA "inhibitable FIds / FIds to be inhibited by inhibit source DFC_ORAmax" VAL_BLK 0x804EB0EE ValA_Wu16 732.000000000 DINH_FIdVerb 0.00 732.000000000 FORMAT "%13.9" NUMBER 69 /end CHARACTERISTIC
/begin CHARACTERISTIC DINH_FId.DFC_ORAmin_CA "inhibitable FIds / FIds to be inhibited by inhibit source DFC_ORAmin" VAL_BLK 0x804EB178 ValA_Wu16 732.000000000 DINH_FIdVerb 0.00 732.000000000 FORMAT "%13.9" NUMBER 69 /end CHARACTERISTIC
/begin CHARACTERISTIC DINH_FId.DFC_PLLSUmax_CA "inhibitable FIds / FIds to be inhibited by inhibit source DFC_PLLSUmax" VAL_BLK 0x804EB202 ValA_Wu16 732.000000000 DINH_FIdVerb 0.00 732.000000000 FORMAT "%13.9" NUMBER 70 /end CHARACTERISTIC
/begin CHARACTERISTIC DINH_FId.DFC_PLLSUmin_CA "inhibitable FIds / FIds to be inhibited by inhibit source DFC_PLLSUmin" VAL_BLK 0x804EB28E ValA_Wu16 732.000000000 DINH_FIdVerb 0.00 732.000000000 FORMAT "%13.9" NUMBER 70 /end CHARACTERISTIC
/begin CHARACTERISTIC DINH_FId.DFC_PSR1max_CA "inhibitable FIds / FIds to be inhibited by inhibit source DFC_PSR1max" VAL_BLK 0x804EB31A ValA_Wu16 732.000000000 DINH_FIdVerb 0.00 732.000000000 FORMAT "%13.9" NUMBER 50 /end CHARACTERISTIC
/begin CHARACTERISTIC DINH_FId.DFC_PSRBmax_CA "inhibitable FIds / FIds to be inhibited by inhibit source DFC_PSRBmax" VAL_BLK 0x804EB37E ValA_Wu16 732.000000000 DINH_FIdVerb 0.00 732.000000000 FORMAT "%13.9" NUMBER 90 /end CHARACTERISTIC
/begin CHARACTERISTIC DINH_FId.DFC_PSRBmin_CA "inhibitable FIds / FIds to be inhibited by inhibit source DFC_PSRBmin" VAL_BLK 0x804EB432 ValA_Wu16 732.000000000 DINH_FIdVerb 0.00 732.000000000 FORMAT "%13.9" NUMBER 90 /end CHARACTERISTIC
/begin CHARACTERISTIC DINH_FId.DFC_PSRPmax_CA "inhibitable FIds / FIds to be inhibited by inhibit source DFC_PSRPmax" VAL_BLK 0x804EB4E6 ValA_Wu16 732.000000000 DINH_FIdVerb 0.00 732.000000000 FORMAT "%13.9" NUMBER 89 /end CHARACTERISTIC
/begin CHARACTERISTIC DINH_FId.DFC_PSRPmin_CA "inhibitable FIds / FIds to be inhibited by inhibit source DFC_PSRPmin" VAL_BLK 0x804EB598 ValA_Wu16 732.000000000 DINH_FIdVerb 0.00 732.000000000 FORMAT "%13.9" NUMBER 89 /end CHARACTERISTIC
/begin CHARACTERISTIC DINH_FId.DFC_PSRPsig_CA "inhibitable FIds / FIds to be inhibited by inhibit source DFC_PSRPsig" VAL_BLK 0x804EB64A ValA_Wu16 732.000000000 DINH_FIdVerb 0.00 732.000000000 FORMAT "%13.9" NUMBER 83 /end CHARACTERISTIC
/begin CHARACTERISTIC DINH_FId.DFC_PSRmax_CA "inhibitable FIds / FIds to be inhibited by inhibit source DFC_PSRmax" VAL_BLK 0x804EB6F0 ValA_Wu16 732.000000000 DINH_FIdVerb 0.00 732.000000000 FORMAT "%13.9" NUMBER 50 /end CHARACTERISTIC
/begin CHARACTERISTIC DINH_FId.DFC_PUmax_CA "inhibitable FIds / FIds to be inhibited by inhibit source DFC_PUmax" VAL_BLK 0x804EB754 ValA_Wu16 732.000000000 DINH_FIdVerb 0.00 732.000000000 FORMAT "%13.9" NUMBER 50 /end CHARACTERISTIC
/begin CHARACTERISTIC DINH_FId.DFC_P_VSE11_OL_CA "inhibitable FIds / FIds to be inhibited by inhibit source DFC_P_VSE11_OL" VAL_BLK 0x804EB7B8 ValA_Wu16 732.000000000 DINH_FIdVerb 0.00 732.000000000 FORMAT "%13.9" NUMBER 76 /end CHARACTERISTIC
/begin CHARACTERISTIC DINH_FId.DFC_P_VSE11_SCB_CA "inhibitable FIds / FIds to be inhibited by inhibit source DFC_P_VSE11_SCB" VAL_BLK 0x804EB850 ValA_Wu16 732.000000000 DINH_FIdVerb 0.00 732.000000000 FORMAT "%13.9" NUMBER 76 /end CHARACTERISTIC
/begin CHARACTERISTIC DINH_FId.DFC_P_VSE11_SCG_CA "inhibitable FIds / FIds to be inhibited by inhibit source DFC_P_VSE11_SCG" VAL_BLK 0x804EB8E8 ValA_Wu16 732.000000000 DINH_FIdVerb 0.00 732.000000000 FORMAT "%13.9" NUMBER 76 /end CHARACTERISTIC
/begin CHARACTERISTIC DINH_FId.DFC_PhyHighAPP1_CA "inhibitable FIds / FIds to be inhibited by inhibit source DFC_PhyHighAPP1" VAL_BLK 0x804EB980 ValA_Wu16 732.000000000 DINH_FIdVerb 0.00 732.000000000 FORMAT "%13.9" NUMBER 57 /end CHARACTERISTIC
/begin CHARACTERISTIC DINH_FId.DFC_PhyHighAPP2_CA "inhibitable FIds / FIds to be inhibited by inhibit source DFC_PhyHighAPP2" VAL_BLK 0x804EB9F2 ValA_Wu16 732.000000000 DINH_FIdVerb 0.00 732.000000000 FORMAT "%13.9" NUMBER 56 /end CHARACTERISTIC
/begin CHARACTERISTIC DINH_FId.DFC_PhyLowAPP1_CA "inhibitable FIds / FIds to be inhibited by inhibit source DFC_PhyLowAPP1" VAL_BLK 0x804EBA62 ValA_Wu16 732.000000000 DINH_FIdVerb 0.00 732.000000000 FORMAT "%13.9" NUMBER 57 /end CHARACTERISTIC
/begin CHARACTERISTIC DINH_FId.DFC_PhyLowAPP2_CA "inhibitable FIds / FIds to be inhibited by inhibit source DFC_PhyLowAPP2" VAL_BLK 0x804EBAD4 ValA_Wu16 732.000000000 DINH_FIdVerb 0.00 732.000000000 FORMAT "%13.9" NUMBER 56 /end CHARACTERISTIC
/begin CHARACTERISTIC DINH_FId.DFC_SRCHighAPP1_CA "inhibitable FIds / FIds to be inhibited by inhibit source DFC_SRCHighAPP1" VAL_BLK 0x804EBB44 ValA_Wu16 732.000000000 DINH_FIdVerb 0.00 732.000000000 FORMAT "%13.9" NUMBER 69 /end CHARACTERISTIC
/begin CHARACTERISTIC DINH_FId.DFC_SRCHighAPP2_CA "inhibitable FIds / FIds to be inhibited by inhibit source DFC_SRCHighAPP2" VAL_BLK 0x804EBBCE ValA_Wu16 732.000000000 DINH_FIdVerb 0.00 732.000000000 FORMAT "%13.9" NUMBER 68 /end CHARACTERISTIC
/begin CHARACTERISTIC DINH_FId.DFC_SRCLowAPP1_CA "inhibitable FIds / FIds to be inhibited by inhibit source DFC_SRCLowAPP1" VAL_BLK 0x804EBC56 ValA_Wu16 732.000000000 DINH_FIdVerb 0.00 732.000000000 FORMAT "%13.9" NUMBER 70 /end CHARACTERISTIC
/begin CHARACTERISTIC DINH_FId.DFC_SRCLowAPP2_CA "inhibitable FIds / FIds to be inhibited by inhibit source DFC_SRCLowAPP2" VAL_BLK 0x804EBCE2 ValA_Wu16 732.000000000 DINH_FIdVerb 0.00 732.000000000 FORMAT "%13.9" NUMBER 69 /end CHARACTERISTIC
/begin CHARACTERISTIC DINH_FId.DFC_SSpMon2_CA "inhibitable FIds / FIds to be inhibited by inhibit source DFC_SSpMon2" VAL_BLK 0x804EBD6C ValA_Wu16 732.000000000 DINH_FIdVerb 0.00 732.000000000 FORMAT "%13.9" NUMBER 88 /end CHARACTERISTIC
/begin CHARACTERISTIC DINH_FId.DFC_SWReset_0_CA "inhibitable FIds / FIds to be inhibited by inhibit source DFC_SWReset_0" VAL_BLK 0x804EBE1C ValA_Wu16 732.000000000 DINH_FIdVerb 0.00 732.000000000 FORMAT "%13.9" NUMBER 50 /end CHARACTERISTIC
/begin CHARACTERISTIC DINH_FId.DFC_SWReset_1_CA "inhibitable FIds / FIds to be inhibited by inhibit source DFC_SWReset_1" VAL_BLK 0x804EBE80 ValA_Wu16 732.000000000 DINH_FIdVerb 0.00 732.000000000 FORMAT "%13.9" NUMBER 50 /end CHARACTERISTIC
/begin CHARACTERISTIC DINH_FId.DFC_SWReset_2_CA "inhibitable FIds / FIds to be inhibited by inhibit source DFC_SWReset_2" VAL_BLK 0x804EBEE4 ValA_Wu16 732.000000000 DINH_FIdVerb 0.00 732.000000000 FORMAT "%13.9" NUMBER 50 /end CHARACTERISTIC
/begin CHARACTERISTIC DINH_FId.DFC_SyncAPP_CA "inhibitable FIds / FIds to be inhibited by inhibit source DFC_SyncAPP" VAL_BLK 0x804EBF48 ValA_Wu16 732.000000000 DINH_FIdVerb 0.00 732.000000000 FORMAT "%13.9" NUMBER 73 /end CHARACTERISTIC
/begin CHARACTERISTIC DINH_FId.DFC_TAmax_Dummy_CA "inhibitable FIds / FIds to be inhibited by inhibit source DFC_TAmax_Dummy" VAL_BLK 0x804EBFDA ValA_Wu16 732.000000000 DINH_FIdVerb 0.00 732.000000000 FORMAT "%13.9" NUMBER 50 /end CHARACTERISTIC
/begin CHARACTERISTIC DINH_FId.DFC_TKAEmax_CA "inhibitable FIds / FIds to be inhibited by inhibit source DFC_TKAEmax" VAL_BLK 0x804EC03E ValA_Wu16 732.000000000 DINH_FIdVerb 0.00 732.000000000 FORMAT "%13.9" NUMBER 50 /end CHARACTERISTIC
/begin CHARACTERISTIC DINH_FId.DFC_TKAEmin_CA "inhibitable FIds / FIds to be inhibited by inhibit source DFC_TKAEmin" VAL_BLK 0x804EC0A2 ValA_Wu16 732.000000000 DINH_FIdVerb 0.00 732.000000000 FORMAT "%13.9" NUMBER 50 /end CHARACTERISTIC
/begin CHARACTERISTIC DINH_FId.DFC_TKARmax_CA "inhibitable FIds / FIds to be inhibited by inhibit source DFC_TKARmax" VAL_BLK 0x804EC106 ValA_Wu16 732.000000000 DINH_FIdVerb 0.00 732.000000000 FORMAT "%13.9" NUMBER 50 /end CHARACTERISTIC
/begin CHARACTERISTIC DINH_FId.DFC_TKARnpl_CA "inhibitable FIds / FIds to be inhibited by inhibit source DFC_TKARnpl" VAL_BLK 0x804EC16A ValA_Wu16 732.000000000 DINH_FIdVerb 0.00 732.000000000 FORMAT "%13.9" NUMBER 50 /end CHARACTERISTIC
/begin CHARACTERISTIC DINH_FId.DFC_TMmax_Dummy_CA "inhibitable FIds / FIds to be inhibited by inhibit source DFC_TMmax_Dummy" VAL_BLK 0x804EC1CE ValA_Wu16 732.000000000 DINH_FIdVerb 0.00 732.000000000 FORMAT "%13.9" NUMBER 50 /end CHARACTERISTIC
/begin CHARACTERISTIC DINH_FId.DFC_TUMmax_Dummy_CA "inhibitable FIds / FIds to be inhibited by inhibit source DFC_TUMmax_Dummy" VAL_BLK 0x804EC232 ValA_Wu16 732.000000000 DINH_FIdVerb 0.00 732.000000000 FORMAT "%13.9" NUMBER 50 /end CHARACTERISTIC
/begin CHARACTERISTIC DINH_FId.DFC_TWCDPriCatB1_CA "inhibitable FIds / FIds to be inhibited by inhibit source DFC_TWCDPriCatB1" VAL_BLK 0x804EC296 ValA_Wu16 732.000000000 DINH_FIdVerb 0.00 732.000000000 FORMAT "%13.9" NUMBER 54 /end CHARACTERISTIC
/begin CHARACTERISTIC DINH_FId.DFC_ThrVlvClsdPosnFirstOffsLrnImpoB1_CA "inhibitable FIds / FIds to be inhibited by inhibit source DFC_ThrVlvClsdPosnFirstOffsLrnImpoB1" VAL_BLK 0x804EC302 ValA_Wu16 732.000000000 DINH_FIdVerb 0.00 732.000000000 FORMAT "%13.9" NUMBER 69 /end CHARACTERISTIC
/begin CHARACTERISTIC DINH_FId.DFC_ThrVlvClsdPosnOffsLrnImpoB1_CA "inhibitable FIds / FIds to be inhibited by inhibit source DFC_ThrVlvClsdPosnOffsLrnImpoB1" VAL_BLK 0x804EC38C ValA_Wu16 732.000000000 DINH_FIdVerb 0.00 732.000000000 FORMAT "%13.9" NUMBER 59 /end CHARACTERISTIC
/begin CHARACTERISTIC DINH_FId.DFC_ThrVlvClsdPosnOffsLrnMaxB1_CA "inhibitable FIds / FIds to be inhibited by inhibit source DFC_ThrVlvClsdPosnOffsLrnMaxB1" VAL_BLK 0x804EC402 ValA_Wu16 732.000000000 DINH_FIdVerb 0.00 732.000000000 FORMAT "%13.9" NUMBER 59 /end CHARACTERISTIC
/begin CHARACTERISTIC DINH_FId.DFC_ThrVlvClsdPosnOffsLrnMinB1_CA "inhibitable FIds / FIds to be inhibited by inhibit source DFC_ThrVlvClsdPosnOffsLrnMinB1" VAL_BLK 0x804EC478 ValA_Wu16 732.000000000 DINH_FIdVerb 0.00 732.000000000 FORMAT "%13.9" NUMBER 59 /end CHARACTERISTIC
/begin CHARACTERISTIC DINH_FId.DFC_ThrVlvCtrlDeB1_CA "inhibitable FIds / FIds to be inhibited by inhibit source DFC_ThrVlvCtrlDeB1" VAL_BLK 0x804EC4EE ValA_Wu16 732.000000000 DINH_FIdVerb 0.00 732.000000000 FORMAT "%13.9" NUMBER 66 /end CHARACTERISTIC
/begin CHARACTERISTIC DINH_FId.DFC_ThrVlvDycB1_CA "inhibitable FIds / FIds to be inhibited by inhibit source DFC_ThrVlvDycB1" VAL_BLK 0x804EC572 ValA_Wu16 732.000000000 DINH_FIdVerb 0.00 732.000000000 FORMAT "%13.9" NUMBER 66 /end CHARACTERISTIC
/begin CHARACTERISTIC DINH_FId.DFC_ThrVlvLimpAirPosnMaxAbsltDriftB1_CA "inhibitable FIds / FIds to be inhibited by inhibit source DFC_ThrVlvLimpAirPosnMaxAbsltDriftB1" VAL_BLK 0x804EC5F6 ValA_Wu16 732.000000000 DINH_FIdVerb 0.00 732.000000000 FORMAT "%13.9" NUMBER 54 /end CHARACTERISTIC
/begin CHARACTERISTIC DINH_FId.DFC_ThrVlvLimpAirPosnMaxB1_CA "inhibitable FIds / FIds to be inhibited by inhibit source DFC_ThrVlvLimpAirPosnMaxB1" VAL_BLK 0x804EC662 ValA_Wu16 732.000000000 DINH_FIdVerb 0.00 732.000000000 FORMAT "%13.9" NUMBER 54 /end CHARACTERISTIC
/begin CHARACTERISTIC DINH_FId.DFC_ThrVlvLimpAirPosnMaxRelDriftB1_CA "inhibitable FIds / FIds to be inhibited by inhibit source DFC_ThrVlvLimpAirPosnMaxRelDriftB1" VAL_BLK 0x804EC6CE ValA_Wu16 732.000000000 DINH_FIdVerb 0.00 732.000000000 FORMAT "%13.9" NUMBER 54 /end CHARACTERISTIC
/begin CHARACTERISTIC DINH_FId.DFC_ThrVlvLimpAirPosnMinB1_CA "inhibitable FIds / FIds to be inhibited by inhibit source DFC_ThrVlvLimpAirPosnMinB1" VAL_BLK 0x804EC73A ValA_Wu16 732.000000000 DINH_FIdVerb 0.00 732.000000000 FORMAT "%13.9" NUMBER 54 /end CHARACTERISTIC
/begin CHARACTERISTIC DINH_FId.DFC_ThrVlvOpenLoadB1_CA "inhibitable FIds / FIds to be inhibited by inhibit source DFC_ThrVlvOpenLoadB1" VAL_BLK 0x804EC7A6 ValA_Wu16 732.000000000 DINH_FIdVerb 0.00 732.000000000 FORMAT "%13.9" NUMBER 65 /end CHARACTERISTIC
/begin CHARACTERISTIC DINH_FId.DFC_ThrVlvOpenSprgB1_CA "inhibitable FIds / FIds to be inhibited by inhibit source DFC_ThrVlvOpenSprgB1" VAL_BLK 0x804EC828 ValA_Wu16 732.000000000 DINH_FIdVerb 0.00 732.000000000 FORMAT "%13.9" NUMBER 65 /end CHARACTERISTIC
/begin CHARACTERISTIC DINH_FId.DFC_ThrVlvOpenSprgSprdB1_CA "inhibitable FIds / FIds to be inhibited by inhibit source DFC_ThrVlvOpenSprgSprdB1" VAL_BLK 0x804EC8AA ValA_Wu16 732.000000000 DINH_FIdVerb 0.00 732.000000000 FORMAT "%13.9" NUMBER 54 /end CHARACTERISTIC
/begin CHARACTERISTIC DINH_FId.DFC_ThrVlvOpenSprgTwnB1_CA "inhibitable FIds / FIds to be inhibited by inhibit source DFC_ThrVlvOpenSprgTwnB1" VAL_BLK 0x804EC916 ValA_Wu16 732.000000000 DINH_FIdVerb 0.00 732.000000000 FORMAT "%13.9" NUMBER 52 /end CHARACTERISTIC
/begin CHARACTERISTIC DINH_FId.DFC_ThrVlvOverTB1_CA "inhibitable FIds / FIds to be inhibited by inhibit source DFC_ThrVlvOverTB1" VAL_BLK 0x804EC97E ValA_Wu16 732.000000000 DINH_FIdVerb 0.00 732.000000000 FORMAT "%13.9" NUMBER 65 /end CHARACTERISTIC
/begin CHARACTERISTIC DINH_FId.DFC_ThrVlvRetSprgB1_CA "inhibitable FIds / FIds to be inhibited by inhibit source DFC_ThrVlvRetSprgB1" VAL_BLK 0x804ECA00 ValA_Wu16 732.000000000 DINH_FIdVerb 0.00 732.000000000 FORMAT "%13.9" NUMBER 64 /end CHARACTERISTIC
/begin CHARACTERISTIC DINH_FId.DFC_ThrVlvRetSprgSprdB1_CA "inhibitable FIds / FIds to be inhibited by inhibit source DFC_ThrVlvRetSprgSprdB1" VAL_BLK 0x804ECA80 ValA_Wu16 732.000000000 DINH_FIdVerb 0.00 732.000000000 FORMAT "%13.9" NUMBER 51 /end CHARACTERISTIC
/begin CHARACTERISTIC DINH_FId.DFC_ThrVlvRetSprgTwnB1_CA "inhibitable FIds / FIds to be inhibited by inhibit source DFC_ThrVlvRetSprgTwnB1" VAL_BLK 0x804ECAE6 ValA_Wu16 732.000000000 DINH_FIdVerb 0.00 732.000000000 FORMAT "%13.9" NUMBER 52 /end CHARACTERISTIC
/begin CHARACTERISTIC DINH_FId.DFC_ThrVlvSens1MaxB1_CA "inhibitable FIds / FIds to be inhibited by inhibit source DFC_ThrVlvSens1MaxB1" VAL_BLK 0x804ECB4E ValA_Wu16 732.000000000 DINH_FIdVerb 0.00 732.000000000 FORMAT "%13.9" NUMBER 89 /end CHARACTERISTIC
/begin CHARACTERISTIC DINH_FId.DFC_ThrVlvSens1NplB1_CA "inhibitable FIds / FIds to be inhibited by inhibit source DFC_ThrVlvSens1NplB1" VAL_BLK 0x804ECC00 ValA_Wu16 732.000000000 DINH_FIdVerb 0.00 732.000000000 FORMAT "%13.9" NUMBER 89 /end CHARACTERISTIC
/begin CHARACTERISTIC DINH_FId.DFC_ThrVlvSens2MaxB1_CA "inhibitable FIds / FIds to be inhibited by inhibit source DFC_ThrVlvSens2MaxB1" VAL_BLK 0x804ECCB2 ValA_Wu16 732.000000000 DINH_FIdVerb 0.00 732.000000000 FORMAT "%13.9" NUMBER 89 /end CHARACTERISTIC
/begin CHARACTERISTIC DINH_FId.DFC_ThrVlvSens2MinB1_CA "inhibitable FIds / FIds to be inhibited by inhibit source DFC_ThrVlvSens2MinB1" VAL_BLK 0x804ECD64 ValA_Wu16 732.000000000 DINH_FIdVerb 0.00 732.000000000 FORMAT "%13.9" NUMBER 89 /end CHARACTERISTIC
/begin CHARACTERISTIC DINH_FId.DFC_ThrVlvSens2NplB1_CA "inhibitable FIds / FIds to be inhibited by inhibit source DFC_ThrVlvSens2NplB1" VAL_BLK 0x804ECE16 ValA_Wu16 732.000000000 DINH_FIdVerb 0.00 732.000000000 FORMAT "%13.9" NUMBER 89 /end CHARACTERISTIC
/begin CHARACTERISTIC DINH_FId.DFC_ThrVlvShoCircB1_CA "inhibitable FIds / FIds to be inhibited by inhibit source DFC_ThrVlvShoCircB1" VAL_BLK 0x804ECEC8 ValA_Wu16 732.000000000 DINH_FIdVerb 0.00 732.000000000 FORMAT "%13.9" NUMBER 65 /end CHARACTERISTIC
/begin CHARACTERISTIC DINH_FId.DFC_ThrVlvSpiErrB1_CA "inhibitable FIds / FIds to be inhibited by inhibit source DFC_ThrVlvSpiErrB1" VAL_BLK 0x804ECF4A ValA_Wu16 732.000000000 DINH_FIdVerb 0.00 732.000000000 FORMAT "%13.9" NUMBER 65 /end CHARACTERISTIC
/begin CHARACTERISTIC DINH_FId.DFC_ThrvlvSens1MinB1_CA "inhibitable FIds / FIds to be inhibited by inhibit source DFC_ThrvlvSens1MinB1" VAL_BLK 0x804ECFCC ValA_Wu16 732.000000000 DINH_FIdVerb 0.00 732.000000000 FORMAT "%13.9" NUMBER 89 /end CHARACTERISTIC
/begin CHARACTERISTIC DINH_FId.DFC_TiOffTBasdChkFast_CA "inhibitable FIds / FIds to be inhibited by inhibit source DFC_TiOffTBasdChkFast" VAL_BLK 0x804ED07E ValA_Wu16 732.000000000 DINH_FIdVerb 0.00 732.000000000 FORMAT "%13.9" NUMBER 51 /end CHARACTERISTIC
/begin CHARACTERISTIC DINH_FId.DFC_TiOffTBasdChkSlow_CA "inhibitable FIds / FIds to be inhibited by inhibit source DFC_TiOffTBasdChkSlow" VAL_BLK 0x804ED0E4 ValA_Wu16 732.000000000 DINH_FIdVerb 0.00 732.000000000 FORMAT "%13.9" NUMBER 51 /end CHARACTERISTIC
/begin CHARACTERISTIC DINH_FId.DFC_UEGOHeatrCtlS1B1_CA "inhibitable FIds / FIds to be inhibited by inhibit source DFC_UEGOHeatrCtlS1B1" VAL_BLK 0x804ED14A ValA_Wu16 732.000000000 DINH_FIdVerb 0.00 732.000000000 FORMAT "%13.9" NUMBER 72 /end CHARACTERISTIC
/begin CHARACTERISTIC DINH_FId.DFC_UEGOSnsrMntdS1B1_CA "inhibitable FIds / FIds to be inhibited by inhibit source DFC_UEGOSnsrMntdS1B1" VAL_BLK 0x804ED1DA ValA_Wu16 732.000000000 DINH_FIdVerb 0.00 732.000000000 FORMAT "%13.9" NUMBER 66 /end CHARACTERISTIC
/begin CHARACTERISTIC DINH_FId.DFC_VehVSig_CA "inhibitable FIds / FIds to be inhibited by inhibit source DFC_VehVSig" VAL_BLK 0x804ED25E ValA_Wu16 732.000000000 DINH_FIdVerb 0.00 732.000000000 FORMAT "%13.9" NUMBER 75 /end CHARACTERISTIC
/begin CHARACTERISTIC DINH_FId.DFC_VlvLftFbSwtIntk11SpclFail_CA "inhibitable FIds / FIds to be inhibited by inhibit source DFC_VlvLftFbSwtIntk11SpclFail" VAL_BLK 0x804ED2F4 ValA_Wu16 732.000000000 DINH_FIdVerb 0.00 732.000000000 FORMAT "%13.9" NUMBER 77 /end CHARACTERISTIC
/begin CHARACTERISTIC DINH_FId.DFC_VlvLftFbSwtIntk11StdFail_CA "inhibitable FIds / FIds to be inhibited by inhibit source DFC_VlvLftFbSwtIntk11StdFail" VAL_BLK 0x804ED38E ValA_Wu16 732.000000000 DINH_FIdVerb 0.00 732.000000000 FORMAT "%13.9" NUMBER 77 /end CHARACTERISTIC
/begin CHARACTERISTIC DINH_FId.DSQ_ACClntP_CA "inhibitable FIds / FIds to be inhibited by inhibit source DSQ_ACClntP" VAL_BLK 0x804ED428 ValA_Wu16 732.000000000 DINH_FIdVerb 0.00 732.000000000 FORMAT "%13.9" NUMBER 50 /end CHARACTERISTIC
/begin CHARACTERISTIC DINH_FId.DSQ_ACEvpT_CA "inhibitable FIds / FIds to be inhibited by inhibit source DSQ_ACEvpT" VAL_BLK 0x804ED48C ValA_Wu16 732.000000000 DINH_FIdVerb 0.00 732.000000000 FORMAT "%13.9" NUMBER 50 /end CHARACTERISTIC
/begin CHARACTERISTIC DINH_FId.DSQ_AirCCmprActr_CA "inhibitable FIds / FIds to be inhibited by inhibit source DSQ_AirCCmprActr" VAL_BLK 0x804ED4F0 ValA_Wu16 732.000000000 DINH_FIdVerb 0.00 732.000000000 FORMAT "%13.9" NUMBER 50 /end CHARACTERISTIC
/begin CHARACTERISTIC DINH_FId.DSQ_BattU_CA "inhibitable FIds / FIds to be inhibited by inhibit source DSQ_BattU" VAL_BLK 0x804ED554 ValA_Wu16 732.000000000 DINH_FIdVerb 0.00 732.000000000 FORMAT "%13.9" NUMBER 51 /end CHARACTERISTIC
/begin CHARACTERISTIC DINH_FId.DSQ_BattULo_CA "inhibitable FIds / FIds to be inhibited by inhibit source DSQ_BattULo" VAL_BLK 0x804ED5BA ValA_Wu16 732.000000000 DINH_FIdVerb 0.00 732.000000000 FORMAT "%13.9" NUMBER 50 /end CHARACTERISTIC
/begin CHARACTERISTIC DINH_FId.DSQ_CoVMDIDASFail_CA "inhibitable FIds / FIds to be inhibited by inhibit source DSQ_CoVMDIDASFail" VAL_BLK 0x804ED61E ValA_Wu16 732.000000000 DINH_FIdVerb 0.00 732.000000000 FORMAT "%13.9" NUMBER 50 /end CHARACTERISTIC
/begin CHARACTERISTIC DINH_FId.DSQ_DSMInhibitAlways_CA "inhibitable FIds / FIds to be inhibited by inhibit source DSQ_DSMInhibitAlways" VAL_BLK 0x804ED682 ValA_Wu16 732.000000000 DINH_FIdVerb 0.00 732.000000000 FORMAT "%13.9" NUMBER 51 /end CHARACTERISTIC
/begin CHARACTERISTIC DINH_FId.DSQ_ElecLd_CA "inhibitable FIds / FIds to be inhibited by inhibit source DSQ_ElecLd" VAL_BLK 0x804ED6E8 ValA_Wu16 732.000000000 DINH_FIdVerb 0.00 732.000000000 FORMAT "%13.9" NUMBER 51 /end CHARACTERISTIC
/begin CHARACTERISTIC DINH_FId.DSQ_EngICO_CA "inhibitable FIds / FIds to be inhibited by inhibit source DSQ_EngICO" VAL_BLK 0x804ED74E ValA_Wu16 732.000000000 DINH_FIdVerb 0.00 732.000000000 FORMAT "%13.9" NUMBER 50 /end CHARACTERISTIC
/begin CHARACTERISTIC DINH_FId.DSQ_EpmCaSSigQuality_CA "inhibitable FIds / FIds to be inhibited by inhibit source DSQ_EpmCaSSigQuality" VAL_BLK 0x804ED7B2 ValA_Wu16 732.000000000 DINH_FIdVerb 0.00 732.000000000 FORMAT "%13.9" NUMBER 55 /end CHARACTERISTIC
/begin CHARACTERISTIC DINH_FId.DSQ_EpmReverseRun_CA "inhibitable FIds / FIds to be inhibited by inhibit source DSQ_EpmReverseRun" VAL_BLK 0x804ED820 ValA_Wu16 732.000000000 DINH_FIdVerb 0.00 732.000000000 FORMAT "%13.9" NUMBER 52 /end CHARACTERISTIC
/begin CHARACTERISTIC DINH_FId.DSQ_FanDIO_0_CA "inhibitable FIds / FIds to be inhibited by inhibit source DSQ_FanDIO_0" VAL_BLK 0x804ED888 ValA_Wu16 732.000000000 DINH_FIdVerb 0.00 732.000000000 FORMAT "%13.9" NUMBER 50 /end CHARACTERISTIC
/begin CHARACTERISTIC DINH_FId.DSQ_FanDIO_1_CA "inhibitable FIds / FIds to be inhibited by inhibit source DSQ_FanDIO_1" VAL_BLK 0x804ED8EC ValA_Wu16 732.000000000 DINH_FIdVerb 0.00 732.000000000 FORMAT "%13.9" NUMBER 50 /end CHARACTERISTIC
/begin CHARACTERISTIC DINH_FId.DSQ_FuelP_CA "inhibitable FIds / FIds to be inhibited by inhibit source DSQ_FuelP" VAL_BLK 0x804ED950 ValA_Wu16 732.000000000 DINH_FIdVerb 0.00 732.000000000 FORMAT "%13.9" NUMBER 50 /end CHARACTERISTIC
/begin CHARACTERISTIC DINH_FId.DSQ_FuelT_CA "inhibitable FIds / FIds to be inhibited by inhibit source DSQ_FuelT" VAL_BLK 0x804ED9B4 ValA_Wu16 732.000000000 DINH_FIdVerb 0.00 732.000000000 FORMAT "%13.9" NUMBER 50 /end CHARACTERISTIC
/begin CHARACTERISTIC DINH_FId.DSQ_GbxPNPos_CA "inhibitable FIds / FIds to be inhibited by inhibit source DSQ_GbxPNPos" VAL_BLK 0x804EDA18 ValA_Wu16 732.000000000 DINH_FIdVerb 0.00 732.000000000 FORMAT "%13.9" NUMBER 51 /end CHARACTERISTIC
/begin CHARACTERISTIC DINH_FId.DSQ_GbxPosNotPN_CA "inhibitable FIds / FIds to be inhibited by inhibit source DSQ_GbxPosNotPN" VAL_BLK 0x804EDA7E ValA_Wu16 732.000000000 DINH_FIdVerb 0.00 732.000000000 FORMAT "%13.9" NUMBER 51 /end CHARACTERISTIC
/begin CHARACTERISTIC DINH_FId.DSQ_MRly_CA "inhibitable FIds / FIds to be inhibited by inhibit source DSQ_MRly" VAL_BLK 0x804EDAE4 ValA_Wu16 732.000000000 DINH_FIdVerb 0.00 732.000000000 FORMAT "%13.9" NUMBER 50 /end CHARACTERISTIC
/begin CHARACTERISTIC DINH_FId.DSQ_PEnvMeasVld_CA "inhibitable FIds / FIds to be inhibited by inhibit source DSQ_PEnvMeasVld" VAL_BLK 0x804EDB48 ValA_Wu16 732.000000000 DINH_FIdVerb 0.00 732.000000000 FORMAT "%13.9" NUMBER 52 /end CHARACTERISTIC
/begin CHARACTERISTIC DINH_FId.DSQ_PEnvVld_CA "inhibitable FIds / FIds to be inhibited by inhibit source DSQ_PEnvVld" VAL_BLK 0x804EDBB0 ValA_Wu16 732.000000000 DINH_FIdVerb 0.00 732.000000000 FORMAT "%13.9" NUMBER 52 /end CHARACTERISTIC
/begin CHARACTERISTIC DINH_FId.DSQ_PEnv_pRaw_CA "inhibitable FIds / FIds to be inhibited by inhibit source DSQ_PEnv_pRaw" VAL_BLK 0x804EDC18 ValA_Wu16 732.000000000 DINH_FIdVerb 0.00 732.000000000 FORMAT "%13.9" NUMBER 51 /end CHARACTERISTIC
/begin CHARACTERISTIC DINH_FId.DSQ_PThrVlvUs_CA "inhibitable FIds / FIds to be inhibited by inhibit source DSQ_PThrVlvUs" VAL_BLK 0x804EDC7E ValA_Wu16 732.000000000 DINH_FIdVerb 0.00 732.000000000 FORMAT "%13.9" NUMBER 50 /end CHARACTERISTIC
/begin CHARACTERISTIC DINH_FId.DSQ_PThrVlvUsB1_CA "inhibitable FIds / FIds to be inhibited by inhibit source DSQ_PThrVlvUsB1" VAL_BLK 0x804EDCE2 ValA_Wu16 732.000000000 DINH_FIdVerb 0.00 732.000000000 FORMAT "%13.9" NUMBER 50 /end CHARACTERISTIC
/begin CHARACTERISTIC DINH_FId.DSQ_StrtImobChk_CA "inhibitable FIds / FIds to be inhibited by inhibit source DSQ_StrtImobChk" VAL_BLK 0x804EDD46 ValA_Wu16 732.000000000 DINH_FIdVerb 0.00 732.000000000 FORMAT "%13.9" NUMBER 50 /end CHARACTERISTIC
/begin CHARACTERISTIC DINH_FId.DSQ_TDevCenColdStrt_CA "inhibitable FIds / FIds to be inhibited by inhibit source DSQ_TDevCenColdStrt" VAL_BLK 0x804EDDAA ValA_Wu16 732.000000000 DINH_FIdVerb 0.00 732.000000000 FORMAT "%13.9" NUMBER 52 /end CHARACTERISTIC
/begin CHARACTERISTIC DINH_FId.DSQ_UEGOHeatrPwrOKS1B1_CA "inhibitable FIds / FIds to be inhibited by inhibit source DSQ_UEGOHeatrPwrOKS1B1" VAL_BLK 0x804EDE12 ValA_Wu16 732.000000000 DINH_FIdVerb 0.00 732.000000000 FORMAT "%13.9" NUMBER 50 /end CHARACTERISTIC
/begin CHARACTERISTIC DINH_FId.DSQ_UEGOIPmpS1B1_CA "inhibitable FIds / FIds to be inhibited by inhibit source DSQ_UEGOIPmpS1B1" VAL_BLK 0x804EDE76 ValA_Wu16 732.000000000 DINH_FIdVerb 0.00 732.000000000 FORMAT "%13.9" NUMBER 57 /end CHARACTERISTIC
/begin CHARACTERISTIC DINH_FId.DSQ_UEGOLamS1B1_CA "inhibitable FIds / FIds to be inhibited by inhibit source DSQ_UEGOLamS1B1" VAL_BLK 0x804EDEE8 ValA_Wu16 732.000000000 DINH_FIdVerb 0.00 732.000000000 FORMAT "%13.9" NUMBER 52 /end CHARACTERISTIC
/begin CHARACTERISTIC DINH_FId.DSQ_UEGOTCtrlS1B1_CA "inhibitable FIds / FIds to be inhibited by inhibit source DSQ_UEGOTCtrlS1B1" VAL_BLK 0x804EDF50 ValA_Wu16 732.000000000 DINH_FIdVerb 0.00 732.000000000 FORMAT "%13.9" NUMBER 61 /end CHARACTERISTIC
/begin CHARACTERISTIC DINH_FId.DSQ_VehV_CA "inhibitable FIds / FIds to be inhibited by inhibit source DSQ_VehV" VAL_BLK 0x804EDFCA ValA_Wu16 732.000000000 DINH_FIdVerb 0.00 732.000000000 FORMAT "%13.9" NUMBER 55 /end CHARACTERISTIC
/begin CHARACTERISTIC DINH_FId.DSQ_VehVSnsr_CA "inhibitable FIds / FIds to be inhibited by inhibit source DSQ_VehVSnsr" VAL_BLK 0x804EE038 ValA_Wu16 732.000000000 DINH_FIdVerb 0.00 732.000000000 FORMAT "%13.9" NUMBER 62 /end CHARACTERISTIC
/begin CHARACTERISTIC DINH_FId.DSQ_stAPP_CA "inhibitable FIds / FIds to be inhibited by inhibit source DSQ_stAPP" VAL_BLK 0x804EE0B4 ValA_Wu16 732.000000000 DINH_FIdVerb 0.00 732.000000000 FORMAT "%13.9" NUMBER 58 /end CHARACTERISTIC
/begin CHARACTERISTIC DINH_FId.DSQ_stComEAT4_CA "inhibitable FIds / FIds to be inhibited by inhibit source DSQ_stComEAT4" VAL_BLK 0x804EE128 ValA_Wu16 732.000000000 DINH_FIdVerb 0.00 732.000000000 FORMAT "%13.9" NUMBER 50 /end CHARACTERISTIC
/begin CHARACTERISTIC DINH_Lim.DFC_AltIOACGFailr_CA "inhibit conditions / inhibit limit conditions for inhibit source DFC_AltIOACGFailr" VAL_BLK 0x804EEBAE ValA_Wu8 17.0000000000 DINH_LimDFCVerb 0.00 17.0000000000 FORMAT "%13.10" NUMBER 63 /end CHARACTERISTIC
/begin CHARACTERISTIC DINH_Lim.DFC_AltIOACGHiVltg_CA "inhibit conditions / inhibit limit conditions for inhibit source DFC_AltIOACGHiVltg" VAL_BLK 0x804EEBED ValA_Wu8 17.0000000000 DINH_LimDFCVerb 0.00 17.0000000000 FORMAT "%13.10" NUMBER 63 /end CHARACTERISTIC
/begin CHARACTERISTIC DINH_Lim.DFC_AltIOACGLoVltg_CA "inhibit conditions / inhibit limit conditions for inhibit source DFC_AltIOACGLoVltg" VAL_BLK 0x804EEC2C ValA_Wu8 17.0000000000 DINH_LimDFCVerb 0.00 17.0000000000 FORMAT "%13.10" NUMBER 63 /end CHARACTERISTIC
/begin CHARACTERISTIC DINH_Lim.DFC_AltIOACGTHi_CA "inhibit conditions / inhibit limit conditions for inhibit source DFC_AltIOACGTHi" VAL_BLK 0x804EEC6B ValA_Wu8 17.0000000000 DINH_LimDFCVerb 0.00 17.0000000000 FORMAT "%13.10" NUMBER 58 /end CHARACTERISTIC
/begin CHARACTERISTIC DINH_Lim.DFC_AltIODConnACG_CA "inhibit conditions / inhibit limit conditions for inhibit source DFC_AltIODConnACG" VAL_BLK 0x804EECA5 ValA_Wu8 17.0000000000 DINH_LimDFCVerb 0.00 17.0000000000 FORMAT "%13.10" NUMBER 63 /end CHARACTERISTIC
/begin CHARACTERISTIC DINH_Lim.DFC_BattUHiFailr_CA "inhibit conditions / inhibit limit conditions for inhibit source DFC_BattUHiFailr" VAL_BLK 0x804EECE4 ValA_Wu8 17.0000000000 DINH_LimDFCVerb 0.00 17.0000000000 FORMAT "%13.10" NUMBER 3 /end CHARACTERISTIC
/begin CHARACTERISTIC DINH_Lim.DFC_BattULoFailr_CA "inhibit conditions / inhibit limit conditions for inhibit source DFC_BattULoFailr" VAL_BLK 0x804EECE7 ValA_Wu8 17.0000000000 DINH_LimDFCVerb 0.00 17.0000000000 FORMAT "%13.10" NUMBER 3 /end CHARACTERISTIC
/begin CHARACTERISTIC DINH_Lim.DFC_BrkBstPDriftHiErr_CA "inhibit conditions / inhibit limit conditions for inhibit source DFC_BrkBstPDriftHiErr" VAL_BLK 0x804EECEA ValA_Wu8 17.0000000000 DINH_LimDFCVerb 0.00 17.0000000000 FORMAT "%13.10" NUMBER 55 /end CHARACTERISTIC
/begin CHARACTERISTIC DINH_Lim.DFC_BrkBstPDriftLoErr_CA "inhibit conditions / inhibit limit conditions for inhibit source DFC_BrkBstPDriftLoErr" VAL_BLK 0x804EED21 ValA_Wu8 17.0000000000 DINH_LimDFCVerb 0.00 17.0000000000 FORMAT "%13.10" NUMBER 55 /end CHARACTERISTIC
/begin CHARACTERISTIC DINH_Lim.DFC_BrkBstPSnsrStuck_CA "inhibit conditions / inhibit limit conditions for inhibit source DFC_BrkBstPSnsrStuck" VAL_BLK 0x804EED58 ValA_Wu8 17.0000000000 DINH_LimDFCVerb 0.00 17.0000000000 FORMAT "%13.10" NUMBER 56 /end CHARACTERISTIC
/begin CHARACTERISTIC DINH_Lim.DFC_BrkMnSwtContOn_CA "inhibit conditions / inhibit limit conditions for inhibit source DFC_BrkMnSwtContOn" VAL_BLK 0x804EED90 ValA_Wu8 17.0000000000 DINH_LimDFCVerb 0.00 17.0000000000 FORMAT "%13.10" NUMBER 55 /end CHARACTERISTIC
/begin CHARACTERISTIC DINH_Lim.DFC_BrkMnSwtNotStp_CA "inhibit conditions / inhibit limit conditions for inhibit source DFC_BrkMnSwtNotStp" VAL_BLK 0x804EEDC7 ValA_Wu8 17.0000000000 DINH_LimDFCVerb 0.00 17.0000000000 FORMAT "%13.10" NUMBER 55 /end CHARACTERISTIC
/begin CHARACTERISTIC DINH_Lim.DFC_BrkNpl_CA "inhibit conditions / inhibit limit conditions for inhibit source DFC_BrkNpl" VAL_BLK 0x804EEDFE ValA_Wu8 17.0000000000 DINH_LimDFCVerb 0.00 17.0000000000 FORMAT "%13.10" NUMBER 54 /end CHARACTERISTIC
/begin CHARACTERISTIC DINH_Lim.DFC_BrkRdntSwtContOn_CA "inhibit conditions / inhibit limit conditions for inhibit source DFC_BrkRdntSwtContOn" VAL_BLK 0x804EEE34 ValA_Wu8 17.0000000000 DINH_LimDFCVerb 0.00 17.0000000000 FORMAT "%13.10" NUMBER 55 /end CHARACTERISTIC
/begin CHARACTERISTIC DINH_Lim.DFC_BrkRdntSwtNotStp_CA "inhibit conditions / inhibit limit conditions for inhibit source DFC_BrkRdntSwtNotStp" VAL_BLK 0x804EEE6B ValA_Wu8 17.0000000000 DINH_LimDFCVerb 0.00 17.0000000000 FORMAT "%13.10" NUMBER 55 /end CHARACTERISTIC
/begin CHARACTERISTIC DINH_Lim.DFC_Clth3ONStuck_CA "inhibit conditions / inhibit limit conditions for inhibit source DFC_Clth3ONStuck" VAL_BLK 0x804EEEA2 ValA_Wu8 17.0000000000 DINH_LimDFCVerb 0.00 17.0000000000 FORMAT "%13.10" NUMBER 61 /end CHARACTERISTIC
/begin CHARACTERISTIC DINH_Lim.DFC_Clth4OFFStuck_CA "inhibit conditions / inhibit limit conditions for inhibit source DFC_Clth4OFFStuck" VAL_BLK 0x804EEEDF ValA_Wu8 17.0000000000 DINH_LimDFCVerb 0.00 17.0000000000 FORMAT "%13.10" NUMBER 59 /end CHARACTERISTIC
/begin CHARACTERISTIC DINH_Lim.DFC_ClthOFFStuck_CA "inhibit conditions / inhibit limit conditions for inhibit source DFC_ClthOFFStuck" VAL_BLK 0x804EEF1A ValA_Wu8 17.0000000000 DINH_LimDFCVerb 0.00 17.0000000000 FORMAT "%13.10" NUMBER 60 /end CHARACTERISTIC
/begin CHARACTERISTIC DINH_Lim.DFC_ClthONStuck_CA "inhibit conditions / inhibit limit conditions for inhibit source DFC_ClthONStuck" VAL_BLK 0x804EEF56 ValA_Wu8 17.0000000000 DINH_LimDFCVerb 0.00 17.0000000000 FORMAT "%13.10" NUMBER 60 /end CHARACTERISTIC
/begin CHARACTERISTIC DINH_Lim.DFC_ClthStkFailInfo_CA "inhibit conditions / inhibit limit conditions for inhibit source DFC_ClthStkFailInfo" VAL_BLK 0x804EEF92 ValA_Wu8 17.0000000000 DINH_LimDFCVerb 0.00 17.0000000000 FORMAT "%13.10" NUMBER 68 /end CHARACTERISTIC
/begin CHARACTERISTIC DINH_Lim.DFC_ComACFailInfo_CA "inhibit conditions / inhibit limit conditions for inhibit source DFC_ComACFailInfo" VAL_BLK 0x804EEFD6 ValA_Wu8 17.0000000000 DINH_LimDFCVerb 0.00 17.0000000000 FORMAT "%13.10" NUMBER 53 /end CHARACTERISTIC
/begin CHARACTERISTIC DINH_Lim.DFC_ComATFTValErr_CA "inhibit conditions / inhibit limit conditions for inhibit source DFC_ComATFTValErr" VAL_BLK 0x804EF00B ValA_Wu8 17.0000000000 DINH_LimDFCVerb 0.00 17.0000000000 FORMAT "%13.10" NUMBER 50 /end CHARACTERISTIC
/begin CHARACTERISTIC DINH_Lim.DFC_ComATMILReq_CA "inhibit conditions / inhibit limit conditions for inhibit source DFC_ComATMILReq" VAL_BLK 0x804EF03D ValA_Wu8 17.0000000000 DINH_LimDFCVerb 0.00 17.0000000000 FORMAT "%13.10" NUMBER 50 /end CHARACTERISTIC
/begin CHARACTERISTIC DINH_Lim.DFC_ComAYCAChksum_CA "inhibit conditions / inhibit limit conditions for inhibit source DFC_ComAYCAChksum" VAL_BLK 0x804EF06F ValA_Wu8 17.0000000000 DINH_LimDFCVerb 0.00 17.0000000000 FORMAT "%13.10" NUMBER 65 /end CHARACTERISTIC
/begin CHARACTERISTIC DINH_Lim.DFC_ComAYCARingCnt_CA "inhibit conditions / inhibit limit conditions for inhibit source DFC_ComAYCARingCnt" VAL_BLK 0x804EF0B0 ValA_Wu8 17.0000000000 DINH_LimDFCVerb 0.00 17.0000000000 FORMAT "%13.10" NUMBER 65 /end CHARACTERISTIC
/begin CHARACTERISTIC DINH_Lim.DFC_ComAYCATOut_CA "inhibit conditions / inhibit limit conditions for inhibit source DFC_ComAYCATOut" VAL_BLK 0x804EF0F1 ValA_Wu8 17.0000000000 DINH_LimDFCVerb 0.00 17.0000000000 FORMAT "%13.10" NUMBER 65 /end CHARACTERISTIC
/begin CHARACTERISTIC DINH_Lim.DFC_ComAYCDChkSum_CA "inhibit conditions / inhibit limit conditions for inhibit source DFC_ComAYCDChkSum" VAL_BLK 0x804EF132 ValA_Wu8 17.0000000000 DINH_LimDFCVerb 0.00 17.0000000000 FORMAT "%13.10" NUMBER 64 /end CHARACTERISTIC
/begin CHARACTERISTIC DINH_Lim.DFC_ComAYCDTOut_CA "inhibit conditions / inhibit limit conditions for inhibit source DFC_ComAYCDTOut" VAL_BLK 0x804EF172 ValA_Wu8 17.0000000000 DINH_LimDFCVerb 0.00 17.0000000000 FORMAT "%13.10" NUMBER 64 /end CHARACTERISTIC
/begin CHARACTERISTIC DINH_Lim.DFC_ComAYCFChksum_CA "inhibit conditions / inhibit limit conditions for inhibit source DFC_ComAYCFChksum" VAL_BLK 0x804EF1B2 ValA_Wu8 17.0000000000 DINH_LimDFCVerb 0.00 17.0000000000 FORMAT "%13.10" NUMBER 67 /end CHARACTERISTIC
/begin CHARACTERISTIC DINH_Lim.DFC_ComAYCFRingCnt_CA "inhibit conditions / inhibit limit conditions for inhibit source DFC_ComAYCFRingCnt" VAL_BLK 0x804EF1F5 ValA_Wu8 17.0000000000 DINH_LimDFCVerb 0.00 17.0000000000 FORMAT "%13.10" NUMBER 67 /end CHARACTERISTIC
/begin CHARACTERISTIC DINH_Lim.DFC_ComAYCFTOut_CA "inhibit conditions / inhibit limit conditions for inhibit source DFC_ComAYCFTOut" VAL_BLK 0x804EF238 ValA_Wu8 17.0000000000 DINH_LimDFCVerb 0.00 17.0000000000 FORMAT "%13.10" NUMBER 67 /end CHARACTERISTIC
/begin CHARACTERISTIC DINH_Lim.DFC_ComAYCGChksum_CA "inhibit conditions / inhibit limit conditions for inhibit source DFC_ComAYCGChksum" VAL_BLK 0x804EF27B ValA_Wu8 17.0000000000 DINH_LimDFCVerb 0.00 17.0000000000 FORMAT "%13.10" NUMBER 64 /end CHARACTERISTIC
/begin CHARACTERISTIC DINH_Lim.DFC_ComAYCGRingCnt_CA "inhibit conditions / inhibit limit conditions for inhibit source DFC_ComAYCGRingCnt" VAL_BLK 0x804EF2BB ValA_Wu8 17.0000000000 DINH_LimDFCVerb 0.00 17.0000000000 FORMAT "%13.10" NUMBER 64 /end CHARACTERISTIC
/begin CHARACTERISTIC DINH_Lim.DFC_ComAYCGTOut_CA "inhibit conditions / inhibit limit conditions for inhibit source DFC_ComAYCGTOut" VAL_BLK 0x804EF2FB ValA_Wu8 17.0000000000 DINH_LimDFCVerb 0.00 17.0000000000 FORMAT "%13.10" NUMBER 64 /end CHARACTERISTIC
/begin CHARACTERISTIC DINH_Lim.DFC_ComAYCIChkSum_CA "inhibit conditions / inhibit limit conditions for inhibit source DFC_ComAYCIChkSum" VAL_BLK 0x804EF33B ValA_Wu8 17.0000000000 DINH_LimDFCVerb 0.00 17.0000000000 FORMAT "%13.10" NUMBER 56 /end CHARACTERISTIC
/begin CHARACTERISTIC DINH_Lim.DFC_ComAYCIRingCnt_CA "inhibit conditions / inhibit limit conditions for inhibit source DFC_ComAYCIRingCnt" VAL_BLK 0x804EF373 ValA_Wu8 17.0000000000 DINH_LimDFCVerb 0.00 17.0000000000 FORMAT "%13.10" NUMBER 56 /end CHARACTERISTIC
/begin CHARACTERISTIC DINH_Lim.DFC_ComAYCITOut_CA "inhibit conditions / inhibit limit conditions for inhibit source DFC_ComAYCITOut" VAL_BLK 0x804EF3AB ValA_Wu8 17.0000000000 DINH_LimDFCVerb 0.00 17.0000000000 FORMAT "%13.10" NUMBER 56 /end CHARACTERISTIC
/begin CHARACTERISTIC DINH_Lim.DFC_ComBCM1ChkSum_CA "inhibit conditions / inhibit limit conditions for inhibit source DFC_ComBCM1ChkSum" VAL_BLK 0x804EF3E3 ValA_Wu8 17.0000000000 DINH_LimDFCVerb 0.00 17.0000000000 FORMAT "%13.10" NUMBER 53 /end CHARACTERISTIC
/begin CHARACTERISTIC DINH_Lim.DFC_ComBCM1RingCnt_CA "inhibit conditions / inhibit limit conditions for inhibit source DFC_ComBCM1RingCnt" VAL_BLK 0x804EF418 ValA_Wu8 17.0000000000 DINH_LimDFCVerb 0.00 17.0000000000 FORMAT "%13.10" NUMBER 53 /end CHARACTERISTIC
/begin CHARACTERISTIC DINH_Lim.DFC_ComBCM1TOut_CA "inhibit conditions / inhibit limit conditions for inhibit source DFC_ComBCM1TOut" VAL_BLK 0x804EF44D ValA_Wu8 17.0000000000 DINH_LimDFCVerb 0.00 17.0000000000 FORMAT "%13.10" NUMBER 53 /end CHARACTERISTIC
/begin CHARACTERISTIC DINH_Lim.DFC_ComCANABusOffErr_CA "inhibit conditions / inhibit limit conditions for inhibit source DFC_ComCANABusOffErr" VAL_BLK 0x804EF482 ValA_Wu8 17.0000000000 DINH_LimDFCVerb 0.00 17.0000000000 FORMAT "%13.10" NUMBER 206 /end CHARACTERISTIC
/begin CHARACTERISTIC DINH_Lim.DFC_ComCANBBusOffErr_CA "inhibit conditions / inhibit limit conditions for inhibit source DFC_ComCANBBusOffErr" VAL_BLK 0x804EF550 ValA_Wu8 17.0000000000 DINH_LimDFCVerb 0.00 17.0000000000 FORMAT "%13.10" NUMBER 200 /end CHARACTERISTIC
/begin CHARACTERISTIC DINH_Lim.DFC_ComCANCBusOffErr_CA "inhibit conditions / inhibit limit conditions for inhibit source DFC_ComCANCBusOffErr" VAL_BLK 0x804EF618 ValA_Wu8 17.0000000000 DINH_LimDFCVerb 0.00 17.0000000000 FORMAT "%13.10" NUMBER 200 /end CHARACTERISTIC
/begin CHARACTERISTIC DINH_Lim.DFC_ComCGW1ChkSum_CA "inhibit conditions / inhibit limit conditions for inhibit source DFC_ComCGW1ChkSum" VAL_BLK 0x804EF6E0 ValA_Wu8 17.0000000000 DINH_LimDFCVerb 0.00 17.0000000000 FORMAT "%13.10" NUMBER 51 /end CHARACTERISTIC
/begin CHARACTERISTIC DINH_Lim.DFC_ComCGW1RingCnt_CA "inhibit conditions / inhibit limit conditions for inhibit source DFC_ComCGW1RingCnt" VAL_BLK 0x804EF713 ValA_Wu8 17.0000000000 DINH_LimDFCVerb 0.00 17.0000000000 FORMAT "%13.10" NUMBER 51 /end CHARACTERISTIC
/begin CHARACTERISTIC DINH_Lim.DFC_ComCGW1TOut_CA "inhibit conditions / inhibit limit conditions for inhibit source DFC_ComCGW1TOut" VAL_BLK 0x804EF746 ValA_Wu8 17.0000000000 DINH_LimDFCVerb 0.00 17.0000000000 FORMAT "%13.10" NUMBER 51 /end CHARACTERISTIC
/begin CHARACTERISTIC DINH_Lim.DFC_ComConvBoostErr_CA "inhibit conditions / inhibit limit conditions for inhibit source DFC_ComConvBoostErr" VAL_BLK 0x804EF779 ValA_Wu8 17.0000000000 DINH_LimDFCVerb 0.00 17.0000000000 FORMAT "%13.10" NUMBER 51 /end CHARACTERISTIC
/begin CHARACTERISTIC DINH_Lim.DFC_ComConvSlipErr_CA "inhibit conditions / inhibit limit conditions for inhibit source DFC_ComConvSlipErr" VAL_BLK 0x804EF7AC ValA_Wu8 17.0000000000 DINH_LimDFCVerb 0.00 17.0000000000 FORMAT "%13.10" NUMBER 51 /end CHARACTERISTIC
/begin CHARACTERISTIC DINH_Lim.DFC_ComEAT10Chksum_CA "inhibit conditions / inhibit limit conditions for inhibit source DFC_ComEAT10Chksum" VAL_BLK 0x804EF7DF ValA_Wu8 17.0000000000 DINH_LimDFCVerb 0.00 17.0000000000 FORMAT "%13.10" NUMBER 60 /end CHARACTERISTIC
/begin CHARACTERISTIC DINH_Lim.DFC_ComEAT10RingCnt_CA "inhibit conditions / inhibit limit conditions for inhibit source DFC_ComEAT10RingCnt" VAL_BLK 0x804EF81B ValA_Wu8 17.0000000000 DINH_LimDFCVerb 0.00 17.0000000000 FORMAT "%13.10" NUMBER 60 /end CHARACTERISTIC
/begin CHARACTERISTIC DINH_Lim.DFC_ComEAT10TOut_CA "inhibit conditions / inhibit limit conditions for inhibit source DFC_ComEAT10TOut" VAL_BLK 0x804EF857 ValA_Wu8 17.0000000000 DINH_LimDFCVerb 0.00 17.0000000000 FORMAT "%13.10" NUMBER 60 /end CHARACTERISTIC
/begin CHARACTERISTIC DINH_Lim.DFC_ComEAT11ChkSum_CA "inhibit conditions / inhibit limit conditions for inhibit source DFC_ComEAT11ChkSum" VAL_BLK 0x804EF893 ValA_Wu8 17.0000000000 DINH_LimDFCVerb 0.00 17.0000000000 FORMAT "%13.10" NUMBER 53 /end CHARACTERISTIC
/begin CHARACTERISTIC DINH_Lim.DFC_ComEAT11RingCnt_CA "inhibit conditions / inhibit limit conditions for inhibit source DFC_ComEAT11RingCnt" VAL_BLK 0x804EF8C8 ValA_Wu8 17.0000000000 DINH_LimDFCVerb 0.00 17.0000000000 FORMAT "%13.10" NUMBER 53 /end CHARACTERISTIC
/begin CHARACTERISTIC DINH_Lim.DFC_ComEAT11TOut_CA "inhibit conditions / inhibit limit conditions for inhibit source DFC_ComEAT11TOut" VAL_BLK 0x804EF8FD ValA_Wu8 17.0000000000 DINH_LimDFCVerb 0.00 17.0000000000 FORMAT "%13.10" NUMBER 53 /end CHARACTERISTIC
/begin CHARACTERISTIC DINH_Lim.DFC_ComEAT12ChkSum_CA "inhibit conditions / inhibit limit conditions for inhibit source DFC_ComEAT12ChkSum" VAL_BLK 0x804EF932 ValA_Wu8 17.0000000000 DINH_LimDFCVerb 0.00 17.0000000000 FORMAT "%13.10" NUMBER 53 /end CHARACTERISTIC
/begin FUNCTION DINH "30000.27.0_1.0.0Diagnostic Inhibit Handler"
 /begin DEF_CHARACTERISTIC DINH_FId.DFC_ComVehSpdPndFltTCU_CA DINH_FId.DFC_EbsChartcCurrErr_CA DINH_FId.DFC_EbsSelfDiagErr_CA DINH_FId.DFC_GbxCANDigPlausErr_CA DINH_FId.DFC_GbxNPos1SRCMax_CA DINH_FId.DFC_GbxNPos1SRCMin_CA DINH_FId.DFC_GbxNPos2SRCMax_CA DINH_FId.DFC_GbxNPos2SRCMin_CA DINH_FId.DFC_GbxNPosAlvChk_CA DINH_FId.DFC_GbxNPosSyncErr_CA DINH_FId.DFC_HEGOS2B1HtrPsMax_CA DINH_FId.DFC_HEGOS2B1HtrPsMin_CA DINH_FId.DFC_HEGOS2B1HtrPsSig_CA DINH_FId.DFC_LinCSErrACG_CA DINH_FId.DFC_LinCSErrEBS_CA DINH_FId.DFC_LinHdrTimeoutErrACG_CA DINH_FId.DFC_LinHdrTimeoutErrEBS_CA DINH_FId.DFC_LinMsgTimeoutErrACG_CA DINH_FId.DFC_LinMsgTimeoutErrEBS_CA DINH_FId.DFC_LinNoStrtComErr_CA DINH_FId.DFC_MisfDetVWhlFrntLeOORHi_CA DINH_FId.DFC_MisfDetVWhlFrntLeRatyHi_CA DINH_FId.DFC_MisfDetVWhlFrntLeRatyLo_CA DINH_FId.DFC_MisfDetVWhlFrntLeStuck_CA DINH_FId.DFC_MisfDetVWhlFrntRiOORHi_CA DINH_FId.DFC_MisfDetVWhlFrntRiRatyHi_CA DINH_FId.DFC_MisfDetVWhlFrntRiRatyLo_CA DINH_FId.DFC_MisfDetVWhlFrntRiStuck_CA DINH_FId.DFC_MisfDetVWhlReLeOORHi_CA DINH_FId.DFC_MisfDetVWhlReLeRatyHi_CA DINH_FId.DFC_MisfDetVWhlReLeRatyLo_CA DINH_FId.DFC_MisfDetVWhlReLeStuck_CA DINH_FId.DFC_MisfDetVWhlReRiOORHi_CA DINH_FId.DFC_MisfDetVWhlReRiRatyHi_CA DINH_FId.DFC_MisfDetVWhlReRiRatyLo_CA DINH_FId.DFC_MisfDetVWhlReRiStuck_CA DINH_FId.DFC_MisfDetdVWhlFrntLePlaus_CA DINH_FId.DFC_MisfDetdVWhlFrntRiPlaus_CA DINH_FId.DFC_MisfDetdVWhlReLePlaus_CA DINH_FId.DFC_MisfDetdVWhlReRiPlaus_CA DINH_FId.DFC_PEnvSigRngMax_CA DINH_FId.DFC_PEnvSigRngMin_CA DINH_FId.DFC_StmFault_CA DINH_FId.DFC_StrtCtOffPth_CA DINH_FId.DFC_StrtCtlErr_CA DINH_FId.DFC_StrtFault_CA DINH_FId.DFC_StrtLckJudg1_CA DINH_FId.DFC_StrtLckJudg2_CA DINH_FId.DFC_StrtOL_CA DINH_FId.DFC_StrtOL2_CA DINH_FId.DFC_StrtSCB_CA DINH_FId.DFC_StrtSCB2_CA DINH_FId.DFC_StrtSCG_CA DINH_FId.DFC_StrtSCG2_CA DINH_FId.DFC_StrtStkRly1_CA DINH_FId.DFC_StrtStkRly2_CA DINH_FId.DFC_TEVEmax_CA DINH_FId.DFC_TEVEmin_CA DINH_FId.DFC_TEVEsig_CA DINH_FId.DFC_VehVAllPlaus_CA DINH_FId.DFC_VehVNCSnsrElecFailr_CA DINH_FId.DFC_VehVPlausCan_CA DINH_FId.DFC_VehVPlausFco_CA DINH_FId.DFC_VehVPlausPwr_CA DINH_FId.DFC_VehVPlausV2N_CA DINH_FId.DFC_VehVSpdSnsrAElecFailr_CA DINH_FId.DFC_VehVSpdSnsrBElecFailr_CA DINH_FId.DFC_ClthMax_CA DINH_FId.DFC_IgnClPs_DevComErr_CA DINH_FId.DFC_IgnClPs_LineOl_0_CA DINH_FId.DFC_IgnClPs_LineOl_1_CA DINH_FId.DFC_IgnClPs_LineOl_2_CA DINH_FId.DFC_IgnClPs_LineOl_3_CA DINH_FId.DFC_IgnClPs_LineScb_0_CA DINH_FId.DFC_IgnClPs_LineScb_1_CA DINH_FId.DFC_IgnClPs_LineScb_2_CA DINH_FId.DFC_IgnClPs_LineScb_3_CA DINH_FId.DFC_IgnClPs_LineScg_0_CA DINH_FId.DFC_IgnClPs_LineScg_1_CA DINH_FId.DFC_IgnClPs_LineScg_2_CA DINH_FId.DFC_IgnClPs_LineScg_3_CA DINH_FId.DFC_UEGOASICS1B1_CA DINH_FId.DFC_UEGOOLIPES1B1_CA DINH_FId.DFC_UEGOOLRES1B1_CA DINH_FId.DFC_UEGOSCBS1B1_CA DINH_FId.DFC_UEGOSCGS1B1_CA DINH_FId.DFC_UEGOSPIS1B1_CA DINH_FId.DFC_UEGOSnsrS1B1_CA DINH_FId.DFC_UegoOlApesS1B1_CA DINH_FId.DFC_UegoOlRCmpS1B1_CA DINH_FId.DFC_AirCCmprOL_CA DINH_FId.DFC_AirCCmprOvrTemp_CA DINH_FId.DFC_AirCCmprSCB_CA DINH_FId.DFC_AirCCmprSCG_CA DINH_FId.DFC_AltErr_CA DINH_FId.DFC_BattUSRCMax_CA DINH_FId.DFC_BattUSRCMin_CA DINH_FId.DFC_ComChksTCU1_CA DINH_FId.DFC_ComChksTCU11_CA DINH_FId.DFC_ComChksTCU12_CA DINH_FId.DFC_ComChksTCU13_CA DINH_FId.DFC_ComChksTCU2_CA DINH_FId.DFC_ComChksTCU3_CA DINH_FId.DFC_ComChksTCU4_CA DINH_FId.DFC_ComCntTCU1_CA DINH_FId.DFC_ComCntTCU11_CA DINH_FId.DFC_ComCntTCU12_CA DINH_FId.DFC_ComCntTCU13_CA DINH_FId.DFC_ComCntTCU2_CA DINH_FId.DFC_ComCntTCU3_CA DINH_FId.DFC_ComCntTCU4_CA DINH_FId.DFC_ComTOutTCU01_CA DINH_FId.DFC_ComTOutTCU02_CA DINH_FId.DFC_ComTOutTCU1_CA DINH_FId.DFC_ComTOutTCU11_CA DINH_FId.DFC_ComTOutTCU12_CA DINH_FId.DFC_ComTOutTCU13_CA DINH_FId.DFC_ComTOutTCU14_CA DINH_FId.DFC_ComTOutTCU2_CA DINH_FId.DFC_ComTOutTCU3_CA DINH_FId.DFC_ComTOutTCU4_CA DINH_FId.DFC_DevLibBattUHi_CA DINH_FId.DFC_DevLibBattULo_CA DINH_FId.DFC_FanDIOOL_0_CA DINH_FId.DFC_FanDIOOL_1_CA DINH_FId.DFC_FanDIOOvrTemp_0_CA DINH_FId.DFC_FanDIOOvrTemp_1_CA DINH_FId.DFC_FanDIOSCB_0_CA DINH_FId.DFC_FanDIOSCB_1_CA DINH_FId.DFC_FanDIOSCG_0_CA DINH_FId.DFC_FanDIOSCG_1_CA DINH_FId.DFC_MRlyDcOL_CA DINH_FId.DFC_MRlyDcSCB_CA DINH_FId.DFC_MRlyDcSCG_CA DINH_FId.DFC_PSPOL_CA DINH_FId.DFC_PSPOvrTemp_CA DINH_FId.DFC_PSPSCB_CA DINH_FId.DFC_PSPSCG_CA DINH_FId.DFC_T50Err_CA DINH_FId.DFC_ThrVlvLoBattB1_CA DINH_FId.DFC_VehVPhysRngHi_CA DINH_FId.DFC_VehVSclOutOL_CA DINH_FId.DFC_VehVSclOutOT_CA DINH_FId.DFC_VehVSclOutSCB_CA DINH_FId.DFC_VehVSclOutSCG_CA DINH_FId.DFC_VehVSnsrARngHi_CA DINH_FId.DFC_VehVSnsrBRngHi_CA DINH_FId.DFC_VehVSpdRtyDiag_CA DINH_FId.DFC_VehVWhlErr_CA DINH_FId.DFC_ACEvpTSRCMax_CA DINH_FId.DFC_ACEvpTSRCMin_CA DINH_FId.DFC_AirCClntPAnaSRCMax_CA DINH_FId.DFC_AirCClntPAnaSRCMin_CA DINH_FId.DFC_AirCSwtNpl_CA DINH_FId.DFC_AirCSwtSig_CA DINH_FId.DFC_Brk_CA DINH_FId.DFC_BrkSig_CA DINH_FId.DFC_ClthSig_CA DINH_FId.DFC_HLSDemOvhtEngLim_CA DINH_FId.DFC_OilPNpl_CA DINH_FId.DFC_PIntkVUsLineHiB1_CA DINH_FId.DFC_PIntkVUsLineLoB1_CA DINH_FId.DFC_VehVPhysRngLo_CA DINH_FId.DFC_VehVSigCan_CA DINH_FId.DFC_VehVSigCanSafe_CA DINH_FId.DFC_VlvLftFbOilPSnsrIntk11SRCMax_CA DINH_FId.DFC_VlvLftFbOilPSnsrIntk11SRCMin_CA DINH_FId.DFC_ClthNpl_CA DINH_FId.DFC_EV1max_CA DINH_FId.DFC_EV1min_CA DINH_FId.DFC_EV1sig_CA DINH_FId.DFC_EV2max_CA DINH_FId.DFC_EV2min_CA DINH_FId.DFC_EV2sig_CA DINH_FId.DFC_EV3max_CA DINH_FId.DFC_EV3min_CA DINH_FId.DFC_EV3sig_CA DINH_FId.DFC_EV4max_CA DINH_FId.DFC_EV4min_CA DINH_FId.DFC_EV4sig_CA DINH_FId.DFC_GbxPNPosnDrvCdn_CA DINH_FId.DFC_GbxPNPosnPlausy_CA DINH_FId.DFC_PEnvCcMax_CA DINH_FId.DFC_PEnvCcMin_CA DINH_FId.DFC_PEnvRngChkMax_CA DINH_FId.DFC_PEnvRngChkMin_CA DINH_FId.DFC_PEnvSnsrPlaus_CA DINH_FId.DFC_UEGOHeatrPsS1B1Max_CA DINH_FId.DFC_UEGOHeatrPsS1B1Min_CA DINH_FId.DFC_UEGOHeatrPsS1B1Sig_CA DINH_FId.DFC_UEGOHeatrRlyPsOLS1B1_CA DINH_FId.DFC_UEGOHeatrRlyPsSCBS1B1_CA DINH_FId.DFC_UEGOHeatrRlyPsSCGS1B1_CA DINH_FId.DFC_KnDetSens1PortAMax_CA DINH_FId.DFC_KnDetSens1PortAMin_CA DINH_FId.DFC_KnDetSens1PortBMax_CA DINH_FId.DFC_KnDetSens1PortBMin_CA DINH_FId.DFC_Clth2ONStuck_CA DINH_FId.DFC_Clth2ONStuckLdc_CA DINH_FId.DFC_Clth3ONStuckLdc_CA DINH_FId.DFC_Clth3ONStuckPostDrv_CA DINH_FId.DFC_Clth4ONStuck_CA DINH_FId.DFC_Clth4ONStuckLdc_CA DINH_FId.DFC_ComDLCTCU01_CA DINH_FId.DFC_ComDLCTCU02_CA DINH_FId.DFC_ComDLCTCU1_CA DINH_FId.DFC_ComDLCTCU11_CA DINH_FId.DFC_ComDLCTCU12_CA DINH_FId.DFC_ComDLCTCU13_CA DINH_FId.DFC_ComDLCTCU14_CA DINH_FId.DFC_ComDLCTCU2_CA DINH_FId.DFC_ComDLCTCU3_CA DINH_FId.DFC_ComDLCTCU4_CA DINH_FId.DFC_EVX_CA DINH_FId.DFC_EbsSocFlt_CA DINH_FId.DFC_I14229VINErr_CA DINH_FId.DFC_LLRKHmax_CA DINH_FId.DFC_LLRKHmin_CA DINH_FId.DFC_LLRmax_CA DINH_FId.DFC_LLRmin_CA DINH_FId.DFC_RoughRoad_CA DINH_FId.DFC_SiaEEPRdErr_CA DINH_FId.DFC_SiaEEPWrngCod_CA DINH_FId.DFC_UegoDummy_CA DINH_FId.DFC_BusDiagCANAPPLBusOff_CA DINH_FId.DFC_BusDiagCANCANCBusOff_CA DINH_FId.DFC_BusDiagCANVEHICLEBusOff_CA DINH_FId.DFC_RBA_IODIAGPWR_rba_IoExtCy329_SignalVltSply_0_CA DINH_FId.DFC_RBA_IODIAGPWR_rba_IoExtCy329_SignalVltSply_0OT_CA DINH_FId.DFC_RBA_IODIAGPWR_rba_IoExtCy329_SignalVltSply_0OV_CA DINH_FId.DFC_RBA_IODIAGPWR_rba_IoExtCy329_SignalVltSply_0SCG_CA DINH_FId.DFC_RBA_IODIAGPWR_rba_IoExtCy329_SignalVltSply_0UV_CA DINH_FId.DFC_RBA_IODIAGPWR_rba_IoExtCy329_SignalVltSply_1_CA DINH_FId.DFC_RBA_IODIAGPWR_rba_IoExtCy329_SignalVltSply_1OT_CA DINH_FId.DFC_RBA_IODIAGPWR_rba_IoExtCy329_SignalVltSply_1OV_CA DINH_FId.DFC_RBA_IODIAGPWR_rba_IoExtCy329_SignalVltSply_1SCG_CA DINH_FId.DFC_RBA_IODIAGPWR_rba_IoExtCy329_SignalVltSply_1UV_CA DINH_FId.DFC_RBA_IODIAGPWR_rba_IoExtCy329_SignalVltSply_2_CA DINH_FId.DFC_RBA_IODIAGPWR_rba_IoExtCy329_SignalVltSply_2OT_CA DINH_FId.DFC_RBA_IODIAGPWR_rba_IoExtCy329_SignalVltSply_2OV_CA DINH_FId.DFC_RBA_IODIAGPWR_rba_IoExtCy329_SignalVltSply_2SCG_CA DINH_FId.DFC_RBA_IODIAGPWR_rba_IoExtCy329_SignalVltSply_2UV_CA DINH_FId.DFC_CAN_E_TIMEOUT_CA DINH_FId.DFC_LIN_E_TIMEOUT_CA DINH_FId.DFC_MRlyOL_CA DINH_FId.DFC_MRlySCB_CA DINH_FId.DFC_MRlySCG_CA DINH_FId.DFC_rba_MultiStackTrace_Threshold_CA DINH_FId.DFC_BSWM_E_ACTION_FAILED_CA DINH_FId.DFC_BSWM_E_INTRPTQUEUE_FULL_CA DINH_FId.DFC_RBA_IOEXTLIB_KEEPALIVE_DRV_CA DINH_FId.DFC_RBA_IOEXTLIB_KEEPALIVE_INI_CA DINH_FId.DFC_rba_IoSigRtc_StopCounter_CA DINH_FId.DFC_rba_MRly_Diag_Stk_Event_CA DINH_FId.DFC_rba_MemDiag_MemReadErr_CA DINH_FId.DFC_rba_MemDiag_MemWrErr_CA DINH_FId.DFC_rba_SyC_IrrSwOffTrigEngRun_Event_CA DINH_FId.DFC_rba_T15_Diag_ComInVld_Event_CA DINH_FId.DFC_rba_T15_Diag_ComOff_HwOn_Event_CA DINH_FId.DFC_rba_T15_Diag_ComOn_HwOff_Event_CA DINH_FId.DFC_AppAllSnsrDfct_CA DINH_FId.DFC_BattUStdbyDiaOL_CA DINH_FId.DFC_BigLeakIntkMnfldEmiInfl_CA DINH_FId.DFC_BrkMnSwtContOnWarnLmp_CA DINH_FId.DFC_BrkMnSwtNotStpWarnLmp_CA DINH_FId.DFC_BrkRdntSwtContOnWarnLmp_CA DINH_FId.DFC_BrkRdntSwtNotStpWarnLmp_CA DINH_FId.DFC_CEngDsTColdStrtMax_CA DINH_FId.DFC_CEngDsTColdStrtMin_CA DINH_FId.DFC_CEngDsTImps_CA DINH_FId.DFC_CEngDsTPlausLSC_CA DINH_FId.DFC_CEngDsTPlausSTC_CA DINH_FId.DFC_CEngDsTSRCMax_CA DINH_FId.DFC_CEngDsTSRCMin_CA DINH_FId.DFC_CEngDsTSig_CA DINH_FId.DFC_CEngUsTSRCMax_CA DINH_FId.DFC_CEngUsTSRCMin_CA DINH_FId.DFC_DCDCFltDet_CA DINH_FId.DFC_DKRSA_CA DINH_FId.DFC_DKVSmax_CA DINH_FId.DFC_DKnpl_CA DINH_FId.DFC_DSSmax_CA DINH_FId.DFC_DSTTI_CA DINH_FId.DFC_DSUmax_CA DINH_FId.DFC_EGRVlvOL_CA DINH_FId.DFC_EGRVlvSCB_CA DINH_FId.DFC_EGRVlvSCG_CA DINH_FId.DFC_EGSDUS2B1LtrDly_CA DINH_FId.DFC_EGSDUS2B1LtrPT1_CA DINH_FId.DFC_EGSDUS2B1RtlDly_CA DINH_FId.DFC_EGSDUS2B1RtlPT1_CA DINH_FId.DFC_EGSDUS2B1TarLean_CA DINH_FId.DFC_EGSDUS2B1TarRich_CA DINH_FId.DFC_ETAKHLmax_CA DINH_FId.DFC_ETAKHTmax_CA DINH_FId.DFC_EngICO_CA DINH_FId.DFC_EngPrtOvrSpdMon_CA DINH_FId.DFC_EpmCaSI1ErrSig_CA DINH_FId.DFC_EpmCaSI1NoSig_CA DINH_FId.DFC_EpmCaSI1OfsErr_CA DINH_FId.DFC_EpmCrSErrSig_CA DINH_FId.DFC_EpmCrSNoSig_CA DINH_FId.DFC_EtaEngIdleNonCsers_CA DINH_FId.DFC_EtaEngPtlNonCsers_CA DINH_FId.DFC_FRAmax_CA DINH_FId.DFC_FRAmin_CA DINH_FId.DFC_GbxRvsSwtStk_CA DINH_FId.DFC_HDRmax_CA DINH_FId.DFC_HEGOS2B1ElecMax_CA DINH_FId.DFC_HEGOS2B1ElecMin_CA DINH_FId.DFC_HEGOS2B1ElecSig_CA DINH_FId.DFC_HEGOS2B1HtgNpl_CA DINH_FId.DFC_IntkAirTIntkMnfldCrssMax_CA DINH_FId.DFC_IntkAirTIntkMnfldCrssMin_CA DINH_FId.DFC_IntkAirTIntkMnfldHSCMax_CA DINH_FId.DFC_IntkAirTIntkMnfldImps_CA DINH_FId.DFC_IntkAirTIntkMnfldPRCMax_CA DINH_FId.DFC_IntkAirTIntkMnfldPRCMin_CA DINH_FId.DFC_IntkAirTIntkMnfldSRCMax_CA DINH_FId.DFC_IntkAirTIntkMnfldSRCMin_CA DINH_FId.DFC_IntkAirTIntkMnfldSTC_CA DINH_FId.DFC_KS1max_CA DINH_FId.DFC_KS1min_CA DINH_FId.DFC_LMmax_CA DINH_FId.DFC_LZSRnpl_CA DINH_FId.DFC_LamDynDiagS1B1_CA DINH_FId.DFC_LeakIntkMnfldEmiInfl_CA DINH_FId.DFC_MD00max_CA DINH_FId.DFC_MDBmax_CA DINH_FId.DFC_MDCat_CA DINH_FId.DFC_MDCatCrit_CA DINH_FId.DFC_MDCatCurr_CA DINH_FId.DFC_MDCyl_0_CA DINH_FId.DFC_MDCyl_1_CA DINH_FId.DFC_MDCyl_2_CA DINH_FId.DFC_MDCyl_3_CA DINH_FId.DFC_MDEmi_CA DINH_FId.DFC_MDEmiStrt_CA DINH_FId.DFC_MDFco_CA DINH_FId.DFC_MDMpl_CA DINH_FId.DFC_MDSegTiAdpn_CA DINH_FId.DFC_MDmax_CA DINH_FId.DFC_MOXEMM_SMU_ALM0_0_CA DINH_FId.DFC_MOXEMM_SMU_ALM0_1_CA DINH_FId.DFC_MOXEMM_SMU_ALM0_10_CA DINH_FId.DFC_MOXEMM_SMU_ALM0_11_CA DINH_FId.DFC_MOXEMM_SMU_ALM0_13_CA DINH_FId.DFC_MOXEMM_SMU_ALM0_14_CA DINH_FId.DFC_MOXEMM_SMU_ALM0_2_CA DINH_FId.DFC_MOXEMM_SMU_ALM0_22_CA DINH_FId.DFC_MOXEMM_SMU_ALM0_23_CA DINH_FId.DFC_MOXEMM_SMU_ALM0_4_CA DINH_FId.DFC_MOXEMM_SMU_ALM0_5_CA DINH_FId.DFC_MOXEMM_SMU_ALM0_7_CA DINH_FId.DFC_MOXEMM_SMU_ALM0_8_CA DINH_FId.DFC_MOXEMM_SMU_ALM10_16_CA DINH_FId.DFC_MOXEMM_SMU_ALM10_17_CA DINH_FId.DFC_MOXEMM_SMU_ALM10_21_CA DINH_FId.DFC_MOXEMM_SMU_ALM11_0_CA DINH_FId.DFC_MOXEMM_SMU_ALM11_1_CA DINH_FId.DFC_MOXEMM_SMU_ALM11_2_CA DINH_FId.DFC_MOXEMM_SMU_ALM11_3_CA DINH_FId.DFC_MOXEMM_SMU_ALM11_4_CA DINH_FId.DFC_MOXEMM_SMU_ALM11_5_CA DINH_FId.DFC_MOXEMM_SMU_ALM11_8_CA DINH_FId.DFC_MOXEMM_SMU_ALM11_9_CA DINH_FId.DFC_MOXEMM_SMU_ALM1_0_CA DINH_FId.DFC_MOXEMM_SMU_ALM1_1_CA DINH_FId.DFC_MOXEMM_SMU_ALM1_10_CA DINH_FId.DFC_MOXEMM_SMU_ALM1_11_CA DINH_FId.DFC_MOXEMM_SMU_ALM1_13_CA DINH_FId.DFC_MOXEMM_SMU_ALM1_14_CA DINH_FId.DFC_MOXEMM_SMU_ALM1_2_CA DINH_FId.DFC_MOXEMM_SMU_ALM1_22_CA DINH_FId.DFC_MOXEMM_SMU_ALM1_23_CA DINH_FId.DFC_MOXEMM_SMU_ALM1_4_CA DINH_FId.DFC_MOXEMM_SMU_ALM1_5_CA DINH_FId.DFC_MOXEMM_SMU_ALM1_7_CA DINH_FId.DFC_MOXEMM_SMU_ALM1_8_CA DINH_FId.DFC_MOXEMM_SMU_ALM21_0_CA DINH_FId.DFC_MOXEMM_SMU_ALM21_16_CA DINH_FId.DFC_MOXEMM_SMU_ALM21_3_CA DINH_FId.DFC_MOXEMM_SMU_ALM2_1_CA DINH_FId.DFC_MOXEMM_SMU_ALM2_10_CA DINH_FId.DFC_MOXEMM_SMU_ALM2_11_CA DINH_FId.DFC_MOXEMM_SMU_ALM2_13_CA DINH_FId.DFC_MOXEMM_SMU_ALM2_14_CA DINH_FId.DFC_MOXEMM_SMU_ALM2_22_CA DINH_FId.DFC_MOXEMM_SMU_ALM2_23_CA DINH_FId.DFC_MOXEMM_SMU_ALM2_4_CA DINH_FId.DFC_MOXEMM_SMU_ALM2_5_CA DINH_FId.DFC_MOXEMM_SMU_ALM2_7_CA DINH_FId.DFC_MOXEMM_SMU_ALM2_8_CA DINH_FId.DFC_MOXEMM_SMU_ALM6_0_CA DINH_FId.DFC_MOXEMM_SMU_ALM6_11_CA DINH_FId.DFC_MOXEMM_SMU_ALM6_12_CA DINH_FId.DFC_MOXEMM_SMU_ALM6_14_CA DINH_FId.DFC_MOXEMM_SMU_ALM6_15_CA DINH_FId.DFC_MOXEMM_SMU_ALM6_17_CA DINH_FId.DFC_MOXEMM_SMU_ALM6_18_CA DINH_FId.DFC_MOXEMM_SMU_ALM6_20_CA DINH_FId.DFC_MOXEMM_SMU_ALM6_21_CA DINH_FId.DFC_MOXEMM_SMU_ALM6_25_CA DINH_FId.DFC_MOXEMM_SMU_ALM6_4_CA DINH_FId.DFC_MOXEMM_SMU_ALM6_5_CA DINH_FId.DFC_MOXEMM_SMU_ALM6_7_CA DINH_FId.DFC_MOXEMM_SMU_ALM6_8_CA DINH_FId.DFC_MOXEMM_SMU_ALM7_1_CA DINH_FId.DFC_MOXEMM_SMU_ALM7_12_CA DINH_FId.DFC_MOXEMM_SMU_ALM7_13_CA DINH_FId.DFC_MOXEMM_SMU_ALM7_14_CA DINH_FId.DFC_MOXEMM_SMU_ALM7_15_CA DINH_FId.DFC_MOXEMM_SMU_ALM7_16_CA DINH_FId.DFC_MOXEMM_SMU_ALM7_17_CA DINH_FId.DFC_MOXEMM_SMU_ALM7_2_CA DINH_FId.DFC_MOXEMM_SMU_ALM7_20_CA DINH_FId.DFC_MOXEMM_SMU_ALM7_25_CA DINH_FId.DFC_MOXEMM_SMU_ALM7_26_CA DINH_FId.DFC_MOXEMM_SMU_ALM7_28_CA DINH_FId.DFC_MOXEMM_SMU_ALM7_29_CA DINH_FId.DFC_MOXEMM_SMU_ALM7_30_CA DINH_FId.DFC_MOXEMM_SMU_ALM7_31_CA DINH_FId.DFC_MOXEMM_SMU_ALM8_0_CA DINH_FId.DFC_MOXEMM_SMU_ALM8_1_CA DINH_FId.DFC_MOXEMM_SMU_ALM8_10_CA DINH_FId.DFC_MOXEMM_SMU_ALM8_11_CA DINH_FId.DFC_MOXEMM_SMU_ALM8_12_CA DINH_FId.DFC_MOXEMM_SMU_ALM8_16_CA DINH_FId.DFC_MOXEMM_SMU_ALM8_18_CA DINH_FId.DFC_MOXEMM_SMU_ALM8_2_CA DINH_FId.DFC_MOXEMM_SMU_ALM8_3_CA DINH_FId.DFC_MOXEMM_SMU_ALM8_31_CA DINH_FId.DFC_MOXEMM_SMU_ALM8_4_CA DINH_FId.DFC_MOXEMM_SMU_ALM9_0_CA DINH_FId.DFC_MOXEMM_SMU_ALM9_15_CA DINH_FId.DFC_MOXEMM_SMU_ALM9_3_CA DINH_FId.DFC_MoCADCNTP_CA DINH_FId.DFC_MoCADCTst_CA DINH_FId.DFC_MoCSOPICO_CA DINH_FId.DFC_MoFAPP_CA DINH_FId.DFC_MoFAirFilgPrdc_CA DINH_FId.DFC_MoFAirFlCtOffPfi_CA DINH_FId.DFC_MoFAirFlCylPfi_CA DINH_FId.DFC_MoFAirFlIn_CA DINH_FId.DFC_MoFAirFlMixCtlPfiChkAirFl_CA DINH_FId.DFC_MoFAirFlMixCtlPfiChkCtrl_CA DINH_FId.DFC_MoFAirFlMode_CA DINH_FId.DFC_MoFESpd_CA DINH_FId.DFC_MoFIACo_CA DINH_FId.DFC_MoFICOL1_CA DINH_FId.DFC_MoFICOL2_CA DINH_FId.DFC_MoFStrt_CA DINH_FId.DFC_MoFTrqCmp_CA DINH_FId.DFC_MoFTrqCmpMax_CA DINH_FId.DFC_MoFTrqCmpMin_CA DINH_FId.DFC_MoFVarPostBldSel_CA DINH_FId.DFC_MoXEMMHwLTMCUFW_CA DINH_FId.DFC_MoXEMMHwLTMonBIST_CA DINH_FId.DFC_MoXEMMHwLTRegMonTest_CA DINH_FId.DFC_MoXEMMHwLTStbySMUAlvTest_CA DINH_FId.DFC_MoXEMMHwLTTempSens_CA DINH_FId.DFC_MoXEMMHwLTUCBCfg_CA DINH_FId.DFC_OCWDAABEActv_CA DINH_FId.DFC_OCWDACom_CA DINH_FId.DFC_OCWDAErrPin_CA DINH_FId.DFC_OCWDAOvrVltg_CA DINH_FId.DFC_ORAmax_CA DINH_FId.DFC_ORAmin_CA DINH_FId.DFC_PLLSUmax_CA DINH_FId.DFC_PLLSUmin_CA DINH_FId.DFC_PSR1max_CA DINH_FId.DFC_PSRBmax_CA DINH_FId.DFC_PSRBmin_CA DINH_FId.DFC_PSRPmax_CA DINH_FId.DFC_PSRPmin_CA DINH_FId.DFC_PSRPsig_CA DINH_FId.DFC_PSRmax_CA DINH_FId.DFC_PUmax_CA DINH_FId.DFC_P_VSE11_OL_CA DINH_FId.DFC_P_VSE11_SCB_CA DINH_FId.DFC_P_VSE11_SCG_CA DINH_FId.DFC_PhyHighAPP1_CA DINH_FId.DFC_PhyHighAPP2_CA DINH_FId.DFC_PhyLowAPP1_CA DINH_FId.DFC_PhyLowAPP2_CA DINH_FId.DFC_SRCHighAPP1_CA DINH_FId.DFC_SRCHighAPP2_CA DINH_FId.DFC_SRCLowAPP1_CA DINH_FId.DFC_SRCLowAPP2_CA DINH_FId.DFC_SSpMon2_CA DINH_FId.DFC_SWReset_0_CA DINH_FId.DFC_SWReset_1_CA DINH_FId.DFC_SWReset_2_CA DINH_FId.DFC_SyncAPP_CA DINH_FId.DFC_TAmax_Dummy_CA DINH_FId.DFC_TKAEmax_CA DINH_FId.DFC_TKAEmin_CA DINH_FId.DFC_TKARmax_CA DINH_FId.DFC_TKARnpl_CA DINH_FId.DFC_TMmax_Dummy_CA DINH_FId.DFC_TUMmax_Dummy_CA DINH_FId.DFC_TWCDPriCatB1_CA DINH_FId.DFC_ThrVlvClsdPosnFirstOffsLrnImpoB1_CA DINH_FId.DFC_ThrVlvClsdPosnOffsLrnImpoB1_CA DINH_FId.DFC_ThrVlvClsdPosnOffsLrnMaxB1_CA DINH_FId.DFC_ThrVlvClsdPosnOffsLrnMinB1_CA DINH_FId.DFC_ThrVlvCtrlDeB1_CA DINH_FId.DFC_ThrVlvDycB1_CA DINH_FId.DFC_ThrVlvLimpAirPosnMaxAbsltDriftB1_CA DINH_FId.DFC_ThrVlvLimpAirPosnMaxB1_CA DINH_FId.DFC_ThrVlvLimpAirPosnMaxRelDriftB1_CA DINH_FId.DFC_ThrVlvLimpAirPosnMinB1_CA DINH_FId.DFC_ThrVlvOpenLoadB1_CA DINH_FId.DFC_ThrVlvOpenSprgB1_CA DINH_FId.DFC_ThrVlvOpenSprgSprdB1_CA DINH_FId.DFC_ThrVlvOpenSprgTwnB1_CA DINH_FId.DFC_ThrVlvOverTB1_CA DINH_FId.DFC_ThrVlvRetSprgB1_CA DINH_FId.DFC_ThrVlvRetSprgSprdB1_CA DINH_FId.DFC_ThrVlvRetSprgTwnB1_CA DINH_FId.DFC_ThrVlvSens1MaxB1_CA DINH_FId.DFC_ThrVlvSens1NplB1_CA DINH_FId.DFC_ThrVlvSens2MaxB1_CA DINH_FId.DFC_ThrVlvSens2MinB1_CA DINH_FId.DFC_ThrVlvSens2NplB1_CA DINH_FId.DFC_ThrVlvShoCircB1_CA DINH_FId.DFC_ThrVlvSpiErrB1_CA DINH_FId.DFC_ThrvlvSens1MinB1_CA DINH_FId.DFC_TiOffTBasdChkFast_CA DINH_FId.DFC_TiOffTBasdChkSlow_CA DINH_FId.DFC_UEGOHeatrCtlS1B1_CA DINH_FId.DFC_UEGOSnsrMntdS1B1_CA DINH_FId.DFC_VehVSig_CA DINH_FId.DFC_VlvLftFbSwtIntk11SpclFail_CA DINH_FId.DFC_VlvLftFbSwtIntk11StdFail_CA DINH_FId.DSQ_ACClntP_CA DINH_FId.DSQ_ACEvpT_CA DINH_FId.DSQ_AirCCmprActr_CA DINH_FId.DSQ_BattU_CA DINH_FId.DSQ_BattULo_CA DINH_FId.DSQ_CoVMDIDASFail_CA DINH_FId.DSQ_DSMInhibitAlways_CA DINH_FId.DSQ_ElecLd_CA DINH_FId.DSQ_EngICO_CA DINH_FId.DSQ_EpmCaSSigQuality_CA DINH_FId.DSQ_EpmReverseRun_CA DINH_FId.DSQ_FanDIO_0_CA DINH_FId.DSQ_FanDIO_1_CA DINH_FId.DSQ_FuelP_CA DINH_FId.DSQ_FuelT_CA DINH_FId.DSQ_GbxPNPos_CA DINH_FId.DSQ_GbxPosNotPN_CA DINH_FId.DSQ_MRly_CA DINH_FId.DSQ_PEnvMeasVld_CA DINH_FId.DSQ_PEnvVld_CA DINH_FId.DSQ_PEnv_pRaw_CA DINH_FId.DSQ_PThrVlvUs_CA DINH_FId.DSQ_PThrVlvUsB1_CA DINH_FId.DSQ_StrtImobChk_CA DINH_FId.DSQ_TDevCenColdStrt_CA DINH_FId.DSQ_UEGOHeatrPwrOKS1B1_CA DINH_FId.DSQ_UEGOIPmpS1B1_CA DINH_FId.DSQ_UEGOLamS1B1_CA DINH_FId.DSQ_UEGOTCtrlS1B1_CA DINH_FId.DSQ_VehV_CA DINH_FId.DSQ_VehVSnsr_CA DINH_FId.DSQ_stAPP_CA DINH_FId.DSQ_stComEAT4_CA DINH_Lim.DFC_AltIOACGFailr_CA DINH_Lim.DFC_AltIOACGHiVltg_CA DINH_Lim.DFC_AltIOACGLoVltg_CA DINH_Lim.DFC_AltIOACGTHi_CA DINH_Lim.DFC_AltIODConnACG_CA DINH_Lim.DFC_BattUHiFailr_CA DINH_Lim.DFC_BattULoFailr_CA DINH_Lim.DFC_BrkBstPDriftHiErr_CA DINH_Lim.DFC_BrkBstPDriftLoErr_CA DINH_Lim.DFC_BrkBstPSnsrStuck_CA DINH_Lim.DFC_BrkMnSwtContOn_CA DINH_Lim.DFC_BrkMnSwtNotStp_CA DINH_Lim.DFC_BrkNpl_CA DINH_Lim.DFC_BrkRdntSwtContOn_CA DINH_Lim.DFC_BrkRdntSwtNotStp_CA DINH_Lim.DFC_Clth3ONStuck_CA DINH_Lim.DFC_Clth4OFFStuck_CA DINH_Lim.DFC_ClthOFFStuck_CA DINH_Lim.DFC_ClthONStuck_CA DINH_Lim.DFC_ClthStkFailInfo_CA DINH_Lim.DFC_ComACFailInfo_CA DINH_Lim.DFC_ComATFTValErr_CA DINH_Lim.DFC_ComATMILReq_CA DINH_Lim.DFC_ComAYCAChksum_CA DINH_Lim.DFC_ComAYCARingCnt_CA DINH_Lim.DFC_ComAYCATOut_CA DINH_Lim.DFC_ComAYCDChkSum_CA DINH_Lim.DFC_ComAYCDTOut_CA DINH_Lim.DFC_ComAYCFChksum_CA DINH_Lim.DFC_ComAYCFRingCnt_CA DINH_Lim.DFC_ComAYCFTOut_CA DINH_Lim.DFC_ComAYCGChksum_CA DINH_Lim.DFC_ComAYCGRingCnt_CA DINH_Lim.DFC_ComAYCGTOut_CA DINH_Lim.DFC_ComAYCIChkSum_CA DINH_Lim.DFC_ComAYCIRingCnt_CA DINH_Lim.DFC_ComAYCITOut_CA DINH_Lim.DFC_ComBCM1ChkSum_CA DINH_Lim.DFC_ComBCM1RingCnt_CA DINH_Lim.DFC_ComBCM1TOut_CA DINH_Lim.DFC_ComCANABusOffErr_CA DINH_Lim.DFC_ComCANBBusOffErr_CA DINH_Lim.DFC_ComCANCBusOffErr_CA DINH_Lim.DFC_ComCGW1ChkSum_CA DINH_Lim.DFC_ComCGW1RingCnt_CA DINH_Lim.DFC_ComCGW1TOut_CA DINH_Lim.DFC_ComConvBoostErr_CA DINH_Lim.DFC_ComConvSlipErr_CA DINH_Lim.DFC_ComEAT10Chksum_CA DINH_Lim.DFC_ComEAT10RingCnt_CA DINH_Lim.DFC_ComEAT10TOut_CA DINH_Lim.DFC_ComEAT11ChkSum_CA DINH_Lim.DFC_ComEAT11RingCnt_CA DINH_Lim.DFC_ComEAT11TOut_CA DINH_Lim.DFC_ComEAT12ChkSum_CA /end DEF_CHARACTERISTIC
 FUNCTION_VERSION "30000.27.0_1.0.0" /end FUNCTION
/begin COMPU_METHOD DINH_FIdVerb "" TAB_VERB "%6.3" "-" COMPU_TAB_REF DINH_FIdVerb /end COMPU_METHOD
/begin COMPU_VTAB DINH_FIdVerb "" TAB_VERB 733 0 "FId_Unused" 1 "FID_AFRA" 2 "FID_AORA" 3 "FID_ATEH" 4 "FID_ATEL" 5 "FID_ATEN" 6 "FId_EGSDCmnSeg1B1Parl" 7 "FID_BLLRH" 8 "FID_BLLRKH" 9 "FID_BPLSU" 10 "FId_CJ135RvsChrgMeasS1B1" 11 "FId_CatHeatgColdStrtReq" 12 "FId_CatHeatgWrmReq" 13 "FId_EGSDO2SnsrMntdRelsS1B1" 14 "FId_EGSDO2_LamOffsFastS1B1" 15 "FId_MisfDetDnAdpnNv" 16 "FID_BGFKMS" 17 "FID_CDSTTI" 18 "FID_CETKHL" 19 "FID_CETKHT" 20 "FID_CGLSRDP" 21 "FID_CLLKHV" 22 "FID_CLLRHV" 23 "FID_CLZSRDP" 24 "FID_CNSAD" 25 "FID_CNSAD2" 26 "FID_CPFISTRT" 27 "FID_CPSRB" 28 "FID_CPSRP" 29 "FID_DKRSA" 30 "FID_DLLRBandEndTst" 31 "FID_DLLRShrtTrpSpdRmp" 32 "FID_FEDKAPB" 33 "FID_FEDSSB" 34 "FID_FOFSTP" 35 "FID_FONSTP" 36 "FID_FUEDK" 37 "FID_LRADLSU" 38 "FID_LRALSVErr" 39 "FID_LRAPLLSU" 40 "FID_LUSTP" 41 "FID_LnKS1" 42 "FID_PLSUV" 43 "FID_PSRMOZDG" 44 "FID_PSRMOZG" 45 "FID_STRTDIA" 46 "FID_STRTSTM" 47 "FID_TFA1CSMW" 48 "FID_TKACSMW" 49 "FID_TMCSMW" 50 "FID_TOCHOilSwmpTQly" 51 "FID_TOCHTME" 52 "FID_TOSPCSMW" 53 "FID_UEGOHeatrRlyS1B1" 54 "FID_VehStvSSEOk" 55 "FID_VldtLamPlausMaxS1B1" 56 "FID_VldtLamPlausMinS1B1" 57 "FId_ACClntPSSPMon" 58 "FId_ACCompComCANBusOff" 59 "FId_ACCompComCANErrMtr" 60 "FId_ACComp_HiUTWSnsrErr" 61 "FId_ACComp_LoUTWSnsrErr" 62 "FId_ACComp_PDSnsrErr" 63 "FId_ACComp_VehSpdSnsrErr" 64 "FId_ACCtl_ACStrtCut" 65 "FId_ACCtl_APP1" 66 "FId_ACCtl_APP2" 67 "FId_ACCtl_APPSync" 68 "FId_ACCtl_AcOff" 69 "FId_ACCtl_Clmb" 70 "FId_ACCtl_DK1" 71 "FId_ACCtl_DK2" 72 "FId_ACCtl_DKSync" 73 "FId_ACCtl_VehSpdSnsrErr" 74 "FId_ACCtl_pAC" 75 "FId_ACEvpTCANErr" 76 "FId_ACEvpTFrzVal" 77 "FId_ACEvpTRplVal" 78 "FId_APP1SigPath" 79 "FId_APP2SigPath" 80 "FId_APPBrkErr" 81 "FId_APPLETVldnErr" 82 "FId_APPLrn" 83 "FId_APPVehVErr" 84 "FId_AccPedDrvModComErr" 85 "FId_AccPedDrvModFailr" 86 "FId_AccPedNMaxLim" 87 "FId_AccPedNMinLim" 88 "FId_AccPedNMinLimBrkApp" 89 "FId_AccPedTrqLim" 90 "FId_AirCClntPFrzVal" 91 "FId_AirCClntPRplVal" 92 "FId_AirCSwt" 93 "FId_AirDvPAdpnPEnv" 94 "FId_AirDvPAdpnPIntkVUsB1" 95 "FId_AirDvPPSnsrAdpn_PModeActv" 96 "FId_AltACGFailr" 97 "FId_AltAPPErrSt" 98 "FId_AltBattMngtFailr" 99 "FId_AltBrkErrSt" 100 "FId_AltComErr" 101 "FId_AltENGB" 102 "FId_AltElecLoadErr" 103 "FId_AltEnvTErr" 104 "FId_AltFFAltLoadFast" 105 "FId_AltFFAltLoadSlow" 106 "FId_AltIOACGErr" 107 "FId_AltIOACGLinComFailr" 108 "FId_AltIOComErr" 109 "FId_AltLinErr" 110 "FId_AltPwr" 111 "FId_AltVehVErrSt" 112 "FId_BGFKMSEPSR" 113 "FId_BGFKMSEPU" 114 "FId_BGFKMSESumClr" 115 "FId_BGFKMSZPSR" 116 "FId_BGOSCCat1B1" 117 "FId_BGOSCCat2B1" 118 "FId_BattAltFailr" 119 "FId_BattMngtFailr" 120 "FId_BattSigPtd" 121 "FId_BattU2MEDSRC" 122 "FId_BattUDrpPrvOff" 123 "FId_BattUFrzVal" 124 "FId_BattUHiFailrEna" 125 "FId_BattUIMGTCUCANFailr" 126 "FId_BattULoFailrEna" 127 "FId_BattUReplVal" 128 "FId_BattUSRC" 129 "FId_BlwrComErr" 130 "FId_BrkBstPDetnInhbn" 131 "FId_BrkBstPMstCylPSnsrFail" 132 "FId_BrkBstPSnsrStuckDetn" 133 "FId_BrkMnSwtErr" 134 "FId_BrkPOilPres" 135 "FId_BrkPedEngStopEna" 136 "FId_BrkRdntSwtErr" 137 "FId_CAGRSDS" 138 "FId_CEngDsTColdStrt" 139 "FId_CEngDsTColdStrtErr" 140 "FId_CEngDsTLSC" 141 "FId_CEngDsTPlausErr" 142 "FId_CEngDsTReplMdlEngStop" 143 "FId_CEngDsTSTC" 144 "FId_CEngDsTSnsrElec" 145 "FId_CEngDsTSwtReplMdl" 146 "FId_CEngUsTElecErr" 147 "FId_CEngUsTSnsrElecErr" 148 "FId_CEngUsTSwtReplMdl" 149 "FId_CJ135CtlFullAltvS1B1" 150 "FId_CJ135CtlIPmpAltvS1B1" 151 "FId_CJ135CtlIPmpS1B1" 152 "FId_CJ135CtlRParlTstdS1B1" 153 "FId_CJ135CtlS1B1" 154 "FId_CJ135CtlSnsrHotS1B1" 155 "FId_CJ135DiagSnsrS1B1" 156 "FId_CJ135IPmpNoBiasS1B1" 157 "FId_CJ135IPmpNoErrS1B1" 158 "FId_CMSUDKSOM1" 159 "FId_CMSUDKSOM2" 160 "FId_CSTRTCTL" 161 "FId_Cj135DiagAsicS1B1" 162 "FId_Cj135DiagOlEnaNotEnfS1B1" 163 "FId_Cj135DiagOlEnaS1B1" 164 "FId_Cj135DiagSpiS1B1" 165 "FId_Cj135DiagWireRprtS1B1" 166 "FId_Cj135DiagWireS1B1" 167 "FId_Cj135Dummy" 168 "FId_Cj135PerdDiagOperEnaS1B1" 169 "FId_ClntTempENGB" 170 "FId_Clth" 171 "FId_Clth2" 172 "FId_Clth3StuckOn" 173 "FId_Clth4" 174 "FId_ClthCAN" 175 "FId_ClthMax" 176 "FId_ClthStk" 177 "FId_ClthStkErr" 178 "FId_ClthStkFailr" 179 "FId_ClthStkOFFStuck" 180 "FId_ClthStkONStuck" 181 "FId_ClthSwtFailr" 182 "FId_CoEOMGdiEomErrLcy" 183 "FId_CoETM" 184 "FId_CoETS_StTrqLimErr1" 185 "FId_CoETS_StTrqLimErr2" 186 "FId_CoEngStopEnblStSpEngT" 187 "FId_CoEngStopEnblStSpLSU" 188 "FId_CoEngStopEnblStSpTcT" 189 "FId_CoEngStopEnblSysErr" 190 "FId_CoEngVlvLftSpIntk" 191 "FId_CoPOMStrtgDevStrtr" 192 "FId_CoPOM_FirstStrtAut" 193 "FId_CoTS_SwtOff" 194 "FId_CoVOMACCComFailr" 195 "FId_CoVOMBrkPedISABSigFailr" 196 "FId_CoVOMEngCrkAbort" 197 "FId_CoVOMEngRstrtEnaCdn" 198 "FId_CoVOMISSEng" 199 "FId_ComACRly" 200 "FId_ComAPPSensFail" 201 "FId_ComAPedl" 202 "FId_ComAYCA" 203 "FId_ComAYCAMon" 204 "FId_ComAYCD" 205 "FId_ComAYCDMon" 206 "FId_ComAYCF" 207 "FId_ComAYCFMon" 208 "FId_ComAYCG" 209 "FId_ComAYCGMon" 210 "FId_ComAYCI" 211 "FId_ComAYCIMon" 212 "FId_ComAirPThrUsSnsrErr" 213 "FId_ComAltFail" 214 "FId_ComAppVehSnsrFailr" 215 "FId_ComBCM1" 216 "FId_ComBCM1Mon" 217 "FId_ComBstCtrl" 218 "FId_ComCANVEHICLEBusOff" 219 "FId_ComCGW1" 220 "FId_ComCGW1Mon" 221 "FId_ComClthSt" 222 "FId_ComConvClth" 223 "FId_ComCrCtlReq" 224 "FId_ComCrsMaiIndcnLampReq" 225 "FId_ComCrsSetIndcnLampReq" 226 "FId_ComDCDCCdn" 227 "FId_ComDesGearCurr" 228 "FId_ComDetrmAirM" 229 "FId_ComDwnShiftCtrlReq" 230 "FId_ComEAT1" 231 "FId_ComEAT10" 232 "FId_ComEAT10Mon" 233 "FId_ComEAT11" 234 "FId_ComEAT11Mon" 235 "FId_ComEAT12" 236 "FId_ComEAT12Mon" 237 "FId_ComEAT13" 238 "FId_ComEAT13Mon" 239 "FId_ComEAT1Mon" 240 "FId_ComEAT2" 241 "FId_ComEAT2Mon" 242 "FId_ComEAT4" 243 "FId_ComEAT4Mon" 244 "FId_ComEAT6" 245 "FId_ComEAT6Mon" 246 "FId_ComEAT7" 247 "FId_ComEAT7Mon" 248 "FId_ComEAT8" 249 "FId_ComEAT8Mon" 250 "FId_ComEATA" 251 "FId_ComEATAMon" 252 "FId_ComEATB" 253 "FId_ComEATBMon" 254 "FId_ComEATC" 255 "FId_ComEATCMon" 256 "FId_ComEBBA" 257 "FId_ComEBBAMon" 258 "FId_ComECUHwErr" 259 "FId_ComEMSIntAirTemp" 260 "FId_ComEPS1" 261 "FId_ComEPS1Mon" 262 "FId_ComEngBrkOvrdInfo" 263 "FId_ComEngBrkOvrdMtr" 264 "FId_ComEngBrkSwErr" 265 "FId_ComEngPosng" 266 "FId_ComEngRPMLim" 267 "FId_ComEngTrqLim" 268 "FId_ComEnvtlAirPSnsrErr" 269 "FId_ComEstmTqNormJdg" 270 "FId_ComEthnlSErr" 271 "FId_ComEwpErr" 272 "FId_ComFlSply" 273 "FId_ComFuCnsBitDurgIdleStop" 274 "FId_ComGEVCntrl" 275 "FId_ComGbxNPosFail" 276 "FId_ComGbxTemp" 277 "FId_ComGwIMG1" 278 "FId_ComGwIMG1Mon" 279 "FId_ComGwIMG3" 280 "FId_ComGwIMG3Mon" 281 "FId_ComGwIMG4" 282 "FId_ComGwIMG4Mon" 283 "FId_ComGwIMG5" 284 "FId_ComGwIMG5Mon" 285 "FId_ComGwIMG6" 286 "FId_ComGwIMG6Mon" 287 "FId_ComHFMSnsrErr" 288 "FId_ComIDASB" 289 "FId_ComIDASBMon" 290 "FId_ComIDASEngFail" 291 "FId_ComISG2" 292 "FId_ComIgnCtrl" 293 "FId_ComInjCtrl" 294 "FId_ComIntkAirPSnsrErr" 295 "FId_ComLamCtrl" 296 "FId_ComMETA" 297 "FId_ComMETAMon" 298 "FId_ComMETC" 299 "FId_ComMETCMon" 300 "FId_ComMETD" 301 "FId_ComMETDMon" 302 "FId_ComMETE2" 303 "FId_ComMETE2Mon" 304 "FId_ComMETF" 305 "FId_ComMETFMon" 306 "FId_ComMETG" 307 "FId_ComMETGMon" 308 "FId_ComMETH" 309 "FId_ComMETH2" 310 "FId_ComMETH2Mon" 311 "FId_ComMETHMon" 312 "FId_ComMETI" 313 "FId_ComMETIMon" 314 "FId_ComMETK" 315 "FId_ComMETKMon" 316 "FId_ComMETL" 317 "FId_ComMETLMon" 318 "FId_ComMETM" 319 "FId_ComMETMMon" 320 "FId_ComMETN" 321 "FId_ComMETNMon" 322 "FId_ComMisf" 323 "FId_ComMon" 324 "FId_ComNTrbn" 325 "FId_ComODOff" 326 "FId_ComOilLvlLamp" 327 "FId_ComOilPWarnLamp" 328 "FId_ComPASensFail" 329 "FId_ComPBSensFail" 330 "FId_ComPCU" 331 "FId_ComPCUMon" 332 "FId_ComPosActnSpdLimrFctReq" 333 "FId_ComSRS" 334 "FId_ComSRSA" 335 "FId_ComSRSAMon" 336 "FId_ComSRSB" 337 "FId_ComSRSBMon" 338 "FId_ComSRSMon" 339 "FId_ComSTFlt" 340 "FId_ComSpdLimrDevActvn" 341 "FId_ComTCU01" 342 "FId_ComTCU02" 343 "FId_ComTCU1" 344 "FId_ComTCU11" 345 "FId_ComTCU12" 346 "FId_ComTCU13" 347 "FId_ComTCU14" 348 "FId_ComTCU2" 349 "FId_ComTCU3" 350 "FId_ComTCU4" 351 "FId_ComTCUGear" 352 "FId_ComTarGearDwnShift" 353 "FId_ComTarGearUpShift" 354 "FId_ComThrPosnFail" 355 "FId_ComThrVlv" 356 "FId_ComTrboChrgnErr" 357 "FId_ComTrqAccuracySlow" 358 "FId_ComTrqReqFast" 359 "FId_ComTrqReqSlow" 360 "FId_ComVSAErr" 361 "FId_ComVehSpdFltChk" 362 "FId_ComVehSpdImpsErr" 363 "FId_ComVlvLftCtrl" 364 "FId_ComvolEng" 365 "FId_ConvLdCalcLvrPos" 366 "FId_ConvLdNTrbnCan" 367 "FId_ConvLdOilCoolrPmp" 368 "FId_ConvLdOilTemp" 369 "FId_ConvLdTrqLdCan" 370 "FId_ConvLdVel" 371 "FId_CptProtnExhTempMdl" 372 "FId_CptProtnO2SnsrB1" 373 "FId_CptProtnVVeh" 374 "FId_CrCUI1EFRxErr" 375 "FId_CrCUICANRxErr" 376 "FId_CrCUIFCMRxErr" 377 "FId_CrCUIMETDRxErr" 378 "FId_CrCtlACCRxErr" 379 "FId_CrCtlAppSnsrErr" 380 "FId_CrCtlShutOffEng" 381 "FId_DIUMPRCldStrtMon" 382 "FId_DIUMPRGenDenom1" 383 "FId_DIUMPRGenDenom2" 384 "FId_DIUMPRGenDenom3" 385 "FId_DIUMPRIgn" 386 "FId_DOGov" 387 "FId_DSMWarmUpCycle" 388 "FId_DewDetTKAMax" 389 "FId_DkrsaEpmNoSig" 390 "FId_EBBCANErrFrzVal" 391 "FId_EBBCANErrReplVal" 392 "FId_EGLZSR" 393 "FId_EGSDO2OffsRstDsmS1B1" 394 "FId_EGSDO2_LamOffsSlowS1" 395 "FId_EGSDUS2B1LtrDly" 396 "FId_EGSDUS2B1LtrPT1" 397 "FId_EGSDUS2B1RtlDly" 398 "FId_EGSDUS2B1RtlPT1" 399 "FId_EGSDUS2B1TarEvln" 400 "FId_EGSDUS2B1TarLean" 401 "FId_EGSDUS2B1TarRich" 402 "FId_ELZSR" 403 "FId_EPBErr" 404 "FId_EPBFrmErr" 405 "FId_EPBFrmErrClth" 406 "FId_EVPComFailr" 407 "FId_EbsLinErr" 408 "FId_EepReadWrState" 409 "FId_ElecLdComErr" 410 "FId_ElecLdFrzVal" 411 "FId_ElecLdHdLiComErr" 412 "FId_ElecLdRplVal" 413 "FId_ElecLoadEPSComErr" 414 "FId_EngBlkTWrn" 415 "FId_EngCooltTFail" 416 "FId_EngDemTqLimnCamsftErr" 417 "FId_EngDemTqLimnErrThmstHeatCtrlCirc" 418 "FId_EngDemTqLimnOilPmp" 419 "FId_EngDemTrqLimErrAPP" 420 "FId_EngIntkAirFail" 421 "FId_EngPrtErrVehV" 422 "FId_EngSpd30DegFail" 423 "FId_EngStrtEnaEthAdap" 424 "FId_EngStrt_InjProhb" 425 "FId_EngTqRvsnEnaFlg" 426 "FId_EnvTPrimMod" 427 "FId_EnvTPrimModIniVal" 428 "FId_EnvTSensSum" 429 "FId_EnvTtCEngDsT" 430 "FId_EnvTtIntkMnfld" 431 "FId_EpmBCr" 432 "FId_EpmCaSAdapCaSI1" 433 "FId_EpmCaSAdapRstI1" 434 "FId_EpmCaSDiagI1" 435 "FId_EpmCaSErrCaSI1" 436 "FId_EpmCaSOfsDiagCaSI1" 437 "FId_EpmCaSOfsErrCaSI1" 438 "FId_EpmCaSSegI1" 439 "FId_EpmCaSSpdPlausI1" 440 "FId_EpmCrSDiag" 441 "FId_EpmCrSDiagVeh" 442 "FId_EpmCrSErr" 443 "FId_EpmRRSCrSFaultCheck" 444 "FId_EpmRRSVehVFaultChck" 445 "FId_EpmSynLockCaSSync" 446 "FId_EtaEngIdleNonCsers" 447 "FId_EtaEngPtlNonCsers" 448 "FId_FanCtlACClntP" 449 "FId_FanCtlACGModFail" 450 "FId_FanCtlAPP1" 451 "FId_FanCtlAPP2" 452 "FId_FanCtlAPPSync" 453 "FId_FanCtlBlowrU" 454 "FId_FanCtlCooltT" 455 "FId_FanCtlCooltT2" 456 "FId_FanCtlEnvT" 457 "FId_FanCtlLiSwtInfo" 458 "FId_FanCtlSpd" 459 "FId_FanCtlTSnsrErr" 460 "FId_FanCtlThr1" 461 "FId_FanCtlThr2" 462 "FId_FcoReq" 463 "FId_FiMFID_rba_MRly_Diag_Stk" 464 "FId_FlMALamDynDiag" 465 "FId_FuEvapPurgTCpvDty" 466 "FId_FuMixUegoErrExcl" 467 "FId_GEVCtlVlvLftEnaIntk" 468 "FId_GbxAnNeutPosnErr" 469 "FId_GbxCANDigPlausErr" 470 "FId_GbxCANNeutSigErr" 471 "FId_GbxPNPosSig" 472 "FId_GbxPNPosnComErr" 473 "FId_GbxPNPosnDiagDrvCdnRels" 474 "FId_GbxPNPosnDiagDrvCodnHealRels" 475 "FId_GbxPNPosnDiagPlausyRels" 476 "FId_GbxPNPosnSubsVal" 477 "FId_GbxRvsSwtStk" 478 "FId_GbxSnsrSplyUErr" 479 "FId_GbxSpstReqOk" 480 "FId_GlbDaLSumvXPtd" 481 "FId_GslThrVlvSnsrDiagB1" 482 "FId_HEGOS2B1DElec" 483 "FId_HEGOS2B1DHtg" 484 "FId_HEGOS2B1Htg" 485 "FId_HEGOS2B1HtrPsSt" 486 "FId_HEGOS2B1InVld" 487 "FId_HEGOS2B1LSPsDiaDi" 488 "FId_HLSDemBrkFlt" 489 "FId_HLSDemIntkAirTemp" 490 "FId_HLSDemMotTemp" 491 "FId_HLSDemMstCyldpVld" 492 "FId_HLSDemOvhtExhMnf" 493 "FId_HLSDemOvhtFanR" 494 "FId_HLSDemOvhtGear" 495 "FId_HLSDemOvhtTum" 496 "FId_HLSDemOvhtVehV" 497 "FId_HLSDemSpdClthGearAccrSigErr" 498 "FId_HLSDem_DrvOffSuprt" 499 "FId_HLSDem_DrvOffSuprtBrkHldSys" 500 "FId_HLSDem_DrvOffSuprtLAS" 501 "FId_HLSDem_PModeActv" 502 "FId_HLSDem_TModeActv" 503 "FId_HLSDem_TraSubFcn" 504 "FId_HLSDem_nMaxLimErr1" 505 "FId_HLSDem_nMaxLimErr2" 506 "FId_HLSDem_nMaxLimErr3" 507 "FId_HLSDem_nMaxVErr" 508 "FId_I14229APP" 509 "FId_I14229CANErr" 510 "FId_I14229EWPErr" 511 "FId_I14229TrbCh" 512 "FId_I14229VTCErr" 513 "FId_IMGISABComErr" 514 "FId_InhbLamDynS1B1" 515 "FId_InhibitAlways" 516 "FId_InhibitNever" 517 "FId_InjVvgPFIEV1" 518 "FId_InjVvgPFIEV2" 519 "FId_InjVvgPFIEV3" 520 "FId_InjVvgPFIEV4" 521 "FId_IntkAirTIntkMnfldCrssChk" 522 "FId_IntkAirTIntkMnfldPlausChk" 523 "FId_IntkAirTIntkMnfldRepl" 524 "FId_IntkAirTSnsr1Elec" 525 "FId_IntkAirTSnsr1PRC" 526 "FId_IntkAirTSnsr1Sum" 527 "FId_IntkArTempENGB" 528 "FId_LIGovDfrstI" 529 "FId_LIGovUndrBrk" 530 "FId_LINDCDCRxErr" 531 "FId_LLimAppSnsrErr" 532 "FId_LLimAppSnsrSyncErr" 533 "FId_LLimMTVehSpdSnsrErr" 534 "FId_LLimShutOffEng" 535 "FId_LRSEBMisf" 536 "FId_LZSR" 537 "FId_LeakToMnfldTstd" 538 "FId_MaiLoadSnsr" 539 "FId_MisfDetDnAdpn" 540 "FId_MisfDetDnAdpnPlaus" 541 "FId_MisfDetEnvP" 542 "FId_MisfDetSegTiAdpnFco" 543 "FId_MisfDetShtrpAct" 544 "FId_MisfDetStc" 545 "FId_MisfDetV" 546 "FId_MisfDetVWhlFrntLe" 547 "FId_MisfDetVWhlFrntRi" 548 "FId_MisfDetVWhlReLe" 549 "FId_MisfDetVWhlReRi" 550 "FId_MisfDet_InjLockdOpen01" 551 "FId_MisfDet_InjLockdOpen02" 552 "FId_MisfDet_InjLockdOpen03" 553 "FId_MisfDet_InjLockdOpen04" 554 "FId_NLimVehHalt" 555 "FId_NSHTDAmbT" 556 "FId_NSHTDEngT" 557 "FId_NSHTILimHiAltiLoIdleSp" 558 "FId_O2StorgMdlMD" 559 "FId_OilCmbdSen_LvlDfctHW" 560 "FId_OilSwmpTCEngDsTWrmUp" 561 "FId_OilSwmpT_B_tospg" 562 "FId_OilSwmpT_B_tospgg" 563 "FId_OilSwmpT_CmbdSnsrErr" 564 "FId_OilSwmpT_CmbdSnsrTiTErr" 565 "FId_OilSwmpT_EnvT" 566 "FId_OilSwmpT_TSnsrErr" 567 "FId_PEnvMeasVld" 568 "FId_PEnvModel" 569 "FId_PEnvPlausDiagVDD" 570 "FId_PEnvRawVldVDD" 571 "FId_PEnvRefSnsr" 572 "FId_PEnvSigRngVld" 573 "FId_PEnvSnsrPlausVDD" 574 "FId_PEnvVldVDD" 575 "FId_PIDA6SigSrcErr" 576 "FId_PIntkMnfldPlaus" 577 "FId_PIntkVUsElecDiagB1" 578 "FId_PSPCtlDisbl" 579 "FId_PSPCtlPreRun" 580 "FId_PSPDiagDisbl" 581 "FId_PTGripConv" 582 "FId_PTGripConvStrt" 583 "FId_PTGripMnlClth" 584 "FId_PTGripMnlClthStrt" 585 "FId_PTTrqRatCANPtd" 586 "FId_PThrVlVUsVldB1" 587 "FId_PThrVlvUsMeasdVldB1" 588 "FId_P_VSE11_Diag" 589 "FId_PrmId03_FltRdnS1B1" 590 "FId_PrmId03_FltUegoS1B1" 591 "FId_SSEEPBRelease" 592 "FId_SSEFCANPRelease" 593 "FId_SSEPTCANPRelease" 594 "FId_SSEStartRelease" 595 "FId_SSEStartReleaseMTCl10" 596 "FId_SSEStartReleaseMTCl100" 597 "FId_SSEStartReleaseMTCl20" 598 "FId_SSEStartReleaseMTCl90" 599 "FId_SSEStartRequest" 600 "FId_SSEStopRelease" 601 "FId_SSEStrtStopRelease" 602 "FId_SSESysOff" 603 "FId_SSEUI2DCSysFailr" 604 "FId_SSEUIBCANErr" 605 "FId_SSEUISysFail" 606 "FId_SiaEEPErr" 607 "FId_StrtCrkSnsrFailr" 608 "FId_StrtCtlAutoCrkModeCdn" 609 "FId_StrtCtlComEngStrtErr" 610 "FId_StrtCtlNPCdnCncl" 611 "FId_StrtCtlNoCpuFailr" 612 "FId_StrtCtlNoFailCanLine" 613 "FId_StrtCtlNoFailPTCanLine" 614 "FId_StrtCtlNoTCUFail" 615 "FId_StrtCtlPNPosnSubsVal" 616 "FId_StrtCtlSTMFailr" 617 "FId_StrtErrShaft" 618 "FId_StrtrRlyFailr" 619 "FId_SumErrHndlg" 620 "FId_SysDiagComErr" 621 "FId_SysDiagModInhbErr" 622 "FId_TOSPM" 623 "FId_TWCCILckExtd" 624 "FId_TWCCIRstB1" 625 "FId_TWCCIRstDSMClearB1" 626 "FId_TWCCLsuB1" 627 "FId_TWCCLsuCyc" 628 "FId_TWCCLsuDynB1" 629 "FId_TWCCMisfDetn" 630 "FId_TWCDPriCatParB1" 631 "FId_TWCDPriCatVldnB1" 632 "FId_ThrVlvMon" 633 "FId_ThrVlvOffsLrnPrmsB1" 634 "FId_TiOffTBasdChkFast" 635 "FId_TiOffTBasdChkSlow" 636 "FId_TiOffVdClk" 637 "FId_TqDecelOffsInhb" 638 "FId_TraAddAirCANPtd" 639 "FId_TraAddClntCANPtd" 640 "FId_TraFwdRvsCluInfo" 641 "FId_TraGbxNPos" 642 "FId_TraGearInfoCanCom" 643 "FId_TraGearInfoDet" 644 "FId_TraGearInfoGearShftActv" 645 "FId_TraGearInfoInfoCan" 646 "FId_TraGearInfoLevPos" 647 "FId_TraGearInfoLoRng" 648 "FId_TraGearInfoRTra" 649 "FId_TraGearInfoRevGear" 650 "FId_TraGearReq" 651 "FId_TraNoShftIdctr" 652 "FId_TraPrtGearCANPtd" 653 "FId_TraPrtGearIndpdtProblem" 654 "FId_TraRPosn" 655 "FId_TraRtnIntfcASTIntv" 656 "FId_TraRtnIntfcIdlSetP" 657 "FId_TraRtnIntfcNMaxCan" 658 "FId_TraRtnIntfcNMaxVel" 659 "FId_TraTrqRedLmpHmeDec" 660 "FId_TraTrqRedLmpHmeInc" 661 "FId_TraTrqRedPTCanErr" 662 "FId_TraTrqRedTIIntvDes" 663 "FId_TraTrqRedTIIntvLead" 664 "FId_TraTrqRedTSCIntvDes" 665 "FId_TraTrqRedTSCIntvLead" 666 "FId_TraTrsmTypHw" 667 "FId_TranIdleDes" 668 "FId_UEGODiagRelsS1B1" 669 "FId_UEGOHeatrLrgTWinS1B1" 670 "FId_UEGOHeatrPwrStgDiagRelsS1B1" 671 "FId_UEGOHeatrPwrStgDiagRelsSCBS1B1" 672 "FId_UEGOHtrCtlOffS1B1" 673 "FId_UEGOHtrCtlRedS1B1" 674 "FId_UEGOHtrCtlStopS1B1" 675 "FId_UEGOHtrCtlUpS1B1" 676 "FId_UEGOIPmpEvlnRelsS1B1" 677 "FId_UEGOIPmpTCorrnS1B1" 678 "FId_UEGOIPmpTRelsS1B1" 679 "FId_UEGOLamRecprMdlRelsS1B1" 680 "FId_UEGOLamRelsAltvS1B1" 681 "FId_UEGOLamRelsS1B1" 682 "FId_UEGOLoDiagS1B1" 683 "FId_UEGOPrmntDiagS1B1" 684 "FId_UEGOStrtDiagRprtErrS1B1" 685 "FId_UEGOStrtDiagS1B1" 686 "FId_UEGOTEvlnRelsS1B1" 687 "FId_UegoInhbOperRelsS1B1" 688 "FId_UegoIntrptCdnOperRelsPreEngStrt" 689 "FId_UegoPlausErrHndlg" 690 "FId_UegoSigAvailS1B1" 691 "FId_VMSIDCSRmpShOff" 692 "FId_VMSIDCSShOff" 693 "FId_VMSITCSRmpShOff" 694 "FId_VMSITCSShOff" 695 "FId_VSACANErr" 696 "FId_VehStcDCDCFailr" 697 "FId_VehStcMisf" 698 "FId_VehVCANFrzVal" 699 "FId_VehVCANReplVal" 700 "FId_VehVCanSafeFrzVal" 701 "FId_VehVCanSafeReplVal" 702 "FId_VehVExcdLim" 703 "FId_VehVFrzVal" 704 "FId_VehVNCSnsrElecFailr" 705 "FId_VehVOBDFrzVal" 706 "FId_VehVOBDReplVal" 707 "FId_VehVOutCanErr" 708 "FId_VehVPWMFrzVal" 709 "FId_VehVPWMReplVal" 710 "FId_VehVPhysRng" 711 "FId_VehVPlaus" 712 "FId_VehVPlausCan" 713 "FId_VehVPlausFco" 714 "FId_VehVPlausPwr" 715 "FId_VehVPlausV2N" 716 "FId_VehVReplVal" 717 "FId_VehVSigCan" 718 "FId_VehVSigCanSafe" 719 "FId_VehVSnsrARngHi" 720 "FId_VehVSnsrBRngHi" 721 "FId_VehVSpdRtyDiag" 722 "FId_VehVSpdSnsrAElecFailr" 723 "FId_VehVSpdSnsrBElecFailr" 724 "FId_VehVWhlErrDet" 725 "FId_VldtLamDynS1B1" 726 "FId_VlvLftFbIntkOilPSnsr11SRC" 727 "FId_VlvLftFbSwtIntk11Diag" 728 "FId_ZGLZSR" 729 "FId_airIntkFltSnsrKnkPrtnIgn" 730 "FId_stChkChgnSys" 731 "FId_stChkChgnSys2DC" 732 "FId_tFltSnsrKnkPrtnIgn" DEFAULT_VALUE "---" /end COMPU_VTAB
/begin COMPU_METHOD DINH_LimDFCVerb "" TAB_VERB "%6.3" "-" COMPU_TAB_REF DINH_LimDFCVerb /end COMPU_METHOD
/begin COMPU_VTAB DINH_LimDFCVerb "" TAB_VERB 18 0 "No_Inhibit" 1 "Def50_Deb100" 2 "Def100_Deb100" 3 "Def50_Deb100_Tst" 4 "Def100_Deb100_Tst" 5 "Def50_Deb100_or_NTst" 6 "Def100_Deb100_or_NTst" 7 "Tested" 8 "NotTested" 9 "Def100_Deb0" 10 "Def50_Deb0" 11 "Def25_Deb0" 12 "Def0_Deb0" 13 "Def50_Deb100_Tst_Trip" 14 "Def100_Deb100_Tst_Trip" 15 "Def50_Deb100_MILOn" 16 "Def50_Deb100_Trip" 17 "Def100_Deb100_Trip" /end COMPU_VTAB
/begin RECORD_LAYOUT ValA_Wu16 FNC_VALUES 1 UWORD COLUMN_DIR DIRECT /end RECORD_LAYOUT
/begin RECORD_LAYOUT ValA_Wu8 FNC_VALUES 1 UBYTE COLUMN_DIR DIRECT /end RECORD_LAYOUT
/end MODULE
/end PROJECT
