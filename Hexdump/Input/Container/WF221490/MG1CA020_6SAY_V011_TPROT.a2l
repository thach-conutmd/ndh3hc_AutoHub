ASAP2_VERSION 1 60
/begin PROJECT MG1CA020 "MG1CA020"
/begin HEADER "" VERSION "MG1CA020_6SAY_V011_TPROT" PROJECT_NO MG1CA020 /end HEADER
/begin MODULE DIM ""
/begin MOD_COMMON "" BYTE_ORDER MSB_LAST ALIGNMENT_BYTE 1 ALIGNMENT_WORD 2 ALIGNMENT_LONG 4 ALIGNMENT_INT64 4 ALIGNMENT_FLOAT32_IEEE 4 ALIGNMENT_FLOAT64_IEEE 4 DATA_SIZE 32 /end MOD_COMMON
/begin CHARACTERISTIC DFES_GrpRpr.DFC_MoXEMMHwLTTempSens_C "common MIL debouncing / group representative for common MIL debouncing of DFC_MoXEMMHwLTTempSens" VALUE 0x804FA2F6 Val_Wu16 703.000000000 DFC_Verb 0.00 703.000000000 FORMAT "%13.9" /end CHARACTERISTIC
/begin CHARACTERISTIC DFES_GrpRpr.DFC_MoXEMMHwLTUCBCfg_C "common MIL debouncing / group representative for common MIL debouncing of DFC_MoXEMMHwLTUCBCfg" VALUE 0x804FA2F8 Val_Wu16 703.000000000 DFC_Verb 0.00 703.000000000 FORMAT "%13.9" /end CHARACTERISTIC
/begin CHARACTERISTIC DFES_GrpRpr.DFC_OCWDAABEActv_C "common MIL debouncing / group representative for common MIL debouncing of DFC_OCWDAABEActv" VALUE 0x804FA2FA Val_Wu16 703.000000000 DFC_Verb 0.00 703.000000000 FORMAT "%13.9" /end CHARACTERISTIC
/begin CHARACTERISTIC DFES_GrpRpr.DFC_OCWDACom_C "common MIL debouncing / group representative for common MIL debouncing of DFC_OCWDACom" VALUE 0x804FA2FC Val_Wu16 703.000000000 DFC_Verb 0.00 703.000000000 FORMAT "%13.9" /end CHARACTERISTIC
/begin CHARACTERISTIC DFES_GrpRpr.DFC_OCWDAErrPin_C "common MIL debouncing / group representative for common MIL debouncing of DFC_OCWDAErrPin" VALUE 0x804FA2FE Val_Wu16 703.000000000 DFC_Verb 0.00 703.000000000 FORMAT "%13.9" /end CHARACTERISTIC
/begin CHARACTERISTIC DFES_GrpRpr.DFC_OCWDAOvrVltg_C "common MIL debouncing / group representative for common MIL debouncing of DFC_OCWDAOvrVltg" VALUE 0x804FA300 Val_Wu16 703.000000000 DFC_Verb 0.00 703.000000000 FORMAT "%13.9" /end CHARACTERISTIC
/begin CHARACTERISTIC DFES_GrpRpr.DFC_ORAmax_C "common MIL debouncing / group representative for common MIL debouncing of DFC_ORAmax" VALUE 0x804FA302 Val_Wu16 703.000000000 DFC_Verb 0.00 703.000000000 FORMAT "%13.9" /end CHARACTERISTIC
/begin CHARACTERISTIC DFES_GrpRpr.DFC_ORAmin_C "common MIL debouncing / group representative for common MIL debouncing of DFC_ORAmin" VALUE 0x804FA304 Val_Wu16 703.000000000 DFC_Verb 0.00 703.000000000 FORMAT "%13.9" /end CHARACTERISTIC
/begin CHARACTERISTIC DFES_GrpRpr.DFC_PLLSUmax_C "common MIL debouncing / group representative for common MIL debouncing of DFC_PLLSUmax" VALUE 0x804FA306 Val_Wu16 703.000000000 DFC_Verb 0.00 703.000000000 FORMAT "%13.9" /end CHARACTERISTIC
/begin CHARACTERISTIC DFES_GrpRpr.DFC_PLLSUmin_C "common MIL debouncing / group representative for common MIL debouncing of DFC_PLLSUmin" VALUE 0x804FA308 Val_Wu16 703.000000000 DFC_Verb 0.00 703.000000000 FORMAT "%13.9" /end CHARACTERISTIC
/begin CHARACTERISTIC DFES_GrpRpr.DFC_PSR1max_C "common MIL debouncing / group representative for common MIL debouncing of DFC_PSR1max" VALUE 0x804FA30A Val_Wu16 703.000000000 DFC_Verb 0.00 703.000000000 FORMAT "%13.9" /end CHARACTERISTIC
/begin CHARACTERISTIC DFES_GrpRpr.DFC_PSRBmax_C "common MIL debouncing / group representative for common MIL debouncing of DFC_PSRBmax" VALUE 0x804FA30C Val_Wu16 703.000000000 DFC_Verb 0.00 703.000000000 FORMAT "%13.9" /end CHARACTERISTIC
/begin CHARACTERISTIC DFES_GrpRpr.DFC_PSRBmin_C "common MIL debouncing / group representative for common MIL debouncing of DFC_PSRBmin" VALUE 0x804FA30E Val_Wu16 703.000000000 DFC_Verb 0.00 703.000000000 FORMAT "%13.9" /end CHARACTERISTIC
/begin CHARACTERISTIC DFES_GrpRpr.DFC_PSRPmax_C "common MIL debouncing / group representative for common MIL debouncing of DFC_PSRPmax" VALUE 0x804FA310 Val_Wu16 703.000000000 DFC_Verb 0.00 703.000000000 FORMAT "%13.9" /end CHARACTERISTIC
/begin CHARACTERISTIC DFES_GrpRpr.DFC_PSRPmin_C "common MIL debouncing / group representative for common MIL debouncing of DFC_PSRPmin" VALUE 0x804FA312 Val_Wu16 703.000000000 DFC_Verb 0.00 703.000000000 FORMAT "%13.9" /end CHARACTERISTIC
/begin CHARACTERISTIC DFES_GrpRpr.DFC_PSRPsig_C "common MIL debouncing / group representative for common MIL debouncing of DFC_PSRPsig" VALUE 0x804FA314 Val_Wu16 703.000000000 DFC_Verb 0.00 703.000000000 FORMAT "%13.9" /end CHARACTERISTIC
/begin CHARACTERISTIC DFES_GrpRpr.DFC_PSRmax_C "common MIL debouncing / group representative for common MIL debouncing of DFC_PSRmax" VALUE 0x804FA316 Val_Wu16 703.000000000 DFC_Verb 0.00 703.000000000 FORMAT "%13.9" /end CHARACTERISTIC
/begin CHARACTERISTIC DFES_GrpRpr.DFC_PUmax_C "common MIL debouncing / group representative for common MIL debouncing of DFC_PUmax" VALUE 0x804FA318 Val_Wu16 703.000000000 DFC_Verb 0.00 703.000000000 FORMAT "%13.9" /end CHARACTERISTIC
/begin CHARACTERISTIC DFES_GrpRpr.DFC_P_VSE11_OL_C "common MIL debouncing / group representative for common MIL debouncing of DFC_P_VSE11_OL" VALUE 0x804FA31A Val_Wu16 703.000000000 DFC_Verb 0.00 703.000000000 FORMAT "%13.9" /end CHARACTERISTIC
/begin CHARACTERISTIC DFES_GrpRpr.DFC_P_VSE11_SCB_C "common MIL debouncing / group representative for common MIL debouncing of DFC_P_VSE11_SCB" VALUE 0x804FA31C Val_Wu16 703.000000000 DFC_Verb 0.00 703.000000000 FORMAT "%13.9" /end CHARACTERISTIC
/begin CHARACTERISTIC DFES_GrpRpr.DFC_P_VSE11_SCG_C "common MIL debouncing / group representative for common MIL debouncing of DFC_P_VSE11_SCG" VALUE 0x804FA31E Val_Wu16 703.000000000 DFC_Verb 0.00 703.000000000 FORMAT "%13.9" /end CHARACTERISTIC
/begin CHARACTERISTIC DFES_GrpRpr.DFC_PhyHighAPP1_C "common MIL debouncing / group representative for common MIL debouncing of DFC_PhyHighAPP1" VALUE 0x804FA320 Val_Wu16 703.000000000 DFC_Verb 0.00 703.000000000 FORMAT "%13.9" /end CHARACTERISTIC
/begin CHARACTERISTIC DFES_GrpRpr.DFC_PhyHighAPP2_C "common MIL debouncing / group representative for common MIL debouncing of DFC_PhyHighAPP2" VALUE 0x804FA322 Val_Wu16 703.000000000 DFC_Verb 0.00 703.000000000 FORMAT "%13.9" /end CHARACTERISTIC
/begin CHARACTERISTIC DFES_GrpRpr.DFC_PhyLowAPP1_C "common MIL debouncing / group representative for common MIL debouncing of DFC_PhyLowAPP1" VALUE 0x804FA324 Val_Wu16 703.000000000 DFC_Verb 0.00 703.000000000 FORMAT "%13.9" /end CHARACTERISTIC
/begin CHARACTERISTIC DFES_GrpRpr.DFC_PhyLowAPP2_C "common MIL debouncing / group representative for common MIL debouncing of DFC_PhyLowAPP2" VALUE 0x804FA326 Val_Wu16 703.000000000 DFC_Verb 0.00 703.000000000 FORMAT "%13.9" /end CHARACTERISTIC
/begin CHARACTERISTIC DFES_GrpRpr.DFC_SRCHighAPP1_C "common MIL debouncing / group representative for common MIL debouncing of DFC_SRCHighAPP1" VALUE 0x804FA328 Val_Wu16 703.000000000 DFC_Verb 0.00 703.000000000 FORMAT "%13.9" /end CHARACTERISTIC
/begin CHARACTERISTIC DFES_GrpRpr.DFC_SRCHighAPP2_C "common MIL debouncing / group representative for common MIL debouncing of DFC_SRCHighAPP2" VALUE 0x804FA32A Val_Wu16 703.000000000 DFC_Verb 0.00 703.000000000 FORMAT "%13.9" /end CHARACTERISTIC
/begin CHARACTERISTIC DFES_GrpRpr.DFC_SRCLowAPP1_C "common MIL debouncing / group representative for common MIL debouncing of DFC_SRCLowAPP1" VALUE 0x804FA32C Val_Wu16 703.000000000 DFC_Verb 0.00 703.000000000 FORMAT "%13.9" /end CHARACTERISTIC
/begin CHARACTERISTIC DFES_GrpRpr.DFC_SRCLowAPP2_C "common MIL debouncing / group representative for common MIL debouncing of DFC_SRCLowAPP2" VALUE 0x804FA32E Val_Wu16 703.000000000 DFC_Verb 0.00 703.000000000 FORMAT "%13.9" /end CHARACTERISTIC
/begin CHARACTERISTIC DFES_GrpRpr.DFC_SSpMon2_C "common MIL debouncing / group representative for common MIL debouncing of DFC_SSpMon2" VALUE 0x804FA330 Val_Wu16 703.000000000 DFC_Verb 0.00 703.000000000 FORMAT "%13.9" /end CHARACTERISTIC
/begin CHARACTERISTIC DFES_GrpRpr.DFC_SWReset_0_C "common MIL debouncing / group representative for common MIL debouncing of DFC_SWReset_0" VALUE 0x804FA332 Val_Wu16 703.000000000 DFC_Verb 0.00 703.000000000 FORMAT "%13.9" /end CHARACTERISTIC
/begin CHARACTERISTIC DFES_GrpRpr.DFC_SWReset_1_C "common MIL debouncing / group representative for common MIL debouncing of DFC_SWReset_1" VALUE 0x804FA334 Val_Wu16 703.000000000 DFC_Verb 0.00 703.000000000 FORMAT "%13.9" /end CHARACTERISTIC
/begin CHARACTERISTIC DFES_GrpRpr.DFC_SWReset_2_C "common MIL debouncing / group representative for common MIL debouncing of DFC_SWReset_2" VALUE 0x804FA336 Val_Wu16 703.000000000 DFC_Verb 0.00 703.000000000 FORMAT "%13.9" /end CHARACTERISTIC
/begin CHARACTERISTIC DFES_GrpRpr.DFC_SyncAPP_C "common MIL debouncing / group representative for common MIL debouncing of DFC_SyncAPP" VALUE 0x804FA338 Val_Wu16 703.000000000 DFC_Verb 0.00 703.000000000 FORMAT "%13.9" /end CHARACTERISTIC
/begin CHARACTERISTIC DFES_GrpRpr.DFC_TAmax_Dummy_C "common MIL debouncing / group representative for common MIL debouncing of DFC_TAmax_Dummy" VALUE 0x804FA33A Val_Wu16 703.000000000 DFC_Verb 0.00 703.000000000 FORMAT "%13.9" /end CHARACTERISTIC
/begin CHARACTERISTIC DFES_GrpRpr.DFC_TKAEmax_C "common MIL debouncing / group representative for common MIL debouncing of DFC_TKAEmax" VALUE 0x804FA33C Val_Wu16 703.000000000 DFC_Verb 0.00 703.000000000 FORMAT "%13.9" /end CHARACTERISTIC
/begin CHARACTERISTIC DFES_GrpRpr.DFC_TKAEmin_C "common MIL debouncing / group representative for common MIL debouncing of DFC_TKAEmin" VALUE 0x804FA33E Val_Wu16 703.000000000 DFC_Verb 0.00 703.000000000 FORMAT "%13.9" /end CHARACTERISTIC
/begin CHARACTERISTIC DFES_GrpRpr.DFC_TKARmax_C "common MIL debouncing / group representative for common MIL debouncing of DFC_TKARmax" VALUE 0x804FA340 Val_Wu16 703.000000000 DFC_Verb 0.00 703.000000000 FORMAT "%13.9" /end CHARACTERISTIC
/begin CHARACTERISTIC DFES_GrpRpr.DFC_TKARnpl_C "common MIL debouncing / group representative for common MIL debouncing of DFC_TKARnpl" VALUE 0x804FA342 Val_Wu16 703.000000000 DFC_Verb 0.00 703.000000000 FORMAT "%13.9" /end CHARACTERISTIC
/begin CHARACTERISTIC DFES_GrpRpr.DFC_TMmax_Dummy_C "common MIL debouncing / group representative for common MIL debouncing of DFC_TMmax_Dummy" VALUE 0x804FA344 Val_Wu16 703.000000000 DFC_Verb 0.00 703.000000000 FORMAT "%13.9" /end CHARACTERISTIC
/begin CHARACTERISTIC DFES_GrpRpr.DFC_TUMmax_Dummy_C "common MIL debouncing / group representative for common MIL debouncing of DFC_TUMmax_Dummy" VALUE 0x804FA346 Val_Wu16 703.000000000 DFC_Verb 0.00 703.000000000 FORMAT "%13.9" /end CHARACTERISTIC
/begin CHARACTERISTIC DFES_GrpRpr.DFC_TWCDPriCatB1_C "common MIL debouncing / group representative for common MIL debouncing of DFC_TWCDPriCatB1" VALUE 0x804FA348 Val_Wu16 703.000000000 DFC_Verb 0.00 703.000000000 FORMAT "%13.9" /end CHARACTERISTIC
/begin CHARACTERISTIC DFES_GrpRpr.DFC_ThrVlvClsdPosnFirstOffsLrnImpoB1_C "common MIL debouncing / group representative for common MIL debouncing of DFC_ThrVlvClsdPosnFirstOffsLrnImpoB1" VALUE 0x804FA34A Val_Wu16 703.000000000 DFC_Verb 0.00 703.000000000 FORMAT "%13.9" /end CHARACTERISTIC
/begin CHARACTERISTIC DFES_GrpRpr.DFC_ThrVlvClsdPosnOffsLrnImpoB1_C "common MIL debouncing / group representative for common MIL debouncing of DFC_ThrVlvClsdPosnOffsLrnImpoB1" VALUE 0x804FA34C Val_Wu16 703.000000000 DFC_Verb 0.00 703.000000000 FORMAT "%13.9" /end CHARACTERISTIC
/begin CHARACTERISTIC DFES_GrpRpr.DFC_ThrVlvClsdPosnOffsLrnMaxB1_C "common MIL debouncing / group representative for common MIL debouncing of DFC_ThrVlvClsdPosnOffsLrnMaxB1" VALUE 0x804FA34E Val_Wu16 703.000000000 DFC_Verb 0.00 703.000000000 FORMAT "%13.9" /end CHARACTERISTIC
/begin CHARACTERISTIC DFES_GrpRpr.DFC_ThrVlvClsdPosnOffsLrnMinB1_C "common MIL debouncing / group representative for common MIL debouncing of DFC_ThrVlvClsdPosnOffsLrnMinB1" VALUE 0x804FA350 Val_Wu16 703.000000000 DFC_Verb 0.00 703.000000000 FORMAT "%13.9" /end CHARACTERISTIC
/begin CHARACTERISTIC DFES_GrpRpr.DFC_ThrVlvCtrlDeB1_C "common MIL debouncing / group representative for common MIL debouncing of DFC_ThrVlvCtrlDeB1" VALUE 0x804FA352 Val_Wu16 703.000000000 DFC_Verb 0.00 703.000000000 FORMAT "%13.9" /end CHARACTERISTIC
/begin CHARACTERISTIC DFES_GrpRpr.DFC_ThrVlvDycB1_C "common MIL debouncing / group representative for common MIL debouncing of DFC_ThrVlvDycB1" VALUE 0x804FA354 Val_Wu16 703.000000000 DFC_Verb 0.00 703.000000000 FORMAT "%13.9" /end CHARACTERISTIC
/begin CHARACTERISTIC DFES_GrpRpr.DFC_ThrVlvLimpAirPosnMaxAbsltDriftB1_C "common MIL debouncing / group representative for common MIL debouncing of DFC_ThrVlvLimpAirPosnMaxAbsltDriftB1" VALUE 0x804FA356 Val_Wu16 703.000000000 DFC_Verb 0.00 703.000000000 FORMAT "%13.9" /end CHARACTERISTIC
/begin CHARACTERISTIC DFES_GrpRpr.DFC_ThrVlvLimpAirPosnMaxB1_C "common MIL debouncing / group representative for common MIL debouncing of DFC_ThrVlvLimpAirPosnMaxB1" VALUE 0x804FA358 Val_Wu16 703.000000000 DFC_Verb 0.00 703.000000000 FORMAT "%13.9" /end CHARACTERISTIC
/begin CHARACTERISTIC DFES_GrpRpr.DFC_ThrVlvLimpAirPosnMaxRelDriftB1_C "common MIL debouncing / group representative for common MIL debouncing of DFC_ThrVlvLimpAirPosnMaxRelDriftB1" VALUE 0x804FA35A Val_Wu16 703.000000000 DFC_Verb 0.00 703.000000000 FORMAT "%13.9" /end CHARACTERISTIC
/begin CHARACTERISTIC DFES_GrpRpr.DFC_ThrVlvLimpAirPosnMinB1_C "common MIL debouncing / group representative for common MIL debouncing of DFC_ThrVlvLimpAirPosnMinB1" VALUE 0x804FA35C Val_Wu16 703.000000000 DFC_Verb 0.00 703.000000000 FORMAT "%13.9" /end CHARACTERISTIC
/begin CHARACTERISTIC DFES_GrpRpr.DFC_ThrVlvOpenLoadB1_C "common MIL debouncing / group representative for common MIL debouncing of DFC_ThrVlvOpenLoadB1" VALUE 0x804FA35E Val_Wu16 703.000000000 DFC_Verb 0.00 703.000000000 FORMAT "%13.9" /end CHARACTERISTIC
/begin CHARACTERISTIC DFES_GrpRpr.DFC_ThrVlvOpenSprgB1_C "common MIL debouncing / group representative for common MIL debouncing of DFC_ThrVlvOpenSprgB1" VALUE 0x804FA360 Val_Wu16 703.000000000 DFC_Verb 0.00 703.000000000 FORMAT "%13.9" /end CHARACTERISTIC
/begin CHARACTERISTIC DFES_GrpRpr.DFC_ThrVlvOpenSprgSprdB1_C "common MIL debouncing / group representative for common MIL debouncing of DFC_ThrVlvOpenSprgSprdB1" VALUE 0x804FA362 Val_Wu16 703.000000000 DFC_Verb 0.00 703.000000000 FORMAT "%13.9" /end CHARACTERISTIC
/begin CHARACTERISTIC DFES_GrpRpr.DFC_ThrVlvOpenSprgTwnB1_C "common MIL debouncing / group representative for common MIL debouncing of DFC_ThrVlvOpenSprgTwnB1" VALUE 0x804FA364 Val_Wu16 703.000000000 DFC_Verb 0.00 703.000000000 FORMAT "%13.9" /end CHARACTERISTIC
/begin CHARACTERISTIC DFES_GrpRpr.DFC_ThrVlvOverTB1_C "common MIL debouncing / group representative for common MIL debouncing of DFC_ThrVlvOverTB1" VALUE 0x804FA366 Val_Wu16 703.000000000 DFC_Verb 0.00 703.000000000 FORMAT "%13.9" /end CHARACTERISTIC
/begin CHARACTERISTIC DFES_GrpRpr.DFC_ThrVlvRetSprgB1_C "common MIL debouncing / group representative for common MIL debouncing of DFC_ThrVlvRetSprgB1" VALUE 0x804FA368 Val_Wu16 703.000000000 DFC_Verb 0.00 703.000000000 FORMAT "%13.9" /end CHARACTERISTIC
/begin CHARACTERISTIC DFES_GrpRpr.DFC_ThrVlvRetSprgSprdB1_C "common MIL debouncing / group representative for common MIL debouncing of DFC_ThrVlvRetSprgSprdB1" VALUE 0x804FA36A Val_Wu16 703.000000000 DFC_Verb 0.00 703.000000000 FORMAT "%13.9" /end CHARACTERISTIC
/begin CHARACTERISTIC DFES_GrpRpr.DFC_ThrVlvRetSprgTwnB1_C "common MIL debouncing / group representative for common MIL debouncing of DFC_ThrVlvRetSprgTwnB1" VALUE 0x804FA36C Val_Wu16 703.000000000 DFC_Verb 0.00 703.000000000 FORMAT "%13.9" /end CHARACTERISTIC
/begin CHARACTERISTIC DFES_GrpRpr.DFC_ThrVlvSens1MaxB1_C "common MIL debouncing / group representative for common MIL debouncing of DFC_ThrVlvSens1MaxB1" VALUE 0x804FA36E Val_Wu16 703.000000000 DFC_Verb 0.00 703.000000000 FORMAT "%13.9" /end CHARACTERISTIC
/begin CHARACTERISTIC DFES_GrpRpr.DFC_ThrVlvSens1NplB1_C "common MIL debouncing / group representative for common MIL debouncing of DFC_ThrVlvSens1NplB1" VALUE 0x804FA370 Val_Wu16 703.000000000 DFC_Verb 0.00 703.000000000 FORMAT "%13.9" /end CHARACTERISTIC
/begin CHARACTERISTIC DFES_GrpRpr.DFC_ThrVlvSens2MaxB1_C "common MIL debouncing / group representative for common MIL debouncing of DFC_ThrVlvSens2MaxB1" VALUE 0x804FA372 Val_Wu16 703.000000000 DFC_Verb 0.00 703.000000000 FORMAT "%13.9" /end CHARACTERISTIC
/begin CHARACTERISTIC DFES_GrpRpr.DFC_ThrVlvSens2MinB1_C "common MIL debouncing / group representative for common MIL debouncing of DFC_ThrVlvSens2MinB1" VALUE 0x804FA374 Val_Wu16 703.000000000 DFC_Verb 0.00 703.000000000 FORMAT "%13.9" /end CHARACTERISTIC
/begin CHARACTERISTIC DFES_GrpRpr.DFC_ThrVlvSens2NplB1_C "common MIL debouncing / group representative for common MIL debouncing of DFC_ThrVlvSens2NplB1" VALUE 0x804FA376 Val_Wu16 703.000000000 DFC_Verb 0.00 703.000000000 FORMAT "%13.9" /end CHARACTERISTIC
/begin CHARACTERISTIC DFES_GrpRpr.DFC_ThrVlvShoCircB1_C "common MIL debouncing / group representative for common MIL debouncing of DFC_ThrVlvShoCircB1" VALUE 0x804FA378 Val_Wu16 703.000000000 DFC_Verb 0.00 703.000000000 FORMAT "%13.9" /end CHARACTERISTIC
/begin CHARACTERISTIC DFES_GrpRpr.DFC_ThrVlvSpiErrB1_C "common MIL debouncing / group representative for common MIL debouncing of DFC_ThrVlvSpiErrB1" VALUE 0x804FA37A Val_Wu16 703.000000000 DFC_Verb 0.00 703.000000000 FORMAT "%13.9" /end CHARACTERISTIC
/begin CHARACTERISTIC DFES_GrpRpr.DFC_ThrvlvSens1MinB1_C "common MIL debouncing / group representative for common MIL debouncing of DFC_ThrvlvSens1MinB1" VALUE 0x804FA37C Val_Wu16 703.000000000 DFC_Verb 0.00 703.000000000 FORMAT "%13.9" /end CHARACTERISTIC
/begin CHARACTERISTIC DFES_GrpRpr.DFC_TiOffTBasdChkFast_C "common MIL debouncing / group representative for common MIL debouncing of DFC_TiOffTBasdChkFast" VALUE 0x804FA37E Val_Wu16 703.000000000 DFC_Verb 0.00 703.000000000 FORMAT "%13.9" /end CHARACTERISTIC
/begin CHARACTERISTIC DFES_GrpRpr.DFC_TiOffTBasdChkSlow_C "common MIL debouncing / group representative for common MIL debouncing of DFC_TiOffTBasdChkSlow" VALUE 0x804FA380 Val_Wu16 703.000000000 DFC_Verb 0.00 703.000000000 FORMAT "%13.9" /end CHARACTERISTIC
/begin CHARACTERISTIC DFES_GrpRpr.DFC_UEGOHeatrCtlS1B1_C "common MIL debouncing / group representative for common MIL debouncing of DFC_UEGOHeatrCtlS1B1" VALUE 0x804FA382 Val_Wu16 703.000000000 DFC_Verb 0.00 703.000000000 FORMAT "%13.9" /end CHARACTERISTIC
/begin CHARACTERISTIC DFES_GrpRpr.DFC_UEGOSnsrMntdS1B1_C "common MIL debouncing / group representative for common MIL debouncing of DFC_UEGOSnsrMntdS1B1" VALUE 0x804FA384 Val_Wu16 703.000000000 DFC_Verb 0.00 703.000000000 FORMAT "%13.9" /end CHARACTERISTIC
/begin CHARACTERISTIC DFES_GrpRpr.DFC_VehVSig_C "common MIL debouncing / group representative for common MIL debouncing of DFC_VehVSig" VALUE 0x804FA386 Val_Wu16 703.000000000 DFC_Verb 0.00 703.000000000 FORMAT "%13.9" /end CHARACTERISTIC
/begin CHARACTERISTIC DFES_GrpRpr.DFC_VlvLftFbSwtIntk11SpclFail_C "common MIL debouncing / group representative for common MIL debouncing of DFC_VlvLftFbSwtIntk11SpclFail" VALUE 0x804FA388 Val_Wu16 703.000000000 DFC_Verb 0.00 703.000000000 FORMAT "%13.9" /end CHARACTERISTIC
/begin CHARACTERISTIC DFES_GrpRpr.DFC_VlvLftFbSwtIntk11StdFail_C "common MIL debouncing / group representative for common MIL debouncing of DFC_VlvLftFbSwtIntk11StdFail" VALUE 0x804FA38A Val_Wu16 703.000000000 DFC_Verb 0.00 703.000000000 FORMAT "%13.9" /end CHARACTERISTIC
/begin CHARACTERISTIC DFES_MonEvtMSK0_C "Event filter mask of Monitoring - Mask Id mast have 0 at bit mask 0 positions" VALUE 0x804D93EE Val_Wu16 65535.00 OneToOne 0.00 65535.00 FORMAT "%8.2" /end CHARACTERISTIC
/begin CHARACTERISTIC DFES_MonEvtMSK1_C "Event filter mask of Monitoring - Mask Id mast have 1 at bit mask 1 positions" VALUE 0x804D93F0 Val_Wu16 65535.00 OneToOne 0.00 65535.00 FORMAT "%8.2" /end CHARACTERISTIC
/begin CHARACTERISTIC DFES_MonRepeat_C "switch to ignore same kind of monitoring events, set to 0 to suppress identical events in a row" VALUE 0x804D93F2 Val_Wu8 255.0 OneToOne 0.00 255.0 FORMAT "%5.1" /end CHARACTERISTIC
/begin CHARACTERISTIC DFES_numClsDlt_CA "Fault class parameter: Number of cycles for OBD delete counter" VAL_BLK 0x804D93F3 ValA_Wu8 255.0 DFES_OneToOne 0.00 255.0 FORMAT "%5.1" NUMBER 31 /end CHARACTERISTIC
/begin CHARACTERISTIC DFES_numClsFaultCycl_CA "Fault class parameter: Number of cycles for fault counter" VAL_BLK 0x804D9412 ValA_Wu8 255.0 DFES_OneToOne 0.00 255.0 FORMAT "%5.1" NUMBER 31 /end CHARACTERISTIC
/begin CHARACTERISTIC DFES_numClsHealCycl_CA "Fault class parameter: Number of cycles for healing counter" VAL_BLK 0x804D9431 ValA_Wu8 255.0 DFES_OneToOne 0.00 255.0 FORMAT "%5.1" NUMBER 31 /end CHARACTERISTIC
/begin CHARACTERISTIC DFES_numClsPndDlt_CA "Fault class parameter: Number of cycles for pending delete counter" VAL_BLK 0x804D9450 ValA_Wu8 255.0 DFES_OneToOne 0.00 255.0 FORMAT "%5.1" NUMBER 31 /end CHARACTERISTIC
/begin CHARACTERISTIC DFES_numClsSvcDlt_CA "Fault class parameter: Number of cycles for delete counter" VAL_BLK 0x804D946F ValA_Wu8 255.0 DFES_OneToOne 0.00 255.0 FORMAT "%5.1" NUMBER 31 /end CHARACTERISTIC
/begin CHARACTERISTIC DFES_numClsSVSFaultCycl_CA "Fault class parameter: Number of cycles for SVS lamp fault counter" VAL_BLK 0x804D948E ValA_Wu8 255.0 DFES_OneToOne 0.00 255.0 FORMAT "%5.1" NUMBER 31 /end CHARACTERISTIC
/begin CHARACTERISTIC DFES_numClsSVSHealCycl_CA "Fault class parameter: Number of cycles for SVS lamp healing counter" VAL_BLK 0x804D94AD ValA_Wu8 255.0 DFES_OneToOne 0.00 255.0 FORMAT "%5.1" NUMBER 31 /end CHARACTERISTIC
/begin CHARACTERISTIC DFES_ThresSimCond.n_C "" VALUE 0x804D94CC Val_Wu16 16383.75 DFES_nPID0C 0.00 16383.75 FORMAT "%8.2" /end CHARACTERISTIC
/begin CHARACTERISTIC DFES_ThresSimCond.r_C "" VALUE 0x804D94CE Val_Wu8 100.0 DFES_rPID04 0.00 100.0 FORMAT "%5.1" /end CHARACTERISTIC
/begin CHARACTERISTIC DFES_ThresSimCond.t_C "" VALUE 0x804D94CF Val_Wu8 255.0 DFES_tPID05 -40.0 215.0 FORMAT "%5.1" /end CHARACTERISTIC
/begin CHARACTERISTIC DFES_xAsgnExtdFrzFrSig_CA "Signal selection for extended freeze frame (signal based)" VAL_BLK 0x804D94D0 ValA_Wu16 782.000000000 Signals_IntSigNumVerb 0.00 782.000000000 FORMAT "%13.9" NUMBER 50 /end CHARACTERISTIC
/begin CHARACTERISTIC DFES_xAsgnFrzFrSig_CA "Signal selection for freeze frame (signal based)" VAL_BLK 0x804D9534 ValA_Wu16 782.000000000 Signals_IntSigNumVerb 0.00 782.000000000 FORMAT "%13.9" NUMBER 77 /end CHARACTERISTIC
/begin CHARACTERISTIC DFES_xClsDltTrg_CA "Fault class parameter: Trigger type for OBD delete counter" VAL_BLK 0x804D95CE ValA_Wu8 11.0000000000 DSMAUX_DTRGVerb 0.00 11.0000000000 FORMAT "%13.10" NUMBER 31 /end CHARACTERISTIC
/begin CHARACTERISTIC DFES_xClsFaultTrg_CA "Fault class parameter: Trigger type for fault counter" VAL_BLK 0x804D95ED ValA_Wu8 11.0000000000 DSMAUX_DTRGVerb 0.00 11.0000000000 FORMAT "%13.10" NUMBER 31 /end CHARACTERISTIC
/begin CHARACTERISTIC DFES_xClsFltMIL_CA "Fault class parameter: MIL control" VAL_BLK 0x804D960C ValA_Wu8 3.00000000000 DFES_LampFltMIL 0.00 3.00000000000 FORMAT "%13.11" NUMBER 31 /end CHARACTERISTIC
/begin CHARACTERISTIC DFES_xClsFltSVS_CA "Fault class parameter: SVS lamp control" VAL_BLK 0x804D962B ValA_Wu8 8.00000000000 DFES_LampFltSVS 0.00 8.00000000000 FORMAT "%13.11" NUMBER 31 /end CHARACTERISTIC
/begin CHARACTERISTIC DFES_xClsHealTrg_CA "Fault class parameter: Trigger type for healing counter" VAL_BLK 0x804D964A ValA_Wu8 11.0000000000 DSMAUX_DTRGVerb 0.00 11.0000000000 FORMAT "%13.10" NUMBER 31 /end CHARACTERISTIC
/begin CHARACTERISTIC DFES_xClsPndDltTrg_CA "Fault class parameter: Trigger type for pending delete counter" VAL_BLK 0x804D9669 ValA_Wu8 11.0000000000 DSMAUX_DTRGVerb 0.00 11.0000000000 FORMAT "%13.10" NUMBER 31 /end CHARACTERISTIC
/begin CHARACTERISTIC DFES_xClsPrio_CA "Fault class parameter: Static priority and tester visibility" VAL_BLK 0x804D9688 ValA_Wu8 214.000000000 DFES_TstVisAndPrio 3.000000000 217.000000000 FORMAT "%13.9" NUMBER 31 /end CHARACTERISTIC
/begin CHARACTERISTIC DFES_xClsSvcDltTrg_CA "Fault class parameter: Trigger type for delete counter" VAL_BLK 0x804D96A7 ValA_Wu8 11.0000000000 DSMAUX_DTRGVerb 0.00 11.0000000000 FORMAT "%13.10" NUMBER 31 /end CHARACTERISTIC
/begin CHARACTERISTIC DFES_xClsSVSFaultTrg_CA "Fault class parameter: Trigger type for SVS lamp fault counter" VAL_BLK 0x804D96C6 ValA_Wu8 11.0000000000 DSMAUX_DTRGVerb 0.00 11.0000000000 FORMAT "%13.10" NUMBER 31 /end CHARACTERISTIC
/begin CHARACTERISTIC DFES_xClsSVSHealTrg_CA "Fault class parameter: Trigger type for SVS lamp healing counter" VAL_BLK 0x804D96E5 ValA_Wu8 11.0000000000 DSMAUX_DTRGVerb 0.00 11.0000000000 FORMAT "%13.10" NUMBER 31 /end CHARACTERISTIC
/begin CHARACTERISTIC DiaActr_ElecPsDiag_DbgSigId_C "Signal Id to be debugged" VALUE 0x8053AD38 Val_Wu32 4294967295.00 OneToOne 0.00 4294967295.00 FORMAT "%13.2" /end CHARACTERISTIC
/begin CHARACTERISTIC DiaActr_ElecPsDiag_DbgSigTyp_C "Type of the output signal (PWMOut, DigOut, Pmd) to be debugged." VALUE 0x8053AD3C Val_Wu8 3.00000000000 DiaActr_ElecPsDiag_DbgSigTyp_COMPU_VERB 0.00 3.00000000000 FORMAT "%13.11" /end CHARACTERISTIC
/begin CHARACTERISTIC DiaActr_ElecPsDiag_SigOutDurgOpenLd_C "Take into account Open-Load-Error for Shut-Off request." VALUE 0x8053AD3D Val_Wu8 1.000 OneToOne 0.00 1.000 FORMAT "%5.3" EXTENDED_LIMITS 0.00 255.0 /end CHARACTERISTIC
/begin CHARACTERISTIC Diff_rTrqDfftl_C "Defaultvalue for the Differential ratio" VALUE 0x8051C1F6 RB_Val_Ws16 655.3500 TransR -327.6800 327.6700 FORMAT "%8.4" /end CHARACTERISTIC
/begin MEASUREMENT DiaActrElecPsDiag_cntTestPlsTsk_mp "L-1 L=enNumber of testpulses in current driving cycleL-1" UWORD OneToOne 1 100 0.00 65535.00 FORMAT "%8.2" ECU_ADDRESS 0x7000890C /end MEASUREMENT
/begin MEASUREMENT DiaActrElecPsDiag_nrDiagErr_mp "Number of supported errors of the diagnosis signal" UBYTE OneToOne 1 100 0.00 255.0 FORMAT "%5.1" ECU_ADDRESS 0x70008AB3 /end MEASUREMENT
/begin MEASUREMENT DiaActrElecPsDiag_nrTestPls_mp "Number of testpulses in current driving cycle" ULONG OneToOne 1 100 0.00 4294967295.00 FORMAT "%13.2" ECU_ADDRESS 0x700087B4 /end MEASUREMENT
/begin MEASUREMENT DiaActrElecPsDiag_stAttribOL_mp "Current DSM attribute (Tested detection) of the open load error when reporting open load error to DSM module" ULONG OneToOne 1 100 0.00 4294967295.00 FORMAT "%13.2" ECU_ADDRESS 0x700087B0 /end MEASUREMENT
/begin MEASUREMENT DiaActrElecPsDiag_stAttribOT_mp "Current DSM attribute (Tested detection) of the overtemperature error when reporting overtemperature error to DSM module" ULONG OneToOne 1 100 0.00 4294967295.00 FORMAT "%13.2" ECU_ADDRESS 0x700087AC /end MEASUREMENT
/begin MEASUREMENT DiaActrElecPsDiag_stAttribSCB_mp "Current DSM attribute (Tested detection) of the short circuit to battery error when reporting short circuit to battery error to DSM module" ULONG OneToOne 1 100 0.00 4294967295.00 FORMAT "%13.2" ECU_ADDRESS 0x700087A8 /end MEASUREMENT
/begin MEASUREMENT DiaActrElecPsDiag_stAttribSCG_mp "Current DSM attribute (Tested detection) of the short circuit to ground error when reporting short circuit to ground error to DSM module" ULONG OneToOne 1 100 0.00 4294967295.00 FORMAT "%13.2" ECU_ADDRESS 0x700087A4 /end MEASUREMENT
/begin MEASUREMENT DiaActrElecPsDiag_stDsmDebOpenLoad_mp "Debounce status of OL error" ULONG OneToOne 1 100 0.00 4294967295.00 FORMAT "%13.2" ECU_ADDRESS 0x700087A0 /end MEASUREMENT
/begin MEASUREMENT DiaActrElecPsDiag_stDsmDebOverT_mp "Debounce status of OT error" ULONG OneToOne 1 100 0.00 4294967295.00 FORMAT "%13.2" ECU_ADDRESS 0x7000879C /end MEASUREMENT
/begin MEASUREMENT DiaActrElecPsDiag_stDsmDebScb_mp "Debounce status of SCB error" ULONG OneToOne 1 100 0.00 4294967295.00 FORMAT "%13.2" ECU_ADDRESS 0x70008798 /end MEASUREMENT
/begin MEASUREMENT DiaActrElecPsDiag_stDsmDebScg_mp "Debounce status of SCG error" ULONG OneToOne 1 100 0.00 4294967295.00 FORMAT "%13.2" ECU_ADDRESS 0x70008794 /end MEASUREMENT
/begin MEASUREMENT DiaActrElecPsDiag_stErrCfgOpenLoad_mp "Configuration of behaviour for OL error" UBYTE OneToOne 1 100 0.00 255.0 FORMAT "%5.1" ECU_ADDRESS 0x70008AB2 /end MEASUREMENT
/begin MEASUREMENT DiaActrElecPsDiag_stErrCfgOverT_mp "Configuration of behaviour for OT error" UBYTE OneToOne 1 100 0.00 255.0 FORMAT "%5.1" ECU_ADDRESS 0x70008AB1 /end MEASUREMENT
/begin MEASUREMENT DiaActrElecPsDiag_stErrCfgScb_mp "Configuration of behaviour for SCB error" UBYTE OneToOne 1 100 0.00 255.0 FORMAT "%5.1" ECU_ADDRESS 0x70008AB0 /end MEASUREMENT
/begin MEASUREMENT DiaActrElecPsDiag_stErrCfgScg_mp "Configuration of behaviour for SCG error" UBYTE OneToOne 1 100 0.00 255.0 FORMAT "%5.1" ECU_ADDRESS 0x70008AAF /end MEASUREMENT
/begin MEASUREMENT DiaActrElecPsDiag_stPrvTstRslt_mp "The latest result of test impulse" ULONG OneToOne 1 100 0.00 4294967295.00 FORMAT "%13.2" ECU_ADDRESS 0x70008790 /end MEASUREMENT
/begin MEASUREMENT DiaActrElecPsDiag_stSigCfg_mp "Configuration of the diagnosis signal" UBYTE OneToOne 1 100 0.00 255.0 FORMAT "%5.1" ECU_ADDRESS 0x70008AAE /end MEASUREMENT
/begin MEASUREMENT DiaActrElecPsDiag_stSigErrInfo_mp "The last error information of HWE read from the chip" ULONG OneToOne 1 100 0.00 4294967295.00 FORMAT "%13.2" ECU_ADDRESS 0x7000878C /end MEASUREMENT
/begin MEASUREMENT DiaActrElecPsDiag_stSig_mp "Actual state of the diagnosis signal: INVALID, NOTEST, NOFAULT, FAULT, PREFAULT, HEALFAULT, WAITSTATE" UBYTE DiaActrElecPsDiag_stSig_COMPU_VERB 1 100 0.00 6.00000000000 FORMAT "%13.11" ECU_ADDRESS 0x70008AAD /end MEASUREMENT
/begin MEASUREMENT DiaActrElecPsDiag_stTestPls_mp "L-1 L=enThe actual state of the testpulse state machine: NO, REQUESTED, RUN, FINISHED, RE-TRIGGEREDL-1" UBYTE DiaActrElecPsDiag_stTestPls_COMPU_VERB 1 100 1.00000000000 5.00000000000 FORMAT "%13.11" ECU_ADDRESS 0x70008AAC /end MEASUREMENT
/begin MEASUREMENT DiaActrElecPsDiag_stTmngTestPls_mp "The current time to wait between two testpulses" UBYTE DiaActrElecPsDiag_stTmngTestPls_COMPU_VERB 1 100 0.00 3.00000000000 FORMAT "%13.11" ECU_ADDRESS 0x70008AAB /end MEASUREMENT
/begin MEASUREMENT DiaActrElecPsDiag_tiTstPls_mp "Current status of timer for the time between testpulses during permanent fault" SWORD OneToOne 1 100 -32768.00 32767.00 FORMAT "%8.2" ECU_ADDRESS 0x7000890A /end MEASUREMENT
/begin MEASUREMENT DiaActrElecPsDiag_TstPlsCnt_Cfg_mp "Measurement points for test pulse counter setting" UBYTE OneToOne 1 100 0.00 255.0 FORMAT "%5.1" ECU_ADDRESS 0x70008AAA /end MEASUREMENT
/begin MEASUREMENT DINH_DSQSrv7Vis "Service 0x07 visibility of DSQs" UWORD OneToOne 1 100 0.00 65535.00 FORMAT "%8.2" ARRAY_SIZE 3 ECU_ADDRESS 0x500057AE /end MEASUREMENT
/begin MEASUREMENT DINH_FIdSrv7Vis "Service 0x07 visibility of FIds" UWORD OneToOne 1 100 0.00 65535.00 FORMAT "%8.2" ARRAY_SIZE 46 ECU_ADDRESS 0x500057B4 /end MEASUREMENT
/begin MEASUREMENT DINH_nrActvInhReas.FID_AFRA "Number of active inhibit reasons for the FIds / Number of active inhibit reasons for FID_AFRA" UWORD DINH_ct_Compu 1 100 -4095.000 4096.000 BIT_MASK 0x1fff FORMAT "%8.3" ECU_ADDRESS 0x6000DAAA /end MEASUREMENT
/begin MEASUREMENT DINH_nrActvInhReas.FID_AORA "Number of active inhibit reasons for the FIds / Number of active inhibit reasons for FID_AORA" UWORD DINH_ct_Compu 1 100 -4095.000 4096.000 BIT_MASK 0x1fff FORMAT "%8.3" ECU_ADDRESS 0x6000DAAC /end MEASUREMENT
/begin MEASUREMENT DINH_nrActvInhReas.FID_ATEH "Number of active inhibit reasons for the FIds / Number of active inhibit reasons for FID_ATEH" UWORD DINH_ct_Compu 1 100 -4095.000 4096.000 BIT_MASK 0x1fff FORMAT "%8.3" ECU_ADDRESS 0x6000DAAE /end MEASUREMENT
/begin MEASUREMENT DINH_nrActvInhReas.FID_ATEL "Number of active inhibit reasons for the FIds / Number of active inhibit reasons for FID_ATEL" UWORD DINH_ct_Compu 1 100 -4095.000 4096.000 BIT_MASK 0x1fff FORMAT "%8.3" ECU_ADDRESS 0x6000DAB0 /end MEASUREMENT
/begin MEASUREMENT DINH_nrActvInhReas.FID_ATEN "Number of active inhibit reasons for the FIds / Number of active inhibit reasons for FID_ATEN" UWORD DINH_ct_Compu 1 100 -4095.000 4096.000 BIT_MASK 0x1fff FORMAT "%8.3" ECU_ADDRESS 0x6000DAB2 /end MEASUREMENT
/begin MEASUREMENT DINH_nrActvInhReas.FId_EGSDCmnSeg1B1Parl "Number of active inhibit reasons for the FIds / Number of active inhibit reasons for FId_EGSDCmnSeg1B1Parl" UWORD DINH_ct_Compu 1 100 -4095.000 4096.000 BIT_MASK 0x1fff FORMAT "%8.3" ECU_ADDRESS 0x6000DAB4 /end MEASUREMENT
/begin MEASUREMENT DINH_nrActvInhReas.FID_BLLRH "Number of active inhibit reasons for the FIds / Number of active inhibit reasons for FID_BLLRH" UWORD DINH_ct_Compu 1 100 -4095.000 4096.000 BIT_MASK 0x1fff FORMAT "%8.3" ECU_ADDRESS 0x6000DAB6 /end MEASUREMENT
/begin MEASUREMENT DINH_nrActvInhReas.FID_BLLRKH "Number of active inhibit reasons for the FIds / Number of active inhibit reasons for FID_BLLRKH" UWORD DINH_ct_Compu 1 100 -4095.000 4096.000 BIT_MASK 0x1fff FORMAT "%8.3" ECU_ADDRESS 0x6000DAB8 /end MEASUREMENT
/begin MEASUREMENT DINH_nrActvInhReas.FID_BPLSU "Number of active inhibit reasons for the FIds / Number of active inhibit reasons for FID_BPLSU" UWORD DINH_ct_Compu 1 100 -4095.000 4096.000 BIT_MASK 0x1fff FORMAT "%8.3" ECU_ADDRESS 0x6000DABA /end MEASUREMENT
/begin MEASUREMENT DINH_nrActvInhReas.FId_CJ135RvsChrgMeasS1B1 "Number of active inhibit reasons for the FIds / Number of active inhibit reasons for FId_CJ135RvsChrgMeasS1B1" UWORD DINH_ct_Compu 1 100 -4095.000 4096.000 BIT_MASK 0x1fff FORMAT "%8.3" ECU_ADDRESS 0x6000DABC /end MEASUREMENT
/begin MEASUREMENT DINH_nrActvInhReas.FId_CatHeatgColdStrtReq "Number of active inhibit reasons for the FIds / Number of active inhibit reasons for FId_CatHeatgColdStrtReq" UWORD DINH_ct_Compu 1 100 -4095.000 4096.000 BIT_MASK 0x1fff FORMAT "%8.3" ECU_ADDRESS 0x6000DABE /end MEASUREMENT
/begin MEASUREMENT DINH_nrActvInhReas.FId_CatHeatgWrmReq "Number of active inhibit reasons for the FIds / Number of active inhibit reasons for FId_CatHeatgWrmReq" UWORD DINH_ct_Compu 1 100 -4095.000 4096.000 BIT_MASK 0x1fff FORMAT "%8.3" ECU_ADDRESS 0x6000DAC0 /end MEASUREMENT
/begin MEASUREMENT DINH_nrActvInhReas.FId_EGSDO2SnsrMntdRelsS1B1 "Number of active inhibit reasons for the FIds / Number of active inhibit reasons for FId_EGSDO2SnsrMntdRelsS1B1" UWORD DINH_ct_Compu 1 100 -4095.000 4096.000 BIT_MASK 0x1fff FORMAT "%8.3" ECU_ADDRESS 0x6000DAC2 /end MEASUREMENT
/begin MEASUREMENT DINH_nrActvInhReas.FId_EGSDO2_LamOffsFastS1B1 "Number of active inhibit reasons for the FIds / Number of active inhibit reasons for FId_EGSDO2_LamOffsFastS1B1" UWORD DINH_ct_Compu 1 100 -4095.000 4096.000 BIT_MASK 0x1fff FORMAT "%8.3" ECU_ADDRESS 0x6000DAC4 /end MEASUREMENT
/begin MEASUREMENT DINH_nrActvInhReas.FId_MisfDetDnAdpnNv "Number of active inhibit reasons for the FIds / Number of active inhibit reasons for FId_MisfDetDnAdpnNv" UWORD DINH_ct_Compu 1 100 -4095.000 4096.000 BIT_MASK 0x1fff FORMAT "%8.3" ECU_ADDRESS 0x6000DAC6 /end MEASUREMENT
/begin MEASUREMENT DINH_nrActvInhReas.FID_BGFKMS "Number of active inhibit reasons for the FIds / Number of active inhibit reasons for FID_BGFKMS" UWORD DINH_ct_Compu 1 100 -4095.000 4096.000 BIT_MASK 0x1fff FORMAT "%8.3" ECU_ADDRESS 0x6000DAC8 /end MEASUREMENT
/begin MEASUREMENT DINH_nrActvInhReas.FID_CDSTTI "Number of active inhibit reasons for the FIds / Number of active inhibit reasons for FID_CDSTTI" UWORD DINH_ct_Compu 1 100 -4095.000 4096.000 BIT_MASK 0x1fff FORMAT "%8.3" ECU_ADDRESS 0x6000DACA /end MEASUREMENT
/begin MEASUREMENT DINH_nrActvInhReas.FID_CETKHL "Number of active inhibit reasons for the FIds / Number of active inhibit reasons for FID_CETKHL" UWORD DINH_ct_Compu 1 100 -4095.000 4096.000 BIT_MASK 0x1fff FORMAT "%8.3" ECU_ADDRESS 0x6000DACC /end MEASUREMENT
/begin MEASUREMENT DINH_nrActvInhReas.FID_CETKHT "Number of active inhibit reasons for the FIds / Number of active inhibit reasons for FID_CETKHT" UWORD DINH_ct_Compu 1 100 -4095.000 4096.000 BIT_MASK 0x1fff FORMAT "%8.3" ECU_ADDRESS 0x6000DACE /end MEASUREMENT
/begin MEASUREMENT DINH_nrActvInhReas.FID_CGLSRDP "Number of active inhibit reasons for the FIds / Number of active inhibit reasons for FID_CGLSRDP" UWORD DINH_ct_Compu 1 100 -4095.000 4096.000 BIT_MASK 0x1fff FORMAT "%8.3" ECU_ADDRESS 0x6000DAD0 /end MEASUREMENT
/begin MEASUREMENT DINH_nrActvInhReas.FID_CLLKHV "Number of active inhibit reasons for the FIds / Number of active inhibit reasons for FID_CLLKHV" UWORD DINH_ct_Compu 1 100 -4095.000 4096.000 BIT_MASK 0x1fff FORMAT "%8.3" ECU_ADDRESS 0x6000DAD2 /end MEASUREMENT
/begin MEASUREMENT DINH_nrActvInhReas.FID_CLLRHV "Number of active inhibit reasons for the FIds / Number of active inhibit reasons for FID_CLLRHV" UWORD DINH_ct_Compu 1 100 -4095.000 4096.000 BIT_MASK 0x1fff FORMAT "%8.3" ECU_ADDRESS 0x6000DAD4 /end MEASUREMENT
/begin MEASUREMENT DINH_nrActvInhReas.FID_CLZSRDP "Number of active inhibit reasons for the FIds / Number of active inhibit reasons for FID_CLZSRDP" UWORD DINH_ct_Compu 1 100 -4095.000 4096.000 BIT_MASK 0x1fff FORMAT "%8.3" ECU_ADDRESS 0x6000DAD6 /end MEASUREMENT
/begin MEASUREMENT DINH_nrActvInhReas.FID_CNSAD "Number of active inhibit reasons for the FIds / Number of active inhibit reasons for FID_CNSAD" UWORD DINH_ct_Compu 1 100 -4095.000 4096.000 BIT_MASK 0x1fff FORMAT "%8.3" ECU_ADDRESS 0x6000DAD8 /end MEASUREMENT
/begin MEASUREMENT DINH_nrActvInhReas.FID_CNSAD2 "Number of active inhibit reasons for the FIds / Number of active inhibit reasons for FID_CNSAD2" UWORD DINH_ct_Compu 1 100 -4095.000 4096.000 BIT_MASK 0x1fff FORMAT "%8.3" ECU_ADDRESS 0x6000DADA /end MEASUREMENT
/begin MEASUREMENT DINH_nrActvInhReas.FID_CPFISTRT "Number of active inhibit reasons for the FIds / Number of active inhibit reasons for FID_CPFISTRT" UWORD DINH_ct_Compu 1 100 -4095.000 4096.000 BIT_MASK 0x1fff FORMAT "%8.3" ECU_ADDRESS 0x6000DADC /end MEASUREMENT
/begin MEASUREMENT DINH_nrActvInhReas.FID_CPSRB "Number of active inhibit reasons for the FIds / Number of active inhibit reasons for FID_CPSRB" UWORD DINH_ct_Compu 1 100 -4095.000 4096.000 BIT_MASK 0x1fff FORMAT "%8.3" ECU_ADDRESS 0x6000DADE /end MEASUREMENT
/begin MEASUREMENT DINH_nrActvInhReas.FID_CPSRP "Number of active inhibit reasons for the FIds / Number of active inhibit reasons for FID_CPSRP" UWORD DINH_ct_Compu 1 100 -4095.000 4096.000 BIT_MASK 0x1fff FORMAT "%8.3" ECU_ADDRESS 0x6000DAE0 /end MEASUREMENT
/begin MEASUREMENT DINH_nrActvInhReas.FID_DKRSA "Number of active inhibit reasons for the FIds / Number of active inhibit reasons for FID_DKRSA" UWORD DINH_ct_Compu 1 100 -4095.000 4096.000 BIT_MASK 0x1fff FORMAT "%8.3" ECU_ADDRESS 0x6000DAE2 /end MEASUREMENT
/begin MEASUREMENT DINH_nrActvInhReas.FID_DLLRBandEndTst "Number of active inhibit reasons for the FIds / Number of active inhibit reasons for FID_DLLRBandEndTst" UWORD DINH_ct_Compu 1 100 -4095.000 4096.000 BIT_MASK 0x1fff FORMAT "%8.3" ECU_ADDRESS 0x6000DAE4 /end MEASUREMENT
/begin MEASUREMENT DINH_nrActvInhReas.FID_DLLRShrtTrpSpdRmp "Number of active inhibit reasons for the FIds / Number of active inhibit reasons for FID_DLLRShrtTrpSpdRmp" UWORD DINH_ct_Compu 1 100 -4095.000 4096.000 BIT_MASK 0x1fff FORMAT "%8.3" ECU_ADDRESS 0x6000DAE6 /end MEASUREMENT
/begin MEASUREMENT DINH_nrActvInhReas.FID_FEDKAPB "Number of active inhibit reasons for the FIds / Number of active inhibit reasons for FID_FEDKAPB" UWORD DINH_ct_Compu 1 100 -4095.000 4096.000 BIT_MASK 0x1fff FORMAT "%8.3" ECU_ADDRESS 0x6000DAE8 /end MEASUREMENT
/begin MEASUREMENT DINH_nrActvInhReas.FID_FEDSSB "Number of active inhibit reasons for the FIds / Number of active inhibit reasons for FID_FEDSSB" UWORD DINH_ct_Compu 1 100 -4095.000 4096.000 BIT_MASK 0x1fff FORMAT "%8.3" ECU_ADDRESS 0x6000DAEA /end MEASUREMENT
/begin MEASUREMENT DINH_nrActvInhReas.FID_FOFSTP "Number of active inhibit reasons for the FIds / Number of active inhibit reasons for FID_FOFSTP" UWORD DINH_ct_Compu 1 100 -4095.000 4096.000 BIT_MASK 0x1fff FORMAT "%8.3" ECU_ADDRESS 0x6000DAEC /end MEASUREMENT
/begin MEASUREMENT DINH_nrActvInhReas.FID_FONSTP "Number of active inhibit reasons for the FIds / Number of active inhibit reasons for FID_FONSTP" UWORD DINH_ct_Compu 1 100 -4095.000 4096.000 BIT_MASK 0x1fff FORMAT "%8.3" ECU_ADDRESS 0x6000DAEE /end MEASUREMENT
/begin MEASUREMENT DINH_nrActvInhReas.FID_FUEDK "Number of active inhibit reasons for the FIds / Number of active inhibit reasons for FID_FUEDK" UWORD DINH_ct_Compu 1 100 -4095.000 4096.000 BIT_MASK 0x1fff FORMAT "%8.3" ECU_ADDRESS 0x6000DAF0 /end MEASUREMENT
/begin MEASUREMENT DINH_nrActvInhReas.FID_LRADLSU "Number of active inhibit reasons for the FIds / Number of active inhibit reasons for FID_LRADLSU" UWORD DINH_ct_Compu 1 100 -4095.000 4096.000 BIT_MASK 0x1fff FORMAT "%8.3" ECU_ADDRESS 0x6000DAF2 /end MEASUREMENT
/begin MEASUREMENT DINH_nrActvInhReas.FID_LRALSVErr "Number of active inhibit reasons for the FIds / Number of active inhibit reasons for FID_LRALSVErr" UWORD DINH_ct_Compu 1 100 -4095.000 4096.000 BIT_MASK 0x1fff FORMAT "%8.3" ECU_ADDRESS 0x6000DAF4 /end MEASUREMENT
/begin MEASUREMENT DINH_nrActvInhReas.FID_LRAPLLSU "Number of active inhibit reasons for the FIds / Number of active inhibit reasons for FID_LRAPLLSU" UWORD DINH_ct_Compu 1 100 -4095.000 4096.000 BIT_MASK 0x1fff FORMAT "%8.3" ECU_ADDRESS 0x6000DAF6 /end MEASUREMENT
/begin MEASUREMENT DINH_nrActvInhReas.FID_LUSTP "Number of active inhibit reasons for the FIds / Number of active inhibit reasons for FID_LUSTP" UWORD DINH_ct_Compu 1 100 -4095.000 4096.000 BIT_MASK 0x1fff FORMAT "%8.3" ECU_ADDRESS 0x6000DAF8 /end MEASUREMENT
/begin MEASUREMENT DINH_nrActvInhReas.FID_LnKS1 "Number of active inhibit reasons for the FIds / Number of active inhibit reasons for FID_LnKS1" UWORD DINH_ct_Compu 1 100 -4095.000 4096.000 BIT_MASK 0x1fff FORMAT "%8.3" ECU_ADDRESS 0x6000DAFA /end MEASUREMENT
/begin MEASUREMENT DINH_nrActvInhReas.FID_PLSUV "Number of active inhibit reasons for the FIds / Number of active inhibit reasons for FID_PLSUV" UWORD DINH_ct_Compu 1 100 -4095.000 4096.000 BIT_MASK 0x1fff FORMAT "%8.3" ECU_ADDRESS 0x6000DAFC /end MEASUREMENT
/begin MEASUREMENT DINH_nrActvInhReas.FID_PSRMOZDG "Number of active inhibit reasons for the FIds / Number of active inhibit reasons for FID_PSRMOZDG" UWORD DINH_ct_Compu 1 100 -4095.000 4096.000 BIT_MASK 0x1fff FORMAT "%8.3" ECU_ADDRESS 0x6000DAFE /end MEASUREMENT
/begin MEASUREMENT DINH_nrActvInhReas.FID_PSRMOZG "Number of active inhibit reasons for the FIds / Number of active inhibit reasons for FID_PSRMOZG" UWORD DINH_ct_Compu 1 100 -4095.000 4096.000 BIT_MASK 0x1fff FORMAT "%8.3" ECU_ADDRESS 0x6000DB00 /end MEASUREMENT
/begin MEASUREMENT DINH_nrActvInhReas.FID_STRTDIA "Number of active inhibit reasons for the FIds / Number of active inhibit reasons for FID_STRTDIA" UWORD DINH_ct_Compu 1 100 -4095.000 4096.000 BIT_MASK 0x1fff FORMAT "%8.3" ECU_ADDRESS 0x6000DB02 /end MEASUREMENT
/begin MEASUREMENT DINH_nrActvInhReas.FID_STRTSTM "Number of active inhibit reasons for the FIds / Number of active inhibit reasons for FID_STRTSTM" UWORD DINH_ct_Compu 1 100 -4095.000 4096.000 BIT_MASK 0x1fff FORMAT "%8.3" ECU_ADDRESS 0x6000DB04 /end MEASUREMENT
/begin MEASUREMENT DINH_nrActvInhReas.FID_TFA1CSMW "Number of active inhibit reasons for the FIds / Number of active inhibit reasons for FID_TFA1CSMW" UWORD DINH_ct_Compu 1 100 -4095.000 4096.000 BIT_MASK 0x1fff FORMAT "%8.3" ECU_ADDRESS 0x6000DB06 /end MEASUREMENT
/begin MEASUREMENT DINH_nrActvInhReas.FID_TKACSMW "Number of active inhibit reasons for the FIds / Number of active inhibit reasons for FID_TKACSMW" UWORD DINH_ct_Compu 1 100 -4095.000 4096.000 BIT_MASK 0x1fff FORMAT "%8.3" ECU_ADDRESS 0x6000DB08 /end MEASUREMENT
/begin MEASUREMENT DINH_nrActvInhReas.FID_TMCSMW "Number of active inhibit reasons for the FIds / Number of active inhibit reasons for FID_TMCSMW" UWORD DINH_ct_Compu 1 100 -4095.000 4096.000 BIT_MASK 0x1fff FORMAT "%8.3" ECU_ADDRESS 0x6000DB0A /end MEASUREMENT
/begin MEASUREMENT DINH_nrActvInhReas.FID_TOCHOilSwmpTQly "Number of active inhibit reasons for the FIds / Number of active inhibit reasons for FID_TOCHOilSwmpTQly" UWORD DINH_ct_Compu 1 100 -4095.000 4096.000 BIT_MASK 0x1fff FORMAT "%8.3" ECU_ADDRESS 0x6000DB0C /end MEASUREMENT
/begin MEASUREMENT DINH_nrActvInhReas.FID_TOCHTME "Number of active inhibit reasons for the FIds / Number of active inhibit reasons for FID_TOCHTME" UWORD DINH_ct_Compu 1 100 -4095.000 4096.000 BIT_MASK 0x1fff FORMAT "%8.3" ECU_ADDRESS 0x6000DB0E /end MEASUREMENT
/begin MEASUREMENT DINH_nrActvInhReas.FID_TOSPCSMW "Number of active inhibit reasons for the FIds / Number of active inhibit reasons for FID_TOSPCSMW" UWORD DINH_ct_Compu 1 100 -4095.000 4096.000 BIT_MASK 0x1fff FORMAT "%8.3" ECU_ADDRESS 0x6000DB10 /end MEASUREMENT
/begin MEASUREMENT DINH_nrActvInhReas.FID_UEGOHeatrRlyS1B1 "Number of active inhibit reasons for the FIds / Number of active inhibit reasons for FID_UEGOHeatrRlyS1B1" UWORD DINH_ct_Compu 1 100 -4095.000 4096.000 BIT_MASK 0x1fff FORMAT "%8.3" ECU_ADDRESS 0x6000DB12 /end MEASUREMENT
/begin MEASUREMENT DINH_nrActvInhReas.FID_VehStvSSEOk "Number of active inhibit reasons for the FIds / Number of active inhibit reasons for FID_VehStvSSEOk" UWORD DINH_ct_Compu 1 100 -4095.000 4096.000 BIT_MASK 0x1fff FORMAT "%8.3" ECU_ADDRESS 0x6000DB14 /end MEASUREMENT
/begin MEASUREMENT DINH_nrActvInhReas.FID_VldtLamPlausMaxS1B1 "Number of active inhibit reasons for the FIds / Number of active inhibit reasons for FID_VldtLamPlausMaxS1B1" UWORD DINH_ct_Compu 1 100 -4095.000 4096.000 BIT_MASK 0x1fff FORMAT "%8.3" ECU_ADDRESS 0x6000DB16 /end MEASUREMENT
/begin MEASUREMENT DINH_nrActvInhReas.FID_VldtLamPlausMinS1B1 "Number of active inhibit reasons for the FIds / Number of active inhibit reasons for FID_VldtLamPlausMinS1B1" UWORD DINH_ct_Compu 1 100 -4095.000 4096.000 BIT_MASK 0x1fff FORMAT "%8.3" ECU_ADDRESS 0x6000DB18 /end MEASUREMENT
/begin MEASUREMENT DINH_nrActvInhReas.FId_ACClntPSSPMon "Number of active inhibit reasons for the FIds / Number of active inhibit reasons for FId_ACClntPSSPMon" UWORD DINH_ct_Compu 1 100 -4095.000 4096.000 BIT_MASK 0x1fff FORMAT "%8.3" ECU_ADDRESS 0x6000DB1A /end MEASUREMENT
/begin MEASUREMENT DINH_nrActvInhReas.FId_ACCompComCANBusOff "Number of active inhibit reasons for the FIds / Number of active inhibit reasons for FId_ACCompComCANBusOff" UWORD DINH_ct_Compu 1 100 -4095.000 4096.000 BIT_MASK 0x1fff FORMAT "%8.3" ECU_ADDRESS 0x6000DB1C /end MEASUREMENT
/begin MEASUREMENT DINH_nrActvInhReas.FId_ACCompComCANErrMtr "Number of active inhibit reasons for the FIds / Number of active inhibit reasons for FId_ACCompComCANErrMtr" UWORD DINH_ct_Compu 1 100 -4095.000 4096.000 BIT_MASK 0x1fff FORMAT "%8.3" ECU_ADDRESS 0x6000DB1E /end MEASUREMENT
/begin MEASUREMENT DINH_nrActvInhReas.FId_ACComp_HiUTWSnsrErr "Number of active inhibit reasons for the FIds / Number of active inhibit reasons for FId_ACComp_HiUTWSnsrErr" UWORD DINH_ct_Compu 1 100 -4095.000 4096.000 BIT_MASK 0x1fff FORMAT "%8.3" ECU_ADDRESS 0x6000DB20 /end MEASUREMENT
/begin MEASUREMENT DINH_nrActvInhReas.FId_ACComp_LoUTWSnsrErr "Number of active inhibit reasons for the FIds / Number of active inhibit reasons for FId_ACComp_LoUTWSnsrErr" UWORD DINH_ct_Compu 1 100 -4095.000 4096.000 BIT_MASK 0x1fff FORMAT "%8.3" ECU_ADDRESS 0x6000DB22 /end MEASUREMENT
/begin MEASUREMENT DINH_nrActvInhReas.FId_ACComp_PDSnsrErr "Number of active inhibit reasons for the FIds / Number of active inhibit reasons for FId_ACComp_PDSnsrErr" UWORD DINH_ct_Compu 1 100 -4095.000 4096.000 BIT_MASK 0x1fff FORMAT "%8.3" ECU_ADDRESS 0x6000DB24 /end MEASUREMENT
/begin MEASUREMENT DINH_nrActvInhReas.FId_ACComp_VehSpdSnsrErr "Number of active inhibit reasons for the FIds / Number of active inhibit reasons for FId_ACComp_VehSpdSnsrErr" UWORD DINH_ct_Compu 1 100 -4095.000 4096.000 BIT_MASK 0x1fff FORMAT "%8.3" ECU_ADDRESS 0x6000DB26 /end MEASUREMENT
/begin MEASUREMENT DINH_nrActvInhReas.FId_ACCtl_ACStrtCut "Number of active inhibit reasons for the FIds / Number of active inhibit reasons for FId_ACCtl_ACStrtCut" UWORD DINH_ct_Compu 1 100 -4095.000 4096.000 BIT_MASK 0x1fff FORMAT "%8.3" ECU_ADDRESS 0x6000DB28 /end MEASUREMENT
/begin MEASUREMENT DINH_nrActvInhReas.FId_ACCtl_APP1 "Number of active inhibit reasons for the FIds / Number of active inhibit reasons for FId_ACCtl_APP1" UWORD DINH_ct_Compu 1 100 -4095.000 4096.000 BIT_MASK 0x1fff FORMAT "%8.3" ECU_ADDRESS 0x6000DB2A /end MEASUREMENT
/begin MEASUREMENT DINH_nrActvInhReas.FId_ACCtl_APP2 "Number of active inhibit reasons for the FIds / Number of active inhibit reasons for FId_ACCtl_APP2" UWORD DINH_ct_Compu 1 100 -4095.000 4096.000 BIT_MASK 0x1fff FORMAT "%8.3" ECU_ADDRESS 0x6000DB2C /end MEASUREMENT
/begin MEASUREMENT DINH_nrActvInhReas.FId_ACCtl_APPSync "Number of active inhibit reasons for the FIds / Number of active inhibit reasons for FId_ACCtl_APPSync" UWORD DINH_ct_Compu 1 100 -4095.000 4096.000 BIT_MASK 0x1fff FORMAT "%8.3" ECU_ADDRESS 0x6000DB2E /end MEASUREMENT
/begin MEASUREMENT DINH_nrActvInhReas.FId_ACCtl_AcOff "Number of active inhibit reasons for the FIds / Number of active inhibit reasons for FId_ACCtl_AcOff" UWORD DINH_ct_Compu 1 100 -4095.000 4096.000 BIT_MASK 0x1fff FORMAT "%8.3" ECU_ADDRESS 0x6000DB30 /end MEASUREMENT
/begin MEASUREMENT DINH_nrActvInhReas.FId_ACCtl_Clmb "Number of active inhibit reasons for the FIds / Number of active inhibit reasons for FId_ACCtl_Clmb" UWORD DINH_ct_Compu 1 100 -4095.000 4096.000 BIT_MASK 0x1fff FORMAT "%8.3" ECU_ADDRESS 0x6000DB32 /end MEASUREMENT
/begin MEASUREMENT DINH_nrActvInhReas.FId_ACCtl_DK1 "Number of active inhibit reasons for the FIds / Number of active inhibit reasons for FId_ACCtl_DK1" UWORD DINH_ct_Compu 1 100 -4095.000 4096.000 BIT_MASK 0x1fff FORMAT "%8.3" ECU_ADDRESS 0x6000DB34 /end MEASUREMENT
/begin MEASUREMENT DINH_nrActvInhReas.FId_ACCtl_DK2 "Number of active inhibit reasons for the FIds / Number of active inhibit reasons for FId_ACCtl_DK2" UWORD DINH_ct_Compu 1 100 -4095.000 4096.000 BIT_MASK 0x1fff FORMAT "%8.3" ECU_ADDRESS 0x6000DB36 /end MEASUREMENT
/begin MEASUREMENT DINH_nrActvInhReas.FId_ACCtl_DKSync "Number of active inhibit reasons for the FIds / Number of active inhibit reasons for FId_ACCtl_DKSync" UWORD DINH_ct_Compu 1 100 -4095.000 4096.000 BIT_MASK 0x1fff FORMAT "%8.3" ECU_ADDRESS 0x6000DB38 /end MEASUREMENT
/begin MEASUREMENT DINH_nrActvInhReas.FId_ACCtl_VehSpdSnsrErr "Number of active inhibit reasons for the FIds / Number of active inhibit reasons for FId_ACCtl_VehSpdSnsrErr" UWORD DINH_ct_Compu 1 100 -4095.000 4096.000 BIT_MASK 0x1fff FORMAT "%8.3" ECU_ADDRESS 0x6000DB3A /end MEASUREMENT
/begin MEASUREMENT DINH_nrActvInhReas.FId_ACCtl_pAC "Number of active inhibit reasons for the FIds / Number of active inhibit reasons for FId_ACCtl_pAC" UWORD DINH_ct_Compu 1 100 -4095.000 4096.000 BIT_MASK 0x1fff FORMAT "%8.3" ECU_ADDRESS 0x6000DB3C /end MEASUREMENT
/begin MEASUREMENT DINH_nrActvInhReas.FId_ACEvpTCANErr "Number of active inhibit reasons for the FIds / Number of active inhibit reasons for FId_ACEvpTCANErr" UWORD DINH_ct_Compu 1 100 -4095.000 4096.000 BIT_MASK 0x1fff FORMAT "%8.3" ECU_ADDRESS 0x6000DB3E /end MEASUREMENT
/begin MEASUREMENT DINH_nrActvInhReas.FId_ACEvpTFrzVal "Number of active inhibit reasons for the FIds / Number of active inhibit reasons for FId_ACEvpTFrzVal" UWORD DINH_ct_Compu 1 100 -4095.000 4096.000 BIT_MASK 0x1fff FORMAT "%8.3" ECU_ADDRESS 0x6000DB40 /end MEASUREMENT
/begin MEASUREMENT DINH_nrActvInhReas.FId_ACEvpTRplVal "Number of active inhibit reasons for the FIds / Number of active inhibit reasons for FId_ACEvpTRplVal" UWORD DINH_ct_Compu 1 100 -4095.000 4096.000 BIT_MASK 0x1fff FORMAT "%8.3" ECU_ADDRESS 0x6000DB42 /end MEASUREMENT
/begin MEASUREMENT DINH_nrActvInhReas.FId_APP1SigPath "Number of active inhibit reasons for the FIds / Number of active inhibit reasons for FId_APP1SigPath" UWORD DINH_ct_Compu 1 100 -4095.000 4096.000 BIT_MASK 0x1fff FORMAT "%8.3" ECU_ADDRESS 0x6000DB44 /end MEASUREMENT
/begin MEASUREMENT DINH_nrActvInhReas.FId_APP2SigPath "Number of active inhibit reasons for the FIds / Number of active inhibit reasons for FId_APP2SigPath" UWORD DINH_ct_Compu 1 100 -4095.000 4096.000 BIT_MASK 0x1fff FORMAT "%8.3" ECU_ADDRESS 0x6000DB46 /end MEASUREMENT
/begin MEASUREMENT DINH_nrActvInhReas.FId_APPBrkErr "Number of active inhibit reasons for the FIds / Number of active inhibit reasons for FId_APPBrkErr" UWORD DINH_ct_Compu 1 100 -4095.000 4096.000 BIT_MASK 0x1fff FORMAT "%8.3" ECU_ADDRESS 0x6000DB48 /end MEASUREMENT
/begin MEASUREMENT DINH_nrActvInhReas.FId_APPLETVldnErr "Number of active inhibit reasons for the FIds / Number of active inhibit reasons for FId_APPLETVldnErr" UWORD DINH_ct_Compu 1 100 -4095.000 4096.000 BIT_MASK 0x1fff FORMAT "%8.3" ECU_ADDRESS 0x6000DB4A /end MEASUREMENT
/begin MEASUREMENT DINH_nrActvInhReas.FId_APPLrn "Number of active inhibit reasons for the FIds / Number of active inhibit reasons for FId_APPLrn" UWORD DINH_ct_Compu 1 100 -4095.000 4096.000 BIT_MASK 0x1fff FORMAT "%8.3" ECU_ADDRESS 0x6000DB4C /end MEASUREMENT
/begin MEASUREMENT DINH_nrActvInhReas.FId_APPVehVErr "Number of active inhibit reasons for the FIds / Number of active inhibit reasons for FId_APPVehVErr" UWORD DINH_ct_Compu 1 100 -4095.000 4096.000 BIT_MASK 0x1fff FORMAT "%8.3" ECU_ADDRESS 0x6000DB4E /end MEASUREMENT
/begin MEASUREMENT DINH_nrActvInhReas.FId_AccPedDrvModComErr "Number of active inhibit reasons for the FIds / Number of active inhibit reasons for FId_AccPedDrvModComErr" UWORD DINH_ct_Compu 1 100 -4095.000 4096.000 BIT_MASK 0x1fff FORMAT "%8.3" ECU_ADDRESS 0x6000DB50 /end MEASUREMENT
/begin MEASUREMENT DINH_nrActvInhReas.FId_AccPedDrvModFailr "Number of active inhibit reasons for the FIds / Number of active inhibit reasons for FId_AccPedDrvModFailr" UWORD DINH_ct_Compu 1 100 -4095.000 4096.000 BIT_MASK 0x1fff FORMAT "%8.3" ECU_ADDRESS 0x6000DB52 /end MEASUREMENT
/begin MEASUREMENT DINH_nrActvInhReas.FId_AccPedNMaxLim "Number of active inhibit reasons for the FIds / Number of active inhibit reasons for FId_AccPedNMaxLim" UWORD DINH_ct_Compu 1 100 -4095.000 4096.000 BIT_MASK 0x1fff FORMAT "%8.3" ECU_ADDRESS 0x6000DB54 /end MEASUREMENT
/begin MEASUREMENT DINH_nrActvInhReas.FId_AccPedNMinLim "Number of active inhibit reasons for the FIds / Number of active inhibit reasons for FId_AccPedNMinLim" UWORD DINH_ct_Compu 1 100 -4095.000 4096.000 BIT_MASK 0x1fff FORMAT "%8.3" ECU_ADDRESS 0x6000DB56 /end MEASUREMENT
/begin MEASUREMENT DINH_nrActvInhReas.FId_AccPedNMinLimBrkApp "Number of active inhibit reasons for the FIds / Number of active inhibit reasons for FId_AccPedNMinLimBrkApp" UWORD DINH_ct_Compu 1 100 -4095.000 4096.000 BIT_MASK 0x1fff FORMAT "%8.3" ECU_ADDRESS 0x6000DB58 /end MEASUREMENT
/begin MEASUREMENT DINH_nrActvInhReas.FId_AccPedTrqLim "Number of active inhibit reasons for the FIds / Number of active inhibit reasons for FId_AccPedTrqLim" UWORD DINH_ct_Compu 1 100 -4095.000 4096.000 BIT_MASK 0x1fff FORMAT "%8.3" ECU_ADDRESS 0x6000DB5A /end MEASUREMENT
/begin MEASUREMENT DINH_nrActvInhReas.FId_AirCClntPFrzVal "Number of active inhibit reasons for the FIds / Number of active inhibit reasons for FId_AirCClntPFrzVal" UWORD DINH_ct_Compu 1 100 -4095.000 4096.000 BIT_MASK 0x1fff FORMAT "%8.3" ECU_ADDRESS 0x6000DB5C /end MEASUREMENT
/begin MEASUREMENT DINH_nrActvInhReas.FId_AirCClntPRplVal "Number of active inhibit reasons for the FIds / Number of active inhibit reasons for FId_AirCClntPRplVal" UWORD DINH_ct_Compu 1 100 -4095.000 4096.000 BIT_MASK 0x1fff FORMAT "%8.3" ECU_ADDRESS 0x6000DB5E /end MEASUREMENT
/begin MEASUREMENT DINH_nrActvInhReas.FId_AirCSwt "Number of active inhibit reasons for the FIds / Number of active inhibit reasons for FId_AirCSwt" UWORD DINH_ct_Compu 1 100 -4095.000 4096.000 BIT_MASK 0x1fff FORMAT "%8.3" ECU_ADDRESS 0x6000DB60 /end MEASUREMENT
/begin MEASUREMENT DINH_nrActvInhReas.FId_AirDvPAdpnPEnv "Number of active inhibit reasons for the FIds / Number of active inhibit reasons for FId_AirDvPAdpnPEnv" UWORD DINH_ct_Compu 1 100 -4095.000 4096.000 BIT_MASK 0x1fff FORMAT "%8.3" ECU_ADDRESS 0x6000DB62 /end MEASUREMENT
/begin MEASUREMENT DINH_nrActvInhReas.FId_AirDvPAdpnPIntkVUsB1 "Number of active inhibit reasons for the FIds / Number of active inhibit reasons for FId_AirDvPAdpnPIntkVUsB1" UWORD DINH_ct_Compu 1 100 -4095.000 4096.000 BIT_MASK 0x1fff FORMAT "%8.3" ECU_ADDRESS 0x6000DB64 /end MEASUREMENT
/begin MEASUREMENT DINH_nrActvInhReas.FId_AirDvPPSnsrAdpn_PModeActv "Number of active inhibit reasons for the FIds / Number of active inhibit reasons for FId_AirDvPPSnsrAdpn_PModeActv" UWORD DINH_ct_Compu 1 100 -4095.000 4096.000 BIT_MASK 0x1fff FORMAT "%8.3" ECU_ADDRESS 0x6000DB66 /end MEASUREMENT
/begin MEASUREMENT DINH_nrActvInhReas.FId_AltACGFailr "Number of active inhibit reasons for the FIds / Number of active inhibit reasons for FId_AltACGFailr" UWORD DINH_ct_Compu 1 100 -4095.000 4096.000 BIT_MASK 0x1fff FORMAT "%8.3" ECU_ADDRESS 0x6000DB68 /end MEASUREMENT
/begin MEASUREMENT DINH_nrActvInhReas.FId_AltAPPErrSt "Number of active inhibit reasons for the FIds / Number of active inhibit reasons for FId_AltAPPErrSt" UWORD DINH_ct_Compu 1 100 -4095.000 4096.000 BIT_MASK 0x1fff FORMAT "%8.3" ECU_ADDRESS 0x6000DB6A /end MEASUREMENT
/begin MEASUREMENT DINH_nrActvInhReas.FId_AltBattMngtFailr "Number of active inhibit reasons for the FIds / Number of active inhibit reasons for FId_AltBattMngtFailr" UWORD DINH_ct_Compu 1 100 -4095.000 4096.000 BIT_MASK 0x1fff FORMAT "%8.3" ECU_ADDRESS 0x6000DB6C /end MEASUREMENT
/begin MEASUREMENT DINH_nrActvInhReas.FId_AltBrkErrSt "Number of active inhibit reasons for the FIds / Number of active inhibit reasons for FId_AltBrkErrSt" UWORD DINH_ct_Compu 1 100 -4095.000 4096.000 BIT_MASK 0x1fff FORMAT "%8.3" ECU_ADDRESS 0x6000DB6E /end MEASUREMENT
/begin MEASUREMENT DINH_nrActvInhReas.FId_AltComErr "Number of active inhibit reasons for the FIds / Number of active inhibit reasons for FId_AltComErr" UWORD DINH_ct_Compu 1 100 -4095.000 4096.000 BIT_MASK 0x1fff FORMAT "%8.3" ECU_ADDRESS 0x6000DB70 /end MEASUREMENT
/begin MEASUREMENT DINH_nrActvInhReas.FId_AltENGB "Number of active inhibit reasons for the FIds / Number of active inhibit reasons for FId_AltENGB" UWORD DINH_ct_Compu 1 100 -4095.000 4096.000 BIT_MASK 0x1fff FORMAT "%8.3" ECU_ADDRESS 0x6000DB72 /end MEASUREMENT
/begin MEASUREMENT DINH_nrActvInhReas.FId_AltElecLoadErr "Number of active inhibit reasons for the FIds / Number of active inhibit reasons for FId_AltElecLoadErr" UWORD DINH_ct_Compu 1 100 -4095.000 4096.000 BIT_MASK 0x1fff FORMAT "%8.3" ECU_ADDRESS 0x6000DB74 /end MEASUREMENT
/begin MEASUREMENT DINH_nrActvInhReas.FId_AltEnvTErr "Number of active inhibit reasons for the FIds / Number of active inhibit reasons for FId_AltEnvTErr" UWORD DINH_ct_Compu 1 100 -4095.000 4096.000 BIT_MASK 0x1fff FORMAT "%8.3" ECU_ADDRESS 0x6000DB76 /end MEASUREMENT
/begin MEASUREMENT DINH_nrActvInhReas.FId_AltFFAltLoadFast "Number of active inhibit reasons for the FIds / Number of active inhibit reasons for FId_AltFFAltLoadFast" UWORD DINH_ct_Compu 1 100 -4095.000 4096.000 BIT_MASK 0x1fff FORMAT "%8.3" ECU_ADDRESS 0x6000DB78 /end MEASUREMENT
/begin MEASUREMENT DINH_nrActvInhReas.FId_AltFFAltLoadSlow "Number of active inhibit reasons for the FIds / Number of active inhibit reasons for FId_AltFFAltLoadSlow" UWORD DINH_ct_Compu 1 100 -4095.000 4096.000 BIT_MASK 0x1fff FORMAT "%8.3" ECU_ADDRESS 0x6000DB7A /end MEASUREMENT
/begin MEASUREMENT DINH_nrActvInhReas.FId_AltIOACGErr "Number of active inhibit reasons for the FIds / Number of active inhibit reasons for FId_AltIOACGErr" UWORD DINH_ct_Compu 1 100 -4095.000 4096.000 BIT_MASK 0x1fff FORMAT "%8.3" ECU_ADDRESS 0x6000DB7C /end MEASUREMENT
/begin MEASUREMENT DINH_nrActvInhReas.FId_AltIOACGLinComFailr "Number of active inhibit reasons for the FIds / Number of active inhibit reasons for FId_AltIOACGLinComFailr" UWORD DINH_ct_Compu 1 100 -4095.000 4096.000 BIT_MASK 0x1fff FORMAT "%8.3" ECU_ADDRESS 0x6000DB7E /end MEASUREMENT
/begin MEASUREMENT DINH_nrActvInhReas.FId_AltIOComErr "Number of active inhibit reasons for the FIds / Number of active inhibit reasons for FId_AltIOComErr" UWORD DINH_ct_Compu 1 100 -4095.000 4096.000 BIT_MASK 0x1fff FORMAT "%8.3" ECU_ADDRESS 0x6000DB80 /end MEASUREMENT
/begin MEASUREMENT DINH_nrActvInhReas.FId_AltLinErr "Number of active inhibit reasons for the FIds / Number of active inhibit reasons for FId_AltLinErr" UWORD DINH_ct_Compu 1 100 -4095.000 4096.000 BIT_MASK 0x1fff FORMAT "%8.3" ECU_ADDRESS 0x6000DB82 /end MEASUREMENT
/begin MEASUREMENT DINH_nrActvInhReas.FId_AltPwr "Number of active inhibit reasons for the FIds / Number of active inhibit reasons for FId_AltPwr" UWORD DINH_ct_Compu 1 100 -4095.000 4096.000 BIT_MASK 0x1fff FORMAT "%8.3" ECU_ADDRESS 0x6000DB84 /end MEASUREMENT
/begin MEASUREMENT DINH_nrActvInhReas.FId_AltVehVErrSt "Number of active inhibit reasons for the FIds / Number of active inhibit reasons for FId_AltVehVErrSt" UWORD DINH_ct_Compu 1 100 -4095.000 4096.000 BIT_MASK 0x1fff FORMAT "%8.3" ECU_ADDRESS 0x6000DB86 /end MEASUREMENT
/begin MEASUREMENT DINH_nrActvInhReas.FId_BGFKMSEPSR "Number of active inhibit reasons for the FIds / Number of active inhibit reasons for FId_BGFKMSEPSR" UWORD DINH_ct_Compu 1 100 -4095.000 4096.000 BIT_MASK 0x1fff FORMAT "%8.3" ECU_ADDRESS 0x6000DB88 /end MEASUREMENT
/begin MEASUREMENT DINH_nrActvInhReas.FId_BGFKMSEPU "Number of active inhibit reasons for the FIds / Number of active inhibit reasons for FId_BGFKMSEPU" UWORD DINH_ct_Compu 1 100 -4095.000 4096.000 BIT_MASK 0x1fff FORMAT "%8.3" ECU_ADDRESS 0x6000DB8A /end MEASUREMENT
/begin MEASUREMENT DINH_nrActvInhReas.FId_BGFKMSESumClr "Number of active inhibit reasons for the FIds / Number of active inhibit reasons for FId_BGFKMSESumClr" UWORD DINH_ct_Compu 1 100 -4095.000 4096.000 BIT_MASK 0x1fff FORMAT "%8.3" ECU_ADDRESS 0x6000DB8C /end MEASUREMENT
/begin MEASUREMENT DINH_nrActvInhReas.FId_BGFKMSZPSR "Number of active inhibit reasons for the FIds / Number of active inhibit reasons for FId_BGFKMSZPSR" UWORD DINH_ct_Compu 1 100 -4095.000 4096.000 BIT_MASK 0x1fff FORMAT "%8.3" ECU_ADDRESS 0x6000DB8E /end MEASUREMENT
/begin MEASUREMENT DINH_nrActvInhReas.FId_BGOSCCat1B1 "Number of active inhibit reasons for the FIds / Number of active inhibit reasons for FId_BGOSCCat1B1" UWORD DINH_ct_Compu 1 100 -4095.000 4096.000 BIT_MASK 0x1fff FORMAT "%8.3" ECU_ADDRESS 0x6000DB90 /end MEASUREMENT
/begin MEASUREMENT DINH_nrActvInhReas.FId_BGOSCCat2B1 "Number of active inhibit reasons for the FIds / Number of active inhibit reasons for FId_BGOSCCat2B1" UWORD DINH_ct_Compu 1 100 -4095.000 4096.000 BIT_MASK 0x1fff FORMAT "%8.3" ECU_ADDRESS 0x6000DB92 /end MEASUREMENT
/begin MEASUREMENT DINH_nrActvInhReas.FId_BattAltFailr "Number of active inhibit reasons for the FIds / Number of active inhibit reasons for FId_BattAltFailr" UWORD DINH_ct_Compu 1 100 -4095.000 4096.000 BIT_MASK 0x1fff FORMAT "%8.3" ECU_ADDRESS 0x6000DB94 /end MEASUREMENT
/begin MEASUREMENT DINH_nrActvInhReas.FId_BattMngtFailr "Number of active inhibit reasons for the FIds / Number of active inhibit reasons for FId_BattMngtFailr" UWORD DINH_ct_Compu 1 100 -4095.000 4096.000 BIT_MASK 0x1fff FORMAT "%8.3" ECU_ADDRESS 0x6000DB96 /end MEASUREMENT
/begin MEASUREMENT DINH_nrActvInhReas.FId_BattSigPtd "Number of active inhibit reasons for the FIds / Number of active inhibit reasons for FId_BattSigPtd" UWORD DINH_ct_Compu 1 100 -4095.000 4096.000 BIT_MASK 0x1fff FORMAT "%8.3" ECU_ADDRESS 0x6000DB98 /end MEASUREMENT
/begin MEASUREMENT DINH_nrActvInhReas.FId_BattU2MEDSRC "Number of active inhibit reasons for the FIds / Number of active inhibit reasons for FId_BattU2MEDSRC" UWORD DINH_ct_Compu 1 100 -4095.000 4096.000 BIT_MASK 0x1fff FORMAT "%8.3" ECU_ADDRESS 0x6000DB9A /end MEASUREMENT
/begin MEASUREMENT DINH_nrActvInhReas.FId_BattUDrpPrvOff "Number of active inhibit reasons for the FIds / Number of active inhibit reasons for FId_BattUDrpPrvOff" UWORD DINH_ct_Compu 1 100 -4095.000 4096.000 BIT_MASK 0x1fff FORMAT "%8.3" ECU_ADDRESS 0x6000DB9C /end MEASUREMENT
/begin MEASUREMENT DINH_nrActvInhReas.FId_BattUFrzVal "Number of active inhibit reasons for the FIds / Number of active inhibit reasons for FId_BattUFrzVal" UWORD DINH_ct_Compu 1 100 -4095.000 4096.000 BIT_MASK 0x1fff FORMAT "%8.3" ECU_ADDRESS 0x6000DB9E /end MEASUREMENT
/begin MEASUREMENT DINH_nrActvInhReas.FId_BattUHiFailrEna "Number of active inhibit reasons for the FIds / Number of active inhibit reasons for FId_BattUHiFailrEna" UWORD DINH_ct_Compu 1 100 -4095.000 4096.000 BIT_MASK 0x1fff FORMAT "%8.3" ECU_ADDRESS 0x6000DBA0 /end MEASUREMENT
/begin MEASUREMENT DINH_nrActvInhReas.FId_BattUIMGTCUCANFailr "Number of active inhibit reasons for the FIds / Number of active inhibit reasons for FId_BattUIMGTCUCANFailr" UWORD DINH_ct_Compu 1 100 -4095.000 4096.000 BIT_MASK 0x1fff FORMAT "%8.3" ECU_ADDRESS 0x6000DBA2 /end MEASUREMENT
/begin MEASUREMENT DINH_nrActvInhReas.FId_BattULoFailrEna "Number of active inhibit reasons for the FIds / Number of active inhibit reasons for FId_BattULoFailrEna" UWORD DINH_ct_Compu 1 100 -4095.000 4096.000 BIT_MASK 0x1fff FORMAT "%8.3" ECU_ADDRESS 0x6000DBA4 /end MEASUREMENT
/begin MEASUREMENT DINH_nrActvInhReas.FId_BattUReplVal "Number of active inhibit reasons for the FIds / Number of active inhibit reasons for FId_BattUReplVal" UWORD DINH_ct_Compu 1 100 -4095.000 4096.000 BIT_MASK 0x1fff FORMAT "%8.3" ECU_ADDRESS 0x6000DBA6 /end MEASUREMENT
/begin MEASUREMENT DINH_nrActvInhReas.FId_BattUSRC "Number of active inhibit reasons for the FIds / Number of active inhibit reasons for FId_BattUSRC" UWORD DINH_ct_Compu 1 100 -4095.000 4096.000 BIT_MASK 0x1fff FORMAT "%8.3" ECU_ADDRESS 0x6000DBA8 /end MEASUREMENT
/begin MEASUREMENT DINH_nrActvInhReas.FId_BlwrComErr "Number of active inhibit reasons for the FIds / Number of active inhibit reasons for FId_BlwrComErr" UWORD DINH_ct_Compu 1 100 -4095.000 4096.000 BIT_MASK 0x1fff FORMAT "%8.3" ECU_ADDRESS 0x6000DBAA /end MEASUREMENT
/begin MEASUREMENT DINH_nrActvInhReas.FId_BrkBstPDetnInhbn "Number of active inhibit reasons for the FIds / Number of active inhibit reasons for FId_BrkBstPDetnInhbn" UWORD DINH_ct_Compu 1 100 -4095.000 4096.000 BIT_MASK 0x1fff FORMAT "%8.3" ECU_ADDRESS 0x6000DBAC /end MEASUREMENT
/begin MEASUREMENT DINH_nrActvInhReas.FId_BrkBstPMstCylPSnsrFail "Number of active inhibit reasons for the FIds / Number of active inhibit reasons for FId_BrkBstPMstCylPSnsrFail" UWORD DINH_ct_Compu 1 100 -4095.000 4096.000 BIT_MASK 0x1fff FORMAT "%8.3" ECU_ADDRESS 0x6000DBAE /end MEASUREMENT
/begin MEASUREMENT DINH_nrActvInhReas.FId_BrkBstPSnsrStuckDetn "Number of active inhibit reasons for the FIds / Number of active inhibit reasons for FId_BrkBstPSnsrStuckDetn" UWORD DINH_ct_Compu 1 100 -4095.000 4096.000 BIT_MASK 0x1fff FORMAT "%8.3" ECU_ADDRESS 0x6000DBB0 /end MEASUREMENT
/begin MEASUREMENT DINH_nrActvInhReas.FId_BrkMnSwtErr "Number of active inhibit reasons for the FIds / Number of active inhibit reasons for FId_BrkMnSwtErr" UWORD DINH_ct_Compu 1 100 -4095.000 4096.000 BIT_MASK 0x1fff FORMAT "%8.3" ECU_ADDRESS 0x6000DBB2 /end MEASUREMENT
/begin MEASUREMENT DINH_nrActvInhReas.FId_BrkPOilPres "Number of active inhibit reasons for the FIds / Number of active inhibit reasons for FId_BrkPOilPres" UWORD DINH_ct_Compu 1 100 -4095.000 4096.000 BIT_MASK 0x1fff FORMAT "%8.3" ECU_ADDRESS 0x6000DBB4 /end MEASUREMENT
/begin MEASUREMENT DINH_nrActvInhReas.FId_BrkPedEngStopEna "Number of active inhibit reasons for the FIds / Number of active inhibit reasons for FId_BrkPedEngStopEna" UWORD DINH_ct_Compu 1 100 -4095.000 4096.000 BIT_MASK 0x1fff FORMAT "%8.3" ECU_ADDRESS 0x6000DBB6 /end MEASUREMENT
/begin MEASUREMENT DINH_nrActvInhReas.FId_BrkRdntSwtErr "Number of active inhibit reasons for the FIds / Number of active inhibit reasons for FId_BrkRdntSwtErr" UWORD DINH_ct_Compu 1 100 -4095.000 4096.000 BIT_MASK 0x1fff FORMAT "%8.3" ECU_ADDRESS 0x6000DBB8 /end MEASUREMENT
/begin MEASUREMENT DINH_nrActvInhReas.FId_CAGRSDS "Number of active inhibit reasons for the FIds / Number of active inhibit reasons for FId_CAGRSDS" UWORD DINH_ct_Compu 1 100 -4095.000 4096.000 BIT_MASK 0x1fff FORMAT "%8.3" ECU_ADDRESS 0x6000DBBA /end MEASUREMENT
/begin MEASUREMENT DINH_nrActvInhReas.FId_CEngDsTColdStrt "Number of active inhibit reasons for the FIds / Number of active inhibit reasons for FId_CEngDsTColdStrt" UWORD DINH_ct_Compu 1 100 -4095.000 4096.000 BIT_MASK 0x1fff FORMAT "%8.3" ECU_ADDRESS 0x6000DBBC /end MEASUREMENT
/begin MEASUREMENT DINH_nrActvInhReas.FId_CEngDsTColdStrtErr "Number of active inhibit reasons for the FIds / Number of active inhibit reasons for FId_CEngDsTColdStrtErr" UWORD DINH_ct_Compu 1 100 -4095.000 4096.000 BIT_MASK 0x1fff FORMAT "%8.3" ECU_ADDRESS 0x6000DBBE /end MEASUREMENT
/begin MEASUREMENT DINH_nrActvInhReas.FId_CEngDsTLSC "Number of active inhibit reasons for the FIds / Number of active inhibit reasons for FId_CEngDsTLSC" UWORD DINH_ct_Compu 1 100 -4095.000 4096.000 BIT_MASK 0x1fff FORMAT "%8.3" ECU_ADDRESS 0x6000DBC0 /end MEASUREMENT
/begin MEASUREMENT DINH_nrActvInhReas.FId_CEngDsTPlausErr "Number of active inhibit reasons for the FIds / Number of active inhibit reasons for FId_CEngDsTPlausErr" UWORD DINH_ct_Compu 1 100 -4095.000 4096.000 BIT_MASK 0x1fff FORMAT "%8.3" ECU_ADDRESS 0x6000DBC2 /end MEASUREMENT
/begin MEASUREMENT DINH_nrActvInhReas.FId_CEngDsTReplMdlEngStop "Number of active inhibit reasons for the FIds / Number of active inhibit reasons for FId_CEngDsTReplMdlEngStop" UWORD DINH_ct_Compu 1 100 -4095.000 4096.000 BIT_MASK 0x1fff FORMAT "%8.3" ECU_ADDRESS 0x6000DBC4 /end MEASUREMENT
/begin MEASUREMENT DINH_nrActvInhReas.FId_CEngDsTSTC "Number of active inhibit reasons for the FIds / Number of active inhibit reasons for FId_CEngDsTSTC" UWORD DINH_ct_Compu 1 100 -4095.000 4096.000 BIT_MASK 0x1fff FORMAT "%8.3" ECU_ADDRESS 0x6000DBC6 /end MEASUREMENT
/begin MEASUREMENT DINH_nrActvInhReas.FId_CEngDsTSnsrElec "Number of active inhibit reasons for the FIds / Number of active inhibit reasons for FId_CEngDsTSnsrElec" UWORD DINH_ct_Compu 1 100 -4095.000 4096.000 BIT_MASK 0x1fff FORMAT "%8.3" ECU_ADDRESS 0x6000DBC8 /end MEASUREMENT
/begin MEASUREMENT DINH_nrActvInhReas.FId_CEngDsTSwtReplMdl "Number of active inhibit reasons for the FIds / Number of active inhibit reasons for FId_CEngDsTSwtReplMdl" UWORD DINH_ct_Compu 1 100 -4095.000 4096.000 BIT_MASK 0x1fff FORMAT "%8.3" ECU_ADDRESS 0x6000DBCA /end MEASUREMENT
/begin MEASUREMENT DINH_nrActvInhReas.FId_CEngUsTElecErr "Number of active inhibit reasons for the FIds / Number of active inhibit reasons for FId_CEngUsTElecErr" UWORD DINH_ct_Compu 1 100 -4095.000 4096.000 BIT_MASK 0x1fff FORMAT "%8.3" ECU_ADDRESS 0x6000DBCC /end MEASUREMENT
/begin MEASUREMENT DINH_nrActvInhReas.FId_CEngUsTSnsrElecErr "Number of active inhibit reasons for the FIds / Number of active inhibit reasons for FId_CEngUsTSnsrElecErr" UWORD DINH_ct_Compu 1 100 -4095.000 4096.000 BIT_MASK 0x1fff FORMAT "%8.3" ECU_ADDRESS 0x6000DBCE /end MEASUREMENT
/begin MEASUREMENT DINH_nrActvInhReas.FId_CEngUsTSwtReplMdl "Number of active inhibit reasons for the FIds / Number of active inhibit reasons for FId_CEngUsTSwtReplMdl" UWORD DINH_ct_Compu 1 100 -4095.000 4096.000 BIT_MASK 0x1fff FORMAT "%8.3" ECU_ADDRESS 0x6000DBD0 /end MEASUREMENT
/begin MEASUREMENT DINH_nrActvInhReas.FId_CJ135CtlFullAltvS1B1 "Number of active inhibit reasons for the FIds / Number of active inhibit reasons for FId_CJ135CtlFullAltvS1B1" UWORD DINH_ct_Compu 1 100 -4095.000 4096.000 BIT_MASK 0x1fff FORMAT "%8.3" ECU_ADDRESS 0x6000DBD2 /end MEASUREMENT
/begin MEASUREMENT DINH_nrActvInhReas.FId_CJ135CtlIPmpAltvS1B1 "Number of active inhibit reasons for the FIds / Number of active inhibit reasons for FId_CJ135CtlIPmpAltvS1B1" UWORD DINH_ct_Compu 1 100 -4095.000 4096.000 BIT_MASK 0x1fff FORMAT "%8.3" ECU_ADDRESS 0x6000DBD4 /end MEASUREMENT
/begin MEASUREMENT DINH_nrActvInhReas.FId_CJ135CtlIPmpS1B1 "Number of active inhibit reasons for the FIds / Number of active inhibit reasons for FId_CJ135CtlIPmpS1B1" UWORD DINH_ct_Compu 1 100 -4095.000 4096.000 BIT_MASK 0x1fff FORMAT "%8.3" ECU_ADDRESS 0x6000DBD6 /end MEASUREMENT
/begin MEASUREMENT DINH_nrActvInhReas.FId_CJ135CtlRParlTstdS1B1 "Number of active inhibit reasons for the FIds / Number of active inhibit reasons for FId_CJ135CtlRParlTstdS1B1" UWORD DINH_ct_Compu 1 100 -4095.000 4096.000 BIT_MASK 0x1fff FORMAT "%8.3" ECU_ADDRESS 0x6000DBD8 /end MEASUREMENT
/begin MEASUREMENT DINH_nrActvInhReas.FId_CJ135CtlS1B1 "Number of active inhibit reasons for the FIds / Number of active inhibit reasons for FId_CJ135CtlS1B1" UWORD DINH_ct_Compu 1 100 -4095.000 4096.000 BIT_MASK 0x1fff FORMAT "%8.3" ECU_ADDRESS 0x6000DBDA /end MEASUREMENT
/begin MEASUREMENT DINH_nrActvInhReas.FId_CJ135CtlSnsrHotS1B1 "Number of active inhibit reasons for the FIds / Number of active inhibit reasons for FId_CJ135CtlSnsrHotS1B1" UWORD DINH_ct_Compu 1 100 -4095.000 4096.000 BIT_MASK 0x1fff FORMAT "%8.3" ECU_ADDRESS 0x6000DBDC /end MEASUREMENT
/begin MEASUREMENT DINH_nrActvInhReas.FId_CJ135DiagSnsrS1B1 "Number of active inhibit reasons for the FIds / Number of active inhibit reasons for FId_CJ135DiagSnsrS1B1" UWORD DINH_ct_Compu 1 100 -4095.000 4096.000 BIT_MASK 0x1fff FORMAT "%8.3" ECU_ADDRESS 0x6000DBDE /end MEASUREMENT
/begin MEASUREMENT DINH_nrActvInhReas.FId_CJ135IPmpNoBiasS1B1 "Number of active inhibit reasons for the FIds / Number of active inhibit reasons for FId_CJ135IPmpNoBiasS1B1" UWORD DINH_ct_Compu 1 100 -4095.000 4096.000 BIT_MASK 0x1fff FORMAT "%8.3" ECU_ADDRESS 0x6000DBE0 /end MEASUREMENT
/begin MEASUREMENT DINH_nrActvInhReas.FId_CJ135IPmpNoErrS1B1 "Number of active inhibit reasons for the FIds / Number of active inhibit reasons for FId_CJ135IPmpNoErrS1B1" UWORD DINH_ct_Compu 1 100 -4095.000 4096.000 BIT_MASK 0x1fff FORMAT "%8.3" ECU_ADDRESS 0x6000DBE2 /end MEASUREMENT
/begin MEASUREMENT DINH_nrActvInhReas.FId_CMSUDKSOM1 "Number of active inhibit reasons for the FIds / Number of active inhibit reasons for FId_CMSUDKSOM1" UWORD DINH_ct_Compu 1 100 -4095.000 4096.000 BIT_MASK 0x1fff FORMAT "%8.3" ECU_ADDRESS 0x6000DBE4 /end MEASUREMENT
/begin MEASUREMENT DINH_nrActvInhReas.FId_CMSUDKSOM2 "Number of active inhibit reasons for the FIds / Number of active inhibit reasons for FId_CMSUDKSOM2" UWORD DINH_ct_Compu 1 100 -4095.000 4096.000 BIT_MASK 0x1fff FORMAT "%8.3" ECU_ADDRESS 0x6000DBE6 /end MEASUREMENT
/begin MEASUREMENT DINH_nrActvInhReas.FId_CSTRTCTL "Number of active inhibit reasons for the FIds / Number of active inhibit reasons for FId_CSTRTCTL" UWORD DINH_ct_Compu 1 100 -4095.000 4096.000 BIT_MASK 0x1fff FORMAT "%8.3" ECU_ADDRESS 0x6000DBE8 /end MEASUREMENT
/begin MEASUREMENT DINH_nrActvInhReas.FId_Cj135DiagAsicS1B1 "Number of active inhibit reasons for the FIds / Number of active inhibit reasons for FId_Cj135DiagAsicS1B1" UWORD DINH_ct_Compu 1 100 -4095.000 4096.000 BIT_MASK 0x1fff FORMAT "%8.3" ECU_ADDRESS 0x6000DBEA /end MEASUREMENT
/begin MEASUREMENT DINH_nrActvInhReas.FId_Cj135DiagOlEnaNotEnfS1B1 "Number of active inhibit reasons for the FIds / Number of active inhibit reasons for FId_Cj135DiagOlEnaNotEnfS1B1" UWORD DINH_ct_Compu 1 100 -4095.000 4096.000 BIT_MASK 0x1fff FORMAT "%8.3" ECU_ADDRESS 0x6000DBEC /end MEASUREMENT
/begin MEASUREMENT DINH_nrActvInhReas.FId_Cj135DiagOlEnaS1B1 "Number of active inhibit reasons for the FIds / Number of active inhibit reasons for FId_Cj135DiagOlEnaS1B1" UWORD DINH_ct_Compu 1 100 -4095.000 4096.000 BIT_MASK 0x1fff FORMAT "%8.3" ECU_ADDRESS 0x6000DBEE /end MEASUREMENT
/begin MEASUREMENT DINH_nrActvInhReas.FId_Cj135DiagSpiS1B1 "Number of active inhibit reasons for the FIds / Number of active inhibit reasons for FId_Cj135DiagSpiS1B1" UWORD DINH_ct_Compu 1 100 -4095.000 4096.000 BIT_MASK 0x1fff FORMAT "%8.3" ECU_ADDRESS 0x6000DBF0 /end MEASUREMENT
/begin MEASUREMENT DINH_nrActvInhReas.FId_Cj135DiagWireRprtS1B1 "Number of active inhibit reasons for the FIds / Number of active inhibit reasons for FId_Cj135DiagWireRprtS1B1" UWORD DINH_ct_Compu 1 100 -4095.000 4096.000 BIT_MASK 0x1fff FORMAT "%8.3" ECU_ADDRESS 0x6000DBF2 /end MEASUREMENT
/begin MEASUREMENT DINH_nrActvInhReas.FId_Cj135DiagWireS1B1 "Number of active inhibit reasons for the FIds / Number of active inhibit reasons for FId_Cj135DiagWireS1B1" UWORD DINH_ct_Compu 1 100 -4095.000 4096.000 BIT_MASK 0x1fff FORMAT "%8.3" ECU_ADDRESS 0x6000DBF4 /end MEASUREMENT
/begin MEASUREMENT DINH_nrActvInhReas.FId_Cj135Dummy "Number of active inhibit reasons for the FIds / Number of active inhibit reasons for FId_Cj135Dummy" UWORD DINH_ct_Compu 1 100 -4095.000 4096.000 BIT_MASK 0x1fff FORMAT "%8.3" ECU_ADDRESS 0x6000DBF6 /end MEASUREMENT
/begin MEASUREMENT DINH_nrActvInhReas.FId_Cj135PerdDiagOperEnaS1B1 "Number of active inhibit reasons for the FIds / Number of active inhibit reasons for FId_Cj135PerdDiagOperEnaS1B1" UWORD DINH_ct_Compu 1 100 -4095.000 4096.000 BIT_MASK 0x1fff FORMAT "%8.3" ECU_ADDRESS 0x6000DBF8 /end MEASUREMENT
/begin MEASUREMENT DINH_nrActvInhReas.FId_ClntTempENGB "Number of active inhibit reasons for the FIds / Number of active inhibit reasons for FId_ClntTempENGB" UWORD DINH_ct_Compu 1 100 -4095.000 4096.000 BIT_MASK 0x1fff FORMAT "%8.3" ECU_ADDRESS 0x6000DBFA /end MEASUREMENT
/begin MEASUREMENT DINH_nrActvInhReas.FId_Clth "Number of active inhibit reasons for the FIds / Number of active inhibit reasons for FId_Clth" UWORD DINH_ct_Compu 1 100 -4095.000 4096.000 BIT_MASK 0x1fff FORMAT "%8.3" ECU_ADDRESS 0x6000DBFC /end MEASUREMENT
/begin MEASUREMENT DINH_nrActvInhReas.FId_Clth2 "Number of active inhibit reasons for the FIds / Number of active inhibit reasons for FId_Clth2" UWORD DINH_ct_Compu 1 100 -4095.000 4096.000 BIT_MASK 0x1fff FORMAT "%8.3" ECU_ADDRESS 0x6000DBFE /end MEASUREMENT
/begin MEASUREMENT DINH_nrActvInhReas.FId_Clth3StuckOn "Number of active inhibit reasons for the FIds / Number of active inhibit reasons for FId_Clth3StuckOn" UWORD DINH_ct_Compu 1 100 -4095.000 4096.000 BIT_MASK 0x1fff FORMAT "%8.3" ECU_ADDRESS 0x6000DC00 /end MEASUREMENT
/begin MEASUREMENT DINH_nrActvInhReas.FId_Clth4 "Number of active inhibit reasons for the FIds / Number of active inhibit reasons for FId_Clth4" UWORD DINH_ct_Compu 1 100 -4095.000 4096.000 BIT_MASK 0x1fff FORMAT "%8.3" ECU_ADDRESS 0x6000DC02 /end MEASUREMENT
/begin MEASUREMENT DINH_nrActvInhReas.FId_ClthCAN "Number of active inhibit reasons for the FIds / Number of active inhibit reasons for FId_ClthCAN" UWORD DINH_ct_Compu 1 100 -4095.000 4096.000 BIT_MASK 0x1fff FORMAT "%8.3" ECU_ADDRESS 0x6000DC04 /end MEASUREMENT
/begin MEASUREMENT DINH_nrActvInhReas.FId_ClthMax "Number of active inhibit reasons for the FIds / Number of active inhibit reasons for FId_ClthMax" UWORD DINH_ct_Compu 1 100 -4095.000 4096.000 BIT_MASK 0x1fff FORMAT "%8.3" ECU_ADDRESS 0x6000DC06 /end MEASUREMENT
/begin MEASUREMENT DINH_nrActvInhReas.FId_ClthStk "Number of active inhibit reasons for the FIds / Number of active inhibit reasons for FId_ClthStk" UWORD DINH_ct_Compu 1 100 -4095.000 4096.000 BIT_MASK 0x1fff FORMAT "%8.3" ECU_ADDRESS 0x6000DC08 /end MEASUREMENT
/begin MEASUREMENT DINH_nrActvInhReas.FId_ClthStkErr "Number of active inhibit reasons for the FIds / Number of active inhibit reasons for FId_ClthStkErr" UWORD DINH_ct_Compu 1 100 -4095.000 4096.000 BIT_MASK 0x1fff FORMAT "%8.3" ECU_ADDRESS 0x6000DC0A /end MEASUREMENT
/begin MEASUREMENT DINH_nrActvInhReas.FId_ClthStkFailr "Number of active inhibit reasons for the FIds / Number of active inhibit reasons for FId_ClthStkFailr" UWORD DINH_ct_Compu 1 100 -4095.000 4096.000 BIT_MASK 0x1fff FORMAT "%8.3" ECU_ADDRESS 0x6000DC0C /end MEASUREMENT
/begin MEASUREMENT DINH_nrActvInhReas.FId_ClthStkOFFStuck "Number of active inhibit reasons for the FIds / Number of active inhibit reasons for FId_ClthStkOFFStuck" UWORD DINH_ct_Compu 1 100 -4095.000 4096.000 BIT_MASK 0x1fff FORMAT "%8.3" ECU_ADDRESS 0x6000DC0E /end MEASUREMENT
/begin MEASUREMENT DINH_nrActvInhReas.FId_ClthStkONStuck "Number of active inhibit reasons for the FIds / Number of active inhibit reasons for FId_ClthStkONStuck" UWORD DINH_ct_Compu 1 100 -4095.000 4096.000 BIT_MASK 0x1fff FORMAT "%8.3" ECU_ADDRESS 0x6000DC10 /end MEASUREMENT
/begin MEASUREMENT DINH_nrActvInhReas.FId_ClthSwtFailr "Number of active inhibit reasons for the FIds / Number of active inhibit reasons for FId_ClthSwtFailr" UWORD DINH_ct_Compu 1 100 -4095.000 4096.000 BIT_MASK 0x1fff FORMAT "%8.3" ECU_ADDRESS 0x6000DC12 /end MEASUREMENT
/begin MEASUREMENT DINH_nrActvInhReas.FId_CoEOMGdiEomErrLcy "Number of active inhibit reasons for the FIds / Number of active inhibit reasons for FId_CoEOMGdiEomErrLcy" UWORD DINH_ct_Compu 1 100 -4095.000 4096.000 BIT_MASK 0x1fff FORMAT "%8.3" ECU_ADDRESS 0x6000DC14 /end MEASUREMENT
/begin MEASUREMENT DINH_nrActvInhReas.FId_CoETM "Number of active inhibit reasons for the FIds / Number of active inhibit reasons for FId_CoETM" UWORD DINH_ct_Compu 1 100 -4095.000 4096.000 BIT_MASK 0x1fff FORMAT "%8.3" ECU_ADDRESS 0x6000DC16 /end MEASUREMENT
/begin MEASUREMENT DINH_nrActvInhReas.FId_CoETS_StTrqLimErr1 "Number of active inhibit reasons for the FIds / Number of active inhibit reasons for FId_CoETS_StTrqLimErr1" UWORD DINH_ct_Compu 1 100 -4095.000 4096.000 BIT_MASK 0x1fff FORMAT "%8.3" ECU_ADDRESS 0x6000DC18 /end MEASUREMENT
/begin MEASUREMENT DINH_nrActvInhReas.FId_CoETS_StTrqLimErr2 "Number of active inhibit reasons for the FIds / Number of active inhibit reasons for FId_CoETS_StTrqLimErr2" UWORD DINH_ct_Compu 1 100 -4095.000 4096.000 BIT_MASK 0x1fff FORMAT "%8.3" ECU_ADDRESS 0x6000DC1A /end MEASUREMENT
/begin MEASUREMENT DINH_nrActvInhReas.FId_CoEngStopEnblStSpEngT "Number of active inhibit reasons for the FIds / Number of active inhibit reasons for FId_CoEngStopEnblStSpEngT" UWORD DINH_ct_Compu 1 100 -4095.000 4096.000 BIT_MASK 0x1fff FORMAT "%8.3" ECU_ADDRESS 0x6000DC1C /end MEASUREMENT
/begin MEASUREMENT DINH_nrActvInhReas.FId_CoEngStopEnblStSpLSU "Number of active inhibit reasons for the FIds / Number of active inhibit reasons for FId_CoEngStopEnblStSpLSU" UWORD DINH_ct_Compu 1 100 -4095.000 4096.000 BIT_MASK 0x1fff FORMAT "%8.3" ECU_ADDRESS 0x6000DC1E /end MEASUREMENT
/begin MEASUREMENT DINH_nrActvInhReas.FId_CoEngStopEnblStSpTcT "Number of active inhibit reasons for the FIds / Number of active inhibit reasons for FId_CoEngStopEnblStSpTcT" UWORD DINH_ct_Compu 1 100 -4095.000 4096.000 BIT_MASK 0x1fff FORMAT "%8.3" ECU_ADDRESS 0x6000DC20 /end MEASUREMENT
/begin MEASUREMENT DINH_nrActvInhReas.FId_CoEngStopEnblSysErr "Number of active inhibit reasons for the FIds / Number of active inhibit reasons for FId_CoEngStopEnblSysErr" UWORD DINH_ct_Compu 1 100 -4095.000 4096.000 BIT_MASK 0x1fff FORMAT "%8.3" ECU_ADDRESS 0x6000DC22 /end MEASUREMENT
/begin MEASUREMENT DINH_nrActvInhReas.FId_CoEngVlvLftSpIntk "Number of active inhibit reasons for the FIds / Number of active inhibit reasons for FId_CoEngVlvLftSpIntk" UWORD DINH_ct_Compu 1 100 -4095.000 4096.000 BIT_MASK 0x1fff FORMAT "%8.3" ECU_ADDRESS 0x6000DC24 /end MEASUREMENT
/begin MEASUREMENT DINH_nrActvInhReas.FId_CoPOMStrtgDevStrtr "Number of active inhibit reasons for the FIds / Number of active inhibit reasons for FId_CoPOMStrtgDevStrtr" UWORD DINH_ct_Compu 1 100 -4095.000 4096.000 BIT_MASK 0x1fff FORMAT "%8.3" ECU_ADDRESS 0x6000DC26 /end MEASUREMENT
/begin MEASUREMENT DINH_nrActvInhReas.FId_CoPOM_FirstStrtAut "Number of active inhibit reasons for the FIds / Number of active inhibit reasons for FId_CoPOM_FirstStrtAut" UWORD DINH_ct_Compu 1 100 -4095.000 4096.000 BIT_MASK 0x1fff FORMAT "%8.3" ECU_ADDRESS 0x6000DC28 /end MEASUREMENT
/begin MEASUREMENT DINH_nrActvInhReas.FId_CoTS_SwtOff "Number of active inhibit reasons for the FIds / Number of active inhibit reasons for FId_CoTS_SwtOff" UWORD DINH_ct_Compu 1 100 -4095.000 4096.000 BIT_MASK 0x1fff FORMAT "%8.3" ECU_ADDRESS 0x6000DC2A /end MEASUREMENT
/begin MEASUREMENT DINH_nrActvInhReas.FId_CoVOMACCComFailr "Number of active inhibit reasons for the FIds / Number of active inhibit reasons for FId_CoVOMACCComFailr" UWORD DINH_ct_Compu 1 100 -4095.000 4096.000 BIT_MASK 0x1fff FORMAT "%8.3" ECU_ADDRESS 0x6000DC2C /end MEASUREMENT
/begin MEASUREMENT DINH_nrActvInhReas.FId_CoVOMBrkPedISABSigFailr "Number of active inhibit reasons for the FIds / Number of active inhibit reasons for FId_CoVOMBrkPedISABSigFailr" UWORD DINH_ct_Compu 1 100 -4095.000 4096.000 BIT_MASK 0x1fff FORMAT "%8.3" ECU_ADDRESS 0x6000DC2E /end MEASUREMENT
/begin MEASUREMENT DINH_nrActvInhReas.FId_CoVOMEngCrkAbort "Number of active inhibit reasons for the FIds / Number of active inhibit reasons for FId_CoVOMEngCrkAbort" UWORD DINH_ct_Compu 1 100 -4095.000 4096.000 BIT_MASK 0x1fff FORMAT "%8.3" ECU_ADDRESS 0x6000DC30 /end MEASUREMENT
/begin MEASUREMENT DINH_nrActvInhReas.FId_CoVOMEngRstrtEnaCdn "Number of active inhibit reasons for the FIds / Number of active inhibit reasons for FId_CoVOMEngRstrtEnaCdn" UWORD DINH_ct_Compu 1 100 -4095.000 4096.000 BIT_MASK 0x1fff FORMAT "%8.3" ECU_ADDRESS 0x6000DC32 /end MEASUREMENT
/begin MEASUREMENT DINH_nrActvInhReas.FId_CoVOMISSEng "Number of active inhibit reasons for the FIds / Number of active inhibit reasons for FId_CoVOMISSEng" UWORD DINH_ct_Compu 1 100 -4095.000 4096.000 BIT_MASK 0x1fff FORMAT "%8.3" ECU_ADDRESS 0x6000DC34 /end MEASUREMENT
/begin MEASUREMENT DINH_nrActvInhReas.FId_ComACRly "Number of active inhibit reasons for the FIds / Number of active inhibit reasons for FId_ComACRly" UWORD DINH_ct_Compu 1 100 -4095.000 4096.000 BIT_MASK 0x1fff FORMAT "%8.3" ECU_ADDRESS 0x6000DC36 /end MEASUREMENT
/begin MEASUREMENT DINH_nrActvInhReas.FId_ComAPPSensFail "Number of active inhibit reasons for the FIds / Number of active inhibit reasons for FId_ComAPPSensFail" UWORD DINH_ct_Compu 1 100 -4095.000 4096.000 BIT_MASK 0x1fff FORMAT "%8.3" ECU_ADDRESS 0x6000DC38 /end MEASUREMENT
/begin MEASUREMENT DINH_nrActvInhReas.FId_ComAPedl "Number of active inhibit reasons for the FIds / Number of active inhibit reasons for FId_ComAPedl" UWORD DINH_ct_Compu 1 100 -4095.000 4096.000 BIT_MASK 0x1fff FORMAT "%8.3" ECU_ADDRESS 0x6000DC3A /end MEASUREMENT
/begin MEASUREMENT DINH_nrActvInhReas.FId_ComAYCA "Number of active inhibit reasons for the FIds / Number of active inhibit reasons for FId_ComAYCA" UWORD DINH_ct_Compu 1 100 -4095.000 4096.000 BIT_MASK 0x1fff FORMAT "%8.3" ECU_ADDRESS 0x6000DC3C /end MEASUREMENT
/begin MEASUREMENT DINH_nrActvInhReas.FId_ComAYCAMon "Number of active inhibit reasons for the FIds / Number of active inhibit reasons for FId_ComAYCAMon" UWORD DINH_ct_Compu 1 100 -4095.000 4096.000 BIT_MASK 0x1fff FORMAT "%8.3" ECU_ADDRESS 0x6000DC3E /end MEASUREMENT
/begin MEASUREMENT DINH_nrActvInhReas.FId_ComAYCD "Number of active inhibit reasons for the FIds / Number of active inhibit reasons for FId_ComAYCD" UWORD DINH_ct_Compu 1 100 -4095.000 4096.000 BIT_MASK 0x1fff FORMAT "%8.3" ECU_ADDRESS 0x6000DC40 /end MEASUREMENT
/begin MEASUREMENT DINH_nrActvInhReas.FId_ComAYCDMon "Number of active inhibit reasons for the FIds / Number of active inhibit reasons for FId_ComAYCDMon" UWORD DINH_ct_Compu 1 100 -4095.000 4096.000 BIT_MASK 0x1fff FORMAT "%8.3" ECU_ADDRESS 0x6000DC42 /end MEASUREMENT
/begin MEASUREMENT DINH_nrActvInhReas.FId_ComAYCF "Number of active inhibit reasons for the FIds / Number of active inhibit reasons for FId_ComAYCF" UWORD DINH_ct_Compu 1 100 -4095.000 4096.000 BIT_MASK 0x1fff FORMAT "%8.3" ECU_ADDRESS 0x6000DC44 /end MEASUREMENT
/begin MEASUREMENT DINH_nrActvInhReas.FId_ComAYCFMon "Number of active inhibit reasons for the FIds / Number of active inhibit reasons for FId_ComAYCFMon" UWORD DINH_ct_Compu 1 100 -4095.000 4096.000 BIT_MASK 0x1fff FORMAT "%8.3" ECU_ADDRESS 0x6000DC46 /end MEASUREMENT
/begin MEASUREMENT DINH_nrActvInhReas.FId_ComAYCG "Number of active inhibit reasons for the FIds / Number of active inhibit reasons for FId_ComAYCG" UWORD DINH_ct_Compu 1 100 -4095.000 4096.000 BIT_MASK 0x1fff FORMAT "%8.3" ECU_ADDRESS 0x6000DC48 /end MEASUREMENT
/begin MEASUREMENT DINH_nrActvInhReas.FId_ComAYCGMon "Number of active inhibit reasons for the FIds / Number of active inhibit reasons for FId_ComAYCGMon" UWORD DINH_ct_Compu 1 100 -4095.000 4096.000 BIT_MASK 0x1fff FORMAT "%8.3" ECU_ADDRESS 0x6000DC4A /end MEASUREMENT
/begin MEASUREMENT DINH_nrActvInhReas.FId_ComAYCI "Number of active inhibit reasons for the FIds / Number of active inhibit reasons for FId_ComAYCI" UWORD DINH_ct_Compu 1 100 -4095.000 4096.000 BIT_MASK 0x1fff FORMAT "%8.3" ECU_ADDRESS 0x6000DC4C /end MEASUREMENT
/begin MEASUREMENT DINH_nrActvInhReas.FId_ComAYCIMon "Number of active inhibit reasons for the FIds / Number of active inhibit reasons for FId_ComAYCIMon" UWORD DINH_ct_Compu 1 100 -4095.000 4096.000 BIT_MASK 0x1fff FORMAT "%8.3" ECU_ADDRESS 0x6000DC4E /end MEASUREMENT
/begin MEASUREMENT DINH_nrActvInhReas.FId_ComAirPThrUsSnsrErr "Number of active inhibit reasons for the FIds / Number of active inhibit reasons for FId_ComAirPThrUsSnsrErr" UWORD DINH_ct_Compu 1 100 -4095.000 4096.000 BIT_MASK 0x1fff FORMAT "%8.3" ECU_ADDRESS 0x6000DC50 /end MEASUREMENT
/begin MEASUREMENT DINH_nrActvInhReas.FId_ComAltFail "Number of active inhibit reasons for the FIds / Number of active inhibit reasons for FId_ComAltFail" UWORD DINH_ct_Compu 1 100 -4095.000 4096.000 BIT_MASK 0x1fff FORMAT "%8.3" ECU_ADDRESS 0x6000DC52 /end MEASUREMENT
/begin MEASUREMENT DINH_nrActvInhReas.FId_ComAppVehSnsrFailr "Number of active inhibit reasons for the FIds / Number of active inhibit reasons for FId_ComAppVehSnsrFailr" UWORD DINH_ct_Compu 1 100 -4095.000 4096.000 BIT_MASK 0x1fff FORMAT "%8.3" ECU_ADDRESS 0x6000DC54 /end MEASUREMENT
/begin MEASUREMENT DINH_nrActvInhReas.FId_ComBCM1 "Number of active inhibit reasons for the FIds / Number of active inhibit reasons for FId_ComBCM1" UWORD DINH_ct_Compu 1 100 -4095.000 4096.000 BIT_MASK 0x1fff FORMAT "%8.3" ECU_ADDRESS 0x6000DC56 /end MEASUREMENT
/begin MEASUREMENT DINH_nrActvInhReas.FId_ComBCM1Mon "Number of active inhibit reasons for the FIds / Number of active inhibit reasons for FId_ComBCM1Mon" UWORD DINH_ct_Compu 1 100 -4095.000 4096.000 BIT_MASK 0x1fff FORMAT "%8.3" ECU_ADDRESS 0x6000DC58 /end MEASUREMENT
/begin MEASUREMENT DINH_nrActvInhReas.FId_ComBstCtrl "Number of active inhibit reasons for the FIds / Number of active inhibit reasons for FId_ComBstCtrl" UWORD DINH_ct_Compu 1 100 -4095.000 4096.000 BIT_MASK 0x1fff FORMAT "%8.3" ECU_ADDRESS 0x6000DC5A /end MEASUREMENT
/begin MEASUREMENT DINH_nrActvInhReas.FId_ComCANVEHICLEBusOff "Number of active inhibit reasons for the FIds / Number of active inhibit reasons for FId_ComCANVEHICLEBusOff" UWORD DINH_ct_Compu 1 100 -4095.000 4096.000 BIT_MASK 0x1fff FORMAT "%8.3" ECU_ADDRESS 0x6000DC5C /end MEASUREMENT
/begin MEASUREMENT DINH_nrActvInhReas.FId_ComCGW1 "Number of active inhibit reasons for the FIds / Number of active inhibit reasons for FId_ComCGW1" UWORD DINH_ct_Compu 1 100 -4095.000 4096.000 BIT_MASK 0x1fff FORMAT "%8.3" ECU_ADDRESS 0x6000DC5E /end MEASUREMENT
/begin MEASUREMENT DINH_nrActvInhReas.FId_ComCGW1Mon "Number of active inhibit reasons for the FIds / Number of active inhibit reasons for FId_ComCGW1Mon" UWORD DINH_ct_Compu 1 100 -4095.000 4096.000 BIT_MASK 0x1fff FORMAT "%8.3" ECU_ADDRESS 0x6000DC60 /end MEASUREMENT
/begin MEASUREMENT DINH_nrActvInhReas.FId_ComClthSt "Number of active inhibit reasons for the FIds / Number of active inhibit reasons for FId_ComClthSt" UWORD DINH_ct_Compu 1 100 -4095.000 4096.000 BIT_MASK 0x1fff FORMAT "%8.3" ECU_ADDRESS 0x6000DC62 /end MEASUREMENT
/begin MEASUREMENT DINH_nrActvInhReas.FId_ComConvClth "Number of active inhibit reasons for the FIds / Number of active inhibit reasons for FId_ComConvClth" UWORD DINH_ct_Compu 1 100 -4095.000 4096.000 BIT_MASK 0x1fff FORMAT "%8.3" ECU_ADDRESS 0x6000DC64 /end MEASUREMENT
/begin MEASUREMENT DINH_nrActvInhReas.FId_ComCrCtlReq "Number of active inhibit reasons for the FIds / Number of active inhibit reasons for FId_ComCrCtlReq" UWORD DINH_ct_Compu 1 100 -4095.000 4096.000 BIT_MASK 0x1fff FORMAT "%8.3" ECU_ADDRESS 0x6000DC66 /end MEASUREMENT
/begin MEASUREMENT DINH_nrActvInhReas.FId_ComCrsMaiIndcnLampReq "Number of active inhibit reasons for the FIds / Number of active inhibit reasons for FId_ComCrsMaiIndcnLampReq" UWORD DINH_ct_Compu 1 100 -4095.000 4096.000 BIT_MASK 0x1fff FORMAT "%8.3" ECU_ADDRESS 0x6000DC68 /end MEASUREMENT
/begin MEASUREMENT DINH_nrActvInhReas.FId_ComCrsSetIndcnLampReq "Number of active inhibit reasons for the FIds / Number of active inhibit reasons for FId_ComCrsSetIndcnLampReq" UWORD DINH_ct_Compu 1 100 -4095.000 4096.000 BIT_MASK 0x1fff FORMAT "%8.3" ECU_ADDRESS 0x6000DC6A /end MEASUREMENT
/begin MEASUREMENT DINH_nrActvInhReas.FId_ComDCDCCdn "Number of active inhibit reasons for the FIds / Number of active inhibit reasons for FId_ComDCDCCdn" UWORD DINH_ct_Compu 1 100 -4095.000 4096.000 BIT_MASK 0x1fff FORMAT "%8.3" ECU_ADDRESS 0x6000DC6C /end MEASUREMENT
/begin MEASUREMENT DINH_nrActvInhReas.FId_ComDesGearCurr "Number of active inhibit reasons for the FIds / Number of active inhibit reasons for FId_ComDesGearCurr" UWORD DINH_ct_Compu 1 100 -4095.000 4096.000 BIT_MASK 0x1fff FORMAT "%8.3" ECU_ADDRESS 0x6000DC6E /end MEASUREMENT
/begin MEASUREMENT DINH_nrActvInhReas.FId_ComDetrmAirM "Number of active inhibit reasons for the FIds / Number of active inhibit reasons for FId_ComDetrmAirM" UWORD DINH_ct_Compu 1 100 -4095.000 4096.000 BIT_MASK 0x1fff FORMAT "%8.3" ECU_ADDRESS 0x6000DC70 /end MEASUREMENT
/begin MEASUREMENT DINH_nrActvInhReas.FId_ComDwnShiftCtrlReq "Number of active inhibit reasons for the FIds / Number of active inhibit reasons for FId_ComDwnShiftCtrlReq" UWORD DINH_ct_Compu 1 100 -4095.000 4096.000 BIT_MASK 0x1fff FORMAT "%8.3" ECU_ADDRESS 0x6000DC72 /end MEASUREMENT
/begin MEASUREMENT DINH_nrActvInhReas.FId_ComEAT1 "Number of active inhibit reasons for the FIds / Number of active inhibit reasons for FId_ComEAT1" UWORD DINH_ct_Compu 1 100 -4095.000 4096.000 BIT_MASK 0x1fff FORMAT "%8.3" ECU_ADDRESS 0x6000DC74 /end MEASUREMENT
/begin MEASUREMENT DINH_nrActvInhReas.FId_ComEAT10 "Number of active inhibit reasons for the FIds / Number of active inhibit reasons for FId_ComEAT10" UWORD DINH_ct_Compu 1 100 -4095.000 4096.000 BIT_MASK 0x1fff FORMAT "%8.3" ECU_ADDRESS 0x6000DC76 /end MEASUREMENT
/begin MEASUREMENT DINH_nrActvInhReas.FId_ComEAT10Mon "Number of active inhibit reasons for the FIds / Number of active inhibit reasons for FId_ComEAT10Mon" UWORD DINH_ct_Compu 1 100 -4095.000 4096.000 BIT_MASK 0x1fff FORMAT "%8.3" ECU_ADDRESS 0x6000DC78 /end MEASUREMENT
/begin MEASUREMENT DINH_nrActvInhReas.FId_ComEAT11 "Number of active inhibit reasons for the FIds / Number of active inhibit reasons for FId_ComEAT11" UWORD DINH_ct_Compu 1 100 -4095.000 4096.000 BIT_MASK 0x1fff FORMAT "%8.3" ECU_ADDRESS 0x6000DC7A /end MEASUREMENT
/begin MEASUREMENT DINH_nrActvInhReas.FId_ComEAT11Mon "Number of active inhibit reasons for the FIds / Number of active inhibit reasons for FId_ComEAT11Mon" UWORD DINH_ct_Compu 1 100 -4095.000 4096.000 BIT_MASK 0x1fff FORMAT "%8.3" ECU_ADDRESS 0x6000DC7C /end MEASUREMENT
/begin MEASUREMENT DINH_nrActvInhReas.FId_ComEAT12 "Number of active inhibit reasons for the FIds / Number of active inhibit reasons for FId_ComEAT12" UWORD DINH_ct_Compu 1 100 -4095.000 4096.000 BIT_MASK 0x1fff FORMAT "%8.3" ECU_ADDRESS 0x6000DC7E /end MEASUREMENT
/begin MEASUREMENT DINH_nrActvInhReas.FId_ComEAT12Mon "Number of active inhibit reasons for the FIds / Number of active inhibit reasons for FId_ComEAT12Mon" UWORD DINH_ct_Compu 1 100 -4095.000 4096.000 BIT_MASK 0x1fff FORMAT "%8.3" ECU_ADDRESS 0x6000DC80 /end MEASUREMENT
/begin MEASUREMENT DINH_nrActvInhReas.FId_ComEAT13 "Number of active inhibit reasons for the FIds / Number of active inhibit reasons for FId_ComEAT13" UWORD DINH_ct_Compu 1 100 -4095.000 4096.000 BIT_MASK 0x1fff FORMAT "%8.3" ECU_ADDRESS 0x6000DC82 /end MEASUREMENT
/begin MEASUREMENT DINH_nrActvInhReas.FId_ComEAT13Mon "Number of active inhibit reasons for the FIds / Number of active inhibit reasons for FId_ComEAT13Mon" UWORD DINH_ct_Compu 1 100 -4095.000 4096.000 BIT_MASK 0x1fff FORMAT "%8.3" ECU_ADDRESS 0x6000DC84 /end MEASUREMENT
/begin MEASUREMENT DINH_nrActvInhReas.FId_ComEAT1Mon "Number of active inhibit reasons for the FIds / Number of active inhibit reasons for FId_ComEAT1Mon" UWORD DINH_ct_Compu 1 100 -4095.000 4096.000 BIT_MASK 0x1fff FORMAT "%8.3" ECU_ADDRESS 0x6000DC86 /end MEASUREMENT
/begin MEASUREMENT DINH_nrActvInhReas.FId_ComEAT2 "Number of active inhibit reasons for the FIds / Number of active inhibit reasons for FId_ComEAT2" UWORD DINH_ct_Compu 1 100 -4095.000 4096.000 BIT_MASK 0x1fff FORMAT "%8.3" ECU_ADDRESS 0x6000DC88 /end MEASUREMENT
/begin MEASUREMENT DINH_nrActvInhReas.FId_ComEAT2Mon "Number of active inhibit reasons for the FIds / Number of active inhibit reasons for FId_ComEAT2Mon" UWORD DINH_ct_Compu 1 100 -4095.000 4096.000 BIT_MASK 0x1fff FORMAT "%8.3" ECU_ADDRESS 0x6000DC8A /end MEASUREMENT
/begin MEASUREMENT DINH_nrActvInhReas.FId_ComEAT4 "Number of active inhibit reasons for the FIds / Number of active inhibit reasons for FId_ComEAT4" UWORD DINH_ct_Compu 1 100 -4095.000 4096.000 BIT_MASK 0x1fff FORMAT "%8.3" ECU_ADDRESS 0x6000DC8C /end MEASUREMENT
/begin MEASUREMENT DINH_nrActvInhReas.FId_ComEAT4Mon "Number of active inhibit reasons for the FIds / Number of active inhibit reasons for FId_ComEAT4Mon" UWORD DINH_ct_Compu 1 100 -4095.000 4096.000 BIT_MASK 0x1fff FORMAT "%8.3" ECU_ADDRESS 0x6000DC8E /end MEASUREMENT
/begin MEASUREMENT DINH_nrActvInhReas.FId_ComEAT6 "Number of active inhibit reasons for the FIds / Number of active inhibit reasons for FId_ComEAT6" UWORD DINH_ct_Compu 1 100 -4095.000 4096.000 BIT_MASK 0x1fff FORMAT "%8.3" ECU_ADDRESS 0x6000DC90 /end MEASUREMENT
/begin MEASUREMENT DINH_nrActvInhReas.FId_ComEAT6Mon "Number of active inhibit reasons for the FIds / Number of active inhibit reasons for FId_ComEAT6Mon" UWORD DINH_ct_Compu 1 100 -4095.000 4096.000 BIT_MASK 0x1fff FORMAT "%8.3" ECU_ADDRESS 0x6000DC92 /end MEASUREMENT
/begin MEASUREMENT DINH_nrActvInhReas.FId_ComEAT7 "Number of active inhibit reasons for the FIds / Number of active inhibit reasons for FId_ComEAT7" UWORD DINH_ct_Compu 1 100 -4095.000 4096.000 BIT_MASK 0x1fff FORMAT "%8.3" ECU_ADDRESS 0x6000DC94 /end MEASUREMENT
/begin MEASUREMENT DINH_nrActvInhReas.FId_ComEAT7Mon "Number of active inhibit reasons for the FIds / Number of active inhibit reasons for FId_ComEAT7Mon" UWORD DINH_ct_Compu 1 100 -4095.000 4096.000 BIT_MASK 0x1fff FORMAT "%8.3" ECU_ADDRESS 0x6000DC96 /end MEASUREMENT
/begin MEASUREMENT DINH_nrActvInhReas.FId_ComEAT8 "Number of active inhibit reasons for the FIds / Number of active inhibit reasons for FId_ComEAT8" UWORD DINH_ct_Compu 1 100 -4095.000 4096.000 BIT_MASK 0x1fff FORMAT "%8.3" ECU_ADDRESS 0x6000DC98 /end MEASUREMENT
/begin MEASUREMENT DINH_nrActvInhReas.FId_ComEAT8Mon "Number of active inhibit reasons for the FIds / Number of active inhibit reasons for FId_ComEAT8Mon" UWORD DINH_ct_Compu 1 100 -4095.000 4096.000 BIT_MASK 0x1fff FORMAT "%8.3" ECU_ADDRESS 0x6000DC9A /end MEASUREMENT
/begin MEASUREMENT DINH_nrActvInhReas.FId_ComEATA "Number of active inhibit reasons for the FIds / Number of active inhibit reasons for FId_ComEATA" UWORD DINH_ct_Compu 1 100 -4095.000 4096.000 BIT_MASK 0x1fff FORMAT "%8.3" ECU_ADDRESS 0x6000DC9C /end MEASUREMENT
/begin MEASUREMENT DINH_nrActvInhReas.FId_ComEATAMon "Number of active inhibit reasons for the FIds / Number of active inhibit reasons for FId_ComEATAMon" UWORD DINH_ct_Compu 1 100 -4095.000 4096.000 BIT_MASK 0x1fff FORMAT "%8.3" ECU_ADDRESS 0x6000DC9E /end MEASUREMENT
/begin MEASUREMENT DINH_nrActvInhReas.FId_ComEATB "Number of active inhibit reasons for the FIds / Number of active inhibit reasons for FId_ComEATB" UWORD DINH_ct_Compu 1 100 -4095.000 4096.000 BIT_MASK 0x1fff FORMAT "%8.3" ECU_ADDRESS 0x6000DCA0 /end MEASUREMENT
/begin MEASUREMENT DINH_nrActvInhReas.FId_ComEATBMon "Number of active inhibit reasons for the FIds / Number of active inhibit reasons for FId_ComEATBMon" UWORD DINH_ct_Compu 1 100 -4095.000 4096.000 BIT_MASK 0x1fff FORMAT "%8.3" ECU_ADDRESS 0x6000DCA2 /end MEASUREMENT
/begin MEASUREMENT DINH_nrActvInhReas.FId_ComEATC "Number of active inhibit reasons for the FIds / Number of active inhibit reasons for FId_ComEATC" UWORD DINH_ct_Compu 1 100 -4095.000 4096.000 BIT_MASK 0x1fff FORMAT "%8.3" ECU_ADDRESS 0x6000DCA4 /end MEASUREMENT
/begin MEASUREMENT DINH_nrActvInhReas.FId_ComEATCMon "Number of active inhibit reasons for the FIds / Number of active inhibit reasons for FId_ComEATCMon" UWORD DINH_ct_Compu 1 100 -4095.000 4096.000 BIT_MASK 0x1fff FORMAT "%8.3" ECU_ADDRESS 0x6000DCA6 /end MEASUREMENT
/begin MEASUREMENT DINH_nrActvInhReas.FId_ComEBBA "Number of active inhibit reasons for the FIds / Number of active inhibit reasons for FId_ComEBBA" UWORD DINH_ct_Compu 1 100 -4095.000 4096.000 BIT_MASK 0x1fff FORMAT "%8.3" ECU_ADDRESS 0x6000DCA8 /end MEASUREMENT
/begin MEASUREMENT DINH_nrActvInhReas.FId_ComEBBAMon "Number of active inhibit reasons for the FIds / Number of active inhibit reasons for FId_ComEBBAMon" UWORD DINH_ct_Compu 1 100 -4095.000 4096.000 BIT_MASK 0x1fff FORMAT "%8.3" ECU_ADDRESS 0x6000DCAA /end MEASUREMENT
/begin MEASUREMENT DINH_nrActvInhReas.FId_ComECUHwErr "Number of active inhibit reasons for the FIds / Number of active inhibit reasons for FId_ComECUHwErr" UWORD DINH_ct_Compu 1 100 -4095.000 4096.000 BIT_MASK 0x1fff FORMAT "%8.3" ECU_ADDRESS 0x6000DCAC /end MEASUREMENT
/begin MEASUREMENT DINH_nrActvInhReas.FId_ComEMSIntAirTemp "Number of active inhibit reasons for the FIds / Number of active inhibit reasons for FId_ComEMSIntAirTemp" UWORD DINH_ct_Compu 1 100 -4095.000 4096.000 BIT_MASK 0x1fff FORMAT "%8.3" ECU_ADDRESS 0x6000DCAE /end MEASUREMENT
/begin MEASUREMENT DINH_nrActvInhReas.FId_ComEPS1 "Number of active inhibit reasons for the FIds / Number of active inhibit reasons for FId_ComEPS1" UWORD DINH_ct_Compu 1 100 -4095.000 4096.000 BIT_MASK 0x1fff FORMAT "%8.3" ECU_ADDRESS 0x6000DCB0 /end MEASUREMENT
/begin MEASUREMENT DINH_nrActvInhReas.FId_ComEPS1Mon "Number of active inhibit reasons for the FIds / Number of active inhibit reasons for FId_ComEPS1Mon" UWORD DINH_ct_Compu 1 100 -4095.000 4096.000 BIT_MASK 0x1fff FORMAT "%8.3" ECU_ADDRESS 0x6000DCB2 /end MEASUREMENT
/begin MEASUREMENT DINH_nrActvInhReas.FId_ComEngBrkOvrdInfo "Number of active inhibit reasons for the FIds / Number of active inhibit reasons for FId_ComEngBrkOvrdInfo" UWORD DINH_ct_Compu 1 100 -4095.000 4096.000 BIT_MASK 0x1fff FORMAT "%8.3" ECU_ADDRESS 0x6000DCB4 /end MEASUREMENT
/begin MEASUREMENT DINH_nrActvInhReas.FId_ComEngBrkOvrdMtr "Number of active inhibit reasons for the FIds / Number of active inhibit reasons for FId_ComEngBrkOvrdMtr" UWORD DINH_ct_Compu 1 100 -4095.000 4096.000 BIT_MASK 0x1fff FORMAT "%8.3" ECU_ADDRESS 0x6000DCB6 /end MEASUREMENT
/begin MEASUREMENT DINH_nrActvInhReas.FId_ComEngBrkSwErr "Number of active inhibit reasons for the FIds / Number of active inhibit reasons for FId_ComEngBrkSwErr" UWORD DINH_ct_Compu 1 100 -4095.000 4096.000 BIT_MASK 0x1fff FORMAT "%8.3" ECU_ADDRESS 0x6000DCB8 /end MEASUREMENT
/begin MEASUREMENT DINH_nrActvInhReas.FId_ComEngPosng "Number of active inhibit reasons for the FIds / Number of active inhibit reasons for FId_ComEngPosng" UWORD DINH_ct_Compu 1 100 -4095.000 4096.000 BIT_MASK 0x1fff FORMAT "%8.3" ECU_ADDRESS 0x6000DCBA /end MEASUREMENT
/begin MEASUREMENT DINH_nrActvInhReas.FId_ComEngRPMLim "Number of active inhibit reasons for the FIds / Number of active inhibit reasons for FId_ComEngRPMLim" UWORD DINH_ct_Compu 1 100 -4095.000 4096.000 BIT_MASK 0x1fff FORMAT "%8.3" ECU_ADDRESS 0x6000DCBC /end MEASUREMENT
/begin MEASUREMENT DINH_nrActvInhReas.FId_ComEngTrqLim "Number of active inhibit reasons for the FIds / Number of active inhibit reasons for FId_ComEngTrqLim" UWORD DINH_ct_Compu 1 100 -4095.000 4096.000 BIT_MASK 0x1fff FORMAT "%8.3" ECU_ADDRESS 0x6000DCBE /end MEASUREMENT
/begin MEASUREMENT DINH_nrActvInhReas.FId_ComEnvtlAirPSnsrErr "Number of active inhibit reasons for the FIds / Number of active inhibit reasons for FId_ComEnvtlAirPSnsrErr" UWORD DINH_ct_Compu 1 100 -4095.000 4096.000 BIT_MASK 0x1fff FORMAT "%8.3" ECU_ADDRESS 0x6000DCC0 /end MEASUREMENT
/begin MEASUREMENT DINH_nrActvInhReas.FId_ComEstmTqNormJdg "Number of active inhibit reasons for the FIds / Number of active inhibit reasons for FId_ComEstmTqNormJdg" UWORD DINH_ct_Compu 1 100 -4095.000 4096.000 BIT_MASK 0x1fff FORMAT "%8.3" ECU_ADDRESS 0x6000DCC2 /end MEASUREMENT
/begin MEASUREMENT DINH_nrActvInhReas.FId_ComEthnlSErr "Number of active inhibit reasons for the FIds / Number of active inhibit reasons for FId_ComEthnlSErr" UWORD DINH_ct_Compu 1 100 -4095.000 4096.000 BIT_MASK 0x1fff FORMAT "%8.3" ECU_ADDRESS 0x6000DCC4 /end MEASUREMENT
/begin MEASUREMENT DINH_nrActvInhReas.FId_ComEwpErr "Number of active inhibit reasons for the FIds / Number of active inhibit reasons for FId_ComEwpErr" UWORD DINH_ct_Compu 1 100 -4095.000 4096.000 BIT_MASK 0x1fff FORMAT "%8.3" ECU_ADDRESS 0x6000DCC6 /end MEASUREMENT
/begin MEASUREMENT DINH_nrActvInhReas.FId_ComFlSply "Number of active inhibit reasons for the FIds / Number of active inhibit reasons for FId_ComFlSply" UWORD DINH_ct_Compu 1 100 -4095.000 4096.000 BIT_MASK 0x1fff FORMAT "%8.3" ECU_ADDRESS 0x6000DCC8 /end MEASUREMENT
/begin MEASUREMENT DINH_nrActvInhReas.FId_ComFuCnsBitDurgIdleStop "Number of active inhibit reasons for the FIds / Number of active inhibit reasons for FId_ComFuCnsBitDurgIdleStop" UWORD DINH_ct_Compu 1 100 -4095.000 4096.000 BIT_MASK 0x1fff FORMAT "%8.3" ECU_ADDRESS 0x6000DCCA /end MEASUREMENT
/begin MEASUREMENT DINH_nrActvInhReas.FId_ComGEVCntrl "Number of active inhibit reasons for the FIds / Number of active inhibit reasons for FId_ComGEVCntrl" UWORD DINH_ct_Compu 1 100 -4095.000 4096.000 BIT_MASK 0x1fff FORMAT "%8.3" ECU_ADDRESS 0x6000DCCC /end MEASUREMENT
/begin MEASUREMENT DINH_nrActvInhReas.FId_ComGbxNPosFail "Number of active inhibit reasons for the FIds / Number of active inhibit reasons for FId_ComGbxNPosFail" UWORD DINH_ct_Compu 1 100 -4095.000 4096.000 BIT_MASK 0x1fff FORMAT "%8.3" ECU_ADDRESS 0x6000DCCE /end MEASUREMENT
/begin MEASUREMENT DINH_nrActvInhReas.FId_ComGbxTemp "Number of active inhibit reasons for the FIds / Number of active inhibit reasons for FId_ComGbxTemp" UWORD DINH_ct_Compu 1 100 -4095.000 4096.000 BIT_MASK 0x1fff FORMAT "%8.3" ECU_ADDRESS 0x6000DCD0 /end MEASUREMENT
/begin MEASUREMENT DINH_nrActvInhReas.FId_ComGwIMG1 "Number of active inhibit reasons for the FIds / Number of active inhibit reasons for FId_ComGwIMG1" UWORD DINH_ct_Compu 1 100 -4095.000 4096.000 BIT_MASK 0x1fff FORMAT "%8.3" ECU_ADDRESS 0x6000DCD2 /end MEASUREMENT
/begin MEASUREMENT DINH_nrActvInhReas.FId_ComGwIMG1Mon "Number of active inhibit reasons for the FIds / Number of active inhibit reasons for FId_ComGwIMG1Mon" UWORD DINH_ct_Compu 1 100 -4095.000 4096.000 BIT_MASK 0x1fff FORMAT "%8.3" ECU_ADDRESS 0x6000DCD4 /end MEASUREMENT
/begin MEASUREMENT DINH_nrActvInhReas.FId_ComGwIMG3 "Number of active inhibit reasons for the FIds / Number of active inhibit reasons for FId_ComGwIMG3" UWORD DINH_ct_Compu 1 100 -4095.000 4096.000 BIT_MASK 0x1fff FORMAT "%8.3" ECU_ADDRESS 0x6000DCD6 /end MEASUREMENT
/begin MEASUREMENT DINH_nrActvInhReas.FId_ComGwIMG3Mon "Number of active inhibit reasons for the FIds / Number of active inhibit reasons for FId_ComGwIMG3Mon" UWORD DINH_ct_Compu 1 100 -4095.000 4096.000 BIT_MASK 0x1fff FORMAT "%8.3" ECU_ADDRESS 0x6000DCD8 /end MEASUREMENT
/begin MEASUREMENT DINH_nrActvInhReas.FId_ComGwIMG4 "Number of active inhibit reasons for the FIds / Number of active inhibit reasons for FId_ComGwIMG4" UWORD DINH_ct_Compu 1 100 -4095.000 4096.000 BIT_MASK 0x1fff FORMAT "%8.3" ECU_ADDRESS 0x6000DCDA /end MEASUREMENT
/begin MEASUREMENT DINH_nrActvInhReas.FId_ComGwIMG4Mon "Number of active inhibit reasons for the FIds / Number of active inhibit reasons for FId_ComGwIMG4Mon" UWORD DINH_ct_Compu 1 100 -4095.000 4096.000 BIT_MASK 0x1fff FORMAT "%8.3" ECU_ADDRESS 0x6000DCDC /end MEASUREMENT
/begin MEASUREMENT DINH_nrActvInhReas.FId_ComGwIMG5 "Number of active inhibit reasons for the FIds / Number of active inhibit reasons for FId_ComGwIMG5" UWORD DINH_ct_Compu 1 100 -4095.000 4096.000 BIT_MASK 0x1fff FORMAT "%8.3" ECU_ADDRESS 0x6000DCDE /end MEASUREMENT
/begin MEASUREMENT DINH_nrActvInhReas.FId_ComGwIMG5Mon "Number of active inhibit reasons for the FIds / Number of active inhibit reasons for FId_ComGwIMG5Mon" UWORD DINH_ct_Compu 1 100 -4095.000 4096.000 BIT_MASK 0x1fff FORMAT "%8.3" ECU_ADDRESS 0x6000DCE0 /end MEASUREMENT
/begin MEASUREMENT DINH_nrActvInhReas.FId_ComGwIMG6 "Number of active inhibit reasons for the FIds / Number of active inhibit reasons for FId_ComGwIMG6" UWORD DINH_ct_Compu 1 100 -4095.000 4096.000 BIT_MASK 0x1fff FORMAT "%8.3" ECU_ADDRESS 0x6000DCE2 /end MEASUREMENT
/begin MEASUREMENT DINH_nrActvInhReas.FId_ComGwIMG6Mon "Number of active inhibit reasons for the FIds / Number of active inhibit reasons for FId_ComGwIMG6Mon" UWORD DINH_ct_Compu 1 100 -4095.000 4096.000 BIT_MASK 0x1fff FORMAT "%8.3" ECU_ADDRESS 0x6000DCE4 /end MEASUREMENT
/begin MEASUREMENT DINH_nrActvInhReas.FId_ComHFMSnsrErr "Number of active inhibit reasons for the FIds / Number of active inhibit reasons for FId_ComHFMSnsrErr" UWORD DINH_ct_Compu 1 100 -4095.000 4096.000 BIT_MASK 0x1fff FORMAT "%8.3" ECU_ADDRESS 0x6000DCE6 /end MEASUREMENT
/begin MEASUREMENT DINH_nrActvInhReas.FId_ComIDASB "Number of active inhibit reasons for the FIds / Number of active inhibit reasons for FId_ComIDASB" UWORD DINH_ct_Compu 1 100 -4095.000 4096.000 BIT_MASK 0x1fff FORMAT "%8.3" ECU_ADDRESS 0x6000DCE8 /end MEASUREMENT
/begin MEASUREMENT DINH_nrActvInhReas.FId_ComIDASBMon "Number of active inhibit reasons for the FIds / Number of active inhibit reasons for FId_ComIDASBMon" UWORD DINH_ct_Compu 1 100 -4095.000 4096.000 BIT_MASK 0x1fff FORMAT "%8.3" ECU_ADDRESS 0x6000DCEA /end MEASUREMENT
/begin MEASUREMENT DINH_nrActvInhReas.FId_ComIDASEngFail "Number of active inhibit reasons for the FIds / Number of active inhibit reasons for FId_ComIDASEngFail" UWORD DINH_ct_Compu 1 100 -4095.000 4096.000 BIT_MASK 0x1fff FORMAT "%8.3" ECU_ADDRESS 0x6000DCEC /end MEASUREMENT
/begin MEASUREMENT DINH_nrActvInhReas.FId_ComISG2 "Number of active inhibit reasons for the FIds / Number of active inhibit reasons for FId_ComISG2" UWORD DINH_ct_Compu 1 100 -4095.000 4096.000 BIT_MASK 0x1fff FORMAT "%8.3" ECU_ADDRESS 0x6000DCEE /end MEASUREMENT
/begin MEASUREMENT DINH_nrActvInhReas.FId_ComIgnCtrl "Number of active inhibit reasons for the FIds / Number of active inhibit reasons for FId_ComIgnCtrl" UWORD DINH_ct_Compu 1 100 -4095.000 4096.000 BIT_MASK 0x1fff FORMAT "%8.3" ECU_ADDRESS 0x6000DCF0 /end MEASUREMENT
/begin MEASUREMENT DINH_nrActvInhReas.FId_ComInjCtrl "Number of active inhibit reasons for the FIds / Number of active inhibit reasons for FId_ComInjCtrl" UWORD DINH_ct_Compu 1 100 -4095.000 4096.000 BIT_MASK 0x1fff FORMAT "%8.3" ECU_ADDRESS 0x6000DCF2 /end MEASUREMENT
/begin MEASUREMENT DINH_nrActvInhReas.FId_ComIntkAirPSnsrErr "Number of active inhibit reasons for the FIds / Number of active inhibit reasons for FId_ComIntkAirPSnsrErr" UWORD DINH_ct_Compu 1 100 -4095.000 4096.000 BIT_MASK 0x1fff FORMAT "%8.3" ECU_ADDRESS 0x6000DCF4 /end MEASUREMENT
/begin MEASUREMENT DINH_nrActvInhReas.FId_ComLamCtrl "Number of active inhibit reasons for the FIds / Number of active inhibit reasons for FId_ComLamCtrl" UWORD DINH_ct_Compu 1 100 -4095.000 4096.000 BIT_MASK 0x1fff FORMAT "%8.3" ECU_ADDRESS 0x6000DCF6 /end MEASUREMENT
/begin MEASUREMENT DINH_nrActvInhReas.FId_ComMETA "Number of active inhibit reasons for the FIds / Number of active inhibit reasons for FId_ComMETA" UWORD DINH_ct_Compu 1 100 -4095.000 4096.000 BIT_MASK 0x1fff FORMAT "%8.3" ECU_ADDRESS 0x6000DCF8 /end MEASUREMENT
/begin MEASUREMENT DINH_nrActvInhReas.FId_ComMETAMon "Number of active inhibit reasons for the FIds / Number of active inhibit reasons for FId_ComMETAMon" UWORD DINH_ct_Compu 1 100 -4095.000 4096.000 BIT_MASK 0x1fff FORMAT "%8.3" ECU_ADDRESS 0x6000DCFA /end MEASUREMENT
/begin MEASUREMENT DINH_nrActvInhReas.FId_ComMETC "Number of active inhibit reasons for the FIds / Number of active inhibit reasons for FId_ComMETC" UWORD DINH_ct_Compu 1 100 -4095.000 4096.000 BIT_MASK 0x1fff FORMAT "%8.3" ECU_ADDRESS 0x6000DCFC /end MEASUREMENT
/begin MEASUREMENT DINH_nrActvInhReas.FId_ComMETCMon "Number of active inhibit reasons for the FIds / Number of active inhibit reasons for FId_ComMETCMon" UWORD DINH_ct_Compu 1 100 -4095.000 4096.000 BIT_MASK 0x1fff FORMAT "%8.3" ECU_ADDRESS 0x6000DCFE /end MEASUREMENT
/begin MEASUREMENT DINH_nrActvInhReas.FId_ComMETD "Number of active inhibit reasons for the FIds / Number of active inhibit reasons for FId_ComMETD" UWORD DINH_ct_Compu 1 100 -4095.000 4096.000 BIT_MASK 0x1fff FORMAT "%8.3" ECU_ADDRESS 0x6000DD00 /end MEASUREMENT
/begin MEASUREMENT DINH_nrActvInhReas.FId_ComMETDMon "Number of active inhibit reasons for the FIds / Number of active inhibit reasons for FId_ComMETDMon" UWORD DINH_ct_Compu 1 100 -4095.000 4096.000 BIT_MASK 0x1fff FORMAT "%8.3" ECU_ADDRESS 0x6000DD02 /end MEASUREMENT
/begin MEASUREMENT DINH_nrActvInhReas.FId_ComMETE2 "Number of active inhibit reasons for the FIds / Number of active inhibit reasons for FId_ComMETE2" UWORD DINH_ct_Compu 1 100 -4095.000 4096.000 BIT_MASK 0x1fff FORMAT "%8.3" ECU_ADDRESS 0x6000DD04 /end MEASUREMENT
/begin MEASUREMENT DINH_nrActvInhReas.FId_ComMETE2Mon "Number of active inhibit reasons for the FIds / Number of active inhibit reasons for FId_ComMETE2Mon" UWORD DINH_ct_Compu 1 100 -4095.000 4096.000 BIT_MASK 0x1fff FORMAT "%8.3" ECU_ADDRESS 0x6000DD06 /end MEASUREMENT
/begin MEASUREMENT DINH_nrActvInhReas.FId_ComMETF "Number of active inhibit reasons for the FIds / Number of active inhibit reasons for FId_ComMETF" UWORD DINH_ct_Compu 1 100 -4095.000 4096.000 BIT_MASK 0x1fff FORMAT "%8.3" ECU_ADDRESS 0x6000DD08 /end MEASUREMENT
/begin MEASUREMENT DINH_nrActvInhReas.FId_ComMETFMon "Number of active inhibit reasons for the FIds / Number of active inhibit reasons for FId_ComMETFMon" UWORD DINH_ct_Compu 1 100 -4095.000 4096.000 BIT_MASK 0x1fff FORMAT "%8.3" ECU_ADDRESS 0x6000DD0A /end MEASUREMENT
/begin MEASUREMENT DINH_nrActvInhReas.FId_ComMETG "Number of active inhibit reasons for the FIds / Number of active inhibit reasons for FId_ComMETG" UWORD DINH_ct_Compu 1 100 -4095.000 4096.000 BIT_MASK 0x1fff FORMAT "%8.3" ECU_ADDRESS 0x6000DD0C /end MEASUREMENT
/begin MEASUREMENT DINH_nrActvInhReas.FId_ComMETGMon "Number of active inhibit reasons for the FIds / Number of active inhibit reasons for FId_ComMETGMon" UWORD DINH_ct_Compu 1 100 -4095.000 4096.000 BIT_MASK 0x1fff FORMAT "%8.3" ECU_ADDRESS 0x6000DD0E /end MEASUREMENT
/begin MEASUREMENT DINH_nrActvInhReas.FId_ComMETH "Number of active inhibit reasons for the FIds / Number of active inhibit reasons for FId_ComMETH" UWORD DINH_ct_Compu 1 100 -4095.000 4096.000 BIT_MASK 0x1fff FORMAT "%8.3" ECU_ADDRESS 0x6000DD10 /end MEASUREMENT
/begin MEASUREMENT DINH_nrActvInhReas.FId_ComMETH2 "Number of active inhibit reasons for the FIds / Number of active inhibit reasons for FId_ComMETH2" UWORD DINH_ct_Compu 1 100 -4095.000 4096.000 BIT_MASK 0x1fff FORMAT "%8.3" ECU_ADDRESS 0x6000DD12 /end MEASUREMENT
/begin MEASUREMENT DINH_nrActvInhReas.FId_ComMETH2Mon "Number of active inhibit reasons for the FIds / Number of active inhibit reasons for FId_ComMETH2Mon" UWORD DINH_ct_Compu 1 100 -4095.000 4096.000 BIT_MASK 0x1fff FORMAT "%8.3" ECU_ADDRESS 0x6000DD14 /end MEASUREMENT
/begin MEASUREMENT DINH_nrActvInhReas.FId_ComMETHMon "Number of active inhibit reasons for the FIds / Number of active inhibit reasons for FId_ComMETHMon" UWORD DINH_ct_Compu 1 100 -4095.000 4096.000 BIT_MASK 0x1fff FORMAT "%8.3" ECU_ADDRESS 0x6000DD16 /end MEASUREMENT
/begin MEASUREMENT DINH_nrActvInhReas.FId_ComMETI "Number of active inhibit reasons for the FIds / Number of active inhibit reasons for FId_ComMETI" UWORD DINH_ct_Compu 1 100 -4095.000 4096.000 BIT_MASK 0x1fff FORMAT "%8.3" ECU_ADDRESS 0x6000DD18 /end MEASUREMENT
/begin MEASUREMENT DINH_nrActvInhReas.FId_ComMETIMon "Number of active inhibit reasons for the FIds / Number of active inhibit reasons for FId_ComMETIMon" UWORD DINH_ct_Compu 1 100 -4095.000 4096.000 BIT_MASK 0x1fff FORMAT "%8.3" ECU_ADDRESS 0x6000DD1A /end MEASUREMENT
/begin MEASUREMENT DINH_nrActvInhReas.FId_ComMETK "Number of active inhibit reasons for the FIds / Number of active inhibit reasons for FId_ComMETK" UWORD DINH_ct_Compu 1 100 -4095.000 4096.000 BIT_MASK 0x1fff FORMAT "%8.3" ECU_ADDRESS 0x6000DD1C /end MEASUREMENT
/begin MEASUREMENT DINH_nrActvInhReas.FId_ComMETKMon "Number of active inhibit reasons for the FIds / Number of active inhibit reasons for FId_ComMETKMon" UWORD DINH_ct_Compu 1 100 -4095.000 4096.000 BIT_MASK 0x1fff FORMAT "%8.3" ECU_ADDRESS 0x6000DD1E /end MEASUREMENT
/begin MEASUREMENT DINH_nrActvInhReas.FId_ComMETL "Number of active inhibit reasons for the FIds / Number of active inhibit reasons for FId_ComMETL" UWORD DINH_ct_Compu 1 100 -4095.000 4096.000 BIT_MASK 0x1fff FORMAT "%8.3" ECU_ADDRESS 0x6000DD20 /end MEASUREMENT
/begin MEASUREMENT DINH_nrActvInhReas.FId_ComMETLMon "Number of active inhibit reasons for the FIds / Number of active inhibit reasons for FId_ComMETLMon" UWORD DINH_ct_Compu 1 100 -4095.000 4096.000 BIT_MASK 0x1fff FORMAT "%8.3" ECU_ADDRESS 0x6000DD22 /end MEASUREMENT
/begin MEASUREMENT DINH_nrActvInhReas.FId_ComMETM "Number of active inhibit reasons for the FIds / Number of active inhibit reasons for FId_ComMETM" UWORD DINH_ct_Compu 1 100 -4095.000 4096.000 BIT_MASK 0x1fff FORMAT "%8.3" ECU_ADDRESS 0x6000DD24 /end MEASUREMENT
/begin MEASUREMENT DINH_nrActvInhReas.FId_ComMETMMon "Number of active inhibit reasons for the FIds / Number of active inhibit reasons for FId_ComMETMMon" UWORD DINH_ct_Compu 1 100 -4095.000 4096.000 BIT_MASK 0x1fff FORMAT "%8.3" ECU_ADDRESS 0x6000DD26 /end MEASUREMENT
/begin MEASUREMENT DINH_nrActvInhReas.FId_ComMETN "Number of active inhibit reasons for the FIds / Number of active inhibit reasons for FId_ComMETN" UWORD DINH_ct_Compu 1 100 -4095.000 4096.000 BIT_MASK 0x1fff FORMAT "%8.3" ECU_ADDRESS 0x6000DD28 /end MEASUREMENT
/begin MEASUREMENT DINH_nrActvInhReas.FId_ComMETNMon "Number of active inhibit reasons for the FIds / Number of active inhibit reasons for FId_ComMETNMon" UWORD DINH_ct_Compu 1 100 -4095.000 4096.000 BIT_MASK 0x1fff FORMAT "%8.3" ECU_ADDRESS 0x6000DD2A /end MEASUREMENT
/begin MEASUREMENT DINH_nrActvInhReas.FId_ComMisf "Number of active inhibit reasons for the FIds / Number of active inhibit reasons for FId_ComMisf" UWORD DINH_ct_Compu 1 100 -4095.000 4096.000 BIT_MASK 0x1fff FORMAT "%8.3" ECU_ADDRESS 0x6000DD2C /end MEASUREMENT
/begin MEASUREMENT DINH_nrActvInhReas.FId_ComMon "Number of active inhibit reasons for the FIds / Number of active inhibit reasons for FId_ComMon" UWORD DINH_ct_Compu 1 100 -4095.000 4096.000 BIT_MASK 0x1fff FORMAT "%8.3" ECU_ADDRESS 0x6000DD2E /end MEASUREMENT
/begin MEASUREMENT DINH_nrActvInhReas.FId_ComNTrbn "Number of active inhibit reasons for the FIds / Number of active inhibit reasons for FId_ComNTrbn" UWORD DINH_ct_Compu 1 100 -4095.000 4096.000 BIT_MASK 0x1fff FORMAT "%8.3" ECU_ADDRESS 0x6000DD30 /end MEASUREMENT
/begin MEASUREMENT DINH_nrActvInhReas.FId_ComODOff "Number of active inhibit reasons for the FIds / Number of active inhibit reasons for FId_ComODOff" UWORD DINH_ct_Compu 1 100 -4095.000 4096.000 BIT_MASK 0x1fff FORMAT "%8.3" ECU_ADDRESS 0x6000DD32 /end MEASUREMENT
/begin MEASUREMENT DINH_nrActvInhReas.FId_ComOilLvlLamp "Number of active inhibit reasons for the FIds / Number of active inhibit reasons for FId_ComOilLvlLamp" UWORD DINH_ct_Compu 1 100 -4095.000 4096.000 BIT_MASK 0x1fff FORMAT "%8.3" ECU_ADDRESS 0x6000DD34 /end MEASUREMENT
/begin MEASUREMENT DINH_nrActvInhReas.FId_ComOilPWarnLamp "Number of active inhibit reasons for the FIds / Number of active inhibit reasons for FId_ComOilPWarnLamp" UWORD DINH_ct_Compu 1 100 -4095.000 4096.000 BIT_MASK 0x1fff FORMAT "%8.3" ECU_ADDRESS 0x6000DD36 /end MEASUREMENT
/begin MEASUREMENT DINH_nrActvInhReas.FId_ComPASensFail "Number of active inhibit reasons for the FIds / Number of active inhibit reasons for FId_ComPASensFail" UWORD DINH_ct_Compu 1 100 -4095.000 4096.000 BIT_MASK 0x1fff FORMAT "%8.3" ECU_ADDRESS 0x6000DD38 /end MEASUREMENT
/begin MEASUREMENT DINH_nrActvInhReas.FId_ComPBSensFail "Number of active inhibit reasons for the FIds / Number of active inhibit reasons for FId_ComPBSensFail" UWORD DINH_ct_Compu 1 100 -4095.000 4096.000 BIT_MASK 0x1fff FORMAT "%8.3" ECU_ADDRESS 0x6000DD3A /end MEASUREMENT
/begin MEASUREMENT DINH_nrActvInhReas.FId_ComPCU "Number of active inhibit reasons for the FIds / Number of active inhibit reasons for FId_ComPCU" UWORD DINH_ct_Compu 1 100 -4095.000 4096.000 BIT_MASK 0x1fff FORMAT "%8.3" ECU_ADDRESS 0x6000DD3C /end MEASUREMENT
/begin MEASUREMENT VehMot_rTrqDfftl "Torque ratio of differential" SWORD TransR 1 100 -327.6800 327.6700 FORMAT "%8.4" ECU_ADDRESS 0x60004E08 /end MEASUREMENT
/begin FUNCTION DFES "30000.73.0_2.0.0Diagnostic Fault Event Storage"
 /begin DEF_CHARACTERISTIC DFES_GrpRpr.DFC_MoXEMMHwLTTempSens_C DFES_GrpRpr.DFC_MoXEMMHwLTUCBCfg_C DFES_GrpRpr.DFC_OCWDAABEActv_C DFES_GrpRpr.DFC_OCWDACom_C DFES_GrpRpr.DFC_OCWDAErrPin_C DFES_GrpRpr.DFC_OCWDAOvrVltg_C DFES_GrpRpr.DFC_ORAmax_C DFES_GrpRpr.DFC_ORAmin_C DFES_GrpRpr.DFC_PLLSUmax_C DFES_GrpRpr.DFC_PLLSUmin_C DFES_GrpRpr.DFC_PSR1max_C DFES_GrpRpr.DFC_PSRBmax_C DFES_GrpRpr.DFC_PSRBmin_C DFES_GrpRpr.DFC_PSRPmax_C DFES_GrpRpr.DFC_PSRPmin_C DFES_GrpRpr.DFC_PSRPsig_C DFES_GrpRpr.DFC_PSRmax_C DFES_GrpRpr.DFC_PUmax_C DFES_GrpRpr.DFC_P_VSE11_OL_C DFES_GrpRpr.DFC_P_VSE11_SCB_C DFES_GrpRpr.DFC_P_VSE11_SCG_C DFES_GrpRpr.DFC_PhyHighAPP1_C DFES_GrpRpr.DFC_PhyHighAPP2_C DFES_GrpRpr.DFC_PhyLowAPP1_C DFES_GrpRpr.DFC_PhyLowAPP2_C DFES_GrpRpr.DFC_SRCHighAPP1_C DFES_GrpRpr.DFC_SRCHighAPP2_C DFES_GrpRpr.DFC_SRCLowAPP1_C DFES_GrpRpr.DFC_SRCLowAPP2_C DFES_GrpRpr.DFC_SSpMon2_C DFES_GrpRpr.DFC_SWReset_0_C DFES_GrpRpr.DFC_SWReset_1_C DFES_GrpRpr.DFC_SWReset_2_C DFES_GrpRpr.DFC_SyncAPP_C DFES_GrpRpr.DFC_TAmax_Dummy_C DFES_GrpRpr.DFC_TKAEmax_C DFES_GrpRpr.DFC_TKAEmin_C DFES_GrpRpr.DFC_TKARmax_C DFES_GrpRpr.DFC_TKARnpl_C DFES_GrpRpr.DFC_TMmax_Dummy_C DFES_GrpRpr.DFC_TUMmax_Dummy_C DFES_GrpRpr.DFC_TWCDPriCatB1_C DFES_GrpRpr.DFC_ThrVlvClsdPosnFirstOffsLrnImpoB1_C DFES_GrpRpr.DFC_ThrVlvClsdPosnOffsLrnImpoB1_C DFES_GrpRpr.DFC_ThrVlvClsdPosnOffsLrnMaxB1_C DFES_GrpRpr.DFC_ThrVlvClsdPosnOffsLrnMinB1_C DFES_GrpRpr.DFC_ThrVlvCtrlDeB1_C DFES_GrpRpr.DFC_ThrVlvDycB1_C DFES_GrpRpr.DFC_ThrVlvLimpAirPosnMaxAbsltDriftB1_C DFES_GrpRpr.DFC_ThrVlvLimpAirPosnMaxB1_C DFES_GrpRpr.DFC_ThrVlvLimpAirPosnMaxRelDriftB1_C DFES_GrpRpr.DFC_ThrVlvLimpAirPosnMinB1_C DFES_GrpRpr.DFC_ThrVlvOpenLoadB1_C DFES_GrpRpr.DFC_ThrVlvOpenSprgB1_C DFES_GrpRpr.DFC_ThrVlvOpenSprgSprdB1_C DFES_GrpRpr.DFC_ThrVlvOpenSprgTwnB1_C DFES_GrpRpr.DFC_ThrVlvOverTB1_C DFES_GrpRpr.DFC_ThrVlvRetSprgB1_C DFES_GrpRpr.DFC_ThrVlvRetSprgSprdB1_C DFES_GrpRpr.DFC_ThrVlvRetSprgTwnB1_C DFES_GrpRpr.DFC_ThrVlvSens1MaxB1_C DFES_GrpRpr.DFC_ThrVlvSens1NplB1_C DFES_GrpRpr.DFC_ThrVlvSens2MaxB1_C DFES_GrpRpr.DFC_ThrVlvSens2MinB1_C DFES_GrpRpr.DFC_ThrVlvSens2NplB1_C DFES_GrpRpr.DFC_ThrVlvShoCircB1_C DFES_GrpRpr.DFC_ThrVlvSpiErrB1_C DFES_GrpRpr.DFC_ThrvlvSens1MinB1_C DFES_GrpRpr.DFC_TiOffTBasdChkFast_C DFES_GrpRpr.DFC_TiOffTBasdChkSlow_C DFES_GrpRpr.DFC_UEGOHeatrCtlS1B1_C DFES_GrpRpr.DFC_UEGOSnsrMntdS1B1_C DFES_GrpRpr.DFC_VehVSig_C DFES_GrpRpr.DFC_VlvLftFbSwtIntk11SpclFail_C DFES_GrpRpr.DFC_VlvLftFbSwtIntk11StdFail_C DFES_MonEvtMSK0_C DFES_MonEvtMSK1_C DFES_MonRepeat_C DFES_numClsDlt_CA DFES_numClsFaultCycl_CA DFES_numClsHealCycl_CA DFES_numClsPndDlt_CA DFES_numClsSvcDlt_CA DFES_numClsSVSFaultCycl_CA DFES_numClsSVSHealCycl_CA DFES_ThresSimCond.n_C DFES_ThresSimCond.r_C DFES_ThresSimCond.t_C DFES_xAsgnExtdFrzFrSig_CA DFES_xAsgnFrzFrSig_CA DFES_xClsDltTrg_CA DFES_xClsFaultTrg_CA DFES_xClsFltMIL_CA DFES_xClsFltSVS_CA DFES_xClsHealTrg_CA DFES_xClsPndDltTrg_CA DFES_xClsPrio_CA DFES_xClsSvcDltTrg_CA DFES_xClsSVSFaultTrg_CA DFES_xClsSVSHealTrg_CA /end DEF_CHARACTERISTIC
 FUNCTION_VERSION "30000.73.0_2.0.0" /end FUNCTION
/begin FUNCTION DFP "30000.7.0 Diagnostic Fault Path" FUNCTION_VERSION "30000.7.0" /end FUNCTION
/begin FUNCTION DfpCl "3.0.0     support of DFP handling" FUNCTION_VERSION "3.0.0" /end FUNCTION
/begin FUNCTION DiaActr_ElecPsDiag "1.6.0     Standardized electrical power stage diagnosis for discrete output signals"
 /begin DEF_CHARACTERISTIC DiaActr_ElecPsDiag_DbgSigId_C DiaActr_ElecPsDiag_DbgSigTyp_C DiaActr_ElecPsDiag_SigOutDurgOpenLd_C /end DEF_CHARACTERISTIC
 /begin LOC_MEASUREMENT DiaActrElecPsDiag_cntTestPlsTsk_mp DiaActrElecPsDiag_nrDiagErr_mp DiaActrElecPsDiag_nrTestPls_mp DiaActrElecPsDiag_stAttribOL_mp DiaActrElecPsDiag_stAttribOT_mp DiaActrElecPsDiag_stAttribSCB_mp DiaActrElecPsDiag_stAttribSCG_mp DiaActrElecPsDiag_stDsmDebOpenLoad_mp DiaActrElecPsDiag_stDsmDebOverT_mp DiaActrElecPsDiag_stDsmDebScb_mp DiaActrElecPsDiag_stDsmDebScg_mp DiaActrElecPsDiag_stErrCfgOpenLoad_mp DiaActrElecPsDiag_stErrCfgOverT_mp DiaActrElecPsDiag_stErrCfgScb_mp DiaActrElecPsDiag_stErrCfgScg_mp DiaActrElecPsDiag_stPrvTstRslt_mp DiaActrElecPsDiag_stSigCfg_mp DiaActrElecPsDiag_stSigErrInfo_mp DiaActrElecPsDiag_stSig_mp DiaActrElecPsDiag_stTestPls_mp DiaActrElecPsDiag_stTmngTestPls_mp DiaActrElecPsDiag_tiTstPls_mp DiaActrElecPsDiag_TstPlsCnt_Cfg_mp /end LOC_MEASUREMENT
 FUNCTION_VERSION "1.6.0" /end FUNCTION
/begin FUNCTION DiaBas_BufAcs "30000.7.0 Functions for platform independent access (swapping) to data stored in an MSB buffer" FUNCTION_VERSION "30000.7.0" /end FUNCTION
/begin FUNCTION Diff_TrqRat "23.4.0    Differential ratio - Error substitute reactions" /begin DEF_CHARACTERISTIC Diff_rTrqDfftl_C /end DEF_CHARACTERISTIC /begin OUT_MEASUREMENT VehMot_rTrqDfftl /end OUT_MEASUREMENT FUNCTION_VERSION "23.4.0" /end FUNCTION
/begin FUNCTION DINH "30000.27.0_1.0.0Diagnostic Inhibit Handler"
 /begin LOC_MEASUREMENT DINH_DSQSrv7Vis DINH_FIdSrv7Vis DINH_nrActvInhReas.FID_AFRA DINH_nrActvInhReas.FID_AORA DINH_nrActvInhReas.FID_ATEH DINH_nrActvInhReas.FID_ATEL DINH_nrActvInhReas.FID_ATEN DINH_nrActvInhReas.FId_EGSDCmnSeg1B1Parl DINH_nrActvInhReas.FID_BLLRH DINH_nrActvInhReas.FID_BLLRKH DINH_nrActvInhReas.FID_BPLSU DINH_nrActvInhReas.FId_CJ135RvsChrgMeasS1B1 DINH_nrActvInhReas.FId_CatHeatgColdStrtReq DINH_nrActvInhReas.FId_CatHeatgWrmReq DINH_nrActvInhReas.FId_EGSDO2SnsrMntdRelsS1B1 DINH_nrActvInhReas.FId_EGSDO2_LamOffsFastS1B1 DINH_nrActvInhReas.FId_MisfDetDnAdpnNv DINH_nrActvInhReas.FID_BGFKMS DINH_nrActvInhReas.FID_CDSTTI DINH_nrActvInhReas.FID_CETKHL DINH_nrActvInhReas.FID_CETKHT DINH_nrActvInhReas.FID_CGLSRDP DINH_nrActvInhReas.FID_CLLKHV DINH_nrActvInhReas.FID_CLLRHV DINH_nrActvInhReas.FID_CLZSRDP DINH_nrActvInhReas.FID_CNSAD DINH_nrActvInhReas.FID_CNSAD2 DINH_nrActvInhReas.FID_CPFISTRT DINH_nrActvInhReas.FID_CPSRB DINH_nrActvInhReas.FID_CPSRP DINH_nrActvInhReas.FID_DKRSA DINH_nrActvInhReas.FID_DLLRBandEndTst DINH_nrActvInhReas.FID_DLLRShrtTrpSpdRmp DINH_nrActvInhReas.FID_FEDKAPB DINH_nrActvInhReas.FID_FEDSSB DINH_nrActvInhReas.FID_FOFSTP DINH_nrActvInhReas.FID_FONSTP DINH_nrActvInhReas.FID_FUEDK DINH_nrActvInhReas.FID_LRADLSU DINH_nrActvInhReas.FID_LRALSVErr DINH_nrActvInhReas.FID_LRAPLLSU DINH_nrActvInhReas.FID_LUSTP DINH_nrActvInhReas.FID_LnKS1 DINH_nrActvInhReas.FID_PLSUV DINH_nrActvInhReas.FID_PSRMOZDG DINH_nrActvInhReas.FID_PSRMOZG DINH_nrActvInhReas.FID_STRTDIA DINH_nrActvInhReas.FID_STRTSTM DINH_nrActvInhReas.FID_TFA1CSMW DINH_nrActvInhReas.FID_TKACSMW DINH_nrActvInhReas.FID_TMCSMW DINH_nrActvInhReas.FID_TOCHOilSwmpTQly DINH_nrActvInhReas.FID_TOCHTME DINH_nrActvInhReas.FID_TOSPCSMW DINH_nrActvInhReas.FID_UEGOHeatrRlyS1B1 DINH_nrActvInhReas.FID_VehStvSSEOk DINH_nrActvInhReas.FID_VldtLamPlausMaxS1B1 DINH_nrActvInhReas.FID_VldtLamPlausMinS1B1 DINH_nrActvInhReas.FId_ACClntPSSPMon DINH_nrActvInhReas.FId_ACCompComCANBusOff DINH_nrActvInhReas.FId_ACCompComCANErrMtr DINH_nrActvInhReas.FId_ACComp_HiUTWSnsrErr DINH_nrActvInhReas.FId_ACComp_LoUTWSnsrErr DINH_nrActvInhReas.FId_ACComp_PDSnsrErr DINH_nrActvInhReas.FId_ACComp_VehSpdSnsrErr DINH_nrActvInhReas.FId_ACCtl_ACStrtCut DINH_nrActvInhReas.FId_ACCtl_APP1 DINH_nrActvInhReas.FId_ACCtl_APP2 DINH_nrActvInhReas.FId_ACCtl_APPSync DINH_nrActvInhReas.FId_ACCtl_AcOff DINH_nrActvInhReas.FId_ACCtl_Clmb DINH_nrActvInhReas.FId_ACCtl_DK1 DINH_nrActvInhReas.FId_ACCtl_DK2 DINH_nrActvInhReas.FId_ACCtl_DKSync DINH_nrActvInhReas.FId_ACCtl_VehSpdSnsrErr DINH_nrActvInhReas.FId_ACCtl_pAC DINH_nrActvInhReas.FId_ACEvpTCANErr DINH_nrActvInhReas.FId_ACEvpTFrzVal DINH_nrActvInhReas.FId_ACEvpTRplVal DINH_nrActvInhReas.FId_APP1SigPath DINH_nrActvInhReas.FId_APP2SigPath DINH_nrActvInhReas.FId_APPBrkErr DINH_nrActvInhReas.FId_APPLETVldnErr DINH_nrActvInhReas.FId_APPLrn DINH_nrActvInhReas.FId_APPVehVErr DINH_nrActvInhReas.FId_AccPedDrvModComErr DINH_nrActvInhReas.FId_AccPedDrvModFailr DINH_nrActvInhReas.FId_AccPedNMaxLim DINH_nrActvInhReas.FId_AccPedNMinLim DINH_nrActvInhReas.FId_AccPedNMinLimBrkApp DINH_nrActvInhReas.FId_AccPedTrqLim DINH_nrActvInhReas.FId_AirCClntPFrzVal DINH_nrActvInhReas.FId_AirCClntPRplVal DINH_nrActvInhReas.FId_AirCSwt DINH_nrActvInhReas.FId_AirDvPAdpnPEnv DINH_nrActvInhReas.FId_AirDvPAdpnPIntkVUsB1 DINH_nrActvInhReas.FId_AirDvPPSnsrAdpn_PModeActv DINH_nrActvInhReas.FId_AltACGFailr DINH_nrActvInhReas.FId_AltAPPErrSt DINH_nrActvInhReas.FId_AltBattMngtFailr DINH_nrActvInhReas.FId_AltBrkErrSt DINH_nrActvInhReas.FId_AltComErr DINH_nrActvInhReas.FId_AltENGB DINH_nrActvInhReas.FId_AltElecLoadErr DINH_nrActvInhReas.FId_AltEnvTErr DINH_nrActvInhReas.FId_AltFFAltLoadFast DINH_nrActvInhReas.FId_AltFFAltLoadSlow DINH_nrActvInhReas.FId_AltIOACGErr DINH_nrActvInhReas.FId_AltIOACGLinComFailr DINH_nrActvInhReas.FId_AltIOComErr DINH_nrActvInhReas.FId_AltLinErr DINH_nrActvInhReas.FId_AltPwr DINH_nrActvInhReas.FId_AltVehVErrSt DINH_nrActvInhReas.FId_BGFKMSEPSR DINH_nrActvInhReas.FId_BGFKMSEPU DINH_nrActvInhReas.FId_BGFKMSESumClr DINH_nrActvInhReas.FId_BGFKMSZPSR DINH_nrActvInhReas.FId_BGOSCCat1B1 DINH_nrActvInhReas.FId_BGOSCCat2B1 DINH_nrActvInhReas.FId_BattAltFailr DINH_nrActvInhReas.FId_BattMngtFailr DINH_nrActvInhReas.FId_BattSigPtd DINH_nrActvInhReas.FId_BattU2MEDSRC DINH_nrActvInhReas.FId_BattUDrpPrvOff DINH_nrActvInhReas.FId_BattUFrzVal DINH_nrActvInhReas.FId_BattUHiFailrEna DINH_nrActvInhReas.FId_BattUIMGTCUCANFailr DINH_nrActvInhReas.FId_BattULoFailrEna DINH_nrActvInhReas.FId_BattUReplVal DINH_nrActvInhReas.FId_BattUSRC DINH_nrActvInhReas.FId_BlwrComErr DINH_nrActvInhReas.FId_BrkBstPDetnInhbn DINH_nrActvInhReas.FId_BrkBstPMstCylPSnsrFail DINH_nrActvInhReas.FId_BrkBstPSnsrStuckDetn DINH_nrActvInhReas.FId_BrkMnSwtErr DINH_nrActvInhReas.FId_BrkPOilPres DINH_nrActvInhReas.FId_BrkPedEngStopEna DINH_nrActvInhReas.FId_BrkRdntSwtErr DINH_nrActvInhReas.FId_CAGRSDS DINH_nrActvInhReas.FId_CEngDsTColdStrt DINH_nrActvInhReas.FId_CEngDsTColdStrtErr DINH_nrActvInhReas.FId_CEngDsTLSC DINH_nrActvInhReas.FId_CEngDsTPlausErr DINH_nrActvInhReas.FId_CEngDsTReplMdlEngStop DINH_nrActvInhReas.FId_CEngDsTSTC DINH_nrActvInhReas.FId_CEngDsTSnsrElec DINH_nrActvInhReas.FId_CEngDsTSwtReplMdl DINH_nrActvInhReas.FId_CEngUsTElecErr DINH_nrActvInhReas.FId_CEngUsTSnsrElecErr DINH_nrActvInhReas.FId_CEngUsTSwtReplMdl DINH_nrActvInhReas.FId_CJ135CtlFullAltvS1B1 DINH_nrActvInhReas.FId_CJ135CtlIPmpAltvS1B1 DINH_nrActvInhReas.FId_CJ135CtlIPmpS1B1 DINH_nrActvInhReas.FId_CJ135CtlRParlTstdS1B1 DINH_nrActvInhReas.FId_CJ135CtlS1B1 DINH_nrActvInhReas.FId_CJ135CtlSnsrHotS1B1 DINH_nrActvInhReas.FId_CJ135DiagSnsrS1B1 DINH_nrActvInhReas.FId_CJ135IPmpNoBiasS1B1 DINH_nrActvInhReas.FId_CJ135IPmpNoErrS1B1 DINH_nrActvInhReas.FId_CMSUDKSOM1 DINH_nrActvInhReas.FId_CMSUDKSOM2 DINH_nrActvInhReas.FId_CSTRTCTL DINH_nrActvInhReas.FId_Cj135DiagAsicS1B1 DINH_nrActvInhReas.FId_Cj135DiagOlEnaNotEnfS1B1 DINH_nrActvInhReas.FId_Cj135DiagOlEnaS1B1 DINH_nrActvInhReas.FId_Cj135DiagSpiS1B1 DINH_nrActvInhReas.FId_Cj135DiagWireRprtS1B1 DINH_nrActvInhReas.FId_Cj135DiagWireS1B1 DINH_nrActvInhReas.FId_Cj135Dummy DINH_nrActvInhReas.FId_Cj135PerdDiagOperEnaS1B1 DINH_nrActvInhReas.FId_ClntTempENGB DINH_nrActvInhReas.FId_Clth DINH_nrActvInhReas.FId_Clth2 DINH_nrActvInhReas.FId_Clth3StuckOn DINH_nrActvInhReas.FId_Clth4 DINH_nrActvInhReas.FId_ClthCAN DINH_nrActvInhReas.FId_ClthMax DINH_nrActvInhReas.FId_ClthStk DINH_nrActvInhReas.FId_ClthStkErr DINH_nrActvInhReas.FId_ClthStkFailr DINH_nrActvInhReas.FId_ClthStkOFFStuck DINH_nrActvInhReas.FId_ClthStkONStuck DINH_nrActvInhReas.FId_ClthSwtFailr DINH_nrActvInhReas.FId_CoEOMGdiEomErrLcy DINH_nrActvInhReas.FId_CoETM DINH_nrActvInhReas.FId_CoETS_StTrqLimErr1 DINH_nrActvInhReas.FId_CoETS_StTrqLimErr2 DINH_nrActvInhReas.FId_CoEngStopEnblStSpEngT DINH_nrActvInhReas.FId_CoEngStopEnblStSpLSU DINH_nrActvInhReas.FId_CoEngStopEnblStSpTcT DINH_nrActvInhReas.FId_CoEngStopEnblSysErr DINH_nrActvInhReas.FId_CoEngVlvLftSpIntk DINH_nrActvInhReas.FId_CoPOMStrtgDevStrtr DINH_nrActvInhReas.FId_CoPOM_FirstStrtAut DINH_nrActvInhReas.FId_CoTS_SwtOff DINH_nrActvInhReas.FId_CoVOMACCComFailr DINH_nrActvInhReas.FId_CoVOMBrkPedISABSigFailr DINH_nrActvInhReas.FId_CoVOMEngCrkAbort DINH_nrActvInhReas.FId_CoVOMEngRstrtEnaCdn DINH_nrActvInhReas.FId_CoVOMISSEng DINH_nrActvInhReas.FId_ComACRly DINH_nrActvInhReas.FId_ComAPPSensFail DINH_nrActvInhReas.FId_ComAPedl DINH_nrActvInhReas.FId_ComAYCA DINH_nrActvInhReas.FId_ComAYCAMon DINH_nrActvInhReas.FId_ComAYCD DINH_nrActvInhReas.FId_ComAYCDMon DINH_nrActvInhReas.FId_ComAYCF DINH_nrActvInhReas.FId_ComAYCFMon DINH_nrActvInhReas.FId_ComAYCG DINH_nrActvInhReas.FId_ComAYCGMon DINH_nrActvInhReas.FId_ComAYCI DINH_nrActvInhReas.FId_ComAYCIMon DINH_nrActvInhReas.FId_ComAirPThrUsSnsrErr DINH_nrActvInhReas.FId_ComAltFail DINH_nrActvInhReas.FId_ComAppVehSnsrFailr DINH_nrActvInhReas.FId_ComBCM1 DINH_nrActvInhReas.FId_ComBCM1Mon DINH_nrActvInhReas.FId_ComBstCtrl DINH_nrActvInhReas.FId_ComCANVEHICLEBusOff DINH_nrActvInhReas.FId_ComCGW1 DINH_nrActvInhReas.FId_ComCGW1Mon DINH_nrActvInhReas.FId_ComClthSt DINH_nrActvInhReas.FId_ComConvClth DINH_nrActvInhReas.FId_ComCrCtlReq DINH_nrActvInhReas.FId_ComCrsMaiIndcnLampReq DINH_nrActvInhReas.FId_ComCrsSetIndcnLampReq DINH_nrActvInhReas.FId_ComDCDCCdn DINH_nrActvInhReas.FId_ComDesGearCurr DINH_nrActvInhReas.FId_ComDetrmAirM DINH_nrActvInhReas.FId_ComDwnShiftCtrlReq DINH_nrActvInhReas.FId_ComEAT1 DINH_nrActvInhReas.FId_ComEAT10 DINH_nrActvInhReas.FId_ComEAT10Mon DINH_nrActvInhReas.FId_ComEAT11 DINH_nrActvInhReas.FId_ComEAT11Mon DINH_nrActvInhReas.FId_ComEAT12 DINH_nrActvInhReas.FId_ComEAT12Mon DINH_nrActvInhReas.FId_ComEAT13 DINH_nrActvInhReas.FId_ComEAT13Mon DINH_nrActvInhReas.FId_ComEAT1Mon DINH_nrActvInhReas.FId_ComEAT2 DINH_nrActvInhReas.FId_ComEAT2Mon DINH_nrActvInhReas.FId_ComEAT4 DINH_nrActvInhReas.FId_ComEAT4Mon DINH_nrActvInhReas.FId_ComEAT6 DINH_nrActvInhReas.FId_ComEAT6Mon DINH_nrActvInhReas.FId_ComEAT7 DINH_nrActvInhReas.FId_ComEAT7Mon DINH_nrActvInhReas.FId_ComEAT8 DINH_nrActvInhReas.FId_ComEAT8Mon DINH_nrActvInhReas.FId_ComEATA DINH_nrActvInhReas.FId_ComEATAMon DINH_nrActvInhReas.FId_ComEATB DINH_nrActvInhReas.FId_ComEATBMon DINH_nrActvInhReas.FId_ComEATC DINH_nrActvInhReas.FId_ComEATCMon DINH_nrActvInhReas.FId_ComEBBA DINH_nrActvInhReas.FId_ComEBBAMon DINH_nrActvInhReas.FId_ComECUHwErr DINH_nrActvInhReas.FId_ComEMSIntAirTemp DINH_nrActvInhReas.FId_ComEPS1 DINH_nrActvInhReas.FId_ComEPS1Mon DINH_nrActvInhReas.FId_ComEngBrkOvrdInfo DINH_nrActvInhReas.FId_ComEngBrkOvrdMtr DINH_nrActvInhReas.FId_ComEngBrkSwErr DINH_nrActvInhReas.FId_ComEngPosng DINH_nrActvInhReas.FId_ComEngRPMLim DINH_nrActvInhReas.FId_ComEngTrqLim DINH_nrActvInhReas.FId_ComEnvtlAirPSnsrErr DINH_nrActvInhReas.FId_ComEstmTqNormJdg DINH_nrActvInhReas.FId_ComEthnlSErr DINH_nrActvInhReas.FId_ComEwpErr DINH_nrActvInhReas.FId_ComFlSply DINH_nrActvInhReas.FId_ComFuCnsBitDurgIdleStop DINH_nrActvInhReas.FId_ComGEVCntrl DINH_nrActvInhReas.FId_ComGbxNPosFail DINH_nrActvInhReas.FId_ComGbxTemp DINH_nrActvInhReas.FId_ComGwIMG1 DINH_nrActvInhReas.FId_ComGwIMG1Mon DINH_nrActvInhReas.FId_ComGwIMG3 DINH_nrActvInhReas.FId_ComGwIMG3Mon DINH_nrActvInhReas.FId_ComGwIMG4 DINH_nrActvInhReas.FId_ComGwIMG4Mon DINH_nrActvInhReas.FId_ComGwIMG5 DINH_nrActvInhReas.FId_ComGwIMG5Mon DINH_nrActvInhReas.FId_ComGwIMG6 DINH_nrActvInhReas.FId_ComGwIMG6Mon DINH_nrActvInhReas.FId_ComHFMSnsrErr DINH_nrActvInhReas.FId_ComIDASB DINH_nrActvInhReas.FId_ComIDASBMon DINH_nrActvInhReas.FId_ComIDASEngFail DINH_nrActvInhReas.FId_ComISG2 DINH_nrActvInhReas.FId_ComIgnCtrl DINH_nrActvInhReas.FId_ComInjCtrl DINH_nrActvInhReas.FId_ComIntkAirPSnsrErr DINH_nrActvInhReas.FId_ComLamCtrl DINH_nrActvInhReas.FId_ComMETA DINH_nrActvInhReas.FId_ComMETAMon DINH_nrActvInhReas.FId_ComMETC DINH_nrActvInhReas.FId_ComMETCMon DINH_nrActvInhReas.FId_ComMETD DINH_nrActvInhReas.FId_ComMETDMon DINH_nrActvInhReas.FId_ComMETE2 DINH_nrActvInhReas.FId_ComMETE2Mon DINH_nrActvInhReas.FId_ComMETF DINH_nrActvInhReas.FId_ComMETFMon DINH_nrActvInhReas.FId_ComMETG DINH_nrActvInhReas.FId_ComMETGMon DINH_nrActvInhReas.FId_ComMETH DINH_nrActvInhReas.FId_ComMETH2 DINH_nrActvInhReas.FId_ComMETH2Mon DINH_nrActvInhReas.FId_ComMETHMon DINH_nrActvInhReas.FId_ComMETI DINH_nrActvInhReas.FId_ComMETIMon DINH_nrActvInhReas.FId_ComMETK DINH_nrActvInhReas.FId_ComMETKMon DINH_nrActvInhReas.FId_ComMETL DINH_nrActvInhReas.FId_ComMETLMon DINH_nrActvInhReas.FId_ComMETM DINH_nrActvInhReas.FId_ComMETMMon DINH_nrActvInhReas.FId_ComMETN DINH_nrActvInhReas.FId_ComMETNMon DINH_nrActvInhReas.FId_ComMisf DINH_nrActvInhReas.FId_ComMon DINH_nrActvInhReas.FId_ComNTrbn DINH_nrActvInhReas.FId_ComODOff DINH_nrActvInhReas.FId_ComOilLvlLamp DINH_nrActvInhReas.FId_ComOilPWarnLamp DINH_nrActvInhReas.FId_ComPASensFail DINH_nrActvInhReas.FId_ComPBSensFail DINH_nrActvInhReas.FId_ComPCU /end LOC_MEASUREMENT
 FUNCTION_VERSION "30000.27.0_1.0.0" /end FUNCTION
/begin COMPU_METHOD DFC_Verb "" TAB_VERB "%6.3" "-" COMPU_TAB_REF DFC_Verb /end COMPU_METHOD
/begin COMPU_VTAB DFC_Verb "" TAB_VERB 704 0 "DFC_Unused" 318 "DFC_ACEvpTSRCMax" 319 "DFC_ACEvpTSRCMin" 320 "DFC_AirCClntPAnaSRCMax" 321 "DFC_AirCClntPAnaSRCMin" 259 "DFC_AirCCmprOL" 260 "DFC_AirCCmprOvrTemp" 261 "DFC_AirCCmprSCB" 262 "DFC_AirCCmprSCG" 322 "DFC_AirCSwtNpl" 323 "DFC_AirCSwtSig" 263 "DFC_AltErr" 1 "DFC_AltIOACGFailr" 2 "DFC_AltIOACGHiVltg" 3 "DFC_AltIOACGLoVltg" 4 "DFC_AltIOACGTHi" 5 "DFC_AltIODConnACG" 429 "DFC_AppAllSnsrDfct" 6 "DFC_BattUHiFailr" 7 "DFC_BattULoFailr" 264 "DFC_BattUSRCMax" 265 "DFC_BattUSRCMin" 430 "DFC_BattUStdbyDiaOL" 431 "DFC_BigLeakIntkMnfldEmiInfl" 324 "DFC_Brk" 8 "DFC_BrkBstPDriftHiErr" 9 "DFC_BrkBstPDriftLoErr" 10 "DFC_BrkBstPSnsrStuck" 11 "DFC_BrkMnSwtContOn" 432 "DFC_BrkMnSwtContOnWarnLmp" 12 "DFC_BrkMnSwtNotStp" 433 "DFC_BrkMnSwtNotStpWarnLmp" 13 "DFC_BrkNpl" 14 "DFC_BrkRdntSwtContOn" 434 "DFC_BrkRdntSwtContOnWarnLmp" 15 "DFC_BrkRdntSwtNotStp" 435 "DFC_BrkRdntSwtNotStpWarnLmp" 325 "DFC_BrkSig" 417 "DFC_BSWM_E_ACTION_FAILED" 418 "DFC_BSWM_E_INTRPTQUEUE_FULL" 393 "DFC_BusDiagCANAPPLBusOff" 394 "DFC_BusDiagCANCANCBusOff" 395 "DFC_BusDiagCANVEHICLEBusOff" 411 "DFC_CAN_E_TIMEOUT" 436 "DFC_CEngDsTColdStrtMax" 437 "DFC_CEngDsTColdStrtMin" 438 "DFC_CEngDsTImps" 439 "DFC_CEngDsTPlausLSC" 440 "DFC_CEngDsTPlausSTC" 443 "DFC_CEngDsTSig" 441 "DFC_CEngDsTSRCMax" 442 "DFC_CEngDsTSRCMin" 444 "DFC_CEngUsTSRCMax" 445 "DFC_CEngUsTSRCMin" 366 "DFC_Clth2ONStuck" 367 "DFC_Clth2ONStuckLdc" 16 "DFC_Clth3ONStuck" 368 "DFC_Clth3ONStuckLdc" 369 "DFC_Clth3ONStuckPostDrv" 17 "DFC_Clth4OFFStuck" 370 "DFC_Clth4ONStuck" 371 "DFC_Clth4ONStuckLdc" 236 "DFC_ClthMax" 336 "DFC_ClthNpl" 18 "DFC_ClthOFFStuck" 19 "DFC_ClthONStuck" 326 "DFC_ClthSig" 20 "DFC_ClthStkFailInfo" 21 "DFC_ComACFailInfo" 22 "DFC_ComATFTValErr" 23 "DFC_ComATMILReq" 24 "DFC_ComAYCAChksum" 25 "DFC_ComAYCARingCnt" 26 "DFC_ComAYCATOut" 27 "DFC_ComAYCDChkSum" 28 "DFC_ComAYCDTOut" 29 "DFC_ComAYCFChksum" 30 "DFC_ComAYCFRingCnt" 31 "DFC_ComAYCFTOut" 32 "DFC_ComAYCGChksum" 33 "DFC_ComAYCGRingCnt" 34 "DFC_ComAYCGTOut" 35 "DFC_ComAYCIChkSum" 36 "DFC_ComAYCIRingCnt" 37 "DFC_ComAYCITOut" 38 "DFC_ComBCM1ChkSum" 39 "DFC_ComBCM1RingCnt" 40 "DFC_ComBCM1TOut" 41 "DFC_ComCANABusOffErr" 42 "DFC_ComCANBBusOffErr" 43 "DFC_ComCANCBusOffErr" 44 "DFC_ComCGW1ChkSum" 45 "DFC_ComCGW1RingCnt" 46 "DFC_ComCGW1TOut" 266 "DFC_ComChksTCU1" 267 "DFC_ComChksTCU11" 268 "DFC_ComChksTCU12" 269 "DFC_ComChksTCU13" 270 "DFC_ComChksTCU2" 271 "DFC_ComChksTCU3" 272 "DFC_ComChksTCU4" 273 "DFC_ComCntTCU1" 274 "DFC_ComCntTCU11" 275 "DFC_ComCntTCU12" 276 "DFC_ComCntTCU13" 277 "DFC_ComCntTCU2" 278 "DFC_ComCntTCU3" 279 "DFC_ComCntTCU4" 47 "DFC_ComConvBoostErr" 48 "DFC_ComConvSlipErr" 372 "DFC_ComDLCTCU01" 373 "DFC_ComDLCTCU02" 374 "DFC_ComDLCTCU1" 375 "DFC_ComDLCTCU11" 376 "DFC_ComDLCTCU12" 377 "DFC_ComDLCTCU13" 378 "DFC_ComDLCTCU14" 379 "DFC_ComDLCTCU2" 380 "DFC_ComDLCTCU3" 381 "DFC_ComDLCTCU4" 49 "DFC_ComEAT10Chksum" 50 "DFC_ComEAT10RingCnt" 51 "DFC_ComEAT10TOut" 52 "DFC_ComEAT11ChkSum" 53 "DFC_ComEAT11RingCnt" 54 "DFC_ComEAT11TOut" 55 "DFC_ComEAT12ChkSum" 56 "DFC_ComEAT12RingCnt" 57 "DFC_ComEAT12TOut" 58 "DFC_ComEAT13ChkSum" 59 "DFC_ComEAT13RingCnt" 60 "DFC_ComEAT13TOut" 61 "DFC_ComEAT1Chksum" 62 "DFC_ComEAT1RingCnt" 63 "DFC_ComEAT1TOut" 64 "DFC_ComEAT2ChkSum" 65 "DFC_ComEAT2RingCnt" 66 "DFC_ComEAT2TOut" 67 "DFC_ComEAT4ChkSum" 68 "DFC_ComEAT4RingCnt" 69 "DFC_ComEAT4TOut" 70 "DFC_ComEAT6Chksum" 71 "DFC_ComEAT6RingCnt" 72 "DFC_ComEAT6TOut" 73 "DFC_ComEAT7Chksum" 74 "DFC_ComEAT7RingCnt" 75 "DFC_ComEAT7TOut" 76 "DFC_ComEAT8Chksum" 77 "DFC_ComEAT8RingCnt" 78 "DFC_ComEAT8TOut" 79 "DFC_ComEATAChksum" 80 "DFC_ComEATARingCnt" 81 "DFC_ComEATATOut" 82 "DFC_ComEATBChkSum" 83 "DFC_ComEATBRingCnt" 84 "DFC_ComEATBTOut" 85 "DFC_ComEATCChksum" 86 "DFC_ComEATCRingCnt" 87 "DFC_ComEATCTOut" 88 "DFC_ComEBBAChksum" 89 "DFC_ComEBBARingCnt" 90 "DFC_ComEBBATOut" 94 "DFC_ComEngCanRxErr" 91 "DFC_ComEPS1Chksum" 92 "DFC_ComEPS1RingCnt" 93 "DFC_ComEPS1TOut" 95 "DFC_ComGrvySnsrErr" 96 "DFC_ComGwIMG1ChkSum" 97 "DFC_ComGwIMG1RingCnt" 98 "DFC_ComGwIMG1TOut" 99 "DFC_ComGwIMG3ChkSum" 100 "DFC_ComGwIMG3RingCnt" 101 "DFC_ComGwIMG3TOut" 102 "DFC_ComGwIMG4ChkSum" 103 "DFC_ComGwIMG4RingCnt" 104 "DFC_ComGwIMG4TOut" 105 "DFC_ComGwIMG5ChkSum" 106 "DFC_ComGwIMG5RingCnt" 107 "DFC_ComGwIMG5TOut" 108 "DFC_ComGwIMG6ChkSum" 109 "DFC_ComGwIMG6RingCnt" 110 "DFC_ComGwIMG6TOut" 111 "DFC_ComIDASBChksum" 112 "DFC_ComIDASBRingCnt" 113 "DFC_ComIDASBTOut" 114 "DFC_ComIMGMILReq" 115 "DFC_ComISSPrms" 116 "DFC_ComMETAChksum" 117 "DFC_ComMETARingCnt" 118 "DFC_ComMETATOut" 119 "DFC_ComMETCChksum" 120 "DFC_ComMETCRingCnt" 121 "DFC_ComMETCTOut" 122 "DFC_ComMETDChksum" 123 "DFC_ComMETDRingCnt" 124 "DFC_ComMETDTOut" 125 "DFC_ComMETE2Chksum" 126 "DFC_ComMETE2RingCnt" 127 "DFC_ComMETE2TOut" 128 "DFC_ComMETFChksum" 129 "DFC_ComMETFRingCnt" 130 "DFC_ComMETFTOut" 131 "DFC_ComMETGChksum" 132 "DFC_ComMETGRingCnt" 133 "DFC_ComMETGTOut" 134 "DFC_ComMETH2Chksum" 135 "DFC_ComMETH2RingCnt" 136 "DFC_ComMETH2TOut" 137 "DFC_ComMETHChksum" 138 "DFC_ComMETHRingCnt" 139 "DFC_ComMETHTOut" 140 "DFC_ComMETIChksum" 141 "DFC_ComMETIRingCnt" 142 "DFC_ComMETITOut" 143 "DFC_ComMETKChksum" 144 "DFC_ComMETKRingCnt" 145 "DFC_ComMETKTOut" 146 "DFC_ComMETLChksum" 147 "DFC_ComMETLRingCnt" 148 "DFC_ComMETLTOut" 149 "DFC_ComMETMChksum" 150 "DFC_ComMETMRingCnt" 151 "DFC_ComMETMTOut" 152 "DFC_ComMETNChksum" 153 "DFC_ComMETNRingCnt" 154 "DFC_ComMETNTOut" 155 "DFC_ComMtrCom" 156 "DFC_ComPCUChkSum" 157 "DFC_ComPCURingCnt" 158 "DFC_ComPCUTOut" 159 "DFC_ComSRSAChksum" 160 "DFC_ComSRSARingCnt" 161 "DFC_ComSRSATOut" 162 "DFC_ComSRSBChksum" 163 "DFC_ComSRSBRingCnt" 164 "DFC_ComSRSBTOut" 165 "DFC_ComSRSChksum" 166 "DFC_ComSRSErr" 167 "DFC_ComSRSRingCnt" 168 "DFC_ComSRSTOut" 280 "DFC_ComTOutTCU01" 281 "DFC_ComTOutTCU02" 282 "DFC_ComTOutTCU1" 283 "DFC_ComTOutTCU11" 284 "DFC_ComTOutTCU12" 285 "DFC_ComTOutTCU13" 286 "DFC_ComTOutTCU14" 287 "DFC_ComTOutTCU2" 288 "DFC_ComTOutTCU3" 289 "DFC_ComTOutTCU4" 169 "DFC_ComVehSpdPndFltTCU" 446 "DFC_DCDCFltDet" 290 "DFC_DevLibBattUHi" 291 "DFC_DevLibBattULo" 449 "DFC_DKnpl" 447 "DFC_DKRSA" 448 "DFC_DKVSmax" 450 "DFC_DSSmax" 451 "DFC_DSTTI" 452 "DFC_DSUmax" 170 "DFC_EbsChartcCurrErr" 171 "DFC_EbsSelfDiagErr" 383 "DFC_EbsSocFlt" 453 "DFC_EGRVlvOL" 454 "DFC_EGRVlvSCB" 455 "DFC_EGRVlvSCG" 456 "DFC_EGSDUS2B1LtrDly" 457 "DFC_EGSDUS2B1LtrPT1" 458 "DFC_EGSDUS2B1RtlDly" 459 "DFC_EGSDUS2B1RtlPT1" 460 "DFC_EGSDUS2B1TarLean" 461 "DFC_EGSDUS2B1TarRich" 464 "DFC_EngICO" 465 "DFC_EngPrtOvrSpdMon" 466 "DFC_EpmCaSI1ErrSig" 467 "DFC_EpmCaSI1NoSig" 468 "DFC_EpmCaSI1OfsErr" 469 "DFC_EpmCrSErrSig" 470 "DFC_EpmCrSNoSig" 471 "DFC_EtaEngIdleNonCsers" 472 "DFC_EtaEngPtlNonCsers" 462 "DFC_ETAKHLmax" 463 "DFC_ETAKHTmax" 337 "DFC_EV1max" 338 "DFC_EV1min" 339 "DFC_EV1sig" 340 "DFC_EV2max" 341 "DFC_EV2min" 342 "DFC_EV2sig" 343 "DFC_EV3max" 344 "DFC_EV3min" 345 "DFC_EV3sig" 346 "DFC_EV4max" 347 "DFC_EV4min" 348 "DFC_EV4sig" 382 "DFC_EVX" 292 "DFC_FanDIOOL_0" 293 "DFC_FanDIOOL_1" 294 "DFC_FanDIOOvrTemp_0" 295 "DFC_FanDIOOvrTemp_1" 296 "DFC_FanDIOSCB_0" 297 "DFC_FanDIOSCB_1" 298 "DFC_FanDIOSCG_0" 299 "DFC_FanDIOSCG_1" 473 "DFC_FRAmax" 474 "DFC_FRAmin" 172 "DFC_GbxCANDigPlausErr" 173 "DFC_GbxNPos1SRCMax" 174 "DFC_GbxNPos1SRCMin" 175 "DFC_GbxNPos2SRCMax" 176 "DFC_GbxNPos2SRCMin" 177 "DFC_GbxNPosAlvChk" 178 "DFC_GbxNPosSyncErr" 349 "DFC_GbxPNPosnDrvCdn" 350 "DFC_GbxPNPosnPlausy" 475 "DFC_GbxRvsSwtStk" 476 "DFC_HDRmax" 477 "DFC_HEGOS2B1ElecMax" 478 "DFC_HEGOS2B1ElecMin" 479 "DFC_HEGOS2B1ElecSig" 480 "DFC_HEGOS2B1HtgNpl" 179 "DFC_HEGOS2B1HtrPsMax" 180 "DFC_HEGOS2B1HtrPsMin" 181 "DFC_HEGOS2B1HtrPsSig" 327 "DFC_HLSDemOvhtEngLim" 384 "DFC_I14229VINErr" 237 "DFC_IgnClPs_DevComErr" 238 "DFC_IgnClPs_LineOl_0" 239 "DFC_IgnClPs_LineOl_1" 240 "DFC_IgnClPs_LineOl_2" 241 "DFC_IgnClPs_LineOl_3" 242 "DFC_IgnClPs_LineScb_0" 243 "DFC_IgnClPs_LineScb_1" 244 "DFC_IgnClPs_LineScb_2" 245 "DFC_IgnClPs_LineScb_3" 246 "DFC_IgnClPs_LineScg_0" 247 "DFC_IgnClPs_LineScg_1" 248 "DFC_IgnClPs_LineScg_2" 249 "DFC_IgnClPs_LineScg_3" 481 "DFC_IntkAirTIntkMnfldCrssMax" 482 "DFC_IntkAirTIntkMnfldCrssMin" 483 "DFC_IntkAirTIntkMnfldHSCMax" 484 "DFC_IntkAirTIntkMnfldImps" 485 "DFC_IntkAirTIntkMnfldPRCMax" 486 "DFC_IntkAirTIntkMnfldPRCMin" 487 "DFC_IntkAirTIntkMnfldSRCMax" 488 "DFC_IntkAirTIntkMnfldSRCMin" 489 "DFC_IntkAirTIntkMnfldSTC" 362 "DFC_KnDetSens1PortAMax" 363 "DFC_KnDetSens1PortAMin" 364 "DFC_KnDetSens1PortBMax" 365 "DFC_KnDetSens1PortBMin" 490 "DFC_KS1max" 491 "DFC_KS1min" 494 "DFC_LamDynDiagS1B1" 495 "DFC_LeakIntkMnfldEmiInfl" 412 "DFC_LIN_E_TIMEOUT" 182 "DFC_LinCSErrACG" 183 "DFC_LinCSErrEBS" 184 "DFC_LinHdrTimeoutErrACG" 185 "DFC_LinHdrTimeoutErrEBS" 186 "DFC_LinMsgTimeoutErrACG" 187 "DFC_LinMsgTimeoutErrEBS" 188 "DFC_LinNoStrtComErr" 385 "DFC_LLRKHmax" 386 "DFC_LLRKHmin" 387 "DFC_LLRmax" 388 "DFC_LLRmin" 492 "DFC_LMmax" 493 "DFC_LZSRnpl" 496 "DFC_MD00max" 497 "DFC_MDBmax" 498 "DFC_MDCat" 499 "DFC_MDCatCrit" 500 "DFC_MDCatCurr" 501 "DFC_MDCyl_0" 502 "DFC_MDCyl_1" 503 "DFC_MDCyl_2" 504 "DFC_MDCyl_3" 505 "DFC_MDEmi" 506 "DFC_MDEmiStrt" 507 "DFC_MDFco" 510 "DFC_MDmax" 508 "DFC_MDMpl" 509 "DFC_MDSegTiAdpn" 205 "DFC_MisfDetdVWhlFrntLePlaus" 206 "DFC_MisfDetdVWhlFrntRiPlaus" 207 "DFC_MisfDetdVWhlReLePlaus" 208 "DFC_MisfDetdVWhlReRiPlaus" 189 "DFC_MisfDetVWhlFrntLeOORHi" 190 "DFC_MisfDetVWhlFrntLeRatyHi" 191 "DFC_MisfDetVWhlFrntLeRatyLo" 192 "DFC_MisfDetVWhlFrntLeStuck" 193 "DFC_MisfDetVWhlFrntRiOORHi" 194 "DFC_MisfDetVWhlFrntRiRatyHi" 195 "DFC_MisfDetVWhlFrntRiRatyLo" 196 "DFC_MisfDetVWhlFrntRiStuck" 197 "DFC_MisfDetVWhlReLeOORHi" 198 "DFC_MisfDetVWhlReLeRatyHi" 199 "DFC_MisfDetVWhlReLeRatyLo" 200 "DFC_MisfDetVWhlReLeStuck" 201 "DFC_MisfDetVWhlReRiOORHi" 202 "DFC_MisfDetVWhlReRiRatyHi" 203 "DFC_MisfDetVWhlReRiRatyLo" 204 "DFC_MisfDetVWhlReRiStuck" 605 "DFC_MoCADCNTP" 606 "DFC_MoCADCTst" 607 "DFC_MoCSOPICO" 609 "DFC_MoFAirFilgPrdc" 610 "DFC_MoFAirFlCtOffPfi" 611 "DFC_MoFAirFlCylPfi" 612 "DFC_MoFAirFlIn" 613 "DFC_MoFAirFlMixCtlPfiChkAirFl" 614 "DFC_MoFAirFlMixCtlPfiChkCtrl" 615 "DFC_MoFAirFlMode" 608 "DFC_MoFAPP" 616 "DFC_MoFESpd" 617 "DFC_MoFIACo" 618 "DFC_MoFICOL1" 619 "DFC_MoFICOL2" 620 "DFC_MoFStrt" 621 "DFC_MoFTrqCmp" 622 "DFC_MoFTrqCmpMax" 623 "DFC_MoFTrqCmpMin" 624 "DFC_MoFVarPostBldSel" 511 "DFC_MOXEMM_SMU_ALM0_0" 512 "DFC_MOXEMM_SMU_ALM0_1" 513 "DFC_MOXEMM_SMU_ALM0_10" 514 "DFC_MOXEMM_SMU_ALM0_11" 515 "DFC_MOXEMM_SMU_ALM0_13" 516 "DFC_MOXEMM_SMU_ALM0_14" 517 "DFC_MOXEMM_SMU_ALM0_2" 518 "DFC_MOXEMM_SMU_ALM0_22" 519 "DFC_MOXEMM_SMU_ALM0_23" 520 "DFC_MOXEMM_SMU_ALM0_4" 521 "DFC_MOXEMM_SMU_ALM0_5" 522 "DFC_MOXEMM_SMU_ALM0_7" 523 "DFC_MOXEMM_SMU_ALM0_8" 524 "DFC_MOXEMM_SMU_ALM10_16" 525 "DFC_MOXEMM_SMU_ALM10_17" 526 "DFC_MOXEMM_SMU_ALM10_21" 527 "DFC_MOXEMM_SMU_ALM11_0" 528 "DFC_MOXEMM_SMU_ALM11_1" 529 "DFC_MOXEMM_SMU_ALM11_2" 530 "DFC_MOXEMM_SMU_ALM11_3" 531 "DFC_MOXEMM_SMU_ALM11_4" 532 "DFC_MOXEMM_SMU_ALM11_5" 533 "DFC_MOXEMM_SMU_ALM11_8" 534 "DFC_MOXEMM_SMU_ALM11_9" 535 "DFC_MOXEMM_SMU_ALM1_0" 536 "DFC_MOXEMM_SMU_ALM1_1" 537 "DFC_MOXEMM_SMU_ALM1_10" 538 "DFC_MOXEMM_SMU_ALM1_11" 539 "DFC_MOXEMM_SMU_ALM1_13" 540 "DFC_MOXEMM_SMU_ALM1_14" 541 "DFC_MOXEMM_SMU_ALM1_2" 542 "DFC_MOXEMM_SMU_ALM1_22" 543 "DFC_MOXEMM_SMU_ALM1_23" 544 "DFC_MOXEMM_SMU_ALM1_4" 545 "DFC_MOXEMM_SMU_ALM1_5" 546 "DFC_MOXEMM_SMU_ALM1_7" 547 "DFC_MOXEMM_SMU_ALM1_8" 548 "DFC_MOXEMM_SMU_ALM21_0" 549 "DFC_MOXEMM_SMU_ALM21_16" 550 "DFC_MOXEMM_SMU_ALM21_3" 551 "DFC_MOXEMM_SMU_ALM2_1" 552 "DFC_MOXEMM_SMU_ALM2_10" 553 "DFC_MOXEMM_SMU_ALM2_11" 554 "DFC_MOXEMM_SMU_ALM2_13" 555 "DFC_MOXEMM_SMU_ALM2_14" 556 "DFC_MOXEMM_SMU_ALM2_22" 557 "DFC_MOXEMM_SMU_ALM2_23" 558 "DFC_MOXEMM_SMU_ALM2_4" 559 "DFC_MOXEMM_SMU_ALM2_5" 560 "DFC_MOXEMM_SMU_ALM2_7" 561 "DFC_MOXEMM_SMU_ALM2_8" 562 "DFC_MOXEMM_SMU_ALM6_0" 563 "DFC_MOXEMM_SMU_ALM6_11" 564 "DFC_MOXEMM_SMU_ALM6_12" 565 "DFC_MOXEMM_SMU_ALM6_14" 566 "DFC_MOXEMM_SMU_ALM6_15" 567 "DFC_MOXEMM_SMU_ALM6_17" 568 "DFC_MOXEMM_SMU_ALM6_18" 569 "DFC_MOXEMM_SMU_ALM6_20" 570 "DFC_MOXEMM_SMU_ALM6_21" 571 "DFC_MOXEMM_SMU_ALM6_25" 572 "DFC_MOXEMM_SMU_ALM6_4" 573 "DFC_MOXEMM_SMU_ALM6_5" 574 "DFC_MOXEMM_SMU_ALM6_7" 575 "DFC_MOXEMM_SMU_ALM6_8" 576 "DFC_MOXEMM_SMU_ALM7_1" 577 "DFC_MOXEMM_SMU_ALM7_12" 578 "DFC_MOXEMM_SMU_ALM7_13" 579 "DFC_MOXEMM_SMU_ALM7_14" 580 "DFC_MOXEMM_SMU_ALM7_15" 581 "DFC_MOXEMM_SMU_ALM7_16" 582 "DFC_MOXEMM_SMU_ALM7_17" 583 "DFC_MOXEMM_SMU_ALM7_2" 584 "DFC_MOXEMM_SMU_ALM7_20" 585 "DFC_MOXEMM_SMU_ALM7_25" 586 "DFC_MOXEMM_SMU_ALM7_26" 587 "DFC_MOXEMM_SMU_ALM7_28" 588 "DFC_MOXEMM_SMU_ALM7_29" 589 "DFC_MOXEMM_SMU_ALM7_30" 590 "DFC_MOXEMM_SMU_ALM7_31" 591 "DFC_MOXEMM_SMU_ALM8_0" 592 "DFC_MOXEMM_SMU_ALM8_1" 593 "DFC_MOXEMM_SMU_ALM8_10" 594 "DFC_MOXEMM_SMU_ALM8_11" 595 "DFC_MOXEMM_SMU_ALM8_12" 596 "DFC_MOXEMM_SMU_ALM8_16" 597 "DFC_MOXEMM_SMU_ALM8_18" 598 "DFC_MOXEMM_SMU_ALM8_2" 599 "DFC_MOXEMM_SMU_ALM8_3" 600 "DFC_MOXEMM_SMU_ALM8_31" 601 "DFC_MOXEMM_SMU_ALM8_4" 602 "DFC_MOXEMM_SMU_ALM9_0" 603 "DFC_MOXEMM_SMU_ALM9_15" 604 "DFC_MOXEMM_SMU_ALM9_3" 625 "DFC_MoXEMMHwLTMCUFW" 626 "DFC_MoXEMMHwLTMonBIST" 627 "DFC_MoXEMMHwLTRegMonTest" 628 "DFC_MoXEMMHwLTStbySMUAlvTest" 629 "DFC_MoXEMMHwLTTempSens" 630 "DFC_MoXEMMHwLTUCBCfg" 300 "DFC_MRlyDcOL" 301 "DFC_MRlyDcSCB" 302 "DFC_MRlyDcSCG" 413 "DFC_MRlyOL" 414 "DFC_MRlySCB" 415 "DFC_MRlySCG" 631 "DFC_OCWDAABEActv" 632 "DFC_OCWDACom" 633 "DFC_OCWDAErrPin" 634 "DFC_OCWDAOvrVltg" 328 "DFC_OilPNpl" 635 "DFC_ORAmax" 636 "DFC_ORAmin" 647 "DFC_P_VSE11_OL" 648 "DFC_P_VSE11_SCB" 649 "DFC_P_VSE11_SCG" 351 "DFC_PEnvCcMax" 352 "DFC_PEnvCcMin" 353 "DFC_PEnvRngChkMax" 354 "DFC_PEnvRngChkMin" 209 "DFC_PEnvSigRngMax" 210 "DFC_PEnvSigRngMin" 355 "DFC_PEnvSnsrPlaus" 650 "DFC_PhyHighAPP1" 651 "DFC_PhyHighAPP2" 652 "DFC_PhyLowAPP1" 653 "DFC_PhyLowAPP2" 329 "DFC_PIntkVUsLineHiB1" 330 "DFC_PIntkVUsLineLoB1" 637 "DFC_PLLSUmax" 638 "DFC_PLLSUmin" 303 "DFC_PSPOL" 304 "DFC_PSPOvrTemp" 305 "DFC_PSPSCB" 306 "DFC_PSPSCG" 639 "DFC_PSR1max" 640 "DFC_PSRBmax" 641 "DFC_PSRBmin" 645 "DFC_PSRmax" 642 "DFC_PSRPmax" 643 "DFC_PSRPmin" 644 "DFC_PSRPsig" 646 "DFC_PUmax" 396 "DFC_RBA_IODIAGPWR_rba_IoExtCy329_SignalVltSply_0" 397 "DFC_RBA_IODIAGPWR_rba_IoExtCy329_SignalVltSply_0OT" 398 "DFC_RBA_IODIAGPWR_rba_IoExtCy329_SignalVltSply_0OV" 399 "DFC_RBA_IODIAGPWR_rba_IoExtCy329_SignalVltSply_0SCG" 400 "DFC_RBA_IODIAGPWR_rba_IoExtCy329_SignalVltSply_0UV" 401 "DFC_RBA_IODIAGPWR_rba_IoExtCy329_SignalVltSply_1" 402 "DFC_RBA_IODIAGPWR_rba_IoExtCy329_SignalVltSply_1OT" 403 "DFC_RBA_IODIAGPWR_rba_IoExtCy329_SignalVltSply_1OV" 404 "DFC_RBA_IODIAGPWR_rba_IoExtCy329_SignalVltSply_1SCG" 405 "DFC_RBA_IODIAGPWR_rba_IoExtCy329_SignalVltSply_1UV" 406 "DFC_RBA_IODIAGPWR_rba_IoExtCy329_SignalVltSply_2" 407 "DFC_RBA_IODIAGPWR_rba_IoExtCy329_SignalVltSply_2OT" 408 "DFC_RBA_IODIAGPWR_rba_IoExtCy329_SignalVltSply_2OV" 409 "DFC_RBA_IODIAGPWR_rba_IoExtCy329_SignalVltSply_2SCG" 410 "DFC_RBA_IODIAGPWR_rba_IoExtCy329_SignalVltSply_2UV" 419 "DFC_RBA_IOEXTLIB_KEEPALIVE_DRV" 420 "DFC_RBA_IOEXTLIB_KEEPALIVE_INI" 421 "DFC_rba_IoSigRtc_StopCounter" 423 "DFC_rba_MemDiag_MemReadErr" 424 "DFC_rba_MemDiag_MemWrErr" 422 "DFC_rba_MRly_Diag_Stk_Event" 416 "DFC_rba_MultiStackTrace_Threshold" 425 "DFC_rba_SyC_IrrSwOffTrigEngRun_Event" 426 "DFC_rba_T15_Diag_ComInVld_Event" 427 "DFC_rba_T15_Diag_ComOff_HwOn_Event" 428 "DFC_rba_T15_Diag_ComOn_HwOff_Event" 389 "DFC_RoughRoad" 390 "DFC_SiaEEPRdErr" 391 "DFC_SiaEEPWrngCod" 654 "DFC_SRCHighAPP1" 655 "DFC_SRCHighAPP2" 656 "DFC_SRCLowAPP1" 657 "DFC_SRCLowAPP2" 658 "DFC_SSpMon2" 211 "DFC_StmFault" 213 "DFC_StrtCtlErr" 212 "DFC_StrtCtOffPth" 214 "DFC_StrtFault" 215 "DFC_StrtLckJudg1" 216 "DFC_StrtLckJudg2" 217 "DFC_StrtOL" 218 "DFC_StrtOL2" 219 "DFC_StrtSCB" 220 "DFC_StrtSCB2" 221 "DFC_StrtSCG" 222 "DFC_StrtSCG2" 223 "DFC_StrtStkRly1" 224 "DFC_StrtStkRly2" 659 "DFC_SWReset_0" 660 "DFC_SWReset_1" 661 "DFC_SWReset_2" 662 "DFC_SyncAPP" 307 "DFC_T50Err" 663 "DFC_TAmax_Dummy" 225 "DFC_TEVEmax" 226 "DFC_TEVEmin" 227 "DFC_TEVEsig" 671 "DFC_ThrVlvClsdPosnFirstOffsLrnImpoB1" 672 "DFC_ThrVlvClsdPosnOffsLrnImpoB1" 673 "DFC_ThrVlvClsdPosnOffsLrnMaxB1" 674 "DFC_ThrVlvClsdPosnOffsLrnMinB1" 675 "DFC_ThrVlvCtrlDeB1" 676 "DFC_ThrVlvDycB1" 677 "DFC_ThrVlvLimpAirPosnMaxAbsltDriftB1" 678 "DFC_ThrVlvLimpAirPosnMaxB1" 679 "DFC_ThrVlvLimpAirPosnMaxRelDriftB1" 680 "DFC_ThrVlvLimpAirPosnMinB1" 308 "DFC_ThrVlvLoBattB1" 681 "DFC_ThrVlvOpenLoadB1" 682 "DFC_ThrVlvOpenSprgB1" 683 "DFC_ThrVlvOpenSprgSprdB1" 684 "DFC_ThrVlvOpenSprgTwnB1" 685 "DFC_ThrVlvOverTB1" 686 "DFC_ThrVlvRetSprgB1" 687 "DFC_ThrVlvRetSprgSprdB1" 688 "DFC_ThrVlvRetSprgTwnB1" 689 "DFC_ThrVlvSens1MaxB1" 696 "DFC_ThrvlvSens1MinB1" 690 "DFC_ThrVlvSens1NplB1" 691 "DFC_ThrVlvSens2MaxB1" 692 "DFC_ThrVlvSens2MinB1" 693 "DFC_ThrVlvSens2NplB1" 694 "DFC_ThrVlvShoCircB1" 695 "DFC_ThrVlvSpiErrB1" 697 "DFC_TiOffTBasdChkFast" 698 "DFC_TiOffTBasdChkSlow" 664 "DFC_TKAEmax" 665 "DFC_TKAEmin" 666 "DFC_TKARmax" 667 "DFC_TKARnpl" 668 "DFC_TMmax_Dummy" 669 "DFC_TUMmax_Dummy" 670 "DFC_TWCDPriCatB1" 250 "DFC_UEGOASICS1B1" 392 "DFC_UegoDummy" 699 "DFC_UEGOHeatrCtlS1B1" 356 "DFC_UEGOHeatrPsS1B1Max" 357 "DFC_UEGOHeatrPsS1B1Min" 358 "DFC_UEGOHeatrPsS1B1Sig" 359 "DFC_UEGOHeatrRlyPsOLS1B1" 360 "DFC_UEGOHeatrRlyPsSCBS1B1" 361 "DFC_UEGOHeatrRlyPsSCGS1B1" 257 "DFC_UegoOlApesS1B1" 251 "DFC_UEGOOLIPES1B1" 258 "DFC_UegoOlRCmpS1B1" 252 "DFC_UEGOOLRES1B1" 253 "DFC_UEGOSCBS1B1" 254 "DFC_UEGOSCGS1B1" 700 "DFC_UEGOSnsrMntdS1B1" 256 "DFC_UEGOSnsrS1B1" 255 "DFC_UEGOSPIS1B1" 228 "DFC_VehVAllPlaus" 229 "DFC_VehVNCSnsrElecFailr" 309 "DFC_VehVPhysRngHi" 331 "DFC_VehVPhysRngLo" 230 "DFC_VehVPlausCan" 231 "DFC_VehVPlausFco" 232 "DFC_VehVPlausPwr" 233 "DFC_VehVPlausV2N" 310 "DFC_VehVSclOutOL" 311 "DFC_VehVSclOutOT" 312 "DFC_VehVSclOutSCB" 313 "DFC_VehVSclOutSCG" 701 "DFC_VehVSig" 332 "DFC_VehVSigCan" 333 "DFC_VehVSigCanSafe" 314 "DFC_VehVSnsrARngHi" 315 "DFC_VehVSnsrBRngHi" 316 "DFC_VehVSpdRtyDiag" 234 "DFC_VehVSpdSnsrAElecFailr" 235 "DFC_VehVSpdSnsrBElecFailr" 317 "DFC_VehVWhlErr" 334 "DFC_VlvLftFbOilPSnsrIntk11SRCMax" 335 "DFC_VlvLftFbOilPSnsrIntk11SRCMin" 702 "DFC_VlvLftFbSwtIntk11SpclFail" 703 "DFC_VlvLftFbSwtIntk11StdFail" DEFAULT_VALUE "---" /end COMPU_VTAB
/begin COMPU_METHOD DFES_LampFltMIL "" TAB_VERB "%6.3" "-" COMPU_TAB_REF DFES_LampFltMIL /end COMPU_METHOD
/begin COMPU_VTAB DFES_LampFltMIL "" TAB_VERB 4 0 "NO_Lamp_Activation" 1 "Continous_Lamp_Support" 2 "Blinking_Lamp_Support" 3 "Blinking_and_Continous_Lamp_Supp" /end COMPU_VTAB
/begin COMPU_METHOD DFES_LampFltSVS "" TAB_VERB "%6.3" "-" COMPU_TAB_REF DFES_LampFltSVS /end COMPU_METHOD
/begin COMPU_VTAB DFES_LampFltSVS "" TAB_VERB 6 0 "NO_Lamp_Activation" 1 "Continous_Lamp_Support" 2 "Blinking_Lamp_Support" 3 "Blinking_and_Continous_Lamp_Supp" 4 "Continuous_SVS_Support_LDF" 8 "Continuous_SVS_Support_LDF_FLC" /end COMPU_VTAB
/begin COMPU_METHOD DFES_nPID0C "" RAT_FUNC "%6.3" "rpm" COEFFS 0 4 0 0 0 1 /end COMPU_METHOD
/begin COMPU_METHOD DFES_OneToOne "" RAT_FUNC "%6.2" "-" COEFFS 0 1 0 0 0 1 /end COMPU_METHOD
/begin COMPU_METHOD DFES_rPID04 "" RAT_FUNC "%6.3" "%" COEFFS 0 2.55 0 0 0 1 /end COMPU_METHOD
/begin COMPU_METHOD DFES_tPID05 "" RAT_FUNC "%6.2" "deg C" COEFFS 0 1 40 0 0 1 /end COMPU_METHOD
/begin COMPU_METHOD DFES_TstVisAndPrio "" TAB_VERB "%6.3" "-" COMPU_TAB_REF DFES_TstVisAndPrio /end COMPU_METHOD
/begin COMPU_VTAB DFES_TstVisAndPrio "" TAB_VERB 13 3 "invisible_for_all_Testers" 5 "ServiceLow" 7 "ServiceHigh" 9 "ServiceHigh_PrioOffs_1" 11 "ServiceHigh_PrioOffs_2" 27 "ServiceHighPlus" 205 "OBDLow" 207 "OBDHigh" 209 "OBDHighPlus" 211 "ServiceHigh_MaxPrio" 213 "ServiceHigh_OBDLow_MaxPrio" 215 "ServiceHigh_OBDHigh_MaxPrio" 217 "ServiceHigh_OBDHighPlus_MaxPrio" /end COMPU_VTAB
/begin COMPU_METHOD DiaActrElecPsDiag_stSig_COMPU_VERB "" TAB_VERB "%6.3" "" COMPU_TAB_REF DiaActrElecPsDiag_stSig_COMPU_VERB /end COMPU_METHOD
/begin COMPU_VTAB DiaActrElecPsDiag_stSig_COMPU_VERB "" TAB_VERB 7 0 "INVALID" 1 "NOTEST" 2 "NOFAULT" 3 "FAULT" 4 "PREFAULT" 5 "HEALFAULT" 6 "WAITSTATE" DEFAULT_VALUE "0" /end COMPU_VTAB
/begin COMPU_METHOD DiaActrElecPsDiag_stTestPls_COMPU_VERB "" TAB_VERB "%6.3" "" COMPU_TAB_REF DiaActrElecPsDiag_stTestPls_COMPU_VERB /end COMPU_METHOD
/begin COMPU_VTAB DiaActrElecPsDiag_stTestPls_COMPU_VERB "" TAB_VERB 5 1 "NO" 2 "REQUESTED" 3 "RUNNING" 4 "FINISHED" 5 "RE-TRIGGERED" DEFAULT_VALUE "1" /end COMPU_VTAB
/begin COMPU_METHOD DiaActrElecPsDiag_stTmngTestPls_COMPU_VERB "" TAB_VERB "%6.3" "" COMPU_TAB_REF DiaActrElecPsDiag_stTmngTestPls_COMPU_VERB /end COMPU_METHOD
/begin COMPU_VTAB DiaActrElecPsDiag_stTmngTestPls_COMPU_VERB "" TAB_VERB 4 1 "EVERY_RASTER" 2 "TIME_BETWEEN_TEST_1" 3 "TIME_BETWEEN_TEST_2" 0 "NO" DEFAULT_VALUE "0" /end COMPU_VTAB
/begin COMPU_METHOD DiaActr_ElecPsDiag_DbgSigTyp_COMPU_VERB "" TAB_VERB "%6.3" "" COMPU_TAB_REF DiaActr_ElecPsDiag_DbgSigTyp_COMPU_VERB /end COMPU_METHOD
/begin COMPU_VTAB DiaActr_ElecPsDiag_DbgSigTyp_COMPU_VERB "" TAB_VERB 4 1 "DIGITAL_OUTPUT" 2 "PWM_OUTPUT" 3 "PMD_OUTPUT" 0 "NONE" DEFAULT_VALUE "0" /end COMPU_VTAB
/begin COMPU_METHOD DINH_ct_Compu "" RAT_FUNC "%6.0" "" COEFFS 0 -1 4096 0 0 1 /end COMPU_METHOD
/begin COMPU_METHOD DSMAUX_DTRGVerb "" TAB_VERB "%6.3" "-" COMPU_TAB_REF DSMAUX_DTRGVerb /end COMPU_METHOD
/begin COMPU_VTAB DSMAUX_DTRGVerb "" TAB_VERB 12 1 "DTRG_AlwaysTrue" 2 "DTRG_DrivingCycleFLC" 3 "DTRG_DrivingCycleHLC" 4 "DTRG_MDCatHLC" 5 "DTRG_MDEmiHLC" 6 "DTRG_MDEmiStrtHLC" 7 "DTRG_MDFLC2" 8 "DTRG_MDHLC2" 9 "DTRG_NoTrigger" 10 "DTRG_SimilarCondHLC" 0 "DTRG_Time200ms" 11 "DTRG_WarmUpCycle" DEFAULT_VALUE "---" /end COMPU_VTAB
/begin COMPU_METHOD EPMCAS_SELNDIAGFAILRADPN_SC_Compu "" TAB_VERB "%6.3" "" COMPU_TAB_REF EPMCAS_SELNDIAGFAILRADPN_SC_Compu /end COMPU_METHOD
/begin COMPU_VTAB EPMCAS_SELNDIAGFAILRADPN_SC_Compu "" TAB_VERB 2 0 "DISAD_DIAG_FAILRADPN" 1 "ENAD_DIAG_FAILRADPN" /end COMPU_VTAB
/begin COMPU_METHOD EPMCRS_DGIPLSCORRNACTVD_SC_Compu "" RAT_FUNC "%6.2" "" COEFFS 0 1 0 0 0 1 /end COMPU_METHOD
/begin COMPU_METHOD EPMCRS_DIAGDETAILEXTD_SC_Compu "" TAB_VERB "%6.3" "" COMPU_TAB_REF EPMCRS_DIAGDETAILEXTD_SC_Compu /end COMPU_METHOD
/begin COMPU_VTAB EPMCRS_DIAGDETAILEXTD_SC_Compu "" TAB_VERB 3 0 "DISABLE" 1 "ENABLE_SIGNAL" 2 "ENABLE_NOSIGNAL" /end COMPU_VTAB
/begin COMPU_METHOD EPMCRS_DIAGSRC_SC_Compu "" RAT_FUNC "%6.2" "" COEFFS 0 1 0 0 0 1 /end COMPU_METHOD
/begin COMPU_METHOD EPMCRS_DIAGSYNCLOST_SC_Compu "" TAB_VERB "%6.3" "" COMPU_TAB_REF EPMCRS_DIAGSYNCLOST_SC_Compu /end COMPU_METHOD
/begin COMPU_VTAB EPMCRS_DIAGSYNCLOST_SC_Compu "" TAB_VERB 2 0 "DISABLE_DIAGSYNCLOST" 1 "ENABLE_DIAGSYNCLOST" /end COMPU_VTAB
/begin COMPU_METHOD EPMCRS_ENASIGLVLDIAG_SC_Compu "" TAB_VERB "%6.3" "" COMPU_TAB_REF EPMCRS_ENASIGLVLDIAG_SC_Compu /end COMPU_METHOD
/begin COMPU_VTAB EPMCRS_ENASIGLVLDIAG_SC_Compu "" TAB_VERB 2 0 "False" 1 "True" /end COMPU_VTAB
/begin COMPU_METHOD EPMCRS_MAXAXISPNTSTIPLSCRV_SC_Compu "" RAT_FUNC "%6.2" "" COEFFS 0 1 0 0 0 1 /end COMPU_METHOD
/begin COMPU_METHOD EPMCRS_NRENGSPDSEGPLAUS_SC_Compu "" RAT_FUNC "%6.2" "" COEFFS 0 1 0 0 0 1 /end COMPU_METHOD
/begin COMPU_METHOD EPMCRS_NUMINCOUT_SC_Compu "" RAT_FUNC "%6.2" "" COEFFS 0 1 0 0 0 1 /end COMPU_METHOD
/begin COMPU_METHOD EPMCRS_PLSWIDTHAPPLACTVD_SC_Compu "" TAB_VERB "%6.3" "" COMPU_TAB_REF EPMCRS_PLSWIDTHAPPLACTVD_SC_Compu /end COMPU_METHOD
/begin COMPU_VTAB EPMCRS_PLSWIDTHAPPLACTVD_SC_Compu "" TAB_VERB 2 0 "0" 1 "1" /end COMPU_VTAB
/begin COMPU_METHOD EPMCRS_RESLTOTREV_SC_Compu "" TAB_VERB "%6.3" "" COMPU_TAB_REF EPMCRS_RESLTOTREV_SC_Compu /end COMPU_METHOD
/begin COMPU_VTAB EPMCRS_RESLTOTREV_SC_Compu "" TAB_VERB 3 0 "RESL1000" 1 "RESL100" 2 "RESL10" /end COMPU_VTAB
/begin COMPU_METHOD EPMCRS_REVSTRTCONT_SC_Compu "" TAB_VERB "%6.3" "" COMPU_TAB_REF EPMCRS_REVSTRTCONT_SC_Compu /end COMPU_METHOD
/begin COMPU_VTAB EPMCRS_REVSTRTCONT_SC_Compu "" TAB_VERB 2 0 "False" 1 "True" /end COMPU_VTAB
/begin COMPU_METHOD EPMCRS_TIINCOUTPVBL_SC_Compu "" TAB_VERB "%6.3" "" COMPU_TAB_REF EPMCRS_TIINCOUTPVBL_SC_Compu /end COMPU_METHOD
/begin COMPU_VTAB EPMCRS_TIINCOUTPVBL_SC_Compu "" TAB_VERB 3 1 "TIINC" 2 "TIINCLRES" 3 "TIINC_TIINCLRES" /end COMPU_VTAB
/begin COMPU_METHOD EPMCRS_TIINCOUT_SC_Compu "" TAB_VERB "%6.3" "" COMPU_TAB_REF EPMCRS_TIINCOUT_SC_Compu /end COMPU_METHOD
/begin COMPU_VTAB EPMCRS_TIINCOUT_SC_Compu "" TAB_VERB 2 0 "False" 1 "True" /end COMPU_VTAB
/begin COMPU_METHOD EPMERR_NRERRINFOARY_SC_Compu "" TAB_VERB "%6.3" "" COMPU_TAB_REF EPMERR_NRERRINFOARY_SC_Compu /end COMPU_METHOD
/begin COMPU_VTAB EPMERR_NRERRINFOARY_SC_Compu "" TAB_VERB 3 1 "small block size" 2 "medium block size" 3 "big block size" /end COMPU_VTAB
/begin COMPU_METHOD EPMHWE_RTM_SY_Compu "" TAB_VERB "%6.3" "" COMPU_TAB_REF EPMHWE_RTM_SY_Compu /end COMPU_METHOD
/begin COMPU_VTAB EPMHWE_RTM_SY_Compu "" TAB_VERB 2 0 "NO_RTM" 1 "RTM" /end COMPU_VTAB
/begin COMPU_METHOD EPMHWE_SWTCPU_SY_Compu "" TAB_VERB "%6.3" "" COMPU_TAB_REF EPMHWE_SWTCPU_SY_Compu /end COMPU_METHOD
/begin COMPU_VTAB EPMHWE_SWTCPU_SY_Compu "" TAB_VERB 2 0 "PCP" 1 "CPU" /end COMPU_VTAB
/begin COMPU_METHOD EPMRRS_IGNLOCKRELSIMDT_SC_Compu "" TAB_VERB "%6.3" "" COMPU_TAB_REF EPMRRS_IGNLOCKRELSIMDT_SC_Compu /end COMPU_METHOD
/begin COMPU_VTAB EPMRRS_IGNLOCKRELSIMDT_SC_Compu "" TAB_VERB 2 0 "False" 1 "True" /end COMPU_VTAB
/begin COMPU_METHOD EPMRRS_SY_Compu "" TAB_VERB "%6.3" "" COMPU_TAB_REF EPMRRS_SY_Compu /end COMPU_METHOD
/begin COMPU_VTAB EPMRRS_SY_Compu "" TAB_VERB 3 0 "NO_RRS" 1 "REV" 2 "REV_STOP" /end COMPU_VTAB
/begin COMPU_METHOD OneToOne "" RAT_FUNC "%6.2" "-" COEFFS 0 1 0 0 0 1 /end COMPU_METHOD
/begin COMPU_METHOD Signals_IntSigNumVerb "" TAB_VERB "%6.3" "" COMPU_TAB_REF Signals_IntSigNumVerb /end COMPU_METHOD
/begin COMPU_VTAB Signals_IntSigNumVerb "" TAB_VERB 783 0 "SIGNALS_Signals_Default" 1 "SIGNALS_APP_rUnFlt" 2 "SIGNALS_APP_r_sig" 3 "SIGNALS_APP_r_signal" 4 "SIGNALS_APP_uRaw1_signal" 5 "SIGNALS_APP_uRaw2_signal" 6 "SIGNALS_AbsLdCom8Bit_PID43h" 7 "SIGNALS_AccPed_tqMapBasd_BENG_signal" 8 "SIGNALS_AccPed_tqMapBasd_TRQB_signal" 9 "SIGNALS_ActMod_trqInr_signal" 10 "SIGNALS_AirC_uAnaRawClnt_signal" 11 "SIGNALS_Alt_iExctLim_signal" 12 "SIGNALS_Alt_rAltExct_signal" 13 "SIGNALS_Alt_uFinalDes_signal" 14 "SIGNALS_BattU_u" 15 "SIGNALS_BattU_uSens1_signal" 16 "SIGNALS_BattU_uSens2_s" 17 "SIGNALS_BattU_uSens_signal" 18 "SIGNALS_Batt_lMaxCnsChk_signal" 19 "SIGNALS_Batt_lMinCnsChk_signal" 20 "SIGNALS_Batt_qCnsChkAH_signal" 21 "SIGNALS_Brk_st" 22 "SIGNALS_Brk_stRed" 23 "SIGNALS_CEngDsT_uRaw_s" 24 "SIGNALS_CoEng_tiCranking_signal" 25 "SIGNALS_CoEng_tiScneEngStrtPrmIdH1F_signal" 26 "SIGNALS_CoVeh_trqAcs_s" 27 "SIGNALS_ComEBS_BattID_signal" 28 "SIGNALS_ComEBS_rBattSensCh_signal" 29 "SIGNALS_ComEBS_uBattSens_signal" 30 "SIGNALS_ComEBS_uBattUCO_signal" 31 "SIGNALS_Com_iBattEBS_signal" 32 "SIGNALS_Com_lDst_signal" 33 "SIGNALS_Com_rMeasdBattREbs_signal" 34 "SIGNALS_Com_tBattEBS_signal" 35 "SIGNALS_Com_trqAYCFDes_signal" 36 "SIGNALS_Com_uPeak_signal" 37 "SIGNALS_CrCtl_stShutOffCode0_signal" 38 "SIGNALS_CrCtl_stShutOffCode1_signal" 39 "SIGNALS_CrCtl_stShutOffCode2_signal" 40 "SIGNALS_CrCtl_stShutOffCode3_signal" 41 "SIGNALS_CrCtl_stShutOffCode4_signal" 42 "SIGNALS_CrCtl_stShutOffCode5_signal" 43 "SIGNALS_CrCtl_stShutOffCode6_signal" 44 "SIGNALS_CrCtl_stShutOffCode7_signal" 45 "SIGNALS_CrCtl_stShutOffCode8_signal" 46 "SIGNALS_CrCtl_stShutOffCode9_signal" 47 "SIGNALS_DIUMPR_ctGenDenom_signal" 48 "SIGNALS_DIUMPR_ctIgn_signal" 49 "SIGNALS_DRIVE_numDTCFrz_s" 50 "SIGNALS_DRIVE_stCurTrgMode_signal" 51 "SIGNALS_DRIVE_stHardToStrt_s" 52 "SIGNALS_DSMDur_ctPID21h_signal" 53 "SIGNALS_DSMDur_ctPID31h_signal" 54 "SIGNALS_DcmDspUDS_rdbi_2612Byte10_signal" 55 "SIGNALS_DcmDspUDS_rdbi_2612Byte11_signal" 56 "SIGNALS_DcmDspUDS_rdbi_fixed_signal" 57 "SIGNALS_DcmDspUDS_rdbi_reserved0_signal_s" 58 "SIGNALS_DcmDspUDS_rdbi_reserved0_signal_w_s" 59 "SIGNALS_DcmDspUDS_rdbi_reserved1_signal" 60 "SIGNALS_Dspl_stCrsSwtInfo_signal" 61 "SIGNALS_Ebs_qBliChrg_signal" 62 "SIGNALS_Ebs_qBliDchaTotDcyc_0_signal" 63 "SIGNALS_Ebs_qBliDchaTotDcyc_1_signal" 64 "SIGNALS_Ebs_qBliDchaTotDcyc_2_signal" 65 "SIGNALS_Ebs_qBliDchaTotDcyc_3_signal" 66 "SIGNALS_Ebs_qBliDchaTotDcyc_4_signal" 67 "SIGNALS_Ebs_qBliDcha_signal" 68 "SIGNALS_Ebs_stStbIEBSByt0_0_signal" 69 "SIGNALS_Ebs_stStbIEBSByt0_1_signal" 70 "SIGNALS_Ebs_stStbIEBSByt0_2_signal" 71 "SIGNALS_Ebs_stStbIEBSByt0_3_signal" 72 "SIGNALS_Ebs_stStbIEBSByt0_4_signal" 73 "SIGNALS_Ebs_stStbIEBSByt1_0_signal" 74 "SIGNALS_Ebs_stStbIEBSByt1_1_signal" 75 "SIGNALS_Ebs_stStbIEBSByt1_2_signal" 76 "SIGNALS_Ebs_stStbIEBSByt1_3_signal" 77 "SIGNALS_Ebs_stStbIEBSByt1_4_signal" 78 "SIGNALS_Ebs_stStbIEBSByt2_0_signal" 79 "SIGNALS_Ebs_stStbIEBSByt2_1_signal" 80 "SIGNALS_Ebs_stStbIEBSByt2_2_signal" 81 "SIGNALS_Ebs_stStbIEBSByt2_3_signal" 82 "SIGNALS_Ebs_stStbIEBSByt2_4_signal" 83 "SIGNALS_Ebs_stStbIEBSByt3_0_signal" 84 "SIGNALS_Ebs_stStbIEBSByt3_1_signal" 85 "SIGNALS_Ebs_stStbIEBSByt3_2_signal" 86 "SIGNALS_Ebs_stStbIEBSByt3_3_signal" 87 "SIGNALS_Ebs_stStbIEBSByt3_4_signal" 88 "SIGNALS_Ebs_stStbIEBSByt4_0_signal" 89 "SIGNALS_Ebs_stStbIEBSByt4_1_signal" 90 "SIGNALS_Ebs_stStbIEBSByt4_2_signal" 91 "SIGNALS_Ebs_stStbIEBSByt4_3_signal" 92 "SIGNALS_Ebs_stStbIEBSByt4_4_signal" 93 "SIGNALS_EngTrqPtd_trqLead_s" 94 "SIGNALS_EngTrqPtd_trqLead_signal" 95 "SIGNALS_EngTrqPtd_trqSet_s" 96 "SIGNALS_EngTrqPtd_trqSet_signal" 97 "SIGNALS_EpmCaS_ctErrSig_signal" 98 "SIGNALS_EpmCaS_ctNoSig_signal" 99 "SIGNALS_EpmCaS_phiDiffCal2AdapEqAvg_0" 100 "SIGNALS_EpmCaS_phiOfsCorr" 101 "SIGNALS_EpmCrS_ctCaSRev_mp_signal" 102 "SIGNALS_EpmCrS_ctErrSig_signal" 103 "SIGNALS_Epm_nEngAct" 104 "SIGNALS_Epm_nEngRaw_s" 105 "SIGNALS_Epm_nEngRaw_signal" 106 "SIGNALS_Epm_stOpMode" 107 "SIGNALS_Epm_stSync" 108 "SIGNALS_ExhMod_tCat1B1_signal" 109 "SIGNALS_GlbDa_lenTotDstDcycHiResl_signal" 110 "SIGNALS_HEGO_uS2B1Extd_s" 111 "SIGNALS_HEGO_uS2B1HiRes_signal" 112 "SIGNALS_I14229CoEng_tiNormalOBDPrevDcyc_s" 113 "SIGNALS_I14229GlbDa_lTotDstDCHiReslPrevDcyc_s" 114 "SIGNALS_I14229IntkAirT_tSnsrTstrMax_s" 115 "SIGNALS_I14229IntkAirT_tSnsrTstrMin_s" 116 "SIGNALS_I14229RDBI_nOvrSpd_signal" 117 "SIGNALS_I14229RDBI_tiOvrSpd_signal" 118 "SIGNALS_I14229_ElecLd_iEPSLoadOnly_signal" 119 "SIGNALS_I14229_EpmCrS_ctErrSig_signal" 120 "SIGNALS_I14229_ivzabg_w_signal" 121 "SIGNALS_I14229_lDst_signal" 122 "SIGNALS_I14229_ml_w_msg_signal" 123 "SIGNALS_I14229_nstat_signal" 124 "SIGNALS_I14229_numDTCFrzFrmHi_signal" 125 "SIGNALS_I14229_numDTCFrzFrmLo_signal" 126 "SIGNALS_I14229_numDTCFrzFrmMid_signal" 127 "SIGNALS_I14229_ps_w_signal" 128 "SIGNALS_I14229_rTrqPT_signal" 129 "SIGNALS_I14229_tSnsrFild1_signal" 130 "SIGNALS_I14229_tiInj1On_signal" 131 "SIGNALS_I14229_tiOilFlowCompl_signal" 132 "SIGNALS_I14229_tiSia_signal" 133 "SIGNALS_I14229_tkaMax_s" 134 "SIGNALS_I14229_tkaMin_s" 135 "SIGNALS_I14229_tka_signal" 136 "SIGNALS_I14229_tmotMaxCurrDcyc_s" 137 "SIGNALS_I14229_tmotMaxPrevDcyc_s" 138 "SIGNALS_I14229_tmotMinCurrDcyc_s" 139 "SIGNALS_I14229_tmotMinPrevDcyc_s" 140 "SIGNALS_I14229_ubsq_signal" 141 "SIGNALS_I14229_umsrln_w_signal" 142 "SIGNALS_I14229_wdks_w_signal" 143 "SIGNALS_I14229_wped1_signal" 144 "SIGNALS_I14229_wped2_signal" 145 "SIGNALS_I14229_zwist_signal" 146 "SIGNALS_I14229iocpMDA_numACGC_signal" 147 "SIGNALS_I14229iocpMDA_numAPS_signal" 148 "SIGNALS_I14229iocpMDA_numPSC_signal" 149 "SIGNALS_I14229iocpMDA_numRFAN_signal" 150 "SIGNALS_I14229iocpMDA_numVTEC_signal" 151 "SIGNALS_I14229iocp_numCtlSt_s" 152 "SIGNALS_I14229iocp_numEXE_signal" 153 "SIGNALS_I14229iocp_numREQ_s" 154 "SIGNALS_I14229iocp_stSFTRJC_s" 155 "SIGNALS_I15031_PID1Dh" 156 "SIGNALS_I15031_PID65Ah" 157 "SIGNALS_I15031_PID66Ah" 158 "SIGNALS_I15031_PID68Ah" 159 "SIGNALS_I15031_PID69Ah" 160 "SIGNALS_I15031_PID6AAh" 161 "SIGNALS_I15031_PID6BAh" 162 "SIGNALS_I15031_PID6CAh" 163 "SIGNALS_I15031_PID6DAh" 164 "SIGNALS_I15031_PID6EAh" 165 "SIGNALS_I15031_PID6FAh" 166 "SIGNALS_I15031_PID70Ah" 167 "SIGNALS_I15031_PID71Ah" 168 "SIGNALS_I15031_PID72Ah" 169 "SIGNALS_I15031_PID73Ah" 170 "SIGNALS_I15031_PID74Ah" 171 "SIGNALS_I15031_PID75Ah" 172 "SIGNALS_I15031_PID76Ah" 173 "SIGNALS_I15031_PID77Ah" 174 "SIGNALS_I15031_PID78Ah" 175 "SIGNALS_I15031_PID79Ah" 176 "SIGNALS_I15031_PID7AAh" 177 "SIGNALS_I15031_PID7BAh" 178 "SIGNALS_I15031_PID7CAh" 179 "SIGNALS_I15031_PID7FAh" 180 "SIGNALS_I15031_PID81Ah" 181 "SIGNALS_I15031_PID82Ah" 182 "SIGNALS_I15031_PID85Ah" 183 "SIGNALS_I15031_PID86Ah" 184 "SIGNALS_I15031_PID87Ah" 185 "SIGNALS_I15031_PID89Ah" 186 "SIGNALS_I15031_PID8AAh" 187 "SIGNALS_I15031_PID8FAh" 188 "SIGNALS_I15031_PID92Ah" 189 "SIGNALS_I15031_PID93Ah" 190 "SIGNALS_I15031_PID94Ah" 191 "SIGNALS_I15031_PID98Ah" 192 "SIGNALS_I15031_PID99Ah" 193 "SIGNALS_I15031_PID9CAh" 194 "SIGNALS_I15031_PIDA3Ah" 195 "SIGNALS_I15031_PIDA4Ah" 196 "SIGNALS_I15031_PIDA5Ah" 197 "SIGNALS_I15031_PIDA9Ah" 198 "SIGNALS_I15031_PIDACAh" 199 "SIGNALS_IKCtl_agAdpnCurr_s16_signal" 200 "SIGNALS_IKCtl_agKnkAvrg_s8_signal" 201 "SIGNALS_InjSys_volFuConsDrvCycCAN_s" 202 "SIGNALS_IntkAirT_uSnsr1Exprt_signal" 203 "SIGNALS_IntkAirT_uSnsr3CrssSwtLoc_s" 204 "SIGNALS_MoF_rTrqInrAct_s" 205 "SIGNALS_MoF_rTrqPtdFlt_s" 206 "SIGNALS_OilLfT_degOilDetern_signal" 207 "SIGNALS_OilSwmpT_uSnsrRaw_s" 208 "SIGNALS_PID01h" 209 "SIGNALS_PID03h_0" 210 "SIGNALS_PID03h_1" 211 "SIGNALS_PID04h" 212 "SIGNALS_PID05h" 213 "SIGNALS_PID06h_0" 214 "SIGNALS_PID07h_0" 215 "SIGNALS_PID0Ch_Epm_nEng" 216 "SIGNALS_PID0D_VehV_vSens" 217 "SIGNALS_PID0Eh" 218 "SIGNALS_PID0Fh" 219 "SIGNALS_PID0Fh_s" 220 "SIGNALS_PID0bh" 221 "SIGNALS_PID0bh_PIntkVUs_pRawObd" 222 "SIGNALS_PID11h_ThrVlv_ratActSens1AbsltB1_u8" 223 "SIGNALS_PID13h" 224 "SIGNALS_PID15h_0" 225 "SIGNALS_PID15h_1" 226 "SIGNALS_PID1Ch" 227 "SIGNALS_PID1Fh_TiScneEngStrt" 228 "SIGNALS_PID21h" 229 "SIGNALS_PID2Eh" 230 "SIGNALS_PID30h" 231 "SIGNALS_PID31h" 232 "SIGNALS_PID33h_PEnv_pRaw" 233 "SIGNALS_PID34h_0" 234 "SIGNALS_PID34h_1" 235 "SIGNALS_PID3Ch" 236 "SIGNALS_PID42_BattU_uSens" 237 "SIGNALS_PID43h" 238 "SIGNALS_PID44h" 239 "SIGNALS_PID45h_ThrVlv_ratActSens1RelB1_u8" 240 "SIGNALS_PID46h" 241 "SIGNALS_PID47h_ThrVlv_ratActSens2AbsltB1_u8" 242 "SIGNALS_PID49_APP_uRaw1unLim" 243 "SIGNALS_PID4A_APP_uRaw2unLim" 244 "SIGNALS_PID4Ch_wdks_msg" 245 "SIGNALS_PID4FAh" 246 "SIGNALS_PID4FBh" 247 "SIGNALS_PID4FCh" 248 "SIGNALS_PID4FDh" 249 "SIGNALS_PID50Ah" 250 "SIGNALS_PID50Bh" 251 "SIGNALS_PID50Ch" 252 "SIGNALS_PID50Dh" 253 "SIGNALS_PID51h_PID51_stFuTyp" 254 "SIGNALS_PID56h_0" 255 "SIGNALS_PID5A_APP_rOBDPID5A" 256 "SIGNALS_PID5Fh" 257 "SIGNALS_PID62h_TME_ratActEngPercTqPrmIdH62" 258 "SIGNALS_IntFloat_PID63h_TqEngRef" 259 "SIGNALS_PID67h_ects2sva_msg" 260 "SIGNALS_PID67h_ects2svb_msg" 261 "SIGNALS_PID67h_ects2svc_msg" 262 "SIGNALS_PID68h_iats2svb" 263 "SIGNALS_PID68h_iats2svc" 264 "SIGNALS_PID68h_iats2svd" 265 "SIGNALS_PID68h_iats2sve" 266 "SIGNALS_PID68h_iats2svf" 267 "SIGNALS_PID68h_iats2svg" 268 "SIGNALS_PID7Fh_RTId_TotRt" 269 "SIGNALS_PID7Fh_RtId_TotIdleRt" 270 "SIGNALS_PID7Fh_RtId_TotPtoRt" 271 "SIGNALS_PID87h_PIntkVUs_pRawObd" 272 "SIGNALS_PID8BAh" 273 "SIGNALS_PID8CAh" 274 "SIGNALS_PID8Eh_TME_ratEngFricPercTqPrmIdH8E" 275 "SIGNALS_PID9AAh" 276 "SIGNALS_PID9Dh_InjSys_mfEngFuRate" 277 "SIGNALS_PID9Dh_InjSys_mfVehFuRate" 278 "SIGNALS_PID9FAh" 279 "SIGNALS_PIDA6h_lTotDst" 280 "SIGNALS_PID_FILLSIG_1BIT" 281 "SIGNALS_PID_FILLSIG_1BITNZ" 282 "SIGNALS_PID_FILLSIG_1BYTE" 283 "SIGNALS_PID_FILLSIG_1BYTENZ" 284 "SIGNALS_PID_FILLSIG_2BIT" 285 "SIGNALS_PID_FILLSIG_2BITNZ" 286 "SIGNALS_PID_FILLSIG_2BYTE" 287 "SIGNALS_PID_FILLSIG_2BYTENZ" 288 "SIGNALS_PID_FILLSIG_3BIT" 289 "SIGNALS_PID_FILLSIG_3BITNZ" 290 "SIGNALS_PID_FILLSIG_4BIT" 291 "SIGNALS_PID_FILLSIG_4BITNZ" 292 "SIGNALS_PID_FILLSIG_4BYTE" 293 "SIGNALS_PID_FILLSIG_4BYTENZ" 294 "SIGNALS_PID_FILLSIG_5BIT" 295 "SIGNALS_PID_FILLSIG_5BITNZ" 296 "SIGNALS_PID_FILLSIG_6BIT" 297 "SIGNALS_PID_FILLSIG_6BITNZ" 298 "SIGNALS_PID_FILLSIG_7BIT" 299 "SIGNALS_PID_FILLSIG_7BITNZ" 300 "SIGNALS_PIntkVUs_uRawUnFlt_signal" 301 "SIGNALS_PT_rGrip_signal" 302 "SIGNALS_PT_trqLos_signal" 303 "SIGNALS_PtCoornDyn_tqCluDes_signal" 304 "SIGNALS_PtCoornDyn_tqCluLeadTrsmIntv_signal" 305 "SIGNALS_PthLead_trqInrNoMon_s" 306 "SIGNALS_PthLead_trqInrNoMon_signal" 307 "SIGNALS_PthSet_trqInrIABef_s" 308 "SIGNALS_PthSet_trqInrLtd_s" 309 "SIGNALS_RngMod_trqDiffAdap_signal" 310 "SIGNALS_RngMod_trqInrBs_s" 311 "SIGNALS_TWCD_numMeasB1_s" 312 "SIGNALS_TWCD_rOSCAvrgPriB1_s" 313 "SIGNALS_ThrVlv_uRawSens1B1_signal" 314 "SIGNALS_ThrVlv_uRawSens2B1_signal" 315 "SIGNALS_TiEngOff_ti_signal" 316 "SIGNALS_UEGO_ratLamSrv1S1B1_signal" 317 "SIGNALS_VehStc_numFuDiagRecA_0_s" 318 "SIGNALS_VehStc_numFuDiagRecA_10_s" 319 "SIGNALS_VehStc_numFuDiagRecA_11_s" 320 "SIGNALS_VehStc_numFuDiagRecA_12_s" 321 "SIGNALS_VehStc_numFuDiagRecA_13_s" 322 "SIGNALS_VehStc_numFuDiagRecA_14_s" 323 "SIGNALS_VehStc_numFuDiagRecA_15_s" 324 "SIGNALS_VehStc_numFuDiagRecA_16_s" 325 "SIGNALS_VehStc_numFuDiagRecA_17_s" 326 "SIGNALS_VehStc_numFuDiagRecA_18_s" 327 "SIGNALS_VehStc_numFuDiagRecA_19_s" 328 "SIGNALS_VehStc_numFuDiagRecA_1_s" 329 "SIGNALS_VehStc_numFuDiagRecA_20_s" 330 "SIGNALS_VehStc_numFuDiagRecA_2_s" 331 "SIGNALS_VehStc_numFuDiagRecA_3_s" 332 "SIGNALS_VehStc_numFuDiagRecA_4_s" 333 "SIGNALS_VehStc_numFuDiagRecA_5_s" 334 "SIGNALS_VehStc_numFuDiagRecA_6_s" 335 "SIGNALS_VehStc_numFuDiagRecA_7_s" 336 "SIGNALS_VehStc_numFuDiagRecA_8_s" 337 "SIGNALS_VehStc_numFuDiagRecA_9_s" 338 "SIGNALS_VehStc_numMisfDetnHiEctA_0_s" 339 "SIGNALS_VehStc_numMisfDetnHiEctA_10_s" 340 "SIGNALS_VehStc_numMisfDetnHiEctA_11_s" 341 "SIGNALS_VehStc_numMisfDetnHiEctA_12_s" 342 "SIGNALS_VehStc_numMisfDetnHiEctA_13_s" 343 "SIGNALS_VehStc_numMisfDetnHiEctA_14_s" 344 "SIGNALS_VehStc_numMisfDetnHiEctA_15_s" 345 "SIGNALS_VehStc_numMisfDetnHiEctA_16_s" 346 "SIGNALS_VehStc_numMisfDetnHiEctA_17_s" 347 "SIGNALS_VehStc_numMisfDetnHiEctA_18_s" 348 "SIGNALS_VehStc_numMisfDetnHiEctA_19_s" 349 "SIGNALS_VehStc_numMisfDetnHiEctA_1_s" 350 "SIGNALS_VehStc_numMisfDetnHiEctA_20_s" 351 "SIGNALS_VehStc_numMisfDetnHiEctA_2_s" 352 "SIGNALS_VehStc_numMisfDetnHiEctA_3_s" 353 "SIGNALS_VehStc_numMisfDetnHiEctA_4_s" 354 "SIGNALS_VehStc_numMisfDetnHiEctA_5_s" 355 "SIGNALS_VehStc_numMisfDetnHiEctA_6_s" 356 "SIGNALS_VehStc_numMisfDetnHiEctA_7_s" 357 "SIGNALS_VehStc_numMisfDetnHiEctA_8_s" 358 "SIGNALS_VehStc_numMisfDetnHiEctA_9_s" 359 "SIGNALS_VehStc_numMisfDetnLoEctA_0_s" 360 "SIGNALS_VehStc_numMisfDetnLoEctA_10_s" 361 "SIGNALS_VehStc_numMisfDetnLoEctA_11_s" 362 "SIGNALS_VehStc_numMisfDetnLoEctA_12_s" 363 "SIGNALS_VehStc_numMisfDetnLoEctA_13_s" 364 "SIGNALS_VehStc_numMisfDetnLoEctA_14_s" 365 "SIGNALS_VehStc_numMisfDetnLoEctA_15_s" 366 "SIGNALS_VehStc_numMisfDetnLoEctA_16_s" 367 "SIGNALS_VehStc_numMisfDetnLoEctA_17_s" 368 "SIGNALS_VehStc_numMisfDetnLoEctA_18_s" 369 "SIGNALS_VehStc_numMisfDetnLoEctA_19_s" 370 "SIGNALS_VehStc_numMisfDetnLoEctA_1_s" 371 "SIGNALS_VehStc_numMisfDetnLoEctA_20_s" 372 "SIGNALS_VehStc_numMisfDetnLoEctA_2_s" 373 "SIGNALS_VehStc_numMisfDetnLoEctA_3_s" 374 "SIGNALS_VehStc_numMisfDetnLoEctA_4_s" 375 "SIGNALS_VehStc_numMisfDetnLoEctA_5_s" 376 "SIGNALS_VehStc_numMisfDetnLoEctA_6_s" 377 "SIGNALS_VehStc_numMisfDetnLoEctA_7_s" 378 "SIGNALS_VehStc_numMisfDetnLoEctA_8_s" 379 "SIGNALS_VehStc_numMisfDetnLoEctA_9_s" 380 "SIGNALS_VehStc_numMisfDetnNormA_0_s" 381 "SIGNALS_VehStc_numMisfDetnNormA_10_s" 382 "SIGNALS_VehStc_numMisfDetnNormA_11_s" 383 "SIGNALS_VehStc_numMisfDetnNormA_12_s" 384 "SIGNALS_VehStc_numMisfDetnNormA_13_s" 385 "SIGNALS_VehStc_numMisfDetnNormA_14_s" 386 "SIGNALS_VehStc_numMisfDetnNormA_15_s" 387 "SIGNALS_VehStc_numMisfDetnNormA_16_s" 388 "SIGNALS_VehStc_numMisfDetnNormA_17_s" 389 "SIGNALS_VehStc_numMisfDetnNormA_18_s" 390 "SIGNALS_VehStc_numMisfDetnNormA_19_s" 391 "SIGNALS_VehStc_numMisfDetnNormA_1_s" 392 "SIGNALS_VehStc_numMisfDetnNormA_20_s" 393 "SIGNALS_VehStc_numMisfDetnNormA_2_s" 394 "SIGNALS_VehStc_numMisfDetnNormA_3_s" 395 "SIGNALS_VehStc_numMisfDetnNormA_4_s" 396 "SIGNALS_VehStc_numMisfDetnNormA_5_s" 397 "SIGNALS_VehStc_numMisfDetnNormA_6_s" 398 "SIGNALS_VehStc_numMisfDetnNormA_7_s" 399 "SIGNALS_VehStc_numMisfDetnNormA_8_s" 400 "SIGNALS_VehStc_numMisfDetnNormA_9_s" 401 "SIGNALS_VehStc_rDiagRsltB1A_0_s" 402 "SIGNALS_VehStc_rDiagRsltB1A_1_s" 403 "SIGNALS_VehStc_rDiagRsltB1A_2_s" 404 "SIGNALS_VehStc_rDiagRsltB1A_3_s" 405 "SIGNALS_VehStc_rDiagRsltB1A_4_s" 406 "SIGNALS_VehV_a" 407 "SIGNALS_VehV_v" 408 "SIGNALS_VehV_vSens_signal" 409 "SIGNALS_flglrs_msg_s" 410 "SIGNALS_fra_w_msg_signal" 411 "SIGNALS_fra_w_s" 412 "SIGNALS_ftead_w_msg_s" 413 "SIGNALS_ftead_w_si" 414 "SIGNALS_ftead_w_signal" 415 "SIGNALS_lamsobd_w_msg_s" 416 "SIGNALS_lutskzyl_w_0_signal" 417 "SIGNALS_lutskzyl_w_1_signal" 418 "SIGNALS_lutskzyl_w_2_signal" 419 "SIGNALS_lutskzyl_w_3_signal" 420 "SIGNALS_lutskzyl_w_msg_0_signal" 421 "SIGNALS_lutskzyl_w_msg_1_signal" 422 "SIGNALS_lutskzyl_w_msg_2_signal" 423 "SIGNALS_lutskzyl_w_msg_3_signal" 424 "SIGNALS_ofmsndkh1_w_msg_signal" 425 "SIGNALS_ofmsndkh2_w_msg_signal" 426 "SIGNALS_ora_w_msg_signal" 427 "SIGNALS_tateout_w_msg_signal" 428 "SIGNALS_tateout_w_signal" 429 "SIGNALS_tatesoll_w_msg_signal" 430 "SIGNALS_tmst_signal" 431 "SIGNALS_wkratst_signal" 432 "SIGNALS_PID83h_A_BitCombineSignal" 433 "SIGNALS_PID9Bh_A_BitCombineSignal" 434 "SIGNALS_PIDA1h_A_BitCombineSignal" 435 "SIGNALS_PIDA7h_A_BitCombineSignal" 436 "SIGNALS_PIDA8h_A_BitCombineSignal" 437 "SIGNALS_Virtual_CEngDsT_uRaw_signal" 438 "SIGNALS_Virtual_DcmDspUDS_2600Byte06_signal" 439 "SIGNALS_Virtual_DcmDspUDS_2610Byte00_signal" 440 "SIGNALS_Virtual_DcmDspUDS_2610Byte01_signal" 441 "SIGNALS_Virtual_DcmDspUDS_2610Byte02_signal" 442 "SIGNALS_Virtual_DcmDspUDS_2610Byte03_signal" 443 "SIGNALS_Virtual_DcmDspUDS_2610Byte04_signal" 444 "SIGNALS_Virtual_DcmDspUDS_2610Byte05_signal" 445 "SIGNALS_Virtual_DcmDspUDS_2610Byte10_signal" 446 "SIGNALS_Virtual_DcmDspUDS_2610Byte1F_signal" 447 "SIGNALS_Virtual_DcmDspUDS_2610Byte20_signal" 448 "SIGNALS_Virtual_DcmDspUDS_2610Byte25_signal" 449 "SIGNALS_Virtual_DcmDspUDS_2610Byte26_signal" 450 "SIGNALS_Virtual_DcmDspUDS_2611Byte00_signal" 451 "SIGNALS_Virtual_DcmDspUDS_2611Byte01_signal" 452 "SIGNALS_Virtual_DcmDspUDS_2611Byte02_signal" 453 "SIGNALS_Virtual_DcmDspUDS_2611Byte03_signal" 454 "SIGNALS_Virtual_DcmDspUDS_2611Byte04_signal" 455 "SIGNALS_Virtual_DcmDspUDS_2611Byte05_signal" 456 "SIGNALS_Virtual_DcmDspUDS_2611Byte06_07_signal" 457 "SIGNALS_Virtual_DcmDspUDS_2611Byte2A_signal" 458 "SIGNALS_Virtual_DcmDspUDS_2611Byte2B_signal" 459 "SIGNALS_Virtual_DcmDspUDS_2612Byte00_signal" 460 "SIGNALS_Virtual_DcmDspUDS_2612Byte01_signal" 461 "SIGNALS_Virtual_DcmDspUDS_2612Byte02_signal" 462 "SIGNALS_Virtual_DcmDspUDS_2612Byte03_signal" 463 "SIGNALS_Virtual_DcmDspUDS_2612Byte04_signal" 464 "SIGNALS_Virtual_DcmDspUDS_2612Byte05_signal" 465 "SIGNALS_Virtual_DcmDspUDS_2612Byte14_signal" 466 "SIGNALS_Virtual_DcmDspUDS_2612Byte15_signal" 467 "SIGNALS_Virtual_DcmDspUDS_2612Byte16_signal" 468 "SIGNALS_Virtual_DcmDspUDS_2612Byte17_signal" 469 "SIGNALS_Virtual_DcmDspUDS_2612Byte29_signal" 470 "SIGNALS_Virtual_DcmDspUDS_2612Byte2A_signal" 471 "SIGNALS_Virtual_DcmDspUDS_2612Byte2B_signal" 472 "SIGNALS_Virtual_DcmDspUDS_2613Byte00_signal" 473 "SIGNALS_Virtual_DcmDspUDS_2613Byte01_signal" 474 "SIGNALS_Virtual_DcmDspUDS_2613Byte02_signal" 475 "SIGNALS_Virtual_DcmDspUDS_2613Byte03_signal" 476 "SIGNALS_Virtual_DcmDspUDS_2613Byte04_signal" 477 "SIGNALS_Virtual_DcmDspUDS_2613Byte05_signal" 478 "SIGNALS_Virtual_DcmDspUDS_2620Byte00_signal" 479 "SIGNALS_Virtual_DcmDspUDS_2620Byte01_signal" 480 "SIGNALS_Virtual_DcmDspUDS_2620Byte02_signal" 481 "SIGNALS_Virtual_DcmDspUDS_2620Byte03_signal" 482 "SIGNALS_Virtual_DcmDspUDS_2620Byte04_signal" 483 "SIGNALS_Virtual_DcmDspUDS_2620Byte05_signal" 484 "SIGNALS_Virtual_DcmDspUDS_2621Byte00_signal" 485 "SIGNALS_Virtual_DcmDspUDS_2621Byte01_signal" 486 "SIGNALS_Virtual_DcmDspUDS_2621Byte02_signal" 487 "SIGNALS_Virtual_DcmDspUDS_2621Byte03_signal" 488 "SIGNALS_Virtual_DcmDspUDS_2621Byte04_signal" 489 "SIGNALS_Virtual_DcmDspUDS_2621Byte05_signal" 490 "SIGNALS_Virtual_DcmDspUDS_2622Byte00_signal" 491 "SIGNALS_Virtual_DcmDspUDS_2622Byte01_signal" 492 "SIGNALS_Virtual_DcmDspUDS_2622Byte02_signal" 493 "SIGNALS_Virtual_DcmDspUDS_2622Byte03_signal" 494 "SIGNALS_Virtual_DcmDspUDS_2622Byte04_signal" 495 "SIGNALS_Virtual_DcmDspUDS_2622Byte05_signal" 496 "SIGNALS_Virtual_DcmDspUDS_2623Byte00_signal" 497 "SIGNALS_Virtual_DcmDspUDS_2623Byte01_signal" 498 "SIGNALS_Virtual_DcmDspUDS_2623Byte02_signal" 499 "SIGNALS_Virtual_DcmDspUDS_2623Byte03_signal" 500 "SIGNALS_Virtual_DcmDspUDS_2623Byte04_signal" 501 "SIGNALS_Virtual_DcmDspUDS_2623Byte05_signal" 502 "SIGNALS_Virtual_DcmDspUDS_2660Byte0_signal" 503 "SIGNALS_Virtual_DcmDspUDS_2660Byte15_signal" 504 "SIGNALS_Virtual_DcmDspUDS_2660Byte16_signal" 505 "SIGNALS_Virtual_DcmDspUDS_2660Byte17_signal" 506 "SIGNALS_Virtual_DcmDspUDS_2660Byte18_signal" 507 "SIGNALS_Virtual_DcmDspUDS_2660Byte19_signal" 508 "SIGNALS_Virtual_DcmDspUDS_2660Byte1A_signal" 509 "SIGNALS_Virtual_DcmDspUDS_2660Byte1B_signal" 510 "SIGNALS_Virtual_DcmDspUDS_2660Byte1C_signal" 511 "SIGNALS_Virtual_DcmDspUDS_2660Byte1D_signal" 512 "SIGNALS_Virtual_DcmDspUDS_2660Byte1E_signal" 513 "SIGNALS_Virtual_DcmDspUDS_2660Byte1_signal" 514 "SIGNALS_Virtual_DcmDspUDS_2660Byte2_signal" 515 "SIGNALS_Virtual_DcmDspUDS_2660Byte3_signal" 516 "SIGNALS_Virtual_DcmDspUDS_2660Byte4_signal" 517 "SIGNALS_Virtual_DcmDspUDS_2660Byte5_signal" 518 "SIGNALS_Virtual_DcmDspUDS_2660Byte6_signal" 519 "SIGNALS_Virtual_DcmDspUDS_2661Byte0A_signal" 520 "SIGNALS_Virtual_DcmDspUDS_2661Byte0B_signal" 521 "SIGNALS_Virtual_DcmDspUDS_2661Byte0C_signal" 522 "SIGNALS_Virtual_DcmDspUDS_2661Byte0D_signal" 523 "SIGNALS_Virtual_DcmDspUDS_2661Byte0E_signal" 524 "SIGNALS_Virtual_DcmDspUDS_2661Byte0F_signal" 525 "SIGNALS_Virtual_DcmDspUDS_2661Byte0_signal" 526 "SIGNALS_Virtual_DcmDspUDS_2661Byte1_signal" 527 "SIGNALS_Virtual_DcmDspUDS_2661Byte27_signal" 528 "SIGNALS_Virtual_DcmDspUDS_2661Byte2A_signal" 529 "SIGNALS_Virtual_DcmDspUDS_2661Byte2D_signal" 530 "SIGNALS_Virtual_DcmDspUDS_2661Byte2E_signal" 531 "SIGNALS_Virtual_DcmDspUDS_2661Byte2F_signal" 532 "SIGNALS_Virtual_DcmDspUDS_2661Byte2_signal" 533 "SIGNALS_Virtual_DcmDspUDS_2661Byte30_signal" 534 "SIGNALS_Virtual_DcmDspUDS_2661Byte31_signal" 535 "SIGNALS_Virtual_DcmDspUDS_2661Byte32_signal" 536 "SIGNALS_Virtual_DcmDspUDS_2661Byte35_signal" 537 "SIGNALS_Virtual_DcmDspUDS_2661Byte3_signal" 538 "SIGNALS_Virtual_DcmDspUDS_2661Byte4_signal" 539 "SIGNALS_Virtual_DcmDspUDS_2661Byte5_signal" 540 "SIGNALS_Virtual_DcmDspUDS_2661Byte6_signal" 541 "SIGNALS_Virtual_DcmDspUDS_2661Byte7_signal" 542 "SIGNALS_Virtual_DcmDspUDS_2661Byte8_signal" 543 "SIGNALS_Virtual_DcmDspUDS_2661Byte9_signal" 544 "SIGNALS_Virtual_DcmDspUDS_2662Byte0_signal" 545 "SIGNALS_Virtual_DcmDspUDS_2662Byte18_signal" 546 "SIGNALS_Virtual_DcmDspUDS_2662Byte19_signal" 547 "SIGNALS_Virtual_DcmDspUDS_2662Byte1_signal" 548 "SIGNALS_Virtual_DcmDspUDS_2662Byte2_signal" 549 "SIGNALS_Virtual_DcmDspUDS_2662Byte3_signal" 550 "SIGNALS_Virtual_DcmDspUDS_2662Byte4_signal" 551 "SIGNALS_Virtual_DcmDspUDS_2662Byte5_signal" 552 "SIGNALS_Virtual_DcmDspUDS_2663Byte0_signal" 553 "SIGNALS_Virtual_DcmDspUDS_2663Byte1_signal" 554 "SIGNALS_Virtual_DcmDspUDS_2663Byte2_signal" 555 "SIGNALS_Virtual_DcmDspUDS_2663Byte3_signal" 556 "SIGNALS_Virtual_DcmDspUDS_2663Byte4_signal" 557 "SIGNALS_Virtual_DcmDspUDS_2663Byte5_signal" 558 "SIGNALS_Virtual_DcmDspUDS_2664Byte0_signal" 559 "SIGNALS_Virtual_DcmDspUDS_2664Byte1_signal" 560 "SIGNALS_Virtual_DcmDspUDS_2664Byte25_signal" 561 "SIGNALS_Virtual_DcmDspUDS_2664Byte26_signal" 562 "SIGNALS_Virtual_DcmDspUDS_2664Byte2_signal" 563 "SIGNALS_Virtual_DcmDspUDS_2664Byte3_signal" 564 "SIGNALS_Virtual_DcmDspUDS_2664Byte4_signal" 565 "SIGNALS_Virtual_DcmDspUDS_2664Byte5_signal" 566 "SIGNALS_Virtual_DcmDspUDS_2664Byte6_signal" 567 "SIGNALS_Virtual_DcmDspUDS_2664Byte7_signal" 568 "SIGNALS_Virtual_DcmDspUDS_2665Byte0_signal" 569 "SIGNALS_Virtual_DcmDspUDS_2665Byte1_signal" 570 "SIGNALS_Virtual_DcmDspUDS_2665Byte2_signal" 571 "SIGNALS_Virtual_DcmDspUDS_2665Byte3_signal" 572 "SIGNALS_Virtual_DcmDspUDS_2665Byte4_signal" 573 "SIGNALS_Virtual_DcmDspUDS_2665Byte5_signal" 574 "SIGNALS_Virtual_DcmDspUDS_2668Byte0_signal" 575 "SIGNALS_Virtual_DcmDspUDS_2668Byte1B_signal" 576 "SIGNALS_Virtual_DcmDspUDS_2668Byte1_signal" 577 "SIGNALS_Virtual_DcmDspUDS_2668Byte2_signal" 578 "SIGNALS_Virtual_DcmDspUDS_2668Byte3_signal" 579 "SIGNALS_Virtual_DcmDspUDS_2668Byte4_signal" 580 "SIGNALS_Virtual_DcmDspUDS_2668Byte5_signal" 581 "SIGNALS_Virtual_DcmDspUDS_266CByte0_signal" 582 "SIGNALS_Virtual_DcmDspUDS_266CByte1_signal" 583 "SIGNALS_Virtual_DcmDspUDS_266CByte26_signal" 584 "SIGNALS_Virtual_DcmDspUDS_266CByte27_signal" 585 "SIGNALS_Virtual_DcmDspUDS_266CByte2_signal" 586 "SIGNALS_Virtual_DcmDspUDS_266CByte3_signal" 587 "SIGNALS_Virtual_DcmDspUDS_266CByte4_signal" 588 "SIGNALS_Virtual_DcmDspUDS_266CByte5_signal" 589 "SIGNALS_Virtual_DcmDspUDS_266DByte0_signal" 590 "SIGNALS_Virtual_DcmDspUDS_266DByte1_signal" 591 "SIGNALS_Virtual_DcmDspUDS_266DByte2_signal" 592 "SIGNALS_Virtual_DcmDspUDS_266DByte3_signal" 593 "SIGNALS_Virtual_DcmDspUDS_266DByte4_signal" 594 "SIGNALS_Virtual_DcmDspUDS_266DByte5_signal" 595 "SIGNALS_Virtual_DcmDspUDS_266FByte0_signal" 596 "SIGNALS_Virtual_DcmDspUDS_266FByte1_signal" 597 "SIGNALS_Virtual_DcmDspUDS_266FByte2_signal" 598 "SIGNALS_Virtual_DcmDspUDS_266FByte3_signal" 599 "SIGNALS_Virtual_DcmDspUDS_2673Byte0A_signal" 600 "SIGNALS_Virtual_DcmDspUDS_2673Byte0B_signal" 601 "SIGNALS_Virtual_DcmDspUDS_2673Byte0_signal" 602 "SIGNALS_Virtual_DcmDspUDS_2673Byte12_signal" 603 "SIGNALS_Virtual_DcmDspUDS_2673Byte13_signal" 604 "SIGNALS_Virtual_DcmDspUDS_2673Byte16_signal" 605 "SIGNALS_Virtual_DcmDspUDS_2673Byte17_signal" 606 "SIGNALS_Virtual_DcmDspUDS_2673Byte1E_signal" 607 "SIGNALS_Virtual_DcmDspUDS_2673Byte1F_signal" 608 "SIGNALS_Virtual_DcmDspUDS_2673Byte1_signal" 609 "SIGNALS_Virtual_DcmDspUDS_2673Byte2_signal" 610 "SIGNALS_Virtual_DcmDspUDS_2673Byte3_signal" 611 "SIGNALS_Virtual_DcmDspUDS_2673Byte4_signal" 612 "SIGNALS_Virtual_DcmDspUDS_2673Byte5_signal" 613 "SIGNALS_Virtual_DcmDspUDS_2673Byte6_signal" 614 "SIGNALS_Virtual_DcmDspUDS_2673Byte7_signal" 615 "SIGNALS_Virtual_DcmDspUDS_2676Byte0_signal" 616 "SIGNALS_Virtual_DcmDspUDS_2676Byte1_signal" 617 "SIGNALS_Virtual_DcmDspUDS_2676Byte2E_signal" 618 "SIGNALS_Virtual_DcmDspUDS_2676Byte2F_signal" 619 "SIGNALS_Virtual_DcmDspUDS_2676Byte2_signal" 620 "SIGNALS_Virtual_DcmDspUDS_2676Byte3_signal" 621 "SIGNALS_Virtual_DcmDspUDS_2676Byte4_signal" 622 "SIGNALS_Virtual_DcmDspUDS_2676Byte5_signal" 623 "SIGNALS_Virtual_DcmDspUDS_2676Byte6_signal" 624 "SIGNALS_Virtual_DcmDspUDS_2676Byte7_signal" 625 "SIGNALS_Virtual_DcmDspUDS_2676Byte8_signal" 626 "SIGNALS_Virtual_DcmDspUDS_2676Byte9_signal" 627 "SIGNALS_Virtual_DcmDspUDS_267BByte0_signal" 628 "SIGNALS_Virtual_DcmDspUDS_267BByte1_signal" 629 "SIGNALS_Virtual_DcmDspUDS_267BByte2_signal" 630 "SIGNALS_Virtual_DcmDspUDS_267BByte3_signal" 631 "SIGNALS_Virtual_DcmDspUDS_267BByte4_signal" 632 "SIGNALS_Virtual_DcmDspUDS_267BByte5_signal" 633 "SIGNALS_Virtual_DcmDspUDS_267EByte0_signal" 634 "SIGNALS_Virtual_DcmDspUDS_267EByte1_signal" 635 "SIGNALS_Virtual_DcmDspUDS_267EByte22_signal" 636 "SIGNALS_Virtual_DcmDspUDS_2680Byte00_signal" 637 "SIGNALS_Virtual_DcmDspUDS_2680Byte01_signal" 638 "SIGNALS_Virtual_DcmDspUDS_2680Byte02_signal" 639 "SIGNALS_Virtual_DcmDspUDS_2680Byte03_signal" 640 "SIGNALS_Virtual_DcmDspUDS_2680Byte04_signal" 641 "SIGNALS_Virtual_DcmDspUDS_2680Byte05_signal" 642 "SIGNALS_Virtual_DcmDspUDS_2680Byte08_signal" 643 "SIGNALS_Virtual_DcmDspUDS_2680Byte09_signal" 644 "SIGNALS_Virtual_DcmDspUDS_2680Byte0E_signal" 645 "SIGNALS_Virtual_DcmDspUDS_2680Byte0F_signal" 646 "SIGNALS_Virtual_DcmDspUDS_2681Byte00_signal" 647 "SIGNALS_Virtual_DcmDspUDS_2681Byte01_signal" 648 "SIGNALS_Virtual_DcmDspUDS_2681Byte02_signal" 649 "SIGNALS_Virtual_DcmDspUDS_2681Byte03_signal" 650 "SIGNALS_Virtual_DcmDspUDS_2681Byte04_signal" 651 "SIGNALS_Virtual_DcmDspUDS_2681Byte05_signal" 652 "SIGNALS_Virtual_DcmDspUDS_2681Byte0F_signal" 653 "SIGNALS_Virtual_DcmDspUDS_2681Byte10_signal" 654 "SIGNALS_Virtual_DcmDspUDS_2681Byte13_signal" 655 "SIGNALS_Virtual_DcmDspUDS_2681Byte14_signal" 656 "SIGNALS_Virtual_DcmDspUDS_2681Byte1D_signal" 657 "SIGNALS_Virtual_DcmDspUDS_2681Byte1E_signal" 658 "SIGNALS_Virtual_DcmDspUDS_2682Byte00_signal" 659 "SIGNALS_Virtual_DcmDspUDS_2682Byte01_signal" 660 "SIGNALS_Virtual_DcmDspUDS_2682Byte02_signal" 661 "SIGNALS_Virtual_DcmDspUDS_2682Byte03_signal" 662 "SIGNALS_Virtual_DcmDspUDS_2682Byte04_signal" 663 "SIGNALS_Virtual_DcmDspUDS_2682Byte05_signal" 664 "SIGNALS_Virtual_DcmDspUDS_2682Byte06_07_signal" 665 "SIGNALS_Virtual_DcmDspUDS_2682Byte08_09_signal" 666 "SIGNALS_Virtual_DcmDspUDS_2682Byte0E_signal" 667 "SIGNALS_Virtual_DcmDspUDS_2682Byte11_12_signal" 668 "SIGNALS_Virtual_DcmDspUDS_2682Byte13_14_signal" 669 "SIGNALS_Virtual_DcmDspUDS_2682Byte15_16_signal" 670 "SIGNALS_Virtual_DcmDspUDS_2682Byte18_19_signal" 671 "SIGNALS_Virtual_DcmDspUDS_2682Byte1B_signal" 672 "SIGNALS_Virtual_DcmDspUDS_2682Byte1C_signal" 673 "SIGNALS_Virtual_DcmDspUDS_268FByte00_signal" 674 "SIGNALS_Virtual_DcmDspUDS_268FByte01_signal" 675 "SIGNALS_Virtual_DcmDspUDS_268FByte02_signal" 676 "SIGNALS_Virtual_DcmDspUDS_268FByte03_signal" 677 "SIGNALS_Virtual_DcmDspUDS_268FByte04_signal" 678 "SIGNALS_Virtual_DcmDspUDS_268FByte05_signal" 679 "SIGNALS_Virtual_DcmDspUDS_268FByte0A_signal" 680 "SIGNALS_Virtual_DcmDspUDS_268FByte0B_signal" 681 "SIGNALS_Virtual_DcmDspUDS_268FByte0C_signal" 682 "SIGNALS_Virtual_DcmDspUDS_269AByte00_signal" 683 "SIGNALS_Virtual_DcmDspUDS_269AByte01_signal" 684 "SIGNALS_Virtual_DcmDspUDS_269AByte02_signal" 685 "SIGNALS_Virtual_DcmDspUDS_269AByte03_signal" 686 "SIGNALS_Virtual_DcmDspUDS_269AByte04_signal" 687 "SIGNALS_Virtual_DcmDspUDS_269AByte05_signal" 688 "SIGNALS_Virtual_DcmDspUDS_26A2Byte00_signal" 689 "SIGNALS_Virtual_DcmDspUDS_26A2Byte01_signal" 690 "SIGNALS_Virtual_DcmDspUDS_26A2Byte02_signal" 691 "SIGNALS_Virtual_DcmDspUDS_26A2Byte03_signal" 692 "SIGNALS_Virtual_DcmDspUDS_26A2Byte04_signal" 693 "SIGNALS_Virtual_DcmDspUDS_26A2Byte05_signal" 694 "SIGNALS_Virtual_DcmDspUDS_26A2Byte12_13_signal" 695 "SIGNALS_Virtual_DcmDspUDS_Acm_fzabgs_w_signal" 696 "SIGNALS_Virtual_DcmDspUDS_Acm_fzabgzyl_w_0_signal" 697 "SIGNALS_Virtual_DcmDspUDS_Acm_fzabgzyl_w_1_signal" 698 "SIGNALS_Virtual_DcmDspUDS_Acm_fzabgzyl_w_2_signal" 699 "SIGNALS_Virtual_DcmDspUDS_Acm_fzabgzyl_w_3_signal" 700 "SIGNALS_Virtual_DcmDspUDS_DID_E402Byte00_signal" 701 "SIGNALS_Virtual_DcmDspUDS_DID_E402Byte01_signal" 702 "SIGNALS_Virtual_DcmDspUDS_DID_E402Byte07to08_signal" 703 "SIGNALS_Virtual_DcmDspUDS_DID_E402Byte10to11_signal" 704 "SIGNALS_Virtual_DcmDspUDS_DID_E402Byte19to1A_signal" 705 "SIGNALS_Virtual_DcmDspUDS_DID_E402Byte22to23_signal" 706 "SIGNALS_Virtual_DcmDspUDS_DID_E402Byte2Bto2C_signal" 707 "SIGNALS_Virtual_DcmDspUDS_DID_F110Byte0_3_signal" 708 "SIGNALS_Virtual_DcmDspUDS_DID_F110Byte12_15_signal" 709 "SIGNALS_Virtual_DcmDspUDS_DID_F110Byte16_signal" 710 "SIGNALS_Virtual_DcmDspUDS_DID_F110Byte4_7_signal" 711 "SIGNALS_Virtual_DcmDspUDS_DID_F110Byte8_11_signal" 712 "SIGNALS_Virtual_DcmDspUDS_DID_F112Byte0_3_signal" 713 "SIGNALS_Virtual_DcmDspUDS_DID_F112Byte12_15_signal" 714 "SIGNALS_Virtual_DcmDspUDS_DID_F112Byte16_19_signal" 715 "SIGNALS_Virtual_DcmDspUDS_DID_F112Byte20_23_signal" 716 "SIGNALS_Virtual_DcmDspUDS_DID_F112Byte24_27_signal" 717 "SIGNALS_Virtual_DcmDspUDS_DID_F112Byte28_29_signal" 718 "SIGNALS_Virtual_DcmDspUDS_DID_F112Byte30_signal" 719 "SIGNALS_Virtual_DcmDspUDS_DID_F112Byte4_7_signal" 720 "SIGNALS_Virtual_DcmDspUDS_DID_F112Byte8_11_signal" 721 "SIGNALS_Virtual_DcmDspUDS_E602Byte2_signal" 722 "SIGNALS_Virtual_DcmDspUDS_F181Byte0_3_signal" 723 "SIGNALS_Virtual_DcmDspUDS_F181Byte12_15_signal" 724 "SIGNALS_Virtual_DcmDspUDS_F181Byte4_7_signal" 725 "SIGNALS_Virtual_DcmDspUDS_F181Byte8_11_signal" 726 "SIGNALS_Virtual_DcmDspUDS_fzabgs_w_signal" 727 "SIGNALS_Virtual_DcmDspUDS_fzabgzyl_w_0_signal" 728 "SIGNALS_Virtual_DcmDspUDS_fzabgzyl_w_1_signal" 729 "SIGNALS_Virtual_DcmDspUDS_fzabgzyl_w_2_signal" 730 "SIGNALS_Virtual_DcmDspUDS_fzabgzyl_w_3_signal" 731 "SIGNALS_Virtual_DcmDspUDS_numReWrECUID1_signal" 732 "SIGNALS_Virtual_DcmDspUDS_numReWrECUID2_signal" 733 "SIGNALS_Virtual_I14229B9_0490_FrNo09_signal" 734 "SIGNALS_Virtual_I14229B9_0490_FrNo10_signal" 735 "SIGNALS_Virtual_I14229B9_04B1_FrNo16_signal" 736 "SIGNALS_Virtual_I14229B9_04B1_FrNo17_signal" 737 "SIGNALS_Virtual_I14229B9_04B1_FrNo20_signal" 738 "SIGNALS_Virtual_I14229B9_04B1_FrNo21_signal" 739 "SIGNALS_Virtual_I14229B9_04B1_FrNo22_signal" 740 "SIGNALS_Virtual_I14229B9_04B1_FrNo23_signal" 741 "SIGNALS_Virtual_I14229B9_04C2_FrNo2021_signal" 742 "SIGNALS_Virtual_I14229B9_04D2_FrNo24_signal" 743 "SIGNALS_Virtual_I14229B9_04D2_FrNo25_signal" 744 "SIGNALS_Virtual_I14229B9_0520_FrNo15_signal" 745 "SIGNALS_Virtual_I14229B9_0520_FrNo16_signal" 746 "SIGNALS_Virtual_I14229B9_0523_FrNo42_signal" 747 "SIGNALS_Virtual_I14229B9_0523_FrNo43_signal" 748 "SIGNALS_Virtual_I14229B9_0524_FrNo09_signal" 749 "SIGNALS_Virtual_I14229B9_0524_FrNo10_signal" 750 "SIGNALS_Virtual_I14229B9_0550_FrNo09_signal" 751 "SIGNALS_Virtual_I14229B9_0550_FrNo10_signal" 752 "SIGNALS_Virtual_I14229B9_0553_FrNo13_signal" 753 "SIGNALS_Virtual_I14229B9_0553_FrNo14_signal" 754 "SIGNALS_Virtual_I14229B9_056A_FrNo8_signal" 755 "SIGNALS_Virtual_I14229B9_056A_FrNo9_signal" 756 "SIGNALS_Virtual_I14229B9_0588_FrNo15_signal" 757 "SIGNALS_Virtual_I14229B9_0588_FrNo16_signal" 758 "SIGNALS_Virtual_I14229B9_05A0_FrNo40_signal" 759 "SIGNALS_Virtual_I14229B9_05A0_FrNo41_signal" 760 "SIGNALS_Virtual_I14229B9_05B0_FrNo13_signal" 761 "SIGNALS_Virtual_I14229B9_05B0_FrNo14_signal" 762 "SIGNALS_Virtual_I14229B9_05C0_FrNo12_signal" 763 "SIGNALS_Virtual_I14229B9_05C0_FrNo13_signal" 764 "SIGNALS_Virtual_I14229B9_05E0_FrNo19_signal" 765 "SIGNALS_Virtual_I14229B9_05E0_FrNo20_signal" 766 "SIGNALS_Virtual_I14229B9_05E0_FrNo21_signal" 767 "SIGNALS_Virtual_I14229B9_05E0_FrNo22_signal" 768 "SIGNALS_Virtual_I14229B9_05E0_FrNo23_signal" 769 "SIGNALS_Virtual_I14229B9_05E0_FrNo24_signal" 770 "SIGNALS_Virtual_I14229B9_1208_FrNo34_signal" 771 "SIGNALS_Virtual_I14229B9_1208_FrNo35_signal" 772 "SIGNALS_Virtual_I14229B9_1208_FrNo36_signal" 773 "SIGNALS_Virtual_I14229B9_1208_FrNo37_signal" 774 "SIGNALS_Virtual_I14229B9_120A_FrNo09_signal" 775 "SIGNALS_Virtual_I14229B9_120A_FrNo10_signal" 776 "SIGNALS_Virtual_I14229B9_120B_FrNo09_signal" 777 "SIGNALS_Virtual_I14229B9_120B_FrNo10_signal" 778 "SIGNALS_Virtual_I14229_AirC_pAnaClnt_signal" 779 "SIGNALS_Virtual_I14229_EpmCaS_ctErrSig2_signal" 780 "SIGNALS_Virtual_I14229_pEngSrtMin_signal" 781 "SIGNALS_Virtual_I14229_wdkba_w_signal" 782 "SIGNALS_Virtual_Tra_numGear_signal" /end COMPU_VTAB
/begin COMPU_METHOD TransR "" RAT_FUNC "%6.4" "-" COEFFS 0 100 0 0 0 1 /end COMPU_METHOD
/begin RECORD_LAYOUT RB_Val_Ws16 FNC_VALUES 1 SWORD COLUMN_DIR DIRECT /end RECORD_LAYOUT
/begin RECORD_LAYOUT ValA_Wu16 FNC_VALUES 1 UWORD COLUMN_DIR DIRECT /end RECORD_LAYOUT
/begin RECORD_LAYOUT ValA_Wu8 FNC_VALUES 1 UBYTE COLUMN_DIR DIRECT /end RECORD_LAYOUT
/begin RECORD_LAYOUT Val_Wu16 FNC_VALUES 1 UWORD COLUMN_DIR DIRECT /end RECORD_LAYOUT
/begin RECORD_LAYOUT Val_Wu32 FNC_VALUES 1 ULONG COLUMN_DIR DIRECT /end RECORD_LAYOUT
/begin RECORD_LAYOUT Val_Wu8 FNC_VALUES 1 UBYTE COLUMN_DIR DIRECT /end RECORD_LAYOUT
/end MODULE
/end PROJECT
