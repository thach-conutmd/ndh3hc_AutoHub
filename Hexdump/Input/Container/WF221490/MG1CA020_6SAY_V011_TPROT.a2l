ASAP2_VERSION 1 60
/begin PROJECT MG1CA020 "MG1CA020"
/begin HEADER "" VERSION "MG1CA020_6SAY_V011_TPROT" PROJECT_NO MG1CA020 /end HEADER
/begin MODULE DIM ""
/begin MOD_COMMON "" BYTE_ORDER MSB_LAST ALIGNMENT_BYTE 1 ALIGNMENT_WORD 2 ALIGNMENT_LONG 4 ALIGNMENT_INT64 4 ALIGNMENT_FLOAT32_IEEE 4 ALIGNMENT_FLOAT64_IEEE 4 DATA_SIZE 32 /end MOD_COMMON
/begin CHARACTERISTIC Com_lDistShipModLim_C "Calibration for total travel distance limitation of Shipping mode" VALUE 0x80525088 Val_Ws32 4294967295.00 OilMlg -2147483648.00 2147483647.00 FORMAT "%13.2" /end CHARACTERISTIC
/begin CHARACTERISTIC Com_lDstDCLim_C "Driving distance of 1Dc is reached to limitation" VALUE 0x8052508C Val_Ws32 4294967295.00 OilMlg -2147483648.00 2147483647.00 FORMAT "%13.2" /end CHARACTERISTIC
/begin CHARACTERISTIC Com_lDstShipMod_C "Travel distance for Shipping mode" VALUE 0x80525090 Val_Ws32 4294967295.00 OilMlg -2147483648.00 2147483647.00 FORMAT "%13.2" /end CHARACTERISTIC
/begin CHARACTERISTIC Com_tiOdoDly_C "Delay timer to ensure odometer value from meter unit" VALUE 0x80525094 RB_Val_Wu16 655350.0 Time_ms 0.00 655350.0 FORMAT "%8.1" /end CHARACTERISTIC
/begin CHARACTERISTIC CWTATETEV "Codewort CWTEATEV" VALUE 0x80525054 RB_Val_Wu8 255.0 dez 0.00 255.0 FORMAT "%5.1" /end CHARACTERISTIC
/begin CHARACTERISTIC FPCtl_stCpvDiPs_C "state of CPV Disable Powerstage" VALUE 0x80525056 RB_Val_Wu16 65535.00 OneToOne 0.00 65535.00 FORMAT "%8.2" /end CHARACTERISTIC
/begin CHARACTERISTIC HLSDem_aLASMax_C "Maximum allowed vehicle acceleration for the release of the vehicle acceleration dependent low idle speed setpoint offset" VALUE 0x805244A8 RB_Val_Ws16 65.53500 Acc -32.76800 32.76700 FORMAT "%8.5" /end CHARACTERISTIC
/begin CHARACTERISTIC HLSDem_aLASMin_C "Minimum allowed vehicle acceleration for the release of the vehicle acceleration dependent low idle speed setpoint offset" VALUE 0x805244AA RB_Val_Ws16 65.53500 Acc -32.76800 32.76700 FORMAT "%8.5" /end CHARACTERISTIC
/begin CHARACTERISTIC HLSDem_dKnCtlSlopNeg_C "Negative slope for limitation in case of active safety ignition retardation" VALUE 0x805247F8 RB_Val_Wu16 32767.50 EngNGrd 0.00 32767.50 FORMAT "%8.2" /end CHARACTERISTIC
/begin CHARACTERISTIC HLSDem_dKnCtlSlopPos_C "Positive slope for limitation in case of active safety ignition retardation" VALUE 0x805247FA RB_Val_Wu16 32767.50 EngNGrd 0.00 32767.50 FORMAT "%8.2" /end CHARACTERISTIC
/begin CHARACTERISTIC HLSDem_dNDrvOffSlopNeg_C "Negative engine-speed slope for overspeed limitation at drive-off" VALUE 0x805247FC RB_Val_Wu16 32767.50 EngNGrd 0.00 32767.50 FORMAT "%8.2" /end CHARACTERISTIC
/begin CHARACTERISTIC HLSDem_dNDrvOffSlopPos_C "Positive engine-speed slope for overspeed limitation at drive-off" VALUE 0x805247FE RB_Val_Wu16 32767.50 EngNGrd 0.00 32767.50 FORMAT "%8.2" /end CHARACTERISTIC
/begin CHARACTERISTIC HLSDem_dNDrvOffTractPlsSlopNeg_C "Negative engine-speed slope for overspeed limitation at drive-off with TractIon Plus" VALUE 0x80524800 RB_Val_Wu16 32767.50 EngNGrd 0.00 32767.50 FORMAT "%8.2" /end CHARACTERISTIC
/begin CHARACTERISTIC HLSDem_dNDrvOffTractPlsSlopPos_C "Positive engine-speed slope for overspeed limitation at drive-off with TractIon Plus" VALUE 0x80524802 RB_Val_Wu16 32767.50 EngNGrd 0.00 32767.50 FORMAT "%8.2" /end CHARACTERISTIC
/begin CHARACTERISTIC HLSDem_dnGradCVT_C "Minimum descent of engine speed limitation in drag indicator in case of CVT gearboxes" VALUE 0x80524F10 RB_Val_Ws16 32767.50 EngN -16384.00 16383.50 FORMAT "%8.2" /end CHARACTERISTIC
/begin CHARACTERISTIC HLSDem_dnGradLim_C "Maximum reduction of engine speed with drag indicator activ" VALUE 0x80524F12 RB_Val_Ws16 32767.50 EngN -16384.00 16383.50 FORMAT "%8.2" /end CHARACTERISTIC
/begin CHARACTERISTIC HLSDem_dnHiDrgThres_C "Necessary speed reduction to enable the drag indicator" VALUE 0x80524F14 RB_Val_Ws16 32767.50 EngN -16384.00 16383.50 FORMAT "%8.2" /end CHARACTERISTIC
/begin CHARACTERISTIC HLSDem_dnRmpNeg_MAP "Permissible reduction of engine speed limit per calculation step" MAP 0x80524F16 RB_Map_S16S16_S16 65535.00 OneToOne -32768.00 32767.00 FORMAT "%8.2"
 /begin AXIS_DESCR STD_AXIS HLSDem_dnMaxEng EngN 5 -16384.00 16383.50 FORMAT "%8.2" DEPOSIT ABSOLUTE /end AXIS_DESCR
 /begin AXIS_DESCR STD_AXIS PT_rTrq TransR 3 -327.6800 327.6700 FORMAT "%8.4" DEPOSIT ABSOLUTE /end AXIS_DESCR
/end CHARACTERISTIC
/begin CHARACTERISTIC HLSDem_dnRmpPos_C "Permissible increase of engine speed limit per calculation step" VALUE 0x80524F48 RB_Val_Ws32 32767999.9924 RmpEngN -16384000.0000 16383999.9924 FORMAT "%13.4" /end CHARACTERISTIC
/begin CHARACTERISTIC HLSDem_dpMstCylBrkRightHysDelta_C "Threshold for the hysteresis used for the slope of the master cylinder pressure for the activation of drive-off support" VALUE 0x805244AC RB_Val_Ws16 6553500. PreshPa_10ms -3276800. 3276700. FORMAT "%8.0" /end CHARACTERISTIC
/begin CHARACTERISTIC HLSDem_drClthHysMax_C "Derivative upper threshold to enable drive off support in hysteresis" VALUE 0x805244AE RB_Val_Ws16 255.9961 Prc_Fact256 -128.0000 127.9961 FORMAT "%8.4" /end CHARACTERISTIC
/begin CHARACTERISTIC HLSDem_drClthHysMin_C "Derivative lower threshold to enable drive off support in hysteresis" VALUE 0x805244B0 RB_Val_Ws16 255.9961 Prc_Fact256 -128.0000 127.9961 FORMAT "%8.4" /end CHARACTERISTIC
/begin CHARACTERISTIC HLSDem_DrvOffSuprtMstCyldp_CUR "master cylinder brake pressure gradient" CURVE 0x805244B2 RB_Curve_S16_S16 6553500. PreshPa_10ms -3276800. 3276700. FORMAT "%8.0"
 /begin AXIS_DESCR STD_AXIS HLSDem_pMstCylBrk p_ub_q10 6 -327680.0 327670.0 FORMAT "%8.1" DEPOSIT ABSOLUTE /end AXIS_DESCR
/end CHARACTERISTIC
/begin CHARACTERISTIC HLSDem_DrvOffSuprtRampHiGrdtNegSlop_C "Negative slope parameter for the drive-off setpoint ramp when the vehicle speed is above a threshold" VALUE 0x805244CC RB_Val_Ws32 32767999.9924 RmpEngN -16384000.0000 16383999.9924 FORMAT "%13.4" /end CHARACTERISTIC
/begin CHARACTERISTIC HLSDem_DrvOffSuprtRampHiGrdtPosSlop_C "Positive slope parameter for the drive-off setpoint ramp when the vehicle speed is above a threshold" VALUE 0x805244D0 RB_Val_Ws32 32767999.9924 RmpEngN -16384000.0000 16383999.9924 FORMAT "%13.4" /end CHARACTERISTIC
/begin CHARACTERISTIC HLSDem_DrvOffSuprtRampLoGrdtNegSlop_C "Negative slope parameter for the drive-off setpoint ramp when the vehicle speed is below a threshold" VALUE 0x805244D4 RB_Val_Ws32 32767999.9924 RmpEngN -16384000.0000 16383999.9924 FORMAT "%13.4" /end CHARACTERISTIC
/begin CHARACTERISTIC HLSDem_DrvOffSuprtRampLoGrdtPosSlop_C "Positive slope parameter for the drive-off setpoint ramp when the vehicle speed is below a threshold" VALUE 0x805244D8 RB_Val_Ws32 32767999.9924 RmpEngN -16384000.0000 16383999.9924 FORMAT "%13.4" /end CHARACTERISTIC
/begin CHARACTERISTIC HLSDem_DrvOffSuprtSpIncrNeg_C "Negetive ramp parameter for driveoff setpoint increase" VALUE 0x805244DC RB_Val_Ws16 32767.50 nmot_sw_q0p5 -16384.00 16383.50 FORMAT "%8.2" /end CHARACTERISTIC
/begin CHARACTERISTIC HLSDem_DrvOffSuprtSpIncrPos_C "Positive ramp parameter for driveoff setpoint increase" VALUE 0x805244DE RB_Val_Ws16 32767.50 nmot_sw_q0p5 -16384.00 16383.50 FORMAT "%8.2" /end CHARACTERISTIC
/begin CHARACTERISTIC HLSDem_dtOilHys_C "Delta temperature to calculate the upper limit of the the hysterisis , for the calculation of oil temperature." VALUE 0x80524804 RB_Val_Ws16 6553.500 Temp_Cels -3549.940 3003.560 FORMAT "%8.3" /end CHARACTERISTIC
/begin CHARACTERISTIC HLSDem_dtWrmHys_C "Delta temperature for the hysteresis in the calculation of warm up status." VALUE 0x80524806 RB_Val_Ws16 6553.500 Temp_Cels -3549.940 3003.560 FORMAT "%8.3" /end CHARACTERISTIC
/begin CHARACTERISTIC HLSDem_facAirOvhtPrv_MAP "Weighting factor for NMAX-limitation, dependent on intake air temperature" MAP 0x80524808 RB_Map_S16S16_S16 7.999878 Fact -4.000000 3.999878 FORMAT "%8.6"
 /begin AXIS_DESCR STD_AXIS HLSDem_tAir_mp Temp_Cels 8 -3549.940 3003.560 FORMAT "%8.3" DEPOSIT ABSOLUTE /end AXIS_DESCR
 /begin AXIS_DESCR STD_AXIS Epm_nEng EngN 8 -16384.00 16383.50 FORMAT "%8.2" DEPOSIT ABSOLUTE /end AXIS_DESCR
/end CHARACTERISTIC
/begin CHARACTERISTIC HLSDem_facCTOvhtPrvMax_MAP "Weighting factor for NMAX-limitation, dependent on temperature of coolant medium" MAP 0x805248AC RB_Map_S16S16_S16 7.999878 Fact -4.000000 3.999878 FORMAT "%8.6"
 /begin AXIS_DESCR STD_AXIS CEngDsT_t Temp_Cels 8 -3549.940 3003.560 FORMAT "%8.3" DEPOSIT ABSOLUTE /end AXIS_DESCR
 /begin AXIS_DESCR STD_AXIS VehV_v Vel 8 -327.6800 327.6700 FORMAT "%8.4" DEPOSIT ABSOLUTE /end AXIS_DESCR
/end CHARACTERISTIC
/begin CHARACTERISTIC HLSDem_facDrvOffCouplSprtOffs_C "Factor for coupling condition offset for drive off support for sport mode" VALUE 0x805244E0 RB_Val_Wu8 25.50 Fact_q0p1_COMPU 0.00 25.50 FORMAT "%5.2" /end CHARACTERISTIC
/begin CHARACTERISTIC HLSDem_facDrvOffDeadZoneSprtOffs_C "Factor for Accelerator dead way condition offset for drive off support for sport mode" VALUE 0x805244E1 RB_Val_Wu8 25.50 Fact_q0p1_COMPU 0.00 25.50 FORMAT "%5.2" /end CHARACTERISTIC
/begin CHARACTERISTIC HLSDem_facDrvOffGearRat_CUR "Clutch-slip dependent curve for a factor for the calculation of the low idle speed setpoint offset in the case of a non-analogous clutch sensor" CURVE 0x805244E2 RB_Curve_S16_S16 7.999878 Fact -4.000000 3.999878 FORMAT "%8.6"
 /begin AXIS_DESCR STD_AXIS HLSDem_rGearDrvOffFlt Fact_10000 8 -3.276800 3.276700 FORMAT "%8.6" DEPOSIT ABSOLUTE /end AXIS_DESCR
/end CHARACTERISTIC
/begin CHARACTERISTIC HLSDem_facDrvOffsLAS_CUR "Vehicle acceleration dependent curve for a factor for the calculation of the low idle speed setpoint offset in the case of a non-analogous clutch sensor" CURVE 0x80524504 RB_Curve_S16_S16 7.999878 Fact -4.000000 3.999878 FORMAT "%8.6"
 /begin AXIS_DESCR STD_AXIS LAS_a Acc 8 -32.76800 32.76700 FORMAT "%8.5" DEPOSIT ABSOLUTE /end AXIS_DESCR
/end CHARACTERISTIC
/begin CHARACTERISTIC HLSDem_facDrvOffSuprtSprtOffs_C "Factor for Drive-Off Condition offset for drive off support for sport mode" VALUE 0x80524526 RB_Val_Wu8 25.50 Fact_q0p1_COMPU 0.00 25.50 FORMAT "%5.2" /end CHARACTERISTIC
/begin CHARACTERISTIC HLSDem_facFlTempMax_MAP "Weighting factor for NMAX-limitation, dependent on fuel temperature" MAP 0x80524950 RB_Map_S16S16_S16 7.999878 Fact -4.000000 3.999878 FORMAT "%8.6"
 /begin AXIS_DESCR STD_AXIS FuelT_t Temp_Cels 8 -3549.940 3003.560 FORMAT "%8.3" DEPOSIT ABSOLUTE /end AXIS_DESCR
 /begin AXIS_DESCR STD_AXIS Epm_nEng EngN 8 -16384.00 16383.50 FORMAT "%8.2" DEPOSIT ABSOLUTE /end AXIS_DESCR
/end CHARACTERISTIC
/begin CHARACTERISTIC HLSDem_facOffsAppDeadZoneNorm_C "Factor for Accelerator dead way condition offset for drive off support for normal mode" VALUE 0x80524527 RB_Val_Wu8 25.50 Fact_q0p1_COMPU 0.00 25.50 FORMAT "%5.2" /end CHARACTERISTIC
/begin CHARACTERISTIC HLSDem_facOffsCouplNorm_C "Factor for coupling condition offset for drive off support for normal mode" VALUE 0x80524528 RB_Val_Wu8 25.50 Fact_q0p1_COMPU 0.00 25.50 FORMAT "%5.2" /end CHARACTERISTIC
/begin CHARACTERISTIC HLSDem_facOffsDrvOffClthKisspnt_CUR "Factor for the offset of the low idle speed setpoint in dependency of the deviation of the analog clutch signal from modified kiss point" CURVE 0x8052452A RB_Curve_S16_S16 7.999878 Fact -4.000000 3.999878 FORMAT "%8.6"
 /begin AXIS_DESCR STD_AXIS HLSDem_rClthKisspntDiff Prc_Fact256 8 -128.0000 127.9961 FORMAT "%8.4" DEPOSIT ABSOLUTE /end AXIS_DESCR
/end CHARACTERISTIC
/begin CHARACTERISTIC HLSDem_facOffsDrvOffNorm_C "Factor for Drive-Off Condition offset for drive off support for normal mode" VALUE 0x8052454C RB_Val_Wu8 25.50 Fact_q0p1_COMPU 0.00 25.50 FORMAT "%5.2" /end CHARACTERISTIC
/begin CHARACTERISTIC HLSDem_facOffsDrvOffPhiCorr_CUR "Road gradient dependent curve for a factor for the calculation of the low idle speed setpoint offset" CURVE 0x8052454E RB_Curve_S16_S16 7.999878 Fact -4.000000 3.999878 FORMAT "%8.6"
 /begin AXIS_DESCR STD_AXIS LAS_facRoadGrdt Prc_Fact100 8 -327.6800 327.6700 FORMAT "%8.4" DEPOSIT ABSOLUTE /end AXIS_DESCR
/end CHARACTERISTIC
/begin CHARACTERISTIC HLSDem_facOffsDrvOff_CUR "Factor due to clutch pedal speed release" CURVE 0x80524570 RB_Curve_S16_S16 7.999878 Fact -4.000000 3.999878 FORMAT "%8.6"
 /begin AXIS_DESCR STD_AXIS Clth_drFlt Prc_Fact256 8 -128.0000 127.9961 FORMAT "%8.4" DEPOSIT ABSOLUTE /end AXIS_DESCR
/end CHARACTERISTIC
/begin CHARACTERISTIC HLSDem_facOffsEnvtlPCorrn_T "Environmental pressure dependent correction offset factor for the drive-off suport of MT vehicles" CURVE 0x80524592 RB_Curve_S16_S16 7.999878 Fact -4.000000 3.999878 FORMAT "%8.6"
 /begin AXIS_DESCR STD_AXIS EnvP_p Pres_hPa 4 -32768.00 32767.00 FORMAT "%8.2" DEPOSIT ABSOLUTE /end AXIS_DESCR
/end CHARACTERISTIC
/begin CHARACTERISTIC HLSDem_facOilOvhtPrvMax_MAP "Weighting factor for NMAX-limitation, dependent on oil temperature" MAP 0x805249F4 RB_Map_S16S16_S16 7.999878 Fact -4.000000 3.999878 FORMAT "%8.6"
 /begin AXIS_DESCR STD_AXIS HLSDem_tOil Temp_Cels 8 -3549.940 3003.560 FORMAT "%8.3" DEPOSIT ABSOLUTE /end AXIS_DESCR
 /begin AXIS_DESCR STD_AXIS Epm_nEng EngN 8 -16384.00 16383.50 FORMAT "%8.2" DEPOSIT ABSOLUTE /end AXIS_DESCR
/end CHARACTERISTIC
/begin CHARACTERISTIC HLSDem_facOvhtThresGovHi_C "Upper threshold limit for NMAX-limitation due to temperature for governor." VALUE 0x80524A98 RB_Val_Ws16 7.999878 Fact -4.000000 3.999878 FORMAT "%8.6" /end CHARACTERISTIC
/begin CHARACTERISTIC HLSDem_facOvhtThresGovLo_C "Lower threshold limit for NMAX-limitation due to temperature for governor." VALUE 0x80524A9A RB_Val_Ws16 7.999878 Fact -4.000000 3.999878 FORMAT "%8.6" /end CHARACTERISTIC
/begin CHARACTERISTIC HLSDem_facOvhtThresHi_C "Upper threshold limit for NMAX-limitation due to temperature" VALUE 0x80524A9C RB_Val_Ws16 7.999878 Fact -4.000000 3.999878 FORMAT "%8.6" /end CHARACTERISTIC
/begin CHARACTERISTIC HLSDem_facOvhtThresLo_C "Lower threshold limit for NMAX-limitation due to temperature" VALUE 0x80524A9E RB_Val_Ws16 7.999878 Fact -4.000000 3.999878 FORMAT "%8.6" /end CHARACTERISTIC
/begin CHARACTERISTIC HLSDem_facRvsGearCreepSp_C "Factor of creep setpoint when reverse gear is engaged" VALUE 0x805245A4 RB_Val_Wu8 12.75 fak_q0p05 0.00 12.75 FORMAT "%5.2" /end CHARACTERISTIC
/begin CHARACTERISTIC HLSDem_facRvsGearDrvOffSp_C "Factor of drive off (MT or CVT) setpoint when reverse gear is engaged" VALUE 0x805245A5 RB_Val_Wu8 12.75 fak_q0p05 0.00 12.75 FORMAT "%5.2" /end CHARACTERISTIC
/begin CHARACTERISTIC HLSDem_facRvsGearKissPntSp_C "Factor of kiss point setpoint when reverse gear is engaged" VALUE 0x805245A6 RB_Val_Wu8 12.75 fak_q0p05 0.00 12.75 FORMAT "%5.2" /end CHARACTERISTIC
/begin CHARACTERISTIC HLSDem_facSpIncrKissPnt_T "Factor for kiss-point setpoint calculation" CURVE 0x805245A8 RB_Curve_S16_S16 7.999878 Fact -4.000000 3.999878 FORMAT "%8.6"
 /begin AXIS_DESCR STD_AXIS VehV_v Vel 6 -327.6800 327.6700 FORMAT "%8.4" DEPOSIT ABSOLUTE /end AXIS_DESCR
/end CHARACTERISTIC
/begin CHARACTERISTIC HLSDem_flgChkClthStandStill_C "Enabling of clutch state for activation of engine-speed limitation by vehicle standstill to protect the engine and the clutch" VALUE 0x80524AA0 RB_Val_Wu8 1.00000000000 B_TRUE 0.00 1.00000000000 FORMAT "%13.11" /end CHARACTERISTIC
/begin CHARACTERISTIC HLSDem_flgGearNeutralPosSelnMT_C "Calibration to activate or deactivate gear neautral position condition in MT" VALUE 0x805245C2 RB_Val_Wboolean 1.00000000000 B_TRUE 0.00 1.00000000000 FORMAT "%13.11" /end CHARACTERISTIC
/begin CHARACTERISTIC HLSDem_flgNoGripActv_C "Parameter to switch between standstll conditions" VALUE 0x80524AA1 RB_Val_Wu8 1.00000000000 B_TRUE 0.00 1.00000000000 FORMAT "%13.11" /end CHARACTERISTIC
/begin CHARACTERISTIC HLSDem_flgSelBrkHldSysActvCdn_C "calibration to enable driveoff setpoint during brake hold system active" VALUE 0x805245C3 RB_Val_Wboolean 1.00000000000 B_TRUE 0.00 1.00000000000 FORMAT "%13.11" /end CHARACTERISTIC
/begin CHARACTERISTIC HLSDem_hOvhtHysLimLe_C "Hysteresis engine speed limitation because engine component overheat - left limit" VALUE 0x80524E54 RB_Val_Wu16 98302.50 h_uw_q1p5 0.00 98302.50 FORMAT "%8.2" /end CHARACTERISTIC
/begin CHARACTERISTIC HLSDem_hOvhtHysLimRht_C "Hysteresis engine speed limitation because engine component overheat - right limit" VALUE 0x80524E56 RB_Val_Wu16 98302.50 h_uw_q1p5 0.00 98302.50 FORMAT "%8.2" /end CHARACTERISTIC
/begin CHARACTERISTIC HLSDem_nAcsLimThres_C "Engine speed threshold for a limitation in the drive train, which is considered valid" VALUE 0x80524F4C RB_Val_Ws16 32767.50 EngN -16384.00 16383.50 FORMAT "%8.2" /end CHARACTERISTIC
/begin CHARACTERISTIC HLSDem_nDeltaDrvOffRst_C "Delta to non-Drive-Off engine speed limitation for switching off limitation" VALUE 0x80524AA2 RB_Val_Ws16 16383.50 EngN 0.00 16383.50 FORMAT "%8.2" EXTENDED_LIMITS -16384.00 16383.50 /end CHARACTERISTIC
/begin CHARACTERISTIC HLSDem_nDrvOffSuprtAbsltSpMT_CUR "engine temperature dependent drive off support offset" CURVE 0x805245C4 RB_Curve_U8_S16_Static 32767.50 nmot_sw_q0p5 -16384.00 16383.50 FORMAT "%8.2"
 /begin AXIS_DESCR STD_AXIS tmot temp_ub_q0p75_o48 8 -48.0 143.3 FORMAT "%5.1" DEPOSIT ABSOLUTE /end AXIS_DESCR
/end CHARACTERISTIC
/begin CHARACTERISTIC HLSDem_nDrvOffSuprtAbsltSp_MAP "Characteristic MAP for unfiltered low idle speed setpoint for drive-off support when HLSDem_swtDrvOffSuprtSpMod_C == 1" MAP 0x805245DE RB_Map_S16U8_S16 32767.50 nmot_sw_q0p5 -16384.00 16383.50 FORMAT "%8.2"
 /begin AXIS_DESCR STD_AXIS HLSDem_pMstCylBrk p_ub_q10 8 -327680.0 327670.0 FORMAT "%8.1" DEPOSIT ABSOLUTE /end AXIS_DESCR
 /begin AXIS_DESCR STD_AXIS tmot temp_ub_q0p75_o48 8 -48.0 143.3 FORMAT "%5.1" DEPOSIT ABSOLUTE /end AXIS_DESCR
/end CHARACTERISTIC
/begin CHARACTERISTIC HLSDem_nDrvOffSuprtOffs_CUR "Curve for the offset of the low-idle setpoint (used when HLSDem_swtDrvOffSuprtSpMod_C == 0)" CURVE 0x8052467A RB_Curve_S16_S16 32767.50 nmot_sw_q0p5 -16384.00 16383.50 FORMAT "%8.2"
 /begin AXIS_DESCR STD_AXIS HLSDem_pMstCylBrk p_ub_q10 10 -327680.0 327670.0 FORMAT "%8.1" DEPOSIT ABSOLUTE /end AXIS_DESCR
/end CHARACTERISTIC
/begin CHARACTERISTIC HLSDem_nDrvOffSuprtSpIncr_C "Calibration parameter for Drvoff support setpoint increase" VALUE 0x805246A4 RB_Val_Ws16 32767.50 nmot_sw_q0p5 -16384.00 16383.50 FORMAT "%8.2" /end CHARACTERISTIC
/begin CHARACTERISTIC HLSDem_nDrvOffSuprtSpIncr_M "Calibration parameter for Drvoff support setpoint increase(tmot, fho)" MAP 0x805246A6 RB_Map_U8U8_S16 32767.50 nmot_sw_q0p5 -16384.00 16383.50 FORMAT "%8.2"
 /begin AXIS_DESCR STD_AXIS tmot temp_ub_q0p75_o48 6 -48.0 143.3 FORMAT "%5.1" DEPOSIT ABSOLUTE /end AXIS_DESCR
 /begin AXIS_DESCR STD_AXIS fho fak_ub_b4 6 0.00 3.984 FORMAT "%5.3" DEPOSIT ABSOLUTE /end AXIS_DESCR
/end CHARACTERISTIC
/begin CHARACTERISTIC HLSDem_nDrvOffSuprtSpLimMax_C "Maximum for the low idle set point offset for drive-off support" VALUE 0x805246FC RB_Val_Ws16 32767.50 nmot_sw_q0p5 -16384.00 16383.50 FORMAT "%8.2" /end CHARACTERISTIC
/begin CHARACTERISTIC HLSDem_nEngMaxGov_MAP "Demanded engine speed during high temperature for governor." MAP 0x80524AA4 RB_Map_S16S16_S16 32767.50 EngN -16384.00 16383.50 FORMAT "%8.2"
 /begin AXIS_DESCR STD_AXIS VehV_v Vel 8 -327.6800 327.6700 FORMAT "%8.4" DEPOSIT ABSOLUTE /end AXIS_DESCR
 /begin AXIS_DESCR STD_AXIS HLSDem_facEngSpdLimGov Fact 8 -4.000000 3.999878 FORMAT "%8.6" DEPOSIT ABSOLUTE /end AXIS_DESCR
/end CHARACTERISTIC
/begin CHARACTERISTIC HLSDem_nEngMax_MAP "Demanded engine speed during high temperature" MAP 0x80524B48 RB_Map_S16S16_S16 32767.50 EngN -16384.00 16383.50 FORMAT "%8.2"
 /begin AXIS_DESCR STD_AXIS VehV_v Vel 8 -327.6800 327.6700 FORMAT "%8.4" DEPOSIT ABSOLUTE /end AXIS_DESCR
 /begin AXIS_DESCR STD_AXIS HLSDem_facEngSpdLim Fact 8 -4.000000 3.999878 FORMAT "%8.6" DEPOSIT ABSOLUTE /end AXIS_DESCR
/end CHARACTERISTIC
/begin CHARACTERISTIC HLSDem_nGearLimThres_C "Engine speed threshold for a limitation in the drive train, which is considered valid" VALUE 0x80524F4E RB_Val_Ws16 32767.50 EngN -16384.00 16383.50 FORMAT "%8.2" /end CHARACTERISTIC
/begin CHARACTERISTIC HLSDem_nLimAvusWarn_C "NMAX-limitation in case of AVS failure" VALUE 0x80524BEC RB_Val_Ws16 32767.50 EngN -16384.00 16383.50 FORMAT "%8.2" /end CHARACTERISTIC
/begin CHARACTERISTIC HLSDem_nLimLftLimp_C "Engine speed limitation for valve lift system" VALUE 0x80524BEE RB_Val_Ws16 32767.50 EngN -16384.00 16383.50 FORMAT "%8.2" /end CHARACTERISTIC
/begin CHARACTERISTIC HLSDem_nMaxDspl_C "Maximum engine speed limit for display (calibratable value)" VALUE 0x80524F50 RB_Val_Ws16 32767.50 EngN -16384.00 16383.50 FORMAT "%8.2" /end CHARACTERISTIC
/begin CHARACTERISTIC HLSDem_nMaxEngGovOvht_T "Table engine speed limitation because engine component overheat - governor path for engine control" CURVE 0x80524E58 RB_Curve_S16_S16 32767.50 EngN -16384.00 16383.50 FORMAT "%8.2"
 /begin AXIS_DESCR STD_AXIS Tra_numGear OneToOne 9 -128.0000 127.0000 FORMAT "%8.4" EXTENDED_LIMITS -32768.00 32767.00 DEPOSIT ABSOLUTE /end AXIS_DESCR
/end CHARACTERISTIC
/begin CHARACTERISTIC HLSDem_nMaxEngOvht_T "Table engine speed limitation because engine component overheat - path for vehicle control" CURVE 0x80524E7E RB_Curve_S16_S16 32767.50 EngN -16384.00 16383.50 FORMAT "%8.2"
 /begin AXIS_DESCR STD_AXIS Tra_numGear OneToOne 9 -128.0000 127.0000 FORMAT "%8.4" EXTENDED_LIMITS -32768.00 32767.00 DEPOSIT ABSOLUTE /end AXIS_DESCR
/end CHARACTERISTIC
/begin CHARACTERISTIC HLSDem_nMaxHiSprt_CUR "Maximally permissible engine speed (short-term increased height) in Sportgasses" CURVE 0x80524BF0 RB_Curve_S16_S16 32767.50 EngN -16384.00 16383.50 FORMAT "%8.2"
 /begin AXIS_DESCR STD_AXIS PT_rTrq TransR 10 -327.6800 327.6700 FORMAT "%8.4" DEPOSIT ABSOLUTE /end AXIS_DESCR
/end CHARACTERISTIC
/begin CHARACTERISTIC HLSDem_nMaxHiTipp_CUR "Maximum permissible engine speed in tip shift gutter (short increase)" CURVE 0x80524C1A RB_Curve_S16_S16 32767.50 EngN -16384.00 16383.50 FORMAT "%8.2"
 /begin AXIS_DESCR STD_AXIS PT_rTrq TransR 10 -327.6800 327.6700 FORMAT "%8.4" DEPOSIT ABSOLUTE /end AXIS_DESCR
/end CHARACTERISTIC
/begin CHARACTERISTIC HLSDem_nMaxHi_CUR "Maximum permissible engine speed (short increase)" CURVE 0x80524C44 RB_Curve_S16_S16 32767.50 EngN -16384.00 16383.50 FORMAT "%8.2"
 /begin AXIS_DESCR STD_AXIS PT_rTrq TransR 10 -327.6800 327.6700 FORMAT "%8.4" DEPOSIT ABSOLUTE /end AXIS_DESCR
/end CHARACTERISTIC
/begin CHARACTERISTIC HLSDem_nMaxKnCtl_C "Engine speed limit at safety ignition retard by knock control" VALUE 0x80524C6E RB_Val_Ws16 32767.50 EngN -16384.00 16383.50 FORMAT "%8.2" /end CHARACTERISTIC
/begin CHARACTERISTIC HLSDem_nMaxLimErr1_C "In case of Error of FId: FId_HLSDem_nMaxLimErr1 this value will be used" VALUE 0x80524F52 RB_Val_Ws16 32767.50 EngN -16384.00 16383.50 FORMAT "%8.2" /end CHARACTERISTIC
/begin CHARACTERISTIC HLSDem_nMaxLimErr2_C "In case of Error of FId: FId_HLSDem_nMaxLimErr2 this value will be used" VALUE 0x80524F54 RB_Val_Ws16 32767.50 EngN -16384.00 16383.50 FORMAT "%8.2" /end CHARACTERISTIC
/begin CHARACTERISTIC HLSDem_nMaxLimErr3_C "In case of Error of FId: FId_HLSDem_nMaxLimErr3 this value will be used" VALUE 0x80524F56 RB_Val_Ws16 32767.50 EngN -16384.00 16383.50 FORMAT "%8.2" /end CHARACTERISTIC
/begin CHARACTERISTIC HLSDem_nMaxNFrstGearTPlus_C "Target value overspeed limitation at drive-off in the first gear with Traction Plus" VALUE 0x80524C70 RB_Val_Ws16 16383.50 EngN 0.00 16383.50 FORMAT "%8.2" EXTENDED_LIMITS -16384.00 16383.50 /end CHARACTERISTIC
/begin CHARACTERISTIC HLSDem_nMaxNFrstGear_C "Target value overspeed limitation at drive-off in the first gear" VALUE 0x80524C72 RB_Val_Ws16 16383.50 EngN 0.00 16383.50 FORMAT "%8.2" EXTENDED_LIMITS -16384.00 16383.50 /end CHARACTERISTIC
/begin CHARACTERISTIC HLSDem_nMaxNRvsGearTPlus_C "Target value overspeed limitation at drive-off in the reverse gear with Traction Plus" VALUE 0x80524C74 RB_Val_Ws16 16383.50 EngN 0.00 16383.50 FORMAT "%8.2" EXTENDED_LIMITS -16384.00 16383.50 /end CHARACTERISTIC
/begin CHARACTERISTIC HLSDem_nMaxNRvsGear_C "Target value overspeed limitation at drive-off in the reverse gear" VALUE 0x80524C76 RB_Val_Ws16 16383.50 EngN 0.00 16383.50 FORMAT "%8.2" EXTENDED_LIMITS -16384.00 16383.50 /end CHARACTERISTIC
/begin CHARACTERISTIC HLSDem_nMaxOffsSpIncr_C "Maximum offest for drvoff-setpoint" VALUE 0x805246FE RB_Val_Ws16 32767.50 nmot_sw_q0p5 -16384.00 16383.50 FORMAT "%8.2" /end CHARACTERISTIC
/begin CHARACTERISTIC HLSDem_nMaxOilT_MAP "Max engine speed limit at high oil temperature." MAP 0x80524C78 RB_Map_S16S16_S16 32767.50 EngN -16384.00 16383.50 FORMAT "%8.2"
 /begin AXIS_DESCR STD_AXIS HLSDem_tOilHys Temp_Cels 8 -3549.940 3003.560 FORMAT "%8.3" DEPOSIT ABSOLUTE /end AXIS_DESCR
 /begin AXIS_DESCR STD_AXIS PT_rTrq TransR 10 -327.6800 327.6700 FORMAT "%8.4" DEPOSIT ABSOLUTE /end AXIS_DESCR
/end CHARACTERISTIC
/begin CHARACTERISTIC HLSDem_nMaxPModeActv_C "In case of Error of FId: HLSDem_PModeActv this value will be used" VALUE 0x80524F58 RB_Val_Ws16 32767.50 EngN -16384.00 16383.50 FORMAT "%8.2" /end CHARACTERISTIC
/begin CHARACTERISTIC HLSDem_nMaxPTCoord_CW "Codeword of function %HLSDEm_NMaxPTCoord" VALUE 0x80524F5A RB_Val_Wu8 255.0 OneToOne 0.00 255.0 FORMAT "%5.1" /end CHARACTERISTIC
/begin CHARACTERISTIC HLSDem_nMaxRGear_C "Upper engine speed limitaion for reverse gear" VALUE 0x80524F5C RB_Val_Ws16 32767.50 EngN -16384.00 16383.50 FORMAT "%8.2" /end CHARACTERISTIC
/begin CHARACTERISTIC HLSDem_nMaxShtrp_C "Higher engine speed limit at function request from customer service" VALUE 0x80524D40 RB_Val_Ws16 32767.50 EngN -16384.00 16383.50 FORMAT "%8.2" /end CHARACTERISTIC
/begin CHARACTERISTIC HLSDem_nMaxStandSigErr_C "engine speed limitation for stand still with sensor fault" VALUE 0x80524D42 RB_Val_Ws16 32767.50 EngN -16384.00 16383.50 FORMAT "%8.2" /end CHARACTERISTIC
/begin CHARACTERISTIC HLSDem_nMaxStandStill_CW "Codeword: maximum engine speed when vehicle is standing" VALUE 0x80524D44 RB_Val_Wu8 255.0 OneToOne 0.00 255.0 FORMAT "%5.1" /end CHARACTERISTIC
/begin CHARACTERISTIC HLSDem_nMaxStand_C "Maximum engine speed when vehicle is standing" VALUE 0x80524D46 RB_Val_Ws16 32767.50 EngN -16384.00 16383.50 FORMAT "%8.2" /end CHARACTERISTIC
/begin CHARACTERISTIC HLSDem_nMaxStdOfs_C "Offset for standard engine speed limit in the calculation of HLSDem_bNMaxHi" VALUE 0x80524D48 RB_Val_Ws16 32767.50 EngN -16384.00 16383.50 FORMAT "%8.2" /end CHARACTERISTIC
/begin CHARACTERISTIC HLSDem_nMaxStdSprt_CUR "Maximally permissible engine speed (stationary) in sport mode" CURVE 0x80524D4A RB_Curve_S16_S16 32767.50 EngN -16384.00 16383.50 FORMAT "%8.2"
 /begin AXIS_DESCR STD_AXIS PT_rTrq TransR 10 -327.6800 327.6700 FORMAT "%8.4" DEPOSIT ABSOLUTE /end AXIS_DESCR
/end CHARACTERISTIC
/begin CHARACTERISTIC HLSDem_nMaxStdTipp_CUR "Maximum permissible engine speed in tip shift gutter (stationary)" CURVE 0x80524D74 RB_Curve_S16_S16 32767.50 EngN -16384.00 16383.50 FORMAT "%8.2"
 /begin AXIS_DESCR STD_AXIS PT_rTrq TransR 10 -327.6800 327.6700 FORMAT "%8.4" DEPOSIT ABSOLUTE /end AXIS_DESCR
/end CHARACTERISTIC
/begin CHARACTERISTIC HLSDem_nMaxStd_CUR "Maximum permissible engine speed (stationary)" CURVE 0x80524D9E RB_Curve_S16_S16 32767.50 EngN -16384.00 16383.50 FORMAT "%8.2"
 /begin AXIS_DESCR STD_AXIS PT_rTrq TransR 10 -327.6800 327.6700 FORMAT "%8.4" DEPOSIT ABSOLUTE /end AXIS_DESCR
/end CHARACTERISTIC
/begin CHARACTERISTIC HLSDem_nMaxTEng_CUR "Engine speed limit at high engine temperature." CURVE 0x80524DC8 RB_Curve_S16_S16 32767.50 EngN -16384.00 16383.50 FORMAT "%8.2"
 /begin AXIS_DESCR STD_AXIS EngDa_tEng Temp_Cels 10 -3549.940 3003.560 FORMAT "%8.3" DEPOSIT ABSOLUTE /end AXIS_DESCR
/end CHARACTERISTIC
/begin CHARACTERISTIC HLSDem_nMaxTModeActv_C "In case of Error of FId: HLSDem_TModeActv this value will be used" VALUE 0x80524F5E RB_Val_Ws16 32767.50 EngN -16384.00 16383.50 FORMAT "%8.2" /end CHARACTERISTIC
/begin CHARACTERISTIC HLSDem_nMaxVErr_CA "Gearbox dependant engine speed limitation during fault in vehicle speed detection" VAL_BLK 0x80524F60 RB_ValA_Ws16 32767.50 EngN -16384.00 16383.50 FORMAT "%8.2" NUMBER 4 /end CHARACTERISTIC
/begin CHARACTERISTIC HLSDem_nMaxVErr_CUR "Engine speed limit for automatic transmission at fault of vehicle speed signal" CURVE 0x80524F68 RB_Curve_S16_S16 32767.50 EngN -16384.00 16383.50 FORMAT "%8.2"
 /begin AXIS_DESCR STD_AXIS PT_rTrq TransR 7 -327.6800 327.6700 FORMAT "%8.4" DEPOSIT ABSOLUTE /end AXIS_DESCR
/end CHARACTERISTIC
/begin CHARACTERISTIC HLSDem_nOffsAppDeadZone_CUR "Low-idle speed offset for drive-off support dependent on the weighted voltage diffenence between accped sensor 1 and accped sensor 2" CURVE 0x80524700 RB_Curve_S16_S16 32767.50 nmot_sw_q0p5 -16384.00 16383.50 FORMAT "%8.2"
 /begin AXIS_DESCR STD_AXIS HLSDem_facAppDeadZone Fact 4 -4.000000 3.999878 FORMAT "%8.6" DEPOSIT ABSOLUTE /end AXIS_DESCR
/end CHARACTERISTIC
/begin CHARACTERISTIC HLSDem_nOffsCoupling_C "Base factor for the calculation of the low idle speed setpoint offset for drive-off support" VALUE 0x80524712 RB_Val_Ws16 32767.50 nmot_sw_q0p5 -16384.00 16383.50 FORMAT "%8.2" /end CHARACTERISTIC
/begin CHARACTERISTIC HLSDem_nOffsDrvOff_C "Additive part of the low idle speed setpoint offset for drive-off support" VALUE 0x80524714 RB_Val_Ws16 32767.50 nmot_sw_q0p5 -16384.00 16383.50 FORMAT "%8.2" /end CHARACTERISTIC
/begin CHARACTERISTIC HLSDem_nOffsSpIncrCreep_C "creep offset for drvoff-Calibration" VALUE 0x80524716 RB_Val_Ws16 32767.50 nmot_sw_q0p5 -16384.00 16383.50 FORMAT "%8.2" /end CHARACTERISTIC
/begin CHARACTERISTIC HLSDem_nOffsSpIncrCreep_T "creep offset for drvoff-Map" CURVE 0x80524718 RB_Curve_S16_S16 32767.50 nmot_sw_q0p5 -16384.00 16383.50 FORMAT "%8.2"
 /begin AXIS_DESCR STD_AXIS VehV_v Vel 6 -327.6800 327.6700 FORMAT "%8.4" DEPOSIT ABSOLUTE /end AXIS_DESCR
/end CHARACTERISTIC
/begin CHARACTERISTIC HLSDem_nOffsSpIncrKissPnt_M "Kisspoint setpoint for drvoff-map" MAP 0x80524732 RB_Map_U8U8_S16 32767.50 nmot_sw_q0p5 -16384.00 16383.50 FORMAT "%8.2"
 /begin AXIS_DESCR STD_AXIS tmot temp_ub_q0p75_o48 6 -48.0 143.3 FORMAT "%5.1" DEPOSIT ABSOLUTE /end AXIS_DESCR
 /begin AXIS_DESCR STD_AXIS fho fak_ub_b4 6 0.00 3.984 FORMAT "%5.3" DEPOSIT ABSOLUTE /end AXIS_DESCR
/end CHARACTERISTIC
/begin CHARACTERISTIC HLSDem_nSetPHiBas_MAP "Gear dependent base value for the engine speed limitation" MAP 0x80524F86 RB_Map_S16S16_S16 32767.50 EngN -16384.00 16383.50 FORMAT "%8.2"
 /begin AXIS_DESCR STD_AXIS HLSDem_numGear OneToOne 9 -32768.00 32767.00 FORMAT "%8.2" DEPOSIT ABSOLUTE /end AXIS_DESCR
 /begin AXIS_DESCR STD_AXIS HLSDem_tTempSel Temp_Cels 8 -3549.940 3003.560 FORMAT "%8.3" DEPOSIT ABSOLUTE /end AXIS_DESCR
/end CHARACTERISTIC
/begin CHARACTERISTIC HLSDem_nSysErrLimThres_C "Engine speed threshold for a limitation in the drive train, which is considered valid" VALUE 0x8052503C RB_Val_Ws16 32767.50 EngN -16384.00 16383.50 FORMAT "%8.2" /end CHARACTERISTIC
/begin CHARACTERISTIC HLSDem_nTraLimThres_C "Engine speed threshold for a limitation in the drive train, which is considered valid" VALUE 0x8052503E RB_Val_Ws16 32767.50 EngN -16384.00 16383.50 FORMAT "%8.2" /end CHARACTERISTIC
/begin CHARACTERISTIC HLSDem_numGearErrOvht_C "Replacement value current transmission gear for model engine speed limitation due to engine component overheat" VALUE 0x80524EA4 RB_Val_Ws8 255.0 OneToOne -128.0 127.0 FORMAT "%5.1" /end CHARACTERISTIC
/begin CHARACTERISTIC HLSDem_pMstCylBrkLeftHysDelta_C "Threshold for the hysteresis(against Brake pressure) used for MCP detection in Drive off support activation" VALUE 0x80524788 RB_Val_Ws32 8589934590.00 PresAC_hPa -4294967296.00 4294967294.00 FORMAT "%13.2" /end CHARACTERISTIC
/begin CHARACTERISTIC HLSDem_pMstCylBrkLeftHysMin_C "Threshold for the hysteresis(against Brake pressure) used for MCP detection in Drive off support activation" VALUE 0x8052478C RB_Val_Ws32 8589934590.00 PresAC_hPa -4294967296.00 4294967294.00 FORMAT "%13.2" /end CHARACTERISTIC
/begin CHARACTERISTIC HLSDem_rAppMin_C "Minimum accelerator pedal value to reset the slope value for positive ramp for high speed limit." VALUE 0x80525040 RB_Val_Ws16 799.9878 Prc -400.0000 399.9878 FORMAT "%8.4" /end CHARACTERISTIC
/begin CHARACTERISTIC HLSDem_rClthDrvAwyMax_C "High clutch position value to enable drive off support" VALUE 0x80524790 RB_Val_Ws16 255.9961 Prc_Fact256 -128.0000 127.9961 FORMAT "%8.4" /end CHARACTERISTIC
/begin CHARACTERISTIC HLSDem_rClthDrvAwyMin_C "Low clutch position value to enable drive off support" VALUE 0x80524792 RB_Val_Ws16 255.9961 Prc_Fact256 -128.0000 127.9961 FORMAT "%8.4" /end CHARACTERISTIC
/begin CHARACTERISTIC HLSDem_rClthKisspntGain_C "Gain for the modification of the clutch kissing point" VALUE 0x80524794 RB_Val_Ws16 7.999878 Fact -4.000000 3.999878 FORMAT "%8.6" /end CHARACTERISTIC
/begin CHARACTERISTIC HLSDem_rClthKisspntOffset_C "Offset for the modification of the clutch kissing point" VALUE 0x80524796 RB_Val_Ws16 255.9961 Prc_Fact256 -128.0000 127.9961 FORMAT "%8.4" /end CHARACTERISTIC
/begin CHARACTERISTIC HLSDem_rClthMaxOffs1EnaThreshold_C "clutch ratio threshold to detect the maximum value of drive off" VALUE 0x80524798 RB_Val_Ws16 255.9961 Prc_Fact256 -128.0000 127.9961 FORMAT "%8.4" /end CHARACTERISTIC
/begin CHARACTERISTIC HLSDem_rClthMaxOffs1Ena_C "Threshold for the clutch ratio for the activation of a part of the drive-off support" VALUE 0x8052479A RB_Val_Ws16 255.9961 Prc_Fact256 -128.0000 127.9961 FORMAT "%8.4" /end CHARACTERISTIC
/begin CHARACTERISTIC HLSDem_rClthPsdThd_C "Threshold to check, if clutch is open" VALUE 0x80524DF2 RB_Val_Ws16 100.0000 Prc_Fact256 0.00 100.0000 FORMAT "%8.4" EXTENDED_LIMITS -128.0000 127.9961 /end CHARACTERISTIC
/begin CHARACTERISTIC HLSDem_rDrvOffSuprtAThd_C "Maximum threshold for acceleration pedal ratio" VALUE 0x8052479C RB_Val_Ws16 799.9878 Prc -400.0000 399.9878 FORMAT "%8.4" /end CHARACTERISTIC
/begin CHARACTERISTIC HLSDem_rFanErrOvht_C "Replacement value fan control ratio for model engine speed limitation due to engine component overheat" VALUE 0x80524EA6 RB_Val_Ws16 799.9878 Prc -400.0000 399.9878 FORMAT "%8.4" /end CHARACTERISTIC
/begin CHARACTERISTIC HLSDem_rMaxClthPosSpIncr_C "Max cluth position for kisspoint setpoint calulation" VALUE 0x8052479E RB_Val_Ws16 255.9961 Prc_Fact256 -128.0000 127.9961 FORMAT "%8.4" /end CHARACTERISTIC
/begin CHARACTERISTIC HLSDem_rMaxClthRatSpIncr_C "Max cluth ratio for kisspoint setpoint calulation" VALUE 0x805247A0 RB_Val_Ws16 255.9961 Prc_Fact256 -128.0000 127.9961 FORMAT "%8.4" /end CHARACTERISTIC
/begin CHARACTERISTIC HLSDem_rMaxDiDrvOff_C "Threshold for the clutch ratio for the deactivation of the drive-off support" VALUE 0x805247A2 RB_Val_Ws16 255.9961 Prc_Fact256 -128.0000 127.9961 FORMAT "%8.4" /end CHARACTERISTIC
/begin CHARACTERISTIC HLSDem_rMinClthPosSpIncr_C "Min cluth ratio for kisspoint setpoint calulation" VALUE 0x805247A4 RB_Val_Ws16 255.9961 Prc_Fact256 -128.0000 127.9961 FORMAT "%8.4" /end CHARACTERISTIC
/begin CHARACTERISTIC HLSDem_rMinClthRatSpIncr_C "Min cluth ratio for kisspoint setpoint calulation" VALUE 0x805247A6 RB_Val_Ws16 255.9961 Prc_Fact256 -128.0000 127.9961 FORMAT "%8.4" /end CHARACTERISTIC
/begin CHARACTERISTIC HLSDem_stClthPsd_C "Calibration parameter to dectect cluth position to activate or deactivate Drive-off conditions" VALUE 0x805247A8 RB_Val_Wu8 7.000 OneToOne 0.00 7.000 FORMAT "%5.3" EXTENDED_LIMITS 0.00 255.0 /end CHARACTERISTIC
/begin CHARACTERISTIC HLSDem_stDrvOffSuprtDiMaskAST_C "Bitmask for the configuration of the disabling conditions of drive-off support of vehicles without MT" VALUE 0x805247AA RB_Val_Wu16 65535.00 OneToOne 0.00 65535.00 FORMAT "%8.2" /end CHARACTERISTIC
/begin CHARACTERISTIC HLSDem_stDrvOffSuprtDiMask_C "Mask for selecting different conditions for disabling drive-off support feature" VALUE 0x805247AC RB_Val_Wu16 65535.00 OneToOne 0.00 65535.00 FORMAT "%8.2" /end CHARACTERISTIC
/begin CHARACTERISTIC HLSDem_stDrvOffSuprtEnaMaskAST_C "Bitmask for the configuration of the enabling conditions of drive-off support of vehicles without MT" VALUE 0x805247AE RB_Val_Wu16 65535.00 OneToOne 0.00 65535.00 FORMAT "%8.2" /end CHARACTERISTIC
/begin CHARACTERISTIC HLSDem_stDrvOffSuprtEnaMask_C "Mask for selecting different conditions for enabling drive-off support feature" VALUE 0x805247B0 RB_Val_Wu16 65535.00 OneToOne 0.00 65535.00 FORMAT "%8.2" /end CHARACTERISTIC
/begin CHARACTERISTIC HLSDem_stEngOperModSeln_FT "Satus to select drivability mode for parameter" CURVE 0x805247B2 RB_Curve_U8_U8 255.0 OneToOne 0.00 255.0 FORMAT "%5.1"
 /begin AXIS_DESCR STD_AXIS Com_stEngMapReq OneToOne 16 0.00 255.0 FORMAT "%5.1" DEPOSIT ABSOLUTE /end AXIS_DESCR
/end CHARACTERISTIC
/begin CHARACTERISTIC HLSDem_stNMaxEngGov_CW "Status: Partcular engine speed limitation considered for engine speed limitation for governor." VALUE 0x80524DF4 RB_Val_Wu32 4294967295.00 OneToOne 0.00 4294967295.00 FORMAT "%13.2" /end CHARACTERISTIC
/begin CHARACTERISTIC HLSDem_stNMaxEng_CW "Codewort of function %HLSDem_nMaxEng" VALUE 0x80524DF8 RB_Val_Wu8 255.0 OneToOne 0.00 255.0 FORMAT "%5.1" /end CHARACTERISTIC
/begin CHARACTERISTIC HLSDem_stNMaxExtPrio_C "Status: condition set externally requested transmission speed" VALUE 0x80524EA8 RB_Val_Wu8 255.0 dez 0.00 255.0 FORMAT "%5.1" /end CHARACTERISTIC
/begin CHARACTERISTIC HLSDem_stNMaxPrio_CW "Status: condition set desired transmission speed" VALUE 0x80524DFC RB_Val_Wu32 4294967295.00 OneToOne 0.00 4294967295.00 FORMAT "%13.2" /end CHARACTERISTIC
/begin CHARACTERISTIC HLSDem_stOvhtEngMaxGov_CW "Status: Limitations that should be considered for overheat engine speed limitation for Governor." VALUE 0x80524E00 RB_Val_Wu16 65535.00 OneToOne 0.00 65535.00 FORMAT "%8.2" /end CHARACTERISTIC
/begin CHARACTERISTIC HLSDem_stPTMaxPrio_CW "Status: Condition for setting desired gearbox speed" VALUE 0x80525042 RB_Val_Wu16 65535.00 OneToOne 0.00 65535.00 FORMAT "%8.2" /end CHARACTERISTIC
/begin CHARACTERISTIC HLSDem_stWarn2500_CW "Speed limitations which is to be displayed as, engine speed limited to 2500rpm in Combi." VALUE 0x80524E02 RB_Val_Wu16 65535.00 OneToOne 0.00 65535.00 FORMAT "%8.2" /end CHARACTERISTIC
/begin CHARACTERISTIC HLSDem_stWarn4000_CW "Speed limitations which is to be displayed as, engine speed limited to 4000rpm in Combi." VALUE 0x80524E04 RB_Val_Wu16 65535.00 OneToOne 0.00 65535.00 FORMAT "%8.2" /end CHARACTERISTIC
/begin CHARACTERISTIC HLSDem_stWarn6000_CW "Speed limitations which is to be displayed as, engine speed limited to 6000rpm in Combi." VALUE 0x80524E06 RB_Val_Wu16 65535.00 OneToOne 0.00 65535.00 FORMAT "%8.2" /end CHARACTERISTIC
/begin CHARACTERISTIC HLSDem_swtClthDetEna_C "Switch to chose the type of clutch state detection" VALUE 0x805247D3 RB_Val_Wu8 255.0 OneToOne 0.00 255.0 FORMAT "%5.1" /end CHARACTERISTIC
/begin CHARACTERISTIC HLSDem_SwtDeactvDrvOffSuprtOffs_C "Drive off deactivation for creep feature" VALUE 0x805247D4 RB_Val_Wboolean 1.00000000000 B_TRUE 0.00 1.00000000000 FORMAT "%13.11" /end CHARACTERISTIC
/begin CHARACTERISTIC HLSDem_swtDrvOffSuprtSpMod_C "Switch to select different ways of determining the unfiltered setpoint for drive-off support" VALUE 0x805247D5 RB_Val_Wu8 255.0 OneToOne 0.00 255.0 FORMAT "%5.1" /end CHARACTERISTIC
/begin CHARACTERISTIC HLSDem_swtDrvOffSuprtSpSeln_C "Switch select nstat(HLSDem_nSetPlo) OR Drive off setpoint for ramping of drive-off setpoint" VALUE 0x805247D6 RB_Val_Wu8 255.0 OneToOne 0.00 255.0 FORMAT "%5.1" /end CHARACTERISTIC
/begin CHARACTERISTIC HLSDem_swtTempSel_C "Temperature selection switch for gear dependant maximum engine speed" VALUE 0x80525044 RB_Val_Wboolean 1.00000000000 B_TRUE 0.00 1.00000000000 FORMAT "%13.11" /end CHARACTERISTIC
/begin CHARACTERISTIC HLSDem_swtTracPlusPrsnt_C "Switch to enable the Traction Plus" VALUE 0x80524E08 RB_Val_Wu8 255.0 OneToOne 0.00 255.0 FORMAT "%5.1" /end CHARACTERISTIC
/begin CHARACTERISTIC HLSDem_tEnvErrOvht_C "Replacement value environment air temperature for model engine speed limitation due to engine component overheat" VALUE 0x80524EAA RB_Val_Ws16 6553.500 Temp_Cels -3549.940 3003.560 FORMAT "%8.3" /end CHARACTERISTIC
/begin CHARACTERISTIC HLSDem_tExhMnfB1_C "Replacement value exhaust gas temperature for model engine speed limitation due to engine component overheat" VALUE 0x80524EAC RB_Val_Ws16 6553.500 Temp_Cels -3549.940 3003.560 FORMAT "%8.3" /end CHARACTERISTIC
/begin CHARACTERISTIC HLSDem_tiBrkHldSysActvTOFF_C "Time duration for turnoff delay for brake hold system active to activate driveoff setpoint" VALUE 0x805247D7 RB_Val_Wu8 5.100 t_q0p02 0.00 5.100 FORMAT "%5.3" /end CHARACTERISTIC
/begin CHARACTERISTIC HLSDem_tiDeadTimeFirstEngStrtPassd_C "Time delay parameter to wait for first engine start to be finished" VALUE 0x805247D8 RB_Val_Wu16 1310700. Time_ms_20ms 0.00 1310700. FORMAT "%8.0" /end CHARACTERISTIC
/begin CHARACTERISTIC HLSDem_tiDelNMaxESP_C "Delay time for the unblocking of the ESP switch at the maximum speed limitation" VALUE 0x80524E0C RB_Val_Ws32 2147.48364700 Time_Dt 0.00 2147.48364700 FORMAT "%13.8" EXTENDED_LIMITS -2147.48364800 2147.48364700 /end CHARACTERISTIC
/begin CHARACTERISTIC HLSDem_tiDlyDrvOffSuprtSpIncrCVT_C "Time delay parameter to release condition of drive -off in case CVT" VALUE 0x805247DA RB_Val_Wu16 1310700. Time_ms_20ms 0.00 1310700. FORMAT "%8.0" /end CHARACTERISTIC
/begin CHARACTERISTIC HLSDem_tiDlySpIncrMT_C "time delay for activation of drvoff for MT" VALUE 0x805247DC RB_Val_Wu16 1310700. Time_ms_20ms 0.00 1310700. FORMAT "%8.0" /end CHARACTERISTIC
/begin CHARACTERISTIC HLSDem_tiDrvOffSuprtEnaThd_C "Maximum duration of drive-off support" VALUE 0x805247DE RB_Val_Wu16 1310700. Time_ms_20ms 0.00 1310700. FORMAT "%8.0" /end CHARACTERISTIC
/begin CHARACTERISTIC HLSDem_tiEngOffNMaxOvht_C "Minimum engine off time for heat integrator reset during ini" VALUE 0x80524EB0 RB_Val_Ws32 4294967295.00 TimeEngOn -2147483648.00 2147483647.00 FORMAT "%13.2" /end CHARACTERISTIC
/begin CHARACTERISTIC HLSDem_tiExDrvOff_C "Waiting time for resetting condition drive-off active" VALUE 0x80524E10 RB_Val_Wu8 25.50 t_q0p1 0.00 25.50 FORMAT "%5.2" /end CHARACTERISTIC
/begin CHARACTERISTIC HLSDem_tiGearRatDrvOffFlt_C "Time constant for PT1 filtering of the ratio of gearbox input shaft speed and engine speed to estimate the clutch slip" VALUE 0x805247E0 RB_Val_Ws32 4294.9672940000000 TimeDelay_s 0.0000020000000 4294.9672959999998 FORMAT "%19.14" EXTENDED_LIMITS 0.000002000000001 4294.9672959999998 /end CHARACTERISTIC
/begin CHARACTERISTIC HLSDem_tiGearShft_C "Delay time for keeping gear information during gear shifts for or to reverse gear" VALUE 0x80524E11 RB_Val_Wu8 25.50 t_q0p1 0.00 25.50 FORMAT "%5.2" /end CHARACTERISTIC
/begin CHARACTERISTIC HLSDem_tiKnCntl_C "Delay for activating the engine speed limitationin case of active safety ignition retardation" VALUE 0x80524E12 RB_Val_Wu8 25.50 t_q0p1 0.00 25.50 FORMAT "%5.2" /end CHARACTERISTIC
/begin CHARACTERISTIC HLSDem_tiMaxNMaxHi_CUR "Maximum duration for raised engine speed limit" CURVE 0x80524E14 RB_Curve_S16_S16 2147.500 Time_sec_1 0.00 2147.500 FORMAT "%8.3" EXTENDED_LIMITS -3276.800 3276.700
 /begin AXIS_DESCR STD_AXIS PT_rTrq TransR 10 -327.6800 327.6700 FORMAT "%8.4" DEPOSIT ABSOLUTE /end AXIS_DESCR
/end CHARACTERISTIC
/begin CHARACTERISTIC HLSDem_tiNMaxBlw_C "Dwell time below lower engine speed limit before activation of upper limit" VALUE 0x80524E40 RB_Val_Ws32 2147.48364700 Time_Dt 0.00 2147.48364700 FORMAT "%13.8" EXTENDED_LIMITS -2147.48364800 2147.48364700 /end CHARACTERISTIC
/begin CHARACTERISTIC HLSDem_tiNMaxDelVErr_C "Delay time for engine speed limit at fault of vehicle speed signal" VALUE 0x80525048 RB_Val_Ws32 4294.96729500 Time_Dt -2147.48364800 2147.48364700 FORMAT "%13.8" /end CHARACTERISTIC
/begin CHARACTERISTIC HLSDem_tiNMaxStand_C "Delay time of maximum speed limitation during stillstand" VALUE 0x80524E44 RB_Val_Ws32 2147.48364700 Time_Dt 0.00 2147.48364700 FORMAT "%13.8" EXTENDED_LIMITS -2147.48364800 2147.48364700 /end CHARACTERISTIC
/begin CHARACTERISTIC HLSDem_tiOvhtIntgl_C "Integrator time constant to calculate engine component heat" VALUE 0x80524EB4 RB_Val_Wu16 992.95454522 hk100msxs_uw_b993 0.01515175 992.96969697 FORMAT "%12.8" EXTENDED_LIMITS 0.015151746349 992.96969697 /end CHARACTERISTIC
/begin CHARACTERISTIC HLSDem_tiOvrRunDly_C "Time delay after overrun, before engine speed limitation because engine component overheat is enabled" VALUE 0x80524EB6 RB_Val_Wu16 6553.500 t_q0p1 0.00 6553.500 FORMAT "%8.3" /end CHARACTERISTIC
/begin CHARACTERISTIC HLSDem_tiRlsRmp_C "Minimum time for which Acc ped value should be less than a calibratable threshold to reset the positive slope to MAXSINT32 for high set point." VALUE 0x8052504C RB_Val_Ws32 4294.96729500 Time_Dt -2147.48364800 2147.48364700 FORMAT "%13.8" /end CHARACTERISTIC
/begin CHARACTERISTIC HLSDem_tNMaxHi_C "Engine temperature threshold for activation of increased engine speed limit" VALUE 0x80524E48 RB_Val_Ws16 6553.500 Temp_Cels -3549.940 3003.560 FORMAT "%8.3" /end CHARACTERISTIC
/begin CHARACTERISTIC HLSDem_tOvhtFanPwr_T "Table offset component overheat model for engine speed limitation depending on fan control" CURVE 0x80524EB8 RB_Curve_S16_S16 6553.500 Temp_Kelv -3276.800 3276.700 FORMAT "%8.3"
 /begin AXIS_DESCR STD_AXIS Fan_r Prc 5 -400.0000 399.9878 FORMAT "%8.4" DEPOSIT ABSOLUTE /end AXIS_DESCR
/end CHARACTERISTIC
/begin CHARACTERISTIC HLSDem_tOvhtTEnv_T "Table offset component overheat model for engine speed limitation depending on environment temperature" CURVE 0x80524ECE RB_Curve_S16_S16 6553.500 Temp_Kelv -3276.800 3276.700 FORMAT "%8.3"
 /begin AXIS_DESCR STD_AXIS EnvT_t Temp_Cels 7 -3549.940 3003.560 FORMAT "%8.3" DEPOSIT ABSOLUTE /end AXIS_DESCR
/end CHARACTERISTIC
/begin CHARACTERISTIC HLSDem_tOvhtVehV_T "Table offset component overheat model for engine speed limitation depending on vehicle speed" CURVE 0x80524EEC RB_Curve_S16_S16 6553.500 Temp_Kelv -3276.800 3276.700 FORMAT "%8.3"
 /begin AXIS_DESCR STD_AXIS VehV_v vel_q0p01 7 -327.6800 327.6700 FORMAT "%8.4" DEPOSIT ABSOLUTE /end AXIS_DESCR
/end CHARACTERISTIC
/begin CHARACTERISTIC HLSDem_tOvht_C "Component overheat model temperature for engine speed limitation" VALUE 0x80524F0A RB_Val_Ws16 6553.500 Temp_Kelv -3276.800 3276.700 FORMAT "%8.3" /end CHARACTERISTIC
/begin CHARACTERISTIC HLSDem_tWrm_C "Temperature limit (Nmax-limittion) for separation between cold engine mode and warm engine mode" VALUE 0x80524E4A RB_Val_Ws16 6553.500 Temp_Cels -3549.940 3003.560 FORMAT "%8.3" /end CHARACTERISTIC
/begin CHARACTERISTIC HLSDem_uPedDeadZone_C "Weighting factor for the voltage difference between accped sensor 1 and accped sensor 2" VALUE 0x805247E4 RB_Val_Ws16 13107.00 Volt -6553.600 6553.400 FORMAT "%8.3" /end CHARACTERISTIC
/begin CHARACTERISTIC HLSDem_vActStandStill_C "Vehicle speed threshold for activation of engine speed limitation during still stand" VALUE 0x80524E4C RB_Val_Ws16 655.3500 Vel -327.6800 327.6700 FORMAT "%8.4" /end CHARACTERISTIC
/begin CHARACTERISTIC HLSDem_vDrvOffSuprtVehVThd_C "Threshold for distinguishing between lower and higher vehicle velocity for the ramp slope parameters" VALUE 0x805247E6 RB_Val_Ws16 655.3500 Vel -327.6800 327.6700 FORMAT "%8.4" /end CHARACTERISTIC
/begin CHARACTERISTIC HLSDem_vDrvOffVehVHysMax_C "Maximum threshold of hysteresis for vehicle velocity" VALUE 0x805247E8 RB_Val_Ws16 655.3500 Vel -327.6800 327.6700 FORMAT "%8.4" /end CHARACTERISTIC
/begin CHARACTERISTIC HLSDem_vDrvOffVehVHysMin_C "Minimum threshold of hysteresis for vehicle velocity" VALUE 0x805247EA RB_Val_Ws16 655.3500 Vel -327.6800 327.6700 FORMAT "%8.4" /end CHARACTERISTIC
/begin CHARACTERISTIC HLSDem_vMaxDrvOff_C "Maximum vehicle speed for condition drive-off active" VALUE 0x80524E4E RB_Val_Ws16 655.3500 Vel -327.6800 327.6700 FORMAT "%8.4" /end CHARACTERISTIC
/begin CHARACTERISTIC HLSDem_vMaxVehVelSpIncrCreep_C "max vehicle velocity for activation of drvoff creep" VALUE 0x805247EC RB_Val_Ws16 655.3500 Vel -327.6800 327.6700 FORMAT "%8.4" /end CHARACTERISTIC
/begin CHARACTERISTIC HLSDem_vMaxVehVelSpIncrCVT_C "max vehicle velocity for activation of drvoff CVT" VALUE 0x805247EE RB_Val_Ws16 655.3500 Vel -327.6800 327.6700 FORMAT "%8.4" /end CHARACTERISTIC
/begin CHARACTERISTIC HLSDem_vMaxVehVelSpIncrMT_C "max vehicle velocity for activation of drvoff MT" VALUE 0x805247F0 RB_Val_Ws16 655.3500 Vel -327.6800 327.6700 FORMAT "%8.4" /end CHARACTERISTIC
/begin CHARACTERISTIC HLSDem_vMinVehVelSpIncrCreep_C "min vehicle velocity for activation of drvoff creep" VALUE 0x805247F2 RB_Val_Ws16 655.3500 Vel -327.6800 327.6700 FORMAT "%8.4" /end CHARACTERISTIC
/begin CHARACTERISTIC HLSDem_vMinVehVelSpIncrCVT_C "min vehicle velocity for activation of drvoff CVT" VALUE 0x805247F4 RB_Val_Ws16 655.3500 Vel -327.6800 327.6700 FORMAT "%8.4" /end CHARACTERISTIC
/begin CHARACTERISTIC HLSDem_vMinVehVelSpIncrMT_C "min vehicle velocity for activation of drvoff MT" VALUE 0x805247F6 RB_Val_Ws16 655.3500 Vel -327.6800 327.6700 FORMAT "%8.4" /end CHARACTERISTIC
/begin CHARACTERISTIC HLSDem_vNMaxHi_C "Vehicle speed threshold for activation of increased engine speed limit" VALUE 0x80524E50 RB_Val_Ws16 655.3500 Vel -327.6800 327.6700 FORMAT "%8.4" /end CHARACTERISTIC
/begin CHARACTERISTIC HLSDem_vVehErrOvht_C "Replacement value vehicle speed for model engine speed limitation due to engine component overheat" VALUE 0x80524F0C RB_Val_Ws16 655.3500 vel_q0p01 -327.6800 327.6700 FORMAT "%8.4" /end CHARACTERISTIC
/begin CHARACTERISTIC HLSDem_vVehMin_C "Minimum value of vehicle speed to reset the slope value for positive ramp for high speed limit." VALUE 0x80525050 RB_Val_Ws16 655.3500 Vel -327.6800 327.6700 FORMAT "%8.4" /end CHARACTERISTIC
/begin CHARACTERISTIC I14229iocbi_rPCSDutyIni_C "Initial value of PCS duty cycle" VALUE 0x8053B100 Val_Wu8 99.61 rel_q0p39 0.00 99.61 FORMAT "%5.2" /end CHARACTERISTIC
/begin CHARACTERISTIC I14229_GEVCtl_agMaxAdpdIntk_C "element use to conver to VTC system cam shaft no advanced absolute position" VALUE 0x80525096 RB_Val_Ws16 1023.984 kw_q0p0156 -512.0000 511.9844 FORMAT "%8.4" /end CHARACTERISTIC
/begin CHARACTERISTIC I14229_nHpFlInjCdnIdlRunngHi_C "maximum value of engine speed for high presure routine control" VALUE 0x80525098 RB_Val_Ws16 32767.50 EngN -16384.00 16383.50 FORMAT "%8.2" /end CHARACTERISTIC
/begin CHARACTERISTIC I14229_SigTabRFFD_CA "Array with all signal numbers used for freeze frame readout using srevice $22" VAL_BLK 0x8052509A RB_ValA_Wu16 782.000000000 Signals_IntSigNumVerb 0.00 782.000000000 FORMAT "%13.9" NUMBER 62 /end CHARACTERISTIC
/begin CHARACTERISTIC I14229_stEnaVINDia_C "Calibration to enable or disable VIN Diagnosis" VALUE 0x80525116 RB_Val_Wu8 255.0 OneToOne 0.00 255.0 FORMAT "%5.1" /end CHARACTERISTIC
/begin CHARACTERISTIC I14229_stSwtB9SecuChkEna_C "Security-B9_enable" VALUE 0x80525130 Val_Wu8 1.000 OneToOne 0.00 1.000 FORMAT "%5.3" EXTENDED_LIMITS 0.00 255.0 /end CHARACTERISTIC
/begin CHARACTERISTIC I14229_stSwtOilPmpOutp_C "To update the status of solenoid ON or OFF from tester based on engine oil pump output" VALUE 0x80525117 RB_Val_Wu8 255.0 OneToOne 0.00 255.0 FORMAT "%5.1" /end CHARACTERISTIC
/begin CHARACTERISTIC I14229_stVINWriteClrUnit_C "Whether clear information is stored in other units or not" VALUE 0x80525118 RB_Val_Wu8 255.0 OneToOne 0.00 255.0 FORMAT "%5.1" /end CHARACTERISTIC
/begin CHARACTERISTIC I14229_tiForceActvTmr_C "Calibration corresponding to force active timer" VALUE 0x8052511C RB_Val_Ws32 42949672950.0 Time_ms -21474836480.0 21474836470.0 FORMAT "%13.1" /end CHARACTERISTIC
/begin CHARACTERISTIC I14229_tiKsDiag_C "calibration corresponding to Diag time" VALUE 0x80525120 RB_Val_Ws32 4294.96729500 Time_Dt -2147.48364800 2147.48364700 FORMAT "%13.8" /end CHARACTERISTIC
/begin CHARACTERISTIC I14229_tiPHAACTRINTKTmr_C "Calibration value for protection timer condition check" VALUE 0x80525124 RB_Val_Ws16 655350.0 Time_ms -327680.0 327670.0 FORMAT "%8.1" /end CHARACTERISTIC
/begin CHARACTERISTIC I14229_tiPHAACTROUTLTmr_C "Calibration value for protection timer condition check" VALUE 0x80525126 RB_Val_Ws16 655350.0 Time_ms -327680.0 327670.0 FORMAT "%8.1" /end CHARACTERISTIC
/begin CHARACTERISTIC I14229_tiSwtHistDly_C "Timer for the switch histroy delay." VALUE 0x80525128 RB_Val_Ws16 655350.0 Time_ms -327680.0 327670.0 FORMAT "%8.1" /end CHARACTERISTIC
/begin CHARACTERISTIC I14229_tiVINWriteClrTimeout_C "Timeout time for clear process" VALUE 0x8052512A RB_Val_Ws16 655350.0 Time_ms -327680.0 327670.0 FORMAT "%8.1" /end CHARACTERISTIC
/begin CHARACTERISTIC I14229_TrbCh_uLongTermClsdSensB1_C "Long term adaptation value of lower electrical stop sensor 1 bank 1 factor" VALUE 0x8052512C RB_Val_Wu16 79.99878 spg_q1p221Em3_V 0.00 79.99878 FORMAT "%8.5" /end CHARACTERISTIC
/begin CHARACTERISTIC I15031_nMaxSrv4_C "Maximum engine speed for Mode$04 Clear Diagnostic Information" VALUE 0x8053B102 Val_Ws16 10000.00 EngN 0.00 10000.00 FORMAT "%8.2" EXTENDED_LIMITS -16384.00 16383.50 /end CHARACTERISTIC
/begin CHARACTERISTIC I15031_PID13_C "Location of oxigen sensor" VALUE 0x8053B114 Val_Wu8 255.0 OneToOne 0.00 255.0 FORMAT "%5.1" /end CHARACTERISTIC
/begin CHARACTERISTIC I15031_PID1C_C "OBD requirements to which vehicle is designed" VALUE 0x8053B115 Val_Wu8 51.0000000000 I15031_PID1CVerb 1.0000000000 52.0000000000 FORMAT "%13.10" /end CHARACTERISTIC
/begin CHARACTERISTIC I15031_PID1D_C "Location of oxygen sensors" VALUE 0x8053B116 Val_Wu8 255.0 OneToOne 0.00 255.0 FORMAT "%5.1" /end CHARACTERISTIC
/begin CHARACTERISTIC I15031_PID4FA_C "External Test Equipment Configuration Information. Maximum value for Equivalence Ratio" VALUE 0x8053B117 Val_Wu8 255.0 OneToOne 0.00 255.0 FORMAT "%5.1" /end CHARACTERISTIC
/begin CHARACTERISTIC I15031_PID4FB_C "External Test Equipment Configuration Information. Maximum value for Oxygen Sensor Voltage" VALUE 0x8053B118 Val_Wu8 255.0 OneToOne 0.00 255.0 FORMAT "%5.1" /end CHARACTERISTIC
/begin CHARACTERISTIC I15031_PID4FC_C "External Test Equipment Configuration Information. Maximum value for Oxygen Sensor Current" VALUE 0x8053B119 Val_Wu8 255.0 OneToOne 0.00 255.0 FORMAT "%5.1" /end CHARACTERISTIC
/begin CHARACTERISTIC I15031_PID4FD_C "External Test Equipment Configuration Information. Maximum value for Intake Manifold Absolute Pressure." VALUE 0x8053B11A Val_Wu8 2550. OneToTenCarb 0.00 2550. FORMAT "%5.0" /end CHARACTERISTIC
/begin CHARACTERISTIC I15031_PID50A_C "External Test Equipment Configuration Information. Maximum value for ""Air Flow Rate from Mass Air Flow Sensor""" VALUE 0x8053B11B Val_Wu8 2550. OneToTenCarb 0.00 2550. FORMAT "%5.0" /end CHARACTERISTIC
/begin CHARACTERISTIC I15031_PID5F_C "OBD requirements to which vehicle is designed" VALUE 0x8053B11C Val_Wu8 3.00000000000 I15031_PID5FVerb 14.0000000000 17.0000000000 FORMAT "%13.10" /end CHARACTERISTIC
/begin CHARACTERISTIC I15031_PID65A_C "Shows which Auxiliary Inputs / Outputs are supported in PID65" VALUE 0x8053B11D Val_Wu8 255.0 OneToOne 0.00 255.0 FORMAT "%5.1" /end CHARACTERISTIC
/begin CHARACTERISTIC I15031_PID66A_C "Shows which Mass Air Flow Sensor data are supported in PID66" VALUE 0x8053B11E Val_Wu8 255.0 OneToOne 0.00 255.0 FORMAT "%5.1" /end CHARACTERISTIC
/begin CHARACTERISTIC I15031_PID67A_C "Shows which Engine Coolant Temperature data are supported in PID67" VALUE 0x8053B11F Val_Wu8 255.0 OneToOne 0.00 255.0 FORMAT "%5.1" /end CHARACTERISTIC
/begin CHARACTERISTIC I15031_PID68A_C "Shows which Intake Air Temperature Sensor data are supported in PID68" VALUE 0x8053B120 Val_Wu8 255.0 OneToOne 0.00 255.0 FORMAT "%5.1" /end CHARACTERISTIC
/begin CHARACTERISTIC I15031_PID69A_C "Shows which Commanded EGR System data are supported in PID69" VALUE 0x8053B121 Val_Wu8 255.0 OneToOne 0.00 255.0 FORMAT "%5.1" /end CHARACTERISTIC
/begin CHARACTERISTIC I15031_PID6AA_C "Shows which Commanded Diesel Intake Air Flow Control and Relative Intake Air Flow Position data are supported in PID6A" VALUE 0x8053B122 Val_Wu8 255.0 OneToOne 0.00 255.0 FORMAT "%5.1" /end CHARACTERISTIC
/begin CHARACTERISTIC I15031_PID6BA_C "Shows which Exhaust Gas Recirculation Temperature data are supported in PID6B" VALUE 0x8053B123 Val_Wu8 255.0 OneToOne 0.00 255.0 FORMAT "%5.1" /end CHARACTERISTIC
/begin CHARACTERISTIC I15031_PID6CA_C "Shows which Commanded Throttle Actuator Control and Relative Throttle Position data are supported in PID6C" VALUE 0x8053B124 Val_Wu8 255.0 OneToOne 0.00 255.0 FORMAT "%5.1" /end CHARACTERISTIC
/begin CHARACTERISTIC I15031_PID6DA_C "Shows which Fuel Pressure Control System data are supported in PID6D" VALUE 0x8053B125 Val_Wu8 255.0 OneToOne 0.00 255.0 FORMAT "%5.1" /end CHARACTERISTIC
/begin CHARACTERISTIC I15031_PID6EA_C "Shows which Injection Pressure Control System data are supported in PID6E" VALUE 0x8053B126 Val_Wu8 255.0 OneToOne 0.00 255.0 FORMAT "%5.1" /end CHARACTERISTIC
/begin CHARACTERISTIC I15031_PID6FA_C "Shows which Turbocharger Compressor Inlet Pressure data are supported in PID6F" VALUE 0x8053B127 Val_Wu8 255.0 OneToOne 0.00 255.0 FORMAT "%5.1" /end CHARACTERISTIC
/begin CHARACTERISTIC I15031_PID70A_C "Shows which Boost Pressure Control data are supported in PID70" VALUE 0x8053B128 Val_Wu8 255.0 OneToOne 0.00 255.0 FORMAT "%5.1" /end CHARACTERISTIC
/begin CHARACTERISTIC I15031_PID71A_C "Shows which Variable Geometry Turbo (VGT) Control data are supported in PID71" VALUE 0x8053B129 Val_Wu8 255.0 OneToOne 0.00 255.0 FORMAT "%5.1" /end CHARACTERISTIC
/begin CHARACTERISTIC I15031_PID72A_C "Shows which Wastegate Control data are supported in PID72" VALUE 0x8053B12A Val_Wu8 255.0 OneToOne 0.00 255.0 FORMAT "%5.1" /end CHARACTERISTIC
/begin CHARACTERISTIC I15031_PID73A_C "Shows which Exhaust Pressure data are supported in PID73" VALUE 0x8053B12B Val_Wu8 255.0 OneToOne 0.00 255.0 FORMAT "%5.1" /end CHARACTERISTIC
/begin CHARACTERISTIC I15031_PID74A_C "Shows which Turbocharger RPM data are supported in PID74" VALUE 0x8053B12C Val_Wu8 255.0 OneToOne 0.00 255.0 FORMAT "%5.1" /end CHARACTERISTIC
/begin CHARACTERISTIC I15031_PID75A_C "Shows which Turbocharger A Temperature data are supported in PID75" VALUE 0x8053B12D Val_Wu8 255.0 OneToOne 0.00 255.0 FORMAT "%5.1" /end CHARACTERISTIC
/begin CHARACTERISTIC I15031_PID76A_C "Shows which Turbocharger B Temperature data are supported in PID76" VALUE 0x8053B12E Val_Wu8 255.0 OneToOne 0.00 255.0 FORMAT "%5.1" /end CHARACTERISTIC
/begin CHARACTERISTIC I15031_PID77A_C "Shows which Charge Air Cooler Temperature (CACT) data are supported in PID77" VALUE 0x8053B12F Val_Wu8 255.0 OneToOne 0.00 255.0 FORMAT "%5.1" /end CHARACTERISTIC
/begin CHARACTERISTIC I15031_PID78A_C "Shows which Exhaust Gas Temperature (EGT) Bank 1 data are supported in PID78" VALUE 0x8053B130 Val_Wu8 255.0 OneToOne 0.00 255.0 FORMAT "%5.1" /end CHARACTERISTIC
/begin CHARACTERISTIC I15031_PID79A_C "Shows which Exhaust Gas Temperature (EGT) Bank 2 data are supported in PID79" VALUE 0x8053B131 Val_Wu8 255.0 OneToOne 0.00 255.0 FORMAT "%5.1" /end CHARACTERISTIC
/begin CHARACTERISTIC I15031_PID7AA_C "Shows which Particulate Filter (PF) Bank 1 data are supported in PID7A" VALUE 0x8053B132 Val_Wu8 255.0 OneToOne 0.00 255.0 FORMAT "%5.1" /end CHARACTERISTIC
/begin CHARACTERISTIC I15031_PID7BA_C "Shows which Particulate Filter (PF) Bank 2 data are supported in PID7B" VALUE 0x8053B133 Val_Wu8 255.0 OneToOne 0.00 255.0 FORMAT "%5.1" /end CHARACTERISTIC
/begin CHARACTERISTIC I15031_PID7CA_C "Shows which Particulate Filter (PF) Temperature data are supported in PID7C" VALUE 0x8053B134 Val_Wu8 255.0 OneToOne 0.00 255.0 FORMAT "%5.1" /end CHARACTERISTIC
/begin CHARACTERISTIC I15031_PID7FA_C "Shows which Engine Run Time is supported in PID7F" VALUE 0x8053B135 Val_Wu8 255.0 OneToOne 0.00 255.0 FORMAT "%5.1" /end CHARACTERISTIC
/begin CHARACTERISTIC I15031_PID81A_C "Shows which Engine Run Time for AECD #1 - #5 is supported in PID81" VALUE 0x8053B136 Val_Wu8 255.0 OneToOne 0.00 255.0 FORMAT "%5.1" /end CHARACTERISTIC
/begin CHARACTERISTIC I15031_PID82A_C "Shows which Engine Run Time for AECD #6 - #10 is supported in PID82" VALUE 0x8053B137 Val_Wu8 255.0 OneToOne 0.00 255.0 FORMAT "%5.1" /end CHARACTERISTIC
/begin CHARACTERISTIC I15031_PID83A_C "Shows which NOx Sensor data are supported in PID83" VALUE 0x8053B138 Val_Wu8 255.0 OneToOne 0.00 255.0 FORMAT "%5.1" /end CHARACTERISTIC
/begin CHARACTERISTIC I15031_PID85A_C "Shows which NOx Control System data are supported in PID85" VALUE 0x8053B139 Val_Wu8 255.0 OneToOne 0.00 255.0 FORMAT "%5.1" /end CHARACTERISTIC
/begin CHARACTERISTIC I15031_PID86A_C "Shows which Particulate Matter (PM) Sensor data are supported in PID86" VALUE 0x8053B13A Val_Wu8 255.0 OneToOne 0.00 255.0 FORMAT "%5.1" /end CHARACTERISTIC
/begin CHARACTERISTIC I15031_PID87A_C "Shows which Intake Manifold Absolute Pressure data are supported in PID87" VALUE 0x8053B13B Val_Wu8 255.0 OneToOne 0.00 255.0 FORMAT "%5.1" /end CHARACTERISTIC
/begin CHARACTERISTIC I15031_PID89A_C "Shows which Engine Run Time for AECD #11 - #15 is supported in PID89" VALUE 0x8053B13C Val_Wu8 255.0 OneToOne 0.00 255.0 FORMAT "%5.1" /end CHARACTERISTIC
/begin CHARACTERISTIC I15031_PID8AA_C "Shows which Engine Run Time for AECD #16 - #20 is supported in PID8A" VALUE 0x8053B13D Val_Wu8 255.0 OneToOne 0.00 255.0 FORMAT "%5.1" /end CHARACTERISTIC
/begin CHARACTERISTIC I15031_PID8BA_C "Shows which Aftertreatment Status is supported in PID8B ByteB." VALUE 0x8053B13E Val_Wu8 255.0 OneToOne 0.00 255.0 FORMAT "%5.1" /end CHARACTERISTIC
/begin CHARACTERISTIC I15031_PID8CA_C "Calibration for O2 Sensor Data support information(Sensor 1, Sensor 2)" VALUE 0x8053B13F Val_Wu8 255.0 OneToOne 0.00 255.0 FORMAT "%5.1" /end CHARACTERISTIC
/begin CHARACTERISTIC I15031_PID8FA_C "Shows which PM (Particulate Matter) Sensor Output is supported in PID8F" VALUE 0x8053B140 Val_Wu8 255.0 OneToOne 0.00 255.0 FORMAT "%5.1" /end CHARACTERISTIC
/begin CHARACTERISTIC I15031_PID92A_C "Calibration for Fuel System Status support information" VALUE 0x8053B141 Val_Wu8 255.0 OneToOne 0.00 255.0 FORMAT "%5.1" /end CHARACTERISTIC
/begin CHARACTERISTIC I15031_PID93A_C "Calibration for WWH B1 counter support information" VALUE 0x8053B142 Val_Wu8 255.0 OneToOne 0.00 255.0 FORMAT "%5.1" /end CHARACTERISTIC
/begin CHARACTERISTIC I15031_PID94A_C "Calibration for Inducement Counters support information" VALUE 0x8053B143 Val_Wu8 255.0 OneToOne 0.00 255.0 FORMAT "%5.1" /end CHARACTERISTIC
/begin CHARACTERISTIC I15031_PID98A_C "Shows which exhaust gas temperature for bank 1 data are supported in PID98" VALUE 0x8053B144 Val_Wu8 255.0 OneToOne 0.00 255.0 FORMAT "%5.1" /end CHARACTERISTIC
/begin CHARACTERISTIC I15031_PID99A_C "Calibration for Exhaust Gas Temperature Sensor Data support information" VALUE 0x8053B145 Val_Wu8 255.0 OneToOne 0.00 255.0 FORMAT "%5.1" /end CHARACTERISTIC
/begin CHARACTERISTIC I15031_PID9AA_C "Shows if HybridEV Vehicle State is supported in PID9A" VALUE 0x8053B146 Val_Wu8 255.0 OneToOne 0.00 255.0 FORMAT "%5.1" /end CHARACTERISTIC
/begin CHARACTERISTIC I15031_PID9BA_C "Diesel exhaust fluid sensor output" VALUE 0x8053B147 Val_Wu8 255.0 OneToOne 0.00 255.0 FORMAT "%5.1" /end CHARACTERISTIC
/begin CHARACTERISTIC I15031_PID9CA_C "Calibration for O2 Sensor Data support information(Sensor 3, Sensor 4)" VALUE 0x8053B148 Val_Wu8 255.0 OneToOne 0.00 255.0 FORMAT "%5.1" /end CHARACTERISTIC
/begin CHARACTERISTIC I15031_PID9FA_C "Support of fuel system percentage use" VALUE 0x8053B149 Val_Wu8 255.0 OneToOne 0.00 255.0 FORMAT "%5.1" /end CHARACTERISTIC
/begin CHARACTERISTIC I15031_PIDA1A_C "Displays the NOx Sensor Corrected Data supported in PIDA1" VALUE 0x8053B14A Val_Wu8 255.0 OneToOne 0.00 255.0 FORMAT "%5.1" /end CHARACTERISTIC
/begin CHARACTERISTIC I15031_PIDA3A_C "Evap System Vapor Pressure" VALUE 0x8053B14B Val_Wu8 255.0 OneToOne 0.00 255.0 FORMAT "%5.1" /end CHARACTERISTIC
/begin CHARACTERISTIC I15031_PIDA4A_C "Transmission Actual Gear" VALUE 0x8053B14C Val_Wu8 255.0 OneToOne 0.00 255.0 FORMAT "%5.1" /end CHARACTERISTIC
/begin CHARACTERISTIC I15031_PIDA5A_C "calibration parameter to update message of byte A ini PIDA5 for Diesel Exhaust Fluid Dosing" VALUE 0x8053B14D Val_Wu8 255.0 OneToOne 0.00 255.0 FORMAT "%5.1" /end CHARACTERISTIC
/begin CHARACTERISTIC I15031_PIDA7A_C "Support of NOx Sensor Data" VALUE 0x8053B14E Val_Wu8 255.0 OneToOne 0.00 255.0 FORMAT "%5.1" /end CHARACTERISTIC
/begin CHARACTERISTIC I15031_PIDA8A_C "NOx Sensor Corrected" VALUE 0x8053B14F Val_Wu8 255.0 OneToOne 0.00 255.0 FORMAT "%5.1" /end CHARACTERISTIC
/begin CHARACTERISTIC I15031_PIDA9A_C "Motorcycle InputOutput Status" VALUE 0x8053B150 Val_Wu8 255.0 OneToOne 0.00 255.0 FORMAT "%5.1" /end CHARACTERISTIC
/begin CHARACTERISTIC I15031_PIDACA_C "Shows Support of DEF Dosing Rate or Mode" VALUE 0x8053B151 Val_Wu8 255.0 OneToOne 0.00 255.0 FORMAT "%5.1" /end CHARACTERISTIC
/begin CHARACTERISTIC I15031_srv9PIDTable.PID0_C "" VALUE 0x8053B104 Val_Wu8 255.0 OneToOne 0.00 255.0 FORMAT "%5.1" /end CHARACTERISTIC
/begin CHARACTERISTIC I15031_srv9PIDTable.PID2_C "" VALUE 0x8053B106 Val_Wu8 255.0 OneToOne 0.00 255.0 FORMAT "%5.1" /end CHARACTERISTIC
/begin CHARACTERISTIC I15031_srv9PIDTable.PID4_C "" VALUE 0x8053B108 Val_Wu8 255.0 OneToOne 0.00 255.0 FORMAT "%5.1" /end CHARACTERISTIC
/begin CHARACTERISTIC I15031_srv9PIDTable.PID6_C "" VALUE 0x8053B10A Val_Wu8 255.0 OneToOne 0.00 255.0 FORMAT "%5.1" /end CHARACTERISTIC
/begin CHARACTERISTIC I15031_srv9PIDTable.PID8_C "" VALUE 0x8053B10C Val_Wu8 255.0 OneToOne 0.00 255.0 FORMAT "%5.1" /end CHARACTERISTIC
/begin CHARACTERISTIC I15031_srv9PIDTable.PIDA_C "" VALUE 0x8053B10E Val_Wu8 255.0 OneToOne 0.00 255.0 FORMAT "%5.1" /end CHARACTERISTIC
/begin CHARACTERISTIC I15031_srv9PIDTable.PIDB_C "" VALUE 0x8053B10F Val_Wu8 255.0 OneToOne 0.00 255.0 FORMAT "%5.1" /end CHARACTERISTIC
/begin CHARACTERISTIC I15031_srv9PIDTable.PIDF_C "" VALUE 0x8053B113 Val_Wu8 255.0 OneToOne 0.00 255.0 FORMAT "%5.1" /end CHARACTERISTIC
/begin CHARACTERISTIC I15031_stRfrshCal_C "Start of support calculation for Service0102" VALUE 0x8053B152 Val_Wu8 1.000 OneToOne 0.00 1.000 FORMAT "%5.3" EXTENDED_LIMITS 0.00 255.0 /end CHARACTERISTIC
/begin CHARACTERISTIC TATEOUT1 "calibration output duty cycle for canister purge valve 1 (only for test)" VALUE 0x80525058 RB_Val_Wu16 99.99847 rel_uw_b100 0.00 99.99847 FORMAT "%8.5" /end CHARACTERISTIC
/begin CHARACTERISTIC VlvLft_pOilPIntkHighrThd_C "Upper Threshold of hysteresis value for intake VTEC pressure sensor" VALUE 0x8052505A RB_Val_Ws16 6553.500 Pres -3276.800 3276.700 FORMAT "%8.3" /end CHARACTERISTIC
/begin CHARACTERISTIC VlvLft_pOilPIntkLowrThd_C "Upper Threshold of hysteresis value for exhaust VTEC pressure sensor" VALUE 0x8052505C RB_Val_Ws16 6553.500 Pres -3276.800 3276.700 FORMAT "%8.3" /end CHARACTERISTIC
/begin CHARACTERISTIC VlvLft_pTrfPSnsrIntk_T "Curve to map ADC voltage to intake physcial oil pressure" CURVE 0x8052505E RB_Curve_S16_S16 6553.500 Pres -3276.800 3276.700 FORMAT "%8.3"
 /begin AXIS_DESCR STD_AXIS VlvLft_uRawPSnsrIntkFild Volt 8 -6553.600 6553.400 FORMAT "%8.3" DEPOSIT ABSOLUTE /end AXIS_DESCR
/end CHARACTERISTIC
/begin CHARACTERISTIC Vlvlft_stFbIntkSwt_C "Calibration for Valvelift Intake Feedback Switch Mode" VALUE 0x80525080 RB_Val_Wu8 2.00000000000 VlvLft_stFbSwt_VERB 0.00 2.00000000000 FORMAT "%13.11" /end CHARACTERISTIC
/begin CHARACTERISTIC VlvLft_tiOilPSnsrIntkLT_C "Filter time for inlet VTEC oil pressure value for LowpassT filter" VALUE 0x80525082 RB_Val_Wu16 65.53400 t_q0p001 0.00100 65.53500 FORMAT "%8.5" EXTENDED_LIMITS 0.00 65.53500 /end CHARACTERISTIC
/begin CHARACTERISTIC VlvLft_tiSpclPrSwtIntkDeb_C "Timer special pressure switch intake" VALUE 0x80525084 RB_Val_Wu8 0.2550 t_q0p001 0.00 0.2550 FORMAT "%6.4" /end CHARACTERISTIC
/begin CHARACTERISTIC VlvLft_tiStdPrSwtIntkDeb_C "Timer standard pressure switch intake" VALUE 0x80525085 RB_Val_Wu8 0.2550 t_q0p001 0.00 0.2550 FORMAT "%6.4" /end CHARACTERISTIC
/begin MEASUREMENT BattuT30C_uRaw "Raw battery voltage at T30C in Voltage" SWORD spg_q0p001 1 100 -32.76800 32.76700 FORMAT "%8.5" ECU_ADDRESS 0x70001E90 /end MEASUREMENT
/begin MEASUREMENT B_cht2ktvhe "calculation condition inlet" UBYTE B_TRUE 1 100 0.00 1.00000000000 BIT_MASK 0x1 FORMAT "%13.11" ECU_ADDRESS 0x7000199F /end MEASUREMENT
/begin MEASUREMENT B_dmdsteol "diagnosis misfire detection delayed during End-On-Line check" UBYTE B_TRUE 1 100 0.00 1.00000000000 BIT_MASK 0x1 FORMAT "%13.11" ECU_ADDRESS 0x700001F8 /end MEASUREMENT
/begin MEASUREMENT B_tevtini_msg "TEV timer re-initialized" UBYTE B_TRUE 1 100 0.00 1.00000000000 BIT_MASK 0x1 FORMAT "%13.11" ECU_ADDRESS 0x70000985 /end MEASUREMENT
/begin MEASUREMENT B_wrm "Hysteresis for HLSDem_bNMaxWrm" UBYTE B_TRUE 1 100 0.00 1.00000000000 BIT_MASK 0x1 FORMAT "%13.11" ECU_ADDRESS 0x70000200 /end MEASUREMENT
/begin MEASUREMENT Com_lDstDCShip "Allowed distance in 1DCY with shipping mode" SLONG OilMlg 1 100 -2147483648.00 2147483647.00 FORMAT "%13.2" ECU_ADDRESS 0x60036578 /end MEASUREMENT
/begin MEASUREMENT Com_lTarShipModDst "Target total travel distance for activation of Shipping mode" SLONG OilMlg 1 100 -2147483648.00 2147483647.00 FORMAT "%13.2" ECU_ADDRESS 0x60036574 /end MEASUREMENT
/begin MEASUREMENT Com_stShipMod "Status of requesting for Rapid charging mode from Shipping mode operation" UBYTE OneToOne 1 100 0.00 255.0 BIT_MASK 0x1 FORMAT "%5.1" ECU_ADDRESS 0x60037F7C /end MEASUREMENT
/begin MEASUREMENT Com_stShipModOdoSupp "suppression flag for odometer related checks" UBYTE OneToOne 1 100 0.00 255.0 FORMAT "%5.1" ECU_ADDRESS 0x6000A499 /end MEASUREMENT
/begin MEASUREMENT Com_stShipModSupp "suppression flag for other checks" UBYTE OneToOne 1 100 0.00 255.0 FORMAT "%5.1" ECU_ADDRESS 0x6000A498 /end MEASUREMENT
/begin MEASUREMENT Com_stShipModSuppFlg "suppression flag to reset shipping mode" UBYTE OneToOne 1 100 0.00 255.0 FORMAT "%5.1" ECU_ADDRESS 0x6000A497 /end MEASUREMENT
/begin MEASUREMENT CstrPurg_ratPercCpv "output duty cycle of CPV" SWORD rel_sw_b100 1 100 -100.0000 99.9969 FORMAT "%8.4" ECU_ADDRESS 0x60003796 /end MEASUREMENT
/begin MEASUREMENT ECUSerNum "ECU serial number" UBYTE OneToOne 1 100 0.00 255.0 FORMAT "%5.1" ARRAY_SIZE 13 ECU_ADDRESS 0x6000A761 /end MEASUREMENT
/begin MEASUREMENT FPCtl_flgReIniHT2KTTEV20ms "Flag: Re-Initialization necessary for HT2KTTEV 20ms" UBYTE B_TRUE 1 100 0.00 1.00000000000 BIT_MASK 0x1 FORMAT "%13.11" ECU_ADDRESS 0x700001F9 /end MEASUREMENT
/begin MEASUREMENT HLSDem_bDrvOffSuprtActv "Drive-off support is active" UBYTE B_TRUE 1 100 0.00 1.00000000000 BIT_MASK 0x1 FORMAT "%13.11" ECU_ADDRESS 0x6000A184 /end MEASUREMENT
/begin MEASUREMENT HLSDem_bNMaxEngExtPrio "Condition external speed limitiation request" UBYTE B_TRUE 1 100 0.00 1.00000000000 BIT_MASK 0x1 FORMAT "%13.11" ECU_ADDRESS 0x7000075A /end MEASUREMENT
/begin MEASUREMENT HLSDem_bNMaxEngOvht "Condition engine speed limitation because engine component overheat - path for vehicle control" UBYTE B_TRUE 1 100 0.00 1.00000000000 BIT_MASK 0x1 FORMAT "%13.11" ECU_ADDRESS 0x700001FB /end MEASUREMENT
/begin MEASUREMENT HLSDem_bNMaxEngPrioOvht "Engine Speed limitation priority flag because engine component overheat" UBYTE B_TRUE 1 100 0.00 1.00000000000 BIT_MASK 0x1 FORMAT "%13.11" ECU_ADDRESS 0x700001FA /end MEASUREMENT
/begin MEASUREMENT HLSDem_bNMaxHi "Condition short increase of engine speed limit" UBYTE B_TRUE 1 100 0.00 1.00000000000 BIT_MASK 0x1 FORMAT "%13.11" ECU_ADDRESS 0x700001FF /end MEASUREMENT
/begin MEASUREMENT HLSDem_bNMaxHiTmp "Limitation of engine speed because of high temperature" UBYTE B_TRUE 1 100 0.00 1.00000000000 BIT_MASK 0x1 FORMAT "%13.11" ECU_ADDRESS 0x70000759 /end MEASUREMENT
/begin MEASUREMENT HLSDem_bNMaxHiTmpLmpOn "Request hot lamp on because of limitation of engine speed" UBYTE B_TRUE 1 100 0.00 1.00000000000 BIT_MASK 0x1 FORMAT "%13.11" ECU_ADDRESS 0x70000758 /end MEASUREMENT
/begin MEASUREMENT HLSDem_bNMaxKnCtl "Condition engine speed limitation at safety ignition retard by knock control" UBYTE B_TRUE 1 100 0.00 1.00000000000 BIT_MASK 0x1 FORMAT "%13.11" ECU_ADDRESS 0x700001FE /end MEASUREMENT
/begin MEASUREMENT HLSDem_bNMaxPrio "Condition set desired transmission speed" UBYTE B_TRUE 1 100 0.00 1.00000000000 BIT_MASK 0x1 FORMAT "%13.11" ECU_ADDRESS 0x70000757 /end MEASUREMENT
/begin MEASUREMENT HLSDem_bNMaxRed "Reduce of maximum engine speed" UBYTE B_TRUE 1 100 0.00 1.00000000000 BIT_MASK 0x1 FORMAT "%13.11" ECU_ADDRESS 0x70000756 /end MEASUREMENT
/begin MEASUREMENT HLSDem_bNMaxRedPT "Flag to indicate engine speed limitation is not from powertrain" UBYTE B_TRUE 1 100 0.00 1.00000000000 BIT_MASK 0x1 FORMAT "%13.11" ECU_ADDRESS 0x60006450 /end MEASUREMENT
/begin MEASUREMENT HLSDem_bNMaxRmpUp "Condition Ramping up of engine speed is active in the calculation of High Setpoint." UBYTE B_TRUE 1 100 0.00 1.00000000000 BIT_MASK 0x1 FORMAT "%13.11" ECU_ADDRESS 0x70000755 /end MEASUREMENT
/begin MEASUREMENT HLSDem_bNMaxWrm "Speed limit warm-up activ" UBYTE B_TRUE 1 100 0.00 1.00000000000 BIT_MASK 0x1 FORMAT "%13.11" ECU_ADDRESS 0x70000754 /end MEASUREMENT
/begin MEASUREMENT HLSDem_bOvhtEngNLim "Engine speed limitation due to high temperatures active" UBYTE B_TRUE 1 100 0.00 1.00000000000 BIT_MASK 0x1 FORMAT "%13.11" ECU_ADDRESS 0x70000753 /end MEASUREMENT
/begin MEASUREMENT HLSDem_bOvhtEngNLimGov "Engine speed limitation due to high temperatures for governor active." UBYTE B_TRUE 1 100 0.00 1.00000000000 BIT_MASK 0x1 FORMAT "%13.11" ECU_ADDRESS 0x70000752 /end MEASUREMENT
/begin MEASUREMENT HLSDem_bOvrRunDlyTOFFV_I.outbit "Overrun turn-off delay / Output Bit" UBYTE B_TRUE 1 100 0.00 1.00000000000 BIT_MASK 0x1 FORMAT "%13.11" ECU_ADDRESS 0x600037A6 /end MEASUREMENT
/begin MEASUREMENT HLSDem_bOvrRunDlyTOFFV_I.time "Overrun turn-off delay / Occured Time" UWORD t_q0p1 1 100 0.00 6553.500 FORMAT "%8.3" ECU_ADDRESS 0x600037A8 /end MEASUREMENT
/begin MEASUREMENT HLSDem_bPTMaxPrio "Condition for setting desired gearbox engine speed" UBYTE B_TRUE 1 100 0.00 1.00000000000 BIT_MASK 0x1 FORMAT "%13.11" ECU_ADDRESS 0x70000751 /end MEASUREMENT
/begin MEASUREMENT HLSDem_bRmpUpRdy "Condition Ramping up of engine speed is not active in the calculation of High Setpoint." UBYTE B_TRUE 1 100 0.00 1.00000000000 BIT_MASK 0x1 FORMAT "%13.11" ECU_ADDRESS 0x6000644F /end MEASUREMENT
/begin MEASUREMENT HLSDem_bStandStillLimActv "Standstill limitation active." UBYTE B_TRUE 1 100 0.00 1.00000000000 BIT_MASK 0x1 FORMAT "%13.11" ECU_ADDRESS 0x700001FD /end MEASUREMENT
/begin MEASUREMENT HLSDem_bVehStand "Status standstill of vehicle" UBYTE B_TRUE 1 100 0.00 1.00000000000 BIT_MASK 0x1 FORMAT "%13.11" ECU_ADDRESS 0x60006458 /end MEASUREMENT
/begin MEASUREMENT HLSDem_dnMaxEng "Idle speed difference between two calculation steps based on HLSDem_nMaxEng" SWORD EngN 1 100 -16384.00 16383.50 FORMAT "%8.2" ECU_ADDRESS 0x600037A2 /end MEASUREMENT
/begin MEASUREMENT HLSDem_DrvOffLim_FF.status "FlipFlop for activating the drive off limitation / current value of RS-FF" UBYTE B_TRUE 1 100 0.00 1.00000000000 BIT_MASK 0x1 FORMAT "%13.11" ECU_ADDRESS 0x60006455 /end MEASUREMENT
/begin MEASUREMENT HLSDem_ExDrvOff_TONVNM.time "FlipFlop for deactivating the drive off limitation / Delay Time" UBYTE t_q0p1 1 100 0.00 25.50 FORMAT "%5.2" ECU_ADDRESS 0x60006454 /end MEASUREMENT
/begin MEASUREMENT HLSDem_facAppDeadZone "Weighted voltage difference between accelerator pedal sensor 1 and accelerator pedal sensor 2" SWORD Fact 1 100 -4.000000 3.999878 FORMAT "%8.6" ECU_ADDRESS 0x60005040 /end MEASUREMENT
/begin MEASUREMENT HLSDem_facEngSpdLim "Weighing factor for Engine speed limitation from different temperatures." SWORD Fact 1 100 -4.000000 3.999878 FORMAT "%8.6" ECU_ADDRESS 0x6000D916 /end MEASUREMENT
/begin MEASUREMENT HLSDem_facEngSpdLimGov "Weighing factor for Engine speed limitation for governor from different temperatures." SWORD Fact 1 100 -4.000000 3.999878 FORMAT "%8.6" ECU_ADDRESS 0x6000D918 /end MEASUREMENT
/begin MEASUREMENT HLSDem_flgDrvOffActv "Condition overspeed limitation at drive-off active" UBYTE B_TRUE 1 100 0.00 1.00000000000 BIT_MASK 0x1 FORMAT "%13.11" ECU_ADDRESS 0x700001FC /end MEASUREMENT
/begin MEASUREMENT HLSDem_flgSpdClthGearAccrSigErr "Bit, if sensor fault of spd, clth, gear, accr is detected" UBYTE B_TRUE 1 100 0.00 1.00000000000 BIT_MASK 0x1 FORMAT "%13.11" ECU_ADDRESS 0x60006457 /end MEASUREMENT
/begin MEASUREMENT HLSDem_flgSptModActv "Flag to indicate sport mode related drivability parameters are active" UBYTE B_TRUE 1 100 0.00 1.00000000000 BIT_MASK 0x1 FORMAT "%13.11" ECU_ADDRESS 0x6000A183 /end MEASUREMENT
/begin MEASUREMENT HLSDem_GearChngFF_I.status "FlipFlop for gear change in active drive off limitation / current value of RS-FF" UBYTE B_TRUE 1 100 0.00 1.00000000000 BIT_MASK 0x1 FORMAT "%13.11" ECU_ADDRESS 0x60006453 /end MEASUREMENT
/begin MEASUREMENT HLSDem_hOvht "Relative heat in engine components - model value for engine speed limitation" UWORD h_uw_q1p5 1 100 0.00 98302.50 FORMAT "%8.2" ECU_ADDRESS 0x6003657C /end MEASUREMENT
/begin MEASUREMENT HLSDem_hOvhtHLR_I.hysterese "Relative heat hystheresis / Current value of the hysteresis" UBYTE B_TRUE 1 100 0.00 1.00000000000 BIT_MASK 0x1 FORMAT "%13.11" ECU_ADDRESS 0x60006451 /end MEASUREMENT
/begin MEASUREMENT HLSDem_hOvhtITL_I.memory "Relative heat Integrator / current integrator value" ULONG Temp_Kelv 1 100 0.00 429496729.500 FORMAT "%13.3" ECU_ADDRESS 0x60001390 /end MEASUREMENT
/begin MEASUREMENT HLSDem_KnCtlTONVNM_I.time "Delay for knock control error limitation / Delay Time" UBYTE t_q0p1 1 100 0.00 25.50 FORMAT "%5.2" ECU_ADDRESS 0x6000E3B0 /end MEASUREMENT
/begin MEASUREMENT HLSDem_KnCtl_NRamp_I.nRampMem "Ramp for knock control error limitation / Temporary variable of ramp for engine speed limitation in drive off" SLONG EngN 1 100 -1073741824.00 1073741823.50 FORMAT "%13.2" ECU_ADDRESS 0x60001394 /end MEASUREMENT
/begin MEASUREMENT HLSDem_nDrvOffLim "Overspeed limitation at drive-off" SWORD EngN 1 100 -16384.00 16383.50 FORMAT "%8.2" ECU_ADDRESS 0x600037B4 /end MEASUREMENT
/begin MEASUREMENT HLSDem_nDrvOffSuprtAbsltSp "Unfiltered Low idle setpoint for drive-off support when HLSDem_swtDrvOffSuprtSpMod_C == 1" SWORD nmot_sw_q0p5 1 100 -16384.00 16383.50 FORMAT "%8.2" ECU_ADDRESS 0x600037C2 /end MEASUREMENT
/begin MEASUREMENT HLSDem_nDrvOffSuprtBascSpLo "Basic low idle speed for drive-off support (used when HLSDem_swtDrvOffSuprtSpMod_C == 0)" SWORD nmot_sw_q0p5 1 100 -16384.00 16383.50 FORMAT "%8.2" ECU_ADDRESS 0x600037C0 /end MEASUREMENT
/begin MEASUREMENT HLSDem_nDrvOffSuprtOffs "Offset engine speed for drive-off support (used when HLSDem_swtDrvOffSuprtSpMod_C == 0)" SWORD nmot_sw_q0p5 1 100 -16384.00 16383.50 FORMAT "%8.2" ECU_ADDRESS 0x600037BE /end MEASUREMENT
/begin MEASUREMENT HLSDem_nDrvOffSuprtSp "Low idle setpoint demand from drive-off support" SWORD nmot_sw_q0p5 1 100 -16384.00 16383.50 FORMAT "%8.2" ECU_ADDRESS 0x6000503E /end MEASUREMENT
/begin MEASUREMENT HLSDem_nDrvOffSuprtSpIncr "Drvoff support setpoint" SWORD nmot_sw_q0p5 1 100 -16384.00 16383.50 FORMAT "%8.2" ECU_ADDRESS 0x6000503C /end MEASUREMENT
/begin MEASUREMENT HLSDem_nDrvOffSuprtSpRaw "Unfiltered low idle setpoint for drive-off support" SWORD nmot_sw_q0p5 1 100 -16384.00 16383.50 FORMAT "%8.2" ECU_ADDRESS 0x600037BC /end MEASUREMENT
/begin MEASUREMENT HLSDem_nGearLim "Gear dependant engine speed limit" SWORD EngN 1 100 -16384.00 16383.50 FORMAT "%8.2" ECU_ADDRESS 0x6000503A /end MEASUREMENT
/begin MEASUREMENT HLSDem_nHiTemp_mp "Current speed maximum with activ drag indicator" SWORD EngN 1 100 -16384.00 16383.50 FORMAT "%8.2" ECU_ADDRESS 0x70008D30 /end MEASUREMENT
/begin MEASUREMENT HLSDem_nKnCtlLim "Max engine speed allowed due to active safety ignition retardation active" SWORD EngN 1 100 -16384.00 16383.50 FORMAT "%8.2" ECU_ADDRESS 0x600037B2 /end MEASUREMENT
/begin MEASUREMENT HLSDem_nMax "Desired engine speed for rpm control" SWORD EngN 1 100 -16384.00 16383.50 FORMAT "%8.2" ECU_ADDRESS 0x6000E276 /end MEASUREMENT
/begin MEASUREMENT HLSDem_nMaxAVSLimGov_mp "Engine speed limitation including AVS" SWORD EngN 1 100 -16384.00 16383.50 FORMAT "%8.2" ECU_ADDRESS 0x70008D3E /end MEASUREMENT
/begin MEASUREMENT HLSDem_nMaxBDELimGov_mp "Engine speed limitation including BDE limitation." SWORD EngN 1 100 -16384.00 16383.50 FORMAT "%8.2" ECU_ADDRESS 0x70008D3C /end MEASUREMENT
/begin MEASUREMENT HLSDem_nMaxBefLim "Maximum permissible engine speed before limitations." SWORD EngN 1 100 -16384.00 16383.50 FORMAT "%8.2" ECU_ADDRESS 0x600037B0 /end MEASUREMENT
/begin MEASUREMENT HLSDem_nMaxChaElgLimGov_mp "Engine speed limitation including ChaElg limitation." SWORD EngN 1 100 -16384.00 16383.50 FORMAT "%8.2" ECU_ADDRESS 0x70008D3A /end MEASUREMENT
/begin MEASUREMENT HLSDem_nMaxDspl "Maximum engine speed limit for display" SWORD EngN 1 100 -16384.00 16383.50 FORMAT "%8.2" ECU_ADDRESS 0x60005038 /end MEASUREMENT
/begin MEASUREMENT HLSDem_nMaxEng "Max. allowed engine speed, filtering allowed" SWORD EngN 1 100 -16384.00 16383.50 FORMAT "%8.2" ECU_ADDRESS 0x600049DC /end MEASUREMENT
/begin MEASUREMENT HLSDem_nMaxEngExt "External speed limitation request" SWORD EngN 1 100 -16384.00 16383.50 FORMAT "%8.2" ECU_ADDRESS 0x600049DA /end MEASUREMENT
/begin MEASUREMENT HLSDem_nMaxEngExtGov "Max speed limitation on external speed governor." SWORD EngN 1 100 -16384.00 16383.50 FORMAT "%8.2" ECU_ADDRESS 0x600049D8 /end MEASUREMENT
/begin MEASUREMENT HLSDem_nMaxEngFlt "Max. allowed engine speed, filtering allowed" SWORD EngN 1 100 -16384.00 16383.50 FORMAT "%8.2" ECU_ADDRESS 0x6000E278 /end MEASUREMENT
/begin MEASUREMENT HLSDem_nMaxEngFltGov "Max. allowed engine speed, filtering allowed , for governor" SWORD EngN 1 100 -16384.00 16383.50 FORMAT "%8.2" ECU_ADDRESS 0x6000E27A /end MEASUREMENT
/begin MEASUREMENT HLSDem_nMaxEngGovOvht "Engine speed limitation because engine component overheat - governor path for engine control" SWORD EngN 1 100 -16384.00 16383.50 FORMAT "%8.2" ECU_ADDRESS 0x600037AE /end MEASUREMENT
/begin MEASUREMENT HLSDem_nMaxEngOld "old value of max. allowed engine speed, filtering allowed" SWORD EngN 1 100 -16384.00 16383.50 FORMAT "%8.2" ECU_ADDRESS 0x600037A0 /end MEASUREMENT
/begin MEASUREMENT HLSDem_nMaxEngOvht "Engine speed limitation because engine component overheat - path for vehicle control" SWORD EngN 1 100 -16384.00 16383.50 FORMAT "%8.2" ECU_ADDRESS 0x600037AC /end MEASUREMENT
/begin MEASUREMENT HLSDem_nMaxEngUnFlt "Max. allowed engine speed, filtering not allowed" SWORD EngN 1 100 -16384.00 16383.50 FORMAT "%8.2" ECU_ADDRESS 0x6000E27C /end MEASUREMENT
/begin MEASUREMENT HLSDem_nMaxEngWoHalt "Engine speed limitation without standstill limitation" SWORD EngN 1 100 -16384.00 16383.50 FORMAT "%8.2" ECU_ADDRESS 0x600049D6 /end MEASUREMENT
/begin MEASUREMENT HLSDem_nMaxEngWoHaltGov "Engine speed limitation without standstill limitation for governor" SWORD EngN 1 100 -16384.00 16383.50 FORMAT "%8.2" ECU_ADDRESS 0x6000E27E /end MEASUREMENT
/begin MEASUREMENT HLSDem_nMaxHiStd "Engine speed limitation during normal conditions" SWORD EngN 1 100 -16384.00 16383.50 FORMAT "%8.2" ECU_ADDRESS 0x6000E280 /end MEASUREMENT
/begin MEASUREMENT HLSDem_nMaxHi_mp "Increased engine speed limit" SWORD EngN 1 100 -16384.00 16383.50 FORMAT "%8.2" ECU_ADDRESS 0x70008D38 /end MEASUREMENT
/begin MEASUREMENT HLSDem_nMaxKnCtlLimGov_mp "Engine speed limitation including Knock control limitation." SWORD EngN 1 100 -16384.00 16383.50 FORMAT "%8.2" ECU_ADDRESS 0x70008D36 /end MEASUREMENT
/begin MEASUREMENT HLSDem_nMaxLimpHome "Maximum limit of Engine speed at limp home" SWORD EngN 1 100 -16384.00 16383.50 FORMAT "%8.2" ECU_ADDRESS 0x6000379E /end MEASUREMENT
/begin MEASUREMENT HLSDem_nMaxRmp "Output value of positive ramp for high SetPoint." SWORD EngN 1 100 -16384.00 16383.50 FORMAT "%8.2" ECU_ADDRESS 0x60005036 /end MEASUREMENT
/begin MEASUREMENT HLSDem_nMaxStd_mp "Stationary engine speed limit" SWORD EngN 1 100 -16384.00 16383.50 FORMAT "%8.2" ECU_ADDRESS 0x70008D34 /end MEASUREMENT
/begin MEASUREMENT HLSDem_nMaxT "Engine speed limit based on oil and engine temperature." SWORD EngN 1 100 -16384.00 16383.50 FORMAT "%8.2" ECU_ADDRESS 0x6000D91A /end MEASUREMENT
/begin MEASUREMENT HLSDem_nMaxUnFltPT_mp "Coordinated, unfiltered maximum engine speed from Eng and PwrTrn" SWORD EngN 1 100 -16384.00 16383.50 FORMAT "%8.2" ECU_ADDRESS 0x70008D2E /end MEASUREMENT
/begin MEASUREMENT HLSDem_nMaxVErr_mp "Maximum engine speed in case vehicle speed sensor signal is invalid for vehicles with automatic gearbox" SWORD EngN 1 100 -16384.00 16383.50 FORMAT "%8.2" ECU_ADDRESS 0x70008D2C /end MEASUREMENT
/begin MEASUREMENT HLSDem_nOffsDrvOffSpIncKissPnt "Kisspoint setpoint for drvoff" SWORD nmot_sw_q0p5 1 100 -16384.00 16383.50 FORMAT "%8.2" ECU_ADDRESS 0x60005030 /end MEASUREMENT
/begin MEASUREMENT HLSDem_nOffsSpIncrCreep "creep offset for drvoff" SWORD nmot_sw_q0p5 1 100 -16384.00 16383.50 FORMAT "%8.2" ECU_ADDRESS 0x6000502E /end MEASUREMENT
/begin MEASUREMENT HLSDem_nOvhtEngNLim "Engine speed limitation due to high temperatures" SWORD EngN 1 100 -16384.00 16383.50 FORMAT "%8.2" ECU_ADDRESS 0x6000E282 /end MEASUREMENT
/begin MEASUREMENT HLSDem_nOvhtEngNLimGov "Engine speed limitation due to high temperatures for governor." SWORD EngN 1 100 -16384.00 16383.50 FORMAT "%8.2" ECU_ADDRESS 0x6000E284 /end MEASUREMENT
/begin MEASUREMENT HLSDem_nSetPHi "Maximum speed of complete system" SWORD EngN 1 100 -16384.00 16383.50 FORMAT "%8.2" ECU_ADDRESS 0x6000E286 /end MEASUREMENT
/begin MEASUREMENT HLSDem_nSetPHiBas_mp "Gear dependent base value for the engine speed limitation" SWORD EngN 1 100 -16384.00 16383.50 FORMAT "%8.2" ECU_ADDRESS 0x70008D2A /end MEASUREMENT
/begin MEASUREMENT HLSDem_nSpHiUnFlt "Unfiltered Maximum allowed engine speed, filtering not allowed" SWORD EngN 1 100 -16384.00 16383.50 FORMAT "%8.2" ECU_ADDRESS 0x6000379C /end MEASUREMENT
/begin MEASUREMENT HLSDem_numGear "Current gear information desired from HLSDem" SWORD OneToOne 1 100 -32768.00 32767.00 FORMAT "%8.2" ECU_ADDRESS 0x6000379A /end MEASUREMENT
/begin MEASUREMENT HLSDem_pMstCylBrk "Master cylinder Pressure (with low resolution)" SWORD p_ub_q10 1 100 -327680.0 327670.0 FORMAT "%8.1" ECU_ADDRESS 0x600037BA /end MEASUREMENT
/begin MEASUREMENT HLSDem_rClthKisspntDiff "Deviation of the analog clutch signal from modified kiss point" SWORD Prc_Fact256 1 100 -128.0000 127.9961 FORMAT "%8.4" ECU_ADDRESS 0x6000502A /end MEASUREMENT
/begin MEASUREMENT HLSDem_rGearDrvOff "Unfiltered ratio of gearbox input shaft speed and engine speed to estimate the clutch slip" SWORD Fact_10000 1 100 -3.276800 3.276700 FORMAT "%8.6" ECU_ADDRESS 0x60005028 /end MEASUREMENT
/begin MEASUREMENT HLSDem_rGearDrvOffFlt "Filtered ratio of gearbox input shaft speed and engine speed to estimate the clutch slip" SWORD Fact_10000 1 100 -3.276800 3.276700 FORMAT "%8.6" ECU_ADDRESS 0x60005026 /end MEASUREMENT
/begin MEASUREMENT HLSDem_stAvusWarn "Decides the speed limit be to displayed as 6000rpm or 4000 rpm or 2500rpm." UBYTE OneToOne 1 100 0.00 255.0 FORMAT "%5.1" ECU_ADDRESS 0x6000E422 /end MEASUREMENT
/begin MEASUREMENT HLSDem_stDrvOffMT "offset activation for drive off support with manual transmission" UWORD OneToOne 1 100 0.00 255.0000 FORMAT "%8.4" ECU_ADDRESS 0x60004CB6 /end MEASUREMENT
/begin MEASUREMENT HLSDem_stDrvOffSpIncrCVT "status of driveoff activation-CVT" UBYTE B_TRUE 1 100 0.00 1.00000000000 BIT_MASK 0x1 FORMAT "%13.11" ECU_ADDRESS 0x6000A182 /end MEASUREMENT
/begin MEASUREMENT HLSDem_stDrvOffSpIncrKissPnt "status of driveoff activation-Kisspoint" UBYTE B_TRUE 1 100 0.00 1.00000000000 BIT_MASK 0x1 FORMAT "%13.11" ECU_ADDRESS 0x6000A181 /end MEASUREMENT
/begin MEASUREMENT HLSDem_stDrvOffSpIncrMT "status of driveoff activation-MT" UBYTE B_TRUE 1 100 0.00 1.00000000000 BIT_MASK 0x1 FORMAT "%13.11" ECU_ADDRESS 0x6000A180 /end MEASUREMENT
/begin MEASUREMENT HLSDem_stDrvOffSuprtDiCdn "Bit coded status message for all disabling conditions for drive-off support" UWORD OneToOne 1 100 0.00 65535.00 FORMAT "%8.2" ECU_ADDRESS 0x600037B8 /end MEASUREMENT
/begin MEASUREMENT HLSDem_stDrvOffSuprtEnaCdn "Bit coded status message for all activation conditions for drive-off support" UWORD OneToOne 1 100 0.00 65535.00 FORMAT "%8.2" ECU_ADDRESS 0x600037B6 /end MEASUREMENT
/begin MEASUREMENT HLSDem_stDrvOffSuprtSpFilTyp "Number of filtration method for requested engine speed setpoint for drive-off-support in setpoint coordination" UBYTE OneToOne 1 100 0.00 255.0 FORMAT "%5.1" ECU_ADDRESS 0x6000A3A1 /end MEASUREMENT
/begin MEASUREMENT HLSDem_stDrvOffSuprtSpIncr "status of the drive off activation condition (MT OR CVT)" UBYTE B_TRUE 1 100 0.00 1.00000000000 BIT_MASK 0x1 FORMAT "%13.11" ECU_ADDRESS 0x6000A17F /end MEASUREMENT
/begin MEASUREMENT HLSDem_stEngOperModSeln "Satus to select drivability mode for parameter" UBYTE OneToOne 1 100 0.00 255.0 FORMAT "%5.1" ECU_ADDRESS 0x6000645B /end MEASUREMENT
/begin MEASUREMENT HLSDem_stNLimEng "Status Engine speed limitation active by different sources" ULONG OneToOne 1 100 0.00 4294967295.00 FORMAT "%13.2" ECU_ADDRESS 0x60001BE0 /end MEASUREMENT
/begin MEASUREMENT HLSDem_stNLimEngExt "Status Engine speed limitation active by external request" UBYTE dez 1 100 0.00 255.0 FORMAT "%5.1" ECU_ADDRESS 0x60006452 /end MEASUREMENT
/begin MEASUREMENT HLSDem_stNMaxDeacStand "Status of deactivation conditions for reduced engine speed limit during standstill" UBYTE OneToOne 1 100 0.00 255.0 FORMAT "%5.1" ECU_ADDRESS 0x60006456 /end MEASUREMENT
/begin MEASUREMENT HLSDem_stNMaxWarnDspl "Status active engine speed limitation warning for display" UBYTE OneToOne 1 100 0.00 255.0 FORMAT "%5.1" ECU_ADDRESS 0x6000A3A0 /end MEASUREMENT
/begin MEASUREMENT HLSDem_stPTLim "Engine speed limiting status for active limitations in the drive train" UWORD OneToOne 1 100 0.00 65535.00 FORMAT "%8.2" ECU_ADDRESS 0x60004CB4 /end MEASUREMENT
/begin MEASUREMENT HLSDem_stSIncrCondCVT "local variable for Idle speed increase (CVT)" UBYTE B_TRUE 1 100 0.00 1.00000000000 BIT_MASK 0x1 FORMAT "%13.11" ECU_ADDRESS 0x6000645A /end MEASUREMENT
/begin MEASUREMENT HLSDem_stSIncrCondMT "local variable for Idle speed increase (MT)" UBYTE B_TRUE 1 100 0.00 1.00000000000 BIT_MASK 0x1 FORMAT "%13.11" ECU_ADDRESS 0x60006459 /end MEASUREMENT
/begin MEASUREMENT HLSDem_stTiEngOffER_I.buffer "Time engine-off condition / rising edge detected" UBYTE B_TRUE 1 100 0.00 1.00000000000 BIT_MASK 0x1 FORMAT "%13.11" ECU_ADDRESS 0x600037A4 /end MEASUREMENT
/begin MEASUREMENT HLSDem_stTiEngOffER_I.oldSignal "Time engine-off condition / flag rising edge" UBYTE B_TRUE 1 100 0.00 1.00000000000 BIT_MASK 0x1 FORMAT "%13.11" ECU_ADDRESS 0x600037A5 /end MEASUREMENT
/begin MEASUREMENT HLSDem_tAir_mp "temperature selected from temperature field" SWORD Temp_Cels 1 100 -3549.940 3003.560 FORMAT "%8.3" ECU_ADDRESS 0x70008D32 /end MEASUREMENT
/begin MEASUREMENT HLSDem_tOil "Oil temperature" SWORD Temp_Cels 1 100 -3549.940 3003.560 FORMAT "%8.3" ECU_ADDRESS 0x6000E28C /end MEASUREMENT
/begin MEASUREMENT HLSDem_tOilHys "Stable Oil temperature after hysteresis." SWORD Temp_Cels 1 100 -3549.940 3003.560 FORMAT "%8.3" ECU_ADDRESS 0x6000D91C /end MEASUREMENT
/begin MEASUREMENT HLSDem_tOilUp "Upper limit of Oil temperature hysteresis" SWORD Temp_Cels 1 100 -3549.940 3003.560 FORMAT "%8.3" ECU_ADDRESS 0x6000D91E /end MEASUREMENT
/begin MEASUREMENT HLSDem_tOvhtCrit "Component overheat model temperature for engine speed limitation including all offset" SWORD Temp_Kelv 1 100 -3276.800 3276.700 FORMAT "%8.3" ECU_ADDRESS 0x600037AA /end MEASUREMENT
/begin MEASUREMENT HLSDem_tTempSel "CEngDsT_t or Oil_tSwmp temperature, depending upon the calibration HLSDem_swtTempSel_C." SWORD Temp_Cels 1 100 -3549.940 3003.560 FORMAT "%8.3" ECU_ADDRESS 0x60003798 /end MEASUREMENT
/begin MEASUREMENT I14229CoEng_tiNormalOBDPrevDcyc "Engine running time during previous drvinc cyle" UWORD Time_sec_q1_COMPU 1 100 0.00 65535.00 FORMAT "%8.2" ECU_ADDRESS 0x60037F82 /end MEASUREMENT
/begin MEASUREMENT I14229EpmCaS_ctErrSig1 "Exhaust CAM pulse noise counter" UBYTE OneToOne 1 100 0.00 255.0 FORMAT "%5.1" ECU_ADDRESS 0x6000A39E /end MEASUREMENT
/begin MEASUREMENT I14229GlbDa_lTotDstDCHiReslPrevDcyc "Distance traveled during previous drvinc cycle" UWORD Length_10m 1 100 0.00 655350.0 FORMAT "%8.1" ECU_ADDRESS 0x60037F80 /end MEASUREMENT
/begin MEASUREMENT I14229IntkAirT_tSnsrTstrMax "The maximum IAT during engine runnning at this driving cycle" SWORD Temp_Cels 1 100 -3549.940 3003.560 FORMAT "%8.3" ECU_ADDRESS 0x60005390 /end MEASUREMENT
/begin MEASUREMENT I14229IntkAirT_tSnsrTstrMin "The minimum IAT during engine runnning at this driving cycle" SWORD Temp_Cels 1 100 -3549.940 3003.560 FORMAT "%8.3" ECU_ADDRESS 0x6000538E /end MEASUREMENT
/begin MEASUREMENT I14229RDBI_nOvrSpd "The highest RPM caused P0219" SWORD EngN 1 100 -16384.00 16383.50 FORMAT "%8.2" ECU_ADDRESS 0x6003497E /end MEASUREMENT
/begin MEASUREMENT I14229RDBI_tiOvrSpd "Cumulative time faster than P0219" UWORD Time_msec_q10_COMPU 1 100 0.00 655350.0 FORMAT "%8.1" ECU_ADDRESS 0x6003497C /end MEASUREMENT
/begin MEASUREMENT I14229_AirC_pAnaClnt "input output by Data identifier" SWORD Pres_kPa 1 100 -6553.600 6553.400 FORMAT "%8.3" ECU_ADDRESS 0x60005024 /end MEASUREMENT
/begin MEASUREMENT I14229_Brk_st "switch history status for Brk_st message" UBYTE OneToOne 1 100 0.00 255.0 FORMAT "%5.1" ECU_ADDRESS 0x6000A39D /end MEASUREMENT
/begin MEASUREMENT I14229_Brk_stRed "signal corresponding to redundant brake switch status" UBYTE OneToOne 1 100 0.00 255.0 FORMAT "%5.1" ECU_ADDRESS 0x6000A39C /end MEASUREMENT
/begin MEASUREMENT I14229_cntrReIni "Local counter to record number of times system state SYC_POSTDRIVE is left" UBYTE OneToOne 1 100 0.00 255.0 FORMAT "%5.1" ECU_ADDRESS 0x6000A398 /end MEASUREMENT
/begin MEASUREMENT I14229_ElcWastGatLift_s32 "Message for Electric waste Gate Lift in mm" SLONG OneToOne 1 100 -2147483648.00 2147483647.00 FORMAT "%13.2" ECU_ADDRESS 0x60001CEC /end MEASUREMENT
/begin MEASUREMENT I14229_ElecLd_iEPSLoadOnly "comdia variable for Consumption current of EPS (Electronic Power Steering)." UBYTE OneToOne 1 100 0.00 255.0 FORMAT "%5.1" ECU_ADDRESS 0x6000A39B /end MEASUREMENT
/begin MEASUREMENT I14229_EpmCaS_ctErrSig "comdia variable for CRK pulse noise counter." UBYTE OneToOne 1 100 0.00 255.0 FORMAT "%5.1" ECU_ADDRESS 0x6000A39A /end MEASUREMENT
/begin MEASUREMENT I14229_EpmCaS_ctErrSig2 "TDC pulse Noise counter" UWORD CrSRev2CrSInc 1 100 0.00 1820.417 FORMAT "%8.3" ECU_ADDRESS 0x60004CB2 /end MEASUREMENT
/begin MEASUREMENT I14229_EpmCrS_ctErrSig "CKP pulse noise counter" SWORD OneToOne 1 100 -32768.00 32767.00 FORMAT "%8.2" ECU_ADDRESS 0x6000538C /end MEASUREMENT
/begin MEASUREMENT I14229_flgInhbE82E "Inhibit flag for DIDE82E" UBYTE B_TRUE 1 100 0.00 1.00000000000 BIT_MASK 0x1 FORMAT "%13.11" ECU_ADDRESS 0x60009F91 /end MEASUREMENT
/begin MEASUREMENT I14229_ForceActvTmr "signal corresponding to force active timer." SLONG Time_ms 1 100 -21474836480.0 21474836470.0 FORMAT "%13.1" ECU_ADDRESS 0x60001CE8 /end MEASUREMENT
/begin MEASUREMENT I14229_fzabgs_w "Accumulate misfire counter for 1 driving cycle." UWORD dez 1 100 0.00 65535.00 FORMAT "%8.2" ECU_ADDRESS 0x60005344 /end MEASUREMENT
/begin MEASUREMENT I14229_fzabgzyl_w "Accumulate misfire counter for 4 cylinders." UWORD dez 1 100 0.00 65535.00 FORMAT "%8.2" ARRAY_SIZE 4 ECU_ADDRESS 0x70001E88 /end MEASUREMENT
/begin MEASUREMENT I14229_Gbx_uAna1NPosRaw "New interface for DID2615_PDR1A" UBYTE OneToOne 1 100 0.00 255.0 FORMAT "%5.1" ECU_ADDRESS 0x6000A750 /end MEASUREMENT
/begin MEASUREMENT I14229_Gbx_uAna2NPosRaw "New interface for DID2615_PDR1B" UBYTE OneToOne 1 100 0.00 255.0 FORMAT "%5.1" ECU_ADDRESS 0x6000A399 /end MEASUREMENT
/begin MEASUREMENT I14229_ivzabg_w "Accumulate Engine speed counter during Misfire monitoring" UWORD dez 1 100 0.00 65535.00 FORMAT "%8.2" ECU_ADDRESS 0x60005342 /end MEASUREMENT
/begin MEASUREMENT I14229_lDst "Coverage distance received from meter" ULONG OilMlg 1 100 0.00 4294967295.00 FORMAT "%13.2" ECU_ADDRESS 0x60001C60 /end MEASUREMENT
/begin MEASUREMENT I14229_LongTermAdpnVal_s32 "Message for long-term adaptation value based on typical position in mm" SLONG OneToOne 1 100 -2147483648.00 2147483647.00 FORMAT "%13.2" ECU_ADDRESS 0x60001CE4 /end MEASUREMENT
/begin MEASUREMENT I14229_ml_w_msg "signal corresponding to Learning value of intake air during idling control" UWORD m_q0p1 1 100 0.00 6553.500 FORMAT "%8.3" ECU_ADDRESS 0x70001CF0 /end MEASUREMENT
/begin MEASUREMENT I14229_nstat "signal corresponding to stationery engine speed" SWORD nmot_ub_q10_rpm 1 100 -1310720. 1310680. FORMAT "%8.0" ECU_ADDRESS 0x60005022 /end MEASUREMENT
/begin MEASUREMENT I14229_numDTCFrzFrmHi "High Byte of the DTC Information read from Carb $02 Service" UBYTE OneToOne 1 100 0.00 255.0 FORMAT "%5.1" ECU_ADDRESS 0x6000A396 /end MEASUREMENT
/begin MEASUREMENT I14229_numDTCFrzFrmLo "Low Byte of the DTC Information read from Carb $02 Service" UBYTE OneToOne 1 100 0.00 255.0 FORMAT "%5.1" ECU_ADDRESS 0x6000A395 /end MEASUREMENT
/begin MEASUREMENT I14229_numDTCFrzFrmMid "Middle Byte of the DTC Information read from Carb $02 Service" UBYTE OneToOne 1 100 0.00 255.0 FORMAT "%5.1" ECU_ADDRESS 0x6000A394 /end MEASUREMENT
/begin MEASUREMENT I14229_pEngSrtMin "input output by Data identifier" SWORD p_uw_q0p039_mmHg 1 100 -960.0815 960.0522 FORMAT "%8.4" ECU_ADDRESS 0x60005020 /end MEASUREMENT
/begin MEASUREMENT I14229_ps_w "input output by Data identifier" UWORD p_uw_q0p039_mmHg 1 100 0.00 1920.134 FORMAT "%8.3" ECU_ADDRESS 0x60005340 /end MEASUREMENT
/begin MEASUREMENT I14229_rHtgS2B1 "request for modification in heater element" UWORD fak_q3p906Em5 1 100 0.00 2.559961 FORMAT "%8.6" ECU_ADDRESS 0x60003794 /end MEASUREMENT
/begin MEASUREMENT I14229_rTrqPT "Tester message forThe transmission ratio for an acceleration hazard judging" UBYTE RBPtCel_fac_0p125_1 1 100 0.00 31.88 FORMAT "%5.2" ECU_ADDRESS 0x6000A74F /end MEASUREMENT
/begin MEASUREMENT I14229_stBrkMnRaw "input output by Data identifier" UBYTE OneToOne 1 100 0.00 255.0 FORMAT "%5.1" ECU_ADDRESS 0x6000A390 /end MEASUREMENT
/begin MEASUREMENT I14229_stClth2 "input output by Data identifier" UBYTE OneToOne 1 100 0.00 255.0 FORMAT "%5.1" ECU_ADDRESS 0x6000A74E /end MEASUREMENT
/begin MEASUREMENT I14229_stClth3 "input output by Data identifier" UBYTE OneToOne 1 100 0.00 255.0 FORMAT "%5.1" ECU_ADDRESS 0x6000A38F /end MEASUREMENT
/begin MEASUREMENT I14229_stClth4Bit0 "input output by Data identifier" UBYTE OneToOne 1 100 0.00 255.0 FORMAT "%5.1" ECU_ADDRESS 0x6000A38E /end MEASUREMENT
/begin MEASUREMENT I14229_stClthBit4 "input output by Data identifier" UBYTE OneToOne 1 100 0.00 255.0 FORMAT "%5.1" ECU_ADDRESS 0x6000A38D /end MEASUREMENT
/begin MEASUREMENT I14229_stForceActvTmr "signal corresponding to force active timer status." UBYTE OneToOne 1 100 0.00 255.0 FORMAT "%5.1" ECU_ADDRESS 0x6000A38C /end MEASUREMENT
/begin MEASUREMENT I14229_stGbxRvsPos "input output by Data identifier" UBYTE OneToOne 1 100 0.00 255.0 FORMAT "%5.1" ECU_ADDRESS 0x6000A38B /end MEASUREMENT
/begin MEASUREMENT I14229_stKSdiag "signal corresponding to KS diagnosis status" UBYTE OneToOne 1 100 0.00 255.0 FORMAT "%5.1" ECU_ADDRESS 0x6000A38A /end MEASUREMENT
/begin MEASUREMENT I14229_stPHAACTRINTKTmr "Status of protection timer condition check" UBYTE OneToOne 1 100 0.00 255.0 FORMAT "%5.1" ECU_ADDRESS 0x6000A388 /end MEASUREMENT
/begin MEASUREMENT I14229_stPHAACTROUTLTmr "Status of protection timer condition check" UBYTE OneToOne 1 100 0.00 255.0 FORMAT "%5.1" ECU_ADDRESS 0x6000A387 /end MEASUREMENT
/begin MEASUREMENT I14229_stSwtHistDly_mp "Status of the switch histroy delay" UBYTE OneToOne 1 100 0.00 255.0 FORMAT "%5.1" ECU_ADDRESS 0x70008D28 /end MEASUREMENT
/begin MEASUREMENT I14229_stSwtHistFlg "Status of the switch histroy delay" ULONG dez 1 100 0.00 4294967295.00 FORMAT "%13.2" ECU_ADDRESS 0x60034970 /end MEASUREMENT
/begin MEASUREMENT I14229_stSwtOffOnHistFlg "input output by Data identifier" ULONG dez 1 100 0.00 4294967295.00 FORMAT "%13.2" ECU_ADDRESS 0x6003496C /end MEASUREMENT
/begin MEASUREMENT I14229_stSwtOnOffHistFlg "signal corresponding to switch ON OFF histerysis flag" ULONG dez 1 100 0.00 4294967295.00 FORMAT "%13.2" ECU_ADDRESS 0x60034968 /end MEASUREMENT
/begin MEASUREMENT I14229_stVBM "Status of VBM for I14229" UBYTE OneToOne 1 100 0.00 255.0 FORMAT "%5.1" ECU_ADDRESS 0x6000A386 /end MEASUREMENT
/begin MEASUREMENT I14229_stVINWriteClrDone "VIN write clear done status" UBYTE OneToOne 1 100 0.00 255.0 FORMAT "%5.1" ECU_ADDRESS 0x6000A747 /end MEASUREMENT
/begin MEASUREMENT I14229_stVINWriteClrReq "VIN write clear request" UBYTE OneToOne 1 100 0.00 255.0 FORMAT "%5.1" ECU_ADDRESS 0x6000A385 /end MEASUREMENT
/begin MEASUREMENT I14229_tiInj1On "Injector #1 ON duration" ULONG t_q0p001_ms 1 100 0.00 4294967.29500 FORMAT "%13.5" ECU_ADDRESS 0x60001C5C /end MEASUREMENT
/begin MEASUREMENT I14229_tiSia "timing parameter corresponding to security and immobiliser" UBYTE Time_sec_q1_COMPU 1 100 0.00 255.0 FORMAT "%5.1" ECU_ADDRESS 0x6000A382 /end MEASUREMENT
/begin MEASUREMENT I14229_tiVINWriteClrTimeoutNRC22_mp "time out for VIN clear request" SWORD Time_ms 1 100 -327680.0 327670.0 FORMAT "%8.1" ECU_ADDRESS 0x70008D26 /end MEASUREMENT
/begin MEASUREMENT I14229_tiVINWriteClrTimeout_mp "Timer for clear process" SWORD Time_ms 1 100 -327680.0 327670.0 FORMAT "%8.1" ECU_ADDRESS 0x70008D24 /end MEASUREMENT
/begin MEASUREMENT I14229_tka "Tester variable for Engine coolant temperature at crank" UBYTE temp_ub_q0p75_o48 1 100 -48.0 143.3 FORMAT "%5.1" ECU_ADDRESS 0x6000A381 /end MEASUREMENT
/begin MEASUREMENT I14229_tkaMax "Maximum temperature of TW2 sensor during current Drving Cycle" UBYTE temp_ub_q0p75_o48 1 100 -48.0 143.3 FORMAT "%5.1" ECU_ADDRESS 0x6000A746 /end MEASUREMENT
/begin MEASUREMENT I14229_tkaMin "Minimum temperature of TW2 sensor during current Drving Cycle" UBYTE temp_ub_q0p75_o48 1 100 -48.0 143.3 FORMAT "%5.1" ECU_ADDRESS 0x6000A745 /end MEASUREMENT
/begin MEASUREMENT I14229_tmotMaxCurrDcyc "The maximum ECT1 temperature during vehicle is running at current drving cycle" UBYTE temp_ub_q0p75_o48 1 100 -48.0 143.3 FORMAT "%5.1" ECU_ADDRESS 0x6000A744 /end MEASUREMENT
/begin MEASUREMENT I14229_tmotMaxPrevDcyc "The maximum ECT1 temperature during vehicle is running at previous driving cycle" UBYTE temp_ub_q0p75_o48 1 100 -48.0 143.3 FORMAT "%5.1" ECU_ADDRESS 0x60037F7E /end MEASUREMENT
/begin MEASUREMENT I14229_tmotMinCurrDcyc "The minimum ECT1 temperature during vehicle is running at current drving cycle" UBYTE temp_ub_q0p75_o48 1 100 -48.0 143.3 FORMAT "%5.1" ECU_ADDRESS 0x6000A743 /end MEASUREMENT
/begin MEASUREMENT I14229_tmotMinPrevDcyc "The minimum ECT1 temperature during vehicle is running at previous driving cycle" UBYTE temp_ub_q0p75_o48 1 100 -48.0 143.3 FORMAT "%5.1" ECU_ADDRESS 0x60037F7D /end MEASUREMENT
/begin MEASUREMENT I14229_trqInrLtdPthSet "tester message for engine net torque" SWORD OneToOne 1 100 -32768.00 32767.00 FORMAT "%8.2" ECU_ADDRESS 0x6000501E /end MEASUREMENT
/begin MEASUREMENT I14229_trqSetEngTrqPtd "tester message for net torque value for the acceleration hazard judging" SWORD OneToOne 1 100 -32768.00 32767.00 FORMAT "%8.2" ECU_ADDRESS 0x6000501C /end MEASUREMENT
/begin MEASUREMENT I14229_tSnsrFild1 "Filtered value of sensor temperature" UBYTE RBPtCel_t_1p0_om40_1 1 100 -40.0 215.0 FORMAT "%5.1" ECU_ADDRESS 0x6000A384 /end MEASUREMENT
/begin MEASUREMENT I14229_ubsq "signal corresponding to battery voltage (on board), conversed to standard quantization" UBYTE spg_q0p1 1 100 0.00 25.50 FORMAT "%5.2" ECU_ADDRESS 0x6000A380 /end MEASUREMENT
/begin MEASUREMENT I14229_umsrln_w "input output by Data identifier" SWORD q1p412_L_DIV_min 1 100 -46269.63 46268.22 FORMAT "%8.2" ECU_ADDRESS 0x6000501A /end MEASUREMENT
/begin MEASUREMENT I14229_wdkba_w "input output by Data identifier" SWORD relDK_q0p02441 1 100 -800.0000 799.9756 FORMAT "%8.4" ECU_ADDRESS 0x60005018 /end MEASUREMENT
/begin MEASUREMENT I14229_wdks_w "input output by Data identifier" UWORD relDK_uw_b100 1 100 0.00 100.0000 FORMAT "%8.4" ECU_ADDRESS 0x60004CB0 /end MEASUREMENT
/begin MEASUREMENT I14229_wped1 "input output by Data identifier" UWORD relPED_q0p00153 1 100 0.00 100.0000 FORMAT "%8.4" ECU_ADDRESS 0x6000533E /end MEASUREMENT
/begin MEASUREMENT I14229_wped2 "input output by Data identifier" UWORD relPED_q0p00153 1 100 0.00 100.0000 FORMAT "%8.4" ECU_ADDRESS 0x6000533C /end MEASUREMENT
/begin MEASUREMENT I14229_zwist "input output by Data identifier" SWORD zw_q0p1 1 100 -3276.800 3276.700 FORMAT "%8.3" ECU_ADDRESS 0x60005016 /end MEASUREMENT
/begin MEASUREMENT I15031_FILLSIG1 "Fillsignal for not supported signals with the size of 1 Byte" UBYTE OneToOne 1 100 0.00 255.0 FORMAT "%5.1" ECU_ADDRESS 0x6000A737 /end MEASUREMENT
/begin MEASUREMENT I15031_FILLSIG2 "Fillsignal for not supported signals with the size of 2 Bytes" UWORD OneToOne 1 100 0.00 65535.00 FORMAT "%8.2" ECU_ADDRESS 0x6000531C /end MEASUREMENT
/begin MEASUREMENT I15031_FILLSIG4 "Fillsignal for not supported signals with the size of 4 Bytes" ULONG OneToOne 1 100 0.00 4294967295.00 FORMAT "%13.2" ECU_ADDRESS 0x60001DB4 /end MEASUREMENT
/begin MEASUREMENT I15031_ITIDSuppSrv9 "To store support infotype bits in mode9" ULONG OneToOne 1 100 0.00 4294967295.00 FORMAT "%13.2" ARRAY_SIZE 8 ECU_ADDRESS 0x500040CC /end MEASUREMENT
/begin MEASUREMENT I15031_PID13 "Location of oxigen sensor" UBYTE OneToOne 1 100 0.00 255.0 FORMAT "%5.1" ECU_ADDRESS 0x6000A736 /end MEASUREMENT
/begin MEASUREMENT I15031_PID1C "OBD requirements to which vehicle is designed" UBYTE OneToOne 1 100 0.00 255.0 FORMAT "%5.1" ECU_ADDRESS 0x6000A735 /end MEASUREMENT
/begin MEASUREMENT I15031_PID1D "Location of oxygen sensors" UBYTE OneToOne 1 100 0.00 255.0 FORMAT "%5.1" ECU_ADDRESS 0x6000A734 /end MEASUREMENT
/begin MEASUREMENT I15031_PID4FA "External Test Equipment Configuration Information. Maximum value for Equivalence Ratio." UBYTE OneToOne 1 100 0.00 255.0 FORMAT "%5.1" ECU_ADDRESS 0x6000A733 /end MEASUREMENT
/begin MEASUREMENT I15031_PID4FB "External Test Equipment Configuration Information. Maximum value for Oxygen Sensor Voltage." UBYTE OneToOne 1 100 0.00 255.0 FORMAT "%5.1" ECU_ADDRESS 0x6000A732 /end MEASUREMENT
/begin MEASUREMENT I15031_PID4FC "External Test Equipment Configuration Information. Maximum value for Oxygen Sensor Current." UBYTE OneToOne 1 100 0.00 255.0 FORMAT "%5.1" ECU_ADDRESS 0x6000A731 /end MEASUREMENT
/begin MEASUREMENT I15031_PID4FD "External Test Equipment Configuration Information. Maximum value for Intake Manifold Absolute Pressure." UBYTE OneToTenCarb 1 100 0.00 2550. FORMAT "%5.0" ECU_ADDRESS 0x6000A730 /end MEASUREMENT
/begin MEASUREMENT I15031_PID50A "External Test Equipment Configuration Information. Maximum value for Air Flow Rate from Mass Air Flow Sensor" UBYTE OneToTenCarb 1 100 0.00 2550. FORMAT "%5.0" ECU_ADDRESS 0x6000A72F /end MEASUREMENT
/begin MEASUREMENT I15031_PID50B "External Test Equipment Configuration Information. Demanded manifold Pressure" UBYTE OneToOne 1 100 0.00 255.0 FORMAT "%5.1" ECU_ADDRESS 0x6000A72E /end MEASUREMENT
/begin MEASUREMENT I15031_PID50C "External Test Equipment Configuration Information. Engine Oil Level" UBYTE OneToOne 1 100 0.00 255.0 FORMAT "%5.1" ECU_ADDRESS 0x6000A72D /end MEASUREMENT
/begin MEASUREMENT I15031_PID50D "External Test Equipment Configuration Information. Fuel Rail pressure control" UBYTE OneToOne 1 100 0.00 255.0 FORMAT "%5.1" ECU_ADDRESS 0x6000A72C /end MEASUREMENT
/begin MEASUREMENT I15031_PID5F "Emission requirements to which vehicle is designed" UBYTE OneToOne 1 100 0.00 255.0 FORMAT "%5.1" ECU_ADDRESS 0x6000A72B /end MEASUREMENT
/begin MEASUREMENT I15031_PID65A "Shows which Auxiliary Inputs / Outputs are supported in PID65" UBYTE OneToOne 1 100 0.00 255.0 FORMAT "%5.1" ECU_ADDRESS 0x6000A72A /end MEASUREMENT
/begin MEASUREMENT I15031_PID66A "Shows which Mass Air Flow Sensor data are supported in PID66" UBYTE OneToOne 1 100 0.00 255.0 FORMAT "%5.1" ECU_ADDRESS 0x6000A729 /end MEASUREMENT
/begin MEASUREMENT I15031_PID67A "Shows which Engine Coolant Temperature data are supported in PID67" UBYTE OneToOne 1 100 0.00 255.0 FORMAT "%5.1" ECU_ADDRESS 0x6000A728 /end MEASUREMENT
/begin MEASUREMENT I15031_PID68A "Shows which Intake Air Temperature Sensor data are supported in PID68" UBYTE OneToOne 1 100 0.00 255.0 FORMAT "%5.1" ECU_ADDRESS 0x6000A727 /end MEASUREMENT
/begin MEASUREMENT I15031_PID69A "Shows which Commanded EGR System data are supported in PID69" UBYTE OneToOne 1 100 0.00 255.0 FORMAT "%5.1" ECU_ADDRESS 0x6000A726 /end MEASUREMENT
/begin MEASUREMENT I15031_PID6AA "Shows which Commanded Diesel Intake Air Flow Control and Relative Intake Air Flow Position data are supported in PID6A" UBYTE OneToOne 1 100 0.00 255.0 FORMAT "%5.1" ECU_ADDRESS 0x6000A725 /end MEASUREMENT
/begin MEASUREMENT I15031_PID6BA "Shows which Exhaust Gas Recirculation Temperature data are supported in PID6B" UBYTE OneToOne 1 100 0.00 255.0 FORMAT "%5.1" ECU_ADDRESS 0x6000A724 /end MEASUREMENT
/begin MEASUREMENT I15031_PID6CA "Shows which Commanded Throttle Actuator Control and Relative Throttle Position data are supported in PID6C" UBYTE OneToOne 1 100 0.00 255.0 FORMAT "%5.1" ECU_ADDRESS 0x6000A723 /end MEASUREMENT
/begin MEASUREMENT I15031_PID6DA "Shows which Fuel Pressure Control System data are supported in PID6D" UBYTE OneToOne 1 100 0.00 255.0 FORMAT "%5.1" ECU_ADDRESS 0x6000A722 /end MEASUREMENT
/begin MEASUREMENT I15031_PID6EA "Shows which Injection Pressure Control System data are supported in PID6E" UBYTE OneToOne 1 100 0.00 255.0 FORMAT "%5.1" ECU_ADDRESS 0x6000A721 /end MEASUREMENT
/begin MEASUREMENT I15031_PID6FA "Shows which Turbocharger Compressor Inlet Pressure data are supported in PID6F" UBYTE OneToOne 1 100 0.00 255.0 FORMAT "%5.1" ECU_ADDRESS 0x6000A720 /end MEASUREMENT
/begin MEASUREMENT I15031_PID70A "Shows which Boost Pressure Control data are supported in PID70" UBYTE OneToOne 1 100 0.00 255.0 FORMAT "%5.1" ECU_ADDRESS 0x6000A71F /end MEASUREMENT
/begin MEASUREMENT I15031_PID71A "Shows which Variable Geometry Turbo (VGT) Control data are supported in PID71" UBYTE OneToOne 1 100 0.00 255.0 FORMAT "%5.1" ECU_ADDRESS 0x6000A71E /end MEASUREMENT
/begin MEASUREMENT I15031_PID72A "Shows which Wastegate Control data are supported in PID72" UBYTE OneToOne 1 100 0.00 255.0 FORMAT "%5.1" ECU_ADDRESS 0x6000A71D /end MEASUREMENT
/begin MEASUREMENT I15031_PID73A "Shows which Exhaust Pressure data are supported in PID73" UBYTE OneToOne 1 100 0.00 255.0 FORMAT "%5.1" ECU_ADDRESS 0x6000A71C /end MEASUREMENT
/begin MEASUREMENT I15031_PID74A "Shows which Turbocharger RPM data are supported in PID74" UBYTE OneToOne 1 100 0.00 255.0 FORMAT "%5.1" ECU_ADDRESS 0x6000A71B /end MEASUREMENT
/begin MEASUREMENT I15031_PID75A "Shows which Turbocharger A Temperature data are supported in PID75" UBYTE OneToOne 1 100 0.00 255.0 FORMAT "%5.1" ECU_ADDRESS 0x6000A71A /end MEASUREMENT
/begin MEASUREMENT I15031_PID76A "Shows which Turbocharger B Temperature data are supported in PID76" UBYTE OneToOne 1 100 0.00 255.0 FORMAT "%5.1" ECU_ADDRESS 0x6000A719 /end MEASUREMENT
/begin MEASUREMENT I15031_PID77A "Shows which Charge Air Cooler Temperature (CACT) data are supported in PID77" UBYTE OneToOne 1 100 0.00 255.0 FORMAT "%5.1" ECU_ADDRESS 0x6000A718 /end MEASUREMENT
/begin MEASUREMENT I15031_PID78A "Shows which Exhaust Gas Temperature (EGT) Bank 1 data are supported in PID78" UBYTE OneToOne 1 100 0.00 255.0 FORMAT "%5.1" ECU_ADDRESS 0x6000A717 /end MEASUREMENT
/begin MEASUREMENT I15031_PID79A "Shows which Exhaust Gas Temperature (EGT) Bank 2 data are supported in PID79" UBYTE OneToOne 1 100 0.00 255.0 FORMAT "%5.1" ECU_ADDRESS 0x6000A716 /end MEASUREMENT
/begin MEASUREMENT I15031_PID7AA "Shows which Particulate Filter (PF) Bank 1 data are supported in PID7A" UBYTE OneToOne 1 100 0.00 255.0 FORMAT "%5.1" ECU_ADDRESS 0x6000A715 /end MEASUREMENT
/begin MEASUREMENT I15031_PID7BA "Shows which Particulate Filter (PF) Bank 2 data are supported in PID7B" UBYTE OneToOne 1 100 0.00 255.0 FORMAT "%5.1" ECU_ADDRESS 0x6000A714 /end MEASUREMENT
/begin MEASUREMENT I15031_PID7CA "Shows which Particulate Filter (PF) Temperature data are supported in PID7C" UBYTE OneToOne 1 100 0.00 255.0 FORMAT "%5.1" ECU_ADDRESS 0x6000A713 /end MEASUREMENT
/begin MEASUREMENT I15031_PID7FA "Shows which Engine Run Time is supported in PID7F" UBYTE OneToOne 1 100 0.00 255.0 FORMAT "%5.1" ECU_ADDRESS 0x6000A712 /end MEASUREMENT
/begin MEASUREMENT I15031_PID81A "Shows which Engine Run Time for AECD #1 - #5 is supported in PID81" UBYTE OneToOne 1 100 0.00 255.0 FORMAT "%5.1" ECU_ADDRESS 0x6000A711 /end MEASUREMENT
/begin MEASUREMENT I15031_PID82A "Shows which Engine Run Time for AECD #6 - #10 is supported in PID82" UBYTE OneToOne 1 100 0.00 255.0 FORMAT "%5.1" ECU_ADDRESS 0x6000A710 /end MEASUREMENT
/begin MEASUREMENT I15031_PID83A "Shows which NOx Sensor data are supported in PID83" UBYTE OneToOne 1 100 0.00 255.0 FORMAT "%5.1" ECU_ADDRESS 0x6000A70F /end MEASUREMENT
/begin MEASUREMENT I15031_PID85A "Shows which NOx Control System data are supported in PID85" UBYTE OneToOne 1 100 0.00 255.0 FORMAT "%5.1" ECU_ADDRESS 0x6000A70E /end MEASUREMENT
/begin MEASUREMENT I15031_PID86A "Shows which Particulate Matter (PM) Sensor data are supported in PID86" UBYTE OneToOne 1 100 0.00 255.0 FORMAT "%5.1" ECU_ADDRESS 0x6000A70D /end MEASUREMENT
/begin MEASUREMENT I15031_PID87A "Shows which Intake Manifold Absolute Pressure data are supported in PID87" UBYTE OneToOne 1 100 0.00 255.0 FORMAT "%5.1" ECU_ADDRESS 0x6000A70C /end MEASUREMENT
/begin MEASUREMENT I15031_PID89A "Shows which Engine Run Time for AECD #11 - #15 is supported in PID89" UBYTE OneToOne 1 100 0.00 255.0 FORMAT "%5.1" ECU_ADDRESS 0x6000A70B /end MEASUREMENT
/begin MEASUREMENT I15031_PID8AA "Shows which Engine Run Time for AECD #16 - #20 is supported in PID8A" UBYTE OneToOne 1 100 0.00 255.0 FORMAT "%5.1" ECU_ADDRESS 0x6000A70A /end MEASUREMENT
/begin MEASUREMENT I15031_PID8BA "Shows which Aftertreatment Status is supported in PID8B ByteB." UBYTE OneToOne 1 100 0.00 255.0 FORMAT "%5.1" ECU_ADDRESS 0x6000A709 /end MEASUREMENT
/begin MEASUREMENT I15031_PID8CA "Calibration for O2 Sensor Data support information(Sensor 1, Sensor 2)" UBYTE OneToOne 1 100 0.00 255.0 FORMAT "%5.1" ECU_ADDRESS 0x6000A708 /end MEASUREMENT
/begin MEASUREMENT I15031_PID8FA "Shows which PM (Particulate Matter) Sensor Output is supported in PID8F" UBYTE OneToOne 1 100 0.00 255.0 FORMAT "%5.1" ECU_ADDRESS 0x6000A707 /end MEASUREMENT
/begin MEASUREMENT I15031_PID92A "Fuel System Status support information" UBYTE OneToOne 1 100 0.00 255.0 FORMAT "%5.1" ECU_ADDRESS 0x6000A706 /end MEASUREMENT
/begin MEASUREMENT I15031_PID93A "WWH B1 counter support information" UBYTE OneToOne 1 100 0.00 255.0 FORMAT "%5.1" ECU_ADDRESS 0x6000A705 /end MEASUREMENT
/begin MEASUREMENT I15031_PID94A "Inducement Counters support information" UBYTE OneToOne 1 100 0.00 255.0 FORMAT "%5.1" ECU_ADDRESS 0x6000A704 /end MEASUREMENT
/begin MEASUREMENT I15031_PID98A "Exhaust Gas Temperature Sensor Data support information(Bank 1)" UBYTE OneToOne 1 100 0.00 255.0 FORMAT "%5.1" ECU_ADDRESS 0x6000A703 /end MEASUREMENT
/begin MEASUREMENT I15031_PID99A "Exhaust Gas Temperature Sensor Data support information" UBYTE OneToOne 1 100 0.00 255.0 FORMAT "%5.1" ECU_ADDRESS 0x6000A702 /end MEASUREMENT
/begin MEASUREMENT I15031_PID9AA "Shows if HybridEV Vehicle State is supported in PID9A" UBYTE OneToOne 1 100 0.00 255.0 FORMAT "%5.1" ECU_ADDRESS 0x6000A701 /end MEASUREMENT
/begin MEASUREMENT I15031_PID9BA "Diesel exhaust fluid sensor output" UBYTE OneToOne 1 100 0.00 255.0 FORMAT "%5.1" ECU_ADDRESS 0x6000A700 /end MEASUREMENT
/begin MEASUREMENT I15031_PID9CA "O2 Sensor Data support information(Sensor 3, Sensor 4)" UBYTE OneToOne 1 100 0.00 255.0 FORMAT "%5.1" ECU_ADDRESS 0x6000A6FF /end MEASUREMENT
/begin MEASUREMENT I15031_PID9FA "Fuel system percentage use" UBYTE OneToOne 1 100 0.00 255.0 FORMAT "%5.1" ECU_ADDRESS 0x6000A6FE /end MEASUREMENT
/begin MEASUREMENT I15031_PIDA1A "Displays the NOx Sensor Corrected Data supported in PIDA1" UBYTE OneToOne 1 100 0.00 255.0 FORMAT "%5.1" ECU_ADDRESS 0x6000A6FD /end MEASUREMENT
/begin MEASUREMENT I15031_PIDA3A "Evap System Vapor Pressure" UBYTE OneToOne 1 100 0.00 255.0 FORMAT "%5.1" ECU_ADDRESS 0x6000A6FC /end MEASUREMENT
/begin MEASUREMENT I15031_PIDA4A "Transmission Actual Gear" UBYTE OneToOne 1 100 0.00 255.0 FORMAT "%5.1" ECU_ADDRESS 0x6000A6FB /end MEASUREMENT
/begin MEASUREMENT I15031_PIDA5A "message to update byte A ini PIDA5 for Diesel Exhaust Fluid Dosing" UBYTE OneToOne 1 100 0.00 255.0 FORMAT "%5.1" ECU_ADDRESS 0x6000A6FA /end MEASUREMENT
/begin MEASUREMENT I15031_PIDA7A "Support of NOx Sensor Data" UBYTE OneToOne 1 100 0.00 255.0 FORMAT "%5.1" ECU_ADDRESS 0x6000A6F9 /end MEASUREMENT
/begin MEASUREMENT I15031_PIDA8A "NOx Sensor Corrected" UBYTE OneToOne 1 100 0.00 255.0 FORMAT "%5.1" ECU_ADDRESS 0x6000A6F8 /end MEASUREMENT
/begin MEASUREMENT I15031_PIDA9A "Motorcycle InputOutput Status" UBYTE OneToOne 1 100 0.00 255.0 FORMAT "%5.1" ECU_ADDRESS 0x6000A6F7 /end MEASUREMENT
/begin MEASUREMENT I15031_PIDACA "Shows Support of DEF Dosing Rate or Mode" UBYTE OneToOne 1 100 0.00 255.0 FORMAT "%5.1" ECU_ADDRESS 0x6000A6F6 /end MEASUREMENT
/begin MEASUREMENT I15031_PIDSuppSrv1 "PIDs supported in Service 1 are indicated in 32 bit measurement array" ULONG OneToOne 1 100 0.00 4294967295.00 FORMAT "%13.2" ARRAY_SIZE 8 ECU_ADDRESS 0x5000406C /end MEASUREMENT
/begin MEASUREMENT I15031_PIDSuppSrv2 "PIDs supported in Service 2 are indicated in 32 bit measurement array" ULONG OneToOne 1 100 0.00 4294967295.00 FORMAT "%13.2" ARRAY_SIZE 8 ECU_ADDRESS 0x5000408C /end MEASUREMENT
/begin MEASUREMENT I15031_Srv12_Ext_DisablPIDSupp "PIDs requested for dynamic support switch off are indicated in 32 bit measurement array" ULONG OneToOne 1 100 0.00 4294967295.00 FORMAT "%13.2" ARRAY_SIZE 8 ECU_ADDRESS 0x500040AC /end MEASUREMENT
/begin MEASUREMENT i15031_srv9_CVN_Calc_ui "State of CVN calculation" UBYTE I15031_srv9_CVN_CalcVerb 1 100 0.00 6. FORMAT "%2.0" ECU_ADDRESS 0x6000A6E7 /end MEASUREMENT
/begin MEASUREMENT I15031_srv9_stCVNRecalc "Recalculation of CVN" UBYTE OneToOne 1 100 0.00 255.0 FORMAT "%5.1" ECU_ADDRESS 0x6000E423 /end MEASUREMENT
/begin MEASUREMENT I15031_srv9_ValidCVN "Availability of valid CVN in Envram." UBYTE OneToOne 1 100 0.00 255.0 FORMAT "%5.1" ECU_ADDRESS 0x6000A6F5 /end MEASUREMENT
/begin MEASUREMENT udst_w_msg "Value first tank pressure sensor" UWORD spg_uw_b5 1 100 0.00 319.9951 FORMAT "%8.4" ECU_ADDRESS 0x60004B9A /end MEASUREMENT
/begin MEASUREMENT VlvLft_fbIntkDrct11_loc "Pressure SwitchFeedback for actuator11 intake direct access" UBYTE B_TRUE 1 100 0.00 1.00000000000 BIT_MASK 0x1 FORMAT "%13.11" ECU_ADDRESS 0x6000072E /end MEASUREMENT
/begin MEASUREMENT VlvLft_fbIntkSwtOutp11 "Pressure SwitchFeedback for actuator11" UBYTE B_TRUE 1 100 0.00 1.00000000000 BIT_MASK 0x1 FORMAT "%13.11" ECU_ADDRESS 0x70001BE9 /end MEASUREMENT
/begin MEASUREMENT VlvLft_fbSnsrIntkOutp11 "intake feedback flag for LowHigh Lift" UBYTE B_TRUE 1 100 0.00 1.00000000000 BIT_MASK 0x1 FORMAT "%13.11" ECU_ADDRESS 0x7000199E /end MEASUREMENT
/begin MEASUREMENT VlvLft_pSnsrIntk "physical VTEC oil pressure intake" SWORD Pres 1 100 -3276.800 3276.700 FORMAT "%8.3" ECU_ADDRESS 0x70001D30 /end MEASUREMENT
/begin MEASUREMENT VlvLft_stFbSnsrActvIntk "Status flag for valvelift intake feedback sensor active" UBYTE B_TRUE 1 100 0.00 1.00000000000 BIT_MASK 0x1 FORMAT "%13.11" ECU_ADDRESS 0x70001BE2 /end MEASUREMENT
/begin MEASUREMENT Vlvlft_stFbSwtActvIntk "Label for Valvelift Intake Feedback Switch Mode" UBYTE B_TRUE 1 100 0.00 1.00000000000 BIT_MASK 0x1 FORMAT "%13.11" ECU_ADDRESS 0x70001BE1 /end MEASUREMENT
/begin MEASUREMENT VlvLft_uRawPSnsrIntk "Intake raw voltage pressure value of VTEC oil sensor" SWORD Volt 1 100 -6553.600 6553.400 FORMAT "%8.3" ECU_ADDRESS 0x70001D2E /end MEASUREMENT
/begin MEASUREMENT VlvLft_uRawPSnsrIntkFild "Filtered raw pressure voltage(intake) value" SWORD Volt 1 100 -6553.600 6553.400 FORMAT "%8.3" ECU_ADDRESS 0x7000199C /end MEASUREMENT
/begin MEASUREMENT VlvLiftCtl_ActrActv_VHE_1 "State of valve lift actuator intake channel 1" UBYTE dez 1 100 0.00 255.0 FORMAT "%5.1" ECU_ADDRESS 0x600007AF /end MEASUREMENT
/begin FUNCTION HLSDem_DrvOffSuprt "1.9.0_1.6.0Detection of drive-off of the vehicle and request of an increased low idle setpoint to support the drive-off"
 /begin DEF_CHARACTERISTIC HLSDem_aLASMax_C HLSDem_aLASMin_C HLSDem_dpMstCylBrkRightHysDelta_C HLSDem_drClthHysMax_C HLSDem_drClthHysMin_C HLSDem_DrvOffSuprtMstCyldp_CUR HLSDem_DrvOffSuprtRampHiGrdtNegSlop_C HLSDem_DrvOffSuprtRampHiGrdtPosSlop_C HLSDem_DrvOffSuprtRampLoGrdtNegSlop_C HLSDem_DrvOffSuprtRampLoGrdtPosSlop_C HLSDem_DrvOffSuprtSpIncrNeg_C HLSDem_DrvOffSuprtSpIncrPos_C HLSDem_facDrvOffCouplSprtOffs_C HLSDem_facDrvOffDeadZoneSprtOffs_C HLSDem_facDrvOffGearRat_CUR HLSDem_facDrvOffsLAS_CUR HLSDem_facDrvOffSuprtSprtOffs_C HLSDem_facOffsAppDeadZoneNorm_C HLSDem_facOffsCouplNorm_C HLSDem_facOffsDrvOffClthKisspnt_CUR HLSDem_facOffsDrvOffNorm_C HLSDem_facOffsDrvOffPhiCorr_CUR HLSDem_facOffsDrvOff_CUR HLSDem_facOffsEnvtlPCorrn_T HLSDem_facRvsGearCreepSp_C HLSDem_facRvsGearDrvOffSp_C HLSDem_facRvsGearKissPntSp_C HLSDem_facSpIncrKissPnt_T HLSDem_flgGearNeutralPosSelnMT_C HLSDem_flgSelBrkHldSysActvCdn_C HLSDem_nDrvOffSuprtAbsltSpMT_CUR HLSDem_nDrvOffSuprtAbsltSp_MAP HLSDem_nDrvOffSuprtOffs_CUR HLSDem_nDrvOffSuprtSpIncr_C HLSDem_nDrvOffSuprtSpIncr_M HLSDem_nDrvOffSuprtSpLimMax_C HLSDem_nMaxOffsSpIncr_C HLSDem_nOffsAppDeadZone_CUR HLSDem_nOffsCoupling_C HLSDem_nOffsDrvOff_C HLSDem_nOffsSpIncrCreep_C HLSDem_nOffsSpIncrCreep_T HLSDem_nOffsSpIncrKissPnt_M HLSDem_pMstCylBrkLeftHysDelta_C HLSDem_pMstCylBrkLeftHysMin_C HLSDem_rClthDrvAwyMax_C HLSDem_rClthDrvAwyMin_C HLSDem_rClthKisspntGain_C HLSDem_rClthKisspntOffset_C HLSDem_rClthMaxOffs1EnaThreshold_C HLSDem_rClthMaxOffs1Ena_C HLSDem_rDrvOffSuprtAThd_C HLSDem_rMaxClthPosSpIncr_C HLSDem_rMaxClthRatSpIncr_C HLSDem_rMaxDiDrvOff_C HLSDem_rMinClthPosSpIncr_C HLSDem_rMinClthRatSpIncr_C HLSDem_stClthPsd_C HLSDem_stDrvOffSuprtDiMaskAST_C HLSDem_stDrvOffSuprtDiMask_C HLSDem_stDrvOffSuprtEnaMaskAST_C HLSDem_stDrvOffSuprtEnaMask_C HLSDem_stEngOperModSeln_FT HLSDem_swtClthDetEna_C HLSDem_SwtDeactvDrvOffSuprtOffs_C HLSDem_swtDrvOffSuprtSpMod_C HLSDem_swtDrvOffSuprtSpSeln_C HLSDem_tiBrkHldSysActvTOFF_C HLSDem_tiDeadTimeFirstEngStrtPassd_C HLSDem_tiDlyDrvOffSuprtSpIncrCVT_C HLSDem_tiDlySpIncrMT_C HLSDem_tiDrvOffSuprtEnaThd_C HLSDem_tiGearRatDrvOffFlt_C HLSDem_uPedDeadZone_C HLSDem_vDrvOffSuprtVehVThd_C HLSDem_vDrvOffVehVHysMax_C HLSDem_vDrvOffVehVHysMin_C HLSDem_vMaxVehVelSpIncrCreep_C HLSDem_vMaxVehVelSpIncrCVT_C HLSDem_vMaxVehVelSpIncrMT_C HLSDem_vMinVehVelSpIncrCreep_C HLSDem_vMinVehVelSpIncrCVT_C HLSDem_vMinVehVelSpIncrMT_C /end DEF_CHARACTERISTIC
 /begin REF_CHARACTERISTIC PT_rTraGear1_C /end REF_CHARACTERISTIC
 /begin IN_MEASUREMENT APP_r APP_uRaw1 APP_uRaw2 BrkP_dpMstCyl BrkP_p Brk_st B_kh_msg Clth3_st Clth_drFlt Clth_r Clth_rKisspnt Clth_st Clth_stClthExtd Clth_swtClthType Com_stBrkHldSys Com_stEngMapReq CoVOM_bEngFrstStrtPassed EnvP_p Epm_nEng fho Gbx_stNPos Gbx_stPNPos Gbx_stRvsPos GlbDa_lWhlCirc HLSDem_nSetPLo HndBrk_stDebVal LAS_a LAS_facRoadGrdt nstatfil_msg PT_stTraType SyC_stSub tmot VehMot_rTrqDfftl VehV_v /end IN_MEASUREMENT
 /begin OUT_MEASUREMENT HLSDem_bDrvOffSuprtActv HLSDem_facAppDeadZone HLSDem_flgSptModActv HLSDem_nDrvOffSuprtSp HLSDem_nOffsSpIncrCreep HLSDem_rClthKisspntDiff HLSDem_rGearDrvOff HLSDem_rGearDrvOffFlt HLSDem_stDrvOffMT HLSDem_stDrvOffSuprtSpFilTyp HLSDem_stDrvOffSuprtSpIncr /end OUT_MEASUREMENT
 /begin LOC_MEASUREMENT HLSDem_nDrvOffSuprtAbsltSp HLSDem_nDrvOffSuprtBascSpLo HLSDem_nDrvOffSuprtOffs HLSDem_nDrvOffSuprtSpIncr HLSDem_nDrvOffSuprtSpRaw HLSDem_nOffsDrvOffSpIncKissPnt HLSDem_pMstCylBrk HLSDem_stDrvOffSpIncrCVT HLSDem_stDrvOffSpIncrKissPnt HLSDem_stDrvOffSpIncrMT HLSDem_stDrvOffSuprtDiCdn HLSDem_stDrvOffSuprtEnaCdn HLSDem_stEngOperModSeln HLSDem_stSIncrCondCVT HLSDem_stSIncrCondMT /end LOC_MEASUREMENT
 FUNCTION_VERSION "1.9.0_1.6.0" /end FUNCTION
/begin FUNCTION HLSDem_NMaxEng "1.49.0    Calculation max. engine speed depending on combustion engine demand"
 /begin DEF_CHARACTERISTIC HLSDem_dKnCtlSlopNeg_C HLSDem_dKnCtlSlopPos_C HLSDem_dNDrvOffSlopNeg_C HLSDem_dNDrvOffSlopPos_C HLSDem_dNDrvOffTractPlsSlopNeg_C HLSDem_dNDrvOffTractPlsSlopPos_C HLSDem_dtOilHys_C HLSDem_dtWrmHys_C HLSDem_facAirOvhtPrv_MAP HLSDem_facCTOvhtPrvMax_MAP HLSDem_facFlTempMax_MAP HLSDem_facOilOvhtPrvMax_MAP HLSDem_facOvhtThresGovHi_C HLSDem_facOvhtThresGovLo_C HLSDem_facOvhtThresHi_C HLSDem_facOvhtThresLo_C HLSDem_flgChkClthStandStill_C HLSDem_flgNoGripActv_C HLSDem_nDeltaDrvOffRst_C HLSDem_nEngMaxGov_MAP HLSDem_nEngMax_MAP HLSDem_nLimAvusWarn_C HLSDem_nLimLftLimp_C HLSDem_nMaxHiSprt_CUR HLSDem_nMaxHiTipp_CUR HLSDem_nMaxHi_CUR HLSDem_nMaxKnCtl_C HLSDem_nMaxNFrstGearTPlus_C HLSDem_nMaxNFrstGear_C HLSDem_nMaxNRvsGearTPlus_C HLSDem_nMaxNRvsGear_C HLSDem_nMaxOilT_MAP HLSDem_nMaxShtrp_C HLSDem_nMaxStandSigErr_C HLSDem_nMaxStandStill_CW HLSDem_nMaxStand_C HLSDem_nMaxStdOfs_C HLSDem_nMaxStdSprt_CUR HLSDem_nMaxStdTipp_CUR HLSDem_nMaxStd_CUR HLSDem_nMaxTEng_CUR HLSDem_rClthPsdThd_C HLSDem_stNMaxEngGov_CW HLSDem_stNMaxEng_CW HLSDem_stNMaxPrio_CW HLSDem_stOvhtEngMaxGov_CW HLSDem_stWarn2500_CW HLSDem_stWarn4000_CW HLSDem_stWarn6000_CW HLSDem_swtTracPlusPrsnt_C HLSDem_tiDelNMaxESP_C HLSDem_tiExDrvOff_C HLSDem_tiGearShft_C HLSDem_tiKnCntl_C HLSDem_tiMaxNMaxHi_CUR HLSDem_tiNMaxBlw_C HLSDem_tiNMaxStand_C HLSDem_tNMaxHi_C HLSDem_tWrm_C HLSDem_vActStandStill_C HLSDem_vMaxDrvOff_C HLSDem_vNMaxHi_C /end DEF_CHARACTERISTIC
 /begin IN_MEASUREMENT Air_tCACDs CEngDsT_t Clth_r Clth_st Clth_stClthExtd Clth_swtClthType Com_stASROff EngDa_tEng EngPrt_bOvhtEngLim EngPrt_nOvhtEngLim Epm_nEng FuelT_t Gbx_nRrngEngSpdInh Gbx_stGearLvr GEVCtl_flgLftLimpNLim GlbDa_stTraPlus HLSDem_bNMaxEngExtPrio HLSDem_bNMaxRmpUp HLSDem_nMaxEngExt HLSDem_nMaxEngExtGov IKCtl_flgSftyRtdt MoX_nMaxICOMsg Oil_stAvusWarn Oil_tSwmp PT_bNoGrip PT_rTrq PT_stTraType Shtrp_stAct SpdGov_bNLimActv StbIntv_bESPErr StbIntv_bTCSDeActv Tra_bCANErrMax Tra_numGear VehV_v /end IN_MEASUREMENT
 /begin OUT_MEASUREMENT HLSDem_bNMaxHiTmp HLSDem_bNMaxHiTmpLmpOn HLSDem_bNMaxPrio HLSDem_bNMaxRed HLSDem_bNMaxWrm HLSDem_bOvhtEngNLim HLSDem_bOvhtEngNLimGov HLSDem_nMax HLSDem_nMaxEng HLSDem_nMaxEngFlt HLSDem_nMaxEngFltGov HLSDem_nMaxEngUnFlt HLSDem_nMaxEngWoHalt HLSDem_nMaxEngWoHaltGov HLSDem_nMaxHiStd HLSDem_nOvhtEngNLim HLSDem_nOvhtEngNLimGov HLSDem_stAvusWarn HLSDem_stNLimEng HLSDem_tOil /end OUT_MEASUREMENT
 /begin LOC_MEASUREMENT B_wrm HLSDem_bNMaxHi HLSDem_bNMaxKnCtl HLSDem_bStandStillLimActv HLSDem_bVehStand HLSDem_DrvOffLim_FF.status HLSDem_ExDrvOff_TONVNM.time HLSDem_facEngSpdLim HLSDem_facEngSpdLimGov HLSDem_flgDrvOffActv HLSDem_flgSpdClthGearAccrSigErr HLSDem_GearChngFF_I.status HLSDem_KnCtlTONVNM_I.time HLSDem_KnCtl_NRamp_I.nRampMem HLSDem_nDrvOffLim HLSDem_nKnCtlLim HLSDem_nMaxAVSLimGov_mp HLSDem_nMaxBDELimGov_mp HLSDem_nMaxBefLim HLSDem_nMaxChaElgLimGov_mp HLSDem_nMaxHi_mp HLSDem_nMaxKnCtlLimGov_mp HLSDem_nMaxStd_mp HLSDem_nMaxT HLSDem_stNMaxDeacStand HLSDem_tAir_mp HLSDem_tOilHys HLSDem_tOilUp /end LOC_MEASUREMENT
 FUNCTION_VERSION "1.49.0" /end FUNCTION
/begin FUNCTION HLSDem_NMaxEngExt "1.5.0     External request for engine protection limitation"
 /begin DEF_CHARACTERISTIC HLSDem_hOvhtHysLimLe_C HLSDem_hOvhtHysLimRht_C HLSDem_nMaxEngGovOvht_T HLSDem_nMaxEngOvht_T HLSDem_numGearErrOvht_C HLSDem_rFanErrOvht_C HLSDem_stNMaxExtPrio_C HLSDem_tEnvErrOvht_C HLSDem_tExhMnfB1_C HLSDem_tiEngOffNMaxOvht_C HLSDem_tiOvhtIntgl_C HLSDem_tiOvrRunDly_C HLSDem_tOvhtFanPwr_T HLSDem_tOvhtTEnv_T HLSDem_tOvhtVehV_T HLSDem_tOvht_C HLSDem_vVehErrOvht_C /end DEF_CHARACTERISTIC
 /begin IN_MEASUREMENT CoEng_flgRelsFco EnvT_t ExhMod_tExhMnfB1 Fan_r TiOff_stTiStrtEndOffVW TiOff_tiStrtEndOff Tra_numGear VehV_v /end IN_MEASUREMENT
 /begin OUT_MEASUREMENT HLSDem_bNMaxEngExtPrio HLSDem_nMaxEngExt HLSDem_nMaxEngExtGov /end OUT_MEASUREMENT
 /begin LOC_MEASUREMENT HLSDem_bNMaxEngOvht HLSDem_bNMaxEngPrioOvht HLSDem_bOvrRunDlyTOFFV_I.outbit HLSDem_bOvrRunDlyTOFFV_I.time HLSDem_hOvht HLSDem_hOvhtHLR_I.hysterese HLSDem_hOvhtITL_I.memory HLSDem_nMaxEngGovOvht HLSDem_nMaxEngOvht HLSDem_stNLimEngExt HLSDem_stTiEngOffER_I.buffer HLSDem_stTiEngOffER_I.oldSignal HLSDem_tOvhtCrit /end LOC_MEASUREMENT
 FUNCTION_VERSION "1.5.0" /end FUNCTION
/begin FUNCTION HLSDem_NMaxPTCoord "28.0.0    Coordination of max. allowed engine speed due to all used engines"
 /begin DEF_CHARACTERISTIC HLSDem_dnGradCVT_C HLSDem_dnGradLim_C HLSDem_dnHiDrgThres_C HLSDem_dnRmpNeg_MAP HLSDem_dnRmpPos_C HLSDem_nAcsLimThres_C HLSDem_nGearLimThres_C HLSDem_nMaxDspl_C HLSDem_nMaxLimErr1_C HLSDem_nMaxLimErr2_C HLSDem_nMaxLimErr3_C HLSDem_nMaxPModeActv_C HLSDem_nMaxPTCoord_CW HLSDem_nMaxRGear_C HLSDem_nMaxTModeActv_C HLSDem_nMaxVErr_CA HLSDem_nMaxVErr_CUR HLSDem_nSetPHiBas_MAP HLSDem_nSysErrLimThres_C HLSDem_nTraLimThres_C HLSDem_rAppMin_C HLSDem_stPTMaxPrio_CW HLSDem_swtTempSel_C HLSDem_tiNMaxDelVErr_C HLSDem_tiRlsRmp_C HLSDem_vVehMin_C /end DEF_CHARACTERISTIC
 /begin IN_MEASUREMENT APP_r CEngDsT_t CoPT_nMaxAcs CoPT_nMaxSysErr CoPT_nMaxTra CrCtl_stActive Epm_nEng HLSDem_bNMaxRed HLSDem_nMaxEng HLSDem_nMaxEngFltGov HLSDem_nMaxEngUnFlt HLSDem_nMaxEngWoHalt HLSDem_nMaxEngWoHaltGov LLim_stActive OilSwmpT_t PT_rTrq PT_stTraRevGear PT_stTraType SpdGov_nMaxPrdc Tra_numGear VehV_v VMD_rVirtAPP /end IN_MEASUREMENT
 /begin OUT_MEASUREMENT HLSDem_bNMaxRmpUp HLSDem_bPTMaxPrio HLSDem_nGearLim HLSDem_nMaxDspl HLSDem_nMaxRmp HLSDem_nSetPHi HLSDem_stNMaxWarnDspl HLSDem_stPTLim /end OUT_MEASUREMENT
 /begin LOC_MEASUREMENT HLSDem_bNMaxRedPT HLSDem_bRmpUpRdy HLSDem_dnMaxEng HLSDem_nHiTemp_mp HLSDem_nMaxEngOld HLSDem_nMaxLimpHome HLSDem_nMaxUnFltPT_mp HLSDem_nMaxVErr_mp HLSDem_nSetPHiBas_mp HLSDem_nSpHiUnFlt HLSDem_numGear HLSDem_tTempSel /end LOC_MEASUREMENT
 FUNCTION_VERSION "28.0.0" /end FUNCTION
/begin FUNCTION HT2KTTEV "30301.0.0 Interface hardware driver - component driver output canister purge valve" /begin DEF_CHARACTERISTIC CWTATETEV FPCtl_stCpvDiPs_C TATEOUT1 /end DEF_CHARACTERISTIC
 /begin IN_MEASUREMENT B_tatewi_msg DevLib_stPwrStgEnaCond tateout_w_msg tevper_msg /end IN_MEASUREMENT
 /begin OUT_MEASUREMENT B_tevtini_msg /end OUT_MEASUREMENT
 /begin LOC_MEASUREMENT CstrPurg_ratPercCpv FPCtl_flgReIniHT2KTTEV20ms /end LOC_MEASUREMENT
 FUNCTION_VERSION "30301.0.0" /end FUNCTION
/begin FUNCTION HT2KTVH "14.2.0    ME(D)17 hardware-/component driver switched valve lift"
 /begin DEF_CHARACTERISTIC VlvLft_pOilPIntkHighrThd_C VlvLft_pOilPIntkLowrThd_C VlvLft_pTrfPSnsrIntk_T Vlvlft_stFbIntkSwt_C VlvLft_tiOilPSnsrIntkLT_C VlvLft_tiSpclPrSwtIntkDeb_C VlvLft_tiStdPrSwtIntkDeb_C /end DEF_CHARACTERISTIC
 /begin IN_MEASUREMENT SyC_stSub VlvLft_flgCtrlActrIntk1 VlvLft_tiDlyVlvActvnIntk /end IN_MEASUREMENT
 /begin OUT_MEASUREMENT VlvLft_fbIntkSwtOutp11 VlvLft_pSnsrIntk VlvLft_stFbSnsrActvIntk Vlvlft_stFbSwtActvIntk VlvLft_uRawPSnsrIntk VlvLiftCtl_ActrActv_VHE_1 /end OUT_MEASUREMENT
 /begin LOC_MEASUREMENT B_cht2ktvhe VlvLft_fbIntkDrct11_loc VlvLft_fbSnsrIntkOutp11 VlvLft_uRawPSnsrIntkFild /end LOC_MEASUREMENT
 FUNCTION_VERSION "14.2.0" /end FUNCTION
/begin FUNCTION HWSIG "14721.0.0_1.0.0Hardware Signals" /begin IN_MEASUREMENT SyC_stSub /end IN_MEASUREMENT /begin OUT_MEASUREMENT BattuT30C_uRaw udst_w_msg /end OUT_MEASUREMENT FUNCTION_VERSION "14721.0.0_1.0.0" /end FUNCTION
/begin FUNCTION I14229_AC "3.1.0     Customer specific service 0xAC" /begin IN_MEASUREMENT Sia_stIgnLck /end IN_MEASUREMENT FUNCTION_VERSION "3.1.0" /end FUNCTION
/begin FUNCTION I14229_Appl "74.3.0_6.9.0UDS Service Application"
 /begin DEF_CHARACTERISTIC Com_lDistShipModLim_C Com_lDstDCLim_C Com_lDstShipMod_C Com_tiOdoDly_C I14229iocbi_rPCSDutyIni_C I14229_GEVCtl_agMaxAdpdIntk_C I14229_nHpFlInjCdnIdlRunngHi_C I14229_SigTabRFFD_CA I14229_stEnaVINDia_C I14229_stSwtOilPmpOutp_C I14229_stVINWriteClrUnit_C I14229_tiForceActvTmr_C I14229_tiKsDiag_C I14229_tiPHAACTRINTKTmr_C I14229_tiPHAACTROUTLTmr_C I14229_tiSwtHistDly_C I14229_tiVINWriteClrTimeout_C I14229_TrbCh_uLongTermClsdSensB1_C /end DEF_CHARACTERISTIC
 /begin IN_MEASUREMENT AirC_pAnaClnt APP_uRaw1ADC APP_uRaw2ADC arqtprs_w_msg BattU_stPwrFail BattU_u Brk_st Brk_stMn Brk_stRed BusDiag_flgVEHICLEBUSOFF B_dksc_msg CEngDsT_t Clth2_st Clth3_st Clth_st CoEng_bStalEng CoEng_st Com_aLgtG Com_flgEbsRst Com_lDst Com_stShftInPark Com_stVINWriteClrDone CoVOM_stSSE CoVOM_stStopRls ehlpks_sc_msg ElecLd_iEPSLoadOnly EngPrt_stOvrSpd EpmCaS_ctErrSig EpmCrS_ctErrSig Epm_nEng fzabgs_w_msg fzabgzyl_w_msg Gbx_uAna1NPosRaw Gbx_uAna2NPosRaw GlbDa_lenTotDstDcycHiResl I14229iocp_stSFTRJC I14229rcCrCtl_stLmp I14229_rPCSDuty I14229_stHpFlInjCdnIdl Ign_ia_real_s16 IntkAirT_tSnsrFild1 ivzabg_w_msg LIGov_trqI ml_w_msg nstat ps_w_msg PthSet_trqInrLtd PT_rTrq PT_stTraType RngMod_trqInrOpt Sia_stOK SyC_ctPostDrvLeave SyC_stSub SysDiag_flgCModJdg T15_st tez_l_msg tka_msg tvub_w_msg ubsq VehV_v wdkba_w_msg wdks_w zwist zzyllfb_msg /end IN_MEASUREMENT
 /begin OUT_MEASUREMENT B_dmdsteol Com_stShipMod ECUSerNum I14229CoEng_tiNormalOBDPrevDcyc I14229EpmCaS_ctErrSig1 I14229GlbDa_lTotDstDCHiReslPrevDcyc I14229IntkAirT_tSnsrTstrMax I14229IntkAirT_tSnsrTstrMin I14229RDBI_tiOvrSpd I14229_AirC_pAnaClnt I14229_Brk_st I14229_Brk_stRed I14229_ElcWastGatLift_s32 I14229_ElecLd_iEPSLoadOnly I14229_EpmCaS_ctErrSig I14229_EpmCaS_ctErrSig2 I14229_EpmCrS_ctErrSig I14229_flgInhbE82E I14229_ForceActvTmr I14229_fzabgs_w I14229_fzabgzyl_w I14229_Gbx_uAna1NPosRaw I14229_Gbx_uAna2NPosRaw I14229_ivzabg_w I14229_LongTermAdpnVal_s32 I14229_ml_w_msg I14229_nstat I14229_numDTCFrzFrmHi I14229_numDTCFrzFrmLo I14229_numDTCFrzFrmMid I14229_pEngSrtMin I14229_ps_w I14229_rHtgS2B1 I14229_rTrqPT I14229_stBrkMnRaw I14229_stClth2 I14229_stClth3 I14229_stClth4Bit0 I14229_stClthBit4 I14229_stForceActvTmr I14229_stGbxRvsPos I14229_stKSdiag I14229_stPHAACTRINTKTmr I14229_stPHAACTROUTLTmr I14229_stSwtHistFlg I14229_stSwtOffOnHistFlg I14229_stSwtOnOffHistFlg I14229_stVBM I14229_stVINWriteClrDone I14229_stVINWriteClrReq I14229_tiInj1On I14229_tiSia I14229_tiVINWriteClrTimeout_mp I14229_tka I14229_tkaMax I14229_tkaMin I14229_tmotMaxCurrDcyc I14229_tmotMaxPrevDcyc I14229_tmotMinCurrDcyc I14229_tmotMinPrevDcyc I14229_trqInrLtdPthSet I14229_trqSetEngTrqPtd I14229_tSnsrFild1 I14229_ubsq I14229_umsrln_w I14229_wdkba_w I14229_wdks_w I14229_wped1 I14229_wped2 I14229_zwist /end OUT_MEASUREMENT
 /begin LOC_MEASUREMENT Com_lDstDCShip Com_lTarShipModDst Com_stShipModOdoSupp Com_stShipModSupp Com_stShipModSuppFlg I14229RDBI_nOvrSpd I14229_cntrReIni I14229_lDst I14229_stSwtHistDly_mp I14229_tiVINWriteClrTimeoutNRC22_mp /end LOC_MEASUREMENT
 FUNCTION_VERSION "74.3.0_6.9.0" /end FUNCTION
/begin FUNCTION I14229_B8 "4.4.0     Optional On Board Snap Shot Setting service" FUNCTION_VERSION "4.4.0" /end FUNCTION
/begin FUNCTION I14229_B9 "18.4.0    Customer specific service 0xB9" /begin DEF_CHARACTERISTIC I14229_stSwtB9SecuChkEna_C /end DEF_CHARACTERISTIC
 /begin IN_MEASUREMENT AirC_stPsCmpr AirC_stSwt Batt_flgDeternDetd Batt_flgInhbSpst Batt_stEngStopInhbn BdInt_stInhbReas BrkPed_bEngStopEna BrkPed_flgISABBrkPSuffVehStill BrkPed_flgSlopeExcd BrkPed_flgSwtISABAvl Brk_stMn B_kl15 B_llri Clth3_st Com_stInShiftNeut Com_stInShiftPrkg Com_stShftInNeutr Com_stShftInPark Com_stStSpEngStop Com_stTranStop CoVOM_bSSEEna CoVOM_bStopReq CoVOM_bVXSinceStrtDeb CoVOM_stISGoStb CoVOM_stISStopInhb CoVOM_stStopReqCdn CoVOM_stStopRls Epm_nEng Epm_numCyl ESS_bEngStopEna mshfmst_w PthSet_bEnaFCO PT_bEngStopEna PT_bEngStopReq PT_stTraType RESERVED_BIT0 RESERVED_BIT1 Sia_stIgnLck StSpSwt_st VlvLft_flgCtrlActrIntk1 VlvLft_flgFbVlvStIntk /end IN_MEASUREMENT
 FUNCTION_VERSION "18.4.0" /end FUNCTION
/begin FUNCTION I15031Extd_srv1 "30000.16.0Request current powertrain diagnostic data extended" FUNCTION_VERSION "30000.16.0" /end FUNCTION
/begin FUNCTION I15031Extd_srv2 "30000.12.0Request powertrain freeze frame data extended" FUNCTION_VERSION "30000.12.0" /end FUNCTION
/begin FUNCTION I15031Extd_srv37 "30000.7.0 Request of emission-relevant Diagnostic Trouble Codes from currentcompleted driving cycles extended" FUNCTION_VERSION "30000.7.0" /end FUNCTION
/begin FUNCTION I15031Extd_srv4 "30000.7.0_2.1.0Clear and reset emission-related diagnostic information extended" /begin DEF_CHARACTERISTIC I15031_nMaxSrv4_C /end DEF_CHARACTERISTIC /begin IN_MEASUREMENT Epm_nEng /end IN_MEASUREMENT FUNCTION_VERSION "30000.7.0_2.1.0" /end FUNCTION
/begin FUNCTION I15031Extd_srv9 "30000.32.0_1.2.0Request vehicle informations extended"
 /begin DEF_CHARACTERISTIC I15031_srv9PIDTable.PID0_C I15031_srv9PIDTable.PID2_C I15031_srv9PIDTable.PID4_C I15031_srv9PIDTable.PID6_C I15031_srv9PIDTable.PID8_C I15031_srv9PIDTable.PIDA_C I15031_srv9PIDTable.PIDB_C I15031_srv9PIDTable.PIDF_C /end DEF_CHARACTERISTIC
 /begin IN_MEASUREMENT T15_st /end IN_MEASUREMENT
 /begin OUT_MEASUREMENT I15031_ITIDSuppSrv9 I15031_srv9_stCVNRecalc I15031_srv9_ValidCVN /end OUT_MEASUREMENT
 /begin LOC_MEASUREMENT i15031_srv9_CVN_Calc_ui /end LOC_MEASUREMENT
 FUNCTION_VERSION "30000.32.0_1.2.0" /end FUNCTION
/begin FUNCTION I15031_srv1 "30000.40.0_2.1.0Request current powertrain diagnostic data"
 /begin DEF_CHARACTERISTIC I15031_PID13_C I15031_PID1C_C I15031_PID1D_C I15031_PID4FA_C I15031_PID4FB_C I15031_PID4FC_C I15031_PID4FD_C I15031_PID50A_C I15031_PID5F_C I15031_PID65A_C I15031_PID66A_C I15031_PID67A_C I15031_PID68A_C I15031_PID69A_C I15031_PID6AA_C I15031_PID6BA_C I15031_PID6CA_C I15031_PID6DA_C I15031_PID6EA_C I15031_PID6FA_C I15031_PID70A_C I15031_PID71A_C I15031_PID72A_C I15031_PID73A_C I15031_PID74A_C I15031_PID75A_C I15031_PID76A_C I15031_PID77A_C I15031_PID78A_C I15031_PID79A_C I15031_PID7AA_C I15031_PID7BA_C I15031_PID7CA_C I15031_PID7FA_C I15031_PID81A_C I15031_PID82A_C I15031_PID83A_C I15031_PID85A_C I15031_PID86A_C I15031_PID87A_C I15031_PID89A_C I15031_PID8AA_C I15031_PID8BA_C I15031_PID8CA_C I15031_PID8FA_C I15031_PID92A_C I15031_PID93A_C I15031_PID94A_C I15031_PID98A_C I15031_PID99A_C I15031_PID9AA_C I15031_PID9BA_C I15031_PID9CA_C I15031_PID9FA_C I15031_PIDA1A_C I15031_PIDA3A_C I15031_PIDA4A_C I15031_PIDA5A_C I15031_PIDA7A_C I15031_PIDA8A_C I15031_PIDA9A_C I15031_PIDACA_C I15031_stRfrshCal_C /end DEF_CHARACTERISTIC
 /begin OUT_MEASUREMENT I15031_FILLSIG1 I15031_FILLSIG2 I15031_FILLSIG4 I15031_PID13 I15031_PID1C I15031_PID1D I15031_PID4FA I15031_PID4FB I15031_PID4FC I15031_PID4FD I15031_PID50A I15031_PID50B I15031_PID50C I15031_PID50D I15031_PID5F I15031_PID65A I15031_PID66A I15031_PID67A I15031_PID68A I15031_PID69A I15031_PID6AA I15031_PID6BA I15031_PID6CA I15031_PID6DA I15031_PID6EA I15031_PID6FA I15031_PID70A I15031_PID71A I15031_PID72A I15031_PID73A I15031_PID74A I15031_PID75A I15031_PID76A I15031_PID77A I15031_PID78A I15031_PID79A I15031_PID7AA I15031_PID7BA I15031_PID7CA I15031_PID7FA I15031_PID81A I15031_PID82A I15031_PID83A I15031_PID85A I15031_PID86A I15031_PID87A I15031_PID89A I15031_PID8AA I15031_PID8BA I15031_PID8CA I15031_PID8FA I15031_PID92A I15031_PID93A I15031_PID94A I15031_PID98A I15031_PID99A I15031_PID9AA I15031_PID9BA I15031_PID9CA I15031_PID9FA I15031_PIDA1A I15031_PIDA3A I15031_PIDA4A I15031_PIDA5A I15031_PIDA7A I15031_PIDA8A I15031_PIDA9A I15031_PIDACA I15031_PIDSuppSrv1 I15031_Srv12_Ext_DisablPIDSupp /end OUT_MEASUREMENT
 /begin LOC_MEASUREMENT I15031_PIDSuppSrv2 /end LOC_MEASUREMENT
 FUNCTION_VERSION "30000.40.0_2.1.0" /end FUNCTION
/begin FUNCTION I15031_srv2 "30000.6.0 Request powertrain freeze frame data" FUNCTION_VERSION "30000.6.0" /end FUNCTION
/begin FUNCTION I15031_srv37 "30000.9.0_1.1.0Request of emission-relevant DTC's from current/completed driving cycle(s)" FUNCTION_VERSION "30000.9.0_1.1.0" /end FUNCTION
/begin FUNCTION I15031_srv4 "30000.9.0 Clear and reset emission-related diagnostic information" FUNCTION_VERSION "30000.9.0" /end FUNCTION
/begin FUNCTION I15031_srv6 "30000.10.0Request on-board monitoring test results for specific monitored systems" FUNCTION_VERSION "30000.10.0" /end FUNCTION
/begin COMPU_METHOD Acc "" RAT_FUNC "%6.5" "m/s^2" COEFFS 0 1000 0 0 0 1 /end COMPU_METHOD
/begin COMPU_METHOD B_TRUE "" TAB_VERB "%6.3" "" COMPU_TAB_REF B_TRUE /end COMPU_METHOD
/begin COMPU_VTAB B_TRUE "" TAB_VERB 2 0 "FALSE" 1 "TRUE" /end COMPU_VTAB
/begin COMPU_METHOD CrSRev2CrSInc "" RAT_FUNC "%6.4" "-" COEFFS 0 36 0 0 0 1 /end COMPU_METHOD
/begin COMPU_METHOD dez "" RAT_FUNC "%6.2" "" COEFFS 0 1 0 0 0 1 /end COMPU_METHOD
/begin COMPU_METHOD EngN "" RAT_FUNC "%6.3" "rpm" COEFFS 0 2 0 0 0 1 /end COMPU_METHOD
/begin COMPU_METHOD EngNGrd "" RAT_FUNC "%6.3" "rpm/s" COEFFS 0 2 0 0 0 1 /end COMPU_METHOD
/begin COMPU_METHOD Fact "" RAT_FUNC "%6.5" "-" COEFFS 0 8192 0 0 0 1 /end COMPU_METHOD
/begin COMPU_METHOD Fact_10000 "" RAT_FUNC "%7.6" "-" COEFFS 0 10000 0 0 0 1 /end COMPU_METHOD
/begin COMPU_METHOD Fact_q0p1_COMPU "" RAT_FUNC "%6.3" "-" COEFFS 0 10 0 0 0 1 /end COMPU_METHOD
/begin COMPU_METHOD fak_q0p05 "" RAT_FUNC "%6.4" "" COEFFS 0 1 0 0 0 0.05 /end COMPU_METHOD
/begin COMPU_METHOD fak_q3p906Em5 "" RAT_FUNC "%7.6" "-" COEFFS 0 25600 0 0 0 1 /end COMPU_METHOD
/begin COMPU_METHOD fak_ub_b4 "" RAT_FUNC "%6.4" "-" COEFFS 0 256 0 0 0 4 /end COMPU_METHOD
/begin COMPU_METHOD hk100msxs_uw_b993 "" RAT_FUNC "%6.2" "s" COEFFS 0 0 65536 0 66 0 /end COMPU_METHOD
/begin COMPU_METHOD h_uw_q1p5 "" RAT_FUNC "%6.2" "J" COEFFS 0 2 0 0 0 3 /end COMPU_METHOD
/begin COMPU_METHOD I15031_PID1CVerb "" TAB_VERB "%6.3" "-" COMPU_TAB_REF I15031_PID1CVerb /end COMPU_METHOD
/begin COMPU_VTAB I15031_PID1CVerb "" TAB_VERB 49 1 "OBD II" 2 "OBD" 3 "OBD and OBD II" 4 "OBD I" 5 "No OBD" 6 "EOBD" 7 "EOBD and OBD II" 8 "EOBD and OBD" 9 "EOBD, OBD and OBD II" 10 "JOBD" 11 "JOBD and OBD II" 12 "JOBD and EOBD" 13 "JOBD, EOBD and OBD II" 14 "OBD, EOBD and KOBD" 15 "OBD, OBD II, EOBD and KOBD" 17 "EMD" 18 "EMD+" 19 "HD OBD-C" 20 "HD OBD" 21 "WWH OBD" 23 "HD EOBD-I" 24 "HD EOBD-I N" 25 "HD EOBD-II" 26 "HD EOBD-II N" 28 "OBDBr-1" 29 "OBDBr-2" 30 "KOBD" 31 "IOBD I" 32 "IOBD II" 33 "HD EOBD-VI" 34 "OBD, OBD II and HD OBD" 35 "OBDBr-3" 36 "MC EOBD-I" 37 "MC EOBD-II" 38 "MC COBD-I" 39 "MC TOBD-I" 40 "MC JOBD-I" 41 "CN-OBD-6" 42 "OBDBr-D" 43 "CN-HDOBD-VI" 44 "IOBD-I-BS6" 45 "IOBD-II-BS6" 46 "IHDOBD-BSVI" 47 "OBDBr-P8" 48 "HD-JOBD-II" 49 "HD-KOBD-II" 50 "CN-OROBD-IV" 51 "ZEV Placeholder" 52 "MC JOBD-II" /end COMPU_VTAB
/begin COMPU_METHOD I15031_PID5FVerb "" TAB_VERB "%6.3" "-" COMPU_TAB_REF I15031_PID5FVerb /end COMPU_METHOD
/begin COMPU_VTAB I15031_PID5FVerb "" TAB_VERB 4 14 "EURO IV B1" 15 "EURO V B2" 16 "EURO C" 17 "EURO VI" /end COMPU_VTAB
/begin COMPU_METHOD I15031_srv9_CVN_CalcVerb "" TAB_VERB "%2.1" "-" COMPU_TAB_REF I15031_srv9_CVN_CalcVerb /end COMPU_METHOD
/begin COMPU_VTAB I15031_srv9_CVN_CalcVerb "" TAB_VERB 7 0 "NOTAVAILABLE" 1 "CALC_START" 2 "CALC_BUSY" 3 "CALC_WRITE" 4 "CALC_READY" 5 "CALC_CLEAR" 6 "CALC_CLEARBUSY" /end COMPU_VTAB
/begin COMPU_METHOD kw_q0p0156 "" RAT_FUNC "%6.4" "Grad KW" COEFFS 0 64 0 0 0 1 /end COMPU_METHOD
/begin COMPU_METHOD Length_10m "" RAT_FUNC "%6.1" "m" COEFFS 0 0.1 0 0 0 1 /end COMPU_METHOD
/begin COMPU_METHOD m_q0p1 "" RAT_FUNC "%6.3" "kg/h" COEFFS 0 10 0 0 0 1 /end COMPU_METHOD
/begin COMPU_METHOD nmot_sw_q0p5 "" RAT_FUNC "%6.3" "1/min" COEFFS 0 2 0 0 0 1 /end COMPU_METHOD
/begin COMPU_METHOD nmot_ub_q10_rpm "" RAT_FUNC "%6.1" "rpm" COEFFS 0 1 0 0 0 40 /end COMPU_METHOD
/begin COMPU_METHOD OILFILT_STUCKCHK_SC_Compu "" TAB_VERB "%6.3" "" COMPU_TAB_REF OILFILT_STUCKCHK_SC_Compu /end COMPU_METHOD
/begin COMPU_VTAB OILFILT_STUCKCHK_SC_Compu "" TAB_VERB 2 0 "False" 1 "True" /end COMPU_VTAB
/begin COMPU_METHOD OILGLRYT_COLDSTRTDIAG_SC_Compu "" TAB_VERB "%6.3" "" COMPU_TAB_REF OILGLRYT_COLDSTRTDIAG_SC_Compu /end COMPU_METHOD
/begin COMPU_VTAB OILGLRYT_COLDSTRTDIAG_SC_Compu "" TAB_VERB 2 0 "False" 1 "True" /end COMPU_VTAB
/begin COMPU_METHOD OILGLRYT_SNSRCFG_SC_Compu "" TAB_VERB "%6.3" "" COMPU_TAB_REF OILGLRYT_SNSRCFG_SC_Compu /end COMPU_METHOD
/begin COMPU_VTAB OILGLRYT_SNSRCFG_SC_Compu "" TAB_VERB 5 0 "No_Sensor" 1 "Analog" 2 "CAN" 3 "SENT_Slow_Channel" 4 "SENT_Fast_Channel" /end COMPU_VTAB
/begin COMPU_METHOD OilMassPerTime "" RAT_FUNC "%7.6" "mg/s" COEFFS 0 10000 0 0 0 1 /end COMPU_METHOD
/begin COMPU_METHOD OilMassPerTimeLo "" RAT_FUNC "%6.4" "mg/s" COEFFS 0 500 0 0 0 1 /end COMPU_METHOD
/begin COMPU_METHOD OilMFl_mgps_q0p1 "" RAT_FUNC "%6.3" "mg/s" COEFFS 0 10 0 0 0 1 /end COMPU_METHOD
/begin COMPU_METHOD OilMlg "" RAT_FUNC "%6.2" "km" COEFFS 0 1 0 0 0 1 /end COMPU_METHOD
/begin COMPU_METHOD OILMOK_SY_Compu "" TAB_VERB "%6.3" "" COMPU_TAB_REF OILMOK_SY_Compu /end COMPU_METHOD
/begin COMPU_VTAB OILMOK_SY_Compu "" TAB_VERB 2 0 "False" 1 "True" /end COMPU_VTAB
/begin COMPU_METHOD OilMsPrc_q0p01 "" RAT_FUNC "%6.4" "%" COEFFS 0 100 0 0 0 1 /end COMPU_METHOD
/begin COMPU_METHOD OilMs_mg "" RAT_FUNC "%6.2" "mg" COEFFS 0 1 0 0 0 1 /end COMPU_METHOD
/begin COMPU_METHOD OilMs_q0p1 "" RAT_FUNC "%6.3" "g" COEFFS 0 10 0 0 0 1 /end COMPU_METHOD
/begin COMPU_METHOD OilMs_q10 "" RAT_FUNC "%6.1" "g" COEFFS 0 0.1 0 0 0 1 /end COMPU_METHOD
/begin COMPU_METHOD OILPCTL_SY_Compu "" TAB_VERB "%6.3" "" COMPU_TAB_REF OILPCTL_SY_Compu /end COMPU_METHOD
/begin COMPU_VTAB OILPCTL_SY_Compu "" TAB_VERB 2 0 "False" 1 "True" /end COMPU_VTAB
/begin COMPU_METHOD OILPMPFRICTQ_SC_Compu "" TAB_VERB "%6.3" "" COMPU_TAB_REF OILPMPFRICTQ_SC_Compu /end COMPU_METHOD
/begin COMPU_VTAB OILPMPFRICTQ_SC_Compu "" TAB_VERB 2 0 "False" 1 "True" /end COMPU_VTAB
/begin COMPU_METHOD OILPMPTYP_SC_Compu "" TAB_VERB "%6.3" "" COMPU_TAB_REF OILPMPTYP_SC_Compu /end COMPU_METHOD
/begin COMPU_VTAB OILPMPTYP_SC_Compu "" TAB_VERB 3 0 "two-stage" 1 "a continuous oil pressure pump is available" 255 "two-stage and continuous oil pressure pump" /end COMPU_VTAB
/begin COMPU_METHOD OILPMP_CTL_SY_Compu "" TAB_VERB "%6.3" "" COMPU_TAB_REF OILPMP_CTL_SY_Compu /end COMPU_METHOD
/begin COMPU_VTAB OILPMP_CTL_SY_Compu "" TAB_VERB 2 0 "False" 1 "True" /end COMPU_VTAB
/begin COMPU_METHOD OILPMP_SC_Compu "" TAB_VERB "%6.3" "" COMPU_TAB_REF OILPMP_SC_Compu /end COMPU_METHOD
/begin COMPU_VTAB OILPMP_SC_Compu "" TAB_VERB 2 0 "False" 1 "True" /end COMPU_VTAB
/begin COMPU_METHOD OILPPSSWT_SC_Compu "" TAB_VERB "%6.3" "" COMPU_TAB_REF OILPPSSWT_SC_Compu /end COMPU_METHOD
/begin COMPU_VTAB OILPPSSWT_SC_Compu "" TAB_VERB 2 0 "False" 1 "True" /end COMPU_VTAB
/begin COMPU_METHOD OILPSEN_DRQREQ_SC_Compu "" TAB_VERB "%6.3" "" COMPU_TAB_REF OILPSEN_DRQREQ_SC_Compu /end COMPU_METHOD
/begin COMPU_VTAB OILPSEN_DRQREQ_SC_Compu "" TAB_VERB 2 0 "False" 1 "True" /end COMPU_VTAB
/begin COMPU_METHOD OILPSEN_SY_Compu "" TAB_VERB "%6.3" "" COMPU_TAB_REF OILPSEN_SY_Compu /end COMPU_METHOD
/begin COMPU_VTAB OILPSEN_SY_Compu "" TAB_VERB 2 0 "False" 1 "True" /end COMPU_VTAB
/begin COMPU_METHOD OILPSNSRTYP_SC_Compu "" TAB_VERB "%6.3" "" COMPU_TAB_REF OILPSNSRTYP_SC_Compu /end COMPU_METHOD
/begin COMPU_VTAB OILPSNSRTYP_SC_Compu "" TAB_VERB 4 0 "ANALOG" 1 "DIGITAL" 2 "SENT" 255 "SELECTABLE" /end COMPU_VTAB
/begin COMPU_METHOD OILP_TYPAVL_SY_Compu "" TAB_VERB "%6.3" "" COMPU_TAB_REF OILP_TYPAVL_SY_Compu /end COMPU_METHOD
/begin COMPU_VTAB OILP_TYPAVL_SY_Compu "" TAB_VERB 2 0 "False" 1 "True" /end COMPU_VTAB
/begin COMPU_METHOD OILSWMPT_CMBDSNSRPLAUSCC_SC_Compu "" TAB_VERB "%6.3" "" COMPU_TAB_REF OILSWMPT_CMBDSNSRPLAUSCC_SC_Compu /end COMPU_METHOD
/begin COMPU_VTAB OILSWMPT_CMBDSNSRPLAUSCC_SC_Compu "" TAB_VERB 2 0 "False" 1 "True" /end COMPU_VTAB
/begin COMPU_METHOD OILSWMPT_CMBDSNSRPLAUSMBC_SC_Compu "" TAB_VERB "%6.3" "" COMPU_TAB_REF OILSWMPT_CMBDSNSRPLAUSMBC_SC_Compu /end COMPU_METHOD
/begin COMPU_VTAB OILSWMPT_CMBDSNSRPLAUSMBC_SC_Compu "" TAB_VERB 2 0 "False" 1 "True" /end COMPU_VTAB
/begin COMPU_METHOD OILSWMPT_CMBDSNSRPLAUSPRC_SC_Compu "" TAB_VERB "%6.3" "" COMPU_TAB_REF OILSWMPT_CMBDSNSRPLAUSPRC_SC_Compu /end COMPU_METHOD
/begin COMPU_VTAB OILSWMPT_CMBDSNSRPLAUSPRC_SC_Compu "" TAB_VERB 2 0 "False" 1 "True" /end COMPU_VTAB
/begin COMPU_METHOD OILSWMPT_MDL_SC_Compu "" TAB_VERB "%6.3" "" COMPU_TAB_REF OILSWMPT_MDL_SC_Compu /end COMPU_METHOD
/begin COMPU_VTAB OILSWMPT_MDL_SC_Compu "" TAB_VERB 2 0 "False" 1 "True" /end COMPU_VTAB
/begin COMPU_METHOD OILSWMPT_PCKSELNOIL_SC_Compu "" TAB_VERB "%6.3" "" COMPU_TAB_REF OILSWMPT_PCKSELNOIL_SC_Compu /end COMPU_METHOD
/begin COMPU_VTAB OILSWMPT_PCKSELNOIL_SC_Compu "" TAB_VERB 2 0 "0" 1 "1" /end COMPU_VTAB
/begin COMPU_METHOD OILSWMPT_PLAUS_SC_Compu "" TAB_VERB "%6.3" "" COMPU_TAB_REF OILSWMPT_PLAUS_SC_Compu /end COMPU_METHOD
/begin COMPU_VTAB OILSWMPT_PLAUS_SC_Compu "" TAB_VERB 2 0 "False" 1 "True" /end COMPU_VTAB
/begin COMPU_METHOD OILSWMPT_SNSRCFG_SC_Compu "" TAB_VERB "%6.3" "" COMPU_TAB_REF OILSWMPT_SNSRCFG_SC_Compu /end COMPU_METHOD
/begin COMPU_VTAB OILSWMPT_SNSRCFG_SC_Compu "" TAB_VERB 4 0 "No_Sensor" 1 "ADC" 2 "LIN" 255 "Via_application_parameter" /end COMPU_VTAB
/begin COMPU_METHOD OILSWMPT_SNSRPRSNT_SC_Compu "" TAB_VERB "%6.3" "" COMPU_TAB_REF OILSWMPT_SNSRPRSNT_SC_Compu /end COMPU_METHOD
/begin COMPU_VTAB OILSWMPT_SNSRPRSNT_SC_Compu "" TAB_VERB 2 0 "False" 1 "True" /end COMPU_VTAB
/begin COMPU_METHOD OILSWMPT_SWMPTSNSRPLAUSCC_SC_Compu "" TAB_VERB "%6.3" "" COMPU_TAB_REF OILSWMPT_SWMPTSNSRPLAUSCC_SC_Compu /end COMPU_METHOD
/begin COMPU_VTAB OILSWMPT_SWMPTSNSRPLAUSCC_SC_Compu "" TAB_VERB 2 0 "False" 1 "True" /end COMPU_VTAB
/begin COMPU_METHOD OILSWMPT_SWMPTSNSRPLAUSMBC_SC_Compu "" TAB_VERB "%6.3" "" COMPU_TAB_REF OILSWMPT_SWMPTSNSRPLAUSMBC_SC_Compu /end COMPU_METHOD
/begin COMPU_VTAB OILSWMPT_SWMPTSNSRPLAUSMBC_SC_Compu "" TAB_VERB 2 0 "False" 1 "True" /end COMPU_VTAB
/begin COMPU_METHOD OILSWMPT_SWMPTSNSRPLAUSPRC_SC_Compu "" TAB_VERB "%6.3" "" COMPU_TAB_REF OILSWMPT_SWMPTSNSRPLAUSPRC_SC_Compu /end COMPU_METHOD
/begin COMPU_VTAB OILSWMPT_SWMPTSNSRPLAUSPRC_SC_Compu "" TAB_VERB 2 0 "False" 1 "True" /end COMPU_VTAB
/begin COMPU_METHOD OILSWMPT_TYPAVL_SC_Compu "" TAB_VERB "%6.3" "" COMPU_TAB_REF OILSWMPT_TYPAVL_SC_Compu /end COMPU_METHOD
/begin COMPU_VTAB OILSWMPT_TYPAVL_SC_Compu "" TAB_VERB 2 0 "False" 1 "True" /end COMPU_VTAB
/begin COMPU_METHOD OILTADC_SY_Compu "" TAB_VERB "%6.3" "" COMPU_TAB_REF OILTADC_SY_Compu /end COMPU_METHOD
/begin COMPU_VTAB OILTADC_SY_Compu "" TAB_VERB 2 0 "False" 1 "True" /end COMPU_VTAB
/begin COMPU_METHOD OILTPID5CCFG_SC_Compu "" TAB_VERB "%6.3" "" COMPU_TAB_REF OILTPID5CCFG_SC_Compu /end COMPU_METHOD
/begin COMPU_VTAB OILTPID5CCFG_SC_Compu "" TAB_VERB 3 0 "No sensor" 1 "OilSwmpT" 2 "OilCylHdT" /end COMPU_VTAB
/begin COMPU_METHOD OILTPULS_SY_Compu "" TAB_VERB "%6.3" "" COMPU_TAB_REF OILTPULS_SY_Compu /end COMPU_METHOD
/begin COMPU_VTAB OILTPULS_SY_Compu "" TAB_VERB 2 0 "False" 1 "True" /end COMPU_VTAB
/begin COMPU_METHOD OILT_TYPAVL_SY_Compu "" TAB_VERB "%6.3" "" COMPU_TAB_REF OILT_TYPAVL_SY_Compu /end COMPU_METHOD
/begin COMPU_VTAB OILT_TYPAVL_SY_Compu "" TAB_VERB 2 0 "False" 1 "True" /end COMPU_VTAB
/begin COMPU_METHOD OIL_DYNTSTON_SY_Compu "" TAB_VERB "%6.3" "" COMPU_TAB_REF OIL_DYNTSTON_SY_Compu /end COMPU_METHOD
/begin COMPU_VTAB OIL_DYNTSTON_SY_Compu "" TAB_VERB 2 0 "FALSE" 1 "TRUE" /end COMPU_VTAB
/begin COMPU_METHOD Oil_lvl_mm_q0p004 "" RAT_FUNC "%6.4" "mm" COEFFS 0 250 0 0 0 1 /end COMPU_METHOD
/begin COMPU_METHOD OIL_VAR_SY_Compu "" TAB_VERB "%6.3" "" COMPU_TAB_REF OIL_VAR_SY_Compu /end COMPU_METHOD
/begin COMPU_VTAB OIL_VAR_SY_Compu "" TAB_VERB 45 1 "DAI" 3 "VWW" 4 "POR" 5 "AUD" 6 "OPE" 9 "FIA" 11 "BMW" 14 "PSA" 15 "REN" 17 "ALF" 18 "SAB" 19 "VOL" 20 "NIS" 21 "GMU" 22 "FOR" 26 "IMJ" 51 "SEA" 53 "CHR" 54 "JAG" 55 "ROL" 69 "FER" 72 "TOY" 123 "MIT" 147 "HYU" 159 "HON" 160 "MAZ" 183 "CU" 190 "LRG" 204 "VVW" 214 "AVT" 242 "Iveco" 243 "DMC" 248 "SUZ" 267 "SSANGYONG" 270 "KEF" 289 "AMG" 308 "TAT" 319 "MVM" 385 "UAES" 590 "Scania" 828 "RBCD" 999 "ALL" 2887 "Nonox" 9454 "Fuso" 9947 "SONSTIGE" /end COMPU_VTAB
/begin COMPU_METHOD OneToOne "" RAT_FUNC "%6.2" "-" COEFFS 0 1 0 0 0 1 /end COMPU_METHOD
/begin COMPU_METHOD OneToTenCarb "" RAT_FUNC "%6.1" "-" COEFFS 0 0.1 0 0 0 1 /end COMPU_METHOD
/begin COMPU_METHOD OPENETCFCO_SC_Compu "" TAB_VERB "%6.3" "" COMPU_TAB_REF OPENETCFCO_SC_Compu /end COMPU_METHOD
/begin COMPU_VTAB OPENETCFCO_SC_Compu "" TAB_VERB 2 0 "False" 1 "True" /end COMPU_VTAB
/begin COMPU_METHOD OTA_SC_Compu "" TAB_VERB "%6.3" "" COMPU_TAB_REF OTA_SC_Compu /end COMPU_METHOD
/begin COMPU_VTAB OTA_SC_Compu "" TAB_VERB 2 0 "False" 1 "True" /end COMPU_VTAB
/begin COMPU_METHOD OVERSPDCNTRLVL_SC_Compu "" RAT_FUNC "%6.2" "" COEFFS 0 1 0 0 0 1 /end COMPU_METHOD
/begin COMPU_METHOD OVERSPDCNTR_SC_Compu "" RAT_FUNC "%6.2" "" COEFFS 0 1 0 0 0 1 /end COMPU_METHOD
/begin COMPU_METHOD OVERSPDDIAG_SC_Compu "" RAT_FUNC "%6.2" "" COEFFS 0 1 0 0 0 1 /end COMPU_METHOD
/begin COMPU_METHOD OVERSPDTHRCLS_SC_Compu "" RAT_FUNC "%6.2" "" COEFFS 0 1 0 0 0 1 /end COMPU_METHOD
/begin COMPU_METHOD OVRRUNINHB_PT_SY_Compu "" TAB_VERB "%6.3" "" COMPU_TAB_REF OVRRUNINHB_PT_SY_Compu /end COMPU_METHOD
/begin COMPU_VTAB OVRRUNINHB_PT_SY_Compu "" TAB_VERB 2 0 "False" 1 "True" /end COMPU_VTAB
/begin COMPU_METHOD OXSENSDYNADAP_SY_Compu "" TAB_VERB "%6.3" "" COMPU_TAB_REF OXSENSDYNADAP_SY_Compu /end COMPU_METHOD
/begin COMPU_VTAB OXSENSDYNADAP_SY_Compu "" TAB_VERB 2 0 "False" 1 "True" /end COMPU_VTAB
/begin COMPU_METHOD PAIRFLTDSPRS_SY_Compu "" TAB_VERB "%6.3" "" COMPU_TAB_REF PAIRFLTDSPRS_SY_Compu /end COMPU_METHOD
/begin COMPU_VTAB PAIRFLTDSPRS_SY_Compu "" TAB_VERB 2 0 "False" 1 "True" /end COMPU_VTAB
/begin COMPU_METHOD PAIRFLTDS_SNSR2PRSNT_SC_Compu "" TAB_VERB "%6.3" "" COMPU_TAB_REF PAIRFLTDS_SNSR2PRSNT_SC_Compu /end COMPU_METHOD
/begin COMPU_VTAB PAIRFLTDS_SNSR2PRSNT_SC_Compu "" TAB_VERB 2 0 "False" 1 "True" /end COMPU_VTAB
/begin COMPU_METHOD PAIRFLTDS_TYPAVL_SY_Compu "" TAB_VERB "%6.3" "" COMPU_TAB_REF PAIRFLTDS_TYPAVL_SY_Compu /end COMPU_METHOD
/begin COMPU_VTAB PAIRFLTDS_TYPAVL_SY_Compu "" TAB_VERB 2 0 "False" 1 "True" /end COMPU_VTAB
/begin COMPU_METHOD PASSDOORRDNT_TYPAVL_SC_Compu "" TAB_VERB "%6.3" "" COMPU_TAB_REF PASSDOORRDNT_TYPAVL_SC_Compu /end COMPU_METHOD
/begin COMPU_VTAB PASSDOORRDNT_TYPAVL_SC_Compu "" TAB_VERB 2 0 "False" 1 "True" /end COMPU_VTAB
/begin COMPU_METHOD PBALTUBEINTKMNFLD_SC_Compu "" TAB_VERB "%6.3" "" COMPU_TAB_REF PBALTUBEINTKMNFLD_SC_Compu /end COMPU_METHOD
/begin COMPU_VTAB PBALTUBEINTKMNFLD_SC_Compu "" TAB_VERB 2 0 "False" 1 "True" /end COMPU_VTAB
/begin COMPU_METHOD PCMPR2US_SNSR1PRSNT_SC_Compu "" TAB_VERB "%6.3" "" COMPU_TAB_REF PCMPR2US_SNSR1PRSNT_SC_Compu /end COMPU_METHOD
/begin COMPU_VTAB PCMPR2US_SNSR1PRSNT_SC_Compu "" TAB_VERB 2 0 "False" 1 "True" /end COMPU_VTAB
/begin COMPU_METHOD PCRCSPRS_SC_Compu "" TAB_VERB "%6.3" "" COMPU_TAB_REF PCRCSPRS_SC_Compu /end COMPU_METHOD
/begin COMPU_VTAB PCRCSPRS_SC_Compu "" TAB_VERB 2 0 "False" 1 "True" /end COMPU_VTAB
/begin COMPU_METHOD PCSI_SY_Compu "" TAB_VERB "%6.3" "" COMPU_TAB_REF PCSI_SY_Compu /end COMPU_METHOD
/begin COMPU_VTAB PCSI_SY_Compu "" TAB_VERB 2 0 "no PCSI" 1 "PCSI used" /end COMPU_VTAB
/begin COMPU_METHOD PEGRLPDIFF_TYPAVL_SY_Compu "" TAB_VERB "%6.3" "" COMPU_TAB_REF PEGRLPDIFF_TYPAVL_SY_Compu /end COMPU_METHOD
/begin COMPU_VTAB PEGRLPDIFF_TYPAVL_SY_Compu "" TAB_VERB 2 0 "False" 1 "True" /end COMPU_VTAB
/begin COMPU_METHOD PEGRPIPUSSENS_SC_Compu "" TAB_VERB "%6.3" "" COMPU_TAB_REF PEGRPIPUSSENS_SC_Compu /end COMPU_METHOD
/begin COMPU_VTAB PEGRPIPUSSENS_SC_Compu "" TAB_VERB 3 0 "0" 1 "1" 2 "2" /end COMPU_VTAB
/begin COMPU_METHOD PEGRVLVDSEXT_SC_Compu "" TAB_VERB "%6.3" "" COMPU_TAB_REF PEGRVLVDSEXT_SC_Compu /end COMPU_METHOD
/begin COMPU_VTAB PEGRVLVDSEXT_SC_Compu "" TAB_VERB 2 0 "False" 1 "True" /end COMPU_VTAB
/begin COMPU_METHOD PEGRVLVUSSENS_SC_Compu "" TAB_VERB "%6.3" "" COMPU_TAB_REF PEGRVLVUSSENS_SC_Compu /end COMPU_METHOD
/begin COMPU_VTAB PEGRVLVUSSENS_SC_Compu "" TAB_VERB 3 0 "0" 1 "1" 2 "2" /end COMPU_VTAB
/begin COMPU_METHOD PENVPRSNT_SC_Compu "" TAB_VERB "%6.3" "" COMPU_TAB_REF PENVPRSNT_SC_Compu /end COMPU_METHOD
/begin COMPU_VTAB PENVPRSNT_SC_Compu "" TAB_VERB 2 0 "False" 1 "True" /end COMPU_VTAB
/begin COMPU_METHOD PENVREJHIVALERR_SC_Compu "" TAB_VERB "%6.3" "" COMPU_TAB_REF PENVREJHIVALERR_SC_Compu /end COMPU_METHOD
/begin COMPU_VTAB PENVREJHIVALERR_SC_Compu "" TAB_VERB 2 0 "Disable" 1 "Enable" /end COMPU_VTAB
/begin COMPU_METHOD PENVSNSRTYP_SC_Compu "" TAB_VERB "%6.3" "" COMPU_TAB_REF PENVSNSRTYP_SC_Compu /end COMPU_METHOD
/begin COMPU_VTAB PENVSNSRTYP_SC_Compu "" TAB_VERB 3 0 "ANA" 1 "SPI" 2 "CAN" /end COMPU_VTAB
/begin COMPU_METHOD PERMSPLYSYS_SY_Compu "" TAB_VERB "%6.3" "" COMPU_TAB_REF PERMSPLYSYS_SY_Compu /end COMPU_METHOD
/begin COMPU_VTAB PERMSPLYSYS_SY_Compu "" TAB_VERB 2 0 "non-permanently supplied system" 1 "permanently supplied system" /end COMPU_VTAB
/begin COMPU_METHOD PEXHMNFLD_TYPAVL_SC_Compu "" TAB_VERB "%6.3" "" COMPU_TAB_REF PEXHMNFLD_TYPAVL_SC_Compu /end COMPU_METHOD
/begin COMPU_VTAB PEXHMNFLD_TYPAVL_SC_Compu "" TAB_VERB 2 0 "False" 1 "True" /end COMPU_VTAB
/begin COMPU_METHOD Prc "" RAT_FUNC "%6.4" "%" COEFFS 0 81.92 0 0 0 1 /end COMPU_METHOD
/begin COMPU_METHOD Prc_Fact100 "" RAT_FUNC "%6.4" "%" COEFFS 0 100 0 0 0 1 /end COMPU_METHOD
/begin COMPU_METHOD Prc_Fact256 "" RAT_FUNC "%6.4" "%" COEFFS 0 256 0 0 0 1 /end COMPU_METHOD
/begin COMPU_METHOD Pres "" RAT_FUNC "%6.3" "kPa" COEFFS 0 10 0 0 0 1 /end COMPU_METHOD
/begin COMPU_METHOD PresAC_hPa "" RAT_FUNC "%6.2" "hPa" COEFFS 0 0.5 0 0 0 1 /end COMPU_METHOD
/begin COMPU_METHOD PreshPa_10ms "" RAT_FUNC "%6.0" "hPa/s" COEFFS 0 0.01 0 0 0 1 /end COMPU_METHOD
/begin COMPU_METHOD Pres_hPa "" RAT_FUNC "%6.2" "hPa" COEFFS 0 1 0 0 0 1 /end COMPU_METHOD
/begin COMPU_METHOD Pres_kPa "" RAT_FUNC "%6.3" "kPa" COEFFS 0 10 0 0 0 2 /end COMPU_METHOD
/begin COMPU_METHOD p_ub_q10 "" RAT_FUNC "%6.1" "hPa" COEFFS 0 1 0 0 0 10 /end COMPU_METHOD
/begin COMPU_METHOD p_uw_q0p039_mmHg "" RAT_FUNC "%6.4" "mmHg" COEFFS 0 256 0 0 0 7.500637 /end COMPU_METHOD
/begin COMPU_METHOD q1p412_L_DIV_min "" RAT_FUNC "%6.2" "l/min" COEFFS 0 1728 0 0 0 2440 /end COMPU_METHOD
/begin COMPU_METHOD RBPtCel_fac_0p125_1 "" RAT_FUNC "%6.3" "-" COEFFS 0 8 0 0 0 1 /end COMPU_METHOD
/begin COMPU_METHOD RBPtCel_t_1p0_om40_1 "" RAT_FUNC "%6.2" "Deg C" COEFFS 0 1 40 0 0 1 /end COMPU_METHOD
/begin COMPU_METHOD relDK_q0p02441 "" RAT_FUNC "%6.4" "%DK" COEFFS 0 65536 0 0 0 1600 /end COMPU_METHOD
/begin COMPU_METHOD relDK_uw_b100 "" RAT_FUNC "%6.4" "%DK" COEFFS 0 65535 0 0 0 100 /end COMPU_METHOD
/begin COMPU_METHOD relPED_q0p00153 "" RAT_FUNC "%6.4" "% PED" COEFFS 0 65535 0 0 0 100 /end COMPU_METHOD
/begin COMPU_METHOD rel_q0p39 "" RAT_FUNC "%6.3" "%" COEFFS 0 256 0 0 0 100 /end COMPU_METHOD
/begin COMPU_METHOD rel_sw_b100 "" RAT_FUNC "%6.4" "%" COEFFS 0 32768 0 0 0 100 /end COMPU_METHOD
/begin COMPU_METHOD rel_uw_b100 "" RAT_FUNC "%6.4" "%" COEFFS 0 65536 0 0 0 100 /end COMPU_METHOD
/begin COMPU_METHOD RmpEngN "" RAT_FUNC "%6.4" "rpm/s" COEFFS 0 131.072 0 0 0 1 /end COMPU_METHOD
/begin COMPU_METHOD Signals_IntSigNumVerb "" TAB_VERB "%6.3" "" COMPU_TAB_REF Signals_IntSigNumVerb /end COMPU_METHOD
/begin COMPU_VTAB Signals_IntSigNumVerb "" TAB_VERB 783 0 "SIGNALS_Signals_Default" 1 "SIGNALS_APP_rUnFlt" 2 "SIGNALS_APP_r_sig" 3 "SIGNALS_APP_r_signal" 4 "SIGNALS_APP_uRaw1_signal" 5 "SIGNALS_APP_uRaw2_signal" 6 "SIGNALS_AbsLdCom8Bit_PID43h" 7 "SIGNALS_AccPed_tqMapBasd_BENG_signal" 8 "SIGNALS_AccPed_tqMapBasd_TRQB_signal" 9 "SIGNALS_ActMod_trqInr_signal" 10 "SIGNALS_AirC_uAnaRawClnt_signal" 11 "SIGNALS_Alt_iExctLim_signal" 12 "SIGNALS_Alt_rAltExct_signal" 13 "SIGNALS_Alt_uFinalDes_signal" 14 "SIGNALS_BattU_u" 15 "SIGNALS_BattU_uSens1_signal" 16 "SIGNALS_BattU_uSens2_s" 17 "SIGNALS_BattU_uSens_signal" 18 "SIGNALS_Batt_lMaxCnsChk_signal" 19 "SIGNALS_Batt_lMinCnsChk_signal" 20 "SIGNALS_Batt_qCnsChkAH_signal" 21 "SIGNALS_Brk_st" 22 "SIGNALS_Brk_stRed" 23 "SIGNALS_CEngDsT_uRaw_s" 24 "SIGNALS_CoEng_tiCranking_signal" 25 "SIGNALS_CoEng_tiScneEngStrtPrmIdH1F_signal" 26 "SIGNALS_CoVeh_trqAcs_s" 27 "SIGNALS_ComEBS_BattID_signal" 28 "SIGNALS_ComEBS_rBattSensCh_signal" 29 "SIGNALS_ComEBS_uBattSens_signal" 30 "SIGNALS_ComEBS_uBattUCO_signal" 31 "SIGNALS_Com_iBattEBS_signal" 32 "SIGNALS_Com_lDst_signal" 33 "SIGNALS_Com_rMeasdBattREbs_signal" 34 "SIGNALS_Com_tBattEBS_signal" 35 "SIGNALS_Com_trqAYCFDes_signal" 36 "SIGNALS_Com_uPeak_signal" 37 "SIGNALS_CrCtl_stShutOffCode0_signal" 38 "SIGNALS_CrCtl_stShutOffCode1_signal" 39 "SIGNALS_CrCtl_stShutOffCode2_signal" 40 "SIGNALS_CrCtl_stShutOffCode3_signal" 41 "SIGNALS_CrCtl_stShutOffCode4_signal" 42 "SIGNALS_CrCtl_stShutOffCode5_signal" 43 "SIGNALS_CrCtl_stShutOffCode6_signal" 44 "SIGNALS_CrCtl_stShutOffCode7_signal" 45 "SIGNALS_CrCtl_stShutOffCode8_signal" 46 "SIGNALS_CrCtl_stShutOffCode9_signal" 47 "SIGNALS_DIUMPR_ctGenDenom_signal" 48 "SIGNALS_DIUMPR_ctIgn_signal" 49 "SIGNALS_DRIVE_numDTCFrz_s" 50 "SIGNALS_DRIVE_stCurTrgMode_signal" 51 "SIGNALS_DRIVE_stHardToStrt_s" 52 "SIGNALS_DSMDur_ctPID21h_signal" 53 "SIGNALS_DSMDur_ctPID31h_signal" 54 "SIGNALS_DcmDspUDS_rdbi_2612Byte10_signal" 55 "SIGNALS_DcmDspUDS_rdbi_2612Byte11_signal" 56 "SIGNALS_DcmDspUDS_rdbi_fixed_signal" 57 "SIGNALS_DcmDspUDS_rdbi_reserved0_signal_s" 58 "SIGNALS_DcmDspUDS_rdbi_reserved0_signal_w_s" 59 "SIGNALS_DcmDspUDS_rdbi_reserved1_signal" 60 "SIGNALS_Dspl_stCrsSwtInfo_signal" 61 "SIGNALS_Ebs_qBliChrg_signal" 62 "SIGNALS_Ebs_qBliDchaTotDcyc_0_signal" 63 "SIGNALS_Ebs_qBliDchaTotDcyc_1_signal" 64 "SIGNALS_Ebs_qBliDchaTotDcyc_2_signal" 65 "SIGNALS_Ebs_qBliDchaTotDcyc_3_signal" 66 "SIGNALS_Ebs_qBliDchaTotDcyc_4_signal" 67 "SIGNALS_Ebs_qBliDcha_signal" 68 "SIGNALS_Ebs_stStbIEBSByt0_0_signal" 69 "SIGNALS_Ebs_stStbIEBSByt0_1_signal" 70 "SIGNALS_Ebs_stStbIEBSByt0_2_signal" 71 "SIGNALS_Ebs_stStbIEBSByt0_3_signal" 72 "SIGNALS_Ebs_stStbIEBSByt0_4_signal" 73 "SIGNALS_Ebs_stStbIEBSByt1_0_signal" 74 "SIGNALS_Ebs_stStbIEBSByt1_1_signal" 75 "SIGNALS_Ebs_stStbIEBSByt1_2_signal" 76 "SIGNALS_Ebs_stStbIEBSByt1_3_signal" 77 "SIGNALS_Ebs_stStbIEBSByt1_4_signal" 78 "SIGNALS_Ebs_stStbIEBSByt2_0_signal" 79 "SIGNALS_Ebs_stStbIEBSByt2_1_signal" 80 "SIGNALS_Ebs_stStbIEBSByt2_2_signal" 81 "SIGNALS_Ebs_stStbIEBSByt2_3_signal" 82 "SIGNALS_Ebs_stStbIEBSByt2_4_signal" 83 "SIGNALS_Ebs_stStbIEBSByt3_0_signal" 84 "SIGNALS_Ebs_stStbIEBSByt3_1_signal" 85 "SIGNALS_Ebs_stStbIEBSByt3_2_signal" 86 "SIGNALS_Ebs_stStbIEBSByt3_3_signal" 87 "SIGNALS_Ebs_stStbIEBSByt3_4_signal" 88 "SIGNALS_Ebs_stStbIEBSByt4_0_signal" 89 "SIGNALS_Ebs_stStbIEBSByt4_1_signal" 90 "SIGNALS_Ebs_stStbIEBSByt4_2_signal" 91 "SIGNALS_Ebs_stStbIEBSByt4_3_signal" 92 "SIGNALS_Ebs_stStbIEBSByt4_4_signal" 93 "SIGNALS_EngTrqPtd_trqLead_s" 94 "SIGNALS_EngTrqPtd_trqLead_signal" 95 "SIGNALS_EngTrqPtd_trqSet_s" 96 "SIGNALS_EngTrqPtd_trqSet_signal" 97 "SIGNALS_EpmCaS_ctErrSig_signal" 98 "SIGNALS_EpmCaS_ctNoSig_signal" 99 "SIGNALS_EpmCaS_phiDiffCal2AdapEqAvg_0" 100 "SIGNALS_EpmCaS_phiOfsCorr" 101 "SIGNALS_EpmCrS_ctCaSRev_mp_signal" 102 "SIGNALS_EpmCrS_ctErrSig_signal" 103 "SIGNALS_Epm_nEngAct" 104 "SIGNALS_Epm_nEngRaw_s" 105 "SIGNALS_Epm_nEngRaw_signal" 106 "SIGNALS_Epm_stOpMode" 107 "SIGNALS_Epm_stSync" 108 "SIGNALS_ExhMod_tCat1B1_signal" 109 "SIGNALS_GlbDa_lenTotDstDcycHiResl_signal" 110 "SIGNALS_HEGO_uS2B1Extd_s" 111 "SIGNALS_HEGO_uS2B1HiRes_signal" 112 "SIGNALS_I14229CoEng_tiNormalOBDPrevDcyc_s" 113 "SIGNALS_I14229GlbDa_lTotDstDCHiReslPrevDcyc_s" 114 "SIGNALS_I14229IntkAirT_tSnsrTstrMax_s" 115 "SIGNALS_I14229IntkAirT_tSnsrTstrMin_s" 116 "SIGNALS_I14229RDBI_nOvrSpd_signal" 117 "SIGNALS_I14229RDBI_tiOvrSpd_signal" 118 "SIGNALS_I14229_ElecLd_iEPSLoadOnly_signal" 119 "SIGNALS_I14229_EpmCrS_ctErrSig_signal" 120 "SIGNALS_I14229_ivzabg_w_signal" 121 "SIGNALS_I14229_lDst_signal" 122 "SIGNALS_I14229_ml_w_msg_signal" 123 "SIGNALS_I14229_nstat_signal" 124 "SIGNALS_I14229_numDTCFrzFrmHi_signal" 125 "SIGNALS_I14229_numDTCFrzFrmLo_signal" 126 "SIGNALS_I14229_numDTCFrzFrmMid_signal" 127 "SIGNALS_I14229_ps_w_signal" 128 "SIGNALS_I14229_rTrqPT_signal" 129 "SIGNALS_I14229_tSnsrFild1_signal" 130 "SIGNALS_I14229_tiInj1On_signal" 131 "SIGNALS_I14229_tiOilFlowCompl_signal" 132 "SIGNALS_I14229_tiSia_signal" 133 "SIGNALS_I14229_tkaMax_s" 134 "SIGNALS_I14229_tkaMin_s" 135 "SIGNALS_I14229_tka_signal" 136 "SIGNALS_I14229_tmotMaxCurrDcyc_s" 137 "SIGNALS_I14229_tmotMaxPrevDcyc_s" 138 "SIGNALS_I14229_tmotMinCurrDcyc_s" 139 "SIGNALS_I14229_tmotMinPrevDcyc_s" 140 "SIGNALS_I14229_ubsq_signal" 141 "SIGNALS_I14229_umsrln_w_signal" 142 "SIGNALS_I14229_wdks_w_signal" 143 "SIGNALS_I14229_wped1_signal" 144 "SIGNALS_I14229_wped2_signal" 145 "SIGNALS_I14229_zwist_signal" 146 "SIGNALS_I14229iocpMDA_numACGC_signal" 147 "SIGNALS_I14229iocpMDA_numAPS_signal" 148 "SIGNALS_I14229iocpMDA_numPSC_signal" 149 "SIGNALS_I14229iocpMDA_numRFAN_signal" 150 "SIGNALS_I14229iocpMDA_numVTEC_signal" 151 "SIGNALS_I14229iocp_numCtlSt_s" 152 "SIGNALS_I14229iocp_numEXE_signal" 153 "SIGNALS_I14229iocp_numREQ_s" 154 "SIGNALS_I14229iocp_stSFTRJC_s" 155 "SIGNALS_I15031_PID1Dh" 156 "SIGNALS_I15031_PID65Ah" 157 "SIGNALS_I15031_PID66Ah" 158 "SIGNALS_I15031_PID68Ah" 159 "SIGNALS_I15031_PID69Ah" 160 "SIGNALS_I15031_PID6AAh" 161 "SIGNALS_I15031_PID6BAh" 162 "SIGNALS_I15031_PID6CAh" 163 "SIGNALS_I15031_PID6DAh" 164 "SIGNALS_I15031_PID6EAh" 165 "SIGNALS_I15031_PID6FAh" 166 "SIGNALS_I15031_PID70Ah" 167 "SIGNALS_I15031_PID71Ah" 168 "SIGNALS_I15031_PID72Ah" 169 "SIGNALS_I15031_PID73Ah" 170 "SIGNALS_I15031_PID74Ah" 171 "SIGNALS_I15031_PID75Ah" 172 "SIGNALS_I15031_PID76Ah" 173 "SIGNALS_I15031_PID77Ah" 174 "SIGNALS_I15031_PID78Ah" 175 "SIGNALS_I15031_PID79Ah" 176 "SIGNALS_I15031_PID7AAh" 177 "SIGNALS_I15031_PID7BAh" 178 "SIGNALS_I15031_PID7CAh" 179 "SIGNALS_I15031_PID7FAh" 180 "SIGNALS_I15031_PID81Ah" 181 "SIGNALS_I15031_PID82Ah" 182 "SIGNALS_I15031_PID85Ah" 183 "SIGNALS_I15031_PID86Ah" 184 "SIGNALS_I15031_PID87Ah" 185 "SIGNALS_I15031_PID89Ah" 186 "SIGNALS_I15031_PID8AAh" 187 "SIGNALS_I15031_PID8FAh" 188 "SIGNALS_I15031_PID92Ah" 189 "SIGNALS_I15031_PID93Ah" 190 "SIGNALS_I15031_PID94Ah" 191 "SIGNALS_I15031_PID98Ah" 192 "SIGNALS_I15031_PID99Ah" 193 "SIGNALS_I15031_PID9CAh" 194 "SIGNALS_I15031_PIDA3Ah" 195 "SIGNALS_I15031_PIDA4Ah" 196 "SIGNALS_I15031_PIDA5Ah" 197 "SIGNALS_I15031_PIDA9Ah" 198 "SIGNALS_I15031_PIDACAh" 199 "SIGNALS_IKCtl_agAdpnCurr_s16_signal" 200 "SIGNALS_IKCtl_agKnkAvrg_s8_signal" 201 "SIGNALS_InjSys_volFuConsDrvCycCAN_s" 202 "SIGNALS_IntkAirT_uSnsr1Exprt_signal" 203 "SIGNALS_IntkAirT_uSnsr3CrssSwtLoc_s" 204 "SIGNALS_MoF_rTrqInrAct_s" 205 "SIGNALS_MoF_rTrqPtdFlt_s" 206 "SIGNALS_OilLfT_degOilDetern_signal" 207 "SIGNALS_OilSwmpT_uSnsrRaw_s" 208 "SIGNALS_PID01h" 209 "SIGNALS_PID03h_0" 210 "SIGNALS_PID03h_1" 211 "SIGNALS_PID04h" 212 "SIGNALS_PID05h" 213 "SIGNALS_PID06h_0" 214 "SIGNALS_PID07h_0" 215 "SIGNALS_PID0Ch_Epm_nEng" 216 "SIGNALS_PID0D_VehV_vSens" 217 "SIGNALS_PID0Eh" 218 "SIGNALS_PID0Fh" 219 "SIGNALS_PID0Fh_s" 220 "SIGNALS_PID0bh" 221 "SIGNALS_PID0bh_PIntkVUs_pRawObd" 222 "SIGNALS_PID11h_ThrVlv_ratActSens1AbsltB1_u8" 223 "SIGNALS_PID13h" 224 "SIGNALS_PID15h_0" 225 "SIGNALS_PID15h_1" 226 "SIGNALS_PID1Ch" 227 "SIGNALS_PID1Fh_TiScneEngStrt" 228 "SIGNALS_PID21h" 229 "SIGNALS_PID2Eh" 230 "SIGNALS_PID30h" 231 "SIGNALS_PID31h" 232 "SIGNALS_PID33h_PEnv_pRaw" 233 "SIGNALS_PID34h_0" 234 "SIGNALS_PID34h_1" 235 "SIGNALS_PID3Ch" 236 "SIGNALS_PID42_BattU_uSens" 237 "SIGNALS_PID43h" 238 "SIGNALS_PID44h" 239 "SIGNALS_PID45h_ThrVlv_ratActSens1RelB1_u8" 240 "SIGNALS_PID46h" 241 "SIGNALS_PID47h_ThrVlv_ratActSens2AbsltB1_u8" 242 "SIGNALS_PID49_APP_uRaw1unLim" 243 "SIGNALS_PID4A_APP_uRaw2unLim" 244 "SIGNALS_PID4Ch_wdks_msg" 245 "SIGNALS_PID4FAh" 246 "SIGNALS_PID4FBh" 247 "SIGNALS_PID4FCh" 248 "SIGNALS_PID4FDh" 249 "SIGNALS_PID50Ah" 250 "SIGNALS_PID50Bh" 251 "SIGNALS_PID50Ch" 252 "SIGNALS_PID50Dh" 253 "SIGNALS_PID51h_PID51_stFuTyp" 254 "SIGNALS_PID56h_0" 255 "SIGNALS_PID5A_APP_rOBDPID5A" 256 "SIGNALS_PID5Fh" 257 "SIGNALS_PID62h_TME_ratActEngPercTqPrmIdH62" 258 "SIGNALS_IntFloat_PID63h_TqEngRef" 259 "SIGNALS_PID67h_ects2sva_msg" 260 "SIGNALS_PID67h_ects2svb_msg" 261 "SIGNALS_PID67h_ects2svc_msg" 262 "SIGNALS_PID68h_iats2svb" 263 "SIGNALS_PID68h_iats2svc" 264 "SIGNALS_PID68h_iats2svd" 265 "SIGNALS_PID68h_iats2sve" 266 "SIGNALS_PID68h_iats2svf" 267 "SIGNALS_PID68h_iats2svg" 268 "SIGNALS_PID7Fh_RTId_TotRt" 269 "SIGNALS_PID7Fh_RtId_TotIdleRt" 270 "SIGNALS_PID7Fh_RtId_TotPtoRt" 271 "SIGNALS_PID87h_PIntkVUs_pRawObd" 272 "SIGNALS_PID8BAh" 273 "SIGNALS_PID8CAh" 274 "SIGNALS_PID8Eh_TME_ratEngFricPercTqPrmIdH8E" 275 "SIGNALS_PID9AAh" 276 "SIGNALS_PID9Dh_InjSys_mfEngFuRate" 277 "SIGNALS_PID9Dh_InjSys_mfVehFuRate" 278 "SIGNALS_PID9FAh" 279 "SIGNALS_PIDA6h_lTotDst" 280 "SIGNALS_PID_FILLSIG_1BIT" 281 "SIGNALS_PID_FILLSIG_1BITNZ" 282 "SIGNALS_PID_FILLSIG_1BYTE" 283 "SIGNALS_PID_FILLSIG_1BYTENZ" 284 "SIGNALS_PID_FILLSIG_2BIT" 285 "SIGNALS_PID_FILLSIG_2BITNZ" 286 "SIGNALS_PID_FILLSIG_2BYTE" 287 "SIGNALS_PID_FILLSIG_2BYTENZ" 288 "SIGNALS_PID_FILLSIG_3BIT" 289 "SIGNALS_PID_FILLSIG_3BITNZ" 290 "SIGNALS_PID_FILLSIG_4BIT" 291 "SIGNALS_PID_FILLSIG_4BITNZ" 292 "SIGNALS_PID_FILLSIG_4BYTE" 293 "SIGNALS_PID_FILLSIG_4BYTENZ" 294 "SIGNALS_PID_FILLSIG_5BIT" 295 "SIGNALS_PID_FILLSIG_5BITNZ" 296 "SIGNALS_PID_FILLSIG_6BIT" 297 "SIGNALS_PID_FILLSIG_6BITNZ" 298 "SIGNALS_PID_FILLSIG_7BIT" 299 "SIGNALS_PID_FILLSIG_7BITNZ" 300 "SIGNALS_PIntkVUs_uRawUnFlt_signal" 301 "SIGNALS_PT_rGrip_signal" 302 "SIGNALS_PT_trqLos_signal" 303 "SIGNALS_PtCoornDyn_tqCluDes_signal" 304 "SIGNALS_PtCoornDyn_tqCluLeadTrsmIntv_signal" 305 "SIGNALS_PthLead_trqInrNoMon_s" 306 "SIGNALS_PthLead_trqInrNoMon_signal" 307 "SIGNALS_PthSet_trqInrIABef_s" 308 "SIGNALS_PthSet_trqInrLtd_s" 309 "SIGNALS_RngMod_trqDiffAdap_signal" 310 "SIGNALS_RngMod_trqInrBs_s" 311 "SIGNALS_TWCD_numMeasB1_s" 312 "SIGNALS_TWCD_rOSCAvrgPriB1_s" 313 "SIGNALS_ThrVlv_uRawSens1B1_signal" 314 "SIGNALS_ThrVlv_uRawSens2B1_signal" 315 "SIGNALS_TiEngOff_ti_signal" 316 "SIGNALS_UEGO_ratLamSrv1S1B1_signal" 317 "SIGNALS_VehStc_numFuDiagRecA_0_s" 318 "SIGNALS_VehStc_numFuDiagRecA_10_s" 319 "SIGNALS_VehStc_numFuDiagRecA_11_s" 320 "SIGNALS_VehStc_numFuDiagRecA_12_s" 321 "SIGNALS_VehStc_numFuDiagRecA_13_s" 322 "SIGNALS_VehStc_numFuDiagRecA_14_s" 323 "SIGNALS_VehStc_numFuDiagRecA_15_s" 324 "SIGNALS_VehStc_numFuDiagRecA_16_s" 325 "SIGNALS_VehStc_numFuDiagRecA_17_s" 326 "SIGNALS_VehStc_numFuDiagRecA_18_s" 327 "SIGNALS_VehStc_numFuDiagRecA_19_s" 328 "SIGNALS_VehStc_numFuDiagRecA_1_s" 329 "SIGNALS_VehStc_numFuDiagRecA_20_s" 330 "SIGNALS_VehStc_numFuDiagRecA_2_s" 331 "SIGNALS_VehStc_numFuDiagRecA_3_s" 332 "SIGNALS_VehStc_numFuDiagRecA_4_s" 333 "SIGNALS_VehStc_numFuDiagRecA_5_s" 334 "SIGNALS_VehStc_numFuDiagRecA_6_s" 335 "SIGNALS_VehStc_numFuDiagRecA_7_s" 336 "SIGNALS_VehStc_numFuDiagRecA_8_s" 337 "SIGNALS_VehStc_numFuDiagRecA_9_s" 338 "SIGNALS_VehStc_numMisfDetnHiEctA_0_s" 339 "SIGNALS_VehStc_numMisfDetnHiEctA_10_s" 340 "SIGNALS_VehStc_numMisfDetnHiEctA_11_s" 341 "SIGNALS_VehStc_numMisfDetnHiEctA_12_s" 342 "SIGNALS_VehStc_numMisfDetnHiEctA_13_s" 343 "SIGNALS_VehStc_numMisfDetnHiEctA_14_s" 344 "SIGNALS_VehStc_numMisfDetnHiEctA_15_s" 345 "SIGNALS_VehStc_numMisfDetnHiEctA_16_s" 346 "SIGNALS_VehStc_numMisfDetnHiEctA_17_s" 347 "SIGNALS_VehStc_numMisfDetnHiEctA_18_s" 348 "SIGNALS_VehStc_numMisfDetnHiEctA_19_s" 349 "SIGNALS_VehStc_numMisfDetnHiEctA_1_s" 350 "SIGNALS_VehStc_numMisfDetnHiEctA_20_s" 351 "SIGNALS_VehStc_numMisfDetnHiEctA_2_s" 352 "SIGNALS_VehStc_numMisfDetnHiEctA_3_s" 353 "SIGNALS_VehStc_numMisfDetnHiEctA_4_s" 354 "SIGNALS_VehStc_numMisfDetnHiEctA_5_s" 355 "SIGNALS_VehStc_numMisfDetnHiEctA_6_s" 356 "SIGNALS_VehStc_numMisfDetnHiEctA_7_s" 357 "SIGNALS_VehStc_numMisfDetnHiEctA_8_s" 358 "SIGNALS_VehStc_numMisfDetnHiEctA_9_s" 359 "SIGNALS_VehStc_numMisfDetnLoEctA_0_s" 360 "SIGNALS_VehStc_numMisfDetnLoEctA_10_s" 361 "SIGNALS_VehStc_numMisfDetnLoEctA_11_s" 362 "SIGNALS_VehStc_numMisfDetnLoEctA_12_s" 363 "SIGNALS_VehStc_numMisfDetnLoEctA_13_s" 364 "SIGNALS_VehStc_numMisfDetnLoEctA_14_s" 365 "SIGNALS_VehStc_numMisfDetnLoEctA_15_s" 366 "SIGNALS_VehStc_numMisfDetnLoEctA_16_s" 367 "SIGNALS_VehStc_numMisfDetnLoEctA_17_s" 368 "SIGNALS_VehStc_numMisfDetnLoEctA_18_s" 369 "SIGNALS_VehStc_numMisfDetnLoEctA_19_s" 370 "SIGNALS_VehStc_numMisfDetnLoEctA_1_s" 371 "SIGNALS_VehStc_numMisfDetnLoEctA_20_s" 372 "SIGNALS_VehStc_numMisfDetnLoEctA_2_s" 373 "SIGNALS_VehStc_numMisfDetnLoEctA_3_s" 374 "SIGNALS_VehStc_numMisfDetnLoEctA_4_s" 375 "SIGNALS_VehStc_numMisfDetnLoEctA_5_s" 376 "SIGNALS_VehStc_numMisfDetnLoEctA_6_s" 377 "SIGNALS_VehStc_numMisfDetnLoEctA_7_s" 378 "SIGNALS_VehStc_numMisfDetnLoEctA_8_s" 379 "SIGNALS_VehStc_numMisfDetnLoEctA_9_s" 380 "SIGNALS_VehStc_numMisfDetnNormA_0_s" 381 "SIGNALS_VehStc_numMisfDetnNormA_10_s" 382 "SIGNALS_VehStc_numMisfDetnNormA_11_s" 383 "SIGNALS_VehStc_numMisfDetnNormA_12_s" 384 "SIGNALS_VehStc_numMisfDetnNormA_13_s" 385 "SIGNALS_VehStc_numMisfDetnNormA_14_s" 386 "SIGNALS_VehStc_numMisfDetnNormA_15_s" 387 "SIGNALS_VehStc_numMisfDetnNormA_16_s" 388 "SIGNALS_VehStc_numMisfDetnNormA_17_s" 389 "SIGNALS_VehStc_numMisfDetnNormA_18_s" 390 "SIGNALS_VehStc_numMisfDetnNormA_19_s" 391 "SIGNALS_VehStc_numMisfDetnNormA_1_s" 392 "SIGNALS_VehStc_numMisfDetnNormA_20_s" 393 "SIGNALS_VehStc_numMisfDetnNormA_2_s" 394 "SIGNALS_VehStc_numMisfDetnNormA_3_s" 395 "SIGNALS_VehStc_numMisfDetnNormA_4_s" 396 "SIGNALS_VehStc_numMisfDetnNormA_5_s" 397 "SIGNALS_VehStc_numMisfDetnNormA_6_s" 398 "SIGNALS_VehStc_numMisfDetnNormA_7_s" 399 "SIGNALS_VehStc_numMisfDetnNormA_8_s" 400 "SIGNALS_VehStc_numMisfDetnNormA_9_s" 401 "SIGNALS_VehStc_rDiagRsltB1A_0_s" 402 "SIGNALS_VehStc_rDiagRsltB1A_1_s" 403 "SIGNALS_VehStc_rDiagRsltB1A_2_s" 404 "SIGNALS_VehStc_rDiagRsltB1A_3_s" 405 "SIGNALS_VehStc_rDiagRsltB1A_4_s" 406 "SIGNALS_VehV_a" 407 "SIGNALS_VehV_v" 408 "SIGNALS_VehV_vSens_signal" 409 "SIGNALS_flglrs_msg_s" 410 "SIGNALS_fra_w_msg_signal" 411 "SIGNALS_fra_w_s" 412 "SIGNALS_ftead_w_msg_s" 413 "SIGNALS_ftead_w_si" 414 "SIGNALS_ftead_w_signal" 415 "SIGNALS_lamsobd_w_msg_s" 416 "SIGNALS_lutskzyl_w_0_signal" 417 "SIGNALS_lutskzyl_w_1_signal" 418 "SIGNALS_lutskzyl_w_2_signal" 419 "SIGNALS_lutskzyl_w_3_signal" 420 "SIGNALS_lutskzyl_w_msg_0_signal" 421 "SIGNALS_lutskzyl_w_msg_1_signal" 422 "SIGNALS_lutskzyl_w_msg_2_signal" 423 "SIGNALS_lutskzyl_w_msg_3_signal" 424 "SIGNALS_ofmsndkh1_w_msg_signal" 425 "SIGNALS_ofmsndkh2_w_msg_signal" 426 "SIGNALS_ora_w_msg_signal" 427 "SIGNALS_tateout_w_msg_signal" 428 "SIGNALS_tateout_w_signal" 429 "SIGNALS_tatesoll_w_msg_signal" 430 "SIGNALS_tmst_signal" 431 "SIGNALS_wkratst_signal" 432 "SIGNALS_PID83h_A_BitCombineSignal" 433 "SIGNALS_PID9Bh_A_BitCombineSignal" 434 "SIGNALS_PIDA1h_A_BitCombineSignal" 435 "SIGNALS_PIDA7h_A_BitCombineSignal" 436 "SIGNALS_PIDA8h_A_BitCombineSignal" 437 "SIGNALS_Virtual_CEngDsT_uRaw_signal" 438 "SIGNALS_Virtual_DcmDspUDS_2600Byte06_signal" 439 "SIGNALS_Virtual_DcmDspUDS_2610Byte00_signal" 440 "SIGNALS_Virtual_DcmDspUDS_2610Byte01_signal" 441 "SIGNALS_Virtual_DcmDspUDS_2610Byte02_signal" 442 "SIGNALS_Virtual_DcmDspUDS_2610Byte03_signal" 443 "SIGNALS_Virtual_DcmDspUDS_2610Byte04_signal" 444 "SIGNALS_Virtual_DcmDspUDS_2610Byte05_signal" 445 "SIGNALS_Virtual_DcmDspUDS_2610Byte10_signal" 446 "SIGNALS_Virtual_DcmDspUDS_2610Byte1F_signal" 447 "SIGNALS_Virtual_DcmDspUDS_2610Byte20_signal" 448 "SIGNALS_Virtual_DcmDspUDS_2610Byte25_signal" 449 "SIGNALS_Virtual_DcmDspUDS_2610Byte26_signal" 450 "SIGNALS_Virtual_DcmDspUDS_2611Byte00_signal" 451 "SIGNALS_Virtual_DcmDspUDS_2611Byte01_signal" 452 "SIGNALS_Virtual_DcmDspUDS_2611Byte02_signal" 453 "SIGNALS_Virtual_DcmDspUDS_2611Byte03_signal" 454 "SIGNALS_Virtual_DcmDspUDS_2611Byte04_signal" 455 "SIGNALS_Virtual_DcmDspUDS_2611Byte05_signal" 456 "SIGNALS_Virtual_DcmDspUDS_2611Byte06_07_signal" 457 "SIGNALS_Virtual_DcmDspUDS_2611Byte2A_signal" 458 "SIGNALS_Virtual_DcmDspUDS_2611Byte2B_signal" 459 "SIGNALS_Virtual_DcmDspUDS_2612Byte00_signal" 460 "SIGNALS_Virtual_DcmDspUDS_2612Byte01_signal" 461 "SIGNALS_Virtual_DcmDspUDS_2612Byte02_signal" 462 "SIGNALS_Virtual_DcmDspUDS_2612Byte03_signal" 463 "SIGNALS_Virtual_DcmDspUDS_2612Byte04_signal" 464 "SIGNALS_Virtual_DcmDspUDS_2612Byte05_signal" 465 "SIGNALS_Virtual_DcmDspUDS_2612Byte14_signal" 466 "SIGNALS_Virtual_DcmDspUDS_2612Byte15_signal" 467 "SIGNALS_Virtual_DcmDspUDS_2612Byte16_signal" 468 "SIGNALS_Virtual_DcmDspUDS_2612Byte17_signal" 469 "SIGNALS_Virtual_DcmDspUDS_2612Byte29_signal" 470 "SIGNALS_Virtual_DcmDspUDS_2612Byte2A_signal" 471 "SIGNALS_Virtual_DcmDspUDS_2612Byte2B_signal" 472 "SIGNALS_Virtual_DcmDspUDS_2613Byte00_signal" 473 "SIGNALS_Virtual_DcmDspUDS_2613Byte01_signal" 474 "SIGNALS_Virtual_DcmDspUDS_2613Byte02_signal" 475 "SIGNALS_Virtual_DcmDspUDS_2613Byte03_signal" 476 "SIGNALS_Virtual_DcmDspUDS_2613Byte04_signal" 477 "SIGNALS_Virtual_DcmDspUDS_2613Byte05_signal" 478 "SIGNALS_Virtual_DcmDspUDS_2620Byte00_signal" 479 "SIGNALS_Virtual_DcmDspUDS_2620Byte01_signal" 480 "SIGNALS_Virtual_DcmDspUDS_2620Byte02_signal" 481 "SIGNALS_Virtual_DcmDspUDS_2620Byte03_signal" 482 "SIGNALS_Virtual_DcmDspUDS_2620Byte04_signal" 483 "SIGNALS_Virtual_DcmDspUDS_2620Byte05_signal" 484 "SIGNALS_Virtual_DcmDspUDS_2621Byte00_signal" 485 "SIGNALS_Virtual_DcmDspUDS_2621Byte01_signal" 486 "SIGNALS_Virtual_DcmDspUDS_2621Byte02_signal" 487 "SIGNALS_Virtual_DcmDspUDS_2621Byte03_signal" 488 "SIGNALS_Virtual_DcmDspUDS_2621Byte04_signal" 489 "SIGNALS_Virtual_DcmDspUDS_2621Byte05_signal" 490 "SIGNALS_Virtual_DcmDspUDS_2622Byte00_signal" 491 "SIGNALS_Virtual_DcmDspUDS_2622Byte01_signal" 492 "SIGNALS_Virtual_DcmDspUDS_2622Byte02_signal" 493 "SIGNALS_Virtual_DcmDspUDS_2622Byte03_signal" 494 "SIGNALS_Virtual_DcmDspUDS_2622Byte04_signal" 495 "SIGNALS_Virtual_DcmDspUDS_2622Byte05_signal" 496 "SIGNALS_Virtual_DcmDspUDS_2623Byte00_signal" 497 "SIGNALS_Virtual_DcmDspUDS_2623Byte01_signal" 498 "SIGNALS_Virtual_DcmDspUDS_2623Byte02_signal" 499 "SIGNALS_Virtual_DcmDspUDS_2623Byte03_signal" 500 "SIGNALS_Virtual_DcmDspUDS_2623Byte04_signal" 501 "SIGNALS_Virtual_DcmDspUDS_2623Byte05_signal" 502 "SIGNALS_Virtual_DcmDspUDS_2660Byte0_signal" 503 "SIGNALS_Virtual_DcmDspUDS_2660Byte15_signal" 504 "SIGNALS_Virtual_DcmDspUDS_2660Byte16_signal" 505 "SIGNALS_Virtual_DcmDspUDS_2660Byte17_signal" 506 "SIGNALS_Virtual_DcmDspUDS_2660Byte18_signal" 507 "SIGNALS_Virtual_DcmDspUDS_2660Byte19_signal" 508 "SIGNALS_Virtual_DcmDspUDS_2660Byte1A_signal" 509 "SIGNALS_Virtual_DcmDspUDS_2660Byte1B_signal" 510 "SIGNALS_Virtual_DcmDspUDS_2660Byte1C_signal" 511 "SIGNALS_Virtual_DcmDspUDS_2660Byte1D_signal" 512 "SIGNALS_Virtual_DcmDspUDS_2660Byte1E_signal" 513 "SIGNALS_Virtual_DcmDspUDS_2660Byte1_signal" 514 "SIGNALS_Virtual_DcmDspUDS_2660Byte2_signal" 515 "SIGNALS_Virtual_DcmDspUDS_2660Byte3_signal" 516 "SIGNALS_Virtual_DcmDspUDS_2660Byte4_signal" 517 "SIGNALS_Virtual_DcmDspUDS_2660Byte5_signal" 518 "SIGNALS_Virtual_DcmDspUDS_2660Byte6_signal" 519 "SIGNALS_Virtual_DcmDspUDS_2661Byte0A_signal" 520 "SIGNALS_Virtual_DcmDspUDS_2661Byte0B_signal" 521 "SIGNALS_Virtual_DcmDspUDS_2661Byte0C_signal" 522 "SIGNALS_Virtual_DcmDspUDS_2661Byte0D_signal" 523 "SIGNALS_Virtual_DcmDspUDS_2661Byte0E_signal" 524 "SIGNALS_Virtual_DcmDspUDS_2661Byte0F_signal" 525 "SIGNALS_Virtual_DcmDspUDS_2661Byte0_signal" 526 "SIGNALS_Virtual_DcmDspUDS_2661Byte1_signal" 527 "SIGNALS_Virtual_DcmDspUDS_2661Byte27_signal" 528 "SIGNALS_Virtual_DcmDspUDS_2661Byte2A_signal" 529 "SIGNALS_Virtual_DcmDspUDS_2661Byte2D_signal" 530 "SIGNALS_Virtual_DcmDspUDS_2661Byte2E_signal" 531 "SIGNALS_Virtual_DcmDspUDS_2661Byte2F_signal" 532 "SIGNALS_Virtual_DcmDspUDS_2661Byte2_signal" 533 "SIGNALS_Virtual_DcmDspUDS_2661Byte30_signal" 534 "SIGNALS_Virtual_DcmDspUDS_2661Byte31_signal" 535 "SIGNALS_Virtual_DcmDspUDS_2661Byte32_signal" 536 "SIGNALS_Virtual_DcmDspUDS_2661Byte35_signal" 537 "SIGNALS_Virtual_DcmDspUDS_2661Byte3_signal" 538 "SIGNALS_Virtual_DcmDspUDS_2661Byte4_signal" 539 "SIGNALS_Virtual_DcmDspUDS_2661Byte5_signal" 540 "SIGNALS_Virtual_DcmDspUDS_2661Byte6_signal" 541 "SIGNALS_Virtual_DcmDspUDS_2661Byte7_signal" 542 "SIGNALS_Virtual_DcmDspUDS_2661Byte8_signal" 543 "SIGNALS_Virtual_DcmDspUDS_2661Byte9_signal" 544 "SIGNALS_Virtual_DcmDspUDS_2662Byte0_signal" 545 "SIGNALS_Virtual_DcmDspUDS_2662Byte18_signal" 546 "SIGNALS_Virtual_DcmDspUDS_2662Byte19_signal" 547 "SIGNALS_Virtual_DcmDspUDS_2662Byte1_signal" 548 "SIGNALS_Virtual_DcmDspUDS_2662Byte2_signal" 549 "SIGNALS_Virtual_DcmDspUDS_2662Byte3_signal" 550 "SIGNALS_Virtual_DcmDspUDS_2662Byte4_signal" 551 "SIGNALS_Virtual_DcmDspUDS_2662Byte5_signal" 552 "SIGNALS_Virtual_DcmDspUDS_2663Byte0_signal" 553 "SIGNALS_Virtual_DcmDspUDS_2663Byte1_signal" 554 "SIGNALS_Virtual_DcmDspUDS_2663Byte2_signal" 555 "SIGNALS_Virtual_DcmDspUDS_2663Byte3_signal" 556 "SIGNALS_Virtual_DcmDspUDS_2663Byte4_signal" 557 "SIGNALS_Virtual_DcmDspUDS_2663Byte5_signal" 558 "SIGNALS_Virtual_DcmDspUDS_2664Byte0_signal" 559 "SIGNALS_Virtual_DcmDspUDS_2664Byte1_signal" 560 "SIGNALS_Virtual_DcmDspUDS_2664Byte25_signal" 561 "SIGNALS_Virtual_DcmDspUDS_2664Byte26_signal" 562 "SIGNALS_Virtual_DcmDspUDS_2664Byte2_signal" 563 "SIGNALS_Virtual_DcmDspUDS_2664Byte3_signal" 564 "SIGNALS_Virtual_DcmDspUDS_2664Byte4_signal" 565 "SIGNALS_Virtual_DcmDspUDS_2664Byte5_signal" 566 "SIGNALS_Virtual_DcmDspUDS_2664Byte6_signal" 567 "SIGNALS_Virtual_DcmDspUDS_2664Byte7_signal" 568 "SIGNALS_Virtual_DcmDspUDS_2665Byte0_signal" 569 "SIGNALS_Virtual_DcmDspUDS_2665Byte1_signal" 570 "SIGNALS_Virtual_DcmDspUDS_2665Byte2_signal" 571 "SIGNALS_Virtual_DcmDspUDS_2665Byte3_signal" 572 "SIGNALS_Virtual_DcmDspUDS_2665Byte4_signal" 573 "SIGNALS_Virtual_DcmDspUDS_2665Byte5_signal" 574 "SIGNALS_Virtual_DcmDspUDS_2668Byte0_signal" 575 "SIGNALS_Virtual_DcmDspUDS_2668Byte1B_signal" 576 "SIGNALS_Virtual_DcmDspUDS_2668Byte1_signal" 577 "SIGNALS_Virtual_DcmDspUDS_2668Byte2_signal" 578 "SIGNALS_Virtual_DcmDspUDS_2668Byte3_signal" 579 "SIGNALS_Virtual_DcmDspUDS_2668Byte4_signal" 580 "SIGNALS_Virtual_DcmDspUDS_2668Byte5_signal" 581 "SIGNALS_Virtual_DcmDspUDS_266CByte0_signal" 582 "SIGNALS_Virtual_DcmDspUDS_266CByte1_signal" 583 "SIGNALS_Virtual_DcmDspUDS_266CByte26_signal" 584 "SIGNALS_Virtual_DcmDspUDS_266CByte27_signal" 585 "SIGNALS_Virtual_DcmDspUDS_266CByte2_signal" 586 "SIGNALS_Virtual_DcmDspUDS_266CByte3_signal" 587 "SIGNALS_Virtual_DcmDspUDS_266CByte4_signal" 588 "SIGNALS_Virtual_DcmDspUDS_266CByte5_signal" 589 "SIGNALS_Virtual_DcmDspUDS_266DByte0_signal" 590 "SIGNALS_Virtual_DcmDspUDS_266DByte1_signal" 591 "SIGNALS_Virtual_DcmDspUDS_266DByte2_signal" 592 "SIGNALS_Virtual_DcmDspUDS_266DByte3_signal" 593 "SIGNALS_Virtual_DcmDspUDS_266DByte4_signal" 594 "SIGNALS_Virtual_DcmDspUDS_266DByte5_signal" 595 "SIGNALS_Virtual_DcmDspUDS_266FByte0_signal" 596 "SIGNALS_Virtual_DcmDspUDS_266FByte1_signal" 597 "SIGNALS_Virtual_DcmDspUDS_266FByte2_signal" 598 "SIGNALS_Virtual_DcmDspUDS_266FByte3_signal" 599 "SIGNALS_Virtual_DcmDspUDS_2673Byte0A_signal" 600 "SIGNALS_Virtual_DcmDspUDS_2673Byte0B_signal" 601 "SIGNALS_Virtual_DcmDspUDS_2673Byte0_signal" 602 "SIGNALS_Virtual_DcmDspUDS_2673Byte12_signal" 603 "SIGNALS_Virtual_DcmDspUDS_2673Byte13_signal" 604 "SIGNALS_Virtual_DcmDspUDS_2673Byte16_signal" 605 "SIGNALS_Virtual_DcmDspUDS_2673Byte17_signal" 606 "SIGNALS_Virtual_DcmDspUDS_2673Byte1E_signal" 607 "SIGNALS_Virtual_DcmDspUDS_2673Byte1F_signal" 608 "SIGNALS_Virtual_DcmDspUDS_2673Byte1_signal" 609 "SIGNALS_Virtual_DcmDspUDS_2673Byte2_signal" 610 "SIGNALS_Virtual_DcmDspUDS_2673Byte3_signal" 611 "SIGNALS_Virtual_DcmDspUDS_2673Byte4_signal" 612 "SIGNALS_Virtual_DcmDspUDS_2673Byte5_signal" 613 "SIGNALS_Virtual_DcmDspUDS_2673Byte6_signal" 614 "SIGNALS_Virtual_DcmDspUDS_2673Byte7_signal" 615 "SIGNALS_Virtual_DcmDspUDS_2676Byte0_signal" 616 "SIGNALS_Virtual_DcmDspUDS_2676Byte1_signal" 617 "SIGNALS_Virtual_DcmDspUDS_2676Byte2E_signal" 618 "SIGNALS_Virtual_DcmDspUDS_2676Byte2F_signal" 619 "SIGNALS_Virtual_DcmDspUDS_2676Byte2_signal" 620 "SIGNALS_Virtual_DcmDspUDS_2676Byte3_signal" 621 "SIGNALS_Virtual_DcmDspUDS_2676Byte4_signal" 622 "SIGNALS_Virtual_DcmDspUDS_2676Byte5_signal" 623 "SIGNALS_Virtual_DcmDspUDS_2676Byte6_signal" 624 "SIGNALS_Virtual_DcmDspUDS_2676Byte7_signal" 625 "SIGNALS_Virtual_DcmDspUDS_2676Byte8_signal" 626 "SIGNALS_Virtual_DcmDspUDS_2676Byte9_signal" 627 "SIGNALS_Virtual_DcmDspUDS_267BByte0_signal" 628 "SIGNALS_Virtual_DcmDspUDS_267BByte1_signal" 629 "SIGNALS_Virtual_DcmDspUDS_267BByte2_signal" 630 "SIGNALS_Virtual_DcmDspUDS_267BByte3_signal" 631 "SIGNALS_Virtual_DcmDspUDS_267BByte4_signal" 632 "SIGNALS_Virtual_DcmDspUDS_267BByte5_signal" 633 "SIGNALS_Virtual_DcmDspUDS_267EByte0_signal" 634 "SIGNALS_Virtual_DcmDspUDS_267EByte1_signal" 635 "SIGNALS_Virtual_DcmDspUDS_267EByte22_signal" 636 "SIGNALS_Virtual_DcmDspUDS_2680Byte00_signal" 637 "SIGNALS_Virtual_DcmDspUDS_2680Byte01_signal" 638 "SIGNALS_Virtual_DcmDspUDS_2680Byte02_signal" 639 "SIGNALS_Virtual_DcmDspUDS_2680Byte03_signal" 640 "SIGNALS_Virtual_DcmDspUDS_2680Byte04_signal" 641 "SIGNALS_Virtual_DcmDspUDS_2680Byte05_signal" 642 "SIGNALS_Virtual_DcmDspUDS_2680Byte08_signal" 643 "SIGNALS_Virtual_DcmDspUDS_2680Byte09_signal" 644 "SIGNALS_Virtual_DcmDspUDS_2680Byte0E_signal" 645 "SIGNALS_Virtual_DcmDspUDS_2680Byte0F_signal" 646 "SIGNALS_Virtual_DcmDspUDS_2681Byte00_signal" 647 "SIGNALS_Virtual_DcmDspUDS_2681Byte01_signal" 648 "SIGNALS_Virtual_DcmDspUDS_2681Byte02_signal" 649 "SIGNALS_Virtual_DcmDspUDS_2681Byte03_signal" 650 "SIGNALS_Virtual_DcmDspUDS_2681Byte04_signal" 651 "SIGNALS_Virtual_DcmDspUDS_2681Byte05_signal" 652 "SIGNALS_Virtual_DcmDspUDS_2681Byte0F_signal" 653 "SIGNALS_Virtual_DcmDspUDS_2681Byte10_signal" 654 "SIGNALS_Virtual_DcmDspUDS_2681Byte13_signal" 655 "SIGNALS_Virtual_DcmDspUDS_2681Byte14_signal" 656 "SIGNALS_Virtual_DcmDspUDS_2681Byte1D_signal" 657 "SIGNALS_Virtual_DcmDspUDS_2681Byte1E_signal" 658 "SIGNALS_Virtual_DcmDspUDS_2682Byte00_signal" 659 "SIGNALS_Virtual_DcmDspUDS_2682Byte01_signal" 660 "SIGNALS_Virtual_DcmDspUDS_2682Byte02_signal" 661 "SIGNALS_Virtual_DcmDspUDS_2682Byte03_signal" 662 "SIGNALS_Virtual_DcmDspUDS_2682Byte04_signal" 663 "SIGNALS_Virtual_DcmDspUDS_2682Byte05_signal" 664 "SIGNALS_Virtual_DcmDspUDS_2682Byte06_07_signal" 665 "SIGNALS_Virtual_DcmDspUDS_2682Byte08_09_signal" 666 "SIGNALS_Virtual_DcmDspUDS_2682Byte0E_signal" 667 "SIGNALS_Virtual_DcmDspUDS_2682Byte11_12_signal" 668 "SIGNALS_Virtual_DcmDspUDS_2682Byte13_14_signal" 669 "SIGNALS_Virtual_DcmDspUDS_2682Byte15_16_signal" 670 "SIGNALS_Virtual_DcmDspUDS_2682Byte18_19_signal" 671 "SIGNALS_Virtual_DcmDspUDS_2682Byte1B_signal" 672 "SIGNALS_Virtual_DcmDspUDS_2682Byte1C_signal" 673 "SIGNALS_Virtual_DcmDspUDS_268FByte00_signal" 674 "SIGNALS_Virtual_DcmDspUDS_268FByte01_signal" 675 "SIGNALS_Virtual_DcmDspUDS_268FByte02_signal" 676 "SIGNALS_Virtual_DcmDspUDS_268FByte03_signal" 677 "SIGNALS_Virtual_DcmDspUDS_268FByte04_signal" 678 "SIGNALS_Virtual_DcmDspUDS_268FByte05_signal" 679 "SIGNALS_Virtual_DcmDspUDS_268FByte0A_signal" 680 "SIGNALS_Virtual_DcmDspUDS_268FByte0B_signal" 681 "SIGNALS_Virtual_DcmDspUDS_268FByte0C_signal" 682 "SIGNALS_Virtual_DcmDspUDS_269AByte00_signal" 683 "SIGNALS_Virtual_DcmDspUDS_269AByte01_signal" 684 "SIGNALS_Virtual_DcmDspUDS_269AByte02_signal" 685 "SIGNALS_Virtual_DcmDspUDS_269AByte03_signal" 686 "SIGNALS_Virtual_DcmDspUDS_269AByte04_signal" 687 "SIGNALS_Virtual_DcmDspUDS_269AByte05_signal" 688 "SIGNALS_Virtual_DcmDspUDS_26A2Byte00_signal" 689 "SIGNALS_Virtual_DcmDspUDS_26A2Byte01_signal" 690 "SIGNALS_Virtual_DcmDspUDS_26A2Byte02_signal" 691 "SIGNALS_Virtual_DcmDspUDS_26A2Byte03_signal" 692 "SIGNALS_Virtual_DcmDspUDS_26A2Byte04_signal" 693 "SIGNALS_Virtual_DcmDspUDS_26A2Byte05_signal" 694 "SIGNALS_Virtual_DcmDspUDS_26A2Byte12_13_signal" 695 "SIGNALS_Virtual_DcmDspUDS_Acm_fzabgs_w_signal" 696 "SIGNALS_Virtual_DcmDspUDS_Acm_fzabgzyl_w_0_signal" 697 "SIGNALS_Virtual_DcmDspUDS_Acm_fzabgzyl_w_1_signal" 698 "SIGNALS_Virtual_DcmDspUDS_Acm_fzabgzyl_w_2_signal" 699 "SIGNALS_Virtual_DcmDspUDS_Acm_fzabgzyl_w_3_signal" 700 "SIGNALS_Virtual_DcmDspUDS_DID_E402Byte00_signal" 701 "SIGNALS_Virtual_DcmDspUDS_DID_E402Byte01_signal" 702 "SIGNALS_Virtual_DcmDspUDS_DID_E402Byte07to08_signal" 703 "SIGNALS_Virtual_DcmDspUDS_DID_E402Byte10to11_signal" 704 "SIGNALS_Virtual_DcmDspUDS_DID_E402Byte19to1A_signal" 705 "SIGNALS_Virtual_DcmDspUDS_DID_E402Byte22to23_signal" 706 "SIGNALS_Virtual_DcmDspUDS_DID_E402Byte2Bto2C_signal" 707 "SIGNALS_Virtual_DcmDspUDS_DID_F110Byte0_3_signal" 708 "SIGNALS_Virtual_DcmDspUDS_DID_F110Byte12_15_signal" 709 "SIGNALS_Virtual_DcmDspUDS_DID_F110Byte16_signal" 710 "SIGNALS_Virtual_DcmDspUDS_DID_F110Byte4_7_signal" 711 "SIGNALS_Virtual_DcmDspUDS_DID_F110Byte8_11_signal" 712 "SIGNALS_Virtual_DcmDspUDS_DID_F112Byte0_3_signal" 713 "SIGNALS_Virtual_DcmDspUDS_DID_F112Byte12_15_signal" 714 "SIGNALS_Virtual_DcmDspUDS_DID_F112Byte16_19_signal" 715 "SIGNALS_Virtual_DcmDspUDS_DID_F112Byte20_23_signal" 716 "SIGNALS_Virtual_DcmDspUDS_DID_F112Byte24_27_signal" 717 "SIGNALS_Virtual_DcmDspUDS_DID_F112Byte28_29_signal" 718 "SIGNALS_Virtual_DcmDspUDS_DID_F112Byte30_signal" 719 "SIGNALS_Virtual_DcmDspUDS_DID_F112Byte4_7_signal" 720 "SIGNALS_Virtual_DcmDspUDS_DID_F112Byte8_11_signal" 721 "SIGNALS_Virtual_DcmDspUDS_E602Byte2_signal" 722 "SIGNALS_Virtual_DcmDspUDS_F181Byte0_3_signal" 723 "SIGNALS_Virtual_DcmDspUDS_F181Byte12_15_signal" 724 "SIGNALS_Virtual_DcmDspUDS_F181Byte4_7_signal" 725 "SIGNALS_Virtual_DcmDspUDS_F181Byte8_11_signal" 726 "SIGNALS_Virtual_DcmDspUDS_fzabgs_w_signal" 727 "SIGNALS_Virtual_DcmDspUDS_fzabgzyl_w_0_signal" 728 "SIGNALS_Virtual_DcmDspUDS_fzabgzyl_w_1_signal" 729 "SIGNALS_Virtual_DcmDspUDS_fzabgzyl_w_2_signal" 730 "SIGNALS_Virtual_DcmDspUDS_fzabgzyl_w_3_signal" 731 "SIGNALS_Virtual_DcmDspUDS_numReWrECUID1_signal" 732 "SIGNALS_Virtual_DcmDspUDS_numReWrECUID2_signal" 733 "SIGNALS_Virtual_I14229B9_0490_FrNo09_signal" 734 "SIGNALS_Virtual_I14229B9_0490_FrNo10_signal" 735 "SIGNALS_Virtual_I14229B9_04B1_FrNo16_signal" 736 "SIGNALS_Virtual_I14229B9_04B1_FrNo17_signal" 737 "SIGNALS_Virtual_I14229B9_04B1_FrNo20_signal" 738 "SIGNALS_Virtual_I14229B9_04B1_FrNo21_signal" 739 "SIGNALS_Virtual_I14229B9_04B1_FrNo22_signal" 740 "SIGNALS_Virtual_I14229B9_04B1_FrNo23_signal" 741 "SIGNALS_Virtual_I14229B9_04C2_FrNo2021_signal" 742 "SIGNALS_Virtual_I14229B9_04D2_FrNo24_signal" 743 "SIGNALS_Virtual_I14229B9_04D2_FrNo25_signal" 744 "SIGNALS_Virtual_I14229B9_0520_FrNo15_signal" 745 "SIGNALS_Virtual_I14229B9_0520_FrNo16_signal" 746 "SIGNALS_Virtual_I14229B9_0523_FrNo42_signal" 747 "SIGNALS_Virtual_I14229B9_0523_FrNo43_signal" 748 "SIGNALS_Virtual_I14229B9_0524_FrNo09_signal" 749 "SIGNALS_Virtual_I14229B9_0524_FrNo10_signal" 750 "SIGNALS_Virtual_I14229B9_0550_FrNo09_signal" 751 "SIGNALS_Virtual_I14229B9_0550_FrNo10_signal" 752 "SIGNALS_Virtual_I14229B9_0553_FrNo13_signal" 753 "SIGNALS_Virtual_I14229B9_0553_FrNo14_signal" 754 "SIGNALS_Virtual_I14229B9_056A_FrNo8_signal" 755 "SIGNALS_Virtual_I14229B9_056A_FrNo9_signal" 756 "SIGNALS_Virtual_I14229B9_0588_FrNo15_signal" 757 "SIGNALS_Virtual_I14229B9_0588_FrNo16_signal" 758 "SIGNALS_Virtual_I14229B9_05A0_FrNo40_signal" 759 "SIGNALS_Virtual_I14229B9_05A0_FrNo41_signal" 760 "SIGNALS_Virtual_I14229B9_05B0_FrNo13_signal" 761 "SIGNALS_Virtual_I14229B9_05B0_FrNo14_signal" 762 "SIGNALS_Virtual_I14229B9_05C0_FrNo12_signal" 763 "SIGNALS_Virtual_I14229B9_05C0_FrNo13_signal" 764 "SIGNALS_Virtual_I14229B9_05E0_FrNo19_signal" 765 "SIGNALS_Virtual_I14229B9_05E0_FrNo20_signal" 766 "SIGNALS_Virtual_I14229B9_05E0_FrNo21_signal" 767 "SIGNALS_Virtual_I14229B9_05E0_FrNo22_signal" 768 "SIGNALS_Virtual_I14229B9_05E0_FrNo23_signal" 769 "SIGNALS_Virtual_I14229B9_05E0_FrNo24_signal" 770 "SIGNALS_Virtual_I14229B9_1208_FrNo34_signal" 771 "SIGNALS_Virtual_I14229B9_1208_FrNo35_signal" 772 "SIGNALS_Virtual_I14229B9_1208_FrNo36_signal" 773 "SIGNALS_Virtual_I14229B9_1208_FrNo37_signal" 774 "SIGNALS_Virtual_I14229B9_120A_FrNo09_signal" 775 "SIGNALS_Virtual_I14229B9_120A_FrNo10_signal" 776 "SIGNALS_Virtual_I14229B9_120B_FrNo09_signal" 777 "SIGNALS_Virtual_I14229B9_120B_FrNo10_signal" 778 "SIGNALS_Virtual_I14229_AirC_pAnaClnt_signal" 779 "SIGNALS_Virtual_I14229_EpmCaS_ctErrSig2_signal" 780 "SIGNALS_Virtual_I14229_pEngSrtMin_signal" 781 "SIGNALS_Virtual_I14229_wdkba_w_signal" 782 "SIGNALS_Virtual_Tra_numGear_signal" /end COMPU_VTAB
/begin COMPU_METHOD spg_q0p001 "" RAT_FUNC "%6.5" "V" COEFFS 0 1000 0 0 0 1 /end COMPU_METHOD
/begin COMPU_METHOD spg_q0p1 "" RAT_FUNC "%6.3" "V" COEFFS 0 1 0 0 0 0.1 /end COMPU_METHOD
/begin COMPU_METHOD spg_q1p221Em3_V "" RAT_FUNC "%6.4" "V" COEFFS 0 65536 0 0 0 80 /end COMPU_METHOD
/begin COMPU_METHOD spg_uw_b5 "" RAT_FUNC "%6.4" "V" COEFFS 0 1024 0 0 0 5 /end COMPU_METHOD
/begin COMPU_METHOD Temp_Cels "" RAT_FUNC "%6.1" "deg C" COEFFS 0 10 2731.4 0 0 1 /end COMPU_METHOD
/begin COMPU_METHOD Temp_Kelv "" RAT_FUNC "%6.3" "K" COEFFS 0 10 0 0 0 1 /end COMPU_METHOD
/begin COMPU_METHOD temp_ub_q0p75_o48 "" RAT_FUNC "%6.2" "Grad C" COEFFS 0 1 48 0 0 0.75 /end COMPU_METHOD
/begin COMPU_METHOD TimeDelay_s "" RAT_FUNC "%6.1" "s" COEFFS 0 0 1 0 0.00023283064365387 0 /end COMPU_METHOD
/begin COMPU_METHOD TimeEngOn "" RAT_FUNC "%6.2" "s" COEFFS 0 1 0 0 0 1 /end COMPU_METHOD
/begin COMPU_METHOD Time_Dt "" RAT_FUNC "%9.8" "s" COEFFS 0 1000000 0 0 0 1 /end COMPU_METHOD
/begin COMPU_METHOD Time_ms "" RAT_FUNC "%6.1" "ms" COEFFS 0 0.1 0 0 0 1 /end COMPU_METHOD
/begin COMPU_METHOD Time_msec_q10_COMPU "" RAT_FUNC "%6.1" "ms" COEFFS 0 1 0 0 0 10 /end COMPU_METHOD
/begin COMPU_METHOD Time_ms_20ms "" RAT_FUNC "%6.1" "ms" COEFFS 0 0.05 0 0 0 1 /end COMPU_METHOD
/begin COMPU_METHOD Time_sec_1 "" RAT_FUNC "%6.3" "s" COEFFS 0 10 0 0 0 1 /end COMPU_METHOD
/begin COMPU_METHOD Time_sec_q1_COMPU "" RAT_FUNC "%6.2" "s" COEFFS 0 1 0 0 0 1 /end COMPU_METHOD
/begin COMPU_METHOD TransR "" RAT_FUNC "%6.4" "-" COEFFS 0 100 0 0 0 1 /end COMPU_METHOD
/begin COMPU_METHOD t_q0p001 "" RAT_FUNC "%6.5" "s" COEFFS 0 1000 0 0 0 1 /end COMPU_METHOD
/begin COMPU_METHOD t_q0p001_ms "" RAT_FUNC "%6.5" "ms" COEFFS 0 1 0 0 0 0.001 /end COMPU_METHOD
/begin COMPU_METHOD t_q0p02 "" RAT_FUNC "%6.4" "s" COEFFS 0 100 0 0 0 2 /end COMPU_METHOD
/begin COMPU_METHOD t_q0p1 "" RAT_FUNC "%6.3" "s" COEFFS 0 10 0 0 0 1 /end COMPU_METHOD
/begin COMPU_METHOD Vel "" RAT_FUNC "%6.4" "km/h" COEFFS 0 100 0 0 0 1 /end COMPU_METHOD
/begin COMPU_METHOD vel_q0p01 "" RAT_FUNC "%6.4" "km/h" COEFFS 0 100 0 0 0 1 /end COMPU_METHOD
/begin COMPU_METHOD VlvLft_stFbSwt_VERB "" TAB_VERB "%6.3" "" COMPU_TAB_REF VlvLft_stFbSwt_VERB /end COMPU_METHOD
/begin COMPU_VTAB VlvLft_stFbSwt_VERB "" TAB_VERB 3 0 "VlvLft_Ol" 1 "VlvLft_ClSwt" 2 "VlvLft_ClSnsr" /end COMPU_VTAB
/begin COMPU_METHOD Volt "" RAT_FUNC "%6.3" "mV" COEFFS 0 5 0 0 0 1 /end COMPU_METHOD
/begin COMPU_METHOD zw_q0p1 "" RAT_FUNC "%6.3" "Grad KW" COEFFS 0 10 0 0 0 1 /end COMPU_METHOD
/begin RECORD_LAYOUT RB_Curve_S16_S16 NO_AXIS_PTS_X 1 SWORD AXIS_PTS_X 2 SWORD INDEX_INCR DIRECT FNC_VALUES 3 SWORD COLUMN_DIR DIRECT /end RECORD_LAYOUT
/begin RECORD_LAYOUT RB_Curve_U8_S16_Static NO_AXIS_PTS_X 1 UBYTE AXIS_PTS_X 2 UBYTE INDEX_INCR DIRECT FNC_VALUES 3 SWORD COLUMN_DIR DIRECT STATIC_RECORD_LAYOUT /end RECORD_LAYOUT
/begin RECORD_LAYOUT RB_Curve_U8_U8 NO_AXIS_PTS_X 1 UBYTE AXIS_PTS_X 2 UBYTE INDEX_INCR DIRECT FNC_VALUES 3 UBYTE COLUMN_DIR DIRECT /end RECORD_LAYOUT
/begin RECORD_LAYOUT RB_Map_S16S16_S16 NO_AXIS_PTS_X 1 SWORD NO_AXIS_PTS_Y 2 SWORD AXIS_PTS_X 3 SWORD INDEX_INCR DIRECT AXIS_PTS_Y 4 SWORD INDEX_INCR DIRECT FNC_VALUES 5 SWORD COLUMN_DIR DIRECT /end RECORD_LAYOUT
/begin RECORD_LAYOUT RB_Map_S16U8_S16 NO_AXIS_PTS_X 1 SWORD NO_AXIS_PTS_Y 2 SWORD AXIS_PTS_X 3 SWORD INDEX_INCR DIRECT AXIS_PTS_Y 4 UBYTE INDEX_INCR DIRECT FNC_VALUES 5 SWORD COLUMN_DIR DIRECT /end RECORD_LAYOUT
/begin RECORD_LAYOUT RB_Map_U8U8_S16 NO_AXIS_PTS_X 1 UBYTE NO_AXIS_PTS_Y 2 UBYTE AXIS_PTS_X 3 UBYTE INDEX_INCR DIRECT AXIS_PTS_Y 4 UBYTE INDEX_INCR DIRECT FNC_VALUES 5 SWORD COLUMN_DIR DIRECT /end RECORD_LAYOUT
/begin RECORD_LAYOUT RB_ValA_Ws16 FNC_VALUES 1 SWORD COLUMN_DIR DIRECT /end RECORD_LAYOUT
/begin RECORD_LAYOUT RB_ValA_Wu16 FNC_VALUES 1 UWORD COLUMN_DIR DIRECT /end RECORD_LAYOUT
/begin RECORD_LAYOUT RB_Val_Wboolean FNC_VALUES 1 UBYTE COLUMN_DIR DIRECT /end RECORD_LAYOUT
/begin RECORD_LAYOUT RB_Val_Ws16 FNC_VALUES 1 SWORD COLUMN_DIR DIRECT /end RECORD_LAYOUT
/begin RECORD_LAYOUT RB_Val_Ws32 FNC_VALUES 1 SLONG COLUMN_DIR DIRECT /end RECORD_LAYOUT
/begin RECORD_LAYOUT RB_Val_Ws8 FNC_VALUES 1 SBYTE COLUMN_DIR DIRECT /end RECORD_LAYOUT
/begin RECORD_LAYOUT RB_Val_Wu16 FNC_VALUES 1 UWORD COLUMN_DIR DIRECT /end RECORD_LAYOUT
/begin RECORD_LAYOUT RB_Val_Wu32 FNC_VALUES 1 ULONG COLUMN_DIR DIRECT /end RECORD_LAYOUT
/begin RECORD_LAYOUT RB_Val_Wu8 FNC_VALUES 1 UBYTE COLUMN_DIR DIRECT /end RECORD_LAYOUT
/begin RECORD_LAYOUT Val_Ws16 FNC_VALUES 1 SWORD COLUMN_DIR DIRECT /end RECORD_LAYOUT
/begin RECORD_LAYOUT Val_Ws32 FNC_VALUES 1 SLONG COLUMN_DIR DIRECT /end RECORD_LAYOUT
/begin RECORD_LAYOUT Val_Wu8 FNC_VALUES 1 UBYTE COLUMN_DIR DIRECT /end RECORD_LAYOUT
/end MODULE
/end PROJECT
