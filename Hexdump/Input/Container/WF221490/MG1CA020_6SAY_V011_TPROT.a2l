ASAP2_VERSION 1 60
/begin PROJECT MG1CA020 "MG1CA020"
/begin HEADER "" VERSION "MG1CA020_6SAY_V011_TPROT" PROJECT_NO MG1CA020 /end HEADER
/begin MODULE DIM ""
/begin MOD_COMMON "" BYTE_ORDER MSB_LAST ALIGNMENT_BYTE 1 ALIGNMENT_WORD 2 ALIGNMENT_LONG 4 ALIGNMENT_INT64 4 ALIGNMENT_FLOAT32_IEEE 4 ALIGNMENT_FLOAT64_IEEE 4 DATA_SIZE 32 /end MOD_COMMON
/begin CHARACTERISTIC DFC_CtlMsk.DFC_MRlyDcSCG_C "Behaviour control mask / Behaviour control masks of check DFC_MRlyDcSCG" VALUE 0x804D8E04 Val_Wu16 65535.00 DFES_OneToOne 0.00 65535.00 FORMAT "%8.2" /end CHARACTERISTIC
/begin CHARACTERISTIC DFC_CtlMsk.DFC_PSPOL_C "Behaviour control mask / Behaviour control masks of check DFC_PSPOL" VALUE 0x804D8E06 Val_Wu16 65535.00 DFES_OneToOne 0.00 65535.00 FORMAT "%8.2" /end CHARACTERISTIC
/begin CHARACTERISTIC DFC_CtlMsk.DFC_PSPOvrTemp_C "Behaviour control mask / Behaviour control masks of check DFC_PSPOvrTemp" VALUE 0x804D8E08 Val_Wu16 65535.00 DFES_OneToOne 0.00 65535.00 FORMAT "%8.2" /end CHARACTERISTIC
/begin CHARACTERISTIC DFC_CtlMsk.DFC_PSPSCB_C "Behaviour control mask / Behaviour control masks of check DFC_PSPSCB" VALUE 0x804D8E0A Val_Wu16 65535.00 DFES_OneToOne 0.00 65535.00 FORMAT "%8.2" /end CHARACTERISTIC
/begin CHARACTERISTIC DFC_CtlMsk.DFC_PSPSCG_C "Behaviour control mask / Behaviour control masks of check DFC_PSPSCG" VALUE 0x804D8E0C Val_Wu16 65535.00 DFES_OneToOne 0.00 65535.00 FORMAT "%8.2" /end CHARACTERISTIC
/begin CHARACTERISTIC DFC_CtlMsk.DFC_T50Err_C "Behaviour control mask / Behaviour control masks of check DFC_T50Err" VALUE 0x804D8E0E Val_Wu16 65535.00 DFES_OneToOne 0.00 65535.00 FORMAT "%8.2" /end CHARACTERISTIC
/begin CHARACTERISTIC DFC_CtlMsk.DFC_ThrVlvLoBattB1_C "Behaviour control mask / Behaviour control masks of check DFC_ThrVlvLoBattB1" VALUE 0x804D8E10 Val_Wu16 65535.00 DFES_OneToOne 0.00 65535.00 FORMAT "%8.2" /end CHARACTERISTIC
/begin CHARACTERISTIC DFC_CtlMsk.DFC_VehVPhysRngHi_C "Behaviour control mask / Behaviour control masks of check DFC_VehVPhysRngHi" VALUE 0x804D8E12 Val_Wu16 65535.00 DFES_OneToOne 0.00 65535.00 FORMAT "%8.2" /end CHARACTERISTIC
/begin CHARACTERISTIC DFC_CtlMsk.DFC_VehVSclOutOL_C "Behaviour control mask / Behaviour control masks of check DFC_VehVSclOutOL" VALUE 0x804D8E14 Val_Wu16 65535.00 DFES_OneToOne 0.00 65535.00 FORMAT "%8.2" /end CHARACTERISTIC
/begin CHARACTERISTIC DFC_CtlMsk.DFC_VehVSclOutOT_C "Behaviour control mask / Behaviour control masks of check DFC_VehVSclOutOT" VALUE 0x804D8E16 Val_Wu16 65535.00 DFES_OneToOne 0.00 65535.00 FORMAT "%8.2" /end CHARACTERISTIC
/begin CHARACTERISTIC DFC_CtlMsk.DFC_VehVSclOutSCB_C "Behaviour control mask / Behaviour control masks of check DFC_VehVSclOutSCB" VALUE 0x804D8E18 Val_Wu16 65535.00 DFES_OneToOne 0.00 65535.00 FORMAT "%8.2" /end CHARACTERISTIC
/begin CHARACTERISTIC DFC_CtlMsk.DFC_VehVSclOutSCG_C "Behaviour control mask / Behaviour control masks of check DFC_VehVSclOutSCG" VALUE 0x804D8E1A Val_Wu16 65535.00 DFES_OneToOne 0.00 65535.00 FORMAT "%8.2" /end CHARACTERISTIC
/begin CHARACTERISTIC DFC_CtlMsk.DFC_VehVSnsrARngHi_C "Behaviour control mask / Behaviour control masks of check DFC_VehVSnsrARngHi" VALUE 0x804D8E1C Val_Wu16 65535.00 DFES_OneToOne 0.00 65535.00 FORMAT "%8.2" /end CHARACTERISTIC
/begin CHARACTERISTIC DFC_CtlMsk.DFC_VehVSnsrBRngHi_C "Behaviour control mask / Behaviour control masks of check DFC_VehVSnsrBRngHi" VALUE 0x804D8E1E Val_Wu16 65535.00 DFES_OneToOne 0.00 65535.00 FORMAT "%8.2" /end CHARACTERISTIC
/begin CHARACTERISTIC DFC_CtlMsk.DFC_VehVSpdRtyDiag_C "Behaviour control mask / Behaviour control masks of check DFC_VehVSpdRtyDiag" VALUE 0x804D8E20 Val_Wu16 65535.00 DFES_OneToOne 0.00 65535.00 FORMAT "%8.2" /end CHARACTERISTIC
/begin CHARACTERISTIC DFC_CtlMsk.DFC_VehVWhlErr_C "Behaviour control mask / Behaviour control masks of check DFC_VehVWhlErr" VALUE 0x804D8E22 Val_Wu16 65535.00 DFES_OneToOne 0.00 65535.00 FORMAT "%8.2" /end CHARACTERISTIC
/begin CHARACTERISTIC DFC_CtlMsk.DFC_ACEvpTSRCMax_C "Behaviour control mask / Behaviour control masks of check DFC_ACEvpTSRCMax" VALUE 0x804D8E24 Val_Wu16 65535.00 DFES_OneToOne 0.00 65535.00 FORMAT "%8.2" /end CHARACTERISTIC
/begin CHARACTERISTIC DFC_CtlMsk.DFC_ACEvpTSRCMin_C "Behaviour control mask / Behaviour control masks of check DFC_ACEvpTSRCMin" VALUE 0x804D8E26 Val_Wu16 65535.00 DFES_OneToOne 0.00 65535.00 FORMAT "%8.2" /end CHARACTERISTIC
/begin CHARACTERISTIC DFC_CtlMsk.DFC_AirCClntPAnaSRCMax_C "Behaviour control mask / Behaviour control masks of check DFC_AirCClntPAnaSRCMax" VALUE 0x804D8E28 Val_Wu16 65535.00 DFES_OneToOne 0.00 65535.00 FORMAT "%8.2" /end CHARACTERISTIC
/begin CHARACTERISTIC DFC_CtlMsk.DFC_AirCClntPAnaSRCMin_C "Behaviour control mask / Behaviour control masks of check DFC_AirCClntPAnaSRCMin" VALUE 0x804D8E2A Val_Wu16 65535.00 DFES_OneToOne 0.00 65535.00 FORMAT "%8.2" /end CHARACTERISTIC
/begin CHARACTERISTIC DFC_CtlMsk.DFC_AirCSwtNpl_C "Behaviour control mask / Behaviour control masks of check DFC_AirCSwtNpl" VALUE 0x804D8E2C Val_Wu16 65535.00 DFES_OneToOne 0.00 65535.00 FORMAT "%8.2" /end CHARACTERISTIC
/begin CHARACTERISTIC DFC_CtlMsk.DFC_AirCSwtSig_C "Behaviour control mask / Behaviour control masks of check DFC_AirCSwtSig" VALUE 0x804D8E2E Val_Wu16 65535.00 DFES_OneToOne 0.00 65535.00 FORMAT "%8.2" /end CHARACTERISTIC
/begin CHARACTERISTIC DFC_CtlMsk.DFC_Brk_C "Behaviour control mask / Behaviour control masks of check DFC_Brk" VALUE 0x804D8E30 Val_Wu16 65535.00 DFES_OneToOne 0.00 65535.00 FORMAT "%8.2" /end CHARACTERISTIC
/begin CHARACTERISTIC DFC_CtlMsk.DFC_BrkSig_C "Behaviour control mask / Behaviour control masks of check DFC_BrkSig" VALUE 0x804D8E32 Val_Wu16 65535.00 DFES_OneToOne 0.00 65535.00 FORMAT "%8.2" /end CHARACTERISTIC
/begin CHARACTERISTIC DFC_CtlMsk.DFC_ClthSig_C "Behaviour control mask / Behaviour control masks of check DFC_ClthSig" VALUE 0x804D8E34 Val_Wu16 65535.00 DFES_OneToOne 0.00 65535.00 FORMAT "%8.2" /end CHARACTERISTIC
/begin CHARACTERISTIC DFC_CtlMsk.DFC_HLSDemOvhtEngLim_C "Behaviour control mask / Behaviour control masks of check DFC_HLSDemOvhtEngLim" VALUE 0x804D8E36 Val_Wu16 65535.00 DFES_OneToOne 0.00 65535.00 FORMAT "%8.2" /end CHARACTERISTIC
/begin CHARACTERISTIC DFC_CtlMsk.DFC_OilPNpl_C "Behaviour control mask / Behaviour control masks of check DFC_OilPNpl" VALUE 0x804D8E38 Val_Wu16 65535.00 DFES_OneToOne 0.00 65535.00 FORMAT "%8.2" /end CHARACTERISTIC
/begin CHARACTERISTIC DFC_CtlMsk.DFC_PIntkVUsLineHiB1_C "Behaviour control mask / Behaviour control masks of check DFC_PIntkVUsLineHiB1" VALUE 0x804D8E3A Val_Wu16 65535.00 DFES_OneToOne 0.00 65535.00 FORMAT "%8.2" /end CHARACTERISTIC
/begin CHARACTERISTIC DFC_CtlMsk.DFC_PIntkVUsLineLoB1_C "Behaviour control mask / Behaviour control masks of check DFC_PIntkVUsLineLoB1" VALUE 0x804D8E3C Val_Wu16 65535.00 DFES_OneToOne 0.00 65535.00 FORMAT "%8.2" /end CHARACTERISTIC
/begin CHARACTERISTIC DFC_CtlMsk.DFC_VehVPhysRngLo_C "Behaviour control mask / Behaviour control masks of check DFC_VehVPhysRngLo" VALUE 0x804D8E3E Val_Wu16 65535.00 DFES_OneToOne 0.00 65535.00 FORMAT "%8.2" /end CHARACTERISTIC
/begin CHARACTERISTIC DFC_CtlMsk.DFC_VehVSigCan_C "Behaviour control mask / Behaviour control masks of check DFC_VehVSigCan" VALUE 0x804D8E40 Val_Wu16 65535.00 DFES_OneToOne 0.00 65535.00 FORMAT "%8.2" /end CHARACTERISTIC
/begin CHARACTERISTIC DFC_CtlMsk.DFC_VehVSigCanSafe_C "Behaviour control mask / Behaviour control masks of check DFC_VehVSigCanSafe" VALUE 0x804D8E42 Val_Wu16 65535.00 DFES_OneToOne 0.00 65535.00 FORMAT "%8.2" /end CHARACTERISTIC
/begin CHARACTERISTIC DFC_CtlMsk.DFC_VlvLftFbOilPSnsrIntk11SRCMax_C "Behaviour control mask / Behaviour control masks of check DFC_VlvLftFbOilPSnsrIntk11SRCMax" VALUE 0x804D8E44 Val_Wu16 65535.00 DFES_OneToOne 0.00 65535.00 FORMAT "%8.2" /end CHARACTERISTIC
/begin CHARACTERISTIC DFC_CtlMsk.DFC_VlvLftFbOilPSnsrIntk11SRCMin_C "Behaviour control mask / Behaviour control masks of check DFC_VlvLftFbOilPSnsrIntk11SRCMin" VALUE 0x804D8E46 Val_Wu16 65535.00 DFES_OneToOne 0.00 65535.00 FORMAT "%8.2" /end CHARACTERISTIC
/begin CHARACTERISTIC DFC_CtlMsk.DFC_ClthNpl_C "Behaviour control mask / Behaviour control masks of check DFC_ClthNpl" VALUE 0x804D8E48 Val_Wu16 65535.00 DFES_OneToOne 0.00 65535.00 FORMAT "%8.2" /end CHARACTERISTIC
/begin CHARACTERISTIC DFC_CtlMsk.DFC_EV1max_C "Behaviour control mask / Behaviour control masks of check DFC_EV1max" VALUE 0x804D8E4A Val_Wu16 65535.00 DFES_OneToOne 0.00 65535.00 FORMAT "%8.2" /end CHARACTERISTIC
/begin CHARACTERISTIC DFC_CtlMsk.DFC_EV1min_C "Behaviour control mask / Behaviour control masks of check DFC_EV1min" VALUE 0x804D8E4C Val_Wu16 65535.00 DFES_OneToOne 0.00 65535.00 FORMAT "%8.2" /end CHARACTERISTIC
/begin CHARACTERISTIC DFC_CtlMsk.DFC_EV1sig_C "Behaviour control mask / Behaviour control masks of check DFC_EV1sig" VALUE 0x804D8E4E Val_Wu16 65535.00 DFES_OneToOne 0.00 65535.00 FORMAT "%8.2" /end CHARACTERISTIC
/begin CHARACTERISTIC DFC_CtlMsk.DFC_EV2max_C "Behaviour control mask / Behaviour control masks of check DFC_EV2max" VALUE 0x804D8E50 Val_Wu16 65535.00 DFES_OneToOne 0.00 65535.00 FORMAT "%8.2" /end CHARACTERISTIC
/begin CHARACTERISTIC DFC_CtlMsk.DFC_EV2min_C "Behaviour control mask / Behaviour control masks of check DFC_EV2min" VALUE 0x804D8E52 Val_Wu16 65535.00 DFES_OneToOne 0.00 65535.00 FORMAT "%8.2" /end CHARACTERISTIC
/begin CHARACTERISTIC DFC_CtlMsk.DFC_EV2sig_C "Behaviour control mask / Behaviour control masks of check DFC_EV2sig" VALUE 0x804D8E54 Val_Wu16 65535.00 DFES_OneToOne 0.00 65535.00 FORMAT "%8.2" /end CHARACTERISTIC
/begin CHARACTERISTIC DFC_CtlMsk.DFC_EV3max_C "Behaviour control mask / Behaviour control masks of check DFC_EV3max" VALUE 0x804D8E56 Val_Wu16 65535.00 DFES_OneToOne 0.00 65535.00 FORMAT "%8.2" /end CHARACTERISTIC
/begin CHARACTERISTIC DFC_CtlMsk.DFC_EV3min_C "Behaviour control mask / Behaviour control masks of check DFC_EV3min" VALUE 0x804D8E58 Val_Wu16 65535.00 DFES_OneToOne 0.00 65535.00 FORMAT "%8.2" /end CHARACTERISTIC
/begin CHARACTERISTIC DFC_CtlMsk.DFC_EV3sig_C "Behaviour control mask / Behaviour control masks of check DFC_EV3sig" VALUE 0x804D8E5A Val_Wu16 65535.00 DFES_OneToOne 0.00 65535.00 FORMAT "%8.2" /end CHARACTERISTIC
/begin CHARACTERISTIC DFC_CtlMsk.DFC_EV4max_C "Behaviour control mask / Behaviour control masks of check DFC_EV4max" VALUE 0x804D8E5C Val_Wu16 65535.00 DFES_OneToOne 0.00 65535.00 FORMAT "%8.2" /end CHARACTERISTIC
/begin CHARACTERISTIC DFC_CtlMsk.DFC_EV4min_C "Behaviour control mask / Behaviour control masks of check DFC_EV4min" VALUE 0x804D8E5E Val_Wu16 65535.00 DFES_OneToOne 0.00 65535.00 FORMAT "%8.2" /end CHARACTERISTIC
/begin CHARACTERISTIC DFC_CtlMsk.DFC_EV4sig_C "Behaviour control mask / Behaviour control masks of check DFC_EV4sig" VALUE 0x804D8E60 Val_Wu16 65535.00 DFES_OneToOne 0.00 65535.00 FORMAT "%8.2" /end CHARACTERISTIC
/begin CHARACTERISTIC DFC_CtlMsk.DFC_GbxPNPosnDrvCdn_C "Behaviour control mask / Behaviour control masks of check DFC_GbxPNPosnDrvCdn" VALUE 0x804D8E62 Val_Wu16 65535.00 DFES_OneToOne 0.00 65535.00 FORMAT "%8.2" /end CHARACTERISTIC
/begin CHARACTERISTIC DFC_CtlMsk.DFC_GbxPNPosnPlausy_C "Behaviour control mask / Behaviour control masks of check DFC_GbxPNPosnPlausy" VALUE 0x804D8E64 Val_Wu16 65535.00 DFES_OneToOne 0.00 65535.00 FORMAT "%8.2" /end CHARACTERISTIC
/begin CHARACTERISTIC DFC_CtlMsk.DFC_PEnvCcMax_C "Behaviour control mask / Behaviour control masks of check DFC_PEnvCcMax" VALUE 0x804D8E66 Val_Wu16 65535.00 DFES_OneToOne 0.00 65535.00 FORMAT "%8.2" /end CHARACTERISTIC
/begin CHARACTERISTIC DFC_CtlMsk.DFC_PEnvCcMin_C "Behaviour control mask / Behaviour control masks of check DFC_PEnvCcMin" VALUE 0x804D8E68 Val_Wu16 65535.00 DFES_OneToOne 0.00 65535.00 FORMAT "%8.2" /end CHARACTERISTIC
/begin CHARACTERISTIC DFC_CtlMsk.DFC_PEnvRngChkMax_C "Behaviour control mask / Behaviour control masks of check DFC_PEnvRngChkMax" VALUE 0x804D8E6A Val_Wu16 65535.00 DFES_OneToOne 0.00 65535.00 FORMAT "%8.2" /end CHARACTERISTIC
/begin CHARACTERISTIC DFC_CtlMsk.DFC_PEnvRngChkMin_C "Behaviour control mask / Behaviour control masks of check DFC_PEnvRngChkMin" VALUE 0x804D8E6C Val_Wu16 65535.00 DFES_OneToOne 0.00 65535.00 FORMAT "%8.2" /end CHARACTERISTIC
/begin CHARACTERISTIC DFC_CtlMsk.DFC_PEnvSnsrPlaus_C "Behaviour control mask / Behaviour control masks of check DFC_PEnvSnsrPlaus" VALUE 0x804D8E6E Val_Wu16 65535.00 DFES_OneToOne 0.00 65535.00 FORMAT "%8.2" /end CHARACTERISTIC
/begin CHARACTERISTIC DFC_CtlMsk.DFC_UEGOHeatrPsS1B1Max_C "Behaviour control mask / Behaviour control masks of check DFC_UEGOHeatrPsS1B1Max" VALUE 0x804D8E70 Val_Wu16 65535.00 DFES_OneToOne 0.00 65535.00 FORMAT "%8.2" /end CHARACTERISTIC
/begin CHARACTERISTIC DFC_CtlMsk.DFC_UEGOHeatrPsS1B1Min_C "Behaviour control mask / Behaviour control masks of check DFC_UEGOHeatrPsS1B1Min" VALUE 0x804D8E72 Val_Wu16 65535.00 DFES_OneToOne 0.00 65535.00 FORMAT "%8.2" /end CHARACTERISTIC
/begin CHARACTERISTIC DFC_CtlMsk.DFC_UEGOHeatrPsS1B1Sig_C "Behaviour control mask / Behaviour control masks of check DFC_UEGOHeatrPsS1B1Sig" VALUE 0x804D8E74 Val_Wu16 65535.00 DFES_OneToOne 0.00 65535.00 FORMAT "%8.2" /end CHARACTERISTIC
/begin CHARACTERISTIC DFC_CtlMsk.DFC_UEGOHeatrRlyPsOLS1B1_C "Behaviour control mask / Behaviour control masks of check DFC_UEGOHeatrRlyPsOLS1B1" VALUE 0x804D8E76 Val_Wu16 65535.00 DFES_OneToOne 0.00 65535.00 FORMAT "%8.2" /end CHARACTERISTIC
/begin CHARACTERISTIC DFC_CtlMsk.DFC_UEGOHeatrRlyPsSCBS1B1_C "Behaviour control mask / Behaviour control masks of check DFC_UEGOHeatrRlyPsSCBS1B1" VALUE 0x804D8E78 Val_Wu16 65535.00 DFES_OneToOne 0.00 65535.00 FORMAT "%8.2" /end CHARACTERISTIC
/begin CHARACTERISTIC DFC_CtlMsk.DFC_UEGOHeatrRlyPsSCGS1B1_C "Behaviour control mask / Behaviour control masks of check DFC_UEGOHeatrRlyPsSCGS1B1" VALUE 0x804D8E7A Val_Wu16 65535.00 DFES_OneToOne 0.00 65535.00 FORMAT "%8.2" /end CHARACTERISTIC
/begin CHARACTERISTIC DFC_CtlMsk.DFC_KnDetSens1PortAMax_C "Behaviour control mask / Behaviour control masks of check DFC_KnDetSens1PortAMax" VALUE 0x804D8E7C Val_Wu16 65535.00 DFES_OneToOne 0.00 65535.00 FORMAT "%8.2" /end CHARACTERISTIC
/begin CHARACTERISTIC DFC_CtlMsk.DFC_KnDetSens1PortAMin_C "Behaviour control mask / Behaviour control masks of check DFC_KnDetSens1PortAMin" VALUE 0x804D8E7E Val_Wu16 65535.00 DFES_OneToOne 0.00 65535.00 FORMAT "%8.2" /end CHARACTERISTIC
/begin CHARACTERISTIC DFC_CtlMsk.DFC_KnDetSens1PortBMax_C "Behaviour control mask / Behaviour control masks of check DFC_KnDetSens1PortBMax" VALUE 0x804D8E80 Val_Wu16 65535.00 DFES_OneToOne 0.00 65535.00 FORMAT "%8.2" /end CHARACTERISTIC
/begin CHARACTERISTIC DFC_CtlMsk.DFC_KnDetSens1PortBMin_C "Behaviour control mask / Behaviour control masks of check DFC_KnDetSens1PortBMin" VALUE 0x804D8E82 Val_Wu16 65535.00 DFES_OneToOne 0.00 65535.00 FORMAT "%8.2" /end CHARACTERISTIC
/begin CHARACTERISTIC DFC_CtlMsk.DFC_Clth2ONStuck_C "Behaviour control mask / Behaviour control masks of check DFC_Clth2ONStuck" VALUE 0x804D8E84 Val_Wu16 65535.00 DFES_OneToOne 0.00 65535.00 FORMAT "%8.2" /end CHARACTERISTIC
/begin CHARACTERISTIC DFC_CtlMsk.DFC_Clth2ONStuckLdc_C "Behaviour control mask / Behaviour control masks of check DFC_Clth2ONStuckLdc" VALUE 0x804D8E86 Val_Wu16 65535.00 DFES_OneToOne 0.00 65535.00 FORMAT "%8.2" /end CHARACTERISTIC
/begin CHARACTERISTIC DFC_CtlMsk.DFC_Clth3ONStuckLdc_C "Behaviour control mask / Behaviour control masks of check DFC_Clth3ONStuckLdc" VALUE 0x804D8E88 Val_Wu16 65535.00 DFES_OneToOne 0.00 65535.00 FORMAT "%8.2" /end CHARACTERISTIC
/begin CHARACTERISTIC DFC_CtlMsk.DFC_Clth3ONStuckPostDrv_C "Behaviour control mask / Behaviour control masks of check DFC_Clth3ONStuckPostDrv" VALUE 0x804D8E8A Val_Wu16 65535.00 DFES_OneToOne 0.00 65535.00 FORMAT "%8.2" /end CHARACTERISTIC
/begin CHARACTERISTIC DFC_CtlMsk.DFC_Clth4ONStuck_C "Behaviour control mask / Behaviour control masks of check DFC_Clth4ONStuck" VALUE 0x804D8E8C Val_Wu16 65535.00 DFES_OneToOne 0.00 65535.00 FORMAT "%8.2" /end CHARACTERISTIC
/begin CHARACTERISTIC DFC_CtlMsk.DFC_Clth4ONStuckLdc_C "Behaviour control mask / Behaviour control masks of check DFC_Clth4ONStuckLdc" VALUE 0x804D8E8E Val_Wu16 65535.00 DFES_OneToOne 0.00 65535.00 FORMAT "%8.2" /end CHARACTERISTIC
/begin CHARACTERISTIC DFC_CtlMsk.DFC_ComDLCTCU01_C "Behaviour control mask / Behaviour control masks of check DFC_ComDLCTCU01" VALUE 0x804D8E90 Val_Wu16 65535.00 DFES_OneToOne 0.00 65535.00 FORMAT "%8.2" /end CHARACTERISTIC
/begin CHARACTERISTIC DFC_CtlMsk.DFC_ComDLCTCU02_C "Behaviour control mask / Behaviour control masks of check DFC_ComDLCTCU02" VALUE 0x804D8E92 Val_Wu16 65535.00 DFES_OneToOne 0.00 65535.00 FORMAT "%8.2" /end CHARACTERISTIC
/begin CHARACTERISTIC DFC_CtlMsk.DFC_ComDLCTCU1_C "Behaviour control mask / Behaviour control masks of check DFC_ComDLCTCU1" VALUE 0x804D8E94 Val_Wu16 65535.00 DFES_OneToOne 0.00 65535.00 FORMAT "%8.2" /end CHARACTERISTIC
/begin CHARACTERISTIC DFC_CtlMsk.DFC_ComDLCTCU11_C "Behaviour control mask / Behaviour control masks of check DFC_ComDLCTCU11" VALUE 0x804D8E96 Val_Wu16 65535.00 DFES_OneToOne 0.00 65535.00 FORMAT "%8.2" /end CHARACTERISTIC
/begin CHARACTERISTIC DFC_CtlMsk.DFC_ComDLCTCU12_C "Behaviour control mask / Behaviour control masks of check DFC_ComDLCTCU12" VALUE 0x804D8E98 Val_Wu16 65535.00 DFES_OneToOne 0.00 65535.00 FORMAT "%8.2" /end CHARACTERISTIC
/begin CHARACTERISTIC DFC_CtlMsk.DFC_ComDLCTCU13_C "Behaviour control mask / Behaviour control masks of check DFC_ComDLCTCU13" VALUE 0x804D8E9A Val_Wu16 65535.00 DFES_OneToOne 0.00 65535.00 FORMAT "%8.2" /end CHARACTERISTIC
/begin CHARACTERISTIC DFC_CtlMsk.DFC_ComDLCTCU14_C "Behaviour control mask / Behaviour control masks of check DFC_ComDLCTCU14" VALUE 0x804D8E9C Val_Wu16 65535.00 DFES_OneToOne 0.00 65535.00 FORMAT "%8.2" /end CHARACTERISTIC
/begin CHARACTERISTIC DFC_CtlMsk.DFC_ComDLCTCU2_C "Behaviour control mask / Behaviour control masks of check DFC_ComDLCTCU2" VALUE 0x804D8E9E Val_Wu16 65535.00 DFES_OneToOne 0.00 65535.00 FORMAT "%8.2" /end CHARACTERISTIC
/begin CHARACTERISTIC DFC_CtlMsk.DFC_ComDLCTCU3_C "Behaviour control mask / Behaviour control masks of check DFC_ComDLCTCU3" VALUE 0x804D8EA0 Val_Wu16 65535.00 DFES_OneToOne 0.00 65535.00 FORMAT "%8.2" /end CHARACTERISTIC
/begin CHARACTERISTIC DFC_CtlMsk.DFC_ComDLCTCU4_C "Behaviour control mask / Behaviour control masks of check DFC_ComDLCTCU4" VALUE 0x804D8EA2 Val_Wu16 65535.00 DFES_OneToOne 0.00 65535.00 FORMAT "%8.2" /end CHARACTERISTIC
/begin CHARACTERISTIC DFC_CtlMsk.DFC_EVX_C "Behaviour control mask / Behaviour control masks of check DFC_EVX" VALUE 0x804D8EA4 Val_Wu16 65535.00 DFES_OneToOne 0.00 65535.00 FORMAT "%8.2" /end CHARACTERISTIC
/begin CHARACTERISTIC DFC_CtlMsk.DFC_EbsSocFlt_C "Behaviour control mask / Behaviour control masks of check DFC_EbsSocFlt" VALUE 0x804D8EA6 Val_Wu16 65535.00 DFES_OneToOne 0.00 65535.00 FORMAT "%8.2" /end CHARACTERISTIC
/begin CHARACTERISTIC DFC_CtlMsk.DFC_I14229VINErr_C "Behaviour control mask / Behaviour control masks of check DFC_I14229VINErr" VALUE 0x804D8EA8 Val_Wu16 65535.00 DFES_OneToOne 0.00 65535.00 FORMAT "%8.2" /end CHARACTERISTIC
/begin CHARACTERISTIC DFC_CtlMsk.DFC_LLRKHmax_C "Behaviour control mask / Behaviour control masks of check DFC_LLRKHmax" VALUE 0x804D8EAA Val_Wu16 65535.00 DFES_OneToOne 0.00 65535.00 FORMAT "%8.2" /end CHARACTERISTIC
/begin CHARACTERISTIC DFC_CtlMsk.DFC_LLRKHmin_C "Behaviour control mask / Behaviour control masks of check DFC_LLRKHmin" VALUE 0x804D8EAC Val_Wu16 65535.00 DFES_OneToOne 0.00 65535.00 FORMAT "%8.2" /end CHARACTERISTIC
/begin CHARACTERISTIC DFC_CtlMsk.DFC_LLRmax_C "Behaviour control mask / Behaviour control masks of check DFC_LLRmax" VALUE 0x804D8EAE Val_Wu16 65535.00 DFES_OneToOne 0.00 65535.00 FORMAT "%8.2" /end CHARACTERISTIC
/begin CHARACTERISTIC DFC_CtlMsk.DFC_LLRmin_C "Behaviour control mask / Behaviour control masks of check DFC_LLRmin" VALUE 0x804D8EB0 Val_Wu16 65535.00 DFES_OneToOne 0.00 65535.00 FORMAT "%8.2" /end CHARACTERISTIC
/begin CHARACTERISTIC DFC_CtlMsk.DFC_RoughRoad_C "Behaviour control mask / Behaviour control masks of check DFC_RoughRoad" VALUE 0x804D8EB2 Val_Wu16 65535.00 DFES_OneToOne 0.00 65535.00 FORMAT "%8.2" /end CHARACTERISTIC
/begin CHARACTERISTIC DFC_CtlMsk.DFC_SiaEEPRdErr_C "Behaviour control mask / Behaviour control masks of check DFC_SiaEEPRdErr" VALUE 0x804D8EB4 Val_Wu16 65535.00 DFES_OneToOne 0.00 65535.00 FORMAT "%8.2" /end CHARACTERISTIC
/begin CHARACTERISTIC DFC_CtlMsk.DFC_SiaEEPWrngCod_C "Behaviour control mask / Behaviour control masks of check DFC_SiaEEPWrngCod" VALUE 0x804D8EB6 Val_Wu16 65535.00 DFES_OneToOne 0.00 65535.00 FORMAT "%8.2" /end CHARACTERISTIC
/begin CHARACTERISTIC DFC_CtlMsk.DFC_UegoDummy_C "Behaviour control mask / Behaviour control masks of check DFC_UegoDummy" VALUE 0x804D8EB8 Val_Wu16 65535.00 DFES_OneToOne 0.00 65535.00 FORMAT "%8.2" /end CHARACTERISTIC
/begin CHARACTERISTIC DFC_CtlMsk.DFC_BusDiagCANAPPLBusOff_C "Behaviour control mask / Behaviour control masks of check DFC_BusDiagCANAPPLBusOff" VALUE 0x804D8EBA Val_Wu16 65535.00 DFES_OneToOne 0.00 65535.00 FORMAT "%8.2" /end CHARACTERISTIC
/begin CHARACTERISTIC DFC_CtlMsk.DFC_BusDiagCANCANCBusOff_C "Behaviour control mask / Behaviour control masks of check DFC_BusDiagCANCANCBusOff" VALUE 0x804D8EBC Val_Wu16 65535.00 DFES_OneToOne 0.00 65535.00 FORMAT "%8.2" /end CHARACTERISTIC
/begin CHARACTERISTIC DFC_CtlMsk.DFC_BusDiagCANVEHICLEBusOff_C "Behaviour control mask / Behaviour control masks of check DFC_BusDiagCANVEHICLEBusOff" VALUE 0x804D8EBE Val_Wu16 65535.00 DFES_OneToOne 0.00 65535.00 FORMAT "%8.2" /end CHARACTERISTIC
/begin CHARACTERISTIC DFC_CtlMsk.DFC_RBA_IODIAGPWR_rba_IoExtCy329_SignalVltSply_0_C "Behaviour control mask / Behaviour control masks of check DFC_RBA_IODIAGPWR_rba_IoExtCy329_SignalVltSply_0" VALUE 0x804D8EC0 Val_Wu16 65535.00 DFES_OneToOne 0.00 65535.00 FORMAT "%8.2" /end CHARACTERISTIC
/begin CHARACTERISTIC DFC_CtlMsk.DFC_RBA_IODIAGPWR_rba_IoExtCy329_SignalVltSply_0OT_C "Behaviour control mask / Behaviour control masks of check DFC_RBA_IODIAGPWR_rba_IoExtCy329_SignalVltSply_0OT" VALUE 0x804D8EC2 Val_Wu16 65535.00 DFES_OneToOne 0.00 65535.00 FORMAT "%8.2" /end CHARACTERISTIC
/begin CHARACTERISTIC DFC_CtlMsk.DFC_RBA_IODIAGPWR_rba_IoExtCy329_SignalVltSply_0OV_C "Behaviour control mask / Behaviour control masks of check DFC_RBA_IODIAGPWR_rba_IoExtCy329_SignalVltSply_0OV" VALUE 0x804D8EC4 Val_Wu16 65535.00 DFES_OneToOne 0.00 65535.00 FORMAT "%8.2" /end CHARACTERISTIC
/begin CHARACTERISTIC DFC_CtlMsk.DFC_RBA_IODIAGPWR_rba_IoExtCy329_SignalVltSply_0SCG_C "Behaviour control mask / Behaviour control masks of check DFC_RBA_IODIAGPWR_rba_IoExtCy329_SignalVltSply_0SCG" VALUE 0x804D8EC6 Val_Wu16 65535.00 DFES_OneToOne 0.00 65535.00 FORMAT "%8.2" /end CHARACTERISTIC
/begin CHARACTERISTIC DFC_CtlMsk.DFC_RBA_IODIAGPWR_rba_IoExtCy329_SignalVltSply_0UV_C "Behaviour control mask / Behaviour control masks of check DFC_RBA_IODIAGPWR_rba_IoExtCy329_SignalVltSply_0UV" VALUE 0x804D8EC8 Val_Wu16 65535.00 DFES_OneToOne 0.00 65535.00 FORMAT "%8.2" /end CHARACTERISTIC
/begin CHARACTERISTIC DFC_CtlMsk.DFC_RBA_IODIAGPWR_rba_IoExtCy329_SignalVltSply_1_C "Behaviour control mask / Behaviour control masks of check DFC_RBA_IODIAGPWR_rba_IoExtCy329_SignalVltSply_1" VALUE 0x804D8ECA Val_Wu16 65535.00 DFES_OneToOne 0.00 65535.00 FORMAT "%8.2" /end CHARACTERISTIC
/begin CHARACTERISTIC DFC_CtlMsk.DFC_RBA_IODIAGPWR_rba_IoExtCy329_SignalVltSply_1OT_C "Behaviour control mask / Behaviour control masks of check DFC_RBA_IODIAGPWR_rba_IoExtCy329_SignalVltSply_1OT" VALUE 0x804D8ECC Val_Wu16 65535.00 DFES_OneToOne 0.00 65535.00 FORMAT "%8.2" /end CHARACTERISTIC
/begin CHARACTERISTIC DFC_CtlMsk.DFC_RBA_IODIAGPWR_rba_IoExtCy329_SignalVltSply_1OV_C "Behaviour control mask / Behaviour control masks of check DFC_RBA_IODIAGPWR_rba_IoExtCy329_SignalVltSply_1OV" VALUE 0x804D8ECE Val_Wu16 65535.00 DFES_OneToOne 0.00 65535.00 FORMAT "%8.2" /end CHARACTERISTIC
/begin CHARACTERISTIC DFC_CtlMsk.DFC_RBA_IODIAGPWR_rba_IoExtCy329_SignalVltSply_1SCG_C "Behaviour control mask / Behaviour control masks of check DFC_RBA_IODIAGPWR_rba_IoExtCy329_SignalVltSply_1SCG" VALUE 0x804D8ED0 Val_Wu16 65535.00 DFES_OneToOne 0.00 65535.00 FORMAT "%8.2" /end CHARACTERISTIC
/begin CHARACTERISTIC DFC_CtlMsk.DFC_RBA_IODIAGPWR_rba_IoExtCy329_SignalVltSply_1UV_C "Behaviour control mask / Behaviour control masks of check DFC_RBA_IODIAGPWR_rba_IoExtCy329_SignalVltSply_1UV" VALUE 0x804D8ED2 Val_Wu16 65535.00 DFES_OneToOne 0.00 65535.00 FORMAT "%8.2" /end CHARACTERISTIC
/begin CHARACTERISTIC DFC_CtlMsk.DFC_RBA_IODIAGPWR_rba_IoExtCy329_SignalVltSply_2_C "Behaviour control mask / Behaviour control masks of check DFC_RBA_IODIAGPWR_rba_IoExtCy329_SignalVltSply_2" VALUE 0x804D8ED4 Val_Wu16 65535.00 DFES_OneToOne 0.00 65535.00 FORMAT "%8.2" /end CHARACTERISTIC
/begin CHARACTERISTIC DFC_CtlMsk.DFC_RBA_IODIAGPWR_rba_IoExtCy329_SignalVltSply_2OT_C "Behaviour control mask / Behaviour control masks of check DFC_RBA_IODIAGPWR_rba_IoExtCy329_SignalVltSply_2OT" VALUE 0x804D8ED6 Val_Wu16 65535.00 DFES_OneToOne 0.00 65535.00 FORMAT "%8.2" /end CHARACTERISTIC
/begin CHARACTERISTIC DFC_CtlMsk.DFC_RBA_IODIAGPWR_rba_IoExtCy329_SignalVltSply_2OV_C "Behaviour control mask / Behaviour control masks of check DFC_RBA_IODIAGPWR_rba_IoExtCy329_SignalVltSply_2OV" VALUE 0x804D8ED8 Val_Wu16 65535.00 DFES_OneToOne 0.00 65535.00 FORMAT "%8.2" /end CHARACTERISTIC
/begin CHARACTERISTIC DFC_CtlMsk.DFC_RBA_IODIAGPWR_rba_IoExtCy329_SignalVltSply_2SCG_C "Behaviour control mask / Behaviour control masks of check DFC_RBA_IODIAGPWR_rba_IoExtCy329_SignalVltSply_2SCG" VALUE 0x804D8EDA Val_Wu16 65535.00 DFES_OneToOne 0.00 65535.00 FORMAT "%8.2" /end CHARACTERISTIC
/begin CHARACTERISTIC DFC_CtlMsk.DFC_RBA_IODIAGPWR_rba_IoExtCy329_SignalVltSply_2UV_C "Behaviour control mask / Behaviour control masks of check DFC_RBA_IODIAGPWR_rba_IoExtCy329_SignalVltSply_2UV" VALUE 0x804D8EDC Val_Wu16 65535.00 DFES_OneToOne 0.00 65535.00 FORMAT "%8.2" /end CHARACTERISTIC
/begin CHARACTERISTIC DFC_CtlMsk.DFC_CAN_E_TIMEOUT_C "Behaviour control mask / Behaviour control masks of check DFC_CAN_E_TIMEOUT" VALUE 0x804D8EDE Val_Wu16 65535.00 DFES_OneToOne 0.00 65535.00 FORMAT "%8.2" /end CHARACTERISTIC
/begin CHARACTERISTIC DFC_CtlMsk.DFC_LIN_E_TIMEOUT_C "Behaviour control mask / Behaviour control masks of check DFC_LIN_E_TIMEOUT" VALUE 0x804D8EE0 Val_Wu16 65535.00 DFES_OneToOne 0.00 65535.00 FORMAT "%8.2" /end CHARACTERISTIC
/begin CHARACTERISTIC DFC_CtlMsk.DFC_MRlyOL_C "Behaviour control mask / Behaviour control masks of check DFC_MRlyOL" VALUE 0x804D8EE2 Val_Wu16 65535.00 DFES_OneToOne 0.00 65535.00 FORMAT "%8.2" /end CHARACTERISTIC
/begin CHARACTERISTIC DFC_CtlMsk.DFC_MRlySCB_C "Behaviour control mask / Behaviour control masks of check DFC_MRlySCB" VALUE 0x804D8EE4 Val_Wu16 65535.00 DFES_OneToOne 0.00 65535.00 FORMAT "%8.2" /end CHARACTERISTIC
/begin CHARACTERISTIC DFC_CtlMsk.DFC_MRlySCG_C "Behaviour control mask / Behaviour control masks of check DFC_MRlySCG" VALUE 0x804D8EE6 Val_Wu16 65535.00 DFES_OneToOne 0.00 65535.00 FORMAT "%8.2" /end CHARACTERISTIC
/begin CHARACTERISTIC DFC_CtlMsk.DFC_rba_MultiStackTrace_Threshold_C "Behaviour control mask / Behaviour control masks of check DFC_rba_MultiStackTrace_Threshold" VALUE 0x804D8EE8 Val_Wu16 65535.00 DFES_OneToOne 0.00 65535.00 FORMAT "%8.2" /end CHARACTERISTIC
/begin CHARACTERISTIC DFC_CtlMsk.DFC_BSWM_E_ACTION_FAILED_C "Behaviour control mask / Behaviour control masks of check DFC_BSWM_E_ACTION_FAILED" VALUE 0x804D8EEA Val_Wu16 65535.00 DFES_OneToOne 0.00 65535.00 FORMAT "%8.2" /end CHARACTERISTIC
/begin CHARACTERISTIC DFC_CtlMsk.DFC_BSWM_E_INTRPTQUEUE_FULL_C "Behaviour control mask / Behaviour control masks of check DFC_BSWM_E_INTRPTQUEUE_FULL" VALUE 0x804D8EEC Val_Wu16 65535.00 DFES_OneToOne 0.00 65535.00 FORMAT "%8.2" /end CHARACTERISTIC
/begin CHARACTERISTIC DFC_CtlMsk.DFC_RBA_IOEXTLIB_KEEPALIVE_DRV_C "Behaviour control mask / Behaviour control masks of check DFC_RBA_IOEXTLIB_KEEPALIVE_DRV" VALUE 0x804D8EEE Val_Wu16 65535.00 DFES_OneToOne 0.00 65535.00 FORMAT "%8.2" /end CHARACTERISTIC
/begin CHARACTERISTIC DFC_CtlMsk.DFC_RBA_IOEXTLIB_KEEPALIVE_INI_C "Behaviour control mask / Behaviour control masks of check DFC_RBA_IOEXTLIB_KEEPALIVE_INI" VALUE 0x804D8EF0 Val_Wu16 65535.00 DFES_OneToOne 0.00 65535.00 FORMAT "%8.2" /end CHARACTERISTIC
/begin CHARACTERISTIC DFC_CtlMsk.DFC_rba_IoSigRtc_StopCounter_C "Behaviour control mask / Behaviour control masks of check DFC_rba_IoSigRtc_StopCounter" VALUE 0x804D8EF2 Val_Wu16 65535.00 DFES_OneToOne 0.00 65535.00 FORMAT "%8.2" /end CHARACTERISTIC
/begin CHARACTERISTIC DFC_CtlMsk.DFC_rba_MRly_Diag_Stk_Event_C "Behaviour control mask / Behaviour control masks of check DFC_rba_MRly_Diag_Stk_Event" VALUE 0x804D8EF4 Val_Wu16 65535.00 DFES_OneToOne 0.00 65535.00 FORMAT "%8.2" /end CHARACTERISTIC
/begin CHARACTERISTIC DFC_CtlMsk.DFC_rba_MemDiag_MemReadErr_C "Behaviour control mask / Behaviour control masks of check DFC_rba_MemDiag_MemReadErr" VALUE 0x804D8EF6 Val_Wu16 65535.00 DFES_OneToOne 0.00 65535.00 FORMAT "%8.2" /end CHARACTERISTIC
/begin CHARACTERISTIC DFC_CtlMsk.DFC_rba_MemDiag_MemWrErr_C "Behaviour control mask / Behaviour control masks of check DFC_rba_MemDiag_MemWrErr" VALUE 0x804D8EF8 Val_Wu16 65535.00 DFES_OneToOne 0.00 65535.00 FORMAT "%8.2" /end CHARACTERISTIC
/begin CHARACTERISTIC DFC_CtlMsk.DFC_rba_SyC_IrrSwOffTrigEngRun_Event_C "Behaviour control mask / Behaviour control masks of check DFC_rba_SyC_IrrSwOffTrigEngRun_Event" VALUE 0x804D8EFA Val_Wu16 65535.00 DFES_OneToOne 0.00 65535.00 FORMAT "%8.2" /end CHARACTERISTIC
/begin CHARACTERISTIC DFC_CtlMsk.DFC_rba_T15_Diag_ComInVld_Event_C "Behaviour control mask / Behaviour control masks of check DFC_rba_T15_Diag_ComInVld_Event" VALUE 0x804D8EFC Val_Wu16 65535.00 DFES_OneToOne 0.00 65535.00 FORMAT "%8.2" /end CHARACTERISTIC
/begin CHARACTERISTIC DFC_CtlMsk.DFC_rba_T15_Diag_ComOff_HwOn_Event_C "Behaviour control mask / Behaviour control masks of check DFC_rba_T15_Diag_ComOff_HwOn_Event" VALUE 0x804D8EFE Val_Wu16 65535.00 DFES_OneToOne 0.00 65535.00 FORMAT "%8.2" /end CHARACTERISTIC
/begin CHARACTERISTIC DFC_CtlMsk.DFC_rba_T15_Diag_ComOn_HwOff_Event_C "Behaviour control mask / Behaviour control masks of check DFC_rba_T15_Diag_ComOn_HwOff_Event" VALUE 0x804D8F00 Val_Wu16 65535.00 DFES_OneToOne 0.00 65535.00 FORMAT "%8.2" /end CHARACTERISTIC
/begin CHARACTERISTIC DFC_CtlMsk.DFC_AppAllSnsrDfct_C "Behaviour control mask / Behaviour control masks of check DFC_AppAllSnsrDfct" VALUE 0x804D8F02 Val_Wu16 65535.00 DFES_OneToOne 0.00 65535.00 FORMAT "%8.2" /end CHARACTERISTIC
/begin CHARACTERISTIC DFC_CtlMsk.DFC_BattUStdbyDiaOL_C "Behaviour control mask / Behaviour control masks of check DFC_BattUStdbyDiaOL" VALUE 0x804D8F04 Val_Wu16 65535.00 DFES_OneToOne 0.00 65535.00 FORMAT "%8.2" /end CHARACTERISTIC
/begin CHARACTERISTIC DFC_CtlMsk.DFC_BigLeakIntkMnfldEmiInfl_C "Behaviour control mask / Behaviour control masks of check DFC_BigLeakIntkMnfldEmiInfl" VALUE 0x804D8F06 Val_Wu16 65535.00 DFES_OneToOne 0.00 65535.00 FORMAT "%8.2" /end CHARACTERISTIC
/begin CHARACTERISTIC DFC_CtlMsk.DFC_BrkMnSwtContOnWarnLmp_C "Behaviour control mask / Behaviour control masks of check DFC_BrkMnSwtContOnWarnLmp" VALUE 0x804D8F08 Val_Wu16 65535.00 DFES_OneToOne 0.00 65535.00 FORMAT "%8.2" /end CHARACTERISTIC
/begin CHARACTERISTIC DFC_CtlMsk.DFC_BrkMnSwtNotStpWarnLmp_C "Behaviour control mask / Behaviour control masks of check DFC_BrkMnSwtNotStpWarnLmp" VALUE 0x804D8F0A Val_Wu16 65535.00 DFES_OneToOne 0.00 65535.00 FORMAT "%8.2" /end CHARACTERISTIC
/begin CHARACTERISTIC DFC_CtlMsk.DFC_BrkRdntSwtContOnWarnLmp_C "Behaviour control mask / Behaviour control masks of check DFC_BrkRdntSwtContOnWarnLmp" VALUE 0x804D8F0C Val_Wu16 65535.00 DFES_OneToOne 0.00 65535.00 FORMAT "%8.2" /end CHARACTERISTIC
/begin CHARACTERISTIC DFC_CtlMsk.DFC_BrkRdntSwtNotStpWarnLmp_C "Behaviour control mask / Behaviour control masks of check DFC_BrkRdntSwtNotStpWarnLmp" VALUE 0x804D8F0E Val_Wu16 65535.00 DFES_OneToOne 0.00 65535.00 FORMAT "%8.2" /end CHARACTERISTIC
/begin CHARACTERISTIC DFC_CtlMsk.DFC_CEngDsTColdStrtMax_C "Behaviour control mask / Behaviour control masks of check DFC_CEngDsTColdStrtMax" VALUE 0x804D8F10 Val_Wu16 65535.00 DFES_OneToOne 0.00 65535.00 FORMAT "%8.2" /end CHARACTERISTIC
/begin CHARACTERISTIC DFC_CtlMsk.DFC_CEngDsTColdStrtMin_C "Behaviour control mask / Behaviour control masks of check DFC_CEngDsTColdStrtMin" VALUE 0x804D8F12 Val_Wu16 65535.00 DFES_OneToOne 0.00 65535.00 FORMAT "%8.2" /end CHARACTERISTIC
/begin CHARACTERISTIC DFC_CtlMsk.DFC_CEngDsTImps_C "Behaviour control mask / Behaviour control masks of check DFC_CEngDsTImps" VALUE 0x804D8F14 Val_Wu16 65535.00 DFES_OneToOne 0.00 65535.00 FORMAT "%8.2" /end CHARACTERISTIC
/begin CHARACTERISTIC DFC_CtlMsk.DFC_CEngDsTPlausLSC_C "Behaviour control mask / Behaviour control masks of check DFC_CEngDsTPlausLSC" VALUE 0x804D8F16 Val_Wu16 65535.00 DFES_OneToOne 0.00 65535.00 FORMAT "%8.2" /end CHARACTERISTIC
/begin CHARACTERISTIC DFC_CtlMsk.DFC_CEngDsTPlausSTC_C "Behaviour control mask / Behaviour control masks of check DFC_CEngDsTPlausSTC" VALUE 0x804D8F18 Val_Wu16 65535.00 DFES_OneToOne 0.00 65535.00 FORMAT "%8.2" /end CHARACTERISTIC
/begin CHARACTERISTIC DFC_CtlMsk.DFC_CEngDsTSRCMax_C "Behaviour control mask / Behaviour control masks of check DFC_CEngDsTSRCMax" VALUE 0x804D8F1A Val_Wu16 65535.00 DFES_OneToOne 0.00 65535.00 FORMAT "%8.2" /end CHARACTERISTIC
/begin CHARACTERISTIC DFC_CtlMsk.DFC_CEngDsTSRCMin_C "Behaviour control mask / Behaviour control masks of check DFC_CEngDsTSRCMin" VALUE 0x804D8F1C Val_Wu16 65535.00 DFES_OneToOne 0.00 65535.00 FORMAT "%8.2" /end CHARACTERISTIC
/begin CHARACTERISTIC DFC_CtlMsk.DFC_CEngDsTSig_C "Behaviour control mask / Behaviour control masks of check DFC_CEngDsTSig" VALUE 0x804D8F1E Val_Wu16 65535.00 DFES_OneToOne 0.00 65535.00 FORMAT "%8.2" /end CHARACTERISTIC
/begin CHARACTERISTIC DFC_CtlMsk.DFC_CEngUsTSRCMax_C "Behaviour control mask / Behaviour control masks of check DFC_CEngUsTSRCMax" VALUE 0x804D8F20 Val_Wu16 65535.00 DFES_OneToOne 0.00 65535.00 FORMAT "%8.2" /end CHARACTERISTIC
/begin CHARACTERISTIC DFC_CtlMsk.DFC_CEngUsTSRCMin_C "Behaviour control mask / Behaviour control masks of check DFC_CEngUsTSRCMin" VALUE 0x804D8F22 Val_Wu16 65535.00 DFES_OneToOne 0.00 65535.00 FORMAT "%8.2" /end CHARACTERISTIC
/begin CHARACTERISTIC DFC_CtlMsk.DFC_DCDCFltDet_C "Behaviour control mask / Behaviour control masks of check DFC_DCDCFltDet" VALUE 0x804D8F24 Val_Wu16 65535.00 DFES_OneToOne 0.00 65535.00 FORMAT "%8.2" /end CHARACTERISTIC
/begin CHARACTERISTIC DFC_CtlMsk.DFC_DKRSA_C "Behaviour control mask / Behaviour control masks of check DFC_DKRSA" VALUE 0x804D8F26 Val_Wu16 65535.00 DFES_OneToOne 0.00 65535.00 FORMAT "%8.2" /end CHARACTERISTIC
/begin CHARACTERISTIC DFC_CtlMsk.DFC_DKVSmax_C "Behaviour control mask / Behaviour control masks of check DFC_DKVSmax" VALUE 0x804D8F28 Val_Wu16 65535.00 DFES_OneToOne 0.00 65535.00 FORMAT "%8.2" /end CHARACTERISTIC
/begin CHARACTERISTIC DFC_CtlMsk.DFC_DKnpl_C "Behaviour control mask / Behaviour control masks of check DFC_DKnpl" VALUE 0x804D8F2A Val_Wu16 65535.00 DFES_OneToOne 0.00 65535.00 FORMAT "%8.2" /end CHARACTERISTIC
/begin CHARACTERISTIC DFC_CtlMsk.DFC_DSSmax_C "Behaviour control mask / Behaviour control masks of check DFC_DSSmax" VALUE 0x804D8F2C Val_Wu16 65535.00 DFES_OneToOne 0.00 65535.00 FORMAT "%8.2" /end CHARACTERISTIC
/begin CHARACTERISTIC DFC_CtlMsk.DFC_DSTTI_C "Behaviour control mask / Behaviour control masks of check DFC_DSTTI" VALUE 0x804D8F2E Val_Wu16 65535.00 DFES_OneToOne 0.00 65535.00 FORMAT "%8.2" /end CHARACTERISTIC
/begin CHARACTERISTIC DFC_CtlMsk.DFC_DSUmax_C "Behaviour control mask / Behaviour control masks of check DFC_DSUmax" VALUE 0x804D8F30 Val_Wu16 65535.00 DFES_OneToOne 0.00 65535.00 FORMAT "%8.2" /end CHARACTERISTIC
/begin CHARACTERISTIC DFC_CtlMsk.DFC_EGRVlvOL_C "Behaviour control mask / Behaviour control masks of check DFC_EGRVlvOL" VALUE 0x804D8F32 Val_Wu16 65535.00 DFES_OneToOne 0.00 65535.00 FORMAT "%8.2" /end CHARACTERISTIC
/begin CHARACTERISTIC DFC_CtlMsk.DFC_EGRVlvSCB_C "Behaviour control mask / Behaviour control masks of check DFC_EGRVlvSCB" VALUE 0x804D8F34 Val_Wu16 65535.00 DFES_OneToOne 0.00 65535.00 FORMAT "%8.2" /end CHARACTERISTIC
/begin CHARACTERISTIC DFC_CtlMsk.DFC_EGRVlvSCG_C "Behaviour control mask / Behaviour control masks of check DFC_EGRVlvSCG" VALUE 0x804D8F36 Val_Wu16 65535.00 DFES_OneToOne 0.00 65535.00 FORMAT "%8.2" /end CHARACTERISTIC
/begin CHARACTERISTIC DFC_CtlMsk.DFC_EGSDUS2B1LtrDly_C "Behaviour control mask / Behaviour control masks of check DFC_EGSDUS2B1LtrDly" VALUE 0x804D8F38 Val_Wu16 65535.00 DFES_OneToOne 0.00 65535.00 FORMAT "%8.2" /end CHARACTERISTIC
/begin CHARACTERISTIC DFC_CtlMsk.DFC_EGSDUS2B1LtrPT1_C "Behaviour control mask / Behaviour control masks of check DFC_EGSDUS2B1LtrPT1" VALUE 0x804D8F3A Val_Wu16 65535.00 DFES_OneToOne 0.00 65535.00 FORMAT "%8.2" /end CHARACTERISTIC
/begin CHARACTERISTIC DFC_CtlMsk.DFC_EGSDUS2B1RtlDly_C "Behaviour control mask / Behaviour control masks of check DFC_EGSDUS2B1RtlDly" VALUE 0x804D8F3C Val_Wu16 65535.00 DFES_OneToOne 0.00 65535.00 FORMAT "%8.2" /end CHARACTERISTIC
/begin CHARACTERISTIC DFC_CtlMsk.DFC_EGSDUS2B1RtlPT1_C "Behaviour control mask / Behaviour control masks of check DFC_EGSDUS2B1RtlPT1" VALUE 0x804D8F3E Val_Wu16 65535.00 DFES_OneToOne 0.00 65535.00 FORMAT "%8.2" /end CHARACTERISTIC
/begin CHARACTERISTIC DFC_CtlMsk.DFC_EGSDUS2B1TarLean_C "Behaviour control mask / Behaviour control masks of check DFC_EGSDUS2B1TarLean" VALUE 0x804D8F40 Val_Wu16 65535.00 DFES_OneToOne 0.00 65535.00 FORMAT "%8.2" /end CHARACTERISTIC
/begin CHARACTERISTIC DFC_CtlMsk.DFC_EGSDUS2B1TarRich_C "Behaviour control mask / Behaviour control masks of check DFC_EGSDUS2B1TarRich" VALUE 0x804D8F42 Val_Wu16 65535.00 DFES_OneToOne 0.00 65535.00 FORMAT "%8.2" /end CHARACTERISTIC
/begin CHARACTERISTIC DFC_CtlMsk.DFC_ETAKHLmax_C "Behaviour control mask / Behaviour control masks of check DFC_ETAKHLmax" VALUE 0x804D8F44 Val_Wu16 65535.00 DFES_OneToOne 0.00 65535.00 FORMAT "%8.2" /end CHARACTERISTIC
/begin CHARACTERISTIC DFC_CtlMsk.DFC_ETAKHTmax_C "Behaviour control mask / Behaviour control masks of check DFC_ETAKHTmax" VALUE 0x804D8F46 Val_Wu16 65535.00 DFES_OneToOne 0.00 65535.00 FORMAT "%8.2" /end CHARACTERISTIC
/begin CHARACTERISTIC DFC_CtlMsk.DFC_EngICO_C "Behaviour control mask / Behaviour control masks of check DFC_EngICO" VALUE 0x804D8F48 Val_Wu16 65535.00 DFES_OneToOne 0.00 65535.00 FORMAT "%8.2" /end CHARACTERISTIC
/begin CHARACTERISTIC DFC_CtlMsk.DFC_EngPrtOvrSpdMon_C "Behaviour control mask / Behaviour control masks of check DFC_EngPrtOvrSpdMon" VALUE 0x804D8F4A Val_Wu16 65535.00 DFES_OneToOne 0.00 65535.00 FORMAT "%8.2" /end CHARACTERISTIC
/begin CHARACTERISTIC DFC_CtlMsk.DFC_EpmCaSI1ErrSig_C "Behaviour control mask / Behaviour control masks of check DFC_EpmCaSI1ErrSig" VALUE 0x804D8F4C Val_Wu16 65535.00 DFES_OneToOne 0.00 65535.00 FORMAT "%8.2" /end CHARACTERISTIC
/begin CHARACTERISTIC DFC_CtlMsk.DFC_EpmCaSI1NoSig_C "Behaviour control mask / Behaviour control masks of check DFC_EpmCaSI1NoSig" VALUE 0x804D8F4E Val_Wu16 65535.00 DFES_OneToOne 0.00 65535.00 FORMAT "%8.2" /end CHARACTERISTIC
/begin CHARACTERISTIC DFC_CtlMsk.DFC_EpmCaSI1OfsErr_C "Behaviour control mask / Behaviour control masks of check DFC_EpmCaSI1OfsErr" VALUE 0x804D8F50 Val_Wu16 65535.00 DFES_OneToOne 0.00 65535.00 FORMAT "%8.2" /end CHARACTERISTIC
/begin CHARACTERISTIC DFC_CtlMsk.DFC_EpmCrSErrSig_C "Behaviour control mask / Behaviour control masks of check DFC_EpmCrSErrSig" VALUE 0x804D8F52 Val_Wu16 65535.00 DFES_OneToOne 0.00 65535.00 FORMAT "%8.2" /end CHARACTERISTIC
/begin CHARACTERISTIC DFC_CtlMsk.DFC_EpmCrSNoSig_C "Behaviour control mask / Behaviour control masks of check DFC_EpmCrSNoSig" VALUE 0x804D8F54 Val_Wu16 65535.00 DFES_OneToOne 0.00 65535.00 FORMAT "%8.2" /end CHARACTERISTIC
/begin CHARACTERISTIC DFC_CtlMsk.DFC_EtaEngIdleNonCsers_C "Behaviour control mask / Behaviour control masks of check DFC_EtaEngIdleNonCsers" VALUE 0x804D8F56 Val_Wu16 65535.00 DFES_OneToOne 0.00 65535.00 FORMAT "%8.2" /end CHARACTERISTIC
/begin CHARACTERISTIC DFC_CtlMsk.DFC_EtaEngPtlNonCsers_C "Behaviour control mask / Behaviour control masks of check DFC_EtaEngPtlNonCsers" VALUE 0x804D8F58 Val_Wu16 65535.00 DFES_OneToOne 0.00 65535.00 FORMAT "%8.2" /end CHARACTERISTIC
/begin CHARACTERISTIC DFC_CtlMsk.DFC_FRAmax_C "Behaviour control mask / Behaviour control masks of check DFC_FRAmax" VALUE 0x804D8F5A Val_Wu16 65535.00 DFES_OneToOne 0.00 65535.00 FORMAT "%8.2" /end CHARACTERISTIC
/begin CHARACTERISTIC DFC_CtlMsk.DFC_FRAmin_C "Behaviour control mask / Behaviour control masks of check DFC_FRAmin" VALUE 0x804D8F5C Val_Wu16 65535.00 DFES_OneToOne 0.00 65535.00 FORMAT "%8.2" /end CHARACTERISTIC
/begin CHARACTERISTIC DFC_CtlMsk.DFC_GbxRvsSwtStk_C "Behaviour control mask / Behaviour control masks of check DFC_GbxRvsSwtStk" VALUE 0x804D8F5E Val_Wu16 65535.00 DFES_OneToOne 0.00 65535.00 FORMAT "%8.2" /end CHARACTERISTIC
/begin CHARACTERISTIC DFC_CtlMsk.DFC_HDRmax_C "Behaviour control mask / Behaviour control masks of check DFC_HDRmax" VALUE 0x804D8F60 Val_Wu16 65535.00 DFES_OneToOne 0.00 65535.00 FORMAT "%8.2" /end CHARACTERISTIC
/begin CHARACTERISTIC DFC_CtlMsk.DFC_HEGOS2B1ElecMax_C "Behaviour control mask / Behaviour control masks of check DFC_HEGOS2B1ElecMax" VALUE 0x804D8F62 Val_Wu16 65535.00 DFES_OneToOne 0.00 65535.00 FORMAT "%8.2" /end CHARACTERISTIC
/begin CHARACTERISTIC DFC_CtlMsk.DFC_HEGOS2B1ElecMin_C "Behaviour control mask / Behaviour control masks of check DFC_HEGOS2B1ElecMin" VALUE 0x804D8F64 Val_Wu16 65535.00 DFES_OneToOne 0.00 65535.00 FORMAT "%8.2" /end CHARACTERISTIC
/begin CHARACTERISTIC DFC_CtlMsk.DFC_HEGOS2B1ElecSig_C "Behaviour control mask / Behaviour control masks of check DFC_HEGOS2B1ElecSig" VALUE 0x804D8F66 Val_Wu16 65535.00 DFES_OneToOne 0.00 65535.00 FORMAT "%8.2" /end CHARACTERISTIC
/begin CHARACTERISTIC DFC_CtlMsk.DFC_HEGOS2B1HtgNpl_C "Behaviour control mask / Behaviour control masks of check DFC_HEGOS2B1HtgNpl" VALUE 0x804D8F68 Val_Wu16 65535.00 DFES_OneToOne 0.00 65535.00 FORMAT "%8.2" /end CHARACTERISTIC
/begin CHARACTERISTIC DFC_CtlMsk.DFC_IntkAirTIntkMnfldCrssMax_C "Behaviour control mask / Behaviour control masks of check DFC_IntkAirTIntkMnfldCrssMax" VALUE 0x804D8F6A Val_Wu16 65535.00 DFES_OneToOne 0.00 65535.00 FORMAT "%8.2" /end CHARACTERISTIC
/begin CHARACTERISTIC DFC_CtlMsk.DFC_IntkAirTIntkMnfldCrssMin_C "Behaviour control mask / Behaviour control masks of check DFC_IntkAirTIntkMnfldCrssMin" VALUE 0x804D8F6C Val_Wu16 65535.00 DFES_OneToOne 0.00 65535.00 FORMAT "%8.2" /end CHARACTERISTIC
/begin CHARACTERISTIC DFC_CtlMsk.DFC_IntkAirTIntkMnfldHSCMax_C "Behaviour control mask / Behaviour control masks of check DFC_IntkAirTIntkMnfldHSCMax" VALUE 0x804D8F6E Val_Wu16 65535.00 DFES_OneToOne 0.00 65535.00 FORMAT "%8.2" /end CHARACTERISTIC
/begin CHARACTERISTIC DFC_CtlMsk.DFC_IntkAirTIntkMnfldImps_C "Behaviour control mask / Behaviour control masks of check DFC_IntkAirTIntkMnfldImps" VALUE 0x804D8F70 Val_Wu16 65535.00 DFES_OneToOne 0.00 65535.00 FORMAT "%8.2" /end CHARACTERISTIC
/begin CHARACTERISTIC DFC_CtlMsk.DFC_IntkAirTIntkMnfldPRCMax_C "Behaviour control mask / Behaviour control masks of check DFC_IntkAirTIntkMnfldPRCMax" VALUE 0x804D8F72 Val_Wu16 65535.00 DFES_OneToOne 0.00 65535.00 FORMAT "%8.2" /end CHARACTERISTIC
/begin CHARACTERISTIC DFC_CtlMsk.DFC_IntkAirTIntkMnfldPRCMin_C "Behaviour control mask / Behaviour control masks of check DFC_IntkAirTIntkMnfldPRCMin" VALUE 0x804D8F74 Val_Wu16 65535.00 DFES_OneToOne 0.00 65535.00 FORMAT "%8.2" /end CHARACTERISTIC
/begin CHARACTERISTIC DFC_CtlMsk.DFC_IntkAirTIntkMnfldSRCMax_C "Behaviour control mask / Behaviour control masks of check DFC_IntkAirTIntkMnfldSRCMax" VALUE 0x804D8F76 Val_Wu16 65535.00 DFES_OneToOne 0.00 65535.00 FORMAT "%8.2" /end CHARACTERISTIC
/begin CHARACTERISTIC DFC_CtlMsk.DFC_IntkAirTIntkMnfldSRCMin_C "Behaviour control mask / Behaviour control masks of check DFC_IntkAirTIntkMnfldSRCMin" VALUE 0x804D8F78 Val_Wu16 65535.00 DFES_OneToOne 0.00 65535.00 FORMAT "%8.2" /end CHARACTERISTIC
/begin CHARACTERISTIC DFC_CtlMsk.DFC_IntkAirTIntkMnfldSTC_C "Behaviour control mask / Behaviour control masks of check DFC_IntkAirTIntkMnfldSTC" VALUE 0x804D8F7A Val_Wu16 65535.00 DFES_OneToOne 0.00 65535.00 FORMAT "%8.2" /end CHARACTERISTIC
/begin CHARACTERISTIC DFC_CtlMsk.DFC_KS1max_C "Behaviour control mask / Behaviour control masks of check DFC_KS1max" VALUE 0x804D8F7C Val_Wu16 65535.00 DFES_OneToOne 0.00 65535.00 FORMAT "%8.2" /end CHARACTERISTIC
/begin CHARACTERISTIC DFC_CtlMsk.DFC_KS1min_C "Behaviour control mask / Behaviour control masks of check DFC_KS1min" VALUE 0x804D8F7E Val_Wu16 65535.00 DFES_OneToOne 0.00 65535.00 FORMAT "%8.2" /end CHARACTERISTIC
/begin CHARACTERISTIC DFC_CtlMsk.DFC_LMmax_C "Behaviour control mask / Behaviour control masks of check DFC_LMmax" VALUE 0x804D8F80 Val_Wu16 65535.00 DFES_OneToOne 0.00 65535.00 FORMAT "%8.2" /end CHARACTERISTIC
/begin CHARACTERISTIC DFC_CtlMsk.DFC_LZSRnpl_C "Behaviour control mask / Behaviour control masks of check DFC_LZSRnpl" VALUE 0x804D8F82 Val_Wu16 65535.00 DFES_OneToOne 0.00 65535.00 FORMAT "%8.2" /end CHARACTERISTIC
/begin CHARACTERISTIC DFC_CtlMsk.DFC_LamDynDiagS1B1_C "Behaviour control mask / Behaviour control masks of check DFC_LamDynDiagS1B1" VALUE 0x804D8F84 Val_Wu16 65535.00 DFES_OneToOne 0.00 65535.00 FORMAT "%8.2" /end CHARACTERISTIC
/begin CHARACTERISTIC DFC_CtlMsk.DFC_LeakIntkMnfldEmiInfl_C "Behaviour control mask / Behaviour control masks of check DFC_LeakIntkMnfldEmiInfl" VALUE 0x804D8F86 Val_Wu16 65535.00 DFES_OneToOne 0.00 65535.00 FORMAT "%8.2" /end CHARACTERISTIC
/begin CHARACTERISTIC DFC_CtlMsk.DFC_MD00max_C "Behaviour control mask / Behaviour control masks of check DFC_MD00max" VALUE 0x804D8F88 Val_Wu16 65535.00 DFES_OneToOne 0.00 65535.00 FORMAT "%8.2" /end CHARACTERISTIC
/begin CHARACTERISTIC DFC_CtlMsk.DFC_MDBmax_C "Behaviour control mask / Behaviour control masks of check DFC_MDBmax" VALUE 0x804D8F8A Val_Wu16 65535.00 DFES_OneToOne 0.00 65535.00 FORMAT "%8.2" /end CHARACTERISTIC
/begin CHARACTERISTIC DFC_CtlMsk.DFC_MDCat_C "Behaviour control mask / Behaviour control masks of check DFC_MDCat" VALUE 0x804D8F8C Val_Wu16 65535.00 DFES_OneToOne 0.00 65535.00 FORMAT "%8.2" /end CHARACTERISTIC
/begin CHARACTERISTIC DFC_CtlMsk.DFC_MDCatCrit_C "Behaviour control mask / Behaviour control masks of check DFC_MDCatCrit" VALUE 0x804D8F8E Val_Wu16 65535.00 DFES_OneToOne 0.00 65535.00 FORMAT "%8.2" /end CHARACTERISTIC
/begin CHARACTERISTIC DFC_CtlMsk.DFC_MDCatCurr_C "Behaviour control mask / Behaviour control masks of check DFC_MDCatCurr" VALUE 0x804D8F90 Val_Wu16 65535.00 DFES_OneToOne 0.00 65535.00 FORMAT "%8.2" /end CHARACTERISTIC
/begin CHARACTERISTIC DFC_CtlMsk.DFC_MDCyl_0_C "Behaviour control mask / Behaviour control masks of check DFC_MDCyl_0" VALUE 0x804D8F92 Val_Wu16 65535.00 DFES_OneToOne 0.00 65535.00 FORMAT "%8.2" /end CHARACTERISTIC
/begin CHARACTERISTIC DFC_CtlMsk.DFC_MDCyl_1_C "Behaviour control mask / Behaviour control masks of check DFC_MDCyl_1" VALUE 0x804D8F94 Val_Wu16 65535.00 DFES_OneToOne 0.00 65535.00 FORMAT "%8.2" /end CHARACTERISTIC
/begin CHARACTERISTIC DFC_CtlMsk.DFC_MDCyl_2_C "Behaviour control mask / Behaviour control masks of check DFC_MDCyl_2" VALUE 0x804D8F96 Val_Wu16 65535.00 DFES_OneToOne 0.00 65535.00 FORMAT "%8.2" /end CHARACTERISTIC
/begin CHARACTERISTIC DFC_CtlMsk.DFC_MDCyl_3_C "Behaviour control mask / Behaviour control masks of check DFC_MDCyl_3" VALUE 0x804D8F98 Val_Wu16 65535.00 DFES_OneToOne 0.00 65535.00 FORMAT "%8.2" /end CHARACTERISTIC
/begin CHARACTERISTIC DFC_CtlMsk.DFC_MDEmi_C "Behaviour control mask / Behaviour control masks of check DFC_MDEmi" VALUE 0x804D8F9A Val_Wu16 65535.00 DFES_OneToOne 0.00 65535.00 FORMAT "%8.2" /end CHARACTERISTIC
/begin CHARACTERISTIC DFC_CtlMsk.DFC_MDEmiStrt_C "Behaviour control mask / Behaviour control masks of check DFC_MDEmiStrt" VALUE 0x804D8F9C Val_Wu16 65535.00 DFES_OneToOne 0.00 65535.00 FORMAT "%8.2" /end CHARACTERISTIC
/begin CHARACTERISTIC DFC_CtlMsk.DFC_MDFco_C "Behaviour control mask / Behaviour control masks of check DFC_MDFco" VALUE 0x804D8F9E Val_Wu16 65535.00 DFES_OneToOne 0.00 65535.00 FORMAT "%8.2" /end CHARACTERISTIC
/begin CHARACTERISTIC DFC_CtlMsk.DFC_MDMpl_C "Behaviour control mask / Behaviour control masks of check DFC_MDMpl" VALUE 0x804D8FA0 Val_Wu16 65535.00 DFES_OneToOne 0.00 65535.00 FORMAT "%8.2" /end CHARACTERISTIC
/begin CHARACTERISTIC DFC_CtlMsk.DFC_MDSegTiAdpn_C "Behaviour control mask / Behaviour control masks of check DFC_MDSegTiAdpn" VALUE 0x804D8FA2 Val_Wu16 65535.00 DFES_OneToOne 0.00 65535.00 FORMAT "%8.2" /end CHARACTERISTIC
/begin CHARACTERISTIC DFC_CtlMsk.DFC_MDmax_C "Behaviour control mask / Behaviour control masks of check DFC_MDmax" VALUE 0x804D8FA4 Val_Wu16 65535.00 DFES_OneToOne 0.00 65535.00 FORMAT "%8.2" /end CHARACTERISTIC
/begin CHARACTERISTIC DFC_CtlMsk.DFC_MOXEMM_SMU_ALM0_0_C "Behaviour control mask / Behaviour control masks of check DFC_MOXEMM_SMU_ALM0_0" VALUE 0x804D8FA6 Val_Wu16 65535.00 DFES_OneToOne 0.00 65535.00 FORMAT "%8.2" /end CHARACTERISTIC
/begin CHARACTERISTIC DFC_CtlMsk.DFC_MOXEMM_SMU_ALM0_1_C "Behaviour control mask / Behaviour control masks of check DFC_MOXEMM_SMU_ALM0_1" VALUE 0x804D8FA8 Val_Wu16 65535.00 DFES_OneToOne 0.00 65535.00 FORMAT "%8.2" /end CHARACTERISTIC
/begin CHARACTERISTIC DFC_CtlMsk.DFC_MOXEMM_SMU_ALM0_10_C "Behaviour control mask / Behaviour control masks of check DFC_MOXEMM_SMU_ALM0_10" VALUE 0x804D8FAA Val_Wu16 65535.00 DFES_OneToOne 0.00 65535.00 FORMAT "%8.2" /end CHARACTERISTIC
/begin CHARACTERISTIC DFC_CtlMsk.DFC_MOXEMM_SMU_ALM0_11_C "Behaviour control mask / Behaviour control masks of check DFC_MOXEMM_SMU_ALM0_11" VALUE 0x804D8FAC Val_Wu16 65535.00 DFES_OneToOne 0.00 65535.00 FORMAT "%8.2" /end CHARACTERISTIC
/begin CHARACTERISTIC DFC_CtlMsk.DFC_MOXEMM_SMU_ALM0_13_C "Behaviour control mask / Behaviour control masks of check DFC_MOXEMM_SMU_ALM0_13" VALUE 0x804D8FAE Val_Wu16 65535.00 DFES_OneToOne 0.00 65535.00 FORMAT "%8.2" /end CHARACTERISTIC
/begin CHARACTERISTIC DFC_CtlMsk.DFC_MOXEMM_SMU_ALM0_14_C "Behaviour control mask / Behaviour control masks of check DFC_MOXEMM_SMU_ALM0_14" VALUE 0x804D8FB0 Val_Wu16 65535.00 DFES_OneToOne 0.00 65535.00 FORMAT "%8.2" /end CHARACTERISTIC
/begin CHARACTERISTIC DFC_CtlMsk.DFC_MOXEMM_SMU_ALM0_2_C "Behaviour control mask / Behaviour control masks of check DFC_MOXEMM_SMU_ALM0_2" VALUE 0x804D8FB2 Val_Wu16 65535.00 DFES_OneToOne 0.00 65535.00 FORMAT "%8.2" /end CHARACTERISTIC
/begin CHARACTERISTIC DFC_CtlMsk.DFC_MOXEMM_SMU_ALM0_22_C "Behaviour control mask / Behaviour control masks of check DFC_MOXEMM_SMU_ALM0_22" VALUE 0x804D8FB4 Val_Wu16 65535.00 DFES_OneToOne 0.00 65535.00 FORMAT "%8.2" /end CHARACTERISTIC
/begin CHARACTERISTIC DFC_CtlMsk.DFC_MOXEMM_SMU_ALM0_23_C "Behaviour control mask / Behaviour control masks of check DFC_MOXEMM_SMU_ALM0_23" VALUE 0x804D8FB6 Val_Wu16 65535.00 DFES_OneToOne 0.00 65535.00 FORMAT "%8.2" /end CHARACTERISTIC
/begin CHARACTERISTIC DFC_CtlMsk.DFC_MOXEMM_SMU_ALM0_4_C "Behaviour control mask / Behaviour control masks of check DFC_MOXEMM_SMU_ALM0_4" VALUE 0x804D8FB8 Val_Wu16 65535.00 DFES_OneToOne 0.00 65535.00 FORMAT "%8.2" /end CHARACTERISTIC
/begin CHARACTERISTIC DFC_CtlMsk.DFC_MOXEMM_SMU_ALM0_5_C "Behaviour control mask / Behaviour control masks of check DFC_MOXEMM_SMU_ALM0_5" VALUE 0x804D8FBA Val_Wu16 65535.00 DFES_OneToOne 0.00 65535.00 FORMAT "%8.2" /end CHARACTERISTIC
/begin CHARACTERISTIC DFC_CtlMsk.DFC_MOXEMM_SMU_ALM0_7_C "Behaviour control mask / Behaviour control masks of check DFC_MOXEMM_SMU_ALM0_7" VALUE 0x804D8FBC Val_Wu16 65535.00 DFES_OneToOne 0.00 65535.00 FORMAT "%8.2" /end CHARACTERISTIC
/begin CHARACTERISTIC DFC_CtlMsk.DFC_MOXEMM_SMU_ALM0_8_C "Behaviour control mask / Behaviour control masks of check DFC_MOXEMM_SMU_ALM0_8" VALUE 0x804D8FBE Val_Wu16 65535.00 DFES_OneToOne 0.00 65535.00 FORMAT "%8.2" /end CHARACTERISTIC
/begin CHARACTERISTIC DFC_CtlMsk.DFC_MOXEMM_SMU_ALM10_16_C "Behaviour control mask / Behaviour control masks of check DFC_MOXEMM_SMU_ALM10_16" VALUE 0x804D8FC0 Val_Wu16 65535.00 DFES_OneToOne 0.00 65535.00 FORMAT "%8.2" /end CHARACTERISTIC
/begin CHARACTERISTIC DFC_CtlMsk.DFC_MOXEMM_SMU_ALM10_17_C "Behaviour control mask / Behaviour control masks of check DFC_MOXEMM_SMU_ALM10_17" VALUE 0x804D8FC2 Val_Wu16 65535.00 DFES_OneToOne 0.00 65535.00 FORMAT "%8.2" /end CHARACTERISTIC
/begin CHARACTERISTIC DFC_CtlMsk.DFC_MOXEMM_SMU_ALM10_21_C "Behaviour control mask / Behaviour control masks of check DFC_MOXEMM_SMU_ALM10_21" VALUE 0x804D8FC4 Val_Wu16 65535.00 DFES_OneToOne 0.00 65535.00 FORMAT "%8.2" /end CHARACTERISTIC
/begin CHARACTERISTIC DFC_CtlMsk.DFC_MOXEMM_SMU_ALM11_0_C "Behaviour control mask / Behaviour control masks of check DFC_MOXEMM_SMU_ALM11_0" VALUE 0x804D8FC6 Val_Wu16 65535.00 DFES_OneToOne 0.00 65535.00 FORMAT "%8.2" /end CHARACTERISTIC
/begin CHARACTERISTIC DFC_CtlMsk.DFC_MOXEMM_SMU_ALM11_1_C "Behaviour control mask / Behaviour control masks of check DFC_MOXEMM_SMU_ALM11_1" VALUE 0x804D8FC8 Val_Wu16 65535.00 DFES_OneToOne 0.00 65535.00 FORMAT "%8.2" /end CHARACTERISTIC
/begin CHARACTERISTIC DFC_CtlMsk.DFC_MOXEMM_SMU_ALM11_2_C "Behaviour control mask / Behaviour control masks of check DFC_MOXEMM_SMU_ALM11_2" VALUE 0x804D8FCA Val_Wu16 65535.00 DFES_OneToOne 0.00 65535.00 FORMAT "%8.2" /end CHARACTERISTIC
/begin CHARACTERISTIC DFC_CtlMsk.DFC_MOXEMM_SMU_ALM11_3_C "Behaviour control mask / Behaviour control masks of check DFC_MOXEMM_SMU_ALM11_3" VALUE 0x804D8FCC Val_Wu16 65535.00 DFES_OneToOne 0.00 65535.00 FORMAT "%8.2" /end CHARACTERISTIC
/begin CHARACTERISTIC DFC_CtlMsk.DFC_MOXEMM_SMU_ALM11_4_C "Behaviour control mask / Behaviour control masks of check DFC_MOXEMM_SMU_ALM11_4" VALUE 0x804D8FCE Val_Wu16 65535.00 DFES_OneToOne 0.00 65535.00 FORMAT "%8.2" /end CHARACTERISTIC
/begin CHARACTERISTIC DFC_CtlMsk.DFC_MOXEMM_SMU_ALM11_5_C "Behaviour control mask / Behaviour control masks of check DFC_MOXEMM_SMU_ALM11_5" VALUE 0x804D8FD0 Val_Wu16 65535.00 DFES_OneToOne 0.00 65535.00 FORMAT "%8.2" /end CHARACTERISTIC
/begin CHARACTERISTIC DFC_CtlMsk.DFC_MOXEMM_SMU_ALM11_8_C "Behaviour control mask / Behaviour control masks of check DFC_MOXEMM_SMU_ALM11_8" VALUE 0x804D8FD2 Val_Wu16 65535.00 DFES_OneToOne 0.00 65535.00 FORMAT "%8.2" /end CHARACTERISTIC
/begin CHARACTERISTIC DFC_CtlMsk.DFC_MOXEMM_SMU_ALM11_9_C "Behaviour control mask / Behaviour control masks of check DFC_MOXEMM_SMU_ALM11_9" VALUE 0x804D8FD4 Val_Wu16 65535.00 DFES_OneToOne 0.00 65535.00 FORMAT "%8.2" /end CHARACTERISTIC
/begin CHARACTERISTIC DFC_CtlMsk.DFC_MOXEMM_SMU_ALM1_0_C "Behaviour control mask / Behaviour control masks of check DFC_MOXEMM_SMU_ALM1_0" VALUE 0x804D8FD6 Val_Wu16 65535.00 DFES_OneToOne 0.00 65535.00 FORMAT "%8.2" /end CHARACTERISTIC
/begin CHARACTERISTIC DFC_CtlMsk.DFC_MOXEMM_SMU_ALM1_1_C "Behaviour control mask / Behaviour control masks of check DFC_MOXEMM_SMU_ALM1_1" VALUE 0x804D8FD8 Val_Wu16 65535.00 DFES_OneToOne 0.00 65535.00 FORMAT "%8.2" /end CHARACTERISTIC
/begin CHARACTERISTIC DFC_CtlMsk.DFC_MOXEMM_SMU_ALM1_10_C "Behaviour control mask / Behaviour control masks of check DFC_MOXEMM_SMU_ALM1_10" VALUE 0x804D8FDA Val_Wu16 65535.00 DFES_OneToOne 0.00 65535.00 FORMAT "%8.2" /end CHARACTERISTIC
/begin CHARACTERISTIC DFC_CtlMsk.DFC_MOXEMM_SMU_ALM1_11_C "Behaviour control mask / Behaviour control masks of check DFC_MOXEMM_SMU_ALM1_11" VALUE 0x804D8FDC Val_Wu16 65535.00 DFES_OneToOne 0.00 65535.00 FORMAT "%8.2" /end CHARACTERISTIC
/begin CHARACTERISTIC DFC_CtlMsk.DFC_MOXEMM_SMU_ALM1_13_C "Behaviour control mask / Behaviour control masks of check DFC_MOXEMM_SMU_ALM1_13" VALUE 0x804D8FDE Val_Wu16 65535.00 DFES_OneToOne 0.00 65535.00 FORMAT "%8.2" /end CHARACTERISTIC
/begin CHARACTERISTIC DFC_CtlMsk.DFC_MOXEMM_SMU_ALM1_14_C "Behaviour control mask / Behaviour control masks of check DFC_MOXEMM_SMU_ALM1_14" VALUE 0x804D8FE0 Val_Wu16 65535.00 DFES_OneToOne 0.00 65535.00 FORMAT "%8.2" /end CHARACTERISTIC
/begin CHARACTERISTIC DFC_CtlMsk.DFC_MOXEMM_SMU_ALM1_2_C "Behaviour control mask / Behaviour control masks of check DFC_MOXEMM_SMU_ALM1_2" VALUE 0x804D8FE2 Val_Wu16 65535.00 DFES_OneToOne 0.00 65535.00 FORMAT "%8.2" /end CHARACTERISTIC
/begin CHARACTERISTIC DFC_CtlMsk.DFC_MOXEMM_SMU_ALM1_22_C "Behaviour control mask / Behaviour control masks of check DFC_MOXEMM_SMU_ALM1_22" VALUE 0x804D8FE4 Val_Wu16 65535.00 DFES_OneToOne 0.00 65535.00 FORMAT "%8.2" /end CHARACTERISTIC
/begin CHARACTERISTIC DFC_CtlMsk.DFC_MOXEMM_SMU_ALM1_23_C "Behaviour control mask / Behaviour control masks of check DFC_MOXEMM_SMU_ALM1_23" VALUE 0x804D8FE6 Val_Wu16 65535.00 DFES_OneToOne 0.00 65535.00 FORMAT "%8.2" /end CHARACTERISTIC
/begin CHARACTERISTIC DFC_CtlMsk.DFC_MOXEMM_SMU_ALM1_4_C "Behaviour control mask / Behaviour control masks of check DFC_MOXEMM_SMU_ALM1_4" VALUE 0x804D8FE8 Val_Wu16 65535.00 DFES_OneToOne 0.00 65535.00 FORMAT "%8.2" /end CHARACTERISTIC
/begin CHARACTERISTIC DFC_CtlMsk.DFC_MOXEMM_SMU_ALM1_5_C "Behaviour control mask / Behaviour control masks of check DFC_MOXEMM_SMU_ALM1_5" VALUE 0x804D8FEA Val_Wu16 65535.00 DFES_OneToOne 0.00 65535.00 FORMAT "%8.2" /end CHARACTERISTIC
/begin CHARACTERISTIC DFC_CtlMsk.DFC_MOXEMM_SMU_ALM1_7_C "Behaviour control mask / Behaviour control masks of check DFC_MOXEMM_SMU_ALM1_7" VALUE 0x804D8FEC Val_Wu16 65535.00 DFES_OneToOne 0.00 65535.00 FORMAT "%8.2" /end CHARACTERISTIC
/begin CHARACTERISTIC DFC_CtlMsk.DFC_MOXEMM_SMU_ALM1_8_C "Behaviour control mask / Behaviour control masks of check DFC_MOXEMM_SMU_ALM1_8" VALUE 0x804D8FEE Val_Wu16 65535.00 DFES_OneToOne 0.00 65535.00 FORMAT "%8.2" /end CHARACTERISTIC
/begin CHARACTERISTIC DFC_CtlMsk.DFC_MOXEMM_SMU_ALM21_0_C "Behaviour control mask / Behaviour control masks of check DFC_MOXEMM_SMU_ALM21_0" VALUE 0x804D8FF0 Val_Wu16 65535.00 DFES_OneToOne 0.00 65535.00 FORMAT "%8.2" /end CHARACTERISTIC
/begin CHARACTERISTIC DFC_CtlMsk.DFC_MOXEMM_SMU_ALM21_16_C "Behaviour control mask / Behaviour control masks of check DFC_MOXEMM_SMU_ALM21_16" VALUE 0x804D8FF2 Val_Wu16 65535.00 DFES_OneToOne 0.00 65535.00 FORMAT "%8.2" /end CHARACTERISTIC
/begin CHARACTERISTIC DFC_CtlMsk.DFC_MOXEMM_SMU_ALM21_3_C "Behaviour control mask / Behaviour control masks of check DFC_MOXEMM_SMU_ALM21_3" VALUE 0x804D8FF4 Val_Wu16 65535.00 DFES_OneToOne 0.00 65535.00 FORMAT "%8.2" /end CHARACTERISTIC
/begin CHARACTERISTIC DFC_CtlMsk.DFC_MOXEMM_SMU_ALM2_1_C "Behaviour control mask / Behaviour control masks of check DFC_MOXEMM_SMU_ALM2_1" VALUE 0x804D8FF6 Val_Wu16 65535.00 DFES_OneToOne 0.00 65535.00 FORMAT "%8.2" /end CHARACTERISTIC
/begin CHARACTERISTIC DFC_CtlMsk.DFC_MOXEMM_SMU_ALM2_10_C "Behaviour control mask / Behaviour control masks of check DFC_MOXEMM_SMU_ALM2_10" VALUE 0x804D8FF8 Val_Wu16 65535.00 DFES_OneToOne 0.00 65535.00 FORMAT "%8.2" /end CHARACTERISTIC
/begin CHARACTERISTIC DFC_CtlMsk.DFC_MOXEMM_SMU_ALM2_11_C "Behaviour control mask / Behaviour control masks of check DFC_MOXEMM_SMU_ALM2_11" VALUE 0x804D8FFA Val_Wu16 65535.00 DFES_OneToOne 0.00 65535.00 FORMAT "%8.2" /end CHARACTERISTIC
/begin CHARACTERISTIC DFC_CtlMsk.DFC_MOXEMM_SMU_ALM2_13_C "Behaviour control mask / Behaviour control masks of check DFC_MOXEMM_SMU_ALM2_13" VALUE 0x804D8FFC Val_Wu16 65535.00 DFES_OneToOne 0.00 65535.00 FORMAT "%8.2" /end CHARACTERISTIC
/begin CHARACTERISTIC DFC_CtlMsk.DFC_MOXEMM_SMU_ALM2_14_C "Behaviour control mask / Behaviour control masks of check DFC_MOXEMM_SMU_ALM2_14" VALUE 0x804D8FFE Val_Wu16 65535.00 DFES_OneToOne 0.00 65535.00 FORMAT "%8.2" /end CHARACTERISTIC
/begin CHARACTERISTIC DFC_CtlMsk.DFC_MOXEMM_SMU_ALM2_22_C "Behaviour control mask / Behaviour control masks of check DFC_MOXEMM_SMU_ALM2_22" VALUE 0x804D9000 Val_Wu16 65535.00 DFES_OneToOne 0.00 65535.00 FORMAT "%8.2" /end CHARACTERISTIC
/begin CHARACTERISTIC DFC_CtlMsk.DFC_MOXEMM_SMU_ALM2_23_C "Behaviour control mask / Behaviour control masks of check DFC_MOXEMM_SMU_ALM2_23" VALUE 0x804D9002 Val_Wu16 65535.00 DFES_OneToOne 0.00 65535.00 FORMAT "%8.2" /end CHARACTERISTIC
/begin CHARACTERISTIC DFC_CtlMsk.DFC_MOXEMM_SMU_ALM2_4_C "Behaviour control mask / Behaviour control masks of check DFC_MOXEMM_SMU_ALM2_4" VALUE 0x804D9004 Val_Wu16 65535.00 DFES_OneToOne 0.00 65535.00 FORMAT "%8.2" /end CHARACTERISTIC
/begin CHARACTERISTIC DFC_CtlMsk.DFC_MOXEMM_SMU_ALM2_5_C "Behaviour control mask / Behaviour control masks of check DFC_MOXEMM_SMU_ALM2_5" VALUE 0x804D9006 Val_Wu16 65535.00 DFES_OneToOne 0.00 65535.00 FORMAT "%8.2" /end CHARACTERISTIC
/begin CHARACTERISTIC DFC_CtlMsk.DFC_MOXEMM_SMU_ALM2_7_C "Behaviour control mask / Behaviour control masks of check DFC_MOXEMM_SMU_ALM2_7" VALUE 0x804D9008 Val_Wu16 65535.00 DFES_OneToOne 0.00 65535.00 FORMAT "%8.2" /end CHARACTERISTIC
/begin CHARACTERISTIC DFC_CtlMsk.DFC_MOXEMM_SMU_ALM2_8_C "Behaviour control mask / Behaviour control masks of check DFC_MOXEMM_SMU_ALM2_8" VALUE 0x804D900A Val_Wu16 65535.00 DFES_OneToOne 0.00 65535.00 FORMAT "%8.2" /end CHARACTERISTIC
/begin CHARACTERISTIC DFC_CtlMsk.DFC_MOXEMM_SMU_ALM6_0_C "Behaviour control mask / Behaviour control masks of check DFC_MOXEMM_SMU_ALM6_0" VALUE 0x804D900C Val_Wu16 65535.00 DFES_OneToOne 0.00 65535.00 FORMAT "%8.2" /end CHARACTERISTIC
/begin CHARACTERISTIC DFC_CtlMsk.DFC_MOXEMM_SMU_ALM6_11_C "Behaviour control mask / Behaviour control masks of check DFC_MOXEMM_SMU_ALM6_11" VALUE 0x804D900E Val_Wu16 65535.00 DFES_OneToOne 0.00 65535.00 FORMAT "%8.2" /end CHARACTERISTIC
/begin CHARACTERISTIC DFC_CtlMsk.DFC_MOXEMM_SMU_ALM6_12_C "Behaviour control mask / Behaviour control masks of check DFC_MOXEMM_SMU_ALM6_12" VALUE 0x804D9010 Val_Wu16 65535.00 DFES_OneToOne 0.00 65535.00 FORMAT "%8.2" /end CHARACTERISTIC
/begin CHARACTERISTIC DFC_CtlMsk.DFC_MOXEMM_SMU_ALM6_14_C "Behaviour control mask / Behaviour control masks of check DFC_MOXEMM_SMU_ALM6_14" VALUE 0x804D9012 Val_Wu16 65535.00 DFES_OneToOne 0.00 65535.00 FORMAT "%8.2" /end CHARACTERISTIC
/begin CHARACTERISTIC DFC_CtlMsk.DFC_MOXEMM_SMU_ALM6_15_C "Behaviour control mask / Behaviour control masks of check DFC_MOXEMM_SMU_ALM6_15" VALUE 0x804D9014 Val_Wu16 65535.00 DFES_OneToOne 0.00 65535.00 FORMAT "%8.2" /end CHARACTERISTIC
/begin CHARACTERISTIC DFC_CtlMsk.DFC_MOXEMM_SMU_ALM6_17_C "Behaviour control mask / Behaviour control masks of check DFC_MOXEMM_SMU_ALM6_17" VALUE 0x804D9016 Val_Wu16 65535.00 DFES_OneToOne 0.00 65535.00 FORMAT "%8.2" /end CHARACTERISTIC
/begin CHARACTERISTIC DFC_CtlMsk.DFC_MOXEMM_SMU_ALM6_18_C "Behaviour control mask / Behaviour control masks of check DFC_MOXEMM_SMU_ALM6_18" VALUE 0x804D9018 Val_Wu16 65535.00 DFES_OneToOne 0.00 65535.00 FORMAT "%8.2" /end CHARACTERISTIC
/begin CHARACTERISTIC DFC_CtlMsk.DFC_MOXEMM_SMU_ALM6_20_C "Behaviour control mask / Behaviour control masks of check DFC_MOXEMM_SMU_ALM6_20" VALUE 0x804D901A Val_Wu16 65535.00 DFES_OneToOne 0.00 65535.00 FORMAT "%8.2" /end CHARACTERISTIC
/begin CHARACTERISTIC DFC_CtlMsk.DFC_MOXEMM_SMU_ALM6_21_C "Behaviour control mask / Behaviour control masks of check DFC_MOXEMM_SMU_ALM6_21" VALUE 0x804D901C Val_Wu16 65535.00 DFES_OneToOne 0.00 65535.00 FORMAT "%8.2" /end CHARACTERISTIC
/begin CHARACTERISTIC DFC_CtlMsk.DFC_MOXEMM_SMU_ALM6_25_C "Behaviour control mask / Behaviour control masks of check DFC_MOXEMM_SMU_ALM6_25" VALUE 0x804D901E Val_Wu16 65535.00 DFES_OneToOne 0.00 65535.00 FORMAT "%8.2" /end CHARACTERISTIC
/begin CHARACTERISTIC DFC_CtlMsk.DFC_MOXEMM_SMU_ALM6_4_C "Behaviour control mask / Behaviour control masks of check DFC_MOXEMM_SMU_ALM6_4" VALUE 0x804D9020 Val_Wu16 65535.00 DFES_OneToOne 0.00 65535.00 FORMAT "%8.2" /end CHARACTERISTIC
/begin CHARACTERISTIC DFC_CtlMsk.DFC_MOXEMM_SMU_ALM6_5_C "Behaviour control mask / Behaviour control masks of check DFC_MOXEMM_SMU_ALM6_5" VALUE 0x804D9022 Val_Wu16 65535.00 DFES_OneToOne 0.00 65535.00 FORMAT "%8.2" /end CHARACTERISTIC
/begin CHARACTERISTIC DFC_CtlMsk.DFC_MOXEMM_SMU_ALM6_7_C "Behaviour control mask / Behaviour control masks of check DFC_MOXEMM_SMU_ALM6_7" VALUE 0x804D9024 Val_Wu16 65535.00 DFES_OneToOne 0.00 65535.00 FORMAT "%8.2" /end CHARACTERISTIC
/begin CHARACTERISTIC DFC_CtlMsk.DFC_MOXEMM_SMU_ALM6_8_C "Behaviour control mask / Behaviour control masks of check DFC_MOXEMM_SMU_ALM6_8" VALUE 0x804D9026 Val_Wu16 65535.00 DFES_OneToOne 0.00 65535.00 FORMAT "%8.2" /end CHARACTERISTIC
/begin CHARACTERISTIC DFC_CtlMsk.DFC_MOXEMM_SMU_ALM7_1_C "Behaviour control mask / Behaviour control masks of check DFC_MOXEMM_SMU_ALM7_1" VALUE 0x804D9028 Val_Wu16 65535.00 DFES_OneToOne 0.00 65535.00 FORMAT "%8.2" /end CHARACTERISTIC
/begin CHARACTERISTIC DFC_CtlMsk.DFC_MOXEMM_SMU_ALM7_12_C "Behaviour control mask / Behaviour control masks of check DFC_MOXEMM_SMU_ALM7_12" VALUE 0x804D902A Val_Wu16 65535.00 DFES_OneToOne 0.00 65535.00 FORMAT "%8.2" /end CHARACTERISTIC
/begin CHARACTERISTIC DFC_CtlMsk.DFC_MOXEMM_SMU_ALM7_13_C "Behaviour control mask / Behaviour control masks of check DFC_MOXEMM_SMU_ALM7_13" VALUE 0x804D902C Val_Wu16 65535.00 DFES_OneToOne 0.00 65535.00 FORMAT "%8.2" /end CHARACTERISTIC
/begin CHARACTERISTIC DFC_CtlMsk.DFC_MOXEMM_SMU_ALM7_14_C "Behaviour control mask / Behaviour control masks of check DFC_MOXEMM_SMU_ALM7_14" VALUE 0x804D902E Val_Wu16 65535.00 DFES_OneToOne 0.00 65535.00 FORMAT "%8.2" /end CHARACTERISTIC
/begin CHARACTERISTIC DFC_CtlMsk.DFC_MOXEMM_SMU_ALM7_15_C "Behaviour control mask / Behaviour control masks of check DFC_MOXEMM_SMU_ALM7_15" VALUE 0x804D9030 Val_Wu16 65535.00 DFES_OneToOne 0.00 65535.00 FORMAT "%8.2" /end CHARACTERISTIC
/begin CHARACTERISTIC DFC_CtlMsk.DFC_MOXEMM_SMU_ALM7_16_C "Behaviour control mask / Behaviour control masks of check DFC_MOXEMM_SMU_ALM7_16" VALUE 0x804D9032 Val_Wu16 65535.00 DFES_OneToOne 0.00 65535.00 FORMAT "%8.2" /end CHARACTERISTIC
/begin CHARACTERISTIC DFC_CtlMsk.DFC_MOXEMM_SMU_ALM7_17_C "Behaviour control mask / Behaviour control masks of check DFC_MOXEMM_SMU_ALM7_17" VALUE 0x804D9034 Val_Wu16 65535.00 DFES_OneToOne 0.00 65535.00 FORMAT "%8.2" /end CHARACTERISTIC
/begin CHARACTERISTIC DFC_CtlMsk.DFC_MOXEMM_SMU_ALM7_2_C "Behaviour control mask / Behaviour control masks of check DFC_MOXEMM_SMU_ALM7_2" VALUE 0x804D9036 Val_Wu16 65535.00 DFES_OneToOne 0.00 65535.00 FORMAT "%8.2" /end CHARACTERISTIC
/begin CHARACTERISTIC DFC_CtlMsk.DFC_MOXEMM_SMU_ALM7_20_C "Behaviour control mask / Behaviour control masks of check DFC_MOXEMM_SMU_ALM7_20" VALUE 0x804D9038 Val_Wu16 65535.00 DFES_OneToOne 0.00 65535.00 FORMAT "%8.2" /end CHARACTERISTIC
/begin CHARACTERISTIC DFC_CtlMsk.DFC_MOXEMM_SMU_ALM7_25_C "Behaviour control mask / Behaviour control masks of check DFC_MOXEMM_SMU_ALM7_25" VALUE 0x804D903A Val_Wu16 65535.00 DFES_OneToOne 0.00 65535.00 FORMAT "%8.2" /end CHARACTERISTIC
/begin CHARACTERISTIC DFC_CtlMsk.DFC_MOXEMM_SMU_ALM7_26_C "Behaviour control mask / Behaviour control masks of check DFC_MOXEMM_SMU_ALM7_26" VALUE 0x804D903C Val_Wu16 65535.00 DFES_OneToOne 0.00 65535.00 FORMAT "%8.2" /end CHARACTERISTIC
/begin CHARACTERISTIC DFC_CtlMsk.DFC_MOXEMM_SMU_ALM7_28_C "Behaviour control mask / Behaviour control masks of check DFC_MOXEMM_SMU_ALM7_28" VALUE 0x804D903E Val_Wu16 65535.00 DFES_OneToOne 0.00 65535.00 FORMAT "%8.2" /end CHARACTERISTIC
/begin CHARACTERISTIC DFC_CtlMsk.DFC_MOXEMM_SMU_ALM7_29_C "Behaviour control mask / Behaviour control masks of check DFC_MOXEMM_SMU_ALM7_29" VALUE 0x804D9040 Val_Wu16 65535.00 DFES_OneToOne 0.00 65535.00 FORMAT "%8.2" /end CHARACTERISTIC
/begin CHARACTERISTIC DFC_CtlMsk.DFC_MOXEMM_SMU_ALM7_30_C "Behaviour control mask / Behaviour control masks of check DFC_MOXEMM_SMU_ALM7_30" VALUE 0x804D9042 Val_Wu16 65535.00 DFES_OneToOne 0.00 65535.00 FORMAT "%8.2" /end CHARACTERISTIC
/begin CHARACTERISTIC DFC_CtlMsk.DFC_MOXEMM_SMU_ALM7_31_C "Behaviour control mask / Behaviour control masks of check DFC_MOXEMM_SMU_ALM7_31" VALUE 0x804D9044 Val_Wu16 65535.00 DFES_OneToOne 0.00 65535.00 FORMAT "%8.2" /end CHARACTERISTIC
/begin CHARACTERISTIC DFC_CtlMsk.DFC_MOXEMM_SMU_ALM8_0_C "Behaviour control mask / Behaviour control masks of check DFC_MOXEMM_SMU_ALM8_0" VALUE 0x804D9046 Val_Wu16 65535.00 DFES_OneToOne 0.00 65535.00 FORMAT "%8.2" /end CHARACTERISTIC
/begin CHARACTERISTIC DFC_CtlMsk.DFC_MOXEMM_SMU_ALM8_1_C "Behaviour control mask / Behaviour control masks of check DFC_MOXEMM_SMU_ALM8_1" VALUE 0x804D9048 Val_Wu16 65535.00 DFES_OneToOne 0.00 65535.00 FORMAT "%8.2" /end CHARACTERISTIC
/begin CHARACTERISTIC DFC_CtlMsk.DFC_MOXEMM_SMU_ALM8_10_C "Behaviour control mask / Behaviour control masks of check DFC_MOXEMM_SMU_ALM8_10" VALUE 0x804D904A Val_Wu16 65535.00 DFES_OneToOne 0.00 65535.00 FORMAT "%8.2" /end CHARACTERISTIC
/begin CHARACTERISTIC DFC_CtlMsk.DFC_MOXEMM_SMU_ALM8_11_C "Behaviour control mask / Behaviour control masks of check DFC_MOXEMM_SMU_ALM8_11" VALUE 0x804D904C Val_Wu16 65535.00 DFES_OneToOne 0.00 65535.00 FORMAT "%8.2" /end CHARACTERISTIC
/begin CHARACTERISTIC DFC_CtlMsk.DFC_MOXEMM_SMU_ALM8_12_C "Behaviour control mask / Behaviour control masks of check DFC_MOXEMM_SMU_ALM8_12" VALUE 0x804D904E Val_Wu16 65535.00 DFES_OneToOne 0.00 65535.00 FORMAT "%8.2" /end CHARACTERISTIC
/begin CHARACTERISTIC DFC_CtlMsk.DFC_MOXEMM_SMU_ALM8_16_C "Behaviour control mask / Behaviour control masks of check DFC_MOXEMM_SMU_ALM8_16" VALUE 0x804D9050 Val_Wu16 65535.00 DFES_OneToOne 0.00 65535.00 FORMAT "%8.2" /end CHARACTERISTIC
/begin CHARACTERISTIC DFC_CtlMsk.DFC_MOXEMM_SMU_ALM8_18_C "Behaviour control mask / Behaviour control masks of check DFC_MOXEMM_SMU_ALM8_18" VALUE 0x804D9052 Val_Wu16 65535.00 DFES_OneToOne 0.00 65535.00 FORMAT "%8.2" /end CHARACTERISTIC
/begin CHARACTERISTIC DFC_CtlMsk.DFC_MOXEMM_SMU_ALM8_2_C "Behaviour control mask / Behaviour control masks of check DFC_MOXEMM_SMU_ALM8_2" VALUE 0x804D9054 Val_Wu16 65535.00 DFES_OneToOne 0.00 65535.00 FORMAT "%8.2" /end CHARACTERISTIC
/begin CHARACTERISTIC DFC_CtlMsk.DFC_MOXEMM_SMU_ALM8_3_C "Behaviour control mask / Behaviour control masks of check DFC_MOXEMM_SMU_ALM8_3" VALUE 0x804D9056 Val_Wu16 65535.00 DFES_OneToOne 0.00 65535.00 FORMAT "%8.2" /end CHARACTERISTIC
/begin CHARACTERISTIC DFC_CtlMsk.DFC_MOXEMM_SMU_ALM8_31_C "Behaviour control mask / Behaviour control masks of check DFC_MOXEMM_SMU_ALM8_31" VALUE 0x804D9058 Val_Wu16 65535.00 DFES_OneToOne 0.00 65535.00 FORMAT "%8.2" /end CHARACTERISTIC
/begin CHARACTERISTIC DFC_CtlMsk.DFC_MOXEMM_SMU_ALM8_4_C "Behaviour control mask / Behaviour control masks of check DFC_MOXEMM_SMU_ALM8_4" VALUE 0x804D905A Val_Wu16 65535.00 DFES_OneToOne 0.00 65535.00 FORMAT "%8.2" /end CHARACTERISTIC
/begin CHARACTERISTIC DFC_CtlMsk.DFC_MOXEMM_SMU_ALM9_0_C "Behaviour control mask / Behaviour control masks of check DFC_MOXEMM_SMU_ALM9_0" VALUE 0x804D905C Val_Wu16 65535.00 DFES_OneToOne 0.00 65535.00 FORMAT "%8.2" /end CHARACTERISTIC
/begin CHARACTERISTIC DFC_CtlMsk.DFC_MOXEMM_SMU_ALM9_15_C "Behaviour control mask / Behaviour control masks of check DFC_MOXEMM_SMU_ALM9_15" VALUE 0x804D905E Val_Wu16 65535.00 DFES_OneToOne 0.00 65535.00 FORMAT "%8.2" /end CHARACTERISTIC
/begin CHARACTERISTIC DFC_CtlMsk.DFC_MOXEMM_SMU_ALM9_3_C "Behaviour control mask / Behaviour control masks of check DFC_MOXEMM_SMU_ALM9_3" VALUE 0x804D9060 Val_Wu16 65535.00 DFES_OneToOne 0.00 65535.00 FORMAT "%8.2" /end CHARACTERISTIC
/begin CHARACTERISTIC DFC_CtlMsk.DFC_MoCADCNTP_C "Behaviour control mask / Behaviour control masks of check DFC_MoCADCNTP" VALUE 0x804D9062 Val_Wu16 65535.00 DFES_OneToOne 0.00 65535.00 FORMAT "%8.2" /end CHARACTERISTIC
/begin CHARACTERISTIC DFC_CtlMsk.DFC_MoCADCTst_C "Behaviour control mask / Behaviour control masks of check DFC_MoCADCTst" VALUE 0x804D9064 Val_Wu16 65535.00 DFES_OneToOne 0.00 65535.00 FORMAT "%8.2" /end CHARACTERISTIC
/begin CHARACTERISTIC DFC_CtlMsk.DFC_MoCSOPICO_C "Behaviour control mask / Behaviour control masks of check DFC_MoCSOPICO" VALUE 0x804D9066 Val_Wu16 65535.00 DFES_OneToOne 0.00 65535.00 FORMAT "%8.2" /end CHARACTERISTIC
/begin CHARACTERISTIC DFC_CtlMsk.DFC_MoFAPP_C "Behaviour control mask / Behaviour control masks of check DFC_MoFAPP" VALUE 0x804D9068 Val_Wu16 65535.00 DFES_OneToOne 0.00 65535.00 FORMAT "%8.2" /end CHARACTERISTIC
/begin CHARACTERISTIC DFC_CtlMsk.DFC_MoFAirFilgPrdc_C "Behaviour control mask / Behaviour control masks of check DFC_MoFAirFilgPrdc" VALUE 0x804D906A Val_Wu16 65535.00 DFES_OneToOne 0.00 65535.00 FORMAT "%8.2" /end CHARACTERISTIC
/begin CHARACTERISTIC DFC_CtlMsk.DFC_MoFAirFlCtOffPfi_C "Behaviour control mask / Behaviour control masks of check DFC_MoFAirFlCtOffPfi" VALUE 0x804D906C Val_Wu16 65535.00 DFES_OneToOne 0.00 65535.00 FORMAT "%8.2" /end CHARACTERISTIC
/begin CHARACTERISTIC DFC_CtlMsk.DFC_MoFAirFlCylPfi_C "Behaviour control mask / Behaviour control masks of check DFC_MoFAirFlCylPfi" VALUE 0x804D906E Val_Wu16 65535.00 DFES_OneToOne 0.00 65535.00 FORMAT "%8.2" /end CHARACTERISTIC
/begin CHARACTERISTIC DFC_CtlMsk.DFC_MoFAirFlIn_C "Behaviour control mask / Behaviour control masks of check DFC_MoFAirFlIn" VALUE 0x804D9070 Val_Wu16 65535.00 DFES_OneToOne 0.00 65535.00 FORMAT "%8.2" /end CHARACTERISTIC
/begin CHARACTERISTIC DFC_CtlMsk.DFC_MoFAirFlMixCtlPfiChkAirFl_C "Behaviour control mask / Behaviour control masks of check DFC_MoFAirFlMixCtlPfiChkAirFl" VALUE 0x804D9072 Val_Wu16 65535.00 DFES_OneToOne 0.00 65535.00 FORMAT "%8.2" /end CHARACTERISTIC
/begin CHARACTERISTIC DFC_CtlMsk.DFC_MoFAirFlMixCtlPfiChkCtrl_C "Behaviour control mask / Behaviour control masks of check DFC_MoFAirFlMixCtlPfiChkCtrl" VALUE 0x804D9074 Val_Wu16 65535.00 DFES_OneToOne 0.00 65535.00 FORMAT "%8.2" /end CHARACTERISTIC
/begin CHARACTERISTIC DFC_CtlMsk.DFC_MoFAirFlMode_C "Behaviour control mask / Behaviour control masks of check DFC_MoFAirFlMode" VALUE 0x804D9076 Val_Wu16 65535.00 DFES_OneToOne 0.00 65535.00 FORMAT "%8.2" /end CHARACTERISTIC
/begin CHARACTERISTIC DFC_CtlMsk.DFC_MoFESpd_C "Behaviour control mask / Behaviour control masks of check DFC_MoFESpd" VALUE 0x804D9078 Val_Wu16 65535.00 DFES_OneToOne 0.00 65535.00 FORMAT "%8.2" /end CHARACTERISTIC
/begin CHARACTERISTIC DFC_CtlMsk.DFC_MoFIACo_C "Behaviour control mask / Behaviour control masks of check DFC_MoFIACo" VALUE 0x804D907A Val_Wu16 65535.00 DFES_OneToOne 0.00 65535.00 FORMAT "%8.2" /end CHARACTERISTIC
/begin CHARACTERISTIC DFC_CtlMsk.DFC_MoFICOL1_C "Behaviour control mask / Behaviour control masks of check DFC_MoFICOL1" VALUE 0x804D907C Val_Wu16 65535.00 DFES_OneToOne 0.00 65535.00 FORMAT "%8.2" /end CHARACTERISTIC
/begin CHARACTERISTIC DFC_CtlMsk.DFC_MoFICOL2_C "Behaviour control mask / Behaviour control masks of check DFC_MoFICOL2" VALUE 0x804D907E Val_Wu16 65535.00 DFES_OneToOne 0.00 65535.00 FORMAT "%8.2" /end CHARACTERISTIC
/begin CHARACTERISTIC DFC_CtlMsk.DFC_MoFStrt_C "Behaviour control mask / Behaviour control masks of check DFC_MoFStrt" VALUE 0x804D9080 Val_Wu16 65535.00 DFES_OneToOne 0.00 65535.00 FORMAT "%8.2" /end CHARACTERISTIC
/begin CHARACTERISTIC DFC_CtlMsk.DFC_MoFTrqCmp_C "Behaviour control mask / Behaviour control masks of check DFC_MoFTrqCmp" VALUE 0x804D9082 Val_Wu16 65535.00 DFES_OneToOne 0.00 65535.00 FORMAT "%8.2" /end CHARACTERISTIC
/begin CHARACTERISTIC DFC_CtlMsk.DFC_MoFTrqCmpMax_C "Behaviour control mask / Behaviour control masks of check DFC_MoFTrqCmpMax" VALUE 0x804D9084 Val_Wu16 65535.00 DFES_OneToOne 0.00 65535.00 FORMAT "%8.2" /end CHARACTERISTIC
/begin CHARACTERISTIC DFC_CtlMsk.DFC_MoFTrqCmpMin_C "Behaviour control mask / Behaviour control masks of check DFC_MoFTrqCmpMin" VALUE 0x804D9086 Val_Wu16 65535.00 DFES_OneToOne 0.00 65535.00 FORMAT "%8.2" /end CHARACTERISTIC
/begin CHARACTERISTIC DFC_CtlMsk.DFC_MoFVarPostBldSel_C "Behaviour control mask / Behaviour control masks of check DFC_MoFVarPostBldSel" VALUE 0x804D9088 Val_Wu16 65535.00 DFES_OneToOne 0.00 65535.00 FORMAT "%8.2" /end CHARACTERISTIC
/begin CHARACTERISTIC DFC_CtlMsk.DFC_MoXEMMHwLTMCUFW_C "Behaviour control mask / Behaviour control masks of check DFC_MoXEMMHwLTMCUFW" VALUE 0x804D908A Val_Wu16 65535.00 DFES_OneToOne 0.00 65535.00 FORMAT "%8.2" /end CHARACTERISTIC
/begin CHARACTERISTIC DFC_CtlMsk.DFC_MoXEMMHwLTMonBIST_C "Behaviour control mask / Behaviour control masks of check DFC_MoXEMMHwLTMonBIST" VALUE 0x804D908C Val_Wu16 65535.00 DFES_OneToOne 0.00 65535.00 FORMAT "%8.2" /end CHARACTERISTIC
/begin CHARACTERISTIC DFC_CtlMsk.DFC_MoXEMMHwLTRegMonTest_C "Behaviour control mask / Behaviour control masks of check DFC_MoXEMMHwLTRegMonTest" VALUE 0x804D908E Val_Wu16 65535.00 DFES_OneToOne 0.00 65535.00 FORMAT "%8.2" /end CHARACTERISTIC
/begin CHARACTERISTIC DFC_CtlMsk.DFC_MoXEMMHwLTStbySMUAlvTest_C "Behaviour control mask / Behaviour control masks of check DFC_MoXEMMHwLTStbySMUAlvTest" VALUE 0x804D9090 Val_Wu16 65535.00 DFES_OneToOne 0.00 65535.00 FORMAT "%8.2" /end CHARACTERISTIC
/begin CHARACTERISTIC DFC_CtlMsk.DFC_MoXEMMHwLTTempSens_C "Behaviour control mask / Behaviour control masks of check DFC_MoXEMMHwLTTempSens" VALUE 0x804D9092 Val_Wu16 65535.00 DFES_OneToOne 0.00 65535.00 FORMAT "%8.2" /end CHARACTERISTIC
/begin CHARACTERISTIC DFC_CtlMsk.DFC_MoXEMMHwLTUCBCfg_C "Behaviour control mask / Behaviour control masks of check DFC_MoXEMMHwLTUCBCfg" VALUE 0x804D9094 Val_Wu16 65535.00 DFES_OneToOne 0.00 65535.00 FORMAT "%8.2" /end CHARACTERISTIC
/begin CHARACTERISTIC DFC_CtlMsk.DFC_OCWDAABEActv_C "Behaviour control mask / Behaviour control masks of check DFC_OCWDAABEActv" VALUE 0x804D9096 Val_Wu16 65535.00 DFES_OneToOne 0.00 65535.00 FORMAT "%8.2" /end CHARACTERISTIC
/begin CHARACTERISTIC DFC_CtlMsk.DFC_OCWDACom_C "Behaviour control mask / Behaviour control masks of check DFC_OCWDACom" VALUE 0x804D9098 Val_Wu16 65535.00 DFES_OneToOne 0.00 65535.00 FORMAT "%8.2" /end CHARACTERISTIC
/begin CHARACTERISTIC DFC_CtlMsk.DFC_OCWDAErrPin_C "Behaviour control mask / Behaviour control masks of check DFC_OCWDAErrPin" VALUE 0x804D909A Val_Wu16 65535.00 DFES_OneToOne 0.00 65535.00 FORMAT "%8.2" /end CHARACTERISTIC
/begin CHARACTERISTIC DFC_CtlMsk.DFC_OCWDAOvrVltg_C "Behaviour control mask / Behaviour control masks of check DFC_OCWDAOvrVltg" VALUE 0x804D909C Val_Wu16 65535.00 DFES_OneToOne 0.00 65535.00 FORMAT "%8.2" /end CHARACTERISTIC
/begin CHARACTERISTIC DFC_CtlMsk.DFC_ORAmax_C "Behaviour control mask / Behaviour control masks of check DFC_ORAmax" VALUE 0x804D909E Val_Wu16 65535.00 DFES_OneToOne 0.00 65535.00 FORMAT "%8.2" /end CHARACTERISTIC
/begin CHARACTERISTIC DFC_CtlMsk.DFC_ORAmin_C "Behaviour control mask / Behaviour control masks of check DFC_ORAmin" VALUE 0x804D90A0 Val_Wu16 65535.00 DFES_OneToOne 0.00 65535.00 FORMAT "%8.2" /end CHARACTERISTIC
/begin CHARACTERISTIC DFC_CtlMsk.DFC_PLLSUmax_C "Behaviour control mask / Behaviour control masks of check DFC_PLLSUmax" VALUE 0x804D90A2 Val_Wu16 65535.00 DFES_OneToOne 0.00 65535.00 FORMAT "%8.2" /end CHARACTERISTIC
/begin CHARACTERISTIC DFC_CtlMsk.DFC_PLLSUmin_C "Behaviour control mask / Behaviour control masks of check DFC_PLLSUmin" VALUE 0x804D90A4 Val_Wu16 65535.00 DFES_OneToOne 0.00 65535.00 FORMAT "%8.2" /end CHARACTERISTIC
/begin CHARACTERISTIC DFC_CtlMsk.DFC_PSR1max_C "Behaviour control mask / Behaviour control masks of check DFC_PSR1max" VALUE 0x804D90A6 Val_Wu16 65535.00 DFES_OneToOne 0.00 65535.00 FORMAT "%8.2" /end CHARACTERISTIC
/begin CHARACTERISTIC DFC_CtlMsk.DFC_PSRBmax_C "Behaviour control mask / Behaviour control masks of check DFC_PSRBmax" VALUE 0x804D90A8 Val_Wu16 65535.00 DFES_OneToOne 0.00 65535.00 FORMAT "%8.2" /end CHARACTERISTIC
/begin CHARACTERISTIC DFC_CtlMsk.DFC_PSRBmin_C "Behaviour control mask / Behaviour control masks of check DFC_PSRBmin" VALUE 0x804D90AA Val_Wu16 65535.00 DFES_OneToOne 0.00 65535.00 FORMAT "%8.2" /end CHARACTERISTIC
/begin CHARACTERISTIC DFC_CtlMsk.DFC_PSRPmax_C "Behaviour control mask / Behaviour control masks of check DFC_PSRPmax" VALUE 0x804D90AC Val_Wu16 65535.00 DFES_OneToOne 0.00 65535.00 FORMAT "%8.2" /end CHARACTERISTIC
/begin CHARACTERISTIC DFC_CtlMsk.DFC_PSRPmin_C "Behaviour control mask / Behaviour control masks of check DFC_PSRPmin" VALUE 0x804D90AE Val_Wu16 65535.00 DFES_OneToOne 0.00 65535.00 FORMAT "%8.2" /end CHARACTERISTIC
/begin CHARACTERISTIC DFC_CtlMsk.DFC_PSRPsig_C "Behaviour control mask / Behaviour control masks of check DFC_PSRPsig" VALUE 0x804D90B0 Val_Wu16 65535.00 DFES_OneToOne 0.00 65535.00 FORMAT "%8.2" /end CHARACTERISTIC
/begin CHARACTERISTIC DFC_CtlMsk.DFC_PSRmax_C "Behaviour control mask / Behaviour control masks of check DFC_PSRmax" VALUE 0x804D90B2 Val_Wu16 65535.00 DFES_OneToOne 0.00 65535.00 FORMAT "%8.2" /end CHARACTERISTIC
/begin CHARACTERISTIC DFC_CtlMsk.DFC_PUmax_C "Behaviour control mask / Behaviour control masks of check DFC_PUmax" VALUE 0x804D90B4 Val_Wu16 65535.00 DFES_OneToOne 0.00 65535.00 FORMAT "%8.2" /end CHARACTERISTIC
/begin CHARACTERISTIC DFC_CtlMsk.DFC_P_VSE11_OL_C "Behaviour control mask / Behaviour control masks of check DFC_P_VSE11_OL" VALUE 0x804D90B6 Val_Wu16 65535.00 DFES_OneToOne 0.00 65535.00 FORMAT "%8.2" /end CHARACTERISTIC
/begin CHARACTERISTIC DFC_CtlMsk.DFC_P_VSE11_SCB_C "Behaviour control mask / Behaviour control masks of check DFC_P_VSE11_SCB" VALUE 0x804D90B8 Val_Wu16 65535.00 DFES_OneToOne 0.00 65535.00 FORMAT "%8.2" /end CHARACTERISTIC
/begin CHARACTERISTIC DFC_CtlMsk.DFC_P_VSE11_SCG_C "Behaviour control mask / Behaviour control masks of check DFC_P_VSE11_SCG" VALUE 0x804D90BA Val_Wu16 65535.00 DFES_OneToOne 0.00 65535.00 FORMAT "%8.2" /end CHARACTERISTIC
/begin CHARACTERISTIC DFC_CtlMsk.DFC_PhyHighAPP1_C "Behaviour control mask / Behaviour control masks of check DFC_PhyHighAPP1" VALUE 0x804D90BC Val_Wu16 65535.00 DFES_OneToOne 0.00 65535.00 FORMAT "%8.2" /end CHARACTERISTIC
/begin CHARACTERISTIC DFC_CtlMsk.DFC_PhyHighAPP2_C "Behaviour control mask / Behaviour control masks of check DFC_PhyHighAPP2" VALUE 0x804D90BE Val_Wu16 65535.00 DFES_OneToOne 0.00 65535.00 FORMAT "%8.2" /end CHARACTERISTIC
/begin CHARACTERISTIC DFC_CtlMsk.DFC_PhyLowAPP1_C "Behaviour control mask / Behaviour control masks of check DFC_PhyLowAPP1" VALUE 0x804D90C0 Val_Wu16 65535.00 DFES_OneToOne 0.00 65535.00 FORMAT "%8.2" /end CHARACTERISTIC
/begin CHARACTERISTIC DFC_CtlMsk.DFC_PhyLowAPP2_C "Behaviour control mask / Behaviour control masks of check DFC_PhyLowAPP2" VALUE 0x804D90C2 Val_Wu16 65535.00 DFES_OneToOne 0.00 65535.00 FORMAT "%8.2" /end CHARACTERISTIC
/begin CHARACTERISTIC DFC_CtlMsk.DFC_SRCHighAPP1_C "Behaviour control mask / Behaviour control masks of check DFC_SRCHighAPP1" VALUE 0x804D90C4 Val_Wu16 65535.00 DFES_OneToOne 0.00 65535.00 FORMAT "%8.2" /end CHARACTERISTIC
/begin CHARACTERISTIC DFC_CtlMsk.DFC_SRCHighAPP2_C "Behaviour control mask / Behaviour control masks of check DFC_SRCHighAPP2" VALUE 0x804D90C6 Val_Wu16 65535.00 DFES_OneToOne 0.00 65535.00 FORMAT "%8.2" /end CHARACTERISTIC
/begin CHARACTERISTIC DFC_CtlMsk.DFC_SRCLowAPP1_C "Behaviour control mask / Behaviour control masks of check DFC_SRCLowAPP1" VALUE 0x804D90C8 Val_Wu16 65535.00 DFES_OneToOne 0.00 65535.00 FORMAT "%8.2" /end CHARACTERISTIC
/begin CHARACTERISTIC DFC_CtlMsk.DFC_SRCLowAPP2_C "Behaviour control mask / Behaviour control masks of check DFC_SRCLowAPP2" VALUE 0x804D90CA Val_Wu16 65535.00 DFES_OneToOne 0.00 65535.00 FORMAT "%8.2" /end CHARACTERISTIC
/begin CHARACTERISTIC DFC_CtlMsk.DFC_SSpMon2_C "Behaviour control mask / Behaviour control masks of check DFC_SSpMon2" VALUE 0x804D90CC Val_Wu16 65535.00 DFES_OneToOne 0.00 65535.00 FORMAT "%8.2" /end CHARACTERISTIC
/begin CHARACTERISTIC DFC_CtlMsk.DFC_SWReset_0_C "Behaviour control mask / Behaviour control masks of check DFC_SWReset_0" VALUE 0x804D90CE Val_Wu16 65535.00 DFES_OneToOne 0.00 65535.00 FORMAT "%8.2" /end CHARACTERISTIC
/begin CHARACTERISTIC DFC_CtlMsk.DFC_SWReset_1_C "Behaviour control mask / Behaviour control masks of check DFC_SWReset_1" VALUE 0x804D90D0 Val_Wu16 65535.00 DFES_OneToOne 0.00 65535.00 FORMAT "%8.2" /end CHARACTERISTIC
/begin CHARACTERISTIC DFC_CtlMsk.DFC_SWReset_2_C "Behaviour control mask / Behaviour control masks of check DFC_SWReset_2" VALUE 0x804D90D2 Val_Wu16 65535.00 DFES_OneToOne 0.00 65535.00 FORMAT "%8.2" /end CHARACTERISTIC
/begin CHARACTERISTIC DFC_CtlMsk.DFC_SyncAPP_C "Behaviour control mask / Behaviour control masks of check DFC_SyncAPP" VALUE 0x804D90D4 Val_Wu16 65535.00 DFES_OneToOne 0.00 65535.00 FORMAT "%8.2" /end CHARACTERISTIC
/begin CHARACTERISTIC DFC_CtlMsk.DFC_TAmax_Dummy_C "Behaviour control mask / Behaviour control masks of check DFC_TAmax_Dummy" VALUE 0x804D90D6 Val_Wu16 65535.00 DFES_OneToOne 0.00 65535.00 FORMAT "%8.2" /end CHARACTERISTIC
/begin CHARACTERISTIC DFC_CtlMsk.DFC_TKAEmax_C "Behaviour control mask / Behaviour control masks of check DFC_TKAEmax" VALUE 0x804D90D8 Val_Wu16 65535.00 DFES_OneToOne 0.00 65535.00 FORMAT "%8.2" /end CHARACTERISTIC
/begin CHARACTERISTIC DFC_CtlMsk.DFC_TKAEmin_C "Behaviour control mask / Behaviour control masks of check DFC_TKAEmin" VALUE 0x804D90DA Val_Wu16 65535.00 DFES_OneToOne 0.00 65535.00 FORMAT "%8.2" /end CHARACTERISTIC
/begin CHARACTERISTIC DFC_CtlMsk.DFC_TKARmax_C "Behaviour control mask / Behaviour control masks of check DFC_TKARmax" VALUE 0x804D90DC Val_Wu16 65535.00 DFES_OneToOne 0.00 65535.00 FORMAT "%8.2" /end CHARACTERISTIC
/begin CHARACTERISTIC DFC_CtlMsk.DFC_TKARnpl_C "Behaviour control mask / Behaviour control masks of check DFC_TKARnpl" VALUE 0x804D90DE Val_Wu16 65535.00 DFES_OneToOne 0.00 65535.00 FORMAT "%8.2" /end CHARACTERISTIC
/begin CHARACTERISTIC DFC_CtlMsk.DFC_TMmax_Dummy_C "Behaviour control mask / Behaviour control masks of check DFC_TMmax_Dummy" VALUE 0x804D90E0 Val_Wu16 65535.00 DFES_OneToOne 0.00 65535.00 FORMAT "%8.2" /end CHARACTERISTIC
/begin CHARACTERISTIC DFC_CtlMsk.DFC_TUMmax_Dummy_C "Behaviour control mask / Behaviour control masks of check DFC_TUMmax_Dummy" VALUE 0x804D90E2 Val_Wu16 65535.00 DFES_OneToOne 0.00 65535.00 FORMAT "%8.2" /end CHARACTERISTIC
/begin CHARACTERISTIC DFC_CtlMsk.DFC_TWCDPriCatB1_C "Behaviour control mask / Behaviour control masks of check DFC_TWCDPriCatB1" VALUE 0x804D90E4 Val_Wu16 65535.00 DFES_OneToOne 0.00 65535.00 FORMAT "%8.2" /end CHARACTERISTIC
/begin CHARACTERISTIC DFC_CtlMsk.DFC_ThrVlvClsdPosnFirstOffsLrnImpoB1_C "Behaviour control mask / Behaviour control masks of check DFC_ThrVlvClsdPosnFirstOffsLrnImpoB1" VALUE 0x804D90E6 Val_Wu16 65535.00 DFES_OneToOne 0.00 65535.00 FORMAT "%8.2" /end CHARACTERISTIC
/begin CHARACTERISTIC DFC_CtlMsk.DFC_ThrVlvClsdPosnOffsLrnImpoB1_C "Behaviour control mask / Behaviour control masks of check DFC_ThrVlvClsdPosnOffsLrnImpoB1" VALUE 0x804D90E8 Val_Wu16 65535.00 DFES_OneToOne 0.00 65535.00 FORMAT "%8.2" /end CHARACTERISTIC
/begin CHARACTERISTIC DFC_CtlMsk.DFC_ThrVlvClsdPosnOffsLrnMaxB1_C "Behaviour control mask / Behaviour control masks of check DFC_ThrVlvClsdPosnOffsLrnMaxB1" VALUE 0x804D90EA Val_Wu16 65535.00 DFES_OneToOne 0.00 65535.00 FORMAT "%8.2" /end CHARACTERISTIC
/begin CHARACTERISTIC DFC_CtlMsk.DFC_ThrVlvClsdPosnOffsLrnMinB1_C "Behaviour control mask / Behaviour control masks of check DFC_ThrVlvClsdPosnOffsLrnMinB1" VALUE 0x804D90EC Val_Wu16 65535.00 DFES_OneToOne 0.00 65535.00 FORMAT "%8.2" /end CHARACTERISTIC
/begin CHARACTERISTIC DFC_CtlMsk.DFC_ThrVlvCtrlDeB1_C "Behaviour control mask / Behaviour control masks of check DFC_ThrVlvCtrlDeB1" VALUE 0x804D90EE Val_Wu16 65535.00 DFES_OneToOne 0.00 65535.00 FORMAT "%8.2" /end CHARACTERISTIC
/begin CHARACTERISTIC DFC_CtlMsk.DFC_ThrVlvDycB1_C "Behaviour control mask / Behaviour control masks of check DFC_ThrVlvDycB1" VALUE 0x804D90F0 Val_Wu16 65535.00 DFES_OneToOne 0.00 65535.00 FORMAT "%8.2" /end CHARACTERISTIC
/begin CHARACTERISTIC DFC_CtlMsk.DFC_ThrVlvLimpAirPosnMaxAbsltDriftB1_C "Behaviour control mask / Behaviour control masks of check DFC_ThrVlvLimpAirPosnMaxAbsltDriftB1" VALUE 0x804D90F2 Val_Wu16 65535.00 DFES_OneToOne 0.00 65535.00 FORMAT "%8.2" /end CHARACTERISTIC
/begin CHARACTERISTIC DFC_CtlMsk.DFC_ThrVlvLimpAirPosnMaxB1_C "Behaviour control mask / Behaviour control masks of check DFC_ThrVlvLimpAirPosnMaxB1" VALUE 0x804D90F4 Val_Wu16 65535.00 DFES_OneToOne 0.00 65535.00 FORMAT "%8.2" /end CHARACTERISTIC
/begin CHARACTERISTIC DFC_CtlMsk.DFC_ThrVlvLimpAirPosnMaxRelDriftB1_C "Behaviour control mask / Behaviour control masks of check DFC_ThrVlvLimpAirPosnMaxRelDriftB1" VALUE 0x804D90F6 Val_Wu16 65535.00 DFES_OneToOne 0.00 65535.00 FORMAT "%8.2" /end CHARACTERISTIC
/begin CHARACTERISTIC DFC_CtlMsk.DFC_ThrVlvLimpAirPosnMinB1_C "Behaviour control mask / Behaviour control masks of check DFC_ThrVlvLimpAirPosnMinB1" VALUE 0x804D90F8 Val_Wu16 65535.00 DFES_OneToOne 0.00 65535.00 FORMAT "%8.2" /end CHARACTERISTIC
/begin CHARACTERISTIC DFC_CtlMsk.DFC_ThrVlvOpenLoadB1_C "Behaviour control mask / Behaviour control masks of check DFC_ThrVlvOpenLoadB1" VALUE 0x804D90FA Val_Wu16 65535.00 DFES_OneToOne 0.00 65535.00 FORMAT "%8.2" /end CHARACTERISTIC
/begin CHARACTERISTIC DFC_CtlMsk.DFC_ThrVlvOpenSprgB1_C "Behaviour control mask / Behaviour control masks of check DFC_ThrVlvOpenSprgB1" VALUE 0x804D90FC Val_Wu16 65535.00 DFES_OneToOne 0.00 65535.00 FORMAT "%8.2" /end CHARACTERISTIC
/begin CHARACTERISTIC DFC_CtlMsk.DFC_ThrVlvOpenSprgSprdB1_C "Behaviour control mask / Behaviour control masks of check DFC_ThrVlvOpenSprgSprdB1" VALUE 0x804D90FE Val_Wu16 65535.00 DFES_OneToOne 0.00 65535.00 FORMAT "%8.2" /end CHARACTERISTIC
/begin CHARACTERISTIC DFC_CtlMsk.DFC_ThrVlvOpenSprgTwnB1_C "Behaviour control mask / Behaviour control masks of check DFC_ThrVlvOpenSprgTwnB1" VALUE 0x804D9100 Val_Wu16 65535.00 DFES_OneToOne 0.00 65535.00 FORMAT "%8.2" /end CHARACTERISTIC
/begin CHARACTERISTIC DFC_CtlMsk.DFC_ThrVlvOverTB1_C "Behaviour control mask / Behaviour control masks of check DFC_ThrVlvOverTB1" VALUE 0x804D9102 Val_Wu16 65535.00 DFES_OneToOne 0.00 65535.00 FORMAT "%8.2" /end CHARACTERISTIC
/begin CHARACTERISTIC DFC_CtlMsk.DFC_ThrVlvRetSprgB1_C "Behaviour control mask / Behaviour control masks of check DFC_ThrVlvRetSprgB1" VALUE 0x804D9104 Val_Wu16 65535.00 DFES_OneToOne 0.00 65535.00 FORMAT "%8.2" /end CHARACTERISTIC
/begin CHARACTERISTIC DFC_CtlMsk.DFC_ThrVlvRetSprgSprdB1_C "Behaviour control mask / Behaviour control masks of check DFC_ThrVlvRetSprgSprdB1" VALUE 0x804D9106 Val_Wu16 65535.00 DFES_OneToOne 0.00 65535.00 FORMAT "%8.2" /end CHARACTERISTIC
/begin CHARACTERISTIC DFC_CtlMsk.DFC_ThrVlvRetSprgTwnB1_C "Behaviour control mask / Behaviour control masks of check DFC_ThrVlvRetSprgTwnB1" VALUE 0x804D9108 Val_Wu16 65535.00 DFES_OneToOne 0.00 65535.00 FORMAT "%8.2" /end CHARACTERISTIC
/begin CHARACTERISTIC DFC_CtlMsk.DFC_ThrVlvSens1MaxB1_C "Behaviour control mask / Behaviour control masks of check DFC_ThrVlvSens1MaxB1" VALUE 0x804D910A Val_Wu16 65535.00 DFES_OneToOne 0.00 65535.00 FORMAT "%8.2" /end CHARACTERISTIC
/begin CHARACTERISTIC DFC_CtlMsk.DFC_ThrVlvSens1NplB1_C "Behaviour control mask / Behaviour control masks of check DFC_ThrVlvSens1NplB1" VALUE 0x804D910C Val_Wu16 65535.00 DFES_OneToOne 0.00 65535.00 FORMAT "%8.2" /end CHARACTERISTIC
/begin CHARACTERISTIC DFC_CtlMsk.DFC_ThrVlvSens2MaxB1_C "Behaviour control mask / Behaviour control masks of check DFC_ThrVlvSens2MaxB1" VALUE 0x804D910E Val_Wu16 65535.00 DFES_OneToOne 0.00 65535.00 FORMAT "%8.2" /end CHARACTERISTIC
/begin CHARACTERISTIC DFC_CtlMsk.DFC_ThrVlvSens2MinB1_C "Behaviour control mask / Behaviour control masks of check DFC_ThrVlvSens2MinB1" VALUE 0x804D9110 Val_Wu16 65535.00 DFES_OneToOne 0.00 65535.00 FORMAT "%8.2" /end CHARACTERISTIC
/begin CHARACTERISTIC DFC_CtlMsk.DFC_ThrVlvSens2NplB1_C "Behaviour control mask / Behaviour control masks of check DFC_ThrVlvSens2NplB1" VALUE 0x804D9112 Val_Wu16 65535.00 DFES_OneToOne 0.00 65535.00 FORMAT "%8.2" /end CHARACTERISTIC
/begin CHARACTERISTIC DFC_CtlMsk.DFC_ThrVlvShoCircB1_C "Behaviour control mask / Behaviour control masks of check DFC_ThrVlvShoCircB1" VALUE 0x804D9114 Val_Wu16 65535.00 DFES_OneToOne 0.00 65535.00 FORMAT "%8.2" /end CHARACTERISTIC
/begin CHARACTERISTIC DFC_CtlMsk.DFC_ThrVlvSpiErrB1_C "Behaviour control mask / Behaviour control masks of check DFC_ThrVlvSpiErrB1" VALUE 0x804D9116 Val_Wu16 65535.00 DFES_OneToOne 0.00 65535.00 FORMAT "%8.2" /end CHARACTERISTIC
/begin CHARACTERISTIC DFC_CtlMsk.DFC_ThrvlvSens1MinB1_C "Behaviour control mask / Behaviour control masks of check DFC_ThrvlvSens1MinB1" VALUE 0x804D9118 Val_Wu16 65535.00 DFES_OneToOne 0.00 65535.00 FORMAT "%8.2" /end CHARACTERISTIC
/begin CHARACTERISTIC DFC_CtlMsk.DFC_TiOffTBasdChkFast_C "Behaviour control mask / Behaviour control masks of check DFC_TiOffTBasdChkFast" VALUE 0x804D911A Val_Wu16 65535.00 DFES_OneToOne 0.00 65535.00 FORMAT "%8.2" /end CHARACTERISTIC
/begin CHARACTERISTIC DFC_CtlMsk.DFC_TiOffTBasdChkSlow_C "Behaviour control mask / Behaviour control masks of check DFC_TiOffTBasdChkSlow" VALUE 0x804D911C Val_Wu16 65535.00 DFES_OneToOne 0.00 65535.00 FORMAT "%8.2" /end CHARACTERISTIC
/begin CHARACTERISTIC DFC_CtlMsk.DFC_UEGOHeatrCtlS1B1_C "Behaviour control mask / Behaviour control masks of check DFC_UEGOHeatrCtlS1B1" VALUE 0x804D911E Val_Wu16 65535.00 DFES_OneToOne 0.00 65535.00 FORMAT "%8.2" /end CHARACTERISTIC
/begin CHARACTERISTIC DFC_CtlMsk.DFC_UEGOSnsrMntdS1B1_C "Behaviour control mask / Behaviour control masks of check DFC_UEGOSnsrMntdS1B1" VALUE 0x804D9120 Val_Wu16 65535.00 DFES_OneToOne 0.00 65535.00 FORMAT "%8.2" /end CHARACTERISTIC
/begin CHARACTERISTIC DFC_CtlMsk.DFC_VehVSig_C "Behaviour control mask / Behaviour control masks of check DFC_VehVSig" VALUE 0x804D9122 Val_Wu16 65535.00 DFES_OneToOne 0.00 65535.00 FORMAT "%8.2" /end CHARACTERISTIC
/begin CHARACTERISTIC DFC_CtlMsk.DFC_VlvLftFbSwtIntk11SpclFail_C "Behaviour control mask / Behaviour control masks of check DFC_VlvLftFbSwtIntk11SpclFail" VALUE 0x804D9124 Val_Wu16 65535.00 DFES_OneToOne 0.00 65535.00 FORMAT "%8.2" /end CHARACTERISTIC
/begin CHARACTERISTIC DFC_CtlMsk.DFC_VlvLftFbSwtIntk11StdFail_C "Behaviour control mask / Behaviour control masks of check DFC_VlvLftFbSwtIntk11StdFail" VALUE 0x804D9126 Val_Wu16 65535.00 DFES_OneToOne 0.00 65535.00 FORMAT "%8.2" /end CHARACTERISTIC
/begin CHARACTERISTIC DFC_DisblMsk.DFC_Unused_C "disable mask / " VALUE 0x804EE62E Val_Wu16 65535.00 DFES_OneToOne 0.00 65535.00 FORMAT "%8.2" READ_ONLY /end CHARACTERISTIC
/begin CHARACTERISTIC DFC_DisblMsk.DFC_AltIOACGFailr_C "disable mask / Disable masks of check DFC_AltIOACGFailr" VALUE 0x804EE630 Val_Wu16 65535.00 DFES_OneToOne 0.00 65535.00 FORMAT "%8.2" /end CHARACTERISTIC
/begin CHARACTERISTIC DFC_DisblMsk.DFC_AltIOACGHiVltg_C "disable mask / Disable masks of check DFC_AltIOACGHiVltg" VALUE 0x804EE632 Val_Wu16 65535.00 DFES_OneToOne 0.00 65535.00 FORMAT "%8.2" /end CHARACTERISTIC
/begin CHARACTERISTIC DFC_DisblMsk.DFC_AltIOACGLoVltg_C "disable mask / Disable masks of check DFC_AltIOACGLoVltg" VALUE 0x804EE634 Val_Wu16 65535.00 DFES_OneToOne 0.00 65535.00 FORMAT "%8.2" /end CHARACTERISTIC
/begin CHARACTERISTIC DFC_DisblMsk.DFC_AltIOACGTHi_C "disable mask / Disable masks of check DFC_AltIOACGTHi" VALUE 0x804EE636 Val_Wu16 65535.00 DFES_OneToOne 0.00 65535.00 FORMAT "%8.2" /end CHARACTERISTIC
/begin CHARACTERISTIC DFC_DisblMsk.DFC_AltIODConnACG_C "disable mask / Disable masks of check DFC_AltIODConnACG" VALUE 0x804EE638 Val_Wu16 65535.00 DFES_OneToOne 0.00 65535.00 FORMAT "%8.2" /end CHARACTERISTIC
/begin CHARACTERISTIC DFC_DisblMsk.DFC_BattUHiFailr_C "disable mask / Disable masks of check DFC_BattUHiFailr" VALUE 0x804EE63A Val_Wu16 65535.00 DFES_OneToOne 0.00 65535.00 FORMAT "%8.2" /end CHARACTERISTIC
/begin CHARACTERISTIC DFC_DisblMsk.DFC_BattULoFailr_C "disable mask / Disable masks of check DFC_BattULoFailr" VALUE 0x804EE63C Val_Wu16 65535.00 DFES_OneToOne 0.00 65535.00 FORMAT "%8.2" /end CHARACTERISTIC
/begin CHARACTERISTIC DFC_DisblMsk.DFC_BrkBstPDriftHiErr_C "disable mask / Disable masks of check DFC_BrkBstPDriftHiErr" VALUE 0x804EE63E Val_Wu16 65535.00 DFES_OneToOne 0.00 65535.00 FORMAT "%8.2" /end CHARACTERISTIC
/begin CHARACTERISTIC DFC_DisblMsk.DFC_BrkBstPDriftLoErr_C "disable mask / Disable masks of check DFC_BrkBstPDriftLoErr" VALUE 0x804EE640 Val_Wu16 65535.00 DFES_OneToOne 0.00 65535.00 FORMAT "%8.2" /end CHARACTERISTIC
/begin CHARACTERISTIC DFC_DisblMsk.DFC_BrkBstPSnsrStuck_C "disable mask / Disable masks of check DFC_BrkBstPSnsrStuck" VALUE 0x804EE642 Val_Wu16 65535.00 DFES_OneToOne 0.00 65535.00 FORMAT "%8.2" /end CHARACTERISTIC
/begin CHARACTERISTIC DFC_DisblMsk.DFC_BrkMnSwtContOn_C "disable mask / Disable masks of check DFC_BrkMnSwtContOn" VALUE 0x804EE644 Val_Wu16 65535.00 DFES_OneToOne 0.00 65535.00 FORMAT "%8.2" /end CHARACTERISTIC
/begin CHARACTERISTIC DFC_DisblMsk.DFC_BrkMnSwtNotStp_C "disable mask / Disable masks of check DFC_BrkMnSwtNotStp" VALUE 0x804EE646 Val_Wu16 65535.00 DFES_OneToOne 0.00 65535.00 FORMAT "%8.2" /end CHARACTERISTIC
/begin CHARACTERISTIC DFC_DisblMsk.DFC_BrkNpl_C "disable mask / Disable masks of check DFC_BrkNpl" VALUE 0x804EE648 Val_Wu16 65535.00 DFES_OneToOne 0.00 65535.00 FORMAT "%8.2" /end CHARACTERISTIC
/begin CHARACTERISTIC DFC_DisblMsk.DFC_BrkRdntSwtContOn_C "disable mask / Disable masks of check DFC_BrkRdntSwtContOn" VALUE 0x804EE64A Val_Wu16 65535.00 DFES_OneToOne 0.00 65535.00 FORMAT "%8.2" /end CHARACTERISTIC
/begin CHARACTERISTIC DFC_DisblMsk.DFC_BrkRdntSwtNotStp_C "disable mask / Disable masks of check DFC_BrkRdntSwtNotStp" VALUE 0x804EE64C Val_Wu16 65535.00 DFES_OneToOne 0.00 65535.00 FORMAT "%8.2" /end CHARACTERISTIC
/begin CHARACTERISTIC DFC_DisblMsk.DFC_Clth3ONStuck_C "disable mask / Disable masks of check DFC_Clth3ONStuck" VALUE 0x804EE64E Val_Wu16 65535.00 DFES_OneToOne 0.00 65535.00 FORMAT "%8.2" /end CHARACTERISTIC
/begin CHARACTERISTIC DFC_DisblMsk.DFC_Clth4OFFStuck_C "disable mask / Disable masks of check DFC_Clth4OFFStuck" VALUE 0x804EE650 Val_Wu16 65535.00 DFES_OneToOne 0.00 65535.00 FORMAT "%8.2" /end CHARACTERISTIC
/begin CHARACTERISTIC DFC_DisblMsk.DFC_ClthOFFStuck_C "disable mask / Disable masks of check DFC_ClthOFFStuck" VALUE 0x804EE652 Val_Wu16 65535.00 DFES_OneToOne 0.00 65535.00 FORMAT "%8.2" /end CHARACTERISTIC
/begin CHARACTERISTIC DFC_DisblMsk.DFC_ClthONStuck_C "disable mask / Disable masks of check DFC_ClthONStuck" VALUE 0x804EE654 Val_Wu16 65535.00 DFES_OneToOne 0.00 65535.00 FORMAT "%8.2" /end CHARACTERISTIC
/begin CHARACTERISTIC DFC_DisblMsk.DFC_ClthStkFailInfo_C "disable mask / Disable masks of check DFC_ClthStkFailInfo" VALUE 0x804EE656 Val_Wu16 65535.00 DFES_OneToOne 0.00 65535.00 FORMAT "%8.2" /end CHARACTERISTIC
/begin CHARACTERISTIC DFC_DisblMsk.DFC_ComACFailInfo_C "disable mask / Disable masks of check DFC_ComACFailInfo" VALUE 0x804EE658 Val_Wu16 65535.00 DFES_OneToOne 0.00 65535.00 FORMAT "%8.2" /end CHARACTERISTIC
/begin CHARACTERISTIC DFC_DisblMsk.DFC_ComATFTValErr_C "disable mask / Disable masks of check DFC_ComATFTValErr" VALUE 0x804EE65A Val_Wu16 65535.00 DFES_OneToOne 0.00 65535.00 FORMAT "%8.2" /end CHARACTERISTIC
/begin CHARACTERISTIC DFC_DisblMsk.DFC_ComATMILReq_C "disable mask / Disable masks of check DFC_ComATMILReq" VALUE 0x804EE65C Val_Wu16 65535.00 DFES_OneToOne 0.00 65535.00 FORMAT "%8.2" /end CHARACTERISTIC
/begin CHARACTERISTIC DFC_DisblMsk.DFC_ComAYCAChksum_C "disable mask / Disable masks of check DFC_ComAYCAChksum" VALUE 0x804EE65E Val_Wu16 65535.00 DFES_OneToOne 0.00 65535.00 FORMAT "%8.2" /end CHARACTERISTIC
/begin CHARACTERISTIC DFC_DisblMsk.DFC_ComAYCARingCnt_C "disable mask / Disable masks of check DFC_ComAYCARingCnt" VALUE 0x804EE660 Val_Wu16 65535.00 DFES_OneToOne 0.00 65535.00 FORMAT "%8.2" /end CHARACTERISTIC
/begin CHARACTERISTIC DFC_DisblMsk.DFC_ComAYCATOut_C "disable mask / Disable masks of check DFC_ComAYCATOut" VALUE 0x804EE662 Val_Wu16 65535.00 DFES_OneToOne 0.00 65535.00 FORMAT "%8.2" /end CHARACTERISTIC
/begin CHARACTERISTIC DFC_DisblMsk.DFC_ComAYCDChkSum_C "disable mask / Disable masks of check DFC_ComAYCDChkSum" VALUE 0x804EE664 Val_Wu16 65535.00 DFES_OneToOne 0.00 65535.00 FORMAT "%8.2" /end CHARACTERISTIC
/begin CHARACTERISTIC DFC_DisblMsk.DFC_ComAYCDTOut_C "disable mask / Disable masks of check DFC_ComAYCDTOut" VALUE 0x804EE666 Val_Wu16 65535.00 DFES_OneToOne 0.00 65535.00 FORMAT "%8.2" /end CHARACTERISTIC
/begin CHARACTERISTIC DFC_DisblMsk.DFC_ComAYCFChksum_C "disable mask / Disable masks of check DFC_ComAYCFChksum" VALUE 0x804EE668 Val_Wu16 65535.00 DFES_OneToOne 0.00 65535.00 FORMAT "%8.2" /end CHARACTERISTIC
/begin CHARACTERISTIC DFC_DisblMsk.DFC_ComAYCFRingCnt_C "disable mask / Disable masks of check DFC_ComAYCFRingCnt" VALUE 0x804EE66A Val_Wu16 65535.00 DFES_OneToOne 0.00 65535.00 FORMAT "%8.2" /end CHARACTERISTIC
/begin CHARACTERISTIC DFC_DisblMsk.DFC_ComAYCFTOut_C "disable mask / Disable masks of check DFC_ComAYCFTOut" VALUE 0x804EE66C Val_Wu16 65535.00 DFES_OneToOne 0.00 65535.00 FORMAT "%8.2" /end CHARACTERISTIC
/begin CHARACTERISTIC DFC_DisblMsk.DFC_ComAYCGChksum_C "disable mask / Disable masks of check DFC_ComAYCGChksum" VALUE 0x804EE66E Val_Wu16 65535.00 DFES_OneToOne 0.00 65535.00 FORMAT "%8.2" /end CHARACTERISTIC
/begin CHARACTERISTIC DFC_DisblMsk.DFC_ComAYCGRingCnt_C "disable mask / Disable masks of check DFC_ComAYCGRingCnt" VALUE 0x804EE670 Val_Wu16 65535.00 DFES_OneToOne 0.00 65535.00 FORMAT "%8.2" /end CHARACTERISTIC
/begin CHARACTERISTIC DFC_DisblMsk.DFC_ComAYCGTOut_C "disable mask / Disable masks of check DFC_ComAYCGTOut" VALUE 0x804EE672 Val_Wu16 65535.00 DFES_OneToOne 0.00 65535.00 FORMAT "%8.2" /end CHARACTERISTIC
/begin CHARACTERISTIC DFC_DisblMsk.DFC_ComAYCIChkSum_C "disable mask / Disable masks of check DFC_ComAYCIChkSum" VALUE 0x804EE674 Val_Wu16 65535.00 DFES_OneToOne 0.00 65535.00 FORMAT "%8.2" /end CHARACTERISTIC
/begin CHARACTERISTIC DFC_DisblMsk.DFC_ComAYCIRingCnt_C "disable mask / Disable masks of check DFC_ComAYCIRingCnt" VALUE 0x804EE676 Val_Wu16 65535.00 DFES_OneToOne 0.00 65535.00 FORMAT "%8.2" /end CHARACTERISTIC
/begin CHARACTERISTIC DFC_DisblMsk.DFC_ComAYCITOut_C "disable mask / Disable masks of check DFC_ComAYCITOut" VALUE 0x804EE678 Val_Wu16 65535.00 DFES_OneToOne 0.00 65535.00 FORMAT "%8.2" /end CHARACTERISTIC
/begin CHARACTERISTIC DFC_DisblMsk.DFC_ComBCM1ChkSum_C "disable mask / Disable masks of check DFC_ComBCM1ChkSum" VALUE 0x804EE67A Val_Wu16 65535.00 DFES_OneToOne 0.00 65535.00 FORMAT "%8.2" /end CHARACTERISTIC
/begin CHARACTERISTIC DFC_DisblMsk.DFC_ComBCM1RingCnt_C "disable mask / Disable masks of check DFC_ComBCM1RingCnt" VALUE 0x804EE67C Val_Wu16 65535.00 DFES_OneToOne 0.00 65535.00 FORMAT "%8.2" /end CHARACTERISTIC
/begin CHARACTERISTIC DFC_DisblMsk.DFC_ComBCM1TOut_C "disable mask / Disable masks of check DFC_ComBCM1TOut" VALUE 0x804EE67E Val_Wu16 65535.00 DFES_OneToOne 0.00 65535.00 FORMAT "%8.2" /end CHARACTERISTIC
/begin CHARACTERISTIC DFC_DisblMsk.DFC_ComCANABusOffErr_C "disable mask / Disable masks of check DFC_ComCANABusOffErr" VALUE 0x804EE680 Val_Wu16 65535.00 DFES_OneToOne 0.00 65535.00 FORMAT "%8.2" /end CHARACTERISTIC
/begin CHARACTERISTIC DFC_DisblMsk.DFC_ComCANBBusOffErr_C "disable mask / Disable masks of check DFC_ComCANBBusOffErr" VALUE 0x804EE682 Val_Wu16 65535.00 DFES_OneToOne 0.00 65535.00 FORMAT "%8.2" /end CHARACTERISTIC
/begin CHARACTERISTIC DFC_DisblMsk.DFC_ComCANCBusOffErr_C "disable mask / Disable masks of check DFC_ComCANCBusOffErr" VALUE 0x804EE684 Val_Wu16 65535.00 DFES_OneToOne 0.00 65535.00 FORMAT "%8.2" /end CHARACTERISTIC
/begin CHARACTERISTIC DFC_DisblMsk.DFC_ComCGW1ChkSum_C "disable mask / Disable masks of check DFC_ComCGW1ChkSum" VALUE 0x804EE686 Val_Wu16 65535.00 DFES_OneToOne 0.00 65535.00 FORMAT "%8.2" /end CHARACTERISTIC
/begin CHARACTERISTIC DFC_DisblMsk.DFC_ComCGW1RingCnt_C "disable mask / Disable masks of check DFC_ComCGW1RingCnt" VALUE 0x804EE688 Val_Wu16 65535.00 DFES_OneToOne 0.00 65535.00 FORMAT "%8.2" /end CHARACTERISTIC
/begin CHARACTERISTIC DFC_DisblMsk.DFC_ComCGW1TOut_C "disable mask / Disable masks of check DFC_ComCGW1TOut" VALUE 0x804EE68A Val_Wu16 65535.00 DFES_OneToOne 0.00 65535.00 FORMAT "%8.2" /end CHARACTERISTIC
/begin CHARACTERISTIC DFC_DisblMsk.DFC_ComConvBoostErr_C "disable mask / Disable masks of check DFC_ComConvBoostErr" VALUE 0x804EE68C Val_Wu16 65535.00 DFES_OneToOne 0.00 65535.00 FORMAT "%8.2" /end CHARACTERISTIC
/begin CHARACTERISTIC DFC_DisblMsk.DFC_ComConvSlipErr_C "disable mask / Disable masks of check DFC_ComConvSlipErr" VALUE 0x804EE68E Val_Wu16 65535.00 DFES_OneToOne 0.00 65535.00 FORMAT "%8.2" /end CHARACTERISTIC
/begin CHARACTERISTIC DFC_DisblMsk.DFC_ComEAT10Chksum_C "disable mask / Disable masks of check DFC_ComEAT10Chksum" VALUE 0x804EE690 Val_Wu16 65535.00 DFES_OneToOne 0.00 65535.00 FORMAT "%8.2" /end CHARACTERISTIC
/begin CHARACTERISTIC DFC_DisblMsk.DFC_ComEAT10RingCnt_C "disable mask / Disable masks of check DFC_ComEAT10RingCnt" VALUE 0x804EE692 Val_Wu16 65535.00 DFES_OneToOne 0.00 65535.00 FORMAT "%8.2" /end CHARACTERISTIC
/begin CHARACTERISTIC DFC_DisblMsk.DFC_ComEAT10TOut_C "disable mask / Disable masks of check DFC_ComEAT10TOut" VALUE 0x804EE694 Val_Wu16 65535.00 DFES_OneToOne 0.00 65535.00 FORMAT "%8.2" /end CHARACTERISTIC
/begin CHARACTERISTIC DFC_DisblMsk.DFC_ComEAT11ChkSum_C "disable mask / Disable masks of check DFC_ComEAT11ChkSum" VALUE 0x804EE696 Val_Wu16 65535.00 DFES_OneToOne 0.00 65535.00 FORMAT "%8.2" /end CHARACTERISTIC
/begin CHARACTERISTIC DFC_DisblMsk.DFC_ComEAT11RingCnt_C "disable mask / Disable masks of check DFC_ComEAT11RingCnt" VALUE 0x804EE698 Val_Wu16 65535.00 DFES_OneToOne 0.00 65535.00 FORMAT "%8.2" /end CHARACTERISTIC
/begin CHARACTERISTIC DFC_DisblMsk.DFC_ComEAT11TOut_C "disable mask / Disable masks of check DFC_ComEAT11TOut" VALUE 0x804EE69A Val_Wu16 65535.00 DFES_OneToOne 0.00 65535.00 FORMAT "%8.2" /end CHARACTERISTIC
/begin CHARACTERISTIC DFC_DisblMsk.DFC_ComEAT12ChkSum_C "disable mask / Disable masks of check DFC_ComEAT12ChkSum" VALUE 0x804EE69C Val_Wu16 65535.00 DFES_OneToOne 0.00 65535.00 FORMAT "%8.2" /end CHARACTERISTIC
/begin CHARACTERISTIC DFC_DisblMsk.DFC_ComEAT12RingCnt_C "disable mask / Disable masks of check DFC_ComEAT12RingCnt" VALUE 0x804EE69E Val_Wu16 65535.00 DFES_OneToOne 0.00 65535.00 FORMAT "%8.2" /end CHARACTERISTIC
/begin CHARACTERISTIC DFC_DisblMsk.DFC_ComEAT12TOut_C "disable mask / Disable masks of check DFC_ComEAT12TOut" VALUE 0x804EE6A0 Val_Wu16 65535.00 DFES_OneToOne 0.00 65535.00 FORMAT "%8.2" /end CHARACTERISTIC
/begin CHARACTERISTIC DFC_DisblMsk.DFC_ComEAT13ChkSum_C "disable mask / Disable masks of check DFC_ComEAT13ChkSum" VALUE 0x804EE6A2 Val_Wu16 65535.00 DFES_OneToOne 0.00 65535.00 FORMAT "%8.2" /end CHARACTERISTIC
/begin CHARACTERISTIC DFC_DisblMsk.DFC_ComEAT13RingCnt_C "disable mask / Disable masks of check DFC_ComEAT13RingCnt" VALUE 0x804EE6A4 Val_Wu16 65535.00 DFES_OneToOne 0.00 65535.00 FORMAT "%8.2" /end CHARACTERISTIC
/begin CHARACTERISTIC DFC_DisblMsk.DFC_ComEAT13TOut_C "disable mask / Disable masks of check DFC_ComEAT13TOut" VALUE 0x804EE6A6 Val_Wu16 65535.00 DFES_OneToOne 0.00 65535.00 FORMAT "%8.2" /end CHARACTERISTIC
/begin CHARACTERISTIC DFC_DisblMsk.DFC_ComEAT1Chksum_C "disable mask / Disable masks of check DFC_ComEAT1Chksum" VALUE 0x804EE6A8 Val_Wu16 65535.00 DFES_OneToOne 0.00 65535.00 FORMAT "%8.2" /end CHARACTERISTIC
/begin CHARACTERISTIC DFC_DisblMsk.DFC_ComEAT1RingCnt_C "disable mask / Disable masks of check DFC_ComEAT1RingCnt" VALUE 0x804EE6AA Val_Wu16 65535.00 DFES_OneToOne 0.00 65535.00 FORMAT "%8.2" /end CHARACTERISTIC
/begin CHARACTERISTIC DFC_DisblMsk.DFC_ComEAT1TOut_C "disable mask / Disable masks of check DFC_ComEAT1TOut" VALUE 0x804EE6AC Val_Wu16 65535.00 DFES_OneToOne 0.00 65535.00 FORMAT "%8.2" /end CHARACTERISTIC
/begin CHARACTERISTIC DFC_DisblMsk.DFC_ComEAT2ChkSum_C "disable mask / Disable masks of check DFC_ComEAT2ChkSum" VALUE 0x804EE6AE Val_Wu16 65535.00 DFES_OneToOne 0.00 65535.00 FORMAT "%8.2" /end CHARACTERISTIC
/begin CHARACTERISTIC DFC_DisblMsk.DFC_ComEAT2RingCnt_C "disable mask / Disable masks of check DFC_ComEAT2RingCnt" VALUE 0x804EE6B0 Val_Wu16 65535.00 DFES_OneToOne 0.00 65535.00 FORMAT "%8.2" /end CHARACTERISTIC
/begin CHARACTERISTIC DFC_DisblMsk.DFC_ComEAT2TOut_C "disable mask / Disable masks of check DFC_ComEAT2TOut" VALUE 0x804EE6B2 Val_Wu16 65535.00 DFES_OneToOne 0.00 65535.00 FORMAT "%8.2" /end CHARACTERISTIC
/begin CHARACTERISTIC DFC_DisblMsk.DFC_ComEAT4ChkSum_C "disable mask / Disable masks of check DFC_ComEAT4ChkSum" VALUE 0x804EE6B4 Val_Wu16 65535.00 DFES_OneToOne 0.00 65535.00 FORMAT "%8.2" /end CHARACTERISTIC
/begin CHARACTERISTIC DFC_DisblMsk.DFC_ComEAT4RingCnt_C "disable mask / Disable masks of check DFC_ComEAT4RingCnt" VALUE 0x804EE6B6 Val_Wu16 65535.00 DFES_OneToOne 0.00 65535.00 FORMAT "%8.2" /end CHARACTERISTIC
/begin CHARACTERISTIC DFC_DisblMsk.DFC_ComEAT4TOut_C "disable mask / Disable masks of check DFC_ComEAT4TOut" VALUE 0x804EE6B8 Val_Wu16 65535.00 DFES_OneToOne 0.00 65535.00 FORMAT "%8.2" /end CHARACTERISTIC
/begin CHARACTERISTIC DFC_DisblMsk.DFC_ComEAT6Chksum_C "disable mask / Disable masks of check DFC_ComEAT6Chksum" VALUE 0x804EE6BA Val_Wu16 65535.00 DFES_OneToOne 0.00 65535.00 FORMAT "%8.2" /end CHARACTERISTIC
/begin CHARACTERISTIC DFC_DisblMsk.DFC_ComEAT6RingCnt_C "disable mask / Disable masks of check DFC_ComEAT6RingCnt" VALUE 0x804EE6BC Val_Wu16 65535.00 DFES_OneToOne 0.00 65535.00 FORMAT "%8.2" /end CHARACTERISTIC
/begin CHARACTERISTIC DFC_DisblMsk.DFC_ComEAT6TOut_C "disable mask / Disable masks of check DFC_ComEAT6TOut" VALUE 0x804EE6BE Val_Wu16 65535.00 DFES_OneToOne 0.00 65535.00 FORMAT "%8.2" /end CHARACTERISTIC
/begin CHARACTERISTIC DFC_DisblMsk.DFC_ComEAT7Chksum_C "disable mask / Disable masks of check DFC_ComEAT7Chksum" VALUE 0x804EE6C0 Val_Wu16 65535.00 DFES_OneToOne 0.00 65535.00 FORMAT "%8.2" /end CHARACTERISTIC
/begin CHARACTERISTIC DFC_DisblMsk.DFC_ComEAT7RingCnt_C "disable mask / Disable masks of check DFC_ComEAT7RingCnt" VALUE 0x804EE6C2 Val_Wu16 65535.00 DFES_OneToOne 0.00 65535.00 FORMAT "%8.2" /end CHARACTERISTIC
/begin CHARACTERISTIC DFC_DisblMsk.DFC_ComEAT7TOut_C "disable mask / Disable masks of check DFC_ComEAT7TOut" VALUE 0x804EE6C4 Val_Wu16 65535.00 DFES_OneToOne 0.00 65535.00 FORMAT "%8.2" /end CHARACTERISTIC
/begin CHARACTERISTIC DFC_DisblMsk.DFC_ComEAT8Chksum_C "disable mask / Disable masks of check DFC_ComEAT8Chksum" VALUE 0x804EE6C6 Val_Wu16 65535.00 DFES_OneToOne 0.00 65535.00 FORMAT "%8.2" /end CHARACTERISTIC
/begin CHARACTERISTIC DFC_DisblMsk.DFC_ComEAT8RingCnt_C "disable mask / Disable masks of check DFC_ComEAT8RingCnt" VALUE 0x804EE6C8 Val_Wu16 65535.00 DFES_OneToOne 0.00 65535.00 FORMAT "%8.2" /end CHARACTERISTIC
/begin CHARACTERISTIC DFC_DisblMsk.DFC_ComEAT8TOut_C "disable mask / Disable masks of check DFC_ComEAT8TOut" VALUE 0x804EE6CA Val_Wu16 65535.00 DFES_OneToOne 0.00 65535.00 FORMAT "%8.2" /end CHARACTERISTIC
/begin CHARACTERISTIC DFC_DisblMsk.DFC_ComEATAChksum_C "disable mask / Disable masks of check DFC_ComEATAChksum" VALUE 0x804EE6CC Val_Wu16 65535.00 DFES_OneToOne 0.00 65535.00 FORMAT "%8.2" /end CHARACTERISTIC
/begin CHARACTERISTIC DFC_DisblMsk.DFC_ComEATARingCnt_C "disable mask / Disable masks of check DFC_ComEATARingCnt" VALUE 0x804EE6CE Val_Wu16 65535.00 DFES_OneToOne 0.00 65535.00 FORMAT "%8.2" /end CHARACTERISTIC
/begin CHARACTERISTIC DFC_DisblMsk.DFC_ComEATATOut_C "disable mask / Disable masks of check DFC_ComEATATOut" VALUE 0x804EE6D0 Val_Wu16 65535.00 DFES_OneToOne 0.00 65535.00 FORMAT "%8.2" /end CHARACTERISTIC
/begin CHARACTERISTIC DFC_DisblMsk.DFC_ComEATBChkSum_C "disable mask / Disable masks of check DFC_ComEATBChkSum" VALUE 0x804EE6D2 Val_Wu16 65535.00 DFES_OneToOne 0.00 65535.00 FORMAT "%8.2" /end CHARACTERISTIC
/begin CHARACTERISTIC DFC_DisblMsk.DFC_ComEATBRingCnt_C "disable mask / Disable masks of check DFC_ComEATBRingCnt" VALUE 0x804EE6D4 Val_Wu16 65535.00 DFES_OneToOne 0.00 65535.00 FORMAT "%8.2" /end CHARACTERISTIC
/begin CHARACTERISTIC DFC_DisblMsk.DFC_ComEATBTOut_C "disable mask / Disable masks of check DFC_ComEATBTOut" VALUE 0x804EE6D6 Val_Wu16 65535.00 DFES_OneToOne 0.00 65535.00 FORMAT "%8.2" /end CHARACTERISTIC
/begin CHARACTERISTIC DFC_DisblMsk.DFC_ComEATCChksum_C "disable mask / Disable masks of check DFC_ComEATCChksum" VALUE 0x804EE6D8 Val_Wu16 65535.00 DFES_OneToOne 0.00 65535.00 FORMAT "%8.2" /end CHARACTERISTIC
/begin CHARACTERISTIC DFC_DisblMsk.DFC_ComEATCRingCnt_C "disable mask / Disable masks of check DFC_ComEATCRingCnt" VALUE 0x804EE6DA Val_Wu16 65535.00 DFES_OneToOne 0.00 65535.00 FORMAT "%8.2" /end CHARACTERISTIC
/begin CHARACTERISTIC DFC_DisblMsk.DFC_ComEATCTOut_C "disable mask / Disable masks of check DFC_ComEATCTOut" VALUE 0x804EE6DC Val_Wu16 65535.00 DFES_OneToOne 0.00 65535.00 FORMAT "%8.2" /end CHARACTERISTIC
/begin CHARACTERISTIC DFC_DisblMsk.DFC_ComEBBAChksum_C "disable mask / Disable masks of check DFC_ComEBBAChksum" VALUE 0x804EE6DE Val_Wu16 65535.00 DFES_OneToOne 0.00 65535.00 FORMAT "%8.2" /end CHARACTERISTIC
/begin CHARACTERISTIC DFC_DisblMsk.DFC_ComEBBARingCnt_C "disable mask / Disable masks of check DFC_ComEBBARingCnt" VALUE 0x804EE6E0 Val_Wu16 65535.00 DFES_OneToOne 0.00 65535.00 FORMAT "%8.2" /end CHARACTERISTIC
/begin CHARACTERISTIC DFC_DisblMsk.DFC_ComEBBATOut_C "disable mask / Disable masks of check DFC_ComEBBATOut" VALUE 0x804EE6E2 Val_Wu16 65535.00 DFES_OneToOne 0.00 65535.00 FORMAT "%8.2" /end CHARACTERISTIC
/begin CHARACTERISTIC DFC_DisblMsk.DFC_ComEPS1Chksum_C "disable mask / Disable masks of check DFC_ComEPS1Chksum" VALUE 0x804EE6E4 Val_Wu16 65535.00 DFES_OneToOne 0.00 65535.00 FORMAT "%8.2" /end CHARACTERISTIC
/begin CHARACTERISTIC DFC_DisblMsk.DFC_ComEPS1RingCnt_C "disable mask / Disable masks of check DFC_ComEPS1RingCnt" VALUE 0x804EE6E6 Val_Wu16 65535.00 DFES_OneToOne 0.00 65535.00 FORMAT "%8.2" /end CHARACTERISTIC
/begin CHARACTERISTIC DFC_DisblMsk.DFC_ComEPS1TOut_C "disable mask / Disable masks of check DFC_ComEPS1TOut" VALUE 0x804EE6E8 Val_Wu16 65535.00 DFES_OneToOne 0.00 65535.00 FORMAT "%8.2" /end CHARACTERISTIC
/begin CHARACTERISTIC DFC_DisblMsk.DFC_ComEngCanRxErr_C "disable mask / Disable masks of check DFC_ComEngCanRxErr" VALUE 0x804EE6EA Val_Wu16 65535.00 DFES_OneToOne 0.00 65535.00 FORMAT "%8.2" /end CHARACTERISTIC
/begin CHARACTERISTIC DFC_DisblMsk.DFC_ComGrvySnsrErr_C "disable mask / Disable masks of check DFC_ComGrvySnsrErr" VALUE 0x804EE6EC Val_Wu16 65535.00 DFES_OneToOne 0.00 65535.00 FORMAT "%8.2" /end CHARACTERISTIC
/begin CHARACTERISTIC DFC_DisblMsk.DFC_ComGwIMG1ChkSum_C "disable mask / Disable masks of check DFC_ComGwIMG1ChkSum" VALUE 0x804EE6EE Val_Wu16 65535.00 DFES_OneToOne 0.00 65535.00 FORMAT "%8.2" /end CHARACTERISTIC
/begin CHARACTERISTIC DFC_DisblMsk.DFC_ComGwIMG1RingCnt_C "disable mask / Disable masks of check DFC_ComGwIMG1RingCnt" VALUE 0x804EE6F0 Val_Wu16 65535.00 DFES_OneToOne 0.00 65535.00 FORMAT "%8.2" /end CHARACTERISTIC
/begin CHARACTERISTIC DFC_DisblMsk.DFC_ComGwIMG1TOut_C "disable mask / Disable masks of check DFC_ComGwIMG1TOut" VALUE 0x804EE6F2 Val_Wu16 65535.00 DFES_OneToOne 0.00 65535.00 FORMAT "%8.2" /end CHARACTERISTIC
/begin CHARACTERISTIC DFC_DisblMsk.DFC_ComGwIMG3ChkSum_C "disable mask / Disable masks of check DFC_ComGwIMG3ChkSum" VALUE 0x804EE6F4 Val_Wu16 65535.00 DFES_OneToOne 0.00 65535.00 FORMAT "%8.2" /end CHARACTERISTIC
/begin CHARACTERISTIC DFC_DisblMsk.DFC_ComGwIMG3RingCnt_C "disable mask / Disable masks of check DFC_ComGwIMG3RingCnt" VALUE 0x804EE6F6 Val_Wu16 65535.00 DFES_OneToOne 0.00 65535.00 FORMAT "%8.2" /end CHARACTERISTIC
/begin CHARACTERISTIC DFC_DisblMsk.DFC_ComGwIMG3TOut_C "disable mask / Disable masks of check DFC_ComGwIMG3TOut" VALUE 0x804EE6F8 Val_Wu16 65535.00 DFES_OneToOne 0.00 65535.00 FORMAT "%8.2" /end CHARACTERISTIC
/begin CHARACTERISTIC DFC_DisblMsk.DFC_ComGwIMG4ChkSum_C "disable mask / Disable masks of check DFC_ComGwIMG4ChkSum" VALUE 0x804EE6FA Val_Wu16 65535.00 DFES_OneToOne 0.00 65535.00 FORMAT "%8.2" /end CHARACTERISTIC
/begin CHARACTERISTIC DFC_DisblMsk.DFC_ComGwIMG4RingCnt_C "disable mask / Disable masks of check DFC_ComGwIMG4RingCnt" VALUE 0x804EE6FC Val_Wu16 65535.00 DFES_OneToOne 0.00 65535.00 FORMAT "%8.2" /end CHARACTERISTIC
/begin CHARACTERISTIC DFC_DisblMsk.DFC_ComGwIMG4TOut_C "disable mask / Disable masks of check DFC_ComGwIMG4TOut" VALUE 0x804EE6FE Val_Wu16 65535.00 DFES_OneToOne 0.00 65535.00 FORMAT "%8.2" /end CHARACTERISTIC
/begin CHARACTERISTIC DFC_DisblMsk.DFC_ComGwIMG5ChkSum_C "disable mask / Disable masks of check DFC_ComGwIMG5ChkSum" VALUE 0x804EE700 Val_Wu16 65535.00 DFES_OneToOne 0.00 65535.00 FORMAT "%8.2" /end CHARACTERISTIC
/begin CHARACTERISTIC DFC_DisblMsk.DFC_ComGwIMG5RingCnt_C "disable mask / Disable masks of check DFC_ComGwIMG5RingCnt" VALUE 0x804EE702 Val_Wu16 65535.00 DFES_OneToOne 0.00 65535.00 FORMAT "%8.2" /end CHARACTERISTIC
/begin CHARACTERISTIC DFC_DisblMsk.DFC_ComGwIMG5TOut_C "disable mask / Disable masks of check DFC_ComGwIMG5TOut" VALUE 0x804EE704 Val_Wu16 65535.00 DFES_OneToOne 0.00 65535.00 FORMAT "%8.2" /end CHARACTERISTIC
/begin CHARACTERISTIC DFC_DisblMsk.DFC_ComGwIMG6ChkSum_C "disable mask / Disable masks of check DFC_ComGwIMG6ChkSum" VALUE 0x804EE706 Val_Wu16 65535.00 DFES_OneToOne 0.00 65535.00 FORMAT "%8.2" /end CHARACTERISTIC
/begin CHARACTERISTIC DFC_DisblMsk.DFC_ComGwIMG6RingCnt_C "disable mask / Disable masks of check DFC_ComGwIMG6RingCnt" VALUE 0x804EE708 Val_Wu16 65535.00 DFES_OneToOne 0.00 65535.00 FORMAT "%8.2" /end CHARACTERISTIC
/begin CHARACTERISTIC DFC_DisblMsk.DFC_ComGwIMG6TOut_C "disable mask / Disable masks of check DFC_ComGwIMG6TOut" VALUE 0x804EE70A Val_Wu16 65535.00 DFES_OneToOne 0.00 65535.00 FORMAT "%8.2" /end CHARACTERISTIC
/begin CHARACTERISTIC DFC_DisblMsk.DFC_ComIDASBChksum_C "disable mask / Disable masks of check DFC_ComIDASBChksum" VALUE 0x804EE70C Val_Wu16 65535.00 DFES_OneToOne 0.00 65535.00 FORMAT "%8.2" /end CHARACTERISTIC
/begin CHARACTERISTIC DFC_DisblMsk.DFC_ComIDASBRingCnt_C "disable mask / Disable masks of check DFC_ComIDASBRingCnt" VALUE 0x804EE70E Val_Wu16 65535.00 DFES_OneToOne 0.00 65535.00 FORMAT "%8.2" /end CHARACTERISTIC
/begin CHARACTERISTIC DFC_DisblMsk.DFC_ComIDASBTOut_C "disable mask / Disable masks of check DFC_ComIDASBTOut" VALUE 0x804EE710 Val_Wu16 65535.00 DFES_OneToOne 0.00 65535.00 FORMAT "%8.2" /end CHARACTERISTIC
/begin CHARACTERISTIC DFC_DisblMsk.DFC_ComIMGMILReq_C "disable mask / Disable masks of check DFC_ComIMGMILReq" VALUE 0x804EE712 Val_Wu16 65535.00 DFES_OneToOne 0.00 65535.00 FORMAT "%8.2" /end CHARACTERISTIC
/begin CHARACTERISTIC DFC_DisblMsk.DFC_ComISSPrms_C "disable mask / Disable masks of check DFC_ComISSPrms" VALUE 0x804EE714 Val_Wu16 65535.00 DFES_OneToOne 0.00 65535.00 FORMAT "%8.2" /end CHARACTERISTIC
/begin CHARACTERISTIC DFC_DisblMsk.DFC_ComMETAChksum_C "disable mask / Disable masks of check DFC_ComMETAChksum" VALUE 0x804EE716 Val_Wu16 65535.00 DFES_OneToOne 0.00 65535.00 FORMAT "%8.2" /end CHARACTERISTIC
/begin CHARACTERISTIC DFC_DisblMsk.DFC_ComMETARingCnt_C "disable mask / Disable masks of check DFC_ComMETARingCnt" VALUE 0x804EE718 Val_Wu16 65535.00 DFES_OneToOne 0.00 65535.00 FORMAT "%8.2" /end CHARACTERISTIC
/begin CHARACTERISTIC DFC_DisblMsk.DFC_ComMETATOut_C "disable mask / Disable masks of check DFC_ComMETATOut" VALUE 0x804EE71A Val_Wu16 65535.00 DFES_OneToOne 0.00 65535.00 FORMAT "%8.2" /end CHARACTERISTIC
/begin CHARACTERISTIC DFC_DisblMsk.DFC_ComMETCChksum_C "disable mask / Disable masks of check DFC_ComMETCChksum" VALUE 0x804EE71C Val_Wu16 65535.00 DFES_OneToOne 0.00 65535.00 FORMAT "%8.2" /end CHARACTERISTIC
/begin CHARACTERISTIC DFC_DisblMsk.DFC_ComMETCRingCnt_C "disable mask / Disable masks of check DFC_ComMETCRingCnt" VALUE 0x804EE71E Val_Wu16 65535.00 DFES_OneToOne 0.00 65535.00 FORMAT "%8.2" /end CHARACTERISTIC
/begin CHARACTERISTIC DFC_DisblMsk.DFC_ComMETCTOut_C "disable mask / Disable masks of check DFC_ComMETCTOut" VALUE 0x804EE720 Val_Wu16 65535.00 DFES_OneToOne 0.00 65535.00 FORMAT "%8.2" /end CHARACTERISTIC
/begin CHARACTERISTIC DFC_DisblMsk.DFC_ComMETDChksum_C "disable mask / Disable masks of check DFC_ComMETDChksum" VALUE 0x804EE722 Val_Wu16 65535.00 DFES_OneToOne 0.00 65535.00 FORMAT "%8.2" /end CHARACTERISTIC
/begin CHARACTERISTIC DFC_DisblMsk.DFC_ComMETDRingCnt_C "disable mask / Disable masks of check DFC_ComMETDRingCnt" VALUE 0x804EE724 Val_Wu16 65535.00 DFES_OneToOne 0.00 65535.00 FORMAT "%8.2" /end CHARACTERISTIC
/begin CHARACTERISTIC DFC_DisblMsk.DFC_ComMETDTOut_C "disable mask / Disable masks of check DFC_ComMETDTOut" VALUE 0x804EE726 Val_Wu16 65535.00 DFES_OneToOne 0.00 65535.00 FORMAT "%8.2" /end CHARACTERISTIC
/begin CHARACTERISTIC DFC_DisblMsk.DFC_ComMETE2Chksum_C "disable mask / Disable masks of check DFC_ComMETE2Chksum" VALUE 0x804EE728 Val_Wu16 65535.00 DFES_OneToOne 0.00 65535.00 FORMAT "%8.2" /end CHARACTERISTIC
/begin CHARACTERISTIC DFC_DisblMsk.DFC_ComMETE2RingCnt_C "disable mask / Disable masks of check DFC_ComMETE2RingCnt" VALUE 0x804EE72A Val_Wu16 65535.00 DFES_OneToOne 0.00 65535.00 FORMAT "%8.2" /end CHARACTERISTIC
/begin CHARACTERISTIC DFC_DisblMsk.DFC_ComMETE2TOut_C "disable mask / Disable masks of check DFC_ComMETE2TOut" VALUE 0x804EE72C Val_Wu16 65535.00 DFES_OneToOne 0.00 65535.00 FORMAT "%8.2" /end CHARACTERISTIC
/begin CHARACTERISTIC DFC_DisblMsk.DFC_ComMETFChksum_C "disable mask / Disable masks of check DFC_ComMETFChksum" VALUE 0x804EE72E Val_Wu16 65535.00 DFES_OneToOne 0.00 65535.00 FORMAT "%8.2" /end CHARACTERISTIC
/begin CHARACTERISTIC DFC_DisblMsk.DFC_ComMETFRingCnt_C "disable mask / Disable masks of check DFC_ComMETFRingCnt" VALUE 0x804EE730 Val_Wu16 65535.00 DFES_OneToOne 0.00 65535.00 FORMAT "%8.2" /end CHARACTERISTIC
/begin CHARACTERISTIC DFC_DisblMsk.DFC_ComMETFTOut_C "disable mask / Disable masks of check DFC_ComMETFTOut" VALUE 0x804EE732 Val_Wu16 65535.00 DFES_OneToOne 0.00 65535.00 FORMAT "%8.2" /end CHARACTERISTIC
/begin CHARACTERISTIC DFC_DisblMsk.DFC_ComMETGChksum_C "disable mask / Disable masks of check DFC_ComMETGChksum" VALUE 0x804EE734 Val_Wu16 65535.00 DFES_OneToOne 0.00 65535.00 FORMAT "%8.2" /end CHARACTERISTIC
/begin CHARACTERISTIC DFC_DisblMsk.DFC_ComMETGRingCnt_C "disable mask / Disable masks of check DFC_ComMETGRingCnt" VALUE 0x804EE736 Val_Wu16 65535.00 DFES_OneToOne 0.00 65535.00 FORMAT "%8.2" /end CHARACTERISTIC
/begin CHARACTERISTIC DFC_DisblMsk.DFC_ComMETGTOut_C "disable mask / Disable masks of check DFC_ComMETGTOut" VALUE 0x804EE738 Val_Wu16 65535.00 DFES_OneToOne 0.00 65535.00 FORMAT "%8.2" /end CHARACTERISTIC
/begin CHARACTERISTIC DFC_DisblMsk.DFC_ComMETH2Chksum_C "disable mask / Disable masks of check DFC_ComMETH2Chksum" VALUE 0x804EE73A Val_Wu16 65535.00 DFES_OneToOne 0.00 65535.00 FORMAT "%8.2" /end CHARACTERISTIC
/begin CHARACTERISTIC DFC_DisblMsk.DFC_ComMETH2RingCnt_C "disable mask / Disable masks of check DFC_ComMETH2RingCnt" VALUE 0x804EE73C Val_Wu16 65535.00 DFES_OneToOne 0.00 65535.00 FORMAT "%8.2" /end CHARACTERISTIC
/begin CHARACTERISTIC DFC_DisblMsk.DFC_ComMETH2TOut_C "disable mask / Disable masks of check DFC_ComMETH2TOut" VALUE 0x804EE73E Val_Wu16 65535.00 DFES_OneToOne 0.00 65535.00 FORMAT "%8.2" /end CHARACTERISTIC
/begin CHARACTERISTIC DFC_DisblMsk.DFC_ComMETHChksum_C "disable mask / Disable masks of check DFC_ComMETHChksum" VALUE 0x804EE740 Val_Wu16 65535.00 DFES_OneToOne 0.00 65535.00 FORMAT "%8.2" /end CHARACTERISTIC
/begin CHARACTERISTIC DFC_DisblMsk.DFC_ComMETHRingCnt_C "disable mask / Disable masks of check DFC_ComMETHRingCnt" VALUE 0x804EE742 Val_Wu16 65535.00 DFES_OneToOne 0.00 65535.00 FORMAT "%8.2" /end CHARACTERISTIC
/begin CHARACTERISTIC DFC_DisblMsk.DFC_ComMETHTOut_C "disable mask / Disable masks of check DFC_ComMETHTOut" VALUE 0x804EE744 Val_Wu16 65535.00 DFES_OneToOne 0.00 65535.00 FORMAT "%8.2" /end CHARACTERISTIC
/begin CHARACTERISTIC DFC_DisblMsk.DFC_ComMETIChksum_C "disable mask / Disable masks of check DFC_ComMETIChksum" VALUE 0x804EE746 Val_Wu16 65535.00 DFES_OneToOne 0.00 65535.00 FORMAT "%8.2" /end CHARACTERISTIC
/begin CHARACTERISTIC DFC_DisblMsk.DFC_ComMETIRingCnt_C "disable mask / Disable masks of check DFC_ComMETIRingCnt" VALUE 0x804EE748 Val_Wu16 65535.00 DFES_OneToOne 0.00 65535.00 FORMAT "%8.2" /end CHARACTERISTIC
/begin CHARACTERISTIC DFC_DisblMsk.DFC_ComMETITOut_C "disable mask / Disable masks of check DFC_ComMETITOut" VALUE 0x804EE74A Val_Wu16 65535.00 DFES_OneToOne 0.00 65535.00 FORMAT "%8.2" /end CHARACTERISTIC
/begin CHARACTERISTIC DFC_DisblMsk.DFC_ComMETKChksum_C "disable mask / Disable masks of check DFC_ComMETKChksum" VALUE 0x804EE74C Val_Wu16 65535.00 DFES_OneToOne 0.00 65535.00 FORMAT "%8.2" /end CHARACTERISTIC
/begin CHARACTERISTIC DFC_DisblMsk.DFC_ComMETKRingCnt_C "disable mask / Disable masks of check DFC_ComMETKRingCnt" VALUE 0x804EE74E Val_Wu16 65535.00 DFES_OneToOne 0.00 65535.00 FORMAT "%8.2" /end CHARACTERISTIC
/begin CHARACTERISTIC DFC_DisblMsk.DFC_ComMETKTOut_C "disable mask / Disable masks of check DFC_ComMETKTOut" VALUE 0x804EE750 Val_Wu16 65535.00 DFES_OneToOne 0.00 65535.00 FORMAT "%8.2" /end CHARACTERISTIC
/begin CHARACTERISTIC DFC_DisblMsk.DFC_ComMETLChksum_C "disable mask / Disable masks of check DFC_ComMETLChksum" VALUE 0x804EE752 Val_Wu16 65535.00 DFES_OneToOne 0.00 65535.00 FORMAT "%8.2" /end CHARACTERISTIC
/begin CHARACTERISTIC DFC_DisblMsk.DFC_ComMETLRingCnt_C "disable mask / Disable masks of check DFC_ComMETLRingCnt" VALUE 0x804EE754 Val_Wu16 65535.00 DFES_OneToOne 0.00 65535.00 FORMAT "%8.2" /end CHARACTERISTIC
/begin CHARACTERISTIC DFC_DisblMsk.DFC_ComMETLTOut_C "disable mask / Disable masks of check DFC_ComMETLTOut" VALUE 0x804EE756 Val_Wu16 65535.00 DFES_OneToOne 0.00 65535.00 FORMAT "%8.2" /end CHARACTERISTIC
/begin CHARACTERISTIC DFC_DisblMsk.DFC_ComMETMChksum_C "disable mask / Disable masks of check DFC_ComMETMChksum" VALUE 0x804EE758 Val_Wu16 65535.00 DFES_OneToOne 0.00 65535.00 FORMAT "%8.2" /end CHARACTERISTIC
/begin CHARACTERISTIC DFC_DisblMsk.DFC_ComMETMRingCnt_C "disable mask / Disable masks of check DFC_ComMETMRingCnt" VALUE 0x804EE75A Val_Wu16 65535.00 DFES_OneToOne 0.00 65535.00 FORMAT "%8.2" /end CHARACTERISTIC
/begin CHARACTERISTIC DFC_DisblMsk.DFC_ComMETMTOut_C "disable mask / Disable masks of check DFC_ComMETMTOut" VALUE 0x804EE75C Val_Wu16 65535.00 DFES_OneToOne 0.00 65535.00 FORMAT "%8.2" /end CHARACTERISTIC
/begin CHARACTERISTIC DFC_DisblMsk.DFC_ComMETNChksum_C "disable mask / Disable masks of check DFC_ComMETNChksum" VALUE 0x804EE75E Val_Wu16 65535.00 DFES_OneToOne 0.00 65535.00 FORMAT "%8.2" /end CHARACTERISTIC
/begin CHARACTERISTIC DFC_DisblMsk.DFC_ComMETNRingCnt_C "disable mask / Disable masks of check DFC_ComMETNRingCnt" VALUE 0x804EE760 Val_Wu16 65535.00 DFES_OneToOne 0.00 65535.00 FORMAT "%8.2" /end CHARACTERISTIC
/begin CHARACTERISTIC DFC_DisblMsk.DFC_ComMETNTOut_C "disable mask / Disable masks of check DFC_ComMETNTOut" VALUE 0x804EE762 Val_Wu16 65535.00 DFES_OneToOne 0.00 65535.00 FORMAT "%8.2" /end CHARACTERISTIC
/begin CHARACTERISTIC DFC_DisblMsk.DFC_ComMtrCom_C "disable mask / Disable masks of check DFC_ComMtrCom" VALUE 0x804EE764 Val_Wu16 65535.00 DFES_OneToOne 0.00 65535.00 FORMAT "%8.2" /end CHARACTERISTIC
/begin CHARACTERISTIC DFC_DisblMsk.DFC_ComPCUChkSum_C "disable mask / Disable masks of check DFC_ComPCUChkSum" VALUE 0x804EE766 Val_Wu16 65535.00 DFES_OneToOne 0.00 65535.00 FORMAT "%8.2" /end CHARACTERISTIC
/begin CHARACTERISTIC DFC_DisblMsk.DFC_ComPCURingCnt_C "disable mask / Disable masks of check DFC_ComPCURingCnt" VALUE 0x804EE768 Val_Wu16 65535.00 DFES_OneToOne 0.00 65535.00 FORMAT "%8.2" /end CHARACTERISTIC
/begin CHARACTERISTIC DFC_DisblMsk.DFC_ComPCUTOut_C "disable mask / Disable masks of check DFC_ComPCUTOut" VALUE 0x804EE76A Val_Wu16 65535.00 DFES_OneToOne 0.00 65535.00 FORMAT "%8.2" /end CHARACTERISTIC
/begin CHARACTERISTIC DFC_DisblMsk.DFC_ComSRSAChksum_C "disable mask / Disable masks of check DFC_ComSRSAChksum" VALUE 0x804EE76C Val_Wu16 65535.00 DFES_OneToOne 0.00 65535.00 FORMAT "%8.2" /end CHARACTERISTIC
/begin CHARACTERISTIC DFC_DisblMsk.DFC_ComSRSARingCnt_C "disable mask / Disable masks of check DFC_ComSRSARingCnt" VALUE 0x804EE76E Val_Wu16 65535.00 DFES_OneToOne 0.00 65535.00 FORMAT "%8.2" /end CHARACTERISTIC
/begin CHARACTERISTIC DFC_DisblMsk.DFC_ComSRSATOut_C "disable mask / Disable masks of check DFC_ComSRSATOut" VALUE 0x804EE770 Val_Wu16 65535.00 DFES_OneToOne 0.00 65535.00 FORMAT "%8.2" /end CHARACTERISTIC
/begin CHARACTERISTIC DFC_DisblMsk.DFC_ComSRSBChksum_C "disable mask / Disable masks of check DFC_ComSRSBChksum" VALUE 0x804EE772 Val_Wu16 65535.00 DFES_OneToOne 0.00 65535.00 FORMAT "%8.2" /end CHARACTERISTIC
/begin CHARACTERISTIC DFC_DisblMsk.DFC_ComSRSBRingCnt_C "disable mask / Disable masks of check DFC_ComSRSBRingCnt" VALUE 0x804EE774 Val_Wu16 65535.00 DFES_OneToOne 0.00 65535.00 FORMAT "%8.2" /end CHARACTERISTIC
/begin CHARACTERISTIC DFC_DisblMsk.DFC_ComSRSBTOut_C "disable mask / Disable masks of check DFC_ComSRSBTOut" VALUE 0x804EE776 Val_Wu16 65535.00 DFES_OneToOne 0.00 65535.00 FORMAT "%8.2" /end CHARACTERISTIC
/begin CHARACTERISTIC DFC_DisblMsk.DFC_ComSRSChksum_C "disable mask / Disable masks of check DFC_ComSRSChksum" VALUE 0x804EE778 Val_Wu16 65535.00 DFES_OneToOne 0.00 65535.00 FORMAT "%8.2" /end CHARACTERISTIC
/begin CHARACTERISTIC DFC_DisblMsk.DFC_ComSRSErr_C "disable mask / Disable masks of check DFC_ComSRSErr" VALUE 0x804EE77A Val_Wu16 65535.00 DFES_OneToOne 0.00 65535.00 FORMAT "%8.2" /end CHARACTERISTIC
/begin CHARACTERISTIC DFC_DisblMsk.DFC_ComSRSRingCnt_C "disable mask / Disable masks of check DFC_ComSRSRingCnt" VALUE 0x804EE77C Val_Wu16 65535.00 DFES_OneToOne 0.00 65535.00 FORMAT "%8.2" /end CHARACTERISTIC
/begin CHARACTERISTIC DFC_DisblMsk.DFC_ComSRSTOut_C "disable mask / Disable masks of check DFC_ComSRSTOut" VALUE 0x804EE77E Val_Wu16 65535.00 DFES_OneToOne 0.00 65535.00 FORMAT "%8.2" /end CHARACTERISTIC
/begin CHARACTERISTIC DFC_DisblMsk.DFC_ComVehSpdPndFltTCU_C "disable mask / Disable masks of check DFC_ComVehSpdPndFltTCU" VALUE 0x804EE780 Val_Wu16 65535.00 DFES_OneToOne 0.00 65535.00 FORMAT "%8.2" /end CHARACTERISTIC
/begin CHARACTERISTIC DFC_DisblMsk.DFC_EbsChartcCurrErr_C "disable mask / Disable masks of check DFC_EbsChartcCurrErr" VALUE 0x804EE782 Val_Wu16 65535.00 DFES_OneToOne 0.00 65535.00 FORMAT "%8.2" /end CHARACTERISTIC
/begin CHARACTERISTIC DFC_DisblMsk.DFC_EbsSelfDiagErr_C "disable mask / Disable masks of check DFC_EbsSelfDiagErr" VALUE 0x804EE784 Val_Wu16 65535.00 DFES_OneToOne 0.00 65535.00 FORMAT "%8.2" /end CHARACTERISTIC
/begin CHARACTERISTIC DFC_DisblMsk.DFC_GbxCANDigPlausErr_C "disable mask / Disable masks of check DFC_GbxCANDigPlausErr" VALUE 0x804EE786 Val_Wu16 65535.00 DFES_OneToOne 0.00 65535.00 FORMAT "%8.2" /end CHARACTERISTIC
/begin CHARACTERISTIC DFC_DisblMsk.DFC_GbxNPos1SRCMax_C "disable mask / Disable masks of check DFC_GbxNPos1SRCMax" VALUE 0x804EE788 Val_Wu16 65535.00 DFES_OneToOne 0.00 65535.00 FORMAT "%8.2" /end CHARACTERISTIC
/begin CHARACTERISTIC DFC_DisblMsk.DFC_GbxNPos1SRCMin_C "disable mask / Disable masks of check DFC_GbxNPos1SRCMin" VALUE 0x804EE78A Val_Wu16 65535.00 DFES_OneToOne 0.00 65535.00 FORMAT "%8.2" /end CHARACTERISTIC
/begin CHARACTERISTIC DFC_DisblMsk.DFC_GbxNPos2SRCMax_C "disable mask / Disable masks of check DFC_GbxNPos2SRCMax" VALUE 0x804EE78C Val_Wu16 65535.00 DFES_OneToOne 0.00 65535.00 FORMAT "%8.2" /end CHARACTERISTIC
/begin CHARACTERISTIC DFC_DisblMsk.DFC_GbxNPos2SRCMin_C "disable mask / Disable masks of check DFC_GbxNPos2SRCMin" VALUE 0x804EE78E Val_Wu16 65535.00 DFES_OneToOne 0.00 65535.00 FORMAT "%8.2" /end CHARACTERISTIC
/begin CHARACTERISTIC DFC_DisblMsk.DFC_GbxNPosAlvChk_C "disable mask / Disable masks of check DFC_GbxNPosAlvChk" VALUE 0x804EE790 Val_Wu16 65535.00 DFES_OneToOne 0.00 65535.00 FORMAT "%8.2" /end CHARACTERISTIC
/begin CHARACTERISTIC DFC_DisblMsk.DFC_GbxNPosSyncErr_C "disable mask / Disable masks of check DFC_GbxNPosSyncErr" VALUE 0x804EE792 Val_Wu16 65535.00 DFES_OneToOne 0.00 65535.00 FORMAT "%8.2" /end CHARACTERISTIC
/begin CHARACTERISTIC DFC_DisblMsk.DFC_HEGOS2B1HtrPsMax_C "disable mask / Disable masks of check DFC_HEGOS2B1HtrPsMax" VALUE 0x804EE794 Val_Wu16 65535.00 DFES_OneToOne 0.00 65535.00 FORMAT "%8.2" /end CHARACTERISTIC
/begin CHARACTERISTIC DFC_DisblMsk.DFC_HEGOS2B1HtrPsMin_C "disable mask / Disable masks of check DFC_HEGOS2B1HtrPsMin" VALUE 0x804EE796 Val_Wu16 65535.00 DFES_OneToOne 0.00 65535.00 FORMAT "%8.2" /end CHARACTERISTIC
/begin CHARACTERISTIC DFC_DisblMsk.DFC_HEGOS2B1HtrPsSig_C "disable mask / Disable masks of check DFC_HEGOS2B1HtrPsSig" VALUE 0x804EE798 Val_Wu16 65535.00 DFES_OneToOne 0.00 65535.00 FORMAT "%8.2" /end CHARACTERISTIC
/begin CHARACTERISTIC DFC_DisblMsk.DFC_LinCSErrACG_C "disable mask / Disable masks of check DFC_LinCSErrACG" VALUE 0x804EE79A Val_Wu16 65535.00 DFES_OneToOne 0.00 65535.00 FORMAT "%8.2" /end CHARACTERISTIC
/begin CHARACTERISTIC DFC_DisblMsk.DFC_LinCSErrEBS_C "disable mask / Disable masks of check DFC_LinCSErrEBS" VALUE 0x804EE79C Val_Wu16 65535.00 DFES_OneToOne 0.00 65535.00 FORMAT "%8.2" /end CHARACTERISTIC
/begin CHARACTERISTIC DFC_DisblMsk.DFC_LinHdrTimeoutErrACG_C "disable mask / Disable masks of check DFC_LinHdrTimeoutErrACG" VALUE 0x804EE79E Val_Wu16 65535.00 DFES_OneToOne 0.00 65535.00 FORMAT "%8.2" /end CHARACTERISTIC
/begin CHARACTERISTIC DFC_DisblMsk.DFC_LinHdrTimeoutErrEBS_C "disable mask / Disable masks of check DFC_LinHdrTimeoutErrEBS" VALUE 0x804EE7A0 Val_Wu16 65535.00 DFES_OneToOne 0.00 65535.00 FORMAT "%8.2" /end CHARACTERISTIC
/begin CHARACTERISTIC DFC_DisblMsk.DFC_LinMsgTimeoutErrACG_C "disable mask / Disable masks of check DFC_LinMsgTimeoutErrACG" VALUE 0x804EE7A2 Val_Wu16 65535.00 DFES_OneToOne 0.00 65535.00 FORMAT "%8.2" /end CHARACTERISTIC
/begin CHARACTERISTIC DFC_DisblMsk.DFC_LinMsgTimeoutErrEBS_C "disable mask / Disable masks of check DFC_LinMsgTimeoutErrEBS" VALUE 0x804EE7A4 Val_Wu16 65535.00 DFES_OneToOne 0.00 65535.00 FORMAT "%8.2" /end CHARACTERISTIC
/begin CHARACTERISTIC DFC_DisblMsk.DFC_LinNoStrtComErr_C "disable mask / Disable masks of check DFC_LinNoStrtComErr" VALUE 0x804EE7A6 Val_Wu16 65535.00 DFES_OneToOne 0.00 65535.00 FORMAT "%8.2" /end CHARACTERISTIC
/begin CHARACTERISTIC DFC_DisblMsk.DFC_MisfDetVWhlFrntLeOORHi_C "disable mask / Disable masks of check DFC_MisfDetVWhlFrntLeOORHi" VALUE 0x804EE7A8 Val_Wu16 65535.00 DFES_OneToOne 0.00 65535.00 FORMAT "%8.2" /end CHARACTERISTIC
/begin CHARACTERISTIC DFC_DisblMsk.DFC_MisfDetVWhlFrntLeRatyHi_C "disable mask / Disable masks of check DFC_MisfDetVWhlFrntLeRatyHi" VALUE 0x804EE7AA Val_Wu16 65535.00 DFES_OneToOne 0.00 65535.00 FORMAT "%8.2" /end CHARACTERISTIC
/begin CHARACTERISTIC DFC_DisblMsk.DFC_MisfDetVWhlFrntLeRatyLo_C "disable mask / Disable masks of check DFC_MisfDetVWhlFrntLeRatyLo" VALUE 0x804EE7AC Val_Wu16 65535.00 DFES_OneToOne 0.00 65535.00 FORMAT "%8.2" /end CHARACTERISTIC
/begin CHARACTERISTIC DFC_DisblMsk.DFC_MisfDetVWhlFrntLeStuck_C "disable mask / Disable masks of check DFC_MisfDetVWhlFrntLeStuck" VALUE 0x804EE7AE Val_Wu16 65535.00 DFES_OneToOne 0.00 65535.00 FORMAT "%8.2" /end CHARACTERISTIC
/begin CHARACTERISTIC DFC_DisblMsk.DFC_MisfDetVWhlFrntRiOORHi_C "disable mask / Disable masks of check DFC_MisfDetVWhlFrntRiOORHi" VALUE 0x804EE7B0 Val_Wu16 65535.00 DFES_OneToOne 0.00 65535.00 FORMAT "%8.2" /end CHARACTERISTIC
/begin CHARACTERISTIC DFC_DisblMsk.DFC_MisfDetVWhlFrntRiRatyHi_C "disable mask / Disable masks of check DFC_MisfDetVWhlFrntRiRatyHi" VALUE 0x804EE7B2 Val_Wu16 65535.00 DFES_OneToOne 0.00 65535.00 FORMAT "%8.2" /end CHARACTERISTIC
/begin CHARACTERISTIC DFC_DisblMsk.DFC_MisfDetVWhlFrntRiRatyLo_C "disable mask / Disable masks of check DFC_MisfDetVWhlFrntRiRatyLo" VALUE 0x804EE7B4 Val_Wu16 65535.00 DFES_OneToOne 0.00 65535.00 FORMAT "%8.2" /end CHARACTERISTIC
/begin CHARACTERISTIC DFC_DisblMsk.DFC_MisfDetVWhlFrntRiStuck_C "disable mask / Disable masks of check DFC_MisfDetVWhlFrntRiStuck" VALUE 0x804EE7B6 Val_Wu16 65535.00 DFES_OneToOne 0.00 65535.00 FORMAT "%8.2" /end CHARACTERISTIC
/begin CHARACTERISTIC DFC_DisblMsk.DFC_MisfDetVWhlReLeOORHi_C "disable mask / Disable masks of check DFC_MisfDetVWhlReLeOORHi" VALUE 0x804EE7B8 Val_Wu16 65535.00 DFES_OneToOne 0.00 65535.00 FORMAT "%8.2" /end CHARACTERISTIC
/begin CHARACTERISTIC DFC_DisblMsk.DFC_MisfDetVWhlReLeRatyHi_C "disable mask / Disable masks of check DFC_MisfDetVWhlReLeRatyHi" VALUE 0x804EE7BA Val_Wu16 65535.00 DFES_OneToOne 0.00 65535.00 FORMAT "%8.2" /end CHARACTERISTIC
/begin CHARACTERISTIC DFC_DisblMsk.DFC_MisfDetVWhlReLeRatyLo_C "disable mask / Disable masks of check DFC_MisfDetVWhlReLeRatyLo" VALUE 0x804EE7BC Val_Wu16 65535.00 DFES_OneToOne 0.00 65535.00 FORMAT "%8.2" /end CHARACTERISTIC
/begin CHARACTERISTIC DFC_DisblMsk.DFC_MisfDetVWhlReLeStuck_C "disable mask / Disable masks of check DFC_MisfDetVWhlReLeStuck" VALUE 0x804EE7BE Val_Wu16 65535.00 DFES_OneToOne 0.00 65535.00 FORMAT "%8.2" /end CHARACTERISTIC
/begin CHARACTERISTIC DFC_DisblMsk.DFC_MisfDetVWhlReRiOORHi_C "disable mask / Disable masks of check DFC_MisfDetVWhlReRiOORHi" VALUE 0x804EE7C0 Val_Wu16 65535.00 DFES_OneToOne 0.00 65535.00 FORMAT "%8.2" /end CHARACTERISTIC
/begin CHARACTERISTIC DFC_DisblMsk.DFC_MisfDetVWhlReRiRatyHi_C "disable mask / Disable masks of check DFC_MisfDetVWhlReRiRatyHi" VALUE 0x804EE7C2 Val_Wu16 65535.00 DFES_OneToOne 0.00 65535.00 FORMAT "%8.2" /end CHARACTERISTIC
/begin CHARACTERISTIC DFC_DisblMsk.DFC_MisfDetVWhlReRiRatyLo_C "disable mask / Disable masks of check DFC_MisfDetVWhlReRiRatyLo" VALUE 0x804EE7C4 Val_Wu16 65535.00 DFES_OneToOne 0.00 65535.00 FORMAT "%8.2" /end CHARACTERISTIC
/begin CHARACTERISTIC DFC_DisblMsk.DFC_MisfDetVWhlReRiStuck_C "disable mask / Disable masks of check DFC_MisfDetVWhlReRiStuck" VALUE 0x804EE7C6 Val_Wu16 65535.00 DFES_OneToOne 0.00 65535.00 FORMAT "%8.2" /end CHARACTERISTIC
/begin CHARACTERISTIC DFC_DisblMsk.DFC_MisfDetdVWhlFrntLePlaus_C "disable mask / Disable masks of check DFC_MisfDetdVWhlFrntLePlaus" VALUE 0x804EE7C8 Val_Wu16 65535.00 DFES_OneToOne 0.00 65535.00 FORMAT "%8.2" /end CHARACTERISTIC
/begin CHARACTERISTIC DFC_DisblMsk.DFC_MisfDetdVWhlFrntRiPlaus_C "disable mask / Disable masks of check DFC_MisfDetdVWhlFrntRiPlaus" VALUE 0x804EE7CA Val_Wu16 65535.00 DFES_OneToOne 0.00 65535.00 FORMAT "%8.2" /end CHARACTERISTIC
/begin CHARACTERISTIC DFC_DisblMsk.DFC_MisfDetdVWhlReLePlaus_C "disable mask / Disable masks of check DFC_MisfDetdVWhlReLePlaus" VALUE 0x804EE7CC Val_Wu16 65535.00 DFES_OneToOne 0.00 65535.00 FORMAT "%8.2" /end CHARACTERISTIC
/begin CHARACTERISTIC DFC_DisblMsk.DFC_MisfDetdVWhlReRiPlaus_C "disable mask / Disable masks of check DFC_MisfDetdVWhlReRiPlaus" VALUE 0x804EE7CE Val_Wu16 65535.00 DFES_OneToOne 0.00 65535.00 FORMAT "%8.2" /end CHARACTERISTIC
/begin CHARACTERISTIC DFC_DisblMsk.DFC_PEnvSigRngMax_C "disable mask / Disable masks of check DFC_PEnvSigRngMax" VALUE 0x804EE7D0 Val_Wu16 65535.00 DFES_OneToOne 0.00 65535.00 FORMAT "%8.2" /end CHARACTERISTIC
/begin CHARACTERISTIC DFC_DisblMsk.DFC_PEnvSigRngMin_C "disable mask / Disable masks of check DFC_PEnvSigRngMin" VALUE 0x804EE7D2 Val_Wu16 65535.00 DFES_OneToOne 0.00 65535.00 FORMAT "%8.2" /end CHARACTERISTIC
/begin CHARACTERISTIC DFC_DisblMsk.DFC_StmFault_C "disable mask / Disable masks of check DFC_StmFault" VALUE 0x804EE7D4 Val_Wu16 65535.00 DFES_OneToOne 0.00 65535.00 FORMAT "%8.2" /end CHARACTERISTIC
/begin CHARACTERISTIC DFC_DisblMsk.DFC_StrtCtOffPth_C "disable mask / Disable masks of check DFC_StrtCtOffPth" VALUE 0x804EE7D6 Val_Wu16 65535.00 DFES_OneToOne 0.00 65535.00 FORMAT "%8.2" /end CHARACTERISTIC
/begin CHARACTERISTIC DFC_DisblMsk.DFC_StrtCtlErr_C "disable mask / Disable masks of check DFC_StrtCtlErr" VALUE 0x804EE7D8 Val_Wu16 65535.00 DFES_OneToOne 0.00 65535.00 FORMAT "%8.2" /end CHARACTERISTIC
/begin CHARACTERISTIC DFC_DisblMsk.DFC_StrtFault_C "disable mask / Disable masks of check DFC_StrtFault" VALUE 0x804EE7DA Val_Wu16 65535.00 DFES_OneToOne 0.00 65535.00 FORMAT "%8.2" /end CHARACTERISTIC
/begin CHARACTERISTIC DFC_DisblMsk.DFC_StrtLckJudg1_C "disable mask / Disable masks of check DFC_StrtLckJudg1" VALUE 0x804EE7DC Val_Wu16 65535.00 DFES_OneToOne 0.00 65535.00 FORMAT "%8.2" /end CHARACTERISTIC
/begin CHARACTERISTIC DFC_DisblMsk.DFC_StrtLckJudg2_C "disable mask / Disable masks of check DFC_StrtLckJudg2" VALUE 0x804EE7DE Val_Wu16 65535.00 DFES_OneToOne 0.00 65535.00 FORMAT "%8.2" /end CHARACTERISTIC
/begin CHARACTERISTIC DFC_DisblMsk.DFC_StrtOL_C "disable mask / Disable masks of check DFC_StrtOL" VALUE 0x804EE7E0 Val_Wu16 65535.00 DFES_OneToOne 0.00 65535.00 FORMAT "%8.2" /end CHARACTERISTIC
/begin CHARACTERISTIC DFC_DisblMsk.DFC_StrtOL2_C "disable mask / Disable masks of check DFC_StrtOL2" VALUE 0x804EE7E2 Val_Wu16 65535.00 DFES_OneToOne 0.00 65535.00 FORMAT "%8.2" /end CHARACTERISTIC
/begin CHARACTERISTIC DFC_DisblMsk.DFC_StrtSCB_C "disable mask / Disable masks of check DFC_StrtSCB" VALUE 0x804EE7E4 Val_Wu16 65535.00 DFES_OneToOne 0.00 65535.00 FORMAT "%8.2" /end CHARACTERISTIC
/begin CHARACTERISTIC DFC_DisblMsk.DFC_StrtSCB2_C "disable mask / Disable masks of check DFC_StrtSCB2" VALUE 0x804EE7E6 Val_Wu16 65535.00 DFES_OneToOne 0.00 65535.00 FORMAT "%8.2" /end CHARACTERISTIC
/begin CHARACTERISTIC DFC_DisblMsk.DFC_StrtSCG_C "disable mask / Disable masks of check DFC_StrtSCG" VALUE 0x804EE7E8 Val_Wu16 65535.00 DFES_OneToOne 0.00 65535.00 FORMAT "%8.2" /end CHARACTERISTIC
/begin CHARACTERISTIC DFC_DisblMsk.DFC_StrtSCG2_C "disable mask / Disable masks of check DFC_StrtSCG2" VALUE 0x804EE7EA Val_Wu16 65535.00 DFES_OneToOne 0.00 65535.00 FORMAT "%8.2" /end CHARACTERISTIC
/begin CHARACTERISTIC DFC_DisblMsk.DFC_StrtStkRly1_C "disable mask / Disable masks of check DFC_StrtStkRly1" VALUE 0x804EE7EC Val_Wu16 65535.00 DFES_OneToOne 0.00 65535.00 FORMAT "%8.2" /end CHARACTERISTIC
/begin CHARACTERISTIC DFC_DisblMsk.DFC_StrtStkRly2_C "disable mask / Disable masks of check DFC_StrtStkRly2" VALUE 0x804EE7EE Val_Wu16 65535.00 DFES_OneToOne 0.00 65535.00 FORMAT "%8.2" /end CHARACTERISTIC
/begin CHARACTERISTIC DFC_DisblMsk.DFC_TEVEmax_C "disable mask / Disable masks of check DFC_TEVEmax" VALUE 0x804EE7F0 Val_Wu16 65535.00 DFES_OneToOne 0.00 65535.00 FORMAT "%8.2" /end CHARACTERISTIC
/begin CHARACTERISTIC DFC_DisblMsk.DFC_TEVEmin_C "disable mask / Disable masks of check DFC_TEVEmin" VALUE 0x804EE7F2 Val_Wu16 65535.00 DFES_OneToOne 0.00 65535.00 FORMAT "%8.2" /end CHARACTERISTIC
/begin CHARACTERISTIC DFC_DisblMsk.DFC_TEVEsig_C "disable mask / Disable masks of check DFC_TEVEsig" VALUE 0x804EE7F4 Val_Wu16 65535.00 DFES_OneToOne 0.00 65535.00 FORMAT "%8.2" /end CHARACTERISTIC
/begin CHARACTERISTIC DFC_DisblMsk.DFC_VehVAllPlaus_C "disable mask / Disable masks of check DFC_VehVAllPlaus" VALUE 0x804EE7F6 Val_Wu16 65535.00 DFES_OneToOne 0.00 65535.00 FORMAT "%8.2" /end CHARACTERISTIC
/begin CHARACTERISTIC DFC_DisblMsk.DFC_VehVNCSnsrElecFailr_C "disable mask / Disable masks of check DFC_VehVNCSnsrElecFailr" VALUE 0x804EE7F8 Val_Wu16 65535.00 DFES_OneToOne 0.00 65535.00 FORMAT "%8.2" /end CHARACTERISTIC
/begin CHARACTERISTIC DFC_DisblMsk.DFC_VehVPlausCan_C "disable mask / Disable masks of check DFC_VehVPlausCan" VALUE 0x804EE7FA Val_Wu16 65535.00 DFES_OneToOne 0.00 65535.00 FORMAT "%8.2" /end CHARACTERISTIC
/begin CHARACTERISTIC DFC_DisblMsk.DFC_VehVPlausFco_C "disable mask / Disable masks of check DFC_VehVPlausFco" VALUE 0x804EE7FC Val_Wu16 65535.00 DFES_OneToOne 0.00 65535.00 FORMAT "%8.2" /end CHARACTERISTIC
/begin CHARACTERISTIC DFC_DisblMsk.DFC_VehVPlausPwr_C "disable mask / Disable masks of check DFC_VehVPlausPwr" VALUE 0x804EE7FE Val_Wu16 65535.00 DFES_OneToOne 0.00 65535.00 FORMAT "%8.2" /end CHARACTERISTIC
/begin CHARACTERISTIC DFC_DisblMsk.DFC_VehVPlausV2N_C "disable mask / Disable masks of check DFC_VehVPlausV2N" VALUE 0x804EE800 Val_Wu16 65535.00 DFES_OneToOne 0.00 65535.00 FORMAT "%8.2" /end CHARACTERISTIC
/begin CHARACTERISTIC DFC_DisblMsk.DFC_VehVSpdSnsrAElecFailr_C "disable mask / Disable masks of check DFC_VehVSpdSnsrAElecFailr" VALUE 0x804EE802 Val_Wu16 65535.00 DFES_OneToOne 0.00 65535.00 FORMAT "%8.2" /end CHARACTERISTIC
/begin CHARACTERISTIC DFC_DisblMsk.DFC_VehVSpdSnsrBElecFailr_C "disable mask / Disable masks of check DFC_VehVSpdSnsrBElecFailr" VALUE 0x804EE804 Val_Wu16 65535.00 DFES_OneToOne 0.00 65535.00 FORMAT "%8.2" /end CHARACTERISTIC
/begin CHARACTERISTIC DFC_DisblMsk.DFC_ClthMax_C "disable mask / Disable masks of check DFC_ClthMax" VALUE 0x804EE806 Val_Wu16 65535.00 DFES_OneToOne 0.00 65535.00 FORMAT "%8.2" /end CHARACTERISTIC
/begin CHARACTERISTIC DFC_DisblMsk.DFC_IgnClPs_DevComErr_C "disable mask / Disable masks of check DFC_IgnClPs_DevComErr" VALUE 0x804EE808 Val_Wu16 65535.00 DFES_OneToOne 0.00 65535.00 FORMAT "%8.2" /end CHARACTERISTIC
/begin CHARACTERISTIC DFC_DisblMsk.DFC_IgnClPs_LineOl_0_C "disable mask / Disable masks of check DFC_IgnClPs_LineOl_0" VALUE 0x804EE80A Val_Wu16 65535.00 DFES_OneToOne 0.00 65535.00 FORMAT "%8.2" /end CHARACTERISTIC
/begin CHARACTERISTIC DFC_DisblMsk.DFC_IgnClPs_LineOl_1_C "disable mask / Disable masks of check DFC_IgnClPs_LineOl_1" VALUE 0x804EE80C Val_Wu16 65535.00 DFES_OneToOne 0.00 65535.00 FORMAT "%8.2" /end CHARACTERISTIC
/begin CHARACTERISTIC DFC_DisblMsk.DFC_IgnClPs_LineOl_2_C "disable mask / Disable masks of check DFC_IgnClPs_LineOl_2" VALUE 0x804EE80E Val_Wu16 65535.00 DFES_OneToOne 0.00 65535.00 FORMAT "%8.2" /end CHARACTERISTIC
/begin CHARACTERISTIC DFC_DisblMsk.DFC_IgnClPs_LineOl_3_C "disable mask / Disable masks of check DFC_IgnClPs_LineOl_3" VALUE 0x804EE810 Val_Wu16 65535.00 DFES_OneToOne 0.00 65535.00 FORMAT "%8.2" /end CHARACTERISTIC
/begin CHARACTERISTIC DFC_DisblMsk.DFC_IgnClPs_LineScb_0_C "disable mask / Disable masks of check DFC_IgnClPs_LineScb_0" VALUE 0x804EE812 Val_Wu16 65535.00 DFES_OneToOne 0.00 65535.00 FORMAT "%8.2" /end CHARACTERISTIC
/begin CHARACTERISTIC DFC_DisblMsk.DFC_IgnClPs_LineScb_1_C "disable mask / Disable masks of check DFC_IgnClPs_LineScb_1" VALUE 0x804EE814 Val_Wu16 65535.00 DFES_OneToOne 0.00 65535.00 FORMAT "%8.2" /end CHARACTERISTIC
/begin CHARACTERISTIC DFC_DisblMsk.DFC_IgnClPs_LineScb_2_C "disable mask / Disable masks of check DFC_IgnClPs_LineScb_2" VALUE 0x804EE816 Val_Wu16 65535.00 DFES_OneToOne 0.00 65535.00 FORMAT "%8.2" /end CHARACTERISTIC
/begin CHARACTERISTIC DFC_DisblMsk.DFC_IgnClPs_LineScb_3_C "disable mask / Disable masks of check DFC_IgnClPs_LineScb_3" VALUE 0x804EE818 Val_Wu16 65535.00 DFES_OneToOne 0.00 65535.00 FORMAT "%8.2" /end CHARACTERISTIC
/begin CHARACTERISTIC DFC_DisblMsk.DFC_IgnClPs_LineScg_0_C "disable mask / Disable masks of check DFC_IgnClPs_LineScg_0" VALUE 0x804EE81A Val_Wu16 65535.00 DFES_OneToOne 0.00 65535.00 FORMAT "%8.2" /end CHARACTERISTIC
/begin CHARACTERISTIC DFC_DisblMsk.DFC_IgnClPs_LineScg_1_C "disable mask / Disable masks of check DFC_IgnClPs_LineScg_1" VALUE 0x804EE81C Val_Wu16 65535.00 DFES_OneToOne 0.00 65535.00 FORMAT "%8.2" /end CHARACTERISTIC
/begin CHARACTERISTIC DFC_DisblMsk.DFC_IgnClPs_LineScg_2_C "disable mask / Disable masks of check DFC_IgnClPs_LineScg_2" VALUE 0x804EE81E Val_Wu16 65535.00 DFES_OneToOne 0.00 65535.00 FORMAT "%8.2" /end CHARACTERISTIC
/begin CHARACTERISTIC DFC_DisblMsk.DFC_IgnClPs_LineScg_3_C "disable mask / Disable masks of check DFC_IgnClPs_LineScg_3" VALUE 0x804EE820 Val_Wu16 65535.00 DFES_OneToOne 0.00 65535.00 FORMAT "%8.2" /end CHARACTERISTIC
/begin CHARACTERISTIC DFC_DisblMsk.DFC_UEGOASICS1B1_C "disable mask / Disable masks of check DFC_UEGOASICS1B1" VALUE 0x804EE822 Val_Wu16 65535.00 DFES_OneToOne 0.00 65535.00 FORMAT "%8.2" /end CHARACTERISTIC
/begin CHARACTERISTIC DFC_DisblMsk.DFC_UEGOOLIPES1B1_C "disable mask / Disable masks of check DFC_UEGOOLIPES1B1" VALUE 0x804EE824 Val_Wu16 65535.00 DFES_OneToOne 0.00 65535.00 FORMAT "%8.2" /end CHARACTERISTIC
/begin CHARACTERISTIC DFC_DisblMsk.DFC_UEGOOLRES1B1_C "disable mask / Disable masks of check DFC_UEGOOLRES1B1" VALUE 0x804EE826 Val_Wu16 65535.00 DFES_OneToOne 0.00 65535.00 FORMAT "%8.2" /end CHARACTERISTIC
/begin CHARACTERISTIC DFC_DisblMsk.DFC_UEGOSCBS1B1_C "disable mask / Disable masks of check DFC_UEGOSCBS1B1" VALUE 0x804EE828 Val_Wu16 65535.00 DFES_OneToOne 0.00 65535.00 FORMAT "%8.2" /end CHARACTERISTIC
/begin CHARACTERISTIC DFC_DisblMsk.DFC_UEGOSCGS1B1_C "disable mask / Disable masks of check DFC_UEGOSCGS1B1" VALUE 0x804EE82A Val_Wu16 65535.00 DFES_OneToOne 0.00 65535.00 FORMAT "%8.2" /end CHARACTERISTIC
/begin CHARACTERISTIC DFC_DisblMsk.DFC_UEGOSPIS1B1_C "disable mask / Disable masks of check DFC_UEGOSPIS1B1" VALUE 0x804EE82C Val_Wu16 65535.00 DFES_OneToOne 0.00 65535.00 FORMAT "%8.2" /end CHARACTERISTIC
/begin CHARACTERISTIC DFC_DisblMsk.DFC_UEGOSnsrS1B1_C "disable mask / Disable masks of check DFC_UEGOSnsrS1B1" VALUE 0x804EE82E Val_Wu16 65535.00 DFES_OneToOne 0.00 65535.00 FORMAT "%8.2" /end CHARACTERISTIC
/begin CHARACTERISTIC DFC_DisblMsk.DFC_UegoOlApesS1B1_C "disable mask / Disable masks of check DFC_UegoOlApesS1B1" VALUE 0x804EE830 Val_Wu16 65535.00 DFES_OneToOne 0.00 65535.00 FORMAT "%8.2" /end CHARACTERISTIC
/begin CHARACTERISTIC DFC_DisblMsk.DFC_UegoOlRCmpS1B1_C "disable mask / Disable masks of check DFC_UegoOlRCmpS1B1" VALUE 0x804EE832 Val_Wu16 65535.00 DFES_OneToOne 0.00 65535.00 FORMAT "%8.2" /end CHARACTERISTIC
/begin CHARACTERISTIC DFC_DisblMsk.DFC_AirCCmprOL_C "disable mask / Disable masks of check DFC_AirCCmprOL" VALUE 0x804EE834 Val_Wu16 65535.00 DFES_OneToOne 0.00 65535.00 FORMAT "%8.2" /end CHARACTERISTIC
/begin CHARACTERISTIC DFC_DisblMsk.DFC_AirCCmprOvrTemp_C "disable mask / Disable masks of check DFC_AirCCmprOvrTemp" VALUE 0x804EE836 Val_Wu16 65535.00 DFES_OneToOne 0.00 65535.00 FORMAT "%8.2" /end CHARACTERISTIC
/begin CHARACTERISTIC DFC_DisblMsk.DFC_AirCCmprSCB_C "disable mask / Disable masks of check DFC_AirCCmprSCB" VALUE 0x804EE838 Val_Wu16 65535.00 DFES_OneToOne 0.00 65535.00 FORMAT "%8.2" /end CHARACTERISTIC
/begin CHARACTERISTIC DFC_DisblMsk.DFC_AirCCmprSCG_C "disable mask / Disable masks of check DFC_AirCCmprSCG" VALUE 0x804EE83A Val_Wu16 65535.00 DFES_OneToOne 0.00 65535.00 FORMAT "%8.2" /end CHARACTERISTIC
/begin CHARACTERISTIC DFC_DisblMsk.DFC_AltErr_C "disable mask / Disable masks of check DFC_AltErr" VALUE 0x804EE83C Val_Wu16 65535.00 DFES_OneToOne 0.00 65535.00 FORMAT "%8.2" /end CHARACTERISTIC
/begin CHARACTERISTIC DFC_DisblMsk.DFC_BattUSRCMax_C "disable mask / Disable masks of check DFC_BattUSRCMax" VALUE 0x804EE83E Val_Wu16 65535.00 DFES_OneToOne 0.00 65535.00 FORMAT "%8.2" /end CHARACTERISTIC
/begin CHARACTERISTIC DFC_DisblMsk.DFC_BattUSRCMin_C "disable mask / Disable masks of check DFC_BattUSRCMin" VALUE 0x804EE840 Val_Wu16 65535.00 DFES_OneToOne 0.00 65535.00 FORMAT "%8.2" /end CHARACTERISTIC
/begin CHARACTERISTIC DFC_DisblMsk.DFC_ComChksTCU1_C "disable mask / Disable masks of check DFC_ComChksTCU1" VALUE 0x804EE842 Val_Wu16 65535.00 DFES_OneToOne 0.00 65535.00 FORMAT "%8.2" /end CHARACTERISTIC
/begin CHARACTERISTIC DFC_DisblMsk.DFC_ComChksTCU11_C "disable mask / Disable masks of check DFC_ComChksTCU11" VALUE 0x804EE844 Val_Wu16 65535.00 DFES_OneToOne 0.00 65535.00 FORMAT "%8.2" /end CHARACTERISTIC
/begin CHARACTERISTIC DFC_DisblMsk.DFC_ComChksTCU12_C "disable mask / Disable masks of check DFC_ComChksTCU12" VALUE 0x804EE846 Val_Wu16 65535.00 DFES_OneToOne 0.00 65535.00 FORMAT "%8.2" /end CHARACTERISTIC
/begin CHARACTERISTIC DFC_DisblMsk.DFC_ComChksTCU13_C "disable mask / Disable masks of check DFC_ComChksTCU13" VALUE 0x804EE848 Val_Wu16 65535.00 DFES_OneToOne 0.00 65535.00 FORMAT "%8.2" /end CHARACTERISTIC
/begin CHARACTERISTIC DFC_DisblMsk.DFC_ComChksTCU2_C "disable mask / Disable masks of check DFC_ComChksTCU2" VALUE 0x804EE84A Val_Wu16 65535.00 DFES_OneToOne 0.00 65535.00 FORMAT "%8.2" /end CHARACTERISTIC
/begin CHARACTERISTIC DFC_DisblMsk.DFC_ComChksTCU3_C "disable mask / Disable masks of check DFC_ComChksTCU3" VALUE 0x804EE84C Val_Wu16 65535.00 DFES_OneToOne 0.00 65535.00 FORMAT "%8.2" /end CHARACTERISTIC
/begin CHARACTERISTIC DFC_DisblMsk.DFC_ComChksTCU4_C "disable mask / Disable masks of check DFC_ComChksTCU4" VALUE 0x804EE84E Val_Wu16 65535.00 DFES_OneToOne 0.00 65535.00 FORMAT "%8.2" /end CHARACTERISTIC
/begin CHARACTERISTIC DFC_DisblMsk.DFC_ComCntTCU1_C "disable mask / Disable masks of check DFC_ComCntTCU1" VALUE 0x804EE850 Val_Wu16 65535.00 DFES_OneToOne 0.00 65535.00 FORMAT "%8.2" /end CHARACTERISTIC
/begin CHARACTERISTIC DFC_DisblMsk.DFC_ComCntTCU11_C "disable mask / Disable masks of check DFC_ComCntTCU11" VALUE 0x804EE852 Val_Wu16 65535.00 DFES_OneToOne 0.00 65535.00 FORMAT "%8.2" /end CHARACTERISTIC
/begin CHARACTERISTIC DFC_DisblMsk.DFC_ComCntTCU12_C "disable mask / Disable masks of check DFC_ComCntTCU12" VALUE 0x804EE854 Val_Wu16 65535.00 DFES_OneToOne 0.00 65535.00 FORMAT "%8.2" /end CHARACTERISTIC
/begin CHARACTERISTIC DFC_DisblMsk.DFC_ComCntTCU13_C "disable mask / Disable masks of check DFC_ComCntTCU13" VALUE 0x804EE856 Val_Wu16 65535.00 DFES_OneToOne 0.00 65535.00 FORMAT "%8.2" /end CHARACTERISTIC
/begin CHARACTERISTIC DFC_DisblMsk.DFC_ComCntTCU2_C "disable mask / Disable masks of check DFC_ComCntTCU2" VALUE 0x804EE858 Val_Wu16 65535.00 DFES_OneToOne 0.00 65535.00 FORMAT "%8.2" /end CHARACTERISTIC
/begin CHARACTERISTIC DFC_DisblMsk.DFC_ComCntTCU3_C "disable mask / Disable masks of check DFC_ComCntTCU3" VALUE 0x804EE85A Val_Wu16 65535.00 DFES_OneToOne 0.00 65535.00 FORMAT "%8.2" /end CHARACTERISTIC
/begin CHARACTERISTIC DFC_DisblMsk.DFC_ComCntTCU4_C "disable mask / Disable masks of check DFC_ComCntTCU4" VALUE 0x804EE85C Val_Wu16 65535.00 DFES_OneToOne 0.00 65535.00 FORMAT "%8.2" /end CHARACTERISTIC
/begin CHARACTERISTIC DFC_DisblMsk.DFC_ComTOutTCU01_C "disable mask / Disable masks of check DFC_ComTOutTCU01" VALUE 0x804EE85E Val_Wu16 65535.00 DFES_OneToOne 0.00 65535.00 FORMAT "%8.2" /end CHARACTERISTIC
/begin CHARACTERISTIC DFC_DisblMsk.DFC_ComTOutTCU02_C "disable mask / Disable masks of check DFC_ComTOutTCU02" VALUE 0x804EE860 Val_Wu16 65535.00 DFES_OneToOne 0.00 65535.00 FORMAT "%8.2" /end CHARACTERISTIC
/begin CHARACTERISTIC DFC_DisblMsk.DFC_ComTOutTCU1_C "disable mask / Disable masks of check DFC_ComTOutTCU1" VALUE 0x804EE862 Val_Wu16 65535.00 DFES_OneToOne 0.00 65535.00 FORMAT "%8.2" /end CHARACTERISTIC
/begin CHARACTERISTIC DFC_DisblMsk.DFC_ComTOutTCU11_C "disable mask / Disable masks of check DFC_ComTOutTCU11" VALUE 0x804EE864 Val_Wu16 65535.00 DFES_OneToOne 0.00 65535.00 FORMAT "%8.2" /end CHARACTERISTIC
/begin CHARACTERISTIC DFC_DisblMsk.DFC_ComTOutTCU12_C "disable mask / Disable masks of check DFC_ComTOutTCU12" VALUE 0x804EE866 Val_Wu16 65535.00 DFES_OneToOne 0.00 65535.00 FORMAT "%8.2" /end CHARACTERISTIC
/begin CHARACTERISTIC DFC_DisblMsk.DFC_ComTOutTCU13_C "disable mask / Disable masks of check DFC_ComTOutTCU13" VALUE 0x804EE868 Val_Wu16 65535.00 DFES_OneToOne 0.00 65535.00 FORMAT "%8.2" /end CHARACTERISTIC
/begin CHARACTERISTIC DFC_DisblMsk.DFC_ComTOutTCU14_C "disable mask / Disable masks of check DFC_ComTOutTCU14" VALUE 0x804EE86A Val_Wu16 65535.00 DFES_OneToOne 0.00 65535.00 FORMAT "%8.2" /end CHARACTERISTIC
/begin CHARACTERISTIC DFC_DisblMsk.DFC_ComTOutTCU2_C "disable mask / Disable masks of check DFC_ComTOutTCU2" VALUE 0x804EE86C Val_Wu16 65535.00 DFES_OneToOne 0.00 65535.00 FORMAT "%8.2" /end CHARACTERISTIC
/begin CHARACTERISTIC DFC_DisblMsk.DFC_ComTOutTCU3_C "disable mask / Disable masks of check DFC_ComTOutTCU3" VALUE 0x804EE86E Val_Wu16 65535.00 DFES_OneToOne 0.00 65535.00 FORMAT "%8.2" /end CHARACTERISTIC
/begin CHARACTERISTIC DFC_DisblMsk.DFC_ComTOutTCU4_C "disable mask / Disable masks of check DFC_ComTOutTCU4" VALUE 0x804EE870 Val_Wu16 65535.00 DFES_OneToOne 0.00 65535.00 FORMAT "%8.2" /end CHARACTERISTIC
/begin CHARACTERISTIC DFC_DisblMsk.DFC_DevLibBattUHi_C "disable mask / Disable masks of check DFC_DevLibBattUHi" VALUE 0x804EE872 Val_Wu16 65535.00 DFES_OneToOne 0.00 65535.00 FORMAT "%8.2" /end CHARACTERISTIC
/begin CHARACTERISTIC DFC_DisblMsk.DFC_DevLibBattULo_C "disable mask / Disable masks of check DFC_DevLibBattULo" VALUE 0x804EE874 Val_Wu16 65535.00 DFES_OneToOne 0.00 65535.00 FORMAT "%8.2" /end CHARACTERISTIC
/begin CHARACTERISTIC DFC_DisblMsk.DFC_FanDIOOL_0_C "disable mask / Disable masks of check DFC_FanDIOOL_0" VALUE 0x804EE876 Val_Wu16 65535.00 DFES_OneToOne 0.00 65535.00 FORMAT "%8.2" /end CHARACTERISTIC
/begin CHARACTERISTIC DFC_DisblMsk.DFC_FanDIOOL_1_C "disable mask / Disable masks of check DFC_FanDIOOL_1" VALUE 0x804EE878 Val_Wu16 65535.00 DFES_OneToOne 0.00 65535.00 FORMAT "%8.2" /end CHARACTERISTIC
/begin CHARACTERISTIC DFC_DisblMsk.DFC_FanDIOOvrTemp_0_C "disable mask / Disable masks of check DFC_FanDIOOvrTemp_0" VALUE 0x804EE87A Val_Wu16 65535.00 DFES_OneToOne 0.00 65535.00 FORMAT "%8.2" /end CHARACTERISTIC
/begin CHARACTERISTIC DFC_DisblMsk.DFC_FanDIOOvrTemp_1_C "disable mask / Disable masks of check DFC_FanDIOOvrTemp_1" VALUE 0x804EE87C Val_Wu16 65535.00 DFES_OneToOne 0.00 65535.00 FORMAT "%8.2" /end CHARACTERISTIC
/begin CHARACTERISTIC DFC_DisblMsk.DFC_FanDIOSCB_0_C "disable mask / Disable masks of check DFC_FanDIOSCB_0" VALUE 0x804EE87E Val_Wu16 65535.00 DFES_OneToOne 0.00 65535.00 FORMAT "%8.2" /end CHARACTERISTIC
/begin CHARACTERISTIC DFC_DisblMsk.DFC_FanDIOSCB_1_C "disable mask / Disable masks of check DFC_FanDIOSCB_1" VALUE 0x804EE880 Val_Wu16 65535.00 DFES_OneToOne 0.00 65535.00 FORMAT "%8.2" /end CHARACTERISTIC
/begin CHARACTERISTIC DFC_DisblMsk.DFC_FanDIOSCG_0_C "disable mask / Disable masks of check DFC_FanDIOSCG_0" VALUE 0x804EE882 Val_Wu16 65535.00 DFES_OneToOne 0.00 65535.00 FORMAT "%8.2" /end CHARACTERISTIC
/begin CHARACTERISTIC DFC_DisblMsk.DFC_FanDIOSCG_1_C "disable mask / Disable masks of check DFC_FanDIOSCG_1" VALUE 0x804EE884 Val_Wu16 65535.00 DFES_OneToOne 0.00 65535.00 FORMAT "%8.2" /end CHARACTERISTIC
/begin CHARACTERISTIC DFC_DisblMsk.DFC_MRlyDcOL_C "disable mask / Disable masks of check DFC_MRlyDcOL" VALUE 0x804EE886 Val_Wu16 65535.00 DFES_OneToOne 0.00 65535.00 FORMAT "%8.2" /end CHARACTERISTIC
/begin CHARACTERISTIC DFC_DisblMsk.DFC_MRlyDcSCB_C "disable mask / Disable masks of check DFC_MRlyDcSCB" VALUE 0x804EE888 Val_Wu16 65535.00 DFES_OneToOne 0.00 65535.00 FORMAT "%8.2" /end CHARACTERISTIC
/begin CHARACTERISTIC DFC_DisblMsk.DFC_MRlyDcSCG_C "disable mask / Disable masks of check DFC_MRlyDcSCG" VALUE 0x804EE88A Val_Wu16 65535.00 DFES_OneToOne 0.00 65535.00 FORMAT "%8.2" /end CHARACTERISTIC
/begin CHARACTERISTIC DFC_DisblMsk.DFC_PSPOL_C "disable mask / Disable masks of check DFC_PSPOL" VALUE 0x804EE88C Val_Wu16 65535.00 DFES_OneToOne 0.00 65535.00 FORMAT "%8.2" /end CHARACTERISTIC
/begin CHARACTERISTIC DFC_DisblMsk.DFC_PSPOvrTemp_C "disable mask / Disable masks of check DFC_PSPOvrTemp" VALUE 0x804EE88E Val_Wu16 65535.00 DFES_OneToOne 0.00 65535.00 FORMAT "%8.2" /end CHARACTERISTIC
/begin CHARACTERISTIC DFC_DisblMsk.DFC_PSPSCB_C "disable mask / Disable masks of check DFC_PSPSCB" VALUE 0x804EE890 Val_Wu16 65535.00 DFES_OneToOne 0.00 65535.00 FORMAT "%8.2" /end CHARACTERISTIC
/begin CHARACTERISTIC DFC_DisblMsk.DFC_PSPSCG_C "disable mask / Disable masks of check DFC_PSPSCG" VALUE 0x804EE892 Val_Wu16 65535.00 DFES_OneToOne 0.00 65535.00 FORMAT "%8.2" /end CHARACTERISTIC
/begin CHARACTERISTIC DFC_DisblMsk.DFC_T50Err_C "disable mask / Disable masks of check DFC_T50Err" VALUE 0x804EE894 Val_Wu16 65535.00 DFES_OneToOne 0.00 65535.00 FORMAT "%8.2" /end CHARACTERISTIC
/begin CHARACTERISTIC DFC_DisblMsk.DFC_ThrVlvLoBattB1_C "disable mask / Disable masks of check DFC_ThrVlvLoBattB1" VALUE 0x804EE896 Val_Wu16 65535.00 DFES_OneToOne 0.00 65535.00 FORMAT "%8.2" /end CHARACTERISTIC
/begin CHARACTERISTIC DFC_DisblMsk.DFC_VehVPhysRngHi_C "disable mask / Disable masks of check DFC_VehVPhysRngHi" VALUE 0x804EE898 Val_Wu16 65535.00 DFES_OneToOne 0.00 65535.00 FORMAT "%8.2" /end CHARACTERISTIC
/begin CHARACTERISTIC DFC_DisblMsk.DFC_VehVSclOutOL_C "disable mask / Disable masks of check DFC_VehVSclOutOL" VALUE 0x804EE89A Val_Wu16 65535.00 DFES_OneToOne 0.00 65535.00 FORMAT "%8.2" /end CHARACTERISTIC
/begin CHARACTERISTIC DFC_DisblMsk.DFC_VehVSclOutOT_C "disable mask / Disable masks of check DFC_VehVSclOutOT" VALUE 0x804EE89C Val_Wu16 65535.00 DFES_OneToOne 0.00 65535.00 FORMAT "%8.2" /end CHARACTERISTIC
/begin CHARACTERISTIC DFC_DisblMsk.DFC_VehVSclOutSCB_C "disable mask / Disable masks of check DFC_VehVSclOutSCB" VALUE 0x804EE89E Val_Wu16 65535.00 DFES_OneToOne 0.00 65535.00 FORMAT "%8.2" /end CHARACTERISTIC
/begin CHARACTERISTIC DFC_DisblMsk.DFC_VehVSclOutSCG_C "disable mask / Disable masks of check DFC_VehVSclOutSCG" VALUE 0x804EE8A0 Val_Wu16 65535.00 DFES_OneToOne 0.00 65535.00 FORMAT "%8.2" /end CHARACTERISTIC
/begin CHARACTERISTIC DFC_DisblMsk.DFC_VehVSnsrARngHi_C "disable mask / Disable masks of check DFC_VehVSnsrARngHi" VALUE 0x804EE8A2 Val_Wu16 65535.00 DFES_OneToOne 0.00 65535.00 FORMAT "%8.2" /end CHARACTERISTIC
/begin CHARACTERISTIC DFC_DisblMsk.DFC_VehVSnsrBRngHi_C "disable mask / Disable masks of check DFC_VehVSnsrBRngHi" VALUE 0x804EE8A4 Val_Wu16 65535.00 DFES_OneToOne 0.00 65535.00 FORMAT "%8.2" /end CHARACTERISTIC
/begin CHARACTERISTIC DFC_DisblMsk.DFC_VehVSpdRtyDiag_C "disable mask / Disable masks of check DFC_VehVSpdRtyDiag" VALUE 0x804EE8A6 Val_Wu16 65535.00 DFES_OneToOne 0.00 65535.00 FORMAT "%8.2" /end CHARACTERISTIC
/begin CHARACTERISTIC DFC_DisblMsk.DFC_VehVWhlErr_C "disable mask / Disable masks of check DFC_VehVWhlErr" VALUE 0x804EE8A8 Val_Wu16 65535.00 DFES_OneToOne 0.00 65535.00 FORMAT "%8.2" /end CHARACTERISTIC
/begin CHARACTERISTIC DFC_DisblMsk.DFC_ACEvpTSRCMax_C "disable mask / Disable masks of check DFC_ACEvpTSRCMax" VALUE 0x804EE8AA Val_Wu16 65535.00 DFES_OneToOne 0.00 65535.00 FORMAT "%8.2" /end CHARACTERISTIC
/begin CHARACTERISTIC DFC_DisblMsk.DFC_ACEvpTSRCMin_C "disable mask / Disable masks of check DFC_ACEvpTSRCMin" VALUE 0x804EE8AC Val_Wu16 65535.00 DFES_OneToOne 0.00 65535.00 FORMAT "%8.2" /end CHARACTERISTIC
/begin CHARACTERISTIC DFC_DisblMsk.DFC_AirCClntPAnaSRCMax_C "disable mask / Disable masks of check DFC_AirCClntPAnaSRCMax" VALUE 0x804EE8AE Val_Wu16 65535.00 DFES_OneToOne 0.00 65535.00 FORMAT "%8.2" /end CHARACTERISTIC
/begin CHARACTERISTIC DFC_DisblMsk.DFC_AirCClntPAnaSRCMin_C "disable mask / Disable masks of check DFC_AirCClntPAnaSRCMin" VALUE 0x804EE8B0 Val_Wu16 65535.00 DFES_OneToOne 0.00 65535.00 FORMAT "%8.2" /end CHARACTERISTIC
/begin CHARACTERISTIC DFC_DisblMsk.DFC_AirCSwtNpl_C "disable mask / Disable masks of check DFC_AirCSwtNpl" VALUE 0x804EE8B2 Val_Wu16 65535.00 DFES_OneToOne 0.00 65535.00 FORMAT "%8.2" /end CHARACTERISTIC
/begin CHARACTERISTIC DFC_DisblMsk.DFC_AirCSwtSig_C "disable mask / Disable masks of check DFC_AirCSwtSig" VALUE 0x804EE8B4 Val_Wu16 65535.00 DFES_OneToOne 0.00 65535.00 FORMAT "%8.2" /end CHARACTERISTIC
/begin CHARACTERISTIC DFC_DisblMsk.DFC_Brk_C "disable mask / Disable masks of check DFC_Brk" VALUE 0x804EE8B6 Val_Wu16 65535.00 DFES_OneToOne 0.00 65535.00 FORMAT "%8.2" /end CHARACTERISTIC
/begin CHARACTERISTIC DFC_DisblMsk.DFC_BrkSig_C "disable mask / Disable masks of check DFC_BrkSig" VALUE 0x804EE8B8 Val_Wu16 65535.00 DFES_OneToOne 0.00 65535.00 FORMAT "%8.2" /end CHARACTERISTIC
/begin CHARACTERISTIC DFC_DisblMsk.DFC_ClthSig_C "disable mask / Disable masks of check DFC_ClthSig" VALUE 0x804EE8BA Val_Wu16 65535.00 DFES_OneToOne 0.00 65535.00 FORMAT "%8.2" /end CHARACTERISTIC
/begin CHARACTERISTIC DFC_DisblMsk.DFC_HLSDemOvhtEngLim_C "disable mask / Disable masks of check DFC_HLSDemOvhtEngLim" VALUE 0x804EE8BC Val_Wu16 65535.00 DFES_OneToOne 0.00 65535.00 FORMAT "%8.2" /end CHARACTERISTIC
/begin CHARACTERISTIC DFC_DisblMsk.DFC_OilPNpl_C "disable mask / Disable masks of check DFC_OilPNpl" VALUE 0x804EE8BE Val_Wu16 65535.00 DFES_OneToOne 0.00 65535.00 FORMAT "%8.2" /end CHARACTERISTIC
/begin CHARACTERISTIC DFC_DisblMsk.DFC_PIntkVUsLineHiB1_C "disable mask / Disable masks of check DFC_PIntkVUsLineHiB1" VALUE 0x804EE8C0 Val_Wu16 65535.00 DFES_OneToOne 0.00 65535.00 FORMAT "%8.2" /end CHARACTERISTIC
/begin CHARACTERISTIC DFC_DisblMsk.DFC_PIntkVUsLineLoB1_C "disable mask / Disable masks of check DFC_PIntkVUsLineLoB1" VALUE 0x804EE8C2 Val_Wu16 65535.00 DFES_OneToOne 0.00 65535.00 FORMAT "%8.2" /end CHARACTERISTIC
/begin CHARACTERISTIC DFC_DisblMsk.DFC_VehVPhysRngLo_C "disable mask / Disable masks of check DFC_VehVPhysRngLo" VALUE 0x804EE8C4 Val_Wu16 65535.00 DFES_OneToOne 0.00 65535.00 FORMAT "%8.2" /end CHARACTERISTIC
/begin CHARACTERISTIC DFC_DisblMsk.DFC_VehVSigCan_C "disable mask / Disable masks of check DFC_VehVSigCan" VALUE 0x804EE8C6 Val_Wu16 65535.00 DFES_OneToOne 0.00 65535.00 FORMAT "%8.2" /end CHARACTERISTIC
/begin CHARACTERISTIC DFC_DisblMsk.DFC_VehVSigCanSafe_C "disable mask / Disable masks of check DFC_VehVSigCanSafe" VALUE 0x804EE8C8 Val_Wu16 65535.00 DFES_OneToOne 0.00 65535.00 FORMAT "%8.2" /end CHARACTERISTIC
/begin CHARACTERISTIC DFC_DisblMsk.DFC_VlvLftFbOilPSnsrIntk11SRCMax_C "disable mask / Disable masks of check DFC_VlvLftFbOilPSnsrIntk11SRCMax" VALUE 0x804EE8CA Val_Wu16 65535.00 DFES_OneToOne 0.00 65535.00 FORMAT "%8.2" /end CHARACTERISTIC
/begin CHARACTERISTIC DFC_DisblMsk.DFC_VlvLftFbOilPSnsrIntk11SRCMin_C "disable mask / Disable masks of check DFC_VlvLftFbOilPSnsrIntk11SRCMin" VALUE 0x804EE8CC Val_Wu16 65535.00 DFES_OneToOne 0.00 65535.00 FORMAT "%8.2" /end CHARACTERISTIC
/begin CHARACTERISTIC DFC_DisblMsk.DFC_ClthNpl_C "disable mask / Disable masks of check DFC_ClthNpl" VALUE 0x804EE8CE Val_Wu16 65535.00 DFES_OneToOne 0.00 65535.00 FORMAT "%8.2" /end CHARACTERISTIC
/begin CHARACTERISTIC DFC_DisblMsk.DFC_EV1max_C "disable mask / Disable masks of check DFC_EV1max" VALUE 0x804EE8D0 Val_Wu16 65535.00 DFES_OneToOne 0.00 65535.00 FORMAT "%8.2" /end CHARACTERISTIC
/begin CHARACTERISTIC DFC_DisblMsk.DFC_EV1min_C "disable mask / Disable masks of check DFC_EV1min" VALUE 0x804EE8D2 Val_Wu16 65535.00 DFES_OneToOne 0.00 65535.00 FORMAT "%8.2" /end CHARACTERISTIC
/begin CHARACTERISTIC DFC_DisblMsk.DFC_EV1sig_C "disable mask / Disable masks of check DFC_EV1sig" VALUE 0x804EE8D4 Val_Wu16 65535.00 DFES_OneToOne 0.00 65535.00 FORMAT "%8.2" /end CHARACTERISTIC
/begin CHARACTERISTIC DFC_DisblMsk.DFC_EV2max_C "disable mask / Disable masks of check DFC_EV2max" VALUE 0x804EE8D6 Val_Wu16 65535.00 DFES_OneToOne 0.00 65535.00 FORMAT "%8.2" /end CHARACTERISTIC
/begin CHARACTERISTIC DFC_DisblMsk.DFC_EV2min_C "disable mask / Disable masks of check DFC_EV2min" VALUE 0x804EE8D8 Val_Wu16 65535.00 DFES_OneToOne 0.00 65535.00 FORMAT "%8.2" /end CHARACTERISTIC
/begin CHARACTERISTIC DFC_DisblMsk.DFC_EV2sig_C "disable mask / Disable masks of check DFC_EV2sig" VALUE 0x804EE8DA Val_Wu16 65535.00 DFES_OneToOne 0.00 65535.00 FORMAT "%8.2" /end CHARACTERISTIC
/begin CHARACTERISTIC DFC_DisblMsk.DFC_EV3max_C "disable mask / Disable masks of check DFC_EV3max" VALUE 0x804EE8DC Val_Wu16 65535.00 DFES_OneToOne 0.00 65535.00 FORMAT "%8.2" /end CHARACTERISTIC
/begin CHARACTERISTIC DFC_DisblMsk.DFC_EV3min_C "disable mask / Disable masks of check DFC_EV3min" VALUE 0x804EE8DE Val_Wu16 65535.00 DFES_OneToOne 0.00 65535.00 FORMAT "%8.2" /end CHARACTERISTIC
/begin CHARACTERISTIC DFC_DisblMsk.DFC_EV3sig_C "disable mask / Disable masks of check DFC_EV3sig" VALUE 0x804EE8E0 Val_Wu16 65535.00 DFES_OneToOne 0.00 65535.00 FORMAT "%8.2" /end CHARACTERISTIC
/begin CHARACTERISTIC DFC_DisblMsk.DFC_EV4max_C "disable mask / Disable masks of check DFC_EV4max" VALUE 0x804EE8E2 Val_Wu16 65535.00 DFES_OneToOne 0.00 65535.00 FORMAT "%8.2" /end CHARACTERISTIC
/begin CHARACTERISTIC DFC_DisblMsk.DFC_EV4min_C "disable mask / Disable masks of check DFC_EV4min" VALUE 0x804EE8E4 Val_Wu16 65535.00 DFES_OneToOne 0.00 65535.00 FORMAT "%8.2" /end CHARACTERISTIC
/begin CHARACTERISTIC DFC_DisblMsk.DFC_EV4sig_C "disable mask / Disable masks of check DFC_EV4sig" VALUE 0x804EE8E6 Val_Wu16 65535.00 DFES_OneToOne 0.00 65535.00 FORMAT "%8.2" /end CHARACTERISTIC
/begin CHARACTERISTIC DFC_DisblMsk.DFC_GbxPNPosnDrvCdn_C "disable mask / Disable masks of check DFC_GbxPNPosnDrvCdn" VALUE 0x804EE8E8 Val_Wu16 65535.00 DFES_OneToOne 0.00 65535.00 FORMAT "%8.2" /end CHARACTERISTIC
/begin CHARACTERISTIC DFC_DisblMsk.DFC_GbxPNPosnPlausy_C "disable mask / Disable masks of check DFC_GbxPNPosnPlausy" VALUE 0x804EE8EA Val_Wu16 65535.00 DFES_OneToOne 0.00 65535.00 FORMAT "%8.2" /end CHARACTERISTIC
/begin CHARACTERISTIC DFC_DisblMsk.DFC_PEnvCcMax_C "disable mask / Disable masks of check DFC_PEnvCcMax" VALUE 0x804EE8EC Val_Wu16 65535.00 DFES_OneToOne 0.00 65535.00 FORMAT "%8.2" /end CHARACTERISTIC
/begin CHARACTERISTIC DFC_DisblMsk.DFC_PEnvCcMin_C "disable mask / Disable masks of check DFC_PEnvCcMin" VALUE 0x804EE8EE Val_Wu16 65535.00 DFES_OneToOne 0.00 65535.00 FORMAT "%8.2" /end CHARACTERISTIC
/begin CHARACTERISTIC DFC_DisblMsk.DFC_PEnvRngChkMax_C "disable mask / Disable masks of check DFC_PEnvRngChkMax" VALUE 0x804EE8F0 Val_Wu16 65535.00 DFES_OneToOne 0.00 65535.00 FORMAT "%8.2" /end CHARACTERISTIC
/begin CHARACTERISTIC DFC_DisblMsk.DFC_PEnvRngChkMin_C "disable mask / Disable masks of check DFC_PEnvRngChkMin" VALUE 0x804EE8F2 Val_Wu16 65535.00 DFES_OneToOne 0.00 65535.00 FORMAT "%8.2" /end CHARACTERISTIC
/begin CHARACTERISTIC DFC_DisblMsk.DFC_PEnvSnsrPlaus_C "disable mask / Disable masks of check DFC_PEnvSnsrPlaus" VALUE 0x804EE8F4 Val_Wu16 65535.00 DFES_OneToOne 0.00 65535.00 FORMAT "%8.2" /end CHARACTERISTIC
/begin CHARACTERISTIC DFC_DisblMsk.DFC_UEGOHeatrPsS1B1Max_C "disable mask / Disable masks of check DFC_UEGOHeatrPsS1B1Max" VALUE 0x804EE8F6 Val_Wu16 65535.00 DFES_OneToOne 0.00 65535.00 FORMAT "%8.2" /end CHARACTERISTIC
/begin CHARACTERISTIC DFC_DisblMsk.DFC_UEGOHeatrPsS1B1Min_C "disable mask / Disable masks of check DFC_UEGOHeatrPsS1B1Min" VALUE 0x804EE8F8 Val_Wu16 65535.00 DFES_OneToOne 0.00 65535.00 FORMAT "%8.2" /end CHARACTERISTIC
/begin CHARACTERISTIC DFC_DisblMsk.DFC_UEGOHeatrPsS1B1Sig_C "disable mask / Disable masks of check DFC_UEGOHeatrPsS1B1Sig" VALUE 0x804EE8FA Val_Wu16 65535.00 DFES_OneToOne 0.00 65535.00 FORMAT "%8.2" /end CHARACTERISTIC
/begin CHARACTERISTIC DFC_DisblMsk.DFC_UEGOHeatrRlyPsOLS1B1_C "disable mask / Disable masks of check DFC_UEGOHeatrRlyPsOLS1B1" VALUE 0x804EE8FC Val_Wu16 65535.00 DFES_OneToOne 0.00 65535.00 FORMAT "%8.2" /end CHARACTERISTIC
/begin CHARACTERISTIC DFC_DisblMsk.DFC_UEGOHeatrRlyPsSCBS1B1_C "disable mask / Disable masks of check DFC_UEGOHeatrRlyPsSCBS1B1" VALUE 0x804EE8FE Val_Wu16 65535.00 DFES_OneToOne 0.00 65535.00 FORMAT "%8.2" /end CHARACTERISTIC
/begin CHARACTERISTIC DFC_DisblMsk.DFC_UEGOHeatrRlyPsSCGS1B1_C "disable mask / Disable masks of check DFC_UEGOHeatrRlyPsSCGS1B1" VALUE 0x804EE900 Val_Wu16 65535.00 DFES_OneToOne 0.00 65535.00 FORMAT "%8.2" /end CHARACTERISTIC
/begin CHARACTERISTIC DFC_DisblMsk.DFC_KnDetSens1PortAMax_C "disable mask / Disable masks of check DFC_KnDetSens1PortAMax" VALUE 0x804EE902 Val_Wu16 65535.00 DFES_OneToOne 0.00 65535.00 FORMAT "%8.2" /end CHARACTERISTIC
/begin CHARACTERISTIC DFC_DisblMsk.DFC_KnDetSens1PortAMin_C "disable mask / Disable masks of check DFC_KnDetSens1PortAMin" VALUE 0x804EE904 Val_Wu16 65535.00 DFES_OneToOne 0.00 65535.00 FORMAT "%8.2" /end CHARACTERISTIC
/begin CHARACTERISTIC DFC_DisblMsk.DFC_KnDetSens1PortBMax_C "disable mask / Disable masks of check DFC_KnDetSens1PortBMax" VALUE 0x804EE906 Val_Wu16 65535.00 DFES_OneToOne 0.00 65535.00 FORMAT "%8.2" /end CHARACTERISTIC
/begin CHARACTERISTIC DFC_DisblMsk.DFC_KnDetSens1PortBMin_C "disable mask / Disable masks of check DFC_KnDetSens1PortBMin" VALUE 0x804EE908 Val_Wu16 65535.00 DFES_OneToOne 0.00 65535.00 FORMAT "%8.2" /end CHARACTERISTIC
/begin CHARACTERISTIC DFC_DisblMsk.DFC_Clth2ONStuck_C "disable mask / Disable masks of check DFC_Clth2ONStuck" VALUE 0x804EE90A Val_Wu16 65535.00 DFES_OneToOne 0.00 65535.00 FORMAT "%8.2" /end CHARACTERISTIC
/begin FUNCTION DFC "30000.33.0Diagnostic Fault Check"
 /begin DEF_CHARACTERISTIC DFC_CtlMsk.DFC_MRlyDcSCG_C DFC_CtlMsk.DFC_PSPOL_C DFC_CtlMsk.DFC_PSPOvrTemp_C DFC_CtlMsk.DFC_PSPSCB_C DFC_CtlMsk.DFC_PSPSCG_C DFC_CtlMsk.DFC_T50Err_C DFC_CtlMsk.DFC_ThrVlvLoBattB1_C DFC_CtlMsk.DFC_VehVPhysRngHi_C DFC_CtlMsk.DFC_VehVSclOutOL_C DFC_CtlMsk.DFC_VehVSclOutOT_C DFC_CtlMsk.DFC_VehVSclOutSCB_C DFC_CtlMsk.DFC_VehVSclOutSCG_C DFC_CtlMsk.DFC_VehVSnsrARngHi_C DFC_CtlMsk.DFC_VehVSnsrBRngHi_C DFC_CtlMsk.DFC_VehVSpdRtyDiag_C DFC_CtlMsk.DFC_VehVWhlErr_C DFC_CtlMsk.DFC_ACEvpTSRCMax_C DFC_CtlMsk.DFC_ACEvpTSRCMin_C DFC_CtlMsk.DFC_AirCClntPAnaSRCMax_C DFC_CtlMsk.DFC_AirCClntPAnaSRCMin_C DFC_CtlMsk.DFC_AirCSwtNpl_C DFC_CtlMsk.DFC_AirCSwtSig_C DFC_CtlMsk.DFC_Brk_C DFC_CtlMsk.DFC_BrkSig_C DFC_CtlMsk.DFC_ClthSig_C DFC_CtlMsk.DFC_HLSDemOvhtEngLim_C DFC_CtlMsk.DFC_OilPNpl_C DFC_CtlMsk.DFC_PIntkVUsLineHiB1_C DFC_CtlMsk.DFC_PIntkVUsLineLoB1_C DFC_CtlMsk.DFC_VehVPhysRngLo_C DFC_CtlMsk.DFC_VehVSigCan_C DFC_CtlMsk.DFC_VehVSigCanSafe_C DFC_CtlMsk.DFC_VlvLftFbOilPSnsrIntk11SRCMax_C DFC_CtlMsk.DFC_VlvLftFbOilPSnsrIntk11SRCMin_C DFC_CtlMsk.DFC_ClthNpl_C DFC_CtlMsk.DFC_EV1max_C DFC_CtlMsk.DFC_EV1min_C DFC_CtlMsk.DFC_EV1sig_C DFC_CtlMsk.DFC_EV2max_C DFC_CtlMsk.DFC_EV2min_C DFC_CtlMsk.DFC_EV2sig_C DFC_CtlMsk.DFC_EV3max_C DFC_CtlMsk.DFC_EV3min_C DFC_CtlMsk.DFC_EV3sig_C DFC_CtlMsk.DFC_EV4max_C DFC_CtlMsk.DFC_EV4min_C DFC_CtlMsk.DFC_EV4sig_C DFC_CtlMsk.DFC_GbxPNPosnDrvCdn_C DFC_CtlMsk.DFC_GbxPNPosnPlausy_C DFC_CtlMsk.DFC_PEnvCcMax_C DFC_CtlMsk.DFC_PEnvCcMin_C DFC_CtlMsk.DFC_PEnvRngChkMax_C DFC_CtlMsk.DFC_PEnvRngChkMin_C DFC_CtlMsk.DFC_PEnvSnsrPlaus_C DFC_CtlMsk.DFC_UEGOHeatrPsS1B1Max_C DFC_CtlMsk.DFC_UEGOHeatrPsS1B1Min_C DFC_CtlMsk.DFC_UEGOHeatrPsS1B1Sig_C DFC_CtlMsk.DFC_UEGOHeatrRlyPsOLS1B1_C DFC_CtlMsk.DFC_UEGOHeatrRlyPsSCBS1B1_C DFC_CtlMsk.DFC_UEGOHeatrRlyPsSCGS1B1_C DFC_CtlMsk.DFC_KnDetSens1PortAMax_C DFC_CtlMsk.DFC_KnDetSens1PortAMin_C DFC_CtlMsk.DFC_KnDetSens1PortBMax_C DFC_CtlMsk.DFC_KnDetSens1PortBMin_C DFC_CtlMsk.DFC_Clth2ONStuck_C DFC_CtlMsk.DFC_Clth2ONStuckLdc_C DFC_CtlMsk.DFC_Clth3ONStuckLdc_C DFC_CtlMsk.DFC_Clth3ONStuckPostDrv_C DFC_CtlMsk.DFC_Clth4ONStuck_C DFC_CtlMsk.DFC_Clth4ONStuckLdc_C DFC_CtlMsk.DFC_ComDLCTCU01_C DFC_CtlMsk.DFC_ComDLCTCU02_C DFC_CtlMsk.DFC_ComDLCTCU1_C DFC_CtlMsk.DFC_ComDLCTCU11_C DFC_CtlMsk.DFC_ComDLCTCU12_C DFC_CtlMsk.DFC_ComDLCTCU13_C DFC_CtlMsk.DFC_ComDLCTCU14_C DFC_CtlMsk.DFC_ComDLCTCU2_C DFC_CtlMsk.DFC_ComDLCTCU3_C DFC_CtlMsk.DFC_ComDLCTCU4_C DFC_CtlMsk.DFC_EVX_C DFC_CtlMsk.DFC_EbsSocFlt_C DFC_CtlMsk.DFC_I14229VINErr_C DFC_CtlMsk.DFC_LLRKHmax_C DFC_CtlMsk.DFC_LLRKHmin_C DFC_CtlMsk.DFC_LLRmax_C DFC_CtlMsk.DFC_LLRmin_C DFC_CtlMsk.DFC_RoughRoad_C DFC_CtlMsk.DFC_SiaEEPRdErr_C DFC_CtlMsk.DFC_SiaEEPWrngCod_C DFC_CtlMsk.DFC_UegoDummy_C DFC_CtlMsk.DFC_BusDiagCANAPPLBusOff_C DFC_CtlMsk.DFC_BusDiagCANCANCBusOff_C DFC_CtlMsk.DFC_BusDiagCANVEHICLEBusOff_C DFC_CtlMsk.DFC_RBA_IODIAGPWR_rba_IoExtCy329_SignalVltSply_0_C DFC_CtlMsk.DFC_RBA_IODIAGPWR_rba_IoExtCy329_SignalVltSply_0OT_C DFC_CtlMsk.DFC_RBA_IODIAGPWR_rba_IoExtCy329_SignalVltSply_0OV_C DFC_CtlMsk.DFC_RBA_IODIAGPWR_rba_IoExtCy329_SignalVltSply_0SCG_C DFC_CtlMsk.DFC_RBA_IODIAGPWR_rba_IoExtCy329_SignalVltSply_0UV_C DFC_CtlMsk.DFC_RBA_IODIAGPWR_rba_IoExtCy329_SignalVltSply_1_C DFC_CtlMsk.DFC_RBA_IODIAGPWR_rba_IoExtCy329_SignalVltSply_1OT_C DFC_CtlMsk.DFC_RBA_IODIAGPWR_rba_IoExtCy329_SignalVltSply_1OV_C DFC_CtlMsk.DFC_RBA_IODIAGPWR_rba_IoExtCy329_SignalVltSply_1SCG_C DFC_CtlMsk.DFC_RBA_IODIAGPWR_rba_IoExtCy329_SignalVltSply_1UV_C DFC_CtlMsk.DFC_RBA_IODIAGPWR_rba_IoExtCy329_SignalVltSply_2_C DFC_CtlMsk.DFC_RBA_IODIAGPWR_rba_IoExtCy329_SignalVltSply_2OT_C DFC_CtlMsk.DFC_RBA_IODIAGPWR_rba_IoExtCy329_SignalVltSply_2OV_C DFC_CtlMsk.DFC_RBA_IODIAGPWR_rba_IoExtCy329_SignalVltSply_2SCG_C DFC_CtlMsk.DFC_RBA_IODIAGPWR_rba_IoExtCy329_SignalVltSply_2UV_C DFC_CtlMsk.DFC_CAN_E_TIMEOUT_C DFC_CtlMsk.DFC_LIN_E_TIMEOUT_C DFC_CtlMsk.DFC_MRlyOL_C DFC_CtlMsk.DFC_MRlySCB_C DFC_CtlMsk.DFC_MRlySCG_C DFC_CtlMsk.DFC_rba_MultiStackTrace_Threshold_C DFC_CtlMsk.DFC_BSWM_E_ACTION_FAILED_C DFC_CtlMsk.DFC_BSWM_E_INTRPTQUEUE_FULL_C DFC_CtlMsk.DFC_RBA_IOEXTLIB_KEEPALIVE_DRV_C DFC_CtlMsk.DFC_RBA_IOEXTLIB_KEEPALIVE_INI_C DFC_CtlMsk.DFC_rba_IoSigRtc_StopCounter_C DFC_CtlMsk.DFC_rba_MRly_Diag_Stk_Event_C DFC_CtlMsk.DFC_rba_MemDiag_MemReadErr_C DFC_CtlMsk.DFC_rba_MemDiag_MemWrErr_C DFC_CtlMsk.DFC_rba_SyC_IrrSwOffTrigEngRun_Event_C DFC_CtlMsk.DFC_rba_T15_Diag_ComInVld_Event_C DFC_CtlMsk.DFC_rba_T15_Diag_ComOff_HwOn_Event_C DFC_CtlMsk.DFC_rba_T15_Diag_ComOn_HwOff_Event_C DFC_CtlMsk.DFC_AppAllSnsrDfct_C DFC_CtlMsk.DFC_BattUStdbyDiaOL_C DFC_CtlMsk.DFC_BigLeakIntkMnfldEmiInfl_C DFC_CtlMsk.DFC_BrkMnSwtContOnWarnLmp_C DFC_CtlMsk.DFC_BrkMnSwtNotStpWarnLmp_C DFC_CtlMsk.DFC_BrkRdntSwtContOnWarnLmp_C DFC_CtlMsk.DFC_BrkRdntSwtNotStpWarnLmp_C DFC_CtlMsk.DFC_CEngDsTColdStrtMax_C DFC_CtlMsk.DFC_CEngDsTColdStrtMin_C DFC_CtlMsk.DFC_CEngDsTImps_C DFC_CtlMsk.DFC_CEngDsTPlausLSC_C DFC_CtlMsk.DFC_CEngDsTPlausSTC_C DFC_CtlMsk.DFC_CEngDsTSRCMax_C DFC_CtlMsk.DFC_CEngDsTSRCMin_C DFC_CtlMsk.DFC_CEngDsTSig_C DFC_CtlMsk.DFC_CEngUsTSRCMax_C DFC_CtlMsk.DFC_CEngUsTSRCMin_C DFC_CtlMsk.DFC_DCDCFltDet_C DFC_CtlMsk.DFC_DKRSA_C DFC_CtlMsk.DFC_DKVSmax_C DFC_CtlMsk.DFC_DKnpl_C DFC_CtlMsk.DFC_DSSmax_C DFC_CtlMsk.DFC_DSTTI_C DFC_CtlMsk.DFC_DSUmax_C DFC_CtlMsk.DFC_EGRVlvOL_C DFC_CtlMsk.DFC_EGRVlvSCB_C DFC_CtlMsk.DFC_EGRVlvSCG_C DFC_CtlMsk.DFC_EGSDUS2B1LtrDly_C DFC_CtlMsk.DFC_EGSDUS2B1LtrPT1_C DFC_CtlMsk.DFC_EGSDUS2B1RtlDly_C DFC_CtlMsk.DFC_EGSDUS2B1RtlPT1_C DFC_CtlMsk.DFC_EGSDUS2B1TarLean_C DFC_CtlMsk.DFC_EGSDUS2B1TarRich_C DFC_CtlMsk.DFC_ETAKHLmax_C DFC_CtlMsk.DFC_ETAKHTmax_C DFC_CtlMsk.DFC_EngICO_C DFC_CtlMsk.DFC_EngPrtOvrSpdMon_C DFC_CtlMsk.DFC_EpmCaSI1ErrSig_C DFC_CtlMsk.DFC_EpmCaSI1NoSig_C DFC_CtlMsk.DFC_EpmCaSI1OfsErr_C DFC_CtlMsk.DFC_EpmCrSErrSig_C DFC_CtlMsk.DFC_EpmCrSNoSig_C DFC_CtlMsk.DFC_EtaEngIdleNonCsers_C DFC_CtlMsk.DFC_EtaEngPtlNonCsers_C DFC_CtlMsk.DFC_FRAmax_C DFC_CtlMsk.DFC_FRAmin_C DFC_CtlMsk.DFC_GbxRvsSwtStk_C DFC_CtlMsk.DFC_HDRmax_C DFC_CtlMsk.DFC_HEGOS2B1ElecMax_C DFC_CtlMsk.DFC_HEGOS2B1ElecMin_C DFC_CtlMsk.DFC_HEGOS2B1ElecSig_C DFC_CtlMsk.DFC_HEGOS2B1HtgNpl_C DFC_CtlMsk.DFC_IntkAirTIntkMnfldCrssMax_C DFC_CtlMsk.DFC_IntkAirTIntkMnfldCrssMin_C DFC_CtlMsk.DFC_IntkAirTIntkMnfldHSCMax_C DFC_CtlMsk.DFC_IntkAirTIntkMnfldImps_C DFC_CtlMsk.DFC_IntkAirTIntkMnfldPRCMax_C DFC_CtlMsk.DFC_IntkAirTIntkMnfldPRCMin_C DFC_CtlMsk.DFC_IntkAirTIntkMnfldSRCMax_C DFC_CtlMsk.DFC_IntkAirTIntkMnfldSRCMin_C DFC_CtlMsk.DFC_IntkAirTIntkMnfldSTC_C DFC_CtlMsk.DFC_KS1max_C DFC_CtlMsk.DFC_KS1min_C DFC_CtlMsk.DFC_LMmax_C DFC_CtlMsk.DFC_LZSRnpl_C DFC_CtlMsk.DFC_LamDynDiagS1B1_C DFC_CtlMsk.DFC_LeakIntkMnfldEmiInfl_C DFC_CtlMsk.DFC_MD00max_C DFC_CtlMsk.DFC_MDBmax_C DFC_CtlMsk.DFC_MDCat_C DFC_CtlMsk.DFC_MDCatCrit_C DFC_CtlMsk.DFC_MDCatCurr_C DFC_CtlMsk.DFC_MDCyl_0_C DFC_CtlMsk.DFC_MDCyl_1_C DFC_CtlMsk.DFC_MDCyl_2_C DFC_CtlMsk.DFC_MDCyl_3_C DFC_CtlMsk.DFC_MDEmi_C DFC_CtlMsk.DFC_MDEmiStrt_C DFC_CtlMsk.DFC_MDFco_C DFC_CtlMsk.DFC_MDMpl_C DFC_CtlMsk.DFC_MDSegTiAdpn_C DFC_CtlMsk.DFC_MDmax_C DFC_CtlMsk.DFC_MOXEMM_SMU_ALM0_0_C DFC_CtlMsk.DFC_MOXEMM_SMU_ALM0_1_C DFC_CtlMsk.DFC_MOXEMM_SMU_ALM0_10_C DFC_CtlMsk.DFC_MOXEMM_SMU_ALM0_11_C DFC_CtlMsk.DFC_MOXEMM_SMU_ALM0_13_C DFC_CtlMsk.DFC_MOXEMM_SMU_ALM0_14_C DFC_CtlMsk.DFC_MOXEMM_SMU_ALM0_2_C DFC_CtlMsk.DFC_MOXEMM_SMU_ALM0_22_C DFC_CtlMsk.DFC_MOXEMM_SMU_ALM0_23_C DFC_CtlMsk.DFC_MOXEMM_SMU_ALM0_4_C DFC_CtlMsk.DFC_MOXEMM_SMU_ALM0_5_C DFC_CtlMsk.DFC_MOXEMM_SMU_ALM0_7_C DFC_CtlMsk.DFC_MOXEMM_SMU_ALM0_8_C DFC_CtlMsk.DFC_MOXEMM_SMU_ALM10_16_C DFC_CtlMsk.DFC_MOXEMM_SMU_ALM10_17_C DFC_CtlMsk.DFC_MOXEMM_SMU_ALM10_21_C DFC_CtlMsk.DFC_MOXEMM_SMU_ALM11_0_C DFC_CtlMsk.DFC_MOXEMM_SMU_ALM11_1_C DFC_CtlMsk.DFC_MOXEMM_SMU_ALM11_2_C DFC_CtlMsk.DFC_MOXEMM_SMU_ALM11_3_C DFC_CtlMsk.DFC_MOXEMM_SMU_ALM11_4_C DFC_CtlMsk.DFC_MOXEMM_SMU_ALM11_5_C DFC_CtlMsk.DFC_MOXEMM_SMU_ALM11_8_C DFC_CtlMsk.DFC_MOXEMM_SMU_ALM11_9_C DFC_CtlMsk.DFC_MOXEMM_SMU_ALM1_0_C DFC_CtlMsk.DFC_MOXEMM_SMU_ALM1_1_C DFC_CtlMsk.DFC_MOXEMM_SMU_ALM1_10_C DFC_CtlMsk.DFC_MOXEMM_SMU_ALM1_11_C DFC_CtlMsk.DFC_MOXEMM_SMU_ALM1_13_C DFC_CtlMsk.DFC_MOXEMM_SMU_ALM1_14_C DFC_CtlMsk.DFC_MOXEMM_SMU_ALM1_2_C DFC_CtlMsk.DFC_MOXEMM_SMU_ALM1_22_C DFC_CtlMsk.DFC_MOXEMM_SMU_ALM1_23_C DFC_CtlMsk.DFC_MOXEMM_SMU_ALM1_4_C DFC_CtlMsk.DFC_MOXEMM_SMU_ALM1_5_C DFC_CtlMsk.DFC_MOXEMM_SMU_ALM1_7_C DFC_CtlMsk.DFC_MOXEMM_SMU_ALM1_8_C DFC_CtlMsk.DFC_MOXEMM_SMU_ALM21_0_C DFC_CtlMsk.DFC_MOXEMM_SMU_ALM21_16_C DFC_CtlMsk.DFC_MOXEMM_SMU_ALM21_3_C DFC_CtlMsk.DFC_MOXEMM_SMU_ALM2_1_C DFC_CtlMsk.DFC_MOXEMM_SMU_ALM2_10_C DFC_CtlMsk.DFC_MOXEMM_SMU_ALM2_11_C DFC_CtlMsk.DFC_MOXEMM_SMU_ALM2_13_C DFC_CtlMsk.DFC_MOXEMM_SMU_ALM2_14_C DFC_CtlMsk.DFC_MOXEMM_SMU_ALM2_22_C DFC_CtlMsk.DFC_MOXEMM_SMU_ALM2_23_C DFC_CtlMsk.DFC_MOXEMM_SMU_ALM2_4_C DFC_CtlMsk.DFC_MOXEMM_SMU_ALM2_5_C DFC_CtlMsk.DFC_MOXEMM_SMU_ALM2_7_C DFC_CtlMsk.DFC_MOXEMM_SMU_ALM2_8_C DFC_CtlMsk.DFC_MOXEMM_SMU_ALM6_0_C DFC_CtlMsk.DFC_MOXEMM_SMU_ALM6_11_C DFC_CtlMsk.DFC_MOXEMM_SMU_ALM6_12_C DFC_CtlMsk.DFC_MOXEMM_SMU_ALM6_14_C DFC_CtlMsk.DFC_MOXEMM_SMU_ALM6_15_C DFC_CtlMsk.DFC_MOXEMM_SMU_ALM6_17_C DFC_CtlMsk.DFC_MOXEMM_SMU_ALM6_18_C DFC_CtlMsk.DFC_MOXEMM_SMU_ALM6_20_C DFC_CtlMsk.DFC_MOXEMM_SMU_ALM6_21_C DFC_CtlMsk.DFC_MOXEMM_SMU_ALM6_25_C DFC_CtlMsk.DFC_MOXEMM_SMU_ALM6_4_C DFC_CtlMsk.DFC_MOXEMM_SMU_ALM6_5_C DFC_CtlMsk.DFC_MOXEMM_SMU_ALM6_7_C DFC_CtlMsk.DFC_MOXEMM_SMU_ALM6_8_C DFC_CtlMsk.DFC_MOXEMM_SMU_ALM7_1_C DFC_CtlMsk.DFC_MOXEMM_SMU_ALM7_12_C DFC_CtlMsk.DFC_MOXEMM_SMU_ALM7_13_C DFC_CtlMsk.DFC_MOXEMM_SMU_ALM7_14_C DFC_CtlMsk.DFC_MOXEMM_SMU_ALM7_15_C DFC_CtlMsk.DFC_MOXEMM_SMU_ALM7_16_C DFC_CtlMsk.DFC_MOXEMM_SMU_ALM7_17_C DFC_CtlMsk.DFC_MOXEMM_SMU_ALM7_2_C DFC_CtlMsk.DFC_MOXEMM_SMU_ALM7_20_C DFC_CtlMsk.DFC_MOXEMM_SMU_ALM7_25_C DFC_CtlMsk.DFC_MOXEMM_SMU_ALM7_26_C DFC_CtlMsk.DFC_MOXEMM_SMU_ALM7_28_C DFC_CtlMsk.DFC_MOXEMM_SMU_ALM7_29_C DFC_CtlMsk.DFC_MOXEMM_SMU_ALM7_30_C DFC_CtlMsk.DFC_MOXEMM_SMU_ALM7_31_C DFC_CtlMsk.DFC_MOXEMM_SMU_ALM8_0_C DFC_CtlMsk.DFC_MOXEMM_SMU_ALM8_1_C DFC_CtlMsk.DFC_MOXEMM_SMU_ALM8_10_C DFC_CtlMsk.DFC_MOXEMM_SMU_ALM8_11_C DFC_CtlMsk.DFC_MOXEMM_SMU_ALM8_12_C DFC_CtlMsk.DFC_MOXEMM_SMU_ALM8_16_C DFC_CtlMsk.DFC_MOXEMM_SMU_ALM8_18_C DFC_CtlMsk.DFC_MOXEMM_SMU_ALM8_2_C DFC_CtlMsk.DFC_MOXEMM_SMU_ALM8_3_C DFC_CtlMsk.DFC_MOXEMM_SMU_ALM8_31_C DFC_CtlMsk.DFC_MOXEMM_SMU_ALM8_4_C DFC_CtlMsk.DFC_MOXEMM_SMU_ALM9_0_C DFC_CtlMsk.DFC_MOXEMM_SMU_ALM9_15_C DFC_CtlMsk.DFC_MOXEMM_SMU_ALM9_3_C DFC_CtlMsk.DFC_MoCADCNTP_C DFC_CtlMsk.DFC_MoCADCTst_C DFC_CtlMsk.DFC_MoCSOPICO_C DFC_CtlMsk.DFC_MoFAPP_C DFC_CtlMsk.DFC_MoFAirFilgPrdc_C DFC_CtlMsk.DFC_MoFAirFlCtOffPfi_C DFC_CtlMsk.DFC_MoFAirFlCylPfi_C DFC_CtlMsk.DFC_MoFAirFlIn_C DFC_CtlMsk.DFC_MoFAirFlMixCtlPfiChkAirFl_C DFC_CtlMsk.DFC_MoFAirFlMixCtlPfiChkCtrl_C DFC_CtlMsk.DFC_MoFAirFlMode_C DFC_CtlMsk.DFC_MoFESpd_C DFC_CtlMsk.DFC_MoFIACo_C DFC_CtlMsk.DFC_MoFICOL1_C DFC_CtlMsk.DFC_MoFICOL2_C DFC_CtlMsk.DFC_MoFStrt_C DFC_CtlMsk.DFC_MoFTrqCmp_C DFC_CtlMsk.DFC_MoFTrqCmpMax_C DFC_CtlMsk.DFC_MoFTrqCmpMin_C DFC_CtlMsk.DFC_MoFVarPostBldSel_C DFC_CtlMsk.DFC_MoXEMMHwLTMCUFW_C DFC_CtlMsk.DFC_MoXEMMHwLTMonBIST_C DFC_CtlMsk.DFC_MoXEMMHwLTRegMonTest_C DFC_CtlMsk.DFC_MoXEMMHwLTStbySMUAlvTest_C DFC_CtlMsk.DFC_MoXEMMHwLTTempSens_C DFC_CtlMsk.DFC_MoXEMMHwLTUCBCfg_C DFC_CtlMsk.DFC_OCWDAABEActv_C DFC_CtlMsk.DFC_OCWDACom_C DFC_CtlMsk.DFC_OCWDAErrPin_C DFC_CtlMsk.DFC_OCWDAOvrVltg_C DFC_CtlMsk.DFC_ORAmax_C DFC_CtlMsk.DFC_ORAmin_C DFC_CtlMsk.DFC_PLLSUmax_C DFC_CtlMsk.DFC_PLLSUmin_C DFC_CtlMsk.DFC_PSR1max_C DFC_CtlMsk.DFC_PSRBmax_C DFC_CtlMsk.DFC_PSRBmin_C DFC_CtlMsk.DFC_PSRPmax_C DFC_CtlMsk.DFC_PSRPmin_C DFC_CtlMsk.DFC_PSRPsig_C DFC_CtlMsk.DFC_PSRmax_C DFC_CtlMsk.DFC_PUmax_C DFC_CtlMsk.DFC_P_VSE11_OL_C DFC_CtlMsk.DFC_P_VSE11_SCB_C DFC_CtlMsk.DFC_P_VSE11_SCG_C DFC_CtlMsk.DFC_PhyHighAPP1_C DFC_CtlMsk.DFC_PhyHighAPP2_C DFC_CtlMsk.DFC_PhyLowAPP1_C DFC_CtlMsk.DFC_PhyLowAPP2_C DFC_CtlMsk.DFC_SRCHighAPP1_C DFC_CtlMsk.DFC_SRCHighAPP2_C DFC_CtlMsk.DFC_SRCLowAPP1_C DFC_CtlMsk.DFC_SRCLowAPP2_C DFC_CtlMsk.DFC_SSpMon2_C DFC_CtlMsk.DFC_SWReset_0_C DFC_CtlMsk.DFC_SWReset_1_C DFC_CtlMsk.DFC_SWReset_2_C DFC_CtlMsk.DFC_SyncAPP_C DFC_CtlMsk.DFC_TAmax_Dummy_C DFC_CtlMsk.DFC_TKAEmax_C DFC_CtlMsk.DFC_TKAEmin_C DFC_CtlMsk.DFC_TKARmax_C DFC_CtlMsk.DFC_TKARnpl_C DFC_CtlMsk.DFC_TMmax_Dummy_C DFC_CtlMsk.DFC_TUMmax_Dummy_C DFC_CtlMsk.DFC_TWCDPriCatB1_C DFC_CtlMsk.DFC_ThrVlvClsdPosnFirstOffsLrnImpoB1_C DFC_CtlMsk.DFC_ThrVlvClsdPosnOffsLrnImpoB1_C DFC_CtlMsk.DFC_ThrVlvClsdPosnOffsLrnMaxB1_C DFC_CtlMsk.DFC_ThrVlvClsdPosnOffsLrnMinB1_C DFC_CtlMsk.DFC_ThrVlvCtrlDeB1_C DFC_CtlMsk.DFC_ThrVlvDycB1_C DFC_CtlMsk.DFC_ThrVlvLimpAirPosnMaxAbsltDriftB1_C DFC_CtlMsk.DFC_ThrVlvLimpAirPosnMaxB1_C DFC_CtlMsk.DFC_ThrVlvLimpAirPosnMaxRelDriftB1_C DFC_CtlMsk.DFC_ThrVlvLimpAirPosnMinB1_C DFC_CtlMsk.DFC_ThrVlvOpenLoadB1_C DFC_CtlMsk.DFC_ThrVlvOpenSprgB1_C DFC_CtlMsk.DFC_ThrVlvOpenSprgSprdB1_C DFC_CtlMsk.DFC_ThrVlvOpenSprgTwnB1_C DFC_CtlMsk.DFC_ThrVlvOverTB1_C DFC_CtlMsk.DFC_ThrVlvRetSprgB1_C DFC_CtlMsk.DFC_ThrVlvRetSprgSprdB1_C DFC_CtlMsk.DFC_ThrVlvRetSprgTwnB1_C DFC_CtlMsk.DFC_ThrVlvSens1MaxB1_C DFC_CtlMsk.DFC_ThrVlvSens1NplB1_C DFC_CtlMsk.DFC_ThrVlvSens2MaxB1_C DFC_CtlMsk.DFC_ThrVlvSens2MinB1_C DFC_CtlMsk.DFC_ThrVlvSens2NplB1_C DFC_CtlMsk.DFC_ThrVlvShoCircB1_C DFC_CtlMsk.DFC_ThrVlvSpiErrB1_C DFC_CtlMsk.DFC_ThrvlvSens1MinB1_C DFC_CtlMsk.DFC_TiOffTBasdChkFast_C DFC_CtlMsk.DFC_TiOffTBasdChkSlow_C DFC_CtlMsk.DFC_UEGOHeatrCtlS1B1_C DFC_CtlMsk.DFC_UEGOSnsrMntdS1B1_C DFC_CtlMsk.DFC_VehVSig_C DFC_CtlMsk.DFC_VlvLftFbSwtIntk11SpclFail_C DFC_CtlMsk.DFC_VlvLftFbSwtIntk11StdFail_C DFC_DisblMsk.DFC_Unused_C DFC_DisblMsk.DFC_AltIOACGFailr_C DFC_DisblMsk.DFC_AltIOACGHiVltg_C DFC_DisblMsk.DFC_AltIOACGLoVltg_C DFC_DisblMsk.DFC_AltIOACGTHi_C DFC_DisblMsk.DFC_AltIODConnACG_C DFC_DisblMsk.DFC_BattUHiFailr_C DFC_DisblMsk.DFC_BattULoFailr_C DFC_DisblMsk.DFC_BrkBstPDriftHiErr_C DFC_DisblMsk.DFC_BrkBstPDriftLoErr_C DFC_DisblMsk.DFC_BrkBstPSnsrStuck_C DFC_DisblMsk.DFC_BrkMnSwtContOn_C DFC_DisblMsk.DFC_BrkMnSwtNotStp_C DFC_DisblMsk.DFC_BrkNpl_C DFC_DisblMsk.DFC_BrkRdntSwtContOn_C DFC_DisblMsk.DFC_BrkRdntSwtNotStp_C DFC_DisblMsk.DFC_Clth3ONStuck_C DFC_DisblMsk.DFC_Clth4OFFStuck_C DFC_DisblMsk.DFC_ClthOFFStuck_C DFC_DisblMsk.DFC_ClthONStuck_C DFC_DisblMsk.DFC_ClthStkFailInfo_C DFC_DisblMsk.DFC_ComACFailInfo_C DFC_DisblMsk.DFC_ComATFTValErr_C DFC_DisblMsk.DFC_ComATMILReq_C DFC_DisblMsk.DFC_ComAYCAChksum_C DFC_DisblMsk.DFC_ComAYCARingCnt_C DFC_DisblMsk.DFC_ComAYCATOut_C DFC_DisblMsk.DFC_ComAYCDChkSum_C DFC_DisblMsk.DFC_ComAYCDTOut_C DFC_DisblMsk.DFC_ComAYCFChksum_C DFC_DisblMsk.DFC_ComAYCFRingCnt_C DFC_DisblMsk.DFC_ComAYCFTOut_C DFC_DisblMsk.DFC_ComAYCGChksum_C DFC_DisblMsk.DFC_ComAYCGRingCnt_C DFC_DisblMsk.DFC_ComAYCGTOut_C DFC_DisblMsk.DFC_ComAYCIChkSum_C DFC_DisblMsk.DFC_ComAYCIRingCnt_C DFC_DisblMsk.DFC_ComAYCITOut_C DFC_DisblMsk.DFC_ComBCM1ChkSum_C DFC_DisblMsk.DFC_ComBCM1RingCnt_C DFC_DisblMsk.DFC_ComBCM1TOut_C DFC_DisblMsk.DFC_ComCANABusOffErr_C DFC_DisblMsk.DFC_ComCANBBusOffErr_C DFC_DisblMsk.DFC_ComCANCBusOffErr_C DFC_DisblMsk.DFC_ComCGW1ChkSum_C DFC_DisblMsk.DFC_ComCGW1RingCnt_C DFC_DisblMsk.DFC_ComCGW1TOut_C DFC_DisblMsk.DFC_ComConvBoostErr_C DFC_DisblMsk.DFC_ComConvSlipErr_C DFC_DisblMsk.DFC_ComEAT10Chksum_C DFC_DisblMsk.DFC_ComEAT10RingCnt_C DFC_DisblMsk.DFC_ComEAT10TOut_C DFC_DisblMsk.DFC_ComEAT11ChkSum_C DFC_DisblMsk.DFC_ComEAT11RingCnt_C DFC_DisblMsk.DFC_ComEAT11TOut_C DFC_DisblMsk.DFC_ComEAT12ChkSum_C DFC_DisblMsk.DFC_ComEAT12RingCnt_C DFC_DisblMsk.DFC_ComEAT12TOut_C DFC_DisblMsk.DFC_ComEAT13ChkSum_C DFC_DisblMsk.DFC_ComEAT13RingCnt_C DFC_DisblMsk.DFC_ComEAT13TOut_C DFC_DisblMsk.DFC_ComEAT1Chksum_C DFC_DisblMsk.DFC_ComEAT1RingCnt_C DFC_DisblMsk.DFC_ComEAT1TOut_C DFC_DisblMsk.DFC_ComEAT2ChkSum_C DFC_DisblMsk.DFC_ComEAT2RingCnt_C DFC_DisblMsk.DFC_ComEAT2TOut_C DFC_DisblMsk.DFC_ComEAT4ChkSum_C DFC_DisblMsk.DFC_ComEAT4RingCnt_C DFC_DisblMsk.DFC_ComEAT4TOut_C DFC_DisblMsk.DFC_ComEAT6Chksum_C DFC_DisblMsk.DFC_ComEAT6RingCnt_C DFC_DisblMsk.DFC_ComEAT6TOut_C DFC_DisblMsk.DFC_ComEAT7Chksum_C DFC_DisblMsk.DFC_ComEAT7RingCnt_C DFC_DisblMsk.DFC_ComEAT7TOut_C DFC_DisblMsk.DFC_ComEAT8Chksum_C DFC_DisblMsk.DFC_ComEAT8RingCnt_C DFC_DisblMsk.DFC_ComEAT8TOut_C DFC_DisblMsk.DFC_ComEATAChksum_C DFC_DisblMsk.DFC_ComEATARingCnt_C DFC_DisblMsk.DFC_ComEATATOut_C DFC_DisblMsk.DFC_ComEATBChkSum_C DFC_DisblMsk.DFC_ComEATBRingCnt_C DFC_DisblMsk.DFC_ComEATBTOut_C DFC_DisblMsk.DFC_ComEATCChksum_C DFC_DisblMsk.DFC_ComEATCRingCnt_C DFC_DisblMsk.DFC_ComEATCTOut_C DFC_DisblMsk.DFC_ComEBBAChksum_C DFC_DisblMsk.DFC_ComEBBARingCnt_C DFC_DisblMsk.DFC_ComEBBATOut_C DFC_DisblMsk.DFC_ComEPS1Chksum_C DFC_DisblMsk.DFC_ComEPS1RingCnt_C DFC_DisblMsk.DFC_ComEPS1TOut_C DFC_DisblMsk.DFC_ComEngCanRxErr_C DFC_DisblMsk.DFC_ComGrvySnsrErr_C DFC_DisblMsk.DFC_ComGwIMG1ChkSum_C DFC_DisblMsk.DFC_ComGwIMG1RingCnt_C DFC_DisblMsk.DFC_ComGwIMG1TOut_C DFC_DisblMsk.DFC_ComGwIMG3ChkSum_C DFC_DisblMsk.DFC_ComGwIMG3RingCnt_C DFC_DisblMsk.DFC_ComGwIMG3TOut_C DFC_DisblMsk.DFC_ComGwIMG4ChkSum_C DFC_DisblMsk.DFC_ComGwIMG4RingCnt_C DFC_DisblMsk.DFC_ComGwIMG4TOut_C DFC_DisblMsk.DFC_ComGwIMG5ChkSum_C DFC_DisblMsk.DFC_ComGwIMG5RingCnt_C DFC_DisblMsk.DFC_ComGwIMG5TOut_C DFC_DisblMsk.DFC_ComGwIMG6ChkSum_C DFC_DisblMsk.DFC_ComGwIMG6RingCnt_C DFC_DisblMsk.DFC_ComGwIMG6TOut_C DFC_DisblMsk.DFC_ComIDASBChksum_C DFC_DisblMsk.DFC_ComIDASBRingCnt_C DFC_DisblMsk.DFC_ComIDASBTOut_C DFC_DisblMsk.DFC_ComIMGMILReq_C DFC_DisblMsk.DFC_ComISSPrms_C DFC_DisblMsk.DFC_ComMETAChksum_C DFC_DisblMsk.DFC_ComMETARingCnt_C DFC_DisblMsk.DFC_ComMETATOut_C DFC_DisblMsk.DFC_ComMETCChksum_C DFC_DisblMsk.DFC_ComMETCRingCnt_C DFC_DisblMsk.DFC_ComMETCTOut_C DFC_DisblMsk.DFC_ComMETDChksum_C DFC_DisblMsk.DFC_ComMETDRingCnt_C DFC_DisblMsk.DFC_ComMETDTOut_C DFC_DisblMsk.DFC_ComMETE2Chksum_C DFC_DisblMsk.DFC_ComMETE2RingCnt_C DFC_DisblMsk.DFC_ComMETE2TOut_C DFC_DisblMsk.DFC_ComMETFChksum_C DFC_DisblMsk.DFC_ComMETFRingCnt_C DFC_DisblMsk.DFC_ComMETFTOut_C DFC_DisblMsk.DFC_ComMETGChksum_C DFC_DisblMsk.DFC_ComMETGRingCnt_C DFC_DisblMsk.DFC_ComMETGTOut_C DFC_DisblMsk.DFC_ComMETH2Chksum_C DFC_DisblMsk.DFC_ComMETH2RingCnt_C DFC_DisblMsk.DFC_ComMETH2TOut_C DFC_DisblMsk.DFC_ComMETHChksum_C DFC_DisblMsk.DFC_ComMETHRingCnt_C DFC_DisblMsk.DFC_ComMETHTOut_C DFC_DisblMsk.DFC_ComMETIChksum_C DFC_DisblMsk.DFC_ComMETIRingCnt_C DFC_DisblMsk.DFC_ComMETITOut_C DFC_DisblMsk.DFC_ComMETKChksum_C DFC_DisblMsk.DFC_ComMETKRingCnt_C DFC_DisblMsk.DFC_ComMETKTOut_C DFC_DisblMsk.DFC_ComMETLChksum_C DFC_DisblMsk.DFC_ComMETLRingCnt_C DFC_DisblMsk.DFC_ComMETLTOut_C DFC_DisblMsk.DFC_ComMETMChksum_C DFC_DisblMsk.DFC_ComMETMRingCnt_C DFC_DisblMsk.DFC_ComMETMTOut_C DFC_DisblMsk.DFC_ComMETNChksum_C DFC_DisblMsk.DFC_ComMETNRingCnt_C DFC_DisblMsk.DFC_ComMETNTOut_C DFC_DisblMsk.DFC_ComMtrCom_C DFC_DisblMsk.DFC_ComPCUChkSum_C DFC_DisblMsk.DFC_ComPCURingCnt_C DFC_DisblMsk.DFC_ComPCUTOut_C DFC_DisblMsk.DFC_ComSRSAChksum_C DFC_DisblMsk.DFC_ComSRSARingCnt_C DFC_DisblMsk.DFC_ComSRSATOut_C DFC_DisblMsk.DFC_ComSRSBChksum_C DFC_DisblMsk.DFC_ComSRSBRingCnt_C DFC_DisblMsk.DFC_ComSRSBTOut_C DFC_DisblMsk.DFC_ComSRSChksum_C DFC_DisblMsk.DFC_ComSRSErr_C DFC_DisblMsk.DFC_ComSRSRingCnt_C DFC_DisblMsk.DFC_ComSRSTOut_C DFC_DisblMsk.DFC_ComVehSpdPndFltTCU_C DFC_DisblMsk.DFC_EbsChartcCurrErr_C DFC_DisblMsk.DFC_EbsSelfDiagErr_C DFC_DisblMsk.DFC_GbxCANDigPlausErr_C DFC_DisblMsk.DFC_GbxNPos1SRCMax_C DFC_DisblMsk.DFC_GbxNPos1SRCMin_C DFC_DisblMsk.DFC_GbxNPos2SRCMax_C DFC_DisblMsk.DFC_GbxNPos2SRCMin_C DFC_DisblMsk.DFC_GbxNPosAlvChk_C DFC_DisblMsk.DFC_GbxNPosSyncErr_C DFC_DisblMsk.DFC_HEGOS2B1HtrPsMax_C DFC_DisblMsk.DFC_HEGOS2B1HtrPsMin_C DFC_DisblMsk.DFC_HEGOS2B1HtrPsSig_C DFC_DisblMsk.DFC_LinCSErrACG_C DFC_DisblMsk.DFC_LinCSErrEBS_C DFC_DisblMsk.DFC_LinHdrTimeoutErrACG_C DFC_DisblMsk.DFC_LinHdrTimeoutErrEBS_C DFC_DisblMsk.DFC_LinMsgTimeoutErrACG_C DFC_DisblMsk.DFC_LinMsgTimeoutErrEBS_C DFC_DisblMsk.DFC_LinNoStrtComErr_C DFC_DisblMsk.DFC_MisfDetVWhlFrntLeOORHi_C DFC_DisblMsk.DFC_MisfDetVWhlFrntLeRatyHi_C DFC_DisblMsk.DFC_MisfDetVWhlFrntLeRatyLo_C DFC_DisblMsk.DFC_MisfDetVWhlFrntLeStuck_C DFC_DisblMsk.DFC_MisfDetVWhlFrntRiOORHi_C DFC_DisblMsk.DFC_MisfDetVWhlFrntRiRatyHi_C DFC_DisblMsk.DFC_MisfDetVWhlFrntRiRatyLo_C DFC_DisblMsk.DFC_MisfDetVWhlFrntRiStuck_C DFC_DisblMsk.DFC_MisfDetVWhlReLeOORHi_C DFC_DisblMsk.DFC_MisfDetVWhlReLeRatyHi_C DFC_DisblMsk.DFC_MisfDetVWhlReLeRatyLo_C DFC_DisblMsk.DFC_MisfDetVWhlReLeStuck_C DFC_DisblMsk.DFC_MisfDetVWhlReRiOORHi_C DFC_DisblMsk.DFC_MisfDetVWhlReRiRatyHi_C DFC_DisblMsk.DFC_MisfDetVWhlReRiRatyLo_C DFC_DisblMsk.DFC_MisfDetVWhlReRiStuck_C DFC_DisblMsk.DFC_MisfDetdVWhlFrntLePlaus_C DFC_DisblMsk.DFC_MisfDetdVWhlFrntRiPlaus_C DFC_DisblMsk.DFC_MisfDetdVWhlReLePlaus_C DFC_DisblMsk.DFC_MisfDetdVWhlReRiPlaus_C DFC_DisblMsk.DFC_PEnvSigRngMax_C DFC_DisblMsk.DFC_PEnvSigRngMin_C DFC_DisblMsk.DFC_StmFault_C DFC_DisblMsk.DFC_StrtCtOffPth_C DFC_DisblMsk.DFC_StrtCtlErr_C DFC_DisblMsk.DFC_StrtFault_C DFC_DisblMsk.DFC_StrtLckJudg1_C DFC_DisblMsk.DFC_StrtLckJudg2_C DFC_DisblMsk.DFC_StrtOL_C DFC_DisblMsk.DFC_StrtOL2_C DFC_DisblMsk.DFC_StrtSCB_C DFC_DisblMsk.DFC_StrtSCB2_C DFC_DisblMsk.DFC_StrtSCG_C DFC_DisblMsk.DFC_StrtSCG2_C DFC_DisblMsk.DFC_StrtStkRly1_C DFC_DisblMsk.DFC_StrtStkRly2_C DFC_DisblMsk.DFC_TEVEmax_C DFC_DisblMsk.DFC_TEVEmin_C DFC_DisblMsk.DFC_TEVEsig_C DFC_DisblMsk.DFC_VehVAllPlaus_C DFC_DisblMsk.DFC_VehVNCSnsrElecFailr_C DFC_DisblMsk.DFC_VehVPlausCan_C DFC_DisblMsk.DFC_VehVPlausFco_C DFC_DisblMsk.DFC_VehVPlausPwr_C DFC_DisblMsk.DFC_VehVPlausV2N_C DFC_DisblMsk.DFC_VehVSpdSnsrAElecFailr_C DFC_DisblMsk.DFC_VehVSpdSnsrBElecFailr_C DFC_DisblMsk.DFC_ClthMax_C DFC_DisblMsk.DFC_IgnClPs_DevComErr_C DFC_DisblMsk.DFC_IgnClPs_LineOl_0_C DFC_DisblMsk.DFC_IgnClPs_LineOl_1_C DFC_DisblMsk.DFC_IgnClPs_LineOl_2_C DFC_DisblMsk.DFC_IgnClPs_LineOl_3_C DFC_DisblMsk.DFC_IgnClPs_LineScb_0_C DFC_DisblMsk.DFC_IgnClPs_LineScb_1_C DFC_DisblMsk.DFC_IgnClPs_LineScb_2_C DFC_DisblMsk.DFC_IgnClPs_LineScb_3_C DFC_DisblMsk.DFC_IgnClPs_LineScg_0_C DFC_DisblMsk.DFC_IgnClPs_LineScg_1_C DFC_DisblMsk.DFC_IgnClPs_LineScg_2_C DFC_DisblMsk.DFC_IgnClPs_LineScg_3_C DFC_DisblMsk.DFC_UEGOASICS1B1_C DFC_DisblMsk.DFC_UEGOOLIPES1B1_C DFC_DisblMsk.DFC_UEGOOLRES1B1_C DFC_DisblMsk.DFC_UEGOSCBS1B1_C DFC_DisblMsk.DFC_UEGOSCGS1B1_C DFC_DisblMsk.DFC_UEGOSPIS1B1_C DFC_DisblMsk.DFC_UEGOSnsrS1B1_C DFC_DisblMsk.DFC_UegoOlApesS1B1_C DFC_DisblMsk.DFC_UegoOlRCmpS1B1_C DFC_DisblMsk.DFC_AirCCmprOL_C DFC_DisblMsk.DFC_AirCCmprOvrTemp_C DFC_DisblMsk.DFC_AirCCmprSCB_C DFC_DisblMsk.DFC_AirCCmprSCG_C DFC_DisblMsk.DFC_AltErr_C DFC_DisblMsk.DFC_BattUSRCMax_C DFC_DisblMsk.DFC_BattUSRCMin_C DFC_DisblMsk.DFC_ComChksTCU1_C DFC_DisblMsk.DFC_ComChksTCU11_C DFC_DisblMsk.DFC_ComChksTCU12_C DFC_DisblMsk.DFC_ComChksTCU13_C DFC_DisblMsk.DFC_ComChksTCU2_C DFC_DisblMsk.DFC_ComChksTCU3_C DFC_DisblMsk.DFC_ComChksTCU4_C DFC_DisblMsk.DFC_ComCntTCU1_C DFC_DisblMsk.DFC_ComCntTCU11_C DFC_DisblMsk.DFC_ComCntTCU12_C DFC_DisblMsk.DFC_ComCntTCU13_C DFC_DisblMsk.DFC_ComCntTCU2_C DFC_DisblMsk.DFC_ComCntTCU3_C DFC_DisblMsk.DFC_ComCntTCU4_C DFC_DisblMsk.DFC_ComTOutTCU01_C DFC_DisblMsk.DFC_ComTOutTCU02_C DFC_DisblMsk.DFC_ComTOutTCU1_C DFC_DisblMsk.DFC_ComTOutTCU11_C DFC_DisblMsk.DFC_ComTOutTCU12_C DFC_DisblMsk.DFC_ComTOutTCU13_C DFC_DisblMsk.DFC_ComTOutTCU14_C DFC_DisblMsk.DFC_ComTOutTCU2_C DFC_DisblMsk.DFC_ComTOutTCU3_C DFC_DisblMsk.DFC_ComTOutTCU4_C DFC_DisblMsk.DFC_DevLibBattUHi_C DFC_DisblMsk.DFC_DevLibBattULo_C DFC_DisblMsk.DFC_FanDIOOL_0_C DFC_DisblMsk.DFC_FanDIOOL_1_C DFC_DisblMsk.DFC_FanDIOOvrTemp_0_C DFC_DisblMsk.DFC_FanDIOOvrTemp_1_C DFC_DisblMsk.DFC_FanDIOSCB_0_C DFC_DisblMsk.DFC_FanDIOSCB_1_C DFC_DisblMsk.DFC_FanDIOSCG_0_C DFC_DisblMsk.DFC_FanDIOSCG_1_C DFC_DisblMsk.DFC_MRlyDcOL_C DFC_DisblMsk.DFC_MRlyDcSCB_C DFC_DisblMsk.DFC_MRlyDcSCG_C DFC_DisblMsk.DFC_PSPOL_C DFC_DisblMsk.DFC_PSPOvrTemp_C DFC_DisblMsk.DFC_PSPSCB_C DFC_DisblMsk.DFC_PSPSCG_C DFC_DisblMsk.DFC_T50Err_C DFC_DisblMsk.DFC_ThrVlvLoBattB1_C DFC_DisblMsk.DFC_VehVPhysRngHi_C DFC_DisblMsk.DFC_VehVSclOutOL_C DFC_DisblMsk.DFC_VehVSclOutOT_C DFC_DisblMsk.DFC_VehVSclOutSCB_C DFC_DisblMsk.DFC_VehVSclOutSCG_C DFC_DisblMsk.DFC_VehVSnsrARngHi_C DFC_DisblMsk.DFC_VehVSnsrBRngHi_C DFC_DisblMsk.DFC_VehVSpdRtyDiag_C DFC_DisblMsk.DFC_VehVWhlErr_C DFC_DisblMsk.DFC_ACEvpTSRCMax_C DFC_DisblMsk.DFC_ACEvpTSRCMin_C DFC_DisblMsk.DFC_AirCClntPAnaSRCMax_C DFC_DisblMsk.DFC_AirCClntPAnaSRCMin_C DFC_DisblMsk.DFC_AirCSwtNpl_C DFC_DisblMsk.DFC_AirCSwtSig_C DFC_DisblMsk.DFC_Brk_C DFC_DisblMsk.DFC_BrkSig_C DFC_DisblMsk.DFC_ClthSig_C DFC_DisblMsk.DFC_HLSDemOvhtEngLim_C DFC_DisblMsk.DFC_OilPNpl_C DFC_DisblMsk.DFC_PIntkVUsLineHiB1_C DFC_DisblMsk.DFC_PIntkVUsLineLoB1_C DFC_DisblMsk.DFC_VehVPhysRngLo_C DFC_DisblMsk.DFC_VehVSigCan_C DFC_DisblMsk.DFC_VehVSigCanSafe_C DFC_DisblMsk.DFC_VlvLftFbOilPSnsrIntk11SRCMax_C DFC_DisblMsk.DFC_VlvLftFbOilPSnsrIntk11SRCMin_C DFC_DisblMsk.DFC_ClthNpl_C DFC_DisblMsk.DFC_EV1max_C DFC_DisblMsk.DFC_EV1min_C DFC_DisblMsk.DFC_EV1sig_C DFC_DisblMsk.DFC_EV2max_C DFC_DisblMsk.DFC_EV2min_C DFC_DisblMsk.DFC_EV2sig_C DFC_DisblMsk.DFC_EV3max_C DFC_DisblMsk.DFC_EV3min_C DFC_DisblMsk.DFC_EV3sig_C DFC_DisblMsk.DFC_EV4max_C DFC_DisblMsk.DFC_EV4min_C DFC_DisblMsk.DFC_EV4sig_C DFC_DisblMsk.DFC_GbxPNPosnDrvCdn_C DFC_DisblMsk.DFC_GbxPNPosnPlausy_C DFC_DisblMsk.DFC_PEnvCcMax_C DFC_DisblMsk.DFC_PEnvCcMin_C DFC_DisblMsk.DFC_PEnvRngChkMax_C DFC_DisblMsk.DFC_PEnvRngChkMin_C DFC_DisblMsk.DFC_PEnvSnsrPlaus_C DFC_DisblMsk.DFC_UEGOHeatrPsS1B1Max_C DFC_DisblMsk.DFC_UEGOHeatrPsS1B1Min_C DFC_DisblMsk.DFC_UEGOHeatrPsS1B1Sig_C DFC_DisblMsk.DFC_UEGOHeatrRlyPsOLS1B1_C DFC_DisblMsk.DFC_UEGOHeatrRlyPsSCBS1B1_C DFC_DisblMsk.DFC_UEGOHeatrRlyPsSCGS1B1_C DFC_DisblMsk.DFC_KnDetSens1PortAMax_C DFC_DisblMsk.DFC_KnDetSens1PortAMin_C DFC_DisblMsk.DFC_KnDetSens1PortBMax_C DFC_DisblMsk.DFC_KnDetSens1PortBMin_C DFC_DisblMsk.DFC_Clth2ONStuck_C /end DEF_CHARACTERISTIC
 FUNCTION_VERSION "30000.33.0" /end FUNCTION
/begin COMPU_METHOD DFES_OneToOne "" RAT_FUNC "%6.2" "-" COEFFS 0 1 0 0 0 1 /end COMPU_METHOD
/begin RECORD_LAYOUT Val_Wu16 FNC_VALUES 1 UWORD COLUMN_DIR DIRECT /end RECORD_LAYOUT
/end MODULE
/end PROJECT
