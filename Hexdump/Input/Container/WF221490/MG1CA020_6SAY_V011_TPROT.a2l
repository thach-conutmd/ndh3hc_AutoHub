ASAP2_VERSION 1 60
/begin PROJECT MG1CA020 "MG1CA020"
/begin HEADER "" VERSION "MG1CA020_6SAY_V011_TPROT" PROJECT_NO MG1CA020 /end HEADER
/begin MODULE DIM ""
/begin MOD_COMMON "" BYTE_ORDER MSB_LAST ALIGNMENT_BYTE 1 ALIGNMENT_WORD 2 ALIGNMENT_LONG 4 ALIGNMENT_INT64 4 ALIGNMENT_FLOAT32_IEEE 4 ALIGNMENT_FLOAT64_IEEE 4 DATA_SIZE 32 /end MOD_COMMON
/begin CHARACTERISTIC CWMSUDKSOM "codeword MSUDKSOM" VALUE 0x8052FE58 RB_Val_Wu8 255.0 OneToOne 0.00 255.0 FORMAT "%5.1" /end CHARACTERISTIC
/begin CHARACTERISTIC CWNSKH "Codeword for idle-speed while catalyst-heating" VALUE 0x805325F0 RB_Val_Wu16 65535.00 dez 0.00 65535.00 FORMAT "%8.2" /end CHARACTERISTIC
/begin CHARACTERISTIC CWTOSPM "code word for configuration model oil temperature in sump" VALUE 0x80532BC0 RB_Val_Wu8 255.0 dez 0.00 255.0 FORMAT "%5.1" /end CHARACTERISTIC
/begin CHARACTERISTIC CWTOSPM2 "code word 2 for configuration model oil temperature in sump" VALUE 0x80532BC1 RB_Val_Wu8 255.0 dez 0.00 255.0 FORMAT "%5.1" /end CHARACTERISTIC
/begin CHARACTERISTIC DTAHLL "Delta tans for stopping hot idling" VALUE 0x805322B6 RB_Val_Wu8 191.3 temp_ub_b191p25 0.00 191.3 FORMAT "%5.1" /end CHARACTERISTIC
/begin CHARACTERISTIC DTMHLL "Delat tmot for stopping hot idling" VALUE 0x805322B7 RB_Val_Wu8 191.3 temp_ub_b191p25 0.00 191.3 FORMAT "%5.1" /end CHARACTERISTIC
/begin AXIS_PTS EngStrt_facCoorAltiAirPth_AX "Base point distribution over altitude correction for air path at start" 0x8052FE5A PEnv_facCorrAlti RB_Axis_U16 3.999939 fak_uw_b4 4 0.00 3.999939 FORMAT "%8.6" DEPOSIT ABSOLUTE /end AXIS_PTS
/begin CHARACTERISTIC EngStrt_facCoorAltiMfAir_GT "Correction curve dependent on height of the filling feed forward control in the start to the avoidance of start problems on account of a too slightly precontrolled filling" CURVE 0x8052FE64 RB_CurveGroup_U8 1.992188 fak_ub_b2 0.00 1.992188 FORMAT "%8.6"
 /begin AXIS_DESCR COM_AXIS PEnv_facCorrAlti fak_uw_b4 4 0.00 3.999939 FORMAT "%8.6" AXIS_PTS_REF EngStrt_facCoorAltiAirPth_AX /end AXIS_DESCR
/end CHARACTERISTIC
/begin CHARACTERISTIC EngStrt_idxClassSelnTiFacAirPthTran_T "Curve class selector for filter time class" CURVE 0x8052FE68 RB_Curve_U16_U8_Static 255.0 OneToOne 0.00 255.0 FORMAT "%5.1"
 /begin AXIS_DESCR STD_AXIS EngStrt_stStrtReq ENGSTRT_STSTRTREQ_SET_COMPU_VERB 6 0.00 16384.0000000 FORMAT "%13.7" DEPOSIT ABSOLUTE /end AXIS_DESCR
/end CHARACTERISTIC
/begin CHARACTERISTIC EngStrt_idxSelnMfAirWait_T "Curve class instance selector for air mass flow between start request and start beginning" CURVE 0x8052FE7C RB_Curve_U16_U8_Static 0.00 ENGSTRT_MFAIRWAIT_SET_COMPU_VERB 0.00 0.00 FORMAT "%13.2"
 /begin AXIS_DESCR STD_AXIS EngStrt_stStrtReq ENGSTRT_STSTRTREQ_SET_COMPU_VERB 6 0.00 16384.0000000 FORMAT "%13.7" DEPOSIT ABSOLUTE /end AXIS_DESCR
/end CHARACTERISTIC
/begin CHARACTERISTIC EngStrt_idxSelnMfAir_T "Curve class instance selector for air mass flow during start" CURVE 0x8052FE90 RB_Curve_U16_U8_Static 3.00000000000 ENGSTRT_MFAIRSTRT_SET_COMPU_VERB 0.00 3.00000000000 FORMAT "%13.11"
 /begin AXIS_DESCR STD_AXIS EngStrt_stStrtReq ENGSTRT_STSTRTREQ_SET_COMPU_VERB 6 0.00 16384.0000000 FORMAT "%13.7" DEPOSIT ABSOLUTE /end AXIS_DESCR
/end CHARACTERISTIC
/begin CHARACTERISTIC EngStrt_idxSelnTiFacAirPthTranCon_T "Curve class instance selector for filter time parameter during start" CURVE 0x8052FEA4 RB_Curve_U16_U8_Static 1.00000000000 ENGSTRT_TIFACAIRPTHTRANCON_SET_COMPU_VERB 0.00 1.00000000000 FORMAT "%13.11"
 /begin AXIS_DESCR STD_AXIS EngStrt_stStrtReq ENGSTRT_STSTRTREQ_SET_COMPU_VERB 6 0.00 16384.0000000 FORMAT "%13.7" DEPOSIT ABSOLUTE /end AXIS_DESCR
/end CHARACTERISTIC
/begin CHARACTERISTIC EngStrt_idxSelnTiFacAirPthTran_T "Curve class instance selector for filter time table during start" CURVE 0x8052FEB8 RB_Curve_U16_U8_Static 1.00000000000 ENGSTRT_TIFACAIRPTHTRAN_SET_COMPU_VERB 0.00 1.00000000000 FORMAT "%13.11"
 /begin AXIS_DESCR STD_AXIS EngStrt_stStrtReq ENGSTRT_STSTRTREQ_SET_COMPU_VERB 6 0.00 16384.0000000 FORMAT "%13.7" DEPOSIT ABSOLUTE /end AXIS_DESCR
/end CHARACTERISTIC
/begin CHARACTERISTIC EngStrt_mfAirEngOff_GT "Grouped curve desired standardised air mass flow at stopped engine" CURVE 0x8052FECC RB_CurveGroup_U16 6553.500 m_uw_b6553p5 0.00 6553.500 FORMAT "%8.3"
 /begin AXIS_DESCR COM_AXIS EngStrt_tStrtCoor Temp_Cels 12 -273.140 3003.560 FORMAT "%8.3" EXTENDED_LIMITS -3549.940 3003.560 AXIS_PTS_REF EngStrt_tStrtAirPth_AX /end AXIS_DESCR
/end CHARACTERISTIC
/begin AXIS_PTS EngStrt_nEngAirPth_AX "Base point distribution over engine speed for air path at start" 0x8052FEE4 Epm_nEng10ms RB_Axis_S16 32767.50 EngN 4 -16384.00 16383.50 FORMAT "%8.2" DEPOSIT ABSOLUTE /end AXIS_PTS
/begin CHARACTERISTIC EngStrt_nNxtStrtAirPthRst_T "Curve for the threshold COM for deactivation desired throttle position without torque structure" CURVE 0x8052FEEE RB_Curve_S16_S16 32767.50 EngN -16384.00 16383.50 FORMAT "%8.2"
 /begin AXIS_DESCR STD_AXIS EngStrt_tStrtCoor Temp_Cels 6 -273.140 3003.560 FORMAT "%8.3" EXTENDED_LIMITS -3549.940 3003.560 DEPOSIT ABSOLUTE /end AXIS_DESCR
/end CHARACTERISTIC
/begin AXIS_PTS EngStrt_nrInjAirPth_AX "Base point distribution for the number of injection" 0x8052FF08 EngStrt_nrInjAirPth RB_Axis_U8 255.0 OneToOne 8 0.00 255.0 FORMAT "%5.1" DEPOSIT ABSOLUTE /end AXIS_PTS
/begin AXIS_PTS EngStrt_rPedAirPth_AX "Base point distribution over accelerator pedal angle for air path at start" 0x8052FF12 APP_r RB_Axis_S16 799.9878 Prc 10 -400.0000 399.9878 FORMAT "%8.4" DEPOSIT ABSOLUTE /end AXIS_PTS
/begin AXIS_PTS EngStrt_tStrtAirPth_AX "Base point distribution over start temperature for air path at start" 0x8052FF28 EngStrt_tStrtCoor RB_Axis_S16 3276.700 Temp_Cels 12 -273.140 3003.560 FORMAT "%8.3" EXTENDED_LIMITS -3549.940 3003.560 DEPOSIT ABSOLUTE /end AXIS_PTS
/begin CHARACTERISTIC ExhMgT_facCatWrmIdleN_M "Weighting factor for idle speed control because of Catalyst Keeping Warm request" MAP 0x805325F2 RB_Map_S16U16_U16 3.999939 fak_uw_b4 0.00 3.999939 FORMAT "%8.6"
 /begin AXIS_DESCR STD_AXIS tmchtslo_w Temp_Cels 8 -3549.940 3003.560 FORMAT "%8.3" DEPOSIT ABSOLUTE /end AXIS_DESCR
 /begin AXIS_DESCR STD_AXIS frhokor_w_msg fak_uw_b4 4 0.00 3.999939 FORMAT "%8.6" DEPOSIT ABSOLUTE /end AXIS_DESCR
/end CHARACTERISTIC
/begin CHARACTERISTIC ExhMgT_facHeatgProgsIdleSpdCorrnDrvgPosn_M "map for control of engine idle speed during catalyst heating and engaged driving position in dependence of heating progress and catalyst start temperature" MAP 0x8053264E RB_Map_U16S16_U16 1.999969 fak_uw_b2 0.00 1.999969 FORMAT "%8.6"
 /begin AXIS_DESCR STD_AXIS ExhMgT_facCatHeatgProgsNIdle fak_uw_b1 8 0.00 0.9999847 FORMAT "%9.7" DEPOSIT ABSOLUTE /end AXIS_DESCR
 /begin AXIS_DESCR STD_AXIS ExhMgT_tCatColdStrtIdleSpdReq Temp_Cels 4 -3549.940 3003.560 FORMAT "%8.3" DEPOSIT ABSOLUTE /end AXIS_DESCR
/end CHARACTERISTIC
/begin CHARACTERISTIC ExhMgT_facHeatgProgsIdleSpdCorrn_M "map for control of engine idle speed during catalyst heating in dependence of heating progress and catalyst start temperature" MAP 0x805326AA RB_Map_U16S16_U16 1.999969 fak_uw_b2 0.00 1.999969 FORMAT "%8.6"
 /begin AXIS_DESCR STD_AXIS ExhMgT_facCatHeatgProgsNIdle fak_uw_b1 8 0.00 0.9999847 FORMAT "%9.7" DEPOSIT ABSOLUTE /end AXIS_DESCR
 /begin AXIS_DESCR STD_AXIS ExhMgT_tCatColdStrtIdleSpdReq Temp_Cels 4 -3549.940 3003.560 FORMAT "%8.3" DEPOSIT ABSOLUTE /end AXIS_DESCR
/end CHARACTERISTIC
/begin CHARACTERISTIC ExhMgT_nIdleCatHeatgDrvgPosn_M "desired nominal idling speed during catalyst heating in dependence of engine and catalyst temperature with engaged driving position" MAP 0x80532706 RB_Map_S16S16_U8 2550. nmot_q10 0.00 2550. FORMAT "%5.0"
 /begin AXIS_DESCR STD_AXIS ExhMgT_tEngCatHeatgIdle Temp_Cels 8 -3549.940 3003.560 FORMAT "%8.3" DEPOSIT ABSOLUTE /end AXIS_DESCR
 /begin AXIS_DESCR STD_AXIS ExhMgT_tCatColdStrtIdleSpdReq Temp_Cels 8 -3549.940 3003.560 FORMAT "%8.3" DEPOSIT ABSOLUTE /end AXIS_DESCR
/end CHARACTERISTIC
/begin CHARACTERISTIC ExhMgT_nIdleCatHeatg_M "desired nominal idling speed during catalyst heating in dependence of engine and catalyst temperature" MAP 0x8053276A RB_Map_S16S16_U8 2550. nmot_q10 0.00 2550. FORMAT "%5.0"
 /begin AXIS_DESCR STD_AXIS ExhMgT_tEngCatHeatgIdle Temp_Cels 8 -3549.940 3003.560 FORMAT "%8.3" DEPOSIT ABSOLUTE /end AXIS_DESCR
 /begin AXIS_DESCR STD_AXIS ExhMgT_tCatColdStrtIdleSpdReq Temp_Cels 8 -3549.940 3003.560 FORMAT "%8.3" DEPOSIT ABSOLUTE /end AXIS_DESCR
/end CHARACTERISTIC
/begin CHARACTERISTIC ExhMgT_nIdleSpdCatWrmDrvgPosn_M "desired nominal idling speed during catalyst warm up mode in dependence of engine and catalyst temperature with engaged driving position" MAP 0x805327CE RB_Map_S16S16_U8 2550. nmot_q10 0.00 2550. FORMAT "%5.0"
 /begin AXIS_DESCR STD_AXIS ExhMgT_tEngCatHeatgIdle Temp_Cels 8 -3549.940 3003.560 FORMAT "%8.3" DEPOSIT ABSOLUTE /end AXIS_DESCR
 /begin AXIS_DESCR STD_AXIS ExhMgT_tCatWrmIdleSpdReq Temp_Cels 8 -3549.940 3003.560 FORMAT "%8.3" DEPOSIT ABSOLUTE /end AXIS_DESCR
/end CHARACTERISTIC
/begin CHARACTERISTIC ExhMgT_nIdleSpdCatWrm_M "desired nominal idling speed during catalyst warm up mode in dependence of engine and catalyst temperature" MAP 0x80532832 RB_Map_S16S16_U8 2550. nmot_q10 0.00 2550. FORMAT "%5.0"
 /begin AXIS_DESCR STD_AXIS ExhMgT_tEngCatHeatgIdle Temp_Cels 8 -3549.940 3003.560 FORMAT "%8.3" DEPOSIT ABSOLUTE /end AXIS_DESCR
 /begin AXIS_DESCR STD_AXIS ExhMgT_tCatWrmIdleSpdReq Temp_Cels 8 -3549.940 3003.560 FORMAT "%8.3" DEPOSIT ABSOLUTE /end AXIS_DESCR
/end CHARACTERISTIC
/begin CHARACTERISTIC ExhMgT_stIdleSpeedCatHeatg2_C "Additional codeword for the activation of function features of idle speed increase for catalyst heating" VALUE 0x80532896 RB_Val_Wu16 65535.00 dez 0.00 65535.00 FORMAT "%8.2" /end CHARACTERISTIC
/begin CHARACTERISTIC ExhMgT_stIdleSpeedCatHeatg_C "code word for the function idle speed calculation for catalyst heating" VALUE 0x80532898 RB_Val_Wu16 65535.00 dez 0.00 65535.00 FORMAT "%8.2" /end CHARACTERISTIC
/begin CHARACTERISTIC ExhMgT_tiDlyDrvgPosnNotEngd_C "Delay time for the information, that the driving position is not engaged anymore" VALUE 0x8053289A RB_Val_Wu8 25.50 t_q0p1 0.00 25.50 FORMAT "%5.2" /end CHARACTERISTIC
/begin CHARACTERISTIC ExhMgT_tiIdleSpdFltCatHeatgEndDrvgPosn_C "Time constant for filtering the desired nominal idle speed during no catalyst heating while driving position is engaged" VALUE 0x8053289B RB_Val_Wu8 25.4996 zk100msxs_ub_b25p5 0.1004 25.6000 FORMAT "%7.4" EXTENDED_LIMITS 0.100392 25.6000 /end CHARACTERISTIC
/begin CHARACTERISTIC ExhMgT_tiIdleSpdFltCatHeatgEnd_C "Time constant for filtering the desired nominal idle speed during no catalyst heating" VALUE 0x8053289C RB_Val_Wu8 25.4996 zk100msxs_ub_b25p5 0.1004 25.6000 FORMAT "%7.4" EXTENDED_LIMITS 0.100392 25.6000 /end CHARACTERISTIC
/begin CHARACTERISTIC ExhMgT_tiIdleSpdFltCatHeatgStrtDrvgPosn_C "Time constant for filtering the desired nominal idle speed during catalyst heating while driving position is engaged" VALUE 0x8053289D RB_Val_Wu8 25.4996 zk100msxs_ub_b25p5 0.1004 25.6000 FORMAT "%7.4" EXTENDED_LIMITS 0.100392 25.6000 /end CHARACTERISTIC
/begin CHARACTERISTIC ExhMgT_tiIdleSpdFltCatHeatgStrt_C "Time constant for filtering the desired nominal idle speed during catalyst heating" VALUE 0x8053289E RB_Val_Wu8 25.4996 zk100msxs_ub_b25p5 0.1004 25.6000 FORMAT "%7.4" EXTENDED_LIMITS 0.100392 25.6000 /end CHARACTERISTIC
/begin CHARACTERISTIC ExhMgT_tiIdleSpdFltCatWrmDrvgPosn_C "Time constant for filtering the desired nominal idle speed during catalyst warm up mode while driving position is engaged" VALUE 0x8053289F RB_Val_Wu8 25.4996 zk100msxs_ub_b25p5 0.1004 25.6000 FORMAT "%7.4" EXTENDED_LIMITS 0.100392 25.6000 /end CHARACTERISTIC
/begin CHARACTERISTIC ExhMgT_tiIdleSpdFltCatWrm_C "filter time constant for filtering of desired idle speed in case of catalyst heating because of catalyst warming" VALUE 0x805328A0 RB_Val_Wu8 25.4996 zk100msxs_ub_b25p5 0.1004 25.6000 FORMAT "%7.4" EXTENDED_LIMITS 0.100392 25.6000 /end CHARACTERISTIC
/begin CHARACTERISTIC ExhMgt_vVehThdCatHeatg_C "velocity threshold for trigger the reset condition for decrease idling speed during catalyst heating" VALUE 0x805328A2 RB_Val_Ws16 655.3500 Vel -327.6800 327.6700 FORMAT "%8.4" /end CHARACTERISTIC
/begin CHARACTERISTIC GANGKHLL "gear for start of ramping down idle speed in case of set drive position" VALUE 0x805328A4 RB_Val_Ws8 127.0 dez 0.00 127.0 FORMAT "%5.1" EXTENDED_LIMITS -128.0 127.0 /end CHARACTERISTIC
/begin CHARACTERISTIC KFMSUDKSH "additional desired air mass flow at start with independent car heater" MAP 0x8052FF42 RB_Map_U8S16_U16 6553.500 m_uw_b6553p5 0.00 6553.500 FORMAT "%8.3"
 /begin AXIS_DESCR STD_AXIS tumgsudksh temp_ub_q0p75_o48 6 -48.0 143.3 FORMAT "%5.1" DEPOSIT ABSOLUTE /end AXIS_DESCR
 /begin AXIS_DESCR STD_AXIS EngStrt_tStrtCoor Temp_Cels 6 -273.140 3003.560 FORMAT "%8.3" EXTENDED_LIMITS -3549.940 3003.560 DEPOSIT ABSOLUTE /end AXIS_DESCR
/end CHARACTERISTIC
/begin CHARACTERISTIC KFNLLKEB "idle speed after start for first start at end of line" CURVE 0x80532B18 RB_Curve_U8_U8 2550. nmot_ub_q10 0.00 2550. FORMAT "%5.0"
 /begin AXIS_DESCR STD_AXIS NSPTS_tnstloc t1sxs_ub_b255 4 0.00 255.0 FORMAT "%5.1" DEPOSIT ABSOLUTE /end AXIS_DESCR
/end CHARACTERISTIC
/begin CHARACTERISTIC KFNLLNST "idle speed after start" MAP 0x80532B21 RB_MapGroup_U8 2550. nmot_ub_q10 0.00 2550. FORMAT "%5.0"
 /begin AXIS_DESCR COM_AXIS NSPTS_tnstloc t1sxs_ub_b255 6 0.00 255.0 FORMAT "%5.1" AXIS_PTS_REF STN06LLUB_NSPTS /end AXIS_DESCR
 /begin AXIS_DESCR COM_AXIS NSPTS_tmotloc temp_ub_q0p75_o48 6 -24624.00 24527.25 FORMAT "%8.2" AXIS_PTS_REF STM06LLUB_NSPTS /end AXIS_DESCR
/end CHARACTERISTIC
/begin CHARACTERISTIC KFNSKHLL "map for control of idle speed during catalyst heating" MAP 0x805328A6 RB_Map_U16U16_U16 1.999969 fak_uw_b2 0.00 1.999969 FORMAT "%8.6"
 /begin AXIS_DESCR STD_AXIS ExhMgT_tiAftStrtCatHeatgNIdle t100msxs_uw_b6553p5 8 0.00 6553.500 FORMAT "%8.3" DEPOSIT ABSOLUTE /end AXIS_DESCR
 /begin AXIS_DESCR STD_AXIS frhokor_w_msg fak_uw_b4 4 0.00 3.999939 FORMAT "%8.6" DEPOSIT ABSOLUTE /end AXIS_DESCR
/end CHARACTERISTIC
/begin CHARACTERISTIC KFNSKHLLFS "map for control up engine during catalyst heating while the driving state is active" MAP 0x80532902 RB_Map_U16U16_U16 1.999969 fak_uw_b2 0.00 1.999969 FORMAT "%8.6"
 /begin AXIS_DESCR STD_AXIS ExhMgT_tiAftStrtCatHeatgNIdle t100msxs_uw_b6553p5 8 0.00 6553.500 FORMAT "%8.3" DEPOSIT ABSOLUTE /end AXIS_DESCR
 /begin AXIS_DESCR STD_AXIS frhokor_w_msg fak_uw_b4 4 0.00 3.999939 FORMAT "%8.6" DEPOSIT ABSOLUTE /end AXIS_DESCR
/end CHARACTERISTIC
/begin CHARACTERISTIC KFNSKHLLFSIML "Map for speed control during catalytic converter heating" MAP 0x8053295E RB_Map_U16U16_U16 1.999969 fak_uw_b2 0.00 1.999969 FORMAT "%8.6"
 /begin AXIS_DESCR STD_AXIS ExhMgT_facCatHeatgProgsNIdle fak_uw_b1 8 0.00 0.9999847 FORMAT "%9.7" DEPOSIT ABSOLUTE /end AXIS_DESCR
 /begin AXIS_DESCR STD_AXIS frhokor_w_msg fak_uw_b4 4 0.00 3.999939 FORMAT "%8.6" DEPOSIT ABSOLUTE /end AXIS_DESCR
/end CHARACTERISTIC
/begin CHARACTERISTIC KFNSKHLLIML "Map for speed control during catalytic converter heating" MAP 0x805329BA RB_Map_U16U16_U16 1.999969 fak_uw_b2 0.00 1.999969 FORMAT "%8.6"
 /begin AXIS_DESCR STD_AXIS ExhMgT_facCatHeatgProgsNIdle fak_uw_b1 8 0.00 0.9999847 FORMAT "%9.7" DEPOSIT ABSOLUTE /end AXIS_DESCR
 /begin AXIS_DESCR STD_AXIS frhokor_w_msg fak_uw_b4 4 0.00 3.999939 FORMAT "%8.6" DEPOSIT ABSOLUTE /end AXIS_DESCR
/end CHARACTERISTIC
/begin CHARACTERISTIC KFNSKHLLTM "map for control of idle speed during catalyst heating in dependence of time counter at end of start and engine temperature at start" MAP 0x80532A16 RB_Map_U16S16_U16 1.999969 fak_uw_b2 0.00 1.999969 FORMAT "%8.6"
 /begin AXIS_DESCR STD_AXIS ExhMgT_tiAftStrtCatHeatgNIdle t100msxs_uw_b6553p5 8 0.00 6553.500 FORMAT "%8.3" DEPOSIT ABSOLUTE /end AXIS_DESCR
 /begin AXIS_DESCR STD_AXIS ExhMgT_tStrtNCatHeatg Temp_Cels 5 -3549.940 3003.560 FORMAT "%8.3" DEPOSIT ABSOLUTE /end AXIS_DESCR
/end CHARACTERISTIC
/begin CHARACTERISTIC KFNSKHLLTMIML "map for control of idle speed during catalyst heating in dependence of catalyst heating progress and engine temperature at start" MAP 0x80532A84 RB_Map_U16S16_U16 1.999969 fak_uw_b2 0.00 1.999969 FORMAT "%8.6"
 /begin AXIS_DESCR STD_AXIS ExhMgT_facCatHeatgProgsNIdle fak_uw_b1 8 0.00 0.9999847 FORMAT "%9.7" DEPOSIT ABSOLUTE /end AXIS_DESCR
 /begin AXIS_DESCR STD_AXIS ExhMgT_tStrtNCatHeatg Temp_Cels 5 -3549.940 3003.560 FORMAT "%8.3" DEPOSIT ABSOLUTE /end AXIS_DESCR
/end CHARACTERISTIC
/begin CHARACTERISTIC KFNSOLHT "Desired idling speed, depending of height and temperature of the environment" MAP 0x805322B8 RB_Map_U16S16_U8 2550. nmot_q10 0.00 2550. FORMAT "%5.0"
 /begin AXIS_DESCR STD_AXIS PEnv_facCorrAlti fak_uw_b4 4 0.00 3.999939 FORMAT "%8.6" DEPOSIT ABSOLUTE /end AXIS_DESCR
 /begin AXIS_DESCR STD_AXIS EnvT_t Temp_Cels 4 -3549.940 3003.560 FORMAT "%8.3" DEPOSIT ABSOLUTE /end AXIS_DESCR
/end CHARACTERISTIC
/begin CHARACTERISTIC KFTMHTD "Map for target idle speed, heating demand according to coolant temperature" MAP 0x80532118 RB_Map_S16S16_U8 2550. nmot_ub_q10 0.00 2550. FORMAT "%5.0"
 /begin AXIS_DESCR STD_AXIS CEngDsT_t Temp_Cels 10 -3549.940 3003.560 FORMAT "%8.3" DEPOSIT ABSOLUTE /end AXIS_DESCR
 /begin AXIS_DESCR STD_AXIS CEngDsT_tStrt Temp_Cels 6 -3549.940 3003.560 FORMAT "%8.3" DEPOSIT ABSOLUTE /end AXIS_DESCR
/end CHARACTERISTIC
/begin CHARACTERISTIC KFTMHTDFS "Map for target idle speed, heating demand according to coolant temperature" MAP 0x80532178 RB_Map_S16S16_U8 2550. nmot_ub_q10 0.00 2550. FORMAT "%5.0"
 /begin AXIS_DESCR STD_AXIS CEngDsT_t Temp_Cels 10 -3549.940 3003.560 FORMAT "%8.3" DEPOSIT ABSOLUTE /end AXIS_DESCR
 /begin AXIS_DESCR STD_AXIS CEngDsT_tStrt Temp_Cels 6 -3549.940 3003.560 FORMAT "%8.3" DEPOSIT ABSOLUTE /end AXIS_DESCR
/end CHARACTERISTIC
/begin CHARACTERISTIC KFTOSPMVML "heating effect air mass flow and vehicle speed (model oil temperature in sump)" MAP 0x80532BC2 RB_Map_U16U8_S16 1.992188 fak_ub_b2 0.00 1.992188 FORMAT "%8.6" EXTENDED_LIMITS -256.0000 255.9922
 /begin AXIS_DESCR STD_AXIS mlwOilSwmpT m_uw_b6553p5 8 0.00 6553.500 FORMAT "%8.3" DEPOSIT ABSOLUTE /end AXIS_DESCR
 /begin AXIS_DESCR STD_AXIS vfzgOilSwmpT vfzg_ub_q1p25 8 0.00 318.8 FORMAT "%5.1" DEPOSIT ABSOLUTE /end AXIS_DESCR
/end CHARACTERISTIC
/begin CHARACTERISTIC KFTOSPMWC "weighting for calculation of the oil temperature out of coolant- and ambient air temperature" MAP 0x80532C5E RB_Map_U8U8_U8 1.000 fak_ub_q0p00392 0.00 1.000 FORMAT "%5.3"
 /begin AXIS_DESCR STD_AXIS tumgOilSwmpT temp_ub_q0p75_o48 8 -48.0 143.3 FORMAT "%5.1" DEPOSIT ABSOLUTE /end AXIS_DESCR
 /begin AXIS_DESCR STD_AXIS OilSwmpT_tWrmUp temp_ub_q0p75_o48 8 -48.0 143.3 FORMAT "%5.1" DEPOSIT ABSOLUTE /end AXIS_DESCR
/end CHARACTERISTIC
/begin CHARACTERISTIC KFTUMHTD "Map for target idle speed heating demand according to coolant temp and ambient temp." MAP 0x805321D8 RB_Map_S16S16_U8 2550. nmot_ub_q10 0.00 2550. FORMAT "%5.0"
 /begin AXIS_DESCR STD_AXIS CEngDsT_t Temp_Cels 10 -3549.940 3003.560 FORMAT "%8.3" DEPOSIT ABSOLUTE /end AXIS_DESCR
 /begin AXIS_DESCR STD_AXIS EnvT_t Temp_Cels 8 -3549.940 3003.560 FORMAT "%8.3" DEPOSIT ABSOLUTE /end AXIS_DESCR
/end CHARACTERISTIC
/begin CHARACTERISTIC KFTUMHTDFS "Map for target idle speed heating demand according to coolant temp and ambient temp. (B_fs = 1)" MAP 0x80532250 RB_Map_S16S16_U8 2550. nmot_ub_q10 0.00 2550. FORMAT "%5.0"
 /begin AXIS_DESCR STD_AXIS CEngDsT_t Temp_Cels 10 -3549.940 3003.560 FORMAT "%8.3" DEPOSIT ABSOLUTE /end AXIS_DESCR
 /begin AXIS_DESCR STD_AXIS EnvT_t Temp_Cels 6 -3549.940 3003.560 FORMAT "%8.3" DEPOSIT ABSOLUTE /end AXIS_DESCR
/end CHARACTERISTIC
/begin CHARACTERISTIC KLNLLKHAGE "weighting of desired nominal idling speed during catalyst heating in dependence of catalyst ageing" CURVE 0x80532AF2 RB_Curve_U16_U16 1.999969 fak_uw_b2 0.00 1.999969 FORMAT "%8.6"
 /begin AXIS_DESCR STD_AXIS ExhMgT_facWghtCatAge fak_uw_b2 4 0.00 1.999969 FORMAT "%8.6" DEPOSIT ABSOLUTE /end AXIS_DESCR
/end CHARACTERISTIC
/begin CHARACTERISTIC KLRSDKSST "characteristic line reset throttle conrol for start" CURVE 0x8052FF9E RB_Curve_S16_S16 32767.50 EngN -16384.00 16383.50 FORMAT "%8.2"
 /begin AXIS_DESCR STD_AXIS EngStrt_tStrtCoor Temp_Cels 4 -273.140 3003.560 FORMAT "%8.3" EXTENDED_LIMITS -3549.940 3003.560 DEPOSIT ABSOLUTE /end AXIS_DESCR
/end CHARACTERISTIC
/begin CHARACTERISTIC KLTOSPM_N "heating effect engine speed (model oil temperature in sump)" CURVE 0x80532CB0 RB_Curve_U8_U8 1.992188 fak_ub_b2 0.00 1.992188 FORMAT "%8.6"
 /begin AXIS_DESCR STD_AXIS nmotOilSwmpT nmot_ub_q40 7 0.00 10200. FORMAT "%5.0" DEPOSIT ABSOLUTE /end AXIS_DESCR
/end CHARACTERISTIC
/begin CHARACTERISTIC KLTOSPM_TU "heating effect ambient temperature (model oil temperature in sump)" CURVE 0x80532CBF RB_Curve_U8_U8 1.992188 fak_ub_b2 0.00 1.992188 FORMAT "%8.6"
 /begin AXIS_DESCR STD_AXIS tumgOilSwmpT temp_ub_q0p75_o48 8 -48.0 143.3 FORMAT "%5.1" DEPOSIT ABSOLUTE /end AXIS_DESCR
/end CHARACTERISTIC
/begin CHARACTERISTIC KLTSSDKSST "characteristic line reset throttle conrol for start" CURVE 0x8052FFB0 RB_Curve_S16_U16_Static 655.3500 t_q0p01 0.00 655.3500 FORMAT "%8.4"
 /begin AXIS_DESCR STD_AXIS EngStrt_tStrtCoor Temp_Cels 4 -273.140 3003.560 FORMAT "%8.3" EXTENDED_LIMITS -3549.940 3003.560 DEPOSIT ABSOLUTE /end AXIS_DESCR
/end CHARACTERISTIC
/begin CHARACTERISTIC KLTSWITCH "control of time constant (model oil temperature in sump)" CURVE 0x80532CD0 RB_Curve_U8_U8 254.0 t_q1 1.0 255.0 FORMAT "%5.1" EXTENDED_LIMITS 0.00 255.0
 /begin AXIS_DESCR STD_AXIS nmotOilSwmpT nmot_ub_q40 3 0.00 10200. FORMAT "%5.0" DEPOSIT ABSOLUTE /end AXIS_DESCR
/end CHARACTERISTIC
/begin CHARACTERISTIC KLTTOSPM1 "time constant heating (model oil temperature in sump)" CURVE 0x80532CD8 RB_Curve_U8_S16_Static 32766.00 dez 1.00 32767.00 FORMAT "%8.2" EXTENDED_LIMITS -32768.00 32767.00
 /begin AXIS_DESCR STD_AXIS nmotOilSwmpT nmot_ub_q40 8 0.00 10200. FORMAT "%5.0" DEPOSIT ABSOLUTE /end AXIS_DESCR
/end CHARACTERISTIC
/begin CHARACTERISTIC KLTTOSPM2 "time constant cooling (model oil temperature in sump)" CURVE 0x80532CF2 RB_Curve_U8_S16_Static 32766.00 dez 1.00 32767.00 FORMAT "%8.2" EXTENDED_LIMITS -32768.00 32767.00
 /begin AXIS_DESCR STD_AXIS nmotOilSwmpT nmot_ub_q40 8 0.00 10200. FORMAT "%5.0" DEPOSIT ABSOLUTE /end AXIS_DESCR
/end CHARACTERISTIC
/begin CHARACTERISTIC KLWMSABST "correction desired standardised over critical air mass flow by soak time" CURVE 0x8052FFC2 RB_Curve_U16_U8_Static 1.992188 fak_ub_b2 0.00 1.992188 FORMAT "%8.6"
 /begin AXIS_DESCR STD_AXIS tabstloc_w t1sxs_uw_q1 4 0.00 65535.00 FORMAT "%8.2" DEPOSIT ABSOLUTE /end AXIS_DESCR
/end CHARACTERISTIC
/begin CHARACTERISTIC MFAIRSTRT_BASE.mfAirAccrPed_GM "Class instance for desired air mass flow at start / Offset grouped map desired standardised over critical air mass flow requested by the driver" MAP 0x805305E4 RB_MapGroup_U16 6553.500 m_uw_b6553p5 0.00 6553.500 FORMAT "%8.3"
 /begin AXIS_DESCR COM_AXIS APP_r Prc 10 -400.0000 399.9878 FORMAT "%8.4" AXIS_PTS_REF EngStrt_rPedAirPth_AX /end AXIS_DESCR
 /begin AXIS_DESCR COM_AXIS Epm_nEng10ms EngN 4 -16384.00 16383.50 FORMAT "%8.2" AXIS_PTS_REF EngStrt_nEngAirPth_AX /end AXIS_DESCR
/end CHARACTERISTIC
/begin CHARACTERISTIC MFAIRSTRT_BASE.mfAirBaseNrInj_GM "Class instance for desired air mass flow at start / Number of Injections" MAP 0x80530634 RB_MapGroup_U16 6553.500 m_uw_b6553p5 0.00 6553.500 FORMAT "%8.3"
 /begin AXIS_DESCR COM_AXIS EngStrt_tStrtCoor Temp_Cels 12 -273.140 3003.560 FORMAT "%8.3" EXTENDED_LIMITS -3549.940 3003.560 AXIS_PTS_REF EngStrt_tStrtAirPth_AX /end AXIS_DESCR
 /begin AXIS_DESCR COM_AXIS EngStrt_nrInjAirPth OneToOne 8 0.00 255.0 FORMAT "%5.1" AXIS_PTS_REF EngStrt_nrInjAirPth_AX /end AXIS_DESCR
/end CHARACTERISTIC
/begin CHARACTERISTIC MFAIRSTRT_BASE.mfAirCatHeatg_GM "Class instance for desired air mass flow at start / Map air mass flow at start during catalyst heating" MAP 0x805306F4 RB_MapGroup_U16 6553.500 m_uw_b6553p5 0.00 6553.500 FORMAT "%8.3"
 /begin AXIS_DESCR COM_AXIS EngStrt_tStrtCoor Temp_Cels 12 -273.140 3003.560 FORMAT "%8.3" EXTENDED_LIMITS -3549.940 3003.560 AXIS_PTS_REF EngStrt_tStrtAirPth_AX /end AXIS_DESCR
 /begin AXIS_DESCR COM_AXIS Epm_nEng10ms EngN 4 -16384.00 16383.50 FORMAT "%8.2" AXIS_PTS_REF EngStrt_nEngAirPth_AX /end AXIS_DESCR
/end CHARACTERISTIC
/begin CHARACTERISTIC MFAIRSTRT_BASE.mfAir_GM "Class instance for desired air mass flow at start / Map air mass flow at start" MAP 0x80530754 RB_MapGroup_U16 6553.500 m_uw_b6553p5 0.00 6553.500 FORMAT "%8.3"
 /begin AXIS_DESCR COM_AXIS EngStrt_tStrtCoor Temp_Cels 12 -273.140 3003.560 FORMAT "%8.3" EXTENDED_LIMITS -3549.940 3003.560 AXIS_PTS_REF EngStrt_tStrtAirPth_AX /end AXIS_DESCR
 /begin AXIS_DESCR COM_AXIS Epm_nEng10ms EngN 4 -16384.00 16383.50 FORMAT "%8.2" AXIS_PTS_REF EngStrt_nEngAirPth_AX /end AXIS_DESCR
/end CHARACTERISTIC
/begin CHARACTERISTIC MFAIRSTRT_COM.mfAirAccrPed_GM " / Offset grouped map desired standardised over critical air mass flow requested by the driver" MAP 0x8053002C RB_MapGroup_U16 6553.500 m_uw_b6553p5 0.00 6553.500 FORMAT "%8.3"
 /begin AXIS_DESCR COM_AXIS APP_r Prc 10 -400.0000 399.9878 FORMAT "%8.4" AXIS_PTS_REF EngStrt_rPedAirPth_AX /end AXIS_DESCR
 /begin AXIS_DESCR COM_AXIS Epm_nEng10ms EngN 4 -16384.00 16383.50 FORMAT "%8.2" AXIS_PTS_REF EngStrt_nEngAirPth_AX /end AXIS_DESCR
/end CHARACTERISTIC
/begin CHARACTERISTIC MFAIRSTRT_COM.mfAirBaseNrInj_GM " / Number of Injections" MAP 0x8053007C RB_MapGroup_U16 6553.500 m_uw_b6553p5 0.00 6553.500 FORMAT "%8.3"
 /begin AXIS_DESCR COM_AXIS EngStrt_tStrtCoor Temp_Cels 12 -273.140 3003.560 FORMAT "%8.3" EXTENDED_LIMITS -3549.940 3003.560 AXIS_PTS_REF EngStrt_tStrtAirPth_AX /end AXIS_DESCR
 /begin AXIS_DESCR COM_AXIS EngStrt_nrInjAirPth OneToOne 8 0.00 255.0 FORMAT "%5.1" AXIS_PTS_REF EngStrt_nrInjAirPth_AX /end AXIS_DESCR
/end CHARACTERISTIC
/begin CHARACTERISTIC MFAIRSTRT_COM.mfAirCatHeatg_GM " / Map air mass flow at start during catalyst heating" MAP 0x8053013C RB_MapGroup_U16 6553.500 m_uw_b6553p5 0.00 6553.500 FORMAT "%8.3"
 /begin AXIS_DESCR COM_AXIS EngStrt_tStrtCoor Temp_Cels 12 -273.140 3003.560 FORMAT "%8.3" EXTENDED_LIMITS -3549.940 3003.560 AXIS_PTS_REF EngStrt_tStrtAirPth_AX /end AXIS_DESCR
 /begin AXIS_DESCR COM_AXIS Epm_nEng10ms EngN 4 -16384.00 16383.50 FORMAT "%8.2" AXIS_PTS_REF EngStrt_nEngAirPth_AX /end AXIS_DESCR
/end CHARACTERISTIC
/begin CHARACTERISTIC MFAIRSTRT_COM.mfAir_GM " / Map air mass flow at start" MAP 0x8053019C RB_MapGroup_U16 6553.500 m_uw_b6553p5 0.00 6553.500 FORMAT "%8.3"
 /begin AXIS_DESCR COM_AXIS EngStrt_tStrtCoor Temp_Cels 12 -273.140 3003.560 FORMAT "%8.3" EXTENDED_LIMITS -3549.940 3003.560 AXIS_PTS_REF EngStrt_tStrtAirPth_AX /end AXIS_DESCR
 /begin AXIS_DESCR COM_AXIS Epm_nEng10ms EngN 4 -16384.00 16383.50 FORMAT "%8.2" AXIS_PTS_REF EngStrt_nEngAirPth_AX /end AXIS_DESCR
/end CHARACTERISTIC
/begin CHARACTERISTIC MFAIRSTRT_COMWAITSTRTR.mfAirAccrPed_GM " / Offset grouped map desired standardised over critical air mass flow requested by the driver" MAP 0x80530200 RB_MapGroup_U16 6553.500 m_uw_b6553p5 0.00 6553.500 FORMAT "%8.3"
 /begin AXIS_DESCR COM_AXIS APP_r Prc 10 -400.0000 399.9878 FORMAT "%8.4" AXIS_PTS_REF EngStrt_rPedAirPth_AX /end AXIS_DESCR
 /begin AXIS_DESCR COM_AXIS Epm_nEng10ms EngN 4 -16384.00 16383.50 FORMAT "%8.2" AXIS_PTS_REF EngStrt_nEngAirPth_AX /end AXIS_DESCR
/end CHARACTERISTIC
/begin CHARACTERISTIC MFAIRSTRT_COMWAITSTRTR.mfAirBaseNrInj_GM " / Number of Injections" MAP 0x80530250 RB_MapGroup_U16 6553.500 m_uw_b6553p5 0.00 6553.500 FORMAT "%8.3"
 /begin AXIS_DESCR COM_AXIS EngStrt_tStrtCoor Temp_Cels 12 -273.140 3003.560 FORMAT "%8.3" EXTENDED_LIMITS -3549.940 3003.560 AXIS_PTS_REF EngStrt_tStrtAirPth_AX /end AXIS_DESCR
 /begin AXIS_DESCR COM_AXIS EngStrt_nrInjAirPth OneToOne 8 0.00 255.0 FORMAT "%5.1" AXIS_PTS_REF EngStrt_nrInjAirPth_AX /end AXIS_DESCR
/end CHARACTERISTIC
/begin CHARACTERISTIC MFAIRSTRT_COMWAITSTRTR.mfAirCatHeatg_GM " / Map air mass flow at start during catalyst heating" MAP 0x80530310 RB_MapGroup_U16 6553.500 m_uw_b6553p5 0.00 6553.500 FORMAT "%8.3"
 /begin AXIS_DESCR COM_AXIS EngStrt_tStrtCoor Temp_Cels 12 -273.140 3003.560 FORMAT "%8.3" EXTENDED_LIMITS -3549.940 3003.560 AXIS_PTS_REF EngStrt_tStrtAirPth_AX /end AXIS_DESCR
 /begin AXIS_DESCR COM_AXIS Epm_nEng10ms EngN 4 -16384.00 16383.50 FORMAT "%8.2" AXIS_PTS_REF EngStrt_nEngAirPth_AX /end AXIS_DESCR
/end CHARACTERISTIC
/begin CHARACTERISTIC MFAIRSTRT_COMWAITSTRTR.mfAir_GM " / Map air mass flow at start" MAP 0x80530370 RB_MapGroup_U16 6553.500 m_uw_b6553p5 0.00 6553.500 FORMAT "%8.3"
 /begin AXIS_DESCR COM_AXIS EngStrt_tStrtCoor Temp_Cels 12 -273.140 3003.560 FORMAT "%8.3" EXTENDED_LIMITS -3549.940 3003.560 AXIS_PTS_REF EngStrt_tStrtAirPth_AX /end AXIS_DESCR
 /begin AXIS_DESCR COM_AXIS Epm_nEng10ms EngN 4 -16384.00 16383.50 FORMAT "%8.2" AXIS_PTS_REF EngStrt_nEngAirPth_AX /end AXIS_DESCR
/end CHARACTERISTIC
/begin CHARACTERISTIC MFAIRSTRT_FOLW.mfAirAccrPed_GM " / Offset grouped map desired standardised over critical air mass flow requested by the driver" MAP 0x805303D4 RB_MapGroup_U16 6553.500 m_uw_b6553p5 0.00 6553.500 FORMAT "%8.3"
 /begin AXIS_DESCR COM_AXIS APP_r Prc 10 -400.0000 399.9878 FORMAT "%8.4" AXIS_PTS_REF EngStrt_rPedAirPth_AX /end AXIS_DESCR
 /begin AXIS_DESCR COM_AXIS Epm_nEng10ms EngN 4 -16384.00 16383.50 FORMAT "%8.2" AXIS_PTS_REF EngStrt_nEngAirPth_AX /end AXIS_DESCR
/end CHARACTERISTIC
/begin CHARACTERISTIC MFAIRSTRT_FOLW.mfAirBaseNrInj_GM " / Number of Injections" MAP 0x80530424 RB_MapGroup_U16 6553.500 m_uw_b6553p5 0.00 6553.500 FORMAT "%8.3"
 /begin AXIS_DESCR COM_AXIS EngStrt_tStrtCoor Temp_Cels 12 -273.140 3003.560 FORMAT "%8.3" EXTENDED_LIMITS -3549.940 3003.560 AXIS_PTS_REF EngStrt_tStrtAirPth_AX /end AXIS_DESCR
 /begin AXIS_DESCR COM_AXIS EngStrt_nrInjAirPth OneToOne 8 0.00 255.0 FORMAT "%5.1" AXIS_PTS_REF EngStrt_nrInjAirPth_AX /end AXIS_DESCR
/end CHARACTERISTIC
/begin CHARACTERISTIC MFAIRSTRT_FOLW.mfAirCatHeatg_GM " / Map air mass flow at start during catalyst heating" MAP 0x805304E4 RB_MapGroup_U16 6553.500 m_uw_b6553p5 0.00 6553.500 FORMAT "%8.3"
 /begin AXIS_DESCR COM_AXIS EngStrt_tStrtCoor Temp_Cels 12 -273.140 3003.560 FORMAT "%8.3" EXTENDED_LIMITS -3549.940 3003.560 AXIS_PTS_REF EngStrt_tStrtAirPth_AX /end AXIS_DESCR
 /begin AXIS_DESCR COM_AXIS Epm_nEng10ms EngN 4 -16384.00 16383.50 FORMAT "%8.2" AXIS_PTS_REF EngStrt_nEngAirPth_AX /end AXIS_DESCR
/end CHARACTERISTIC
/begin CHARACTERISTIC MFAIRSTRT_FOLW.mfAir_GM " / Map air mass flow at start" MAP 0x80530544 RB_MapGroup_U16 6553.500 m_uw_b6553p5 0.00 6553.500 FORMAT "%8.3"
 /begin AXIS_DESCR COM_AXIS EngStrt_tStrtCoor Temp_Cels 12 -273.140 3003.560 FORMAT "%8.3" EXTENDED_LIMITS -3549.940 3003.560 AXIS_PTS_REF EngStrt_tStrtAirPth_AX /end AXIS_DESCR
 /begin AXIS_DESCR COM_AXIS Epm_nEng10ms EngN 4 -16384.00 16383.50 FORMAT "%8.2" AXIS_PTS_REF EngStrt_nEngAirPth_AX /end AXIS_DESCR
/end CHARACTERISTIC
/begin CHARACTERISTIC MFAIRWAIT_STRTR.mfAirWait_GM "Class instance for desired air mass flow between start request and start beginning / Grouped map Air mass flow between start request and start beginning" MAP 0x805307B8 RB_MapGroup_U16 6553.500 m_uw_b6553p5 0.00 6553.500 FORMAT "%8.3"
 /begin AXIS_DESCR COM_AXIS EngStrt_tStrtCoor Temp_Cels 12 -273.140 3003.560 FORMAT "%8.3" EXTENDED_LIMITS -3549.940 3003.560 AXIS_PTS_REF EngStrt_tStrtAirPth_AX /end AXIS_DESCR
 /begin AXIS_DESCR COM_AXIS Epm_nEng10ms EngN 4 -16384.00 16383.50 FORMAT "%8.2" AXIS_PTS_REF EngStrt_nEngAirPth_AX /end AXIS_DESCR
/end CHARACTERISTIC
/begin CHARACTERISTIC Mo_cwMstSlave_C "Codeword master-slave configuration in function monitoring" VALUE 0x8053BD2E Val_Wu8 255.0 OneToOne 0.00 255.0 FORMAT "%5.1" /end CHARACTERISTIC
/begin CHARACTERISTIC Mo_stSwtHyb_C "code word for hybrid vehicle in the function monitoring" VALUE 0x8053BD2F Val_Wu8 255.0 OneToOne 0.00 255.0 FORMAT "%5.1" /end CHARACTERISTIC
/begin CHARACTERISTIC Mo_swtClrCntrMax_C "Condition reset drag counter in function monitoring" VALUE 0x8053CD2A Val_Wu8 255.0 OneToOne 0.00 255.0 FORMAT "%5.1" /end CHARACTERISTIC
/begin CHARACTERISTIC Mo_swtCyclCalUpdt_C "Switch to update level 2 calibration messages for level 1" VALUE 0x8053BD30 Val_Wu8 255.0 OneToOne 0.00 255.0 FORMAT "%5.1" /end CHARACTERISTIC
/begin CHARACTERISTIC Mo_trqIdcMax_C "Maximum of inner engine torque from ECU monitoring package." VALUE 0x8053CADE Val_Ws16 3276.600 md_q0p1 0.100 3276.700 FORMAT "%8.3" EXTENDED_LIMITS -3276.800 3276.700 /end CHARACTERISTIC
/begin CHARACTERISTIC MRly_VD_BattuMax_C "Maximum Valid Battery voltage" VALUE 0x8052FE50 RB_Val_Ws16 65.53500 spg_q0p001 -32.76800 32.76700 FORMAT "%8.5" /end CHARACTERISTIC
/begin CHARACTERISTIC MRly_VD_BattuMin_C "Minimum Valid Battery voltage check" VALUE 0x8052FE52 RB_Val_Ws16 65.53500 spg_q0p001 -32.76800 32.76700 FORMAT "%8.5" /end CHARACTERISTIC
/begin CHARACTERISTIC MRly_VD_SCB_OL_Plaus_Enable_C "Plausibility Enable check between SCB and OL" VALUE 0x8052FE54 RB_Val_Wboolean 1.00000000000 B_TRUE 0.00 1.00000000000 FORMAT "%13.11" /end CHARACTERISTIC
/begin CHARACTERISTIC MRly_VD_SCB_OL_Plaus_Threshold_C "SCB and OL Plausibility Threshold" VALUE 0x8052FE55 RB_Val_Wu8 255.0 OneToOne 0.00 255.0 FORMAT "%5.1" /end CHARACTERISTIC
/begin CHARACTERISTIC MSUDKSNLN "desired standardised over critical air mass flow at KL15 off" CURVE 0x8052FFD0 RB_Curve_S16_U16_Static 6553.500 m_uw_b6553p5 0.00 6553.500 FORMAT "%8.3"
 /begin AXIS_DESCR STD_AXIS Epm_nEng10ms EngN 8 -16384.00 16383.50 FORMAT "%8.2" DEPOSIT ABSOLUTE /end AXIS_DESCR
/end CHARACTERISTIC
/begin CHARACTERISTIC NFSKS "Target engine speed for preventiong boiling (B_fs=1)" VALUE 0x80532114 RB_Val_Wu8 2550. nmot_ub_q10 0.00 2550. FORMAT "%5.0" /end CHARACTERISTIC
/begin CHARACTERISTIC NFSNLDG "Target-speed increase for speed-sensor limp-home" VALUE 0x80532B14 RB_Val_Wu8 2550. nmot_q10 0.00 2550. FORMAT "%5.0" /end CHARACTERISTIC
/begin CHARACTERISTIC NSHLL "Minimal target speed for hot idling" VALUE 0x805322DC RB_Val_Wu8 2550. nmot_q10 0.00 2550. FORMAT "%5.0" /end CHARACTERISTIC
/begin CHARACTERISTIC NSHTI_facCorrnAltiAmbTAvdNvhDrvg_M "Correction factor based on altitude and ambient temperature to avoid noise, vibration and harshness during driving." MAP 0x805322DE RB_Map_U16S16_U16 3.999939 fak_uw_b4 0.00 3.999939 FORMAT "%8.6"
 /begin AXIS_DESCR STD_AXIS PEnv_facCorrAlti fak_uw_b4 8 0.00 3.999939 FORMAT "%8.6" DEPOSIT ABSOLUTE /end AXIS_DESCR
 /begin AXIS_DESCR STD_AXIS EnvT_t Temp_Cels 8 -3549.940 3003.560 FORMAT "%8.3" DEPOSIT ABSOLUTE /end AXIS_DESCR
/end CHARACTERISTIC
/begin CHARACTERISTIC NSHTI_facCorrnAltiAmbTAvdNvh_M "Correction factor based on altitude and ambient temperature to avoid noise, vibration and harshness when vehicle is in parking or neutral position." MAP 0x80532382 RB_Map_U16S16_U16 3.999939 fak_uw_b4 0.00 3.999939 FORMAT "%8.6"
 /begin AXIS_DESCR STD_AXIS PEnv_facCorrAlti fak_uw_b4 8 0.00 3.999939 FORMAT "%8.6" DEPOSIT ABSOLUTE /end AXIS_DESCR
 /begin AXIS_DESCR STD_AXIS EnvT_t Temp_Cels 8 -3549.940 3003.560 FORMAT "%8.3" DEPOSIT ABSOLUTE /end AXIS_DESCR
/end CHARACTERISTIC
/begin CHARACTERISTIC NSHTI_facCorrnEngTAvdNvhDrvg_T "Correction factor based on engine temperature to avoid noise, vibration and harshness during driving." CURVE 0x80532426 RB_Curve_S16_U16_Static 3.999939 fak_uw_b4 0.00 3.999939 FORMAT "%8.6"
 /begin AXIS_DESCR STD_AXIS CEngDsT_t Temp_Cels 8 -3549.940 3003.560 FORMAT "%8.3" DEPOSIT ABSOLUTE /end AXIS_DESCR
/end CHARACTERISTIC
/begin CHARACTERISTIC NSHTI_facCorrnEngTAvdNvh_T "Correction factor based on engine temperature to avoid noise, vibration and harshness when vehicle is in parking or neutral position." CURVE 0x80532448 RB_Curve_S16_U16_Static 3.999939 fak_uw_b4 0.00 3.999939 FORMAT "%8.6"
 /begin AXIS_DESCR STD_AXIS CEngDsT_t Temp_Cels 8 -3549.940 3003.560 FORMAT "%8.3" DEPOSIT ABSOLUTE /end AXIS_DESCR
/end CHARACTERISTIC
/begin CHARACTERISTIC NSHTI_facCorrnOffsDrvg_C "Correction factor offset during driving" VALUE 0x8053246A RB_Val_Wu16 3.999939 fak_uw_b4 0.00 3.999939 FORMAT "%8.6" /end CHARACTERISTIC
/begin CHARACTERISTIC NSHTI_facCorrnOffs_C "Correction factor offset" VALUE 0x8053246C RB_Val_Wu16 3.999939 fak_uw_b4 0.00 3.999939 FORMAT "%8.6" /end CHARACTERISTIC
/begin CHARACTERISTIC NSHTI_flgStgySeln_C "Parameter for selecting filtered or unfiltered speed" VALUE 0x8053246E RB_Val_Wu8 1.00000000000 B_TRUE 0.00 1.00000000000 FORMAT "%13.11" /end CHARACTERISTIC
/begin CHARACTERISTIC NSHTI_nHiAltiAvdNvhLoIdleSpDrvg_T "Low idle set point at high altitude to avoid Noise, vibration and harshness during driving which is dependent on correction factor" CURVE 0x80532470 RB_Curve_U16_U16 2550.000 nmot_q10 0.00 2550.000 FORMAT "%8.3" EXTENDED_LIMITS 0.00 655350.0
 /begin AXIS_DESCR STD_AXIS NSHTI_facCorrnHiAltiAvdNvhDrvg fak_uw_b4 16 0.00 3.999939 FORMAT "%8.6" DEPOSIT ABSOLUTE /end AXIS_DESCR
/end CHARACTERISTIC
/begin CHARACTERISTIC NSHTI_nHiAltiAvdNvhLoIdleSp_T "Low idle set point at high altitude to avoid Noise, vibration and harshness when vehicle is in parking or neutral position and this is dependent on correction factor." CURVE 0x805324B2 RB_Curve_U16_U16 2550.000 nmot_q10 0.00 2550.000 FORMAT "%8.3" EXTENDED_LIMITS 0.00 655350.0
 /begin AXIS_DESCR STD_AXIS NSHTI_facCorrnHiAltiAvdNvh fak_uw_b4 16 0.00 3.999939 FORMAT "%8.6" DEPOSIT ABSOLUTE /end AXIS_DESCR
/end CHARACTERISTIC
/begin CHARACTERISTIC NSHTI_nLimHiAltiFwdDrvgLoIdleSp_M "Low idle set point limitation at high altitude during forward driving which is dependent on vehicle velocity and altitue factor" MAP 0x805324F4 RB_Map_U16S16_U8 2550. nmot_ub_q10 0.00 2550. FORMAT "%5.0"
 /begin AXIS_DESCR STD_AXIS PEnv_facCorrAlti fak_uw_b4 8 0.00 3.999939 FORMAT "%8.6" DEPOSIT ABSOLUTE /end AXIS_DESCR
 /begin AXIS_DESCR STD_AXIS VehV_v Vel 8 -327.6800 327.6700 FORMAT "%8.4" DEPOSIT ABSOLUTE /end AXIS_DESCR
/end CHARACTERISTIC
/begin CHARACTERISTIC NSHTI_nLimHiAltiRvsCrpLoIdleSp_M "Low idle set point limitation at high altitude during reverse creeping which is dependent on vehicle velocity and altitue factor" MAP 0x80532558 RB_Map_U16S16_U8 2550. nmot_ub_q10 0.00 2550. FORMAT "%5.0"
 /begin AXIS_DESCR STD_AXIS PEnv_facCorrAlti fak_uw_b4 8 0.00 3.999939 FORMAT "%8.6" DEPOSIT ABSOLUTE /end AXIS_DESCR
 /begin AXIS_DESCR STD_AXIS VehV_v Vel 8 -327.6800 327.6700 FORMAT "%8.4" DEPOSIT ABSOLUTE /end AXIS_DESCR
/end CHARACTERISTIC
/begin CHARACTERISTIC NSKS "Targen speed to prevent boiling" VALUE 0x80532115 RB_Val_Wu8 2550. nmot_ub_q10 0.00 2550. FORMAT "%5.0" /end CHARACTERISTIC
/begin CHARACTERISTIC NSNLDG "Target-speed increase for speed-sensor limp-home" VALUE 0x80532B15 RB_Val_Wu8 2550. nmot_q10 0.00 2550. FORMAT "%5.0" /end CHARACTERISTIC
/begin CHARACTERISTIC NSNOT "Target engine speed while by throtle inadequacy" VALUE 0x80532B16 RB_Val_Wu8 2550. nmot_q10 0.00 2550. FORMAT "%5.0" /end CHARACTERISTIC
/begin CHARACTERISTIC NSPTS_nIdleAftStrtDrvg_GM "idle speed after start for B_fs=1(Drive mode)" MAP 0x80532B45 RB_MapGroup_U8 2550. nmot_ub_q10 0.00 2550. FORMAT "%5.0"
 /begin AXIS_DESCR COM_AXIS NSPTS_tnstloc t1sxs_ub_b255 6 0.00 255.0 FORMAT "%5.1" AXIS_PTS_REF STN06LLUB_NSPTS /end AXIS_DESCR
 /begin AXIS_DESCR COM_AXIS NSPTS_tmotloc temp_ub_q0p75_o48 6 -24624.00 24527.25 FORMAT "%8.2" AXIS_PTS_REF STM06LLUB_NSPTS /end AXIS_DESCR
/end CHARACTERISTIC
/begin CHARACTERISTIC NSTOEL "idle speed reference: engine oil overheat" CURVE 0x805325BC RB_Curve_U8_U8 2550. nmot_q10 0.00 2550. FORMAT "%5.0"
 /begin AXIS_DESCR STD_AXIS toellrns temp_ub_q1_o60 8 -60.0 195.0 FORMAT "%5.1" DEPOSIT ABSOLUTE /end AXIS_DESCR
/end CHARACTERISTIC
/begin CHARACTERISTIC NTUM "Target idle RPM in case of low ambient temperature (B_fs=0)" VALUE 0x805322B0 RB_Val_Wu8 2550. nmot_ub_q10 0.00 2550. FORMAT "%5.0" /end CHARACTERISTIC
/begin CHARACTERISTIC NTUMFS "Target idle RPM in case of low ambient temperature (B_fs=1)" VALUE 0x805322B1 RB_Val_Wu8 2550. nmot_ub_q10 0.00 2550. FORMAT "%5.0" /end CHARACTERISTIC
/begin CHARACTERISTIC NWDKSSTKL "curve threshold for deactivation desired throttle position without torque structur" CURVE 0x8052FFF2 RB_Curve_S16_S16 32767.50 EngN -16384.00 16383.50 FORMAT "%8.2"
 /begin AXIS_DESCR STD_AXIS EngStrt_tStrtCoor Temp_Cels 6 -273.140 3003.560 FORMAT "%8.3" EXTENDED_LIMITS -3549.940 3003.560 DEPOSIT ABSOLUTE /end AXIS_DESCR
/end CHARACTERISTIC
/begin CHARACTERISTIC NZHDTL "Speed threshold for decrementing time counter for hot idling" CURVE 0x805325CD RB_Curve_U8_U8 10200. nmot_ub_q40 0.00 10200. FORMAT "%5.0"
 /begin AXIS_DESCR STD_AXIS NSHTI_rlloc rel_ub_q0p75 6 0.00 191.3 FORMAT "%5.1" DEPOSIT ABSOLUTE /end AXIS_DESCR
/end CHARACTERISTIC
/begin CHARACTERISTIC NZHITL "Speed threshold for incrementing time counter for hot idling" CURVE 0x805325DA RB_Curve_U8_U8 10200. nmot_ub_q40 0.00 10200. FORMAT "%5.0"
 /begin AXIS_DESCR STD_AXIS NSHTI_rlloc rel_ub_q0p75 6 0.00 191.3 FORMAT "%5.1" DEPOSIT ABSOLUTE /end AXIS_DESCR
/end CHARACTERISTIC
/begin CHARACTERISTIC OCWDA_ctDebActvErr_C "Debouncing time of Error active condition" VALUE 0x80532B80 RB_Val_Wu8 255.0 OneToOne 0.00 255.0 FORMAT "%5.1" /end CHARACTERISTIC
/begin CHARACTERISTIC OCWDA_ctDebOvrVltgOn_C "Debouncing time of overvoltage diagnosis" VALUE 0x80532B82 RB_Val_Wu16 65535.00 OneToOne 0.00 65535.00 FORMAT "%8.2" /end CHARACTERISTIC
/begin CHARACTERISTIC OCWDA_stErrSimn_C "Failure simulation of overvoltage, undervoltage, WDA communication errors, error pin activation (0: no error simulation active)" VALUE 0x80532B84 RB_Val_Wu8 8.00000000000 OCWDA_stErrSimn_C_compu_VERB 0.00 8.00000000000 FORMAT "%13.11" /end CHARACTERISTIC
/begin CHARACTERISTIC OCWDA_swtOffRst_C "Deactivation of error reaction (reset), if signal gets inactive once it was recognized as active." VALUE 0x80532B85 RB_Val_Wu8 1.00000000000 OCWDA_swtOffRst_C_compu_VERB 0.00 1.00000000000 FORMAT "%13.11" /end CHARACTERISTIC
/begin CHARACTERISTIC OilSwmpT_dtMdlElecDrv_MAP "The characteristic field to calculate the gradient of model temperature in operating state Engine off, ECU on" MAP 0x80532D0C RB_Map_S16U8_S16 1535.977 temp_q0p0234 -768.0000 767.9766 FORMAT "%8.4"
 /begin AXIS_DESCR STD_AXIS OilSwmpT_tdiffElecDrv temp_q0p0234_o273 5 -273.1500 494.8266 FORMAT "%8.4" EXTENDED_LIMITS -1041.150 494.8266 DEPOSIT ABSOLUTE /end AXIS_DESCR
 /begin AXIS_DESCR STD_AXIS vfzgOilSwmpT vfzg_ub_q1p25 5 0.00 318.8 FORMAT "%5.1" DEPOSIT ABSOLUTE /end AXIS_DESCR
/end CHARACTERISTIC
/begin CHARACTERISTIC OilSwmpT_dtMdlSnsrMax_C "upper difference with comparison sensor and model value" VALUE 0x80532B94 RB_Val_Ws16 6553.500 Temp_Cels -3549.940 3003.560 FORMAT "%8.3" /end CHARACTERISTIC
/begin CHARACTERISTIC OilSwmpT_dtMdlSnsrMin_C "lower difference with comparison sensor and model value" VALUE 0x80532B96 RB_Val_Ws16 6553.500 Temp_Cels -3549.940 3003.560 FORMAT "%8.3" /end CHARACTERISTIC
/begin CHARACTERISTIC OilSwmpT_facHeatgWrmEnvT_M "influence factor dependign on environment temperature and coolant temperature" MAP 0x80532D52 RB_Map_U8U16_U8 1.992 fak_q0p0078 0.00 1.992 FORMAT "%5.3"
 /begin AXIS_DESCR STD_AXIS tumgOilSwmpT temp_ub_q0p75_o48 8 -48.0 143.3 FORMAT "%5.1" DEPOSIT ABSOLUTE /end AXIS_DESCR
 /begin AXIS_DESCR STD_AXIS OilSwmpT_tWrmUpFild temp_ub_q0p75_o48 12 -48.0000 143.2500 FORMAT "%8.4" EXTENDED_LIMITS -48.00000 49103.25 DEPOSIT ABSOLUTE /end AXIS_DESCR
/end CHARACTERISTIC
/begin CHARACTERISTIC OilSwmpT_facIntegElecDrv_C "Factor of the integrator in operating state Engine off, ECU on" VALUE 0x80532DD4 RB_Val_Wu16 0.9999847 fak_uw_b1 0.00 0.9999847 FORMAT "%9.7" /end CHARACTERISTIC
/begin CHARACTERISTIC OilSwmpT_facMdlElecDrv_T "factor for ambient temperature (model oil temperature in sump)" CURVE 0x80532DD6 RB_Curve_U8_U8 1.992188 fak_ub_b2 0.00 1.992188 FORMAT "%8.6"
 /begin AXIS_DESCR STD_AXIS tumgOilSwmpT temp_ub_q0p75_o48 8 -48.0 143.3 FORMAT "%5.1" DEPOSIT ABSOLUTE /end AXIS_DESCR
/end CHARACTERISTIC
/begin CHARACTERISTIC OilSwmpT_facMdlLdVVeh_MAP "Map: Effect of the vehicle velocity and coolant heat input to the oil temperature" MAP 0x80532DE8 RB_Map_S16U8_S16 1.992188 fak_ub_b2 0.00 1.992188 FORMAT "%8.6" EXTENDED_LIMITS -256.0000 255.9922
 /begin AXIS_DESCR STD_AXIS pwrClntEntryOilSwmpT pwr2 6 0.00 617643.4 FORMAT "%8.1" EXTENDED_LIMITS -617662.2 617643.4 DEPOSIT ABSOLUTE /end AXIS_DESCR
 /begin AXIS_DESCR STD_AXIS vfzgOilSwmpT vfzg_ub_q1p25 5 0.00 318.8 FORMAT "%5.1" DEPOSIT ABSOLUTE /end AXIS_DESCR
/end CHARACTERISTIC
/begin CHARACTERISTIC OilSwmpT_maskB_tospgg_C "calibration to indicate the signal quality mask for Oil temperature sensor" VALUE 0x80532B8C RB_Val_Wu32 4294967295.00 OneToOne 0.00 4294967295.00 FORMAT "%13.2" /end CHARACTERISTIC
/begin CHARACTERISTIC OilSwmpT_maskB_tospg_C "calibration to indicate the signal quality mask for Oil temperature sensor" VALUE 0x80532B90 RB_Val_Wu32 4294967295.00 OneToOne 0.00 4294967295.00 FORMAT "%13.2" /end CHARACTERISTIC
/begin CHARACTERISTIC OilSwmpT_maskEngTWrmUp_C "Calibration mask for oil temperature model to read the SQ-state of CEngDsT_t_Sq or CHdT_t_Sq" VALUE 0x80532E3A RB_Val_Wu16 65535.00 OneToOne 0.00 65535.00 FORMAT "%8.2" /end CHARACTERISTIC
/begin CHARACTERISTIC OilSwmpT_maskEnvTSq_C "calibration to indicate the signal quality mask for ambient temperature sensor" VALUE 0x80532B86 RB_Val_Wu16 65535.00 OneToOne 0.00 65535.00 FORMAT "%8.2" /end CHARACTERISTIC
/begin CHARACTERISTIC OilSwmpT_swtMdlPULSEna_C "release code word for model value use after sensor value comparison" VALUE 0x80532B98 RB_Val_Wu8 255.0 OneToOne 0.00 255.0 FORMAT "%5.1" /end CHARACTERISTIC
/begin CHARACTERISTIC OilSwmpT_swtMdlTAvl_C "Switch from which the status of the oil temperature model for the substitute value switch is valid" VALUE 0x80532B99 RB_Val_Wu8 1.000 OneToOne 0.00 1.000 FORMAT "%5.3" EXTENDED_LIMITS 0.00 255.0 /end CHARACTERISTIC
/begin CHARACTERISTIC OilSwmpT_swtPwrClntEntrySeln_C "Switch to select heat insertion of engine into coolant agent" VALUE 0x80532E3C RB_Val_Wu8 255.0 OneToOne 0.00 255.0 FORMAT "%5.1" /end CHARACTERISTIC
/begin CHARACTERISTIC OilSwmpT_swtTAmbVld_C "Switch to select validity of ambient temperature" VALUE 0x80532B88 RB_Val_Wu8 1.00000000000 B_TRUE 0.00 1.00000000000 FORMAT "%13.11" /end CHARACTERISTIC
/begin CHARACTERISTIC OilSwmpT_swtTSrcADCFrzDfl_C "Selection switch: OilSwmpT_tADC is freezed or set to the replacement value OilSwmpT_tADCDfl_C, if for a longer time OilSwmpT_flgSwmpTSnsrAvl_mp = FALSE." VALUE 0x80532B9A RB_Val_Wu8 1.000 OneToOne 0.00 1.000 FORMAT "%5.3" EXTENDED_LIMITS 0.00 255.0 /end CHARACTERISTIC
/begin CHARACTERISTIC OilSwmpT_swtTSrcADC_C "Switch: Source of replacement value for OilSwmpT_tADC" VALUE 0x80532B9B RB_Val_Wu8 255.0 OneToOne 0.00 255.0 FORMAT "%5.1" /end CHARACTERISTIC
/begin CHARACTERISTIC OilSwmpT_swtTSrcDispl_C "Switch: Source for OilSwmpT_tDispl" VALUE 0x80532B9C RB_Val_Wu8 255.0 OneToOne 0.00 255.0 FORMAT "%5.1" /end CHARACTERISTIC
/begin CHARACTERISTIC OilSwmpT_swtTSrcPULSFrzDfl_C "Selection switch: OilSwmpT_tPULS is frozen or set to the substitute value OilSwmpT_tPULSDfl_C, if OilSwmpT_flgCmbdSnsrAvl_mp = FALSE for a longer time" VALUE 0x80532B9D RB_Val_Wu8 1.000 OneToOne 0.00 1.000 FORMAT "%5.3" EXTENDED_LIMITS 0.00 255.0 /end CHARACTERISTIC
/begin CHARACTERISTIC OilSwmpT_swtTSrcPULS_C "Selection switch: Source of the oil temperature replacement value for OilSwmpT_tPULS" VALUE 0x80532B9E RB_Val_Wu8 255.0 OneToOne 0.00 255.0 FORMAT "%5.1" /end CHARACTERISTIC
/begin CHARACTERISTIC OilSwmpT_swtTSrc_C "Selection switch: Source of the oil temperature for OilSwmpT_t" VALUE 0x80532B9F RB_Val_Wu8 255.0 OneToOne 0.00 255.0 FORMAT "%5.1" /end CHARACTERISTIC
/begin CHARACTERISTIC OilSwmpT_tADCDfl_C "Default Oil Temperature of sensor connected on ADC" VALUE 0x80532BA0 RB_Val_Ws16 3276.700 Temp_Cels -273.140 3003.560 FORMAT "%8.3" EXTENDED_LIMITS -3549.940 3003.560 /end CHARACTERISTIC
/begin CHARACTERISTIC OilSwmpT_tDfl_C "Default Oil Temperature" VALUE 0x80532BA2 RB_Val_Ws16 3276.700 Temp_Cels -273.140 3003.560 FORMAT "%8.3" EXTENDED_LIMITS -3549.940 3003.560 /end CHARACTERISTIC
/begin CHARACTERISTIC OilSwmpT_tiCmbdSnsrFrzMax_C "timelimit for swiching of the stat mcahin from short time to long time without a valid signal" VALUE 0x80532BA4 RB_Val_Ws32 4294967295.00 Per_Dur -2147483648.00 2147483647.00 FORMAT "%13.2" /end CHARACTERISTIC
/begin CHARACTERISTIC OilSwmpT_tiElecDrv_C "Time constant of the Lowpass-Filters in operating state Engine off, ECU on" VALUE 0x80532E3E RB_Val_Wu16 65534.00 t_q1 1.00 65535.00 FORMAT "%8.2" EXTENDED_LIMITS 0.00 65535.00 /end CHARACTERISTIC
/begin CHARACTERISTIC OilSwmpT_tiTADCPT1_C "Filter time for the PT1_Filter for OilSwmpt_tADCFltd" VALUE 0x80532BA8 RB_Val_Ws32 4294.9672940000000 TimeDelay_s 0.0000020000000 4294.9672959999998 FORMAT "%19.14" EXTENDED_LIMITS 0.000002000000001 4294.9672959999998 /end CHARACTERISTIC
/begin CHARACTERISTIC OilSwmpT_tiTDisplPT1_C "Filter time for the PT1_Filter for OilSwmpt_tDisplFltd" VALUE 0x80532BAC RB_Val_Ws32 4294.9672940000000 TimeDelay_s 0.0000020000000 4294.9672959999998 FORMAT "%19.14" EXTENDED_LIMITS 0.000002000000001 4294.9672959999998 /end CHARACTERISTIC
/begin CHARACTERISTIC OilSwmpT_tiTOSPMR_T "curve for time constant of lowpass filter, denpending on engine speed" CURVE 0x80532E40 RB_Curve_U8_U16_Static 65534.00 t_q1 1.00 65535.00 FORMAT "%8.2" EXTENDED_LIMITS 0.00 65535.00
 /begin AXIS_DESCR STD_AXIS nmotOilSwmpT nmot_ub_q40 6 0.00 10200. FORMAT "%5.0" DEPOSIT ABSOLUTE /end AXIS_DESCR
/end CHARACTERISTIC
/begin CHARACTERISTIC OilSwmpT_tiTPT1_C "Filtering Time Constant for OilSwmpt_tFltd" VALUE 0x80532BB0 RB_Val_Ws32 4294.9672940000000 TimeDelay_s 0.0000020000000 4294.9672959999998 FORMAT "%19.14" EXTENDED_LIMITS 0.000002000000001 4294.9672959999998 /end CHARACTERISTIC
/begin CHARACTERISTIC OilSwmpT_tiTPULSPT1_C "Filtertime for PT1 filter of OilSwmpt_tPULSFltd" VALUE 0x80532BB4 RB_Val_Ws32 4294.9672940000000 TimeDelay_s 0.0000020000000 4294.9672959999998 FORMAT "%19.14" EXTENDED_LIMITS 0.000002000000001 4294.9672959999998 /end CHARACTERISTIC
/begin CHARACTERISTIC OilSwmpT_tiTSnsrFrzMax_C "max thresholdtime for switching of the state machine for the replacement handling for the oil temperature sensor in case no valid value is present" VALUE 0x80532BB8 RB_Val_Ws32 4294967295.00 Per_Dur -2147483648.00 2147483647.00 FORMAT "%13.2" /end CHARACTERISTIC
/begin CHARACTERISTIC OilSwmpT_tiWrmUp_C "time constant of lowpass filter" VALUE 0x80532E54 RB_Val_Wu16 65534.00 t_q1 1.00 65535.00 FORMAT "%8.2" EXTENDED_LIMITS 0.00 65535.00 /end CHARACTERISTIC
/begin CHARACTERISTIC OilSwmpT_tPULSDfl_C "Default value of Oil Temperature of the Oil-Combined-Sensor" VALUE 0x80532BBC RB_Val_Ws16 3276.700 Temp_Cels -273.140 3003.560 FORMAT "%8.3" EXTENDED_LIMITS -3549.940 3003.560 /end CHARACTERISTIC
/begin CHARACTERISTIC OilSwmpT_tSelMdlCEngDsT_C "Threshold of the coolant temperature to select the source of oil temperature." VALUE 0x80532BBE RB_Val_Ws16 3276.700 Temp_Cels -273.140 3003.560 FORMAT "%8.3" EXTENDED_LIMITS -3549.940 3003.560 /end CHARACTERISTIC
/begin CHARACTERISTIC OilSwmpT_tWrmUpHeatgCorrn_M "Map for temperature correction due to influence of heating" MAP 0x80532E56 RB_Map_S16U16_U16 1535.977 temp_q0p0234_o273 -273.150 1262.827 FORMAT "%8.3"
 /begin AXIS_DESCR STD_AXIS OilSwmpT_tMdlTmp Temp_Cels 12 -273.140 3003.560 FORMAT "%8.3" EXTENDED_LIMITS -3549.940 3003.560 DEPOSIT ABSOLUTE /end AXIS_DESCR
 /begin AXIS_DESCR STD_AXIS OilSwmpT_tWrmUpFild temp_ub_q0p75_o48 12 -48.0000 143.2500 FORMAT "%8.4" EXTENDED_LIMITS -48.00000 49103.25 DEPOSIT ABSOLUTE /end AXIS_DESCR
/end CHARACTERISTIC
/begin CHARACTERISTIC Oil_DebP.tiHiLo_C "Debounce structure for Oil-Digital Input / Time for a High to Low transition" VALUE 0x8053B15E Kw_Ws16 655350.0 TimeDeb -327680.0 327670.0 FORMAT "%8.1" /end CHARACTERISTIC
/begin CHARACTERISTIC Oil_DebP.tiLoHi_C "Debounce structure for Oil-Digital Input / Time for a Low to High transition" VALUE 0x8053B160 Kw_Ws16 655350.0 TimeDeb -327680.0 327670.0 FORMAT "%8.1" /end CHARACTERISTIC
/begin AXIS_PTS STM06LLUB_NSPTS "Distribution search : Engine temperature, for determination of idle speed depending on engine temperature" 0x80532B6A NSPTS_tmotloc RB_Axis_S16 49151.25 temp_ub_q0p75_o48 6 -24624.00 24527.25 FORMAT "%8.2" DEPOSIT ABSOLUTE /end AXIS_PTS
/begin AXIS_PTS STN06LLUB_NSPTS "Distribution search : for determination of idle speed depending on time after start." 0x80532B78 NSPTS_tnstloc RB_Axis_U8 255.0 t1sxs_ub_b255 6 0.00 255.0 FORMAT "%5.1" DEPOSIT ABSOLUTE /end AXIS_PTS
/begin CHARACTERISTIC SWTMOT "threshold selection computation model (model oil temperature in sump)" VALUE 0x80532FAA RB_Val_Wu8 191.3 temp_ub_q0p75_o48 -48.0 143.3 FORMAT "%5.1" /end CHARACTERISTIC
/begin CHARACTERISTIC SWTOSPM "threshold selection computation model (model oil temperature in sump)" VALUE 0x80532FAC RB_Val_Wu16 1535.977 temp_q0p0234_o273 -273.150 1262.827 FORMAT "%8.3" /end CHARACTERISTIC
/begin CHARACTERISTIC TAHLL "tans threshold for increased target speed at hot idling" VALUE 0x805325E7 RB_Val_Wu8 191.3 temp_ub_q0p75_o48 -48.0 143.3 FORMAT "%5.1" /end CHARACTERISTIC
/begin CHARACTERISTIC TDBKVKHN "Delay time in which increased idle speed is required though B_bkvleer is set" VALUE 0x80532B04 RB_Val_Wu16 6553.500 t_q0p1 0.00 6553.500 FORMAT "%8.3" /end CHARACTERISTIC
/begin CHARACTERISTIC TDTUMG "Debouncing time for diagnosis of ambient (air) temperature" VALUE 0x805322B2 RB_Val_Wu16 6553.500 t100msxs_uw_q100 0.00 6553.500 FORMAT "%8.3" /end CHARACTERISTIC
/begin CHARACTERISTIC THDNSOLPTS "Threshold of desired idle speed - poststart" VALUE 0x80532B06 RB_Val_Wu8 2550. nmot_q10 0.00 2550. FORMAT "%5.0" /end CHARACTERISTIC
/begin CHARACTERISTIC TIFACAIRPTHTRANCON_BASE.tiFacAirPthTran_C "class filter time parameter / parameter filter time" VALUE 0x8053081C RB_Val_Wu16 655.3400 t_q0p01 0.0100 655.3500 FORMAT "%8.4" EXTENDED_LIMITS 0.00 655.3500 /end CHARACTERISTIC
/begin CHARACTERISTIC TIFACAIRPTHTRANCON_FOLW.tiFacAirPthTran_C " / parameter filter time" VALUE 0x805305A8 RB_Val_Wu16 655.3400 t_q0p01 0.0100 655.3500 FORMAT "%8.4" EXTENDED_LIMITS 0.00 655.3500 /end CHARACTERISTIC
/begin CHARACTERISTIC TIFACAIRPTHTRAN_BASE.tiFacAirPthTranCatHeatg_GT "class filter time table / table filter time cat heating" CURVE 0x80530824 RB_CurveGroup_U16 655.3400 t_q0p01 0.0100 655.3500 FORMAT "%8.4" EXTENDED_LIMITS 0.00 655.3500
 /begin AXIS_DESCR COM_AXIS EngStrt_tStrtCoor Temp_Cels 12 -273.140 3003.560 FORMAT "%8.3" EXTENDED_LIMITS -3549.940 3003.560 AXIS_PTS_REF EngStrt_tStrtAirPth_AX /end AXIS_DESCR
/end CHARACTERISTIC
/begin CHARACTERISTIC TIFACAIRPTHTRAN_BASE.tiFacAirPthTran_GT "class filter time table / table filter time" CURVE 0x8053083C RB_CurveGroup_U16 655.3400 t_q0p01 0.0100 655.3500 FORMAT "%8.4" EXTENDED_LIMITS 0.00 655.3500
 /begin AXIS_DESCR COM_AXIS EngStrt_tStrtCoor Temp_Cels 12 -273.140 3003.560 FORMAT "%8.3" EXTENDED_LIMITS -3549.940 3003.560 AXIS_PTS_REF EngStrt_tStrtAirPth_AX /end AXIS_DESCR
/end CHARACTERISTIC
/begin CHARACTERISTIC TIFACAIRPTHTRAN_FOLW.tiFacAirPthTranCatHeatg_GT " / table filter time cat heating" CURVE 0x805305B0 RB_CurveGroup_U16 655.3400 t_q0p01 0.0100 655.3500 FORMAT "%8.4" EXTENDED_LIMITS 0.00 655.3500
 /begin AXIS_DESCR COM_AXIS EngStrt_tStrtCoor Temp_Cels 12 -273.140 3003.560 FORMAT "%8.3" EXTENDED_LIMITS -3549.940 3003.560 AXIS_PTS_REF EngStrt_tStrtAirPth_AX /end AXIS_DESCR
/end CHARACTERISTIC
/begin CHARACTERISTIC TIFACAIRPTHTRAN_FOLW.tiFacAirPthTran_GT " / table filter time" CURVE 0x805305C8 RB_CurveGroup_U16 655.3400 t_q0p01 0.0100 655.3500 FORMAT "%8.4" EXTENDED_LIMITS 0.00 655.3500
 /begin AXIS_DESCR COM_AXIS EngStrt_tStrtCoor Temp_Cels 12 -273.140 3003.560 FORMAT "%8.3" EXTENDED_LIMITS -3549.940 3003.560 AXIS_PTS_REF EngStrt_tStrtAirPth_AX /end AXIS_DESCR
/end CHARACTERISTIC
/begin CHARACTERISTIC TKHFSAB "delay time switching to idle speed at drive at catalyst heating" VALUE 0x80532B08 RB_Val_Wu16 6553.500 t100msxs_uw_b6553p5 0.00 6553.500 FORMAT "%8.3" /end CHARACTERISTIC
/begin CHARACTERISTIC TKHFSRG "delay time switching to idle speed at drive at catalyst heating when drive position would be engaged with rear gear" VALUE 0x80532B0A RB_Val_Wu16 6553.500 t100msxs_uw_b6553p5 0.00 6553.500 FORMAT "%8.3" /end CHARACTERISTIC
/begin CHARACTERISTIC TKHFSVZ "delay time switching to idle speed at drive at catalyst heating when drive position would be engaged (front gear)and exceed of a velocity threshold" VALUE 0x80532B0C RB_Val_Wu16 6553.500 t100msxs_uw_b6553p5 0.00 6553.500 FORMAT "%8.3" /end CHARACTERISTIC
/begin CHARACTERISTIC TKHNABBKV "time constant for filtering idle speed by catalyst heating by brake booster" VALUE 0x80532B0E RB_Val_Wu8 25.4996 zk100msxs_ub_b25p5 0.1004 25.6000 FORMAT "%7.4" EXTENDED_LIMITS 0.100392 25.6000 /end CHARACTERISTIC
/begin CHARACTERISTIC TMHLL "tmot threshold for increased target speed at hot idling" VALUE 0x805325E8 RB_Val_Wu8 191.3 temp_ub_q0p75_o48 -48.0 143.3 FORMAT "%5.1" /end CHARACTERISTIC
/begin CHARACTERISTIC TMLLX "Threshold for boiling prevention" VALUE 0x80532116 RB_Val_Wu8 191.3 temp_ub_q0p75_o48 -48.0 143.3 FORMAT "%5.1" /end CHARACTERISTIC
/begin CHARACTERISTIC TMRZHLL "tmot threshold for resetting the time counter for hot idling" VALUE 0x805325E9 RB_Val_Wu8 191.3 temp_ub_q0p75_o48 -48.0 143.3 FORMAT "%5.1" /end CHARACTERISTIC
/begin CHARACTERISTIC TOLCHLLMN "lower temperature threshold for hot idling" VALUE 0x805325EA RB_Val_Wu8 255.0 temp_ub_q1_o60 -60.0 195.0 FORMAT "%5.1" /end CHARACTERISTIC
/begin CHARACTERISTIC TOLCHLLMX "high temperature threshold for hot idling" VALUE 0x805325EB RB_Val_Wu8 255.0 temp_ub_q1_o60 -60.0 195.0 FORMAT "%5.1" /end CHARACTERISTIC
/begin CHARACTERISTIC TOSPMQD "debounce time for state of oiltemperature-model (sump)" VALUE 0x80532FAE RB_Val_Wu16 65535.00 t_q1 0.00 65535.00 FORMAT "%8.2" /end CHARACTERISTIC
/begin CHARACTERISTIC TOSPMQDS "short debounce time for state of oiltemperature-model (sump)" VALUE 0x80532FB0 RB_Val_Wu16 65535.00 t_q1 0.00 65535.00 FORMAT "%8.2" /end CHARACTERISTIC
/begin CHARACTERISTIC TOSPMQWS "threshold for state of oiltemperature-model (sump)" VALUE 0x80532FB2 RB_Val_Wu8 191.3 temp_ub_q0p75_o48 -48.0 143.3 FORMAT "%5.1" /end CHARACTERISTIC
/begin CHARACTERISTIC TOSPREPL "replacement value oil temperature (model oil temperature in sump)" VALUE 0x80532FB4 RB_Val_Wu16 1535.977 temp_q0p0234_o273 -273.150 1262.827 FORMAT "%8.3" /end CHARACTERISTIC
/begin CHARACTERISTIC TOSPREPLI "replacement value oil temperature during ini2 (model oil temperature in sump)" VALUE 0x80532FB6 RB_Val_Wu16 1535.977 temp_q0p0234_o273 -273.150 1262.827 FORMAT "%8.3" /end CHARACTERISTIC
/begin CHARACTERISTIC TTOSPMVLD "delay time of validity of modelled oil temperature" VALUE 0x80532FB8 RB_Val_Wu16 65535.00 t_q1 0.00 65535.00 FORMAT "%8.2" /end CHARACTERISTIC
/begin CHARACTERISTIC TTUM "Ambient temperature threshold for target idle Resolutions Per Minute" VALUE 0x805322B4 RB_Val_Ws16 6553.500 Temp_Cels -3549.940 3003.560 FORMAT "%8.3" /end CHARACTERISTIC
/begin CHARACTERISTIC TVHEGTESOFF "Time until canister purge is released" VALUE 0x80530854 RB_Val_Ws32 2147.00000000 Time_Dt 0.00 2147.00000000 FORMAT "%13.8" EXTENDED_LIMITS -2147.48364800 2147.48364700 /end CHARACTERISTIC
/begin CHARACTERISTIC TWDKSNSTKL "curve time constant for filtering of reference throttle blade position" CURVE 0x8053000C RB_Curve_S16_U16_Static 655.3400 t10msxs_uw_b655p35 0.0100 655.3500 FORMAT "%8.4" EXTENDED_LIMITS 0.00 655.3500
 /begin AXIS_DESCR STD_AXIS EngStrt_tStrtCoor Temp_Cels 6 -273.140 3003.560 FORMAT "%8.3" EXTENDED_LIMITS -3549.940 3003.560 DEPOSIT ABSOLUTE /end AXIS_DESCR
/end CHARACTERISTIC
/begin CHARACTERISTIC VFZGGRDKH "Threshold for velocity gradient to switch over to a separate idle speed after engage gear" VALUE 0x80532B10 RB_Val_Ws16 655.3500 Vel -327.6800 327.6700 FORMAT "%8.4" /end CHARACTERISTIC
/begin CHARACTERISTIC VFZGNLLKH "minimum velocity for separate idle speed after engage gear" VALUE 0x80532B12 RB_Val_Ws16 655.3500 Vel -327.6800 327.6700 FORMAT "%8.4" /end CHARACTERISTIC
/begin CHARACTERISTIC ZHLLA "Time counter for stopping increased speed in hot idling" VALUE 0x805325EC RB_Val_Wu16 13107.00 t200msxs_uw_q0p2 0.00 13107.00 FORMAT "%8.2" /end CHARACTERISTIC
/begin CHARACTERISTIC ZHLLE "Time counter threshold for increased speed at hot idling" VALUE 0x805325EE RB_Val_Wu16 13107.00 t200msxs_uw_q0p2 0.00 13107.00 FORMAT "%8.2" /end CHARACTERISTIC
/begin MEASUREMENT B_bkvkhab "condition catalyst heating cut off because of not enough pressure for brake booster" UBYTE B_TRUE 1 100 0.00 1.00000000000 BIT_MASK 0x1 FORMAT "%13.11" ECU_ADDRESS 0x7000016C /end MEASUREMENT
/begin MEASUREMENT B_cwnllkh0 "evaluation Bit0 of codeword CWNSKH" UBYTE B_TRUE 1 100 0.00 1.00000000000 BIT_MASK 0x1 FORMAT "%13.11" ECU_ADDRESS 0x7000016B /end MEASUREMENT
/begin MEASUREMENT B_cwnllkh1 "evaluation Bit1 of codeword CWNSKH" UBYTE B_TRUE 1 100 0.00 1.00000000000 BIT_MASK 0x1 FORMAT "%13.11" ECU_ADDRESS 0x7000016A /end MEASUREMENT
/begin MEASUREMENT B_cwnllkh10 "evaluation Bit10 of codeword CWNSKH" UBYTE B_TRUE 1 100 0.00 1.00000000000 BIT_MASK 0x1 FORMAT "%13.11" ECU_ADDRESS 0x70000169 /end MEASUREMENT
/begin MEASUREMENT B_cwnllkh14 "evaluation Bit14 of codeword CWNSKH" UBYTE B_TRUE 1 100 0.00 1.00000000000 BIT_MASK 0x1 FORMAT "%13.11" ECU_ADDRESS 0x70000168 /end MEASUREMENT
/begin MEASUREMENT B_cwnllkh2 "evaluation Bit2 of codeword CWNSKH" UBYTE B_TRUE 1 100 0.00 1.00000000000 BIT_MASK 0x1 FORMAT "%13.11" ECU_ADDRESS 0x70000167 /end MEASUREMENT
/begin MEASUREMENT B_cwnllkh3 "evaluation Bit3 of codeword CWNSKH" UBYTE B_TRUE 1 100 0.00 1.00000000000 BIT_MASK 0x1 FORMAT "%13.11" ECU_ADDRESS 0x70000166 /end MEASUREMENT
/begin MEASUREMENT B_cwnllkh4 "evaluation Bit4 of codeword CWNSKH" UBYTE B_TRUE 1 100 0.00 1.00000000000 BIT_MASK 0x1 FORMAT "%13.11" ECU_ADDRESS 0x70000165 /end MEASUREMENT
/begin MEASUREMENT B_cwnllkh5 "evaluation Bit5 of codeword CWNSKH" UBYTE B_TRUE 1 100 0.00 1.00000000000 BIT_MASK 0x1 FORMAT "%13.11" ECU_ADDRESS 0x70000164 /end MEASUREMENT
/begin MEASUREMENT B_cwnllkh8 "evaluation Bit8 of codeword CWNSKH" UBYTE B_TRUE 1 100 0.00 1.00000000000 BIT_MASK 0x1 FORMAT "%13.11" ECU_ADDRESS 0x70000163 /end MEASUREMENT
/begin MEASUREMENT B_cwnllkh9 "evaluation Bit9 of codeword CWNSKH" UBYTE B_TRUE 1 100 0.00 1.00000000000 BIT_MASK 0x1 FORMAT "%13.11" ECU_ADDRESS 0x70000162 /end MEASUREMENT
/begin MEASUREMENT B_deseehr_mrly_vld_msg "Valid Voltage check" UBYTE OneToOne 1 100 0.00 255.0 BIT_MASK 0x1 FORMAT "%5.1" ECU_ADDRESS 0x6000A6E3 /end MEASUREMENT
/begin MEASUREMENT B_hll "Condition hot idling" UBYTE B_TRUE 1 100 0.00 1.00000000000 BIT_MASK 0x1 FORMAT "%13.11" ECU_ADDRESS 0x7000016E /end MEASUREMENT
/begin MEASUREMENT B_hr_msg "condition main relay on" UBYTE B_TRUE 1 100 0.00 1.00000000000 BIT_MASK 0x1 FORMAT "%13.11" ECU_ADDRESS 0x6000014D /end MEASUREMENT
/begin MEASUREMENT B_inolu "info throttle actuator malfunction" UBYTE B_TRUE 1 100 0.00 1.00000000000 BIT_MASK 0x1 FORMAT "%13.11" ECU_ADDRESS 0x7000015B /end MEASUREMENT
/begin MEASUREMENT B_khnshp_msg "catalyst desired engine speed has a very high priority" UBYTE B_TRUE 1 100 0.00 1.00000000000 BIT_MASK 0x1 FORMAT "%13.11" ECU_ADDRESS 0x70000A1E /end MEASUREMENT
/begin MEASUREMENT B_khn_msg "condition catalyst heating idle speed" UBYTE B_TRUE 1 100 0.00 1.00000000000 BIT_MASK 0x1 FORMAT "%13.11" ECU_ADDRESS 0x70000A1F /end MEASUREMENT
/begin MEASUREMENT B_msudksom_msg "desired standardised critical air mass flow without torque structure active" UBYTE B_TRUE 1 100 0.00 1.00000000000 BIT_MASK 0x1 FORMAT "%13.11" ECU_ADDRESS 0x700009EA /end MEASUREMENT
/begin MEASUREMENT B_munst_msg "Condition allow intervention of torque monitoring" UBYTE B_TRUE 1 100 0.00 1.00000000000 BIT_MASK 0x1 FORMAT "%13.11" ECU_ADDRESS 0x700009E9 /end MEASUREMENT
/begin MEASUREMENT B_mwrlstas_msg "Trigger because of Eom changes for the desired air charge." UBYTE B_TRUE 1 100 0.00 1.00000000000 BIT_MASK 0x1 FORMAT "%13.11" ECU_ADDRESS 0x700009E6 /end MEASUREMENT
/begin MEASUREMENT B_mwtes_msg "Trigger because of Eom changes to the canister purge." UBYTE B_TRUE 1 100 0.00 1.00000000000 BIT_MASK 0x1 FORMAT "%13.11" ECU_ADDRESS 0x700009E5 /end MEASUREMENT
/begin MEASUREMENT B_nfskh "change over of desired engine speed for catalyst heating when drive position would be engaged" UBYTE B_TRUE 1 100 0.00 1.00000000000 BIT_MASK 0x1 FORMAT "%13.11" ECU_ADDRESS 0x70000161 /end MEASUREMENT
/begin MEASUREMENT B_nsks "Condition for increasing target speed (prevent from boiling)" UBYTE B_TRUE 1 100 0.00 1.00000000000 BIT_MASK 0x1 FORMAT "%13.11" ECU_ADDRESS 0x7000016F /end MEASUREMENT
/begin MEASUREMENT B_tfwdksom_msg "time constant to filter desired throttle angle without torque structure active" UBYTE B_TRUE 1 100 0.00 1.00000000000 BIT_MASK 0x1 FORMAT "%13.11" ECU_ADDRESS 0x70000982 /end MEASUREMENT
/begin MEASUREMENT B_toeltmp "Condition idle speed increase , oil temperature" UBYTE B_TRUE 1 100 0.00 1.00000000000 BIT_MASK 0x1 FORMAT "%13.11" ECU_ADDRESS 0x7000097D /end MEASUREMENT
/begin MEASUREMENT B_tospgg_msg "validity of sensor signal tospr (electrical and physical)" UBYTE B_TRUE 1 100 0.00 1.00000000000 BIT_MASK 0x1 FORMAT "%13.11" ECU_ADDRESS 0x7000097A /end MEASUREMENT
/begin MEASUREMENT B_tospg_msg "validity of signal tosp" UBYTE B_TRUE 1 100 0.00 1.00000000000 BIT_MASK 0x1 FORMAT "%13.11" ECU_ADDRESS 0x7000097B /end MEASUREMENT
/begin MEASUREMENT B_tospmadi "condition: soak time based initialisation of oil temperature model valid" UBYTE B_TRUE 1 100 0.00 1.00000000000 BIT_MASK 0x1 FORMAT "%13.11" ECU_ADDRESS 0x70000154 /end MEASUREMENT
/begin MEASUREMENT B_tospmefr "oil temperature in sump from model errorfree" UBYTE B_TRUE 1 100 0.00 1.00000000000 BIT_MASK 0x1 FORMAT "%13.11" ECU_ADDRESS 0x70000153 /end MEASUREMENT
/begin MEASUREMENT B_tospmg "oil temperature in sump from model valid" UBYTE B_TRUE 1 100 0.00 1.00000000000 BIT_MASK 0x1 FORMAT "%13.11" ECU_ADDRESS 0x70000152 /end MEASUREMENT
/begin MEASUREMENT B_tospmwst "Condition: Transition from warm-up-model to warm state model" UBYTE B_TRUE 1 100 0.00 1.00000000000 BIT_MASK 0x1 FORMAT "%13.11" ECU_ADDRESS 0x70000151 /end MEASUREMENT
/begin MEASUREMENT CoEng_bModtr "Dynamic operation during GDI-mode change" UBYTE B_TRUE 1 100 0.00 1.00000000000 BIT_MASK 0x1 FORMAT "%13.11" ECU_ADDRESS 0x700008D9 /end MEASUREMENT
/begin MEASUREMENT CoEOM_DlyReengmtFpcAdvTOFFVNM_I.Time "Delay before the re-engagement of the canister purge, independant of grid. / Internal timer value" SLONG Time_Dt 1 100 0.00 2147.48364700 FORMAT "%13.8" ECU_ADDRESS 0x60001374 /end MEASUREMENT
/begin MEASUREMENT EngStrt_ctMSUDKSOMDrvEntr10ms "Local variable to store the global drive enter counter(SyC_ctDrvEnter)" UBYTE OneToOne 1 100 0.00 255.0 FORMAT "%5.1" ECU_ADDRESS 0x60006338 /end MEASUREMENT
/begin MEASUREMENT EngStrt_flgAccrPed "accelerator pedal pressed during start" UBYTE B_TRUE 1 100 0.00 1.00000000000 BIT_MASK 0x1 FORMAT "%13.11" ECU_ADDRESS 0x70000173 /end MEASUREMENT
/begin MEASUREMENT EngStrt_flgAirPthStrtRst "reset of air path at start" UBYTE B_TRUE 1 100 0.00 1.00000000000 BIT_MASK 0x1 FORMAT "%13.11" ECU_ADDRESS 0x70000172 /end MEASUREMENT
/begin MEASUREMENT EngStrt_flgEngShutDown "engine is shut down" UBYTE B_TRUE 1 100 0.00 1.00000000000 BIT_MASK 0x1 FORMAT "%13.11" ECU_ADDRESS 0x70000171 /end MEASUREMENT
/begin MEASUREMENT EngStrt_flgEngShutDownDlyd "engine is shut down (with delay until next Proc EngReStrt)" UBYTE B_TRUE 1 100 0.00 1.00000000000 BIT_MASK 0x1 FORMAT "%13.11" ECU_ADDRESS 0x70000804 /end MEASUREMENT
/begin MEASUREMENT EngStrt_flgTqActv "torque intervention during start" UBYTE B_TRUE 1 100 0.00 1.00000000000 BIT_MASK 0x1 FORMAT "%13.11" ECU_ADDRESS 0x70000170 /end MEASUREMENT
/begin MEASUREMENT EngStrt_mfAirAccrPed "correction desired standardised over critical air mass flow pedal value" UWORD m_uw_b6553p5 1 100 0.00 6553.500 FORMAT "%8.3" ECU_ADDRESS 0x70002B6A /end MEASUREMENT
/begin MEASUREMENT EngStrt_nrInjAirPth "local variable injection counter for the air path at start" UBYTE OneToOne 1 100 0.00 255.0 FORMAT "%5.1" ECU_ADDRESS 0x70002D50 /end MEASUREMENT
/begin MEASUREMENT EngStrt_tiSnceStrt "time since engine start" UWORD t_q0p01 1 100 0.00 655.3500 FORMAT "%8.4" ECU_ADDRESS 0x70002B6E /end MEASUREMENT
/begin MEASUREMENT ExhMgT_cntrReiniIdleCatHeatg "Counter for recognizing the re-initialization of variables and parameters" UBYTE OneToOne 1 100 0.00 255.0 FORMAT "%5.1" ECU_ADDRESS 0x60006327 /end MEASUREMENT
/begin MEASUREMENT ExhMgT_facCatHeatgProgsNIdle "Catalyst heating progress for requesting a desired engine idle speed" UWORD fak_uw_b1 1 100 0.00 0.9999847 FORMAT "%9.7" ECU_ADDRESS 0x6000368E /end MEASUREMENT
/begin MEASUREMENT ExhMgT_facCorrnIdleAlti "correction of desired idle speed for catalyst heating in dependence of air density" UWORD fak_uw_b2 1 100 0.00 1.999969 FORMAT "%8.6" ECU_ADDRESS 0x6000368C /end MEASUREMENT
/begin MEASUREMENT ExhMgT_flgCatHeatgWrmIdleSpdReq "Flag for a catalyst warm up request for requesting a desired nominal engine idle speed" UBYTE B_TRUE 1 100 0.00 1.00000000000 BIT_MASK 0x1 FORMAT "%13.11" ECU_ADDRESS 0x70000160 /end MEASUREMENT
/begin MEASUREMENT ExhMgT_flgGripClu "reduction of desired idle speed for catalyst heating in case of detected closed power train" UBYTE B_TRUE 1 100 0.00 1.00000000000 BIT_MASK 0x1 FORMAT "%13.11" ECU_ADDRESS 0x7000015F /end MEASUREMENT
/begin MEASUREMENT ExhMgT_flgIdleSpdActvnBrkP "Flag for activation of ramp time selction for idle speed calculation" UBYTE B_TRUE 1 100 0.00 1.00000000000 BIT_MASK 0x1 FORMAT "%13.11" ECU_ADDRESS 0x7000015E /end MEASUREMENT
/begin MEASUREMENT ExhMgT_flgIdleSpdDeactvnBrkP "Flag for deactivation of idle speed calculation when there is not enough break pressure" UBYTE B_TRUE 1 100 0.00 1.00000000000 BIT_MASK 0x1 FORMAT "%13.11" ECU_ADDRESS 0x7000015D /end MEASUREMENT
/begin MEASUREMENT ExhMgT_flgRepStrtNonCsersIdleSpdReq "Flag for switching the requested engine idle speed to the Non-Csers-idle speeds during catalyst heating after a repeated start" UBYTE B_TRUE 1 100 0.00 1.00000000000 BIT_MASK 0x1 FORMAT "%13.11" ECU_ADDRESS 0x700007C2 /end MEASUREMENT
/begin MEASUREMENT ExhMgT_flgTondDrvgPosn "Bit with Turn on delay if driving position is engaged or not" UBYTE B_TRUE 1 100 0.00 1.00000000000 BIT_MASK 0x1 FORMAT "%13.11" ECU_ADDRESS 0x7000015C /end MEASUREMENT
/begin MEASUREMENT ExhMgT_nEngIdleCatHeat "Desired idle speed considering gear , brake pressure , vehicle speed and engine speed" UBYTE nmot_q10 1 100 0.00 2550. FORMAT "%5.0" ECU_ADDRESS 0x60006326 /end MEASUREMENT
/begin MEASUREMENT ExhMgT_nEngMaxIdleCatHeat "Maximum engine idle speed" UBYTE nmot_q10 1 100 0.00 2550. FORMAT "%5.0" ECU_ADDRESS 0x6000E41F /end MEASUREMENT
/begin MEASUREMENT ExhMgT_nIdleCatHeatgSp "Desired idling speed, catalyst heating" UBYTE nmot_q10 1 100 0.00 2550. FORMAT "%5.0" ECU_ADDRESS 0x6000A061 /end MEASUREMENT
/begin MEASUREMENT ExhMgT_nIdleInitCatHeatg "engine speed for initialisation of low pass for filtering of desired idle speed for catalyst heating" UBYTE nmot_q10 1 100 0.00 2550. FORMAT "%5.0" ECU_ADDRESS 0x60006325 /end MEASUREMENT
/begin MEASUREMENT ExhMgT_nIdleVirtDiagCsers "desired catalyst heating idle in case that catalyst heating is active or would be active" UBYTE nmot_q10 1 100 0.00 2550. FORMAT "%5.0" ECU_ADDRESS 0x6000A060 /end MEASUREMENT
/begin MEASUREMENT ExhMgT_nIdleVirtDiagNonCsers "Desired engine idle speed for virtual diagnosis during Non-Csers case" UBYTE nmot_q10 1 100 0.00 2550. FORMAT "%5.0" ECU_ADDRESS 0x6000A05F /end MEASUREMENT
/begin MEASUREMENT ExhMgT_tCatColdStrtIdleSpdReq "Catalyst temperature as input for requesting a nominal idle speed for catalyst heating" SWORD Temp_Cels 1 100 -3549.940 3003.560 FORMAT "%8.3" ECU_ADDRESS 0x6000368A /end MEASUREMENT
/begin MEASUREMENT ExhMgT_tCatHeatgIdleSpdReqFixd "Frozen value of the Catalyst temperature at the begin of catalyst heating for requesting a nominal idle speed for catalyst heating" SWORD Temp_Cels 1 100 -3549.940 3003.560 FORMAT "%8.3" ECU_ADDRESS 0x60003688 /end MEASUREMENT
/begin MEASUREMENT ExhMgT_tCatWrmIdleSpdReq "Catalyst temperature as input for requesting a nominal idle speed for catalyst warm up mode" SWORD Temp_Cels 1 100 -3549.940 3003.560 FORMAT "%8.3" ECU_ADDRESS 0x60003686 /end MEASUREMENT
/begin MEASUREMENT ExhMgT_tEngCatHeatgIdle "engine temperature (engine coolant or cylinder head), local copy, at the rising edge of active catalyst heating" SWORD Temp_Cels 1 100 -3549.940 3003.560 FORMAT "%8.3" ECU_ADDRESS 0x60003684 /end MEASUREMENT
/begin MEASUREMENT ExhMgT_tiAftStrtCatHeatgNIdle "Time from start-up of catalyst heating for rotational speed" UWORD t_q0p1 1 100 0.00 6553.500 FORMAT "%8.3" ECU_ADDRESS 0x60003682 /end MEASUREMENT
/begin MEASUREMENT ExhMgT_tiIdleSpdFltCatHeatg "Time constant for filtering the desired nominal idle speed during catalyst heating" UBYTE zk100msxs_ub_b25p5 1 100 0.1004 25.6000 FORMAT "%7.4" ECU_ADDRESS 0x60006324 /end MEASUREMENT
/begin MEASUREMENT ExhMgT_tStrtNCatHeatg "engine start temperature for correction of desired idle speed for catalyst heating" SWORD Temp_Cels 1 100 -3549.940 3003.560 FORMAT "%8.3" ECU_ADDRESS 0x60003680 /end MEASUREMENT
/begin MEASUREMENT frhokor_w_msg "factor for correction of density by secondary air" UWORD fak_uw_b4 1 100 0.00 3.999939 FORMAT "%8.6" ECU_ADDRESS 0x60004828 /end MEASUREMENT
/begin MEASUREMENT MFAIRSTRT_BASE.mfAir "Class instance for desired air mass flow at start / air mass flow at start" UWORD m_uw_b6553p5 1 100 0.00 6553.500 FORMAT "%8.3" ECU_ADDRESS 0x6000D938 /end MEASUREMENT
/begin MEASUREMENT MFAIRSTRT_COM.mfAir " / air mass flow at start" UWORD m_uw_b6553p5 1 100 0.00 6553.500 FORMAT "%8.3" ECU_ADDRESS 0x600036A6 /end MEASUREMENT
/begin MEASUREMENT MFAIRSTRT_COMWAITSTRTR.mfAir " / air mass flow at start" UWORD m_uw_b6553p5 1 100 0.00 6553.500 FORMAT "%8.3" ECU_ADDRESS 0x600036A2 /end MEASUREMENT
/begin MEASUREMENT MFAIRSTRT_FOLW.mfAir " / air mass flow at start" UWORD m_uw_b6553p5 1 100 0.00 6553.500 FORMAT "%8.3" ECU_ADDRESS 0x6000369E /end MEASUREMENT
/begin MEASUREMENT MFAIRWAIT_STRTR.mfAirWait "Class instance for desired air mass flow between start request and start beginning / Air mass flow between start request and start beginning" UWORD m_uw_b6553p5 1 100 0.00 6553.500 FORMAT "%8.3" ECU_ADDRESS 0x60003698 /end MEASUREMENT
/begin MEASUREMENT mlwOilSwmpT "Intake air mass used for OilSwmpT" UWORD m_uw_b6553p5 1 100 0.00 6553.500 FORMAT "%8.3" ECU_ADDRESS 0x60003670 /end MEASUREMENT
/begin MEASUREMENT MoCMem_vblStructCpl_Core1_10ms_Nr1.MoCMem_ctDebErrChkRAMOld "Instance for specific core and task / Old value of counter how often the threshold for MaxValueIndicator for double storage and cyclic RAM-Test is exeeded" UBYTE OneToOne 1 100 0.00 255.0 FORMAT "%5.1" ECU_ADDRESS 0x60011E04 /end MEASUREMENT
/begin MEASUREMENT MoCMem_vblStructCpl_Core1_10ms_Nr1.MoCMem_ctDebErrChkRAMCpl "Instance for specific core and task / RAM data redundancy for MoCMem_ctDebErrChkRAM" UBYTE OneToOne 1 100 0.00 255.0 FORMAT "%5.1" ECU_ADDRESS 0x60011E05 /end MEASUREMENT
/begin MEASUREMENT MoCMem_vblStructCpl_Core1_10ms_Nr1.MoCMem_ctDebHealChkRAMCpl "Instance for specific core and task / complement of the error healing counter for double storage and cyclical RAM-test" UWORD OneToOne 1 100 0.00 65535.00 FORMAT "%8.2" ECU_ADDRESS 0x60011E06 /end MEASUREMENT
/begin MEASUREMENT MoCMem_vblStructCpl_Core1_10ms_Nr1.MoCMem_nrRamChkCpl "Instance for specific core and task / complement of the number of words to be tested on the cyclic RAM check" UWORD OneToOne 1 100 0.00 65535.00 FORMAT "%8.2" ECU_ADDRESS 0x60011E08 /end MEASUREMENT
/begin MEASUREMENT MoCMem_vblStructCpl_Core1_10ms_Nr1.MoCMem_nrStckChkCpl "Instance for specific core and task / Complement of the number of bytes to be checked on each call of the cyclic stack check" ULONG OneToOne 1 100 0.00 4294967295.00 FORMAT "%13.2" ECU_ADDRESS 0x60011E0C /end MEASUREMENT
/begin MEASUREMENT MoCMem_vblStructCpl_Core1_10ms_Nr1.MoCMem_nrCSAChkCpl "Instance for specific core and task / Complement of the number of bytes to be checked on each call of the cyclic CSA check" ULONG OneToOne 1 100 0.00 4294967295.00 FORMAT "%13.2" ECU_ADDRESS 0x60011E10 /end MEASUREMENT
/begin MEASUREMENT MoCMem_vblStructCpl_Core1_10ms_Nr1.MoCMem_RamOffsetPtrCpl "Instance for specific core and task / duplicate storage of MoCMem_RamOffsetPtr" ULONG OneToOne 1 100 0.00 4294967295.00 FORMAT "%13.2" ECU_ADDRESS 0x60011E14 /end MEASUREMENT
/begin MEASUREMENT MoCMem_vblStructCpl_Core1_10ms_Nr1.MoCMem_CSAOffsetPtrCpl "Instance for specific core and task / Complement of CSA start address of the current CSA cyclic check complements" ULONG OneToOne 1 100 0.00 4294967295.00 FORMAT "%13.2" ECU_ADDRESS 0x60011E1C /end MEASUREMENT
/begin MEASUREMENT MoCMem_vblStructCpl_Core1_10ms_Nr1.MoCMem_StckOffsetPtrCpl "Instance for specific core and task / Complement of the stack start address of the current stck cyclic check" ULONG OneToOne 1 100 0.00 4294967295.00 FORMAT "%13.2" ECU_ADDRESS 0x60011E18 /end MEASUREMENT
/begin MEASUREMENT MoCMem_vblStructCpl_Core1_10ms_Nr1.Mo_RamCyclicCheckCpl "Instance for specific core and task / not used" ULONG OneToOne 1 100 0.00 4294967295.00 FORMAT "%13.2" ECU_ADDRESS 0x60011E20 /end MEASUREMENT
/begin MEASUREMENT MoCMem_vblStructCpl_Core1_10ms_Nr1.MoCMem_ctLrnRAMCpl "Instance for specific core and task / Complement of the counter for the learn process of the RAM check" UBYTE OneToOne 1 100 0.00 255.0 FORMAT "%5.1" ECU_ADDRESS 0x60011E24 /end MEASUREMENT
/begin MEASUREMENT MoCMem_vblStructCpl_Core1_10ms_Nr1.MoCMem_tiRAMusOldCpl "Instance for specific core and task / complement of the old time stamp of the cyclic RAM check" ULONG OneToOne 1 100 0.00 4294967295.00 FORMAT "%13.2" ECU_ADDRESS 0x60011E28 /end MEASUREMENT
/begin MEASUREMENT MoCMem_vblStructCpl_Core1_10ms_Nr1.MoCMem_tiRAMAccusCpl "Instance for specific core and task / complement of the sum of the time intervals between calls to the cyclic RAM check" ULONG OneToOne 1 100 0.00 4294967295.00 FORMAT "%13.2" ECU_ADDRESS 0x60011E30 /end MEASUREMENT
/begin MEASUREMENT MoCMem_vblStructCpl_Core1_10ms_Nr1.MoCMem_tiRAMusCpl "Instance for specific core and task / complement of the time stamp of the cyclic RAM check" ULONG OneToOne 1 100 0.00 4294967295.00 FORMAT "%13.2" ECU_ADDRESS 0x60011E2C /end MEASUREMENT
/begin MEASUREMENT MoCMem_vblStructCpl_Core1_10ms_Nr1.MoCMem_ctLrnErrHdlrCpl "Instance for specific core and task / Complement of the counter of the learn process for the error handler" UBYTE OneToOne 1 100 0.00 255.0 FORMAT "%5.1" ECU_ADDRESS 0x60011E34 /end MEASUREMENT
/begin MEASUREMENT MoCMem_vblStructCpl_Core1_10ms_Nr1.MoCMem_tiErrHdlrusOldCpl "Instance for specific core and task / Complement of the previous time stamp for the error handler" ULONG OneToOne 1 100 0.00 4294967295.00 FORMAT "%13.2" ECU_ADDRESS 0x60011E3C /end MEASUREMENT
/begin MEASUREMENT MoCMem_vblStructCpl_Core1_10ms_Nr1.MoCMem_tiErrHdlrusCpl "Instance for specific core and task / Complement of the current time stamp for the error handler" ULONG OneToOne 1 100 0.00 4294967295.00 FORMAT "%13.2" ECU_ADDRESS 0x60011E38 /end MEASUREMENT
/begin MEASUREMENT MoCMem_vblStructCpl_Core1_10ms_Nr1.MoCMem_tiErrHdlrAccusCpl "Instance for specific core and task / Complement of the sums of the intervals between calls for the error handler" ULONG OneToOne 1 100 0.00 4294967295.00 FORMAT "%13.2" ECU_ADDRESS 0x60011E40 /end MEASUREMENT
/begin MEASUREMENT MoCMem_vblStructCpl_Core1_10ms_Nr1.MoCMem_numHealFacCpl "Instance for specific core and task / Complement of the compensation factor for the healing counter" UBYTE OneToOne 1 100 0.00 255.0 FORMAT "%5.1" ECU_ADDRESS 0x60011E44 /end MEASUREMENT
/begin MEASUREMENT MoCMem_vblStructEarlyClearedRAM_Core1_10ms_Nr1.MoCMem_st "Instance for specific core and task / Request of a complete memory test during initialisation; status of complete ROM test" UBYTE OneToOne 1 100 0.00 255.0 FORMAT "%5.1" ECU_ADDRESS 0x7003AB90 /end MEASUREMENT
/begin MEASUREMENT MoCMem_vblStructEarlyClearedRAM_Core1_10ms_Nr1.MoCMem_stCpl "Instance for specific core and task / Double storage for request of complete RAMROM-memory checks during initialization" UBYTE OneToOne 1 100 0.00 255.0 FORMAT "%5.1" ECU_ADDRESS 0x7003AB91 /end MEASUREMENT
/begin MEASUREMENT MoCMem_vblStructNVRAM_Core1_10ms_Nr1.MoCMem_ctDebErrChkRAMMaxNv "Instance for specific core and task / MaxValueIndicator for double storage and cyclic RAM-Test" UBYTE OneToOne 1 100 0.00 255.0 FORMAT "%5.1" ECU_ADDRESS 0x60037FD8 /end MEASUREMENT
/begin MEASUREMENT MoCMem_vblStructNVRAM_Core1_10ms_Nr1.MoCMem_ctDebErrChkRAMExcddThdNv "Instance for specific core and task / Counter how often the threshold for MaxValueIndicator for double storage and cyclic RAM-Test is exeeded" UBYTE OneToOne 1 100 0.00 255.0 FORMAT "%5.1" ECU_ADDRESS 0x60037FD9 /end MEASUREMENT
/begin MEASUREMENT MoCMem_vblStruct_Core1_10ms_Nr1.MoCMem_ctDebErrChkRAM "Instance for specific core and task / error debounce counter for double storage and cyclical RAM-test" UBYTE OneToOne 1 100 0.00 255.0 FORMAT "%5.1" ECU_ADDRESS 0x60012730 /end MEASUREMENT
/begin MEASUREMENT MoCMem_vblStruct_Core1_10ms_Nr1.MoCMem_ctDebHealChkRAM "Instance for specific core and task / error healing counter for double storage and cyclical RAM-test" UWORD OneToOne 1 100 0.00 65535.00 FORMAT "%8.2" ECU_ADDRESS 0x60012732 /end MEASUREMENT
/begin MEASUREMENT MoCMem_vblStruct_Core1_10ms_Nr1.MoCMem_nrRamChkSize "Instance for specific core and task / Memory size in Byte that is tested in the cyclic RAM check" ULONG OneToOne 1 100 0.00 4294967295.00 FORMAT "%13.2" ECU_ADDRESS 0x60012734 /end MEASUREMENT
/begin MEASUREMENT MoCMem_vblStruct_Core1_10ms_Nr1.MoCMem_adrChkStckEnd "Instance for specific core and task / End address of the current tested stack memory" ULONG OneToOne 1 100 0.00 4294967295.00 FORMAT "%13.2" ECU_ADDRESS 0x6001273C /end MEASUREMENT
/begin MEASUREMENT MoCMem_vblStruct_Core1_10ms_Nr1.MoCMem_adrChkStckStrt "Instance for specific core and task / Start address of the current tested stack memory" ULONG OneToOne 1 100 0.00 4294967295.00 FORMAT "%13.2" ECU_ADDRESS 0x60012738 /end MEASUREMENT
/begin MEASUREMENT MoCMem_vblStruct_Core1_10ms_Nr1.MoCMem_adrChkCSAStrt "Instance for specific core and task / Start address of the current tested CSA region" ULONG OneToOne 1 100 0.00 4294967295.00 FORMAT "%13.2" ECU_ADDRESS 0x60012740 /end MEASUREMENT
/begin MEASUREMENT MoCMem_vblStruct_Core1_10ms_Nr1.MoCMem_adrChkCSAEnd "Instance for specific core and task / End address of the current tested CSA region" ULONG OneToOne 1 100 0.00 4294967295.00 FORMAT "%13.2" ECU_ADDRESS 0x60012744 /end MEASUREMENT
/begin MEASUREMENT MoCMem_vblStruct_Core1_10ms_Nr1.MoCMem_nrRamChk "Instance for specific core and task / Number of 32-bit memory cells to be tested in cyclical RAM check" UWORD OneToOne 1 100 0.00 65535.00 FORMAT "%8.2" ECU_ADDRESS 0x60012748 /end MEASUREMENT
/begin MEASUREMENT MoCMem_vblStruct_Core1_10ms_Nr1.MoCMem_nrStckChk "Instance for specific core and task / Number of bytes to be checked on each call of the cyclic stack check" ULONG OneToOne 1 100 0.00 4294967295.00 FORMAT "%13.2" ECU_ADDRESS 0x6001274C /end MEASUREMENT
/begin MEASUREMENT MoCMem_vblStruct_Core1_10ms_Nr1.MoCMem_nrCSAChk "Instance for specific core and task / Number of bytes to be checked on each call of the cyclic CSA check" ULONG OneToOne 1 100 0.00 4294967295.00 FORMAT "%13.2" ECU_ADDRESS 0x60012750 /end MEASUREMENT
/begin MEASUREMENT MoCMem_vblStruct_Core1_10ms_Nr1.MoCMem_StckOffsetPtr "Instance for specific core and task / Stack start address of the current stck cyclic check" ULONG OneToOne 1 100 0.00 4294967295.00 FORMAT "%13.2" ECU_ADDRESS 0x60012754 /end MEASUREMENT
/begin MEASUREMENT MoCMem_vblStruct_Core1_10ms_Nr1.MoCMem_CSAOffsetPtr "Instance for specific core and task / CSA start address of the current CSA cyclic check" ULONG OneToOne 1 100 0.00 4294967295.00 FORMAT "%13.2" ECU_ADDRESS 0x60012758 /end MEASUREMENT
/begin MEASUREMENT MoCMem_vblStruct_Core1_10ms_Nr1.MoCMem_adrChkStckSP "Instance for specific core and task / current test cycle start address of the stack region to be tested" ULONG OneToOne 1 100 0.00 4294967295.00 FORMAT "%13.2" ECU_ADDRESS 0x6001275C /end MEASUREMENT
/begin MEASUREMENT MoCMem_vblStruct_Core1_10ms_Nr1.MoCMem_RamOffsetPtr "Instance for specific core and task / pointer with the address for the cyclic checked RAM area which should be checkt at the next cyclic call of the cyclic RAM check" ULONG OneToOne 1 100 0.00 4294967295.00 FORMAT "%13.2" ECU_ADDRESS 0x60012760 /end MEASUREMENT
/begin MEASUREMENT MoCMem_vblStruct_Core1_10ms_Nr1.MoCMem_ChkRAMStck "Instance for specific core and task / temporary stack used during cyclic stack check" ULONG OneToOne 1 100 0.00 4294967295.00 FORMAT "%13.2" ARRAY_SIZE 80 ECU_ADDRESS 0x60012764 /end MEASUREMENT
/begin MEASUREMENT MoCMem_vblStruct_Core1_10ms_Nr1.MoCMem_ctLrnRAM "Instance for specific core and task / Counter for the learn process of the RAM check" UBYTE OneToOne 1 100 0.00 255.0 FORMAT "%5.1" ECU_ADDRESS 0x600128A4 /end MEASUREMENT
/begin MEASUREMENT MoCMem_vblStruct_Core1_10ms_Nr1.MoCMem_tiRAMus "Instance for specific core and task / time stamp of the cyclic RAM check" ULONG OneToOne 1 100 0.00 4294967295.00 FORMAT "%13.2" ECU_ADDRESS 0x600128AC /end MEASUREMENT
/begin MEASUREMENT MoCMem_vblStruct_Core1_10ms_Nr1.MoCMem_tiRAMusOld "Instance for specific core and task / old time stamp of the cyclic RAM check" ULONG OneToOne 1 100 0.00 4294967295.00 FORMAT "%13.2" ECU_ADDRESS 0x600128A8 /end MEASUREMENT
/begin MEASUREMENT MoCMem_vblStruct_Core1_10ms_Nr1.MoCMem_tiRAMAccus "Instance for specific core and task / sum of the time intervals between calls to the cyclic RAM check" ULONG OneToOne 1 100 0.00 4294967295.00 FORMAT "%13.2" ECU_ADDRESS 0x600128B0 /end MEASUREMENT
/begin MEASUREMENT MoCMem_vblStruct_Core1_10ms_Nr1.MoCMem_ctLrnErrHdlr "Instance for specific core and task / Counter of the learn process for the error handler" UBYTE OneToOne 1 100 0.00 255.0 FORMAT "%5.1" ECU_ADDRESS 0x600128B4 /end MEASUREMENT
/begin MEASUREMENT MoCMem_vblStruct_Core1_10ms_Nr1.MoCMem_tiErrHdlrusOld "Instance for specific core and task / Previous time stamp for the error handler" ULONG OneToOne 1 100 0.00 4294967295.00 FORMAT "%13.2" ECU_ADDRESS 0x600128B8 /end MEASUREMENT
/begin MEASUREMENT MoCMem_vblStruct_Core1_10ms_Nr1.MoCMem_tiErrHdlrus "Instance for specific core and task / Current time stamp for the error handler" ULONG OneToOne 1 100 0.00 4294967295.00 FORMAT "%13.2" ECU_ADDRESS 0x600128BC /end MEASUREMENT
/begin MEASUREMENT MoCMem_vblStruct_Core1_10ms_Nr1.MoCMem_tiErrHdlrAccus "Instance for specific core and task / Sum of the intervals between calls for the error handler" ULONG OneToOne 1 100 0.00 4294967295.00 FORMAT "%13.2" ECU_ADDRESS 0x600128C0 /end MEASUREMENT
/begin MEASUREMENT MoCMem_vblStruct_Core1_10ms_Nr1.MoCMem_numHealFac "Instance for specific core and task / Compensation factor for the healing counter" UBYTE OneToOne 1 100 0.00 255.0 FORMAT "%5.1" ECU_ADDRESS 0x600128C4 /end MEASUREMENT
/begin MEASUREMENT MoCPFC_vblStructCpl_Core1_10ms_Nr1.MoCPFC_cntr "Instance for specific core and task / Module call counter" UBYTE OneToOne 1 100 0.00 255.0 FORMAT "%5.1" ECU_ADDRESS 0x60011DC4 /end MEASUREMENT
/begin MEASUREMENT MoCPFC_vblStructCpl_Core1_10ms_Nr1.MoCPFC_numChkword "Instance for specific core and task / Module specific checkword" ULONG OneToOne 1 100 0.00 4294967295.00 FORMAT "%13.2" ECU_ADDRESS 0x60011DC8 /end MEASUREMENT
/begin MEASUREMENT MoCPFC_vblStructCpl_Core1_10ms_Nr1.MoCPFC_numChks "Instance for specific core and task / Module specific total CRC checksum (from MISR algorithm)" ULONG OneToOne 1 100 0.00 4294967295.00 FORMAT "%13.2" ECU_ADDRESS 0x60011DCC /end MEASUREMENT
/begin MEASUREMENT MoCPFC_vblStructCpl_Core1_10ms_Nr1.MoCPFC_numConCatVal "Instance for specific core and task / Task-core combination specific concatenated value" ULONG OneToOne 1 100 0.00 4294967295.00 FORMAT "%13.2" ECU_ADDRESS 0x60011DD0 /end MEASUREMENT
/begin MEASUREMENT MoCPFC_vblStructCpl_Core1_10ms_Nr1.MoCPFC_cntrRollg "Instance for specific core and task / Task-core combination specific Rolling counter" ULONG OneToOne 1 100 0.00 4294967295.00 FORMAT "%13.2" ECU_ADDRESS 0x60011DD4 /end MEASUREMENT
/begin MEASUREMENT MoCPFC_vblStructCpl_Core1_10ms_Nr1.MoCPFC_aryRingBuf "Instance for specific core and task / Task-core combination specific Ring Buffer" ULONG OneToOne 1 100 0.00 4294967295.00 FORMAT "%13.2" ARRAY_SIZE 6 ECU_ADDRESS 0x60011DD8 /end MEASUREMENT
/begin MEASUREMENT MoCPFC_vblStructCpl_Core1_10ms_Nr1.MoCPFC_stWrErr "Instance for specific core and task / Status of task-core combination specific ring buffer full error" UBYTE OneToOne 1 100 0.00 255.0 FORMAT "%5.1" ECU_ADDRESS 0x60011DF0 /end MEASUREMENT
/begin MEASUREMENT MoCPFC_vblStructCpl_Core1_10ms_Nr1.MoCPFC_RingBuf_pst.startAdr "Instance for specific core and task / Structure holding task-core combination specific Ring Buffer properties / start address of Ring buffer" ULONG default 1 100 0.00 4294967295.00 FORMAT "%13.2" ECU_ADDRESS 0x60011DF4 /end MEASUREMENT
/begin MEASUREMENT MoCPFC_vblStructCpl_Core1_10ms_Nr1.MoCPFC_RingBuf_pst.size "Instance for specific core and task / Structure holding task-core combination specific Ring Buffer properties / maximum number of elements in the buffer" UBYTE OneToOne 1 100 0.00 255.0 FORMAT "%5.1" ECU_ADDRESS 0x60011DF8 /end MEASUREMENT
/begin MEASUREMENT MoCPFC_vblStructCpl_Core1_10ms_Nr1.MoCPFC_RingBuf_pst.head "Instance for specific core and task / Structure holding task-core combination specific Ring Buffer properties / pointer to head of the ring buffer" ULONG default 1 100 0.00 4294967295.00 FORMAT "%13.2" ECU_ADDRESS 0x60011DFC /end MEASUREMENT
/begin MEASUREMENT MoCPFC_vblStructCpl_Core1_10ms_Nr1.MoCPFC_RingBuf_pst.tail "Instance for specific core and task / Structure holding task-core combination specific Ring Buffer properties / pointer to head of the ring buffer" ULONG default 1 100 0.00 4294967295.00 FORMAT "%13.2" ECU_ADDRESS 0x60011E00 /end MEASUREMENT
/begin MEASUREMENT MoCSCC_varStructCpl_Core1_10ms_Nr1.MoCSCC_stChpIdCpl "Instance for specific core and task / Complement of CPU version" ULONG OneToOne 1 100 0.00 4294967295.00 FORMAT "%13.2" ECU_ADDRESS 0x60011DBC /end MEASUREMENT
/begin MEASUREMENT MoCSCC_varStructCpl_Core1_10ms_Nr1.MoCSCC_cntrDebCpl "Instance for specific core and task / Complement of debounce counter for configuration check error" UBYTE OneToOne 1 100 0.00 255.0 FORMAT "%5.1" ECU_ADDRESS 0x60011DC0 /end MEASUREMENT
/begin MEASUREMENT MoCSCC_varStructCpl_Core1_10ms_Nr1.MoCSCC_stTrmDevCpl "Instance for specific core and task / Complement of trimmed device" UBYTE OneToOne 1 100 0.00 255.0 FORMAT "%5.1" ECU_ADDRESS 0x60011DC1 /end MEASUREMENT
/begin MEASUREMENT MoCSCC_varStructCpl_Core1_10ms_Nr1.MoCSCC_cntrMPURegChkCpl "Instance for specific core and task / Complement of counter of MPU registers to be checked" UBYTE OneToOne 1 100 0.00 255.0 FORMAT "%5.1" ECU_ADDRESS 0x60011DC2 /end MEASUREMENT
/begin MEASUREMENT MoCSCC_varStructNVRAM_Core1_10ms_Nr1.MoCSCC_cntrDebMaxNv "Instance for specific core and task / Max value indicator for error debounce counter of configuration check error" UBYTE OneToOne 1 100 0.00 255.0 FORMAT "%5.1" ECU_ADDRESS 0x60037FD4 /end MEASUREMENT
/begin MEASUREMENT MoCSCC_varStructNVRAM_Core1_10ms_Nr1.MoCSCC_cntrDebExcddThdNv "Instance for specific core and task / Counter to store the number of times error debounce counter of configuration check error exceeds the threshold value" UBYTE OneToOne 1 100 0.00 255.0 FORMAT "%5.1" ECU_ADDRESS 0x60037FD5 /end MEASUREMENT
/begin MEASUREMENT MoCSCC_varStructNVRAM_Core1_10ms_Nr1.MoCSCC_cntrDebOld "Instance for specific core and task / Counter to store the old value of error debounce counter of configuration check error" UBYTE OneToOne 1 100 0.00 255.0 FORMAT "%5.1" ECU_ADDRESS 0x60037FD6 /end MEASUREMENT
/begin MEASUREMENT MoCSCC_varStruct_Core1_10ms_Nr1.MoCSCC_stErr "Instance for specific core and task / Status word to report configuration check error" UWORD OneToOne 1 100 0.00 65535.00 FORMAT "%8.2" ECU_ADDRESS 0x60012724 /end MEASUREMENT
/begin MEASUREMENT MoCSCC_varStruct_Core1_10ms_Nr1.MoCSCC_cntrDeb "Instance for specific core and task / Debounce counter for configuration check error" UBYTE OneToOne 1 100 0.00 255.0 FORMAT "%5.1" ECU_ADDRESS 0x60012726 /end MEASUREMENT
/begin MEASUREMENT MoCSCC_varStruct_Core1_10ms_Nr1.MoCSCC_stTrmDev "Instance for specific core and task / Trimmed device" UBYTE OneToOne 1 100 0.00 255.0 FORMAT "%5.1" ECU_ADDRESS 0x60012727 /end MEASUREMENT
/begin MEASUREMENT MoCSCC_varStruct_Core1_10ms_Nr1.MoCSCC_stChpId "Instance for specific core and task / Cpu version" ULONG OneToOne 1 100 0.00 4294967295.00 FORMAT "%13.2" ECU_ADDRESS 0x60012728 /end MEASUREMENT
/begin MEASUREMENT MoCSCC_varStruct_Core1_10ms_Nr1.MoCSCC_cntrMPURegChk "Instance for specific core and task / Counter of MPU registers to be checked" UBYTE OneToOne 1 100 0.00 255.0 FORMAT "%5.1" ECU_ADDRESS 0x6001272C /end MEASUREMENT
/begin MEASUREMENT MoExe_varStructCpl_Core1_10ms_Nr1.MoExe_ctCycCpl "Instance for specific core and task / Instance for specific core and task" UBYTE OneToOne 1 100 0.00 255.0 FORMAT "%5.1" ECU_ADDRESS 0x60011DB8 /end MEASUREMENT
/begin MEASUREMENT MoExe_varStruct_Core1_10ms_Nr1.MoExe_ctCyc "Instance for specific core and task / Instance structure for MoExe_Co scheduling counter" UBYTE OneToOne 1 100 0.00 255.0 FORMAT "%5.1" ECU_ADDRESS 0x60012721 /end MEASUREMENT
/begin MEASUREMENT MoGlbl_bbLocExtdTskCpl "duplicate storage for MoGlbl_bbLocExtdTskCpl" UBYTE OneToOne 1 100 0.00 255.0 FORMAT "%5.1" ECU_ADDRESS 0x60011805 /end MEASUREMENT
/begin MEASUREMENT MoGlbl_vblStruct.Mo_stMoC "structure variable for instancing concept / Instance variable for Mo_stMoC" UBYTE OneToOne 1 100 0.00 255.0 FORMAT "%5.1" ECU_ADDRESS 0x60011EB8 /end MEASUREMENT
/begin MEASUREMENT MoGlbl_vblStructCpl.Mo_stCplChk "structure for instancing concept / Instance variable for Mo_stCplChk" ULONG OneToOne 1 100 0.00 4294967295.00 FORMAT "%13.2" ECU_ADDRESS 0x600117F0 /end MEASUREMENT
/begin MEASUREMENT MoGlbl_vblStructCpl.Mo_stMoCCpl "structure for instancing concept / Instance variable for Mo_stMoCCpl" UBYTE OneToOne 1 100 0.00 255.0 FORMAT "%5.1" ECU_ADDRESS 0x600117F4 /end MEASUREMENT
/begin MEASUREMENT MoGlbl_vblStructCpl_Core1_10ms_Nr1.Mo_stCplChk "Instance for specific core and task / Instance variable for Mo_stCplChk" ULONG OneToOne 1 100 0.00 4294967295.00 FORMAT "%13.2" ECU_ADDRESS 0x60011DB0 /end MEASUREMENT
/begin MEASUREMENT MoGlbl_vblStructCpl_Core1_10ms_Nr1.Mo_stMoCCpl "Instance for specific core and task / Instance variable for Mo_stMoCCpl" UBYTE OneToOne 1 100 0.00 255.0 FORMAT "%5.1" ECU_ADDRESS 0x60011DB4 /end MEASUREMENT
/begin MEASUREMENT MoGlbl_vblStruct_Core1_10ms_Nr1.Mo_stMoC "Instance for specific core and task / Instance variable for Mo_stMoC" UBYTE OneToOne 1 100 0.00 255.0 FORMAT "%5.1" ECU_ADDRESS 0x60012720 /end MEASUREMENT
/begin MEASUREMENT Mo_bAddConPFC "Generation of additional Response Contributions to program Folw Check" UBYTE B_TRUE 1 100 0.00 1.00000000000 BIT_MASK 0x80 FORMAT "%13.11" ECU_ADDRESS 0x60011EBA /end MEASUREMENT
/begin MEASUREMENT Mo_bAddConPFCExtdTsk "Generation of additional Response Contributions to program Folw Check in the extended task" UBYTE B_TRUE 1 100 0.00 1.00000000000 BIT_MASK 0x80 FORMAT "%13.11" ECU_ADDRESS 0x60011EB9 /end MEASUREMENT
/begin MEASUREMENT Mo_bAddDisblPreICORst "Additional condition disable Pre-ICO reset in function monitoring" UBYTE B_TRUE 1 100 0.00 1.00000000000 BIT_MASK 0x8 FORMAT "%13.11" ECU_ADDRESS 0x60011EBA /end MEASUREMENT
/begin MEASUREMENT Mo_bAddDisblPreICORstExtdTsk "Additional condition disable Pre-ICO reset in function monitoring in the extended task" UBYTE B_TRUE 1 100 0.00 1.00000000000 BIT_MASK 0x8 FORMAT "%13.11" ECU_ADDRESS 0x60011EB9 /end MEASUREMENT
/begin MEASUREMENT Mo_bCplChk "Fault reaction requirement from cyclic RAM safeguarding in function monitoring" UBYTE B_TRUE 1 100 0.00 1.00000000000 BIT_MASK 0x1 FORMAT "%13.11" ECU_ADDRESS 0x60011EBC /end MEASUREMENT
/begin MEASUREMENT Mo_bCplChkExtdTsk "Fault reaction requirement from cyclic RAM safeguarding in function monitoring in the extended task" UBYTE B_TRUE 1 100 0.00 1.00000000000 BIT_MASK 0x1 FORMAT "%13.11" ECU_ADDRESS 0x60011EBB /end MEASUREMENT
/begin MEASUREMENT Mo_bEmgcyAir "Request standby air driving from level1 in function monitoring" UBYTE B_TRUE 1 100 0.00 1.00000000000 BIT_MASK 0x20 FORMAT "%13.11" ECU_ADDRESS 0x60011EBA /end MEASUREMENT
/begin MEASUREMENT Mo_bICOL1 "Injection Cut Off demand from Level 1" UBYTE B_TRUE 1 100 0.00 1.00000000000 BIT_MASK 0x2 FORMAT "%13.11" ECU_ADDRESS 0x60011EBA /end MEASUREMENT
/begin MEASUREMENT Mo_bICOL2 "Injection Cut Off demand from Level 2" UBYTE B_TRUE 1 100 0.00 1.00000000000 BIT_MASK 0x1 FORMAT "%13.11" ECU_ADDRESS 0x60011EBA /end MEASUREMENT
/begin MEASUREMENT Mo_bICOL2ExtdTsk "Injection Cut Off demand from Level 2 in the extended task" UBYTE B_TRUE 1 100 0.00 1.00000000000 BIT_MASK 0x1 FORMAT "%13.11" ECU_ADDRESS 0x60011EB9 /end MEASUREMENT
/begin MEASUREMENT Mo_bIrvElMIdl "irreversible idle request for the electric motor" UBYTE B_TRUE 1 100 0.00 1.00000000000 BIT_MASK 0x20 FORMAT "%13.11" ECU_ADDRESS 0x60011EBD /end MEASUREMENT
/begin MEASUREMENT Mo_bIrvHybLimpL1 "Irreversible hybrid-limp-home mode requested from level 1" UBYTE B_TRUE 1 100 0.00 1.00000000000 BIT_MASK 0x2 FORMAT "%13.11" ECU_ADDRESS 0x60011EBD /end MEASUREMENT
/begin MEASUREMENT Mo_bIrvHybLimpL2 "Irreversible hybrid-limp-home mode requested from level 2" UBYTE B_TRUE 1 100 0.00 1.00000000000 BIT_MASK 0x1 FORMAT "%13.11" ECU_ADDRESS 0x60011EBD /end MEASUREMENT
/begin MEASUREMENT Mo_bIrvHybP1LimpL2 "Irreversible limp home mode P1 hybrid from level 2 in function monitoring" UBYTE B_TRUE 1 100 0.00 1.00000000000 BIT_MASK 0x10 FORMAT "%13.11" ECU_ADDRESS 0x60011EBD /end MEASUREMENT
/begin MEASUREMENT Mo_bIrvTrqLimL1 "Irreversible torque limitation from level 1 in function monitoring" UBYTE B_TRUE 1 100 0.00 1.00000000000 BIT_MASK 0x8 FORMAT "%13.11" ECU_ADDRESS 0x60011EBD /end MEASUREMENT
/begin MEASUREMENT Mo_bIrvTrqLimL2 "Irreversible torque limitation from level 2 in function monitoring" UBYTE B_TRUE 1 100 0.00 1.00000000000 BIT_MASK 0x4 FORMAT "%13.11" ECU_ADDRESS 0x60011EBD /end MEASUREMENT
/begin MEASUREMENT Mo_bLoVltg "Battery voltage not OK, undervoltage shut-off active" UBYTE B_TRUE 1 100 0.00 1.00000000000 BIT_MASK 0x4 FORMAT "%13.11" ECU_ADDRESS 0x60011EBA /end MEASUREMENT
/begin MEASUREMENT Mo_bNlh "irreversible demand of non-lean operation mode from function monitoring" UBYTE B_TRUE 1 100 0.00 1.00000000000 BIT_MASK 0x10 FORMAT "%13.11" ECU_ADDRESS 0x60011EBA /end MEASUREMENT
/begin MEASUREMENT Mo_bRamErr "RAM error occured in cyclic check" UBYTE B_TRUE 1 100 0.00 1.00000000000 BIT_MASK 0x2 FORMAT "%13.11" ECU_ADDRESS 0x60011EBC /end MEASUREMENT
/begin MEASUREMENT Mo_bRamErrExtdTsk "RAM error occured in cyclic check" UBYTE B_TRUE 1 100 0.00 1.00000000000 BIT_MASK 0x2 FORMAT "%13.11" ECU_ADDRESS 0x60011EBB /end MEASUREMENT
/begin MEASUREMENT Mo_bRomErr "ROM error occured in cyclic check" UBYTE B_TRUE 1 100 0.00 1.00000000000 BIT_MASK 0x4 FORMAT "%13.11" ECU_ADDRESS 0x60011EBC /end MEASUREMENT
/begin MEASUREMENT Mo_bSyncLos "condition loss of synchronization in function monitoring" UBYTE B_TRUE 1 100 0.00 1.00000000000 BIT_MASK 0x40 FORMAT "%13.11" ECU_ADDRESS 0x60011EBA /end MEASUREMENT
/begin MEASUREMENT Mo_ctRst "Reset counter" UBYTE OneToOne 1 100 0.00 255.0 FORMAT "%5.1" ECU_ADDRESS 0x60034755 /end MEASUREMENT
/begin MEASUREMENT Mo_ctRstCpl "RAM data redundancy of Mo_ctRst" UBYTE OneToOne 1 100 0.00 255.0 FORMAT "%5.1" ECU_ADDRESS 0x60034754 /end MEASUREMENT
/begin MEASUREMENT Mo_ctRstMsg "Reset counter" UBYTE OneToOne 1 100 0.00 255.0 FORMAT "%5.1" ECU_ADDRESS 0x6000A322 /end MEASUREMENT
/begin MEASUREMENT Mo_flgICOMsg "flag for layer 1: error reaction injection quantities limitation from the monitoring" UBYTE B_TRUE 1 100 0.00 1.00000000000 BIT_MASK 0x1 FORMAT "%13.11" ECU_ADDRESS 0x6000A170 /end MEASUREMENT
/begin MEASUREMENT Mo_stCplChk "Complementcheck failed" ULONG OneToOne 1 100 0.00 4294967295.00 FORMAT "%13.2" ECU_ADDRESS 0x600117FC /end MEASUREMENT
/begin MEASUREMENT Mo_stErrHyb "Status Bits for demands of error reaction hybrid system in function monitoring" UBYTE OneToOne 1 100 0.00 255.0 FORMAT "%5.1" ECU_ADDRESS 0x60011EBD /end MEASUREMENT
/begin MEASUREMENT Mo_stErrHybCpl "RAM data redundancy of Mo_stErrHyb" UBYTE OneToOne 1 100 0.00 255.0 FORMAT "%5.1" ECU_ADDRESS 0x60011804 /end MEASUREMENT
/begin MEASUREMENT Mo_stMoC "Status Bits for demands of error reaction in controller monitoring" UBYTE OneToOne 1 100 0.00 255.0 FORMAT "%5.1" ECU_ADDRESS 0x60011EBC /end MEASUREMENT
/begin MEASUREMENT Mo_stMoCCpl "RAM data redundancy of Mo_stMoC" UBYTE OneToOne 1 100 0.00 255.0 FORMAT "%5.1" ECU_ADDRESS 0x60011803 /end MEASUREMENT
/begin MEASUREMENT Mo_stMoCExtdTsk "Status bits for the error reaction request in the monitoring processor" UBYTE OneToOne 1 100 0.00 255.0 FORMAT "%5.1" ECU_ADDRESS 0x60011EBB /end MEASUREMENT
/begin MEASUREMENT Mo_stMoCExtdTskCpl "Complement value for Mo_stMoCExtdTsk" UBYTE OneToOne 1 100 0.00 255.0 FORMAT "%5.1" ECU_ADDRESS 0x60011802 /end MEASUREMENT
/begin MEASUREMENT Mo_stMoCExtdTskMsg "Message containing status bits for the error reaction request in the monitoring processor" UBYTE OneToOne 1 100 0.00 255.0 FORMAT "%5.1" ECU_ADDRESS 0x6000A321 /end MEASUREMENT
/begin MEASUREMENT Mo_stMoCMsg "Message containing status Bits for demands of error reaction in controller monitoring" UBYTE OneToOne 1 100 0.00 255.0 FORMAT "%5.1" ECU_ADDRESS 0x6000A320 /end MEASUREMENT
/begin MEASUREMENT Mo_stMoF "Status Bits for demands of error reaction in function monitoring" UBYTE OneToOne 1 100 0.00 255.0 FORMAT "%5.1" ECU_ADDRESS 0x60011EBA /end MEASUREMENT
/begin MEASUREMENT Mo_stMoFCpl "RAM data redundancy of Mo_stMoF" UBYTE OneToOne 1 100 0.00 255.0 FORMAT "%5.1" ECU_ADDRESS 0x60011801 /end MEASUREMENT
/begin MEASUREMENT Mo_stMoFExtdTsk "Status Bits for demands of error reaction in function monitoring in the extended task" UBYTE OneToOne 1 100 0.00 255.0 FORMAT "%5.1" ECU_ADDRESS 0x60011EB9 /end MEASUREMENT
/begin MEASUREMENT Mo_stMoFExtdTskCpl "RAM data redundancy of Mo_stMoFExtdTsk" UBYTE OneToOne 1 100 0.00 255.0 FORMAT "%5.1" ECU_ADDRESS 0x60011800 /end MEASUREMENT
/begin MEASUREMENT Mo_stMoFExtdTskMsg "Message containing status Bits for demands of error reaction in function monitoring in the extended task" UBYTE OneToOne 1 100 0.00 255.0 FORMAT "%5.1" ECU_ADDRESS 0x6000A31F /end MEASUREMENT
/begin MEASUREMENT Mo_stMoFMsg "Msg for L1of Status Bits for demands of error reaction in function monitoring" UBYTE OneToOne 1 100 0.00 255.0 FORMAT "%5.1" ECU_ADDRESS 0x6000A31E /end MEASUREMENT
/begin MEASUREMENT Mo_stProtRAM "status of Prot RAM initialisation of error monitoring" UBYTE OneToOne 1 100 0.00 255.0 FORMAT "%5.1" ECU_ADDRESS 0x60034756 /end MEASUREMENT
/begin MEASUREMENT Mo_stVldR32Chk "status to determine if the ValidR32 check failed" ULONG OneToOne 1 100 0.00 4294967295.00 FORMAT "%13.2" ECU_ADDRESS 0x600117F8 /end MEASUREMENT
/begin MEASUREMENT MRlyst_Sq "signal quality message for Main relay status" UBYTE SigQly_COMPU_VERB 1 100 0.00 15.0000000000 FORMAT "%13.10" ECU_ADDRESS 0x6000A33B /end MEASUREMENT
/begin MEASUREMENT MRly_st "Request to switch on and off the main relay" UBYTE OneToOne 1 100 0.00 255.0 BIT_MASK 0x1 FORMAT "%5.1" ECU_ADDRESS 0x6000A6D9 /end MEASUREMENT
/begin MEASUREMENT MRly_stAct "Status of main relay" UBYTE OneToOne 1 100 0.00 255.0 FORMAT "%5.1" ECU_ADDRESS 0x6000A6F4 /end MEASUREMENT
/begin MEASUREMENT msudksom_w_msg "desired standardized overcritical air mass flow without torque structure" UWORD m_uw_b6553p5 1 100 0.00 6553.500 FORMAT "%8.3" ECU_ADDRESS 0x60004BCA /end MEASUREMENT
/begin MEASUREMENT nllkh_msg "Idling speed for catalyzer heating" UBYTE nmot_q10 1 100 0.00 2550. FORMAT "%5.0" ECU_ADDRESS 0x6000E456 /end MEASUREMENT
/begin MEASUREMENT nmfskh "Idling speed for catalyzer heating when drive position is engaged" UBYTE nmot_q10 1 100 0.00 2550. FORMAT "%5.0" ECU_ADDRESS 0x60006323 /end MEASUREMENT
/begin MEASUREMENT nmfskhgs "Gasoline Idling speed for catalyzer heating when drive position is engaged" UBYTE nmot_q10 1 100 0.00 2550. FORMAT "%5.0" ECU_ADDRESS 0x60006322 /end MEASUREMENT
/begin MEASUREMENT nmllkh "Idling speed for catalyzer heating (drive position not engaged)" UBYTE nmot_q10 1 100 0.00 2550. FORMAT "%5.0" ECU_ADDRESS 0x60006321 /end MEASUREMENT
/begin MEASUREMENT nmllkhgs "gasoline Idling speed for catalyzer heating (drive position not engaged)" UBYTE nmot_q10 1 100 0.00 2550. FORMAT "%5.0" ECU_ADDRESS 0x60006320 /end MEASUREMENT
/begin MEASUREMENT nmotllkh "Idling speed for catalyzer heating" UBYTE nmot_q10 1 100 0.00 2550. FORMAT "%5.0" ECU_ADDRESS 0x6000631F /end MEASUREMENT
/begin MEASUREMENT nmotOilSwmpT "Engine speed used for OilSwmpT" UBYTE nmot_ub_q40 1 100 0.00 10200. FORMAT "%5.0" ECU_ADDRESS 0x60006319 /end MEASUREMENT
/begin MEASUREMENT NSHTD_ctReIni "Re-initialization counter" UBYTE OneToOne 1 100 0.00 255.0 FORMAT "%5.1" ECU_ADDRESS 0x60006336 /end MEASUREMENT
/begin MEASUREMENT NSHTI_B_st "condition for start" UBYTE B_TRUE 1 100 0.00 1.00000000000 BIT_MASK 0x1 FORMAT "%13.11" ECU_ADDRESS 0x7000016D /end MEASUREMENT
/begin MEASUREMENT NSHTI_ctIniDrv "counter for NSHTI initiation" UBYTE OneToOne 1 100 0.00 255.0 FORMAT "%5.1" ECU_ADDRESS 0x6000632C /end MEASUREMENT
/begin MEASUREMENT NSHTI_facCorrnHiAltiAvdNvh "Correction factor at high altitude to avoid noise, vibration and harshness when vehicle is in parking or neutral position." UWORD fak_uw_b4 1 100 0.00 3.999939 FORMAT "%8.6" ECU_ADDRESS 0x60003692 /end MEASUREMENT
/begin MEASUREMENT NSHTI_facCorrnHiAltiAvdNvhDrvg "Correction factor at high altitude to avoid noise, vibration and harshness during driving." UWORD fak_uw_b4 1 100 0.00 3.999939 FORMAT "%8.6" ECU_ADDRESS 0x60003690 /end MEASUREMENT
/begin MEASUREMENT NSHTI_flgHiAltiLimActv "Flag to indicate high altitude limitation is active" UBYTE B_TRUE 1 100 0.00 1.00000000000 BIT_MASK 0x1 FORMAT "%13.11" ECU_ADDRESS 0x6000A16F /end MEASUREMENT
/begin MEASUREMENT NSHTI_nHiAltiAvdNvhDrvgLoc "Local low idle set point at high altitude to avoid Noise, vibration and harshness during driving" UBYTE nmot_ub_q10 1 100 0.00 2550. FORMAT "%5.0" ECU_ADDRESS 0x60006333 /end MEASUREMENT
/begin MEASUREMENT NSHTI_nHiAltiAvdNvhDrvgTmp "Temporary low idle set point at high altitude to avoid Noise, vibration and harshness during driving" UBYTE nmot_ub_q10 1 100 0.00 2550. FORMAT "%5.0" ECU_ADDRESS 0x60006332 /end MEASUREMENT
/begin MEASUREMENT NSHTI_nHiAltiAvdNvhIdle "Low idle set point at high altitude to avoid Noise, vibration and harshness when vehicle is in parking or neutral position" UBYTE nmot_ub_q10 1 100 0.00 2550. FORMAT "%5.0" ECU_ADDRESS 0x6000A31D /end MEASUREMENT
/begin MEASUREMENT NSHTI_nHiAltiAvdNvhIdleDrvg "Low idle set point at high altitude to avoid Noise, vibration and harshness during driving." UBYTE nmot_ub_q10 1 100 0.00 2550. FORMAT "%5.0" ECU_ADDRESS 0x6000A31C /end MEASUREMENT
/begin MEASUREMENT NSHTI_nHiAltiAvdNvhIdleLoc "Local Low idle set point at high altitude to avoid Noise, vibration and harshness when vehicle is in parking or neutral position" UBYTE nmot_ub_q10 1 100 0.00 2550. FORMAT "%5.0" ECU_ADDRESS 0x60006331 /end MEASUREMENT
/begin MEASUREMENT NSHTI_nHiAltiAvdNvhIdleTmp "Temporary Low idle set point at high altitude to avoid Noise, vibration and harshness when vehicle is in parking or neutral position" UBYTE nmot_ub_q10 1 100 0.00 2550. FORMAT "%5.0" ECU_ADDRESS 0x60006330 /end MEASUREMENT
/begin MEASUREMENT NSHTI_nHiAltiAvdNvhLoIdleSp "Low idle set point at high altitude to avoid Noise, vibration and harshness" UBYTE nmot_ub_q10 1 100 0.00 2550. FORMAT "%5.0" ECU_ADDRESS 0x6000A31B /end MEASUREMENT
/begin MEASUREMENT NSHTI_nLimHiAltiLoIdleSp "Low idle set point limitation at high altitude" UBYTE nmot_ub_q10 1 100 0.00 2550. FORMAT "%5.0" ECU_ADDRESS 0x6000A31A /end MEASUREMENT
/begin MEASUREMENT NSHTI_nmotloc "local variable in nshti" UBYTE nmot_ub_q40 1 100 0.00 10200. FORMAT "%5.0" ECU_ADDRESS 0x6000632B /end MEASUREMENT
/begin MEASUREMENT NSHTI_rlloc "local variable in nshti" UBYTE rel_ub_q0p75 1 100 0.00 191.3 FORMAT "%5.1" ECU_ADDRESS 0x6000632A /end MEASUREMENT
/begin MEASUREMENT NSHTI_tans "intake air temperature" UBYTE temp_ub_q0p75_o48 1 100 -48.0 143.3 FORMAT "%5.1" ECU_ADDRESS 0x6000632F /end MEASUREMENT
/begin MEASUREMENT NSHTI_tmstloc "engine temperature at start" UBYTE temp_ub_q0p75_o48 1 100 -48.0 143.3 FORMAT "%5.1" ECU_ADDRESS 0x6000632E /end MEASUREMENT
/begin MEASUREMENT NSHTI_tolc "oil temperature from combi or from COWIV" UBYTE temp_ub_q1_o60 1 100 -60.0 195.0 FORMAT "%5.1" ECU_ADDRESS 0x60006329 /end MEASUREMENT
/begin MEASUREMENT nsmodhtd_msg "Mode desired idling speed, heating demand" UBYTE OneToOne 1 100 0.00 255.0 FORMAT "%5.1" ECU_ADDRESS 0x6000A29A /end MEASUREMENT
/begin MEASUREMENT nsmodlph_msg "Mode desired idling speed, limp-home" UBYTE dez 1 100 0.00 255.0 FORMAT "%5.1" ECU_ADDRESS 0x6000A299 /end MEASUREMENT
/begin MEASUREMENT nsolblp_msg "Desired idling speed, boiling protection" UBYTE nmot_q10 1 100 0.00 2550. FORMAT "%5.0" ECU_ADDRESS 0x6000A297 /end MEASUREMENT
/begin MEASUREMENT nsolcat_msg "Desired idling speed, catalyst heating" UBYTE nmot_q10 1 100 0.00 2550. FORMAT "%5.0" ECU_ADDRESS 0x6000E458 /end MEASUREMENT
/begin MEASUREMENT nsolht "Desired idling speed, depending of height and temperature of the environment" UBYTE nmot_q10 1 100 0.00 2550. FORMAT "%5.0" ECU_ADDRESS 0x6000632D /end MEASUREMENT
/begin MEASUREMENT nsolhtdtm "Desired idling speed, heating demand according to coolant temp." UBYTE nmot_ub_q10 1 100 0.00 2550. FORMAT "%5.0" ECU_ADDRESS 0x60006335 /end MEASUREMENT
/begin MEASUREMENT nsolhtdtum "Desired idling speed, heating demand according to ambient air temp." UBYTE nmot_ub_q10 1 100 0.00 2550. FORMAT "%5.0" ECU_ADDRESS 0x60006334 /end MEASUREMENT
/begin MEASUREMENT nsolhtd_msg "Desired idling speed, heating demand according to ambient air temperature" UBYTE nmot_ub_q10 1 100 0.00 2550. FORMAT "%5.0" ECU_ADDRESS 0x6000A296 /end MEASUREMENT
/begin MEASUREMENT nsolhti_msg "Desired idling speed, hot idling" UBYTE nmot_q10 1 100 0.00 2550. FORMAT "%5.0" ECU_ADDRESS 0x6000A295 /end MEASUREMENT
/begin MEASUREMENT nsollph_msg "Desired idling speed, limp-home" UBYTE nmot_q10 1 100 0.00 2550. FORMAT "%5.0" ECU_ADDRESS 0x6000A294 /end MEASUREMENT
/begin MEASUREMENT nsolpts_msg "Desired idling speed, post start" UBYTE nmot_q10 1 100 0.00 2550. FORMAT "%5.0" ECU_ADDRESS 0x60009FE8 /end MEASUREMENT
/begin MEASUREMENT NSPTS_ctIniDrv "function specific counter for detection of state change" UBYTE OneToOne 1 100 0.00 255.0 FORMAT "%5.1" ECU_ADDRESS 0x6000A02D /end MEASUREMENT
/begin MEASUREMENT NSPTS_tmotloc "engine temperature at start" SWORD temp_ub_q0p75_o48 1 100 -24624.00 24527.25 FORMAT "%8.2" ECU_ADDRESS 0x6000367C /end MEASUREMENT
/begin MEASUREMENT NSPTS_tnstloc "time after end of start" UBYTE t1sxs_ub_b255 1 100 0.00 255.0 FORMAT "%5.1" ECU_ADDRESS 0x6000631E /end MEASUREMENT
/begin MEASUREMENT nstoel_tmp "desired idle speed , oil temperature" UBYTE nmot_ub_q10 1 100 0.00 2550. FORMAT "%5.0" ECU_ADDRESS 0x6000A290 /end MEASUREMENT
/begin MEASUREMENT OCWDA_ctBattU "Debounce counter for stable battery voltage" UBYTE OneToOne 1 100 0.00 255.0 FORMAT "%5.1" ECU_ADDRESS 0x6000A319 /end MEASUREMENT
/begin MEASUREMENT OCWDA_ctDebActvErr "Debounce counter for Error Pin, WDA, ABE active" UBYTE OneToOne 1 100 0.00 255.0 FORMAT "%5.1" ECU_ADDRESS 0x6000A318 /end MEASUREMENT
/begin MEASUREMENT OCWDA_ctDebErrNotActv "Debounce counter for healing inactive Error Pin, WDA, ABE" UBYTE OneToOne 1 100 0.00 255.0 FORMAT "%5.1" ECU_ADDRESS 0x6000A317 /end MEASUREMENT
/begin MEASUREMENT OCWDA_ctDebOvrVltgOn "Debounce counter for overvoltage on detection" UWORD OneToOne 1 100 0.00 65535.00 FORMAT "%8.2" ECU_ADDRESS 0x60004C74 /end MEASUREMENT
/begin MEASUREMENT OCWDA_ctTstOCWDA "Debounce counter for setting of test- or errorflags" UBYTE OneToOne 1 100 0.00 255.0 FORMAT "%5.1" ECU_ADDRESS 0x6000A316 /end MEASUREMENT
/begin MEASUREMENT OCWDA_ctTstOvrVltg "Counter for setting test flag in WDA-diagnosis of the overvoltage check" UWORD OneToOne 1 100 0.00 65535.00 FORMAT "%8.2" ECU_ADDRESS 0x60004C72 /end MEASUREMENT
/begin MEASUREMENT OCWDA_flgClrDebDFC "Flag bit to indicate request to clear fault memory" UBYTE OneToOne 1 100 0.00 255.0 FORMAT "%5.1" ECU_ADDRESS 0x6000A02C /end MEASUREMENT
/begin MEASUREMENT OCWDA_stABEActv "Internal ABE status" UBYTE OneToOne 1 100 0.00 255.0 FORMAT "%5.1" ECU_ADDRESS 0x6000A315 /end MEASUREMENT
/begin MEASUREMENT OCWDA_stCheckState "Variable contains the current state of the WDA diagnosis task" ULONG OneToOne 1 100 0.00 4294967295.00 FORMAT "%13.2" ECU_ADDRESS 0x60001C58 /end MEASUREMENT
/begin MEASUREMENT OCWDA_stErrMonPtt "Status information for diagnosis process to set failure entry" ULONG OneToOne 1 100 0.00 4294967295.00 FORMAT "%13.2" ECU_ADDRESS 0x6000D730 /end MEASUREMENT
/begin MEASUREMENT OCWDA_stErrPinActv "Internal Error Pin status" UBYTE OneToOne 1 100 0.00 255.0 FORMAT "%5.1" ECU_ADDRESS 0x6000A314 /end MEASUREMENT
/begin MEASUREMENT OCWDA_stOvrVltgActv "Internal status of overvoltage at powerstage modul" UBYTE OneToOne 1 100 0.00 255.0 FORMAT "%5.1" ECU_ADDRESS 0x6000A313 /end MEASUREMENT
/begin MEASUREMENT OCWDA_stWDAActv "Internal WDA status" UBYTE OneToOne 1 100 0.00 255.0 FORMAT "%5.1" ECU_ADDRESS 0x6000A312 /end MEASUREMENT
/begin MEASUREMENT OilSwmpT_bengrot "Condition: motor is rotating" UBYTE B_TRUE 1 100 0.00 1.00000000000 BIT_MASK 0x1 FORMAT "%13.11" ECU_ADDRESS 0x700006B6 /end MEASUREMENT
/begin MEASUREMENT OilSwmpT_bgtumg "validity of ambient temperature, set if model parth is determined, valid and actual or if there is no error in the sensor value" UBYTE B_TRUE 1 100 0.00 1.00000000000 BIT_MASK 0x1 FORMAT "%13.11" ECU_ADDRESS 0x700006B5 /end MEASUREMENT
/begin MEASUREMENT OilSwmpT_bsa "Fuel cut-off" UBYTE B_TRUE 1 100 0.00 1.00000000000 BIT_MASK 0x1 FORMAT "%13.11" ECU_ADDRESS 0x700006B4 /end MEASUREMENT
/begin MEASUREMENT OilSwmpT_btengsr "Flag: counters of soak time are reset" UBYTE B_TRUE 1 100 0.00 1.00000000000 BIT_MASK 0x1 FORMAT "%13.11" ECU_ADDRESS 0x700006B3 /end MEASUREMENT
/begin MEASUREMENT OilSwmpT_btumgg "condition: ambient air temperature sensormodel is error free" UBYTE B_TRUE 1 100 0.00 1.00000000000 BIT_MASK 0x1 FORMAT "%13.11" ECU_ADDRESS 0x700006B2 /end MEASUREMENT
/begin MEASUREMENT OilSwmpT_bVldMdlENVRAM "Local variable to indicate validity of EEP elements used for model" UBYTE B_TRUE 1 100 0.00 1.00000000000 BIT_MASK 0x1 FORMAT "%13.11" ECU_ADDRESS 0x70000150 /end MEASUREMENT
/begin MEASUREMENT OilSwmpT_dtMdlElecDrv "gradient of model temperature in operating state Engine off, ECU on" SWORD temp_q0p0234 1 100 -768.0000 767.9766 FORMAT "%8.4" ECU_ADDRESS 0x6000366E /end MEASUREMENT
/begin MEASUREMENT OilSwmpT_flgEngStopFrz "Flag: Engine stop for the oil temperatures detected" UBYTE B_TRUE 1 100 0.00 1.00000000000 BIT_MASK 0x1 FORMAT "%13.11" ECU_ADDRESS 0x7000015A /end MEASUREMENT
/begin MEASUREMENT OilSwmpT_flgMdlPrs "Oil temperature model is availiable" UBYTE B_TRUE 1 100 0.00 1.00000000000 BIT_MASK 0x1 FORMAT "%13.11" ECU_ADDRESS 0x700006B0 /end MEASUREMENT
/begin MEASUREMENT OilSwmpT_flgMdlRstIni "Reset flag of the Oil temperature model" UBYTE B_TRUE 1 100 0.00 1.00000000000 BIT_MASK 0x1 FORMAT "%13.11" ECU_ADDRESS 0x7000014F /end MEASUREMENT
/begin MEASUREMENT OilSwmpT_flgOilSwmpTCmbdSnsrAvl "Flag to indicalte sensor availability" UBYTE B_TRUE 1 100 0.00 1.00000000000 BIT_MASK 0x1 FORMAT "%13.11" ECU_ADDRESS 0x70000159 /end MEASUREMENT
/begin MEASUREMENT OilSwmpT_flgOilSwmpTMdlAvl "Flag: Oil temperature model available for the substitute value circuit" UBYTE B_TRUE 1 100 0.00 1.00000000000 BIT_MASK 0x1 FORMAT "%13.11" ECU_ADDRESS 0x70000158 /end MEASUREMENT
/begin MEASUREMENT OilSwmpT_flgOilSwmpTSnsrAvl "Status flag: Oil temperature sensor is present and OK" UBYTE B_TRUE 1 100 0.00 1.00000000000 BIT_MASK 0x1 FORMAT "%13.11" ECU_ADDRESS 0x70000157 /end MEASUREMENT
/begin MEASUREMENT OilSwmpT_flgOvrRunActvd "Status of fuel cut-off used for OilSwmpT" UBYTE B_TRUE 1 100 0.00 1.00000000000 BIT_MASK 0x1 FORMAT "%13.11" ECU_ADDRESS 0x7000014E /end MEASUREMENT
/begin MEASUREMENT OilSwmpT_flgOvrRun_loc "Status of fuel cut-off used for OilSwmpT" UBYTE B_TRUE 1 100 0.00 1.00000000000 BIT_MASK 0x1 FORMAT "%13.11" ECU_ADDRESS 0x7000014D /end MEASUREMENT
/begin MEASUREMENT OilSwmpT_flgPULSMdlHi "Flag model value is higher than the sensor value from combi-sensor" UBYTE B_TRUE 1 100 0.00 1.00000000000 BIT_MASK 0x1 FORMAT "%13.11" ECU_ADDRESS 0x70000156 /end MEASUREMENT
/begin MEASUREMENT OilSwmpT_flgTiEngOff_bEngRot_loc "Status of engine rotation used for OilSwmpT" UBYTE B_TRUE 1 100 0.00 1.00000000000 BIT_MASK 0x1 FORMAT "%13.11" ECU_ADDRESS 0x7000014C /end MEASUREMENT
/begin MEASUREMENT OilSwmpT_flgTiEngOff_bRst_loc "Status of B_tengsr for OilSwmpT" UBYTE B_TRUE 1 100 0.00 1.00000000000 BIT_MASK 0x1 FORMAT "%13.11" ECU_ADDRESS 0x7000014B /end MEASUREMENT
/begin MEASUREMENT OilSwmpT_flgTOSPMabVld "Flag: Engine temperature was valid at the time of the shut-off" UBYTE OneToOne 1 100 0.00 1.000 FORMAT "%5.3" ECU_ADDRESS 0x60036335 /end MEASUREMENT
/begin MEASUREMENT OilSwmpT_flgvdMdlPrsloc "Oil temperature model is availiable" UBYTE B_TRUE 1 100 0.00 1.00000000000 BIT_MASK 0x1 FORMAT "%13.11" ECU_ADDRESS 0x70000155 /end MEASUREMENT
/begin MEASUREMENT OilSwmpT_flgVldTWrmUp "Validity of engine temperature used for Oil temperature model." UBYTE B_TRUE 1 100 0.00 1.00000000000 BIT_MASK 0x1 FORMAT "%13.11" ECU_ADDRESS 0x60006318 /end MEASUREMENT
/begin MEASUREMENT OilSwmpT_idxTSrc "Index: source of the Oil temperature for OilSwmpT_t" UBYTE OneToOne 1 100 0.00 255.0 FORMAT "%5.1" ECU_ADDRESS 0x6000A02B /end MEASUREMENT
/begin MEASUREMENT OilSwmpT_idxTSrcADC "Index: Source of oil temperature for OilSwmpT_tADC" UBYTE OneToOne 1 100 0.00 255.0 FORMAT "%5.1" ECU_ADDRESS 0x6000631D /end MEASUREMENT
/begin MEASUREMENT OilSwmpT_idxTSrcDispl "Index: Source of oil temperature for OilSwmpT_tDispl" UBYTE OneToOne 1 100 0.00 255.0 FORMAT "%5.1" ECU_ADDRESS 0x6000631C /end MEASUREMENT
/begin MEASUREMENT OilSwmpT_idxTSrcPULS "Selection of the oil temperature source for OilSwmpT_tPULS" UBYTE OneToOne 1 100 0.00 255.0 FORMAT "%5.1" ECU_ADDRESS 0x6000631B /end MEASUREMENT
/begin MEASUREMENT OilSwmpT_nmot "engine speed for the oil temperature model" UBYTE nmot_ub_q40 1 100 0.00 10200. FORMAT "%5.0" ECU_ADDRESS 0x6000A02A /end MEASUREMENT
/begin MEASUREMENT OilSwmpT_stCmbdSnsrRplVal "Status to indicate the replacement value for the oil combined sensor" UBYTE OneToOne 1 100 0.00 255.0 FORMAT "%5.1" ECU_ADDRESS 0x60036341 /end MEASUREMENT
/begin MEASUREMENT OilSwmpT_stMdlElecDrvSaved "State of oil temperature modeling at ECU switch off" UBYTE dez 1 100 0.00 255.0 FORMAT "%5.1" ECU_ADDRESS 0x60036334 /end MEASUREMENT
/begin MEASUREMENT OilSwmpT_stPwrOnRstTMdl "Status indicates detection of power-On Reset" UBYTE B_TRUE 1 100 0.00 1.00000000000 BIT_MASK 0x1 FORMAT "%13.11" ECU_ADDRESS 0x7000014A /end MEASUREMENT
/begin MEASUREMENT OilSwmpT_stSigT "Signal quality for OilSwmpT_t" ULONG OneToOne 1 100 0.00 4294967295.00 FORMAT "%13.2" ECU_ADDRESS 0x60001BD4 /end MEASUREMENT
/begin MEASUREMENT OilSwmpT_stSigTADC "Signal quality for OilSwmpT_tADC" ULONG OneToOne 1 100 0.00 4294967295.00 FORMAT "%13.2" ECU_ADDRESS 0x60001BD0 /end MEASUREMENT
/begin MEASUREMENT OilSwmpT_stSigTDispl "status to indicate signal quality of the sensor value." UBYTE OneToOne 1 100 0.00 255.0 FORMAT "%5.1" ECU_ADDRESS 0x6000A029 /end MEASUREMENT
/begin MEASUREMENT OilSwmpT_stSigTPULS "Signal quality for OilSwmpT_tPULS" ULONG OneToOne 1 100 0.00 4294967295.00 FORMAT "%13.2" ECU_ADDRESS 0x60001BCC /end MEASUREMENT
/begin MEASUREMENT OilSwmpT_stTDisplStop "State of the oil temperature for indicating in the combi ECU at the time of engine switch-off" UBYTE OneToOne 1 100 0.00 255.0 FORMAT "%5.1" ECU_ADDRESS 0x6000A028 /end MEASUREMENT
/begin MEASUREMENT OilSwmpT_stTMdl "Status of the oil temperature model" UBYTE OneToOne 1 100 0.00 255.0 FORMAT "%5.1" ECU_ADDRESS 0x6000A026 /end MEASUREMENT
/begin MEASUREMENT OilSwmpT_stTMdlloc "local State of the oil temperature model" UBYTE OneToOne 1 100 0.00 255.0 FORMAT "%5.1" ECU_ADDRESS 0x60006317 /end MEASUREMENT
/begin MEASUREMENT OilSwmpT_stTSnsrRplVal "Status of the state machine of the replacement value switching for the oil-temperature-sensor" UBYTE OneToOne 1 100 0.00 255.0 FORMAT "%5.1" ECU_ADDRESS 0x60036340 /end MEASUREMENT
/begin MEASUREMENT OilSwmpT_stvdTMdlloc "Status of the oil temperature model" UBYTE OneToOne 1 100 0.00 255.0 FORMAT "%5.1" ECU_ADDRESS 0x6000631A /end MEASUREMENT
/begin MEASUREMENT OilSwmpT_t "Oil temperature" SWORD Temp_Cels 1 100 -273.140 3003.560 FORMAT "%8.3" ECU_ADDRESS 0x600049B0 /end MEASUREMENT
/begin MEASUREMENT OilSwmpT_tADC "Oil Temperature of sensor connected on ADC" SWORD Temp_Cels 1 100 -273.140 3003.560 FORMAT "%8.3" ECU_ADDRESS 0x600049AE /end MEASUREMENT
/begin MEASUREMENT OilSwmpT_tADCFltd "filtered Oil Temperature of sensor connected on ADC" SWORD Temp_Cels 1 100 -273.140 3003.560 FORMAT "%8.3" ECU_ADDRESS 0x600049AC /end MEASUREMENT
/begin MEASUREMENT OilSwmpT_tADCFltdStop "filtered Oil Temperature of sensor connected on ADC at Engine stop" SWORD Temp_Cels 1 100 -273.140 3003.560 FORMAT "%8.3" ECU_ADDRESS 0x600049AA /end MEASUREMENT
/begin MEASUREMENT OilSwmpT_tADCFltdStop_Sq "Signal quality of filtered Oil Temperature of sensor connected on ADC at Engine stop" UBYTE SigQly_COMPU_VERB 1 100 0.00 15.0000000000 FORMAT "%13.10" ECU_ADDRESS 0x6000A025 /end MEASUREMENT
/begin MEASUREMENT OilSwmpT_tADCFltd_Sq "Signal quality of filtered Oil Temperature of sensor connected on ADC" UBYTE SigQly_COMPU_VERB 1 100 0.00 15.0000000000 FORMAT "%13.10" ECU_ADDRESS 0x6000A024 /end MEASUREMENT
/begin MEASUREMENT OilSwmpT_tADCStop "Oil Temperature of sensor connected on ADC at Engine stop" SWORD Temp_Cels 1 100 -273.140 3003.560 FORMAT "%8.3" ECU_ADDRESS 0x600049A8 /end MEASUREMENT
/begin MEASUREMENT OilSwmpT_tADCStop_Sq "signal quality for oil temperature at engine stop (oil temperature sensor only)" UBYTE SigQly_COMPU_VERB 1 100 0.00 15.0000000000 FORMAT "%13.10" ECU_ADDRESS 0x6000A023 /end MEASUREMENT
/begin MEASUREMENT OilSwmpT_tADC_Sq "signal quality for oil temperature (oil temperature sensor only)" UBYTE SigQly_COMPU_VERB 1 100 0.00 15.0000000000 FORMAT "%13.10" ECU_ADDRESS 0x6000A022 /end MEASUREMENT
/begin MEASUREMENT OilSwmpT_tAdprSnsrFildLoc "filtered Oil Temperature of sensor" SWORD Temp_Cels 1 100 -273.140 3003.560 FORMAT "%8.3" ECU_ADDRESS 0x6000367A /end MEASUREMENT
/begin MEASUREMENT OilSwmpT_tAdprSnsrLoc "Sensed value of Oil Temperature" SWORD Temp_Cels 1 100 -273.140 3003.560 FORMAT "%8.3" ECU_ADDRESS 0x60003678 /end MEASUREMENT
/begin MEASUREMENT OilSwmpT_tdiffElecDrv "Difference in oil sump and ambient temperature" SWORD temp_q0p0234_o273 1 100 -273.1500 494.8266 FORMAT "%8.4" ECU_ADDRESS 0x6000366C /end MEASUREMENT
/begin MEASUREMENT OilSwmpT_tDispl "Oil Temperature for the display in the cockpit" SWORD Temp_Cels 1 100 -273.140 3003.560 FORMAT "%8.3" ECU_ADDRESS 0x600049A6 /end MEASUREMENT
/begin MEASUREMENT OilSwmpT_tDisplFltd "filtered Oil Temperature for the display in the cockpit" SWORD Temp_Cels 1 100 -273.140 3003.560 FORMAT "%8.3" ECU_ADDRESS 0x600049A4 /end MEASUREMENT
/begin MEASUREMENT OilSwmpT_tDisplFltdStop "filtered Oil Temperature for the display in the cockpit at engine stop" SWORD Temp_Cels 1 100 -273.140 3003.560 FORMAT "%8.3" ECU_ADDRESS 0x600049A2 /end MEASUREMENT
/begin MEASUREMENT OilSwmpT_tDisplStop "Oil Temperature for the display in the cockpit at engine stop" SWORD Temp_Cels 1 100 -273.140 3003.560 FORMAT "%8.3" ECU_ADDRESS 0x600049A0 /end MEASUREMENT
/begin MEASUREMENT OilSwmpT_tFltd "filtered Oil Temperature" SWORD Temp_Cels 1 100 -273.140 3003.560 FORMAT "%8.3" ECU_ADDRESS 0x6000499E /end MEASUREMENT
/begin MEASUREMENT OilSwmpT_tFltdStop "filtered Oil Temperature at engine stop" SWORD Temp_Cels 1 100 -273.140 3003.560 FORMAT "%8.3" ECU_ADDRESS 0x6000499C /end MEASUREMENT
/begin MEASUREMENT OilSwmpT_tFltdStop_Sq "Signal quality of filtered Oil Temperature at engine stop" UBYTE SigQly_COMPU_VERB 1 100 0.00 15.0000000000 FORMAT "%13.10" ECU_ADDRESS 0x6000A021 /end MEASUREMENT
/begin MEASUREMENT OilSwmpT_tFltd_Sq "Signal quality of filtered Oil Temperature" UBYTE SigQly_COMPU_VERB 1 100 0.00 15.0000000000 FORMAT "%13.10" ECU_ADDRESS 0x6000A020 /end MEASUREMENT
/begin MEASUREMENT OilSwmpT_tiCmbdSnsrNoVal "Zeit für den Öl-Kombi-Sensor wenn kein gültiger Sensorwert vorliegt" SLONG Per_Dur 1 100 -2147483648.00 2147483647.00 FORMAT "%13.2" ECU_ADDRESS 0x6003633C /end MEASUREMENT
/begin MEASUREMENT OilSwmpT_tiEcuOn "Time between the Switch-Off of Motor and the Switch-Off of ECU" SLONG t_q1 1 100 -2147483648.00 2147483647.00 FORMAT "%13.2" ECU_ADDRESS 0x60036330 /end MEASUREMENT
/begin MEASUREMENT OilSwmpT_tiEngOff "Engine Off Time used for model of oil temperature ans plausibility checks" SLONG t_q1 1 100 0.00 2147483647.00 FORMAT "%13.2" ECU_ADDRESS 0x50004D34 /end MEASUREMENT
/begin MEASUREMENT OilSwmpT_tiTSnsrNoVal "no valid value from the Oil temperature sensor" SLONG Per_Dur 1 100 -2147483648.00 2147483647.00 FORMAT "%13.2" ECU_ADDRESS 0x60036338 /end MEASUREMENT
/begin MEASUREMENT OilSwmpT_tMdl "Modelled Oil temperature" SWORD Temp_Cels 1 100 -273.140 3003.560 FORMAT "%8.3" ECU_ADDRESS 0x60004998 /end MEASUREMENT
/begin MEASUREMENT OilSwmpT_tMdlElecDrv "oil temperature in sump in operating state Engine off, ECU on" UWORD temp_q0p0234_o273 1 100 -273.150 1262.827 FORMAT "%8.3" ECU_ADDRESS 0x6000366A /end MEASUREMENT
/begin MEASUREMENT OilSwmpT_tMdlElecDrvFild "oil temperature in sump in operating state Engine off, ECU on, filtered" UWORD temp_q0p0234_o273 1 100 -273.150 1262.827 FORMAT "%8.3" ECU_ADDRESS 0x60003668 /end MEASUREMENT
/begin MEASUREMENT OilSwmpT_tMdlElecDrvSaved "oil temperature in oil sump at ECU Switch-Off" UWORD temp_q0p0234_o273 1 100 -273.150 1262.827 FORMAT "%8.3" ECU_ADDRESS 0x6003632E /end MEASUREMENT
/begin MEASUREMENT OilSwmpT_tMdlloc "Modelled Oil temperature (local copy)" SWORD Temp_Cels 1 100 -273.140 3003.560 FORMAT "%8.3" ECU_ADDRESS 0x60003666 /end MEASUREMENT
/begin MEASUREMENT OilSwmpT_tMdlStop "Modelled Oil temperature at enginge stop" SWORD Temp_Cels 1 100 -273.140 3003.560 FORMAT "%8.3" ECU_ADDRESS 0x60004996 /end MEASUREMENT
/begin MEASUREMENT OilSwmpT_tMdlTmp "Modelled Oil temperature (local variable)" SWORD Temp_Cels 1 100 -273.140 3003.560 FORMAT "%8.3" ECU_ADDRESS 0x60003664 /end MEASUREMENT
/begin MEASUREMENT OilSwmpT_tospmloc "Local variable for OilSwmpT model temperature" UBYTE temp_ub_q0p75_o48 1 100 -48.0 143.3 FORMAT "%5.1" ECU_ADDRESS 0x60006316 /end MEASUREMENT
/begin MEASUREMENT OilSwmpT_tospmloc_w "Local variable for OilSwmpT model temperature" UWORD temp_q0p0234_o273 1 100 -273.150 1262.827 FORMAT "%8.3" ECU_ADDRESS 0x60003662 /end MEASUREMENT
/begin MEASUREMENT OilSwmpT_tPid5C "PID5C Tester inteface for Oil temperature sensor" SWORD Temp_Cels 1 100 -3549.940 3003.560 FORMAT "%8.3" ECU_ADDRESS 0x6000498A /end MEASUREMENT
/begin MEASUREMENT OilSwmpT_tPistCoolgFild "The additional temperature because of the activation of the piston cooling, filtered" UWORD temp_q0p0234_o273 1 100 -273.150 1262.827 FORMAT "%8.3" ECU_ADDRESS 0x60003660 /end MEASUREMENT
/begin MEASUREMENT OilSwmpT_tPULS "Oil Temperature of the Oil-Combined-Sensor" SWORD Temp_Cels 1 100 -273.140 3003.560 FORMAT "%8.3" ECU_ADDRESS 0x60004992 /end MEASUREMENT
/begin MEASUREMENT OilSwmpT_tPULSFltd "filtered Oil Temperature of the Oil-Combined-Sensor" SWORD Temp_Cels 1 100 -273.140 3003.560 FORMAT "%8.3" ECU_ADDRESS 0x60004990 /end MEASUREMENT
/begin MEASUREMENT OilSwmpT_tPULSFltdStop "filtered Oil Temperature of the Oil-Combined-Sensor at engine stop" SWORD Temp_Cels 1 100 -273.140 3003.560 FORMAT "%8.3" ECU_ADDRESS 0x6000498E /end MEASUREMENT
/begin MEASUREMENT OilSwmpT_tPULSFltdStop_Sq "Signal quality of filtered Oil Temperature of the Oil-Combined-Sensor at engine stop" UBYTE SigQly_COMPU_VERB 1 100 0.00 15.0000000000 FORMAT "%13.10" ECU_ADDRESS 0x6000A01F /end MEASUREMENT
/begin MEASUREMENT OilSwmpT_tPULSFltd_Sq "Signal quality of filtered Oil Temperature of the Oil-Combined-Sensor" UBYTE SigQly_COMPU_VERB 1 100 0.00 15.0000000000 FORMAT "%13.10" ECU_ADDRESS 0x6000A01E /end MEASUREMENT
/begin MEASUREMENT OilSwmpT_tPULSStop "filtered Oil Temperature of the Oil-Combined-Sensor at engine stop" SWORD Temp_Cels 1 100 -273.140 3003.560 FORMAT "%8.3" ECU_ADDRESS 0x6000498C /end MEASUREMENT
/begin MEASUREMENT OilSwmpT_tPULSStop_Sq "signal quality for oil temperature at engine stop (oil combined sensor)" UBYTE SigQly_COMPU_VERB 1 100 0.00 15.0000000000 FORMAT "%13.10" ECU_ADDRESS 0x6000A01D /end MEASUREMENT
/begin MEASUREMENT OilSwmpT_tPULS_Sq "signal quality for oil temperature (oil combined sensor)" UBYTE SigQly_COMPU_VERB 1 100 0.00 15.0000000000 FORMAT "%13.10" ECU_ADDRESS 0x6000A01C /end MEASUREMENT
/begin MEASUREMENT OilSwmpT_tStop "Oil Temperature at engine stop" SWORD Temp_Cels 1 100 -273.140 3003.560 FORMAT "%8.3" ECU_ADDRESS 0x60004988 /end MEASUREMENT
/begin MEASUREMENT OilSwmpT_tStop_Sq "signal quality for oil temperature at engine stop" UBYTE SigQly_COMPU_VERB 1 100 0.00 15.0000000000 FORMAT "%13.10" ECU_ADDRESS 0x6000A01B /end MEASUREMENT
/begin MEASUREMENT OilSwmpT_tumg "ambient air temperature" UBYTE temp_ub_q0p75_o48 1 100 -48.0 143.3 FORMAT "%5.1" ECU_ADDRESS 0x6000A019 /end MEASUREMENT
/begin MEASUREMENT OilSwmpT_tvdCEngDsTloc "Local copy of the CEngDsT_t in the FC OilSwmpT_VD" SWORD Temp_Cels 1 100 -3549.940 3003.560 FORMAT "%8.3" ECU_ADDRESS 0x60003674 /end MEASUREMENT
/begin MEASUREMENT OilSwmpT_tvdMdlloc "Modelled Oil temperature" SWORD Temp_Cels 1 100 -273.140 3003.560 FORMAT "%8.3" ECU_ADDRESS 0x60003672 /end MEASUREMENT
/begin MEASUREMENT OilSwmpT_tWrmUp "Engine temperature used for Oil temperature model" UBYTE temp_ub_q0p75_o48 1 100 -48.0 143.3 FORMAT "%5.1" ECU_ADDRESS 0x60006315 /end MEASUREMENT
/begin MEASUREMENT OilSwmpT_tWrmUpFild "filtered engine coolant temperature" UWORD temp_ub_q0p75_o48 1 100 -48.0000 143.2500 FORMAT "%8.4" ECU_ADDRESS 0x6000365E /end MEASUREMENT
/begin MEASUREMENT OilSwmpT_tWrmUpHeatgCorrn "temperature correction due to influence of heating" UWORD temp_q0p0234_o273 1 100 -273.150 1262.827 FORMAT "%8.3" ECU_ADDRESS 0x6000365C /end MEASUREMENT
/begin MEASUREMENT OilSwmpT_t_Sq "Signal Qualitiy of oil temperature" UBYTE SigQly_COMPU_VERB 1 100 0.00 15.0000000000 FORMAT "%13.10" ECU_ADDRESS 0x6000A01A /end MEASUREMENT
/begin MEASUREMENT OilSwmpT_vfzg "vehicle speed (kmh)" UBYTE vfzg_ub_q1p25 1 100 0.00 318.8 FORMAT "%5.1" ECU_ADDRESS 0x6000A018 /end MEASUREMENT
/begin MEASUREMENT OilT_stTSensDsplNoAvl "A temperaturesensor is availiable for the display" UBYTE OneToOne 1 100 0.00 255.0 FORMAT "%5.1" ECU_ADDRESS 0x6000A017 /end MEASUREMENT
/begin MEASUREMENT Oil_stPSwmp "Oil Pressure Switch Debounced Value" UBYTE OneToOne 1 100 0.00 255.0 FORMAT "%5.1" ECU_ADDRESS 0x6000A6F2 /end MEASUREMENT
/begin MEASUREMENT Oil_stRawPSwmp "Raw Value of Oil Pressure Switch" UBYTE default 1 100 0.00 255.0 FORMAT "%5.1" ECU_ADDRESS 0x6000A6F1 /end MEASUREMENT
/begin MEASUREMENT Oil_swtADCPresT "Switch information which provides if oil temperature sensor from ADC is present or not" UBYTE OneToOne 1 100 0.00 255.0 FORMAT "%5.1" ECU_ADDRESS 0x6000A016 /end MEASUREMENT
/begin MEASUREMENT Oil_swtCANPresT "Switch information which provides if oil temperature signal via CAN is present or not" UBYTE OneToOne 1 100 0.00 255.0 FORMAT "%5.1" ECU_ADDRESS 0x6000A015 /end MEASUREMENT
/begin MEASUREMENT Oil_swtSensPresT "Switch information which provides if oil temperature sensor is present or not" UBYTE OneToOne 1 100 0.00 255.0 FORMAT "%5.1" ECU_ADDRESS 0x6000A014 /end MEASUREMENT
/begin MEASUREMENT Oil_swtSigT "Switch that determines the mode of calc" UBYTE OneToOne 1 100 0.00 255.0 FORMAT "%5.1" ECU_ADDRESS 0x6000A013 /end MEASUREMENT
/begin MEASUREMENT Oil_tADC "Oil temperature from ADC" SWORD Temp_Cels 1 100 -273.140 3003.560 FORMAT "%8.3" ECU_ADDRESS 0x60004984 /end MEASUREMENT
/begin MEASUREMENT Oil_tADCGradLtd "Oil temperature from ADC with limited increase" SWORD Temp_Cels 1 100 -273.140 3003.560 FORMAT "%8.3" ECU_ADDRESS 0x60004982 /end MEASUREMENT
/begin MEASUREMENT Oil_tPULS "Oil temperature from PULS sensor" SWORD Temp_Cels 1 100 -273.140 3003.560 FORMAT "%8.3" ECU_ADDRESS 0x60004980 /end MEASUREMENT
/begin MEASUREMENT Oil_tPULSGradLtd "Oil temperature from PULS sensor with limited increase" SWORD Temp_Cels 1 100 -273.140 3003.560 FORMAT "%8.3" ECU_ADDRESS 0x6000497E /end MEASUREMENT
/begin MEASUREMENT Oil_tSensADC "Sensed value of oil temperature from ADC" SWORD Temp_Cels 1 100 -273.140 3003.560 FORMAT "%8.3" ECU_ADDRESS 0x6000497C /end MEASUREMENT
/begin MEASUREMENT Oil_tSensPULS "Sensed value of oil temperature from PULS sensor" SWORD Temp_Cels 1 100 -273.140 3003.560 FORMAT "%8.3" ECU_ADDRESS 0x6000497A /end MEASUREMENT
/begin MEASUREMENT Oil_tSensTSwmp "Sensed value of Oil Temperature" SWORD Temp_Cels 1 100 -273.140 3003.560 FORMAT "%8.3" ECU_ADDRESS 0x60004978 /end MEASUREMENT
/begin MEASUREMENT Oil_tSwmp "Oil temperature in oil sump" SWORD Temp_Cels 1 100 -273.140 3003.560 FORMAT "%8.3" ECU_ADDRESS 0x6000E298 /end MEASUREMENT
/begin MEASUREMENT Oil_tSwmpGradLtd "Oil temperature with limited increase" SWORD Temp_Cels 1 100 -273.140 3003.560 FORMAT "%8.3" ECU_ADDRESS 0x60004976 /end MEASUREMENT
/begin MEASUREMENT Oil_uRawTSwmp "Raw voltage of oil temperature signal from oil sump" SWORD Volt 1 100 -6553.600 6553.400 FORMAT "%8.3" ECU_ADDRESS 0x60004974 /end MEASUREMENT
/begin MEASUREMENT pwrClntEntryOilSwmpT "Heat insertion of engine into coolant agent for OilSwmpT" SWORD pwr2 1 100 0.00 617643.4 FORMAT "%8.1" ECU_ADDRESS 0x6000365A /end MEASUREMENT
/begin MEASUREMENT stCoEngOilSwmpT "Engine status used for OilSwmpT" UWORD CoEng_stMai_VERB 1 100 0.00 16384.0000000 FORMAT "%13.7" ECU_ADDRESS 0x60003658 /end MEASUREMENT
/begin MEASUREMENT stSnsrWasOK "internal state indicating if the Sensor has send valid values (Bit0 Temperaturesensor, Bit1 Oil-Combined-Sensor)" UBYTE OneToOne 1 100 0.00 255.0 FORMAT "%5.1" ECU_ADDRESS 0x60036336 /end MEASUREMENT
/begin MEASUREMENT tabstloc_w "Stop time" UWORD t1sxs_uw_q1 1 100 0.00 65535.00 FORMAT "%8.2" ECU_ADDRESS 0x70002BB2 /end MEASUREMENT
/begin MEASUREMENT tFltSensOilTSwmp "physical temperature value, which is derived from low pass filtered sensor signal tospr_w" SWORD Temp_Cels 1 100 -273.140 3003.560 FORMAT "%8.3" ECU_ADDRESS 0x60003676 /end MEASUREMENT
/begin MEASUREMENT tfwdksom_w_msg "time constant to filter desired throttle angle without torque structure" UWORD zk10msxs_uw_b655 1 100 0.01000015 655.36000000 FORMAT "%12.8" ECU_ADDRESS 0x60004BA4 /end MEASUREMENT
/begin MEASUREMENT tiEngOffOilSwmpT "Engine off time used for OilSwmpT" SLONG t_q1 1 100 -2147483648.00 2147483647.00 FORMAT "%13.2" ECU_ADDRESS 0x60001370 /end MEASUREMENT
/begin MEASUREMENT TIFACAIRPTHTRANCON_BASE.tiFacAirPthTran "class filter time parameter / filter time" UWORD t_q0p01 1 100 0.0100 655.3500 FORMAT "%8.4" ECU_ADDRESS 0x60003696 /end MEASUREMENT
/begin MEASUREMENT TIFACAIRPTHTRANCON_FOLW.tiFacAirPthTran " / filter time" UWORD t_q0p01 1 100 0.0100 655.3500 FORMAT "%8.4" ECU_ADDRESS 0x6000369C /end MEASUREMENT
/begin MEASUREMENT TIFACAIRPTHTRAN_BASE.tiFacAirPthTran "class filter time table / filter time" UWORD t_q0p01 1 100 0.0100 655.3500 FORMAT "%8.4" ECU_ADDRESS 0x60003694 /end MEASUREMENT
/begin MEASUREMENT TIFACAIRPTHTRAN_FOLW.tiFacAirPthTran " / filter time" UWORD t_q0p01 1 100 0.0100 655.3500 FORMAT "%8.4" ECU_ADDRESS 0x6000369A /end MEASUREMENT
/begin MEASUREMENT tmchtslo_w "engine temperature (engine coolant or cylinder head), local copy, at the rising edge of active catalyst heating" SWORD Temp_Cels 1 100 -3549.940 3003.560 FORMAT "%8.3" ECU_ADDRESS 0x6000367E /end MEASUREMENT
/begin MEASUREMENT toellrns "engine oil temperature" UBYTE temp_ub_q1_o60 1 100 -60.0 195.0 FORMAT "%5.1" ECU_ADDRESS 0x60006328 /end MEASUREMENT
/begin MEASUREMENT tospmbm_w "oil temperature in sump during basic initialisation" UWORD temp_q0p0234_o273 1 100 -273.150 1262.827 FORMAT "%8.3" ECU_ADDRESS 0x60003656 /end MEASUREMENT
/begin MEASUREMENT tospmloc_w "oil temperature in sump from model (local)" UWORD temp_q0p0234_o273 1 100 -273.150 1262.827 FORMAT "%8.3" ECU_ADDRESS 0x6003632C /end MEASUREMENT
/begin MEASUREMENT tospmnf_w "oil temperature in sump from model (not filtered)" UWORD temp_q0p0234_o273 1 100 -273.150 1262.827 FORMAT "%8.3" ECU_ADDRESS 0x60003654 /end MEASUREMENT
/begin MEASUREMENT tospmq "state of oiltemperature-model" UBYTE dez 1 100 0.00 255.0 FORMAT "%5.1" ECU_ADDRESS 0x60006314 /end MEASUREMENT
/begin MEASUREMENT tospmqloc "state of oiltemperature-model local" UBYTE dez 1 100 0.00 255.0 FORMAT "%5.1" ECU_ADDRESS 0x6003632B /end MEASUREMENT
/begin MEASUREMENT tospmr_w "oil temperature in sump from model (raw value)" UWORD temp_q0p0234_o273 1 100 -273.150 1262.827 FORMAT "%8.3" ECU_ADDRESS 0x60003652 /end MEASUREMENT
/begin MEASUREMENT tospmst "State of oil temperature modeling" UBYTE dez 1 100 0.00 255.0 FORMAT "%5.1" ECU_ADDRESS 0x6003632A /end MEASUREMENT
/begin MEASUREMENT tospmstab "State of oil temperature modeling at engine switch off" UBYTE dez 1 100 0.00 255.0 FORMAT "%5.1" ECU_ADDRESS 0x60036329 /end MEASUREMENT
/begin MEASUREMENT tospmtdr_w "Duration of transition state in oil temperature model" UWORD t_q1 1 100 0.00 65535.00 FORMAT "%8.2" ECU_ADDRESS 0x60003650 /end MEASUREMENT
/begin MEASUREMENT tosprf_msg "physical temperature value, which is derived from low pass filtered sensor signal tospr" UBYTE temp_ub_q0p75_o48 1 100 -48.0 143.3 FORMAT "%5.1" ECU_ADDRESS 0x60009FDF /end MEASUREMENT
/begin MEASUREMENT tosprf_w_msg "physical temperature value, which is derived from low pass filtered sensor signal tospr_w" UWORD temp_q0p0234_o273 1 100 -273.150 1262.827 FORMAT "%8.3" ECU_ADDRESS 0x600047E0 /end MEASUREMENT
/begin MEASUREMENT tosptmab "local engien oft temperature" UBYTE temp_uw_q0p75_o48 1 100 -48.0 143.3 FORMAT "%5.1" ECU_ADDRESS 0x60036328 /end MEASUREMENT
/begin MEASUREMENT tosp_msg "Oil temperature in oil sump - measured or modeled" UBYTE temp_ub_q0p75_o48 1 100 -48.0 143.3 FORMAT "%5.1" ECU_ADDRESS 0x60009FE0 /end MEASUREMENT
/begin MEASUREMENT tosp_w_msg "oil temperature in oil sump - measured or modeled" UWORD temp_q0p0234_o273 1 100 -273.150 1262.827 FORMAT "%8.3" ECU_ADDRESS 0x600047E2 /end MEASUREMENT
/begin MEASUREMENT ttospmr "time constant of low pass filter (model oil temperature in sump)" UWORD t_q1 1 100 1.00 65535.00 FORMAT "%8.2" ECU_ADDRESS 0x6000364E /end MEASUREMENT
/begin MEASUREMENT ttospmrsw "Oiltemperature-Model: time-constant for switching over in warm-state" UWORD t_q0p1 1 100 0.00 25.50000 FORMAT "%8.5" ECU_ADDRESS 0x6000364C /end MEASUREMENT
/begin MEASUREMENT tumgOilSwmpT "Ambient air temperature used for OilSwmpT" UBYTE temp_ub_q0p75_o48 1 100 -48.0 143.3 FORMAT "%5.1" ECU_ADDRESS 0x60006313 /end MEASUREMENT
/begin MEASUREMENT tumgsudksh "environment temperature without independent car heater influence" UBYTE temp_ub_q0p75_o48 1 100 -48.0 143.3 FORMAT "%5.1" ECU_ADDRESS 0x60006337 /end MEASUREMENT
/begin MEASUREMENT vfzgOilSwmpT "Vehicle speed used for OilSwmpT" UBYTE vfzg_ub_q1p25 1 100 0.00 318.8 FORMAT "%5.1" ECU_ADDRESS 0x60006312 /end MEASUREMENT
/begin MEASUREMENT zhll_w "Time counter for hot idle" UWORD t200msxs_uw_q0p2 1 100 0.00 13107.00 FORMAT "%8.2" ECU_ADDRESS 0x60036342 /end MEASUREMENT
/begin FUNCTION Mo_Glbl "97.14.0   Monitoring: Global definitions"
 /begin DEF_CHARACTERISTIC Mo_cwMstSlave_C Mo_stSwtHyb_C Mo_swtClrCntrMax_C Mo_swtCyclCalUpdt_C Mo_trqIdcMax_C /end DEF_CHARACTERISTIC
 /begin IN_MEASUREMENT SyC_stSub /end IN_MEASUREMENT
 /begin OUT_MEASUREMENT MoGlbl_vblStruct.Mo_stMoC MoGlbl_vblStructCpl.Mo_stCplChk MoGlbl_vblStructCpl.Mo_stMoCCpl Mo_ctRst Mo_ctRstCpl Mo_ctRstMsg Mo_flgICOMsg Mo_stCplChk Mo_stErrHyb Mo_stErrHybCpl Mo_stMoC Mo_stMoCCpl Mo_stMoCExtdTsk Mo_stMoCExtdTskCpl Mo_stMoCExtdTskMsg Mo_stMoCMsg Mo_stMoF Mo_stMoFCpl Mo_stMoFExtdTsk Mo_stMoFExtdTskCpl Mo_stMoFExtdTskMsg Mo_stMoFMsg Mo_stVldR32Chk /end OUT_MEASUREMENT
 /begin LOC_MEASUREMENT MoGlbl_bbLocExtdTskCpl Mo_bAddConPFC Mo_bAddConPFCExtdTsk Mo_bAddDisblPreICORst Mo_bAddDisblPreICORstExtdTsk Mo_bCplChk Mo_bCplChkExtdTsk Mo_bEmgcyAir Mo_bICOL1 Mo_bICOL2 Mo_bICOL2ExtdTsk Mo_bIrvElMIdl Mo_bIrvHybLimpL1 Mo_bIrvHybLimpL2 Mo_bIrvHybP1LimpL2 Mo_bIrvTrqLimL1 Mo_bIrvTrqLimL2 Mo_bLoVltg Mo_bNlh Mo_bRamErr Mo_bRamErrExtdTsk Mo_bRomErr Mo_bSyncLos Mo_stProtRAM /end LOC_MEASUREMENT
 FUNCTION_VERSION "97.14.0" /end FUNCTION
/begin FUNCTION Mo_Inst "629.0.0   Function Monitoring: Instances for MultiCore Structs"
 /begin LOC_MEASUREMENT MoCMem_vblStructCpl_Core1_10ms_Nr1.MoCMem_ctDebErrChkRAMOld MoCMem_vblStructCpl_Core1_10ms_Nr1.MoCMem_ctDebErrChkRAMCpl MoCMem_vblStructCpl_Core1_10ms_Nr1.MoCMem_ctDebHealChkRAMCpl MoCMem_vblStructCpl_Core1_10ms_Nr1.MoCMem_nrRamChkCpl MoCMem_vblStructCpl_Core1_10ms_Nr1.MoCMem_nrStckChkCpl MoCMem_vblStructCpl_Core1_10ms_Nr1.MoCMem_nrCSAChkCpl MoCMem_vblStructCpl_Core1_10ms_Nr1.MoCMem_RamOffsetPtrCpl MoCMem_vblStructCpl_Core1_10ms_Nr1.MoCMem_CSAOffsetPtrCpl MoCMem_vblStructCpl_Core1_10ms_Nr1.MoCMem_StckOffsetPtrCpl MoCMem_vblStructCpl_Core1_10ms_Nr1.Mo_RamCyclicCheckCpl MoCMem_vblStructCpl_Core1_10ms_Nr1.MoCMem_ctLrnRAMCpl MoCMem_vblStructCpl_Core1_10ms_Nr1.MoCMem_tiRAMusOldCpl MoCMem_vblStructCpl_Core1_10ms_Nr1.MoCMem_tiRAMAccusCpl MoCMem_vblStructCpl_Core1_10ms_Nr1.MoCMem_tiRAMusCpl MoCMem_vblStructCpl_Core1_10ms_Nr1.MoCMem_ctLrnErrHdlrCpl MoCMem_vblStructCpl_Core1_10ms_Nr1.MoCMem_tiErrHdlrusOldCpl MoCMem_vblStructCpl_Core1_10ms_Nr1.MoCMem_tiErrHdlrusCpl MoCMem_vblStructCpl_Core1_10ms_Nr1.MoCMem_tiErrHdlrAccusCpl MoCMem_vblStructCpl_Core1_10ms_Nr1.MoCMem_numHealFacCpl MoCMem_vblStructEarlyClearedRAM_Core1_10ms_Nr1.MoCMem_st MoCMem_vblStructEarlyClearedRAM_Core1_10ms_Nr1.MoCMem_stCpl MoCMem_vblStructNVRAM_Core1_10ms_Nr1.MoCMem_ctDebErrChkRAMMaxNv MoCMem_vblStructNVRAM_Core1_10ms_Nr1.MoCMem_ctDebErrChkRAMExcddThdNv MoCMem_vblStruct_Core1_10ms_Nr1.MoCMem_ctDebErrChkRAM MoCMem_vblStruct_Core1_10ms_Nr1.MoCMem_ctDebHealChkRAM MoCMem_vblStruct_Core1_10ms_Nr1.MoCMem_nrRamChkSize MoCMem_vblStruct_Core1_10ms_Nr1.MoCMem_adrChkStckEnd MoCMem_vblStruct_Core1_10ms_Nr1.MoCMem_adrChkStckStrt MoCMem_vblStruct_Core1_10ms_Nr1.MoCMem_adrChkCSAStrt MoCMem_vblStruct_Core1_10ms_Nr1.MoCMem_adrChkCSAEnd MoCMem_vblStruct_Core1_10ms_Nr1.MoCMem_nrRamChk MoCMem_vblStruct_Core1_10ms_Nr1.MoCMem_nrStckChk MoCMem_vblStruct_Core1_10ms_Nr1.MoCMem_nrCSAChk MoCMem_vblStruct_Core1_10ms_Nr1.MoCMem_StckOffsetPtr MoCMem_vblStruct_Core1_10ms_Nr1.MoCMem_CSAOffsetPtr MoCMem_vblStruct_Core1_10ms_Nr1.MoCMem_adrChkStckSP MoCMem_vblStruct_Core1_10ms_Nr1.MoCMem_RamOffsetPtr MoCMem_vblStruct_Core1_10ms_Nr1.MoCMem_ChkRAMStck MoCMem_vblStruct_Core1_10ms_Nr1.MoCMem_ctLrnRAM MoCMem_vblStruct_Core1_10ms_Nr1.MoCMem_tiRAMus MoCMem_vblStruct_Core1_10ms_Nr1.MoCMem_tiRAMusOld MoCMem_vblStruct_Core1_10ms_Nr1.MoCMem_tiRAMAccus MoCMem_vblStruct_Core1_10ms_Nr1.MoCMem_ctLrnErrHdlr MoCMem_vblStruct_Core1_10ms_Nr1.MoCMem_tiErrHdlrusOld MoCMem_vblStruct_Core1_10ms_Nr1.MoCMem_tiErrHdlrus MoCMem_vblStruct_Core1_10ms_Nr1.MoCMem_tiErrHdlrAccus MoCMem_vblStruct_Core1_10ms_Nr1.MoCMem_numHealFac MoCPFC_vblStructCpl_Core1_10ms_Nr1.MoCPFC_cntr MoCPFC_vblStructCpl_Core1_10ms_Nr1.MoCPFC_numChkword MoCPFC_vblStructCpl_Core1_10ms_Nr1.MoCPFC_numChks MoCPFC_vblStructCpl_Core1_10ms_Nr1.MoCPFC_numConCatVal MoCPFC_vblStructCpl_Core1_10ms_Nr1.MoCPFC_cntrRollg MoCPFC_vblStructCpl_Core1_10ms_Nr1.MoCPFC_aryRingBuf MoCPFC_vblStructCpl_Core1_10ms_Nr1.MoCPFC_stWrErr MoCPFC_vblStructCpl_Core1_10ms_Nr1.MoCPFC_RingBuf_pst.startAdr MoCPFC_vblStructCpl_Core1_10ms_Nr1.MoCPFC_RingBuf_pst.size MoCPFC_vblStructCpl_Core1_10ms_Nr1.MoCPFC_RingBuf_pst.head MoCPFC_vblStructCpl_Core1_10ms_Nr1.MoCPFC_RingBuf_pst.tail MoCSCC_varStructCpl_Core1_10ms_Nr1.MoCSCC_stChpIdCpl MoCSCC_varStructCpl_Core1_10ms_Nr1.MoCSCC_cntrDebCpl MoCSCC_varStructCpl_Core1_10ms_Nr1.MoCSCC_stTrmDevCpl MoCSCC_varStructCpl_Core1_10ms_Nr1.MoCSCC_cntrMPURegChkCpl MoCSCC_varStructNVRAM_Core1_10ms_Nr1.MoCSCC_cntrDebMaxNv MoCSCC_varStructNVRAM_Core1_10ms_Nr1.MoCSCC_cntrDebExcddThdNv MoCSCC_varStructNVRAM_Core1_10ms_Nr1.MoCSCC_cntrDebOld MoCSCC_varStruct_Core1_10ms_Nr1.MoCSCC_stErr MoCSCC_varStruct_Core1_10ms_Nr1.MoCSCC_cntrDeb MoCSCC_varStruct_Core1_10ms_Nr1.MoCSCC_stTrmDev MoCSCC_varStruct_Core1_10ms_Nr1.MoCSCC_stChpId MoCSCC_varStruct_Core1_10ms_Nr1.MoCSCC_cntrMPURegChk MoExe_varStructCpl_Core1_10ms_Nr1.MoExe_ctCycCpl MoExe_varStruct_Core1_10ms_Nr1.MoExe_ctCyc MoGlbl_vblStructCpl_Core1_10ms_Nr1.Mo_stCplChk MoGlbl_vblStructCpl_Core1_10ms_Nr1.Mo_stMoCCpl MoGlbl_vblStruct_Core1_10ms_Nr1.Mo_stMoC /end LOC_MEASUREMENT
 FUNCTION_VERSION "629.0.0" /end FUNCTION
/begin FUNCTION MRly2MED "10.6.0    Interface Adapter MRly to MED" /begin IN_MEASUREMENT MRly_st /end IN_MEASUREMENT /begin OUT_MEASUREMENT B_hr_msg /end OUT_MEASUREMENT FUNCTION_VERSION "10.6.0" /end FUNCTION
/begin FUNCTION MRly_Vld2Lcy "1.11.0_1.1.0SW Adapter Main Relay Component Package: Mapping Valid to Legacy Interface Elements"
 /begin DEF_CHARACTERISTIC MRly_VD_BattuMax_C MRly_VD_BattuMin_C MRly_VD_SCB_OL_Plaus_Enable_C MRly_VD_SCB_OL_Plaus_Threshold_C /end DEF_CHARACTERISTIC
 /begin IN_MEASUREMENT BattuT30C_uRaw BattU_uSens DSM_TripChgAndClrFinshd /end IN_MEASUREMENT
 /begin OUT_MEASUREMENT B_deseehr_mrly_vld_msg MRlyst_Sq MRly_st MRly_stAct /end OUT_MEASUREMENT
 FUNCTION_VERSION "1.11.0_1.1.0" /end FUNCTION
/begin FUNCTION MSUDKSOM "15.27.0   Overcritical set value air charge without torque stucture"
 /begin DEF_CHARACTERISTIC CWMSUDKSOM EngStrt_facCoorAltiAirPth_AX EngStrt_facCoorAltiMfAir_GT EngStrt_idxClassSelnTiFacAirPthTran_T EngStrt_idxSelnMfAirWait_T EngStrt_idxSelnMfAir_T EngStrt_idxSelnTiFacAirPthTranCon_T EngStrt_idxSelnTiFacAirPthTran_T EngStrt_mfAirEngOff_GT EngStrt_nEngAirPth_AX EngStrt_nNxtStrtAirPthRst_T EngStrt_nrInjAirPth_AX EngStrt_rPedAirPth_AX EngStrt_tStrtAirPth_AX KFMSUDKSH KLRSDKSST KLTSSDKSST KLWMSABST MFAIRSTRT_BASE.mfAirAccrPed_GM MFAIRSTRT_BASE.mfAirBaseNrInj_GM MFAIRSTRT_BASE.mfAirCatHeatg_GM MFAIRSTRT_BASE.mfAir_GM MFAIRSTRT_COM.mfAirAccrPed_GM MFAIRSTRT_COM.mfAirBaseNrInj_GM MFAIRSTRT_COM.mfAirCatHeatg_GM MFAIRSTRT_COM.mfAir_GM MFAIRSTRT_COMWAITSTRTR.mfAirAccrPed_GM MFAIRSTRT_COMWAITSTRTR.mfAirBaseNrInj_GM MFAIRSTRT_COMWAITSTRTR.mfAirCatHeatg_GM MFAIRSTRT_COMWAITSTRTR.mfAir_GM MFAIRSTRT_FOLW.mfAirAccrPed_GM MFAIRSTRT_FOLW.mfAirBaseNrInj_GM MFAIRSTRT_FOLW.mfAirCatHeatg_GM MFAIRSTRT_FOLW.mfAir_GM MFAIRWAIT_STRTR.mfAirWait_GM MSUDKSNLN NWDKSSTKL TIFACAIRPTHTRANCON_BASE.tiFacAirPthTran_C TIFACAIRPTHTRANCON_FOLW.tiFacAirPthTran_C TIFACAIRPTHTRAN_BASE.tiFacAirPthTranCatHeatg_GT TIFACAIRPTHTRAN_BASE.tiFacAirPthTran_GT TIFACAIRPTHTRAN_FOLW.tiFacAirPthTranCatHeatg_GT TIFACAIRPTHTRAN_FOLW.tiFacAirPthTran_GT TWDKSNSTKL /end DEF_CHARACTERISTIC
 /begin IN_MEASUREMENT ActMod_trqInr anztib_msg APP_r AuxHtg_bActv B_dtmbh_msg B_enllri_msg B_kha_msg CoEng_stMai EngStrt_bStrtEnd EngStrt_flgStrtEndTqStruct EngStrt_stStrtReq EngStrt_stStrtSit EngStrt_tStrtCoor EngTrqPtd_trqSet EnvT_t Epm_nEng10ms PEnv_facCorrAlti SyC_ctDrvEnter TiOff_tiStrtEndOff tka_msg /end IN_MEASUREMENT
 /begin OUT_MEASUREMENT B_msudksom_msg B_munst_msg B_tfwdksom_msg msudksom_w_msg tfwdksom_w_msg /end OUT_MEASUREMENT
 /begin LOC_MEASUREMENT EngStrt_ctMSUDKSOMDrvEntr10ms EngStrt_flgAccrPed EngStrt_flgAirPthStrtRst EngStrt_flgEngShutDown EngStrt_flgEngShutDownDlyd EngStrt_flgTqActv EngStrt_mfAirAccrPed EngStrt_nrInjAirPth EngStrt_tiSnceStrt MFAIRSTRT_BASE.mfAir MFAIRSTRT_COM.mfAir MFAIRSTRT_COMWAITSTRTR.mfAir MFAIRSTRT_FOLW.mfAir MFAIRWAIT_STRTR.mfAirWait tabstloc_w TIFACAIRPTHTRANCON_BASE.tiFacAirPthTran TIFACAIRPTHTRANCON_FOLW.tiFacAirPthTran TIFACAIRPTHTRAN_BASE.tiFacAirPthTran TIFACAIRPTHTRAN_FOLW.tiFacAirPthTran tumgsudksh /end LOC_MEASUREMENT
 FUNCTION_VERSION "15.27.0" /end FUNCTION
/begin FUNCTION MWKO "1.16.0    Mode switch coordination" /begin DEF_CHARACTERISTIC TVHEGTESOFF /end DEF_CHARACTERISTIC /begin IN_MEASUREMENT B_vhegtes_msg B_vheinst_msg B_vherlsts_msg /end IN_MEASUREMENT /begin OUT_MEASUREMENT B_mwrlstas_msg B_mwtes_msg CoEng_bModtr /end OUT_MEASUREMENT /begin LOC_MEASUREMENT CoEOM_DlyReengmtFpcAdvTOFFVNM_I.Time /end LOC_MEASUREMENT FUNCTION_VERSION "1.16.0" /end FUNCTION
/begin FUNCTION NSBLP "1.6.0     Increasing of engine low idle speed when engine temperature is too high" /begin DEF_CHARACTERISTIC NFSKS NSKS TMLLX /end DEF_CHARACTERISTIC /begin IN_MEASUREMENT B_fs_msg B_ll_msg B_nswo1_msg CEngDsT_t Epm_nEng /end IN_MEASUREMENT /begin OUT_MEASUREMENT nsolblp_msg /end OUT_MEASUREMENT /begin LOC_MEASUREMENT B_nsks /end LOC_MEASUREMENT FUNCTION_VERSION "1.6.0" /end FUNCTION
/begin FUNCTION NSHTD "8.0.0     Desired idle speed heating demand"
 /begin DEF_CHARACTERISTIC KFTMHTD KFTMHTDFS KFTUMHTD KFTUMHTDFS NTUM NTUMFS TDTUMG TTUM /end DEF_CHARACTERISTIC
 /begin IN_MEASUREMENT B_fs_msg B_ll_msg CEngDsT_t CEngDsT_tStrt EnvT_t PT_stTraType SyC_ctPostDrvLeave /end IN_MEASUREMENT
 /begin OUT_MEASUREMENT nsmodhtd_msg nsolhtd_msg /end OUT_MEASUREMENT
 /begin LOC_MEASUREMENT NSHTD_ctReIni nsolhtdtm nsolhtdtum /end LOC_MEASUREMENT
 FUNCTION_VERSION "8.0.0" /end FUNCTION
/begin FUNCTION NSHTI "28.0.0    Increasing of engine low idle speed when engine temperature is too high"
 /begin DEF_CHARACTERISTIC DTAHLL DTMHLL KFNSOLHT NSHLL NSHTI_facCorrnAltiAmbTAvdNvhDrvg_M NSHTI_facCorrnAltiAmbTAvdNvh_M NSHTI_facCorrnEngTAvdNvhDrvg_T NSHTI_facCorrnEngTAvdNvh_T NSHTI_facCorrnOffsDrvg_C NSHTI_facCorrnOffs_C NSHTI_flgStgySeln_C NSHTI_nHiAltiAvdNvhLoIdleSpDrvg_T NSHTI_nHiAltiAvdNvhLoIdleSp_T NSHTI_nLimHiAltiFwdDrvgLoIdleSp_M NSHTI_nLimHiAltiRvsCrpLoIdleSp_M NSTOEL NZHDTL NZHITL TAHLL TMHLL TMRZHLL TOLCHLLMN TOLCHLLMX ZHLLA ZHLLE /end DEF_CHARACTERISTIC
 /begin REF_CHARACTERISTIC CNFLLRNS /end REF_CHARACTERISTIC
 /begin IN_MEASUREMENT B_ll_msg B_nswo1_msg B_tolcb_msg CEngDsT_t CEngDsT_tStrt CoVMD_flgIdleDrv EngStrt_bStrt EnvT_t Epm_nEngLRes Gbx_stGearLvr Gbx_stPNPos PEnv_facCorrAlti PT_stTraType rl_msg SyC_ctDrvEnter SyC_stSub tans_msg tolc_msg VehV_v /end IN_MEASUREMENT
 /begin OUT_MEASUREMENT NSHTI_flgHiAltiLimActv NSHTI_nHiAltiAvdNvhIdle NSHTI_nHiAltiAvdNvhIdleDrvg NSHTI_nHiAltiAvdNvhLoIdleSp NSHTI_nLimHiAltiLoIdleSp nsolhti_msg zhll_w /end OUT_MEASUREMENT
 /begin LOC_MEASUREMENT B_hll B_toeltmp NSHTI_B_st NSHTI_ctIniDrv NSHTI_facCorrnHiAltiAvdNvh NSHTI_facCorrnHiAltiAvdNvhDrvg NSHTI_nHiAltiAvdNvhDrvgLoc NSHTI_nHiAltiAvdNvhDrvgTmp NSHTI_nHiAltiAvdNvhIdleLoc NSHTI_nHiAltiAvdNvhIdleTmp NSHTI_nmotloc NSHTI_rlloc NSHTI_tans NSHTI_tmstloc NSHTI_tolc nsolht nstoel_tmp toellrns /end LOC_MEASUREMENT
 FUNCTION_VERSION "28.0.0" /end FUNCTION
/begin FUNCTION NSKH "5.34.0    specification of desired idle speed for catalyst heating"
 /begin DEF_CHARACTERISTIC CWNSKH ExhMgT_facCatWrmIdleN_M ExhMgT_facHeatgProgsIdleSpdCorrnDrvgPosn_M ExhMgT_facHeatgProgsIdleSpdCorrn_M ExhMgT_nIdleCatHeatgDrvgPosn_M ExhMgT_nIdleCatHeatg_M ExhMgT_nIdleSpdCatWrmDrvgPosn_M ExhMgT_nIdleSpdCatWrm_M ExhMgT_stIdleSpeedCatHeatg2_C ExhMgT_stIdleSpeedCatHeatg_C ExhMgT_tiDlyDrvgPosnNotEngd_C ExhMgT_tiIdleSpdFltCatHeatgEndDrvgPosn_C ExhMgT_tiIdleSpdFltCatHeatgEnd_C ExhMgT_tiIdleSpdFltCatHeatgStrtDrvgPosn_C ExhMgT_tiIdleSpdFltCatHeatgStrt_C ExhMgT_tiIdleSpdFltCatWrmDrvgPosn_C ExhMgT_tiIdleSpdFltCatWrm_C ExhMgt_vVehThdCatHeatg_C GANGKHLL KFNSKHLL KFNSKHLLFS KFNSKHLLFSIML KFNSKHLLIML KFNSKHLLTM KFNSKHLLTMIML KLNLLKHAGE TDBKVKHN THDNSOLPTS TKHFSAB TKHFSRG TKHFSVZ TKHNABBKV VFZGGRDKH VFZGNLLKH /end DEF_CHARACTERISTIC
 /begin IN_MEASUREMENT Brk_st B_bkvnkhab_msg B_fs_msg B_khakt_msg B_khakw_msg B_khan_msg B_kha_msg B_kh_msg B_ll_msg CEngDsT_t CEngDsT_tStrt Clth_st Com_stGrip Epm_nEng Epm_stSpd ExhMgT_facWghtCatAge ExhMgT_flgCatHeatgWrmReq ExhMod_tCat1B1 frhol_w_msg gangsist_msg imlpr_w_msg nsolpts_msg PEnv_facCorrAlti SyC_ctPostDrvLeave SyC_stSub tnse_w_msg VehV_v /end IN_MEASUREMENT
 /begin OUT_MEASUREMENT B_khnshp_msg B_khn_msg ExhMgT_flgRepStrtNonCsersIdleSpdReq ExhMgT_nEngMaxIdleCatHeat ExhMgT_nIdleCatHeatgSp ExhMgT_nIdleVirtDiagCsers ExhMgT_nIdleVirtDiagNonCsers frhokor_w_msg nllkh_msg nsolcat_msg /end OUT_MEASUREMENT
 /begin LOC_MEASUREMENT B_bkvkhab B_cwnllkh0 B_cwnllkh1 B_cwnllkh10 B_cwnllkh14 B_cwnllkh2 B_cwnllkh3 B_cwnllkh4 B_cwnllkh5 B_cwnllkh8 B_cwnllkh9 B_nfskh ExhMgT_cntrReiniIdleCatHeatg ExhMgT_facCatHeatgProgsNIdle ExhMgT_facCorrnIdleAlti ExhMgT_flgCatHeatgWrmIdleSpdReq ExhMgT_flgGripClu ExhMgT_flgIdleSpdActvnBrkP ExhMgT_flgIdleSpdDeactvnBrkP ExhMgT_flgTondDrvgPosn ExhMgT_nEngIdleCatHeat ExhMgT_nIdleInitCatHeatg ExhMgT_tCatColdStrtIdleSpdReq ExhMgT_tCatHeatgIdleSpdReqFixd ExhMgT_tCatWrmIdleSpdReq ExhMgT_tEngCatHeatgIdle ExhMgT_tiAftStrtCatHeatgNIdle ExhMgT_tiIdleSpdFltCatHeatg ExhMgT_tStrtNCatHeatg nmfskh nmfskhgs nmllkh nmllkhgs nmotllkh tmchtslo_w /end LOC_MEASUREMENT
 FUNCTION_VERSION "5.34.0" /end FUNCTION
/begin FUNCTION NSLPH "1.7.0     Desired idling speed limp-home" /begin DEF_CHARACTERISTIC NFSNLDG NSNLDG NSNOT /end DEF_CHARACTERISTIC
 /begin IN_MEASUREMENT B_fs_msg B_nswo1_msg Epm_stOpMode ThrVlv_flgLimpModeB1 ThrVlv_flgReqFuCutOffB1 /end IN_MEASUREMENT
 /begin OUT_MEASUREMENT nsmodlph_msg nsollph_msg /end OUT_MEASUREMENT
 /begin LOC_MEASUREMENT B_inolu /end LOC_MEASUREMENT
 FUNCTION_VERSION "1.7.0" /end FUNCTION
/begin FUNCTION NSPTS "1.12.0    Desired idling speed post start"
 /begin DEF_CHARACTERISTIC KFNLLKEB KFNLLNST NSPTS_nIdleAftStrtDrvg_GM STM06LLUB_NSPTS STN06LLUB_NSPTS /end DEF_CHARACTERISTIC
 /begin IN_MEASUREMENT B_fs_msg B_nswo1_msg B_teftstft_msg CEngDsT_t SyC_ctDrvEnter tnst_w_msg /end IN_MEASUREMENT
 /begin OUT_MEASUREMENT nsolpts_msg /end OUT_MEASUREMENT
 /begin LOC_MEASUREMENT NSPTS_ctIniDrv NSPTS_tmotloc NSPTS_tnstloc /end LOC_MEASUREMENT
 FUNCTION_VERSION "1.12.0" /end FUNCTION
/begin FUNCTION OCWDA_Co "80.5.1    Extended Monitoring: Operation conditions of WDA/ABE shut off"
 /begin DEF_CHARACTERISTIC OCWDA_ctDebActvErr_C OCWDA_ctDebOvrVltgOn_C OCWDA_stErrSimn_C OCWDA_swtOffRst_C /end DEF_CHARACTERISTIC
 /begin IN_MEASUREMENT BattU_u MoCCom_ctErrFC MoCCom_ctErrMM MoCSOP_stActMsg MoCSOP_stOvl /end IN_MEASUREMENT
 /begin OUT_MEASUREMENT OCWDA_stErrMonPtt /end OUT_MEASUREMENT
 /begin LOC_MEASUREMENT OCWDA_ctBattU OCWDA_ctDebActvErr OCWDA_ctDebErrNotActv OCWDA_ctDebOvrVltgOn OCWDA_ctTstOCWDA OCWDA_ctTstOvrVltg OCWDA_flgClrDebDFC OCWDA_stABEActv OCWDA_stCheckState OCWDA_stErrPinActv OCWDA_stOvrVltgActv OCWDA_stWDAActv /end LOC_MEASUREMENT
 FUNCTION_VERSION "80.5.1" /end FUNCTION
/begin FUNCTION OilP_DD "7.2.0     Oil Pressure Sensor Device Driver" /begin DEF_CHARACTERISTIC Oil_DebP.tiHiLo_C Oil_DebP.tiLoHi_C /end DEF_CHARACTERISTIC FUNCTION_VERSION "7.2.0" /end FUNCTION
/begin FUNCTION OilP_VD "7.2.0     Oil Pressure Sensor Virtual Device" /begin IN_MEASUREMENT Epm_nEng /end IN_MEASUREMENT /begin OUT_MEASUREMENT Oil_stPSwmp Oil_stRawPSwmp /end OUT_MEASUREMENT FUNCTION_VERSION "7.2.0" /end FUNCTION
/begin FUNCTION OilSwmpT_AdprInp "2.6.0     Interface adapter: GC oil temeprature in sump: inputs" /begin DEF_CHARACTERISTIC OilSwmpT_maskEnvTSq_C OilSwmpT_swtTAmbVld_C /end DEF_CHARACTERISTIC
 /begin IN_MEASUREMENT B_gtumg_msg B_sa_msg B_tumgg_msg EnvT_t EnvT_t_Sq Epm_nEng TiEngOff_bEngRot TiEngOff_bRst TiEngOff_ti VehV_v /end IN_MEASUREMENT
 /begin OUT_MEASUREMENT OilSwmpT_bengrot OilSwmpT_bgtumg OilSwmpT_bsa OilSwmpT_btengsr OilSwmpT_btumgg OilSwmpT_nmot OilSwmpT_tiEngOff OilSwmpT_tumg OilSwmpT_vfzg /end OUT_MEASUREMENT
 FUNCTION_VERSION "2.6.0" /end FUNCTION
/begin FUNCTION OilSwmpT_AdprOutp "1.6.0     Interface adapter: GC oil temeprature in sump: outputs" /begin DEF_CHARACTERISTIC OilSwmpT_maskB_tospgg_C OilSwmpT_maskB_tospg_C /end DEF_CHARACTERISTIC
 /begin IN_MEASUREMENT OilSwmpT_idxTSrc OilSwmpT_stSigT OilSwmpT_tADCFltd OilSwmpT_tFltd OilSwmpT_tPULSFltd /end IN_MEASUREMENT
 /begin OUT_MEASUREMENT B_tospgg_msg B_tospg_msg OilT_stTSensDsplNoAvl Oil_swtADCPresT Oil_swtCANPresT Oil_swtSensPresT Oil_swtSigT Oil_tADC Oil_tADCGradLtd Oil_tPULS Oil_tPULSGradLtd Oil_tSensADC Oil_tSensPULS Oil_tSensTSwmp Oil_tSwmp Oil_tSwmpGradLtd Oil_uRawTSwmp tosprf_msg tosprf_w_msg tosp_msg tosp_w_msg /end OUT_MEASUREMENT
 /begin LOC_MEASUREMENT OilSwmpT_tAdprSnsrFildLoc OilSwmpT_tAdprSnsrLoc tFltSensOilTSwmp /end LOC_MEASUREMENT
 FUNCTION_VERSION "1.6.0" /end FUNCTION
/begin FUNCTION OilSwmpT_VD "1.15.0    Virtual Device: Temperature of oil in sump"
 /begin DEF_CHARACTERISTIC OilSwmpT_dtMdlSnsrMax_C OilSwmpT_dtMdlSnsrMin_C OilSwmpT_swtMdlPULSEna_C OilSwmpT_swtMdlTAvl_C OilSwmpT_swtTSrcADCFrzDfl_C OilSwmpT_swtTSrcADC_C OilSwmpT_swtTSrcDispl_C OilSwmpT_swtTSrcPULSFrzDfl_C OilSwmpT_swtTSrcPULS_C OilSwmpT_swtTSrc_C OilSwmpT_tADCDfl_C OilSwmpT_tDfl_C OilSwmpT_tiCmbdSnsrFrzMax_C OilSwmpT_tiTADCPT1_C OilSwmpT_tiTDisplPT1_C OilSwmpT_tiTPT1_C OilSwmpT_tiTPULSPT1_C OilSwmpT_tiTSnsrFrzMax_C OilSwmpT_tPULSDfl_C OilSwmpT_tSelMdlCEngDsT_C /end DEF_CHARACTERISTIC
 /begin IN_MEASUREMENT CEngDsT_t Eep_EnvRamHist Eep_EnvRamInvld OilSwmpT_btengsr OilSwmpT_flgMdlPrs OilSwmpT_stTMdl OilSwmpT_tMdl /end IN_MEASUREMENT
 /begin OUT_MEASUREMENT OilSwmpT_idxTSrc OilSwmpT_stSigT OilSwmpT_stSigTADC OilSwmpT_stSigTDispl OilSwmpT_stSigTPULS OilSwmpT_stTDisplStop OilSwmpT_t OilSwmpT_tADC OilSwmpT_tADCFltd OilSwmpT_tADCFltdStop OilSwmpT_tADCFltdStop_Sq OilSwmpT_tADCFltd_Sq OilSwmpT_tADCStop OilSwmpT_tADCStop_Sq OilSwmpT_tADC_Sq OilSwmpT_tDispl OilSwmpT_tDisplFltd OilSwmpT_tDisplFltdStop OilSwmpT_tDisplStop OilSwmpT_tFltd OilSwmpT_tFltdStop OilSwmpT_tFltdStop_Sq OilSwmpT_tFltd_Sq OilSwmpT_tPid5C OilSwmpT_tPULS OilSwmpT_tPULSFltd OilSwmpT_tPULSFltdStop OilSwmpT_tPULSFltdStop_Sq OilSwmpT_tPULSFltd_Sq OilSwmpT_tPULSStop OilSwmpT_tPULSStop_Sq OilSwmpT_tPULS_Sq OilSwmpT_tStop OilSwmpT_tStop_Sq OilSwmpT_t_Sq /end OUT_MEASUREMENT
 /begin LOC_MEASUREMENT OilSwmpT_flgEngStopFrz OilSwmpT_flgOilSwmpTCmbdSnsrAvl OilSwmpT_flgOilSwmpTMdlAvl OilSwmpT_flgOilSwmpTSnsrAvl OilSwmpT_flgPULSMdlHi OilSwmpT_flgvdMdlPrsloc OilSwmpT_idxTSrcADC OilSwmpT_idxTSrcDispl OilSwmpT_idxTSrcPULS OilSwmpT_stCmbdSnsrRplVal OilSwmpT_stTSnsrRplVal OilSwmpT_stvdTMdlloc OilSwmpT_tiCmbdSnsrNoVal OilSwmpT_tiTSnsrNoVal OilSwmpT_tvdCEngDsTloc OilSwmpT_tvdMdlloc stSnsrWasOK /end LOC_MEASUREMENT
 FUNCTION_VERSION "1.15.0" /end FUNCTION
/begin FUNCTION OilSwmpT_VDMdl "1.19.0    Calculation of model value: Temperature of oil in sump"
 /begin DEF_CHARACTERISTIC CWTOSPM CWTOSPM2 KFTOSPMVML KFTOSPMWC KLTOSPM_N KLTOSPM_TU KLTSWITCH KLTTOSPM1 KLTTOSPM2 OilSwmpT_dtMdlElecDrv_MAP OilSwmpT_facHeatgWrmEnvT_M OilSwmpT_facIntegElecDrv_C OilSwmpT_facMdlElecDrv_T OilSwmpT_facMdlLdVVeh_MAP OilSwmpT_maskEngTWrmUp_C OilSwmpT_swtPwrClntEntrySeln_C OilSwmpT_tiElecDrv_C OilSwmpT_tiTOSPMR_T OilSwmpT_tiWrmUp_C OilSwmpT_tWrmUpHeatgCorrn_M SWTMOT SWTOSPM TOSPMQD TOSPMQDS TOSPMQWS TOSPREPL TOSPREPLI TTOSPMVLD /end DEF_CHARACTERISTIC
 /begin IN_MEASUREMENT CEngDsT_t CEngDsT_t_Sq CoEng_stMai Eep_EnvRamHist Eep_EnvRamInvld ml_w_msg OilSwmpT_bsa OilSwmpT_nmot OilSwmpT_tiEngOff OilSwmpT_tumg OilSwmpT_vfzg PhyMod_pwrClntEntry TiEngOff_bEngRot TiEngOff_bRst /end IN_MEASUREMENT
 /begin OUT_MEASUREMENT OilSwmpT_flgMdlPrs OilSwmpT_stTMdl OilSwmpT_tMdl OilSwmpT_tMdlStop /end OUT_MEASUREMENT
 /begin LOC_MEASUREMENT B_tospmadi B_tospmefr B_tospmg B_tospmwst mlwOilSwmpT nmotOilSwmpT OilSwmpT_bVldMdlENVRAM OilSwmpT_dtMdlElecDrv OilSwmpT_flgMdlRstIni OilSwmpT_flgOvrRunActvd OilSwmpT_flgOvrRun_loc OilSwmpT_flgTiEngOff_bEngRot_loc OilSwmpT_flgTiEngOff_bRst_loc OilSwmpT_flgTOSPMabVld OilSwmpT_flgVldTWrmUp OilSwmpT_stMdlElecDrvSaved OilSwmpT_stPwrOnRstTMdl OilSwmpT_stTMdlloc OilSwmpT_tdiffElecDrv OilSwmpT_tiEcuOn OilSwmpT_tMdlElecDrv OilSwmpT_tMdlElecDrvFild OilSwmpT_tMdlElecDrvSaved OilSwmpT_tMdlloc OilSwmpT_tMdlTmp OilSwmpT_tospmloc OilSwmpT_tospmloc_w OilSwmpT_tPistCoolgFild OilSwmpT_tWrmUp OilSwmpT_tWrmUpFild OilSwmpT_tWrmUpHeatgCorrn pwrClntEntryOilSwmpT stCoEngOilSwmpT tiEngOffOilSwmpT tospmbm_w tospmloc_w tospmnf_w tospmq tospmqloc tospmr_w tospmst tospmstab tospmtdr_w tosptmab ttospmr ttospmrsw tumgOilSwmpT vfzgOilSwmpT /end LOC_MEASUREMENT
 FUNCTION_VERSION "1.19.0" /end FUNCTION
/begin COMPU_METHOD B_TRUE "" TAB_VERB "%6.3" "" COMPU_TAB_REF B_TRUE /end COMPU_METHOD
/begin COMPU_VTAB B_TRUE "" TAB_VERB 2 0 "FALSE" 1 "TRUE" /end COMPU_VTAB
/begin COMPU_METHOD CoEng_stMai_VERB "" TAB_VERB "%6.3" "" COMPU_TAB_REF CoEng_stMai_VERB /end COMPU_METHOD
/begin COMPU_VTAB CoEng_stMai_VERB "" TAB_VERB 7 0 "COENG_ST_STANDBY" 4 "COENG_ST_READY" 16 "COENG_ST_STARTING" 64 "COENG_ST_AUTOSTOPPING" 1024 "COENG_ST_RUNNING" 4096 "COENG_ST_STOPPING" 16384 "COENG_ST_FINISH" /end COMPU_VTAB
/begin COMPU_METHOD dez "" RAT_FUNC "%6.2" "" COEFFS 0 1 0 0 0 1 /end COMPU_METHOD
/begin COMPU_METHOD EngN "" RAT_FUNC "%6.3" "rpm" COEFFS 0 2 0 0 0 1 /end COMPU_METHOD
/begin COMPU_METHOD ENGSTRT_MFAIRSTRT_SET_COMPU_VERB "" TAB_VERB "%6.3" "-" COMPU_TAB_REF ENGSTRT_MFAIRSTRT_SET_COMPU_VERB /end COMPU_METHOD
/begin COMPU_VTAB ENGSTRT_MFAIRSTRT_SET_COMPU_VERB "" TAB_VERB 4 0 "MFAIRSTRT_BASE" 1 "MFAIRSTRT_FOLW" 2 "MFAIRSTRT_COM" 3 "MFAIRSTRT_COMWAITSTRTR" /end COMPU_VTAB
/begin COMPU_METHOD ENGSTRT_MFAIRWAIT_SET_COMPU_VERB "" TAB_VERB "%6.3" "-" COMPU_TAB_REF ENGSTRT_MFAIRWAIT_SET_COMPU_VERB /end COMPU_METHOD
/begin COMPU_VTAB ENGSTRT_MFAIRWAIT_SET_COMPU_VERB "" TAB_VERB 1 0 "MFAIRWAIT_STRTR" /end COMPU_VTAB
/begin COMPU_METHOD ENGSTRT_STSTRTREQ_SET_COMPU_VERB "" TAB_VERB "%6.3" "-" COMPU_TAB_REF ENGSTRT_STSTRTREQ_SET_COMPU_VERB /end COMPU_METHOD
/begin COMPU_VTAB ENGSTRT_STSTRTREQ_SET_COMPU_VERB "" TAB_VERB 6 0 "ENGSTRT_NOSTRT" 1025 "ENGSTRT_PFI" 8192 "ENGSTRT_COMRUNNG" 8193 "ENGSTRT_COMSTRTG" 8194 "ENGSTRT_COMWAITSTRTR" 16384 "ENGSTRT_FOLW" /end COMPU_VTAB
/begin COMPU_METHOD ENGSTRT_TIFACAIRPTHTRANCON_SET_COMPU_VERB "" TAB_VERB "%6.3" "-" COMPU_TAB_REF ENGSTRT_TIFACAIRPTHTRANCON_SET_COMPU_VERB /end COMPU_METHOD
/begin COMPU_VTAB ENGSTRT_TIFACAIRPTHTRANCON_SET_COMPU_VERB "" TAB_VERB 2 0 "TIFACAIRPTHTRANCON_BASE" 1 "TIFACAIRPTHTRANCON_FOLW" /end COMPU_VTAB
/begin COMPU_METHOD ENGSTRT_TIFACAIRPTHTRAN_SET_COMPU_VERB "" TAB_VERB "%6.3" "-" COMPU_TAB_REF ENGSTRT_TIFACAIRPTHTRAN_SET_COMPU_VERB /end COMPU_METHOD
/begin COMPU_VTAB ENGSTRT_TIFACAIRPTHTRAN_SET_COMPU_VERB "" TAB_VERB 2 0 "TIFACAIRPTHTRAN_BASE" 1 "TIFACAIRPTHTRAN_FOLW" /end COMPU_VTAB
/begin COMPU_METHOD fak_q0p0078 "" RAT_FUNC "%6.4" "-" COEFFS 0 128 0 0 0 1 /end COMPU_METHOD
/begin COMPU_METHOD fak_ub_b2 "" RAT_FUNC "%8.5" "-" COEFFS 0 256 0 0 0 2 /end COMPU_METHOD
/begin COMPU_METHOD fak_ub_q0p00392 "" RAT_FUNC "%6.4" "-" COEFFS 0 255 0 0 0 1 /end COMPU_METHOD
/begin COMPU_METHOD fak_uw_b1 "" RAT_FUNC "%7.6" "-" COEFFS 0 65536 0 0 0 1 /end COMPU_METHOD
/begin COMPU_METHOD fak_uw_b2 "" RAT_FUNC "%7.6" "-" COEFFS 0 65536 0 0 0 2 /end COMPU_METHOD
/begin COMPU_METHOD fak_uw_b4 "" RAT_FUNC "%7.6" "-" COEFFS 0 65536 0 0 0 4 /end COMPU_METHOD
/begin COMPU_METHOD md_q0p1 "" RAT_FUNC "%6.3" "Nm" COEFFS 0 10 0 0 0 1 /end COMPU_METHOD
/begin COMPU_METHOD m_uw_b6553p5 "" RAT_FUNC "%6.3" "kg/h" COEFFS 0 1 0 0 0 0.1 /end COMPU_METHOD
/begin COMPU_METHOD nmot_q10 "" RAT_FUNC "%6.1" "1/min" COEFFS 0 1 0 0 0 10 /end COMPU_METHOD
/begin COMPU_METHOD nmot_ub_q10 "" RAT_FUNC "%6.1" "1/min" COEFFS 0 1 0 0 0 10 /end COMPU_METHOD
/begin COMPU_METHOD nmot_ub_q40 "" RAT_FUNC "%6.1" "1/min" COEFFS 0 1 0 0 0 40 /end COMPU_METHOD
/begin COMPU_METHOD OCWDA_stErrSimn_C_compu_VERB "" TAB_VERB "%6.3" "" COMPU_TAB_REF OCWDA_stErrSimn_C_compu_VERB /end COMPU_METHOD
/begin COMPU_VTAB OCWDA_stErrSimn_C_compu_VERB "" TAB_VERB 9 0 "OCWDA_CO_SIMN_OFF" 1 "OCWDA_CO_SIMNERRPINON" 2 "OCWDA_CO_SIMNERRPINOFF" 3 "OCWDA_CO_SIMNWDAACTV" 4 "OCWDA_CO_SIMNWDAOFF" 5 "OCWDA_CO_SIMNOVRVLTG" 6 "OCWDA_CO_SIMNNORMVLTG" 7 "OCWDA_CO_SIMNABEACTV" 8 "OCWDA_CO_SIMNABEOFF" /end COMPU_VTAB
/begin COMPU_METHOD OCWDA_swtOffRst_C_compu_VERB "" TAB_VERB "%6.3" "" COMPU_TAB_REF OCWDA_swtOffRst_C_compu_VERB /end COMPU_METHOD
/begin COMPU_VTAB OCWDA_swtOffRst_C_compu_VERB "" TAB_VERB 2 0 "OCWDA_RESET_ACTIVE" 1 "OCWDA_RESET_INACTIVE" /end COMPU_VTAB
/begin COMPU_METHOD OneToOne "" RAT_FUNC "%6.2" "-" COEFFS 0 1 0 0 0 1 /end COMPU_METHOD
/begin COMPU_METHOD Per_Dur "" RAT_FUNC "%6.2" "usec" COEFFS 0 1 0 0 0 1 /end COMPU_METHOD
/begin COMPU_METHOD Prc "" RAT_FUNC "%6.4" "%" COEFFS 0 81.92 0 0 0 1 /end COMPU_METHOD
/begin COMPU_METHOD pwr2 "" RAT_FUNC "%6.1" "W" COEFFS 0 0.0530516476972949 0 0 0 1 /end COMPU_METHOD
/begin COMPU_METHOD rel_ub_q0p75 "" RAT_FUNC "%6.3" "%" COEFFS 0 1 0 0 0 0.75 /end COMPU_METHOD
/begin COMPU_METHOD SigQly_COMPU_VERB "" TAB_VERB "%6.3" "" COMPU_TAB_REF SigQly_COMPU_VERB /end COMPU_METHOD
/begin COMPU_VTAB SigQly_COMPU_VERB "" TAB_VERB 16 0 "SIGQLY_NOTCALC" 1 "SIGQLY_INIT" 2 "SIGQLY_OK" 3 "SIGQLY_MODEL" 4 "SIGQLY_REPLACEMENT" 5 "SIGQLY_FROZEN" 6 "SIGQLY_INVALID" 7 "SIGQLY_RESERVED_7" 8 "SIGQLY_RESERVED_8" 9 "SIGQLY_RESERVED_9" 10 "SIGQLY_RESERVED_10" 11 "SIGQLY_RESERVED_11" 12 "SIGQLY_RESERVED_12" 13 "SIGQLY_RESERVED_13" 14 "SIGQLY_RESERVED_14" 15 "SIGQLY_RESERVED_15" /end COMPU_VTAB
/begin COMPU_METHOD spg_q0p001 "" RAT_FUNC "%6.5" "V" COEFFS 0 1000 0 0 0 1 /end COMPU_METHOD
/begin COMPU_METHOD SY_LSFNTL2_Compu "" TAB_VERB "%6.3" "" COMPU_TAB_REF SY_LSFNTL2_Compu /end COMPU_METHOD
/begin COMPU_VTAB SY_LSFNTL2_Compu "" TAB_VERB 2 0 "False" 1 "True" /end COMPU_VTAB
/begin COMPU_METHOD SY_LSFNTL_Compu "" TAB_VERB "%6.3" "" COMPU_TAB_REF SY_LSFNTL_Compu /end COMPU_METHOD
/begin COMPU_VTAB SY_LSFNTL_Compu "" TAB_VERB 2 0 "False" 1 "True" /end COMPU_VTAB
/begin COMPU_METHOD SY_LSFNVK2_Compu "" TAB_VERB "%6.3" "" COMPU_TAB_REF SY_LSFNVK2_Compu /end COMPU_METHOD
/begin COMPU_VTAB SY_LSFNVK2_Compu "" TAB_VERB 2 0 "keine Lambdasonde hinter Frontakat Bank 2" 1 "Lambdasonde hinter Frontakat Bank 2" /end COMPU_VTAB
/begin COMPU_METHOD SY_LSFNVK_Compu "" TAB_VERB "%6.3" "" COMPU_TAB_REF SY_LSFNVK_Compu /end COMPU_METHOD
/begin COMPU_VTAB SY_LSFNVK_Compu "" TAB_VERB 2 0 "keine Lambdasonde hinter dem Frontakat vorhanden" 1 "Lambdasonde hinter dem Frontakat vorhanden" /end COMPU_VTAB
/begin COMPU_METHOD SY_LSFVHK2_Compu "" TAB_VERB "%6.3" "" COMPU_TAB_REF SY_LSFVHK2_Compu /end COMPU_METHOD
/begin COMPU_VTAB SY_LSFVHK2_Compu "" TAB_VERB 2 0 "False" 1 "True" /end COMPU_VTAB
/begin COMPU_METHOD SY_LSFVHK_Compu "" TAB_VERB "%6.3" "" COMPU_TAB_REF SY_LSFVHK_Compu /end COMPU_METHOD
/begin COMPU_VTAB SY_LSFVHK_Compu "" TAB_VERB 2 0 "False" 1 "True" /end COMPU_VTAB
/begin COMPU_METHOD SY_LSFVVK2_Compu "" TAB_VERB "%6.3" "" COMPU_TAB_REF SY_LSFVVK2_Compu /end COMPU_METHOD
/begin COMPU_VTAB SY_LSFVVK2_Compu "" TAB_VERB 2 0 "keine LSF vor Vorkatalysator, Bank2 vorhanden" 1 "LSF vor Vorkatalysator, Bank2 vorhanden" /end COMPU_VTAB
/begin COMPU_METHOD SY_LSFVVK_Compu "" TAB_VERB "%6.3" "" COMPU_TAB_REF SY_LSFVVK_Compu /end COMPU_METHOD
/begin COMPU_VTAB SY_LSFVVK_Compu "" TAB_VERB 2 0 "keine LSF vor Vorkatalysator vorhanden" 1 "LSF vor Vorkatalysator vorhanden" /end COMPU_VTAB
/begin COMPU_METHOD SY_LSFV_Compu "" TAB_VERB "%6.3" "" COMPU_TAB_REF SY_LSFV_Compu /end COMPU_METHOD
/begin COMPU_VTAB SY_LSFV_Compu "" TAB_VERB 2 0 "keine Diag.vertauschte Sonden hinter FrontKat" 1 "Diagnose vertauschte Sonden hinter FrontKat" /end COMPU_VTAB
/begin COMPU_METHOD SY_LSHV_Compu "" TAB_VERB "%6.3" "" COMPU_TAB_REF SY_LSHV_Compu /end COMPU_METHOD
/begin COMPU_VTAB SY_LSHV_Compu "" TAB_VERB 2 0 "keine vertauschte Sonde hinter Kat im System" 1 "vertauschte Sonde hinter Kat im System vorhanden" /end COMPU_VTAB
/begin COMPU_METHOD SY_LSUIKR2_Compu "" TAB_VERB "%6.3" "" COMPU_TAB_REF SY_LSUIKR2_Compu /end COMPU_METHOD
/begin COMPU_VTAB SY_LSUIKR2_Compu "" TAB_VERB 2 0 "keine LSU im Abgaskrümmer Bank2 vorhanden" 1 "LSU im Abgaskrümmer Bank2 vorhanden" /end COMPU_VTAB
/begin COMPU_METHOD SY_LSUIKR_Compu "" TAB_VERB "%6.3" "" COMPU_TAB_REF SY_LSUIKR_Compu /end COMPU_METHOD
/begin COMPU_VTAB SY_LSUIKR_Compu "" TAB_VERB 2 0 "keine LSU im Abgaskrümmer vorhanden" 1 "LSU im Abgaskrümmer vorhanden" /end COMPU_VTAB
/begin COMPU_METHOD SY_LSUMRS_Compu "" TAB_VERB "%6.3" "" COMPU_TAB_REF SY_LSUMRS_Compu /end COMPU_METHOD
/begin COMPU_VTAB SY_LSUMRS_Compu "" TAB_VERB 2 0 "keine %LSUMRS vorhanden" 1 "%LSUMRS vorhanden" /end COMPU_VTAB
/begin COMPU_METHOD SY_LSUNHK2_Compu "" TAB_VERB "%6.3" "" COMPU_TAB_REF SY_LSUNHK2_Compu /end COMPU_METHOD
/begin COMPU_VTAB SY_LSUNHK2_Compu "" TAB_VERB 2 0 "LSU nicht nach Hauptkat, Bank2 verbaut" 1 "LSU nach Hauptkat, Bank2 verbaut" /end COMPU_VTAB
/begin COMPU_METHOD SY_LSUNHK_Compu "" TAB_VERB "%6.3" "" COMPU_TAB_REF SY_LSUNHK_Compu /end COMPU_METHOD
/begin COMPU_VTAB SY_LSUNHK_Compu "" TAB_VERB 2 0 "keine LSU nach Hauptkatalysator" 1 "LSU nach Hauptkatalysator" /end COMPU_VTAB
/begin COMPU_METHOD SY_LSUNTL2_Compu "" TAB_VERB "%6.3" "" COMPU_TAB_REF SY_LSUNTL2_Compu /end COMPU_METHOD
/begin COMPU_VTAB SY_LSUNTL2_Compu "" TAB_VERB 2 0 "keine LSU nach Abgasturbolader, Bank2" 1 "LSU nach Abgasturbolader, Bank2" /end COMPU_VTAB
/begin COMPU_METHOD SY_LSUNTL_Compu "" TAB_VERB "%6.3" "" COMPU_TAB_REF SY_LSUNTL_Compu /end COMPU_METHOD
/begin COMPU_VTAB SY_LSUNTL_Compu "" TAB_VERB 2 0 "keine LSU nach Abgasturbolader" 1 "LSU nach Abgasturbolader" /end COMPU_VTAB
/begin COMPU_METHOD SY_LSUNVK2_Compu "" TAB_VERB "%6.3" "" COMPU_TAB_REF SY_LSUNVK2_Compu /end COMPU_METHOD
/begin COMPU_VTAB SY_LSUNVK2_Compu "" TAB_VERB 2 0 "keine LSU nach Vorkat, Bank 2" 1 "LSU nach Vorkatalysator, Bank 2 verbaut" /end COMPU_VTAB
/begin COMPU_METHOD SY_LSUNVK_Compu "" TAB_VERB "%6.3" "" COMPU_TAB_REF SY_LSUNVK_Compu /end COMPU_METHOD
/begin COMPU_VTAB SY_LSUNVK_Compu "" TAB_VERB 2 0 "keine LSU nach Vorkatalysator" 1 "LSU nach Vorkatalysator" /end COMPU_VTAB
/begin COMPU_METHOD SY_LSUSTA_Compu "" TAB_VERB "%6.3" "" COMPU_TAB_REF SY_LSUSTA_Compu /end COMPU_METHOD
/begin COMPU_VTAB SY_LSUSTA_Compu "" TAB_VERB 2 0 "False" 1 "True" /end COMPU_VTAB
/begin COMPU_METHOD SY_LSUVHK2_Compu "" TAB_VERB "%6.3" "" COMPU_TAB_REF SY_LSUVHK2_Compu /end COMPU_METHOD
/begin COMPU_VTAB SY_LSUVHK2_Compu "" TAB_VERB 2 0 "keine LSU vor Hauptkatalysator, Bank 2 verbaut" 1 "LSU vor Hauptkatalysator, Bank 2 verbaut" /end COMPU_VTAB
/begin COMPU_METHOD SY_LSUVHK_Compu "" TAB_VERB "%6.3" "" COMPU_TAB_REF SY_LSUVHK_Compu /end COMPU_METHOD
/begin COMPU_VTAB SY_LSUVHK_Compu "" TAB_VERB 2 0 "keine LSU vor Hauptkatalysator" 1 "LSU vor Hauptkatalysator" /end COMPU_VTAB
/begin COMPU_METHOD SY_LSUVVK2_Compu "" TAB_VERB "%6.3" "" COMPU_TAB_REF SY_LSUVVK2_Compu /end COMPU_METHOD
/begin COMPU_VTAB SY_LSUVVK2_Compu "" TAB_VERB 2 0 "keine LSU vor Vorkatalysator, Bank2" 1 "LSU vor Vorkatalysator, Bank2" /end COMPU_VTAB
/begin COMPU_METHOD SY_LSUVVK_Compu "" TAB_VERB "%6.3" "" COMPU_TAB_REF SY_LSUVVK_Compu /end COMPU_METHOD
/begin COMPU_VTAB SY_LSUVVK_Compu "" TAB_VERB 2 0 "keine LSU vor Vorkatalysator" 1 "LSU vor Vorkatalysator" /end COMPU_VTAB
/begin COMPU_METHOD SY_LSVV_Compu "" TAB_VERB "%6.3" "" COMPU_TAB_REF SY_LSVV_Compu /end COMPU_METHOD
/begin COMPU_VTAB SY_LSVV_Compu "" TAB_VERB 2 0 "keine Diag.vertauschte Sonden vor Vorkat" 1 "Diagnose vertauschte Sonden vor Vorkat vorhanden" /end COMPU_VTAB
/begin COMPU_METHOD SY_LSZYVER_Compu "" TAB_VERB "%6.3" "" COMPU_TAB_REF SY_LSZYVER_Compu /end COMPU_METHOD
/begin COMPU_VTAB SY_LSZYVER_Compu "" TAB_VERB 2 0 "False" 1 "True" /end COMPU_VTAB
/begin COMPU_METHOD SY_LS_Compu "" TAB_VERB "%6.3" "" COMPU_TAB_REF SY_LS_Compu /end COMPU_METHOD
/begin COMPU_VTAB SY_LS_Compu "" TAB_VERB 2 0 "Lambda-Split nicht vorhanden" 1 "Lambda-Split vorhanden" /end COMPU_VTAB
/begin COMPU_METHOD SY_LUFAK_Compu "" RAT_FUNC "%6.2" "" COEFFS 0 1 0 0 0 1 /end COMPU_METHOD
/begin COMPU_METHOD SY_LUSRKR_Compu "" TAB_VERB "%6.3" "" COMPU_TAB_REF SY_LUSRKR_Compu /end COMPU_METHOD
/begin COMPU_VTAB SY_LUSRKR_Compu "" TAB_VERB 3 0 "no Scavenging" 1 "Scavenging with Inlet Cam Phasing" 2 "Scavenging with Inlet and Exhaust Cam Phasing" /end COMPU_VTAB
/begin COMPU_METHOD SY_LWMEXT_Compu "" TAB_VERB "%6.3" "" COMPU_TAB_REF SY_LWMEXT_Compu /end COMPU_METHOD
/begin COMPU_VTAB SY_LWMEXT_Compu "" TAB_VERB 4 0 "ValuesOfBGLWMFromBGLWM" 1 "ValuesOfBGLWMFromBGLWMwithBGLWMintegrated" 2 "ValuesOfBGLWMFromBGLWMwithBGLWMNotintegrated" 3 "Values of BGLWM from external function" /end COMPU_VTAB
/begin COMPU_METHOD SY_M8TE_Compu "" TAB_VERB "%6.3" "" COMPU_TAB_REF SY_M8TE_Compu /end COMPU_METHOD
/begin COMPU_VTAB SY_M8TE_Compu "" TAB_VERB 2 0 "False" 1 "True" /end COMPU_VTAB
/begin COMPU_METHOD SY_MAGER_Compu "" TAB_VERB "%6.3" "" COMPU_TAB_REF SY_MAGER_Compu /end COMPU_METHOD
/begin COMPU_VTAB SY_MAGER_Compu "" TAB_VERB 2 0 "kein Magerbetrieb erlaubt" 1 "Magerbetrieb erlaubt" /end COMPU_VTAB
/begin COMPU_METHOD SY_MDBGHS_Compu "" TAB_VERB "%6.3" "" COMPU_TAB_REF SY_MDBGHS_Compu /end COMPU_METHOD
/begin COMPU_VTAB SY_MDBGHS_Compu "" TAB_VERB 2 0 "False" 1 "True" /end COMPU_VTAB
/begin COMPU_METHOD SY_MDBGTI_Compu "" TAB_VERB "%6.3" "" COMPU_TAB_REF SY_MDBGTI_Compu /end COMPU_METHOD
/begin COMPU_VTAB SY_MDBGTI_Compu "" TAB_VERB 2 0 "0" 1 "1" /end COMPU_VTAB
/begin COMPU_METHOD SY_MDISTM_Compu "" TAB_VERB "%6.3" "" COMPU_TAB_REF SY_MDISTM_Compu /end COMPU_METHOD
/begin COMPU_VTAB SY_MDISTM_Compu "" TAB_VERB 2 0 "keine Modellierung eines mittleren Ist-Drehmomente" 1 "Bereitstellung eines mittleren Ist-Drehmomentes" /end COMPU_VTAB
/begin COMPU_METHOD SY_MDI_Compu "" TAB_VERB "%6.3" "" COMPU_TAB_REF SY_MDI_Compu /end COMPU_METHOD
/begin COMPU_VTAB SY_MDI_Compu "" TAB_VERB 2 0 "False" 1 "True" /end COMPU_VTAB
/begin COMPU_METHOD SY_MDMXEXC_Compu "" TAB_VERB "%6.3" "" COMPU_TAB_REF SY_MDMXEXC_Compu /end COMPU_METHOD
/begin COMPU_VTAB SY_MDMXEXC_Compu "" TAB_VERB 2 0 "False" 1 "True" /end COMPU_VTAB
/begin COMPU_METHOD SY_MDSRL_Compu "" TAB_VERB "%6.3" "" COMPU_TAB_REF SY_MDSRL_Compu /end COMPU_METHOD
/begin COMPU_VTAB SY_MDSRL_Compu "" TAB_VERB 2 0 "False" 1 "True" /end COMPU_VTAB
/begin COMPU_METHOD SY_MEVD172_Compu "" RAT_FUNC "%6.2" "" COEFFS 0 1 0 0 0 1 /end COMPU_METHOD
/begin COMPU_METHOD SY_MPM_Compu "" TAB_VERB "%6.3" "" COMPU_TAB_REF SY_MPM_Compu /end COMPU_METHOD
/begin COMPU_VTAB SY_MPM_Compu "" TAB_VERB 2 0 "False" 1 "True" /end COMPU_VTAB
/begin COMPU_METHOD SY_MSDKN_Compu "" TAB_VERB "%6.3" "" COMPU_TAB_REF SY_MSDKN_Compu /end COMPU_METHOD
/begin COMPU_VTAB SY_MSDKN_Compu "" TAB_VERB 2 0 "False" 1 "True" /end COMPU_VTAB
/begin COMPU_METHOD SY_MSGRED_Compu "" TAB_VERB "%6.3" "" COMPU_TAB_REF SY_MSGRED_Compu /end COMPU_METHOD
/begin COMPU_VTAB SY_MSGRED_Compu "" TAB_VERB 2 0 "False" 1 "True" /end COMPU_VTAB
/begin COMPU_METHOD SY_MSVKOMP_Compu "" TAB_VERB "%6.3" "" COMPU_TAB_REF SY_MSVKOMP_Compu /end COMPU_METHOD
/begin COMPU_VTAB SY_MSVKOMP_Compu "" TAB_VERB 10 0 "MSV-Ansteuerung Förderenderegelung, z.B. HDP2" 1 "MSV-Ansteuerung Förderbeginnregelung, z.B. Hitachi" 2 "MSV_DBCTR_PWM" 3 "MSV_SAC" 4 "MSV_Hitachi_Generation3" 5 "MSV_Hitachi_Generation1" 6 "MSV_Hitachi_RB" 7 "MSV_RB_HDP5evo" 8 "MSV_RB_HDP5-MSV_RB_HDP5evo" 9 "MSV_Conti_RB" /end COMPU_VTAB
/begin COMPU_METHOD SY_MTRXBLR_Compu "" TAB_VERB "%6.3" "" COMPU_TAB_REF SY_MTRXBLR_Compu /end COMPU_METHOD
/begin COMPU_VTAB SY_MTRXBLR_Compu "" TAB_VERB 2 0 "False" 1 "True" /end COMPU_VTAB
/begin COMPU_METHOD SY_MULCATI_Compu "" TAB_VERB "%6.3" "" COMPU_TAB_REF SY_MULCATI_Compu /end COMPU_METHOD
/begin COMPU_VTAB SY_MULCATI_Compu "" TAB_VERB 2 0 "False" 1 "True" /end COMPU_VTAB
/begin COMPU_METHOD SY_NG_Compu "" TAB_VERB "%6.3" "" COMPU_TAB_REF SY_NG_Compu /end COMPU_METHOD
/begin COMPU_VTAB SY_NG_Compu "" TAB_VERB 4 0 "SY_NG_0" 1 "SY_NG_1" 2 "SY_NG_2" 3 "SY_NG_3" /end COMPU_VTAB
/begin COMPU_METHOD SY_NLLKHFH_Compu "" TAB_VERB "%6.3" "" COMPU_TAB_REF SY_NLLKHFH_Compu /end COMPU_METHOD
/begin COMPU_VTAB SY_NLLKHFH_Compu "" TAB_VERB 2 0 "SY_NLLKHFH=0" 1 "SY_NLLKHFH=1" /end COMPU_VTAB
/begin COMPU_METHOD SY_NLZOFF_Compu "" TAB_VERB "%6.3" "" COMPU_TAB_REF SY_NLZOFF_Compu /end COMPU_METHOD
/begin COMPU_VTAB SY_NLZOFF_Compu "" TAB_VERB 2 0 "false" 1 "true" /end COMPU_VTAB
/begin COMPU_METHOD SY_NOHK_Compu "" TAB_VERB "%6.3" "" COMPU_TAB_REF SY_NOHK_Compu /end COMPU_METHOD
/begin COMPU_VTAB SY_NOHK_Compu "" TAB_VERB 2 0 "kein NOx-Sensor hinter Kat" 1 "NOx-Sensor hinter Kat" /end COMPU_VTAB
/begin COMPU_METHOD SY_NOKT_Compu "" TAB_VERB "%6.3" "" COMPU_TAB_REF SY_NOKT_Compu /end COMPU_METHOD
/begin COMPU_VTAB SY_NOKT_Compu "" TAB_VERB 2 0 "no" 1 "dzwzk" /end COMPU_VTAB
/begin COMPU_METHOD SY_NOXKAT2_Compu "" TAB_VERB "%6.3" "" COMPU_TAB_REF SY_NOXKAT2_Compu /end COMPU_METHOD
/begin COMPU_VTAB SY_NOXKAT2_Compu "" TAB_VERB 2 0 "NOx-Speicherkat in Abgassystem nicht verbaut" 1 "NOx-Speicherkat in Abgassystem verbaut" /end COMPU_VTAB
/begin COMPU_METHOD SY_NOXKAT_Compu "" TAB_VERB "%6.3" "" COMPU_TAB_REF SY_NOXKAT_Compu /end COMPU_METHOD
/begin COMPU_VTAB SY_NOXKAT_Compu "" TAB_VERB 2 0 "kein NOx-Speicherkat vorhanden" 1 "NOx-Speicherkat vorhanden" /end COMPU_VTAB
/begin COMPU_METHOD SY_NSAC_Compu "" RAT_FUNC "%6.2" "" COEFFS 0 1 0 0 0 1 /end COMPU_METHOD
/begin COMPU_METHOD SY_NSAD_Compu "" TAB_VERB "%6.3" "" COMPU_TAB_REF SY_NSAD_Compu /end COMPU_METHOD
/begin COMPU_VTAB SY_NSAD_Compu "" TAB_VERB 2 0 "keine Nachstartadaption" 1 "Nachstartadaption" /end COMPU_VTAB
/begin COMPU_METHOD SY_NSALT_Compu "" RAT_FUNC "%6.2" "" COEFFS 0 1 0 0 0 1 /end COMPU_METHOD
/begin COMPU_METHOD SY_NSASG_Compu "" RAT_FUNC "%6.2" "" COEFFS 0 1 0 0 0 1 /end COMPU_METHOD
/begin COMPU_METHOD SY_NSBLP_Compu "" RAT_FUNC "%6.2" "" COEFFS 0 1 0 0 0 1 /end COMPU_METHOD
/begin COMPU_METHOD SY_NSCAM_Compu "" RAT_FUNC "%6.2" "" COEFFS 0 1 0 0 0 1 /end COMPU_METHOD
/begin COMPU_METHOD SY_NSCAT_Compu "" RAT_FUNC "%6.2" "" COEFFS 0 1 0 0 0 1 /end COMPU_METHOD
/begin COMPU_METHOD SY_NSCDE_Compu "" RAT_FUNC "%6.2" "" COEFFS 0 1 0 0 0 1 /end COMPU_METHOD
/begin COMPU_METHOD SY_NSCRP_Compu "" RAT_FUNC "%6.2" "" COEFFS 0 1 0 0 0 1 /end COMPU_METHOD
/begin COMPU_METHOD t100msxs_uw_b6553p5 "" RAT_FUNC "%6.3" "s" COEFFS 0 1 0 0 0 0.1 /end COMPU_METHOD
/begin COMPU_METHOD t100msxs_uw_q100 "" RAT_FUNC "%6.3" "s" COEFFS 0 1 0 0 0 0.1 /end COMPU_METHOD
/begin COMPU_METHOD t10msxs_uw_b655p35 "" RAT_FUNC "%6.4" "s" COEFFS 0 1 0 0 0 0.01 /end COMPU_METHOD
/begin COMPU_METHOD t1sxs_ub_b255 "" RAT_FUNC "%6.2" "s" COEFFS 0 1 0 0 0 1 /end COMPU_METHOD
/begin COMPU_METHOD t1sxs_uw_q1 "" RAT_FUNC "%6.2" "s" COEFFS 0 1 0 0 0 1 /end COMPU_METHOD
/begin COMPU_METHOD t200msxs_uw_q0p2 "" RAT_FUNC "%6.3" "s" COEFFS 0 1 0 0 0 0.2 /end COMPU_METHOD
/begin COMPU_METHOD Temp_Cels "" RAT_FUNC "%6.1" "deg C" COEFFS 0 10 2731.4 0 0 1 /end COMPU_METHOD
/begin COMPU_METHOD temp_q0p0234 "" RAT_FUNC "%6.4" "K" COEFFS 0 256 0 0 0 6 /end COMPU_METHOD
/begin COMPU_METHOD temp_q0p0234_o273 "" RAT_FUNC "%6.1" "Grad C" COEFFS 0 1 273.15 0 0 0.0234375 /end COMPU_METHOD
/begin COMPU_METHOD temp_ub_b191p25 "" RAT_FUNC "%6.3" "Grad C" COEFFS 0 1 0 0 0 0.75 /end COMPU_METHOD
/begin COMPU_METHOD temp_ub_q0p75_o48 "" RAT_FUNC "%6.2" "Grad C" COEFFS 0 1 48 0 0 0.75 /end COMPU_METHOD
/begin COMPU_METHOD temp_ub_q1_o60 "" RAT_FUNC "%6.2" "Grad C" COEFFS 0 1 60 0 0 1 /end COMPU_METHOD
/begin COMPU_METHOD temp_uw_q0p75_o48 "" RAT_FUNC "%6.2" "Grad C" COEFFS 0 1 48 0 0 0.75 /end COMPU_METHOD
/begin COMPU_METHOD TimeDeb "" RAT_FUNC "%6.1" "ms" COEFFS 0 0.1 0 0 0 1 /end COMPU_METHOD
/begin COMPU_METHOD TimeDelay_s "" RAT_FUNC "%6.1" "s" COEFFS 0 0 1 0 0.00023283064365387 0 /end COMPU_METHOD
/begin COMPU_METHOD Time_Dt "" RAT_FUNC "%9.8" "s" COEFFS 0 1000000 0 0 0 1 /end COMPU_METHOD
/begin COMPU_METHOD t_q0p01 "" RAT_FUNC "%6.4" "s" COEFFS 0 100 0 0 0 1 /end COMPU_METHOD
/begin COMPU_METHOD t_q0p1 "" RAT_FUNC "%6.3" "s" COEFFS 0 10 0 0 0 1 /end COMPU_METHOD
/begin COMPU_METHOD t_q1 "" RAT_FUNC "%6.2" "s" COEFFS 0 1 0 0 0 1 /end COMPU_METHOD
/begin COMPU_METHOD Vel "" RAT_FUNC "%6.4" "km/h" COEFFS 0 100 0 0 0 1 /end COMPU_METHOD
/begin COMPU_METHOD vfzg_ub_q1p25 "" RAT_FUNC "%6.2" "km/h" COEFFS 0 1 0 0 0 1.25 /end COMPU_METHOD
/begin COMPU_METHOD Volt "" RAT_FUNC "%6.3" "mV" COEFFS 0 5 0 0 0 1 /end COMPU_METHOD
/begin COMPU_METHOD zk100msxs_ub_b25p5 "" RAT_FUNC "%6.3" "s" COEFFS 0 0 256 0 10 0 /end COMPU_METHOD
/begin COMPU_METHOD zk10msxs_uw_b655 "" RAT_FUNC "%6.2" "s" COEFFS 0 0 65536 0 100 0 /end COMPU_METHOD
/begin COMPU_METHOD default "" RAT_FUNC "%6.2" "" COEFFS 0 1 0 0 0 1 /end COMPU_METHOD
/begin RECORD_LAYOUT Kw_Ws16 FNC_VALUES 1 SWORD COLUMN_DIR DIRECT /end RECORD_LAYOUT
/begin RECORD_LAYOUT RB_Axis_S16 NO_AXIS_PTS_X 1 SWORD AXIS_PTS_X 2 SWORD INDEX_INCR DIRECT /end RECORD_LAYOUT
/begin RECORD_LAYOUT RB_Axis_U16 NO_AXIS_PTS_X 1 UWORD AXIS_PTS_X 2 UWORD INDEX_INCR DIRECT /end RECORD_LAYOUT
/begin RECORD_LAYOUT RB_Axis_U8 NO_AXIS_PTS_X 1 UBYTE AXIS_PTS_X 2 UBYTE INDEX_INCR DIRECT /end RECORD_LAYOUT
/begin RECORD_LAYOUT RB_CurveGroup_U16 FNC_VALUES 1 UWORD COLUMN_DIR DIRECT /end RECORD_LAYOUT
/begin RECORD_LAYOUT RB_CurveGroup_U8 FNC_VALUES 1 UBYTE COLUMN_DIR DIRECT /end RECORD_LAYOUT
/begin RECORD_LAYOUT RB_Curve_S16_S16 NO_AXIS_PTS_X 1 SWORD AXIS_PTS_X 2 SWORD INDEX_INCR DIRECT FNC_VALUES 3 SWORD COLUMN_DIR DIRECT /end RECORD_LAYOUT
/begin RECORD_LAYOUT RB_Curve_S16_U16_Static NO_AXIS_PTS_X 1 SWORD AXIS_PTS_X 2 SWORD INDEX_INCR DIRECT FNC_VALUES 3 UWORD COLUMN_DIR DIRECT STATIC_RECORD_LAYOUT /end RECORD_LAYOUT
/begin RECORD_LAYOUT RB_Curve_U16_U16 NO_AXIS_PTS_X 1 UWORD AXIS_PTS_X 2 UWORD INDEX_INCR DIRECT FNC_VALUES 3 UWORD COLUMN_DIR DIRECT /end RECORD_LAYOUT
/begin RECORD_LAYOUT RB_Curve_U16_U8_Static NO_AXIS_PTS_X 1 UWORD AXIS_PTS_X 2 UWORD INDEX_INCR DIRECT FNC_VALUES 3 UBYTE COLUMN_DIR DIRECT STATIC_RECORD_LAYOUT /end RECORD_LAYOUT
/begin RECORD_LAYOUT RB_Curve_U8_S16_Static NO_AXIS_PTS_X 1 UBYTE AXIS_PTS_X 2 UBYTE INDEX_INCR DIRECT FNC_VALUES 3 SWORD COLUMN_DIR DIRECT STATIC_RECORD_LAYOUT /end RECORD_LAYOUT
/begin RECORD_LAYOUT RB_Curve_U8_U16_Static NO_AXIS_PTS_X 1 UBYTE AXIS_PTS_X 2 UBYTE INDEX_INCR DIRECT FNC_VALUES 3 UWORD COLUMN_DIR DIRECT STATIC_RECORD_LAYOUT /end RECORD_LAYOUT
/begin RECORD_LAYOUT RB_Curve_U8_U8 NO_AXIS_PTS_X 1 UBYTE AXIS_PTS_X 2 UBYTE INDEX_INCR DIRECT FNC_VALUES 3 UBYTE COLUMN_DIR DIRECT /end RECORD_LAYOUT
/begin RECORD_LAYOUT RB_MapGroup_U16 FNC_VALUES 1 UWORD COLUMN_DIR DIRECT /end RECORD_LAYOUT
/begin RECORD_LAYOUT RB_MapGroup_U8 FNC_VALUES 1 UBYTE COLUMN_DIR DIRECT /end RECORD_LAYOUT
/begin RECORD_LAYOUT RB_Map_S16S16_U8 NO_AXIS_PTS_X 1 SWORD NO_AXIS_PTS_Y 2 SWORD AXIS_PTS_X 3 SWORD INDEX_INCR DIRECT AXIS_PTS_Y 4 SWORD INDEX_INCR DIRECT FNC_VALUES 5 UBYTE COLUMN_DIR DIRECT /end RECORD_LAYOUT
/begin RECORD_LAYOUT RB_Map_S16U16_U16 NO_AXIS_PTS_X 1 SWORD NO_AXIS_PTS_Y 2 SWORD AXIS_PTS_X 3 SWORD INDEX_INCR DIRECT AXIS_PTS_Y 4 UWORD INDEX_INCR DIRECT FNC_VALUES 5 UWORD ROW_DIR DIRECT /end RECORD_LAYOUT
/begin RECORD_LAYOUT RB_Map_S16U8_S16 NO_AXIS_PTS_X 1 SWORD NO_AXIS_PTS_Y 2 SWORD AXIS_PTS_X 3 SWORD INDEX_INCR DIRECT AXIS_PTS_Y 4 UBYTE INDEX_INCR DIRECT FNC_VALUES 5 SWORD COLUMN_DIR DIRECT /end RECORD_LAYOUT
/begin RECORD_LAYOUT RB_Map_U16S16_U16 NO_AXIS_PTS_X 1 UWORD NO_AXIS_PTS_Y 2 UWORD AXIS_PTS_X 3 UWORD INDEX_INCR DIRECT AXIS_PTS_Y 4 SWORD INDEX_INCR DIRECT FNC_VALUES 5 UWORD COLUMN_DIR DIRECT /end RECORD_LAYOUT
/begin RECORD_LAYOUT RB_Map_U16S16_U8 NO_AXIS_PTS_X 1 UWORD NO_AXIS_PTS_Y 2 UWORD AXIS_PTS_X 3 UWORD INDEX_INCR DIRECT AXIS_PTS_Y 4 SWORD INDEX_INCR DIRECT FNC_VALUES 5 UBYTE COLUMN_DIR DIRECT /end RECORD_LAYOUT
/begin RECORD_LAYOUT RB_Map_U16U16_U16 NO_AXIS_PTS_X 1 UWORD NO_AXIS_PTS_Y 2 UWORD AXIS_PTS_X 3 UWORD INDEX_INCR DIRECT AXIS_PTS_Y 4 UWORD INDEX_INCR DIRECT FNC_VALUES 5 UWORD COLUMN_DIR DIRECT /end RECORD_LAYOUT
/begin RECORD_LAYOUT RB_Map_U16U8_S16 NO_AXIS_PTS_X 1 UWORD NO_AXIS_PTS_Y 2 UWORD AXIS_PTS_X 3 UWORD INDEX_INCR DIRECT AXIS_PTS_Y 4 UBYTE INDEX_INCR DIRECT FNC_VALUES 5 SWORD COLUMN_DIR DIRECT /end RECORD_LAYOUT
/begin RECORD_LAYOUT RB_Map_U8S16_U16 NO_AXIS_PTS_X 1 UBYTE NO_AXIS_PTS_Y 2 UBYTE AXIS_PTS_X 3 UBYTE INDEX_INCR DIRECT AXIS_PTS_Y 4 SWORD INDEX_INCR DIRECT FNC_VALUES 5 UWORD ROW_DIR DIRECT /end RECORD_LAYOUT
/begin RECORD_LAYOUT RB_Map_U8U16_U8 NO_AXIS_PTS_X 1 UBYTE NO_AXIS_PTS_Y 2 UBYTE AXIS_PTS_X 3 UBYTE INDEX_INCR DIRECT AXIS_PTS_Y 4 UWORD INDEX_INCR DIRECT FNC_VALUES 5 UBYTE ROW_DIR DIRECT /end RECORD_LAYOUT
/begin RECORD_LAYOUT RB_Map_U8U8_U8 NO_AXIS_PTS_X 1 UBYTE NO_AXIS_PTS_Y 2 UBYTE AXIS_PTS_X 3 UBYTE INDEX_INCR DIRECT AXIS_PTS_Y 4 UBYTE INDEX_INCR DIRECT FNC_VALUES 5 UBYTE COLUMN_DIR DIRECT /end RECORD_LAYOUT
/begin RECORD_LAYOUT RB_Val_Wboolean FNC_VALUES 1 UBYTE COLUMN_DIR DIRECT /end RECORD_LAYOUT
/begin RECORD_LAYOUT RB_Val_Ws16 FNC_VALUES 1 SWORD COLUMN_DIR DIRECT /end RECORD_LAYOUT
/begin RECORD_LAYOUT RB_Val_Ws32 FNC_VALUES 1 SLONG COLUMN_DIR DIRECT /end RECORD_LAYOUT
/begin RECORD_LAYOUT RB_Val_Ws8 FNC_VALUES 1 SBYTE COLUMN_DIR DIRECT /end RECORD_LAYOUT
/begin RECORD_LAYOUT RB_Val_Wu16 FNC_VALUES 1 UWORD COLUMN_DIR DIRECT /end RECORD_LAYOUT
/begin RECORD_LAYOUT RB_Val_Wu32 FNC_VALUES 1 ULONG COLUMN_DIR DIRECT /end RECORD_LAYOUT
/begin RECORD_LAYOUT RB_Val_Wu8 FNC_VALUES 1 UBYTE COLUMN_DIR DIRECT /end RECORD_LAYOUT
/begin RECORD_LAYOUT Val_Ws16 FNC_VALUES 1 SWORD COLUMN_DIR DIRECT /end RECORD_LAYOUT
/begin RECORD_LAYOUT Val_Wu8 FNC_VALUES 1 UBYTE COLUMN_DIR DIRECT /end RECORD_LAYOUT
/end MODULE
/end PROJECT
