ASAP2_VERSION 1 60
/begin PROJECT MG1CA020 "MG1CA020"
/begin HEADER "" VERSION "MG1CA020_6SAY_V011_TPROT" PROJECT_NO MG1CA020 /end HEADER
/begin MODULE DIM ""
/begin MOD_COMMON "" BYTE_ORDER MSB_LAST ALIGNMENT_BYTE 1 ALIGNMENT_WORD 2 ALIGNMENT_LONG 4 ALIGNMENT_INT64 4 ALIGNMENT_FLOAT32_IEEE 4 ALIGNMENT_FLOAT64_IEEE 4 DATA_SIZE 32 /end MOD_COMMON
/begin CHARACTERISTIC DPSWATCHINDEX "Index of the observed output stage (in case of diagnosis problem)" VALUE 0x8053A4C4 KwUb 255.0 dez 0.00 255.0 FORMAT "%5.1" /end CHARACTERISTIC
/begin CHARACTERISTIC DRIVE_Clear_Arbitrary_C "Switch to clear, measure or disable recording of data." VALUE 0x8053A79A Val_Wu8 2.00000000000 DRIVE_PRDS_CLEARSTORETYPE 0.00 2.00000000000 FORMAT "%13.11" /end CHARACTERISTIC
/begin CHARACTERISTIC DRIVE_Clear_BadEngStrt_C "Switch to clear, measure or disable recording of data." VALUE 0x8053A79B Val_Wu8 2.00000000000 DRIVE_PRDS_CLEARSTORETYPE 0.00 2.00000000000 FORMAT "%13.11" /end CHARACTERISTIC
/begin CHARACTERISTIC DRIVE_Clear_C "Calibration to clear the recorded data of the drive recorder" VALUE 0x8053A79C Val_Wu8 2.00000000000 DRIVE_PRDS_CLEARSTORETYPE 0.00 2.00000000000 FORMAT "%13.11" /end CHARACTERISTIC
/begin CHARACTERISTIC DRIVE_Clear_EngStal_C "Switch to clear, measure or disable recording of data." VALUE 0x8053A79D Val_Wu8 2.00000000000 DRIVE_PRDS_CLEARSTORETYPE 0.00 2.00000000000 FORMAT "%13.11" /end CHARACTERISTIC
/begin CHARACTERISTIC DRIVE_CurTrgMode_C "Current trigger mode sect by calibration(For testing)" VALUE 0x8053A79E Val_Wu8 2.00000000000 DRIVE_PRDS_TRGMODETYPE 0.00 2.00000000000 FORMAT "%13.11" /end CHARACTERISTIC
/begin CHARACTERISTIC DRIVE_numBadStrtDCTIDLst_CA "DCTID list for Bad Engine start measurement blocks" VAL_BLK 0x8053A7A0 ValA_Wu16 65535.00 OneToOne 0.00 65535.00 FORMAT "%8.2" NUMBER 6 /end CHARACTERISTIC
/begin CHARACTERISTIC DRIVE_numDCTIDLst_CA "DCTID of snapshot and singleshot record in drive recorder" VAL_BLK 0x8053A7AC ValA_Wu16 65535.00 OneToOne 0.00 65535.00 FORMAT "%8.2" NUMBER 28 /end CHARACTERISTIC
/begin CHARACTERISTIC DRIVE_numEngStalDCTIDLst_CA "DCTID list for Engine stall measurement blocks" VAL_BLK 0x8053A7E4 ValA_Wu16 65535.00 OneToOne 0.00 65535.00 FORMAT "%8.2" NUMBER 6 /end CHARACTERISTIC
/begin CHARACTERISTIC DRIVE_numSysId_C "System identifier for diesel ecu" VALUE 0x804D8646 Val_Wu8 1.000 OneToOne 0.00 1.000 FORMAT "%5.3" EXTENDED_LIMITS 0.00 255.0 /end CHARACTERISTIC
/begin CHARACTERISTIC DRIVE_PRDS_Bnk0Blk00_Sig_CA "Calibration array for bank 0 block 0 recording" VAL_BLK 0x8053A7F0 ValA_Wu16 782.000000000 Signals_IntSigNumVerb 0.00 782.000000000 FORMAT "%13.9" NUMBER 8 /end CHARACTERISTIC
/begin CHARACTERISTIC DRIVE_PRDS_Bnk0Blk01_Sig_CA "Calibration array for bank 0 block 1 recording" VAL_BLK 0x8053A800 ValA_Wu16 782.000000000 Signals_IntSigNumVerb 0.00 782.000000000 FORMAT "%13.9" NUMBER 35 /end CHARACTERISTIC
/begin CHARACTERISTIC DRIVE_PRDS_Bnk0Blk02_Sig_CA "Calibration array for bank 0 block 2 recording" VAL_BLK 0x8053A846 ValA_Wu16 782.000000000 Signals_IntSigNumVerb 0.00 782.000000000 FORMAT "%13.9" NUMBER 9 /end CHARACTERISTIC
/begin CHARACTERISTIC DRIVE_PRDS_Bnk0Blk04_Sig_CA "Calibration array for bank 0 block 4 recording" VAL_BLK 0x8053A858 ValA_Wu16 782.000000000 Signals_IntSigNumVerb 0.00 782.000000000 FORMAT "%13.9" NUMBER 10 /end CHARACTERISTIC
/begin CHARACTERISTIC DRIVE_PRDS_Bnk0Blk05_Sig_CA "Calibration array for bank 0 block 5 recording" VAL_BLK 0x8053A86C ValA_Wu16 782.000000000 Signals_IntSigNumVerb 0.00 782.000000000 FORMAT "%13.9" NUMBER 10 /end CHARACTERISTIC
/begin CHARACTERISTIC DRIVE_PRDS_Bnk0Blk06_Sig_CA "Calibration array for bank 0 block 6 recording" VAL_BLK 0x8053A880 ValA_Wu16 782.000000000 Signals_IntSigNumVerb 0.00 782.000000000 FORMAT "%13.9" NUMBER 41 /end CHARACTERISTIC
/begin CHARACTERISTIC DRIVE_PRDS_Bnk0Blk07_Sig_CA "Calibration array for bank 0 block 7 recording" VAL_BLK 0x8053A8D2 ValA_Wu16 782.000000000 Signals_IntSigNumVerb 0.00 782.000000000 FORMAT "%13.9" NUMBER 12 /end CHARACTERISTIC
/begin CHARACTERISTIC DRIVE_PRDS_Bnk0Blk09_Sig_CA "Calibration array for bank 0 block 9 recording" VAL_BLK 0x8053A8EA ValA_Wu16 782.000000000 Signals_IntSigNumVerb 0.00 782.000000000 FORMAT "%13.9" NUMBER 11 /end CHARACTERISTIC
/begin CHARACTERISTIC DRIVE_PRDS_Bnk0Blk0a_Sig_CA "Calibration array for bank 0 block 10 recording" VAL_BLK 0x8053A900 ValA_Wu16 782.000000000 Signals_IntSigNumVerb 0.00 782.000000000 FORMAT "%13.9" NUMBER 2 /end CHARACTERISTIC
/begin CHARACTERISTIC DRIVE_PRDS_Bnk0Blk0b_Sig_CA "Calibration array for bank 0 block 11 recording" VAL_BLK 0x8053A904 ValA_Wu16 782.000000000 Signals_IntSigNumVerb 0.00 782.000000000 FORMAT "%13.9" NUMBER 6 /end CHARACTERISTIC
/begin CHARACTERISTIC DRIVE_PRDS_Bnk0Blk0c_Sig_CA "Calibration array for bank 0 block 12 recording" VAL_BLK 0x8053A910 ValA_Wu16 782.000000000 Signals_IntSigNumVerb 0.00 782.000000000 FORMAT "%13.9" NUMBER 4 /end CHARACTERISTIC
/begin CHARACTERISTIC DRIVE_PRDS_Bnk0Blk0d_Sig_CA "Calibration array for bank 0 block 13 recording" VAL_BLK 0x8053A918 ValA_Wu16 782.000000000 Signals_IntSigNumVerb 0.00 782.000000000 FORMAT "%13.9" NUMBER 8 /end CHARACTERISTIC
/begin CHARACTERISTIC DRIVE_PRDS_Bnk0Blk0e_Sig_CA "Calibration array for Bank 0 Block e recording" VAL_BLK 0x8053A928 ValA_Wu16 782.000000000 Signals_IntSigNumVerb 0.00 782.000000000 FORMAT "%13.9" NUMBER 30 /end CHARACTERISTIC
/begin CHARACTERISTIC DRIVE_PRDS_Bnk0Blk0f_Sig_CA "Calibration array for Bank0 Block f recording" VAL_BLK 0x8053A964 ValA_Wu16 782.000000000 Signals_IntSigNumVerb 0.00 782.000000000 FORMAT "%13.9" NUMBER 41 /end CHARACTERISTIC
/begin CHARACTERISTIC DRIVE_PRDS_Bnk0Blk10_Sig_CA "Calibration array for Bank0 Block 10 recording" VAL_BLK 0x8053A9B6 ValA_Wu16 782.000000000 Signals_IntSigNumVerb 0.00 782.000000000 FORMAT "%13.9" NUMBER 42 /end CHARACTERISTIC
/begin CHARACTERISTIC DRIVE_PRDS_Bnk0Blk11_Sig_CA "Calibration array for Bank 0 Block 11 recording" VAL_BLK 0x8053AA0A ValA_Wu16 782.000000000 Signals_IntSigNumVerb 0.00 782.000000000 FORMAT "%13.9" NUMBER 42 /end CHARACTERISTIC
/begin CHARACTERISTIC DRIVE_PRDS_Bnk0Blk12_Sig_CA "Calibration array for Bank 0 Block 12 recording" VAL_BLK 0x8053AA5E ValA_Wu16 782.000000000 Signals_IntSigNumVerb 0.00 782.000000000 FORMAT "%13.9" NUMBER 42 /end CHARACTERISTIC
/begin CHARACTERISTIC DRIVE_PRDS_Bnk0Blk13_Sig_CA "Calibration array for Bank 0 Block 13 recording" VAL_BLK 0x8053AAB2 ValA_Wu16 782.000000000 Signals_IntSigNumVerb 0.00 782.000000000 FORMAT "%13.9" NUMBER 42 /end CHARACTERISTIC
/begin CHARACTERISTIC DRIVE_PRDS_Bnk0Blk14_Sig_CA "Calibration array for Bank 0 Block 14 recording" VAL_BLK 0x8053AB06 ValA_Wu16 782.000000000 Signals_IntSigNumVerb 0.00 782.000000000 FORMAT "%13.9" NUMBER 3 /end CHARACTERISTIC
/begin CHARACTERISTIC DRIVE_PRDS_Bnk0Blk15_Sig_CA "Calibration array for Bank 0 Block 15 recording" VAL_BLK 0x8053AB0C ValA_Wu16 782.000000000 Signals_IntSigNumVerb 0.00 782.000000000 FORMAT "%13.9" NUMBER 29 /end CHARACTERISTIC
/begin CHARACTERISTIC DRIVE_PRDS_Bnk0Blk16_Sig_CA "Calibration array for Bank 0 Block 16 recording" VAL_BLK 0x8053AB46 ValA_Wu16 782.000000000 Signals_IntSigNumVerb 0.00 782.000000000 FORMAT "%13.9" NUMBER 1 /end CHARACTERISTIC
/begin CHARACTERISTIC DRIVE_PRDS_Bnk0Blk17_Sig_CA "Calibration array for Bank 0 Block 17 recording" VAL_BLK 0x8053AB48 ValA_Wu16 782.000000000 Signals_IntSigNumVerb 0.00 782.000000000 FORMAT "%13.9" NUMBER 10 /end CHARACTERISTIC
/begin CHARACTERISTIC DRIVE_PRDS_Bnk0Blk18_Sig_CA "Calibration array for Bank 0 Block 18 recording" VAL_BLK 0x8053AB5C ValA_Wu16 782.000000000 Signals_IntSigNumVerb 0.00 782.000000000 FORMAT "%13.9" NUMBER 2 /end CHARACTERISTIC
/begin CHARACTERISTIC DRIVE_PRDS_Bnk0Blk19_Sig_CA "Calibration array for Bank 0 Block 19 recording" VAL_BLK 0x8053AB60 ValA_Wu16 782.000000000 Signals_IntSigNumVerb 0.00 782.000000000 FORMAT "%13.9" NUMBER 2 /end CHARACTERISTIC
/begin CHARACTERISTIC DRIVE_PRDS_Bnk0Blk1a_Sig_CA "Calibration array for bank 0 block 1a recording" VAL_BLK 0x8053AB64 ValA_Wu16 782.000000000 Signals_IntSigNumVerb 0.00 782.000000000 FORMAT "%13.9" NUMBER 23 /end CHARACTERISTIC
/begin CHARACTERISTIC DRIVE_PRDS_Bnk0Blk1b_Sig_CA "Calibration array for bank 0 block 1b recording" VAL_BLK 0x8053AB92 ValA_Wu16 782.000000000 Signals_IntSigNumVerb 0.00 782.000000000 FORMAT "%13.9" NUMBER 2 /end CHARACTERISTIC
/begin CHARACTERISTIC DRIVE_PRDS_Bnk1Blk00_Sig_CA "Calibration array for bank 1 block 0 recording" VAL_BLK 0x8053AB96 ValA_Wu16 782.000000000 Signals_IntSigNumVerb 0.00 782.000000000 FORMAT "%13.9" NUMBER 35 /end CHARACTERISTIC
/begin CHARACTERISTIC DRIVE_PRDS_Bnk1Blk02_Sig_CA "Calibration array for Bank 1 Block 02 recording" VAL_BLK 0x8053ABDC ValA_Wu16 782.000000000 Signals_IntSigNumVerb 0.00 782.000000000 FORMAT "%13.9" NUMBER 8 /end CHARACTERISTIC
/begin CHARACTERISTIC DRIVE_PRDS_Bnk1Blk03_Sig_CA "Calibration array for Bank 1 Block 03 recording" VAL_BLK 0x8053ABEC ValA_Wu16 782.000000000 Signals_IntSigNumVerb 0.00 782.000000000 FORMAT "%13.9" NUMBER 7 /end CHARACTERISTIC
/begin CHARACTERISTIC DRIVE_PRDS_Bnk1Blk04_Sig_CA "Calibration array for bank 1 block 4 recording" VAL_BLK 0x8053ABFA ValA_Wu16 782.000000000 Signals_IntSigNumVerb 0.00 782.000000000 FORMAT "%13.9" NUMBER 7 /end CHARACTERISTIC
/begin CHARACTERISTIC DRIVE_PRDS_Bnk1Blk05_Sig_CA "Calibration array for Bank 1 Block 05 recording" VAL_BLK 0x8053AC08 ValA_Wu16 782.000000000 Signals_IntSigNumVerb 0.00 782.000000000 FORMAT "%13.9" NUMBER 18 /end CHARACTERISTIC
/begin CHARACTERISTIC Drive_stClrData_Arbitrary_C "Calibration to decide drive recorder action in case of non volatile memory error" VALUE 0x8053AC2C Val_Wu8 1.000 OneToOne 0.00 1.000 FORMAT "%5.3" EXTENDED_LIMITS 0.00 255.0 /end CHARACTERISTIC
/begin CHARACTERISTIC Drive_stClrData_BadEngStrt_C "Calibration to decide drive recorder action in case of non volatile memory error" VALUE 0x8053AC2D Val_Wu8 1.000 OneToOne 0.00 1.000 FORMAT "%5.3" EXTENDED_LIMITS 0.00 255.0 /end CHARACTERISTIC
/begin CHARACTERISTIC Drive_stClrData_C "Calibration to enable clearing of drive recorder data in case of memory error" VALUE 0x8053AC2E Val_Wu8 1.000 OneToOne 0.00 1.000 FORMAT "%5.3" EXTENDED_LIMITS 0.00 255.0 /end CHARACTERISTIC
/begin CHARACTERISTIC Drive_stClrData_EngStal_C "Calibration to decide drive recorder action in case of non volatile memory error" VALUE 0x8053AC2F Val_Wu8 1.000 OneToOne 0.00 1.000 FORMAT "%5.3" EXTENDED_LIMITS 0.00 255.0 /end CHARACTERISTIC
/begin CHARACTERISTIC DRIVE_swtForcedRecCond_C "Calibration to controll recording condition in DRIVE recorder" VALUE 0x8053AC30 Val_Wu8 255.0 OneToOne 0.00 255.0 FORMAT "%5.1" /end CHARACTERISTIC
/begin CHARACTERISTIC DRIVE_swtForcedTrg_C "Calibration to control trigger condition in DRIVE recorder" VALUE 0x8053AC31 Val_Wu8 255.0 OneToOne 0.00 255.0 FORMAT "%5.1" /end CHARACTERISTIC
/begin CHARACTERISTIC DRIVE_swtNPos_C "Switch position" VALUE 0x8053AC32 Val_Wu8 1.000 OneToOne 0.00 1.000 FORMAT "%5.3" EXTENDED_LIMITS 0.00 255.0 /end CHARACTERISTIC
/begin CHARACTERISTIC DRIVE_tiEngStal_C "Delay timer after engine running" VALUE 0x8053AC34 Val_Wu16 25500.00 Time_ms 0.00 25500.00 FORMAT "%8.2" EXTENDED_LIMITS 0.00 655350.0 /end CHARACTERISTIC
/begin CHARACTERISTIC DRIVE_tiEngStrtBad_CUR "Bad engine start timer duration" CURVE 0x8053AC36 Cur_Xs16Ws16 327670.0 Time_ms 0.00 327670.0 FORMAT "%8.1" EXTENDED_LIMITS -327680.0 327670.0
 /begin AXIS_DESCR STD_AXIS CEngDsT_t Temp_Cels 10 -3549.940 3003.560 FORMAT "%8.3" DEPOSIT ABSOLUTE /end AXIS_DESCR
/end CHARACTERISTIC
/begin CHARACTERISTIC DRIVE_vEngStal_C "Minimum Vehicle speed condition for Engine stall to occur" VALUE 0x8053AC60 Val_Ws16 655.3500 Vel -327.6800 327.6700 FORMAT "%8.4" /end CHARACTERISTIC
/begin CHARACTERISTIC DSCHED_AsgnCheck.FID_AFRA_C "assigned Check / Assigned Check for scheduled FId FID_AFRA" VALUE 0x804F90F2 Val_Wu16 703.000000000 DFC_Verb 0.00 703.000000000 FORMAT "%13.9" /end CHARACTERISTIC
/begin CHARACTERISTIC DSCHED_AsgnCheck.FID_AORA_C "assigned Check / Assigned Check for scheduled FId FID_AORA" VALUE 0x804F90F4 Val_Wu16 703.000000000 DFC_Verb 0.00 703.000000000 FORMAT "%13.9" /end CHARACTERISTIC
/begin CHARACTERISTIC DSCHED_AsgnCheck.FID_ATEH_C "assigned Check / Assigned Check for scheduled FId FID_ATEH" VALUE 0x804F90F6 Val_Wu16 703.000000000 DFC_Verb 0.00 703.000000000 FORMAT "%13.9" /end CHARACTERISTIC
/begin CHARACTERISTIC DSCHED_AsgnCheck.FID_ATEL_C "assigned Check / Assigned Check for scheduled FId FID_ATEL" VALUE 0x804F90F8 Val_Wu16 703.000000000 DFC_Verb 0.00 703.000000000 FORMAT "%13.9" /end CHARACTERISTIC
/begin CHARACTERISTIC DSCHED_AsgnCheck.FID_ATEN_C "assigned Check / Assigned Check for scheduled FId FID_ATEN" VALUE 0x804F90FA Val_Wu16 703.000000000 DFC_Verb 0.00 703.000000000 FORMAT "%13.9" /end CHARACTERISTIC
/begin CHARACTERISTIC DSCHED_AsgnCheck.FId_EGSDCmnSeg1B1Parl_C "assigned Check / Assigned Check for scheduled FId FId_EGSDCmnSeg1B1Parl" VALUE 0x804F90FC Val_Wu16 703.000000000 DFC_Verb 0.00 703.000000000 FORMAT "%13.9" /end CHARACTERISTIC
/begin CHARACTERISTIC DSCHED_AsgnCheck.FID_BLLRH_C "assigned Check / Assigned Check for scheduled FId FID_BLLRH" VALUE 0x804F90FE Val_Wu16 703.000000000 DFC_Verb 0.00 703.000000000 FORMAT "%13.9" /end CHARACTERISTIC
/begin CHARACTERISTIC DSCHED_AsgnCheck.FID_BLLRKH_C "assigned Check / Assigned Check for scheduled FId FID_BLLRKH" VALUE 0x804F9100 Val_Wu16 703.000000000 DFC_Verb 0.00 703.000000000 FORMAT "%13.9" /end CHARACTERISTIC
/begin CHARACTERISTIC DSCHED_AsgnCheck.FID_BPLSU_C "assigned Check / Assigned Check for scheduled FId FID_BPLSU" VALUE 0x804F9102 Val_Wu16 703.000000000 DFC_Verb 0.00 703.000000000 FORMAT "%13.9" /end CHARACTERISTIC
/begin CHARACTERISTIC DSCHED_AsgnCheck.FId_CJ135RvsChrgMeasS1B1_C "assigned Check / Assigned Check for scheduled FId FId_CJ135RvsChrgMeasS1B1" VALUE 0x804F9104 Val_Wu16 703.000000000 DFC_Verb 0.00 703.000000000 FORMAT "%13.9" /end CHARACTERISTIC
/begin CHARACTERISTIC DSCHED_AsgnCheck.FId_CatHeatgColdStrtReq_C "assigned Check / Assigned Check for scheduled FId FId_CatHeatgColdStrtReq" VALUE 0x804F9106 Val_Wu16 703.000000000 DFC_Verb 0.00 703.000000000 FORMAT "%13.9" /end CHARACTERISTIC
/begin CHARACTERISTIC DSCHED_AsgnCheck.FId_CatHeatgWrmReq_C "assigned Check / Assigned Check for scheduled FId FId_CatHeatgWrmReq" VALUE 0x804F9108 Val_Wu16 703.000000000 DFC_Verb 0.00 703.000000000 FORMAT "%13.9" /end CHARACTERISTIC
/begin CHARACTERISTIC DSCHED_AsgnCheck.FId_EGSDO2SnsrMntdRelsS1B1_C "assigned Check / Assigned Check for scheduled FId FId_EGSDO2SnsrMntdRelsS1B1" VALUE 0x804F910A Val_Wu16 703.000000000 DFC_Verb 0.00 703.000000000 FORMAT "%13.9" /end CHARACTERISTIC
/begin CHARACTERISTIC DSCHED_AsgnCheck.FId_EGSDO2_LamOffsFastS1B1_C "assigned Check / Assigned Check for scheduled FId FId_EGSDO2_LamOffsFastS1B1" VALUE 0x804F910C Val_Wu16 703.000000000 DFC_Verb 0.00 703.000000000 FORMAT "%13.9" /end CHARACTERISTIC
/begin CHARACTERISTIC DSCHED_AsgnCheck.FId_MisfDetDnAdpnNv_C "assigned Check / Assigned Check for scheduled FId FId_MisfDetDnAdpnNv" VALUE 0x804F910E Val_Wu16 703.000000000 DFC_Verb 0.00 703.000000000 FORMAT "%13.9" /end CHARACTERISTIC
/begin CHARACTERISTIC DSCHED_BsPrio.FID_AFRA_C "base priority / Base priority for scheduled FId FID_AFRA" VALUE 0x804F9110 Val_Wu16 8191.000 DFC_OneToOne 0.00 8191.000 FORMAT "%8.3" EXTENDED_LIMITS 0.00 65535.00 /end CHARACTERISTIC
/begin CHARACTERISTIC DSCHED_BsPrio.FID_AORA_C "base priority / Base priority for scheduled FId FID_AORA" VALUE 0x804F9112 Val_Wu16 8191.000 DFC_OneToOne 0.00 8191.000 FORMAT "%8.3" EXTENDED_LIMITS 0.00 65535.00 /end CHARACTERISTIC
/begin CHARACTERISTIC DSCHED_BsPrio.FID_ATEH_C "base priority / Base priority for scheduled FId FID_ATEH" VALUE 0x804F9114 Val_Wu16 8191.000 DFC_OneToOne 0.00 8191.000 FORMAT "%8.3" EXTENDED_LIMITS 0.00 65535.00 /end CHARACTERISTIC
/begin CHARACTERISTIC DSCHED_BsPrio.FID_ATEL_C "base priority / Base priority for scheduled FId FID_ATEL" VALUE 0x804F9116 Val_Wu16 8191.000 DFC_OneToOne 0.00 8191.000 FORMAT "%8.3" EXTENDED_LIMITS 0.00 65535.00 /end CHARACTERISTIC
/begin CHARACTERISTIC DSCHED_BsPrio.FID_ATEN_C "base priority / Base priority for scheduled FId FID_ATEN" VALUE 0x804F9118 Val_Wu16 8191.000 DFC_OneToOne 0.00 8191.000 FORMAT "%8.3" EXTENDED_LIMITS 0.00 65535.00 /end CHARACTERISTIC
/begin CHARACTERISTIC DSCHED_BsPrio.FId_EGSDCmnSeg1B1Parl_C "base priority / Base priority for scheduled FId FId_EGSDCmnSeg1B1Parl" VALUE 0x804F911A Val_Wu16 8191.000 DFC_OneToOne 0.00 8191.000 FORMAT "%8.3" EXTENDED_LIMITS 0.00 65535.00 /end CHARACTERISTIC
/begin CHARACTERISTIC DSCHED_BsPrio.FID_BLLRH_C "base priority / Base priority for scheduled FId FID_BLLRH" VALUE 0x804F911C Val_Wu16 8191.000 DFC_OneToOne 0.00 8191.000 FORMAT "%8.3" EXTENDED_LIMITS 0.00 65535.00 /end CHARACTERISTIC
/begin CHARACTERISTIC DSCHED_BsPrio.FID_BLLRKH_C "base priority / Base priority for scheduled FId FID_BLLRKH" VALUE 0x804F911E Val_Wu16 8191.000 DFC_OneToOne 0.00 8191.000 FORMAT "%8.3" EXTENDED_LIMITS 0.00 65535.00 /end CHARACTERISTIC
/begin CHARACTERISTIC DSCHED_BsPrio.FID_BPLSU_C "base priority / Base priority for scheduled FId FID_BPLSU" VALUE 0x804F9120 Val_Wu16 8191.000 DFC_OneToOne 0.00 8191.000 FORMAT "%8.3" EXTENDED_LIMITS 0.00 65535.00 /end CHARACTERISTIC
/begin CHARACTERISTIC DSCHED_BsPrio.FId_CJ135RvsChrgMeasS1B1_C "base priority / Base priority for scheduled FId FId_CJ135RvsChrgMeasS1B1" VALUE 0x804F9122 Val_Wu16 8191.000 DFC_OneToOne 0.00 8191.000 FORMAT "%8.3" EXTENDED_LIMITS 0.00 65535.00 /end CHARACTERISTIC
/begin CHARACTERISTIC DSCHED_BsPrio.FId_CatHeatgColdStrtReq_C "base priority / Base priority for scheduled FId FId_CatHeatgColdStrtReq" VALUE 0x804F9124 Val_Wu16 8191.000 DFC_OneToOne 0.00 8191.000 FORMAT "%8.3" EXTENDED_LIMITS 0.00 65535.00 /end CHARACTERISTIC
/begin CHARACTERISTIC DSCHED_BsPrio.FId_CatHeatgWrmReq_C "base priority / Base priority for scheduled FId FId_CatHeatgWrmReq" VALUE 0x804F9126 Val_Wu16 8191.000 DFC_OneToOne 0.00 8191.000 FORMAT "%8.3" EXTENDED_LIMITS 0.00 65535.00 /end CHARACTERISTIC
/begin CHARACTERISTIC DSCHED_BsPrio.FId_EGSDO2SnsrMntdRelsS1B1_C "base priority / Base priority for scheduled FId FId_EGSDO2SnsrMntdRelsS1B1" VALUE 0x804F9128 Val_Wu16 8191.000 DFC_OneToOne 0.00 8191.000 FORMAT "%8.3" EXTENDED_LIMITS 0.00 65535.00 /end CHARACTERISTIC
/begin CHARACTERISTIC DSCHED_BsPrio.FId_EGSDO2_LamOffsFastS1B1_C "base priority / Base priority for scheduled FId FId_EGSDO2_LamOffsFastS1B1" VALUE 0x804F912A Val_Wu16 8191.000 DFC_OneToOne 0.00 8191.000 FORMAT "%8.3" EXTENDED_LIMITS 0.00 65535.00 /end CHARACTERISTIC
/begin CHARACTERISTIC DSCHED_BsPrio.FId_MisfDetDnAdpnNv_C "base priority / Base priority for scheduled FId FId_MisfDetDnAdpnNv" VALUE 0x804F912C Val_Wu16 8191.000 DFC_OneToOne 0.00 8191.000 FORMAT "%8.3" EXTENDED_LIMITS 0.00 65535.00 /end CHARACTERISTIC
/begin CHARACTERISTIC DSCHED_FacPhys.FID_AFRA_C "weighting physical priority / Factor for physical Priority for scheduled FId FID_AFRA" VALUE 0x804F912E Val_Wu8 255.0 DFC_OneToOne 0.00 255.0 FORMAT "%5.1" /end CHARACTERISTIC
/begin CHARACTERISTIC DSCHED_FacPhys.FID_AORA_C "weighting physical priority / Factor for physical Priority for scheduled FId FID_AORA" VALUE 0x804F912F Val_Wu8 255.0 DFC_OneToOne 0.00 255.0 FORMAT "%5.1" /end CHARACTERISTIC
/begin CHARACTERISTIC DSCHED_FacPhys.FID_ATEH_C "weighting physical priority / Factor for physical Priority for scheduled FId FID_ATEH" VALUE 0x804F9130 Val_Wu8 255.0 DFC_OneToOne 0.00 255.0 FORMAT "%5.1" /end CHARACTERISTIC
/begin CHARACTERISTIC DSCHED_FacPhys.FID_ATEL_C "weighting physical priority / Factor for physical Priority for scheduled FId FID_ATEL" VALUE 0x804F9131 Val_Wu8 255.0 DFC_OneToOne 0.00 255.0 FORMAT "%5.1" /end CHARACTERISTIC
/begin CHARACTERISTIC DSCHED_FacPhys.FID_ATEN_C "weighting physical priority / Factor for physical Priority for scheduled FId FID_ATEN" VALUE 0x804F9132 Val_Wu8 255.0 DFC_OneToOne 0.00 255.0 FORMAT "%5.1" /end CHARACTERISTIC
/begin CHARACTERISTIC DSCHED_FacPhys.FId_EGSDCmnSeg1B1Parl_C "weighting physical priority / Factor for physical Priority for scheduled FId FId_EGSDCmnSeg1B1Parl" VALUE 0x804F9133 Val_Wu8 255.0 DFC_OneToOne 0.00 255.0 FORMAT "%5.1" /end CHARACTERISTIC
/begin CHARACTERISTIC DSCHED_FacPhys.FID_BLLRH_C "weighting physical priority / Factor for physical Priority for scheduled FId FID_BLLRH" VALUE 0x804F9134 Val_Wu8 255.0 DFC_OneToOne 0.00 255.0 FORMAT "%5.1" /end CHARACTERISTIC
/begin CHARACTERISTIC DSCHED_FacPhys.FID_BLLRKH_C "weighting physical priority / Factor for physical Priority for scheduled FId FID_BLLRKH" VALUE 0x804F9135 Val_Wu8 255.0 DFC_OneToOne 0.00 255.0 FORMAT "%5.1" /end CHARACTERISTIC
/begin CHARACTERISTIC DSCHED_FacPhys.FID_BPLSU_C "weighting physical priority / Factor for physical Priority for scheduled FId FID_BPLSU" VALUE 0x804F9136 Val_Wu8 255.0 DFC_OneToOne 0.00 255.0 FORMAT "%5.1" /end CHARACTERISTIC
/begin CHARACTERISTIC DSCHED_FacPhys.FId_CJ135RvsChrgMeasS1B1_C "weighting physical priority / Factor for physical Priority for scheduled FId FId_CJ135RvsChrgMeasS1B1" VALUE 0x804F9137 Val_Wu8 255.0 DFC_OneToOne 0.00 255.0 FORMAT "%5.1" /end CHARACTERISTIC
/begin CHARACTERISTIC DSCHED_FacPhys.FId_CatHeatgColdStrtReq_C "weighting physical priority / Factor for physical Priority for scheduled FId FId_CatHeatgColdStrtReq" VALUE 0x804F9138 Val_Wu8 255.0 DFC_OneToOne 0.00 255.0 FORMAT "%5.1" /end CHARACTERISTIC
/begin CHARACTERISTIC DSCHED_FacPhys.FId_CatHeatgWrmReq_C "weighting physical priority / Factor for physical Priority for scheduled FId FId_CatHeatgWrmReq" VALUE 0x804F9139 Val_Wu8 255.0 DFC_OneToOne 0.00 255.0 FORMAT "%5.1" /end CHARACTERISTIC
/begin CHARACTERISTIC DSCHED_FacPhys.FId_EGSDO2SnsrMntdRelsS1B1_C "weighting physical priority / Factor for physical Priority for scheduled FId FId_EGSDO2SnsrMntdRelsS1B1" VALUE 0x804F913A Val_Wu8 255.0 DFC_OneToOne 0.00 255.0 FORMAT "%5.1" /end CHARACTERISTIC
/begin CHARACTERISTIC DSCHED_FacPhys.FId_EGSDO2_LamOffsFastS1B1_C "weighting physical priority / Factor for physical Priority for scheduled FId FId_EGSDO2_LamOffsFastS1B1" VALUE 0x804F913B Val_Wu8 255.0 DFC_OneToOne 0.00 255.0 FORMAT "%5.1" /end CHARACTERISTIC
/begin CHARACTERISTIC DSCHED_FacPhys.FId_MisfDetDnAdpnNv_C "weighting physical priority / Factor for physical Priority for scheduled FId FId_MisfDetDnAdpnNv" VALUE 0x804F913C Val_Wu8 255.0 DFC_OneToOne 0.00 255.0 FORMAT "%5.1" /end CHARACTERISTIC
/begin CHARACTERISTIC DSCHED_idxWTTEnd_C "Last index of window time table which shall be processed" VALUE 0x804F913E Val_Wu8 9.000 DINH_OneToOne 0.00 9.000 FORMAT "%5.3" EXTENDED_LIMITS 0.00 255.0 /end CHARACTERISTIC
/begin CHARACTERISTIC DSCHED_idxWTTStrt_C "First index of window time table which shall be processed" VALUE 0x804F913F Val_Wu8 9.000 DINH_OneToOne 0.00 9.000 FORMAT "%5.3" EXTENDED_LIMITS 0.00 255.0 /end CHARACTERISTIC
/begin CHARACTERISTIC DSCHED_JmpActvPrio.FID_AFRA_C "priority bonus while active / Jump Active Priority for scheduled FId FID_AFRA" VALUE 0x804F9140 Val_Wu16 8191.000 DFC_OneToOne 0.00 8191.000 FORMAT "%8.3" EXTENDED_LIMITS 0.00 65535.00 /end CHARACTERISTIC
/begin CHARACTERISTIC DSCHED_JmpActvPrio.FID_AORA_C "priority bonus while active / Jump Active Priority for scheduled FId FID_AORA" VALUE 0x804F9142 Val_Wu16 8191.000 DFC_OneToOne 0.00 8191.000 FORMAT "%8.3" EXTENDED_LIMITS 0.00 65535.00 /end CHARACTERISTIC
/begin CHARACTERISTIC DSCHED_JmpActvPrio.FID_ATEH_C "priority bonus while active / Jump Active Priority for scheduled FId FID_ATEH" VALUE 0x804F9144 Val_Wu16 8191.000 DFC_OneToOne 0.00 8191.000 FORMAT "%8.3" EXTENDED_LIMITS 0.00 65535.00 /end CHARACTERISTIC
/begin CHARACTERISTIC DSCHED_JmpActvPrio.FID_ATEL_C "priority bonus while active / Jump Active Priority for scheduled FId FID_ATEL" VALUE 0x804F9146 Val_Wu16 8191.000 DFC_OneToOne 0.00 8191.000 FORMAT "%8.3" EXTENDED_LIMITS 0.00 65535.00 /end CHARACTERISTIC
/begin CHARACTERISTIC DSCHED_JmpActvPrio.FID_ATEN_C "priority bonus while active / Jump Active Priority for scheduled FId FID_ATEN" VALUE 0x804F9148 Val_Wu16 8191.000 DFC_OneToOne 0.00 8191.000 FORMAT "%8.3" EXTENDED_LIMITS 0.00 65535.00 /end CHARACTERISTIC
/begin CHARACTERISTIC DSCHED_JmpActvPrio.FId_EGSDCmnSeg1B1Parl_C "priority bonus while active / Jump Active Priority for scheduled FId FId_EGSDCmnSeg1B1Parl" VALUE 0x804F914A Val_Wu16 8191.000 DFC_OneToOne 0.00 8191.000 FORMAT "%8.3" EXTENDED_LIMITS 0.00 65535.00 /end CHARACTERISTIC
/begin CHARACTERISTIC DSCHED_JmpActvPrio.FID_BLLRH_C "priority bonus while active / Jump Active Priority for scheduled FId FID_BLLRH" VALUE 0x804F914C Val_Wu16 8191.000 DFC_OneToOne 0.00 8191.000 FORMAT "%8.3" EXTENDED_LIMITS 0.00 65535.00 /end CHARACTERISTIC
/begin CHARACTERISTIC DSCHED_JmpActvPrio.FID_BLLRKH_C "priority bonus while active / Jump Active Priority for scheduled FId FID_BLLRKH" VALUE 0x804F914E Val_Wu16 8191.000 DFC_OneToOne 0.00 8191.000 FORMAT "%8.3" EXTENDED_LIMITS 0.00 65535.00 /end CHARACTERISTIC
/begin CHARACTERISTIC DSCHED_JmpActvPrio.FID_BPLSU_C "priority bonus while active / Jump Active Priority for scheduled FId FID_BPLSU" VALUE 0x804F9150 Val_Wu16 8191.000 DFC_OneToOne 0.00 8191.000 FORMAT "%8.3" EXTENDED_LIMITS 0.00 65535.00 /end CHARACTERISTIC
/begin CHARACTERISTIC DSCHED_JmpActvPrio.FId_CJ135RvsChrgMeasS1B1_C "priority bonus while active / Jump Active Priority for scheduled FId FId_CJ135RvsChrgMeasS1B1" VALUE 0x804F9152 Val_Wu16 8191.000 DFC_OneToOne 0.00 8191.000 FORMAT "%8.3" EXTENDED_LIMITS 0.00 65535.00 /end CHARACTERISTIC
/begin CHARACTERISTIC DSCHED_JmpActvPrio.FId_CatHeatgColdStrtReq_C "priority bonus while active / Jump Active Priority for scheduled FId FId_CatHeatgColdStrtReq" VALUE 0x804F9154 Val_Wu16 8191.000 DFC_OneToOne 0.00 8191.000 FORMAT "%8.3" EXTENDED_LIMITS 0.00 65535.00 /end CHARACTERISTIC
/begin CHARACTERISTIC DSCHED_JmpActvPrio.FId_CatHeatgWrmReq_C "priority bonus while active / Jump Active Priority for scheduled FId FId_CatHeatgWrmReq" VALUE 0x804F9156 Val_Wu16 8191.000 DFC_OneToOne 0.00 8191.000 FORMAT "%8.3" EXTENDED_LIMITS 0.00 65535.00 /end CHARACTERISTIC
/begin CHARACTERISTIC DSCHED_JmpActvPrio.FId_EGSDO2SnsrMntdRelsS1B1_C "priority bonus while active / Jump Active Priority for scheduled FId FId_EGSDO2SnsrMntdRelsS1B1" VALUE 0x804F9158 Val_Wu16 8191.000 DFC_OneToOne 0.00 8191.000 FORMAT "%8.3" EXTENDED_LIMITS 0.00 65535.00 /end CHARACTERISTIC
/begin CHARACTERISTIC DSCHED_JmpActvPrio.FId_EGSDO2_LamOffsFastS1B1_C "priority bonus while active / Jump Active Priority for scheduled FId FId_EGSDO2_LamOffsFastS1B1" VALUE 0x804F915A Val_Wu16 8191.000 DFC_OneToOne 0.00 8191.000 FORMAT "%8.3" EXTENDED_LIMITS 0.00 65535.00 /end CHARACTERISTIC
/begin CHARACTERISTIC DSCHED_JmpActvPrio.FId_MisfDetDnAdpnNv_C "priority bonus while active / Jump Active Priority for scheduled FId FId_MisfDetDnAdpnNv" VALUE 0x804F915C Val_Wu16 8191.000 DFC_OneToOne 0.00 8191.000 FORMAT "%8.3" EXTENDED_LIMITS 0.00 65535.00 /end CHARACTERISTIC
/begin CHARACTERISTIC DSCHED_SetPointRateActv.FID_AFRA_C "set point active rate / Ramp active set point for scheduled FId FID_AFRA" VALUE 0x804F915E Val_Wu16 13107.00 DSCHED_Time200ms 0.00 13107.00 FORMAT "%8.2" /end CHARACTERISTIC
/begin CHARACTERISTIC DSCHED_SetPointRateActv.FID_AORA_C "set point active rate / Ramp active set point for scheduled FId FID_AORA" VALUE 0x804F9160 Val_Wu16 13107.00 DSCHED_Time200ms 0.00 13107.00 FORMAT "%8.2" /end CHARACTERISTIC
/begin CHARACTERISTIC DSCHED_SetPointRateActv.FID_ATEH_C "set point active rate / Ramp active set point for scheduled FId FID_ATEH" VALUE 0x804F9162 Val_Wu16 13107.00 DSCHED_Time200ms 0.00 13107.00 FORMAT "%8.2" /end CHARACTERISTIC
/begin CHARACTERISTIC DSCHED_SetPointRateActv.FID_ATEL_C "set point active rate / Ramp active set point for scheduled FId FID_ATEL" VALUE 0x804F9164 Val_Wu16 13107.00 DSCHED_Time200ms 0.00 13107.00 FORMAT "%8.2" /end CHARACTERISTIC
/begin CHARACTERISTIC DSCHED_SetPointRateActv.FID_ATEN_C "set point active rate / Ramp active set point for scheduled FId FID_ATEN" VALUE 0x804F9166 Val_Wu16 13107.00 DSCHED_Time200ms 0.00 13107.00 FORMAT "%8.2" /end CHARACTERISTIC
/begin CHARACTERISTIC DSCHED_SetPointRateActv.FId_EGSDCmnSeg1B1Parl_C "set point active rate / Ramp active set point for scheduled FId FId_EGSDCmnSeg1B1Parl" VALUE 0x804F9168 Val_Wu16 13107.00 DSCHED_Time200ms 0.00 13107.00 FORMAT "%8.2" /end CHARACTERISTIC
/begin CHARACTERISTIC DSCHED_SetPointRateActv.FID_BLLRH_C "set point active rate / Ramp active set point for scheduled FId FID_BLLRH" VALUE 0x804F916A Val_Wu16 13107.00 DSCHED_Time200ms 0.00 13107.00 FORMAT "%8.2" /end CHARACTERISTIC
/begin CHARACTERISTIC DSCHED_SetPointRateActv.FID_BLLRKH_C "set point active rate / Ramp active set point for scheduled FId FID_BLLRKH" VALUE 0x804F916C Val_Wu16 13107.00 DSCHED_Time200ms 0.00 13107.00 FORMAT "%8.2" /end CHARACTERISTIC
/begin CHARACTERISTIC DSCHED_SetPointRateActv.FID_BPLSU_C "set point active rate / Ramp active set point for scheduled FId FID_BPLSU" VALUE 0x804F916E Val_Wu16 13107.00 DSCHED_Time200ms 0.00 13107.00 FORMAT "%8.2" /end CHARACTERISTIC
/begin CHARACTERISTIC DSCHED_SetPointRateActv.FId_CJ135RvsChrgMeasS1B1_C "set point active rate / Ramp active set point for scheduled FId FId_CJ135RvsChrgMeasS1B1" VALUE 0x804F9170 Val_Wu16 13107.00 DSCHED_Time200ms 0.00 13107.00 FORMAT "%8.2" /end CHARACTERISTIC
/begin CHARACTERISTIC DSCHED_SetPointRateActv.FId_CatHeatgColdStrtReq_C "set point active rate / Ramp active set point for scheduled FId FId_CatHeatgColdStrtReq" VALUE 0x804F9172 Val_Wu16 13107.00 DSCHED_Time200ms 0.00 13107.00 FORMAT "%8.2" /end CHARACTERISTIC
/begin CHARACTERISTIC DSCHED_SetPointRateActv.FId_CatHeatgWrmReq_C "set point active rate / Ramp active set point for scheduled FId FId_CatHeatgWrmReq" VALUE 0x804F9174 Val_Wu16 13107.00 DSCHED_Time200ms 0.00 13107.00 FORMAT "%8.2" /end CHARACTERISTIC
/begin CHARACTERISTIC DSCHED_SetPointRateActv.FId_EGSDO2SnsrMntdRelsS1B1_C "set point active rate / Ramp active set point for scheduled FId FId_EGSDO2SnsrMntdRelsS1B1" VALUE 0x804F9176 Val_Wu16 13107.00 DSCHED_Time200ms 0.00 13107.00 FORMAT "%8.2" /end CHARACTERISTIC
/begin CHARACTERISTIC DSCHED_SetPointRateActv.FId_EGSDO2_LamOffsFastS1B1_C "set point active rate / Ramp active set point for scheduled FId FId_EGSDO2_LamOffsFastS1B1" VALUE 0x804F9178 Val_Wu16 13107.00 DSCHED_Time200ms 0.00 13107.00 FORMAT "%8.2" /end CHARACTERISTIC
/begin CHARACTERISTIC DSCHED_SetPointRateActv.FId_MisfDetDnAdpnNv_C "set point active rate / Ramp active set point for scheduled FId FId_MisfDetDnAdpnNv" VALUE 0x804F917A Val_Wu16 13107.00 DSCHED_Time200ms 0.00 13107.00 FORMAT "%8.2" /end CHARACTERISTIC
/begin CHARACTERISTIC DSCHED_SetPointRatePas.FID_AFRA_C "set point passive rate / Ramp passive set point for scheduled FId FID_AFRA" VALUE 0x804F917C Val_Wu16 13107.00 DSCHED_Time200ms 0.00 13107.00 FORMAT "%8.2" /end CHARACTERISTIC
/begin CHARACTERISTIC DSCHED_SetPointRatePas.FID_AORA_C "set point passive rate / Ramp passive set point for scheduled FId FID_AORA" VALUE 0x804F917E Val_Wu16 13107.00 DSCHED_Time200ms 0.00 13107.00 FORMAT "%8.2" /end CHARACTERISTIC
/begin CHARACTERISTIC DSCHED_SetPointRatePas.FID_ATEH_C "set point passive rate / Ramp passive set point for scheduled FId FID_ATEH" VALUE 0x804F9180 Val_Wu16 13107.00 DSCHED_Time200ms 0.00 13107.00 FORMAT "%8.2" /end CHARACTERISTIC
/begin CHARACTERISTIC DSCHED_SetPointRatePas.FID_ATEL_C "set point passive rate / Ramp passive set point for scheduled FId FID_ATEL" VALUE 0x804F9182 Val_Wu16 13107.00 DSCHED_Time200ms 0.00 13107.00 FORMAT "%8.2" /end CHARACTERISTIC
/begin CHARACTERISTIC DSCHED_SetPointRatePas.FID_ATEN_C "set point passive rate / Ramp passive set point for scheduled FId FID_ATEN" VALUE 0x804F9184 Val_Wu16 13107.00 DSCHED_Time200ms 0.00 13107.00 FORMAT "%8.2" /end CHARACTERISTIC
/begin CHARACTERISTIC DSCHED_SetPointRatePas.FId_EGSDCmnSeg1B1Parl_C "set point passive rate / Ramp passive set point for scheduled FId FId_EGSDCmnSeg1B1Parl" VALUE 0x804F9186 Val_Wu16 13107.00 DSCHED_Time200ms 0.00 13107.00 FORMAT "%8.2" /end CHARACTERISTIC
/begin CHARACTERISTIC DSCHED_SetPointRatePas.FID_BLLRH_C "set point passive rate / Ramp passive set point for scheduled FId FID_BLLRH" VALUE 0x804F9188 Val_Wu16 13107.00 DSCHED_Time200ms 0.00 13107.00 FORMAT "%8.2" /end CHARACTERISTIC
/begin CHARACTERISTIC DSCHED_SetPointRatePas.FID_BLLRKH_C "set point passive rate / Ramp passive set point for scheduled FId FID_BLLRKH" VALUE 0x804F918A Val_Wu16 13107.00 DSCHED_Time200ms 0.00 13107.00 FORMAT "%8.2" /end CHARACTERISTIC
/begin CHARACTERISTIC DSCHED_SetPointRatePas.FID_BPLSU_C "set point passive rate / Ramp passive set point for scheduled FId FID_BPLSU" VALUE 0x804F918C Val_Wu16 13107.00 DSCHED_Time200ms 0.00 13107.00 FORMAT "%8.2" /end CHARACTERISTIC
/begin CHARACTERISTIC DSCHED_SetPointRatePas.FId_CJ135RvsChrgMeasS1B1_C "set point passive rate / Ramp passive set point for scheduled FId FId_CJ135RvsChrgMeasS1B1" VALUE 0x804F918E Val_Wu16 13107.00 DSCHED_Time200ms 0.00 13107.00 FORMAT "%8.2" /end CHARACTERISTIC
/begin CHARACTERISTIC DSCHED_SetPointRatePas.FId_CatHeatgColdStrtReq_C "set point passive rate / Ramp passive set point for scheduled FId FId_CatHeatgColdStrtReq" VALUE 0x804F9190 Val_Wu16 13107.00 DSCHED_Time200ms 0.00 13107.00 FORMAT "%8.2" /end CHARACTERISTIC
/begin CHARACTERISTIC DSCHED_SetPointRatePas.FId_CatHeatgWrmReq_C "set point passive rate / Ramp passive set point for scheduled FId FId_CatHeatgWrmReq" VALUE 0x804F9192 Val_Wu16 13107.00 DSCHED_Time200ms 0.00 13107.00 FORMAT "%8.2" /end CHARACTERISTIC
/begin CHARACTERISTIC DSCHED_SetPointRatePas.FId_EGSDO2SnsrMntdRelsS1B1_C "set point passive rate / Ramp passive set point for scheduled FId FId_EGSDO2SnsrMntdRelsS1B1" VALUE 0x804F9194 Val_Wu16 13107.00 DSCHED_Time200ms 0.00 13107.00 FORMAT "%8.2" /end CHARACTERISTIC
/begin CHARACTERISTIC DSCHED_SetPointRatePas.FId_EGSDO2_LamOffsFastS1B1_C "set point passive rate / Ramp passive set point for scheduled FId FId_EGSDO2_LamOffsFastS1B1" VALUE 0x804F9196 Val_Wu16 13107.00 DSCHED_Time200ms 0.00 13107.00 FORMAT "%8.2" /end CHARACTERISTIC
/begin CHARACTERISTIC DSCHED_SetPointRatePas.FId_MisfDetDnAdpnNv_C "set point passive rate / Ramp passive set point for scheduled FId FId_MisfDetDnAdpnNv" VALUE 0x804F9198 Val_Wu16 13107.00 DSCHED_Time200ms 0.00 13107.00 FORMAT "%8.2" /end CHARACTERISTIC
/begin CHARACTERISTIC DSCHED_tiWTT_CA "Time values for window time table events. Array must contain the values in chronological order!" VAL_BLK 0x804F919A ValA_Wu16 6553.500 DSCHED_Time100ms 0.00 6553.500 FORMAT "%8.3" NUMBER 10 /end CHARACTERISTIC
/begin CHARACTERISTIC DSCHED_UpLimRateLow.FID_AFRA_C "upper priority limit (if rate is not satisfied) / Upper limit if rate is low for scheduled FId FID_AFRA" VALUE 0x804F91AE Val_Wu16 8191.000 DFC_OneToOne 0.00 8191.000 FORMAT "%8.3" EXTENDED_LIMITS 0.00 65535.00 /end CHARACTERISTIC
/begin CHARACTERISTIC DSCHED_UpLimRateLow.FID_AORA_C "upper priority limit (if rate is not satisfied) / Upper limit if rate is low for scheduled FId FID_AORA" VALUE 0x804F91B0 Val_Wu16 8191.000 DFC_OneToOne 0.00 8191.000 FORMAT "%8.3" EXTENDED_LIMITS 0.00 65535.00 /end CHARACTERISTIC
/begin CHARACTERISTIC DSCHED_UpLimRateLow.FID_ATEH_C "upper priority limit (if rate is not satisfied) / Upper limit if rate is low for scheduled FId FID_ATEH" VALUE 0x804F91B2 Val_Wu16 8191.000 DFC_OneToOne 0.00 8191.000 FORMAT "%8.3" EXTENDED_LIMITS 0.00 65535.00 /end CHARACTERISTIC
/begin CHARACTERISTIC DSCHED_UpLimRateLow.FID_ATEL_C "upper priority limit (if rate is not satisfied) / Upper limit if rate is low for scheduled FId FID_ATEL" VALUE 0x804F91B4 Val_Wu16 8191.000 DFC_OneToOne 0.00 8191.000 FORMAT "%8.3" EXTENDED_LIMITS 0.00 65535.00 /end CHARACTERISTIC
/begin CHARACTERISTIC DSCHED_UpLimRateLow.FID_ATEN_C "upper priority limit (if rate is not satisfied) / Upper limit if rate is low for scheduled FId FID_ATEN" VALUE 0x804F91B6 Val_Wu16 8191.000 DFC_OneToOne 0.00 8191.000 FORMAT "%8.3" EXTENDED_LIMITS 0.00 65535.00 /end CHARACTERISTIC
/begin CHARACTERISTIC DSCHED_UpLimRateLow.FId_EGSDCmnSeg1B1Parl_C "upper priority limit (if rate is not satisfied) / Upper limit if rate is low for scheduled FId FId_EGSDCmnSeg1B1Parl" VALUE 0x804F91B8 Val_Wu16 8191.000 DFC_OneToOne 0.00 8191.000 FORMAT "%8.3" EXTENDED_LIMITS 0.00 65535.00 /end CHARACTERISTIC
/begin CHARACTERISTIC DSCHED_UpLimRateLow.FID_BLLRH_C "upper priority limit (if rate is not satisfied) / Upper limit if rate is low for scheduled FId FID_BLLRH" VALUE 0x804F91BA Val_Wu16 8191.000 DFC_OneToOne 0.00 8191.000 FORMAT "%8.3" EXTENDED_LIMITS 0.00 65535.00 /end CHARACTERISTIC
/begin CHARACTERISTIC DSCHED_UpLimRateLow.FID_BLLRKH_C "upper priority limit (if rate is not satisfied) / Upper limit if rate is low for scheduled FId FID_BLLRKH" VALUE 0x804F91BC Val_Wu16 8191.000 DFC_OneToOne 0.00 8191.000 FORMAT "%8.3" EXTENDED_LIMITS 0.00 65535.00 /end CHARACTERISTIC
/begin CHARACTERISTIC DSCHED_UpLimRateLow.FID_BPLSU_C "upper priority limit (if rate is not satisfied) / Upper limit if rate is low for scheduled FId FID_BPLSU" VALUE 0x804F91BE Val_Wu16 8191.000 DFC_OneToOne 0.00 8191.000 FORMAT "%8.3" EXTENDED_LIMITS 0.00 65535.00 /end CHARACTERISTIC
/begin CHARACTERISTIC DSCHED_UpLimRateLow.FId_CJ135RvsChrgMeasS1B1_C "upper priority limit (if rate is not satisfied) / Upper limit if rate is low for scheduled FId FId_CJ135RvsChrgMeasS1B1" VALUE 0x804F91C0 Val_Wu16 8191.000 DFC_OneToOne 0.00 8191.000 FORMAT "%8.3" EXTENDED_LIMITS 0.00 65535.00 /end CHARACTERISTIC
/begin CHARACTERISTIC DSCHED_UpLimRateLow.FId_CatHeatgColdStrtReq_C "upper priority limit (if rate is not satisfied) / Upper limit if rate is low for scheduled FId FId_CatHeatgColdStrtReq" VALUE 0x804F91C2 Val_Wu16 8191.000 DFC_OneToOne 0.00 8191.000 FORMAT "%8.3" EXTENDED_LIMITS 0.00 65535.00 /end CHARACTERISTIC
/begin CHARACTERISTIC DSCHED_UpLimRateLow.FId_CatHeatgWrmReq_C "upper priority limit (if rate is not satisfied) / Upper limit if rate is low for scheduled FId FId_CatHeatgWrmReq" VALUE 0x804F91C4 Val_Wu16 8191.000 DFC_OneToOne 0.00 8191.000 FORMAT "%8.3" EXTENDED_LIMITS 0.00 65535.00 /end CHARACTERISTIC
/begin CHARACTERISTIC DSCHED_UpLimRateLow.FId_EGSDO2SnsrMntdRelsS1B1_C "upper priority limit (if rate is not satisfied) / Upper limit if rate is low for scheduled FId FId_EGSDO2SnsrMntdRelsS1B1" VALUE 0x804F91C6 Val_Wu16 8191.000 DFC_OneToOne 0.00 8191.000 FORMAT "%8.3" EXTENDED_LIMITS 0.00 65535.00 /end CHARACTERISTIC
/begin CHARACTERISTIC DSCHED_UpLimRateLow.FId_EGSDO2_LamOffsFastS1B1_C "upper priority limit (if rate is not satisfied) / Upper limit if rate is low for scheduled FId FId_EGSDO2_LamOffsFastS1B1" VALUE 0x804F91C8 Val_Wu16 8191.000 DFC_OneToOne 0.00 8191.000 FORMAT "%8.3" EXTENDED_LIMITS 0.00 65535.00 /end CHARACTERISTIC
/begin CHARACTERISTIC DSCHED_UpLimRateLow.FId_MisfDetDnAdpnNv_C "upper priority limit (if rate is not satisfied) / Upper limit if rate is low for scheduled FId FId_MisfDetDnAdpnNv" VALUE 0x804F91CA Val_Wu16 8191.000 DFC_OneToOne 0.00 8191.000 FORMAT "%8.3" EXTENDED_LIMITS 0.00 65535.00 /end CHARACTERISTIC
/begin CHARACTERISTIC DSCHED_UpLimRateOk.FID_AFRA_C "upper priority limit (if rate is satisfied) / Upper limit if rate is ok for scheduled FId FID_AFRA" VALUE 0x804F91CC Val_Wu16 8191.000 DFC_OneToOne 0.00 8191.000 FORMAT "%8.3" EXTENDED_LIMITS 0.00 65535.00 /end CHARACTERISTIC
/begin CHARACTERISTIC DSCHED_UpLimRateOk.FID_AORA_C "upper priority limit (if rate is satisfied) / Upper limit if rate is ok for scheduled FId FID_AORA" VALUE 0x804F91CE Val_Wu16 8191.000 DFC_OneToOne 0.00 8191.000 FORMAT "%8.3" EXTENDED_LIMITS 0.00 65535.00 /end CHARACTERISTIC
/begin CHARACTERISTIC DSCHED_UpLimRateOk.FID_ATEH_C "upper priority limit (if rate is satisfied) / Upper limit if rate is ok for scheduled FId FID_ATEH" VALUE 0x804F91D0 Val_Wu16 8191.000 DFC_OneToOne 0.00 8191.000 FORMAT "%8.3" EXTENDED_LIMITS 0.00 65535.00 /end CHARACTERISTIC
/begin CHARACTERISTIC DSCHED_UpLimRateOk.FID_ATEL_C "upper priority limit (if rate is satisfied) / Upper limit if rate is ok for scheduled FId FID_ATEL" VALUE 0x804F91D2 Val_Wu16 8191.000 DFC_OneToOne 0.00 8191.000 FORMAT "%8.3" EXTENDED_LIMITS 0.00 65535.00 /end CHARACTERISTIC
/begin CHARACTERISTIC DSCHED_UpLimRateOk.FID_ATEN_C "upper priority limit (if rate is satisfied) / Upper limit if rate is ok for scheduled FId FID_ATEN" VALUE 0x804F91D4 Val_Wu16 8191.000 DFC_OneToOne 0.00 8191.000 FORMAT "%8.3" EXTENDED_LIMITS 0.00 65535.00 /end CHARACTERISTIC
/begin CHARACTERISTIC DSCHED_UpLimRateOk.FId_EGSDCmnSeg1B1Parl_C "upper priority limit (if rate is satisfied) / Upper limit if rate is ok for scheduled FId FId_EGSDCmnSeg1B1Parl" VALUE 0x804F91D6 Val_Wu16 8191.000 DFC_OneToOne 0.00 8191.000 FORMAT "%8.3" EXTENDED_LIMITS 0.00 65535.00 /end CHARACTERISTIC
/begin CHARACTERISTIC DSCHED_UpLimRateOk.FID_BLLRH_C "upper priority limit (if rate is satisfied) / Upper limit if rate is ok for scheduled FId FID_BLLRH" VALUE 0x804F91D8 Val_Wu16 8191.000 DFC_OneToOne 0.00 8191.000 FORMAT "%8.3" EXTENDED_LIMITS 0.00 65535.00 /end CHARACTERISTIC
/begin CHARACTERISTIC DSCHED_UpLimRateOk.FID_BLLRKH_C "upper priority limit (if rate is satisfied) / Upper limit if rate is ok for scheduled FId FID_BLLRKH" VALUE 0x804F91DA Val_Wu16 8191.000 DFC_OneToOne 0.00 8191.000 FORMAT "%8.3" EXTENDED_LIMITS 0.00 65535.00 /end CHARACTERISTIC
/begin CHARACTERISTIC DSCHED_UpLimRateOk.FID_BPLSU_C "upper priority limit (if rate is satisfied) / Upper limit if rate is ok for scheduled FId FID_BPLSU" VALUE 0x804F91DC Val_Wu16 8191.000 DFC_OneToOne 0.00 8191.000 FORMAT "%8.3" EXTENDED_LIMITS 0.00 65535.00 /end CHARACTERISTIC
/begin CHARACTERISTIC DSCHED_UpLimRateOk.FId_CJ135RvsChrgMeasS1B1_C "upper priority limit (if rate is satisfied) / Upper limit if rate is ok for scheduled FId FId_CJ135RvsChrgMeasS1B1" VALUE 0x804F91DE Val_Wu16 8191.000 DFC_OneToOne 0.00 8191.000 FORMAT "%8.3" EXTENDED_LIMITS 0.00 65535.00 /end CHARACTERISTIC
/begin CHARACTERISTIC DSCHED_UpLimRateOk.FId_CatHeatgColdStrtReq_C "upper priority limit (if rate is satisfied) / Upper limit if rate is ok for scheduled FId FId_CatHeatgColdStrtReq" VALUE 0x804F91E0 Val_Wu16 8191.000 DFC_OneToOne 0.00 8191.000 FORMAT "%8.3" EXTENDED_LIMITS 0.00 65535.00 /end CHARACTERISTIC
/begin CHARACTERISTIC DSCHED_UpLimRateOk.FId_CatHeatgWrmReq_C "upper priority limit (if rate is satisfied) / Upper limit if rate is ok for scheduled FId FId_CatHeatgWrmReq" VALUE 0x804F91E2 Val_Wu16 8191.000 DFC_OneToOne 0.00 8191.000 FORMAT "%8.3" EXTENDED_LIMITS 0.00 65535.00 /end CHARACTERISTIC
/begin CHARACTERISTIC DSCHED_UpLimRateOk.FId_EGSDO2SnsrMntdRelsS1B1_C "upper priority limit (if rate is satisfied) / Upper limit if rate is ok for scheduled FId FId_EGSDO2SnsrMntdRelsS1B1" VALUE 0x804F91E4 Val_Wu16 8191.000 DFC_OneToOne 0.00 8191.000 FORMAT "%8.3" EXTENDED_LIMITS 0.00 65535.00 /end CHARACTERISTIC
/begin CHARACTERISTIC DSCHED_UpLimRateOk.FId_EGSDO2_LamOffsFastS1B1_C "upper priority limit (if rate is satisfied) / Upper limit if rate is ok for scheduled FId FId_EGSDO2_LamOffsFastS1B1" VALUE 0x804F91E6 Val_Wu16 8191.000 DFC_OneToOne 0.00 8191.000 FORMAT "%8.3" EXTENDED_LIMITS 0.00 65535.00 /end CHARACTERISTIC
/begin CHARACTERISTIC DSCHED_UpLimRateOk.FId_MisfDetDnAdpnNv_C "upper priority limit (if rate is satisfied) / Upper limit if rate is ok for scheduled FId FId_MisfDetDnAdpnNv" VALUE 0x804F91E8 Val_Wu16 8191.000 DFC_OneToOne 0.00 8191.000 FORMAT "%8.3" EXTENDED_LIMITS 0.00 65535.00 /end CHARACTERISTIC
/begin CHARACTERISTIC DSCHED_valOfsPrioOpMode_C "Jump Priority Operation Mode (additional priority if operation mode is compatible to possible operation modes)" VALUE 0x804F91EA Val_Wu16 8191.000 DINH_OneToOne 0.00 8191.000 FORMAT "%8.3" EXTENDED_LIMITS 0.00 65535.00 /end CHARACTERISTIC
/begin CHARACTERISTIC DSCHED_valOfsPrioTst_C "Increase Priority on not tested (additional priority if tested flag is not set)" VALUE 0x804F91EC Val_Wu16 8191.000 DINH_OneToOne 0.00 8191.000 FORMAT "%8.3" EXTENDED_LIMITS 0.00 65535.00 /end CHARACTERISTIC
/begin CHARACTERISTIC DSCHED_xFctTstFId_CA "List of FIds which are raised in priority under tester control" VAL_BLK 0x804F91EE ValA_Wu8 15.0000000000 DSCHED_FIdVerb 0.00 15.0000000000 FORMAT "%13.10" NUMBER 8 /end CHARACTERISTIC
/begin CHARACTERISTIC DSCHED_xWTTFId_CA "Assigned FId and activation mode for window time table events (per DSCHED_tiWTT_CA entry)" VAL_BLK 0x804F91F6 ValA_Wu16 32783.0000000 DSCHED_FIdWTTVerb 0.00 32783.0000000 FORMAT "%13.7" NUMBER 10 /end CHARACTERISTIC
/begin CHARACTERISTIC THP "delay time failure heiling powerstage diagnosis" VALUE 0x8053A4C5 KwUb 25.00 t_q0p1 0.50 25.50 FORMAT "%5.2" EXTENDED_LIMITS 0.00 25.50 /end CHARACTERISTIC
/begin CHARACTERISTIC TVP "delay time failure verification powerstage diagnosis ME(D) 9" VALUE 0x8053A4C6 KwUb 25.00 t_q0p1 0.50 25.50 FORMAT "%5.2" EXTENDED_LIMITS 0.00 25.50 /end CHARACTERISTIC
/begin MEASUREMENT dps_error "last read Pmd_GetErr() content of state OBSERVING" UWORD dez 1 100 0.00 65535.00 FORMAT "%8.2" ECU_ADDRESS 0x60000890 /end MEASUREMENT
/begin MEASUREMENT dps_errStat "read Pmd_GetErr() content in state VERIFY or RECOVERY; this content is compared to dps_error" UWORD dez 1 100 0.00 65535.00 FORMAT "%8.2" ECU_ADDRESS 0x6000088A /end MEASUREMENT
/begin MEASUREMENT dps_errStat_sum_rec "contains dps_errStat read during RECOVERY state" UWORD dez 1 100 0.00 65535.00 FORMAT "%8.2" ECU_ADDRESS 0x6000088C /end MEASUREMENT
/begin MEASUREMENT dps_errStat_sum_ver "contains dps_errStat read during VERIFY state" UWORD dez 1 100 0.00 65535.00 FORMAT "%8.2" ECU_ADDRESS 0x6000088E /end MEASUREMENT
/begin MEASUREMENT dps_index "Indicates which powerstage is being observed" UBYTE dez 1 100 0.00 255.0 FORMAT "%5.1" ECU_ADDRESS 0x60000896 /end MEASUREMENT
/begin MEASUREMENT dps_recoveryTime "Timer Recovery" UBYTE t_q0p1 1 100 0.00 25.50 FORMAT "%5.2" ECU_ADDRESS 0x60000897 /end MEASUREMENT
/begin MEASUREMENT dps_state "Index Statemachine" UBYTE dez 1 100 0.00 255.0 FORMAT "%5.1" ECU_ADDRESS 0x60000898 /end MEASUREMENT
/begin MEASUREMENT dps_verifyTime "Timer Verify" UBYTE t_q0p1 1 100 0.00 25.50 FORMAT "%5.2" ECU_ADDRESS 0x60000899 /end MEASUREMENT
/begin MEASUREMENT DRIVE_AobsFrqTmr "Frequency timer for arbitrary OBS judgement method" SLONG Time_s 1 100 -21474836.4800 21474836.4700 FORMAT "%13.4" ARRAY_SIZE 20 ECU_ADDRESS 0x6000181C /end MEASUREMENT
/begin MEASUREMENT DRIVE_AobsTmrCnt "Display value for judgement methods" SLONG OneToOne 1 100 -2147483648.00 2147483647.00 FORMAT "%13.2" ARRAY_SIZE 20 ECU_ADDRESS 0x600017CC /end MEASUREMENT
/begin MEASUREMENT DRIVE_AOBS_Mode "Mode of Arbitrary OBS" UBYTE DRIVE_AOBS_MODE 1 100 0.00 1.00000000000 FORMAT "%13.11" ECU_ADDRESS 0x60037E61 /end MEASUREMENT
/begin MEASUREMENT DRIVE_AOBS_stPrmSet "Setting status of Arbitrary OBS parameters" UBYTE DRIVE_AOBS_stSet 1 100 0.00 1.00000000000 FORMAT "%13.11" ECU_ADDRESS 0x60037E60 /end MEASUREMENT
/begin MEASUREMENT Drive_DSMFaults "Copy of DFC no. of DFES entries." UWORD OneToOne 1 100 0.00 65535.00 FORMAT "%8.2" ARRAY_SIZE 20 ECU_ADDRESS 0x60037E38 /end MEASUREMENT
/begin MEASUREMENT DRIVE_FirstLayerResult "Status of First Layer expression result of Arbitrary OBS" UBYTE OneToOne 1 100 0.00 255.0 FORMAT "%5.1" ECU_ADDRESS 0x60009B47 /end MEASUREMENT
/begin MEASUREMENT Drive_idxDFC "DFC number of the OBD OBS frozen fault" ULONG OneToOne 1 100 0.00 4294967295.00 FORMAT "%13.2" ECU_ADDRESS 0x60037E34 /end MEASUREMENT
/begin MEASUREMENT DRIVE_numAOBSDCTIDLst_defined "DCTID List for service B8" UWORD OneToOne 1 100 0.00 65535.00 FORMAT "%8.2" ARRAY_SIZE 2 ECU_ADDRESS 0x60037E30 /end MEASUREMENT
/begin MEASUREMENT DRIVE_numAOBSDCTIDLst_record "DCTID List for service B9" UWORD OneToOne 1 100 0.00 65535.00 FORMAT "%8.2" ARRAY_SIZE 2 ECU_ADDRESS 0x60037E2C /end MEASUREMENT
/begin MEASUREMENT DRIVE_numDTCFrz "DTC number for the corresponding DFC which caused the trigger" UWORD OneToOne 1 100 0.00 65535.00 FORMAT "%8.2" ECU_ADDRESS 0x60037F84 /end MEASUREMENT
/begin MEASUREMENT Drive_numPCode "Array of PCode data for confirmed DTC faults" UWORD OneToOne 1 100 0.00 65535.00 FORMAT "%8.2" ARRAY_SIZE 20 ECU_ADDRESS 0x60037E04 /end MEASUREMENT
/begin MEASUREMENT DRIVE_PRDS_Bnk0Blk00_idx_NV "non volatile index storage for DRIVE recorder blocks" UWORD OneToOne 1 100 0.00 65535.00 FORMAT "%8.2" ARRAY_SIZE 2 ECU_ADDRESS 0x60037E00 /end MEASUREMENT
/begin MEASUREMENT DRIVE_PRDS_Bnk0Blk00_Rcrd_NV "DRIVE recorder non volatile record buffer" UBYTE OneToOne 1 100 0.00 255.0 FORMAT "%5.1" ARRAY_SIZE 600 ECU_ADDRESS 0x5001523C /end MEASUREMENT
/begin MEASUREMENT DRIVE_PRDS_Bnk0Blk01_idx_NV "non volatile index storage for DRIVE recorder blocks" UWORD OneToOne 1 100 0.00 65535.00 FORMAT "%8.2" ARRAY_SIZE 2 ECU_ADDRESS 0x60037DFC /end MEASUREMENT
/begin MEASUREMENT DRIVE_PRDS_Bnk0Blk01_Rcrd_NV "DRIVE recorder non volatile record buffer" UBYTE OneToOne 1 100 0.00 255.0 FORMAT "%5.1" ARRAY_SIZE 2625 ECU_ADDRESS 0x500147FB /end MEASUREMENT
/begin MEASUREMENT DRIVE_PRDS_Bnk0Blk02_idx_NV "non volatile index storage for DRIVE recorder blocks" UWORD OneToOne 1 100 0.00 65535.00 FORMAT "%8.2" ARRAY_SIZE 2 ECU_ADDRESS 0x60037DF8 /end MEASUREMENT
/begin MEASUREMENT DRIVE_PRDS_Bnk0Blk02_Rcrd_NV "DRIVE recorder non volatile record buffer" UBYTE OneToOne 1 100 0.00 255.0 FORMAT "%5.1" ARRAY_SIZE 675 ECU_ADDRESS 0x50014558 /end MEASUREMENT
/begin MEASUREMENT DRIVE_PRDS_Bnk0Blk04_idx_NV "non volatile index storage for DRIVE recorder blocks" UWORD OneToOne 1 100 0.00 65535.00 FORMAT "%8.2" ARRAY_SIZE 2 ECU_ADDRESS 0x60037DF4 /end MEASUREMENT
/begin MEASUREMENT DRIVE_PRDS_Bnk0Blk04_Rcrd_NV "DRIVE recorder non volatile record buffer" UBYTE OneToOne 1 100 0.00 255.0 FORMAT "%5.1" ARRAY_SIZE 750 ECU_ADDRESS 0x5001426A /end MEASUREMENT
/begin MEASUREMENT DRIVE_PRDS_Bnk0Blk05_idx_NV "non volatile index storage for DRIVE recorder blocks" UWORD OneToOne 1 100 0.00 65535.00 FORMAT "%8.2" ARRAY_SIZE 2 ECU_ADDRESS 0x60037DF0 /end MEASUREMENT
/begin MEASUREMENT DRIVE_PRDS_Bnk0Blk05_Rcrd_NV "DRIVE recorder non volatile record buffer" UBYTE OneToOne 1 100 0.00 255.0 FORMAT "%5.1" ARRAY_SIZE 150 ECU_ADDRESS 0x500141D4 /end MEASUREMENT
/begin MEASUREMENT DRIVE_PRDS_Bnk0Blk06_idx_NV "non volatile index storage for DRIVE recorder blocks" UWORD OneToOne 1 100 0.00 65535.00 FORMAT "%8.2" ARRAY_SIZE 2 ECU_ADDRESS 0x60037DEC /end MEASUREMENT
/begin MEASUREMENT DRIVE_PRDS_Bnk0Blk06_Rcrd_NV "DRIVE recorder non volatile record buffer" UBYTE OneToOne 1 100 0.00 255.0 FORMAT "%5.1" ARRAY_SIZE 615 ECU_ADDRESS 0x50013F6D /end MEASUREMENT
/begin MEASUREMENT DRIVE_PRDS_Bnk0Blk07_idx_NV "non volatile index storage for DRIVE recorder blocks" UWORD OneToOne 1 100 0.00 65535.00 FORMAT "%8.2" ARRAY_SIZE 2 ECU_ADDRESS 0x60037DE8 /end MEASUREMENT
/begin MEASUREMENT DRIVE_PRDS_Bnk0Blk07_Rcrd_NV "non volatile recording buffer for DRIVE blocks" UBYTE OneToOne 1 100 0.00 255.0 FORMAT "%5.1" ARRAY_SIZE 180 ECU_ADDRESS 0x50013EB9 /end MEASUREMENT
/begin MEASUREMENT DRIVE_PRDS_Bnk0Blk09_idx_NV "non volatile index storage for DRIVE recorder blocks" UWORD OneToOne 1 100 0.00 65535.00 FORMAT "%8.2" ARRAY_SIZE 2 ECU_ADDRESS 0x60037DE4 /end MEASUREMENT
/begin MEASUREMENT DRIVE_PRDS_Bnk0Blk09_Rcrd_NV "non volatile recording buffer for DRIVE blocks" UBYTE OneToOne 1 100 0.00 255.0 FORMAT "%5.1" ARRAY_SIZE 165 ECU_ADDRESS 0x50013E14 /end MEASUREMENT
/begin MEASUREMENT DRIVE_PRDS_Bnk0Blk0a_idx_NV "non volatile index storage for DRIVE recorder blocks" UWORD OneToOne 1 100 0.00 65535.00 FORMAT "%8.2" ARRAY_SIZE 2 ECU_ADDRESS 0x60037DE0 /end MEASUREMENT
/begin MEASUREMENT DRIVE_PRDS_Bnk0Blk0a_Rcrd_NV "DRIVE recorder non volatile record buffer" UBYTE OneToOne 1 100 0.00 255.0 FORMAT "%5.1" ARRAY_SIZE 720 ECU_ADDRESS 0x50013B44 /end MEASUREMENT
/begin MEASUREMENT DRIVE_PRDS_Bnk0Blk0b_idx_NV "non volatile index storage for DRIVE recorder blocks" UWORD OneToOne 1 100 0.00 65535.00 FORMAT "%8.2" ARRAY_SIZE 2 ECU_ADDRESS 0x60037DDC /end MEASUREMENT
/begin MEASUREMENT DRIVE_PRDS_Bnk0Blk0b_Rcrd_NV "DRIVE recorder non volatile record buffer" UBYTE OneToOne 1 100 0.00 255.0 FORMAT "%5.1" ARRAY_SIZE 720 ECU_ADDRESS 0x50013874 /end MEASUREMENT
/begin MEASUREMENT DRIVE_PRDS_Bnk0Blk0c_idx_NV "non volatile index storage for DRIVE recorder blocks" UWORD OneToOne 1 100 0.00 65535.00 FORMAT "%8.2" ARRAY_SIZE 2 ECU_ADDRESS 0x60037DD8 /end MEASUREMENT
/begin MEASUREMENT DRIVE_PRDS_Bnk0Blk0c_Rcrd_NV "DRIVE recorder non volatile record buffer" UBYTE OneToOne 1 100 0.00 255.0 FORMAT "%5.1" ARRAY_SIZE 1440 ECU_ADDRESS 0x500132D4 /end MEASUREMENT
/begin MEASUREMENT DRIVE_PRDS_Bnk0Blk0d_idx_NV "non volatile index storage for DRIVE recorder blocks" UWORD OneToOne 1 100 0.00 65535.00 FORMAT "%8.2" ARRAY_SIZE 2 ECU_ADDRESS 0x60037DD4 /end MEASUREMENT
/begin MEASUREMENT DRIVE_PRDS_Bnk0Blk0d_Rcrd_NV "DRIVE recorder non volatile record buffer" UBYTE OneToOne 1 100 0.00 255.0 FORMAT "%5.1" ARRAY_SIZE 960 ECU_ADDRESS 0x50012F14 /end MEASUREMENT
/begin MEASUREMENT DRIVE_PRDS_Bnk0Blk0e_idx_NV "non volatile index storage for DRIVE recorder blocks" UWORD OneToOne 1 100 0.00 65535.00 FORMAT "%8.2" ARRAY_SIZE 2 ECU_ADDRESS 0x60037DD0 /end MEASUREMENT
/begin MEASUREMENT DRIVE_PRDS_Bnk0Blk0e_Rcrd_NV "DRIVE recorder non volatile record buffer" UBYTE OneToOne 1 100 0.00 255.0 FORMAT "%5.1" ARRAY_SIZE 30 ECU_ADDRESS 0x50012EF6 /end MEASUREMENT
/begin MEASUREMENT DRIVE_PRDS_Bnk0Blk0f_idx_NV "non volatile index storage for DRIVE recorder blocks" UWORD OneToOne 1 100 0.00 65535.00 FORMAT "%8.2" ARRAY_SIZE 2 ECU_ADDRESS 0x60037DCC /end MEASUREMENT
/begin MEASUREMENT DRIVE_PRDS_Bnk0Blk0f_Rcrd_NV "DRIVE recorder non volatile record buffer" UBYTE OneToOne 1 100 0.00 255.0 FORMAT "%5.1" ARRAY_SIZE 41 ECU_ADDRESS 0x50012ECD /end MEASUREMENT
/begin MEASUREMENT DRIVE_PRDS_Bnk0Blk10_idx_NV "non volatile index storage for DRIVE recorder blocks" UWORD OneToOne 1 100 0.00 65535.00 FORMAT "%8.2" ARRAY_SIZE 2 ECU_ADDRESS 0x60037DC8 /end MEASUREMENT
/begin MEASUREMENT DRIVE_PRDS_Bnk0Blk10_Rcrd_NV "DRIVE recorder non volatile record buffer" UBYTE OneToOne 1 100 0.00 255.0 FORMAT "%5.1" ARRAY_SIZE 42 ECU_ADDRESS 0x50012EA3 /end MEASUREMENT
/begin MEASUREMENT DRIVE_PRDS_Bnk0Blk11_idx_NV "non volatile index storage for DRIVE recorder blocks" UWORD OneToOne 1 100 0.00 65535.00 FORMAT "%8.2" ARRAY_SIZE 2 ECU_ADDRESS 0x60037DC4 /end MEASUREMENT
/begin MEASUREMENT DRIVE_PRDS_Bnk0Blk11_Rcrd_NV "DRIVE recorder non volatile record buffer" UBYTE OneToOne 1 100 0.00 255.0 FORMAT "%5.1" ARRAY_SIZE 42 ECU_ADDRESS 0x50012E79 /end MEASUREMENT
/begin MEASUREMENT DRIVE_PRDS_Bnk0Blk12_idx_NV "non volatile index storage for DRIVE recorder blocks" UWORD OneToOne 1 100 0.00 65535.00 FORMAT "%8.2" ARRAY_SIZE 2 ECU_ADDRESS 0x60037DC0 /end MEASUREMENT
/begin MEASUREMENT DRIVE_PRDS_Bnk0Blk12_Rcrd_NV "DRIVE recorder non volatile record buffer" UBYTE OneToOne 1 100 0.00 255.0 FORMAT "%5.1" ARRAY_SIZE 42 ECU_ADDRESS 0x50012E4F /end MEASUREMENT
/begin MEASUREMENT DRIVE_PRDS_Bnk0Blk13_idx_NV "non volatile index storage for DRIVE recorder blocks" UWORD OneToOne 1 100 0.00 65535.00 FORMAT "%8.2" ARRAY_SIZE 2 ECU_ADDRESS 0x60037DBC /end MEASUREMENT
/begin MEASUREMENT DRIVE_PRDS_Bnk0Blk13_Rcrd_NV "DRIVE recorder non volatile record buffer" UBYTE OneToOne 1 100 0.00 255.0 FORMAT "%5.1" ARRAY_SIZE 42 ECU_ADDRESS 0x50012E25 /end MEASUREMENT
/begin MEASUREMENT DRIVE_PRDS_Bnk0Blk14_idx_NV "non volatile index storage for DRIVE recorder blocks" UWORD OneToOne 1 100 0.00 65535.00 FORMAT "%8.2" ARRAY_SIZE 2 ECU_ADDRESS 0x60037DB8 /end MEASUREMENT
/begin MEASUREMENT DRIVE_PRDS_Bnk0Blk14_Rcrd_NV "DRIVE recorder non volatile record buffer" UBYTE OneToOne 1 100 0.00 255.0 FORMAT "%5.1" ARRAY_SIZE 3 ECU_ADDRESS 0x50012E22 /end MEASUREMENT
/begin MEASUREMENT DRIVE_PRDS_Bnk0Blk15_idx_NV "non volatile index storage for DRIVE recorder blocks" UWORD OneToOne 1 100 0.00 65535.00 FORMAT "%8.2" ARRAY_SIZE 2 ECU_ADDRESS 0x60037DB4 /end MEASUREMENT
/begin MEASUREMENT DRIVE_PRDS_Bnk0Blk15_Rcrd_NV "DRIVE recorder non volatile record buffer" UBYTE OneToOne 1 100 0.00 255.0 FORMAT "%5.1" ARRAY_SIZE 29 ECU_ADDRESS 0x50012E05 /end MEASUREMENT
/begin MEASUREMENT DRIVE_PRDS_Bnk0Blk16_idx_NV "non volatile index storage for DRIVE recorder blocks" UWORD OneToOne 1 100 0.00 65535.00 FORMAT "%8.2" ARRAY_SIZE 2 ECU_ADDRESS 0x60037DB0 /end MEASUREMENT
/begin MEASUREMENT DRIVE_PRDS_Bnk0Blk16_Rcrd_NV "DRIVE recorder non volatile record buffer" UBYTE OneToOne 1 100 0.00 255.0 FORMAT "%5.1" ARRAY_SIZE 150 ECU_ADDRESS 0x50012D6F /end MEASUREMENT
/begin MEASUREMENT DRIVE_PRDS_Bnk0Blk17_idx_NV "non volatile index storage for DRIVE recorder blocks" UWORD OneToOne 1 100 0.00 65535.00 FORMAT "%8.2" ARRAY_SIZE 2 ECU_ADDRESS 0x60037DAC /end MEASUREMENT
/begin MEASUREMENT DRIVE_PRDS_Bnk0Blk17_Rcrd_NV "DRIVE recorder non volatile record buffer" UBYTE OneToOne 1 100 0.00 255.0 FORMAT "%5.1" ARRAY_SIZE 750 ECU_ADDRESS 0x50012A81 /end MEASUREMENT
/begin MEASUREMENT DRIVE_PRDS_Bnk0Blk18_idx_NV "non volatile index storage for DRIVE recorder blocks" UWORD OneToOne 1 100 0.00 65535.00 FORMAT "%8.2" ARRAY_SIZE 2 ECU_ADDRESS 0x60037DA8 /end MEASUREMENT
/begin MEASUREMENT DRIVE_PRDS_Bnk0Blk18_Rcrd_NV "DRIVE recorder non volatile record buffer" UBYTE OneToOne 1 100 0.00 255.0 FORMAT "%5.1" ARRAY_SIZE 150 ECU_ADDRESS 0x500129EB /end MEASUREMENT
/begin MEASUREMENT DRIVE_PRDS_Bnk0Blk19_idx_NV "non volatile index storage for DRIVE recorder blocks" UWORD OneToOne 1 100 0.00 65535.00 FORMAT "%8.2" ARRAY_SIZE 2 ECU_ADDRESS 0x60037DA4 /end MEASUREMENT
/begin MEASUREMENT DRIVE_PRDS_Bnk0Blk19_Rcrd_NV "DRIVE recorder non volatile record buffer" UBYTE OneToOne 1 100 0.00 255.0 FORMAT "%5.1" ARRAY_SIZE 30 ECU_ADDRESS 0x500129CD /end MEASUREMENT
/begin MEASUREMENT DRIVE_PRDS_Bnk0Blk1a_idx_NV "non volatile index storage for DRIVE recorder blocks" UWORD OneToOne 1 100 0.00 65535.00 FORMAT "%8.2" ARRAY_SIZE 2 ECU_ADDRESS 0x60037DA0 /end MEASUREMENT
/begin MEASUREMENT DRIVE_PRDS_Bnk0Blk1a_Rcrd_NV "DRIVE recorder non volatile record buffer" UBYTE OneToOne 1 100 0.00 255.0 FORMAT "%5.1" ARRAY_SIZE 1725 ECU_ADDRESS 0x50012310 /end MEASUREMENT
/begin MEASUREMENT DRIVE_PRDS_Bnk0Blk1b_idx_NV "non volatile index storage for DRIVE recorder blocks" UWORD OneToOne 1 100 0.00 65535.00 FORMAT "%8.2" ARRAY_SIZE 2 ECU_ADDRESS 0x60037D9C /end MEASUREMENT
/begin MEASUREMENT DRIVE_PRDS_Bnk0Blk1b_Rcrd_NV "DRIVE recorder non volatile record buffer" UBYTE OneToOne 1 100 0.00 255.0 FORMAT "%5.1" ARRAY_SIZE 720 ECU_ADDRESS 0x50012040 /end MEASUREMENT
/begin MEASUREMENT DRIVE_PRDS_Bnk1Blk00_idx "Index storage for DRIVE recorder blocks" UWORD OneToOne 1 100 0.00 65535.00 FORMAT "%8.2" ARRAY_SIZE 2 ECU_ADDRESS 0x60003BFA /end MEASUREMENT
/begin MEASUREMENT DRIVE_PRDS_Bnk1Blk00_idx_NV "non volatile index storage for DRIVE recorder blocks" UWORD OneToOne 1 100 0.00 65535.00 FORMAT "%8.2" ARRAY_SIZE 2 ECU_ADDRESS 0x60037D98 /end MEASUREMENT
/begin MEASUREMENT DRIVE_PRDS_Bnk1Blk00_Rcrd "Buffer for bank 1 block 0 recording" UBYTE OneToOne 1 100 0.00 255.0 FORMAT "%5.1" ARRAY_SIZE 3500 ECU_ADDRESS 0x60008D9B /end MEASUREMENT
/begin MEASUREMENT DRIVE_PRDS_Bnk1Blk00_Rcrd_NV "DRIVE recorder non volatile record buffer" UBYTE OneToOne 1 100 0.00 255.0 FORMAT "%5.1" ARRAY_SIZE 3500 ECU_ADDRESS 0x50011294 /end MEASUREMENT
/begin MEASUREMENT DRIVE_PRDS_Bnk1Blk02_idx "Index storage for DRIVE recorder blocks" UWORD OneToOne 1 100 0.00 65535.00 FORMAT "%8.2" ARRAY_SIZE 2 ECU_ADDRESS 0x60003BF6 /end MEASUREMENT
/begin MEASUREMENT DRIVE_PRDS_Bnk1Blk02_idx_NV "non volatile index storage for DRIVE recorder blocks" UWORD OneToOne 1 100 0.00 65535.00 FORMAT "%8.2" ARRAY_SIZE 2 ECU_ADDRESS 0x60037D94 /end MEASUREMENT
/begin MEASUREMENT DRIVE_PRDS_Bnk1Blk02_Rcrd "DRIVE Recorder Buffer for Engine stall Bank 200 MSec sampling" UBYTE OneToOne 1 100 0.00 255.0 FORMAT "%5.1" ARRAY_SIZE 400 ECU_ADDRESS 0x60008C0B /end MEASUREMENT
/begin MEASUREMENT DRIVE_PRDS_Bnk1Blk02_Rcrd_NV "DRIVE recorder non volatile record buffer" UBYTE OneToOne 1 100 0.00 255.0 FORMAT "%5.1" ARRAY_SIZE 400 ECU_ADDRESS 0x50011104 /end MEASUREMENT
/begin MEASUREMENT DRIVE_PRDS_Bnk1Blk03_idx "Index storage for DRIVE recorder blocks" UWORD OneToOne 1 100 0.00 65535.00 FORMAT "%8.2" ARRAY_SIZE 2 ECU_ADDRESS 0x60003BF2 /end MEASUREMENT
/begin MEASUREMENT DRIVE_PRDS_Bnk1Blk03_idx_NV "non volatile index storage for DRIVE recorder blocks" UWORD OneToOne 1 100 0.00 65535.00 FORMAT "%8.2" ARRAY_SIZE 2 ECU_ADDRESS 0x60037D90 /end MEASUREMENT
/begin MEASUREMENT DRIVE_PRDS_Bnk1Blk03_Rcrd "DRIVE Recorder Buffer for Engine Stall Bank 500 MSec sampling" UBYTE OneToOne 1 100 0.00 255.0 FORMAT "%5.1" ARRAY_SIZE 140 ECU_ADDRESS 0x60008B7F /end MEASUREMENT
/begin MEASUREMENT DRIVE_PRDS_Bnk1Blk03_Rcrd_NV "DRIVE recorder non volatile record buffer" UBYTE OneToOne 1 100 0.00 255.0 FORMAT "%5.1" ARRAY_SIZE 140 ECU_ADDRESS 0x50011078 /end MEASUREMENT
/begin MEASUREMENT DRIVE_PRDS_Bnk1Blk04_idx "Index storage for DRIVE recorder blocks" UWORD OneToOne 1 100 0.00 65535.00 FORMAT "%8.2" ARRAY_SIZE 2 ECU_ADDRESS 0x60003BEE /end MEASUREMENT
/begin MEASUREMENT DRIVE_PRDS_Bnk1Blk04_idx_NV "non volatile index storage for DRIVE recorder blocks" UWORD OneToOne 1 100 0.00 65535.00 FORMAT "%8.2" ARRAY_SIZE 2 ECU_ADDRESS 0x60037D8C /end MEASUREMENT
/begin MEASUREMENT DRIVE_PRDS_Bnk1Blk04_Rcrd "Buffer for bank 1 block 4 recording" UBYTE OneToOne 1 100 0.00 255.0 FORMAT "%5.1" ARRAY_SIZE 70 ECU_ADDRESS 0x60008B39 /end MEASUREMENT
/begin MEASUREMENT DRIVE_PRDS_Bnk1Blk04_Rcrd_NV "DRIVE recorder non volatile record buffer" UBYTE OneToOne 1 100 0.00 255.0 FORMAT "%5.1" ARRAY_SIZE 70 ECU_ADDRESS 0x50011032 /end MEASUREMENT
/begin MEASUREMENT DRIVE_PRDS_Bnk1Blk05_idx "Index storage for DRIVE recorder blocks" UWORD OneToOne 1 100 0.00 65535.00 FORMAT "%8.2" ARRAY_SIZE 2 ECU_ADDRESS 0x60003BEA /end MEASUREMENT
/begin MEASUREMENT DRIVE_PRDS_Bnk1Blk05_idx_NV "non volatile index storage for DRIVE recorder blocks" UWORD OneToOne 1 100 0.00 65535.00 FORMAT "%8.2" ARRAY_SIZE 2 ECU_ADDRESS 0x60037D88 /end MEASUREMENT
/begin MEASUREMENT DRIVE_PRDS_Bnk1Blk05_Rcrd "DRIVE Recorder Buffer for Engine Stall Bank single shot" UBYTE OneToOne 1 100 0.00 255.0 FORMAT "%5.1" ARRAY_SIZE 18 ECU_ADDRESS 0x60008B27 /end MEASUREMENT
/begin MEASUREMENT DRIVE_PRDS_Bnk1Blk05_Rcrd_NV "DRIVE recorder non volatile record buffer" UBYTE OneToOne 1 100 0.00 255.0 FORMAT "%5.1" ARRAY_SIZE 18 ECU_ADDRESS 0x50011020 /end MEASUREMENT
/begin MEASUREMENT DRIVE_PRDS_Bnk2Blk00_idx "Index storage for DRIVE recorder blocks" UWORD OneToOne 1 100 0.00 65535.00 FORMAT "%8.2" ARRAY_SIZE 2 ECU_ADDRESS 0x60003BE6 /end MEASUREMENT
/begin MEASUREMENT DRIVE_PRDS_Bnk2Blk00_idx_NV "non volatile index storage for DRIVE recorder blocks" UWORD OneToOne 1 100 0.00 65535.00 FORMAT "%8.2" ARRAY_SIZE 2 ECU_ADDRESS 0x60037D84 /end MEASUREMENT
/begin MEASUREMENT DRIVE_PRDS_Bnk2Blk00_Rcrd "Buffer for bank 2 block 0 recording" UBYTE OneToOne 1 100 0.00 255.0 FORMAT "%5.1" ARRAY_SIZE 3500 ECU_ADDRESS 0x60007D7B /end MEASUREMENT
/begin MEASUREMENT DRIVE_PRDS_Bnk2Blk00_Rcrd_NV "DRIVE recorder non volatile record buffer" UBYTE OneToOne 1 100 0.00 255.0 FORMAT "%5.1" ARRAY_SIZE 3500 ECU_ADDRESS 0x50010274 /end MEASUREMENT
/begin MEASUREMENT DRIVE_PRDS_Bnk2Blk02_idx "Index storage for DRIVE recorder blocks" UWORD OneToOne 1 100 0.00 65535.00 FORMAT "%8.2" ARRAY_SIZE 2 ECU_ADDRESS 0x60003BE2 /end MEASUREMENT
/begin MEASUREMENT DRIVE_PRDS_Bnk2Blk02_idx_NV "non volatile index storage for DRIVE recorder blocks" UWORD OneToOne 1 100 0.00 65535.00 FORMAT "%8.2" ARRAY_SIZE 2 ECU_ADDRESS 0x60037D80 /end MEASUREMENT
/begin MEASUREMENT DRIVE_PRDS_Bnk2Blk02_Rcrd "Buffer for bank 2 block 2 recording" UBYTE OneToOne 1 100 0.00 255.0 FORMAT "%5.1" ARRAY_SIZE 400 ECU_ADDRESS 0x60007BEB /end MEASUREMENT
/begin MEASUREMENT DRIVE_PRDS_Bnk2Blk02_Rcrd_NV "DRIVE recorder non volatile record buffer" UBYTE OneToOne 1 100 0.00 255.0 FORMAT "%5.1" ARRAY_SIZE 400 ECU_ADDRESS 0x500100E4 /end MEASUREMENT
/begin MEASUREMENT DRIVE_PRDS_Bnk2Blk03_idx "Index storage for DRIVE recorder blocks" UWORD OneToOne 1 100 0.00 65535.00 FORMAT "%8.2" ARRAY_SIZE 2 ECU_ADDRESS 0x60003BDE /end MEASUREMENT
/begin MEASUREMENT DRIVE_PRDS_Bnk2Blk03_idx_NV "non volatile index storage for DRIVE recorder blocks" UWORD OneToOne 1 100 0.00 65535.00 FORMAT "%8.2" ARRAY_SIZE 2 ECU_ADDRESS 0x60037D7C /end MEASUREMENT
/begin MEASUREMENT DRIVE_PRDS_Bnk2Blk03_Rcrd "Buffer for bank 2 block 3 recording" UBYTE OneToOne 1 100 0.00 255.0 FORMAT "%5.1" ARRAY_SIZE 140 ECU_ADDRESS 0x60007B5F /end MEASUREMENT
/begin MEASUREMENT DRIVE_PRDS_Bnk2Blk03_Rcrd_NV "DRIVE recorder non volatile record buffer" UBYTE OneToOne 1 100 0.00 255.0 FORMAT "%5.1" ARRAY_SIZE 140 ECU_ADDRESS 0x50010058 /end MEASUREMENT
/begin MEASUREMENT DRIVE_PRDS_Bnk2Blk04_idx "Index storage for DRIVE recorder blocks" UWORD OneToOne 1 100 0.00 65535.00 FORMAT "%8.2" ARRAY_SIZE 2 ECU_ADDRESS 0x60003BDA /end MEASUREMENT
/begin MEASUREMENT DRIVE_PRDS_Bnk2Blk04_idx_NV "non volatile index storage for DRIVE recorder blocks" UWORD OneToOne 1 100 0.00 65535.00 FORMAT "%8.2" ARRAY_SIZE 2 ECU_ADDRESS 0x60037D78 /end MEASUREMENT
/begin MEASUREMENT DRIVE_PRDS_Bnk2Blk04_Rcrd "Buffer for bank 2 block 4 recording" UBYTE OneToOne 1 100 0.00 255.0 FORMAT "%5.1" ARRAY_SIZE 70 ECU_ADDRESS 0x60007B19 /end MEASUREMENT
/begin MEASUREMENT DRIVE_PRDS_Bnk2Blk04_Rcrd_NV "DRIVE recorder non volatile record buffer" UBYTE OneToOne 1 100 0.00 255.0 FORMAT "%5.1" ARRAY_SIZE 70 ECU_ADDRESS 0x50010012 /end MEASUREMENT
/begin MEASUREMENT DRIVE_PRDS_Bnk2Blk05_idx "Index storage for DRIVE recorder blocks" UWORD OneToOne 1 100 0.00 65535.00 FORMAT "%8.2" ARRAY_SIZE 2 ECU_ADDRESS 0x60003BD6 /end MEASUREMENT
/begin MEASUREMENT DRIVE_PRDS_Bnk2Blk05_idx_NV "non volatile index storage for DRIVE recorder blocks" UWORD OneToOne 1 100 0.00 65535.00 FORMAT "%8.2" ARRAY_SIZE 2 ECU_ADDRESS 0x60037D74 /end MEASUREMENT
/begin MEASUREMENT DRIVE_PRDS_Bnk2Blk05_Rcrd "DRIVE Recorder Buffer for BaD Engine start Bank 1000 MSec sampling" UBYTE OneToOne 1 100 0.00 255.0 FORMAT "%5.1" ARRAY_SIZE 18 ECU_ADDRESS 0x60007B07 /end MEASUREMENT
/begin MEASUREMENT DRIVE_PRDS_Bnk2Blk05_Rcrd_NV "DRIVE recorder non volatile record buffer" UBYTE OneToOne 1 100 0.00 255.0 FORMAT "%5.1" ARRAY_SIZE 18 ECU_ADDRESS 0x50010000 /end MEASUREMENT
/begin MEASUREMENT DRIVE_PRDS_Bnk3Blk00_idx "Index storage for DRIVE recorder blocks" UWORD OneToOne 1 100 0.00 65535.00 FORMAT "%8.2" ARRAY_SIZE 2 ECU_ADDRESS 0x60003BD2 /end MEASUREMENT
/begin MEASUREMENT DRIVE_PRDS_Bnk3Blk00_idx_NV "non volatile index storage for DRIVE recorder blocks" UWORD OneToOne 1 100 0.00 65535.00 FORMAT "%8.2" ARRAY_SIZE 2 ECU_ADDRESS 0x60037D70 /end MEASUREMENT
/begin MEASUREMENT DRIVE_PRDS_Bnk3Blk00_Rcrd "Buffer for bank 3 block 0 recording" UBYTE OneToOne 1 100 0.00 255.0 FORMAT "%5.1" ARRAY_SIZE 5400 ECU_ADDRESS 0x600065EF /end MEASUREMENT
/begin MEASUREMENT DRIVE_PRDS_Bnk3Blk00_Rcrd_NV "DRIVE recorder non volatile record buffer" UBYTE OneToOne 1 100 0.00 255.0 FORMAT "%5.1" ARRAY_SIZE 5400 ECU_ADDRESS 0x60036858 /end MEASUREMENT
/begin MEASUREMENT DRIVE_PRDS_Bnk3Blk00_RecMsk "Record mask for Bank 3 block 0" UBYTE OneToOne 1 100 0.00 255.0 FORMAT "%5.1" ARRAY_SIZE 54 ECU_ADDRESS 0x60036822 /end MEASUREMENT
/begin MEASUREMENT DRIVE_PRDS_Bnk3Blk00_Sig "Trouble shooting parameter array for bank 3 block 0 recording" UWORD Signals_IntSigNumVerb 1 100 0.00 782.000000000 FORMAT "%13.9" ARRAY_SIZE 54 ECU_ADDRESS 0x600367B6 /end MEASUREMENT
/begin MEASUREMENT DRIVE_PRDS_Bnk3Blk01_idx "Index storage for DRIVE recorder blocks" UWORD OneToOne 1 100 0.00 65535.00 FORMAT "%8.2" ARRAY_SIZE 2 ECU_ADDRESS 0x60003BCE /end MEASUREMENT
/begin MEASUREMENT DRIVE_PRDS_Bnk3Blk01_idx_NV "non volatile index storage for DRIVE recorder blocks" UWORD OneToOne 1 100 0.00 65535.00 FORMAT "%8.2" ARRAY_SIZE 2 ECU_ADDRESS 0x600367B2 /end MEASUREMENT
/begin MEASUREMENT DRIVE_PRDS_Bnk3Blk01_Rcrd "Buffer for bank 3 block 1 recording" UBYTE OneToOne 1 100 0.00 255.0 FORMAT "%5.1" ARRAY_SIZE 54 ECU_ADDRESS 0x600065B9 /end MEASUREMENT
/begin MEASUREMENT DRIVE_PRDS_Bnk3Blk01_Rcrd_NV "DRIVE recorder non volatile record buffer" UBYTE OneToOne 1 100 0.00 255.0 FORMAT "%5.1" ARRAY_SIZE 54 ECU_ADDRESS 0x6003677C /end MEASUREMENT
/begin MEASUREMENT DRIVE_PRDS_Bnk3Blk01_RecMsk "Record mask for Bank 3 block 1" UBYTE OneToOne 1 100 0.00 255.0 FORMAT "%5.1" ARRAY_SIZE 54 ECU_ADDRESS 0x60036746 /end MEASUREMENT
/begin MEASUREMENT DRIVE_PRDS_Bnk3Blk01_Sig "Trouble shooting parameter array for bank 3 block 1 recording" UWORD Signals_IntSigNumVerb 1 100 0.00 782.000000000 FORMAT "%13.9" ARRAY_SIZE 54 ECU_ADDRESS 0x600366DA /end MEASUREMENT
/begin MEASUREMENT DRIVE_ScndLyrExpRes_raw "Old status of Second Layer expression result of Arbitrary OBS" UBYTE OneToOne 1 100 0.00 255.0 FORMAT "%5.1" ECU_ADDRESS 0x600065B8 /end MEASUREMENT
/begin MEASUREMENT DRIVE_SecondLayerExpMsk "Mask for second layer expression of Arbitrary OBS" UBYTE OneToOne 1 100 0.00 255.0 FORMAT "%5.1" ECU_ADDRESS 0x600065B7 /end MEASUREMENT
/begin MEASUREMENT DRIVE_SecondLayerExpResults "Status of Second Layer expression result of Arbitrary OBS" UBYTE OneToOne 1 100 0.00 255.0 FORMAT "%5.1" ECU_ADDRESS 0x600065B6 /end MEASUREMENT
/begin MEASUREMENT DRIVE_stAOBSTrg "Status of Arbitrary Trigger" UBYTE OneToOne 1 100 0.00 255.0 FORMAT "%5.1" ECU_ADDRESS 0x6000A779 /end MEASUREMENT
/begin MEASUREMENT DRIVE_stArbitraryTrgFrz "Status of trigger mode that caused freeze of drive recorder in Arbitrary OBS bank" UBYTE OneToOne 1 100 0.00 255.0 FORMAT "%5.1" ECU_ADDRESS 0x6000A778 /end MEASUREMENT
/begin MEASUREMENT DRIVE_stArbitraryTrg_mp "Arbitrary trigger measurement point" UBYTE OneToOne 1 100 0.00 255.0 FORMAT "%5.1" ECU_ADDRESS 0x70008AA7 /end MEASUREMENT
/begin MEASUREMENT DRIVE_stBadEngStrt "Bad engine start detected flag" UBYTE OneToOne 1 100 0.00 255.0 FORMAT "%5.1" ECU_ADDRESS 0x6000A777 /end MEASUREMENT
/begin MEASUREMENT DRIVE_stBadStrtTrgFrz "Status of trigger mode that caused freeye of drive recorder in bad start bank" UBYTE OneToOne 1 100 0.00 255.0 FORMAT "%5.1" ECU_ADDRESS 0x6000A776 /end MEASUREMENT
/begin MEASUREMENT DRIVE_stCrLon "Cranking too long status" UBYTE OneToOne 1 100 0.00 255.0 FORMAT "%5.1" ECU_ADDRESS 0x6000A775 /end MEASUREMENT
/begin MEASUREMENT DRIVE_stCurTrgMode "Current trigger mode for drive recorder data" UBYTE DRIVE_PRDS_TRGMODETYPE 1 100 0.00 2.00000000000 FORMAT "%13.11" ECU_ADDRESS 0x6000A774 /end MEASUREMENT
/begin MEASUREMENT DRIVE_stEngNoStrt "Bad Engine start status" UBYTE OneToOne 1 100 0.00 255.0 FORMAT "%5.1" ECU_ADDRESS 0x6000A772 /end MEASUREMENT
/begin MEASUREMENT DRIVE_stEngNStrt "Cranking too long then engine not started status" UBYTE OneToOne 1 100 0.00 255.0 FORMAT "%5.1" ECU_ADDRESS 0x6000A773 /end MEASUREMENT
/begin MEASUREMENT DRIVE_stEngStalTrgFrz "Status of trigger mode that caused freeye of drive recorder in engine stall bank" UBYTE OneToOne 1 100 0.00 255.0 FORMAT "%5.1" ECU_ADDRESS 0x6000A771 /end MEASUREMENT
/begin MEASUREMENT DRIVE_stEngStalTrg_mp "Engine Stall trigger measurement point" UBYTE OneToOne 1 100 0.00 255.0 FORMAT "%5.1" ECU_ADDRESS 0x70008AA6 /end MEASUREMENT
/begin MEASUREMENT DRIVE_stEngStrt "Engine started successfully flag" UBYTE OneToOne 1 100 0.00 255.0 FORMAT "%5.1" ECU_ADDRESS 0x600366D9 /end MEASUREMENT
/begin MEASUREMENT DRIVE_stHardToStrt "Status of trigger hard to start" UBYTE OneToOne 1 100 0.00 255.0 FORMAT "%5.1" ECU_ADDRESS 0x6000A770 /end MEASUREMENT
/begin MEASUREMENT DRIVE_stRingBuf_Arbitrary_mp "Status of Ring Buffer for Arbitrary OBS" UBYTE DRIVE_PRDS_BUFSTATTYPE 1 100 0.00 2.00000000000 FORMAT "%13.11" ECU_ADDRESS 0x70008AA5 /end MEASUREMENT
/begin MEASUREMENT DRIVE_stRingBuf_BadEngStrt_mp "Measurement point of the measurement buffer state." UBYTE DRIVE_PRDS_BUFSTATTYPE 1 100 0.00 2.00000000000 FORMAT "%13.11" ECU_ADDRESS 0x70008AA4 /end MEASUREMENT
/begin MEASUREMENT DRIVE_stRingBuf_EngStal_mp "Measurement point of the measurement buffer state." UBYTE DRIVE_PRDS_BUFSTATTYPE 1 100 0.00 2.00000000000 FORMAT "%13.11" ECU_ADDRESS 0x70008AA3 /end MEASUREMENT
/begin MEASUREMENT DRIVE_stRingBuf_mp "Status of the ring buffer for Drive recorder" UBYTE DRIVE_PRDS_BUFSTATTYPE 1 100 0.00 2.00000000000 FORMAT "%13.11" ECU_ADDRESS 0x70008AA2 /end MEASUREMENT
/begin MEASUREMENT DRIVE_stStalAftEngStrt "Engine stall just after engine started flag" UBYTE OneToOne 1 100 0.00 255.0 FORMAT "%5.1" ECU_ADDRESS 0x6000A76F /end MEASUREMENT
/begin MEASUREMENT DRIVE_stStalAftEngStrt_mp "Engine stall just after engine started measurement point" UBYTE OneToOne 1 100 0.00 255.0 FORMAT "%5.1" ECU_ADDRESS 0x70008AA1 /end MEASUREMENT
/begin MEASUREMENT DRIVE_stStore_Arbitrary_mp "Status of store for Arbitrary OBS" UBYTE DRIVE_PRDS_CLEARSTORETYPE 1 100 0.00 2.00000000000 FORMAT "%13.11" ECU_ADDRESS 0x70008AA0 /end MEASUREMENT
/begin MEASUREMENT DRIVE_stStore_BadEngStrt_mp "Measurement point of the buffer store state." UBYTE DRIVE_PRDS_CLEARSTORETYPE 1 100 0.00 2.00000000000 FORMAT "%13.11" ECU_ADDRESS 0x70008A9F /end MEASUREMENT
/begin MEASUREMENT DRIVE_stStore_EngStal_mp "Measurement point of the buffer store state." UBYTE DRIVE_PRDS_CLEARSTORETYPE 1 100 0.00 2.00000000000 FORMAT "%13.11" ECU_ADDRESS 0x70008A9E /end MEASUREMENT
/begin MEASUREMENT DRIVE_stStore_mp "Status of the ring buffer storage for Drive recorder" UBYTE DRIVE_PRDS_CLEARSTORETYPE 1 100 0.00 2.00000000000 FORMAT "%13.11" ECU_ADDRESS 0x70008A9D /end MEASUREMENT
/begin MEASUREMENT DRIVE_stTimeLapse "status of time lapse of Arbitrary OBS" UBYTE OneToOne 1 100 0.00 255.0 FORMAT "%5.1" ARRAY_SIZE 20 ECU_ADDRESS 0x600065A2 /end MEASUREMENT
/begin MEASUREMENT DRIVE_stTrgSigFrz "Status of trigger mode that caused freeye of drive recorder in DTC trigger bank" UBYTE OneToOne 1 100 0.00 255.0 FORMAT "%5.1" ECU_ADDRESS 0x6000A76E /end MEASUREMENT
/begin MEASUREMENT DRIVE_ThirdLayerExpResults "Status of Third Layer expression result of Arbitrary OBS" UWORD OneToOne 1 100 0.00 65535.00 FORMAT "%8.2" ECU_ADDRESS 0x60003BCC /end MEASUREMENT
/begin MEASUREMENT DRIVE_ThirdLayerExpResults_old "Bit coded results of third layer expressions in previous raster" UWORD OneToOne 1 100 0.00 65535.00 FORMAT "%8.2" ECU_ADDRESS 0x60003BCA /end MEASUREMENT
/begin MEASUREMENT DRIVE_ThrdLyrCntrRes_raw "Old status of Third layer counter expression results" ULONG OneToOne 1 100 0.00 4294967295.00 FORMAT "%13.2" ECU_ADDRESS 0x600017C8 /end MEASUREMENT
/begin MEASUREMENT DRIVE_TriggerSignal "Current trigger signal for DTC bank" ULONG DRIVE_PRDS_TRIGGERCODETYPE 1 100 69649.00000 1044735.00000 FORMAT "%13.5" ECU_ADDRESS 0x60001DC4 /end MEASUREMENT
/begin MEASUREMENT DRIVE_TriggerSignal_Arbitrary "Current trigger signal for Arbitrary OBS bank" ULONG DRIVE_PRDS_TRIGGERCODETYPE 1 100 69649.00000 1044735.00000 FORMAT "%13.5" ECU_ADDRESS 0x60001DC0 /end MEASUREMENT
/begin MEASUREMENT DRIVE_TriggerSignal_BadEngStrt "Current trigger signal for bad engine start bank" ULONG DRIVE_PRDS_TRIGGERCODETYPE 1 100 69649.00000 1044735.00000 FORMAT "%13.5" ECU_ADDRESS 0x60001DBC /end MEASUREMENT
/begin MEASUREMENT DRIVE_TriggerSignal_EngStal "Current trigger signal for engine stall bank" ULONG DRIVE_PRDS_TRIGGERCODETYPE 1 100 69649.00000 1044735.00000 FORMAT "%13.5" ECU_ADDRESS 0x60001DB8 /end MEASUREMENT
/begin MEASUREMENT DSCHED_DynPrio.FId_Unused "dynamic priority / " SWORD DFC_OneToOne 1 100 -32768.00 32767.00 FORMAT "%8.2" ECU_ADDRESS 0x50005828 /end MEASUREMENT
/begin MEASUREMENT DSCHED_DynPrio.FID_AFRA "dynamic priority / Dynamic priority of scheduled function identifier FID_AFRA" SWORD DFC_OneToOne 1 100 -32768.00 32767.00 FORMAT "%8.2" ECU_ADDRESS 0x5000582A /end MEASUREMENT
/begin MEASUREMENT DSCHED_DynPrio.FID_AORA "dynamic priority / Dynamic priority of scheduled function identifier FID_AORA" SWORD DFC_OneToOne 1 100 -32768.00 32767.00 FORMAT "%8.2" ECU_ADDRESS 0x5000582C /end MEASUREMENT
/begin MEASUREMENT DSCHED_DynPrio.FID_ATEH "dynamic priority / Dynamic priority of scheduled function identifier FID_ATEH" SWORD DFC_OneToOne 1 100 -32768.00 32767.00 FORMAT "%8.2" ECU_ADDRESS 0x5000582E /end MEASUREMENT
/begin MEASUREMENT DSCHED_DynPrio.FID_ATEL "dynamic priority / Dynamic priority of scheduled function identifier FID_ATEL" SWORD DFC_OneToOne 1 100 -32768.00 32767.00 FORMAT "%8.2" ECU_ADDRESS 0x50005830 /end MEASUREMENT
/begin MEASUREMENT DSCHED_DynPrio.FID_ATEN "dynamic priority / Dynamic priority of scheduled function identifier FID_ATEN" SWORD DFC_OneToOne 1 100 -32768.00 32767.00 FORMAT "%8.2" ECU_ADDRESS 0x50005832 /end MEASUREMENT
/begin MEASUREMENT DSCHED_DynPrio.FId_EGSDCmnSeg1B1Parl "dynamic priority / Dynamic priority of scheduled function identifier FId_EGSDCmnSeg1B1Parl" SWORD DFC_OneToOne 1 100 -32768.00 32767.00 FORMAT "%8.2" ECU_ADDRESS 0x50005834 /end MEASUREMENT
/begin MEASUREMENT DSCHED_DynPrio.FID_BLLRH "dynamic priority / Dynamic priority of scheduled function identifier FID_BLLRH" SWORD DFC_OneToOne 1 100 -32768.00 32767.00 FORMAT "%8.2" ECU_ADDRESS 0x50005836 /end MEASUREMENT
/begin MEASUREMENT DSCHED_DynPrio.FID_BLLRKH "dynamic priority / Dynamic priority of scheduled function identifier FID_BLLRKH" SWORD DFC_OneToOne 1 100 -32768.00 32767.00 FORMAT "%8.2" ECU_ADDRESS 0x50005838 /end MEASUREMENT
/begin MEASUREMENT DSCHED_DynPrio.FID_BPLSU "dynamic priority / Dynamic priority of scheduled function identifier FID_BPLSU" SWORD DFC_OneToOne 1 100 -32768.00 32767.00 FORMAT "%8.2" ECU_ADDRESS 0x5000583A /end MEASUREMENT
/begin MEASUREMENT DSCHED_DynPrio.FId_CJ135RvsChrgMeasS1B1 "dynamic priority / Dynamic priority of scheduled function identifier FId_CJ135RvsChrgMeasS1B1" SWORD DFC_OneToOne 1 100 -32768.00 32767.00 FORMAT "%8.2" ECU_ADDRESS 0x5000583C /end MEASUREMENT
/begin MEASUREMENT DSCHED_DynPrio.FId_CatHeatgColdStrtReq "dynamic priority / Dynamic priority of scheduled function identifier FId_CatHeatgColdStrtReq" SWORD DFC_OneToOne 1 100 -32768.00 32767.00 FORMAT "%8.2" ECU_ADDRESS 0x5000583E /end MEASUREMENT
/begin MEASUREMENT DSCHED_DynPrio.FId_CatHeatgWrmReq "dynamic priority / Dynamic priority of scheduled function identifier FId_CatHeatgWrmReq" SWORD DFC_OneToOne 1 100 -32768.00 32767.00 FORMAT "%8.2" ECU_ADDRESS 0x50005840 /end MEASUREMENT
/begin MEASUREMENT DSCHED_DynPrio.FId_EGSDO2SnsrMntdRelsS1B1 "dynamic priority / Dynamic priority of scheduled function identifier FId_EGSDO2SnsrMntdRelsS1B1" SWORD DFC_OneToOne 1 100 -32768.00 32767.00 FORMAT "%8.2" ECU_ADDRESS 0x50005842 /end MEASUREMENT
/begin MEASUREMENT DSCHED_DynPrio.FId_EGSDO2_LamOffsFastS1B1 "dynamic priority / Dynamic priority of scheduled function identifier FId_EGSDO2_LamOffsFastS1B1" SWORD DFC_OneToOne 1 100 -32768.00 32767.00 FORMAT "%8.2" ECU_ADDRESS 0x50005844 /end MEASUREMENT
/begin MEASUREMENT DSCHED_DynPrio.FId_MisfDetDnAdpnNv "dynamic priority / Dynamic priority of scheduled function identifier FId_MisfDetDnAdpnNv" SWORD DFC_OneToOne 1 100 -32768.00 32767.00 FORMAT "%8.2" ECU_ADDRESS 0x50005846 /end MEASUREMENT
/begin MEASUREMENT DSCHED_idxWTTAct "Next index for window time table processing" UWORD DINH_OneToOne 1 100 0.00 65535.00 FORMAT "%8.2" ECU_ADDRESS 0x6000570A /end MEASUREMENT
/begin MEASUREMENT DSCHED_PhysPrio.FId_Unused "physical priority / " UBYTE DFC_OneToOne 1 100 0.00 255.0 FORMAT "%5.1" ECU_ADDRESS 0x6000AA1E /end MEASUREMENT
/begin MEASUREMENT DSCHED_PhysPrio.FID_AFRA "physical priority / Physical priority of scheduled function identifier FID_AFRA" UBYTE DFC_OneToOne 1 100 0.00 255.0 FORMAT "%5.1" ECU_ADDRESS 0x6000AA1F /end MEASUREMENT
/begin MEASUREMENT DSCHED_PhysPrio.FID_AORA "physical priority / Physical priority of scheduled function identifier FID_AORA" UBYTE DFC_OneToOne 1 100 0.00 255.0 FORMAT "%5.1" ECU_ADDRESS 0x6000AA20 /end MEASUREMENT
/begin MEASUREMENT DSCHED_PhysPrio.FID_ATEH "physical priority / Physical priority of scheduled function identifier FID_ATEH" UBYTE DFC_OneToOne 1 100 0.00 255.0 FORMAT "%5.1" ECU_ADDRESS 0x6000AA21 /end MEASUREMENT
/begin MEASUREMENT DSCHED_PhysPrio.FID_ATEL "physical priority / Physical priority of scheduled function identifier FID_ATEL" UBYTE DFC_OneToOne 1 100 0.00 255.0 FORMAT "%5.1" ECU_ADDRESS 0x6000AA22 /end MEASUREMENT
/begin MEASUREMENT DSCHED_PhysPrio.FID_ATEN "physical priority / Physical priority of scheduled function identifier FID_ATEN" UBYTE DFC_OneToOne 1 100 0.00 255.0 FORMAT "%5.1" ECU_ADDRESS 0x6000AA23 /end MEASUREMENT
/begin MEASUREMENT DSCHED_PhysPrio.FId_EGSDCmnSeg1B1Parl "physical priority / Physical priority of scheduled function identifier FId_EGSDCmnSeg1B1Parl" UBYTE DFC_OneToOne 1 100 0.00 255.0 FORMAT "%5.1" ECU_ADDRESS 0x6000AA24 /end MEASUREMENT
/begin MEASUREMENT DSCHED_PhysPrio.FID_BLLRH "physical priority / Physical priority of scheduled function identifier FID_BLLRH" UBYTE DFC_OneToOne 1 100 0.00 255.0 FORMAT "%5.1" ECU_ADDRESS 0x6000AA25 /end MEASUREMENT
/begin MEASUREMENT DSCHED_PhysPrio.FID_BLLRKH "physical priority / Physical priority of scheduled function identifier FID_BLLRKH" UBYTE DFC_OneToOne 1 100 0.00 255.0 FORMAT "%5.1" ECU_ADDRESS 0x6000AA26 /end MEASUREMENT
/begin MEASUREMENT DSCHED_PhysPrio.FID_BPLSU "physical priority / Physical priority of scheduled function identifier FID_BPLSU" UBYTE DFC_OneToOne 1 100 0.00 255.0 FORMAT "%5.1" ECU_ADDRESS 0x6000AA27 /end MEASUREMENT
/begin MEASUREMENT DSCHED_PhysPrio.FId_CJ135RvsChrgMeasS1B1 "physical priority / Physical priority of scheduled function identifier FId_CJ135RvsChrgMeasS1B1" UBYTE DFC_OneToOne 1 100 0.00 255.0 FORMAT "%5.1" ECU_ADDRESS 0x6000AA28 /end MEASUREMENT
/begin MEASUREMENT DSCHED_PhysPrio.FId_CatHeatgColdStrtReq "physical priority / Physical priority of scheduled function identifier FId_CatHeatgColdStrtReq" UBYTE DFC_OneToOne 1 100 0.00 255.0 FORMAT "%5.1" ECU_ADDRESS 0x6000AA29 /end MEASUREMENT
/begin MEASUREMENT DSCHED_PhysPrio.FId_CatHeatgWrmReq "physical priority / Physical priority of scheduled function identifier FId_CatHeatgWrmReq" UBYTE DFC_OneToOne 1 100 0.00 255.0 FORMAT "%5.1" ECU_ADDRESS 0x6000AA2A /end MEASUREMENT
/begin MEASUREMENT DSCHED_PhysPrio.FId_EGSDO2SnsrMntdRelsS1B1 "physical priority / Physical priority of scheduled function identifier FId_EGSDO2SnsrMntdRelsS1B1" UBYTE DFC_OneToOne 1 100 0.00 255.0 FORMAT "%5.1" ECU_ADDRESS 0x6000AA2B /end MEASUREMENT
/begin MEASUREMENT DSCHED_PhysPrio.FId_EGSDO2_LamOffsFastS1B1 "physical priority / Physical priority of scheduled function identifier FId_EGSDO2_LamOffsFastS1B1" UBYTE DFC_OneToOne 1 100 0.00 255.0 FORMAT "%5.1" ECU_ADDRESS 0x6000AA2C /end MEASUREMENT
/begin MEASUREMENT DSCHED_PhysPrio.FId_MisfDetDnAdpnNv "physical priority / Physical priority of scheduled function identifier FId_MisfDetDnAdpnNv" UBYTE DFC_OneToOne 1 100 0.00 255.0 FORMAT "%5.1" ECU_ADDRESS 0x6000AA2D /end MEASUREMENT
/begin MEASUREMENT DSCHED_TiActv.FId_Unused "active counter / " UWORD DFC_OneToOne 1 100 0.00 65535.00 FORMAT "%8.2" ECU_ADDRESS 0x50005848 /end MEASUREMENT
/begin MEASUREMENT DSCHED_TiActv.FID_AFRA "active counter / Rate active time of scheduled function identifier FID_AFRA" UWORD DSCHED_Time200ms 1 100 0.00 13107.00 FORMAT "%8.2" ECU_ADDRESS 0x5000584A /end MEASUREMENT
/begin MEASUREMENT DSCHED_TiActv.FID_AORA "active counter / Rate active time of scheduled function identifier FID_AORA" UWORD DSCHED_Time200ms 1 100 0.00 13107.00 FORMAT "%8.2" ECU_ADDRESS 0x5000584C /end MEASUREMENT
/begin MEASUREMENT DSCHED_TiActv.FID_ATEH "active counter / Rate active time of scheduled function identifier FID_ATEH" UWORD DSCHED_Time200ms 1 100 0.00 13107.00 FORMAT "%8.2" ECU_ADDRESS 0x5000584E /end MEASUREMENT
/begin MEASUREMENT DSCHED_TiActv.FID_ATEL "active counter / Rate active time of scheduled function identifier FID_ATEL" UWORD DSCHED_Time200ms 1 100 0.00 13107.00 FORMAT "%8.2" ECU_ADDRESS 0x50005850 /end MEASUREMENT
/begin MEASUREMENT DSCHED_TiActv.FID_ATEN "active counter / Rate active time of scheduled function identifier FID_ATEN" UWORD DSCHED_Time200ms 1 100 0.00 13107.00 FORMAT "%8.2" ECU_ADDRESS 0x50005852 /end MEASUREMENT
/begin MEASUREMENT DSCHED_TiActv.FId_EGSDCmnSeg1B1Parl "active counter / Rate active time of scheduled function identifier FId_EGSDCmnSeg1B1Parl" UWORD DSCHED_Time200ms 1 100 0.00 13107.00 FORMAT "%8.2" ECU_ADDRESS 0x50005854 /end MEASUREMENT
/begin MEASUREMENT DSCHED_TiActv.FID_BLLRH "active counter / Rate active time of scheduled function identifier FID_BLLRH" UWORD DSCHED_Time200ms 1 100 0.00 13107.00 FORMAT "%8.2" ECU_ADDRESS 0x50005856 /end MEASUREMENT
/begin MEASUREMENT DSCHED_TiActv.FID_BLLRKH "active counter / Rate active time of scheduled function identifier FID_BLLRKH" UWORD DSCHED_Time200ms 1 100 0.00 13107.00 FORMAT "%8.2" ECU_ADDRESS 0x50005858 /end MEASUREMENT
/begin MEASUREMENT DSCHED_TiActv.FID_BPLSU "active counter / Rate active time of scheduled function identifier FID_BPLSU" UWORD DSCHED_Time200ms 1 100 0.00 13107.00 FORMAT "%8.2" ECU_ADDRESS 0x5000585A /end MEASUREMENT
/begin MEASUREMENT DSCHED_TiActv.FId_CJ135RvsChrgMeasS1B1 "active counter / Rate active time of scheduled function identifier FId_CJ135RvsChrgMeasS1B1" UWORD DSCHED_Time200ms 1 100 0.00 13107.00 FORMAT "%8.2" ECU_ADDRESS 0x5000585C /end MEASUREMENT
/begin MEASUREMENT DSCHED_TiActv.FId_CatHeatgColdStrtReq "active counter / Rate active time of scheduled function identifier FId_CatHeatgColdStrtReq" UWORD DSCHED_Time200ms 1 100 0.00 13107.00 FORMAT "%8.2" ECU_ADDRESS 0x5000585E /end MEASUREMENT
/begin MEASUREMENT DSCHED_TiActv.FId_CatHeatgWrmReq "active counter / Rate active time of scheduled function identifier FId_CatHeatgWrmReq" UWORD DSCHED_Time200ms 1 100 0.00 13107.00 FORMAT "%8.2" ECU_ADDRESS 0x50005860 /end MEASUREMENT
/begin MEASUREMENT DSCHED_TiActv.FId_EGSDO2SnsrMntdRelsS1B1 "active counter / Rate active time of scheduled function identifier FId_EGSDO2SnsrMntdRelsS1B1" UWORD DSCHED_Time200ms 1 100 0.00 13107.00 FORMAT "%8.2" ECU_ADDRESS 0x50005862 /end MEASUREMENT
/begin MEASUREMENT DSCHED_TiActv.FId_EGSDO2_LamOffsFastS1B1 "active counter / Rate active time of scheduled function identifier FId_EGSDO2_LamOffsFastS1B1" UWORD DSCHED_Time200ms 1 100 0.00 13107.00 FORMAT "%8.2" ECU_ADDRESS 0x50005864 /end MEASUREMENT
/begin MEASUREMENT DSCHED_TiActv.FId_MisfDetDnAdpnNv "active counter / Rate active time of scheduled function identifier FId_MisfDetDnAdpnNv" UWORD DSCHED_Time200ms 1 100 0.00 13107.00 FORMAT "%8.2" ECU_ADDRESS 0x50005866 /end MEASUREMENT
/begin MEASUREMENT DSCHED_TiPas.FId_Unused "passive counter / " UWORD DFC_OneToOne 1 100 0.00 65535.00 FORMAT "%8.2" ECU_ADDRESS 0x50005868 /end MEASUREMENT
/begin MEASUREMENT DSCHED_TiPas.FID_AFRA "passive counter / Rate passive time of scheduled function identifier FID_AFRA" UWORD DSCHED_Time200ms 1 100 0.00 13107.00 FORMAT "%8.2" ECU_ADDRESS 0x5000586A /end MEASUREMENT
/begin MEASUREMENT DSCHED_TiPas.FID_AORA "passive counter / Rate passive time of scheduled function identifier FID_AORA" UWORD DSCHED_Time200ms 1 100 0.00 13107.00 FORMAT "%8.2" ECU_ADDRESS 0x5000586C /end MEASUREMENT
/begin MEASUREMENT DSCHED_TiPas.FID_ATEH "passive counter / Rate passive time of scheduled function identifier FID_ATEH" UWORD DSCHED_Time200ms 1 100 0.00 13107.00 FORMAT "%8.2" ECU_ADDRESS 0x5000586E /end MEASUREMENT
/begin MEASUREMENT DSCHED_TiPas.FID_ATEL "passive counter / Rate passive time of scheduled function identifier FID_ATEL" UWORD DSCHED_Time200ms 1 100 0.00 13107.00 FORMAT "%8.2" ECU_ADDRESS 0x50005870 /end MEASUREMENT
/begin MEASUREMENT DSCHED_TiPas.FID_ATEN "passive counter / Rate passive time of scheduled function identifier FID_ATEN" UWORD DSCHED_Time200ms 1 100 0.00 13107.00 FORMAT "%8.2" ECU_ADDRESS 0x50005872 /end MEASUREMENT
/begin MEASUREMENT DSCHED_TiPas.FId_EGSDCmnSeg1B1Parl "passive counter / Rate passive time of scheduled function identifier FId_EGSDCmnSeg1B1Parl" UWORD DSCHED_Time200ms 1 100 0.00 13107.00 FORMAT "%8.2" ECU_ADDRESS 0x50005874 /end MEASUREMENT
/begin MEASUREMENT DSCHED_TiPas.FID_BLLRH "passive counter / Rate passive time of scheduled function identifier FID_BLLRH" UWORD DSCHED_Time200ms 1 100 0.00 13107.00 FORMAT "%8.2" ECU_ADDRESS 0x50005876 /end MEASUREMENT
/begin MEASUREMENT DSCHED_TiPas.FID_BLLRKH "passive counter / Rate passive time of scheduled function identifier FID_BLLRKH" UWORD DSCHED_Time200ms 1 100 0.00 13107.00 FORMAT "%8.2" ECU_ADDRESS 0x50005878 /end MEASUREMENT
/begin MEASUREMENT DSCHED_TiPas.FID_BPLSU "passive counter / Rate passive time of scheduled function identifier FID_BPLSU" UWORD DSCHED_Time200ms 1 100 0.00 13107.00 FORMAT "%8.2" ECU_ADDRESS 0x5000587A /end MEASUREMENT
/begin MEASUREMENT DSCHED_TiPas.FId_CJ135RvsChrgMeasS1B1 "passive counter / Rate passive time of scheduled function identifier FId_CJ135RvsChrgMeasS1B1" UWORD DSCHED_Time200ms 1 100 0.00 13107.00 FORMAT "%8.2" ECU_ADDRESS 0x5000587C /end MEASUREMENT
/begin MEASUREMENT DSCHED_TiPas.FId_CatHeatgColdStrtReq "passive counter / Rate passive time of scheduled function identifier FId_CatHeatgColdStrtReq" UWORD DSCHED_Time200ms 1 100 0.00 13107.00 FORMAT "%8.2" ECU_ADDRESS 0x5000587E /end MEASUREMENT
/begin MEASUREMENT DSCHED_TiPas.FId_CatHeatgWrmReq "passive counter / Rate passive time of scheduled function identifier FId_CatHeatgWrmReq" UWORD DSCHED_Time200ms 1 100 0.00 13107.00 FORMAT "%8.2" ECU_ADDRESS 0x50005880 /end MEASUREMENT
/begin MEASUREMENT DSCHED_TiPas.FId_EGSDO2SnsrMntdRelsS1B1 "passive counter / Rate passive time of scheduled function identifier FId_EGSDO2SnsrMntdRelsS1B1" UWORD DSCHED_Time200ms 1 100 0.00 13107.00 FORMAT "%8.2" ECU_ADDRESS 0x50005882 /end MEASUREMENT
/begin MEASUREMENT DSCHED_TiPas.FId_EGSDO2_LamOffsFastS1B1 "passive counter / Rate passive time of scheduled function identifier FId_EGSDO2_LamOffsFastS1B1" UWORD DSCHED_Time200ms 1 100 0.00 13107.00 FORMAT "%8.2" ECU_ADDRESS 0x50005884 /end MEASUREMENT
/begin MEASUREMENT DSCHED_TiPas.FId_MisfDetDnAdpnNv "passive counter / Rate passive time of scheduled function identifier FId_MisfDetDnAdpnNv" UWORD DSCHED_Time200ms 1 100 0.00 13107.00 FORMAT "%8.2" ECU_ADDRESS 0x50005886 /end MEASUREMENT
/begin MEASUREMENT DSCHED_tiWTT "engine on time for window time table handling" UWORD DSCHED_Time100ms 1 100 0.00 6553.500 FORMAT "%8.3" ECU_ADDRESS 0x60005708 /end MEASUREMENT
/begin MEASUREMENT DSCHED_VirtDynPrio.FId_Unused "virtual dynamic priority / " SWORD DFC_OneToOne 1 100 -32768.00 32767.00 FORMAT "%8.2" ECU_ADDRESS 0x600054C8 /end MEASUREMENT
/begin MEASUREMENT DSCHED_VirtDynPrio.FID_AFRA "virtual dynamic priority / Virtual dynamic priority of scheduled function identifier FID_AFRA" SWORD DFC_OneToOne 1 100 -32768.00 32767.00 FORMAT "%8.2" ECU_ADDRESS 0x600054CA /end MEASUREMENT
/begin MEASUREMENT DSCHED_VirtDynPrio.FID_AORA "virtual dynamic priority / Virtual dynamic priority of scheduled function identifier FID_AORA" SWORD DFC_OneToOne 1 100 -32768.00 32767.00 FORMAT "%8.2" ECU_ADDRESS 0x600054CC /end MEASUREMENT
/begin MEASUREMENT DSCHED_VirtDynPrio.FID_ATEH "virtual dynamic priority / Virtual dynamic priority of scheduled function identifier FID_ATEH" SWORD DFC_OneToOne 1 100 -32768.00 32767.00 FORMAT "%8.2" ECU_ADDRESS 0x600054CE /end MEASUREMENT
/begin MEASUREMENT DSCHED_VirtDynPrio.FID_ATEL "virtual dynamic priority / Virtual dynamic priority of scheduled function identifier FID_ATEL" SWORD DFC_OneToOne 1 100 -32768.00 32767.00 FORMAT "%8.2" ECU_ADDRESS 0x600054D0 /end MEASUREMENT
/begin MEASUREMENT DSCHED_VirtDynPrio.FID_ATEN "virtual dynamic priority / Virtual dynamic priority of scheduled function identifier FID_ATEN" SWORD DFC_OneToOne 1 100 -32768.00 32767.00 FORMAT "%8.2" ECU_ADDRESS 0x600054D2 /end MEASUREMENT
/begin MEASUREMENT DSCHED_VirtDynPrio.FId_EGSDCmnSeg1B1Parl "virtual dynamic priority / Virtual dynamic priority of scheduled function identifier FId_EGSDCmnSeg1B1Parl" SWORD DFC_OneToOne 1 100 -32768.00 32767.00 FORMAT "%8.2" ECU_ADDRESS 0x600054D4 /end MEASUREMENT
/begin MEASUREMENT DSCHED_VirtDynPrio.FID_BLLRH "virtual dynamic priority / Virtual dynamic priority of scheduled function identifier FID_BLLRH" SWORD DFC_OneToOne 1 100 -32768.00 32767.00 FORMAT "%8.2" ECU_ADDRESS 0x600054D6 /end MEASUREMENT
/begin MEASUREMENT DSCHED_VirtDynPrio.FID_BLLRKH "virtual dynamic priority / Virtual dynamic priority of scheduled function identifier FID_BLLRKH" SWORD DFC_OneToOne 1 100 -32768.00 32767.00 FORMAT "%8.2" ECU_ADDRESS 0x600054D8 /end MEASUREMENT
/begin MEASUREMENT DSCHED_VirtDynPrio.FID_BPLSU "virtual dynamic priority / Virtual dynamic priority of scheduled function identifier FID_BPLSU" SWORD DFC_OneToOne 1 100 -32768.00 32767.00 FORMAT "%8.2" ECU_ADDRESS 0x600054DA /end MEASUREMENT
/begin MEASUREMENT DSCHED_VirtDynPrio.FId_CJ135RvsChrgMeasS1B1 "virtual dynamic priority / Virtual dynamic priority of scheduled function identifier FId_CJ135RvsChrgMeasS1B1" SWORD DFC_OneToOne 1 100 -32768.00 32767.00 FORMAT "%8.2" ECU_ADDRESS 0x600054DC /end MEASUREMENT
/begin MEASUREMENT DSCHED_VirtDynPrio.FId_CatHeatgColdStrtReq "virtual dynamic priority / Virtual dynamic priority of scheduled function identifier FId_CatHeatgColdStrtReq" SWORD DFC_OneToOne 1 100 -32768.00 32767.00 FORMAT "%8.2" ECU_ADDRESS 0x600054DE /end MEASUREMENT
/begin MEASUREMENT DSCHED_VirtDynPrio.FId_CatHeatgWrmReq "virtual dynamic priority / Virtual dynamic priority of scheduled function identifier FId_CatHeatgWrmReq" SWORD DFC_OneToOne 1 100 -32768.00 32767.00 FORMAT "%8.2" ECU_ADDRESS 0x600054E0 /end MEASUREMENT
/begin MEASUREMENT DSCHED_VirtDynPrio.FId_EGSDO2SnsrMntdRelsS1B1 "virtual dynamic priority / Virtual dynamic priority of scheduled function identifier FId_EGSDO2SnsrMntdRelsS1B1" SWORD DFC_OneToOne 1 100 -32768.00 32767.00 FORMAT "%8.2" ECU_ADDRESS 0x600054E2 /end MEASUREMENT
/begin MEASUREMENT DSCHED_VirtDynPrio.FId_EGSDO2_LamOffsFastS1B1 "virtual dynamic priority / Virtual dynamic priority of scheduled function identifier FId_EGSDO2_LamOffsFastS1B1" SWORD DFC_OneToOne 1 100 -32768.00 32767.00 FORMAT "%8.2" ECU_ADDRESS 0x600054E4 /end MEASUREMENT
/begin MEASUREMENT DSCHED_VirtDynPrio.FId_MisfDetDnAdpnNv "virtual dynamic priority / Virtual dynamic priority of scheduled function identifier FId_MisfDetDnAdpnNv" SWORD DFC_OneToOne 1 100 -32768.00 32767.00 FORMAT "%8.2" ECU_ADDRESS 0x600054E6 /end MEASUREMENT
/begin MEASUREMENT DSCHED_VirtPhysPrio.FId_Unused "virtual physical priority / " UBYTE DFC_OneToOne 1 100 0.00 255.0 FORMAT "%5.1" ECU_ADDRESS 0x6000AA0E /end MEASUREMENT
/begin MEASUREMENT DSCHED_VirtPhysPrio.FID_AFRA "virtual physical priority / Virtual physical priority of scheduled function identifier FID_AFRA" UBYTE DFC_OneToOne 1 100 0.00 255.0 FORMAT "%5.1" ECU_ADDRESS 0x6000AA0F /end MEASUREMENT
/begin MEASUREMENT DSCHED_VirtPhysPrio.FID_AORA "virtual physical priority / Virtual physical priority of scheduled function identifier FID_AORA" UBYTE DFC_OneToOne 1 100 0.00 255.0 FORMAT "%5.1" ECU_ADDRESS 0x6000AA10 /end MEASUREMENT
/begin MEASUREMENT DSCHED_VirtPhysPrio.FID_ATEH "virtual physical priority / Virtual physical priority of scheduled function identifier FID_ATEH" UBYTE DFC_OneToOne 1 100 0.00 255.0 FORMAT "%5.1" ECU_ADDRESS 0x6000AA11 /end MEASUREMENT
/begin MEASUREMENT DSCHED_VirtPhysPrio.FID_ATEL "virtual physical priority / Virtual physical priority of scheduled function identifier FID_ATEL" UBYTE DFC_OneToOne 1 100 0.00 255.0 FORMAT "%5.1" ECU_ADDRESS 0x6000AA12 /end MEASUREMENT
/begin MEASUREMENT DSCHED_VirtPhysPrio.FID_ATEN "virtual physical priority / Virtual physical priority of scheduled function identifier FID_ATEN" UBYTE DFC_OneToOne 1 100 0.00 255.0 FORMAT "%5.1" ECU_ADDRESS 0x6000AA13 /end MEASUREMENT
/begin MEASUREMENT DSCHED_VirtPhysPrio.FId_EGSDCmnSeg1B1Parl "virtual physical priority / Virtual physical priority of scheduled function identifier FId_EGSDCmnSeg1B1Parl" UBYTE DFC_OneToOne 1 100 0.00 255.0 FORMAT "%5.1" ECU_ADDRESS 0x6000AA14 /end MEASUREMENT
/begin MEASUREMENT DSCHED_VirtPhysPrio.FID_BLLRH "virtual physical priority / Virtual physical priority of scheduled function identifier FID_BLLRH" UBYTE DFC_OneToOne 1 100 0.00 255.0 FORMAT "%5.1" ECU_ADDRESS 0x6000AA15 /end MEASUREMENT
/begin MEASUREMENT DSCHED_VirtPhysPrio.FID_BLLRKH "virtual physical priority / Virtual physical priority of scheduled function identifier FID_BLLRKH" UBYTE DFC_OneToOne 1 100 0.00 255.0 FORMAT "%5.1" ECU_ADDRESS 0x6000AA16 /end MEASUREMENT
/begin MEASUREMENT DSCHED_VirtPhysPrio.FID_BPLSU "virtual physical priority / Virtual physical priority of scheduled function identifier FID_BPLSU" UBYTE DFC_OneToOne 1 100 0.00 255.0 FORMAT "%5.1" ECU_ADDRESS 0x6000AA17 /end MEASUREMENT
/begin MEASUREMENT DSCHED_VirtPhysPrio.FId_CJ135RvsChrgMeasS1B1 "virtual physical priority / Virtual physical priority of scheduled function identifier FId_CJ135RvsChrgMeasS1B1" UBYTE DFC_OneToOne 1 100 0.00 255.0 FORMAT "%5.1" ECU_ADDRESS 0x6000AA18 /end MEASUREMENT
/begin MEASUREMENT DSCHED_VirtPhysPrio.FId_CatHeatgColdStrtReq "virtual physical priority / Virtual physical priority of scheduled function identifier FId_CatHeatgColdStrtReq" UBYTE DFC_OneToOne 1 100 0.00 255.0 FORMAT "%5.1" ECU_ADDRESS 0x6000AA19 /end MEASUREMENT
/begin MEASUREMENT DSCHED_VirtPhysPrio.FId_CatHeatgWrmReq "virtual physical priority / Virtual physical priority of scheduled function identifier FId_CatHeatgWrmReq" UBYTE DFC_OneToOne 1 100 0.00 255.0 FORMAT "%5.1" ECU_ADDRESS 0x6000AA1A /end MEASUREMENT
/begin MEASUREMENT DSCHED_VirtPhysPrio.FId_EGSDO2SnsrMntdRelsS1B1 "virtual physical priority / Virtual physical priority of scheduled function identifier FId_EGSDO2SnsrMntdRelsS1B1" UBYTE DFC_OneToOne 1 100 0.00 255.0 FORMAT "%5.1" ECU_ADDRESS 0x6000AA1B /end MEASUREMENT
/begin MEASUREMENT DSCHED_VirtPhysPrio.FId_EGSDO2_LamOffsFastS1B1 "virtual physical priority / Virtual physical priority of scheduled function identifier FId_EGSDO2_LamOffsFastS1B1" UBYTE DFC_OneToOne 1 100 0.00 255.0 FORMAT "%5.1" ECU_ADDRESS 0x6000AA1C /end MEASUREMENT
/begin MEASUREMENT DSCHED_VirtPhysPrio.FId_MisfDetDnAdpnNv "virtual physical priority / Virtual physical priority of scheduled function identifier FId_MisfDetDnAdpnNv" UBYTE DFC_OneToOne 1 100 0.00 255.0 FORMAT "%5.1" ECU_ADDRESS 0x6000AA1D /end MEASUREMENT
/begin FUNCTION DPS_Tmp "100.1.0   standard powerstage diagnosis" /begin DEF_CHARACTERISTIC DPSWATCHINDEX THP TVP /end DEF_CHARACTERISTIC /begin IN_MEASUREMENT B_PmdInit_msg /end IN_MEASUREMENT
 /begin LOC_MEASUREMENT dps_error dps_errStat dps_errStat_sum_rec dps_errStat_sum_ver dps_index dps_recoveryTime dps_state dps_verifyTime /end LOC_MEASUREMENT
 FUNCTION_VERSION "100.1.0" /end FUNCTION
/begin FUNCTION DRIVE_PRDS "16.3.0    Diagnostic Recorder for Evaluation an Verification - Project Dataset"
 /begin DEF_CHARACTERISTIC DRIVE_Clear_Arbitrary_C DRIVE_Clear_BadEngStrt_C DRIVE_Clear_C DRIVE_Clear_EngStal_C DRIVE_CurTrgMode_C DRIVE_numBadStrtDCTIDLst_CA DRIVE_numDCTIDLst_CA DRIVE_numEngStalDCTIDLst_CA DRIVE_numSysId_C DRIVE_PRDS_Bnk0Blk00_Sig_CA DRIVE_PRDS_Bnk0Blk01_Sig_CA DRIVE_PRDS_Bnk0Blk02_Sig_CA DRIVE_PRDS_Bnk0Blk04_Sig_CA DRIVE_PRDS_Bnk0Blk05_Sig_CA DRIVE_PRDS_Bnk0Blk06_Sig_CA DRIVE_PRDS_Bnk0Blk07_Sig_CA DRIVE_PRDS_Bnk0Blk09_Sig_CA DRIVE_PRDS_Bnk0Blk0a_Sig_CA DRIVE_PRDS_Bnk0Blk0b_Sig_CA DRIVE_PRDS_Bnk0Blk0c_Sig_CA DRIVE_PRDS_Bnk0Blk0d_Sig_CA DRIVE_PRDS_Bnk0Blk0e_Sig_CA DRIVE_PRDS_Bnk0Blk0f_Sig_CA DRIVE_PRDS_Bnk0Blk10_Sig_CA DRIVE_PRDS_Bnk0Blk11_Sig_CA DRIVE_PRDS_Bnk0Blk12_Sig_CA DRIVE_PRDS_Bnk0Blk13_Sig_CA DRIVE_PRDS_Bnk0Blk14_Sig_CA DRIVE_PRDS_Bnk0Blk15_Sig_CA DRIVE_PRDS_Bnk0Blk16_Sig_CA DRIVE_PRDS_Bnk0Blk17_Sig_CA DRIVE_PRDS_Bnk0Blk18_Sig_CA DRIVE_PRDS_Bnk0Blk19_Sig_CA DRIVE_PRDS_Bnk0Blk1a_Sig_CA DRIVE_PRDS_Bnk0Blk1b_Sig_CA DRIVE_PRDS_Bnk1Blk00_Sig_CA DRIVE_PRDS_Bnk1Blk02_Sig_CA DRIVE_PRDS_Bnk1Blk03_Sig_CA DRIVE_PRDS_Bnk1Blk04_Sig_CA DRIVE_PRDS_Bnk1Blk05_Sig_CA Drive_stClrData_Arbitrary_C Drive_stClrData_BadEngStrt_C Drive_stClrData_C Drive_stClrData_EngStal_C DRIVE_swtForcedRecCond_C DRIVE_swtForcedTrg_C DRIVE_swtNPos_C DRIVE_tiEngStal_C DRIVE_tiEngStrtBad_CUR DRIVE_vEngStal_C /end DEF_CHARACTERISTIC
 /begin IN_MEASUREMENT CEngDsT_t Clth_st CoEng_st CoEng_stStalEngReas CoEng_tiNormal DSMAUX_stDsmClrActv DSM_TripChgFinshd EGSDCmn_stLamGenrParlB1 Epm_nEng Gbx_stNPos I14229_stSuppRst T15_st VehV_v /end IN_MEASUREMENT
 /begin OUT_MEASUREMENT DRIVE_numDTCFrz DRIVE_stAOBSTrg DRIVE_stBadEngStrt DRIVE_stCrLon DRIVE_stCurTrgMode DRIVE_stEngNoStrt DRIVE_stEngNStrt DRIVE_stHardToStrt DRIVE_stStalAftEngStrt /end OUT_MEASUREMENT
 /begin LOC_MEASUREMENT DRIVE_AobsFrqTmr DRIVE_AobsTmrCnt DRIVE_AOBS_Mode DRIVE_AOBS_stPrmSet Drive_DSMFaults DRIVE_FirstLayerResult Drive_idxDFC DRIVE_numAOBSDCTIDLst_defined DRIVE_numAOBSDCTIDLst_record Drive_numPCode DRIVE_PRDS_Bnk0Blk00_idx_NV DRIVE_PRDS_Bnk0Blk00_Rcrd_NV DRIVE_PRDS_Bnk0Blk01_idx_NV DRIVE_PRDS_Bnk0Blk01_Rcrd_NV DRIVE_PRDS_Bnk0Blk02_idx_NV DRIVE_PRDS_Bnk0Blk02_Rcrd_NV DRIVE_PRDS_Bnk0Blk04_idx_NV DRIVE_PRDS_Bnk0Blk04_Rcrd_NV DRIVE_PRDS_Bnk0Blk05_idx_NV DRIVE_PRDS_Bnk0Blk05_Rcrd_NV DRIVE_PRDS_Bnk0Blk06_idx_NV DRIVE_PRDS_Bnk0Blk06_Rcrd_NV DRIVE_PRDS_Bnk0Blk07_idx_NV DRIVE_PRDS_Bnk0Blk07_Rcrd_NV DRIVE_PRDS_Bnk0Blk09_idx_NV DRIVE_PRDS_Bnk0Blk09_Rcrd_NV DRIVE_PRDS_Bnk0Blk0a_idx_NV DRIVE_PRDS_Bnk0Blk0a_Rcrd_NV DRIVE_PRDS_Bnk0Blk0b_idx_NV DRIVE_PRDS_Bnk0Blk0b_Rcrd_NV DRIVE_PRDS_Bnk0Blk0c_idx_NV DRIVE_PRDS_Bnk0Blk0c_Rcrd_NV DRIVE_PRDS_Bnk0Blk0d_idx_NV DRIVE_PRDS_Bnk0Blk0d_Rcrd_NV DRIVE_PRDS_Bnk0Blk0e_idx_NV DRIVE_PRDS_Bnk0Blk0e_Rcrd_NV DRIVE_PRDS_Bnk0Blk0f_idx_NV DRIVE_PRDS_Bnk0Blk0f_Rcrd_NV DRIVE_PRDS_Bnk0Blk10_idx_NV DRIVE_PRDS_Bnk0Blk10_Rcrd_NV DRIVE_PRDS_Bnk0Blk11_idx_NV DRIVE_PRDS_Bnk0Blk11_Rcrd_NV DRIVE_PRDS_Bnk0Blk12_idx_NV DRIVE_PRDS_Bnk0Blk12_Rcrd_NV DRIVE_PRDS_Bnk0Blk13_idx_NV DRIVE_PRDS_Bnk0Blk13_Rcrd_NV DRIVE_PRDS_Bnk0Blk14_idx_NV DRIVE_PRDS_Bnk0Blk14_Rcrd_NV DRIVE_PRDS_Bnk0Blk15_idx_NV DRIVE_PRDS_Bnk0Blk15_Rcrd_NV DRIVE_PRDS_Bnk0Blk16_idx_NV DRIVE_PRDS_Bnk0Blk16_Rcrd_NV DRIVE_PRDS_Bnk0Blk17_idx_NV DRIVE_PRDS_Bnk0Blk17_Rcrd_NV DRIVE_PRDS_Bnk0Blk18_idx_NV DRIVE_PRDS_Bnk0Blk18_Rcrd_NV DRIVE_PRDS_Bnk0Blk19_idx_NV DRIVE_PRDS_Bnk0Blk19_Rcrd_NV DRIVE_PRDS_Bnk0Blk1a_idx_NV DRIVE_PRDS_Bnk0Blk1a_Rcrd_NV DRIVE_PRDS_Bnk0Blk1b_idx_NV DRIVE_PRDS_Bnk0Blk1b_Rcrd_NV DRIVE_PRDS_Bnk1Blk00_idx DRIVE_PRDS_Bnk1Blk00_idx_NV DRIVE_PRDS_Bnk1Blk00_Rcrd DRIVE_PRDS_Bnk1Blk00_Rcrd_NV DRIVE_PRDS_Bnk1Blk02_idx DRIVE_PRDS_Bnk1Blk02_idx_NV DRIVE_PRDS_Bnk1Blk02_Rcrd DRIVE_PRDS_Bnk1Blk02_Rcrd_NV DRIVE_PRDS_Bnk1Blk03_idx DRIVE_PRDS_Bnk1Blk03_idx_NV DRIVE_PRDS_Bnk1Blk03_Rcrd DRIVE_PRDS_Bnk1Blk03_Rcrd_NV DRIVE_PRDS_Bnk1Blk04_idx DRIVE_PRDS_Bnk1Blk04_idx_NV DRIVE_PRDS_Bnk1Blk04_Rcrd DRIVE_PRDS_Bnk1Blk04_Rcrd_NV DRIVE_PRDS_Bnk1Blk05_idx DRIVE_PRDS_Bnk1Blk05_idx_NV DRIVE_PRDS_Bnk1Blk05_Rcrd DRIVE_PRDS_Bnk1Blk05_Rcrd_NV DRIVE_PRDS_Bnk2Blk00_idx DRIVE_PRDS_Bnk2Blk00_idx_NV DRIVE_PRDS_Bnk2Blk00_Rcrd DRIVE_PRDS_Bnk2Blk00_Rcrd_NV DRIVE_PRDS_Bnk2Blk02_idx DRIVE_PRDS_Bnk2Blk02_idx_NV DRIVE_PRDS_Bnk2Blk02_Rcrd DRIVE_PRDS_Bnk2Blk02_Rcrd_NV DRIVE_PRDS_Bnk2Blk03_idx DRIVE_PRDS_Bnk2Blk03_idx_NV DRIVE_PRDS_Bnk2Blk03_Rcrd DRIVE_PRDS_Bnk2Blk03_Rcrd_NV DRIVE_PRDS_Bnk2Blk04_idx DRIVE_PRDS_Bnk2Blk04_idx_NV DRIVE_PRDS_Bnk2Blk04_Rcrd DRIVE_PRDS_Bnk2Blk04_Rcrd_NV DRIVE_PRDS_Bnk2Blk05_idx DRIVE_PRDS_Bnk2Blk05_idx_NV DRIVE_PRDS_Bnk2Blk05_Rcrd DRIVE_PRDS_Bnk2Blk05_Rcrd_NV DRIVE_PRDS_Bnk3Blk00_idx DRIVE_PRDS_Bnk3Blk00_idx_NV DRIVE_PRDS_Bnk3Blk00_Rcrd DRIVE_PRDS_Bnk3Blk00_Rcrd_NV DRIVE_PRDS_Bnk3Blk00_RecMsk DRIVE_PRDS_Bnk3Blk00_Sig DRIVE_PRDS_Bnk3Blk01_idx DRIVE_PRDS_Bnk3Blk01_idx_NV DRIVE_PRDS_Bnk3Blk01_Rcrd DRIVE_PRDS_Bnk3Blk01_Rcrd_NV DRIVE_PRDS_Bnk3Blk01_RecMsk DRIVE_PRDS_Bnk3Blk01_Sig DRIVE_ScndLyrExpRes_raw DRIVE_SecondLayerExpMsk DRIVE_SecondLayerExpResults DRIVE_stArbitraryTrgFrz DRIVE_stArbitraryTrg_mp DRIVE_stBadStrtTrgFrz DRIVE_stEngStalTrgFrz DRIVE_stEngStalTrg_mp DRIVE_stEngStrt DRIVE_stRingBuf_Arbitrary_mp DRIVE_stRingBuf_BadEngStrt_mp DRIVE_stRingBuf_EngStal_mp DRIVE_stRingBuf_mp DRIVE_stStalAftEngStrt_mp DRIVE_stStore_Arbitrary_mp DRIVE_stStore_BadEngStrt_mp DRIVE_stStore_EngStal_mp DRIVE_stStore_mp DRIVE_stTimeLapse DRIVE_stTrgSigFrz DRIVE_ThirdLayerExpResults DRIVE_ThirdLayerExpResults_old DRIVE_ThrdLyrCntrRes_raw DRIVE_TriggerSignal DRIVE_TriggerSignal_Arbitrary DRIVE_TriggerSignal_BadEngStrt DRIVE_TriggerSignal_EngStal /end LOC_MEASUREMENT
 FUNCTION_VERSION "16.3.0" /end FUNCTION
/begin FUNCTION DSCHED_Cal "30000.2.0 Diagnostic Scheduler Calibration"
 /begin DEF_CHARACTERISTIC DSCHED_AsgnCheck.FID_AFRA_C DSCHED_AsgnCheck.FID_AORA_C DSCHED_AsgnCheck.FID_ATEH_C DSCHED_AsgnCheck.FID_ATEL_C DSCHED_AsgnCheck.FID_ATEN_C DSCHED_AsgnCheck.FId_EGSDCmnSeg1B1Parl_C DSCHED_AsgnCheck.FID_BLLRH_C DSCHED_AsgnCheck.FID_BLLRKH_C DSCHED_AsgnCheck.FID_BPLSU_C DSCHED_AsgnCheck.FId_CJ135RvsChrgMeasS1B1_C DSCHED_AsgnCheck.FId_CatHeatgColdStrtReq_C DSCHED_AsgnCheck.FId_CatHeatgWrmReq_C DSCHED_AsgnCheck.FId_EGSDO2SnsrMntdRelsS1B1_C DSCHED_AsgnCheck.FId_EGSDO2_LamOffsFastS1B1_C DSCHED_AsgnCheck.FId_MisfDetDnAdpnNv_C DSCHED_BsPrio.FID_AFRA_C DSCHED_BsPrio.FID_AORA_C DSCHED_BsPrio.FID_ATEH_C DSCHED_BsPrio.FID_ATEL_C DSCHED_BsPrio.FID_ATEN_C DSCHED_BsPrio.FId_EGSDCmnSeg1B1Parl_C DSCHED_BsPrio.FID_BLLRH_C DSCHED_BsPrio.FID_BLLRKH_C DSCHED_BsPrio.FID_BPLSU_C DSCHED_BsPrio.FId_CJ135RvsChrgMeasS1B1_C DSCHED_BsPrio.FId_CatHeatgColdStrtReq_C DSCHED_BsPrio.FId_CatHeatgWrmReq_C DSCHED_BsPrio.FId_EGSDO2SnsrMntdRelsS1B1_C DSCHED_BsPrio.FId_EGSDO2_LamOffsFastS1B1_C DSCHED_BsPrio.FId_MisfDetDnAdpnNv_C DSCHED_FacPhys.FID_AFRA_C DSCHED_FacPhys.FID_AORA_C DSCHED_FacPhys.FID_ATEH_C DSCHED_FacPhys.FID_ATEL_C DSCHED_FacPhys.FID_ATEN_C DSCHED_FacPhys.FId_EGSDCmnSeg1B1Parl_C DSCHED_FacPhys.FID_BLLRH_C DSCHED_FacPhys.FID_BLLRKH_C DSCHED_FacPhys.FID_BPLSU_C DSCHED_FacPhys.FId_CJ135RvsChrgMeasS1B1_C DSCHED_FacPhys.FId_CatHeatgColdStrtReq_C DSCHED_FacPhys.FId_CatHeatgWrmReq_C DSCHED_FacPhys.FId_EGSDO2SnsrMntdRelsS1B1_C DSCHED_FacPhys.FId_EGSDO2_LamOffsFastS1B1_C DSCHED_FacPhys.FId_MisfDetDnAdpnNv_C DSCHED_idxWTTEnd_C DSCHED_idxWTTStrt_C DSCHED_JmpActvPrio.FID_AFRA_C DSCHED_JmpActvPrio.FID_AORA_C DSCHED_JmpActvPrio.FID_ATEH_C DSCHED_JmpActvPrio.FID_ATEL_C DSCHED_JmpActvPrio.FID_ATEN_C DSCHED_JmpActvPrio.FId_EGSDCmnSeg1B1Parl_C DSCHED_JmpActvPrio.FID_BLLRH_C DSCHED_JmpActvPrio.FID_BLLRKH_C DSCHED_JmpActvPrio.FID_BPLSU_C DSCHED_JmpActvPrio.FId_CJ135RvsChrgMeasS1B1_C DSCHED_JmpActvPrio.FId_CatHeatgColdStrtReq_C DSCHED_JmpActvPrio.FId_CatHeatgWrmReq_C DSCHED_JmpActvPrio.FId_EGSDO2SnsrMntdRelsS1B1_C DSCHED_JmpActvPrio.FId_EGSDO2_LamOffsFastS1B1_C DSCHED_JmpActvPrio.FId_MisfDetDnAdpnNv_C DSCHED_SetPointRateActv.FID_AFRA_C DSCHED_SetPointRateActv.FID_AORA_C DSCHED_SetPointRateActv.FID_ATEH_C DSCHED_SetPointRateActv.FID_ATEL_C DSCHED_SetPointRateActv.FID_ATEN_C DSCHED_SetPointRateActv.FId_EGSDCmnSeg1B1Parl_C DSCHED_SetPointRateActv.FID_BLLRH_C DSCHED_SetPointRateActv.FID_BLLRKH_C DSCHED_SetPointRateActv.FID_BPLSU_C DSCHED_SetPointRateActv.FId_CJ135RvsChrgMeasS1B1_C DSCHED_SetPointRateActv.FId_CatHeatgColdStrtReq_C DSCHED_SetPointRateActv.FId_CatHeatgWrmReq_C DSCHED_SetPointRateActv.FId_EGSDO2SnsrMntdRelsS1B1_C DSCHED_SetPointRateActv.FId_EGSDO2_LamOffsFastS1B1_C DSCHED_SetPointRateActv.FId_MisfDetDnAdpnNv_C DSCHED_SetPointRatePas.FID_AFRA_C DSCHED_SetPointRatePas.FID_AORA_C DSCHED_SetPointRatePas.FID_ATEH_C DSCHED_SetPointRatePas.FID_ATEL_C DSCHED_SetPointRatePas.FID_ATEN_C DSCHED_SetPointRatePas.FId_EGSDCmnSeg1B1Parl_C DSCHED_SetPointRatePas.FID_BLLRH_C DSCHED_SetPointRatePas.FID_BLLRKH_C DSCHED_SetPointRatePas.FID_BPLSU_C DSCHED_SetPointRatePas.FId_CJ135RvsChrgMeasS1B1_C DSCHED_SetPointRatePas.FId_CatHeatgColdStrtReq_C DSCHED_SetPointRatePas.FId_CatHeatgWrmReq_C DSCHED_SetPointRatePas.FId_EGSDO2SnsrMntdRelsS1B1_C DSCHED_SetPointRatePas.FId_EGSDO2_LamOffsFastS1B1_C DSCHED_SetPointRatePas.FId_MisfDetDnAdpnNv_C DSCHED_tiWTT_CA DSCHED_UpLimRateLow.FID_AFRA_C DSCHED_UpLimRateLow.FID_AORA_C DSCHED_UpLimRateLow.FID_ATEH_C DSCHED_UpLimRateLow.FID_ATEL_C DSCHED_UpLimRateLow.FID_ATEN_C DSCHED_UpLimRateLow.FId_EGSDCmnSeg1B1Parl_C DSCHED_UpLimRateLow.FID_BLLRH_C DSCHED_UpLimRateLow.FID_BLLRKH_C DSCHED_UpLimRateLow.FID_BPLSU_C DSCHED_UpLimRateLow.FId_CJ135RvsChrgMeasS1B1_C DSCHED_UpLimRateLow.FId_CatHeatgColdStrtReq_C DSCHED_UpLimRateLow.FId_CatHeatgWrmReq_C DSCHED_UpLimRateLow.FId_EGSDO2SnsrMntdRelsS1B1_C DSCHED_UpLimRateLow.FId_EGSDO2_LamOffsFastS1B1_C DSCHED_UpLimRateLow.FId_MisfDetDnAdpnNv_C DSCHED_UpLimRateOk.FID_AFRA_C DSCHED_UpLimRateOk.FID_AORA_C DSCHED_UpLimRateOk.FID_ATEH_C DSCHED_UpLimRateOk.FID_ATEL_C DSCHED_UpLimRateOk.FID_ATEN_C DSCHED_UpLimRateOk.FId_EGSDCmnSeg1B1Parl_C DSCHED_UpLimRateOk.FID_BLLRH_C DSCHED_UpLimRateOk.FID_BLLRKH_C DSCHED_UpLimRateOk.FID_BPLSU_C DSCHED_UpLimRateOk.FId_CJ135RvsChrgMeasS1B1_C DSCHED_UpLimRateOk.FId_CatHeatgColdStrtReq_C DSCHED_UpLimRateOk.FId_CatHeatgWrmReq_C DSCHED_UpLimRateOk.FId_EGSDO2SnsrMntdRelsS1B1_C DSCHED_UpLimRateOk.FId_EGSDO2_LamOffsFastS1B1_C DSCHED_UpLimRateOk.FId_MisfDetDnAdpnNv_C DSCHED_valOfsPrioOpMode_C DSCHED_valOfsPrioTst_C DSCHED_xFctTstFId_CA DSCHED_xWTTFId_CA /end DEF_CHARACTERISTIC
 /begin OUT_MEASUREMENT DSCHED_DynPrio.FId_Unused DSCHED_DynPrio.FID_AFRA DSCHED_DynPrio.FID_AORA DSCHED_DynPrio.FID_ATEH DSCHED_DynPrio.FID_ATEL DSCHED_DynPrio.FID_ATEN DSCHED_DynPrio.FId_EGSDCmnSeg1B1Parl DSCHED_DynPrio.FID_BLLRH DSCHED_DynPrio.FID_BLLRKH DSCHED_DynPrio.FID_BPLSU DSCHED_DynPrio.FId_CJ135RvsChrgMeasS1B1 DSCHED_DynPrio.FId_CatHeatgColdStrtReq DSCHED_DynPrio.FId_CatHeatgWrmReq DSCHED_DynPrio.FId_EGSDO2SnsrMntdRelsS1B1 DSCHED_DynPrio.FId_EGSDO2_LamOffsFastS1B1 DSCHED_DynPrio.FId_MisfDetDnAdpnNv DSCHED_PhysPrio.FId_Unused DSCHED_PhysPrio.FID_AFRA DSCHED_PhysPrio.FID_AORA DSCHED_PhysPrio.FID_ATEH DSCHED_PhysPrio.FID_ATEL DSCHED_PhysPrio.FID_ATEN DSCHED_PhysPrio.FId_EGSDCmnSeg1B1Parl DSCHED_PhysPrio.FID_BLLRH DSCHED_PhysPrio.FID_BLLRKH DSCHED_PhysPrio.FID_BPLSU DSCHED_PhysPrio.FId_CJ135RvsChrgMeasS1B1 DSCHED_PhysPrio.FId_CatHeatgColdStrtReq DSCHED_PhysPrio.FId_CatHeatgWrmReq DSCHED_PhysPrio.FId_EGSDO2SnsrMntdRelsS1B1 DSCHED_PhysPrio.FId_EGSDO2_LamOffsFastS1B1 DSCHED_PhysPrio.FId_MisfDetDnAdpnNv DSCHED_TiActv.FId_Unused DSCHED_TiActv.FID_AFRA DSCHED_TiActv.FID_AORA DSCHED_TiActv.FID_ATEH DSCHED_TiActv.FID_ATEL DSCHED_TiActv.FID_ATEN DSCHED_TiActv.FId_EGSDCmnSeg1B1Parl DSCHED_TiActv.FID_BLLRH DSCHED_TiActv.FID_BLLRKH DSCHED_TiActv.FID_BPLSU DSCHED_TiActv.FId_CJ135RvsChrgMeasS1B1 DSCHED_TiActv.FId_CatHeatgColdStrtReq DSCHED_TiActv.FId_CatHeatgWrmReq DSCHED_TiActv.FId_EGSDO2SnsrMntdRelsS1B1 DSCHED_TiActv.FId_EGSDO2_LamOffsFastS1B1 DSCHED_TiActv.FId_MisfDetDnAdpnNv DSCHED_TiPas.FId_Unused DSCHED_TiPas.FID_AFRA DSCHED_TiPas.FID_AORA DSCHED_TiPas.FID_ATEH DSCHED_TiPas.FID_ATEL DSCHED_TiPas.FID_ATEN DSCHED_TiPas.FId_EGSDCmnSeg1B1Parl DSCHED_TiPas.FID_BLLRH DSCHED_TiPas.FID_BLLRKH DSCHED_TiPas.FID_BPLSU DSCHED_TiPas.FId_CJ135RvsChrgMeasS1B1 DSCHED_TiPas.FId_CatHeatgColdStrtReq DSCHED_TiPas.FId_CatHeatgWrmReq DSCHED_TiPas.FId_EGSDO2SnsrMntdRelsS1B1 DSCHED_TiPas.FId_EGSDO2_LamOffsFastS1B1 DSCHED_TiPas.FId_MisfDetDnAdpnNv DSCHED_VirtDynPrio.FId_Unused DSCHED_VirtDynPrio.FID_AFRA DSCHED_VirtDynPrio.FID_AORA DSCHED_VirtDynPrio.FID_ATEH DSCHED_VirtDynPrio.FID_ATEL DSCHED_VirtDynPrio.FID_ATEN DSCHED_VirtDynPrio.FId_EGSDCmnSeg1B1Parl DSCHED_VirtDynPrio.FID_BLLRH DSCHED_VirtDynPrio.FID_BLLRKH DSCHED_VirtDynPrio.FID_BPLSU DSCHED_VirtDynPrio.FId_CJ135RvsChrgMeasS1B1 DSCHED_VirtDynPrio.FId_CatHeatgColdStrtReq DSCHED_VirtDynPrio.FId_CatHeatgWrmReq DSCHED_VirtDynPrio.FId_EGSDO2SnsrMntdRelsS1B1 DSCHED_VirtDynPrio.FId_EGSDO2_LamOffsFastS1B1 DSCHED_VirtDynPrio.FId_MisfDetDnAdpnNv DSCHED_VirtPhysPrio.FId_Unused DSCHED_VirtPhysPrio.FID_AFRA DSCHED_VirtPhysPrio.FID_AORA DSCHED_VirtPhysPrio.FID_ATEH DSCHED_VirtPhysPrio.FID_ATEL DSCHED_VirtPhysPrio.FID_ATEN DSCHED_VirtPhysPrio.FId_EGSDCmnSeg1B1Parl DSCHED_VirtPhysPrio.FID_BLLRH DSCHED_VirtPhysPrio.FID_BLLRKH DSCHED_VirtPhysPrio.FID_BPLSU DSCHED_VirtPhysPrio.FId_CJ135RvsChrgMeasS1B1 DSCHED_VirtPhysPrio.FId_CatHeatgColdStrtReq DSCHED_VirtPhysPrio.FId_CatHeatgWrmReq DSCHED_VirtPhysPrio.FId_EGSDO2SnsrMntdRelsS1B1 DSCHED_VirtPhysPrio.FId_EGSDO2_LamOffsFastS1B1 DSCHED_VirtPhysPrio.FId_MisfDetDnAdpnNv /end OUT_MEASUREMENT
 /begin LOC_MEASUREMENT DSCHED_idxWTTAct DSCHED_tiWTT /end LOC_MEASUREMENT
 FUNCTION_VERSION "30000.2.0" /end FUNCTION
/begin COMPU_METHOD dez "" RAT_FUNC "%6.2" "" COEFFS 0 1 0 0 0 1 /end COMPU_METHOD
/begin COMPU_METHOD DFC_OneToOne "" RAT_FUNC "%6.2" "-" COEFFS 0 1 0 0 0 1 /end COMPU_METHOD
/begin COMPU_METHOD DFC_Verb "" TAB_VERB "%6.3" "-" COMPU_TAB_REF DFC_Verb /end COMPU_METHOD
/begin COMPU_VTAB DFC_Verb "" TAB_VERB 704 0 "DFC_Unused" 318 "DFC_ACEvpTSRCMax" 319 "DFC_ACEvpTSRCMin" 320 "DFC_AirCClntPAnaSRCMax" 321 "DFC_AirCClntPAnaSRCMin" 259 "DFC_AirCCmprOL" 260 "DFC_AirCCmprOvrTemp" 261 "DFC_AirCCmprSCB" 262 "DFC_AirCCmprSCG" 322 "DFC_AirCSwtNpl" 323 "DFC_AirCSwtSig" 263 "DFC_AltErr" 1 "DFC_AltIOACGFailr" 2 "DFC_AltIOACGHiVltg" 3 "DFC_AltIOACGLoVltg" 4 "DFC_AltIOACGTHi" 5 "DFC_AltIODConnACG" 429 "DFC_AppAllSnsrDfct" 6 "DFC_BattUHiFailr" 7 "DFC_BattULoFailr" 264 "DFC_BattUSRCMax" 265 "DFC_BattUSRCMin" 430 "DFC_BattUStdbyDiaOL" 431 "DFC_BigLeakIntkMnfldEmiInfl" 324 "DFC_Brk" 8 "DFC_BrkBstPDriftHiErr" 9 "DFC_BrkBstPDriftLoErr" 10 "DFC_BrkBstPSnsrStuck" 11 "DFC_BrkMnSwtContOn" 432 "DFC_BrkMnSwtContOnWarnLmp" 12 "DFC_BrkMnSwtNotStp" 433 "DFC_BrkMnSwtNotStpWarnLmp" 13 "DFC_BrkNpl" 14 "DFC_BrkRdntSwtContOn" 434 "DFC_BrkRdntSwtContOnWarnLmp" 15 "DFC_BrkRdntSwtNotStp" 435 "DFC_BrkRdntSwtNotStpWarnLmp" 325 "DFC_BrkSig" 417 "DFC_BSWM_E_ACTION_FAILED" 418 "DFC_BSWM_E_INTRPTQUEUE_FULL" 393 "DFC_BusDiagCANAPPLBusOff" 394 "DFC_BusDiagCANCANCBusOff" 395 "DFC_BusDiagCANVEHICLEBusOff" 411 "DFC_CAN_E_TIMEOUT" 436 "DFC_CEngDsTColdStrtMax" 437 "DFC_CEngDsTColdStrtMin" 438 "DFC_CEngDsTImps" 439 "DFC_CEngDsTPlausLSC" 440 "DFC_CEngDsTPlausSTC" 443 "DFC_CEngDsTSig" 441 "DFC_CEngDsTSRCMax" 442 "DFC_CEngDsTSRCMin" 444 "DFC_CEngUsTSRCMax" 445 "DFC_CEngUsTSRCMin" 366 "DFC_Clth2ONStuck" 367 "DFC_Clth2ONStuckLdc" 16 "DFC_Clth3ONStuck" 368 "DFC_Clth3ONStuckLdc" 369 "DFC_Clth3ONStuckPostDrv" 17 "DFC_Clth4OFFStuck" 370 "DFC_Clth4ONStuck" 371 "DFC_Clth4ONStuckLdc" 236 "DFC_ClthMax" 336 "DFC_ClthNpl" 18 "DFC_ClthOFFStuck" 19 "DFC_ClthONStuck" 326 "DFC_ClthSig" 20 "DFC_ClthStkFailInfo" 21 "DFC_ComACFailInfo" 22 "DFC_ComATFTValErr" 23 "DFC_ComATMILReq" 24 "DFC_ComAYCAChksum" 25 "DFC_ComAYCARingCnt" 26 "DFC_ComAYCATOut" 27 "DFC_ComAYCDChkSum" 28 "DFC_ComAYCDTOut" 29 "DFC_ComAYCFChksum" 30 "DFC_ComAYCFRingCnt" 31 "DFC_ComAYCFTOut" 32 "DFC_ComAYCGChksum" 33 "DFC_ComAYCGRingCnt" 34 "DFC_ComAYCGTOut" 35 "DFC_ComAYCIChkSum" 36 "DFC_ComAYCIRingCnt" 37 "DFC_ComAYCITOut" 38 "DFC_ComBCM1ChkSum" 39 "DFC_ComBCM1RingCnt" 40 "DFC_ComBCM1TOut" 41 "DFC_ComCANABusOffErr" 42 "DFC_ComCANBBusOffErr" 43 "DFC_ComCANCBusOffErr" 44 "DFC_ComCGW1ChkSum" 45 "DFC_ComCGW1RingCnt" 46 "DFC_ComCGW1TOut" 266 "DFC_ComChksTCU1" 267 "DFC_ComChksTCU11" 268 "DFC_ComChksTCU12" 269 "DFC_ComChksTCU13" 270 "DFC_ComChksTCU2" 271 "DFC_ComChksTCU3" 272 "DFC_ComChksTCU4" 273 "DFC_ComCntTCU1" 274 "DFC_ComCntTCU11" 275 "DFC_ComCntTCU12" 276 "DFC_ComCntTCU13" 277 "DFC_ComCntTCU2" 278 "DFC_ComCntTCU3" 279 "DFC_ComCntTCU4" 47 "DFC_ComConvBoostErr" 48 "DFC_ComConvSlipErr" 372 "DFC_ComDLCTCU01" 373 "DFC_ComDLCTCU02" 374 "DFC_ComDLCTCU1" 375 "DFC_ComDLCTCU11" 376 "DFC_ComDLCTCU12" 377 "DFC_ComDLCTCU13" 378 "DFC_ComDLCTCU14" 379 "DFC_ComDLCTCU2" 380 "DFC_ComDLCTCU3" 381 "DFC_ComDLCTCU4" 49 "DFC_ComEAT10Chksum" 50 "DFC_ComEAT10RingCnt" 51 "DFC_ComEAT10TOut" 52 "DFC_ComEAT11ChkSum" 53 "DFC_ComEAT11RingCnt" 54 "DFC_ComEAT11TOut" 55 "DFC_ComEAT12ChkSum" 56 "DFC_ComEAT12RingCnt" 57 "DFC_ComEAT12TOut" 58 "DFC_ComEAT13ChkSum" 59 "DFC_ComEAT13RingCnt" 60 "DFC_ComEAT13TOut" 61 "DFC_ComEAT1Chksum" 62 "DFC_ComEAT1RingCnt" 63 "DFC_ComEAT1TOut" 64 "DFC_ComEAT2ChkSum" 65 "DFC_ComEAT2RingCnt" 66 "DFC_ComEAT2TOut" 67 "DFC_ComEAT4ChkSum" 68 "DFC_ComEAT4RingCnt" 69 "DFC_ComEAT4TOut" 70 "DFC_ComEAT6Chksum" 71 "DFC_ComEAT6RingCnt" 72 "DFC_ComEAT6TOut" 73 "DFC_ComEAT7Chksum" 74 "DFC_ComEAT7RingCnt" 75 "DFC_ComEAT7TOut" 76 "DFC_ComEAT8Chksum" 77 "DFC_ComEAT8RingCnt" 78 "DFC_ComEAT8TOut" 79 "DFC_ComEATAChksum" 80 "DFC_ComEATARingCnt" 81 "DFC_ComEATATOut" 82 "DFC_ComEATBChkSum" 83 "DFC_ComEATBRingCnt" 84 "DFC_ComEATBTOut" 85 "DFC_ComEATCChksum" 86 "DFC_ComEATCRingCnt" 87 "DFC_ComEATCTOut" 88 "DFC_ComEBBAChksum" 89 "DFC_ComEBBARingCnt" 90 "DFC_ComEBBATOut" 94 "DFC_ComEngCanRxErr" 91 "DFC_ComEPS1Chksum" 92 "DFC_ComEPS1RingCnt" 93 "DFC_ComEPS1TOut" 95 "DFC_ComGrvySnsrErr" 96 "DFC_ComGwIMG1ChkSum" 97 "DFC_ComGwIMG1RingCnt" 98 "DFC_ComGwIMG1TOut" 99 "DFC_ComGwIMG3ChkSum" 100 "DFC_ComGwIMG3RingCnt" 101 "DFC_ComGwIMG3TOut" 102 "DFC_ComGwIMG4ChkSum" 103 "DFC_ComGwIMG4RingCnt" 104 "DFC_ComGwIMG4TOut" 105 "DFC_ComGwIMG5ChkSum" 106 "DFC_ComGwIMG5RingCnt" 107 "DFC_ComGwIMG5TOut" 108 "DFC_ComGwIMG6ChkSum" 109 "DFC_ComGwIMG6RingCnt" 110 "DFC_ComGwIMG6TOut" 111 "DFC_ComIDASBChksum" 112 "DFC_ComIDASBRingCnt" 113 "DFC_ComIDASBTOut" 114 "DFC_ComIMGMILReq" 115 "DFC_ComISSPrms" 116 "DFC_ComMETAChksum" 117 "DFC_ComMETARingCnt" 118 "DFC_ComMETATOut" 119 "DFC_ComMETCChksum" 120 "DFC_ComMETCRingCnt" 121 "DFC_ComMETCTOut" 122 "DFC_ComMETDChksum" 123 "DFC_ComMETDRingCnt" 124 "DFC_ComMETDTOut" 125 "DFC_ComMETE2Chksum" 126 "DFC_ComMETE2RingCnt" 127 "DFC_ComMETE2TOut" 128 "DFC_ComMETFChksum" 129 "DFC_ComMETFRingCnt" 130 "DFC_ComMETFTOut" 131 "DFC_ComMETGChksum" 132 "DFC_ComMETGRingCnt" 133 "DFC_ComMETGTOut" 134 "DFC_ComMETH2Chksum" 135 "DFC_ComMETH2RingCnt" 136 "DFC_ComMETH2TOut" 137 "DFC_ComMETHChksum" 138 "DFC_ComMETHRingCnt" 139 "DFC_ComMETHTOut" 140 "DFC_ComMETIChksum" 141 "DFC_ComMETIRingCnt" 142 "DFC_ComMETITOut" 143 "DFC_ComMETKChksum" 144 "DFC_ComMETKRingCnt" 145 "DFC_ComMETKTOut" 146 "DFC_ComMETLChksum" 147 "DFC_ComMETLRingCnt" 148 "DFC_ComMETLTOut" 149 "DFC_ComMETMChksum" 150 "DFC_ComMETMRingCnt" 151 "DFC_ComMETMTOut" 152 "DFC_ComMETNChksum" 153 "DFC_ComMETNRingCnt" 154 "DFC_ComMETNTOut" 155 "DFC_ComMtrCom" 156 "DFC_ComPCUChkSum" 157 "DFC_ComPCURingCnt" 158 "DFC_ComPCUTOut" 159 "DFC_ComSRSAChksum" 160 "DFC_ComSRSARingCnt" 161 "DFC_ComSRSATOut" 162 "DFC_ComSRSBChksum" 163 "DFC_ComSRSBRingCnt" 164 "DFC_ComSRSBTOut" 165 "DFC_ComSRSChksum" 166 "DFC_ComSRSErr" 167 "DFC_ComSRSRingCnt" 168 "DFC_ComSRSTOut" 280 "DFC_ComTOutTCU01" 281 "DFC_ComTOutTCU02" 282 "DFC_ComTOutTCU1" 283 "DFC_ComTOutTCU11" 284 "DFC_ComTOutTCU12" 285 "DFC_ComTOutTCU13" 286 "DFC_ComTOutTCU14" 287 "DFC_ComTOutTCU2" 288 "DFC_ComTOutTCU3" 289 "DFC_ComTOutTCU4" 169 "DFC_ComVehSpdPndFltTCU" 446 "DFC_DCDCFltDet" 290 "DFC_DevLibBattUHi" 291 "DFC_DevLibBattULo" 449 "DFC_DKnpl" 447 "DFC_DKRSA" 448 "DFC_DKVSmax" 450 "DFC_DSSmax" 451 "DFC_DSTTI" 452 "DFC_DSUmax" 170 "DFC_EbsChartcCurrErr" 171 "DFC_EbsSelfDiagErr" 383 "DFC_EbsSocFlt" 453 "DFC_EGRVlvOL" 454 "DFC_EGRVlvSCB" 455 "DFC_EGRVlvSCG" 456 "DFC_EGSDUS2B1LtrDly" 457 "DFC_EGSDUS2B1LtrPT1" 458 "DFC_EGSDUS2B1RtlDly" 459 "DFC_EGSDUS2B1RtlPT1" 460 "DFC_EGSDUS2B1TarLean" 461 "DFC_EGSDUS2B1TarRich" 464 "DFC_EngICO" 465 "DFC_EngPrtOvrSpdMon" 466 "DFC_EpmCaSI1ErrSig" 467 "DFC_EpmCaSI1NoSig" 468 "DFC_EpmCaSI1OfsErr" 469 "DFC_EpmCrSErrSig" 470 "DFC_EpmCrSNoSig" 471 "DFC_EtaEngIdleNonCsers" 472 "DFC_EtaEngPtlNonCsers" 462 "DFC_ETAKHLmax" 463 "DFC_ETAKHTmax" 337 "DFC_EV1max" 338 "DFC_EV1min" 339 "DFC_EV1sig" 340 "DFC_EV2max" 341 "DFC_EV2min" 342 "DFC_EV2sig" 343 "DFC_EV3max" 344 "DFC_EV3min" 345 "DFC_EV3sig" 346 "DFC_EV4max" 347 "DFC_EV4min" 348 "DFC_EV4sig" 382 "DFC_EVX" 292 "DFC_FanDIOOL_0" 293 "DFC_FanDIOOL_1" 294 "DFC_FanDIOOvrTemp_0" 295 "DFC_FanDIOOvrTemp_1" 296 "DFC_FanDIOSCB_0" 297 "DFC_FanDIOSCB_1" 298 "DFC_FanDIOSCG_0" 299 "DFC_FanDIOSCG_1" 473 "DFC_FRAmax" 474 "DFC_FRAmin" 172 "DFC_GbxCANDigPlausErr" 173 "DFC_GbxNPos1SRCMax" 174 "DFC_GbxNPos1SRCMin" 175 "DFC_GbxNPos2SRCMax" 176 "DFC_GbxNPos2SRCMin" 177 "DFC_GbxNPosAlvChk" 178 "DFC_GbxNPosSyncErr" 349 "DFC_GbxPNPosnDrvCdn" 350 "DFC_GbxPNPosnPlausy" 475 "DFC_GbxRvsSwtStk" 476 "DFC_HDRmax" 477 "DFC_HEGOS2B1ElecMax" 478 "DFC_HEGOS2B1ElecMin" 479 "DFC_HEGOS2B1ElecSig" 480 "DFC_HEGOS2B1HtgNpl" 179 "DFC_HEGOS2B1HtrPsMax" 180 "DFC_HEGOS2B1HtrPsMin" 181 "DFC_HEGOS2B1HtrPsSig" 327 "DFC_HLSDemOvhtEngLim" 384 "DFC_I14229VINErr" 237 "DFC_IgnClPs_DevComErr" 238 "DFC_IgnClPs_LineOl_0" 239 "DFC_IgnClPs_LineOl_1" 240 "DFC_IgnClPs_LineOl_2" 241 "DFC_IgnClPs_LineOl_3" 242 "DFC_IgnClPs_LineScb_0" 243 "DFC_IgnClPs_LineScb_1" 244 "DFC_IgnClPs_LineScb_2" 245 "DFC_IgnClPs_LineScb_3" 246 "DFC_IgnClPs_LineScg_0" 247 "DFC_IgnClPs_LineScg_1" 248 "DFC_IgnClPs_LineScg_2" 249 "DFC_IgnClPs_LineScg_3" 481 "DFC_IntkAirTIntkMnfldCrssMax" 482 "DFC_IntkAirTIntkMnfldCrssMin" 483 "DFC_IntkAirTIntkMnfldHSCMax" 484 "DFC_IntkAirTIntkMnfldImps" 485 "DFC_IntkAirTIntkMnfldPRCMax" 486 "DFC_IntkAirTIntkMnfldPRCMin" 487 "DFC_IntkAirTIntkMnfldSRCMax" 488 "DFC_IntkAirTIntkMnfldSRCMin" 489 "DFC_IntkAirTIntkMnfldSTC" 362 "DFC_KnDetSens1PortAMax" 363 "DFC_KnDetSens1PortAMin" 364 "DFC_KnDetSens1PortBMax" 365 "DFC_KnDetSens1PortBMin" 490 "DFC_KS1max" 491 "DFC_KS1min" 494 "DFC_LamDynDiagS1B1" 495 "DFC_LeakIntkMnfldEmiInfl" 412 "DFC_LIN_E_TIMEOUT" 182 "DFC_LinCSErrACG" 183 "DFC_LinCSErrEBS" 184 "DFC_LinHdrTimeoutErrACG" 185 "DFC_LinHdrTimeoutErrEBS" 186 "DFC_LinMsgTimeoutErrACG" 187 "DFC_LinMsgTimeoutErrEBS" 188 "DFC_LinNoStrtComErr" 385 "DFC_LLRKHmax" 386 "DFC_LLRKHmin" 387 "DFC_LLRmax" 388 "DFC_LLRmin" 492 "DFC_LMmax" 493 "DFC_LZSRnpl" 496 "DFC_MD00max" 497 "DFC_MDBmax" 498 "DFC_MDCat" 499 "DFC_MDCatCrit" 500 "DFC_MDCatCurr" 501 "DFC_MDCyl_0" 502 "DFC_MDCyl_1" 503 "DFC_MDCyl_2" 504 "DFC_MDCyl_3" 505 "DFC_MDEmi" 506 "DFC_MDEmiStrt" 507 "DFC_MDFco" 510 "DFC_MDmax" 508 "DFC_MDMpl" 509 "DFC_MDSegTiAdpn" 205 "DFC_MisfDetdVWhlFrntLePlaus" 206 "DFC_MisfDetdVWhlFrntRiPlaus" 207 "DFC_MisfDetdVWhlReLePlaus" 208 "DFC_MisfDetdVWhlReRiPlaus" 189 "DFC_MisfDetVWhlFrntLeOORHi" 190 "DFC_MisfDetVWhlFrntLeRatyHi" 191 "DFC_MisfDetVWhlFrntLeRatyLo" 192 "DFC_MisfDetVWhlFrntLeStuck" 193 "DFC_MisfDetVWhlFrntRiOORHi" 194 "DFC_MisfDetVWhlFrntRiRatyHi" 195 "DFC_MisfDetVWhlFrntRiRatyLo" 196 "DFC_MisfDetVWhlFrntRiStuck" 197 "DFC_MisfDetVWhlReLeOORHi" 198 "DFC_MisfDetVWhlReLeRatyHi" 199 "DFC_MisfDetVWhlReLeRatyLo" 200 "DFC_MisfDetVWhlReLeStuck" 201 "DFC_MisfDetVWhlReRiOORHi" 202 "DFC_MisfDetVWhlReRiRatyHi" 203 "DFC_MisfDetVWhlReRiRatyLo" 204 "DFC_MisfDetVWhlReRiStuck" 605 "DFC_MoCADCNTP" 606 "DFC_MoCADCTst" 607 "DFC_MoCSOPICO" 609 "DFC_MoFAirFilgPrdc" 610 "DFC_MoFAirFlCtOffPfi" 611 "DFC_MoFAirFlCylPfi" 612 "DFC_MoFAirFlIn" 613 "DFC_MoFAirFlMixCtlPfiChkAirFl" 614 "DFC_MoFAirFlMixCtlPfiChkCtrl" 615 "DFC_MoFAirFlMode" 608 "DFC_MoFAPP" 616 "DFC_MoFESpd" 617 "DFC_MoFIACo" 618 "DFC_MoFICOL1" 619 "DFC_MoFICOL2" 620 "DFC_MoFStrt" 621 "DFC_MoFTrqCmp" 622 "DFC_MoFTrqCmpMax" 623 "DFC_MoFTrqCmpMin" 624 "DFC_MoFVarPostBldSel" 511 "DFC_MOXEMM_SMU_ALM0_0" 512 "DFC_MOXEMM_SMU_ALM0_1" 513 "DFC_MOXEMM_SMU_ALM0_10" 514 "DFC_MOXEMM_SMU_ALM0_11" 515 "DFC_MOXEMM_SMU_ALM0_13" 516 "DFC_MOXEMM_SMU_ALM0_14" 517 "DFC_MOXEMM_SMU_ALM0_2" 518 "DFC_MOXEMM_SMU_ALM0_22" 519 "DFC_MOXEMM_SMU_ALM0_23" 520 "DFC_MOXEMM_SMU_ALM0_4" 521 "DFC_MOXEMM_SMU_ALM0_5" 522 "DFC_MOXEMM_SMU_ALM0_7" 523 "DFC_MOXEMM_SMU_ALM0_8" 524 "DFC_MOXEMM_SMU_ALM10_16" 525 "DFC_MOXEMM_SMU_ALM10_17" 526 "DFC_MOXEMM_SMU_ALM10_21" 527 "DFC_MOXEMM_SMU_ALM11_0" 528 "DFC_MOXEMM_SMU_ALM11_1" 529 "DFC_MOXEMM_SMU_ALM11_2" 530 "DFC_MOXEMM_SMU_ALM11_3" 531 "DFC_MOXEMM_SMU_ALM11_4" 532 "DFC_MOXEMM_SMU_ALM11_5" 533 "DFC_MOXEMM_SMU_ALM11_8" 534 "DFC_MOXEMM_SMU_ALM11_9" 535 "DFC_MOXEMM_SMU_ALM1_0" 536 "DFC_MOXEMM_SMU_ALM1_1" 537 "DFC_MOXEMM_SMU_ALM1_10" 538 "DFC_MOXEMM_SMU_ALM1_11" 539 "DFC_MOXEMM_SMU_ALM1_13" 540 "DFC_MOXEMM_SMU_ALM1_14" 541 "DFC_MOXEMM_SMU_ALM1_2" 542 "DFC_MOXEMM_SMU_ALM1_22" 543 "DFC_MOXEMM_SMU_ALM1_23" 544 "DFC_MOXEMM_SMU_ALM1_4" 545 "DFC_MOXEMM_SMU_ALM1_5" 546 "DFC_MOXEMM_SMU_ALM1_7" 547 "DFC_MOXEMM_SMU_ALM1_8" 548 "DFC_MOXEMM_SMU_ALM21_0" 549 "DFC_MOXEMM_SMU_ALM21_16" 550 "DFC_MOXEMM_SMU_ALM21_3" 551 "DFC_MOXEMM_SMU_ALM2_1" 552 "DFC_MOXEMM_SMU_ALM2_10" 553 "DFC_MOXEMM_SMU_ALM2_11" 554 "DFC_MOXEMM_SMU_ALM2_13" 555 "DFC_MOXEMM_SMU_ALM2_14" 556 "DFC_MOXEMM_SMU_ALM2_22" 557 "DFC_MOXEMM_SMU_ALM2_23" 558 "DFC_MOXEMM_SMU_ALM2_4" 559 "DFC_MOXEMM_SMU_ALM2_5" 560 "DFC_MOXEMM_SMU_ALM2_7" 561 "DFC_MOXEMM_SMU_ALM2_8" 562 "DFC_MOXEMM_SMU_ALM6_0" 563 "DFC_MOXEMM_SMU_ALM6_11" 564 "DFC_MOXEMM_SMU_ALM6_12" 565 "DFC_MOXEMM_SMU_ALM6_14" 566 "DFC_MOXEMM_SMU_ALM6_15" 567 "DFC_MOXEMM_SMU_ALM6_17" 568 "DFC_MOXEMM_SMU_ALM6_18" 569 "DFC_MOXEMM_SMU_ALM6_20" 570 "DFC_MOXEMM_SMU_ALM6_21" 571 "DFC_MOXEMM_SMU_ALM6_25" 572 "DFC_MOXEMM_SMU_ALM6_4" 573 "DFC_MOXEMM_SMU_ALM6_5" 574 "DFC_MOXEMM_SMU_ALM6_7" 575 "DFC_MOXEMM_SMU_ALM6_8" 576 "DFC_MOXEMM_SMU_ALM7_1" 577 "DFC_MOXEMM_SMU_ALM7_12" 578 "DFC_MOXEMM_SMU_ALM7_13" 579 "DFC_MOXEMM_SMU_ALM7_14" 580 "DFC_MOXEMM_SMU_ALM7_15" 581 "DFC_MOXEMM_SMU_ALM7_16" 582 "DFC_MOXEMM_SMU_ALM7_17" 583 "DFC_MOXEMM_SMU_ALM7_2" 584 "DFC_MOXEMM_SMU_ALM7_20" 585 "DFC_MOXEMM_SMU_ALM7_25" 586 "DFC_MOXEMM_SMU_ALM7_26" 587 "DFC_MOXEMM_SMU_ALM7_28" 588 "DFC_MOXEMM_SMU_ALM7_29" 589 "DFC_MOXEMM_SMU_ALM7_30" 590 "DFC_MOXEMM_SMU_ALM7_31" 591 "DFC_MOXEMM_SMU_ALM8_0" 592 "DFC_MOXEMM_SMU_ALM8_1" 593 "DFC_MOXEMM_SMU_ALM8_10" 594 "DFC_MOXEMM_SMU_ALM8_11" 595 "DFC_MOXEMM_SMU_ALM8_12" 596 "DFC_MOXEMM_SMU_ALM8_16" 597 "DFC_MOXEMM_SMU_ALM8_18" 598 "DFC_MOXEMM_SMU_ALM8_2" 599 "DFC_MOXEMM_SMU_ALM8_3" 600 "DFC_MOXEMM_SMU_ALM8_31" 601 "DFC_MOXEMM_SMU_ALM8_4" 602 "DFC_MOXEMM_SMU_ALM9_0" 603 "DFC_MOXEMM_SMU_ALM9_15" 604 "DFC_MOXEMM_SMU_ALM9_3" 625 "DFC_MoXEMMHwLTMCUFW" 626 "DFC_MoXEMMHwLTMonBIST" 627 "DFC_MoXEMMHwLTRegMonTest" 628 "DFC_MoXEMMHwLTStbySMUAlvTest" 629 "DFC_MoXEMMHwLTTempSens" 630 "DFC_MoXEMMHwLTUCBCfg" 300 "DFC_MRlyDcOL" 301 "DFC_MRlyDcSCB" 302 "DFC_MRlyDcSCG" 413 "DFC_MRlyOL" 414 "DFC_MRlySCB" 415 "DFC_MRlySCG" 631 "DFC_OCWDAABEActv" 632 "DFC_OCWDACom" 633 "DFC_OCWDAErrPin" 634 "DFC_OCWDAOvrVltg" 328 "DFC_OilPNpl" 635 "DFC_ORAmax" 636 "DFC_ORAmin" 647 "DFC_P_VSE11_OL" 648 "DFC_P_VSE11_SCB" 649 "DFC_P_VSE11_SCG" 351 "DFC_PEnvCcMax" 352 "DFC_PEnvCcMin" 353 "DFC_PEnvRngChkMax" 354 "DFC_PEnvRngChkMin" 209 "DFC_PEnvSigRngMax" 210 "DFC_PEnvSigRngMin" 355 "DFC_PEnvSnsrPlaus" 650 "DFC_PhyHighAPP1" 651 "DFC_PhyHighAPP2" 652 "DFC_PhyLowAPP1" 653 "DFC_PhyLowAPP2" 329 "DFC_PIntkVUsLineHiB1" 330 "DFC_PIntkVUsLineLoB1" 637 "DFC_PLLSUmax" 638 "DFC_PLLSUmin" 303 "DFC_PSPOL" 304 "DFC_PSPOvrTemp" 305 "DFC_PSPSCB" 306 "DFC_PSPSCG" 639 "DFC_PSR1max" 640 "DFC_PSRBmax" 641 "DFC_PSRBmin" 645 "DFC_PSRmax" 642 "DFC_PSRPmax" 643 "DFC_PSRPmin" 644 "DFC_PSRPsig" 646 "DFC_PUmax" 396 "DFC_RBA_IODIAGPWR_rba_IoExtCy329_SignalVltSply_0" 397 "DFC_RBA_IODIAGPWR_rba_IoExtCy329_SignalVltSply_0OT" 398 "DFC_RBA_IODIAGPWR_rba_IoExtCy329_SignalVltSply_0OV" 399 "DFC_RBA_IODIAGPWR_rba_IoExtCy329_SignalVltSply_0SCG" 400 "DFC_RBA_IODIAGPWR_rba_IoExtCy329_SignalVltSply_0UV" 401 "DFC_RBA_IODIAGPWR_rba_IoExtCy329_SignalVltSply_1" 402 "DFC_RBA_IODIAGPWR_rba_IoExtCy329_SignalVltSply_1OT" 403 "DFC_RBA_IODIAGPWR_rba_IoExtCy329_SignalVltSply_1OV" 404 "DFC_RBA_IODIAGPWR_rba_IoExtCy329_SignalVltSply_1SCG" 405 "DFC_RBA_IODIAGPWR_rba_IoExtCy329_SignalVltSply_1UV" 406 "DFC_RBA_IODIAGPWR_rba_IoExtCy329_SignalVltSply_2" 407 "DFC_RBA_IODIAGPWR_rba_IoExtCy329_SignalVltSply_2OT" 408 "DFC_RBA_IODIAGPWR_rba_IoExtCy329_SignalVltSply_2OV" 409 "DFC_RBA_IODIAGPWR_rba_IoExtCy329_SignalVltSply_2SCG" 410 "DFC_RBA_IODIAGPWR_rba_IoExtCy329_SignalVltSply_2UV" 419 "DFC_RBA_IOEXTLIB_KEEPALIVE_DRV" 420 "DFC_RBA_IOEXTLIB_KEEPALIVE_INI" 421 "DFC_rba_IoSigRtc_StopCounter" 423 "DFC_rba_MemDiag_MemReadErr" 424 "DFC_rba_MemDiag_MemWrErr" 422 "DFC_rba_MRly_Diag_Stk_Event" 416 "DFC_rba_MultiStackTrace_Threshold" 425 "DFC_rba_SyC_IrrSwOffTrigEngRun_Event" 426 "DFC_rba_T15_Diag_ComInVld_Event" 427 "DFC_rba_T15_Diag_ComOff_HwOn_Event" 428 "DFC_rba_T15_Diag_ComOn_HwOff_Event" 389 "DFC_RoughRoad" 390 "DFC_SiaEEPRdErr" 391 "DFC_SiaEEPWrngCod" 654 "DFC_SRCHighAPP1" 655 "DFC_SRCHighAPP2" 656 "DFC_SRCLowAPP1" 657 "DFC_SRCLowAPP2" 658 "DFC_SSpMon2" 211 "DFC_StmFault" 213 "DFC_StrtCtlErr" 212 "DFC_StrtCtOffPth" 214 "DFC_StrtFault" 215 "DFC_StrtLckJudg1" 216 "DFC_StrtLckJudg2" 217 "DFC_StrtOL" 218 "DFC_StrtOL2" 219 "DFC_StrtSCB" 220 "DFC_StrtSCB2" 221 "DFC_StrtSCG" 222 "DFC_StrtSCG2" 223 "DFC_StrtStkRly1" 224 "DFC_StrtStkRly2" 659 "DFC_SWReset_0" 660 "DFC_SWReset_1" 661 "DFC_SWReset_2" 662 "DFC_SyncAPP" 307 "DFC_T50Err" 663 "DFC_TAmax_Dummy" 225 "DFC_TEVEmax" 226 "DFC_TEVEmin" 227 "DFC_TEVEsig" 671 "DFC_ThrVlvClsdPosnFirstOffsLrnImpoB1" 672 "DFC_ThrVlvClsdPosnOffsLrnImpoB1" 673 "DFC_ThrVlvClsdPosnOffsLrnMaxB1" 674 "DFC_ThrVlvClsdPosnOffsLrnMinB1" 675 "DFC_ThrVlvCtrlDeB1" 676 "DFC_ThrVlvDycB1" 677 "DFC_ThrVlvLimpAirPosnMaxAbsltDriftB1" 678 "DFC_ThrVlvLimpAirPosnMaxB1" 679 "DFC_ThrVlvLimpAirPosnMaxRelDriftB1" 680 "DFC_ThrVlvLimpAirPosnMinB1" 308 "DFC_ThrVlvLoBattB1" 681 "DFC_ThrVlvOpenLoadB1" 682 "DFC_ThrVlvOpenSprgB1" 683 "DFC_ThrVlvOpenSprgSprdB1" 684 "DFC_ThrVlvOpenSprgTwnB1" 685 "DFC_ThrVlvOverTB1" 686 "DFC_ThrVlvRetSprgB1" 687 "DFC_ThrVlvRetSprgSprdB1" 688 "DFC_ThrVlvRetSprgTwnB1" 689 "DFC_ThrVlvSens1MaxB1" 696 "DFC_ThrvlvSens1MinB1" 690 "DFC_ThrVlvSens1NplB1" 691 "DFC_ThrVlvSens2MaxB1" 692 "DFC_ThrVlvSens2MinB1" 693 "DFC_ThrVlvSens2NplB1" 694 "DFC_ThrVlvShoCircB1" 695 "DFC_ThrVlvSpiErrB1" 697 "DFC_TiOffTBasdChkFast" 698 "DFC_TiOffTBasdChkSlow" 664 "DFC_TKAEmax" 665 "DFC_TKAEmin" 666 "DFC_TKARmax" 667 "DFC_TKARnpl" 668 "DFC_TMmax_Dummy" 669 "DFC_TUMmax_Dummy" 670 "DFC_TWCDPriCatB1" 250 "DFC_UEGOASICS1B1" 392 "DFC_UegoDummy" 699 "DFC_UEGOHeatrCtlS1B1" 356 "DFC_UEGOHeatrPsS1B1Max" 357 "DFC_UEGOHeatrPsS1B1Min" 358 "DFC_UEGOHeatrPsS1B1Sig" 359 "DFC_UEGOHeatrRlyPsOLS1B1" 360 "DFC_UEGOHeatrRlyPsSCBS1B1" 361 "DFC_UEGOHeatrRlyPsSCGS1B1" 257 "DFC_UegoOlApesS1B1" 251 "DFC_UEGOOLIPES1B1" 258 "DFC_UegoOlRCmpS1B1" 252 "DFC_UEGOOLRES1B1" 253 "DFC_UEGOSCBS1B1" 254 "DFC_UEGOSCGS1B1" 700 "DFC_UEGOSnsrMntdS1B1" 256 "DFC_UEGOSnsrS1B1" 255 "DFC_UEGOSPIS1B1" 228 "DFC_VehVAllPlaus" 229 "DFC_VehVNCSnsrElecFailr" 309 "DFC_VehVPhysRngHi" 331 "DFC_VehVPhysRngLo" 230 "DFC_VehVPlausCan" 231 "DFC_VehVPlausFco" 232 "DFC_VehVPlausPwr" 233 "DFC_VehVPlausV2N" 310 "DFC_VehVSclOutOL" 311 "DFC_VehVSclOutOT" 312 "DFC_VehVSclOutSCB" 313 "DFC_VehVSclOutSCG" 701 "DFC_VehVSig" 332 "DFC_VehVSigCan" 333 "DFC_VehVSigCanSafe" 314 "DFC_VehVSnsrARngHi" 315 "DFC_VehVSnsrBRngHi" 316 "DFC_VehVSpdRtyDiag" 234 "DFC_VehVSpdSnsrAElecFailr" 235 "DFC_VehVSpdSnsrBElecFailr" 317 "DFC_VehVWhlErr" 334 "DFC_VlvLftFbOilPSnsrIntk11SRCMax" 335 "DFC_VlvLftFbOilPSnsrIntk11SRCMin" 702 "DFC_VlvLftFbSwtIntk11SpclFail" 703 "DFC_VlvLftFbSwtIntk11StdFail" DEFAULT_VALUE "---" /end COMPU_VTAB
/begin COMPU_METHOD DINH_OneToOne "" RAT_FUNC "%6.2" "-" COEFFS 0 1 0 0 0 1 /end COMPU_METHOD
/begin COMPU_METHOD DRIVE_AOBS_MODE "" TAB_VERB "%6.3" "" COMPU_TAB_REF DRIVE_AOBS_MODE /end COMPU_METHOD
/begin COMPU_VTAB DRIVE_AOBS_MODE "" TAB_VERB 2 0 "DRIVE_AOBS_DISABLE" 1 "DRIVE_AOBS_ENABLE" /end COMPU_VTAB
/begin COMPU_METHOD DRIVE_AOBS_stSet "" TAB_VERB "%6.3" "" COMPU_TAB_REF DRIVE_AOBS_stSet /end COMPU_METHOD
/begin COMPU_VTAB DRIVE_AOBS_stSet "" TAB_VERB 2 0 "DRIVE_AOBS_NOTSET" 1 "DRIVE_AOBS_SET" /end COMPU_VTAB
/begin COMPU_METHOD DRIVE_PRDS_BUFSTATTYPE "" TAB_VERB "%6.3" "" COMPU_TAB_REF DRIVE_PRDS_BUFSTATTYPE /end COMPU_METHOD
/begin COMPU_VTAB DRIVE_PRDS_BUFSTATTYPE "" TAB_VERB 3 0 "DRIVE_BUF_CLEAR" 1 "DRIVE_BUF_STOP" 2 "DRIVE_BUF_MEAS" /end COMPU_VTAB
/begin COMPU_METHOD DRIVE_PRDS_CLEARSTORETYPE "" TAB_VERB "%6.3" "" COMPU_TAB_REF DRIVE_PRDS_CLEARSTORETYPE /end COMPU_METHOD
/begin COMPU_VTAB DRIVE_PRDS_CLEARSTORETYPE "" TAB_VERB 3 0 "DRIVE_RETAIN_DATA" 1 "DRIVE_CLEAR_DATA" 2 "DRIVE_DISABLE_REC" /end COMPU_VTAB
/begin COMPU_METHOD DRIVE_PRDS_TRGMODETYPE "" TAB_VERB "%6.3" "" COMPU_TAB_REF DRIVE_PRDS_TRGMODETYPE /end COMPU_METHOD
/begin COMPU_VTAB DRIVE_PRDS_TRGMODETYPE "" TAB_VERB 3 0 "DRIVE_DIAG_DEV" 1 "DRIVE_DTC_STORE" 2 "DRIVE_ENG_STALL" /end COMPU_VTAB
/begin COMPU_METHOD DRIVE_PRDS_TRIGGERCODETYPE "" TAB_VERB "%6.3" "" COMPU_TAB_REF DRIVE_PRDS_TRIGGERCODETYPE /end COMPU_METHOD
/begin COMPU_VTAB DRIVE_PRDS_TRIGGERCODETYPE "" TAB_VERB 3 69649 "DRIVE_TRIGGER_ON" 1044735 "DRIVE_TRIGGER_OFF" 348245 "DRIVE_TRIGGER_DISABLE" /end COMPU_VTAB
/begin COMPU_METHOD DSCHED_FIdVerb "" TAB_VERB "%6.3" "-" COMPU_TAB_REF DSCHED_FIdVerb /end COMPU_METHOD
/begin COMPU_VTAB DSCHED_FIdVerb "" TAB_VERB 16 0 "FId_Unused" 1 "FID_AFRA" 2 "FID_AORA" 3 "FID_ATEH" 4 "FID_ATEL" 5 "FID_ATEN" 6 "FId_EGSDCmnSeg1B1Parl" 7 "FID_BLLRH" 8 "FID_BLLRKH" 9 "FID_BPLSU" 10 "FId_CJ135RvsChrgMeasS1B1" 11 "FId_CatHeatgColdStrtReq" 12 "FId_CatHeatgWrmReq" 13 "FId_EGSDO2SnsrMntdRelsS1B1" 14 "FId_EGSDO2_LamOffsFastS1B1" 15 "FId_MisfDetDnAdpnNv" DEFAULT_VALUE "---" /end COMPU_VTAB
/begin COMPU_METHOD DSCHED_FIdWTTVerb "" TAB_VERB "%6.3" "-" COMPU_TAB_REF DSCHED_FIdWTTVerb /end COMPU_METHOD
/begin COMPU_VTAB DSCHED_FIdWTTVerb "" TAB_VERB 31 0 "FId_Unused" 1 "FID_AFRA_Reset" 2 "FID_AORA_Reset" 3 "FID_ATEH_Reset" 4 "FID_ATEL_Reset" 5 "FID_ATEN_Reset" 6 "FId_EGSDCmnSeg1B1Parl_Reset" 7 "FID_BLLRH_Reset" 8 "FID_BLLRKH_Reset" 9 "FID_BPLSU_Reset" 10 "FId_CJ135RvsChrgMeasS1B1_Reset" 11 "FId_CatHeatgColdStrtReq_Reset" 12 "FId_CatHeatgWrmReq_Reset" 13 "FId_EGSDO2SnsrMntdRelsS1B1_Reset" 14 "FId_EGSDO2_LamOffsFastS1B1_Reset" 15 "FId_MisfDetDnAdpnNv_Reset" 32769 "FID_AFRA_Activate" 32770 "FID_AORA_Activate" 32771 "FID_ATEH_Activate" 32772 "FID_ATEL_Activate" 32773 "FID_ATEN_Activate" 32774 "FId_EGSDCmnSeg1B1Parl_Activate" 32775 "FID_BLLRH_Activate" 32776 "FID_BLLRKH_Activate" 32777 "FID_BPLSU_Activate" 32778 "FId_CJ135RvsChrgMeasS1B1_Activate" 32779 "FId_CatHeatgColdStrtReq_Activate" 32780 "FId_CatHeatgWrmReq_Activate" 32781 "FId_EGSDO2SnsrMntdRelsS1B1_Activate" 32782 "FId_EGSDO2_LamOffsFastS1B1_Activate" 32783 "FId_MisfDetDnAdpnNv_Activate" DEFAULT_VALUE "---" /end COMPU_VTAB
/begin COMPU_METHOD DSCHED_Time100ms "" RAT_FUNC "%6.3" "s" COEFFS 0 10 0 0 0 1 /end COMPU_METHOD
/begin COMPU_METHOD DSCHED_Time200ms "" RAT_FUNC "%6.3" "s" COEFFS 0 5 0 0 0 1 /end COMPU_METHOD
/begin COMPU_METHOD ERCLNTVLVT_TYPAVL_SC_Compu "" TAB_VERB "%6.3" "" COMPU_TAB_REF ERCLNTVLVT_TYPAVL_SC_Compu /end COMPU_METHOD
/begin COMPU_VTAB ERCLNTVLVT_TYPAVL_SC_Compu "" TAB_VERB 2 0 "False" 1 "True" /end COMPU_VTAB
/begin COMPU_METHOD ERCLNTVLV_TYPAVLACTRLIB_SY_Compu "" TAB_VERB "%6.3" "" COMPU_TAB_REF ERCLNTVLV_TYPAVLACTRLIB_SY_Compu /end COMPU_METHOD
/begin COMPU_VTAB ERCLNTVLV_TYPAVLACTRLIB_SY_Compu "" TAB_VERB 2 0 "False" 1 "True" /end COMPU_VTAB
/begin COMPU_METHOD ERCLNTVLV_TYPAVL_SY_Compu "" TAB_VERB "%6.3" "" COMPU_TAB_REF ERCLNTVLV_TYPAVL_SY_Compu /end COMPU_METHOD
/begin COMPU_VTAB ERCLNTVLV_TYPAVL_SY_Compu "" TAB_VERB 2 0 "FALSE" 1 "TRUE" /end COMPU_VTAB
/begin COMPU_METHOD ERRLMP_CUST_SY_Compu "" TAB_VERB "%6.3" "" COMPU_TAB_REF ERRLMP_CUST_SY_Compu /end COMPU_METHOD
/begin COMPU_VTAB ERRLMP_CUST_SY_Compu "" TAB_VERB 5 0 "ERRLMP_RB" 1 "ERRLMP_VAG" 2 "ERRLMP_BMW" 3 "ERRLMP_DAcom" 4 "ERRLMP_MSE" /end COMPU_VTAB
/begin COMPU_METHOD ERRLMP_UNIFY_SC_Compu "" TAB_VERB "%6.3" "" COMPU_TAB_REF ERRLMP_UNIFY_SC_Compu /end COMPU_METHOD
/begin COMPU_VTAB ERRLMP_UNIFY_SC_Compu "" TAB_VERB 2 0 "False" 1 "True" /end COMPU_VTAB
/begin COMPU_METHOD ERRREACHPINJVLVSTK_SY_Compu "" TAB_VERB "%6.3" "" COMPU_TAB_REF ERRREACHPINJVLVSTK_SY_Compu /end COMPU_METHOD
/begin COMPU_VTAB ERRREACHPINJVLVSTK_SY_Compu "" TAB_VERB 2 0 "FALSE" 1 "TRUE" /end COMPU_VTAB
/begin COMPU_METHOD ESC_ACTVTSYNCHAINCFG_SC_Compu "" TAB_VERB "%6.3" "" COMPU_TAB_REF ESC_ACTVTSYNCHAINCFG_SC_Compu /end COMPU_METHOD
/begin COMPU_VTAB ESC_ACTVTSYNCHAINCFG_SC_Compu "" TAB_VERB 3 0 "ACTVTSYNCHAIN_NONE" 1 "ACTVTSYNCHAIN_EBOS" 2 "ACTVTSYNCHAIN_ESC" /end COMPU_VTAB
/begin COMPU_METHOD ESC_ACTVTSYNTSKCHAIN_SC_Compu "" TAB_VERB "%6.3" "" COMPU_TAB_REF ESC_ACTVTSYNTSKCHAIN_SC_Compu /end COMPU_METHOD
/begin COMPU_VTAB ESC_ACTVTSYNTSKCHAIN_SC_Compu "" TAB_VERB 2 0 "DEACTIVE" 1 "ACTIVE" /end COMPU_VTAB
/begin COMPU_METHOD ESC_ENAPROCGROUP_SC_Compu "" TAB_VERB "%6.3" "" COMPU_TAB_REF ESC_ENAPROCGROUP_SC_Compu /end COMPU_METHOD
/begin COMPU_VTAB ESC_ENAPROCGROUP_SC_Compu "" TAB_VERB 2 0 "DISABLED" 1 "ENABLED" /end COMPU_VTAB
/begin COMPU_METHOD ESC_NRAGEVEWCYC_SC_Compu "" RAT_FUNC "%6.2" "" COEFFS 0 1 0 0 0 1 /end COMPU_METHOD
/begin COMPU_METHOD ESC_NRTSKAGEVE_SC_Compu "" RAT_FUNC "%6.2" "" COEFFS 0 1 0 0 0 1 /end COMPU_METHOD
/begin COMPU_METHOD ESC_SAMPLETICALCN_SC_Compu "" TAB_VERB "%6.3" "" COMPU_TAB_REF ESC_SAMPLETICALCN_SC_Compu /end COMPU_METHOD
/begin COMPU_VTAB ESC_SAMPLETICALCN_SC_Compu "" TAB_VERB 2 0 "SEG_AG_BASD" 1 "TSK_TI_STAMP_BASD" /end COMPU_VTAB
/begin COMPU_METHOD OneToOne "" RAT_FUNC "%6.2" "-" COEFFS 0 1 0 0 0 1 /end COMPU_METHOD
/begin COMPU_METHOD Signals_IntSigNumVerb "" TAB_VERB "%6.3" "" COMPU_TAB_REF Signals_IntSigNumVerb /end COMPU_METHOD
/begin COMPU_VTAB Signals_IntSigNumVerb "" TAB_VERB 783 0 "SIGNALS_Signals_Default" 1 "SIGNALS_APP_rUnFlt" 2 "SIGNALS_APP_r_sig" 3 "SIGNALS_APP_r_signal" 4 "SIGNALS_APP_uRaw1_signal" 5 "SIGNALS_APP_uRaw2_signal" 6 "SIGNALS_AbsLdCom8Bit_PID43h" 7 "SIGNALS_AccPed_tqMapBasd_BENG_signal" 8 "SIGNALS_AccPed_tqMapBasd_TRQB_signal" 9 "SIGNALS_ActMod_trqInr_signal" 10 "SIGNALS_AirC_uAnaRawClnt_signal" 11 "SIGNALS_Alt_iExctLim_signal" 12 "SIGNALS_Alt_rAltExct_signal" 13 "SIGNALS_Alt_uFinalDes_signal" 14 "SIGNALS_BattU_u" 15 "SIGNALS_BattU_uSens1_signal" 16 "SIGNALS_BattU_uSens2_s" 17 "SIGNALS_BattU_uSens_signal" 18 "SIGNALS_Batt_lMaxCnsChk_signal" 19 "SIGNALS_Batt_lMinCnsChk_signal" 20 "SIGNALS_Batt_qCnsChkAH_signal" 21 "SIGNALS_Brk_st" 22 "SIGNALS_Brk_stRed" 23 "SIGNALS_CEngDsT_uRaw_s" 24 "SIGNALS_CoEng_tiCranking_signal" 25 "SIGNALS_CoEng_tiScneEngStrtPrmIdH1F_signal" 26 "SIGNALS_CoVeh_trqAcs_s" 27 "SIGNALS_ComEBS_BattID_signal" 28 "SIGNALS_ComEBS_rBattSensCh_signal" 29 "SIGNALS_ComEBS_uBattSens_signal" 30 "SIGNALS_ComEBS_uBattUCO_signal" 31 "SIGNALS_Com_iBattEBS_signal" 32 "SIGNALS_Com_lDst_signal" 33 "SIGNALS_Com_rMeasdBattREbs_signal" 34 "SIGNALS_Com_tBattEBS_signal" 35 "SIGNALS_Com_trqAYCFDes_signal" 36 "SIGNALS_Com_uPeak_signal" 37 "SIGNALS_CrCtl_stShutOffCode0_signal" 38 "SIGNALS_CrCtl_stShutOffCode1_signal" 39 "SIGNALS_CrCtl_stShutOffCode2_signal" 40 "SIGNALS_CrCtl_stShutOffCode3_signal" 41 "SIGNALS_CrCtl_stShutOffCode4_signal" 42 "SIGNALS_CrCtl_stShutOffCode5_signal" 43 "SIGNALS_CrCtl_stShutOffCode6_signal" 44 "SIGNALS_CrCtl_stShutOffCode7_signal" 45 "SIGNALS_CrCtl_stShutOffCode8_signal" 46 "SIGNALS_CrCtl_stShutOffCode9_signal" 47 "SIGNALS_DIUMPR_ctGenDenom_signal" 48 "SIGNALS_DIUMPR_ctIgn_signal" 49 "SIGNALS_DRIVE_numDTCFrz_s" 50 "SIGNALS_DRIVE_stCurTrgMode_signal" 51 "SIGNALS_DRIVE_stHardToStrt_s" 52 "SIGNALS_DSMDur_ctPID21h_signal" 53 "SIGNALS_DSMDur_ctPID31h_signal" 54 "SIGNALS_DcmDspUDS_rdbi_2612Byte10_signal" 55 "SIGNALS_DcmDspUDS_rdbi_2612Byte11_signal" 56 "SIGNALS_DcmDspUDS_rdbi_fixed_signal" 57 "SIGNALS_DcmDspUDS_rdbi_reserved0_signal_s" 58 "SIGNALS_DcmDspUDS_rdbi_reserved0_signal_w_s" 59 "SIGNALS_DcmDspUDS_rdbi_reserved1_signal" 60 "SIGNALS_Dspl_stCrsSwtInfo_signal" 61 "SIGNALS_Ebs_qBliChrg_signal" 62 "SIGNALS_Ebs_qBliDchaTotDcyc_0_signal" 63 "SIGNALS_Ebs_qBliDchaTotDcyc_1_signal" 64 "SIGNALS_Ebs_qBliDchaTotDcyc_2_signal" 65 "SIGNALS_Ebs_qBliDchaTotDcyc_3_signal" 66 "SIGNALS_Ebs_qBliDchaTotDcyc_4_signal" 67 "SIGNALS_Ebs_qBliDcha_signal" 68 "SIGNALS_Ebs_stStbIEBSByt0_0_signal" 69 "SIGNALS_Ebs_stStbIEBSByt0_1_signal" 70 "SIGNALS_Ebs_stStbIEBSByt0_2_signal" 71 "SIGNALS_Ebs_stStbIEBSByt0_3_signal" 72 "SIGNALS_Ebs_stStbIEBSByt0_4_signal" 73 "SIGNALS_Ebs_stStbIEBSByt1_0_signal" 74 "SIGNALS_Ebs_stStbIEBSByt1_1_signal" 75 "SIGNALS_Ebs_stStbIEBSByt1_2_signal" 76 "SIGNALS_Ebs_stStbIEBSByt1_3_signal" 77 "SIGNALS_Ebs_stStbIEBSByt1_4_signal" 78 "SIGNALS_Ebs_stStbIEBSByt2_0_signal" 79 "SIGNALS_Ebs_stStbIEBSByt2_1_signal" 80 "SIGNALS_Ebs_stStbIEBSByt2_2_signal" 81 "SIGNALS_Ebs_stStbIEBSByt2_3_signal" 82 "SIGNALS_Ebs_stStbIEBSByt2_4_signal" 83 "SIGNALS_Ebs_stStbIEBSByt3_0_signal" 84 "SIGNALS_Ebs_stStbIEBSByt3_1_signal" 85 "SIGNALS_Ebs_stStbIEBSByt3_2_signal" 86 "SIGNALS_Ebs_stStbIEBSByt3_3_signal" 87 "SIGNALS_Ebs_stStbIEBSByt3_4_signal" 88 "SIGNALS_Ebs_stStbIEBSByt4_0_signal" 89 "SIGNALS_Ebs_stStbIEBSByt4_1_signal" 90 "SIGNALS_Ebs_stStbIEBSByt4_2_signal" 91 "SIGNALS_Ebs_stStbIEBSByt4_3_signal" 92 "SIGNALS_Ebs_stStbIEBSByt4_4_signal" 93 "SIGNALS_EngTrqPtd_trqLead_s" 94 "SIGNALS_EngTrqPtd_trqLead_signal" 95 "SIGNALS_EngTrqPtd_trqSet_s" 96 "SIGNALS_EngTrqPtd_trqSet_signal" 97 "SIGNALS_EpmCaS_ctErrSig_signal" 98 "SIGNALS_EpmCaS_ctNoSig_signal" 99 "SIGNALS_EpmCaS_phiDiffCal2AdapEqAvg_0" 100 "SIGNALS_EpmCaS_phiOfsCorr" 101 "SIGNALS_EpmCrS_ctCaSRev_mp_signal" 102 "SIGNALS_EpmCrS_ctErrSig_signal" 103 "SIGNALS_Epm_nEngAct" 104 "SIGNALS_Epm_nEngRaw_s" 105 "SIGNALS_Epm_nEngRaw_signal" 106 "SIGNALS_Epm_stOpMode" 107 "SIGNALS_Epm_stSync" 108 "SIGNALS_ExhMod_tCat1B1_signal" 109 "SIGNALS_GlbDa_lenTotDstDcycHiResl_signal" 110 "SIGNALS_HEGO_uS2B1Extd_s" 111 "SIGNALS_HEGO_uS2B1HiRes_signal" 112 "SIGNALS_I14229CoEng_tiNormalOBDPrevDcyc_s" 113 "SIGNALS_I14229GlbDa_lTotDstDCHiReslPrevDcyc_s" 114 "SIGNALS_I14229IntkAirT_tSnsrTstrMax_s" 115 "SIGNALS_I14229IntkAirT_tSnsrTstrMin_s" 116 "SIGNALS_I14229RDBI_nOvrSpd_signal" 117 "SIGNALS_I14229RDBI_tiOvrSpd_signal" 118 "SIGNALS_I14229_ElecLd_iEPSLoadOnly_signal" 119 "SIGNALS_I14229_EpmCrS_ctErrSig_signal" 120 "SIGNALS_I14229_ivzabg_w_signal" 121 "SIGNALS_I14229_lDst_signal" 122 "SIGNALS_I14229_ml_w_msg_signal" 123 "SIGNALS_I14229_nstat_signal" 124 "SIGNALS_I14229_numDTCFrzFrmHi_signal" 125 "SIGNALS_I14229_numDTCFrzFrmLo_signal" 126 "SIGNALS_I14229_numDTCFrzFrmMid_signal" 127 "SIGNALS_I14229_ps_w_signal" 128 "SIGNALS_I14229_rTrqPT_signal" 129 "SIGNALS_I14229_tSnsrFild1_signal" 130 "SIGNALS_I14229_tiInj1On_signal" 131 "SIGNALS_I14229_tiOilFlowCompl_signal" 132 "SIGNALS_I14229_tiSia_signal" 133 "SIGNALS_I14229_tkaMax_s" 134 "SIGNALS_I14229_tkaMin_s" 135 "SIGNALS_I14229_tka_signal" 136 "SIGNALS_I14229_tmotMaxCurrDcyc_s" 137 "SIGNALS_I14229_tmotMaxPrevDcyc_s" 138 "SIGNALS_I14229_tmotMinCurrDcyc_s" 139 "SIGNALS_I14229_tmotMinPrevDcyc_s" 140 "SIGNALS_I14229_ubsq_signal" 141 "SIGNALS_I14229_umsrln_w_signal" 142 "SIGNALS_I14229_wdks_w_signal" 143 "SIGNALS_I14229_wped1_signal" 144 "SIGNALS_I14229_wped2_signal" 145 "SIGNALS_I14229_zwist_signal" 146 "SIGNALS_I14229iocpMDA_numACGC_signal" 147 "SIGNALS_I14229iocpMDA_numAPS_signal" 148 "SIGNALS_I14229iocpMDA_numPSC_signal" 149 "SIGNALS_I14229iocpMDA_numRFAN_signal" 150 "SIGNALS_I14229iocpMDA_numVTEC_signal" 151 "SIGNALS_I14229iocp_numCtlSt_s" 152 "SIGNALS_I14229iocp_numEXE_signal" 153 "SIGNALS_I14229iocp_numREQ_s" 154 "SIGNALS_I14229iocp_stSFTRJC_s" 155 "SIGNALS_I15031_PID1Dh" 156 "SIGNALS_I15031_PID65Ah" 157 "SIGNALS_I15031_PID66Ah" 158 "SIGNALS_I15031_PID68Ah" 159 "SIGNALS_I15031_PID69Ah" 160 "SIGNALS_I15031_PID6AAh" 161 "SIGNALS_I15031_PID6BAh" 162 "SIGNALS_I15031_PID6CAh" 163 "SIGNALS_I15031_PID6DAh" 164 "SIGNALS_I15031_PID6EAh" 165 "SIGNALS_I15031_PID6FAh" 166 "SIGNALS_I15031_PID70Ah" 167 "SIGNALS_I15031_PID71Ah" 168 "SIGNALS_I15031_PID72Ah" 169 "SIGNALS_I15031_PID73Ah" 170 "SIGNALS_I15031_PID74Ah" 171 "SIGNALS_I15031_PID75Ah" 172 "SIGNALS_I15031_PID76Ah" 173 "SIGNALS_I15031_PID77Ah" 174 "SIGNALS_I15031_PID78Ah" 175 "SIGNALS_I15031_PID79Ah" 176 "SIGNALS_I15031_PID7AAh" 177 "SIGNALS_I15031_PID7BAh" 178 "SIGNALS_I15031_PID7CAh" 179 "SIGNALS_I15031_PID7FAh" 180 "SIGNALS_I15031_PID81Ah" 181 "SIGNALS_I15031_PID82Ah" 182 "SIGNALS_I15031_PID85Ah" 183 "SIGNALS_I15031_PID86Ah" 184 "SIGNALS_I15031_PID87Ah" 185 "SIGNALS_I15031_PID89Ah" 186 "SIGNALS_I15031_PID8AAh" 187 "SIGNALS_I15031_PID8FAh" 188 "SIGNALS_I15031_PID92Ah" 189 "SIGNALS_I15031_PID93Ah" 190 "SIGNALS_I15031_PID94Ah" 191 "SIGNALS_I15031_PID98Ah" 192 "SIGNALS_I15031_PID99Ah" 193 "SIGNALS_I15031_PID9CAh" 194 "SIGNALS_I15031_PIDA3Ah" 195 "SIGNALS_I15031_PIDA4Ah" 196 "SIGNALS_I15031_PIDA5Ah" 197 "SIGNALS_I15031_PIDA9Ah" 198 "SIGNALS_I15031_PIDACAh" 199 "SIGNALS_IKCtl_agAdpnCurr_s16_signal" 200 "SIGNALS_IKCtl_agKnkAvrg_s8_signal" 201 "SIGNALS_InjSys_volFuConsDrvCycCAN_s" 202 "SIGNALS_IntkAirT_uSnsr1Exprt_signal" 203 "SIGNALS_IntkAirT_uSnsr3CrssSwtLoc_s" 204 "SIGNALS_MoF_rTrqInrAct_s" 205 "SIGNALS_MoF_rTrqPtdFlt_s" 206 "SIGNALS_OilLfT_degOilDetern_signal" 207 "SIGNALS_OilSwmpT_uSnsrRaw_s" 208 "SIGNALS_PID01h" 209 "SIGNALS_PID03h_0" 210 "SIGNALS_PID03h_1" 211 "SIGNALS_PID04h" 212 "SIGNALS_PID05h" 213 "SIGNALS_PID06h_0" 214 "SIGNALS_PID07h_0" 215 "SIGNALS_PID0Ch_Epm_nEng" 216 "SIGNALS_PID0D_VehV_vSens" 217 "SIGNALS_PID0Eh" 218 "SIGNALS_PID0Fh" 219 "SIGNALS_PID0Fh_s" 220 "SIGNALS_PID0bh" 221 "SIGNALS_PID0bh_PIntkVUs_pRawObd" 222 "SIGNALS_PID11h_ThrVlv_ratActSens1AbsltB1_u8" 223 "SIGNALS_PID13h" 224 "SIGNALS_PID15h_0" 225 "SIGNALS_PID15h_1" 226 "SIGNALS_PID1Ch" 227 "SIGNALS_PID1Fh_TiScneEngStrt" 228 "SIGNALS_PID21h" 229 "SIGNALS_PID2Eh" 230 "SIGNALS_PID30h" 231 "SIGNALS_PID31h" 232 "SIGNALS_PID33h_PEnv_pRaw" 233 "SIGNALS_PID34h_0" 234 "SIGNALS_PID34h_1" 235 "SIGNALS_PID3Ch" 236 "SIGNALS_PID42_BattU_uSens" 237 "SIGNALS_PID43h" 238 "SIGNALS_PID44h" 239 "SIGNALS_PID45h_ThrVlv_ratActSens1RelB1_u8" 240 "SIGNALS_PID46h" 241 "SIGNALS_PID47h_ThrVlv_ratActSens2AbsltB1_u8" 242 "SIGNALS_PID49_APP_uRaw1unLim" 243 "SIGNALS_PID4A_APP_uRaw2unLim" 244 "SIGNALS_PID4Ch_wdks_msg" 245 "SIGNALS_PID4FAh" 246 "SIGNALS_PID4FBh" 247 "SIGNALS_PID4FCh" 248 "SIGNALS_PID4FDh" 249 "SIGNALS_PID50Ah" 250 "SIGNALS_PID50Bh" 251 "SIGNALS_PID50Ch" 252 "SIGNALS_PID50Dh" 253 "SIGNALS_PID51h_PID51_stFuTyp" 254 "SIGNALS_PID56h_0" 255 "SIGNALS_PID5A_APP_rOBDPID5A" 256 "SIGNALS_PID5Fh" 257 "SIGNALS_PID62h_TME_ratActEngPercTqPrmIdH62" 258 "SIGNALS_IntFloat_PID63h_TqEngRef" 259 "SIGNALS_PID67h_ects2sva_msg" 260 "SIGNALS_PID67h_ects2svb_msg" 261 "SIGNALS_PID67h_ects2svc_msg" 262 "SIGNALS_PID68h_iats2svb" 263 "SIGNALS_PID68h_iats2svc" 264 "SIGNALS_PID68h_iats2svd" 265 "SIGNALS_PID68h_iats2sve" 266 "SIGNALS_PID68h_iats2svf" 267 "SIGNALS_PID68h_iats2svg" 268 "SIGNALS_PID7Fh_RTId_TotRt" 269 "SIGNALS_PID7Fh_RtId_TotIdleRt" 270 "SIGNALS_PID7Fh_RtId_TotPtoRt" 271 "SIGNALS_PID87h_PIntkVUs_pRawObd" 272 "SIGNALS_PID8BAh" 273 "SIGNALS_PID8CAh" 274 "SIGNALS_PID8Eh_TME_ratEngFricPercTqPrmIdH8E" 275 "SIGNALS_PID9AAh" 276 "SIGNALS_PID9Dh_InjSys_mfEngFuRate" 277 "SIGNALS_PID9Dh_InjSys_mfVehFuRate" 278 "SIGNALS_PID9FAh" 279 "SIGNALS_PIDA6h_lTotDst" 280 "SIGNALS_PID_FILLSIG_1BIT" 281 "SIGNALS_PID_FILLSIG_1BITNZ" 282 "SIGNALS_PID_FILLSIG_1BYTE" 283 "SIGNALS_PID_FILLSIG_1BYTENZ" 284 "SIGNALS_PID_FILLSIG_2BIT" 285 "SIGNALS_PID_FILLSIG_2BITNZ" 286 "SIGNALS_PID_FILLSIG_2BYTE" 287 "SIGNALS_PID_FILLSIG_2BYTENZ" 288 "SIGNALS_PID_FILLSIG_3BIT" 289 "SIGNALS_PID_FILLSIG_3BITNZ" 290 "SIGNALS_PID_FILLSIG_4BIT" 291 "SIGNALS_PID_FILLSIG_4BITNZ" 292 "SIGNALS_PID_FILLSIG_4BYTE" 293 "SIGNALS_PID_FILLSIG_4BYTENZ" 294 "SIGNALS_PID_FILLSIG_5BIT" 295 "SIGNALS_PID_FILLSIG_5BITNZ" 296 "SIGNALS_PID_FILLSIG_6BIT" 297 "SIGNALS_PID_FILLSIG_6BITNZ" 298 "SIGNALS_PID_FILLSIG_7BIT" 299 "SIGNALS_PID_FILLSIG_7BITNZ" 300 "SIGNALS_PIntkVUs_uRawUnFlt_signal" 301 "SIGNALS_PT_rGrip_signal" 302 "SIGNALS_PT_trqLos_signal" 303 "SIGNALS_PtCoornDyn_tqCluDes_signal" 304 "SIGNALS_PtCoornDyn_tqCluLeadTrsmIntv_signal" 305 "SIGNALS_PthLead_trqInrNoMon_s" 306 "SIGNALS_PthLead_trqInrNoMon_signal" 307 "SIGNALS_PthSet_trqInrIABef_s" 308 "SIGNALS_PthSet_trqInrLtd_s" 309 "SIGNALS_RngMod_trqDiffAdap_signal" 310 "SIGNALS_RngMod_trqInrBs_s" 311 "SIGNALS_TWCD_numMeasB1_s" 312 "SIGNALS_TWCD_rOSCAvrgPriB1_s" 313 "SIGNALS_ThrVlv_uRawSens1B1_signal" 314 "SIGNALS_ThrVlv_uRawSens2B1_signal" 315 "SIGNALS_TiEngOff_ti_signal" 316 "SIGNALS_UEGO_ratLamSrv1S1B1_signal" 317 "SIGNALS_VehStc_numFuDiagRecA_0_s" 318 "SIGNALS_VehStc_numFuDiagRecA_10_s" 319 "SIGNALS_VehStc_numFuDiagRecA_11_s" 320 "SIGNALS_VehStc_numFuDiagRecA_12_s" 321 "SIGNALS_VehStc_numFuDiagRecA_13_s" 322 "SIGNALS_VehStc_numFuDiagRecA_14_s" 323 "SIGNALS_VehStc_numFuDiagRecA_15_s" 324 "SIGNALS_VehStc_numFuDiagRecA_16_s" 325 "SIGNALS_VehStc_numFuDiagRecA_17_s" 326 "SIGNALS_VehStc_numFuDiagRecA_18_s" 327 "SIGNALS_VehStc_numFuDiagRecA_19_s" 328 "SIGNALS_VehStc_numFuDiagRecA_1_s" 329 "SIGNALS_VehStc_numFuDiagRecA_20_s" 330 "SIGNALS_VehStc_numFuDiagRecA_2_s" 331 "SIGNALS_VehStc_numFuDiagRecA_3_s" 332 "SIGNALS_VehStc_numFuDiagRecA_4_s" 333 "SIGNALS_VehStc_numFuDiagRecA_5_s" 334 "SIGNALS_VehStc_numFuDiagRecA_6_s" 335 "SIGNALS_VehStc_numFuDiagRecA_7_s" 336 "SIGNALS_VehStc_numFuDiagRecA_8_s" 337 "SIGNALS_VehStc_numFuDiagRecA_9_s" 338 "SIGNALS_VehStc_numMisfDetnHiEctA_0_s" 339 "SIGNALS_VehStc_numMisfDetnHiEctA_10_s" 340 "SIGNALS_VehStc_numMisfDetnHiEctA_11_s" 341 "SIGNALS_VehStc_numMisfDetnHiEctA_12_s" 342 "SIGNALS_VehStc_numMisfDetnHiEctA_13_s" 343 "SIGNALS_VehStc_numMisfDetnHiEctA_14_s" 344 "SIGNALS_VehStc_numMisfDetnHiEctA_15_s" 345 "SIGNALS_VehStc_numMisfDetnHiEctA_16_s" 346 "SIGNALS_VehStc_numMisfDetnHiEctA_17_s" 347 "SIGNALS_VehStc_numMisfDetnHiEctA_18_s" 348 "SIGNALS_VehStc_numMisfDetnHiEctA_19_s" 349 "SIGNALS_VehStc_numMisfDetnHiEctA_1_s" 350 "SIGNALS_VehStc_numMisfDetnHiEctA_20_s" 351 "SIGNALS_VehStc_numMisfDetnHiEctA_2_s" 352 "SIGNALS_VehStc_numMisfDetnHiEctA_3_s" 353 "SIGNALS_VehStc_numMisfDetnHiEctA_4_s" 354 "SIGNALS_VehStc_numMisfDetnHiEctA_5_s" 355 "SIGNALS_VehStc_numMisfDetnHiEctA_6_s" 356 "SIGNALS_VehStc_numMisfDetnHiEctA_7_s" 357 "SIGNALS_VehStc_numMisfDetnHiEctA_8_s" 358 "SIGNALS_VehStc_numMisfDetnHiEctA_9_s" 359 "SIGNALS_VehStc_numMisfDetnLoEctA_0_s" 360 "SIGNALS_VehStc_numMisfDetnLoEctA_10_s" 361 "SIGNALS_VehStc_numMisfDetnLoEctA_11_s" 362 "SIGNALS_VehStc_numMisfDetnLoEctA_12_s" 363 "SIGNALS_VehStc_numMisfDetnLoEctA_13_s" 364 "SIGNALS_VehStc_numMisfDetnLoEctA_14_s" 365 "SIGNALS_VehStc_numMisfDetnLoEctA_15_s" 366 "SIGNALS_VehStc_numMisfDetnLoEctA_16_s" 367 "SIGNALS_VehStc_numMisfDetnLoEctA_17_s" 368 "SIGNALS_VehStc_numMisfDetnLoEctA_18_s" 369 "SIGNALS_VehStc_numMisfDetnLoEctA_19_s" 370 "SIGNALS_VehStc_numMisfDetnLoEctA_1_s" 371 "SIGNALS_VehStc_numMisfDetnLoEctA_20_s" 372 "SIGNALS_VehStc_numMisfDetnLoEctA_2_s" 373 "SIGNALS_VehStc_numMisfDetnLoEctA_3_s" 374 "SIGNALS_VehStc_numMisfDetnLoEctA_4_s" 375 "SIGNALS_VehStc_numMisfDetnLoEctA_5_s" 376 "SIGNALS_VehStc_numMisfDetnLoEctA_6_s" 377 "SIGNALS_VehStc_numMisfDetnLoEctA_7_s" 378 "SIGNALS_VehStc_numMisfDetnLoEctA_8_s" 379 "SIGNALS_VehStc_numMisfDetnLoEctA_9_s" 380 "SIGNALS_VehStc_numMisfDetnNormA_0_s" 381 "SIGNALS_VehStc_numMisfDetnNormA_10_s" 382 "SIGNALS_VehStc_numMisfDetnNormA_11_s" 383 "SIGNALS_VehStc_numMisfDetnNormA_12_s" 384 "SIGNALS_VehStc_numMisfDetnNormA_13_s" 385 "SIGNALS_VehStc_numMisfDetnNormA_14_s" 386 "SIGNALS_VehStc_numMisfDetnNormA_15_s" 387 "SIGNALS_VehStc_numMisfDetnNormA_16_s" 388 "SIGNALS_VehStc_numMisfDetnNormA_17_s" 389 "SIGNALS_VehStc_numMisfDetnNormA_18_s" 390 "SIGNALS_VehStc_numMisfDetnNormA_19_s" 391 "SIGNALS_VehStc_numMisfDetnNormA_1_s" 392 "SIGNALS_VehStc_numMisfDetnNormA_20_s" 393 "SIGNALS_VehStc_numMisfDetnNormA_2_s" 394 "SIGNALS_VehStc_numMisfDetnNormA_3_s" 395 "SIGNALS_VehStc_numMisfDetnNormA_4_s" 396 "SIGNALS_VehStc_numMisfDetnNormA_5_s" 397 "SIGNALS_VehStc_numMisfDetnNormA_6_s" 398 "SIGNALS_VehStc_numMisfDetnNormA_7_s" 399 "SIGNALS_VehStc_numMisfDetnNormA_8_s" 400 "SIGNALS_VehStc_numMisfDetnNormA_9_s" 401 "SIGNALS_VehStc_rDiagRsltB1A_0_s" 402 "SIGNALS_VehStc_rDiagRsltB1A_1_s" 403 "SIGNALS_VehStc_rDiagRsltB1A_2_s" 404 "SIGNALS_VehStc_rDiagRsltB1A_3_s" 405 "SIGNALS_VehStc_rDiagRsltB1A_4_s" 406 "SIGNALS_VehV_a" 407 "SIGNALS_VehV_v" 408 "SIGNALS_VehV_vSens_signal" 409 "SIGNALS_flglrs_msg_s" 410 "SIGNALS_fra_w_msg_signal" 411 "SIGNALS_fra_w_s" 412 "SIGNALS_ftead_w_msg_s" 413 "SIGNALS_ftead_w_si" 414 "SIGNALS_ftead_w_signal" 415 "SIGNALS_lamsobd_w_msg_s" 416 "SIGNALS_lutskzyl_w_0_signal" 417 "SIGNALS_lutskzyl_w_1_signal" 418 "SIGNALS_lutskzyl_w_2_signal" 419 "SIGNALS_lutskzyl_w_3_signal" 420 "SIGNALS_lutskzyl_w_msg_0_signal" 421 "SIGNALS_lutskzyl_w_msg_1_signal" 422 "SIGNALS_lutskzyl_w_msg_2_signal" 423 "SIGNALS_lutskzyl_w_msg_3_signal" 424 "SIGNALS_ofmsndkh1_w_msg_signal" 425 "SIGNALS_ofmsndkh2_w_msg_signal" 426 "SIGNALS_ora_w_msg_signal" 427 "SIGNALS_tateout_w_msg_signal" 428 "SIGNALS_tateout_w_signal" 429 "SIGNALS_tatesoll_w_msg_signal" 430 "SIGNALS_tmst_signal" 431 "SIGNALS_wkratst_signal" 432 "SIGNALS_PID83h_A_BitCombineSignal" 433 "SIGNALS_PID9Bh_A_BitCombineSignal" 434 "SIGNALS_PIDA1h_A_BitCombineSignal" 435 "SIGNALS_PIDA7h_A_BitCombineSignal" 436 "SIGNALS_PIDA8h_A_BitCombineSignal" 437 "SIGNALS_Virtual_CEngDsT_uRaw_signal" 438 "SIGNALS_Virtual_DcmDspUDS_2600Byte06_signal" 439 "SIGNALS_Virtual_DcmDspUDS_2610Byte00_signal" 440 "SIGNALS_Virtual_DcmDspUDS_2610Byte01_signal" 441 "SIGNALS_Virtual_DcmDspUDS_2610Byte02_signal" 442 "SIGNALS_Virtual_DcmDspUDS_2610Byte03_signal" 443 "SIGNALS_Virtual_DcmDspUDS_2610Byte04_signal" 444 "SIGNALS_Virtual_DcmDspUDS_2610Byte05_signal" 445 "SIGNALS_Virtual_DcmDspUDS_2610Byte10_signal" 446 "SIGNALS_Virtual_DcmDspUDS_2610Byte1F_signal" 447 "SIGNALS_Virtual_DcmDspUDS_2610Byte20_signal" 448 "SIGNALS_Virtual_DcmDspUDS_2610Byte25_signal" 449 "SIGNALS_Virtual_DcmDspUDS_2610Byte26_signal" 450 "SIGNALS_Virtual_DcmDspUDS_2611Byte00_signal" 451 "SIGNALS_Virtual_DcmDspUDS_2611Byte01_signal" 452 "SIGNALS_Virtual_DcmDspUDS_2611Byte02_signal" 453 "SIGNALS_Virtual_DcmDspUDS_2611Byte03_signal" 454 "SIGNALS_Virtual_DcmDspUDS_2611Byte04_signal" 455 "SIGNALS_Virtual_DcmDspUDS_2611Byte05_signal" 456 "SIGNALS_Virtual_DcmDspUDS_2611Byte06_07_signal" 457 "SIGNALS_Virtual_DcmDspUDS_2611Byte2A_signal" 458 "SIGNALS_Virtual_DcmDspUDS_2611Byte2B_signal" 459 "SIGNALS_Virtual_DcmDspUDS_2612Byte00_signal" 460 "SIGNALS_Virtual_DcmDspUDS_2612Byte01_signal" 461 "SIGNALS_Virtual_DcmDspUDS_2612Byte02_signal" 462 "SIGNALS_Virtual_DcmDspUDS_2612Byte03_signal" 463 "SIGNALS_Virtual_DcmDspUDS_2612Byte04_signal" 464 "SIGNALS_Virtual_DcmDspUDS_2612Byte05_signal" 465 "SIGNALS_Virtual_DcmDspUDS_2612Byte14_signal" 466 "SIGNALS_Virtual_DcmDspUDS_2612Byte15_signal" 467 "SIGNALS_Virtual_DcmDspUDS_2612Byte16_signal" 468 "SIGNALS_Virtual_DcmDspUDS_2612Byte17_signal" 469 "SIGNALS_Virtual_DcmDspUDS_2612Byte29_signal" 470 "SIGNALS_Virtual_DcmDspUDS_2612Byte2A_signal" 471 "SIGNALS_Virtual_DcmDspUDS_2612Byte2B_signal" 472 "SIGNALS_Virtual_DcmDspUDS_2613Byte00_signal" 473 "SIGNALS_Virtual_DcmDspUDS_2613Byte01_signal" 474 "SIGNALS_Virtual_DcmDspUDS_2613Byte02_signal" 475 "SIGNALS_Virtual_DcmDspUDS_2613Byte03_signal" 476 "SIGNALS_Virtual_DcmDspUDS_2613Byte04_signal" 477 "SIGNALS_Virtual_DcmDspUDS_2613Byte05_signal" 478 "SIGNALS_Virtual_DcmDspUDS_2620Byte00_signal" 479 "SIGNALS_Virtual_DcmDspUDS_2620Byte01_signal" 480 "SIGNALS_Virtual_DcmDspUDS_2620Byte02_signal" 481 "SIGNALS_Virtual_DcmDspUDS_2620Byte03_signal" 482 "SIGNALS_Virtual_DcmDspUDS_2620Byte04_signal" 483 "SIGNALS_Virtual_DcmDspUDS_2620Byte05_signal" 484 "SIGNALS_Virtual_DcmDspUDS_2621Byte00_signal" 485 "SIGNALS_Virtual_DcmDspUDS_2621Byte01_signal" 486 "SIGNALS_Virtual_DcmDspUDS_2621Byte02_signal" 487 "SIGNALS_Virtual_DcmDspUDS_2621Byte03_signal" 488 "SIGNALS_Virtual_DcmDspUDS_2621Byte04_signal" 489 "SIGNALS_Virtual_DcmDspUDS_2621Byte05_signal" 490 "SIGNALS_Virtual_DcmDspUDS_2622Byte00_signal" 491 "SIGNALS_Virtual_DcmDspUDS_2622Byte01_signal" 492 "SIGNALS_Virtual_DcmDspUDS_2622Byte02_signal" 493 "SIGNALS_Virtual_DcmDspUDS_2622Byte03_signal" 494 "SIGNALS_Virtual_DcmDspUDS_2622Byte04_signal" 495 "SIGNALS_Virtual_DcmDspUDS_2622Byte05_signal" 496 "SIGNALS_Virtual_DcmDspUDS_2623Byte00_signal" 497 "SIGNALS_Virtual_DcmDspUDS_2623Byte01_signal" 498 "SIGNALS_Virtual_DcmDspUDS_2623Byte02_signal" 499 "SIGNALS_Virtual_DcmDspUDS_2623Byte03_signal" 500 "SIGNALS_Virtual_DcmDspUDS_2623Byte04_signal" 501 "SIGNALS_Virtual_DcmDspUDS_2623Byte05_signal" 502 "SIGNALS_Virtual_DcmDspUDS_2660Byte0_signal" 503 "SIGNALS_Virtual_DcmDspUDS_2660Byte15_signal" 504 "SIGNALS_Virtual_DcmDspUDS_2660Byte16_signal" 505 "SIGNALS_Virtual_DcmDspUDS_2660Byte17_signal" 506 "SIGNALS_Virtual_DcmDspUDS_2660Byte18_signal" 507 "SIGNALS_Virtual_DcmDspUDS_2660Byte19_signal" 508 "SIGNALS_Virtual_DcmDspUDS_2660Byte1A_signal" 509 "SIGNALS_Virtual_DcmDspUDS_2660Byte1B_signal" 510 "SIGNALS_Virtual_DcmDspUDS_2660Byte1C_signal" 511 "SIGNALS_Virtual_DcmDspUDS_2660Byte1D_signal" 512 "SIGNALS_Virtual_DcmDspUDS_2660Byte1E_signal" 513 "SIGNALS_Virtual_DcmDspUDS_2660Byte1_signal" 514 "SIGNALS_Virtual_DcmDspUDS_2660Byte2_signal" 515 "SIGNALS_Virtual_DcmDspUDS_2660Byte3_signal" 516 "SIGNALS_Virtual_DcmDspUDS_2660Byte4_signal" 517 "SIGNALS_Virtual_DcmDspUDS_2660Byte5_signal" 518 "SIGNALS_Virtual_DcmDspUDS_2660Byte6_signal" 519 "SIGNALS_Virtual_DcmDspUDS_2661Byte0A_signal" 520 "SIGNALS_Virtual_DcmDspUDS_2661Byte0B_signal" 521 "SIGNALS_Virtual_DcmDspUDS_2661Byte0C_signal" 522 "SIGNALS_Virtual_DcmDspUDS_2661Byte0D_signal" 523 "SIGNALS_Virtual_DcmDspUDS_2661Byte0E_signal" 524 "SIGNALS_Virtual_DcmDspUDS_2661Byte0F_signal" 525 "SIGNALS_Virtual_DcmDspUDS_2661Byte0_signal" 526 "SIGNALS_Virtual_DcmDspUDS_2661Byte1_signal" 527 "SIGNALS_Virtual_DcmDspUDS_2661Byte27_signal" 528 "SIGNALS_Virtual_DcmDspUDS_2661Byte2A_signal" 529 "SIGNALS_Virtual_DcmDspUDS_2661Byte2D_signal" 530 "SIGNALS_Virtual_DcmDspUDS_2661Byte2E_signal" 531 "SIGNALS_Virtual_DcmDspUDS_2661Byte2F_signal" 532 "SIGNALS_Virtual_DcmDspUDS_2661Byte2_signal" 533 "SIGNALS_Virtual_DcmDspUDS_2661Byte30_signal" 534 "SIGNALS_Virtual_DcmDspUDS_2661Byte31_signal" 535 "SIGNALS_Virtual_DcmDspUDS_2661Byte32_signal" 536 "SIGNALS_Virtual_DcmDspUDS_2661Byte35_signal" 537 "SIGNALS_Virtual_DcmDspUDS_2661Byte3_signal" 538 "SIGNALS_Virtual_DcmDspUDS_2661Byte4_signal" 539 "SIGNALS_Virtual_DcmDspUDS_2661Byte5_signal" 540 "SIGNALS_Virtual_DcmDspUDS_2661Byte6_signal" 541 "SIGNALS_Virtual_DcmDspUDS_2661Byte7_signal" 542 "SIGNALS_Virtual_DcmDspUDS_2661Byte8_signal" 543 "SIGNALS_Virtual_DcmDspUDS_2661Byte9_signal" 544 "SIGNALS_Virtual_DcmDspUDS_2662Byte0_signal" 545 "SIGNALS_Virtual_DcmDspUDS_2662Byte18_signal" 546 "SIGNALS_Virtual_DcmDspUDS_2662Byte19_signal" 547 "SIGNALS_Virtual_DcmDspUDS_2662Byte1_signal" 548 "SIGNALS_Virtual_DcmDspUDS_2662Byte2_signal" 549 "SIGNALS_Virtual_DcmDspUDS_2662Byte3_signal" 550 "SIGNALS_Virtual_DcmDspUDS_2662Byte4_signal" 551 "SIGNALS_Virtual_DcmDspUDS_2662Byte5_signal" 552 "SIGNALS_Virtual_DcmDspUDS_2663Byte0_signal" 553 "SIGNALS_Virtual_DcmDspUDS_2663Byte1_signal" 554 "SIGNALS_Virtual_DcmDspUDS_2663Byte2_signal" 555 "SIGNALS_Virtual_DcmDspUDS_2663Byte3_signal" 556 "SIGNALS_Virtual_DcmDspUDS_2663Byte4_signal" 557 "SIGNALS_Virtual_DcmDspUDS_2663Byte5_signal" 558 "SIGNALS_Virtual_DcmDspUDS_2664Byte0_signal" 559 "SIGNALS_Virtual_DcmDspUDS_2664Byte1_signal" 560 "SIGNALS_Virtual_DcmDspUDS_2664Byte25_signal" 561 "SIGNALS_Virtual_DcmDspUDS_2664Byte26_signal" 562 "SIGNALS_Virtual_DcmDspUDS_2664Byte2_signal" 563 "SIGNALS_Virtual_DcmDspUDS_2664Byte3_signal" 564 "SIGNALS_Virtual_DcmDspUDS_2664Byte4_signal" 565 "SIGNALS_Virtual_DcmDspUDS_2664Byte5_signal" 566 "SIGNALS_Virtual_DcmDspUDS_2664Byte6_signal" 567 "SIGNALS_Virtual_DcmDspUDS_2664Byte7_signal" 568 "SIGNALS_Virtual_DcmDspUDS_2665Byte0_signal" 569 "SIGNALS_Virtual_DcmDspUDS_2665Byte1_signal" 570 "SIGNALS_Virtual_DcmDspUDS_2665Byte2_signal" 571 "SIGNALS_Virtual_DcmDspUDS_2665Byte3_signal" 572 "SIGNALS_Virtual_DcmDspUDS_2665Byte4_signal" 573 "SIGNALS_Virtual_DcmDspUDS_2665Byte5_signal" 574 "SIGNALS_Virtual_DcmDspUDS_2668Byte0_signal" 575 "SIGNALS_Virtual_DcmDspUDS_2668Byte1B_signal" 576 "SIGNALS_Virtual_DcmDspUDS_2668Byte1_signal" 577 "SIGNALS_Virtual_DcmDspUDS_2668Byte2_signal" 578 "SIGNALS_Virtual_DcmDspUDS_2668Byte3_signal" 579 "SIGNALS_Virtual_DcmDspUDS_2668Byte4_signal" 580 "SIGNALS_Virtual_DcmDspUDS_2668Byte5_signal" 581 "SIGNALS_Virtual_DcmDspUDS_266CByte0_signal" 582 "SIGNALS_Virtual_DcmDspUDS_266CByte1_signal" 583 "SIGNALS_Virtual_DcmDspUDS_266CByte26_signal" 584 "SIGNALS_Virtual_DcmDspUDS_266CByte27_signal" 585 "SIGNALS_Virtual_DcmDspUDS_266CByte2_signal" 586 "SIGNALS_Virtual_DcmDspUDS_266CByte3_signal" 587 "SIGNALS_Virtual_DcmDspUDS_266CByte4_signal" 588 "SIGNALS_Virtual_DcmDspUDS_266CByte5_signal" 589 "SIGNALS_Virtual_DcmDspUDS_266DByte0_signal" 590 "SIGNALS_Virtual_DcmDspUDS_266DByte1_signal" 591 "SIGNALS_Virtual_DcmDspUDS_266DByte2_signal" 592 "SIGNALS_Virtual_DcmDspUDS_266DByte3_signal" 593 "SIGNALS_Virtual_DcmDspUDS_266DByte4_signal" 594 "SIGNALS_Virtual_DcmDspUDS_266DByte5_signal" 595 "SIGNALS_Virtual_DcmDspUDS_266FByte0_signal" 596 "SIGNALS_Virtual_DcmDspUDS_266FByte1_signal" 597 "SIGNALS_Virtual_DcmDspUDS_266FByte2_signal" 598 "SIGNALS_Virtual_DcmDspUDS_266FByte3_signal" 599 "SIGNALS_Virtual_DcmDspUDS_2673Byte0A_signal" 600 "SIGNALS_Virtual_DcmDspUDS_2673Byte0B_signal" 601 "SIGNALS_Virtual_DcmDspUDS_2673Byte0_signal" 602 "SIGNALS_Virtual_DcmDspUDS_2673Byte12_signal" 603 "SIGNALS_Virtual_DcmDspUDS_2673Byte13_signal" 604 "SIGNALS_Virtual_DcmDspUDS_2673Byte16_signal" 605 "SIGNALS_Virtual_DcmDspUDS_2673Byte17_signal" 606 "SIGNALS_Virtual_DcmDspUDS_2673Byte1E_signal" 607 "SIGNALS_Virtual_DcmDspUDS_2673Byte1F_signal" 608 "SIGNALS_Virtual_DcmDspUDS_2673Byte1_signal" 609 "SIGNALS_Virtual_DcmDspUDS_2673Byte2_signal" 610 "SIGNALS_Virtual_DcmDspUDS_2673Byte3_signal" 611 "SIGNALS_Virtual_DcmDspUDS_2673Byte4_signal" 612 "SIGNALS_Virtual_DcmDspUDS_2673Byte5_signal" 613 "SIGNALS_Virtual_DcmDspUDS_2673Byte6_signal" 614 "SIGNALS_Virtual_DcmDspUDS_2673Byte7_signal" 615 "SIGNALS_Virtual_DcmDspUDS_2676Byte0_signal" 616 "SIGNALS_Virtual_DcmDspUDS_2676Byte1_signal" 617 "SIGNALS_Virtual_DcmDspUDS_2676Byte2E_signal" 618 "SIGNALS_Virtual_DcmDspUDS_2676Byte2F_signal" 619 "SIGNALS_Virtual_DcmDspUDS_2676Byte2_signal" 620 "SIGNALS_Virtual_DcmDspUDS_2676Byte3_signal" 621 "SIGNALS_Virtual_DcmDspUDS_2676Byte4_signal" 622 "SIGNALS_Virtual_DcmDspUDS_2676Byte5_signal" 623 "SIGNALS_Virtual_DcmDspUDS_2676Byte6_signal" 624 "SIGNALS_Virtual_DcmDspUDS_2676Byte7_signal" 625 "SIGNALS_Virtual_DcmDspUDS_2676Byte8_signal" 626 "SIGNALS_Virtual_DcmDspUDS_2676Byte9_signal" 627 "SIGNALS_Virtual_DcmDspUDS_267BByte0_signal" 628 "SIGNALS_Virtual_DcmDspUDS_267BByte1_signal" 629 "SIGNALS_Virtual_DcmDspUDS_267BByte2_signal" 630 "SIGNALS_Virtual_DcmDspUDS_267BByte3_signal" 631 "SIGNALS_Virtual_DcmDspUDS_267BByte4_signal" 632 "SIGNALS_Virtual_DcmDspUDS_267BByte5_signal" 633 "SIGNALS_Virtual_DcmDspUDS_267EByte0_signal" 634 "SIGNALS_Virtual_DcmDspUDS_267EByte1_signal" 635 "SIGNALS_Virtual_DcmDspUDS_267EByte22_signal" 636 "SIGNALS_Virtual_DcmDspUDS_2680Byte00_signal" 637 "SIGNALS_Virtual_DcmDspUDS_2680Byte01_signal" 638 "SIGNALS_Virtual_DcmDspUDS_2680Byte02_signal" 639 "SIGNALS_Virtual_DcmDspUDS_2680Byte03_signal" 640 "SIGNALS_Virtual_DcmDspUDS_2680Byte04_signal" 641 "SIGNALS_Virtual_DcmDspUDS_2680Byte05_signal" 642 "SIGNALS_Virtual_DcmDspUDS_2680Byte08_signal" 643 "SIGNALS_Virtual_DcmDspUDS_2680Byte09_signal" 644 "SIGNALS_Virtual_DcmDspUDS_2680Byte0E_signal" 645 "SIGNALS_Virtual_DcmDspUDS_2680Byte0F_signal" 646 "SIGNALS_Virtual_DcmDspUDS_2681Byte00_signal" 647 "SIGNALS_Virtual_DcmDspUDS_2681Byte01_signal" 648 "SIGNALS_Virtual_DcmDspUDS_2681Byte02_signal" 649 "SIGNALS_Virtual_DcmDspUDS_2681Byte03_signal" 650 "SIGNALS_Virtual_DcmDspUDS_2681Byte04_signal" 651 "SIGNALS_Virtual_DcmDspUDS_2681Byte05_signal" 652 "SIGNALS_Virtual_DcmDspUDS_2681Byte0F_signal" 653 "SIGNALS_Virtual_DcmDspUDS_2681Byte10_signal" 654 "SIGNALS_Virtual_DcmDspUDS_2681Byte13_signal" 655 "SIGNALS_Virtual_DcmDspUDS_2681Byte14_signal" 656 "SIGNALS_Virtual_DcmDspUDS_2681Byte1D_signal" 657 "SIGNALS_Virtual_DcmDspUDS_2681Byte1E_signal" 658 "SIGNALS_Virtual_DcmDspUDS_2682Byte00_signal" 659 "SIGNALS_Virtual_DcmDspUDS_2682Byte01_signal" 660 "SIGNALS_Virtual_DcmDspUDS_2682Byte02_signal" 661 "SIGNALS_Virtual_DcmDspUDS_2682Byte03_signal" 662 "SIGNALS_Virtual_DcmDspUDS_2682Byte04_signal" 663 "SIGNALS_Virtual_DcmDspUDS_2682Byte05_signal" 664 "SIGNALS_Virtual_DcmDspUDS_2682Byte06_07_signal" 665 "SIGNALS_Virtual_DcmDspUDS_2682Byte08_09_signal" 666 "SIGNALS_Virtual_DcmDspUDS_2682Byte0E_signal" 667 "SIGNALS_Virtual_DcmDspUDS_2682Byte11_12_signal" 668 "SIGNALS_Virtual_DcmDspUDS_2682Byte13_14_signal" 669 "SIGNALS_Virtual_DcmDspUDS_2682Byte15_16_signal" 670 "SIGNALS_Virtual_DcmDspUDS_2682Byte18_19_signal" 671 "SIGNALS_Virtual_DcmDspUDS_2682Byte1B_signal" 672 "SIGNALS_Virtual_DcmDspUDS_2682Byte1C_signal" 673 "SIGNALS_Virtual_DcmDspUDS_268FByte00_signal" 674 "SIGNALS_Virtual_DcmDspUDS_268FByte01_signal" 675 "SIGNALS_Virtual_DcmDspUDS_268FByte02_signal" 676 "SIGNALS_Virtual_DcmDspUDS_268FByte03_signal" 677 "SIGNALS_Virtual_DcmDspUDS_268FByte04_signal" 678 "SIGNALS_Virtual_DcmDspUDS_268FByte05_signal" 679 "SIGNALS_Virtual_DcmDspUDS_268FByte0A_signal" 680 "SIGNALS_Virtual_DcmDspUDS_268FByte0B_signal" 681 "SIGNALS_Virtual_DcmDspUDS_268FByte0C_signal" 682 "SIGNALS_Virtual_DcmDspUDS_269AByte00_signal" 683 "SIGNALS_Virtual_DcmDspUDS_269AByte01_signal" 684 "SIGNALS_Virtual_DcmDspUDS_269AByte02_signal" 685 "SIGNALS_Virtual_DcmDspUDS_269AByte03_signal" 686 "SIGNALS_Virtual_DcmDspUDS_269AByte04_signal" 687 "SIGNALS_Virtual_DcmDspUDS_269AByte05_signal" 688 "SIGNALS_Virtual_DcmDspUDS_26A2Byte00_signal" 689 "SIGNALS_Virtual_DcmDspUDS_26A2Byte01_signal" 690 "SIGNALS_Virtual_DcmDspUDS_26A2Byte02_signal" 691 "SIGNALS_Virtual_DcmDspUDS_26A2Byte03_signal" 692 "SIGNALS_Virtual_DcmDspUDS_26A2Byte04_signal" 693 "SIGNALS_Virtual_DcmDspUDS_26A2Byte05_signal" 694 "SIGNALS_Virtual_DcmDspUDS_26A2Byte12_13_signal" 695 "SIGNALS_Virtual_DcmDspUDS_Acm_fzabgs_w_signal" 696 "SIGNALS_Virtual_DcmDspUDS_Acm_fzabgzyl_w_0_signal" 697 "SIGNALS_Virtual_DcmDspUDS_Acm_fzabgzyl_w_1_signal" 698 "SIGNALS_Virtual_DcmDspUDS_Acm_fzabgzyl_w_2_signal" 699 "SIGNALS_Virtual_DcmDspUDS_Acm_fzabgzyl_w_3_signal" 700 "SIGNALS_Virtual_DcmDspUDS_DID_E402Byte00_signal" 701 "SIGNALS_Virtual_DcmDspUDS_DID_E402Byte01_signal" 702 "SIGNALS_Virtual_DcmDspUDS_DID_E402Byte07to08_signal" 703 "SIGNALS_Virtual_DcmDspUDS_DID_E402Byte10to11_signal" 704 "SIGNALS_Virtual_DcmDspUDS_DID_E402Byte19to1A_signal" 705 "SIGNALS_Virtual_DcmDspUDS_DID_E402Byte22to23_signal" 706 "SIGNALS_Virtual_DcmDspUDS_DID_E402Byte2Bto2C_signal" 707 "SIGNALS_Virtual_DcmDspUDS_DID_F110Byte0_3_signal" 708 "SIGNALS_Virtual_DcmDspUDS_DID_F110Byte12_15_signal" 709 "SIGNALS_Virtual_DcmDspUDS_DID_F110Byte16_signal" 710 "SIGNALS_Virtual_DcmDspUDS_DID_F110Byte4_7_signal" 711 "SIGNALS_Virtual_DcmDspUDS_DID_F110Byte8_11_signal" 712 "SIGNALS_Virtual_DcmDspUDS_DID_F112Byte0_3_signal" 713 "SIGNALS_Virtual_DcmDspUDS_DID_F112Byte12_15_signal" 714 "SIGNALS_Virtual_DcmDspUDS_DID_F112Byte16_19_signal" 715 "SIGNALS_Virtual_DcmDspUDS_DID_F112Byte20_23_signal" 716 "SIGNALS_Virtual_DcmDspUDS_DID_F112Byte24_27_signal" 717 "SIGNALS_Virtual_DcmDspUDS_DID_F112Byte28_29_signal" 718 "SIGNALS_Virtual_DcmDspUDS_DID_F112Byte30_signal" 719 "SIGNALS_Virtual_DcmDspUDS_DID_F112Byte4_7_signal" 720 "SIGNALS_Virtual_DcmDspUDS_DID_F112Byte8_11_signal" 721 "SIGNALS_Virtual_DcmDspUDS_E602Byte2_signal" 722 "SIGNALS_Virtual_DcmDspUDS_F181Byte0_3_signal" 723 "SIGNALS_Virtual_DcmDspUDS_F181Byte12_15_signal" 724 "SIGNALS_Virtual_DcmDspUDS_F181Byte4_7_signal" 725 "SIGNALS_Virtual_DcmDspUDS_F181Byte8_11_signal" 726 "SIGNALS_Virtual_DcmDspUDS_fzabgs_w_signal" 727 "SIGNALS_Virtual_DcmDspUDS_fzabgzyl_w_0_signal" 728 "SIGNALS_Virtual_DcmDspUDS_fzabgzyl_w_1_signal" 729 "SIGNALS_Virtual_DcmDspUDS_fzabgzyl_w_2_signal" 730 "SIGNALS_Virtual_DcmDspUDS_fzabgzyl_w_3_signal" 731 "SIGNALS_Virtual_DcmDspUDS_numReWrECUID1_signal" 732 "SIGNALS_Virtual_DcmDspUDS_numReWrECUID2_signal" 733 "SIGNALS_Virtual_I14229B9_0490_FrNo09_signal" 734 "SIGNALS_Virtual_I14229B9_0490_FrNo10_signal" 735 "SIGNALS_Virtual_I14229B9_04B1_FrNo16_signal" 736 "SIGNALS_Virtual_I14229B9_04B1_FrNo17_signal" 737 "SIGNALS_Virtual_I14229B9_04B1_FrNo20_signal" 738 "SIGNALS_Virtual_I14229B9_04B1_FrNo21_signal" 739 "SIGNALS_Virtual_I14229B9_04B1_FrNo22_signal" 740 "SIGNALS_Virtual_I14229B9_04B1_FrNo23_signal" 741 "SIGNALS_Virtual_I14229B9_04C2_FrNo2021_signal" 742 "SIGNALS_Virtual_I14229B9_04D2_FrNo24_signal" 743 "SIGNALS_Virtual_I14229B9_04D2_FrNo25_signal" 744 "SIGNALS_Virtual_I14229B9_0520_FrNo15_signal" 745 "SIGNALS_Virtual_I14229B9_0520_FrNo16_signal" 746 "SIGNALS_Virtual_I14229B9_0523_FrNo42_signal" 747 "SIGNALS_Virtual_I14229B9_0523_FrNo43_signal" 748 "SIGNALS_Virtual_I14229B9_0524_FrNo09_signal" 749 "SIGNALS_Virtual_I14229B9_0524_FrNo10_signal" 750 "SIGNALS_Virtual_I14229B9_0550_FrNo09_signal" 751 "SIGNALS_Virtual_I14229B9_0550_FrNo10_signal" 752 "SIGNALS_Virtual_I14229B9_0553_FrNo13_signal" 753 "SIGNALS_Virtual_I14229B9_0553_FrNo14_signal" 754 "SIGNALS_Virtual_I14229B9_056A_FrNo8_signal" 755 "SIGNALS_Virtual_I14229B9_056A_FrNo9_signal" 756 "SIGNALS_Virtual_I14229B9_0588_FrNo15_signal" 757 "SIGNALS_Virtual_I14229B9_0588_FrNo16_signal" 758 "SIGNALS_Virtual_I14229B9_05A0_FrNo40_signal" 759 "SIGNALS_Virtual_I14229B9_05A0_FrNo41_signal" 760 "SIGNALS_Virtual_I14229B9_05B0_FrNo13_signal" 761 "SIGNALS_Virtual_I14229B9_05B0_FrNo14_signal" 762 "SIGNALS_Virtual_I14229B9_05C0_FrNo12_signal" 763 "SIGNALS_Virtual_I14229B9_05C0_FrNo13_signal" 764 "SIGNALS_Virtual_I14229B9_05E0_FrNo19_signal" 765 "SIGNALS_Virtual_I14229B9_05E0_FrNo20_signal" 766 "SIGNALS_Virtual_I14229B9_05E0_FrNo21_signal" 767 "SIGNALS_Virtual_I14229B9_05E0_FrNo22_signal" 768 "SIGNALS_Virtual_I14229B9_05E0_FrNo23_signal" 769 "SIGNALS_Virtual_I14229B9_05E0_FrNo24_signal" 770 "SIGNALS_Virtual_I14229B9_1208_FrNo34_signal" 771 "SIGNALS_Virtual_I14229B9_1208_FrNo35_signal" 772 "SIGNALS_Virtual_I14229B9_1208_FrNo36_signal" 773 "SIGNALS_Virtual_I14229B9_1208_FrNo37_signal" 774 "SIGNALS_Virtual_I14229B9_120A_FrNo09_signal" 775 "SIGNALS_Virtual_I14229B9_120A_FrNo10_signal" 776 "SIGNALS_Virtual_I14229B9_120B_FrNo09_signal" 777 "SIGNALS_Virtual_I14229B9_120B_FrNo10_signal" 778 "SIGNALS_Virtual_I14229_AirC_pAnaClnt_signal" 779 "SIGNALS_Virtual_I14229_EpmCaS_ctErrSig2_signal" 780 "SIGNALS_Virtual_I14229_pEngSrtMin_signal" 781 "SIGNALS_Virtual_I14229_wdkba_w_signal" 782 "SIGNALS_Virtual_Tra_numGear_signal" /end COMPU_VTAB
/begin COMPU_METHOD Temp_Cels "" RAT_FUNC "%6.1" "deg C" COEFFS 0 10 2731.4 0 0 1 /end COMPU_METHOD
/begin COMPU_METHOD Time_ms "" RAT_FUNC "%6.1" "ms" COEFFS 0 0.1 0 0 0 1 /end COMPU_METHOD
/begin COMPU_METHOD Time_s "" RAT_FUNC "%6.4" "s" COEFFS 0 100 0 0 0 1 /end COMPU_METHOD
/begin COMPU_METHOD t_q0p1 "" RAT_FUNC "%6.3" "s" COEFFS 0 10 0 0 0 1 /end COMPU_METHOD
/begin COMPU_METHOD Vel "" RAT_FUNC "%6.4" "km/h" COEFFS 0 100 0 0 0 1 /end COMPU_METHOD
/begin RECORD_LAYOUT Cur_Xs16Ws16 NO_AXIS_PTS_X 1 SWORD AXIS_PTS_X 2 SWORD INDEX_INCR DIRECT FNC_VALUES 3 SWORD COLUMN_DIR DIRECT /end RECORD_LAYOUT
/begin RECORD_LAYOUT KwUb FNC_VALUES 1 UBYTE COLUMN_DIR DIRECT /end RECORD_LAYOUT
/begin RECORD_LAYOUT ValA_Wu16 FNC_VALUES 1 UWORD COLUMN_DIR DIRECT /end RECORD_LAYOUT
/begin RECORD_LAYOUT ValA_Wu8 FNC_VALUES 1 UBYTE COLUMN_DIR DIRECT /end RECORD_LAYOUT
/begin RECORD_LAYOUT Val_Ws16 FNC_VALUES 1 SWORD COLUMN_DIR DIRECT /end RECORD_LAYOUT
/begin RECORD_LAYOUT Val_Wu16 FNC_VALUES 1 UWORD COLUMN_DIR DIRECT /end RECORD_LAYOUT
/begin RECORD_LAYOUT Val_Wu8 FNC_VALUES 1 UBYTE COLUMN_DIR DIRECT /end RECORD_LAYOUT
/end MODULE
/end PROJECT
