ASAP2_VERSION 1 60
/begin PROJECT MG1CA020 "MG1CA020"
/begin HEADER "" VERSION "MG1CA020_6SAY_V011_TPROT" PROJECT_NO MG1CA020 /end HEADER
/begin MODULE DIM ""
/begin MOD_COMMON "" BYTE_ORDER MSB_LAST ALIGNMENT_BYTE 1 ALIGNMENT_WORD 2 ALIGNMENT_LONG 4 ALIGNMENT_INT64 4 ALIGNMENT_FLOAT32_IEEE 4 ALIGNMENT_FLOAT64_IEEE 4 DATA_SIZE 32 /end MOD_COMMON
/begin CHARACTERISTIC DDRC_DurDeb.AirC_tiCmprOLDebOk_C "debouncing parameter / Duration of healing debouncing for check DFC_AirCCmprOL" VALUE 0x804D86C8 Val_Wu16 655350.0 DDRCTime_ms 0.00 655350.0 FORMAT "%8.1" /end CHARACTERISTIC
/begin CHARACTERISTIC DDRC_DurDeb.AirC_tiCmprOLDebDef_C "debouncing parameter / Duration of defect debouncing for check DFC_AirCCmprOL" VALUE 0x804D86CA Val_Wu16 655350.0 DDRCTime_ms 0.00 655350.0 FORMAT "%8.1" /end CHARACTERISTIC
/begin CHARACTERISTIC DDRC_DurDeb.AirC_tiCmprOvrTempDebOk_C "debouncing parameter / Duration of healing debouncing for check DFC_AirCCmprOvrTemp" VALUE 0x804D86CC Val_Wu16 655350.0 DDRCTime_ms 0.00 655350.0 FORMAT "%8.1" /end CHARACTERISTIC
/begin CHARACTERISTIC DDRC_DurDeb.AirC_tiCmprOvrTempDebDef_C "debouncing parameter / Duration of defect debouncing for check DFC_AirCCmprOvrTemp" VALUE 0x804D86CE Val_Wu16 655350.0 DDRCTime_ms 0.00 655350.0 FORMAT "%8.1" /end CHARACTERISTIC
/begin CHARACTERISTIC DDRC_DurDeb.AirC_tiCmprSCBDebOk_C "debouncing parameter / Duration of healing debouncing for check DFC_AirCCmprSCB" VALUE 0x804D86D0 Val_Wu16 655350.0 DDRCTime_ms 0.00 655350.0 FORMAT "%8.1" /end CHARACTERISTIC
/begin CHARACTERISTIC DDRC_DurDeb.AirC_tiCmprSCBDebDef_C "debouncing parameter / Duration of defect debouncing for check DFC_AirCCmprSCB" VALUE 0x804D86D2 Val_Wu16 655350.0 DDRCTime_ms 0.00 655350.0 FORMAT "%8.1" /end CHARACTERISTIC
/begin CHARACTERISTIC DDRC_DurDeb.AirC_tiCmprSCGDebOk_C "debouncing parameter / Duration of healing debouncing for check DFC_AirCCmprSCG" VALUE 0x804D86D4 Val_Wu16 655350.0 DDRCTime_ms 0.00 655350.0 FORMAT "%8.1" /end CHARACTERISTIC
/begin CHARACTERISTIC DDRC_DurDeb.AirC_tiCmprSCGDebDef_C "debouncing parameter / Duration of defect debouncing for check DFC_AirCCmprSCG" VALUE 0x804D86D6 Val_Wu16 655350.0 DDRCTime_ms 0.00 655350.0 FORMAT "%8.1" /end CHARACTERISTIC
/begin CHARACTERISTIC DDRC_DurDeb.Alt_tiErrDebOk_C "debouncing parameter / Duration of healing debouncing for check DFC_AltErr" VALUE 0x804D86D8 Val_Wu16 655350.0 DDRCTime_ms 0.00 655350.0 FORMAT "%8.1" /end CHARACTERISTIC
/begin CHARACTERISTIC DDRC_DurDeb.Alt_tiErrDebDef_C "debouncing parameter / Duration of defect debouncing for check DFC_AltErr" VALUE 0x804D86DA Val_Wu16 655350.0 DDRCTime_ms 0.00 655350.0 FORMAT "%8.1" /end CHARACTERISTIC
/begin CHARACTERISTIC DDRC_DurDeb.BattU_tiMaxDebOk_C "debouncing parameter / Duration of healing debouncing for check DFC_BattUSRCMax" VALUE 0x804D86DC Val_Wu16 655350.0 DDRCTime_ms 0.00 655350.0 FORMAT "%8.1" /end CHARACTERISTIC
/begin CHARACTERISTIC DDRC_DurDeb.BattU_tiMaxDebDef_C "debouncing parameter / Duration of defect debouncing for check DFC_BattUSRCMax" VALUE 0x804D86DE Val_Wu16 655350.0 DDRCTime_ms 0.00 655350.0 FORMAT "%8.1" /end CHARACTERISTIC
/begin CHARACTERISTIC DDRC_DurDeb.BattU_tiMinDebOk_C "debouncing parameter / Duration of healing debouncing for check DFC_BattUSRCMin" VALUE 0x804D86E0 Val_Wu16 655350.0 DDRCTime_ms 0.00 655350.0 FORMAT "%8.1" /end CHARACTERISTIC
/begin CHARACTERISTIC DDRC_DurDeb.BattU_tiMinDebDef_C "debouncing parameter / Duration of defect debouncing for check DFC_BattUSRCMin" VALUE 0x804D86E2 Val_Wu16 655350.0 DDRCTime_ms 0.00 655350.0 FORMAT "%8.1" /end CHARACTERISTIC
/begin CHARACTERISTIC DDRC_DurDeb.Com_tiChksTCU1DebOk_C "debouncing parameter / Duration of healing debouncing for check DFC_ComChksTCU1" VALUE 0x804D86E4 Val_Wu16 655350.0 DDRCTime_ms 0.00 655350.0 FORMAT "%8.1" /end CHARACTERISTIC
/begin CHARACTERISTIC DDRC_DurDeb.Com_tiChksTCU1DebDef_C "debouncing parameter / Duration of defect debouncing for check DFC_ComChksTCU1" VALUE 0x804D86E6 Val_Wu16 655350.0 DDRCTime_ms 0.00 655350.0 FORMAT "%8.1" /end CHARACTERISTIC
/begin CHARACTERISTIC DDRC_DurDeb.Com_tiChksTCU11DebOk_C "debouncing parameter / Duration of healing debouncing for check DFC_ComChksTCU11" VALUE 0x804D86E8 Val_Wu16 655350.0 DDRCTime_ms 0.00 655350.0 FORMAT "%8.1" /end CHARACTERISTIC
/begin CHARACTERISTIC DDRC_DurDeb.Com_tiChksTCU11DebDef_C "debouncing parameter / Duration of defect debouncing for check DFC_ComChksTCU11" VALUE 0x804D86EA Val_Wu16 655350.0 DDRCTime_ms 0.00 655350.0 FORMAT "%8.1" /end CHARACTERISTIC
/begin CHARACTERISTIC DDRC_DurDeb.Com_tiChksTCU12DebOk_C "debouncing parameter / Duration of healing debouncing for check DFC_ComChksTCU12" VALUE 0x804D86EC Val_Wu16 655350.0 DDRCTime_ms 0.00 655350.0 FORMAT "%8.1" /end CHARACTERISTIC
/begin CHARACTERISTIC DDRC_DurDeb.Com_tiChksTCU12DebDef_C "debouncing parameter / Duration of defect debouncing for check DFC_ComChksTCU12" VALUE 0x804D86EE Val_Wu16 655350.0 DDRCTime_ms 0.00 655350.0 FORMAT "%8.1" /end CHARACTERISTIC
/begin CHARACTERISTIC DDRC_DurDeb.Com_tiChksTCU13DebOk_C "debouncing parameter / Duration of healing debouncing for check DFC_ComChksTCU13" VALUE 0x804D86F0 Val_Wu16 655350.0 DDRCTime_ms 0.00 655350.0 FORMAT "%8.1" /end CHARACTERISTIC
/begin CHARACTERISTIC DDRC_DurDeb.Com_tiChksTCU13DebDef_C "debouncing parameter / Duration of defect debouncing for check DFC_ComChksTCU13" VALUE 0x804D86F2 Val_Wu16 655350.0 DDRCTime_ms 0.00 655350.0 FORMAT "%8.1" /end CHARACTERISTIC
/begin CHARACTERISTIC DDRC_DurDeb.Com_tiChksTCU2DebOk_C "debouncing parameter / Duration of healing debouncing for check DFC_ComChksTCU2" VALUE 0x804D86F4 Val_Wu16 655350.0 DDRCTime_ms 0.00 655350.0 FORMAT "%8.1" /end CHARACTERISTIC
/begin CHARACTERISTIC DDRC_DurDeb.Com_tiChksTCU2DebDef_C "debouncing parameter / Duration of defect debouncing for check DFC_ComChksTCU2" VALUE 0x804D86F6 Val_Wu16 655350.0 DDRCTime_ms 0.00 655350.0 FORMAT "%8.1" /end CHARACTERISTIC
/begin CHARACTERISTIC DDRC_DurDeb.Com_tiChksTCU3DebOk_C "debouncing parameter / Duration of healing debouncing for check DFC_ComChksTCU3" VALUE 0x804D86F8 Val_Wu16 655350.0 DDRCTime_ms 0.00 655350.0 FORMAT "%8.1" /end CHARACTERISTIC
/begin CHARACTERISTIC DDRC_DurDeb.Com_tiChksTCU3DebDef_C "debouncing parameter / Duration of defect debouncing for check DFC_ComChksTCU3" VALUE 0x804D86FA Val_Wu16 655350.0 DDRCTime_ms 0.00 655350.0 FORMAT "%8.1" /end CHARACTERISTIC
/begin CHARACTERISTIC DDRC_DurDeb.Com_tiChksTCU4DebOk_C "debouncing parameter / Duration of healing debouncing for check DFC_ComChksTCU4" VALUE 0x804D86FC Val_Wu16 655350.0 DDRCTime_ms 0.00 655350.0 FORMAT "%8.1" /end CHARACTERISTIC
/begin CHARACTERISTIC DDRC_DurDeb.Com_tiChksTCU4DebDef_C "debouncing parameter / Duration of defect debouncing for check DFC_ComChksTCU4" VALUE 0x804D86FE Val_Wu16 655350.0 DDRCTime_ms 0.00 655350.0 FORMAT "%8.1" /end CHARACTERISTIC
/begin CHARACTERISTIC DDRC_DurDeb.Com_tiCntTCU1DebOk_C "debouncing parameter / Duration of healing debouncing for check DFC_ComCntTCU1" VALUE 0x804D8700 Val_Wu16 655350.0 DDRCTime_ms 0.00 655350.0 FORMAT "%8.1" /end CHARACTERISTIC
/begin CHARACTERISTIC DDRC_DurDeb.Com_tiCntTCU1DebDef_C "debouncing parameter / Duration of defect debouncing for check DFC_ComCntTCU1" VALUE 0x804D8702 Val_Wu16 655350.0 DDRCTime_ms 0.00 655350.0 FORMAT "%8.1" /end CHARACTERISTIC
/begin CHARACTERISTIC DDRC_DurDeb.Com_tiCntTCU11DebOk_C "debouncing parameter / Duration of healing debouncing for check DFC_ComCntTCU11" VALUE 0x804D8704 Val_Wu16 655350.0 DDRCTime_ms 0.00 655350.0 FORMAT "%8.1" /end CHARACTERISTIC
/begin CHARACTERISTIC DDRC_DurDeb.Com_tiCntTCU11DebDef_C "debouncing parameter / Duration of defect debouncing for check DFC_ComCntTCU11" VALUE 0x804D8706 Val_Wu16 655350.0 DDRCTime_ms 0.00 655350.0 FORMAT "%8.1" /end CHARACTERISTIC
/begin CHARACTERISTIC DDRC_DurDeb.Com_tiCntTCU12DebOk_C "debouncing parameter / Duration of healing debouncing for check DFC_ComCntTCU12" VALUE 0x804D8708 Val_Wu16 655350.0 DDRCTime_ms 0.00 655350.0 FORMAT "%8.1" /end CHARACTERISTIC
/begin CHARACTERISTIC DDRC_DurDeb.Com_tiCntTCU12DebDef_C "debouncing parameter / Duration of defect debouncing for check DFC_ComCntTCU12" VALUE 0x804D870A Val_Wu16 655350.0 DDRCTime_ms 0.00 655350.0 FORMAT "%8.1" /end CHARACTERISTIC
/begin CHARACTERISTIC DDRC_DurDeb.Com_tiCntTCU13DebOk_C "debouncing parameter / Duration of healing debouncing for check DFC_ComCntTCU13" VALUE 0x804D870C Val_Wu16 655350.0 DDRCTime_ms 0.00 655350.0 FORMAT "%8.1" /end CHARACTERISTIC
/begin CHARACTERISTIC DDRC_DurDeb.Com_tiCntTCU13DebDef_C "debouncing parameter / Duration of defect debouncing for check DFC_ComCntTCU13" VALUE 0x804D870E Val_Wu16 655350.0 DDRCTime_ms 0.00 655350.0 FORMAT "%8.1" /end CHARACTERISTIC
/begin CHARACTERISTIC DDRC_DurDeb.Com_tiCntTCU2DebOk_C "debouncing parameter / Duration of healing debouncing for check DFC_ComCntTCU2" VALUE 0x804D8710 Val_Wu16 655350.0 DDRCTime_ms 0.00 655350.0 FORMAT "%8.1" /end CHARACTERISTIC
/begin CHARACTERISTIC DDRC_DurDeb.Com_tiCntTCU2DebDef_C "debouncing parameter / Duration of defect debouncing for check DFC_ComCntTCU2" VALUE 0x804D8712 Val_Wu16 655350.0 DDRCTime_ms 0.00 655350.0 FORMAT "%8.1" /end CHARACTERISTIC
/begin CHARACTERISTIC DDRC_DurDeb.Com_tiCntTCU3DebOk_C "debouncing parameter / Duration of healing debouncing for check DFC_ComCntTCU3" VALUE 0x804D8714 Val_Wu16 655350.0 DDRCTime_ms 0.00 655350.0 FORMAT "%8.1" /end CHARACTERISTIC
/begin CHARACTERISTIC DDRC_DurDeb.Com_tiCntTCU3DebDef_C "debouncing parameter / Duration of defect debouncing for check DFC_ComCntTCU3" VALUE 0x804D8716 Val_Wu16 655350.0 DDRCTime_ms 0.00 655350.0 FORMAT "%8.1" /end CHARACTERISTIC
/begin CHARACTERISTIC DDRC_DurDeb.Com_tiCntTCU4DebOk_C "debouncing parameter / Duration of healing debouncing for check DFC_ComCntTCU4" VALUE 0x804D8718 Val_Wu16 655350.0 DDRCTime_ms 0.00 655350.0 FORMAT "%8.1" /end CHARACTERISTIC
/begin CHARACTERISTIC DDRC_DurDeb.Com_tiCntTCU4DebDef_C "debouncing parameter / Duration of defect debouncing for check DFC_ComCntTCU4" VALUE 0x804D871A Val_Wu16 655350.0 DDRCTime_ms 0.00 655350.0 FORMAT "%8.1" /end CHARACTERISTIC
/begin CHARACTERISTIC DDRC_DurDeb.Com_tiTOutTCU01DebOk_C "debouncing parameter / Duration of healing debouncing for check DFC_ComTOutTCU01" VALUE 0x804D871C Val_Wu16 655350.0 DDRCTime_ms 0.00 655350.0 FORMAT "%8.1" /end CHARACTERISTIC
/begin CHARACTERISTIC DDRC_DurDeb.Com_tiTOutTCU01DebDef_C "debouncing parameter / Duration of defect debouncing for check DFC_ComTOutTCU01" VALUE 0x804D871E Val_Wu16 655350.0 DDRCTime_ms 0.00 655350.0 FORMAT "%8.1" /end CHARACTERISTIC
/begin CHARACTERISTIC DDRC_DurDeb.Com_tiTOutTCU02DebOk_C "debouncing parameter / Duration of healing debouncing for check DFC_ComTOutTCU02" VALUE 0x804D8720 Val_Wu16 655350.0 DDRCTime_ms 0.00 655350.0 FORMAT "%8.1" /end CHARACTERISTIC
/begin CHARACTERISTIC DDRC_DurDeb.Com_tiTOutTCU02DebDef_C "debouncing parameter / Duration of defect debouncing for check DFC_ComTOutTCU02" VALUE 0x804D8722 Val_Wu16 655350.0 DDRCTime_ms 0.00 655350.0 FORMAT "%8.1" /end CHARACTERISTIC
/begin CHARACTERISTIC DDRC_DurDeb.Com_tiTOutTCU1DebOk_C "debouncing parameter / Duration of healing debouncing for check DFC_ComTOutTCU1" VALUE 0x804D8724 Val_Wu16 655350.0 DDRCTime_ms 0.00 655350.0 FORMAT "%8.1" /end CHARACTERISTIC
/begin CHARACTERISTIC DDRC_DurDeb.Com_tiTOutTCU1DebDef_C "debouncing parameter / Duration of defect debouncing for check DFC_ComTOutTCU1" VALUE 0x804D8726 Val_Wu16 655350.0 DDRCTime_ms 0.00 655350.0 FORMAT "%8.1" /end CHARACTERISTIC
/begin CHARACTERISTIC DDRC_DurDeb.Com_tiTOutTCU11DebOk_C "debouncing parameter / Duration of healing debouncing for check DFC_ComTOutTCU11" VALUE 0x804D8728 Val_Wu16 655350.0 DDRCTime_ms 0.00 655350.0 FORMAT "%8.1" /end CHARACTERISTIC
/begin CHARACTERISTIC DDRC_DurDeb.Com_tiTOutTCU11DebDef_C "debouncing parameter / Duration of defect debouncing for check DFC_ComTOutTCU11" VALUE 0x804D872A Val_Wu16 655350.0 DDRCTime_ms 0.00 655350.0 FORMAT "%8.1" /end CHARACTERISTIC
/begin CHARACTERISTIC DDRC_DurDeb.Com_tiTOutTCU12DebOk_C "debouncing parameter / Duration of healing debouncing for check DFC_ComTOutTCU12" VALUE 0x804D872C Val_Wu16 655350.0 DDRCTime_ms 0.00 655350.0 FORMAT "%8.1" /end CHARACTERISTIC
/begin CHARACTERISTIC DDRC_DurDeb.Com_tiTOutTCU12DebDef_C "debouncing parameter / Duration of defect debouncing for check DFC_ComTOutTCU12" VALUE 0x804D872E Val_Wu16 655350.0 DDRCTime_ms 0.00 655350.0 FORMAT "%8.1" /end CHARACTERISTIC
/begin CHARACTERISTIC DDRC_DurDeb.Com_tiTOutTCU13DebOk_C "debouncing parameter / Duration of healing debouncing for check DFC_ComTOutTCU13" VALUE 0x804D8730 Val_Wu16 655350.0 DDRCTime_ms 0.00 655350.0 FORMAT "%8.1" /end CHARACTERISTIC
/begin CHARACTERISTIC DDRC_DurDeb.Com_tiTOutTCU13DebDef_C "debouncing parameter / Duration of defect debouncing for check DFC_ComTOutTCU13" VALUE 0x804D8732 Val_Wu16 655350.0 DDRCTime_ms 0.00 655350.0 FORMAT "%8.1" /end CHARACTERISTIC
/begin CHARACTERISTIC DDRC_DurDeb.Com_tiTOutTCU14DebOk_C "debouncing parameter / Duration of healing debouncing for check DFC_ComTOutTCU14" VALUE 0x804D8734 Val_Wu16 655350.0 DDRCTime_ms 0.00 655350.0 FORMAT "%8.1" /end CHARACTERISTIC
/begin CHARACTERISTIC DDRC_DurDeb.Com_tiTOutTCU14DebDef_C "debouncing parameter / Duration of defect debouncing for check DFC_ComTOutTCU14" VALUE 0x804D8736 Val_Wu16 655350.0 DDRCTime_ms 0.00 655350.0 FORMAT "%8.1" /end CHARACTERISTIC
/begin CHARACTERISTIC DDRC_DurDeb.Com_tiTOutTCU2DebOk_C "debouncing parameter / Duration of healing debouncing for check DFC_ComTOutTCU2" VALUE 0x804D8738 Val_Wu16 655350.0 DDRCTime_ms 0.00 655350.0 FORMAT "%8.1" /end CHARACTERISTIC
/begin CHARACTERISTIC DDRC_DurDeb.Com_tiTOutTCU2DebDef_C "debouncing parameter / Duration of defect debouncing for check DFC_ComTOutTCU2" VALUE 0x804D873A Val_Wu16 655350.0 DDRCTime_ms 0.00 655350.0 FORMAT "%8.1" /end CHARACTERISTIC
/begin CHARACTERISTIC DDRC_DurDeb.Com_tiTOutTCU3DebOk_C "debouncing parameter / Duration of healing debouncing for check DFC_ComTOutTCU3" VALUE 0x804D873C Val_Wu16 655350.0 DDRCTime_ms 0.00 655350.0 FORMAT "%8.1" /end CHARACTERISTIC
/begin CHARACTERISTIC DDRC_DurDeb.Com_tiTOutTCU3DebDef_C "debouncing parameter / Duration of defect debouncing for check DFC_ComTOutTCU3" VALUE 0x804D873E Val_Wu16 655350.0 DDRCTime_ms 0.00 655350.0 FORMAT "%8.1" /end CHARACTERISTIC
/begin CHARACTERISTIC DDRC_DurDeb.Com_tiTOutTCU4DebOk_C "debouncing parameter / Duration of healing debouncing for check DFC_ComTOutTCU4" VALUE 0x804D8740 Val_Wu16 655350.0 DDRCTime_ms 0.00 655350.0 FORMAT "%8.1" /end CHARACTERISTIC
/begin CHARACTERISTIC DDRC_DurDeb.Com_tiTOutTCU4DebDef_C "debouncing parameter / Duration of defect debouncing for check DFC_ComTOutTCU4" VALUE 0x804D8742 Val_Wu16 655350.0 DDRCTime_ms 0.00 655350.0 FORMAT "%8.1" /end CHARACTERISTIC
/begin CHARACTERISTIC DDRC_DurDeb.DevLib_tiBattUHiDebOk_C "debouncing parameter / Duration of healing debouncing for check DFC_DevLibBattUHi" VALUE 0x804D8744 Val_Wu16 655350.0 DDRCTime_ms 0.00 655350.0 FORMAT "%8.1" /end CHARACTERISTIC
/begin CHARACTERISTIC DDRC_DurDeb.DevLib_tiBattUHiDebDef_C "debouncing parameter / Duration of defect debouncing for check DFC_DevLibBattUHi" VALUE 0x804D8746 Val_Wu16 655350.0 DDRCTime_ms 0.00 655350.0 FORMAT "%8.1" /end CHARACTERISTIC
/begin CHARACTERISTIC DDRC_DurDeb.DevLib_tiBattULoDebOk_C "debouncing parameter / Duration of healing debouncing for check DFC_DevLibBattULo" VALUE 0x804D8748 Val_Wu16 655350.0 DDRCTime_ms 0.00 655350.0 FORMAT "%8.1" /end CHARACTERISTIC
/begin CHARACTERISTIC DDRC_DurDeb.DevLib_tiBattULoDebDef_C "debouncing parameter / Duration of defect debouncing for check DFC_DevLibBattULo" VALUE 0x804D874A Val_Wu16 655350.0 DDRCTime_ms 0.00 655350.0 FORMAT "%8.1" /end CHARACTERISTIC
/begin CHARACTERISTIC DDRC_DurDeb.Fan_tiDIOOLDebOk_C "debouncing parameter / Duration of healing debouncing for check DFC_FanDIOOL" VALUE 0x804D874C Val_Wu16 655350.0 DDRCTime_ms 0.00 655350.0 FORMAT "%8.1" /end CHARACTERISTIC
/begin CHARACTERISTIC DDRC_DurDeb.Fan_tiDIOOLDebDef_C "debouncing parameter / Duration of defect debouncing for check DFC_FanDIOOL" VALUE 0x804D874E Val_Wu16 655350.0 DDRCTime_ms 0.00 655350.0 FORMAT "%8.1" /end CHARACTERISTIC
/begin CHARACTERISTIC DDRC_DurDeb.Fan_tiDIOOvrTempDebOk_C "debouncing parameter / Duration of healing debouncing for check DFC_FanDIOOvrTemp" VALUE 0x804D8750 Val_Wu16 655350.0 DDRCTime_ms 0.00 655350.0 FORMAT "%8.1" /end CHARACTERISTIC
/begin CHARACTERISTIC DDRC_DurDeb.Fan_tiDIOOvrTempDebDef_C "debouncing parameter / Duration of defect debouncing for check DFC_FanDIOOvrTemp" VALUE 0x804D8752 Val_Wu16 655350.0 DDRCTime_ms 0.00 655350.0 FORMAT "%8.1" /end CHARACTERISTIC
/begin CHARACTERISTIC DDRC_DurDeb.Fan_tiDIOSCBDebOk_C "debouncing parameter / Duration of healing debouncing for check DFC_FanDIOSCB" VALUE 0x804D8754 Val_Wu16 655350.0 DDRCTime_ms 0.00 655350.0 FORMAT "%8.1" /end CHARACTERISTIC
/begin CHARACTERISTIC DDRC_DurDeb.Fan_tiDIOSCBDebDef_C "debouncing parameter / Duration of defect debouncing for check DFC_FanDIOSCB" VALUE 0x804D8756 Val_Wu16 655350.0 DDRCTime_ms 0.00 655350.0 FORMAT "%8.1" /end CHARACTERISTIC
/begin CHARACTERISTIC DDRC_DurDeb.Fan_tiDIOSCGDebOk_C "debouncing parameter / Duration of healing debouncing for check DFC_FanDIOSCG" VALUE 0x804D8758 Val_Wu16 655350.0 DDRCTime_ms 0.00 655350.0 FORMAT "%8.1" /end CHARACTERISTIC
/begin CHARACTERISTIC DDRC_DurDeb.Fan_tiDIOSCGDebDef_C "debouncing parameter / Duration of defect debouncing for check DFC_FanDIOSCG" VALUE 0x804D875A Val_Wu16 655350.0 DDRCTime_ms 0.00 655350.0 FORMAT "%8.1" /end CHARACTERISTIC
/begin CHARACTERISTIC DDRC_DurDeb.MRlyDcOL_tisigOLDebOk_C "debouncing parameter / Duration of healing debouncing for check DFC_MRlyDcOL" VALUE 0x804D875C Val_Wu16 655350.0 DDRCTime_ms 0.00 655350.0 FORMAT "%8.1" /end CHARACTERISTIC
/begin CHARACTERISTIC DDRC_DurDeb.MRlyDcOL_tisigOLDebDef_C "debouncing parameter / Duration of defect debouncing for check DFC_MRlyDcOL" VALUE 0x804D875E Val_Wu16 655350.0 DDRCTime_ms 0.00 655350.0 FORMAT "%8.1" /end CHARACTERISTIC
/begin CHARACTERISTIC DDRC_DurDeb.MRlyDcSCB_tisigSCBDebOk_C "debouncing parameter / Duration of healing debouncing for check DFC_MRlyDcSCB" VALUE 0x804D8760 Val_Wu16 655350.0 DDRCTime_ms 0.00 655350.0 FORMAT "%8.1" /end CHARACTERISTIC
/begin CHARACTERISTIC DDRC_DurDeb.MRlyDcSCB_tisigSCBDebDef_C "debouncing parameter / Duration of defect debouncing for check DFC_MRlyDcSCB" VALUE 0x804D8762 Val_Wu16 655350.0 DDRCTime_ms 0.00 655350.0 FORMAT "%8.1" /end CHARACTERISTIC
/begin CHARACTERISTIC DDRC_DurDeb.MRlyDcSCG_tisigSCGDebOk_C "debouncing parameter / Duration of healing debouncing for check DFC_MRlyDcSCG" VALUE 0x804D8764 Val_Wu16 655350.0 DDRCTime_ms 0.00 655350.0 FORMAT "%8.1" /end CHARACTERISTIC
/begin CHARACTERISTIC DDRC_DurDeb.MRlyDcSCG_tisigSCGDebDef_C "debouncing parameter / Duration of defect debouncing for check DFC_MRlyDcSCG" VALUE 0x804D8766 Val_Wu16 655350.0 DDRCTime_ms 0.00 655350.0 FORMAT "%8.1" /end CHARACTERISTIC
/begin CHARACTERISTIC DDRC_DurDeb.PSP_tiOLDebOk_C "debouncing parameter / Duration of healing debouncing for check DFC_PSPOL" VALUE 0x804D8768 Val_Wu16 655350.0 DDRCTime_ms 0.00 655350.0 FORMAT "%8.1" /end CHARACTERISTIC
/begin CHARACTERISTIC DDRC_DurDeb.PSP_tiOLDebDef_C "debouncing parameter / Duration of defect debouncing for check DFC_PSPOL" VALUE 0x804D876A Val_Wu16 655350.0 DDRCTime_ms 0.00 655350.0 FORMAT "%8.1" /end CHARACTERISTIC
/begin CHARACTERISTIC DDRC_DurDeb.PSP_tiOvrTempDebOk_C "debouncing parameter / Duration of healing debouncing for check DFC_PSPOvrTemp" VALUE 0x804D876C Val_Wu16 655350.0 DDRCTime_ms 0.00 655350.0 FORMAT "%8.1" /end CHARACTERISTIC
/begin CHARACTERISTIC DDRC_DurDeb.PSP_tiOvrTempDebDef_C "debouncing parameter / Duration of defect debouncing for check DFC_PSPOvrTemp" VALUE 0x804D876E Val_Wu16 655350.0 DDRCTime_ms 0.00 655350.0 FORMAT "%8.1" /end CHARACTERISTIC
/begin CHARACTERISTIC DDRC_DurDeb.PSP_tiSCBDebOk_C "debouncing parameter / Duration of healing debouncing for check DFC_PSPSCB" VALUE 0x804D8770 Val_Wu16 655350.0 DDRCTime_ms 0.00 655350.0 FORMAT "%8.1" /end CHARACTERISTIC
/begin CHARACTERISTIC DDRC_DurDeb.PSP_tiSCBDebDef_C "debouncing parameter / Duration of defect debouncing for check DFC_PSPSCB" VALUE 0x804D8772 Val_Wu16 655350.0 DDRCTime_ms 0.00 655350.0 FORMAT "%8.1" /end CHARACTERISTIC
/begin CHARACTERISTIC DDRC_DurDeb.PSP_tiSCGDebOk_C "debouncing parameter / Duration of healing debouncing for check DFC_PSPSCG" VALUE 0x804D8774 Val_Wu16 655350.0 DDRCTime_ms 0.00 655350.0 FORMAT "%8.1" /end CHARACTERISTIC
/begin CHARACTERISTIC DDRC_DurDeb.PSP_tiSCGDebDef_C "debouncing parameter / Duration of defect debouncing for check DFC_PSPSCG" VALUE 0x804D8776 Val_Wu16 655350.0 DDRCTime_ms 0.00 655350.0 FORMAT "%8.1" /end CHARACTERISTIC
/begin CHARACTERISTIC DDRC_DurDeb.T50_tiErrDebOk_C "debouncing parameter / Duration of healing debouncing for check DFC_T50Err" VALUE 0x804D8778 Val_Wu16 655350.0 DDRCTime_ms 0.00 655350.0 FORMAT "%8.1" /end CHARACTERISTIC
/begin CHARACTERISTIC DDRC_DurDeb.T50_tiErrDebDef_C "debouncing parameter / Duration of defect debouncing for check DFC_T50Err" VALUE 0x804D877A Val_Wu16 655350.0 DDRCTime_ms 0.00 655350.0 FORMAT "%8.1" /end CHARACTERISTIC
/begin CHARACTERISTIC DDRC_DurDeb.ThrVlv_tiLoBattB1DebOk_C "debouncing parameter / Duration of healing debouncing for check DFC_ThrVlvLoBattB1" VALUE 0x804D877C Val_Wu16 655350.0 DDRCTime_ms 0.00 655350.0 FORMAT "%8.1" /end CHARACTERISTIC
/begin CHARACTERISTIC DDRC_DurDeb.ThrVlv_tiLoBattB1DebDef_C "debouncing parameter / Duration of defect debouncing for check DFC_ThrVlvLoBattB1" VALUE 0x804D877E Val_Wu16 655350.0 DDRCTime_ms 0.00 655350.0 FORMAT "%8.1" /end CHARACTERISTIC
/begin CHARACTERISTIC DDRC_DurDeb.VehV_tiOLDebOk_C "debouncing parameter / Duration of healing debouncing for check DFC_VehVSclOutOL" VALUE 0x804D8780 Val_Wu16 655350.0 DDRCTime_ms 0.00 655350.0 FORMAT "%8.1" /end CHARACTERISTIC
/begin CHARACTERISTIC DDRC_DurDeb.VehV_tiOLDebDef_C "debouncing parameter / Duration of defect debouncing for check DFC_VehVSclOutOL" VALUE 0x804D8782 Val_Wu16 655350.0 DDRCTime_ms 0.00 655350.0 FORMAT "%8.1" /end CHARACTERISTIC
/begin CHARACTERISTIC DDRC_DurDeb.VehV_tiOTDebOk_C "debouncing parameter / Duration of healing debouncing for check DFC_VehVSclOutOT" VALUE 0x804D8784 Val_Wu16 655350.0 DDRCTime_ms 0.00 655350.0 FORMAT "%8.1" /end CHARACTERISTIC
/begin CHARACTERISTIC DDRC_DurDeb.VehV_tiOTDebDef_C "debouncing parameter / Duration of defect debouncing for check DFC_VehVSclOutOT" VALUE 0x804D8786 Val_Wu16 655350.0 DDRCTime_ms 0.00 655350.0 FORMAT "%8.1" /end CHARACTERISTIC
/begin CHARACTERISTIC DDRC_DurDeb.VehV_tiPhysRngHiDebOk_C "debouncing parameter / Duration of healing debouncing for check DFC_VehVPhysRngHi" VALUE 0x804D8788 Val_Wu16 655350.0 DDRCTime_ms 0.00 655350.0 FORMAT "%8.1" /end CHARACTERISTIC
/begin CHARACTERISTIC DDRC_DurDeb.VehV_tiPhysRngHiDebDef_C "debouncing parameter / Duration of defect debouncing for check DFC_VehVPhysRngHi" VALUE 0x804D878A Val_Wu16 655350.0 DDRCTime_ms 0.00 655350.0 FORMAT "%8.1" /end CHARACTERISTIC
/begin CHARACTERISTIC DDRC_DurDeb.VehV_tiSCBDebOk_C "debouncing parameter / Duration of healing debouncing for check DFC_VehVSclOutSCB" VALUE 0x804D878C Val_Wu16 655350.0 DDRCTime_ms 0.00 655350.0 FORMAT "%8.1" /end CHARACTERISTIC
/begin CHARACTERISTIC DDRC_DurDeb.VehV_tiSCBDebDef_C "debouncing parameter / Duration of defect debouncing for check DFC_VehVSclOutSCB" VALUE 0x804D878E Val_Wu16 655350.0 DDRCTime_ms 0.00 655350.0 FORMAT "%8.1" /end CHARACTERISTIC
/begin CHARACTERISTIC DDRC_DurDeb.VehV_tiSCGDebOk_C "debouncing parameter / Duration of healing debouncing for check DFC_VehVSclOutSCG" VALUE 0x804D8790 Val_Wu16 655350.0 DDRCTime_ms 0.00 655350.0 FORMAT "%8.1" /end CHARACTERISTIC
/begin CHARACTERISTIC DDRC_DurDeb.VehV_tiSCGDebDef_C "debouncing parameter / Duration of defect debouncing for check DFC_VehVSclOutSCG" VALUE 0x804D8792 Val_Wu16 655350.0 DDRCTime_ms 0.00 655350.0 FORMAT "%8.1" /end CHARACTERISTIC
/begin CHARACTERISTIC DDRC_DurDeb.VehV_tiSnsrARngHiDebOk_C "debouncing parameter / Duration of healing debouncing for check DFC_VehVSnsrARngHi" VALUE 0x804D8794 Val_Wu16 655350.0 DDRCTime_ms 0.00 655350.0 FORMAT "%8.1" /end CHARACTERISTIC
/begin CHARACTERISTIC DDRC_DurDeb.VehV_tiSnsrARngHiDebDef_C "debouncing parameter / Duration of defect debouncing for check DFC_VehVSnsrARngHi" VALUE 0x804D8796 Val_Wu16 655350.0 DDRCTime_ms 0.00 655350.0 FORMAT "%8.1" /end CHARACTERISTIC
/begin CHARACTERISTIC DDRC_DurDeb.VehV_tiSnsrBRngHiDebOk_C "debouncing parameter / Duration of healing debouncing for check DFC_VehVSnsrBRngHi" VALUE 0x804D8798 Val_Wu16 655350.0 DDRCTime_ms 0.00 655350.0 FORMAT "%8.1" /end CHARACTERISTIC
/begin CHARACTERISTIC DDRC_DurDeb.VehV_tiSnsrBRngHiDebDef_C "debouncing parameter / Duration of defect debouncing for check DFC_VehVSnsrBRngHi" VALUE 0x804D879A Val_Wu16 655350.0 DDRCTime_ms 0.00 655350.0 FORMAT "%8.1" /end CHARACTERISTIC
/begin CHARACTERISTIC DDRC_DurDeb.VehV_tiSpdRtyDiagDebOk_C "debouncing parameter / Duration of healing debouncing for check DFC_VehVSpdRtyDiag" VALUE 0x804D879C Val_Wu16 655350.0 DDRCTime_ms 0.00 655350.0 FORMAT "%8.1" /end CHARACTERISTIC
/begin CHARACTERISTIC DDRC_DurDeb.VehV_tiSpdRtyDiagDebDef_C "debouncing parameter / Duration of defect debouncing for check DFC_VehVSpdRtyDiag" VALUE 0x804D879E Val_Wu16 655350.0 DDRCTime_ms 0.00 655350.0 FORMAT "%8.1" /end CHARACTERISTIC
/begin CHARACTERISTIC DDRC_DurDeb.VehV_ctWhlErrDebOk_C "debouncing parameter / Duration of healing debouncing for check DFC_VehVWhlErr" VALUE 0x804D87A0 Val_Wu16 65535.00 OneToOne 0.00 65535.00 FORMAT "%8.2" /end CHARACTERISTIC
/begin CHARACTERISTIC DDRC_DurDeb.VehV_ctWhlErrDebDef_C "debouncing parameter / Duration of defect debouncing for check DFC_VehVWhlErr" VALUE 0x804D87A2 Val_Wu16 65535.00 OneToOne 0.00 65535.00 FORMAT "%8.2" /end CHARACTERISTIC
/begin CHARACTERISTIC DDRC_DurDeb.ACEvpT_tiSRCMaxDebOk_C "debouncing parameter / Duration of healing debouncing for check DFC_ACEvpTSRCMax" VALUE 0x804D87A4 Val_Wu16 655350.0 DDRCTime_ms 0.00 655350.0 FORMAT "%8.1" /end CHARACTERISTIC
/begin CHARACTERISTIC DDRC_DurDeb.ACEvpT_tiSRCMaxDebDef_C "debouncing parameter / Duration of defect debouncing for check DFC_ACEvpTSRCMax" VALUE 0x804D87A6 Val_Wu16 655350.0 DDRCTime_ms 0.00 655350.0 FORMAT "%8.1" /end CHARACTERISTIC
/begin CHARACTERISTIC DDRC_DurDeb.ACEvpT_tiSRCMinDebOk_C "debouncing parameter / Duration of healing debouncing for check DFC_ACEvpTSRCMin" VALUE 0x804D87A8 Val_Wu16 655350.0 DDRCTime_ms 0.00 655350.0 FORMAT "%8.1" /end CHARACTERISTIC
/begin CHARACTERISTIC DDRC_DurDeb.ACEvpT_tiSRCMinDebDef_C "debouncing parameter / Duration of defect debouncing for check DFC_ACEvpTSRCMin" VALUE 0x804D87AA Val_Wu16 655350.0 DDRCTime_ms 0.00 655350.0 FORMAT "%8.1" /end CHARACTERISTIC
/begin CHARACTERISTIC DDRC_DurDeb.AirC_tiClntSRCMaxDebOk_C "debouncing parameter / Duration of healing debouncing for check DFC_AirCClntPAnaSRCMax" VALUE 0x804D87AC Val_Wu16 655350.0 DDRCTime_ms 0.00 655350.0 FORMAT "%8.1" /end CHARACTERISTIC
/begin CHARACTERISTIC DDRC_DurDeb.AirC_tiClntSRCMaxDebDef_C "debouncing parameter / Duration of defect debouncing for check DFC_AirCClntPAnaSRCMax" VALUE 0x804D87AE Val_Wu16 655350.0 DDRCTime_ms 0.00 655350.0 FORMAT "%8.1" /end CHARACTERISTIC
/begin CHARACTERISTIC DDRC_DurDeb.AirC_tiClntSRCMinDebOk_C "debouncing parameter / Duration of healing debouncing for check DFC_AirCClntPAnaSRCMin" VALUE 0x804D87B0 Val_Wu16 655350.0 DDRCTime_ms 0.00 655350.0 FORMAT "%8.1" /end CHARACTERISTIC
/begin CHARACTERISTIC DDRC_DurDeb.AirC_tiClntSRCMinDebDef_C "debouncing parameter / Duration of defect debouncing for check DFC_AirCClntPAnaSRCMin" VALUE 0x804D87B2 Val_Wu16 655350.0 DDRCTime_ms 0.00 655350.0 FORMAT "%8.1" /end CHARACTERISTIC
/begin CHARACTERISTIC DDRC_DurDeb.AirC_tiSwtNplDebOk_C "debouncing parameter / Duration of healing debouncing for check DFC_AirCSwtNpl" VALUE 0x804D87B4 Val_Wu16 655350.0 DDRCTime_ms 0.00 655350.0 FORMAT "%8.1" /end CHARACTERISTIC
/begin CHARACTERISTIC DDRC_DurDeb.AirC_tiSwtNplDebDef_C "debouncing parameter / Duration of defect debouncing for check DFC_AirCSwtNpl" VALUE 0x804D87B6 Val_Wu16 655350.0 DDRCTime_ms 0.00 655350.0 FORMAT "%8.1" /end CHARACTERISTIC
/begin CHARACTERISTIC DDRC_DurDeb.AirC_tiSwtSigDebOk_C "debouncing parameter / Duration of healing debouncing for check DFC_AirCSwtSig" VALUE 0x804D87B8 Val_Wu16 655350.0 DDRCTime_ms 0.00 655350.0 FORMAT "%8.1" /end CHARACTERISTIC
/begin CHARACTERISTIC DDRC_DurDeb.AirC_tiSwtSigDebDef_C "debouncing parameter / Duration of defect debouncing for check DFC_AirCSwtSig" VALUE 0x804D87BA Val_Wu16 655350.0 DDRCTime_ms 0.00 655350.0 FORMAT "%8.1" /end CHARACTERISTIC
/begin CHARACTERISTIC DDRC_DurDeb.Brk_tiDebOk_C "debouncing parameter / Duration of healing debouncing for check DFC_Brk" VALUE 0x804D87BC Val_Wu16 655350.0 DDRCTime_ms 0.00 655350.0 FORMAT "%8.1" /end CHARACTERISTIC
/begin CHARACTERISTIC DDRC_DurDeb.Brk_tiDebDef_C "debouncing parameter / Duration of defect debouncing for check DFC_Brk" VALUE 0x804D87BE Val_Wu16 655350.0 DDRCTime_ms 0.00 655350.0 FORMAT "%8.1" /end CHARACTERISTIC
/begin CHARACTERISTIC DDRC_DurDeb.Brk_tiSigDebOk_C "debouncing parameter / Duration of healing debouncing for check DFC_BrkSig" VALUE 0x804D87C0 Val_Wu16 655350.0 DDRCTime_ms 0.00 655350.0 FORMAT "%8.1" /end CHARACTERISTIC
/begin CHARACTERISTIC DDRC_DurDeb.Brk_tiSigDebDef_C "debouncing parameter / Duration of defect debouncing for check DFC_BrkSig" VALUE 0x804D87C2 Val_Wu16 655350.0 DDRCTime_ms 0.00 655350.0 FORMAT "%8.1" /end CHARACTERISTIC
/begin CHARACTERISTIC DDRC_DurDeb.Clth_tiSigDebOk_C "debouncing parameter / Duration of healing debouncing for check DFC_ClthSig" VALUE 0x804D87C4 Val_Wu16 655350.0 DDRCTime_ms 0.00 655350.0 FORMAT "%8.1" /end CHARACTERISTIC
/begin CHARACTERISTIC DDRC_DurDeb.Clth_tiSigDebDef_C "debouncing parameter / Duration of defect debouncing for check DFC_ClthSig" VALUE 0x804D87C6 Val_Wu16 655350.0 DDRCTime_ms 0.00 655350.0 FORMAT "%8.1" /end CHARACTERISTIC
/begin CHARACTERISTIC DDRC_DurDeb.HLSDem_tiOvhtDebOk_C "debouncing parameter / Duration of healing debouncing for check DFC_HLSDemOvhtEngLim" VALUE 0x804D87C8 Val_Wu16 655350.0 DDRCTime_ms 0.00 655350.0 FORMAT "%8.1" /end CHARACTERISTIC
/begin CHARACTERISTIC DDRC_DurDeb.HLSDem_tiOvhtDebDef_C "debouncing parameter / Duration of defect debouncing for check DFC_HLSDemOvhtEngLim" VALUE 0x804D87CA Val_Wu16 655350.0 DDRCTime_ms 0.00 655350.0 FORMAT "%8.1" /end CHARACTERISTIC
/begin CHARACTERISTIC DDRC_DurDeb.Oil_tiNplPDebOk_C "debouncing parameter / Duration of healing debouncing for check DFC_OilPNpl" VALUE 0x804D87CC Val_Wu16 655350.0 DDRCTime_ms 0.00 655350.0 FORMAT "%8.1" /end CHARACTERISTIC
/begin CHARACTERISTIC DDRC_DurDeb.Oil_tiNplPDebDef_C "debouncing parameter / Duration of defect debouncing for check DFC_OilPNpl" VALUE 0x804D87CE Val_Wu16 655350.0 DDRCTime_ms 0.00 655350.0 FORMAT "%8.1" /end CHARACTERISTIC
/begin CHARACTERISTIC DDRC_DurDeb.PIntkVUs_tiLineHiB1DebOk_C "debouncing parameter / Duration of healing debouncing for check DFC_PIntkVUsLineHiB1" VALUE 0x804D87D0 Val_Wu16 655350.0 DDRCTime_ms 0.00 655350.0 FORMAT "%8.1" /end CHARACTERISTIC
/begin CHARACTERISTIC DDRC_DurDeb.PIntkVUs_tiLineHiB1DebDef_C "debouncing parameter / Duration of defect debouncing for check DFC_PIntkVUsLineHiB1" VALUE 0x804D87D2 Val_Wu16 655350.0 DDRCTime_ms 0.00 655350.0 FORMAT "%8.1" /end CHARACTERISTIC
/begin CHARACTERISTIC DDRC_DurDeb.PIntkVUs_tiLineLoB1DebOk_C "debouncing parameter / Duration of healing debouncing for check DFC_PIntkVUsLineLoB1" VALUE 0x804D87D4 Val_Wu16 655350.0 DDRCTime_ms 0.00 655350.0 FORMAT "%8.1" /end CHARACTERISTIC
/begin CHARACTERISTIC DDRC_DurDeb.PIntkVUs_tiLineLoB1DebDef_C "debouncing parameter / Duration of defect debouncing for check DFC_PIntkVUsLineLoB1" VALUE 0x804D87D6 Val_Wu16 655350.0 DDRCTime_ms 0.00 655350.0 FORMAT "%8.1" /end CHARACTERISTIC
/begin CHARACTERISTIC DDRC_DurDeb.VehV_tiPhysRngLoDebOk_C "debouncing parameter / Duration of healing debouncing for check DFC_VehVPhysRngLo" VALUE 0x804D87D8 Val_Wu16 655350.0 DDRCTime_ms 0.00 655350.0 FORMAT "%8.1" /end CHARACTERISTIC
/begin CHARACTERISTIC DDRC_DurDeb.VehV_tiPhysRngLoDebDef_C "debouncing parameter / Duration of defect debouncing for check DFC_VehVPhysRngLo" VALUE 0x804D87DA Val_Wu16 655350.0 DDRCTime_ms 0.00 655350.0 FORMAT "%8.1" /end CHARACTERISTIC
/begin CHARACTERISTIC DDRC_DurDeb.VehV_tiSigCanDebOk_C "debouncing parameter / Duration of healing debouncing for check DFC_VehVSigCan" VALUE 0x804D87DC Val_Wu16 655350.0 DDRCTime_ms 0.00 655350.0 FORMAT "%8.1" /end CHARACTERISTIC
/begin CHARACTERISTIC DDRC_DurDeb.VehV_tiSigCanDebDef_C "debouncing parameter / Duration of defect debouncing for check DFC_VehVSigCan" VALUE 0x804D87DE Val_Wu16 655350.0 DDRCTime_ms 0.00 655350.0 FORMAT "%8.1" /end CHARACTERISTIC
/begin CHARACTERISTIC DDRC_DurDeb.VehV_tiSigCanSafeDebOk_C "debouncing parameter / Duration of healing debouncing for check DFC_VehVSigCanSafe" VALUE 0x804D87E0 Val_Wu16 655350.0 DDRCTime_ms 0.00 655350.0 FORMAT "%8.1" /end CHARACTERISTIC
/begin CHARACTERISTIC DDRC_DurDeb.VehV_tiSigCanSafeDebDef_C "debouncing parameter / Duration of defect debouncing for check DFC_VehVSigCanSafe" VALUE 0x804D87E2 Val_Wu16 655350.0 DDRCTime_ms 0.00 655350.0 FORMAT "%8.1" /end CHARACTERISTIC
/begin CHARACTERISTIC DDRC_DurDeb.VlvLft_tiSRCMaxOilPSnsrIntk11DebOk_C "debouncing parameter / Duration of healing debouncing for check DFC_VlvLftFbOilPSnsrIntk11SRCMax" VALUE 0x804D87E4 Val_Wu16 655350.0 DDRCTime_ms 0.00 655350.0 FORMAT "%8.1" /end CHARACTERISTIC
/begin CHARACTERISTIC DDRC_DurDeb.VlvLft_tiSRCMaxOilPSnsrIntk11DebDef_C "debouncing parameter / Duration of defect debouncing for check DFC_VlvLftFbOilPSnsrIntk11SRCMax" VALUE 0x804D87E6 Val_Wu16 655350.0 DDRCTime_ms 0.00 655350.0 FORMAT "%8.1" /end CHARACTERISTIC
/begin CHARACTERISTIC DDRC_DurDeb.VlvLft_tiSRCMinOilPSnsrIntk11DebOk_C "debouncing parameter / Duration of healing debouncing for check DFC_VlvLftFbOilPSnsrIntk11SRCMin" VALUE 0x804D87E8 Val_Wu16 655350.0 DDRCTime_ms 0.00 655350.0 FORMAT "%8.1" /end CHARACTERISTIC
/begin CHARACTERISTIC DDRC_DurDeb.VlvLft_tiSRCMinOilPSnsrIntk11DebDef_C "debouncing parameter / Duration of defect debouncing for check DFC_VlvLftFbOilPSnsrIntk11SRCMin" VALUE 0x804D87EA Val_Wu16 655350.0 DDRCTime_ms 0.00 655350.0 FORMAT "%8.1" /end CHARACTERISTIC
/begin CHARACTERISTIC DDRC_DurDeb.Clth_numPlaDebOk_C "debouncing parameter / Duration of healing debouncing for check DFC_ClthNpl" VALUE 0x804D87EC Val_Wu16 65535.00 OneToOne 0.00 65535.00 FORMAT "%8.2" /end CHARACTERISTIC
/begin CHARACTERISTIC DDRC_DurDeb.Clth_numPlaDebDef_C "debouncing parameter / Duration of defect debouncing for check DFC_ClthNpl" VALUE 0x804D87EE Val_Wu16 65535.00 OneToOne 0.00 65535.00 FORMAT "%8.2" /end CHARACTERISTIC
/begin CHARACTERISTIC DDRC_DurDeb.Gbx_numPNPosnDrvCdnDebOk_C "debouncing parameter / Duration of healing debouncing for check DFC_GbxPNPosnDrvCdn" VALUE 0x804D87F0 Val_Wu16 65535.00 OneToOne 0.00 65535.00 FORMAT "%8.2" /end CHARACTERISTIC
/begin CHARACTERISTIC DDRC_DurDeb.Gbx_numPNPosnDrvCdnDebDef_C "debouncing parameter / Duration of defect debouncing for check DFC_GbxPNPosnDrvCdn" VALUE 0x804D87F2 Val_Wu16 65535.00 OneToOne 0.00 65535.00 FORMAT "%8.2" /end CHARACTERISTIC
/begin CHARACTERISTIC DDRC_DurDeb.Gbx_numPNPosnPlausyDebOk_C "debouncing parameter / Duration of healing debouncing for check DFC_GbxPNPosnPlausy" VALUE 0x804D87F4 Val_Wu16 65535.00 OneToOne 0.00 65535.00 FORMAT "%8.2" /end CHARACTERISTIC
/begin CHARACTERISTIC DDRC_DurDeb.Gbx_numPNPosnPlausyDebDef_C "debouncing parameter / Duration of defect debouncing for check DFC_GbxPNPosnPlausy" VALUE 0x804D87F6 Val_Wu16 65535.00 OneToOne 0.00 65535.00 FORMAT "%8.2" /end CHARACTERISTIC
/begin CHARACTERISTIC DDRC_DurDeb.InjVvG_numOLDebOk_C "debouncing parameter / Duration of healing debouncing for check DFC_EV4sig" VALUE 0x804D87F8 Val_Wu16 65535.00 OneToOne 0.00 65535.00 FORMAT "%8.2" /end CHARACTERISTIC
/begin CHARACTERISTIC DDRC_DurDeb.InjVvG_numOLDebDef_C "debouncing parameter / Duration of defect debouncing for check DFC_EV4sig" VALUE 0x804D87FA Val_Wu16 65535.00 OneToOne 0.00 65535.00 FORMAT "%8.2" /end CHARACTERISTIC
/begin CHARACTERISTIC DDRC_DurDeb.InjVvG_numSCBDebOk_C "debouncing parameter / Duration of healing debouncing for check DFC_EV4max" VALUE 0x804D87FC Val_Wu16 65535.00 OneToOne 0.00 65535.00 FORMAT "%8.2" /end CHARACTERISTIC
/begin CHARACTERISTIC DDRC_DurDeb.InjVvG_numSCBDebDef_C "debouncing parameter / Duration of defect debouncing for check DFC_EV4max" VALUE 0x804D87FE Val_Wu16 65535.00 OneToOne 0.00 65535.00 FORMAT "%8.2" /end CHARACTERISTIC
/begin CHARACTERISTIC DDRC_DurDeb.InjVvG_numSCGDebOk_C "debouncing parameter / Duration of healing debouncing for check DFC_EV4min" VALUE 0x804D8800 Val_Wu16 65535.00 OneToOne 0.00 65535.00 FORMAT "%8.2" /end CHARACTERISTIC
/begin CHARACTERISTIC DDRC_DurDeb.InjVvG_numSCGDebDef_C "debouncing parameter / Duration of defect debouncing for check DFC_EV4min" VALUE 0x804D8802 Val_Wu16 65535.00 OneToOne 0.00 65535.00 FORMAT "%8.2" /end CHARACTERISTIC
/begin CHARACTERISTIC DDRC_DurDeb.AltIO_tiACGFailrDebOk_C "debouncing parameter / Duration of healing debouncing for check DFC_AltIOACGFailr" VALUE 0x804D8804 Val_Wu16 655350.0 DDRCTime_ms 0.00 655350.0 FORMAT "%8.1" /end CHARACTERISTIC
/begin CHARACTERISTIC DDRC_DurDeb.AltIO_tiACGFailrDebDef_C "debouncing parameter / Duration of defect debouncing for check DFC_AltIOACGFailr" VALUE 0x804D8806 Val_Wu16 655350.0 DDRCTime_ms 0.00 655350.0 FORMAT "%8.1" /end CHARACTERISTIC
/begin CHARACTERISTIC DDRC_DurDeb.AltIO_tiACGHiVltgDebOk_C "debouncing parameter / Duration of healing debouncing for check DFC_AltIOACGHiVltg" VALUE 0x804D8808 Val_Wu16 655350.0 DDRCTime_ms 0.00 655350.0 FORMAT "%8.1" /end CHARACTERISTIC
/begin CHARACTERISTIC DDRC_DurDeb.AltIO_tiACGHiVltgDebDef_C "debouncing parameter / Duration of defect debouncing for check DFC_AltIOACGHiVltg" VALUE 0x804D880A Val_Wu16 655350.0 DDRCTime_ms 0.00 655350.0 FORMAT "%8.1" /end CHARACTERISTIC
/begin CHARACTERISTIC DDRC_DurDeb.AltIO_tiACGLoVltgDebOk_C "debouncing parameter / Duration of healing debouncing for check DFC_AltIOACGLoVltg" VALUE 0x804D880C Val_Wu16 655350.0 DDRCTime_ms 0.00 655350.0 FORMAT "%8.1" /end CHARACTERISTIC
/begin CHARACTERISTIC DDRC_DurDeb.AltIO_tiACGLoVltgDebDef_C "debouncing parameter / Duration of defect debouncing for check DFC_AltIOACGLoVltg" VALUE 0x804D880E Val_Wu16 655350.0 DDRCTime_ms 0.00 655350.0 FORMAT "%8.1" /end CHARACTERISTIC
/begin CHARACTERISTIC DDRC_DurDeb.AltIO_tiACGTHiDebOk_C "debouncing parameter / Duration of healing debouncing for check DFC_AltIOACGTHi" VALUE 0x804D8810 Val_Wu16 655350.0 DDRCTime_ms 0.00 655350.0 FORMAT "%8.1" /end CHARACTERISTIC
/begin CHARACTERISTIC DDRC_DurDeb.AltIO_tiACGTHiDebDef_C "debouncing parameter / Duration of defect debouncing for check DFC_AltIOACGTHi" VALUE 0x804D8812 Val_Wu16 655350.0 DDRCTime_ms 0.00 655350.0 FORMAT "%8.1" /end CHARACTERISTIC
/begin CHARACTERISTIC DDRC_DurDeb.AltIO_tiDConnACGDebOk_C "debouncing parameter / Duration of healing debouncing for check DFC_AltIODConnACG" VALUE 0x804D8814 Val_Wu16 655350.0 DDRCTime_ms 0.00 655350.0 FORMAT "%8.1" /end CHARACTERISTIC
/begin CHARACTERISTIC DDRC_DurDeb.AltIO_tiDConnACGDebDef_C "debouncing parameter / Duration of defect debouncing for check DFC_AltIODConnACG" VALUE 0x804D8816 Val_Wu16 655350.0 DDRCTime_ms 0.00 655350.0 FORMAT "%8.1" /end CHARACTERISTIC
/begin CHARACTERISTIC DDRC_DurDeb.BattU_tiHiFailrDebOk_C "debouncing parameter / Duration of healing debouncing for check DFC_BattUHiFailr" VALUE 0x804D8818 Val_Wu16 655350.0 DDRCTime_ms 0.00 655350.0 FORMAT "%8.1" /end CHARACTERISTIC
/begin CHARACTERISTIC DDRC_DurDeb.BattU_tiHiFailrDebDef_C "debouncing parameter / Duration of defect debouncing for check DFC_BattUHiFailr" VALUE 0x804D881A Val_Wu16 655350.0 DDRCTime_ms 0.00 655350.0 FORMAT "%8.1" /end CHARACTERISTIC
/begin CHARACTERISTIC DDRC_DurDeb.BattU_tiLoFailrDebOk_C "debouncing parameter / Duration of healing debouncing for check DFC_BattULoFailr" VALUE 0x804D881C Val_Wu16 655350.0 DDRCTime_ms 0.00 655350.0 FORMAT "%8.1" /end CHARACTERISTIC
/begin CHARACTERISTIC DDRC_DurDeb.BattU_tiLoFailrDebDef_C "debouncing parameter / Duration of defect debouncing for check DFC_BattULoFailr" VALUE 0x804D881E Val_Wu16 655350.0 DDRCTime_ms 0.00 655350.0 FORMAT "%8.1" /end CHARACTERISTIC
/begin CHARACTERISTIC DDRC_DurDeb.BrkBstP_tiDriftHiErrDebOk_C "debouncing parameter / Duration of healing debouncing for check DFC_BrkBstPDriftHiErr" VALUE 0x804D8820 Val_Wu16 655350.0 DDRCTime_ms 0.00 655350.0 FORMAT "%8.1" /end CHARACTERISTIC
/begin CHARACTERISTIC DDRC_DurDeb.BrkBstP_tiDriftHiErrDebDef_C "debouncing parameter / Duration of defect debouncing for check DFC_BrkBstPDriftHiErr" VALUE 0x804D8822 Val_Wu16 655350.0 DDRCTime_ms 0.00 655350.0 FORMAT "%8.1" /end CHARACTERISTIC
/begin CHARACTERISTIC DDRC_DurDeb.BrkBstP_tiDriftLoErrDebOk_C "debouncing parameter / Duration of healing debouncing for check DFC_BrkBstPDriftLoErr" VALUE 0x804D8824 Val_Wu16 655350.0 DDRCTime_ms 0.00 655350.0 FORMAT "%8.1" /end CHARACTERISTIC
/begin CHARACTERISTIC DDRC_DurDeb.BrkBstP_tiDriftLoErrDebDef_C "debouncing parameter / Duration of defect debouncing for check DFC_BrkBstPDriftLoErr" VALUE 0x804D8826 Val_Wu16 655350.0 DDRCTime_ms 0.00 655350.0 FORMAT "%8.1" /end CHARACTERISTIC
/begin CHARACTERISTIC DDRC_DurDeb.BrkBstP_tiSnsrStuckDebOk_C "debouncing parameter / Duration of healing debouncing for check DFC_BrkBstPSnsrStuck" VALUE 0x804D8828 Val_Wu16 655350.0 DDRCTime_ms 0.00 655350.0 FORMAT "%8.1" /end CHARACTERISTIC
/begin CHARACTERISTIC I14229iocbi_agPHAACTRINTK1_C "Calibration for Intake Camshaft Phase SDA test data" VALUE 0x8053AC90 Val_Ws16 1023.984 kw_q0p0156 -512.0000 511.9844 FORMAT "%8.4" /end CHARACTERISTIC
/begin CHARACTERISTIC I14229iocbi_agPHAACTRINTK2_C "Calibration for Intake Camshaft Phase SDA test data" VALUE 0x8053AC92 Val_Ws16 1023.984 kw_q0p0156 -512.0000 511.9844 FORMAT "%8.4" /end CHARACTERISTIC
/begin CHARACTERISTIC I14229iocbi_agPHAACTRINTK3_C "Calibration for Intake Camshaft Phase SDA test data" VALUE 0x8053AC94 Val_Ws16 1023.984 kw_q0p0156 -512.0000 511.9844 FORMAT "%8.4" /end CHARACTERISTIC
/begin CHARACTERISTIC I14229iocbi_agPHAACTROUTL1_C "Calibration for Outlet Camshaft Phase SDA test data" VALUE 0x8053AC96 Val_Ws16 1023.984 kw_q0p0156 -512.0000 511.9844 FORMAT "%8.4" /end CHARACTERISTIC
/begin CHARACTERISTIC I14229iocbi_agPHAACTROUTL2_C "Calibration for Outlet Camshaft Phase SDA test data" VALUE 0x8053AC98 Val_Ws16 1023.984 kw_q0p0156 -512.0000 511.9844 FORMAT "%8.4" /end CHARACTERISTIC
/begin CHARACTERISTIC I14229iocbi_agPHAACTROUTL3_C "Calibration for Outlet Camshaft Phase SDA test data" VALUE 0x8053AC9A Val_Ws16 1023.984 kw_q0p0156 -512.0000 511.9844 FORMAT "%8.4" /end CHARACTERISTIC
/begin CHARACTERISTIC I14229iocbi_nCP_C "Input output request calibration for capacity factor" VALUE 0x8053AC9C Val_Ws16 32767.50 EngN -16384.00 16383.50 FORMAT "%8.2" /end CHARACTERISTIC
/begin CHARACTERISTIC I14229iocbi_nHiRpmColdStrtFlPmp_C "Calibration for High rpm at cold start condition at fuel bleeding for replacement of fuel injector" VALUE 0x8051C1DE RB_Val_Ws16 32767.50 EngN -16384.00 16383.50 FORMAT "%8.2" /end CHARACTERISTIC
/begin CHARACTERISTIC I14229iocbi_nInjVlvCyl_C "input output request calibration for injector valve cylinder factor" VALUE 0x8053AC9E Val_Ws16 32767.50 EngN -16384.00 16383.50 FORMAT "%8.2" /end CHARACTERISTIC
/begin CHARACTERISTIC I14229iocbi_nInjVlv_C "input output request calibration for injector valve factor" VALUE 0x8053ACA0 Val_Ws16 32767.50 EngN -16384.00 16383.50 FORMAT "%8.2" /end CHARACTERISTIC
/begin CHARACTERISTIC I14229iocbi_nRvsLck_C "Calibration value for checking engine speed for Reverse Lock." VALUE 0x8053ACA2 Val_Ws16 32767.50 EngN -16384.00 16383.50 FORMAT "%8.2" /end CHARACTERISTIC
/begin CHARACTERISTIC I14229iocbi_nTrbCh_C "Parameter to check engine speed condition using for Turbor Charge Bank SDA tset" VALUE 0x8053ACA4 Val_Ws16 32767.50 EngN -16384.00 16383.50 FORMAT "%8.2" /end CHARACTERISTIC
/begin CHARACTERISTIC I14229iocbi_numAirCCmpr_C "air compressor calibration" VALUE 0x804D86C4 Val_Wu16 65535.00 OneToOne 0.00 65535.00 FORMAT "%8.2" /end CHARACTERISTIC
/begin CHARACTERISTIC I14229iocbi_numAPP_C "Number corresponding to Accelerator pedal position sensor" VALUE 0x804D86C2 Val_Wu16 65535.00 OneToOne 0.00 65535.00 FORMAT "%8.2" /end CHARACTERISTIC
/begin CHARACTERISTIC I14229iocbi_numCP_C "capacity number" VALUE 0x804D86C0 Val_Wu16 65535.00 OneToOne 0.00 65535.00 FORMAT "%8.2" /end CHARACTERISTIC
/begin CHARACTERISTIC I14229iocbi_numDuv_C "Maximum number of Operation modes allowed for Air Bypass Solenoid Valve FST mode" VALUE 0x804D86BE Val_Wu16 65535.00 OneToOne 0.00 65535.00 FORMAT "%8.2" /end CHARACTERISTIC
/begin CHARACTERISTIC I14229iocbi_numFanDig_C "digital fan number" VALUE 0x804D86BC Val_Wu16 65535.00 OneToOne 0.00 65535.00 FORMAT "%8.2" /end CHARACTERISTIC
/begin CHARACTERISTIC I14229iocbi_numFlPmp_C "number of fuel number" VALUE 0x804D86BA Val_Wu16 65535.00 OneToOne 0.00 65535.00 FORMAT "%8.2" /end CHARACTERISTIC
/begin CHARACTERISTIC I14229iocbi_numInjTstFlg1_C "Injector tester flag" VALUE 0x804D86B8 Val_Wu16 65535.00 OneToOne 0.00 65535.00 FORMAT "%8.2" /end CHARACTERISTIC
/begin CHARACTERISTIC I14229iocbi_numInjTstFlg_C "injector tester flag" VALUE 0x804D86B6 Val_Wu16 65535.00 OneToOne 0.00 65535.00 FORMAT "%8.2" /end CHARACTERISTIC
/begin CHARACTERISTIC I14229iocbi_numMDAAltIO_C "Alternator input output value" VALUE 0x804D86B4 Val_Wu16 65535.00 OneToOne 0.00 65535.00 FORMAT "%8.2" /end CHARACTERISTIC
/begin CHARACTERISTIC I14229iocbi_numMDACP_C "Maximum number of Operation modes allowed for Canister Purge Valve MDA FST mode" VALUE 0x804D86B2 Val_Wu16 65535.00 OneToOne 0.00 65535.00 FORMAT "%8.2" /end CHARACTERISTIC
/begin CHARACTERISTIC I14229iocbi_numMDADuv_C "Maximum number of Operation modes allowed for Air Bypass Solenoid Valve MDA test FST mode" VALUE 0x804D86B0 Val_Wu16 65535.00 OneToOne 0.00 65535.00 FORMAT "%8.2" /end CHARACTERISTIC
/begin CHARACTERISTIC I14229iocbi_numMDAFanDig_C "Digital value corresponding to cooling fan" VALUE 0x804D86AE Val_Wu16 65535.00 OneToOne 0.00 65535.00 FORMAT "%8.2" /end CHARACTERISTIC
/begin CHARACTERISTIC I14229iocbi_numMDAICEWP_C "Maximum number of Operation modes allowed for water charge air cooler EWP control MDA" VALUE 0x804D86AC Val_Wu16 65535.00 OneToOne 0.00 65535.00 FORMAT "%8.2" /end CHARACTERISTIC
/begin CHARACTERISTIC I14229iocbi_numMDAVlvLft_C "Maximum number of Operation modes allowed for Valve Lift MDA test FST mode" VALUE 0x804D86AA Val_Wu16 65535.00 OneToOne 0.00 65535.00 FORMAT "%8.2" /end CHARACTERISTIC
/begin CHARACTERISTIC I14229iocbi_numPHAACTRINTK_C "Maximum number of Operation modes allowed for Intake Camshaft Phase SDA test FST mode" VALUE 0x804D86A8 Val_Wu16 65535.00 OneToOne 0.00 65535.00 FORMAT "%8.2" /end CHARACTERISTIC
/begin CHARACTERISTIC I14229iocbi_numPHAACTROUTL_C "Maximum number of Operation modes allowed for Outlet Camshaft Phase SDA test FST mode" VALUE 0x804D86A6 Val_Wu16 65535.00 OneToOne 0.00 65535.00 FORMAT "%8.2" /end CHARACTERISTIC
/begin CHARACTERISTIC I14229iocbi_numRvsLck_C "Maximum number of modes alllowed for Reverse Lock" VALUE 0x804D86A4 Val_Wu16 65535.00 OneToOne 0.00 65535.00 FORMAT "%8.2" /end CHARACTERISTIC
/begin CHARACTERISTIC I14229iocbi_numSDAICEWP_C "Maximum number of Operation modes allowed for this water charge air cooler ICEWP SDA" VALUE 0x804D86A2 Val_Wu16 65535.00 OneToOne 0.00 65535.00 FORMAT "%8.2" /end CHARACTERISTIC
/begin CHARACTERISTIC I14229iocbi_numThrVlv_C "Maximum operation mode number for ThrVlv SFT" VALUE 0x804D86A0 Val_Wu16 65535.00 OneToOne 0.00 65535.00 FORMAT "%8.2" /end CHARACTERISTIC
/begin CHARACTERISTIC I14229iocbi_numTrbCh_C "Maximum operation mode number for TrbCh SFT" VALUE 0x804D869E Val_Wu16 65535.00 OneToOne 0.00 65535.00 FORMAT "%8.2" /end CHARACTERISTIC
/begin CHARACTERISTIC I14229iocbi_numVlvLft_C "Valve lift value" VALUE 0x804D869C Val_Wu16 65535.00 OneToOne 0.00 65535.00 FORMAT "%8.2" /end CHARACTERISTIC
/begin CHARACTERISTIC I14229iocbi_nVlvLftHi_C "Upper limit for valve lift value" VALUE 0x8053ACA6 Val_Ws16 32767.50 EngN -16384.00 16383.50 FORMAT "%8.2" /end CHARACTERISTIC
/begin CHARACTERISTIC I14229iocbi_nVlvLftLo_C "Lower limit for valve lift value" VALUE 0x8053ACA8 Val_Ws16 32767.50 EngN -16384.00 16383.50 FORMAT "%8.2" /end CHARACTERISTIC
/begin CHARACTERISTIC I14229iocbi_rDuv1_C "Parameter to control the opening of Air Bypass Solenoid Valve SDA test" VALUE 0x8053ACAA Val_Wu16 99.99847 rel_uw_b100 0.00 99.99847 FORMAT "%8.5" /end CHARACTERISTIC
/begin CHARACTERISTIC I14229iocbi_rDuv2_C "Parameter to control the opening of Air Bypass Solenoid Valve SDA test" VALUE 0x8053ACAC Val_Wu16 99.99847 rel_uw_b100 0.00 99.99847 FORMAT "%8.5" /end CHARACTERISTIC
/begin CHARACTERISTIC I14229iocbi_rMDADuv1_C "Parameter to control the opening of Air Bypass Solenoid Valve MDA test" VALUE 0x8053ACAE Val_Wu16 99.99847 rel_uw_b100 0.00 99.99847 FORMAT "%8.5" /end CHARACTERISTIC
/begin CHARACTERISTIC I14229iocbi_rMDADuv2_C "Parameter to control the opening of Air Bypass Solenoid Valve MDA test" VALUE 0x8053ACB0 Val_Wu16 99.99847 rel_uw_b100 0.00 99.99847 FORMAT "%8.5" /end CHARACTERISTIC
/begin CHARACTERISTIC I14229iocbi_rTrbChCls_C "Parameter to control the closing of Turbor Charge Bank 1 SDA test" VALUE 0x8053ACB2 Val_Ws16 511.9922 rel_q0p0078125 -256.0000 255.9922 FORMAT "%8.4" /end CHARACTERISTIC
/begin CHARACTERISTIC I14229iocbi_rTrbChOpen_C "Parameter to control the opening of Turbor Charge Bank 1 SDA test" VALUE 0x8053ACB4 Val_Ws16 511.9922 rel_q0p0078125 -256.0000 255.9922 FORMAT "%8.4" /end CHARACTERISTIC
/begin CHARACTERISTIC I14229iocbi_tFanDig_C "Digital fan temperature" VALUE 0x8053ACB6 Val_Ws16 6553.500 Temp_Cels -3549.940 3003.560 FORMAT "%8.3" /end CHARACTERISTIC
/begin CHARACTERISTIC I14229iocbi_tInjTstCylHi_C "Upper limit of injector tester cylinder temperature" VALUE 0x8053ACB8 Val_Ws16 6553.500 Temp_Cels -3549.940 3003.560 FORMAT "%8.3" /end CHARACTERISTIC
/begin CHARACTERISTIC I14229iocbi_tInjTstCylLo_C "Lower limit of injector tester cylinder temperature" VALUE 0x8053ACBA Val_Ws16 6553.500 Temp_Cels -3549.940 3003.560 FORMAT "%8.3" /end CHARACTERISTIC
/begin CHARACTERISTIC I14229iocbi_tPHAACTRINTKHi_C "Upper limit of Intake Camshaft Phase SDA temperature" VALUE 0x8053ACBC Val_Ws16 6553.500 Temp_Cels -3549.940 3003.560 FORMAT "%8.3" /end CHARACTERISTIC
/begin CHARACTERISTIC I14229iocbi_tPHAACTRINTKLo_C "Lower limit of Intake Camshaft Phase SDA temperature" VALUE 0x8053ACBE Val_Ws16 6553.500 Temp_Cels -3549.940 3003.560 FORMAT "%8.3" /end CHARACTERISTIC
/begin CHARACTERISTIC I14229iocbi_tPHAACTROUTLHi_C "Upper limit of Outlet Camshaft Phase SDA temperature" VALUE 0x8053ACC0 Val_Ws16 6553.500 Temp_Cels -3549.940 3003.560 FORMAT "%8.3" /end CHARACTERISTIC
/begin CHARACTERISTIC I14229iocbi_tPHAACTROUTLLo_C "Lower limit of Outlet Camshaft Phase SDA temperature" VALUE 0x8053ACC2 Val_Ws16 6553.500 Temp_Cels -3549.940 3003.560 FORMAT "%8.3" /end CHARACTERISTIC
/begin CHARACTERISTIC I14229iocbi_tVlvLft_C "valve lift temperature." VALUE 0x8053ACC4 Val_Ws16 6553.500 Temp_Cels -3549.940 3003.560 FORMAT "%8.3" /end CHARACTERISTIC
/begin CHARACTERISTIC I14229iocbi_uAirCCmpr_C "Air compressor voltage" VALUE 0x8053ACC6 Val_Ws16 1310700. Volt_Batt -655360.0 655340.0 FORMAT "%8.1" /end CHARACTERISTIC
/begin CHARACTERISTIC I14229iocbi_uCPRun_C "Canister Purge Valve calibration for Power voltage check when engine is running" VALUE 0x8053ACC8 Val_Ws16 1310700. Volt_Batt -655360.0 655340.0 FORMAT "%8.1" /end CHARACTERISTIC
/begin CHARACTERISTIC I14229iocbi_uCP_C "Capacity voltage" VALUE 0x8053ACCA Val_Ws16 1310700. Volt_Batt -655360.0 655340.0 FORMAT "%8.1" /end CHARACTERISTIC
/begin CHARACTERISTIC I14229iocbi_uDuvRun_C "Air Bypass Solenoid Valve running voltage SDA test" VALUE 0x8053ACCC Val_Ws16 1310700. Volt_Batt -655360.0 655340.0 FORMAT "%8.1" /end CHARACTERISTIC
/begin CHARACTERISTIC I14229iocbi_uDuv_C "Voltage coresponding to Air Bypass Solenoid Valve" VALUE 0x8053ACCE Val_Ws16 1310700. Volt_Batt -655360.0 655340.0 FORMAT "%8.1" /end CHARACTERISTIC
/begin CHARACTERISTIC I14229iocbi_uFanDigRun_C "Digital voltage of fan running" VALUE 0x8053ACD0 Val_Ws16 1310700. Volt_Batt -655360.0 655340.0 FORMAT "%8.1" /end CHARACTERISTIC
/begin CHARACTERISTIC I14229iocbi_uFanDigStl_C "Digital voltage of fan running" VALUE 0x8053ACD2 Val_Ws16 1310700. Volt_Batt -655360.0 655340.0 FORMAT "%8.1" /end CHARACTERISTIC
/begin CHARACTERISTIC I14229iocbi_uFlPmpRun_C "Fuel pump running voltage" VALUE 0x8053ACD4 Val_Ws16 1310700. Volt_Batt -655360.0 655340.0 FORMAT "%8.1" /end CHARACTERISTIC
/begin CHARACTERISTIC I14229iocbi_uFlPmpStl_C "voltage coresponding to fuel pump" VALUE 0x8053ACD6 Val_Ws16 1310700. Volt_Batt -655360.0 655340.0 FORMAT "%8.1" /end CHARACTERISTIC
/begin CHARACTERISTIC I14229iocbi_uInjTstRun_C "voltage corresponding to injector test run" VALUE 0x8053ACD8 Val_Ws16 1310700. Volt_Batt -655360.0 655340.0 FORMAT "%8.1" /end CHARACTERISTIC
/begin CHARACTERISTIC I14229iocbi_uInjTstStl_C "voltage corresponding to injector test stall" VALUE 0x8053ACDA Val_Ws16 1310700. Volt_Batt -655360.0 655340.0 FORMAT "%8.1" /end CHARACTERISTIC
/begin CHARACTERISTIC I14229iocbi_uMDACPRun_C "Canister Purge Valve runing Voltage" VALUE 0x8053ACDC Val_Ws16 1310700. Volt_Batt -655360.0 655340.0 FORMAT "%8.1" /end CHARACTERISTIC
/begin CHARACTERISTIC I14229iocbi_uMDACP_C "Voltage coresponding to Air Bypass Solenoid Valve MDA test" VALUE 0x8053ACDE Val_Ws16 1310700. Volt_Batt -655360.0 655340.0 FORMAT "%8.1" /end CHARACTERISTIC
/begin CHARACTERISTIC I14229iocbi_uMDADuvRun_C "Air Bypass Solenoid Valve running voltage MDA test" VALUE 0x8053ACE0 Val_Ws16 1310700. Volt_Batt -655360.0 655340.0 FORMAT "%8.1" /end CHARACTERISTIC
/begin CHARACTERISTIC I14229iocbi_uMDADuv_C "Voltage coresponding to Air Bypass Solenoid Valve MDA test" VALUE 0x8053ACE2 Val_Ws16 1310700. Volt_Batt -655360.0 655340.0 FORMAT "%8.1" /end CHARACTERISTIC
/begin CHARACTERISTIC I14229iocbi_uPHAACTRINTKRun_C "Parameter to check power voltage condition using for for Intake Camshaft Phase SDA test when engine is running" VALUE 0x8053ACE4 Val_Ws16 1310700. Volt_Batt -655360.0 655340.0 FORMAT "%8.1" /end CHARACTERISTIC
/begin CHARACTERISTIC I14229iocbi_uPHAACTRINTKStl_C "Parameter to check power voltage condition using for for Intake Camshaft Phase SDA test when engine is not running" VALUE 0x8053ACE6 Val_Ws16 1310700. Volt_Batt -655360.0 655340.0 FORMAT "%8.1" /end CHARACTERISTIC
/begin CHARACTERISTIC I14229iocbi_uPHAACTROUTL_C "Parameter to check power voltage condition using for for Outlet Camshaft Phase SDA test" VALUE 0x8053ACE8 Val_Ws16 1310700. Volt_Batt -655360.0 655340.0 FORMAT "%8.1" /end CHARACTERISTIC
/begin CHARACTERISTIC I14229iocbi_uThrVlv_C "voltage corresponding to throttle valve" VALUE 0x8053ACEA Val_Ws16 1310700. Volt_Batt -655360.0 655340.0 FORMAT "%8.1" /end CHARACTERISTIC
/begin CHARACTERISTIC I14229iocbi_uTrbCh_C "voltage coresponding to Turbor Charge bank 1" VALUE 0x8053ACEC Val_Ws16 1310700. Volt_Batt -655360.0 655340.0 FORMAT "%8.1" /end CHARACTERISTIC
/begin CHARACTERISTIC I14229iocbi_uVlvLftRun_C "voltage corresponding to valve lift run" VALUE 0x8053ACEE Val_Ws16 1310700. Volt_Batt -655360.0 655340.0 FORMAT "%8.1" /end CHARACTERISTIC
/begin CHARACTERISTIC I14229iocbi_uVlvLftStl_C "voltage corresponding to valve lift stall" VALUE 0x8053ACF0 Val_Ws16 1310700. Volt_Batt -655360.0 655340.0 FORMAT "%8.1" /end CHARACTERISTIC
/begin CHARACTERISTIC I14229iocbi_vAPP_C "Velocity corresponding to Accelerator pedal position sensor" VALUE 0x8053ACF2 Val_Ws16 655.3500 Vel -327.6800 327.6700 FORMAT "%8.4" /end CHARACTERISTIC
/begin CHARACTERISTIC I14229iocbi_vRvsLck_C "Calibration value for checking vehicle speed for Reverse Lock." VALUE 0x8053ACF4 Val_Ws16 655.3500 Vel -327.6800 327.6700 FORMAT "%8.4" /end CHARACTERISTIC
/begin CHARACTERISTIC I14229_AirCCmpr_stMsk_CA "air compressor status mask" VAL_BLK 0x804D8698 ValA_Wu16 65535.00 OneToOne 0.00 65535.00 FORMAT "%8.2" NUMBER 2 /end CHARACTERISTIC
/begin CHARACTERISTIC I14229_AltIO_stMskMDA_CA "alternator input output mask" VAL_BLK 0x804D8694 ValA_Wu16 65535.00 OneToOne 0.00 65535.00 FORMAT "%8.2" NUMBER 2 /end CHARACTERISTIC
/begin CHARACTERISTIC I14229_APP_stMskMDA_CA "mask for Accped postion sensor Mda" VAL_BLK 0x804D8690 ValA_Wu16 65535.00 OneToOne 0.00 65535.00 FORMAT "%8.2" NUMBER 2 /end CHARACTERISTIC
/begin CHARACTERISTIC I14229_CP_stMskMDA_CA "Condition check Mask Canister Purge Valve MDA Test" VAL_BLK 0x804D868C ValA_Wu16 65535.00 OneToOne 0.00 65535.00 FORMAT "%8.2" NUMBER 2 /end CHARACTERISTIC
/begin CHARACTERISTIC I14229_CP_stMsk_CA "capacity status mask" VAL_BLK 0x804D8688 ValA_Wu16 65535.00 OneToOne 0.00 65535.00 FORMAT "%8.2" NUMBER 2 /end CHARACTERISTIC
/begin CHARACTERISTIC I14229_ctTxWaitRepDTC_C "Calibration for run time optimization for sub function 02 of RDTC service" VALUE 0x8053AD08 RB_Val_Wu16 65535.00 OneToOne 0.00 65535.00 FORMAT "%8.2" /end CHARACTERISTIC
/begin CHARACTERISTIC I14229_ctTxWaitSuppDTC_C "Calibration for run time optimization for sub function 0A of RDTC service" VALUE 0x8053AD0A RB_Val_Wu16 65535.00 OneToOne 0.00 65535.00 FORMAT "%8.2" /end CHARACTERISTIC
/begin CHARACTERISTIC I14229_ctWaitNumDTC_C "Calibration for run time optimization for sub function 01 of RDTC service" VALUE 0x8053AD0C RB_Val_Wu16 65535.00 OneToOne 0.00 65535.00 FORMAT "%8.2" /end CHARACTERISTIC
/begin CHARACTERISTIC I14229_ctWaitRepDTC_C "Calibration for run time optimization for sub function 02 of RDTC service" VALUE 0x8053AD0E RB_Val_Wu16 65535.00 OneToOne 0.00 65535.00 FORMAT "%8.2" /end CHARACTERISTIC
/begin CHARACTERISTIC I14229_ctWaitSuppDTC_C "Calibration for run time optimization for sub function 0A of RDTC service" VALUE 0x8053AD10 RB_Val_Wu16 65535.00 OneToOne 0.00 65535.00 FORMAT "%8.2" /end CHARACTERISTIC
/begin CHARACTERISTIC I14229_dRMBAEna_C "RMBA service enable" VALUE 0x8051C1F2 RB_Val_Wu8 255.0 OneToOne 0.00 255.0 FORMAT "%5.1" /end CHARACTERISTIC
/begin CHARACTERISTIC I14229_Duv_stMskMDA_CA "Condition check Mask for Air Bypass Solenoid Valve MDA Test" VAL_BLK 0x804D8684 ValA_Wu16 65535.00 OneToOne 0.00 65535.00 FORMAT "%8.2" NUMBER 2 /end CHARACTERISTIC
/begin CHARACTERISTIC I14229_Duv_stMsk_CA "Condition check Mask for Air Bypass Solenoid Valve SDA Test" VAL_BLK 0x804D8680 ValA_Wu16 65535.00 OneToOne 0.00 65535.00 FORMAT "%8.2" NUMBER 2 /end CHARACTERISTIC
/begin CHARACTERISTIC I14229_FanDig_stMskMDA_CA "Digital fan status mask (MDA)" VAL_BLK 0x804D867C ValA_Wu16 65535.00 OneToOne 0.00 65535.00 FORMAT "%8.2" NUMBER 2 /end CHARACTERISTIC
/begin CHARACTERISTIC I14229_FanDig_stMsk_CA "digital fan status mask calibration array." VAL_BLK 0x804D8678 ValA_Wu16 65535.00 OneToOne 0.00 65535.00 FORMAT "%8.2" NUMBER 2 /end CHARACTERISTIC
/begin CHARACTERISTIC I14229_FlPmp_stMsk_CA "Fuel pump status mask calibration array." VAL_BLK 0x804D8674 ValA_Wu16 65535.00 OneToOne 0.00 65535.00 FORMAT "%8.2" NUMBER 2 /end CHARACTERISTIC
/begin CHARACTERISTIC I14229_iACCompCmprSol_C "Calibration value for checking the compressor volume control current" VALUE 0x8051C1E2 RB_Val_Wu16 65535.00 i_q1_mA 0.00 65535.00 FORMAT "%8.2" /end CHARACTERISTIC
/begin CHARACTERISTIC I14229_ICEWP_stMskMDA_CA "Application to Mask the condition check for water charge air cooler EWP control SDA" VAL_BLK 0x804D8670 ValA_Wu16 65535.00 OneToOne 0.00 65535.00 FORMAT "%8.2" NUMBER 2 /end CHARACTERISTIC
/begin CHARACTERISTIC I14229_ICEWP_stMsk_CA "Application to Mask the condition check for water charge air cooler EWP control MDA" VAL_BLK 0x804D866C ValA_Wu16 65535.00 OneToOne 0.00 65535.00 FORMAT "%8.2" NUMBER 2 /end CHARACTERISTIC
/begin CHARACTERISTIC I14229_InjTst1_stMsk_CA "Calibration mask for Injector tester service" VAL_BLK 0x804D8668 ValA_Wu16 65535.00 OneToOne 0.00 65535.00 FORMAT "%8.2" NUMBER 2 /end CHARACTERISTIC
/begin CHARACTERISTIC I14229_InjTst_stMsk_CA "Injector tester status mask calibration array." VAL_BLK 0x804D8664 ValA_Wu16 65535.00 OneToOne 0.00 65535.00 FORMAT "%8.2" NUMBER 2 /end CHARACTERISTIC
/begin CHARACTERISTIC I14229_nACSafHysHi_C "Calibration of upper safety limit of AC hysterisis" VALUE 0x8051C1E4 RB_Val_Ws16 32767.50 EngN -16384.00 16383.50 FORMAT "%8.2" /end CHARACTERISTIC
/begin CHARACTERISTIC I14229_nACSafHysLo_C "Calibration of lower safety limit of AC hysterisis" VALUE 0x8051C1E6 RB_Val_Ws16 32767.50 EngN -16384.00 16383.50 FORMAT "%8.2" /end CHARACTERISTIC
/begin CHARACTERISTIC I14229_nEngHysHi_C "Calibration of upper lmit of engine speed hysterisis" VALUE 0x8051C1E8 RB_Val_Ws16 32767.50 EngN -16384.00 16383.50 FORMAT "%8.2" /end CHARACTERISTIC
/begin CHARACTERISTIC I14229_nEngHysLo_C "Calibration of lower limit engine speed hysterisis" VALUE 0x8051C1EA RB_Val_Ws16 32767.50 EngN -16384.00 16383.50 FORMAT "%8.2" /end CHARACTERISTIC
/begin CHARACTERISTIC I14229_nHpFlInjCdnIdlHi_C "Calibration high hysteresis value for checking engine speed" VALUE 0x8053AD14 Val_Ws16 32767.50 EngN -16384.00 16383.50 FORMAT "%8.2" /end CHARACTERISTIC
/begin CHARACTERISTIC I14229_nHpFlInjCdnIdlLo_C "Calibration value for checking engine speed" VALUE 0x8053AD16 Val_Ws16 32767.50 EngN -16384.00 16383.50 FORMAT "%8.2" /end CHARACTERISTIC
/begin CHARACTERISTIC I14229_nrABSFailCnclMax_C "Max possible number of ABS fail safe action" VALUE 0x8051C1EC RB_Val_Wu8 255.0 OneToOne 0.00 255.0 FORMAT "%5.1" /end CHARACTERISTIC
/begin CHARACTERISTIC I14229_nrABSFailCnclSubs_C "Replacement value of possible number of ABS fail safe action cancel execution in case of EEPROM error" VALUE 0x8051C1ED RB_Val_Wu8 255.0 OneToOne 0.00 255.0 FORMAT "%5.1" /end CHARACTERISTIC
/begin CHARACTERISTIC I14229_PHAACTRINTK_stMsk_CA "Condition check Mask for Intake Camshaft Phase SDA Test" VAL_BLK 0x804D8660 ValA_Wu16 65535.00 OneToOne 0.00 65535.00 FORMAT "%8.2" NUMBER 2 /end CHARACTERISTIC
/begin CHARACTERISTIC I14229_PHAACTROUTL_stMsk_CA "Condition check Mask for Outlet Camshaft Phase SDA Test" VAL_BLK 0x804D865C ValA_Wu16 65535.00 OneToOne 0.00 65535.00 FORMAT "%8.2" NUMBER 2 /end CHARACTERISTIC
/begin CHARACTERISTIC I14229_rAppLETThd_C "Acceleration pedal sensor value for checking condition of APP test." VALUE 0x8051C1E0 Val_Ws16 799.9878 Prc -400.0000 399.9878 FORMAT "%8.4" /end CHARACTERISTIC
/begin CHARACTERISTIC I14229_ratCoolg_C "Duty for AirVent" VALUE 0x804FA864 KwWU16 99.99847 rel_uw_b100 0.00 99.99847 FORMAT "%8.5" /end CHARACTERISTIC
/begin CHARACTERISTIC I14229_RvsLck_stMskMDA_CA "Condition check mask for Reverse Lock" VAL_BLK 0x804D8658 ValA_Wu16 65535.00 OneToOne 0.00 65535.00 FORMAT "%8.2" NUMBER 2 /end CHARACTERISTIC
/begin CHARACTERISTIC I14229_stACCompDeActvReqSubs_C "Alternating current comparision deactiavtion request substitute calibration" VALUE 0x8051C1EE RB_Val_Wu8 255.0 OneToOne 0.00 255.0 FORMAT "%5.1" /end CHARACTERISTIC
/begin CHARACTERISTIC I14229_stCACPmpRlyOFF_C "CAC pump relay off status" VALUE 0x8053ACF6 Val_Wu8 255.0 OneToOne 0.00 255.0 FORMAT "%5.1" /end CHARACTERISTIC
/begin CHARACTERISTIC I14229_stCACPmpRlyON_C "CAC pump relay on status" VALUE 0x8053ACF7 Val_Wu8 255.0 OneToOne 0.00 255.0 FORMAT "%5.1" /end CHARACTERISTIC
/begin CHARACTERISTIC I14229_stIOCBIMskSuprtMDA_C "input output mask support (MDA)" VALUE 0x8053ACF8 Val_Wu32 4294967295.00 OneToOne 0.00 4294967295.00 FORMAT "%13.2" /end CHARACTERISTIC
/begin CHARACTERISTIC I14229_stIOCBIMskSuprtSDA_C "Bit mask for SFT of individual devices" VALUE 0x8053ACFC Val_Wu32 4294967295.00 OneToOne 0.00 4294967295.00 FORMAT "%13.2" /end CHARACTERISTIC
/begin CHARACTERISTIC I14229_stOilFlowComplSubs_C "Calibration corresponding to Status of oil flow completion sustitute" VALUE 0x8051C1EF RB_Val_Wu8 255.0 OneToOne 0.00 255.0 FORMAT "%5.1" /end CHARACTERISTIC
/begin CHARACTERISTIC I14229_stRMBADFlashBlkEna_C "EEPROM block reading enable calibration" VALUE 0x8053AD22 RB_Val_Wu8 255.0 OneToOne 0.00 255.0 FORMAT "%5.1" /end CHARACTERISTIC
/begin CHARACTERISTIC I14229_stRMBADS0BlkEna_C "DS0 block reading enable calibration" VALUE 0x8051C1F3 RB_Val_Wu8 255.0 OneToOne 0.00 255.0 FORMAT "%5.1" /end CHARACTERISTIC
/begin CHARACTERISTIC I14229_stRMBASecuEna_C "parameter to enable Security check condition" VALUE 0x8051C1F4 RB_Val_Wu8 255.0 OneToOne 0.00 255.0 FORMAT "%5.1" /end CHARACTERISTIC
/begin CHARACTERISTIC I14229_swtDTCLowByte_C "Calibration corresponding to low byte information for DTC switch." VALUE 0x8053AD12 RB_Val_Wu8 255.0 OneToOne 0.00 255.0 FORMAT "%5.1" /end CHARACTERISTIC
/begin CHARACTERISTIC I14229_tHpFlInjCdnIdlHi_C "Calibration of upper value for checking coolant temperature" VALUE 0x8053AD18 Val_Ws16 6553.500 Temp_Cels -3549.940 3003.560 FORMAT "%8.3" /end CHARACTERISTIC
/begin CHARACTERISTIC I14229_tHpFlInjCdnIdlLo_C "Calibration of lower value for checking coolant temperature" VALUE 0x8053AD1A Val_Ws16 6553.500 Temp_Cels -3549.940 3003.560 FORMAT "%8.3" /end CHARACTERISTIC
/begin CHARACTERISTIC I14229_ThrVlv_stMsk_CA "Engine condition check Mask for Line End Tester and Service Tool. ( ThrVlv SFT)" VAL_BLK 0x804D8654 ValA_Wu16 65535.00 OneToOne 0.00 65535.00 FORMAT "%8.2" NUMBER 2 /end CHARACTERISTIC
/begin CHARACTERISTIC I14229_tiOilFlowComplSubs_C "Calibration corresponding to oil flow completion sustitute time" VALUE 0x8051C1F0 RB_Val_Wu8 255.0 Time_sec_q1_COMPU 0.00 255.0 FORMAT "%5.1" /end CHARACTERISTIC
/begin CHARACTERISTIC I14229_tiThrVlvMax_C "Maximum duration of throttle valve SFT" VALUE 0x8053AD00 Val_Ws16 655.3500 Time_s -327.6800 327.6700 FORMAT "%8.4" /end CHARACTERISTIC
/begin CHARACTERISTIC I14229_TrbCh_stMsk_CA "Engine condition check Mask for Line End Tester and Service Tool. ( TrbCh SFT)" VAL_BLK 0x804D8650 ValA_Wu16 65535.00 OneToOne 0.00 65535.00 FORMAT "%8.2" NUMBER 2 /end CHARACTERISTIC
/begin CHARACTERISTIC I14229_uHpFlInjCdnIdl_C "Calibration of lower value for checking battery voltage" VALUE 0x8053AD1C Val_Ws16 1310700. Volt_Batt -655360.0 655340.0 FORMAT "%8.1" /end CHARACTERISTIC
/begin CHARACTERISTIC I14229_vHpFlInjCdnIdl_C "Calibration of lower value for checking vehicle speed" VALUE 0x8053AD1E Val_Ws16 655.3500 Vel -327.6800 327.6700 FORMAT "%8.4" /end CHARACTERISTIC
/begin CHARACTERISTIC I14229_VlvLft_stMskMDA_CA "valve lift status mask (MDA)" VAL_BLK 0x804D864C ValA_Wu16 65535.00 OneToOne 0.00 65535.00 FORMAT "%8.2" NUMBER 2 /end CHARACTERISTIC
/begin CHARACTERISTIC I14229_VlvLft_stMsk_CA "valve lift status mask" VAL_BLK 0x804D8648 ValA_Wu16 65535.00 OneToOne 0.00 65535.00 FORMAT "%8.2" NUMBER 2 /end CHARACTERISTIC
/begin CHARACTERISTIC I14229_vRCCrCtl_C "Vehicle speed check limit" VALUE 0x8053AD20 Val_Ws16 655.3500 Vel -327.6800 327.6700 FORMAT "%8.4" /end CHARACTERISTIC
/begin CHARACTERISTIC I14229_wACT_C "Caibration limit to decide throttle valve is open or close" VALUE 0x8053AD02 Val_Wu16 100.0000 relPED_q0p00153 0.00 100.0000 FORMAT "%8.4" /end CHARACTERISTIC
/begin CHARACTERISTIC I14229_wFlPmp_C "Caibration corresponding to fuel pump signal" VALUE 0x8053AD04 Val_Wu16 100.0000 relPED_q0p00153 0.00 100.0000 FORMAT "%8.4" /end CHARACTERISTIC
/begin CHARACTERISTIC I14229_wRvsLck_C "Calibration value for checking Accel pedal position" VALUE 0x8053AD06 Val_Wu16 100.0000 relPED_q0p00153 0.00 100.0000 FORMAT "%8.4" /end CHARACTERISTIC
/begin MEASUREMENT arqtprs_w_msg "setpoint high pressure by tester" UWORD p_q0p0005 1 100 0.00 32.76750 FORMAT "%8.5" ECU_ADDRESS 0x70001E92 /end MEASUREMENT
/begin MEASUREMENT B_rqtprsol_msg "condition request setpoint high pressure by tester" UBYTE B_TRUE 1 100 0.00 1.00000000000 BIT_MASK 0x1 FORMAT "%13.11" ECU_ADDRESS 0x600000E7 /end MEASUREMENT
/begin MEASUREMENT DDRC_St.DFC_AltIOACGFailr "Debouncing counters / Debounce Timer or Event counter for check DFC_AltIOACGFailr" ULONG DFC_OneToOne 1 100 0.00 536870911.000 BIT_MASK 0x1fffffff FORMAT "%13.3" ECU_ADDRESS 0x6000D168 /end MEASUREMENT
/begin MEASUREMENT DDRC_St.DFC_AltIOACGHiVltg "Debouncing counters / Debounce Timer or Event counter for check DFC_AltIOACGHiVltg" ULONG DFC_OneToOne 1 100 0.00 536870911.000 BIT_MASK 0x1fffffff FORMAT "%13.3" ECU_ADDRESS 0x6000D16C /end MEASUREMENT
/begin MEASUREMENT DDRC_St.DFC_AltIOACGLoVltg "Debouncing counters / Debounce Timer or Event counter for check DFC_AltIOACGLoVltg" ULONG DFC_OneToOne 1 100 0.00 536870911.000 BIT_MASK 0x1fffffff FORMAT "%13.3" ECU_ADDRESS 0x6000D170 /end MEASUREMENT
/begin MEASUREMENT DDRC_St.DFC_AltIOACGTHi "Debouncing counters / Debounce Timer or Event counter for check DFC_AltIOACGTHi" ULONG DFC_OneToOne 1 100 0.00 536870911.000 BIT_MASK 0x1fffffff FORMAT "%13.3" ECU_ADDRESS 0x6000D174 /end MEASUREMENT
/begin MEASUREMENT DDRC_St.DFC_AltIODConnACG "Debouncing counters / Debounce Timer or Event counter for check DFC_AltIODConnACG" ULONG DFC_OneToOne 1 100 0.00 536870911.000 BIT_MASK 0x1fffffff FORMAT "%13.3" ECU_ADDRESS 0x6000D178 /end MEASUREMENT
/begin MEASUREMENT DDRC_St.DFC_BattUHiFailr "Debouncing counters / Debounce Timer or Event counter for check DFC_BattUHiFailr" ULONG DFC_OneToOne 1 100 0.00 536870911.000 BIT_MASK 0x1fffffff FORMAT "%13.3" ECU_ADDRESS 0x6000D17C /end MEASUREMENT
/begin MEASUREMENT DDRC_St.DFC_BattULoFailr "Debouncing counters / Debounce Timer or Event counter for check DFC_BattULoFailr" ULONG DFC_OneToOne 1 100 0.00 536870911.000 BIT_MASK 0x1fffffff FORMAT "%13.3" ECU_ADDRESS 0x6000D180 /end MEASUREMENT
/begin MEASUREMENT DDRC_St.DFC_BrkBstPDriftHiErr "Debouncing counters / Debounce Timer or Event counter for check DFC_BrkBstPDriftHiErr" ULONG DFC_OneToOne 1 100 0.00 536870911.000 BIT_MASK 0x1fffffff FORMAT "%13.3" ECU_ADDRESS 0x6000D184 /end MEASUREMENT
/begin MEASUREMENT DDRC_St.DFC_BrkBstPDriftLoErr "Debouncing counters / Debounce Timer or Event counter for check DFC_BrkBstPDriftLoErr" ULONG DFC_OneToOne 1 100 0.00 536870911.000 BIT_MASK 0x1fffffff FORMAT "%13.3" ECU_ADDRESS 0x6000D188 /end MEASUREMENT
/begin MEASUREMENT DDRC_St.DFC_BrkBstPSnsrStuck "Debouncing counters / Debounce Timer or Event counter for check DFC_BrkBstPSnsrStuck" ULONG DFC_OneToOne 1 100 0.00 536870911.000 BIT_MASK 0x1fffffff FORMAT "%13.3" ECU_ADDRESS 0x6000D18C /end MEASUREMENT
/begin MEASUREMENT DDRC_St.DFC_BrkMnSwtContOn "Debouncing counters / Debounce Timer or Event counter for check DFC_BrkMnSwtContOn" ULONG DFC_OneToOne 1 100 0.00 536870911.000 BIT_MASK 0x1fffffff FORMAT "%13.3" ECU_ADDRESS 0x6000D190 /end MEASUREMENT
/begin MEASUREMENT DDRC_St.DFC_BrkMnSwtNotStp "Debouncing counters / Debounce Timer or Event counter for check DFC_BrkMnSwtNotStp" ULONG DFC_OneToOne 1 100 0.00 536870911.000 BIT_MASK 0x1fffffff FORMAT "%13.3" ECU_ADDRESS 0x6000D194 /end MEASUREMENT
/begin MEASUREMENT DDRC_St.DFC_BrkNpl "Debouncing counters / Debounce Timer or Event counter for check DFC_BrkNpl" ULONG DFC_OneToOne 1 100 0.00 536870911.000 BIT_MASK 0x1fffffff FORMAT "%13.3" ECU_ADDRESS 0x6000D198 /end MEASUREMENT
/begin MEASUREMENT DDRC_St.DFC_BrkRdntSwtContOn "Debouncing counters / Debounce Timer or Event counter for check DFC_BrkRdntSwtContOn" ULONG DFC_OneToOne 1 100 0.00 536870911.000 BIT_MASK 0x1fffffff FORMAT "%13.3" ECU_ADDRESS 0x6000D19C /end MEASUREMENT
/begin MEASUREMENT DDRC_St.DFC_BrkRdntSwtNotStp "Debouncing counters / Debounce Timer or Event counter for check DFC_BrkRdntSwtNotStp" ULONG DFC_OneToOne 1 100 0.00 536870911.000 BIT_MASK 0x1fffffff FORMAT "%13.3" ECU_ADDRESS 0x6000D1A0 /end MEASUREMENT
/begin MEASUREMENT DDRC_St.DFC_Clth3ONStuck "Debouncing counters / Debounce Timer or Event counter for check DFC_Clth3ONStuck" ULONG DFC_OneToOne 1 100 0.00 536870911.000 BIT_MASK 0x1fffffff FORMAT "%13.3" ECU_ADDRESS 0x6000D1A4 /end MEASUREMENT
/begin MEASUREMENT DDRC_St.DFC_Clth4OFFStuck "Debouncing counters / Debounce Timer or Event counter for check DFC_Clth4OFFStuck" ULONG DFC_OneToOne 1 100 0.00 536870911.000 BIT_MASK 0x1fffffff FORMAT "%13.3" ECU_ADDRESS 0x6000D1A8 /end MEASUREMENT
/begin MEASUREMENT DDRC_St.DFC_ClthOFFStuck "Debouncing counters / Debounce Timer or Event counter for check DFC_ClthOFFStuck" ULONG DFC_OneToOne 1 100 0.00 536870911.000 BIT_MASK 0x1fffffff FORMAT "%13.3" ECU_ADDRESS 0x6000D1AC /end MEASUREMENT
/begin MEASUREMENT DDRC_St.DFC_ClthONStuck "Debouncing counters / Debounce Timer or Event counter for check DFC_ClthONStuck" ULONG DFC_OneToOne 1 100 0.00 536870911.000 BIT_MASK 0x1fffffff FORMAT "%13.3" ECU_ADDRESS 0x6000D1B0 /end MEASUREMENT
/begin MEASUREMENT DDRC_St.DFC_ClthStkFailInfo "Debouncing counters / Debounce Timer or Event counter for check DFC_ClthStkFailInfo" ULONG DFC_OneToOne 1 100 0.00 536870911.000 BIT_MASK 0x1fffffff FORMAT "%13.3" ECU_ADDRESS 0x6000D1B4 /end MEASUREMENT
/begin MEASUREMENT DDRC_St.DFC_ComACFailInfo "Debouncing counters / Debounce Timer or Event counter for check DFC_ComACFailInfo" ULONG DFC_OneToOne 1 100 0.00 536870911.000 BIT_MASK 0x1fffffff FORMAT "%13.3" ECU_ADDRESS 0x6000D1B8 /end MEASUREMENT
/begin MEASUREMENT DDRC_St.DFC_ComATFTValErr "Debouncing counters / Debounce Timer or Event counter for check DFC_ComATFTValErr" ULONG DFC_OneToOne 1 100 0.00 536870911.000 BIT_MASK 0x1fffffff FORMAT "%13.3" ECU_ADDRESS 0x6000D1BC /end MEASUREMENT
/begin MEASUREMENT DDRC_St.DFC_ComATMILReq "Debouncing counters / Debounce Timer or Event counter for check DFC_ComATMILReq" ULONG DFC_OneToOne 1 100 0.00 536870911.000 BIT_MASK 0x1fffffff FORMAT "%13.3" ECU_ADDRESS 0x6000D1C0 /end MEASUREMENT
/begin MEASUREMENT DDRC_St.DFC_ComAYCAChksum "Debouncing counters / Debounce Timer or Event counter for check DFC_ComAYCAChksum" ULONG DFC_OneToOne 1 100 0.00 536870911.000 BIT_MASK 0x1fffffff FORMAT "%13.3" ECU_ADDRESS 0x6000D1C4 /end MEASUREMENT
/begin MEASUREMENT DDRC_St.DFC_ComAYCARingCnt "Debouncing counters / Debounce Timer or Event counter for check DFC_ComAYCARingCnt" ULONG DFC_OneToOne 1 100 0.00 536870911.000 BIT_MASK 0x1fffffff FORMAT "%13.3" ECU_ADDRESS 0x6000D1C8 /end MEASUREMENT
/begin MEASUREMENT DDRC_St.DFC_ComAYCATOut "Debouncing counters / Debounce Timer or Event counter for check DFC_ComAYCATOut" ULONG DFC_OneToOne 1 100 0.00 536870911.000 BIT_MASK 0x1fffffff FORMAT "%13.3" ECU_ADDRESS 0x6000D1CC /end MEASUREMENT
/begin MEASUREMENT DDRC_St.DFC_ComAYCDChkSum "Debouncing counters / Debounce Timer or Event counter for check DFC_ComAYCDChkSum" ULONG DFC_OneToOne 1 100 0.00 536870911.000 BIT_MASK 0x1fffffff FORMAT "%13.3" ECU_ADDRESS 0x6000D1D0 /end MEASUREMENT
/begin MEASUREMENT DDRC_St.DFC_ComAYCDTOut "Debouncing counters / Debounce Timer or Event counter for check DFC_ComAYCDTOut" ULONG DFC_OneToOne 1 100 0.00 536870911.000 BIT_MASK 0x1fffffff FORMAT "%13.3" ECU_ADDRESS 0x6000D1D4 /end MEASUREMENT
/begin MEASUREMENT DDRC_St.DFC_ComAYCFChksum "Debouncing counters / Debounce Timer or Event counter for check DFC_ComAYCFChksum" ULONG DFC_OneToOne 1 100 0.00 536870911.000 BIT_MASK 0x1fffffff FORMAT "%13.3" ECU_ADDRESS 0x6000D1D8 /end MEASUREMENT
/begin MEASUREMENT DDRC_St.DFC_ComAYCFRingCnt "Debouncing counters / Debounce Timer or Event counter for check DFC_ComAYCFRingCnt" ULONG DFC_OneToOne 1 100 0.00 536870911.000 BIT_MASK 0x1fffffff FORMAT "%13.3" ECU_ADDRESS 0x6000D1DC /end MEASUREMENT
/begin MEASUREMENT DDRC_St.DFC_ComAYCFTOut "Debouncing counters / Debounce Timer or Event counter for check DFC_ComAYCFTOut" ULONG DFC_OneToOne 1 100 0.00 536870911.000 BIT_MASK 0x1fffffff FORMAT "%13.3" ECU_ADDRESS 0x6000D1E0 /end MEASUREMENT
/begin MEASUREMENT DDRC_St.DFC_ComAYCGChksum "Debouncing counters / Debounce Timer or Event counter for check DFC_ComAYCGChksum" ULONG DFC_OneToOne 1 100 0.00 536870911.000 BIT_MASK 0x1fffffff FORMAT "%13.3" ECU_ADDRESS 0x6000D1E4 /end MEASUREMENT
/begin MEASUREMENT DDRC_St.DFC_ComAYCGRingCnt "Debouncing counters / Debounce Timer or Event counter for check DFC_ComAYCGRingCnt" ULONG DFC_OneToOne 1 100 0.00 536870911.000 BIT_MASK 0x1fffffff FORMAT "%13.3" ECU_ADDRESS 0x6000D1E8 /end MEASUREMENT
/begin MEASUREMENT DDRC_St.DFC_ComAYCGTOut "Debouncing counters / Debounce Timer or Event counter for check DFC_ComAYCGTOut" ULONG DFC_OneToOne 1 100 0.00 536870911.000 BIT_MASK 0x1fffffff FORMAT "%13.3" ECU_ADDRESS 0x6000D1EC /end MEASUREMENT
/begin MEASUREMENT DDRC_St.DFC_ComAYCIChkSum "Debouncing counters / Debounce Timer or Event counter for check DFC_ComAYCIChkSum" ULONG DFC_OneToOne 1 100 0.00 536870911.000 BIT_MASK 0x1fffffff FORMAT "%13.3" ECU_ADDRESS 0x6000D1F0 /end MEASUREMENT
/begin MEASUREMENT DDRC_St.DFC_ComAYCIRingCnt "Debouncing counters / Debounce Timer or Event counter for check DFC_ComAYCIRingCnt" ULONG DFC_OneToOne 1 100 0.00 536870911.000 BIT_MASK 0x1fffffff FORMAT "%13.3" ECU_ADDRESS 0x6000D1F4 /end MEASUREMENT
/begin MEASUREMENT DDRC_St.DFC_ComAYCITOut "Debouncing counters / Debounce Timer or Event counter for check DFC_ComAYCITOut" ULONG DFC_OneToOne 1 100 0.00 536870911.000 BIT_MASK 0x1fffffff FORMAT "%13.3" ECU_ADDRESS 0x6000D1F8 /end MEASUREMENT
/begin MEASUREMENT DDRC_St.DFC_ComBCM1ChkSum "Debouncing counters / Debounce Timer or Event counter for check DFC_ComBCM1ChkSum" ULONG DFC_OneToOne 1 100 0.00 536870911.000 BIT_MASK 0x1fffffff FORMAT "%13.3" ECU_ADDRESS 0x6000D1FC /end MEASUREMENT
/begin MEASUREMENT DDRC_St.DFC_ComBCM1RingCnt "Debouncing counters / Debounce Timer or Event counter for check DFC_ComBCM1RingCnt" ULONG DFC_OneToOne 1 100 0.00 536870911.000 BIT_MASK 0x1fffffff FORMAT "%13.3" ECU_ADDRESS 0x6000D200 /end MEASUREMENT
/begin MEASUREMENT DDRC_St.DFC_ComBCM1TOut "Debouncing counters / Debounce Timer or Event counter for check DFC_ComBCM1TOut" ULONG DFC_OneToOne 1 100 0.00 536870911.000 BIT_MASK 0x1fffffff FORMAT "%13.3" ECU_ADDRESS 0x6000D204 /end MEASUREMENT
/begin MEASUREMENT DDRC_St.DFC_ComCANABusOffErr "Debouncing counters / Debounce Timer or Event counter for check DFC_ComCANABusOffErr" ULONG DFC_OneToOne 1 100 0.00 536870911.000 BIT_MASK 0x1fffffff FORMAT "%13.3" ECU_ADDRESS 0x6000D208 /end MEASUREMENT
/begin MEASUREMENT DDRC_St.DFC_ComCANBBusOffErr "Debouncing counters / Debounce Timer or Event counter for check DFC_ComCANBBusOffErr" ULONG DFC_OneToOne 1 100 0.00 536870911.000 BIT_MASK 0x1fffffff FORMAT "%13.3" ECU_ADDRESS 0x6000D20C /end MEASUREMENT
/begin MEASUREMENT DDRC_St.DFC_ComCANCBusOffErr "Debouncing counters / Debounce Timer or Event counter for check DFC_ComCANCBusOffErr" ULONG DFC_OneToOne 1 100 0.00 536870911.000 BIT_MASK 0x1fffffff FORMAT "%13.3" ECU_ADDRESS 0x6000D210 /end MEASUREMENT
/begin MEASUREMENT DDRC_St.DFC_ComCGW1ChkSum "Debouncing counters / Debounce Timer or Event counter for check DFC_ComCGW1ChkSum" ULONG DFC_OneToOne 1 100 0.00 536870911.000 BIT_MASK 0x1fffffff FORMAT "%13.3" ECU_ADDRESS 0x6000D214 /end MEASUREMENT
/begin MEASUREMENT DDRC_St.DFC_ComCGW1RingCnt "Debouncing counters / Debounce Timer or Event counter for check DFC_ComCGW1RingCnt" ULONG DFC_OneToOne 1 100 0.00 536870911.000 BIT_MASK 0x1fffffff FORMAT "%13.3" ECU_ADDRESS 0x6000D218 /end MEASUREMENT
/begin MEASUREMENT DDRC_St.DFC_ComCGW1TOut "Debouncing counters / Debounce Timer or Event counter for check DFC_ComCGW1TOut" ULONG DFC_OneToOne 1 100 0.00 536870911.000 BIT_MASK 0x1fffffff FORMAT "%13.3" ECU_ADDRESS 0x6000D21C /end MEASUREMENT
/begin MEASUREMENT DDRC_St.DFC_ComConvBoostErr "Debouncing counters / Debounce Timer or Event counter for check DFC_ComConvBoostErr" ULONG DFC_OneToOne 1 100 0.00 536870911.000 BIT_MASK 0x1fffffff FORMAT "%13.3" ECU_ADDRESS 0x6000D220 /end MEASUREMENT
/begin MEASUREMENT DDRC_St.DFC_ComConvSlipErr "Debouncing counters / Debounce Timer or Event counter for check DFC_ComConvSlipErr" ULONG DFC_OneToOne 1 100 0.00 536870911.000 BIT_MASK 0x1fffffff FORMAT "%13.3" ECU_ADDRESS 0x6000D224 /end MEASUREMENT
/begin MEASUREMENT DDRC_St.DFC_ComEAT10Chksum "Debouncing counters / Debounce Timer or Event counter for check DFC_ComEAT10Chksum" ULONG DFC_OneToOne 1 100 0.00 536870911.000 BIT_MASK 0x1fffffff FORMAT "%13.3" ECU_ADDRESS 0x6000D228 /end MEASUREMENT
/begin MEASUREMENT DDRC_St.DFC_ComEAT10RingCnt "Debouncing counters / Debounce Timer or Event counter for check DFC_ComEAT10RingCnt" ULONG DFC_OneToOne 1 100 0.00 536870911.000 BIT_MASK 0x1fffffff FORMAT "%13.3" ECU_ADDRESS 0x6000D22C /end MEASUREMENT
/begin MEASUREMENT DDRC_St.DFC_ComEAT10TOut "Debouncing counters / Debounce Timer or Event counter for check DFC_ComEAT10TOut" ULONG DFC_OneToOne 1 100 0.00 536870911.000 BIT_MASK 0x1fffffff FORMAT "%13.3" ECU_ADDRESS 0x6000D230 /end MEASUREMENT
/begin MEASUREMENT DDRC_St.DFC_ComEAT11ChkSum "Debouncing counters / Debounce Timer or Event counter for check DFC_ComEAT11ChkSum" ULONG DFC_OneToOne 1 100 0.00 536870911.000 BIT_MASK 0x1fffffff FORMAT "%13.3" ECU_ADDRESS 0x6000D234 /end MEASUREMENT
/begin MEASUREMENT DDRC_St.DFC_ComEAT11RingCnt "Debouncing counters / Debounce Timer or Event counter for check DFC_ComEAT11RingCnt" ULONG DFC_OneToOne 1 100 0.00 536870911.000 BIT_MASK 0x1fffffff FORMAT "%13.3" ECU_ADDRESS 0x6000D238 /end MEASUREMENT
/begin MEASUREMENT DDRC_St.DFC_ComEAT11TOut "Debouncing counters / Debounce Timer or Event counter for check DFC_ComEAT11TOut" ULONG DFC_OneToOne 1 100 0.00 536870911.000 BIT_MASK 0x1fffffff FORMAT "%13.3" ECU_ADDRESS 0x6000D23C /end MEASUREMENT
/begin MEASUREMENT DDRC_St.DFC_ComEAT12ChkSum "Debouncing counters / Debounce Timer or Event counter for check DFC_ComEAT12ChkSum" ULONG DFC_OneToOne 1 100 0.00 536870911.000 BIT_MASK 0x1fffffff FORMAT "%13.3" ECU_ADDRESS 0x6000D240 /end MEASUREMENT
/begin MEASUREMENT DDRC_St.DFC_ComEAT12RingCnt "Debouncing counters / Debounce Timer or Event counter for check DFC_ComEAT12RingCnt" ULONG DFC_OneToOne 1 100 0.00 536870911.000 BIT_MASK 0x1fffffff FORMAT "%13.3" ECU_ADDRESS 0x6000D244 /end MEASUREMENT
/begin MEASUREMENT DDRC_St.DFC_ComEAT12TOut "Debouncing counters / Debounce Timer or Event counter for check DFC_ComEAT12TOut" ULONG DFC_OneToOne 1 100 0.00 536870911.000 BIT_MASK 0x1fffffff FORMAT "%13.3" ECU_ADDRESS 0x6000D248 /end MEASUREMENT
/begin MEASUREMENT DDRC_St.DFC_ComEAT13ChkSum "Debouncing counters / Debounce Timer or Event counter for check DFC_ComEAT13ChkSum" ULONG DFC_OneToOne 1 100 0.00 536870911.000 BIT_MASK 0x1fffffff FORMAT "%13.3" ECU_ADDRESS 0x6000D24C /end MEASUREMENT
/begin MEASUREMENT DDRC_St.DFC_ComEAT13RingCnt "Debouncing counters / Debounce Timer or Event counter for check DFC_ComEAT13RingCnt" ULONG DFC_OneToOne 1 100 0.00 536870911.000 BIT_MASK 0x1fffffff FORMAT "%13.3" ECU_ADDRESS 0x6000D250 /end MEASUREMENT
/begin MEASUREMENT DDRC_St.DFC_ComEAT13TOut "Debouncing counters / Debounce Timer or Event counter for check DFC_ComEAT13TOut" ULONG DFC_OneToOne 1 100 0.00 536870911.000 BIT_MASK 0x1fffffff FORMAT "%13.3" ECU_ADDRESS 0x6000D254 /end MEASUREMENT
/begin MEASUREMENT DDRC_St.DFC_ComEAT1Chksum "Debouncing counters / Debounce Timer or Event counter for check DFC_ComEAT1Chksum" ULONG DFC_OneToOne 1 100 0.00 536870911.000 BIT_MASK 0x1fffffff FORMAT "%13.3" ECU_ADDRESS 0x6000D258 /end MEASUREMENT
/begin MEASUREMENT DDRC_St.DFC_ComEAT1RingCnt "Debouncing counters / Debounce Timer or Event counter for check DFC_ComEAT1RingCnt" ULONG DFC_OneToOne 1 100 0.00 536870911.000 BIT_MASK 0x1fffffff FORMAT "%13.3" ECU_ADDRESS 0x6000D25C /end MEASUREMENT
/begin MEASUREMENT DDRC_St.DFC_ComEAT1TOut "Debouncing counters / Debounce Timer or Event counter for check DFC_ComEAT1TOut" ULONG DFC_OneToOne 1 100 0.00 536870911.000 BIT_MASK 0x1fffffff FORMAT "%13.3" ECU_ADDRESS 0x6000D260 /end MEASUREMENT
/begin MEASUREMENT DDRC_St.DFC_ComEAT2ChkSum "Debouncing counters / Debounce Timer or Event counter for check DFC_ComEAT2ChkSum" ULONG DFC_OneToOne 1 100 0.00 536870911.000 BIT_MASK 0x1fffffff FORMAT "%13.3" ECU_ADDRESS 0x6000D264 /end MEASUREMENT
/begin MEASUREMENT DDRC_St.DFC_ComEAT2RingCnt "Debouncing counters / Debounce Timer or Event counter for check DFC_ComEAT2RingCnt" ULONG DFC_OneToOne 1 100 0.00 536870911.000 BIT_MASK 0x1fffffff FORMAT "%13.3" ECU_ADDRESS 0x6000D268 /end MEASUREMENT
/begin MEASUREMENT DDRC_St.DFC_ComEAT2TOut "Debouncing counters / Debounce Timer or Event counter for check DFC_ComEAT2TOut" ULONG DFC_OneToOne 1 100 0.00 536870911.000 BIT_MASK 0x1fffffff FORMAT "%13.3" ECU_ADDRESS 0x6000D26C /end MEASUREMENT
/begin MEASUREMENT DDRC_St.DFC_ComEAT4ChkSum "Debouncing counters / Debounce Timer or Event counter for check DFC_ComEAT4ChkSum" ULONG DFC_OneToOne 1 100 0.00 536870911.000 BIT_MASK 0x1fffffff FORMAT "%13.3" ECU_ADDRESS 0x6000D270 /end MEASUREMENT
/begin MEASUREMENT DDRC_St.DFC_ComEAT4RingCnt "Debouncing counters / Debounce Timer or Event counter for check DFC_ComEAT4RingCnt" ULONG DFC_OneToOne 1 100 0.00 536870911.000 BIT_MASK 0x1fffffff FORMAT "%13.3" ECU_ADDRESS 0x6000D274 /end MEASUREMENT
/begin MEASUREMENT DDRC_St.DFC_ComEAT4TOut "Debouncing counters / Debounce Timer or Event counter for check DFC_ComEAT4TOut" ULONG DFC_OneToOne 1 100 0.00 536870911.000 BIT_MASK 0x1fffffff FORMAT "%13.3" ECU_ADDRESS 0x6000D278 /end MEASUREMENT
/begin MEASUREMENT DDRC_St.DFC_ComEAT6Chksum "Debouncing counters / Debounce Timer or Event counter for check DFC_ComEAT6Chksum" ULONG DFC_OneToOne 1 100 0.00 536870911.000 BIT_MASK 0x1fffffff FORMAT "%13.3" ECU_ADDRESS 0x6000D27C /end MEASUREMENT
/begin MEASUREMENT DDRC_St.DFC_ComEAT6RingCnt "Debouncing counters / Debounce Timer or Event counter for check DFC_ComEAT6RingCnt" ULONG DFC_OneToOne 1 100 0.00 536870911.000 BIT_MASK 0x1fffffff FORMAT "%13.3" ECU_ADDRESS 0x6000D280 /end MEASUREMENT
/begin MEASUREMENT DDRC_St.DFC_ComEAT6TOut "Debouncing counters / Debounce Timer or Event counter for check DFC_ComEAT6TOut" ULONG DFC_OneToOne 1 100 0.00 536870911.000 BIT_MASK 0x1fffffff FORMAT "%13.3" ECU_ADDRESS 0x6000D284 /end MEASUREMENT
/begin MEASUREMENT DDRC_St.DFC_ComEAT7Chksum "Debouncing counters / Debounce Timer or Event counter for check DFC_ComEAT7Chksum" ULONG DFC_OneToOne 1 100 0.00 536870911.000 BIT_MASK 0x1fffffff FORMAT "%13.3" ECU_ADDRESS 0x6000D288 /end MEASUREMENT
/begin MEASUREMENT DDRC_St.DFC_ComEAT7RingCnt "Debouncing counters / Debounce Timer or Event counter for check DFC_ComEAT7RingCnt" ULONG DFC_OneToOne 1 100 0.00 536870911.000 BIT_MASK 0x1fffffff FORMAT "%13.3" ECU_ADDRESS 0x6000D28C /end MEASUREMENT
/begin MEASUREMENT DDRC_St.DFC_ComEAT7TOut "Debouncing counters / Debounce Timer or Event counter for check DFC_ComEAT7TOut" ULONG DFC_OneToOne 1 100 0.00 536870911.000 BIT_MASK 0x1fffffff FORMAT "%13.3" ECU_ADDRESS 0x6000D290 /end MEASUREMENT
/begin MEASUREMENT DDRC_St.DFC_ComEAT8Chksum "Debouncing counters / Debounce Timer or Event counter for check DFC_ComEAT8Chksum" ULONG DFC_OneToOne 1 100 0.00 536870911.000 BIT_MASK 0x1fffffff FORMAT "%13.3" ECU_ADDRESS 0x6000D294 /end MEASUREMENT
/begin MEASUREMENT DDRC_St.DFC_ComEAT8RingCnt "Debouncing counters / Debounce Timer or Event counter for check DFC_ComEAT8RingCnt" ULONG DFC_OneToOne 1 100 0.00 536870911.000 BIT_MASK 0x1fffffff FORMAT "%13.3" ECU_ADDRESS 0x6000D298 /end MEASUREMENT
/begin MEASUREMENT DDRC_St.DFC_ComEAT8TOut "Debouncing counters / Debounce Timer or Event counter for check DFC_ComEAT8TOut" ULONG DFC_OneToOne 1 100 0.00 536870911.000 BIT_MASK 0x1fffffff FORMAT "%13.3" ECU_ADDRESS 0x6000D29C /end MEASUREMENT
/begin MEASUREMENT DDRC_St.DFC_ComEATAChksum "Debouncing counters / Debounce Timer or Event counter for check DFC_ComEATAChksum" ULONG DFC_OneToOne 1 100 0.00 536870911.000 BIT_MASK 0x1fffffff FORMAT "%13.3" ECU_ADDRESS 0x6000D2A0 /end MEASUREMENT
/begin MEASUREMENT DDRC_St.DFC_ComEATARingCnt "Debouncing counters / Debounce Timer or Event counter for check DFC_ComEATARingCnt" ULONG DFC_OneToOne 1 100 0.00 536870911.000 BIT_MASK 0x1fffffff FORMAT "%13.3" ECU_ADDRESS 0x6000D2A4 /end MEASUREMENT
/begin MEASUREMENT DDRC_St.DFC_ComEATATOut "Debouncing counters / Debounce Timer or Event counter for check DFC_ComEATATOut" ULONG DFC_OneToOne 1 100 0.00 536870911.000 BIT_MASK 0x1fffffff FORMAT "%13.3" ECU_ADDRESS 0x6000D2A8 /end MEASUREMENT
/begin MEASUREMENT DDRC_St.DFC_ComEATBChkSum "Debouncing counters / Debounce Timer or Event counter for check DFC_ComEATBChkSum" ULONG DFC_OneToOne 1 100 0.00 536870911.000 BIT_MASK 0x1fffffff FORMAT "%13.3" ECU_ADDRESS 0x6000D2AC /end MEASUREMENT
/begin MEASUREMENT DDRC_St.DFC_ComEATBRingCnt "Debouncing counters / Debounce Timer or Event counter for check DFC_ComEATBRingCnt" ULONG DFC_OneToOne 1 100 0.00 536870911.000 BIT_MASK 0x1fffffff FORMAT "%13.3" ECU_ADDRESS 0x6000D2B0 /end MEASUREMENT
/begin MEASUREMENT DDRC_St.DFC_ComEATBTOut "Debouncing counters / Debounce Timer or Event counter for check DFC_ComEATBTOut" ULONG DFC_OneToOne 1 100 0.00 536870911.000 BIT_MASK 0x1fffffff FORMAT "%13.3" ECU_ADDRESS 0x6000D2B4 /end MEASUREMENT
/begin MEASUREMENT DDRC_St.DFC_ComEATCChksum "Debouncing counters / Debounce Timer or Event counter for check DFC_ComEATCChksum" ULONG DFC_OneToOne 1 100 0.00 536870911.000 BIT_MASK 0x1fffffff FORMAT "%13.3" ECU_ADDRESS 0x6000D2B8 /end MEASUREMENT
/begin MEASUREMENT DDRC_St.DFC_ComEATCRingCnt "Debouncing counters / Debounce Timer or Event counter for check DFC_ComEATCRingCnt" ULONG DFC_OneToOne 1 100 0.00 536870911.000 BIT_MASK 0x1fffffff FORMAT "%13.3" ECU_ADDRESS 0x6000D2BC /end MEASUREMENT
/begin MEASUREMENT DDRC_St.DFC_ComEATCTOut "Debouncing counters / Debounce Timer or Event counter for check DFC_ComEATCTOut" ULONG DFC_OneToOne 1 100 0.00 536870911.000 BIT_MASK 0x1fffffff FORMAT "%13.3" ECU_ADDRESS 0x6000D2C0 /end MEASUREMENT
/begin MEASUREMENT DDRC_St.DFC_ComEBBAChksum "Debouncing counters / Debounce Timer or Event counter for check DFC_ComEBBAChksum" ULONG DFC_OneToOne 1 100 0.00 536870911.000 BIT_MASK 0x1fffffff FORMAT "%13.3" ECU_ADDRESS 0x6000D2C4 /end MEASUREMENT
/begin MEASUREMENT DDRC_St.DFC_ComEBBARingCnt "Debouncing counters / Debounce Timer or Event counter for check DFC_ComEBBARingCnt" ULONG DFC_OneToOne 1 100 0.00 536870911.000 BIT_MASK 0x1fffffff FORMAT "%13.3" ECU_ADDRESS 0x6000D2C8 /end MEASUREMENT
/begin MEASUREMENT DDRC_St.DFC_ComEBBATOut "Debouncing counters / Debounce Timer or Event counter for check DFC_ComEBBATOut" ULONG DFC_OneToOne 1 100 0.00 536870911.000 BIT_MASK 0x1fffffff FORMAT "%13.3" ECU_ADDRESS 0x6000D2CC /end MEASUREMENT
/begin MEASUREMENT DDRC_St.DFC_ComEPS1Chksum "Debouncing counters / Debounce Timer or Event counter for check DFC_ComEPS1Chksum" ULONG DFC_OneToOne 1 100 0.00 536870911.000 BIT_MASK 0x1fffffff FORMAT "%13.3" ECU_ADDRESS 0x6000D2D0 /end MEASUREMENT
/begin MEASUREMENT DDRC_St.DFC_ComEPS1RingCnt "Debouncing counters / Debounce Timer or Event counter for check DFC_ComEPS1RingCnt" ULONG DFC_OneToOne 1 100 0.00 536870911.000 BIT_MASK 0x1fffffff FORMAT "%13.3" ECU_ADDRESS 0x6000D2D4 /end MEASUREMENT
/begin MEASUREMENT DDRC_St.DFC_ComEPS1TOut "Debouncing counters / Debounce Timer or Event counter for check DFC_ComEPS1TOut" ULONG DFC_OneToOne 1 100 0.00 536870911.000 BIT_MASK 0x1fffffff FORMAT "%13.3" ECU_ADDRESS 0x6000D2D8 /end MEASUREMENT
/begin MEASUREMENT DDRC_St.DFC_ComEngCanRxErr "Debouncing counters / Debounce Timer or Event counter for check DFC_ComEngCanRxErr" ULONG DFC_OneToOne 1 100 0.00 536870911.000 BIT_MASK 0x1fffffff FORMAT "%13.3" ECU_ADDRESS 0x6000D2DC /end MEASUREMENT
/begin MEASUREMENT DDRC_St.DFC_ComGrvySnsrErr "Debouncing counters / Debounce Timer or Event counter for check DFC_ComGrvySnsrErr" ULONG DFC_OneToOne 1 100 0.00 536870911.000 BIT_MASK 0x1fffffff FORMAT "%13.3" ECU_ADDRESS 0x6000D2E0 /end MEASUREMENT
/begin MEASUREMENT DDRC_St.DFC_ComGwIMG1ChkSum "Debouncing counters / Debounce Timer or Event counter for check DFC_ComGwIMG1ChkSum" ULONG DFC_OneToOne 1 100 0.00 536870911.000 BIT_MASK 0x1fffffff FORMAT "%13.3" ECU_ADDRESS 0x6000D2E4 /end MEASUREMENT
/begin MEASUREMENT DDRC_St.DFC_ComGwIMG1RingCnt "Debouncing counters / Debounce Timer or Event counter for check DFC_ComGwIMG1RingCnt" ULONG DFC_OneToOne 1 100 0.00 536870911.000 BIT_MASK 0x1fffffff FORMAT "%13.3" ECU_ADDRESS 0x6000D2E8 /end MEASUREMENT
/begin MEASUREMENT DDRC_St.DFC_ComGwIMG1TOut "Debouncing counters / Debounce Timer or Event counter for check DFC_ComGwIMG1TOut" ULONG DFC_OneToOne 1 100 0.00 536870911.000 BIT_MASK 0x1fffffff FORMAT "%13.3" ECU_ADDRESS 0x6000D2EC /end MEASUREMENT
/begin MEASUREMENT DDRC_St.DFC_ComGwIMG3ChkSum "Debouncing counters / Debounce Timer or Event counter for check DFC_ComGwIMG3ChkSum" ULONG DFC_OneToOne 1 100 0.00 536870911.000 BIT_MASK 0x1fffffff FORMAT "%13.3" ECU_ADDRESS 0x6000D2F0 /end MEASUREMENT
/begin MEASUREMENT DDRC_St.DFC_ComGwIMG3RingCnt "Debouncing counters / Debounce Timer or Event counter for check DFC_ComGwIMG3RingCnt" ULONG DFC_OneToOne 1 100 0.00 536870911.000 BIT_MASK 0x1fffffff FORMAT "%13.3" ECU_ADDRESS 0x6000D2F4 /end MEASUREMENT
/begin MEASUREMENT DDRC_St.DFC_ComGwIMG3TOut "Debouncing counters / Debounce Timer or Event counter for check DFC_ComGwIMG3TOut" ULONG DFC_OneToOne 1 100 0.00 536870911.000 BIT_MASK 0x1fffffff FORMAT "%13.3" ECU_ADDRESS 0x6000D2F8 /end MEASUREMENT
/begin MEASUREMENT DDRC_St.DFC_ComGwIMG4ChkSum "Debouncing counters / Debounce Timer or Event counter for check DFC_ComGwIMG4ChkSum" ULONG DFC_OneToOne 1 100 0.00 536870911.000 BIT_MASK 0x1fffffff FORMAT "%13.3" ECU_ADDRESS 0x6000D2FC /end MEASUREMENT
/begin MEASUREMENT DDRC_St.DFC_ComGwIMG4RingCnt "Debouncing counters / Debounce Timer or Event counter for check DFC_ComGwIMG4RingCnt" ULONG DFC_OneToOne 1 100 0.00 536870911.000 BIT_MASK 0x1fffffff FORMAT "%13.3" ECU_ADDRESS 0x6000D300 /end MEASUREMENT
/begin MEASUREMENT DDRC_St.DFC_ComGwIMG4TOut "Debouncing counters / Debounce Timer or Event counter for check DFC_ComGwIMG4TOut" ULONG DFC_OneToOne 1 100 0.00 536870911.000 BIT_MASK 0x1fffffff FORMAT "%13.3" ECU_ADDRESS 0x6000D304 /end MEASUREMENT
/begin MEASUREMENT DDRC_St.DFC_ComGwIMG5ChkSum "Debouncing counters / Debounce Timer or Event counter for check DFC_ComGwIMG5ChkSum" ULONG DFC_OneToOne 1 100 0.00 536870911.000 BIT_MASK 0x1fffffff FORMAT "%13.3" ECU_ADDRESS 0x6000D308 /end MEASUREMENT
/begin MEASUREMENT DDRC_St.DFC_ComGwIMG5RingCnt "Debouncing counters / Debounce Timer or Event counter for check DFC_ComGwIMG5RingCnt" ULONG DFC_OneToOne 1 100 0.00 536870911.000 BIT_MASK 0x1fffffff FORMAT "%13.3" ECU_ADDRESS 0x6000D30C /end MEASUREMENT
/begin MEASUREMENT DDRC_St.DFC_ComGwIMG5TOut "Debouncing counters / Debounce Timer or Event counter for check DFC_ComGwIMG5TOut" ULONG DFC_OneToOne 1 100 0.00 536870911.000 BIT_MASK 0x1fffffff FORMAT "%13.3" ECU_ADDRESS 0x6000D310 /end MEASUREMENT
/begin MEASUREMENT DDRC_St.DFC_ComGwIMG6ChkSum "Debouncing counters / Debounce Timer or Event counter for check DFC_ComGwIMG6ChkSum" ULONG DFC_OneToOne 1 100 0.00 536870911.000 BIT_MASK 0x1fffffff FORMAT "%13.3" ECU_ADDRESS 0x6000D314 /end MEASUREMENT
/begin MEASUREMENT DDRC_St.DFC_ComGwIMG6RingCnt "Debouncing counters / Debounce Timer or Event counter for check DFC_ComGwIMG6RingCnt" ULONG DFC_OneToOne 1 100 0.00 536870911.000 BIT_MASK 0x1fffffff FORMAT "%13.3" ECU_ADDRESS 0x6000D318 /end MEASUREMENT
/begin MEASUREMENT DDRC_St.DFC_ComGwIMG6TOut "Debouncing counters / Debounce Timer or Event counter for check DFC_ComGwIMG6TOut" ULONG DFC_OneToOne 1 100 0.00 536870911.000 BIT_MASK 0x1fffffff FORMAT "%13.3" ECU_ADDRESS 0x6000D31C /end MEASUREMENT
/begin MEASUREMENT DDRC_St.DFC_ComIDASBChksum "Debouncing counters / Debounce Timer or Event counter for check DFC_ComIDASBChksum" ULONG DFC_OneToOne 1 100 0.00 536870911.000 BIT_MASK 0x1fffffff FORMAT "%13.3" ECU_ADDRESS 0x6000D320 /end MEASUREMENT
/begin MEASUREMENT DDRC_St.DFC_ComIDASBRingCnt "Debouncing counters / Debounce Timer or Event counter for check DFC_ComIDASBRingCnt" ULONG DFC_OneToOne 1 100 0.00 536870911.000 BIT_MASK 0x1fffffff FORMAT "%13.3" ECU_ADDRESS 0x6000D324 /end MEASUREMENT
/begin MEASUREMENT DDRC_St.DFC_ComIDASBTOut "Debouncing counters / Debounce Timer or Event counter for check DFC_ComIDASBTOut" ULONG DFC_OneToOne 1 100 0.00 536870911.000 BIT_MASK 0x1fffffff FORMAT "%13.3" ECU_ADDRESS 0x6000D328 /end MEASUREMENT
/begin MEASUREMENT DDRC_St.DFC_ComIMGMILReq "Debouncing counters / Debounce Timer or Event counter for check DFC_ComIMGMILReq" ULONG DFC_OneToOne 1 100 0.00 536870911.000 BIT_MASK 0x1fffffff FORMAT "%13.3" ECU_ADDRESS 0x6000D32C /end MEASUREMENT
/begin MEASUREMENT DDRC_St.DFC_ComISSPrms "Debouncing counters / Debounce Timer or Event counter for check DFC_ComISSPrms" ULONG DFC_OneToOne 1 100 0.00 536870911.000 BIT_MASK 0x1fffffff FORMAT "%13.3" ECU_ADDRESS 0x6000D330 /end MEASUREMENT
/begin MEASUREMENT DDRC_St.DFC_ComMETAChksum "Debouncing counters / Debounce Timer or Event counter for check DFC_ComMETAChksum" ULONG DFC_OneToOne 1 100 0.00 536870911.000 BIT_MASK 0x1fffffff FORMAT "%13.3" ECU_ADDRESS 0x6000D334 /end MEASUREMENT
/begin MEASUREMENT DDRC_St.DFC_ComMETARingCnt "Debouncing counters / Debounce Timer or Event counter for check DFC_ComMETARingCnt" ULONG DFC_OneToOne 1 100 0.00 536870911.000 BIT_MASK 0x1fffffff FORMAT "%13.3" ECU_ADDRESS 0x6000D338 /end MEASUREMENT
/begin MEASUREMENT DDRC_St.DFC_ComMETATOut "Debouncing counters / Debounce Timer or Event counter for check DFC_ComMETATOut" ULONG DFC_OneToOne 1 100 0.00 536870911.000 BIT_MASK 0x1fffffff FORMAT "%13.3" ECU_ADDRESS 0x6000D33C /end MEASUREMENT
/begin MEASUREMENT DDRC_St.DFC_ComMETCChksum "Debouncing counters / Debounce Timer or Event counter for check DFC_ComMETCChksum" ULONG DFC_OneToOne 1 100 0.00 536870911.000 BIT_MASK 0x1fffffff FORMAT "%13.3" ECU_ADDRESS 0x6000D340 /end MEASUREMENT
/begin MEASUREMENT DDRC_St.DFC_ComMETCRingCnt "Debouncing counters / Debounce Timer or Event counter for check DFC_ComMETCRingCnt" ULONG DFC_OneToOne 1 100 0.00 536870911.000 BIT_MASK 0x1fffffff FORMAT "%13.3" ECU_ADDRESS 0x6000D344 /end MEASUREMENT
/begin MEASUREMENT DDRC_St.DFC_ComMETCTOut "Debouncing counters / Debounce Timer or Event counter for check DFC_ComMETCTOut" ULONG DFC_OneToOne 1 100 0.00 536870911.000 BIT_MASK 0x1fffffff FORMAT "%13.3" ECU_ADDRESS 0x6000D348 /end MEASUREMENT
/begin MEASUREMENT DDRC_St.DFC_ComMETDChksum "Debouncing counters / Debounce Timer or Event counter for check DFC_ComMETDChksum" ULONG DFC_OneToOne 1 100 0.00 536870911.000 BIT_MASK 0x1fffffff FORMAT "%13.3" ECU_ADDRESS 0x6000D34C /end MEASUREMENT
/begin MEASUREMENT DDRC_St.DFC_ComMETDRingCnt "Debouncing counters / Debounce Timer or Event counter for check DFC_ComMETDRingCnt" ULONG DFC_OneToOne 1 100 0.00 536870911.000 BIT_MASK 0x1fffffff FORMAT "%13.3" ECU_ADDRESS 0x6000D350 /end MEASUREMENT
/begin MEASUREMENT DDRC_St.DFC_ComMETDTOut "Debouncing counters / Debounce Timer or Event counter for check DFC_ComMETDTOut" ULONG DFC_OneToOne 1 100 0.00 536870911.000 BIT_MASK 0x1fffffff FORMAT "%13.3" ECU_ADDRESS 0x6000D354 /end MEASUREMENT
/begin MEASUREMENT DDRC_St.DFC_ComMETE2Chksum "Debouncing counters / Debounce Timer or Event counter for check DFC_ComMETE2Chksum" ULONG DFC_OneToOne 1 100 0.00 536870911.000 BIT_MASK 0x1fffffff FORMAT "%13.3" ECU_ADDRESS 0x6000D358 /end MEASUREMENT
/begin MEASUREMENT DDRC_St.DFC_ComMETE2RingCnt "Debouncing counters / Debounce Timer or Event counter for check DFC_ComMETE2RingCnt" ULONG DFC_OneToOne 1 100 0.00 536870911.000 BIT_MASK 0x1fffffff FORMAT "%13.3" ECU_ADDRESS 0x6000D35C /end MEASUREMENT
/begin MEASUREMENT DDRC_St.DFC_ComMETE2TOut "Debouncing counters / Debounce Timer or Event counter for check DFC_ComMETE2TOut" ULONG DFC_OneToOne 1 100 0.00 536870911.000 BIT_MASK 0x1fffffff FORMAT "%13.3" ECU_ADDRESS 0x6000D360 /end MEASUREMENT
/begin MEASUREMENT DDRC_St.DFC_ComMETFChksum "Debouncing counters / Debounce Timer or Event counter for check DFC_ComMETFChksum" ULONG DFC_OneToOne 1 100 0.00 536870911.000 BIT_MASK 0x1fffffff FORMAT "%13.3" ECU_ADDRESS 0x6000D364 /end MEASUREMENT
/begin MEASUREMENT DDRC_St.DFC_ComMETFRingCnt "Debouncing counters / Debounce Timer or Event counter for check DFC_ComMETFRingCnt" ULONG DFC_OneToOne 1 100 0.00 536870911.000 BIT_MASK 0x1fffffff FORMAT "%13.3" ECU_ADDRESS 0x6000D368 /end MEASUREMENT
/begin MEASUREMENT DDRC_St.DFC_ComMETFTOut "Debouncing counters / Debounce Timer or Event counter for check DFC_ComMETFTOut" ULONG DFC_OneToOne 1 100 0.00 536870911.000 BIT_MASK 0x1fffffff FORMAT "%13.3" ECU_ADDRESS 0x6000D36C /end MEASUREMENT
/begin MEASUREMENT DDRC_St.DFC_ComMETGChksum "Debouncing counters / Debounce Timer or Event counter for check DFC_ComMETGChksum" ULONG DFC_OneToOne 1 100 0.00 536870911.000 BIT_MASK 0x1fffffff FORMAT "%13.3" ECU_ADDRESS 0x6000D370 /end MEASUREMENT
/begin MEASUREMENT DDRC_St.DFC_ComMETGRingCnt "Debouncing counters / Debounce Timer or Event counter for check DFC_ComMETGRingCnt" ULONG DFC_OneToOne 1 100 0.00 536870911.000 BIT_MASK 0x1fffffff FORMAT "%13.3" ECU_ADDRESS 0x6000D374 /end MEASUREMENT
/begin MEASUREMENT DDRC_St.DFC_ComMETGTOut "Debouncing counters / Debounce Timer or Event counter for check DFC_ComMETGTOut" ULONG DFC_OneToOne 1 100 0.00 536870911.000 BIT_MASK 0x1fffffff FORMAT "%13.3" ECU_ADDRESS 0x6000D378 /end MEASUREMENT
/begin MEASUREMENT DDRC_St.DFC_ComMETH2Chksum "Debouncing counters / Debounce Timer or Event counter for check DFC_ComMETH2Chksum" ULONG DFC_OneToOne 1 100 0.00 536870911.000 BIT_MASK 0x1fffffff FORMAT "%13.3" ECU_ADDRESS 0x6000D37C /end MEASUREMENT
/begin MEASUREMENT DDRC_St.DFC_ComMETH2RingCnt "Debouncing counters / Debounce Timer or Event counter for check DFC_ComMETH2RingCnt" ULONG DFC_OneToOne 1 100 0.00 536870911.000 BIT_MASK 0x1fffffff FORMAT "%13.3" ECU_ADDRESS 0x6000D380 /end MEASUREMENT
/begin MEASUREMENT DDRC_St.DFC_ComMETH2TOut "Debouncing counters / Debounce Timer or Event counter for check DFC_ComMETH2TOut" ULONG DFC_OneToOne 1 100 0.00 536870911.000 BIT_MASK 0x1fffffff FORMAT "%13.3" ECU_ADDRESS 0x6000D384 /end MEASUREMENT
/begin MEASUREMENT DDRC_St.DFC_ComMETHChksum "Debouncing counters / Debounce Timer or Event counter for check DFC_ComMETHChksum" ULONG DFC_OneToOne 1 100 0.00 536870911.000 BIT_MASK 0x1fffffff FORMAT "%13.3" ECU_ADDRESS 0x6000D388 /end MEASUREMENT
/begin MEASUREMENT DDRC_St.DFC_ComMETHRingCnt "Debouncing counters / Debounce Timer or Event counter for check DFC_ComMETHRingCnt" ULONG DFC_OneToOne 1 100 0.00 536870911.000 BIT_MASK 0x1fffffff FORMAT "%13.3" ECU_ADDRESS 0x6000D38C /end MEASUREMENT
/begin MEASUREMENT DDRC_St.DFC_ComMETHTOut "Debouncing counters / Debounce Timer or Event counter for check DFC_ComMETHTOut" ULONG DFC_OneToOne 1 100 0.00 536870911.000 BIT_MASK 0x1fffffff FORMAT "%13.3" ECU_ADDRESS 0x6000D390 /end MEASUREMENT
/begin MEASUREMENT DDRC_St.DFC_ComMETIChksum "Debouncing counters / Debounce Timer or Event counter for check DFC_ComMETIChksum" ULONG DFC_OneToOne 1 100 0.00 536870911.000 BIT_MASK 0x1fffffff FORMAT "%13.3" ECU_ADDRESS 0x6000D394 /end MEASUREMENT
/begin MEASUREMENT DDRC_St.DFC_ComMETIRingCnt "Debouncing counters / Debounce Timer or Event counter for check DFC_ComMETIRingCnt" ULONG DFC_OneToOne 1 100 0.00 536870911.000 BIT_MASK 0x1fffffff FORMAT "%13.3" ECU_ADDRESS 0x6000D398 /end MEASUREMENT
/begin MEASUREMENT DDRC_St.DFC_ComMETITOut "Debouncing counters / Debounce Timer or Event counter for check DFC_ComMETITOut" ULONG DFC_OneToOne 1 100 0.00 536870911.000 BIT_MASK 0x1fffffff FORMAT "%13.3" ECU_ADDRESS 0x6000D39C /end MEASUREMENT
/begin MEASUREMENT DDRC_St.DFC_ComMETKChksum "Debouncing counters / Debounce Timer or Event counter for check DFC_ComMETKChksum" ULONG DFC_OneToOne 1 100 0.00 536870911.000 BIT_MASK 0x1fffffff FORMAT "%13.3" ECU_ADDRESS 0x6000D3A0 /end MEASUREMENT
/begin MEASUREMENT DDRC_St.DFC_ComMETKRingCnt "Debouncing counters / Debounce Timer or Event counter for check DFC_ComMETKRingCnt" ULONG DFC_OneToOne 1 100 0.00 536870911.000 BIT_MASK 0x1fffffff FORMAT "%13.3" ECU_ADDRESS 0x6000D3A4 /end MEASUREMENT
/begin MEASUREMENT DDRC_St.DFC_ComMETKTOut "Debouncing counters / Debounce Timer or Event counter for check DFC_ComMETKTOut" ULONG DFC_OneToOne 1 100 0.00 536870911.000 BIT_MASK 0x1fffffff FORMAT "%13.3" ECU_ADDRESS 0x6000D3A8 /end MEASUREMENT
/begin MEASUREMENT DDRC_St.DFC_ComMETLChksum "Debouncing counters / Debounce Timer or Event counter for check DFC_ComMETLChksum" ULONG DFC_OneToOne 1 100 0.00 536870911.000 BIT_MASK 0x1fffffff FORMAT "%13.3" ECU_ADDRESS 0x6000D3AC /end MEASUREMENT
/begin MEASUREMENT DDRC_St.DFC_ComMETLRingCnt "Debouncing counters / Debounce Timer or Event counter for check DFC_ComMETLRingCnt" ULONG DFC_OneToOne 1 100 0.00 536870911.000 BIT_MASK 0x1fffffff FORMAT "%13.3" ECU_ADDRESS 0x6000D3B0 /end MEASUREMENT
/begin MEASUREMENT DDRC_St.DFC_ComMETLTOut "Debouncing counters / Debounce Timer or Event counter for check DFC_ComMETLTOut" ULONG DFC_OneToOne 1 100 0.00 536870911.000 BIT_MASK 0x1fffffff FORMAT "%13.3" ECU_ADDRESS 0x6000D3B4 /end MEASUREMENT
/begin MEASUREMENT DDRC_St.DFC_ComMETMChksum "Debouncing counters / Debounce Timer or Event counter for check DFC_ComMETMChksum" ULONG DFC_OneToOne 1 100 0.00 536870911.000 BIT_MASK 0x1fffffff FORMAT "%13.3" ECU_ADDRESS 0x6000D3B8 /end MEASUREMENT
/begin MEASUREMENT DDRC_St.DFC_ComMETMRingCnt "Debouncing counters / Debounce Timer or Event counter for check DFC_ComMETMRingCnt" ULONG DFC_OneToOne 1 100 0.00 536870911.000 BIT_MASK 0x1fffffff FORMAT "%13.3" ECU_ADDRESS 0x6000D3BC /end MEASUREMENT
/begin MEASUREMENT DDRC_St.DFC_ComMETMTOut "Debouncing counters / Debounce Timer or Event counter for check DFC_ComMETMTOut" ULONG DFC_OneToOne 1 100 0.00 536870911.000 BIT_MASK 0x1fffffff FORMAT "%13.3" ECU_ADDRESS 0x6000D3C0 /end MEASUREMENT
/begin MEASUREMENT DDRC_St.DFC_ComMETNChksum "Debouncing counters / Debounce Timer or Event counter for check DFC_ComMETNChksum" ULONG DFC_OneToOne 1 100 0.00 536870911.000 BIT_MASK 0x1fffffff FORMAT "%13.3" ECU_ADDRESS 0x6000D3C4 /end MEASUREMENT
/begin MEASUREMENT DDRC_St.DFC_ComMETNRingCnt "Debouncing counters / Debounce Timer or Event counter for check DFC_ComMETNRingCnt" ULONG DFC_OneToOne 1 100 0.00 536870911.000 BIT_MASK 0x1fffffff FORMAT "%13.3" ECU_ADDRESS 0x6000D3C8 /end MEASUREMENT
/begin MEASUREMENT DDRC_St.DFC_ComMETNTOut "Debouncing counters / Debounce Timer or Event counter for check DFC_ComMETNTOut" ULONG DFC_OneToOne 1 100 0.00 536870911.000 BIT_MASK 0x1fffffff FORMAT "%13.3" ECU_ADDRESS 0x6000D3CC /end MEASUREMENT
/begin MEASUREMENT DDRC_St.DFC_ComMtrCom "Debouncing counters / Debounce Timer or Event counter for check DFC_ComMtrCom" ULONG DFC_OneToOne 1 100 0.00 536870911.000 BIT_MASK 0x1fffffff FORMAT "%13.3" ECU_ADDRESS 0x6000D3D0 /end MEASUREMENT
/begin MEASUREMENT DDRC_St.DFC_ComPCUChkSum "Debouncing counters / Debounce Timer or Event counter for check DFC_ComPCUChkSum" ULONG DFC_OneToOne 1 100 0.00 536870911.000 BIT_MASK 0x1fffffff FORMAT "%13.3" ECU_ADDRESS 0x6000D3D4 /end MEASUREMENT
/begin MEASUREMENT DDRC_St.DFC_ComPCURingCnt "Debouncing counters / Debounce Timer or Event counter for check DFC_ComPCURingCnt" ULONG DFC_OneToOne 1 100 0.00 536870911.000 BIT_MASK 0x1fffffff FORMAT "%13.3" ECU_ADDRESS 0x6000D3D8 /end MEASUREMENT
/begin MEASUREMENT DDRC_St.DFC_ComPCUTOut "Debouncing counters / Debounce Timer or Event counter for check DFC_ComPCUTOut" ULONG DFC_OneToOne 1 100 0.00 536870911.000 BIT_MASK 0x1fffffff FORMAT "%13.3" ECU_ADDRESS 0x6000D3DC /end MEASUREMENT
/begin MEASUREMENT DDRC_St.DFC_ComSRSAChksum "Debouncing counters / Debounce Timer or Event counter for check DFC_ComSRSAChksum" ULONG DFC_OneToOne 1 100 0.00 536870911.000 BIT_MASK 0x1fffffff FORMAT "%13.3" ECU_ADDRESS 0x6000D3E0 /end MEASUREMENT
/begin MEASUREMENT DDRC_St.DFC_ComSRSARingCnt "Debouncing counters / Debounce Timer or Event counter for check DFC_ComSRSARingCnt" ULONG DFC_OneToOne 1 100 0.00 536870911.000 BIT_MASK 0x1fffffff FORMAT "%13.3" ECU_ADDRESS 0x6000D3E4 /end MEASUREMENT
/begin MEASUREMENT DDRC_St.DFC_ComSRSATOut "Debouncing counters / Debounce Timer or Event counter for check DFC_ComSRSATOut" ULONG DFC_OneToOne 1 100 0.00 536870911.000 BIT_MASK 0x1fffffff FORMAT "%13.3" ECU_ADDRESS 0x6000D3E8 /end MEASUREMENT
/begin MEASUREMENT DDRC_St.DFC_ComSRSBChksum "Debouncing counters / Debounce Timer or Event counter for check DFC_ComSRSBChksum" ULONG DFC_OneToOne 1 100 0.00 536870911.000 BIT_MASK 0x1fffffff FORMAT "%13.3" ECU_ADDRESS 0x6000D3EC /end MEASUREMENT
/begin MEASUREMENT DDRC_St.DFC_ComSRSBRingCnt "Debouncing counters / Debounce Timer or Event counter for check DFC_ComSRSBRingCnt" ULONG DFC_OneToOne 1 100 0.00 536870911.000 BIT_MASK 0x1fffffff FORMAT "%13.3" ECU_ADDRESS 0x6000D3F0 /end MEASUREMENT
/begin MEASUREMENT DDRC_St.DFC_ComSRSBTOut "Debouncing counters / Debounce Timer or Event counter for check DFC_ComSRSBTOut" ULONG DFC_OneToOne 1 100 0.00 536870911.000 BIT_MASK 0x1fffffff FORMAT "%13.3" ECU_ADDRESS 0x6000D3F4 /end MEASUREMENT
/begin MEASUREMENT DDRC_St.DFC_ComSRSChksum "Debouncing counters / Debounce Timer or Event counter for check DFC_ComSRSChksum" ULONG DFC_OneToOne 1 100 0.00 536870911.000 BIT_MASK 0x1fffffff FORMAT "%13.3" ECU_ADDRESS 0x6000D3F8 /end MEASUREMENT
/begin MEASUREMENT DDRC_St.DFC_ComSRSErr "Debouncing counters / Debounce Timer or Event counter for check DFC_ComSRSErr" ULONG DFC_OneToOne 1 100 0.00 536870911.000 BIT_MASK 0x1fffffff FORMAT "%13.3" ECU_ADDRESS 0x6000D3FC /end MEASUREMENT
/begin MEASUREMENT DDRC_St.DFC_ComSRSRingCnt "Debouncing counters / Debounce Timer or Event counter for check DFC_ComSRSRingCnt" ULONG DFC_OneToOne 1 100 0.00 536870911.000 BIT_MASK 0x1fffffff FORMAT "%13.3" ECU_ADDRESS 0x6000D400 /end MEASUREMENT
/begin MEASUREMENT DDRC_St.DFC_ComSRSTOut "Debouncing counters / Debounce Timer or Event counter for check DFC_ComSRSTOut" ULONG DFC_OneToOne 1 100 0.00 536870911.000 BIT_MASK 0x1fffffff FORMAT "%13.3" ECU_ADDRESS 0x6000D404 /end MEASUREMENT
/begin MEASUREMENT DDRC_St.DFC_ComVehSpdPndFltTCU "Debouncing counters / Debounce Timer or Event counter for check DFC_ComVehSpdPndFltTCU" ULONG DFC_OneToOne 1 100 0.00 536870911.000 BIT_MASK 0x1fffffff FORMAT "%13.3" ECU_ADDRESS 0x6000D408 /end MEASUREMENT
/begin MEASUREMENT DDRC_St.DFC_EbsChartcCurrErr "Debouncing counters / Debounce Timer or Event counter for check DFC_EbsChartcCurrErr" ULONG DFC_OneToOne 1 100 0.00 536870911.000 BIT_MASK 0x1fffffff FORMAT "%13.3" ECU_ADDRESS 0x6000D40C /end MEASUREMENT
/begin MEASUREMENT DDRC_St.DFC_EbsSelfDiagErr "Debouncing counters / Debounce Timer or Event counter for check DFC_EbsSelfDiagErr" ULONG DFC_OneToOne 1 100 0.00 536870911.000 BIT_MASK 0x1fffffff FORMAT "%13.3" ECU_ADDRESS 0x6000D410 /end MEASUREMENT
/begin MEASUREMENT DDRC_St.DFC_GbxCANDigPlausErr "Debouncing counters / Debounce Timer or Event counter for check DFC_GbxCANDigPlausErr" ULONG DFC_OneToOne 1 100 0.00 536870911.000 BIT_MASK 0x1fffffff FORMAT "%13.3" ECU_ADDRESS 0x6000D414 /end MEASUREMENT
/begin MEASUREMENT DDRC_St.DFC_GbxNPos1SRCMax "Debouncing counters / Debounce Timer or Event counter for check DFC_GbxNPos1SRCMax" ULONG DFC_OneToOne 1 100 0.00 536870911.000 BIT_MASK 0x1fffffff FORMAT "%13.3" ECU_ADDRESS 0x6000D418 /end MEASUREMENT
/begin MEASUREMENT DDRC_St.DFC_GbxNPos1SRCMin "Debouncing counters / Debounce Timer or Event counter for check DFC_GbxNPos1SRCMin" ULONG DFC_OneToOne 1 100 0.00 536870911.000 BIT_MASK 0x1fffffff FORMAT "%13.3" ECU_ADDRESS 0x6000D41C /end MEASUREMENT
/begin MEASUREMENT DDRC_St.DFC_GbxNPos2SRCMax "Debouncing counters / Debounce Timer or Event counter for check DFC_GbxNPos2SRCMax" ULONG DFC_OneToOne 1 100 0.00 536870911.000 BIT_MASK 0x1fffffff FORMAT "%13.3" ECU_ADDRESS 0x6000D420 /end MEASUREMENT
/begin MEASUREMENT DDRC_St.DFC_GbxNPos2SRCMin "Debouncing counters / Debounce Timer or Event counter for check DFC_GbxNPos2SRCMin" ULONG DFC_OneToOne 1 100 0.00 536870911.000 BIT_MASK 0x1fffffff FORMAT "%13.3" ECU_ADDRESS 0x6000D424 /end MEASUREMENT
/begin MEASUREMENT DDRC_St.DFC_GbxNPosAlvChk "Debouncing counters / Debounce Timer or Event counter for check DFC_GbxNPosAlvChk" ULONG DFC_OneToOne 1 100 0.00 536870911.000 BIT_MASK 0x1fffffff FORMAT "%13.3" ECU_ADDRESS 0x6000D428 /end MEASUREMENT
/begin MEASUREMENT DDRC_St.DFC_GbxNPosSyncErr "Debouncing counters / Debounce Timer or Event counter for check DFC_GbxNPosSyncErr" ULONG DFC_OneToOne 1 100 0.00 536870911.000 BIT_MASK 0x1fffffff FORMAT "%13.3" ECU_ADDRESS 0x6000D42C /end MEASUREMENT
/begin MEASUREMENT DDRC_St.DFC_HEGOS2B1HtrPsMax "Debouncing counters / Debounce Timer or Event counter for check DFC_HEGOS2B1HtrPsMax" ULONG DFC_OneToOne 1 100 0.00 536870911.000 BIT_MASK 0x1fffffff FORMAT "%13.3" ECU_ADDRESS 0x6000D430 /end MEASUREMENT
/begin MEASUREMENT DDRC_St.DFC_HEGOS2B1HtrPsMin "Debouncing counters / Debounce Timer or Event counter for check DFC_HEGOS2B1HtrPsMin" ULONG DFC_OneToOne 1 100 0.00 536870911.000 BIT_MASK 0x1fffffff FORMAT "%13.3" ECU_ADDRESS 0x6000D434 /end MEASUREMENT
/begin MEASUREMENT DDRC_St.DFC_HEGOS2B1HtrPsSig "Debouncing counters / Debounce Timer or Event counter for check DFC_HEGOS2B1HtrPsSig" ULONG DFC_OneToOne 1 100 0.00 536870911.000 BIT_MASK 0x1fffffff FORMAT "%13.3" ECU_ADDRESS 0x6000D438 /end MEASUREMENT
/begin MEASUREMENT DDRC_St.DFC_LinCSErrACG "Debouncing counters / Debounce Timer or Event counter for check DFC_LinCSErrACG" ULONG DFC_OneToOne 1 100 0.00 536870911.000 BIT_MASK 0x1fffffff FORMAT "%13.3" ECU_ADDRESS 0x6000D43C /end MEASUREMENT
/begin MEASUREMENT DDRC_St.DFC_LinCSErrEBS "Debouncing counters / Debounce Timer or Event counter for check DFC_LinCSErrEBS" ULONG DFC_OneToOne 1 100 0.00 536870911.000 BIT_MASK 0x1fffffff FORMAT "%13.3" ECU_ADDRESS 0x6000D440 /end MEASUREMENT
/begin MEASUREMENT DDRC_St.DFC_LinHdrTimeoutErrACG "Debouncing counters / Debounce Timer or Event counter for check DFC_LinHdrTimeoutErrACG" ULONG DFC_OneToOne 1 100 0.00 536870911.000 BIT_MASK 0x1fffffff FORMAT "%13.3" ECU_ADDRESS 0x6000D444 /end MEASUREMENT
/begin MEASUREMENT DDRC_St.DFC_LinHdrTimeoutErrEBS "Debouncing counters / Debounce Timer or Event counter for check DFC_LinHdrTimeoutErrEBS" ULONG DFC_OneToOne 1 100 0.00 536870911.000 BIT_MASK 0x1fffffff FORMAT "%13.3" ECU_ADDRESS 0x6000D448 /end MEASUREMENT
/begin MEASUREMENT DDRC_St.DFC_LinMsgTimeoutErrACG "Debouncing counters / Debounce Timer or Event counter for check DFC_LinMsgTimeoutErrACG" ULONG DFC_OneToOne 1 100 0.00 536870911.000 BIT_MASK 0x1fffffff FORMAT "%13.3" ECU_ADDRESS 0x6000D44C /end MEASUREMENT
/begin MEASUREMENT DDRC_St.DFC_LinMsgTimeoutErrEBS "Debouncing counters / Debounce Timer or Event counter for check DFC_LinMsgTimeoutErrEBS" ULONG DFC_OneToOne 1 100 0.00 536870911.000 BIT_MASK 0x1fffffff FORMAT "%13.3" ECU_ADDRESS 0x6000D450 /end MEASUREMENT
/begin MEASUREMENT DDRC_St.DFC_LinNoStrtComErr "Debouncing counters / Debounce Timer or Event counter for check DFC_LinNoStrtComErr" ULONG DFC_OneToOne 1 100 0.00 536870911.000 BIT_MASK 0x1fffffff FORMAT "%13.3" ECU_ADDRESS 0x6000D454 /end MEASUREMENT
/begin MEASUREMENT DDRC_St.DFC_MisfDetVWhlFrntLeOORHi "Debouncing counters / Debounce Timer or Event counter for check DFC_MisfDetVWhlFrntLeOORHi" ULONG DFC_OneToOne 1 100 0.00 536870911.000 BIT_MASK 0x1fffffff FORMAT "%13.3" ECU_ADDRESS 0x6000D458 /end MEASUREMENT
/begin MEASUREMENT DDRC_St.DFC_MisfDetVWhlFrntLeRatyHi "Debouncing counters / Debounce Timer or Event counter for check DFC_MisfDetVWhlFrntLeRatyHi" ULONG DFC_OneToOne 1 100 0.00 536870911.000 BIT_MASK 0x1fffffff FORMAT "%13.3" ECU_ADDRESS 0x6000D45C /end MEASUREMENT
/begin MEASUREMENT DDRC_St.DFC_MisfDetVWhlFrntLeRatyLo "Debouncing counters / Debounce Timer or Event counter for check DFC_MisfDetVWhlFrntLeRatyLo" ULONG DFC_OneToOne 1 100 0.00 536870911.000 BIT_MASK 0x1fffffff FORMAT "%13.3" ECU_ADDRESS 0x6000D460 /end MEASUREMENT
/begin MEASUREMENT DDRC_St.DFC_MisfDetVWhlFrntLeStuck "Debouncing counters / Debounce Timer or Event counter for check DFC_MisfDetVWhlFrntLeStuck" ULONG DFC_OneToOne 1 100 0.00 536870911.000 BIT_MASK 0x1fffffff FORMAT "%13.3" ECU_ADDRESS 0x6000D464 /end MEASUREMENT
/begin MEASUREMENT DDRC_St.DFC_MisfDetVWhlFrntRiOORHi "Debouncing counters / Debounce Timer or Event counter for check DFC_MisfDetVWhlFrntRiOORHi" ULONG DFC_OneToOne 1 100 0.00 536870911.000 BIT_MASK 0x1fffffff FORMAT "%13.3" ECU_ADDRESS 0x6000D468 /end MEASUREMENT
/begin MEASUREMENT DDRC_St.DFC_MisfDetVWhlFrntRiRatyHi "Debouncing counters / Debounce Timer or Event counter for check DFC_MisfDetVWhlFrntRiRatyHi" ULONG DFC_OneToOne 1 100 0.00 536870911.000 BIT_MASK 0x1fffffff FORMAT "%13.3" ECU_ADDRESS 0x6000D46C /end MEASUREMENT
/begin MEASUREMENT DDRC_St.DFC_MisfDetVWhlFrntRiRatyLo "Debouncing counters / Debounce Timer or Event counter for check DFC_MisfDetVWhlFrntRiRatyLo" ULONG DFC_OneToOne 1 100 0.00 536870911.000 BIT_MASK 0x1fffffff FORMAT "%13.3" ECU_ADDRESS 0x6000D470 /end MEASUREMENT
/begin MEASUREMENT DDRC_St.DFC_MisfDetVWhlFrntRiStuck "Debouncing counters / Debounce Timer or Event counter for check DFC_MisfDetVWhlFrntRiStuck" ULONG DFC_OneToOne 1 100 0.00 536870911.000 BIT_MASK 0x1fffffff FORMAT "%13.3" ECU_ADDRESS 0x6000D474 /end MEASUREMENT
/begin MEASUREMENT DDRC_St.DFC_MisfDetVWhlReLeOORHi "Debouncing counters / Debounce Timer or Event counter for check DFC_MisfDetVWhlReLeOORHi" ULONG DFC_OneToOne 1 100 0.00 536870911.000 BIT_MASK 0x1fffffff FORMAT "%13.3" ECU_ADDRESS 0x6000D478 /end MEASUREMENT
/begin MEASUREMENT DDRC_St.DFC_MisfDetVWhlReLeRatyHi "Debouncing counters / Debounce Timer or Event counter for check DFC_MisfDetVWhlReLeRatyHi" ULONG DFC_OneToOne 1 100 0.00 536870911.000 BIT_MASK 0x1fffffff FORMAT "%13.3" ECU_ADDRESS 0x6000D47C /end MEASUREMENT
/begin MEASUREMENT DDRC_St.DFC_MisfDetVWhlReLeRatyLo "Debouncing counters / Debounce Timer or Event counter for check DFC_MisfDetVWhlReLeRatyLo" ULONG DFC_OneToOne 1 100 0.00 536870911.000 BIT_MASK 0x1fffffff FORMAT "%13.3" ECU_ADDRESS 0x6000D480 /end MEASUREMENT
/begin MEASUREMENT DDRC_St.DFC_MisfDetVWhlReLeStuck "Debouncing counters / Debounce Timer or Event counter for check DFC_MisfDetVWhlReLeStuck" ULONG DFC_OneToOne 1 100 0.00 536870911.000 BIT_MASK 0x1fffffff FORMAT "%13.3" ECU_ADDRESS 0x6000D484 /end MEASUREMENT
/begin MEASUREMENT DDRC_St.DFC_MisfDetVWhlReRiOORHi "Debouncing counters / Debounce Timer or Event counter for check DFC_MisfDetVWhlReRiOORHi" ULONG DFC_OneToOne 1 100 0.00 536870911.000 BIT_MASK 0x1fffffff FORMAT "%13.3" ECU_ADDRESS 0x6000D488 /end MEASUREMENT
/begin MEASUREMENT DDRC_St.DFC_MisfDetVWhlReRiRatyHi "Debouncing counters / Debounce Timer or Event counter for check DFC_MisfDetVWhlReRiRatyHi" ULONG DFC_OneToOne 1 100 0.00 536870911.000 BIT_MASK 0x1fffffff FORMAT "%13.3" ECU_ADDRESS 0x6000D48C /end MEASUREMENT
/begin MEASUREMENT DDRC_St.DFC_MisfDetVWhlReRiRatyLo "Debouncing counters / Debounce Timer or Event counter for check DFC_MisfDetVWhlReRiRatyLo" ULONG DFC_OneToOne 1 100 0.00 536870911.000 BIT_MASK 0x1fffffff FORMAT "%13.3" ECU_ADDRESS 0x6000D490 /end MEASUREMENT
/begin MEASUREMENT DDRC_St.DFC_MisfDetVWhlReRiStuck "Debouncing counters / Debounce Timer or Event counter for check DFC_MisfDetVWhlReRiStuck" ULONG DFC_OneToOne 1 100 0.00 536870911.000 BIT_MASK 0x1fffffff FORMAT "%13.3" ECU_ADDRESS 0x6000D494 /end MEASUREMENT
/begin MEASUREMENT DDRC_St.DFC_MisfDetdVWhlFrntLePlaus "Debouncing counters / Debounce Timer or Event counter for check DFC_MisfDetdVWhlFrntLePlaus" ULONG DFC_OneToOne 1 100 0.00 536870911.000 BIT_MASK 0x1fffffff FORMAT "%13.3" ECU_ADDRESS 0x6000D498 /end MEASUREMENT
/begin MEASUREMENT DDRC_St.DFC_MisfDetdVWhlFrntRiPlaus "Debouncing counters / Debounce Timer or Event counter for check DFC_MisfDetdVWhlFrntRiPlaus" ULONG DFC_OneToOne 1 100 0.00 536870911.000 BIT_MASK 0x1fffffff FORMAT "%13.3" ECU_ADDRESS 0x6000D49C /end MEASUREMENT
/begin MEASUREMENT DDRC_St.DFC_MisfDetdVWhlReLePlaus "Debouncing counters / Debounce Timer or Event counter for check DFC_MisfDetdVWhlReLePlaus" ULONG DFC_OneToOne 1 100 0.00 536870911.000 BIT_MASK 0x1fffffff FORMAT "%13.3" ECU_ADDRESS 0x6000D4A0 /end MEASUREMENT
/begin MEASUREMENT DDRC_St.DFC_MisfDetdVWhlReRiPlaus "Debouncing counters / Debounce Timer or Event counter for check DFC_MisfDetdVWhlReRiPlaus" ULONG DFC_OneToOne 1 100 0.00 536870911.000 BIT_MASK 0x1fffffff FORMAT "%13.3" ECU_ADDRESS 0x6000D4A4 /end MEASUREMENT
/begin MEASUREMENT DDRC_St.DFC_PEnvSigRngMax "Debouncing counters / Debounce Timer or Event counter for check DFC_PEnvSigRngMax" ULONG DFC_OneToOne 1 100 0.00 536870911.000 BIT_MASK 0x1fffffff FORMAT "%13.3" ECU_ADDRESS 0x6000D4A8 /end MEASUREMENT
/begin MEASUREMENT DDRC_St.DFC_PEnvSigRngMin "Debouncing counters / Debounce Timer or Event counter for check DFC_PEnvSigRngMin" ULONG DFC_OneToOne 1 100 0.00 536870911.000 BIT_MASK 0x1fffffff FORMAT "%13.3" ECU_ADDRESS 0x6000D4AC /end MEASUREMENT
/begin MEASUREMENT DDRC_St.DFC_StmFault "Debouncing counters / Debounce Timer or Event counter for check DFC_StmFault" ULONG DFC_OneToOne 1 100 0.00 536870911.000 BIT_MASK 0x1fffffff FORMAT "%13.3" ECU_ADDRESS 0x6000D4B0 /end MEASUREMENT
/begin MEASUREMENT DDRC_St.DFC_StrtCtOffPth "Debouncing counters / Debounce Timer or Event counter for check DFC_StrtCtOffPth" ULONG DFC_OneToOne 1 100 0.00 536870911.000 BIT_MASK 0x1fffffff FORMAT "%13.3" ECU_ADDRESS 0x6000D4B4 /end MEASUREMENT
/begin MEASUREMENT DDRC_St.DFC_StrtCtlErr "Debouncing counters / Debounce Timer or Event counter for check DFC_StrtCtlErr" ULONG DFC_OneToOne 1 100 0.00 536870911.000 BIT_MASK 0x1fffffff FORMAT "%13.3" ECU_ADDRESS 0x6000D4B8 /end MEASUREMENT
/begin MEASUREMENT DDRC_St.DFC_StrtFault "Debouncing counters / Debounce Timer or Event counter for check DFC_StrtFault" ULONG DFC_OneToOne 1 100 0.00 536870911.000 BIT_MASK 0x1fffffff FORMAT "%13.3" ECU_ADDRESS 0x6000D4BC /end MEASUREMENT
/begin MEASUREMENT DDRC_St.DFC_StrtLckJudg1 "Debouncing counters / Debounce Timer or Event counter for check DFC_StrtLckJudg1" ULONG DFC_OneToOne 1 100 0.00 536870911.000 BIT_MASK 0x1fffffff FORMAT "%13.3" ECU_ADDRESS 0x6000D4C0 /end MEASUREMENT
/begin MEASUREMENT DDRC_St.DFC_StrtLckJudg2 "Debouncing counters / Debounce Timer or Event counter for check DFC_StrtLckJudg2" ULONG DFC_OneToOne 1 100 0.00 536870911.000 BIT_MASK 0x1fffffff FORMAT "%13.3" ECU_ADDRESS 0x6000D4C4 /end MEASUREMENT
/begin MEASUREMENT DDRC_St.DFC_StrtOL "Debouncing counters / Debounce Timer or Event counter for check DFC_StrtOL" ULONG DFC_OneToOne 1 100 0.00 536870911.000 BIT_MASK 0x1fffffff FORMAT "%13.3" ECU_ADDRESS 0x6000D4C8 /end MEASUREMENT
/begin MEASUREMENT DDRC_St.DFC_StrtOL2 "Debouncing counters / Debounce Timer or Event counter for check DFC_StrtOL2" ULONG DFC_OneToOne 1 100 0.00 536870911.000 BIT_MASK 0x1fffffff FORMAT "%13.3" ECU_ADDRESS 0x6000D4CC /end MEASUREMENT
/begin MEASUREMENT DDRC_St.DFC_StrtSCB "Debouncing counters / Debounce Timer or Event counter for check DFC_StrtSCB" ULONG DFC_OneToOne 1 100 0.00 536870911.000 BIT_MASK 0x1fffffff FORMAT "%13.3" ECU_ADDRESS 0x6000D4D0 /end MEASUREMENT
/begin MEASUREMENT DDRC_St.DFC_StrtSCB2 "Debouncing counters / Debounce Timer or Event counter for check DFC_StrtSCB2" ULONG DFC_OneToOne 1 100 0.00 536870911.000 BIT_MASK 0x1fffffff FORMAT "%13.3" ECU_ADDRESS 0x6000D4D4 /end MEASUREMENT
/begin MEASUREMENT DDRC_St.DFC_StrtSCG "Debouncing counters / Debounce Timer or Event counter for check DFC_StrtSCG" ULONG DFC_OneToOne 1 100 0.00 536870911.000 BIT_MASK 0x1fffffff FORMAT "%13.3" ECU_ADDRESS 0x6000D4D8 /end MEASUREMENT
/begin MEASUREMENT DDRC_St.DFC_StrtSCG2 "Debouncing counters / Debounce Timer or Event counter for check DFC_StrtSCG2" ULONG DFC_OneToOne 1 100 0.00 536870911.000 BIT_MASK 0x1fffffff FORMAT "%13.3" ECU_ADDRESS 0x6000D4DC /end MEASUREMENT
/begin MEASUREMENT DDRC_St.DFC_StrtStkRly1 "Debouncing counters / Debounce Timer or Event counter for check DFC_StrtStkRly1" ULONG DFC_OneToOne 1 100 0.00 536870911.000 BIT_MASK 0x1fffffff FORMAT "%13.3" ECU_ADDRESS 0x6000D4E0 /end MEASUREMENT
/begin MEASUREMENT DDRC_St.DFC_StrtStkRly2 "Debouncing counters / Debounce Timer or Event counter for check DFC_StrtStkRly2" ULONG DFC_OneToOne 1 100 0.00 536870911.000 BIT_MASK 0x1fffffff FORMAT "%13.3" ECU_ADDRESS 0x6000D4E4 /end MEASUREMENT
/begin MEASUREMENT DDRC_St.DFC_TEVEmax "Debouncing counters / Debounce Timer or Event counter for check DFC_TEVEmax" ULONG DFC_OneToOne 1 100 0.00 536870911.000 BIT_MASK 0x1fffffff FORMAT "%13.3" ECU_ADDRESS 0x6000D4E8 /end MEASUREMENT
/begin MEASUREMENT DDRC_St.DFC_TEVEmin "Debouncing counters / Debounce Timer or Event counter for check DFC_TEVEmin" ULONG DFC_OneToOne 1 100 0.00 536870911.000 BIT_MASK 0x1fffffff FORMAT "%13.3" ECU_ADDRESS 0x6000D4EC /end MEASUREMENT
/begin MEASUREMENT DDRC_St.DFC_TEVEsig "Debouncing counters / Debounce Timer or Event counter for check DFC_TEVEsig" ULONG DFC_OneToOne 1 100 0.00 536870911.000 BIT_MASK 0x1fffffff FORMAT "%13.3" ECU_ADDRESS 0x6000D4F0 /end MEASUREMENT
/begin MEASUREMENT DDRC_St.DFC_VehVAllPlaus "Debouncing counters / Debounce Timer or Event counter for check DFC_VehVAllPlaus" ULONG DFC_OneToOne 1 100 0.00 536870911.000 BIT_MASK 0x1fffffff FORMAT "%13.3" ECU_ADDRESS 0x6000D4F4 /end MEASUREMENT
/begin MEASUREMENT DDRC_St.DFC_VehVNCSnsrElecFailr "Debouncing counters / Debounce Timer or Event counter for check DFC_VehVNCSnsrElecFailr" ULONG DFC_OneToOne 1 100 0.00 536870911.000 BIT_MASK 0x1fffffff FORMAT "%13.3" ECU_ADDRESS 0x6000D4F8 /end MEASUREMENT
/begin MEASUREMENT DDRC_St.DFC_VehVPlausCan "Debouncing counters / Debounce Timer or Event counter for check DFC_VehVPlausCan" ULONG DFC_OneToOne 1 100 0.00 536870911.000 BIT_MASK 0x1fffffff FORMAT "%13.3" ECU_ADDRESS 0x6000D4FC /end MEASUREMENT
/begin MEASUREMENT DDRC_St.DFC_VehVPlausFco "Debouncing counters / Debounce Timer or Event counter for check DFC_VehVPlausFco" ULONG DFC_OneToOne 1 100 0.00 536870911.000 BIT_MASK 0x1fffffff FORMAT "%13.3" ECU_ADDRESS 0x6000D500 /end MEASUREMENT
/begin MEASUREMENT DDRC_St.DFC_VehVPlausPwr "Debouncing counters / Debounce Timer or Event counter for check DFC_VehVPlausPwr" ULONG DFC_OneToOne 1 100 0.00 536870911.000 BIT_MASK 0x1fffffff FORMAT "%13.3" ECU_ADDRESS 0x6000D504 /end MEASUREMENT
/begin MEASUREMENT DDRC_St.DFC_VehVPlausV2N "Debouncing counters / Debounce Timer or Event counter for check DFC_VehVPlausV2N" ULONG DFC_OneToOne 1 100 0.00 536870911.000 BIT_MASK 0x1fffffff FORMAT "%13.3" ECU_ADDRESS 0x6000D508 /end MEASUREMENT
/begin MEASUREMENT DDRC_St.DFC_VehVSpdSnsrAElecFailr "Debouncing counters / Debounce Timer or Event counter for check DFC_VehVSpdSnsrAElecFailr" ULONG DFC_OneToOne 1 100 0.00 536870911.000 BIT_MASK 0x1fffffff FORMAT "%13.3" ECU_ADDRESS 0x6000D50C /end MEASUREMENT
/begin MEASUREMENT DDRC_St.DFC_VehVSpdSnsrBElecFailr "Debouncing counters / Debounce Timer or Event counter for check DFC_VehVSpdSnsrBElecFailr" ULONG DFC_OneToOne 1 100 0.00 536870911.000 BIT_MASK 0x1fffffff FORMAT "%13.3" ECU_ADDRESS 0x6000D510 /end MEASUREMENT
/begin MEASUREMENT DDRC_St.DFC_ClthMax "Debouncing counters / Debounce Timer or Event counter for check DFC_ClthMax" ULONG DFC_OneToOne 1 100 0.00 536870911.000 BIT_MASK 0x1fffffff FORMAT "%13.3" ECU_ADDRESS 0x6000D514 /end MEASUREMENT
/begin MEASUREMENT DDRC_St.DFC_IgnClPs_DevComErr "Debouncing counters / Debounce Timer or Event counter for check DFC_IgnClPs_DevComErr" ULONG DFC_OneToOne 1 100 0.00 536870911.000 BIT_MASK 0x1fffffff FORMAT "%13.3" ECU_ADDRESS 0x6000D518 /end MEASUREMENT
/begin MEASUREMENT DDRC_St.DFC_IgnClPs_LineOl_0 "Debouncing counters / Debounce Timer or Event counter for check DFC_IgnClPs_LineOl_0" ULONG DFC_OneToOne 1 100 0.00 536870911.000 BIT_MASK 0x1fffffff FORMAT "%13.3" ECU_ADDRESS 0x6000D51C /end MEASUREMENT
/begin MEASUREMENT DDRC_St.DFC_IgnClPs_LineOl_1 "Debouncing counters / Debounce Timer or Event counter for check DFC_IgnClPs_LineOl_1" ULONG DFC_OneToOne 1 100 0.00 536870911.000 BIT_MASK 0x1fffffff FORMAT "%13.3" ECU_ADDRESS 0x6000D520 /end MEASUREMENT
/begin MEASUREMENT DDRC_St.DFC_IgnClPs_LineOl_2 "Debouncing counters / Debounce Timer or Event counter for check DFC_IgnClPs_LineOl_2" ULONG DFC_OneToOne 1 100 0.00 536870911.000 BIT_MASK 0x1fffffff FORMAT "%13.3" ECU_ADDRESS 0x6000D524 /end MEASUREMENT
/begin MEASUREMENT DDRC_St.DFC_IgnClPs_LineOl_3 "Debouncing counters / Debounce Timer or Event counter for check DFC_IgnClPs_LineOl_3" ULONG DFC_OneToOne 1 100 0.00 536870911.000 BIT_MASK 0x1fffffff FORMAT "%13.3" ECU_ADDRESS 0x6000D528 /end MEASUREMENT
/begin MEASUREMENT DDRC_St.DFC_IgnClPs_LineScb_0 "Debouncing counters / Debounce Timer or Event counter for check DFC_IgnClPs_LineScb_0" ULONG DFC_OneToOne 1 100 0.00 536870911.000 BIT_MASK 0x1fffffff FORMAT "%13.3" ECU_ADDRESS 0x6000D52C /end MEASUREMENT
/begin MEASUREMENT DDRC_St.DFC_IgnClPs_LineScb_1 "Debouncing counters / Debounce Timer or Event counter for check DFC_IgnClPs_LineScb_1" ULONG DFC_OneToOne 1 100 0.00 536870911.000 BIT_MASK 0x1fffffff FORMAT "%13.3" ECU_ADDRESS 0x6000D530 /end MEASUREMENT
/begin MEASUREMENT DDRC_St.DFC_IgnClPs_LineScb_2 "Debouncing counters / Debounce Timer or Event counter for check DFC_IgnClPs_LineScb_2" ULONG DFC_OneToOne 1 100 0.00 536870911.000 BIT_MASK 0x1fffffff FORMAT "%13.3" ECU_ADDRESS 0x6000D534 /end MEASUREMENT
/begin MEASUREMENT DDRC_St.DFC_IgnClPs_LineScb_3 "Debouncing counters / Debounce Timer or Event counter for check DFC_IgnClPs_LineScb_3" ULONG DFC_OneToOne 1 100 0.00 536870911.000 BIT_MASK 0x1fffffff FORMAT "%13.3" ECU_ADDRESS 0x6000D538 /end MEASUREMENT
/begin MEASUREMENT DDRC_St.DFC_IgnClPs_LineScg_0 "Debouncing counters / Debounce Timer or Event counter for check DFC_IgnClPs_LineScg_0" ULONG DFC_OneToOne 1 100 0.00 536870911.000 BIT_MASK 0x1fffffff FORMAT "%13.3" ECU_ADDRESS 0x6000D53C /end MEASUREMENT
/begin MEASUREMENT DDRC_St.DFC_IgnClPs_LineScg_1 "Debouncing counters / Debounce Timer or Event counter for check DFC_IgnClPs_LineScg_1" ULONG DFC_OneToOne 1 100 0.00 536870911.000 BIT_MASK 0x1fffffff FORMAT "%13.3" ECU_ADDRESS 0x6000D540 /end MEASUREMENT
/begin MEASUREMENT DDRC_St.DFC_IgnClPs_LineScg_2 "Debouncing counters / Debounce Timer or Event counter for check DFC_IgnClPs_LineScg_2" ULONG DFC_OneToOne 1 100 0.00 536870911.000 BIT_MASK 0x1fffffff FORMAT "%13.3" ECU_ADDRESS 0x6000D544 /end MEASUREMENT
/begin MEASUREMENT DDRC_St.DFC_IgnClPs_LineScg_3 "Debouncing counters / Debounce Timer or Event counter for check DFC_IgnClPs_LineScg_3" ULONG DFC_OneToOne 1 100 0.00 536870911.000 BIT_MASK 0x1fffffff FORMAT "%13.3" ECU_ADDRESS 0x6000D548 /end MEASUREMENT
/begin MEASUREMENT DDRC_St.DFC_UEGOASICS1B1 "Debouncing counters / Debounce Timer or Event counter for check DFC_UEGOASICS1B1" ULONG DFC_OneToOne 1 100 0.00 536870911.000 BIT_MASK 0x1fffffff FORMAT "%13.3" ECU_ADDRESS 0x6000D54C /end MEASUREMENT
/begin MEASUREMENT DDRC_St.DFC_UEGOOLIPES1B1 "Debouncing counters / Debounce Timer or Event counter for check DFC_UEGOOLIPES1B1" ULONG DFC_OneToOne 1 100 0.00 536870911.000 BIT_MASK 0x1fffffff FORMAT "%13.3" ECU_ADDRESS 0x6000D550 /end MEASUREMENT
/begin MEASUREMENT DDRC_St.DFC_UEGOOLRES1B1 "Debouncing counters / Debounce Timer or Event counter for check DFC_UEGOOLRES1B1" ULONG DFC_OneToOne 1 100 0.00 536870911.000 BIT_MASK 0x1fffffff FORMAT "%13.3" ECU_ADDRESS 0x6000D554 /end MEASUREMENT
/begin MEASUREMENT DDRC_St.DFC_UEGOSCBS1B1 "Debouncing counters / Debounce Timer or Event counter for check DFC_UEGOSCBS1B1" ULONG DFC_OneToOne 1 100 0.00 536870911.000 BIT_MASK 0x1fffffff FORMAT "%13.3" ECU_ADDRESS 0x6000D558 /end MEASUREMENT
/begin MEASUREMENT DDRC_St.DFC_UEGOSCGS1B1 "Debouncing counters / Debounce Timer or Event counter for check DFC_UEGOSCGS1B1" ULONG DFC_OneToOne 1 100 0.00 536870911.000 BIT_MASK 0x1fffffff FORMAT "%13.3" ECU_ADDRESS 0x6000D55C /end MEASUREMENT
/begin MEASUREMENT DDRC_St.DFC_UEGOSPIS1B1 "Debouncing counters / Debounce Timer or Event counter for check DFC_UEGOSPIS1B1" ULONG DFC_OneToOne 1 100 0.00 536870911.000 BIT_MASK 0x1fffffff FORMAT "%13.3" ECU_ADDRESS 0x6000D560 /end MEASUREMENT
/begin MEASUREMENT DDRC_St.DFC_UEGOSnsrS1B1 "Debouncing counters / Debounce Timer or Event counter for check DFC_UEGOSnsrS1B1" ULONG DFC_OneToOne 1 100 0.00 536870911.000 BIT_MASK 0x1fffffff FORMAT "%13.3" ECU_ADDRESS 0x6000D564 /end MEASUREMENT
/begin MEASUREMENT DDRC_St.DFC_UegoOlApesS1B1 "Debouncing counters / Debounce Timer or Event counter for check DFC_UegoOlApesS1B1" ULONG DFC_OneToOne 1 100 0.00 536870911.000 BIT_MASK 0x1fffffff FORMAT "%13.3" ECU_ADDRESS 0x6000D568 /end MEASUREMENT
/begin MEASUREMENT DDRC_St.DFC_UegoOlRCmpS1B1 "Debouncing counters / Debounce Timer or Event counter for check DFC_UegoOlRCmpS1B1" ULONG DFC_OneToOne 1 100 0.00 536870911.000 BIT_MASK 0x1fffffff FORMAT "%13.3" ECU_ADDRESS 0x6000D56C /end MEASUREMENT
/begin MEASUREMENT DDRC_St.DFC_AirCCmprOL "Debouncing counters / Debounce Timer or Event counter for check DFC_AirCCmprOL" ULONG DFC_OneToOne 1 100 0.00 536870911.000 BIT_MASK 0x1fffffff FORMAT "%13.3" ECU_ADDRESS 0x6000D570 /end MEASUREMENT
/begin MEASUREMENT DDRC_St.DFC_AirCCmprOvrTemp "Debouncing counters / Debounce Timer or Event counter for check DFC_AirCCmprOvrTemp" ULONG DFC_OneToOne 1 100 0.00 536870911.000 BIT_MASK 0x1fffffff FORMAT "%13.3" ECU_ADDRESS 0x6000D574 /end MEASUREMENT
/begin MEASUREMENT DDRC_St.DFC_AirCCmprSCB "Debouncing counters / Debounce Timer or Event counter for check DFC_AirCCmprSCB" ULONG DFC_OneToOne 1 100 0.00 536870911.000 BIT_MASK 0x1fffffff FORMAT "%13.3" ECU_ADDRESS 0x6000D578 /end MEASUREMENT
/begin MEASUREMENT DDRC_St.DFC_AirCCmprSCG "Debouncing counters / Debounce Timer or Event counter for check DFC_AirCCmprSCG" ULONG DFC_OneToOne 1 100 0.00 536870911.000 BIT_MASK 0x1fffffff FORMAT "%13.3" ECU_ADDRESS 0x6000D57C /end MEASUREMENT
/begin MEASUREMENT DDRC_St.DFC_AltErr "Debouncing counters / Debounce Timer or Event counter for check DFC_AltErr" ULONG DFC_OneToOne 1 100 0.00 536870911.000 BIT_MASK 0x1fffffff FORMAT "%13.3" ECU_ADDRESS 0x6000D580 /end MEASUREMENT
/begin MEASUREMENT DDRC_St.DFC_BattUSRCMax "Debouncing counters / Debounce Timer or Event counter for check DFC_BattUSRCMax" ULONG DFC_OneToOne 1 100 0.00 536870911.000 BIT_MASK 0x1fffffff FORMAT "%13.3" ECU_ADDRESS 0x6000D584 /end MEASUREMENT
/begin MEASUREMENT DDRC_St.DFC_BattUSRCMin "Debouncing counters / Debounce Timer or Event counter for check DFC_BattUSRCMin" ULONG DFC_OneToOne 1 100 0.00 536870911.000 BIT_MASK 0x1fffffff FORMAT "%13.3" ECU_ADDRESS 0x6000D588 /end MEASUREMENT
/begin MEASUREMENT DDRC_St.DFC_ComChksTCU1 "Debouncing counters / Debounce Timer or Event counter for check DFC_ComChksTCU1" ULONG DFC_OneToOne 1 100 0.00 536870911.000 BIT_MASK 0x1fffffff FORMAT "%13.3" ECU_ADDRESS 0x6000D58C /end MEASUREMENT
/begin MEASUREMENT DDRC_St.DFC_ComChksTCU11 "Debouncing counters / Debounce Timer or Event counter for check DFC_ComChksTCU11" ULONG DFC_OneToOne 1 100 0.00 536870911.000 BIT_MASK 0x1fffffff FORMAT "%13.3" ECU_ADDRESS 0x6000D590 /end MEASUREMENT
/begin MEASUREMENT DDRC_St.DFC_ComChksTCU12 "Debouncing counters / Debounce Timer or Event counter for check DFC_ComChksTCU12" ULONG DFC_OneToOne 1 100 0.00 536870911.000 BIT_MASK 0x1fffffff FORMAT "%13.3" ECU_ADDRESS 0x6000D594 /end MEASUREMENT
/begin MEASUREMENT DDRC_St.DFC_ComChksTCU13 "Debouncing counters / Debounce Timer or Event counter for check DFC_ComChksTCU13" ULONG DFC_OneToOne 1 100 0.00 536870911.000 BIT_MASK 0x1fffffff FORMAT "%13.3" ECU_ADDRESS 0x6000D598 /end MEASUREMENT
/begin MEASUREMENT DDRC_St.DFC_ComChksTCU2 "Debouncing counters / Debounce Timer or Event counter for check DFC_ComChksTCU2" ULONG DFC_OneToOne 1 100 0.00 536870911.000 BIT_MASK 0x1fffffff FORMAT "%13.3" ECU_ADDRESS 0x6000D59C /end MEASUREMENT
/begin MEASUREMENT DDRC_St.DFC_ComChksTCU3 "Debouncing counters / Debounce Timer or Event counter for check DFC_ComChksTCU3" ULONG DFC_OneToOne 1 100 0.00 536870911.000 BIT_MASK 0x1fffffff FORMAT "%13.3" ECU_ADDRESS 0x6000D5A0 /end MEASUREMENT
/begin MEASUREMENT DDRC_St.DFC_ComChksTCU4 "Debouncing counters / Debounce Timer or Event counter for check DFC_ComChksTCU4" ULONG DFC_OneToOne 1 100 0.00 536870911.000 BIT_MASK 0x1fffffff FORMAT "%13.3" ECU_ADDRESS 0x6000D5A4 /end MEASUREMENT
/begin MEASUREMENT DDRC_St.DFC_ComCntTCU1 "Debouncing counters / Debounce Timer or Event counter for check DFC_ComCntTCU1" ULONG DFC_OneToOne 1 100 0.00 536870911.000 BIT_MASK 0x1fffffff FORMAT "%13.3" ECU_ADDRESS 0x6000D5A8 /end MEASUREMENT
/begin MEASUREMENT DDRC_St.DFC_ComCntTCU11 "Debouncing counters / Debounce Timer or Event counter for check DFC_ComCntTCU11" ULONG DFC_OneToOne 1 100 0.00 536870911.000 BIT_MASK 0x1fffffff FORMAT "%13.3" ECU_ADDRESS 0x6000D5AC /end MEASUREMENT
/begin MEASUREMENT DDRC_St.DFC_ComCntTCU12 "Debouncing counters / Debounce Timer or Event counter for check DFC_ComCntTCU12" ULONG DFC_OneToOne 1 100 0.00 536870911.000 BIT_MASK 0x1fffffff FORMAT "%13.3" ECU_ADDRESS 0x6000D5B0 /end MEASUREMENT
/begin MEASUREMENT DDRC_St.DFC_ComCntTCU13 "Debouncing counters / Debounce Timer or Event counter for check DFC_ComCntTCU13" ULONG DFC_OneToOne 1 100 0.00 536870911.000 BIT_MASK 0x1fffffff FORMAT "%13.3" ECU_ADDRESS 0x6000D5B4 /end MEASUREMENT
/begin MEASUREMENT DDRC_St.DFC_ComCntTCU2 "Debouncing counters / Debounce Timer or Event counter for check DFC_ComCntTCU2" ULONG DFC_OneToOne 1 100 0.00 536870911.000 BIT_MASK 0x1fffffff FORMAT "%13.3" ECU_ADDRESS 0x6000D5B8 /end MEASUREMENT
/begin MEASUREMENT DDRC_St.DFC_ComCntTCU3 "Debouncing counters / Debounce Timer or Event counter for check DFC_ComCntTCU3" ULONG DFC_OneToOne 1 100 0.00 536870911.000 BIT_MASK 0x1fffffff FORMAT "%13.3" ECU_ADDRESS 0x6000D5BC /end MEASUREMENT
/begin MEASUREMENT DDRC_St.DFC_ComCntTCU4 "Debouncing counters / Debounce Timer or Event counter for check DFC_ComCntTCU4" ULONG DFC_OneToOne 1 100 0.00 536870911.000 BIT_MASK 0x1fffffff FORMAT "%13.3" ECU_ADDRESS 0x6000D5C0 /end MEASUREMENT
/begin MEASUREMENT DDRC_St.DFC_ComTOutTCU01 "Debouncing counters / Debounce Timer or Event counter for check DFC_ComTOutTCU01" ULONG DFC_OneToOne 1 100 0.00 536870911.000 BIT_MASK 0x1fffffff FORMAT "%13.3" ECU_ADDRESS 0x6000D5C4 /end MEASUREMENT
/begin MEASUREMENT DDRC_St.DFC_ComTOutTCU02 "Debouncing counters / Debounce Timer or Event counter for check DFC_ComTOutTCU02" ULONG DFC_OneToOne 1 100 0.00 536870911.000 BIT_MASK 0x1fffffff FORMAT "%13.3" ECU_ADDRESS 0x6000D5C8 /end MEASUREMENT
/begin MEASUREMENT DDRC_St.DFC_ComTOutTCU1 "Debouncing counters / Debounce Timer or Event counter for check DFC_ComTOutTCU1" ULONG DFC_OneToOne 1 100 0.00 536870911.000 BIT_MASK 0x1fffffff FORMAT "%13.3" ECU_ADDRESS 0x6000D5CC /end MEASUREMENT
/begin MEASUREMENT DDRC_St.DFC_ComTOutTCU11 "Debouncing counters / Debounce Timer or Event counter for check DFC_ComTOutTCU11" ULONG DFC_OneToOne 1 100 0.00 536870911.000 BIT_MASK 0x1fffffff FORMAT "%13.3" ECU_ADDRESS 0x6000D5D0 /end MEASUREMENT
/begin MEASUREMENT DDRC_St.DFC_ComTOutTCU12 "Debouncing counters / Debounce Timer or Event counter for check DFC_ComTOutTCU12" ULONG DFC_OneToOne 1 100 0.00 536870911.000 BIT_MASK 0x1fffffff FORMAT "%13.3" ECU_ADDRESS 0x6000D5D4 /end MEASUREMENT
/begin MEASUREMENT DDRC_St.DFC_ComTOutTCU13 "Debouncing counters / Debounce Timer or Event counter for check DFC_ComTOutTCU13" ULONG DFC_OneToOne 1 100 0.00 536870911.000 BIT_MASK 0x1fffffff FORMAT "%13.3" ECU_ADDRESS 0x6000D5D8 /end MEASUREMENT
/begin MEASUREMENT DDRC_St.DFC_ComTOutTCU14 "Debouncing counters / Debounce Timer or Event counter for check DFC_ComTOutTCU14" ULONG DFC_OneToOne 1 100 0.00 536870911.000 BIT_MASK 0x1fffffff FORMAT "%13.3" ECU_ADDRESS 0x6000D5DC /end MEASUREMENT
/begin MEASUREMENT DDRC_St.DFC_ComTOutTCU2 "Debouncing counters / Debounce Timer or Event counter for check DFC_ComTOutTCU2" ULONG DFC_OneToOne 1 100 0.00 536870911.000 BIT_MASK 0x1fffffff FORMAT "%13.3" ECU_ADDRESS 0x6000D5E0 /end MEASUREMENT
/begin MEASUREMENT DDRC_St.DFC_ComTOutTCU3 "Debouncing counters / Debounce Timer or Event counter for check DFC_ComTOutTCU3" ULONG DFC_OneToOne 1 100 0.00 536870911.000 BIT_MASK 0x1fffffff FORMAT "%13.3" ECU_ADDRESS 0x6000D5E4 /end MEASUREMENT
/begin MEASUREMENT DDRC_St.DFC_ComTOutTCU4 "Debouncing counters / Debounce Timer or Event counter for check DFC_ComTOutTCU4" ULONG DFC_OneToOne 1 100 0.00 536870911.000 BIT_MASK 0x1fffffff FORMAT "%13.3" ECU_ADDRESS 0x6000D5E8 /end MEASUREMENT
/begin MEASUREMENT DDRC_St.DFC_DevLibBattUHi "Debouncing counters / Debounce Timer or Event counter for check DFC_DevLibBattUHi" ULONG DFC_OneToOne 1 100 0.00 536870911.000 BIT_MASK 0x1fffffff FORMAT "%13.3" ECU_ADDRESS 0x6000D5EC /end MEASUREMENT
/begin MEASUREMENT DDRC_St.DFC_DevLibBattULo "Debouncing counters / Debounce Timer or Event counter for check DFC_DevLibBattULo" ULONG DFC_OneToOne 1 100 0.00 536870911.000 BIT_MASK 0x1fffffff FORMAT "%13.3" ECU_ADDRESS 0x6000D5F0 /end MEASUREMENT
/begin MEASUREMENT DDRC_St.DFC_FanDIOOL_0 "Debouncing counters / Debounce Timer or Event counter for check DFC_FanDIOOL_0" ULONG DFC_OneToOne 1 100 0.00 536870911.000 BIT_MASK 0x1fffffff FORMAT "%13.3" ECU_ADDRESS 0x6000D5F4 /end MEASUREMENT
/begin MEASUREMENT DDRC_St.DFC_FanDIOOL_1 "Debouncing counters / Debounce Timer or Event counter for check DFC_FanDIOOL_1" ULONG DFC_OneToOne 1 100 0.00 536870911.000 BIT_MASK 0x1fffffff FORMAT "%13.3" ECU_ADDRESS 0x6000D5F8 /end MEASUREMENT
/begin MEASUREMENT DDRC_St.DFC_FanDIOOvrTemp_0 "Debouncing counters / Debounce Timer or Event counter for check DFC_FanDIOOvrTemp_0" ULONG DFC_OneToOne 1 100 0.00 536870911.000 BIT_MASK 0x1fffffff FORMAT "%13.3" ECU_ADDRESS 0x6000D5FC /end MEASUREMENT
/begin MEASUREMENT DDRC_St.DFC_FanDIOOvrTemp_1 "Debouncing counters / Debounce Timer or Event counter for check DFC_FanDIOOvrTemp_1" ULONG DFC_OneToOne 1 100 0.00 536870911.000 BIT_MASK 0x1fffffff FORMAT "%13.3" ECU_ADDRESS 0x6000D600 /end MEASUREMENT
/begin MEASUREMENT DDRC_St.DFC_FanDIOSCB_0 "Debouncing counters / Debounce Timer or Event counter for check DFC_FanDIOSCB_0" ULONG DFC_OneToOne 1 100 0.00 536870911.000 BIT_MASK 0x1fffffff FORMAT "%13.3" ECU_ADDRESS 0x6000D604 /end MEASUREMENT
/begin MEASUREMENT DDRC_St.DFC_FanDIOSCB_1 "Debouncing counters / Debounce Timer or Event counter for check DFC_FanDIOSCB_1" ULONG DFC_OneToOne 1 100 0.00 536870911.000 BIT_MASK 0x1fffffff FORMAT "%13.3" ECU_ADDRESS 0x6000D608 /end MEASUREMENT
/begin MEASUREMENT DDRC_St.DFC_FanDIOSCG_0 "Debouncing counters / Debounce Timer or Event counter for check DFC_FanDIOSCG_0" ULONG DFC_OneToOne 1 100 0.00 536870911.000 BIT_MASK 0x1fffffff FORMAT "%13.3" ECU_ADDRESS 0x6000D60C /end MEASUREMENT
/begin MEASUREMENT DDRC_St.DFC_FanDIOSCG_1 "Debouncing counters / Debounce Timer or Event counter for check DFC_FanDIOSCG_1" ULONG DFC_OneToOne 1 100 0.00 536870911.000 BIT_MASK 0x1fffffff FORMAT "%13.3" ECU_ADDRESS 0x6000D610 /end MEASUREMENT
/begin MEASUREMENT DDRC_St.DFC_MRlyDcOL "Debouncing counters / Debounce Timer or Event counter for check DFC_MRlyDcOL" ULONG DFC_OneToOne 1 100 0.00 536870911.000 BIT_MASK 0x1fffffff FORMAT "%13.3" ECU_ADDRESS 0x6000D614 /end MEASUREMENT
/begin MEASUREMENT DDRC_St.DFC_MRlyDcSCB "Debouncing counters / Debounce Timer or Event counter for check DFC_MRlyDcSCB" ULONG DFC_OneToOne 1 100 0.00 536870911.000 BIT_MASK 0x1fffffff FORMAT "%13.3" ECU_ADDRESS 0x6000D618 /end MEASUREMENT
/begin MEASUREMENT DDRC_St.DFC_MRlyDcSCG "Debouncing counters / Debounce Timer or Event counter for check DFC_MRlyDcSCG" ULONG DFC_OneToOne 1 100 0.00 536870911.000 BIT_MASK 0x1fffffff FORMAT "%13.3" ECU_ADDRESS 0x6000D61C /end MEASUREMENT
/begin MEASUREMENT DDRC_St.DFC_PSPOL "Debouncing counters / Debounce Timer or Event counter for check DFC_PSPOL" ULONG DFC_OneToOne 1 100 0.00 536870911.000 BIT_MASK 0x1fffffff FORMAT "%13.3" ECU_ADDRESS 0x6000D620 /end MEASUREMENT
/begin MEASUREMENT DDRC_St.DFC_PSPOvrTemp "Debouncing counters / Debounce Timer or Event counter for check DFC_PSPOvrTemp" ULONG DFC_OneToOne 1 100 0.00 536870911.000 BIT_MASK 0x1fffffff FORMAT "%13.3" ECU_ADDRESS 0x6000D624 /end MEASUREMENT
/begin MEASUREMENT DDRC_St.DFC_PSPSCB "Debouncing counters / Debounce Timer or Event counter for check DFC_PSPSCB" ULONG DFC_OneToOne 1 100 0.00 536870911.000 BIT_MASK 0x1fffffff FORMAT "%13.3" ECU_ADDRESS 0x6000D628 /end MEASUREMENT
/begin MEASUREMENT DDRC_St.DFC_PSPSCG "Debouncing counters / Debounce Timer or Event counter for check DFC_PSPSCG" ULONG DFC_OneToOne 1 100 0.00 536870911.000 BIT_MASK 0x1fffffff FORMAT "%13.3" ECU_ADDRESS 0x6000D62C /end MEASUREMENT
/begin MEASUREMENT DDRC_St.DFC_T50Err "Debouncing counters / Debounce Timer or Event counter for check DFC_T50Err" ULONG DFC_OneToOne 1 100 0.00 536870911.000 BIT_MASK 0x1fffffff FORMAT "%13.3" ECU_ADDRESS 0x6000D630 /end MEASUREMENT
/begin MEASUREMENT DDRC_St.DFC_ThrVlvLoBattB1 "Debouncing counters / Debounce Timer or Event counter for check DFC_ThrVlvLoBattB1" ULONG DFC_OneToOne 1 100 0.00 536870911.000 BIT_MASK 0x1fffffff FORMAT "%13.3" ECU_ADDRESS 0x6000D634 /end MEASUREMENT
/begin MEASUREMENT DDRC_St.DFC_VehVPhysRngHi "Debouncing counters / Debounce Timer or Event counter for check DFC_VehVPhysRngHi" ULONG DFC_OneToOne 1 100 0.00 536870911.000 BIT_MASK 0x1fffffff FORMAT "%13.3" ECU_ADDRESS 0x6000D638 /end MEASUREMENT
/begin MEASUREMENT DDRC_St.DFC_VehVSclOutOL "Debouncing counters / Debounce Timer or Event counter for check DFC_VehVSclOutOL" ULONG DFC_OneToOne 1 100 0.00 536870911.000 BIT_MASK 0x1fffffff FORMAT "%13.3" ECU_ADDRESS 0x6000D63C /end MEASUREMENT
/begin MEASUREMENT DDRC_St.DFC_VehVSclOutOT "Debouncing counters / Debounce Timer or Event counter for check DFC_VehVSclOutOT" ULONG DFC_OneToOne 1 100 0.00 536870911.000 BIT_MASK 0x1fffffff FORMAT "%13.3" ECU_ADDRESS 0x6000D640 /end MEASUREMENT
/begin MEASUREMENT DDRC_St.DFC_VehVSclOutSCB "Debouncing counters / Debounce Timer or Event counter for check DFC_VehVSclOutSCB" ULONG DFC_OneToOne 1 100 0.00 536870911.000 BIT_MASK 0x1fffffff FORMAT "%13.3" ECU_ADDRESS 0x6000D644 /end MEASUREMENT
/begin MEASUREMENT DDRC_St.DFC_VehVSclOutSCG "Debouncing counters / Debounce Timer or Event counter for check DFC_VehVSclOutSCG" ULONG DFC_OneToOne 1 100 0.00 536870911.000 BIT_MASK 0x1fffffff FORMAT "%13.3" ECU_ADDRESS 0x6000D648 /end MEASUREMENT
/begin MEASUREMENT DDRC_St.DFC_VehVSnsrARngHi "Debouncing counters / Debounce Timer or Event counter for check DFC_VehVSnsrARngHi" ULONG DFC_OneToOne 1 100 0.00 536870911.000 BIT_MASK 0x1fffffff FORMAT "%13.3" ECU_ADDRESS 0x6000D64C /end MEASUREMENT
/begin MEASUREMENT DDRC_St.DFC_VehVSnsrBRngHi "Debouncing counters / Debounce Timer or Event counter for check DFC_VehVSnsrBRngHi" ULONG DFC_OneToOne 1 100 0.00 536870911.000 BIT_MASK 0x1fffffff FORMAT "%13.3" ECU_ADDRESS 0x6000D650 /end MEASUREMENT
/begin MEASUREMENT DDRC_St.DFC_VehVSpdRtyDiag "Debouncing counters / Debounce Timer or Event counter for check DFC_VehVSpdRtyDiag" ULONG DFC_OneToOne 1 100 0.00 536870911.000 BIT_MASK 0x1fffffff FORMAT "%13.3" ECU_ADDRESS 0x6000D654 /end MEASUREMENT
/begin MEASUREMENT DDRC_St.DFC_VehVWhlErr "Debouncing counters / Debounce Timer or Event counter for check DFC_VehVWhlErr" ULONG DFC_OneToOne 1 100 0.00 536870911.000 BIT_MASK 0x1fffffff FORMAT "%13.3" ECU_ADDRESS 0x6000D658 /end MEASUREMENT
/begin MEASUREMENT DDRC_St.DFC_ACEvpTSRCMax "Debouncing counters / Debounce Timer or Event counter for check DFC_ACEvpTSRCMax" UWORD DFC_OneToOne 1 100 0.00 8191.000 BIT_MASK 0x1fff FORMAT "%8.3" ECU_ADDRESS 0x6000D9E2 /end MEASUREMENT
/begin MEASUREMENT DDRC_St.DFC_ACEvpTSRCMin "Debouncing counters / Debounce Timer or Event counter for check DFC_ACEvpTSRCMin" UWORD DFC_OneToOne 1 100 0.00 8191.000 BIT_MASK 0x1fff FORMAT "%8.3" ECU_ADDRESS 0x6000D9E4 /end MEASUREMENT
/begin MEASUREMENT DDRC_St.DFC_AirCClntPAnaSRCMax "Debouncing counters / Debounce Timer or Event counter for check DFC_AirCClntPAnaSRCMax" UWORD DFC_OneToOne 1 100 0.00 8191.000 BIT_MASK 0x1fff FORMAT "%8.3" ECU_ADDRESS 0x6000D9E6 /end MEASUREMENT
/begin MEASUREMENT DDRC_St.DFC_AirCClntPAnaSRCMin "Debouncing counters / Debounce Timer or Event counter for check DFC_AirCClntPAnaSRCMin" UWORD DFC_OneToOne 1 100 0.00 8191.000 BIT_MASK 0x1fff FORMAT "%8.3" ECU_ADDRESS 0x6000D9E8 /end MEASUREMENT
/begin MEASUREMENT DDRC_St.DFC_AirCSwtNpl "Debouncing counters / Debounce Timer or Event counter for check DFC_AirCSwtNpl" UWORD DFC_OneToOne 1 100 0.00 8191.000 BIT_MASK 0x1fff FORMAT "%8.3" ECU_ADDRESS 0x6000D9EA /end MEASUREMENT
/begin MEASUREMENT DDRC_St.DFC_AirCSwtSig "Debouncing counters / Debounce Timer or Event counter for check DFC_AirCSwtSig" UWORD DFC_OneToOne 1 100 0.00 8191.000 BIT_MASK 0x1fff FORMAT "%8.3" ECU_ADDRESS 0x6000D9EC /end MEASUREMENT
/begin MEASUREMENT DDRC_St.DFC_Brk "Debouncing counters / Debounce Timer or Event counter for check DFC_Brk" UWORD DFC_OneToOne 1 100 0.00 8191.000 BIT_MASK 0x1fff FORMAT "%8.3" ECU_ADDRESS 0x6000D9EE /end MEASUREMENT
/begin MEASUREMENT DDRC_St.DFC_BrkSig "Debouncing counters / Debounce Timer or Event counter for check DFC_BrkSig" UWORD DFC_OneToOne 1 100 0.00 8191.000 BIT_MASK 0x1fff FORMAT "%8.3" ECU_ADDRESS 0x6000D9F0 /end MEASUREMENT
/begin MEASUREMENT DDRC_St.DFC_ClthSig "Debouncing counters / Debounce Timer or Event counter for check DFC_ClthSig" UWORD DFC_OneToOne 1 100 0.00 8191.000 BIT_MASK 0x1fff FORMAT "%8.3" ECU_ADDRESS 0x6000D9F2 /end MEASUREMENT
/begin MEASUREMENT DDRC_St.DFC_HLSDemOvhtEngLim "Debouncing counters / Debounce Timer or Event counter for check DFC_HLSDemOvhtEngLim" UWORD DFC_OneToOne 1 100 0.00 8191.000 BIT_MASK 0x1fff FORMAT "%8.3" ECU_ADDRESS 0x6000D9F4 /end MEASUREMENT
/begin MEASUREMENT DDRC_St.DFC_OilPNpl "Debouncing counters / Debounce Timer or Event counter for check DFC_OilPNpl" UWORD DFC_OneToOne 1 100 0.00 8191.000 BIT_MASK 0x1fff FORMAT "%8.3" ECU_ADDRESS 0x6000D9F6 /end MEASUREMENT
/begin MEASUREMENT DDRC_St.DFC_PIntkVUsLineHiB1 "Debouncing counters / Debounce Timer or Event counter for check DFC_PIntkVUsLineHiB1" UWORD DFC_OneToOne 1 100 0.00 8191.000 BIT_MASK 0x1fff FORMAT "%8.3" ECU_ADDRESS 0x6000D9F8 /end MEASUREMENT
/begin MEASUREMENT DDRC_St.DFC_PIntkVUsLineLoB1 "Debouncing counters / Debounce Timer or Event counter for check DFC_PIntkVUsLineLoB1" UWORD DFC_OneToOne 1 100 0.00 8191.000 BIT_MASK 0x1fff FORMAT "%8.3" ECU_ADDRESS 0x6000D9FA /end MEASUREMENT
/begin MEASUREMENT DDRC_St.DFC_VehVPhysRngLo "Debouncing counters / Debounce Timer or Event counter for check DFC_VehVPhysRngLo" UWORD DFC_OneToOne 1 100 0.00 8191.000 BIT_MASK 0x1fff FORMAT "%8.3" ECU_ADDRESS 0x6000D9FC /end MEASUREMENT
/begin MEASUREMENT DDRC_St.DFC_VehVSigCan "Debouncing counters / Debounce Timer or Event counter for check DFC_VehVSigCan" UWORD DFC_OneToOne 1 100 0.00 8191.000 BIT_MASK 0x1fff FORMAT "%8.3" ECU_ADDRESS 0x6000D9FE /end MEASUREMENT
/begin MEASUREMENT DDRC_St.DFC_VehVSigCanSafe "Debouncing counters / Debounce Timer or Event counter for check DFC_VehVSigCanSafe" UWORD DFC_OneToOne 1 100 0.00 8191.000 BIT_MASK 0x1fff FORMAT "%8.3" ECU_ADDRESS 0x6000DA00 /end MEASUREMENT
/begin MEASUREMENT DDRC_St.DFC_VlvLftFbOilPSnsrIntk11SRCMax "Debouncing counters / Debounce Timer or Event counter for check DFC_VlvLftFbOilPSnsrIntk11SRCMax" UWORD DFC_OneToOne 1 100 0.00 8191.000 BIT_MASK 0x1fff FORMAT "%8.3" ECU_ADDRESS 0x6000DA02 /end MEASUREMENT
/begin MEASUREMENT DDRC_St.DFC_VlvLftFbOilPSnsrIntk11SRCMin "Debouncing counters / Debounce Timer or Event counter for check DFC_VlvLftFbOilPSnsrIntk11SRCMin" UWORD DFC_OneToOne 1 100 0.00 8191.000 BIT_MASK 0x1fff FORMAT "%8.3" ECU_ADDRESS 0x6000DA04 /end MEASUREMENT
/begin MEASUREMENT DDRC_St.DFC_ClthNpl "Debouncing counters / Debounce Timer or Event counter for check DFC_ClthNpl" UWORD DFC_OneToOne 1 100 0.00 8191.000 BIT_MASK 0x1fff FORMAT "%8.3" ECU_ADDRESS 0x6000DA06 /end MEASUREMENT
/begin MEASUREMENT DDRC_St.DFC_EV1max "Debouncing counters / Debounce Timer or Event counter for check DFC_EV1max" UWORD DFC_OneToOne 1 100 0.00 8191.000 BIT_MASK 0x1fff FORMAT "%8.3" ECU_ADDRESS 0x6000DA08 /end MEASUREMENT
/begin MEASUREMENT DDRC_St.DFC_EV1min "Debouncing counters / Debounce Timer or Event counter for check DFC_EV1min" UWORD DFC_OneToOne 1 100 0.00 8191.000 BIT_MASK 0x1fff FORMAT "%8.3" ECU_ADDRESS 0x6000DA0A /end MEASUREMENT
/begin MEASUREMENT DDRC_St.DFC_EV1sig "Debouncing counters / Debounce Timer or Event counter for check DFC_EV1sig" UWORD DFC_OneToOne 1 100 0.00 8191.000 BIT_MASK 0x1fff FORMAT "%8.3" ECU_ADDRESS 0x6000DA0C /end MEASUREMENT
/begin MEASUREMENT DDRC_St.DFC_EV2max "Debouncing counters / Debounce Timer or Event counter for check DFC_EV2max" UWORD DFC_OneToOne 1 100 0.00 8191.000 BIT_MASK 0x1fff FORMAT "%8.3" ECU_ADDRESS 0x6000DA0E /end MEASUREMENT
/begin MEASUREMENT DDRC_St.DFC_EV2min "Debouncing counters / Debounce Timer or Event counter for check DFC_EV2min" UWORD DFC_OneToOne 1 100 0.00 8191.000 BIT_MASK 0x1fff FORMAT "%8.3" ECU_ADDRESS 0x6000DA10 /end MEASUREMENT
/begin MEASUREMENT DDRC_St.DFC_EV2sig "Debouncing counters / Debounce Timer or Event counter for check DFC_EV2sig" UWORD DFC_OneToOne 1 100 0.00 8191.000 BIT_MASK 0x1fff FORMAT "%8.3" ECU_ADDRESS 0x6000DA12 /end MEASUREMENT
/begin MEASUREMENT DDRC_St.DFC_EV3max "Debouncing counters / Debounce Timer or Event counter for check DFC_EV3max" UWORD DFC_OneToOne 1 100 0.00 8191.000 BIT_MASK 0x1fff FORMAT "%8.3" ECU_ADDRESS 0x6000DA14 /end MEASUREMENT
/begin MEASUREMENT DDRC_St.DFC_EV3min "Debouncing counters / Debounce Timer or Event counter for check DFC_EV3min" UWORD DFC_OneToOne 1 100 0.00 8191.000 BIT_MASK 0x1fff FORMAT "%8.3" ECU_ADDRESS 0x6000DA16 /end MEASUREMENT
/begin MEASUREMENT DDRC_St.DFC_EV3sig "Debouncing counters / Debounce Timer or Event counter for check DFC_EV3sig" UWORD DFC_OneToOne 1 100 0.00 8191.000 BIT_MASK 0x1fff FORMAT "%8.3" ECU_ADDRESS 0x6000DA18 /end MEASUREMENT
/begin MEASUREMENT DDRC_St.DFC_EV4max "Debouncing counters / Debounce Timer or Event counter for check DFC_EV4max" UWORD DFC_OneToOne 1 100 0.00 8191.000 BIT_MASK 0x1fff FORMAT "%8.3" ECU_ADDRESS 0x6000DA1A /end MEASUREMENT
/begin MEASUREMENT DDRC_St.DFC_EV4min "Debouncing counters / Debounce Timer or Event counter for check DFC_EV4min" UWORD DFC_OneToOne 1 100 0.00 8191.000 BIT_MASK 0x1fff FORMAT "%8.3" ECU_ADDRESS 0x6000DA1C /end MEASUREMENT
/begin MEASUREMENT DDRC_St.DFC_EV4sig "Debouncing counters / Debounce Timer or Event counter for check DFC_EV4sig" UWORD DFC_OneToOne 1 100 0.00 8191.000 BIT_MASK 0x1fff FORMAT "%8.3" ECU_ADDRESS 0x6000DA1E /end MEASUREMENT
/begin MEASUREMENT DDRC_St.DFC_GbxPNPosnDrvCdn "Debouncing counters / Debounce Timer or Event counter for check DFC_GbxPNPosnDrvCdn" UWORD DFC_OneToOne 1 100 0.00 8191.000 BIT_MASK 0x1fff FORMAT "%8.3" ECU_ADDRESS 0x6000DA20 /end MEASUREMENT
/begin MEASUREMENT DDRC_St.DFC_GbxPNPosnPlausy "Debouncing counters / Debounce Timer or Event counter for check DFC_GbxPNPosnPlausy" UWORD DFC_OneToOne 1 100 0.00 8191.000 BIT_MASK 0x1fff FORMAT "%8.3" ECU_ADDRESS 0x6000DA22 /end MEASUREMENT
/begin MEASUREMENT DDRC_St.DFC_PEnvCcMax "Debouncing counters / Debounce Timer or Event counter for check DFC_PEnvCcMax" UWORD DFC_OneToOne 1 100 0.00 8191.000 BIT_MASK 0x1fff FORMAT "%8.3" ECU_ADDRESS 0x6000DA24 /end MEASUREMENT
/begin MEASUREMENT DDRC_St.DFC_PEnvCcMin "Debouncing counters / Debounce Timer or Event counter for check DFC_PEnvCcMin" UWORD DFC_OneToOne 1 100 0.00 8191.000 BIT_MASK 0x1fff FORMAT "%8.3" ECU_ADDRESS 0x6000DA26 /end MEASUREMENT
/begin MEASUREMENT DDRC_St.DFC_PEnvRngChkMax "Debouncing counters / Debounce Timer or Event counter for check DFC_PEnvRngChkMax" UWORD DFC_OneToOne 1 100 0.00 8191.000 BIT_MASK 0x1fff FORMAT "%8.3" ECU_ADDRESS 0x6000DA28 /end MEASUREMENT
/begin MEASUREMENT DDRC_St.DFC_PEnvRngChkMin "Debouncing counters / Debounce Timer or Event counter for check DFC_PEnvRngChkMin" UWORD DFC_OneToOne 1 100 0.00 8191.000 BIT_MASK 0x1fff FORMAT "%8.3" ECU_ADDRESS 0x6000DA2A /end MEASUREMENT
/begin MEASUREMENT DDRC_St.DFC_PEnvSnsrPlaus "Debouncing counters / Debounce Timer or Event counter for check DFC_PEnvSnsrPlaus" UWORD DFC_OneToOne 1 100 0.00 8191.000 BIT_MASK 0x1fff FORMAT "%8.3" ECU_ADDRESS 0x6000DA2C /end MEASUREMENT
/begin MEASUREMENT DDRC_St.DFC_UEGOHeatrPsS1B1Max "Debouncing counters / Debounce Timer or Event counter for check DFC_UEGOHeatrPsS1B1Max" UWORD DFC_OneToOne 1 100 0.00 8191.000 BIT_MASK 0x1fff FORMAT "%8.3" ECU_ADDRESS 0x6000DA2E /end MEASUREMENT
/begin MEASUREMENT DDRC_St.DFC_UEGOHeatrPsS1B1Min "Debouncing counters / Debounce Timer or Event counter for check DFC_UEGOHeatrPsS1B1Min" UWORD DFC_OneToOne 1 100 0.00 8191.000 BIT_MASK 0x1fff FORMAT "%8.3" ECU_ADDRESS 0x6000DA30 /end MEASUREMENT
/begin MEASUREMENT DDRC_St.DFC_UEGOHeatrPsS1B1Sig "Debouncing counters / Debounce Timer or Event counter for check DFC_UEGOHeatrPsS1B1Sig" UWORD DFC_OneToOne 1 100 0.00 8191.000 BIT_MASK 0x1fff FORMAT "%8.3" ECU_ADDRESS 0x6000DA32 /end MEASUREMENT
/begin MEASUREMENT DDRC_St.DFC_UEGOHeatrRlyPsOLS1B1 "Debouncing counters / Debounce Timer or Event counter for check DFC_UEGOHeatrRlyPsOLS1B1" UWORD DFC_OneToOne 1 100 0.00 8191.000 BIT_MASK 0x1fff FORMAT "%8.3" ECU_ADDRESS 0x6000DA34 /end MEASUREMENT
/begin MEASUREMENT DDRC_St.DFC_UEGOHeatrRlyPsSCBS1B1 "Debouncing counters / Debounce Timer or Event counter for check DFC_UEGOHeatrRlyPsSCBS1B1" UWORD DFC_OneToOne 1 100 0.00 8191.000 BIT_MASK 0x1fff FORMAT "%8.3" ECU_ADDRESS 0x6000DA36 /end MEASUREMENT
/begin MEASUREMENT DDRC_St.DFC_UEGOHeatrRlyPsSCGS1B1 "Debouncing counters / Debounce Timer or Event counter for check DFC_UEGOHeatrRlyPsSCGS1B1" UWORD DFC_OneToOne 1 100 0.00 8191.000 BIT_MASK 0x1fff FORMAT "%8.3" ECU_ADDRESS 0x6000DA38 /end MEASUREMENT
/begin MEASUREMENT DDRC_St.DFC_KnDetSens1PortAMax "Debouncing counters / Debounce Timer or Event counter for check DFC_KnDetSens1PortAMax" UWORD DFC_OneToOne 1 100 0.00 8191.000 BIT_MASK 0x1fff FORMAT "%8.3" ECU_ADDRESS 0x6000DA3A /end MEASUREMENT
/begin MEASUREMENT DDRC_St.DFC_KnDetSens1PortAMin "Debouncing counters / Debounce Timer or Event counter for check DFC_KnDetSens1PortAMin" UWORD DFC_OneToOne 1 100 0.00 8191.000 BIT_MASK 0x1fff FORMAT "%8.3" ECU_ADDRESS 0x6000DA3C /end MEASUREMENT
/begin MEASUREMENT DDRC_St.DFC_KnDetSens1PortBMax "Debouncing counters / Debounce Timer or Event counter for check DFC_KnDetSens1PortBMax" UWORD DFC_OneToOne 1 100 0.00 8191.000 BIT_MASK 0x1fff FORMAT "%8.3" ECU_ADDRESS 0x6000DA3E /end MEASUREMENT
/begin MEASUREMENT DDRC_St.DFC_KnDetSens1PortBMin "Debouncing counters / Debounce Timer or Event counter for check DFC_KnDetSens1PortBMin" UWORD DFC_OneToOne 1 100 0.00 8191.000 BIT_MASK 0x1fff FORMAT "%8.3" ECU_ADDRESS 0x6000DA40 /end MEASUREMENT
/begin MEASUREMENT DSM_xTabVersion "DSM version indentification signature" UWORD DFC_OneToOne 1 100 0.00 65535.00 FORMAT "%8.2" ECU_ADDRESS 0x60005BF6 /end MEASUREMENT
/begin MEASUREMENT I14229AirCCmpr_stVal "Status information for AC Compressor Device Driver SDA test" UWORD OneToOne 1 100 0.00 65535.00 FORMAT "%8.2" ECU_ADDRESS 0x6000536E /end MEASUREMENT
/begin MEASUREMENT I14229CP_stVal "Status information for Canister Purge Valve SDA test" UWORD OneToOne 1 100 0.00 65535.00 FORMAT "%8.2" ECU_ADDRESS 0x6000536C /end MEASUREMENT
/begin MEASUREMENT I14229Duv_stVal "status information for Air Bypass Solenoid Valve control SDA test" UWORD OneToOne 1 100 0.00 65535.00 FORMAT "%8.2" ECU_ADDRESS 0x6000536A /end MEASUREMENT
/begin MEASUREMENT I14229FanDig_stVal "Status information for FAN control SDA test" UWORD OneToOne 1 100 0.00 65535.00 FORMAT "%8.2" ECU_ADDRESS 0x60005368 /end MEASUREMENT
/begin MEASUREMENT I14229FlPmp_stVal "Status information for Fuel Pump ON or OFF (SDA)" UWORD OneToOne 1 100 0.00 65535.00 FORMAT "%8.2" ECU_ADDRESS 0x60005366 /end MEASUREMENT
/begin MEASUREMENT I14229ICEWP_stVal "Status for ATS test for water charge air cooler EWP control SDA" UWORD OneToOne 1 100 0.00 65535.00 FORMAT "%8.2" ECU_ADDRESS 0x60005364 /end MEASUREMENT
/begin MEASUREMENT I14229InjTstFlg1_stVal "Status information for Injector power stage (Cut injection for each cylinder)SDA test" UWORD OneToOne 1 100 0.00 65535.00 FORMAT "%8.2" ECU_ADDRESS 0x60005362 /end MEASUREMENT
/begin MEASUREMENT I14229InjTstFlg_stVal "Status information for Injector power stage (Cut injection for all cylinder)SDA test" UWORD OneToOne 1 100 0.00 65535.00 FORMAT "%8.2" ECU_ADDRESS 0x60005360 /end MEASUREMENT
/begin MEASUREMENT I14229iocbi_numActivMDA "currently active MDA mode" UWORD OneToOne 1 100 0.00 65535.00 FORMAT "%8.2" ECU_ADDRESS 0x6000533A /end MEASUREMENT
/begin MEASUREMENT I14229iocbi_numActivSFT "Number of the SFT mode active" UWORD OneToOne 1 100 0.00 65535.00 FORMAT "%8.2" ECU_ADDRESS 0x60005338 /end MEASUREMENT
/begin MEASUREMENT I14229iocbi_numDID "Number of the IOBI DID" UWORD OneToOne 1 100 0.00 65535.00 FORMAT "%8.2" ECU_ADDRESS 0x60005336 /end MEASUREMENT
/begin MEASUREMENT I14229iocbi_numResp "Number of the IOBI DID for Byte 5,6" UWORD OneToOne 1 100 0.00 65535.00 FORMAT "%8.2" ECU_ADDRESS 0x60005334 /end MEASUREMENT
/begin MEASUREMENT I14229iocbi_numSt "Number of the IOBI State" UBYTE OneToOne 1 100 0.00 255.0 FORMAT "%5.1" ECU_ADDRESS 0x6000A742 /end MEASUREMENT
/begin MEASUREMENT I14229iocbi_stSFT "Status of the SFT Mode type ( LET or Service Tool)" UBYTE OneToOne 1 100 0.00 255.0 FORMAT "%5.1" ECU_ADDRESS 0x6000A741 /end MEASUREMENT
/begin MEASUREMENT I14229iocpMDA_numABV "Input output by Data Identifier" UWORD OneToOne 1 100 0.00 65535.00 FORMAT "%8.2" ECU_ADDRESS 0x60005332 /end MEASUREMENT
/begin MEASUREMENT I14229iocpMDA_numACGC "input output by Data identifier" UWORD OneToOne 1 100 0.00 65535.00 FORMAT "%8.2" ECU_ADDRESS 0x60005330 /end MEASUREMENT
/begin MEASUREMENT I14229iocpMDA_numAPS "input output by Data identifier" UWORD OneToOne 1 100 0.00 65535.00 FORMAT "%8.2" ECU_ADDRESS 0x6000532E /end MEASUREMENT
/begin MEASUREMENT I14229iocpMDA_numICEWP "Command value for MDA-ICEWP control" UWORD OneToOne 1 100 0.00 65535.00 FORMAT "%8.2" ECU_ADDRESS 0x6000532C /end MEASUREMENT
/begin MEASUREMENT I14229iocpMDA_numPSC "Input output by Data Identifier" UWORD OneToOne 1 100 0.00 65535.00 FORMAT "%8.2" ECU_ADDRESS 0x6000532A /end MEASUREMENT
/begin MEASUREMENT I14229iocpMDA_numRFAN "input output by Data identifier" UWORD OneToOne 1 100 0.00 65535.00 FORMAT "%8.2" ECU_ADDRESS 0x60005328 /end MEASUREMENT
/begin MEASUREMENT I14229iocpMDA_numRvsLck "Input output by Data Identifier" UWORD OneToOne 1 100 0.00 65535.00 FORMAT "%8.2" ECU_ADDRESS 0x60005326 /end MEASUREMENT
/begin MEASUREMENT I14229iocpMDA_numVTEC "input output by Data identifier" UWORD OneToOne 1 100 0.00 65535.00 FORMAT "%8.2" ECU_ADDRESS 0x60005324 /end MEASUREMENT
/begin MEASUREMENT I14229iocpMDA_stABV "Status of request to make Air Bypass Solenoid Valve active through tester" UBYTE OneToOne 1 100 0.00 255.0 FORMAT "%5.1" ECU_ADDRESS 0x6000A740 /end MEASUREMENT
/begin MEASUREMENT I14229iocpMDA_stACGC "status of request to make Alternator Device Driver active through tester" UBYTE OneToOne 1 100 0.00 255.0 FORMAT "%5.1" ECU_ADDRESS 0x6000A73F /end MEASUREMENT
/begin MEASUREMENT I14229iocpMDA_stAPS "status of request to make Accel Pedal Sensor active through tester" UBYTE OneToOne 1 100 0.00 255.0 FORMAT "%5.1" ECU_ADDRESS 0x6000A73E /end MEASUREMENT
/begin MEASUREMENT I14229iocpMDA_stICEWP "status for Water charge air cooler EWP control MDA request through tester" UBYTE OneToOne 1 100 0.00 255.0 FORMAT "%5.1" ECU_ADDRESS 0x6000A73D /end MEASUREMENT
/begin MEASUREMENT I14229iocpMDA_stPSC "Status of request to make Canister Purge Valve active through tester" UBYTE OneToOne 1 100 0.00 255.0 FORMAT "%5.1" ECU_ADDRESS 0x6000A73C /end MEASUREMENT
/begin MEASUREMENT I14229iocpMDA_stRFAN "status of request to make Fan Device Driver active through tester" UBYTE OneToOne 1 100 0.00 255.0 FORMAT "%5.1" ECU_ADDRESS 0x6000A73B /end MEASUREMENT
/begin MEASUREMENT I14229iocpMDA_stRvsLck "Status of request to control Reverse Lock" UBYTE OneToOne 1 100 0.00 255.0 FORMAT "%5.1" ECU_ADDRESS 0x6000A73A /end MEASUREMENT
/begin MEASUREMENT I14229iocpMDA_stVTEC "status of request to make Valve Lift Control active through tester" UBYTE OneToOne 1 100 0.00 255.0 FORMAT "%5.1" ECU_ADDRESS 0x6000A739 /end MEASUREMENT
/begin MEASUREMENT I14229iocp_numCtlSt "input output by Data identifier" UWORD OneToOne 1 100 0.00 65535.00 FORMAT "%8.2" ECU_ADDRESS 0x60005322 /end MEASUREMENT
/begin MEASUREMENT I14229iocp_numEXE "input output by Data identifier" UWORD OneToOne 1 100 0.00 65535.00 FORMAT "%8.2" ECU_ADDRESS 0x60005320 /end MEASUREMENT
/begin MEASUREMENT I14229iocp_numREQ "input output by Data identifier" UWORD OneToOne 1 100 0.00 65535.00 FORMAT "%8.2" ECU_ADDRESS 0x6000531E /end MEASUREMENT
/begin MEASUREMENT I14229iocp_stAInjDAct "status of request to activate Injector power stage through tester" UBYTE OneToOne 1 100 0.00 255.0 FORMAT "%5.1" ECU_ADDRESS 0x60037E70 /end MEASUREMENT
/begin MEASUREMENT I14229iocp_stSFTRJC "input output by Data identifier" UBYTE OneToOne 1 100 0.00 255.0 FORMAT "%5.1" ECU_ADDRESS 0x6000A738 /end MEASUREMENT
/begin MEASUREMENT I14229MDAAltIO_stVal "Status information for Alternator Device Driver( Alternator Generating Voltage Test)" UWORD OneToOne 1 100 0.00 65535.00 FORMAT "%8.2" ECU_ADDRESS 0x6000535C /end MEASUREMENT
/begin MEASUREMENT I14229MDAAPS_stVal "Status information for Accel Pedal Sensor (Change target throttle angle by tester)" UWORD OneToOne 1 100 0.00 65535.00 FORMAT "%8.2" ECU_ADDRESS 0x6000535E /end MEASUREMENT
/begin MEASUREMENT I14229MDACP_stVal "Status information for Canister Purge Valve MDA test" UWORD OneToOne 1 100 0.00 65535.00 FORMAT "%8.2" ECU_ADDRESS 0x6000535A /end MEASUREMENT
/begin MEASUREMENT I14229MDADuv_stVal "Status information for Air Bypass Solenoid Valve MDA test" UWORD OneToOne 1 100 0.00 65535.00 FORMAT "%8.2" ECU_ADDRESS 0x60005358 /end MEASUREMENT
/begin MEASUREMENT I14229MDAFAN_stVal "Status information for FAN control MDA test" UWORD OneToOne 1 100 0.00 65535.00 FORMAT "%8.2" ECU_ADDRESS 0x60005356 /end MEASUREMENT
/begin MEASUREMENT I14229MDAICEWP_stVal "Status for ATS test for water charge air cooler EWP control MDA" UWORD OneToOne 1 100 0.00 65535.00 FORMAT "%8.2" ECU_ADDRESS 0x60005354 /end MEASUREMENT
/begin MEASUREMENT I14229MDARvsLck_stVal "Status information for Reverse Lock" UWORD OneToOne 1 100 0.00 65535.00 FORMAT "%8.2" ECU_ADDRESS 0x60005352 /end MEASUREMENT
/begin MEASUREMENT I14229MDAVTEC_stVal "Status information for Valve Lift Control (Make VTEC Solenoid ON or OFF) by MDA test" UWORD OneToOne 1 100 0.00 65535.00 FORMAT "%8.2" ECU_ADDRESS 0x60005350 /end MEASUREMENT
/begin MEASUREMENT I14229PHAACTRINTK_stVal "Status information for Intake Camshaft Phase SDA test" UWORD OneToOne 1 100 0.00 65535.00 FORMAT "%8.2" ECU_ADDRESS 0x6000534E /end MEASUREMENT
/begin MEASUREMENT I14229PHAACTROUTL_stVal "Status information for Outlet Camshaft Phase SDA test" UWORD OneToOne 1 100 0.00 65535.00 FORMAT "%8.2" ECU_ADDRESS 0x6000534C /end MEASUREMENT
/begin MEASUREMENT I14229rcCrCtl_stLmp "Cruise Control Lamp on/off drive signal" UBYTE OneToOne 1 100 0.00 255.0 FORMAT "%5.1" ECU_ADDRESS 0x6000A37F /end MEASUREMENT
/begin MEASUREMENT I14229ThrVlv_stVal "Status information for throttle valve MDA test" UWORD OneToOne 1 100 0.00 65535.00 FORMAT "%8.2" ECU_ADDRESS 0x6000534A /end MEASUREMENT
/begin MEASUREMENT I14229TrbCh_stVal "Status information for Turbor Charge Bank 1 SDA test" UWORD OneToOne 1 100 0.00 65535.00 FORMAT "%8.2" ECU_ADDRESS 0x60005348 /end MEASUREMENT
/begin MEASUREMENT I14229VlvLft_stVal "Status information for Throttle valve SDA test" UWORD OneToOne 1 100 0.00 65535.00 FORMAT "%8.2" ECU_ADDRESS 0x60005346 /end MEASUREMENT
/begin MEASUREMENT I14229_nrABSFailCncl "Possible number of ABS fail safe action canceller execution" UBYTE OneToOne 1 100 0.00 255.0 FORMAT "%5.1" ECU_ADDRESS 0x6000A397 /end MEASUREMENT
/begin MEASUREMENT I14229_stABSFailCnclActv "Status of ABS fail safe action activation" UBYTE OneToOne 1 100 0.00 255.0 FORMAT "%5.1" ECU_ADDRESS 0x6000A393 /end MEASUREMENT
/begin MEASUREMENT I14229_stABSFailCnclStart_mp "ABS fail safe action canceller start request flag" UBYTE OneToOne 1 100 0.00 255.0 FORMAT "%5.1" ECU_ADDRESS 0x70008DB5 /end MEASUREMENT
/begin MEASUREMENT I14229_stABSFailCnclStop_mp "ABS fail safe action canceller stop request flag" UBYTE OneToOne 1 100 0.00 255.0 FORMAT "%5.1" ECU_ADDRESS 0x70008DB4 /end MEASUREMENT
/begin MEASUREMENT I14229_stACCompDeActvOn "Status of A/C clutch operating Limit Action" UBYTE OneToOne 1 100 0.00 255.0 FORMAT "%5.1" ECU_ADDRESS 0x6000A392 /end MEASUREMENT
/begin MEASUREMENT I14229_stACCompDeActvReq "Status of A/C clutch operating Limit request from the Tester" UBYTE OneToOne 1 100 0.00 255.0 FORMAT "%5.1" ECU_ADDRESS 0x6000A391 /end MEASUREMENT
/begin MEASUREMENT I14229_stAirVent "AirVent test status" UBYTE OneToOne 1 100 0.00 255.0 FORMAT "%5.1" ECU_ADDRESS 0x6000A6DA /end MEASUREMENT
/begin MEASUREMENT I14229_stEepStoreEepramRc "Status of programming learning values" UBYTE OneToOne 1 100 0.00 255.0 FORMAT "%5.1" ECU_ADDRESS 0x6000A74D /end MEASUREMENT
/begin MEASUREMENT I14229_stFlPmpReq "status of request to make puel pump ON through tester" UBYTE OneToOne 1 100 0.00 255.0 FORMAT "%5.1" ECU_ADDRESS 0x6000A74C /end MEASUREMENT
/begin MEASUREMENT I14229_stHpFlInjCdnIdl "Operation status of high pressure fuel injection routine" UBYTE OneToOne 1 100 0.00 255.0 FORMAT "%5.1" ECU_ADDRESS 0x6000A74B /end MEASUREMENT
/begin MEASUREMENT I14229_stIdlStopCdn "Idle stop condition relieve mode status flag" UBYTE OneToOne 1 100 0.00 255.0 FORMAT "%5.1" ECU_ADDRESS 0x6000A041 /end MEASUREMENT
/begin MEASUREMENT I14229_stIdlStopPhd "Status of Idling stop prohibition mode request" UBYTE OneToOne 1 100 0.00 255.0 FORMAT "%5.1" ECU_ADDRESS 0x6000A74A /end MEASUREMENT
/begin MEASUREMENT I14229_stMDA "status of requested DID is an MDA request." UBYTE OneToOne 1 100 0.00 255.0 FORMAT "%5.1" ECU_ADDRESS 0x6000A749 /end MEASUREMENT
/begin MEASUREMENT I14229_stOilFlowCompl "Signal corresponding to Status of oil flow completion" UBYTE OneToOne 1 100 0.00 255.0 FORMAT "%5.1" ECU_ADDRESS 0x6000A389 /end MEASUREMENT
/begin MEASUREMENT I14229_stSDA "status of requested DID is an SDA request." UBYTE OneToOne 1 100 0.00 255.0 FORMAT "%5.1" ECU_ADDRESS 0x6000A748 /end MEASUREMENT
/begin MEASUREMENT I14229_tiOilFlowCompl "Signal corresponding to oil flow completion time" UBYTE Time_sec_q1_COMPU 1 100 0.00 255.0 FORMAT "%5.1" ECU_ADDRESS 0x6000A383 /end MEASUREMENT
/begin FUNCTION DcmDspUDS_IOCBI "63.0.0_6.4.0DCM UDS Input Output Control By Identifier"
 /begin DEF_CHARACTERISTIC I14229iocbi_agPHAACTRINTK1_C I14229iocbi_agPHAACTRINTK2_C I14229iocbi_agPHAACTRINTK3_C I14229iocbi_agPHAACTROUTL1_C I14229iocbi_agPHAACTROUTL2_C I14229iocbi_agPHAACTROUTL3_C I14229iocbi_nCP_C I14229iocbi_nHiRpmColdStrtFlPmp_C I14229iocbi_nInjVlvCyl_C I14229iocbi_nInjVlv_C I14229iocbi_nRvsLck_C I14229iocbi_nTrbCh_C I14229iocbi_numAirCCmpr_C I14229iocbi_numAPP_C I14229iocbi_numCP_C I14229iocbi_numDuv_C I14229iocbi_numFanDig_C I14229iocbi_numFlPmp_C I14229iocbi_numInjTstFlg1_C I14229iocbi_numInjTstFlg_C I14229iocbi_numMDAAltIO_C I14229iocbi_numMDACP_C I14229iocbi_numMDADuv_C I14229iocbi_numMDAFanDig_C I14229iocbi_numMDAICEWP_C I14229iocbi_numMDAVlvLft_C I14229iocbi_numPHAACTRINTK_C I14229iocbi_numPHAACTROUTL_C I14229iocbi_numRvsLck_C I14229iocbi_numSDAICEWP_C I14229iocbi_numThrVlv_C I14229iocbi_numTrbCh_C I14229iocbi_numVlvLft_C I14229iocbi_nVlvLftHi_C I14229iocbi_nVlvLftLo_C I14229iocbi_rDuv1_C I14229iocbi_rDuv2_C I14229iocbi_rMDADuv1_C I14229iocbi_rMDADuv2_C I14229iocbi_rTrbChCls_C I14229iocbi_rTrbChOpen_C I14229iocbi_tFanDig_C I14229iocbi_tInjTstCylHi_C I14229iocbi_tInjTstCylLo_C I14229iocbi_tPHAACTRINTKHi_C I14229iocbi_tPHAACTRINTKLo_C I14229iocbi_tPHAACTROUTLHi_C I14229iocbi_tPHAACTROUTLLo_C I14229iocbi_tVlvLft_C I14229iocbi_uAirCCmpr_C I14229iocbi_uCPRun_C I14229iocbi_uCP_C I14229iocbi_uDuvRun_C I14229iocbi_uDuv_C I14229iocbi_uFanDigRun_C I14229iocbi_uFanDigStl_C I14229iocbi_uFlPmpRun_C I14229iocbi_uFlPmpStl_C I14229iocbi_uInjTstRun_C I14229iocbi_uInjTstStl_C I14229iocbi_uMDACPRun_C I14229iocbi_uMDACP_C I14229iocbi_uMDADuvRun_C I14229iocbi_uMDADuv_C I14229iocbi_uPHAACTRINTKRun_C I14229iocbi_uPHAACTRINTKStl_C I14229iocbi_uPHAACTROUTL_C I14229iocbi_uThrVlv_C I14229iocbi_uTrbCh_C I14229iocbi_uVlvLftRun_C I14229iocbi_uVlvLftStl_C I14229iocbi_vAPP_C I14229iocbi_vRvsLck_C I14229_AirCCmpr_stMsk_CA I14229_AltIO_stMskMDA_CA I14229_APP_stMskMDA_CA I14229_CP_stMskMDA_CA I14229_CP_stMsk_CA I14229_Duv_stMskMDA_CA I14229_Duv_stMsk_CA I14229_FanDig_stMskMDA_CA I14229_FanDig_stMsk_CA I14229_FlPmp_stMsk_CA I14229_ICEWP_stMskMDA_CA I14229_ICEWP_stMsk_CA I14229_InjTst1_stMsk_CA I14229_InjTst_stMsk_CA I14229_PHAACTRINTK_stMsk_CA I14229_PHAACTROUTL_stMsk_CA I14229_rAppLETThd_C I14229_ratCoolg_C I14229_RvsLck_stMskMDA_CA I14229_stCACPmpRlyOFF_C I14229_stCACPmpRlyON_C I14229_stIOCBIMskSuprtMDA_C I14229_stIOCBIMskSuprtSDA_C I14229_ThrVlv_stMsk_CA I14229_tiThrVlvMax_C I14229_TrbCh_stMsk_CA I14229_VlvLft_stMskMDA_CA I14229_VlvLft_stMsk_CA I14229_wACT_C I14229_wFlPmp_C I14229_wRvsLck_C /end DEF_CHARACTERISTIC
 /begin IN_MEASUREMENT AirC_stSwt APP_r APP_rAppPrev APP_stLETAbort BattU_u Brk_st CACPmp_uPlausyHiThd CACPmp_uPlausyLoThd CEngDsT_t Clth_st CoEng_st Epm_nEng HLSDem_nSetPLo I14229_ps_w I14229_stForceActvTmr I14229_stPHAACTRINTKTmr I14229_stPHAACTROUTLTmr MoFETC_flgMonDiagEnaPlausMsg VehV_v wped_w /end IN_MEASUREMENT
 /begin OUT_MEASUREMENT I14229AirCCmpr_stVal I14229CP_stVal I14229Duv_stVal I14229FanDig_stVal I14229FlPmp_stVal I14229ICEWP_stVal I14229InjTstFlg1_stVal I14229InjTstFlg_stVal I14229iocbi_numActivMDA I14229iocbi_numActivSFT I14229iocbi_numDID I14229iocbi_numResp I14229iocbi_numSt I14229iocbi_stSFT I14229iocpMDA_numABV I14229iocpMDA_numACGC I14229iocpMDA_numAPS I14229iocpMDA_numICEWP I14229iocpMDA_numPSC I14229iocpMDA_numRFAN I14229iocpMDA_numRvsLck I14229iocpMDA_numVTEC I14229iocpMDA_stABV I14229iocpMDA_stACGC I14229iocpMDA_stAPS I14229iocpMDA_stICEWP I14229iocpMDA_stPSC I14229iocpMDA_stRFAN I14229iocpMDA_stRvsLck I14229iocpMDA_stVTEC I14229iocp_numCtlSt I14229iocp_numEXE I14229iocp_numREQ I14229iocp_stAInjDAct I14229iocp_stSFTRJC I14229MDAAltIO_stVal I14229MDAAPS_stVal I14229MDACP_stVal I14229MDADuv_stVal I14229MDAFAN_stVal I14229MDAICEWP_stVal I14229MDARvsLck_stVal I14229MDAVTEC_stVal I14229PHAACTRINTK_stVal I14229PHAACTROUTL_stVal I14229ThrVlv_stVal I14229TrbCh_stVal I14229VlvLft_stVal I14229_stAirVent I14229_stFlPmpReq I14229_stMDA I14229_stSDA /end OUT_MEASUREMENT
 FUNCTION_VERSION "63.0.0_6.4.0" /end FUNCTION
/begin FUNCTION DcmDspUDS_RDTC "44.1.0    DCM UDS Read DTC Information"
 /begin DEF_CHARACTERISTIC I14229_ctTxWaitRepDTC_C I14229_ctTxWaitSuppDTC_C I14229_ctWaitNumDTC_C I14229_ctWaitRepDTC_C I14229_ctWaitSuppDTC_C I14229_swtDTCLowByte_C /end DEF_CHARACTERISTIC
 FUNCTION_VERSION "44.1.0" /end FUNCTION
/begin FUNCTION DcmDspUDS_RID "47.1.0_6.1.0Configuration and Implementation of the Routines for the DCM UDS Service RoutineControl (RC)"
 /begin DEF_CHARACTERISTIC I14229_iACCompCmprSol_C I14229_nACSafHysHi_C I14229_nACSafHysLo_C I14229_nEngHysHi_C I14229_nEngHysLo_C I14229_nHpFlInjCdnIdlHi_C I14229_nHpFlInjCdnIdlLo_C I14229_nrABSFailCnclMax_C I14229_nrABSFailCnclSubs_C I14229_stACCompDeActvReqSubs_C I14229_stOilFlowComplSubs_C I14229_tHpFlInjCdnIdlHi_C I14229_tHpFlInjCdnIdlLo_C I14229_tiOilFlowComplSubs_C I14229_uHpFlInjCdnIdl_C I14229_vHpFlInjCdnIdl_C I14229_vRCCrCtl_C /end DEF_CHARACTERISTIC
 /begin IN_MEASUREMENT ACCI_aReq AirC_stPsCmpr Epm_nEng I14229_stSuppRst StSpSwt_stSelTyp T15_st VehV_v /end IN_MEASUREMENT
 /begin OUT_MEASUREMENT arqtprs_w_msg B_rqtprsol_msg I14229rcCrCtl_stLmp I14229_nrABSFailCncl I14229_stABSFailCnclActv I14229_stABSFailCnclStart_mp I14229_stABSFailCnclStop_mp I14229_stACCompDeActvOn I14229_stACCompDeActvReq I14229_stHpFlInjCdnIdl I14229_stIdlStopCdn I14229_stOilFlowCompl I14229_tiOilFlowCompl /end OUT_MEASUREMENT
 /begin LOC_MEASUREMENT I14229_stEepStoreEepramRc I14229_stIdlStopPhd /end LOC_MEASUREMENT
 FUNCTION_VERSION "47.1.0_6.1.0" /end FUNCTION
/begin FUNCTION DcmDspUDS_RMBA "10.1.0_1.0.0DCM UDS Read Memory By Address"
 /begin DEF_CHARACTERISTIC I14229_dRMBAEna_C I14229_stRMBADFlashBlkEna_C I14229_stRMBADS0BlkEna_C I14229_stRMBASecuEna_C /end DEF_CHARACTERISTIC
 FUNCTION_VERSION "10.1.0_1.0.0" /end FUNCTION
/begin FUNCTION DDRC "30000.21.1Diagnostic Debounce and Report of Check"
 /begin DEF_CHARACTERISTIC DDRC_DurDeb.AirC_tiCmprOLDebOk_C DDRC_DurDeb.AirC_tiCmprOLDebDef_C DDRC_DurDeb.AirC_tiCmprOvrTempDebOk_C DDRC_DurDeb.AirC_tiCmprOvrTempDebDef_C DDRC_DurDeb.AirC_tiCmprSCBDebOk_C DDRC_DurDeb.AirC_tiCmprSCBDebDef_C DDRC_DurDeb.AirC_tiCmprSCGDebOk_C DDRC_DurDeb.AirC_tiCmprSCGDebDef_C DDRC_DurDeb.Alt_tiErrDebOk_C DDRC_DurDeb.Alt_tiErrDebDef_C DDRC_DurDeb.BattU_tiMaxDebOk_C DDRC_DurDeb.BattU_tiMaxDebDef_C DDRC_DurDeb.BattU_tiMinDebOk_C DDRC_DurDeb.BattU_tiMinDebDef_C DDRC_DurDeb.Com_tiChksTCU1DebOk_C DDRC_DurDeb.Com_tiChksTCU1DebDef_C DDRC_DurDeb.Com_tiChksTCU11DebOk_C DDRC_DurDeb.Com_tiChksTCU11DebDef_C DDRC_DurDeb.Com_tiChksTCU12DebOk_C DDRC_DurDeb.Com_tiChksTCU12DebDef_C DDRC_DurDeb.Com_tiChksTCU13DebOk_C DDRC_DurDeb.Com_tiChksTCU13DebDef_C DDRC_DurDeb.Com_tiChksTCU2DebOk_C DDRC_DurDeb.Com_tiChksTCU2DebDef_C DDRC_DurDeb.Com_tiChksTCU3DebOk_C DDRC_DurDeb.Com_tiChksTCU3DebDef_C DDRC_DurDeb.Com_tiChksTCU4DebOk_C DDRC_DurDeb.Com_tiChksTCU4DebDef_C DDRC_DurDeb.Com_tiCntTCU1DebOk_C DDRC_DurDeb.Com_tiCntTCU1DebDef_C DDRC_DurDeb.Com_tiCntTCU11DebOk_C DDRC_DurDeb.Com_tiCntTCU11DebDef_C DDRC_DurDeb.Com_tiCntTCU12DebOk_C DDRC_DurDeb.Com_tiCntTCU12DebDef_C DDRC_DurDeb.Com_tiCntTCU13DebOk_C DDRC_DurDeb.Com_tiCntTCU13DebDef_C DDRC_DurDeb.Com_tiCntTCU2DebOk_C DDRC_DurDeb.Com_tiCntTCU2DebDef_C DDRC_DurDeb.Com_tiCntTCU3DebOk_C DDRC_DurDeb.Com_tiCntTCU3DebDef_C DDRC_DurDeb.Com_tiCntTCU4DebOk_C DDRC_DurDeb.Com_tiCntTCU4DebDef_C DDRC_DurDeb.Com_tiTOutTCU01DebOk_C DDRC_DurDeb.Com_tiTOutTCU01DebDef_C DDRC_DurDeb.Com_tiTOutTCU02DebOk_C DDRC_DurDeb.Com_tiTOutTCU02DebDef_C DDRC_DurDeb.Com_tiTOutTCU1DebOk_C DDRC_DurDeb.Com_tiTOutTCU1DebDef_C DDRC_DurDeb.Com_tiTOutTCU11DebOk_C DDRC_DurDeb.Com_tiTOutTCU11DebDef_C DDRC_DurDeb.Com_tiTOutTCU12DebOk_C DDRC_DurDeb.Com_tiTOutTCU12DebDef_C DDRC_DurDeb.Com_tiTOutTCU13DebOk_C DDRC_DurDeb.Com_tiTOutTCU13DebDef_C DDRC_DurDeb.Com_tiTOutTCU14DebOk_C DDRC_DurDeb.Com_tiTOutTCU14DebDef_C DDRC_DurDeb.Com_tiTOutTCU2DebOk_C DDRC_DurDeb.Com_tiTOutTCU2DebDef_C DDRC_DurDeb.Com_tiTOutTCU3DebOk_C DDRC_DurDeb.Com_tiTOutTCU3DebDef_C DDRC_DurDeb.Com_tiTOutTCU4DebOk_C DDRC_DurDeb.Com_tiTOutTCU4DebDef_C DDRC_DurDeb.DevLib_tiBattUHiDebOk_C DDRC_DurDeb.DevLib_tiBattUHiDebDef_C DDRC_DurDeb.DevLib_tiBattULoDebOk_C DDRC_DurDeb.DevLib_tiBattULoDebDef_C DDRC_DurDeb.Fan_tiDIOOLDebOk_C DDRC_DurDeb.Fan_tiDIOOLDebDef_C DDRC_DurDeb.Fan_tiDIOOvrTempDebOk_C DDRC_DurDeb.Fan_tiDIOOvrTempDebDef_C DDRC_DurDeb.Fan_tiDIOSCBDebOk_C DDRC_DurDeb.Fan_tiDIOSCBDebDef_C DDRC_DurDeb.Fan_tiDIOSCGDebOk_C DDRC_DurDeb.Fan_tiDIOSCGDebDef_C DDRC_DurDeb.MRlyDcOL_tisigOLDebOk_C DDRC_DurDeb.MRlyDcOL_tisigOLDebDef_C DDRC_DurDeb.MRlyDcSCB_tisigSCBDebOk_C DDRC_DurDeb.MRlyDcSCB_tisigSCBDebDef_C DDRC_DurDeb.MRlyDcSCG_tisigSCGDebOk_C DDRC_DurDeb.MRlyDcSCG_tisigSCGDebDef_C DDRC_DurDeb.PSP_tiOLDebOk_C DDRC_DurDeb.PSP_tiOLDebDef_C DDRC_DurDeb.PSP_tiOvrTempDebOk_C DDRC_DurDeb.PSP_tiOvrTempDebDef_C DDRC_DurDeb.PSP_tiSCBDebOk_C DDRC_DurDeb.PSP_tiSCBDebDef_C DDRC_DurDeb.PSP_tiSCGDebOk_C DDRC_DurDeb.PSP_tiSCGDebDef_C DDRC_DurDeb.T50_tiErrDebOk_C DDRC_DurDeb.T50_tiErrDebDef_C DDRC_DurDeb.ThrVlv_tiLoBattB1DebOk_C DDRC_DurDeb.ThrVlv_tiLoBattB1DebDef_C DDRC_DurDeb.VehV_tiOLDebOk_C DDRC_DurDeb.VehV_tiOLDebDef_C DDRC_DurDeb.VehV_tiOTDebOk_C DDRC_DurDeb.VehV_tiOTDebDef_C DDRC_DurDeb.VehV_tiPhysRngHiDebOk_C DDRC_DurDeb.VehV_tiPhysRngHiDebDef_C DDRC_DurDeb.VehV_tiSCBDebOk_C DDRC_DurDeb.VehV_tiSCBDebDef_C DDRC_DurDeb.VehV_tiSCGDebOk_C DDRC_DurDeb.VehV_tiSCGDebDef_C DDRC_DurDeb.VehV_tiSnsrARngHiDebOk_C DDRC_DurDeb.VehV_tiSnsrARngHiDebDef_C DDRC_DurDeb.VehV_tiSnsrBRngHiDebOk_C DDRC_DurDeb.VehV_tiSnsrBRngHiDebDef_C DDRC_DurDeb.VehV_tiSpdRtyDiagDebOk_C DDRC_DurDeb.VehV_tiSpdRtyDiagDebDef_C DDRC_DurDeb.VehV_ctWhlErrDebOk_C DDRC_DurDeb.VehV_ctWhlErrDebDef_C DDRC_DurDeb.ACEvpT_tiSRCMaxDebOk_C DDRC_DurDeb.ACEvpT_tiSRCMaxDebDef_C DDRC_DurDeb.ACEvpT_tiSRCMinDebOk_C DDRC_DurDeb.ACEvpT_tiSRCMinDebDef_C DDRC_DurDeb.AirC_tiClntSRCMaxDebOk_C DDRC_DurDeb.AirC_tiClntSRCMaxDebDef_C DDRC_DurDeb.AirC_tiClntSRCMinDebOk_C DDRC_DurDeb.AirC_tiClntSRCMinDebDef_C DDRC_DurDeb.AirC_tiSwtNplDebOk_C DDRC_DurDeb.AirC_tiSwtNplDebDef_C DDRC_DurDeb.AirC_tiSwtSigDebOk_C DDRC_DurDeb.AirC_tiSwtSigDebDef_C DDRC_DurDeb.Brk_tiDebOk_C DDRC_DurDeb.Brk_tiDebDef_C DDRC_DurDeb.Brk_tiSigDebOk_C DDRC_DurDeb.Brk_tiSigDebDef_C DDRC_DurDeb.Clth_tiSigDebOk_C DDRC_DurDeb.Clth_tiSigDebDef_C DDRC_DurDeb.HLSDem_tiOvhtDebOk_C DDRC_DurDeb.HLSDem_tiOvhtDebDef_C DDRC_DurDeb.Oil_tiNplPDebOk_C DDRC_DurDeb.Oil_tiNplPDebDef_C DDRC_DurDeb.PIntkVUs_tiLineHiB1DebOk_C DDRC_DurDeb.PIntkVUs_tiLineHiB1DebDef_C DDRC_DurDeb.PIntkVUs_tiLineLoB1DebOk_C DDRC_DurDeb.PIntkVUs_tiLineLoB1DebDef_C DDRC_DurDeb.VehV_tiPhysRngLoDebOk_C DDRC_DurDeb.VehV_tiPhysRngLoDebDef_C DDRC_DurDeb.VehV_tiSigCanDebOk_C DDRC_DurDeb.VehV_tiSigCanDebDef_C DDRC_DurDeb.VehV_tiSigCanSafeDebOk_C DDRC_DurDeb.VehV_tiSigCanSafeDebDef_C DDRC_DurDeb.VlvLft_tiSRCMaxOilPSnsrIntk11DebOk_C DDRC_DurDeb.VlvLft_tiSRCMaxOilPSnsrIntk11DebDef_C DDRC_DurDeb.VlvLft_tiSRCMinOilPSnsrIntk11DebOk_C DDRC_DurDeb.VlvLft_tiSRCMinOilPSnsrIntk11DebDef_C DDRC_DurDeb.Clth_numPlaDebOk_C DDRC_DurDeb.Clth_numPlaDebDef_C DDRC_DurDeb.Gbx_numPNPosnDrvCdnDebOk_C DDRC_DurDeb.Gbx_numPNPosnDrvCdnDebDef_C DDRC_DurDeb.Gbx_numPNPosnPlausyDebOk_C DDRC_DurDeb.Gbx_numPNPosnPlausyDebDef_C DDRC_DurDeb.InjVvG_numOLDebOk_C DDRC_DurDeb.InjVvG_numOLDebDef_C DDRC_DurDeb.InjVvG_numSCBDebOk_C DDRC_DurDeb.InjVvG_numSCBDebDef_C DDRC_DurDeb.InjVvG_numSCGDebOk_C DDRC_DurDeb.InjVvG_numSCGDebDef_C DDRC_DurDeb.AltIO_tiACGFailrDebOk_C DDRC_DurDeb.AltIO_tiACGFailrDebDef_C DDRC_DurDeb.AltIO_tiACGHiVltgDebOk_C DDRC_DurDeb.AltIO_tiACGHiVltgDebDef_C DDRC_DurDeb.AltIO_tiACGLoVltgDebOk_C DDRC_DurDeb.AltIO_tiACGLoVltgDebDef_C DDRC_DurDeb.AltIO_tiACGTHiDebOk_C DDRC_DurDeb.AltIO_tiACGTHiDebDef_C DDRC_DurDeb.AltIO_tiDConnACGDebOk_C DDRC_DurDeb.AltIO_tiDConnACGDebDef_C DDRC_DurDeb.BattU_tiHiFailrDebOk_C DDRC_DurDeb.BattU_tiHiFailrDebDef_C DDRC_DurDeb.BattU_tiLoFailrDebOk_C DDRC_DurDeb.BattU_tiLoFailrDebDef_C DDRC_DurDeb.BrkBstP_tiDriftHiErrDebOk_C DDRC_DurDeb.BrkBstP_tiDriftHiErrDebDef_C DDRC_DurDeb.BrkBstP_tiDriftLoErrDebOk_C DDRC_DurDeb.BrkBstP_tiDriftLoErrDebDef_C DDRC_DurDeb.BrkBstP_tiSnsrStuckDebOk_C /end DEF_CHARACTERISTIC
 /begin IN_MEASUREMENT Dem_disableEventStatusUpdateGroup /end IN_MEASUREMENT
 /begin LOC_MEASUREMENT DDRC_St.DFC_AltIOACGFailr DDRC_St.DFC_AltIOACGHiVltg DDRC_St.DFC_AltIOACGLoVltg DDRC_St.DFC_AltIOACGTHi DDRC_St.DFC_AltIODConnACG DDRC_St.DFC_BattUHiFailr DDRC_St.DFC_BattULoFailr DDRC_St.DFC_BrkBstPDriftHiErr DDRC_St.DFC_BrkBstPDriftLoErr DDRC_St.DFC_BrkBstPSnsrStuck DDRC_St.DFC_BrkMnSwtContOn DDRC_St.DFC_BrkMnSwtNotStp DDRC_St.DFC_BrkNpl DDRC_St.DFC_BrkRdntSwtContOn DDRC_St.DFC_BrkRdntSwtNotStp DDRC_St.DFC_Clth3ONStuck DDRC_St.DFC_Clth4OFFStuck DDRC_St.DFC_ClthOFFStuck DDRC_St.DFC_ClthONStuck DDRC_St.DFC_ClthStkFailInfo DDRC_St.DFC_ComACFailInfo DDRC_St.DFC_ComATFTValErr DDRC_St.DFC_ComATMILReq DDRC_St.DFC_ComAYCAChksum DDRC_St.DFC_ComAYCARingCnt DDRC_St.DFC_ComAYCATOut DDRC_St.DFC_ComAYCDChkSum DDRC_St.DFC_ComAYCDTOut DDRC_St.DFC_ComAYCFChksum DDRC_St.DFC_ComAYCFRingCnt DDRC_St.DFC_ComAYCFTOut DDRC_St.DFC_ComAYCGChksum DDRC_St.DFC_ComAYCGRingCnt DDRC_St.DFC_ComAYCGTOut DDRC_St.DFC_ComAYCIChkSum DDRC_St.DFC_ComAYCIRingCnt DDRC_St.DFC_ComAYCITOut DDRC_St.DFC_ComBCM1ChkSum DDRC_St.DFC_ComBCM1RingCnt DDRC_St.DFC_ComBCM1TOut DDRC_St.DFC_ComCANABusOffErr DDRC_St.DFC_ComCANBBusOffErr DDRC_St.DFC_ComCANCBusOffErr DDRC_St.DFC_ComCGW1ChkSum DDRC_St.DFC_ComCGW1RingCnt DDRC_St.DFC_ComCGW1TOut DDRC_St.DFC_ComConvBoostErr DDRC_St.DFC_ComConvSlipErr DDRC_St.DFC_ComEAT10Chksum DDRC_St.DFC_ComEAT10RingCnt DDRC_St.DFC_ComEAT10TOut DDRC_St.DFC_ComEAT11ChkSum DDRC_St.DFC_ComEAT11RingCnt DDRC_St.DFC_ComEAT11TOut DDRC_St.DFC_ComEAT12ChkSum DDRC_St.DFC_ComEAT12RingCnt DDRC_St.DFC_ComEAT12TOut DDRC_St.DFC_ComEAT13ChkSum DDRC_St.DFC_ComEAT13RingCnt DDRC_St.DFC_ComEAT13TOut DDRC_St.DFC_ComEAT1Chksum DDRC_St.DFC_ComEAT1RingCnt DDRC_St.DFC_ComEAT1TOut DDRC_St.DFC_ComEAT2ChkSum DDRC_St.DFC_ComEAT2RingCnt DDRC_St.DFC_ComEAT2TOut DDRC_St.DFC_ComEAT4ChkSum DDRC_St.DFC_ComEAT4RingCnt DDRC_St.DFC_ComEAT4TOut DDRC_St.DFC_ComEAT6Chksum DDRC_St.DFC_ComEAT6RingCnt DDRC_St.DFC_ComEAT6TOut DDRC_St.DFC_ComEAT7Chksum DDRC_St.DFC_ComEAT7RingCnt DDRC_St.DFC_ComEAT7TOut DDRC_St.DFC_ComEAT8Chksum DDRC_St.DFC_ComEAT8RingCnt DDRC_St.DFC_ComEAT8TOut DDRC_St.DFC_ComEATAChksum DDRC_St.DFC_ComEATARingCnt DDRC_St.DFC_ComEATATOut DDRC_St.DFC_ComEATBChkSum DDRC_St.DFC_ComEATBRingCnt DDRC_St.DFC_ComEATBTOut DDRC_St.DFC_ComEATCChksum DDRC_St.DFC_ComEATCRingCnt DDRC_St.DFC_ComEATCTOut DDRC_St.DFC_ComEBBAChksum DDRC_St.DFC_ComEBBARingCnt DDRC_St.DFC_ComEBBATOut DDRC_St.DFC_ComEPS1Chksum DDRC_St.DFC_ComEPS1RingCnt DDRC_St.DFC_ComEPS1TOut DDRC_St.DFC_ComEngCanRxErr DDRC_St.DFC_ComGrvySnsrErr DDRC_St.DFC_ComGwIMG1ChkSum DDRC_St.DFC_ComGwIMG1RingCnt DDRC_St.DFC_ComGwIMG1TOut DDRC_St.DFC_ComGwIMG3ChkSum DDRC_St.DFC_ComGwIMG3RingCnt DDRC_St.DFC_ComGwIMG3TOut DDRC_St.DFC_ComGwIMG4ChkSum DDRC_St.DFC_ComGwIMG4RingCnt DDRC_St.DFC_ComGwIMG4TOut DDRC_St.DFC_ComGwIMG5ChkSum DDRC_St.DFC_ComGwIMG5RingCnt DDRC_St.DFC_ComGwIMG5TOut DDRC_St.DFC_ComGwIMG6ChkSum DDRC_St.DFC_ComGwIMG6RingCnt DDRC_St.DFC_ComGwIMG6TOut DDRC_St.DFC_ComIDASBChksum DDRC_St.DFC_ComIDASBRingCnt DDRC_St.DFC_ComIDASBTOut DDRC_St.DFC_ComIMGMILReq DDRC_St.DFC_ComISSPrms DDRC_St.DFC_ComMETAChksum DDRC_St.DFC_ComMETARingCnt DDRC_St.DFC_ComMETATOut DDRC_St.DFC_ComMETCChksum DDRC_St.DFC_ComMETCRingCnt DDRC_St.DFC_ComMETCTOut DDRC_St.DFC_ComMETDChksum DDRC_St.DFC_ComMETDRingCnt DDRC_St.DFC_ComMETDTOut DDRC_St.DFC_ComMETE2Chksum DDRC_St.DFC_ComMETE2RingCnt DDRC_St.DFC_ComMETE2TOut DDRC_St.DFC_ComMETFChksum DDRC_St.DFC_ComMETFRingCnt DDRC_St.DFC_ComMETFTOut DDRC_St.DFC_ComMETGChksum DDRC_St.DFC_ComMETGRingCnt DDRC_St.DFC_ComMETGTOut DDRC_St.DFC_ComMETH2Chksum DDRC_St.DFC_ComMETH2RingCnt DDRC_St.DFC_ComMETH2TOut DDRC_St.DFC_ComMETHChksum DDRC_St.DFC_ComMETHRingCnt DDRC_St.DFC_ComMETHTOut DDRC_St.DFC_ComMETIChksum DDRC_St.DFC_ComMETIRingCnt DDRC_St.DFC_ComMETITOut DDRC_St.DFC_ComMETKChksum DDRC_St.DFC_ComMETKRingCnt DDRC_St.DFC_ComMETKTOut DDRC_St.DFC_ComMETLChksum DDRC_St.DFC_ComMETLRingCnt DDRC_St.DFC_ComMETLTOut DDRC_St.DFC_ComMETMChksum DDRC_St.DFC_ComMETMRingCnt DDRC_St.DFC_ComMETMTOut DDRC_St.DFC_ComMETNChksum DDRC_St.DFC_ComMETNRingCnt DDRC_St.DFC_ComMETNTOut DDRC_St.DFC_ComMtrCom DDRC_St.DFC_ComPCUChkSum DDRC_St.DFC_ComPCURingCnt DDRC_St.DFC_ComPCUTOut DDRC_St.DFC_ComSRSAChksum DDRC_St.DFC_ComSRSARingCnt DDRC_St.DFC_ComSRSATOut DDRC_St.DFC_ComSRSBChksum DDRC_St.DFC_ComSRSBRingCnt DDRC_St.DFC_ComSRSBTOut DDRC_St.DFC_ComSRSChksum DDRC_St.DFC_ComSRSErr DDRC_St.DFC_ComSRSRingCnt DDRC_St.DFC_ComSRSTOut DDRC_St.DFC_ComVehSpdPndFltTCU DDRC_St.DFC_EbsChartcCurrErr DDRC_St.DFC_EbsSelfDiagErr DDRC_St.DFC_GbxCANDigPlausErr DDRC_St.DFC_GbxNPos1SRCMax DDRC_St.DFC_GbxNPos1SRCMin DDRC_St.DFC_GbxNPos2SRCMax DDRC_St.DFC_GbxNPos2SRCMin DDRC_St.DFC_GbxNPosAlvChk DDRC_St.DFC_GbxNPosSyncErr DDRC_St.DFC_HEGOS2B1HtrPsMax DDRC_St.DFC_HEGOS2B1HtrPsMin DDRC_St.DFC_HEGOS2B1HtrPsSig DDRC_St.DFC_LinCSErrACG DDRC_St.DFC_LinCSErrEBS DDRC_St.DFC_LinHdrTimeoutErrACG DDRC_St.DFC_LinHdrTimeoutErrEBS DDRC_St.DFC_LinMsgTimeoutErrACG DDRC_St.DFC_LinMsgTimeoutErrEBS DDRC_St.DFC_LinNoStrtComErr DDRC_St.DFC_MisfDetVWhlFrntLeOORHi DDRC_St.DFC_MisfDetVWhlFrntLeRatyHi DDRC_St.DFC_MisfDetVWhlFrntLeRatyLo DDRC_St.DFC_MisfDetVWhlFrntLeStuck DDRC_St.DFC_MisfDetVWhlFrntRiOORHi DDRC_St.DFC_MisfDetVWhlFrntRiRatyHi DDRC_St.DFC_MisfDetVWhlFrntRiRatyLo DDRC_St.DFC_MisfDetVWhlFrntRiStuck DDRC_St.DFC_MisfDetVWhlReLeOORHi DDRC_St.DFC_MisfDetVWhlReLeRatyHi DDRC_St.DFC_MisfDetVWhlReLeRatyLo DDRC_St.DFC_MisfDetVWhlReLeStuck DDRC_St.DFC_MisfDetVWhlReRiOORHi DDRC_St.DFC_MisfDetVWhlReRiRatyHi DDRC_St.DFC_MisfDetVWhlReRiRatyLo DDRC_St.DFC_MisfDetVWhlReRiStuck DDRC_St.DFC_MisfDetdVWhlFrntLePlaus DDRC_St.DFC_MisfDetdVWhlFrntRiPlaus DDRC_St.DFC_MisfDetdVWhlReLePlaus DDRC_St.DFC_MisfDetdVWhlReRiPlaus DDRC_St.DFC_PEnvSigRngMax DDRC_St.DFC_PEnvSigRngMin DDRC_St.DFC_StmFault DDRC_St.DFC_StrtCtOffPth DDRC_St.DFC_StrtCtlErr DDRC_St.DFC_StrtFault DDRC_St.DFC_StrtLckJudg1 DDRC_St.DFC_StrtLckJudg2 DDRC_St.DFC_StrtOL DDRC_St.DFC_StrtOL2 DDRC_St.DFC_StrtSCB DDRC_St.DFC_StrtSCB2 DDRC_St.DFC_StrtSCG DDRC_St.DFC_StrtSCG2 DDRC_St.DFC_StrtStkRly1 DDRC_St.DFC_StrtStkRly2 DDRC_St.DFC_TEVEmax DDRC_St.DFC_TEVEmin DDRC_St.DFC_TEVEsig DDRC_St.DFC_VehVAllPlaus DDRC_St.DFC_VehVNCSnsrElecFailr DDRC_St.DFC_VehVPlausCan DDRC_St.DFC_VehVPlausFco DDRC_St.DFC_VehVPlausPwr DDRC_St.DFC_VehVPlausV2N DDRC_St.DFC_VehVSpdSnsrAElecFailr DDRC_St.DFC_VehVSpdSnsrBElecFailr DDRC_St.DFC_ClthMax DDRC_St.DFC_IgnClPs_DevComErr DDRC_St.DFC_IgnClPs_LineOl_0 DDRC_St.DFC_IgnClPs_LineOl_1 DDRC_St.DFC_IgnClPs_LineOl_2 DDRC_St.DFC_IgnClPs_LineOl_3 DDRC_St.DFC_IgnClPs_LineScb_0 DDRC_St.DFC_IgnClPs_LineScb_1 DDRC_St.DFC_IgnClPs_LineScb_2 DDRC_St.DFC_IgnClPs_LineScb_3 DDRC_St.DFC_IgnClPs_LineScg_0 DDRC_St.DFC_IgnClPs_LineScg_1 DDRC_St.DFC_IgnClPs_LineScg_2 DDRC_St.DFC_IgnClPs_LineScg_3 DDRC_St.DFC_UEGOASICS1B1 DDRC_St.DFC_UEGOOLIPES1B1 DDRC_St.DFC_UEGOOLRES1B1 DDRC_St.DFC_UEGOSCBS1B1 DDRC_St.DFC_UEGOSCGS1B1 DDRC_St.DFC_UEGOSPIS1B1 DDRC_St.DFC_UEGOSnsrS1B1 DDRC_St.DFC_UegoOlApesS1B1 DDRC_St.DFC_UegoOlRCmpS1B1 DDRC_St.DFC_AirCCmprOL DDRC_St.DFC_AirCCmprOvrTemp DDRC_St.DFC_AirCCmprSCB DDRC_St.DFC_AirCCmprSCG DDRC_St.DFC_AltErr DDRC_St.DFC_BattUSRCMax DDRC_St.DFC_BattUSRCMin DDRC_St.DFC_ComChksTCU1 DDRC_St.DFC_ComChksTCU11 DDRC_St.DFC_ComChksTCU12 DDRC_St.DFC_ComChksTCU13 DDRC_St.DFC_ComChksTCU2 DDRC_St.DFC_ComChksTCU3 DDRC_St.DFC_ComChksTCU4 DDRC_St.DFC_ComCntTCU1 DDRC_St.DFC_ComCntTCU11 DDRC_St.DFC_ComCntTCU12 DDRC_St.DFC_ComCntTCU13 DDRC_St.DFC_ComCntTCU2 DDRC_St.DFC_ComCntTCU3 DDRC_St.DFC_ComCntTCU4 DDRC_St.DFC_ComTOutTCU01 DDRC_St.DFC_ComTOutTCU02 DDRC_St.DFC_ComTOutTCU1 DDRC_St.DFC_ComTOutTCU11 DDRC_St.DFC_ComTOutTCU12 DDRC_St.DFC_ComTOutTCU13 DDRC_St.DFC_ComTOutTCU14 DDRC_St.DFC_ComTOutTCU2 DDRC_St.DFC_ComTOutTCU3 DDRC_St.DFC_ComTOutTCU4 DDRC_St.DFC_DevLibBattUHi DDRC_St.DFC_DevLibBattULo DDRC_St.DFC_FanDIOOL_0 DDRC_St.DFC_FanDIOOL_1 DDRC_St.DFC_FanDIOOvrTemp_0 DDRC_St.DFC_FanDIOOvrTemp_1 DDRC_St.DFC_FanDIOSCB_0 DDRC_St.DFC_FanDIOSCB_1 DDRC_St.DFC_FanDIOSCG_0 DDRC_St.DFC_FanDIOSCG_1 DDRC_St.DFC_MRlyDcOL DDRC_St.DFC_MRlyDcSCB DDRC_St.DFC_MRlyDcSCG DDRC_St.DFC_PSPOL DDRC_St.DFC_PSPOvrTemp DDRC_St.DFC_PSPSCB DDRC_St.DFC_PSPSCG DDRC_St.DFC_T50Err DDRC_St.DFC_ThrVlvLoBattB1 DDRC_St.DFC_VehVPhysRngHi DDRC_St.DFC_VehVSclOutOL DDRC_St.DFC_VehVSclOutOT DDRC_St.DFC_VehVSclOutSCB DDRC_St.DFC_VehVSclOutSCG DDRC_St.DFC_VehVSnsrARngHi DDRC_St.DFC_VehVSnsrBRngHi DDRC_St.DFC_VehVSpdRtyDiag DDRC_St.DFC_VehVWhlErr DDRC_St.DFC_ACEvpTSRCMax DDRC_St.DFC_ACEvpTSRCMin DDRC_St.DFC_AirCClntPAnaSRCMax DDRC_St.DFC_AirCClntPAnaSRCMin DDRC_St.DFC_AirCSwtNpl DDRC_St.DFC_AirCSwtSig DDRC_St.DFC_Brk DDRC_St.DFC_BrkSig DDRC_St.DFC_ClthSig DDRC_St.DFC_HLSDemOvhtEngLim DDRC_St.DFC_OilPNpl DDRC_St.DFC_PIntkVUsLineHiB1 DDRC_St.DFC_PIntkVUsLineLoB1 DDRC_St.DFC_VehVPhysRngLo DDRC_St.DFC_VehVSigCan DDRC_St.DFC_VehVSigCanSafe DDRC_St.DFC_VlvLftFbOilPSnsrIntk11SRCMax DDRC_St.DFC_VlvLftFbOilPSnsrIntk11SRCMin DDRC_St.DFC_ClthNpl DDRC_St.DFC_EV1max DDRC_St.DFC_EV1min DDRC_St.DFC_EV1sig DDRC_St.DFC_EV2max DDRC_St.DFC_EV2min DDRC_St.DFC_EV2sig DDRC_St.DFC_EV3max DDRC_St.DFC_EV3min DDRC_St.DFC_EV3sig DDRC_St.DFC_EV4max DDRC_St.DFC_EV4min DDRC_St.DFC_EV4sig DDRC_St.DFC_GbxPNPosnDrvCdn DDRC_St.DFC_GbxPNPosnPlausy DDRC_St.DFC_PEnvCcMax DDRC_St.DFC_PEnvCcMin DDRC_St.DFC_PEnvRngChkMax DDRC_St.DFC_PEnvRngChkMin DDRC_St.DFC_PEnvSnsrPlaus DDRC_St.DFC_UEGOHeatrPsS1B1Max DDRC_St.DFC_UEGOHeatrPsS1B1Min DDRC_St.DFC_UEGOHeatrPsS1B1Sig DDRC_St.DFC_UEGOHeatrRlyPsOLS1B1 DDRC_St.DFC_UEGOHeatrRlyPsSCBS1B1 DDRC_St.DFC_UEGOHeatrRlyPsSCGS1B1 DDRC_St.DFC_KnDetSens1PortAMax DDRC_St.DFC_KnDetSens1PortAMin DDRC_St.DFC_KnDetSens1PortBMax DDRC_St.DFC_KnDetSens1PortBMin DSM_xTabVersion /end LOC_MEASUREMENT
 FUNCTION_VERSION "30000.21.1" /end FUNCTION
/begin COMPU_METHOD B_TRUE "" TAB_VERB "%6.3" "" COMPU_TAB_REF B_TRUE /end COMPU_METHOD
/begin COMPU_VTAB B_TRUE "" TAB_VERB 2 0 "FALSE" 1 "TRUE" /end COMPU_VTAB
/begin COMPU_METHOD DDRCTime_ms "" RAT_FUNC "%6.1" "ms" COEFFS 0 1 0 0 0 10 /end COMPU_METHOD
/begin COMPU_METHOD DFC_OneToOne "" RAT_FUNC "%6.2" "-" COEFFS 0 1 0 0 0 1 /end COMPU_METHOD
/begin COMPU_METHOD EngN "" RAT_FUNC "%6.3" "rpm" COEFFS 0 2 0 0 0 1 /end COMPU_METHOD
/begin COMPU_METHOD ENGOPMODE_SY_Compu "" TAB_VERB "%6.3" "" COMPU_TAB_REF ENGOPMODE_SY_Compu /end COMPU_METHOD
/begin COMPU_VTAB ENGOPMODE_SY_Compu "" TAB_VERB 2 0 "False" 1 "True" /end COMPU_VTAB
/begin COMPU_METHOD ENGRESTRT_SY_Compu "" TAB_VERB "%6.3" "" COMPU_TAB_REF ENGRESTRT_SY_Compu /end COMPU_METHOD
/begin COMPU_VTAB ENGRESTRT_SY_Compu "" TAB_VERB 2 0 "False" 1 "True" /end COMPU_VTAB
/begin COMPU_METHOD ENGRSTRTVRNT_SC_Compu "" TAB_VERB "%6.3" "" COMPU_TAB_REF ENGRSTRTVRNT_SC_Compu /end COMPU_METHOD
/begin COMPU_VTAB ENGRSTRTVRNT_SC_Compu "" TAB_VERB 3 0 "NO_RESTART" 1 "RESTART_TASK" 2 "RESTART_EVENT" /end COMPU_VTAB
/begin COMPU_METHOD ENGSPDHI_SC_Compu "" TAB_VERB "%6.3" "" COMPU_TAB_REF ENGSPDHI_SC_Compu /end COMPU_METHOD
/begin COMPU_VTAB ENGSPDHI_SC_Compu "" TAB_VERB 2 0 "False" 1 "True" /end COMPU_VTAB
/begin COMPU_METHOD ENGSPDLIMN_INHOUSE_SC_Compu "" TAB_VERB "%6.3" "" COMPU_TAB_REF ENGSPDLIMN_INHOUSE_SC_Compu /end COMPU_METHOD
/begin COMPU_VTAB ENGSPDLIMN_INHOUSE_SC_Compu "" TAB_VERB 2 0 "False" 1 "True" /end COMPU_VTAB
/begin COMPU_METHOD ENGSPDPLSENA_SC_Compu "" TAB_VERB "%6.3" "" COMPU_TAB_REF ENGSPDPLSENA_SC_Compu /end COMPU_METHOD
/begin COMPU_VTAB ENGSPDPLSENA_SC_Compu "" TAB_VERB 2 0 "False" 1 "True" /end COMPU_VTAB
/begin COMPU_METHOD ENGSPDPREDAVL_SC_Compu "" TAB_VERB "%6.3" "" COMPU_TAB_REF ENGSPDPREDAVL_SC_Compu /end COMPU_METHOD
/begin COMPU_VTAB ENGSPDPREDAVL_SC_Compu "" TAB_VERB 2 0 "False" 1 "True" /end COMPU_VTAB
/begin COMPU_METHOD ENGSPD_LIMSTRT_SY_Compu "" TAB_VERB "%6.3" "" COMPU_TAB_REF ENGSPD_LIMSTRT_SY_Compu /end COMPU_METHOD
/begin COMPU_VTAB ENGSPD_LIMSTRT_SY_Compu "" TAB_VERB 2 0 "0" 1 "1" /end COMPU_VTAB
/begin COMPU_METHOD ENGSPD_SWTENA_SY_Compu "" TAB_VERB "%6.3" "" COMPU_TAB_REF ENGSPD_SWTENA_SY_Compu /end COMPU_METHOD
/begin COMPU_VTAB ENGSPD_SWTENA_SY_Compu "" TAB_VERB 2 0 "FALSE" 1 "TRUE" /end COMPU_VTAB
/begin COMPU_METHOD ENGSTRTTREPLCMTVAL_SC_Compu "" TAB_VERB "%6.3" "" COMPU_TAB_REF ENGSTRTTREPLCMTVAL_SC_Compu /end COMPU_METHOD
/begin COMPU_VTAB ENGSTRTTREPLCMTVAL_SC_Compu "" TAB_VERB 3 0 "NONE" 1 "TDEV" 2 "ENGSTRT" /end COMPU_VTAB
/begin COMPU_METHOD ENGSTRT_CLBSIMPLE_SC_Compu "" TAB_VERB "%6.3" "" COMPU_TAB_REF ENGSTRT_CLBSIMPLE_SC_Compu /end COMPU_METHOD
/begin COMPU_VTAB ENGSTRT_CLBSIMPLE_SC_Compu "" TAB_VERB 2 0 "False" 1 "True" /end COMPU_VTAB
/begin COMPU_METHOD ENGSTRT_FWENGOFF_SC_Compu "" TAB_VERB "%6.3" "" COMPU_TAB_REF ENGSTRT_FWENGOFF_SC_Compu /end COMPU_METHOD
/begin COMPU_VTAB ENGSTRT_FWENGOFF_SC_Compu "" TAB_VERB 2 0 "DISABLED" 1 "ENABLED" /end COMPU_VTAB
/begin COMPU_METHOD ENGSTRT_NEWSYNCNPOSTDRV_SC_Compu "" RAT_FUNC "%6.2" "" COEFFS 0 1 0 0 0 1 /end COMPU_METHOD
/begin COMPU_METHOD i_q1_mA "" RAT_FUNC "%6.2" "mA" COEFFS 0 1 0 0 0 1 /end COMPU_METHOD
/begin COMPU_METHOD kw_q0p0156 "" RAT_FUNC "%6.4" "Grad KW" COEFFS 0 64 0 0 0 1 /end COMPU_METHOD
/begin COMPU_METHOD OneToOne "" RAT_FUNC "%6.2" "-" COEFFS 0 1 0 0 0 1 /end COMPU_METHOD
/begin COMPU_METHOD Prc "" RAT_FUNC "%6.4" "%" COEFFS 0 81.92 0 0 0 1 /end COMPU_METHOD
/begin COMPU_METHOD p_q0p0005 "" RAT_FUNC "%6.5" "MPa" COEFFS 0 10000 0 0 0 5 /end COMPU_METHOD
/begin COMPU_METHOD relPED_q0p00153 "" RAT_FUNC "%6.4" "% PED" COEFFS 0 65535 0 0 0 100 /end COMPU_METHOD
/begin COMPU_METHOD rel_q0p0078125 "" RAT_FUNC "%6.4" "%" COEFFS 0 128 0 0 0 1 /end COMPU_METHOD
/begin COMPU_METHOD rel_uw_b100 "" RAT_FUNC "%6.4" "%" COEFFS 0 65536 0 0 0 100 /end COMPU_METHOD
/begin COMPU_METHOD Temp_Cels "" RAT_FUNC "%6.1" "deg C" COEFFS 0 10 2731.4 0 0 1 /end COMPU_METHOD
/begin COMPU_METHOD Time_s "" RAT_FUNC "%6.4" "s" COEFFS 0 100 0 0 0 1 /end COMPU_METHOD
/begin COMPU_METHOD Time_sec_q1_COMPU "" RAT_FUNC "%6.2" "s" COEFFS 0 1 0 0 0 1 /end COMPU_METHOD
/begin COMPU_METHOD Vel "" RAT_FUNC "%6.4" "km/h" COEFFS 0 100 0 0 0 1 /end COMPU_METHOD
/begin COMPU_METHOD Volt_Batt "" RAT_FUNC "%6.1" "mV" COEFFS 0 0.05 0 0 0 1 /end COMPU_METHOD
/begin RECORD_LAYOUT KwWU16 FNC_VALUES 1 UWORD COLUMN_DIR DIRECT /end RECORD_LAYOUT
/begin RECORD_LAYOUT RB_Val_Ws16 FNC_VALUES 1 SWORD COLUMN_DIR DIRECT /end RECORD_LAYOUT
/begin RECORD_LAYOUT RB_Val_Wu16 FNC_VALUES 1 UWORD COLUMN_DIR DIRECT /end RECORD_LAYOUT
/begin RECORD_LAYOUT RB_Val_Wu8 FNC_VALUES 1 UBYTE COLUMN_DIR DIRECT /end RECORD_LAYOUT
/begin RECORD_LAYOUT ValA_Wu16 FNC_VALUES 1 UWORD COLUMN_DIR DIRECT /end RECORD_LAYOUT
/begin RECORD_LAYOUT Val_Ws16 FNC_VALUES 1 SWORD COLUMN_DIR DIRECT /end RECORD_LAYOUT
/begin RECORD_LAYOUT Val_Wu16 FNC_VALUES 1 UWORD COLUMN_DIR DIRECT /end RECORD_LAYOUT
/begin RECORD_LAYOUT Val_Wu32 FNC_VALUES 1 ULONG COLUMN_DIR DIRECT /end RECORD_LAYOUT
/begin RECORD_LAYOUT Val_Wu8 FNC_VALUES 1 UBYTE COLUMN_DIR DIRECT /end RECORD_LAYOUT
/end MODULE
/end PROJECT
