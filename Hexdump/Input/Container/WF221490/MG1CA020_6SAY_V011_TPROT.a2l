ASAP2_VERSION 1 60
/begin PROJECT MG1CA020 "MG1CA020"
/begin HEADER "" VERSION "MG1CA020_6SAY_V011_TPROT" PROJECT_NO MG1CA020 /end HEADER
/begin MODULE DIM ""
/begin MOD_COMMON "" BYTE_ORDER MSB_LAST ALIGNMENT_BYTE 1 ALIGNMENT_WORD 2 ALIGNMENT_LONG 4 ALIGNMENT_INT64 4 ALIGNMENT_FLOAT32_IEEE 4 ALIGNMENT_FLOAT64_IEEE 4 DATA_SIZE 32 /end MOD_COMMON
/begin CHARACTERISTIC HEGO_ctRiCalc_C "Number of calculations of the internal resistance" VALUE 0x805242B1 RB_Val_Wu8 255.0 dez 0.00 255.0 FORMAT "%5.1" /end CHARACTERISTIC
/begin CHARACTERISTIC HEGO_duErrElecMinLdPls_C "Threshold sensor voltage difference for electrical min error (short to ground)" VALUE 0x80524128 RB_Val_Wu16 4.998779 spg_q1p221Em3_V 0.00 4.998779 FORMAT "%8.6" EXTENDED_LIMITS 0.00 79.99878 /end CHARACTERISTIC
/begin CHARACTERISTIC HEGO_duErrElecSigLdPls_C "Threshold sensor voltage with Load for electrical sig error (wire interruption)" VALUE 0x8052412A RB_Val_Wu16 4.998779 spg_q1p221Em3_V 0.00 4.998779 FORMAT "%8.6" EXTENDED_LIMITS 0.00 79.99878 /end CHARACTERISTIC
/begin CHARACTERISTIC HEGO_duHtgMapMax_C "Maximum heating voltage offset for map controlled heating" VALUE 0x80523F74 RB_Val_Wu16 25.59961 spg_q0p00039 0.00 25.59961 FORMAT "%8.5" /end CHARACTERISTIC
/begin CHARACTERISTIC HEGO_duNomHtgIMax_C "Maximum limit for heater voltage difference, I-part" VALUE 0x80523F76 RB_Val_Ws16 25.59961 spg_q0p00039 -12.80000 12.79961 FORMAT "%8.5" /end CHARACTERISTIC
/begin CHARACTERISTIC HEGO_duNomHtgIMin_C "Minimum limit for heater voltage difference, I-part" VALUE 0x80523F78 RB_Val_Ws16 25.59961 spg_q0p00039 -12.80000 12.79961 FORMAT "%8.5" /end CHARACTERISTIC
/begin CHARACTERISTIC HEGO_duNomHtgPMax_C "Maximum limit for heater voltage difference, P-part" VALUE 0x80523F7A RB_Val_Ws16 25.59961 spg_q0p00039 -12.80000 12.79961 FORMAT "%8.5" /end CHARACTERISTIC
/begin CHARACTERISTIC HEGO_duNomHtgPMin_C "Minimum limit for heater voltage difference, P-part" VALUE 0x80523F7C RB_Val_Ws16 25.59961 spg_q0p00039 -12.80000 12.79961 FORMAT "%8.5" /end CHARACTERISTIC
/begin CHARACTERISTIC HEGO_duNomHtgRedErrElecMin_C "Heater voltage reduction in case of ElecMin error suspect" VALUE 0x80523F7E RB_Val_Wu16 25.59961 spg_q0p00039 0.00 25.59961 FORMAT "%8.5" /end CHARACTERISTIC
/begin CHARACTERISTIC HEGO_duRiAftFrz_C "Voltage difference after freeze during Ri measurement" VALUE 0x805242B2 RB_Val_Wu16 4.998779 spg_q1p221Em3_V 0.00 4.998779 FORMAT "%8.6" EXTENDED_LIMITS 0.00 79.99878 /end CHARACTERISTIC
/begin CHARACTERISTIC HEGO_duTCerChg_CUR "HEGO sensor voltage change caused by ceramic temperature change" CURVE 0x805242B4 RB_Curve_U16_S16_Static 0.4166540 q6p357Em6_V_DIV_K -0.2083270 0.2083270 FORMAT "%9.7" EXTENDED_LIMITS -0.2083333 0.2083270
 /begin AXIS_DESCR STD_AXIS NO_INPUT_QUANTITY spg_q1p221Em3_V 16 0.00 4.998779 FORMAT "%8.6" EXTENDED_LIMITS 0.00 79.99878 DEPOSIT ABSOLUTE /end AXIS_DESCR
/end CHARACTERISTIC
/begin CHARACTERISTIC HEGO_facHtgIGn_C "I-part gain of closed loop heating control" VALUE 0x80523F80 RB_Val_Wu16 12.79980 q1p953125Em4_V_DIV_s_Ohm 0.00 12.79980 FORMAT "%8.5" /end CHARACTERISTIC
/begin CHARACTERISTIC HEGO_facHtgPGn_CUR "P-part gain of closed loop heating control" CURVE 0x80523F82 RB_Curve_S16_U16_Static 12.79980 q1p953125Em4_V_DIV_Ohm 0.00 12.79980 FORMAT "%8.5"
 /begin AXIS_DESCR STD_AXIS NO_INPUT_QUANTITY r_uw_q2 11 -65536.00 65534.00 FORMAT "%8.2" DEPOSIT ABSOLUTE /end AXIS_DESCR
/end CHARACTERISTIC
/begin CHARACTERISTIC HEGO_flgDebDHtgAftStop_CW "Codebit debouncing of heater performance diagnosis after stop-phase" VALUE 0x805241B8 RB_Val_Wu8 1.00000000000 B_TRUE 0.00 1.00000000000 FORMAT "%13.11" /end CHARACTERISTIC
/begin CHARACTERISTIC HEGO_flgDewPntEndFreeSnsr_C "Flag to bypass dew point end for dew point end free sensors" VALUE 0x80523FB0 RB_Val_Wu8 1.00000000000 B_TRUE 0.00 1.00000000000 FORMAT "%13.11" /end CHARACTERISTIC
/begin CHARACTERISTIC HEGO_flgDiDesLamChk_CW "Consideration of desired lambda value check for electrical diagnosis of short circuit to battery" VALUE 0x8052412C RB_Val_Wu8 1.00000000000 B_TRUE 0.00 1.00000000000 FORMAT "%13.11" /end CHARACTERISTIC
/begin CHARACTERISTIC HEGO_flgEnaElecMaxNplColdSnsr_CW "code word for enabilng the diagnoses heater coupling and short circuit to battery for cold sensor" VALUE 0x8052412D RB_Val_Wu8 1.00000000000 B_TRUE 0.00 1.00000000000 FORMAT "%13.11" /end CHARACTERISTIC
/begin CHARACTERISTIC HEGO_flgPmpO2Ref_C "CW for HEGO sensor type with pumped O2 reference" VALUE 0x8052412E RB_Val_Wu8 1.00000000000 B_TRUE 0.00 1.00000000000 FORMAT "%13.11" /end CHARACTERISTIC
/begin CHARACTERISTIC HEGO_flgS2B1Prsnt_C "calibration flag HEGO-sensor 2 bank 1 present" VALUE 0x805242F6 RB_Val_Wu8 1.00000000000 B_TRUE 0.00 1.00000000000 FORMAT "%13.11" /end CHARACTERISTIC
/begin CHARACTERISTIC HEGO_flgS2UTNom_CW "Codebit calculation of HEGO sensor 2 voltage at nominal temperature" VALUE 0x805242F7 RB_Val_Wu8 1.00000000000 B_TRUE 0.00 1.00000000000 FORMAT "%13.11" /end CHARACTERISTIC
/begin CHARACTERISTIC HEGO_flgSnsrOperRdnOverRi_CW "codeword choosing only Ri-condition for sensor operation readiness independant of sensor type" VALUE 0x8052412F RB_Val_Wu8 1.00000000000 B_TRUE 0.00 1.00000000000 FORMAT "%13.11" /end CHARACTERISTIC
/begin CHARACTERISTIC HEGO_flgVltgBasSymc_C "flag to choose the base sensor voltage for symmetrization" VALUE 0x805242F8 RB_Val_Wu8 1.00000000000 B_TRUE 0.00 1.00000000000 FORMAT "%13.11" /end CHARACTERISTIC
/begin CHARACTERISTIC HEGO_flgVltgSymc_C "flag to activate symmetrization of HEGO sensor voltage" VALUE 0x805242F9 RB_Val_Wu8 1.00000000000 B_TRUE 0.00 1.00000000000 FORMAT "%13.11" /end CHARACTERISTIC
/begin CHARACTERISTIC HEGO_HtgS2B1_I.duHtgRmpDwn_C "Heating, HEGO sensor 2 bank 1 / Heating voltage gradient during ramp down" VALUE 0x80523FFC RB_Val_Wu16 255.9961 spgg_q0p0039 0.00 255.9961 FORMAT "%8.4" /end CHARACTERISTIC
/begin CHARACTERISTIC HEGO_HtgS2B1_I.duHtgRmpUp_C "Heating, HEGO sensor 2 bank 1 / Heating voltage gradient during ramp up" VALUE 0x80523FFE RB_Val_Wu16 255.9961 spgg_q0p0039 0.00 255.9961 FORMAT "%8.4" /end CHARACTERISTIC
/begin CHARACTERISTIC HEGO_HtgS2B1_I.pwrHtgSuffMin_C "Heating, HEGO sensor 2 bank 1 / Minimum normalized heating power for sufficient heating" VALUE 0x80524000 RB_Val_Wu8 2.550 fak_q0p01 0.00 2.550 FORMAT "%5.3" /end CHARACTERISTIC
/begin CHARACTERISTIC HEGO_HtgS2B1_I.resRiDBndMax_C "Heating, HEGO sensor 2 bank 1 / Maximum value for Ri deadband" VALUE 0x80524002 RB_Val_Ws16 131070.0 r_uw_q2 -65536.00 65534.00 FORMAT "%8.2" /end CHARACTERISTIC
/begin CHARACTERISTIC HEGO_HtgS2B1_I.resRiDBndMin_C "Heating, HEGO sensor 2 bank 1 / Minimum value for Ri deadband" VALUE 0x80524004 RB_Val_Ws16 131070.0 r_uw_q2 -65536.00 65534.00 FORMAT "%8.2" /end CHARACTERISTIC
/begin CHARACTERISTIC HEGO_HtgS2B1_I.resRiNom_C "Heating, HEGO sensor 2 bank 1 / Nominal internal resistance Ri of HEGO sensors" VALUE 0x80524006 RB_Val_Ws16 131070.0 r_uw_q2 -65536.00 65534.00 FORMAT "%8.2" /end CHARACTERISTIC
/begin CHARACTERISTIC HEGO_HtgS2B1_I.stHtg_CW "Heating, HEGO sensor 2 bank 1 / Code word HEGO sensor heating" VALUE 0x80524008 RB_Val_Wu8 255.0 dez 0.00 255.0 FORMAT "%5.1" /end CHARACTERISTIC
/begin CHARACTERISTIC HEGO_HtgS2B1_I.tEGHtgSuffMin_C "Heating, HEGO sensor 2 bank 1 / Minimum exhaust gas temperature for sufficient heating" VALUE 0x8052400A RB_Val_Wu16 1535.977 temp_q0p0234_o273 -273.150 1262.827 FORMAT "%8.3" /end CHARACTERISTIC
/begin CHARACTERISTIC HEGO_HtgS2B1_I.tiDebHtgMax_C "Heating, HEGO sensor 2 bank 1 / Debouncing time for maximum heating" VALUE 0x8052400C RB_Val_Wu16 6553.500 t_q0p1 0.00 6553.500 FORMAT "%8.3" /end CHARACTERISTIC
/begin CHARACTERISTIC HEGO_HtgS2B1_I.tiDebHtgStrtUs_C "Heating, HEGO sensor 2 bank 1 / Debouncing time for heating during start phase depending on upstream sensor" VALUE 0x8052400E RB_Val_Wu8 25.50 t_q0p1 0.00 25.50 FORMAT "%5.2" /end CHARACTERISTIC
/begin CHARACTERISTIC HEGO_HtgS2B1_I.tiHtgSuffDeb_C "Heating, HEGO sensor 2 bank 1 / Debouncing time for sufficient heating" VALUE 0x8052400F RB_Val_Wu8 25.50 t_q0p1 0.00 25.50 FORMAT "%5.2" /end CHARACTERISTIC
/begin CHARACTERISTIC HEGO_HtgS2B1_I.tiMaxHtgRedEngOff_CUR "Heating, HEGO sensor 2 bank 1 / Maximum time until heater power reduction based on engine off time" CURVE 0x80524010 RB_Curve_U16_U16 6553.500 t_q0p1 0.00 6553.500 FORMAT "%8.3"
 /begin AXIS_DESCR STD_AXIS NO_INPUT_QUANTITY t_q1 5 0.00 65535.00 FORMAT "%8.2" DEPOSIT ABSOLUTE /end AXIS_DESCR
/end CHARACTERISTIC
/begin CHARACTERISTIC HEGO_HtgS2B1_I.tiMaxHtgRedPrt_CUR "Heating, HEGO sensor 2 bank 1 / Maximum time until heater power reduction based on protective heating duration sensor" CURVE 0x80524026 RB_Curve_U16_U16 6553.500 t_q0p1 0.00 6553.500 FORMAT "%8.3"
 /begin AXIS_DESCR STD_AXIS HEGO_HtgS2B1_I.tiHtgPrt t_q0p1 5 0.00 6553.500 FORMAT "%8.3" DEPOSIT ABSOLUTE /end AXIS_DESCR
/end CHARACTERISTIC
/begin CHARACTERISTIC HEGO_HtgS2B1_I.tiMaxHtgRed_C "Heating, HEGO sensor 2 bank 1 / Maximum time until heating power is reduced" VALUE 0x8052403C RB_Val_Wu16 6553.500 t_q0p1 0.00 6553.500 FORMAT "%8.3" /end CHARACTERISTIC
/begin CHARACTERISTIC HEGO_HtgS2B1_I.tiTExhSnsrFil_M "Heating, HEGO sensor 2 bank 1 / Exhaust gas temperature filter-time-constant for sensor heating" MAP 0x8052403E RB_Map_U16S16_U16 6553.4999985 zk100msxs_uw_b6553p6 0.1000015 6553.6000000 FORMAT "%12.7" EXTENDED_LIMITS 0.10000152590 6553.6000000
 /begin AXIS_DESCR STD_AXIS HEGO_HtgS2B1_I.mEGHtg m_uw_b6553p5 5 0.00 6553.500 FORMAT "%8.3" DEPOSIT ABSOLUTE /end AXIS_DESCR
 /begin AXIS_DESCR STD_AXIS HEGO_HtgS2B1_I.tExhSnsrDyn temp_q0p0234_o273 3 -1041.150 494.827 FORMAT "%8.3" EXTENDED_LIMITS -1041.150 494.8266 DEPOSIT ABSOLUTE /end AXIS_DESCR
/end CHARACTERISTIC
/begin CHARACTERISTIC HEGO_HtgS2B1_I.uDrpHtg_C "Heating, HEGO sensor 2 bank 1 / Voltage drop in the wiring harness for sensor heating" VALUE 0x80524070 RB_Val_Wu16 25.59961 spg_q0p00039 0.00 25.59961 FORMAT "%8.5" /end CHARACTERISTIC
/begin CHARACTERISTIC HEGO_HtgS2B1_I.uHtgAftPrt_CUR "Heating, HEGO sensor 2 bank 1 / Nominal heater voltage after protective heating is finished" CURVE 0x80524072 RB_Curve_U16_U16 25.59961 spg_q0p00039 0.00 25.59961 FORMAT "%8.5"
 /begin AXIS_DESCR STD_AXIS HEGO_HtgS2B1_I.tEg temp_q0p0234_o273 6 -273.150 1262.827 FORMAT "%8.3" DEPOSIT ABSOLUTE /end AXIS_DESCR
/end CHARACTERISTIC
/begin CHARACTERISTIC HEGO_HtgS2B1_I.uHtgMapCtl_MAP "Heating, HEGO sensor 2 bank 1 / Map to control sensor heating voltage" MAP 0x8052408C RB_Map_U16U16_U16 25.59961 spg_q0p00039 0.00 25.59961 FORMAT "%8.5"
 /begin AXIS_DESCR STD_AXIS HEGO_HtgS2B1_I.mEGHtg m_uw_b6553p5 7 0.00 6553.500 FORMAT "%8.3" DEPOSIT ABSOLUTE /end AXIS_DESCR
 /begin AXIS_DESCR STD_AXIS HEGO_HtgS2B1_I.tEGFltHtg temp_q0p0234_o273 8 -273.150 1262.827 FORMAT "%8.3" DEPOSIT ABSOLUTE /end AXIS_DESCR
/end CHARACTERISTIC
/begin CHARACTERISTIC HEGO_HtgS2B1_I.uHtgMaxDeb_C "Heating, HEGO sensor 2 bank 1 / Maximum heating voltage, debounced" VALUE 0x8052411E RB_Val_Wu16 23.64648 spg_q0p00039 1.95313 25.59961 FORMAT "%8.5" EXTENDED_LIMITS 0.00 25.59961 /end CHARACTERISTIC
/begin CHARACTERISTIC HEGO_HtgS2B1_I.uHtgMaxHtUp_C "Heating, HEGO sensor 2 bank 1 / Maximum heating voltage during heat-up phase" VALUE 0x80524120 RB_Val_Wu16 25.59961 spg_q0p00039 0.00 25.59961 FORMAT "%8.5" /end CHARACTERISTIC
/begin CHARACTERISTIC HEGO_HtgS2B1_I.uHtgMax_C "Heating, HEGO sensor 2 bank 1 / Maximum heating voltage" VALUE 0x80524122 RB_Val_Wu16 23.64648 spg_q0p00039 1.95313 25.59961 FORMAT "%8.5" EXTENDED_LIMITS 0.00 25.59961 /end CHARACTERISTIC
/begin CHARACTERISTIC HEGO_HtgS2B1_I.uHtgNom_C "Heating, HEGO sensor 2 bank 1 / Nominal heating voltage" VALUE 0x80524124 RB_Val_Wu16 23.64648 spg_q0p00039 1.95313 25.59961 FORMAT "%8.5" EXTENDED_LIMITS 0.00 25.59961 /end CHARACTERISTIC
/begin CHARACTERISTIC HEGO_HtgS2B1_I.uHtgPrt_C "Heating, HEGO sensor 2 bank 1 / Protective heating voltage" VALUE 0x80524126 RB_Val_Wu16 25.59961 spg_q0p00039 0.00 25.59961 FORMAT "%8.5" /end CHARACTERISTIC
/begin CHARACTERISTIC HEGO_nrTstPls_C "max. number of test pulses in a driving cycle" VALUE 0x80524294 RB_Val_Wu32 4294967295.00 OneToOne 0.00 4294967295.00 FORMAT "%13.2" /end CHARACTERISTIC
/begin CHARACTERISTIC HEGO_numMinVoltMeasmtElecMax_C "minimum number of voltage measurements sufficient for ElecMax (SCB) diagnosis debounce" VALUE 0x80524130 RB_Val_Wu8 254.0 dez 1.0 255.0 FORMAT "%5.1" EXTENDED_LIMITS 0.00 255.0 /end CHARACTERISTIC
/begin CHARACTERISTIC HEGO_numRiOkOpRdn_C "Threshold number of Ri measurements for sensor operation readiness" VALUE 0x80524131 RB_Val_Wu8 255.0 dez 0.00 255.0 FORMAT "%5.1" /end CHARACTERISTIC
/begin CHARACTERISTIC HEGO_OBDElecS2B1_I.stDElec_CW "Electrical diagnostics, HEGO sensor 2 bank 1 / Code word electrical diagnostics for HEGO sensors" VALUE 0x80524158 RB_Val_Wu8 255.0 dez 0.00 255.0 FORMAT "%5.1" /end CHARACTERISTIC
/begin CHARACTERISTIC HEGO_OBDHtgS2B1_I.resRiThresDHtgLoTemp_MAP "Heater performance diagnosis, HEGO sensor 2 bank 1 / Map for internal resistance threshold for heater performance diagnosis, low temperature mode" MAP 0x805241FC RB_Map_U16U16_U16 131070.0 r_uw_q2 0.00 131070.0 FORMAT "%8.1"
 /begin AXIS_DESCR STD_AXIS HEGO_OBDHtgS2B1_I.tEGFlt temp_q0p0234_o273 5 -273.150 1262.827 FORMAT "%8.3" DEPOSIT ABSOLUTE /end AXIS_DESCR
 /begin AXIS_DESCR STD_AXIS HEGO_OBDHtgS2B1_I.pwrHtgFlt fak_q0p01 5 0.00 2.550000 FORMAT "%8.6" EXTENDED_LIMITS 0.00 655.3500 DEPOSIT ABSOLUTE /end AXIS_DESCR
/end CHARACTERISTIC
/begin CHARACTERISTIC HEGO_OBDHtgS2B1_I.resRiThresDHtg_MAP "Heater performance diagnosis, HEGO sensor 2 bank 1 / Map for internal resistance threshold for heater performance diagnosis" MAP 0x80524246 RB_Map_U16U16_U16 131070.0 r_uw_q2 0.00 131070.0 FORMAT "%8.1"
 /begin AXIS_DESCR STD_AXIS HEGO_OBDHtgS2B1_I.tEGFlt temp_q0p0234_o273 5 -273.150 1262.827 FORMAT "%8.3" DEPOSIT ABSOLUTE /end AXIS_DESCR
 /begin AXIS_DESCR STD_AXIS HEGO_OBDHtgS2B1_I.pwrHtgFlt fak_q0p01 5 0.00 2.550000 FORMAT "%8.6" EXTENDED_LIMITS 0.00 655.3500 DEPOSIT ABSOLUTE /end AXIS_DESCR
/end CHARACTERISTIC
/begin CHARACTERISTIC HEGO_OBDHtgS2B1_I.stDHtg_CW "Heater performance diagnosis, HEGO sensor 2 bank 1 / Code word heater performance diagnosis (class)" VALUE 0x80524290 RB_Val_Wu8 255.0 dez 0.00 255.0 FORMAT "%5.1" /end CHARACTERISTIC
/begin CHARACTERISTIC HEGO_OBDHtrPsS2B1_I.tiDebDHtrPsEnaFst_C "Heater powerstage diagnostics, HEGO sensor 2 bank 1 / debounce time for enabling diagnosis of weak heater power stage, when condition for low heater current is given" VALUE 0x805242AC RB_Val_Wu8 25.50 t_q0p1 0.00 25.50 FORMAT "%5.2" /end CHARACTERISTIC
/begin CHARACTERISTIC HEGO_OBDHtrPsS2B1_I.tiDebDHtrPsEna_C "Heater powerstage diagnostics, HEGO sensor 2 bank 1 / debounce time for enabling diagnosis of weak heater power stage, when condition for low heater current has to be achieved by heating up the sensor" VALUE 0x805242AD RB_Val_Wu8 25.50 t_q0p1 0.00 25.50 FORMAT "%5.2" /end CHARACTERISTIC
/begin CHARACTERISTIC HEGO_OBDHtrPsS2B1_I.uBattMaxDHtrPs_C "Heater powerstage diagnostics, HEGO sensor 2 bank 1 / maximum voltage for heater power stage diagnosis, when sensor is not heated" VALUE 0x805242AE RB_Val_Wu16 25.59961 spg_q0p00039 0.00 25.59961 FORMAT "%8.5" /end CHARACTERISTIC
/begin CHARACTERISTIC HEGO_OpRdnS2B1_I.flgHtgSuff_CW "Operating readiness, HEGO sensor 2 bank 1 / Codeword: considering bHtgSuff for setting sensor operation and diagnosis readines" VALUE 0x80524160 RB_Val_Wu8 1.00000000000 B_TRUE 0.00 1.00000000000 FORMAT "%13.11" /end CHARACTERISTIC
/begin CHARACTERISTIC HEGO_OpRdnS2B1_I.stOpRdn_CW "Operating readiness, HEGO sensor 2 bank 1 / Code word operating readiness for HEGO sensors" VALUE 0x80524161 RB_Val_Wu8 255.0 dez 0.00 255.0 FORMAT "%5.1" /end CHARACTERISTIC
/begin CHARACTERISTIC HEGO_OpRdnS2B1_I.tCerMdlThdExptOpRdn_C "Operating readiness, HEGO sensor 2 bank 1 / Modelled sensor ceramic temperature threshold for expected operation readiness" VALUE 0x80524162 RB_Val_Wu16 1535.977 temp_q0p0234_o273 -273.150 1262.827 FORMAT "%8.3" /end CHARACTERISTIC
/begin CHARACTERISTIC HEGO_OpRdnS2B1_I.tiDebErrStk_C "Operating readiness, HEGO sensor 2 bank 1 / Debouncing time for stuck error" VALUE 0x80524164 RB_Val_Wu16 6552.500 t_q0p1 1.000 6553.500 FORMAT "%8.3" EXTENDED_LIMITS 0.00 6553.500 /end CHARACTERISTIC
/begin CHARACTERISTIC HEGO_OpRdnS2B1_I.tiDebExptOpRdn_CUR "Operating readiness, HEGO sensor 2 bank 1 / Debouncing time for expected operating readiness" CURVE 0x80524166 RB_Curve_U16_U16 6553.500 t_q0p1 0.00 6553.500 FORMAT "%8.3"
 /begin AXIS_DESCR STD_AXIS HEGO_OpRdnS2B1_I.tEGOpRdn temp_q0p0234_om273 4 -273.150 1262.827 FORMAT "%8.3" DEPOSIT ABSOLUTE /end AXIS_DESCR
/end CHARACTERISTIC
/begin CHARACTERISTIC HEGO_OpRdnS2B1_I.tiDebPrtHtgFin_C "Operating readiness, HEGO sensor 2 bank 1 / Debouncing time protective heating finished" VALUE 0x80524178 RB_Val_Wu16 6553.500 t_q0p1 0.00 6553.500 FORMAT "%8.3" /end CHARACTERISTIC
/begin CHARACTERISTIC HEGO_resErrElecSigRi_C "Threshold internal resistance for electrical sig error (wire interruption)" VALUE 0x80524132 RB_Val_Wu16 131070.0 r_uw_q2 0.00 131070.0 FORMAT "%8.1" /end CHARACTERISTIC
/begin CHARACTERISTIC HEGO_resRiCorrdHtgRed_C "Corrected intenal resistance threshold for heating reduction" VALUE 0x80523FB2 RB_Val_Wu16 131070.0 r_uw_q2 0.00 131070.0 FORMAT "%8.1" /end CHARACTERISTIC
/begin CHARACTERISTIC HEGO_resRiHtgOffLo_C "Internal resistance threshold for HEGO sensor closed loop heating control shut-off" VALUE 0x80523FB4 RB_Val_Wu16 131070.0 r_uw_q2 0.00 131070.0 FORMAT "%8.1" /end CHARACTERISTIC
/begin CHARACTERISTIC HEGO_resRiHtgOff_C "Internal resistance threshold for HEGO sensor heating shut-off" VALUE 0x80523FB6 RB_Val_Wu16 131070.0 r_uw_q2 0.00 131070.0 FORMAT "%8.1" /end CHARACTERISTIC
/begin CHARACTERISTIC HEGO_resRiHystDHtg_C "Internal resistance hysteresis for HEGO heater performance diagnostics" VALUE 0x805241BA RB_Val_Wu16 131070.0 r_uw_q2 0.00 131070.0 FORMAT "%8.1" /end CHARACTERISTIC
/begin CHARACTERISTIC HEGO_resRiImpsThdHtgStrt_C "Ri threshold above which make heating start time dependent on eng.-off-time or time of protective-htg" VALUE 0x80523FB8 RB_Val_Wu16 131070.0 r_uw_q2 0.00 131070.0 FORMAT "%8.1" /end CHARACTERISTIC
/begin CHARACTERISTIC HEGO_resRiMaxHtgSuff_C "Maximum value for internal resistance for sufficient heating" VALUE 0x805241BC RB_Val_Wu16 131070.0 r_uw_q2 0.00 131070.0 FORMAT "%8.1" /end CHARACTERISTIC
/begin CHARACTERISTIC HEGO_resRiNom_C "Nominal internal resistance Ri of HEGO sensors" VALUE 0x805242FA RB_Val_Wu16 131070.0 r_uw_q2 0.00 131070.0 FORMAT "%8.1" /end CHARACTERISTIC
/begin CHARACTERISTIC HEGO_resRiOffsHysHtgRed_C "hysteresis offset for increased Ri-threshold for return to heating up phase from map- or closed loop -heater control in case sensor is cooling down again within the allowed heating up time." VALUE 0x80523FBA RB_Val_Wu16 131070.0 r_uw_q2 0.00 131070.0 FORMAT "%8.1" /end CHARACTERISTIC
/begin CHARACTERISTIC HEGO_resRiOpRdn_C "Threshold internal resistance for HEGO sensor operating readiness" VALUE 0x80524134 RB_Val_Wu16 131070.0 r_uw_q2 0.00 131070.0 FORMAT "%8.1" /end CHARACTERISTIC
/begin CHARACTERISTIC HEGO_resRiSwtHeatgMapThd_C "Threshold for internal resistance to switch back to Map based control heater voltage" VALUE 0x80523FBC RB_Val_Wu16 131070.0 r_uw_q2 0.00 131070.0 FORMAT "%8.1" /end CHARACTERISTIC
/begin CHARACTERISTIC HEGO_resRiTCer_CUR "Internal sensor resistance as a function of the ceramic temperature" CURVE 0x805242FC RB_Curve_U16_U16 131070.0 r_uw_q2 0.00 131070.0 FORMAT "%8.1"
 /begin AXIS_DESCR STD_AXIS NO_INPUT_QUANTITY temp_q0p0234_o273 16 -273.150 1262.827 FORMAT "%8.3" DEPOSIT ABSOLUTE /end AXIS_DESCR
/end CHARACTERISTIC
/begin CHARACTERISTIC HEGO_resRstErrElecSigRi_C "Threshold internal resistance for reset of electrical sig error (wire interruption)" VALUE 0x80524136 RB_Val_Wu16 131070.0 r_uw_q2 0.00 131070.0 FORMAT "%8.1" /end CHARACTERISTIC
/begin CHARACTERISTIC HEGO_resTCerRiMax_C "Max resistance of sensor ceramic temperature curve" VALUE 0x8052433E RB_Val_Wu16 131070.0 r_uw_q2 0.00 131070.0 FORMAT "%8.1" /end CHARACTERISTIC
/begin CHARACTERISTIC HEGO_resTCerRiMin_C "Min resistance of sensor ceramic temperature curve" VALUE 0x80524340 RB_Val_Wu16 131070.0 r_uw_q2 0.00 131070.0 FORMAT "%8.1" /end CHARACTERISTIC
/begin CHARACTERISTIC HEGO_rHtgMaxAntiWindUp_C "Maximum heating duty ratio for anti wind up" VALUE 0x80523FBE RB_Val_Wu16 2.559961 fak_q3p906Em5 0.00 2.559961 FORMAT "%8.6" /end CHARACTERISTIC
/begin CHARACTERISTIC HEGO_rHtgMinAntiWindUp_C "Minimum heating duty ratio for anti wind up" VALUE 0x80523FC0 RB_Val_Wu16 2.559961 fak_q3p906Em5 0.00 2.559961 FORMAT "%8.6" /end CHARACTERISTIC
/begin CHARACTERISTIC HEGO_rS2LamLinHiRes_CUR "Sensor characteristics (lambda linearization), HEGO sensor 2" CURVE 0x80524342 RB_Curve_U16_U16 1.999969 fak_q3p0518Em5 0.00 1.999969 FORMAT "%8.6"
 /begin AXIS_DESCR STD_AXIS HEGO_uLamHiResS2 spg_q1p221Em3_V 24 0.00 4.998779 FORMAT "%8.6" EXTENDED_LIMITS 0.00 79.99878 DEPOSIT ABSOLUTE /end AXIS_DESCR
/end CHARACTERISTIC
/begin CHARACTERISTIC HEGO_SensS2B1_I.facRiCorr_M "Signal acquisition of HEGO sensor 2 bank 1 / Correction factor for Ri, based on sensor voltage and exhaust gas temperature" MAP 0x80524460 RB_Map_U16S16_S16 3.999878 fak_uw_b8 0.00 3.999878 FORMAT "%8.6" EXTENDED_LIMITS -4.000000 3.999878
 /begin AXIS_DESCR STD_AXIS NO_INPUT_QUANTITY spg_q1p221Em3_V 4 0.00 4.998779 FORMAT "%8.6" EXTENDED_LIMITS 0.00 79.99878 DEPOSIT ABSOLUTE /end AXIS_DESCR
 /begin AXIS_DESCR STD_AXIS NO_INPUT_QUANTITY Temp_Cels 4 -3549.940 3003.560 FORMAT "%8.3" DEPOSIT ABSOLUTE /end AXIS_DESCR
/end CHARACTERISTIC
/begin CHARACTERISTIC HEGO_SensS2B1_I.tiDebEnaRiVltg_C "Signal acquisition of HEGO sensor 2 bank 1 / Debounce time of the sensor voltage enable condition for the measurement of the internal resistance" VALUE 0x80524494 RB_Val_Wu8 2.550 t_q0p01 0.00 2.550 FORMAT "%5.3" /end CHARACTERISTIC
/begin CHARACTERISTIC HEGO_SensS2B1_I.uRiLoLim_C "Signal acquisition of HEGO sensor 2 bank 1 / Lower sensor voltage limit for the measurement of the internal resistance" VALUE 0x80524496 RB_Val_Wu16 4.998779 spg_q1p221Em3_V 0.00 4.998779 FORMAT "%8.6" EXTENDED_LIMITS 0.00 79.99878 /end CHARACTERISTIC
/begin CHARACTERISTIC HEGO_SensS2B1_I.uRiOORLim_C "Signal acquisition of HEGO sensor 2 bank 1 / lower boundary (for certain error detection Out Of Range Low) of admissible voltage range for Ri-measurements" VALUE 0x80524498 RB_Val_Wu16 4.998779 spg_q1p221Em3_V 0.00 4.998779 FORMAT "%8.6" EXTENDED_LIMITS 0.00 79.99878 /end CHARACTERISTIC
/begin CHARACTERISTIC HEGO_SensS2B1_I.uRiUpLim_C "Signal acquisition of HEGO sensor 2 bank 1 / Upper sensor voltage limit for the measurement of the internal resistance" VALUE 0x8052449A RB_Val_Wu16 4.998779 spg_q1p221Em3_V 0.00 4.998779 FORMAT "%8.6" EXTENDED_LIMITS 0.00 79.99878 /end CHARACTERISTIC
/begin CHARACTERISTIC HEGO_SnsrTMdlS2B1_I.facHeatgPwrCnvnT_C "sensor temperature model, class instance sensor 2 bank 1 / Heat convection factor of sensor heater power to sensor temperature." VALUE 0x80524180 RB_Val_Wu16 0.6553500 q0p00001_degC_DIV_W 0.00 0.6553500 FORMAT "%9.7" /end CHARACTERISTIC
/begin CHARACTERISTIC HEGO_SnsrTMdlS2B1_I.facTHeatFlowEgWall_C "sensor temperature model, class instance sensor 2 bank 1 / Heat convection factor of heat flow from exhaust wall to sensor temperature." VALUE 0x80524182 RB_Val_Wu16 65.53500 q0p001_W_DIV_K 0.00 65.53500 FORMAT "%8.5" /end CHARACTERISTIC
/begin CHARACTERISTIC HEGO_SnsrTMdlS2B1_I.facTHeatFlowEg_T "sensor temperature model, class instance sensor 2 bank 1 / Heat convection factor of heat flow from engine to sensor temperature" CURVE 0x80524184 RB_Curve_R32_U16_Static 65.53500 q0p001_W_DIV_K 0.00 65.53500 FORMAT "%8.5"
 /begin AXIS_DESCR STD_AXIS NO_INPUT_QUANTITY AirMassPerTime_float 5 0.00 50000.0000 FORMAT "%10.4" EXTENDED_LIMITS -3.40282347E+038 3.40282347E+038 DEPOSIT ABSOLUTE /end AXIS_DESCR
/end CHARACTERISTIC
/begin CHARACTERISTIC HEGO_SnsrTMdlS2B1_I.facTHeatFlowEng_C "sensor temperature model, class instance sensor 2 bank 1 / Heat convection factor of heat flow from engine to sensor temperature." VALUE 0x805241A8 RB_Val_Wu16 65.53500 q0p001_W_DIV_K 0.00 65.53500 FORMAT "%8.5" /end CHARACTERISTIC
/begin CHARACTERISTIC HEGO_SnsrTMdlS2B1_I.facTHeatFlowIntkAir_C "sensor temperature model, class instance sensor 2 bank 1 / Heat convection factor of heat flow from intake air to sensor temperature." VALUE 0x805241AA RB_Val_Wu16 65.53500 q0p001_W_DIV_K 0.00 65.53500 FORMAT "%8.5" /end CHARACTERISTIC
/begin CHARACTERISTIC HEGO_SnsrTMdlS2B1_I.rHeatr_T "sensor temperature model, class instance sensor 2 bank 1 / Curve, heater resistance dependeng on modelled sensor ceramic temperature" CURVE 0x805241AC RB_Curve_U16_U16 25.59961 r_q0p00039_Ohm 0.00 25.59961 FORMAT "%8.5"
 /begin AXIS_DESCR STD_AXIS HEGO_SnsrTMdlS2B1_I.tCerMdlWpDisp temp_q0p0234_om273 2 -273.150 1262.827 FORMAT "%8.3" DEPOSIT ABSOLUTE /end AXIS_DESCR
/end CHARACTERISTIC
/begin CHARACTERISTIC HEGO_SnsrTMdlS2B1_I.rLossHeatrPS_C "sensor temperature model, class instance sensor 2 bank 1 / parameter: resistance of heater supply line, for considering voltage drop of battery voltage for sensor heater" VALUE 0x805241B6 RB_Val_Wu16 25.59961 r_q0p00039_Ohm 0.00 25.59961 FORMAT "%8.5" /end CHARACTERISTIC
/begin CHARACTERISTIC HEGO_stDElec_CW "Codeword for electrical diagnostics for HEGO sensors" VALUE 0x80524138 RB_Val_Wu8 255.0 dez 0.00 255.0 FORMAT "%5.1" /end CHARACTERISTIC
/begin CHARACTERISTIC HEGO_stHeatrPSDiagDeactvn_C "Codeword Deactivation Diagnosis Powerstage Heater" VALUE 0x80524298 RB_Val_Wu16 65535.00 dez 0.00 65535.00 FORMAT "%8.2" /end CHARACTERISTIC
/begin CHARACTERISTIC HEGO_stHtgEna_CW "Code word enable conditions for HEGO sensor heating" VALUE 0x80523FC2 RB_Val_Wu8 255.0 dez 0.00 255.0 FORMAT "%5.1" /end CHARACTERISTIC
/begin CHARACTERISTIC HEGO_stHtg_CW "Code word HEGO sensor heating" VALUE 0x80523FC3 RB_Val_Wu8 255.0 dez 0.00 255.0 FORMAT "%5.1" /end CHARACTERISTIC
/begin CHARACTERISTIC HEGO_stS2DHtg_CW "Code word heater performance diagnosis, HEGO sensor 2" VALUE 0x805241BE RB_Val_Wu8 255.0 dez 0.00 255.0 FORMAT "%5.1" /end CHARACTERISTIC
/begin CHARACTERISTIC HEGO_stS2Ps_CW "Code word heater powerstage, HEGO sensor 2" VALUE 0x8052429A RB_Val_Wu8 255.0 dez 0.00 255.0 FORMAT "%5.1" /end CHARACTERISTIC
/begin CHARACTERISTIC HEGO_stSensHw_CW "Code word HEGO sensor hardware" VALUE 0x805243A4 RB_Val_Wu8 255.0 dez 0.00 255.0 FORMAT "%5.1" /end CHARACTERISTIC
/begin CHARACTERISTIC HEGO_stSens_CW "Code word HEGO_Sens" VALUE 0x805242B0 RB_Val_Wu8 255.0 dez 0.00 255.0 FORMAT "%5.1" /end CHARACTERISTIC
/begin CHARACTERISTIC HEGO_tAmbMinDHtrPs_C "Ambient temperature threshold for HEGO heater power stage diagnosis" VALUE 0x8052429C RB_Val_Ws16 6553.500 Temp_Cels -3549.940 3003.560 FORMAT "%8.3" /end CHARACTERISTIC
/begin CHARACTERISTIC HEGO_tCerRi_CUR "HEGO sensor ceramic temperature as a function of internal resistance" CURVE 0x805243A6 RB_Curve_U16_U16 1535.977 temp_q0p0234_o273 -273.150 1262.827 FORMAT "%8.3"
 /begin AXIS_DESCR STD_AXIS NO_INPUT_QUANTITY r_uw_q2 16 0.00 131070.0 FORMAT "%8.1" DEPOSIT ABSOLUTE /end AXIS_DESCR
/end CHARACTERISTIC
/begin CHARACTERISTIC HEGO_tEGDHtgMax_C "Maximum exhaust gas temperature for heater performance diagnosis" VALUE 0x805241C0 RB_Val_Wu16 1535.977 temp_q0p0234_o273 -273.150 1262.827 FORMAT "%8.3" /end CHARACTERISTIC
/begin CHARACTERISTIC HEGO_tEGDHtgMin_C "Minimum exhaust gas temperature for heater performance diagnosis" VALUE 0x805241C2 RB_Val_Wu16 1535.977 temp_q0p0234_o273 -273.150 1262.827 FORMAT "%8.3" /end CHARACTERISTIC
/begin CHARACTERISTIC HEGO_tEGDHtgShrtTrpMax_C "Maximum exhaust gas temperature for heater performance diagnosis in short trip" VALUE 0x805241C4 RB_Val_Wu16 1535.977 temp_q0p0234_o273 -273.150 1262.827 FORMAT "%8.3" /end CHARACTERISTIC
/begin CHARACTERISTIC HEGO_tEGDHtgShrtTrpMin_C "Minimum exhaust gas tempearture for heater performance diagnosis in short trip" VALUE 0x805241C6 RB_Val_Wu16 1535.977 temp_q0p0234_o273 -273.150 1262.827 FORMAT "%8.3" /end CHARACTERISTIC
/begin CHARACTERISTIC HEGO_tEGErrElecSigRi_C "Threshold exhaust gas temperature for electrical sig error (wire interruption) due to Ri" VALUE 0x8052413A RB_Val_Wu16 1535.977 temp_q0p0234_om273 -273.150 1262.827 FORMAT "%8.3" /end CHARACTERISTIC
/begin CHARACTERISTIC HEGO_tEGFltMin_C "Mimimum filtered exhaust gas temperature" VALUE 0x805241C8 RB_Val_Wu16 1535.977 temp_q0p0234_o273 -273.150 1262.827 FORMAT "%8.3" /end CHARACTERISTIC
/begin CHARACTERISTIC HEGO_tEGHtgOffStop_C "Exhaust gas temperature threshold to switch off heating in stop phase" VALUE 0x80523FC4 RB_Val_Wu16 1535.977 temp_q0p0234_o273 -273.150 1262.827 FORMAT "%8.3" /end CHARACTERISTIC
/begin CHARACTERISTIC HEGO_tEGHtgRed_C "Exhaust gas temperature threshold for reduced heating power" VALUE 0x80523FC6 RB_Val_Wu16 1535.977 temp_q0p0234_o273 -273.150 1262.827 FORMAT "%8.3" /end CHARACTERISTIC
/begin CHARACTERISTIC HEGO_tEGMaxHtgEna_C "Maximum exhaust gas temperature for heating of HEGO sensors" VALUE 0x80523FC8 RB_Val_Wu16 1535.977 temp_q0p0234_o273 -273.150 1262.827 FORMAT "%8.3" /end CHARACTERISTIC
/begin CHARACTERISTIC HEGO_tEGMinHtg_C "Start value: 100°C (only relevant for LSF Xfour or LSF Xfour TSP in combination with 2.2 A power stage of CJ930)" VALUE 0x80523FCA RB_Val_Wu16 1535.977 temp_q0p0234_o273 -273.150 1262.827 FORMAT "%8.3" /end CHARACTERISTIC
/begin CHARACTERISTIC HEGO_tEngHotHtg_C "Engine temperature hot enough for sensor heating" VALUE 0x80523FCC RB_Val_Wu8 191.3 temp_ub_q0p75_o48 -48.0 143.3 FORMAT "%5.1" /end CHARACTERISTIC
/begin CHARACTERISTIC HEGO_tEngMinHeatgProtn_C "Minimum engine temperature limit for enabling protective heating" VALUE 0x80523FCD RB_Val_Wu8 191.3 temp_ub_q0p75_o48 -48.0 143.3 FORMAT "%5.1" /end CHARACTERISTIC
/begin CHARACTERISTIC HEGO_tExhStrtMinMapHtg_C "Calibratable minimum exhaust gas temperature at engine start for enabling map control sensor heating" VALUE 0x80523FCE RB_Val_Ws16 6553.500 Temp_Cels -3549.940 3003.560 FORMAT "%8.3" /end CHARACTERISTIC
/begin CHARACTERISTIC HEGO_tExhStrt_C "calibratable exhaust gas temperature at engine start for enabling (protective) sensor heater" VALUE 0x80523FD0 RB_Val_Ws16 6553.500 Temp_Cels -3549.940 3003.560 FORMAT "%8.3" /end CHARACTERISTIC
/begin CHARACTERISTIC HEGO_tiBtwElecFlt_C "time between test pulses for electrical errors" VALUE 0x8052429E RB_Val_Wu16 655350.0 Time_ms 0.00 655350.0 FORMAT "%8.1" /end CHARACTERISTIC
/begin CHARACTERISTIC HEGO_tiBtwOTFlt_C "time between test pulses for overtemperature error" VALUE 0x805242A0 RB_Val_Wu16 655.3500 Time_s 0.00 655.3500 FORMAT "%8.4" /end CHARACTERISTIC
/begin CHARACTERISTIC HEGO_tiDebBattHtgOff_C "Debouncing time for heating switch off at high battery voltage" VALUE 0x80523FD2 RB_Val_Wu8 25.50 t_q0p1 0.00 25.50 FORMAT "%5.2" /end CHARACTERISTIC
/begin CHARACTERISTIC HEGO_tiDebDHtgFuncReq_C "Debouncing time function request for heater performance diagnosis" VALUE 0x805241CA RB_Val_Wu8 25.50 t_q0p1 0.00 25.50 FORMAT "%5.2" /end CHARACTERISTIC
/begin CHARACTERISTIC HEGO_tiDebDHtgStop_C "Debouncing time stop phase for heater performance diagnosis" VALUE 0x805241CC RB_Val_Wu16 6553.500 t_q0p1 0.00 6553.500 FORMAT "%8.3" /end CHARACTERISTIC
/begin CHARACTERISTIC HEGO_tiDebDHtgStrt_C "Debouncing time start phase for heater performance diagnosis" VALUE 0x805241CE RB_Val_Wu16 6553.500 t_q0p1 0.00 6553.500 FORMAT "%8.3" /end CHARACTERISTIC
/begin CHARACTERISTIC HEGO_tiDebDPERiThresDHtg_C "Debouncing time for dew-point end to switch Ri threshold" VALUE 0x805241D0 RB_Val_Wu8 25.50 t_q0p1 0.00 25.50 FORMAT "%5.2" /end CHARACTERISTIC
/begin CHARACTERISTIC HEGO_tiDebEnaDHtgCtlExt_C "Debouncing time for external heating control heating performance diagnosis enable" VALUE 0x805241D1 RB_Val_Wu8 25.50 t_q0p1 0.00 25.50 FORMAT "%5.2" /end CHARACTERISTIC
/begin CHARACTERISTIC HEGO_tiDebErrElecMax_C "Debouncing time for electrical max error (short to battery voltage)" VALUE 0x8052413C RB_Val_Wu8 25.50 t_q0p1 0.00 25.50 FORMAT "%5.2" /end CHARACTERISTIC
/begin CHARACTERISTIC HEGO_tiDebErrElecMinSus_C "Debouncing time for electrical min error suspicion" VALUE 0x8052413D RB_Val_Wu8 25.50 t_q0p1 0.00 25.50 FORMAT "%5.2" /end CHARACTERISTIC
/begin CHARACTERISTIC HEGO_tiDebErrElecMin_C "Debouncing time for electrical min error (short to ground)" VALUE 0x8052413E RB_Val_Wu8 25.50 t_q0p1 0.00 25.50 FORMAT "%5.2" /end CHARACTERISTIC
/begin CHARACTERISTIC HEGO_tiDebErrElecSigSus_C "Debouncing time for electrical sig error suspicion" VALUE 0x8052413F RB_Val_Wu8 25.50 t_q0p1 0.00 25.50 FORMAT "%5.2" /end CHARACTERISTIC
/begin CHARACTERISTIC HEGO_tiDebErrHtgFIDRls_C "Debouncing time heater performance error after FID release" VALUE 0x805241D2 RB_Val_Wu16 6553.500 t_q0p1 0.00 6553.500 FORMAT "%8.3" /end CHARACTERISTIC
/begin CHARACTERISTIC HEGO_tiDebErrHtg_C "Debouncing time heater performance error" VALUE 0x805241D4 RB_Val_Wu8 25.50 t_q0p1 0.00 25.50 FORMAT "%5.2" /end CHARACTERISTIC
/begin CHARACTERISTIC HEGO_tiDebGenDElec_C "General debouncing time for electrical diagnostics" VALUE 0x80524140 RB_Val_Wu8 25.50 t_q0p1 0.00 25.50 FORMAT "%5.2" /end CHARACTERISTIC
/begin CHARACTERISTIC HEGO_tiDebHealHtgErr_C "Debouncing time healing for heater performance diagnosis in case of error" VALUE 0x805241D5 RB_Val_Wu8 25.50 t_q0p1 0.00 25.50 FORMAT "%5.2" /end CHARACTERISTIC
/begin CHARACTERISTIC HEGO_tiDebHealHtg_C "Debouncing time healing for heater performance diagnosis" VALUE 0x805241D6 RB_Val_Wu8 25.50 t_q0p1 0.00 25.50 FORMAT "%5.2" /end CHARACTERISTIC
/begin CHARACTERISTIC HEGO_tiDebHeatgStrt_C "delay time for reset of heating start information avoids reset during transition from cold operation to normal mode" VALUE 0x80523FD4 RB_Val_Wu16 6553.500 t_q0p1 0.00 6553.500 FORMAT "%8.3" /end CHARACTERISTIC
/begin CHARACTERISTIC HEGO_tiDebHtgMapClsdLop_C "Debouncing time for activation of closed loop heating control" VALUE 0x80523FD6 RB_Val_Wu16 6553.500 t_q0p1 0.00 6553.500 FORMAT "%8.3" /end CHARACTERISTIC
/begin CHARACTERISTIC HEGO_tiDebHtgMaxHys_C "Debouncing time for maximum heating hysteresis" VALUE 0x80523FD8 RB_Val_Wu16 6553.500 t_q0p1 0.00 6553.500 FORMAT "%8.3" /end CHARACTERISTIC
/begin CHARACTERISTIC HEGO_tiDebHtgPreDrive_C "Debouncing time for HEGO sensor heating during predrive" VALUE 0x80523FDA RB_Val_Wu16 6553.500 t_q0p1 0.00 6553.500 FORMAT "%8.3" /end CHARACTERISTIC
/begin CHARACTERISTIC HEGO_tiDebNewRiAvlHtg_C "Deboucing time to disable closed loop heating control" VALUE 0x80523FDC RB_Val_Wu16 6553.500 t_q0p1 0.00 6553.500 FORMAT "%8.3" /end CHARACTERISTIC
/begin CHARACTERISTIC HEGO_tiDebNewRiHtg_C "maximum time between two Ri measurements for closed loop heater control before requesting new Ri-measurement by HEGO_Htg." VALUE 0x80523FDE RB_Val_Wu16 6553.500 t_q0p1 0.00 6553.500 FORMAT "%8.3" /end CHARACTERISTIC
/begin CHARACTERISTIC HEGO_tiDebRiActAvlHtg_C "Debouncing time for internal resistance actual available" VALUE 0x80523FE0 RB_Val_Wu8 25.50 t_q0p1 0.00 25.50 FORMAT "%5.2" /end CHARACTERISTIC
/begin CHARACTERISTIC HEGO_tiDebRstErrStkCVB_C "Debouncing time for reset of error stuck in countervoltage band" VALUE 0x80524141 RB_Val_Wu8 25.50 t_q0p1 0.00 25.50 FORMAT "%5.2" /end CHARACTERISTIC
/begin CHARACTERISTIC HEGO_tiDebTAmbHtrPs_C "Debouncing time for valid ambient temperature" VALUE 0x805242A2 RB_Val_Wu8 25.50 t_q0p1 0.00 25.50 FORMAT "%5.2" /end CHARACTERISTIC
/begin CHARACTERISTIC HEGO_tiDelLdPlsMin_C "Delay time between two load pulses in case of min error suspicion" VALUE 0x80524142 RB_Val_Wu8 25.40 t_q0p1 0.10 25.50 FORMAT "%5.2" EXTENDED_LIMITS 0.00 25.50 /end CHARACTERISTIC
/begin CHARACTERISTIC HEGO_tiDelLdPlsSig_C "Delay time between two load pulses in case of sig error suspicion" VALUE 0x80524143 RB_Val_Wu8 25.40 t_q0p1 0.10 25.50 FORMAT "%5.2" EXTENDED_LIMITS 0.00 25.50 /end CHARACTERISTIC
/begin CHARACTERISTIC HEGO_tiDelLdPls_C "Waiting time between two load pulses" VALUE 0x805243E8 RB_Val_Wu16 6553.300 t_q0p1 0.200 6553.500 FORMAT "%8.3" EXTENDED_LIMITS 0.00 6553.500 /end CHARACTERISTIC
/begin CHARACTERISTIC HEGO_tiDelOpRdnRiPls_C "Waiting time between Ri pulses for operating readiness detection" VALUE 0x805243EA RB_Val_Wu8 25.30 t_q0p1 0.20 25.50 FORMAT "%5.2" EXTENDED_LIMITS 0.00 25.50 /end CHARACTERISTIC
/begin CHARACTERISTIC HEGO_tiDelRiPls_C "Delay time between two Ri measurement pulses" VALUE 0x805243EB RB_Val_Wu8 2.550 t_q0p01 0.00 2.550 FORMAT "%5.3" /end CHARACTERISTIC
/begin CHARACTERISTIC HEGO_tiEngStopDHtgMin_C "Minimum engine stop time for heater performance diagnosis" VALUE 0x805241D8 RB_Val_Wu16 65535.00 t_q1 0.00 65535.00 FORMAT "%8.2" /end CHARACTERISTIC
/begin CHARACTERISTIC HEGO_tiEngStop_C "minimum engine off time for activating of (protective) heating" VALUE 0x80523FE2 RB_Val_Wu16 65535.00 t_q1 0.00 65535.00 FORMAT "%8.2" /end CHARACTERISTIC
/begin CHARACTERISTIC HEGO_tiFltPwrHtg_C "Heater power filter time constant for heater performance diagnosis" VALUE 0x805241DA RB_Val_Wu16 6553.4999985 zk100msxs_uw_b6553p6 0.1000015 6553.6000000 FORMAT "%12.7" EXTENDED_LIMITS 0.10000152590 6553.6000000 /end CHARACTERISTIC
/begin CHARACTERISTIC HEGO_tiFltRiHtg_C "Ri Filter time constant for heating control" VALUE 0x80523FE4 RB_Val_Wu16 6553.4999985 zk100msxs_uw_b6553p6 0.1000015 6553.6000000 FORMAT "%12.7" EXTENDED_LIMITS 0.10000152590 6553.6000000 /end CHARACTERISTIC
/begin CHARACTERISTIC HEGO_tiFltTempEG_CUR "Exhaust gas temperature filter time constant for heater performance diagnosis" CURVE 0x805241DC RB_Curve_U16_U16 6553.4999985 zk100msxs_uw_b6553p6 0.1000015 6553.6000000 FORMAT "%12.7" EXTENDED_LIMITS 0.10000152590 6553.6000000
 /begin AXIS_DESCR STD_AXIS NO_INPUT_QUANTITY m_q0p1 5 0.00 6553.500 FORMAT "%8.3" DEPOSIT ABSOLUTE /end AXIS_DESCR
/end CHARACTERISTIC
/begin CHARACTERISTIC HEGO_tIntkAirThrDHtgMin_C "Minimum intake air temperature downstream throttle for heater performance diagnosis" VALUE 0x805241F2 RB_Val_Wu16 1535.977 temp_q0p0234_o273 -273.150 1262.827 FORMAT "%8.3" /end CHARACTERISTIC
/begin CHARACTERISTIC HEGO_tiPerdHtg_C "Time period for heating of HEGO Sensor" VALUE 0x80523FE6 RB_Val_Wu8 245.0 t_q1_ms 10.0 255.0 FORMAT "%5.1" EXTENDED_LIMITS 0.00 255.0 /end CHARACTERISTIC
/begin CHARACTERISTIC HEGO_tiPolarRedPls_C "Duration of pulse for polarization reduction" VALUE 0x805243EC RB_Val_Wu8 0.01500 t_q0p001 0.00 0.01500 FORMAT "%7.5" EXTENDED_LIMITS 0.00 0.2550 /end CHARACTERISTIC
/begin CHARACTERISTIC HEGO_tiS2FrzSigRiAcqn_C "Sensor signal freeze time after measurement of internal resistance, HEGO sensor 2" VALUE 0x805243ED RB_Val_Wu8 2.540 t_q0p01 0.010 2.550 FORMAT "%5.3" EXTENDED_LIMITS 0.00 2.550 /end CHARACTERISTIC
/begin CHARACTERISTIC HEGO_tiSmotngSymc_C "Time constant for smoothing of sensor voltage in case of symmetrization" VALUE 0x805243EE RB_Val_Wu16 655.3400 t_q0p01 0.0100 655.3500 FORMAT "%8.4" EXTENDED_LIMITS 0.00 655.3500 /end CHARACTERISTIC
/begin CHARACTERISTIC HEGO_tiTExhSnsrDyn_C "Time constant for calculation of exhaust temperature gradient" VALUE 0x80523FE8 RB_Val_Wu16 6553.4999985 zk100msxs_uw_b6553p6 0.1000015 6553.6000000 FORMAT "%12.7" EXTENDED_LIMITS 0.10000152590 6553.6000000 /end CHARACTERISTIC
/begin CHARACTERISTIC HEGO_uBattDHeatgMax_C "Maximum battery voltage for heater performance diagnosis" VALUE 0x805241F4 RB_Val_Ws16 1310700. Volt_Batt -655360.0 655340.0 FORMAT "%8.1" /end CHARACTERISTIC
/begin CHARACTERISTIC HEGO_uBattDHeatgMin_C "Mimimum battery voltage for heater performance diagnosis" VALUE 0x805241F6 RB_Val_Ws16 1310700. Volt_Batt -655360.0 655340.0 FORMAT "%8.1" /end CHARACTERISTIC
/begin CHARACTERISTIC HEGO_uBattHtgOff_C "Battery voltage threshold for heating switch off" VALUE 0x80523FEA RB_Val_Wu16 25.59961 spg_q0p00039 0.00 25.59961 FORMAT "%8.5" /end CHARACTERISTIC
/begin CHARACTERISTIC HEGO_uBattMinDElec_C "Minimum battery voltage for electrical diagnostics" VALUE 0x80524144 RB_Val_Wu8 25.50 spg_q0p1 0.00 25.50 FORMAT "%5.2" /end CHARACTERISTIC
/begin CHARACTERISTIC HEGO_uBattMinDHtrPs_C "minimum battery voltage for heater power stage diagnosis" VALUE 0x805242A4 RB_Val_Wu16 25.59961 spg_q0p00039 0.00 25.59961 FORMAT "%8.5" /end CHARACTERISTIC
/begin CHARACTERISTIC HEGO_uErrElecMaxColdSnsr_C "Sensor voltage threshold for Elec-Max fault for cold sensor" VALUE 0x80524146 RB_Val_Wu16 4.995117 spg_q0p00488 0.00 4.995117 FORMAT "%8.6" EXTENDED_LIMITS 0.00 319.9951 /end CHARACTERISTIC
/begin CHARACTERISTIC HEGO_uErrElecMaxNormOper_C "signal line SCB diagnosis threshold for fully heated sensor" VALUE 0x80524148 RB_Val_Wu16 4.995117 spg_q0p00488 0.00 4.995117 FORMAT "%8.6" EXTENDED_LIMITS 0.00 319.9951 /end CHARACTERISTIC
/begin CHARACTERISTIC HEGO_uErrElecMinORRLow_C "Out-of-range-low voltage-threshold (Elec-Min fault criterion) for LSFX4" VALUE 0x8052414A RB_Val_Wu16 4.995117 spg_q0p00488 0.00 4.995117 FORMAT "%8.6" EXTENDED_LIMITS 0.00 319.9951 /end CHARACTERISTIC
/begin CHARACTERISTIC HEGO_uErrElecMin_C "Voltage threshold for electrical min error (short to ground)" VALUE 0x8052414C RB_Val_Wu16 4.995117 spg_q0p00488 0.00 4.995117 FORMAT "%8.6" EXTENDED_LIMITS 0.00 319.9951 /end CHARACTERISTIC
/begin CHARACTERISTIC HEGO_uS23LeanOpRdn_C "Threshold lean voltage for operating readiness, HEGO sensors 2 and 3" VALUE 0x8052414E RB_Val_Wu16 4.995117 spg_q0p00488 0.00 4.995117 FORMAT "%8.6" EXTENDED_LIMITS 0.00 319.9951 /end CHARACTERISTIC
/begin CHARACTERISTIC HEGO_uS23RichOpRdn_C "Threshold rich voltage for operating readiness, HEGO sensors 2 and 3" VALUE 0x80524150 RB_Val_Wu16 4.995117 spg_q0p00488 0.00 4.995117 FORMAT "%8.6" EXTENDED_LIMITS 0.00 319.9951 /end CHARACTERISTIC
/begin CHARACTERISTIC HEGO_uS2InvLamLinHiRes_CUR "Sensor characteristics (inverse lambda linearization), HEGO sensor 2" CURVE 0x805243F0 RB_Curve_U16_U16 4.998779 spg_q1p221Em3_V 0.00 4.998779 FORMAT "%8.6" EXTENDED_LIMITS 0.00 79.99878
 /begin AXIS_DESCR STD_AXIS HEGO_facLamLinHiResS2 fak_q3p0518Em5 24 0.00 1.999969 FORMAT "%8.6" DEPOSIT ABSOLUTE /end AXIS_DESCR
/end CHARACTERISTIC
/begin CHARACTERISTIC HESrv_numBnk_CA "Stores which cylinder belongs to which bank" VAL_BLK 0x8052449C ValA_Wu8 1.000 OneToOne 0.00 1.000 FORMAT "%5.3" EXTENDED_LIMITS 0.00 255.0 NUMBER 4 /end CHARACTERISTIC
/begin CHARACTERISTIC HESrv_stRmtInjVlv_CA "Stores which cylinder belongs to which ECU" VAL_BLK 0x805244A0 ValA_Wu8 1.000 OneToOne 0.00 1.000 FORMAT "%5.3" EXTENDED_LIMITS 0.00 255.0 NUMBER 4 /end CHARACTERISTIC
/begin CHARACTERISTIC HESrv_swtMSidConf_C "MSid configuration switch" VALUE 0x805244A6 Val_Wu8 255.0 OneToOne 0.00 255.0 FORMAT "%5.1" /end CHARACTERISTIC
/begin CHARACTERISTIC HESrv_swtPOpVis_C "Calibration parameter to select the bank used for working point indication of a common CURVE/MAP within a twin-flow system" VALUE 0x805244A4 Val_Wu8 1.00000000000 HESrv_SwtPOpVis 0.00 1.00000000000 FORMAT "%13.11" /end CHARACTERISTIC
/begin CHARACTERISTIC HESrv_swtScndFlwActv_C "Calibration parameter to switch off the second flow within a twin-flow system if this feature was enabled" VALUE 0x805244A5 Val_Wu8 1.000 OneToOne 0.00 1.000 FORMAT "%5.3" EXTENDED_LIMITS 0.00 255.0 /end CHARACTERISTIC
/begin MEASUREMENT DelRiPlsT_I.timeCounter "time delay between two Ri-pulses / Remaining time of the timer" UBYTE t_q0p01 1 100 0.00 2.550 FORMAT "%5.3" ECU_ADDRESS 0x6000645D /end MEASUREMENT
/begin MEASUREMENT HEGO_bDHtgTempIntkAirOk "Bit intake air temperature ok for heater performance diagnosis" UBYTE B_TRUE 1 100 0.00 1.00000000000 BIT_MASK 0x1 FORMAT "%13.11" ECU_ADDRESS 0x70000208 /end MEASUREMENT
/begin MEASUREMENT HEGO_bDHtgTiEngStopOk "Bit engine stop time ok for heater performance diagnosis" UBYTE B_TRUE 1 100 0.00 1.00000000000 BIT_MASK 0x1 FORMAT "%13.11" ECU_ADDRESS 0x70000207 /end MEASUREMENT
/begin MEASUREMENT HEGO_bEnaDElecPhy "Bit physical enable conditions for electrical HEGO sensor diagnostics met" UBYTE B_TRUE 1 100 0.00 1.00000000000 BIT_MASK 0x1 FORMAT "%13.11" ECU_ADDRESS 0x70000782 /end MEASUREMENT
/begin MEASUREMENT HEGO_bEnaDHtgAftStop "Bit enable condition for heater performance diagnosis after stop-phase" UBYTE B_TRUE 1 100 0.00 1.00000000000 BIT_MASK 0x1 FORMAT "%13.11" ECU_ADDRESS 0x70000206 /end MEASUREMENT
/begin MEASUREMENT HEGO_bEnaDPs "Bit heater power stage diagnostics enabled" UBYTE B_TRUE 1 100 0.00 1.00000000000 BIT_MASK 0x1 FORMAT "%13.11" ECU_ADDRESS 0x70000781 /end MEASUREMENT
/begin MEASUREMENT HEGO_bFCMClrS2B1OBDHtg "FCM Clear request, Sensor 2 Bank 1" UBYTE B_TRUE 1 100 0.00 1.00000000000 BIT_MASK 0x1 FORMAT "%13.11" ECU_ADDRESS 0x70000205 /end MEASUREMENT
/begin MEASUREMENT HEGO_bRiPlsReq "Bit pulse for measurement of internal resistance requested" UBYTE B_TRUE 1 100 0.00 1.00000000000 BIT_MASK 0x1 FORMAT "%13.11" ECU_ADDRESS 0x70000202 /end MEASUREMENT
/begin MEASUREMENT HEGO_bS2B1EnaDElec "Bit electrical diagnostics enabled, HEGO sensor 2 bank 1" UBYTE B_TRUE 1 100 0.00 1.00000000000 BIT_MASK 0x1 FORMAT "%13.11" ECU_ADDRESS 0x70000780 /end MEASUREMENT
/begin MEASUREMENT HEGO_bS2B1EnaDHtg "Bit heater performance diagnosis enabled, HEGO sensor 2 bank 1" UBYTE B_TRUE 1 100 0.00 1.00000000000 BIT_MASK 0x1 FORMAT "%13.11" ECU_ADDRESS 0x7000077F /end MEASUREMENT
/begin MEASUREMENT HEGO_bS2B1ErrElecHtrCpl "Bit electrical error heater coupling, HEGO sensor 2 bank 1" UBYTE B_TRUE 1 100 0.00 1.00000000000 BIT_MASK 0x1 FORMAT "%13.11" ECU_ADDRESS 0x7000077E /end MEASUREMENT
/begin MEASUREMENT HEGO_bS2B1ErrElecMinWoDeb "Bit electrical min error without debouncing, HEGO sensor 2 bank 1" UBYTE B_TRUE 1 100 0.00 1.00000000000 BIT_MASK 0x1 FORMAT "%13.11" ECU_ADDRESS 0x7000077D /end MEASUREMENT
/begin MEASUREMENT HEGO_bS2B1ErrElecSig "Bit electrical sig error (wire interruption), HEGO sensor 2 bank 1" UBYTE B_TRUE 1 100 0.00 1.00000000000 BIT_MASK 0x1 FORMAT "%13.11" ECU_ADDRESS 0x7000077C /end MEASUREMENT
/begin MEASUREMENT HEGO_bS2B1ErrElecSigPrev "Bit electrical sig error (wire interruption) in previous trip, HEGO sensor 2 bank 1" UBYTE B_TRUE 1 100 0.00 1.00000000000 BIT_MASK 0x1 FORMAT "%13.11" ECU_ADDRESS 0x7000077B /end MEASUREMENT
/begin MEASUREMENT HEGO_bS2B1ErrElecSigRi "Bit elctrical sig error (wire interruption) due to Ri, HEGO sensor 1 bank 2" UBYTE B_TRUE 1 100 0.00 1.00000000000 BIT_MASK 0x1 FORMAT "%13.11" ECU_ADDRESS 0x7000077A /end MEASUREMENT
/begin MEASUREMENT HEGO_bS2B1ExptOpRdn "Bit expected operating readiness, HEGO sensor 2 bank 1" UBYTE B_TRUE 1 100 0.00 1.00000000000 BIT_MASK 0x1 FORMAT "%13.11" ECU_ADDRESS 0x70000779 /end MEASUREMENT
/begin MEASUREMENT HEGO_bS2B1FrzRi "Bit sensor signal frozen due to measurement of internal resistance, Heated Exhaust Gas Oxygen sensor 2 bank 1" UBYTE B_TRUE 1 100 0.00 1.00000000000 BIT_MASK 0x1 FORMAT "%13.11" ECU_ADDRESS 0x70000778 /end MEASUREMENT
/begin MEASUREMENT HEGO_bS2B1HtgEna "Bit heating enabled, HEGO sensor 2, bank 1" UBYTE B_TRUE 1 100 0.00 1.00000000000 BIT_MASK 0x1 FORMAT "%13.11" ECU_ADDRESS 0x70000777 /end MEASUREMENT
/begin MEASUREMENT HEGO_bS2B1HtgOffTiImpsMem "Bit heating off due to implausible heater timing, HEGO sensor 2 bank 1" UBYTE B_TRUE 1 100 0.00 1.00000000000 BIT_MASK 0x1 FORMAT "%13.11" ECU_ADDRESS 0x7000020A /end MEASUREMENT
/begin MEASUREMENT HEGO_bS2B1HtgOn "Bit heating on, HEGO sensor 2 bank 1" UBYTE B_TRUE 1 100 0.00 1.00000000000 BIT_MASK 0x1 FORMAT "%13.11" ECU_ADDRESS 0x70000776 /end MEASUREMENT
/begin MEASUREMENT HEGO_bS2B1HtgPrtFin "Bit protective heating finished, HEGO sensor 2 bank 1" UBYTE B_TRUE 1 100 0.00 1.00000000000 BIT_MASK 0x1 FORMAT "%13.11" ECU_ADDRESS 0x70000775 /end MEASUREMENT
/begin MEASUREMENT HEGO_bS2B1HtgRiReq "Bit Ri measurement request for closed loop heater control, HEGO sensor 2 bank 1" UBYTE B_TRUE 1 100 0.00 1.00000000000 BIT_MASK 0x1 FORMAT "%13.11" ECU_ADDRESS 0x70000774 /end MEASUREMENT
/begin MEASUREMENT HEGO_bS2B1HtgStrt "Bit heating during start phase, HEGO sensor 2 bank 1" UBYTE B_TRUE 1 100 0.00 1.00000000000 BIT_MASK 0x1 FORMAT "%13.11" ECU_ADDRESS 0x70000773 /end MEASUREMENT
/begin MEASUREMENT HEGO_bS2B1HtgSuff "Bit sufficient heating, HEGO sensor 2 bank 1" UBYTE B_TRUE 1 100 0.00 1.00000000000 BIT_MASK 0x1 FORMAT "%13.11" ECU_ADDRESS 0x70000772 /end MEASUREMENT
/begin MEASUREMENT HEGO_bS2B1HtgSuffRi "Bit sufficient heating (Ri low enough), HEGO sensor 2 bank 1" UBYTE B_TRUE 1 100 0.00 1.00000000000 BIT_MASK 0x1 FORMAT "%13.11" ECU_ADDRESS 0x70000771 /end MEASUREMENT
/begin MEASUREMENT HEGO_bS2B1InVldErr "Bit signal invalid due to error, HEGO sensor 2 bank 1" UBYTE B_TRUE 1 100 0.00 1.00000000000 BIT_MASK 0x1 FORMAT "%13.11" ECU_ADDRESS 0x70000770 /end MEASUREMENT
/begin MEASUREMENT HEGO_bS2B1LdPlsMinReq "Bit load pulses requested due to min error (short to ground) suspicion, HEGO sensor 2 bank 1" UBYTE B_TRUE 1 100 0.00 1.00000000000 BIT_MASK 0x1 FORMAT "%13.11" ECU_ADDRESS 0x7000076F /end MEASUREMENT
/begin MEASUREMENT HEGO_bS2B1LdPlsRslt "Bit result of load pulse measurement is available, HEGO sensor 2 bank 1" UBYTE B_TRUE 1 100 0.00 1.00000000000 BIT_MASK 0x1 FORMAT "%13.11" ECU_ADDRESS 0x7000076E /end MEASUREMENT
/begin MEASUREMENT HEGO_bS2B1LdPlsSigCnfReq "Bit load pulses requested to confirm sig error (wire interruption) suspicion, HEGO sensor 2 bank 1" UBYTE B_TRUE 1 100 0.00 1.00000000000 BIT_MASK 0x1 FORMAT "%13.11" ECU_ADDRESS 0x7000076D /end MEASUREMENT
/begin MEASUREMENT HEGO_bS2B1LdPlsSigReq "Bit load pulse requested due to sig error (wire interruption) suspicion, HEGO sensor 2 bank 1" UBYTE B_TRUE 1 100 0.00 1.00000000000 BIT_MASK 0x1 FORMAT "%13.11" ECU_ADDRESS 0x7000076C /end MEASUREMENT
/begin MEASUREMENT HEGO_bS2B1NewRi "Bit New Ri value available, HEGO sensor 2 bank 1" UBYTE B_TRUE 1 100 0.00 1.00000000000 BIT_MASK 0x1 FORMAT "%13.11" ECU_ADDRESS 0x7000076B /end MEASUREMENT
/begin MEASUREMENT HEGO_bS2B1OpRdnRiReq "Ri measurement requsest for operation readiness detection, HEGO sensor 2 bank 1" UBYTE B_TRUE 1 100 0.00 1.00000000000 BIT_MASK 0x1 FORMAT "%13.11" ECU_ADDRESS 0x7000076A /end MEASUREMENT
/begin MEASUREMENT HEGO_bS2B1RiPlsReq "Bit pulse for measurement of internal resistance requested, HEGO sensor 2 bank 1" UBYTE B_TRUE 1 100 0.00 1.00000000000 BIT_MASK 0x1 FORMAT "%13.11" ECU_ADDRESS 0x70000201 /end MEASUREMENT
/begin MEASUREMENT HEGO_bS2B1Vld "Bit signal valid, Heated Exhaust Gas Oxygen sensor 2 bank 1" UBYTE B_TRUE 1 100 0.00 1.00000000000 BIT_MASK 0x1 FORMAT "%13.11" ECU_ADDRESS 0x70000769 /end MEASUREMENT
/begin MEASUREMENT HEGO_bS2B1VldRi "Bit internal resistance is valid, HEGO sensor 2 bank 1" UBYTE B_TRUE 1 100 0.00 1.00000000000 BIT_MASK 0x1 FORMAT "%13.11" ECU_ADDRESS 0x70000768 /end MEASUREMENT
/begin MEASUREMENT HEGO_DebDHtgAftStopFF_I.status "Flip Flop condition for engine speed above a threshold for enabling sensor heating. / current value of RS-FF" UBYTE B_TRUE 1 100 0.00 1.00000000000 BIT_MASK 0x1 FORMAT "%13.11" ECU_ADDRESS 0x6000645F /end MEASUREMENT
/begin MEASUREMENT HEGO_DebDHtgGenFuncReqTONV_I.outbit "Debouncing on function scan tool request for sensor heating diagnosis. / return value" UBYTE B_TRUE 1 100 0.00 1.00000000000 BIT_MASK 0x1 FORMAT "%13.11" ECU_ADDRESS 0x600037D4 /end MEASUREMENT
/begin MEASUREMENT HEGO_DebDHtgGenFuncReqTONV_I.time "Debouncing on function scan tool request for sensor heating diagnosis. / expired delay time" UBYTE t_q0p1 1 100 0.00 25.50 FORMAT "%5.2" ECU_ADDRESS 0x600037D5 /end MEASUREMENT
/begin MEASUREMENT HEGO_DebDHtgStopEF_I.buffer "edge falling Debouncing stop phase for heater performance diagnosis / memory to detect falling edge" UBYTE B_TRUE 1 100 0.00 1.00000000000 BIT_MASK 0x1 FORMAT "%13.11" ECU_ADDRESS 0x600037D2 /end MEASUREMENT
/begin MEASUREMENT HEGO_DebDHtgStopEF_I.oldSignal "edge falling Debouncing stop phase for heater performance diagnosis / memory to detect falling edge" UBYTE B_TRUE 1 100 0.00 1.00000000000 BIT_MASK 0x1 FORMAT "%13.11" ECU_ADDRESS 0x600037D3 /end MEASUREMENT
/begin MEASUREMENT HEGO_DebDHtgStopTOFFV_I.outbit "Debouncing stop phase for heater performance diagnosis / Output Bit" UBYTE B_TRUE 1 100 0.00 1.00000000000 BIT_MASK 0x1 FORMAT "%13.11" ECU_ADDRESS 0x600037CE /end MEASUREMENT
/begin MEASUREMENT HEGO_DebDHtgStopTOFFV_I.time "Debouncing stop phase for heater performance diagnosis / Occured Time" UWORD t_q0p1 1 100 0.00 6553.500 FORMAT "%8.3" ECU_ADDRESS 0x600037D0 /end MEASUREMENT
/begin MEASUREMENT HEGO_DebDHtgStrtER_I.buffer "Edge rise condition based on engine speed for enabling sensor heating diagnosis after a stop. / rising edge detected" UBYTE B_TRUE 1 100 0.00 1.00000000000 BIT_MASK 0x1 FORMAT "%13.11" ECU_ADDRESS 0x600037CC /end MEASUREMENT
/begin MEASUREMENT HEGO_DebDHtgStrtER_I.oldSignal "Edge rise condition based on engine speed for enabling sensor heating diagnosis after a stop. / flag rising edge" UBYTE B_TRUE 1 100 0.00 1.00000000000 BIT_MASK 0x1 FORMAT "%13.11" ECU_ADDRESS 0x600037CD /end MEASUREMENT
/begin MEASUREMENT HEGO_DebDHtgStrtTONV_I.outbit "Debounce time based on engine speed for enabling sensor diagnosis after a stop. / return value" UBYTE B_TRUE 1 100 0.00 1.00000000000 BIT_MASK 0x1 FORMAT "%13.11" ECU_ADDRESS 0x600037C8 /end MEASUREMENT
/begin MEASUREMENT HEGO_DebDHtgStrtTONV_I.time "Debounce time based on engine speed for enabling sensor diagnosis after a stop. / expired delay time" UWORD t_q0p1 1 100 0.00 6553.500 FORMAT "%8.3" ECU_ADDRESS 0x600037CA /end MEASUREMENT
/begin MEASUREMENT HEGO_DebTAmbHtrPsTONV_I.outbit "turn on delay for release power stage diagnosis w.r.t. ambient temperature / return value" UBYTE B_TRUE 1 100 0.00 1.00000000000 BIT_MASK 0x1 FORMAT "%13.11" ECU_ADDRESS 0x600037C6 /end MEASUREMENT
/begin MEASUREMENT HEGO_DebTAmbHtrPsTONV_I.time "turn on delay for release power stage diagnosis w.r.t. ambient temperature / expired delay time" UBYTE t_q0p1 1 100 0.00 25.50 FORMAT "%5.2" ECU_ADDRESS 0x600037C7 /end MEASUREMENT
/begin MEASUREMENT HEGO_DHtgEGTMStrtB1ER_I.buffer "Edge rise detection of sensor start temperature in dew point end. / rising edge detected" UBYTE B_TRUE 1 100 0.00 1.00000000000 BIT_MASK 0x1 FORMAT "%13.11" ECU_ADDRESS 0x600037D6 /end MEASUREMENT
/begin MEASUREMENT HEGO_DHtgEGTMStrtB1ER_I.oldSignal "Edge rise detection of sensor start temperature in dew point end. / flag rising edge" UBYTE B_TRUE 1 100 0.00 1.00000000000 BIT_MASK 0x1 FORMAT "%13.11" ECU_ADDRESS 0x600037D7 /end MEASUREMENT
/begin MEASUREMENT HEGO_dresS2B1RiThresMin "Running minimum of difference between internal resistance value and threshold, HEGO sensor 2 bank 1" SLONG r_uw_q2 1 100 -131070.000000 131070.000000 FORMAT "%13.6" ECU_ADDRESS 0x50004D2C /end MEASUREMENT
/begin MEASUREMENT HEGO_dresS2B1RiThresMinNV "Running minimum of difference between internal resistance value and threshold, HEGO sensor 2 bank 1" SLONG r_uw_q2 1 100 -131070.000000 131070.000000 FORMAT "%13.6" ECU_ADDRESS 0x60036580 /end MEASUREMENT
/begin MEASUREMENT HEGO_facLamLinHiResS2 "Factor lambda, HEGO sensor 2 working point display" UWORD fak_q3p0518Em5 1 100 0.00 1.999969 FORMAT "%8.6" ECU_ADDRESS 0x70002B84 /end MEASUREMENT
/begin MEASUREMENT HEGO_flgDrvDsmEntryDIntPs "flag integrated power stage diagnosis enabling conditions given, considering battery voltage and DSM-Init" UBYTE B_TRUE 1 100 0.00 1.00000000000 BIT_MASK 0x1 FORMAT "%13.11" ECU_ADDRESS 0x70000766 /end MEASUREMENT
/begin MEASUREMENT HEGO_flgDrvDsmTripChgdOBDHtg "flag: DSM initialization done" UBYTE B_TRUE 1 100 0.00 1.00000000000 BIT_MASK 0x1 FORMAT "%13.11" ECU_ADDRESS 0x6000A7C9 /end MEASUREMENT
/begin MEASUREMENT HEGO_flgDrvDSMTripChgFinshdOBDElec "flag: DSM initialization done" UBYTE B_TRUE 1 100 0.00 1.00000000000 BIT_MASK 0x1 FORMAT "%13.11" ECU_ADDRESS 0x70000767 /end MEASUREMENT
/begin MEASUREMENT HEGO_flgEnaDWeakPsCmn "enabling condition for diagnosis of weak power stage w.r.t. ambient temperature" UBYTE B_TRUE 1 100 0.00 1.00000000000 BIT_MASK 0x1 FORMAT "%13.11" ECU_ADDRESS 0x70000765 /end MEASUREMENT
/begin MEASUREMENT HEGO_flgEnvtlCond "Environmental condition for heater performance diagnosis" UBYTE B_TRUE 1 100 0.00 1.00000000000 BIT_MASK 0x1 FORMAT "%13.11" ECU_ADDRESS 0x70000204 /end MEASUREMENT
/begin MEASUREMENT HEGO_flgExhS2B1AvlEF_I.buffer "edge falling: calibration flag HEGO-sensor 2 bank 1 present / memory to detect falling edge" UBYTE B_TRUE 1 100 0.00 1.00000000000 BIT_MASK 0x1 FORMAT "%13.11" ECU_ADDRESS 0x600037C4 /end MEASUREMENT
/begin MEASUREMENT HEGO_flgExhS2B1AvlEF_I.oldSignal "edge falling: calibration flag HEGO-sensor 2 bank 1 present / memory to detect falling edge" UBYTE B_TRUE 1 100 0.00 1.00000000000 BIT_MASK 0x1 FORMAT "%13.11" ECU_ADDRESS 0x600037C5 /end MEASUREMENT
/begin MEASUREMENT HEGO_flgFCMClrReqdOBDElec100msS2 "FCMClr reset variable" UBYTE B_TRUE 1 100 0.00 1.00000000000 BIT_MASK 0x1 FORMAT "%13.11" ECU_ADDRESS 0x70000764 /end MEASUREMENT
/begin MEASUREMENT HEGO_flgFCMClrReqdOBDElec10msS2 "FCMClr reset variable" UBYTE B_TRUE 1 100 0.00 1.00000000000 BIT_MASK 0x1 FORMAT "%13.11" ECU_ADDRESS 0x70000763 /end MEASUREMENT
/begin MEASUREMENT HEGO_flgFCMClrReqdOBDHtg "FCM-Clear requested" UBYTE B_TRUE 1 100 0.00 1.00000000000 BIT_MASK 0x1 FORMAT "%13.11" ECU_ADDRESS 0x70000203 /end MEASUREMENT
/begin MEASUREMENT HEGO_flgFCMClrReqdSens_100ms "HEGO_Sens Fault code memory clear requested for 100ms task" UBYTE B_TRUE 1 100 0.00 1.00000000000 BIT_MASK 0x1 FORMAT "%13.11" ECU_ADDRESS 0x70000762 /end MEASUREMENT
/begin MEASUREMENT HEGO_flgFCMClrReqdSens_10ms "HEGO_Sens Fault code memory clear requested for 10ms task" UBYTE B_TRUE 1 100 0.00 1.00000000000 BIT_MASK 0x1 FORMAT "%13.11" ECU_ADDRESS 0x70000761 /end MEASUREMENT
/begin MEASUREMENT HEGO_flgHtgClsdLopEnaS2B1 "Condition closed loop heater control enabled for sensor 2 bank 1" UBYTE B_TRUE 1 100 0.00 1.00000000000 BIT_MASK 0x1 FORMAT "%13.11" ECU_ADDRESS 0x70000760 /end MEASUREMENT
/begin MEASUREMENT HEGO_flgLamEnaElecMaxS2B1 "lambda not rich for ElecMax-Diagnosis for binary sensor 2 bank 1 (primarily with air reference)" UBYTE B_TRUE 1 100 0.00 1.00000000000 BIT_MASK 0x1 FORMAT "%13.11" ECU_ADDRESS 0x7000075F /end MEASUREMENT
/begin MEASUREMENT HEGO_flgNumVoltMeasmtElecMaxSuffS2B1 "flag number of voltage measurements sufficient for ElecMax (SCB) diagnosis debounce sensor 2 bank 1" UBYTE B_TRUE 1 100 0.00 1.00000000000 BIT_MASK 0x1 FORMAT "%13.11" ECU_ADDRESS 0x7000075E /end MEASUREMENT
/begin MEASUREMENT HEGO_flgPwrStgEnaCond "general enabling condition for power stage diagnosis" UBYTE B_TRUE 1 100 0.00 1.00000000000 BIT_MASK 0x1 FORMAT "%13.11" ECU_ADDRESS 0x7000075D /end MEASUREMENT
/begin MEASUREMENT HEGO_flgS2B1HtgOnDes "Desired condition for Heaer ON is set for Sensor 2 bank 1" UBYTE B_TRUE 1 100 0.00 1.00000000000 BIT_MASK 0x1 FORMAT "%13.11" ECU_ADDRESS 0x70000209 /end MEASUREMENT
/begin MEASUREMENT HEGO_flgS2B1InhbRiMeasmtElDiag "flag for inhibit of Ri measurement S2B1 during heater OFF state for voltage acquisition for ElecMax diagnosis." UBYTE B_TRUE 1 100 0.00 1.00000000000 BIT_MASK 0x1 FORMAT "%13.11" ECU_ADDRESS 0x7000075B /end MEASUREMENT
/begin MEASUREMENT HEGO_flgVldTstrS2B1 "sensor operation readiness of binary sensor 2 bank 1 for tester device" UBYTE B_TRUE 1 100 0.00 1.00000000000 BIT_MASK 0x1 FORMAT "%13.11" ECU_ADDRESS 0x60009F92 /end MEASUREMENT
/begin MEASUREMENT HEGO_HtgEnaS2B1_I.bEngStrtFinFF "Enable conditions for heating sensor 2 bank 1 / Bit enginge start finished (flip-flop)" UBYTE B_TRUE 1 100 0.00 1.00000000000 BIT_MASK 0x1 FORMAT "%13.11" ECU_ADDRESS 0x60003800 /end MEASUREMENT
/begin MEASUREMENT HEGO_HtgEnaS2B1_I.bHtgEna "Enable conditions for heating sensor 2 bank 1 / Bit heating enabled" UBYTE B_TRUE 1 100 0.00 1.00000000000 BIT_MASK 0x1 FORMAT "%13.11" ECU_ADDRESS 0x60003801 /end MEASUREMENT
/begin MEASUREMENT HEGO_HtgEnaS2B1_I.flgPhysEna "Enable conditions for heating sensor 2 bank 1 / Flag heating release by physical conditions" UBYTE B_TRUE 1 100 0.00 1.00000000000 BIT_MASK 0x1 FORMAT "%13.11" ECU_ADDRESS 0x60003802 /end MEASUREMENT
/begin MEASUREMENT HEGO_HtgEnaS2B1_I.BattHtgOffTONV_I.outbit "Enable conditions for heating sensor 2 bank 1 / Delay for heater turn-off in case of too high battery voltage / return value" UBYTE B_TRUE 1 100 0.00 1.00000000000 BIT_MASK 0x1 FORMAT "%13.11" ECU_ADDRESS 0x60003804 /end MEASUREMENT
/begin MEASUREMENT HEGO_HtgEnaS2B1_I.BattHtgOffTONV_I.time "Enable conditions for heating sensor 2 bank 1 / Delay for heater turn-off in case of too high battery voltage / expired delay time" UBYTE t_q0p1 1 100 0.00 25.50 FORMAT "%5.2" ECU_ADDRESS 0x60003805 /end MEASUREMENT
/begin MEASUREMENT HEGO_HtgEnaS2B1_I.DebHtgPreDriveTOFFV_I.outbit "Enable conditions for heating sensor 2 bank 1 / Debouncing of HEGO sensor heating during predrive / Output Bit" UBYTE B_TRUE 1 100 0.00 1.00000000000 BIT_MASK 0x1 FORMAT "%13.11" ECU_ADDRESS 0x60003806 /end MEASUREMENT
/begin MEASUREMENT HEGO_HtgEnaS2B1_I.DebHtgPreDriveTOFFV_I.time "Enable conditions for heating sensor 2 bank 1 / Debouncing of HEGO sensor heating during predrive / Occured Time" UWORD t_q0p1 1 100 0.00 6553.500 FORMAT "%8.3" ECU_ADDRESS 0x60003808 /end MEASUREMENT
/begin MEASUREMENT HEGO_HtgS2B1_I.bDebHtgStrt "Heating, HEGO sensor 2 bank 1 / Bit condition for heating during start phase debounced" UBYTE B_TRUE 1 100 0.00 1.00000000000 BIT_MASK 0x1 FORMAT "%13.11" ECU_ADDRESS 0x60036584 /end MEASUREMENT
/begin MEASUREMENT HEGO_HtgS2B1_I.bHtgClsdLopAntiWndUp "Heating, HEGO sensor 2 bank 1 / Bit anti wind up of for closed loop heating control" UBYTE B_TRUE 1 100 0.00 1.00000000000 BIT_MASK 0x1 FORMAT "%13.11" ECU_ADDRESS 0x500015D0 /end MEASUREMENT
/begin MEASUREMENT HEGO_HtgS2B1_I.bHtgClsdLopEna "Heating, HEGO sensor 2 bank 1 / Bit enable closed loop heating control" UBYTE B_TRUE 1 100 0.00 1.00000000000 BIT_MASK 0x1 FORMAT "%13.11" ECU_ADDRESS 0x500015D2 /end MEASUREMENT
/begin MEASUREMENT HEGO_HtgS2B1_I.bHtgClsdLopRiReq "Heating, HEGO sensor 2 bank 1 / Bit Ri request from closed loop heating control" UBYTE B_TRUE 1 100 0.00 1.00000000000 BIT_MASK 0x4 FORMAT "%13.11" ECU_ADDRESS 0x500015D1 /end MEASUREMENT
/begin MEASUREMENT HEGO_HtgS2B1_I.bHtgEna "Heating, HEGO sensor 2 bank 1 / Flag heating released" UBYTE B_TRUE 1 100 0.00 1.00000000000 BIT_MASK 0x1 FORMAT "%13.11" ECU_ADDRESS 0x60006461 /end MEASUREMENT
/begin MEASUREMENT HEGO_HtgS2B1_I.bHtgMap "Heating, HEGO sensor 2 bank 1 / Bit map controlled heating" UBYTE B_TRUE 1 100 0.00 1.00000000000 BIT_MASK 0x2 FORMAT "%13.11" ECU_ADDRESS 0x500015D0 /end MEASUREMENT
/begin MEASUREMENT HEGO_HtgS2B1_I.bHtgOffHiTemp "Heating, HEGO sensor 2 bank 1 / Bit heating turned of because of too high temperature" UBYTE B_TRUE 1 100 0.00 1.00000000000 BIT_MASK 0x4 FORMAT "%13.11" ECU_ADDRESS 0x500015D0 /end MEASUREMENT
/begin MEASUREMENT HEGO_HtgS2B1_I.bHtgPrtFin "Heating, HEGO sensor 2 bank 1 / Bit protective heating finisihed" UBYTE B_TRUE 1 100 0.00 1.00000000000 BIT_MASK 0x8 FORMAT "%13.11" ECU_ADDRESS 0x500015D1 /end MEASUREMENT
/begin MEASUREMENT HEGO_HtgS2B1_I.bHtgPrtInhb "Heating, HEGO sensor 2 bank 1 / Bit protective heating inhibited" UBYTE B_TRUE 1 100 0.00 1.00000000000 BIT_MASK 0x10 FORMAT "%13.11" ECU_ADDRESS 0x500015D1 /end MEASUREMENT
/begin MEASUREMENT HEGO_HtgS2B1_I.bHtgStrt "Heating, HEGO sensor 2 bank 1 / Bit heating during start phase" UBYTE B_TRUE 1 100 0.00 1.00000000000 BIT_MASK 0x1 FORMAT "%13.11" ECU_ADDRESS 0x500015D3 /end MEASUREMENT
/begin MEASUREMENT HEGO_HtgS2B1_I.bHtgStrtInhb "Heating, HEGO sensor 2 bank 1 / Bit heating during start phase inhibited" UBYTE B_TRUE 1 100 0.00 1.00000000000 BIT_MASK 0x20 FORMAT "%13.11" ECU_ADDRESS 0x500015D1 /end MEASUREMENT
/begin MEASUREMENT HEGO_HtgS2B1_I.bHtgStrtPwrRed "Heating, HEGO sensor 2 bank 1 / Bit reduced heating power during start phase" UBYTE B_TRUE 1 100 0.00 1.00000000000 BIT_MASK 0x8 FORMAT "%13.11" ECU_ADDRESS 0x500015D0 /end MEASUREMENT
/begin MEASUREMENT HEGO_HtgS2B1_I.bHtgSuff "Heating, HEGO sensor 2 bank 1 / Bit sufficient heating" UBYTE B_TRUE 1 100 0.00 1.00000000000 BIT_MASK 0x1 FORMAT "%13.11" ECU_ADDRESS 0x500015D4 /end MEASUREMENT
/begin MEASUREMENT HEGO_HtgS2B1_I.bRiActAvl "Heating, HEGO sensor 2 bank 1 / Actual Ri value available" UBYTE B_TRUE 1 100 0.00 1.00000000000 BIT_MASK 0x80 FORMAT "%13.11" ECU_ADDRESS 0x500015D1 /end MEASUREMENT
/begin MEASUREMENT HEGO_HtgS2B1_I.cycHtgCntr "Heating, HEGO sensor 2 bank 1 / Counter of remaining heating cycles in heating period" UBYTE dez 1 100 0.00 250.0 FORMAT "%5.1" ECU_ADDRESS 0x500001A0 /end MEASUREMENT
/begin MEASUREMENT HEGO_HtgS2B1_I.dresRi "Heating, HEGO sensor 2 bank 1 / Internal resistance difference for closed loop heating controller" SWORD r_uw_q2 1 100 -65536.00 65534.00 FORMAT "%8.2" ECU_ADDRESS 0x500015D6 /end MEASUREMENT
/begin MEASUREMENT HEGO_HtgS2B1_I.duNomHtgClsdLop "Heating, HEGO sensor 2 bank 1 / Nominal heating voltage correction of closed loop heating control" SWORD spg_q0p00039 1 100 -12.80000 12.79961 FORMAT "%8.5" ECU_ADDRESS 0x500015D8 /end MEASUREMENT
/begin MEASUREMENT HEGO_HtgS2B1_I.duNomHtgI "Heating, HEGO sensor 2 bank 1 / Nominal heating voltage correction of closed loop heating control, I-part" SWORD spg_q0p00039 1 100 -12.80000 12.79961 FORMAT "%8.5" ECU_ADDRESS 0x500015DA /end MEASUREMENT
/begin MEASUREMENT HEGO_HtgS2B1_I.duNomHtgP "Heating, HEGO sensor 2 bank 1 / Nominal heating voltage correction of closed loop heating control, P-part" SWORD spg_q0p00039 1 100 -12.80000 12.79961 FORMAT "%8.5" ECU_ADDRESS 0x500015DC /end MEASUREMENT
/begin MEASUREMENT HEGO_HtgS2B1_I.flgHtgOnReq "Heating, HEGO sensor 2 bank 1 / Flag heating on request" UBYTE B_TRUE 1 100 0.00 1.00000000000 BIT_MASK 0x1 FORMAT "%13.11" ECU_ADDRESS 0x500001A1 /end MEASUREMENT
/begin MEASUREMENT HEGO_HtgS2B1_I.flgInhbRiElecMax "Heating, HEGO sensor 2 bank 1 / flag for inhibit of Ri measurement during heater OFF state for voltage acquisition for ElecMax diagnosis." UBYTE B_TRUE 1 100 0.00 1.00000000000 BIT_MASK 0x1 FORMAT "%13.11" ECU_ADDRESS 0x500001A2 /end MEASUREMENT
/begin MEASUREMENT HEGO_HtgS2B1_I.flgRiHtgStrtPwrRed "Heating, HEGO sensor 2 bank 1 / Flag to start heating power reduction based of sensor resistance treshold" UBYTE B_TRUE 1 100 0.00 1.00000000000 BIT_MASK 0x40 FORMAT "%13.11" ECU_ADDRESS 0x500015D0 /end MEASUREMENT
/begin MEASUREMENT HEGO_HtgS2B1_I.mEGHtg "Heating, HEGO sensor 2 bank 1 / Exhaust gass mass flow for sensor heating" UWORD m_uw_b6553p5 1 100 0.00 6553.500 FORMAT "%8.3" ECU_ADDRESS 0x500015DE /end MEASUREMENT
/begin MEASUREMENT HEGO_HtgS2B1_I.numHtgCycDif "Heating, HEGO sensor 2 bank 1 / Difference between number of heating on cycles setpoint and actual value" UWORD fak_q3p906Em5 1 100 0.00 2.559961 FORMAT "%8.6" ECU_ADDRESS 0x500001A4 /end MEASUREMENT
/begin MEASUREMENT HEGO_HtgS2B1_I.numHtgCycOffReq "Heating, HEGO sensor 2 bank 1 / Requested number of heating off cycles in heating period" UBYTE dez 1 100 0.00 250.0 FORMAT "%5.1" ECU_ADDRESS 0x500001A6 /end MEASUREMENT
/begin MEASUREMENT HEGO_HtgS2B1_I.numHtgCycOnReq "Heating, HEGO sensor 2 bank 1 / Requested number of heating on cycles in heating period" UBYTE dez 1 100 0.00 250.0 FORMAT "%5.1" ECU_ADDRESS 0x500001A7 /end MEASUREMENT
/begin MEASUREMENT HEGO_HtgS2B1_I.numVoltMeasmtElecMaxPrev "Heating, HEGO sensor 2 bank 1 / lalst value of numVoltMeasmtElecMax for indication of new voltage measurement for ElecMax diagnosis" UBYTE dez 1 100 0.00 255.0 FORMAT "%5.1" ECU_ADDRESS 0x500001A8 /end MEASUREMENT
/begin MEASUREMENT HEGO_HtgS2B1_I.pwrHtg "Heating, HEGO sensor 2 bank 1 / Normalized heating power" UBYTE fak_q0p01 1 100 0.00 2.550 FORMAT "%5.3" ECU_ADDRESS 0x500015E0 /end MEASUREMENT
/begin MEASUREMENT HEGO_HtgS2B1_I.pwrHtgOnRls "Heating, HEGO sensor 2 bank 1 / Normalized heating power with released heating" UBYTE fak_q0p01 1 100 0.00 2.550 FORMAT "%5.3" ECU_ADDRESS 0x500015E1 /end MEASUREMENT
/begin MEASUREMENT HEGO_HtgS2B1_I.rHtg "Heating, HEGO sensor 2 bank 1 / Sensor heating duty ratio" UWORD fak_q3p906Em5 1 100 0.00 2.559961 FORMAT "%8.6" ECU_ADDRESS 0x500015E2 /end MEASUREMENT
/begin MEASUREMENT HEGO_HtgS2B1_I.rHtgLim "Heating, HEGO sensor 2 bank 1 / Sensor limited heating duty ratio" UWORD fak_q3p906Em5 1 100 0.00 1.000000 FORMAT "%8.6" ECU_ADDRESS 0x500015E4 /end MEASUREMENT
/begin MEASUREMENT HEGO_HtgS2B1_I.resRiAct "Heating, HEGO sensor 2 bank 1 / Actual internal resistance" UWORD r_uw_q2 1 100 0.00 131070.0 FORMAT "%8.1" ECU_ADDRESS 0x500015E6 /end MEASUREMENT
/begin MEASUREMENT HEGO_HtgS2B1_I.resRiNom "Heating, HEGO sensor 2 bank 1 / Nominal internal resistance" SWORD r_uw_q2 1 100 -65536.00 65534.00 FORMAT "%8.2" ECU_ADDRESS 0x500015E8 /end MEASUREMENT
/begin MEASUREMENT HEGO_HtgS2B1_I.tEGFltHtg "Heating, HEGO sensor 2 bank 1 / Filtered exhaust gas temperature for sensor heating" UWORD temp_q0p0234_o273 1 100 -273.150 1262.827 FORMAT "%8.3" ECU_ADDRESS 0x500015EA /end MEASUREMENT
/begin MEASUREMENT HEGO_HtgS2B1_I.tEg "Heating, HEGO sensor 2 bank 1 / Exhaust gas temperature at lambda sensor" UWORD temp_q0p0234_o273 1 100 -273.150 1262.827 FORMAT "%8.3" ECU_ADDRESS 0x500015EC /end MEASUREMENT
/begin MEASUREMENT HEGO_HtgS2B1_I.tExhSnsrDyn "Heating, HEGO sensor 2 bank 1 / exhasut temperature gradient at sensor position" SWORD temp_q0p0234_o273 1 100 -1041.150 494.827 FORMAT "%8.3" ECU_ADDRESS 0x500015EE /end MEASUREMENT
/begin MEASUREMENT HEGO_HtgS2B1_I.tiFilTExhSn "Heating, HEGO sensor 2 bank 1 / filter time constant of low pass exhaust gas temperature filter" UWORD zk100msxs_uw_b6553p6 1 100 0.1000015 6553.6000000 FORMAT "%12.7" ECU_ADDRESS 0x500015F0 /end MEASUREMENT
/begin MEASUREMENT HEGO_HtgS2B1_I.tiHtgOn "Heating, HEGO sensor 2 bank 1 / Heater on-time" UBYTE t_q0p001 1 100 0.00 0.2550 FORMAT "%6.4" ECU_ADDRESS 0x500015F2 /end MEASUREMENT
/begin MEASUREMENT HEGO_HtgS2B1_I.tiHtgPrt "Heating, HEGO sensor 2 bank 1 / Duration of protective heating" UWORD t_q0p1 1 100 0.00 6553.500 FORMAT "%8.3" ECU_ADDRESS 0x500015F4 /end MEASUREMENT
/begin MEASUREMENT HEGO_HtgS2B1_I.uBattHtg "Heating, HEGO sensor 2 bank 1 / Corrected battery voltage for sensor heating" UWORD spg_q0p00039 1 100 0.00 25.59961 FORMAT "%8.5" ECU_ADDRESS 0x500015F6 /end MEASUREMENT
/begin MEASUREMENT HEGO_HtgS2B1_I.uNomHtg "Heating, HEGO sensor 2 bank 1 / Nominal heating voltage" UWORD spg_q0p00039 1 100 0.00 25.59961 FORMAT "%8.5" ECU_ADDRESS 0x500015F8 /end MEASUREMENT
/begin MEASUREMENT HEGO_HtgS2B1_I.uNomHtgAftPrt "Heating, HEGO sensor 2 bank 1 / Nominal heating voltage after protective heating" UWORD spg_q0p00039 1 100 0.00 25.59961 FORMAT "%8.5" ECU_ADDRESS 0x500015FA /end MEASUREMENT
/begin MEASUREMENT HEGO_HtgS2B1_I.uNomHtgLim "Heating, HEGO sensor 2 bank 1 / Limited nominal heating voltage" UWORD spg_q0p00039 1 100 0.00 25.59961 FORMAT "%8.5" ECU_ADDRESS 0x500015FC /end MEASUREMENT
/begin MEASUREMENT HEGO_HtgS2B1_I.uNomHtgMap "Heating, HEGO sensor 2 bank 1 / Nominal heating voltage during open loop control (map)" UWORD spg_q0p00039 1 100 0.00 25.59961 FORMAT "%8.5" ECU_ADDRESS 0x500015FE /end MEASUREMENT
/begin MEASUREMENT HEGO_HtgS2B1_I.uNomHtgNoLim "Heating, HEGO sensor 2 bank 1 / Nominal heating voltage without limiting" UWORD spg_q0p00039 1 100 0.00 25.59961 FORMAT "%8.5" ECU_ADDRESS 0x50001600 /end MEASUREMENT
/begin MEASUREMENT HEGO_HtgS2B1_I.uNomHtgStrt "Heating, HEGO sensor 2 bank 1 / Nominal heating voltage during start phase" UWORD spg_q0p00039 1 100 0.00 25.59961 FORMAT "%8.5" ECU_ADDRESS 0x50001602 /end MEASUREMENT
/begin MEASUREMENT HEGO_HtgS2B1_I.DebAtmstTONV_I.outbit "Heating, HEGO sensor 2 bank 1 / TONV: Debounced condition sensor temperature calculated from dew-point / return value" UBYTE B_TRUE 1 100 0.00 1.00000000000 BIT_MASK 0x1 FORMAT "%13.11" ECU_ADDRESS 0x50001604 /end MEASUREMENT
/begin MEASUREMENT HEGO_HtgS2B1_I.DebAtmstTONV_I.time "Heating, HEGO sensor 2 bank 1 / TONV: Debounced condition sensor temperature calculated from dew-point / expired delay time" UWORD t_q0p1 1 100 0.00 6553.500 FORMAT "%8.3" ECU_ADDRESS 0x50001606 /end MEASUREMENT
/begin MEASUREMENT HEGO_HtgS2B1_I.DebHeatgStrtTONV_I.outbit "Heating, HEGO sensor 2 bank 1 / TONV: Condition for heating during start phase / return value" UBYTE B_TRUE 1 100 0.00 1.00000000000 BIT_MASK 0x1 FORMAT "%13.11" ECU_ADDRESS 0x50001608 /end MEASUREMENT
/begin MEASUREMENT HEGO_HtgS2B1_I.DebHeatgStrtTONV_I.time "Heating, HEGO sensor 2 bank 1 / TONV: Condition for heating during start phase / expired delay time" UWORD t_q0p1 1 100 0.00 6553.500 FORMAT "%8.3" ECU_ADDRESS 0x5000160A /end MEASUREMENT
/begin MEASUREMENT HEGO_HtgS2B1_I.DebHtgMapClsdLopTONV_I.outbit "Heating, HEGO sensor 2 bank 1 / Debouncing for activation of closed loop heating control / return value" UBYTE B_TRUE 1 100 0.00 1.00000000000 BIT_MASK 0x1 FORMAT "%13.11" ECU_ADDRESS 0x5000160C /end MEASUREMENT
/begin MEASUREMENT HEGO_HtgS2B1_I.DebHtgMapClsdLopTONV_I.time "Heating, HEGO sensor 2 bank 1 / Debouncing for activation of closed loop heating control / expired delay time" UWORD t_q0p1 1 100 0.00 6553.500 FORMAT "%8.3" ECU_ADDRESS 0x5000160E /end MEASUREMENT
/begin MEASUREMENT HEGO_HtgS2B1_I.DebHtgMaxTOFFV_I.outbit "Heating, HEGO sensor 2 bank 1 / Debouncing of heating with maximum allowable power / Output Bit" UBYTE B_TRUE 1 100 0.00 1.00000000000 BIT_MASK 0x1 FORMAT "%13.11" ECU_ADDRESS 0x50001610 /end MEASUREMENT
/begin MEASUREMENT HEGO_HtgS2B1_I.DebHtgMaxTOFFV_I.time "Heating, HEGO sensor 2 bank 1 / Debouncing of heating with maximum allowable power / Occured Time" UWORD t_q0p1 1 100 0.00 6553.500 FORMAT "%8.3" ECU_ADDRESS 0x50001612 /end MEASUREMENT
/begin MEASUREMENT HEGO_HtgS2B1_I.DebHtgStrtUsTONV_I.outbit "Heating, HEGO sensor 2 bank 1 / Debouncing of heating during start phase depending on upstream sensor / return value" UBYTE B_TRUE 1 100 0.00 1.00000000000 BIT_MASK 0x1 FORMAT "%13.11" ECU_ADDRESS 0x50001616 /end MEASUREMENT
/begin MEASUREMENT HEGO_HtgS2B1_I.DebHtgStrtUsTONV_I.time "Heating, HEGO sensor 2 bank 1 / Debouncing of heating during start phase depending on upstream sensor / expired delay time" UBYTE t_q0p1 1 100 0.00 25.50 FORMAT "%5.2" ECU_ADDRESS 0x50001617 /end MEASUREMENT
/begin MEASUREMENT HEGO_HtgS2B1_I.DebNewRiAvlTOFFV_I.outbit "Heating, HEGO sensor 2 bank 1 / TOFFV: Debounced new internal resistance value availble / Output Bit" UBYTE B_TRUE 1 100 0.00 1.00000000000 BIT_MASK 0x1 FORMAT "%13.11" ECU_ADDRESS 0x50001618 /end MEASUREMENT
/begin MEASUREMENT HEGO_HtgS2B1_I.DebNewRiAvlTOFFV_I.time "Heating, HEGO sensor 2 bank 1 / TOFFV: Debounced new internal resistance value availble / Occured Time" UWORD t_q0p1 1 100 0.00 6553.500 FORMAT "%8.3" ECU_ADDRESS 0x5000161A /end MEASUREMENT
/begin MEASUREMENT HEGO_HtgS2B1_I.DebNewRiTOFFV_I.outbit "Heating, HEGO sensor 2 bank 1 / Debounce for new internal resistance request / Output Bit" UBYTE B_TRUE 1 100 0.00 1.00000000000 BIT_MASK 0x1 FORMAT "%13.11" ECU_ADDRESS 0x5000161C /end MEASUREMENT
/begin MEASUREMENT HEGO_HtgS2B1_I.DebNewRiTOFFV_I.time "Heating, HEGO sensor 2 bank 1 / Debounce for new internal resistance request / Occured Time" UWORD t_q0p1 1 100 0.00 6553.500 FORMAT "%8.3" ECU_ADDRESS 0x5000161E /end MEASUREMENT
/begin MEASUREMENT HEGO_HtgS2B1_I.DebRiActAvlTOFFV_I.outbit "Heating, HEGO sensor 2 bank 1 / Debouncing for internal resistance actual available / Output Bit" UBYTE B_TRUE 1 100 0.00 1.00000000000 BIT_MASK 0x1 FORMAT "%13.11" ECU_ADDRESS 0x50001620 /end MEASUREMENT
/begin MEASUREMENT HEGO_HtgS2B1_I.DebRiActAvlTOFFV_I.time "Heating, HEGO sensor 2 bank 1 / Debouncing for internal resistance actual available / Occured Time" UBYTE t_q0p1 1 100 0.00 25.50 FORMAT "%5.2" ECU_ADDRESS 0x50001621 /end MEASUREMENT
/begin MEASUREMENT HEGO_HtgS2B1_I.HtgRedTONV_I.outbit "Heating, HEGO sensor 2 bank 1 / Delay until reduction of heating power / return value" UBYTE B_TRUE 1 100 0.00 1.00000000000 BIT_MASK 0x1 FORMAT "%13.11" ECU_ADDRESS 0x50001622 /end MEASUREMENT
/begin MEASUREMENT HEGO_HtgS2B1_I.HtgRedTONV_I.time "Heating, HEGO sensor 2 bank 1 / Delay until reduction of heating power / expired delay time" UWORD t_q0p1 1 100 0.00 6553.500 FORMAT "%8.3" ECU_ADDRESS 0x50001624 /end MEASUREMENT
/begin MEASUREMENT HEGO_HtgS2B1_I.RiHtgLT_I.memory "Heating, HEGO sensor 2 bank 1 / Filtered internal resistance for heating / current lowpass value" ULONG r_q3p0518Em5 1 100 0.00 131071.999969 FORMAT "%13.6" ECU_ADDRESS 0x50001628 /end MEASUREMENT
/begin MEASUREMENT HEGO_HtgS2B1_I.bHtgStrtEF_I.buffer "Heating, HEGO sensor 2 bank 1 / Falling edge of bHtgStrt / memory to detect falling edge" UBYTE B_TRUE 1 100 0.00 1.00000000000 BIT_MASK 0x1 FORMAT "%13.11" ECU_ADDRESS 0x5000162C /end MEASUREMENT
/begin MEASUREMENT HEGO_HtgS2B1_I.bHtgStrtEF_I.oldSignal "Heating, HEGO sensor 2 bank 1 / Falling edge of bHtgStrt / memory to detect falling edge" UBYTE B_TRUE 1 100 0.00 1.00000000000 BIT_MASK 0x1 FORMAT "%13.11" ECU_ADDRESS 0x5000162D /end MEASUREMENT
/begin MEASUREMENT HEGO_HtgS2B1_I.bHtgStrtPwrRedEF_I.buffer "Heating, HEGO sensor 2 bank 1 / Edge falling of bit heating start of power reduction / memory to detect falling edge" UBYTE B_TRUE 1 100 0.00 1.00000000000 BIT_MASK 0x1 FORMAT "%13.11" ECU_ADDRESS 0x50001630 /end MEASUREMENT
/begin MEASUREMENT HEGO_HtgS2B1_I.bHtgStrtPwrRedEF_I.oldSignal "Heating, HEGO sensor 2 bank 1 / Edge falling of bit heating start of power reduction / memory to detect falling edge" UBYTE B_TRUE 1 100 0.00 1.00000000000 BIT_MASK 0x1 FORMAT "%13.11" ECU_ADDRESS 0x50001631 /end MEASUREMENT
/begin MEASUREMENT HEGO_HtgS2B1_I.bRiActAvlER_I.buffer "Heating, HEGO sensor 2 bank 1 / Rising edge of bRiActAvl / rising edge detected" UBYTE B_TRUE 1 100 0.00 1.00000000000 BIT_MASK 0x1 FORMAT "%13.11" ECU_ADDRESS 0x50001634 /end MEASUREMENT
/begin MEASUREMENT HEGO_HtgS2B1_I.bRiActAvlER_I.oldSignal "Heating, HEGO sensor 2 bank 1 / Rising edge of bRiActAvl / flag rising edge" UBYTE B_TRUE 1 100 0.00 1.00000000000 BIT_MASK 0x1 FORMAT "%13.11" ECU_ADDRESS 0x50001635 /end MEASUREMENT
/begin MEASUREMENT HEGO_HtgS2B1_I.duNomHtgITL_I.memory "Heating, HEGO sensor 2 bank 1 / Nominal heating voltage correction of closed loop heating control, integrator / current integrator value" SLONG dez 1 100 -2147483648.00 2147483647.00 FORMAT "%13.2" ECU_ADDRESS 0x50001638 /end MEASUREMENT
/begin MEASUREMENT HEGO_HtgS2B1_I.flgIntrptHeatgElDiagSW_I.timeCounter "Heating, HEGO sensor 2 bank 1 / stop watch i.o.t. guarantee interrupting heater for diagnosis each 500ms / expired time since start" UWORD t_q1_ms 1 100 0.00 65535.00 FORMAT "%8.2" ECU_ADDRESS 0x500001AA /end MEASUREMENT
/begin MEASUREMENT HEGO_HtgS2B1_I.tEGHtgLT_I.memory "Heating, HEGO sensor 2 bank 1 / Low-pass filter for exhaust gas temperature / current lowpass value" ULONG temp_q3p57Em7_om273 1 100 -273.15000000 1262.84999964 FORMAT "%13.8" ECU_ADDRESS 0x5000163C /end MEASUREMENT
/begin MEASUREMENT HEGO_HtgS2B1_I.tExhSnsrLT_I.memory "Heating, HEGO sensor 2 bank 1 / Lowpass for exhaustgas temperature / current lowpass value" ULONG temp_q3p57Em7_om273 1 100 -273.15000000 1262.84999964 FORMAT "%13.8" ECU_ADDRESS 0x50001640 /end MEASUREMENT
/begin MEASUREMENT HEGO_HtgS2B1_I.tiHtgPrtSW_I.timeCounter "Heating, HEGO sensor 2 bank 1 / Protective heating duration / expired time since start" UWORD t_q0p1 1 100 0.00 6553.500 FORMAT "%8.3" ECU_ADDRESS 0x50001644 /end MEASUREMENT
/begin MEASUREMENT HEGO_HtgS2B1_I.uNomHtgStrtAL_I.memory "Heating, HEGO sensor 2 bank 1 / Nominal heating voltage during start phase / Accumulator" SLONG spg_q0p00039 1 100 -838860.800000 838860.799609 FORMAT "%13.6" ECU_ADDRESS 0x50001648 /end MEASUREMENT
/begin MEASUREMENT HEGO_Htg_ctReIni "Counter for Re-Initialization request for HEGO_Htg" UBYTE OneToOne 1 100 0.00 255.0 FORMAT "%5.1" ECU_ADDRESS 0x60006462 /end MEASUREMENT
/begin MEASUREMENT HEGO_idxSensRiPls "Sensor index for measurement of internal resistance" UBYTE dez 1 100 0.00 255.0 FORMAT "%5.1" ECU_ADDRESS 0x6000645E /end MEASUREMENT
/begin MEASUREMENT HEGO_numCalcRiS2B1 "numerator for indication of executed Ri-pulse sensor 2 bank 1" UBYTE dez 1 100 0.00 255.0 FORMAT "%5.1" ECU_ADDRESS 0x6000A046 /end MEASUREMENT
/begin MEASUREMENT HEGO_numNewRiS2B1 "Numerator for indication of a new Ri value sensor 2 bank 1" UBYTE dez 1 100 0.00 255.0 FORMAT "%5.1" ECU_ADDRESS 0x6000A045 /end MEASUREMENT
/begin MEASUREMENT HEGO_numTCerRiVldS2B1 "indication of a valid ceramic temperature sensor 2 bank 1, when numerator is incremented" UBYTE dez 1 100 0.00 255.0 FORMAT "%5.1" ECU_ADDRESS 0x6000A3A5 /end MEASUREMENT
/begin MEASUREMENT HEGO_numVoltMeasmtElecMaxS2B1 "running counter of voltage measurement S2B1 during heater OFF state wo. Ri-pulse." UBYTE dez 1 100 0.00 255.0 FORMAT "%5.1" ECU_ADDRESS 0x70001C29 /end MEASUREMENT
/begin MEASUREMENT HEGO_OBDElecS2B1_I.bErrElecMinWoDeb "Electrical diagnostics, HEGO sensor 2 bank 1 / Bit electrical error without debouncing" UBYTE B_TRUE 1 100 0.00 1.00000000000 BIT_MASK 0x1 FORMAT "%13.11" ECU_ADDRESS 0x600037D9 /end MEASUREMENT
/begin MEASUREMENT HEGO_OBDElecS2B1_I.bErrElecSig "Electrical diagnostics, HEGO sensor 2 bank 1 / Bit electrical sig error (wire interruption)" UBYTE B_TRUE 1 100 0.00 1.00000000000 BIT_MASK 0x1 FORMAT "%13.11" ECU_ADDRESS 0x600037DA /end MEASUREMENT
/begin MEASUREMENT HEGO_OBDElecS2B1_I.bErrElecSus "Electrical diagnostics, HEGO sensor 2 bank 1 / Bit suspicion of electical sensor failure" UBYTE B_TRUE 1 100 0.00 1.00000000000 BIT_MASK 0x1 FORMAT "%13.11" ECU_ADDRESS 0x600037DB /end MEASUREMENT
/begin MEASUREMENT HEGO_OBDElecS2B1_I.bErrHtrCpl "Electrical diagnostics, HEGO sensor 2 bank 1 / Bit electrical error heater coupling" UBYTE B_TRUE 1 100 0.00 1.00000000000 BIT_MASK 0x1 FORMAT "%13.11" ECU_ADDRESS 0x600037DC /end MEASUREMENT
/begin MEASUREMENT HEGO_OBDElecS2B1_I.bFCMClrReqdCL100ms "Electrical diagnostics, HEGO sensor 2 bank 1 / FCM Clear request for CL_100ms task" UBYTE B_TRUE 1 100 0.00 1.00000000000 BIT_MASK 0x1 FORMAT "%13.11" ECU_ADDRESS 0x600037DD /end MEASUREMENT
/begin MEASUREMENT HEGO_OBDElecS2B1_I.bNoErrElecMinSus "Electrical diagnostics, HEGO sensor 2 bank 1 / Bit no electrical min error suspicion" UBYTE B_TRUE 1 100 0.00 1.00000000000 BIT_MASK 0x1 FORMAT "%13.11" ECU_ADDRESS 0x600037D8 /end MEASUREMENT
/begin MEASUREMENT HEGO_OBDElecS2B1_I.ctReset100ms "Electrical diagnostics, HEGO sensor 2 bank 1 / Post drive leave counter for 100ms process" UBYTE OneToOne 1 100 0.00 255.0 FORMAT "%5.1" ECU_ADDRESS 0x600037DE /end MEASUREMENT
/begin MEASUREMENT HEGO_OBDElecS2B1_I.flgDiagElecMax "Electrical diagnostics, HEGO sensor 2 bank 1 / Condition Elec Max diagnosis done" UBYTE B_TRUE 1 100 0.00 1.00000000000 BIT_MASK 0x2 FORMAT "%13.11" ECU_ADDRESS 0x600037D8 /end MEASUREMENT
/begin MEASUREMENT HEGO_OBDElecS2B1_I.flgDiagElecMaxUHi "Electrical diagnostics, HEGO sensor 2 bank 1 / internal flag, that SCB diagnosis is debounced completely." UBYTE B_TRUE 1 100 0.00 1.00000000000 BIT_MASK 0x4 FORMAT "%13.11" ECU_ADDRESS 0x600037D8 /end MEASUREMENT
/begin MEASUREMENT HEGO_OBDElecS2B1_I.flgDiagElecMin "Electrical diagnostics, HEGO sensor 2 bank 1 / Condition Elec Min diagnosis done" UBYTE B_TRUE 1 100 0.00 1.00000000000 BIT_MASK 0x8 FORMAT "%13.11" ECU_ADDRESS 0x600037D8 /end MEASUREMENT
/begin MEASUREMENT HEGO_OBDElecS2B1_I.flgErrElecMax "Electrical diagnostics, HEGO sensor 2 bank 1 / internal flag, that SCB error has been detected." UBYTE B_TRUE 1 100 0.00 1.00000000000 BIT_MASK 0x10 FORMAT "%13.11" ECU_ADDRESS 0x600037D8 /end MEASUREMENT
/begin MEASUREMENT HEGO_OBDElecS2B1_I.flgLamEnaElecMax "Electrical diagnostics, HEGO sensor 2 bank 1 / lambda not rich for ElecMax-Diagnosis for binary sensor (primarily with air reference)" UBYTE B_TRUE 1 100 0.00 1.00000000000 BIT_MASK 0x1 FORMAT "%13.11" ECU_ADDRESS 0x600037DF /end MEASUREMENT
/begin MEASUREMENT HEGO_OBDElecS2B1_I.flgNumvoltMeasmtElecMaxSuff "Electrical diagnostics, HEGO sensor 2 bank 1 / internal flag: necessary number of voltage measurements during heater off state for ElecMax diagnosis is reached." UBYTE B_TRUE 1 100 0.00 1.00000000000 BIT_MASK 0x20 FORMAT "%13.11" ECU_ADDRESS 0x600037D8 /end MEASUREMENT
/begin MEASUREMENT HEGO_OBDElecS2B1_I.DebDiagElecMaxTONV_I.outbit "Electrical diagnostics, HEGO sensor 2 bank 1 / Debounce for Elec Max diagnosis enabling conditions / return value" UBYTE B_TRUE 1 100 0.00 1.00000000000 BIT_MASK 0x1 FORMAT "%13.11" ECU_ADDRESS 0x600037E0 /end MEASUREMENT
/begin MEASUREMENT HEGO_OBDElecS2B1_I.DebDiagElecMaxTONV_I.time "Electrical diagnostics, HEGO sensor 2 bank 1 / Debounce for Elec Max diagnosis enabling conditions / expired delay time" UBYTE t_q0p1 1 100 0.00 25.50 FORMAT "%5.2" ECU_ADDRESS 0x600037E1 /end MEASUREMENT
/begin MEASUREMENT HEGO_OBDElecS2B1_I.DebDiagElecMinTONV_I.outbit "Electrical diagnostics, HEGO sensor 2 bank 1 / Debounce for Elec Min diagnosis enabling conditions / return value" UBYTE B_TRUE 1 100 0.00 1.00000000000 BIT_MASK 0x1 FORMAT "%13.11" ECU_ADDRESS 0x600037E2 /end MEASUREMENT
/begin MEASUREMENT HEGO_OBDElecS2B1_I.DebDiagElecMinTONV_I.time "Electrical diagnostics, HEGO sensor 2 bank 1 / Debounce for Elec Min diagnosis enabling conditions / expired delay time" UBYTE t_q0p1 1 100 0.00 25.50 FORMAT "%5.2" ECU_ADDRESS 0x600037E3 /end MEASUREMENT
/begin MEASUREMENT HEGO_OBDElecS2B1_I.DebErrElecMaxTONV_I.outbit "Electrical diagnostics, HEGO sensor 2 bank 1 / Debouncing of electrical max error (short to battery voltage) / return value" UBYTE B_TRUE 1 100 0.00 1.00000000000 BIT_MASK 0x1 FORMAT "%13.11" ECU_ADDRESS 0x600037E4 /end MEASUREMENT
/begin MEASUREMENT HEGO_OBDElecS2B1_I.DebErrElecMaxTONV_I.time "Electrical diagnostics, HEGO sensor 2 bank 1 / Debouncing of electrical max error (short to battery voltage) / expired delay time" UBYTE t_q0p1 1 100 0.00 25.50 FORMAT "%5.2" ECU_ADDRESS 0x600037E5 /end MEASUREMENT
/begin MEASUREMENT HEGO_OBDElecS2B1_I.DebErrElecMinSusTONV_I.outbit "Electrical diagnostics, HEGO sensor 2 bank 1 / Debouncing of electrical min error suspicion / return value" UBYTE B_TRUE 1 100 0.00 1.00000000000 BIT_MASK 0x1 FORMAT "%13.11" ECU_ADDRESS 0x600037E6 /end MEASUREMENT
/begin MEASUREMENT HEGO_OBDElecS2B1_I.DebErrElecMinSusTONV_I.time "Electrical diagnostics, HEGO sensor 2 bank 1 / Debouncing of electrical min error suspicion / expired delay time" UBYTE t_q0p1 1 100 0.00 25.50 FORMAT "%5.2" ECU_ADDRESS 0x600037E7 /end MEASUREMENT
/begin MEASUREMENT HEGO_OBDElecS2B1_I.DebErrElecMinTONV_I.outbit "Electrical diagnostics, HEGO sensor 2 bank 1 / Debouncing of electrical min error (short to ground) / return value" UBYTE B_TRUE 1 100 0.00 1.00000000000 BIT_MASK 0x1 FORMAT "%13.11" ECU_ADDRESS 0x600037E8 /end MEASUREMENT
/begin MEASUREMENT HEGO_OBDElecS2B1_I.DebErrElecMinTONV_I.time "Electrical diagnostics, HEGO sensor 2 bank 1 / Debouncing of electrical min error (short to ground) / expired delay time" UBYTE t_q0p1 1 100 0.00 25.50 FORMAT "%5.2" ECU_ADDRESS 0x600037E9 /end MEASUREMENT
/begin MEASUREMENT HEGO_OBDElecS2B1_I.DebErrElecSigSusTONV_I.outbit "Electrical diagnostics, HEGO sensor 2 bank 1 / Debouncing of electrical sig error suspicion / return value" UBYTE B_TRUE 1 100 0.00 1.00000000000 BIT_MASK 0x1 FORMAT "%13.11" ECU_ADDRESS 0x600037EA /end MEASUREMENT
/begin MEASUREMENT HEGO_OBDElecS2B1_I.DebErrElecSigSusTONV_I.time "Electrical diagnostics, HEGO sensor 2 bank 1 / Debouncing of electrical sig error suspicion / expired delay time" UBYTE t_q0p1 1 100 0.00 25.50 FORMAT "%5.2" ECU_ADDRESS 0x600037EB /end MEASUREMENT
/begin MEASUREMENT HEGO_OBDElecS2B1_I.DebRstErrElecMinTONV_I.outbit "Electrical diagnostics, HEGO sensor 2 bank 1 / Debouncing reset of electrical min error (short to ground) / return value" UBYTE B_TRUE 1 100 0.00 1.00000000000 BIT_MASK 0x1 FORMAT "%13.11" ECU_ADDRESS 0x600037EC /end MEASUREMENT
/begin MEASUREMENT HEGO_OBDElecS2B1_I.DebRstErrElecMinTONV_I.time "Electrical diagnostics, HEGO sensor 2 bank 1 / Debouncing reset of electrical min error (short to ground) / expired delay time" UBYTE t_q0p1 1 100 0.00 25.50 FORMAT "%5.2" ECU_ADDRESS 0x600037ED /end MEASUREMENT
/begin MEASUREMENT HEGO_OBDElecS2B1_I.ErrElecMaxFF_I.status "Electrical diagnostics, HEGO sensor 2 bank 1 / Flipflop electrical max error (short to battery) / current value of RS-FF" UBYTE B_TRUE 1 100 0.00 1.00000000000 BIT_MASK 0x1 FORMAT "%13.11" ECU_ADDRESS 0x600037EE /end MEASUREMENT
/begin MEASUREMENT HEGO_OBDElecS2B1_I.ErrElecMinFF_I.status "Electrical diagnostics, HEGO sensor 2 bank 1 / Flipflop electrical min error (short to ground) / current value of RS-FF" UBYTE B_TRUE 1 100 0.00 1.00000000000 BIT_MASK 0x1 FORMAT "%13.11" ECU_ADDRESS 0x600037EF /end MEASUREMENT
/begin MEASUREMENT HEGO_OBDElecS2B1_I.ErrElecSigRiFF_I.status "Electrical diagnostics, HEGO sensor 2 bank 1 / Flipflop electrical sig error (wire interruption) due to Ri / current value of RS-FF" UBYTE B_TRUE 1 100 0.00 1.00000000000 BIT_MASK 0x1 FORMAT "%13.11" ECU_ADDRESS 0x600037F0 /end MEASUREMENT
/begin MEASUREMENT HEGO_OBDElecS2B1_I.Min_I.bErrMinLdPls "Electrical diagnostics, HEGO sensor 2 bank 1 / Electrical min error (short to ground) diagnosis for HEGO sensors / Bit electrical min error (short to ground) detected by load pulse check" UBYTE B_TRUE 1 100 0.00 1.00000000000 BIT_MASK 0x1 FORMAT "%13.11" ECU_ADDRESS 0x600037F2 /end MEASUREMENT
/begin MEASUREMENT HEGO_OBDElecS2B1_I.Min_I.bLdPlsMinReq "Electrical diagnostics, HEGO sensor 2 bank 1 / Electrical min error (short to ground) diagnosis for HEGO sensors / Bit load pulses requested due to min error (short to ground) suspicion" UBYTE B_TRUE 1 100 0.00 1.00000000000 BIT_MASK 0x1 FORMAT "%13.11" ECU_ADDRESS 0x600037F3 /end MEASUREMENT
/begin MEASUREMENT HEGO_OBDElecS2B1_I.Min_I.flgMinDiagEnad "Electrical diagnostics, HEGO sensor 2 bank 1 / Electrical min error (short to ground) diagnosis for HEGO sensors / Condition Elec Min diagnosis enabled after suspicion is debounced." UBYTE B_TRUE 1 100 0.00 1.00000000000 BIT_MASK 0x1 FORMAT "%13.11" ECU_ADDRESS 0x600037F4 /end MEASUREMENT
/begin MEASUREMENT HEGO_OBDElecS2B1_I.Min_I.sm "Electrical diagnostics, HEGO sensor 2 bank 1 / Electrical min error (short to ground) diagnosis for HEGO sensors / State-index of state-machine for electrical min error diagnosis" UBYTE HEGO_OBDElecMin_CLS_sm_tab_verb 1 100 0.00 3.00000000000 FORMAT "%13.11" ECU_ADDRESS 0x600037F5 /end MEASUREMENT
/begin MEASUREMENT HEGO_OBDElecS2B1_I.Min_I.DelLdPlsMinTR_I.timeCounter "Electrical diagnostics, HEGO sensor 2 bank 1 / Electrical min error (short to ground) diagnosis for HEGO sensors / Timer Retrigger / Remaining time of the timer" UBYTE t_q0p1 1 100 0.00 25.50 FORMAT "%5.2" ECU_ADDRESS 0x600037F6 /end MEASUREMENT
/begin MEASUREMENT HEGO_OBDElecS2B1_I.Sig_I.bErrSigLdPls "Electrical diagnostics, HEGO sensor 2 bank 1 / Electrical sig error (wire interruption) diagnosis for HEGO sensors / Bit electrical sig error (wire interruption) detected by load pulse check" UBYTE B_TRUE 1 100 0.00 1.00000000000 BIT_MASK 0x1 FORMAT "%13.11" ECU_ADDRESS 0x600037F8 /end MEASUREMENT
/begin MEASUREMENT HEGO_OBDElecS2B1_I.Sig_I.bErrSigSusLdPls "Electrical diagnostics, HEGO sensor 2 bank 1 / Electrical sig error (wire interruption) diagnosis for HEGO sensors / Bit electrical sig error (wire interruption) suspicion after load pulse check" UBYTE B_TRUE 1 100 0.00 1.00000000000 BIT_MASK 0x1 FORMAT "%13.11" ECU_ADDRESS 0x600037F9 /end MEASUREMENT
/begin MEASUREMENT HEGO_OBDElecS2B1_I.Sig_I.bLdPlsSigCnfExe "Electrical diagnostics, HEGO sensor 2 bank 1 / Electrical sig error (wire interruption) diagnosis for HEGO sensors / Bit load pulses executed to confirm sig error (wire interruption) suspicion" UBYTE B_TRUE 1 100 0.00 1.00000000000 BIT_MASK 0x1 FORMAT "%13.11" ECU_ADDRESS 0x600037FA /end MEASUREMENT
/begin MEASUREMENT HEGO_OBDElecS2B1_I.Sig_I.bLdPlsSigCnfReq "Electrical diagnostics, HEGO sensor 2 bank 1 / Electrical sig error (wire interruption) diagnosis for HEGO sensors / Bit load pulses requested to confirm sig error (wire interruption) suspicion" UBYTE B_TRUE 1 100 0.00 1.00000000000 BIT_MASK 0x1 FORMAT "%13.11" ECU_ADDRESS 0x600037FB /end MEASUREMENT
/begin MEASUREMENT HEGO_OBDElecS2B1_I.Sig_I.bLdPlsSigExe "Electrical diagnostics, HEGO sensor 2 bank 1 / Electrical sig error (wire interruption) diagnosis for HEGO sensors / Bit load pulse executed due to sig error (wire interruption) suspicion" UBYTE B_TRUE 1 100 0.00 1.00000000000 BIT_MASK 0x1 FORMAT "%13.11" ECU_ADDRESS 0x600037FC /end MEASUREMENT
/begin MEASUREMENT HEGO_OBDElecS2B1_I.Sig_I.bLdPlsSigReq "Electrical diagnostics, HEGO sensor 2 bank 1 / Electrical sig error (wire interruption) diagnosis for HEGO sensors / Bit load pulse requested due to sig error (wire interruption) suspicion" UBYTE B_TRUE 1 100 0.00 1.00000000000 BIT_MASK 0x1 FORMAT "%13.11" ECU_ADDRESS 0x600037FD /end MEASUREMENT
/begin MEASUREMENT HEGO_OBDElecS2B1_I.Sig_I.sm "Electrical diagnostics, HEGO sensor 2 bank 1 / Electrical sig error (wire interruption) diagnosis for HEGO sensors / State-index of state-machine for electrical sig error diagnosis" UBYTE HEGO_OBDElecSig_CLS_sm_tab_verb 1 100 0.00 4.00000000000 FORMAT "%13.11" ECU_ADDRESS 0x600037FE /end MEASUREMENT
/begin MEASUREMENT HEGO_OBDElecS2B1_I.Sig_I.DelLdPlsSigTR_I.timeCounter "Electrical diagnostics, HEGO sensor 2 bank 1 / Electrical sig error (wire interruption) diagnosis for HEGO sensors / Timer Retrigger / Remaining time of the timer" UBYTE t_q0p1 1 100 0.00 25.50 FORMAT "%5.2" ECU_ADDRESS 0x600037FF /end MEASUREMENT
/begin MEASUREMENT HEGO_OBDHtgS2B1_I.bEnaDHtg "Heater performance diagnosis, HEGO sensor 2 bank 1 / Bit heater performance diagnosis enabled" UBYTE B_TRUE 1 100 0.00 1.00000000000 BIT_MASK 0x1 FORMAT "%13.11" ECU_ADDRESS 0x5000164D /end MEASUREMENT
/begin MEASUREMENT HEGO_OBDHtgS2B1_I.bEnaDHtgFCMClrEngRun "Heater performance diagnosis, HEGO sensor 2 bank 1 / Bit heater performance diagnosis enabled in case of fcmclr with running engine" UBYTE B_TRUE 1 100 0.00 1.00000000000 BIT_MASK 0x1 FORMAT "%13.11" ECU_ADDRESS 0x5000164C /end MEASUREMENT
/begin MEASUREMENT HEGO_OBDHtgS2B1_I.bErrHtg "Heater performance diagnosis, HEGO sensor 2 bank 1 / Bit heater performance fault" UBYTE B_TRUE 1 100 0.00 1.00000000000 BIT_MASK 0x1 FORMAT "%13.11" ECU_ADDRESS 0x5000164E /end MEASUREMENT
/begin MEASUREMENT HEGO_OBDHtgS2B1_I.bHealHtg "Heater performance diagnosis, HEGO sensor 2 bank 1 / Bit healing of heater performance error" UBYTE B_TRUE 1 100 0.00 1.00000000000 BIT_MASK 0x2 FORMAT "%13.11" ECU_ADDRESS 0x5000164C /end MEASUREMENT
/begin MEASUREMENT HEGO_OBDHtgS2B1_I.bHtgSuffRi "Heater performance diagnosis, HEGO sensor 2 bank 1 / Bit sufficient heating (Ri low enough)" UBYTE B_TRUE 1 100 0.00 1.00000000000 BIT_MASK 0x1 FORMAT "%13.11" ECU_ADDRESS 0x5000164F /end MEASUREMENT
/begin MEASUREMENT HEGO_OBDHtgS2B1_I.bRiImPlausHi "Heater performance diagnosis, HEGO sensor 2 bank 1 / Bit Ri implausibly high" UBYTE B_TRUE 1 100 0.00 1.00000000000 BIT_MASK 0x4 FORMAT "%13.11" ECU_ADDRESS 0x5000164C /end MEASUREMENT
/begin MEASUREMENT HEGO_OBDHtgS2B1_I.bRlsDHtg "Heater performance diagnosis, HEGO sensor 2 bank 1 / Bit release heater performance diagnosis" UBYTE B_TRUE 1 100 0.00 1.00000000000 BIT_MASK 0x8 FORMAT "%13.11" ECU_ADDRESS 0x5000164C /end MEASUREMENT
/begin MEASUREMENT HEGO_OBDHtgS2B1_I.pwrHtgFlt "Heater performance diagnosis, HEGO sensor 2 bank 1 / Filtered normalized heating power" UBYTE fak_q0p01 1 100 0.00 2.550 FORMAT "%5.3" ECU_ADDRESS 0x50001650 /end MEASUREMENT
/begin MEASUREMENT HEGO_OBDHtgS2B1_I.resRiThresDHtg "Heater performance diagnosis, HEGO sensor 2 bank 1 / Threshold internal resistance for heater performance diagnosis" UWORD r_uw_q2 1 100 0.00 131070.0 FORMAT "%8.1" ECU_ADDRESS 0x50001652 /end MEASUREMENT
/begin MEASUREMENT HEGO_OBDHtgS2B1_I.tEGFlt "Heater performance diagnosis, HEGO sensor 2 bank 1 / Filtered exhaust gas temperature for heater performance diagnosis" UWORD temp_q0p0234_o273 1 100 -273.150 1262.827 FORMAT "%8.3" ECU_ADDRESS 0x50001654 /end MEASUREMENT
/begin MEASUREMENT HEGO_OBDHtgS2B1_I.DHtgGenFuncReqFF_I.status "Heater performance diagnosis, HEGO sensor 2 bank 1 / General function request via scan tool for sensor heating testing / current value of RS-FF" UBYTE B_TRUE 1 100 0.00 1.00000000000 BIT_MASK 0x1 FORMAT "%13.11" ECU_ADDRESS 0x50001656 /end MEASUREMENT
/begin MEASUREMENT HEGO_OBDHtgS2B1_I.DebDPERiThresDHtgTONV_I.outbit "Heater performance diagnosis, HEGO sensor 2 bank 1 / Debouncing time for dew-point end to switch Ri threshold / return value" UBYTE B_TRUE 1 100 0.00 1.00000000000 BIT_MASK 0x1 FORMAT "%13.11" ECU_ADDRESS 0x50001658 /end MEASUREMENT
/begin MEASUREMENT HEGO_OBDHtgS2B1_I.DebDPERiThresDHtgTONV_I.time "Heater performance diagnosis, HEGO sensor 2 bank 1 / Debouncing time for dew-point end to switch Ri threshold / expired delay time" UBYTE t_q0p1 1 100 0.00 25.50 FORMAT "%5.2" ECU_ADDRESS 0x50001659 /end MEASUREMENT
/begin MEASUREMENT HEGO_OBDHtgS2B1_I.DebEnaDHtgCtlExtTONV_I.outbit "Heater performance diagnosis, HEGO sensor 2 bank 1 / TONV: Deboucing time external heating control heating performance diagnosis enable / return value" UBYTE B_TRUE 1 100 0.00 1.00000000000 BIT_MASK 0x1 FORMAT "%13.11" ECU_ADDRESS 0x5000165A /end MEASUREMENT
/begin MEASUREMENT HEGO_OBDHtgS2B1_I.DebEnaDHtgCtlExtTONV_I.time "Heater performance diagnosis, HEGO sensor 2 bank 1 / TONV: Deboucing time external heating control heating performance diagnosis enable / expired delay time" UBYTE t_q0p1 1 100 0.00 25.50 FORMAT "%5.2" ECU_ADDRESS 0x5000165B /end MEASUREMENT
/begin MEASUREMENT HEGO_OBDHtgS2B1_I.DebErrHtgFIDRlsTONV_I.outbit "Heater performance diagnosis, HEGO sensor 2 bank 1 / Debouncing heater performance error after FID release / return value" UBYTE B_TRUE 1 100 0.00 1.00000000000 BIT_MASK 0x1 FORMAT "%13.11" ECU_ADDRESS 0x5000165C /end MEASUREMENT
/begin MEASUREMENT HEGO_OBDHtgS2B1_I.DebErrHtgFIDRlsTONV_I.time "Heater performance diagnosis, HEGO sensor 2 bank 1 / Debouncing heater performance error after FID release / expired delay time" UWORD t_q0p1 1 100 0.00 6553.500 FORMAT "%8.3" ECU_ADDRESS 0x5000165E /end MEASUREMENT
/begin MEASUREMENT HEGO_OBDHtgS2B1_I.DebErrHtgIUMPRTONV_I.outbit "Heater performance diagnosis, HEGO sensor 2 bank 1 / Delay for debouncing of heater perormance error (IUMPR) / return value" UBYTE B_TRUE 1 100 0.00 1.00000000000 BIT_MASK 0x1 FORMAT "%13.11" ECU_ADDRESS 0x50001660 /end MEASUREMENT
/begin MEASUREMENT HEGO_OBDHtgS2B1_I.DebErrHtgIUMPRTONV_I.time "Heater performance diagnosis, HEGO sensor 2 bank 1 / Delay for debouncing of heater perormance error (IUMPR) / expired delay time" UBYTE t_q0p1 1 100 0.00 25.50 FORMAT "%5.2" ECU_ADDRESS 0x50001661 /end MEASUREMENT
/begin MEASUREMENT HEGO_OBDHtgS2B1_I.DebHealHtgTONV_I.outbit "Heater performance diagnosis, HEGO sensor 2 bank 1 / Debouncing of heater performance error healing / return value" UBYTE B_TRUE 1 100 0.00 1.00000000000 BIT_MASK 0x1 FORMAT "%13.11" ECU_ADDRESS 0x50001662 /end MEASUREMENT
/begin MEASUREMENT HEGO_OBDHtgS2B1_I.DebHealHtgTONV_I.time "Heater performance diagnosis, HEGO sensor 2 bank 1 / Debouncing of heater performance error healing / expired delay time" UBYTE t_q0p1 1 100 0.00 25.50 FORMAT "%5.2" ECU_ADDRESS 0x50001663 /end MEASUREMENT
/begin MEASUREMENT HEGO_OBDHtgS2B1_I.PwrHtgLPT_I.memory "Heater performance diagnosis, HEGO sensor 2 bank 1 / Low-pass filter for heater power / current lowpass value" ULONG fak_q1p5259Em7 1 100 0.00 655.359999847 FORMAT "%13.9" ECU_ADDRESS 0x50001664 /end MEASUREMENT
/begin MEASUREMENT HEGO_OBDHtgS2B1_I.TempEGLPT_I.memory "Heater performance diagnosis, HEGO sensor 2 bank 1 / Low-pass filter for exhaust gas temperature / current lowpass value" ULONG temp_q3p57Em7_om273 1 100 -273.15000000 1262.84999964 FORMAT "%13.8" ECU_ADDRESS 0x50001668 /end MEASUREMENT
/begin MEASUREMENT HEGO_OBDHtgS2B1_I.flgDebErrHtgTONV_I.outbit "Heater performance diagnosis, HEGO sensor 2 bank 1 / Delay for debouncing of heater performance error / return value" UBYTE B_TRUE 1 100 0.00 1.00000000000 BIT_MASK 0x1 FORMAT "%13.11" ECU_ADDRESS 0x5000166C /end MEASUREMENT
/begin MEASUREMENT HEGO_OBDHtgS2B1_I.flgDebErrHtgTONV_I.time "Heater performance diagnosis, HEGO sensor 2 bank 1 / Delay for debouncing of heater performance error / expired delay time" UBYTE t_q0p1 1 100 0.00 25.50 FORMAT "%5.2" ECU_ADDRESS 0x5000166D /end MEASUREMENT
/begin MEASUREMENT HEGO_OBDHtg_ctReIni "ReInitialization request counter for HEGO_OBDHtg" UBYTE OneToOne 1 100 0.00 255.0 FORMAT "%5.1" ECU_ADDRESS 0x60006460 /end MEASUREMENT
/begin MEASUREMENT HEGO_OBDHtrPsS2B1_I.bDHtrPsEna "Heater powerstage diagnostics, HEGO sensor 2 bank 1 / Bit heater power stage diagnostics enabled" UBYTE B_TRUE 1 100 0.00 1.00000000000 BIT_MASK 0x1 FORMAT "%13.11" ECU_ADDRESS 0x600013DC /end MEASUREMENT
/begin MEASUREMENT HEGO_OBDHtrPsS2B1_I.bFCMClrReqdCL100ms "Heater powerstage diagnostics, HEGO sensor 2 bank 1 / FCM Clear requested for CL_100ms task" UBYTE B_TRUE 1 100 0.00 1.00000000000 BIT_MASK 0x1 FORMAT "%13.11" ECU_ADDRESS 0x600013DD /end MEASUREMENT
/begin MEASUREMENT HEGO_OBDHtrPsS2B1_I.stErrInfo "Heater powerstage diagnostics, HEGO sensor 2 bank 1 / status variable for power stage diagnosis error information" ULONG OneToOne 1 100 0.00 4294967295.00 FORMAT "%13.2" ECU_ADDRESS 0x600013E0 /end MEASUREMENT
/begin MEASUREMENT HEGO_OBDHtrPsS2B1_I.DHtrPsEnaTONV_I.outbit "Heater powerstage diagnostics, HEGO sensor 2 bank 1 / Debouncing of enable conditions for heater power stage diagnostics / return value" UBYTE B_TRUE 1 100 0.00 1.00000000000 BIT_MASK 0x1 FORMAT "%13.11" ECU_ADDRESS 0x600013E4 /end MEASUREMENT
/begin MEASUREMENT HEGO_OBDHtrPsS2B1_I.DHtrPsEnaTONV_I.time "Heater powerstage diagnostics, HEGO sensor 2 bank 1 / Debouncing of enable conditions for heater power stage diagnostics / expired delay time" UBYTE t_q0p1 1 100 0.00 25.50 FORMAT "%5.2" ECU_ADDRESS 0x600013E5 /end MEASUREMENT
/begin MEASUREMENT HEGO_OBDHtrPsS2B1_I.DebDHtrPsEnaFstTONV_I.outbit "Heater powerstage diagnostics, HEGO sensor 2 bank 1 / Debouncing of fast enable conditions for heater power stage diagnostics / return value" UBYTE B_TRUE 1 100 0.00 1.00000000000 BIT_MASK 0x1 FORMAT "%13.11" ECU_ADDRESS 0x600013E6 /end MEASUREMENT
/begin MEASUREMENT HEGO_OBDHtrPsS2B1_I.DebDHtrPsEnaFstTONV_I.time "Heater powerstage diagnostics, HEGO sensor 2 bank 1 / Debouncing of fast enable conditions for heater power stage diagnostics / expired delay time" UBYTE t_q0p1 1 100 0.00 25.50 FORMAT "%5.2" ECU_ADDRESS 0x600013E7 /end MEASUREMENT
/begin MEASUREMENT HEGO_OpRdnS2B1_I.bEna "Operating readiness, HEGO sensor 2 bank 1 / Bit enable conditions" UBYTE B_TRUE 1 100 0.00 1.00000000000 BIT_MASK 0x1 FORMAT "%13.11" ECU_ADDRESS 0x6000D8F6 /end MEASUREMENT
/begin MEASUREMENT HEGO_OpRdnS2B1_I.bEnaDElec "Operating readiness, HEGO sensor 2 bank 1 / Bit electrical diagnostics enabled" UBYTE B_TRUE 1 100 0.00 1.00000000000 BIT_MASK 0x2 FORMAT "%13.11" ECU_ADDRESS 0x6000D8F6 /end MEASUREMENT
/begin MEASUREMENT HEGO_OpRdnS2B1_I.bEnaOpRdnSens "Operating readiness, HEGO sensor 2 bank 1 / Bit enable operation readiness based on sensor signals" UBYTE B_TRUE 1 100 0.00 1.00000000000 BIT_MASK 0x1 FORMAT "%13.11" ECU_ADDRESS 0x6000D8F7 /end MEASUREMENT
/begin MEASUREMENT HEGO_OpRdnS2B1_I.bEnaSigChkd "Operating readiness, HEGO sensor 2 bank 1 / Bit enable conditions signal error checked" UBYTE B_TRUE 1 100 0.00 1.00000000000 BIT_MASK 0x2 FORMAT "%13.11" ECU_ADDRESS 0x6000D8F7 /end MEASUREMENT
/begin MEASUREMENT HEGO_OpRdnS2B1_I.bErrSigPrev "Operating readiness, HEGO sensor 2 bank 1 / Bit electrical sig error (wire interruption) in previous trip" UBYTE B_TRUE 1 100 0.00 1.00000000000 BIT_MASK 0x4 FORMAT "%13.11" ECU_ADDRESS 0x6000D8F6 /end MEASUREMENT
/begin MEASUREMENT HEGO_OpRdnS2B1_I.bExptOpRdn "Operating readiness, HEGO sensor 2 bank 1 / Flag expected operation readiness" UBYTE B_TRUE 1 100 0.00 1.00000000000 BIT_MASK 0x4 FORMAT "%13.11" ECU_ADDRESS 0x6000D8F7 /end MEASUREMENT
/begin MEASUREMENT HEGO_OpRdnS2B1_I.bFCMClrReqdCL100ms "Operating readiness, HEGO sensor 2 bank 1 / FCM clear request for CL_100ms taks" UBYTE B_TRUE 1 100 0.00 1.00000000000 BIT_MASK 0x1 FORMAT "%13.11" ECU_ADDRESS 0x6000D8F8 /end MEASUREMENT
/begin MEASUREMENT HEGO_OpRdnS2B1_I.bHEGOInVldErr "Operating readiness, HEGO sensor 2 bank 1 / Reset of sensor readiness due to failure" UBYTE B_TRUE 1 100 0.00 1.00000000000 BIT_MASK 0x1 FORMAT "%13.11" ECU_ADDRESS 0x6000D8F9 /end MEASUREMENT
/begin MEASUREMENT HEGO_OpRdnS2B1_I.bHtgOk "Operating readiness, HEGO sensor 2 bank 1 / Bit heating OK" UBYTE B_TRUE 1 100 0.00 1.00000000000 BIT_MASK 0x1 FORMAT "%13.11" ECU_ADDRESS 0x6000D8FA /end MEASUREMENT
/begin MEASUREMENT HEGO_OpRdnS2B1_I.bOpRdnRiReq "Operating readiness, HEGO sensor 2 bank 1 / Bit Ri measurement request for sensor operating readiness" UBYTE B_TRUE 1 100 0.00 1.00000000000 BIT_MASK 0x8 FORMAT "%13.11" ECU_ADDRESS 0x6000D8F6 /end MEASUREMENT
/begin MEASUREMENT HEGO_OpRdnS2B1_I.bRiOkOpRdn "Operating readiness, HEGO sensor 2 bank 1 / Bit Ri ok for operating readiness" UBYTE B_TRUE 1 100 0.00 1.00000000000 BIT_MASK 0x20 FORMAT "%13.11" ECU_ADDRESS 0x6000D8F6 /end MEASUREMENT
/begin MEASUREMENT HEGO_OpRdnS2B1_I.bSVld "Operating readiness, HEGO sensor 2 bank 1 / Bit sensor signal valid" UBYTE B_TRUE 1 100 0.00 1.00000000000 BIT_MASK 0x40 FORMAT "%13.11" ECU_ADDRESS 0x6000D8F6 /end MEASUREMENT
/begin MEASUREMENT HEGO_OpRdnS2B1_I.bStkCVB "Operating readiness, HEGO sensor 2 bank 1 / Bit stuck in counter voltage band" UBYTE B_TRUE 1 100 0.00 1.00000000000 BIT_MASK 0x8 FORMAT "%13.11" ECU_ADDRESS 0x6000D8F7 /end MEASUREMENT
/begin MEASUREMENT HEGO_OpRdnS2B1_I.flgTCerMdlOk "Operating readiness, HEGO sensor 2 bank 1 / Flag modelled sensor ceramic temperature is okay" UBYTE B_TRUE 1 100 0.00 1.00000000000 BIT_MASK 0x10 FORMAT "%13.11" ECU_ADDRESS 0x6000D8F7 /end MEASUREMENT
/begin MEASUREMENT HEGO_OpRdnS2B1_I.numCalcRiOpRdn "Operating readiness, HEGO sensor 2 bank 1 / Number of Ri calculations for operation readiness" UBYTE dez 1 100 0.00 255.0 FORMAT "%5.1" ECU_ADDRESS 0x6000D8FB /end MEASUREMENT
/begin MEASUREMENT HEGO_OpRdnS2B1_I.tEGOpRdn "Operating readiness, HEGO sensor 2 bank 1 / Exhaust gas temperature for operation readiness detection" UWORD temp_q0p0234_om273 1 100 -273.150 1262.827 FORMAT "%8.3" ECU_ADDRESS 0x6000D8FC /end MEASUREMENT
/begin MEASUREMENT HEGO_OpRdnS2B1_I.DebErrStkTONV_I.outbit "Operating readiness, HEGO sensor 2 bank 1 / Debouncing of stuck error / return value" UBYTE B_TRUE 1 100 0.00 1.00000000000 BIT_MASK 0x1 FORMAT "%13.11" ECU_ADDRESS 0x6000D8FE /end MEASUREMENT
/begin MEASUREMENT HEGO_OpRdnS2B1_I.DebErrStkTONV_I.time "Operating readiness, HEGO sensor 2 bank 1 / Debouncing of stuck error / expired delay time" UWORD t_q0p1 1 100 0.00 6553.500 FORMAT "%8.3" ECU_ADDRESS 0x6000D900 /end MEASUREMENT
/begin MEASUREMENT HEGO_OpRdnS2B1_I.DebExptOpRdnTONV_I.outbit "Operating readiness, HEGO sensor 2 bank 1 / Debouncing of expected operating readiness / return value" UBYTE B_TRUE 1 100 0.00 1.00000000000 BIT_MASK 0x1 FORMAT "%13.11" ECU_ADDRESS 0x6000D902 /end MEASUREMENT
/begin MEASUREMENT HEGO_OpRdnS2B1_I.DebExptOpRdnTONV_I.time "Operating readiness, HEGO sensor 2 bank 1 / Debouncing of expected operating readiness / expired delay time" UWORD t_q0p1 1 100 0.00 6553.500 FORMAT "%8.3" ECU_ADDRESS 0x6000D904 /end MEASUREMENT
/begin MEASUREMENT HEGO_OpRdnS2B1_I.DebPrtHtgFinTONV_I.outbit "Operating readiness, HEGO sensor 2 bank 1 / Debouncing of protective heating finished / return value" UBYTE B_TRUE 1 100 0.00 1.00000000000 BIT_MASK 0x1 FORMAT "%13.11" ECU_ADDRESS 0x6000D906 /end MEASUREMENT
/begin MEASUREMENT HEGO_OpRdnS2B1_I.DebPrtHtgFinTONV_I.time "Operating readiness, HEGO sensor 2 bank 1 / Debouncing of protective heating finished / expired delay time" UWORD t_q0p1 1 100 0.00 6553.500 FORMAT "%8.3" ECU_ADDRESS 0x6000D908 /end MEASUREMENT
/begin MEASUREMENT HEGO_OpRdnS2B1_I.DebSVldTONV_I.outbit "Operating readiness, HEGO sensor 2 bank 1 / Debouncing sensor signal valid / return value" UBYTE B_TRUE 1 100 0.00 1.00000000000 BIT_MASK 0x1 FORMAT "%13.11" ECU_ADDRESS 0x6000D90C /end MEASUREMENT
/begin MEASUREMENT HEGO_OpRdnS2B1_I.DebSVldTONV_I.time "Operating readiness, HEGO sensor 2 bank 1 / Debouncing sensor signal valid / expired delay time" UBYTE t_q0p1 1 100 0.00 25.50 FORMAT "%5.2" ECU_ADDRESS 0x6000D90D /end MEASUREMENT
/begin MEASUREMENT HEGO_OpRdnS2B1_I.EnaOpRdnHtgFF_I.status "Operating readiness, HEGO sensor 2 bank 1 / Enable cold operation readiness / current value of RS-FF" UBYTE B_TRUE 1 100 0.00 1.00000000000 BIT_MASK 0x1 FORMAT "%13.11" ECU_ADDRESS 0x6000D90E /end MEASUREMENT
/begin MEASUREMENT HEGO_OpRdnS2B1_I.OpRdnMemFF_I.status "Operating readiness, HEGO sensor 2 bank 1 / Flipflop operation readiness / current value of RS-FF" UBYTE B_TRUE 1 100 0.00 1.00000000000 BIT_MASK 0x1 FORMAT "%13.11" ECU_ADDRESS 0x6000D90F /end MEASUREMENT
/begin MEASUREMENT HEGO_OpRdnS2B1_I.SVldFF_I.status "Operating readiness, HEGO sensor 2 bank 1 / Flipflop sensor signal valid / current value of RS-FF" UBYTE B_TRUE 1 100 0.00 1.00000000000 BIT_MASK 0x1 FORMAT "%13.11" ECU_ADDRESS 0x6000D910 /end MEASUREMENT
/begin MEASUREMENT HEGO_OpRdnS2B1_I.StkCVBSusFF_I.status "Operating readiness, HEGO sensor 2 bank 1 / Flipflop suspicion of stuck in countervoltage band / current value of RS-FF" UBYTE B_TRUE 1 100 0.00 1.00000000000 BIT_MASK 0x1 FORMAT "%13.11" ECU_ADDRESS 0x6000D911 /end MEASUREMENT
/begin MEASUREMENT HEGO_OpRdnS2B1_I.numRiOkCTR_I.counter "Operating readiness, HEGO sensor 2 bank 1 / Counter for valid Ri measurements / current counter value" UBYTE dez 1 100 0.00 255.0 FORMAT "%5.1" ECU_ADDRESS 0x6000D912 /end MEASUREMENT
/begin MEASUREMENT HEGO_pwrS2B1Htg "Normalized heating power, HEGO sensor 2 bank 1" UBYTE fak_q0p01 1 100 0.00 2.550 FORMAT "%5.3" ECU_ADDRESS 0x6000A044 /end MEASUREMENT
/begin MEASUREMENT HEGO_pwrS2B1HtgOnRls "Normalized heating power with released heating, HEGO sensor 2 bank 1" UBYTE fak_q0p01 1 100 0.00 2.550 FORMAT "%5.3" ECU_ADDRESS 0x6000A043 /end MEASUREMENT
/begin MEASUREMENT HEGO_resS2B1Ri "Internal resistance, HEGO sensor 2 bank 1" UWORD r_uw_q2 1 100 0.00 131070.0 FORMAT "%8.1" ECU_ADDRESS 0x600048B6 /end MEASUREMENT
/begin MEASUREMENT HEGO_resS2B1RiCorrd "Corrected Internal resistance, HEGO sensor 2 bank 1" UWORD r_uw_q2 1 100 0.00 131070.0 FORMAT "%8.1" ECU_ADDRESS 0x600048B4 /end MEASUREMENT
/begin MEASUREMENT HEGO_resS2B1RiCorrdFild "Temperature related corrected unfiltered internal resistance,HEGO sensor 2 bank 1" UWORD r_uw_q2 1 100 0.00 131070.0 FORMAT "%8.1" ECU_ADDRESS 0x600048B2 /end MEASUREMENT
/begin MEASUREMENT HEGO_resS2B1RiNoFlt "Unfiltered internal resistance, HEGO sensor 2 bank 1" UWORD r_uw_q2 1 100 0.00 131070.0 FORMAT "%8.1" ECU_ADDRESS 0x6000E272 /end MEASUREMENT
/begin MEASUREMENT HEGO_resS2B1RiNom "nominal Ri sensor 2 bank 1" UWORD r_uw_q2 1 100 0.00 131070.0 FORMAT "%8.1" ECU_ADDRESS 0x600048B0 /end MEASUREMENT
/begin MEASUREMENT HEGO_resS2B1RiThres "Threshold internal resistance, HEGO sensor 2 bank 1" UWORD r_uw_q2 1 100 0.00 131070.0 FORMAT "%8.1" ECU_ADDRESS 0x600048AE /end MEASUREMENT
/begin MEASUREMENT HEGO_rS2B1HtgLim "HEGO sensor 2 bank 1 duty cycle limited" UWORD fak_q3p906Em5 1 100 0.00 2.559961 FORMAT "%8.6" ECU_ADDRESS 0x600048B8 /end MEASUREMENT
/begin MEASUREMENT HEGO_rS2B1Lam "Lambda, HEGO sensor 2 bank 1" UWORD fak_q3p0518Em5 1 100 0.00 1.999969 FORMAT "%8.6" ECU_ADDRESS 0x70002C5C /end MEASUREMENT
/begin MEASUREMENT HEGO_rS2B1LamHiRes "Lambda, HEGO sensor 2 bank 1" UWORD fak_q3p0518Em5 1 100 0.00 1.999969 FORMAT "%8.6" ECU_ADDRESS 0x70002C5E /end MEASUREMENT
/begin MEASUREMENT HEGO_SensS2B1_ctReIni "sensor 2 bank 1 specific counter to trigger ReIni if not equal to SyC_ctPostDrvLeave" UBYTE dez 1 100 0.00 255.0 FORMAT "%5.1" ECU_ADDRESS 0x700019A2 /end MEASUREMENT
/begin MEASUREMENT HEGO_SensS2B1_I.bCalcRi "Signal acquisition of HEGO sensor 2 bank 1 / Bit claculate internal resistance" UBYTE B_TRUE 1 100 0.00 1.00000000000 BIT_MASK 0x1 FORMAT "%13.11" ECU_ADDRESS 0x50005433 /end MEASUREMENT
/begin MEASUREMENT HEGO_SensS2B1_I.bDelOpRdnRiPls "Signal acquisition of HEGO sensor 2 bank 1 / Bit delay for sensor operation detection Ri pulse active" UBYTE B_TRUE 1 100 0.00 1.00000000000 BIT_MASK 0x1 FORMAT "%13.11" ECU_ADDRESS 0x50005432 /end MEASUREMENT
/begin MEASUREMENT HEGO_SensS2B1_I.bEnaLdPls "Signal acquisition of HEGO sensor 2 bank 1 / Bit load pulse check enabled" UBYTE B_TRUE 1 100 0.00 1.00000000000 BIT_MASK 0x1 FORMAT "%13.11" ECU_ADDRESS 0x6000CD79 /end MEASUREMENT
/begin MEASUREMENT HEGO_SensS2B1_I.bEnaOpRdnRiPls "Signal acquisition of HEGO sensor 2 bank 1 / Bit operation readiness detection Ri pulse enabled" UBYTE B_TRUE 1 100 0.00 1.00000000000 BIT_MASK 0x1 FORMAT "%13.11" ECU_ADDRESS 0x6000CD7A /end MEASUREMENT
/begin MEASUREMENT HEGO_SensS2B1_I.bEnaRi "Signal acquisition of HEGO sensor 2 bank 1 / Bit measurement of internal resistance enabled" UBYTE B_TRUE 1 100 0.00 1.00000000000 BIT_MASK 0x1 FORMAT "%13.11" ECU_ADDRESS 0x6000CD78 /end MEASUREMENT
/begin MEASUREMENT HEGO_SensS2B1_I.bEnaRiFlt "Signal acquisition of HEGO sensor 2 bank 1 / Bit enable transfer of current internal resistance to the filter" UBYTE B_TRUE 1 100 0.00 1.00000000000 BIT_MASK 0x2 FORMAT "%13.11" ECU_ADDRESS 0x50005432 /end MEASUREMENT
/begin MEASUREMENT HEGO_SensS2B1_I.bEnaRiSens "Signal acquisition of HEGO sensor 2 bank 1 / Bit enable condition for Ri measurement" UBYTE B_TRUE 1 100 0.00 1.00000000000 BIT_MASK 0x2 FORMAT "%13.11" ECU_ADDRESS 0x6000CD78 /end MEASUREMENT
/begin MEASUREMENT HEGO_SensS2B1_I.bFCMClrReqd100ms "Signal acquisition of HEGO sensor 2 bank 1 / FCM_Clear requested for _100ms task" UBYTE B_TRUE 1 100 0.00 1.00000000000 BIT_MASK 0x1 FORMAT "%13.11" ECU_ADDRESS 0x50005434 /end MEASUREMENT
/begin MEASUREMENT HEGO_SensS2B1_I.bFCMClrReqd1ms "Signal acquisition of HEGO sensor 2 bank 1 / FCM_Clear requested for _1ms task" UBYTE B_TRUE 1 100 0.00 1.00000000000 BIT_MASK 0x1 FORMAT "%13.11" ECU_ADDRESS 0x500001AC /end MEASUREMENT
/begin MEASUREMENT HEGO_SensS2B1_I.bFrzRi "Signal acquisition of HEGO sensor 2 bank 1 / Bit sensor signal frozen due to measurement of internal resistance" UBYTE B_TRUE 1 100 0.00 1.00000000000 BIT_MASK 0x1 FORMAT "%13.11" ECU_ADDRESS 0x6000CD7B /end MEASUREMENT
/begin MEASUREMENT HEGO_SensS2B1_I.bFrzRiPrev "Signal acquisition of HEGO sensor 2 bank 1 / flag voltage freezed due to Ri-measurement with value of previous sequence call" UBYTE B_TRUE 1 100 0.00 1.00000000000 BIT_MASK 0x1 FORMAT "%13.11" ECU_ADDRESS 0x500001AD /end MEASUREMENT
/begin MEASUREMENT HEGO_SensS2B1_I.bLdPlsEval "Signal acquisition of HEGO sensor 2 bank 1 / Bit evaluate result of load pulse check" UBYTE B_TRUE 1 100 0.00 1.00000000000 BIT_MASK 0x4 FORMAT "%13.11" ECU_ADDRESS 0x50005432 /end MEASUREMENT
/begin MEASUREMENT HEGO_SensS2B1_I.bLdPlsFin "Signal acquisition of HEGO sensor 2 bank 1 / Bit load pulse check finished" UBYTE B_TRUE 1 100 0.00 1.00000000000 BIT_MASK 0x8 FORMAT "%13.11" ECU_ADDRESS 0x50005432 /end MEASUREMENT
/begin MEASUREMENT HEGO_SensS2B1_I.bLdPlsRslt "Signal acquisition of HEGO sensor 2 bank 1 / Bit result of load pulse measurement is available" UBYTE B_TRUE 1 100 0.00 1.00000000000 BIT_MASK 0x1 FORMAT "%13.11" ECU_ADDRESS 0x6000CD7C /end MEASUREMENT
/begin MEASUREMENT HEGO_SensS2B1_I.bNewRi "Signal acquisition of HEGO sensor 2 bank 1 / Bit New Ri value available" UBYTE B_TRUE 1 100 0.00 1.00000000000 BIT_MASK 0x1 FORMAT "%13.11" ECU_ADDRESS 0x50005435 /end MEASUREMENT
/begin MEASUREMENT HEGO_SensS2B1_I.bPlausRi "Signal acquisition of HEGO sensor 2 bank 1 / Bit current internal resistance is plausible" UBYTE B_TRUE 1 100 0.00 1.00000000000 BIT_MASK 0x10 FORMAT "%13.11" ECU_ADDRESS 0x50005432 /end MEASUREMENT
/begin MEASUREMENT HEGO_SensS2B1_I.bPolarRedPls "Signal acquisition of HEGO sensor 2 bank 1 / Bit pulse for polarization reduction" UBYTE B_TRUE 1 100 0.00 1.00000000000 BIT_MASK 0x1 FORMAT "%13.11" ECU_ADDRESS 0x500001AE /end MEASUREMENT
/begin MEASUREMENT HEGO_SensS2B1_I.bRiMeas "Signal acquisition of HEGO sensor 2 bank 1 / bit: Ri-measurement done (independent from validity of measurement)" UBYTE B_TRUE 1 100 0.00 1.00000000000 BIT_MASK 0x1 FORMAT "%13.11" ECU_ADDRESS 0x50005436 /end MEASUREMENT
/begin MEASUREMENT HEGO_SensS2B1_I.bRiPls "Signal acquisition of HEGO sensor 2 bank 1 / Bit pulse for measurement of internal resistance" UBYTE B_TRUE 1 100 0.00 1.00000000000 BIT_MASK 0x1 FORMAT "%13.11" ECU_ADDRESS 0x500001AF /end MEASUREMENT
/begin MEASUREMENT HEGO_SensS2B1_I.bRiTrg "Signal acquisition of HEGO sensor 2 bank 1 / Bit trigger measurement of internal resistance" UBYTE B_TRUE 1 100 0.00 1.00000000000 BIT_MASK 0x1 FORMAT "%13.11" ECU_ADDRESS 0x500001B0 /end MEASUREMENT
/begin MEASUREMENT HEGO_SensS2B1_I.bVldRi "Signal acquisition of HEGO sensor 2 bank 1 / Bit internal resistance is valid" UBYTE B_TRUE 1 100 0.00 1.00000000000 BIT_MASK 0x1 FORMAT "%13.11" ECU_ADDRESS 0x50005437 /end MEASUREMENT
/begin MEASUREMENT HEGO_SensS2B1_I.ctLdPls "Signal acquisition of HEGO sensor 2 bank 1 / Number of load pulses" UBYTE dez 1 100 0.00 255.0 FORMAT "%5.1" ECU_ADDRESS 0x6000CD7D /end MEASUREMENT
/begin MEASUREMENT HEGO_SensS2B1_I.flgCdnStMacTran02 "Signal acquisition of HEGO sensor 2 bank 1 / transition condition from _0_measure_us to _2_ri_acquisition for Ri-measurement" UBYTE B_TRUE 1 100 0.00 1.00000000000 BIT_MASK 0x4 FORMAT "%13.11" ECU_ADDRESS 0x6000CD78 /end MEASUREMENT
/begin MEASUREMENT HEGO_SensS2B1_I.flgCdnStMacTran12 "Signal acquisition of HEGO sensor 2 bank 1 / transition condition from _1_pending to _2_ri_acquisition for Ri-measurement" UBYTE B_TRUE 1 100 0.00 1.00000000000 BIT_MASK 0x8 FORMAT "%13.11" ECU_ADDRESS 0x6000CD78 /end MEASUREMENT
/begin MEASUREMENT HEGO_SensS2B1_I.flgInitVolt "Signal acquisition of HEGO sensor 2 bank 1 / Flag initial voltage acquisition has happened with necessary conditions" UBYTE B_TRUE 1 100 0.00 1.00000000000 BIT_MASK 0x1 FORMAT "%13.11" ECU_ADDRESS 0x500001B1 /end MEASUREMENT
/begin MEASUREMENT HEGO_SensS2B1_I.flgNewUSExtd "Signal acquisition of HEGO sensor 2 bank 1 / voltage acquisition done newly" UBYTE B_TRUE 1 100 0.00 1.00000000000 BIT_MASK 0x1 FORMAT "%13.11" ECU_ADDRESS 0x500001B2 /end MEASUREMENT
/begin MEASUREMENT HEGO_SensS2B1_I.flgNumVoltMeasmtElecMaxSuff "Signal acquisition of HEGO sensor 2 bank 1 / class internal flag number of voltage measurements for ElecMax-(SCB) diagnosis debounce sufficient" UBYTE B_TRUE 1 100 0.00 1.00000000000 BIT_MASK 0x1 FORMAT "%13.11" ECU_ADDRESS 0x500001B3 /end MEASUREMENT
/begin MEASUREMENT HEGO_SensS2B1_I.numCalcRi "Signal acquisition of HEGO sensor 2 bank 1 / Numerator for indication of executed Ri-pulse" UBYTE dez 1 100 0.00 255.0 FORMAT "%5.1" ECU_ADDRESS 0x50005438 /end MEASUREMENT
/begin MEASUREMENT HEGO_SensS2B1_I.numLdPlsMax "Signal acquisition of HEGO sensor 2 bank 1 / Maximum number of load pulses" UBYTE dez 1 100 0.00 255.0 FORMAT "%5.1" ECU_ADDRESS 0x6000CD7E /end MEASUREMENT
/begin MEASUREMENT HEGO_SensS2B1_I.numNewRi "Signal acquisition of HEGO sensor 2 bank 1 / Numerator for indication of a new Ri value" UBYTE dez 1 100 0.00 255.0 FORMAT "%5.1" ECU_ADDRESS 0x50005439 /end MEASUREMENT
/begin MEASUREMENT HEGO_SensS2B1_I.numVoltMeasmtElecMax "Signal acquisition of HEGO sensor 2 bank 1 / class internal counter of voltage measurement for elecMax-diagnosis" UBYTE dez 1 100 0.00 255.0 FORMAT "%5.1" ECU_ADDRESS 0x500001B4 /end MEASUREMENT
/begin MEASUREMENT HEGO_SensS2B1_I.resRi "Signal acquisition of HEGO sensor 2 bank 1 / Internal resistance of HEGO sensor" UWORD r_uw_q2 1 100 0.00 131070.0 FORMAT "%8.1" ECU_ADDRESS 0x5000543A /end MEASUREMENT
/begin MEASUREMENT HEGO_SensS2B1_I.resRiCorrd "Signal acquisition of HEGO sensor 2 bank 1 / Corrected internal resistance" UWORD r_uw_q2 1 100 0.00 131070.0 FORMAT "%8.1" ECU_ADDRESS 0x5000543C /end MEASUREMENT
/begin MEASUREMENT HEGO_SensS2B1_I.resRiCorrdFild "Signal acquisition of HEGO sensor 2 bank 1 / Temperature releated corrected Internal resistance" UWORD r_uw_q2 1 100 0.00 131070.0 FORMAT "%8.1" ECU_ADDRESS 0x5000543E /end MEASUREMENT
/begin MEASUREMENT HEGO_SensS2B1_I.resRiCorrdPrev "Signal acquisition of HEGO sensor 2 bank 1 / Previous corrected internal resistance" UWORD r_uw_q2 1 100 0.00 131070.0 FORMAT "%8.1" ECU_ADDRESS 0x50005440 /end MEASUREMENT
/begin MEASUREMENT HEGO_SensS2B1_I.resRiNoFlt "Signal acquisition of HEGO sensor 2 bank 1 / Unfiltered internal resistance of HEGO sensor" UWORD r_uw_q2 1 100 0.00 131070.0 FORMAT "%8.1" ECU_ADDRESS 0x50005442 /end MEASUREMENT
/begin MEASUREMENT HEGO_SensS2B1_I.sm "Signal acquisition of HEGO sensor 2 bank 1 / State-index of state-machine for signal acquisition" UBYTE HEGO_Sens_CLS_sm_tab_verb 1 100 0.00 2.00000000000 FORMAT "%13.11" ECU_ADDRESS 0x6000CD7F /end MEASUREMENT
/begin MEASUREMENT HEGO_SensS2B1_I.uLdPls "Signal acquisition of HEGO sensor 2 bank 1 / Voltage resulting from load pulse check" UWORD spg_q1p221Em3_V 1 100 0.00 4.998779 FORMAT "%8.6" ECU_ADDRESS 0x50005444 /end MEASUREMENT
/begin MEASUREMENT HEGO_SensS2B1_I.uLdPlsDiff "Signal acquisition of HEGO sensor 2 bank 1 / Voltage difference due to load pulse" UWORD spg_q1p221Em3_V 1 100 0.00 15.00000 FORMAT "%8.5" ECU_ADDRESS 0x6000CD80 /end MEASUREMENT
/begin MEASUREMENT HEGO_SensS2B1_I.uRiAftFrz "Signal acquisition of HEGO sensor 2 bank 1 / Sensor voltage after freeze due to measurement of the internal resistance" UWORD spg_q1p221Em3_V 1 100 0.00 4.998779 FORMAT "%8.6" ECU_ADDRESS 0x6000CD84 /end MEASUREMENT
/begin MEASUREMENT HEGO_SensS2B1_I.uRiWiLd "Signal acquisition of HEGO sensor 2 bank 1 / Sensor voltage with load for the measurement of the internal resistance" UWORD spg_q1p221Em3_V 1 100 0.00 4.998779 FORMAT "%8.6" ECU_ADDRESS 0x500001B6 /end MEASUREMENT
/begin MEASUREMENT HEGO_SensS2B1_I.uRiWoLd "Signal acquisition of HEGO sensor 2 bank 1 / Sensor voltage without load for the measurement of the internal resistance" UWORD spg_q1p221Em3_V 1 100 0.00 4.998779 FORMAT "%8.6" ECU_ADDRESS 0x500001B8 /end MEASUREMENT
/begin MEASUREMENT HEGO_SensS2B1_I.uSExtd "Signal acquisition of HEGO sensor 2 bank 1 / Output voltage of HEGO sensor, extended range" UWORD spg_q1p221Em3_V 1 100 0.00 4.998779 FORMAT "%8.6" ECU_ADDRESS 0x6000CD86 /end MEASUREMENT
/begin MEASUREMENT HEGO_SensS2B1_I.uSExtdHeatrOff "Signal acquisition of HEGO sensor 2 bank 1 / measured voltage during heater off state" UWORD spg_q1p221Em3_V 1 100 0.00 4.998779 FORMAT "%8.6" ECU_ADDRESS 0x500001BA /end MEASUREMENT
/begin MEASUREMENT HEGO_SensS2B1_I.uVoltMeasmtFildElecMax "Signal acquisition of HEGO sensor 2 bank 1 / filtered voltage inside HEGO_Sens_CLS value for ElecMax diagnosis" UWORD spg_q1p221Em3_V 1 100 0.00 4.998779 FORMAT "%8.6" ECU_ADDRESS 0x500001BC /end MEASUREMENT
/begin MEASUREMENT HEGO_SensS2B1_I.DebEnaRiVltgTONV_I.outbit "Signal acquisition of HEGO sensor 2 bank 1 / Debouncing of Ri measurement (sensor voltage) / return value" UBYTE B_TRUE 1 100 0.00 1.00000000000 BIT_MASK 0x1 FORMAT "%13.11" ECU_ADDRESS 0x6000CD88 /end MEASUREMENT
/begin MEASUREMENT HEGO_SensS2B1_I.DebEnaRiVltgTONV_I.time "Signal acquisition of HEGO sensor 2 bank 1 / Debouncing of Ri measurement (sensor voltage) / expired delay time" UBYTE t_q0p01 1 100 0.00 2.550 FORMAT "%5.3" ECU_ADDRESS 0x6000CD89 /end MEASUREMENT
/begin MEASUREMENT HEGO_SensS2B1_I.DelLdPlsT_I.timeCounter "Signal acquisition of HEGO sensor 2 bank 1 / Timer for waiting between two load pulses / Remaining time of the timer" UWORD t_q0p1 1 100 0.00 6553.500 FORMAT "%8.3" ECU_ADDRESS 0x50005446 /end MEASUREMENT
/begin MEASUREMENT HEGO_SensS2B1_I.DelOpRdnRiPlsT_I.timeCounter "Signal acquisition of HEGO sensor 2 bank 1 / Delay after operation readiness detection Ri pulse / Remaining time of the timer" UBYTE t_q0p1 1 100 0.00 25.50 FORMAT "%5.2" ECU_ADDRESS 0x50005448 /end MEASUREMENT
/begin MEASUREMENT HEGO_SensS2B1_I.FrzRiT_I.timeCounter "Signal acquisition of HEGO sensor 2 bank 1 / Timer for freeze of sensor voltage during Ri measurement / Remaining time of the timer" UBYTE t_q0p01 1 100 0.00 2.550 FORMAT "%5.3" ECU_ADDRESS 0x6000CD8A /end MEASUREMENT
/begin MEASUREMENT HEGO_SensS2B1_I.NewRiTR_I.timeCounter "Signal acquisition of HEGO sensor 2 bank 1 / Timer for up-to-dateness of Ri value / Remaining time of the timer" UBYTE t_q0p1 1 100 0.00 25.50 FORMAT "%5.2" ECU_ADDRESS 0x50005449 /end MEASUREMENT
/begin MEASUREMENT HEGO_SensS2B1_I.PolarRedPlsT_I.timeCounter "Signal acquisition of HEGO sensor 2 bank 1 / Timer for duration of pulse for polarization recuction / Remaining time of the timer" UWORD t_q0p001 1 100 0.00 65.53500 FORMAT "%8.5" ECU_ADDRESS 0x500001BE /end MEASUREMENT
/begin MEASUREMENT HEGO_SensS2B1_I.RiCalcCTR_I.counter "Signal acquisition of HEGO sensor 2 bank 1 / Counter for number of calculations of the internal resistance / current counter value" UBYTE dez 1 100 0.00 255.0 FORMAT "%5.1" ECU_ADDRESS 0x6000CD8B /end MEASUREMENT
/begin MEASUREMENT HEGO_SensS2B1_I.RiCorrdDL_I.memory "Signal acquisition of HEGO sensor 2 bank 1 / Digital lowpass for T-corrected internal resistance / current lowpass value" ULONG r_q3p0518Em5 1 100 0.00 131071.999969 FORMAT "%13.6" ECU_ADDRESS 0x6000CD8C /end MEASUREMENT
/begin MEASUREMENT HEGO_SensS2B1_I.RiDL_I.memory "Signal acquisition of HEGO sensor 2 bank 1 / Digital lowpass for internal resistance / current lowpass value" ULONG r_q3p0518Em5 1 100 0.00 131071.999969 FORMAT "%13.6" ECU_ADDRESS 0x6000CD90 /end MEASUREMENT
/begin MEASUREMENT HEGO_SensS2B1_I.RiNoPlausCTR_I.counter "Signal acquisition of HEGO sensor 2 bank 1 / Counter implausible measurements of the internal resistance / current counter value" UBYTE dez 1 100 0.00 255.0 FORMAT "%5.1" ECU_ADDRESS 0x6000CD94 /end MEASUREMENT
/begin MEASUREMENT HEGO_SensS2B1_I.RiPlsT_I.timeCounter "Signal acquisition of HEGO sensor 2 bank 1 / Timer for duration of Ri measurement pulse / Remaining time of the timer" UBYTE t_q0p001 1 100 0.00 0.2550 FORMAT "%6.4" ECU_ADDRESS 0x500001C0 /end MEASUREMENT
/begin MEASUREMENT HEGO_SensS2B1_I.bLdPlsSigCnfReqER_I.buffer "Signal acquisition of HEGO sensor 2 bank 1 / Rising edge of bLdPlsSigCnfReq / rising edge detected" UBYTE B_TRUE 1 100 0.00 1.00000000000 BIT_MASK 0x1 FORMAT "%13.11" ECU_ADDRESS 0x6000CD96 /end MEASUREMENT
/begin MEASUREMENT HEGO_SensS2B1_I.bLdPlsSigCnfReqER_I.oldSignal "Signal acquisition of HEGO sensor 2 bank 1 / Rising edge of bLdPlsSigCnfReq / flag rising edge" UBYTE B_TRUE 1 100 0.00 1.00000000000 BIT_MASK 0x1 FORMAT "%13.11" ECU_ADDRESS 0x6000CD97 /end MEASUREMENT
/begin MEASUREMENT HEGO_SensS2B1_I.bLdPlsSigReqER_I.buffer "Signal acquisition of HEGO sensor 2 bank 1 / Rising edge of bLdPlsSigReq / rising edge detected" UBYTE B_TRUE 1 100 0.00 1.00000000000 BIT_MASK 0x1 FORMAT "%13.11" ECU_ADDRESS 0x6000CD98 /end MEASUREMENT
/begin MEASUREMENT HEGO_SensS2B1_I.bLdPlsSigReqER_I.oldSignal "Signal acquisition of HEGO sensor 2 bank 1 / Rising edge of bLdPlsSigReq / flag rising edge" UBYTE B_TRUE 1 100 0.00 1.00000000000 BIT_MASK 0x1 FORMAT "%13.11" ECU_ADDRESS 0x6000CD99 /end MEASUREMENT
/begin MEASUREMENT HEGO_SensS2B1_I.flgHeatgOffTONV_I.outbit "Signal acquisition of HEGO sensor 2 bank 1 / Delay of heater OFF state for voltage acquisition for Heater coupling detection in ElecMax diagnosis / return value" UBYTE B_TRUE 1 100 0.00 1.00000000000 BIT_MASK 0x1 FORMAT "%13.11" ECU_ADDRESS 0x500001C2 /end MEASUREMENT
/begin MEASUREMENT HEGO_SensS2B1_I.flgHeatgOffTONV_I.time "Signal acquisition of HEGO sensor 2 bank 1 / Delay of heater OFF state for voltage acquisition for Heater coupling detection in ElecMax diagnosis / expired delay time" UBYTE t_q0p001 1 100 0.00 0.2550 FORMAT "%6.4" ECU_ADDRESS 0x500001C3 /end MEASUREMENT
/begin MEASUREMENT HEGO_SensS2B1_I.uVoltMeasmtElecMaxDL_I.memory "Signal acquisition of HEGO sensor 2 bank 1 / filter for measured voltages during heater off for ElecMax-diagnosis / current lowpass value" ULONG spg_q1p8626Em8_V 1 100 0.00 4.99999998137 FORMAT "%13.11" ECU_ADDRESS 0x500001C4 /end MEASUREMENT
/begin MEASUREMENT HEGO_SigCorS2B1_I.duDifT "class instance for HEGO signal correction sensor 2 bank 1 / Voltage deviation caused by temperature deviation, HEGO" SWORD spg_q1p221Em3_V 1 100 -2.500000 2.498779 FORMAT "%8.6" ECU_ADDRESS 0x5000544C /end MEASUREMENT
/begin MEASUREMENT HEGO_SigCorS2B1_I.duSigCor "class instance for HEGO signal correction sensor 2 bank 1 / Voltage signal correction dependant on ceramic temperature" SWORD spg_q1p221Em3_V 1 100 -2.500000 2.498779 FORMAT "%8.6" ECU_ADDRESS 0x5000544E /end MEASUREMENT
/begin MEASUREMENT HEGO_SigCorS2B1_I.numNewRiOld "class instance for HEGO signal correction sensor 2 bank 1 / numerator copy of new Ri for new-Ri-value-indication" UBYTE dez 1 100 0.00 255.0 FORMAT "%5.1" ECU_ADDRESS 0x700019A0 /end MEASUREMENT
/begin MEASUREMENT HEGO_SigCorS2B1_I.numTCerRiVld "class instance for HEGO signal correction sensor 2 bank 1 / Numerator for indication of a valid ceramic temperature sensor 1 bank 1" UBYTE dez 1 100 0.00 255.0 FORMAT "%5.1" ECU_ADDRESS 0x700019A1 /end MEASUREMENT
/begin MEASUREMENT HEGO_SigCorS2B1_I.resRi "class instance for HEGO signal correction sensor 2 bank 1 / internal resistance considering Ri-aging" UWORD r_uw_q2 1 100 0.00 131070.0 FORMAT "%8.1" ECU_ADDRESS 0x50005450 /end MEASUREMENT
/begin MEASUREMENT HEGO_SigCorS2B1_I.resRiElec "class instance for HEGO signal correction sensor 2 bank 1 / initernal resistance in electrical contest" UWORD r_uw_q2 1 100 0.00 131070.0 FORMAT "%8.1" ECU_ADDRESS 0x50005452 /end MEASUREMENT
/begin MEASUREMENT HEGO_SigCorS2B1_I.resRiWpDisp "class instance for HEGO signal correction sensor 2 bank 1 / internal resistance considering Ri-aging" UWORD r_uw_q2 1 100 0.00 131070.0 FORMAT "%8.1" ECU_ADDRESS 0x50005454 /end MEASUREMENT
/begin MEASUREMENT HEGO_SigCorS2B1_I.tCerAct "class instance for HEGO signal correction sensor 2 bank 1 / Actual ceramic temperature, HEGO" UWORD temp_q0p0234_o273 1 100 -273.150 1262.827 FORMAT "%8.3" ECU_ADDRESS 0x50005456 /end MEASUREMENT
/begin MEASUREMENT HEGO_SigCorS2B1_I.tCerNom "class instance for HEGO signal correction sensor 2 bank 1 / Nominal ceramic temperature, HEGO" UWORD temp_q0p0234_o273 1 100 -273.150 1262.827 FORMAT "%8.3" ECU_ADDRESS 0x50005458 /end MEASUREMENT
/begin MEASUREMENT HEGO_SigCorS2B1_I.uNernst "class instance for HEGO signal correction sensor 2 bank 1 / Nernst voltage without electrical circuit, HEGO" UWORD spg_q1p221Em3_V 1 100 0.00 4.998779 FORMAT "%8.6" ECU_ADDRESS 0x5000545A /end MEASUREMENT
/begin MEASUREMENT HEGO_SigCorS2B1_I.uNernstTCor "class instance for HEGO signal correction sensor 2 bank 1 / Nernst volatge at nominal temperature" UWORD spg_q1p221Em3_V 1 100 0.00 4.998779 FORMAT "%8.6" ECU_ADDRESS 0x5000545C /end MEASUREMENT
/begin MEASUREMENT HEGO_SigCorS2B1_I.uTNom "class instance for HEGO signal correction sensor 2 bank 1 / Nernst voltage at nominal temperature, HEGO" UWORD spg_q1p221Em3_V 1 100 0.00 4.998779 FORMAT "%8.6" ECU_ADDRESS 0x5000545E /end MEASUREMENT
/begin MEASUREMENT HEGO_SigCorS2B1_I.uTNomCor "class instance for HEGO signal correction sensor 2 bank 1 / temperature corrected measured sensor voltage" UWORD spg_q1p221Em3_V 1 100 0.00 4.998779 FORMAT "%8.6" ECU_ADDRESS 0x50005460 /end MEASUREMENT
/begin MEASUREMENT HEGO_SnsrTMdlS2B1_I.ctReset100ms "sensor temperature model, class instance sensor 2 bank 1 / Counter reset for interfaces in 100ms" UBYTE OneToOne 1 100 0.00 255.0 FORMAT "%5.1" ECU_ADDRESS 0x600013E8 /end MEASUREMENT
/begin MEASUREMENT HEGO_SnsrTMdlS2B1_I.dtMdlEg "sensor temperature model, class instance sensor 2 bank 1 / temperature difference between exhaust gas and sensor ceramic temperature model" SWORD temp_q0p0234 1 100 -768.0000 767.9766 FORMAT "%8.4" ECU_ADDRESS 0x600013EA /end MEASUREMENT
/begin MEASUREMENT HEGO_SnsrTMdlS2B1_I.dtMdlEgWall "sensor temperature model, class instance sensor 2 bank 1 / temperature difference between exhaust gas wall and sensor ceramic temperature model" SWORD temp_q0p0234 1 100 -768.0000 767.9766 FORMAT "%8.4" ECU_ADDRESS 0x600013EC /end MEASUREMENT
/begin MEASUREMENT HEGO_SnsrTMdlS2B1_I.dtMdlEng "sensor temperature model, class instance sensor 2 bank 1 / temperature difference between engine and sensor ceramic temperature model" SWORD temp_q0p0234 1 100 -768.0000 767.9766 FORMAT "%8.4" ECU_ADDRESS 0x600013EE /end MEASUREMENT
/begin MEASUREMENT HEGO_SnsrTMdlS2B1_I.dtMdlIntkAir "sensor temperature model, class instance sensor 2 bank 1 / temperature difference between intake air and sensor ceramic temperature model" SWORD temp_q0p0234 1 100 -768.0000 767.9766 FORMAT "%8.4" ECU_ADDRESS 0x600013F0 /end MEASUREMENT
/begin MEASUREMENT HEGO_SnsrTMdlS2B1_I.flgReset "sensor temperature model, class instance sensor 2 bank 1 / Flag reset in FcmClr" UBYTE B_TRUE 1 100 0.00 1.00000000000 BIT_MASK 0x1 FORMAT "%13.11" ECU_ADDRESS 0x600013F2 /end MEASUREMENT
/begin MEASUREMENT HEGO_SnsrTMdlS2B1_I.iPHeatr "sensor temperature model, class instance sensor 2 bank 1 / Heater current" UWORD i_q0p00039_A 1 100 0.00 24.99962 FORMAT "%8.5" ECU_ADDRESS 0x600013F4 /end MEASUREMENT
/begin MEASUREMENT HEGO_SnsrTMdlS2B1_I.pwrMdlEg "sensor temperature model, class instance sensor 2 bank 1 / Modelled heat flow from exhaust gas to sensor ceramic" SWORD leist_q0p00244 1 100 -80.00000 79.99756 FORMAT "%8.5" ECU_ADDRESS 0x600013F6 /end MEASUREMENT
/begin MEASUREMENT HEGO_SnsrTMdlS2B1_I.pwrMdlEgWall "sensor temperature model, class instance sensor 2 bank 1 / Modelled heat flow from exhaust wall to sensor ceramic" SWORD leist_q0p00244 1 100 -80.00000 79.99756 FORMAT "%8.5" ECU_ADDRESS 0x600013F8 /end MEASUREMENT
/begin MEASUREMENT HEGO_SnsrTMdlS2B1_I.pwrMdlEng "sensor temperature model, class instance sensor 2 bank 1 / Modelled heat flow from engine to sensor ceramic" SWORD leist_q0p00244 1 100 -80.00000 79.99756 FORMAT "%8.5" ECU_ADDRESS 0x600013FA /end MEASUREMENT
/begin MEASUREMENT HEGO_SnsrTMdlS2B1_I.pwrMdlHeatr "sensor temperature model, class instance sensor 2 bank 1 / Modelled heat flow from sensor heater to sensor ceramic" UWORD leist_q0p00244 1 100 0.00 159.9976 FORMAT "%8.4" ECU_ADDRESS 0x600013FC /end MEASUREMENT
/begin MEASUREMENT HEGO_SnsrTMdlS2B1_I.pwrMdlIntAir "sensor temperature model, class instance sensor 2 bank 1 / Modelled heat flow from intake air to sensor ceramic" SWORD leist_q0p00244 1 100 -80.00000 79.99756 FORMAT "%8.5" ECU_ADDRESS 0x600013FE /end MEASUREMENT
/begin MEASUREMENT HEGO_SnsrTMdlS2B1_I.rHeatr "sensor temperature model, class instance sensor 2 bank 1 / Heater resistance" UWORD r_q0p00039_Ohm 1 100 0.00 25.59961 FORMAT "%8.5" ECU_ADDRESS 0x60001400 /end MEASUREMENT
/begin MEASUREMENT HEGO_SnsrTMdlS2B1_I.tCerMdl "sensor temperature model, class instance sensor 2 bank 1 / modelled sensor ceramic temperature" SLONG temp_q1p5259Em6_om273 1 100 -3549.94000000 3003.65999847 FORMAT "%13.8" ECU_ADDRESS 0x60001404 /end MEASUREMENT
/begin MEASUREMENT HEGO_SnsrTMdlS2B1_I.tCerMdlWpDisp "sensor temperature model, class instance sensor 2 bank 1 / modelled sensor ceramic temperature" UWORD temp_q0p0234_om273 1 100 -273.150 1262.827 FORMAT "%8.3" ECU_ADDRESS 0x60001408 /end MEASUREMENT
/begin MEASUREMENT HEGO_tiS2B1HtgOn "Heater on-time, HEGO sensor 2 bank 1" UBYTE t_q0p001 1 100 0.00 0.2550 FORMAT "%6.4" ECU_ADDRESS 0x6000A042 /end MEASUREMENT
/begin MEASUREMENT HEGO_tS2B1CerAct "Actual ceramic temperature, HEGO sensor 2 bank 1" UWORD temp_q0p0234_o273 1 100 -273.150 1262.827 FORMAT "%8.3" ECU_ADDRESS 0x70002C60 /end MEASUREMENT
/begin MEASUREMENT HEGO_tS2B1EGFltDHtg "Filtered exhaust gas temperature for heater performance diagnosis, HEGO sensor 2 bank 1" UWORD temp_q0p0234_o273 1 100 -273.150 1262.827 FORMAT "%8.3" ECU_ADDRESS 0x600048AC /end MEASUREMENT
/begin MEASUREMENT HEGO_tS2CerNom "Nominal ceramic temperature, HEGO sensor 2" UWORD temp_q0p0234_o273 1 100 -273.150 1262.827 FORMAT "%8.3" ECU_ADDRESS 0x70002C62 /end MEASUREMENT
/begin MEASUREMENT HEGO_uLamHiResS2 "Last modified sensor voltage befor tranfer to lambda, HEGO sensor 2 working point display" UWORD spg_q1p221Em3_V 1 100 0.00 4.998779 FORMAT "%8.6" ECU_ADDRESS 0x6000D914 /end MEASUREMENT
/begin MEASUREMENT HEGO_uS2B1 "Output voltage of Heated Exhaust Gas Oxygen sensor 2 bank 1" UBYTE spg_q0p00488 1 100 0.00 1.245 FORMAT "%5.3" ECU_ADDRESS 0x6000A3A4 /end MEASUREMENT
/begin MEASUREMENT HEGO_uS2B1Extd "Output voltage of HEGO sensor 2 bank 1, extended range" UWORD spg_q0p00488 1 100 0.00 4.995117 FORMAT "%8.6" ECU_ADDRESS 0x60004CBE /end MEASUREMENT
/begin MEASUREMENT HEGO_uS2B1HiRes "Output voltage of Heated Exhaust Gas Oxygen sensor 2 bank 1, high resolution" UWORD spg_q1p221Em3_V 1 100 0.00 4.998779 FORMAT "%8.6" ECU_ADDRESS 0x70002C64 /end MEASUREMENT
/begin MEASUREMENT HEGO_uS2B1LamHiRes "Last modified sensor voltage before transfer to lambda, Heated Exhaust Gas Oxygen sensor 2 bank 1" UWORD spg_q1p221Em3_V 1 100 0.00 4.998779 FORMAT "%8.6" ECU_ADDRESS 0x60004CBC /end MEASUREMENT
/begin MEASUREMENT HEGO_uS2B1LdPls "Voltage resulting from load pulse check, HEGO sensor 2 bank 1" UWORD spg_q1p221Em3_V 1 100 0.00 4.998779 FORMAT "%8.6" ECU_ADDRESS 0x600048AA /end MEASUREMENT
/begin MEASUREMENT HEGO_uS2B1NomHtgLim "Limited nominal heating voltage, HEGO sensor 2 bank 1" UWORD spg_q0p00039 1 100 0.00 25.59961 FORMAT "%8.5" ECU_ADDRESS 0x600048A8 /end MEASUREMENT
/begin MEASUREMENT HEGO_uS2B1SymcHiRes "Symmetrized sensor voltage, Heated Exhaust Gas Oxygen sensor 2 bank 1" UWORD spg_q1p221Em3_V 1 100 0.00 4.998779 FORMAT "%8.6" ECU_ADDRESS 0x60004CBA /end MEASUREMENT
/begin MEASUREMENT HEGO_uS2B1Tstr "Output voltage of HEGO sensor 2 bank 1, for tester" UBYTE spg_q0p005 1 100 0.00 1.275 FORMAT "%5.3" ECU_ADDRESS 0x70002D8D /end MEASUREMENT
/begin MEASUREMENT HEGO_uS2B1WiH2HiRes "Output voltage of HEGO sensor 2 bank 1, with hydrogen influence, high resolution" UWORD spg_q1p221Em3_V 1 100 0.00 4.998779 FORMAT "%8.6" ECU_ADDRESS 0x60004CB8 /end MEASUREMENT
/begin MEASUREMENT HEGO_uS2B1WoDynSimHiRes "Output voltage of HEGO sensor 2 bank 1, without dynamics simulation, high resolution" UWORD spg_q1p221Em3_V 1 100 0.00 4.998779 FORMAT "%8.6" ECU_ADDRESS 0x6000E274 /end MEASUREMENT
/begin MEASUREMENT HEGO_uVoltMeasmtFildElecMaxS2B1 "filtered voltage during heater off state for ElecMax-diagnosis, S2B1" UWORD spg_q1p221Em3_V 1 100 0.00 4.998779 FORMAT "%8.6" ECU_ADDRESS 0x70001CF2 /end MEASUREMENT
/begin MEASUREMENT HEGO_VltgSymcS2B1_I.flgLtrDly "Sensor voltage symmetrization, HEGO sensor 2 bank 1 / Flag asymemtric delay time lean-rich" UBYTE B_TRUE 1 100 0.00 1.00000000000 BIT_MASK 0x1 FORMAT "%13.11" ECU_ADDRESS 0x60001398 /end MEASUREMENT
/begin MEASUREMENT HEGO_VltgSymcS2B1_I.flgLtrSlow "Sensor voltage symmetrization, HEGO sensor 2 bank 1 / Flag asymemtric slow-down lean-rich" UBYTE B_TRUE 1 100 0.00 1.00000000000 BIT_MASK 0x2 FORMAT "%13.11" ECU_ADDRESS 0x60001398 /end MEASUREMENT
/begin MEASUREMENT HEGO_VltgSymcS2B1_I.flgLtrTran "Sensor voltage symmetrization, HEGO sensor 2 bank 1 / Flag asymemtric transition time lean-rich" UBYTE B_TRUE 1 100 0.00 1.00000000000 BIT_MASK 0x4 FORMAT "%13.11" ECU_ADDRESS 0x60001398 /end MEASUREMENT
/begin MEASUREMENT HEGO_VltgSymcS2B1_I.flgRtlDly "Sensor voltage symmetrization, HEGO sensor 2 bank 1 / Flag asymemtric delay time rich-lean" UBYTE B_TRUE 1 100 0.00 1.00000000000 BIT_MASK 0x8 FORMAT "%13.11" ECU_ADDRESS 0x60001398 /end MEASUREMENT
/begin MEASUREMENT HEGO_VltgSymcS2B1_I.flgRtlSlow "Sensor voltage symmetrization, HEGO sensor 2 bank 1 / Flag asymemtric slow-down rich-lean" UBYTE B_TRUE 1 100 0.00 1.00000000000 BIT_MASK 0x10 FORMAT "%13.11" ECU_ADDRESS 0x60001398 /end MEASUREMENT
/begin MEASUREMENT HEGO_VltgSymcS2B1_I.flgRtlTran "Sensor voltage symmetrization, HEGO sensor 2 bank 1 / Flag asymemtric transition time rich-lean" UBYTE B_TRUE 1 100 0.00 1.00000000000 BIT_MASK 0x20 FORMAT "%13.11" ECU_ADDRESS 0x60001398 /end MEASUREMENT
/begin MEASUREMENT HEGO_VltgSymcS2B1_I.flgSymcEna "Sensor voltage symmetrization, HEGO sensor 2 bank 1 / Flag enable symmetrization" UBYTE B_TRUE 1 100 0.00 1.00000000000 BIT_MASK 0x40 FORMAT "%13.11" ECU_ADDRESS 0x60001398 /end MEASUREMENT
/begin MEASUREMENT HEGO_VltgSymcS2B1_I.uSmotngOld "Sensor voltage symmetrization, HEGO sensor 2 bank 1 / Smoothed sensor voltage, old value" UWORD spg_q1p221Em3_V 1 100 0.00 4.998779 FORMAT "%8.6" ECU_ADDRESS 0x6000139A /end MEASUREMENT
/begin MEASUREMENT HEGO_VltgSymcS2B1_I.uSymc "Sensor voltage symmetrization, HEGO sensor 2 bank 1 / Symmetrized sensor voltage" UWORD spg_q1p221Em3_V 1 100 0.00 4.998779 FORMAT "%8.6" ECU_ADDRESS 0x6000139C /end MEASUREMENT
/begin MEASUREMENT HEGO_VltgSymcS2B1_I.uSymcTran "Sensor voltage symmetrization, HEGO sensor 2 bank 1 / Sensor voltage after transition time symmetrization" UWORD spg_q1p221Em3_V 1 100 0.00 4.998779 FORMAT "%8.6" ECU_ADDRESS 0x6000139E /end MEASUREMENT
/begin MEASUREMENT HEGO_VltgSymcS2B1_I.flgSlowER_I.buffer "Sensor voltage symmetrization, HEGO sensor 2 bank 1 / Rising edge of asymmetric slow-down / rising edge detected" UBYTE B_TRUE 1 100 0.00 1.00000000000 BIT_MASK 0x1 FORMAT "%13.11" ECU_ADDRESS 0x600013A0 /end MEASUREMENT
/begin MEASUREMENT HEGO_VltgSymcS2B1_I.flgSlowER_I.oldSignal "Sensor voltage symmetrization, HEGO sensor 2 bank 1 / Rising edge of asymmetric slow-down / flag rising edge" UBYTE B_TRUE 1 100 0.00 1.00000000000 BIT_MASK 0x1 FORMAT "%13.11" ECU_ADDRESS 0x600013A1 /end MEASUREMENT
/begin MEASUREMENT HEGO_VltgSymcS2B1_I.flgSymcDlyEnaER_I.buffer "Sensor voltage symmetrization, HEGO sensor 2 bank 1 / Rising edge of enable condition for delay time symmetrization / rising edge detected" UBYTE B_TRUE 1 100 0.00 1.00000000000 BIT_MASK 0x1 FORMAT "%13.11" ECU_ADDRESS 0x600013A2 /end MEASUREMENT
/begin MEASUREMENT HEGO_VltgSymcS2B1_I.flgSymcDlyEnaER_I.oldSignal "Sensor voltage symmetrization, HEGO sensor 2 bank 1 / Rising edge of enable condition for delay time symmetrization / flag rising edge" UBYTE B_TRUE 1 100 0.00 1.00000000000 BIT_MASK 0x1 FORMAT "%13.11" ECU_ADDRESS 0x600013A3 /end MEASUREMENT
/begin MEASUREMENT HEGO_VltgSymcS2B1_I.flgSymcTranEnaER_I.buffer "Sensor voltage symmetrization, HEGO sensor 2 bank 1 / Rising edge of enable condition for transition time symmetrization / rising edge detected" UBYTE B_TRUE 1 100 0.00 1.00000000000 BIT_MASK 0x1 FORMAT "%13.11" ECU_ADDRESS 0x600013A4 /end MEASUREMENT
/begin MEASUREMENT HEGO_VltgSymcS2B1_I.flgSymcTranEnaER_I.oldSignal "Sensor voltage symmetrization, HEGO sensor 2 bank 1 / Rising edge of enable condition for transition time symmetrization / flag rising edge" UBYTE B_TRUE 1 100 0.00 1.00000000000 BIT_MASK 0x1 FORMAT "%13.11" ECU_ADDRESS 0x600013A5 /end MEASUREMENT
/begin MEASUREMENT HEGO_VltgSymcS2B1_I.uDlyDTTtOptSens_I.buffer "Sensor voltage symmetrization, HEGO sensor 2 bank 1 / Delay for delay time symmetrization / Delay for symmetrization" UWORD spg_q1p221Em3_V 1 100 0.00 4.998779 FORMAT "%8.6" ARRAY_SIZE 21 ECU_ADDRESS 0x600013A6 /end MEASUREMENT
/begin MEASUREMENT HEGO_VltgSymcS2B1_I.uDlyDTTtOptSens_I.counter "Sensor voltage symmetrization, HEGO sensor 2 bank 1 / Delay for delay time symmetrization / Delay for symmetrization" UWORD fak_uw_b2 1 100 0.00 1.000000 FORMAT "%8.6" ECU_ADDRESS 0x600013D0 /end MEASUREMENT
/begin MEASUREMENT HEGO_VltgSymcS2B1_I.uDlyDTTtOptSens_I.pointer "Sensor voltage symmetrization, HEGO sensor 2 bank 1 / Delay for delay time symmetrization / Delay for symmetrization" UBYTE dez 1 100 0.00 255.0 FORMAT "%5.1" ECU_ADDRESS 0x600013D2 /end MEASUREMENT
/begin MEASUREMENT HEGO_VltgSymcS2B1_I.uSmotngLT_I.memory "Sensor voltage symmetrization, HEGO sensor 2 bank 1 / Smoothing of sensor voltage for direction detection in case if symmetrization / current lowpass value" ULONG spg_q1p8626Em8_V 1 100 0.00 4.99999998137 FORMAT "%13.11" ECU_ADDRESS 0x600013D4 /end MEASUREMENT
/begin MEASUREMENT HEGO_VltgSymcS2B1_I.uTranLT_I.memory "Sensor voltage symmetrization, HEGO sensor 2 bank 1 / Lowpass filter for transition time symmetrization / current lowpass value" ULONG spg_q1p8626Em8_V 1 100 0.00 4.99999998137 FORMAT "%13.11" ECU_ADDRESS 0x600013D8 /end MEASUREMENT
/begin MEASUREMENT HESrv_stMSid "ECU ID in 2 ECU concepts" UBYTE HESrv_stMSid_t 1 100 0.00 255.000000000 FORMAT "%13.9" ECU_ADDRESS 0x6000A3A3 /end MEASUREMENT
/begin FUNCTION HEGO_Htg "3.53.0    Heating binary oxygen sensors"
 /begin DEF_CHARACTERISTIC HEGO_duHtgMapMax_C HEGO_duNomHtgIMax_C HEGO_duNomHtgIMin_C HEGO_duNomHtgPMax_C HEGO_duNomHtgPMin_C HEGO_duNomHtgRedErrElecMin_C HEGO_facHtgIGn_C HEGO_facHtgPGn_CUR HEGO_flgDewPntEndFreeSnsr_C HEGO_HtgS2B1_I.duHtgRmpDwn_C HEGO_HtgS2B1_I.duHtgRmpUp_C HEGO_HtgS2B1_I.pwrHtgSuffMin_C HEGO_HtgS2B1_I.resRiDBndMax_C HEGO_HtgS2B1_I.resRiDBndMin_C HEGO_HtgS2B1_I.resRiNom_C HEGO_HtgS2B1_I.stHtg_CW HEGO_HtgS2B1_I.tEGHtgSuffMin_C HEGO_HtgS2B1_I.tiDebHtgMax_C HEGO_HtgS2B1_I.tiDebHtgStrtUs_C HEGO_HtgS2B1_I.tiHtgSuffDeb_C HEGO_HtgS2B1_I.tiMaxHtgRedEngOff_CUR HEGO_HtgS2B1_I.tiMaxHtgRedPrt_CUR HEGO_HtgS2B1_I.tiMaxHtgRed_C HEGO_HtgS2B1_I.tiTExhSnsrFil_M HEGO_HtgS2B1_I.uDrpHtg_C HEGO_HtgS2B1_I.uHtgAftPrt_CUR HEGO_HtgS2B1_I.uHtgMapCtl_MAP HEGO_HtgS2B1_I.uHtgMaxDeb_C HEGO_HtgS2B1_I.uHtgMaxHtUp_C HEGO_HtgS2B1_I.uHtgMax_C HEGO_HtgS2B1_I.uHtgNom_C HEGO_HtgS2B1_I.uHtgPrt_C HEGO_resRiCorrdHtgRed_C HEGO_resRiHtgOffLo_C HEGO_resRiHtgOff_C HEGO_resRiImpsThdHtgStrt_C HEGO_resRiOffsHysHtgRed_C HEGO_resRiSwtHeatgMapThd_C HEGO_rHtgMaxAntiWindUp_C HEGO_rHtgMinAntiWindUp_C HEGO_stHtgEna_CW HEGO_stHtg_CW HEGO_tEGHtgOffStop_C HEGO_tEGHtgRed_C HEGO_tEGMaxHtgEna_C HEGO_tEGMinHtg_C HEGO_tEngHotHtg_C HEGO_tEngMinHeatgProtn_C HEGO_tExhStrtMinMapHtg_C HEGO_tExhStrt_C HEGO_tiDebBattHtgOff_C HEGO_tiDebHeatgStrt_C HEGO_tiDebHtgMapClsdLop_C HEGO_tiDebHtgMaxHys_C HEGO_tiDebHtgPreDrive_C HEGO_tiDebNewRiAvlHtg_C HEGO_tiDebNewRiHtg_C HEGO_tiDebRiActAvlHtg_C HEGO_tiEngStop_C HEGO_tiFltRiHtg_C HEGO_tiPerdHtg_C HEGO_tiTExhSnsrDyn_C HEGO_uBattHtgOff_C /end DEF_CHARACTERISTIC
 /begin REF_CHARACTERISTIC HEGO_flgS2B1Prsnt_C HEGO_tiS2FrzSigRiAcqn_C /end REF_CHARACTERISTIC
 /begin IN_MEASUREMENT BattU_u CEngDsT_t Eep_EnvRamInvld EngStrt_bStrtEnd ExhMod_flgDewPntEndS2B1 ExhMod_flgTSnsrStrtCalcdB1 ExhMod_mfExhCat1B1 ExhMod_tExhS2B1 ExhMod_tExhStrtS2B1 ExhMod_tWallS2B1 HEGO_bS2B1ErrElecMinWoDeb HEGO_bS2B1NewRi HEGO_bS2B1Vld HEGO_numVoltMeasmtElecMaxS2B1 HEGO_resS2B1RiCorrd SyC_ctPostDrvLeave SyC_stSub TiEngOff_stTi TiOff_tiStrtEndOff UEGO_flgSnsrHotS1B1 /end IN_MEASUREMENT
 /begin OUT_MEASUREMENT HEGO_bS2B1HtgEna HEGO_bS2B1HtgOn HEGO_bS2B1HtgPrtFin HEGO_bS2B1HtgRiReq HEGO_bS2B1HtgStrt HEGO_bS2B1HtgSuff HEGO_flgHtgClsdLopEnaS2B1 HEGO_flgS2B1InhbRiMeasmtElDiag HEGO_pwrS2B1Htg HEGO_pwrS2B1HtgOnRls HEGO_resS2B1RiNom HEGO_rS2B1HtgLim HEGO_tiS2B1HtgOn HEGO_uS2B1NomHtgLim /end OUT_MEASUREMENT
 /begin LOC_MEASUREMENT HEGO_bS2B1HtgOffTiImpsMem HEGO_flgS2B1HtgOnDes HEGO_HtgEnaS2B1_I.bEngStrtFinFF HEGO_HtgEnaS2B1_I.bHtgEna HEGO_HtgEnaS2B1_I.flgPhysEna HEGO_HtgEnaS2B1_I.BattHtgOffTONV_I.outbit HEGO_HtgEnaS2B1_I.BattHtgOffTONV_I.time HEGO_HtgEnaS2B1_I.DebHtgPreDriveTOFFV_I.outbit HEGO_HtgEnaS2B1_I.DebHtgPreDriveTOFFV_I.time HEGO_HtgS2B1_I.bDebHtgStrt HEGO_HtgS2B1_I.bHtgClsdLopAntiWndUp HEGO_HtgS2B1_I.bHtgClsdLopEna HEGO_HtgS2B1_I.bHtgClsdLopRiReq HEGO_HtgS2B1_I.bHtgEna HEGO_HtgS2B1_I.bHtgMap HEGO_HtgS2B1_I.bHtgOffHiTemp HEGO_HtgS2B1_I.bHtgPrtFin HEGO_HtgS2B1_I.bHtgPrtInhb HEGO_HtgS2B1_I.bHtgStrt HEGO_HtgS2B1_I.bHtgStrtInhb HEGO_HtgS2B1_I.bHtgStrtPwrRed HEGO_HtgS2B1_I.bHtgSuff HEGO_HtgS2B1_I.bRiActAvl HEGO_HtgS2B1_I.cycHtgCntr HEGO_HtgS2B1_I.dresRi HEGO_HtgS2B1_I.duNomHtgClsdLop HEGO_HtgS2B1_I.duNomHtgI HEGO_HtgS2B1_I.duNomHtgP HEGO_HtgS2B1_I.flgHtgOnReq HEGO_HtgS2B1_I.flgInhbRiElecMax HEGO_HtgS2B1_I.flgRiHtgStrtPwrRed HEGO_HtgS2B1_I.mEGHtg HEGO_HtgS2B1_I.numHtgCycDif HEGO_HtgS2B1_I.numHtgCycOffReq HEGO_HtgS2B1_I.numHtgCycOnReq HEGO_HtgS2B1_I.numVoltMeasmtElecMaxPrev HEGO_HtgS2B1_I.pwrHtg HEGO_HtgS2B1_I.pwrHtgOnRls HEGO_HtgS2B1_I.rHtg HEGO_HtgS2B1_I.rHtgLim HEGO_HtgS2B1_I.resRiAct HEGO_HtgS2B1_I.resRiNom HEGO_HtgS2B1_I.tEGFltHtg HEGO_HtgS2B1_I.tEg HEGO_HtgS2B1_I.tExhSnsrDyn HEGO_HtgS2B1_I.tiFilTExhSn HEGO_HtgS2B1_I.tiHtgOn HEGO_HtgS2B1_I.tiHtgPrt HEGO_HtgS2B1_I.uBattHtg HEGO_HtgS2B1_I.uNomHtg HEGO_HtgS2B1_I.uNomHtgAftPrt HEGO_HtgS2B1_I.uNomHtgLim HEGO_HtgS2B1_I.uNomHtgMap HEGO_HtgS2B1_I.uNomHtgNoLim HEGO_HtgS2B1_I.uNomHtgStrt HEGO_HtgS2B1_I.DebAtmstTONV_I.outbit HEGO_HtgS2B1_I.DebAtmstTONV_I.time HEGO_HtgS2B1_I.DebHeatgStrtTONV_I.outbit HEGO_HtgS2B1_I.DebHeatgStrtTONV_I.time HEGO_HtgS2B1_I.DebHtgMapClsdLopTONV_I.outbit HEGO_HtgS2B1_I.DebHtgMapClsdLopTONV_I.time HEGO_HtgS2B1_I.DebHtgMaxTOFFV_I.outbit HEGO_HtgS2B1_I.DebHtgMaxTOFFV_I.time HEGO_HtgS2B1_I.DebHtgStrtUsTONV_I.outbit HEGO_HtgS2B1_I.DebHtgStrtUsTONV_I.time HEGO_HtgS2B1_I.DebNewRiAvlTOFFV_I.outbit HEGO_HtgS2B1_I.DebNewRiAvlTOFFV_I.time HEGO_HtgS2B1_I.DebNewRiTOFFV_I.outbit HEGO_HtgS2B1_I.DebNewRiTOFFV_I.time HEGO_HtgS2B1_I.DebRiActAvlTOFFV_I.outbit HEGO_HtgS2B1_I.DebRiActAvlTOFFV_I.time HEGO_HtgS2B1_I.HtgRedTONV_I.outbit HEGO_HtgS2B1_I.HtgRedTONV_I.time HEGO_HtgS2B1_I.RiHtgLT_I.memory HEGO_HtgS2B1_I.bHtgStrtEF_I.buffer HEGO_HtgS2B1_I.bHtgStrtEF_I.oldSignal HEGO_HtgS2B1_I.bHtgStrtPwrRedEF_I.buffer HEGO_HtgS2B1_I.bHtgStrtPwrRedEF_I.oldSignal HEGO_HtgS2B1_I.bRiActAvlER_I.buffer HEGO_HtgS2B1_I.bRiActAvlER_I.oldSignal HEGO_HtgS2B1_I.duNomHtgITL_I.memory HEGO_HtgS2B1_I.flgIntrptHeatgElDiagSW_I.timeCounter HEGO_HtgS2B1_I.tEGHtgLT_I.memory HEGO_HtgS2B1_I.tExhSnsrLT_I.memory HEGO_HtgS2B1_I.tiHtgPrtSW_I.timeCounter HEGO_HtgS2B1_I.uNomHtgStrtAL_I.memory HEGO_Htg_ctReIni /end LOC_MEASUREMENT
 FUNCTION_VERSION "3.53.0" /end FUNCTION
/begin FUNCTION HEGO_OBDElec "1.54.0    Electrical diagnostics for binary oxygen sensors"
 /begin DEF_CHARACTERISTIC HEGO_duErrElecMinLdPls_C HEGO_duErrElecSigLdPls_C HEGO_flgDiDesLamChk_CW HEGO_flgEnaElecMaxNplColdSnsr_CW HEGO_flgPmpO2Ref_C HEGO_flgSnsrOperRdnOverRi_CW HEGO_numMinVoltMeasmtElecMax_C HEGO_numRiOkOpRdn_C HEGO_OBDElecS2B1_I.stDElec_CW HEGO_OpRdnS2B1_I.flgHtgSuff_CW HEGO_OpRdnS2B1_I.stOpRdn_CW HEGO_OpRdnS2B1_I.tCerMdlThdExptOpRdn_C HEGO_OpRdnS2B1_I.tiDebErrStk_C HEGO_OpRdnS2B1_I.tiDebExptOpRdn_CUR HEGO_OpRdnS2B1_I.tiDebPrtHtgFin_C HEGO_resErrElecSigRi_C HEGO_resRiOpRdn_C HEGO_resRstErrElecSigRi_C HEGO_SnsrTMdlS2B1_I.facHeatgPwrCnvnT_C HEGO_SnsrTMdlS2B1_I.facTHeatFlowEgWall_C HEGO_SnsrTMdlS2B1_I.facTHeatFlowEg_T HEGO_SnsrTMdlS2B1_I.facTHeatFlowEng_C HEGO_SnsrTMdlS2B1_I.facTHeatFlowIntkAir_C HEGO_SnsrTMdlS2B1_I.rHeatr_T HEGO_SnsrTMdlS2B1_I.rLossHeatrPS_C HEGO_stDElec_CW HEGO_tEGErrElecSigRi_C HEGO_tiDebErrElecMax_C HEGO_tiDebErrElecMinSus_C HEGO_tiDebErrElecMin_C HEGO_tiDebErrElecSigSus_C HEGO_tiDebGenDElec_C HEGO_tiDebRstErrStkCVB_C HEGO_tiDelLdPlsMin_C HEGO_tiDelLdPlsSig_C HEGO_uBattMinDElec_C HEGO_uErrElecMaxColdSnsr_C HEGO_uErrElecMaxNormOper_C HEGO_uErrElecMinORRLow_C HEGO_uErrElecMin_C HEGO_uS23LeanOpRdn_C HEGO_uS23RichOpRdn_C /end DEF_CHARACTERISTIC
 /begin REF_CHARACTERISTIC HEGO_flgReIniSnsrTMdl_C HEGO_resRiMaxPlaus_C HEGO_flgS2B1Prsnt_C /end REF_CHARACTERISTIC
 /begin IN_MEASUREMENT BattU_u B_bevab_msg B_sa_msg Eep_EnvRamInvld EngStrt_bStrtEnd ExhMod_tExhS2B1 ExhMod_tWallS2B1 HEGO_bS2B1HtgPrtFin HEGO_bS2B1HtgSuff HEGO_bS2B1LdPlsRslt HEGO_bS2B1NewRi HEGO_bS2B1VldRi HEGO_flgNumVoltMeasmtElecMaxSuffS2B1 HEGO_numCalcRiS2B1 HEGO_resS2B1Ri HEGO_resS2B1RiCorrd HEGO_rS2B1HtgLim HEGO_tS2B1CerAct HEGO_uS2B1Extd HEGO_uS2B1LdPls HEGO_uVoltMeasmtFildElecMaxS2B1 lamsons_w_msg SyC_ctPostDrvLeave SyC_stSub TWCC_bEnaRichPurgB1 /end IN_MEASUREMENT
 /begin OUT_MEASUREMENT HEGO_bS2B1EnaDElec HEGO_bS2B1ErrElecHtrCpl HEGO_bS2B1ErrElecMinWoDeb HEGO_bS2B1ErrElecSig HEGO_bS2B1ErrElecSigPrev HEGO_bS2B1ErrElecSigRi HEGO_bS2B1ExptOpRdn HEGO_bS2B1InVldErr HEGO_bS2B1LdPlsMinReq HEGO_bS2B1LdPlsSigCnfReq HEGO_bS2B1LdPlsSigReq HEGO_bS2B1OpRdnRiReq HEGO_bS2B1Vld HEGO_flgLamEnaElecMaxS2B1 HEGO_flgVldTstrS2B1 /end OUT_MEASUREMENT
 /begin LOC_MEASUREMENT HEGO_bEnaDElecPhy HEGO_flgDrvDSMTripChgFinshdOBDElec HEGO_flgFCMClrReqdOBDElec100msS2 HEGO_flgFCMClrReqdOBDElec10msS2 HEGO_OBDElecS2B1_I.bErrElecMinWoDeb HEGO_OBDElecS2B1_I.bErrElecSig HEGO_OBDElecS2B1_I.bErrElecSus HEGO_OBDElecS2B1_I.bErrHtrCpl HEGO_OBDElecS2B1_I.bFCMClrReqdCL100ms HEGO_OBDElecS2B1_I.bNoErrElecMinSus HEGO_OBDElecS2B1_I.ctReset100ms HEGO_OBDElecS2B1_I.flgDiagElecMax HEGO_OBDElecS2B1_I.flgDiagElecMaxUHi HEGO_OBDElecS2B1_I.flgDiagElecMin HEGO_OBDElecS2B1_I.flgErrElecMax HEGO_OBDElecS2B1_I.flgLamEnaElecMax HEGO_OBDElecS2B1_I.flgNumvoltMeasmtElecMaxSuff HEGO_OBDElecS2B1_I.DebDiagElecMaxTONV_I.outbit HEGO_OBDElecS2B1_I.DebDiagElecMaxTONV_I.time HEGO_OBDElecS2B1_I.DebDiagElecMinTONV_I.outbit HEGO_OBDElecS2B1_I.DebDiagElecMinTONV_I.time HEGO_OBDElecS2B1_I.DebErrElecMaxTONV_I.outbit HEGO_OBDElecS2B1_I.DebErrElecMaxTONV_I.time HEGO_OBDElecS2B1_I.DebErrElecMinSusTONV_I.outbit HEGO_OBDElecS2B1_I.DebErrElecMinSusTONV_I.time HEGO_OBDElecS2B1_I.DebErrElecMinTONV_I.outbit HEGO_OBDElecS2B1_I.DebErrElecMinTONV_I.time HEGO_OBDElecS2B1_I.DebErrElecSigSusTONV_I.outbit HEGO_OBDElecS2B1_I.DebErrElecSigSusTONV_I.time HEGO_OBDElecS2B1_I.DebRstErrElecMinTONV_I.outbit HEGO_OBDElecS2B1_I.DebRstErrElecMinTONV_I.time HEGO_OBDElecS2B1_I.ErrElecMaxFF_I.status HEGO_OBDElecS2B1_I.ErrElecMinFF_I.status HEGO_OBDElecS2B1_I.ErrElecSigRiFF_I.status HEGO_OBDElecS2B1_I.Min_I.bErrMinLdPls HEGO_OBDElecS2B1_I.Min_I.bLdPlsMinReq HEGO_OBDElecS2B1_I.Min_I.flgMinDiagEnad HEGO_OBDElecS2B1_I.Min_I.sm HEGO_OBDElecS2B1_I.Min_I.DelLdPlsMinTR_I.timeCounter HEGO_OBDElecS2B1_I.Sig_I.bErrSigLdPls HEGO_OBDElecS2B1_I.Sig_I.bErrSigSusLdPls HEGO_OBDElecS2B1_I.Sig_I.bLdPlsSigCnfExe HEGO_OBDElecS2B1_I.Sig_I.bLdPlsSigCnfReq HEGO_OBDElecS2B1_I.Sig_I.bLdPlsSigExe HEGO_OBDElecS2B1_I.Sig_I.bLdPlsSigReq HEGO_OBDElecS2B1_I.Sig_I.sm HEGO_OBDElecS2B1_I.Sig_I.DelLdPlsSigTR_I.timeCounter HEGO_OpRdnS2B1_I.bEna HEGO_OpRdnS2B1_I.bEnaDElec HEGO_OpRdnS2B1_I.bEnaOpRdnSens HEGO_OpRdnS2B1_I.bEnaSigChkd HEGO_OpRdnS2B1_I.bErrSigPrev HEGO_OpRdnS2B1_I.bExptOpRdn HEGO_OpRdnS2B1_I.bFCMClrReqdCL100ms HEGO_OpRdnS2B1_I.bHEGOInVldErr HEGO_OpRdnS2B1_I.bHtgOk HEGO_OpRdnS2B1_I.bOpRdnRiReq HEGO_OpRdnS2B1_I.bRiOkOpRdn HEGO_OpRdnS2B1_I.bSVld HEGO_OpRdnS2B1_I.bStkCVB HEGO_OpRdnS2B1_I.flgTCerMdlOk HEGO_OpRdnS2B1_I.numCalcRiOpRdn HEGO_OpRdnS2B1_I.tEGOpRdn HEGO_OpRdnS2B1_I.DebErrStkTONV_I.outbit HEGO_OpRdnS2B1_I.DebErrStkTONV_I.time HEGO_OpRdnS2B1_I.DebExptOpRdnTONV_I.outbit HEGO_OpRdnS2B1_I.DebExptOpRdnTONV_I.time HEGO_OpRdnS2B1_I.DebPrtHtgFinTONV_I.outbit HEGO_OpRdnS2B1_I.DebPrtHtgFinTONV_I.time HEGO_OpRdnS2B1_I.DebSVldTONV_I.outbit HEGO_OpRdnS2B1_I.DebSVldTONV_I.time HEGO_OpRdnS2B1_I.EnaOpRdnHtgFF_I.status HEGO_OpRdnS2B1_I.OpRdnMemFF_I.status HEGO_OpRdnS2B1_I.SVldFF_I.status HEGO_OpRdnS2B1_I.StkCVBSusFF_I.status HEGO_OpRdnS2B1_I.numRiOkCTR_I.counter HEGO_SnsrTMdlS2B1_I.ctReset100ms HEGO_SnsrTMdlS2B1_I.dtMdlEg HEGO_SnsrTMdlS2B1_I.dtMdlEgWall HEGO_SnsrTMdlS2B1_I.dtMdlEng HEGO_SnsrTMdlS2B1_I.dtMdlIntkAir HEGO_SnsrTMdlS2B1_I.flgReset HEGO_SnsrTMdlS2B1_I.iPHeatr HEGO_SnsrTMdlS2B1_I.pwrMdlEg HEGO_SnsrTMdlS2B1_I.pwrMdlEgWall HEGO_SnsrTMdlS2B1_I.pwrMdlEng HEGO_SnsrTMdlS2B1_I.pwrMdlHeatr HEGO_SnsrTMdlS2B1_I.pwrMdlIntAir HEGO_SnsrTMdlS2B1_I.rHeatr HEGO_SnsrTMdlS2B1_I.tCerMdl HEGO_SnsrTMdlS2B1_I.tCerMdlWpDisp /end LOC_MEASUREMENT
 FUNCTION_VERSION "1.54.0" /end FUNCTION
/begin FUNCTION HEGO_OBDHtg "1.35.0    Heating performance diagnostics for binary oxygen sensors"
 /begin DEF_CHARACTERISTIC HEGO_flgDebDHtgAftStop_CW HEGO_OBDHtgS2B1_I.resRiThresDHtgLoTemp_MAP HEGO_OBDHtgS2B1_I.resRiThresDHtg_MAP HEGO_OBDHtgS2B1_I.stDHtg_CW HEGO_resRiHystDHtg_C HEGO_resRiMaxHtgSuff_C HEGO_stS2DHtg_CW HEGO_tEGDHtgMax_C HEGO_tEGDHtgMin_C HEGO_tEGDHtgShrtTrpMax_C HEGO_tEGDHtgShrtTrpMin_C HEGO_tEGFltMin_C HEGO_tiDebDHtgFuncReq_C HEGO_tiDebDHtgStop_C HEGO_tiDebDHtgStrt_C HEGO_tiDebDPERiThresDHtg_C HEGO_tiDebEnaDHtgCtlExt_C HEGO_tiDebErrHtgFIDRls_C HEGO_tiDebErrHtg_C HEGO_tiDebHealHtgErr_C HEGO_tiDebHealHtg_C HEGO_tiEngStopDHtgMin_C HEGO_tiFltPwrHtg_C HEGO_tiFltTempEG_CUR HEGO_tIntkAirThrDHtgMin_C HEGO_uBattDHeatgMax_C HEGO_uBattDHeatgMin_C /end DEF_CHARACTERISTIC
 /begin REF_CHARACTERISTIC HEGO_flgS2B1Prsnt_C /end REF_CHARACTERISTIC
 /begin IN_MEASUREMENT BattU_u B_sa_msg Eep_EnvRamInvld EngStrt_bStrtEnd ExhMod_flgDewPntEndS2B1 ExhMod_flgTSnsrStrtCalcdB1 ExhMod_mfExhCat1B1 ExhMod_tExhS2B1 HEGO_bS2B1ErrElecSigRi HEGO_bS2B1ExptOpRdn HEGO_bS2B1VldRi HEGO_pwrS2B1Htg HEGO_resS2B1RiCorrdFild SyC_ctPostDrvLeave SyC_stSub tandk_w_msg TiEngOff_stTiFirstStrt TiEngOff_tiFirstStrt /end IN_MEASUREMENT
 /begin OUT_MEASUREMENT HEGO_bEnaDPs HEGO_bS2B1EnaDHtg HEGO_bS2B1HtgSuffRi HEGO_dresS2B1RiThresMin HEGO_resS2B1RiThres HEGO_tS2B1EGFltDHtg /end OUT_MEASUREMENT
 /begin LOC_MEASUREMENT HEGO_bDHtgTempIntkAirOk HEGO_bDHtgTiEngStopOk HEGO_bEnaDHtgAftStop HEGO_bFCMClrS2B1OBDHtg HEGO_DebDHtgAftStopFF_I.status HEGO_DebDHtgGenFuncReqTONV_I.outbit HEGO_DebDHtgGenFuncReqTONV_I.time HEGO_DebDHtgStopEF_I.buffer HEGO_DebDHtgStopEF_I.oldSignal HEGO_DebDHtgStopTOFFV_I.outbit HEGO_DebDHtgStopTOFFV_I.time HEGO_DebDHtgStrtER_I.buffer HEGO_DebDHtgStrtER_I.oldSignal HEGO_DebDHtgStrtTONV_I.outbit HEGO_DebDHtgStrtTONV_I.time HEGO_DHtgEGTMStrtB1ER_I.buffer HEGO_DHtgEGTMStrtB1ER_I.oldSignal HEGO_dresS2B1RiThresMinNV HEGO_flgDrvDsmTripChgdOBDHtg HEGO_flgEnvtlCond HEGO_flgFCMClrReqdOBDHtg HEGO_OBDHtgS2B1_I.bEnaDHtg HEGO_OBDHtgS2B1_I.bEnaDHtgFCMClrEngRun HEGO_OBDHtgS2B1_I.bErrHtg HEGO_OBDHtgS2B1_I.bHealHtg HEGO_OBDHtgS2B1_I.bHtgSuffRi HEGO_OBDHtgS2B1_I.bRiImPlausHi HEGO_OBDHtgS2B1_I.bRlsDHtg HEGO_OBDHtgS2B1_I.pwrHtgFlt HEGO_OBDHtgS2B1_I.resRiThresDHtg HEGO_OBDHtgS2B1_I.tEGFlt HEGO_OBDHtgS2B1_I.DHtgGenFuncReqFF_I.status HEGO_OBDHtgS2B1_I.DebDPERiThresDHtgTONV_I.outbit HEGO_OBDHtgS2B1_I.DebDPERiThresDHtgTONV_I.time HEGO_OBDHtgS2B1_I.DebEnaDHtgCtlExtTONV_I.outbit HEGO_OBDHtgS2B1_I.DebEnaDHtgCtlExtTONV_I.time HEGO_OBDHtgS2B1_I.DebErrHtgFIDRlsTONV_I.outbit HEGO_OBDHtgS2B1_I.DebErrHtgFIDRlsTONV_I.time HEGO_OBDHtgS2B1_I.DebErrHtgIUMPRTONV_I.outbit HEGO_OBDHtgS2B1_I.DebErrHtgIUMPRTONV_I.time HEGO_OBDHtgS2B1_I.DebHealHtgTONV_I.outbit HEGO_OBDHtgS2B1_I.DebHealHtgTONV_I.time HEGO_OBDHtgS2B1_I.PwrHtgLPT_I.memory HEGO_OBDHtgS2B1_I.TempEGLPT_I.memory HEGO_OBDHtgS2B1_I.flgDebErrHtgTONV_I.outbit HEGO_OBDHtgS2B1_I.flgDebErrHtgTONV_I.time HEGO_OBDHtg_ctReIni /end LOC_MEASUREMENT
 FUNCTION_VERSION "1.35.0" /end FUNCTION
/begin FUNCTION HEGO_OBDHtrPs "1.30.0    Heater power stage diagnosis binary oxygen sensors"
 /begin DEF_CHARACTERISTIC HEGO_nrTstPls_C HEGO_OBDHtrPsS2B1_I.tiDebDHtrPsEnaFst_C HEGO_OBDHtrPsS2B1_I.tiDebDHtrPsEna_C HEGO_OBDHtrPsS2B1_I.uBattMaxDHtrPs_C HEGO_stHeatrPSDiagDeactvn_C HEGO_stS2Ps_CW HEGO_tAmbMinDHtrPs_C HEGO_tiBtwElecFlt_C HEGO_tiBtwOTFlt_C HEGO_tiDebTAmbHtrPs_C HEGO_uBattMinDHtrPs_C /end DEF_CHARACTERISTIC
 /begin REF_CHARACTERISTIC HEGO_flgS2B1Prsnt_C /end REF_CHARACTERISTIC
 /begin IN_MEASUREMENT BattU_u DevLib_stPwrStgEnaCond EnvT_t HEGO_bS2B1HtgEna HEGO_bS2B1HtgStrt SyC_stSub T15_st /end IN_MEASUREMENT
 /begin LOC_MEASUREMENT HEGO_DebTAmbHtrPsTONV_I.outbit HEGO_DebTAmbHtrPsTONV_I.time HEGO_flgDrvDsmEntryDIntPs HEGO_flgEnaDWeakPsCmn HEGO_flgPwrStgEnaCond HEGO_OBDHtrPsS2B1_I.bDHtrPsEna HEGO_OBDHtrPsS2B1_I.bFCMClrReqdCL100ms HEGO_OBDHtrPsS2B1_I.stErrInfo HEGO_OBDHtrPsS2B1_I.DHtrPsEnaTONV_I.outbit HEGO_OBDHtrPsS2B1_I.DHtrPsEnaTONV_I.time HEGO_OBDHtrPsS2B1_I.DebDHtrPsEnaFstTONV_I.outbit HEGO_OBDHtrPsS2B1_I.DebDHtrPsEnaFstTONV_I.time /end LOC_MEASUREMENT
 FUNCTION_VERSION "1.30.0" /end FUNCTION
/begin FUNCTION HEGO_Sens "1.53.1    Signal acquisition for binary oxygen sensors"
 /begin DEF_CHARACTERISTIC HEGO_stSens_CW HEGO_ctRiCalc_C HEGO_duRiAftFrz_C HEGO_duTCerChg_CUR HEGO_flgS2B1Prsnt_C HEGO_flgS2UTNom_CW HEGO_flgVltgBasSymc_C HEGO_flgVltgSymc_C HEGO_resRiNom_C HEGO_resRiTCer_CUR HEGO_resTCerRiMax_C HEGO_resTCerRiMin_C HEGO_rS2LamLinHiRes_CUR HEGO_SensS2B1_I.facRiCorr_M HEGO_SensS2B1_I.tiDebEnaRiVltg_C HEGO_SensS2B1_I.uRiLoLim_C HEGO_SensS2B1_I.uRiOORLim_C HEGO_SensS2B1_I.uRiUpLim_C HEGO_stSensHw_CW HEGO_tCerRi_CUR HEGO_tiDelLdPls_C HEGO_tiDelOpRdnRiPls_C HEGO_tiDelRiPls_C HEGO_tiPolarRedPls_C HEGO_tiS2FrzSigRiAcqn_C HEGO_tiSmotngSymc_C HEGO_uS2InvLamLinHiRes_CUR /end DEF_CHARACTERISTIC
 /begin REF_CHARACTERISTIC HEGO_numMinVoltMeasmtElecMax_C /end REF_CHARACTERISTIC
 /begin IN_MEASUREMENT EGSDU_flgS2B1AsymcFltEvln EGSDU_flgS2B1InhbRiEvln EGSDU_tiS2B1LtrDlySymcEvln EGSDU_tiS2B1LtrTranSymcEvln EGSDU_tiS2B1RtlDlySymcEvln EGSDU_tiS2B1RtlTranSymcEvln ExhMod_tExhS2B1 HEGO_bS2B1ErrElecHtrCpl HEGO_bS2B1ErrElecSigPrev HEGO_bS2B1ExptOpRdn HEGO_bS2B1HtgOn HEGO_bS2B1HtgRiReq HEGO_bS2B1LdPlsMinReq HEGO_bS2B1LdPlsSigCnfReq HEGO_bS2B1LdPlsSigReq HEGO_bS2B1OpRdnRiReq HEGO_flgLamEnaElecMaxS2B1 HEGO_flgS2B1InhbRiMeasmtElDiag SyC_ctPostDrvLeave /end IN_MEASUREMENT
 /begin OUT_MEASUREMENT HEGO_bS2B1FrzRi HEGO_bS2B1LdPlsRslt HEGO_bS2B1NewRi HEGO_bS2B1VldRi HEGO_flgNumVoltMeasmtElecMaxSuffS2B1 HEGO_numCalcRiS2B1 HEGO_numNewRiS2B1 HEGO_numTCerRiVldS2B1 HEGO_numVoltMeasmtElecMaxS2B1 HEGO_resS2B1Ri HEGO_resS2B1RiCorrd HEGO_resS2B1RiCorrdFild HEGO_resS2B1RiNoFlt HEGO_rS2B1Lam HEGO_rS2B1LamHiRes HEGO_tS2B1CerAct HEGO_tS2CerNom HEGO_uS2B1 HEGO_uS2B1Extd HEGO_uS2B1HiRes HEGO_uS2B1LamHiRes HEGO_uS2B1LdPls HEGO_uS2B1SymcHiRes HEGO_uS2B1Tstr HEGO_uS2B1WiH2HiRes HEGO_uS2B1WoDynSimHiRes HEGO_uVoltMeasmtFildElecMaxS2B1 /end OUT_MEASUREMENT
 /begin LOC_MEASUREMENT DelRiPlsT_I.timeCounter HEGO_bRiPlsReq HEGO_bS2B1RiPlsReq HEGO_facLamLinHiResS2 HEGO_flgExhS2B1AvlEF_I.buffer HEGO_flgExhS2B1AvlEF_I.oldSignal HEGO_flgFCMClrReqdSens_100ms HEGO_flgFCMClrReqdSens_10ms HEGO_idxSensRiPls HEGO_SensS2B1_ctReIni HEGO_SensS2B1_I.bCalcRi HEGO_SensS2B1_I.bDelOpRdnRiPls HEGO_SensS2B1_I.bEnaLdPls HEGO_SensS2B1_I.bEnaOpRdnRiPls HEGO_SensS2B1_I.bEnaRi HEGO_SensS2B1_I.bEnaRiFlt HEGO_SensS2B1_I.bEnaRiSens HEGO_SensS2B1_I.bFCMClrReqd100ms HEGO_SensS2B1_I.bFCMClrReqd1ms HEGO_SensS2B1_I.bFrzRi HEGO_SensS2B1_I.bFrzRiPrev HEGO_SensS2B1_I.bLdPlsEval HEGO_SensS2B1_I.bLdPlsFin HEGO_SensS2B1_I.bLdPlsRslt HEGO_SensS2B1_I.bNewRi HEGO_SensS2B1_I.bPlausRi HEGO_SensS2B1_I.bPolarRedPls HEGO_SensS2B1_I.bRiMeas HEGO_SensS2B1_I.bRiPls HEGO_SensS2B1_I.bRiTrg HEGO_SensS2B1_I.bVldRi HEGO_SensS2B1_I.ctLdPls HEGO_SensS2B1_I.flgCdnStMacTran02 HEGO_SensS2B1_I.flgCdnStMacTran12 HEGO_SensS2B1_I.flgInitVolt HEGO_SensS2B1_I.flgNewUSExtd HEGO_SensS2B1_I.flgNumVoltMeasmtElecMaxSuff HEGO_SensS2B1_I.numCalcRi HEGO_SensS2B1_I.numLdPlsMax HEGO_SensS2B1_I.numNewRi HEGO_SensS2B1_I.numVoltMeasmtElecMax HEGO_SensS2B1_I.resRi HEGO_SensS2B1_I.resRiCorrd HEGO_SensS2B1_I.resRiCorrdFild HEGO_SensS2B1_I.resRiCorrdPrev HEGO_SensS2B1_I.resRiNoFlt HEGO_SensS2B1_I.sm HEGO_SensS2B1_I.uLdPls HEGO_SensS2B1_I.uLdPlsDiff HEGO_SensS2B1_I.uRiAftFrz HEGO_SensS2B1_I.uRiWiLd HEGO_SensS2B1_I.uRiWoLd HEGO_SensS2B1_I.uSExtd HEGO_SensS2B1_I.uSExtdHeatrOff HEGO_SensS2B1_I.uVoltMeasmtFildElecMax HEGO_SensS2B1_I.DebEnaRiVltgTONV_I.outbit HEGO_SensS2B1_I.DebEnaRiVltgTONV_I.time HEGO_SensS2B1_I.DelLdPlsT_I.timeCounter HEGO_SensS2B1_I.DelOpRdnRiPlsT_I.timeCounter HEGO_SensS2B1_I.FrzRiT_I.timeCounter HEGO_SensS2B1_I.NewRiTR_I.timeCounter HEGO_SensS2B1_I.PolarRedPlsT_I.timeCounter HEGO_SensS2B1_I.RiCalcCTR_I.counter HEGO_SensS2B1_I.RiCorrdDL_I.memory HEGO_SensS2B1_I.RiDL_I.memory HEGO_SensS2B1_I.RiNoPlausCTR_I.counter HEGO_SensS2B1_I.RiPlsT_I.timeCounter HEGO_SensS2B1_I.bLdPlsSigCnfReqER_I.buffer HEGO_SensS2B1_I.bLdPlsSigCnfReqER_I.oldSignal HEGO_SensS2B1_I.bLdPlsSigReqER_I.buffer HEGO_SensS2B1_I.bLdPlsSigReqER_I.oldSignal HEGO_SensS2B1_I.flgHeatgOffTONV_I.outbit HEGO_SensS2B1_I.flgHeatgOffTONV_I.time HEGO_SensS2B1_I.uVoltMeasmtElecMaxDL_I.memory HEGO_SigCorS2B1_I.duDifT HEGO_SigCorS2B1_I.duSigCor HEGO_SigCorS2B1_I.numNewRiOld HEGO_SigCorS2B1_I.numTCerRiVld HEGO_SigCorS2B1_I.resRi HEGO_SigCorS2B1_I.resRiElec HEGO_SigCorS2B1_I.resRiWpDisp HEGO_SigCorS2B1_I.tCerAct HEGO_SigCorS2B1_I.tCerNom HEGO_SigCorS2B1_I.uNernst HEGO_SigCorS2B1_I.uNernstTCor HEGO_SigCorS2B1_I.uTNom HEGO_SigCorS2B1_I.uTNomCor HEGO_uLamHiResS2 HEGO_VltgSymcS2B1_I.flgLtrDly HEGO_VltgSymcS2B1_I.flgLtrSlow HEGO_VltgSymcS2B1_I.flgLtrTran HEGO_VltgSymcS2B1_I.flgRtlDly HEGO_VltgSymcS2B1_I.flgRtlSlow HEGO_VltgSymcS2B1_I.flgRtlTran HEGO_VltgSymcS2B1_I.flgSymcEna HEGO_VltgSymcS2B1_I.uSmotngOld HEGO_VltgSymcS2B1_I.uSymc HEGO_VltgSymcS2B1_I.uSymcTran HEGO_VltgSymcS2B1_I.flgSlowER_I.buffer HEGO_VltgSymcS2B1_I.flgSlowER_I.oldSignal HEGO_VltgSymcS2B1_I.flgSymcDlyEnaER_I.buffer HEGO_VltgSymcS2B1_I.flgSymcDlyEnaER_I.oldSignal HEGO_VltgSymcS2B1_I.flgSymcTranEnaER_I.buffer HEGO_VltgSymcS2B1_I.flgSymcTranEnaER_I.oldSignal HEGO_VltgSymcS2B1_I.uDlyDTTtOptSens_I.buffer HEGO_VltgSymcS2B1_I.uDlyDTTtOptSens_I.counter HEGO_VltgSymcS2B1_I.uDlyDTTtOptSens_I.pointer HEGO_VltgSymcS2B1_I.uSmotngLT_I.memory HEGO_VltgSymcS2B1_I.uTranLT_I.memory /end LOC_MEASUREMENT
 FUNCTION_VERSION "1.53.1" /end FUNCTION
/begin FUNCTION HESrv_Lib "7.3.0     High-End Service Library"
 /begin DEF_CHARACTERISTIC HESrv_numBnk_CA HESrv_stRmtInjVlv_CA HESrv_swtPOpVis_C HESrv_swtScndFlwActv_C /end DEF_CHARACTERISTIC
 FUNCTION_VERSION "7.3.0" /end FUNCTION
/begin FUNCTION HESrv_MacroDef "2.7.0     High-End Service Macro Definition" FUNCTION_VERSION "2.7.0" /end FUNCTION
/begin FUNCTION HESrv_MSid "9.2.0     High-End Master Slave Identification" /begin DEF_CHARACTERISTIC HESrv_swtMSidConf_C /end DEF_CHARACTERISTIC /begin OUT_MEASUREMENT HESrv_stMSid /end OUT_MEASUREMENT FUNCTION_VERSION "9.2.0" /end FUNCTION
/begin FUNCTION HESrv_RCVnsync "5.1.0     Copy process from redoubled messages to cylinderspezific calculation" FUNCTION_VERSION "5.1.0" /end FUNCTION
/begin COMPU_METHOD AirMassPerTime_float "" RAT_FUNC "%6.2" "Kg/h" COEFFS 0 1 0 0 0 1 /end COMPU_METHOD
/begin COMPU_METHOD B_TRUE "" TAB_VERB "%6.3" "" COMPU_TAB_REF B_TRUE /end COMPU_METHOD
/begin COMPU_VTAB B_TRUE "" TAB_VERB 2 0 "FALSE" 1 "TRUE" /end COMPU_VTAB
/begin COMPU_METHOD dez "" RAT_FUNC "%6.2" "" COEFFS 0 1 0 0 0 1 /end COMPU_METHOD
/begin COMPU_METHOD fak_q0p01 "" RAT_FUNC "%6.4" "" COEFFS 0 100 0 0 0 1 /end COMPU_METHOD
/begin COMPU_METHOD fak_q1p5259Em7 "" RAT_FUNC "%9.8" "" COEFFS 0 6553600 0 0 0 1 /end COMPU_METHOD
/begin COMPU_METHOD fak_q3p0518Em5 "" RAT_FUNC "%7.6" "" COEFFS 0 32768 0 0 0 1 /end COMPU_METHOD
/begin COMPU_METHOD fak_q3p906Em5 "" RAT_FUNC "%7.6" "-" COEFFS 0 25600 0 0 0 1 /end COMPU_METHOD
/begin COMPU_METHOD fak_uw_b2 "" RAT_FUNC "%7.6" "-" COEFFS 0 65536 0 0 0 2 /end COMPU_METHOD
/begin COMPU_METHOD fak_uw_b8 "" RAT_FUNC "%6.5" "-" COEFFS 0 65536 0 0 0 8 /end COMPU_METHOD
/begin COMPU_METHOD HEGO_OBDElecMin_CLS_sm_tab_verb "" TAB_VERB "%6.3" "" COMPU_TAB_REF HEGO_OBDElecMin_CLS_sm_tab_verb /end COMPU_METHOD
/begin COMPU_VTAB HEGO_OBDElecMin_CLS_sm_tab_verb "" TAB_VERB 4 0 "_0_start_min" 1 "_1_waiting_min" 2 "_2_request_3_load_pulses_min" 3 "_3_check_result_min" /end COMPU_VTAB
/begin COMPU_METHOD HEGO_OBDElecSig_CLS_sm_tab_verb "" TAB_VERB "%6.3" "" COMPU_TAB_REF HEGO_OBDElecSig_CLS_sm_tab_verb /end COMPU_METHOD
/begin COMPU_VTAB HEGO_OBDElecSig_CLS_sm_tab_verb "" TAB_VERB 5 0 "_0_start_sig" 1 "_1_waiting_sig" 2 "_2_request_load_pulse_sig" 3 "_3_check_result_sig" 4 "_4_request_3_load_pulses_sig" /end COMPU_VTAB
/begin COMPU_METHOD HEGO_Sens_CLS_sm_tab_verb "" TAB_VERB "%6.3" "" COMPU_TAB_REF HEGO_Sens_CLS_sm_tab_verb /end COMPU_METHOD
/begin COMPU_VTAB HEGO_Sens_CLS_sm_tab_verb "" TAB_VERB 3 0 "_0_measure_us" 1 "_1_pending" 2 "_2_ri_acquisition" /end COMPU_VTAB
/begin COMPU_METHOD HESrv_stMSid_t "" TAB_VERB "%6.3" "" COMPU_TAB_REF HESrv_stMSid_t /end COMPU_METHOD
/begin COMPU_VTAB HESrv_stMSid_t "" TAB_VERB 3 0 "Master" 1 "Slave" 255 "Standalone" /end COMPU_VTAB
/begin COMPU_METHOD HESrv_SwtPOpVis "" TAB_VERB "%6.3" "" COMPU_TAB_REF HESrv_SwtPOpVis /end COMPU_METHOD
/begin COMPU_VTAB HESrv_SwtPOpVis "" TAB_VERB 2 0 "Bank 1" 1 "Bank 2" /end COMPU_VTAB
/begin COMPU_METHOD i_q0p00039_A "" RAT_FUNC "%6.5" "A" COEFFS 0 65536 0 0 0 25 /end COMPU_METHOD
/begin COMPU_METHOD leist_q0p00244 "" RAT_FUNC "%6.4" "W" COEFFS 0 4096 0 0 0 10 /end COMPU_METHOD
/begin COMPU_METHOD m_q0p1 "" RAT_FUNC "%6.3" "kg/h" COEFFS 0 10 0 0 0 1 /end COMPU_METHOD
/begin COMPU_METHOD m_uw_b6553p5 "" RAT_FUNC "%6.3" "kg/h" COEFFS 0 1 0 0 0 0.1 /end COMPU_METHOD
/begin COMPU_METHOD NSC2B2_SC_Compu "" TAB_VERB "%6.3" "" COMPU_TAB_REF NSC2B2_SC_Compu /end COMPU_METHOD
/begin COMPU_VTAB NSC2B2_SC_Compu "" TAB_VERB 2 0 "False" 1 "True" /end COMPU_VTAB
/begin COMPU_METHOD NSCRgn_Time_S "" RAT_FUNC "%6.4" "s" COEFFS 0 100 0 0 0 1 /end COMPU_METHOD
/begin COMPU_METHOD NSC_ACTV_SY_Compu "" TAB_VERB "%6.3" "" COMPU_TAB_REF NSC_ACTV_SY_Compu /end COMPU_METHOD
/begin COMPU_VTAB NSC_ACTV_SY_Compu "" TAB_VERB 2 0 "False" 1 "True" /end COMPU_VTAB
/begin COMPU_METHOD NSC_CT_SENSORS_SY_Compu "" TAB_VERB "%6.3" "" COMPU_TAB_REF NSC_CT_SENSORS_SY_Compu /end COMPU_METHOD
/begin COMPU_VTAB NSC_CT_SENSORS_SY_Compu "" TAB_VERB 5 0 "ZERO" 1 "ONE" 2 "TWO" 3 "THREE" 4 "FOUR" /end COMPU_VTAB
/begin COMPU_METHOD NSC_NSCSCRCOUPL_SC_Compu "" TAB_VERB "%6.3" "" COMPU_TAB_REF NSC_NSCSCRCOUPL_SC_Compu /end COMPU_METHOD
/begin COMPU_VTAB NSC_NSCSCRCOUPL_SC_Compu "" TAB_VERB 2 0 "NSC_Only" 1 "NSC_SCR" /end COMPU_VTAB
/begin COMPU_METHOD NSEKP_SC_Compu "" RAT_FUNC "%6.2" "" COEFFS 0 1 0 0 0 1 /end COMPU_METHOD
/begin COMPU_METHOD NSODA_SC_Compu "" TAB_VERB "%6.3" "" COMPU_TAB_REF NSODA_SC_Compu /end COMPU_METHOD
/begin COMPU_VTAB NSODA_SC_Compu "" TAB_VERB 3 0 "NONE" 1 "STANDARD" 2 "EXTENDED" /end COMPU_VTAB
/begin COMPU_METHOD NSTEV_SC_Compu "" TAB_VERB "%6.3" "" COMPU_TAB_REF NSTEV_SC_Compu /end COMPU_METHOD
/begin COMPU_VTAB NSTEV_SC_Compu "" TAB_VERB 3 0 "0" 1 "1" 2 "2" /end COMPU_VTAB
/begin COMPU_METHOD NUMCYLACT_SY_Compu "" TAB_VERB "%6.3" "" COMPU_TAB_REF NUMCYLACT_SY_Compu /end COMPU_METHOD
/begin COMPU_VTAB NUMCYLACT_SY_Compu "" TAB_VERB 12 1 "ONE_CLYL" 2 "TWO_CYL" 3 "THREE_CYL" 4 "FOUR_CYL" 5 "FIVE_CYL" 6 "SIX_CYL" 7 "SEVEN_CYL" 8 "EIGHT_CYL" 10 "TEN_CYL" 12 "TWELVE_CYL" 16 "SIXTEEN_CYL" 24 "Twentyfour_CYL" /end COMPU_VTAB
/begin COMPU_METHOD NUMCYLCAL_SY_Compu "" TAB_VERB "%6.3" "" COMPU_TAB_REF NUMCYLCAL_SY_Compu /end COMPU_METHOD
/begin COMPU_VTAB NUMCYLCAL_SY_Compu "" TAB_VERB 2 0 "FIX" 1 "CAL" /end COMPU_VTAB
/begin COMPU_METHOD NUMCYLMAX_SY_Compu "" TAB_VERB "%6.3" "" COMPU_TAB_REF NUMCYLMAX_SY_Compu /end COMPU_METHOD
/begin COMPU_VTAB NUMCYLMAX_SY_Compu "" TAB_VERB 12 1 "ONE_CLYL" 2 "TWO_CYL" 3 "THREE_CYL" 4 "FOUR_CYL" 5 "FIVE_CYL" 6 "SIX_CYL" 7 "SEVEN_CYL" 8 "EIGHT_CYL" 10 "TEN_CYL" 12 "TWELVE_CYL" 16 "SIXTEEN_CYL" 24 "Twentyfour_CYL" /end COMPU_VTAB
/begin COMPU_METHOD NUMFANS_SY_Compu "" TAB_VERB "%6.3" "" COMPU_TAB_REF NUMFANS_SY_Compu /end COMPU_METHOD
/begin COMPU_VTAB NUMFANS_SY_Compu "" TAB_VERB 6 0 "0" 1 "1" 2 "2" 3 "3" 4 "4" 12 "12" /end COMPU_VTAB
/begin COMPU_METHOD NUMNTEAR_SY_Compu "" RAT_FUNC "%6.2" "" COEFFS 0 1 0 0 0 1 /end COMPU_METHOD
/begin COMPU_METHOD NUMPSICCHP_SY_Compu "" TAB_VERB "%6.3" "" COMPU_TAB_REF NUMPSICCHP_SY_Compu /end COMPU_METHOD
/begin COMPU_VTAB NUMPSICCHP_SY_Compu "" TAB_VERB 5 1 "1" 2 "2" 3 "3" 4 "4" 5 "5" /end COMPU_VTAB
/begin COMPU_METHOD NUMVEHVSENS_SY_Compu "" RAT_FUNC "%6.2" "" COEFFS 0 1 0 0 0 1 /end COMPU_METHOD
/begin COMPU_METHOD NUM_WAHT_SY_Compu "" RAT_FUNC "%6.2" "" COEFFS 0 1 0 0 0 1 /end COMPU_METHOD
/begin COMPU_METHOD NVLDTELL_SC_Compu "" TAB_VERB "%6.3" "" COMPU_TAB_REF NVLDTELL_SC_Compu /end COMPU_METHOD
/begin COMPU_VTAB NVLDTELL_SC_Compu "" TAB_VERB 2 0 "False" 1 "True" /end COMPU_VTAB
/begin COMPU_METHOD O2 "" RAT_FUNC "%8.7" "-" COEFFS 0 100000 0 0 0 1 /end COMPU_METHOD
/begin COMPU_METHOD O2MassPerTimeLo "" RAT_FUNC "%6.4" "Kg/h" COEFFS 0 50 0 0 0 1 /end COMPU_METHOD
/begin COMPU_METHOD OBD_PHYSMEDM_SY_Compu "" TAB_VERB "%6.3" "" COMPU_TAB_REF OBD_PHYSMEDM_SY_Compu /end COMPU_METHOD
/begin COMPU_VTAB OBD_PHYSMEDM_SY_Compu "" TAB_VERB 2 0 "OBD_PHYSMEDM_CAN" 1 "OBD_PHYSMEDM_KLINE" /end COMPU_VTAB
/begin COMPU_METHOD OBS_SY_Compu "" TAB_VERB "%6.3" "" COMPU_TAB_REF OBS_SY_Compu /end COMPU_METHOD
/begin COMPU_VTAB OBS_SY_Compu "" TAB_VERB 2 0 "NOOBS" 1 "SMP480" /end COMPU_VTAB
/begin COMPU_METHOD OFFSCRKPIST_SC_Compu "" TAB_VERB "%6.3" "" COMPU_TAB_REF OFFSCRKPIST_SC_Compu /end COMPU_METHOD
/begin COMPU_VTAB OFFSCRKPIST_SC_Compu "" TAB_VERB 2 0 "False" 1 "True" /end COMPU_VTAB
/begin COMPU_METHOD OILCMBDSEN_SWTCONN_SC_Compu "" TAB_VERB "%6.3" "" COMPU_TAB_REF OILCMBDSEN_SWTCONN_SC_Compu /end COMPU_METHOD
/begin COMPU_VTAB OILCMBDSEN_SWTCONN_SC_Compu "" TAB_VERB 5 0 "0" 1 "1" 2 "2" 3 "3" 255 "255" /end COMPU_VTAB
/begin COMPU_METHOD OILCOOLRDST_TYPAVL_SC_Compu "" TAB_VERB "%6.3" "" COMPU_TAB_REF OILCOOLRDST_TYPAVL_SC_Compu /end COMPU_METHOD
/begin COMPU_VTAB OILCOOLRDST_TYPAVL_SC_Compu "" TAB_VERB 2 0 "False" 1 "True" /end COMPU_VTAB
/begin COMPU_METHOD OILCYLHDT_SENSCFG_SC_Compu "" TAB_VERB "%6.3" "" COMPU_TAB_REF OILCYLHDT_SENSCFG_SC_Compu /end COMPU_METHOD
/begin COMPU_VTAB OILCYLHDT_SENSCFG_SC_Compu "" TAB_VERB 5 0 "No_Sens" 1 "ECU_ADC" 2 "CAN" 3 "SENT" 255 "Switch" /end COMPU_VTAB
/begin COMPU_METHOD OILFILT_COLDSTRTDIAG_SC_Compu "" TAB_VERB "%6.3" "" COMPU_TAB_REF OILFILT_COLDSTRTDIAG_SC_Compu /end COMPU_METHOD
/begin COMPU_VTAB OILFILT_COLDSTRTDIAG_SC_Compu "" TAB_VERB 2 0 "False" 1 "True" /end COMPU_VTAB
/begin COMPU_METHOD OILFILT_LOOSECNCTNCHK_SC_Compu "" TAB_VERB "%6.3" "" COMPU_TAB_REF OILFILT_LOOSECNCTNCHK_SC_Compu /end COMPU_METHOD
/begin COMPU_VTAB OILFILT_LOOSECNCTNCHK_SC_Compu "" TAB_VERB 2 0 "False" 1 "True" /end COMPU_VTAB
/begin COMPU_METHOD OILFILT_PRC_SC_Compu "" TAB_VERB "%6.3" "" COMPU_TAB_REF OILFILT_PRC_SC_Compu /end COMPU_METHOD
/begin COMPU_VTAB OILFILT_PRC_SC_Compu "" TAB_VERB 2 0 "False" 1 "True" /end COMPU_VTAB
/begin COMPU_METHOD OILFILT_SNSRTYP_SC_Compu "" TAB_VERB "%6.3" "" COMPU_TAB_REF OILFILT_SNSRTYP_SC_Compu /end COMPU_METHOD
/begin COMPU_VTAB OILFILT_SNSRTYP_SC_Compu "" TAB_VERB 4 0 "no OilFilT_Sensor" 1 "OilFilT_ADC" 2 "OilFilT_CmbdSenECU" 255 "Via_application_parameter" /end COMPU_VTAB
/begin COMPU_METHOD OneToOne "" RAT_FUNC "%6.2" "-" COEFFS 0 1 0 0 0 1 /end COMPU_METHOD
/begin COMPU_METHOD q0p00001_degC_DIV_W "" RAT_FUNC "%8.7" "degC/W" COEFFS 0 100000 0 0 0 1 /end COMPU_METHOD
/begin COMPU_METHOD q0p001_W_DIV_K "" RAT_FUNC "%6.5" "W/K" COEFFS 0 1000 0 0 0 1 /end COMPU_METHOD
/begin COMPU_METHOD q1p953125Em4_V_DIV_Ohm "" RAT_FUNC "%6.5" "V/Ohm" COEFFS 0 5120 0 0 0 1 /end COMPU_METHOD
/begin COMPU_METHOD q1p953125Em4_V_DIV_s_Ohm "" RAT_FUNC "%6.5" "V/(s*Ohm)" COEFFS 0 5120 0 0 0 1 /end COMPU_METHOD
/begin COMPU_METHOD q6p357Em6_V_DIV_K "" RAT_FUNC "%8.7" "V/K" COEFFS 0 786432 0 0 0 5 /end COMPU_METHOD
/begin COMPU_METHOD r_q0p00039_Ohm "" RAT_FUNC "%6.5" "Ohm" COEFFS 0 65536 0 0 0 25.6 /end COMPU_METHOD
/begin COMPU_METHOD r_q3p0518Em5 "" RAT_FUNC "%7.6" "Ohm" COEFFS 0 32768 0 0 0 1 /end COMPU_METHOD
/begin COMPU_METHOD r_uw_q2 "" RAT_FUNC "%6.2" "Ohm" COEFFS 0 1 0 0 0 2 /end COMPU_METHOD
/begin COMPU_METHOD spgg_q0p0039 "" RAT_FUNC "%6.4" "V/s" COEFFS 0 65536 0 0 0 256 /end COMPU_METHOD
/begin COMPU_METHOD spg_q0p00039 "" RAT_FUNC "%6.5" "V" COEFFS 0 1 0 0 0 0.000390625 /end COMPU_METHOD
/begin COMPU_METHOD spg_q0p00488 "" RAT_FUNC "%6.4" "V" COEFFS 0 1024 0 0 0 5 /end COMPU_METHOD
/begin COMPU_METHOD spg_q0p005 "" RAT_FUNC "%6.4" "V" COEFFS 0 1 0 0 0 0.005 /end COMPU_METHOD
/begin COMPU_METHOD spg_q0p1 "" RAT_FUNC "%6.3" "V" COEFFS 0 1 0 0 0 0.1 /end COMPU_METHOD
/begin COMPU_METHOD spg_q1p221Em3_V "" RAT_FUNC "%6.4" "V" COEFFS 0 65536 0 0 0 80 /end COMPU_METHOD
/begin COMPU_METHOD spg_q1p8626Em8_V "" RAT_FUNC "%10.9" "V" COEFFS 0 268435456 0 0 0 5 /end COMPU_METHOD
/begin COMPU_METHOD Temp_Cels "" RAT_FUNC "%6.1" "deg C" COEFFS 0 10 2731.4 0 0 1 /end COMPU_METHOD
/begin COMPU_METHOD temp_q0p0234 "" RAT_FUNC "%6.4" "K" COEFFS 0 256 0 0 0 6 /end COMPU_METHOD
/begin COMPU_METHOD temp_q0p0234_o273 "" RAT_FUNC "%6.1" "Grad C" COEFFS 0 1 273.15 0 0 0.0234375 /end COMPU_METHOD
/begin COMPU_METHOD temp_q0p0234_om273 "" RAT_FUNC "%6.1" "Grad C" COEFFS 0 640 174816 0 0 15 /end COMPU_METHOD
/begin COMPU_METHOD temp_q1p5259Em6_om273 "" RAT_FUNC "%6.1" "°C" COEFFS 0 65536 17900503.04 0 0 0.1 /end COMPU_METHOD
/begin COMPU_METHOD temp_q3p57Em7_om273 "" RAT_FUNC "%6.1" "Grad C" COEFFS 0 8388608 2291348275.2 0 0 3 /end COMPU_METHOD
/begin COMPU_METHOD temp_ub_q0p75_o48 "" RAT_FUNC "%6.2" "Grad C" COEFFS 0 1 48 0 0 0.75 /end COMPU_METHOD
/begin COMPU_METHOD Time_ms "" RAT_FUNC "%6.1" "ms" COEFFS 0 0.1 0 0 0 1 /end COMPU_METHOD
/begin COMPU_METHOD Time_s "" RAT_FUNC "%6.4" "s" COEFFS 0 100 0 0 0 1 /end COMPU_METHOD
/begin COMPU_METHOD t_q0p001 "" RAT_FUNC "%6.5" "s" COEFFS 0 1000 0 0 0 1 /end COMPU_METHOD
/begin COMPU_METHOD t_q0p01 "" RAT_FUNC "%6.4" "s" COEFFS 0 100 0 0 0 1 /end COMPU_METHOD
/begin COMPU_METHOD t_q0p1 "" RAT_FUNC "%6.3" "s" COEFFS 0 10 0 0 0 1 /end COMPU_METHOD
/begin COMPU_METHOD t_q1 "" RAT_FUNC "%6.2" "s" COEFFS 0 1 0 0 0 1 /end COMPU_METHOD
/begin COMPU_METHOD t_q1_ms "" RAT_FUNC "%6.2" "ms" COEFFS 0 1 0 0 0 1 /end COMPU_METHOD
/begin COMPU_METHOD Volt_Batt "" RAT_FUNC "%6.1" "mV" COEFFS 0 0.05 0 0 0 1 /end COMPU_METHOD
/begin COMPU_METHOD zk100msxs_uw_b6553p6 "" RAT_FUNC "%6.1" "s" COEFFS 0 0 65536 0 10 0 /end COMPU_METHOD
/begin RECORD_LAYOUT RB_Curve_R32_U16_Static NO_AXIS_PTS_X 1 ULONG AXIS_PTS_X 2 FLOAT32_IEEE INDEX_INCR DIRECT FNC_VALUES 3 UWORD COLUMN_DIR DIRECT STATIC_RECORD_LAYOUT /end RECORD_LAYOUT
/begin RECORD_LAYOUT RB_Curve_S16_U16_Static NO_AXIS_PTS_X 1 SWORD AXIS_PTS_X 2 SWORD INDEX_INCR DIRECT FNC_VALUES 3 UWORD COLUMN_DIR DIRECT STATIC_RECORD_LAYOUT /end RECORD_LAYOUT
/begin RECORD_LAYOUT RB_Curve_U16_S16_Static NO_AXIS_PTS_X 1 UWORD AXIS_PTS_X 2 UWORD INDEX_INCR DIRECT FNC_VALUES 3 SWORD COLUMN_DIR DIRECT STATIC_RECORD_LAYOUT /end RECORD_LAYOUT
/begin RECORD_LAYOUT RB_Curve_U16_U16 NO_AXIS_PTS_X 1 UWORD AXIS_PTS_X 2 UWORD INDEX_INCR DIRECT FNC_VALUES 3 UWORD COLUMN_DIR DIRECT /end RECORD_LAYOUT
/begin RECORD_LAYOUT RB_Map_U16S16_S16 NO_AXIS_PTS_X 1 UWORD NO_AXIS_PTS_Y 2 UWORD AXIS_PTS_X 3 UWORD INDEX_INCR DIRECT AXIS_PTS_Y 4 SWORD INDEX_INCR DIRECT FNC_VALUES 5 SWORD COLUMN_DIR DIRECT /end RECORD_LAYOUT
/begin RECORD_LAYOUT RB_Map_U16S16_U16 NO_AXIS_PTS_X 1 UWORD NO_AXIS_PTS_Y 2 UWORD AXIS_PTS_X 3 UWORD INDEX_INCR DIRECT AXIS_PTS_Y 4 SWORD INDEX_INCR DIRECT FNC_VALUES 5 UWORD COLUMN_DIR DIRECT /end RECORD_LAYOUT
/begin RECORD_LAYOUT RB_Map_U16U16_U16 NO_AXIS_PTS_X 1 UWORD NO_AXIS_PTS_Y 2 UWORD AXIS_PTS_X 3 UWORD INDEX_INCR DIRECT AXIS_PTS_Y 4 UWORD INDEX_INCR DIRECT FNC_VALUES 5 UWORD COLUMN_DIR DIRECT /end RECORD_LAYOUT
/begin RECORD_LAYOUT RB_Val_Ws16 FNC_VALUES 1 SWORD COLUMN_DIR DIRECT /end RECORD_LAYOUT
/begin RECORD_LAYOUT RB_Val_Wu16 FNC_VALUES 1 UWORD COLUMN_DIR DIRECT /end RECORD_LAYOUT
/begin RECORD_LAYOUT RB_Val_Wu32 FNC_VALUES 1 ULONG COLUMN_DIR DIRECT /end RECORD_LAYOUT
/begin RECORD_LAYOUT RB_Val_Wu8 FNC_VALUES 1 UBYTE COLUMN_DIR DIRECT /end RECORD_LAYOUT
/begin RECORD_LAYOUT ValA_Wu8 FNC_VALUES 1 UBYTE COLUMN_DIR DIRECT /end RECORD_LAYOUT
/begin RECORD_LAYOUT Val_Wu8 FNC_VALUES 1 UBYTE COLUMN_DIR DIRECT /end RECORD_LAYOUT
/end MODULE
/end PROJECT
