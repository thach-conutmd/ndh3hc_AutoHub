ASAP2_VERSION 1 60
/begin PROJECT MG1CA020 "MG1CA020"
/begin HEADER "" VERSION "MG1CA020_6SAY_V011_TPROT" PROJECT_NO MG1CA020 /end HEADER
/begin MODULE DIM ""
/begin MOD_COMMON "" BYTE_ORDER MSB_LAST ALIGNMENT_BYTE 1 ALIGNMENT_WORD 2 ALIGNMENT_LONG 4 ALIGNMENT_INT64 4 ALIGNMENT_FLOAT32_IEEE 4 ALIGNMENT_FLOAT64_IEEE 4 DATA_SIZE 32 /end MOD_COMMON
/begin MEASUREMENT DINH_nrActvInhReas.FId_ComPCUMon "Number of active inhibit reasons for the FIds / Number of active inhibit reasons for FId_ComPCUMon" UWORD DINH_ct_Compu 1 100 -4095.000 4096.000 BIT_MASK 0x1fff FORMAT "%8.3" ECU_ADDRESS 0x6000DD3E /end MEASUREMENT
/begin MEASUREMENT DINH_nrActvInhReas.FId_ComPosActnSpdLimrFctReq "Number of active inhibit reasons for the FIds / Number of active inhibit reasons for FId_ComPosActnSpdLimrFctReq" UWORD DINH_ct_Compu 1 100 -4095.000 4096.000 BIT_MASK 0x1fff FORMAT "%8.3" ECU_ADDRESS 0x6000DD40 /end MEASUREMENT
/begin MEASUREMENT DINH_nrActvInhReas.FId_ComSRS "Number of active inhibit reasons for the FIds / Number of active inhibit reasons for FId_ComSRS" UWORD DINH_ct_Compu 1 100 -4095.000 4096.000 BIT_MASK 0x1fff FORMAT "%8.3" ECU_ADDRESS 0x6000DD42 /end MEASUREMENT
/begin MEASUREMENT DINH_nrActvInhReas.FId_ComSRSA "Number of active inhibit reasons for the FIds / Number of active inhibit reasons for FId_ComSRSA" UWORD DINH_ct_Compu 1 100 -4095.000 4096.000 BIT_MASK 0x1fff FORMAT "%8.3" ECU_ADDRESS 0x6000DD44 /end MEASUREMENT
/begin MEASUREMENT DINH_nrActvInhReas.FId_ComSRSAMon "Number of active inhibit reasons for the FIds / Number of active inhibit reasons for FId_ComSRSAMon" UWORD DINH_ct_Compu 1 100 -4095.000 4096.000 BIT_MASK 0x1fff FORMAT "%8.3" ECU_ADDRESS 0x6000DD46 /end MEASUREMENT
/begin MEASUREMENT DINH_nrActvInhReas.FId_ComSRSB "Number of active inhibit reasons for the FIds / Number of active inhibit reasons for FId_ComSRSB" UWORD DINH_ct_Compu 1 100 -4095.000 4096.000 BIT_MASK 0x1fff FORMAT "%8.3" ECU_ADDRESS 0x6000DD48 /end MEASUREMENT
/begin MEASUREMENT DINH_nrActvInhReas.FId_ComSRSBMon "Number of active inhibit reasons for the FIds / Number of active inhibit reasons for FId_ComSRSBMon" UWORD DINH_ct_Compu 1 100 -4095.000 4096.000 BIT_MASK 0x1fff FORMAT "%8.3" ECU_ADDRESS 0x6000DD4A /end MEASUREMENT
/begin MEASUREMENT DINH_nrActvInhReas.FId_ComSRSMon "Number of active inhibit reasons for the FIds / Number of active inhibit reasons for FId_ComSRSMon" UWORD DINH_ct_Compu 1 100 -4095.000 4096.000 BIT_MASK 0x1fff FORMAT "%8.3" ECU_ADDRESS 0x6000DD4C /end MEASUREMENT
/begin MEASUREMENT DINH_nrActvInhReas.FId_ComSTFlt "Number of active inhibit reasons for the FIds / Number of active inhibit reasons for FId_ComSTFlt" UWORD DINH_ct_Compu 1 100 -4095.000 4096.000 BIT_MASK 0x1fff FORMAT "%8.3" ECU_ADDRESS 0x6000DD4E /end MEASUREMENT
/begin MEASUREMENT DINH_nrActvInhReas.FId_ComSpdLimrDevActvn "Number of active inhibit reasons for the FIds / Number of active inhibit reasons for FId_ComSpdLimrDevActvn" UWORD DINH_ct_Compu 1 100 -4095.000 4096.000 BIT_MASK 0x1fff FORMAT "%8.3" ECU_ADDRESS 0x6000DD50 /end MEASUREMENT
/begin MEASUREMENT DINH_nrActvInhReas.FId_ComTCU01 "Number of active inhibit reasons for the FIds / Number of active inhibit reasons for FId_ComTCU01" UWORD DINH_ct_Compu 1 100 -4095.000 4096.000 BIT_MASK 0x1fff FORMAT "%8.3" ECU_ADDRESS 0x6000DD52 /end MEASUREMENT
/begin MEASUREMENT DINH_nrActvInhReas.FId_ComTCU02 "Number of active inhibit reasons for the FIds / Number of active inhibit reasons for FId_ComTCU02" UWORD DINH_ct_Compu 1 100 -4095.000 4096.000 BIT_MASK 0x1fff FORMAT "%8.3" ECU_ADDRESS 0x6000DD54 /end MEASUREMENT
/begin MEASUREMENT DINH_nrActvInhReas.FId_ComTCU1 "Number of active inhibit reasons for the FIds / Number of active inhibit reasons for FId_ComTCU1" UWORD DINH_ct_Compu 1 100 -4095.000 4096.000 BIT_MASK 0x1fff FORMAT "%8.3" ECU_ADDRESS 0x6000DD56 /end MEASUREMENT
/begin MEASUREMENT DINH_nrActvInhReas.FId_ComTCU11 "Number of active inhibit reasons for the FIds / Number of active inhibit reasons for FId_ComTCU11" UWORD DINH_ct_Compu 1 100 -4095.000 4096.000 BIT_MASK 0x1fff FORMAT "%8.3" ECU_ADDRESS 0x6000DD58 /end MEASUREMENT
/begin MEASUREMENT DINH_nrActvInhReas.FId_ComTCU12 "Number of active inhibit reasons for the FIds / Number of active inhibit reasons for FId_ComTCU12" UWORD DINH_ct_Compu 1 100 -4095.000 4096.000 BIT_MASK 0x1fff FORMAT "%8.3" ECU_ADDRESS 0x6000DD5A /end MEASUREMENT
/begin MEASUREMENT DINH_nrActvInhReas.FId_ComTCU13 "Number of active inhibit reasons for the FIds / Number of active inhibit reasons for FId_ComTCU13" UWORD DINH_ct_Compu 1 100 -4095.000 4096.000 BIT_MASK 0x1fff FORMAT "%8.3" ECU_ADDRESS 0x6000DD5C /end MEASUREMENT
/begin MEASUREMENT DINH_nrActvInhReas.FId_ComTCU14 "Number of active inhibit reasons for the FIds / Number of active inhibit reasons for FId_ComTCU14" UWORD DINH_ct_Compu 1 100 -4095.000 4096.000 BIT_MASK 0x1fff FORMAT "%8.3" ECU_ADDRESS 0x6000DD5E /end MEASUREMENT
/begin MEASUREMENT DINH_nrActvInhReas.FId_ComTCU2 "Number of active inhibit reasons for the FIds / Number of active inhibit reasons for FId_ComTCU2" UWORD DINH_ct_Compu 1 100 -4095.000 4096.000 BIT_MASK 0x1fff FORMAT "%8.3" ECU_ADDRESS 0x6000DD60 /end MEASUREMENT
/begin MEASUREMENT DINH_nrActvInhReas.FId_ComTCU3 "Number of active inhibit reasons for the FIds / Number of active inhibit reasons for FId_ComTCU3" UWORD DINH_ct_Compu 1 100 -4095.000 4096.000 BIT_MASK 0x1fff FORMAT "%8.3" ECU_ADDRESS 0x6000DD62 /end MEASUREMENT
/begin MEASUREMENT DINH_nrActvInhReas.FId_ComTCU4 "Number of active inhibit reasons for the FIds / Number of active inhibit reasons for FId_ComTCU4" UWORD DINH_ct_Compu 1 100 -4095.000 4096.000 BIT_MASK 0x1fff FORMAT "%8.3" ECU_ADDRESS 0x6000DD64 /end MEASUREMENT
/begin MEASUREMENT DINH_nrActvInhReas.FId_ComTCUGear "Number of active inhibit reasons for the FIds / Number of active inhibit reasons for FId_ComTCUGear" UWORD DINH_ct_Compu 1 100 -4095.000 4096.000 BIT_MASK 0x1fff FORMAT "%8.3" ECU_ADDRESS 0x6000DD66 /end MEASUREMENT
/begin MEASUREMENT DINH_nrActvInhReas.FId_ComTarGearDwnShift "Number of active inhibit reasons for the FIds / Number of active inhibit reasons for FId_ComTarGearDwnShift" UWORD DINH_ct_Compu 1 100 -4095.000 4096.000 BIT_MASK 0x1fff FORMAT "%8.3" ECU_ADDRESS 0x6000DD68 /end MEASUREMENT
/begin MEASUREMENT DINH_nrActvInhReas.FId_ComTarGearUpShift "Number of active inhibit reasons for the FIds / Number of active inhibit reasons for FId_ComTarGearUpShift" UWORD DINH_ct_Compu 1 100 -4095.000 4096.000 BIT_MASK 0x1fff FORMAT "%8.3" ECU_ADDRESS 0x6000DD6A /end MEASUREMENT
/begin MEASUREMENT DINH_nrActvInhReas.FId_ComThrPosnFail "Number of active inhibit reasons for the FIds / Number of active inhibit reasons for FId_ComThrPosnFail" UWORD DINH_ct_Compu 1 100 -4095.000 4096.000 BIT_MASK 0x1fff FORMAT "%8.3" ECU_ADDRESS 0x6000DD6C /end MEASUREMENT
/begin MEASUREMENT DINH_nrActvInhReas.FId_ComThrVlv "Number of active inhibit reasons for the FIds / Number of active inhibit reasons for FId_ComThrVlv" UWORD DINH_ct_Compu 1 100 -4095.000 4096.000 BIT_MASK 0x1fff FORMAT "%8.3" ECU_ADDRESS 0x6000DD6E /end MEASUREMENT
/begin MEASUREMENT DINH_nrActvInhReas.FId_ComTrboChrgnErr "Number of active inhibit reasons for the FIds / Number of active inhibit reasons for FId_ComTrboChrgnErr" UWORD DINH_ct_Compu 1 100 -4095.000 4096.000 BIT_MASK 0x1fff FORMAT "%8.3" ECU_ADDRESS 0x6000DD70 /end MEASUREMENT
/begin MEASUREMENT DINH_nrActvInhReas.FId_ComTrqAccuracySlow "Number of active inhibit reasons for the FIds / Number of active inhibit reasons for FId_ComTrqAccuracySlow" UWORD DINH_ct_Compu 1 100 -4095.000 4096.000 BIT_MASK 0x1fff FORMAT "%8.3" ECU_ADDRESS 0x6000DD72 /end MEASUREMENT
/begin MEASUREMENT DINH_nrActvInhReas.FId_ComTrqReqFast "Number of active inhibit reasons for the FIds / Number of active inhibit reasons for FId_ComTrqReqFast" UWORD DINH_ct_Compu 1 100 -4095.000 4096.000 BIT_MASK 0x1fff FORMAT "%8.3" ECU_ADDRESS 0x6000DD74 /end MEASUREMENT
/begin MEASUREMENT DINH_nrActvInhReas.FId_ComTrqReqSlow "Number of active inhibit reasons for the FIds / Number of active inhibit reasons for FId_ComTrqReqSlow" UWORD DINH_ct_Compu 1 100 -4095.000 4096.000 BIT_MASK 0x1fff FORMAT "%8.3" ECU_ADDRESS 0x6000DD76 /end MEASUREMENT
/begin MEASUREMENT DINH_nrActvInhReas.FId_ComVSAErr "Number of active inhibit reasons for the FIds / Number of active inhibit reasons for FId_ComVSAErr" UWORD DINH_ct_Compu 1 100 -4095.000 4096.000 BIT_MASK 0x1fff FORMAT "%8.3" ECU_ADDRESS 0x6000DD78 /end MEASUREMENT
/begin MEASUREMENT DINH_nrActvInhReas.FId_ComVehSpdFltChk "Number of active inhibit reasons for the FIds / Number of active inhibit reasons for FId_ComVehSpdFltChk" UWORD DINH_ct_Compu 1 100 -4095.000 4096.000 BIT_MASK 0x1fff FORMAT "%8.3" ECU_ADDRESS 0x6000DD7A /end MEASUREMENT
/begin MEASUREMENT DINH_nrActvInhReas.FId_ComVehSpdImpsErr "Number of active inhibit reasons for the FIds / Number of active inhibit reasons for FId_ComVehSpdImpsErr" UWORD DINH_ct_Compu 1 100 -4095.000 4096.000 BIT_MASK 0x1fff FORMAT "%8.3" ECU_ADDRESS 0x6000DD7C /end MEASUREMENT
/begin MEASUREMENT DINH_nrActvInhReas.FId_ComVlvLftCtrl "Number of active inhibit reasons for the FIds / Number of active inhibit reasons for FId_ComVlvLftCtrl" UWORD DINH_ct_Compu 1 100 -4095.000 4096.000 BIT_MASK 0x1fff FORMAT "%8.3" ECU_ADDRESS 0x6000DD7E /end MEASUREMENT
/begin MEASUREMENT DINH_nrActvInhReas.FId_ComvolEng "Number of active inhibit reasons for the FIds / Number of active inhibit reasons for FId_ComvolEng" UWORD DINH_ct_Compu 1 100 -4095.000 4096.000 BIT_MASK 0x1fff FORMAT "%8.3" ECU_ADDRESS 0x6000DD80 /end MEASUREMENT
/begin MEASUREMENT DINH_nrActvInhReas.FId_ConvLdCalcLvrPos "Number of active inhibit reasons for the FIds / Number of active inhibit reasons for FId_ConvLdCalcLvrPos" UWORD DINH_ct_Compu 1 100 -4095.000 4096.000 BIT_MASK 0x1fff FORMAT "%8.3" ECU_ADDRESS 0x6000DD82 /end MEASUREMENT
/begin MEASUREMENT DINH_nrActvInhReas.FId_ConvLdNTrbnCan "Number of active inhibit reasons for the FIds / Number of active inhibit reasons for FId_ConvLdNTrbnCan" UWORD DINH_ct_Compu 1 100 -4095.000 4096.000 BIT_MASK 0x1fff FORMAT "%8.3" ECU_ADDRESS 0x6000DD84 /end MEASUREMENT
/begin MEASUREMENT DINH_nrActvInhReas.FId_ConvLdOilCoolrPmp "Number of active inhibit reasons for the FIds / Number of active inhibit reasons for FId_ConvLdOilCoolrPmp" UWORD DINH_ct_Compu 1 100 -4095.000 4096.000 BIT_MASK 0x1fff FORMAT "%8.3" ECU_ADDRESS 0x6000DD86 /end MEASUREMENT
/begin MEASUREMENT DINH_nrActvInhReas.FId_ConvLdOilTemp "Number of active inhibit reasons for the FIds / Number of active inhibit reasons for FId_ConvLdOilTemp" UWORD DINH_ct_Compu 1 100 -4095.000 4096.000 BIT_MASK 0x1fff FORMAT "%8.3" ECU_ADDRESS 0x6000DD88 /end MEASUREMENT
/begin MEASUREMENT DINH_nrActvInhReas.FId_ConvLdTrqLdCan "Number of active inhibit reasons for the FIds / Number of active inhibit reasons for FId_ConvLdTrqLdCan" UWORD DINH_ct_Compu 1 100 -4095.000 4096.000 BIT_MASK 0x1fff FORMAT "%8.3" ECU_ADDRESS 0x6000DD8A /end MEASUREMENT
/begin MEASUREMENT DINH_nrActvInhReas.FId_ConvLdVel "Number of active inhibit reasons for the FIds / Number of active inhibit reasons for FId_ConvLdVel" UWORD DINH_ct_Compu 1 100 -4095.000 4096.000 BIT_MASK 0x1fff FORMAT "%8.3" ECU_ADDRESS 0x6000DD8C /end MEASUREMENT
/begin MEASUREMENT DINH_nrActvInhReas.FId_CptProtnExhTempMdl "Number of active inhibit reasons for the FIds / Number of active inhibit reasons for FId_CptProtnExhTempMdl" UWORD DINH_ct_Compu 1 100 -4095.000 4096.000 BIT_MASK 0x1fff FORMAT "%8.3" ECU_ADDRESS 0x6000DD8E /end MEASUREMENT
/begin MEASUREMENT DINH_nrActvInhReas.FId_CptProtnO2SnsrB1 "Number of active inhibit reasons for the FIds / Number of active inhibit reasons for FId_CptProtnO2SnsrB1" UWORD DINH_ct_Compu 1 100 -4095.000 4096.000 BIT_MASK 0x1fff FORMAT "%8.3" ECU_ADDRESS 0x6000DD90 /end MEASUREMENT
/begin MEASUREMENT DINH_nrActvInhReas.FId_CptProtnVVeh "Number of active inhibit reasons for the FIds / Number of active inhibit reasons for FId_CptProtnVVeh" UWORD DINH_ct_Compu 1 100 -4095.000 4096.000 BIT_MASK 0x1fff FORMAT "%8.3" ECU_ADDRESS 0x6000DD92 /end MEASUREMENT
/begin MEASUREMENT DINH_nrActvInhReas.FId_CrCUI1EFRxErr "Number of active inhibit reasons for the FIds / Number of active inhibit reasons for FId_CrCUI1EFRxErr" UWORD DINH_ct_Compu 1 100 -4095.000 4096.000 BIT_MASK 0x1fff FORMAT "%8.3" ECU_ADDRESS 0x6000DD94 /end MEASUREMENT
/begin MEASUREMENT DINH_nrActvInhReas.FId_CrCUICANRxErr "Number of active inhibit reasons for the FIds / Number of active inhibit reasons for FId_CrCUICANRxErr" UWORD DINH_ct_Compu 1 100 -4095.000 4096.000 BIT_MASK 0x1fff FORMAT "%8.3" ECU_ADDRESS 0x6000DD96 /end MEASUREMENT
/begin MEASUREMENT DINH_nrActvInhReas.FId_CrCUIFCMRxErr "Number of active inhibit reasons for the FIds / Number of active inhibit reasons for FId_CrCUIFCMRxErr" UWORD DINH_ct_Compu 1 100 -4095.000 4096.000 BIT_MASK 0x1fff FORMAT "%8.3" ECU_ADDRESS 0x6000DD98 /end MEASUREMENT
/begin MEASUREMENT DINH_nrActvInhReas.FId_CrCUIMETDRxErr "Number of active inhibit reasons for the FIds / Number of active inhibit reasons for FId_CrCUIMETDRxErr" UWORD DINH_ct_Compu 1 100 -4095.000 4096.000 BIT_MASK 0x1fff FORMAT "%8.3" ECU_ADDRESS 0x6000DD9A /end MEASUREMENT
/begin MEASUREMENT DINH_nrActvInhReas.FId_CrCtlACCRxErr "Number of active inhibit reasons for the FIds / Number of active inhibit reasons for FId_CrCtlACCRxErr" UWORD DINH_ct_Compu 1 100 -4095.000 4096.000 BIT_MASK 0x1fff FORMAT "%8.3" ECU_ADDRESS 0x6000DD9C /end MEASUREMENT
/begin MEASUREMENT DINH_nrActvInhReas.FId_CrCtlAppSnsrErr "Number of active inhibit reasons for the FIds / Number of active inhibit reasons for FId_CrCtlAppSnsrErr" UWORD DINH_ct_Compu 1 100 -4095.000 4096.000 BIT_MASK 0x1fff FORMAT "%8.3" ECU_ADDRESS 0x6000DD9E /end MEASUREMENT
/begin MEASUREMENT DINH_nrActvInhReas.FId_CrCtlShutOffEng "Number of active inhibit reasons for the FIds / Number of active inhibit reasons for FId_CrCtlShutOffEng" UWORD DINH_ct_Compu 1 100 -4095.000 4096.000 BIT_MASK 0x1fff FORMAT "%8.3" ECU_ADDRESS 0x6000DDA0 /end MEASUREMENT
/begin MEASUREMENT DINH_nrActvInhReas.FId_DIUMPRCldStrtMon "Number of active inhibit reasons for the FIds / Number of active inhibit reasons for FId_DIUMPRCldStrtMon" UWORD DINH_ct_Compu 1 100 -4095.000 4096.000 BIT_MASK 0x1fff FORMAT "%8.3" ECU_ADDRESS 0x6000DDA2 /end MEASUREMENT
/begin MEASUREMENT DINH_nrActvInhReas.FId_DIUMPRGenDenom1 "Number of active inhibit reasons for the FIds / Number of active inhibit reasons for FId_DIUMPRGenDenom1" UWORD DINH_ct_Compu 1 100 -4095.000 4096.000 BIT_MASK 0x1fff FORMAT "%8.3" ECU_ADDRESS 0x6000DDA4 /end MEASUREMENT
/begin MEASUREMENT DINH_nrActvInhReas.FId_DIUMPRGenDenom2 "Number of active inhibit reasons for the FIds / Number of active inhibit reasons for FId_DIUMPRGenDenom2" UWORD DINH_ct_Compu 1 100 -4095.000 4096.000 BIT_MASK 0x1fff FORMAT "%8.3" ECU_ADDRESS 0x6000DDA6 /end MEASUREMENT
/begin MEASUREMENT DINH_nrActvInhReas.FId_DIUMPRGenDenom3 "Number of active inhibit reasons for the FIds / Number of active inhibit reasons for FId_DIUMPRGenDenom3" UWORD DINH_ct_Compu 1 100 -4095.000 4096.000 BIT_MASK 0x1fff FORMAT "%8.3" ECU_ADDRESS 0x6000DDA8 /end MEASUREMENT
/begin MEASUREMENT DINH_nrActvInhReas.FId_DIUMPRIgn "Number of active inhibit reasons for the FIds / Number of active inhibit reasons for FId_DIUMPRIgn" UWORD DINH_ct_Compu 1 100 -4095.000 4096.000 BIT_MASK 0x1fff FORMAT "%8.3" ECU_ADDRESS 0x6000DDAA /end MEASUREMENT
/begin MEASUREMENT DINH_nrActvInhReas.FId_DOGov "Number of active inhibit reasons for the FIds / Number of active inhibit reasons for FId_DOGov" UWORD DINH_ct_Compu 1 100 -4095.000 4096.000 BIT_MASK 0x1fff FORMAT "%8.3" ECU_ADDRESS 0x6000DDAC /end MEASUREMENT
/begin MEASUREMENT DINH_nrActvInhReas.FId_DSMWarmUpCycle "Number of active inhibit reasons for the FIds / Number of active inhibit reasons for FId_DSMWarmUpCycle" UWORD DINH_ct_Compu 1 100 -4095.000 4096.000 BIT_MASK 0x1fff FORMAT "%8.3" ECU_ADDRESS 0x6000DDAE /end MEASUREMENT
/begin MEASUREMENT DINH_nrActvInhReas.FId_DewDetTKAMax "Number of active inhibit reasons for the FIds / Number of active inhibit reasons for FId_DewDetTKAMax" UWORD DINH_ct_Compu 1 100 -4095.000 4096.000 BIT_MASK 0x1fff FORMAT "%8.3" ECU_ADDRESS 0x6000DDB0 /end MEASUREMENT
/begin MEASUREMENT DINH_nrActvInhReas.FId_DkrsaEpmNoSig "Number of active inhibit reasons for the FIds / Number of active inhibit reasons for FId_DkrsaEpmNoSig" UWORD DINH_ct_Compu 1 100 -4095.000 4096.000 BIT_MASK 0x1fff FORMAT "%8.3" ECU_ADDRESS 0x6000DDB2 /end MEASUREMENT
/begin MEASUREMENT DINH_nrActvInhReas.FId_EBBCANErrFrzVal "Number of active inhibit reasons for the FIds / Number of active inhibit reasons for FId_EBBCANErrFrzVal" UWORD DINH_ct_Compu 1 100 -4095.000 4096.000 BIT_MASK 0x1fff FORMAT "%8.3" ECU_ADDRESS 0x6000DDB4 /end MEASUREMENT
/begin MEASUREMENT DINH_nrActvInhReas.FId_EBBCANErrReplVal "Number of active inhibit reasons for the FIds / Number of active inhibit reasons for FId_EBBCANErrReplVal" UWORD DINH_ct_Compu 1 100 -4095.000 4096.000 BIT_MASK 0x1fff FORMAT "%8.3" ECU_ADDRESS 0x6000DDB6 /end MEASUREMENT
/begin MEASUREMENT DINH_nrActvInhReas.FId_EGLZSR "Number of active inhibit reasons for the FIds / Number of active inhibit reasons for FId_EGLZSR" UWORD DINH_ct_Compu 1 100 -4095.000 4096.000 BIT_MASK 0x1fff FORMAT "%8.3" ECU_ADDRESS 0x6000DDB8 /end MEASUREMENT
/begin MEASUREMENT DINH_nrActvInhReas.FId_EGSDO2OffsRstDsmS1B1 "Number of active inhibit reasons for the FIds / Number of active inhibit reasons for FId_EGSDO2OffsRstDsmS1B1" UWORD DINH_ct_Compu 1 100 -4095.000 4096.000 BIT_MASK 0x1fff FORMAT "%8.3" ECU_ADDRESS 0x6000DDBA /end MEASUREMENT
/begin MEASUREMENT DINH_nrActvInhReas.FId_EGSDO2_LamOffsSlowS1 "Number of active inhibit reasons for the FIds / Number of active inhibit reasons for FId_EGSDO2_LamOffsSlowS1" UWORD DINH_ct_Compu 1 100 -4095.000 4096.000 BIT_MASK 0x1fff FORMAT "%8.3" ECU_ADDRESS 0x6000DDBC /end MEASUREMENT
/begin MEASUREMENT DINH_nrActvInhReas.FId_EGSDUS2B1LtrDly "Number of active inhibit reasons for the FIds / Number of active inhibit reasons for FId_EGSDUS2B1LtrDly" UWORD DINH_ct_Compu 1 100 -4095.000 4096.000 BIT_MASK 0x1fff FORMAT "%8.3" ECU_ADDRESS 0x6000DDBE /end MEASUREMENT
/begin MEASUREMENT DINH_nrActvInhReas.FId_EGSDUS2B1LtrPT1 "Number of active inhibit reasons for the FIds / Number of active inhibit reasons for FId_EGSDUS2B1LtrPT1" UWORD DINH_ct_Compu 1 100 -4095.000 4096.000 BIT_MASK 0x1fff FORMAT "%8.3" ECU_ADDRESS 0x6000DDC0 /end MEASUREMENT
/begin MEASUREMENT DINH_nrActvInhReas.FId_EGSDUS2B1RtlDly "Number of active inhibit reasons for the FIds / Number of active inhibit reasons for FId_EGSDUS2B1RtlDly" UWORD DINH_ct_Compu 1 100 -4095.000 4096.000 BIT_MASK 0x1fff FORMAT "%8.3" ECU_ADDRESS 0x6000DDC2 /end MEASUREMENT
/begin MEASUREMENT DINH_nrActvInhReas.FId_EGSDUS2B1RtlPT1 "Number of active inhibit reasons for the FIds / Number of active inhibit reasons for FId_EGSDUS2B1RtlPT1" UWORD DINH_ct_Compu 1 100 -4095.000 4096.000 BIT_MASK 0x1fff FORMAT "%8.3" ECU_ADDRESS 0x6000DDC4 /end MEASUREMENT
/begin MEASUREMENT DINH_nrActvInhReas.FId_EGSDUS2B1TarEvln "Number of active inhibit reasons for the FIds / Number of active inhibit reasons for FId_EGSDUS2B1TarEvln" UWORD DINH_ct_Compu 1 100 -4095.000 4096.000 BIT_MASK 0x1fff FORMAT "%8.3" ECU_ADDRESS 0x6000DDC6 /end MEASUREMENT
/begin MEASUREMENT DINH_nrActvInhReas.FId_EGSDUS2B1TarLean "Number of active inhibit reasons for the FIds / Number of active inhibit reasons for FId_EGSDUS2B1TarLean" UWORD DINH_ct_Compu 1 100 -4095.000 4096.000 BIT_MASK 0x1fff FORMAT "%8.3" ECU_ADDRESS 0x6000DDC8 /end MEASUREMENT
/begin MEASUREMENT DINH_nrActvInhReas.FId_EGSDUS2B1TarRich "Number of active inhibit reasons for the FIds / Number of active inhibit reasons for FId_EGSDUS2B1TarRich" UWORD DINH_ct_Compu 1 100 -4095.000 4096.000 BIT_MASK 0x1fff FORMAT "%8.3" ECU_ADDRESS 0x6000DDCA /end MEASUREMENT
/begin MEASUREMENT DINH_nrActvInhReas.FId_ELZSR "Number of active inhibit reasons for the FIds / Number of active inhibit reasons for FId_ELZSR" UWORD DINH_ct_Compu 1 100 -4095.000 4096.000 BIT_MASK 0x1fff FORMAT "%8.3" ECU_ADDRESS 0x6000DDCC /end MEASUREMENT
/begin MEASUREMENT DINH_nrActvInhReas.FId_EPBErr "Number of active inhibit reasons for the FIds / Number of active inhibit reasons for FId_EPBErr" UWORD DINH_ct_Compu 1 100 -4095.000 4096.000 BIT_MASK 0x1fff FORMAT "%8.3" ECU_ADDRESS 0x6000DDCE /end MEASUREMENT
/begin MEASUREMENT DINH_nrActvInhReas.FId_EPBFrmErr "Number of active inhibit reasons for the FIds / Number of active inhibit reasons for FId_EPBFrmErr" UWORD DINH_ct_Compu 1 100 -4095.000 4096.000 BIT_MASK 0x1fff FORMAT "%8.3" ECU_ADDRESS 0x6000DDD0 /end MEASUREMENT
/begin MEASUREMENT DINH_nrActvInhReas.FId_EPBFrmErrClth "Number of active inhibit reasons for the FIds / Number of active inhibit reasons for FId_EPBFrmErrClth" UWORD DINH_ct_Compu 1 100 -4095.000 4096.000 BIT_MASK 0x1fff FORMAT "%8.3" ECU_ADDRESS 0x6000DDD2 /end MEASUREMENT
/begin MEASUREMENT DINH_nrActvInhReas.FId_EVPComFailr "Number of active inhibit reasons for the FIds / Number of active inhibit reasons for FId_EVPComFailr" UWORD DINH_ct_Compu 1 100 -4095.000 4096.000 BIT_MASK 0x1fff FORMAT "%8.3" ECU_ADDRESS 0x6000DDD4 /end MEASUREMENT
/begin MEASUREMENT DINH_nrActvInhReas.FId_EbsLinErr "Number of active inhibit reasons for the FIds / Number of active inhibit reasons for FId_EbsLinErr" UWORD DINH_ct_Compu 1 100 -4095.000 4096.000 BIT_MASK 0x1fff FORMAT "%8.3" ECU_ADDRESS 0x6000DDD6 /end MEASUREMENT
/begin MEASUREMENT DINH_nrActvInhReas.FId_EepReadWrState "Number of active inhibit reasons for the FIds / Number of active inhibit reasons for FId_EepReadWrState" UWORD DINH_ct_Compu 1 100 -4095.000 4096.000 BIT_MASK 0x1fff FORMAT "%8.3" ECU_ADDRESS 0x6000DDD8 /end MEASUREMENT
/begin MEASUREMENT DINH_nrActvInhReas.FId_ElecLdComErr "Number of active inhibit reasons for the FIds / Number of active inhibit reasons for FId_ElecLdComErr" UWORD DINH_ct_Compu 1 100 -4095.000 4096.000 BIT_MASK 0x1fff FORMAT "%8.3" ECU_ADDRESS 0x6000DDDA /end MEASUREMENT
/begin MEASUREMENT DINH_nrActvInhReas.FId_ElecLdFrzVal "Number of active inhibit reasons for the FIds / Number of active inhibit reasons for FId_ElecLdFrzVal" UWORD DINH_ct_Compu 1 100 -4095.000 4096.000 BIT_MASK 0x1fff FORMAT "%8.3" ECU_ADDRESS 0x6000DDDC /end MEASUREMENT
/begin MEASUREMENT DINH_nrActvInhReas.FId_ElecLdHdLiComErr "Number of active inhibit reasons for the FIds / Number of active inhibit reasons for FId_ElecLdHdLiComErr" UWORD DINH_ct_Compu 1 100 -4095.000 4096.000 BIT_MASK 0x1fff FORMAT "%8.3" ECU_ADDRESS 0x6000DDDE /end MEASUREMENT
/begin MEASUREMENT DINH_nrActvInhReas.FId_ElecLdRplVal "Number of active inhibit reasons for the FIds / Number of active inhibit reasons for FId_ElecLdRplVal" UWORD DINH_ct_Compu 1 100 -4095.000 4096.000 BIT_MASK 0x1fff FORMAT "%8.3" ECU_ADDRESS 0x6000DDE0 /end MEASUREMENT
/begin MEASUREMENT DINH_nrActvInhReas.FId_ElecLoadEPSComErr "Number of active inhibit reasons for the FIds / Number of active inhibit reasons for FId_ElecLoadEPSComErr" UWORD DINH_ct_Compu 1 100 -4095.000 4096.000 BIT_MASK 0x1fff FORMAT "%8.3" ECU_ADDRESS 0x6000DDE2 /end MEASUREMENT
/begin MEASUREMENT DINH_nrActvInhReas.FId_EngBlkTWrn "Number of active inhibit reasons for the FIds / Number of active inhibit reasons for FId_EngBlkTWrn" UWORD DINH_ct_Compu 1 100 -4095.000 4096.000 BIT_MASK 0x1fff FORMAT "%8.3" ECU_ADDRESS 0x6000DDE4 /end MEASUREMENT
/begin MEASUREMENT DINH_nrActvInhReas.FId_EngCooltTFail "Number of active inhibit reasons for the FIds / Number of active inhibit reasons for FId_EngCooltTFail" UWORD DINH_ct_Compu 1 100 -4095.000 4096.000 BIT_MASK 0x1fff FORMAT "%8.3" ECU_ADDRESS 0x6000DDE6 /end MEASUREMENT
/begin MEASUREMENT DINH_nrActvInhReas.FId_EngDemTqLimnCamsftErr "Number of active inhibit reasons for the FIds / Number of active inhibit reasons for FId_EngDemTqLimnCamsftErr" UWORD DINH_ct_Compu 1 100 -4095.000 4096.000 BIT_MASK 0x1fff FORMAT "%8.3" ECU_ADDRESS 0x6000DDE8 /end MEASUREMENT
/begin MEASUREMENT DINH_nrActvInhReas.FId_EngDemTqLimnErrThmstHeatCtrlCirc "Number of active inhibit reasons for the FIds / Number of active inhibit reasons for FId_EngDemTqLimnErrThmstHeatCtrlCirc" UWORD DINH_ct_Compu 1 100 -4095.000 4096.000 BIT_MASK 0x1fff FORMAT "%8.3" ECU_ADDRESS 0x6000DDEA /end MEASUREMENT
/begin MEASUREMENT DINH_nrActvInhReas.FId_EngDemTqLimnOilPmp "Number of active inhibit reasons for the FIds / Number of active inhibit reasons for FId_EngDemTqLimnOilPmp" UWORD DINH_ct_Compu 1 100 -4095.000 4096.000 BIT_MASK 0x1fff FORMAT "%8.3" ECU_ADDRESS 0x6000DDEC /end MEASUREMENT
/begin MEASUREMENT DINH_nrActvInhReas.FId_EngDemTrqLimErrAPP "Number of active inhibit reasons for the FIds / Number of active inhibit reasons for FId_EngDemTrqLimErrAPP" UWORD DINH_ct_Compu 1 100 -4095.000 4096.000 BIT_MASK 0x1fff FORMAT "%8.3" ECU_ADDRESS 0x6000DDEE /end MEASUREMENT
/begin MEASUREMENT DINH_nrActvInhReas.FId_EngIntkAirFail "Number of active inhibit reasons for the FIds / Number of active inhibit reasons for FId_EngIntkAirFail" UWORD DINH_ct_Compu 1 100 -4095.000 4096.000 BIT_MASK 0x1fff FORMAT "%8.3" ECU_ADDRESS 0x6000DDF0 /end MEASUREMENT
/begin MEASUREMENT DINH_nrActvInhReas.FId_EngPrtErrVehV "Number of active inhibit reasons for the FIds / Number of active inhibit reasons for FId_EngPrtErrVehV" UWORD DINH_ct_Compu 1 100 -4095.000 4096.000 BIT_MASK 0x1fff FORMAT "%8.3" ECU_ADDRESS 0x6000DDF2 /end MEASUREMENT
/begin MEASUREMENT DINH_nrActvInhReas.FId_EngSpd30DegFail "Number of active inhibit reasons for the FIds / Number of active inhibit reasons for FId_EngSpd30DegFail" UWORD DINH_ct_Compu 1 100 -4095.000 4096.000 BIT_MASK 0x1fff FORMAT "%8.3" ECU_ADDRESS 0x6000DDF4 /end MEASUREMENT
/begin MEASUREMENT DINH_nrActvInhReas.FId_EngStrtEnaEthAdap "Number of active inhibit reasons for the FIds / Number of active inhibit reasons for FId_EngStrtEnaEthAdap" UWORD DINH_ct_Compu 1 100 -4095.000 4096.000 BIT_MASK 0x1fff FORMAT "%8.3" ECU_ADDRESS 0x6000DDF6 /end MEASUREMENT
/begin MEASUREMENT DINH_nrActvInhReas.FId_EngStrt_InjProhb "Number of active inhibit reasons for the FIds / Number of active inhibit reasons for FId_EngStrt_InjProhb" UWORD DINH_ct_Compu 1 100 -4095.000 4096.000 BIT_MASK 0x1fff FORMAT "%8.3" ECU_ADDRESS 0x6000DDF8 /end MEASUREMENT
/begin MEASUREMENT DINH_nrActvInhReas.FId_EngTqRvsnEnaFlg "Number of active inhibit reasons for the FIds / Number of active inhibit reasons for FId_EngTqRvsnEnaFlg" UWORD DINH_ct_Compu 1 100 -4095.000 4096.000 BIT_MASK 0x1fff FORMAT "%8.3" ECU_ADDRESS 0x6000DDFA /end MEASUREMENT
/begin MEASUREMENT DINH_nrActvInhReas.FId_EnvTPrimMod "Number of active inhibit reasons for the FIds / Number of active inhibit reasons for FId_EnvTPrimMod" UWORD DINH_ct_Compu 1 100 -4095.000 4096.000 BIT_MASK 0x1fff FORMAT "%8.3" ECU_ADDRESS 0x6000DDFC /end MEASUREMENT
/begin MEASUREMENT DINH_nrActvInhReas.FId_EnvTPrimModIniVal "Number of active inhibit reasons for the FIds / Number of active inhibit reasons for FId_EnvTPrimModIniVal" UWORD DINH_ct_Compu 1 100 -4095.000 4096.000 BIT_MASK 0x1fff FORMAT "%8.3" ECU_ADDRESS 0x6000DDFE /end MEASUREMENT
/begin MEASUREMENT DINH_nrActvInhReas.FId_EnvTSensSum "Number of active inhibit reasons for the FIds / Number of active inhibit reasons for FId_EnvTSensSum" UWORD DINH_ct_Compu 1 100 -4095.000 4096.000 BIT_MASK 0x1fff FORMAT "%8.3" ECU_ADDRESS 0x6000DE00 /end MEASUREMENT
/begin MEASUREMENT DINH_nrActvInhReas.FId_EnvTtCEngDsT "Number of active inhibit reasons for the FIds / Number of active inhibit reasons for FId_EnvTtCEngDsT" UWORD DINH_ct_Compu 1 100 -4095.000 4096.000 BIT_MASK 0x1fff FORMAT "%8.3" ECU_ADDRESS 0x6000DE02 /end MEASUREMENT
/begin MEASUREMENT DINH_nrActvInhReas.FId_EnvTtIntkMnfld "Number of active inhibit reasons for the FIds / Number of active inhibit reasons for FId_EnvTtIntkMnfld" UWORD DINH_ct_Compu 1 100 -4095.000 4096.000 BIT_MASK 0x1fff FORMAT "%8.3" ECU_ADDRESS 0x6000DE04 /end MEASUREMENT
/begin MEASUREMENT DINH_nrActvInhReas.FId_EpmBCr "Number of active inhibit reasons for the FIds / Number of active inhibit reasons for FId_EpmBCr" UWORD DINH_ct_Compu 1 100 -4095.000 4096.000 BIT_MASK 0x1fff FORMAT "%8.3" ECU_ADDRESS 0x6000DE06 /end MEASUREMENT
/begin MEASUREMENT DINH_nrActvInhReas.FId_EpmCaSAdapCaSI1 "Number of active inhibit reasons for the FIds / Number of active inhibit reasons for FId_EpmCaSAdapCaSI1" UWORD DINH_ct_Compu 1 100 -4095.000 4096.000 BIT_MASK 0x1fff FORMAT "%8.3" ECU_ADDRESS 0x6000DE08 /end MEASUREMENT
/begin MEASUREMENT DINH_nrActvInhReas.FId_EpmCaSAdapRstI1 "Number of active inhibit reasons for the FIds / Number of active inhibit reasons for FId_EpmCaSAdapRstI1" UWORD DINH_ct_Compu 1 100 -4095.000 4096.000 BIT_MASK 0x1fff FORMAT "%8.3" ECU_ADDRESS 0x6000DE0A /end MEASUREMENT
/begin MEASUREMENT DINH_nrActvInhReas.FId_EpmCaSDiagI1 "Number of active inhibit reasons for the FIds / Number of active inhibit reasons for FId_EpmCaSDiagI1" UWORD DINH_ct_Compu 1 100 -4095.000 4096.000 BIT_MASK 0x1fff FORMAT "%8.3" ECU_ADDRESS 0x6000DE0C /end MEASUREMENT
/begin MEASUREMENT DINH_nrActvInhReas.FId_EpmCaSErrCaSI1 "Number of active inhibit reasons for the FIds / Number of active inhibit reasons for FId_EpmCaSErrCaSI1" UWORD DINH_ct_Compu 1 100 -4095.000 4096.000 BIT_MASK 0x1fff FORMAT "%8.3" ECU_ADDRESS 0x6000DE0E /end MEASUREMENT
/begin MEASUREMENT DINH_nrActvInhReas.FId_EpmCaSOfsDiagCaSI1 "Number of active inhibit reasons for the FIds / Number of active inhibit reasons for FId_EpmCaSOfsDiagCaSI1" UWORD DINH_ct_Compu 1 100 -4095.000 4096.000 BIT_MASK 0x1fff FORMAT "%8.3" ECU_ADDRESS 0x6000DE10 /end MEASUREMENT
/begin MEASUREMENT DINH_nrActvInhReas.FId_EpmCaSOfsErrCaSI1 "Number of active inhibit reasons for the FIds / Number of active inhibit reasons for FId_EpmCaSOfsErrCaSI1" UWORD DINH_ct_Compu 1 100 -4095.000 4096.000 BIT_MASK 0x1fff FORMAT "%8.3" ECU_ADDRESS 0x6000DE12 /end MEASUREMENT
/begin MEASUREMENT DINH_nrActvInhReas.FId_EpmCaSSegI1 "Number of active inhibit reasons for the FIds / Number of active inhibit reasons for FId_EpmCaSSegI1" UWORD DINH_ct_Compu 1 100 -4095.000 4096.000 BIT_MASK 0x1fff FORMAT "%8.3" ECU_ADDRESS 0x6000DE14 /end MEASUREMENT
/begin MEASUREMENT DINH_nrActvInhReas.FId_EpmCaSSpdPlausI1 "Number of active inhibit reasons for the FIds / Number of active inhibit reasons for FId_EpmCaSSpdPlausI1" UWORD DINH_ct_Compu 1 100 -4095.000 4096.000 BIT_MASK 0x1fff FORMAT "%8.3" ECU_ADDRESS 0x6000DE16 /end MEASUREMENT
/begin MEASUREMENT DINH_nrActvInhReas.FId_EpmCrSDiag "Number of active inhibit reasons for the FIds / Number of active inhibit reasons for FId_EpmCrSDiag" UWORD DINH_ct_Compu 1 100 -4095.000 4096.000 BIT_MASK 0x1fff FORMAT "%8.3" ECU_ADDRESS 0x6000DE18 /end MEASUREMENT
/begin MEASUREMENT DINH_nrActvInhReas.FId_EpmCrSDiagVeh "Number of active inhibit reasons for the FIds / Number of active inhibit reasons for FId_EpmCrSDiagVeh" UWORD DINH_ct_Compu 1 100 -4095.000 4096.000 BIT_MASK 0x1fff FORMAT "%8.3" ECU_ADDRESS 0x6000DE1A /end MEASUREMENT
/begin MEASUREMENT DINH_nrActvInhReas.FId_EpmCrSErr "Number of active inhibit reasons for the FIds / Number of active inhibit reasons for FId_EpmCrSErr" UWORD DINH_ct_Compu 1 100 -4095.000 4096.000 BIT_MASK 0x1fff FORMAT "%8.3" ECU_ADDRESS 0x6000DE1C /end MEASUREMENT
/begin MEASUREMENT DINH_nrActvInhReas.FId_EpmRRSCrSFaultCheck "Number of active inhibit reasons for the FIds / Number of active inhibit reasons for FId_EpmRRSCrSFaultCheck" UWORD DINH_ct_Compu 1 100 -4095.000 4096.000 BIT_MASK 0x1fff FORMAT "%8.3" ECU_ADDRESS 0x6000DE1E /end MEASUREMENT
/begin MEASUREMENT DINH_nrActvInhReas.FId_EpmRRSVehVFaultChck "Number of active inhibit reasons for the FIds / Number of active inhibit reasons for FId_EpmRRSVehVFaultChck" UWORD DINH_ct_Compu 1 100 -4095.000 4096.000 BIT_MASK 0x1fff FORMAT "%8.3" ECU_ADDRESS 0x6000DE20 /end MEASUREMENT
/begin MEASUREMENT DINH_nrActvInhReas.FId_EpmSynLockCaSSync "Number of active inhibit reasons for the FIds / Number of active inhibit reasons for FId_EpmSynLockCaSSync" UWORD DINH_ct_Compu 1 100 -4095.000 4096.000 BIT_MASK 0x1fff FORMAT "%8.3" ECU_ADDRESS 0x6000DE22 /end MEASUREMENT
/begin MEASUREMENT DINH_nrActvInhReas.FId_EtaEngIdleNonCsers "Number of active inhibit reasons for the FIds / Number of active inhibit reasons for FId_EtaEngIdleNonCsers" UWORD DINH_ct_Compu 1 100 -4095.000 4096.000 BIT_MASK 0x1fff FORMAT "%8.3" ECU_ADDRESS 0x6000DE24 /end MEASUREMENT
/begin MEASUREMENT DINH_nrActvInhReas.FId_EtaEngPtlNonCsers "Number of active inhibit reasons for the FIds / Number of active inhibit reasons for FId_EtaEngPtlNonCsers" UWORD DINH_ct_Compu 1 100 -4095.000 4096.000 BIT_MASK 0x1fff FORMAT "%8.3" ECU_ADDRESS 0x6000DE26 /end MEASUREMENT
/begin MEASUREMENT DINH_nrActvInhReas.FId_FanCtlACClntP "Number of active inhibit reasons for the FIds / Number of active inhibit reasons for FId_FanCtlACClntP" UWORD DINH_ct_Compu 1 100 -4095.000 4096.000 BIT_MASK 0x1fff FORMAT "%8.3" ECU_ADDRESS 0x6000DE28 /end MEASUREMENT
/begin MEASUREMENT DINH_nrActvInhReas.FId_FanCtlACGModFail "Number of active inhibit reasons for the FIds / Number of active inhibit reasons for FId_FanCtlACGModFail" UWORD DINH_ct_Compu 1 100 -4095.000 4096.000 BIT_MASK 0x1fff FORMAT "%8.3" ECU_ADDRESS 0x6000DE2A /end MEASUREMENT
/begin MEASUREMENT DINH_nrActvInhReas.FId_FanCtlAPP1 "Number of active inhibit reasons for the FIds / Number of active inhibit reasons for FId_FanCtlAPP1" UWORD DINH_ct_Compu 1 100 -4095.000 4096.000 BIT_MASK 0x1fff FORMAT "%8.3" ECU_ADDRESS 0x6000DE2C /end MEASUREMENT
/begin MEASUREMENT DINH_nrActvInhReas.FId_FanCtlAPP2 "Number of active inhibit reasons for the FIds / Number of active inhibit reasons for FId_FanCtlAPP2" UWORD DINH_ct_Compu 1 100 -4095.000 4096.000 BIT_MASK 0x1fff FORMAT "%8.3" ECU_ADDRESS 0x6000DE2E /end MEASUREMENT
/begin MEASUREMENT DINH_nrActvInhReas.FId_FanCtlAPPSync "Number of active inhibit reasons for the FIds / Number of active inhibit reasons for FId_FanCtlAPPSync" UWORD DINH_ct_Compu 1 100 -4095.000 4096.000 BIT_MASK 0x1fff FORMAT "%8.3" ECU_ADDRESS 0x6000DE30 /end MEASUREMENT
/begin MEASUREMENT DINH_nrActvInhReas.FId_FanCtlBlowrU "Number of active inhibit reasons for the FIds / Number of active inhibit reasons for FId_FanCtlBlowrU" UWORD DINH_ct_Compu 1 100 -4095.000 4096.000 BIT_MASK 0x1fff FORMAT "%8.3" ECU_ADDRESS 0x6000DE32 /end MEASUREMENT
/begin MEASUREMENT DINH_nrActvInhReas.FId_FanCtlCooltT "Number of active inhibit reasons for the FIds / Number of active inhibit reasons for FId_FanCtlCooltT" UWORD DINH_ct_Compu 1 100 -4095.000 4096.000 BIT_MASK 0x1fff FORMAT "%8.3" ECU_ADDRESS 0x6000DE34 /end MEASUREMENT
/begin MEASUREMENT DINH_nrActvInhReas.FId_FanCtlCooltT2 "Number of active inhibit reasons for the FIds / Number of active inhibit reasons for FId_FanCtlCooltT2" UWORD DINH_ct_Compu 1 100 -4095.000 4096.000 BIT_MASK 0x1fff FORMAT "%8.3" ECU_ADDRESS 0x6000DE36 /end MEASUREMENT
/begin MEASUREMENT DINH_nrActvInhReas.FId_FanCtlEnvT "Number of active inhibit reasons for the FIds / Number of active inhibit reasons for FId_FanCtlEnvT" UWORD DINH_ct_Compu 1 100 -4095.000 4096.000 BIT_MASK 0x1fff FORMAT "%8.3" ECU_ADDRESS 0x6000DE38 /end MEASUREMENT
/begin MEASUREMENT DINH_nrActvInhReas.FId_FanCtlLiSwtInfo "Number of active inhibit reasons for the FIds / Number of active inhibit reasons for FId_FanCtlLiSwtInfo" UWORD DINH_ct_Compu 1 100 -4095.000 4096.000 BIT_MASK 0x1fff FORMAT "%8.3" ECU_ADDRESS 0x6000DE3A /end MEASUREMENT
/begin MEASUREMENT DINH_nrActvInhReas.FId_FanCtlSpd "Number of active inhibit reasons for the FIds / Number of active inhibit reasons for FId_FanCtlSpd" UWORD DINH_ct_Compu 1 100 -4095.000 4096.000 BIT_MASK 0x1fff FORMAT "%8.3" ECU_ADDRESS 0x6000DE3C /end MEASUREMENT
/begin MEASUREMENT DINH_nrActvInhReas.FId_FanCtlTSnsrErr "Number of active inhibit reasons for the FIds / Number of active inhibit reasons for FId_FanCtlTSnsrErr" UWORD DINH_ct_Compu 1 100 -4095.000 4096.000 BIT_MASK 0x1fff FORMAT "%8.3" ECU_ADDRESS 0x6000DE3E /end MEASUREMENT
/begin MEASUREMENT DINH_nrActvInhReas.FId_FanCtlThr1 "Number of active inhibit reasons for the FIds / Number of active inhibit reasons for FId_FanCtlThr1" UWORD DINH_ct_Compu 1 100 -4095.000 4096.000 BIT_MASK 0x1fff FORMAT "%8.3" ECU_ADDRESS 0x6000DE40 /end MEASUREMENT
/begin MEASUREMENT DINH_nrActvInhReas.FId_FanCtlThr2 "Number of active inhibit reasons for the FIds / Number of active inhibit reasons for FId_FanCtlThr2" UWORD DINH_ct_Compu 1 100 -4095.000 4096.000 BIT_MASK 0x1fff FORMAT "%8.3" ECU_ADDRESS 0x6000DE42 /end MEASUREMENT
/begin MEASUREMENT DINH_nrActvInhReas.FId_FcoReq "Number of active inhibit reasons for the FIds / Number of active inhibit reasons for FId_FcoReq" UWORD DINH_ct_Compu 1 100 -4095.000 4096.000 BIT_MASK 0x1fff FORMAT "%8.3" ECU_ADDRESS 0x6000DE44 /end MEASUREMENT
/begin MEASUREMENT DINH_nrActvInhReas.FId_FiMFID_rba_MRly_Diag_Stk "Number of active inhibit reasons for the FIds / Number of active inhibit reasons for FId_FiMFID_rba_MRly_Diag_Stk" UWORD DINH_ct_Compu 1 100 -4095.000 4096.000 BIT_MASK 0x1fff FORMAT "%8.3" ECU_ADDRESS 0x6000DE46 /end MEASUREMENT
/begin MEASUREMENT DINH_nrActvInhReas.FId_FlMALamDynDiag "Number of active inhibit reasons for the FIds / Number of active inhibit reasons for FId_FlMALamDynDiag" UWORD DINH_ct_Compu 1 100 -4095.000 4096.000 BIT_MASK 0x1fff FORMAT "%8.3" ECU_ADDRESS 0x6000DE48 /end MEASUREMENT
/begin MEASUREMENT DINH_nrActvInhReas.FId_FuEvapPurgTCpvDty "Number of active inhibit reasons for the FIds / Number of active inhibit reasons for FId_FuEvapPurgTCpvDty" UWORD DINH_ct_Compu 1 100 -4095.000 4096.000 BIT_MASK 0x1fff FORMAT "%8.3" ECU_ADDRESS 0x6000DE4A /end MEASUREMENT
/begin MEASUREMENT DINH_nrActvInhReas.FId_FuMixUegoErrExcl "Number of active inhibit reasons for the FIds / Number of active inhibit reasons for FId_FuMixUegoErrExcl" UWORD DINH_ct_Compu 1 100 -4095.000 4096.000 BIT_MASK 0x1fff FORMAT "%8.3" ECU_ADDRESS 0x6000DE4C /end MEASUREMENT
/begin MEASUREMENT DINH_nrActvInhReas.FId_GEVCtlVlvLftEnaIntk "Number of active inhibit reasons for the FIds / Number of active inhibit reasons for FId_GEVCtlVlvLftEnaIntk" UWORD DINH_ct_Compu 1 100 -4095.000 4096.000 BIT_MASK 0x1fff FORMAT "%8.3" ECU_ADDRESS 0x6000DE4E /end MEASUREMENT
/begin MEASUREMENT DINH_nrActvInhReas.FId_GbxAnNeutPosnErr "Number of active inhibit reasons for the FIds / Number of active inhibit reasons for FId_GbxAnNeutPosnErr" UWORD DINH_ct_Compu 1 100 -4095.000 4096.000 BIT_MASK 0x1fff FORMAT "%8.3" ECU_ADDRESS 0x6000DE50 /end MEASUREMENT
/begin MEASUREMENT DINH_nrActvInhReas.FId_GbxCANDigPlausErr "Number of active inhibit reasons for the FIds / Number of active inhibit reasons for FId_GbxCANDigPlausErr" UWORD DINH_ct_Compu 1 100 -4095.000 4096.000 BIT_MASK 0x1fff FORMAT "%8.3" ECU_ADDRESS 0x6000DE52 /end MEASUREMENT
/begin MEASUREMENT DINH_nrActvInhReas.FId_GbxCANNeutSigErr "Number of active inhibit reasons for the FIds / Number of active inhibit reasons for FId_GbxCANNeutSigErr" UWORD DINH_ct_Compu 1 100 -4095.000 4096.000 BIT_MASK 0x1fff FORMAT "%8.3" ECU_ADDRESS 0x6000DE54 /end MEASUREMENT
/begin MEASUREMENT DINH_nrActvInhReas.FId_GbxPNPosSig "Number of active inhibit reasons for the FIds / Number of active inhibit reasons for FId_GbxPNPosSig" UWORD DINH_ct_Compu 1 100 -4095.000 4096.000 BIT_MASK 0x1fff FORMAT "%8.3" ECU_ADDRESS 0x6000DE56 /end MEASUREMENT
/begin MEASUREMENT DINH_nrActvInhReas.FId_GbxPNPosnComErr "Number of active inhibit reasons for the FIds / Number of active inhibit reasons for FId_GbxPNPosnComErr" UWORD DINH_ct_Compu 1 100 -4095.000 4096.000 BIT_MASK 0x1fff FORMAT "%8.3" ECU_ADDRESS 0x6000DE58 /end MEASUREMENT
/begin MEASUREMENT DINH_nrActvInhReas.FId_GbxPNPosnDiagDrvCdnRels "Number of active inhibit reasons for the FIds / Number of active inhibit reasons for FId_GbxPNPosnDiagDrvCdnRels" UWORD DINH_ct_Compu 1 100 -4095.000 4096.000 BIT_MASK 0x1fff FORMAT "%8.3" ECU_ADDRESS 0x6000DE5A /end MEASUREMENT
/begin MEASUREMENT DINH_nrActvInhReas.FId_GbxPNPosnDiagDrvCodnHealRels "Number of active inhibit reasons for the FIds / Number of active inhibit reasons for FId_GbxPNPosnDiagDrvCodnHealRels" UWORD DINH_ct_Compu 1 100 -4095.000 4096.000 BIT_MASK 0x1fff FORMAT "%8.3" ECU_ADDRESS 0x6000DE5C /end MEASUREMENT
/begin MEASUREMENT DINH_nrActvInhReas.FId_GbxPNPosnDiagPlausyRels "Number of active inhibit reasons for the FIds / Number of active inhibit reasons for FId_GbxPNPosnDiagPlausyRels" UWORD DINH_ct_Compu 1 100 -4095.000 4096.000 BIT_MASK 0x1fff FORMAT "%8.3" ECU_ADDRESS 0x6000DE5E /end MEASUREMENT
/begin MEASUREMENT DINH_nrActvInhReas.FId_GbxPNPosnSubsVal "Number of active inhibit reasons for the FIds / Number of active inhibit reasons for FId_GbxPNPosnSubsVal" UWORD DINH_ct_Compu 1 100 -4095.000 4096.000 BIT_MASK 0x1fff FORMAT "%8.3" ECU_ADDRESS 0x6000DE60 /end MEASUREMENT
/begin MEASUREMENT DINH_nrActvInhReas.FId_GbxRvsSwtStk "Number of active inhibit reasons for the FIds / Number of active inhibit reasons for FId_GbxRvsSwtStk" UWORD DINH_ct_Compu 1 100 -4095.000 4096.000 BIT_MASK 0x1fff FORMAT "%8.3" ECU_ADDRESS 0x6000DE62 /end MEASUREMENT
/begin MEASUREMENT DINH_nrActvInhReas.FId_GbxSnsrSplyUErr "Number of active inhibit reasons for the FIds / Number of active inhibit reasons for FId_GbxSnsrSplyUErr" UWORD DINH_ct_Compu 1 100 -4095.000 4096.000 BIT_MASK 0x1fff FORMAT "%8.3" ECU_ADDRESS 0x6000DE64 /end MEASUREMENT
/begin MEASUREMENT DINH_nrActvInhReas.FId_GbxSpstReqOk "Number of active inhibit reasons for the FIds / Number of active inhibit reasons for FId_GbxSpstReqOk" UWORD DINH_ct_Compu 1 100 -4095.000 4096.000 BIT_MASK 0x1fff FORMAT "%8.3" ECU_ADDRESS 0x6000DE66 /end MEASUREMENT
/begin MEASUREMENT DINH_nrActvInhReas.FId_GlbDaLSumvXPtd "Number of active inhibit reasons for the FIds / Number of active inhibit reasons for FId_GlbDaLSumvXPtd" UWORD DINH_ct_Compu 1 100 -4095.000 4096.000 BIT_MASK 0x1fff FORMAT "%8.3" ECU_ADDRESS 0x6000DE68 /end MEASUREMENT
/begin MEASUREMENT DINH_nrActvInhReas.FId_GslThrVlvSnsrDiagB1 "Number of active inhibit reasons for the FIds / Number of active inhibit reasons for FId_GslThrVlvSnsrDiagB1" UWORD DINH_ct_Compu 1 100 -4095.000 4096.000 BIT_MASK 0x1fff FORMAT "%8.3" ECU_ADDRESS 0x6000DE6A /end MEASUREMENT
/begin MEASUREMENT DINH_nrActvInhReas.FId_HEGOS2B1DElec "Number of active inhibit reasons for the FIds / Number of active inhibit reasons for FId_HEGOS2B1DElec" UWORD DINH_ct_Compu 1 100 -4095.000 4096.000 BIT_MASK 0x1fff FORMAT "%8.3" ECU_ADDRESS 0x6000DE6C /end MEASUREMENT
/begin MEASUREMENT DINH_nrActvInhReas.FId_HEGOS2B1DHtg "Number of active inhibit reasons for the FIds / Number of active inhibit reasons for FId_HEGOS2B1DHtg" UWORD DINH_ct_Compu 1 100 -4095.000 4096.000 BIT_MASK 0x1fff FORMAT "%8.3" ECU_ADDRESS 0x6000DE6E /end MEASUREMENT
/begin MEASUREMENT DINH_nrActvInhReas.FId_HEGOS2B1Htg "Number of active inhibit reasons for the FIds / Number of active inhibit reasons for FId_HEGOS2B1Htg" UWORD DINH_ct_Compu 1 100 -4095.000 4096.000 BIT_MASK 0x1fff FORMAT "%8.3" ECU_ADDRESS 0x6000DE70 /end MEASUREMENT
/begin MEASUREMENT DINH_nrActvInhReas.FId_HEGOS2B1HtrPsSt "Number of active inhibit reasons for the FIds / Number of active inhibit reasons for FId_HEGOS2B1HtrPsSt" UWORD DINH_ct_Compu 1 100 -4095.000 4096.000 BIT_MASK 0x1fff FORMAT "%8.3" ECU_ADDRESS 0x6000DE72 /end MEASUREMENT
/begin MEASUREMENT DINH_nrActvInhReas.FId_HEGOS2B1InVld "Number of active inhibit reasons for the FIds / Number of active inhibit reasons for FId_HEGOS2B1InVld" UWORD DINH_ct_Compu 1 100 -4095.000 4096.000 BIT_MASK 0x1fff FORMAT "%8.3" ECU_ADDRESS 0x6000DE74 /end MEASUREMENT
/begin MEASUREMENT DINH_nrActvInhReas.FId_HEGOS2B1LSPsDiaDi "Number of active inhibit reasons for the FIds / Number of active inhibit reasons for FId_HEGOS2B1LSPsDiaDi" UWORD DINH_ct_Compu 1 100 -4095.000 4096.000 BIT_MASK 0x1fff FORMAT "%8.3" ECU_ADDRESS 0x6000DE76 /end MEASUREMENT
/begin MEASUREMENT DINH_nrActvInhReas.FId_HLSDemBrkFlt "Number of active inhibit reasons for the FIds / Number of active inhibit reasons for FId_HLSDemBrkFlt" UWORD DINH_ct_Compu 1 100 -4095.000 4096.000 BIT_MASK 0x1fff FORMAT "%8.3" ECU_ADDRESS 0x6000DE78 /end MEASUREMENT
/begin MEASUREMENT DINH_nrActvInhReas.FId_HLSDemIntkAirTemp "Number of active inhibit reasons for the FIds / Number of active inhibit reasons for FId_HLSDemIntkAirTemp" UWORD DINH_ct_Compu 1 100 -4095.000 4096.000 BIT_MASK 0x1fff FORMAT "%8.3" ECU_ADDRESS 0x6000DE7A /end MEASUREMENT
/begin MEASUREMENT DINH_nrActvInhReas.FId_HLSDemMotTemp "Number of active inhibit reasons for the FIds / Number of active inhibit reasons for FId_HLSDemMotTemp" UWORD DINH_ct_Compu 1 100 -4095.000 4096.000 BIT_MASK 0x1fff FORMAT "%8.3" ECU_ADDRESS 0x6000DE7C /end MEASUREMENT
/begin MEASUREMENT DINH_nrActvInhReas.FId_HLSDemMstCyldpVld "Number of active inhibit reasons for the FIds / Number of active inhibit reasons for FId_HLSDemMstCyldpVld" UWORD DINH_ct_Compu 1 100 -4095.000 4096.000 BIT_MASK 0x1fff FORMAT "%8.3" ECU_ADDRESS 0x6000DE7E /end MEASUREMENT
/begin MEASUREMENT DINH_nrActvInhReas.FId_HLSDemOvhtExhMnf "Number of active inhibit reasons for the FIds / Number of active inhibit reasons for FId_HLSDemOvhtExhMnf" UWORD DINH_ct_Compu 1 100 -4095.000 4096.000 BIT_MASK 0x1fff FORMAT "%8.3" ECU_ADDRESS 0x6000DE80 /end MEASUREMENT
/begin MEASUREMENT DINH_nrActvInhReas.FId_HLSDemOvhtFanR "Number of active inhibit reasons for the FIds / Number of active inhibit reasons for FId_HLSDemOvhtFanR" UWORD DINH_ct_Compu 1 100 -4095.000 4096.000 BIT_MASK 0x1fff FORMAT "%8.3" ECU_ADDRESS 0x6000DE82 /end MEASUREMENT
/begin MEASUREMENT DINH_nrActvInhReas.FId_HLSDemOvhtGear "Number of active inhibit reasons for the FIds / Number of active inhibit reasons for FId_HLSDemOvhtGear" UWORD DINH_ct_Compu 1 100 -4095.000 4096.000 BIT_MASK 0x1fff FORMAT "%8.3" ECU_ADDRESS 0x6000DE84 /end MEASUREMENT
/begin MEASUREMENT DINH_nrActvInhReas.FId_HLSDemOvhtTum "Number of active inhibit reasons for the FIds / Number of active inhibit reasons for FId_HLSDemOvhtTum" UWORD DINH_ct_Compu 1 100 -4095.000 4096.000 BIT_MASK 0x1fff FORMAT "%8.3" ECU_ADDRESS 0x6000DE86 /end MEASUREMENT
/begin MEASUREMENT DINH_nrActvInhReas.FId_HLSDemOvhtVehV "Number of active inhibit reasons for the FIds / Number of active inhibit reasons for FId_HLSDemOvhtVehV" UWORD DINH_ct_Compu 1 100 -4095.000 4096.000 BIT_MASK 0x1fff FORMAT "%8.3" ECU_ADDRESS 0x6000DE88 /end MEASUREMENT
/begin MEASUREMENT DINH_nrActvInhReas.FId_HLSDemSpdClthGearAccrSigErr "Number of active inhibit reasons for the FIds / Number of active inhibit reasons for FId_HLSDemSpdClthGearAccrSigErr" UWORD DINH_ct_Compu 1 100 -4095.000 4096.000 BIT_MASK 0x1fff FORMAT "%8.3" ECU_ADDRESS 0x6000DE8A /end MEASUREMENT
/begin MEASUREMENT DINH_nrActvInhReas.FId_HLSDem_DrvOffSuprt "Number of active inhibit reasons for the FIds / Number of active inhibit reasons for FId_HLSDem_DrvOffSuprt" UWORD DINH_ct_Compu 1 100 -4095.000 4096.000 BIT_MASK 0x1fff FORMAT "%8.3" ECU_ADDRESS 0x6000DE8C /end MEASUREMENT
/begin MEASUREMENT DINH_nrActvInhReas.FId_HLSDem_DrvOffSuprtBrkHldSys "Number of active inhibit reasons for the FIds / Number of active inhibit reasons for FId_HLSDem_DrvOffSuprtBrkHldSys" UWORD DINH_ct_Compu 1 100 -4095.000 4096.000 BIT_MASK 0x1fff FORMAT "%8.3" ECU_ADDRESS 0x6000DE8E /end MEASUREMENT
/begin MEASUREMENT DINH_nrActvInhReas.FId_HLSDem_DrvOffSuprtLAS "Number of active inhibit reasons for the FIds / Number of active inhibit reasons for FId_HLSDem_DrvOffSuprtLAS" UWORD DINH_ct_Compu 1 100 -4095.000 4096.000 BIT_MASK 0x1fff FORMAT "%8.3" ECU_ADDRESS 0x6000DE90 /end MEASUREMENT
/begin MEASUREMENT DINH_nrActvInhReas.FId_HLSDem_PModeActv "Number of active inhibit reasons for the FIds / Number of active inhibit reasons for FId_HLSDem_PModeActv" UWORD DINH_ct_Compu 1 100 -4095.000 4096.000 BIT_MASK 0x1fff FORMAT "%8.3" ECU_ADDRESS 0x6000DE92 /end MEASUREMENT
/begin MEASUREMENT DINH_nrActvInhReas.FId_HLSDem_TModeActv "Number of active inhibit reasons for the FIds / Number of active inhibit reasons for FId_HLSDem_TModeActv" UWORD DINH_ct_Compu 1 100 -4095.000 4096.000 BIT_MASK 0x1fff FORMAT "%8.3" ECU_ADDRESS 0x6000DE94 /end MEASUREMENT
/begin MEASUREMENT DINH_nrActvInhReas.FId_HLSDem_TraSubFcn "Number of active inhibit reasons for the FIds / Number of active inhibit reasons for FId_HLSDem_TraSubFcn" UWORD DINH_ct_Compu 1 100 -4095.000 4096.000 BIT_MASK 0x1fff FORMAT "%8.3" ECU_ADDRESS 0x6000DE96 /end MEASUREMENT
/begin MEASUREMENT DINH_nrActvInhReas.FId_HLSDem_nMaxLimErr1 "Number of active inhibit reasons for the FIds / Number of active inhibit reasons for FId_HLSDem_nMaxLimErr1" UWORD DINH_ct_Compu 1 100 -4095.000 4096.000 BIT_MASK 0x1fff FORMAT "%8.3" ECU_ADDRESS 0x6000DE98 /end MEASUREMENT
/begin MEASUREMENT DINH_nrActvInhReas.FId_HLSDem_nMaxLimErr2 "Number of active inhibit reasons for the FIds / Number of active inhibit reasons for FId_HLSDem_nMaxLimErr2" UWORD DINH_ct_Compu 1 100 -4095.000 4096.000 BIT_MASK 0x1fff FORMAT "%8.3" ECU_ADDRESS 0x6000DE9A /end MEASUREMENT
/begin MEASUREMENT DINH_nrActvInhReas.FId_HLSDem_nMaxLimErr3 "Number of active inhibit reasons for the FIds / Number of active inhibit reasons for FId_HLSDem_nMaxLimErr3" UWORD DINH_ct_Compu 1 100 -4095.000 4096.000 BIT_MASK 0x1fff FORMAT "%8.3" ECU_ADDRESS 0x6000DE9C /end MEASUREMENT
/begin MEASUREMENT DINH_nrActvInhReas.FId_HLSDem_nMaxVErr "Number of active inhibit reasons for the FIds / Number of active inhibit reasons for FId_HLSDem_nMaxVErr" UWORD DINH_ct_Compu 1 100 -4095.000 4096.000 BIT_MASK 0x1fff FORMAT "%8.3" ECU_ADDRESS 0x6000DE9E /end MEASUREMENT
/begin MEASUREMENT DINH_nrActvInhReas.FId_I14229APP "Number of active inhibit reasons for the FIds / Number of active inhibit reasons for FId_I14229APP" UWORD DINH_ct_Compu 1 100 -4095.000 4096.000 BIT_MASK 0x1fff FORMAT "%8.3" ECU_ADDRESS 0x6000DEA0 /end MEASUREMENT
/begin MEASUREMENT DINH_nrActvInhReas.FId_I14229CANErr "Number of active inhibit reasons for the FIds / Number of active inhibit reasons for FId_I14229CANErr" UWORD DINH_ct_Compu 1 100 -4095.000 4096.000 BIT_MASK 0x1fff FORMAT "%8.3" ECU_ADDRESS 0x6000DEA2 /end MEASUREMENT
/begin MEASUREMENT DINH_nrActvInhReas.FId_I14229EWPErr "Number of active inhibit reasons for the FIds / Number of active inhibit reasons for FId_I14229EWPErr" UWORD DINH_ct_Compu 1 100 -4095.000 4096.000 BIT_MASK 0x1fff FORMAT "%8.3" ECU_ADDRESS 0x6000DEA4 /end MEASUREMENT
/begin MEASUREMENT DINH_nrActvInhReas.FId_I14229TrbCh "Number of active inhibit reasons for the FIds / Number of active inhibit reasons for FId_I14229TrbCh" UWORD DINH_ct_Compu 1 100 -4095.000 4096.000 BIT_MASK 0x1fff FORMAT "%8.3" ECU_ADDRESS 0x6000DEA6 /end MEASUREMENT
/begin MEASUREMENT DINH_nrActvInhReas.FId_I14229VTCErr "Number of active inhibit reasons for the FIds / Number of active inhibit reasons for FId_I14229VTCErr" UWORD DINH_ct_Compu 1 100 -4095.000 4096.000 BIT_MASK 0x1fff FORMAT "%8.3" ECU_ADDRESS 0x6000DEA8 /end MEASUREMENT
/begin MEASUREMENT DINH_nrActvInhReas.FId_IMGISABComErr "Number of active inhibit reasons for the FIds / Number of active inhibit reasons for FId_IMGISABComErr" UWORD DINH_ct_Compu 1 100 -4095.000 4096.000 BIT_MASK 0x1fff FORMAT "%8.3" ECU_ADDRESS 0x6000DEAA /end MEASUREMENT
/begin MEASUREMENT DINH_nrActvInhReas.FId_InhbLamDynS1B1 "Number of active inhibit reasons for the FIds / Number of active inhibit reasons for FId_InhbLamDynS1B1" UWORD DINH_ct_Compu 1 100 -4095.000 4096.000 BIT_MASK 0x1fff FORMAT "%8.3" ECU_ADDRESS 0x6000DEAC /end MEASUREMENT
/begin MEASUREMENT DINH_nrActvInhReas.FId_InhibitAlways "Number of active inhibit reasons for the FIds / Number of active inhibit reasons for FId_InhibitAlways" UWORD DINH_ct_Compu 1 100 -4095.000 4096.000 BIT_MASK 0x1fff FORMAT "%8.3" ECU_ADDRESS 0x6000DEAE /end MEASUREMENT
/begin MEASUREMENT DINH_nrActvInhReas.FId_InhibitNever "Number of active inhibit reasons for the FIds / Number of active inhibit reasons for FId_InhibitNever" UWORD DINH_ct_Compu 1 100 -4095.000 4096.000 BIT_MASK 0x1fff FORMAT "%8.3" ECU_ADDRESS 0x6000DEB0 /end MEASUREMENT
/begin MEASUREMENT DINH_nrActvInhReas.FId_InjVvgPFIEV1 "Number of active inhibit reasons for the FIds / Number of active inhibit reasons for FId_InjVvgPFIEV1" UWORD DINH_ct_Compu 1 100 -4095.000 4096.000 BIT_MASK 0x1fff FORMAT "%8.3" ECU_ADDRESS 0x6000DEB2 /end MEASUREMENT
/begin MEASUREMENT DINH_nrActvInhReas.FId_InjVvgPFIEV2 "Number of active inhibit reasons for the FIds / Number of active inhibit reasons for FId_InjVvgPFIEV2" UWORD DINH_ct_Compu 1 100 -4095.000 4096.000 BIT_MASK 0x1fff FORMAT "%8.3" ECU_ADDRESS 0x6000DEB4 /end MEASUREMENT
/begin MEASUREMENT DINH_nrActvInhReas.FId_InjVvgPFIEV3 "Number of active inhibit reasons for the FIds / Number of active inhibit reasons for FId_InjVvgPFIEV3" UWORD DINH_ct_Compu 1 100 -4095.000 4096.000 BIT_MASK 0x1fff FORMAT "%8.3" ECU_ADDRESS 0x6000DEB6 /end MEASUREMENT
/begin MEASUREMENT DINH_nrActvInhReas.FId_InjVvgPFIEV4 "Number of active inhibit reasons for the FIds / Number of active inhibit reasons for FId_InjVvgPFIEV4" UWORD DINH_ct_Compu 1 100 -4095.000 4096.000 BIT_MASK 0x1fff FORMAT "%8.3" ECU_ADDRESS 0x6000DEB8 /end MEASUREMENT
/begin MEASUREMENT DINH_nrActvInhReas.FId_IntkAirTIntkMnfldCrssChk "Number of active inhibit reasons for the FIds / Number of active inhibit reasons for FId_IntkAirTIntkMnfldCrssChk" UWORD DINH_ct_Compu 1 100 -4095.000 4096.000 BIT_MASK 0x1fff FORMAT "%8.3" ECU_ADDRESS 0x6000DEBA /end MEASUREMENT
/begin MEASUREMENT DINH_nrActvInhReas.FId_IntkAirTIntkMnfldPlausChk "Number of active inhibit reasons for the FIds / Number of active inhibit reasons for FId_IntkAirTIntkMnfldPlausChk" UWORD DINH_ct_Compu 1 100 -4095.000 4096.000 BIT_MASK 0x1fff FORMAT "%8.3" ECU_ADDRESS 0x6000DEBC /end MEASUREMENT
/begin MEASUREMENT DINH_nrActvInhReas.FId_IntkAirTIntkMnfldRepl "Number of active inhibit reasons for the FIds / Number of active inhibit reasons for FId_IntkAirTIntkMnfldRepl" UWORD DINH_ct_Compu 1 100 -4095.000 4096.000 BIT_MASK 0x1fff FORMAT "%8.3" ECU_ADDRESS 0x6000DEBE /end MEASUREMENT
/begin MEASUREMENT DINH_nrActvInhReas.FId_IntkAirTSnsr1Elec "Number of active inhibit reasons for the FIds / Number of active inhibit reasons for FId_IntkAirTSnsr1Elec" UWORD DINH_ct_Compu 1 100 -4095.000 4096.000 BIT_MASK 0x1fff FORMAT "%8.3" ECU_ADDRESS 0x6000DEC0 /end MEASUREMENT
/begin MEASUREMENT DINH_nrActvInhReas.FId_IntkAirTSnsr1PRC "Number of active inhibit reasons for the FIds / Number of active inhibit reasons for FId_IntkAirTSnsr1PRC" UWORD DINH_ct_Compu 1 100 -4095.000 4096.000 BIT_MASK 0x1fff FORMAT "%8.3" ECU_ADDRESS 0x6000DEC2 /end MEASUREMENT
/begin MEASUREMENT DINH_nrActvInhReas.FId_IntkAirTSnsr1Sum "Number of active inhibit reasons for the FIds / Number of active inhibit reasons for FId_IntkAirTSnsr1Sum" UWORD DINH_ct_Compu 1 100 -4095.000 4096.000 BIT_MASK 0x1fff FORMAT "%8.3" ECU_ADDRESS 0x6000DEC4 /end MEASUREMENT
/begin MEASUREMENT DINH_nrActvInhReas.FId_IntkArTempENGB "Number of active inhibit reasons for the FIds / Number of active inhibit reasons for FId_IntkArTempENGB" UWORD DINH_ct_Compu 1 100 -4095.000 4096.000 BIT_MASK 0x1fff FORMAT "%8.3" ECU_ADDRESS 0x6000DEC6 /end MEASUREMENT
/begin MEASUREMENT DINH_nrActvInhReas.FId_LIGovDfrstI "Number of active inhibit reasons for the FIds / Number of active inhibit reasons for FId_LIGovDfrstI" UWORD DINH_ct_Compu 1 100 -4095.000 4096.000 BIT_MASK 0x1fff FORMAT "%8.3" ECU_ADDRESS 0x6000DEC8 /end MEASUREMENT
/begin MEASUREMENT DINH_nrActvInhReas.FId_LIGovUndrBrk "Number of active inhibit reasons for the FIds / Number of active inhibit reasons for FId_LIGovUndrBrk" UWORD DINH_ct_Compu 1 100 -4095.000 4096.000 BIT_MASK 0x1fff FORMAT "%8.3" ECU_ADDRESS 0x6000DECA /end MEASUREMENT
/begin MEASUREMENT DINH_nrActvInhReas.FId_LINDCDCRxErr "Number of active inhibit reasons for the FIds / Number of active inhibit reasons for FId_LINDCDCRxErr" UWORD DINH_ct_Compu 1 100 -4095.000 4096.000 BIT_MASK 0x1fff FORMAT "%8.3" ECU_ADDRESS 0x6000DECC /end MEASUREMENT
/begin MEASUREMENT DINH_nrActvInhReas.FId_LLimAppSnsrErr "Number of active inhibit reasons for the FIds / Number of active inhibit reasons for FId_LLimAppSnsrErr" UWORD DINH_ct_Compu 1 100 -4095.000 4096.000 BIT_MASK 0x1fff FORMAT "%8.3" ECU_ADDRESS 0x6000DECE /end MEASUREMENT
/begin MEASUREMENT DINH_nrActvInhReas.FId_LLimAppSnsrSyncErr "Number of active inhibit reasons for the FIds / Number of active inhibit reasons for FId_LLimAppSnsrSyncErr" UWORD DINH_ct_Compu 1 100 -4095.000 4096.000 BIT_MASK 0x1fff FORMAT "%8.3" ECU_ADDRESS 0x6000DED0 /end MEASUREMENT
/begin MEASUREMENT DINH_nrActvInhReas.FId_LLimMTVehSpdSnsrErr "Number of active inhibit reasons for the FIds / Number of active inhibit reasons for FId_LLimMTVehSpdSnsrErr" UWORD DINH_ct_Compu 1 100 -4095.000 4096.000 BIT_MASK 0x1fff FORMAT "%8.3" ECU_ADDRESS 0x6000DED2 /end MEASUREMENT
/begin MEASUREMENT DINH_nrActvInhReas.FId_LLimShutOffEng "Number of active inhibit reasons for the FIds / Number of active inhibit reasons for FId_LLimShutOffEng" UWORD DINH_ct_Compu 1 100 -4095.000 4096.000 BIT_MASK 0x1fff FORMAT "%8.3" ECU_ADDRESS 0x6000DED4 /end MEASUREMENT
/begin MEASUREMENT DINH_nrActvInhReas.FId_LRSEBMisf "Number of active inhibit reasons for the FIds / Number of active inhibit reasons for FId_LRSEBMisf" UWORD DINH_ct_Compu 1 100 -4095.000 4096.000 BIT_MASK 0x1fff FORMAT "%8.3" ECU_ADDRESS 0x6000DED6 /end MEASUREMENT
/begin MEASUREMENT DINH_nrActvInhReas.FId_LZSR "Number of active inhibit reasons for the FIds / Number of active inhibit reasons for FId_LZSR" UWORD DINH_ct_Compu 1 100 -4095.000 4096.000 BIT_MASK 0x1fff FORMAT "%8.3" ECU_ADDRESS 0x6000DED8 /end MEASUREMENT
/begin MEASUREMENT DINH_nrActvInhReas.FId_LeakToMnfldTstd "Number of active inhibit reasons for the FIds / Number of active inhibit reasons for FId_LeakToMnfldTstd" UWORD DINH_ct_Compu 1 100 -4095.000 4096.000 BIT_MASK 0x1fff FORMAT "%8.3" ECU_ADDRESS 0x6000DEDA /end MEASUREMENT
/begin MEASUREMENT DINH_nrActvInhReas.FId_MaiLoadSnsr "Number of active inhibit reasons for the FIds / Number of active inhibit reasons for FId_MaiLoadSnsr" UWORD DINH_ct_Compu 1 100 -4095.000 4096.000 BIT_MASK 0x1fff FORMAT "%8.3" ECU_ADDRESS 0x6000DEDC /end MEASUREMENT
/begin MEASUREMENT DINH_nrActvInhReas.FId_MisfDetDnAdpn "Number of active inhibit reasons for the FIds / Number of active inhibit reasons for FId_MisfDetDnAdpn" UWORD DINH_ct_Compu 1 100 -4095.000 4096.000 BIT_MASK 0x1fff FORMAT "%8.3" ECU_ADDRESS 0x6000DEDE /end MEASUREMENT
/begin MEASUREMENT DINH_nrActvInhReas.FId_MisfDetDnAdpnPlaus "Number of active inhibit reasons for the FIds / Number of active inhibit reasons for FId_MisfDetDnAdpnPlaus" UWORD DINH_ct_Compu 1 100 -4095.000 4096.000 BIT_MASK 0x1fff FORMAT "%8.3" ECU_ADDRESS 0x6000DEE0 /end MEASUREMENT
/begin MEASUREMENT DINH_nrActvInhReas.FId_MisfDetEnvP "Number of active inhibit reasons for the FIds / Number of active inhibit reasons for FId_MisfDetEnvP" UWORD DINH_ct_Compu 1 100 -4095.000 4096.000 BIT_MASK 0x1fff FORMAT "%8.3" ECU_ADDRESS 0x6000DEE2 /end MEASUREMENT
/begin MEASUREMENT DINH_nrActvInhReas.FId_MisfDetSegTiAdpnFco "Number of active inhibit reasons for the FIds / Number of active inhibit reasons for FId_MisfDetSegTiAdpnFco" UWORD DINH_ct_Compu 1 100 -4095.000 4096.000 BIT_MASK 0x1fff FORMAT "%8.3" ECU_ADDRESS 0x6000DEE4 /end MEASUREMENT
/begin MEASUREMENT DINH_nrActvInhReas.FId_MisfDetShtrpAct "Number of active inhibit reasons for the FIds / Number of active inhibit reasons for FId_MisfDetShtrpAct" UWORD DINH_ct_Compu 1 100 -4095.000 4096.000 BIT_MASK 0x1fff FORMAT "%8.3" ECU_ADDRESS 0x6000DEE6 /end MEASUREMENT
/begin MEASUREMENT DINH_nrActvInhReas.FId_MisfDetStc "Number of active inhibit reasons for the FIds / Number of active inhibit reasons for FId_MisfDetStc" UWORD DINH_ct_Compu 1 100 -4095.000 4096.000 BIT_MASK 0x1fff FORMAT "%8.3" ECU_ADDRESS 0x6000DEE8 /end MEASUREMENT
/begin MEASUREMENT DINH_nrActvInhReas.FId_MisfDetV "Number of active inhibit reasons for the FIds / Number of active inhibit reasons for FId_MisfDetV" UWORD DINH_ct_Compu 1 100 -4095.000 4096.000 BIT_MASK 0x1fff FORMAT "%8.3" ECU_ADDRESS 0x6000DEEA /end MEASUREMENT
/begin MEASUREMENT DINH_nrActvInhReas.FId_MisfDetVWhlFrntLe "Number of active inhibit reasons for the FIds / Number of active inhibit reasons for FId_MisfDetVWhlFrntLe" UWORD DINH_ct_Compu 1 100 -4095.000 4096.000 BIT_MASK 0x1fff FORMAT "%8.3" ECU_ADDRESS 0x6000DEEC /end MEASUREMENT
/begin MEASUREMENT DINH_nrActvInhReas.FId_MisfDetVWhlFrntRi "Number of active inhibit reasons for the FIds / Number of active inhibit reasons for FId_MisfDetVWhlFrntRi" UWORD DINH_ct_Compu 1 100 -4095.000 4096.000 BIT_MASK 0x1fff FORMAT "%8.3" ECU_ADDRESS 0x6000DEEE /end MEASUREMENT
/begin MEASUREMENT DINH_nrActvInhReas.FId_MisfDetVWhlReLe "Number of active inhibit reasons for the FIds / Number of active inhibit reasons for FId_MisfDetVWhlReLe" UWORD DINH_ct_Compu 1 100 -4095.000 4096.000 BIT_MASK 0x1fff FORMAT "%8.3" ECU_ADDRESS 0x6000DEF0 /end MEASUREMENT
/begin MEASUREMENT DINH_nrActvInhReas.FId_MisfDetVWhlReRi "Number of active inhibit reasons for the FIds / Number of active inhibit reasons for FId_MisfDetVWhlReRi" UWORD DINH_ct_Compu 1 100 -4095.000 4096.000 BIT_MASK 0x1fff FORMAT "%8.3" ECU_ADDRESS 0x6000DEF2 /end MEASUREMENT
/begin MEASUREMENT DINH_nrActvInhReas.FId_MisfDet_InjLockdOpen01 "Number of active inhibit reasons for the FIds / Number of active inhibit reasons for FId_MisfDet_InjLockdOpen01" UWORD DINH_ct_Compu 1 100 -4095.000 4096.000 BIT_MASK 0x1fff FORMAT "%8.3" ECU_ADDRESS 0x6000DEF4 /end MEASUREMENT
/begin MEASUREMENT DINH_nrActvInhReas.FId_MisfDet_InjLockdOpen02 "Number of active inhibit reasons for the FIds / Number of active inhibit reasons for FId_MisfDet_InjLockdOpen02" UWORD DINH_ct_Compu 1 100 -4095.000 4096.000 BIT_MASK 0x1fff FORMAT "%8.3" ECU_ADDRESS 0x6000DEF6 /end MEASUREMENT
/begin MEASUREMENT DINH_nrActvInhReas.FId_MisfDet_InjLockdOpen03 "Number of active inhibit reasons for the FIds / Number of active inhibit reasons for FId_MisfDet_InjLockdOpen03" UWORD DINH_ct_Compu 1 100 -4095.000 4096.000 BIT_MASK 0x1fff FORMAT "%8.3" ECU_ADDRESS 0x6000DEF8 /end MEASUREMENT
/begin MEASUREMENT DINH_nrActvInhReas.FId_MisfDet_InjLockdOpen04 "Number of active inhibit reasons for the FIds / Number of active inhibit reasons for FId_MisfDet_InjLockdOpen04" UWORD DINH_ct_Compu 1 100 -4095.000 4096.000 BIT_MASK 0x1fff FORMAT "%8.3" ECU_ADDRESS 0x6000DEFA /end MEASUREMENT
/begin MEASUREMENT DINH_nrActvInhReas.FId_NLimVehHalt "Number of active inhibit reasons for the FIds / Number of active inhibit reasons for FId_NLimVehHalt" UWORD DINH_ct_Compu 1 100 -4095.000 4096.000 BIT_MASK 0x1fff FORMAT "%8.3" ECU_ADDRESS 0x6000DEFC /end MEASUREMENT
/begin MEASUREMENT DINH_nrActvInhReas.FId_NSHTDAmbT "Number of active inhibit reasons for the FIds / Number of active inhibit reasons for FId_NSHTDAmbT" UWORD DINH_ct_Compu 1 100 -4095.000 4096.000 BIT_MASK 0x1fff FORMAT "%8.3" ECU_ADDRESS 0x6000DEFE /end MEASUREMENT
/begin MEASUREMENT DINH_nrActvInhReas.FId_NSHTDEngT "Number of active inhibit reasons for the FIds / Number of active inhibit reasons for FId_NSHTDEngT" UWORD DINH_ct_Compu 1 100 -4095.000 4096.000 BIT_MASK 0x1fff FORMAT "%8.3" ECU_ADDRESS 0x6000DF00 /end MEASUREMENT
/begin MEASUREMENT DINH_nrActvInhReas.FId_NSHTILimHiAltiLoIdleSp "Number of active inhibit reasons for the FIds / Number of active inhibit reasons for FId_NSHTILimHiAltiLoIdleSp" UWORD DINH_ct_Compu 1 100 -4095.000 4096.000 BIT_MASK 0x1fff FORMAT "%8.3" ECU_ADDRESS 0x6000DF02 /end MEASUREMENT
/begin MEASUREMENT DINH_nrActvInhReas.FId_O2StorgMdlMD "Number of active inhibit reasons for the FIds / Number of active inhibit reasons for FId_O2StorgMdlMD" UWORD DINH_ct_Compu 1 100 -4095.000 4096.000 BIT_MASK 0x1fff FORMAT "%8.3" ECU_ADDRESS 0x6000DF04 /end MEASUREMENT
/begin MEASUREMENT DINH_nrActvInhReas.FId_OilCmbdSen_LvlDfctHW "Number of active inhibit reasons for the FIds / Number of active inhibit reasons for FId_OilCmbdSen_LvlDfctHW" UWORD DINH_ct_Compu 1 100 -4095.000 4096.000 BIT_MASK 0x1fff FORMAT "%8.3" ECU_ADDRESS 0x6000DF06 /end MEASUREMENT
/begin MEASUREMENT DINH_nrActvInhReas.FId_OilSwmpTCEngDsTWrmUp "Number of active inhibit reasons for the FIds / Number of active inhibit reasons for FId_OilSwmpTCEngDsTWrmUp" UWORD DINH_ct_Compu 1 100 -4095.000 4096.000 BIT_MASK 0x1fff FORMAT "%8.3" ECU_ADDRESS 0x6000DF08 /end MEASUREMENT
/begin MEASUREMENT DINH_nrActvInhReas.FId_OilSwmpT_B_tospg "Number of active inhibit reasons for the FIds / Number of active inhibit reasons for FId_OilSwmpT_B_tospg" UWORD DINH_ct_Compu 1 100 -4095.000 4096.000 BIT_MASK 0x1fff FORMAT "%8.3" ECU_ADDRESS 0x6000DF0A /end MEASUREMENT
/begin MEASUREMENT DINH_nrActvInhReas.FId_OilSwmpT_B_tospgg "Number of active inhibit reasons for the FIds / Number of active inhibit reasons for FId_OilSwmpT_B_tospgg" UWORD DINH_ct_Compu 1 100 -4095.000 4096.000 BIT_MASK 0x1fff FORMAT "%8.3" ECU_ADDRESS 0x6000DF0C /end MEASUREMENT
/begin MEASUREMENT DINH_nrActvInhReas.FId_OilSwmpT_CmbdSnsrErr "Number of active inhibit reasons for the FIds / Number of active inhibit reasons for FId_OilSwmpT_CmbdSnsrErr" UWORD DINH_ct_Compu 1 100 -4095.000 4096.000 BIT_MASK 0x1fff FORMAT "%8.3" ECU_ADDRESS 0x6000DF0E /end MEASUREMENT
/begin MEASUREMENT DINH_nrActvInhReas.FId_OilSwmpT_CmbdSnsrTiTErr "Number of active inhibit reasons for the FIds / Number of active inhibit reasons for FId_OilSwmpT_CmbdSnsrTiTErr" UWORD DINH_ct_Compu 1 100 -4095.000 4096.000 BIT_MASK 0x1fff FORMAT "%8.3" ECU_ADDRESS 0x6000DF10 /end MEASUREMENT
/begin MEASUREMENT DINH_nrActvInhReas.FId_OilSwmpT_EnvT "Number of active inhibit reasons for the FIds / Number of active inhibit reasons for FId_OilSwmpT_EnvT" UWORD DINH_ct_Compu 1 100 -4095.000 4096.000 BIT_MASK 0x1fff FORMAT "%8.3" ECU_ADDRESS 0x6000DF12 /end MEASUREMENT
/begin MEASUREMENT DINH_nrActvInhReas.FId_OilSwmpT_TSnsrErr "Number of active inhibit reasons for the FIds / Number of active inhibit reasons for FId_OilSwmpT_TSnsrErr" UWORD DINH_ct_Compu 1 100 -4095.000 4096.000 BIT_MASK 0x1fff FORMAT "%8.3" ECU_ADDRESS 0x6000DF14 /end MEASUREMENT
/begin MEASUREMENT DINH_nrActvInhReas.FId_PEnvMeasVld "Number of active inhibit reasons for the FIds / Number of active inhibit reasons for FId_PEnvMeasVld" UWORD DINH_ct_Compu 1 100 -4095.000 4096.000 BIT_MASK 0x1fff FORMAT "%8.3" ECU_ADDRESS 0x6000DF16 /end MEASUREMENT
/begin MEASUREMENT DINH_nrActvInhReas.FId_PEnvModel "Number of active inhibit reasons for the FIds / Number of active inhibit reasons for FId_PEnvModel" UWORD DINH_ct_Compu 1 100 -4095.000 4096.000 BIT_MASK 0x1fff FORMAT "%8.3" ECU_ADDRESS 0x6000DF18 /end MEASUREMENT
/begin MEASUREMENT DINH_nrActvInhReas.FId_PEnvPlausDiagVDD "Number of active inhibit reasons for the FIds / Number of active inhibit reasons for FId_PEnvPlausDiagVDD" UWORD DINH_ct_Compu 1 100 -4095.000 4096.000 BIT_MASK 0x1fff FORMAT "%8.3" ECU_ADDRESS 0x6000DF1A /end MEASUREMENT
/begin MEASUREMENT DINH_nrActvInhReas.FId_PEnvRawVldVDD "Number of active inhibit reasons for the FIds / Number of active inhibit reasons for FId_PEnvRawVldVDD" UWORD DINH_ct_Compu 1 100 -4095.000 4096.000 BIT_MASK 0x1fff FORMAT "%8.3" ECU_ADDRESS 0x6000DF1C /end MEASUREMENT
/begin MEASUREMENT DINH_nrActvInhReas.FId_PEnvRefSnsr "Number of active inhibit reasons for the FIds / Number of active inhibit reasons for FId_PEnvRefSnsr" UWORD DINH_ct_Compu 1 100 -4095.000 4096.000 BIT_MASK 0x1fff FORMAT "%8.3" ECU_ADDRESS 0x6000DF1E /end MEASUREMENT
/begin MEASUREMENT DINH_nrActvInhReas.FId_PEnvSigRngVld "Number of active inhibit reasons for the FIds / Number of active inhibit reasons for FId_PEnvSigRngVld" UWORD DINH_ct_Compu 1 100 -4095.000 4096.000 BIT_MASK 0x1fff FORMAT "%8.3" ECU_ADDRESS 0x6000DF20 /end MEASUREMENT
/begin MEASUREMENT DINH_nrActvInhReas.FId_PEnvSnsrPlausVDD "Number of active inhibit reasons for the FIds / Number of active inhibit reasons for FId_PEnvSnsrPlausVDD" UWORD DINH_ct_Compu 1 100 -4095.000 4096.000 BIT_MASK 0x1fff FORMAT "%8.3" ECU_ADDRESS 0x6000DF22 /end MEASUREMENT
/begin MEASUREMENT DINH_nrActvInhReas.FId_PEnvVldVDD "Number of active inhibit reasons for the FIds / Number of active inhibit reasons for FId_PEnvVldVDD" UWORD DINH_ct_Compu 1 100 -4095.000 4096.000 BIT_MASK 0x1fff FORMAT "%8.3" ECU_ADDRESS 0x6000DF24 /end MEASUREMENT
/begin MEASUREMENT DINH_nrActvInhReas.FId_PIDA6SigSrcErr "Number of active inhibit reasons for the FIds / Number of active inhibit reasons for FId_PIDA6SigSrcErr" UWORD DINH_ct_Compu 1 100 -4095.000 4096.000 BIT_MASK 0x1fff FORMAT "%8.3" ECU_ADDRESS 0x6000DF26 /end MEASUREMENT
/begin MEASUREMENT DINH_nrActvInhReas.FId_PIntkMnfldPlaus "Number of active inhibit reasons for the FIds / Number of active inhibit reasons for FId_PIntkMnfldPlaus" UWORD DINH_ct_Compu 1 100 -4095.000 4096.000 BIT_MASK 0x1fff FORMAT "%8.3" ECU_ADDRESS 0x6000DF28 /end MEASUREMENT
/begin MEASUREMENT DINH_nrActvInhReas.FId_PIntkVUsElecDiagB1 "Number of active inhibit reasons for the FIds / Number of active inhibit reasons for FId_PIntkVUsElecDiagB1" UWORD DINH_ct_Compu 1 100 -4095.000 4096.000 BIT_MASK 0x1fff FORMAT "%8.3" ECU_ADDRESS 0x6000DF2A /end MEASUREMENT
/begin MEASUREMENT DINH_nrActvInhReas.FId_PSPCtlDisbl "Number of active inhibit reasons for the FIds / Number of active inhibit reasons for FId_PSPCtlDisbl" UWORD DINH_ct_Compu 1 100 -4095.000 4096.000 BIT_MASK 0x1fff FORMAT "%8.3" ECU_ADDRESS 0x6000DF2C /end MEASUREMENT
/begin MEASUREMENT DINH_nrActvInhReas.FId_PSPCtlPreRun "Number of active inhibit reasons for the FIds / Number of active inhibit reasons for FId_PSPCtlPreRun" UWORD DINH_ct_Compu 1 100 -4095.000 4096.000 BIT_MASK 0x1fff FORMAT "%8.3" ECU_ADDRESS 0x6000DF2E /end MEASUREMENT
/begin MEASUREMENT DINH_nrActvInhReas.FId_PSPDiagDisbl "Number of active inhibit reasons for the FIds / Number of active inhibit reasons for FId_PSPDiagDisbl" UWORD DINH_ct_Compu 1 100 -4095.000 4096.000 BIT_MASK 0x1fff FORMAT "%8.3" ECU_ADDRESS 0x6000DF30 /end MEASUREMENT
/begin MEASUREMENT DINH_nrActvInhReas.FId_PTGripConv "Number of active inhibit reasons for the FIds / Number of active inhibit reasons for FId_PTGripConv" UWORD DINH_ct_Compu 1 100 -4095.000 4096.000 BIT_MASK 0x1fff FORMAT "%8.3" ECU_ADDRESS 0x6000DF32 /end MEASUREMENT
/begin MEASUREMENT DINH_nrActvInhReas.FId_PTGripConvStrt "Number of active inhibit reasons for the FIds / Number of active inhibit reasons for FId_PTGripConvStrt" UWORD DINH_ct_Compu 1 100 -4095.000 4096.000 BIT_MASK 0x1fff FORMAT "%8.3" ECU_ADDRESS 0x6000DF34 /end MEASUREMENT
/begin MEASUREMENT DINH_nrActvInhReas.FId_PTGripMnlClth "Number of active inhibit reasons for the FIds / Number of active inhibit reasons for FId_PTGripMnlClth" UWORD DINH_ct_Compu 1 100 -4095.000 4096.000 BIT_MASK 0x1fff FORMAT "%8.3" ECU_ADDRESS 0x6000DF36 /end MEASUREMENT
/begin MEASUREMENT DINH_nrActvInhReas.FId_PTGripMnlClthStrt "Number of active inhibit reasons for the FIds / Number of active inhibit reasons for FId_PTGripMnlClthStrt" UWORD DINH_ct_Compu 1 100 -4095.000 4096.000 BIT_MASK 0x1fff FORMAT "%8.3" ECU_ADDRESS 0x6000DF38 /end MEASUREMENT
/begin MEASUREMENT DINH_nrActvInhReas.FId_PTTrqRatCANPtd "Number of active inhibit reasons for the FIds / Number of active inhibit reasons for FId_PTTrqRatCANPtd" UWORD DINH_ct_Compu 1 100 -4095.000 4096.000 BIT_MASK 0x1fff FORMAT "%8.3" ECU_ADDRESS 0x6000DF3A /end MEASUREMENT
/begin MEASUREMENT DINH_nrActvInhReas.FId_PThrVlVUsVldB1 "Number of active inhibit reasons for the FIds / Number of active inhibit reasons for FId_PThrVlVUsVldB1" UWORD DINH_ct_Compu 1 100 -4095.000 4096.000 BIT_MASK 0x1fff FORMAT "%8.3" ECU_ADDRESS 0x6000DF3C /end MEASUREMENT
/begin MEASUREMENT DINH_nrActvInhReas.FId_PThrVlvUsMeasdVldB1 "Number of active inhibit reasons for the FIds / Number of active inhibit reasons for FId_PThrVlvUsMeasdVldB1" UWORD DINH_ct_Compu 1 100 -4095.000 4096.000 BIT_MASK 0x1fff FORMAT "%8.3" ECU_ADDRESS 0x6000DF3E /end MEASUREMENT
/begin MEASUREMENT DINH_nrActvInhReas.FId_P_VSE11_Diag "Number of active inhibit reasons for the FIds / Number of active inhibit reasons for FId_P_VSE11_Diag" UWORD DINH_ct_Compu 1 100 -4095.000 4096.000 BIT_MASK 0x1fff FORMAT "%8.3" ECU_ADDRESS 0x6000DF40 /end MEASUREMENT
/begin MEASUREMENT DINH_nrActvInhReas.FId_PrmId03_FltRdnS1B1 "Number of active inhibit reasons for the FIds / Number of active inhibit reasons for FId_PrmId03_FltRdnS1B1" UWORD DINH_ct_Compu 1 100 -4095.000 4096.000 BIT_MASK 0x1fff FORMAT "%8.3" ECU_ADDRESS 0x6000DF42 /end MEASUREMENT
/begin MEASUREMENT DINH_nrActvInhReas.FId_PrmId03_FltUegoS1B1 "Number of active inhibit reasons for the FIds / Number of active inhibit reasons for FId_PrmId03_FltUegoS1B1" UWORD DINH_ct_Compu 1 100 -4095.000 4096.000 BIT_MASK 0x1fff FORMAT "%8.3" ECU_ADDRESS 0x6000DF44 /end MEASUREMENT
/begin MEASUREMENT DINH_nrActvInhReas.FId_SSEEPBRelease "Number of active inhibit reasons for the FIds / Number of active inhibit reasons for FId_SSEEPBRelease" UWORD DINH_ct_Compu 1 100 -4095.000 4096.000 BIT_MASK 0x1fff FORMAT "%8.3" ECU_ADDRESS 0x6000DF46 /end MEASUREMENT
/begin MEASUREMENT DINH_nrActvInhReas.FId_SSEFCANPRelease "Number of active inhibit reasons for the FIds / Number of active inhibit reasons for FId_SSEFCANPRelease" UWORD DINH_ct_Compu 1 100 -4095.000 4096.000 BIT_MASK 0x1fff FORMAT "%8.3" ECU_ADDRESS 0x6000DF48 /end MEASUREMENT
/begin MEASUREMENT DINH_nrActvInhReas.FId_SSEPTCANPRelease "Number of active inhibit reasons for the FIds / Number of active inhibit reasons for FId_SSEPTCANPRelease" UWORD DINH_ct_Compu 1 100 -4095.000 4096.000 BIT_MASK 0x1fff FORMAT "%8.3" ECU_ADDRESS 0x6000DF4A /end MEASUREMENT
/begin MEASUREMENT DINH_nrActvInhReas.FId_SSEStartRelease "Number of active inhibit reasons for the FIds / Number of active inhibit reasons for FId_SSEStartRelease" UWORD DINH_ct_Compu 1 100 -4095.000 4096.000 BIT_MASK 0x1fff FORMAT "%8.3" ECU_ADDRESS 0x6000DF4C /end MEASUREMENT
/begin MEASUREMENT DINH_nrActvInhReas.FId_SSEStartReleaseMTCl10 "Number of active inhibit reasons for the FIds / Number of active inhibit reasons for FId_SSEStartReleaseMTCl10" UWORD DINH_ct_Compu 1 100 -4095.000 4096.000 BIT_MASK 0x1fff FORMAT "%8.3" ECU_ADDRESS 0x6000DF4E /end MEASUREMENT
/begin MEASUREMENT DINH_nrActvInhReas.FId_SSEStartReleaseMTCl100 "Number of active inhibit reasons for the FIds / Number of active inhibit reasons for FId_SSEStartReleaseMTCl100" UWORD DINH_ct_Compu 1 100 -4095.000 4096.000 BIT_MASK 0x1fff FORMAT "%8.3" ECU_ADDRESS 0x6000DF50 /end MEASUREMENT
/begin MEASUREMENT DINH_nrActvInhReas.FId_SSEStartReleaseMTCl20 "Number of active inhibit reasons for the FIds / Number of active inhibit reasons for FId_SSEStartReleaseMTCl20" UWORD DINH_ct_Compu 1 100 -4095.000 4096.000 BIT_MASK 0x1fff FORMAT "%8.3" ECU_ADDRESS 0x6000DF52 /end MEASUREMENT
/begin MEASUREMENT DINH_nrActvInhReas.FId_SSEStartReleaseMTCl90 "Number of active inhibit reasons for the FIds / Number of active inhibit reasons for FId_SSEStartReleaseMTCl90" UWORD DINH_ct_Compu 1 100 -4095.000 4096.000 BIT_MASK 0x1fff FORMAT "%8.3" ECU_ADDRESS 0x6000DF54 /end MEASUREMENT
/begin MEASUREMENT DINH_nrActvInhReas.FId_SSEStartRequest "Number of active inhibit reasons for the FIds / Number of active inhibit reasons for FId_SSEStartRequest" UWORD DINH_ct_Compu 1 100 -4095.000 4096.000 BIT_MASK 0x1fff FORMAT "%8.3" ECU_ADDRESS 0x6000DF56 /end MEASUREMENT
/begin MEASUREMENT DINH_nrActvInhReas.FId_SSEStopRelease "Number of active inhibit reasons for the FIds / Number of active inhibit reasons for FId_SSEStopRelease" UWORD DINH_ct_Compu 1 100 -4095.000 4096.000 BIT_MASK 0x1fff FORMAT "%8.3" ECU_ADDRESS 0x6000DF58 /end MEASUREMENT
/begin MEASUREMENT DINH_nrActvInhReas.FId_SSEStrtStopRelease "Number of active inhibit reasons for the FIds / Number of active inhibit reasons for FId_SSEStrtStopRelease" UWORD DINH_ct_Compu 1 100 -4095.000 4096.000 BIT_MASK 0x1fff FORMAT "%8.3" ECU_ADDRESS 0x6000DF5A /end MEASUREMENT
/begin MEASUREMENT DINH_nrActvInhReas.FId_SSESysOff "Number of active inhibit reasons for the FIds / Number of active inhibit reasons for FId_SSESysOff" UWORD DINH_ct_Compu 1 100 -4095.000 4096.000 BIT_MASK 0x1fff FORMAT "%8.3" ECU_ADDRESS 0x6000DF5C /end MEASUREMENT
/begin MEASUREMENT DINH_nrActvInhReas.FId_SSEUI2DCSysFailr "Number of active inhibit reasons for the FIds / Number of active inhibit reasons for FId_SSEUI2DCSysFailr" UWORD DINH_ct_Compu 1 100 -4095.000 4096.000 BIT_MASK 0x1fff FORMAT "%8.3" ECU_ADDRESS 0x6000DF5E /end MEASUREMENT
/begin MEASUREMENT DINH_nrActvInhReas.FId_SSEUIBCANErr "Number of active inhibit reasons for the FIds / Number of active inhibit reasons for FId_SSEUIBCANErr" UWORD DINH_ct_Compu 1 100 -4095.000 4096.000 BIT_MASK 0x1fff FORMAT "%8.3" ECU_ADDRESS 0x6000DF60 /end MEASUREMENT
/begin MEASUREMENT DINH_nrActvInhReas.FId_SSEUISysFail "Number of active inhibit reasons for the FIds / Number of active inhibit reasons for FId_SSEUISysFail" UWORD DINH_ct_Compu 1 100 -4095.000 4096.000 BIT_MASK 0x1fff FORMAT "%8.3" ECU_ADDRESS 0x6000DF62 /end MEASUREMENT
/begin MEASUREMENT DINH_nrActvInhReas.FId_SiaEEPErr "Number of active inhibit reasons for the FIds / Number of active inhibit reasons for FId_SiaEEPErr" UWORD DINH_ct_Compu 1 100 -4095.000 4096.000 BIT_MASK 0x1fff FORMAT "%8.3" ECU_ADDRESS 0x6000DF64 /end MEASUREMENT
/begin MEASUREMENT DINH_nrActvInhReas.FId_StrtCrkSnsrFailr "Number of active inhibit reasons for the FIds / Number of active inhibit reasons for FId_StrtCrkSnsrFailr" UWORD DINH_ct_Compu 1 100 -4095.000 4096.000 BIT_MASK 0x1fff FORMAT "%8.3" ECU_ADDRESS 0x6000DF66 /end MEASUREMENT
/begin MEASUREMENT DINH_nrActvInhReas.FId_StrtCtlAutoCrkModeCdn "Number of active inhibit reasons for the FIds / Number of active inhibit reasons for FId_StrtCtlAutoCrkModeCdn" UWORD DINH_ct_Compu 1 100 -4095.000 4096.000 BIT_MASK 0x1fff FORMAT "%8.3" ECU_ADDRESS 0x6000DF68 /end MEASUREMENT
/begin MEASUREMENT DINH_nrActvInhReas.FId_StrtCtlComEngStrtErr "Number of active inhibit reasons for the FIds / Number of active inhibit reasons for FId_StrtCtlComEngStrtErr" UWORD DINH_ct_Compu 1 100 -4095.000 4096.000 BIT_MASK 0x1fff FORMAT "%8.3" ECU_ADDRESS 0x6000DF6A /end MEASUREMENT
/begin MEASUREMENT DINH_nrActvInhReas.FId_StrtCtlNPCdnCncl "Number of active inhibit reasons for the FIds / Number of active inhibit reasons for FId_StrtCtlNPCdnCncl" UWORD DINH_ct_Compu 1 100 -4095.000 4096.000 BIT_MASK 0x1fff FORMAT "%8.3" ECU_ADDRESS 0x6000DF6C /end MEASUREMENT
/begin MEASUREMENT DINH_nrActvInhReas.FId_StrtCtlNoCpuFailr "Number of active inhibit reasons for the FIds / Number of active inhibit reasons for FId_StrtCtlNoCpuFailr" UWORD DINH_ct_Compu 1 100 -4095.000 4096.000 BIT_MASK 0x1fff FORMAT "%8.3" ECU_ADDRESS 0x6000DF6E /end MEASUREMENT
/begin MEASUREMENT DINH_nrActvInhReas.FId_StrtCtlNoFailCanLine "Number of active inhibit reasons for the FIds / Number of active inhibit reasons for FId_StrtCtlNoFailCanLine" UWORD DINH_ct_Compu 1 100 -4095.000 4096.000 BIT_MASK 0x1fff FORMAT "%8.3" ECU_ADDRESS 0x6000DF70 /end MEASUREMENT
/begin MEASUREMENT DINH_nrActvInhReas.FId_StrtCtlNoFailPTCanLine "Number of active inhibit reasons for the FIds / Number of active inhibit reasons for FId_StrtCtlNoFailPTCanLine" UWORD DINH_ct_Compu 1 100 -4095.000 4096.000 BIT_MASK 0x1fff FORMAT "%8.3" ECU_ADDRESS 0x6000DF72 /end MEASUREMENT
/begin MEASUREMENT DINH_nrActvInhReas.FId_StrtCtlNoTCUFail "Number of active inhibit reasons for the FIds / Number of active inhibit reasons for FId_StrtCtlNoTCUFail" UWORD DINH_ct_Compu 1 100 -4095.000 4096.000 BIT_MASK 0x1fff FORMAT "%8.3" ECU_ADDRESS 0x6000DF74 /end MEASUREMENT
/begin MEASUREMENT DINH_nrActvInhReas.FId_StrtCtlPNPosnSubsVal "Number of active inhibit reasons for the FIds / Number of active inhibit reasons for FId_StrtCtlPNPosnSubsVal" UWORD DINH_ct_Compu 1 100 -4095.000 4096.000 BIT_MASK 0x1fff FORMAT "%8.3" ECU_ADDRESS 0x6000DF76 /end MEASUREMENT
/begin MEASUREMENT DINH_nrActvInhReas.FId_StrtCtlSTMFailr "Number of active inhibit reasons for the FIds / Number of active inhibit reasons for FId_StrtCtlSTMFailr" UWORD DINH_ct_Compu 1 100 -4095.000 4096.000 BIT_MASK 0x1fff FORMAT "%8.3" ECU_ADDRESS 0x6000DF78 /end MEASUREMENT
/begin MEASUREMENT DINH_nrActvInhReas.FId_StrtErrShaft "Number of active inhibit reasons for the FIds / Number of active inhibit reasons for FId_StrtErrShaft" UWORD DINH_ct_Compu 1 100 -4095.000 4096.000 BIT_MASK 0x1fff FORMAT "%8.3" ECU_ADDRESS 0x6000DF7A /end MEASUREMENT
/begin MEASUREMENT DINH_nrActvInhReas.FId_StrtrRlyFailr "Number of active inhibit reasons for the FIds / Number of active inhibit reasons for FId_StrtrRlyFailr" UWORD DINH_ct_Compu 1 100 -4095.000 4096.000 BIT_MASK 0x1fff FORMAT "%8.3" ECU_ADDRESS 0x6000DF7C /end MEASUREMENT
/begin MEASUREMENT DINH_nrActvInhReas.FId_SumErrHndlg "Number of active inhibit reasons for the FIds / Number of active inhibit reasons for FId_SumErrHndlg" UWORD DINH_ct_Compu 1 100 -4095.000 4096.000 BIT_MASK 0x1fff FORMAT "%8.3" ECU_ADDRESS 0x6000DF7E /end MEASUREMENT
/begin MEASUREMENT DINH_nrActvInhReas.FId_SysDiagComErr "Number of active inhibit reasons for the FIds / Number of active inhibit reasons for FId_SysDiagComErr" UWORD DINH_ct_Compu 1 100 -4095.000 4096.000 BIT_MASK 0x1fff FORMAT "%8.3" ECU_ADDRESS 0x6000DF80 /end MEASUREMENT
/begin MEASUREMENT DINH_nrActvInhReas.FId_SysDiagModInhbErr "Number of active inhibit reasons for the FIds / Number of active inhibit reasons for FId_SysDiagModInhbErr" UWORD DINH_ct_Compu 1 100 -4095.000 4096.000 BIT_MASK 0x1fff FORMAT "%8.3" ECU_ADDRESS 0x6000DF82 /end MEASUREMENT
/begin MEASUREMENT DINH_nrActvInhReas.FId_TOSPM "Number of active inhibit reasons for the FIds / Number of active inhibit reasons for FId_TOSPM" UWORD DINH_ct_Compu 1 100 -4095.000 4096.000 BIT_MASK 0x1fff FORMAT "%8.3" ECU_ADDRESS 0x6000DF84 /end MEASUREMENT
/begin MEASUREMENT DINH_nrActvInhReas.FId_TWCCILckExtd "Number of active inhibit reasons for the FIds / Number of active inhibit reasons for FId_TWCCILckExtd" UWORD DINH_ct_Compu 1 100 -4095.000 4096.000 BIT_MASK 0x1fff FORMAT "%8.3" ECU_ADDRESS 0x6000DF86 /end MEASUREMENT
/begin MEASUREMENT DINH_nrActvInhReas.FId_TWCCIRstB1 "Number of active inhibit reasons for the FIds / Number of active inhibit reasons for FId_TWCCIRstB1" UWORD DINH_ct_Compu 1 100 -4095.000 4096.000 BIT_MASK 0x1fff FORMAT "%8.3" ECU_ADDRESS 0x6000DF88 /end MEASUREMENT
/begin MEASUREMENT DINH_nrActvInhReas.FId_TWCCIRstDSMClearB1 "Number of active inhibit reasons for the FIds / Number of active inhibit reasons for FId_TWCCIRstDSMClearB1" UWORD DINH_ct_Compu 1 100 -4095.000 4096.000 BIT_MASK 0x1fff FORMAT "%8.3" ECU_ADDRESS 0x6000DF8A /end MEASUREMENT
/begin MEASUREMENT DINH_nrActvInhReas.FId_TWCCLsuB1 "Number of active inhibit reasons for the FIds / Number of active inhibit reasons for FId_TWCCLsuB1" UWORD DINH_ct_Compu 1 100 -4095.000 4096.000 BIT_MASK 0x1fff FORMAT "%8.3" ECU_ADDRESS 0x6000DF8C /end MEASUREMENT
/begin MEASUREMENT DINH_nrActvInhReas.FId_TWCCLsuCyc "Number of active inhibit reasons for the FIds / Number of active inhibit reasons for FId_TWCCLsuCyc" UWORD DINH_ct_Compu 1 100 -4095.000 4096.000 BIT_MASK 0x1fff FORMAT "%8.3" ECU_ADDRESS 0x6000DF8E /end MEASUREMENT
/begin MEASUREMENT DINH_nrActvInhReas.FId_TWCCLsuDynB1 "Number of active inhibit reasons for the FIds / Number of active inhibit reasons for FId_TWCCLsuDynB1" UWORD DINH_ct_Compu 1 100 -4095.000 4096.000 BIT_MASK 0x1fff FORMAT "%8.3" ECU_ADDRESS 0x6000DF90 /end MEASUREMENT
/begin MEASUREMENT DINH_nrActvInhReas.FId_TWCCMisfDetn "Number of active inhibit reasons for the FIds / Number of active inhibit reasons for FId_TWCCMisfDetn" UWORD DINH_ct_Compu 1 100 -4095.000 4096.000 BIT_MASK 0x1fff FORMAT "%8.3" ECU_ADDRESS 0x6000DF92 /end MEASUREMENT
/begin MEASUREMENT DINH_nrActvInhReas.FId_TWCDPriCatParB1 "Number of active inhibit reasons for the FIds / Number of active inhibit reasons for FId_TWCDPriCatParB1" UWORD DINH_ct_Compu 1 100 -4095.000 4096.000 BIT_MASK 0x1fff FORMAT "%8.3" ECU_ADDRESS 0x6000DF94 /end MEASUREMENT
/begin MEASUREMENT DINH_nrActvInhReas.FId_TWCDPriCatVldnB1 "Number of active inhibit reasons for the FIds / Number of active inhibit reasons for FId_TWCDPriCatVldnB1" UWORD DINH_ct_Compu 1 100 -4095.000 4096.000 BIT_MASK 0x1fff FORMAT "%8.3" ECU_ADDRESS 0x6000DF96 /end MEASUREMENT
/begin MEASUREMENT DINH_nrActvInhReas.FId_ThrVlvMon "Number of active inhibit reasons for the FIds / Number of active inhibit reasons for FId_ThrVlvMon" UWORD DINH_ct_Compu 1 100 -4095.000 4096.000 BIT_MASK 0x1fff FORMAT "%8.3" ECU_ADDRESS 0x6000DF98 /end MEASUREMENT
/begin MEASUREMENT DINH_nrActvInhReas.FId_ThrVlvOffsLrnPrmsB1 "Number of active inhibit reasons for the FIds / Number of active inhibit reasons for FId_ThrVlvOffsLrnPrmsB1" UWORD DINH_ct_Compu 1 100 -4095.000 4096.000 BIT_MASK 0x1fff FORMAT "%8.3" ECU_ADDRESS 0x6000DF9A /end MEASUREMENT
/begin MEASUREMENT DINH_nrActvInhReas.FId_TiOffTBasdChkFast "Number of active inhibit reasons for the FIds / Number of active inhibit reasons for FId_TiOffTBasdChkFast" UWORD DINH_ct_Compu 1 100 -4095.000 4096.000 BIT_MASK 0x1fff FORMAT "%8.3" ECU_ADDRESS 0x6000DF9C /end MEASUREMENT
/begin MEASUREMENT DINH_nrActvInhReas.FId_TiOffTBasdChkSlow "Number of active inhibit reasons for the FIds / Number of active inhibit reasons for FId_TiOffTBasdChkSlow" UWORD DINH_ct_Compu 1 100 -4095.000 4096.000 BIT_MASK 0x1fff FORMAT "%8.3" ECU_ADDRESS 0x6000DF9E /end MEASUREMENT
/begin MEASUREMENT DINH_nrActvInhReas.FId_TiOffVdClk "Number of active inhibit reasons for the FIds / Number of active inhibit reasons for FId_TiOffVdClk" UWORD DINH_ct_Compu 1 100 -4095.000 4096.000 BIT_MASK 0x1fff FORMAT "%8.3" ECU_ADDRESS 0x6000DFA0 /end MEASUREMENT
/begin MEASUREMENT DINH_nrActvInhReas.FId_TqDecelOffsInhb "Number of active inhibit reasons for the FIds / Number of active inhibit reasons for FId_TqDecelOffsInhb" UWORD DINH_ct_Compu 1 100 -4095.000 4096.000 BIT_MASK 0x1fff FORMAT "%8.3" ECU_ADDRESS 0x6000DFA2 /end MEASUREMENT
/begin MEASUREMENT DINH_nrActvInhReas.FId_TraAddAirCANPtd "Number of active inhibit reasons for the FIds / Number of active inhibit reasons for FId_TraAddAirCANPtd" UWORD DINH_ct_Compu 1 100 -4095.000 4096.000 BIT_MASK 0x1fff FORMAT "%8.3" ECU_ADDRESS 0x6000DFA4 /end MEASUREMENT
/begin MEASUREMENT DINH_nrActvInhReas.FId_TraAddClntCANPtd "Number of active inhibit reasons for the FIds / Number of active inhibit reasons for FId_TraAddClntCANPtd" UWORD DINH_ct_Compu 1 100 -4095.000 4096.000 BIT_MASK 0x1fff FORMAT "%8.3" ECU_ADDRESS 0x6000DFA6 /end MEASUREMENT
/begin MEASUREMENT DINH_nrActvInhReas.FId_TraFwdRvsCluInfo "Number of active inhibit reasons for the FIds / Number of active inhibit reasons for FId_TraFwdRvsCluInfo" UWORD DINH_ct_Compu 1 100 -4095.000 4096.000 BIT_MASK 0x1fff FORMAT "%8.3" ECU_ADDRESS 0x6000DFA8 /end MEASUREMENT
/begin MEASUREMENT DINH_nrActvInhReas.FId_TraGbxNPos "Number of active inhibit reasons for the FIds / Number of active inhibit reasons for FId_TraGbxNPos" UWORD DINH_ct_Compu 1 100 -4095.000 4096.000 BIT_MASK 0x1fff FORMAT "%8.3" ECU_ADDRESS 0x6000DFAA /end MEASUREMENT
/begin MEASUREMENT DINH_nrActvInhReas.FId_TraGearInfoCanCom "Number of active inhibit reasons for the FIds / Number of active inhibit reasons for FId_TraGearInfoCanCom" UWORD DINH_ct_Compu 1 100 -4095.000 4096.000 BIT_MASK 0x1fff FORMAT "%8.3" ECU_ADDRESS 0x6000DFAC /end MEASUREMENT
/begin MEASUREMENT DINH_nrActvInhReas.FId_TraGearInfoDet "Number of active inhibit reasons for the FIds / Number of active inhibit reasons for FId_TraGearInfoDet" UWORD DINH_ct_Compu 1 100 -4095.000 4096.000 BIT_MASK 0x1fff FORMAT "%8.3" ECU_ADDRESS 0x6000DFAE /end MEASUREMENT
/begin MEASUREMENT DINH_nrActvInhReas.FId_TraGearInfoGearShftActv "Number of active inhibit reasons for the FIds / Number of active inhibit reasons for FId_TraGearInfoGearShftActv" UWORD DINH_ct_Compu 1 100 -4095.000 4096.000 BIT_MASK 0x1fff FORMAT "%8.3" ECU_ADDRESS 0x6000DFB0 /end MEASUREMENT
/begin MEASUREMENT DINH_nrActvInhReas.FId_TraGearInfoInfoCan "Number of active inhibit reasons for the FIds / Number of active inhibit reasons for FId_TraGearInfoInfoCan" UWORD DINH_ct_Compu 1 100 -4095.000 4096.000 BIT_MASK 0x1fff FORMAT "%8.3" ECU_ADDRESS 0x6000DFB2 /end MEASUREMENT
/begin MEASUREMENT DINH_nrActvInhReas.FId_TraGearInfoLevPos "Number of active inhibit reasons for the FIds / Number of active inhibit reasons for FId_TraGearInfoLevPos" UWORD DINH_ct_Compu 1 100 -4095.000 4096.000 BIT_MASK 0x1fff FORMAT "%8.3" ECU_ADDRESS 0x6000DFB4 /end MEASUREMENT
/begin MEASUREMENT DINH_nrActvInhReas.FId_TraGearInfoLoRng "Number of active inhibit reasons for the FIds / Number of active inhibit reasons for FId_TraGearInfoLoRng" UWORD DINH_ct_Compu 1 100 -4095.000 4096.000 BIT_MASK 0x1fff FORMAT "%8.3" ECU_ADDRESS 0x6000DFB6 /end MEASUREMENT
/begin MEASUREMENT DINH_nrActvInhReas.FId_TraGearInfoRTra "Number of active inhibit reasons for the FIds / Number of active inhibit reasons for FId_TraGearInfoRTra" UWORD DINH_ct_Compu 1 100 -4095.000 4096.000 BIT_MASK 0x1fff FORMAT "%8.3" ECU_ADDRESS 0x6000DFB8 /end MEASUREMENT
/begin MEASUREMENT DINH_nrActvInhReas.FId_TraGearInfoRevGear "Number of active inhibit reasons for the FIds / Number of active inhibit reasons for FId_TraGearInfoRevGear" UWORD DINH_ct_Compu 1 100 -4095.000 4096.000 BIT_MASK 0x1fff FORMAT "%8.3" ECU_ADDRESS 0x6000DFBA /end MEASUREMENT
/begin MEASUREMENT DINH_nrActvInhReas.FId_TraGearReq "Number of active inhibit reasons for the FIds / Number of active inhibit reasons for FId_TraGearReq" UWORD DINH_ct_Compu 1 100 -4095.000 4096.000 BIT_MASK 0x1fff FORMAT "%8.3" ECU_ADDRESS 0x6000DFBC /end MEASUREMENT
/begin MEASUREMENT DINH_nrActvInhReas.FId_TraNoShftIdctr "Number of active inhibit reasons for the FIds / Number of active inhibit reasons for FId_TraNoShftIdctr" UWORD DINH_ct_Compu 1 100 -4095.000 4096.000 BIT_MASK 0x1fff FORMAT "%8.3" ECU_ADDRESS 0x6000DFBE /end MEASUREMENT
/begin MEASUREMENT DINH_nrActvInhReas.FId_TraPrtGearCANPtd "Number of active inhibit reasons for the FIds / Number of active inhibit reasons for FId_TraPrtGearCANPtd" UWORD DINH_ct_Compu 1 100 -4095.000 4096.000 BIT_MASK 0x1fff FORMAT "%8.3" ECU_ADDRESS 0x6000DFC0 /end MEASUREMENT
/begin MEASUREMENT DINH_nrActvInhReas.FId_TraPrtGearIndpdtProblem "Number of active inhibit reasons for the FIds / Number of active inhibit reasons for FId_TraPrtGearIndpdtProblem" UWORD DINH_ct_Compu 1 100 -4095.000 4096.000 BIT_MASK 0x1fff FORMAT "%8.3" ECU_ADDRESS 0x6000DFC2 /end MEASUREMENT
/begin MEASUREMENT DINH_nrActvInhReas.FId_TraRPosn "Number of active inhibit reasons for the FIds / Number of active inhibit reasons for FId_TraRPosn" UWORD DINH_ct_Compu 1 100 -4095.000 4096.000 BIT_MASK 0x1fff FORMAT "%8.3" ECU_ADDRESS 0x6000DFC4 /end MEASUREMENT
/begin MEASUREMENT DINH_nrActvInhReas.FId_TraRtnIntfcASTIntv "Number of active inhibit reasons for the FIds / Number of active inhibit reasons for FId_TraRtnIntfcASTIntv" UWORD DINH_ct_Compu 1 100 -4095.000 4096.000 BIT_MASK 0x1fff FORMAT "%8.3" ECU_ADDRESS 0x6000DFC6 /end MEASUREMENT
/begin MEASUREMENT DINH_nrActvInhReas.FId_TraRtnIntfcIdlSetP "Number of active inhibit reasons for the FIds / Number of active inhibit reasons for FId_TraRtnIntfcIdlSetP" UWORD DINH_ct_Compu 1 100 -4095.000 4096.000 BIT_MASK 0x1fff FORMAT "%8.3" ECU_ADDRESS 0x6000DFC8 /end MEASUREMENT
/begin MEASUREMENT DINH_nrActvInhReas.FId_TraRtnIntfcNMaxCan "Number of active inhibit reasons for the FIds / Number of active inhibit reasons for FId_TraRtnIntfcNMaxCan" UWORD DINH_ct_Compu 1 100 -4095.000 4096.000 BIT_MASK 0x1fff FORMAT "%8.3" ECU_ADDRESS 0x6000DFCA /end MEASUREMENT
/begin MEASUREMENT DINH_nrActvInhReas.FId_TraRtnIntfcNMaxVel "Number of active inhibit reasons for the FIds / Number of active inhibit reasons for FId_TraRtnIntfcNMaxVel" UWORD DINH_ct_Compu 1 100 -4095.000 4096.000 BIT_MASK 0x1fff FORMAT "%8.3" ECU_ADDRESS 0x6000DFCC /end MEASUREMENT
/begin MEASUREMENT DINH_nrActvInhReas.FId_TraTrqRedLmpHmeDec "Number of active inhibit reasons for the FIds / Number of active inhibit reasons for FId_TraTrqRedLmpHmeDec" UWORD DINH_ct_Compu 1 100 -4095.000 4096.000 BIT_MASK 0x1fff FORMAT "%8.3" ECU_ADDRESS 0x6000DFCE /end MEASUREMENT
/begin MEASUREMENT DINH_nrActvInhReas.FId_TraTrqRedLmpHmeInc "Number of active inhibit reasons for the FIds / Number of active inhibit reasons for FId_TraTrqRedLmpHmeInc" UWORD DINH_ct_Compu 1 100 -4095.000 4096.000 BIT_MASK 0x1fff FORMAT "%8.3" ECU_ADDRESS 0x6000DFD0 /end MEASUREMENT
/begin MEASUREMENT DINH_nrActvInhReas.FId_TraTrqRedPTCanErr "Number of active inhibit reasons for the FIds / Number of active inhibit reasons for FId_TraTrqRedPTCanErr" UWORD DINH_ct_Compu 1 100 -4095.000 4096.000 BIT_MASK 0x1fff FORMAT "%8.3" ECU_ADDRESS 0x6000DFD2 /end MEASUREMENT
/begin MEASUREMENT DINH_nrActvInhReas.FId_TraTrqRedTIIntvDes "Number of active inhibit reasons for the FIds / Number of active inhibit reasons for FId_TraTrqRedTIIntvDes" UWORD DINH_ct_Compu 1 100 -4095.000 4096.000 BIT_MASK 0x1fff FORMAT "%8.3" ECU_ADDRESS 0x6000DFD4 /end MEASUREMENT
/begin MEASUREMENT DINH_nrActvInhReas.FId_TraTrqRedTIIntvLead "Number of active inhibit reasons for the FIds / Number of active inhibit reasons for FId_TraTrqRedTIIntvLead" UWORD DINH_ct_Compu 1 100 -4095.000 4096.000 BIT_MASK 0x1fff FORMAT "%8.3" ECU_ADDRESS 0x6000DFD6 /end MEASUREMENT
/begin MEASUREMENT DINH_nrActvInhReas.FId_TraTrqRedTSCIntvDes "Number of active inhibit reasons for the FIds / Number of active inhibit reasons for FId_TraTrqRedTSCIntvDes" UWORD DINH_ct_Compu 1 100 -4095.000 4096.000 BIT_MASK 0x1fff FORMAT "%8.3" ECU_ADDRESS 0x6000DFD8 /end MEASUREMENT
/begin MEASUREMENT DINH_nrActvInhReas.FId_TraTrqRedTSCIntvLead "Number of active inhibit reasons for the FIds / Number of active inhibit reasons for FId_TraTrqRedTSCIntvLead" UWORD DINH_ct_Compu 1 100 -4095.000 4096.000 BIT_MASK 0x1fff FORMAT "%8.3" ECU_ADDRESS 0x6000DFDA /end MEASUREMENT
/begin MEASUREMENT DINH_nrActvInhReas.FId_TraTrsmTypHw "Number of active inhibit reasons for the FIds / Number of active inhibit reasons for FId_TraTrsmTypHw" UWORD DINH_ct_Compu 1 100 -4095.000 4096.000 BIT_MASK 0x1fff FORMAT "%8.3" ECU_ADDRESS 0x6000DFDC /end MEASUREMENT
/begin MEASUREMENT DINH_nrActvInhReas.FId_TranIdleDes "Number of active inhibit reasons for the FIds / Number of active inhibit reasons for FId_TranIdleDes" UWORD DINH_ct_Compu 1 100 -4095.000 4096.000 BIT_MASK 0x1fff FORMAT "%8.3" ECU_ADDRESS 0x6000DFDE /end MEASUREMENT
/begin MEASUREMENT DINH_nrActvInhReas.FId_UEGODiagRelsS1B1 "Number of active inhibit reasons for the FIds / Number of active inhibit reasons for FId_UEGODiagRelsS1B1" UWORD DINH_ct_Compu 1 100 -4095.000 4096.000 BIT_MASK 0x1fff FORMAT "%8.3" ECU_ADDRESS 0x6000DFE0 /end MEASUREMENT
/begin MEASUREMENT DINH_nrActvInhReas.FId_UEGOHeatrLrgTWinS1B1 "Number of active inhibit reasons for the FIds / Number of active inhibit reasons for FId_UEGOHeatrLrgTWinS1B1" UWORD DINH_ct_Compu 1 100 -4095.000 4096.000 BIT_MASK 0x1fff FORMAT "%8.3" ECU_ADDRESS 0x6000DFE2 /end MEASUREMENT
/begin MEASUREMENT DINH_nrActvInhReas.FId_UEGOHeatrPwrStgDiagRelsS1B1 "Number of active inhibit reasons for the FIds / Number of active inhibit reasons for FId_UEGOHeatrPwrStgDiagRelsS1B1" UWORD DINH_ct_Compu 1 100 -4095.000 4096.000 BIT_MASK 0x1fff FORMAT "%8.3" ECU_ADDRESS 0x6000DFE4 /end MEASUREMENT
/begin MEASUREMENT DINH_nrActvInhReas.FId_UEGOHeatrPwrStgDiagRelsSCBS1B1 "Number of active inhibit reasons for the FIds / Number of active inhibit reasons for FId_UEGOHeatrPwrStgDiagRelsSCBS1B1" UWORD DINH_ct_Compu 1 100 -4095.000 4096.000 BIT_MASK 0x1fff FORMAT "%8.3" ECU_ADDRESS 0x6000DFE6 /end MEASUREMENT
/begin MEASUREMENT DINH_nrActvInhReas.FId_UEGOHtrCtlOffS1B1 "Number of active inhibit reasons for the FIds / Number of active inhibit reasons for FId_UEGOHtrCtlOffS1B1" UWORD DINH_ct_Compu 1 100 -4095.000 4096.000 BIT_MASK 0x1fff FORMAT "%8.3" ECU_ADDRESS 0x6000DFE8 /end MEASUREMENT
/begin MEASUREMENT DINH_nrActvInhReas.FId_UEGOHtrCtlRedS1B1 "Number of active inhibit reasons for the FIds / Number of active inhibit reasons for FId_UEGOHtrCtlRedS1B1" UWORD DINH_ct_Compu 1 100 -4095.000 4096.000 BIT_MASK 0x1fff FORMAT "%8.3" ECU_ADDRESS 0x6000DFEA /end MEASUREMENT
/begin MEASUREMENT DINH_nrActvInhReas.FId_UEGOHtrCtlStopS1B1 "Number of active inhibit reasons for the FIds / Number of active inhibit reasons for FId_UEGOHtrCtlStopS1B1" UWORD DINH_ct_Compu 1 100 -4095.000 4096.000 BIT_MASK 0x1fff FORMAT "%8.3" ECU_ADDRESS 0x6000DFEC /end MEASUREMENT
/begin MEASUREMENT DINH_nrActvInhReas.FId_UEGOHtrCtlUpS1B1 "Number of active inhibit reasons for the FIds / Number of active inhibit reasons for FId_UEGOHtrCtlUpS1B1" UWORD DINH_ct_Compu 1 100 -4095.000 4096.000 BIT_MASK 0x1fff FORMAT "%8.3" ECU_ADDRESS 0x6000DFEE /end MEASUREMENT
/begin MEASUREMENT DINH_nrActvInhReas.FId_UEGOIPmpEvlnRelsS1B1 "Number of active inhibit reasons for the FIds / Number of active inhibit reasons for FId_UEGOIPmpEvlnRelsS1B1" UWORD DINH_ct_Compu 1 100 -4095.000 4096.000 BIT_MASK 0x1fff FORMAT "%8.3" ECU_ADDRESS 0x6000DFF0 /end MEASUREMENT
/begin MEASUREMENT DINH_nrActvInhReas.FId_UEGOIPmpTCorrnS1B1 "Number of active inhibit reasons for the FIds / Number of active inhibit reasons for FId_UEGOIPmpTCorrnS1B1" UWORD DINH_ct_Compu 1 100 -4095.000 4096.000 BIT_MASK 0x1fff FORMAT "%8.3" ECU_ADDRESS 0x6000DFF2 /end MEASUREMENT
/begin MEASUREMENT DINH_nrActvInhReas.FId_UEGOIPmpTRelsS1B1 "Number of active inhibit reasons for the FIds / Number of active inhibit reasons for FId_UEGOIPmpTRelsS1B1" UWORD DINH_ct_Compu 1 100 -4095.000 4096.000 BIT_MASK 0x1fff FORMAT "%8.3" ECU_ADDRESS 0x6000DFF4 /end MEASUREMENT
/begin MEASUREMENT DINH_nrActvInhReas.FId_UEGOLamRecprMdlRelsS1B1 "Number of active inhibit reasons for the FIds / Number of active inhibit reasons for FId_UEGOLamRecprMdlRelsS1B1" UWORD DINH_ct_Compu 1 100 -4095.000 4096.000 BIT_MASK 0x1fff FORMAT "%8.3" ECU_ADDRESS 0x6000DFF6 /end MEASUREMENT
/begin MEASUREMENT DINH_nrActvInhReas.FId_UEGOLamRelsAltvS1B1 "Number of active inhibit reasons for the FIds / Number of active inhibit reasons for FId_UEGOLamRelsAltvS1B1" UWORD DINH_ct_Compu 1 100 -4095.000 4096.000 BIT_MASK 0x1fff FORMAT "%8.3" ECU_ADDRESS 0x6000DFF8 /end MEASUREMENT
/begin MEASUREMENT DINH_nrActvInhReas.FId_UEGOLamRelsS1B1 "Number of active inhibit reasons for the FIds / Number of active inhibit reasons for FId_UEGOLamRelsS1B1" UWORD DINH_ct_Compu 1 100 -4095.000 4096.000 BIT_MASK 0x1fff FORMAT "%8.3" ECU_ADDRESS 0x6000DFFA /end MEASUREMENT
/begin MEASUREMENT DINH_nrActvInhReas.FId_UEGOLoDiagS1B1 "Number of active inhibit reasons for the FIds / Number of active inhibit reasons for FId_UEGOLoDiagS1B1" UWORD DINH_ct_Compu 1 100 -4095.000 4096.000 BIT_MASK 0x1fff FORMAT "%8.3" ECU_ADDRESS 0x6000DFFC /end MEASUREMENT
/begin MEASUREMENT DINH_nrActvInhReas.FId_UEGOPrmntDiagS1B1 "Number of active inhibit reasons for the FIds / Number of active inhibit reasons for FId_UEGOPrmntDiagS1B1" UWORD DINH_ct_Compu 1 100 -4095.000 4096.000 BIT_MASK 0x1fff FORMAT "%8.3" ECU_ADDRESS 0x6000DFFE /end MEASUREMENT
/begin MEASUREMENT DINH_nrActvInhReas.FId_UEGOStrtDiagRprtErrS1B1 "Number of active inhibit reasons for the FIds / Number of active inhibit reasons for FId_UEGOStrtDiagRprtErrS1B1" UWORD DINH_ct_Compu 1 100 -4095.000 4096.000 BIT_MASK 0x1fff FORMAT "%8.3" ECU_ADDRESS 0x6000E000 /end MEASUREMENT
/begin MEASUREMENT DINH_nrActvInhReas.FId_UEGOStrtDiagS1B1 "Number of active inhibit reasons for the FIds / Number of active inhibit reasons for FId_UEGOStrtDiagS1B1" UWORD DINH_ct_Compu 1 100 -4095.000 4096.000 BIT_MASK 0x1fff FORMAT "%8.3" ECU_ADDRESS 0x6000E002 /end MEASUREMENT
/begin MEASUREMENT DINH_nrActvInhReas.FId_UEGOTEvlnRelsS1B1 "Number of active inhibit reasons for the FIds / Number of active inhibit reasons for FId_UEGOTEvlnRelsS1B1" UWORD DINH_ct_Compu 1 100 -4095.000 4096.000 BIT_MASK 0x1fff FORMAT "%8.3" ECU_ADDRESS 0x6000E004 /end MEASUREMENT
/begin MEASUREMENT DINH_nrActvInhReas.FId_UegoInhbOperRelsS1B1 "Number of active inhibit reasons for the FIds / Number of active inhibit reasons for FId_UegoInhbOperRelsS1B1" UWORD DINH_ct_Compu 1 100 -4095.000 4096.000 BIT_MASK 0x1fff FORMAT "%8.3" ECU_ADDRESS 0x6000E006 /end MEASUREMENT
/begin MEASUREMENT DINH_nrActvInhReas.FId_UegoIntrptCdnOperRelsPreEngStrt "Number of active inhibit reasons for the FIds / Number of active inhibit reasons for FId_UegoIntrptCdnOperRelsPreEngStrt" UWORD DINH_ct_Compu 1 100 -4095.000 4096.000 BIT_MASK 0x1fff FORMAT "%8.3" ECU_ADDRESS 0x6000E008 /end MEASUREMENT
/begin MEASUREMENT DINH_nrActvInhReas.FId_UegoPlausErrHndlg "Number of active inhibit reasons for the FIds / Number of active inhibit reasons for FId_UegoPlausErrHndlg" UWORD DINH_ct_Compu 1 100 -4095.000 4096.000 BIT_MASK 0x1fff FORMAT "%8.3" ECU_ADDRESS 0x6000E00A /end MEASUREMENT
/begin MEASUREMENT DINH_nrActvInhReas.FId_UegoSigAvailS1B1 "Number of active inhibit reasons for the FIds / Number of active inhibit reasons for FId_UegoSigAvailS1B1" UWORD DINH_ct_Compu 1 100 -4095.000 4096.000 BIT_MASK 0x1fff FORMAT "%8.3" ECU_ADDRESS 0x6000E00C /end MEASUREMENT
/begin MEASUREMENT DINH_nrActvInhReas.FId_VMSIDCSRmpShOff "Number of active inhibit reasons for the FIds / Number of active inhibit reasons for FId_VMSIDCSRmpShOff" UWORD DINH_ct_Compu 1 100 -4095.000 4096.000 BIT_MASK 0x1fff FORMAT "%8.3" ECU_ADDRESS 0x6000E00E /end MEASUREMENT
/begin MEASUREMENT DINH_nrActvInhReas.FId_VMSIDCSShOff "Number of active inhibit reasons for the FIds / Number of active inhibit reasons for FId_VMSIDCSShOff" UWORD DINH_ct_Compu 1 100 -4095.000 4096.000 BIT_MASK 0x1fff FORMAT "%8.3" ECU_ADDRESS 0x6000E010 /end MEASUREMENT
/begin MEASUREMENT DINH_nrActvInhReas.FId_VMSITCSRmpShOff "Number of active inhibit reasons for the FIds / Number of active inhibit reasons for FId_VMSITCSRmpShOff" UWORD DINH_ct_Compu 1 100 -4095.000 4096.000 BIT_MASK 0x1fff FORMAT "%8.3" ECU_ADDRESS 0x6000E012 /end MEASUREMENT
/begin MEASUREMENT DINH_nrActvInhReas.FId_VMSITCSShOff "Number of active inhibit reasons for the FIds / Number of active inhibit reasons for FId_VMSITCSShOff" UWORD DINH_ct_Compu 1 100 -4095.000 4096.000 BIT_MASK 0x1fff FORMAT "%8.3" ECU_ADDRESS 0x6000E014 /end MEASUREMENT
/begin MEASUREMENT DINH_nrActvInhReas.FId_VSACANErr "Number of active inhibit reasons for the FIds / Number of active inhibit reasons for FId_VSACANErr" UWORD DINH_ct_Compu 1 100 -4095.000 4096.000 BIT_MASK 0x1fff FORMAT "%8.3" ECU_ADDRESS 0x6000E016 /end MEASUREMENT
/begin MEASUREMENT DINH_nrActvInhReas.FId_VehStcDCDCFailr "Number of active inhibit reasons for the FIds / Number of active inhibit reasons for FId_VehStcDCDCFailr" UWORD DINH_ct_Compu 1 100 -4095.000 4096.000 BIT_MASK 0x1fff FORMAT "%8.3" ECU_ADDRESS 0x6000E018 /end MEASUREMENT
/begin MEASUREMENT DINH_nrActvInhReas.FId_VehStcMisf "Number of active inhibit reasons for the FIds / Number of active inhibit reasons for FId_VehStcMisf" UWORD DINH_ct_Compu 1 100 -4095.000 4096.000 BIT_MASK 0x1fff FORMAT "%8.3" ECU_ADDRESS 0x6000E01A /end MEASUREMENT
/begin MEASUREMENT DINH_nrActvInhReas.FId_VehVCANFrzVal "Number of active inhibit reasons for the FIds / Number of active inhibit reasons for FId_VehVCANFrzVal" UWORD DINH_ct_Compu 1 100 -4095.000 4096.000 BIT_MASK 0x1fff FORMAT "%8.3" ECU_ADDRESS 0x6000E01C /end MEASUREMENT
/begin MEASUREMENT DINH_nrActvInhReas.FId_VehVCANReplVal "Number of active inhibit reasons for the FIds / Number of active inhibit reasons for FId_VehVCANReplVal" UWORD DINH_ct_Compu 1 100 -4095.000 4096.000 BIT_MASK 0x1fff FORMAT "%8.3" ECU_ADDRESS 0x6000E01E /end MEASUREMENT
/begin MEASUREMENT DINH_nrActvInhReas.FId_VehVCanSafeFrzVal "Number of active inhibit reasons for the FIds / Number of active inhibit reasons for FId_VehVCanSafeFrzVal" UWORD DINH_ct_Compu 1 100 -4095.000 4096.000 BIT_MASK 0x1fff FORMAT "%8.3" ECU_ADDRESS 0x6000E020 /end MEASUREMENT
/begin MEASUREMENT DINH_nrActvInhReas.FId_VehVCanSafeReplVal "Number of active inhibit reasons for the FIds / Number of active inhibit reasons for FId_VehVCanSafeReplVal" UWORD DINH_ct_Compu 1 100 -4095.000 4096.000 BIT_MASK 0x1fff FORMAT "%8.3" ECU_ADDRESS 0x6000E022 /end MEASUREMENT
/begin MEASUREMENT DINH_nrActvInhReas.FId_VehVExcdLim "Number of active inhibit reasons for the FIds / Number of active inhibit reasons for FId_VehVExcdLim" UWORD DINH_ct_Compu 1 100 -4095.000 4096.000 BIT_MASK 0x1fff FORMAT "%8.3" ECU_ADDRESS 0x6000E024 /end MEASUREMENT
/begin MEASUREMENT DINH_nrActvInhReas.FId_VehVFrzVal "Number of active inhibit reasons for the FIds / Number of active inhibit reasons for FId_VehVFrzVal" UWORD DINH_ct_Compu 1 100 -4095.000 4096.000 BIT_MASK 0x1fff FORMAT "%8.3" ECU_ADDRESS 0x6000E026 /end MEASUREMENT
/begin MEASUREMENT DINH_nrActvInhReas.FId_VehVNCSnsrElecFailr "Number of active inhibit reasons for the FIds / Number of active inhibit reasons for FId_VehVNCSnsrElecFailr" UWORD DINH_ct_Compu 1 100 -4095.000 4096.000 BIT_MASK 0x1fff FORMAT "%8.3" ECU_ADDRESS 0x6000E028 /end MEASUREMENT
/begin MEASUREMENT DINH_nrActvInhReas.FId_VehVOBDFrzVal "Number of active inhibit reasons for the FIds / Number of active inhibit reasons for FId_VehVOBDFrzVal" UWORD DINH_ct_Compu 1 100 -4095.000 4096.000 BIT_MASK 0x1fff FORMAT "%8.3" ECU_ADDRESS 0x6000E02A /end MEASUREMENT
/begin MEASUREMENT DINH_nrActvInhReas.FId_VehVOBDReplVal "Number of active inhibit reasons for the FIds / Number of active inhibit reasons for FId_VehVOBDReplVal" UWORD DINH_ct_Compu 1 100 -4095.000 4096.000 BIT_MASK 0x1fff FORMAT "%8.3" ECU_ADDRESS 0x6000E02C /end MEASUREMENT
/begin MEASUREMENT DINH_nrActvInhReas.FId_VehVOutCanErr "Number of active inhibit reasons for the FIds / Number of active inhibit reasons for FId_VehVOutCanErr" UWORD DINH_ct_Compu 1 100 -4095.000 4096.000 BIT_MASK 0x1fff FORMAT "%8.3" ECU_ADDRESS 0x6000E02E /end MEASUREMENT
/begin MEASUREMENT DINH_nrActvInhReas.FId_VehVPWMFrzVal "Number of active inhibit reasons for the FIds / Number of active inhibit reasons for FId_VehVPWMFrzVal" UWORD DINH_ct_Compu 1 100 -4095.000 4096.000 BIT_MASK 0x1fff FORMAT "%8.3" ECU_ADDRESS 0x6000E030 /end MEASUREMENT
/begin MEASUREMENT DINH_nrActvInhReas.FId_VehVPWMReplVal "Number of active inhibit reasons for the FIds / Number of active inhibit reasons for FId_VehVPWMReplVal" UWORD DINH_ct_Compu 1 100 -4095.000 4096.000 BIT_MASK 0x1fff FORMAT "%8.3" ECU_ADDRESS 0x6000E032 /end MEASUREMENT
/begin MEASUREMENT DINH_nrActvInhReas.FId_VehVPhysRng "Number of active inhibit reasons for the FIds / Number of active inhibit reasons for FId_VehVPhysRng" UWORD DINH_ct_Compu 1 100 -4095.000 4096.000 BIT_MASK 0x1fff FORMAT "%8.3" ECU_ADDRESS 0x6000E034 /end MEASUREMENT
/begin MEASUREMENT DINH_nrActvInhReas.FId_VehVPlaus "Number of active inhibit reasons for the FIds / Number of active inhibit reasons for FId_VehVPlaus" UWORD DINH_ct_Compu 1 100 -4095.000 4096.000 BIT_MASK 0x1fff FORMAT "%8.3" ECU_ADDRESS 0x6000E036 /end MEASUREMENT
/begin MEASUREMENT DINH_nrActvInhReas.FId_VehVPlausCan "Number of active inhibit reasons for the FIds / Number of active inhibit reasons for FId_VehVPlausCan" UWORD DINH_ct_Compu 1 100 -4095.000 4096.000 BIT_MASK 0x1fff FORMAT "%8.3" ECU_ADDRESS 0x6000E038 /end MEASUREMENT
/begin MEASUREMENT DINH_nrActvInhReas.FId_VehVPlausFco "Number of active inhibit reasons for the FIds / Number of active inhibit reasons for FId_VehVPlausFco" UWORD DINH_ct_Compu 1 100 -4095.000 4096.000 BIT_MASK 0x1fff FORMAT "%8.3" ECU_ADDRESS 0x6000E03A /end MEASUREMENT
/begin MEASUREMENT DINH_nrActvInhReas.FId_VehVPlausPwr "Number of active inhibit reasons for the FIds / Number of active inhibit reasons for FId_VehVPlausPwr" UWORD DINH_ct_Compu 1 100 -4095.000 4096.000 BIT_MASK 0x1fff FORMAT "%8.3" ECU_ADDRESS 0x6000E03C /end MEASUREMENT
/begin MEASUREMENT DINH_nrActvInhReas.FId_VehVPlausV2N "Number of active inhibit reasons for the FIds / Number of active inhibit reasons for FId_VehVPlausV2N" UWORD DINH_ct_Compu 1 100 -4095.000 4096.000 BIT_MASK 0x1fff FORMAT "%8.3" ECU_ADDRESS 0x6000E03E /end MEASUREMENT
/begin MEASUREMENT DINH_nrActvInhReas.FId_VehVReplVal "Number of active inhibit reasons for the FIds / Number of active inhibit reasons for FId_VehVReplVal" UWORD DINH_ct_Compu 1 100 -4095.000 4096.000 BIT_MASK 0x1fff FORMAT "%8.3" ECU_ADDRESS 0x6000E040 /end MEASUREMENT
/begin MEASUREMENT DINH_nrActvInhReas.FId_VehVSigCan "Number of active inhibit reasons for the FIds / Number of active inhibit reasons for FId_VehVSigCan" UWORD DINH_ct_Compu 1 100 -4095.000 4096.000 BIT_MASK 0x1fff FORMAT "%8.3" ECU_ADDRESS 0x6000E042 /end MEASUREMENT
/begin MEASUREMENT DINH_nrActvInhReas.FId_VehVSigCanSafe "Number of active inhibit reasons for the FIds / Number of active inhibit reasons for FId_VehVSigCanSafe" UWORD DINH_ct_Compu 1 100 -4095.000 4096.000 BIT_MASK 0x1fff FORMAT "%8.3" ECU_ADDRESS 0x6000E044 /end MEASUREMENT
/begin MEASUREMENT DINH_nrActvInhReas.FId_VehVSnsrARngHi "Number of active inhibit reasons for the FIds / Number of active inhibit reasons for FId_VehVSnsrARngHi" UWORD DINH_ct_Compu 1 100 -4095.000 4096.000 BIT_MASK 0x1fff FORMAT "%8.3" ECU_ADDRESS 0x6000E046 /end MEASUREMENT
/begin MEASUREMENT DINH_nrActvInhReas.FId_VehVSnsrBRngHi "Number of active inhibit reasons for the FIds / Number of active inhibit reasons for FId_VehVSnsrBRngHi" UWORD DINH_ct_Compu 1 100 -4095.000 4096.000 BIT_MASK 0x1fff FORMAT "%8.3" ECU_ADDRESS 0x6000E048 /end MEASUREMENT
/begin MEASUREMENT DINH_nrActvInhReas.FId_VehVSpdRtyDiag "Number of active inhibit reasons for the FIds / Number of active inhibit reasons for FId_VehVSpdRtyDiag" UWORD DINH_ct_Compu 1 100 -4095.000 4096.000 BIT_MASK 0x1fff FORMAT "%8.3" ECU_ADDRESS 0x6000E04A /end MEASUREMENT
/begin MEASUREMENT DINH_nrActvInhReas.FId_VehVSpdSnsrAElecFailr "Number of active inhibit reasons for the FIds / Number of active inhibit reasons for FId_VehVSpdSnsrAElecFailr" UWORD DINH_ct_Compu 1 100 -4095.000 4096.000 BIT_MASK 0x1fff FORMAT "%8.3" ECU_ADDRESS 0x6000E04C /end MEASUREMENT
/begin MEASUREMENT DINH_nrActvInhReas.FId_VehVSpdSnsrBElecFailr "Number of active inhibit reasons for the FIds / Number of active inhibit reasons for FId_VehVSpdSnsrBElecFailr" UWORD DINH_ct_Compu 1 100 -4095.000 4096.000 BIT_MASK 0x1fff FORMAT "%8.3" ECU_ADDRESS 0x6000E04E /end MEASUREMENT
/begin MEASUREMENT DINH_nrActvInhReas.FId_VehVWhlErrDet "Number of active inhibit reasons for the FIds / Number of active inhibit reasons for FId_VehVWhlErrDet" UWORD DINH_ct_Compu 1 100 -4095.000 4096.000 BIT_MASK 0x1fff FORMAT "%8.3" ECU_ADDRESS 0x6000E050 /end MEASUREMENT
/begin MEASUREMENT DINH_nrActvInhReas.FId_VldtLamDynS1B1 "Number of active inhibit reasons for the FIds / Number of active inhibit reasons for FId_VldtLamDynS1B1" UWORD DINH_ct_Compu 1 100 -4095.000 4096.000 BIT_MASK 0x1fff FORMAT "%8.3" ECU_ADDRESS 0x6000E052 /end MEASUREMENT
/begin MEASUREMENT DINH_nrActvInhReas.FId_VlvLftFbIntkOilPSnsr11SRC "Number of active inhibit reasons for the FIds / Number of active inhibit reasons for FId_VlvLftFbIntkOilPSnsr11SRC" UWORD DINH_ct_Compu 1 100 -4095.000 4096.000 BIT_MASK 0x1fff FORMAT "%8.3" ECU_ADDRESS 0x6000E054 /end MEASUREMENT
/begin MEASUREMENT DINH_nrActvInhReas.FId_VlvLftFbSwtIntk11Diag "Number of active inhibit reasons for the FIds / Number of active inhibit reasons for FId_VlvLftFbSwtIntk11Diag" UWORD DINH_ct_Compu 1 100 -4095.000 4096.000 BIT_MASK 0x1fff FORMAT "%8.3" ECU_ADDRESS 0x6000E056 /end MEASUREMENT
/begin MEASUREMENT DINH_nrActvInhReas.FId_ZGLZSR "Number of active inhibit reasons for the FIds / Number of active inhibit reasons for FId_ZGLZSR" UWORD DINH_ct_Compu 1 100 -4095.000 4096.000 BIT_MASK 0x1fff FORMAT "%8.3" ECU_ADDRESS 0x6000E058 /end MEASUREMENT
/begin MEASUREMENT DINH_nrActvInhReas.FId_airIntkFltSnsrKnkPrtnIgn "Number of active inhibit reasons for the FIds / Number of active inhibit reasons for FId_airIntkFltSnsrKnkPrtnIgn" UWORD DINH_ct_Compu 1 100 -4095.000 4096.000 BIT_MASK 0x1fff FORMAT "%8.3" ECU_ADDRESS 0x6000E05A /end MEASUREMENT
/begin MEASUREMENT DINH_nrActvInhReas.FId_stChkChgnSys "Number of active inhibit reasons for the FIds / Number of active inhibit reasons for FId_stChkChgnSys" UWORD DINH_ct_Compu 1 100 -4095.000 4096.000 BIT_MASK 0x1fff FORMAT "%8.3" ECU_ADDRESS 0x6000E05C /end MEASUREMENT
/begin MEASUREMENT DINH_nrActvInhReas.FId_stChkChgnSys2DC "Number of active inhibit reasons for the FIds / Number of active inhibit reasons for FId_stChkChgnSys2DC" UWORD DINH_ct_Compu 1 100 -4095.000 4096.000 BIT_MASK 0x1fff FORMAT "%8.3" ECU_ADDRESS 0x6000E05E /end MEASUREMENT
/begin MEASUREMENT DINH_nrActvInhReas.FId_tFltSnsrKnkPrtnIgn "Number of active inhibit reasons for the FIds / Number of active inhibit reasons for FId_tFltSnsrKnkPrtnIgn" UWORD DINH_ct_Compu 1 100 -4095.000 4096.000 BIT_MASK 0x1fff FORMAT "%8.3" ECU_ADDRESS 0x6000E060 /end MEASUREMENT
/begin MEASUREMENT DINH_stClctFId_mp "Collected states of all function identifiers, if the bit is 1 the FId is inhibited" UWORD DFC_OneToOne 1 100 0.00 65535.00 FORMAT "%8.2" ARRAY_SIZE 46 ECU_ADDRESS 0x700088AE /end MEASUREMENT
/begin MEASUREMENT DINH_stFId.FId_Unused "Inhibit Status of FIds / " UWORD DFC_OneToOne 1 100 0.00 65535.00 FORMAT "%8.2" ECU_ADDRESS 0x6000DAA8 /end MEASUREMENT
/begin MEASUREMENT DINH_stFId.FID_AFRA "Inhibit Status of FIds / Status of function identifier FID_AFRA" UWORD DFC_OneToOne 1 100 0.00 65535.00 FORMAT "%8.2" ECU_ADDRESS 0x6000DAAA /end MEASUREMENT
/begin MEASUREMENT DINH_stFId.FID_AORA "Inhibit Status of FIds / Status of function identifier FID_AORA" UWORD DFC_OneToOne 1 100 0.00 65535.00 FORMAT "%8.2" ECU_ADDRESS 0x6000DAAC /end MEASUREMENT
/begin MEASUREMENT DINH_stFId.FID_ATEH "Inhibit Status of FIds / Status of function identifier FID_ATEH" UWORD DFC_OneToOne 1 100 0.00 65535.00 FORMAT "%8.2" ECU_ADDRESS 0x6000DAAE /end MEASUREMENT
/begin MEASUREMENT DINH_stFId.FID_ATEL "Inhibit Status of FIds / Status of function identifier FID_ATEL" UWORD DFC_OneToOne 1 100 0.00 65535.00 FORMAT "%8.2" ECU_ADDRESS 0x6000DAB0 /end MEASUREMENT
/begin MEASUREMENT DINH_stFId.FID_ATEN "Inhibit Status of FIds / Status of function identifier FID_ATEN" UWORD DFC_OneToOne 1 100 0.00 65535.00 FORMAT "%8.2" ECU_ADDRESS 0x6000DAB2 /end MEASUREMENT
/begin MEASUREMENT DINH_stFId.FId_EGSDCmnSeg1B1Parl "Inhibit Status of FIds / Status of function identifier FId_EGSDCmnSeg1B1Parl" UWORD DFC_OneToOne 1 100 0.00 65535.00 FORMAT "%8.2" ECU_ADDRESS 0x6000DAB4 /end MEASUREMENT
/begin MEASUREMENT DINH_stFId.FID_BLLRH "Inhibit Status of FIds / Status of function identifier FID_BLLRH" UWORD DFC_OneToOne 1 100 0.00 65535.00 FORMAT "%8.2" ECU_ADDRESS 0x6000DAB6 /end MEASUREMENT
/begin MEASUREMENT DINH_stFId.FID_BLLRKH "Inhibit Status of FIds / Status of function identifier FID_BLLRKH" UWORD DFC_OneToOne 1 100 0.00 65535.00 FORMAT "%8.2" ECU_ADDRESS 0x6000DAB8 /end MEASUREMENT
/begin MEASUREMENT DINH_stFId.FID_BPLSU "Inhibit Status of FIds / Status of function identifier FID_BPLSU" UWORD DFC_OneToOne 1 100 0.00 65535.00 FORMAT "%8.2" ECU_ADDRESS 0x6000DABA /end MEASUREMENT
/begin MEASUREMENT DINH_stFId.FId_CJ135RvsChrgMeasS1B1 "Inhibit Status of FIds / Status of function identifier FId_CJ135RvsChrgMeasS1B1" UWORD DFC_OneToOne 1 100 0.00 65535.00 FORMAT "%8.2" ECU_ADDRESS 0x6000DABC /end MEASUREMENT
/begin MEASUREMENT DINH_stFId.FId_CatHeatgColdStrtReq "Inhibit Status of FIds / Status of function identifier FId_CatHeatgColdStrtReq" UWORD DFC_OneToOne 1 100 0.00 65535.00 FORMAT "%8.2" ECU_ADDRESS 0x6000DABE /end MEASUREMENT
/begin MEASUREMENT DINH_stFId.FId_CatHeatgWrmReq "Inhibit Status of FIds / Status of function identifier FId_CatHeatgWrmReq" UWORD DFC_OneToOne 1 100 0.00 65535.00 FORMAT "%8.2" ECU_ADDRESS 0x6000DAC0 /end MEASUREMENT
/begin MEASUREMENT DINH_stFId.FId_EGSDO2SnsrMntdRelsS1B1 "Inhibit Status of FIds / Status of function identifier FId_EGSDO2SnsrMntdRelsS1B1" UWORD DFC_OneToOne 1 100 0.00 65535.00 FORMAT "%8.2" ECU_ADDRESS 0x6000DAC2 /end MEASUREMENT
/begin MEASUREMENT DINH_stFId.FId_EGSDO2_LamOffsFastS1B1 "Inhibit Status of FIds / Status of function identifier FId_EGSDO2_LamOffsFastS1B1" UWORD DFC_OneToOne 1 100 0.00 65535.00 FORMAT "%8.2" ECU_ADDRESS 0x6000DAC4 /end MEASUREMENT
/begin MEASUREMENT DINH_stFId.FId_MisfDetDnAdpnNv "Inhibit Status of FIds / Status of function identifier FId_MisfDetDnAdpnNv" UWORD DFC_OneToOne 1 100 0.00 65535.00 FORMAT "%8.2" ECU_ADDRESS 0x6000DAC6 /end MEASUREMENT
/begin MEASUREMENT DINH_stFId.FID_BGFKMS "Inhibit Status of FIds / Status of function identifier FID_BGFKMS" UWORD DFC_OneToOne 1 100 0.00 65535.00 FORMAT "%8.2" ECU_ADDRESS 0x6000DAC8 /end MEASUREMENT
/begin MEASUREMENT DINH_stFId.FID_CDSTTI "Inhibit Status of FIds / Status of function identifier FID_CDSTTI" UWORD DFC_OneToOne 1 100 0.00 65535.00 FORMAT "%8.2" ECU_ADDRESS 0x6000DACA /end MEASUREMENT
/begin MEASUREMENT DINH_stFId.FID_CETKHL "Inhibit Status of FIds / Status of function identifier FID_CETKHL" UWORD DFC_OneToOne 1 100 0.00 65535.00 FORMAT "%8.2" ECU_ADDRESS 0x6000DACC /end MEASUREMENT
/begin MEASUREMENT DINH_stFId.FID_CETKHT "Inhibit Status of FIds / Status of function identifier FID_CETKHT" UWORD DFC_OneToOne 1 100 0.00 65535.00 FORMAT "%8.2" ECU_ADDRESS 0x6000DACE /end MEASUREMENT
/begin MEASUREMENT DINH_stFId.FID_CGLSRDP "Inhibit Status of FIds / Status of function identifier FID_CGLSRDP" UWORD DFC_OneToOne 1 100 0.00 65535.00 FORMAT "%8.2" ECU_ADDRESS 0x6000DAD0 /end MEASUREMENT
/begin MEASUREMENT DINH_stFId.FID_CLLKHV "Inhibit Status of FIds / Status of function identifier FID_CLLKHV" UWORD DFC_OneToOne 1 100 0.00 65535.00 FORMAT "%8.2" ECU_ADDRESS 0x6000DAD2 /end MEASUREMENT
/begin MEASUREMENT DINH_stFId.FID_CLLRHV "Inhibit Status of FIds / Status of function identifier FID_CLLRHV" UWORD DFC_OneToOne 1 100 0.00 65535.00 FORMAT "%8.2" ECU_ADDRESS 0x6000DAD4 /end MEASUREMENT
/begin MEASUREMENT DINH_stFId.FID_CLZSRDP "Inhibit Status of FIds / Status of function identifier FID_CLZSRDP" UWORD DFC_OneToOne 1 100 0.00 65535.00 FORMAT "%8.2" ECU_ADDRESS 0x6000DAD6 /end MEASUREMENT
/begin MEASUREMENT DINH_stFId.FID_CNSAD "Inhibit Status of FIds / Status of function identifier FID_CNSAD" UWORD DFC_OneToOne 1 100 0.00 65535.00 FORMAT "%8.2" ECU_ADDRESS 0x6000DAD8 /end MEASUREMENT
/begin MEASUREMENT DINH_stFId.FID_CNSAD2 "Inhibit Status of FIds / Status of function identifier FID_CNSAD2" UWORD DFC_OneToOne 1 100 0.00 65535.00 FORMAT "%8.2" ECU_ADDRESS 0x6000DADA /end MEASUREMENT
/begin MEASUREMENT DINH_stFId.FID_CPFISTRT "Inhibit Status of FIds / Status of function identifier FID_CPFISTRT" UWORD DFC_OneToOne 1 100 0.00 65535.00 FORMAT "%8.2" ECU_ADDRESS 0x6000DADC /end MEASUREMENT
/begin MEASUREMENT DINH_stFId.FID_CPSRB "Inhibit Status of FIds / Status of function identifier FID_CPSRB" UWORD DFC_OneToOne 1 100 0.00 65535.00 FORMAT "%8.2" ECU_ADDRESS 0x6000DADE /end MEASUREMENT
/begin MEASUREMENT DINH_stFId.FID_CPSRP "Inhibit Status of FIds / Status of function identifier FID_CPSRP" UWORD DFC_OneToOne 1 100 0.00 65535.00 FORMAT "%8.2" ECU_ADDRESS 0x6000DAE0 /end MEASUREMENT
/begin MEASUREMENT DINH_stFId.FID_DKRSA "Inhibit Status of FIds / Status of function identifier FID_DKRSA" UWORD DFC_OneToOne 1 100 0.00 65535.00 FORMAT "%8.2" ECU_ADDRESS 0x6000DAE2 /end MEASUREMENT
/begin MEASUREMENT DINH_stFId.FID_DLLRBandEndTst "Inhibit Status of FIds / Status of function identifier FID_DLLRBandEndTst" UWORD DFC_OneToOne 1 100 0.00 65535.00 FORMAT "%8.2" ECU_ADDRESS 0x6000DAE4 /end MEASUREMENT
/begin MEASUREMENT DINH_stFId.FID_DLLRShrtTrpSpdRmp "Inhibit Status of FIds / Status of function identifier FID_DLLRShrtTrpSpdRmp" UWORD DFC_OneToOne 1 100 0.00 65535.00 FORMAT "%8.2" ECU_ADDRESS 0x6000DAE6 /end MEASUREMENT
/begin MEASUREMENT DINH_stFId.FID_FEDKAPB "Inhibit Status of FIds / Status of function identifier FID_FEDKAPB" UWORD DFC_OneToOne 1 100 0.00 65535.00 FORMAT "%8.2" ECU_ADDRESS 0x6000DAE8 /end MEASUREMENT
/begin MEASUREMENT DINH_stFId.FID_FEDSSB "Inhibit Status of FIds / Status of function identifier FID_FEDSSB" UWORD DFC_OneToOne 1 100 0.00 65535.00 FORMAT "%8.2" ECU_ADDRESS 0x6000DAEA /end MEASUREMENT
/begin MEASUREMENT DINH_stFId.FID_FOFSTP "Inhibit Status of FIds / Status of function identifier FID_FOFSTP" UWORD DFC_OneToOne 1 100 0.00 65535.00 FORMAT "%8.2" ECU_ADDRESS 0x6000DAEC /end MEASUREMENT
/begin MEASUREMENT DINH_stFId.FID_FONSTP "Inhibit Status of FIds / Status of function identifier FID_FONSTP" UWORD DFC_OneToOne 1 100 0.00 65535.00 FORMAT "%8.2" ECU_ADDRESS 0x6000DAEE /end MEASUREMENT
/begin MEASUREMENT DINH_stFId.FID_FUEDK "Inhibit Status of FIds / Status of function identifier FID_FUEDK" UWORD DFC_OneToOne 1 100 0.00 65535.00 FORMAT "%8.2" ECU_ADDRESS 0x6000DAF0 /end MEASUREMENT
/begin MEASUREMENT DINH_stFId.FID_LRADLSU "Inhibit Status of FIds / Status of function identifier FID_LRADLSU" UWORD DFC_OneToOne 1 100 0.00 65535.00 FORMAT "%8.2" ECU_ADDRESS 0x6000DAF2 /end MEASUREMENT
/begin MEASUREMENT DINH_stFId.FID_LRALSVErr "Inhibit Status of FIds / Status of function identifier FID_LRALSVErr" UWORD DFC_OneToOne 1 100 0.00 65535.00 FORMAT "%8.2" ECU_ADDRESS 0x6000DAF4 /end MEASUREMENT
/begin MEASUREMENT DINH_stFId.FID_LRAPLLSU "Inhibit Status of FIds / Status of function identifier FID_LRAPLLSU" UWORD DFC_OneToOne 1 100 0.00 65535.00 FORMAT "%8.2" ECU_ADDRESS 0x6000DAF6 /end MEASUREMENT
/begin MEASUREMENT DINH_stFId.FID_LUSTP "Inhibit Status of FIds / Status of function identifier FID_LUSTP" UWORD DFC_OneToOne 1 100 0.00 65535.00 FORMAT "%8.2" ECU_ADDRESS 0x6000DAF8 /end MEASUREMENT
/begin MEASUREMENT DINH_stFId.FID_LnKS1 "Inhibit Status of FIds / Status of function identifier FID_LnKS1" UWORD DFC_OneToOne 1 100 0.00 65535.00 FORMAT "%8.2" ECU_ADDRESS 0x6000DAFA /end MEASUREMENT
/begin MEASUREMENT DINH_stFId.FID_PLSUV "Inhibit Status of FIds / Status of function identifier FID_PLSUV" UWORD DFC_OneToOne 1 100 0.00 65535.00 FORMAT "%8.2" ECU_ADDRESS 0x6000DAFC /end MEASUREMENT
/begin MEASUREMENT DINH_stFId.FID_PSRMOZDG "Inhibit Status of FIds / Status of function identifier FID_PSRMOZDG" UWORD DFC_OneToOne 1 100 0.00 65535.00 FORMAT "%8.2" ECU_ADDRESS 0x6000DAFE /end MEASUREMENT
/begin MEASUREMENT DINH_stFId.FID_PSRMOZG "Inhibit Status of FIds / Status of function identifier FID_PSRMOZG" UWORD DFC_OneToOne 1 100 0.00 65535.00 FORMAT "%8.2" ECU_ADDRESS 0x6000DB00 /end MEASUREMENT
/begin MEASUREMENT DINH_stFId.FID_STRTDIA "Inhibit Status of FIds / Status of function identifier FID_STRTDIA" UWORD DFC_OneToOne 1 100 0.00 65535.00 FORMAT "%8.2" ECU_ADDRESS 0x6000DB02 /end MEASUREMENT
/begin MEASUREMENT DINH_stFId.FID_STRTSTM "Inhibit Status of FIds / Status of function identifier FID_STRTSTM" UWORD DFC_OneToOne 1 100 0.00 65535.00 FORMAT "%8.2" ECU_ADDRESS 0x6000DB04 /end MEASUREMENT
/begin MEASUREMENT DINH_stFId.FID_TFA1CSMW "Inhibit Status of FIds / Status of function identifier FID_TFA1CSMW" UWORD DFC_OneToOne 1 100 0.00 65535.00 FORMAT "%8.2" ECU_ADDRESS 0x6000DB06 /end MEASUREMENT
/begin MEASUREMENT DINH_stFId.FID_TKACSMW "Inhibit Status of FIds / Status of function identifier FID_TKACSMW" UWORD DFC_OneToOne 1 100 0.00 65535.00 FORMAT "%8.2" ECU_ADDRESS 0x6000DB08 /end MEASUREMENT
/begin MEASUREMENT DINH_stFId.FID_TMCSMW "Inhibit Status of FIds / Status of function identifier FID_TMCSMW" UWORD DFC_OneToOne 1 100 0.00 65535.00 FORMAT "%8.2" ECU_ADDRESS 0x6000DB0A /end MEASUREMENT
/begin MEASUREMENT DINH_stFId.FID_TOCHOilSwmpTQly "Inhibit Status of FIds / Status of function identifier FID_TOCHOilSwmpTQly" UWORD DFC_OneToOne 1 100 0.00 65535.00 FORMAT "%8.2" ECU_ADDRESS 0x6000DB0C /end MEASUREMENT
/begin MEASUREMENT DINH_stFId.FID_TOCHTME "Inhibit Status of FIds / Status of function identifier FID_TOCHTME" UWORD DFC_OneToOne 1 100 0.00 65535.00 FORMAT "%8.2" ECU_ADDRESS 0x6000DB0E /end MEASUREMENT
/begin MEASUREMENT DINH_stFId.FID_TOSPCSMW "Inhibit Status of FIds / Status of function identifier FID_TOSPCSMW" UWORD DFC_OneToOne 1 100 0.00 65535.00 FORMAT "%8.2" ECU_ADDRESS 0x6000DB10 /end MEASUREMENT
/begin MEASUREMENT DINH_stFId.FID_UEGOHeatrRlyS1B1 "Inhibit Status of FIds / Status of function identifier FID_UEGOHeatrRlyS1B1" UWORD DFC_OneToOne 1 100 0.00 65535.00 FORMAT "%8.2" ECU_ADDRESS 0x6000DB12 /end MEASUREMENT
/begin MEASUREMENT DINH_stFId.FID_VehStvSSEOk "Inhibit Status of FIds / Status of function identifier FID_VehStvSSEOk" UWORD DFC_OneToOne 1 100 0.00 65535.00 FORMAT "%8.2" ECU_ADDRESS 0x6000DB14 /end MEASUREMENT
/begin MEASUREMENT DINH_stFId.FID_VldtLamPlausMaxS1B1 "Inhibit Status of FIds / Status of function identifier FID_VldtLamPlausMaxS1B1" UWORD DFC_OneToOne 1 100 0.00 65535.00 FORMAT "%8.2" ECU_ADDRESS 0x6000DB16 /end MEASUREMENT
/begin MEASUREMENT DINH_stFId.FID_VldtLamPlausMinS1B1 "Inhibit Status of FIds / Status of function identifier FID_VldtLamPlausMinS1B1" UWORD DFC_OneToOne 1 100 0.00 65535.00 FORMAT "%8.2" ECU_ADDRESS 0x6000DB18 /end MEASUREMENT
/begin MEASUREMENT DINH_stFId.FId_ACClntPSSPMon "Inhibit Status of FIds / Status of function identifier FId_ACClntPSSPMon" UWORD DFC_OneToOne 1 100 0.00 65535.00 FORMAT "%8.2" ECU_ADDRESS 0x6000DB1A /end MEASUREMENT
/begin MEASUREMENT DINH_stFId.FId_ACCompComCANBusOff "Inhibit Status of FIds / Status of function identifier FId_ACCompComCANBusOff" UWORD DFC_OneToOne 1 100 0.00 65535.00 FORMAT "%8.2" ECU_ADDRESS 0x6000DB1C /end MEASUREMENT
/begin MEASUREMENT DINH_stFId.FId_ACCompComCANErrMtr "Inhibit Status of FIds / Status of function identifier FId_ACCompComCANErrMtr" UWORD DFC_OneToOne 1 100 0.00 65535.00 FORMAT "%8.2" ECU_ADDRESS 0x6000DB1E /end MEASUREMENT
/begin MEASUREMENT DINH_stFId.FId_ACComp_HiUTWSnsrErr "Inhibit Status of FIds / Status of function identifier FId_ACComp_HiUTWSnsrErr" UWORD DFC_OneToOne 1 100 0.00 65535.00 FORMAT "%8.2" ECU_ADDRESS 0x6000DB20 /end MEASUREMENT
/begin MEASUREMENT DINH_stFId.FId_ACComp_LoUTWSnsrErr "Inhibit Status of FIds / Status of function identifier FId_ACComp_LoUTWSnsrErr" UWORD DFC_OneToOne 1 100 0.00 65535.00 FORMAT "%8.2" ECU_ADDRESS 0x6000DB22 /end MEASUREMENT
/begin MEASUREMENT DINH_stFId.FId_ACComp_PDSnsrErr "Inhibit Status of FIds / Status of function identifier FId_ACComp_PDSnsrErr" UWORD DFC_OneToOne 1 100 0.00 65535.00 FORMAT "%8.2" ECU_ADDRESS 0x6000DB24 /end MEASUREMENT
/begin MEASUREMENT DINH_stFId.FId_ACComp_VehSpdSnsrErr "Inhibit Status of FIds / Status of function identifier FId_ACComp_VehSpdSnsrErr" UWORD DFC_OneToOne 1 100 0.00 65535.00 FORMAT "%8.2" ECU_ADDRESS 0x6000DB26 /end MEASUREMENT
/begin MEASUREMENT DINH_stFId.FId_ACCtl_ACStrtCut "Inhibit Status of FIds / Status of function identifier FId_ACCtl_ACStrtCut" UWORD DFC_OneToOne 1 100 0.00 65535.00 FORMAT "%8.2" ECU_ADDRESS 0x6000DB28 /end MEASUREMENT
/begin MEASUREMENT DINH_stFId.FId_ACCtl_APP1 "Inhibit Status of FIds / Status of function identifier FId_ACCtl_APP1" UWORD DFC_OneToOne 1 100 0.00 65535.00 FORMAT "%8.2" ECU_ADDRESS 0x6000DB2A /end MEASUREMENT
/begin MEASUREMENT DINH_stFId.FId_ACCtl_APP2 "Inhibit Status of FIds / Status of function identifier FId_ACCtl_APP2" UWORD DFC_OneToOne 1 100 0.00 65535.00 FORMAT "%8.2" ECU_ADDRESS 0x6000DB2C /end MEASUREMENT
/begin MEASUREMENT DINH_stFId.FId_ACCtl_APPSync "Inhibit Status of FIds / Status of function identifier FId_ACCtl_APPSync" UWORD DFC_OneToOne 1 100 0.00 65535.00 FORMAT "%8.2" ECU_ADDRESS 0x6000DB2E /end MEASUREMENT
/begin MEASUREMENT DINH_stFId.FId_ACCtl_AcOff "Inhibit Status of FIds / Status of function identifier FId_ACCtl_AcOff" UWORD DFC_OneToOne 1 100 0.00 65535.00 FORMAT "%8.2" ECU_ADDRESS 0x6000DB30 /end MEASUREMENT
/begin MEASUREMENT DINH_stFId.FId_ACCtl_Clmb "Inhibit Status of FIds / Status of function identifier FId_ACCtl_Clmb" UWORD DFC_OneToOne 1 100 0.00 65535.00 FORMAT "%8.2" ECU_ADDRESS 0x6000DB32 /end MEASUREMENT
/begin MEASUREMENT DINH_stFId.FId_ACCtl_DK1 "Inhibit Status of FIds / Status of function identifier FId_ACCtl_DK1" UWORD DFC_OneToOne 1 100 0.00 65535.00 FORMAT "%8.2" ECU_ADDRESS 0x6000DB34 /end MEASUREMENT
/begin MEASUREMENT DINH_stFId.FId_ACCtl_DK2 "Inhibit Status of FIds / Status of function identifier FId_ACCtl_DK2" UWORD DFC_OneToOne 1 100 0.00 65535.00 FORMAT "%8.2" ECU_ADDRESS 0x6000DB36 /end MEASUREMENT
/begin MEASUREMENT DINH_stFId.FId_ACCtl_DKSync "Inhibit Status of FIds / Status of function identifier FId_ACCtl_DKSync" UWORD DFC_OneToOne 1 100 0.00 65535.00 FORMAT "%8.2" ECU_ADDRESS 0x6000DB38 /end MEASUREMENT
/begin MEASUREMENT DINH_stFId.FId_ACCtl_VehSpdSnsrErr "Inhibit Status of FIds / Status of function identifier FId_ACCtl_VehSpdSnsrErr" UWORD DFC_OneToOne 1 100 0.00 65535.00 FORMAT "%8.2" ECU_ADDRESS 0x6000DB3A /end MEASUREMENT
/begin MEASUREMENT DINH_stFId.FId_ACCtl_pAC "Inhibit Status of FIds / Status of function identifier FId_ACCtl_pAC" UWORD DFC_OneToOne 1 100 0.00 65535.00 FORMAT "%8.2" ECU_ADDRESS 0x6000DB3C /end MEASUREMENT
/begin MEASUREMENT DINH_stFId.FId_ACEvpTCANErr "Inhibit Status of FIds / Status of function identifier FId_ACEvpTCANErr" UWORD DFC_OneToOne 1 100 0.00 65535.00 FORMAT "%8.2" ECU_ADDRESS 0x6000DB3E /end MEASUREMENT
/begin MEASUREMENT DINH_stFId.FId_ACEvpTFrzVal "Inhibit Status of FIds / Status of function identifier FId_ACEvpTFrzVal" UWORD DFC_OneToOne 1 100 0.00 65535.00 FORMAT "%8.2" ECU_ADDRESS 0x6000DB40 /end MEASUREMENT
/begin MEASUREMENT DINH_stFId.FId_ACEvpTRplVal "Inhibit Status of FIds / Status of function identifier FId_ACEvpTRplVal" UWORD DFC_OneToOne 1 100 0.00 65535.00 FORMAT "%8.2" ECU_ADDRESS 0x6000DB42 /end MEASUREMENT
/begin MEASUREMENT DINH_stFId.FId_APP1SigPath "Inhibit Status of FIds / Status of function identifier FId_APP1SigPath" UWORD DFC_OneToOne 1 100 0.00 65535.00 FORMAT "%8.2" ECU_ADDRESS 0x6000DB44 /end MEASUREMENT
/begin MEASUREMENT DINH_stFId.FId_APP2SigPath "Inhibit Status of FIds / Status of function identifier FId_APP2SigPath" UWORD DFC_OneToOne 1 100 0.00 65535.00 FORMAT "%8.2" ECU_ADDRESS 0x6000DB46 /end MEASUREMENT
/begin MEASUREMENT DINH_stFId.FId_APPBrkErr "Inhibit Status of FIds / Status of function identifier FId_APPBrkErr" UWORD DFC_OneToOne 1 100 0.00 65535.00 FORMAT "%8.2" ECU_ADDRESS 0x6000DB48 /end MEASUREMENT
/begin MEASUREMENT DINH_stFId.FId_APPLETVldnErr "Inhibit Status of FIds / Status of function identifier FId_APPLETVldnErr" UWORD DFC_OneToOne 1 100 0.00 65535.00 FORMAT "%8.2" ECU_ADDRESS 0x6000DB4A /end MEASUREMENT
/begin MEASUREMENT DINH_stFId.FId_APPLrn "Inhibit Status of FIds / Status of function identifier FId_APPLrn" UWORD DFC_OneToOne 1 100 0.00 65535.00 FORMAT "%8.2" ECU_ADDRESS 0x6000DB4C /end MEASUREMENT
/begin MEASUREMENT DINH_stFId.FId_APPVehVErr "Inhibit Status of FIds / Status of function identifier FId_APPVehVErr" UWORD DFC_OneToOne 1 100 0.00 65535.00 FORMAT "%8.2" ECU_ADDRESS 0x6000DB4E /end MEASUREMENT
/begin MEASUREMENT DINH_stFId.FId_AccPedDrvModComErr "Inhibit Status of FIds / Status of function identifier FId_AccPedDrvModComErr" UWORD DFC_OneToOne 1 100 0.00 65535.00 FORMAT "%8.2" ECU_ADDRESS 0x6000DB50 /end MEASUREMENT
/begin MEASUREMENT DINH_stFId.FId_AccPedDrvModFailr "Inhibit Status of FIds / Status of function identifier FId_AccPedDrvModFailr" UWORD DFC_OneToOne 1 100 0.00 65535.00 FORMAT "%8.2" ECU_ADDRESS 0x6000DB52 /end MEASUREMENT
/begin MEASUREMENT DINH_stFId.FId_AccPedNMaxLim "Inhibit Status of FIds / Status of function identifier FId_AccPedNMaxLim" UWORD DFC_OneToOne 1 100 0.00 65535.00 FORMAT "%8.2" ECU_ADDRESS 0x6000DB54 /end MEASUREMENT
/begin MEASUREMENT DINH_stFId.FId_AccPedNMinLim "Inhibit Status of FIds / Status of function identifier FId_AccPedNMinLim" UWORD DFC_OneToOne 1 100 0.00 65535.00 FORMAT "%8.2" ECU_ADDRESS 0x6000DB56 /end MEASUREMENT
/begin MEASUREMENT DINH_stFId.FId_AccPedNMinLimBrkApp "Inhibit Status of FIds / Status of function identifier FId_AccPedNMinLimBrkApp" UWORD DFC_OneToOne 1 100 0.00 65535.00 FORMAT "%8.2" ECU_ADDRESS 0x6000DB58 /end MEASUREMENT
/begin MEASUREMENT DINH_stFId.FId_AccPedTrqLim "Inhibit Status of FIds / Status of function identifier FId_AccPedTrqLim" UWORD DFC_OneToOne 1 100 0.00 65535.00 FORMAT "%8.2" ECU_ADDRESS 0x6000DB5A /end MEASUREMENT
/begin MEASUREMENT DINH_stFId.FId_AirCClntPFrzVal "Inhibit Status of FIds / Status of function identifier FId_AirCClntPFrzVal" UWORD DFC_OneToOne 1 100 0.00 65535.00 FORMAT "%8.2" ECU_ADDRESS 0x6000DB5C /end MEASUREMENT
/begin MEASUREMENT DINH_stFId.FId_AirCClntPRplVal "Inhibit Status of FIds / Status of function identifier FId_AirCClntPRplVal" UWORD DFC_OneToOne 1 100 0.00 65535.00 FORMAT "%8.2" ECU_ADDRESS 0x6000DB5E /end MEASUREMENT
/begin MEASUREMENT DINH_stFId.FId_AirCSwt "Inhibit Status of FIds / Status of function identifier FId_AirCSwt" UWORD DFC_OneToOne 1 100 0.00 65535.00 FORMAT "%8.2" ECU_ADDRESS 0x6000DB60 /end MEASUREMENT
/begin MEASUREMENT DINH_stFId.FId_AirDvPAdpnPEnv "Inhibit Status of FIds / Status of function identifier FId_AirDvPAdpnPEnv" UWORD DFC_OneToOne 1 100 0.00 65535.00 FORMAT "%8.2" ECU_ADDRESS 0x6000DB62 /end MEASUREMENT
/begin MEASUREMENT DINH_stFId.FId_AirDvPAdpnPIntkVUsB1 "Inhibit Status of FIds / Status of function identifier FId_AirDvPAdpnPIntkVUsB1" UWORD DFC_OneToOne 1 100 0.00 65535.00 FORMAT "%8.2" ECU_ADDRESS 0x6000DB64 /end MEASUREMENT
/begin MEASUREMENT DINH_stFId.FId_AirDvPPSnsrAdpn_PModeActv "Inhibit Status of FIds / Status of function identifier FId_AirDvPPSnsrAdpn_PModeActv" UWORD DFC_OneToOne 1 100 0.00 65535.00 FORMAT "%8.2" ECU_ADDRESS 0x6000DB66 /end MEASUREMENT
/begin MEASUREMENT DINH_stFId.FId_AltACGFailr "Inhibit Status of FIds / Status of function identifier FId_AltACGFailr" UWORD DFC_OneToOne 1 100 0.00 65535.00 FORMAT "%8.2" ECU_ADDRESS 0x6000DB68 /end MEASUREMENT
/begin MEASUREMENT DINH_stFId.FId_AltAPPErrSt "Inhibit Status of FIds / Status of function identifier FId_AltAPPErrSt" UWORD DFC_OneToOne 1 100 0.00 65535.00 FORMAT "%8.2" ECU_ADDRESS 0x6000DB6A /end MEASUREMENT
/begin MEASUREMENT DINH_stFId.FId_AltBattMngtFailr "Inhibit Status of FIds / Status of function identifier FId_AltBattMngtFailr" UWORD DFC_OneToOne 1 100 0.00 65535.00 FORMAT "%8.2" ECU_ADDRESS 0x6000DB6C /end MEASUREMENT
/begin MEASUREMENT DINH_stFId.FId_AltBrkErrSt "Inhibit Status of FIds / Status of function identifier FId_AltBrkErrSt" UWORD DFC_OneToOne 1 100 0.00 65535.00 FORMAT "%8.2" ECU_ADDRESS 0x6000DB6E /end MEASUREMENT
/begin MEASUREMENT DINH_stFId.FId_AltComErr "Inhibit Status of FIds / Status of function identifier FId_AltComErr" UWORD DFC_OneToOne 1 100 0.00 65535.00 FORMAT "%8.2" ECU_ADDRESS 0x6000DB70 /end MEASUREMENT
/begin MEASUREMENT DINH_stFId.FId_AltENGB "Inhibit Status of FIds / Status of function identifier FId_AltENGB" UWORD DFC_OneToOne 1 100 0.00 65535.00 FORMAT "%8.2" ECU_ADDRESS 0x6000DB72 /end MEASUREMENT
/begin MEASUREMENT DINH_stFId.FId_AltElecLoadErr "Inhibit Status of FIds / Status of function identifier FId_AltElecLoadErr" UWORD DFC_OneToOne 1 100 0.00 65535.00 FORMAT "%8.2" ECU_ADDRESS 0x6000DB74 /end MEASUREMENT
/begin MEASUREMENT DINH_stFId.FId_AltEnvTErr "Inhibit Status of FIds / Status of function identifier FId_AltEnvTErr" UWORD DFC_OneToOne 1 100 0.00 65535.00 FORMAT "%8.2" ECU_ADDRESS 0x6000DB76 /end MEASUREMENT
/begin MEASUREMENT DINH_stFId.FId_AltFFAltLoadFast "Inhibit Status of FIds / Status of function identifier FId_AltFFAltLoadFast" UWORD DFC_OneToOne 1 100 0.00 65535.00 FORMAT "%8.2" ECU_ADDRESS 0x6000DB78 /end MEASUREMENT
/begin MEASUREMENT DINH_stFId.FId_AltFFAltLoadSlow "Inhibit Status of FIds / Status of function identifier FId_AltFFAltLoadSlow" UWORD DFC_OneToOne 1 100 0.00 65535.00 FORMAT "%8.2" ECU_ADDRESS 0x6000DB7A /end MEASUREMENT
/begin MEASUREMENT DINH_stFId.FId_AltIOACGErr "Inhibit Status of FIds / Status of function identifier FId_AltIOACGErr" UWORD DFC_OneToOne 1 100 0.00 65535.00 FORMAT "%8.2" ECU_ADDRESS 0x6000DB7C /end MEASUREMENT
/begin MEASUREMENT DINH_stFId.FId_AltIOACGLinComFailr "Inhibit Status of FIds / Status of function identifier FId_AltIOACGLinComFailr" UWORD DFC_OneToOne 1 100 0.00 65535.00 FORMAT "%8.2" ECU_ADDRESS 0x6000DB7E /end MEASUREMENT
/begin MEASUREMENT DINH_stFId.FId_AltIOComErr "Inhibit Status of FIds / Status of function identifier FId_AltIOComErr" UWORD DFC_OneToOne 1 100 0.00 65535.00 FORMAT "%8.2" ECU_ADDRESS 0x6000DB80 /end MEASUREMENT
/begin MEASUREMENT DINH_stFId.FId_AltLinErr "Inhibit Status of FIds / Status of function identifier FId_AltLinErr" UWORD DFC_OneToOne 1 100 0.00 65535.00 FORMAT "%8.2" ECU_ADDRESS 0x6000DB82 /end MEASUREMENT
/begin MEASUREMENT DINH_stFId.FId_AltPwr "Inhibit Status of FIds / Status of function identifier FId_AltPwr" UWORD DFC_OneToOne 1 100 0.00 65535.00 FORMAT "%8.2" ECU_ADDRESS 0x6000DB84 /end MEASUREMENT
/begin MEASUREMENT DINH_stFId.FId_AltVehVErrSt "Inhibit Status of FIds / Status of function identifier FId_AltVehVErrSt" UWORD DFC_OneToOne 1 100 0.00 65535.00 FORMAT "%8.2" ECU_ADDRESS 0x6000DB86 /end MEASUREMENT
/begin MEASUREMENT DINH_stFId.FId_BGFKMSEPSR "Inhibit Status of FIds / Status of function identifier FId_BGFKMSEPSR" UWORD DFC_OneToOne 1 100 0.00 65535.00 FORMAT "%8.2" ECU_ADDRESS 0x6000DB88 /end MEASUREMENT
/begin MEASUREMENT DINH_stFId.FId_BGFKMSEPU "Inhibit Status of FIds / Status of function identifier FId_BGFKMSEPU" UWORD DFC_OneToOne 1 100 0.00 65535.00 FORMAT "%8.2" ECU_ADDRESS 0x6000DB8A /end MEASUREMENT
/begin MEASUREMENT DINH_stFId.FId_BGFKMSESumClr "Inhibit Status of FIds / Status of function identifier FId_BGFKMSESumClr" UWORD DFC_OneToOne 1 100 0.00 65535.00 FORMAT "%8.2" ECU_ADDRESS 0x6000DB8C /end MEASUREMENT
/begin MEASUREMENT DINH_stFId.FId_BGFKMSZPSR "Inhibit Status of FIds / Status of function identifier FId_BGFKMSZPSR" UWORD DFC_OneToOne 1 100 0.00 65535.00 FORMAT "%8.2" ECU_ADDRESS 0x6000DB8E /end MEASUREMENT
/begin MEASUREMENT DINH_stFId.FId_BGOSCCat1B1 "Inhibit Status of FIds / Status of function identifier FId_BGOSCCat1B1" UWORD DFC_OneToOne 1 100 0.00 65535.00 FORMAT "%8.2" ECU_ADDRESS 0x6000DB90 /end MEASUREMENT
/begin MEASUREMENT DINH_stFId.FId_BGOSCCat2B1 "Inhibit Status of FIds / Status of function identifier FId_BGOSCCat2B1" UWORD DFC_OneToOne 1 100 0.00 65535.00 FORMAT "%8.2" ECU_ADDRESS 0x6000DB92 /end MEASUREMENT
/begin MEASUREMENT DINH_stFId.FId_BattAltFailr "Inhibit Status of FIds / Status of function identifier FId_BattAltFailr" UWORD DFC_OneToOne 1 100 0.00 65535.00 FORMAT "%8.2" ECU_ADDRESS 0x6000DB94 /end MEASUREMENT
/begin MEASUREMENT DINH_stFId.FId_BattMngtFailr "Inhibit Status of FIds / Status of function identifier FId_BattMngtFailr" UWORD DFC_OneToOne 1 100 0.00 65535.00 FORMAT "%8.2" ECU_ADDRESS 0x6000DB96 /end MEASUREMENT
/begin MEASUREMENT DINH_stFId.FId_BattSigPtd "Inhibit Status of FIds / Status of function identifier FId_BattSigPtd" UWORD DFC_OneToOne 1 100 0.00 65535.00 FORMAT "%8.2" ECU_ADDRESS 0x6000DB98 /end MEASUREMENT
/begin MEASUREMENT DINH_stFId.FId_BattU2MEDSRC "Inhibit Status of FIds / Status of function identifier FId_BattU2MEDSRC" UWORD DFC_OneToOne 1 100 0.00 65535.00 FORMAT "%8.2" ECU_ADDRESS 0x6000DB9A /end MEASUREMENT
/begin MEASUREMENT DINH_stFId.FId_BattUDrpPrvOff "Inhibit Status of FIds / Status of function identifier FId_BattUDrpPrvOff" UWORD DFC_OneToOne 1 100 0.00 65535.00 FORMAT "%8.2" ECU_ADDRESS 0x6000DB9C /end MEASUREMENT
/begin MEASUREMENT DINH_stFId.FId_BattUFrzVal "Inhibit Status of FIds / Status of function identifier FId_BattUFrzVal" UWORD DFC_OneToOne 1 100 0.00 65535.00 FORMAT "%8.2" ECU_ADDRESS 0x6000DB9E /end MEASUREMENT
/begin MEASUREMENT DINH_stFId.FId_BattUHiFailrEna "Inhibit Status of FIds / Status of function identifier FId_BattUHiFailrEna" UWORD DFC_OneToOne 1 100 0.00 65535.00 FORMAT "%8.2" ECU_ADDRESS 0x6000DBA0 /end MEASUREMENT
/begin MEASUREMENT DINH_stFId.FId_BattUIMGTCUCANFailr "Inhibit Status of FIds / Status of function identifier FId_BattUIMGTCUCANFailr" UWORD DFC_OneToOne 1 100 0.00 65535.00 FORMAT "%8.2" ECU_ADDRESS 0x6000DBA2 /end MEASUREMENT
/begin MEASUREMENT DINH_stFId.FId_BattULoFailrEna "Inhibit Status of FIds / Status of function identifier FId_BattULoFailrEna" UWORD DFC_OneToOne 1 100 0.00 65535.00 FORMAT "%8.2" ECU_ADDRESS 0x6000DBA4 /end MEASUREMENT
/begin MEASUREMENT DINH_stFId.FId_BattUReplVal "Inhibit Status of FIds / Status of function identifier FId_BattUReplVal" UWORD DFC_OneToOne 1 100 0.00 65535.00 FORMAT "%8.2" ECU_ADDRESS 0x6000DBA6 /end MEASUREMENT
/begin MEASUREMENT DINH_stFId.FId_BattUSRC "Inhibit Status of FIds / Status of function identifier FId_BattUSRC" UWORD DFC_OneToOne 1 100 0.00 65535.00 FORMAT "%8.2" ECU_ADDRESS 0x6000DBA8 /end MEASUREMENT
/begin MEASUREMENT DINH_stFId.FId_BlwrComErr "Inhibit Status of FIds / Status of function identifier FId_BlwrComErr" UWORD DFC_OneToOne 1 100 0.00 65535.00 FORMAT "%8.2" ECU_ADDRESS 0x6000DBAA /end MEASUREMENT
/begin MEASUREMENT DINH_stFId.FId_BrkBstPDetnInhbn "Inhibit Status of FIds / Status of function identifier FId_BrkBstPDetnInhbn" UWORD DFC_OneToOne 1 100 0.00 65535.00 FORMAT "%8.2" ECU_ADDRESS 0x6000DBAC /end MEASUREMENT
/begin MEASUREMENT DINH_stFId.FId_BrkBstPMstCylPSnsrFail "Inhibit Status of FIds / Status of function identifier FId_BrkBstPMstCylPSnsrFail" UWORD DFC_OneToOne 1 100 0.00 65535.00 FORMAT "%8.2" ECU_ADDRESS 0x6000DBAE /end MEASUREMENT
/begin MEASUREMENT DINH_stFId.FId_BrkBstPSnsrStuckDetn "Inhibit Status of FIds / Status of function identifier FId_BrkBstPSnsrStuckDetn" UWORD DFC_OneToOne 1 100 0.00 65535.00 FORMAT "%8.2" ECU_ADDRESS 0x6000DBB0 /end MEASUREMENT
/begin MEASUREMENT DINH_stFId.FId_BrkMnSwtErr "Inhibit Status of FIds / Status of function identifier FId_BrkMnSwtErr" UWORD DFC_OneToOne 1 100 0.00 65535.00 FORMAT "%8.2" ECU_ADDRESS 0x6000DBB2 /end MEASUREMENT
/begin MEASUREMENT DINH_stFId.FId_BrkPOilPres "Inhibit Status of FIds / Status of function identifier FId_BrkPOilPres" UWORD DFC_OneToOne 1 100 0.00 65535.00 FORMAT "%8.2" ECU_ADDRESS 0x6000DBB4 /end MEASUREMENT
/begin MEASUREMENT DINH_stFId.FId_BrkPedEngStopEna "Inhibit Status of FIds / Status of function identifier FId_BrkPedEngStopEna" UWORD DFC_OneToOne 1 100 0.00 65535.00 FORMAT "%8.2" ECU_ADDRESS 0x6000DBB6 /end MEASUREMENT
/begin MEASUREMENT DINH_stFId.FId_BrkRdntSwtErr "Inhibit Status of FIds / Status of function identifier FId_BrkRdntSwtErr" UWORD DFC_OneToOne 1 100 0.00 65535.00 FORMAT "%8.2" ECU_ADDRESS 0x6000DBB8 /end MEASUREMENT
/begin MEASUREMENT DINH_stFId.FId_CAGRSDS "Inhibit Status of FIds / Status of function identifier FId_CAGRSDS" UWORD DFC_OneToOne 1 100 0.00 65535.00 FORMAT "%8.2" ECU_ADDRESS 0x6000DBBA /end MEASUREMENT
/begin MEASUREMENT DINH_stFId.FId_CEngDsTColdStrt "Inhibit Status of FIds / Status of function identifier FId_CEngDsTColdStrt" UWORD DFC_OneToOne 1 100 0.00 65535.00 FORMAT "%8.2" ECU_ADDRESS 0x6000DBBC /end MEASUREMENT
/begin MEASUREMENT DINH_stFId.FId_CEngDsTColdStrtErr "Inhibit Status of FIds / Status of function identifier FId_CEngDsTColdStrtErr" UWORD DFC_OneToOne 1 100 0.00 65535.00 FORMAT "%8.2" ECU_ADDRESS 0x6000DBBE /end MEASUREMENT
/begin MEASUREMENT DINH_stFId.FId_CEngDsTLSC "Inhibit Status of FIds / Status of function identifier FId_CEngDsTLSC" UWORD DFC_OneToOne 1 100 0.00 65535.00 FORMAT "%8.2" ECU_ADDRESS 0x6000DBC0 /end MEASUREMENT
/begin MEASUREMENT DINH_stFId.FId_CEngDsTPlausErr "Inhibit Status of FIds / Status of function identifier FId_CEngDsTPlausErr" UWORD DFC_OneToOne 1 100 0.00 65535.00 FORMAT "%8.2" ECU_ADDRESS 0x6000DBC2 /end MEASUREMENT
/begin MEASUREMENT DINH_stFId.FId_CEngDsTReplMdlEngStop "Inhibit Status of FIds / Status of function identifier FId_CEngDsTReplMdlEngStop" UWORD DFC_OneToOne 1 100 0.00 65535.00 FORMAT "%8.2" ECU_ADDRESS 0x6000DBC4 /end MEASUREMENT
/begin MEASUREMENT DINH_stFId.FId_CEngDsTSTC "Inhibit Status of FIds / Status of function identifier FId_CEngDsTSTC" UWORD DFC_OneToOne 1 100 0.00 65535.00 FORMAT "%8.2" ECU_ADDRESS 0x6000DBC6 /end MEASUREMENT
/begin MEASUREMENT DINH_stFId.FId_CEngDsTSnsrElec "Inhibit Status of FIds / Status of function identifier FId_CEngDsTSnsrElec" UWORD DFC_OneToOne 1 100 0.00 65535.00 FORMAT "%8.2" ECU_ADDRESS 0x6000DBC8 /end MEASUREMENT
/begin MEASUREMENT DINH_stFId.FId_CEngDsTSwtReplMdl "Inhibit Status of FIds / Status of function identifier FId_CEngDsTSwtReplMdl" UWORD DFC_OneToOne 1 100 0.00 65535.00 FORMAT "%8.2" ECU_ADDRESS 0x6000DBCA /end MEASUREMENT
/begin MEASUREMENT DINH_stFId.FId_CEngUsTElecErr "Inhibit Status of FIds / Status of function identifier FId_CEngUsTElecErr" UWORD DFC_OneToOne 1 100 0.00 65535.00 FORMAT "%8.2" ECU_ADDRESS 0x6000DBCC /end MEASUREMENT
/begin MEASUREMENT DINH_stFId.FId_CEngUsTSnsrElecErr "Inhibit Status of FIds / Status of function identifier FId_CEngUsTSnsrElecErr" UWORD DFC_OneToOne 1 100 0.00 65535.00 FORMAT "%8.2" ECU_ADDRESS 0x6000DBCE /end MEASUREMENT
/begin MEASUREMENT DINH_stFId.FId_CEngUsTSwtReplMdl "Inhibit Status of FIds / Status of function identifier FId_CEngUsTSwtReplMdl" UWORD DFC_OneToOne 1 100 0.00 65535.00 FORMAT "%8.2" ECU_ADDRESS 0x6000DBD0 /end MEASUREMENT
/begin MEASUREMENT DINH_stFId.FId_CJ135CtlFullAltvS1B1 "Inhibit Status of FIds / Status of function identifier FId_CJ135CtlFullAltvS1B1" UWORD DFC_OneToOne 1 100 0.00 65535.00 FORMAT "%8.2" ECU_ADDRESS 0x6000DBD2 /end MEASUREMENT
/begin MEASUREMENT DINH_stFId.FId_CJ135CtlIPmpAltvS1B1 "Inhibit Status of FIds / Status of function identifier FId_CJ135CtlIPmpAltvS1B1" UWORD DFC_OneToOne 1 100 0.00 65535.00 FORMAT "%8.2" ECU_ADDRESS 0x6000DBD4 /end MEASUREMENT
/begin MEASUREMENT DINH_stFId.FId_CJ135CtlIPmpS1B1 "Inhibit Status of FIds / Status of function identifier FId_CJ135CtlIPmpS1B1" UWORD DFC_OneToOne 1 100 0.00 65535.00 FORMAT "%8.2" ECU_ADDRESS 0x6000DBD6 /end MEASUREMENT
/begin MEASUREMENT DINH_stFId.FId_CJ135CtlRParlTstdS1B1 "Inhibit Status of FIds / Status of function identifier FId_CJ135CtlRParlTstdS1B1" UWORD DFC_OneToOne 1 100 0.00 65535.00 FORMAT "%8.2" ECU_ADDRESS 0x6000DBD8 /end MEASUREMENT
/begin MEASUREMENT DINH_stFId.FId_CJ135CtlS1B1 "Inhibit Status of FIds / Status of function identifier FId_CJ135CtlS1B1" UWORD DFC_OneToOne 1 100 0.00 65535.00 FORMAT "%8.2" ECU_ADDRESS 0x6000DBDA /end MEASUREMENT
/begin MEASUREMENT DINH_stFId.FId_CJ135CtlSnsrHotS1B1 "Inhibit Status of FIds / Status of function identifier FId_CJ135CtlSnsrHotS1B1" UWORD DFC_OneToOne 1 100 0.00 65535.00 FORMAT "%8.2" ECU_ADDRESS 0x6000DBDC /end MEASUREMENT
/begin MEASUREMENT DINH_stFId.FId_CJ135DiagSnsrS1B1 "Inhibit Status of FIds / Status of function identifier FId_CJ135DiagSnsrS1B1" UWORD DFC_OneToOne 1 100 0.00 65535.00 FORMAT "%8.2" ECU_ADDRESS 0x6000DBDE /end MEASUREMENT
/begin MEASUREMENT DINH_stFId.FId_CJ135IPmpNoBiasS1B1 "Inhibit Status of FIds / Status of function identifier FId_CJ135IPmpNoBiasS1B1" UWORD DFC_OneToOne 1 100 0.00 65535.00 FORMAT "%8.2" ECU_ADDRESS 0x6000DBE0 /end MEASUREMENT
/begin MEASUREMENT DINH_stFId.FId_CJ135IPmpNoErrS1B1 "Inhibit Status of FIds / Status of function identifier FId_CJ135IPmpNoErrS1B1" UWORD DFC_OneToOne 1 100 0.00 65535.00 FORMAT "%8.2" ECU_ADDRESS 0x6000DBE2 /end MEASUREMENT
/begin MEASUREMENT DINH_stFId.FId_CMSUDKSOM1 "Inhibit Status of FIds / Status of function identifier FId_CMSUDKSOM1" UWORD DFC_OneToOne 1 100 0.00 65535.00 FORMAT "%8.2" ECU_ADDRESS 0x6000DBE4 /end MEASUREMENT
/begin MEASUREMENT DINH_stFId.FId_CMSUDKSOM2 "Inhibit Status of FIds / Status of function identifier FId_CMSUDKSOM2" UWORD DFC_OneToOne 1 100 0.00 65535.00 FORMAT "%8.2" ECU_ADDRESS 0x6000DBE6 /end MEASUREMENT
/begin MEASUREMENT DINH_stFId.FId_CSTRTCTL "Inhibit Status of FIds / Status of function identifier FId_CSTRTCTL" UWORD DFC_OneToOne 1 100 0.00 65535.00 FORMAT "%8.2" ECU_ADDRESS 0x6000DBE8 /end MEASUREMENT
/begin MEASUREMENT DINH_stFId.FId_Cj135DiagAsicS1B1 "Inhibit Status of FIds / Status of function identifier FId_Cj135DiagAsicS1B1" UWORD DFC_OneToOne 1 100 0.00 65535.00 FORMAT "%8.2" ECU_ADDRESS 0x6000DBEA /end MEASUREMENT
/begin MEASUREMENT DINH_stFId.FId_Cj135DiagOlEnaNotEnfS1B1 "Inhibit Status of FIds / Status of function identifier FId_Cj135DiagOlEnaNotEnfS1B1" UWORD DFC_OneToOne 1 100 0.00 65535.00 FORMAT "%8.2" ECU_ADDRESS 0x6000DBEC /end MEASUREMENT
/begin MEASUREMENT DINH_stFId.FId_Cj135DiagOlEnaS1B1 "Inhibit Status of FIds / Status of function identifier FId_Cj135DiagOlEnaS1B1" UWORD DFC_OneToOne 1 100 0.00 65535.00 FORMAT "%8.2" ECU_ADDRESS 0x6000DBEE /end MEASUREMENT
/begin MEASUREMENT DINH_stFId.FId_Cj135DiagSpiS1B1 "Inhibit Status of FIds / Status of function identifier FId_Cj135DiagSpiS1B1" UWORD DFC_OneToOne 1 100 0.00 65535.00 FORMAT "%8.2" ECU_ADDRESS 0x6000DBF0 /end MEASUREMENT
/begin MEASUREMENT DINH_stFId.FId_Cj135DiagWireRprtS1B1 "Inhibit Status of FIds / Status of function identifier FId_Cj135DiagWireRprtS1B1" UWORD DFC_OneToOne 1 100 0.00 65535.00 FORMAT "%8.2" ECU_ADDRESS 0x6000DBF2 /end MEASUREMENT
/begin MEASUREMENT DINH_stFId.FId_Cj135DiagWireS1B1 "Inhibit Status of FIds / Status of function identifier FId_Cj135DiagWireS1B1" UWORD DFC_OneToOne 1 100 0.00 65535.00 FORMAT "%8.2" ECU_ADDRESS 0x6000DBF4 /end MEASUREMENT
/begin MEASUREMENT DINH_stFId.FId_Cj135Dummy "Inhibit Status of FIds / Status of function identifier FId_Cj135Dummy" UWORD DFC_OneToOne 1 100 0.00 65535.00 FORMAT "%8.2" ECU_ADDRESS 0x6000DBF6 /end MEASUREMENT
/begin MEASUREMENT DINH_stFId.FId_Cj135PerdDiagOperEnaS1B1 "Inhibit Status of FIds / Status of function identifier FId_Cj135PerdDiagOperEnaS1B1" UWORD DFC_OneToOne 1 100 0.00 65535.00 FORMAT "%8.2" ECU_ADDRESS 0x6000DBF8 /end MEASUREMENT
/begin MEASUREMENT DINH_stFId.FId_ClntTempENGB "Inhibit Status of FIds / Status of function identifier FId_ClntTempENGB" UWORD DFC_OneToOne 1 100 0.00 65535.00 FORMAT "%8.2" ECU_ADDRESS 0x6000DBFA /end MEASUREMENT
/begin MEASUREMENT DINH_stFId.FId_Clth "Inhibit Status of FIds / Status of function identifier FId_Clth" UWORD DFC_OneToOne 1 100 0.00 65535.00 FORMAT "%8.2" ECU_ADDRESS 0x6000DBFC /end MEASUREMENT
/begin MEASUREMENT DINH_stFId.FId_Clth2 "Inhibit Status of FIds / Status of function identifier FId_Clth2" UWORD DFC_OneToOne 1 100 0.00 65535.00 FORMAT "%8.2" ECU_ADDRESS 0x6000DBFE /end MEASUREMENT
/begin MEASUREMENT DINH_stFId.FId_Clth3StuckOn "Inhibit Status of FIds / Status of function identifier FId_Clth3StuckOn" UWORD DFC_OneToOne 1 100 0.00 65535.00 FORMAT "%8.2" ECU_ADDRESS 0x6000DC00 /end MEASUREMENT
/begin MEASUREMENT DINH_stFId.FId_Clth4 "Inhibit Status of FIds / Status of function identifier FId_Clth4" UWORD DFC_OneToOne 1 100 0.00 65535.00 FORMAT "%8.2" ECU_ADDRESS 0x6000DC02 /end MEASUREMENT
/begin MEASUREMENT DINH_stFId.FId_ClthCAN "Inhibit Status of FIds / Status of function identifier FId_ClthCAN" UWORD DFC_OneToOne 1 100 0.00 65535.00 FORMAT "%8.2" ECU_ADDRESS 0x6000DC04 /end MEASUREMENT
/begin MEASUREMENT DINH_stFId.FId_ClthMax "Inhibit Status of FIds / Status of function identifier FId_ClthMax" UWORD DFC_OneToOne 1 100 0.00 65535.00 FORMAT "%8.2" ECU_ADDRESS 0x6000DC06 /end MEASUREMENT
/begin MEASUREMENT DINH_stFId.FId_ClthStk "Inhibit Status of FIds / Status of function identifier FId_ClthStk" UWORD DFC_OneToOne 1 100 0.00 65535.00 FORMAT "%8.2" ECU_ADDRESS 0x6000DC08 /end MEASUREMENT
/begin MEASUREMENT DINH_stFId.FId_ClthStkErr "Inhibit Status of FIds / Status of function identifier FId_ClthStkErr" UWORD DFC_OneToOne 1 100 0.00 65535.00 FORMAT "%8.2" ECU_ADDRESS 0x6000DC0A /end MEASUREMENT
/begin MEASUREMENT DINH_stFId.FId_ClthStkFailr "Inhibit Status of FIds / Status of function identifier FId_ClthStkFailr" UWORD DFC_OneToOne 1 100 0.00 65535.00 FORMAT "%8.2" ECU_ADDRESS 0x6000DC0C /end MEASUREMENT
/begin MEASUREMENT DINH_stFId.FId_ClthStkOFFStuck "Inhibit Status of FIds / Status of function identifier FId_ClthStkOFFStuck" UWORD DFC_OneToOne 1 100 0.00 65535.00 FORMAT "%8.2" ECU_ADDRESS 0x6000DC0E /end MEASUREMENT
/begin MEASUREMENT DINH_stFId.FId_ClthStkONStuck "Inhibit Status of FIds / Status of function identifier FId_ClthStkONStuck" UWORD DFC_OneToOne 1 100 0.00 65535.00 FORMAT "%8.2" ECU_ADDRESS 0x6000DC10 /end MEASUREMENT
/begin MEASUREMENT DINH_stFId.FId_ClthSwtFailr "Inhibit Status of FIds / Status of function identifier FId_ClthSwtFailr" UWORD DFC_OneToOne 1 100 0.00 65535.00 FORMAT "%8.2" ECU_ADDRESS 0x6000DC12 /end MEASUREMENT
/begin MEASUREMENT DINH_stFId.FId_CoEOMGdiEomErrLcy "Inhibit Status of FIds / Status of function identifier FId_CoEOMGdiEomErrLcy" UWORD DFC_OneToOne 1 100 0.00 65535.00 FORMAT "%8.2" ECU_ADDRESS 0x6000DC14 /end MEASUREMENT
/begin MEASUREMENT DINH_stFId.FId_CoETM "Inhibit Status of FIds / Status of function identifier FId_CoETM" UWORD DFC_OneToOne 1 100 0.00 65535.00 FORMAT "%8.2" ECU_ADDRESS 0x6000DC16 /end MEASUREMENT
/begin MEASUREMENT DINH_stFId.FId_CoETS_StTrqLimErr1 "Inhibit Status of FIds / Status of function identifier FId_CoETS_StTrqLimErr1" UWORD DFC_OneToOne 1 100 0.00 65535.00 FORMAT "%8.2" ECU_ADDRESS 0x6000DC18 /end MEASUREMENT
/begin MEASUREMENT DINH_stFId.FId_CoETS_StTrqLimErr2 "Inhibit Status of FIds / Status of function identifier FId_CoETS_StTrqLimErr2" UWORD DFC_OneToOne 1 100 0.00 65535.00 FORMAT "%8.2" ECU_ADDRESS 0x6000DC1A /end MEASUREMENT
/begin MEASUREMENT DINH_stFId.FId_CoEngStopEnblStSpEngT "Inhibit Status of FIds / Status of function identifier FId_CoEngStopEnblStSpEngT" UWORD DFC_OneToOne 1 100 0.00 65535.00 FORMAT "%8.2" ECU_ADDRESS 0x6000DC1C /end MEASUREMENT
/begin MEASUREMENT DINH_stFId.FId_CoEngStopEnblStSpLSU "Inhibit Status of FIds / Status of function identifier FId_CoEngStopEnblStSpLSU" UWORD DFC_OneToOne 1 100 0.00 65535.00 FORMAT "%8.2" ECU_ADDRESS 0x6000DC1E /end MEASUREMENT
/begin MEASUREMENT DINH_stFId.FId_CoEngStopEnblStSpTcT "Inhibit Status of FIds / Status of function identifier FId_CoEngStopEnblStSpTcT" UWORD DFC_OneToOne 1 100 0.00 65535.00 FORMAT "%8.2" ECU_ADDRESS 0x6000DC20 /end MEASUREMENT
/begin MEASUREMENT DINH_stFId.FId_CoEngStopEnblSysErr "Inhibit Status of FIds / Status of function identifier FId_CoEngStopEnblSysErr" UWORD DFC_OneToOne 1 100 0.00 65535.00 FORMAT "%8.2" ECU_ADDRESS 0x6000DC22 /end MEASUREMENT
/begin MEASUREMENT DINH_stFId.FId_CoEngVlvLftSpIntk "Inhibit Status of FIds / Status of function identifier FId_CoEngVlvLftSpIntk" UWORD DFC_OneToOne 1 100 0.00 65535.00 FORMAT "%8.2" ECU_ADDRESS 0x6000DC24 /end MEASUREMENT
/begin MEASUREMENT DINH_stFId.FId_CoPOMStrtgDevStrtr "Inhibit Status of FIds / Status of function identifier FId_CoPOMStrtgDevStrtr" UWORD DFC_OneToOne 1 100 0.00 65535.00 FORMAT "%8.2" ECU_ADDRESS 0x6000DC26 /end MEASUREMENT
/begin MEASUREMENT DINH_stFId.FId_CoPOM_FirstStrtAut "Inhibit Status of FIds / Status of function identifier FId_CoPOM_FirstStrtAut" UWORD DFC_OneToOne 1 100 0.00 65535.00 FORMAT "%8.2" ECU_ADDRESS 0x6000DC28 /end MEASUREMENT
/begin MEASUREMENT DINH_stFId.FId_CoTS_SwtOff "Inhibit Status of FIds / Status of function identifier FId_CoTS_SwtOff" UWORD DFC_OneToOne 1 100 0.00 65535.00 FORMAT "%8.2" ECU_ADDRESS 0x6000DC2A /end MEASUREMENT
/begin MEASUREMENT DINH_stFId.FId_CoVOMACCComFailr "Inhibit Status of FIds / Status of function identifier FId_CoVOMACCComFailr" UWORD DFC_OneToOne 1 100 0.00 65535.00 FORMAT "%8.2" ECU_ADDRESS 0x6000DC2C /end MEASUREMENT
/begin MEASUREMENT DINH_stFId.FId_CoVOMBrkPedISABSigFailr "Inhibit Status of FIds / Status of function identifier FId_CoVOMBrkPedISABSigFailr" UWORD DFC_OneToOne 1 100 0.00 65535.00 FORMAT "%8.2" ECU_ADDRESS 0x6000DC2E /end MEASUREMENT
/begin MEASUREMENT DINH_stFId.FId_CoVOMEngCrkAbort "Inhibit Status of FIds / Status of function identifier FId_CoVOMEngCrkAbort" UWORD DFC_OneToOne 1 100 0.00 65535.00 FORMAT "%8.2" ECU_ADDRESS 0x6000DC30 /end MEASUREMENT
/begin MEASUREMENT DINH_stFId.FId_CoVOMEngRstrtEnaCdn "Inhibit Status of FIds / Status of function identifier FId_CoVOMEngRstrtEnaCdn" UWORD DFC_OneToOne 1 100 0.00 65535.00 FORMAT "%8.2" ECU_ADDRESS 0x6000DC32 /end MEASUREMENT
/begin MEASUREMENT DINH_stFId.FId_CoVOMISSEng "Inhibit Status of FIds / Status of function identifier FId_CoVOMISSEng" UWORD DFC_OneToOne 1 100 0.00 65535.00 FORMAT "%8.2" ECU_ADDRESS 0x6000DC34 /end MEASUREMENT
/begin MEASUREMENT DINH_stFId.FId_ComACRly "Inhibit Status of FIds / Status of function identifier FId_ComACRly" UWORD DFC_OneToOne 1 100 0.00 65535.00 FORMAT "%8.2" ECU_ADDRESS 0x6000DC36 /end MEASUREMENT
/begin MEASUREMENT DINH_stFId.FId_ComAPPSensFail "Inhibit Status of FIds / Status of function identifier FId_ComAPPSensFail" UWORD DFC_OneToOne 1 100 0.00 65535.00 FORMAT "%8.2" ECU_ADDRESS 0x6000DC38 /end MEASUREMENT
/begin MEASUREMENT DINH_stFId.FId_ComAPedl "Inhibit Status of FIds / Status of function identifier FId_ComAPedl" UWORD DFC_OneToOne 1 100 0.00 65535.00 FORMAT "%8.2" ECU_ADDRESS 0x6000DC3A /end MEASUREMENT
/begin MEASUREMENT DINH_stFId.FId_ComAYCA "Inhibit Status of FIds / Status of function identifier FId_ComAYCA" UWORD DFC_OneToOne 1 100 0.00 65535.00 FORMAT "%8.2" ECU_ADDRESS 0x6000DC3C /end MEASUREMENT
/begin MEASUREMENT DINH_stFId.FId_ComAYCAMon "Inhibit Status of FIds / Status of function identifier FId_ComAYCAMon" UWORD DFC_OneToOne 1 100 0.00 65535.00 FORMAT "%8.2" ECU_ADDRESS 0x6000DC3E /end MEASUREMENT
/begin MEASUREMENT DINH_stFId.FId_ComAYCD "Inhibit Status of FIds / Status of function identifier FId_ComAYCD" UWORD DFC_OneToOne 1 100 0.00 65535.00 FORMAT "%8.2" ECU_ADDRESS 0x6000DC40 /end MEASUREMENT
/begin MEASUREMENT DINH_stFId.FId_ComAYCDMon "Inhibit Status of FIds / Status of function identifier FId_ComAYCDMon" UWORD DFC_OneToOne 1 100 0.00 65535.00 FORMAT "%8.2" ECU_ADDRESS 0x6000DC42 /end MEASUREMENT
/begin MEASUREMENT DINH_stFId.FId_ComAYCF "Inhibit Status of FIds / Status of function identifier FId_ComAYCF" UWORD DFC_OneToOne 1 100 0.00 65535.00 FORMAT "%8.2" ECU_ADDRESS 0x6000DC44 /end MEASUREMENT
/begin MEASUREMENT DINH_stFId.FId_ComAYCFMon "Inhibit Status of FIds / Status of function identifier FId_ComAYCFMon" UWORD DFC_OneToOne 1 100 0.00 65535.00 FORMAT "%8.2" ECU_ADDRESS 0x6000DC46 /end MEASUREMENT
/begin MEASUREMENT DINH_stFId.FId_ComAYCG "Inhibit Status of FIds / Status of function identifier FId_ComAYCG" UWORD DFC_OneToOne 1 100 0.00 65535.00 FORMAT "%8.2" ECU_ADDRESS 0x6000DC48 /end MEASUREMENT
/begin MEASUREMENT DINH_stFId.FId_ComAYCGMon "Inhibit Status of FIds / Status of function identifier FId_ComAYCGMon" UWORD DFC_OneToOne 1 100 0.00 65535.00 FORMAT "%8.2" ECU_ADDRESS 0x6000DC4A /end MEASUREMENT
/begin MEASUREMENT DINH_stFId.FId_ComAYCI "Inhibit Status of FIds / Status of function identifier FId_ComAYCI" UWORD DFC_OneToOne 1 100 0.00 65535.00 FORMAT "%8.2" ECU_ADDRESS 0x6000DC4C /end MEASUREMENT
/begin MEASUREMENT DINH_stFId.FId_ComAYCIMon "Inhibit Status of FIds / Status of function identifier FId_ComAYCIMon" UWORD DFC_OneToOne 1 100 0.00 65535.00 FORMAT "%8.2" ECU_ADDRESS 0x6000DC4E /end MEASUREMENT
/begin MEASUREMENT DINH_stFId.FId_ComAirPThrUsSnsrErr "Inhibit Status of FIds / Status of function identifier FId_ComAirPThrUsSnsrErr" UWORD DFC_OneToOne 1 100 0.00 65535.00 FORMAT "%8.2" ECU_ADDRESS 0x6000DC50 /end MEASUREMENT
/begin MEASUREMENT DINH_stFId.FId_ComAltFail "Inhibit Status of FIds / Status of function identifier FId_ComAltFail" UWORD DFC_OneToOne 1 100 0.00 65535.00 FORMAT "%8.2" ECU_ADDRESS 0x6000DC52 /end MEASUREMENT
/begin MEASUREMENT DINH_stFId.FId_ComAppVehSnsrFailr "Inhibit Status of FIds / Status of function identifier FId_ComAppVehSnsrFailr" UWORD DFC_OneToOne 1 100 0.00 65535.00 FORMAT "%8.2" ECU_ADDRESS 0x6000DC54 /end MEASUREMENT
/begin MEASUREMENT DINH_stFId.FId_ComBCM1 "Inhibit Status of FIds / Status of function identifier FId_ComBCM1" UWORD DFC_OneToOne 1 100 0.00 65535.00 FORMAT "%8.2" ECU_ADDRESS 0x6000DC56 /end MEASUREMENT
/begin MEASUREMENT DINH_stFId.FId_ComBCM1Mon "Inhibit Status of FIds / Status of function identifier FId_ComBCM1Mon" UWORD DFC_OneToOne 1 100 0.00 65535.00 FORMAT "%8.2" ECU_ADDRESS 0x6000DC58 /end MEASUREMENT
/begin MEASUREMENT DINH_stFId.FId_ComBstCtrl "Inhibit Status of FIds / Status of function identifier FId_ComBstCtrl" UWORD DFC_OneToOne 1 100 0.00 65535.00 FORMAT "%8.2" ECU_ADDRESS 0x6000DC5A /end MEASUREMENT
/begin MEASUREMENT DINH_stFId.FId_ComCANVEHICLEBusOff "Inhibit Status of FIds / Status of function identifier FId_ComCANVEHICLEBusOff" UWORD DFC_OneToOne 1 100 0.00 65535.00 FORMAT "%8.2" ECU_ADDRESS 0x6000DC5C /end MEASUREMENT
/begin MEASUREMENT DINH_stFId.FId_ComCGW1 "Inhibit Status of FIds / Status of function identifier FId_ComCGW1" UWORD DFC_OneToOne 1 100 0.00 65535.00 FORMAT "%8.2" ECU_ADDRESS 0x6000DC5E /end MEASUREMENT
/begin MEASUREMENT DINH_stFId.FId_ComCGW1Mon "Inhibit Status of FIds / Status of function identifier FId_ComCGW1Mon" UWORD DFC_OneToOne 1 100 0.00 65535.00 FORMAT "%8.2" ECU_ADDRESS 0x6000DC60 /end MEASUREMENT
/begin MEASUREMENT DINH_stFId.FId_ComClthSt "Inhibit Status of FIds / Status of function identifier FId_ComClthSt" UWORD DFC_OneToOne 1 100 0.00 65535.00 FORMAT "%8.2" ECU_ADDRESS 0x6000DC62 /end MEASUREMENT
/begin MEASUREMENT DINH_stFId.FId_ComConvClth "Inhibit Status of FIds / Status of function identifier FId_ComConvClth" UWORD DFC_OneToOne 1 100 0.00 65535.00 FORMAT "%8.2" ECU_ADDRESS 0x6000DC64 /end MEASUREMENT
/begin MEASUREMENT DINH_stFId.FId_ComCrCtlReq "Inhibit Status of FIds / Status of function identifier FId_ComCrCtlReq" UWORD DFC_OneToOne 1 100 0.00 65535.00 FORMAT "%8.2" ECU_ADDRESS 0x6000DC66 /end MEASUREMENT
/begin MEASUREMENT DINH_stFId.FId_ComCrsMaiIndcnLampReq "Inhibit Status of FIds / Status of function identifier FId_ComCrsMaiIndcnLampReq" UWORD DFC_OneToOne 1 100 0.00 65535.00 FORMAT "%8.2" ECU_ADDRESS 0x6000DC68 /end MEASUREMENT
/begin MEASUREMENT DINH_stFId.FId_ComCrsSetIndcnLampReq "Inhibit Status of FIds / Status of function identifier FId_ComCrsSetIndcnLampReq" UWORD DFC_OneToOne 1 100 0.00 65535.00 FORMAT "%8.2" ECU_ADDRESS 0x6000DC6A /end MEASUREMENT
/begin MEASUREMENT DINH_stFId.FId_ComDCDCCdn "Inhibit Status of FIds / Status of function identifier FId_ComDCDCCdn" UWORD DFC_OneToOne 1 100 0.00 65535.00 FORMAT "%8.2" ECU_ADDRESS 0x6000DC6C /end MEASUREMENT
/begin MEASUREMENT DINH_stFId.FId_ComDesGearCurr "Inhibit Status of FIds / Status of function identifier FId_ComDesGearCurr" UWORD DFC_OneToOne 1 100 0.00 65535.00 FORMAT "%8.2" ECU_ADDRESS 0x6000DC6E /end MEASUREMENT
/begin MEASUREMENT DINH_stFId.FId_ComDetrmAirM "Inhibit Status of FIds / Status of function identifier FId_ComDetrmAirM" UWORD DFC_OneToOne 1 100 0.00 65535.00 FORMAT "%8.2" ECU_ADDRESS 0x6000DC70 /end MEASUREMENT
/begin MEASUREMENT DINH_stFId.FId_ComDwnShiftCtrlReq "Inhibit Status of FIds / Status of function identifier FId_ComDwnShiftCtrlReq" UWORD DFC_OneToOne 1 100 0.00 65535.00 FORMAT "%8.2" ECU_ADDRESS 0x6000DC72 /end MEASUREMENT
/begin MEASUREMENT DINH_stFId.FId_ComEAT1 "Inhibit Status of FIds / Status of function identifier FId_ComEAT1" UWORD DFC_OneToOne 1 100 0.00 65535.00 FORMAT "%8.2" ECU_ADDRESS 0x6000DC74 /end MEASUREMENT
/begin MEASUREMENT DINH_stFId.FId_ComEAT10 "Inhibit Status of FIds / Status of function identifier FId_ComEAT10" UWORD DFC_OneToOne 1 100 0.00 65535.00 FORMAT "%8.2" ECU_ADDRESS 0x6000DC76 /end MEASUREMENT
/begin MEASUREMENT DINH_stFId.FId_ComEAT10Mon "Inhibit Status of FIds / Status of function identifier FId_ComEAT10Mon" UWORD DFC_OneToOne 1 100 0.00 65535.00 FORMAT "%8.2" ECU_ADDRESS 0x6000DC78 /end MEASUREMENT
/begin MEASUREMENT DINH_stFId.FId_ComEAT11 "Inhibit Status of FIds / Status of function identifier FId_ComEAT11" UWORD DFC_OneToOne 1 100 0.00 65535.00 FORMAT "%8.2" ECU_ADDRESS 0x6000DC7A /end MEASUREMENT
/begin MEASUREMENT DINH_stFId.FId_ComEAT11Mon "Inhibit Status of FIds / Status of function identifier FId_ComEAT11Mon" UWORD DFC_OneToOne 1 100 0.00 65535.00 FORMAT "%8.2" ECU_ADDRESS 0x6000DC7C /end MEASUREMENT
/begin MEASUREMENT DINH_stFId.FId_ComEAT12 "Inhibit Status of FIds / Status of function identifier FId_ComEAT12" UWORD DFC_OneToOne 1 100 0.00 65535.00 FORMAT "%8.2" ECU_ADDRESS 0x6000DC7E /end MEASUREMENT
/begin MEASUREMENT DINH_stFId.FId_ComEAT12Mon "Inhibit Status of FIds / Status of function identifier FId_ComEAT12Mon" UWORD DFC_OneToOne 1 100 0.00 65535.00 FORMAT "%8.2" ECU_ADDRESS 0x6000DC80 /end MEASUREMENT
/begin MEASUREMENT DINH_stFId.FId_ComEAT13 "Inhibit Status of FIds / Status of function identifier FId_ComEAT13" UWORD DFC_OneToOne 1 100 0.00 65535.00 FORMAT "%8.2" ECU_ADDRESS 0x6000DC82 /end MEASUREMENT
/begin MEASUREMENT DINH_stFId.FId_ComEAT13Mon "Inhibit Status of FIds / Status of function identifier FId_ComEAT13Mon" UWORD DFC_OneToOne 1 100 0.00 65535.00 FORMAT "%8.2" ECU_ADDRESS 0x6000DC84 /end MEASUREMENT
/begin MEASUREMENT DINH_stFId.FId_ComEAT1Mon "Inhibit Status of FIds / Status of function identifier FId_ComEAT1Mon" UWORD DFC_OneToOne 1 100 0.00 65535.00 FORMAT "%8.2" ECU_ADDRESS 0x6000DC86 /end MEASUREMENT
/begin MEASUREMENT DINH_stFId.FId_ComEAT2 "Inhibit Status of FIds / Status of function identifier FId_ComEAT2" UWORD DFC_OneToOne 1 100 0.00 65535.00 FORMAT "%8.2" ECU_ADDRESS 0x6000DC88 /end MEASUREMENT
/begin MEASUREMENT DINH_stFId.FId_ComEAT2Mon "Inhibit Status of FIds / Status of function identifier FId_ComEAT2Mon" UWORD DFC_OneToOne 1 100 0.00 65535.00 FORMAT "%8.2" ECU_ADDRESS 0x6000DC8A /end MEASUREMENT
/begin MEASUREMENT DINH_stFId.FId_ComEAT4 "Inhibit Status of FIds / Status of function identifier FId_ComEAT4" UWORD DFC_OneToOne 1 100 0.00 65535.00 FORMAT "%8.2" ECU_ADDRESS 0x6000DC8C /end MEASUREMENT
/begin MEASUREMENT DINH_stFId.FId_ComEAT4Mon "Inhibit Status of FIds / Status of function identifier FId_ComEAT4Mon" UWORD DFC_OneToOne 1 100 0.00 65535.00 FORMAT "%8.2" ECU_ADDRESS 0x6000DC8E /end MEASUREMENT
/begin MEASUREMENT DINH_stFId.FId_ComEAT6 "Inhibit Status of FIds / Status of function identifier FId_ComEAT6" UWORD DFC_OneToOne 1 100 0.00 65535.00 FORMAT "%8.2" ECU_ADDRESS 0x6000DC90 /end MEASUREMENT
/begin MEASUREMENT DINH_stFId.FId_ComEAT6Mon "Inhibit Status of FIds / Status of function identifier FId_ComEAT6Mon" UWORD DFC_OneToOne 1 100 0.00 65535.00 FORMAT "%8.2" ECU_ADDRESS 0x6000DC92 /end MEASUREMENT
/begin MEASUREMENT DINH_stFId.FId_ComEAT7 "Inhibit Status of FIds / Status of function identifier FId_ComEAT7" UWORD DFC_OneToOne 1 100 0.00 65535.00 FORMAT "%8.2" ECU_ADDRESS 0x6000DC94 /end MEASUREMENT
/begin MEASUREMENT DINH_stFId.FId_ComEAT7Mon "Inhibit Status of FIds / Status of function identifier FId_ComEAT7Mon" UWORD DFC_OneToOne 1 100 0.00 65535.00 FORMAT "%8.2" ECU_ADDRESS 0x6000DC96 /end MEASUREMENT
/begin MEASUREMENT DINH_stFId.FId_ComEAT8 "Inhibit Status of FIds / Status of function identifier FId_ComEAT8" UWORD DFC_OneToOne 1 100 0.00 65535.00 FORMAT "%8.2" ECU_ADDRESS 0x6000DC98 /end MEASUREMENT
/begin MEASUREMENT DINH_stFId.FId_ComEAT8Mon "Inhibit Status of FIds / Status of function identifier FId_ComEAT8Mon" UWORD DFC_OneToOne 1 100 0.00 65535.00 FORMAT "%8.2" ECU_ADDRESS 0x6000DC9A /end MEASUREMENT
/begin MEASUREMENT DINH_stFId.FId_ComEATA "Inhibit Status of FIds / Status of function identifier FId_ComEATA" UWORD DFC_OneToOne 1 100 0.00 65535.00 FORMAT "%8.2" ECU_ADDRESS 0x6000DC9C /end MEASUREMENT
/begin MEASUREMENT DINH_stFId.FId_ComEATAMon "Inhibit Status of FIds / Status of function identifier FId_ComEATAMon" UWORD DFC_OneToOne 1 100 0.00 65535.00 FORMAT "%8.2" ECU_ADDRESS 0x6000DC9E /end MEASUREMENT
/begin MEASUREMENT DINH_stFId.FId_ComEATB "Inhibit Status of FIds / Status of function identifier FId_ComEATB" UWORD DFC_OneToOne 1 100 0.00 65535.00 FORMAT "%8.2" ECU_ADDRESS 0x6000DCA0 /end MEASUREMENT
/begin MEASUREMENT DINH_stFId.FId_ComEATBMon "Inhibit Status of FIds / Status of function identifier FId_ComEATBMon" UWORD DFC_OneToOne 1 100 0.00 65535.00 FORMAT "%8.2" ECU_ADDRESS 0x6000DCA2 /end MEASUREMENT
/begin MEASUREMENT DINH_stFId.FId_ComEATC "Inhibit Status of FIds / Status of function identifier FId_ComEATC" UWORD DFC_OneToOne 1 100 0.00 65535.00 FORMAT "%8.2" ECU_ADDRESS 0x6000DCA4 /end MEASUREMENT
/begin MEASUREMENT DINH_stFId.FId_ComEATCMon "Inhibit Status of FIds / Status of function identifier FId_ComEATCMon" UWORD DFC_OneToOne 1 100 0.00 65535.00 FORMAT "%8.2" ECU_ADDRESS 0x6000DCA6 /end MEASUREMENT
/begin MEASUREMENT DINH_stFId.FId_ComEBBA "Inhibit Status of FIds / Status of function identifier FId_ComEBBA" UWORD DFC_OneToOne 1 100 0.00 65535.00 FORMAT "%8.2" ECU_ADDRESS 0x6000DCA8 /end MEASUREMENT
/begin MEASUREMENT DINH_stFId.FId_ComEBBAMon "Inhibit Status of FIds / Status of function identifier FId_ComEBBAMon" UWORD DFC_OneToOne 1 100 0.00 65535.00 FORMAT "%8.2" ECU_ADDRESS 0x6000DCAA /end MEASUREMENT
/begin MEASUREMENT DINH_stFId.FId_ComECUHwErr "Inhibit Status of FIds / Status of function identifier FId_ComECUHwErr" UWORD DFC_OneToOne 1 100 0.00 65535.00 FORMAT "%8.2" ECU_ADDRESS 0x6000DCAC /end MEASUREMENT
/begin MEASUREMENT DINH_stFId.FId_ComEMSIntAirTemp "Inhibit Status of FIds / Status of function identifier FId_ComEMSIntAirTemp" UWORD DFC_OneToOne 1 100 0.00 65535.00 FORMAT "%8.2" ECU_ADDRESS 0x6000DCAE /end MEASUREMENT
/begin MEASUREMENT DINH_stFId.FId_ComEPS1 "Inhibit Status of FIds / Status of function identifier FId_ComEPS1" UWORD DFC_OneToOne 1 100 0.00 65535.00 FORMAT "%8.2" ECU_ADDRESS 0x6000DCB0 /end MEASUREMENT
/begin MEASUREMENT DINH_stFId.FId_ComEPS1Mon "Inhibit Status of FIds / Status of function identifier FId_ComEPS1Mon" UWORD DFC_OneToOne 1 100 0.00 65535.00 FORMAT "%8.2" ECU_ADDRESS 0x6000DCB2 /end MEASUREMENT
/begin MEASUREMENT DINH_stFId.FId_ComEngBrkOvrdInfo "Inhibit Status of FIds / Status of function identifier FId_ComEngBrkOvrdInfo" UWORD DFC_OneToOne 1 100 0.00 65535.00 FORMAT "%8.2" ECU_ADDRESS 0x6000DCB4 /end MEASUREMENT
/begin MEASUREMENT DINH_stFId.FId_ComEngBrkOvrdMtr "Inhibit Status of FIds / Status of function identifier FId_ComEngBrkOvrdMtr" UWORD DFC_OneToOne 1 100 0.00 65535.00 FORMAT "%8.2" ECU_ADDRESS 0x6000DCB6 /end MEASUREMENT
/begin MEASUREMENT DINH_stFId.FId_ComEngBrkSwErr "Inhibit Status of FIds / Status of function identifier FId_ComEngBrkSwErr" UWORD DFC_OneToOne 1 100 0.00 65535.00 FORMAT "%8.2" ECU_ADDRESS 0x6000DCB8 /end MEASUREMENT
/begin MEASUREMENT DINH_stFId.FId_ComEngPosng "Inhibit Status of FIds / Status of function identifier FId_ComEngPosng" UWORD DFC_OneToOne 1 100 0.00 65535.00 FORMAT "%8.2" ECU_ADDRESS 0x6000DCBA /end MEASUREMENT
/begin MEASUREMENT DINH_stFId.FId_ComEngRPMLim "Inhibit Status of FIds / Status of function identifier FId_ComEngRPMLim" UWORD DFC_OneToOne 1 100 0.00 65535.00 FORMAT "%8.2" ECU_ADDRESS 0x6000DCBC /end MEASUREMENT
/begin MEASUREMENT DINH_stFId.FId_ComEngTrqLim "Inhibit Status of FIds / Status of function identifier FId_ComEngTrqLim" UWORD DFC_OneToOne 1 100 0.00 65535.00 FORMAT "%8.2" ECU_ADDRESS 0x6000DCBE /end MEASUREMENT
/begin MEASUREMENT DINH_stFId.FId_ComEnvtlAirPSnsrErr "Inhibit Status of FIds / Status of function identifier FId_ComEnvtlAirPSnsrErr" UWORD DFC_OneToOne 1 100 0.00 65535.00 FORMAT "%8.2" ECU_ADDRESS 0x6000DCC0 /end MEASUREMENT
/begin MEASUREMENT DINH_stFId.FId_ComEstmTqNormJdg "Inhibit Status of FIds / Status of function identifier FId_ComEstmTqNormJdg" UWORD DFC_OneToOne 1 100 0.00 65535.00 FORMAT "%8.2" ECU_ADDRESS 0x6000DCC2 /end MEASUREMENT
/begin MEASUREMENT DINH_stFId.FId_ComEthnlSErr "Inhibit Status of FIds / Status of function identifier FId_ComEthnlSErr" UWORD DFC_OneToOne 1 100 0.00 65535.00 FORMAT "%8.2" ECU_ADDRESS 0x6000DCC4 /end MEASUREMENT
/begin MEASUREMENT DINH_stFId.FId_ComEwpErr "Inhibit Status of FIds / Status of function identifier FId_ComEwpErr" UWORD DFC_OneToOne 1 100 0.00 65535.00 FORMAT "%8.2" ECU_ADDRESS 0x6000DCC6 /end MEASUREMENT
/begin MEASUREMENT DINH_stFId.FId_ComFlSply "Inhibit Status of FIds / Status of function identifier FId_ComFlSply" UWORD DFC_OneToOne 1 100 0.00 65535.00 FORMAT "%8.2" ECU_ADDRESS 0x6000DCC8 /end MEASUREMENT
/begin MEASUREMENT DINH_stFId.FId_ComFuCnsBitDurgIdleStop "Inhibit Status of FIds / Status of function identifier FId_ComFuCnsBitDurgIdleStop" UWORD DFC_OneToOne 1 100 0.00 65535.00 FORMAT "%8.2" ECU_ADDRESS 0x6000DCCA /end MEASUREMENT
/begin MEASUREMENT DINH_stFId.FId_ComGEVCntrl "Inhibit Status of FIds / Status of function identifier FId_ComGEVCntrl" UWORD DFC_OneToOne 1 100 0.00 65535.00 FORMAT "%8.2" ECU_ADDRESS 0x6000DCCC /end MEASUREMENT
/begin MEASUREMENT DINH_stFId.FId_ComGbxNPosFail "Inhibit Status of FIds / Status of function identifier FId_ComGbxNPosFail" UWORD DFC_OneToOne 1 100 0.00 65535.00 FORMAT "%8.2" ECU_ADDRESS 0x6000DCCE /end MEASUREMENT
/begin MEASUREMENT DINH_stFId.FId_ComGbxTemp "Inhibit Status of FIds / Status of function identifier FId_ComGbxTemp" UWORD DFC_OneToOne 1 100 0.00 65535.00 FORMAT "%8.2" ECU_ADDRESS 0x6000DCD0 /end MEASUREMENT
/begin MEASUREMENT DINH_stFId.FId_ComGwIMG1 "Inhibit Status of FIds / Status of function identifier FId_ComGwIMG1" UWORD DFC_OneToOne 1 100 0.00 65535.00 FORMAT "%8.2" ECU_ADDRESS 0x6000DCD2 /end MEASUREMENT
/begin MEASUREMENT DINH_stFId.FId_ComGwIMG1Mon "Inhibit Status of FIds / Status of function identifier FId_ComGwIMG1Mon" UWORD DFC_OneToOne 1 100 0.00 65535.00 FORMAT "%8.2" ECU_ADDRESS 0x6000DCD4 /end MEASUREMENT
/begin MEASUREMENT DINH_stFId.FId_ComGwIMG3 "Inhibit Status of FIds / Status of function identifier FId_ComGwIMG3" UWORD DFC_OneToOne 1 100 0.00 65535.00 FORMAT "%8.2" ECU_ADDRESS 0x6000DCD6 /end MEASUREMENT
/begin MEASUREMENT DINH_stFId.FId_ComGwIMG3Mon "Inhibit Status of FIds / Status of function identifier FId_ComGwIMG3Mon" UWORD DFC_OneToOne 1 100 0.00 65535.00 FORMAT "%8.2" ECU_ADDRESS 0x6000DCD8 /end MEASUREMENT
/begin MEASUREMENT DINH_stFId.FId_ComGwIMG4 "Inhibit Status of FIds / Status of function identifier FId_ComGwIMG4" UWORD DFC_OneToOne 1 100 0.00 65535.00 FORMAT "%8.2" ECU_ADDRESS 0x6000DCDA /end MEASUREMENT
/begin FUNCTION DINH "30000.27.0_1.0.0Diagnostic Inhibit Handler"
 /begin LOC_MEASUREMENT DINH_nrActvInhReas.FId_ComPCUMon DINH_nrActvInhReas.FId_ComPosActnSpdLimrFctReq DINH_nrActvInhReas.FId_ComSRS DINH_nrActvInhReas.FId_ComSRSA DINH_nrActvInhReas.FId_ComSRSAMon DINH_nrActvInhReas.FId_ComSRSB DINH_nrActvInhReas.FId_ComSRSBMon DINH_nrActvInhReas.FId_ComSRSMon DINH_nrActvInhReas.FId_ComSTFlt DINH_nrActvInhReas.FId_ComSpdLimrDevActvn DINH_nrActvInhReas.FId_ComTCU01 DINH_nrActvInhReas.FId_ComTCU02 DINH_nrActvInhReas.FId_ComTCU1 DINH_nrActvInhReas.FId_ComTCU11 DINH_nrActvInhReas.FId_ComTCU12 DINH_nrActvInhReas.FId_ComTCU13 DINH_nrActvInhReas.FId_ComTCU14 DINH_nrActvInhReas.FId_ComTCU2 DINH_nrActvInhReas.FId_ComTCU3 DINH_nrActvInhReas.FId_ComTCU4 DINH_nrActvInhReas.FId_ComTCUGear DINH_nrActvInhReas.FId_ComTarGearDwnShift DINH_nrActvInhReas.FId_ComTarGearUpShift DINH_nrActvInhReas.FId_ComThrPosnFail DINH_nrActvInhReas.FId_ComThrVlv DINH_nrActvInhReas.FId_ComTrboChrgnErr DINH_nrActvInhReas.FId_ComTrqAccuracySlow DINH_nrActvInhReas.FId_ComTrqReqFast DINH_nrActvInhReas.FId_ComTrqReqSlow DINH_nrActvInhReas.FId_ComVSAErr DINH_nrActvInhReas.FId_ComVehSpdFltChk DINH_nrActvInhReas.FId_ComVehSpdImpsErr DINH_nrActvInhReas.FId_ComVlvLftCtrl DINH_nrActvInhReas.FId_ComvolEng DINH_nrActvInhReas.FId_ConvLdCalcLvrPos DINH_nrActvInhReas.FId_ConvLdNTrbnCan DINH_nrActvInhReas.FId_ConvLdOilCoolrPmp DINH_nrActvInhReas.FId_ConvLdOilTemp DINH_nrActvInhReas.FId_ConvLdTrqLdCan DINH_nrActvInhReas.FId_ConvLdVel DINH_nrActvInhReas.FId_CptProtnExhTempMdl DINH_nrActvInhReas.FId_CptProtnO2SnsrB1 DINH_nrActvInhReas.FId_CptProtnVVeh DINH_nrActvInhReas.FId_CrCUI1EFRxErr DINH_nrActvInhReas.FId_CrCUICANRxErr DINH_nrActvInhReas.FId_CrCUIFCMRxErr DINH_nrActvInhReas.FId_CrCUIMETDRxErr DINH_nrActvInhReas.FId_CrCtlACCRxErr DINH_nrActvInhReas.FId_CrCtlAppSnsrErr DINH_nrActvInhReas.FId_CrCtlShutOffEng DINH_nrActvInhReas.FId_DIUMPRCldStrtMon DINH_nrActvInhReas.FId_DIUMPRGenDenom1 DINH_nrActvInhReas.FId_DIUMPRGenDenom2 DINH_nrActvInhReas.FId_DIUMPRGenDenom3 DINH_nrActvInhReas.FId_DIUMPRIgn DINH_nrActvInhReas.FId_DOGov DINH_nrActvInhReas.FId_DSMWarmUpCycle DINH_nrActvInhReas.FId_DewDetTKAMax DINH_nrActvInhReas.FId_DkrsaEpmNoSig DINH_nrActvInhReas.FId_EBBCANErrFrzVal DINH_nrActvInhReas.FId_EBBCANErrReplVal DINH_nrActvInhReas.FId_EGLZSR DINH_nrActvInhReas.FId_EGSDO2OffsRstDsmS1B1 DINH_nrActvInhReas.FId_EGSDO2_LamOffsSlowS1 DINH_nrActvInhReas.FId_EGSDUS2B1LtrDly DINH_nrActvInhReas.FId_EGSDUS2B1LtrPT1 DINH_nrActvInhReas.FId_EGSDUS2B1RtlDly DINH_nrActvInhReas.FId_EGSDUS2B1RtlPT1 DINH_nrActvInhReas.FId_EGSDUS2B1TarEvln DINH_nrActvInhReas.FId_EGSDUS2B1TarLean DINH_nrActvInhReas.FId_EGSDUS2B1TarRich DINH_nrActvInhReas.FId_ELZSR DINH_nrActvInhReas.FId_EPBErr DINH_nrActvInhReas.FId_EPBFrmErr DINH_nrActvInhReas.FId_EPBFrmErrClth DINH_nrActvInhReas.FId_EVPComFailr DINH_nrActvInhReas.FId_EbsLinErr DINH_nrActvInhReas.FId_EepReadWrState DINH_nrActvInhReas.FId_ElecLdComErr DINH_nrActvInhReas.FId_ElecLdFrzVal DINH_nrActvInhReas.FId_ElecLdHdLiComErr DINH_nrActvInhReas.FId_ElecLdRplVal DINH_nrActvInhReas.FId_ElecLoadEPSComErr DINH_nrActvInhReas.FId_EngBlkTWrn DINH_nrActvInhReas.FId_EngCooltTFail DINH_nrActvInhReas.FId_EngDemTqLimnCamsftErr DINH_nrActvInhReas.FId_EngDemTqLimnErrThmstHeatCtrlCirc DINH_nrActvInhReas.FId_EngDemTqLimnOilPmp DINH_nrActvInhReas.FId_EngDemTrqLimErrAPP DINH_nrActvInhReas.FId_EngIntkAirFail DINH_nrActvInhReas.FId_EngPrtErrVehV DINH_nrActvInhReas.FId_EngSpd30DegFail DINH_nrActvInhReas.FId_EngStrtEnaEthAdap DINH_nrActvInhReas.FId_EngStrt_InjProhb DINH_nrActvInhReas.FId_EngTqRvsnEnaFlg DINH_nrActvInhReas.FId_EnvTPrimMod DINH_nrActvInhReas.FId_EnvTPrimModIniVal DINH_nrActvInhReas.FId_EnvTSensSum DINH_nrActvInhReas.FId_EnvTtCEngDsT DINH_nrActvInhReas.FId_EnvTtIntkMnfld DINH_nrActvInhReas.FId_EpmBCr DINH_nrActvInhReas.FId_EpmCaSAdapCaSI1 DINH_nrActvInhReas.FId_EpmCaSAdapRstI1 DINH_nrActvInhReas.FId_EpmCaSDiagI1 DINH_nrActvInhReas.FId_EpmCaSErrCaSI1 DINH_nrActvInhReas.FId_EpmCaSOfsDiagCaSI1 DINH_nrActvInhReas.FId_EpmCaSOfsErrCaSI1 DINH_nrActvInhReas.FId_EpmCaSSegI1 DINH_nrActvInhReas.FId_EpmCaSSpdPlausI1 DINH_nrActvInhReas.FId_EpmCrSDiag DINH_nrActvInhReas.FId_EpmCrSDiagVeh DINH_nrActvInhReas.FId_EpmCrSErr DINH_nrActvInhReas.FId_EpmRRSCrSFaultCheck DINH_nrActvInhReas.FId_EpmRRSVehVFaultChck DINH_nrActvInhReas.FId_EpmSynLockCaSSync DINH_nrActvInhReas.FId_EtaEngIdleNonCsers DINH_nrActvInhReas.FId_EtaEngPtlNonCsers DINH_nrActvInhReas.FId_FanCtlACClntP DINH_nrActvInhReas.FId_FanCtlACGModFail DINH_nrActvInhReas.FId_FanCtlAPP1 DINH_nrActvInhReas.FId_FanCtlAPP2 DINH_nrActvInhReas.FId_FanCtlAPPSync DINH_nrActvInhReas.FId_FanCtlBlowrU DINH_nrActvInhReas.FId_FanCtlCooltT DINH_nrActvInhReas.FId_FanCtlCooltT2 DINH_nrActvInhReas.FId_FanCtlEnvT DINH_nrActvInhReas.FId_FanCtlLiSwtInfo DINH_nrActvInhReas.FId_FanCtlSpd DINH_nrActvInhReas.FId_FanCtlTSnsrErr DINH_nrActvInhReas.FId_FanCtlThr1 DINH_nrActvInhReas.FId_FanCtlThr2 DINH_nrActvInhReas.FId_FcoReq DINH_nrActvInhReas.FId_FiMFID_rba_MRly_Diag_Stk DINH_nrActvInhReas.FId_FlMALamDynDiag DINH_nrActvInhReas.FId_FuEvapPurgTCpvDty DINH_nrActvInhReas.FId_FuMixUegoErrExcl DINH_nrActvInhReas.FId_GEVCtlVlvLftEnaIntk DINH_nrActvInhReas.FId_GbxAnNeutPosnErr DINH_nrActvInhReas.FId_GbxCANDigPlausErr DINH_nrActvInhReas.FId_GbxCANNeutSigErr DINH_nrActvInhReas.FId_GbxPNPosSig DINH_nrActvInhReas.FId_GbxPNPosnComErr DINH_nrActvInhReas.FId_GbxPNPosnDiagDrvCdnRels DINH_nrActvInhReas.FId_GbxPNPosnDiagDrvCodnHealRels DINH_nrActvInhReas.FId_GbxPNPosnDiagPlausyRels DINH_nrActvInhReas.FId_GbxPNPosnSubsVal DINH_nrActvInhReas.FId_GbxRvsSwtStk DINH_nrActvInhReas.FId_GbxSnsrSplyUErr DINH_nrActvInhReas.FId_GbxSpstReqOk DINH_nrActvInhReas.FId_GlbDaLSumvXPtd DINH_nrActvInhReas.FId_GslThrVlvSnsrDiagB1 DINH_nrActvInhReas.FId_HEGOS2B1DElec DINH_nrActvInhReas.FId_HEGOS2B1DHtg DINH_nrActvInhReas.FId_HEGOS2B1Htg DINH_nrActvInhReas.FId_HEGOS2B1HtrPsSt DINH_nrActvInhReas.FId_HEGOS2B1InVld DINH_nrActvInhReas.FId_HEGOS2B1LSPsDiaDi DINH_nrActvInhReas.FId_HLSDemBrkFlt DINH_nrActvInhReas.FId_HLSDemIntkAirTemp DINH_nrActvInhReas.FId_HLSDemMotTemp DINH_nrActvInhReas.FId_HLSDemMstCyldpVld DINH_nrActvInhReas.FId_HLSDemOvhtExhMnf DINH_nrActvInhReas.FId_HLSDemOvhtFanR DINH_nrActvInhReas.FId_HLSDemOvhtGear DINH_nrActvInhReas.FId_HLSDemOvhtTum DINH_nrActvInhReas.FId_HLSDemOvhtVehV DINH_nrActvInhReas.FId_HLSDemSpdClthGearAccrSigErr DINH_nrActvInhReas.FId_HLSDem_DrvOffSuprt DINH_nrActvInhReas.FId_HLSDem_DrvOffSuprtBrkHldSys DINH_nrActvInhReas.FId_HLSDem_DrvOffSuprtLAS DINH_nrActvInhReas.FId_HLSDem_PModeActv DINH_nrActvInhReas.FId_HLSDem_TModeActv DINH_nrActvInhReas.FId_HLSDem_TraSubFcn DINH_nrActvInhReas.FId_HLSDem_nMaxLimErr1 DINH_nrActvInhReas.FId_HLSDem_nMaxLimErr2 DINH_nrActvInhReas.FId_HLSDem_nMaxLimErr3 DINH_nrActvInhReas.FId_HLSDem_nMaxVErr DINH_nrActvInhReas.FId_I14229APP DINH_nrActvInhReas.FId_I14229CANErr DINH_nrActvInhReas.FId_I14229EWPErr DINH_nrActvInhReas.FId_I14229TrbCh DINH_nrActvInhReas.FId_I14229VTCErr DINH_nrActvInhReas.FId_IMGISABComErr DINH_nrActvInhReas.FId_InhbLamDynS1B1 DINH_nrActvInhReas.FId_InhibitAlways DINH_nrActvInhReas.FId_InhibitNever DINH_nrActvInhReas.FId_InjVvgPFIEV1 DINH_nrActvInhReas.FId_InjVvgPFIEV2 DINH_nrActvInhReas.FId_InjVvgPFIEV3 DINH_nrActvInhReas.FId_InjVvgPFIEV4 DINH_nrActvInhReas.FId_IntkAirTIntkMnfldCrssChk DINH_nrActvInhReas.FId_IntkAirTIntkMnfldPlausChk DINH_nrActvInhReas.FId_IntkAirTIntkMnfldRepl DINH_nrActvInhReas.FId_IntkAirTSnsr1Elec DINH_nrActvInhReas.FId_IntkAirTSnsr1PRC DINH_nrActvInhReas.FId_IntkAirTSnsr1Sum DINH_nrActvInhReas.FId_IntkArTempENGB DINH_nrActvInhReas.FId_LIGovDfrstI DINH_nrActvInhReas.FId_LIGovUndrBrk DINH_nrActvInhReas.FId_LINDCDCRxErr DINH_nrActvInhReas.FId_LLimAppSnsrErr DINH_nrActvInhReas.FId_LLimAppSnsrSyncErr DINH_nrActvInhReas.FId_LLimMTVehSpdSnsrErr DINH_nrActvInhReas.FId_LLimShutOffEng DINH_nrActvInhReas.FId_LRSEBMisf DINH_nrActvInhReas.FId_LZSR DINH_nrActvInhReas.FId_LeakToMnfldTstd DINH_nrActvInhReas.FId_MaiLoadSnsr DINH_nrActvInhReas.FId_MisfDetDnAdpn DINH_nrActvInhReas.FId_MisfDetDnAdpnPlaus DINH_nrActvInhReas.FId_MisfDetEnvP DINH_nrActvInhReas.FId_MisfDetSegTiAdpnFco DINH_nrActvInhReas.FId_MisfDetShtrpAct DINH_nrActvInhReas.FId_MisfDetStc DINH_nrActvInhReas.FId_MisfDetV DINH_nrActvInhReas.FId_MisfDetVWhlFrntLe DINH_nrActvInhReas.FId_MisfDetVWhlFrntRi DINH_nrActvInhReas.FId_MisfDetVWhlReLe DINH_nrActvInhReas.FId_MisfDetVWhlReRi DINH_nrActvInhReas.FId_MisfDet_InjLockdOpen01 DINH_nrActvInhReas.FId_MisfDet_InjLockdOpen02 DINH_nrActvInhReas.FId_MisfDet_InjLockdOpen03 DINH_nrActvInhReas.FId_MisfDet_InjLockdOpen04 DINH_nrActvInhReas.FId_NLimVehHalt DINH_nrActvInhReas.FId_NSHTDAmbT DINH_nrActvInhReas.FId_NSHTDEngT DINH_nrActvInhReas.FId_NSHTILimHiAltiLoIdleSp DINH_nrActvInhReas.FId_O2StorgMdlMD DINH_nrActvInhReas.FId_OilCmbdSen_LvlDfctHW DINH_nrActvInhReas.FId_OilSwmpTCEngDsTWrmUp DINH_nrActvInhReas.FId_OilSwmpT_B_tospg DINH_nrActvInhReas.FId_OilSwmpT_B_tospgg DINH_nrActvInhReas.FId_OilSwmpT_CmbdSnsrErr DINH_nrActvInhReas.FId_OilSwmpT_CmbdSnsrTiTErr DINH_nrActvInhReas.FId_OilSwmpT_EnvT DINH_nrActvInhReas.FId_OilSwmpT_TSnsrErr DINH_nrActvInhReas.FId_PEnvMeasVld DINH_nrActvInhReas.FId_PEnvModel DINH_nrActvInhReas.FId_PEnvPlausDiagVDD DINH_nrActvInhReas.FId_PEnvRawVldVDD DINH_nrActvInhReas.FId_PEnvRefSnsr DINH_nrActvInhReas.FId_PEnvSigRngVld DINH_nrActvInhReas.FId_PEnvSnsrPlausVDD DINH_nrActvInhReas.FId_PEnvVldVDD DINH_nrActvInhReas.FId_PIDA6SigSrcErr DINH_nrActvInhReas.FId_PIntkMnfldPlaus DINH_nrActvInhReas.FId_PIntkVUsElecDiagB1 DINH_nrActvInhReas.FId_PSPCtlDisbl DINH_nrActvInhReas.FId_PSPCtlPreRun DINH_nrActvInhReas.FId_PSPDiagDisbl DINH_nrActvInhReas.FId_PTGripConv DINH_nrActvInhReas.FId_PTGripConvStrt DINH_nrActvInhReas.FId_PTGripMnlClth DINH_nrActvInhReas.FId_PTGripMnlClthStrt DINH_nrActvInhReas.FId_PTTrqRatCANPtd DINH_nrActvInhReas.FId_PThrVlVUsVldB1 DINH_nrActvInhReas.FId_PThrVlvUsMeasdVldB1 DINH_nrActvInhReas.FId_P_VSE11_Diag DINH_nrActvInhReas.FId_PrmId03_FltRdnS1B1 DINH_nrActvInhReas.FId_PrmId03_FltUegoS1B1 DINH_nrActvInhReas.FId_SSEEPBRelease DINH_nrActvInhReas.FId_SSEFCANPRelease DINH_nrActvInhReas.FId_SSEPTCANPRelease DINH_nrActvInhReas.FId_SSEStartRelease DINH_nrActvInhReas.FId_SSEStartReleaseMTCl10 DINH_nrActvInhReas.FId_SSEStartReleaseMTCl100 DINH_nrActvInhReas.FId_SSEStartReleaseMTCl20 DINH_nrActvInhReas.FId_SSEStartReleaseMTCl90 DINH_nrActvInhReas.FId_SSEStartRequest DINH_nrActvInhReas.FId_SSEStopRelease DINH_nrActvInhReas.FId_SSEStrtStopRelease DINH_nrActvInhReas.FId_SSESysOff DINH_nrActvInhReas.FId_SSEUI2DCSysFailr DINH_nrActvInhReas.FId_SSEUIBCANErr DINH_nrActvInhReas.FId_SSEUISysFail DINH_nrActvInhReas.FId_SiaEEPErr DINH_nrActvInhReas.FId_StrtCrkSnsrFailr DINH_nrActvInhReas.FId_StrtCtlAutoCrkModeCdn DINH_nrActvInhReas.FId_StrtCtlComEngStrtErr DINH_nrActvInhReas.FId_StrtCtlNPCdnCncl DINH_nrActvInhReas.FId_StrtCtlNoCpuFailr DINH_nrActvInhReas.FId_StrtCtlNoFailCanLine DINH_nrActvInhReas.FId_StrtCtlNoFailPTCanLine DINH_nrActvInhReas.FId_StrtCtlNoTCUFail DINH_nrActvInhReas.FId_StrtCtlPNPosnSubsVal DINH_nrActvInhReas.FId_StrtCtlSTMFailr DINH_nrActvInhReas.FId_StrtErrShaft DINH_nrActvInhReas.FId_StrtrRlyFailr DINH_nrActvInhReas.FId_SumErrHndlg DINH_nrActvInhReas.FId_SysDiagComErr DINH_nrActvInhReas.FId_SysDiagModInhbErr DINH_nrActvInhReas.FId_TOSPM DINH_nrActvInhReas.FId_TWCCILckExtd DINH_nrActvInhReas.FId_TWCCIRstB1 DINH_nrActvInhReas.FId_TWCCIRstDSMClearB1 DINH_nrActvInhReas.FId_TWCCLsuB1 DINH_nrActvInhReas.FId_TWCCLsuCyc DINH_nrActvInhReas.FId_TWCCLsuDynB1 DINH_nrActvInhReas.FId_TWCCMisfDetn DINH_nrActvInhReas.FId_TWCDPriCatParB1 DINH_nrActvInhReas.FId_TWCDPriCatVldnB1 DINH_nrActvInhReas.FId_ThrVlvMon DINH_nrActvInhReas.FId_ThrVlvOffsLrnPrmsB1 DINH_nrActvInhReas.FId_TiOffTBasdChkFast DINH_nrActvInhReas.FId_TiOffTBasdChkSlow DINH_nrActvInhReas.FId_TiOffVdClk DINH_nrActvInhReas.FId_TqDecelOffsInhb DINH_nrActvInhReas.FId_TraAddAirCANPtd DINH_nrActvInhReas.FId_TraAddClntCANPtd DINH_nrActvInhReas.FId_TraFwdRvsCluInfo DINH_nrActvInhReas.FId_TraGbxNPos DINH_nrActvInhReas.FId_TraGearInfoCanCom DINH_nrActvInhReas.FId_TraGearInfoDet DINH_nrActvInhReas.FId_TraGearInfoGearShftActv DINH_nrActvInhReas.FId_TraGearInfoInfoCan DINH_nrActvInhReas.FId_TraGearInfoLevPos DINH_nrActvInhReas.FId_TraGearInfoLoRng DINH_nrActvInhReas.FId_TraGearInfoRTra DINH_nrActvInhReas.FId_TraGearInfoRevGear DINH_nrActvInhReas.FId_TraGearReq DINH_nrActvInhReas.FId_TraNoShftIdctr DINH_nrActvInhReas.FId_TraPrtGearCANPtd DINH_nrActvInhReas.FId_TraPrtGearIndpdtProblem DINH_nrActvInhReas.FId_TraRPosn DINH_nrActvInhReas.FId_TraRtnIntfcASTIntv DINH_nrActvInhReas.FId_TraRtnIntfcIdlSetP DINH_nrActvInhReas.FId_TraRtnIntfcNMaxCan DINH_nrActvInhReas.FId_TraRtnIntfcNMaxVel DINH_nrActvInhReas.FId_TraTrqRedLmpHmeDec DINH_nrActvInhReas.FId_TraTrqRedLmpHmeInc DINH_nrActvInhReas.FId_TraTrqRedPTCanErr DINH_nrActvInhReas.FId_TraTrqRedTIIntvDes DINH_nrActvInhReas.FId_TraTrqRedTIIntvLead DINH_nrActvInhReas.FId_TraTrqRedTSCIntvDes DINH_nrActvInhReas.FId_TraTrqRedTSCIntvLead DINH_nrActvInhReas.FId_TraTrsmTypHw DINH_nrActvInhReas.FId_TranIdleDes DINH_nrActvInhReas.FId_UEGODiagRelsS1B1 DINH_nrActvInhReas.FId_UEGOHeatrLrgTWinS1B1 DINH_nrActvInhReas.FId_UEGOHeatrPwrStgDiagRelsS1B1 DINH_nrActvInhReas.FId_UEGOHeatrPwrStgDiagRelsSCBS1B1 DINH_nrActvInhReas.FId_UEGOHtrCtlOffS1B1 DINH_nrActvInhReas.FId_UEGOHtrCtlRedS1B1 DINH_nrActvInhReas.FId_UEGOHtrCtlStopS1B1 DINH_nrActvInhReas.FId_UEGOHtrCtlUpS1B1 DINH_nrActvInhReas.FId_UEGOIPmpEvlnRelsS1B1 DINH_nrActvInhReas.FId_UEGOIPmpTCorrnS1B1 DINH_nrActvInhReas.FId_UEGOIPmpTRelsS1B1 DINH_nrActvInhReas.FId_UEGOLamRecprMdlRelsS1B1 DINH_nrActvInhReas.FId_UEGOLamRelsAltvS1B1 DINH_nrActvInhReas.FId_UEGOLamRelsS1B1 DINH_nrActvInhReas.FId_UEGOLoDiagS1B1 DINH_nrActvInhReas.FId_UEGOPrmntDiagS1B1 DINH_nrActvInhReas.FId_UEGOStrtDiagRprtErrS1B1 DINH_nrActvInhReas.FId_UEGOStrtDiagS1B1 DINH_nrActvInhReas.FId_UEGOTEvlnRelsS1B1 DINH_nrActvInhReas.FId_UegoInhbOperRelsS1B1 DINH_nrActvInhReas.FId_UegoIntrptCdnOperRelsPreEngStrt DINH_nrActvInhReas.FId_UegoPlausErrHndlg DINH_nrActvInhReas.FId_UegoSigAvailS1B1 DINH_nrActvInhReas.FId_VMSIDCSRmpShOff DINH_nrActvInhReas.FId_VMSIDCSShOff DINH_nrActvInhReas.FId_VMSITCSRmpShOff DINH_nrActvInhReas.FId_VMSITCSShOff DINH_nrActvInhReas.FId_VSACANErr DINH_nrActvInhReas.FId_VehStcDCDCFailr DINH_nrActvInhReas.FId_VehStcMisf DINH_nrActvInhReas.FId_VehVCANFrzVal DINH_nrActvInhReas.FId_VehVCANReplVal DINH_nrActvInhReas.FId_VehVCanSafeFrzVal DINH_nrActvInhReas.FId_VehVCanSafeReplVal DINH_nrActvInhReas.FId_VehVExcdLim DINH_nrActvInhReas.FId_VehVFrzVal DINH_nrActvInhReas.FId_VehVNCSnsrElecFailr DINH_nrActvInhReas.FId_VehVOBDFrzVal DINH_nrActvInhReas.FId_VehVOBDReplVal DINH_nrActvInhReas.FId_VehVOutCanErr DINH_nrActvInhReas.FId_VehVPWMFrzVal DINH_nrActvInhReas.FId_VehVPWMReplVal DINH_nrActvInhReas.FId_VehVPhysRng DINH_nrActvInhReas.FId_VehVPlaus DINH_nrActvInhReas.FId_VehVPlausCan DINH_nrActvInhReas.FId_VehVPlausFco DINH_nrActvInhReas.FId_VehVPlausPwr DINH_nrActvInhReas.FId_VehVPlausV2N DINH_nrActvInhReas.FId_VehVReplVal DINH_nrActvInhReas.FId_VehVSigCan DINH_nrActvInhReas.FId_VehVSigCanSafe DINH_nrActvInhReas.FId_VehVSnsrARngHi DINH_nrActvInhReas.FId_VehVSnsrBRngHi DINH_nrActvInhReas.FId_VehVSpdRtyDiag DINH_nrActvInhReas.FId_VehVSpdSnsrAElecFailr DINH_nrActvInhReas.FId_VehVSpdSnsrBElecFailr DINH_nrActvInhReas.FId_VehVWhlErrDet DINH_nrActvInhReas.FId_VldtLamDynS1B1 DINH_nrActvInhReas.FId_VlvLftFbIntkOilPSnsr11SRC DINH_nrActvInhReas.FId_VlvLftFbSwtIntk11Diag DINH_nrActvInhReas.FId_ZGLZSR DINH_nrActvInhReas.FId_airIntkFltSnsrKnkPrtnIgn DINH_nrActvInhReas.FId_stChkChgnSys DINH_nrActvInhReas.FId_stChkChgnSys2DC DINH_nrActvInhReas.FId_tFltSnsrKnkPrtnIgn DINH_stClctFId_mp DINH_stFId.FId_Unused DINH_stFId.FID_AFRA DINH_stFId.FID_AORA DINH_stFId.FID_ATEH DINH_stFId.FID_ATEL DINH_stFId.FID_ATEN DINH_stFId.FId_EGSDCmnSeg1B1Parl DINH_stFId.FID_BLLRH DINH_stFId.FID_BLLRKH DINH_stFId.FID_BPLSU DINH_stFId.FId_CJ135RvsChrgMeasS1B1 DINH_stFId.FId_CatHeatgColdStrtReq DINH_stFId.FId_CatHeatgWrmReq DINH_stFId.FId_EGSDO2SnsrMntdRelsS1B1 DINH_stFId.FId_EGSDO2_LamOffsFastS1B1 DINH_stFId.FId_MisfDetDnAdpnNv DINH_stFId.FID_BGFKMS DINH_stFId.FID_CDSTTI DINH_stFId.FID_CETKHL DINH_stFId.FID_CETKHT DINH_stFId.FID_CGLSRDP DINH_stFId.FID_CLLKHV DINH_stFId.FID_CLLRHV DINH_stFId.FID_CLZSRDP DINH_stFId.FID_CNSAD DINH_stFId.FID_CNSAD2 DINH_stFId.FID_CPFISTRT DINH_stFId.FID_CPSRB DINH_stFId.FID_CPSRP DINH_stFId.FID_DKRSA DINH_stFId.FID_DLLRBandEndTst DINH_stFId.FID_DLLRShrtTrpSpdRmp DINH_stFId.FID_FEDKAPB DINH_stFId.FID_FEDSSB DINH_stFId.FID_FOFSTP DINH_stFId.FID_FONSTP DINH_stFId.FID_FUEDK DINH_stFId.FID_LRADLSU DINH_stFId.FID_LRALSVErr DINH_stFId.FID_LRAPLLSU DINH_stFId.FID_LUSTP DINH_stFId.FID_LnKS1 DINH_stFId.FID_PLSUV DINH_stFId.FID_PSRMOZDG DINH_stFId.FID_PSRMOZG DINH_stFId.FID_STRTDIA DINH_stFId.FID_STRTSTM DINH_stFId.FID_TFA1CSMW DINH_stFId.FID_TKACSMW DINH_stFId.FID_TMCSMW DINH_stFId.FID_TOCHOilSwmpTQly DINH_stFId.FID_TOCHTME DINH_stFId.FID_TOSPCSMW DINH_stFId.FID_UEGOHeatrRlyS1B1 DINH_stFId.FID_VehStvSSEOk DINH_stFId.FID_VldtLamPlausMaxS1B1 DINH_stFId.FID_VldtLamPlausMinS1B1 DINH_stFId.FId_ACClntPSSPMon DINH_stFId.FId_ACCompComCANBusOff DINH_stFId.FId_ACCompComCANErrMtr DINH_stFId.FId_ACComp_HiUTWSnsrErr DINH_stFId.FId_ACComp_LoUTWSnsrErr DINH_stFId.FId_ACComp_PDSnsrErr DINH_stFId.FId_ACComp_VehSpdSnsrErr DINH_stFId.FId_ACCtl_ACStrtCut DINH_stFId.FId_ACCtl_APP1 DINH_stFId.FId_ACCtl_APP2 DINH_stFId.FId_ACCtl_APPSync DINH_stFId.FId_ACCtl_AcOff DINH_stFId.FId_ACCtl_Clmb DINH_stFId.FId_ACCtl_DK1 DINH_stFId.FId_ACCtl_DK2 DINH_stFId.FId_ACCtl_DKSync DINH_stFId.FId_ACCtl_VehSpdSnsrErr DINH_stFId.FId_ACCtl_pAC DINH_stFId.FId_ACEvpTCANErr DINH_stFId.FId_ACEvpTFrzVal DINH_stFId.FId_ACEvpTRplVal DINH_stFId.FId_APP1SigPath DINH_stFId.FId_APP2SigPath DINH_stFId.FId_APPBrkErr DINH_stFId.FId_APPLETVldnErr DINH_stFId.FId_APPLrn DINH_stFId.FId_APPVehVErr DINH_stFId.FId_AccPedDrvModComErr DINH_stFId.FId_AccPedDrvModFailr DINH_stFId.FId_AccPedNMaxLim DINH_stFId.FId_AccPedNMinLim DINH_stFId.FId_AccPedNMinLimBrkApp DINH_stFId.FId_AccPedTrqLim DINH_stFId.FId_AirCClntPFrzVal DINH_stFId.FId_AirCClntPRplVal DINH_stFId.FId_AirCSwt DINH_stFId.FId_AirDvPAdpnPEnv DINH_stFId.FId_AirDvPAdpnPIntkVUsB1 DINH_stFId.FId_AirDvPPSnsrAdpn_PModeActv DINH_stFId.FId_AltACGFailr DINH_stFId.FId_AltAPPErrSt DINH_stFId.FId_AltBattMngtFailr DINH_stFId.FId_AltBrkErrSt DINH_stFId.FId_AltComErr DINH_stFId.FId_AltENGB DINH_stFId.FId_AltElecLoadErr DINH_stFId.FId_AltEnvTErr DINH_stFId.FId_AltFFAltLoadFast DINH_stFId.FId_AltFFAltLoadSlow DINH_stFId.FId_AltIOACGErr DINH_stFId.FId_AltIOACGLinComFailr DINH_stFId.FId_AltIOComErr DINH_stFId.FId_AltLinErr DINH_stFId.FId_AltPwr DINH_stFId.FId_AltVehVErrSt DINH_stFId.FId_BGFKMSEPSR DINH_stFId.FId_BGFKMSEPU DINH_stFId.FId_BGFKMSESumClr DINH_stFId.FId_BGFKMSZPSR DINH_stFId.FId_BGOSCCat1B1 DINH_stFId.FId_BGOSCCat2B1 DINH_stFId.FId_BattAltFailr DINH_stFId.FId_BattMngtFailr DINH_stFId.FId_BattSigPtd DINH_stFId.FId_BattU2MEDSRC DINH_stFId.FId_BattUDrpPrvOff DINH_stFId.FId_BattUFrzVal DINH_stFId.FId_BattUHiFailrEna DINH_stFId.FId_BattUIMGTCUCANFailr DINH_stFId.FId_BattULoFailrEna DINH_stFId.FId_BattUReplVal DINH_stFId.FId_BattUSRC DINH_stFId.FId_BlwrComErr DINH_stFId.FId_BrkBstPDetnInhbn DINH_stFId.FId_BrkBstPMstCylPSnsrFail DINH_stFId.FId_BrkBstPSnsrStuckDetn DINH_stFId.FId_BrkMnSwtErr DINH_stFId.FId_BrkPOilPres DINH_stFId.FId_BrkPedEngStopEna DINH_stFId.FId_BrkRdntSwtErr DINH_stFId.FId_CAGRSDS DINH_stFId.FId_CEngDsTColdStrt DINH_stFId.FId_CEngDsTColdStrtErr DINH_stFId.FId_CEngDsTLSC DINH_stFId.FId_CEngDsTPlausErr DINH_stFId.FId_CEngDsTReplMdlEngStop DINH_stFId.FId_CEngDsTSTC DINH_stFId.FId_CEngDsTSnsrElec DINH_stFId.FId_CEngDsTSwtReplMdl DINH_stFId.FId_CEngUsTElecErr DINH_stFId.FId_CEngUsTSnsrElecErr DINH_stFId.FId_CEngUsTSwtReplMdl DINH_stFId.FId_CJ135CtlFullAltvS1B1 DINH_stFId.FId_CJ135CtlIPmpAltvS1B1 DINH_stFId.FId_CJ135CtlIPmpS1B1 DINH_stFId.FId_CJ135CtlRParlTstdS1B1 DINH_stFId.FId_CJ135CtlS1B1 DINH_stFId.FId_CJ135CtlSnsrHotS1B1 DINH_stFId.FId_CJ135DiagSnsrS1B1 DINH_stFId.FId_CJ135IPmpNoBiasS1B1 DINH_stFId.FId_CJ135IPmpNoErrS1B1 DINH_stFId.FId_CMSUDKSOM1 DINH_stFId.FId_CMSUDKSOM2 DINH_stFId.FId_CSTRTCTL DINH_stFId.FId_Cj135DiagAsicS1B1 DINH_stFId.FId_Cj135DiagOlEnaNotEnfS1B1 DINH_stFId.FId_Cj135DiagOlEnaS1B1 DINH_stFId.FId_Cj135DiagSpiS1B1 DINH_stFId.FId_Cj135DiagWireRprtS1B1 DINH_stFId.FId_Cj135DiagWireS1B1 DINH_stFId.FId_Cj135Dummy DINH_stFId.FId_Cj135PerdDiagOperEnaS1B1 DINH_stFId.FId_ClntTempENGB DINH_stFId.FId_Clth DINH_stFId.FId_Clth2 DINH_stFId.FId_Clth3StuckOn DINH_stFId.FId_Clth4 DINH_stFId.FId_ClthCAN DINH_stFId.FId_ClthMax DINH_stFId.FId_ClthStk DINH_stFId.FId_ClthStkErr DINH_stFId.FId_ClthStkFailr DINH_stFId.FId_ClthStkOFFStuck DINH_stFId.FId_ClthStkONStuck DINH_stFId.FId_ClthSwtFailr DINH_stFId.FId_CoEOMGdiEomErrLcy DINH_stFId.FId_CoETM DINH_stFId.FId_CoETS_StTrqLimErr1 DINH_stFId.FId_CoETS_StTrqLimErr2 DINH_stFId.FId_CoEngStopEnblStSpEngT DINH_stFId.FId_CoEngStopEnblStSpLSU DINH_stFId.FId_CoEngStopEnblStSpTcT DINH_stFId.FId_CoEngStopEnblSysErr DINH_stFId.FId_CoEngVlvLftSpIntk DINH_stFId.FId_CoPOMStrtgDevStrtr DINH_stFId.FId_CoPOM_FirstStrtAut DINH_stFId.FId_CoTS_SwtOff DINH_stFId.FId_CoVOMACCComFailr DINH_stFId.FId_CoVOMBrkPedISABSigFailr DINH_stFId.FId_CoVOMEngCrkAbort DINH_stFId.FId_CoVOMEngRstrtEnaCdn DINH_stFId.FId_CoVOMISSEng DINH_stFId.FId_ComACRly DINH_stFId.FId_ComAPPSensFail DINH_stFId.FId_ComAPedl DINH_stFId.FId_ComAYCA DINH_stFId.FId_ComAYCAMon DINH_stFId.FId_ComAYCD DINH_stFId.FId_ComAYCDMon DINH_stFId.FId_ComAYCF DINH_stFId.FId_ComAYCFMon DINH_stFId.FId_ComAYCG DINH_stFId.FId_ComAYCGMon DINH_stFId.FId_ComAYCI DINH_stFId.FId_ComAYCIMon DINH_stFId.FId_ComAirPThrUsSnsrErr DINH_stFId.FId_ComAltFail DINH_stFId.FId_ComAppVehSnsrFailr DINH_stFId.FId_ComBCM1 DINH_stFId.FId_ComBCM1Mon DINH_stFId.FId_ComBstCtrl DINH_stFId.FId_ComCANVEHICLEBusOff DINH_stFId.FId_ComCGW1 DINH_stFId.FId_ComCGW1Mon DINH_stFId.FId_ComClthSt DINH_stFId.FId_ComConvClth DINH_stFId.FId_ComCrCtlReq DINH_stFId.FId_ComCrsMaiIndcnLampReq DINH_stFId.FId_ComCrsSetIndcnLampReq DINH_stFId.FId_ComDCDCCdn DINH_stFId.FId_ComDesGearCurr DINH_stFId.FId_ComDetrmAirM DINH_stFId.FId_ComDwnShiftCtrlReq DINH_stFId.FId_ComEAT1 DINH_stFId.FId_ComEAT10 DINH_stFId.FId_ComEAT10Mon DINH_stFId.FId_ComEAT11 DINH_stFId.FId_ComEAT11Mon DINH_stFId.FId_ComEAT12 DINH_stFId.FId_ComEAT12Mon DINH_stFId.FId_ComEAT13 DINH_stFId.FId_ComEAT13Mon DINH_stFId.FId_ComEAT1Mon DINH_stFId.FId_ComEAT2 DINH_stFId.FId_ComEAT2Mon DINH_stFId.FId_ComEAT4 DINH_stFId.FId_ComEAT4Mon DINH_stFId.FId_ComEAT6 DINH_stFId.FId_ComEAT6Mon DINH_stFId.FId_ComEAT7 DINH_stFId.FId_ComEAT7Mon DINH_stFId.FId_ComEAT8 DINH_stFId.FId_ComEAT8Mon DINH_stFId.FId_ComEATA DINH_stFId.FId_ComEATAMon DINH_stFId.FId_ComEATB DINH_stFId.FId_ComEATBMon DINH_stFId.FId_ComEATC DINH_stFId.FId_ComEATCMon DINH_stFId.FId_ComEBBA DINH_stFId.FId_ComEBBAMon DINH_stFId.FId_ComECUHwErr DINH_stFId.FId_ComEMSIntAirTemp DINH_stFId.FId_ComEPS1 DINH_stFId.FId_ComEPS1Mon DINH_stFId.FId_ComEngBrkOvrdInfo DINH_stFId.FId_ComEngBrkOvrdMtr DINH_stFId.FId_ComEngBrkSwErr DINH_stFId.FId_ComEngPosng DINH_stFId.FId_ComEngRPMLim DINH_stFId.FId_ComEngTrqLim DINH_stFId.FId_ComEnvtlAirPSnsrErr DINH_stFId.FId_ComEstmTqNormJdg DINH_stFId.FId_ComEthnlSErr DINH_stFId.FId_ComEwpErr DINH_stFId.FId_ComFlSply DINH_stFId.FId_ComFuCnsBitDurgIdleStop DINH_stFId.FId_ComGEVCntrl DINH_stFId.FId_ComGbxNPosFail DINH_stFId.FId_ComGbxTemp DINH_stFId.FId_ComGwIMG1 DINH_stFId.FId_ComGwIMG1Mon DINH_stFId.FId_ComGwIMG3 DINH_stFId.FId_ComGwIMG3Mon DINH_stFId.FId_ComGwIMG4 /end LOC_MEASUREMENT
 FUNCTION_VERSION "30000.27.0_1.0.0" /end FUNCTION
/begin COMPU_METHOD DFC_OneToOne "" RAT_FUNC "%6.2" "-" COEFFS 0 1 0 0 0 1 /end COMPU_METHOD
/begin COMPU_METHOD DINH_ct_Compu "" RAT_FUNC "%6.0" "" COEFFS 0 -1 4096 0 0 1 /end COMPU_METHOD
/end MODULE
/end PROJECT
