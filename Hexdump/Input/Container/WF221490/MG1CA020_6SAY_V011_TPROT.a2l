ASAP2_VERSION 1 60
/begin PROJECT MG1CA020 "MG1CA020"
/begin HEADER "" VERSION "MG1CA020_6SAY_V011_TPROT" PROJECT_NO MG1CA020 /end HEADER
/begin MODULE DIM ""
/begin MOD_COMMON "" BYTE_ORDER MSB_LAST ALIGNMENT_BYTE 1 ALIGNMENT_WORD 2 ALIGNMENT_LONG 4 ALIGNMENT_INT64 4 ALIGNMENT_FLOAT32_IEEE 4 ALIGNMENT_FLOAT64_IEEE 4 DATA_SIZE 32 /end MOD_COMMON
/begin CHARACTERISTIC CWPSEVE "Codeword for power stage diagnosis fuel injectors" VALUE 0x8053A4C2 KwWU8 255.0 dez 0.00 255.0 FORMAT "%5.1" /end CHARACTERISTIC
/begin CHARACTERISTIC DDRC_DebArCtrBase.MyCtrBasedClass_2.isJmpDwnActv_C "Parameters of ArCtrBase debouncing /  / Jump at change from ""Failed"" to ""Passed"" debouncing" VALUE 0x8051BDF8 RB_Val_Wu8 1.000 OneToOne 0.00 1.000 FORMAT "%5.3" EXTENDED_LIMITS 0.00 255.0 /end CHARACTERISTIC
/begin CHARACTERISTIC DDRC_DebArCtrBase.MyCtrBasedClass_2.isJmpUpActv_C "Parameters of ArCtrBase debouncing /  / Jump at change from ""Passed"" to ""Failed"" debouncing" VALUE 0x8051BDF9 RB_Val_Wu8 1.000 OneToOne 0.00 1.000 FORMAT "%5.3" EXTENDED_LIMITS 0.00 255.0 /end CHARACTERISTIC
/begin CHARACTERISTIC DDRC_DebArCtrBase.MyCtrBasedClass_2.limPassd_C "Parameters of ArCtrBase debouncing /  / ""Passed"" limit" VALUE 0x8051BDFA RB_Val_Ws16 32767.00 OneToOne -32768.00 -1.00 FORMAT "%8.2" EXTENDED_LIMITS -32768.00 32767.00 /end CHARACTERISTIC
/begin CHARACTERISTIC DDRC_DebArCtrBase.MyCtrBasedClass_2.limFaild_C "Parameters of ArCtrBase debouncing /  / ""Failed"" limit" VALUE 0x8051BDFC RB_Val_Ws16 32766.00 OneToOne 1.00 32767.00 FORMAT "%8.2" EXTENDED_LIMITS -32768.00 32767.00 /end CHARACTERISTIC
/begin CHARACTERISTIC DDRC_DebArCtrBase.MyCtrBasedClass_2.jmpUpVal_C "Parameters of ArCtrBase debouncing /  / Jumppoint direction ""Failed""" VALUE 0x8051BDFE RB_Val_Ws16 65535.00 OneToOne -32768.00 32767.00 FORMAT "%8.2" /end CHARACTERISTIC
/begin CHARACTERISTIC DDRC_DebArCtrBase.MyCtrBasedClass_2.jmpDwnVal_C "Parameters of ArCtrBase debouncing /  / Jumppoint direction ""Passed""" VALUE 0x8051BE00 RB_Val_Ws16 65535.00 OneToOne -32768.00 32767.00 FORMAT "%8.2" /end CHARACTERISTIC
/begin CHARACTERISTIC DDRC_DebArCtrBase.MyCtrBasedClass_2.stepUp_C "Parameters of ArCtrBase debouncing /  / Stepsize of ""Failed"" direction" VALUE 0x8051BE02 RB_Val_Ws16 32766.00 OneToOne 1.00 32767.00 FORMAT "%8.2" EXTENDED_LIMITS -32768.00 32767.00 /end CHARACTERISTIC
/begin CHARACTERISTIC DDRC_DebArCtrBase.MyCtrBasedClass_2.stepDwn_C "Parameters of ArCtrBase debouncing /  / Stepsize of ""Passed"" direction" VALUE 0x8051BE04 RB_Val_Ws16 32767.00 OneToOne -32768.00 -1.00 FORMAT "%8.2" EXTENDED_LIMITS -32768.00 32767.00 /end CHARACTERISTIC
/begin CHARACTERISTIC DDRC_DebArCtrBase.MyCtrBasedClass_1.isJmpDwnActv_C "Parameters of ArCtrBase debouncing /  / Jump at change from ""Failed"" to ""Passed"" debouncing" VALUE 0x8051BE06 RB_Val_Wu8 1.000 OneToOne 0.00 1.000 FORMAT "%5.3" EXTENDED_LIMITS 0.00 255.0 /end CHARACTERISTIC
/begin CHARACTERISTIC DDRC_DebArCtrBase.MyCtrBasedClass_1.isJmpUpActv_C "Parameters of ArCtrBase debouncing /  / Jump at change from ""Passed"" to ""Failed"" debouncing" VALUE 0x8051BE07 RB_Val_Wu8 1.000 OneToOne 0.00 1.000 FORMAT "%5.3" EXTENDED_LIMITS 0.00 255.0 /end CHARACTERISTIC
/begin CHARACTERISTIC DDRC_DebArCtrBase.MyCtrBasedClass_1.limPassd_C "Parameters of ArCtrBase debouncing /  / ""Passed"" limit" VALUE 0x8051BE08 RB_Val_Ws16 32767.00 OneToOne -32768.00 -1.00 FORMAT "%8.2" EXTENDED_LIMITS -32768.00 32767.00 /end CHARACTERISTIC
/begin CHARACTERISTIC DDRC_DebArCtrBase.MyCtrBasedClass_1.limFaild_C "Parameters of ArCtrBase debouncing /  / ""Failed"" limit" VALUE 0x8051BE0A RB_Val_Ws16 32766.00 OneToOne 1.00 32767.00 FORMAT "%8.2" EXTENDED_LIMITS -32768.00 32767.00 /end CHARACTERISTIC
/begin CHARACTERISTIC DDRC_DebArCtrBase.MyCtrBasedClass_1.jmpUpVal_C "Parameters of ArCtrBase debouncing /  / Jumppoint direction ""Failed""" VALUE 0x8051BE0C RB_Val_Ws16 65535.00 OneToOne -32768.00 32767.00 FORMAT "%8.2" /end CHARACTERISTIC
/begin CHARACTERISTIC DDRC_DebArCtrBase.MyCtrBasedClass_1.jmpDwnVal_C "Parameters of ArCtrBase debouncing /  / Jumppoint direction ""Passed""" VALUE 0x8051BE0E RB_Val_Ws16 65535.00 OneToOne -32768.00 32767.00 FORMAT "%8.2" /end CHARACTERISTIC
/begin CHARACTERISTIC DDRC_DebArCtrBase.MyCtrBasedClass_1.stepUp_C "Parameters of ArCtrBase debouncing /  / Stepsize of ""Failed"" direction" VALUE 0x8051BE10 RB_Val_Ws16 32766.00 OneToOne 1.00 32767.00 FORMAT "%8.2" EXTENDED_LIMITS -32768.00 32767.00 /end CHARACTERISTIC
/begin CHARACTERISTIC DDRC_DebArCtrBase.MyCtrBasedClass_1.stepDwn_C "Parameters of ArCtrBase debouncing /  / Stepsize of ""Passed"" direction" VALUE 0x8051BE12 RB_Val_Ws16 32767.00 OneToOne -32768.00 -1.00 FORMAT "%8.2" EXTENDED_LIMITS -32768.00 32767.00 /end CHARACTERISTIC
/begin CHARACTERISTIC DDRC_DebArCtrBase.DemDebounceCounterBasedClass_standard.isJmpDwnActv_C "Parameters of ArCtrBase debouncing /  / Jump at change from ""Failed"" to ""Passed"" debouncing" VALUE 0x8051BE14 RB_Val_Wu8 1.000 OneToOne 0.00 1.000 FORMAT "%5.3" EXTENDED_LIMITS 0.00 255.0 /end CHARACTERISTIC
/begin CHARACTERISTIC DDRC_DebArCtrBase.DemDebounceCounterBasedClass_standard.isJmpUpActv_C "Parameters of ArCtrBase debouncing /  / Jump at change from ""Passed"" to ""Failed"" debouncing" VALUE 0x8051BE15 RB_Val_Wu8 1.000 OneToOne 0.00 1.000 FORMAT "%5.3" EXTENDED_LIMITS 0.00 255.0 /end CHARACTERISTIC
/begin CHARACTERISTIC DDRC_DebArCtrBase.DemDebounceCounterBasedClass_standard.limPassd_C "Parameters of ArCtrBase debouncing /  / ""Passed"" limit" VALUE 0x8051BE16 RB_Val_Ws16 32767.00 OneToOne -32768.00 -1.00 FORMAT "%8.2" EXTENDED_LIMITS -32768.00 32767.00 /end CHARACTERISTIC
/begin CHARACTERISTIC DDRC_DebArCtrBase.DemDebounceCounterBasedClass_standard.limFaild_C "Parameters of ArCtrBase debouncing /  / ""Failed"" limit" VALUE 0x8051BE18 RB_Val_Ws16 32766.00 OneToOne 1.00 32767.00 FORMAT "%8.2" EXTENDED_LIMITS -32768.00 32767.00 /end CHARACTERISTIC
/begin CHARACTERISTIC DDRC_DebArCtrBase.DemDebounceCounterBasedClass_standard.jmpUpVal_C "Parameters of ArCtrBase debouncing /  / Jumppoint direction ""Failed""" VALUE 0x8051BE1A RB_Val_Ws16 65535.00 OneToOne -32768.00 32767.00 FORMAT "%8.2" /end CHARACTERISTIC
/begin CHARACTERISTIC DDRC_DebArCtrBase.DemDebounceCounterBasedClass_standard.jmpDwnVal_C "Parameters of ArCtrBase debouncing /  / Jumppoint direction ""Passed""" VALUE 0x8051BE1C RB_Val_Ws16 65535.00 OneToOne -32768.00 32767.00 FORMAT "%8.2" /end CHARACTERISTIC
/begin CHARACTERISTIC DDRC_DebArCtrBase.DemDebounceCounterBasedClass_standard.stepUp_C "Parameters of ArCtrBase debouncing /  / Stepsize of ""Failed"" direction" VALUE 0x8051BE1E RB_Val_Ws16 32766.00 OneToOne 1.00 32767.00 FORMAT "%8.2" EXTENDED_LIMITS -32768.00 32767.00 /end CHARACTERISTIC
/begin CHARACTERISTIC DDRC_DebArCtrBase.DemDebounceCounterBasedClass_standard.stepDwn_C "Parameters of ArCtrBase debouncing /  / Stepsize of ""Passed"" direction" VALUE 0x8051BE20 RB_Val_Ws16 32767.00 OneToOne -32768.00 -1.00 FORMAT "%8.2" EXTENDED_LIMITS -32768.00 32767.00 /end CHARACTERISTIC
/begin CHARACTERISTIC DDRC_DebArTime.DFC_BusDiagCANAPPLBusOff.tiLimFaild_C "Parameters of ArTime debouncing /  / ""Failed"" limit" VALUE 0x8051BE22 RB_Val_Ws16 327660.0 DDRCTime_ms 10.0 327670.0 FORMAT "%8.1" EXTENDED_LIMITS -327680.0 327670.0 /end CHARACTERISTIC
/begin CHARACTERISTIC DDRC_DebArTime.DFC_BusDiagCANAPPLBusOff.tiLimPassd_C "Parameters of ArTime debouncing /  / ""Passed"" limit" VALUE 0x8051BE24 RB_Val_Ws16 327670.0 DDRCTime_ms -327680.0 -10.0 FORMAT "%8.1" EXTENDED_LIMITS -327680.0 327670.0 /end CHARACTERISTIC
/begin CHARACTERISTIC DDRC_DebArTime.DFC_BusDiagCANCANCBusOff.tiLimFaild_C "Parameters of ArTime debouncing /  / ""Failed"" limit" VALUE 0x8051BE28 RB_Val_Ws16 327660.0 DDRCTime_ms 10.0 327670.0 FORMAT "%8.1" EXTENDED_LIMITS -327680.0 327670.0 /end CHARACTERISTIC
/begin CHARACTERISTIC DDRC_DebArTime.DFC_BusDiagCANCANCBusOff.tiLimPassd_C "Parameters of ArTime debouncing /  / ""Passed"" limit" VALUE 0x8051BE2A RB_Val_Ws16 327670.0 DDRCTime_ms -327680.0 -10.0 FORMAT "%8.1" EXTENDED_LIMITS -327680.0 327670.0 /end CHARACTERISTIC
/begin CHARACTERISTIC DDRC_DebArTime.DFC_BusDiagCANVEHICLEBusOff.tiLimFaild_C "Parameters of ArTime debouncing /  / ""Failed"" limit" VALUE 0x8051BE2E RB_Val_Ws16 327660.0 DDRCTime_ms 10.0 327670.0 FORMAT "%8.1" EXTENDED_LIMITS -327680.0 327670.0 /end CHARACTERISTIC
/begin CHARACTERISTIC DDRC_DebArTime.DFC_BusDiagCANVEHICLEBusOff.tiLimPassd_C "Parameters of ArTime debouncing /  / ""Passed"" limit" VALUE 0x8051BE30 RB_Val_Ws16 327670.0 DDRCTime_ms -327680.0 -10.0 FORMAT "%8.1" EXTENDED_LIMITS -327680.0 327670.0 /end CHARACTERISTIC
/begin CHARACTERISTIC DDRC_DebArTime.DFC_RBA_IODIAGPWR_rba_IoExtCy329_SignalVltSply_0.tiLimFaild_C "Parameters of ArTime debouncing /  / ""Failed"" limit" VALUE 0x8051BE34 RB_Val_Ws16 327660.0 DDRCTime_ms 10.0 327670.0 FORMAT "%8.1" EXTENDED_LIMITS -327680.0 327670.0 /end CHARACTERISTIC
/begin CHARACTERISTIC DDRC_DebArTime.DFC_RBA_IODIAGPWR_rba_IoExtCy329_SignalVltSply_0.tiLimPassd_C "Parameters of ArTime debouncing /  / ""Passed"" limit" VALUE 0x8051BE36 RB_Val_Ws16 327670.0 DDRCTime_ms -327680.0 -10.0 FORMAT "%8.1" EXTENDED_LIMITS -327680.0 327670.0 /end CHARACTERISTIC
/begin CHARACTERISTIC DDRC_DebArTime.DFC_RBA_IODIAGPWR_rba_IoExtCy329_SignalVltSply_0OT.tiLimFaild_C "Parameters of ArTime debouncing /  / ""Failed"" limit" VALUE 0x8051BE3A RB_Val_Ws16 327660.0 DDRCTime_ms 10.0 327670.0 FORMAT "%8.1" EXTENDED_LIMITS -327680.0 327670.0 /end CHARACTERISTIC
/begin CHARACTERISTIC DDRC_DebArTime.DFC_RBA_IODIAGPWR_rba_IoExtCy329_SignalVltSply_0OT.tiLimPassd_C "Parameters of ArTime debouncing /  / ""Passed"" limit" VALUE 0x8051BE3C RB_Val_Ws16 327670.0 DDRCTime_ms -327680.0 -10.0 FORMAT "%8.1" EXTENDED_LIMITS -327680.0 327670.0 /end CHARACTERISTIC
/begin CHARACTERISTIC DDRC_DebArTime.DFC_RBA_IODIAGPWR_rba_IoExtCy329_SignalVltSply_0OV.tiLimFaild_C "Parameters of ArTime debouncing /  / ""Failed"" limit" VALUE 0x8051BE40 RB_Val_Ws16 327660.0 DDRCTime_ms 10.0 327670.0 FORMAT "%8.1" EXTENDED_LIMITS -327680.0 327670.0 /end CHARACTERISTIC
/begin CHARACTERISTIC DDRC_DebArTime.DFC_RBA_IODIAGPWR_rba_IoExtCy329_SignalVltSply_0OV.tiLimPassd_C "Parameters of ArTime debouncing /  / ""Passed"" limit" VALUE 0x8051BE42 RB_Val_Ws16 327670.0 DDRCTime_ms -327680.0 -10.0 FORMAT "%8.1" EXTENDED_LIMITS -327680.0 327670.0 /end CHARACTERISTIC
/begin CHARACTERISTIC DDRC_DebArTime.DFC_RBA_IODIAGPWR_rba_IoExtCy329_SignalVltSply_0SCG.tiLimFaild_C "Parameters of ArTime debouncing /  / ""Failed"" limit" VALUE 0x8051BE46 RB_Val_Ws16 327660.0 DDRCTime_ms 10.0 327670.0 FORMAT "%8.1" EXTENDED_LIMITS -327680.0 327670.0 /end CHARACTERISTIC
/begin CHARACTERISTIC DDRC_DebArTime.DFC_RBA_IODIAGPWR_rba_IoExtCy329_SignalVltSply_0SCG.tiLimPassd_C "Parameters of ArTime debouncing /  / ""Passed"" limit" VALUE 0x8051BE48 RB_Val_Ws16 327670.0 DDRCTime_ms -327680.0 -10.0 FORMAT "%8.1" EXTENDED_LIMITS -327680.0 327670.0 /end CHARACTERISTIC
/begin CHARACTERISTIC DDRC_DebArTime.DFC_RBA_IODIAGPWR_rba_IoExtCy329_SignalVltSply_0UV.tiLimFaild_C "Parameters of ArTime debouncing /  / ""Failed"" limit" VALUE 0x8051BE4C RB_Val_Ws16 327660.0 DDRCTime_ms 10.0 327670.0 FORMAT "%8.1" EXTENDED_LIMITS -327680.0 327670.0 /end CHARACTERISTIC
/begin CHARACTERISTIC DDRC_DebArTime.DFC_RBA_IODIAGPWR_rba_IoExtCy329_SignalVltSply_0UV.tiLimPassd_C "Parameters of ArTime debouncing /  / ""Passed"" limit" VALUE 0x8051BE4E RB_Val_Ws16 327670.0 DDRCTime_ms -327680.0 -10.0 FORMAT "%8.1" EXTENDED_LIMITS -327680.0 327670.0 /end CHARACTERISTIC
/begin CHARACTERISTIC DDRC_DebArTime.DFC_RBA_IODIAGPWR_rba_IoExtCy329_SignalVltSply_1.tiLimFaild_C "Parameters of ArTime debouncing /  / ""Failed"" limit" VALUE 0x8051BE52 RB_Val_Ws16 327660.0 DDRCTime_ms 10.0 327670.0 FORMAT "%8.1" EXTENDED_LIMITS -327680.0 327670.0 /end CHARACTERISTIC
/begin CHARACTERISTIC DDRC_DebArTime.DFC_RBA_IODIAGPWR_rba_IoExtCy329_SignalVltSply_1.tiLimPassd_C "Parameters of ArTime debouncing /  / ""Passed"" limit" VALUE 0x8051BE54 RB_Val_Ws16 327670.0 DDRCTime_ms -327680.0 -10.0 FORMAT "%8.1" EXTENDED_LIMITS -327680.0 327670.0 /end CHARACTERISTIC
/begin CHARACTERISTIC DDRC_DebArTime.DFC_RBA_IODIAGPWR_rba_IoExtCy329_SignalVltSply_1OT.tiLimFaild_C "Parameters of ArTime debouncing /  / ""Failed"" limit" VALUE 0x8051BE58 RB_Val_Ws16 327660.0 DDRCTime_ms 10.0 327670.0 FORMAT "%8.1" EXTENDED_LIMITS -327680.0 327670.0 /end CHARACTERISTIC
/begin CHARACTERISTIC DDRC_DebArTime.DFC_RBA_IODIAGPWR_rba_IoExtCy329_SignalVltSply_1OT.tiLimPassd_C "Parameters of ArTime debouncing /  / ""Passed"" limit" VALUE 0x8051BE5A RB_Val_Ws16 327670.0 DDRCTime_ms -327680.0 -10.0 FORMAT "%8.1" EXTENDED_LIMITS -327680.0 327670.0 /end CHARACTERISTIC
/begin CHARACTERISTIC DDRC_DebArTime.DFC_RBA_IODIAGPWR_rba_IoExtCy329_SignalVltSply_1OV.tiLimFaild_C "Parameters of ArTime debouncing /  / ""Failed"" limit" VALUE 0x8051BE5E RB_Val_Ws16 327660.0 DDRCTime_ms 10.0 327670.0 FORMAT "%8.1" EXTENDED_LIMITS -327680.0 327670.0 /end CHARACTERISTIC
/begin CHARACTERISTIC DDRC_DebArTime.DFC_RBA_IODIAGPWR_rba_IoExtCy329_SignalVltSply_1OV.tiLimPassd_C "Parameters of ArTime debouncing /  / ""Passed"" limit" VALUE 0x8051BE60 RB_Val_Ws16 327670.0 DDRCTime_ms -327680.0 -10.0 FORMAT "%8.1" EXTENDED_LIMITS -327680.0 327670.0 /end CHARACTERISTIC
/begin CHARACTERISTIC DDRC_DebArTime.DFC_RBA_IODIAGPWR_rba_IoExtCy329_SignalVltSply_1SCG.tiLimFaild_C "Parameters of ArTime debouncing /  / ""Failed"" limit" VALUE 0x8051BE64 RB_Val_Ws16 327660.0 DDRCTime_ms 10.0 327670.0 FORMAT "%8.1" EXTENDED_LIMITS -327680.0 327670.0 /end CHARACTERISTIC
/begin CHARACTERISTIC DDRC_DebArTime.DFC_RBA_IODIAGPWR_rba_IoExtCy329_SignalVltSply_1SCG.tiLimPassd_C "Parameters of ArTime debouncing /  / ""Passed"" limit" VALUE 0x8051BE66 RB_Val_Ws16 327670.0 DDRCTime_ms -327680.0 -10.0 FORMAT "%8.1" EXTENDED_LIMITS -327680.0 327670.0 /end CHARACTERISTIC
/begin CHARACTERISTIC DDRC_DebArTime.DFC_RBA_IODIAGPWR_rba_IoExtCy329_SignalVltSply_1UV.tiLimFaild_C "Parameters of ArTime debouncing /  / ""Failed"" limit" VALUE 0x8051BE6A RB_Val_Ws16 327660.0 DDRCTime_ms 10.0 327670.0 FORMAT "%8.1" EXTENDED_LIMITS -327680.0 327670.0 /end CHARACTERISTIC
/begin CHARACTERISTIC DDRC_DebArTime.DFC_RBA_IODIAGPWR_rba_IoExtCy329_SignalVltSply_1UV.tiLimPassd_C "Parameters of ArTime debouncing /  / ""Passed"" limit" VALUE 0x8051BE6C RB_Val_Ws16 327670.0 DDRCTime_ms -327680.0 -10.0 FORMAT "%8.1" EXTENDED_LIMITS -327680.0 327670.0 /end CHARACTERISTIC
/begin CHARACTERISTIC DDRC_DebArTime.DFC_RBA_IODIAGPWR_rba_IoExtCy329_SignalVltSply_2.tiLimFaild_C "Parameters of ArTime debouncing /  / ""Failed"" limit" VALUE 0x8051BE70 RB_Val_Ws16 327660.0 DDRCTime_ms 10.0 327670.0 FORMAT "%8.1" EXTENDED_LIMITS -327680.0 327670.0 /end CHARACTERISTIC
/begin CHARACTERISTIC DDRC_DebArTime.DFC_RBA_IODIAGPWR_rba_IoExtCy329_SignalVltSply_2.tiLimPassd_C "Parameters of ArTime debouncing /  / ""Passed"" limit" VALUE 0x8051BE72 RB_Val_Ws16 327670.0 DDRCTime_ms -327680.0 -10.0 FORMAT "%8.1" EXTENDED_LIMITS -327680.0 327670.0 /end CHARACTERISTIC
/begin CHARACTERISTIC DDRC_DebArTime.DFC_RBA_IODIAGPWR_rba_IoExtCy329_SignalVltSply_2OT.tiLimFaild_C "Parameters of ArTime debouncing /  / ""Failed"" limit" VALUE 0x8051BE76 RB_Val_Ws16 327660.0 DDRCTime_ms 10.0 327670.0 FORMAT "%8.1" EXTENDED_LIMITS -327680.0 327670.0 /end CHARACTERISTIC
/begin CHARACTERISTIC DDRC_DebArTime.DFC_RBA_IODIAGPWR_rba_IoExtCy329_SignalVltSply_2OT.tiLimPassd_C "Parameters of ArTime debouncing /  / ""Passed"" limit" VALUE 0x8051BE78 RB_Val_Ws16 327670.0 DDRCTime_ms -327680.0 -10.0 FORMAT "%8.1" EXTENDED_LIMITS -327680.0 327670.0 /end CHARACTERISTIC
/begin CHARACTERISTIC DDRC_DebArTime.DFC_RBA_IODIAGPWR_rba_IoExtCy329_SignalVltSply_2OV.tiLimFaild_C "Parameters of ArTime debouncing /  / ""Failed"" limit" VALUE 0x8051BE7C RB_Val_Ws16 327660.0 DDRCTime_ms 10.0 327670.0 FORMAT "%8.1" EXTENDED_LIMITS -327680.0 327670.0 /end CHARACTERISTIC
/begin CHARACTERISTIC DDRC_DebArTime.DFC_RBA_IODIAGPWR_rba_IoExtCy329_SignalVltSply_2OV.tiLimPassd_C "Parameters of ArTime debouncing /  / ""Passed"" limit" VALUE 0x8051BE7E RB_Val_Ws16 327670.0 DDRCTime_ms -327680.0 -10.0 FORMAT "%8.1" EXTENDED_LIMITS -327680.0 327670.0 /end CHARACTERISTIC
/begin CHARACTERISTIC DDRC_DebArTime.DFC_RBA_IODIAGPWR_rba_IoExtCy329_SignalVltSply_2SCG.tiLimFaild_C "Parameters of ArTime debouncing /  / ""Failed"" limit" VALUE 0x8051BE82 RB_Val_Ws16 327660.0 DDRCTime_ms 10.0 327670.0 FORMAT "%8.1" EXTENDED_LIMITS -327680.0 327670.0 /end CHARACTERISTIC
/begin CHARACTERISTIC DDRC_DebArTime.DFC_RBA_IODIAGPWR_rba_IoExtCy329_SignalVltSply_2SCG.tiLimPassd_C "Parameters of ArTime debouncing /  / ""Passed"" limit" VALUE 0x8051BE84 RB_Val_Ws16 327670.0 DDRCTime_ms -327680.0 -10.0 FORMAT "%8.1" EXTENDED_LIMITS -327680.0 327670.0 /end CHARACTERISTIC
/begin CHARACTERISTIC DDRC_DebArTime.DFC_RBA_IODIAGPWR_rba_IoExtCy329_SignalVltSply_2UV.tiLimFaild_C "Parameters of ArTime debouncing /  / ""Failed"" limit" VALUE 0x8051BE88 RB_Val_Ws16 327660.0 DDRCTime_ms 10.0 327670.0 FORMAT "%8.1" EXTENDED_LIMITS -327680.0 327670.0 /end CHARACTERISTIC
/begin CHARACTERISTIC DDRC_DebArTime.DFC_RBA_IODIAGPWR_rba_IoExtCy329_SignalVltSply_2UV.tiLimPassd_C "Parameters of ArTime debouncing /  / ""Passed"" limit" VALUE 0x8051BE8A RB_Val_Ws16 327670.0 DDRCTime_ms -327680.0 -10.0 FORMAT "%8.1" EXTENDED_LIMITS -327680.0 327670.0 /end CHARACTERISTIC
/begin CHARACTERISTIC DDRC_DurDeb.BrkBstP_tiSnsrStuckDebDef_C "debouncing parameter / Duration of defect debouncing for check DFC_BrkBstPSnsrStuck" VALUE 0x804D882A Val_Wu16 655350.0 DDRCTime_ms 0.00 655350.0 FORMAT "%8.1" /end CHARACTERISTIC
/begin CHARACTERISTIC DDRC_DurDeb.Brk_tiMnSwtContOnDebOk_C "debouncing parameter / Duration of healing debouncing for check DFC_BrkMnSwtContOn" VALUE 0x804D882C Val_Wu16 655350.0 DDRCTime_ms 0.00 655350.0 FORMAT "%8.1" /end CHARACTERISTIC
/begin CHARACTERISTIC DDRC_DurDeb.Brk_tiMnSwtContOnDebDef_C "debouncing parameter / Duration of defect debouncing for check DFC_BrkMnSwtContOn" VALUE 0x804D882E Val_Wu16 655350.0 DDRCTime_ms 0.00 655350.0 FORMAT "%8.1" /end CHARACTERISTIC
/begin CHARACTERISTIC DDRC_DurDeb.Brk_tiMnSwtNotStpDebOk_C "debouncing parameter / Duration of healing debouncing for check DFC_BrkMnSwtNotStp" VALUE 0x804D8830 Val_Wu16 655350.0 DDRCTime_ms 0.00 655350.0 FORMAT "%8.1" /end CHARACTERISTIC
/begin CHARACTERISTIC DDRC_DurDeb.Brk_tiMnSwtNotStpDebDef_C "debouncing parameter / Duration of defect debouncing for check DFC_BrkMnSwtNotStp" VALUE 0x804D8832 Val_Wu16 655350.0 DDRCTime_ms 0.00 655350.0 FORMAT "%8.1" /end CHARACTERISTIC
/begin CHARACTERISTIC DDRC_DurDeb.Brk_tiPlaDebOk_C "debouncing parameter / Duration of healing debouncing for check DFC_BrkNpl" VALUE 0x804D8834 Val_Wu16 655350.0 DDRCTime_ms 0.00 655350.0 FORMAT "%8.1" /end CHARACTERISTIC
/begin CHARACTERISTIC DDRC_DurDeb.Brk_tiPlaDebDef_C "debouncing parameter / Duration of defect debouncing for check DFC_BrkNpl" VALUE 0x804D8836 Val_Wu16 655350.0 DDRCTime_ms 0.00 655350.0 FORMAT "%8.1" /end CHARACTERISTIC
/begin CHARACTERISTIC DDRC_DurDeb.Brk_tiRdntSwtContOnDebOk_C "debouncing parameter / Duration of healing debouncing for check DFC_BrkRdntSwtContOn" VALUE 0x804D8838 Val_Wu16 655350.0 DDRCTime_ms 0.00 655350.0 FORMAT "%8.1" /end CHARACTERISTIC
/begin CHARACTERISTIC DDRC_DurDeb.Brk_tiRdntSwtContOnDebDef_C "debouncing parameter / Duration of defect debouncing for check DFC_BrkRdntSwtContOn" VALUE 0x804D883A Val_Wu16 655350.0 DDRCTime_ms 0.00 655350.0 FORMAT "%8.1" /end CHARACTERISTIC
/begin CHARACTERISTIC DDRC_DurDeb.Brk_tiRdntSwtNotStpDebOk_C "debouncing parameter / Duration of healing debouncing for check DFC_BrkRdntSwtNotStp" VALUE 0x804D883C Val_Wu16 655350.0 DDRCTime_ms 0.00 655350.0 FORMAT "%8.1" /end CHARACTERISTIC
/begin CHARACTERISTIC DDRC_DurDeb.Brk_tiRdntSwtNotStpDebDef_C "debouncing parameter / Duration of defect debouncing for check DFC_BrkRdntSwtNotStp" VALUE 0x804D883E Val_Wu16 655350.0 DDRCTime_ms 0.00 655350.0 FORMAT "%8.1" /end CHARACTERISTIC
/begin CHARACTERISTIC DDRC_DurDeb.Clth_tiClth3ONStuckDebOk_C "debouncing parameter / Duration of healing debouncing for check DFC_Clth3ONStuck" VALUE 0x804D8840 Val_Wu16 655350.0 DDRCTime_ms 0.00 655350.0 FORMAT "%8.1" /end CHARACTERISTIC
/begin CHARACTERISTIC DDRC_DurDeb.Clth_tiClth3ONStuckDebDef_C "debouncing parameter / Duration of defect debouncing for check DFC_Clth3ONStuck" VALUE 0x804D8842 Val_Wu16 655350.0 DDRCTime_ms 0.00 655350.0 FORMAT "%8.1" /end CHARACTERISTIC
/begin CHARACTERISTIC DDRC_DurDeb.Clth_tiClth4OFFStuckDebOk_C "debouncing parameter / Duration of healing debouncing for check DFC_Clth4OFFStuck" VALUE 0x804D8844 Val_Wu16 655350.0 DDRCTime_ms 0.00 655350.0 FORMAT "%8.1" /end CHARACTERISTIC
/begin CHARACTERISTIC DDRC_DurDeb.Clth_tiClth4OFFStuckDebDef_C "debouncing parameter / Duration of defect debouncing for check DFC_Clth4OFFStuck" VALUE 0x804D8846 Val_Wu16 655350.0 DDRCTime_ms 0.00 655350.0 FORMAT "%8.1" /end CHARACTERISTIC
/begin CHARACTERISTIC DDRC_DurDeb.Clth_tiClthOFFStuckDebOk_C "debouncing parameter / Duration of healing debouncing for check DFC_ClthOFFStuck" VALUE 0x804D8848 Val_Wu16 655350.0 DDRCTime_ms 0.00 655350.0 FORMAT "%8.1" /end CHARACTERISTIC
/begin CHARACTERISTIC DDRC_DurDeb.Clth_tiClthOFFStuckDebDef_C "debouncing parameter / Duration of defect debouncing for check DFC_ClthOFFStuck" VALUE 0x804D884A Val_Wu16 655350.0 DDRCTime_ms 0.00 655350.0 FORMAT "%8.1" /end CHARACTERISTIC
/begin CHARACTERISTIC DDRC_DurDeb.Clth_tiClthONStuckDebOk_C "debouncing parameter / Duration of healing debouncing for check DFC_ClthONStuck" VALUE 0x804D884C Val_Wu16 655350.0 DDRCTime_ms 0.00 655350.0 FORMAT "%8.1" /end CHARACTERISTIC
/begin CHARACTERISTIC DDRC_DurDeb.Clth_tiClthONStuckDebDef_C "debouncing parameter / Duration of defect debouncing for check DFC_ClthONStuck" VALUE 0x804D884E Val_Wu16 655350.0 DDRCTime_ms 0.00 655350.0 FORMAT "%8.1" /end CHARACTERISTIC
/begin CHARACTERISTIC DDRC_DurDeb.Clth_tiClthStkFailInfoDebOk_C "debouncing parameter / Duration of healing debouncing for check DFC_ClthStkFailInfo" VALUE 0x804D8850 Val_Wu16 655350.0 DDRCTime_ms 0.00 655350.0 FORMAT "%8.1" /end CHARACTERISTIC
/begin CHARACTERISTIC DDRC_DurDeb.Clth_tiClthStkFailInfoDebDef_C "debouncing parameter / Duration of defect debouncing for check DFC_ClthStkFailInfo" VALUE 0x804D8852 Val_Wu16 655350.0 DDRCTime_ms 0.00 655350.0 FORMAT "%8.1" /end CHARACTERISTIC
/begin CHARACTERISTIC DDRC_DurDeb.Com_tiACFailInfoDebOk_C "debouncing parameter / Duration of healing debouncing for check DFC_ComACFailInfo" VALUE 0x804D8854 Val_Wu16 655350.0 DDRCTime_ms 0.00 655350.0 FORMAT "%8.1" /end CHARACTERISTIC
/begin CHARACTERISTIC DDRC_DurDeb.Com_tiACFailInfoDebDef_C "debouncing parameter / Duration of defect debouncing for check DFC_ComACFailInfo" VALUE 0x804D8856 Val_Wu16 655350.0 DDRCTime_ms 0.00 655350.0 FORMAT "%8.1" /end CHARACTERISTIC
/begin CHARACTERISTIC DDRC_DurDeb.Com_tiATFTValErrDebOk_C "debouncing parameter / Duration of healing debouncing for check DFC_ComATFTValErr" VALUE 0x804D8858 Val_Wu16 655350.0 DDRCTime_ms 0.00 655350.0 FORMAT "%8.1" /end CHARACTERISTIC
/begin CHARACTERISTIC DDRC_DurDeb.Com_tiATFTValErrDebDef_C "debouncing parameter / Duration of defect debouncing for check DFC_ComATFTValErr" VALUE 0x804D885A Val_Wu16 655350.0 DDRCTime_ms 0.00 655350.0 FORMAT "%8.1" /end CHARACTERISTIC
/begin CHARACTERISTIC DDRC_DurDeb.Com_tiATMILReqDebOk_C "debouncing parameter / Duration of healing debouncing for check DFC_ComATMILReq" VALUE 0x804D885C Val_Wu16 655350.0 DDRCTime_ms 0.00 655350.0 FORMAT "%8.1" /end CHARACTERISTIC
/begin CHARACTERISTIC DDRC_DurDeb.Com_tiATMILReqDebDef_C "debouncing parameter / Duration of defect debouncing for check DFC_ComATMILReq" VALUE 0x804D885E Val_Wu16 655350.0 DDRCTime_ms 0.00 655350.0 FORMAT "%8.1" /end CHARACTERISTIC
/begin CHARACTERISTIC DDRC_DurDeb.Com_tiAYCAChksumDebOk_C "debouncing parameter / Duration of healing debouncing for check DFC_ComAYCAChksum" VALUE 0x804D8860 Val_Wu16 655350.0 DDRCTime_ms 0.00 655350.0 FORMAT "%8.1" /end CHARACTERISTIC
/begin CHARACTERISTIC DDRC_DurDeb.Com_tiAYCAChksumDebDef_C "debouncing parameter / Duration of defect debouncing for check DFC_ComAYCAChksum" VALUE 0x804D8862 Val_Wu16 655350.0 DDRCTime_ms 0.00 655350.0 FORMAT "%8.1" /end CHARACTERISTIC
/begin CHARACTERISTIC DDRC_DurDeb.Com_tiAYCARingCntDebOk_C "debouncing parameter / Duration of healing debouncing for check DFC_ComAYCARingCnt" VALUE 0x804D8864 Val_Wu16 655350.0 DDRCTime_ms 0.00 655350.0 FORMAT "%8.1" /end CHARACTERISTIC
/begin CHARACTERISTIC DDRC_DurDeb.Com_tiAYCARingCntDebDef_C "debouncing parameter / Duration of defect debouncing for check DFC_ComAYCARingCnt" VALUE 0x804D8866 Val_Wu16 655350.0 DDRCTime_ms 0.00 655350.0 FORMAT "%8.1" /end CHARACTERISTIC
/begin CHARACTERISTIC DDRC_DurDeb.Com_tiAYCATOutDebOk_C "debouncing parameter / Duration of healing debouncing for check DFC_ComAYCATOut" VALUE 0x804D8868 Val_Wu16 655350.0 DDRCTime_ms 0.00 655350.0 FORMAT "%8.1" /end CHARACTERISTIC
/begin CHARACTERISTIC DDRC_DurDeb.Com_tiAYCATOutDebDef_C "debouncing parameter / Duration of defect debouncing for check DFC_ComAYCATOut" VALUE 0x804D886A Val_Wu16 655350.0 DDRCTime_ms 0.00 655350.0 FORMAT "%8.1" /end CHARACTERISTIC
/begin CHARACTERISTIC DDRC_DurDeb.Com_tiAYCDChkSumDebOk_C "debouncing parameter / Duration of healing debouncing for check DFC_ComAYCDChkSum" VALUE 0x804D886C Val_Wu16 655350.0 DDRCTime_ms 0.00 655350.0 FORMAT "%8.1" /end CHARACTERISTIC
/begin CHARACTERISTIC DDRC_DurDeb.Com_tiAYCDChkSumDebDef_C "debouncing parameter / Duration of defect debouncing for check DFC_ComAYCDChkSum" VALUE 0x804D886E Val_Wu16 655350.0 DDRCTime_ms 0.00 655350.0 FORMAT "%8.1" /end CHARACTERISTIC
/begin CHARACTERISTIC DDRC_DurDeb.Com_tiAYCDTOutDebOk_C "debouncing parameter / Duration of healing debouncing for check DFC_ComAYCDTOut" VALUE 0x804D8870 Val_Wu16 655350.0 DDRCTime_ms 0.00 655350.0 FORMAT "%8.1" /end CHARACTERISTIC
/begin CHARACTERISTIC DDRC_DurDeb.Com_tiAYCDTOutDebDef_C "debouncing parameter / Duration of defect debouncing for check DFC_ComAYCDTOut" VALUE 0x804D8872 Val_Wu16 655350.0 DDRCTime_ms 0.00 655350.0 FORMAT "%8.1" /end CHARACTERISTIC
/begin CHARACTERISTIC DDRC_DurDeb.Com_tiAYCFChksumDebOk_C "debouncing parameter / Duration of healing debouncing for check DFC_ComAYCFChksum" VALUE 0x804D8874 Val_Wu16 655350.0 DDRCTime_ms 0.00 655350.0 FORMAT "%8.1" /end CHARACTERISTIC
/begin CHARACTERISTIC DDRC_DurDeb.Com_tiAYCFChksumDebDef_C "debouncing parameter / Duration of defect debouncing for check DFC_ComAYCFChksum" VALUE 0x804D8876 Val_Wu16 655350.0 DDRCTime_ms 0.00 655350.0 FORMAT "%8.1" /end CHARACTERISTIC
/begin CHARACTERISTIC DDRC_DurDeb.Com_tiAYCFRingCntDebOk_C "debouncing parameter / Duration of healing debouncing for check DFC_ComAYCFRingCnt" VALUE 0x804D8878 Val_Wu16 655350.0 DDRCTime_ms 0.00 655350.0 FORMAT "%8.1" /end CHARACTERISTIC
/begin CHARACTERISTIC DDRC_DurDeb.Com_tiAYCFRingCntDebDef_C "debouncing parameter / Duration of defect debouncing for check DFC_ComAYCFRingCnt" VALUE 0x804D887A Val_Wu16 655350.0 DDRCTime_ms 0.00 655350.0 FORMAT "%8.1" /end CHARACTERISTIC
/begin CHARACTERISTIC DDRC_DurDeb.Com_tiAYCFTOutDebOk_C "debouncing parameter / Duration of healing debouncing for check DFC_ComAYCFTOut" VALUE 0x804D887C Val_Wu16 655350.0 DDRCTime_ms 0.00 655350.0 FORMAT "%8.1" /end CHARACTERISTIC
/begin CHARACTERISTIC DDRC_DurDeb.Com_tiAYCFTOutDebDef_C "debouncing parameter / Duration of defect debouncing for check DFC_ComAYCFTOut" VALUE 0x804D887E Val_Wu16 655350.0 DDRCTime_ms 0.00 655350.0 FORMAT "%8.1" /end CHARACTERISTIC
/begin CHARACTERISTIC DDRC_DurDeb.Com_tiAYCGChksumDebOk_C "debouncing parameter / Duration of healing debouncing for check DFC_ComAYCGChksum" VALUE 0x804D8880 Val_Wu16 655350.0 DDRCTime_ms 0.00 655350.0 FORMAT "%8.1" /end CHARACTERISTIC
/begin CHARACTERISTIC DDRC_DurDeb.Com_tiAYCGChksumDebDef_C "debouncing parameter / Duration of defect debouncing for check DFC_ComAYCGChksum" VALUE 0x804D8882 Val_Wu16 655350.0 DDRCTime_ms 0.00 655350.0 FORMAT "%8.1" /end CHARACTERISTIC
/begin CHARACTERISTIC DDRC_DurDeb.Com_tiAYCGRingCntDebOk_C "debouncing parameter / Duration of healing debouncing for check DFC_ComAYCGRingCnt" VALUE 0x804D8884 Val_Wu16 655350.0 DDRCTime_ms 0.00 655350.0 FORMAT "%8.1" /end CHARACTERISTIC
/begin CHARACTERISTIC DDRC_DurDeb.Com_tiAYCGRingCntDebDef_C "debouncing parameter / Duration of defect debouncing for check DFC_ComAYCGRingCnt" VALUE 0x804D8886 Val_Wu16 655350.0 DDRCTime_ms 0.00 655350.0 FORMAT "%8.1" /end CHARACTERISTIC
/begin CHARACTERISTIC DDRC_DurDeb.Com_tiAYCGTOutDebOk_C "debouncing parameter / Duration of healing debouncing for check DFC_ComAYCGTOut" VALUE 0x804D8888 Val_Wu16 655350.0 DDRCTime_ms 0.00 655350.0 FORMAT "%8.1" /end CHARACTERISTIC
/begin CHARACTERISTIC DDRC_DurDeb.Com_tiAYCGTOutDebDef_C "debouncing parameter / Duration of defect debouncing for check DFC_ComAYCGTOut" VALUE 0x804D888A Val_Wu16 655350.0 DDRCTime_ms 0.00 655350.0 FORMAT "%8.1" /end CHARACTERISTIC
/begin CHARACTERISTIC DDRC_DurDeb.Com_tiAYCIChkSumDebOk_C "debouncing parameter / Duration of healing debouncing for check DFC_ComAYCIChkSum" VALUE 0x804D888C Val_Wu16 655350.0 DDRCTime_ms 0.00 655350.0 FORMAT "%8.1" /end CHARACTERISTIC
/begin CHARACTERISTIC DDRC_DurDeb.Com_tiAYCIChkSumDebDef_C "debouncing parameter / Duration of defect debouncing for check DFC_ComAYCIChkSum" VALUE 0x804D888E Val_Wu16 655350.0 DDRCTime_ms 0.00 655350.0 FORMAT "%8.1" /end CHARACTERISTIC
/begin CHARACTERISTIC DDRC_DurDeb.Com_tiAYCIRingCntDebOk_C "debouncing parameter / Duration of healing debouncing for check DFC_ComAYCIRingCnt" VALUE 0x804D8890 Val_Wu16 655350.0 DDRCTime_ms 0.00 655350.0 FORMAT "%8.1" /end CHARACTERISTIC
/begin CHARACTERISTIC DDRC_DurDeb.Com_tiAYCIRingCntDebDef_C "debouncing parameter / Duration of defect debouncing for check DFC_ComAYCIRingCnt" VALUE 0x804D8892 Val_Wu16 655350.0 DDRCTime_ms 0.00 655350.0 FORMAT "%8.1" /end CHARACTERISTIC
/begin CHARACTERISTIC DDRC_DurDeb.Com_tiAYCITOutDebOk_C "debouncing parameter / Duration of healing debouncing for check DFC_ComAYCITOut" VALUE 0x804D8894 Val_Wu16 655350.0 DDRCTime_ms 0.00 655350.0 FORMAT "%8.1" /end CHARACTERISTIC
/begin CHARACTERISTIC DDRC_DurDeb.Com_tiAYCITOutDebDef_C "debouncing parameter / Duration of defect debouncing for check DFC_ComAYCITOut" VALUE 0x804D8896 Val_Wu16 655350.0 DDRCTime_ms 0.00 655350.0 FORMAT "%8.1" /end CHARACTERISTIC
/begin CHARACTERISTIC DDRC_DurDeb.Com_tiBCM1ChkSumDebOk_C "debouncing parameter / Duration of healing debouncing for check DFC_ComBCM1ChkSum" VALUE 0x804D8898 Val_Wu16 655350.0 DDRCTime_ms 0.00 655350.0 FORMAT "%8.1" /end CHARACTERISTIC
/begin CHARACTERISTIC DDRC_DurDeb.Com_tiBCM1ChkSumDebDef_C "debouncing parameter / Duration of defect debouncing for check DFC_ComBCM1ChkSum" VALUE 0x804D889A Val_Wu16 655350.0 DDRCTime_ms 0.00 655350.0 FORMAT "%8.1" /end CHARACTERISTIC
/begin CHARACTERISTIC DDRC_DurDeb.Com_tiBCM1RingCntDebOk_C "debouncing parameter / Duration of healing debouncing for check DFC_ComBCM1RingCnt" VALUE 0x804D889C Val_Wu16 655350.0 DDRCTime_ms 0.00 655350.0 FORMAT "%8.1" /end CHARACTERISTIC
/begin CHARACTERISTIC DDRC_DurDeb.Com_tiBCM1RingCntDebDef_C "debouncing parameter / Duration of defect debouncing for check DFC_ComBCM1RingCnt" VALUE 0x804D889E Val_Wu16 655350.0 DDRCTime_ms 0.00 655350.0 FORMAT "%8.1" /end CHARACTERISTIC
/begin CHARACTERISTIC DDRC_DurDeb.Com_tiBCM1TOutDebOk_C "debouncing parameter / Duration of healing debouncing for check DFC_ComBCM1TOut" VALUE 0x804D88A0 Val_Wu16 655350.0 DDRCTime_ms 0.00 655350.0 FORMAT "%8.1" /end CHARACTERISTIC
/begin CHARACTERISTIC DDRC_DurDeb.Com_tiBCM1TOutDebDef_C "debouncing parameter / Duration of defect debouncing for check DFC_ComBCM1TOut" VALUE 0x804D88A2 Val_Wu16 655350.0 DDRCTime_ms 0.00 655350.0 FORMAT "%8.1" /end CHARACTERISTIC
/begin CHARACTERISTIC DDRC_DurDeb.Com_tiCANABusOffErrDebOk_C "debouncing parameter / Duration of healing debouncing for check DFC_ComCANABusOffErr" VALUE 0x804D88A4 Val_Wu16 655350.0 DDRCTime_ms 0.00 655350.0 FORMAT "%8.1" /end CHARACTERISTIC
/begin CHARACTERISTIC DDRC_DurDeb.Com_tiCANABusOffErrDebDef_C "debouncing parameter / Duration of defect debouncing for check DFC_ComCANABusOffErr" VALUE 0x804D88A6 Val_Wu16 655350.0 DDRCTime_ms 0.00 655350.0 FORMAT "%8.1" /end CHARACTERISTIC
/begin CHARACTERISTIC DDRC_DurDeb.Com_tiCANBBusOffErrDebOk_C "debouncing parameter / Duration of healing debouncing for check DFC_ComCANBBusOffErr" VALUE 0x804D88A8 Val_Wu16 655350.0 DDRCTime_ms 0.00 655350.0 FORMAT "%8.1" /end CHARACTERISTIC
/begin CHARACTERISTIC DDRC_DurDeb.Com_tiCANBBusOffErrDebDef_C "debouncing parameter / Duration of defect debouncing for check DFC_ComCANBBusOffErr" VALUE 0x804D88AA Val_Wu16 655350.0 DDRCTime_ms 0.00 655350.0 FORMAT "%8.1" /end CHARACTERISTIC
/begin CHARACTERISTIC DDRC_DurDeb.Com_tiCANCBusOffErrDebOk_C "debouncing parameter / Duration of healing debouncing for check DFC_ComCANCBusOffErr" VALUE 0x804D88AC Val_Wu16 655350.0 DDRCTime_ms 0.00 655350.0 FORMAT "%8.1" /end CHARACTERISTIC
/begin CHARACTERISTIC DDRC_DurDeb.Com_tiCANCBusOffErrDebDef_C "debouncing parameter / Duration of defect debouncing for check DFC_ComCANCBusOffErr" VALUE 0x804D88AE Val_Wu16 655350.0 DDRCTime_ms 0.00 655350.0 FORMAT "%8.1" /end CHARACTERISTIC
/begin CHARACTERISTIC DDRC_DurDeb.Com_tiCGW1ChkSumDebOk_C "debouncing parameter / Duration of healing debouncing for check DFC_ComCGW1ChkSum" VALUE 0x804D88B0 Val_Wu16 655350.0 DDRCTime_ms 0.00 655350.0 FORMAT "%8.1" /end CHARACTERISTIC
/begin CHARACTERISTIC DDRC_DurDeb.Com_tiCGW1ChkSumDebDef_C "debouncing parameter / Duration of defect debouncing for check DFC_ComCGW1ChkSum" VALUE 0x804D88B2 Val_Wu16 655350.0 DDRCTime_ms 0.00 655350.0 FORMAT "%8.1" /end CHARACTERISTIC
/begin CHARACTERISTIC DDRC_DurDeb.Com_tiCGW1TOutDebOk_C "debouncing parameter / Duration of healing debouncing for check DFC_ComCGW1TOut" VALUE 0x804D88B4 Val_Wu16 655350.0 DDRCTime_ms 0.00 655350.0 FORMAT "%8.1" /end CHARACTERISTIC
/begin CHARACTERISTIC DDRC_DurDeb.Com_tiCGW1TOutDebDef_C "debouncing parameter / Duration of defect debouncing for check DFC_ComCGW1TOut" VALUE 0x804D88B6 Val_Wu16 655350.0 DDRCTime_ms 0.00 655350.0 FORMAT "%8.1" /end CHARACTERISTIC
/begin CHARACTERISTIC DDRC_DurDeb.Com_tiCGW1ctRingDebOk_C "debouncing parameter / Duration of healing debouncing for check DFC_ComCGW1RingCnt" VALUE 0x804D88B8 Val_Wu16 655350.0 DDRCTime_ms 0.00 655350.0 FORMAT "%8.1" /end CHARACTERISTIC
/begin CHARACTERISTIC DDRC_DurDeb.Com_tiCGW1ctRingDebDef_C "debouncing parameter / Duration of defect debouncing for check DFC_ComCGW1RingCnt" VALUE 0x804D88BA Val_Wu16 655350.0 DDRCTime_ms 0.00 655350.0 FORMAT "%8.1" /end CHARACTERISTIC
/begin CHARACTERISTIC DDRC_DurDeb.Com_tiConvBoostErrDebOk_C "debouncing parameter / Duration of healing debouncing for check DFC_ComConvBoostErr" VALUE 0x804D88BC Val_Wu16 655350.0 DDRCTime_ms 0.00 655350.0 FORMAT "%8.1" /end CHARACTERISTIC
/begin CHARACTERISTIC DDRC_DurDeb.Com_tiConvBoostErrDebDef_C "debouncing parameter / Duration of defect debouncing for check DFC_ComConvBoostErr" VALUE 0x804D88BE Val_Wu16 655350.0 DDRCTime_ms 0.00 655350.0 FORMAT "%8.1" /end CHARACTERISTIC
/begin CHARACTERISTIC DDRC_DurDeb.Com_tiConvSlipErrDebOk_C "debouncing parameter / Duration of healing debouncing for check DFC_ComConvSlipErr" VALUE 0x804D88C0 Val_Wu16 655350.0 DDRCTime_ms 0.00 655350.0 FORMAT "%8.1" /end CHARACTERISTIC
/begin CHARACTERISTIC DDRC_DurDeb.Com_tiConvSlipErrDebDef_C "debouncing parameter / Duration of defect debouncing for check DFC_ComConvSlipErr" VALUE 0x804D88C2 Val_Wu16 655350.0 DDRCTime_ms 0.00 655350.0 FORMAT "%8.1" /end CHARACTERISTIC
/begin CHARACTERISTIC DDRC_DurDeb.Com_tiEAT10ChkSumDebOk_C "debouncing parameter / Duration of healing debouncing for check DFC_ComEAT10Chksum" VALUE 0x804D88C4 Val_Wu16 655350.0 DDRCTime_ms 0.00 655350.0 FORMAT "%8.1" /end CHARACTERISTIC
/begin CHARACTERISTIC DDRC_DurDeb.Com_tiEAT10ChkSumDebDef_C "debouncing parameter / Duration of defect debouncing for check DFC_ComEAT10Chksum" VALUE 0x804D88C6 Val_Wu16 655350.0 DDRCTime_ms 0.00 655350.0 FORMAT "%8.1" /end CHARACTERISTIC
/begin CHARACTERISTIC DDRC_DurDeb.Com_tiEAT10RingCntDebOk_C "debouncing parameter / Duration of healing debouncing for check DFC_ComEAT10RingCnt" VALUE 0x804D88C8 Val_Wu16 655350.0 DDRCTime_ms 0.00 655350.0 FORMAT "%8.1" /end CHARACTERISTIC
/begin CHARACTERISTIC DDRC_DurDeb.Com_tiEAT10RingCntDebDef_C "debouncing parameter / Duration of defect debouncing for check DFC_ComEAT10RingCnt" VALUE 0x804D88CA Val_Wu16 655350.0 DDRCTime_ms 0.00 655350.0 FORMAT "%8.1" /end CHARACTERISTIC
/begin CHARACTERISTIC DDRC_DurDeb.Com_tiEAT10TOutDebOk_C "debouncing parameter / Duration of healing debouncing for check DFC_ComEAT10TOut" VALUE 0x804D88CC Val_Wu16 655350.0 DDRCTime_ms 0.00 655350.0 FORMAT "%8.1" /end CHARACTERISTIC
/begin CHARACTERISTIC DDRC_DurDeb.Com_tiEAT10TOutDebDef_C "debouncing parameter / Duration of defect debouncing for check DFC_ComEAT10TOut" VALUE 0x804D88CE Val_Wu16 655350.0 DDRCTime_ms 0.00 655350.0 FORMAT "%8.1" /end CHARACTERISTIC
/begin CHARACTERISTIC DDRC_DurDeb.Com_tiEAT11ChkSumDebOk_C "debouncing parameter / Duration of healing debouncing for check DFC_ComEAT11ChkSum" VALUE 0x804D88D0 Val_Wu16 655350.0 DDRCTime_ms 0.00 655350.0 FORMAT "%8.1" /end CHARACTERISTIC
/begin CHARACTERISTIC DDRC_DurDeb.Com_tiEAT11ChkSumDebDef_C "debouncing parameter / Duration of defect debouncing for check DFC_ComEAT11ChkSum" VALUE 0x804D88D2 Val_Wu16 655350.0 DDRCTime_ms 0.00 655350.0 FORMAT "%8.1" /end CHARACTERISTIC
/begin CHARACTERISTIC DDRC_DurDeb.Com_tiEAT11RingCntDebOk_C "debouncing parameter / Duration of healing debouncing for check DFC_ComEAT11RingCnt" VALUE 0x804D88D4 Val_Wu16 655350.0 DDRCTime_ms 0.00 655350.0 FORMAT "%8.1" /end CHARACTERISTIC
/begin CHARACTERISTIC DDRC_DurDeb.Com_tiEAT11RingCntDebDef_C "debouncing parameter / Duration of defect debouncing for check DFC_ComEAT11RingCnt" VALUE 0x804D88D6 Val_Wu16 655350.0 DDRCTime_ms 0.00 655350.0 FORMAT "%8.1" /end CHARACTERISTIC
/begin CHARACTERISTIC DDRC_DurDeb.Com_tiEAT11TOutDebOk_C "debouncing parameter / Duration of healing debouncing for check DFC_ComEAT11TOut" VALUE 0x804D88D8 Val_Wu16 655350.0 DDRCTime_ms 0.00 655350.0 FORMAT "%8.1" /end CHARACTERISTIC
/begin CHARACTERISTIC DDRC_DurDeb.Com_tiEAT11TOutDebDef_C "debouncing parameter / Duration of defect debouncing for check DFC_ComEAT11TOut" VALUE 0x804D88DA Val_Wu16 655350.0 DDRCTime_ms 0.00 655350.0 FORMAT "%8.1" /end CHARACTERISTIC
/begin CHARACTERISTIC DDRC_DurDeb.Com_tiEAT12ChkSumDebOk_C "debouncing parameter / Duration of healing debouncing for check DFC_ComEAT12ChkSum" VALUE 0x804D88DC Val_Wu16 655350.0 DDRCTime_ms 0.00 655350.0 FORMAT "%8.1" /end CHARACTERISTIC
/begin CHARACTERISTIC DDRC_DurDeb.Com_tiEAT12ChkSumDebDef_C "debouncing parameter / Duration of defect debouncing for check DFC_ComEAT12ChkSum" VALUE 0x804D88DE Val_Wu16 655350.0 DDRCTime_ms 0.00 655350.0 FORMAT "%8.1" /end CHARACTERISTIC
/begin CHARACTERISTIC DDRC_DurDeb.Com_tiEAT12RingCntDebOk_C "debouncing parameter / Duration of healing debouncing for check DFC_ComEAT12RingCnt" VALUE 0x804D88E0 Val_Wu16 655350.0 DDRCTime_ms 0.00 655350.0 FORMAT "%8.1" /end CHARACTERISTIC
/begin CHARACTERISTIC DDRC_DurDeb.Com_tiEAT12RingCntDebDef_C "debouncing parameter / Duration of defect debouncing for check DFC_ComEAT12RingCnt" VALUE 0x804D88E2 Val_Wu16 655350.0 DDRCTime_ms 0.00 655350.0 FORMAT "%8.1" /end CHARACTERISTIC
/begin CHARACTERISTIC DDRC_DurDeb.Com_tiEAT12TOutDebOk_C "debouncing parameter / Duration of healing debouncing for check DFC_ComEAT12TOut" VALUE 0x804D88E4 Val_Wu16 655350.0 DDRCTime_ms 0.00 655350.0 FORMAT "%8.1" /end CHARACTERISTIC
/begin CHARACTERISTIC DDRC_DurDeb.Com_tiEAT12TOutDebDef_C "debouncing parameter / Duration of defect debouncing for check DFC_ComEAT12TOut" VALUE 0x804D88E6 Val_Wu16 655350.0 DDRCTime_ms 0.00 655350.0 FORMAT "%8.1" /end CHARACTERISTIC
/begin CHARACTERISTIC DDRC_DurDeb.Com_tiEAT13ChkSumDebOk_C "debouncing parameter / Duration of healing debouncing for check DFC_ComEAT13ChkSum" VALUE 0x804D88E8 Val_Wu16 655350.0 DDRCTime_ms 0.00 655350.0 FORMAT "%8.1" /end CHARACTERISTIC
/begin CHARACTERISTIC DDRC_DurDeb.Com_tiEAT13ChkSumDebDef_C "debouncing parameter / Duration of defect debouncing for check DFC_ComEAT13ChkSum" VALUE 0x804D88EA Val_Wu16 655350.0 DDRCTime_ms 0.00 655350.0 FORMAT "%8.1" /end CHARACTERISTIC
/begin CHARACTERISTIC DDRC_DurDeb.Com_tiEAT13RingCntDebOk_C "debouncing parameter / Duration of healing debouncing for check DFC_ComEAT13RingCnt" VALUE 0x804D88EC Val_Wu16 655350.0 DDRCTime_ms 0.00 655350.0 FORMAT "%8.1" /end CHARACTERISTIC
/begin CHARACTERISTIC DDRC_DurDeb.Com_tiEAT13RingCntDebDef_C "debouncing parameter / Duration of defect debouncing for check DFC_ComEAT13RingCnt" VALUE 0x804D88EE Val_Wu16 655350.0 DDRCTime_ms 0.00 655350.0 FORMAT "%8.1" /end CHARACTERISTIC
/begin CHARACTERISTIC DDRC_DurDeb.Com_tiEAT13TOutDebOk_C "debouncing parameter / Duration of healing debouncing for check DFC_ComEAT13TOut" VALUE 0x804D88F0 Val_Wu16 655350.0 DDRCTime_ms 0.00 655350.0 FORMAT "%8.1" /end CHARACTERISTIC
/begin CHARACTERISTIC DDRC_DurDeb.Com_tiEAT13TOutDebDef_C "debouncing parameter / Duration of defect debouncing for check DFC_ComEAT13TOut" VALUE 0x804D88F2 Val_Wu16 655350.0 DDRCTime_ms 0.00 655350.0 FORMAT "%8.1" /end CHARACTERISTIC
/begin CHARACTERISTIC DDRC_DurDeb.Com_tiEAT1ChksumDebOk_C "debouncing parameter / Duration of healing debouncing for check DFC_ComEAT1Chksum" VALUE 0x804D88F4 Val_Wu16 655350.0 DDRCTime_ms 0.00 655350.0 FORMAT "%8.1" /end CHARACTERISTIC
/begin CHARACTERISTIC DDRC_DurDeb.Com_tiEAT1ChksumDebDef_C "debouncing parameter / Duration of defect debouncing for check DFC_ComEAT1Chksum" VALUE 0x804D88F6 Val_Wu16 655350.0 DDRCTime_ms 0.00 655350.0 FORMAT "%8.1" /end CHARACTERISTIC
/begin CHARACTERISTIC DDRC_DurDeb.Com_tiEAT1RingCntDebOk_C "debouncing parameter / Duration of healing debouncing for check DFC_ComEAT1RingCnt" VALUE 0x804D88F8 Val_Wu16 655350.0 DDRCTime_ms 0.00 655350.0 FORMAT "%8.1" /end CHARACTERISTIC
/begin CHARACTERISTIC DDRC_DurDeb.Com_tiEAT1RingCntDebDef_C "debouncing parameter / Duration of defect debouncing for check DFC_ComEAT1RingCnt" VALUE 0x804D88FA Val_Wu16 655350.0 DDRCTime_ms 0.00 655350.0 FORMAT "%8.1" /end CHARACTERISTIC
/begin CHARACTERISTIC DDRC_DurDeb.Com_tiEAT1TOutDebOk_C "debouncing parameter / Duration of healing debouncing for check DFC_ComEAT1TOut" VALUE 0x804D88FC Val_Wu16 655350.0 DDRCTime_ms 0.00 655350.0 FORMAT "%8.1" /end CHARACTERISTIC
/begin CHARACTERISTIC DDRC_DurDeb.Com_tiEAT1TOutDebDef_C "debouncing parameter / Duration of defect debouncing for check DFC_ComEAT1TOut" VALUE 0x804D88FE Val_Wu16 655350.0 DDRCTime_ms 0.00 655350.0 FORMAT "%8.1" /end CHARACTERISTIC
/begin CHARACTERISTIC DDRC_DurDeb.Com_tiEAT2ChksumDebOk_C "debouncing parameter / Duration of healing debouncing for check DFC_ComEAT2ChkSum" VALUE 0x804D8900 Val_Wu16 655350.0 DDRCTime_ms 0.00 655350.0 FORMAT "%8.1" /end CHARACTERISTIC
/begin CHARACTERISTIC DDRC_DurDeb.Com_tiEAT2ChksumDebDef_C "debouncing parameter / Duration of defect debouncing for check DFC_ComEAT2ChkSum" VALUE 0x804D8902 Val_Wu16 655350.0 DDRCTime_ms 0.00 655350.0 FORMAT "%8.1" /end CHARACTERISTIC
/begin CHARACTERISTIC DDRC_DurDeb.Com_tiEAT2RingCntDebOk_C "debouncing parameter / Duration of healing debouncing for check DFC_ComEAT2RingCnt" VALUE 0x804D8904 Val_Wu16 655350.0 DDRCTime_ms 0.00 655350.0 FORMAT "%8.1" /end CHARACTERISTIC
/begin CHARACTERISTIC DDRC_DurDeb.Com_tiEAT2RingCntDebDef_C "debouncing parameter / Duration of defect debouncing for check DFC_ComEAT2RingCnt" VALUE 0x804D8906 Val_Wu16 655350.0 DDRCTime_ms 0.00 655350.0 FORMAT "%8.1" /end CHARACTERISTIC
/begin CHARACTERISTIC DDRC_DurDeb.Com_tiEAT2TOutDebOk_C "debouncing parameter / Duration of healing debouncing for check DFC_ComEAT2TOut" VALUE 0x804D8908 Val_Wu16 655350.0 DDRCTime_ms 0.00 655350.0 FORMAT "%8.1" /end CHARACTERISTIC
/begin CHARACTERISTIC DDRC_DurDeb.Com_tiEAT2TOutDebDef_C "debouncing parameter / Duration of defect debouncing for check DFC_ComEAT2TOut" VALUE 0x804D890A Val_Wu16 655350.0 DDRCTime_ms 0.00 655350.0 FORMAT "%8.1" /end CHARACTERISTIC
/begin CHARACTERISTIC DDRC_DurDeb.Com_tiEAT4ChksumDebOk_C "debouncing parameter / Duration of healing debouncing for check DFC_ComEAT4ChkSum" VALUE 0x804D890C Val_Wu16 655350.0 DDRCTime_ms 0.00 655350.0 FORMAT "%8.1" /end CHARACTERISTIC
/begin CHARACTERISTIC DDRC_DurDeb.Com_tiEAT4ChksumDebDef_C "debouncing parameter / Duration of defect debouncing for check DFC_ComEAT4ChkSum" VALUE 0x804D890E Val_Wu16 655350.0 DDRCTime_ms 0.00 655350.0 FORMAT "%8.1" /end CHARACTERISTIC
/begin CHARACTERISTIC DDRC_DurDeb.Com_tiEAT4RingCntDebOk_C "debouncing parameter / Duration of healing debouncing for check DFC_ComEAT4RingCnt" VALUE 0x804D8910 Val_Wu16 655350.0 DDRCTime_ms 0.00 655350.0 FORMAT "%8.1" /end CHARACTERISTIC
/begin CHARACTERISTIC DDRC_DurDeb.Com_tiEAT4RingCntDebDef_C "debouncing parameter / Duration of defect debouncing for check DFC_ComEAT4RingCnt" VALUE 0x804D8912 Val_Wu16 655350.0 DDRCTime_ms 0.00 655350.0 FORMAT "%8.1" /end CHARACTERISTIC
/begin CHARACTERISTIC DDRC_DurDeb.Com_tiEAT4TOutDebOk_C "debouncing parameter / Duration of healing debouncing for check DFC_ComEAT4TOut" VALUE 0x804D8914 Val_Wu16 655350.0 DDRCTime_ms 0.00 655350.0 FORMAT "%8.1" /end CHARACTERISTIC
/begin CHARACTERISTIC DDRC_DurDeb.Com_tiEAT4TOutDebDef_C "debouncing parameter / Duration of defect debouncing for check DFC_ComEAT4TOut" VALUE 0x804D8916 Val_Wu16 655350.0 DDRCTime_ms 0.00 655350.0 FORMAT "%8.1" /end CHARACTERISTIC
/begin CHARACTERISTIC DDRC_DurDeb.Com_tiEAT6ChkSumDebOk_C "debouncing parameter / Duration of healing debouncing for check DFC_ComEAT6Chksum" VALUE 0x804D8918 Val_Wu16 655350.0 DDRCTime_ms 0.00 655350.0 FORMAT "%8.1" /end CHARACTERISTIC
/begin CHARACTERISTIC DDRC_DurDeb.Com_tiEAT6ChkSumDebDef_C "debouncing parameter / Duration of defect debouncing for check DFC_ComEAT6Chksum" VALUE 0x804D891A Val_Wu16 655350.0 DDRCTime_ms 0.00 655350.0 FORMAT "%8.1" /end CHARACTERISTIC
/begin CHARACTERISTIC DDRC_DurDeb.Com_tiEAT6RingCntDebOk_C "debouncing parameter / Duration of healing debouncing for check DFC_ComEAT6RingCnt" VALUE 0x804D891C Val_Wu16 655350.0 DDRCTime_ms 0.00 655350.0 FORMAT "%8.1" /end CHARACTERISTIC
/begin CHARACTERISTIC DDRC_DurDeb.Com_tiEAT6RingCntDebDef_C "debouncing parameter / Duration of defect debouncing for check DFC_ComEAT6RingCnt" VALUE 0x804D891E Val_Wu16 655350.0 DDRCTime_ms 0.00 655350.0 FORMAT "%8.1" /end CHARACTERISTIC
/begin CHARACTERISTIC DDRC_DurDeb.Com_tiEAT6TOutDebOk_C "debouncing parameter / Duration of healing debouncing for check DFC_ComEAT6TOut" VALUE 0x804D8920 Val_Wu16 655350.0 DDRCTime_ms 0.00 655350.0 FORMAT "%8.1" /end CHARACTERISTIC
/begin CHARACTERISTIC DDRC_DurDeb.Com_tiEAT6TOutDebDef_C "debouncing parameter / Duration of defect debouncing for check DFC_ComEAT6TOut" VALUE 0x804D8922 Val_Wu16 655350.0 DDRCTime_ms 0.00 655350.0 FORMAT "%8.1" /end CHARACTERISTIC
/begin CHARACTERISTIC DDRC_DurDeb.Com_tiEAT7ChkSumDebOk_C "debouncing parameter / Duration of healing debouncing for check DFC_ComEAT7Chksum" VALUE 0x804D8924 Val_Wu16 655350.0 DDRCTime_ms 0.00 655350.0 FORMAT "%8.1" /end CHARACTERISTIC
/begin CHARACTERISTIC DDRC_DurDeb.Com_tiEAT7ChkSumDebDef_C "debouncing parameter / Duration of defect debouncing for check DFC_ComEAT7Chksum" VALUE 0x804D8926 Val_Wu16 655350.0 DDRCTime_ms 0.00 655350.0 FORMAT "%8.1" /end CHARACTERISTIC
/begin CHARACTERISTIC DDRC_DurDeb.Com_tiEAT7RingCntDebOk_C "debouncing parameter / Duration of healing debouncing for check DFC_ComEAT7RingCnt" VALUE 0x804D8928 Val_Wu16 655350.0 DDRCTime_ms 0.00 655350.0 FORMAT "%8.1" /end CHARACTERISTIC
/begin CHARACTERISTIC DDRC_DurDeb.Com_tiEAT7RingCntDebDef_C "debouncing parameter / Duration of defect debouncing for check DFC_ComEAT7RingCnt" VALUE 0x804D892A Val_Wu16 655350.0 DDRCTime_ms 0.00 655350.0 FORMAT "%8.1" /end CHARACTERISTIC
/begin CHARACTERISTIC DDRC_DurDeb.Com_tiEAT7TOutDebOk_C "debouncing parameter / Duration of healing debouncing for check DFC_ComEAT7TOut" VALUE 0x804D892C Val_Wu16 655350.0 DDRCTime_ms 0.00 655350.0 FORMAT "%8.1" /end CHARACTERISTIC
/begin CHARACTERISTIC DDRC_DurDeb.Com_tiEAT7TOutDebDef_C "debouncing parameter / Duration of defect debouncing for check DFC_ComEAT7TOut" VALUE 0x804D892E Val_Wu16 655350.0 DDRCTime_ms 0.00 655350.0 FORMAT "%8.1" /end CHARACTERISTIC
/begin CHARACTERISTIC DDRC_DurDeb.Com_tiEAT8ChkSumDebOk_C "debouncing parameter / Duration of healing debouncing for check DFC_ComEAT8Chksum" VALUE 0x804D8930 Val_Wu16 655350.0 DDRCTime_ms 0.00 655350.0 FORMAT "%8.1" /end CHARACTERISTIC
/begin CHARACTERISTIC DDRC_DurDeb.Com_tiEAT8ChkSumDebDef_C "debouncing parameter / Duration of defect debouncing for check DFC_ComEAT8Chksum" VALUE 0x804D8932 Val_Wu16 655350.0 DDRCTime_ms 0.00 655350.0 FORMAT "%8.1" /end CHARACTERISTIC
/begin CHARACTERISTIC DDRC_DurDeb.Com_tiEAT8RingCntDebOk_C "debouncing parameter / Duration of healing debouncing for check DFC_ComEAT8RingCnt" VALUE 0x804D8934 Val_Wu16 655350.0 DDRCTime_ms 0.00 655350.0 FORMAT "%8.1" /end CHARACTERISTIC
/begin CHARACTERISTIC DDRC_DurDeb.Com_tiEAT8RingCntDebDef_C "debouncing parameter / Duration of defect debouncing for check DFC_ComEAT8RingCnt" VALUE 0x804D8936 Val_Wu16 655350.0 DDRCTime_ms 0.00 655350.0 FORMAT "%8.1" /end CHARACTERISTIC
/begin CHARACTERISTIC DDRC_DurDeb.Com_tiEAT8TOutDebOk_C "debouncing parameter / Duration of healing debouncing for check DFC_ComEAT8TOut" VALUE 0x804D8938 Val_Wu16 655350.0 DDRCTime_ms 0.00 655350.0 FORMAT "%8.1" /end CHARACTERISTIC
/begin CHARACTERISTIC DDRC_DurDeb.Com_tiEAT8TOutDebDef_C "debouncing parameter / Duration of defect debouncing for check DFC_ComEAT8TOut" VALUE 0x804D893A Val_Wu16 655350.0 DDRCTime_ms 0.00 655350.0 FORMAT "%8.1" /end CHARACTERISTIC
/begin CHARACTERISTIC DDRC_DurDeb.Com_tiEATAChkSumDebOk_C "debouncing parameter / Duration of healing debouncing for check DFC_ComEATAChksum" VALUE 0x804D893C Val_Wu16 655350.0 DDRCTime_ms 0.00 655350.0 FORMAT "%8.1" /end CHARACTERISTIC
/begin CHARACTERISTIC DDRC_DurDeb.Com_tiEATAChkSumDebDef_C "debouncing parameter / Duration of defect debouncing for check DFC_ComEATAChksum" VALUE 0x804D893E Val_Wu16 655350.0 DDRCTime_ms 0.00 655350.0 FORMAT "%8.1" /end CHARACTERISTIC
/begin CHARACTERISTIC DDRC_DurDeb.Com_tiEATARingCntDebOk_C "debouncing parameter / Duration of healing debouncing for check DFC_ComEATARingCnt" VALUE 0x804D8940 Val_Wu16 655350.0 DDRCTime_ms 0.00 655350.0 FORMAT "%8.1" /end CHARACTERISTIC
/begin CHARACTERISTIC DDRC_DurDeb.Com_tiEATARingCntDebDef_C "debouncing parameter / Duration of defect debouncing for check DFC_ComEATARingCnt" VALUE 0x804D8942 Val_Wu16 655350.0 DDRCTime_ms 0.00 655350.0 FORMAT "%8.1" /end CHARACTERISTIC
/begin CHARACTERISTIC DDRC_DurDeb.Com_tiEATATOutDebOk_C "debouncing parameter / Duration of healing debouncing for check DFC_ComEATATOut" VALUE 0x804D8944 Val_Wu16 655350.0 DDRCTime_ms 0.00 655350.0 FORMAT "%8.1" /end CHARACTERISTIC
/begin CHARACTERISTIC DDRC_DurDeb.Com_tiEATATOutDebDef_C "debouncing parameter / Duration of defect debouncing for check DFC_ComEATATOut" VALUE 0x804D8946 Val_Wu16 655350.0 DDRCTime_ms 0.00 655350.0 FORMAT "%8.1" /end CHARACTERISTIC
/begin CHARACTERISTIC DDRC_DurDeb.Com_tiEATBChksumDebOk_C "debouncing parameter / Duration of healing debouncing for check DFC_ComEATBChkSum" VALUE 0x804D8948 Val_Wu16 655350.0 DDRCTime_ms 0.00 655350.0 FORMAT "%8.1" /end CHARACTERISTIC
/begin CHARACTERISTIC DDRC_DurDeb.Com_tiEATBChksumDebDef_C "debouncing parameter / Duration of defect debouncing for check DFC_ComEATBChkSum" VALUE 0x804D894A Val_Wu16 655350.0 DDRCTime_ms 0.00 655350.0 FORMAT "%8.1" /end CHARACTERISTIC
/begin CHARACTERISTIC DDRC_DurDeb.Com_tiEATBRingCntDebOk_C "debouncing parameter / Duration of healing debouncing for check DFC_ComEATBRingCnt" VALUE 0x804D894C Val_Wu16 655350.0 DDRCTime_ms 0.00 655350.0 FORMAT "%8.1" /end CHARACTERISTIC
/begin CHARACTERISTIC DDRC_DurDeb.Com_tiEATBRingCntDebDef_C "debouncing parameter / Duration of defect debouncing for check DFC_ComEATBRingCnt" VALUE 0x804D894E Val_Wu16 655350.0 DDRCTime_ms 0.00 655350.0 FORMAT "%8.1" /end CHARACTERISTIC
/begin CHARACTERISTIC DDRC_DurDeb.Com_tiEATBTOutDebOk_C "debouncing parameter / Duration of healing debouncing for check DFC_ComEATBTOut" VALUE 0x804D8950 Val_Wu16 655350.0 DDRCTime_ms 0.00 655350.0 FORMAT "%8.1" /end CHARACTERISTIC
/begin CHARACTERISTIC DDRC_DurDeb.Com_tiEATBTOutDebDef_C "debouncing parameter / Duration of defect debouncing for check DFC_ComEATBTOut" VALUE 0x804D8952 Val_Wu16 655350.0 DDRCTime_ms 0.00 655350.0 FORMAT "%8.1" /end CHARACTERISTIC
/begin CHARACTERISTIC DDRC_DurDeb.Com_tiEATCChkSumDebOk_C "debouncing parameter / Duration of healing debouncing for check DFC_ComEATCChksum" VALUE 0x804D8954 Val_Wu16 655350.0 DDRCTime_ms 0.00 655350.0 FORMAT "%8.1" /end CHARACTERISTIC
/begin CHARACTERISTIC DDRC_DurDeb.Com_tiEATCChkSumDebDef_C "debouncing parameter / Duration of defect debouncing for check DFC_ComEATCChksum" VALUE 0x804D8956 Val_Wu16 655350.0 DDRCTime_ms 0.00 655350.0 FORMAT "%8.1" /end CHARACTERISTIC
/begin CHARACTERISTIC DDRC_DurDeb.Com_tiEATCRingCntDebOk_C "debouncing parameter / Duration of healing debouncing for check DFC_ComEATCRingCnt" VALUE 0x804D8958 Val_Wu16 655350.0 DDRCTime_ms 0.00 655350.0 FORMAT "%8.1" /end CHARACTERISTIC
/begin CHARACTERISTIC DDRC_DurDeb.Com_tiEATCRingCntDebDef_C "debouncing parameter / Duration of defect debouncing for check DFC_ComEATCRingCnt" VALUE 0x804D895A Val_Wu16 655350.0 DDRCTime_ms 0.00 655350.0 FORMAT "%8.1" /end CHARACTERISTIC
/begin CHARACTERISTIC DDRC_DurDeb.Com_tiEATCTOutDebOk_C "debouncing parameter / Duration of healing debouncing for check DFC_ComEATCTOut" VALUE 0x804D895C Val_Wu16 655350.0 DDRCTime_ms 0.00 655350.0 FORMAT "%8.1" /end CHARACTERISTIC
/begin CHARACTERISTIC DDRC_DurDeb.Com_tiEATCTOutDebDef_C "debouncing parameter / Duration of defect debouncing for check DFC_ComEATCTOut" VALUE 0x804D895E Val_Wu16 655350.0 DDRCTime_ms 0.00 655350.0 FORMAT "%8.1" /end CHARACTERISTIC
/begin CHARACTERISTIC DDRC_DurDeb.Com_tiEBBAChksumDebOk_C "debouncing parameter / Duration of healing debouncing for check DFC_ComEBBAChksum" VALUE 0x804D8960 Val_Wu16 655350.0 DDRCTime_ms 0.00 655350.0 FORMAT "%8.1" /end CHARACTERISTIC
/begin CHARACTERISTIC DDRC_DurDeb.Com_tiEBBAChksumDebDef_C "debouncing parameter / Duration of defect debouncing for check DFC_ComEBBAChksum" VALUE 0x804D8962 Val_Wu16 655350.0 DDRCTime_ms 0.00 655350.0 FORMAT "%8.1" /end CHARACTERISTIC
/begin CHARACTERISTIC DDRC_DurDeb.Com_tiEBBARingCntDebOk_C "debouncing parameter / Duration of healing debouncing for check DFC_ComEBBARingCnt" VALUE 0x804D8964 Val_Wu16 655350.0 DDRCTime_ms 0.00 655350.0 FORMAT "%8.1" /end CHARACTERISTIC
/begin CHARACTERISTIC DDRC_DurDeb.Com_tiEBBARingCntDebDef_C "debouncing parameter / Duration of defect debouncing for check DFC_ComEBBARingCnt" VALUE 0x804D8966 Val_Wu16 655350.0 DDRCTime_ms 0.00 655350.0 FORMAT "%8.1" /end CHARACTERISTIC
/begin CHARACTERISTIC DDRC_DurDeb.Com_tiEBBATOutDebOk_C "debouncing parameter / Duration of healing debouncing for check DFC_ComEBBATOut" VALUE 0x804D8968 Val_Wu16 655350.0 DDRCTime_ms 0.00 655350.0 FORMAT "%8.1" /end CHARACTERISTIC
/begin CHARACTERISTIC DDRC_DurDeb.Com_tiEBBATOutDebDef_C "debouncing parameter / Duration of defect debouncing for check DFC_ComEBBATOut" VALUE 0x804D896A Val_Wu16 655350.0 DDRCTime_ms 0.00 655350.0 FORMAT "%8.1" /end CHARACTERISTIC
/begin CHARACTERISTIC DDRC_DurDeb.Com_tiEPS1ChksumDebOk_C "debouncing parameter / Duration of healing debouncing for check DFC_ComEPS1Chksum" VALUE 0x804D896C Val_Wu16 655350.0 DDRCTime_ms 0.00 655350.0 FORMAT "%8.1" /end CHARACTERISTIC
/begin CHARACTERISTIC DDRC_DurDeb.Com_tiEPS1ChksumDebDef_C "debouncing parameter / Duration of defect debouncing for check DFC_ComEPS1Chksum" VALUE 0x804D896E Val_Wu16 655350.0 DDRCTime_ms 0.00 655350.0 FORMAT "%8.1" /end CHARACTERISTIC
/begin CHARACTERISTIC DDRC_DurDeb.Com_tiEPS1RingCntDebOk_C "debouncing parameter / Duration of healing debouncing for check DFC_ComEPS1RingCnt" VALUE 0x804D8970 Val_Wu16 655350.0 DDRCTime_ms 0.00 655350.0 FORMAT "%8.1" /end CHARACTERISTIC
/begin CHARACTERISTIC DDRC_DurDeb.Com_tiEPS1RingCntDebDef_C "debouncing parameter / Duration of defect debouncing for check DFC_ComEPS1RingCnt" VALUE 0x804D8972 Val_Wu16 655350.0 DDRCTime_ms 0.00 655350.0 FORMAT "%8.1" /end CHARACTERISTIC
/begin CHARACTERISTIC DDRC_DurDeb.Com_tiEPS1TOutDebOk_C "debouncing parameter / Duration of healing debouncing for check DFC_ComEPS1TOut" VALUE 0x804D8974 Val_Wu16 655350.0 DDRCTime_ms 0.00 655350.0 FORMAT "%8.1" /end CHARACTERISTIC
/begin CHARACTERISTIC DDRC_DurDeb.Com_tiEPS1TOutDebDef_C "debouncing parameter / Duration of defect debouncing for check DFC_ComEPS1TOut" VALUE 0x804D8976 Val_Wu16 655350.0 DDRCTime_ms 0.00 655350.0 FORMAT "%8.1" /end CHARACTERISTIC
/begin CHARACTERISTIC DDRC_DurDeb.Com_tiEngCanRxErrDebOk_C "debouncing parameter / Duration of healing debouncing for check DFC_ComEngCanRxErr" VALUE 0x804D8978 Val_Wu16 655350.0 DDRCTime_ms 0.00 655350.0 FORMAT "%8.1" /end CHARACTERISTIC
/begin CHARACTERISTIC DDRC_DurDeb.Com_tiEngCanRxErrDebDef_C "debouncing parameter / Duration of defect debouncing for check DFC_ComEngCanRxErr" VALUE 0x804D897A Val_Wu16 655350.0 DDRCTime_ms 0.00 655350.0 FORMAT "%8.1" /end CHARACTERISTIC
/begin CHARACTERISTIC DDRC_DurDeb.Com_tiGrvySnsrErrDebOk_C "debouncing parameter / Duration of healing debouncing for check DFC_ComGrvySnsrErr" VALUE 0x804D897C Val_Wu16 655350.0 DDRCTime_ms 0.00 655350.0 FORMAT "%8.1" /end CHARACTERISTIC
/begin CHARACTERISTIC DDRC_DurDeb.Com_tiGrvySnsrErrDebDef_C "debouncing parameter / Duration of defect debouncing for check DFC_ComGrvySnsrErr" VALUE 0x804D897E Val_Wu16 655350.0 DDRCTime_ms 0.00 655350.0 FORMAT "%8.1" /end CHARACTERISTIC
/begin CHARACTERISTIC DDRC_DurDeb.Com_tiGwIMG1ChkSumDebOk_C "debouncing parameter / Duration of healing debouncing for check DFC_ComGwIMG1ChkSum" VALUE 0x804D8980 Val_Wu16 655350.0 DDRCTime_ms 0.00 655350.0 FORMAT "%8.1" /end CHARACTERISTIC
/begin CHARACTERISTIC DDRC_DurDeb.Com_tiGwIMG1ChkSumDebDef_C "debouncing parameter / Duration of defect debouncing for check DFC_ComGwIMG1ChkSum" VALUE 0x804D8982 Val_Wu16 655350.0 DDRCTime_ms 0.00 655350.0 FORMAT "%8.1" /end CHARACTERISTIC
/begin CHARACTERISTIC DDRC_DurDeb.Com_tiGwIMG1RingCntDebOk_C "debouncing parameter / Duration of healing debouncing for check DFC_ComGwIMG1RingCnt" VALUE 0x804D8984 Val_Wu16 655350.0 DDRCTime_ms 0.00 655350.0 FORMAT "%8.1" /end CHARACTERISTIC
/begin CHARACTERISTIC DDRC_DurDeb.Com_tiGwIMG1RingCntDebDef_C "debouncing parameter / Duration of defect debouncing for check DFC_ComGwIMG1RingCnt" VALUE 0x804D8986 Val_Wu16 655350.0 DDRCTime_ms 0.00 655350.0 FORMAT "%8.1" /end CHARACTERISTIC
/begin CHARACTERISTIC DDRC_DurDeb.Com_tiGwIMG1TOutDebOk_C "debouncing parameter / Duration of healing debouncing for check DFC_ComGwIMG1TOut" VALUE 0x804D8988 Val_Wu16 655350.0 DDRCTime_ms 0.00 655350.0 FORMAT "%8.1" /end CHARACTERISTIC
/begin CHARACTERISTIC DDRC_DurDeb.Com_tiGwIMG1TOutDebDef_C "debouncing parameter / Duration of defect debouncing for check DFC_ComGwIMG1TOut" VALUE 0x804D898A Val_Wu16 655350.0 DDRCTime_ms 0.00 655350.0 FORMAT "%8.1" /end CHARACTERISTIC
/begin CHARACTERISTIC DDRC_DurDeb.Com_tiGwIMG3ChkSumDebOk_C "debouncing parameter / Duration of healing debouncing for check DFC_ComGwIMG3ChkSum" VALUE 0x804D898C Val_Wu16 655350.0 DDRCTime_ms 0.00 655350.0 FORMAT "%8.1" /end CHARACTERISTIC
/begin CHARACTERISTIC DDRC_DurDeb.Com_tiGwIMG3ChkSumDebDef_C "debouncing parameter / Duration of defect debouncing for check DFC_ComGwIMG3ChkSum" VALUE 0x804D898E Val_Wu16 655350.0 DDRCTime_ms 0.00 655350.0 FORMAT "%8.1" /end CHARACTERISTIC
/begin CHARACTERISTIC DDRC_DurDeb.Com_tiGwIMG3RingCntDebOk_C "debouncing parameter / Duration of healing debouncing for check DFC_ComGwIMG3RingCnt" VALUE 0x804D8990 Val_Wu16 655350.0 DDRCTime_ms 0.00 655350.0 FORMAT "%8.1" /end CHARACTERISTIC
/begin CHARACTERISTIC DDRC_DurDeb.Com_tiGwIMG3RingCntDebDef_C "debouncing parameter / Duration of defect debouncing for check DFC_ComGwIMG3RingCnt" VALUE 0x804D8992 Val_Wu16 655350.0 DDRCTime_ms 0.00 655350.0 FORMAT "%8.1" /end CHARACTERISTIC
/begin CHARACTERISTIC DDRC_DurDeb.Com_tiGwIMG3TOutDebOk_C "debouncing parameter / Duration of healing debouncing for check DFC_ComGwIMG3TOut" VALUE 0x804D8994 Val_Wu16 655350.0 DDRCTime_ms 0.00 655350.0 FORMAT "%8.1" /end CHARACTERISTIC
/begin CHARACTERISTIC DDRC_DurDeb.Com_tiGwIMG3TOutDebDef_C "debouncing parameter / Duration of defect debouncing for check DFC_ComGwIMG3TOut" VALUE 0x804D8996 Val_Wu16 655350.0 DDRCTime_ms 0.00 655350.0 FORMAT "%8.1" /end CHARACTERISTIC
/begin CHARACTERISTIC DDRC_DurDeb.Com_tiGwIMG4ChkSumDebOk_C "debouncing parameter / Duration of healing debouncing for check DFC_ComGwIMG4ChkSum" VALUE 0x804D8998 Val_Wu16 655350.0 DDRCTime_ms 0.00 655350.0 FORMAT "%8.1" /end CHARACTERISTIC
/begin CHARACTERISTIC DDRC_DurDeb.Com_tiGwIMG4ChkSumDebDef_C "debouncing parameter / Duration of defect debouncing for check DFC_ComGwIMG4ChkSum" VALUE 0x804D899A Val_Wu16 655350.0 DDRCTime_ms 0.00 655350.0 FORMAT "%8.1" /end CHARACTERISTIC
/begin CHARACTERISTIC DDRC_DurDeb.Com_tiGwIMG4RingCntDebOk_C "debouncing parameter / Duration of healing debouncing for check DFC_ComGwIMG4RingCnt" VALUE 0x804D899C Val_Wu16 655350.0 DDRCTime_ms 0.00 655350.0 FORMAT "%8.1" /end CHARACTERISTIC
/begin CHARACTERISTIC DDRC_DurDeb.Com_tiGwIMG4RingCntDebDef_C "debouncing parameter / Duration of defect debouncing for check DFC_ComGwIMG4RingCnt" VALUE 0x804D899E Val_Wu16 655350.0 DDRCTime_ms 0.00 655350.0 FORMAT "%8.1" /end CHARACTERISTIC
/begin CHARACTERISTIC DDRC_DurDeb.Com_tiGwIMG4TOutDebOk_C "debouncing parameter / Duration of healing debouncing for check DFC_ComGwIMG4TOut" VALUE 0x804D89A0 Val_Wu16 655350.0 DDRCTime_ms 0.00 655350.0 FORMAT "%8.1" /end CHARACTERISTIC
/begin CHARACTERISTIC DDRC_DurDeb.Com_tiGwIMG4TOutDebDef_C "debouncing parameter / Duration of defect debouncing for check DFC_ComGwIMG4TOut" VALUE 0x804D89A2 Val_Wu16 655350.0 DDRCTime_ms 0.00 655350.0 FORMAT "%8.1" /end CHARACTERISTIC
/begin CHARACTERISTIC DDRC_DurDeb.Com_tiGwIMG5ChkSumDebOk_C "debouncing parameter / Duration of healing debouncing for check DFC_ComGwIMG5ChkSum" VALUE 0x804D89A4 Val_Wu16 655350.0 DDRCTime_ms 0.00 655350.0 FORMAT "%8.1" /end CHARACTERISTIC
/begin CHARACTERISTIC DDRC_DurDeb.Com_tiGwIMG5ChkSumDebDef_C "debouncing parameter / Duration of defect debouncing for check DFC_ComGwIMG5ChkSum" VALUE 0x804D89A6 Val_Wu16 655350.0 DDRCTime_ms 0.00 655350.0 FORMAT "%8.1" /end CHARACTERISTIC
/begin CHARACTERISTIC DDRC_DurDeb.Com_tiGwIMG5RingCntDebOk_C "debouncing parameter / Duration of healing debouncing for check DFC_ComGwIMG5RingCnt" VALUE 0x804D89A8 Val_Wu16 655350.0 DDRCTime_ms 0.00 655350.0 FORMAT "%8.1" /end CHARACTERISTIC
/begin CHARACTERISTIC DDRC_DurDeb.Com_tiGwIMG5RingCntDebDef_C "debouncing parameter / Duration of defect debouncing for check DFC_ComGwIMG5RingCnt" VALUE 0x804D89AA Val_Wu16 655350.0 DDRCTime_ms 0.00 655350.0 FORMAT "%8.1" /end CHARACTERISTIC
/begin CHARACTERISTIC DDRC_DurDeb.Com_tiGwIMG5TOutDebOk_C "debouncing parameter / Duration of healing debouncing for check DFC_ComGwIMG5TOut" VALUE 0x804D89AC Val_Wu16 655350.0 DDRCTime_ms 0.00 655350.0 FORMAT "%8.1" /end CHARACTERISTIC
/begin CHARACTERISTIC DDRC_DurDeb.Com_tiGwIMG5TOutDebDef_C "debouncing parameter / Duration of defect debouncing for check DFC_ComGwIMG5TOut" VALUE 0x804D89AE Val_Wu16 655350.0 DDRCTime_ms 0.00 655350.0 FORMAT "%8.1" /end CHARACTERISTIC
/begin CHARACTERISTIC DDRC_DurDeb.Com_tiGwIMG6ChkSumDebOk_C "debouncing parameter / Duration of healing debouncing for check DFC_ComGwIMG6ChkSum" VALUE 0x804D89B0 Val_Wu16 655350.0 DDRCTime_ms 0.00 655350.0 FORMAT "%8.1" /end CHARACTERISTIC
/begin CHARACTERISTIC DDRC_DurDeb.Com_tiGwIMG6ChkSumDebDef_C "debouncing parameter / Duration of defect debouncing for check DFC_ComGwIMG6ChkSum" VALUE 0x804D89B2 Val_Wu16 655350.0 DDRCTime_ms 0.00 655350.0 FORMAT "%8.1" /end CHARACTERISTIC
/begin CHARACTERISTIC DDRC_DurDeb.Com_tiGwIMG6RingCntDebOk_C "debouncing parameter / Duration of healing debouncing for check DFC_ComGwIMG6RingCnt" VALUE 0x804D89B4 Val_Wu16 655350.0 DDRCTime_ms 0.00 655350.0 FORMAT "%8.1" /end CHARACTERISTIC
/begin CHARACTERISTIC DDRC_DurDeb.Com_tiGwIMG6RingCntDebDef_C "debouncing parameter / Duration of defect debouncing for check DFC_ComGwIMG6RingCnt" VALUE 0x804D89B6 Val_Wu16 655350.0 DDRCTime_ms 0.00 655350.0 FORMAT "%8.1" /end CHARACTERISTIC
/begin CHARACTERISTIC DDRC_DurDeb.Com_tiGwIMG6TOutDebOk_C "debouncing parameter / Duration of healing debouncing for check DFC_ComGwIMG6TOut" VALUE 0x804D89B8 Val_Wu16 655350.0 DDRCTime_ms 0.00 655350.0 FORMAT "%8.1" /end CHARACTERISTIC
/begin CHARACTERISTIC DDRC_DurDeb.Com_tiGwIMG6TOutDebDef_C "debouncing parameter / Duration of defect debouncing for check DFC_ComGwIMG6TOut" VALUE 0x804D89BA Val_Wu16 655350.0 DDRCTime_ms 0.00 655350.0 FORMAT "%8.1" /end CHARACTERISTIC
/begin CHARACTERISTIC DDRC_DurDeb.Com_tiIDASBChkSumDebOk_C "debouncing parameter / Duration of healing debouncing for check DFC_ComIDASBChksum" VALUE 0x804D89BC Val_Wu16 655350.0 DDRCTime_ms 0.00 655350.0 FORMAT "%8.1" /end CHARACTERISTIC
/begin CHARACTERISTIC DDRC_DurDeb.Com_tiIDASBChkSumDebDef_C "debouncing parameter / Duration of defect debouncing for check DFC_ComIDASBChksum" VALUE 0x804D89BE Val_Wu16 655350.0 DDRCTime_ms 0.00 655350.0 FORMAT "%8.1" /end CHARACTERISTIC
/begin CHARACTERISTIC DDRC_DurDeb.Com_tiIDASBRingCntDebOk_C "debouncing parameter / Duration of healing debouncing for check DFC_ComIDASBRingCnt" VALUE 0x804D89C0 Val_Wu16 655350.0 DDRCTime_ms 0.00 655350.0 FORMAT "%8.1" /end CHARACTERISTIC
/begin CHARACTERISTIC DDRC_DurDeb.Com_tiIDASBRingCntDebDef_C "debouncing parameter / Duration of defect debouncing for check DFC_ComIDASBRingCnt" VALUE 0x804D89C2 Val_Wu16 655350.0 DDRCTime_ms 0.00 655350.0 FORMAT "%8.1" /end CHARACTERISTIC
/begin CHARACTERISTIC DDRC_DurDeb.Com_tiIDASBTOutDebOk_C "debouncing parameter / Duration of healing debouncing for check DFC_ComIDASBTOut" VALUE 0x804D89C4 Val_Wu16 655350.0 DDRCTime_ms 0.00 655350.0 FORMAT "%8.1" /end CHARACTERISTIC
/begin CHARACTERISTIC DDRC_DurDeb.Com_tiIDASBTOutDebDef_C "debouncing parameter / Duration of defect debouncing for check DFC_ComIDASBTOut" VALUE 0x804D89C6 Val_Wu16 655350.0 DDRCTime_ms 0.00 655350.0 FORMAT "%8.1" /end CHARACTERISTIC
/begin CHARACTERISTIC DDRC_DurDeb.Com_tiIMGMILReqDebOk_C "debouncing parameter / Duration of healing debouncing for check DFC_ComIMGMILReq" VALUE 0x804D89C8 Val_Wu16 655350.0 DDRCTime_ms 0.00 655350.0 FORMAT "%8.1" /end CHARACTERISTIC
/begin CHARACTERISTIC DDRC_DurDeb.Com_tiIMGMILReqDebDef_C "debouncing parameter / Duration of defect debouncing for check DFC_ComIMGMILReq" VALUE 0x804D89CA Val_Wu16 655350.0 DDRCTime_ms 0.00 655350.0 FORMAT "%8.1" /end CHARACTERISTIC
/begin CHARACTERISTIC DDRC_DurDeb.Com_tiISSPrmsDebOk_C "debouncing parameter / Duration of healing debouncing for check DFC_ComISSPrms" VALUE 0x804D89CC Val_Wu16 655350.0 DDRCTime_ms 0.00 655350.0 FORMAT "%8.1" /end CHARACTERISTIC
/begin CHARACTERISTIC DDRC_DurDeb.Com_tiISSPrmsDebDef_C "debouncing parameter / Duration of defect debouncing for check DFC_ComISSPrms" VALUE 0x804D89CE Val_Wu16 655350.0 DDRCTime_ms 0.00 655350.0 FORMAT "%8.1" /end CHARACTERISTIC
/begin CHARACTERISTIC DDRC_DurDeb.Com_tiMETACSumDebOk_C "debouncing parameter / Duration of healing debouncing for check DFC_ComMETAChksum" VALUE 0x804D89D0 Val_Wu16 655350.0 DDRCTime_ms 0.00 655350.0 FORMAT "%8.1" /end CHARACTERISTIC
/begin CHARACTERISTIC DDRC_DurDeb.Com_tiMETACSumDebDef_C "debouncing parameter / Duration of defect debouncing for check DFC_ComMETAChksum" VALUE 0x804D89D2 Val_Wu16 655350.0 DDRCTime_ms 0.00 655350.0 FORMAT "%8.1" /end CHARACTERISTIC
/begin CHARACTERISTIC DDRC_DurDeb.Com_tiMETActRingDebOk_C "debouncing parameter / Duration of healing debouncing for check DFC_ComMETARingCnt" VALUE 0x804D89D4 Val_Wu16 655350.0 DDRCTime_ms 0.00 655350.0 FORMAT "%8.1" /end CHARACTERISTIC
/begin CHARACTERISTIC DDRC_DurDeb.Com_tiMETActRingDebDef_C "debouncing parameter / Duration of defect debouncing for check DFC_ComMETARingCnt" VALUE 0x804D89D6 Val_Wu16 655350.0 DDRCTime_ms 0.00 655350.0 FORMAT "%8.1" /end CHARACTERISTIC
/begin CHARACTERISTIC DDRC_DurDeb.Com_tiMETAtiDebDebOk_C "debouncing parameter / Duration of healing debouncing for check DFC_ComMETATOut" VALUE 0x804D89D8 Val_Wu16 655350.0 DDRCTime_ms 0.00 655350.0 FORMAT "%8.1" /end CHARACTERISTIC
/begin CHARACTERISTIC DDRC_DurDeb.Com_tiMETAtiDebDebDef_C "debouncing parameter / Duration of defect debouncing for check DFC_ComMETATOut" VALUE 0x804D89DA Val_Wu16 655350.0 DDRCTime_ms 0.00 655350.0 FORMAT "%8.1" /end CHARACTERISTIC
/begin CHARACTERISTIC DDRC_DurDeb.Com_tiMETCCSumDebOk_C "debouncing parameter / Duration of healing debouncing for check DFC_ComMETCChksum" VALUE 0x804D89DC Val_Wu16 655350.0 DDRCTime_ms 0.00 655350.0 FORMAT "%8.1" /end CHARACTERISTIC
/begin CHARACTERISTIC DDRC_DurDeb.Com_tiMETCCSumDebDef_C "debouncing parameter / Duration of defect debouncing for check DFC_ComMETCChksum" VALUE 0x804D89DE Val_Wu16 655350.0 DDRCTime_ms 0.00 655350.0 FORMAT "%8.1" /end CHARACTERISTIC
/begin CHARACTERISTIC DDRC_DurDeb.Com_tiMETCctRingDebOk_C "debouncing parameter / Duration of healing debouncing for check DFC_ComMETCRingCnt" VALUE 0x804D89E0 Val_Wu16 655350.0 DDRCTime_ms 0.00 655350.0 FORMAT "%8.1" /end CHARACTERISTIC
/begin CHARACTERISTIC DDRC_DurDeb.Com_tiMETCctRingDebDef_C "debouncing parameter / Duration of defect debouncing for check DFC_ComMETCRingCnt" VALUE 0x804D89E2 Val_Wu16 655350.0 DDRCTime_ms 0.00 655350.0 FORMAT "%8.1" /end CHARACTERISTIC
/begin CHARACTERISTIC DDRC_DurDeb.Com_tiMETCtiDebDebOk_C "debouncing parameter / Duration of healing debouncing for check DFC_ComMETCTOut" VALUE 0x804D89E4 Val_Wu16 655350.0 DDRCTime_ms 0.00 655350.0 FORMAT "%8.1" /end CHARACTERISTIC
/begin CHARACTERISTIC DDRC_DurDeb.Com_tiMETCtiDebDebDef_C "debouncing parameter / Duration of defect debouncing for check DFC_ComMETCTOut" VALUE 0x804D89E6 Val_Wu16 655350.0 DDRCTime_ms 0.00 655350.0 FORMAT "%8.1" /end CHARACTERISTIC
/begin CHARACTERISTIC DDRC_DurDeb.Com_tiMETDCSumDebOk_C "debouncing parameter / Duration of healing debouncing for check DFC_ComMETDChksum" VALUE 0x804D89E8 Val_Wu16 655350.0 DDRCTime_ms 0.00 655350.0 FORMAT "%8.1" /end CHARACTERISTIC
/begin CHARACTERISTIC DDRC_DurDeb.Com_tiMETDCSumDebDef_C "debouncing parameter / Duration of defect debouncing for check DFC_ComMETDChksum" VALUE 0x804D89EA Val_Wu16 655350.0 DDRCTime_ms 0.00 655350.0 FORMAT "%8.1" /end CHARACTERISTIC
/begin CHARACTERISTIC DDRC_DurDeb.Com_tiMETDctRingDebOk_C "debouncing parameter / Duration of healing debouncing for check DFC_ComMETDRingCnt" VALUE 0x804D89EC Val_Wu16 655350.0 DDRCTime_ms 0.00 655350.0 FORMAT "%8.1" /end CHARACTERISTIC
/begin CHARACTERISTIC DDRC_DurDeb.Com_tiMETDctRingDebDef_C "debouncing parameter / Duration of defect debouncing for check DFC_ComMETDRingCnt" VALUE 0x804D89EE Val_Wu16 655350.0 DDRCTime_ms 0.00 655350.0 FORMAT "%8.1" /end CHARACTERISTIC
/begin CHARACTERISTIC DDRC_DurDeb.Com_tiMETDtiDebDebOk_C "debouncing parameter / Duration of healing debouncing for check DFC_ComMETDTOut" VALUE 0x804D89F0 Val_Wu16 655350.0 DDRCTime_ms 0.00 655350.0 FORMAT "%8.1" /end CHARACTERISTIC
/begin CHARACTERISTIC DDRC_DurDeb.Com_tiMETDtiDebDebDef_C "debouncing parameter / Duration of defect debouncing for check DFC_ComMETDTOut" VALUE 0x804D89F2 Val_Wu16 655350.0 DDRCTime_ms 0.00 655350.0 FORMAT "%8.1" /end CHARACTERISTIC
/begin CHARACTERISTIC DDRC_DurDeb.Com_tiMETE2CSumDebOk_C "debouncing parameter / Duration of healing debouncing for check DFC_ComMETE2Chksum" VALUE 0x804D89F4 Val_Wu16 655350.0 DDRCTime_ms 0.00 655350.0 FORMAT "%8.1" /end CHARACTERISTIC
/begin CHARACTERISTIC DDRC_DurDeb.Com_tiMETE2CSumDebDef_C "debouncing parameter / Duration of defect debouncing for check DFC_ComMETE2Chksum" VALUE 0x804D89F6 Val_Wu16 655350.0 DDRCTime_ms 0.00 655350.0 FORMAT "%8.1" /end CHARACTERISTIC
/begin CHARACTERISTIC DDRC_DurDeb.Com_tiMETE2ctRingDebOk_C "debouncing parameter / Duration of healing debouncing for check DFC_ComMETE2RingCnt" VALUE 0x804D89F8 Val_Wu16 655350.0 DDRCTime_ms 0.00 655350.0 FORMAT "%8.1" /end CHARACTERISTIC
/begin CHARACTERISTIC DDRC_DurDeb.Com_tiMETE2ctRingDebDef_C "debouncing parameter / Duration of defect debouncing for check DFC_ComMETE2RingCnt" VALUE 0x804D89FA Val_Wu16 655350.0 DDRCTime_ms 0.00 655350.0 FORMAT "%8.1" /end CHARACTERISTIC
/begin CHARACTERISTIC DDRC_DurDeb.Com_tiMETE2tiDebDebOk_C "debouncing parameter / Duration of healing debouncing for check DFC_ComMETE2TOut" VALUE 0x804D89FC Val_Wu16 655350.0 DDRCTime_ms 0.00 655350.0 FORMAT "%8.1" /end CHARACTERISTIC
/begin CHARACTERISTIC DDRC_DurDeb.Com_tiMETE2tiDebDebDef_C "debouncing parameter / Duration of defect debouncing for check DFC_ComMETE2TOut" VALUE 0x804D89FE Val_Wu16 655350.0 DDRCTime_ms 0.00 655350.0 FORMAT "%8.1" /end CHARACTERISTIC
/begin CHARACTERISTIC DDRC_DurDeb.Com_tiMETFChksumDebOk_C "debouncing parameter / Duration of healing debouncing for check DFC_ComMETFChksum" VALUE 0x804D8A00 Val_Wu16 655350.0 DDRCTime_ms 0.00 655350.0 FORMAT "%8.1" /end CHARACTERISTIC
/begin CHARACTERISTIC DDRC_DurDeb.Com_tiMETFChksumDebDef_C "debouncing parameter / Duration of defect debouncing for check DFC_ComMETFChksum" VALUE 0x804D8A02 Val_Wu16 655350.0 DDRCTime_ms 0.00 655350.0 FORMAT "%8.1" /end CHARACTERISTIC
/begin CHARACTERISTIC DDRC_DurDeb.Com_tiMETFRingCntDebOk_C "debouncing parameter / Duration of healing debouncing for check DFC_ComMETFRingCnt" VALUE 0x804D8A04 Val_Wu16 655350.0 DDRCTime_ms 0.00 655350.0 FORMAT "%8.1" /end CHARACTERISTIC
/begin CHARACTERISTIC DDRC_DurDeb.Com_tiMETFRingCntDebDef_C "debouncing parameter / Duration of defect debouncing for check DFC_ComMETFRingCnt" VALUE 0x804D8A06 Val_Wu16 655350.0 DDRCTime_ms 0.00 655350.0 FORMAT "%8.1" /end CHARACTERISTIC
/begin CHARACTERISTIC DDRC_DurDeb.Com_tiMETFTOutDebOk_C "debouncing parameter / Duration of healing debouncing for check DFC_ComMETFTOut" VALUE 0x804D8A08 Val_Wu16 655350.0 DDRCTime_ms 0.00 655350.0 FORMAT "%8.1" /end CHARACTERISTIC
/begin CHARACTERISTIC DDRC_DurDeb.Com_tiMETFTOutDebDef_C "debouncing parameter / Duration of defect debouncing for check DFC_ComMETFTOut" VALUE 0x804D8A0A Val_Wu16 655350.0 DDRCTime_ms 0.00 655350.0 FORMAT "%8.1" /end CHARACTERISTIC
/begin CHARACTERISTIC DDRC_DurDeb.Com_tiMETGCSumDebOk_C "debouncing parameter / Duration of healing debouncing for check DFC_ComMETGChksum" VALUE 0x804D8A0C Val_Wu16 655350.0 DDRCTime_ms 0.00 655350.0 FORMAT "%8.1" /end CHARACTERISTIC
/begin CHARACTERISTIC DDRC_DurDeb.Com_tiMETGCSumDebDef_C "debouncing parameter / Duration of defect debouncing for check DFC_ComMETGChksum" VALUE 0x804D8A0E Val_Wu16 655350.0 DDRCTime_ms 0.00 655350.0 FORMAT "%8.1" /end CHARACTERISTIC
/begin CHARACTERISTIC DDRC_DurDeb.Com_tiMETGctRingDebOk_C "debouncing parameter / Duration of healing debouncing for check DFC_ComMETGRingCnt" VALUE 0x804D8A10 Val_Wu16 655350.0 DDRCTime_ms 0.00 655350.0 FORMAT "%8.1" /end CHARACTERISTIC
/begin CHARACTERISTIC DDRC_DurDeb.Com_tiMETGctRingDebDef_C "debouncing parameter / Duration of defect debouncing for check DFC_ComMETGRingCnt" VALUE 0x804D8A12 Val_Wu16 655350.0 DDRCTime_ms 0.00 655350.0 FORMAT "%8.1" /end CHARACTERISTIC
/begin CHARACTERISTIC DDRC_DurDeb.Com_tiMETGtiDebDebOk_C "debouncing parameter / Duration of healing debouncing for check DFC_ComMETGTOut" VALUE 0x804D8A14 Val_Wu16 655350.0 DDRCTime_ms 0.00 655350.0 FORMAT "%8.1" /end CHARACTERISTIC
/begin CHARACTERISTIC DDRC_DurDeb.Com_tiMETGtiDebDebDef_C "debouncing parameter / Duration of defect debouncing for check DFC_ComMETGTOut" VALUE 0x804D8A16 Val_Wu16 655350.0 DDRCTime_ms 0.00 655350.0 FORMAT "%8.1" /end CHARACTERISTIC
/begin CHARACTERISTIC DDRC_DurDeb.Com_tiMETH2CSumDebOk_C "debouncing parameter / Duration of healing debouncing for check DFC_ComMETH2Chksum" VALUE 0x804D8A18 Val_Wu16 655350.0 DDRCTime_ms 0.00 655350.0 FORMAT "%8.1" /end CHARACTERISTIC
/begin CHARACTERISTIC DDRC_DurDeb.Com_tiMETH2CSumDebDef_C "debouncing parameter / Duration of defect debouncing for check DFC_ComMETH2Chksum" VALUE 0x804D8A1A Val_Wu16 655350.0 DDRCTime_ms 0.00 655350.0 FORMAT "%8.1" /end CHARACTERISTIC
/begin CHARACTERISTIC DDRC_DurDeb.Com_tiMETH2ctRingDebOk_C "debouncing parameter / Duration of healing debouncing for check DFC_ComMETH2RingCnt" VALUE 0x804D8A1C Val_Wu16 655350.0 DDRCTime_ms 0.00 655350.0 FORMAT "%8.1" /end CHARACTERISTIC
/begin CHARACTERISTIC DDRC_DurDeb.Com_tiMETH2ctRingDebDef_C "debouncing parameter / Duration of defect debouncing for check DFC_ComMETH2RingCnt" VALUE 0x804D8A1E Val_Wu16 655350.0 DDRCTime_ms 0.00 655350.0 FORMAT "%8.1" /end CHARACTERISTIC
/begin CHARACTERISTIC DDRC_DurDeb.Com_tiMETH2tiDebDebOk_C "debouncing parameter / Duration of healing debouncing for check DFC_ComMETH2TOut" VALUE 0x804D8A20 Val_Wu16 655350.0 DDRCTime_ms 0.00 655350.0 FORMAT "%8.1" /end CHARACTERISTIC
/begin CHARACTERISTIC DDRC_DurDeb.Com_tiMETH2tiDebDebDef_C "debouncing parameter / Duration of defect debouncing for check DFC_ComMETH2TOut" VALUE 0x804D8A22 Val_Wu16 655350.0 DDRCTime_ms 0.00 655350.0 FORMAT "%8.1" /end CHARACTERISTIC
/begin CHARACTERISTIC DDRC_DurDeb.Com_tiMETHCSumDebOk_C "debouncing parameter / Duration of healing debouncing for check DFC_ComMETHChksum" VALUE 0x804D8A24 Val_Wu16 655350.0 DDRCTime_ms 0.00 655350.0 FORMAT "%8.1" /end CHARACTERISTIC
/begin CHARACTERISTIC DDRC_DurDeb.Com_tiMETHCSumDebDef_C "debouncing parameter / Duration of defect debouncing for check DFC_ComMETHChksum" VALUE 0x804D8A26 Val_Wu16 655350.0 DDRCTime_ms 0.00 655350.0 FORMAT "%8.1" /end CHARACTERISTIC
/begin CHARACTERISTIC DDRC_DurDeb.Com_tiMETHctRingDebOk_C "debouncing parameter / Duration of healing debouncing for check DFC_ComMETHRingCnt" VALUE 0x804D8A28 Val_Wu16 655350.0 DDRCTime_ms 0.00 655350.0 FORMAT "%8.1" /end CHARACTERISTIC
/begin CHARACTERISTIC DDRC_DurDeb.Com_tiMETHctRingDebDef_C "debouncing parameter / Duration of defect debouncing for check DFC_ComMETHRingCnt" VALUE 0x804D8A2A Val_Wu16 655350.0 DDRCTime_ms 0.00 655350.0 FORMAT "%8.1" /end CHARACTERISTIC
/begin CHARACTERISTIC DDRC_DurDeb.Com_tiMETHtiDebDebOk_C "debouncing parameter / Duration of healing debouncing for check DFC_ComMETHTOut" VALUE 0x804D8A2C Val_Wu16 655350.0 DDRCTime_ms 0.00 655350.0 FORMAT "%8.1" /end CHARACTERISTIC
/begin CHARACTERISTIC DDRC_DurDeb.Com_tiMETHtiDebDebDef_C "debouncing parameter / Duration of defect debouncing for check DFC_ComMETHTOut" VALUE 0x804D8A2E Val_Wu16 655350.0 DDRCTime_ms 0.00 655350.0 FORMAT "%8.1" /end CHARACTERISTIC
/begin CHARACTERISTIC DDRC_DurDeb.Com_tiMETICSumDebOk_C "debouncing parameter / Duration of healing debouncing for check DFC_ComMETIChksum" VALUE 0x804D8A30 Val_Wu16 655350.0 DDRCTime_ms 0.00 655350.0 FORMAT "%8.1" /end CHARACTERISTIC
/begin CHARACTERISTIC DDRC_DurDeb.Com_tiMETICSumDebDef_C "debouncing parameter / Duration of defect debouncing for check DFC_ComMETIChksum" VALUE 0x804D8A32 Val_Wu16 655350.0 DDRCTime_ms 0.00 655350.0 FORMAT "%8.1" /end CHARACTERISTIC
/begin CHARACTERISTIC DDRC_DurDeb.Com_tiMETIctRingDebOk_C "debouncing parameter / Duration of healing debouncing for check DFC_ComMETIRingCnt" VALUE 0x804D8A34 Val_Wu16 655350.0 DDRCTime_ms 0.00 655350.0 FORMAT "%8.1" /end CHARACTERISTIC
/begin CHARACTERISTIC DDRC_DurDeb.Com_tiMETIctRingDebDef_C "debouncing parameter / Duration of defect debouncing for check DFC_ComMETIRingCnt" VALUE 0x804D8A36 Val_Wu16 655350.0 DDRCTime_ms 0.00 655350.0 FORMAT "%8.1" /end CHARACTERISTIC
/begin CHARACTERISTIC DDRC_DurDeb.Com_tiMETItiDebDebOk_C "debouncing parameter / Duration of healing debouncing for check DFC_ComMETITOut" VALUE 0x804D8A38 Val_Wu16 655350.0 DDRCTime_ms 0.00 655350.0 FORMAT "%8.1" /end CHARACTERISTIC
/begin CHARACTERISTIC DDRC_DurDeb.Com_tiMETItiDebDebDef_C "debouncing parameter / Duration of defect debouncing for check DFC_ComMETITOut" VALUE 0x804D8A3A Val_Wu16 655350.0 DDRCTime_ms 0.00 655350.0 FORMAT "%8.1" /end CHARACTERISTIC
/begin CHARACTERISTIC DDRC_DurDeb.Com_tiMETKCSumDebOk_C "debouncing parameter / Duration of healing debouncing for check DFC_ComMETKChksum" VALUE 0x804D8A3C Val_Wu16 655350.0 DDRCTime_ms 0.00 655350.0 FORMAT "%8.1" /end CHARACTERISTIC
/begin CHARACTERISTIC DDRC_DurDeb.Com_tiMETKCSumDebDef_C "debouncing parameter / Duration of defect debouncing for check DFC_ComMETKChksum" VALUE 0x804D8A3E Val_Wu16 655350.0 DDRCTime_ms 0.00 655350.0 FORMAT "%8.1" /end CHARACTERISTIC
/begin CHARACTERISTIC DDRC_DurDeb.Com_tiMETKctRingDebOk_C "debouncing parameter / Duration of healing debouncing for check DFC_ComMETKRingCnt" VALUE 0x804D8A40 Val_Wu16 655350.0 DDRCTime_ms 0.00 655350.0 FORMAT "%8.1" /end CHARACTERISTIC
/begin CHARACTERISTIC DDRC_DurDeb.Com_tiMETKctRingDebDef_C "debouncing parameter / Duration of defect debouncing for check DFC_ComMETKRingCnt" VALUE 0x804D8A42 Val_Wu16 655350.0 DDRCTime_ms 0.00 655350.0 FORMAT "%8.1" /end CHARACTERISTIC
/begin CHARACTERISTIC DDRC_DurDeb.Com_tiMETKtiDebDebOk_C "debouncing parameter / Duration of healing debouncing for check DFC_ComMETKTOut" VALUE 0x804D8A44 Val_Wu16 655350.0 DDRCTime_ms 0.00 655350.0 FORMAT "%8.1" /end CHARACTERISTIC
/begin CHARACTERISTIC DDRC_DurDeb.Com_tiMETKtiDebDebDef_C "debouncing parameter / Duration of defect debouncing for check DFC_ComMETKTOut" VALUE 0x804D8A46 Val_Wu16 655350.0 DDRCTime_ms 0.00 655350.0 FORMAT "%8.1" /end CHARACTERISTIC
/begin CHARACTERISTIC DDRC_DurDeb.Com_tiMETLCSumDebOk_C "debouncing parameter / Duration of healing debouncing for check DFC_ComMETLChksum" VALUE 0x804D8A48 Val_Wu16 655350.0 DDRCTime_ms 0.00 655350.0 FORMAT "%8.1" /end CHARACTERISTIC
/begin CHARACTERISTIC DDRC_DurDeb.Com_tiMETLCSumDebDef_C "debouncing parameter / Duration of defect debouncing for check DFC_ComMETLChksum" VALUE 0x804D8A4A Val_Wu16 655350.0 DDRCTime_ms 0.00 655350.0 FORMAT "%8.1" /end CHARACTERISTIC
/begin CHARACTERISTIC DDRC_DurDeb.Com_tiMETLRingCntrDebOk_C "debouncing parameter / Duration of healing debouncing for check DFC_ComMETLRingCnt" VALUE 0x804D8A4C Val_Wu16 655350.0 DDRCTime_ms 0.00 655350.0 FORMAT "%8.1" /end CHARACTERISTIC
/begin CHARACTERISTIC DDRC_DurDeb.Com_tiMETLRingCntrDebDef_C "debouncing parameter / Duration of defect debouncing for check DFC_ComMETLRingCnt" VALUE 0x804D8A4E Val_Wu16 655350.0 DDRCTime_ms 0.00 655350.0 FORMAT "%8.1" /end CHARACTERISTIC
/begin CHARACTERISTIC DDRC_DurDeb.Com_tiMETLToutDebOk_C "debouncing parameter / Duration of healing debouncing for check DFC_ComMETLTOut" VALUE 0x804D8A50 Val_Wu16 655350.0 DDRCTime_ms 0.00 655350.0 FORMAT "%8.1" /end CHARACTERISTIC
/begin CHARACTERISTIC DDRC_DurDeb.Com_tiMETLToutDebDef_C "debouncing parameter / Duration of defect debouncing for check DFC_ComMETLTOut" VALUE 0x804D8A52 Val_Wu16 655350.0 DDRCTime_ms 0.00 655350.0 FORMAT "%8.1" /end CHARACTERISTIC
/begin CHARACTERISTIC DDRC_DurDeb.Com_tiMETMCSumDebOk_C "debouncing parameter / Duration of healing debouncing for check DFC_ComMETMChksum" VALUE 0x804D8A54 Val_Wu16 655350.0 DDRCTime_ms 0.00 655350.0 FORMAT "%8.1" /end CHARACTERISTIC
/begin CHARACTERISTIC DDRC_DurDeb.Com_tiMETMCSumDebDef_C "debouncing parameter / Duration of defect debouncing for check DFC_ComMETMChksum" VALUE 0x804D8A56 Val_Wu16 655350.0 DDRCTime_ms 0.00 655350.0 FORMAT "%8.1" /end CHARACTERISTIC
/begin CHARACTERISTIC DDRC_DurDeb.Com_tiMETMRingCntrDebOk_C "debouncing parameter / Duration of healing debouncing for check DFC_ComMETMRingCnt" VALUE 0x804D8A58 Val_Wu16 655350.0 DDRCTime_ms 0.00 655350.0 FORMAT "%8.1" /end CHARACTERISTIC
/begin CHARACTERISTIC DDRC_DurDeb.Com_tiMETMRingCntrDebDef_C "debouncing parameter / Duration of defect debouncing for check DFC_ComMETMRingCnt" VALUE 0x804D8A5A Val_Wu16 655350.0 DDRCTime_ms 0.00 655350.0 FORMAT "%8.1" /end CHARACTERISTIC
/begin CHARACTERISTIC DDRC_DurDeb.Com_tiMETMToutDebOk_C "debouncing parameter / Duration of healing debouncing for check DFC_ComMETMTOut" VALUE 0x804D8A5C Val_Wu16 655350.0 DDRCTime_ms 0.00 655350.0 FORMAT "%8.1" /end CHARACTERISTIC
/begin CHARACTERISTIC DDRC_DurDeb.Com_tiMETMToutDebDef_C "debouncing parameter / Duration of defect debouncing for check DFC_ComMETMTOut" VALUE 0x804D8A5E Val_Wu16 655350.0 DDRCTime_ms 0.00 655350.0 FORMAT "%8.1" /end CHARACTERISTIC
/begin CHARACTERISTIC DDRC_DurDeb.Com_tiMETNCSumDebOk_C "debouncing parameter / Duration of healing debouncing for check DFC_ComMETNChksum" VALUE 0x804D8A60 Val_Wu16 655350.0 DDRCTime_ms 0.00 655350.0 FORMAT "%8.1" /end CHARACTERISTIC
/begin CHARACTERISTIC DDRC_DurDeb.Com_tiMETNCSumDebDef_C "debouncing parameter / Duration of defect debouncing for check DFC_ComMETNChksum" VALUE 0x804D8A62 Val_Wu16 655350.0 DDRCTime_ms 0.00 655350.0 FORMAT "%8.1" /end CHARACTERISTIC
/begin CHARACTERISTIC DDRC_DurDeb.Com_tiMETNRingCntrDebOk_C "debouncing parameter / Duration of healing debouncing for check DFC_ComMETNRingCnt" VALUE 0x804D8A64 Val_Wu16 655350.0 DDRCTime_ms 0.00 655350.0 FORMAT "%8.1" /end CHARACTERISTIC
/begin CHARACTERISTIC DDRC_DurDeb.Com_tiMETNRingCntrDebDef_C "debouncing parameter / Duration of defect debouncing for check DFC_ComMETNRingCnt" VALUE 0x804D8A66 Val_Wu16 655350.0 DDRCTime_ms 0.00 655350.0 FORMAT "%8.1" /end CHARACTERISTIC
/begin CHARACTERISTIC DDRC_DurDeb.Com_tiMETNToutDebOk_C "debouncing parameter / Duration of healing debouncing for check DFC_ComMETNTOut" VALUE 0x804D8A68 Val_Wu16 655350.0 DDRCTime_ms 0.00 655350.0 FORMAT "%8.1" /end CHARACTERISTIC
/begin CHARACTERISTIC DDRC_DurDeb.Com_tiMETNToutDebDef_C "debouncing parameter / Duration of defect debouncing for check DFC_ComMETNTOut" VALUE 0x804D8A6A Val_Wu16 655350.0 DDRCTime_ms 0.00 655350.0 FORMAT "%8.1" /end CHARACTERISTIC
/begin CHARACTERISTIC DDRC_DurDeb.Com_tiMtrComDebOk_C "debouncing parameter / Duration of healing debouncing for check DFC_ComMtrCom" VALUE 0x804D8A6C Val_Wu16 655350.0 DDRCTime_ms 0.00 655350.0 FORMAT "%8.1" /end CHARACTERISTIC
/begin CHARACTERISTIC DDRC_DurDeb.Com_tiMtrComDebDef_C "debouncing parameter / Duration of defect debouncing for check DFC_ComMtrCom" VALUE 0x804D8A6E Val_Wu16 655350.0 DDRCTime_ms 0.00 655350.0 FORMAT "%8.1" /end CHARACTERISTIC
/begin CHARACTERISTIC DDRC_DurDeb.Com_tiPCUChkSumDebOk_C "debouncing parameter / Duration of healing debouncing for check DFC_ComPCUChkSum" VALUE 0x804D8A70 Val_Wu16 655350.0 DDRCTime_ms 0.00 655350.0 FORMAT "%8.1" /end CHARACTERISTIC
/begin CHARACTERISTIC DDRC_DurDeb.Com_tiPCUChkSumDebDef_C "debouncing parameter / Duration of defect debouncing for check DFC_ComPCUChkSum" VALUE 0x804D8A72 Val_Wu16 655350.0 DDRCTime_ms 0.00 655350.0 FORMAT "%8.1" /end CHARACTERISTIC
/begin CHARACTERISTIC DDRC_DurDeb.Com_tiPCURingCntDebOk_C "debouncing parameter / Duration of healing debouncing for check DFC_ComPCURingCnt" VALUE 0x804D8A74 Val_Wu16 655350.0 DDRCTime_ms 0.00 655350.0 FORMAT "%8.1" /end CHARACTERISTIC
/begin CHARACTERISTIC DDRC_DurDeb.Com_tiPCURingCntDebDef_C "debouncing parameter / Duration of defect debouncing for check DFC_ComPCURingCnt" VALUE 0x804D8A76 Val_Wu16 655350.0 DDRCTime_ms 0.00 655350.0 FORMAT "%8.1" /end CHARACTERISTIC
/begin CHARACTERISTIC DDRC_DurDeb.Com_tiPCUTOutDebOk_C "debouncing parameter / Duration of healing debouncing for check DFC_ComPCUTOut" VALUE 0x804D8A78 Val_Wu16 655350.0 DDRCTime_ms 0.00 655350.0 FORMAT "%8.1" /end CHARACTERISTIC
/begin CHARACTERISTIC DDRC_DurDeb.Com_tiPCUTOutDebDef_C "debouncing parameter / Duration of defect debouncing for check DFC_ComPCUTOut" VALUE 0x804D8A7A Val_Wu16 655350.0 DDRCTime_ms 0.00 655350.0 FORMAT "%8.1" /end CHARACTERISTIC
/begin CHARACTERISTIC DDRC_DurDeb.Com_tiSRSACSumDebOk_C "debouncing parameter / Duration of healing debouncing for check DFC_ComSRSAChksum" VALUE 0x804D8A7C Val_Wu16 655350.0 DDRCTime_ms 0.00 655350.0 FORMAT "%8.1" /end CHARACTERISTIC
/begin CHARACTERISTIC DDRC_DurDeb.Com_tiSRSACSumDebDef_C "debouncing parameter / Duration of defect debouncing for check DFC_ComSRSAChksum" VALUE 0x804D8A7E Val_Wu16 655350.0 DDRCTime_ms 0.00 655350.0 FORMAT "%8.1" /end CHARACTERISTIC
/begin CHARACTERISTIC DDRC_DurDeb.Com_tiSRSARingCntDebOk_C "debouncing parameter / Duration of healing debouncing for check DFC_ComSRSARingCnt" VALUE 0x804D8A80 Val_Wu16 655350.0 DDRCTime_ms 0.00 655350.0 FORMAT "%8.1" /end CHARACTERISTIC
/begin CHARACTERISTIC DDRC_DurDeb.Com_tiSRSARingCntDebDef_C "debouncing parameter / Duration of defect debouncing for check DFC_ComSRSARingCnt" VALUE 0x804D8A82 Val_Wu16 655350.0 DDRCTime_ms 0.00 655350.0 FORMAT "%8.1" /end CHARACTERISTIC
/begin CHARACTERISTIC DDRC_DurDeb.Com_tiSRSATOutDebOk_C "debouncing parameter / Duration of healing debouncing for check DFC_ComSRSATOut" VALUE 0x804D8A84 Val_Wu16 655350.0 DDRCTime_ms 0.00 655350.0 FORMAT "%8.1" /end CHARACTERISTIC
/begin CHARACTERISTIC DDRC_DurDeb.Com_tiSRSATOutDebDef_C "debouncing parameter / Duration of defect debouncing for check DFC_ComSRSATOut" VALUE 0x804D8A86 Val_Wu16 655350.0 DDRCTime_ms 0.00 655350.0 FORMAT "%8.1" /end CHARACTERISTIC
/begin CHARACTERISTIC DDRC_DurDeb.Com_tiSRSBCSumDebOk_C "debouncing parameter / Duration of healing debouncing for check DFC_ComSRSBChksum" VALUE 0x804D8A88 Val_Wu16 655350.0 DDRCTime_ms 0.00 655350.0 FORMAT "%8.1" /end CHARACTERISTIC
/begin CHARACTERISTIC DDRC_DurDeb.Com_tiSRSBCSumDebDef_C "debouncing parameter / Duration of defect debouncing for check DFC_ComSRSBChksum" VALUE 0x804D8A8A Val_Wu16 655350.0 DDRCTime_ms 0.00 655350.0 FORMAT "%8.1" /end CHARACTERISTIC
/begin CHARACTERISTIC DDRC_DurDeb.Com_tiSRSBRingCntDebOk_C "debouncing parameter / Duration of healing debouncing for check DFC_ComSRSBRingCnt" VALUE 0x804D8A8C Val_Wu16 655350.0 DDRCTime_ms 0.00 655350.0 FORMAT "%8.1" /end CHARACTERISTIC
/begin CHARACTERISTIC DDRC_DurDeb.Com_tiSRSBRingCntDebDef_C "debouncing parameter / Duration of defect debouncing for check DFC_ComSRSBRingCnt" VALUE 0x804D8A8E Val_Wu16 655350.0 DDRCTime_ms 0.00 655350.0 FORMAT "%8.1" /end CHARACTERISTIC
/begin CHARACTERISTIC DDRC_DurDeb.Com_tiSRSBTOutDebOk_C "debouncing parameter / Duration of healing debouncing for check DFC_ComSRSBTOut" VALUE 0x804D8A90 Val_Wu16 655350.0 DDRCTime_ms 0.00 655350.0 FORMAT "%8.1" /end CHARACTERISTIC
/begin CHARACTERISTIC DDRC_DurDeb.Com_tiSRSBTOutDebDef_C "debouncing parameter / Duration of defect debouncing for check DFC_ComSRSBTOut" VALUE 0x804D8A92 Val_Wu16 655350.0 DDRCTime_ms 0.00 655350.0 FORMAT "%8.1" /end CHARACTERISTIC
/begin CHARACTERISTIC DDRC_DurDeb.Com_tiSRSCSumDebOk_C "debouncing parameter / Duration of healing debouncing for check DFC_ComSRSChksum" VALUE 0x804D8A94 Val_Wu16 655350.0 DDRCTime_ms 0.00 655350.0 FORMAT "%8.1" /end CHARACTERISTIC
/begin CHARACTERISTIC DDRC_DurDeb.Com_tiSRSCSumDebDef_C "debouncing parameter / Duration of defect debouncing for check DFC_ComSRSChksum" VALUE 0x804D8A96 Val_Wu16 655350.0 DDRCTime_ms 0.00 655350.0 FORMAT "%8.1" /end CHARACTERISTIC
/begin CHARACTERISTIC DDRC_DurDeb.Com_tiSRSErrDebOk_C "debouncing parameter / Duration of healing debouncing for check DFC_ComSRSErr" VALUE 0x804D8A98 Val_Wu16 655350.0 DDRCTime_ms 0.00 655350.0 FORMAT "%8.1" /end CHARACTERISTIC
/begin CHARACTERISTIC DDRC_DurDeb.Com_tiSRSErrDebDef_C "debouncing parameter / Duration of defect debouncing for check DFC_ComSRSErr" VALUE 0x804D8A9A Val_Wu16 655350.0 DDRCTime_ms 0.00 655350.0 FORMAT "%8.1" /end CHARACTERISTIC
/begin CHARACTERISTIC DDRC_DurDeb.Com_tiSRSRingCntDebOk_C "debouncing parameter / Duration of healing debouncing for check DFC_ComSRSRingCnt" VALUE 0x804D8A9C Val_Wu16 655350.0 DDRCTime_ms 0.00 655350.0 FORMAT "%8.1" /end CHARACTERISTIC
/begin CHARACTERISTIC DDRC_DurDeb.Com_tiSRSRingCntDebDef_C "debouncing parameter / Duration of defect debouncing for check DFC_ComSRSRingCnt" VALUE 0x804D8A9E Val_Wu16 655350.0 DDRCTime_ms 0.00 655350.0 FORMAT "%8.1" /end CHARACTERISTIC
/begin CHARACTERISTIC DDRC_DurDeb.Com_tiSRSTOutDebOk_C "debouncing parameter / Duration of healing debouncing for check DFC_ComSRSTOut" VALUE 0x804D8AA0 Val_Wu16 655350.0 DDRCTime_ms 0.00 655350.0 FORMAT "%8.1" /end CHARACTERISTIC
/begin CHARACTERISTIC DDRC_DurDeb.Com_tiSRSTOutDebDef_C "debouncing parameter / Duration of defect debouncing for check DFC_ComSRSTOut" VALUE 0x804D8AA2 Val_Wu16 655350.0 DDRCTime_ms 0.00 655350.0 FORMAT "%8.1" /end CHARACTERISTIC
/begin CHARACTERISTIC DDRC_DurDeb.Com_tiVehSpdPndFltTCUDebOk_C "debouncing parameter / Duration of healing debouncing for check DFC_ComVehSpdPndFltTCU" VALUE 0x804D8AA4 Val_Wu16 655350.0 DDRCTime_ms 0.00 655350.0 FORMAT "%8.1" /end CHARACTERISTIC
/begin CHARACTERISTIC DDRC_DurDeb.Com_tiVehSpdPndFltTCUDebDef_C "debouncing parameter / Duration of defect debouncing for check DFC_ComVehSpdPndFltTCU" VALUE 0x804D8AA6 Val_Wu16 655350.0 DDRCTime_ms 0.00 655350.0 FORMAT "%8.1" /end CHARACTERISTIC
/begin CHARACTERISTIC DDRC_DurDeb.CstrPurg_tiDebDebOk_C "debouncing parameter / Duration of healing debouncing for check DFC_TEVEsig" VALUE 0x804D8AA8 Val_Wu16 655350.0 DDRCTime_ms 0.00 655350.0 FORMAT "%8.1" /end CHARACTERISTIC
/begin CHARACTERISTIC DDRC_DurDeb.CstrPurg_tiDebDebDef_C "debouncing parameter / Duration of defect debouncing for check DFC_TEVEsig" VALUE 0x804D8AAA Val_Wu16 655350.0 DDRCTime_ms 0.00 655350.0 FORMAT "%8.1" /end CHARACTERISTIC
/begin CHARACTERISTIC DDRC_DurDeb.Ebs_tiChartcCurrErrDebOk_C "debouncing parameter / Duration of healing debouncing for check DFC_EbsChartcCurrErr" VALUE 0x804D8AAC Val_Wu16 655350.0 DDRCTime_ms 0.00 655350.0 FORMAT "%8.1" /end CHARACTERISTIC
/begin CHARACTERISTIC DDRC_DurDeb.Ebs_tiChartcCurrErrDebDef_C "debouncing parameter / Duration of defect debouncing for check DFC_EbsChartcCurrErr" VALUE 0x804D8AAE Val_Wu16 655350.0 DDRCTime_ms 0.00 655350.0 FORMAT "%8.1" /end CHARACTERISTIC
/begin CHARACTERISTIC DDRC_DurDeb.Ebs_tiSelfDiagErrDebOk_C "debouncing parameter / Duration of healing debouncing for check DFC_EbsSelfDiagErr" VALUE 0x804D8AB0 Val_Wu16 655350.0 DDRCTime_ms 0.00 655350.0 FORMAT "%8.1" /end CHARACTERISTIC
/begin CHARACTERISTIC DDRC_DurDeb.Ebs_tiSelfDiagErrDebDef_C "debouncing parameter / Duration of defect debouncing for check DFC_EbsSelfDiagErr" VALUE 0x804D8AB2 Val_Wu16 655350.0 DDRCTime_ms 0.00 655350.0 FORMAT "%8.1" /end CHARACTERISTIC
/begin CHARACTERISTIC DDRC_DurDeb.GbxNPos_tiCANDigPlausDebOk_C "debouncing parameter / Duration of healing debouncing for check DFC_GbxCANDigPlausErr" VALUE 0x804D8AB4 Val_Wu16 655350.0 DDRCTime_ms 0.00 655350.0 FORMAT "%8.1" /end CHARACTERISTIC
/begin CHARACTERISTIC DDRC_DurDeb.GbxNPos_tiCANDigPlausDebDef_C "debouncing parameter / Duration of defect debouncing for check DFC_GbxCANDigPlausErr" VALUE 0x804D8AB6 Val_Wu16 655350.0 DDRCTime_ms 0.00 655350.0 FORMAT "%8.1" /end CHARACTERISTIC
/begin CHARACTERISTIC DDRC_DurDeb.GbxNPos_tiNPos1SRCMaxDebOk_C "debouncing parameter / Duration of healing debouncing for check DFC_GbxNPos1SRCMax" VALUE 0x804D8AB8 Val_Wu16 655350.0 DDRCTime_ms 0.00 655350.0 FORMAT "%8.1" /end CHARACTERISTIC
/begin CHARACTERISTIC DDRC_DurDeb.GbxNPos_tiNPos1SRCMaxDebDef_C "debouncing parameter / Duration of defect debouncing for check DFC_GbxNPos1SRCMax" VALUE 0x804D8ABA Val_Wu16 655350.0 DDRCTime_ms 0.00 655350.0 FORMAT "%8.1" /end CHARACTERISTIC
/begin CHARACTERISTIC DDRC_DurDeb.GbxNPos_tiNPos1SRCMinDebOk_C "debouncing parameter / Duration of healing debouncing for check DFC_GbxNPos1SRCMin" VALUE 0x804D8ABC Val_Wu16 655350.0 DDRCTime_ms 0.00 655350.0 FORMAT "%8.1" /end CHARACTERISTIC
/begin CHARACTERISTIC DDRC_DurDeb.GbxNPos_tiNPos1SRCMinDebDef_C "debouncing parameter / Duration of defect debouncing for check DFC_GbxNPos1SRCMin" VALUE 0x804D8ABE Val_Wu16 655350.0 DDRCTime_ms 0.00 655350.0 FORMAT "%8.1" /end CHARACTERISTIC
/begin CHARACTERISTIC DDRC_DurDeb.GbxNPos_tiNPos2SRCMaxDebOk_C "debouncing parameter / Duration of healing debouncing for check DFC_GbxNPos2SRCMax" VALUE 0x804D8AC0 Val_Wu16 655350.0 DDRCTime_ms 0.00 655350.0 FORMAT "%8.1" /end CHARACTERISTIC
/begin CHARACTERISTIC DDRC_DurDeb.GbxNPos_tiNPos2SRCMaxDebDef_C "debouncing parameter / Duration of defect debouncing for check DFC_GbxNPos2SRCMax" VALUE 0x804D8AC2 Val_Wu16 655350.0 DDRCTime_ms 0.00 655350.0 FORMAT "%8.1" /end CHARACTERISTIC
/begin CHARACTERISTIC DDRC_DurDeb.GbxNPos_tiNPos2SRCMinDebOk_C "debouncing parameter / Duration of healing debouncing for check DFC_GbxNPos2SRCMin" VALUE 0x804D8AC4 Val_Wu16 655350.0 DDRCTime_ms 0.00 655350.0 FORMAT "%8.1" /end CHARACTERISTIC
/begin CHARACTERISTIC DDRC_DurDeb.GbxNPos_tiNPos2SRCMinDebDef_C "debouncing parameter / Duration of defect debouncing for check DFC_GbxNPos2SRCMin" VALUE 0x804D8AC6 Val_Wu16 655350.0 DDRCTime_ms 0.00 655350.0 FORMAT "%8.1" /end CHARACTERISTIC
/begin CHARACTERISTIC DDRC_DurDeb.GbxNPos_tiNPosAlvChkDebOk_C "debouncing parameter / Duration of healing debouncing for check DFC_GbxNPosAlvChk" VALUE 0x804D8AC8 Val_Wu16 655350.0 DDRCTime_ms 0.00 655350.0 FORMAT "%8.1" /end CHARACTERISTIC
/begin CHARACTERISTIC DDRC_DurDeb.GbxNPos_tiNPosAlvChkDebDef_C "debouncing parameter / Duration of defect debouncing for check DFC_GbxNPosAlvChk" VALUE 0x804D8ACA Val_Wu16 655350.0 DDRCTime_ms 0.00 655350.0 FORMAT "%8.1" /end CHARACTERISTIC
/begin CHARACTERISTIC DDRC_DurDeb.GbxNPos_tiNPosSyncErrDebOk_C "debouncing parameter / Duration of healing debouncing for check DFC_GbxNPosSyncErr" VALUE 0x804D8ACC Val_Wu16 655350.0 DDRCTime_ms 0.00 655350.0 FORMAT "%8.1" /end CHARACTERISTIC
/begin CHARACTERISTIC DDRC_DurDeb.GbxNPos_tiNPosSyncErrDebDef_C "debouncing parameter / Duration of defect debouncing for check DFC_GbxNPosSyncErr" VALUE 0x804D8ACE Val_Wu16 655350.0 DDRCTime_ms 0.00 655350.0 FORMAT "%8.1" /end CHARACTERISTIC
/begin CHARACTERISTIC DDRC_DurDeb.HEGO_tiDebHtrPsErrDebOk_C "debouncing parameter / Duration of healing debouncing for check DFC_HEGOS2B1HtrPsSig" VALUE 0x804D8AD0 Val_Wu16 655350.0 DDRCTime_ms 0.00 655350.0 FORMAT "%8.1" /end CHARACTERISTIC
/begin CHARACTERISTIC DDRC_DurDeb.HEGO_tiDebHtrPsErrDebDef_C "debouncing parameter / Duration of defect debouncing for check DFC_HEGOS2B1HtrPsSig" VALUE 0x804D8AD2 Val_Wu16 655350.0 DDRCTime_ms 0.00 655350.0 FORMAT "%8.1" /end CHARACTERISTIC
/begin CHARACTERISTIC DDRC_DurDeb.LIN_tiCSErrACGDebOk_C "debouncing parameter / Duration of healing debouncing for check DFC_LinCSErrACG" VALUE 0x804D8AD4 Val_Wu16 655350.0 DDRCTime_ms 0.00 655350.0 FORMAT "%8.1" /end CHARACTERISTIC
/begin CHARACTERISTIC DDRC_DurDeb.LIN_tiCSErrACGDebDef_C "debouncing parameter / Duration of defect debouncing for check DFC_LinCSErrACG" VALUE 0x804D8AD6 Val_Wu16 655350.0 DDRCTime_ms 0.00 655350.0 FORMAT "%8.1" /end CHARACTERISTIC
/begin CHARACTERISTIC DDRC_DurDeb.LIN_tiCSErrEBSDebOk_C "debouncing parameter / Duration of healing debouncing for check DFC_LinCSErrEBS" VALUE 0x804D8AD8 Val_Wu16 655350.0 DDRCTime_ms 0.00 655350.0 FORMAT "%8.1" /end CHARACTERISTIC
/begin CHARACTERISTIC DDRC_DurDeb.LIN_tiCSErrEBSDebDef_C "debouncing parameter / Duration of defect debouncing for check DFC_LinCSErrEBS" VALUE 0x804D8ADA Val_Wu16 655350.0 DDRCTime_ms 0.00 655350.0 FORMAT "%8.1" /end CHARACTERISTIC
/begin CHARACTERISTIC DDRC_DurDeb.LIN_tiHdrTimeoutErrACGDebOk_C "debouncing parameter / Duration of healing debouncing for check DFC_LinHdrTimeoutErrACG" VALUE 0x804D8ADC Val_Wu16 655350.0 DDRCTime_ms 0.00 655350.0 FORMAT "%8.1" /end CHARACTERISTIC
/begin CHARACTERISTIC DDRC_DurDeb.LIN_tiHdrTimeoutErrACGDebDef_C "debouncing parameter / Duration of defect debouncing for check DFC_LinHdrTimeoutErrACG" VALUE 0x804D8ADE Val_Wu16 655350.0 DDRCTime_ms 0.00 655350.0 FORMAT "%8.1" /end CHARACTERISTIC
/begin CHARACTERISTIC DDRC_DurDeb.LIN_tiHdrTimeoutErrEBSDebOk_C "debouncing parameter / Duration of healing debouncing for check DFC_LinHdrTimeoutErrEBS" VALUE 0x804D8AE0 Val_Wu16 655350.0 DDRCTime_ms 0.00 655350.0 FORMAT "%8.1" /end CHARACTERISTIC
/begin CHARACTERISTIC DDRC_DurDeb.LIN_tiHdrTimeoutErrEBSDebDef_C "debouncing parameter / Duration of defect debouncing for check DFC_LinHdrTimeoutErrEBS" VALUE 0x804D8AE2 Val_Wu16 655350.0 DDRCTime_ms 0.00 655350.0 FORMAT "%8.1" /end CHARACTERISTIC
/begin CHARACTERISTIC DDRC_DurDeb.LIN_tiMsgTimeoutErrACGDebOk_C "debouncing parameter / Duration of healing debouncing for check DFC_LinMsgTimeoutErrACG" VALUE 0x804D8AE4 Val_Wu16 655350.0 DDRCTime_ms 0.00 655350.0 FORMAT "%8.1" /end CHARACTERISTIC
/begin CHARACTERISTIC DDRC_DurDeb.LIN_tiMsgTimeoutErrACGDebDef_C "debouncing parameter / Duration of defect debouncing for check DFC_LinMsgTimeoutErrACG" VALUE 0x804D8AE6 Val_Wu16 655350.0 DDRCTime_ms 0.00 655350.0 FORMAT "%8.1" /end CHARACTERISTIC
/begin CHARACTERISTIC DDRC_DurDeb.LIN_tiMsgTimeoutErrEBSDebOk_C "debouncing parameter / Duration of healing debouncing for check DFC_LinMsgTimeoutErrEBS" VALUE 0x804D8AE8 Val_Wu16 655350.0 DDRCTime_ms 0.00 655350.0 FORMAT "%8.1" /end CHARACTERISTIC
/begin CHARACTERISTIC DDRC_DurDeb.LIN_tiMsgTimeoutErrEBSDebDef_C "debouncing parameter / Duration of defect debouncing for check DFC_LinMsgTimeoutErrEBS" VALUE 0x804D8AEA Val_Wu16 655350.0 DDRCTime_ms 0.00 655350.0 FORMAT "%8.1" /end CHARACTERISTIC
/begin CHARACTERISTIC DDRC_DurDeb.LIN_tiNoStrtComErrDebOk_C "debouncing parameter / Duration of healing debouncing for check DFC_LinNoStrtComErr" VALUE 0x804D8AEC Val_Wu16 655350.0 DDRCTime_ms 0.00 655350.0 FORMAT "%8.1" /end CHARACTERISTIC
/begin CHARACTERISTIC DDRC_DurDeb.LIN_tiNoStrtComErrDebDef_C "debouncing parameter / Duration of defect debouncing for check DFC_LinNoStrtComErr" VALUE 0x804D8AEE Val_Wu16 655350.0 DDRCTime_ms 0.00 655350.0 FORMAT "%8.1" /end CHARACTERISTIC
/begin CHARACTERISTIC DDRC_DurDeb.MisfDet_tiVWhlOORDebOk_C "debouncing parameter / Duration of healing debouncing for check DFC_MisfDetVWhlReRiOORHi" VALUE 0x804D8AF0 Val_Wu16 655350.0 DDRCTime_ms 0.00 655350.0 FORMAT "%8.1" /end CHARACTERISTIC
/begin CHARACTERISTIC DDRC_DurDeb.MisfDet_tiVWhlOORDebDef_C "debouncing parameter / Duration of defect debouncing for check DFC_MisfDetVWhlReRiOORHi" VALUE 0x804D8AF2 Val_Wu16 655350.0 DDRCTime_ms 0.00 655350.0 FORMAT "%8.1" /end CHARACTERISTIC
/begin CHARACTERISTIC DDRC_DurDeb.MisfDet_tiVWhlRatyDebOk_C "debouncing parameter / Duration of healing debouncing for check DFC_MisfDetVWhlReRiRatyLo" VALUE 0x804D8AF4 Val_Wu16 655350.0 DDRCTime_ms 0.00 655350.0 FORMAT "%8.1" /end CHARACTERISTIC
/begin CHARACTERISTIC DDRC_DurDeb.MisfDet_tiVWhlRatyDebDef_C "debouncing parameter / Duration of defect debouncing for check DFC_MisfDetVWhlReRiRatyLo" VALUE 0x804D8AF6 Val_Wu16 655350.0 DDRCTime_ms 0.00 655350.0 FORMAT "%8.1" /end CHARACTERISTIC
/begin CHARACTERISTIC DDRC_DurDeb.MisfDet_tiVWhlStuckDebOk_C "debouncing parameter / Duration of healing debouncing for check DFC_MisfDetVWhlReRiStuck" VALUE 0x804D8AF8 Val_Wu16 655350.0 DDRCTime_ms 0.00 655350.0 FORMAT "%8.1" /end CHARACTERISTIC
/begin CHARACTERISTIC DDRC_DurDeb.MisfDet_tiVWhlStuckDebDef_C "debouncing parameter / Duration of defect debouncing for check DFC_MisfDetVWhlReRiStuck" VALUE 0x804D8AFA Val_Wu16 655350.0 DDRCTime_ms 0.00 655350.0 FORMAT "%8.1" /end CHARACTERISTIC
/begin CHARACTERISTIC DDRC_DurDeb.MisfDet_tidVWhlPlausDebOk_C "debouncing parameter / Duration of healing debouncing for check DFC_MisfDetdVWhlReRiPlaus" VALUE 0x804D8AFC Val_Wu16 655350.0 DDRCTime_ms 0.00 655350.0 FORMAT "%8.1" /end CHARACTERISTIC
/begin CHARACTERISTIC DDRC_DurDeb.MisfDet_tidVWhlPlausDebDef_C "debouncing parameter / Duration of defect debouncing for check DFC_MisfDetdVWhlReRiPlaus" VALUE 0x804D8AFE Val_Wu16 655350.0 DDRCTime_ms 0.00 655350.0 FORMAT "%8.1" /end CHARACTERISTIC
/begin CHARACTERISTIC DDRC_DurDeb.PEnv_tiSigRngChkDebOk_C "debouncing parameter / Duration of healing debouncing for check DFC_PEnvSigRngMin" VALUE 0x804D8B00 Val_Wu16 655350.0 DDRCTime_ms 0.00 655350.0 FORMAT "%8.1" /end CHARACTERISTIC
/begin CHARACTERISTIC DDRC_DurDeb.PEnv_tiSigRngChkDebDef_C "debouncing parameter / Duration of defect debouncing for check DFC_PEnvSigRngMin" VALUE 0x804D8B02 Val_Wu16 655350.0 DDRCTime_ms 0.00 655350.0 FORMAT "%8.1" /end CHARACTERISTIC
/begin CHARACTERISTIC DDRC_DurDeb.Strt_tiCtOffPthDebOk_C "debouncing parameter / Duration of healing debouncing for check DFC_StrtCtOffPth" VALUE 0x804D8B04 Val_Wu16 655350.0 DDRCTime_ms 0.00 655350.0 FORMAT "%8.1" /end CHARACTERISTIC
/begin CHARACTERISTIC DDRC_DurDeb.Strt_tiCtOffPthDebDef_C "debouncing parameter / Duration of defect debouncing for check DFC_StrtCtOffPth" VALUE 0x804D8B06 Val_Wu16 655350.0 DDRCTime_ms 0.00 655350.0 FORMAT "%8.1" /end CHARACTERISTIC
/begin CHARACTERISTIC DDRC_DurDeb.Strt_tiCtlErrDebOk_C "debouncing parameter / Duration of healing debouncing for check DFC_StrtCtlErr" VALUE 0x804D8B08 Val_Wu16 655350.0 DDRCTime_ms 0.00 655350.0 FORMAT "%8.1" /end CHARACTERISTIC
/begin CHARACTERISTIC DDRC_DurDeb.Strt_tiCtlErrDebDef_C "debouncing parameter / Duration of defect debouncing for check DFC_StrtCtlErr" VALUE 0x804D8B0A Val_Wu16 655350.0 DDRCTime_ms 0.00 655350.0 FORMAT "%8.1" /end CHARACTERISTIC
/begin CHARACTERISTIC DDRC_DurDeb.Strt_tiFaultDebOk_C "debouncing parameter / Duration of healing debouncing for check DFC_StrtFault" VALUE 0x804D8B0C Val_Wu16 655350.0 DDRCTime_ms 0.00 655350.0 FORMAT "%8.1" /end CHARACTERISTIC
/begin CHARACTERISTIC DDRC_DurDeb.Strt_tiFaultDebDef_C "debouncing parameter / Duration of defect debouncing for check DFC_StrtFault" VALUE 0x804D8B0E Val_Wu16 655350.0 DDRCTime_ms 0.00 655350.0 FORMAT "%8.1" /end CHARACTERISTIC
/begin CHARACTERISTIC DDRC_DurDeb.Strt_tiStkRly1DebOk_C "debouncing parameter / Duration of healing debouncing for check DFC_StrtStkRly1" VALUE 0x804D8B10 Val_Wu16 655350.0 DDRCTime_ms 0.00 655350.0 FORMAT "%8.1" /end CHARACTERISTIC
/begin CHARACTERISTIC DDRC_DurDeb.Strt_tiStkRly1DebDef_C "debouncing parameter / Duration of defect debouncing for check DFC_StrtStkRly1" VALUE 0x804D8B12 Val_Wu16 655350.0 DDRCTime_ms 0.00 655350.0 FORMAT "%8.1" /end CHARACTERISTIC
/begin CHARACTERISTIC DDRC_DurDeb.Strt_tiStkRly2DebOk_C "debouncing parameter / Duration of healing debouncing for check DFC_StrtStkRly2" VALUE 0x804D8B14 Val_Wu16 655350.0 DDRCTime_ms 0.00 655350.0 FORMAT "%8.1" /end CHARACTERISTIC
/begin CHARACTERISTIC DDRC_DurDeb.Strt_tiStkRly2DebDef_C "debouncing parameter / Duration of defect debouncing for check DFC_StrtStkRly2" VALUE 0x804D8B16 Val_Wu16 655350.0 DDRCTime_ms 0.00 655350.0 FORMAT "%8.1" /end CHARACTERISTIC
/begin CHARACTERISTIC DDRC_DurDeb.Strt_tiStmFaultDebOk_C "debouncing parameter / Duration of healing debouncing for check DFC_StmFault" VALUE 0x804D8B18 Val_Wu16 655350.0 DDRCTime_ms 0.00 655350.0 FORMAT "%8.1" /end CHARACTERISTIC
/begin CHARACTERISTIC DDRC_DurDeb.Strt_tiStmFaultDebDef_C "debouncing parameter / Duration of defect debouncing for check DFC_StmFault" VALUE 0x804D8B1A Val_Wu16 655350.0 DDRCTime_ms 0.00 655350.0 FORMAT "%8.1" /end CHARACTERISTIC
/begin CHARACTERISTIC DDRC_DurDeb.Strt_tiStrtLckJudg1DebOk_C "debouncing parameter / Duration of healing debouncing for check DFC_StrtLckJudg1" VALUE 0x804D8B1C Val_Wu16 655350.0 DDRCTime_ms 0.00 655350.0 FORMAT "%8.1" /end CHARACTERISTIC
/begin CHARACTERISTIC DDRC_DurDeb.Strt_tiStrtLckJudg1DebDef_C "debouncing parameter / Duration of defect debouncing for check DFC_StrtLckJudg1" VALUE 0x804D8B1E Val_Wu16 655350.0 DDRCTime_ms 0.00 655350.0 FORMAT "%8.1" /end CHARACTERISTIC
/begin CHARACTERISTIC DDRC_DurDeb.Strt_tiStrtLckJudg2DebOk_C "debouncing parameter / Duration of healing debouncing for check DFC_StrtLckJudg2" VALUE 0x804D8B20 Val_Wu16 655350.0 DDRCTime_ms 0.00 655350.0 FORMAT "%8.1" /end CHARACTERISTIC
/begin CHARACTERISTIC DDRC_DurDeb.Strt_tiStrtLckJudg2DebDef_C "debouncing parameter / Duration of defect debouncing for check DFC_StrtLckJudg2" VALUE 0x804D8B22 Val_Wu16 655350.0 DDRCTime_ms 0.00 655350.0 FORMAT "%8.1" /end CHARACTERISTIC
/begin CHARACTERISTIC DDRC_DurDeb.Strt_tiStrtOLDebOk_C "debouncing parameter / Duration of healing debouncing for check DFC_StrtOL" VALUE 0x804D8B24 Val_Wu16 655350.0 DDRCTime_ms 0.00 655350.0 FORMAT "%8.1" /end CHARACTERISTIC
/begin CHARACTERISTIC DDRC_DurDeb.Strt_tiStrtOLDebDef_C "debouncing parameter / Duration of defect debouncing for check DFC_StrtOL" VALUE 0x804D8B26 Val_Wu16 655350.0 DDRCTime_ms 0.00 655350.0 FORMAT "%8.1" /end CHARACTERISTIC
/begin CHARACTERISTIC DDRC_DurDeb.Strt_tiStrtOL2DebOk_C "debouncing parameter / Duration of healing debouncing for check DFC_StrtOL2" VALUE 0x804D8B28 Val_Wu16 655350.0 DDRCTime_ms 0.00 655350.0 FORMAT "%8.1" /end CHARACTERISTIC
/begin CHARACTERISTIC DDRC_DurDeb.Strt_tiStrtOL2DebDef_C "debouncing parameter / Duration of defect debouncing for check DFC_StrtOL2" VALUE 0x804D8B2A Val_Wu16 655350.0 DDRCTime_ms 0.00 655350.0 FORMAT "%8.1" /end CHARACTERISTIC
/begin CHARACTERISTIC DDRC_DurDeb.Strt_tiStrtSCBDebOk_C "debouncing parameter / Duration of healing debouncing for check DFC_StrtSCB" VALUE 0x804D8B2C Val_Wu16 655350.0 DDRCTime_ms 0.00 655350.0 FORMAT "%8.1" /end CHARACTERISTIC
/begin CHARACTERISTIC DDRC_DurDeb.Strt_tiStrtSCBDebDef_C "debouncing parameter / Duration of defect debouncing for check DFC_StrtSCB" VALUE 0x804D8B2E Val_Wu16 655350.0 DDRCTime_ms 0.00 655350.0 FORMAT "%8.1" /end CHARACTERISTIC
/begin CHARACTERISTIC DDRC_DurDeb.Strt_tiStrtSCB2DebOk_C "debouncing parameter / Duration of healing debouncing for check DFC_StrtSCB2" VALUE 0x804D8B30 Val_Wu16 655350.0 DDRCTime_ms 0.00 655350.0 FORMAT "%8.1" /end CHARACTERISTIC
/begin CHARACTERISTIC DDRC_DurDeb.Strt_tiStrtSCB2DebDef_C "debouncing parameter / Duration of defect debouncing for check DFC_StrtSCB2" VALUE 0x804D8B32 Val_Wu16 655350.0 DDRCTime_ms 0.00 655350.0 FORMAT "%8.1" /end CHARACTERISTIC
/begin CHARACTERISTIC DDRC_DurDeb.Strt_tiStrtSCGDebOk_C "debouncing parameter / Duration of healing debouncing for check DFC_StrtSCG" VALUE 0x804D8B34 Val_Wu16 655350.0 DDRCTime_ms 0.00 655350.0 FORMAT "%8.1" /end CHARACTERISTIC
/begin CHARACTERISTIC DDRC_DurDeb.Strt_tiStrtSCGDebDef_C "debouncing parameter / Duration of defect debouncing for check DFC_StrtSCG" VALUE 0x804D8B36 Val_Wu16 655350.0 DDRCTime_ms 0.00 655350.0 FORMAT "%8.1" /end CHARACTERISTIC
/begin CHARACTERISTIC DDRC_DurDeb.Strt_tiStrtSCG2DebOk_C "debouncing parameter / Duration of healing debouncing for check DFC_StrtSCG2" VALUE 0x804D8B38 Val_Wu16 655350.0 DDRCTime_ms 0.00 655350.0 FORMAT "%8.1" /end CHARACTERISTIC
/begin CHARACTERISTIC DDRC_DurDeb.Strt_tiStrtSCG2DebDef_C "debouncing parameter / Duration of defect debouncing for check DFC_StrtSCG2" VALUE 0x804D8B3A Val_Wu16 655350.0 DDRCTime_ms 0.00 655350.0 FORMAT "%8.1" /end CHARACTERISTIC
/begin CHARACTERISTIC DDRC_DurDeb.VehV_tiNCSnsrElecFailrDebOk_C "debouncing parameter / Duration of healing debouncing for check DFC_VehVNCSnsrElecFailr" VALUE 0x804D8B3C Val_Wu16 655350.0 DDRCTime_ms 0.00 655350.0 FORMAT "%8.1" /end CHARACTERISTIC
/begin CHARACTERISTIC DDRC_DurDeb.VehV_tiNCSnsrElecFailrDebDef_C "debouncing parameter / Duration of defect debouncing for check DFC_VehVNCSnsrElecFailr" VALUE 0x804D8B3E Val_Wu16 655350.0 DDRCTime_ms 0.00 655350.0 FORMAT "%8.1" /end CHARACTERISTIC
/begin CHARACTERISTIC DDRC_DurDeb.VehV_tiPlaAllDebOk_C "debouncing parameter / Duration of healing debouncing for check DFC_VehVAllPlaus" VALUE 0x804D8B40 Val_Wu16 655350.0 DDRCTime_ms 0.00 655350.0 FORMAT "%8.1" /end CHARACTERISTIC
/begin CHARACTERISTIC DDRC_DurDeb.VehV_tiPlaAllDebDef_C "debouncing parameter / Duration of defect debouncing for check DFC_VehVAllPlaus" VALUE 0x804D8B42 Val_Wu16 655350.0 DDRCTime_ms 0.00 655350.0 FORMAT "%8.1" /end CHARACTERISTIC
/begin CHARACTERISTIC DDRC_DurDeb.VehV_tiPlaCanDebOk_C "debouncing parameter / Duration of healing debouncing for check DFC_VehVPlausCan" VALUE 0x804D8B44 Val_Wu16 655350.0 DDRCTime_ms 0.00 655350.0 FORMAT "%8.1" /end CHARACTERISTIC
/begin CHARACTERISTIC DDRC_DurDeb.VehV_tiPlaCanDebDef_C "debouncing parameter / Duration of defect debouncing for check DFC_VehVPlausCan" VALUE 0x804D8B46 Val_Wu16 655350.0 DDRCTime_ms 0.00 655350.0 FORMAT "%8.1" /end CHARACTERISTIC
/begin CHARACTERISTIC DDRC_DurDeb.VehV_tiPlaFcoDebOk_C "debouncing parameter / Duration of healing debouncing for check DFC_VehVPlausFco" VALUE 0x804D8B48 Val_Wu16 655350.0 DDRCTime_ms 0.00 655350.0 FORMAT "%8.1" /end CHARACTERISTIC
/begin CHARACTERISTIC DDRC_DurDeb.VehV_tiPlaFcoDebDef_C "debouncing parameter / Duration of defect debouncing for check DFC_VehVPlausFco" VALUE 0x804D8B4A Val_Wu16 655350.0 DDRCTime_ms 0.00 655350.0 FORMAT "%8.1" /end CHARACTERISTIC
/begin CHARACTERISTIC DDRC_DurDeb.VehV_tiPlaPwrDebOk_C "debouncing parameter / Duration of healing debouncing for check DFC_VehVPlausPwr" VALUE 0x804D8B4C Val_Wu16 655350.0 DDRCTime_ms 0.00 655350.0 FORMAT "%8.1" /end CHARACTERISTIC
/begin CHARACTERISTIC DDRC_DurDeb.VehV_tiPlaPwrDebDef_C "debouncing parameter / Duration of defect debouncing for check DFC_VehVPlausPwr" VALUE 0x804D8B4E Val_Wu16 655350.0 DDRCTime_ms 0.00 655350.0 FORMAT "%8.1" /end CHARACTERISTIC
/begin CHARACTERISTIC DDRC_DurDeb.VehV_tiPlaV2NDebOk_C "debouncing parameter / Duration of healing debouncing for check DFC_VehVPlausV2N" VALUE 0x804D8B50 Val_Wu16 655350.0 DDRCTime_ms 0.00 655350.0 FORMAT "%8.1" /end CHARACTERISTIC
/begin CHARACTERISTIC DDRC_DurDeb.VehV_tiPlaV2NDebDef_C "debouncing parameter / Duration of defect debouncing for check DFC_VehVPlausV2N" VALUE 0x804D8B52 Val_Wu16 655350.0 DDRCTime_ms 0.00 655350.0 FORMAT "%8.1" /end CHARACTERISTIC
/begin CHARACTERISTIC DDRC_DurDeb.VehV_tiSpdSnsrAElecFailrDebOk_C "debouncing parameter / Duration of healing debouncing for check DFC_VehVSpdSnsrAElecFailr" VALUE 0x804D8B54 Val_Wu16 655350.0 DDRCTime_ms 0.00 655350.0 FORMAT "%8.1" /end CHARACTERISTIC
/begin CHARACTERISTIC DDRC_DurDeb.VehV_tiSpdSnsrAElecFailrDebDef_C "debouncing parameter / Duration of defect debouncing for check DFC_VehVSpdSnsrAElecFailr" VALUE 0x804D8B56 Val_Wu16 655350.0 DDRCTime_ms 0.00 655350.0 FORMAT "%8.1" /end CHARACTERISTIC
/begin CHARACTERISTIC DDRC_DurDeb.VehV_tiSpdSnsrBElecFailrDebOk_C "debouncing parameter / Duration of healing debouncing for check DFC_VehVSpdSnsrBElecFailr" VALUE 0x804D8B58 Val_Wu16 655350.0 DDRCTime_ms 0.00 655350.0 FORMAT "%8.1" /end CHARACTERISTIC
/begin CHARACTERISTIC DDRC_DurDeb.VehV_tiSpdSnsrBElecFailrDebDef_C "debouncing parameter / Duration of defect debouncing for check DFC_VehVSpdSnsrBElecFailr" VALUE 0x804D8B5A Val_Wu16 655350.0 DDRCTime_ms 0.00 655350.0 FORMAT "%8.1" /end CHARACTERISTIC
/begin CHARACTERISTIC DDRC_DurDeb.Clth_tiMaxDebOk_C "debouncing parameter / Duration of healing debouncing for check DFC_ClthMax" VALUE 0x804D8B5C Val_Wu16 65535.00 OneToOne 0.00 65535.00 FORMAT "%8.2" /end CHARACTERISTIC
/begin CHARACTERISTIC DDRC_DurDeb.Clth_tiMaxDebDef_C "debouncing parameter / Duration of defect debouncing for check DFC_ClthMax" VALUE 0x804D8B5E Val_Wu16 65535.00 OneToOne 0.00 65535.00 FORMAT "%8.2" /end CHARACTERISTIC
/begin CHARACTERISTIC DDRC_DurDeb.IgnClPs_numDevComErrDebOk_C "debouncing parameter / Duration of healing debouncing for check DFC_IgnClPs_DevComErr" VALUE 0x804D8B60 Val_Wu16 65535.00 OneToOne 0.00 65535.00 FORMAT "%8.2" /end CHARACTERISTIC
/begin CHARACTERISTIC DDRC_DurDeb.IgnClPs_numDevComErrDebDef_C "debouncing parameter / Duration of defect debouncing for check DFC_IgnClPs_DevComErr" VALUE 0x804D8B62 Val_Wu16 65535.00 OneToOne 0.00 65535.00 FORMAT "%8.2" /end CHARACTERISTIC
/begin CHARACTERISTIC DDRC_DurDeb.IgnClPs_numOpenLoadDebOk_C "debouncing parameter / Duration of healing debouncing for check DFC_IgnClPs_LineOl" VALUE 0x804D8B64 Val_Wu16 65535.00 OneToOne 0.00 65535.00 FORMAT "%8.2" /end CHARACTERISTIC
/begin CHARACTERISTIC DDRC_DurDeb.IgnClPs_numOpenLoadDebDef_C "debouncing parameter / Duration of defect debouncing for check DFC_IgnClPs_LineOl" VALUE 0x804D8B66 Val_Wu16 65535.00 OneToOne 0.00 65535.00 FORMAT "%8.2" /end CHARACTERISTIC
/begin CHARACTERISTIC DDRC_DurDeb.IgnClPs_numShCirBattDebOk_C "debouncing parameter / Duration of healing debouncing for check DFC_IgnClPs_LineScb" VALUE 0x804D8B68 Val_Wu16 65535.00 OneToOne 0.00 65535.00 FORMAT "%8.2" /end CHARACTERISTIC
/begin CHARACTERISTIC DDRC_DurDeb.IgnClPs_numShCirBattDebDef_C "debouncing parameter / Duration of defect debouncing for check DFC_IgnClPs_LineScb" VALUE 0x804D8B6A Val_Wu16 65535.00 OneToOne 0.00 65535.00 FORMAT "%8.2" /end CHARACTERISTIC
/begin CHARACTERISTIC DDRC_DurDeb.IgnClPs_numShCirGndDebOk_C "debouncing parameter / Duration of healing debouncing for check DFC_IgnClPs_LineScg" VALUE 0x804D8B6C Val_Wu16 65535.00 OneToOne 0.00 65535.00 FORMAT "%8.2" /end CHARACTERISTIC
/begin CHARACTERISTIC DDRC_DurDeb.IgnClPs_numShCirGndDebDef_C "debouncing parameter / Duration of defect debouncing for check DFC_IgnClPs_LineScg" VALUE 0x804D8B6E Val_Wu16 65535.00 OneToOne 0.00 65535.00 FORMAT "%8.2" /end CHARACTERISTIC
/begin CHARACTERISTIC DDRC_DurDeb.UEGO_numASICDebOk_C "debouncing parameter / Duration of healing debouncing for check DFC_UEGOASICS1B1" VALUE 0x804D8B70 Val_Wu16 65535.00 OneToOne 0.00 65535.00 FORMAT "%8.2" /end CHARACTERISTIC
/begin CHARACTERISTIC DDRC_DurDeb.UEGO_numASICDebDef_C "debouncing parameter / Duration of defect debouncing for check DFC_UEGOASICS1B1" VALUE 0x804D8B72 Val_Wu16 65535.00 OneToOne 0.00 65535.00 FORMAT "%8.2" /end CHARACTERISTIC
/begin CHARACTERISTIC DDRC_DurDeb.UEGO_numDiagSnsrDebOk_C "debouncing parameter / Duration of healing debouncing for check DFC_UEGOSnsrS1B1" VALUE 0x804D8B74 Val_Wu16 65535.00 OneToOne 0.00 65535.00 FORMAT "%8.2" /end CHARACTERISTIC
/begin CHARACTERISTIC DDRC_DurDeb.UEGO_numDiagSnsrDebDef_C "debouncing parameter / Duration of defect debouncing for check DFC_UEGOSnsrS1B1" VALUE 0x804D8B76 Val_Wu16 65535.00 OneToOne 0.00 65535.00 FORMAT "%8.2" /end CHARACTERISTIC
/begin CHARACTERISTIC DDRC_DurDeb.UEGO_numOLDebOk_C "debouncing parameter / Duration of healing debouncing for check DFC_UegoOlRCmpS1B1" VALUE 0x804D8B78 Val_Wu16 65535.00 OneToOne 0.00 65535.00 FORMAT "%8.2" /end CHARACTERISTIC
/begin CHARACTERISTIC DDRC_DurDeb.UEGO_numOLDebDef_C "debouncing parameter / Duration of defect debouncing for check DFC_UegoOlRCmpS1B1" VALUE 0x804D8B7A Val_Wu16 65535.00 OneToOne 0.00 65535.00 FORMAT "%8.2" /end CHARACTERISTIC
/begin CHARACTERISTIC DDRC_DurDeb.UEGO_numSCBDebOk_C "debouncing parameter / Duration of healing debouncing for check DFC_UEGOSCBS1B1" VALUE 0x804D8B7C Val_Wu16 65535.00 OneToOne 0.00 65535.00 FORMAT "%8.2" /end CHARACTERISTIC
/begin CHARACTERISTIC DDRC_DurDeb.UEGO_numSCBDebDef_C "debouncing parameter / Duration of defect debouncing for check DFC_UEGOSCBS1B1" VALUE 0x804D8B7E Val_Wu16 65535.00 OneToOne 0.00 65535.00 FORMAT "%8.2" /end CHARACTERISTIC
/begin CHARACTERISTIC DDRC_DurDeb.UEGO_numSCGDebOk_C "debouncing parameter / Duration of healing debouncing for check DFC_UEGOSCGS1B1" VALUE 0x804D8B80 Val_Wu16 65535.00 OneToOne 0.00 65535.00 FORMAT "%8.2" /end CHARACTERISTIC
/begin CHARACTERISTIC DDRC_DurDeb.UEGO_numSCGDebDef_C "debouncing parameter / Duration of defect debouncing for check DFC_UEGOSCGS1B1" VALUE 0x804D8B82 Val_Wu16 65535.00 OneToOne 0.00 65535.00 FORMAT "%8.2" /end CHARACTERISTIC
/begin CHARACTERISTIC DDRC_DurDeb.UEGO_numSPIDebOk_C "debouncing parameter / Duration of healing debouncing for check DFC_UEGOSPIS1B1" VALUE 0x804D8B84 Val_Wu16 65535.00 OneToOne 0.00 65535.00 FORMAT "%8.2" /end CHARACTERISTIC
/begin CHARACTERISTIC DDRC_DurDeb.UEGO_numSPIDebDef_C "debouncing parameter / Duration of defect debouncing for check DFC_UEGOSPIS1B1" VALUE 0x804D8B86 Val_Wu16 65535.00 OneToOne 0.00 65535.00 FORMAT "%8.2" /end CHARACTERISTIC
/begin CHARACTERISTIC DDRC_DurDeb.PEnv_tiVDDiagDebOk_C "debouncing parameter / Duration of healing debouncing for check DFC_PEnvSnsrPlaus" VALUE 0x804D8B88 Val_Wu16 655350.0 DDRCTime_ms 0.00 655350.0 FORMAT "%8.1" /end CHARACTERISTIC
/begin CHARACTERISTIC DDRC_DurDeb.PEnv_tiVDDiagDebDef_C "debouncing parameter / Duration of defect debouncing for check DFC_PEnvSnsrPlaus" VALUE 0x804D8B8A Val_Wu16 655350.0 DDRCTime_ms 0.00 655350.0 FORMAT "%8.1" /end CHARACTERISTIC
/begin CHARACTERISTIC DDRC_DurDeb.UEGO_HeatrRlyPsDiag_tiOLDebOk_C "debouncing parameter / Duration of healing debouncing for check DFC_UEGOHeatrRlyPsOLS1B1" VALUE 0x804D8B8C Val_Wu16 655350.0 DDRCTime_ms 0.00 655350.0 FORMAT "%8.1" /end CHARACTERISTIC
/begin CHARACTERISTIC DDRC_DurDeb.UEGO_HeatrRlyPsDiag_tiOLDebDef_C "debouncing parameter / Duration of defect debouncing for check DFC_UEGOHeatrRlyPsOLS1B1" VALUE 0x804D8B8E Val_Wu16 655350.0 DDRCTime_ms 0.00 655350.0 FORMAT "%8.1" /end CHARACTERISTIC
/begin CHARACTERISTIC DDRC_DurDeb.UEGO_HeatrRlyPsDiag_tiSCBDebOk_C "debouncing parameter / Duration of healing debouncing for check DFC_UEGOHeatrRlyPsSCBS1B1" VALUE 0x804D8B90 Val_Wu16 655350.0 DDRCTime_ms 0.00 655350.0 FORMAT "%8.1" /end CHARACTERISTIC
/begin CHARACTERISTIC DDRC_DurDeb.UEGO_HeatrRlyPsDiag_tiSCBDebDef_C "debouncing parameter / Duration of defect debouncing for check DFC_UEGOHeatrRlyPsSCBS1B1" VALUE 0x804D8B92 Val_Wu16 655350.0 DDRCTime_ms 0.00 655350.0 FORMAT "%8.1" /end CHARACTERISTIC
/begin CHARACTERISTIC DDRC_DurDeb.UEGO_HeatrRlyPsDiag_tiSCGDebOk_C "debouncing parameter / Duration of healing debouncing for check DFC_UEGOHeatrRlyPsSCGS1B1" VALUE 0x804D8B94 Val_Wu16 655350.0 DDRCTime_ms 0.00 655350.0 FORMAT "%8.1" /end CHARACTERISTIC
/begin CHARACTERISTIC DDRC_DurDeb.UEGO_HeatrRlyPsDiag_tiSCGDebDef_C "debouncing parameter / Duration of defect debouncing for check DFC_UEGOHeatrRlyPsSCGS1B1" VALUE 0x804D8B96 Val_Wu16 655350.0 DDRCTime_ms 0.00 655350.0 FORMAT "%8.1" /end CHARACTERISTIC
/begin CHARACTERISTIC DDRC_DurDeb.UEGO_HtrPSDia_tiOLDebOk_C "debouncing parameter / Duration of healing debouncing for check DFC_UEGOHeatrPsS1B1Sig" VALUE 0x804D8B98 Val_Wu16 655350.0 DDRCTime_ms 0.00 655350.0 FORMAT "%8.1" /end CHARACTERISTIC
/begin CHARACTERISTIC DDRC_DurDeb.UEGO_HtrPSDia_tiOLDebDef_C "debouncing parameter / Duration of defect debouncing for check DFC_UEGOHeatrPsS1B1Sig" VALUE 0x804D8B9A Val_Wu16 655350.0 DDRCTime_ms 0.00 655350.0 FORMAT "%8.1" /end CHARACTERISTIC
/begin CHARACTERISTIC DDRC_DurDeb.UEGO_HtrPSDia_tiSCBDebOk_C "debouncing parameter / Duration of healing debouncing for check DFC_UEGOHeatrPsS1B1Max" VALUE 0x804D8B9C Val_Wu16 655350.0 DDRCTime_ms 0.00 655350.0 FORMAT "%8.1" /end CHARACTERISTIC
/begin CHARACTERISTIC DDRC_DurDeb.UEGO_HtrPSDia_tiSCBDebDef_C "debouncing parameter / Duration of defect debouncing for check DFC_UEGOHeatrPsS1B1Max" VALUE 0x804D8B9E Val_Wu16 655350.0 DDRCTime_ms 0.00 655350.0 FORMAT "%8.1" /end CHARACTERISTIC
/begin CHARACTERISTIC DDRC_DurDeb.UEGO_HtrPSDia_tiSCGDebOk_C "debouncing parameter / Duration of healing debouncing for check DFC_UEGOHeatrPsS1B1Min" VALUE 0x804D8BA0 Val_Wu16 655350.0 DDRCTime_ms 0.00 655350.0 FORMAT "%8.1" /end CHARACTERISTIC
/begin CHARACTERISTIC DDRC_DurDeb.UEGO_HtrPSDia_tiSCGDebDef_C "debouncing parameter / Duration of defect debouncing for check DFC_UEGOHeatrPsS1B1Min" VALUE 0x804D8BA2 Val_Wu16 655350.0 DDRCTime_ms 0.00 655350.0 FORMAT "%8.1" /end CHARACTERISTIC
/begin CHARACTERISTIC DDRC_DurDeb.KnDet_numShCirDebOk_C "debouncing parameter / Duration of healing debouncing for check DFC_KnDetSens1PortBMax" VALUE 0x804D8BA4 Val_Wu16 65535.00 OneToOne 0.00 65535.00 FORMAT "%8.2" /end CHARACTERISTIC
/begin CHARACTERISTIC DDRC_DurDeb.KnDet_numShCirDebDef_C "debouncing parameter / Duration of defect debouncing for check DFC_KnDetSens1PortBMax" VALUE 0x804D8BA6 Val_Wu16 65535.00 OneToOne 0.00 65535.00 FORMAT "%8.2" /end CHARACTERISTIC
/begin CHARACTERISTIC DDRC_RatDeb.AirC_tiCmprOLUDRat_C "Ratioof up-down debouncing / Defect / Heal Ratio for check DFC_AirCCmprOL" VALUE 0x804EE5DE Val_Wu8 3.00000000000 DDRC_Ratio 1.00000000000 4.00000000000 FORMAT "%13.11" /end CHARACTERISTIC
/begin CHARACTERISTIC DDRC_RatDeb.AirC_tiCmprOvrTempUDRat_C "Ratioof up-down debouncing / Defect / Heal Ratio for check DFC_AirCCmprOvrTemp" VALUE 0x804EE5DF Val_Wu8 3.00000000000 DDRC_Ratio 1.00000000000 4.00000000000 FORMAT "%13.11" /end CHARACTERISTIC
/begin CHARACTERISTIC DDRC_RatDeb.AirC_tiCmprSCBUDRat_C "Ratioof up-down debouncing / Defect / Heal Ratio for check DFC_AirCCmprSCB" VALUE 0x804EE5E0 Val_Wu8 3.00000000000 DDRC_Ratio 1.00000000000 4.00000000000 FORMAT "%13.11" /end CHARACTERISTIC
/begin CHARACTERISTIC DDRC_RatDeb.AirC_tiCmprSCGUDRat_C "Ratioof up-down debouncing / Defect / Heal Ratio for check DFC_AirCCmprSCG" VALUE 0x804EE5E1 Val_Wu8 3.00000000000 DDRC_Ratio 1.00000000000 4.00000000000 FORMAT "%13.11" /end CHARACTERISTIC
/begin CHARACTERISTIC DDRC_RatDeb.Alt_tiErrUDRat_C "Ratioof up-down debouncing / Defect / Heal Ratio for check DFC_AltErr" VALUE 0x804EE5E2 Val_Wu8 3.00000000000 DDRC_Ratio 1.00000000000 4.00000000000 FORMAT "%13.11" /end CHARACTERISTIC
/begin CHARACTERISTIC DDRC_RatDeb.BattU_tiMaxUDRat_C "Ratioof up-down debouncing / Defect / Heal Ratio for check DFC_BattUSRCMax" VALUE 0x804EE5E3 Val_Wu8 3.00000000000 DDRC_Ratio 1.00000000000 4.00000000000 FORMAT "%13.11" /end CHARACTERISTIC
/begin CHARACTERISTIC DDRC_RatDeb.BattU_tiMinUDRat_C "Ratioof up-down debouncing / Defect / Heal Ratio for check DFC_BattUSRCMin" VALUE 0x804EE5E4 Val_Wu8 3.00000000000 DDRC_Ratio 1.00000000000 4.00000000000 FORMAT "%13.11" /end CHARACTERISTIC
/begin CHARACTERISTIC DDRC_RatDeb.Com_tiChksTCU1UDRat_C "Ratioof up-down debouncing / Defect / Heal Ratio for check DFC_ComChksTCU1" VALUE 0x804EE5E5 Val_Wu8 3.00000000000 DDRC_Ratio 1.00000000000 4.00000000000 FORMAT "%13.11" /end CHARACTERISTIC
/begin CHARACTERISTIC DDRC_RatDeb.Com_tiChksTCU11UDRat_C "Ratioof up-down debouncing / Defect / Heal Ratio for check DFC_ComChksTCU11" VALUE 0x804EE5E6 Val_Wu8 3.00000000000 DDRC_Ratio 1.00000000000 4.00000000000 FORMAT "%13.11" /end CHARACTERISTIC
/begin CHARACTERISTIC DDRC_RatDeb.Com_tiChksTCU12UDRat_C "Ratioof up-down debouncing / Defect / Heal Ratio for check DFC_ComChksTCU12" VALUE 0x804EE5E7 Val_Wu8 3.00000000000 DDRC_Ratio 1.00000000000 4.00000000000 FORMAT "%13.11" /end CHARACTERISTIC
/begin CHARACTERISTIC DDRC_RatDeb.Com_tiChksTCU13UDRat_C "Ratioof up-down debouncing / Defect / Heal Ratio for check DFC_ComChksTCU13" VALUE 0x804EE5E8 Val_Wu8 3.00000000000 DDRC_Ratio 1.00000000000 4.00000000000 FORMAT "%13.11" /end CHARACTERISTIC
/begin CHARACTERISTIC DDRC_RatDeb.Com_tiChksTCU2UDRat_C "Ratioof up-down debouncing / Defect / Heal Ratio for check DFC_ComChksTCU2" VALUE 0x804EE5E9 Val_Wu8 3.00000000000 DDRC_Ratio 1.00000000000 4.00000000000 FORMAT "%13.11" /end CHARACTERISTIC
/begin CHARACTERISTIC DDRC_RatDeb.Com_tiChksTCU3UDRat_C "Ratioof up-down debouncing / Defect / Heal Ratio for check DFC_ComChksTCU3" VALUE 0x804EE5EA Val_Wu8 3.00000000000 DDRC_Ratio 1.00000000000 4.00000000000 FORMAT "%13.11" /end CHARACTERISTIC
/begin CHARACTERISTIC DDRC_RatDeb.Com_tiChksTCU4UDRat_C "Ratioof up-down debouncing / Defect / Heal Ratio for check DFC_ComChksTCU4" VALUE 0x804EE5EB Val_Wu8 3.00000000000 DDRC_Ratio 1.00000000000 4.00000000000 FORMAT "%13.11" /end CHARACTERISTIC
/begin CHARACTERISTIC DDRC_RatDeb.Com_tiCntTCU1UDRat_C "Ratioof up-down debouncing / Defect / Heal Ratio for check DFC_ComCntTCU1" VALUE 0x804EE5EC Val_Wu8 3.00000000000 DDRC_Ratio 1.00000000000 4.00000000000 FORMAT "%13.11" /end CHARACTERISTIC
/begin CHARACTERISTIC DDRC_RatDeb.Com_tiCntTCU11UDRat_C "Ratioof up-down debouncing / Defect / Heal Ratio for check DFC_ComCntTCU11" VALUE 0x804EE5ED Val_Wu8 3.00000000000 DDRC_Ratio 1.00000000000 4.00000000000 FORMAT "%13.11" /end CHARACTERISTIC
/begin CHARACTERISTIC DDRC_RatDeb.Com_tiCntTCU12UDRat_C "Ratioof up-down debouncing / Defect / Heal Ratio for check DFC_ComCntTCU12" VALUE 0x804EE5EE Val_Wu8 3.00000000000 DDRC_Ratio 1.00000000000 4.00000000000 FORMAT "%13.11" /end CHARACTERISTIC
/begin CHARACTERISTIC DDRC_RatDeb.Com_tiCntTCU13UDRat_C "Ratioof up-down debouncing / Defect / Heal Ratio for check DFC_ComCntTCU13" VALUE 0x804EE5EF Val_Wu8 3.00000000000 DDRC_Ratio 1.00000000000 4.00000000000 FORMAT "%13.11" /end CHARACTERISTIC
/begin CHARACTERISTIC DDRC_RatDeb.Com_tiCntTCU2UDRat_C "Ratioof up-down debouncing / Defect / Heal Ratio for check DFC_ComCntTCU2" VALUE 0x804EE5F0 Val_Wu8 3.00000000000 DDRC_Ratio 1.00000000000 4.00000000000 FORMAT "%13.11" /end CHARACTERISTIC
/begin CHARACTERISTIC DDRC_RatDeb.Com_tiCntTCU3UDRat_C "Ratioof up-down debouncing / Defect / Heal Ratio for check DFC_ComCntTCU3" VALUE 0x804EE5F1 Val_Wu8 3.00000000000 DDRC_Ratio 1.00000000000 4.00000000000 FORMAT "%13.11" /end CHARACTERISTIC
/begin CHARACTERISTIC DDRC_RatDeb.Com_tiCntTCU4UDRat_C "Ratioof up-down debouncing / Defect / Heal Ratio for check DFC_ComCntTCU4" VALUE 0x804EE5F2 Val_Wu8 3.00000000000 DDRC_Ratio 1.00000000000 4.00000000000 FORMAT "%13.11" /end CHARACTERISTIC
/begin CHARACTERISTIC DDRC_RatDeb.Com_tiTOutTCU01UDRat_C "Ratioof up-down debouncing / Defect / Heal Ratio for check DFC_ComTOutTCU01" VALUE 0x804EE5F3 Val_Wu8 3.00000000000 DDRC_Ratio 1.00000000000 4.00000000000 FORMAT "%13.11" /end CHARACTERISTIC
/begin CHARACTERISTIC DDRC_RatDeb.Com_tiTOutTCU02UDRat_C "Ratioof up-down debouncing / Defect / Heal Ratio for check DFC_ComTOutTCU02" VALUE 0x804EE5F4 Val_Wu8 3.00000000000 DDRC_Ratio 1.00000000000 4.00000000000 FORMAT "%13.11" /end CHARACTERISTIC
/begin CHARACTERISTIC DDRC_RatDeb.Com_tiTOutTCU1UDRat_C "Ratioof up-down debouncing / Defect / Heal Ratio for check DFC_ComTOutTCU1" VALUE 0x804EE5F5 Val_Wu8 3.00000000000 DDRC_Ratio 1.00000000000 4.00000000000 FORMAT "%13.11" /end CHARACTERISTIC
/begin CHARACTERISTIC DDRC_RatDeb.Com_tiTOutTCU11UDRat_C "Ratioof up-down debouncing / Defect / Heal Ratio for check DFC_ComTOutTCU11" VALUE 0x804EE5F6 Val_Wu8 3.00000000000 DDRC_Ratio 1.00000000000 4.00000000000 FORMAT "%13.11" /end CHARACTERISTIC
/begin CHARACTERISTIC DDRC_RatDeb.Com_tiTOutTCU12UDRat_C "Ratioof up-down debouncing / Defect / Heal Ratio for check DFC_ComTOutTCU12" VALUE 0x804EE5F7 Val_Wu8 3.00000000000 DDRC_Ratio 1.00000000000 4.00000000000 FORMAT "%13.11" /end CHARACTERISTIC
/begin CHARACTERISTIC DDRC_RatDeb.Com_tiTOutTCU13UDRat_C "Ratioof up-down debouncing / Defect / Heal Ratio for check DFC_ComTOutTCU13" VALUE 0x804EE5F8 Val_Wu8 3.00000000000 DDRC_Ratio 1.00000000000 4.00000000000 FORMAT "%13.11" /end CHARACTERISTIC
/begin CHARACTERISTIC DDRC_RatDeb.Com_tiTOutTCU14UDRat_C "Ratioof up-down debouncing / Defect / Heal Ratio for check DFC_ComTOutTCU14" VALUE 0x804EE5F9 Val_Wu8 3.00000000000 DDRC_Ratio 1.00000000000 4.00000000000 FORMAT "%13.11" /end CHARACTERISTIC
/begin CHARACTERISTIC DDRC_RatDeb.Com_tiTOutTCU2UDRat_C "Ratioof up-down debouncing / Defect / Heal Ratio for check DFC_ComTOutTCU2" VALUE 0x804EE5FA Val_Wu8 3.00000000000 DDRC_Ratio 1.00000000000 4.00000000000 FORMAT "%13.11" /end CHARACTERISTIC
/begin CHARACTERISTIC DDRC_RatDeb.Com_tiTOutTCU3UDRat_C "Ratioof up-down debouncing / Defect / Heal Ratio for check DFC_ComTOutTCU3" VALUE 0x804EE5FB Val_Wu8 3.00000000000 DDRC_Ratio 1.00000000000 4.00000000000 FORMAT "%13.11" /end CHARACTERISTIC
/begin CHARACTERISTIC DDRC_RatDeb.Com_tiTOutTCU4UDRat_C "Ratioof up-down debouncing / Defect / Heal Ratio for check DFC_ComTOutTCU4" VALUE 0x804EE5FC Val_Wu8 3.00000000000 DDRC_Ratio 1.00000000000 4.00000000000 FORMAT "%13.11" /end CHARACTERISTIC
/begin CHARACTERISTIC DDRC_RatDeb.DevLib_tiBattUHiUDRat_C "Ratioof up-down debouncing / Defect / Heal Ratio for check DFC_DevLibBattUHi" VALUE 0x804EE5FD Val_Wu8 3.00000000000 DDRC_Ratio 1.00000000000 4.00000000000 FORMAT "%13.11" /end CHARACTERISTIC
/begin CHARACTERISTIC DDRC_RatDeb.DevLib_tiBattULoUDRat_C "Ratioof up-down debouncing / Defect / Heal Ratio for check DFC_DevLibBattULo" VALUE 0x804EE5FE Val_Wu8 3.00000000000 DDRC_Ratio 1.00000000000 4.00000000000 FORMAT "%13.11" /end CHARACTERISTIC
/begin CHARACTERISTIC DDRC_RatDeb.Fan_tiDIOOLUDRat_C "Ratioof up-down debouncing / Defect / Heal Ratio for check DFC_FanDIOOL" VALUE 0x804EE5FF Val_Wu8 3.00000000000 DDRC_Ratio 1.00000000000 4.00000000000 FORMAT "%13.11" /end CHARACTERISTIC
/begin CHARACTERISTIC DDRC_RatDeb.Fan_tiDIOOvrTempUDRat_C "Ratioof up-down debouncing / Defect / Heal Ratio for check DFC_FanDIOOvrTemp" VALUE 0x804EE600 Val_Wu8 3.00000000000 DDRC_Ratio 1.00000000000 4.00000000000 FORMAT "%13.11" /end CHARACTERISTIC
/begin CHARACTERISTIC DDRC_RatDeb.Fan_tiDIOSCBUDRat_C "Ratioof up-down debouncing / Defect / Heal Ratio for check DFC_FanDIOSCB" VALUE 0x804EE601 Val_Wu8 3.00000000000 DDRC_Ratio 1.00000000000 4.00000000000 FORMAT "%13.11" /end CHARACTERISTIC
/begin CHARACTERISTIC DDRC_RatDeb.Fan_tiDIOSCGUDRat_C "Ratioof up-down debouncing / Defect / Heal Ratio for check DFC_FanDIOSCG" VALUE 0x804EE602 Val_Wu8 3.00000000000 DDRC_Ratio 1.00000000000 4.00000000000 FORMAT "%13.11" /end CHARACTERISTIC
/begin CHARACTERISTIC DDRC_RatDeb.MRlyDcOL_tisigOLUDRat_C "Ratioof up-down debouncing / Defect / Heal Ratio for check DFC_MRlyDcOL" VALUE 0x804EE603 Val_Wu8 3.00000000000 DDRC_Ratio 1.00000000000 4.00000000000 FORMAT "%13.11" /end CHARACTERISTIC
/begin CHARACTERISTIC DDRC_RatDeb.MRlyDcSCB_tisigSCBUDRat_C "Ratioof up-down debouncing / Defect / Heal Ratio for check DFC_MRlyDcSCB" VALUE 0x804EE604 Val_Wu8 3.00000000000 DDRC_Ratio 1.00000000000 4.00000000000 FORMAT "%13.11" /end CHARACTERISTIC
/begin CHARACTERISTIC DDRC_RatDeb.MRlyDcSCG_tisigSCGUDRat_C "Ratioof up-down debouncing / Defect / Heal Ratio for check DFC_MRlyDcSCG" VALUE 0x804EE605 Val_Wu8 3.00000000000 DDRC_Ratio 1.00000000000 4.00000000000 FORMAT "%13.11" /end CHARACTERISTIC
/begin CHARACTERISTIC DDRC_RatDeb.PSP_tiOLUDRat_C "Ratioof up-down debouncing / Defect / Heal Ratio for check DFC_PSPOL" VALUE 0x804EE606 Val_Wu8 3.00000000000 DDRC_Ratio 1.00000000000 4.00000000000 FORMAT "%13.11" /end CHARACTERISTIC
/begin CHARACTERISTIC DDRC_RatDeb.PSP_tiOvrTempUDRat_C "Ratioof up-down debouncing / Defect / Heal Ratio for check DFC_PSPOvrTemp" VALUE 0x804EE607 Val_Wu8 3.00000000000 DDRC_Ratio 1.00000000000 4.00000000000 FORMAT "%13.11" /end CHARACTERISTIC
/begin CHARACTERISTIC DDRC_RatDeb.PSP_tiSCBUDRat_C "Ratioof up-down debouncing / Defect / Heal Ratio for check DFC_PSPSCB" VALUE 0x804EE608 Val_Wu8 3.00000000000 DDRC_Ratio 1.00000000000 4.00000000000 FORMAT "%13.11" /end CHARACTERISTIC
/begin CHARACTERISTIC DDRC_RatDeb.PSP_tiSCGUDRat_C "Ratioof up-down debouncing / Defect / Heal Ratio for check DFC_PSPSCG" VALUE 0x804EE609 Val_Wu8 3.00000000000 DDRC_Ratio 1.00000000000 4.00000000000 FORMAT "%13.11" /end CHARACTERISTIC
/begin CHARACTERISTIC DDRC_RatDeb.T50_tiErrUDRat_C "Ratioof up-down debouncing / Defect / Heal Ratio for check DFC_T50Err" VALUE 0x804EE60A Val_Wu8 3.00000000000 DDRC_Ratio 1.00000000000 4.00000000000 FORMAT "%13.11" /end CHARACTERISTIC
/begin CHARACTERISTIC DDRC_RatDeb.ThrVlv_tiLoBattB1UDRat_C "Ratioof up-down debouncing / Defect / Heal Ratio for check DFC_ThrVlvLoBattB1" VALUE 0x804EE60B Val_Wu8 3.00000000000 DDRC_Ratio 1.00000000000 4.00000000000 FORMAT "%13.11" /end CHARACTERISTIC
/begin CHARACTERISTIC DDRC_RatDeb.VehV_tiOLUDRat_C "Ratioof up-down debouncing / Defect / Heal Ratio for check DFC_VehVSclOutOL" VALUE 0x804EE60C Val_Wu8 3.00000000000 DDRC_Ratio 1.00000000000 4.00000000000 FORMAT "%13.11" /end CHARACTERISTIC
/begin CHARACTERISTIC DDRC_RatDeb.VehV_tiOTUDRat_C "Ratioof up-down debouncing / Defect / Heal Ratio for check DFC_VehVSclOutOT" VALUE 0x804EE60D Val_Wu8 3.00000000000 DDRC_Ratio 1.00000000000 4.00000000000 FORMAT "%13.11" /end CHARACTERISTIC
/begin CHARACTERISTIC DDRC_RatDeb.VehV_tiPhysRngHiUDRat_C "Ratioof up-down debouncing / Defect / Heal Ratio for check DFC_VehVPhysRngHi" VALUE 0x804EE60E Val_Wu8 3.00000000000 DDRC_Ratio 1.00000000000 4.00000000000 FORMAT "%13.11" /end CHARACTERISTIC
/begin CHARACTERISTIC DDRC_RatDeb.VehV_tiSCBUDRat_C "Ratioof up-down debouncing / Defect / Heal Ratio for check DFC_VehVSclOutSCB" VALUE 0x804EE60F Val_Wu8 3.00000000000 DDRC_Ratio 1.00000000000 4.00000000000 FORMAT "%13.11" /end CHARACTERISTIC
/begin CHARACTERISTIC DDRC_RatDeb.VehV_tiSCGUDRat_C "Ratioof up-down debouncing / Defect / Heal Ratio for check DFC_VehVSclOutSCG" VALUE 0x804EE610 Val_Wu8 3.00000000000 DDRC_Ratio 1.00000000000 4.00000000000 FORMAT "%13.11" /end CHARACTERISTIC
/begin CHARACTERISTIC DDRC_RatDeb.VehV_tiSnsrARngHiUDRat_C "Ratioof up-down debouncing / Defect / Heal Ratio for check DFC_VehVSnsrARngHi" VALUE 0x804EE611 Val_Wu8 3.00000000000 DDRC_Ratio 1.00000000000 4.00000000000 FORMAT "%13.11" /end CHARACTERISTIC
/begin CHARACTERISTIC DDRC_RatDeb.VehV_tiSnsrBRngHiUDRat_C "Ratioof up-down debouncing / Defect / Heal Ratio for check DFC_VehVSnsrBRngHi" VALUE 0x804EE612 Val_Wu8 3.00000000000 DDRC_Ratio 1.00000000000 4.00000000000 FORMAT "%13.11" /end CHARACTERISTIC
/begin CHARACTERISTIC DDRC_RatDeb.VehV_tiSpdRtyDiagUDRat_C "Ratioof up-down debouncing / Defect / Heal Ratio for check DFC_VehVSpdRtyDiag" VALUE 0x804EE613 Val_Wu8 3.00000000000 DDRC_Ratio 1.00000000000 4.00000000000 FORMAT "%13.11" /end CHARACTERISTIC
/begin CHARACTERISTIC DDRC_RatDeb.VehV_ctWhlErrUDRat_C "Ratioof up-down debouncing / Defect / Heal Ratio for check DFC_VehVWhlErr" VALUE 0x804EE614 Val_Wu8 3.00000000000 DDRC_Ratio 1.00000000000 4.00000000000 FORMAT "%13.11" /end CHARACTERISTIC
/begin CHARACTERISTIC DDRC_RatDeb.ACEvpT_tiSRCMaxUDRat_C "Ratioof up-down debouncing / Defect / Heal Ratio for check DFC_ACEvpTSRCMax" VALUE 0x804EE615 Val_Wu8 3.00000000000 DDRC_Ratio 1.00000000000 4.00000000000 FORMAT "%13.11" /end CHARACTERISTIC
/begin CHARACTERISTIC DDRC_RatDeb.ACEvpT_tiSRCMinUDRat_C "Ratioof up-down debouncing / Defect / Heal Ratio for check DFC_ACEvpTSRCMin" VALUE 0x804EE616 Val_Wu8 3.00000000000 DDRC_Ratio 1.00000000000 4.00000000000 FORMAT "%13.11" /end CHARACTERISTIC
/begin CHARACTERISTIC DDRC_RatDeb.AirC_tiClntSRCMaxUDRat_C "Ratioof up-down debouncing / Defect / Heal Ratio for check DFC_AirCClntPAnaSRCMax" VALUE 0x804EE617 Val_Wu8 3.00000000000 DDRC_Ratio 1.00000000000 4.00000000000 FORMAT "%13.11" /end CHARACTERISTIC
/begin CHARACTERISTIC DDRC_RatDeb.AirC_tiClntSRCMinUDRat_C "Ratioof up-down debouncing / Defect / Heal Ratio for check DFC_AirCClntPAnaSRCMin" VALUE 0x804EE618 Val_Wu8 3.00000000000 DDRC_Ratio 1.00000000000 4.00000000000 FORMAT "%13.11" /end CHARACTERISTIC
/begin CHARACTERISTIC DDRC_RatDeb.AirC_tiSwtNplUDRat_C "Ratioof up-down debouncing / Defect / Heal Ratio for check DFC_AirCSwtNpl" VALUE 0x804EE619 Val_Wu8 3.00000000000 DDRC_Ratio 1.00000000000 4.00000000000 FORMAT "%13.11" /end CHARACTERISTIC
/begin CHARACTERISTIC DDRC_RatDeb.AirC_tiSwtSigUDRat_C "Ratioof up-down debouncing / Defect / Heal Ratio for check DFC_AirCSwtSig" VALUE 0x804EE61A Val_Wu8 3.00000000000 DDRC_Ratio 1.00000000000 4.00000000000 FORMAT "%13.11" /end CHARACTERISTIC
/begin CHARACTERISTIC DDRC_RatDeb.Brk_tiUDRat_C "Ratioof up-down debouncing / Defect / Heal Ratio for check DFC_Brk" VALUE 0x804EE61B Val_Wu8 3.00000000000 DDRC_Ratio 1.00000000000 4.00000000000 FORMAT "%13.11" /end CHARACTERISTIC
/begin CHARACTERISTIC DDRC_RatDeb.Brk_tiSigUDRat_C "Ratioof up-down debouncing / Defect / Heal Ratio for check DFC_BrkSig" VALUE 0x804EE61C Val_Wu8 3.00000000000 DDRC_Ratio 1.00000000000 4.00000000000 FORMAT "%13.11" /end CHARACTERISTIC
/begin CHARACTERISTIC DDRC_RatDeb.Clth_tiSigUDRat_C "Ratioof up-down debouncing / Defect / Heal Ratio for check DFC_ClthSig" VALUE 0x804EE61D Val_Wu8 3.00000000000 DDRC_Ratio 1.00000000000 4.00000000000 FORMAT "%13.11" /end CHARACTERISTIC
/begin CHARACTERISTIC DDRC_RatDeb.HLSDem_tiOvhtUDRat_C "Ratioof up-down debouncing / Defect / Heal Ratio for check DFC_HLSDemOvhtEngLim" VALUE 0x804EE61E Val_Wu8 3.00000000000 DDRC_Ratio 1.00000000000 4.00000000000 FORMAT "%13.11" /end CHARACTERISTIC
/begin CHARACTERISTIC DDRC_RatDeb.Oil_tiNplPUDRat_C "Ratioof up-down debouncing / Defect / Heal Ratio for check DFC_OilPNpl" VALUE 0x804EE61F Val_Wu8 3.00000000000 DDRC_Ratio 1.00000000000 4.00000000000 FORMAT "%13.11" /end CHARACTERISTIC
/begin CHARACTERISTIC DDRC_RatDeb.PIntkVUs_tiLineHiB1UDRat_C "Ratioof up-down debouncing / Defect / Heal Ratio for check DFC_PIntkVUsLineHiB1" VALUE 0x804EE620 Val_Wu8 3.00000000000 DDRC_Ratio 1.00000000000 4.00000000000 FORMAT "%13.11" /end CHARACTERISTIC
/begin CHARACTERISTIC DDRC_RatDeb.PIntkVUs_tiLineLoB1UDRat_C "Ratioof up-down debouncing / Defect / Heal Ratio for check DFC_PIntkVUsLineLoB1" VALUE 0x804EE621 Val_Wu8 3.00000000000 DDRC_Ratio 1.00000000000 4.00000000000 FORMAT "%13.11" /end CHARACTERISTIC
/begin CHARACTERISTIC DDRC_RatDeb.VehV_tiPhysRngLoUDRat_C "Ratioof up-down debouncing / Defect / Heal Ratio for check DFC_VehVPhysRngLo" VALUE 0x804EE622 Val_Wu8 3.00000000000 DDRC_Ratio 1.00000000000 4.00000000000 FORMAT "%13.11" /end CHARACTERISTIC
/begin CHARACTERISTIC DDRC_RatDeb.VehV_tiSigCanUDRat_C "Ratioof up-down debouncing / Defect / Heal Ratio for check DFC_VehVSigCan" VALUE 0x804EE623 Val_Wu8 3.00000000000 DDRC_Ratio 1.00000000000 4.00000000000 FORMAT "%13.11" /end CHARACTERISTIC
/begin CHARACTERISTIC DDRC_RatDeb.VehV_tiSigCanSafeUDRat_C "Ratioof up-down debouncing / Defect / Heal Ratio for check DFC_VehVSigCanSafe" VALUE 0x804EE624 Val_Wu8 3.00000000000 DDRC_Ratio 1.00000000000 4.00000000000 FORMAT "%13.11" /end CHARACTERISTIC
/begin CHARACTERISTIC DDRC_RatDeb.VlvLft_tiSRCMaxOilPSnsrIntk11UDRat_C "Ratioof up-down debouncing / Defect / Heal Ratio for check DFC_VlvLftFbOilPSnsrIntk11SRCMax" VALUE 0x804EE625 Val_Wu8 3.00000000000 DDRC_Ratio 1.00000000000 4.00000000000 FORMAT "%13.11" /end CHARACTERISTIC
/begin CHARACTERISTIC DDRC_RatDeb.VlvLft_tiSRCMinOilPSnsrIntk11UDRat_C "Ratioof up-down debouncing / Defect / Heal Ratio for check DFC_VlvLftFbOilPSnsrIntk11SRCMin" VALUE 0x804EE626 Val_Wu8 3.00000000000 DDRC_Ratio 1.00000000000 4.00000000000 FORMAT "%13.11" /end CHARACTERISTIC
/begin CHARACTERISTIC DDRC_RatDeb.Clth_numPlaUDRat_C "Ratioof up-down debouncing / Defect / Heal Ratio for check DFC_ClthNpl" VALUE 0x804EE627 Val_Wu8 3.00000000000 DDRC_Ratio 1.00000000000 4.00000000000 FORMAT "%13.11" /end CHARACTERISTIC
/begin CHARACTERISTIC DDRC_RatDeb.Gbx_numPNPosnDrvCdnUDRat_C "Ratioof up-down debouncing / Defect / Heal Ratio for check DFC_GbxPNPosnDrvCdn" VALUE 0x804EE628 Val_Wu8 3.00000000000 DDRC_Ratio 1.00000000000 4.00000000000 FORMAT "%13.11" /end CHARACTERISTIC
/begin CHARACTERISTIC DDRC_RatDeb.Gbx_numPNPosnPlausyUDRat_C "Ratioof up-down debouncing / Defect / Heal Ratio for check DFC_GbxPNPosnPlausy" VALUE 0x804EE629 Val_Wu8 3.00000000000 DDRC_Ratio 1.00000000000 4.00000000000 FORMAT "%13.11" /end CHARACTERISTIC
/begin CHARACTERISTIC DDRC_RatDeb.InjVvG_numOLUDRat_C "Ratioof up-down debouncing / Defect / Heal Ratio for check DFC_EV4sig" VALUE 0x804EE62A Val_Wu8 3.00000000000 DDRC_Ratio 1.00000000000 4.00000000000 FORMAT "%13.11" /end CHARACTERISTIC
/begin CHARACTERISTIC DDRC_RatDeb.InjVvG_numSCBUDRat_C "Ratioof up-down debouncing / Defect / Heal Ratio for check DFC_EV4max" VALUE 0x804EE62B Val_Wu8 3.00000000000 DDRC_Ratio 1.00000000000 4.00000000000 FORMAT "%13.11" /end CHARACTERISTIC
/begin CHARACTERISTIC DDRC_RatDeb.InjVvG_numSCGUDRat_C "Ratioof up-down debouncing / Defect / Heal Ratio for check DFC_EV4min" VALUE 0x804EE62C Val_Wu8 3.00000000000 DDRC_Ratio 1.00000000000 4.00000000000 FORMAT "%13.11" /end CHARACTERISTIC
/begin CHARACTERISTIC DevLib_DigOutDbgSig_C "Calibration parameter to select the Digital out signal for which the debugging information is to be updated into the measuring points" VALUE 0x8053AD24 Val_Wu16 65535.00 OneToOne 0.00 65535.00 FORMAT "%8.2" /end CHARACTERISTIC
/begin CHARACTERISTIC NDECJ "Engine speed threshold for power stage diagnosis" VALUE 0x8053A4BC KwWU8 10200. EngN_LRes 0.00 10200. FORMAT "%5.0" /end CHARACTERISTIC
/begin CHARACTERISTIC UBCJMN "Min. Ubat-threshold for release of the power stage diagnosis" VALUE 0x8053A4BE KwWU16 15000.00 Volt_Batt 0.00 15000.00 FORMAT "%8.2" EXTENDED_LIMITS 0.00 1310700. /end CHARACTERISTIC
/begin CHARACTERISTIC UBCJMX "Max. Ubat-threshold f. release of the BSP 752 R-power stage diagnosis" VALUE 0x8053A4C0 KwWU16 25500.00 Volt_Batt 0.00 25500.00 FORMAT "%8.2" EXTENDED_LIMITS 0.00 1310700. /end CHARACTERISTIC
/begin MEASUREMENT B_deseehr_msg "Diagnosis power stage after the main Relay: entry conditions fulfilled" UBYTE B_TRUE 1 100 0.00 1.00000000000 BIT_MASK 0x1 FORMAT "%13.11" ECU_ADDRESS 0x70000A9E /end MEASUREMENT
/begin MEASUREMENT B_desee_msg "Diagnosis power stages, entry conditions fulfilled" UBYTE B_TRUE 1 100 0.00 1.00000000000 BIT_MASK 0x1 FORMAT "%13.11" ECU_ADDRESS 0x70000A9F /end MEASUREMENT
/begin MEASUREMENT B_eev_msg "Injector fault (power stage)." UBYTE B_TRUE 1 100 0.00 1.00000000000 BIT_MASK 0x1 FORMAT "%13.11" ECU_ADDRESS 0x70000A84 /end MEASUREMENT
/begin MEASUREMENT B_PmdInit_msg "Reset of standard powerstage diagnosis required" UBYTE B_TRUE 1 100 0.00 1.00000000000 BIT_MASK 0x1 FORMAT "%13.11" ECU_ADDRESS 0x70000AC5 /end MEASUREMENT
/begin MEASUREMENT B_stBattuEna "Toggling of the signal indicating low voltage range" UBYTE B_TRUE 1 100 0.00 1.00000000000 BIT_MASK 0x1 FORMAT "%13.11" ECU_ADDRESS 0x70000AE2 /end MEASUREMENT
/begin MEASUREMENT DDRC_ctArDebLvl.DFC_BusDiagCANAPPLBusOff "Debouncing counters / Debounce Timer or Event counter for check DFC_BusDiagCANAPPLBusOff" SWORD DFC_OneToOne 1 100 -32768.00 32767.00 FORMAT "%8.2" ECU_ADDRESS 0x5000570C /end MEASUREMENT
/begin MEASUREMENT DDRC_ctArDebLvl.DFC_BusDiagCANCANCBusOff "Debouncing counters / Debounce Timer or Event counter for check DFC_BusDiagCANCANCBusOff" SWORD DFC_OneToOne 1 100 -32768.00 32767.00 FORMAT "%8.2" ECU_ADDRESS 0x5000570E /end MEASUREMENT
/begin MEASUREMENT DDRC_ctArDebLvl.DFC_BusDiagCANVEHICLEBusOff "Debouncing counters / Debounce Timer or Event counter for check DFC_BusDiagCANVEHICLEBusOff" SWORD DFC_OneToOne 1 100 -32768.00 32767.00 FORMAT "%8.2" ECU_ADDRESS 0x50005710 /end MEASUREMENT
/begin MEASUREMENT DDRC_ctArDebLvl.DFC_RBA_IODIAGPWR_rba_IoExtCy329_SignalVltSply_0 "Debouncing counters / Debounce Timer or Event counter for check DFC_RBA_IODIAGPWR_rba_IoExtCy329_SignalVltSply_0" SWORD DFC_OneToOne 1 100 -32768.00 32767.00 FORMAT "%8.2" ECU_ADDRESS 0x50005712 /end MEASUREMENT
/begin MEASUREMENT DDRC_ctArDebLvl.DFC_RBA_IODIAGPWR_rba_IoExtCy329_SignalVltSply_0OT "Debouncing counters / Debounce Timer or Event counter for check DFC_RBA_IODIAGPWR_rba_IoExtCy329_SignalVltSply_0OT" SWORD DFC_OneToOne 1 100 -32768.00 32767.00 FORMAT "%8.2" ECU_ADDRESS 0x50005714 /end MEASUREMENT
/begin MEASUREMENT DDRC_ctArDebLvl.DFC_RBA_IODIAGPWR_rba_IoExtCy329_SignalVltSply_0OV "Debouncing counters / Debounce Timer or Event counter for check DFC_RBA_IODIAGPWR_rba_IoExtCy329_SignalVltSply_0OV" SWORD DFC_OneToOne 1 100 -32768.00 32767.00 FORMAT "%8.2" ECU_ADDRESS 0x50005716 /end MEASUREMENT
/begin MEASUREMENT DDRC_ctArDebLvl.DFC_RBA_IODIAGPWR_rba_IoExtCy329_SignalVltSply_0SCG "Debouncing counters / Debounce Timer or Event counter for check DFC_RBA_IODIAGPWR_rba_IoExtCy329_SignalVltSply_0SCG" SWORD DFC_OneToOne 1 100 -32768.00 32767.00 FORMAT "%8.2" ECU_ADDRESS 0x50005718 /end MEASUREMENT
/begin MEASUREMENT DDRC_ctArDebLvl.DFC_RBA_IODIAGPWR_rba_IoExtCy329_SignalVltSply_0UV "Debouncing counters / Debounce Timer or Event counter for check DFC_RBA_IODIAGPWR_rba_IoExtCy329_SignalVltSply_0UV" SWORD DFC_OneToOne 1 100 -32768.00 32767.00 FORMAT "%8.2" ECU_ADDRESS 0x5000571A /end MEASUREMENT
/begin MEASUREMENT DDRC_ctArDebLvl.DFC_RBA_IODIAGPWR_rba_IoExtCy329_SignalVltSply_1 "Debouncing counters / Debounce Timer or Event counter for check DFC_RBA_IODIAGPWR_rba_IoExtCy329_SignalVltSply_1" SWORD DFC_OneToOne 1 100 -32768.00 32767.00 FORMAT "%8.2" ECU_ADDRESS 0x5000571C /end MEASUREMENT
/begin MEASUREMENT DDRC_ctArDebLvl.DFC_RBA_IODIAGPWR_rba_IoExtCy329_SignalVltSply_1OT "Debouncing counters / Debounce Timer or Event counter for check DFC_RBA_IODIAGPWR_rba_IoExtCy329_SignalVltSply_1OT" SWORD DFC_OneToOne 1 100 -32768.00 32767.00 FORMAT "%8.2" ECU_ADDRESS 0x5000571E /end MEASUREMENT
/begin MEASUREMENT DDRC_ctArDebLvl.DFC_RBA_IODIAGPWR_rba_IoExtCy329_SignalVltSply_1OV "Debouncing counters / Debounce Timer or Event counter for check DFC_RBA_IODIAGPWR_rba_IoExtCy329_SignalVltSply_1OV" SWORD DFC_OneToOne 1 100 -32768.00 32767.00 FORMAT "%8.2" ECU_ADDRESS 0x50005720 /end MEASUREMENT
/begin MEASUREMENT DDRC_ctArDebLvl.DFC_RBA_IODIAGPWR_rba_IoExtCy329_SignalVltSply_1SCG "Debouncing counters / Debounce Timer or Event counter for check DFC_RBA_IODIAGPWR_rba_IoExtCy329_SignalVltSply_1SCG" SWORD DFC_OneToOne 1 100 -32768.00 32767.00 FORMAT "%8.2" ECU_ADDRESS 0x50005722 /end MEASUREMENT
/begin MEASUREMENT DDRC_ctArDebLvl.DFC_RBA_IODIAGPWR_rba_IoExtCy329_SignalVltSply_1UV "Debouncing counters / Debounce Timer or Event counter for check DFC_RBA_IODIAGPWR_rba_IoExtCy329_SignalVltSply_1UV" SWORD DFC_OneToOne 1 100 -32768.00 32767.00 FORMAT "%8.2" ECU_ADDRESS 0x50005724 /end MEASUREMENT
/begin MEASUREMENT DDRC_ctArDebLvl.DFC_RBA_IODIAGPWR_rba_IoExtCy329_SignalVltSply_2 "Debouncing counters / Debounce Timer or Event counter for check DFC_RBA_IODIAGPWR_rba_IoExtCy329_SignalVltSply_2" SWORD DFC_OneToOne 1 100 -32768.00 32767.00 FORMAT "%8.2" ECU_ADDRESS 0x50005726 /end MEASUREMENT
/begin MEASUREMENT DDRC_ctArDebLvl.DFC_RBA_IODIAGPWR_rba_IoExtCy329_SignalVltSply_2OT "Debouncing counters / Debounce Timer or Event counter for check DFC_RBA_IODIAGPWR_rba_IoExtCy329_SignalVltSply_2OT" SWORD DFC_OneToOne 1 100 -32768.00 32767.00 FORMAT "%8.2" ECU_ADDRESS 0x50005728 /end MEASUREMENT
/begin MEASUREMENT DDRC_ctArDebLvl.DFC_RBA_IODIAGPWR_rba_IoExtCy329_SignalVltSply_2OV "Debouncing counters / Debounce Timer or Event counter for check DFC_RBA_IODIAGPWR_rba_IoExtCy329_SignalVltSply_2OV" SWORD DFC_OneToOne 1 100 -32768.00 32767.00 FORMAT "%8.2" ECU_ADDRESS 0x5000572A /end MEASUREMENT
/begin MEASUREMENT DDRC_ctArDebLvl.DFC_RBA_IODIAGPWR_rba_IoExtCy329_SignalVltSply_2SCG "Debouncing counters / Debounce Timer or Event counter for check DFC_RBA_IODIAGPWR_rba_IoExtCy329_SignalVltSply_2SCG" SWORD DFC_OneToOne 1 100 -32768.00 32767.00 FORMAT "%8.2" ECU_ADDRESS 0x5000572C /end MEASUREMENT
/begin MEASUREMENT DDRC_ctArDebLvl.DFC_RBA_IODIAGPWR_rba_IoExtCy329_SignalVltSply_2UV "Debouncing counters / Debounce Timer or Event counter for check DFC_RBA_IODIAGPWR_rba_IoExtCy329_SignalVltSply_2UV" SWORD DFC_OneToOne 1 100 -32768.00 32767.00 FORMAT "%8.2" ECU_ADDRESS 0x5000572E /end MEASUREMENT
/begin MEASUREMENT DDRC_ctArDebLvl.DFC_CAN_E_TIMEOUT "Debouncing counters / Debounce Timer or Event counter for check DFC_CAN_E_TIMEOUT" SWORD DFC_OneToOne 1 100 -32768.00 32767.00 FORMAT "%8.2" ECU_ADDRESS 0x50005730 /end MEASUREMENT
/begin MEASUREMENT DDRC_ctArDebLvl.DFC_LIN_E_TIMEOUT "Debouncing counters / Debounce Timer or Event counter for check DFC_LIN_E_TIMEOUT" SWORD DFC_OneToOne 1 100 -32768.00 32767.00 FORMAT "%8.2" ECU_ADDRESS 0x50005732 /end MEASUREMENT
/begin MEASUREMENT DDRC_ctArDebLvl.DFC_MRlyOL "Debouncing counters / Debounce Timer or Event counter for check DFC_MRlyOL" SWORD DFC_OneToOne 1 100 -32768.00 32767.00 FORMAT "%8.2" ECU_ADDRESS 0x50005734 /end MEASUREMENT
/begin MEASUREMENT DDRC_ctArDebLvl.DFC_MRlySCB "Debouncing counters / Debounce Timer or Event counter for check DFC_MRlySCB" SWORD DFC_OneToOne 1 100 -32768.00 32767.00 FORMAT "%8.2" ECU_ADDRESS 0x50005736 /end MEASUREMENT
/begin MEASUREMENT DDRC_ctArDebLvl.DFC_MRlySCG "Debouncing counters / Debounce Timer or Event counter for check DFC_MRlySCG" SWORD DFC_OneToOne 1 100 -32768.00 32767.00 FORMAT "%8.2" ECU_ADDRESS 0x50005738 /end MEASUREMENT
/begin MEASUREMENT DDRC_ctArDebLvl.DFC_rba_MultiStackTrace_Threshold "Debouncing counters / Debounce Timer or Event counter for check DFC_rba_MultiStackTrace_Threshold" SWORD DFC_OneToOne 1 100 -32768.00 32767.00 FORMAT "%8.2" ECU_ADDRESS 0x5000573A /end MEASUREMENT
/begin MEASUREMENT DDRC_stLstRprtEve.DFC_BusDiagCANAPPLBusOff "Monitoring state / Monitoring state of DFC_BusDiagCANAPPLBusOff" UBYTE DDRC_LstRprtEve_VERB 1 100 0.00 255.000000000 FORMAT "%13.9" ECU_ADDRESS 0x6000B17D /end MEASUREMENT
/begin MEASUREMENT DDRC_stLstRprtEve.DFC_BusDiagCANCANCBusOff "Monitoring state / Monitoring state of DFC_BusDiagCANCANCBusOff" UBYTE DDRC_LstRprtEve_VERB 1 100 0.00 255.000000000 FORMAT "%13.9" ECU_ADDRESS 0x6000B17E /end MEASUREMENT
/begin MEASUREMENT DDRC_stLstRprtEve.DFC_BusDiagCANVEHICLEBusOff "Monitoring state / Monitoring state of DFC_BusDiagCANVEHICLEBusOff" UBYTE DDRC_LstRprtEve_VERB 1 100 0.00 255.000000000 FORMAT "%13.9" ECU_ADDRESS 0x6000B17F /end MEASUREMENT
/begin MEASUREMENT DDRC_stLstRprtEve.DFC_RBA_IODIAGPWR_rba_IoExtCy329_SignalVltSply_0 "Monitoring state / Monitoring state of DFC_RBA_IODIAGPWR_rba_IoExtCy329_SignalVltSply_0" UBYTE DDRC_LstRprtEve_VERB 1 100 0.00 255.000000000 FORMAT "%13.9" ECU_ADDRESS 0x6000B180 /end MEASUREMENT
/begin MEASUREMENT DDRC_stLstRprtEve.DFC_RBA_IODIAGPWR_rba_IoExtCy329_SignalVltSply_0OT "Monitoring state / Monitoring state of DFC_RBA_IODIAGPWR_rba_IoExtCy329_SignalVltSply_0OT" UBYTE DDRC_LstRprtEve_VERB 1 100 0.00 255.000000000 FORMAT "%13.9" ECU_ADDRESS 0x6000B181 /end MEASUREMENT
/begin MEASUREMENT DDRC_stLstRprtEve.DFC_RBA_IODIAGPWR_rba_IoExtCy329_SignalVltSply_0OV "Monitoring state / Monitoring state of DFC_RBA_IODIAGPWR_rba_IoExtCy329_SignalVltSply_0OV" UBYTE DDRC_LstRprtEve_VERB 1 100 0.00 255.000000000 FORMAT "%13.9" ECU_ADDRESS 0x6000B182 /end MEASUREMENT
/begin MEASUREMENT DDRC_stLstRprtEve.DFC_RBA_IODIAGPWR_rba_IoExtCy329_SignalVltSply_0SCG "Monitoring state / Monitoring state of DFC_RBA_IODIAGPWR_rba_IoExtCy329_SignalVltSply_0SCG" UBYTE DDRC_LstRprtEve_VERB 1 100 0.00 255.000000000 FORMAT "%13.9" ECU_ADDRESS 0x6000B183 /end MEASUREMENT
/begin MEASUREMENT DDRC_stLstRprtEve.DFC_RBA_IODIAGPWR_rba_IoExtCy329_SignalVltSply_0UV "Monitoring state / Monitoring state of DFC_RBA_IODIAGPWR_rba_IoExtCy329_SignalVltSply_0UV" UBYTE DDRC_LstRprtEve_VERB 1 100 0.00 255.000000000 FORMAT "%13.9" ECU_ADDRESS 0x6000B184 /end MEASUREMENT
/begin MEASUREMENT DDRC_stLstRprtEve.DFC_RBA_IODIAGPWR_rba_IoExtCy329_SignalVltSply_1 "Monitoring state / Monitoring state of DFC_RBA_IODIAGPWR_rba_IoExtCy329_SignalVltSply_1" UBYTE DDRC_LstRprtEve_VERB 1 100 0.00 255.000000000 FORMAT "%13.9" ECU_ADDRESS 0x6000B185 /end MEASUREMENT
/begin MEASUREMENT DDRC_stLstRprtEve.DFC_RBA_IODIAGPWR_rba_IoExtCy329_SignalVltSply_1OT "Monitoring state / Monitoring state of DFC_RBA_IODIAGPWR_rba_IoExtCy329_SignalVltSply_1OT" UBYTE DDRC_LstRprtEve_VERB 1 100 0.00 255.000000000 FORMAT "%13.9" ECU_ADDRESS 0x6000B186 /end MEASUREMENT
/begin MEASUREMENT DDRC_stLstRprtEve.DFC_RBA_IODIAGPWR_rba_IoExtCy329_SignalVltSply_1OV "Monitoring state / Monitoring state of DFC_RBA_IODIAGPWR_rba_IoExtCy329_SignalVltSply_1OV" UBYTE DDRC_LstRprtEve_VERB 1 100 0.00 255.000000000 FORMAT "%13.9" ECU_ADDRESS 0x6000B187 /end MEASUREMENT
/begin MEASUREMENT DDRC_stLstRprtEve.DFC_RBA_IODIAGPWR_rba_IoExtCy329_SignalVltSply_1SCG "Monitoring state / Monitoring state of DFC_RBA_IODIAGPWR_rba_IoExtCy329_SignalVltSply_1SCG" UBYTE DDRC_LstRprtEve_VERB 1 100 0.00 255.000000000 FORMAT "%13.9" ECU_ADDRESS 0x6000B188 /end MEASUREMENT
/begin MEASUREMENT DDRC_stLstRprtEve.DFC_RBA_IODIAGPWR_rba_IoExtCy329_SignalVltSply_1UV "Monitoring state / Monitoring state of DFC_RBA_IODIAGPWR_rba_IoExtCy329_SignalVltSply_1UV" UBYTE DDRC_LstRprtEve_VERB 1 100 0.00 255.000000000 FORMAT "%13.9" ECU_ADDRESS 0x6000B189 /end MEASUREMENT
/begin MEASUREMENT DDRC_stLstRprtEve.DFC_RBA_IODIAGPWR_rba_IoExtCy329_SignalVltSply_2 "Monitoring state / Monitoring state of DFC_RBA_IODIAGPWR_rba_IoExtCy329_SignalVltSply_2" UBYTE DDRC_LstRprtEve_VERB 1 100 0.00 255.000000000 FORMAT "%13.9" ECU_ADDRESS 0x6000B18A /end MEASUREMENT
/begin MEASUREMENT DDRC_stLstRprtEve.DFC_RBA_IODIAGPWR_rba_IoExtCy329_SignalVltSply_2OT "Monitoring state / Monitoring state of DFC_RBA_IODIAGPWR_rba_IoExtCy329_SignalVltSply_2OT" UBYTE DDRC_LstRprtEve_VERB 1 100 0.00 255.000000000 FORMAT "%13.9" ECU_ADDRESS 0x6000B18B /end MEASUREMENT
/begin MEASUREMENT DDRC_stLstRprtEve.DFC_RBA_IODIAGPWR_rba_IoExtCy329_SignalVltSply_2OV "Monitoring state / Monitoring state of DFC_RBA_IODIAGPWR_rba_IoExtCy329_SignalVltSply_2OV" UBYTE DDRC_LstRprtEve_VERB 1 100 0.00 255.000000000 FORMAT "%13.9" ECU_ADDRESS 0x6000B18C /end MEASUREMENT
/begin MEASUREMENT DDRC_stLstRprtEve.DFC_RBA_IODIAGPWR_rba_IoExtCy329_SignalVltSply_2SCG "Monitoring state / Monitoring state of DFC_RBA_IODIAGPWR_rba_IoExtCy329_SignalVltSply_2SCG" UBYTE DDRC_LstRprtEve_VERB 1 100 0.00 255.000000000 FORMAT "%13.9" ECU_ADDRESS 0x6000B18D /end MEASUREMENT
/begin MEASUREMENT DDRC_stLstRprtEve.DFC_RBA_IODIAGPWR_rba_IoExtCy329_SignalVltSply_2UV "Monitoring state / Monitoring state of DFC_RBA_IODIAGPWR_rba_IoExtCy329_SignalVltSply_2UV" UBYTE DDRC_LstRprtEve_VERB 1 100 0.00 255.000000000 FORMAT "%13.9" ECU_ADDRESS 0x6000B18E /end MEASUREMENT
/begin MEASUREMENT DDRC_stLstRprtEve.DFC_CAN_E_TIMEOUT "Monitoring state / Monitoring state of DFC_CAN_E_TIMEOUT" UBYTE DDRC_LstRprtEve_VERB 1 100 0.00 255.000000000 FORMAT "%13.9" ECU_ADDRESS 0x6000B18F /end MEASUREMENT
/begin MEASUREMENT DDRC_stLstRprtEve.DFC_LIN_E_TIMEOUT "Monitoring state / Monitoring state of DFC_LIN_E_TIMEOUT" UBYTE DDRC_LstRprtEve_VERB 1 100 0.00 255.000000000 FORMAT "%13.9" ECU_ADDRESS 0x6000B190 /end MEASUREMENT
/begin MEASUREMENT DDRC_stLstRprtEve.DFC_MRlyOL "Monitoring state / Monitoring state of DFC_MRlyOL" UBYTE DDRC_LstRprtEve_VERB 1 100 0.00 255.000000000 FORMAT "%13.9" ECU_ADDRESS 0x6000B191 /end MEASUREMENT
/begin MEASUREMENT DDRC_stLstRprtEve.DFC_MRlySCB "Monitoring state / Monitoring state of DFC_MRlySCB" UBYTE DDRC_LstRprtEve_VERB 1 100 0.00 255.000000000 FORMAT "%13.9" ECU_ADDRESS 0x6000B192 /end MEASUREMENT
/begin MEASUREMENT DDRC_stLstRprtEve.DFC_MRlySCG "Monitoring state / Monitoring state of DFC_MRlySCG" UBYTE DDRC_LstRprtEve_VERB 1 100 0.00 255.000000000 FORMAT "%13.9" ECU_ADDRESS 0x6000B193 /end MEASUREMENT
/begin MEASUREMENT DDRC_stLstRprtEve.DFC_rba_MultiStackTrace_Threshold "Monitoring state / Monitoring state of DFC_rba_MultiStackTrace_Threshold" UBYTE DDRC_LstRprtEve_VERB 1 100 0.00 255.000000000 FORMAT "%13.9" ECU_ADDRESS 0x6000B194 /end MEASUREMENT
/begin MEASUREMENT Dem_disableEventStatusUpdateGroup "Bit encoded DTCGroups disabled for EventStatusUpdate" UBYTE OneToOne 1 100 0.00 255.0 FORMAT "%5.1" ECU_ADDRESS 0x700057DF /end MEASUREMENT
/begin MEASUREMENT Dem_DTCFltForFltDetnCntr "Adapter to transform DSM interfaces to DEM interfaces" UBYTE OneToOne 1 100 0.00 255.0 FORMAT "%5.1" ARRAY_SIZE 2 ECU_ADDRESS 0x700057E2 /end MEASUREMENT
/begin MEASUREMENT Dem_DTCFltFormat "DTCFormat parameter of current Dem_SetDTCFilter() request" UBYTE OneToOne 1 100 0.00 255.0 FORMAT "%5.1" ARRAY_SIZE 2 ECU_ADDRESS 0x700057EA /end MEASUREMENT
/begin MEASUREMENT Dem_DTCFltOrigin "DTCOrigin parameter of current Dem_SetDTCFilter() request" UWORD OneToOne 1 100 0.00 65535.00 FORMAT "%8.2" ARRAY_SIZE 2 ECU_ADDRESS 0x700045EA /end MEASUREMENT
/begin MEASUREMENT Dem_DTCFltProcCnt "Number of DTCs found to current Dem_SetDTCFilter() request" UWORD OneToOne 1 100 0.00 65535.00 FORMAT "%8.2" ARRAY_SIZE 2 ECU_ADDRESS 0x700045F6 /end MEASUREMENT
/begin MEASUREMENT Dem_DTCFltProcIdx "Loop index for asynchron Dem_SetDTCFilter() processing" UWORD OneToOne 1 100 0.00 65535.00 FORMAT "%8.2" ARRAY_SIZE 2 ECU_ADDRESS 0x700045FA /end MEASUREMENT
/begin MEASUREMENT Dem_DTCFltRecFormat "DTCFormat parameter of current Dem_SetFreezeFrameRecordFilter() request" UBYTE OneToOne 1 100 0.00 255.0 FORMAT "%5.1" ARRAY_SIZE 2 ECU_ADDRESS 0x700057E4 /end MEASUREMENT
/begin MEASUREMENT Dem_DTCFltRecRsltIdx "Index variable for incremental GetNextFilteredRecord output" UWORD OneToOne 1 100 0.00 65535.00 FORMAT "%8.2" ARRAY_SIZE 2 ECU_ADDRESS 0x700045EE /end MEASUREMENT
/begin MEASUREMENT Dem_DTCFltRsltIdx "Index variable for incremental GetNextFilteredDTCxxx output" UWORD OneToOne 1 100 0.00 65535.00 FORMAT "%8.2" ARRAY_SIZE 2 ECU_ADDRESS 0x700045F2 /end MEASUREMENT
/begin MEASUREMENT Dem_DTCFltSeverity "DTCSeverity parameter of current Dem_SetDTCFilter() request" UBYTE OneToOne 1 100 0.00 255.0 FORMAT "%5.1" ARRAY_SIZE 2 ECU_ADDRESS 0x700057E6 /end MEASUREMENT
/begin MEASUREMENT Dem_DTCFltSt "Current state of Dem_SetDTCFilter() processing" UBYTE Dem_DTCFltSt_Verb 1 100 0.00 5.00000000000 FORMAT "%13.11" ARRAY_SIZE 2 ECU_ADDRESS 0x700057E0 /end MEASUREMENT
/begin MEASUREMENT Dem_DTCFltStatusMask "DTCStatusMask parameter of current Dem_SetDTCFilter() request" UBYTE OneToOne 1 100 0.00 255.0 FORMAT "%5.1" ARRAY_SIZE 2 ECU_ADDRESS 0x700057EC /end MEASUREMENT
/begin MEASUREMENT Dem_DTCFltWithSev "Adapter to transform DSM interfaces to DEM interfaces" UBYTE OneToOne 1 100 0.00 255.0 FORMAT "%5.1" ARRAY_SIZE 2 ECU_ADDRESS 0x700057E8 /end MEASUREMENT
/begin MEASUREMENT deve_DiagInfo "deve-diagnosis info" ULONG dez 1 100 0.00 4294967295.00 FORMAT "%13.2" ARRAY_SIZE 4 ECU_ADDRESS 0x500004A8 /end MEASUREMENT
/begin MEASUREMENT deve_PSDiagInfo "Powerstage Diag information" ULONG dez 1 100 0.00 4294967295.00 FORMAT "%13.2" ARRAY_SIZE 4 ECU_ADDRESS 0x500004B8 /end MEASUREMENT
/begin MEASUREMENT DevLib_stDigOutErr_mp "Measuring point that contains the error information received from HWE for the digital out signal selected by DevLib_DigOutDbgSig_C" ULONG OneToOne 1 100 0.00 4294967295.00 FORMAT "%13.2" ECU_ADDRESS 0x700087BC /end MEASUREMENT
/begin MEASUREMENT eevbz "Error in Power stage injection valve" UBYTE dez 1 100 0.00 255.0 FORMAT "%5.1" ECU_ADDRESS 0x6000B4B7 /end MEASUREMENT
/begin MEASUREMENT eevbz_msg "Error in Power stage injection valve" UBYTE dez 1 100 0.00 255.0 FORMAT "%5.1" ECU_ADDRESS 0x6000A2A2 /end MEASUREMENT
/begin MEASUREMENT eevd_bz_ng "." UBYTE dez 1 100 0.00 255.0 FORMAT "%5.1" ECU_ADDRESS 0x6000B4B8 /end MEASUREMENT
/begin MEASUREMENT eevd_msg "Injection valve Errorbyte from DEVE 6.70.1" UBYTE dez 1 100 0.00 255.0 FORMAT "%5.1" ECU_ADDRESS 0x6000A2A1 /end MEASUREMENT
/begin FUNCTION DDRC "30000.21.1Diagnostic Debounce and Report of Check"
 /begin DEF_CHARACTERISTIC DDRC_DurDeb.BrkBstP_tiSnsrStuckDebDef_C DDRC_DurDeb.Brk_tiMnSwtContOnDebOk_C DDRC_DurDeb.Brk_tiMnSwtContOnDebDef_C DDRC_DurDeb.Brk_tiMnSwtNotStpDebOk_C DDRC_DurDeb.Brk_tiMnSwtNotStpDebDef_C DDRC_DurDeb.Brk_tiPlaDebOk_C DDRC_DurDeb.Brk_tiPlaDebDef_C DDRC_DurDeb.Brk_tiRdntSwtContOnDebOk_C DDRC_DurDeb.Brk_tiRdntSwtContOnDebDef_C DDRC_DurDeb.Brk_tiRdntSwtNotStpDebOk_C DDRC_DurDeb.Brk_tiRdntSwtNotStpDebDef_C DDRC_DurDeb.Clth_tiClth3ONStuckDebOk_C DDRC_DurDeb.Clth_tiClth3ONStuckDebDef_C DDRC_DurDeb.Clth_tiClth4OFFStuckDebOk_C DDRC_DurDeb.Clth_tiClth4OFFStuckDebDef_C DDRC_DurDeb.Clth_tiClthOFFStuckDebOk_C DDRC_DurDeb.Clth_tiClthOFFStuckDebDef_C DDRC_DurDeb.Clth_tiClthONStuckDebOk_C DDRC_DurDeb.Clth_tiClthONStuckDebDef_C DDRC_DurDeb.Clth_tiClthStkFailInfoDebOk_C DDRC_DurDeb.Clth_tiClthStkFailInfoDebDef_C DDRC_DurDeb.Com_tiACFailInfoDebOk_C DDRC_DurDeb.Com_tiACFailInfoDebDef_C DDRC_DurDeb.Com_tiATFTValErrDebOk_C DDRC_DurDeb.Com_tiATFTValErrDebDef_C DDRC_DurDeb.Com_tiATMILReqDebOk_C DDRC_DurDeb.Com_tiATMILReqDebDef_C DDRC_DurDeb.Com_tiAYCAChksumDebOk_C DDRC_DurDeb.Com_tiAYCAChksumDebDef_C DDRC_DurDeb.Com_tiAYCARingCntDebOk_C DDRC_DurDeb.Com_tiAYCARingCntDebDef_C DDRC_DurDeb.Com_tiAYCATOutDebOk_C DDRC_DurDeb.Com_tiAYCATOutDebDef_C DDRC_DurDeb.Com_tiAYCDChkSumDebOk_C DDRC_DurDeb.Com_tiAYCDChkSumDebDef_C DDRC_DurDeb.Com_tiAYCDTOutDebOk_C DDRC_DurDeb.Com_tiAYCDTOutDebDef_C DDRC_DurDeb.Com_tiAYCFChksumDebOk_C DDRC_DurDeb.Com_tiAYCFChksumDebDef_C DDRC_DurDeb.Com_tiAYCFRingCntDebOk_C DDRC_DurDeb.Com_tiAYCFRingCntDebDef_C DDRC_DurDeb.Com_tiAYCFTOutDebOk_C DDRC_DurDeb.Com_tiAYCFTOutDebDef_C DDRC_DurDeb.Com_tiAYCGChksumDebOk_C DDRC_DurDeb.Com_tiAYCGChksumDebDef_C DDRC_DurDeb.Com_tiAYCGRingCntDebOk_C DDRC_DurDeb.Com_tiAYCGRingCntDebDef_C DDRC_DurDeb.Com_tiAYCGTOutDebOk_C DDRC_DurDeb.Com_tiAYCGTOutDebDef_C DDRC_DurDeb.Com_tiAYCIChkSumDebOk_C DDRC_DurDeb.Com_tiAYCIChkSumDebDef_C DDRC_DurDeb.Com_tiAYCIRingCntDebOk_C DDRC_DurDeb.Com_tiAYCIRingCntDebDef_C DDRC_DurDeb.Com_tiAYCITOutDebOk_C DDRC_DurDeb.Com_tiAYCITOutDebDef_C DDRC_DurDeb.Com_tiBCM1ChkSumDebOk_C DDRC_DurDeb.Com_tiBCM1ChkSumDebDef_C DDRC_DurDeb.Com_tiBCM1RingCntDebOk_C DDRC_DurDeb.Com_tiBCM1RingCntDebDef_C DDRC_DurDeb.Com_tiBCM1TOutDebOk_C DDRC_DurDeb.Com_tiBCM1TOutDebDef_C DDRC_DurDeb.Com_tiCANABusOffErrDebOk_C DDRC_DurDeb.Com_tiCANABusOffErrDebDef_C DDRC_DurDeb.Com_tiCANBBusOffErrDebOk_C DDRC_DurDeb.Com_tiCANBBusOffErrDebDef_C DDRC_DurDeb.Com_tiCANCBusOffErrDebOk_C DDRC_DurDeb.Com_tiCANCBusOffErrDebDef_C DDRC_DurDeb.Com_tiCGW1ChkSumDebOk_C DDRC_DurDeb.Com_tiCGW1ChkSumDebDef_C DDRC_DurDeb.Com_tiCGW1TOutDebOk_C DDRC_DurDeb.Com_tiCGW1TOutDebDef_C DDRC_DurDeb.Com_tiCGW1ctRingDebOk_C DDRC_DurDeb.Com_tiCGW1ctRingDebDef_C DDRC_DurDeb.Com_tiConvBoostErrDebOk_C DDRC_DurDeb.Com_tiConvBoostErrDebDef_C DDRC_DurDeb.Com_tiConvSlipErrDebOk_C DDRC_DurDeb.Com_tiConvSlipErrDebDef_C DDRC_DurDeb.Com_tiEAT10ChkSumDebOk_C DDRC_DurDeb.Com_tiEAT10ChkSumDebDef_C DDRC_DurDeb.Com_tiEAT10RingCntDebOk_C DDRC_DurDeb.Com_tiEAT10RingCntDebDef_C DDRC_DurDeb.Com_tiEAT10TOutDebOk_C DDRC_DurDeb.Com_tiEAT10TOutDebDef_C DDRC_DurDeb.Com_tiEAT11ChkSumDebOk_C DDRC_DurDeb.Com_tiEAT11ChkSumDebDef_C DDRC_DurDeb.Com_tiEAT11RingCntDebOk_C DDRC_DurDeb.Com_tiEAT11RingCntDebDef_C DDRC_DurDeb.Com_tiEAT11TOutDebOk_C DDRC_DurDeb.Com_tiEAT11TOutDebDef_C DDRC_DurDeb.Com_tiEAT12ChkSumDebOk_C DDRC_DurDeb.Com_tiEAT12ChkSumDebDef_C DDRC_DurDeb.Com_tiEAT12RingCntDebOk_C DDRC_DurDeb.Com_tiEAT12RingCntDebDef_C DDRC_DurDeb.Com_tiEAT12TOutDebOk_C DDRC_DurDeb.Com_tiEAT12TOutDebDef_C DDRC_DurDeb.Com_tiEAT13ChkSumDebOk_C DDRC_DurDeb.Com_tiEAT13ChkSumDebDef_C DDRC_DurDeb.Com_tiEAT13RingCntDebOk_C DDRC_DurDeb.Com_tiEAT13RingCntDebDef_C DDRC_DurDeb.Com_tiEAT13TOutDebOk_C DDRC_DurDeb.Com_tiEAT13TOutDebDef_C DDRC_DurDeb.Com_tiEAT1ChksumDebOk_C DDRC_DurDeb.Com_tiEAT1ChksumDebDef_C DDRC_DurDeb.Com_tiEAT1RingCntDebOk_C DDRC_DurDeb.Com_tiEAT1RingCntDebDef_C DDRC_DurDeb.Com_tiEAT1TOutDebOk_C DDRC_DurDeb.Com_tiEAT1TOutDebDef_C DDRC_DurDeb.Com_tiEAT2ChksumDebOk_C DDRC_DurDeb.Com_tiEAT2ChksumDebDef_C DDRC_DurDeb.Com_tiEAT2RingCntDebOk_C DDRC_DurDeb.Com_tiEAT2RingCntDebDef_C DDRC_DurDeb.Com_tiEAT2TOutDebOk_C DDRC_DurDeb.Com_tiEAT2TOutDebDef_C DDRC_DurDeb.Com_tiEAT4ChksumDebOk_C DDRC_DurDeb.Com_tiEAT4ChksumDebDef_C DDRC_DurDeb.Com_tiEAT4RingCntDebOk_C DDRC_DurDeb.Com_tiEAT4RingCntDebDef_C DDRC_DurDeb.Com_tiEAT4TOutDebOk_C DDRC_DurDeb.Com_tiEAT4TOutDebDef_C DDRC_DurDeb.Com_tiEAT6ChkSumDebOk_C DDRC_DurDeb.Com_tiEAT6ChkSumDebDef_C DDRC_DurDeb.Com_tiEAT6RingCntDebOk_C DDRC_DurDeb.Com_tiEAT6RingCntDebDef_C DDRC_DurDeb.Com_tiEAT6TOutDebOk_C DDRC_DurDeb.Com_tiEAT6TOutDebDef_C DDRC_DurDeb.Com_tiEAT7ChkSumDebOk_C DDRC_DurDeb.Com_tiEAT7ChkSumDebDef_C DDRC_DurDeb.Com_tiEAT7RingCntDebOk_C DDRC_DurDeb.Com_tiEAT7RingCntDebDef_C DDRC_DurDeb.Com_tiEAT7TOutDebOk_C DDRC_DurDeb.Com_tiEAT7TOutDebDef_C DDRC_DurDeb.Com_tiEAT8ChkSumDebOk_C DDRC_DurDeb.Com_tiEAT8ChkSumDebDef_C DDRC_DurDeb.Com_tiEAT8RingCntDebOk_C DDRC_DurDeb.Com_tiEAT8RingCntDebDef_C DDRC_DurDeb.Com_tiEAT8TOutDebOk_C DDRC_DurDeb.Com_tiEAT8TOutDebDef_C DDRC_DurDeb.Com_tiEATAChkSumDebOk_C DDRC_DurDeb.Com_tiEATAChkSumDebDef_C DDRC_DurDeb.Com_tiEATARingCntDebOk_C DDRC_DurDeb.Com_tiEATARingCntDebDef_C DDRC_DurDeb.Com_tiEATATOutDebOk_C DDRC_DurDeb.Com_tiEATATOutDebDef_C DDRC_DurDeb.Com_tiEATBChksumDebOk_C DDRC_DurDeb.Com_tiEATBChksumDebDef_C DDRC_DurDeb.Com_tiEATBRingCntDebOk_C DDRC_DurDeb.Com_tiEATBRingCntDebDef_C DDRC_DurDeb.Com_tiEATBTOutDebOk_C DDRC_DurDeb.Com_tiEATBTOutDebDef_C DDRC_DurDeb.Com_tiEATCChkSumDebOk_C DDRC_DurDeb.Com_tiEATCChkSumDebDef_C DDRC_DurDeb.Com_tiEATCRingCntDebOk_C DDRC_DurDeb.Com_tiEATCRingCntDebDef_C DDRC_DurDeb.Com_tiEATCTOutDebOk_C DDRC_DurDeb.Com_tiEATCTOutDebDef_C DDRC_DurDeb.Com_tiEBBAChksumDebOk_C DDRC_DurDeb.Com_tiEBBAChksumDebDef_C DDRC_DurDeb.Com_tiEBBARingCntDebOk_C DDRC_DurDeb.Com_tiEBBARingCntDebDef_C DDRC_DurDeb.Com_tiEBBATOutDebOk_C DDRC_DurDeb.Com_tiEBBATOutDebDef_C DDRC_DurDeb.Com_tiEPS1ChksumDebOk_C DDRC_DurDeb.Com_tiEPS1ChksumDebDef_C DDRC_DurDeb.Com_tiEPS1RingCntDebOk_C DDRC_DurDeb.Com_tiEPS1RingCntDebDef_C DDRC_DurDeb.Com_tiEPS1TOutDebOk_C DDRC_DurDeb.Com_tiEPS1TOutDebDef_C DDRC_DurDeb.Com_tiEngCanRxErrDebOk_C DDRC_DurDeb.Com_tiEngCanRxErrDebDef_C DDRC_DurDeb.Com_tiGrvySnsrErrDebOk_C DDRC_DurDeb.Com_tiGrvySnsrErrDebDef_C DDRC_DurDeb.Com_tiGwIMG1ChkSumDebOk_C DDRC_DurDeb.Com_tiGwIMG1ChkSumDebDef_C DDRC_DurDeb.Com_tiGwIMG1RingCntDebOk_C DDRC_DurDeb.Com_tiGwIMG1RingCntDebDef_C DDRC_DurDeb.Com_tiGwIMG1TOutDebOk_C DDRC_DurDeb.Com_tiGwIMG1TOutDebDef_C DDRC_DurDeb.Com_tiGwIMG3ChkSumDebOk_C DDRC_DurDeb.Com_tiGwIMG3ChkSumDebDef_C DDRC_DurDeb.Com_tiGwIMG3RingCntDebOk_C DDRC_DurDeb.Com_tiGwIMG3RingCntDebDef_C DDRC_DurDeb.Com_tiGwIMG3TOutDebOk_C DDRC_DurDeb.Com_tiGwIMG3TOutDebDef_C DDRC_DurDeb.Com_tiGwIMG4ChkSumDebOk_C DDRC_DurDeb.Com_tiGwIMG4ChkSumDebDef_C DDRC_DurDeb.Com_tiGwIMG4RingCntDebOk_C DDRC_DurDeb.Com_tiGwIMG4RingCntDebDef_C DDRC_DurDeb.Com_tiGwIMG4TOutDebOk_C DDRC_DurDeb.Com_tiGwIMG4TOutDebDef_C DDRC_DurDeb.Com_tiGwIMG5ChkSumDebOk_C DDRC_DurDeb.Com_tiGwIMG5ChkSumDebDef_C DDRC_DurDeb.Com_tiGwIMG5RingCntDebOk_C DDRC_DurDeb.Com_tiGwIMG5RingCntDebDef_C DDRC_DurDeb.Com_tiGwIMG5TOutDebOk_C DDRC_DurDeb.Com_tiGwIMG5TOutDebDef_C DDRC_DurDeb.Com_tiGwIMG6ChkSumDebOk_C DDRC_DurDeb.Com_tiGwIMG6ChkSumDebDef_C DDRC_DurDeb.Com_tiGwIMG6RingCntDebOk_C DDRC_DurDeb.Com_tiGwIMG6RingCntDebDef_C DDRC_DurDeb.Com_tiGwIMG6TOutDebOk_C DDRC_DurDeb.Com_tiGwIMG6TOutDebDef_C DDRC_DurDeb.Com_tiIDASBChkSumDebOk_C DDRC_DurDeb.Com_tiIDASBChkSumDebDef_C DDRC_DurDeb.Com_tiIDASBRingCntDebOk_C DDRC_DurDeb.Com_tiIDASBRingCntDebDef_C DDRC_DurDeb.Com_tiIDASBTOutDebOk_C DDRC_DurDeb.Com_tiIDASBTOutDebDef_C DDRC_DurDeb.Com_tiIMGMILReqDebOk_C DDRC_DurDeb.Com_tiIMGMILReqDebDef_C DDRC_DurDeb.Com_tiISSPrmsDebOk_C DDRC_DurDeb.Com_tiISSPrmsDebDef_C DDRC_DurDeb.Com_tiMETACSumDebOk_C DDRC_DurDeb.Com_tiMETACSumDebDef_C DDRC_DurDeb.Com_tiMETActRingDebOk_C DDRC_DurDeb.Com_tiMETActRingDebDef_C DDRC_DurDeb.Com_tiMETAtiDebDebOk_C DDRC_DurDeb.Com_tiMETAtiDebDebDef_C DDRC_DurDeb.Com_tiMETCCSumDebOk_C DDRC_DurDeb.Com_tiMETCCSumDebDef_C DDRC_DurDeb.Com_tiMETCctRingDebOk_C DDRC_DurDeb.Com_tiMETCctRingDebDef_C DDRC_DurDeb.Com_tiMETCtiDebDebOk_C DDRC_DurDeb.Com_tiMETCtiDebDebDef_C DDRC_DurDeb.Com_tiMETDCSumDebOk_C DDRC_DurDeb.Com_tiMETDCSumDebDef_C DDRC_DurDeb.Com_tiMETDctRingDebOk_C DDRC_DurDeb.Com_tiMETDctRingDebDef_C DDRC_DurDeb.Com_tiMETDtiDebDebOk_C DDRC_DurDeb.Com_tiMETDtiDebDebDef_C DDRC_DurDeb.Com_tiMETE2CSumDebOk_C DDRC_DurDeb.Com_tiMETE2CSumDebDef_C DDRC_DurDeb.Com_tiMETE2ctRingDebOk_C DDRC_DurDeb.Com_tiMETE2ctRingDebDef_C DDRC_DurDeb.Com_tiMETE2tiDebDebOk_C DDRC_DurDeb.Com_tiMETE2tiDebDebDef_C DDRC_DurDeb.Com_tiMETFChksumDebOk_C DDRC_DurDeb.Com_tiMETFChksumDebDef_C DDRC_DurDeb.Com_tiMETFRingCntDebOk_C DDRC_DurDeb.Com_tiMETFRingCntDebDef_C DDRC_DurDeb.Com_tiMETFTOutDebOk_C DDRC_DurDeb.Com_tiMETFTOutDebDef_C DDRC_DurDeb.Com_tiMETGCSumDebOk_C DDRC_DurDeb.Com_tiMETGCSumDebDef_C DDRC_DurDeb.Com_tiMETGctRingDebOk_C DDRC_DurDeb.Com_tiMETGctRingDebDef_C DDRC_DurDeb.Com_tiMETGtiDebDebOk_C DDRC_DurDeb.Com_tiMETGtiDebDebDef_C DDRC_DurDeb.Com_tiMETH2CSumDebOk_C DDRC_DurDeb.Com_tiMETH2CSumDebDef_C DDRC_DurDeb.Com_tiMETH2ctRingDebOk_C DDRC_DurDeb.Com_tiMETH2ctRingDebDef_C DDRC_DurDeb.Com_tiMETH2tiDebDebOk_C DDRC_DurDeb.Com_tiMETH2tiDebDebDef_C DDRC_DurDeb.Com_tiMETHCSumDebOk_C DDRC_DurDeb.Com_tiMETHCSumDebDef_C DDRC_DurDeb.Com_tiMETHctRingDebOk_C DDRC_DurDeb.Com_tiMETHctRingDebDef_C DDRC_DurDeb.Com_tiMETHtiDebDebOk_C DDRC_DurDeb.Com_tiMETHtiDebDebDef_C DDRC_DurDeb.Com_tiMETICSumDebOk_C DDRC_DurDeb.Com_tiMETICSumDebDef_C DDRC_DurDeb.Com_tiMETIctRingDebOk_C DDRC_DurDeb.Com_tiMETIctRingDebDef_C DDRC_DurDeb.Com_tiMETItiDebDebOk_C DDRC_DurDeb.Com_tiMETItiDebDebDef_C DDRC_DurDeb.Com_tiMETKCSumDebOk_C DDRC_DurDeb.Com_tiMETKCSumDebDef_C DDRC_DurDeb.Com_tiMETKctRingDebOk_C DDRC_DurDeb.Com_tiMETKctRingDebDef_C DDRC_DurDeb.Com_tiMETKtiDebDebOk_C DDRC_DurDeb.Com_tiMETKtiDebDebDef_C DDRC_DurDeb.Com_tiMETLCSumDebOk_C DDRC_DurDeb.Com_tiMETLCSumDebDef_C DDRC_DurDeb.Com_tiMETLRingCntrDebOk_C DDRC_DurDeb.Com_tiMETLRingCntrDebDef_C DDRC_DurDeb.Com_tiMETLToutDebOk_C DDRC_DurDeb.Com_tiMETLToutDebDef_C DDRC_DurDeb.Com_tiMETMCSumDebOk_C DDRC_DurDeb.Com_tiMETMCSumDebDef_C DDRC_DurDeb.Com_tiMETMRingCntrDebOk_C DDRC_DurDeb.Com_tiMETMRingCntrDebDef_C DDRC_DurDeb.Com_tiMETMToutDebOk_C DDRC_DurDeb.Com_tiMETMToutDebDef_C DDRC_DurDeb.Com_tiMETNCSumDebOk_C DDRC_DurDeb.Com_tiMETNCSumDebDef_C DDRC_DurDeb.Com_tiMETNRingCntrDebOk_C DDRC_DurDeb.Com_tiMETNRingCntrDebDef_C DDRC_DurDeb.Com_tiMETNToutDebOk_C DDRC_DurDeb.Com_tiMETNToutDebDef_C DDRC_DurDeb.Com_tiMtrComDebOk_C DDRC_DurDeb.Com_tiMtrComDebDef_C DDRC_DurDeb.Com_tiPCUChkSumDebOk_C DDRC_DurDeb.Com_tiPCUChkSumDebDef_C DDRC_DurDeb.Com_tiPCURingCntDebOk_C DDRC_DurDeb.Com_tiPCURingCntDebDef_C DDRC_DurDeb.Com_tiPCUTOutDebOk_C DDRC_DurDeb.Com_tiPCUTOutDebDef_C DDRC_DurDeb.Com_tiSRSACSumDebOk_C DDRC_DurDeb.Com_tiSRSACSumDebDef_C DDRC_DurDeb.Com_tiSRSARingCntDebOk_C DDRC_DurDeb.Com_tiSRSARingCntDebDef_C DDRC_DurDeb.Com_tiSRSATOutDebOk_C DDRC_DurDeb.Com_tiSRSATOutDebDef_C DDRC_DurDeb.Com_tiSRSBCSumDebOk_C DDRC_DurDeb.Com_tiSRSBCSumDebDef_C DDRC_DurDeb.Com_tiSRSBRingCntDebOk_C DDRC_DurDeb.Com_tiSRSBRingCntDebDef_C DDRC_DurDeb.Com_tiSRSBTOutDebOk_C DDRC_DurDeb.Com_tiSRSBTOutDebDef_C DDRC_DurDeb.Com_tiSRSCSumDebOk_C DDRC_DurDeb.Com_tiSRSCSumDebDef_C DDRC_DurDeb.Com_tiSRSErrDebOk_C DDRC_DurDeb.Com_tiSRSErrDebDef_C DDRC_DurDeb.Com_tiSRSRingCntDebOk_C DDRC_DurDeb.Com_tiSRSRingCntDebDef_C DDRC_DurDeb.Com_tiSRSTOutDebOk_C DDRC_DurDeb.Com_tiSRSTOutDebDef_C DDRC_DurDeb.Com_tiVehSpdPndFltTCUDebOk_C DDRC_DurDeb.Com_tiVehSpdPndFltTCUDebDef_C DDRC_DurDeb.CstrPurg_tiDebDebOk_C DDRC_DurDeb.CstrPurg_tiDebDebDef_C DDRC_DurDeb.Ebs_tiChartcCurrErrDebOk_C DDRC_DurDeb.Ebs_tiChartcCurrErrDebDef_C DDRC_DurDeb.Ebs_tiSelfDiagErrDebOk_C DDRC_DurDeb.Ebs_tiSelfDiagErrDebDef_C DDRC_DurDeb.GbxNPos_tiCANDigPlausDebOk_C DDRC_DurDeb.GbxNPos_tiCANDigPlausDebDef_C DDRC_DurDeb.GbxNPos_tiNPos1SRCMaxDebOk_C DDRC_DurDeb.GbxNPos_tiNPos1SRCMaxDebDef_C DDRC_DurDeb.GbxNPos_tiNPos1SRCMinDebOk_C DDRC_DurDeb.GbxNPos_tiNPos1SRCMinDebDef_C DDRC_DurDeb.GbxNPos_tiNPos2SRCMaxDebOk_C DDRC_DurDeb.GbxNPos_tiNPos2SRCMaxDebDef_C DDRC_DurDeb.GbxNPos_tiNPos2SRCMinDebOk_C DDRC_DurDeb.GbxNPos_tiNPos2SRCMinDebDef_C DDRC_DurDeb.GbxNPos_tiNPosAlvChkDebOk_C DDRC_DurDeb.GbxNPos_tiNPosAlvChkDebDef_C DDRC_DurDeb.GbxNPos_tiNPosSyncErrDebOk_C DDRC_DurDeb.GbxNPos_tiNPosSyncErrDebDef_C DDRC_DurDeb.HEGO_tiDebHtrPsErrDebOk_C DDRC_DurDeb.HEGO_tiDebHtrPsErrDebDef_C DDRC_DurDeb.LIN_tiCSErrACGDebOk_C DDRC_DurDeb.LIN_tiCSErrACGDebDef_C DDRC_DurDeb.LIN_tiCSErrEBSDebOk_C DDRC_DurDeb.LIN_tiCSErrEBSDebDef_C DDRC_DurDeb.LIN_tiHdrTimeoutErrACGDebOk_C DDRC_DurDeb.LIN_tiHdrTimeoutErrACGDebDef_C DDRC_DurDeb.LIN_tiHdrTimeoutErrEBSDebOk_C DDRC_DurDeb.LIN_tiHdrTimeoutErrEBSDebDef_C DDRC_DurDeb.LIN_tiMsgTimeoutErrACGDebOk_C DDRC_DurDeb.LIN_tiMsgTimeoutErrACGDebDef_C DDRC_DurDeb.LIN_tiMsgTimeoutErrEBSDebOk_C DDRC_DurDeb.LIN_tiMsgTimeoutErrEBSDebDef_C DDRC_DurDeb.LIN_tiNoStrtComErrDebOk_C DDRC_DurDeb.LIN_tiNoStrtComErrDebDef_C DDRC_DurDeb.MisfDet_tiVWhlOORDebOk_C DDRC_DurDeb.MisfDet_tiVWhlOORDebDef_C DDRC_DurDeb.MisfDet_tiVWhlRatyDebOk_C DDRC_DurDeb.MisfDet_tiVWhlRatyDebDef_C DDRC_DurDeb.MisfDet_tiVWhlStuckDebOk_C DDRC_DurDeb.MisfDet_tiVWhlStuckDebDef_C DDRC_DurDeb.MisfDet_tidVWhlPlausDebOk_C DDRC_DurDeb.MisfDet_tidVWhlPlausDebDef_C DDRC_DurDeb.PEnv_tiSigRngChkDebOk_C DDRC_DurDeb.PEnv_tiSigRngChkDebDef_C DDRC_DurDeb.Strt_tiCtOffPthDebOk_C DDRC_DurDeb.Strt_tiCtOffPthDebDef_C DDRC_DurDeb.Strt_tiCtlErrDebOk_C DDRC_DurDeb.Strt_tiCtlErrDebDef_C DDRC_DurDeb.Strt_tiFaultDebOk_C DDRC_DurDeb.Strt_tiFaultDebDef_C DDRC_DurDeb.Strt_tiStkRly1DebOk_C DDRC_DurDeb.Strt_tiStkRly1DebDef_C DDRC_DurDeb.Strt_tiStkRly2DebOk_C DDRC_DurDeb.Strt_tiStkRly2DebDef_C DDRC_DurDeb.Strt_tiStmFaultDebOk_C DDRC_DurDeb.Strt_tiStmFaultDebDef_C DDRC_DurDeb.Strt_tiStrtLckJudg1DebOk_C DDRC_DurDeb.Strt_tiStrtLckJudg1DebDef_C DDRC_DurDeb.Strt_tiStrtLckJudg2DebOk_C DDRC_DurDeb.Strt_tiStrtLckJudg2DebDef_C DDRC_DurDeb.Strt_tiStrtOLDebOk_C DDRC_DurDeb.Strt_tiStrtOLDebDef_C DDRC_DurDeb.Strt_tiStrtOL2DebOk_C DDRC_DurDeb.Strt_tiStrtOL2DebDef_C DDRC_DurDeb.Strt_tiStrtSCBDebOk_C DDRC_DurDeb.Strt_tiStrtSCBDebDef_C DDRC_DurDeb.Strt_tiStrtSCB2DebOk_C DDRC_DurDeb.Strt_tiStrtSCB2DebDef_C DDRC_DurDeb.Strt_tiStrtSCGDebOk_C DDRC_DurDeb.Strt_tiStrtSCGDebDef_C DDRC_DurDeb.Strt_tiStrtSCG2DebOk_C DDRC_DurDeb.Strt_tiStrtSCG2DebDef_C DDRC_DurDeb.VehV_tiNCSnsrElecFailrDebOk_C DDRC_DurDeb.VehV_tiNCSnsrElecFailrDebDef_C DDRC_DurDeb.VehV_tiPlaAllDebOk_C DDRC_DurDeb.VehV_tiPlaAllDebDef_C DDRC_DurDeb.VehV_tiPlaCanDebOk_C DDRC_DurDeb.VehV_tiPlaCanDebDef_C DDRC_DurDeb.VehV_tiPlaFcoDebOk_C DDRC_DurDeb.VehV_tiPlaFcoDebDef_C DDRC_DurDeb.VehV_tiPlaPwrDebOk_C DDRC_DurDeb.VehV_tiPlaPwrDebDef_C DDRC_DurDeb.VehV_tiPlaV2NDebOk_C DDRC_DurDeb.VehV_tiPlaV2NDebDef_C DDRC_DurDeb.VehV_tiSpdSnsrAElecFailrDebOk_C DDRC_DurDeb.VehV_tiSpdSnsrAElecFailrDebDef_C DDRC_DurDeb.VehV_tiSpdSnsrBElecFailrDebOk_C DDRC_DurDeb.VehV_tiSpdSnsrBElecFailrDebDef_C DDRC_DurDeb.Clth_tiMaxDebOk_C DDRC_DurDeb.Clth_tiMaxDebDef_C DDRC_DurDeb.IgnClPs_numDevComErrDebOk_C DDRC_DurDeb.IgnClPs_numDevComErrDebDef_C DDRC_DurDeb.IgnClPs_numOpenLoadDebOk_C DDRC_DurDeb.IgnClPs_numOpenLoadDebDef_C DDRC_DurDeb.IgnClPs_numShCirBattDebOk_C DDRC_DurDeb.IgnClPs_numShCirBattDebDef_C DDRC_DurDeb.IgnClPs_numShCirGndDebOk_C DDRC_DurDeb.IgnClPs_numShCirGndDebDef_C DDRC_DurDeb.UEGO_numASICDebOk_C DDRC_DurDeb.UEGO_numASICDebDef_C DDRC_DurDeb.UEGO_numDiagSnsrDebOk_C DDRC_DurDeb.UEGO_numDiagSnsrDebDef_C DDRC_DurDeb.UEGO_numOLDebOk_C DDRC_DurDeb.UEGO_numOLDebDef_C DDRC_DurDeb.UEGO_numSCBDebOk_C DDRC_DurDeb.UEGO_numSCBDebDef_C DDRC_DurDeb.UEGO_numSCGDebOk_C DDRC_DurDeb.UEGO_numSCGDebDef_C DDRC_DurDeb.UEGO_numSPIDebOk_C DDRC_DurDeb.UEGO_numSPIDebDef_C DDRC_DurDeb.PEnv_tiVDDiagDebOk_C DDRC_DurDeb.PEnv_tiVDDiagDebDef_C DDRC_DurDeb.UEGO_HeatrRlyPsDiag_tiOLDebOk_C DDRC_DurDeb.UEGO_HeatrRlyPsDiag_tiOLDebDef_C DDRC_DurDeb.UEGO_HeatrRlyPsDiag_tiSCBDebOk_C DDRC_DurDeb.UEGO_HeatrRlyPsDiag_tiSCBDebDef_C DDRC_DurDeb.UEGO_HeatrRlyPsDiag_tiSCGDebOk_C DDRC_DurDeb.UEGO_HeatrRlyPsDiag_tiSCGDebDef_C DDRC_DurDeb.UEGO_HtrPSDia_tiOLDebOk_C DDRC_DurDeb.UEGO_HtrPSDia_tiOLDebDef_C DDRC_DurDeb.UEGO_HtrPSDia_tiSCBDebOk_C DDRC_DurDeb.UEGO_HtrPSDia_tiSCBDebDef_C DDRC_DurDeb.UEGO_HtrPSDia_tiSCGDebOk_C DDRC_DurDeb.UEGO_HtrPSDia_tiSCGDebDef_C DDRC_DurDeb.KnDet_numShCirDebOk_C DDRC_DurDeb.KnDet_numShCirDebDef_C DDRC_RatDeb.AirC_tiCmprOLUDRat_C DDRC_RatDeb.AirC_tiCmprOvrTempUDRat_C DDRC_RatDeb.AirC_tiCmprSCBUDRat_C DDRC_RatDeb.AirC_tiCmprSCGUDRat_C DDRC_RatDeb.Alt_tiErrUDRat_C DDRC_RatDeb.BattU_tiMaxUDRat_C DDRC_RatDeb.BattU_tiMinUDRat_C DDRC_RatDeb.Com_tiChksTCU1UDRat_C DDRC_RatDeb.Com_tiChksTCU11UDRat_C DDRC_RatDeb.Com_tiChksTCU12UDRat_C DDRC_RatDeb.Com_tiChksTCU13UDRat_C DDRC_RatDeb.Com_tiChksTCU2UDRat_C DDRC_RatDeb.Com_tiChksTCU3UDRat_C DDRC_RatDeb.Com_tiChksTCU4UDRat_C DDRC_RatDeb.Com_tiCntTCU1UDRat_C DDRC_RatDeb.Com_tiCntTCU11UDRat_C DDRC_RatDeb.Com_tiCntTCU12UDRat_C DDRC_RatDeb.Com_tiCntTCU13UDRat_C DDRC_RatDeb.Com_tiCntTCU2UDRat_C DDRC_RatDeb.Com_tiCntTCU3UDRat_C DDRC_RatDeb.Com_tiCntTCU4UDRat_C DDRC_RatDeb.Com_tiTOutTCU01UDRat_C DDRC_RatDeb.Com_tiTOutTCU02UDRat_C DDRC_RatDeb.Com_tiTOutTCU1UDRat_C DDRC_RatDeb.Com_tiTOutTCU11UDRat_C DDRC_RatDeb.Com_tiTOutTCU12UDRat_C DDRC_RatDeb.Com_tiTOutTCU13UDRat_C DDRC_RatDeb.Com_tiTOutTCU14UDRat_C DDRC_RatDeb.Com_tiTOutTCU2UDRat_C DDRC_RatDeb.Com_tiTOutTCU3UDRat_C DDRC_RatDeb.Com_tiTOutTCU4UDRat_C DDRC_RatDeb.DevLib_tiBattUHiUDRat_C DDRC_RatDeb.DevLib_tiBattULoUDRat_C DDRC_RatDeb.Fan_tiDIOOLUDRat_C DDRC_RatDeb.Fan_tiDIOOvrTempUDRat_C DDRC_RatDeb.Fan_tiDIOSCBUDRat_C DDRC_RatDeb.Fan_tiDIOSCGUDRat_C DDRC_RatDeb.MRlyDcOL_tisigOLUDRat_C DDRC_RatDeb.MRlyDcSCB_tisigSCBUDRat_C DDRC_RatDeb.MRlyDcSCG_tisigSCGUDRat_C DDRC_RatDeb.PSP_tiOLUDRat_C DDRC_RatDeb.PSP_tiOvrTempUDRat_C DDRC_RatDeb.PSP_tiSCBUDRat_C DDRC_RatDeb.PSP_tiSCGUDRat_C DDRC_RatDeb.T50_tiErrUDRat_C DDRC_RatDeb.ThrVlv_tiLoBattB1UDRat_C DDRC_RatDeb.VehV_tiOLUDRat_C DDRC_RatDeb.VehV_tiOTUDRat_C DDRC_RatDeb.VehV_tiPhysRngHiUDRat_C DDRC_RatDeb.VehV_tiSCBUDRat_C DDRC_RatDeb.VehV_tiSCGUDRat_C DDRC_RatDeb.VehV_tiSnsrARngHiUDRat_C DDRC_RatDeb.VehV_tiSnsrBRngHiUDRat_C DDRC_RatDeb.VehV_tiSpdRtyDiagUDRat_C DDRC_RatDeb.VehV_ctWhlErrUDRat_C DDRC_RatDeb.ACEvpT_tiSRCMaxUDRat_C DDRC_RatDeb.ACEvpT_tiSRCMinUDRat_C DDRC_RatDeb.AirC_tiClntSRCMaxUDRat_C DDRC_RatDeb.AirC_tiClntSRCMinUDRat_C DDRC_RatDeb.AirC_tiSwtNplUDRat_C DDRC_RatDeb.AirC_tiSwtSigUDRat_C DDRC_RatDeb.Brk_tiUDRat_C DDRC_RatDeb.Brk_tiSigUDRat_C DDRC_RatDeb.Clth_tiSigUDRat_C DDRC_RatDeb.HLSDem_tiOvhtUDRat_C DDRC_RatDeb.Oil_tiNplPUDRat_C DDRC_RatDeb.PIntkVUs_tiLineHiB1UDRat_C DDRC_RatDeb.PIntkVUs_tiLineLoB1UDRat_C DDRC_RatDeb.VehV_tiPhysRngLoUDRat_C DDRC_RatDeb.VehV_tiSigCanUDRat_C DDRC_RatDeb.VehV_tiSigCanSafeUDRat_C DDRC_RatDeb.VlvLft_tiSRCMaxOilPSnsrIntk11UDRat_C DDRC_RatDeb.VlvLft_tiSRCMinOilPSnsrIntk11UDRat_C DDRC_RatDeb.Clth_numPlaUDRat_C DDRC_RatDeb.Gbx_numPNPosnDrvCdnUDRat_C DDRC_RatDeb.Gbx_numPNPosnPlausyUDRat_C DDRC_RatDeb.InjVvG_numOLUDRat_C DDRC_RatDeb.InjVvG_numSCBUDRat_C DDRC_RatDeb.InjVvG_numSCGUDRat_C /end DEF_CHARACTERISTIC
 FUNCTION_VERSION "30000.21.1" /end FUNCTION
/begin FUNCTION DDRC_DemDeb ""
 /begin DEF_CHARACTERISTIC DDRC_DebArCtrBase.MyCtrBasedClass_2.isJmpDwnActv_C DDRC_DebArCtrBase.MyCtrBasedClass_2.isJmpUpActv_C DDRC_DebArCtrBase.MyCtrBasedClass_2.limPassd_C DDRC_DebArCtrBase.MyCtrBasedClass_2.limFaild_C DDRC_DebArCtrBase.MyCtrBasedClass_2.jmpUpVal_C DDRC_DebArCtrBase.MyCtrBasedClass_2.jmpDwnVal_C DDRC_DebArCtrBase.MyCtrBasedClass_2.stepUp_C DDRC_DebArCtrBase.MyCtrBasedClass_2.stepDwn_C DDRC_DebArCtrBase.MyCtrBasedClass_1.isJmpDwnActv_C DDRC_DebArCtrBase.MyCtrBasedClass_1.isJmpUpActv_C DDRC_DebArCtrBase.MyCtrBasedClass_1.limPassd_C DDRC_DebArCtrBase.MyCtrBasedClass_1.limFaild_C DDRC_DebArCtrBase.MyCtrBasedClass_1.jmpUpVal_C DDRC_DebArCtrBase.MyCtrBasedClass_1.jmpDwnVal_C DDRC_DebArCtrBase.MyCtrBasedClass_1.stepUp_C DDRC_DebArCtrBase.MyCtrBasedClass_1.stepDwn_C DDRC_DebArCtrBase.DemDebounceCounterBasedClass_standard.isJmpDwnActv_C DDRC_DebArCtrBase.DemDebounceCounterBasedClass_standard.isJmpUpActv_C DDRC_DebArCtrBase.DemDebounceCounterBasedClass_standard.limPassd_C DDRC_DebArCtrBase.DemDebounceCounterBasedClass_standard.limFaild_C DDRC_DebArCtrBase.DemDebounceCounterBasedClass_standard.jmpUpVal_C DDRC_DebArCtrBase.DemDebounceCounterBasedClass_standard.jmpDwnVal_C DDRC_DebArCtrBase.DemDebounceCounterBasedClass_standard.stepUp_C DDRC_DebArCtrBase.DemDebounceCounterBasedClass_standard.stepDwn_C DDRC_DebArTime.DFC_BusDiagCANAPPLBusOff.tiLimFaild_C DDRC_DebArTime.DFC_BusDiagCANAPPLBusOff.tiLimPassd_C DDRC_DebArTime.DFC_BusDiagCANCANCBusOff.tiLimFaild_C DDRC_DebArTime.DFC_BusDiagCANCANCBusOff.tiLimPassd_C DDRC_DebArTime.DFC_BusDiagCANVEHICLEBusOff.tiLimFaild_C DDRC_DebArTime.DFC_BusDiagCANVEHICLEBusOff.tiLimPassd_C DDRC_DebArTime.DFC_RBA_IODIAGPWR_rba_IoExtCy329_SignalVltSply_0.tiLimFaild_C DDRC_DebArTime.DFC_RBA_IODIAGPWR_rba_IoExtCy329_SignalVltSply_0.tiLimPassd_C DDRC_DebArTime.DFC_RBA_IODIAGPWR_rba_IoExtCy329_SignalVltSply_0OT.tiLimFaild_C DDRC_DebArTime.DFC_RBA_IODIAGPWR_rba_IoExtCy329_SignalVltSply_0OT.tiLimPassd_C DDRC_DebArTime.DFC_RBA_IODIAGPWR_rba_IoExtCy329_SignalVltSply_0OV.tiLimFaild_C DDRC_DebArTime.DFC_RBA_IODIAGPWR_rba_IoExtCy329_SignalVltSply_0OV.tiLimPassd_C DDRC_DebArTime.DFC_RBA_IODIAGPWR_rba_IoExtCy329_SignalVltSply_0SCG.tiLimFaild_C DDRC_DebArTime.DFC_RBA_IODIAGPWR_rba_IoExtCy329_SignalVltSply_0SCG.tiLimPassd_C DDRC_DebArTime.DFC_RBA_IODIAGPWR_rba_IoExtCy329_SignalVltSply_0UV.tiLimFaild_C DDRC_DebArTime.DFC_RBA_IODIAGPWR_rba_IoExtCy329_SignalVltSply_0UV.tiLimPassd_C DDRC_DebArTime.DFC_RBA_IODIAGPWR_rba_IoExtCy329_SignalVltSply_1.tiLimFaild_C DDRC_DebArTime.DFC_RBA_IODIAGPWR_rba_IoExtCy329_SignalVltSply_1.tiLimPassd_C DDRC_DebArTime.DFC_RBA_IODIAGPWR_rba_IoExtCy329_SignalVltSply_1OT.tiLimFaild_C DDRC_DebArTime.DFC_RBA_IODIAGPWR_rba_IoExtCy329_SignalVltSply_1OT.tiLimPassd_C DDRC_DebArTime.DFC_RBA_IODIAGPWR_rba_IoExtCy329_SignalVltSply_1OV.tiLimFaild_C DDRC_DebArTime.DFC_RBA_IODIAGPWR_rba_IoExtCy329_SignalVltSply_1OV.tiLimPassd_C DDRC_DebArTime.DFC_RBA_IODIAGPWR_rba_IoExtCy329_SignalVltSply_1SCG.tiLimFaild_C DDRC_DebArTime.DFC_RBA_IODIAGPWR_rba_IoExtCy329_SignalVltSply_1SCG.tiLimPassd_C DDRC_DebArTime.DFC_RBA_IODIAGPWR_rba_IoExtCy329_SignalVltSply_1UV.tiLimFaild_C DDRC_DebArTime.DFC_RBA_IODIAGPWR_rba_IoExtCy329_SignalVltSply_1UV.tiLimPassd_C DDRC_DebArTime.DFC_RBA_IODIAGPWR_rba_IoExtCy329_SignalVltSply_2.tiLimFaild_C DDRC_DebArTime.DFC_RBA_IODIAGPWR_rba_IoExtCy329_SignalVltSply_2.tiLimPassd_C DDRC_DebArTime.DFC_RBA_IODIAGPWR_rba_IoExtCy329_SignalVltSply_2OT.tiLimFaild_C DDRC_DebArTime.DFC_RBA_IODIAGPWR_rba_IoExtCy329_SignalVltSply_2OT.tiLimPassd_C DDRC_DebArTime.DFC_RBA_IODIAGPWR_rba_IoExtCy329_SignalVltSply_2OV.tiLimFaild_C DDRC_DebArTime.DFC_RBA_IODIAGPWR_rba_IoExtCy329_SignalVltSply_2OV.tiLimPassd_C DDRC_DebArTime.DFC_RBA_IODIAGPWR_rba_IoExtCy329_SignalVltSply_2SCG.tiLimFaild_C DDRC_DebArTime.DFC_RBA_IODIAGPWR_rba_IoExtCy329_SignalVltSply_2SCG.tiLimPassd_C DDRC_DebArTime.DFC_RBA_IODIAGPWR_rba_IoExtCy329_SignalVltSply_2UV.tiLimFaild_C DDRC_DebArTime.DFC_RBA_IODIAGPWR_rba_IoExtCy329_SignalVltSply_2UV.tiLimPassd_C /end DEF_CHARACTERISTIC
 /begin LOC_MEASUREMENT DDRC_ctArDebLvl.DFC_BusDiagCANAPPLBusOff DDRC_ctArDebLvl.DFC_BusDiagCANCANCBusOff DDRC_ctArDebLvl.DFC_BusDiagCANVEHICLEBusOff DDRC_ctArDebLvl.DFC_RBA_IODIAGPWR_rba_IoExtCy329_SignalVltSply_0 DDRC_ctArDebLvl.DFC_RBA_IODIAGPWR_rba_IoExtCy329_SignalVltSply_0OT DDRC_ctArDebLvl.DFC_RBA_IODIAGPWR_rba_IoExtCy329_SignalVltSply_0OV DDRC_ctArDebLvl.DFC_RBA_IODIAGPWR_rba_IoExtCy329_SignalVltSply_0SCG DDRC_ctArDebLvl.DFC_RBA_IODIAGPWR_rba_IoExtCy329_SignalVltSply_0UV DDRC_ctArDebLvl.DFC_RBA_IODIAGPWR_rba_IoExtCy329_SignalVltSply_1 DDRC_ctArDebLvl.DFC_RBA_IODIAGPWR_rba_IoExtCy329_SignalVltSply_1OT DDRC_ctArDebLvl.DFC_RBA_IODIAGPWR_rba_IoExtCy329_SignalVltSply_1OV DDRC_ctArDebLvl.DFC_RBA_IODIAGPWR_rba_IoExtCy329_SignalVltSply_1SCG DDRC_ctArDebLvl.DFC_RBA_IODIAGPWR_rba_IoExtCy329_SignalVltSply_1UV DDRC_ctArDebLvl.DFC_RBA_IODIAGPWR_rba_IoExtCy329_SignalVltSply_2 DDRC_ctArDebLvl.DFC_RBA_IODIAGPWR_rba_IoExtCy329_SignalVltSply_2OT DDRC_ctArDebLvl.DFC_RBA_IODIAGPWR_rba_IoExtCy329_SignalVltSply_2OV DDRC_ctArDebLvl.DFC_RBA_IODIAGPWR_rba_IoExtCy329_SignalVltSply_2SCG DDRC_ctArDebLvl.DFC_RBA_IODIAGPWR_rba_IoExtCy329_SignalVltSply_2UV DDRC_ctArDebLvl.DFC_CAN_E_TIMEOUT DDRC_ctArDebLvl.DFC_LIN_E_TIMEOUT DDRC_ctArDebLvl.DFC_MRlyOL DDRC_ctArDebLvl.DFC_MRlySCB DDRC_ctArDebLvl.DFC_MRlySCG DDRC_ctArDebLvl.DFC_rba_MultiStackTrace_Threshold DDRC_stLstRprtEve.DFC_BusDiagCANAPPLBusOff DDRC_stLstRprtEve.DFC_BusDiagCANCANCBusOff DDRC_stLstRprtEve.DFC_BusDiagCANVEHICLEBusOff DDRC_stLstRprtEve.DFC_RBA_IODIAGPWR_rba_IoExtCy329_SignalVltSply_0 DDRC_stLstRprtEve.DFC_RBA_IODIAGPWR_rba_IoExtCy329_SignalVltSply_0OT DDRC_stLstRprtEve.DFC_RBA_IODIAGPWR_rba_IoExtCy329_SignalVltSply_0OV DDRC_stLstRprtEve.DFC_RBA_IODIAGPWR_rba_IoExtCy329_SignalVltSply_0SCG DDRC_stLstRprtEve.DFC_RBA_IODIAGPWR_rba_IoExtCy329_SignalVltSply_0UV DDRC_stLstRprtEve.DFC_RBA_IODIAGPWR_rba_IoExtCy329_SignalVltSply_1 DDRC_stLstRprtEve.DFC_RBA_IODIAGPWR_rba_IoExtCy329_SignalVltSply_1OT DDRC_stLstRprtEve.DFC_RBA_IODIAGPWR_rba_IoExtCy329_SignalVltSply_1OV DDRC_stLstRprtEve.DFC_RBA_IODIAGPWR_rba_IoExtCy329_SignalVltSply_1SCG DDRC_stLstRprtEve.DFC_RBA_IODIAGPWR_rba_IoExtCy329_SignalVltSply_1UV DDRC_stLstRprtEve.DFC_RBA_IODIAGPWR_rba_IoExtCy329_SignalVltSply_2 DDRC_stLstRprtEve.DFC_RBA_IODIAGPWR_rba_IoExtCy329_SignalVltSply_2OT DDRC_stLstRprtEve.DFC_RBA_IODIAGPWR_rba_IoExtCy329_SignalVltSply_2OV DDRC_stLstRprtEve.DFC_RBA_IODIAGPWR_rba_IoExtCy329_SignalVltSply_2SCG DDRC_stLstRprtEve.DFC_RBA_IODIAGPWR_rba_IoExtCy329_SignalVltSply_2UV DDRC_stLstRprtEve.DFC_CAN_E_TIMEOUT DDRC_stLstRprtEve.DFC_LIN_E_TIMEOUT DDRC_stLstRprtEve.DFC_MRlyOL DDRC_stLstRprtEve.DFC_MRlySCB DDRC_stLstRprtEve.DFC_MRlySCG DDRC_stLstRprtEve.DFC_rba_MultiStackTrace_Threshold /end LOC_MEASUREMENT
/end FUNCTION
/begin FUNCTION DECJ "100.4.0   standard powerstage diagnosis enabling" /begin DEF_CHARACTERISTIC NDECJ UBCJMN UBCJMX /end DEF_CHARACTERISTIC /begin IN_MEASUREMENT BattU_u Epm_nEngLRes SyC_stSub /end IN_MEASUREMENT /begin OUT_MEASUREMENT B_deseehr_msg B_desee_msg B_PmdInit_msg /end OUT_MEASUREMENT FUNCTION_VERSION "100.4.0" /end FUNCTION
/begin FUNCTION DemDcmIf "30000.14.0_2.0.0Dem-Dcm Interfaces" /begin IN_MEASUREMENT DFES_stOutstate DSMAUX_ctWUC DSMRdy_xPId1 /end IN_MEASUREMENT /begin OUT_MEASUREMENT Dem_disableEventStatusUpdateGroup /end OUT_MEASUREMENT
 /begin LOC_MEASUREMENT Dem_DTCFltForFltDetnCntr Dem_DTCFltFormat Dem_DTCFltOrigin Dem_DTCFltProcCnt Dem_DTCFltProcIdx Dem_DTCFltRecFormat Dem_DTCFltRecRsltIdx Dem_DTCFltRsltIdx Dem_DTCFltSeverity Dem_DTCFltSt Dem_DTCFltStatusMask Dem_DTCFltWithSev /end LOC_MEASUREMENT
 FUNCTION_VERSION "30000.14.0_2.0.0" /end FUNCTION
/begin FUNCTION DEVE "1000.22.0_2.1.0Diagnosis of Output Stage Electromagnetic Injector Gasoline PFI" /begin DEF_CHARACTERISTIC CWPSEVE /end DEF_CHARACTERISTIC
 /begin IN_MEASUREMENT BattU_stErrDSQ B_desee_msg B_kl15_msg B_sa_msg EngStrt_bStrtEnd Epm_numCyl evz_austot_msg SyC_stSub /end IN_MEASUREMENT
 /begin OUT_MEASUREMENT B_eev_msg eevbz eevbz_msg eevd_msg /end OUT_MEASUREMENT
 /begin LOC_MEASUREMENT B_stBattuEna deve_DiagInfo deve_PSDiagInfo eevd_bz_ng /end LOC_MEASUREMENT
 FUNCTION_VERSION "1000.22.0_2.1.0" /end FUNCTION
/begin FUNCTION DevLib_DigOutErrHndlr "1.147.0   Digital Output Error handling module" /begin DEF_CHARACTERISTIC DevLib_DigOutDbgSig_C /end DEF_CHARACTERISTIC /begin LOC_MEASUREMENT DevLib_stDigOutErr_mp /end LOC_MEASUREMENT FUNCTION_VERSION "1.147.0" /end FUNCTION
/begin FUNCTION DevLib_PsDiag "1.148.0   Common part of Digital and PWM powerstage diagnosis" FUNCTION_VERSION "1.148.0" /end FUNCTION
/begin COMPU_METHOD B_TRUE "" TAB_VERB "%6.3" "" COMPU_TAB_REF B_TRUE /end COMPU_METHOD
/begin COMPU_VTAB B_TRUE "" TAB_VERB 2 0 "FALSE" 1 "TRUE" /end COMPU_VTAB
/begin COMPU_METHOD DDRCTime_ms "" RAT_FUNC "%6.1" "ms" COEFFS 0 1 0 0 0 10 /end COMPU_METHOD
/begin COMPU_METHOD DDRC_LstRprtEve_VERB "" TAB_VERB "%6.3" "" COMPU_TAB_REF DDRC_LstRprtEve_VERB /end COMPU_METHOD
/begin COMPU_VTAB DDRC_LstRprtEve_VERB "" TAB_VERB 5 0 "PASSED" 1 "FAILED" 2 "PREPASSED" 3 "PREFAILED" 255 "INVALID" /end COMPU_VTAB
/begin COMPU_METHOD DDRC_Ratio "" TAB_VERB "%6.3" "-" COMPU_TAB_REF DDRC_Ratio /end COMPU_METHOD
/begin COMPU_VTAB DDRC_Ratio "" TAB_VERB 4 1 "Ratio1" 2 "Ratio2" 3 "Ratio3" 4 "Ratio4" /end COMPU_VTAB
/begin COMPU_METHOD Dem_DTCFltSt_Verb "" TAB_VERB "%6.3" "-" COMPU_TAB_REF Dem_DTCFltSt_Verb /end COMPU_METHOD
/begin COMPU_VTAB Dem_DTCFltSt_Verb "" TAB_VERB 6 0 "IDLE" 1 "UDS_ENTRIES_PENDING" 2 "UDS_DTCS_PENDING" 3 "UDS_ENTRIES_RSLT" 4 "OBD_ENTRIES_RSLT" 5 "UDS_DTCS_RSLT" /end COMPU_VTAB
/begin COMPU_METHOD dez "" RAT_FUNC "%6.2" "" COEFFS 0 1 0 0 0 1 /end COMPU_METHOD
/begin COMPU_METHOD DFC_OneToOne "" RAT_FUNC "%6.2" "-" COEFFS 0 1 0 0 0 1 /end COMPU_METHOD
/begin COMPU_METHOD EngN_LRes "" RAT_FUNC "%6.1" "rpm" COEFFS 0 0.025 0 0 0 1 /end COMPU_METHOD
/begin COMPU_METHOD ENGSTRT_STRTCOORCUST_SC_Compu "" TAB_VERB "%6.3" "" COMPU_TAB_REF ENGSTRT_STRTCOORCUST_SC_Compu /end COMPU_METHOD
/begin COMPU_VTAB ENGSTRT_STRTCOORCUST_SC_Compu "" TAB_VERB 2 0 "False" 1 "True" /end COMPU_VTAB
/begin COMPU_METHOD ENGSTRT_STRTGDEVIF_SC_Compu "" TAB_VERB "%6.3" "" COMPU_TAB_REF ENGSTRT_STRTGDEVIF_SC_Compu /end COMPU_METHOD
/begin COMPU_VTAB ENGSTRT_STRTGDEVIF_SC_Compu "" TAB_VERB 2 0 "False" 1 "True" /end COMPU_VTAB
/begin COMPU_METHOD ENGSTRT_VAR_SY_Compu "" TAB_VERB "%6.3" "" COMPU_TAB_REF ENGSTRT_VAR_SY_Compu /end COMPU_METHOD
/begin COMPU_VTAB ENGSTRT_VAR_SY_Compu "" TAB_VERB 47 1 "DAI" 3 "VWW" 4 "POR" 5 "AUD" 6 "OPE" 9 "FIA" 11 "BMW" 14 "PSA" 15 "REN" 17 "ALF" 18 "SAB" 19 "VOL" 20 "NIS" 21 "GMU" 22 "FOR" 26 "IMJ" 51 "SEA" 53 "CHR" 54 "JAG" 55 "ROL" 69 "FER" 72 "TOY" 123 "MIT" 147 "HYU" 159 "HON" 160 "MAZ" 183 "CU" 190 "LRG" 204 "VVW" 214 "AVT" 242 "Iveco" 243 "DMC" 248 "SUZ" 267 "SSANGYONG" 270 "KEF" 289 "AMG" 308 "TAT" 319 "MVM" 328 "MM" 385 "UAES" 425 "Polaris" 590 "Scania" 828 "RBCD" 898 "MFTBC" 999 "ALL" 2887 "Nonox" 9454 "Fuso" /end COMPU_VTAB
/begin COMPU_METHOD ENGTMR_VAR_SY_Compu "" TAB_VERB "%6.3" "" COMPU_TAB_REF ENGTMR_VAR_SY_Compu /end COMPU_METHOD
/begin COMPU_VTAB ENGTMR_VAR_SY_Compu "" TAB_VERB 44 1 "DAI" 3 "VWW" 4 "POR" 5 "AUD" 6 "OPE" 9 "FIA" 11 "BMW" 14 "PSA" 15 "REN" 17 "ALF" 18 "SAB" 19 "VOL" 20 "NIS" 21 "GMU" 22 "FOR" 26 "IMJ" 51 "SEA" 53 "CHR" 54 "JAG" 55 "ROL" 69 "FER" 72 "TOY" 123 "MIT" 147 "HYU" 159 "HON" 160 "MAZ" 183 "CU" 190 "LRG" 204 "VVW" 214 "AVT" 242 "Iveco" 243 "DMC" 248 "SUZ" 267 "SSANGYONG" 270 "KEF" 289 "AMG" 308 "TAT" 319 "MVM" 385 "UAES" 590 "Scania" 828 "RBCD" 999 "ALL" 2887 "Nonox" 9454 "Fuso" /end COMPU_VTAB
/begin COMPU_METHOD EnrgPrMol_q0p001_COMPU "" RAT_FUNC "%6.5" "J/mol" COEFFS 0 1000 0 0 0 1 /end COMPU_METHOD
/begin COMPU_METHOD ENVP_TYPAVL_SY_Compu "" TAB_VERB "%6.3" "" COMPU_TAB_REF ENVP_TYPAVL_SY_Compu /end COMPU_METHOD
/begin COMPU_VTAB ENVP_TYPAVL_SY_Compu "" TAB_VERB 2 0 "False" 1 "True" /end COMPU_VTAB
/begin COMPU_METHOD ENVT_PHYSRNGCHK_SY_Compu "" TAB_VERB "%6.3" "" COMPU_TAB_REF ENVT_PHYSRNGCHK_SY_Compu /end COMPU_METHOD
/begin COMPU_VTAB ENVT_PHYSRNGCHK_SY_Compu "" TAB_VERB 2 0 "PHYSRNGCHK_DISBL" 1 "PHYSRNGCHK_ENA" /end COMPU_VTAB
/begin COMPU_METHOD ENVT_PLAUSDIAGCSC_SY_Compu "" TAB_VERB "%6.3" "" COMPU_TAB_REF ENVT_PLAUSDIAGCSC_SY_Compu /end COMPU_METHOD
/begin COMPU_VTAB ENVT_PLAUSDIAGCSC_SY_Compu "" TAB_VERB 2 0 "0" 1 "1" /end COMPU_VTAB
/begin COMPU_METHOD ENVT_PLAUSDIAGMBC_SY_Compu "" TAB_VERB "%6.3" "" COMPU_TAB_REF ENVT_PLAUSDIAGMBC_SY_Compu /end COMPU_METHOD
/begin COMPU_VTAB ENVT_PLAUSDIAGMBC_SY_Compu "" TAB_VERB 2 0 "0" 1 "1" /end COMPU_VTAB
/begin COMPU_METHOD ENVT_PLAUSDIAGPRC_SY_Compu "" TAB_VERB "%6.3" "" COMPU_TAB_REF ENVT_PLAUSDIAGPRC_SY_Compu /end COMPU_METHOD
/begin COMPU_VTAB ENVT_PLAUSDIAGPRC_SY_Compu "" TAB_VERB 2 0 "0" 1 "1" /end COMPU_VTAB
/begin COMPU_METHOD ENVT_SWTHWORCAN_SY_Compu "" TAB_VERB "%6.3" "" COMPU_TAB_REF ENVT_SWTHWORCAN_SY_Compu /end COMPU_METHOD
/begin COMPU_VTAB ENVT_SWTHWORCAN_SY_Compu "" TAB_VERB 3 0 "0" 1 "1" 2 "2" /end COMPU_VTAB
/begin COMPU_METHOD ENVT_TCACINTKBNK_SC_Compu "" TAB_VERB "%6.3" "" COMPU_TAB_REF ENVT_TCACINTKBNK_SC_Compu /end COMPU_METHOD
/begin COMPU_VTAB ENVT_TCACINTKBNK_SC_Compu "" TAB_VERB 3 0 "no_bank" 1 "bank_1" 2 "bank_2" /end COMPU_VTAB
/begin COMPU_METHOD ENVT_TCACINTKPOS_SC_Compu "" TAB_VERB "%6.3" "" COMPU_TAB_REF ENVT_TCACINTKPOS_SC_Compu /end COMPU_METHOD
/begin COMPU_VTAB ENVT_TCACINTKPOS_SC_Compu "" TAB_VERB 6 0 "no_position" 1 "position_1" 2 "position_2" 3 "position_3" 4 "position_4" 5 "position_5" /end COMPU_VTAB
/begin COMPU_METHOD ENVT_TMODINTKBNK_SC_Compu "" TAB_VERB "%6.3" "" COMPU_TAB_REF ENVT_TMODINTKBNK_SC_Compu /end COMPU_METHOD
/begin COMPU_VTAB ENVT_TMODINTKBNK_SC_Compu "" TAB_VERB 3 0 "no_bank" 1 "bank_1" 2 "bank_2" /end COMPU_VTAB
/begin COMPU_METHOD ENVT_TMODINTKPOS_SC_Compu "" TAB_VERB "%6.3" "" COMPU_TAB_REF ENVT_TMODINTKPOS_SC_Compu /end COMPU_METHOD
/begin COMPU_VTAB ENVT_TMODINTKPOS_SC_Compu "" TAB_VERB 6 0 "no_position" 1 "position_1" 2 "position_2" 3 "position_3" 4 "position_4" 5 "position_5" /end COMPU_VTAB
/begin COMPU_METHOD ENVT_TPLAUSMOD_SY_Compu "" TAB_VERB "%6.3" "" COMPU_TAB_REF ENVT_TPLAUSMOD_SY_Compu /end COMPU_METHOD
/begin COMPU_VTAB ENVT_TPLAUSMOD_SY_Compu "" TAB_VERB 3 0 "0" 1 "1" 2 "2" /end COMPU_VTAB
/begin COMPU_METHOD ENVT_TREPLMOD_SY_Compu "" TAB_VERB "%6.3" "" COMPU_TAB_REF ENVT_TREPLMOD_SY_Compu /end COMPU_METHOD
/begin COMPU_VTAB ENVT_TREPLMOD_SY_Compu "" TAB_VERB 3 0 "0" 1 "1" 2 "2" /end COMPU_VTAB
/begin COMPU_METHOD ENVT_TSENSADCAVL_SY_Compu "" TAB_VERB "%6.3" "" COMPU_TAB_REF ENVT_TSENSADCAVL_SY_Compu /end COMPU_METHOD
/begin COMPU_VTAB ENVT_TSENSADCAVL_SY_Compu "" TAB_VERB 2 0 "0" 1 "1" /end COMPU_VTAB
/begin COMPU_METHOD ENVT_TSENSCANAVL_SY_Compu "" TAB_VERB "%6.3" "" COMPU_TAB_REF ENVT_TSENSCANAVL_SY_Compu /end COMPU_METHOD
/begin COMPU_VTAB ENVT_TSENSCANAVL_SY_Compu "" TAB_VERB 2 0 "0" 1 "1" /end COMPU_VTAB
/begin COMPU_METHOD ENVT_TSENSMOD_SY_Compu "" TAB_VERB "%6.3" "" COMPU_TAB_REF ENVT_TSENSMOD_SY_Compu /end COMPU_METHOD
/begin COMPU_VTAB ENVT_TSENSMOD_SY_Compu "" TAB_VERB 2 0 "0" 1 "1" /end COMPU_VTAB
/begin COMPU_METHOD OneToOne "" RAT_FUNC "%6.2" "-" COEFFS 0 1 0 0 0 1 /end COMPU_METHOD
/begin COMPU_METHOD Volt_Batt "" RAT_FUNC "%6.1" "mV" COEFFS 0 0.05 0 0 0 1 /end COMPU_METHOD
/begin RECORD_LAYOUT KwWU16 FNC_VALUES 1 UWORD COLUMN_DIR DIRECT /end RECORD_LAYOUT
/begin RECORD_LAYOUT KwWU8 FNC_VALUES 1 UBYTE COLUMN_DIR DIRECT /end RECORD_LAYOUT
/begin RECORD_LAYOUT RB_Val_Ws16 FNC_VALUES 1 SWORD COLUMN_DIR DIRECT /end RECORD_LAYOUT
/begin RECORD_LAYOUT RB_Val_Wu8 FNC_VALUES 1 UBYTE COLUMN_DIR DIRECT /end RECORD_LAYOUT
/begin RECORD_LAYOUT Val_Wu16 FNC_VALUES 1 UWORD COLUMN_DIR DIRECT /end RECORD_LAYOUT
/begin RECORD_LAYOUT Val_Wu8 FNC_VALUES 1 UBYTE COLUMN_DIR DIRECT /end RECORD_LAYOUT
/end MODULE
/end PROJECT
