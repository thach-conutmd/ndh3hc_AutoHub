ASAP2_VERSION 1 60
/begin PROJECT MG1CA020 "MG1CA020"
/begin HEADER "" VERSION "MG1CA020_6SAY_V011_TPROT" PROJECT_NO MG1CA020 /end HEADER
/begin MODULE DIM ""
/begin MOD_COMMON "" BYTE_ORDER MSB_LAST ALIGNMENT_BYTE 1 ALIGNMENT_WORD 2 ALIGNMENT_LONG 4 ALIGNMENT_INT64 4 ALIGNMENT_FLOAT32_IEEE 4 ALIGNMENT_FLOAT64_IEEE 4 DATA_SIZE 32 /end MOD_COMMON
/begin CHARACTERISTIC ThrVlv_ATS.LimitTypeMsk_C "Actuator test ThrVlv_ATS / Tester demand monitoring enable mask for actuators" VALUE 0x8053A660 Val_Wu8 255.0 OneToOne 0.00 255.0 FORMAT "%5.1" /end CHARACTERISTIC
/begin CHARACTERISTIC ThrVlv_ATS.CnvNorm_C "Actuator test ThrVlv_ATS / Conversion norm used for conversion to/from internal scaling" VALUE 0x8053A661 Val_Wu8 255.0 OneToOne 0.00 255.0 FORMAT "%5.1" /end CHARACTERISTIC
/begin CHARACTERISTIC ThrVlv_ATS.LowLim_C "Actuator test ThrVlv_ATS / Lower limit for monitoring" VALUE 0x8053A662 Val_Ws16 511.9922 rel_q0p0078125 -256.0000 255.9922 FORMAT "%8.4" /end CHARACTERISTIC
/begin CHARACTERISTIC ThrVlv_ATS.UpLim_C "Actuator test ThrVlv_ATS / Upper limit for monitoring" VALUE 0x8053A664 Val_Ws16 511.9922 rel_q0p0078125 -256.0000 255.9922 FORMAT "%8.4" /end CHARACTERISTIC
/begin CHARACTERISTIC ThrVlv_ATS.CnvFac_C "Actuator test ThrVlv_ATS / Factor used for conversion to/from internal scaling" VALUE 0x8053A668 Val_Ws32 4294967295.00 OneToOne -2147483648.00 2147483647.00 FORMAT "%13.2" /end CHARACTERISTIC
/begin CHARACTERISTIC ThrVlv_ATS.CnvOfs_C "Actuator test ThrVlv_ATS / Offset used for conversion to/from internal scaling" VALUE 0x8053A66C Val_Ws16 65535.00 OneToOne -32768.00 32767.00 FORMAT "%8.2" /end CHARACTERISTIC
/begin CHARACTERISTIC ThrVlv_ATS.DfltVal_C "Actuator test ThrVlv_ATS / Default value for standbytest" VALUE 0x8053A66E Val_Ws16 65535.00 OneToOne -32768.00 32767.00 FORMAT "%8.2" /end CHARACTERISTIC
/begin CHARACTERISTIC ThrVlv_IfDetLimpAirPosnRegnB1_I.dUIntglSldgModLhp_CUR "interface class for detection of the limp air position, bank 1 / gain of integral part at limp air postion" CURVE 0x804FA57C Cur_Xs16Ws16 1638.350 RBPtCel_du_0p05_1 0.00 1638.350 FORMAT "%8.3" EXTENDED_LIMITS -1638.400 1638.350
 /begin AXIS_DESCR STD_AXIS NO_INPUT_QUANTITY rel_q0p0078125 4 -256.0000 255.9922 FORMAT "%8.4" DEPOSIT ABSOLUTE /end AXIS_DESCR
/end CHARACTERISTIC
/begin CHARACTERISTIC ThrVlv_IfDetLimpAirPosnRegnB1_I.facCtrlIntglLimpAirPosn_C "interface class for detection of the limp air position, bank 1 / gain of i part at limp air postion" VALUE 0x804FA58E Val_Wu16 655.3500 fak_q0p01 0.00 655.3500 FORMAT "%8.4" /end CHARACTERISTIC
/begin CHARACTERISTIC ThrVlv_IfDetLimpAirPosnRegnB1_I.facCtrlSldgModLhp_C "interface class for detection of the limp air position, bank 1 / gain of the proportional derivative controller at limp air postion" VALUE 0x804FA590 Val_Ws16 65.53500 Fact1000 -32.76800 32.76700 FORMAT "%8.5" /end CHARACTERISTIC
/begin CHARACTERISTIC ThrVlv_IfDetLimpAirPosnRegnB1_I.ratDeCtrlrThdLhpStuckDetn_C "interface class for detection of the limp air position, bank 1 / threshold control deviation to detect a stuck valve at limp home position" VALUE 0x804FA592 Val_Ws16 511.9922 rel_q0p0078125 -256.0000 255.9922 FORMAT "%8.4" /end CHARACTERISTIC
/begin CHARACTERISTIC ThrVlv_IfDetLimpAirPosnRegnB1_I.ratDeLimpAirPosn_C "interface class for detection of the limp air position, bank 1 / distance between trajectory to the limp air position" VALUE 0x804FA594 Val_Ws16 511.9922 rel_q0p0078125 -256.0000 255.9922 FORMAT "%8.4" /end CHARACTERISTIC
/begin CHARACTERISTIC ThrVlv_IfDetLimpAirPosnRegnB1_I.ratLimpAirPosnBand_C "interface class for detection of the limp air position, bank 1 / band around limp air position area" VALUE 0x804FA596 Val_Wu16 511.9844 rel_q0p0078125 0.0078 511.9922 FORMAT "%8.4" EXTENDED_LIMITS 0.00 511.9922 /end CHARACTERISTIC
/begin CHARACTERISTIC ThrVlv_IfDetLimpAirPosnRegnB1_I.uDifOpngSprg_C "interface class for detection of the limp air position, bank 1 / differential voltage between the feedforward of the upper and the lower spring" VALUE 0x804FA598 Val_Ws32 1677721.59961 spg_q0p00039 -838860.800000 838860.799609 FORMAT "%13.6" /end CHARACTERISTIC
/begin CHARACTERISTIC ThrVlv_IfDetLimpAirPosnRegnB1_I.uMinOpngSprg_C "interface class for detection of the limp air position, bank 1 / maximum differential voltage between the feedforward of the upper and the lower spring" VALUE 0x804FA59C Val_Ws32 1677721.59961 spg_q0p00039 -838860.800000 838860.799609 FORMAT "%13.6" /end CHARACTERISTIC
/begin CHARACTERISTIC ThrVlv_IfDiagB1_I.dRatDesPreCtrlGrdtThd_C "interface class diagnosis, bank1 / threshold for gradient of the trajectory to release duty cycle diagnosis" VALUE 0x804FA5A0 Val_Ws16 511992.2 relgrd_q7p8125 -256000.0 255992.2 FORMAT "%8.1" /end CHARACTERISTIC
/begin CHARACTERISTIC ThrVlv_IfDiagB1_I.facDeCtrlTolr_C "interface class diagnosis, bank1 / factor for allowed control deviation" VALUE 0x804FA5A2 Val_Wu16 65.53500 Fact1000 0.00 65.53500 FORMAT "%8.5" /end CHARACTERISTIC
/begin CHARACTERISTIC ThrVlv_IfDiagB1_I.facDiagHeal_C "interface class diagnosis, bank1 / healing factor" VALUE 0x804FA5A4 Val_Wu16 31.49951 fak_q0p000488 0.50000 31.99951 FORMAT "%8.5" EXTENDED_LIMITS 0.00 31.99951 /end CHARACTERISTIC
/begin CHARACTERISTIC ThrVlv_IfDiagB1_I.ratDeCtrlTolrMin_C "interface class diagnosis, bank1 / allowed control deviation in steady state" VALUE 0x804FA5A6 Val_Wu16 255.9922 rel_q0p0078125 0.00 255.9922 FORMAT "%8.4" EXTENDED_LIMITS 0.00 511.9922 /end CHARACTERISTIC
/begin CHARACTERISTIC ThrVlv_IfDiagB1_I.ratDutyCycDiagMaxLoBatt_C "interface class diagnosis, bank1 / upper threshold for duty cycle diagnosis in case of low battery voltage" VALUE 0x804FA5A8 Val_Ws16 511.9922 rel_q0p0078125 -256.0000 255.9922 FORMAT "%8.4" /end CHARACTERISTIC
/begin CHARACTERISTIC ThrVlv_IfDiagB1_I.ratDutyCycDiagMax_C "interface class diagnosis, bank1 / upper threshold for duty cycle diagnosis" VALUE 0x804FA5AA Val_Ws16 511.9922 rel_q0p0078125 -256.0000 255.9922 FORMAT "%8.4" /end CHARACTERISTIC
/begin CHARACTERISTIC ThrVlv_IfDiagB1_I.ratOffsTestMax_C "interface class diagnosis, bank1 / upper threshold for cycle flag" VALUE 0x804FA5AC Val_Ws16 255.9922 rel_q0p0078125 0.00 255.9922 FORMAT "%8.4" EXTENDED_LIMITS -256.0000 255.9922 /end CHARACTERISTIC
/begin CHARACTERISTIC ThrVlv_IfDiagB1_I.ratOffsTestMin_C "interface class diagnosis, bank1 / lower threshold for cycle flag" VALUE 0x804FA5AE Val_Ws16 255.9922 rel_q0p0078125 0.00 255.9922 FORMAT "%8.4" EXTENDED_LIMITS -256.0000 255.9922 /end CHARACTERISTIC
/begin CHARACTERISTIC ThrVlv_IfDiagB1_I.tiCtrlDeMax_C "interface class diagnosis, bank1 / maximum debounce time control deviation" VALUE 0x804FA5B0 Val_Wu16 31.99951 t_tev0p0005 0.00 31.99951 FORMAT "%8.5" /end CHARACTERISTIC
/begin CHARACTERISTIC ThrVlv_IfDiagB1_I.tiDutyCycExcd_C "interface class diagnosis, bank1 / maximum debounce time duty cycle" VALUE 0x804FA5B2 Val_Wu16 31.99951 t_tev0p0005 0.00 31.99951 FORMAT "%8.5" /end CHARACTERISTIC
/begin CHARACTERISTIC ThrVlv_IfExtdPostDrvB1_I.tiExtdPostDrv_C "interface class postdrive prolongation / time for postdrive prolongation" VALUE 0x804FA5B4 Val_Wu16 33.34912 RBPtCel_ti_5p12em4_1 0.20480 33.55392 FORMAT "%8.5" EXTENDED_LIMITS 0.00 33.55392 /end CHARACTERISTIC
/begin CHARACTERISTIC ThrVlv_IfLimpAirPosnChkB1_I.ratOffsLimpAirPosnNotRea_C "interface class check for reaching of limp air position, bank 1 / tolerance for reaching of limp air position" VALUE 0x804FA5B6 Val_Ws16 255.9922 rel_q0p0078125 0.00 255.9922 FORMAT "%8.4" EXTENDED_LIMITS -256.0000 255.9922 /end CHARACTERISTIC
/begin CHARACTERISTIC ThrVlv_IfLimpAirPosnChkB1_I.tiToReaLimpAirPosn_C "interface class check for reaching of limp air position, bank 1 / allowed time to reach limp air position" VALUE 0x804FA5B8 Val_Wu16 33.55392 RBPtCel_ti_5p12em4_1 0.00 33.55392 FORMAT "%8.5" /end CHARACTERISTIC
/begin CHARACTERISTIC ThrVlv_IfLimpHomeSubB1_I.stMask_C "Interface class: Replacement values for the limp air position / Codeword mask for LImpHomeSub method" VALUE 0x804FA7F8 Val_Wu8 255.0 OneToOne 0.00 255.0 FORMAT "%5.1" /end CHARACTERISTIC
/begin CHARACTERISTIC ThrVlv_IfMainFillgCompB1_I.nMinForChrgComp_C "Interface class: Parameter for sensor comparison with main load sensor / Required engine speed for sensor comparison with main charge sensor" VALUE 0x804FA7FA Val_Ws16 32767.50 EngN -16384.00 16383.50 FORMAT "%8.2" /end CHARACTERISTIC
/begin CHARACTERISTIC ThrVlv_IfMainFillgCompB1_I.ratSens1ChrgMaxDe_C "Interface class: Parameter for sensor comparison with main load sensor / Maximal allowed deviation between throttle sensor 1 and main charge sensor" VALUE 0x804FA7FC Val_Ws16 511.9922 rel_q0p0078125 -256.0000 255.9922 FORMAT "%8.4" /end CHARACTERISTIC
/begin CHARACTERISTIC ThrVlv_IfMainFillgCompB1_I.ratSens2ChrgMaxDe_C "Interface class: Parameter for sensor comparison with main load sensor / Maximal allowed deviation between throttle sensor 2 and main charge sensor" VALUE 0x804FA7FE Val_Ws16 511.9922 rel_q0p0078125 -256.0000 255.9922 FORMAT "%8.4" /end CHARACTERISTIC
/begin CHARACTERISTIC ThrVlv_IfMainFillgCompB1_I.tiDebMaiChrgSensErr_C "Interface class: Parameter for sensor comparison with main load sensor / Debounce time: Main charge sensor error" VALUE 0x804FA800 Val_Wu8 2.550 t10msxs_ub_b2p55 0.00 2.550 FORMAT "%5.3" /end CHARACTERISTIC
/begin CHARACTERISTIC ThrVlv_IfMainFillgCompB1_I.tiDebSens1ChrgSyncErr_C "Interface class: Parameter for sensor comparison with main load sensor / Debounce time for maximal deviation between throttle sensor 1 and main load sensor" VALUE 0x804FA801 Val_Wu8 2.550 t10msxs_ub_b2p55 0.00 2.550 FORMAT "%5.3" /end CHARACTERISTIC
/begin CHARACTERISTIC ThrVlv_IfMainFillgCompB1_I.tiDebSens2ChrgSyncErr_C "Interface class: Parameter for sensor comparison with main load sensor / Debounce time for maximal deviation between throttle sensor 2 and main load sensor" VALUE 0x804FA802 Val_Wu8 2.550 t10msxs_ub_b2p55 0.00 2.550 FORMAT "%5.3" /end CHARACTERISTIC
/begin CHARACTERISTIC ThrVlv_IfMainFillgCompB1_I.tiDlySensSel_C "Interface class: Parameter for sensor comparison with main load sensor / Time for active comparison of the throttle sensors with the main charge sensor" VALUE 0x804FA803 Val_Wu8 2.550 t10msxs_ub_b2p55 0.00 2.550 FORMAT "%5.3" /end CHARACTERISTIC
/begin CHARACTERISTIC ThrVlv_IfMainFillgCompB1_I.tiFildCompChrg_CUR "Interface class: Parameter for sensor comparison with main load sensor / Engine speed dependent time constant for filtering of the throttle valve angles" CURVE 0x804FA804 Cur_Xs16Ws16 327.6600 Time_s 0.0100 327.6700 FORMAT "%8.4" EXTENDED_LIMITS -327.6800 327.6700
 /begin AXIS_DESCR STD_AXIS NO_INPUT_QUANTITY EngN 6 -16384.00 16383.50 FORMAT "%8.2" DEPOSIT ABSOLUTE /end AXIS_DESCR
/end CHARACTERISTIC
/begin CHARACTERISTIC ThrVlv_IfPwrSaveB1_I.ratDeCtrlrThd_C "interface class powersave / threshold for control deviation" VALUE 0x804FA5BA Val_Ws16 511.9922 rel_q0p0078125 -256.0000 255.9922 FORMAT "%8.4" /end CHARACTERISTIC
/begin CHARACTERISTIC ThrVlv_IfPwrSaveB1_I.ratDesThdOffs_C "interface class powersave / threshold of desired value" VALUE 0x804FA5BC Val_Ws16 511.9922 rel_q0p0078125 -256.0000 255.9922 FORMAT "%8.4" /end CHARACTERISTIC
/begin CHARACTERISTIC ThrVlv_IfPwrSaveB1_I.swtPosnCdnOpen_C "interface class powersave / position condition of powersave set to open position" VALUE 0x804FA5BE Val_Wu8 1.000 OneToOne 0.00 1.000 FORMAT "%5.3" EXTENDED_LIMITS 0.00 255.0 /end CHARACTERISTIC
/begin CHARACTERISTIC ThrVlv_IfPwrSaveB1_I.swtWakeup_C "interface class powersave / enable switch for wake up in postdrive" VALUE 0x804FA5BF Val_Wu8 1.000 OneToOne 0.00 1.000 FORMAT "%5.3" EXTENDED_LIMITS 0.00 255.0 /end CHARACTERISTIC
/begin CHARACTERISTIC ThrVlv_IfPwrSaveB1_I.tiPwrSave_C "interface class powersave / time delay until power save" VALUE 0x804FA5C0 Val_Wu16 33.45152 RBPtCel_ti_5p12em4_1 0.10240 33.55392 FORMAT "%8.5" EXTENDED_LIMITS 0.00 33.55392 /end CHARACTERISTIC
/begin CHARACTERISTIC ThrVlv_IfRampDwnB1_I.ratOffsBtwVal_C "interface class drive to lower stop by ramping / offset for between value" VALUE 0x804FA5C2 Val_Ws16 511.9922 rel_q0p0078125 -256.0000 255.9922 FORMAT "%8.4" /end CHARACTERISTIC
/begin CHARACTERISTIC ThrVlv_IfRampDwnB1_I.ratStepSize_C "interface class drive to lower stop by ramping / step size" VALUE 0x804FA5C4 Val_Ws16 511.9922 rel_q0p0078125 -256.0000 255.9922 FORMAT "%8.4" /end CHARACTERISTIC
/begin CHARACTERISTIC ThrVlv_IfRampDwnB1_I.ratStrtPosn_C "interface class drive to lower stop by ramping / start position" VALUE 0x804FA5C6 Val_Ws16 511.9922 rel_q0p0078125 -256.0000 255.9922 FORMAT "%8.4" /end CHARACTERISTIC
/begin CHARACTERISTIC ThrVlv_IfRampDwnB1_I.swtRampDwnEna_C "interface class drive to lower stop by ramping / enable switch" VALUE 0x804FA5C8 Val_Wu8 1.000 OneToOne 0.00 1.000 FORMAT "%5.3" EXTENDED_LIMITS 0.00 255.0 /end CHARACTERISTIC
/begin CHARACTERISTIC ThrVlv_IfSens2B1_I.ratMaxSensDe_CUR "Interface class: sensor 2 available / Maximal allowed throttle angle deviation" CURVE 0x804FA81E Cur_Xs16Ws16 511.9922 rel_q0p0078125 -256.0000 255.9922 FORMAT "%8.4"
 /begin AXIS_DESCR STD_AXIS NO_INPUT_QUANTITY rel_q0p0078125 5 -256.0000 255.9922 FORMAT "%8.4" DEPOSIT ABSOLUTE /end AXIS_DESCR
/end CHARACTERISTIC
/begin CHARACTERISTIC ThrVlv_IfSens2B1_I.tiDebSens1Sens2SyncErr_C "Interface class: sensor 2 available / Debounce time for synchronization error between ETB sensor 1 and sensor 2" VALUE 0x804FA834 Val_Wu8 2.550 t10msxs_ub_b2p55 0.00 2.550 FORMAT "%5.3" /end CHARACTERISTIC
/begin CHARACTERISTIC ThrVlv_IfSens2B1_I.tiDebSens2Err_C "Interface class: sensor 2 available / Debounce time for ETB sensor 2 error" VALUE 0x804FA835 Val_Wu8 2.550 t10msxs_ub_b2p55 0.00 2.550 FORMAT "%5.3" /end CHARACTERISTIC
/begin CHARACTERISTIC ThrVlv_IfSens2B1_I.uSens2Max_C "Interface class: sensor 2 available / Upper diagnosis threshold sensor 2" VALUE 0x804FA836 Val_Wu16 79.99878 spg_q1p221Em3_V 0.00 79.99878 FORMAT "%8.5" /end CHARACTERISTIC
/begin CHARACTERISTIC ThrVlv_IfSens2B1_I.uSens2Min_C "Interface class: sensor 2 available / Lower diagnosis threshold sensor 2" VALUE 0x804FA838 Val_Wu16 79.99878 spg_q1p221Em3_V 0.00 79.99878 FORMAT "%8.5" /end CHARACTERISTIC
/begin CHARACTERISTIC ThrVlv_IfSens2B1_I.uVltgOffs_C "Interface class: sensor 2 available / Voltage offset for Visteon ETB" VALUE 0x804FA83A Val_Wu16 79.99878 spg_q1p221_mV 0.00 79.99878 FORMAT "%8.5" /end CHARACTERISTIC
/begin CHARACTERISTIC ThrVlv_IfSens2B1_I.uVltgSlop_C "Interface class: sensor 2 available / Slope for Visteon ETB" VALUE 0x804FA83C Val_Wu16 79.99878 spg_q1p221_mV 0.00 79.99878 FORMAT "%8.5" /end CHARACTERISTIC
/begin CHARACTERISTIC ThrVlv_IfSens2B1_I.uVltgThd_C "Interface class: sensor 2 available / Threshold for switching over between the throttle characteristic sensor curves for Visteon ETB" VALUE 0x804FA83E Val_Wu16 79.99878 spg_q1p221_mV 0.00 79.99878 FORMAT "%8.5" /end CHARACTERISTIC
/begin CHARACTERISTIC ThrVlv_IfSoftLdgB1_I.dRadSpdLimDecel_C "instance of the interface class softlanding / speed limit for deceleration" VALUE 0x804FA5CA Val_Ws16 1023.984 q0p01562_rad_DIV_s -512.0000 511.9844 FORMAT "%8.4" /end CHARACTERISTIC
/begin CHARACTERISTIC ThrVlv_IfSoftLdgB1_I.dRadSpdLimSoftLdg_C "instance of the interface class softlanding / speed limit for softlanding" VALUE 0x804FA5CC Val_Ws16 1023.984 q0p01562_rad_DIV_s -512.0000 511.9844 FORMAT "%8.4" /end CHARACTERISTIC
/begin CHARACTERISTIC ThrVlv_IfSoftLdgB1_I.ratOffsDecel_C "instance of the interface class softlanding / position offset where deceleration starts" VALUE 0x804FA5CE Val_Ws16 511.9922 rel_q0p0078125 -256.0000 255.9922 FORMAT "%8.4" /end CHARACTERISTIC
/begin CHARACTERISTIC ThrVlv_IfSoftLdgB1_I.ratStrtPosn_C "instance of the interface class softlanding / start position" VALUE 0x804FA5D0 Val_Ws16 511.9922 rel_q0p0078125 -256.0000 255.9922 FORMAT "%8.4" /end CHARACTERISTIC
/begin CHARACTERISTIC ThrVlv_IfSoftLdgB1_I.swtSoftLdgEna_C "instance of the interface class softlanding / enable switch" VALUE 0x804FA5D2 Val_Wu8 1.000 OneToOne 0.00 1.000 FORMAT "%5.3" EXTENDED_LIMITS 0.00 255.0 /end CHARACTERISTIC
/begin CHARACTERISTIC ThrVlv_IfSoftLdgB1_I.tiFilSwtSpdLimSoftLdg_C "instance of the interface class softlanding / time constant filtered switchover of the speed limit" VALUE 0x804FA5D4 Val_Wu16 1.000000 t_q0p001 0.00 1.000000 FORMAT "%8.6" EXTENDED_LIMITS 0.00 65.53500 /end CHARACTERISTIC
/begin CHARACTERISTIC ThrVlv_PosnCtrlB1_I.PreCtrlFacB1_C "Position Controller of the throttle valve of motor bench one / pre-controller parameter" VALUE 0x804FA5E0 Val_Wu16 0.9999847 fak_q1p526Em5 0.00 0.9999847 FORMAT "%9.7" /end CHARACTERISTIC
/begin CHARACTERISTIC ThrVlv_PosnCtrlB1_I.PreCtrlFacB2_C "Position Controller of the throttle valve of motor bench one / pre-controller parameter" VALUE 0x804FA5E2 Val_Wu16 0.9999847 fak_q1p526Em5 0.00 0.9999847 FORMAT "%9.7" /end CHARACTERISTIC
/begin CHARACTERISTIC ThrVlv_PosnCtrlB1_I.PreCtrlFacC1_C "Position Controller of the throttle valve of motor bench one / pre-controller parameter" VALUE 0x804FA5E4 Val_Wu16 0.9999847 fak_q1p526Em5 0.00 0.9999847 FORMAT "%9.7" /end CHARACTERISTIC
/begin CHARACTERISTIC ThrVlv_PosnCtrlB1_I.PreCtrlFacC2_C "Position Controller of the throttle valve of motor bench one / pre-controller parameter" VALUE 0x804FA5E6 Val_Wu16 0.9999847 fak_q1p526Em5 0.00 0.9999847 FORMAT "%9.7" /end CHARACTERISTIC
/begin CHARACTERISTIC ThrVlv_PosnCtrlB1_I.PreCtrlFacD_C "Position Controller of the throttle valve of motor bench one / pre-controller parameter" VALUE 0x804FA5E8 Val_Wu16 1.999939 fak_q3p0518Em5 0.000031 1.999969 FORMAT "%8.6" EXTENDED_LIMITS 0.00 1.999969 /end CHARACTERISTIC
/begin CHARACTERISTIC ThrVlv_PosnCtrlB1_I.PreCtrlFacE_C "Position Controller of the throttle valve of motor bench one / pre-controller parameter" VALUE 0x804FA5EA Val_Ws16 3.999756 spg_q0p000122 -1.999878 1.999878 FORMAT "%8.6" EXTENDED_LIMITS -4.000000 3.999878 /end CHARACTERISTIC
/begin CHARACTERISTIC ThrVlv_PosnCtrlB1_I.dRatActThdSwtOffCtrlDer_C "Position Controller of the throttle valve of motor bench one / threshold of nonlinear filtering of derivative of actual position to switch off derivative part" VALUE 0x804FA5EC Val_Wu16 6553.500 q0p1_Perc_DIV_s 0.00 6553.500 FORMAT "%8.3" /end CHARACTERISTIC
/begin CHARACTERISTIC ThrVlv_PosnCtrlB1_I.dUIntglSldgMod_CUR "Position Controller of the throttle valve of motor bench one / gain of integral part part" CURVE 0x804FA5EE Cur_Xs16Ws16 1638.350 RBPtCel_du_0p05_1 0.00 1638.350 FORMAT "%8.3" EXTENDED_LIMITS -1638.400 1638.350
 /begin AXIS_DESCR STD_AXIS ThrVlv_PosnCtrlB1_I.ratDeCtrlrEndValAbslt rel_q0p0078125 4 -256.0000 255.9922 FORMAT "%8.4" DEPOSIT ABSOLUTE /end AXIS_DESCR
/end CHARACTERISTIC
/begin CHARACTERISTIC ThrVlv_PosnCtrlB1_I.facCnvnIdn_C "Position Controller of the throttle valve of motor bench one / conversion factor between software in electronic control unit and parameter estimation tool" VALUE 0x804FA600 Val_Wu16 65.53500 Fact1000 0.00 65.53500 FORMAT "%8.5" /end CHARACTERISTIC
/begin CHARACTERISTIC ThrVlv_PosnCtrlB1_I.facCtrlDer_C "Position Controller of the throttle valve of motor bench one / gain of derivative part" VALUE 0x804FA602 Val_Wu16 6.553500 RBPtCel_fac_1p0em4_1 0.00 6.553500 FORMAT "%8.6" /end CHARACTERISTIC
/begin CHARACTERISTIC ThrVlv_PosnCtrlB1_I.facCtrlDer_MAP "Position Controller of the throttle valve of motor bench one / gain of derivative part" MAP 0x804FA604 Map_Xs16Ys16Ws16 3.276700 RBPtCel_fac_1p0em4_1 0.00 3.276700 FORMAT "%8.6" EXTENDED_LIMITS -3.276800 3.276700
 /begin AXIS_DESCR STD_AXIS ThrVlv_PosnCtrlB1_I.ratDeCtrlrSdlg rel_q0p0078125 6 -256.0000 255.9922 FORMAT "%8.4" DEPOSIT ABSOLUTE /end AXIS_DESCR
 /begin AXIS_DESCR STD_AXIS ThrVlv_PosnCtrlB1_I.ratActPosnSdlg rel_q0p0078125 6 -256.0000 255.9922 FORMAT "%8.4" DEPOSIT ABSOLUTE /end AXIS_DESCR
/end CHARACTERISTIC
/begin CHARACTERISTIC ThrVlv_PosnCtrlB1_I.facCtrlIntglMin_C "Position Controller of the throttle valve of motor bench one / gain of integral part at small control deviation" VALUE 0x804FA668 Val_Wu16 655.3500 fak_q0p01 0.00 655.3500 FORMAT "%8.4" /end CHARACTERISTIC
/begin CHARACTERISTIC ThrVlv_PosnCtrlB1_I.facCtrlIntglSlowTrj_C "Position Controller of the throttle valve of motor bench one / gain of integral part at slow trajectory" VALUE 0x804FA66A Val_Wu16 655.3500 fak_q0p01 0.00 655.3500 FORMAT "%8.4" /end CHARACTERISTIC
/begin CHARACTERISTIC ThrVlv_PosnCtrlB1_I.facCtrlIntgl_C "Position Controller of the throttle valve of motor bench one / gain of i part" VALUE 0x804FA66C Val_Wu16 655.3500 fak_q0p01 0.00 655.3500 FORMAT "%8.4" /end CHARACTERISTIC
/begin CHARACTERISTIC ThrVlv_PosnCtrlB1_I.facCtrlIntgl_MAP "Position Controller of the throttle valve of motor bench one / gain of integral part part" MAP 0x804FA66E Map_Xs16Ys16Ws16 327.6700 fak_q0p01 0.00 327.6700 FORMAT "%8.4" EXTENDED_LIMITS -327.6800 327.6700
 /begin AXIS_DESCR STD_AXIS ThrVlv_PosnCtrlB1_I.ratDeCtrlrSdlg rel_q0p0078125 6 -256.0000 255.9922 FORMAT "%8.4" DEPOSIT ABSOLUTE /end AXIS_DESCR
 /begin AXIS_DESCR STD_AXIS ThrVlv_PosnCtrlB1_I.ratActPosnSdlg rel_q0p0078125 6 -256.0000 255.9922 FORMAT "%8.4" DEPOSIT ABSOLUTE /end AXIS_DESCR
/end CHARACTERISTIC
/begin CHARACTERISTIC ThrVlv_PosnCtrlB1_I.facCtrlK_C "Position Controller of the throttle valve of motor bench one / loop gain" VALUE 0x804FA6D2 Val_Wu16 1.999969 fak_q3p0518Em5 0.00 1.999969 FORMAT "%8.6" /end CHARACTERISTIC
/begin CHARACTERISTIC ThrVlv_PosnCtrlB1_I.facCtrlPropSlowTrj_C "Position Controller of the throttle valve of motor bench one / gain of proportional part at slow trajectory" VALUE 0x804FA6D4 Val_Wu16 655.3500 fak_q0p01 0.00 655.3500 FORMAT "%8.4" /end CHARACTERISTIC
/begin CHARACTERISTIC ThrVlv_PosnCtrlB1_I.facCtrlProp_C "Position Controller of the throttle valve of motor bench one / gain of proportional part" VALUE 0x804FA6D6 Val_Wu16 655.3500 fak_q0p01 0.00 655.3500 FORMAT "%8.4" /end CHARACTERISTIC
/begin CHARACTERISTIC ThrVlv_PosnCtrlB1_I.facCtrlProp_MAP "Position Controller of the throttle valve of motor bench one / gain of proportional part" MAP 0x804FA6D8 Map_Xs16Ys16Ws16 327.6700 fak_q0p01 0.00 327.6700 FORMAT "%8.4" EXTENDED_LIMITS -327.6800 327.6700
 /begin AXIS_DESCR STD_AXIS ThrVlv_PosnCtrlB1_I.ratDeCtrlrSdlg rel_q0p0078125 6 -256.0000 255.9922 FORMAT "%8.4" DEPOSIT ABSOLUTE /end AXIS_DESCR
 /begin AXIS_DESCR STD_AXIS ThrVlv_PosnCtrlB1_I.ratActPosnSdlg rel_q0p0078125 6 -256.0000 255.9922 FORMAT "%8.4" DEPOSIT ABSOLUTE /end AXIS_DESCR
/end CHARACTERISTIC
/begin CHARACTERISTIC ThrVlv_PosnCtrlB1_I.facCtrlSldgMod_CUR "Position Controller of the throttle valve of motor bench one / gain of the proportional derivative controller" CURVE 0x804FA73C Cur_Xs16Ws16 65.53500 Fact1000 -32.76800 32.76700 FORMAT "%8.5"
 /begin AXIS_DESCR STD_AXIS NO_INPUT_QUANTITY q0p1_Perc_DIV_s 2 -3276.800 3276.700 FORMAT "%8.3" DEPOSIT ABSOLUTE /end AXIS_DESCR
/end CHARACTERISTIC
/begin CHARACTERISTIC ThrVlv_PosnCtrlB1_I.facDly_C "Position Controller of the throttle valve of motor bench one / Factor for the delay part of the proportional proportional with lag" VALUE 0x804FA746 Val_Wu16 1.000000 Fact1000 0.00 1.000000 FORMAT "%8.6" EXTENDED_LIMITS 0.00 65.53500 /end CHARACTERISTIC
/begin CHARACTERISTIC ThrVlv_PosnCtrlB1_I.facElecMotIndtCmp_CUR "Position Controller of the throttle valve of motor bench one / compensation of induction voltage" CURVE 0x804FA748 Cur_Xs16Ws16 6.553500 RBPtCel_fac_1p0em4_1 -3.276800 3.276700 FORMAT "%8.6"
 /begin AXIS_DESCR STD_AXIS NO_INPUT_QUANTITY q0p1_Perc_DIV_s 4 -3276.800 3276.700 FORMAT "%8.3" DEPOSIT ABSOLUTE /end AXIS_DESCR
/end CHARACTERISTIC
/begin CHARACTERISTIC ThrVlv_PosnCtrlB1_I.facGainSldgSfcCubic_CUR "Position Controller of the throttle valve of motor bench one / weighting factor of the sliding surface cubic part" CURVE 0x804FA75A Cur_Xs16Ws16 0.3276700 RBPtCel_fac_0p00001_1 0.00 0.3276700 FORMAT "%9.7" EXTENDED_LIMITS -0.3276800 0.3276700
 /begin AXIS_DESCR STD_AXIS NO_INPUT_QUANTITY rel_q0p0078125 2 -256.0000 255.9922 FORMAT "%8.4" DEPOSIT ABSOLUTE /end AXIS_DESCR
/end CHARACTERISTIC
/begin CHARACTERISTIC ThrVlv_PosnCtrlB1_I.facGainSldgSfcSqrt_C "Position Controller of the throttle valve of motor bench one / weighting factor Sliding Surface square root part" VALUE 0x804FA764 Val_Wu16 655.3500 fak_q0p01 0.00 655.3500 FORMAT "%8.4" /end CHARACTERISTIC
/begin CHARACTERISTIC ThrVlv_PosnCtrlB1_I.facWghtSignIntglSldgMod_C "Position Controller of the throttle valve of motor bench one / weighting factor sign of sliding surface" VALUE 0x804FA766 Val_Ws16 655.3500 fak_q0p01 -327.6800 327.6700 FORMAT "%8.4" /end CHARACTERISTIC
/begin CHARACTERISTIC ThrVlv_PosnCtrlB1_I.nrFbCtrlSdlg_C "Position Controller of the throttle valve of motor bench one / selection of the method for scheduling of the controller" VALUE 0x804FA768 Val_Wu8 1.000 OneToOne 1.000 2.000 FORMAT "%5.3" EXTENDED_LIMITS 0.00 255.0 /end CHARACTERISTIC
/begin CHARACTERISTIC ThrVlv_PosnCtrlB1_I.nrMethDerCalcn_C "Position Controller of the throttle valve of motor bench one / selection of the method for derivative calculation" VALUE 0x804FA769 Val_Wu8 2.000 OneToOne 1.000 3.000 FORMAT "%5.3" EXTENDED_LIMITS 0.00 255.0 /end CHARACTERISTIC
/begin CHARACTERISTIC ThrVlv_PosnCtrlB1_I.ratActThdIntglRst_C "Position Controller of the throttle valve of motor bench one / position threshold for reset of the integrator" VALUE 0x804FA76A Val_Ws16 511.9922 rel_q0p0078125 -256.0000 255.9922 FORMAT "%8.4" /end CHARACTERISTIC
/begin CHARACTERISTIC ThrVlv_PosnCtrlB1_I.ratDeCtrlrThdIntglRst_C "Position Controller of the throttle valve of motor bench one / control deviation threshold for reset of the integrator" VALUE 0x804FA76C Val_Ws16 511.9922 rel_q0p0078125 -256.0000 255.9922 FORMAT "%8.4" /end CHARACTERISTIC
/begin CHARACTERISTIC ThrVlv_PosnCtrlB1_I.ratDeCtrlrThdSlowTrj_C "Position Controller of the throttle valve of motor bench one / threshold of the absolute control deviation for slow trajectory" VALUE 0x804FA76E Val_Ws16 511.9922 rel_q0p0078125 -256.0000 255.9922 FORMAT "%8.4" /end CHARACTERISTIC
/begin CHARACTERISTIC ThrVlv_PosnCtrlB1_I.ratDeCtrlrThdSwtOffCtrlStaty_C "Position Controller of the throttle valve of motor bench one / threshold of absolute control deviation to switch parts of the controller off" VALUE 0x804FA770 Val_Ws16 511.9922 rel_q0p0078125 -256.0000 255.9922 FORMAT "%8.4" /end CHARACTERISTIC
/begin CHARACTERISTIC ThrVlv_PosnCtrlB1_I.ratDesPstDrv_C "Position Controller of the throttle valve of motor bench one / desired value in post drive" VALUE 0x804FA772 Val_Ws16 511.9922 rel_q0p0078125 -256.0000 255.9922 FORMAT "%8.4" /end CHARACTERISTIC
/begin CHARACTERISTIC ThrVlv_PosnCtrlB1_I.ratDftlThdSlowTrj_C "Position Controller of the throttle valve of motor bench one / threshold for the gradient of the trajectory to detect a slow trajectory" VALUE 0x804FA774 Val_Ws32 199.999984741 fak_q1p526Em5 -100.000000000 99.999984741 FORMAT "%13.9" EXTENDED_LIMITS -32768.0000000 32767.9999847 /end CHARACTERISTIC
/begin CHARACTERISTIC ThrVlv_PosnCtrlB1_I.ratDutyCycMax_C "Position Controller of the throttle valve of motor bench one / upper limit for the duty cycle" VALUE 0x804FA778 Val_Ws16 511.9922 rel_q0p0078125 -256.0000 255.9922 FORMAT "%8.4" /end CHARACTERISTIC
/begin CHARACTERISTIC ThrVlv_PosnCtrlB1_I.ratDutyCycMin_C "Position Controller of the throttle valve of motor bench one / lower limit for the duty cycle" VALUE 0x804FA77A Val_Ws16 511.9922 rel_q0p0078125 -256.0000 255.9922 FORMAT "%8.4" /end CHARACTERISTIC
/begin CHARACTERISTIC ThrVlv_PosnCtrlB1_I.ratGear_C "Position Controller of the throttle valve of motor bench one / gear box ratio" VALUE 0x804FA77C Val_Wu16 127.9980 fak_q0p00195 0.00 127.9980 FORMAT "%8.4" /end CHARACTERISTIC
/begin CHARACTERISTIC ThrVlv_PosnCtrlB1_I.ratLrgDeltaSpIntglRst_C "Position Controller of the throttle valve of motor bench one / setpoint change for integral part reset" VALUE 0x804FA77E Val_Ws16 511.9922 rel_q0p0078125 -256.0000 255.9922 FORMAT "%8.4" /end CHARACTERISTIC
/begin CHARACTERISTIC ThrVlv_PosnCtrlB1_I.ratOffsDutyCycMax_C "Position Controller of the throttle valve of motor bench one / maximum duty cycle at offset learning" VALUE 0x804FA780 Val_Ws16 511.9922 rel_q0p0078125 -256.0000 255.9922 FORMAT "%8.4" /end CHARACTERISTIC
/begin CHARACTERISTIC ThrVlv_PosnCtrlB1_I.ratOffsDutyCycMin_C "Position Controller of the throttle valve of motor bench one / minimum duty cycle at offset learning" VALUE 0x804FA782 Val_Ws16 511.9922 rel_q0p0078125 -256.0000 255.9922 FORMAT "%8.4" /end CHARACTERISTIC
/begin CHARACTERISTIC ThrVlv_PosnCtrlB1_I.ratSmallDeltaSpIntglRst_C "Position Controller of the throttle valve of motor bench one / setpoint change for integral part reset" VALUE 0x804FA784 Val_Ws16 511.9922 rel_q0p0078125 -256.0000 255.9922 FORMAT "%8.4" /end CHARACTERISTIC
/begin CHARACTERISTIC ThrVlv_PosnCtrlB1_I.swtCtrlDerActPosn_C "Position Controller of the throttle valve of motor bench one / activation of the derivative part based on the actual position" VALUE 0x804FA786 Val_Wu8 1.000 OneToOne 0.00 1.000 FORMAT "%5.3" EXTENDED_LIMITS 0.00 255.0 /end CHARACTERISTIC
/begin CHARACTERISTIC ThrVlv_PosnCtrlB1_I.swtNLFF_C "Position Controller of the throttle valve of motor bench one / activate nonlinear feedforward" VALUE 0x804FA787 Val_Wu8 1.000 OneToOne 0.00 1.000 FORMAT "%5.3" EXTENDED_LIMITS 0.00 255.0 /end CHARACTERISTIC
/begin CHARACTERISTIC ThrVlv_PosnCtrlB1_I.swtOffDRatActSldgModStaty_C "Position Controller of the throttle valve of motor bench one / release switch stationary switch off of derivative part" VALUE 0x804FA788 Val_Wu8 1.000 OneToOne 0.00 1.000 FORMAT "%5.3" EXTENDED_LIMITS 0.00 255.0 /end CHARACTERISTIC
/begin CHARACTERISTIC ThrVlv_PosnCtrlB1_I.swtOffIntglSldgModStaty_C "Position Controller of the throttle valve of motor bench one / release switch stationary switch off of integral part" VALUE 0x804FA789 Val_Wu8 1.000 OneToOne 0.00 1.000 FORMAT "%5.3" EXTENDED_LIMITS 0.00 255.0 /end CHARACTERISTIC
/begin CHARACTERISTIC ThrVlv_PosnCtrlB1_I.swtPidCtrlEna_C "Position Controller of the throttle valve of motor bench one / usage of proportional integral derivative controller" VALUE 0x804FA78A Val_Wu8 1.000 OneToOne 0.00 1.000 FORMAT "%5.3" EXTENDED_LIMITS 0.00 255.0 /end CHARACTERISTIC
/begin CHARACTERISTIC ThrVlv_PosnCtrlB1_I.swtTrjAdpnDurgSatn_C "Position Controller of the throttle valve of motor bench one / release switch" VALUE 0x804FA78B Val_Wu8 1.000 OneToOne 0.00 1.000 FORMAT "%5.3" EXTENDED_LIMITS 0.00 255.0 /end CHARACTERISTIC
/begin CHARACTERISTIC ThrVlv_PosnCtrlB1_I.tiCtrlDerFil_C "Position Controller of the throttle valve of motor bench one / time constant low pass filter derivative part" VALUE 0x804FA78C Val_Wu16 6.553500 q1Em4_s 0.00 6.553500 FORMAT "%8.6" /end CHARACTERISTIC
/begin CHARACTERISTIC ThrVlv_PosnCtrlB1_I.tiDebOpenLoad_C "Position Controller of the throttle valve of motor bench one / debounce time for open load diagnosis" VALUE 0x804FA78E Val_Wu16 33.55392 RBPtCel_ti_5p12em4_1 0.00 33.55392 FORMAT "%8.5" /end CHARACTERISTIC
/begin CHARACTERISTIC ThrVlv_PosnCtrlB1_I.tiFilDRatAct_C "Position Controller of the throttle valve of motor bench one / filter time constant" VALUE 0x804FA790 Val_Wu16 1.000000 t_q0p001 0.00 1.000000 FORMAT "%8.6" EXTENDED_LIMITS 0.00 65.53500 /end CHARACTERISTIC
/begin CHARACTERISTIC ThrVlv_PosnCtrlB1_I.tiFilElecMotIndtCmp_C "Position Controller of the throttle valve of motor bench one / filter time constant compensation of induction voltage" VALUE 0x804FA792 Val_Wu16 6.553500 q1Em4_s 0.00 6.553500 FORMAT "%8.6" /end CHARACTERISTIC
/begin CHARACTERISTIC ThrVlv_PosnCtrlB1_I.tiFilSwtPreCtrl_C "Position Controller of the throttle valve of motor bench one / filter time constant for switching between filter times of the feed forward" VALUE 0x804FA794 Val_Wu16 1.000000 t_q0p001 0.00 1.000000 FORMAT "%8.6" EXTENDED_LIMITS 0.00 65.53500 /end CHARACTERISTIC
/begin CHARACTERISTIC ThrVlv_PosnCtrlB1_I.tiFricDwn_C "Position Controller of the throttle valve of motor bench one / time constant for friciton model" VALUE 0x804FA796 Val_Wu16 65.53400 t_q0p001 0.00100 65.53500 FORMAT "%8.5" EXTENDED_LIMITS 0.00 65.53500 /end CHARACTERISTIC
/begin CHARACTERISTIC ThrVlv_PosnCtrlB1_I.tiFricUp_C "Position Controller of the throttle valve of motor bench one / time constant for friciton model" VALUE 0x804FA798 Val_Wu16 65.53400 t_q0p001 0.00100 65.53500 FORMAT "%8.5" EXTENDED_LIMITS 0.00 65.53500 /end CHARACTERISTIC
/begin CHARACTERISTIC ThrVlv_PosnCtrlB1_I.tiPPT1_CUR "Position Controller of the throttle valve of motor bench one / curve time constant of proportional proportional with lag" CURVE 0x804FA79A Cur_Xs16Ws16 1.000000 t_q0p001 0.00 1.000000 FORMAT "%8.6" EXTENDED_LIMITS -32.76800 32.76700
 /begin AXIS_DESCR STD_AXIS ThrVlv_PosnCtrlB1_I.ratDeCtrlrEndValAbslt rel_q0p0078125 3 0.00 255.9922 FORMAT "%8.4" EXTENDED_LIMITS -256.0000 255.9922 DEPOSIT ABSOLUTE /end AXIS_DESCR
/end CHARACTERISTIC
/begin CHARACTERISTIC ThrVlv_PosnCtrlB1_I.tiPreCtrlGrdtBasd_CUR "Position Controller of the throttle valve of motor bench one / gradient based filter time feedforward" CURVE 0x804FA7A8 Cur_Xs16Ws16 0.2988281 t_tev0p0005 0.0014648 0.3002930 FORMAT "%9.7" EXTENDED_LIMITS -16.00000 15.99951
 /begin AXIS_DESCR STD_AXIS ThrVlv_PosnCtrlB1_I.dRatDesPreCtrlGrdt relgrd_q7p8125 6 -256000.0 255992.2 FORMAT "%8.1" DEPOSIT ABSOLUTE /end AXIS_DESCR
/end CHARACTERISTIC
/begin CHARACTERISTIC ThrVlv_PosnCtrlB1_I.tiSdlFacCtrl_C "Position Controller of the throttle valve of motor bench one / time constant for scheduling of controller parameters" VALUE 0x804FA7C2 Val_Ws16 32.76700 t_q0p001 0.00 32.76700 FORMAT "%8.5" EXTENDED_LIMITS -32.76800 32.76700 /end CHARACTERISTIC
/begin CHARACTERISTIC ThrVlv_PosnCtrlB1_I.tiSldgSfcDer_C "Position Controller of the throttle valve of motor bench one / time constant to weight the velocity dependent part of the Sliding Surface" VALUE 0x804FA7C4 Val_Wu16 65.53500 t_q0p001 0.00 65.53500 FORMAT "%8.5" /end CHARACTERISTIC
/begin CHARACTERISTIC ThrVlv_PosnCtrlB1_I.tiSlowTrjCdn_C "Position Controller of the throttle valve of motor bench one / debounce time for detection of a slow trajectory" VALUE 0x804FA7C6 Val_Wu16 33.55392 RBPtCel_ti_5p12em4_1 0.00 33.55392 FORMAT "%8.5" /end CHARACTERISTIC
/begin CHARACTERISTIC ThrVlv_PosnCtrlB1_I.tiSwtOffCtrlStaty_C "Position Controller of the throttle valve of motor bench one / debounce time for switch off of the derivative part" VALUE 0x804FA7C8 Val_Wu16 33.55392 RBPtCel_ti_5p12em4_1 0.00 33.55392 FORMAT "%8.5" /end CHARACTERISTIC
/begin CHARACTERISTIC ThrVlv_PosnCtrlB1_I.uCtrlIntglRst_C "Position Controller of the throttle valve of motor bench one / voltage integral part reset value" VALUE 0x804FA7CC Val_Ws32 1279.99999970 q2p98023Em7_V -640.000000000 639.999999702 FORMAT "%13.9" /end CHARACTERISTIC
/begin CHARACTERISTIC ThrVlv_PosnCtrlB1_I.uFricCmp_C "Position Controller of the throttle valve of motor bench one / voltage friction compensator" VALUE 0x804FA7D0 Val_Ws16 65.53500 spg_q0p001 -32.76800 32.76700 FORMAT "%8.5" /end CHARACTERISTIC
/begin CHARACTERISTIC ThrVlv_PosnCtrlB1_I.uInpDsbc_C "Position Controller of the throttle valve of motor bench one / voltage input disturbance controller test" VALUE 0x804FA7D2 Val_Ws16 65.53500 spg_q0p001 -32.76800 32.76700 FORMAT "%8.5" /end CHARACTERISTIC
/begin CHARACTERISTIC ThrVlv_PosnCtrlB1_I.uSprgCmp_CUR "Position Controller of the throttle valve of motor bench one / spring compensation" CURVE 0x804FA7D4 Cur_Xs16Ws16 65.53500 spg_q0p001 -32.76800 32.76700 FORMAT "%8.5"
 /begin AXIS_DESCR STD_AXIS NO_INPUT_QUANTITY rel_q0p0078125 5 -256.0000 255.9922 FORMAT "%8.4" DEPOSIT ABSOLUTE /end AXIS_DESCR
/end CHARACTERISTIC
/begin CHARACTERISTIC ThrVlv_ratDesCalcB1_C "Calibration value to define setpoint manually" VALUE 0x804FA578 Val_Ws16 511.9922 rel_q0p0078125 -256.0000 255.9922 FORMAT "%8.4" /end CHARACTERISTIC
/begin CHARACTERISTIC ThrVlv_Sens_B1_I.ratActCharThdMax_C "Class instance from AirActr_Sens / Maximal characteristic angle threshold in a defined driving cycle" VALUE 0x804FA844 Val_Ws16 511.9922 rel_q0p0078125 -256.0000 255.9922 FORMAT "%8.4" /end CHARACTERISTIC
/begin CHARACTERISTIC ThrVlv_Sens_B1_I.ratActCharThdMin_C "Class instance from AirActr_Sens / Minimal characteristic angle threshold in a defined driving cycle" VALUE 0x804FA846 Val_Ws16 511.9922 rel_q0p0078125 -256.0000 255.9922 FORMAT "%8.4" /end CHARACTERISTIC
/begin CHARACTERISTIC ThrVlv_Sens_B1_I.ratLimpHomePosn_C "Class instance from AirActr_Sens / Replacement angle in case of total sensor error" VALUE 0x804FA848 Val_Ws16 511.9922 rel_q0p0078125 -256.0000 255.9922 FORMAT "%8.4" /end CHARACTERISTIC
/begin CHARACTERISTIC ThrVlv_Sens_B1_I.swtNrmActrChar_C "Class instance from AirActr_Sens / Parameter for normalizing of the sensor characteristic curve" VALUE 0x804FA84A Val_Wu8 1.000 OneToOne 0.00 1.000 FORMAT "%5.3" EXTENDED_LIMITS 0.00 255.0 /end CHARACTERISTIC
/begin CHARACTERISTIC ThrVlv_Sens_B1_I.tiDebCycFlg_C "Class instance from AirActr_Sens / Debounce time for setting of the cycle flag" VALUE 0x804FA84B Val_Wu8 2.550 t10msxs_ub_b2p55 0.00 2.550 FORMAT "%5.3" /end CHARACTERISTIC
/begin CHARACTERISTIC ThrVlv_Sens_B1_I.tiDebSens1Err_C "Class instance from AirActr_Sens / Debounce time: Sensor 1 error" VALUE 0x804FA84C Val_Wu8 2.550 t10msxs_ub_b2p55 0.00 2.550 FORMAT "%5.3" /end CHARACTERISTIC
/begin CHARACTERISTIC ThrVlv_Sens_B1_I.uSens1Max_C "Class instance from AirActr_Sens / Upper diagnosis threshold sensor 1" VALUE 0x804FA84E Val_Wu16 79.99878 spg_q1p221Em3_V 0.00 79.99878 FORMAT "%8.5" /end CHARACTERISTIC
/begin CHARACTERISTIC ThrVlv_Sens_B1_I.uSens1Min_C "Class instance from AirActr_Sens / Lower diagnosis threshold sensor 1" VALUE 0x804FA850 Val_Wu16 79.99878 spg_q1p221Em3_V 0.00 79.99878 FORMAT "%8.5" /end CHARACTERISTIC
/begin CHARACTERISTIC ThrVlv_stActrCfg_C "Codeword for configuration of the actuator" VALUE 0x8053B642 Val_Wu8 255.0 OneToOne 0.00 255.0 FORMAT "%5.1" /end CHARACTERISTIC
/begin CHARACTERISTIC ThrVlv_stPsIfCfgB1_C "PsIf configuration codeword" VALUE 0x804FA7EC Val_Wu8 255.0 OneToOne 0.00 255.0 FORMAT "%5.1" /end CHARACTERISTIC
/begin CHARACTERISTIC ThrVlv_stPwrStgEnaCdnMask_C "Mask for power stage enable condition used for disabling power stage after flashing" VALUE 0x804FA7EE Val_Wu16 65535.00 OneToOne 0.00 65535.00 FORMAT "%8.2" /end CHARACTERISTIC
/begin CHARACTERISTIC ThrVlv_swtDesCalcB1_C "switch for desired value for calibration of throttle valve motor bench 1" VALUE 0x804FA57A Val_Wu8 1.000 OneToOne 0.00 1.000 FORMAT "%5.3" EXTENDED_LIMITS 0.00 255.0 /end CHARACTERISTIC
/begin CHARACTERISTIC ThrVlv_tiClrSc_C "Debounce time for clearing of a short circuit error reported by the core SW" VALUE 0x804FA7F0 Val_Wu8 2.550 t10msxs_ub_b2p55 0.00 2.550 FORMAT "%5.3" /end CHARACTERISTIC
/begin CHARACTERISTIC ThrVlv_tiSetOutPerdB1_C "Cyclic period duration for the control line bank 1" VALUE 0x804FA7F4 Val_Wu32 4294967294.00 Per_Dur 1.00 4294967295.00 FORMAT "%13.2" EXTENDED_LIMITS 0.00 4294967295.00 /end CHARACTERISTIC
/begin CHARACTERISTIC TiEngOffBasc_CW "Codeword reset of engine off time in EngReStrt task" VALUE 0x80536080 RB_Val_Wu8 255.0 OneToOne 0.00 255.0 FORMAT "%5.1" /end CHARACTERISTIC
/begin CHARACTERISTIC TiEngOff_tiBEngTmrRstDeb_C "Holding tiime for TiEngOff_bRst after detection of engine stall" VALUE 0x80536084 RB_Val_Ws32 4294967.29500 t_q0p001 -2147483.64800 2147483.64700 FORMAT "%13.5" /end CHARACTERISTIC
/begin CHARACTERISTIC TiEngOff_tiEngRotDeb_C "Holding time from Epm_stSpd to TiEngOff_bEngRot." VALUE 0x80536088 RB_Val_Ws32 4294967.29500 t_q0p001 -2147483.64800 2147483.64700 FORMAT "%13.5" /end CHARACTERISTIC
/begin CHARACTERISTIC TiEngOn_cfgRtId.RtId_TotIdleRt_C " / Configuration of Runtime RtId_TotIdleRt" VALUE 0x80535F76 Val_Wu8 255.0 OneToOne 0.00 255.0 FORMAT "%5.1" /end CHARACTERISTIC
/begin CHARACTERISTIC TiEngOn_cfgRtId.RtId_TotPtoRt_C " / Configuration of Runtime RtId_TotPtoRt" VALUE 0x80535F77 Val_Wu8 255.0 OneToOne 0.00 255.0 FORMAT "%5.1" /end CHARACTERISTIC
/begin CHARACTERISTIC TiEngOn_cfgRtId.RtId_TotRtObd_C " / Configuration of Runtime RtId_TotRtObd" VALUE 0x80535F78 Val_Wu8 255.0 OneToOne 0.00 255.0 FORMAT "%5.1" /end CHARACTERISTIC
/begin CHARACTERISTIC TiEngOn_nIdleSpdPrmId7F_C "Engine speed that represents a running engine based on OBD definition" VALUE 0x80535F7A RB_Val_Ws16 16383.50 EngN 0.00 16383.50 FORMAT "%8.2" EXTENDED_LIMITS -16384.00 16383.50 /end CHARACTERISTIC
/begin CHARACTERISTIC TiEngOn_swtCfgPrmId7F_C "Configuration parameter for TiEngOn_PrmId7F" VALUE 0x80535F7C RB_Val_Wu8 255.0 OneToOne 0.00 255.0 FORMAT "%5.1" /end CHARACTERISTIC
/begin CHARACTERISTIC TiOff_bStrtEndOffRstDeb_C "Debounce time for reset bit of start end off time" VALUE 0x80536094 RB_Val_Wu16 655.3500 t_q0p01 0.00 655.3500 FORMAT "%8.4" /end CHARACTERISTIC
/begin CHARACTERISTIC TiOff_ratCoolDwnTBasdChkFastMax_C "maximum ratio of current cool down compared to last T15-off-event to release fast check" VALUE 0x80535FA0 RB_Val_Wu16 1.000000 fak_q0p000488 0.00 1.000000 FORMAT "%8.6" EXTENDED_LIMITS 0.00 31.99951 /end CHARACTERISTIC
/begin CHARACTERISTIC TiOff_ratCoolDwnTBasdChkFastMin_C "minimum ratio of current cool down compared to last T15-off-event to release fast check" VALUE 0x80535FA2 RB_Val_Wu16 1.000000 fak_q0p000488 0.00 1.000000 FORMAT "%8.6" EXTENDED_LIMITS 0.00 31.99951 /end CHARACTERISTIC
/begin CHARACTERISTIC TiOff_ratCoolDwnTBasdChkSlowMax_C "maximum ratio of current cool down compared to last T15-off-event to release slow check" VALUE 0x80535FA4 RB_Val_Wu16 1.000000 fak_q0p000488 0.00 1.000000 FORMAT "%8.6" EXTENDED_LIMITS 0.00 31.99951 /end CHARACTERISTIC
/begin CHARACTERISTIC TiOff_ratCoolDwnTBasdChkSlowMin_C "minimum ratio of current cool down compared to last T15-off-event to release slow check" VALUE 0x80535FA6 RB_Val_Wu16 1.000000 fak_q0p000488 0.00 1.000000 FORMAT "%8.6" EXTENDED_LIMITS 0.00 31.99951 /end CHARACTERISTIC
/begin CHARACTERISTIC TiOff_stCfgTBasdChk_C "code word to configure Temperature based check features" VALUE 0x80535FA8 RB_Val_Wu8 255.0 OneToOne 0.00 255.0 FORMAT "%5.1" /end CHARACTERISTIC
/begin CHARACTERISTIC TiOff_stClkIntCfg_CW "Codeword to configure TiOff_VdClk" VALUE 0x80535F80 RB_Val_Wu8 255.0 OneToOne 0.00 255.0 FORMAT "%5.1" /end CHARACTERISTIC
/begin CHARACTERISTIC TiOff_stTestClk_CW "Codewort for testconfiguration of TiOff_VdClk" VALUE 0x80535F81 RB_Val_Wu8 255.0 OneToOne 0.00 255.0 FORMAT "%5.1" /end CHARACTERISTIC
/begin CHARACTERISTIC TiOff_stTiEngOffDef_C "Default value for engine off time" VALUE 0x8053608C RB_Val_Wu8 255.0 OneToOne 0.00 255.0 FORMAT "%5.1" /end CHARACTERISTIC
/begin CHARACTERISTIC TiOff_stTiEngOffHwOvf_C "Default value for status of engine off time in case of overflow of HW-clock" VALUE 0x8053608D RB_Val_Wu8 2.000 OneToOne 1.000 3.000 FORMAT "%5.3" EXTENDED_LIMITS 0.00 255.0 /end CHARACTERISTIC
/begin CHARACTERISTIC TiOff_stTiEngOff_CW "Codeword to configure TiOff_VdTiEngOff" VALUE 0x8053608E RB_Val_Wu8 255.0 OneToOne 0.00 255.0 FORMAT "%5.1" /end CHARACTERISTIC
/begin CHARACTERISTIC TiOff_stTiStrtEndOffDef_C "Defaultvalue of start-end time" VALUE 0x80536096 RB_Val_Wu8 255.0 OneToOne 0.00 255.0 FORMAT "%5.1" /end CHARACTERISTIC
/begin CHARACTERISTIC TiOff_stTiStrtEndOffHwOvf_C "Default value of the start- end time with overflow" VALUE 0x80536097 RB_Val_Wu8 2.000 OneToOne 1.000 3.000 FORMAT "%5.3" EXTENDED_LIMITS 0.00 255.0 /end CHARACTERISTIC
/begin CHARACTERISTIC TiOff_stTiStrtEndOff_CW "Codeword to configure TiOff_VdTiStrtEndOff" VALUE 0x80536098 RB_Val_Wu8 255.0 OneToOne 0.00 255.0 FORMAT "%5.1" /end CHARACTERISTIC
/begin CHARACTERISTIC TiOff_tCEngDsTT15StopTBasdChkFastMin_C "minimum engine coolant temperature at last T15-off-event to enable the fast check" VALUE 0x80535FAA RB_Val_Ws16 6553.500 Temp_Cels -3549.940 3003.560 FORMAT "%8.3" /end CHARACTERISTIC
/begin CHARACTERISTIC TiOff_tCEngDsTT15StopTBasdChkSlowMin_C "minimum engine coolant temperature at last T15-off-event to enable the slow check" VALUE 0x80535FAC RB_Val_Ws16 6553.500 Temp_Cels -3549.940 3003.560 FORMAT "%8.3" /end CHARACTERISTIC
/begin CHARACTERISTIC TiOff_tDiffCEngDsTPsblTBasdChkFastMin_C "minimum limit for possible cool down of the coolant temperature wihtin the last T15-off-phase to enable the fast check" VALUE 0x80535FAE RB_Val_Ws16 6553.500 TempDiff_Kelv -3276.800 3276.700 FORMAT "%8.3" /end CHARACTERISTIC
/begin CHARACTERISTIC TiOff_tDiffCEngDsTPsblTBasdChkSlowMin_C "minimum limit for possible cool down of the coolant temperature wihtin the last T15-off-phase to enable the slow check" VALUE 0x80535FB0 RB_Val_Ws16 6553.500 TempDiff_Kelv -3276.800 3276.700 FORMAT "%8.3" /end CHARACTERISTIC
/begin CHARACTERISTIC TiOff_tDiffCEngDsTTBasdChkFastMax_C "maximum cool down of the engine coolant temperature within the last T15-off-phase to enable the fast check" VALUE 0x80535FB2 RB_Val_Ws16 6553.500 TempDiff_Kelv -3276.800 3276.700 FORMAT "%8.3" /end CHARACTERISTIC
/begin CHARACTERISTIC TiOff_tDiffCEngDsTTBasdChkSlowMin_C "minimum cool down of the engine coolant temperature within the last T15-off-phase to enable the slow check" VALUE 0x80535FB4 RB_Val_Ws16 6553.500 TempDiff_Kelv -3276.800 3276.700 FORMAT "%8.3" /end CHARACTERISTIC
/begin CHARACTERISTIC TiOff_tiBTiHwClkRst_C "Duration of Bit TiOff_bTiHwClkRst = TRUE after a reset of TiOff_tiHwClkLoc to 0" VALUE 0x80535F84 RB_Val_Ws32 2147483647.00 Time_sec_q1_COMPU 0.00 2147483647.00 FORMAT "%13.2" EXTENDED_LIMITS -2147483648.00 2147483647.00 /end CHARACTERISTIC
/begin CHARACTERISTIC TiOff_tiClkStopTst_C "testvalue for TiOff_tiHwClkStop in test mode" VALUE 0x80535F88 RB_Val_Ws32 4294967295.00 Time_sec_q1_COMPU -2147483648.00 2147483647.00 FORMAT "%13.2" /end CHARACTERISTIC
/begin CHARACTERISTIC TiOff_tiClkTst_C "Testvalue within TiOff_VdClk" VALUE 0x80535F8C RB_Val_Ws32 4294967295.00 Time_sec_q1_COMPU -2147483648.00 2147483647.00 FORMAT "%13.2" /end CHARACTERISTIC
/begin CHARACTERISTIC TiOff_tiEcuOffIntMax_C "maximum value off ECU-off-time" VALUE 0x80535F90 RB_Val_Ws32 4294967295.00 Time_sec_q1_COMPU -2147483648.00 2147483647.00 FORMAT "%13.2" /end CHARACTERISTIC
/begin CHARACTERISTIC TiOff_tiEcuOffTst_C "Testvalue for SyC_tiEcuOff in testmode" VALUE 0x80535F94 RB_Val_Ws32 4294967295.00 Time_sec_q1_COMPU -2147483648.00 2147483647.00 FORMAT "%13.2" /end CHARACTERISTIC
/begin CHARACTERISTIC TiOff_tiEngOffDef_C "Default value of engine off time" VALUE 0x80536090 RB_Val_Ws32 2147483647.00 Time_sec_q1_COMPU 0.00 2147483647.00 FORMAT "%13.2" EXTENDED_LIMITS -2147483648.00 2147483647.00 /end CHARACTERISTIC
/begin CHARACTERISTIC TiOff_tiHwClkAddWakeup_C "time after reset of the generalized HW clock" VALUE 0x80535F98 RB_Val_Ws32 2147483647.00 Time_sec_q1_COMPU 0.00 2147483647.00 FORMAT "%13.2" EXTENDED_LIMITS -2147483648.00 2147483647.00 /end CHARACTERISTIC
/begin CHARACTERISTIC TiOff_tiHwClkMax_C "maximum time which shall be defined TiOff_tiHwClkLoc" VALUE 0x80535F9C RB_Val_Ws32 2147483647.00 Time_sec_q1_COMPU 0.00 2147483647.00 FORMAT "%13.2" EXTENDED_LIMITS -2147483648.00 2147483647.00 /end CHARACTERISTIC
/begin CHARACTERISTIC TiOff_tiStrtEndOffDef_C "Defaultvalue of start-end time" VALUE 0x8053609C RB_Val_Ws32 2147483647.00 Time_sec_q1_COMPU 0.00 2147483647.00 FORMAT "%13.2" EXTENDED_LIMITS -2147483648.00 2147483647.00 /end CHARACTERISTIC
/begin CHARACTERISTIC TiOff_tiT15OffEcuOnTBasdChkFastMax_T "maximum accumulated ecu-on-time since last T15-off-event to enable the fast check" CURVE 0x80535FB6 RB_Curve_U16_U16 65535.00 t_q1 0.00 65535.00 FORMAT "%8.2"
 /begin AXIS_DESCR STD_AXIS TiOff_ratCoolDwnTBasdChk fak_q0p000488 12 0.00 1.000000 FORMAT "%8.6" EXTENDED_LIMITS 0.00 31.99951 DEPOSIT ABSOLUTE /end AXIS_DESCR
/end CHARACTERISTIC
/begin CHARACTERISTIC TiOff_tiT15OffEcuOnTBasdChkSlowMax_T "maximum accumulated ecu-on-time since last T15-off-event to enable the slow check" CURVE 0x80535FE8 RB_Curve_U16_U16 65535.00 t_q1 0.00 65535.00 FORMAT "%8.2"
 /begin AXIS_DESCR STD_AXIS TiOff_ratCoolDwnTBasdChk fak_q0p000488 12 0.00 1.000000 FORMAT "%8.6" EXTENDED_LIMITS 0.00 31.99951 DEPOSIT ABSOLUTE /end AXIS_DESCR
/end CHARACTERISTIC
/begin CHARACTERISTIC TiOff_tiT15OffTBasdChkFastRef_T "reference value for temperature based check (fast)" CURVE 0x8053601A RB_Curve_U16_U16 65535.00 Time_min_q1_COMPU 0.00 65535.00 FORMAT "%8.2"
 /begin AXIS_DESCR STD_AXIS TiOff_ratCoolDwnTBasdChk fak_q0p000488 12 0.00 31.99951 FORMAT "%8.5" DEPOSIT ABSOLUTE /end AXIS_DESCR
/end CHARACTERISTIC
/begin CHARACTERISTIC TiOff_tiT15OffTBasdChkSlowRef_T "reference value for temperature based check (slow)" CURVE 0x8053604C RB_Curve_U16_U16 65535.00 Time_min_q1_COMPU 0.00 65535.00 FORMAT "%8.2"
 /begin AXIS_DESCR STD_AXIS TiOff_ratCoolDwnTBasdChk fak_q0p000488 12 0.00 31.99951 FORMAT "%8.5" DEPOSIT ABSOLUTE /end AXIS_DESCR
/end CHARACTERISTIC
/begin CHARACTERISTIC TiOff_tiTBasdChkDly_C "Diagnosis delay (after T15 on) for temperature based check" VALUE 0x8053607E RB_Val_Wu8 12.75 t_q0p05 0.00 12.75 FORMAT "%5.2" /end CHARACTERISTIC
/begin CHARACTERISTIC TiOff_tiTBasdChkLst_C "Diagnosis timeout (after T15 on) for temperature based check" VALUE 0x8053607F RB_Val_Wu8 12.75 t_q0p05 0.00 12.75 FORMAT "%5.2" /end CHARACTERISTIC
/begin MEASUREMENT CoCTM_trqMaxAC "Maximum allowed AC compressor torque" SWORD Trq 1 100 -3276.800 3276.700 FORMAT "%8.3" ECU_ADDRESS 0x6000521C /end MEASUREMENT
/begin MEASUREMENT ThrVlv_cntrSens1SelB1 "Counter sensor comparison: sensor 1 suits to charge signal" UBYTE OneToOne 1 100 0.00 255.0 FORMAT "%5.1" ECU_ADDRESS 0x70002D60 /end MEASUREMENT
/begin MEASUREMENT ThrVlv_cntrSens2SelB1 "Counter sensor comparison: sensor 2 suits to charge signal" UBYTE OneToOne 1 100 0.00 255.0 FORMAT "%5.1" ECU_ADDRESS 0x70002D61 /end MEASUREMENT
/begin MEASUREMENT ThrVlv_facUBattB1 "factor for battery voltage compensation" UWORD fak_q6p1035Em5 1 100 0.00 3.999939 FORMAT "%8.6" ECU_ADDRESS 0x60005316 /end MEASUREMENT
/begin MEASUREMENT ThrVlv_flgActPosnVldB1 "Actual position is valid" UBYTE OneToOne 1 100 0.00 1.000 BIT_MASK 0x1 FORMAT "%5.3" ECU_ADDRESS 0x6000A7ED /end MEASUREMENT
/begin MEASUREMENT ThrVlv_flgActrOnB1 "The powerstage of the actuator is switched on" UBYTE OneToOne 1 100 0.00 1.000 BIT_MASK 0x1 FORMAT "%5.3" ECU_ADDRESS 0x6000A7EC /end MEASUREMENT
/begin MEASUREMENT ThrVlv_flgAvrgSens1Sens2SelB1 "Flag: Actual position calculated based on the average from both sensor voltages" UBYTE OneToOne 1 100 0.00 1.000 BIT_MASK 0x1 FORMAT "%5.3" ECU_ADDRESS 0x70002D97 /end MEASUREMENT
/begin MEASUREMENT ThrVlv_flgChrgSens1SyncErrSuspcB1 "Suspicion error: Deviation between sensor 1 and charge signal" UBYTE OneToOne 1 100 0.00 1.000 BIT_MASK 0x1 FORMAT "%5.3" ECU_ADDRESS 0x70002D62 /end MEASUREMENT
/begin MEASUREMENT ThrVlv_flgChrgSens2SyncErrSuspcB1 "Suspicion error: Deviation between sensor 2 and charge signal" UBYTE OneToOne 1 100 0.00 1.000 BIT_MASK 0x1 FORMAT "%5.3" ECU_ADDRESS 0x70002D63 /end MEASUREMENT
/begin MEASUREMENT ThrVlv_flgDblSensErrB1 "Flag: Both throttle valve sensors defect" UBYTE OneToOne 1 100 0.00 1.000 BIT_MASK 0x1 FORMAT "%5.3" ECU_ADDRESS 0x6000A7E8 /end MEASUREMENT
/begin MEASUREMENT ThrVlv_flgDblSensErrSuspcB1 "Suspicion error on both throttle angle sensors" UBYTE OneToOne 1 100 0.00 1.000 BIT_MASK 0x1 FORMAT "%5.3" ECU_ADDRESS 0x6000A7E7 /end MEASUREMENT
/begin MEASUREMENT ThrVlv_flgDesTstrB1 "desired value from tester is active throttle valve bench 1" UBYTE OneToOne 1 100 0.00 1.000 BIT_MASK 0x1 FORMAT "%5.3" ECU_ADDRESS 0x6000A7E6 /end MEASUREMENT
/begin MEASUREMENT ThrVlv_flgDesValVldB1 "desired value valid throttle valve motor bench one" UBYTE OneToOne 1 100 0.00 1.000 BIT_MASK 0x1 FORMAT "%5.3" ECU_ADDRESS 0x6000A7E5 /end MEASUREMENT
/begin MEASUREMENT ThrVlv_flgLimpAirPosnNotReaB1 "Limp home position not reached" UBYTE OneToOne 1 100 0.00 1.000 BIT_MASK 0x1 FORMAT "%5.3" ECU_ADDRESS 0x6000A7E3 /end MEASUREMENT
/begin MEASUREMENT ThrVlv_flgLmsPsdB1 "Valve is pressed to mechanical stop" UBYTE OneToOne 1 100 0.00 1.000 BIT_MASK 0x1 FORMAT "%5.3" ECU_ADDRESS 0x6000A7E2 /end MEASUREMENT
/begin MEASUREMENT ThrVlv_flgLstUnthrSensSelB1 "Last selected angle in unthrottled operation range" UBYTE OneToOne 1 100 0.00 1.000 BIT_MASK 0x1 FORMAT "%5.3" ECU_ADDRESS 0x70002D64 /end MEASUREMENT
/begin MEASUREMENT ThrVlv_flgOpenLoadDiagFinshdB1 "Status flag: open load diagnosis finished" UBYTE OneToOne 1 100 0.00 1.000 BIT_MASK 0x1 FORMAT "%5.3" ECU_ADDRESS 0x6000A7DF /end MEASUREMENT
/begin MEASUREMENT ThrVlv_flgOpenLoopOpngVvtEndPosnB1 "Limp home driving with VVT: End position of throttle valve reached" UBYTE OneToOne 1 100 0.00 1.000 BIT_MASK 0x1 FORMAT "%5.3" ECU_ADDRESS 0x70002D9A /end MEASUREMENT
/begin MEASUREMENT ThrVlv_flgPosnCtrlDsmClrDmdB1 "Request for DMS-Clear position controller error, bank1" UBYTE OneToOne 1 100 0.00 1.000 BIT_MASK 0x1 FORMAT "%5.3" ECU_ADDRESS 0x6000626D /end MEASUREMENT
/begin MEASUREMENT ThrVlv_flgPosnCtrlPsOffB1 "Request powerstage off from ThrVlv_PosnCtrl" UBYTE OneToOne 1 100 0.00 1.000 BIT_MASK 0x1 FORMAT "%5.3" ECU_ADDRESS 0x6000A7DE /end MEASUREMENT
/begin MEASUREMENT ThrVlv_flgReqPsOffB1 "Request powerstage off (accumulative bit)" UBYTE OneToOne 1 100 0.00 1.000 BIT_MASK 0x1 FORMAT "%5.3" ECU_ADDRESS 0x6000A7DC /end MEASUREMENT
/begin MEASUREMENT ThrVlv_flgSens1ErrB1 "Flag: Sensor 1 defect" UBYTE OneToOne 1 100 0.00 1.000 BIT_MASK 0x1 FORMAT "%5.3" ECU_ADDRESS 0x70002D9B /end MEASUREMENT
/begin MEASUREMENT ThrVlv_flgSens1ErrSuspcB1 "Sensor 1 suspicion error" UBYTE OneToOne 1 100 0.00 1.000 BIT_MASK 0x1 FORMAT "%5.3" ECU_ADDRESS 0x70002D9C /end MEASUREMENT
/begin MEASUREMENT ThrVlv_flgSens1SelB1 "Flag: Actual position calculated based on sensor 1 voltage" UBYTE OneToOne 1 100 0.00 1.000 BIT_MASK 0x1 FORMAT "%5.3" ECU_ADDRESS 0x70002D9D /end MEASUREMENT
/begin MEASUREMENT ThrVlv_flgSens1Sens2SyncErrSuspcB1 "Suspicion error: Deviation between voltage sensor 1 and voltage sensor 2" UBYTE OneToOne 1 100 0.00 1.000 BIT_MASK 0x1 FORMAT "%5.3" ECU_ADDRESS 0x70002D65 /end MEASUREMENT
/begin MEASUREMENT ThrVlv_flgSens1SigRngSuspcB1 "Sensor 1 outside of the valid signal range (undebounced)" UBYTE OneToOne 1 100 0.00 1.000 BIT_MASK 0x1 FORMAT "%5.3" ECU_ADDRESS 0x70002D66 /end MEASUREMENT
/begin MEASUREMENT ThrVlv_flgSens2CharPosnMaxExcddB1 "Characteristic maximal actual position exceeded by sensor 2" UBYTE OneToOne 1 100 0.00 1.000 BIT_MASK 0x1 FORMAT "%5.3" ECU_ADDRESS 0x70002D67 /end MEASUREMENT
/begin MEASUREMENT ThrVlv_flgSens2CharPosnMinExcddB1 "Characteristic minimal actual position exceeded by sensor 2" UBYTE OneToOne 1 100 0.00 1.000 BIT_MASK 0x1 FORMAT "%5.3" ECU_ADDRESS 0x70002D68 /end MEASUREMENT
/begin MEASUREMENT ThrVlv_flgSens2ErrB1 "Flag: Sensor 2 defect" UBYTE OneToOne 1 100 0.00 1.000 BIT_MASK 0x1 FORMAT "%5.3" ECU_ADDRESS 0x70002D69 /end MEASUREMENT
/begin MEASUREMENT ThrVlv_flgSens2ErrSuspcB1 "Sensor 2 suspicion error" UBYTE OneToOne 1 100 0.00 1.000 BIT_MASK 0x1 FORMAT "%5.3" ECU_ADDRESS 0x70002D9E /end MEASUREMENT
/begin MEASUREMENT ThrVlv_flgSens2SelB1 "Flag: Actual position calculated based on sensor 2 voltage" UBYTE OneToOne 1 100 0.00 1.000 BIT_MASK 0x1 FORMAT "%5.3" ECU_ADDRESS 0x70002D9F /end MEASUREMENT
/begin MEASUREMENT ThrVlv_flgSens2SigRngSuspcB1 "Sensor 2 outside of the valid signal range (undebounced)" UBYTE OneToOne 1 100 0.00 1.000 BIT_MASK 0x1 FORMAT "%5.3" ECU_ADDRESS 0x70002D6A /end MEASUREMENT
/begin MEASUREMENT ThrVlv_flgSensCompActvdB1 "Flag: Sensor comparison with the charge signal demanded" UBYTE OneToOne 1 100 0.00 1.000 BIT_MASK 0x1 FORMAT "%5.3" ECU_ADDRESS 0x70002DA0 /end MEASUREMENT
/begin MEASUREMENT ThrVlv_flgSensCompDmdDurgUnthrB1 "Flag: Sensor comparison with the charge signal in unthrottled operation mode demanded" UBYTE OneToOne 1 100 0.00 1.000 BIT_MASK 0x1 FORMAT "%5.3" ECU_ADDRESS 0x70002D6B /end MEASUREMENT
/begin MEASUREMENT ThrVlv_flgSngSensErrB1 "One throttle valve sensor faulty" UBYTE OneToOne 1 100 0.00 1.000 BIT_MASK 0x1 FORMAT "%5.3" ECU_ADDRESS 0x50005DC9 /end MEASUREMENT
/begin MEASUREMENT ThrVlv_flgSngSensErrSuspcB1 "Suspicion error on one throttle valve sensor" UBYTE OneToOne 1 100 0.00 1.000 BIT_MASK 0x1 FORMAT "%5.3" ECU_ADDRESS 0x6000A7DA /end MEASUREMENT
/begin MEASUREMENT ThrVlv_flgSwtOffDiagStrtB1 "Open Load diagnosis started bank 1" UBYTE OneToOne 1 100 0.00 1.000 BIT_MASK 0x1 FORMAT "%5.3" ECU_ADDRESS 0x6000626B /end MEASUREMENT
/begin MEASUREMENT ThrVlv_flgTstrCdn "conditions for desired value from tester throttle valve are given" UBYTE OneToOne 1 100 0.00 1.000 BIT_MASK 0x1 FORMAT "%5.3" ECU_ADDRESS 0x6000626C /end MEASUREMENT
/begin MEASUREMENT ThrVlv_flgXPostDrvB1 "Request extend PostDrive" UBYTE OneToOne 1 100 0.00 1.000 BIT_MASK 0x1 FORMAT "%5.3" ECU_ADDRESS 0x6000A7D8 /end MEASUREMENT
/begin MEASUREMENT ThrVlv_PosnCtrlB1_I.PwrLossHeat "Position Controller of the throttle valve of motor bench one / power loss as heat" UWORD leist_q0p015625 1 100 0.00 1023.984 FORMAT "%8.3" ECU_ADDRESS 0x50001A3C /end MEASUREMENT
/begin MEASUREMENT ThrVlv_PosnCtrlB1_I.dRadSpdLimSoftLdg "Position Controller of the throttle valve of motor bench one / speed limit for softlanding" SLONG fak_q1p526Em5 1 100 -100.000000000 99.999984741 FORMAT "%13.9" ECU_ADDRESS 0x50001A40 /end MEASUREMENT
/begin MEASUREMENT ThrVlv_PosnCtrlB1_I.dRadSpdLimSoftLmsLvng "Position Controller of the throttle valve of motor bench one / speed limit for soft leaving" SLONG fak_q1p526Em5 1 100 -100.000000000 99.999984741 FORMAT "%13.9" ECU_ADDRESS 0x50001A44 /end MEASUREMENT
/begin MEASUREMENT ThrVlv_PosnCtrlB1_I.dRatActFild "Position Controller of the throttle valve of motor bench one / filtered derivative of actual position" SWORD relgrd_q7p8125 1 100 -256000.0 255992.2 FORMAT "%8.1" ECU_ADDRESS 0x50001A48 /end MEASUREMENT
/begin MEASUREMENT ThrVlv_PosnCtrlB1_I.dRatActSldgModFild "Position Controller of the throttle valve of motor bench one / nonlinear filtered derivative of actual position" SLONG q0p1_Perc_DIV_s 1 100 -214748364.800 214748364.700 FORMAT "%13.3" ECU_ADDRESS 0x50001A4C /end MEASUREMENT
/begin MEASUREMENT ThrVlv_PosnCtrlB1_I.dRatActSldgModFildAbslt "Position Controller of the throttle valve of motor bench one / nonlinear filtered derivative of actual position" SLONG q0p1_Perc_DIV_s 1 100 -214748364.800 214748364.700 FORMAT "%13.3" ECU_ADDRESS 0x50001A50 /end MEASUREMENT
/begin MEASUREMENT ThrVlv_PosnCtrlB1_I.dRatDesPreCtrlGrdt "Position Controller of the throttle valve of motor bench one / gradient of the filtered desired value" SWORD relgrd_q7p8125 1 100 -256000.0 255992.2 FORMAT "%8.1" ECU_ADDRESS 0x50001A54 /end MEASUREMENT
/begin MEASUREMENT ThrVlv_PosnCtrlB1_I.dUIntglSldgMod "Position Controller of the throttle valve of motor bench one / gain of integral part" UWORD RBPtCel_du_0p05_1 1 100 0.00 3276.750 FORMAT "%8.3" ECU_ADDRESS 0x50001A56 /end MEASUREMENT
/begin MEASUREMENT ThrVlv_PosnCtrlB1_I.dUIntglSldgModLhp "Position Controller of the throttle valve of motor bench one / gain of integral part at limp air postion" SWORD RBPtCel_du_0p05_1 1 100 0.00 1638.350 FORMAT "%8.3" ECU_ADDRESS 0x50001A58 /end MEASUREMENT
/begin MEASUREMENT ThrVlv_PosnCtrlB1_I.dt_fac_u16 "Position Controller of the throttle valve of motor bench one / internal dT" UWORD t_q3p815Em6 1 100 0.00 0.006000519 FORMAT "%11.9" ECU_ADDRESS 0x50001A60 /end MEASUREMENT
/begin MEASUREMENT ThrVlv_PosnCtrlB1_I.dt_ms_0p04881_u16 "Position Controller of the throttle valve of motor bench one / internal dT" UWORD t_tev0p0005 1 100 0.00 11.00000 FORMAT "%8.5" ECU_ADDRESS 0x50001A62 /end MEASUREMENT
/begin MEASUREMENT ThrVlv_PosnCtrlB1_I.egyHeatOld "Position Controller of the throttle valve of motor bench one / absorbed heat energy" FLOAT32_IEEE OneToOne 1 100 -1.00000000E+037 1.00000000E+037 FORMAT "%13.3" ECU_ADDRESS 0x600362D0 /end MEASUREMENT
/begin MEASUREMENT ThrVlv_PosnCtrlB1_I.facCtrlDer "Position Controller of the throttle valve of motor bench one / gain of derivative part" UWORD RBPtCel_fac_1p0em4_1 1 100 0.00 6.553500 FORMAT "%8.6" ECU_ADDRESS 0x50001A66 /end MEASUREMENT
/begin MEASUREMENT ThrVlv_PosnCtrlB1_I.facCtrlIntgl "Position Controller of the throttle valve of motor bench one / gain of i part" UWORD fak_q0p01 1 100 0.00 655.3500 FORMAT "%8.4" ECU_ADDRESS 0x50001A68 /end MEASUREMENT
/begin MEASUREMENT ThrVlv_PosnCtrlB1_I.facCtrlIntglLimpAirPosn "Position Controller of the throttle valve of motor bench one / gain of i part at limp air postion" UWORD fak_q0p01 1 100 0.00 655.3500 FORMAT "%8.4" ECU_ADDRESS 0x50001A6A /end MEASUREMENT
/begin MEASUREMENT ThrVlv_PosnCtrlB1_I.facCtrlProp "Position Controller of the throttle valve of motor bench one / gain of proportional part" UWORD fak_q0p01 1 100 0.00 655.3500 FORMAT "%8.4" ECU_ADDRESS 0x50001A6C /end MEASUREMENT
/begin MEASUREMENT ThrVlv_PosnCtrlB1_I.facCtrlSldgMod "Position Controller of the throttle valve of motor bench one / gain of the proportional derivative controller" SWORD Fact1000 1 100 -32.76800 32.76700 FORMAT "%8.5" ECU_ADDRESS 0x50001A6E /end MEASUREMENT
/begin MEASUREMENT ThrVlv_PosnCtrlB1_I.facCtrlSldgModLhp "Position Controller of the throttle valve of motor bench one / gain of the proportional derivative controller at limp air postion" SWORD Fact1000 1 100 -32.76800 32.76700 FORMAT "%8.5" ECU_ADDRESS 0x50001A70 /end MEASUREMENT
/begin MEASUREMENT ThrVlv_PosnCtrlB1_I.facPreCtrlA1 "Position Controller of the throttle valve of motor bench one / pre-controller parameter" FLOAT32_IEEE OneToOne 1 100 -1.00000000E+037 1.00000000E+037 FORMAT "%13.3" ECU_ADDRESS 0x50001A74 /end MEASUREMENT
/begin MEASUREMENT ThrVlv_PosnCtrlB1_I.facPreCtrlA2 "Position Controller of the throttle valve of motor bench one / pre-controller parameter" FLOAT32_IEEE OneToOne 1 100 -1.00000000E+037 1.00000000E+037 FORMAT "%13.3" ECU_ADDRESS 0x50001A78 /end MEASUREMENT
/begin MEASUREMENT ThrVlv_PosnCtrlB1_I.facPreCtrlA3 "Position Controller of the throttle valve of motor bench one / pre-controller parameter" FLOAT32_IEEE OneToOne 1 100 -1.00000000E+037 1.00000000E+037 FORMAT "%13.3" ECU_ADDRESS 0x50001A7C /end MEASUREMENT
/begin MEASUREMENT ThrVlv_PosnCtrlB1_I.facPreCtrlB "Position Controller of the throttle valve of motor bench one / pre-controller parameter" FLOAT32_IEEE OneToOne 1 100 -1.00000000E+037 1.00000000E+037 FORMAT "%13.3" ECU_ADDRESS 0x50001A80 /end MEASUREMENT
/begin MEASUREMENT ThrVlv_PosnCtrlB1_I.facPreCtrlC "Position Controller of the throttle valve of motor bench one / pre-controller parameter" FLOAT32_IEEE OneToOne 1 100 -1.00000000E+037 1.00000000E+037 FORMAT "%13.3" ECU_ADDRESS 0x50001A84 /end MEASUREMENT
/begin MEASUREMENT ThrVlv_PosnCtrlB1_I.facUBatt "Position Controller of the throttle valve of motor bench one / factor for battery voltage compensation" UWORD fak_q6p1035Em5 1 100 0.00 3.999939 FORMAT "%8.6" ECU_ADDRESS 0x50001A88 /end MEASUREMENT
/begin MEASUREMENT ThrVlv_PosnCtrlB1_I.flgClsdPosnReaSuc "Position Controller of the throttle valve of motor bench one / valve fully closed" UBYTE OneToOne 1 100 0.00 1.000 BIT_MASK 0x1 FORMAT "%5.3" ECU_ADDRESS 0x50001A8A /end MEASUREMENT
/begin MEASUREMENT ThrVlv_PosnCtrlB1_I.flgCompProt "Position Controller of the throttle valve of motor bench one / component protection active" UBYTE OneToOne 1 100 0.00 1.000 BIT_MASK 0x1 FORMAT "%5.3" ECU_ADDRESS 0x50001A8B /end MEASUREMENT
/begin MEASUREMENT ThrVlv_PosnCtrlB1_I.flgCoolgDone "Position Controller of the throttle valve of motor bench one / actuator cooled down" UBYTE OneToOne 1 100 0.00 1.000 BIT_MASK 0x1 FORMAT "%5.3" ECU_ADDRESS 0x50001A8C /end MEASUREMENT
/begin MEASUREMENT ThrVlv_PosnCtrlB1_I.flgCsersDiagActv "Position Controller of the throttle valve of motor bench one / CSERS diagnosis active" UBYTE OneToOne 1 100 0.00 1.000 BIT_MASK 0x1 FORMAT "%5.3" ECU_ADDRESS 0x50001A8D /end MEASUREMENT
/begin MEASUREMENT ThrVlv_PosnCtrlB1_I.flgCsersDiagActvAtErrSet "Position Controller of the throttle valve of motor bench one / CSERS diagnosis was active at error setting" UBYTE OneToOne 1 100 0.00 1.000 BIT_MASK 0x1 FORMAT "%5.3" ECU_ADDRESS 0x50001A8E /end MEASUREMENT
/begin MEASUREMENT ThrVlv_PosnCtrlB1_I.flgCsersDiumprDenom "Position Controller of the throttle valve of motor bench one / increment of the DIUMPR (Diagnostic In-Use Monitor Performance Ratio) denominator" UBYTE OneToOne 1 100 0.00 1.000 BIT_MASK 0x1 FORMAT "%5.3" ECU_ADDRESS 0x50001A8F /end MEASUREMENT
/begin MEASUREMENT ThrVlv_PosnCtrlB1_I.flgCsersDiumprNumr "Position Controller of the throttle valve of motor bench one / increment of the DIUMPR (Diagnostic In-Use Monitor Performance Ratio) numerator" UBYTE OneToOne 1 100 0.00 1.000 BIT_MASK 0x1 FORMAT "%5.3" ECU_ADDRESS 0x50001A90 /end MEASUREMENT
/begin MEASUREMENT ThrVlv_PosnCtrlB1_I.flgCsersEnaCdn "Position Controller of the throttle valve of motor bench one / conditions of CSERS diagnosis fulfilled" UBYTE OneToOne 1 100 0.00 1.000 BIT_MASK 0x1 FORMAT "%5.3" ECU_ADDRESS 0x50001A91 /end MEASUREMENT
/begin MEASUREMENT ThrVlv_PosnCtrlB1_I.flgCtrlDeDeb "Position Controller of the throttle valve of motor bench one / control deviation is debounced" UBYTE OneToOne 1 100 0.00 1.000 BIT_MASK 0x1 FORMAT "%5.3" ECU_ADDRESS 0x50001A92 /end MEASUREMENT
/begin MEASUREMENT ThrVlv_PosnCtrlB1_I.flgCtrlDeDebCsers "Position Controller of the throttle valve of motor bench one / control deviation is debounced" UBYTE OneToOne 1 100 0.00 1.000 BIT_MASK 0x1 FORMAT "%5.3" ECU_ADDRESS 0x50001A93 /end MEASUREMENT
/begin MEASUREMENT ThrVlv_PosnCtrlB1_I.flgCtrlDeDfcLdc "Position Controller of the throttle valve of motor bench one / control deviation DFC in last driving cycle" UBYTE OneToOne 1 100 0.00 1.000 BIT_MASK 0x1 FORMAT "%5.3" ECU_ADDRESS 0x50001A94 /end MEASUREMENT
/begin MEASUREMENT ThrVlv_PosnCtrlB1_I.flgCtrlDeDfcLdcCsers "Position Controller of the throttle valve of motor bench one / control deviation DFC (CSERS) in last driving cycle" UBYTE OneToOne 1 100 0.00 1.000 BIT_MASK 0x1 FORMAT "%5.3" ECU_ADDRESS 0x50001A95 /end MEASUREMENT
/begin MEASUREMENT ThrVlv_PosnCtrlB1_I.flgCycCtrlDeMax "Position Controller of the throttle valve of motor bench one / cycle flag upper position" UBYTE OneToOne 1 100 0.00 1.000 BIT_MASK 0x1 FORMAT "%5.3" ECU_ADDRESS 0x50001A96 /end MEASUREMENT
/begin MEASUREMENT ThrVlv_PosnCtrlB1_I.flgCycCtrlDeMin "Position Controller of the throttle valve of motor bench one / cycle flag lower position" UBYTE OneToOne 1 100 0.00 1.000 BIT_MASK 0x1 FORMAT "%5.3" ECU_ADDRESS 0x50001A97 /end MEASUREMENT
/begin MEASUREMENT ThrVlv_PosnCtrlB1_I.flgCycDutyCycPsMax "Position Controller of the throttle valve of motor bench one / cycle flag upper position" UBYTE OneToOne 1 100 0.00 1.000 BIT_MASK 0x1 FORMAT "%5.3" ECU_ADDRESS 0x50001A98 /end MEASUREMENT
/begin MEASUREMENT ThrVlv_PosnCtrlB1_I.flgCycDutyCycPsMin "Position Controller of the throttle valve of motor bench one / cycle flag lower position" UBYTE OneToOne 1 100 0.00 1.000 BIT_MASK 0x1 FORMAT "%5.3" ECU_ADDRESS 0x50001A99 /end MEASUREMENT
/begin MEASUREMENT ThrVlv_PosnCtrlB1_I.flgDEDIA "Position Controller of the throttle valve of motor bench one / DEDIA active (local)" UBYTE OneToOne 1 100 0.00 1.000 BIT_MASK 0x1 FORMAT "%5.3" ECU_ADDRESS 0x50001A9A /end MEASUREMENT
/begin MEASUREMENT ThrVlv_PosnCtrlB1_I.flgDebLowUBatt "Position Controller of the throttle valve of motor bench one / low battery voltage debounced" UBYTE OneToOne 1 100 0.00 1.000 BIT_MASK 0x1 FORMAT "%5.3" ECU_ADDRESS 0x50001A9B /end MEASUREMENT
/begin MEASUREMENT ThrVlv_PosnCtrlB1_I.flgDebOpenLoad "Position Controller of the throttle valve of motor bench one / openload diagnosis is debounced" UBYTE OneToOne 1 100 0.00 1.000 BIT_MASK 0x1 FORMAT "%5.3" ECU_ADDRESS 0x50001A9C /end MEASUREMENT
/begin MEASUREMENT ThrVlv_PosnCtrlB1_I.flgDesValFromHeal "Position Controller of the throttle valve of motor bench one / desired value comes from healing function" UBYTE OneToOne 1 100 0.00 1.000 BIT_MASK 0x1 FORMAT "%5.3" ECU_ADDRESS 0x50001A9D /end MEASUREMENT
/begin MEASUREMENT ThrVlv_PosnCtrlB1_I.flgDesValVld "Position Controller of the throttle valve of motor bench one / desired value valid" UBYTE OneToOne 1 100 0.00 1.000 BIT_MASK 0x1 FORMAT "%5.3" ECU_ADDRESS 0x50001A9E /end MEASUREMENT
/begin MEASUREMENT ThrVlv_PosnCtrlB1_I.flgDetDfcDoneDcyc "Position Controller of the throttle valve of motor bench one / DFC detection done in this driving cycle" UBYTE OneToOne 1 100 0.00 1.000 BIT_MASK 0x1 FORMAT "%5.3" ECU_ADDRESS 0x50001A9F /end MEASUREMENT
/begin MEASUREMENT ThrVlv_PosnCtrlB1_I.flgDfcLdc "Position Controller of the throttle valve of motor bench one / Lageregler-DFC aus letztem Fahrzyklus uebernommen" UBYTE OneToOne 1 100 0.00 1.000 BIT_MASK 0x1 FORMAT "%5.3" ECU_ADDRESS 0x50001AA0 /end MEASUREMENT
/begin MEASUREMENT ThrVlv_PosnCtrlB1_I.flgDfcSaved "Position Controller of the throttle valve of motor bench one / DFC saved in last driving cycle" UBYTE OneToOne 1 100 0.00 1.000 BIT_MASK 0x1 FORMAT "%5.3" ECU_ADDRESS 0x600362D4 /end MEASUREMENT
/begin MEASUREMENT ThrVlv_PosnCtrlB1_I.flgDrvToLimpAirPosn "Position Controller of the throttle valve of motor bench one / driving to limp air position by electric motor is active" UBYTE OneToOne 1 100 0.00 1.000 BIT_MASK 0x1 FORMAT "%5.3" ECU_ADDRESS 0x50001AA1 /end MEASUREMENT
/begin MEASUREMENT ThrVlv_PosnCtrlB1_I.flgDsmRdyDcyc "Position Controller of the throttle valve of motor bench one / DSM was ready in this driving cycle" UBYTE OneToOne 1 100 0.00 1.000 BIT_MASK 0x1 FORMAT "%5.3" ECU_ADDRESS 0x50001AA2 /end MEASUREMENT
/begin MEASUREMENT ThrVlv_PosnCtrlB1_I.flgDstRea "Position Controller of the throttle valve of motor bench one / distance to reach healing" UBYTE OneToOne 1 100 0.00 1.000 BIT_MASK 0x1 FORMAT "%5.3" ECU_ADDRESS 0x50001AA3 /end MEASUREMENT
/begin MEASUREMENT ThrVlv_PosnCtrlB1_I.flgDutyCycExcdDeb "Position Controller of the throttle valve of motor bench one / too high duty cycle is debounced" UBYTE OneToOne 1 100 0.00 1.000 BIT_MASK 0x1 FORMAT "%5.3" ECU_ADDRESS 0x50001AA4 /end MEASUREMENT
/begin MEASUREMENT ThrVlv_PosnCtrlB1_I.flgDutyCycOpenLoopOpng "Position Controller of the throttle valve of motor bench one / open loop opening of the valve is active" UBYTE OneToOne 1 100 0.00 1.000 BIT_MASK 0x1 FORMAT "%5.3" ECU_ADDRESS 0x50001AA5 /end MEASUREMENT
/begin MEASUREMENT ThrVlv_PosnCtrlB1_I.flgErrRprt "Position Controller of the throttle valve of motor bench one / error reported" UBYTE OneToOne 1 100 0.00 1.000 BIT_MASK 0x1 FORMAT "%5.3" ECU_ADDRESS 0x50001AA6 /end MEASUREMENT
/begin MEASUREMENT ThrVlv_PosnCtrlB1_I.flgFailSafe "Position Controller of the throttle valve of motor bench one / moving to fail safe position accomplished" UBYTE OneToOne 1 100 0.00 1.000 BIT_MASK 0x1 FORMAT "%5.3" ECU_ADDRESS 0x50001AA7 /end MEASUREMENT
/begin MEASUREMENT ThrVlv_PosnCtrlB1_I.flgFailSafeHealDfcActv "Position Controller of the throttle valve of motor bench one / moving to fail safe position in progress" UBYTE OneToOne 1 100 0.00 1.000 BIT_MASK 0x1 FORMAT "%5.3" ECU_ADDRESS 0x50001AA8 /end MEASUREMENT
/begin MEASUREMENT ThrVlv_PosnCtrlB1_I.flgFailSafeOlcActv "Position Controller of the throttle valve of motor bench one / open loop opening respectively closing active" UBYTE OneToOne 1 100 0.00 1.000 BIT_MASK 0x1 FORMAT "%5.3" ECU_ADDRESS 0x50001AA9 /end MEASUREMENT
/begin MEASUREMENT ThrVlv_PosnCtrlB1_I.flgFilRst "Position Controller of the throttle valve of motor bench one / reset filter of desired value" UBYTE OneToOne 1 100 0.00 1.000 BIT_MASK 0x1 FORMAT "%5.3" ECU_ADDRESS 0x50001AAA /end MEASUREMENT
/begin MEASUREMENT ThrVlv_PosnCtrlB1_I.flgFixdCtrlGain "Position Controller of the throttle valve of motor bench one / constant values for PID gains active" UBYTE OneToOne 1 100 0.00 1.000 BIT_MASK 0x1 FORMAT "%5.3" ECU_ADDRESS 0x50001AAB /end MEASUREMENT
/begin MEASUREMENT ThrVlv_PosnCtrlB1_I.flgGpfProtnActv "Position Controller of the throttle valve of motor bench one / particulate filter protection active" UBYTE OneToOne 1 100 0.00 1.000 BIT_MASK 0x1 FORMAT "%5.3" ECU_ADDRESS 0x50001AAC /end MEASUREMENT
/begin MEASUREMENT ThrVlv_PosnCtrlB1_I.flgHealAllwd "Position Controller of the throttle valve of motor bench one / conditions for healing are true" UBYTE OneToOne 1 100 0.00 1.000 BIT_MASK 0x1 FORMAT "%5.3" ECU_ADDRESS 0x50001AAD /end MEASUREMENT
/begin MEASUREMENT ThrVlv_PosnCtrlB1_I.flgHealDesValActv "Position Controller of the throttle valve of motor bench one / healing function active" UBYTE OneToOne 1 100 0.00 1.000 BIT_MASK 0x1 FORMAT "%5.3" ECU_ADDRESS 0x50001AAE /end MEASUREMENT
/begin MEASUREMENT ThrVlv_PosnCtrlB1_I.flgHealDfcActv "Position Controller of the throttle valve of motor bench one / healing function active" UBYTE OneToOne 1 100 0.00 1.000 BIT_MASK 0x1 FORMAT "%5.3" ECU_ADDRESS 0x50001AAF /end MEASUREMENT
/begin MEASUREMENT ThrVlv_PosnCtrlB1_I.flgHealDfcClsd "Position Controller of the throttle valve of motor bench one / healing function could close valve" UBYTE OneToOne 1 100 0.00 1.000 BIT_MASK 0x1 FORMAT "%5.3" ECU_ADDRESS 0x50001AB0 /end MEASUREMENT
/begin MEASUREMENT ThrVlv_PosnCtrlB1_I.flgHealDfcOpend "Position Controller of the throttle valve of motor bench one / healing function could open valve" UBYTE OneToOne 1 100 0.00 1.000 BIT_MASK 0x1 FORMAT "%5.3" ECU_ADDRESS 0x50001AB1 /end MEASUREMENT
/begin MEASUREMENT ThrVlv_PosnCtrlB1_I.flgHealFail "Position Controller of the throttle valve of motor bench one / healing failed" UBYTE OneToOne 1 100 0.00 1.000 BIT_MASK 0x1 FORMAT "%5.3" ECU_ADDRESS 0x50001AB2 /end MEASUREMENT
/begin MEASUREMENT ThrVlv_PosnCtrlB1_I.flgHealSuc "Position Controller of the throttle valve of motor bench one / healing was successful" UBYTE OneToOne 1 100 0.00 1.000 BIT_MASK 0x1 FORMAT "%5.3" ECU_ADDRESS 0x50001AB3 /end MEASUREMENT
/begin MEASUREMENT ThrVlv_PosnCtrlB1_I.flgHldClsdAbortIniFil "Position Controller of the throttle valve of motor bench one / hold closed deactivated reset filters" UBYTE OneToOne 1 100 0.00 1.000 BIT_MASK 0x1 FORMAT "%5.3" ECU_ADDRESS 0x50001AB4 /end MEASUREMENT
/begin MEASUREMENT ThrVlv_PosnCtrlB1_I.flgHldClsdActv "Position Controller of the throttle valve of motor bench one / hold closed active" UBYTE OneToOne 1 100 0.00 1.000 BIT_MASK 0x1 FORMAT "%5.3" ECU_ADDRESS 0x50001AB5 /end MEASUREMENT
/begin MEASUREMENT ThrVlv_PosnCtrlB1_I.flgHldClsdAvl "Position Controller of the throttle valve of motor bench one / hold closed available" UBYTE OneToOne 1 100 0.00 1.000 BIT_MASK 0x1 FORMAT "%5.3" ECU_ADDRESS 0x50001AB6 /end MEASUREMENT
/begin MEASUREMENT ThrVlv_PosnCtrlB1_I.flgHldClsdDynPeak "Position Controller of the throttle valve of motor bench one / hold closed dynamic peak active" UBYTE OneToOne 1 100 0.00 1.000 BIT_MASK 0x1 FORMAT "%5.3" ECU_ADDRESS 0x50001AB7 /end MEASUREMENT
/begin MEASUREMENT ThrVlv_PosnCtrlB1_I.flgHldClsdMaps "Position Controller of the throttle valve of motor bench one / duty cycle maps for hldclosed active" UBYTE OneToOne 1 100 0.00 1.000 BIT_MASK 0x1 FORMAT "%5.3" ECU_ADDRESS 0x50001AB8 /end MEASUREMENT
/begin MEASUREMENT ThrVlv_PosnCtrlB1_I.flgHldOpenActv "Position Controller of the throttle valve of motor bench one / hold open active" UBYTE OneToOne 1 100 0.00 1.000 BIT_MASK 0x1 FORMAT "%5.3" ECU_ADDRESS 0x50001AB9 /end MEASUREMENT
/begin MEASUREMENT ThrVlv_PosnCtrlB1_I.flgIniDesFil "Position Controller of the throttle valve of motor bench one / initialise desired position filters" UBYTE OneToOne 1 100 0.00 1.000 BIT_MASK 0x1 FORMAT "%5.3" ECU_ADDRESS 0x50001ABA /end MEASUREMENT
/begin MEASUREMENT ThrVlv_PosnCtrlB1_I.flgIniDesFilNegSp "Position Controller of the throttle valve of motor bench one / initialise desired position filters (after negative desired positions)" UBYTE OneToOne 1 100 0.00 1.000 BIT_MASK 0x1 FORMAT "%5.3" ECU_ADDRESS 0x50001ABB /end MEASUREMENT
/begin MEASUREMENT ThrVlv_PosnCtrlB1_I.flgIniDesFilUnlimSp "Position Controller of the throttle valve of motor bench one / initialise desired position filters (after unlimited desired positions)" UBYTE OneToOne 1 100 0.00 1.000 BIT_MASK 0x1 FORMAT "%5.3" ECU_ADDRESS 0x50001ABC /end MEASUREMENT
/begin MEASUREMENT ThrVlv_PosnCtrlB1_I.flgIntglRst "Position Controller of the throttle valve of motor bench one / reset of the integrator" UBYTE OneToOne 1 100 0.00 1.000 BIT_MASK 0x1 FORMAT "%5.3" ECU_ADDRESS 0x50001ABD /end MEASUREMENT
/begin MEASUREMENT ThrVlv_PosnCtrlB1_I.flgLhpStuck "Position Controller of the throttle valve of motor bench one / stuck detection at limp air position" UBYTE OneToOne 1 100 0.00 1.000 BIT_MASK 0x1 FORMAT "%5.3" ECU_ADDRESS 0x50001ABE /end MEASUREMENT
/begin MEASUREMENT ThrVlv_PosnCtrlB1_I.flgLimpAirPosnNotRea "Position Controller of the throttle valve of motor bench one / limp home driving: limp home position not reached" UBYTE OneToOne 1 100 0.00 1.000 BIT_MASK 0x1 FORMAT "%5.3" ECU_ADDRESS 0x50001ABF /end MEASUREMENT
/begin MEASUREMENT ThrVlv_PosnCtrlB1_I.flgLimpAirPosnRegn "Position Controller of the throttle valve of motor bench one / trajectory is near the limp air position" UBYTE OneToOne 1 100 0.00 1.000 BIT_MASK 0x1 FORMAT "%5.3" ECU_ADDRESS 0x50001AC0 /end MEASUREMENT
/begin MEASUREMENT ThrVlv_PosnCtrlB1_I.flgLimpAirPosnRegnSp "Position Controller of the throttle valve of motor bench one / desired and actal position are near to the limp air position" UBYTE OneToOne 1 100 0.00 1.000 BIT_MASK 0x1 FORMAT "%5.3" ECU_ADDRESS 0x50001AC1 /end MEASUREMENT
/begin MEASUREMENT ThrVlv_PosnCtrlB1_I.flgLmsClsngActv "Position Controller of the throttle valve of motor bench one / lower mechanical stop closing active" UBYTE OneToOne 1 100 0.00 1.000 BIT_MASK 0x1 FORMAT "%5.3" ECU_ADDRESS 0x50001AC2 /end MEASUREMENT
/begin MEASUREMENT ThrVlv_PosnCtrlB1_I.flgLmsClsngDeactvtPwrSave "Position Controller of the throttle valve of motor bench one / lower mechanical stop closing requests deactivation of power save" UBYTE OneToOne 1 100 0.00 1.000 BIT_MASK 0x1 FORMAT "%5.3" ECU_ADDRESS 0x50001AC3 /end MEASUREMENT
/begin MEASUREMENT ThrVlv_PosnCtrlB1_I.flgLmsClsngDone "Position Controller of the throttle valve of motor bench one / lower mechanical stop closing successfully done" UBYTE OneToOne 1 100 0.00 1.000 BIT_MASK 0x1 FORMAT "%5.3" ECU_ADDRESS 0x50001AC4 /end MEASUREMENT
/begin MEASUREMENT ThrVlv_PosnCtrlB1_I.flgLmsPsd "Position Controller of the throttle valve of motor bench one / Valve is pressed to mechanical stop" UBYTE OneToOne 1 100 0.00 1.000 BIT_MASK 0x1 FORMAT "%5.3" ECU_ADDRESS 0x50001AC5 /end MEASUREMENT
/begin MEASUREMENT ThrVlv_PosnCtrlB1_I.flgLmsRea "Position Controller of the throttle valve of motor bench one / LmsClsng is pressing mechanical stop" UBYTE OneToOne 1 100 0.00 1.000 BIT_MASK 0x1 FORMAT "%5.3" ECU_ADDRESS 0x50001AC6 /end MEASUREMENT
/begin MEASUREMENT ThrVlv_PosnCtrlB1_I.flgLongTermOffs "Position Controller of the throttle valve of motor bench one / long term adaptation value in use" UBYTE OneToOne 1 100 0.00 1.000 BIT_MASK 0x1 FORMAT "%5.3" ECU_ADDRESS 0x50001AC7 /end MEASUREMENT
/begin MEASUREMENT ThrVlv_PosnCtrlB1_I.flgOffsLrnPsErr "Position Controller of the throttle valve of motor bench one / powerstage error reported by OffsLrn" UBYTE OneToOne 1 100 0.00 1.000 BIT_MASK 0x1 FORMAT "%5.3" ECU_ADDRESS 0x50001AC8 /end MEASUREMENT
/begin MEASUREMENT ThrVlv_PosnCtrlB1_I.flgOpenPosnReaSuc "Position Controller of the throttle valve of motor bench one / valve fully open" UBYTE OneToOne 1 100 0.00 1.000 BIT_MASK 0x1 FORMAT "%5.3" ECU_ADDRESS 0x50001AC9 /end MEASUREMENT
/begin MEASUREMENT ThrVlv_PosnCtrlB1_I.flgOpngAftLongHldClsd "Position Controller of the throttle valve of motor bench one / opening after long HldClsd active" UBYTE OneToOne 1 100 0.00 1.000 BIT_MASK 0x1 FORMAT "%5.3" ECU_ADDRESS 0x50001ACA /end MEASUREMENT
/begin MEASUREMENT ThrVlv_PosnCtrlB1_I.flgPosnCtrlErr "Position Controller of the throttle valve of motor bench one / Debounced error in position controller" UBYTE OneToOne 1 100 0.00 1.000 BIT_MASK 0x1 FORMAT "%5.3" ECU_ADDRESS 0x50001ACB /end MEASUREMENT
/begin MEASUREMENT ThrVlv_PosnCtrlB1_I.flgPosnCtrlPsOff "Position Controller of the throttle valve of motor bench one / central switch off of powerstage" UBYTE OneToOne 1 100 0.00 1.000 BIT_MASK 0x1 FORMAT "%5.3" ECU_ADDRESS 0x50001ACC /end MEASUREMENT
/begin MEASUREMENT ThrVlv_PosnCtrlB1_I.flgPosnCtrlSlow "Position Controller of the throttle valve of motor bench one / Flag for slow position control mode" UBYTE OneToOne 1 100 0.00 1.000 BIT_MASK 0x1 FORMAT "%5.3" ECU_ADDRESS 0x50001ACD /end MEASUREMENT
/begin MEASUREMENT ThrVlv_PosnCtrlB1_I.flgPsOff "Position Controller of the throttle valve of motor bench one / powerstage switched off" UBYTE OneToOne 1 100 0.00 1.000 BIT_MASK 0x1 FORMAT "%5.3" ECU_ADDRESS 0x50001ACE /end MEASUREMENT
/begin MEASUREMENT ThrVlv_PosnCtrlB1_I.flgPsRdy "Position Controller of the throttle valve of motor bench one / power stage ready" UBYTE OneToOne 1 100 0.00 1.000 BIT_MASK 0x1 FORMAT "%5.3" ECU_ADDRESS 0x50001ACF /end MEASUREMENT
/begin MEASUREMENT ThrVlv_PosnCtrlB1_I.flgPsRst "Position Controller of the throttle valve of motor bench one / powerstage reset" UBYTE OneToOne 1 100 0.00 1.000 BIT_MASK 0x1 FORMAT "%5.3" ECU_ADDRESS 0x50001AD0 /end MEASUREMENT
/begin MEASUREMENT ThrVlv_PosnCtrlB1_I.flgPsSwtOffDiag "Position Controller of the throttle valve of motor bench one / powerstage switched off by diagnosis" UBYTE OneToOne 1 100 0.00 1.000 BIT_MASK 0x1 FORMAT "%5.3" ECU_ADDRESS 0x50001AD1 /end MEASUREMENT
/begin MEASUREMENT ThrVlv_PosnCtrlB1_I.flgPwrSaveCdn "Position Controller of the throttle valve of motor bench one / condition for powersave fulfilled" UBYTE OneToOne 1 100 0.00 1.000 BIT_MASK 0x1 FORMAT "%5.3" ECU_ADDRESS 0x50001AD2 /end MEASUREMENT
/begin MEASUREMENT ThrVlv_PosnCtrlB1_I.flgRampDwn "Position Controller of the throttle valve of motor bench one / ramp towards lower electrical stop is active" UBYTE OneToOne 1 100 0.00 1.000 BIT_MASK 0x1 FORMAT "%5.3" ECU_ADDRESS 0x50001AD3 /end MEASUREMENT
/begin MEASUREMENT ThrVlv_PosnCtrlB1_I.flgRampDwnDutyLim "Position Controller of the throttle valve of motor bench one / lower duty cycle limit for driving to the lower mechanical stop switched on" UBYTE OneToOne 1 100 0.00 1.000 BIT_MASK 0x1 FORMAT "%5.3" ECU_ADDRESS 0x50001AD4 /end MEASUREMENT
/begin MEASUREMENT ThrVlv_PosnCtrlB1_I.flgRampDwnEna "Position Controller of the throttle valve of motor bench one / function ramp towards lower electrical stop is enabled" UBYTE OneToOne 1 100 0.00 1.000 BIT_MASK 0x1 FORMAT "%5.3" ECU_ADDRESS 0x50001AD5 /end MEASUREMENT
/begin MEASUREMENT ThrVlv_PosnCtrlB1_I.flgReqPsOffBattChk "Position Controller of the throttle valve of motor bench one / switch off powerstage too low battery voltage" UBYTE OneToOne 1 100 0.00 1.000 BIT_MASK 0x1 FORMAT "%5.3" ECU_ADDRESS 0x50001AD6 /end MEASUREMENT
/begin MEASUREMENT ThrVlv_PosnCtrlB1_I.flgReqPsOffCtrlErr "Position Controller of the throttle valve of motor bench one / switch off of the powerstage due to controller error" UBYTE OneToOne 1 100 0.00 1.000 BIT_MASK 0x1 FORMAT "%5.3" ECU_ADDRESS 0x50001AD7 /end MEASUREMENT
/begin MEASUREMENT ThrVlv_PosnCtrlB1_I.flgReqPsOffExtdPostDrv "Position Controller of the throttle valve of motor bench one / switch off powerstage by postdrive prolongation" UBYTE OneToOne 1 100 0.00 1.000 BIT_MASK 0x1 FORMAT "%5.3" ECU_ADDRESS 0x50001AD8 /end MEASUREMENT
/begin MEASUREMENT ThrVlv_PosnCtrlB1_I.flgReqPsOffPwrSave "Position Controller of the throttle valve of motor bench one / switch off powerstage powersave" UBYTE OneToOne 1 100 0.00 1.000 BIT_MASK 0x1 FORMAT "%5.3" ECU_ADDRESS 0x50001AD9 /end MEASUREMENT
/begin MEASUREMENT ThrVlv_PosnCtrlB1_I.flgRstIPrtn "Position Controller of the throttle valve of motor bench one / reset of the integral part" UBYTE OneToOne 1 100 0.00 1.000 BIT_MASK 0x1 FORMAT "%5.3" ECU_ADDRESS 0x50001ADA /end MEASUREMENT
/begin MEASUREMENT ThrVlv_PosnCtrlB1_I.flgRstIPrtnFailSafe "Position Controller of the throttle valve of motor bench one / reset of the integral part" UBYTE OneToOne 1 100 0.00 1.000 BIT_MASK 0x1 FORMAT "%5.3" ECU_ADDRESS 0x50001ADB /end MEASUREMENT
/begin MEASUREMENT ThrVlv_PosnCtrlB1_I.flgRstIPrtnHealDesVal "Position Controller of the throttle valve of motor bench one / reset of the integral part" UBYTE OneToOne 1 100 0.00 1.000 BIT_MASK 0x1 FORMAT "%5.3" ECU_ADDRESS 0x50001ADC /end MEASUREMENT
/begin MEASUREMENT ThrVlv_PosnCtrlB1_I.flgSftyInhb "Position Controller of the throttle valve of motor bench one / Safety Inhibit of the position controller" UBYTE OneToOne 1 100 0.00 1.000 BIT_MASK 0x1 FORMAT "%5.3" ECU_ADDRESS 0x50001ADD /end MEASUREMENT
/begin MEASUREMENT ThrVlv_PosnCtrlB1_I.flgSlowTrj "Position Controller of the throttle valve of motor bench one / slow trajectory" UBYTE OneToOne 1 100 0.00 1.000 BIT_MASK 0x1 FORMAT "%5.3" ECU_ADDRESS 0x50001ADE /end MEASUREMENT
/begin MEASUREMENT ThrVlv_PosnCtrlB1_I.flgSoftLdgActv "Position Controller of the throttle valve of motor bench one / softlanding active" UBYTE OneToOne 1 100 0.00 1.000 BIT_MASK 0x1 FORMAT "%5.3" ECU_ADDRESS 0x50001ADF /end MEASUREMENT
/begin MEASUREMENT ThrVlv_PosnCtrlB1_I.flgSoftLdgEna "Position Controller of the throttle valve of motor bench one / softlanding switched on" UBYTE OneToOne 1 100 0.00 1.000 BIT_MASK 0x1 FORMAT "%5.3" ECU_ADDRESS 0x50001AE0 /end MEASUREMENT
/begin MEASUREMENT ThrVlv_PosnCtrlB1_I.flgSoftLdgRegn "Position Controller of the throttle valve of motor bench one / position condition softlanding valid" UBYTE OneToOne 1 100 0.00 1.000 BIT_MASK 0x1 FORMAT "%5.3" ECU_ADDRESS 0x50001AE1 /end MEASUREMENT
/begin MEASUREMENT ThrVlv_PosnCtrlB1_I.flgSoftLmsLvngActv "Position Controller of the throttle valve of motor bench one / soft leaving active" UBYTE OneToOne 1 100 0.00 1.000 BIT_MASK 0x1 FORMAT "%5.3" ECU_ADDRESS 0x50001AE2 /end MEASUREMENT
/begin MEASUREMENT ThrVlv_PosnCtrlB1_I.flgSoftLmsLvngIniFil "Position Controller of the throttle valve of motor bench one / initialise desired position filter" UBYTE OneToOne 1 100 0.00 1.000 BIT_MASK 0x1 FORMAT "%5.3" ECU_ADDRESS 0x50001AE3 /end MEASUREMENT
/begin MEASUREMENT ThrVlv_PosnCtrlB1_I.flgSoftLmsLvngRegn "Position Controller of the throttle valve of motor bench one / position condition soft leaving valid" UBYTE OneToOne 1 100 0.00 1.000 BIT_MASK 0x1 FORMAT "%5.3" ECU_ADDRESS 0x50001AE4 /end MEASUREMENT
/begin MEASUREMENT ThrVlv_PosnCtrlB1_I.flgStrtEnd "Position Controller of the throttle valve of motor bench one / Local variable: end of start" UBYTE OneToOne 1 100 0.00 1.000 BIT_MASK 0x1 FORMAT "%5.3" ECU_ADDRESS 0x50001AE5 /end MEASUREMENT
/begin MEASUREMENT ThrVlv_PosnCtrlB1_I.flgStuckAtCls "Position Controller of the throttle valve of motor bench one / valve stuck at closing" UBYTE OneToOne 1 100 0.00 1.000 BIT_MASK 0x1 FORMAT "%5.3" ECU_ADDRESS 0x50001AE6 /end MEASUREMENT
/begin MEASUREMENT ThrVlv_PosnCtrlB1_I.flgStuckAtOpng "Position Controller of the throttle valve of motor bench one / valve stuck at opening" UBYTE OneToOne 1 100 0.00 1.000 BIT_MASK 0x1 FORMAT "%5.3" ECU_ADDRESS 0x50001AE7 /end MEASUREMENT
/begin MEASUREMENT ThrVlv_PosnCtrlB1_I.flgStuckPosnClsd "Position Controller of the throttle valve of motor bench one / valve is stuck in closed position" UBYTE OneToOne 1 100 0.00 1.000 BIT_MASK 0x1 FORMAT "%5.3" ECU_ADDRESS 0x50001AE8 /end MEASUREMENT
/begin MEASUREMENT ThrVlv_PosnCtrlB1_I.flgStuckPosnDetnActv "Position Controller of the throttle valve of motor bench one / stuck position detection active" UBYTE OneToOne 1 100 0.00 1.000 BIT_MASK 0x1 FORMAT "%5.3" ECU_ADDRESS 0x50001AE9 /end MEASUREMENT
/begin MEASUREMENT ThrVlv_PosnCtrlB1_I.flgStuckPosnOpen "Position Controller of the throttle valve of motor bench one / valve is stuck in open position" UBYTE OneToOne 1 100 0.00 1.000 BIT_MASK 0x1 FORMAT "%5.3" ECU_ADDRESS 0x50001AEA /end MEASUREMENT
/begin MEASUREMENT ThrVlv_PosnCtrlB1_I.flgStuckStrd "Position Controller of the throttle valve of motor bench one / stuckposition stored" UBYTE OneToOne 1 100 0.00 1.000 BIT_MASK 0x1 FORMAT "%5.3" ECU_ADDRESS 0x50001AEB /end MEASUREMENT
/begin MEASUREMENT ThrVlv_PosnCtrlB1_I.flgSwtOffCtrlStatyCdn "Position Controller of the throttle valve of motor bench one / stationary switch off of controller parts possible" UBYTE OneToOne 1 100 0.00 1.000 BIT_MASK 0x1 FORMAT "%5.3" ECU_ADDRESS 0x50001AEC /end MEASUREMENT
/begin MEASUREMENT ThrVlv_PosnCtrlB1_I.flgTDpdtDutyCycOffsLrnLim "Position Controller of the throttle valve of motor bench one / state dependent duty cycle limitation at offset learning active" UBYTE OneToOne 1 100 0.00 1.000 BIT_MASK 0x1 FORMAT "%5.3" ECU_ADDRESS 0x50001AED /end MEASUREMENT
/begin MEASUREMENT ThrVlv_PosnCtrlB1_I.flgTInvldDebd "Position Controller of the throttle valve of motor bench one / invalid temperature signal debounced" UBYTE OneToOne 1 100 0.00 1.000 BIT_MASK 0x1 FORMAT "%5.3" ECU_ADDRESS 0x50001AEE /end MEASUREMENT
/begin MEASUREMENT ThrVlv_PosnCtrlB1_I.flgTSnsrAdpnDoneDcyc "Position Controller of the throttle valve of motor bench one / temperature sensor adaptation done in this driving cycle" UBYTE OneToOne 1 100 0.00 1.000 BIT_MASK 0x1 FORMAT "%5.3" ECU_ADDRESS 0x50001AEF /end MEASUREMENT
/begin MEASUREMENT ThrVlv_PosnCtrlB1_I.flgTSnsrOffsAdpd "Position Controller of the throttle valve of motor bench one / status that temperature offset was adapted" UBYTE OneToOne 1 100 0.00 1.000 BIT_MASK 0x1 FORMAT "%5.3" ECU_ADDRESS 0x600362D5 /end MEASUREMENT
/begin MEASUREMENT ThrVlv_PosnCtrlB1_I.flgTVldDcyc "Position Controller of the throttle valve of motor bench one / temperature signal was valid in this driving cycle" UBYTE OneToOne 1 100 0.00 1.000 BIT_MASK 0x1 FORMAT "%5.3" ECU_ADDRESS 0x50001AF0 /end MEASUREMENT
/begin MEASUREMENT ThrVlv_PosnCtrlB1_I.flgTiEngOffCdn "Position Controller of the throttle valve of motor bench one / Time Engine Off Sufficient" UBYTE OneToOne 1 100 0.00 1.000 BIT_MASK 0x1 FORMAT "%5.3" ECU_ADDRESS 0x50001AF1 /end MEASUREMENT
/begin MEASUREMENT ThrVlv_PosnCtrlB1_I.flgTiSuffToReaLimpAirPosn "Position Controller of the throttle valve of motor bench one / time to reach limp air position is over" UBYTE OneToOne 1 100 0.00 1.000 BIT_MASK 0x1 FORMAT "%5.3" ECU_ADDRESS 0x50001AF2 /end MEASUREMENT
/begin MEASUREMENT ThrVlv_PosnCtrlB1_I.flgTrigHealDfc "Position Controller of the throttle valve of motor bench one / trigger for healing of DFC" UBYTE OneToOne 1 100 0.00 1.000 BIT_MASK 0x1 FORMAT "%5.3" ECU_ADDRESS 0x50001AF3 /end MEASUREMENT
/begin MEASUREMENT ThrVlv_PosnCtrlB1_I.flgTrjAdpnDurgSatn "Position Controller of the throttle valve of motor bench one / trajectory adaptation active" UBYTE OneToOne 1 100 0.00 1.000 BIT_MASK 0x1 FORMAT "%5.3" ECU_ADDRESS 0x50001AF4 /end MEASUREMENT
/begin MEASUREMENT ThrVlv_PosnCtrlB1_I.flgTrjAdpnInhb "Position Controller of the throttle valve of motor bench one / trajectory adaptation inhibited" UBYTE OneToOne 1 100 0.00 1.000 BIT_MASK 0x1 FORMAT "%5.3" ECU_ADDRESS 0x50001AF5 /end MEASUREMENT
/begin MEASUREMENT ThrVlv_PosnCtrlB1_I.flgVlvDrv "Position Controller of the throttle valve of motor bench one / valve driven to fail safe position" UBYTE OneToOne 1 100 0.00 1.000 BIT_MASK 0x1 FORMAT "%5.3" ECU_ADDRESS 0x50001AF6 /end MEASUREMENT
/begin MEASUREMENT ThrVlv_PosnCtrlB1_I.flgVvtEndPosn "Position Controller of the throttle valve of motor bench one / limp home driving with vvt: time for end position is over" UBYTE OneToOne 1 100 0.00 1.000 BIT_MASK 0x1 FORMAT "%5.3" ECU_ADDRESS 0x50001AF7 /end MEASUREMENT
/begin MEASUREMENT ThrVlv_PosnCtrlB1_I.flgXPostDrv "Position Controller of the throttle valve of motor bench one / extension of post drive" UBYTE OneToOne 1 100 0.00 1.000 BIT_MASK 0x1 FORMAT "%5.3" ECU_ADDRESS 0x50001AF8 /end MEASUREMENT
/begin MEASUREMENT ThrVlv_PosnCtrlB1_I.iElecMot "Position Controller of the throttle valve of motor bench one / current through actuator without countervoltage" SWORD i_q0p001_A 1 100 -32.76800 32.76700 FORMAT "%8.5" ECU_ADDRESS 0x50001AFA /end MEASUREMENT
/begin MEASUREMENT ThrVlv_PosnCtrlB1_I.idxActrTyp "Position Controller of the throttle valve of motor bench one / actuator type" UBYTE OneToOne 1 100 0.00 255.0 FORMAT "%5.1" ECU_ADDRESS 0x50001AFC /end MEASUREMENT
/begin MEASUREMENT ThrVlv_PosnCtrlB1_I.idxSnsrOffsAdpd "Position Controller of the throttle valve of motor bench one / index of array" UBYTE OneToOne 1 100 0.00 255.0 FORMAT "%5.1" ECU_ADDRESS 0x600362D6 /end MEASUREMENT
/begin MEASUREMENT ThrVlv_PosnCtrlB1_I.nrPntsSnsrOffsAdpd "Position Controller of the throttle valve of motor bench one / number of adapted offsets" UBYTE OneToOne 1 100 0.00 255.0 FORMAT "%5.1" ECU_ADDRESS 0x600362D7 /end MEASUREMENT
/begin MEASUREMENT ThrVlv_PosnCtrlB1_I.nrRepHeal "Position Controller of the throttle valve of motor bench one / number of accomplished healing trials" UBYTE OneToOne 1 100 0.00 255.0 FORMAT "%5.1" ECU_ADDRESS 0x50001AFD /end MEASUREMENT
/begin MEASUREMENT ThrVlv_PosnCtrlB1_I.nrRepHealDfc "Position Controller of the throttle valve of motor bench one / number of healing trials" UBYTE OneToOne 1 100 0.00 255.0 FORMAT "%5.1" ECU_ADDRESS 0x50001AFE /end MEASUREMENT
/begin MEASUREMENT ThrVlv_PosnCtrlB1_I.nrRepRamp "Position Controller of the throttle valve of motor bench one / number of pressure checks" UBYTE OneToOne 1 100 0.00 255.0 FORMAT "%5.1" ECU_ADDRESS 0x50001AFF /end MEASUREMENT
/begin MEASUREMENT ThrVlv_PosnCtrlB1_I.nrStepDetDfc "Position Controller of the throttle valve of motor bench one / step in detection of DFC" UBYTE OneToOne 1 100 0.00 255.0 FORMAT "%5.1" ECU_ADDRESS 0x50001B00 /end MEASUREMENT
/begin MEASUREMENT ThrVlv_PosnCtrlB1_I.nrStepFailSafeOlc "Position Controller of the throttle valve of motor bench one / step in open loop opening respectively closing" UBYTE OneToOne 1 100 0.00 255.0 FORMAT "%5.1" ECU_ADDRESS 0x50001B01 /end MEASUREMENT
/begin MEASUREMENT ThrVlv_PosnCtrlB1_I.nrStepHeal "Position Controller of the throttle valve of motor bench one / step in healing by desired value" UWORD OneToOne 1 100 0.00 65535.00 FORMAT "%8.2" ECU_ADDRESS 0x50001B02 /end MEASUREMENT
/begin MEASUREMENT ThrVlv_PosnCtrlB1_I.nrStepHealDfc "Position Controller of the throttle valve of motor bench one / step in healing of DFC" UBYTE OneToOne 1 100 0.00 255.0 FORMAT "%5.1" ECU_ADDRESS 0x50001B04 /end MEASUREMENT
/begin MEASUREMENT ThrVlv_PosnCtrlB1_I.nrStepLmsClsng "Position Controller of the throttle valve of motor bench one / step in valve closing to lower mechanical stop" UBYTE OneToOne 1 100 0.00 255.0 FORMAT "%5.1" ECU_ADDRESS 0x50001B05 /end MEASUREMENT
/begin MEASUREMENT ThrVlv_PosnCtrlB1_I.nrStepOpngAftLongHldClsd "Position Controller of the throttle valve of motor bench one / step in opening after long HldClsd" UWORD OneToOne 1 100 0.00 65535.00 FORMAT "%8.2" ECU_ADDRESS 0x50001B06 /end MEASUREMENT
/begin MEASUREMENT ThrVlv_PosnCtrlB1_I.nrStepTSnsrAdpn "Position Controller of the throttle valve of motor bench one / step in finite state machine" UBYTE OneToOne 1 100 0.00 255.0 FORMAT "%5.1" ECU_ADDRESS 0x50001B08 /end MEASUREMENT
/begin MEASUREMENT ThrVlv_PosnCtrlB1_I.rElecMot "Position Controller of the throttle valve of motor bench one / ohmic resistor" UWORD r_q0p001_Ohm 1 100 0.00100 65.53500 FORMAT "%8.5" ECU_ADDRESS 0x50001B0A /end MEASUREMENT
/begin MEASUREMENT ThrVlv_PosnCtrlB1_I.ratActPosnSdlg "Position Controller of the throttle valve of motor bench one / actual position for controller scheduling" SWORD rel_q0p0078125 1 100 -256.0000 255.9922 FORMAT "%8.4" ECU_ADDRESS 0x50001B0E /end MEASUREMENT
/begin MEASUREMENT ThrVlv_PosnCtrlB1_I.ratActSldgModOld "Position Controller of the throttle valve of motor bench one / actual position (old value)" SWORD rel_q0p0078125 1 100 -256.0000 255.9922 FORMAT "%8.4" ECU_ADDRESS 0x50001B10 /end MEASUREMENT
/begin MEASUREMENT ThrVlv_PosnCtrlB1_I.ratActSldgModOldOld "Position Controller of the throttle valve of motor bench one / actual position (old value)" SWORD rel_q0p0078125 1 100 -256.0000 255.9922 FORMAT "%8.4" ECU_ADDRESS 0x50001B12 /end MEASUREMENT
/begin MEASUREMENT ThrVlv_PosnCtrlB1_I.ratActSldgModOldOldOld "Position Controller of the throttle valve of motor bench one / actual position (old value)" SWORD rel_q0p0078125 1 100 -256.0000 255.9922 FORMAT "%8.4" ECU_ADDRESS 0x50001B14 /end MEASUREMENT
/begin MEASUREMENT ThrVlv_PosnCtrlB1_I.ratActThd "Position Controller of the throttle valve of motor bench one / threshold for actual position" SWORD rel_q0p0078125 1 100 -256.0000 255.9922 FORMAT "%8.4" ECU_ADDRESS 0x50001B16 /end MEASUREMENT
/begin MEASUREMENT ThrVlv_PosnCtrlB1_I.ratActVCalcnOld "Position Controller of the throttle valve of motor bench one / actual value (old value)" SWORD rel_q0p0078125 1 100 -256.0000 255.9922 FORMAT "%8.4" ECU_ADDRESS 0x50001B18 /end MEASUREMENT
/begin MEASUREMENT ThrVlv_PosnCtrlB1_I.ratDeCtrlr "Position Controller of the throttle valve of motor bench one / control deviation" SWORD rel_q0p0078125 1 100 -256.0000 255.9922 FORMAT "%8.4" ECU_ADDRESS 0x50001B1A /end MEASUREMENT
/begin MEASUREMENT ThrVlv_PosnCtrlB1_I.ratDeCtrlrEndVal "Position Controller of the throttle valve of motor bench one / control deviation relative to hard desired value" SWORD rel_q0p0078125 1 100 -256.0000 255.9922 FORMAT "%8.4" ECU_ADDRESS 0x50001B1C /end MEASUREMENT
/begin MEASUREMENT ThrVlv_PosnCtrlB1_I.ratDeCtrlrEndValAbslt "Position Controller of the throttle valve of motor bench one / absolute value of the control deviation relative to hard desired value" SWORD rel_q0p0078125 1 100 -256.0000 255.9922 FORMAT "%8.4" ECU_ADDRESS 0x50001B1E /end MEASUREMENT
/begin MEASUREMENT ThrVlv_PosnCtrlB1_I.ratDeCtrlrOld "Position Controller of the throttle valve of motor bench one / control deviation old value" SWORD rel_q0p0078125 1 100 -256.0000 255.9922 FORMAT "%8.4" ECU_ADDRESS 0x50001B20 /end MEASUREMENT
/begin MEASUREMENT ThrVlv_PosnCtrlB1_I.ratDeCtrlrSdlg "Position Controller of the throttle valve of motor bench one / control deviation for scheduling of the controller parameters" SWORD rel_q0p0078125 1 100 -256.0000 255.9922 FORMAT "%8.4" ECU_ADDRESS 0x50001B22 /end MEASUREMENT
/begin MEASUREMENT ThrVlv_PosnCtrlB1_I.ratDes "Position Controller of the throttle valve of motor bench one / desired position" SWORD rel_q0p0078125 1 100 -256.0000 255.9922 FORMAT "%8.4" ECU_ADDRESS 0x50001B24 /end MEASUREMENT
/begin MEASUREMENT ThrVlv_PosnCtrlB1_I.ratDesFil "Position Controller of the throttle valve of motor bench one / filtered desired value" SWORD rel_q0p0078125 1 100 -256.0000 255.9922 FORMAT "%8.4" ECU_ADDRESS 0x50001B26 /end MEASUREMENT
/begin MEASUREMENT ThrVlv_PosnCtrlB1_I.ratDesFilLowrLim "Position Controller of the throttle valve of motor bench one / lower limit for the allowed actual position" SWORD rel_q0p0078125 1 100 -256.0000 255.9922 FORMAT "%8.4" ECU_ADDRESS 0x50001B28 /end MEASUREMENT
/begin MEASUREMENT ThrVlv_PosnCtrlB1_I.ratDesFilUpprLim "Position Controller of the throttle valve of motor bench one / upper limit for the allowed actual position" SWORD rel_q0p0078125 1 100 -256.0000 255.9922 FORMAT "%8.4" ECU_ADDRESS 0x50001B2A /end MEASUREMENT
/begin MEASUREMENT ThrVlv_PosnCtrlB1_I.ratDesHldClsdAndOpen "Position Controller of the throttle valve of motor bench one / Desired Value at hold closed and hold open" SWORD rel_q0p0078125 1 100 -256.0000 255.9922 FORMAT "%8.4" ECU_ADDRESS 0x50001B2C /end MEASUREMENT
/begin MEASUREMENT ThrVlv_PosnCtrlB1_I.ratDesLim "Position Controller of the throttle valve of motor bench one / limited desired value from ASW" SWORD rel_q0p0078125 1 100 -256.0000 255.9922 FORMAT "%8.4" ECU_ADDRESS 0x50001B2E /end MEASUREMENT
/begin MEASUREMENT ThrVlv_PosnCtrlB1_I.ratDesOpngAftLongHldClsd "Position Controller of the throttle valve of motor bench one / desired position" SWORD rel_q0p0078125 1 100 -256.0000 255.9922 FORMAT "%8.4" ECU_ADDRESS 0x50001B30 /end MEASUREMENT
/begin MEASUREMENT ThrVlv_PosnCtrlB1_I.ratDesPreCtrl "Position Controller of the throttle valve of motor bench one / desired value pre-controller" SWORD rel_q0p0078125 1 100 -256.0000 255.9922 FORMAT "%8.4" ECU_ADDRESS 0x50001B32 /end MEASUREMENT
/begin MEASUREMENT ThrVlv_PosnCtrlB1_I.ratDesPreCtrlDftl "Position Controller of the throttle valve of motor bench one / desired value pre-controller" SLONG fak_q1p526Em5 1 100 -100.000000000 99.999984741 FORMAT "%13.9" ECU_ADDRESS 0x50001B34 /end MEASUREMENT
/begin MEASUREMENT ThrVlv_PosnCtrlB1_I.ratDesPreCtrlDftl2 "Position Controller of the throttle valve of motor bench one / desired value pre-controller" SLONG fak_q0p00195 1 100 -10000.0000000 9999.9980469 FORMAT "%13.7" ECU_ADDRESS 0x50001B38 /end MEASUREMENT
/begin MEASUREMENT ThrVlv_PosnCtrlB1_I.ratDesPreCtrlDftl2Old "Position Controller of the throttle valve of motor bench one / desired value pre-controller" SLONG fak_q0p00195 1 100 -10000.0000000 9999.9980469 FORMAT "%13.7" ECU_ADDRESS 0x50001B3C /end MEASUREMENT
/begin MEASUREMENT ThrVlv_PosnCtrlB1_I.ratDesPreCtrlDftlOld "Position Controller of the throttle valve of motor bench one / desired value pre-controller" SLONG fak_q1p526Em5 1 100 -100.000000000 99.999984741 FORMAT "%13.9" ECU_ADDRESS 0x50001B40 /end MEASUREMENT
/begin MEASUREMENT ThrVlv_PosnCtrlB1_I.ratDesPreCtrlOld "Position Controller of the throttle valve of motor bench one / desired value pre-controller" SWORD rel_q0p0078125 1 100 -256.0000 255.9922 FORMAT "%8.4" ECU_ADDRESS 0x50001B44 /end MEASUREMENT
/begin MEASUREMENT ThrVlv_PosnCtrlB1_I.ratDesPreCtrlRad "Position Controller of the throttle valve of motor bench one / desired value pre-controller" SLONG fak_sw_b0p03125 1 100 -2048.00000000 2047.99999905 FORMAT "%13.8" ECU_ADDRESS 0x50001B48 /end MEASUREMENT
/begin MEASUREMENT ThrVlv_PosnCtrlB1_I.ratDesPreCtrlRadOld "Position Controller of the throttle valve of motor bench one / desired value pre-controller" SLONG fak_sw_b0p03125 1 100 -2048.00000000 2047.99999905 FORMAT "%13.8" ECU_ADDRESS 0x50001B4C /end MEASUREMENT
/begin MEASUREMENT ThrVlv_PosnCtrlB1_I.ratDesRad "Position Controller of the throttle valve of motor bench one / filtered desired value radiant" FLOAT32_IEEE OneToOne 1 100 -1.00000000E+037 1.00000000E+037 FORMAT "%13.3" ECU_ADDRESS 0x50001B50 /end MEASUREMENT
/begin MEASUREMENT ThrVlv_PosnCtrlB1_I.ratDesRampDwn "Position Controller of the throttle valve of motor bench one / desired value to ramp down to the lower electric stop" SWORD rel_q0p0078125 1 100 -256.0000 255.9922 FORMAT "%8.4" ECU_ADDRESS 0x50001B54 /end MEASUREMENT
/begin MEASUREMENT ThrVlv_PosnCtrlB1_I.ratDesRampMem "Position Controller of the throttle valve of motor bench one / desired value to ramp down to the lower electric stop (stored value)" SWORD rel_q0p0078125 1 100 -256.0000 255.9922 FORMAT "%8.4" ECU_ADDRESS 0x50001B56 /end MEASUREMENT
/begin MEASUREMENT ThrVlv_PosnCtrlB1_I.ratDesSwt "Position Controller of the throttle valve of motor bench one / switched desired value" SWORD rel_q0p0078125 1 100 -256.0000 255.9922 FORMAT "%8.4" ECU_ADDRESS 0x50001B58 /end MEASUREMENT
/begin MEASUREMENT ThrVlv_PosnCtrlB1_I.ratDesSwtDeltaAbslt "Position Controller of the throttle valve of motor bench one / absolute change in desired value" SWORD rel_q0p0078125 1 100 -256.0000 255.9922 FORMAT "%8.4" ECU_ADDRESS 0x50001B5A /end MEASUREMENT
/begin MEASUREMENT ThrVlv_PosnCtrlB1_I.ratDesSwtOld "Position Controller of the throttle valve of motor bench one / switched desired value" SWORD rel_q0p0078125 1 100 -256.0000 255.9922 FORMAT "%8.4" ECU_ADDRESS 0x50001B5C /end MEASUREMENT
/begin MEASUREMENT ThrVlv_PosnCtrlB1_I.ratDesSwtUnlimSpOld "Position Controller of the throttle valve of motor bench one / switched desired value" SWORD rel_q0p0078125 1 100 -256.0000 255.9922 FORMAT "%8.4" ECU_ADDRESS 0x50001B5E /end MEASUREMENT
/begin MEASUREMENT ThrVlv_PosnCtrlB1_I.ratDesValFromHeal "Position Controller of the throttle valve of motor bench one / desired value from healing function" SWORD rel_q0p0078125 1 100 -256.0000 255.9922 FORMAT "%8.4" ECU_ADDRESS 0x50001B60 /end MEASUREMENT
/begin MEASUREMENT ThrVlv_PosnCtrlB1_I.ratDutyCycCompProtMax "Position Controller of the throttle valve of motor bench one / upper threshold for duty cycle limiting at component protection" SWORD rel_q0p0078125 1 100 -256.0000 255.9922 FORMAT "%8.4" ECU_ADDRESS 0x50001B62 /end MEASUREMENT
/begin MEASUREMENT ThrVlv_PosnCtrlB1_I.ratDutyCycCompProtMin "Position Controller of the throttle valve of motor bench one / lower threshold for duty cycle limiting at component protection" SWORD rel_q0p0078125 1 100 -256.0000 255.9922 FORMAT "%8.4" ECU_ADDRESS 0x50001B64 /end MEASUREMENT
/begin MEASUREMENT ThrVlv_PosnCtrlB1_I.ratDutyCycCtrl "Position Controller of the throttle valve of motor bench one / duty cycle output of the position controller after anti wind up" SWORD rel_q0p0078125 1 100 -256.0000 255.9922 FORMAT "%8.4" ECU_ADDRESS 0x50001B66 /end MEASUREMENT
/begin MEASUREMENT ThrVlv_PosnCtrlB1_I.ratDutyCycFailSafeOlc "Position Controller of the throttle valve of motor bench one / duty cycle at open loop opening respectively closing" SWORD rel_q0p0078125 1 100 -256.0000 255.9922 FORMAT "%8.4" ECU_ADDRESS 0x50001B68 /end MEASUREMENT
/begin MEASUREMENT ThrVlv_PosnCtrlB1_I.ratDutyCycGpfProtn "Position Controller of the throttle valve of motor bench one / controller output when particulate filter protection is active" SWORD rel_q0p0078125 1 100 -256.0000 255.9922 FORMAT "%8.4" ECU_ADDRESS 0x50001B6A /end MEASUREMENT
/begin MEASUREMENT ThrVlv_PosnCtrlB1_I.ratDutyCycHldClsd "Position Controller of the throttle valve of motor bench one / duty cycle at HldClosed" SWORD rel_q0p0078125 1 100 -256.0000 255.9922 FORMAT "%8.4" ECU_ADDRESS 0x50001B6C /end MEASUREMENT
/begin MEASUREMENT ThrVlv_PosnCtrlB1_I.ratDutyCycHldClsdCompProt "Position Controller of the throttle valve of motor bench one / duty cycle at HldClosed component protection" SWORD rel_q0p0078125 1 100 -256.0000 255.9922 FORMAT "%8.4" ECU_ADDRESS 0x50001B6E /end MEASUREMENT
/begin MEASUREMENT ThrVlv_PosnCtrlB1_I.ratDutyCycHldClsdDynPeak "Position Controller of the throttle valve of motor bench one / duty cycle hold closed dynamic peak" SWORD rel_q0p0078125 1 100 -256.0000 255.9922 FORMAT "%8.4" ECU_ADDRESS 0x50001B70 /end MEASUREMENT
/begin MEASUREMENT ThrVlv_PosnCtrlB1_I.ratDutyCycHldClsdMap "Position Controller of the throttle valve of motor bench one / duty cycle at HldClosed from map" SWORD rel_q0p0078125 1 100 -256.0000 255.9922 FORMAT "%8.4" ECU_ADDRESS 0x50001B72 /end MEASUREMENT
/begin MEASUREMENT ThrVlv_PosnCtrlB1_I.ratDutyCycHldOpen "Position Controller of the throttle valve of motor bench one / duty cycle at hold open" SWORD rel_q0p0078125 1 100 -256.0000 255.9922 FORMAT "%8.4" ECU_ADDRESS 0x50001B74 /end MEASUREMENT
/begin MEASUREMENT ThrVlv_PosnCtrlB1_I.ratDutyCycLmsClsng "Position Controller of the throttle valve of motor bench one / duty cycle at LmsClsng" SWORD rel_q0p0078125 1 100 -256.0000 255.9922 FORMAT "%8.4" ECU_ADDRESS 0x50001B76 /end MEASUREMENT
/begin MEASUREMENT ThrVlv_PosnCtrlB1_I.ratDutyCycMax "Position Controller of the throttle valve of motor bench one / upper limit for the duty cycle" SWORD rel_q0p0078125 1 100 -256.0000 255.9922 FORMAT "%8.4" ECU_ADDRESS 0x50001B78 /end MEASUREMENT
/begin MEASUREMENT ThrVlv_PosnCtrlB1_I.ratDutyCycMin "Position Controller of the throttle valve of motor bench one / lower limit for the duty cycle" SWORD rel_q0p0078125 1 100 -256.0000 255.9922 FORMAT "%8.4" ECU_ADDRESS 0x50001B7A /end MEASUREMENT
/begin MEASUREMENT ThrVlv_PosnCtrlB1_I.ratDutyCycOffsLrnLimNeg "Position Controller of the throttle valve of motor bench one / lower limit for the duty cycle at offset learning" SWORD rel_q0p0078125 1 100 -256.0000 255.9922 FORMAT "%8.4" ECU_ADDRESS 0x50001B7C /end MEASUREMENT
/begin MEASUREMENT ThrVlv_PosnCtrlB1_I.ratDutyCycOpenLoopOpng "Position Controller of the throttle valve of motor bench one / duty cycle at open loop opening" SWORD rel_q0p0078125 1 100 -256.0000 255.9922 FORMAT "%8.4" ECU_ADDRESS 0x50001B7E /end MEASUREMENT
/begin MEASUREMENT ThrVlv_PosnCtrlB1_I.ratDutyCycOpenLoopOpngCntr "Position Controller of the throttle valve of motor bench one / ramped duty cycle at open loop opening" SWORD rel_q0p0078125 1 100 -256.0000 255.9922 FORMAT "%8.4" ECU_ADDRESS 0x50001B80 /end MEASUREMENT
/begin MEASUREMENT ThrVlv_PosnCtrlB1_I.ratDutyCycOpenLoopOpngWoBattCmp "Position Controller of the throttle valve of motor bench one / duty cycle at open loop opening without compensation of the battery voltage" SWORD rel_q0p0078125 1 100 -256.0000 255.9922 FORMAT "%8.4" ECU_ADDRESS 0x50001B82 /end MEASUREMENT
/begin MEASUREMENT ThrVlv_PosnCtrlB1_I.ratDutyCycPreCtrl "Position Controller of the throttle valve of motor bench one / duty cycle of feed forward" SWORD rel_q0p0078125 1 100 -256.0000 255.9922 FORMAT "%8.4" ECU_ADDRESS 0x50001B84 /end MEASUREMENT
/begin MEASUREMENT ThrVlv_PosnCtrlB1_I.ratDutyCycRampDwnMin "Position Controller of the throttle valve of motor bench one / lower duty cycle limit near lower mechanical stop" SWORD rel_q0p0078125 1 100 -256.0000 255.9922 FORMAT "%8.4" ECU_ADDRESS 0x50001B86 /end MEASUREMENT
/begin MEASUREMENT ThrVlv_PosnCtrlB1_I.ratFilDlyOld "Position Controller of the throttle valve of motor bench one / old value of P-T1 of PD-T1" FLOAT32_IEEE OneToOne 1 100 -1.00000000E+037 1.00000000E+037 FORMAT "%13.3" ECU_ADDRESS 0x50001B88 /end MEASUREMENT
/begin MEASUREMENT ThrVlv_PosnCtrlB1_I.ratHldClsdAbortThd "Position Controller of the throttle valve of motor bench one / position where hold closed is deactivated" SWORD rel_q0p0078125 1 100 -256.0000 255.9922 FORMAT "%8.4" ECU_ADDRESS 0x50001B8C /end MEASUREMENT
/begin MEASUREMENT ThrVlv_PosnCtrlB1_I.ratHldClsdPosn "Position Controller of the throttle valve of motor bench one / position where hold closed is activated" SWORD rel_q0p0078125 1 100 -256.0000 255.9922 FORMAT "%8.4" ECU_ADDRESS 0x50001B8E /end MEASUREMENT
/begin MEASUREMENT ThrVlv_PosnCtrlB1_I.ratLimpAirPosnBand "Position Controller of the throttle valve of motor bench one / band around limp air position area" FLOAT32_IEEE OneToOne 1 100 -1.00000000E+037 1.00000000E+037 FORMAT "%13.3" ECU_ADDRESS 0x50001B90 /end MEASUREMENT
/begin MEASUREMENT ThrVlv_PosnCtrlB1_I.ratOffsClsdPosn "Position Controller of the throttle valve of motor bench one / offset on lower mechanical stop" SWORD rel_q0p0078125 1 100 -256.0000 255.9922 FORMAT "%8.4" ECU_ADDRESS 0x50001B94 /end MEASUREMENT
/begin MEASUREMENT ThrVlv_PosnCtrlB1_I.ratPPT1 "Position Controller of the throttle valve of motor bench one / output of the proportional proportional with lag" FLOAT32_IEEE OneToOne 1 100 -1.00000000E+037 1.00000000E+037 FORMAT "%13.3" ECU_ADDRESS 0x50001B98 /end MEASUREMENT
/begin MEASUREMENT ThrVlv_PosnCtrlB1_I.ratRampDwnStrt "Position Controller of the throttle valve of motor bench one / starting position where the ramp to the lower mechanical stop starts" SWORD rel_q0p0078125 1 100 -256.0000 255.9922 FORMAT "%8.4" ECU_ADDRESS 0x50001B9C /end MEASUREMENT
/begin MEASUREMENT ThrVlv_PosnCtrlB1_I.ratSldgSfc "Position Controller of the throttle valve of motor bench one / Sliding Surface" SLONG q0p0001_Perc 1 100 -214748.364800 214748.364700 FORMAT "%13.6" ECU_ADDRESS 0x50001BA0 /end MEASUREMENT
/begin MEASUREMENT ThrVlv_PosnCtrlB1_I.ratSldgSfcCubic "Position Controller of the throttle valve of motor bench one / Sliding Surface cubic part" SLONG q0p0001_Perc 1 100 -214748.364800 214748.364700 FORMAT "%13.6" ECU_ADDRESS 0x50001BA4 /end MEASUREMENT
/begin MEASUREMENT ThrVlv_PosnCtrlB1_I.ratSldgSfcDer "Position Controller of the throttle valve of motor bench one / Sliding Surface velocity dependent part" SLONG q0p0001_Perc 1 100 -214748.364800 214748.364700 FORMAT "%13.6" ECU_ADDRESS 0x50001BA8 /end MEASUREMENT
/begin MEASUREMENT ThrVlv_PosnCtrlB1_I.ratSldgSfcOld "Position Controller of the throttle valve of motor bench one / Sliding Surface" SLONG q0p0001_Perc 1 100 -214748.364800 214748.364700 FORMAT "%13.6" ECU_ADDRESS 0x50001BAC /end MEASUREMENT
/begin MEASUREMENT ThrVlv_PosnCtrlB1_I.ratSldgSfcSqrt "Position Controller of the throttle valve of motor bench one / Sliding Surface square root part" SLONG q0p0001_Perc 1 100 -214748.364800 214748.364700 FORMAT "%13.6" ECU_ADDRESS 0x50001BB0 /end MEASUREMENT
/begin MEASUREMENT ThrVlv_PosnCtrlB1_I.ratSoftLdgDecel "Position Controller of the throttle valve of motor bench one / start position for deceleration" SWORD rel_q0p0078125 1 100 -256.0000 255.9922 FORMAT "%8.4" ECU_ADDRESS 0x50001BB4 /end MEASUREMENT
/begin MEASUREMENT ThrVlv_PosnCtrlB1_I.ratSoftLdgStrt "Position Controller of the throttle valve of motor bench one / start position for softlanding" SWORD rel_q0p0078125 1 100 -256.0000 255.9922 FORMAT "%8.4" ECU_ADDRESS 0x50001BB6 /end MEASUREMENT
/begin MEASUREMENT ThrVlv_PosnCtrlB1_I.ratStuck "Position Controller of the throttle valve of motor bench one / actual position at which valve got stuck" SWORD rel_q0p0078125 1 100 -256.0000 255.9922 FORMAT "%8.4" ECU_ADDRESS 0x50001BB8 /end MEASUREMENT
/begin MEASUREMENT ThrVlv_PosnCtrlB1_I.ratStuckPosnOpenThd "Position Controller of the throttle valve of motor bench one / position threshold to detect a stuck open valve" SWORD rel_q0p0078125 1 100 -256.0000 255.9922 FORMAT "%8.4" ECU_ADDRESS 0x50001BBA /end MEASUREMENT
/begin MEASUREMENT ThrVlv_PosnCtrlB1_I.stMonPosnCtrl "Position Controller of the throttle valve of motor bench one / bit string with error and cycle flags" UWORD OneToOne 1 100 0.00 65535.00 FORMAT "%8.2" ECU_ADDRESS 0x50001BBC /end MEASUREMENT
/begin MEASUREMENT ThrVlv_PosnCtrlB1_I.stMonTSnsrAdpn "Position Controller of the throttle valve of motor bench one / bit string with error and cycle flags" UBYTE OneToOne 1 100 0.00 255.0 FORMAT "%5.1" ECU_ADDRESS 0x50001BBE /end MEASUREMENT
/begin MEASUREMENT ThrVlv_PosnCtrlB1_I.tElecMotEstimd "Position Controller of the throttle valve of motor bench one / estimated actuator temperature" SWORD Temp_Cels 1 100 -3549.940 3003.560 FORMAT "%8.3" ECU_ADDRESS 0x50001BC0 /end MEASUREMENT
/begin MEASUREMENT ThrVlv_PosnCtrlB1_I.tOffsElecMotSelfHeatg "Position Controller of the throttle valve of motor bench one / offset actuator temperature" SWORD Temp_Cels 1 100 -3549.940 3003.560 FORMAT "%8.3" ECU_ADDRESS 0x50001BC2 /end MEASUREMENT
/begin MEASUREMENT ThrVlv_PosnCtrlB1_I.tOffsSample "Position Controller of the throttle valve of motor bench one / in this driving cycle calculated temperature offset" SWORD Temp_Cels 1 100 -3549.940 3003.560 FORMAT "%8.3" ECU_ADDRESS 0x50001BC4 /end MEASUREMENT
/begin MEASUREMENT ThrVlv_PosnCtrlB1_I.tSnsrCorrd "Position Controller of the throttle valve of motor bench one / corrected temperature" SWORD Temp_Cels 1 100 -3549.940 3003.560 FORMAT "%8.3" ECU_ADDRESS 0x50001BC6 /end MEASUREMENT
/begin MEASUREMENT ThrVlv_PosnCtrlB1_I.tSnsrCorrdFild "Position Controller of the throttle valve of motor bench one / filtered corrected temperature" SWORD Temp_Cels 1 100 -3549.940 3003.560 FORMAT "%8.3" ECU_ADDRESS 0x50001BC8 /end MEASUREMENT
/begin MEASUREMENT ThrVlv_PosnCtrlB1_I.tSnsrOffsAdpd "Position Controller of the throttle valve of motor bench one / mean adapted temperature offset" SWORD Temp_Cels 1 100 -3549.940 3003.560 FORMAT "%8.3" ECU_ADDRESS 0x600362D8 /end MEASUREMENT
/begin MEASUREMENT ThrVlv_PosnCtrlB1_I.tSnsrOffsAdpd_a "Position Controller of the throttle valve of motor bench one / array of adapted temperature offsets" SWORD Temp_Cels 1 100 -3549.940 3003.560 FORMAT "%8.3" ARRAY_SIZE 5 ECU_ADDRESS 0x600362DA /end MEASUREMENT
/begin MEASUREMENT ThrVlv_PosnCtrlB1_I.tiCtrlDe "Position Controller of the throttle valve of motor bench one / debounce time control deviation" UWORD t_tev0p0005 1 100 0.00 31.99951 FORMAT "%8.5" ECU_ADDRESS 0x50001BCA /end MEASUREMENT
/begin MEASUREMENT ThrVlv_PosnCtrlB1_I.tiCtrlDeCsers "Position Controller of the throttle valve of motor bench one / debounce time control deviation" UWORD t_tev0p0005 1 100 0.00 31.99951 FORMAT "%8.5" ECU_ADDRESS 0x50001BCC /end MEASUREMENT
/begin MEASUREMENT ThrVlv_PosnCtrlB1_I.tiCtrlDeMaxCsers "Position Controller of the throttle valve of motor bench one / maximum debounce time control deviation" UWORD t_tev0p0005 1 100 0.00 31.99951 FORMAT "%8.5" ECU_ADDRESS 0x50001BCE /end MEASUREMENT
/begin MEASUREMENT ThrVlv_PosnCtrlB1_I.tiDebLowUBatt "Position Controller of the throttle valve of motor bench one / debounce time for a too low battery voltage" UWORD t_tev0p0005 1 100 0.00 31.99951 FORMAT "%8.5" ECU_ADDRESS 0x50001BD0 /end MEASUREMENT
/begin MEASUREMENT ThrVlv_PosnCtrlB1_I.tiDutyCycExcd "Position Controller of the throttle valve of motor bench one / debounce time duty cycle" UWORD t_tev0p0005 1 100 0.00 31.99951 FORMAT "%8.5" ECU_ADDRESS 0x50001BD2 /end MEASUREMENT
/begin MEASUREMENT ThrVlv_PosnCtrlB1_I.tiFilSwtSpdLimSoftLdg "Position Controller of the throttle valve of motor bench one / time constant filtered switchover of the speed limit" UWORD t_q0p001 1 100 0.00 1.000000 FORMAT "%8.6" ECU_ADDRESS 0x50001BD4 /end MEASUREMENT
/begin MEASUREMENT ThrVlv_PosnCtrlB1_I.tiHldClsdActv "Position Controller of the throttle valve of motor bench one / time after which opening after long HldClsd is allowed" ULONG t_tev0p0005 1 100 0.00 2097151.99951 FORMAT "%13.5" ECU_ADDRESS 0x50001BD8 /end MEASUREMENT
/begin MEASUREMENT ThrVlv_PosnCtrlB1_I.tiHldClsdDynPeak "Position Controller of the throttle valve of motor bench one / active time hold closed dynamic peak" UWORD t_tev0p0005 1 100 0.00 31.99951 FORMAT "%8.5" ECU_ADDRESS 0x50001BDC /end MEASUREMENT
/begin MEASUREMENT ThrVlv_PosnCtrlB1_I.tiOpng "Position Controller of the throttle valve of motor bench one / time at opening of the valve" UWORD t_tev0p0005 1 100 0.00 31.99951 FORMAT "%8.5" ECU_ADDRESS 0x50001BDE /end MEASUREMENT
/begin MEASUREMENT ThrVlv_PosnCtrlB1_I.tiPreCtrlFildOld "Position Controller of the throttle valve of motor bench one / filter time feedforward" FLOAT32_IEEE OneToOne 1 100 -1.00000000E+037 1.00000000E+037 FORMAT "%13.3" ECU_ADDRESS 0x50001BE0 /end MEASUREMENT
/begin MEASUREMENT ThrVlv_PosnCtrlB1_I.tiPreCtrlSlow "Position Controller of the throttle valve of motor bench one / filter time feedforward" SWORD t_tev0p0005 1 100 0.0014648 0.3002930 FORMAT "%9.7" ECU_ADDRESS 0x50001BE4 /end MEASUREMENT
/begin MEASUREMENT ThrVlv_PosnCtrlB1_I.tiPsRdy "Position Controller of the throttle valve of motor bench one / timer for detection of powerstage readiness" UWORD t_tev0p0005 1 100 0.00 31.99951 FORMAT "%8.5" ECU_ADDRESS 0x50001BE6 /end MEASUREMENT
/begin MEASUREMENT ThrVlv_PosnCtrlB1_I.tiReaDesPosn "Position Controller of the throttle valve of motor bench one / debounce time for reaching the desired value" UWORD t_tev0p0005 1 100 0.00 31.99951 FORMAT "%8.5" ECU_ADDRESS 0x50001BE8 /end MEASUREMENT
/begin MEASUREMENT ThrVlv_PosnCtrlB1_I.tiReaDesPosnFailSafe "Position Controller of the throttle valve of motor bench one / debounce time for reaching of fail safe position" UWORD t_tev0p0005 1 100 0.00 31.99951 FORMAT "%8.5" ECU_ADDRESS 0x50001BEA /end MEASUREMENT
/begin MEASUREMENT ThrVlv_PosnCtrlB1_I.tiVvtEndPosn "Position Controller of the throttle valve of motor bench one / limp home driving with vvt: delay time till ramp may be new triggered" UWORD t_tev0p0005 1 100 0.00 31.99951 FORMAT "%8.5" ECU_ADDRESS 0x50001BEC /end MEASUREMENT
/begin MEASUREMENT ThrVlv_PosnCtrlB1_I.tqFric "Position Controller of the throttle valve of motor bench one / friction torque" FLOAT32_IEEE OneToOne 1 100 -1.00000000E+037 1.00000000E+037 FORMAT "%13.3" ECU_ADDRESS 0x50001BF0 /end MEASUREMENT
/begin MEASUREMENT ThrVlv_PosnCtrlB1_I.tqFricOld "Position Controller of the throttle valve of motor bench one / friction torque" FLOAT32_IEEE OneToOne 1 100 -1.00000000E+037 1.00000000E+037 FORMAT "%13.3" ECU_ADDRESS 0x50001BF4 /end MEASUREMENT
/begin MEASUREMENT ThrVlv_PosnCtrlB1_I.uBalStrmInfl "Position Controller of the throttle valve of motor bench one / voltage feedforward of stream influences" SWORD spg_q0p001 1 100 -32.76800 32.76700 FORMAT "%8.5" ECU_ADDRESS 0x50001BF8 /end MEASUREMENT
/begin MEASUREMENT ThrVlv_PosnCtrlB1_I.uBattLimNeg "Position Controller of the throttle valve of motor bench one / lower limit of manipulated variable" SWORD fak_q0p0009766 1 100 -32.00000 31.99902 FORMAT "%8.5" ECU_ADDRESS 0x50001BFA /end MEASUREMENT
/begin MEASUREMENT ThrVlv_PosnCtrlB1_I.uBattLimPos "Position Controller of the throttle valve of motor bench one / upper limit of manipulated variable" SWORD fak_q0p0009766 1 100 -32.00000 31.99902 FORMAT "%8.5" ECU_ADDRESS 0x50001BFC /end MEASUREMENT
/begin MEASUREMENT ThrVlv_PosnCtrlB1_I.uCtrl "Position Controller of the throttle valve of motor bench one / voltage controller final output" SWORD spg_q0p001 1 100 -32.76800 32.76700 FORMAT "%8.5" ECU_ADDRESS 0x50001BFE /end MEASUREMENT
/begin MEASUREMENT ThrVlv_PosnCtrlB1_I.uCtrlDer "Position Controller of the throttle valve of motor bench one / voltage d part" SWORD spg_q0p001 1 100 -32.76800 32.76700 FORMAT "%8.5" ECU_ADDRESS 0x50001C00 /end MEASUREMENT
/begin MEASUREMENT ThrVlv_PosnCtrlB1_I.uCtrlDerFild "Position Controller of the throttle valve of motor bench one / voltage d part filtered" SWORD spg_q0p001 1 100 -32.76800 32.76700 FORMAT "%8.5" ECU_ADDRESS 0x50001C02 /end MEASUREMENT
/begin MEASUREMENT ThrVlv_PosnCtrlB1_I.uCtrlIntgl "Position Controller of the throttle valve of motor bench one / voltage integral part" SLONG q2p98023Em7_V 1 100 -640.000000000 639.999999702 FORMAT "%13.9" ECU_ADDRESS 0x50001C04 /end MEASUREMENT
/begin MEASUREMENT ThrVlv_PosnCtrlB1_I.uCtrlIntglOld "Position Controller of the throttle valve of motor bench one / voltage integral part old" SLONG q2p98023Em7_V 1 100 -640.000000000 639.999999702 FORMAT "%13.9" ECU_ADDRESS 0x50001C08 /end MEASUREMENT
/begin MEASUREMENT ThrVlv_PosnCtrlB1_I.uCtrlIntglRstAftLmsClsng "Position Controller of the throttle valve of motor bench one / voltage integral part reset value after lower mechanical stop closing" SLONG q2p98023Em7_V 1 100 -640.000000000 639.999999702 FORMAT "%13.9" ECU_ADDRESS 0x50001C0C /end MEASUREMENT
/begin MEASUREMENT ThrVlv_PosnCtrlB1_I.uCtrlProp "Position Controller of the throttle valve of motor bench one / voltage P part" SWORD spg_q0p001 1 100 -32.76800 32.76700 FORMAT "%8.5" ECU_ADDRESS 0x50001C10 /end MEASUREMENT
/begin MEASUREMENT ThrVlv_PosnCtrlB1_I.uCtrlSldgMod "Position Controller of the throttle valve of motor bench one / sliding mode controller output" SWORD spg_q0p001 1 100 -32.76800 32.76700 FORMAT "%8.5" ECU_ADDRESS 0x50001C12 /end MEASUREMENT
/begin MEASUREMENT ThrVlv_PosnCtrlB1_I.uDesPreCtrl "Position Controller of the throttle valve of motor bench one / voltage feedforward" SWORD fak_q0p0009766 1 100 -32.00000 31.99902 FORMAT "%8.5" ECU_ADDRESS 0x50001C14 /end MEASUREMENT
/begin MEASUREMENT ThrVlv_PosnCtrlB1_I.uDifOpngSprg "Position Controller of the throttle valve of motor bench one / differential voltage between the feedforward of the upper and the lower spring" FLOAT32_IEEE OneToOne 1 100 -1.00000000E+037 1.00000000E+037 FORMAT "%13.3" ECU_ADDRESS 0x50001C18 /end MEASUREMENT
/begin MEASUREMENT ThrVlv_PosnCtrlB1_I.uElecMotIndt "Position Controller of the throttle valve of motor bench one / induced voltage" SWORD spg_q0p001 1 100 -32.76800 32.76700 FORMAT "%8.5" ECU_ADDRESS 0x50001C1C /end MEASUREMENT
/begin MEASUREMENT ThrVlv_PosnCtrlB1_I.uElecMotIndtCmp "Position Controller of the throttle valve of motor bench one / compensation of induction voltage" SWORD spg_q0p001 1 100 -32.76800 32.76700 FORMAT "%8.5" ECU_ADDRESS 0x50001C1E /end MEASUREMENT
/begin MEASUREMENT ThrVlv_PosnCtrlB1_I.uElecMotIndtCmpFild "Position Controller of the throttle valve of motor bench one / compensation of induction voltage" SWORD spg_q0p001 1 100 -32.76800 32.76700 FORMAT "%8.5" ECU_ADDRESS 0x50001C20 /end MEASUREMENT
/begin MEASUREMENT ThrVlv_PosnCtrlB1_I.uElecMotTerminal "Position Controller of the throttle valve of motor bench one / terminal voltage" SWORD spg_q0p001 1 100 -32.76800 32.76700 FORMAT "%8.5" ECU_ADDRESS 0x50001C22 /end MEASUREMENT
/begin MEASUREMENT ThrVlv_PosnCtrlB1_I.uFbCtrlUnlim "Position Controller of the throttle valve of motor bench one / unlimited output of the feedback controller" SWORD spg_q0p001 1 100 -32.76800 32.76700 FORMAT "%8.5" ECU_ADDRESS 0x50001C24 /end MEASUREMENT
/begin MEASUREMENT ThrVlv_PosnCtrlB1_I.uFric "Position Controller of the throttle valve of motor bench one / voltage for friction feedforward" FLOAT32_IEEE OneToOne 1 100 -1.00000000E+037 1.00000000E+037 FORMAT "%13.3" ECU_ADDRESS 0x50001C28 /end MEASUREMENT
/begin MEASUREMENT ThrVlv_PosnCtrlB1_I.uLnrPreCtrl "Position Controller of the throttle valve of motor bench one / linear part of the feedforward voltage" FLOAT32_IEEE OneToOne 1 100 -1.00000000E+037 1.00000000E+037 FORMAT "%13.3" ECU_ADDRESS 0x50001C2C /end MEASUREMENT
/begin MEASUREMENT ThrVlv_PosnCtrlB1_I.uMinOpngSprg "Position Controller of the throttle valve of motor bench one / maximum differential voltage between the feedforward of the upper and the lower spring" FLOAT32_IEEE OneToOne 1 100 -1.00000000E+037 1.00000000E+037 FORMAT "%13.3" ECU_ADDRESS 0x50001C30 /end MEASUREMENT
/begin MEASUREMENT ThrVlv_PosnCtrlB1_I.uOffsTranLineOpngSprg "Position Controller of the throttle valve of motor bench one / offset of the transition line for compensation of the opening spring" FLOAT32_IEEE OneToOne 1 100 -1.00000000E+037 1.00000000E+037 FORMAT "%13.3" ECU_ADDRESS 0x50001C34 /end MEASUREMENT
/begin MEASUREMENT ThrVlv_PosnCtrlB1_I.uOhmR "Position Controller of the throttle valve of motor bench one / voltage drop at ohmic resistor" SWORD spg_q0p001 1 100 -32.76800 32.76700 FORMAT "%8.5" ECU_ADDRESS 0x50001C38 /end MEASUREMENT
/begin MEASUREMENT ThrVlv_PosnCtrlB1_I.uOpngSprgComp "Position Controller of the throttle valve of motor bench one / compensation of the opening spring" FLOAT32_IEEE OneToOne 1 100 -1.00000000E+037 1.00000000E+037 FORMAT "%13.3" ECU_ADDRESS 0x50001C3C /end MEASUREMENT
/begin MEASUREMENT ThrVlv_PosnCtrlB1_I.uSlopLowrLineOpngSprg "Position Controller of the throttle valve of motor bench one / gradient of the lower line for compensation of the opening spring" FLOAT32_IEEE OneToOne 1 100 -1.00000000E+037 1.00000000E+037 FORMAT "%13.3" ECU_ADDRESS 0x50001C40 /end MEASUREMENT
/begin MEASUREMENT ThrVlv_PosnCtrlB1_I.uSlopTranLineOpngSprg "Position Controller of the throttle valve of motor bench one / gradient of the transition line for compensation of the opening spring" FLOAT32_IEEE OneToOne 1 100 -1.00000000E+037 1.00000000E+037 FORMAT "%13.3" ECU_ADDRESS 0x50001C44 /end MEASUREMENT
/begin MEASUREMENT ThrVlv_PosnCtrlB1_I.uSprgCmp "Position Controller of the throttle valve of motor bench one / voltage spring compensation" SWORD spg_q0p001 1 100 -32.76800 32.76700 FORMAT "%8.5" ECU_ADDRESS 0x50001C48 /end MEASUREMENT
/begin MEASUREMENT ThrVlv_PosnCtrlB1_I.wghtSignIntglSldgMod "Position Controller of the throttle valve of motor bench one / weighted sum of sign of sliding surface and sign of gradient of sliding surface" SWORD fak_q0p01 1 100 -327.6800 327.6700 FORMAT "%8.4" ECU_ADDRESS 0x50001C4A /end MEASUREMENT
/begin MEASUREMENT ThrVlv_ratActAvrgB1 "Relative actual position calculated based on the average of both sensor voltages" SWORD rel_q0p0078125 1 100 -256.0000 255.9922 FORMAT "%8.4" ECU_ADDRESS 0x70002B90 /end MEASUREMENT
/begin MEASUREMENT ThrVlv_ratActIntB1 "Position of the throttle valve on motor bench one" SWORD rel_q0p0078125 1 100 -256.0000 255.9922 FORMAT "%8.4" ECU_ADDRESS 0x6000538A /end MEASUREMENT
/begin MEASUREMENT ThrVlv_ratActMnChrgSensFildB1 "Relative filtered charge signal" SWORD rel_q0p0078125 1 100 -256.0000 255.9922 FORMAT "%8.4" ECU_ADDRESS 0x70002B92 /end MEASUREMENT
/begin MEASUREMENT ThrVlv_ratActPosnB1 "Autosar named Actuatorposition" SWORD rel_q0p0078125 1 100 -256.0000 255.9922 FORMAT "%8.4" ECU_ADDRESS 0x50005B1E /end MEASUREMENT
/begin MEASUREMENT ThrVlv_ratActPosnMaxB1 "Maximal relative position of the throttle valve" SWORD rel_q0p0078125 1 100 -256.0000 255.9922 FORMAT "%8.4" ECU_ADDRESS 0x50005B22 /end MEASUREMENT
/begin MEASUREMENT ThrVlv_ratActPosnMinB1 "Minimal relative position of the throttle valve" SWORD rel_q0p0078125 1 100 -256.0000 255.9922 FORMAT "%8.4" ECU_ADDRESS 0x50005B24 /end MEASUREMENT
/begin MEASUREMENT ThrVlv_ratActSens1AbsltB1_u8 "Absolute throttle valve position in 0-100 of supply voltage" UBYTE relDK_q0p3922 1 100 0.00 100.0 FORMAT "%5.1" ECU_ADDRESS 0x6000E436 /end MEASUREMENT
/begin MEASUREMENT ThrVlv_ratActSens1B1 "Relative actual angle calculated based on voltage from sensor 1" SWORD rel_q0p0078125 1 100 -256.0000 255.9922 FORMAT "%8.4" ECU_ADDRESS 0x70002B94 /end MEASUREMENT
/begin MEASUREMENT ThrVlv_ratActSens1FildB1 "Filtered relative actual angle calculated based on voltage from sensor 1" SWORD rel_q0p0078125 1 100 -256.0000 255.9922 FORMAT "%8.4" ECU_ADDRESS 0x70002B96 /end MEASUREMENT
/begin MEASUREMENT ThrVlv_ratActSens1RelB1_u8 "Relative throttle valve position in of supply voltage above mechanical stop" UBYTE relDK_q0p3922 1 100 0.00 100.0 FORMAT "%5.1" ECU_ADDRESS 0x6000E437 /end MEASUREMENT
/begin MEASUREMENT ThrVlv_ratActSens2AbsltB1_u8 "Absolute throttle valve position in 0-100 of supply voltage reversed characteristics for sensor 2" UBYTE relDK_q0p3922 1 100 0.00 100.0 FORMAT "%5.1" ECU_ADDRESS 0x70002DA1 /end MEASUREMENT
/begin MEASUREMENT ThrVlv_ratActSens2B1 "Relative actual angle calculated based on voltage from sensor 2" SWORD rel_q0p0078125 1 100 -256.0000 255.9922 FORMAT "%8.4" ECU_ADDRESS 0x70002B98 /end MEASUREMENT
/begin MEASUREMENT ThrVlv_ratActSens2FildB1 "Filtered relative actual angle calculated based on voltage from sensor 2" SWORD rel_q0p0078125 1 100 -256.0000 255.9922 FORMAT "%8.4" ECU_ADDRESS 0x70002B9A /end MEASUREMENT
/begin MEASUREMENT ThrVlv_ratDeCtrlrB1 "Control deviation of throttle valve of motor bench one" SWORD rel_q0p0078125 1 100 -256.0000 255.9922 FORMAT "%8.4" ECU_ADDRESS 0x70002C90 /end MEASUREMENT
/begin MEASUREMENT ThrVlv_ratDesB1 "Desired throttle plate position" SWORD rel_q0p0078125 1 100 -256.0000 255.9922 FORMAT "%8.4" ECU_ADDRESS 0x60005386 /end MEASUREMENT
/begin MEASUREMENT ThrVlv_ratDesTstrB1 "Desired value from tester throttle valve motor bench 1" SWORD rel_q0p0078125 1 100 -256.0000 255.9922 FORMAT "%8.4" ECU_ADDRESS 0x60005384 /end MEASUREMENT
/begin MEASUREMENT ThrVlv_ratDutyCycB1 "Calculated duty cycle ratio" SWORD rel_q0p0078125 1 100 -256.0000 255.9922 FORMAT "%8.4" ECU_ADDRESS 0x60005382 /end MEASUREMENT
/begin MEASUREMENT ThrVlv_ratDutyCycB1_mp "Calculated duty cycle ratio measurement point" SWORD rel_q0p003052 1 100 -100.0000 99.9969 FORMAT "%8.4" ECU_ADDRESS 0x700087C4 /end MEASUREMENT
/begin MEASUREMENT ThrVlv_Sens_B1_I.Snsr1DiagPrms "Class instance from AirActr_Sens / Diagnosis is released for sensor 1" UBYTE OneToOne 1 100 0.00 1.000 BIT_MASK 0x1 FORMAT "%5.3" ECU_ADDRESS 0x50001CC2 /end MEASUREMENT
/begin MEASUREMENT ThrVlv_Sens_B1_I.cntComErr "Class instance from AirActr_Sens / Maximal number of communication errors for fast debouncing" UWORD OneToOne 1 100 0.00 65535.00 FORMAT "%8.2" ECU_ADDRESS 0x50001CC4 /end MEASUREMENT
/begin MEASUREMENT ThrVlv_Sens_B1_I.cntNoVldDataFast "Class instance from AirActr_Sens / Maximal number of no valid data frames for fast debouncing" UWORD OneToOne 1 100 0.00 65535.00 FORMAT "%8.2" ECU_ADDRESS 0x50001CC6 /end MEASUREMENT
/begin MEASUREMENT ThrVlv_Sens_B1_I.cntSnsrErrFast "Class instance from AirActr_Sens / Maximal number of internal sensor errors for fast debouncing" UWORD OneToOne 1 100 0.00 65535.00 FORMAT "%8.2" ECU_ADDRESS 0x50001CC8 /end MEASUREMENT
/begin MEASUREMENT ThrVlv_Sens_B1_I.flgSens1CharPosnMaxExcdd "Class instance from AirActr_Sens / Maximal characteristic angle threshold exceeded in a defined driving cycle by sensor 1" UBYTE OneToOne 1 100 0.00 1.000 BIT_MASK 0x1 FORMAT "%5.3" ECU_ADDRESS 0x50001CD9 /end MEASUREMENT
/begin MEASUREMENT ThrVlv_Sens_B1_I.flgSens1CharPosnMinExcdd "Class instance from AirActr_Sens / Minimal characteristic angle threshold exceeded in a defined driving cycle by sensor 1" UBYTE OneToOne 1 100 0.00 1.000 BIT_MASK 0x1 FORMAT "%5.3" ECU_ADDRESS 0x50001CDA /end MEASUREMENT
/begin MEASUREMENT ThrVlv_Sens_B1_I.flgSentComErrFast "Class instance from AirActr_Sens / Communication error for fast debouncing" UBYTE OneToOne 1 100 0.00 1.000 BIT_MASK 0x1 FORMAT "%5.3" ECU_ADDRESS 0x50001CF0 /end MEASUREMENT
/begin MEASUREMENT ThrVlv_Sens_B1_I.flgSentNoVldDataFast "Class instance from AirActr_Sens / Errorno valid data frames" UBYTE OneToOne 1 100 0.00 1.000 BIT_MASK 0x1 FORMAT "%5.3" ECU_ADDRESS 0x50001CF5 /end MEASUREMENT
/begin MEASUREMENT ThrVlv_Sens_B1_I.flgSnsrErrFast "Class instance from AirActr_Sens / Internal SENT sensor error" UBYTE OneToOne 1 100 0.00 1.000 BIT_MASK 0x1 FORMAT "%5.3" ECU_ADDRESS 0x50001CFE /end MEASUREMENT
/begin MEASUREMENT ThrVlv_Sens_B1_I.idxActrTyp "Class instance from AirActr_Sens / Type index of the air actuator" UBYTE OneToOne 1 100 0.00 8.000 FORMAT "%5.3" ECU_ADDRESS 0x50001D00 /end MEASUREMENT
/begin MEASUREMENT ThrVlv_Sens_B1_I.ratActIntSnsr "Class instance from AirActr_Sens / Position of the throttle valve on motor bench one" SWORD rel_q0p0078125 1 100 -256.0000 255.9922 FORMAT "%8.4" ECU_ADDRESS 0x50001D06 /end MEASUREMENT
/begin MEASUREMENT ThrVlv_stHbrdgB1 "State of the thottle valve powerstage bank 1" UBYTE OneToOne 1 100 0.00 255.0 FORMAT "%5.1" ECU_ADDRESS 0x6000626A /end MEASUREMENT
/begin MEASUREMENT ThrVlv_stMonPosnCtrlB1 "Monitoring status of the controller" UWORD OneToOne 1 100 0.00 65535.00 FORMAT "%8.2" ECU_ADDRESS 0x60005314 /end MEASUREMENT
/begin MEASUREMENT ThrVlv_stMonPsIfB1 "Error status of the powerstage bank 1" UBYTE OneToOne 1 100 0.00 255.0 FORMAT "%5.1" ECU_ADDRESS 0x6000A6EA /end MEASUREMENT
/begin MEASUREMENT ThrVlv_stMonSensB1 "Status of sensor monitoring" UWORD OneToOne 1 100 0.00 65535.00 FORMAT "%8.2" ECU_ADDRESS 0x60005312 /end MEASUREMENT
/begin MEASUREMENT ThrVlv_stPosnCtrlStB1 "status label of position controller throttle valve bench 1" UBYTE OneToOne 1 100 0.00 255.0 FORMAT "%5.1" ECU_ADDRESS 0x6000A6E8 /end MEASUREMENT
/begin MEASUREMENT ThrVlv_stPsErrB1_mp "Content of the powertage diagnosis register bank 1" ULONG OneToOne 1 100 0.00 4294967295.00 FORMAT "%13.2" ECU_ADDRESS 0x70008600 /end MEASUREMENT
/begin MEASUREMENT ThrVlv_uRawSens1B1 "Raw throttle valve voltage sensor 1 message" UWORD spg_q1p221_mV 1 100 0.00 79.99878 FORMAT "%8.5" ECU_ADDRESS 0x6000530A /end MEASUREMENT
/begin MEASUREMENT ThrVlv_uRawSens2B1 "Raw throttle valve voltage sensor 2 message" UWORD spg_q1p221_mV 1 100 0.00 79.99878 FORMAT "%8.5" ECU_ADDRESS 0x60005308 /end MEASUREMENT
/begin MEASUREMENT ThrVlv_uSens1B1 "Component package internal voltage sensor 1 throttle valve" UWORD spg_q1p221_mV 1 100 0.00 79.99878 FORMAT "%8.5" ECU_ADDRESS 0x60005306 /end MEASUREMENT
/begin MEASUREMENT ThrVlv_uSens2B1 "Component package internal voltage sensor 2 throttle valve" UWORD spg_q1p221_mV 1 100 0.00 79.99878 FORMAT "%8.5" ECU_ADDRESS 0x60005304 /end MEASUREMENT
/begin MEASUREMENT TiEngOff_bEngRot "Definition of engine Rotation for engine off time" UBYTE B_TRUE 1 100 0.00 1.00000000000 BIT_MASK 0x1 FORMAT "%13.11" ECU_ADDRESS 0x6000A119 /end MEASUREMENT
/begin MEASUREMENT TiEngOff_bRst "Definition of moment of reset of engine off time" UBYTE B_TRUE 1 100 0.00 1.00000000000 BIT_MASK 0x1 FORMAT "%13.11" ECU_ADDRESS 0x6000A118 /end MEASUREMENT
/begin MEASUREMENT TiEngOff_bTiEngOffEcuActv "condition ECU time off since the last engine stop activ" UBYTE B_TRUE 1 100 0.00 1.00000000000 BIT_MASK 0x1 FORMAT "%13.11" ECU_ADDRESS 0x6000A117 /end MEASUREMENT
/begin MEASUREMENT TiEngOff_stTi "State of engine off time" UBYTE OneToOne 1 100 0.00 255.0 FORMAT "%5.1" ECU_ADDRESS 0x6000A2DC /end MEASUREMENT
/begin MEASUREMENT TiEngOff_stTiFirstStrt "state of engine stop time copied at the time of first engine start in the driving cycle" UBYTE OneToOne 1 100 0.00 255.0 FORMAT "%5.1" ECU_ADDRESS 0x6000A2DB /end MEASUREMENT
/begin MEASUREMENT TiEngOff_stTiFirstStrtLoc "state of variable tengslst (local)" UBYTE OneToOne 1 100 0.00 255.0 FORMAT "%5.1" ECU_ADDRESS 0x6000625F /end MEASUREMENT
/begin MEASUREMENT TiEngOff_ti "engine off time" SLONG Time_sec_q1_COMPU 1 100 -2147483648.00 2147483647.00 FORMAT "%13.2" ECU_ADDRESS 0x60001CC0 /end MEASUREMENT
/begin MEASUREMENT TiEngOff_tiFirstStrt "engine stop time copied at the time of first engine start in the driving cycle" SLONG Time_sec_q1_COMPU 1 100 -2147483648.00 2147483647.00 FORMAT "%13.2" ECU_ADDRESS 0x6000D754 /end MEASUREMENT
/begin MEASUREMENT TiEngOff_tiFirstStrtLoc "engine stop time copied at the time of first engine start in the driving cycle (local)" SLONG Time_sec_q1_COMPU 1 100 0.00 2147483647.00 FORMAT "%13.2" ECU_ADDRESS 0x50001DCC /end MEASUREMENT
/begin MEASUREMENT TiEngOn_AvsCntr "Number of AVS set requests since initialization" UBYTE OneToOne 1 100 0.00 255.0 FORMAT "%5.1" ECU_ADDRESS 0x60006265 /end MEASUREMENT
/begin MEASUREMENT TiEngOn_AvsCntrLst "Local number of AVS set requests since initialization" UBYTE OneToOne 1 100 0.00 255.0 FORMAT "%5.1" ECU_ADDRESS 0x60006264 /end MEASUREMENT
/begin MEASUREMENT TiEngOn_flgEngRunTiPid7F "Condition : Engine running according to PID 0x7F" UBYTE B_TRUE 1 100 0.00 1.00000000000 BIT_MASK 0x1 FORMAT "%13.11" ECU_ADDRESS 0x60006268 /end MEASUREMENT
/begin MEASUREMENT TiEngOn_flgEngRunTiPtoPrmId7F "Condition : Engine running with PTO active according to PID 0x7F" UBYTE B_TRUE 1 100 0.00 1.00000000000 BIT_MASK 0x1 FORMAT "%13.11" ECU_ADDRESS 0x60006267 /end MEASUREMENT
/begin MEASUREMENT TiEngOn_flgIdleEngRunTiPrmId7F "Condition : Engine idle according to PID 0x7F" UBYTE B_TRUE 1 100 0.00 1.00000000000 BIT_MASK 0x1 FORMAT "%13.11" ECU_ADDRESS 0x60006266 /end MEASUREMENT
/begin MEASUREMENT TiEngOn_flgProgmEve "Condition : Reprogramming event detected" UBYTE B_TRUE 1 100 0.00 1.00000000000 BIT_MASK 0x1 FORMAT "%13.11" ECU_ADDRESS 0x60006269 /end MEASUREMENT
/begin MEASUREMENT TiEngOn_stRtId.RtId_TotIdleRt " / Status of Run Time RtId_TotIdleRt" UBYTE OneToOne 1 100 0.00 255.0 FORMAT "%5.1" ECU_ADDRESS 0x70002692 /end MEASUREMENT
/begin MEASUREMENT TiEngOn_stRtId.RtId_TotPtoRt " / Status of Run Time RtId_TotPtoRt" UBYTE OneToOne 1 100 0.00 255.0 FORMAT "%5.1" ECU_ADDRESS 0x70002693 /end MEASUREMENT
/begin MEASUREMENT TiEngOn_stRtId.RtId_TotRtObd " / Status of Run Time RtId_TotRtObd" UBYTE OneToOne 1 100 0.00 255.0 FORMAT "%5.1" ECU_ADDRESS 0x70002694 /end MEASUREMENT
/begin MEASUREMENT TiEngOn_tiRtId.RtId_TotIdleRt " / Total idle run time (OBD)" ULONG t_q1 1 100 0.00 4294967295.00 FORMAT "%13.2" ECU_ADDRESS 0x50001DD0 /end MEASUREMENT
/begin MEASUREMENT TiEngOn_tiRtId.RtId_TotPtoRt " / Total run time with PTO active (OBD)" ULONG t_q1 1 100 0.00 4294967295.00 FORMAT "%13.2" ECU_ADDRESS 0x50001DD4 /end MEASUREMENT
/begin MEASUREMENT TiEngOn_tiRtId.RtId_TotRtObd " / Total engine run time (OBD)" ULONG t_q1 1 100 0.00 4294967295.00 FORMAT "%13.2" ECU_ADDRESS 0x50001DD8 /end MEASUREMENT
/begin MEASUREMENT TiEngOn_tiTotEngRt "Total engine runtime" ULONG t_q1 1 100 0.00 4294967295.00 FORMAT "%13.2" ECU_ADDRESS 0x50004D6C /end MEASUREMENT
/begin MEASUREMENT TiEngOn_tiTotEngRtAux "Auxiliary counter of total engine runtime" SLONG Time_Dt 1 100 -2147.48364800 2147.48364700 FORMAT "%13.8" ECU_ADDRESS 0x50001DDC /end MEASUREMENT
/begin MEASUREMENT TiEngOn_tiTotEngRtAvs "Total engine runtime set by AVS interface" ULONG t_q1 1 100 0.00 4294967295.00 FORMAT "%13.2" ECU_ADDRESS 0x50001DE0 /end MEASUREMENT
/begin MEASUREMENT TiEngOn_tiTotEngRtNV "Total engine runtime stored in non volatile memory" ULONG t_q1 1 100 0.00 4294967295.00 FORMAT "%13.2" ECU_ADDRESS 0x50001DE4 /end MEASUREMENT
/begin MEASUREMENT TiEngOn_tiTotIgnOn "Total ignition on time" ULONG t_q1 1 100 0.00 4294967295.00 FORMAT "%13.2" ECU_ADDRESS 0x50004D74 /end MEASUREMENT
/begin MEASUREMENT TiEngOn_tiTotIgnOnAux "Auxiliary counter of total ignition on time" SLONG Time_Dt 1 100 -2147.48364800 2147.48364700 FORMAT "%13.8" ECU_ADDRESS 0x60001308 /end MEASUREMENT
/begin MEASUREMENT TiEngOn_tiTotIgnOnNv "Total ignition on time stored in non volatile memory" ULONG t_q1 1 100 0.00 4294967295.00 FORMAT "%13.2" ECU_ADDRESS 0x50001DE8 /end MEASUREMENT
/begin MEASUREMENT TiOff_bEngOffFirstStrtFinLoc "Bit: Detection of first engine stop after initialisation" UBYTE B_TRUE 1 100 0.00 1.00000000000 BIT_MASK 0x1 FORMAT "%13.11" ECU_ADDRESS 0x6000625A /end MEASUREMENT
/begin MEASUREMENT TiOff_bEngOffSwLoc "Bit. internal clock was just reset (local)" UBYTE B_TRUE 1 100 0.00 1.00000000000 BIT_MASK 0x1 FORMAT "%13.11" ECU_ADDRESS 0x7003AB74 /end MEASUREMENT
/begin MEASUREMENT TiOff_bEngRotLoc "Bit: Engine rotation detected (local)" UBYTE B_TRUE 1 100 0.00 1.00000000000 BIT_MASK 0x1 FORMAT "%13.11" ECU_ADDRESS 0x7003AB73 /end MEASUREMENT
/begin MEASUREMENT TiOff_bEngRstDeb "Bit: Engine off time has just been reset" UBYTE B_TRUE 1 100 0.00 1.00000000000 BIT_MASK 0x1 FORMAT "%13.11" ECU_ADDRESS 0x7003ABFC /end MEASUREMENT
/begin MEASUREMENT TiOff_bEngRstLoc "Bit: Engine stop detected (local)" UBYTE B_TRUE 1 100 0.00 1.00000000000 BIT_MASK 0x1 FORMAT "%13.11" ECU_ADDRESS 0x60006259 /end MEASUREMENT
/begin MEASUREMENT TiOff_bIniGap "Bit: detection of phase ecu was off" UBYTE B_TRUE 1 100 0.00 1.00000000000 BIT_MASK 0x1 FORMAT "%13.11" ECU_ADDRESS 0x7000063B /end MEASUREMENT
/begin MEASUREMENT TiOff_bIniGapLoc "Bit: detection of phase ecu was off (local)" UBYTE B_TRUE 1 100 0.00 1.00000000000 BIT_MASK 0x1 FORMAT "%13.11" ECU_ADDRESS 0x60006263 /end MEASUREMENT
/begin MEASUREMENT TiOff_bStrtEndOffActive "Bit: start-end off-time in hold mode (bit start end active)" UBYTE B_TRUE 1 100 0.00 1.00000000000 BIT_MASK 0x1 FORMAT "%13.11" ECU_ADDRESS 0x60009F85 /end MEASUREMENT
/begin MEASUREMENT TiOff_bStrtEndOffActiveFall "Bit: Engine stop detected (local)" UBYTE B_TRUE 1 100 0.00 1.00000000000 BIT_MASK 0x1 FORMAT "%13.11" ECU_ADDRESS 0x60006257 /end MEASUREMENT
/begin MEASUREMENT TiOff_bStrtEndOffActiveLoc "Bit: Engine rotation detected (local)" UBYTE B_TRUE 1 100 0.00 1.00000000000 BIT_MASK 0x1 FORMAT "%13.11" ECU_ADDRESS 0x60009F84 /end MEASUREMENT
/begin MEASUREMENT TiOff_bStrtEndOffFirstStrtFinLoc "Bit: Detection of first engine stop after initialisation" UBYTE B_TRUE 1 100 0.00 1.00000000000 BIT_MASK 0x1 FORMAT "%13.11" ECU_ADDRESS 0x60006256 /end MEASUREMENT
/begin MEASUREMENT TiOff_bStrtEndOffRst "Bit: Start end off time has recently been reset" UBYTE B_TRUE 1 100 0.00 1.00000000000 BIT_MASK 0x1 FORMAT "%13.11" ECU_ADDRESS 0x60009F83 /end MEASUREMENT
/begin MEASUREMENT TiOff_bStrtEndOffRstDeb "Bit: Start end off time has recently been reset (debounced)" UBYTE B_TRUE 1 100 0.00 1.00000000000 BIT_MASK 0x1 FORMAT "%13.11" ECU_ADDRESS 0x7003AB5F /end MEASUREMENT
/begin MEASUREMENT TiOff_bStrtEndOffRstLoc "Bit: Start end off time has recently been reset (local)" UBYTE B_TRUE 1 100 0.00 1.00000000000 BIT_MASK 0x1 FORMAT "%13.11" ECU_ADDRESS 0x60006255 /end MEASUREMENT
/begin MEASUREMENT TiOff_bStrtEndOffRstReIni "Bit: Engine rotation ReIni detected (local)" UBYTE B_TRUE 1 100 0.00 1.00000000000 BIT_MASK 0x1 FORMAT "%13.11" ECU_ADDRESS 0x60006254 /end MEASUREMENT
/begin MEASUREMENT TiOff_bStrtEndOffSwLoc "Bit. internal clock was just reset (local)" UBYTE B_TRUE 1 100 0.00 1.00000000000 BIT_MASK 0x1 FORMAT "%13.11" ECU_ADDRESS 0x7003AB5E /end MEASUREMENT
/begin MEASUREMENT TiOff_bTiEngOffEcuActvLoc "Bit: No powerfail has occured since last engine stop (local)" UBYTE B_TRUE 1 100 0.00 1.00000000000 BIT_MASK 0x1 FORMAT "%13.11" ECU_ADDRESS 0x600362CD /end MEASUREMENT
/begin MEASUREMENT TiOff_bTiEngOffRstReIni "Bit: Engine stop detected in ReIni" UBYTE B_TRUE 1 100 0.00 1.00000000000 BIT_MASK 0x1 FORMAT "%13.11" ECU_ADDRESS 0x6000625E /end MEASUREMENT
/begin MEASUREMENT TiOff_bTiEngOffRstRstrt "Bit: Engine stop detected by EngReStrt" UBYTE B_TRUE 1 100 0.00 1.00000000000 BIT_MASK 0x1 FORMAT "%13.11" ECU_ADDRESS 0x6000A116 /end MEASUREMENT
/begin MEASUREMENT TiOff_bTiHwClk "Bit. generic HW-Clock available" UBYTE B_TRUE 1 100 0.00 1.00000000000 BIT_MASK 0x1 FORMAT "%13.11" ECU_ADDRESS 0x7000063A /end MEASUREMENT
/begin MEASUREMENT TiOff_bTiHwClkRst "Bit. generic HW-Clock was just reset" UBYTE B_TRUE 1 100 0.00 1.00000000000 BIT_MASK 0x1 FORMAT "%13.11" ECU_ADDRESS 0x70000639 /end MEASUREMENT
/begin MEASUREMENT TiOff_bTiHwClkRstDiagDisbl "Bit: Reset of clock by diagnosis is disabled" UBYTE B_TRUE 1 100 0.00 1.00000000000 BIT_MASK 0x1 FORMAT "%13.11" ECU_ADDRESS 0x7003AB88 /end MEASUREMENT
/begin MEASUREMENT TiOff_bTiHwClkRstLoc "Bit. generic HW-Clock was just reset (local)" UBYTE B_TRUE 1 100 0.00 1.00000000000 BIT_MASK 0x1 FORMAT "%13.11" ECU_ADDRESS 0x60006262 /end MEASUREMENT
/begin MEASUREMENT TiOff_bTiStrtEndActOld "Bit: last state start-end system activ" UBYTE B_TRUE 1 100 0.00 1.00000000000 BIT_MASK 0x1 FORMAT "%13.11" ECU_ADDRESS 0x7003AB5D /end MEASUREMENT
/begin MEASUREMENT TiOff_bXPostDrvTiEngOff "Bit: Post drive extension by TiOff_VdTiEngOff" UBYTE B_TRUE 1 100 0.00 1.00000000000 BIT_MASK 0x1 FORMAT "%13.11" ECU_ADDRESS 0x60006258 /end MEASUREMENT
/begin MEASUREMENT TiOff_bXPostDrvTiStrtEndOff "Bit to request post drive prolonguation within TiStrtEnd" UBYTE B_TRUE 1 100 0.00 1.00000000000 BIT_MASK 0x1 FORMAT "%13.11" ECU_ADDRESS 0x60006253 /end MEASUREMENT
/begin MEASUREMENT TiOff_cntrDsmClearTBasdChk "DSM-Clear-counter" UBYTE OneToOne 1 100 0.00 255.0 FORMAT "%5.1" ECU_ADDRESS 0x6000A00A /end MEASUREMENT
/begin MEASUREMENT TiOff_cntrDsmClearTBasdChkLst "DSM-Clear-counter (reference)" UBYTE OneToOne 1 100 0.00 255.0 FORMAT "%5.1" ECU_ADDRESS 0x60006261 /end MEASUREMENT
/begin MEASUREMENT TiOff_cntrEngOffRst "Reset-counter of engine off time based on engine rotation" UBYTE OneToOne 1 100 0.00 255.0 FORMAT "%5.1" ECU_ADDRESS 0x6000A009 /end MEASUREMENT
/begin MEASUREMENT TiOff_cntrEngOffRstLoc "Local reset-counter of engine of engine off time based on engine rotation" UBYTE OneToOne 1 100 0.00 255.0 FORMAT "%5.1" ECU_ADDRESS 0x7003ABFD /end MEASUREMENT
/begin MEASUREMENT TiOff_cntrEngOffRstOld "Local reset-counter of engine of engine off time based on engine rotation from last call" UBYTE OneToOne 1 100 0.00 255.0 FORMAT "%5.1" ECU_ADDRESS 0x7003AB72 /end MEASUREMENT
/begin MEASUREMENT TiOff_cntrStrtEndOffRst "reset-counter of engine of engine off time based on start-end" UBYTE OneToOne 1 100 0.00 255.0 FORMAT "%5.1" ECU_ADDRESS 0x6000A008 /end MEASUREMENT
/begin MEASUREMENT TiOff_cntrStrtEndOffRstLoc "Local reset-counter of engine of engine off time based on start-end" UBYTE OneToOne 1 100 0.00 255.0 FORMAT "%5.1" ECU_ADDRESS 0x7003AB5C /end MEASUREMENT
/begin MEASUREMENT TiOff_cntrStrtEndOffRstOld "Local reset-counter of engine of engine off time based on start-end from last call" UBYTE OneToOne 1 100 0.00 255.0 FORMAT "%5.1" ECU_ADDRESS 0x7003AB5B /end MEASUREMENT
/begin MEASUREMENT TiOff_ctEngOffReIni "internal delay time for ReIni recognition" UBYTE OneToOne 1 100 0.00 255.0 FORMAT "%5.1" ECU_ADDRESS 0x6000625D /end MEASUREMENT
/begin MEASUREMENT TiOff_ctStrtEndOffReIni "internal counter for ReIni detection" UBYTE OneToOne 1 100 0.00 255.0 FORMAT "%5.1" ECU_ADDRESS 0x60006252 /end MEASUREMENT
/begin MEASUREMENT TiOff_flgEcuNotOffTBasdChkProt "local flag in protected ram to indicate the status of ecu right before initialisation" UBYTE B_TRUE 1 100 0.00 1.00000000000 BIT_MASK 0x1 FORMAT "%13.11" ECU_ADDRESS 0x60034730 /end MEASUREMENT
/begin MEASUREMENT TiOff_flgTBasdChkFastPhyEna "Phyiscal enable for T-Based check (fast)" UBYTE B_TRUE 1 100 0.00 1.00000000000 BIT_MASK 0x1 FORMAT "%13.11" ECU_ADDRESS 0x7000010A /end MEASUREMENT
/begin MEASUREMENT TiOff_flgTBasdChkSlowPhyEna "Phyiscal enable for T-Based check (slow)" UBYTE B_TRUE 1 100 0.00 1.00000000000 BIT_MASK 0x1 FORMAT "%13.11" ECU_ADDRESS 0x70000109 /end MEASUREMENT
/begin MEASUREMENT TiOff_ratCoolDwnTBasdChk "Ratio of current cool down compared to last T15-off-event" UWORD fak_q0p000488 1 100 0.00 1.000000 FORMAT "%8.6" ECU_ADDRESS 0x60003508 /end MEASUREMENT
/begin MEASUREMENT TiOff_stTBasdChk "state of temperature based check of the ecu-off-time clock" UBYTE OneToOne 1 100 0.00 255.0 FORMAT "%5.1" ECU_ADDRESS 0x60006260 /end MEASUREMENT
/begin MEASUREMENT TiOff_stTiEngOffHw "Status of engine off time based on HW-clock" UBYTE OneToOne 1 100 0.00 255.0 FORMAT "%5.1" ECU_ADDRESS 0x6000625C /end MEASUREMENT
/begin MEASUREMENT TiOff_stTiEngOffHwEnd "Status of end timestamp of HW clock" UBYTE OneToOne 1 100 0.00 255.0 FORMAT "%5.1" ECU_ADDRESS 0x7003AB71 /end MEASUREMENT
/begin MEASUREMENT TiOff_stTiEngOffHwStart "Status of start timestamp of HW clock" UBYTE OneToOne 1 100 0.00 255.0 FORMAT "%5.1" ECU_ADDRESS 0x7003AB70 /end MEASUREMENT
/begin MEASUREMENT TiOff_stTiEngOffLoc "Status of engine off time (local)" UBYTE OneToOne 1 100 0.00 255.0 FORMAT "%5.1" ECU_ADDRESS 0x6000625B /end MEASUREMENT
/begin MEASUREMENT TiOff_stTiStrtEndActn "State to detremine what start- end time has to do" UBYTE OneToOne 1 100 0.00 255.0 FORMAT "%5.1" ECU_ADDRESS 0x7003AB5A /end MEASUREMENT
/begin MEASUREMENT TiOff_stTiStrtEndOff "state of off time based on start-end recognition" UBYTE OneToOne 1 100 0.00 255.0 FORMAT "%5.1" ECU_ADDRESS 0x6000A007 /end MEASUREMENT
/begin MEASUREMENT TiOff_stTiStrtEndOffFirstStrt "start-end-time after start" UBYTE OneToOne 1 100 0.00 255.0 FORMAT "%5.1" ECU_ADDRESS 0x6000A006 /end MEASUREMENT
/begin MEASUREMENT TiOff_stTiStrtEndOffFirstStrtLoc "start-end time after start (local)" UBYTE OneToOne 1 100 0.00 255.0 FORMAT "%5.1" ECU_ADDRESS 0x60006251 /end MEASUREMENT
/begin MEASUREMENT TiOff_stTiStrtEndOffHw "start-end time using a start-end clock" UBYTE OneToOne 1 100 0.00 255.0 FORMAT "%5.1" ECU_ADDRESS 0x7003AB59 /end MEASUREMENT
/begin MEASUREMENT TiOff_stTiStrtEndOffHwEnd "End point of the start-end -time based on HW-Clock" UBYTE OneToOne 1 100 0.00 255.0 FORMAT "%5.1" ECU_ADDRESS 0x7003AB58 /end MEASUREMENT
/begin MEASUREMENT TiOff_stTiStrtEndOffHwStart "State of the start point of the start-end time using a HW-clock" UBYTE OneToOne 1 100 0.00 255.0 FORMAT "%5.1" ECU_ADDRESS 0x7003AB57 /end MEASUREMENT
/begin MEASUREMENT TiOff_stTiStrtEndOffLoc "State of the start- end time (local)" UBYTE OneToOne 1 100 0.00 255.0 FORMAT "%5.1" ECU_ADDRESS 0x7003AB56 /end MEASUREMENT
/begin MEASUREMENT TiOff_stTiStrtEndOffMdlEnd "End point of the start-end -time based on model-clock" UBYTE OneToOne 1 100 0.00 255.0 FORMAT "%5.1" ECU_ADDRESS 0x7003AB55 /end MEASUREMENT
/begin MEASUREMENT TiOff_stTiStrtEndOffMdlStart "State of the start point of the start-end time using a model-clock" UBYTE OneToOne 1 100 0.00 255.0 FORMAT "%5.1" ECU_ADDRESS 0x7003AB54 /end MEASUREMENT
/begin MEASUREMENT TiOff_stVdClkEcuOnIndcn "semaphore to detect an ecu-off-phase" ULONG OneToOne 1 100 0.00 4294967295.00 FORMAT "%13.2" ECU_ADDRESS 0x7003AB84 /end MEASUREMENT
/begin MEASUREMENT TiOff_stVdTiEngOffEcuOnIndcn "Indiciation, to detect, if the ECU had been shutdown before the initialization" ULONG OneToOne 1 100 0.00 4294967295.00 FORMAT "%13.2" ECU_ADDRESS 0x7003AB6C /end MEASUREMENT
/begin MEASUREMENT TiOff_stVdTiStrtEndOffEcuOnIndcn "ECU off indication" ULONG OneToOne 1 100 0.00 4294967295.00 FORMAT "%13.2" ECU_ADDRESS 0x7003AB50 /end MEASUREMENT
/begin MEASUREMENT TiOff_tCEngDsTT15StopTBasdChk "engine coolant temperature at last T15-off-event" SWORD Temp_Cels 1 100 -3549.940 3003.560 FORMAT "%8.3" ECU_ADDRESS 0x60003506 /end MEASUREMENT
/begin MEASUREMENT TiOff_tCEngDsTT15StrtTBasdChk "engine coolant tempeature at last T15-on-event" SWORD Temp_Cels 1 100 -3549.940 3003.560 FORMAT "%8.3" ECU_ADDRESS 0x60003504 /end MEASUREMENT
/begin MEASUREMENT TiOff_tDiffCEngDsTPsblTBasdChk "possible cool down of the coolant temperature within last T15-off-phase" SWORD TempDiff_Kelv 1 100 -3276.800 3276.700 FORMAT "%8.3" ECU_ADDRESS 0x60003502 /end MEASUREMENT
/begin MEASUREMENT TiOff_tDiffCEngDsTTBasdChk "cool down of the engine coolant temperature within the last T15-off-phase" SWORD TempDiff_Kelv 1 100 -3276.800 3276.700 FORMAT "%8.3" ECU_ADDRESS 0x60003500 /end MEASUREMENT
/begin MEASUREMENT TiOff_tEnvTSensT15StrtTBasdChk "ambient air temperature at last T15-on-event" SWORD Temp_Cels 1 100 -3549.940 3003.560 FORMAT "%8.3" ECU_ADDRESS 0x600034FE /end MEASUREMENT
/begin MEASUREMENT TiOff_tiCumEcuOffTBasdChk "accumulated ecu-off-time since last T15-off-event" SLONG t_q1 1 100 -2147483648.00 2147483647.00 FORMAT "%13.2" ECU_ADDRESS 0x60001304 /end MEASUREMENT
/begin MEASUREMENT TiOff_tiEngOffHw "Engine off time based on HW clock" SLONG Time_sec_q1_COMPU 1 100 0.00 2147483647.00 FORMAT "%13.2" ECU_ADDRESS 0x600012FC /end MEASUREMENT
/begin MEASUREMENT TiOff_tiEngOffHwEnd "End timestamp of HW clock" SLONG Time_sec_q1_COMPU 1 100 -2147483648.00 2147483647.00 FORMAT "%13.2" ECU_ADDRESS 0x7003AB68 /end MEASUREMENT
/begin MEASUREMENT TiOff_tiEngOffHwStart "Start timestamp of HW-clock" SLONG Time_sec_q1_COMPU 1 100 -2147483648.00 2147483647.00 FORMAT "%13.2" ECU_ADDRESS 0x7003AB64 /end MEASUREMENT
/begin MEASUREMENT TiOff_tiEngOffLoc "Engine off time (local)" SLONG Time_sec_q1_COMPU 1 100 0.00 2147483647.00 FORMAT "%13.2" ECU_ADDRESS 0x50001DEC /end MEASUREMENT
/begin MEASUREMENT TiOff_tiEngOffSwAux "Internal counter of software clock" SLONG Time_Dt 1 100 0.00 2147.48364700 FORMAT "%13.8" ECU_ADDRESS 0x600012F8 /end MEASUREMENT
/begin MEASUREMENT TiOff_tiEngOffSwLoc "Engine off time based on software clock" SLONG Time_sec_q1_COMPU 1 100 0.00 2147483647.00 FORMAT "%13.2" ECU_ADDRESS 0x7003AB60 /end MEASUREMENT
/begin MEASUREMENT TiOff_tiHwClk "value of generic HW-Clock" SLONG Time_sec_q1_COMPU 1 100 -2147483648.00 2147483647.00 FORMAT "%13.2" ECU_ADDRESS 0x60001C00 /end MEASUREMENT
/begin MEASUREMENT TiOff_tiHwClkLoc "value of generic HW-Clock (lokal)" SLONG Time_sec_q1_COMPU 1 100 0.00 2147483647.00 FORMAT "%13.2" ECU_ADDRESS 0x7003AB80 /end MEASUREMENT
/begin MEASUREMENT TiOff_tiHwClkLstGap "value of the last gap of the generic HW-Clock" SLONG Time_sec_q1_COMPU 1 100 -2147483648.00 2147483647.00 FORMAT "%13.2" ECU_ADDRESS 0x60001BFC /end MEASUREMENT
/begin MEASUREMENT TiOff_tiHwClkStop "Time value of last stop of HW-Clock" SLONG Time_sec_q1_COMPU 1 100 -2147483648.00 2147483647.00 FORMAT "%13.2" ECU_ADDRESS 0x60001BF8 /end MEASUREMENT
/begin MEASUREMENT TiOff_tiHwClkStopLoc "Time value of last stop of HW-Clock (local)" SLONG Time_sec_q1_COMPU 1 100 0.00 2147483647.00 FORMAT "%13.2" ECU_ADDRESS 0x7003AB7C /end MEASUREMENT
/begin MEASUREMENT TiOff_tiHwClkWakeupLoc "value of the generalized HW clock after reset (locally)" SLONG Time_sec_q1_COMPU 1 100 0.00 2147483647.00 FORMAT "%13.2" ECU_ADDRESS 0x7003AB78 /end MEASUREMENT
/begin MEASUREMENT TiOff_tiStrtEndOff "off time based on start- end recognition" SLONG Time_sec_q1_COMPU 1 100 -2147483648.00 2147483647.00 FORMAT "%13.2" ECU_ADDRESS 0x6000D758 /end MEASUREMENT
/begin MEASUREMENT TiOff_tiStrtEndOffFirstStrt "start end time after start" SLONG Time_sec_q1_COMPU 1 100 -2147483648.00 2147483647.00 FORMAT "%13.2" ECU_ADDRESS 0x60001BF4 /end MEASUREMENT
/begin MEASUREMENT TiOff_tiStrtEndOffFirstStrtLoc "start-end time after start (local)" SLONG Time_sec_q1_COMPU 1 100 -2147483648.00 2147483647.00 FORMAT "%13.2" ECU_ADDRESS 0x50001DF0 /end MEASUREMENT
/begin MEASUREMENT TiOff_tiStrtEndOffHw "start-end time using a HW-Clock" SLONG Time_sec_q1_COMPU 1 100 0.00 2147483647.00 FORMAT "%13.2" ECU_ADDRESS 0x7003AB4C /end MEASUREMENT
/begin MEASUREMENT TiOff_tiStrtEndOffHwEnd "End point of the start-end-time based on HW-Clock" SLONG Time_sec_q1_COMPU 1 100 -2147483648.00 2147483647.00 FORMAT "%13.2" ECU_ADDRESS 0x7003AB48 /end MEASUREMENT
/begin MEASUREMENT TiOff_tiStrtEndOffHwStart "Start point of the start -end-time based on HW-Clock" SLONG Time_sec_q1_COMPU 1 100 -2147483648.00 2147483647.00 FORMAT "%13.2" ECU_ADDRESS 0x7003AB44 /end MEASUREMENT
/begin MEASUREMENT TiOff_tiStrtEndOffLoc "start- end time (local)" SLONG Time_sec_q1_COMPU 1 100 0.00 2147483647.00 FORMAT "%13.2" ECU_ADDRESS 0x7003AB40 /end MEASUREMENT
/begin MEASUREMENT TiOff_tiStrtEndOffMdlEnd "End point of the start-end-time based on model-clock" SLONG Time_sec_q1_COMPU 1 100 -2147483648.00 2147483647.00 FORMAT "%13.2" ECU_ADDRESS 0x7003AB3C /end MEASUREMENT
/begin MEASUREMENT TiOff_tiStrtEndOffSwAux "low counter of the generic internal-Clock" SLONG Time_Dt 1 100 -2147.48364800 2147.48364700 FORMAT "%13.8" ECU_ADDRESS 0x7003AB38 /end MEASUREMENT
/begin MEASUREMENT TiOff_tiStrtEndOffSwLoc "value of generic internal-Clock (lokal)" SLONG Time_sec_q1_COMPU 1 100 -2147483648.00 2147483647.00 FORMAT "%13.2" ECU_ADDRESS 0x7003AB34 /end MEASUREMENT
/begin MEASUREMENT TiOff_tiSwClkAux "low counter of the generic HW-Clock" SLONG Time_Dt 1 100 -2147.48364800 2147.48364700 FORMAT "%13.8" ECU_ADDRESS 0x50001DF4 /end MEASUREMENT
/begin MEASUREMENT TiOff_tiT15OffEcuOnTBasdChk "accumulated ecu-on-time since last T15-off-event" SLONG t_q1 1 100 -2147483648.00 2147483647.00 FORMAT "%13.2" ECU_ADDRESS 0x50001DF8 /end MEASUREMENT
/begin MEASUREMENT TiOff_tiT15OffMinsTBasdChk "off time in minutes for temperatur based check" UWORD Time_min_q1_COMPU 1 100 0.00 65535.00 FORMAT "%8.2" ECU_ADDRESS 0x600034FC /end MEASUREMENT
/begin MEASUREMENT TiOff_tiT15OffSecTrigTBasdChk "local counter to trigger temperature based check" SLONG Time_Dt 1 100 -2147.48364800 2147.48364700 FORMAT "%13.8" ECU_ADDRESS 0x60001300 /end MEASUREMENT
/begin MEASUREMENT TiOff_tiT15OffTBasdChkFastRef "reference value for temperature based check (fast)" UWORD Time_min_q1_COMPU 1 100 0.00 65535.00 FORMAT "%8.2" ECU_ADDRESS 0x600034FA /end MEASUREMENT
/begin MEASUREMENT TiOff_tiT15OffTBasdChkSlowRef "reference value for temperature based check (slow)" UWORD Time_min_q1_COMPU 1 100 0.00 65535.00 FORMAT "%8.2" ECU_ADDRESS 0x600034F8 /end MEASUREMENT
/begin MEASUREMENT TiOff_tiTBasdChkTrig "local counter to trigger temperature based check" SLONG Time_Dt 1 100 -2147.48364800 2147.48364700 FORMAT "%13.8" ECU_ADDRESS 0x50001DFC /end MEASUREMENT
/begin MEASUREMENT TS_stMnSwtAC "Status of air condition main switch" UBYTE OneToOne 1 100 0.00 255.0 FORMAT "%5.1" ECU_ADDRESS 0x50005DC6 /end MEASUREMENT
/begin FUNCTION ThrVlv_PosnCtrl "1.34.0    Position Controller"
 /begin DEF_CHARACTERISTIC ThrVlv_ATS.LimitTypeMsk_C ThrVlv_ATS.CnvNorm_C ThrVlv_ATS.LowLim_C ThrVlv_ATS.UpLim_C ThrVlv_ATS.CnvFac_C ThrVlv_ATS.CnvOfs_C ThrVlv_ATS.DfltVal_C ThrVlv_IfDetLimpAirPosnRegnB1_I.dUIntglSldgModLhp_CUR ThrVlv_IfDetLimpAirPosnRegnB1_I.facCtrlIntglLimpAirPosn_C ThrVlv_IfDetLimpAirPosnRegnB1_I.facCtrlSldgModLhp_C ThrVlv_IfDetLimpAirPosnRegnB1_I.ratDeCtrlrThdLhpStuckDetn_C ThrVlv_IfDetLimpAirPosnRegnB1_I.ratDeLimpAirPosn_C ThrVlv_IfDetLimpAirPosnRegnB1_I.ratLimpAirPosnBand_C ThrVlv_IfDetLimpAirPosnRegnB1_I.uDifOpngSprg_C ThrVlv_IfDetLimpAirPosnRegnB1_I.uMinOpngSprg_C ThrVlv_IfDiagB1_I.dRatDesPreCtrlGrdtThd_C ThrVlv_IfDiagB1_I.facDeCtrlTolr_C ThrVlv_IfDiagB1_I.facDiagHeal_C ThrVlv_IfDiagB1_I.ratDeCtrlTolrMin_C ThrVlv_IfDiagB1_I.ratDutyCycDiagMaxLoBatt_C ThrVlv_IfDiagB1_I.ratDutyCycDiagMax_C ThrVlv_IfDiagB1_I.ratOffsTestMax_C ThrVlv_IfDiagB1_I.ratOffsTestMin_C ThrVlv_IfDiagB1_I.tiCtrlDeMax_C ThrVlv_IfDiagB1_I.tiDutyCycExcd_C ThrVlv_IfExtdPostDrvB1_I.tiExtdPostDrv_C ThrVlv_IfLimpAirPosnChkB1_I.ratOffsLimpAirPosnNotRea_C ThrVlv_IfLimpAirPosnChkB1_I.tiToReaLimpAirPosn_C ThrVlv_IfPwrSaveB1_I.ratDeCtrlrThd_C ThrVlv_IfPwrSaveB1_I.ratDesThdOffs_C ThrVlv_IfPwrSaveB1_I.swtPosnCdnOpen_C ThrVlv_IfPwrSaveB1_I.swtWakeup_C ThrVlv_IfPwrSaveB1_I.tiPwrSave_C ThrVlv_IfRampDwnB1_I.ratOffsBtwVal_C ThrVlv_IfRampDwnB1_I.ratStepSize_C ThrVlv_IfRampDwnB1_I.ratStrtPosn_C ThrVlv_IfRampDwnB1_I.swtRampDwnEna_C ThrVlv_IfSoftLdgB1_I.dRadSpdLimDecel_C ThrVlv_IfSoftLdgB1_I.dRadSpdLimSoftLdg_C ThrVlv_IfSoftLdgB1_I.ratOffsDecel_C ThrVlv_IfSoftLdgB1_I.ratStrtPosn_C ThrVlv_IfSoftLdgB1_I.swtSoftLdgEna_C ThrVlv_IfSoftLdgB1_I.tiFilSwtSpdLimSoftLdg_C ThrVlv_PosnCtrlB1_I.PreCtrlFacB1_C ThrVlv_PosnCtrlB1_I.PreCtrlFacB2_C ThrVlv_PosnCtrlB1_I.PreCtrlFacC1_C ThrVlv_PosnCtrlB1_I.PreCtrlFacC2_C ThrVlv_PosnCtrlB1_I.PreCtrlFacD_C ThrVlv_PosnCtrlB1_I.PreCtrlFacE_C ThrVlv_PosnCtrlB1_I.dRatActThdSwtOffCtrlDer_C ThrVlv_PosnCtrlB1_I.dUIntglSldgMod_CUR ThrVlv_PosnCtrlB1_I.facCnvnIdn_C ThrVlv_PosnCtrlB1_I.facCtrlDer_C ThrVlv_PosnCtrlB1_I.facCtrlDer_MAP ThrVlv_PosnCtrlB1_I.facCtrlIntglMin_C ThrVlv_PosnCtrlB1_I.facCtrlIntglSlowTrj_C ThrVlv_PosnCtrlB1_I.facCtrlIntgl_C ThrVlv_PosnCtrlB1_I.facCtrlIntgl_MAP ThrVlv_PosnCtrlB1_I.facCtrlK_C ThrVlv_PosnCtrlB1_I.facCtrlPropSlowTrj_C ThrVlv_PosnCtrlB1_I.facCtrlProp_C ThrVlv_PosnCtrlB1_I.facCtrlProp_MAP ThrVlv_PosnCtrlB1_I.facCtrlSldgMod_CUR ThrVlv_PosnCtrlB1_I.facDly_C ThrVlv_PosnCtrlB1_I.facElecMotIndtCmp_CUR ThrVlv_PosnCtrlB1_I.facGainSldgSfcCubic_CUR ThrVlv_PosnCtrlB1_I.facGainSldgSfcSqrt_C ThrVlv_PosnCtrlB1_I.facWghtSignIntglSldgMod_C ThrVlv_PosnCtrlB1_I.nrFbCtrlSdlg_C ThrVlv_PosnCtrlB1_I.nrMethDerCalcn_C ThrVlv_PosnCtrlB1_I.ratActThdIntglRst_C ThrVlv_PosnCtrlB1_I.ratDeCtrlrThdIntglRst_C ThrVlv_PosnCtrlB1_I.ratDeCtrlrThdSlowTrj_C ThrVlv_PosnCtrlB1_I.ratDeCtrlrThdSwtOffCtrlStaty_C ThrVlv_PosnCtrlB1_I.ratDesPstDrv_C ThrVlv_PosnCtrlB1_I.ratDftlThdSlowTrj_C ThrVlv_PosnCtrlB1_I.ratDutyCycMax_C ThrVlv_PosnCtrlB1_I.ratDutyCycMin_C ThrVlv_PosnCtrlB1_I.ratGear_C ThrVlv_PosnCtrlB1_I.ratLrgDeltaSpIntglRst_C ThrVlv_PosnCtrlB1_I.ratOffsDutyCycMax_C ThrVlv_PosnCtrlB1_I.ratOffsDutyCycMin_C ThrVlv_PosnCtrlB1_I.ratSmallDeltaSpIntglRst_C ThrVlv_PosnCtrlB1_I.swtCtrlDerActPosn_C ThrVlv_PosnCtrlB1_I.swtNLFF_C ThrVlv_PosnCtrlB1_I.swtOffDRatActSldgModStaty_C ThrVlv_PosnCtrlB1_I.swtOffIntglSldgModStaty_C ThrVlv_PosnCtrlB1_I.swtPidCtrlEna_C ThrVlv_PosnCtrlB1_I.swtTrjAdpnDurgSatn_C ThrVlv_PosnCtrlB1_I.tiCtrlDerFil_C ThrVlv_PosnCtrlB1_I.tiDebOpenLoad_C ThrVlv_PosnCtrlB1_I.tiFilDRatAct_C ThrVlv_PosnCtrlB1_I.tiFilElecMotIndtCmp_C ThrVlv_PosnCtrlB1_I.tiFilSwtPreCtrl_C ThrVlv_PosnCtrlB1_I.tiFricDwn_C ThrVlv_PosnCtrlB1_I.tiFricUp_C ThrVlv_PosnCtrlB1_I.tiPPT1_CUR ThrVlv_PosnCtrlB1_I.tiPreCtrlGrdtBasd_CUR ThrVlv_PosnCtrlB1_I.tiSdlFacCtrl_C ThrVlv_PosnCtrlB1_I.tiSldgSfcDer_C ThrVlv_PosnCtrlB1_I.tiSlowTrjCdn_C ThrVlv_PosnCtrlB1_I.tiSwtOffCtrlStaty_C ThrVlv_PosnCtrlB1_I.uCtrlIntglRst_C ThrVlv_PosnCtrlB1_I.uFricCmp_C ThrVlv_PosnCtrlB1_I.uInpDsbc_C ThrVlv_PosnCtrlB1_I.uSprgCmp_CUR ThrVlv_ratDesCalcB1_C ThrVlv_swtDesCalcB1_C /end DEF_CHARACTERISTIC
 /begin REF_CHARACTERISTIC ThrVlv_stActrCfg_C /end REF_CHARACTERISTIC
 /begin IN_MEASUREMENT BattU_u ChrCtl_ratDesPosnThrVlvB1 Epm_nEng SyC_stSub ThrVlv_flgActPosnVldB1 ThrVlv_flgActrOnB1 ThrVlv_flgAdpnRelsB1 ThrVlv_flgLimpModeB1 ThrVlv_flgOffsLrnPsOffB1 ThrVlv_flgReqFuCutOffB1 ThrVlv_flgReqPsOffB1 ThrVlv_flgUBattSuffB1 ThrVlv_ratActIntB1 ThrVlv_ratAdpnB1 ThrVlv_ratLimpAirPosnB1 ThrVlv_ratOffsClsdPosnB1 ThrVlv_ratOpenPosnMaxB1 ThrVlv_stMonPsIfB1 ThrVlv_stOffsLrnStB1 /end IN_MEASUREMENT
 /begin OUT_MEASUREMENT ThrVlv_facUBattB1 ThrVlv_flgDesTstrB1 ThrVlv_flgDesValVldB1 ThrVlv_flgLimpAirPosnNotReaB1 ThrVlv_flgLmsPsdB1 ThrVlv_flgOpenLoopOpngVvtEndPosnB1 ThrVlv_flgPosnCtrlPsOffB1 ThrVlv_flgXPostDrvB1 ThrVlv_ratDeCtrlrB1 ThrVlv_ratDesB1 ThrVlv_ratDesTstrB1 ThrVlv_ratDutyCycB1 ThrVlv_stMonPosnCtrlB1 ThrVlv_stPosnCtrlStB1 /end OUT_MEASUREMENT
 /begin LOC_MEASUREMENT ThrVlv_flgPosnCtrlDsmClrDmdB1 ThrVlv_flgTstrCdn ThrVlv_PosnCtrlB1_I.PwrLossHeat ThrVlv_PosnCtrlB1_I.dRadSpdLimSoftLdg ThrVlv_PosnCtrlB1_I.dRadSpdLimSoftLmsLvng ThrVlv_PosnCtrlB1_I.dRatActFild ThrVlv_PosnCtrlB1_I.dRatActSldgModFild ThrVlv_PosnCtrlB1_I.dRatActSldgModFildAbslt ThrVlv_PosnCtrlB1_I.dRatDesPreCtrlGrdt ThrVlv_PosnCtrlB1_I.dUIntglSldgMod ThrVlv_PosnCtrlB1_I.dUIntglSldgModLhp ThrVlv_PosnCtrlB1_I.dt_fac_u16 ThrVlv_PosnCtrlB1_I.dt_ms_0p04881_u16 ThrVlv_PosnCtrlB1_I.egyHeatOld ThrVlv_PosnCtrlB1_I.facCtrlDer ThrVlv_PosnCtrlB1_I.facCtrlIntgl ThrVlv_PosnCtrlB1_I.facCtrlIntglLimpAirPosn ThrVlv_PosnCtrlB1_I.facCtrlProp ThrVlv_PosnCtrlB1_I.facCtrlSldgMod ThrVlv_PosnCtrlB1_I.facCtrlSldgModLhp ThrVlv_PosnCtrlB1_I.facPreCtrlA1 ThrVlv_PosnCtrlB1_I.facPreCtrlA2 ThrVlv_PosnCtrlB1_I.facPreCtrlA3 ThrVlv_PosnCtrlB1_I.facPreCtrlB ThrVlv_PosnCtrlB1_I.facPreCtrlC ThrVlv_PosnCtrlB1_I.facUBatt ThrVlv_PosnCtrlB1_I.flgClsdPosnReaSuc ThrVlv_PosnCtrlB1_I.flgCompProt ThrVlv_PosnCtrlB1_I.flgCoolgDone ThrVlv_PosnCtrlB1_I.flgCsersDiagActv ThrVlv_PosnCtrlB1_I.flgCsersDiagActvAtErrSet ThrVlv_PosnCtrlB1_I.flgCsersDiumprDenom ThrVlv_PosnCtrlB1_I.flgCsersDiumprNumr ThrVlv_PosnCtrlB1_I.flgCsersEnaCdn ThrVlv_PosnCtrlB1_I.flgCtrlDeDeb ThrVlv_PosnCtrlB1_I.flgCtrlDeDebCsers ThrVlv_PosnCtrlB1_I.flgCtrlDeDfcLdc ThrVlv_PosnCtrlB1_I.flgCtrlDeDfcLdcCsers ThrVlv_PosnCtrlB1_I.flgCycCtrlDeMax ThrVlv_PosnCtrlB1_I.flgCycCtrlDeMin ThrVlv_PosnCtrlB1_I.flgCycDutyCycPsMax ThrVlv_PosnCtrlB1_I.flgCycDutyCycPsMin ThrVlv_PosnCtrlB1_I.flgDEDIA ThrVlv_PosnCtrlB1_I.flgDebLowUBatt ThrVlv_PosnCtrlB1_I.flgDebOpenLoad ThrVlv_PosnCtrlB1_I.flgDesValFromHeal ThrVlv_PosnCtrlB1_I.flgDesValVld ThrVlv_PosnCtrlB1_I.flgDetDfcDoneDcyc ThrVlv_PosnCtrlB1_I.flgDfcLdc ThrVlv_PosnCtrlB1_I.flgDfcSaved ThrVlv_PosnCtrlB1_I.flgDrvToLimpAirPosn ThrVlv_PosnCtrlB1_I.flgDsmRdyDcyc ThrVlv_PosnCtrlB1_I.flgDstRea ThrVlv_PosnCtrlB1_I.flgDutyCycExcdDeb ThrVlv_PosnCtrlB1_I.flgDutyCycOpenLoopOpng ThrVlv_PosnCtrlB1_I.flgErrRprt ThrVlv_PosnCtrlB1_I.flgFailSafe ThrVlv_PosnCtrlB1_I.flgFailSafeHealDfcActv ThrVlv_PosnCtrlB1_I.flgFailSafeOlcActv ThrVlv_PosnCtrlB1_I.flgFilRst ThrVlv_PosnCtrlB1_I.flgFixdCtrlGain ThrVlv_PosnCtrlB1_I.flgGpfProtnActv ThrVlv_PosnCtrlB1_I.flgHealAllwd ThrVlv_PosnCtrlB1_I.flgHealDesValActv ThrVlv_PosnCtrlB1_I.flgHealDfcActv ThrVlv_PosnCtrlB1_I.flgHealDfcClsd ThrVlv_PosnCtrlB1_I.flgHealDfcOpend ThrVlv_PosnCtrlB1_I.flgHealFail ThrVlv_PosnCtrlB1_I.flgHealSuc ThrVlv_PosnCtrlB1_I.flgHldClsdAbortIniFil ThrVlv_PosnCtrlB1_I.flgHldClsdActv ThrVlv_PosnCtrlB1_I.flgHldClsdAvl ThrVlv_PosnCtrlB1_I.flgHldClsdDynPeak ThrVlv_PosnCtrlB1_I.flgHldClsdMaps ThrVlv_PosnCtrlB1_I.flgHldOpenActv ThrVlv_PosnCtrlB1_I.flgIniDesFil ThrVlv_PosnCtrlB1_I.flgIniDesFilNegSp ThrVlv_PosnCtrlB1_I.flgIniDesFilUnlimSp ThrVlv_PosnCtrlB1_I.flgIntglRst ThrVlv_PosnCtrlB1_I.flgLhpStuck ThrVlv_PosnCtrlB1_I.flgLimpAirPosnNotRea ThrVlv_PosnCtrlB1_I.flgLimpAirPosnRegn ThrVlv_PosnCtrlB1_I.flgLimpAirPosnRegnSp ThrVlv_PosnCtrlB1_I.flgLmsClsngActv ThrVlv_PosnCtrlB1_I.flgLmsClsngDeactvtPwrSave ThrVlv_PosnCtrlB1_I.flgLmsClsngDone ThrVlv_PosnCtrlB1_I.flgLmsPsd ThrVlv_PosnCtrlB1_I.flgLmsRea ThrVlv_PosnCtrlB1_I.flgLongTermOffs ThrVlv_PosnCtrlB1_I.flgOffsLrnPsErr ThrVlv_PosnCtrlB1_I.flgOpenPosnReaSuc ThrVlv_PosnCtrlB1_I.flgOpngAftLongHldClsd ThrVlv_PosnCtrlB1_I.flgPosnCtrlErr ThrVlv_PosnCtrlB1_I.flgPosnCtrlPsOff ThrVlv_PosnCtrlB1_I.flgPosnCtrlSlow ThrVlv_PosnCtrlB1_I.flgPsOff ThrVlv_PosnCtrlB1_I.flgPsRdy ThrVlv_PosnCtrlB1_I.flgPsRst ThrVlv_PosnCtrlB1_I.flgPsSwtOffDiag ThrVlv_PosnCtrlB1_I.flgPwrSaveCdn ThrVlv_PosnCtrlB1_I.flgRampDwn ThrVlv_PosnCtrlB1_I.flgRampDwnDutyLim ThrVlv_PosnCtrlB1_I.flgRampDwnEna ThrVlv_PosnCtrlB1_I.flgReqPsOffBattChk ThrVlv_PosnCtrlB1_I.flgReqPsOffCtrlErr ThrVlv_PosnCtrlB1_I.flgReqPsOffExtdPostDrv ThrVlv_PosnCtrlB1_I.flgReqPsOffPwrSave ThrVlv_PosnCtrlB1_I.flgRstIPrtn ThrVlv_PosnCtrlB1_I.flgRstIPrtnFailSafe ThrVlv_PosnCtrlB1_I.flgRstIPrtnHealDesVal ThrVlv_PosnCtrlB1_I.flgSftyInhb ThrVlv_PosnCtrlB1_I.flgSlowTrj ThrVlv_PosnCtrlB1_I.flgSoftLdgActv ThrVlv_PosnCtrlB1_I.flgSoftLdgEna ThrVlv_PosnCtrlB1_I.flgSoftLdgRegn ThrVlv_PosnCtrlB1_I.flgSoftLmsLvngActv ThrVlv_PosnCtrlB1_I.flgSoftLmsLvngIniFil ThrVlv_PosnCtrlB1_I.flgSoftLmsLvngRegn ThrVlv_PosnCtrlB1_I.flgStrtEnd ThrVlv_PosnCtrlB1_I.flgStuckAtCls ThrVlv_PosnCtrlB1_I.flgStuckAtOpng ThrVlv_PosnCtrlB1_I.flgStuckPosnClsd ThrVlv_PosnCtrlB1_I.flgStuckPosnDetnActv ThrVlv_PosnCtrlB1_I.flgStuckPosnOpen ThrVlv_PosnCtrlB1_I.flgStuckStrd ThrVlv_PosnCtrlB1_I.flgSwtOffCtrlStatyCdn ThrVlv_PosnCtrlB1_I.flgTDpdtDutyCycOffsLrnLim ThrVlv_PosnCtrlB1_I.flgTInvldDebd ThrVlv_PosnCtrlB1_I.flgTSnsrAdpnDoneDcyc ThrVlv_PosnCtrlB1_I.flgTSnsrOffsAdpd ThrVlv_PosnCtrlB1_I.flgTVldDcyc ThrVlv_PosnCtrlB1_I.flgTiEngOffCdn ThrVlv_PosnCtrlB1_I.flgTiSuffToReaLimpAirPosn ThrVlv_PosnCtrlB1_I.flgTrigHealDfc ThrVlv_PosnCtrlB1_I.flgTrjAdpnDurgSatn ThrVlv_PosnCtrlB1_I.flgTrjAdpnInhb ThrVlv_PosnCtrlB1_I.flgVlvDrv ThrVlv_PosnCtrlB1_I.flgVvtEndPosn ThrVlv_PosnCtrlB1_I.flgXPostDrv ThrVlv_PosnCtrlB1_I.iElecMot ThrVlv_PosnCtrlB1_I.idxActrTyp ThrVlv_PosnCtrlB1_I.idxSnsrOffsAdpd ThrVlv_PosnCtrlB1_I.nrPntsSnsrOffsAdpd ThrVlv_PosnCtrlB1_I.nrRepHeal ThrVlv_PosnCtrlB1_I.nrRepHealDfc ThrVlv_PosnCtrlB1_I.nrRepRamp ThrVlv_PosnCtrlB1_I.nrStepDetDfc ThrVlv_PosnCtrlB1_I.nrStepFailSafeOlc ThrVlv_PosnCtrlB1_I.nrStepHeal ThrVlv_PosnCtrlB1_I.nrStepHealDfc ThrVlv_PosnCtrlB1_I.nrStepLmsClsng ThrVlv_PosnCtrlB1_I.nrStepOpngAftLongHldClsd ThrVlv_PosnCtrlB1_I.nrStepTSnsrAdpn ThrVlv_PosnCtrlB1_I.rElecMot ThrVlv_PosnCtrlB1_I.ratActPosnSdlg ThrVlv_PosnCtrlB1_I.ratActSldgModOld ThrVlv_PosnCtrlB1_I.ratActSldgModOldOld ThrVlv_PosnCtrlB1_I.ratActSldgModOldOldOld ThrVlv_PosnCtrlB1_I.ratActThd ThrVlv_PosnCtrlB1_I.ratActVCalcnOld ThrVlv_PosnCtrlB1_I.ratDeCtrlr ThrVlv_PosnCtrlB1_I.ratDeCtrlrEndVal ThrVlv_PosnCtrlB1_I.ratDeCtrlrEndValAbslt ThrVlv_PosnCtrlB1_I.ratDeCtrlrOld ThrVlv_PosnCtrlB1_I.ratDeCtrlrSdlg ThrVlv_PosnCtrlB1_I.ratDes ThrVlv_PosnCtrlB1_I.ratDesFil ThrVlv_PosnCtrlB1_I.ratDesFilLowrLim ThrVlv_PosnCtrlB1_I.ratDesFilUpprLim ThrVlv_PosnCtrlB1_I.ratDesHldClsdAndOpen ThrVlv_PosnCtrlB1_I.ratDesLim ThrVlv_PosnCtrlB1_I.ratDesOpngAftLongHldClsd ThrVlv_PosnCtrlB1_I.ratDesPreCtrl ThrVlv_PosnCtrlB1_I.ratDesPreCtrlDftl ThrVlv_PosnCtrlB1_I.ratDesPreCtrlDftl2 ThrVlv_PosnCtrlB1_I.ratDesPreCtrlDftl2Old ThrVlv_PosnCtrlB1_I.ratDesPreCtrlDftlOld ThrVlv_PosnCtrlB1_I.ratDesPreCtrlOld ThrVlv_PosnCtrlB1_I.ratDesPreCtrlRad ThrVlv_PosnCtrlB1_I.ratDesPreCtrlRadOld ThrVlv_PosnCtrlB1_I.ratDesRad ThrVlv_PosnCtrlB1_I.ratDesRampDwn ThrVlv_PosnCtrlB1_I.ratDesRampMem ThrVlv_PosnCtrlB1_I.ratDesSwt ThrVlv_PosnCtrlB1_I.ratDesSwtDeltaAbslt ThrVlv_PosnCtrlB1_I.ratDesSwtOld ThrVlv_PosnCtrlB1_I.ratDesSwtUnlimSpOld ThrVlv_PosnCtrlB1_I.ratDesValFromHeal ThrVlv_PosnCtrlB1_I.ratDutyCycCompProtMax ThrVlv_PosnCtrlB1_I.ratDutyCycCompProtMin ThrVlv_PosnCtrlB1_I.ratDutyCycCtrl ThrVlv_PosnCtrlB1_I.ratDutyCycFailSafeOlc ThrVlv_PosnCtrlB1_I.ratDutyCycGpfProtn ThrVlv_PosnCtrlB1_I.ratDutyCycHldClsd ThrVlv_PosnCtrlB1_I.ratDutyCycHldClsdCompProt ThrVlv_PosnCtrlB1_I.ratDutyCycHldClsdDynPeak ThrVlv_PosnCtrlB1_I.ratDutyCycHldClsdMap ThrVlv_PosnCtrlB1_I.ratDutyCycHldOpen ThrVlv_PosnCtrlB1_I.ratDutyCycLmsClsng ThrVlv_PosnCtrlB1_I.ratDutyCycMax ThrVlv_PosnCtrlB1_I.ratDutyCycMin ThrVlv_PosnCtrlB1_I.ratDutyCycOffsLrnLimNeg ThrVlv_PosnCtrlB1_I.ratDutyCycOpenLoopOpng ThrVlv_PosnCtrlB1_I.ratDutyCycOpenLoopOpngCntr ThrVlv_PosnCtrlB1_I.ratDutyCycOpenLoopOpngWoBattCmp ThrVlv_PosnCtrlB1_I.ratDutyCycPreCtrl ThrVlv_PosnCtrlB1_I.ratDutyCycRampDwnMin ThrVlv_PosnCtrlB1_I.ratFilDlyOld ThrVlv_PosnCtrlB1_I.ratHldClsdAbortThd ThrVlv_PosnCtrlB1_I.ratHldClsdPosn ThrVlv_PosnCtrlB1_I.ratLimpAirPosnBand ThrVlv_PosnCtrlB1_I.ratOffsClsdPosn ThrVlv_PosnCtrlB1_I.ratPPT1 ThrVlv_PosnCtrlB1_I.ratRampDwnStrt ThrVlv_PosnCtrlB1_I.ratSldgSfc ThrVlv_PosnCtrlB1_I.ratSldgSfcCubic ThrVlv_PosnCtrlB1_I.ratSldgSfcDer ThrVlv_PosnCtrlB1_I.ratSldgSfcOld ThrVlv_PosnCtrlB1_I.ratSldgSfcSqrt ThrVlv_PosnCtrlB1_I.ratSoftLdgDecel ThrVlv_PosnCtrlB1_I.ratSoftLdgStrt ThrVlv_PosnCtrlB1_I.ratStuck ThrVlv_PosnCtrlB1_I.ratStuckPosnOpenThd ThrVlv_PosnCtrlB1_I.stMonPosnCtrl ThrVlv_PosnCtrlB1_I.stMonTSnsrAdpn ThrVlv_PosnCtrlB1_I.tElecMotEstimd ThrVlv_PosnCtrlB1_I.tOffsElecMotSelfHeatg ThrVlv_PosnCtrlB1_I.tOffsSample ThrVlv_PosnCtrlB1_I.tSnsrCorrd ThrVlv_PosnCtrlB1_I.tSnsrCorrdFild ThrVlv_PosnCtrlB1_I.tSnsrOffsAdpd ThrVlv_PosnCtrlB1_I.tSnsrOffsAdpd_a ThrVlv_PosnCtrlB1_I.tiCtrlDe ThrVlv_PosnCtrlB1_I.tiCtrlDeCsers ThrVlv_PosnCtrlB1_I.tiCtrlDeMaxCsers ThrVlv_PosnCtrlB1_I.tiDebLowUBatt ThrVlv_PosnCtrlB1_I.tiDutyCycExcd ThrVlv_PosnCtrlB1_I.tiFilSwtSpdLimSoftLdg ThrVlv_PosnCtrlB1_I.tiHldClsdActv ThrVlv_PosnCtrlB1_I.tiHldClsdDynPeak ThrVlv_PosnCtrlB1_I.tiOpng ThrVlv_PosnCtrlB1_I.tiPreCtrlFildOld ThrVlv_PosnCtrlB1_I.tiPreCtrlSlow ThrVlv_PosnCtrlB1_I.tiPsRdy ThrVlv_PosnCtrlB1_I.tiReaDesPosn ThrVlv_PosnCtrlB1_I.tiReaDesPosnFailSafe ThrVlv_PosnCtrlB1_I.tiVvtEndPosn ThrVlv_PosnCtrlB1_I.tqFric ThrVlv_PosnCtrlB1_I.tqFricOld ThrVlv_PosnCtrlB1_I.uBalStrmInfl ThrVlv_PosnCtrlB1_I.uBattLimNeg ThrVlv_PosnCtrlB1_I.uBattLimPos ThrVlv_PosnCtrlB1_I.uCtrl ThrVlv_PosnCtrlB1_I.uCtrlDer ThrVlv_PosnCtrlB1_I.uCtrlDerFild ThrVlv_PosnCtrlB1_I.uCtrlIntgl ThrVlv_PosnCtrlB1_I.uCtrlIntglOld ThrVlv_PosnCtrlB1_I.uCtrlIntglRstAftLmsClsng ThrVlv_PosnCtrlB1_I.uCtrlProp ThrVlv_PosnCtrlB1_I.uCtrlSldgMod ThrVlv_PosnCtrlB1_I.uDesPreCtrl ThrVlv_PosnCtrlB1_I.uDifOpngSprg ThrVlv_PosnCtrlB1_I.uElecMotIndt ThrVlv_PosnCtrlB1_I.uElecMotIndtCmp ThrVlv_PosnCtrlB1_I.uElecMotIndtCmpFild ThrVlv_PosnCtrlB1_I.uElecMotTerminal ThrVlv_PosnCtrlB1_I.uFbCtrlUnlim ThrVlv_PosnCtrlB1_I.uFric ThrVlv_PosnCtrlB1_I.uLnrPreCtrl ThrVlv_PosnCtrlB1_I.uMinOpngSprg ThrVlv_PosnCtrlB1_I.uOffsTranLineOpngSprg ThrVlv_PosnCtrlB1_I.uOhmR ThrVlv_PosnCtrlB1_I.uOpngSprgComp ThrVlv_PosnCtrlB1_I.uSlopLowrLineOpngSprg ThrVlv_PosnCtrlB1_I.uSlopTranLineOpngSprg ThrVlv_PosnCtrlB1_I.uSprgCmp ThrVlv_PosnCtrlB1_I.wghtSignIntglSldgMod /end LOC_MEASUREMENT
 FUNCTION_VERSION "1.34.0" /end FUNCTION
/begin FUNCTION ThrVlv_PsIf "1.12.0    Interface to Powerstage"
 /begin DEF_CHARACTERISTIC ThrVlv_stPsIfCfgB1_C ThrVlv_stPwrStgEnaCdnMask_C ThrVlv_tiClrSc_C ThrVlv_tiSetOutPerdB1_C /end DEF_CHARACTERISTIC
 /begin IN_MEASUREMENT DevLib_stPwrStgEnaCond MoCSOP_stActvMsg SyC_stSub ThrVlv_flgActPosnVldB1 ThrVlv_flgOffsLrnPsOffB1 ThrVlv_flgPosnCtrlPsOffB1 ThrVlv_flgReqFuCutOffB1 ThrVlv_ratDutyCycB1 /end IN_MEASUREMENT
 /begin OUT_MEASUREMENT ThrVlv_flgActrOnB1 ThrVlv_flgOpenLoadDiagFinshdB1 ThrVlv_flgReqPsOffB1 ThrVlv_stMonPsIfB1 /end OUT_MEASUREMENT
 /begin LOC_MEASUREMENT ThrVlv_flgSwtOffDiagStrtB1 ThrVlv_ratDutyCycB1_mp ThrVlv_stHbrdgB1 ThrVlv_stPsErrB1_mp /end LOC_MEASUREMENT
 FUNCTION_VERSION "1.12.0" /end FUNCTION
/begin FUNCTION ThrVlv_Sens "1.19.0    Position Sensor Evaluation"
 /begin DEF_CHARACTERISTIC ThrVlv_IfLimpHomeSubB1_I.stMask_C ThrVlv_IfMainFillgCompB1_I.nMinForChrgComp_C ThrVlv_IfMainFillgCompB1_I.ratSens1ChrgMaxDe_C ThrVlv_IfMainFillgCompB1_I.ratSens2ChrgMaxDe_C ThrVlv_IfMainFillgCompB1_I.tiDebMaiChrgSensErr_C ThrVlv_IfMainFillgCompB1_I.tiDebSens1ChrgSyncErr_C ThrVlv_IfMainFillgCompB1_I.tiDebSens2ChrgSyncErr_C ThrVlv_IfMainFillgCompB1_I.tiDlySensSel_C ThrVlv_IfMainFillgCompB1_I.tiFildCompChrg_CUR ThrVlv_IfSens2B1_I.ratMaxSensDe_CUR ThrVlv_IfSens2B1_I.tiDebSens1Sens2SyncErr_C ThrVlv_IfSens2B1_I.tiDebSens2Err_C ThrVlv_IfSens2B1_I.uSens2Max_C ThrVlv_IfSens2B1_I.uSens2Min_C ThrVlv_IfSens2B1_I.uVltgOffs_C ThrVlv_IfSens2B1_I.uVltgSlop_C ThrVlv_IfSens2B1_I.uVltgThd_C ThrVlv_Sens_B1_I.ratActCharThdMax_C ThrVlv_Sens_B1_I.ratActCharThdMin_C ThrVlv_Sens_B1_I.ratLimpHomePosn_C ThrVlv_Sens_B1_I.swtNrmActrChar_C ThrVlv_Sens_B1_I.tiDebCycFlg_C ThrVlv_Sens_B1_I.tiDebSens1Err_C ThrVlv_Sens_B1_I.uSens1Max_C ThrVlv_Sens_B1_I.uSens1Min_C ThrVlv_stActrCfg_C /end DEF_CHARACTERISTIC
 /begin IN_MEASUREMENT AirMod_flgMaiChrgSensErr ChrCtl_flgUnthrAgMaiSens ChrCtl_rActPosMnChrgSensB1 Epm_nEng SyC_stSub T15_st ThrVlv_dRatPrVB1 ThrVlv_flgReqFuCutOffB1 ThrVlv_ratLimpAirPosnB1 ThrVlv_uElStopClsdSens1FrstB1 ThrVlv_uElStopClsdSens2FrstB1 /end IN_MEASUREMENT
 /begin OUT_MEASUREMENT ThrVlv_flgActPosnVldB1 ThrVlv_flgAvrgSens1Sens2SelB1 ThrVlv_flgDblSensErrB1 ThrVlv_flgDblSensErrSuspcB1 ThrVlv_flgSens1ErrB1 ThrVlv_flgSens1ErrSuspcB1 ThrVlv_flgSens1SelB1 ThrVlv_flgSens2ErrSuspcB1 ThrVlv_flgSens2SelB1 ThrVlv_flgSensCompActvdB1 ThrVlv_flgSngSensErrB1 ThrVlv_flgSngSensErrSuspcB1 ThrVlv_ratActIntB1 ThrVlv_ratActPosnB1 ThrVlv_ratActPosnMaxB1 ThrVlv_ratActPosnMinB1 ThrVlv_ratActSens1AbsltB1_u8 ThrVlv_ratActSens1RelB1_u8 ThrVlv_ratActSens2AbsltB1_u8 ThrVlv_stMonSensB1 ThrVlv_uRawSens1B1 ThrVlv_uRawSens2B1 ThrVlv_uSens1B1 ThrVlv_uSens2B1 /end OUT_MEASUREMENT
 /begin LOC_MEASUREMENT ThrVlv_cntrSens1SelB1 ThrVlv_cntrSens2SelB1 ThrVlv_flgChrgSens1SyncErrSuspcB1 ThrVlv_flgChrgSens2SyncErrSuspcB1 ThrVlv_flgLstUnthrSensSelB1 ThrVlv_flgSens1Sens2SyncErrSuspcB1 ThrVlv_flgSens1SigRngSuspcB1 ThrVlv_flgSens2CharPosnMaxExcddB1 ThrVlv_flgSens2CharPosnMinExcddB1 ThrVlv_flgSens2ErrB1 ThrVlv_flgSens2SigRngSuspcB1 ThrVlv_flgSensCompDmdDurgUnthrB1 ThrVlv_ratActAvrgB1 ThrVlv_ratActMnChrgSensFildB1 ThrVlv_ratActSens1B1 ThrVlv_ratActSens1FildB1 ThrVlv_ratActSens2B1 ThrVlv_ratActSens2FildB1 ThrVlv_Sens_B1_I.Snsr1DiagPrms ThrVlv_Sens_B1_I.cntComErr ThrVlv_Sens_B1_I.cntNoVldDataFast ThrVlv_Sens_B1_I.cntSnsrErrFast ThrVlv_Sens_B1_I.flgSens1CharPosnMaxExcdd ThrVlv_Sens_B1_I.flgSens1CharPosnMinExcdd ThrVlv_Sens_B1_I.flgSentComErrFast ThrVlv_Sens_B1_I.flgSentNoVldDataFast ThrVlv_Sens_B1_I.flgSnsrErrFast ThrVlv_Sens_B1_I.idxActrTyp ThrVlv_Sens_B1_I.ratActIntSnsr /end LOC_MEASUREMENT
 FUNCTION_VERSION "1.19.0" /end FUNCTION
/begin FUNCTION ThS_AdpLcy "6.0.0     Supply of Interfaces from the Thermal System" /begin IN_MEASUREMENT AirC_stSwt CoVeh_trqMaxAC /end IN_MEASUREMENT /begin OUT_MEASUREMENT CoCTM_trqMaxAC TS_stMnSwtAC /end OUT_MEASUREMENT FUNCTION_VERSION "6.0.0" /end FUNCTION
/begin FUNCTION TiEngOn_EngRtMngt "1.0.0     Engine Runtime Management for AECD-Counters"
 /begin DEF_CHARACTERISTIC TiEngOn_cfgRtId.RtId_TotIdleRt_C TiEngOn_cfgRtId.RtId_TotPtoRt_C TiEngOn_cfgRtId.RtId_TotRtObd_C /end DEF_CHARACTERISTIC
 /begin IN_MEASUREMENT CB_flgFlsProgmEveSts CoEng_stMai PthSet_stOvrRunCoord /end IN_MEASUREMENT
 /begin OUT_MEASUREMENT TiEngOn_stRtId.RtId_TotIdleRt TiEngOn_stRtId.RtId_TotPtoRt TiEngOn_stRtId.RtId_TotRtObd TiEngOn_tiRtId.RtId_TotIdleRt TiEngOn_tiRtId.RtId_TotPtoRt TiEngOn_tiRtId.RtId_TotRtObd /end OUT_MEASUREMENT
 /begin LOC_MEASUREMENT TiEngOn_flgProgmEve /end LOC_MEASUREMENT
 FUNCTION_VERSION "1.0.0" /end FUNCTION
/begin FUNCTION TiEngOn_PrmId7F "1.0.0     Parameter Id 0x7F: Engine Runtimes" /begin DEF_CHARACTERISTIC TiEngOn_nIdleSpdPrmId7F_C TiEngOn_swtCfgPrmId7F_C /end DEF_CHARACTERISTIC /begin IN_MEASUREMENT APP_r Epm_nEng VehV_v VehV_vSens /end IN_MEASUREMENT
 /begin LOC_MEASUREMENT TiEngOn_flgEngRunTiPid7F TiEngOn_flgEngRunTiPtoPrmId7F TiEngOn_flgIdleEngRunTiPrmId7F /end LOC_MEASUREMENT
 FUNCTION_VERSION "1.0.0" /end FUNCTION
/begin FUNCTION TiEngOn_TotEngRt "1.0.1     Total Engine Runtime" /begin IN_MEASUREMENT CoEng_stMai T15_st /end IN_MEASUREMENT /begin OUT_MEASUREMENT TiEngOn_tiTotEngRt TiEngOn_tiTotIgnOn /end OUT_MEASUREMENT
 /begin LOC_MEASUREMENT TiEngOn_AvsCntr TiEngOn_AvsCntrLst TiEngOn_tiTotEngRtAux TiEngOn_tiTotEngRtAvs TiEngOn_tiTotEngRtNV TiEngOn_tiTotIgnOnAux TiEngOn_tiTotIgnOnNv /end LOC_MEASUREMENT
 FUNCTION_VERSION "1.0.1" /end FUNCTION
/begin FUNCTION TiOff_VdClk "5.7.0     Clockinformation for OffTimes-calculation"
 /begin DEF_CHARACTERISTIC TiOff_stClkIntCfg_CW TiOff_stTestClk_CW TiOff_tiBTiHwClkRst_C TiOff_tiClkStopTst_C TiOff_tiClkTst_C TiOff_tiEcuOffIntMax_C TiOff_tiEcuOffTst_C TiOff_tiHwClkAddWakeup_C TiOff_tiHwClkMax_C /end DEF_CHARACTERISTIC
 /begin IN_MEASUREMENT Eep_EnvRamHist Eep_EnvRamInvld /end IN_MEASUREMENT
 /begin OUT_MEASUREMENT TiOff_bIniGap TiOff_bTiHwClk TiOff_bTiHwClkRst TiOff_tiHwClk TiOff_tiHwClkLstGap TiOff_tiHwClkStop /end OUT_MEASUREMENT
 /begin LOC_MEASUREMENT TiOff_bIniGapLoc TiOff_bTiHwClkRstDiagDisbl TiOff_bTiHwClkRstLoc TiOff_stVdClkEcuOnIndcn TiOff_tiHwClkLoc TiOff_tiHwClkStopLoc TiOff_tiHwClkWakeupLoc TiOff_tiSwClkAux /end LOC_MEASUREMENT
 FUNCTION_VERSION "5.7.0" /end FUNCTION
/begin FUNCTION TiOff_VdDiag "2.1.1     Diagnosis of the Off-time"
 /begin DEF_CHARACTERISTIC TiOff_ratCoolDwnTBasdChkFastMax_C TiOff_ratCoolDwnTBasdChkFastMin_C TiOff_ratCoolDwnTBasdChkSlowMax_C TiOff_ratCoolDwnTBasdChkSlowMin_C TiOff_stCfgTBasdChk_C TiOff_tCEngDsTT15StopTBasdChkFastMin_C TiOff_tCEngDsTT15StopTBasdChkSlowMin_C TiOff_tDiffCEngDsTPsblTBasdChkFastMin_C TiOff_tDiffCEngDsTPsblTBasdChkSlowMin_C TiOff_tDiffCEngDsTTBasdChkFastMax_C TiOff_tDiffCEngDsTTBasdChkSlowMin_C TiOff_tiT15OffEcuOnTBasdChkFastMax_T TiOff_tiT15OffEcuOnTBasdChkSlowMax_T TiOff_tiT15OffTBasdChkFastRef_T TiOff_tiT15OffTBasdChkSlowRef_T TiOff_tiTBasdChkDly_C TiOff_tiTBasdChkLst_C /end DEF_CHARACTERISTIC
 /begin IN_MEASUREMENT CEngDsT_flgSnsrElecVld CEngDsT_tSnsrFild Eep_EnvRamHist Eep_EnvRamInvld EnvT_stTSens EnvT_tSens T15_st /end IN_MEASUREMENT
 /begin LOC_MEASUREMENT TiOff_cntrDsmClearTBasdChk TiOff_cntrDsmClearTBasdChkLst TiOff_flgEcuNotOffTBasdChkProt TiOff_flgTBasdChkFastPhyEna TiOff_flgTBasdChkSlowPhyEna TiOff_ratCoolDwnTBasdChk TiOff_stTBasdChk TiOff_tCEngDsTT15StopTBasdChk TiOff_tCEngDsTT15StrtTBasdChk TiOff_tDiffCEngDsTPsblTBasdChk TiOff_tDiffCEngDsTTBasdChk TiOff_tEnvTSensT15StrtTBasdChk TiOff_tiCumEcuOffTBasdChk TiOff_tiT15OffEcuOnTBasdChk TiOff_tiT15OffMinsTBasdChk TiOff_tiT15OffSecTrigTBasdChk TiOff_tiT15OffTBasdChkFastRef TiOff_tiT15OffTBasdChkSlowRef TiOff_tiTBasdChkTrig /end LOC_MEASUREMENT
 FUNCTION_VERSION "2.1.1" /end FUNCTION
/begin FUNCTION TiOff_VdTiEngOff "2.3.0_1.1.0Off-Time based on Engine Rotation"
 /begin DEF_CHARACTERISTIC TiEngOffBasc_CW TiEngOff_tiBEngTmrRstDeb_C TiEngOff_tiEngRotDeb_C TiOff_stTiEngOffDef_C TiOff_stTiEngOffHwOvf_C TiOff_stTiEngOff_CW TiOff_tiEngOffDef_C /end DEF_CHARACTERISTIC
 /begin IN_MEASUREMENT Eep_EnvRamHist Eep_EnvRamInvld EngStrt_stRstrtRsn Epm_stSpd SyC_ctPostDrvLeave TiOff_bTiHwClk TiOff_bTiHwClkRst TiOff_tiHwClk TiOff_tiHwClkLstGap TiOff_tiHwClkStop /end IN_MEASUREMENT
 /begin OUT_MEASUREMENT TiEngOff_bEngRot TiEngOff_bRst TiEngOff_bTiEngOffEcuActv TiEngOff_stTi TiEngOff_stTiFirstStrt TiEngOff_ti TiEngOff_tiFirstStrt TiOff_cntrEngOffRst /end OUT_MEASUREMENT
 /begin LOC_MEASUREMENT TiEngOff_stTiFirstStrtLoc TiEngOff_tiFirstStrtLoc TiOff_bEngOffFirstStrtFinLoc TiOff_bEngOffSwLoc TiOff_bEngRotLoc TiOff_bEngRstDeb TiOff_bEngRstLoc TiOff_bTiEngOffEcuActvLoc TiOff_bTiEngOffRstReIni TiOff_bTiEngOffRstRstrt TiOff_bXPostDrvTiEngOff TiOff_cntrEngOffRstLoc TiOff_cntrEngOffRstOld TiOff_ctEngOffReIni TiOff_stTiEngOffHw TiOff_stTiEngOffHwEnd TiOff_stTiEngOffHwStart TiOff_stTiEngOffLoc TiOff_stVdTiEngOffEcuOnIndcn TiOff_tiEngOffHw TiOff_tiEngOffHwEnd TiOff_tiEngOffHwStart TiOff_tiEngOffLoc TiOff_tiEngOffSwAux TiOff_tiEngOffSwLoc /end LOC_MEASUREMENT
 FUNCTION_VERSION "2.3.0_1.1.0" /end FUNCTION
/begin FUNCTION TiOff_VdTiStrtEndOff "3.2.0_1.1.0Off time of start-end recognition"
 /begin DEF_CHARACTERISTIC TiOff_bStrtEndOffRstDeb_C TiOff_stTiStrtEndOffDef_C TiOff_stTiStrtEndOffHwOvf_C TiOff_stTiStrtEndOff_CW TiOff_tiStrtEndOffDef_C /end DEF_CHARACTERISTIC
 /begin IN_MEASUREMENT Eep_EnvRamHist Eep_EnvRamInvld EngStrt_bStrtEnd SyC_ctPostDrvLeave SyC_stSub TiOff_bTiHwClk TiOff_bTiHwClkRst TiOff_tiHwClk TiOff_tiHwClkLstGap TiOff_tiHwClkStop /end IN_MEASUREMENT
 /begin OUT_MEASUREMENT TiOff_bStrtEndOffActive TiOff_bStrtEndOffRst TiOff_cntrStrtEndOffRst TiOff_stTiStrtEndOff TiOff_stTiStrtEndOffFirstStrt TiOff_tiStrtEndOff TiOff_tiStrtEndOffFirstStrt /end OUT_MEASUREMENT
 /begin LOC_MEASUREMENT TiOff_bStrtEndOffActiveFall TiOff_bStrtEndOffActiveLoc TiOff_bStrtEndOffFirstStrtFinLoc TiOff_bStrtEndOffRstDeb TiOff_bStrtEndOffRstLoc TiOff_bStrtEndOffRstReIni TiOff_bStrtEndOffSwLoc TiOff_bTiStrtEndActOld TiOff_bXPostDrvTiStrtEndOff TiOff_cntrStrtEndOffRstLoc TiOff_cntrStrtEndOffRstOld TiOff_ctStrtEndOffReIni TiOff_stTiStrtEndActn TiOff_stTiStrtEndOffFirstStrtLoc TiOff_stTiStrtEndOffHw TiOff_stTiStrtEndOffHwEnd TiOff_stTiStrtEndOffHwStart TiOff_stTiStrtEndOffLoc TiOff_stTiStrtEndOffMdlEnd TiOff_stTiStrtEndOffMdlStart TiOff_stVdTiStrtEndOffEcuOnIndcn TiOff_tiStrtEndOffFirstStrtLoc TiOff_tiStrtEndOffHw TiOff_tiStrtEndOffHwEnd TiOff_tiStrtEndOffHwStart TiOff_tiStrtEndOffLoc TiOff_tiStrtEndOffMdlEnd TiOff_tiStrtEndOffSwAux TiOff_tiStrtEndOffSwLoc /end LOC_MEASUREMENT
 FUNCTION_VERSION "3.2.0_1.1.0" /end FUNCTION
/begin COMPU_METHOD B_TRUE "" TAB_VERB "%6.3" "" COMPU_TAB_REF B_TRUE /end COMPU_METHOD
/begin COMPU_VTAB B_TRUE "" TAB_VERB 2 0 "FALSE" 1 "TRUE" /end COMPU_VTAB
/begin COMPU_METHOD EngN "" RAT_FUNC "%6.3" "rpm" COEFFS 0 2 0 0 0 1 /end COMPU_METHOD
/begin COMPU_METHOD Fact1000 "" RAT_FUNC "%6.5" "-" COEFFS 0 1000 0 0 0 1 /end COMPU_METHOD
/begin COMPU_METHOD fak_q0p000488 "" RAT_FUNC "%6.5" "-" COEFFS 0 65536 0 0 0 32 /end COMPU_METHOD
/begin COMPU_METHOD fak_q0p0009766 "" RAT_FUNC "%6.5" "-" COEFFS 0 65536 0 0 0 64 /end COMPU_METHOD
/begin COMPU_METHOD fak_q0p00195 "" RAT_FUNC "%6.4" "-" COEFFS 0 65536 0 0 0 128 /end COMPU_METHOD
/begin COMPU_METHOD fak_q0p01 "" RAT_FUNC "%6.4" "" COEFFS 0 100 0 0 0 1 /end COMPU_METHOD
/begin COMPU_METHOD fak_q1p526Em5 "" RAT_FUNC "%7.6" "-" COEFFS 0 65536 0 0 0 1 /end COMPU_METHOD
/begin COMPU_METHOD fak_q3p0518Em5 "" RAT_FUNC "%7.6" "" COEFFS 0 32768 0 0 0 1 /end COMPU_METHOD
/begin COMPU_METHOD fak_q6p1035Em5 "" RAT_FUNC "%7.6" "-" COEFFS 0 65536 0 0 0 4 /end COMPU_METHOD
/begin COMPU_METHOD fak_sw_b0p03125 "" RAT_FUNC "%9.8" "-" COEFFS 0 65536 0 0 0 0.0625 /end COMPU_METHOD
/begin COMPU_METHOD i_q0p001_A "" RAT_FUNC "%6.5" "A" COEFFS 0 1 0 0 0 0.001 /end COMPU_METHOD
/begin COMPU_METHOD leist_q0p015625 "" RAT_FUNC "%6.4" "W" COEFFS 0 64 0 0 0 1 /end COMPU_METHOD
/begin COMPU_METHOD OneToOne "" RAT_FUNC "%6.2" "-" COEFFS 0 1 0 0 0 1 /end COMPU_METHOD
/begin COMPU_METHOD Per_Dur "" RAT_FUNC "%6.2" "usec" COEFFS 0 1 0 0 0 1 /end COMPU_METHOD
/begin COMPU_METHOD q0p0001_Perc "" RAT_FUNC "%7.6" "%" COEFFS 0 10000 0 0 0 1 /end COMPU_METHOD
/begin COMPU_METHOD q0p01562_rad_DIV_s "" RAT_FUNC "%6.4" "rad/s" COEFFS 0 1000000 0 0 0 15625 /end COMPU_METHOD
/begin COMPU_METHOD q0p1_Perc_DIV_s "" RAT_FUNC "%6.3" "%/s" COEFFS 0 10 0 0 0 1 /end COMPU_METHOD
/begin COMPU_METHOD q1Em4_s "" RAT_FUNC "%7.6" "s" COEFFS 0 10000 0 0 0 1 /end COMPU_METHOD
/begin COMPU_METHOD q2p98023Em7_V "" RAT_FUNC "%9.8" "V" COEFFS 0 33554432 0 0 0 10 /end COMPU_METHOD
/begin COMPU_METHOD RBPtCel_du_0p05_1 "" RAT_FUNC "%6.4" "V/s" COEFFS 0 100 0 0 0 5 /end COMPU_METHOD
/begin COMPU_METHOD RBPtCel_fac_0p00001_1 "" RAT_FUNC "%8.7" "-" COEFFS 0 100000 0 0 0 1 /end COMPU_METHOD
/begin COMPU_METHOD RBPtCel_fac_1p0em4_1 "" RAT_FUNC "%7.6" "-" COEFFS 0 10000 0 0 0 1 /end COMPU_METHOD
/begin COMPU_METHOD RBPtCel_ti_5p12em4_1 "" RAT_FUNC "%6.5" "s" COEFFS 0 15625 0 0 0 8 /end COMPU_METHOD
/begin COMPU_METHOD relDK_q0p3922 "" RAT_FUNC "%6.3" "%DK" COEFFS 0 255 0 0 0 100 /end COMPU_METHOD
/begin COMPU_METHOD relgrd_q7p8125 "" RAT_FUNC "%6.2" "%/s" COEFFS 0 128 0 0 0 1000 /end COMPU_METHOD
/begin COMPU_METHOD rel_q0p003052 "" RAT_FUNC "%6.4" "%" COEFFS 0 65536 0 0 0 200 /end COMPU_METHOD
/begin COMPU_METHOD rel_q0p0078125 "" RAT_FUNC "%6.4" "%" COEFFS 0 128 0 0 0 1 /end COMPU_METHOD
/begin COMPU_METHOD r_q0p001_Ohm "" RAT_FUNC "%6.5" "Ohm" COEFFS 0 1000 0 0 0 1 /end COMPU_METHOD
/begin COMPU_METHOD spg_q0p000122 "" RAT_FUNC "%6.5" "V" COEFFS 0 65536 0 0 0 8 /end COMPU_METHOD
/begin COMPU_METHOD spg_q0p00039 "" RAT_FUNC "%6.5" "V" COEFFS 0 1 0 0 0 0.000390625 /end COMPU_METHOD
/begin COMPU_METHOD spg_q0p001 "" RAT_FUNC "%6.5" "V" COEFFS 0 1000 0 0 0 1 /end COMPU_METHOD
/begin COMPU_METHOD spg_q1p221Em3_V "" RAT_FUNC "%6.4" "V" COEFFS 0 65536 0 0 0 80 /end COMPU_METHOD
/begin COMPU_METHOD spg_q1p221_mV "" RAT_FUNC "%6.4" "V" COEFFS 0 65536 0 0 0 80 /end COMPU_METHOD
/begin COMPU_METHOD t10msxs_ub_b2p55 "" RAT_FUNC "%6.4" "s" COEFFS 0 1 0 0 0 0.01 /end COMPU_METHOD
/begin COMPU_METHOD TempDiff_Kelv "" RAT_FUNC "%6.3" "K" COEFFS 0 10 0 0 0 1 /end COMPU_METHOD
/begin COMPU_METHOD Temp_Cels "" RAT_FUNC "%6.1" "deg C" COEFFS 0 10 2731.4 0 0 1 /end COMPU_METHOD
/begin COMPU_METHOD Time_Dt "" RAT_FUNC "%9.8" "s" COEFFS 0 1000000 0 0 0 1 /end COMPU_METHOD
/begin COMPU_METHOD Time_min_q1_COMPU "" RAT_FUNC "%6.2" "min" COEFFS 0 1 0 0 0 1 /end COMPU_METHOD
/begin COMPU_METHOD Time_s "" RAT_FUNC "%6.4" "s" COEFFS 0 100 0 0 0 1 /end COMPU_METHOD
/begin COMPU_METHOD Time_sec_q1_COMPU "" RAT_FUNC "%6.2" "s" COEFFS 0 1 0 0 0 1 /end COMPU_METHOD
/begin COMPU_METHOD TME_VIRTTQ_SC_Compu "" TAB_VERB "%6.3" "" COMPU_TAB_REF TME_VIRTTQ_SC_Compu /end COMPU_METHOD
/begin COMPU_VTAB TME_VIRTTQ_SC_Compu "" TAB_VERB 2 0 "False" 1 "True" /end COMPU_VTAB
/begin COMPU_METHOD TMFWPRT_SY_Compu "" TAB_VERB "%6.3" "" COMPU_TAB_REF TMFWPRT_SY_Compu /end COMPU_METHOD
/begin COMPU_VTAB TMFWPRT_SY_Compu "" TAB_VERB 5 0 "TMFW protection is disabled" 1 "EngPrt_TMFWShutoff is activated" 2 "StSys_TrqShutOff is activated" 3 "BBZMS is activated" 4 "EngPrt_TMFWShutoff  and StSys_TrqShutoff is activa" /end COMPU_VTAB
/begin COMPU_METHOD TMOSNMVO_SC_Compu "" RAT_FUNC "%6.2" "" COEFFS 0 1 0 0 0 1 /end COMPU_METHOD
/begin COMPU_METHOD TMOSNMZO_SC_Compu "" RAT_FUNC "%6.2" "" COEFFS 0 1 0 0 0 1 /end COMPU_METHOD
/begin COMPU_METHOD TMOSRLVO_SC_Compu "" RAT_FUNC "%6.2" "" COEFFS 0 1 0 0 0 1 /end COMPU_METHOD
/begin COMPU_METHOD TMOSRLZO_SC_Compu "" RAT_FUNC "%6.2" "" COEFFS 0 1 0 0 0 1 /end COMPU_METHOD
/begin COMPU_METHOD TOTENGREV_SC_Compu "" TAB_VERB "%6.3" "" COMPU_TAB_REF TOTENGREV_SC_Compu /end COMPU_METHOD
/begin COMPU_VTAB TOTENGREV_SC_Compu "" TAB_VERB 2 0 "False" 1 "True" /end COMPU_VTAB
/begin COMPU_METHOD TOXDCAT_TYPAVL_SC_Compu "" TAB_VERB "%6.3" "" COMPU_TAB_REF TOXDCAT_TYPAVL_SC_Compu /end COMPU_METHOD
/begin COMPU_VTAB TOXDCAT_TYPAVL_SC_Compu "" TAB_VERB 2 0 "False" 1 "True" /end COMPU_VTAB
/begin COMPU_METHOD TOXICATDS_TYPAVL_SY_Compu "" TAB_VERB "%6.3" "" COMPU_TAB_REF TOXICATDS_TYPAVL_SY_Compu /end COMPU_METHOD
/begin COMPU_VTAB TOXICATDS_TYPAVL_SY_Compu "" TAB_VERB 2 0 "False" 1 "True" /end COMPU_VTAB
/begin COMPU_METHOD TOXICATUS_TYPAVL_SY_Compu "" TAB_VERB "%6.3" "" COMPU_TAB_REF TOXICATUS_TYPAVL_SY_Compu /end COMPU_METHOD
/begin COMPU_VTAB TOXICATUS_TYPAVL_SY_Compu "" TAB_VERB 2 0 "False" 1 "True" /end COMPU_VTAB
/begin COMPU_METHOD TPFLTDS_TYPAVL_SY_Compu "" TAB_VERB "%6.3" "" COMPU_TAB_REF TPFLTDS_TYPAVL_SY_Compu /end COMPU_METHOD
/begin COMPU_VTAB TPFLTDS_TYPAVL_SY_Compu "" TAB_VERB 2 0 "False" 1 "True" /end COMPU_VTAB
/begin COMPU_METHOD TPFLTUS_TYPAVL_SY_Compu "" TAB_VERB "%6.3" "" COMPU_TAB_REF TPFLTUS_TYPAVL_SY_Compu /end COMPU_METHOD
/begin COMPU_VTAB TPFLTUS_TYPAVL_SY_Compu "" TAB_VERB 2 0 "False" 1 "True" /end COMPU_VTAB
/begin COMPU_METHOD TPS65917_SC_Compu "" TAB_VERB "%6.3" "" COMPU_TAB_REF TPS65917_SC_Compu /end COMPU_METHOD
/begin COMPU_VTAB TPS65917_SC_Compu "" TAB_VERB 2 0 "no_device" 1 "one_device" /end COMPU_VTAB
/begin COMPU_METHOD TQCOORDCEN_SC_Compu "" TAB_VERB "%6.3" "" COMPU_TAB_REF TQCOORDCEN_SC_Compu /end COMPU_METHOD
/begin COMPU_VTAB TQCOORDCEN_SC_Compu "" TAB_VERB 2 0 "False" 1 "True" /end COMPU_VTAB
/begin COMPU_METHOD TQCOORD_INHOUSE_SC_Compu "" TAB_VERB "%6.3" "" COMPU_TAB_REF TQCOORD_INHOUSE_SC_Compu /end COMPU_METHOD
/begin COMPU_VTAB TQCOORD_INHOUSE_SC_Compu "" TAB_VERB 2 0 "False" 1 "True" /end COMPU_VTAB
/begin COMPU_METHOD TQFRICADPN_ATS_SC_Compu "" TAB_VERB "%6.3" "" COMPU_TAB_REF TQFRICADPN_ATS_SC_Compu /end COMPU_METHOD
/begin COMPU_VTAB TQFRICADPN_ATS_SC_Compu "" TAB_VERB 2 0 "False" 1 "True" /end COMPU_VTAB
/begin COMPU_METHOD TQLIMNHIBOOSTP_SC_Compu "" TAB_VERB "%6.3" "" COMPU_TAB_REF TQLIMNHIBOOSTP_SC_Compu /end COMPU_METHOD
/begin COMPU_VTAB TQLIMNHIBOOSTP_SC_Compu "" TAB_VERB 2 0 "False" 1 "True" /end COMPU_VTAB
/begin COMPU_METHOD TQLIMNLOCKDTCACTR_SC_Compu "" TAB_VERB "%6.3" "" COMPU_TAB_REF TQLIMNLOCKDTCACTR_SC_Compu /end COMPU_METHOD
/begin COMPU_VTAB TQLIMNLOCKDTCACTR_SC_Compu "" TAB_VERB 2 0 "False" 1 "True" /end COMPU_VTAB
/begin COMPU_METHOD TQRESVLIMNREDNFASTINTV_SC_Compu "" TAB_VERB "%6.3" "" COMPU_TAB_REF TQRESVLIMNREDNFASTINTV_SC_Compu /end COMPU_METHOD
/begin COMPU_VTAB TQRESVLIMNREDNFASTINTV_SC_Compu "" TAB_VERB 2 0 "False" 1 "True" /end COMPU_VTAB
/begin COMPU_METHOD TQSTRUCT2W_SC_Compu "" TAB_VERB "%6.3" "" COMPU_TAB_REF TQSTRUCT2W_SC_Compu /end COMPU_METHOD
/begin COMPU_VTAB TQSTRUCT2W_SC_Compu "" TAB_VERB 2 0 "False" 1 "True" /end COMPU_VTAB
/begin COMPU_METHOD TQSTRUCTTYP_SC_Compu "" TAB_VERB "%6.3" "" COMPU_TAB_REF TQSTRUCTTYP_SC_Compu /end COMPU_METHOD
/begin COMPU_VTAB TQSTRUCTTYP_SC_Compu "" TAB_VERB 4 0 "0" 1 "1" 2 "2" 3 "3" /end COMPU_VTAB
/begin COMPU_METHOD TRANOIPRV_SY_Compu "" TAB_VERB "%6.3" "" COMPU_TAB_REF TRANOIPRV_SY_Compu /end COMPU_METHOD
/begin COMPU_VTAB TRANOIPRV_SY_Compu "" TAB_VERB 2 0 "no anti-rattling available" 1 "anti-rattling available" /end COMPU_VTAB
/begin COMPU_METHOD TRANSPTMODE_SY_Compu "" TAB_VERB "%6.3" "" COMPU_TAB_REF TRANSPTMODE_SY_Compu /end COMPU_METHOD
/begin COMPU_VTAB TRANSPTMODE_SY_Compu "" TAB_VERB 2 0 "False" 1 "True" /end COMPU_VTAB
/begin COMPU_METHOD TRA_AST_SY_Compu "" TAB_VERB "%6.3" "" COMPU_TAB_REF TRA_AST_SY_Compu /end COMPU_METHOD
/begin COMPU_VTAB TRA_AST_SY_Compu "" TAB_VERB 3 0 "NOT_AVL" 1 "CFG" 2 "AVL" /end COMPU_VTAB
/begin COMPU_METHOD TRA_AT_SY_Compu "" TAB_VERB "%6.3" "" COMPU_TAB_REF TRA_AT_SY_Compu /end COMPU_METHOD
/begin COMPU_VTAB TRA_AT_SY_Compu "" TAB_VERB 3 0 "NOT_AVL" 1 "CFG" 2 "AVL" /end COMPU_VTAB
/begin COMPU_METHOD TRA_AUTRKPROTNACTV_SC_Compu "" TAB_VERB "%6.3" "" COMPU_TAB_REF TRA_AUTRKPROTNACTV_SC_Compu /end COMPU_METHOD
/begin COMPU_VTAB TRA_AUTRKPROTNACTV_SC_Compu "" TAB_VERB 2 0 "False" 1 "True" /end COMPU_VTAB
/begin COMPU_METHOD TRA_CVT_SY_Compu "" TAB_VERB "%6.3" "" COMPU_TAB_REF TRA_CVT_SY_Compu /end COMPU_METHOD
/begin COMPU_VTAB TRA_CVT_SY_Compu "" TAB_VERB 3 0 "NOT_AVL" 1 "CFG" 2 "AVL" /end COMPU_VTAB
/begin COMPU_METHOD TRA_DCT_SY_Compu "" TAB_VERB "%6.3" "" COMPU_TAB_REF TRA_DCT_SY_Compu /end COMPU_METHOD
/begin COMPU_VTAB TRA_DCT_SY_Compu "" TAB_VERB 3 0 "NOT_AVL" 1 "CFG" 2 "AVL" /end COMPU_VTAB
/begin COMPU_METHOD TRA_INTERLOCK_SY_Compu "" TAB_VERB "%6.3" "" COMPU_TAB_REF TRA_INTERLOCK_SY_Compu /end COMPU_METHOD
/begin COMPU_VTAB TRA_INTERLOCK_SY_Compu "" TAB_VERB 2 0 "FALSE" 1 "TRUE" /end COMPU_VTAB
/begin COMPU_METHOD TRA_MT_SY_Compu "" TAB_VERB "%6.3" "" COMPU_TAB_REF TRA_MT_SY_Compu /end COMPU_METHOD
/begin COMPU_VTAB TRA_MT_SY_Compu "" TAB_VERB 3 0 "NOT_AVL" 1 "CFG" 2 "AVL" /end COMPU_VTAB
/begin COMPU_METHOD TRA_PDK_SY_Compu "" TAB_VERB "%6.3" "" COMPU_TAB_REF TRA_PDK_SY_Compu /end COMPU_METHOD
/begin COMPU_VTAB TRA_PDK_SY_Compu "" TAB_VERB 2 0 "False" 1 "True" /end COMPU_VTAB
/begin COMPU_METHOD TRBCHAIRACTR_SC_Compu "" TAB_VERB "%6.3" "" COMPU_TAB_REF TRBCHAIRACTR_SC_Compu /end COMPU_METHOD
/begin COMPU_VTAB TRBCHAIRACTR_SC_Compu "" TAB_VERB 2 0 "False" 1 "True" /end COMPU_VTAB
/begin COMPU_METHOD TRBCHINSDT_TYPAVL_SC_Compu "" TAB_VERB "%6.3" "" COMPU_TAB_REF TRBCHINSDT_TYPAVL_SC_Compu /end COMPU_METHOD
/begin COMPU_VTAB TRBCHINSDT_TYPAVL_SC_Compu "" TAB_VERB 2 0 "False" 1 "True" /end COMPU_VTAB
/begin COMPU_METHOD TrbChN_float "" RAT_FUNC "%6.2" "rpm" COEFFS 0 1 0 0 0 1 /end COMPU_METHOD
/begin COMPU_METHOD TRBCH_ACTRTYP_SC_Compu "" TAB_VERB "%6.3" "" COMPU_TAB_REF TRBCH_ACTRTYP_SC_Compu /end COMPU_METHOD
/begin COMPU_VTAB TRBCH_ACTRTYP_SC_Compu "" TAB_VERB 7 0 "0" 1 "1" 2 "2" 3 "3" 4 "4" 5 "PWM + h-bridge" 6 "6" /end COMPU_VTAB
/begin COMPU_METHOD Trq "" RAT_FUNC "%6.3" "Nm" COEFFS 0 10 0 0 0 1 /end COMPU_METHOD
/begin COMPU_METHOD t_q0p001 "" RAT_FUNC "%6.5" "s" COEFFS 0 1000 0 0 0 1 /end COMPU_METHOD
/begin COMPU_METHOD t_q0p01 "" RAT_FUNC "%6.4" "s" COEFFS 0 100 0 0 0 1 /end COMPU_METHOD
/begin COMPU_METHOD t_q0p05 "" RAT_FUNC "%6.4" "s" COEFFS 0 100 0 0 0 5 /end COMPU_METHOD
/begin COMPU_METHOD t_q1 "" RAT_FUNC "%6.2" "s" COEFFS 0 1 0 0 0 1 /end COMPU_METHOD
/begin COMPU_METHOD t_q3p815Em6 "" RAT_FUNC "%8.7" "s" COEFFS 0 262144 0 0 0 1 /end COMPU_METHOD
/begin COMPU_METHOD t_tev0p0005 "" RAT_FUNC "%6.5" "s" COEFFS 0 2048 0 0 0 1 /end COMPU_METHOD
/begin RECORD_LAYOUT Cur_Xs16Ws16 NO_AXIS_PTS_X 1 SWORD AXIS_PTS_X 2 SWORD INDEX_INCR DIRECT FNC_VALUES 3 SWORD COLUMN_DIR DIRECT /end RECORD_LAYOUT
/begin RECORD_LAYOUT Map_Xs16Ys16Ws16 NO_AXIS_PTS_X 1 SWORD NO_AXIS_PTS_Y 2 SWORD AXIS_PTS_X 3 SWORD INDEX_INCR DIRECT AXIS_PTS_Y 4 SWORD INDEX_INCR DIRECT FNC_VALUES 5 SWORD COLUMN_DIR DIRECT /end RECORD_LAYOUT
/begin RECORD_LAYOUT RB_Curve_U16_U16 NO_AXIS_PTS_X 1 UWORD AXIS_PTS_X 2 UWORD INDEX_INCR DIRECT FNC_VALUES 3 UWORD COLUMN_DIR DIRECT /end RECORD_LAYOUT
/begin RECORD_LAYOUT RB_Val_Ws16 FNC_VALUES 1 SWORD COLUMN_DIR DIRECT /end RECORD_LAYOUT
/begin RECORD_LAYOUT RB_Val_Ws32 FNC_VALUES 1 SLONG COLUMN_DIR DIRECT /end RECORD_LAYOUT
/begin RECORD_LAYOUT RB_Val_Wu16 FNC_VALUES 1 UWORD COLUMN_DIR DIRECT /end RECORD_LAYOUT
/begin RECORD_LAYOUT RB_Val_Wu8 FNC_VALUES 1 UBYTE COLUMN_DIR DIRECT /end RECORD_LAYOUT
/begin RECORD_LAYOUT Val_Ws16 FNC_VALUES 1 SWORD COLUMN_DIR DIRECT /end RECORD_LAYOUT
/begin RECORD_LAYOUT Val_Ws32 FNC_VALUES 1 SLONG COLUMN_DIR DIRECT /end RECORD_LAYOUT
/begin RECORD_LAYOUT Val_Wu16 FNC_VALUES 1 UWORD COLUMN_DIR DIRECT /end RECORD_LAYOUT
/begin RECORD_LAYOUT Val_Wu32 FNC_VALUES 1 ULONG COLUMN_DIR DIRECT /end RECORD_LAYOUT
/begin RECORD_LAYOUT Val_Wu8 FNC_VALUES 1 UBYTE COLUMN_DIR DIRECT /end RECORD_LAYOUT
/end MODULE
/end PROJECT
