ASAP2_VERSION 1 60
/begin PROJECT MG1CA020 "MG1CA020"
/begin HEADER "" VERSION "MG1CA020_6SAY_V011_TPROT" PROJECT_NO MG1CA020 /end HEADER
/begin MODULE DIM ""
/begin MOD_COMMON "" BYTE_ORDER MSB_LAST ALIGNMENT_BYTE 1 ALIGNMENT_WORD 2 ALIGNMENT_LONG 4 ALIGNMENT_INT64 4 ALIGNMENT_FLOAT32_IEEE 4 ALIGNMENT_FLOAT64_IEEE 4 DATA_SIZE 32 /end MOD_COMMON
/begin CHARACTERISTIC DFES_MeterOut.DFC_AltIOACGFailr_C "project specific calibration data / Project specific calibration data for DFC_AltIOACGFailr" VALUE 0x804EE2B8 Val_Wu8 255.0 OneToOne 0.00 255.0 FORMAT "%5.1" /end CHARACTERISTIC
/begin CHARACTERISTIC DFES_MeterOut.DFC_AltIOACGHiVltg_C "project specific calibration data / Project specific calibration data for DFC_AltIOACGHiVltg" VALUE 0x804EE2B9 Val_Wu8 255.0 OneToOne 0.00 255.0 FORMAT "%5.1" /end CHARACTERISTIC
/begin CHARACTERISTIC DFES_MeterOut.DFC_AltIOACGLoVltg_C "project specific calibration data / Project specific calibration data for DFC_AltIOACGLoVltg" VALUE 0x804EE2BA Val_Wu8 255.0 OneToOne 0.00 255.0 FORMAT "%5.1" /end CHARACTERISTIC
/begin CHARACTERISTIC DFES_MeterOut.DFC_AltIOACGTHi_C "project specific calibration data / Project specific calibration data for DFC_AltIOACGTHi" VALUE 0x804EE2BB Val_Wu8 255.0 OneToOne 0.00 255.0 FORMAT "%5.1" /end CHARACTERISTIC
/begin CHARACTERISTIC DFES_MeterOut.DFC_AltIODConnACG_C "project specific calibration data / Project specific calibration data for DFC_AltIODConnACG" VALUE 0x804EE2BC Val_Wu8 255.0 OneToOne 0.00 255.0 FORMAT "%5.1" /end CHARACTERISTIC
/begin CHARACTERISTIC DFES_MeterOut.DFC_BattUHiFailr_C "project specific calibration data / Project specific calibration data for DFC_BattUHiFailr" VALUE 0x804EE2BD Val_Wu8 255.0 OneToOne 0.00 255.0 FORMAT "%5.1" /end CHARACTERISTIC
/begin CHARACTERISTIC DFES_MeterOut.DFC_BattULoFailr_C "project specific calibration data / Project specific calibration data for DFC_BattULoFailr" VALUE 0x804EE2BE Val_Wu8 255.0 OneToOne 0.00 255.0 FORMAT "%5.1" /end CHARACTERISTIC
/begin CHARACTERISTIC DFES_MeterOut.DFC_BrkBstPDriftHiErr_C "project specific calibration data / Project specific calibration data for DFC_BrkBstPDriftHiErr" VALUE 0x804EE2BF Val_Wu8 255.0 OneToOne 0.00 255.0 FORMAT "%5.1" /end CHARACTERISTIC
/begin CHARACTERISTIC DFES_MeterOut.DFC_BrkBstPDriftLoErr_C "project specific calibration data / Project specific calibration data for DFC_BrkBstPDriftLoErr" VALUE 0x804EE2C0 Val_Wu8 255.0 OneToOne 0.00 255.0 FORMAT "%5.1" /end CHARACTERISTIC
/begin CHARACTERISTIC DFES_MeterOut.DFC_BrkBstPSnsrStuck_C "project specific calibration data / Project specific calibration data for DFC_BrkBstPSnsrStuck" VALUE 0x804EE2C1 Val_Wu8 255.0 OneToOne 0.00 255.0 FORMAT "%5.1" /end CHARACTERISTIC
/begin CHARACTERISTIC DFES_MeterOut.DFC_BrkMnSwtContOn_C "project specific calibration data / Project specific calibration data for DFC_BrkMnSwtContOn" VALUE 0x804EE2C2 Val_Wu8 255.0 OneToOne 0.00 255.0 FORMAT "%5.1" /end CHARACTERISTIC
/begin CHARACTERISTIC DFES_MeterOut.DFC_BrkMnSwtNotStp_C "project specific calibration data / Project specific calibration data for DFC_BrkMnSwtNotStp" VALUE 0x804EE2C3 Val_Wu8 255.0 OneToOne 0.00 255.0 FORMAT "%5.1" /end CHARACTERISTIC
/begin CHARACTERISTIC DFES_MeterOut.DFC_BrkNpl_C "project specific calibration data / Project specific calibration data for DFC_BrkNpl" VALUE 0x804EE2C4 Val_Wu8 255.0 OneToOne 0.00 255.0 FORMAT "%5.1" /end CHARACTERISTIC
/begin CHARACTERISTIC DFES_MeterOut.DFC_BrkRdntSwtContOn_C "project specific calibration data / Project specific calibration data for DFC_BrkRdntSwtContOn" VALUE 0x804EE2C5 Val_Wu8 255.0 OneToOne 0.00 255.0 FORMAT "%5.1" /end CHARACTERISTIC
/begin CHARACTERISTIC DFES_MeterOut.DFC_BrkRdntSwtNotStp_C "project specific calibration data / Project specific calibration data for DFC_BrkRdntSwtNotStp" VALUE 0x804EE2C6 Val_Wu8 255.0 OneToOne 0.00 255.0 FORMAT "%5.1" /end CHARACTERISTIC
/begin CHARACTERISTIC DFES_MeterOut.DFC_Clth3ONStuck_C "project specific calibration data / Project specific calibration data for DFC_Clth3ONStuck" VALUE 0x804EE2C7 Val_Wu8 255.0 OneToOne 0.00 255.0 FORMAT "%5.1" /end CHARACTERISTIC
/begin CHARACTERISTIC DFES_MeterOut.DFC_Clth4OFFStuck_C "project specific calibration data / Project specific calibration data for DFC_Clth4OFFStuck" VALUE 0x804EE2C8 Val_Wu8 255.0 OneToOne 0.00 255.0 FORMAT "%5.1" /end CHARACTERISTIC
/begin CHARACTERISTIC DFES_MeterOut.DFC_ClthOFFStuck_C "project specific calibration data / Project specific calibration data for DFC_ClthOFFStuck" VALUE 0x804EE2C9 Val_Wu8 255.0 OneToOne 0.00 255.0 FORMAT "%5.1" /end CHARACTERISTIC
/begin CHARACTERISTIC DFES_MeterOut.DFC_ClthONStuck_C "project specific calibration data / Project specific calibration data for DFC_ClthONStuck" VALUE 0x804EE2CA Val_Wu8 255.0 OneToOne 0.00 255.0 FORMAT "%5.1" /end CHARACTERISTIC
/begin CHARACTERISTIC DFES_MeterOut.DFC_ClthStkFailInfo_C "project specific calibration data / Project specific calibration data for DFC_ClthStkFailInfo" VALUE 0x804EE2CB Val_Wu8 255.0 OneToOne 0.00 255.0 FORMAT "%5.1" /end CHARACTERISTIC
/begin CHARACTERISTIC DFES_MeterOut.DFC_ComACFailInfo_C "project specific calibration data / Project specific calibration data for DFC_ComACFailInfo" VALUE 0x804EE2CC Val_Wu8 255.0 OneToOne 0.00 255.0 FORMAT "%5.1" /end CHARACTERISTIC
/begin CHARACTERISTIC DFES_MeterOut.DFC_ComATFTValErr_C "project specific calibration data / Project specific calibration data for DFC_ComATFTValErr" VALUE 0x804EE2CD Val_Wu8 255.0 OneToOne 0.00 255.0 FORMAT "%5.1" /end CHARACTERISTIC
/begin CHARACTERISTIC DFES_MeterOut.DFC_ComATMILReq_C "project specific calibration data / Project specific calibration data for DFC_ComATMILReq" VALUE 0x804EE2CE Val_Wu8 255.0 OneToOne 0.00 255.0 FORMAT "%5.1" /end CHARACTERISTIC
/begin CHARACTERISTIC DFES_MeterOut.DFC_ComAYCAChksum_C "project specific calibration data / Project specific calibration data for DFC_ComAYCAChksum" VALUE 0x804EE2CF Val_Wu8 255.0 OneToOne 0.00 255.0 FORMAT "%5.1" /end CHARACTERISTIC
/begin CHARACTERISTIC DFES_MeterOut.DFC_ComAYCARingCnt_C "project specific calibration data / Project specific calibration data for DFC_ComAYCARingCnt" VALUE 0x804EE2D0 Val_Wu8 255.0 OneToOne 0.00 255.0 FORMAT "%5.1" /end CHARACTERISTIC
/begin CHARACTERISTIC DFES_MeterOut.DFC_ComAYCATOut_C "project specific calibration data / Project specific calibration data for DFC_ComAYCATOut" VALUE 0x804EE2D1 Val_Wu8 255.0 OneToOne 0.00 255.0 FORMAT "%5.1" /end CHARACTERISTIC
/begin CHARACTERISTIC DFES_MeterOut.DFC_ComAYCDChkSum_C "project specific calibration data / Project specific calibration data for DFC_ComAYCDChkSum" VALUE 0x804EE2D2 Val_Wu8 255.0 OneToOne 0.00 255.0 FORMAT "%5.1" /end CHARACTERISTIC
/begin CHARACTERISTIC DFES_MeterOut.DFC_ComAYCDTOut_C "project specific calibration data / Project specific calibration data for DFC_ComAYCDTOut" VALUE 0x804EE2D3 Val_Wu8 255.0 OneToOne 0.00 255.0 FORMAT "%5.1" /end CHARACTERISTIC
/begin CHARACTERISTIC DFES_MeterOut.DFC_ComAYCFChksum_C "project specific calibration data / Project specific calibration data for DFC_ComAYCFChksum" VALUE 0x804EE2D4 Val_Wu8 255.0 OneToOne 0.00 255.0 FORMAT "%5.1" /end CHARACTERISTIC
/begin CHARACTERISTIC DFES_MeterOut.DFC_ComAYCFRingCnt_C "project specific calibration data / Project specific calibration data for DFC_ComAYCFRingCnt" VALUE 0x804EE2D5 Val_Wu8 255.0 OneToOne 0.00 255.0 FORMAT "%5.1" /end CHARACTERISTIC
/begin CHARACTERISTIC DFES_MeterOut.DFC_ComAYCFTOut_C "project specific calibration data / Project specific calibration data for DFC_ComAYCFTOut" VALUE 0x804EE2D6 Val_Wu8 255.0 OneToOne 0.00 255.0 FORMAT "%5.1" /end CHARACTERISTIC
/begin CHARACTERISTIC DFES_MeterOut.DFC_ComAYCGChksum_C "project specific calibration data / Project specific calibration data for DFC_ComAYCGChksum" VALUE 0x804EE2D7 Val_Wu8 255.0 OneToOne 0.00 255.0 FORMAT "%5.1" /end CHARACTERISTIC
/begin CHARACTERISTIC DFES_MeterOut.DFC_ComAYCGRingCnt_C "project specific calibration data / Project specific calibration data for DFC_ComAYCGRingCnt" VALUE 0x804EE2D8 Val_Wu8 255.0 OneToOne 0.00 255.0 FORMAT "%5.1" /end CHARACTERISTIC
/begin CHARACTERISTIC DFES_MeterOut.DFC_ComAYCGTOut_C "project specific calibration data / Project specific calibration data for DFC_ComAYCGTOut" VALUE 0x804EE2D9 Val_Wu8 255.0 OneToOne 0.00 255.0 FORMAT "%5.1" /end CHARACTERISTIC
/begin CHARACTERISTIC DFES_MeterOut.DFC_ComAYCIChkSum_C "project specific calibration data / Project specific calibration data for DFC_ComAYCIChkSum" VALUE 0x804EE2DA Val_Wu8 255.0 OneToOne 0.00 255.0 FORMAT "%5.1" /end CHARACTERISTIC
/begin CHARACTERISTIC DFES_MeterOut.DFC_ComAYCIRingCnt_C "project specific calibration data / Project specific calibration data for DFC_ComAYCIRingCnt" VALUE 0x804EE2DB Val_Wu8 255.0 OneToOne 0.00 255.0 FORMAT "%5.1" /end CHARACTERISTIC
/begin CHARACTERISTIC DFES_MeterOut.DFC_ComAYCITOut_C "project specific calibration data / Project specific calibration data for DFC_ComAYCITOut" VALUE 0x804EE2DC Val_Wu8 255.0 OneToOne 0.00 255.0 FORMAT "%5.1" /end CHARACTERISTIC
/begin CHARACTERISTIC DFES_MeterOut.DFC_ComBCM1ChkSum_C "project specific calibration data / Project specific calibration data for DFC_ComBCM1ChkSum" VALUE 0x804EE2DD Val_Wu8 255.0 OneToOne 0.00 255.0 FORMAT "%5.1" /end CHARACTERISTIC
/begin CHARACTERISTIC DFES_MeterOut.DFC_ComBCM1RingCnt_C "project specific calibration data / Project specific calibration data for DFC_ComBCM1RingCnt" VALUE 0x804EE2DE Val_Wu8 255.0 OneToOne 0.00 255.0 FORMAT "%5.1" /end CHARACTERISTIC
/begin CHARACTERISTIC DFES_MeterOut.DFC_ComBCM1TOut_C "project specific calibration data / Project specific calibration data for DFC_ComBCM1TOut" VALUE 0x804EE2DF Val_Wu8 255.0 OneToOne 0.00 255.0 FORMAT "%5.1" /end CHARACTERISTIC
/begin CHARACTERISTIC DFES_MeterOut.DFC_ComCANABusOffErr_C "project specific calibration data / Project specific calibration data for DFC_ComCANABusOffErr" VALUE 0x804EE2E0 Val_Wu8 255.0 OneToOne 0.00 255.0 FORMAT "%5.1" /end CHARACTERISTIC
/begin CHARACTERISTIC DFES_MeterOut.DFC_ComCANBBusOffErr_C "project specific calibration data / Project specific calibration data for DFC_ComCANBBusOffErr" VALUE 0x804EE2E1 Val_Wu8 255.0 OneToOne 0.00 255.0 FORMAT "%5.1" /end CHARACTERISTIC
/begin CHARACTERISTIC DFES_MeterOut.DFC_ComCANCBusOffErr_C "project specific calibration data / Project specific calibration data for DFC_ComCANCBusOffErr" VALUE 0x804EE2E2 Val_Wu8 255.0 OneToOne 0.00 255.0 FORMAT "%5.1" /end CHARACTERISTIC
/begin CHARACTERISTIC DFES_MeterOut.DFC_ComCGW1ChkSum_C "project specific calibration data / Project specific calibration data for DFC_ComCGW1ChkSum" VALUE 0x804EE2E3 Val_Wu8 255.0 OneToOne 0.00 255.0 FORMAT "%5.1" /end CHARACTERISTIC
/begin CHARACTERISTIC DFES_MeterOut.DFC_ComCGW1RingCnt_C "project specific calibration data / Project specific calibration data for DFC_ComCGW1RingCnt" VALUE 0x804EE2E4 Val_Wu8 255.0 OneToOne 0.00 255.0 FORMAT "%5.1" /end CHARACTERISTIC
/begin CHARACTERISTIC DFES_MeterOut.DFC_ComCGW1TOut_C "project specific calibration data / Project specific calibration data for DFC_ComCGW1TOut" VALUE 0x804EE2E5 Val_Wu8 255.0 OneToOne 0.00 255.0 FORMAT "%5.1" /end CHARACTERISTIC
/begin CHARACTERISTIC DFES_MeterOut.DFC_ComConvBoostErr_C "project specific calibration data / Project specific calibration data for DFC_ComConvBoostErr" VALUE 0x804EE2E6 Val_Wu8 255.0 OneToOne 0.00 255.0 FORMAT "%5.1" /end CHARACTERISTIC
/begin CHARACTERISTIC DFES_MeterOut.DFC_ComConvSlipErr_C "project specific calibration data / Project specific calibration data for DFC_ComConvSlipErr" VALUE 0x804EE2E7 Val_Wu8 255.0 OneToOne 0.00 255.0 FORMAT "%5.1" /end CHARACTERISTIC
/begin CHARACTERISTIC DFES_MeterOut.DFC_ComEAT10Chksum_C "project specific calibration data / Project specific calibration data for DFC_ComEAT10Chksum" VALUE 0x804EE2E8 Val_Wu8 255.0 OneToOne 0.00 255.0 FORMAT "%5.1" /end CHARACTERISTIC
/begin CHARACTERISTIC DFES_MeterOut.DFC_ComEAT10RingCnt_C "project specific calibration data / Project specific calibration data for DFC_ComEAT10RingCnt" VALUE 0x804EE2E9 Val_Wu8 255.0 OneToOne 0.00 255.0 FORMAT "%5.1" /end CHARACTERISTIC
/begin CHARACTERISTIC DFES_MeterOut.DFC_ComEAT10TOut_C "project specific calibration data / Project specific calibration data for DFC_ComEAT10TOut" VALUE 0x804EE2EA Val_Wu8 255.0 OneToOne 0.00 255.0 FORMAT "%5.1" /end CHARACTERISTIC
/begin CHARACTERISTIC DFES_MeterOut.DFC_ComEAT11ChkSum_C "project specific calibration data / Project specific calibration data for DFC_ComEAT11ChkSum" VALUE 0x804EE2EB Val_Wu8 255.0 OneToOne 0.00 255.0 FORMAT "%5.1" /end CHARACTERISTIC
/begin CHARACTERISTIC DFES_MeterOut.DFC_ComEAT11RingCnt_C "project specific calibration data / Project specific calibration data for DFC_ComEAT11RingCnt" VALUE 0x804EE2EC Val_Wu8 255.0 OneToOne 0.00 255.0 FORMAT "%5.1" /end CHARACTERISTIC
/begin CHARACTERISTIC DFES_MeterOut.DFC_ComEAT11TOut_C "project specific calibration data / Project specific calibration data for DFC_ComEAT11TOut" VALUE 0x804EE2ED Val_Wu8 255.0 OneToOne 0.00 255.0 FORMAT "%5.1" /end CHARACTERISTIC
/begin CHARACTERISTIC DFES_MeterOut.DFC_ComEAT12ChkSum_C "project specific calibration data / Project specific calibration data for DFC_ComEAT12ChkSum" VALUE 0x804EE2EE Val_Wu8 255.0 OneToOne 0.00 255.0 FORMAT "%5.1" /end CHARACTERISTIC
/begin CHARACTERISTIC DFES_MeterOut.DFC_ComEAT12RingCnt_C "project specific calibration data / Project specific calibration data for DFC_ComEAT12RingCnt" VALUE 0x804EE2EF Val_Wu8 255.0 OneToOne 0.00 255.0 FORMAT "%5.1" /end CHARACTERISTIC
/begin CHARACTERISTIC DFES_MeterOut.DFC_ComEAT12TOut_C "project specific calibration data / Project specific calibration data for DFC_ComEAT12TOut" VALUE 0x804EE2F0 Val_Wu8 255.0 OneToOne 0.00 255.0 FORMAT "%5.1" /end CHARACTERISTIC
/begin CHARACTERISTIC DFES_MeterOut.DFC_ComEAT13ChkSum_C "project specific calibration data / Project specific calibration data for DFC_ComEAT13ChkSum" VALUE 0x804EE2F1 Val_Wu8 255.0 OneToOne 0.00 255.0 FORMAT "%5.1" /end CHARACTERISTIC
/begin CHARACTERISTIC DFES_MeterOut.DFC_ComEAT13RingCnt_C "project specific calibration data / Project specific calibration data for DFC_ComEAT13RingCnt" VALUE 0x804EE2F2 Val_Wu8 255.0 OneToOne 0.00 255.0 FORMAT "%5.1" /end CHARACTERISTIC
/begin CHARACTERISTIC DFES_MeterOut.DFC_ComEAT13TOut_C "project specific calibration data / Project specific calibration data for DFC_ComEAT13TOut" VALUE 0x804EE2F3 Val_Wu8 255.0 OneToOne 0.00 255.0 FORMAT "%5.1" /end CHARACTERISTIC
/begin CHARACTERISTIC DFES_MeterOut.DFC_ComEAT1Chksum_C "project specific calibration data / Project specific calibration data for DFC_ComEAT1Chksum" VALUE 0x804EE2F4 Val_Wu8 255.0 OneToOne 0.00 255.0 FORMAT "%5.1" /end CHARACTERISTIC
/begin CHARACTERISTIC DFES_MeterOut.DFC_ComEAT1RingCnt_C "project specific calibration data / Project specific calibration data for DFC_ComEAT1RingCnt" VALUE 0x804EE2F5 Val_Wu8 255.0 OneToOne 0.00 255.0 FORMAT "%5.1" /end CHARACTERISTIC
/begin CHARACTERISTIC DFES_MeterOut.DFC_ComEAT1TOut_C "project specific calibration data / Project specific calibration data for DFC_ComEAT1TOut" VALUE 0x804EE2F6 Val_Wu8 255.0 OneToOne 0.00 255.0 FORMAT "%5.1" /end CHARACTERISTIC
/begin CHARACTERISTIC DFES_MeterOut.DFC_ComEAT2ChkSum_C "project specific calibration data / Project specific calibration data for DFC_ComEAT2ChkSum" VALUE 0x804EE2F7 Val_Wu8 255.0 OneToOne 0.00 255.0 FORMAT "%5.1" /end CHARACTERISTIC
/begin CHARACTERISTIC DFES_MeterOut.DFC_ComEAT2RingCnt_C "project specific calibration data / Project specific calibration data for DFC_ComEAT2RingCnt" VALUE 0x804EE2F8 Val_Wu8 255.0 OneToOne 0.00 255.0 FORMAT "%5.1" /end CHARACTERISTIC
/begin CHARACTERISTIC DFES_MeterOut.DFC_ComEAT2TOut_C "project specific calibration data / Project specific calibration data for DFC_ComEAT2TOut" VALUE 0x804EE2F9 Val_Wu8 255.0 OneToOne 0.00 255.0 FORMAT "%5.1" /end CHARACTERISTIC
/begin CHARACTERISTIC DFES_MeterOut.DFC_ComEAT4ChkSum_C "project specific calibration data / Project specific calibration data for DFC_ComEAT4ChkSum" VALUE 0x804EE2FA Val_Wu8 255.0 OneToOne 0.00 255.0 FORMAT "%5.1" /end CHARACTERISTIC
/begin CHARACTERISTIC DFES_MeterOut.DFC_ComEAT4RingCnt_C "project specific calibration data / Project specific calibration data for DFC_ComEAT4RingCnt" VALUE 0x804EE2FB Val_Wu8 255.0 OneToOne 0.00 255.0 FORMAT "%5.1" /end CHARACTERISTIC
/begin CHARACTERISTIC DFES_MeterOut.DFC_ComEAT4TOut_C "project specific calibration data / Project specific calibration data for DFC_ComEAT4TOut" VALUE 0x804EE2FC Val_Wu8 255.0 OneToOne 0.00 255.0 FORMAT "%5.1" /end CHARACTERISTIC
/begin CHARACTERISTIC DFES_MeterOut.DFC_ComEAT6Chksum_C "project specific calibration data / Project specific calibration data for DFC_ComEAT6Chksum" VALUE 0x804EE2FD Val_Wu8 255.0 OneToOne 0.00 255.0 FORMAT "%5.1" /end CHARACTERISTIC
/begin CHARACTERISTIC DFES_MeterOut.DFC_ComEAT6RingCnt_C "project specific calibration data / Project specific calibration data for DFC_ComEAT6RingCnt" VALUE 0x804EE2FE Val_Wu8 255.0 OneToOne 0.00 255.0 FORMAT "%5.1" /end CHARACTERISTIC
/begin CHARACTERISTIC DFES_MeterOut.DFC_ComEAT6TOut_C "project specific calibration data / Project specific calibration data for DFC_ComEAT6TOut" VALUE 0x804EE2FF Val_Wu8 255.0 OneToOne 0.00 255.0 FORMAT "%5.1" /end CHARACTERISTIC
/begin CHARACTERISTIC DFES_MeterOut.DFC_ComEAT7Chksum_C "project specific calibration data / Project specific calibration data for DFC_ComEAT7Chksum" VALUE 0x804EE300 Val_Wu8 255.0 OneToOne 0.00 255.0 FORMAT "%5.1" /end CHARACTERISTIC
/begin CHARACTERISTIC DFES_MeterOut.DFC_ComEAT7RingCnt_C "project specific calibration data / Project specific calibration data for DFC_ComEAT7RingCnt" VALUE 0x804EE301 Val_Wu8 255.0 OneToOne 0.00 255.0 FORMAT "%5.1" /end CHARACTERISTIC
/begin CHARACTERISTIC DFES_MeterOut.DFC_ComEAT7TOut_C "project specific calibration data / Project specific calibration data for DFC_ComEAT7TOut" VALUE 0x804EE302 Val_Wu8 255.0 OneToOne 0.00 255.0 FORMAT "%5.1" /end CHARACTERISTIC
/begin CHARACTERISTIC DFES_MeterOut.DFC_ComEAT8Chksum_C "project specific calibration data / Project specific calibration data for DFC_ComEAT8Chksum" VALUE 0x804EE303 Val_Wu8 255.0 OneToOne 0.00 255.0 FORMAT "%5.1" /end CHARACTERISTIC
/begin CHARACTERISTIC DFES_MeterOut.DFC_ComEAT8RingCnt_C "project specific calibration data / Project specific calibration data for DFC_ComEAT8RingCnt" VALUE 0x804EE304 Val_Wu8 255.0 OneToOne 0.00 255.0 FORMAT "%5.1" /end CHARACTERISTIC
/begin CHARACTERISTIC DFES_MeterOut.DFC_ComEAT8TOut_C "project specific calibration data / Project specific calibration data for DFC_ComEAT8TOut" VALUE 0x804EE305 Val_Wu8 255.0 OneToOne 0.00 255.0 FORMAT "%5.1" /end CHARACTERISTIC
/begin CHARACTERISTIC DFES_MeterOut.DFC_ComEATAChksum_C "project specific calibration data / Project specific calibration data for DFC_ComEATAChksum" VALUE 0x804EE306 Val_Wu8 255.0 OneToOne 0.00 255.0 FORMAT "%5.1" /end CHARACTERISTIC
/begin CHARACTERISTIC DFES_MeterOut.DFC_ComEATARingCnt_C "project specific calibration data / Project specific calibration data for DFC_ComEATARingCnt" VALUE 0x804EE307 Val_Wu8 255.0 OneToOne 0.00 255.0 FORMAT "%5.1" /end CHARACTERISTIC
/begin CHARACTERISTIC DFES_MeterOut.DFC_ComEATATOut_C "project specific calibration data / Project specific calibration data for DFC_ComEATATOut" VALUE 0x804EE308 Val_Wu8 255.0 OneToOne 0.00 255.0 FORMAT "%5.1" /end CHARACTERISTIC
/begin CHARACTERISTIC DFES_MeterOut.DFC_ComEATBChkSum_C "project specific calibration data / Project specific calibration data for DFC_ComEATBChkSum" VALUE 0x804EE309 Val_Wu8 255.0 OneToOne 0.00 255.0 FORMAT "%5.1" /end CHARACTERISTIC
/begin CHARACTERISTIC DFES_MeterOut.DFC_ComEATBRingCnt_C "project specific calibration data / Project specific calibration data for DFC_ComEATBRingCnt" VALUE 0x804EE30A Val_Wu8 255.0 OneToOne 0.00 255.0 FORMAT "%5.1" /end CHARACTERISTIC
/begin CHARACTERISTIC DFES_MeterOut.DFC_ComEATBTOut_C "project specific calibration data / Project specific calibration data for DFC_ComEATBTOut" VALUE 0x804EE30B Val_Wu8 255.0 OneToOne 0.00 255.0 FORMAT "%5.1" /end CHARACTERISTIC
/begin CHARACTERISTIC DFES_MeterOut.DFC_ComEATCChksum_C "project specific calibration data / Project specific calibration data for DFC_ComEATCChksum" VALUE 0x804EE30C Val_Wu8 255.0 OneToOne 0.00 255.0 FORMAT "%5.1" /end CHARACTERISTIC
/begin CHARACTERISTIC DFES_MeterOut.DFC_ComEATCRingCnt_C "project specific calibration data / Project specific calibration data for DFC_ComEATCRingCnt" VALUE 0x804EE30D Val_Wu8 255.0 OneToOne 0.00 255.0 FORMAT "%5.1" /end CHARACTERISTIC
/begin CHARACTERISTIC DFES_MeterOut.DFC_ComEATCTOut_C "project specific calibration data / Project specific calibration data for DFC_ComEATCTOut" VALUE 0x804EE30E Val_Wu8 255.0 OneToOne 0.00 255.0 FORMAT "%5.1" /end CHARACTERISTIC
/begin CHARACTERISTIC DFES_MeterOut.DFC_ComEBBAChksum_C "project specific calibration data / Project specific calibration data for DFC_ComEBBAChksum" VALUE 0x804EE30F Val_Wu8 255.0 OneToOne 0.00 255.0 FORMAT "%5.1" /end CHARACTERISTIC
/begin CHARACTERISTIC DFES_MeterOut.DFC_ComEBBARingCnt_C "project specific calibration data / Project specific calibration data for DFC_ComEBBARingCnt" VALUE 0x804EE310 Val_Wu8 255.0 OneToOne 0.00 255.0 FORMAT "%5.1" /end CHARACTERISTIC
/begin CHARACTERISTIC DFES_MeterOut.DFC_ComEBBATOut_C "project specific calibration data / Project specific calibration data for DFC_ComEBBATOut" VALUE 0x804EE311 Val_Wu8 255.0 OneToOne 0.00 255.0 FORMAT "%5.1" /end CHARACTERISTIC
/begin CHARACTERISTIC DFES_MeterOut.DFC_ComEPS1Chksum_C "project specific calibration data / Project specific calibration data for DFC_ComEPS1Chksum" VALUE 0x804EE312 Val_Wu8 255.0 OneToOne 0.00 255.0 FORMAT "%5.1" /end CHARACTERISTIC
/begin CHARACTERISTIC DFES_MeterOut.DFC_ComEPS1RingCnt_C "project specific calibration data / Project specific calibration data for DFC_ComEPS1RingCnt" VALUE 0x804EE313 Val_Wu8 255.0 OneToOne 0.00 255.0 FORMAT "%5.1" /end CHARACTERISTIC
/begin CHARACTERISTIC DFES_MeterOut.DFC_ComEPS1TOut_C "project specific calibration data / Project specific calibration data for DFC_ComEPS1TOut" VALUE 0x804EE314 Val_Wu8 255.0 OneToOne 0.00 255.0 FORMAT "%5.1" /end CHARACTERISTIC
/begin CHARACTERISTIC DFES_MeterOut.DFC_ComEngCanRxErr_C "project specific calibration data / Project specific calibration data for DFC_ComEngCanRxErr" VALUE 0x804EE315 Val_Wu8 255.0 OneToOne 0.00 255.0 FORMAT "%5.1" /end CHARACTERISTIC
/begin CHARACTERISTIC DFES_MeterOut.DFC_ComGrvySnsrErr_C "project specific calibration data / Project specific calibration data for DFC_ComGrvySnsrErr" VALUE 0x804EE316 Val_Wu8 255.0 OneToOne 0.00 255.0 FORMAT "%5.1" /end CHARACTERISTIC
/begin CHARACTERISTIC DFES_MeterOut.DFC_ComGwIMG1ChkSum_C "project specific calibration data / Project specific calibration data for DFC_ComGwIMG1ChkSum" VALUE 0x804EE317 Val_Wu8 255.0 OneToOne 0.00 255.0 FORMAT "%5.1" /end CHARACTERISTIC
/begin CHARACTERISTIC DFES_MeterOut.DFC_ComGwIMG1RingCnt_C "project specific calibration data / Project specific calibration data for DFC_ComGwIMG1RingCnt" VALUE 0x804EE318 Val_Wu8 255.0 OneToOne 0.00 255.0 FORMAT "%5.1" /end CHARACTERISTIC
/begin CHARACTERISTIC DFES_MeterOut.DFC_ComGwIMG1TOut_C "project specific calibration data / Project specific calibration data for DFC_ComGwIMG1TOut" VALUE 0x804EE319 Val_Wu8 255.0 OneToOne 0.00 255.0 FORMAT "%5.1" /end CHARACTERISTIC
/begin CHARACTERISTIC DFES_MeterOut.DFC_ComGwIMG3ChkSum_C "project specific calibration data / Project specific calibration data for DFC_ComGwIMG3ChkSum" VALUE 0x804EE31A Val_Wu8 255.0 OneToOne 0.00 255.0 FORMAT "%5.1" /end CHARACTERISTIC
/begin CHARACTERISTIC DFES_MeterOut.DFC_ComGwIMG3RingCnt_C "project specific calibration data / Project specific calibration data for DFC_ComGwIMG3RingCnt" VALUE 0x804EE31B Val_Wu8 255.0 OneToOne 0.00 255.0 FORMAT "%5.1" /end CHARACTERISTIC
/begin CHARACTERISTIC DFES_MeterOut.DFC_ComGwIMG3TOut_C "project specific calibration data / Project specific calibration data for DFC_ComGwIMG3TOut" VALUE 0x804EE31C Val_Wu8 255.0 OneToOne 0.00 255.0 FORMAT "%5.1" /end CHARACTERISTIC
/begin CHARACTERISTIC DFES_MeterOut.DFC_ComGwIMG4ChkSum_C "project specific calibration data / Project specific calibration data for DFC_ComGwIMG4ChkSum" VALUE 0x804EE31D Val_Wu8 255.0 OneToOne 0.00 255.0 FORMAT "%5.1" /end CHARACTERISTIC
/begin CHARACTERISTIC DFES_MeterOut.DFC_ComGwIMG4RingCnt_C "project specific calibration data / Project specific calibration data for DFC_ComGwIMG4RingCnt" VALUE 0x804EE31E Val_Wu8 255.0 OneToOne 0.00 255.0 FORMAT "%5.1" /end CHARACTERISTIC
/begin CHARACTERISTIC DFES_MeterOut.DFC_ComGwIMG4TOut_C "project specific calibration data / Project specific calibration data for DFC_ComGwIMG4TOut" VALUE 0x804EE31F Val_Wu8 255.0 OneToOne 0.00 255.0 FORMAT "%5.1" /end CHARACTERISTIC
/begin CHARACTERISTIC DFES_MeterOut.DFC_ComGwIMG5ChkSum_C "project specific calibration data / Project specific calibration data for DFC_ComGwIMG5ChkSum" VALUE 0x804EE320 Val_Wu8 255.0 OneToOne 0.00 255.0 FORMAT "%5.1" /end CHARACTERISTIC
/begin CHARACTERISTIC DFES_MeterOut.DFC_ComGwIMG5RingCnt_C "project specific calibration data / Project specific calibration data for DFC_ComGwIMG5RingCnt" VALUE 0x804EE321 Val_Wu8 255.0 OneToOne 0.00 255.0 FORMAT "%5.1" /end CHARACTERISTIC
/begin CHARACTERISTIC DFES_MeterOut.DFC_ComGwIMG5TOut_C "project specific calibration data / Project specific calibration data for DFC_ComGwIMG5TOut" VALUE 0x804EE322 Val_Wu8 255.0 OneToOne 0.00 255.0 FORMAT "%5.1" /end CHARACTERISTIC
/begin CHARACTERISTIC DFES_MeterOut.DFC_ComGwIMG6ChkSum_C "project specific calibration data / Project specific calibration data for DFC_ComGwIMG6ChkSum" VALUE 0x804EE323 Val_Wu8 255.0 OneToOne 0.00 255.0 FORMAT "%5.1" /end CHARACTERISTIC
/begin CHARACTERISTIC DFES_MeterOut.DFC_ComGwIMG6RingCnt_C "project specific calibration data / Project specific calibration data for DFC_ComGwIMG6RingCnt" VALUE 0x804EE324 Val_Wu8 255.0 OneToOne 0.00 255.0 FORMAT "%5.1" /end CHARACTERISTIC
/begin CHARACTERISTIC DFES_MeterOut.DFC_ComGwIMG6TOut_C "project specific calibration data / Project specific calibration data for DFC_ComGwIMG6TOut" VALUE 0x804EE325 Val_Wu8 255.0 OneToOne 0.00 255.0 FORMAT "%5.1" /end CHARACTERISTIC
/begin CHARACTERISTIC DFES_MeterOut.DFC_ComIDASBChksum_C "project specific calibration data / Project specific calibration data for DFC_ComIDASBChksum" VALUE 0x804EE326 Val_Wu8 255.0 OneToOne 0.00 255.0 FORMAT "%5.1" /end CHARACTERISTIC
/begin CHARACTERISTIC DFES_MeterOut.DFC_ComIDASBRingCnt_C "project specific calibration data / Project specific calibration data for DFC_ComIDASBRingCnt" VALUE 0x804EE327 Val_Wu8 255.0 OneToOne 0.00 255.0 FORMAT "%5.1" /end CHARACTERISTIC
/begin CHARACTERISTIC DFES_MeterOut.DFC_ComIDASBTOut_C "project specific calibration data / Project specific calibration data for DFC_ComIDASBTOut" VALUE 0x804EE328 Val_Wu8 255.0 OneToOne 0.00 255.0 FORMAT "%5.1" /end CHARACTERISTIC
/begin CHARACTERISTIC DFES_MeterOut.DFC_ComIMGMILReq_C "project specific calibration data / Project specific calibration data for DFC_ComIMGMILReq" VALUE 0x804EE329 Val_Wu8 255.0 OneToOne 0.00 255.0 FORMAT "%5.1" /end CHARACTERISTIC
/begin CHARACTERISTIC DFES_MeterOut.DFC_ComISSPrms_C "project specific calibration data / Project specific calibration data for DFC_ComISSPrms" VALUE 0x804EE32A Val_Wu8 255.0 OneToOne 0.00 255.0 FORMAT "%5.1" /end CHARACTERISTIC
/begin CHARACTERISTIC DFES_MeterOut.DFC_ComMETAChksum_C "project specific calibration data / Project specific calibration data for DFC_ComMETAChksum" VALUE 0x804EE32B Val_Wu8 255.0 OneToOne 0.00 255.0 FORMAT "%5.1" /end CHARACTERISTIC
/begin CHARACTERISTIC DFES_MeterOut.DFC_ComMETARingCnt_C "project specific calibration data / Project specific calibration data for DFC_ComMETARingCnt" VALUE 0x804EE32C Val_Wu8 255.0 OneToOne 0.00 255.0 FORMAT "%5.1" /end CHARACTERISTIC
/begin CHARACTERISTIC DFES_MeterOut.DFC_ComMETATOut_C "project specific calibration data / Project specific calibration data for DFC_ComMETATOut" VALUE 0x804EE32D Val_Wu8 255.0 OneToOne 0.00 255.0 FORMAT "%5.1" /end CHARACTERISTIC
/begin CHARACTERISTIC DFES_MeterOut.DFC_ComMETCChksum_C "project specific calibration data / Project specific calibration data for DFC_ComMETCChksum" VALUE 0x804EE32E Val_Wu8 255.0 OneToOne 0.00 255.0 FORMAT "%5.1" /end CHARACTERISTIC
/begin CHARACTERISTIC DFES_MeterOut.DFC_ComMETCRingCnt_C "project specific calibration data / Project specific calibration data for DFC_ComMETCRingCnt" VALUE 0x804EE32F Val_Wu8 255.0 OneToOne 0.00 255.0 FORMAT "%5.1" /end CHARACTERISTIC
/begin CHARACTERISTIC DFES_MeterOut.DFC_ComMETCTOut_C "project specific calibration data / Project specific calibration data for DFC_ComMETCTOut" VALUE 0x804EE330 Val_Wu8 255.0 OneToOne 0.00 255.0 FORMAT "%5.1" /end CHARACTERISTIC
/begin CHARACTERISTIC DFES_MeterOut.DFC_ComMETDChksum_C "project specific calibration data / Project specific calibration data for DFC_ComMETDChksum" VALUE 0x804EE331 Val_Wu8 255.0 OneToOne 0.00 255.0 FORMAT "%5.1" /end CHARACTERISTIC
/begin CHARACTERISTIC DFES_MeterOut.DFC_ComMETDRingCnt_C "project specific calibration data / Project specific calibration data for DFC_ComMETDRingCnt" VALUE 0x804EE332 Val_Wu8 255.0 OneToOne 0.00 255.0 FORMAT "%5.1" /end CHARACTERISTIC
/begin CHARACTERISTIC DFES_MeterOut.DFC_ComMETDTOut_C "project specific calibration data / Project specific calibration data for DFC_ComMETDTOut" VALUE 0x804EE333 Val_Wu8 255.0 OneToOne 0.00 255.0 FORMAT "%5.1" /end CHARACTERISTIC
/begin CHARACTERISTIC DFES_MeterOut.DFC_ComMETE2Chksum_C "project specific calibration data / Project specific calibration data for DFC_ComMETE2Chksum" VALUE 0x804EE334 Val_Wu8 255.0 OneToOne 0.00 255.0 FORMAT "%5.1" /end CHARACTERISTIC
/begin CHARACTERISTIC DFES_MeterOut.DFC_ComMETE2RingCnt_C "project specific calibration data / Project specific calibration data for DFC_ComMETE2RingCnt" VALUE 0x804EE335 Val_Wu8 255.0 OneToOne 0.00 255.0 FORMAT "%5.1" /end CHARACTERISTIC
/begin CHARACTERISTIC DFES_MeterOut.DFC_ComMETE2TOut_C "project specific calibration data / Project specific calibration data for DFC_ComMETE2TOut" VALUE 0x804EE336 Val_Wu8 255.0 OneToOne 0.00 255.0 FORMAT "%5.1" /end CHARACTERISTIC
/begin CHARACTERISTIC DFES_MeterOut.DFC_ComMETFChksum_C "project specific calibration data / Project specific calibration data for DFC_ComMETFChksum" VALUE 0x804EE337 Val_Wu8 255.0 OneToOne 0.00 255.0 FORMAT "%5.1" /end CHARACTERISTIC
/begin CHARACTERISTIC DFES_MeterOut.DFC_ComMETFRingCnt_C "project specific calibration data / Project specific calibration data for DFC_ComMETFRingCnt" VALUE 0x804EE338 Val_Wu8 255.0 OneToOne 0.00 255.0 FORMAT "%5.1" /end CHARACTERISTIC
/begin CHARACTERISTIC DFES_MeterOut.DFC_ComMETFTOut_C "project specific calibration data / Project specific calibration data for DFC_ComMETFTOut" VALUE 0x804EE339 Val_Wu8 255.0 OneToOne 0.00 255.0 FORMAT "%5.1" /end CHARACTERISTIC
/begin CHARACTERISTIC DFES_MeterOut.DFC_ComMETGChksum_C "project specific calibration data / Project specific calibration data for DFC_ComMETGChksum" VALUE 0x804EE33A Val_Wu8 255.0 OneToOne 0.00 255.0 FORMAT "%5.1" /end CHARACTERISTIC
/begin CHARACTERISTIC DFES_MeterOut.DFC_ComMETGRingCnt_C "project specific calibration data / Project specific calibration data for DFC_ComMETGRingCnt" VALUE 0x804EE33B Val_Wu8 255.0 OneToOne 0.00 255.0 FORMAT "%5.1" /end CHARACTERISTIC
/begin CHARACTERISTIC DFES_MeterOut.DFC_ComMETGTOut_C "project specific calibration data / Project specific calibration data for DFC_ComMETGTOut" VALUE 0x804EE33C Val_Wu8 255.0 OneToOne 0.00 255.0 FORMAT "%5.1" /end CHARACTERISTIC
/begin CHARACTERISTIC DFES_MeterOut.DFC_ComMETH2Chksum_C "project specific calibration data / Project specific calibration data for DFC_ComMETH2Chksum" VALUE 0x804EE33D Val_Wu8 255.0 OneToOne 0.00 255.0 FORMAT "%5.1" /end CHARACTERISTIC
/begin CHARACTERISTIC DFES_MeterOut.DFC_ComMETH2RingCnt_C "project specific calibration data / Project specific calibration data for DFC_ComMETH2RingCnt" VALUE 0x804EE33E Val_Wu8 255.0 OneToOne 0.00 255.0 FORMAT "%5.1" /end CHARACTERISTIC
/begin CHARACTERISTIC DFES_MeterOut.DFC_ComMETH2TOut_C "project specific calibration data / Project specific calibration data for DFC_ComMETH2TOut" VALUE 0x804EE33F Val_Wu8 255.0 OneToOne 0.00 255.0 FORMAT "%5.1" /end CHARACTERISTIC
/begin CHARACTERISTIC DFES_MeterOut.DFC_ComMETHChksum_C "project specific calibration data / Project specific calibration data for DFC_ComMETHChksum" VALUE 0x804EE340 Val_Wu8 255.0 OneToOne 0.00 255.0 FORMAT "%5.1" /end CHARACTERISTIC
/begin CHARACTERISTIC DFES_MeterOut.DFC_ComMETHRingCnt_C "project specific calibration data / Project specific calibration data for DFC_ComMETHRingCnt" VALUE 0x804EE341 Val_Wu8 255.0 OneToOne 0.00 255.0 FORMAT "%5.1" /end CHARACTERISTIC
/begin CHARACTERISTIC DFES_MeterOut.DFC_ComMETHTOut_C "project specific calibration data / Project specific calibration data for DFC_ComMETHTOut" VALUE 0x804EE342 Val_Wu8 255.0 OneToOne 0.00 255.0 FORMAT "%5.1" /end CHARACTERISTIC
/begin CHARACTERISTIC DFES_MeterOut.DFC_ComMETIChksum_C "project specific calibration data / Project specific calibration data for DFC_ComMETIChksum" VALUE 0x804EE343 Val_Wu8 255.0 OneToOne 0.00 255.0 FORMAT "%5.1" /end CHARACTERISTIC
/begin CHARACTERISTIC DFES_MeterOut.DFC_ComMETIRingCnt_C "project specific calibration data / Project specific calibration data for DFC_ComMETIRingCnt" VALUE 0x804EE344 Val_Wu8 255.0 OneToOne 0.00 255.0 FORMAT "%5.1" /end CHARACTERISTIC
/begin CHARACTERISTIC DFES_MeterOut.DFC_ComMETITOut_C "project specific calibration data / Project specific calibration data for DFC_ComMETITOut" VALUE 0x804EE345 Val_Wu8 255.0 OneToOne 0.00 255.0 FORMAT "%5.1" /end CHARACTERISTIC
/begin CHARACTERISTIC DFES_MeterOut.DFC_ComMETKChksum_C "project specific calibration data / Project specific calibration data for DFC_ComMETKChksum" VALUE 0x804EE346 Val_Wu8 255.0 OneToOne 0.00 255.0 FORMAT "%5.1" /end CHARACTERISTIC
/begin CHARACTERISTIC DFES_MeterOut.DFC_ComMETKRingCnt_C "project specific calibration data / Project specific calibration data for DFC_ComMETKRingCnt" VALUE 0x804EE347 Val_Wu8 255.0 OneToOne 0.00 255.0 FORMAT "%5.1" /end CHARACTERISTIC
/begin CHARACTERISTIC DFES_MeterOut.DFC_ComMETKTOut_C "project specific calibration data / Project specific calibration data for DFC_ComMETKTOut" VALUE 0x804EE348 Val_Wu8 255.0 OneToOne 0.00 255.0 FORMAT "%5.1" /end CHARACTERISTIC
/begin CHARACTERISTIC DFES_MeterOut.DFC_ComMETLChksum_C "project specific calibration data / Project specific calibration data for DFC_ComMETLChksum" VALUE 0x804EE349 Val_Wu8 255.0 OneToOne 0.00 255.0 FORMAT "%5.1" /end CHARACTERISTIC
/begin CHARACTERISTIC DFES_MeterOut.DFC_ComMETLRingCnt_C "project specific calibration data / Project specific calibration data for DFC_ComMETLRingCnt" VALUE 0x804EE34A Val_Wu8 255.0 OneToOne 0.00 255.0 FORMAT "%5.1" /end CHARACTERISTIC
/begin CHARACTERISTIC DFES_MeterOut.DFC_ComMETLTOut_C "project specific calibration data / Project specific calibration data for DFC_ComMETLTOut" VALUE 0x804EE34B Val_Wu8 255.0 OneToOne 0.00 255.0 FORMAT "%5.1" /end CHARACTERISTIC
/begin CHARACTERISTIC DFES_MeterOut.DFC_ComMETMChksum_C "project specific calibration data / Project specific calibration data for DFC_ComMETMChksum" VALUE 0x804EE34C Val_Wu8 255.0 OneToOne 0.00 255.0 FORMAT "%5.1" /end CHARACTERISTIC
/begin CHARACTERISTIC DFES_MeterOut.DFC_ComMETMRingCnt_C "project specific calibration data / Project specific calibration data for DFC_ComMETMRingCnt" VALUE 0x804EE34D Val_Wu8 255.0 OneToOne 0.00 255.0 FORMAT "%5.1" /end CHARACTERISTIC
/begin CHARACTERISTIC DFES_MeterOut.DFC_ComMETMTOut_C "project specific calibration data / Project specific calibration data for DFC_ComMETMTOut" VALUE 0x804EE34E Val_Wu8 255.0 OneToOne 0.00 255.0 FORMAT "%5.1" /end CHARACTERISTIC
/begin CHARACTERISTIC DFES_MeterOut.DFC_ComMETNChksum_C "project specific calibration data / Project specific calibration data for DFC_ComMETNChksum" VALUE 0x804EE34F Val_Wu8 255.0 OneToOne 0.00 255.0 FORMAT "%5.1" /end CHARACTERISTIC
/begin CHARACTERISTIC DFES_MeterOut.DFC_ComMETNRingCnt_C "project specific calibration data / Project specific calibration data for DFC_ComMETNRingCnt" VALUE 0x804EE350 Val_Wu8 255.0 OneToOne 0.00 255.0 FORMAT "%5.1" /end CHARACTERISTIC
/begin CHARACTERISTIC DFES_MeterOut.DFC_ComMETNTOut_C "project specific calibration data / Project specific calibration data for DFC_ComMETNTOut" VALUE 0x804EE351 Val_Wu8 255.0 OneToOne 0.00 255.0 FORMAT "%5.1" /end CHARACTERISTIC
/begin CHARACTERISTIC DFES_MeterOut.DFC_ComMtrCom_C "project specific calibration data / Project specific calibration data for DFC_ComMtrCom" VALUE 0x804EE352 Val_Wu8 255.0 OneToOne 0.00 255.0 FORMAT "%5.1" /end CHARACTERISTIC
/begin CHARACTERISTIC DFES_MeterOut.DFC_ComPCUChkSum_C "project specific calibration data / Project specific calibration data for DFC_ComPCUChkSum" VALUE 0x804EE353 Val_Wu8 255.0 OneToOne 0.00 255.0 FORMAT "%5.1" /end CHARACTERISTIC
/begin CHARACTERISTIC DFES_MeterOut.DFC_ComPCURingCnt_C "project specific calibration data / Project specific calibration data for DFC_ComPCURingCnt" VALUE 0x804EE354 Val_Wu8 255.0 OneToOne 0.00 255.0 FORMAT "%5.1" /end CHARACTERISTIC
/begin CHARACTERISTIC DFES_MeterOut.DFC_ComPCUTOut_C "project specific calibration data / Project specific calibration data for DFC_ComPCUTOut" VALUE 0x804EE355 Val_Wu8 255.0 OneToOne 0.00 255.0 FORMAT "%5.1" /end CHARACTERISTIC
/begin CHARACTERISTIC DFES_MeterOut.DFC_ComSRSAChksum_C "project specific calibration data / Project specific calibration data for DFC_ComSRSAChksum" VALUE 0x804EE356 Val_Wu8 255.0 OneToOne 0.00 255.0 FORMAT "%5.1" /end CHARACTERISTIC
/begin CHARACTERISTIC DFES_MeterOut.DFC_ComSRSARingCnt_C "project specific calibration data / Project specific calibration data for DFC_ComSRSARingCnt" VALUE 0x804EE357 Val_Wu8 255.0 OneToOne 0.00 255.0 FORMAT "%5.1" /end CHARACTERISTIC
/begin CHARACTERISTIC DFES_MeterOut.DFC_ComSRSATOut_C "project specific calibration data / Project specific calibration data for DFC_ComSRSATOut" VALUE 0x804EE358 Val_Wu8 255.0 OneToOne 0.00 255.0 FORMAT "%5.1" /end CHARACTERISTIC
/begin CHARACTERISTIC DFES_MeterOut.DFC_ComSRSBChksum_C "project specific calibration data / Project specific calibration data for DFC_ComSRSBChksum" VALUE 0x804EE359 Val_Wu8 255.0 OneToOne 0.00 255.0 FORMAT "%5.1" /end CHARACTERISTIC
/begin CHARACTERISTIC DFES_MeterOut.DFC_ComSRSBRingCnt_C "project specific calibration data / Project specific calibration data for DFC_ComSRSBRingCnt" VALUE 0x804EE35A Val_Wu8 255.0 OneToOne 0.00 255.0 FORMAT "%5.1" /end CHARACTERISTIC
/begin CHARACTERISTIC DFES_MeterOut.DFC_ComSRSBTOut_C "project specific calibration data / Project specific calibration data for DFC_ComSRSBTOut" VALUE 0x804EE35B Val_Wu8 255.0 OneToOne 0.00 255.0 FORMAT "%5.1" /end CHARACTERISTIC
/begin CHARACTERISTIC DFES_MeterOut.DFC_ComSRSChksum_C "project specific calibration data / Project specific calibration data for DFC_ComSRSChksum" VALUE 0x804EE35C Val_Wu8 255.0 OneToOne 0.00 255.0 FORMAT "%5.1" /end CHARACTERISTIC
/begin CHARACTERISTIC DFES_MeterOut.DFC_ComSRSErr_C "project specific calibration data / Project specific calibration data for DFC_ComSRSErr" VALUE 0x804EE35D Val_Wu8 255.0 OneToOne 0.00 255.0 FORMAT "%5.1" /end CHARACTERISTIC
/begin CHARACTERISTIC DFES_MeterOut.DFC_ComSRSRingCnt_C "project specific calibration data / Project specific calibration data for DFC_ComSRSRingCnt" VALUE 0x804EE35E Val_Wu8 255.0 OneToOne 0.00 255.0 FORMAT "%5.1" /end CHARACTERISTIC
/begin CHARACTERISTIC DFES_MeterOut.DFC_ComSRSTOut_C "project specific calibration data / Project specific calibration data for DFC_ComSRSTOut" VALUE 0x804EE35F Val_Wu8 255.0 OneToOne 0.00 255.0 FORMAT "%5.1" /end CHARACTERISTIC
/begin CHARACTERISTIC DFES_MeterOut.DFC_ComVehSpdPndFltTCU_C "project specific calibration data / Project specific calibration data for DFC_ComVehSpdPndFltTCU" VALUE 0x804EE360 Val_Wu8 255.0 OneToOne 0.00 255.0 FORMAT "%5.1" /end CHARACTERISTIC
/begin CHARACTERISTIC DFES_MeterOut.DFC_EbsChartcCurrErr_C "project specific calibration data / Project specific calibration data for DFC_EbsChartcCurrErr" VALUE 0x804EE361 Val_Wu8 255.0 OneToOne 0.00 255.0 FORMAT "%5.1" /end CHARACTERISTIC
/begin CHARACTERISTIC DFES_MeterOut.DFC_EbsSelfDiagErr_C "project specific calibration data / Project specific calibration data for DFC_EbsSelfDiagErr" VALUE 0x804EE362 Val_Wu8 255.0 OneToOne 0.00 255.0 FORMAT "%5.1" /end CHARACTERISTIC
/begin CHARACTERISTIC DFES_MeterOut.DFC_GbxCANDigPlausErr_C "project specific calibration data / Project specific calibration data for DFC_GbxCANDigPlausErr" VALUE 0x804EE363 Val_Wu8 255.0 OneToOne 0.00 255.0 FORMAT "%5.1" /end CHARACTERISTIC
/begin CHARACTERISTIC DFES_MeterOut.DFC_GbxNPos1SRCMax_C "project specific calibration data / Project specific calibration data for DFC_GbxNPos1SRCMax" VALUE 0x804EE364 Val_Wu8 255.0 OneToOne 0.00 255.0 FORMAT "%5.1" /end CHARACTERISTIC
/begin CHARACTERISTIC DFES_MeterOut.DFC_GbxNPos1SRCMin_C "project specific calibration data / Project specific calibration data for DFC_GbxNPos1SRCMin" VALUE 0x804EE365 Val_Wu8 255.0 OneToOne 0.00 255.0 FORMAT "%5.1" /end CHARACTERISTIC
/begin CHARACTERISTIC DFES_MeterOut.DFC_GbxNPos2SRCMax_C "project specific calibration data / Project specific calibration data for DFC_GbxNPos2SRCMax" VALUE 0x804EE366 Val_Wu8 255.0 OneToOne 0.00 255.0 FORMAT "%5.1" /end CHARACTERISTIC
/begin CHARACTERISTIC DFES_MeterOut.DFC_GbxNPos2SRCMin_C "project specific calibration data / Project specific calibration data for DFC_GbxNPos2SRCMin" VALUE 0x804EE367 Val_Wu8 255.0 OneToOne 0.00 255.0 FORMAT "%5.1" /end CHARACTERISTIC
/begin CHARACTERISTIC DFES_MeterOut.DFC_GbxNPosAlvChk_C "project specific calibration data / Project specific calibration data for DFC_GbxNPosAlvChk" VALUE 0x804EE368 Val_Wu8 255.0 OneToOne 0.00 255.0 FORMAT "%5.1" /end CHARACTERISTIC
/begin CHARACTERISTIC DFES_MeterOut.DFC_GbxNPosSyncErr_C "project specific calibration data / Project specific calibration data for DFC_GbxNPosSyncErr" VALUE 0x804EE369 Val_Wu8 255.0 OneToOne 0.00 255.0 FORMAT "%5.1" /end CHARACTERISTIC
/begin CHARACTERISTIC DFES_MeterOut.DFC_HEGOS2B1HtrPsMax_C "project specific calibration data / Project specific calibration data for DFC_HEGOS2B1HtrPsMax" VALUE 0x804EE36A Val_Wu8 255.0 OneToOne 0.00 255.0 FORMAT "%5.1" /end CHARACTERISTIC
/begin CHARACTERISTIC DFES_MeterOut.DFC_HEGOS2B1HtrPsMin_C "project specific calibration data / Project specific calibration data for DFC_HEGOS2B1HtrPsMin" VALUE 0x804EE36B Val_Wu8 255.0 OneToOne 0.00 255.0 FORMAT "%5.1" /end CHARACTERISTIC
/begin CHARACTERISTIC DFES_MeterOut.DFC_HEGOS2B1HtrPsSig_C "project specific calibration data / Project specific calibration data for DFC_HEGOS2B1HtrPsSig" VALUE 0x804EE36C Val_Wu8 255.0 OneToOne 0.00 255.0 FORMAT "%5.1" /end CHARACTERISTIC
/begin CHARACTERISTIC DFES_MeterOut.DFC_LinCSErrACG_C "project specific calibration data / Project specific calibration data for DFC_LinCSErrACG" VALUE 0x804EE36D Val_Wu8 255.0 OneToOne 0.00 255.0 FORMAT "%5.1" /end CHARACTERISTIC
/begin CHARACTERISTIC DFES_MeterOut.DFC_LinCSErrEBS_C "project specific calibration data / Project specific calibration data for DFC_LinCSErrEBS" VALUE 0x804EE36E Val_Wu8 255.0 OneToOne 0.00 255.0 FORMAT "%5.1" /end CHARACTERISTIC
/begin CHARACTERISTIC DFES_MeterOut.DFC_LinHdrTimeoutErrACG_C "project specific calibration data / Project specific calibration data for DFC_LinHdrTimeoutErrACG" VALUE 0x804EE36F Val_Wu8 255.0 OneToOne 0.00 255.0 FORMAT "%5.1" /end CHARACTERISTIC
/begin CHARACTERISTIC DFES_MeterOut.DFC_LinHdrTimeoutErrEBS_C "project specific calibration data / Project specific calibration data for DFC_LinHdrTimeoutErrEBS" VALUE 0x804EE370 Val_Wu8 255.0 OneToOne 0.00 255.0 FORMAT "%5.1" /end CHARACTERISTIC
/begin CHARACTERISTIC DFES_MeterOut.DFC_LinMsgTimeoutErrACG_C "project specific calibration data / Project specific calibration data for DFC_LinMsgTimeoutErrACG" VALUE 0x804EE371 Val_Wu8 255.0 OneToOne 0.00 255.0 FORMAT "%5.1" /end CHARACTERISTIC
/begin CHARACTERISTIC DFES_MeterOut.DFC_LinMsgTimeoutErrEBS_C "project specific calibration data / Project specific calibration data for DFC_LinMsgTimeoutErrEBS" VALUE 0x804EE372 Val_Wu8 255.0 OneToOne 0.00 255.0 FORMAT "%5.1" /end CHARACTERISTIC
/begin CHARACTERISTIC DFES_MeterOut.DFC_LinNoStrtComErr_C "project specific calibration data / Project specific calibration data for DFC_LinNoStrtComErr" VALUE 0x804EE373 Val_Wu8 255.0 OneToOne 0.00 255.0 FORMAT "%5.1" /end CHARACTERISTIC
/begin CHARACTERISTIC DFES_MeterOut.DFC_MisfDetVWhlFrntLeOORHi_C "project specific calibration data / Project specific calibration data for DFC_MisfDetVWhlFrntLeOORHi" VALUE 0x804EE374 Val_Wu8 255.0 OneToOne 0.00 255.0 FORMAT "%5.1" /end CHARACTERISTIC
/begin CHARACTERISTIC DFES_MeterOut.DFC_MisfDetVWhlFrntLeRatyHi_C "project specific calibration data / Project specific calibration data for DFC_MisfDetVWhlFrntLeRatyHi" VALUE 0x804EE375 Val_Wu8 255.0 OneToOne 0.00 255.0 FORMAT "%5.1" /end CHARACTERISTIC
/begin CHARACTERISTIC DFES_MeterOut.DFC_MisfDetVWhlFrntLeRatyLo_C "project specific calibration data / Project specific calibration data for DFC_MisfDetVWhlFrntLeRatyLo" VALUE 0x804EE376 Val_Wu8 255.0 OneToOne 0.00 255.0 FORMAT "%5.1" /end CHARACTERISTIC
/begin CHARACTERISTIC DFES_MeterOut.DFC_MisfDetVWhlFrntLeStuck_C "project specific calibration data / Project specific calibration data for DFC_MisfDetVWhlFrntLeStuck" VALUE 0x804EE377 Val_Wu8 255.0 OneToOne 0.00 255.0 FORMAT "%5.1" /end CHARACTERISTIC
/begin CHARACTERISTIC DFES_MeterOut.DFC_MisfDetVWhlFrntRiOORHi_C "project specific calibration data / Project specific calibration data for DFC_MisfDetVWhlFrntRiOORHi" VALUE 0x804EE378 Val_Wu8 255.0 OneToOne 0.00 255.0 FORMAT "%5.1" /end CHARACTERISTIC
/begin CHARACTERISTIC DFES_MeterOut.DFC_MisfDetVWhlFrntRiRatyHi_C "project specific calibration data / Project specific calibration data for DFC_MisfDetVWhlFrntRiRatyHi" VALUE 0x804EE379 Val_Wu8 255.0 OneToOne 0.00 255.0 FORMAT "%5.1" /end CHARACTERISTIC
/begin CHARACTERISTIC DFES_MeterOut.DFC_MisfDetVWhlFrntRiRatyLo_C "project specific calibration data / Project specific calibration data for DFC_MisfDetVWhlFrntRiRatyLo" VALUE 0x804EE37A Val_Wu8 255.0 OneToOne 0.00 255.0 FORMAT "%5.1" /end CHARACTERISTIC
/begin CHARACTERISTIC DFES_MeterOut.DFC_MisfDetVWhlFrntRiStuck_C "project specific calibration data / Project specific calibration data for DFC_MisfDetVWhlFrntRiStuck" VALUE 0x804EE37B Val_Wu8 255.0 OneToOne 0.00 255.0 FORMAT "%5.1" /end CHARACTERISTIC
/begin CHARACTERISTIC DFES_MeterOut.DFC_MisfDetVWhlReLeOORHi_C "project specific calibration data / Project specific calibration data for DFC_MisfDetVWhlReLeOORHi" VALUE 0x804EE37C Val_Wu8 255.0 OneToOne 0.00 255.0 FORMAT "%5.1" /end CHARACTERISTIC
/begin CHARACTERISTIC DFES_MeterOut.DFC_MisfDetVWhlReLeRatyHi_C "project specific calibration data / Project specific calibration data for DFC_MisfDetVWhlReLeRatyHi" VALUE 0x804EE37D Val_Wu8 255.0 OneToOne 0.00 255.0 FORMAT "%5.1" /end CHARACTERISTIC
/begin CHARACTERISTIC DFES_MeterOut.DFC_MisfDetVWhlReLeRatyLo_C "project specific calibration data / Project specific calibration data for DFC_MisfDetVWhlReLeRatyLo" VALUE 0x804EE37E Val_Wu8 255.0 OneToOne 0.00 255.0 FORMAT "%5.1" /end CHARACTERISTIC
/begin CHARACTERISTIC DFES_MeterOut.DFC_MisfDetVWhlReLeStuck_C "project specific calibration data / Project specific calibration data for DFC_MisfDetVWhlReLeStuck" VALUE 0x804EE37F Val_Wu8 255.0 OneToOne 0.00 255.0 FORMAT "%5.1" /end CHARACTERISTIC
/begin CHARACTERISTIC DFES_MeterOut.DFC_MisfDetVWhlReRiOORHi_C "project specific calibration data / Project specific calibration data for DFC_MisfDetVWhlReRiOORHi" VALUE 0x804EE380 Val_Wu8 255.0 OneToOne 0.00 255.0 FORMAT "%5.1" /end CHARACTERISTIC
/begin CHARACTERISTIC DFES_MeterOut.DFC_MisfDetVWhlReRiRatyHi_C "project specific calibration data / Project specific calibration data for DFC_MisfDetVWhlReRiRatyHi" VALUE 0x804EE381 Val_Wu8 255.0 OneToOne 0.00 255.0 FORMAT "%5.1" /end CHARACTERISTIC
/begin CHARACTERISTIC DFES_MeterOut.DFC_MisfDetVWhlReRiRatyLo_C "project specific calibration data / Project specific calibration data for DFC_MisfDetVWhlReRiRatyLo" VALUE 0x804EE382 Val_Wu8 255.0 OneToOne 0.00 255.0 FORMAT "%5.1" /end CHARACTERISTIC
/begin CHARACTERISTIC DFES_MeterOut.DFC_MisfDetVWhlReRiStuck_C "project specific calibration data / Project specific calibration data for DFC_MisfDetVWhlReRiStuck" VALUE 0x804EE383 Val_Wu8 255.0 OneToOne 0.00 255.0 FORMAT "%5.1" /end CHARACTERISTIC
/begin CHARACTERISTIC DFES_MeterOut.DFC_MisfDetdVWhlFrntLePlaus_C "project specific calibration data / Project specific calibration data for DFC_MisfDetdVWhlFrntLePlaus" VALUE 0x804EE384 Val_Wu8 255.0 OneToOne 0.00 255.0 FORMAT "%5.1" /end CHARACTERISTIC
/begin CHARACTERISTIC DFES_MeterOut.DFC_MisfDetdVWhlFrntRiPlaus_C "project specific calibration data / Project specific calibration data for DFC_MisfDetdVWhlFrntRiPlaus" VALUE 0x804EE385 Val_Wu8 255.0 OneToOne 0.00 255.0 FORMAT "%5.1" /end CHARACTERISTIC
/begin CHARACTERISTIC DFES_MeterOut.DFC_MisfDetdVWhlReLePlaus_C "project specific calibration data / Project specific calibration data for DFC_MisfDetdVWhlReLePlaus" VALUE 0x804EE386 Val_Wu8 255.0 OneToOne 0.00 255.0 FORMAT "%5.1" /end CHARACTERISTIC
/begin CHARACTERISTIC DFES_MeterOut.DFC_MisfDetdVWhlReRiPlaus_C "project specific calibration data / Project specific calibration data for DFC_MisfDetdVWhlReRiPlaus" VALUE 0x804EE387 Val_Wu8 255.0 OneToOne 0.00 255.0 FORMAT "%5.1" /end CHARACTERISTIC
/begin CHARACTERISTIC DFES_MeterOut.DFC_PEnvSigRngMax_C "project specific calibration data / Project specific calibration data for DFC_PEnvSigRngMax" VALUE 0x804EE388 Val_Wu8 255.0 OneToOne 0.00 255.0 FORMAT "%5.1" /end CHARACTERISTIC
/begin CHARACTERISTIC DFES_MeterOut.DFC_PEnvSigRngMin_C "project specific calibration data / Project specific calibration data for DFC_PEnvSigRngMin" VALUE 0x804EE389 Val_Wu8 255.0 OneToOne 0.00 255.0 FORMAT "%5.1" /end CHARACTERISTIC
/begin CHARACTERISTIC DFES_MeterOut.DFC_StmFault_C "project specific calibration data / Project specific calibration data for DFC_StmFault" VALUE 0x804EE38A Val_Wu8 255.0 OneToOne 0.00 255.0 FORMAT "%5.1" /end CHARACTERISTIC
/begin CHARACTERISTIC DFES_MeterOut.DFC_StrtCtOffPth_C "project specific calibration data / Project specific calibration data for DFC_StrtCtOffPth" VALUE 0x804EE38B Val_Wu8 255.0 OneToOne 0.00 255.0 FORMAT "%5.1" /end CHARACTERISTIC
/begin CHARACTERISTIC DFES_MeterOut.DFC_StrtCtlErr_C "project specific calibration data / Project specific calibration data for DFC_StrtCtlErr" VALUE 0x804EE38C Val_Wu8 255.0 OneToOne 0.00 255.0 FORMAT "%5.1" /end CHARACTERISTIC
/begin CHARACTERISTIC DFES_MeterOut.DFC_StrtFault_C "project specific calibration data / Project specific calibration data for DFC_StrtFault" VALUE 0x804EE38D Val_Wu8 255.0 OneToOne 0.00 255.0 FORMAT "%5.1" /end CHARACTERISTIC
/begin CHARACTERISTIC DFES_MeterOut.DFC_StrtLckJudg1_C "project specific calibration data / Project specific calibration data for DFC_StrtLckJudg1" VALUE 0x804EE38E Val_Wu8 255.0 OneToOne 0.00 255.0 FORMAT "%5.1" /end CHARACTERISTIC
/begin CHARACTERISTIC DFES_MeterOut.DFC_StrtLckJudg2_C "project specific calibration data / Project specific calibration data for DFC_StrtLckJudg2" VALUE 0x804EE38F Val_Wu8 255.0 OneToOne 0.00 255.0 FORMAT "%5.1" /end CHARACTERISTIC
/begin CHARACTERISTIC DFES_MeterOut.DFC_StrtOL_C "project specific calibration data / Project specific calibration data for DFC_StrtOL" VALUE 0x804EE390 Val_Wu8 255.0 OneToOne 0.00 255.0 FORMAT "%5.1" /end CHARACTERISTIC
/begin CHARACTERISTIC DFES_MeterOut.DFC_StrtOL2_C "project specific calibration data / Project specific calibration data for DFC_StrtOL2" VALUE 0x804EE391 Val_Wu8 255.0 OneToOne 0.00 255.0 FORMAT "%5.1" /end CHARACTERISTIC
/begin CHARACTERISTIC DFES_MeterOut.DFC_StrtSCB_C "project specific calibration data / Project specific calibration data for DFC_StrtSCB" VALUE 0x804EE392 Val_Wu8 255.0 OneToOne 0.00 255.0 FORMAT "%5.1" /end CHARACTERISTIC
/begin CHARACTERISTIC DFES_MeterOut.DFC_StrtSCB2_C "project specific calibration data / Project specific calibration data for DFC_StrtSCB2" VALUE 0x804EE393 Val_Wu8 255.0 OneToOne 0.00 255.0 FORMAT "%5.1" /end CHARACTERISTIC
/begin CHARACTERISTIC DFES_MeterOut.DFC_StrtSCG_C "project specific calibration data / Project specific calibration data for DFC_StrtSCG" VALUE 0x804EE394 Val_Wu8 255.0 OneToOne 0.00 255.0 FORMAT "%5.1" /end CHARACTERISTIC
/begin CHARACTERISTIC DFES_MeterOut.DFC_StrtSCG2_C "project specific calibration data / Project specific calibration data for DFC_StrtSCG2" VALUE 0x804EE395 Val_Wu8 255.0 OneToOne 0.00 255.0 FORMAT "%5.1" /end CHARACTERISTIC
/begin CHARACTERISTIC DFES_MeterOut.DFC_StrtStkRly1_C "project specific calibration data / Project specific calibration data for DFC_StrtStkRly1" VALUE 0x804EE396 Val_Wu8 255.0 OneToOne 0.00 255.0 FORMAT "%5.1" /end CHARACTERISTIC
/begin CHARACTERISTIC DFES_MeterOut.DFC_StrtStkRly2_C "project specific calibration data / Project specific calibration data for DFC_StrtStkRly2" VALUE 0x804EE397 Val_Wu8 255.0 OneToOne 0.00 255.0 FORMAT "%5.1" /end CHARACTERISTIC
/begin CHARACTERISTIC DFES_MeterOut.DFC_TEVEmax_C "project specific calibration data / Project specific calibration data for DFC_TEVEmax" VALUE 0x804EE398 Val_Wu8 255.0 OneToOne 0.00 255.0 FORMAT "%5.1" /end CHARACTERISTIC
/begin CHARACTERISTIC DFES_MeterOut.DFC_TEVEmin_C "project specific calibration data / Project specific calibration data for DFC_TEVEmin" VALUE 0x804EE399 Val_Wu8 255.0 OneToOne 0.00 255.0 FORMAT "%5.1" /end CHARACTERISTIC
/begin CHARACTERISTIC DFES_MeterOut.DFC_TEVEsig_C "project specific calibration data / Project specific calibration data for DFC_TEVEsig" VALUE 0x804EE39A Val_Wu8 255.0 OneToOne 0.00 255.0 FORMAT "%5.1" /end CHARACTERISTIC
/begin CHARACTERISTIC DFES_MeterOut.DFC_VehVAllPlaus_C "project specific calibration data / Project specific calibration data for DFC_VehVAllPlaus" VALUE 0x804EE39B Val_Wu8 255.0 OneToOne 0.00 255.0 FORMAT "%5.1" /end CHARACTERISTIC
/begin CHARACTERISTIC DFES_MeterOut.DFC_VehVNCSnsrElecFailr_C "project specific calibration data / Project specific calibration data for DFC_VehVNCSnsrElecFailr" VALUE 0x804EE39C Val_Wu8 255.0 OneToOne 0.00 255.0 FORMAT "%5.1" /end CHARACTERISTIC
/begin CHARACTERISTIC DFES_MeterOut.DFC_VehVPlausCan_C "project specific calibration data / Project specific calibration data for DFC_VehVPlausCan" VALUE 0x804EE39D Val_Wu8 255.0 OneToOne 0.00 255.0 FORMAT "%5.1" /end CHARACTERISTIC
/begin CHARACTERISTIC DFES_MeterOut.DFC_VehVPlausFco_C "project specific calibration data / Project specific calibration data for DFC_VehVPlausFco" VALUE 0x804EE39E Val_Wu8 255.0 OneToOne 0.00 255.0 FORMAT "%5.1" /end CHARACTERISTIC
/begin CHARACTERISTIC DFES_MeterOut.DFC_VehVPlausPwr_C "project specific calibration data / Project specific calibration data for DFC_VehVPlausPwr" VALUE 0x804EE39F Val_Wu8 255.0 OneToOne 0.00 255.0 FORMAT "%5.1" /end CHARACTERISTIC
/begin CHARACTERISTIC DFES_MeterOut.DFC_VehVPlausV2N_C "project specific calibration data / Project specific calibration data for DFC_VehVPlausV2N" VALUE 0x804EE3A0 Val_Wu8 255.0 OneToOne 0.00 255.0 FORMAT "%5.1" /end CHARACTERISTIC
/begin CHARACTERISTIC DFES_MeterOut.DFC_VehVSpdSnsrAElecFailr_C "project specific calibration data / Project specific calibration data for DFC_VehVSpdSnsrAElecFailr" VALUE 0x804EE3A1 Val_Wu8 255.0 OneToOne 0.00 255.0 FORMAT "%5.1" /end CHARACTERISTIC
/begin CHARACTERISTIC DFES_MeterOut.DFC_VehVSpdSnsrBElecFailr_C "project specific calibration data / Project specific calibration data for DFC_VehVSpdSnsrBElecFailr" VALUE 0x804EE3A2 Val_Wu8 255.0 OneToOne 0.00 255.0 FORMAT "%5.1" /end CHARACTERISTIC
/begin CHARACTERISTIC DFES_MeterOut.DFC_ClthMax_C "project specific calibration data / Project specific calibration data for DFC_ClthMax" VALUE 0x804EE3A3 Val_Wu8 255.0 OneToOne 0.00 255.0 FORMAT "%5.1" /end CHARACTERISTIC
/begin CHARACTERISTIC DFES_MeterOut.DFC_IgnClPs_DevComErr_C "project specific calibration data / Project specific calibration data for DFC_IgnClPs_DevComErr" VALUE 0x804EE3A4 Val_Wu8 255.0 OneToOne 0.00 255.0 FORMAT "%5.1" /end CHARACTERISTIC
/begin CHARACTERISTIC DFES_MeterOut.DFC_IgnClPs_LineOl_0_C "project specific calibration data / Project specific calibration data for DFC_IgnClPs_LineOl_0" VALUE 0x804EE3A5 Val_Wu8 255.0 OneToOne 0.00 255.0 FORMAT "%5.1" /end CHARACTERISTIC
/begin CHARACTERISTIC DFES_MeterOut.DFC_IgnClPs_LineOl_1_C "project specific calibration data / Project specific calibration data for DFC_IgnClPs_LineOl_1" VALUE 0x804EE3A6 Val_Wu8 255.0 OneToOne 0.00 255.0 FORMAT "%5.1" /end CHARACTERISTIC
/begin CHARACTERISTIC DFES_MeterOut.DFC_IgnClPs_LineOl_2_C "project specific calibration data / Project specific calibration data for DFC_IgnClPs_LineOl_2" VALUE 0x804EE3A7 Val_Wu8 255.0 OneToOne 0.00 255.0 FORMAT "%5.1" /end CHARACTERISTIC
/begin CHARACTERISTIC DFES_MeterOut.DFC_IgnClPs_LineOl_3_C "project specific calibration data / Project specific calibration data for DFC_IgnClPs_LineOl_3" VALUE 0x804EE3A8 Val_Wu8 255.0 OneToOne 0.00 255.0 FORMAT "%5.1" /end CHARACTERISTIC
/begin CHARACTERISTIC DFES_MeterOut.DFC_IgnClPs_LineScb_0_C "project specific calibration data / Project specific calibration data for DFC_IgnClPs_LineScb_0" VALUE 0x804EE3A9 Val_Wu8 255.0 OneToOne 0.00 255.0 FORMAT "%5.1" /end CHARACTERISTIC
/begin CHARACTERISTIC DFES_MeterOut.DFC_IgnClPs_LineScb_1_C "project specific calibration data / Project specific calibration data for DFC_IgnClPs_LineScb_1" VALUE 0x804EE3AA Val_Wu8 255.0 OneToOne 0.00 255.0 FORMAT "%5.1" /end CHARACTERISTIC
/begin CHARACTERISTIC DFES_MeterOut.DFC_IgnClPs_LineScb_2_C "project specific calibration data / Project specific calibration data for DFC_IgnClPs_LineScb_2" VALUE 0x804EE3AB Val_Wu8 255.0 OneToOne 0.00 255.0 FORMAT "%5.1" /end CHARACTERISTIC
/begin CHARACTERISTIC DFES_MeterOut.DFC_IgnClPs_LineScb_3_C "project specific calibration data / Project specific calibration data for DFC_IgnClPs_LineScb_3" VALUE 0x804EE3AC Val_Wu8 255.0 OneToOne 0.00 255.0 FORMAT "%5.1" /end CHARACTERISTIC
/begin CHARACTERISTIC DFES_MeterOut.DFC_IgnClPs_LineScg_0_C "project specific calibration data / Project specific calibration data for DFC_IgnClPs_LineScg_0" VALUE 0x804EE3AD Val_Wu8 255.0 OneToOne 0.00 255.0 FORMAT "%5.1" /end CHARACTERISTIC
/begin CHARACTERISTIC DFES_MeterOut.DFC_IgnClPs_LineScg_1_C "project specific calibration data / Project specific calibration data for DFC_IgnClPs_LineScg_1" VALUE 0x804EE3AE Val_Wu8 255.0 OneToOne 0.00 255.0 FORMAT "%5.1" /end CHARACTERISTIC
/begin CHARACTERISTIC DFES_MeterOut.DFC_IgnClPs_LineScg_2_C "project specific calibration data / Project specific calibration data for DFC_IgnClPs_LineScg_2" VALUE 0x804EE3AF Val_Wu8 255.0 OneToOne 0.00 255.0 FORMAT "%5.1" /end CHARACTERISTIC
/begin CHARACTERISTIC DFES_MeterOut.DFC_IgnClPs_LineScg_3_C "project specific calibration data / Project specific calibration data for DFC_IgnClPs_LineScg_3" VALUE 0x804EE3B0 Val_Wu8 255.0 OneToOne 0.00 255.0 FORMAT "%5.1" /end CHARACTERISTIC
/begin CHARACTERISTIC DFES_MeterOut.DFC_UEGOASICS1B1_C "project specific calibration data / Project specific calibration data for DFC_UEGOASICS1B1" VALUE 0x804EE3B1 Val_Wu8 255.0 OneToOne 0.00 255.0 FORMAT "%5.1" /end CHARACTERISTIC
/begin CHARACTERISTIC DFES_MeterOut.DFC_UEGOOLIPES1B1_C "project specific calibration data / Project specific calibration data for DFC_UEGOOLIPES1B1" VALUE 0x804EE3B2 Val_Wu8 255.0 OneToOne 0.00 255.0 FORMAT "%5.1" /end CHARACTERISTIC
/begin CHARACTERISTIC DFES_MeterOut.DFC_UEGOOLRES1B1_C "project specific calibration data / Project specific calibration data for DFC_UEGOOLRES1B1" VALUE 0x804EE3B3 Val_Wu8 255.0 OneToOne 0.00 255.0 FORMAT "%5.1" /end CHARACTERISTIC
/begin CHARACTERISTIC DFES_MeterOut.DFC_UEGOSCBS1B1_C "project specific calibration data / Project specific calibration data for DFC_UEGOSCBS1B1" VALUE 0x804EE3B4 Val_Wu8 255.0 OneToOne 0.00 255.0 FORMAT "%5.1" /end CHARACTERISTIC
/begin CHARACTERISTIC DFES_MeterOut.DFC_UEGOSCGS1B1_C "project specific calibration data / Project specific calibration data for DFC_UEGOSCGS1B1" VALUE 0x804EE3B5 Val_Wu8 255.0 OneToOne 0.00 255.0 FORMAT "%5.1" /end CHARACTERISTIC
/begin CHARACTERISTIC DFES_MeterOut.DFC_UEGOSPIS1B1_C "project specific calibration data / Project specific calibration data for DFC_UEGOSPIS1B1" VALUE 0x804EE3B6 Val_Wu8 255.0 OneToOne 0.00 255.0 FORMAT "%5.1" /end CHARACTERISTIC
/begin CHARACTERISTIC DFES_MeterOut.DFC_UEGOSnsrS1B1_C "project specific calibration data / Project specific calibration data for DFC_UEGOSnsrS1B1" VALUE 0x804EE3B7 Val_Wu8 255.0 OneToOne 0.00 255.0 FORMAT "%5.1" /end CHARACTERISTIC
/begin CHARACTERISTIC DFES_MeterOut.DFC_UegoOlApesS1B1_C "project specific calibration data / Project specific calibration data for DFC_UegoOlApesS1B1" VALUE 0x804EE3B8 Val_Wu8 255.0 OneToOne 0.00 255.0 FORMAT "%5.1" /end CHARACTERISTIC
/begin CHARACTERISTIC DFES_MeterOut.DFC_UegoOlRCmpS1B1_C "project specific calibration data / Project specific calibration data for DFC_UegoOlRCmpS1B1" VALUE 0x804EE3B9 Val_Wu8 255.0 OneToOne 0.00 255.0 FORMAT "%5.1" /end CHARACTERISTIC
/begin CHARACTERISTIC DFES_MeterOut.DFC_AirCCmprOL_C "project specific calibration data / Project specific calibration data for DFC_AirCCmprOL" VALUE 0x804EE3BA Val_Wu8 255.0 OneToOne 0.00 255.0 FORMAT "%5.1" /end CHARACTERISTIC
/begin CHARACTERISTIC DFES_MeterOut.DFC_AirCCmprOvrTemp_C "project specific calibration data / Project specific calibration data for DFC_AirCCmprOvrTemp" VALUE 0x804EE3BB Val_Wu8 255.0 OneToOne 0.00 255.0 FORMAT "%5.1" /end CHARACTERISTIC
/begin CHARACTERISTIC DFES_MeterOut.DFC_AirCCmprSCB_C "project specific calibration data / Project specific calibration data for DFC_AirCCmprSCB" VALUE 0x804EE3BC Val_Wu8 255.0 OneToOne 0.00 255.0 FORMAT "%5.1" /end CHARACTERISTIC
/begin CHARACTERISTIC DFES_MeterOut.DFC_AirCCmprSCG_C "project specific calibration data / Project specific calibration data for DFC_AirCCmprSCG" VALUE 0x804EE3BD Val_Wu8 255.0 OneToOne 0.00 255.0 FORMAT "%5.1" /end CHARACTERISTIC
/begin CHARACTERISTIC DFES_MeterOut.DFC_AltErr_C "project specific calibration data / Project specific calibration data for DFC_AltErr" VALUE 0x804EE3BE Val_Wu8 255.0 OneToOne 0.00 255.0 FORMAT "%5.1" /end CHARACTERISTIC
/begin CHARACTERISTIC DFES_MeterOut.DFC_BattUSRCMax_C "project specific calibration data / Project specific calibration data for DFC_BattUSRCMax" VALUE 0x804EE3BF Val_Wu8 255.0 OneToOne 0.00 255.0 FORMAT "%5.1" /end CHARACTERISTIC
/begin CHARACTERISTIC DFES_MeterOut.DFC_BattUSRCMin_C "project specific calibration data / Project specific calibration data for DFC_BattUSRCMin" VALUE 0x804EE3C0 Val_Wu8 255.0 OneToOne 0.00 255.0 FORMAT "%5.1" /end CHARACTERISTIC
/begin CHARACTERISTIC DFES_MeterOut.DFC_ComChksTCU1_C "project specific calibration data / Project specific calibration data for DFC_ComChksTCU1" VALUE 0x804EE3C1 Val_Wu8 255.0 OneToOne 0.00 255.0 FORMAT "%5.1" /end CHARACTERISTIC
/begin CHARACTERISTIC DFES_MeterOut.DFC_ComChksTCU11_C "project specific calibration data / Project specific calibration data for DFC_ComChksTCU11" VALUE 0x804EE3C2 Val_Wu8 255.0 OneToOne 0.00 255.0 FORMAT "%5.1" /end CHARACTERISTIC
/begin CHARACTERISTIC DFES_MeterOut.DFC_ComChksTCU12_C "project specific calibration data / Project specific calibration data for DFC_ComChksTCU12" VALUE 0x804EE3C3 Val_Wu8 255.0 OneToOne 0.00 255.0 FORMAT "%5.1" /end CHARACTERISTIC
/begin CHARACTERISTIC DFES_MeterOut.DFC_ComChksTCU13_C "project specific calibration data / Project specific calibration data for DFC_ComChksTCU13" VALUE 0x804EE3C4 Val_Wu8 255.0 OneToOne 0.00 255.0 FORMAT "%5.1" /end CHARACTERISTIC
/begin CHARACTERISTIC DFES_MeterOut.DFC_ComChksTCU2_C "project specific calibration data / Project specific calibration data for DFC_ComChksTCU2" VALUE 0x804EE3C5 Val_Wu8 255.0 OneToOne 0.00 255.0 FORMAT "%5.1" /end CHARACTERISTIC
/begin CHARACTERISTIC DFES_MeterOut.DFC_ComChksTCU3_C "project specific calibration data / Project specific calibration data for DFC_ComChksTCU3" VALUE 0x804EE3C6 Val_Wu8 255.0 OneToOne 0.00 255.0 FORMAT "%5.1" /end CHARACTERISTIC
/begin CHARACTERISTIC DFES_MeterOut.DFC_ComChksTCU4_C "project specific calibration data / Project specific calibration data for DFC_ComChksTCU4" VALUE 0x804EE3C7 Val_Wu8 255.0 OneToOne 0.00 255.0 FORMAT "%5.1" /end CHARACTERISTIC
/begin CHARACTERISTIC DFES_MeterOut.DFC_ComCntTCU1_C "project specific calibration data / Project specific calibration data for DFC_ComCntTCU1" VALUE 0x804EE3C8 Val_Wu8 255.0 OneToOne 0.00 255.0 FORMAT "%5.1" /end CHARACTERISTIC
/begin CHARACTERISTIC DFES_MeterOut.DFC_ComCntTCU11_C "project specific calibration data / Project specific calibration data for DFC_ComCntTCU11" VALUE 0x804EE3C9 Val_Wu8 255.0 OneToOne 0.00 255.0 FORMAT "%5.1" /end CHARACTERISTIC
/begin CHARACTERISTIC DFES_MeterOut.DFC_ComCntTCU12_C "project specific calibration data / Project specific calibration data for DFC_ComCntTCU12" VALUE 0x804EE3CA Val_Wu8 255.0 OneToOne 0.00 255.0 FORMAT "%5.1" /end CHARACTERISTIC
/begin CHARACTERISTIC DFES_MeterOut.DFC_ComCntTCU13_C "project specific calibration data / Project specific calibration data for DFC_ComCntTCU13" VALUE 0x804EE3CB Val_Wu8 255.0 OneToOne 0.00 255.0 FORMAT "%5.1" /end CHARACTERISTIC
/begin CHARACTERISTIC DFES_MeterOut.DFC_ComCntTCU2_C "project specific calibration data / Project specific calibration data for DFC_ComCntTCU2" VALUE 0x804EE3CC Val_Wu8 255.0 OneToOne 0.00 255.0 FORMAT "%5.1" /end CHARACTERISTIC
/begin CHARACTERISTIC DFES_MeterOut.DFC_ComCntTCU3_C "project specific calibration data / Project specific calibration data for DFC_ComCntTCU3" VALUE 0x804EE3CD Val_Wu8 255.0 OneToOne 0.00 255.0 FORMAT "%5.1" /end CHARACTERISTIC
/begin CHARACTERISTIC DFES_MeterOut.DFC_ComCntTCU4_C "project specific calibration data / Project specific calibration data for DFC_ComCntTCU4" VALUE 0x804EE3CE Val_Wu8 255.0 OneToOne 0.00 255.0 FORMAT "%5.1" /end CHARACTERISTIC
/begin CHARACTERISTIC DFES_MeterOut.DFC_ComTOutTCU01_C "project specific calibration data / Project specific calibration data for DFC_ComTOutTCU01" VALUE 0x804EE3CF Val_Wu8 255.0 OneToOne 0.00 255.0 FORMAT "%5.1" /end CHARACTERISTIC
/begin CHARACTERISTIC DFES_MeterOut.DFC_ComTOutTCU02_C "project specific calibration data / Project specific calibration data for DFC_ComTOutTCU02" VALUE 0x804EE3D0 Val_Wu8 255.0 OneToOne 0.00 255.0 FORMAT "%5.1" /end CHARACTERISTIC
/begin CHARACTERISTIC DFES_MeterOut.DFC_ComTOutTCU1_C "project specific calibration data / Project specific calibration data for DFC_ComTOutTCU1" VALUE 0x804EE3D1 Val_Wu8 255.0 OneToOne 0.00 255.0 FORMAT "%5.1" /end CHARACTERISTIC
/begin CHARACTERISTIC DFES_MeterOut.DFC_ComTOutTCU11_C "project specific calibration data / Project specific calibration data for DFC_ComTOutTCU11" VALUE 0x804EE3D2 Val_Wu8 255.0 OneToOne 0.00 255.0 FORMAT "%5.1" /end CHARACTERISTIC
/begin CHARACTERISTIC DFES_MeterOut.DFC_ComTOutTCU12_C "project specific calibration data / Project specific calibration data for DFC_ComTOutTCU12" VALUE 0x804EE3D3 Val_Wu8 255.0 OneToOne 0.00 255.0 FORMAT "%5.1" /end CHARACTERISTIC
/begin CHARACTERISTIC DFES_MeterOut.DFC_ComTOutTCU13_C "project specific calibration data / Project specific calibration data for DFC_ComTOutTCU13" VALUE 0x804EE3D4 Val_Wu8 255.0 OneToOne 0.00 255.0 FORMAT "%5.1" /end CHARACTERISTIC
/begin CHARACTERISTIC DFES_MeterOut.DFC_ComTOutTCU14_C "project specific calibration data / Project specific calibration data for DFC_ComTOutTCU14" VALUE 0x804EE3D5 Val_Wu8 255.0 OneToOne 0.00 255.0 FORMAT "%5.1" /end CHARACTERISTIC
/begin CHARACTERISTIC DFES_MeterOut.DFC_ComTOutTCU2_C "project specific calibration data / Project specific calibration data for DFC_ComTOutTCU2" VALUE 0x804EE3D6 Val_Wu8 255.0 OneToOne 0.00 255.0 FORMAT "%5.1" /end CHARACTERISTIC
/begin CHARACTERISTIC DFES_MeterOut.DFC_ComTOutTCU3_C "project specific calibration data / Project specific calibration data for DFC_ComTOutTCU3" VALUE 0x804EE3D7 Val_Wu8 255.0 OneToOne 0.00 255.0 FORMAT "%5.1" /end CHARACTERISTIC
/begin CHARACTERISTIC DFES_MeterOut.DFC_ComTOutTCU4_C "project specific calibration data / Project specific calibration data for DFC_ComTOutTCU4" VALUE 0x804EE3D8 Val_Wu8 255.0 OneToOne 0.00 255.0 FORMAT "%5.1" /end CHARACTERISTIC
/begin CHARACTERISTIC DFES_MeterOut.DFC_DevLibBattUHi_C "project specific calibration data / Project specific calibration data for DFC_DevLibBattUHi" VALUE 0x804EE3D9 Val_Wu8 255.0 OneToOne 0.00 255.0 FORMAT "%5.1" /end CHARACTERISTIC
/begin CHARACTERISTIC DFES_MeterOut.DFC_DevLibBattULo_C "project specific calibration data / Project specific calibration data for DFC_DevLibBattULo" VALUE 0x804EE3DA Val_Wu8 255.0 OneToOne 0.00 255.0 FORMAT "%5.1" /end CHARACTERISTIC
/begin CHARACTERISTIC DFES_MeterOut.DFC_FanDIOOL_0_C "project specific calibration data / Project specific calibration data for DFC_FanDIOOL_0" VALUE 0x804EE3DB Val_Wu8 255.0 OneToOne 0.00 255.0 FORMAT "%5.1" /end CHARACTERISTIC
/begin CHARACTERISTIC DFES_MeterOut.DFC_FanDIOOL_1_C "project specific calibration data / Project specific calibration data for DFC_FanDIOOL_1" VALUE 0x804EE3DC Val_Wu8 255.0 OneToOne 0.00 255.0 FORMAT "%5.1" /end CHARACTERISTIC
/begin CHARACTERISTIC DFES_MeterOut.DFC_FanDIOOvrTemp_0_C "project specific calibration data / Project specific calibration data for DFC_FanDIOOvrTemp_0" VALUE 0x804EE3DD Val_Wu8 255.0 OneToOne 0.00 255.0 FORMAT "%5.1" /end CHARACTERISTIC
/begin CHARACTERISTIC DFES_MeterOut.DFC_FanDIOOvrTemp_1_C "project specific calibration data / Project specific calibration data for DFC_FanDIOOvrTemp_1" VALUE 0x804EE3DE Val_Wu8 255.0 OneToOne 0.00 255.0 FORMAT "%5.1" /end CHARACTERISTIC
/begin CHARACTERISTIC DFES_MeterOut.DFC_FanDIOSCB_0_C "project specific calibration data / Project specific calibration data for DFC_FanDIOSCB_0" VALUE 0x804EE3DF Val_Wu8 255.0 OneToOne 0.00 255.0 FORMAT "%5.1" /end CHARACTERISTIC
/begin CHARACTERISTIC DFES_MeterOut.DFC_FanDIOSCB_1_C "project specific calibration data / Project specific calibration data for DFC_FanDIOSCB_1" VALUE 0x804EE3E0 Val_Wu8 255.0 OneToOne 0.00 255.0 FORMAT "%5.1" /end CHARACTERISTIC
/begin CHARACTERISTIC DFES_MeterOut.DFC_FanDIOSCG_0_C "project specific calibration data / Project specific calibration data for DFC_FanDIOSCG_0" VALUE 0x804EE3E1 Val_Wu8 255.0 OneToOne 0.00 255.0 FORMAT "%5.1" /end CHARACTERISTIC
/begin CHARACTERISTIC DFES_MeterOut.DFC_FanDIOSCG_1_C "project specific calibration data / Project specific calibration data for DFC_FanDIOSCG_1" VALUE 0x804EE3E2 Val_Wu8 255.0 OneToOne 0.00 255.0 FORMAT "%5.1" /end CHARACTERISTIC
/begin CHARACTERISTIC DFES_MeterOut.DFC_MRlyDcOL_C "project specific calibration data / Project specific calibration data for DFC_MRlyDcOL" VALUE 0x804EE3E3 Val_Wu8 255.0 OneToOne 0.00 255.0 FORMAT "%5.1" /end CHARACTERISTIC
/begin CHARACTERISTIC DFES_MeterOut.DFC_MRlyDcSCB_C "project specific calibration data / Project specific calibration data for DFC_MRlyDcSCB" VALUE 0x804EE3E4 Val_Wu8 255.0 OneToOne 0.00 255.0 FORMAT "%5.1" /end CHARACTERISTIC
/begin CHARACTERISTIC DFES_MeterOut.DFC_MRlyDcSCG_C "project specific calibration data / Project specific calibration data for DFC_MRlyDcSCG" VALUE 0x804EE3E5 Val_Wu8 255.0 OneToOne 0.00 255.0 FORMAT "%5.1" /end CHARACTERISTIC
/begin CHARACTERISTIC DFES_MeterOut.DFC_PSPOL_C "project specific calibration data / Project specific calibration data for DFC_PSPOL" VALUE 0x804EE3E6 Val_Wu8 255.0 OneToOne 0.00 255.0 FORMAT "%5.1" /end CHARACTERISTIC
/begin CHARACTERISTIC DFES_MeterOut.DFC_PSPOvrTemp_C "project specific calibration data / Project specific calibration data for DFC_PSPOvrTemp" VALUE 0x804EE3E7 Val_Wu8 255.0 OneToOne 0.00 255.0 FORMAT "%5.1" /end CHARACTERISTIC
/begin CHARACTERISTIC DFES_MeterOut.DFC_PSPSCB_C "project specific calibration data / Project specific calibration data for DFC_PSPSCB" VALUE 0x804EE3E8 Val_Wu8 255.0 OneToOne 0.00 255.0 FORMAT "%5.1" /end CHARACTERISTIC
/begin CHARACTERISTIC DFES_MeterOut.DFC_PSPSCG_C "project specific calibration data / Project specific calibration data for DFC_PSPSCG" VALUE 0x804EE3E9 Val_Wu8 255.0 OneToOne 0.00 255.0 FORMAT "%5.1" /end CHARACTERISTIC
/begin CHARACTERISTIC DFES_MeterOut.DFC_T50Err_C "project specific calibration data / Project specific calibration data for DFC_T50Err" VALUE 0x804EE3EA Val_Wu8 255.0 OneToOne 0.00 255.0 FORMAT "%5.1" /end CHARACTERISTIC
/begin CHARACTERISTIC DFES_MeterOut.DFC_ThrVlvLoBattB1_C "project specific calibration data / Project specific calibration data for DFC_ThrVlvLoBattB1" VALUE 0x804EE3EB Val_Wu8 255.0 OneToOne 0.00 255.0 FORMAT "%5.1" /end CHARACTERISTIC
/begin CHARACTERISTIC DFES_MeterOut.DFC_VehVPhysRngHi_C "project specific calibration data / Project specific calibration data for DFC_VehVPhysRngHi" VALUE 0x804EE3EC Val_Wu8 255.0 OneToOne 0.00 255.0 FORMAT "%5.1" /end CHARACTERISTIC
/begin CHARACTERISTIC DFES_MeterOut.DFC_VehVSclOutOL_C "project specific calibration data / Project specific calibration data for DFC_VehVSclOutOL" VALUE 0x804EE3ED Val_Wu8 255.0 OneToOne 0.00 255.0 FORMAT "%5.1" /end CHARACTERISTIC
/begin CHARACTERISTIC DFES_MeterOut.DFC_VehVSclOutOT_C "project specific calibration data / Project specific calibration data for DFC_VehVSclOutOT" VALUE 0x804EE3EE Val_Wu8 255.0 OneToOne 0.00 255.0 FORMAT "%5.1" /end CHARACTERISTIC
/begin CHARACTERISTIC DFES_MeterOut.DFC_VehVSclOutSCB_C "project specific calibration data / Project specific calibration data for DFC_VehVSclOutSCB" VALUE 0x804EE3EF Val_Wu8 255.0 OneToOne 0.00 255.0 FORMAT "%5.1" /end CHARACTERISTIC
/begin CHARACTERISTIC DFES_MeterOut.DFC_VehVSclOutSCG_C "project specific calibration data / Project specific calibration data for DFC_VehVSclOutSCG" VALUE 0x804EE3F0 Val_Wu8 255.0 OneToOne 0.00 255.0 FORMAT "%5.1" /end CHARACTERISTIC
/begin CHARACTERISTIC DFES_MeterOut.DFC_VehVSnsrARngHi_C "project specific calibration data / Project specific calibration data for DFC_VehVSnsrARngHi" VALUE 0x804EE3F1 Val_Wu8 255.0 OneToOne 0.00 255.0 FORMAT "%5.1" /end CHARACTERISTIC
/begin CHARACTERISTIC DFES_MeterOut.DFC_VehVSnsrBRngHi_C "project specific calibration data / Project specific calibration data for DFC_VehVSnsrBRngHi" VALUE 0x804EE3F2 Val_Wu8 255.0 OneToOne 0.00 255.0 FORMAT "%5.1" /end CHARACTERISTIC
/begin CHARACTERISTIC DFES_MeterOut.DFC_VehVSpdRtyDiag_C "project specific calibration data / Project specific calibration data for DFC_VehVSpdRtyDiag" VALUE 0x804EE3F3 Val_Wu8 255.0 OneToOne 0.00 255.0 FORMAT "%5.1" /end CHARACTERISTIC
/begin CHARACTERISTIC DFES_MeterOut.DFC_VehVWhlErr_C "project specific calibration data / Project specific calibration data for DFC_VehVWhlErr" VALUE 0x804EE3F4 Val_Wu8 255.0 OneToOne 0.00 255.0 FORMAT "%5.1" /end CHARACTERISTIC
/begin CHARACTERISTIC DFES_MeterOut.DFC_ACEvpTSRCMax_C "project specific calibration data / Project specific calibration data for DFC_ACEvpTSRCMax" VALUE 0x804EE3F5 Val_Wu8 255.0 OneToOne 0.00 255.0 FORMAT "%5.1" /end CHARACTERISTIC
/begin CHARACTERISTIC DFES_MeterOut.DFC_ACEvpTSRCMin_C "project specific calibration data / Project specific calibration data for DFC_ACEvpTSRCMin" VALUE 0x804EE3F6 Val_Wu8 255.0 OneToOne 0.00 255.0 FORMAT "%5.1" /end CHARACTERISTIC
/begin CHARACTERISTIC DFES_MeterOut.DFC_AirCClntPAnaSRCMax_C "project specific calibration data / Project specific calibration data for DFC_AirCClntPAnaSRCMax" VALUE 0x804EE3F7 Val_Wu8 255.0 OneToOne 0.00 255.0 FORMAT "%5.1" /end CHARACTERISTIC
/begin CHARACTERISTIC DFES_MeterOut.DFC_AirCClntPAnaSRCMin_C "project specific calibration data / Project specific calibration data for DFC_AirCClntPAnaSRCMin" VALUE 0x804EE3F8 Val_Wu8 255.0 OneToOne 0.00 255.0 FORMAT "%5.1" /end CHARACTERISTIC
/begin CHARACTERISTIC DFES_MeterOut.DFC_AirCSwtNpl_C "project specific calibration data / Project specific calibration data for DFC_AirCSwtNpl" VALUE 0x804EE3F9 Val_Wu8 255.0 OneToOne 0.00 255.0 FORMAT "%5.1" /end CHARACTERISTIC
/begin CHARACTERISTIC DFES_MeterOut.DFC_AirCSwtSig_C "project specific calibration data / Project specific calibration data for DFC_AirCSwtSig" VALUE 0x804EE3FA Val_Wu8 255.0 OneToOne 0.00 255.0 FORMAT "%5.1" /end CHARACTERISTIC
/begin CHARACTERISTIC DFES_MeterOut.DFC_Brk_C "project specific calibration data / Project specific calibration data for DFC_Brk" VALUE 0x804EE3FB Val_Wu8 255.0 OneToOne 0.00 255.0 FORMAT "%5.1" /end CHARACTERISTIC
/begin CHARACTERISTIC DFES_MeterOut.DFC_BrkSig_C "project specific calibration data / Project specific calibration data for DFC_BrkSig" VALUE 0x804EE3FC Val_Wu8 255.0 OneToOne 0.00 255.0 FORMAT "%5.1" /end CHARACTERISTIC
/begin CHARACTERISTIC DFES_MeterOut.DFC_ClthSig_C "project specific calibration data / Project specific calibration data for DFC_ClthSig" VALUE 0x804EE3FD Val_Wu8 255.0 OneToOne 0.00 255.0 FORMAT "%5.1" /end CHARACTERISTIC
/begin CHARACTERISTIC DFES_MeterOut.DFC_HLSDemOvhtEngLim_C "project specific calibration data / Project specific calibration data for DFC_HLSDemOvhtEngLim" VALUE 0x804EE3FE Val_Wu8 255.0 OneToOne 0.00 255.0 FORMAT "%5.1" /end CHARACTERISTIC
/begin CHARACTERISTIC DFES_MeterOut.DFC_OilPNpl_C "project specific calibration data / Project specific calibration data for DFC_OilPNpl" VALUE 0x804EE3FF Val_Wu8 255.0 OneToOne 0.00 255.0 FORMAT "%5.1" /end CHARACTERISTIC
/begin CHARACTERISTIC DFES_MeterOut.DFC_PIntkVUsLineHiB1_C "project specific calibration data / Project specific calibration data for DFC_PIntkVUsLineHiB1" VALUE 0x804EE400 Val_Wu8 255.0 OneToOne 0.00 255.0 FORMAT "%5.1" /end CHARACTERISTIC
/begin CHARACTERISTIC DFES_MeterOut.DFC_PIntkVUsLineLoB1_C "project specific calibration data / Project specific calibration data for DFC_PIntkVUsLineLoB1" VALUE 0x804EE401 Val_Wu8 255.0 OneToOne 0.00 255.0 FORMAT "%5.1" /end CHARACTERISTIC
/begin CHARACTERISTIC DFES_MeterOut.DFC_VehVPhysRngLo_C "project specific calibration data / Project specific calibration data for DFC_VehVPhysRngLo" VALUE 0x804EE402 Val_Wu8 255.0 OneToOne 0.00 255.0 FORMAT "%5.1" /end CHARACTERISTIC
/begin CHARACTERISTIC DFES_MeterOut.DFC_VehVSigCan_C "project specific calibration data / Project specific calibration data for DFC_VehVSigCan" VALUE 0x804EE403 Val_Wu8 255.0 OneToOne 0.00 255.0 FORMAT "%5.1" /end CHARACTERISTIC
/begin CHARACTERISTIC DFES_MeterOut.DFC_VehVSigCanSafe_C "project specific calibration data / Project specific calibration data for DFC_VehVSigCanSafe" VALUE 0x804EE404 Val_Wu8 255.0 OneToOne 0.00 255.0 FORMAT "%5.1" /end CHARACTERISTIC
/begin CHARACTERISTIC DFES_MeterOut.DFC_VlvLftFbOilPSnsrIntk11SRCMax_C "project specific calibration data / Project specific calibration data for DFC_VlvLftFbOilPSnsrIntk11SRCMax" VALUE 0x804EE405 Val_Wu8 255.0 OneToOne 0.00 255.0 FORMAT "%5.1" /end CHARACTERISTIC
/begin CHARACTERISTIC DFES_MeterOut.DFC_VlvLftFbOilPSnsrIntk11SRCMin_C "project specific calibration data / Project specific calibration data for DFC_VlvLftFbOilPSnsrIntk11SRCMin" VALUE 0x804EE406 Val_Wu8 255.0 OneToOne 0.00 255.0 FORMAT "%5.1" /end CHARACTERISTIC
/begin CHARACTERISTIC DFES_MeterOut.DFC_ClthNpl_C "project specific calibration data / Project specific calibration data for DFC_ClthNpl" VALUE 0x804EE407 Val_Wu8 255.0 OneToOne 0.00 255.0 FORMAT "%5.1" /end CHARACTERISTIC
/begin CHARACTERISTIC DFES_MeterOut.DFC_EV1max_C "project specific calibration data / Project specific calibration data for DFC_EV1max" VALUE 0x804EE408 Val_Wu8 255.0 OneToOne 0.00 255.0 FORMAT "%5.1" /end CHARACTERISTIC
/begin CHARACTERISTIC DFES_MeterOut.DFC_EV1min_C "project specific calibration data / Project specific calibration data for DFC_EV1min" VALUE 0x804EE409 Val_Wu8 255.0 OneToOne 0.00 255.0 FORMAT "%5.1" /end CHARACTERISTIC
/begin CHARACTERISTIC DFES_MeterOut.DFC_EV1sig_C "project specific calibration data / Project specific calibration data for DFC_EV1sig" VALUE 0x804EE40A Val_Wu8 255.0 OneToOne 0.00 255.0 FORMAT "%5.1" /end CHARACTERISTIC
/begin CHARACTERISTIC DFES_MeterOut.DFC_EV2max_C "project specific calibration data / Project specific calibration data for DFC_EV2max" VALUE 0x804EE40B Val_Wu8 255.0 OneToOne 0.00 255.0 FORMAT "%5.1" /end CHARACTERISTIC
/begin CHARACTERISTIC DFES_MeterOut.DFC_EV2min_C "project specific calibration data / Project specific calibration data for DFC_EV2min" VALUE 0x804EE40C Val_Wu8 255.0 OneToOne 0.00 255.0 FORMAT "%5.1" /end CHARACTERISTIC
/begin CHARACTERISTIC DFES_MeterOut.DFC_EV2sig_C "project specific calibration data / Project specific calibration data for DFC_EV2sig" VALUE 0x804EE40D Val_Wu8 255.0 OneToOne 0.00 255.0 FORMAT "%5.1" /end CHARACTERISTIC
/begin CHARACTERISTIC DFES_MeterOut.DFC_EV3max_C "project specific calibration data / Project specific calibration data for DFC_EV3max" VALUE 0x804EE40E Val_Wu8 255.0 OneToOne 0.00 255.0 FORMAT "%5.1" /end CHARACTERISTIC
/begin CHARACTERISTIC DFES_MeterOut.DFC_EV3min_C "project specific calibration data / Project specific calibration data for DFC_EV3min" VALUE 0x804EE40F Val_Wu8 255.0 OneToOne 0.00 255.0 FORMAT "%5.1" /end CHARACTERISTIC
/begin CHARACTERISTIC DFES_MeterOut.DFC_EV3sig_C "project specific calibration data / Project specific calibration data for DFC_EV3sig" VALUE 0x804EE410 Val_Wu8 255.0 OneToOne 0.00 255.0 FORMAT "%5.1" /end CHARACTERISTIC
/begin CHARACTERISTIC DFES_MeterOut.DFC_EV4max_C "project specific calibration data / Project specific calibration data for DFC_EV4max" VALUE 0x804EE411 Val_Wu8 255.0 OneToOne 0.00 255.0 FORMAT "%5.1" /end CHARACTERISTIC
/begin CHARACTERISTIC DFES_MeterOut.DFC_EV4min_C "project specific calibration data / Project specific calibration data for DFC_EV4min" VALUE 0x804EE412 Val_Wu8 255.0 OneToOne 0.00 255.0 FORMAT "%5.1" /end CHARACTERISTIC
/begin CHARACTERISTIC DFES_MeterOut.DFC_EV4sig_C "project specific calibration data / Project specific calibration data for DFC_EV4sig" VALUE 0x804EE413 Val_Wu8 255.0 OneToOne 0.00 255.0 FORMAT "%5.1" /end CHARACTERISTIC
/begin CHARACTERISTIC DFES_MeterOut.DFC_GbxPNPosnDrvCdn_C "project specific calibration data / Project specific calibration data for DFC_GbxPNPosnDrvCdn" VALUE 0x804EE414 Val_Wu8 255.0 OneToOne 0.00 255.0 FORMAT "%5.1" /end CHARACTERISTIC
/begin CHARACTERISTIC DFES_MeterOut.DFC_GbxPNPosnPlausy_C "project specific calibration data / Project specific calibration data for DFC_GbxPNPosnPlausy" VALUE 0x804EE415 Val_Wu8 255.0 OneToOne 0.00 255.0 FORMAT "%5.1" /end CHARACTERISTIC
/begin CHARACTERISTIC DFES_MeterOut.DFC_PEnvCcMax_C "project specific calibration data / Project specific calibration data for DFC_PEnvCcMax" VALUE 0x804EE416 Val_Wu8 255.0 OneToOne 0.00 255.0 FORMAT "%5.1" /end CHARACTERISTIC
/begin CHARACTERISTIC DFES_MeterOut.DFC_PEnvCcMin_C "project specific calibration data / Project specific calibration data for DFC_PEnvCcMin" VALUE 0x804EE417 Val_Wu8 255.0 OneToOne 0.00 255.0 FORMAT "%5.1" /end CHARACTERISTIC
/begin CHARACTERISTIC DFES_MeterOut.DFC_PEnvRngChkMax_C "project specific calibration data / Project specific calibration data for DFC_PEnvRngChkMax" VALUE 0x804EE418 Val_Wu8 255.0 OneToOne 0.00 255.0 FORMAT "%5.1" /end CHARACTERISTIC
/begin CHARACTERISTIC DFES_MeterOut.DFC_PEnvRngChkMin_C "project specific calibration data / Project specific calibration data for DFC_PEnvRngChkMin" VALUE 0x804EE419 Val_Wu8 255.0 OneToOne 0.00 255.0 FORMAT "%5.1" /end CHARACTERISTIC
/begin CHARACTERISTIC DFES_MeterOut.DFC_PEnvSnsrPlaus_C "project specific calibration data / Project specific calibration data for DFC_PEnvSnsrPlaus" VALUE 0x804EE41A Val_Wu8 255.0 OneToOne 0.00 255.0 FORMAT "%5.1" /end CHARACTERISTIC
/begin CHARACTERISTIC DFES_MeterOut.DFC_UEGOHeatrPsS1B1Max_C "project specific calibration data / Project specific calibration data for DFC_UEGOHeatrPsS1B1Max" VALUE 0x804EE41B Val_Wu8 255.0 OneToOne 0.00 255.0 FORMAT "%5.1" /end CHARACTERISTIC
/begin CHARACTERISTIC DFES_MeterOut.DFC_UEGOHeatrPsS1B1Min_C "project specific calibration data / Project specific calibration data for DFC_UEGOHeatrPsS1B1Min" VALUE 0x804EE41C Val_Wu8 255.0 OneToOne 0.00 255.0 FORMAT "%5.1" /end CHARACTERISTIC
/begin CHARACTERISTIC DFES_MeterOut.DFC_UEGOHeatrPsS1B1Sig_C "project specific calibration data / Project specific calibration data for DFC_UEGOHeatrPsS1B1Sig" VALUE 0x804EE41D Val_Wu8 255.0 OneToOne 0.00 255.0 FORMAT "%5.1" /end CHARACTERISTIC
/begin CHARACTERISTIC DFES_MeterOut.DFC_UEGOHeatrRlyPsOLS1B1_C "project specific calibration data / Project specific calibration data for DFC_UEGOHeatrRlyPsOLS1B1" VALUE 0x804EE41E Val_Wu8 255.0 OneToOne 0.00 255.0 FORMAT "%5.1" /end CHARACTERISTIC
/begin CHARACTERISTIC DFES_MeterOut.DFC_UEGOHeatrRlyPsSCBS1B1_C "project specific calibration data / Project specific calibration data for DFC_UEGOHeatrRlyPsSCBS1B1" VALUE 0x804EE41F Val_Wu8 255.0 OneToOne 0.00 255.0 FORMAT "%5.1" /end CHARACTERISTIC
/begin CHARACTERISTIC DFES_MeterOut.DFC_UEGOHeatrRlyPsSCGS1B1_C "project specific calibration data / Project specific calibration data for DFC_UEGOHeatrRlyPsSCGS1B1" VALUE 0x804EE420 Val_Wu8 255.0 OneToOne 0.00 255.0 FORMAT "%5.1" /end CHARACTERISTIC
/begin CHARACTERISTIC DFES_MeterOut.DFC_KnDetSens1PortAMax_C "project specific calibration data / Project specific calibration data for DFC_KnDetSens1PortAMax" VALUE 0x804EE421 Val_Wu8 255.0 OneToOne 0.00 255.0 FORMAT "%5.1" /end CHARACTERISTIC
/begin CHARACTERISTIC DFES_MeterOut.DFC_KnDetSens1PortAMin_C "project specific calibration data / Project specific calibration data for DFC_KnDetSens1PortAMin" VALUE 0x804EE422 Val_Wu8 255.0 OneToOne 0.00 255.0 FORMAT "%5.1" /end CHARACTERISTIC
/begin CHARACTERISTIC DFES_MeterOut.DFC_KnDetSens1PortBMax_C "project specific calibration data / Project specific calibration data for DFC_KnDetSens1PortBMax" VALUE 0x804EE423 Val_Wu8 255.0 OneToOne 0.00 255.0 FORMAT "%5.1" /end CHARACTERISTIC
/begin CHARACTERISTIC DFES_MeterOut.DFC_KnDetSens1PortBMin_C "project specific calibration data / Project specific calibration data for DFC_KnDetSens1PortBMin" VALUE 0x804EE424 Val_Wu8 255.0 OneToOne 0.00 255.0 FORMAT "%5.1" /end CHARACTERISTIC
/begin CHARACTERISTIC DFES_MeterOut.DFC_Clth2ONStuck_C "project specific calibration data / Project specific calibration data for DFC_Clth2ONStuck" VALUE 0x804EE425 Val_Wu8 255.0 OneToOne 0.00 255.0 FORMAT "%5.1" /end CHARACTERISTIC
/begin CHARACTERISTIC DFES_MeterOut.DFC_Clth2ONStuckLdc_C "project specific calibration data / Project specific calibration data for DFC_Clth2ONStuckLdc" VALUE 0x804EE426 Val_Wu8 255.0 OneToOne 0.00 255.0 FORMAT "%5.1" /end CHARACTERISTIC
/begin CHARACTERISTIC DFES_MeterOut.DFC_Clth3ONStuckLdc_C "project specific calibration data / Project specific calibration data for DFC_Clth3ONStuckLdc" VALUE 0x804EE427 Val_Wu8 255.0 OneToOne 0.00 255.0 FORMAT "%5.1" /end CHARACTERISTIC
/begin CHARACTERISTIC DFES_MeterOut.DFC_Clth3ONStuckPostDrv_C "project specific calibration data / Project specific calibration data for DFC_Clth3ONStuckPostDrv" VALUE 0x804EE428 Val_Wu8 255.0 OneToOne 0.00 255.0 FORMAT "%5.1" /end CHARACTERISTIC
/begin CHARACTERISTIC DFES_MeterOut.DFC_Clth4ONStuck_C "project specific calibration data / Project specific calibration data for DFC_Clth4ONStuck" VALUE 0x804EE429 Val_Wu8 255.0 OneToOne 0.00 255.0 FORMAT "%5.1" /end CHARACTERISTIC
/begin CHARACTERISTIC DFES_MeterOut.DFC_Clth4ONStuckLdc_C "project specific calibration data / Project specific calibration data for DFC_Clth4ONStuckLdc" VALUE 0x804EE42A Val_Wu8 255.0 OneToOne 0.00 255.0 FORMAT "%5.1" /end CHARACTERISTIC
/begin CHARACTERISTIC DFES_MeterOut.DFC_ComDLCTCU01_C "project specific calibration data / Project specific calibration data for DFC_ComDLCTCU01" VALUE 0x804EE42B Val_Wu8 255.0 OneToOne 0.00 255.0 FORMAT "%5.1" /end CHARACTERISTIC
/begin CHARACTERISTIC DFES_MeterOut.DFC_ComDLCTCU02_C "project specific calibration data / Project specific calibration data for DFC_ComDLCTCU02" VALUE 0x804EE42C Val_Wu8 255.0 OneToOne 0.00 255.0 FORMAT "%5.1" /end CHARACTERISTIC
/begin CHARACTERISTIC DFES_MeterOut.DFC_ComDLCTCU1_C "project specific calibration data / Project specific calibration data for DFC_ComDLCTCU1" VALUE 0x804EE42D Val_Wu8 255.0 OneToOne 0.00 255.0 FORMAT "%5.1" /end CHARACTERISTIC
/begin CHARACTERISTIC DFES_MeterOut.DFC_ComDLCTCU11_C "project specific calibration data / Project specific calibration data for DFC_ComDLCTCU11" VALUE 0x804EE42E Val_Wu8 255.0 OneToOne 0.00 255.0 FORMAT "%5.1" /end CHARACTERISTIC
/begin CHARACTERISTIC DFES_MeterOut.DFC_ComDLCTCU12_C "project specific calibration data / Project specific calibration data for DFC_ComDLCTCU12" VALUE 0x804EE42F Val_Wu8 255.0 OneToOne 0.00 255.0 FORMAT "%5.1" /end CHARACTERISTIC
/begin CHARACTERISTIC DFES_MeterOut.DFC_ComDLCTCU13_C "project specific calibration data / Project specific calibration data for DFC_ComDLCTCU13" VALUE 0x804EE430 Val_Wu8 255.0 OneToOne 0.00 255.0 FORMAT "%5.1" /end CHARACTERISTIC
/begin CHARACTERISTIC DFES_MeterOut.DFC_ComDLCTCU14_C "project specific calibration data / Project specific calibration data for DFC_ComDLCTCU14" VALUE 0x804EE431 Val_Wu8 255.0 OneToOne 0.00 255.0 FORMAT "%5.1" /end CHARACTERISTIC
/begin CHARACTERISTIC DFES_MeterOut.DFC_ComDLCTCU2_C "project specific calibration data / Project specific calibration data for DFC_ComDLCTCU2" VALUE 0x804EE432 Val_Wu8 255.0 OneToOne 0.00 255.0 FORMAT "%5.1" /end CHARACTERISTIC
/begin CHARACTERISTIC DFES_MeterOut.DFC_ComDLCTCU3_C "project specific calibration data / Project specific calibration data for DFC_ComDLCTCU3" VALUE 0x804EE433 Val_Wu8 255.0 OneToOne 0.00 255.0 FORMAT "%5.1" /end CHARACTERISTIC
/begin CHARACTERISTIC DFES_MeterOut.DFC_ComDLCTCU4_C "project specific calibration data / Project specific calibration data for DFC_ComDLCTCU4" VALUE 0x804EE434 Val_Wu8 255.0 OneToOne 0.00 255.0 FORMAT "%5.1" /end CHARACTERISTIC
/begin CHARACTERISTIC DFES_MeterOut.DFC_EVX_C "project specific calibration data / Project specific calibration data for DFC_EVX" VALUE 0x804EE435 Val_Wu8 255.0 OneToOne 0.00 255.0 FORMAT "%5.1" /end CHARACTERISTIC
/begin CHARACTERISTIC DFES_MeterOut.DFC_EbsSocFlt_C "project specific calibration data / Project specific calibration data for DFC_EbsSocFlt" VALUE 0x804EE436 Val_Wu8 255.0 OneToOne 0.00 255.0 FORMAT "%5.1" /end CHARACTERISTIC
/begin CHARACTERISTIC DFES_MeterOut.DFC_I14229VINErr_C "project specific calibration data / Project specific calibration data for DFC_I14229VINErr" VALUE 0x804EE437 Val_Wu8 255.0 OneToOne 0.00 255.0 FORMAT "%5.1" /end CHARACTERISTIC
/begin CHARACTERISTIC DFES_MeterOut.DFC_LLRKHmax_C "project specific calibration data / Project specific calibration data for DFC_LLRKHmax" VALUE 0x804EE438 Val_Wu8 255.0 OneToOne 0.00 255.0 FORMAT "%5.1" /end CHARACTERISTIC
/begin CHARACTERISTIC DFES_MeterOut.DFC_LLRKHmin_C "project specific calibration data / Project specific calibration data for DFC_LLRKHmin" VALUE 0x804EE439 Val_Wu8 255.0 OneToOne 0.00 255.0 FORMAT "%5.1" /end CHARACTERISTIC
/begin CHARACTERISTIC DFES_MeterOut.DFC_LLRmax_C "project specific calibration data / Project specific calibration data for DFC_LLRmax" VALUE 0x804EE43A Val_Wu8 255.0 OneToOne 0.00 255.0 FORMAT "%5.1" /end CHARACTERISTIC
/begin CHARACTERISTIC DFES_MeterOut.DFC_LLRmin_C "project specific calibration data / Project specific calibration data for DFC_LLRmin" VALUE 0x804EE43B Val_Wu8 255.0 OneToOne 0.00 255.0 FORMAT "%5.1" /end CHARACTERISTIC
/begin CHARACTERISTIC DFES_MeterOut.DFC_RoughRoad_C "project specific calibration data / Project specific calibration data for DFC_RoughRoad" VALUE 0x804EE43C Val_Wu8 255.0 OneToOne 0.00 255.0 FORMAT "%5.1" /end CHARACTERISTIC
/begin CHARACTERISTIC DFES_MeterOut.DFC_SiaEEPRdErr_C "project specific calibration data / Project specific calibration data for DFC_SiaEEPRdErr" VALUE 0x804EE43D Val_Wu8 255.0 OneToOne 0.00 255.0 FORMAT "%5.1" /end CHARACTERISTIC
/begin CHARACTERISTIC DFES_MeterOut.DFC_SiaEEPWrngCod_C "project specific calibration data / Project specific calibration data for DFC_SiaEEPWrngCod" VALUE 0x804EE43E Val_Wu8 255.0 OneToOne 0.00 255.0 FORMAT "%5.1" /end CHARACTERISTIC
/begin CHARACTERISTIC DFES_MeterOut.DFC_UegoDummy_C "project specific calibration data / Project specific calibration data for DFC_UegoDummy" VALUE 0x804EE43F Val_Wu8 255.0 OneToOne 0.00 255.0 FORMAT "%5.1" /end CHARACTERISTIC
/begin CHARACTERISTIC DFES_MeterOut.DFC_BusDiagCANAPPLBusOff_C "project specific calibration data / Project specific calibration data for DFC_BusDiagCANAPPLBusOff" VALUE 0x804EE440 Val_Wu8 255.0 OneToOne 0.00 255.0 FORMAT "%5.1" /end CHARACTERISTIC
/begin CHARACTERISTIC DFES_MeterOut.DFC_BusDiagCANCANCBusOff_C "project specific calibration data / Project specific calibration data for DFC_BusDiagCANCANCBusOff" VALUE 0x804EE441 Val_Wu8 255.0 OneToOne 0.00 255.0 FORMAT "%5.1" /end CHARACTERISTIC
/begin CHARACTERISTIC DFES_MeterOut.DFC_BusDiagCANVEHICLEBusOff_C "project specific calibration data / Project specific calibration data for DFC_BusDiagCANVEHICLEBusOff" VALUE 0x804EE442 Val_Wu8 255.0 OneToOne 0.00 255.0 FORMAT "%5.1" /end CHARACTERISTIC
/begin CHARACTERISTIC DFES_MeterOut.DFC_RBA_IODIAGPWR_rba_IoExtCy329_SignalVltSply_0_C "project specific calibration data / Project specific calibration data for DFC_RBA_IODIAGPWR_rba_IoExtCy329_SignalVltSply_0" VALUE 0x804EE443 Val_Wu8 255.0 OneToOne 0.00 255.0 FORMAT "%5.1" /end CHARACTERISTIC
/begin CHARACTERISTIC DFES_MeterOut.DFC_RBA_IODIAGPWR_rba_IoExtCy329_SignalVltSply_0OT_C "project specific calibration data / Project specific calibration data for DFC_RBA_IODIAGPWR_rba_IoExtCy329_SignalVltSply_0OT" VALUE 0x804EE444 Val_Wu8 255.0 OneToOne 0.00 255.0 FORMAT "%5.1" /end CHARACTERISTIC
/begin CHARACTERISTIC DFES_MeterOut.DFC_RBA_IODIAGPWR_rba_IoExtCy329_SignalVltSply_0OV_C "project specific calibration data / Project specific calibration data for DFC_RBA_IODIAGPWR_rba_IoExtCy329_SignalVltSply_0OV" VALUE 0x804EE445 Val_Wu8 255.0 OneToOne 0.00 255.0 FORMAT "%5.1" /end CHARACTERISTIC
/begin CHARACTERISTIC DFES_MeterOut.DFC_RBA_IODIAGPWR_rba_IoExtCy329_SignalVltSply_0SCG_C "project specific calibration data / Project specific calibration data for DFC_RBA_IODIAGPWR_rba_IoExtCy329_SignalVltSply_0SCG" VALUE 0x804EE446 Val_Wu8 255.0 OneToOne 0.00 255.0 FORMAT "%5.1" /end CHARACTERISTIC
/begin CHARACTERISTIC DFES_MeterOut.DFC_RBA_IODIAGPWR_rba_IoExtCy329_SignalVltSply_0UV_C "project specific calibration data / Project specific calibration data for DFC_RBA_IODIAGPWR_rba_IoExtCy329_SignalVltSply_0UV" VALUE 0x804EE447 Val_Wu8 255.0 OneToOne 0.00 255.0 FORMAT "%5.1" /end CHARACTERISTIC
/begin CHARACTERISTIC DFES_MeterOut.DFC_RBA_IODIAGPWR_rba_IoExtCy329_SignalVltSply_1_C "project specific calibration data / Project specific calibration data for DFC_RBA_IODIAGPWR_rba_IoExtCy329_SignalVltSply_1" VALUE 0x804EE448 Val_Wu8 255.0 OneToOne 0.00 255.0 FORMAT "%5.1" /end CHARACTERISTIC
/begin CHARACTERISTIC DFES_MeterOut.DFC_RBA_IODIAGPWR_rba_IoExtCy329_SignalVltSply_1OT_C "project specific calibration data / Project specific calibration data for DFC_RBA_IODIAGPWR_rba_IoExtCy329_SignalVltSply_1OT" VALUE 0x804EE449 Val_Wu8 255.0 OneToOne 0.00 255.0 FORMAT "%5.1" /end CHARACTERISTIC
/begin CHARACTERISTIC DFES_MeterOut.DFC_RBA_IODIAGPWR_rba_IoExtCy329_SignalVltSply_1OV_C "project specific calibration data / Project specific calibration data for DFC_RBA_IODIAGPWR_rba_IoExtCy329_SignalVltSply_1OV" VALUE 0x804EE44A Val_Wu8 255.0 OneToOne 0.00 255.0 FORMAT "%5.1" /end CHARACTERISTIC
/begin CHARACTERISTIC DFES_MeterOut.DFC_RBA_IODIAGPWR_rba_IoExtCy329_SignalVltSply_1SCG_C "project specific calibration data / Project specific calibration data for DFC_RBA_IODIAGPWR_rba_IoExtCy329_SignalVltSply_1SCG" VALUE 0x804EE44B Val_Wu8 255.0 OneToOne 0.00 255.0 FORMAT "%5.1" /end CHARACTERISTIC
/begin CHARACTERISTIC DFES_MeterOut.DFC_RBA_IODIAGPWR_rba_IoExtCy329_SignalVltSply_1UV_C "project specific calibration data / Project specific calibration data for DFC_RBA_IODIAGPWR_rba_IoExtCy329_SignalVltSply_1UV" VALUE 0x804EE44C Val_Wu8 255.0 OneToOne 0.00 255.0 FORMAT "%5.1" /end CHARACTERISTIC
/begin CHARACTERISTIC DFES_MeterOut.DFC_RBA_IODIAGPWR_rba_IoExtCy329_SignalVltSply_2_C "project specific calibration data / Project specific calibration data for DFC_RBA_IODIAGPWR_rba_IoExtCy329_SignalVltSply_2" VALUE 0x804EE44D Val_Wu8 255.0 OneToOne 0.00 255.0 FORMAT "%5.1" /end CHARACTERISTIC
/begin CHARACTERISTIC DFES_MeterOut.DFC_RBA_IODIAGPWR_rba_IoExtCy329_SignalVltSply_2OT_C "project specific calibration data / Project specific calibration data for DFC_RBA_IODIAGPWR_rba_IoExtCy329_SignalVltSply_2OT" VALUE 0x804EE44E Val_Wu8 255.0 OneToOne 0.00 255.0 FORMAT "%5.1" /end CHARACTERISTIC
/begin CHARACTERISTIC DFES_MeterOut.DFC_RBA_IODIAGPWR_rba_IoExtCy329_SignalVltSply_2OV_C "project specific calibration data / Project specific calibration data for DFC_RBA_IODIAGPWR_rba_IoExtCy329_SignalVltSply_2OV" VALUE 0x804EE44F Val_Wu8 255.0 OneToOne 0.00 255.0 FORMAT "%5.1" /end CHARACTERISTIC
/begin CHARACTERISTIC DFES_MeterOut.DFC_RBA_IODIAGPWR_rba_IoExtCy329_SignalVltSply_2SCG_C "project specific calibration data / Project specific calibration data for DFC_RBA_IODIAGPWR_rba_IoExtCy329_SignalVltSply_2SCG" VALUE 0x804EE450 Val_Wu8 255.0 OneToOne 0.00 255.0 FORMAT "%5.1" /end CHARACTERISTIC
/begin CHARACTERISTIC DFES_MeterOut.DFC_RBA_IODIAGPWR_rba_IoExtCy329_SignalVltSply_2UV_C "project specific calibration data / Project specific calibration data for DFC_RBA_IODIAGPWR_rba_IoExtCy329_SignalVltSply_2UV" VALUE 0x804EE451 Val_Wu8 255.0 OneToOne 0.00 255.0 FORMAT "%5.1" /end CHARACTERISTIC
/begin CHARACTERISTIC DFES_MeterOut.DFC_CAN_E_TIMEOUT_C "project specific calibration data / Project specific calibration data for DFC_CAN_E_TIMEOUT" VALUE 0x804EE452 Val_Wu8 255.0 OneToOne 0.00 255.0 FORMAT "%5.1" /end CHARACTERISTIC
/begin CHARACTERISTIC DFES_MeterOut.DFC_LIN_E_TIMEOUT_C "project specific calibration data / Project specific calibration data for DFC_LIN_E_TIMEOUT" VALUE 0x804EE453 Val_Wu8 255.0 OneToOne 0.00 255.0 FORMAT "%5.1" /end CHARACTERISTIC
/begin CHARACTERISTIC DFES_MeterOut.DFC_MRlyOL_C "project specific calibration data / Project specific calibration data for DFC_MRlyOL" VALUE 0x804EE454 Val_Wu8 255.0 OneToOne 0.00 255.0 FORMAT "%5.1" /end CHARACTERISTIC
/begin CHARACTERISTIC DFES_MeterOut.DFC_MRlySCB_C "project specific calibration data / Project specific calibration data for DFC_MRlySCB" VALUE 0x804EE455 Val_Wu8 255.0 OneToOne 0.00 255.0 FORMAT "%5.1" /end CHARACTERISTIC
/begin CHARACTERISTIC DFES_MeterOut.DFC_MRlySCG_C "project specific calibration data / Project specific calibration data for DFC_MRlySCG" VALUE 0x804EE456 Val_Wu8 255.0 OneToOne 0.00 255.0 FORMAT "%5.1" /end CHARACTERISTIC
/begin CHARACTERISTIC DFES_MeterOut.DFC_rba_MultiStackTrace_Threshold_C "project specific calibration data / Project specific calibration data for DFC_rba_MultiStackTrace_Threshold" VALUE 0x804EE457 Val_Wu8 255.0 OneToOne 0.00 255.0 FORMAT "%5.1" /end CHARACTERISTIC
/begin CHARACTERISTIC DFES_MeterOut.DFC_BSWM_E_ACTION_FAILED_C "project specific calibration data / Project specific calibration data for DFC_BSWM_E_ACTION_FAILED" VALUE 0x804EE458 Val_Wu8 255.0 OneToOne 0.00 255.0 FORMAT "%5.1" /end CHARACTERISTIC
/begin CHARACTERISTIC DFES_MeterOut.DFC_BSWM_E_INTRPTQUEUE_FULL_C "project specific calibration data / Project specific calibration data for DFC_BSWM_E_INTRPTQUEUE_FULL" VALUE 0x804EE459 Val_Wu8 255.0 OneToOne 0.00 255.0 FORMAT "%5.1" /end CHARACTERISTIC
/begin CHARACTERISTIC DFES_MeterOut.DFC_RBA_IOEXTLIB_KEEPALIVE_DRV_C "project specific calibration data / Project specific calibration data for DFC_RBA_IOEXTLIB_KEEPALIVE_DRV" VALUE 0x804EE45A Val_Wu8 255.0 OneToOne 0.00 255.0 FORMAT "%5.1" /end CHARACTERISTIC
/begin CHARACTERISTIC DFES_MeterOut.DFC_RBA_IOEXTLIB_KEEPALIVE_INI_C "project specific calibration data / Project specific calibration data for DFC_RBA_IOEXTLIB_KEEPALIVE_INI" VALUE 0x804EE45B Val_Wu8 255.0 OneToOne 0.00 255.0 FORMAT "%5.1" /end CHARACTERISTIC
/begin CHARACTERISTIC DFES_MeterOut.DFC_rba_IoSigRtc_StopCounter_C "project specific calibration data / Project specific calibration data for DFC_rba_IoSigRtc_StopCounter" VALUE 0x804EE45C Val_Wu8 255.0 OneToOne 0.00 255.0 FORMAT "%5.1" /end CHARACTERISTIC
/begin CHARACTERISTIC DFES_MeterOut.DFC_rba_MRly_Diag_Stk_Event_C "project specific calibration data / Project specific calibration data for DFC_rba_MRly_Diag_Stk_Event" VALUE 0x804EE45D Val_Wu8 255.0 OneToOne 0.00 255.0 FORMAT "%5.1" /end CHARACTERISTIC
/begin CHARACTERISTIC DFES_MeterOut.DFC_rba_MemDiag_MemReadErr_C "project specific calibration data / Project specific calibration data for DFC_rba_MemDiag_MemReadErr" VALUE 0x804EE45E Val_Wu8 255.0 OneToOne 0.00 255.0 FORMAT "%5.1" /end CHARACTERISTIC
/begin CHARACTERISTIC DFES_MeterOut.DFC_rba_MemDiag_MemWrErr_C "project specific calibration data / Project specific calibration data for DFC_rba_MemDiag_MemWrErr" VALUE 0x804EE45F Val_Wu8 255.0 OneToOne 0.00 255.0 FORMAT "%5.1" /end CHARACTERISTIC
/begin CHARACTERISTIC DFES_MeterOut.DFC_rba_SyC_IrrSwOffTrigEngRun_Event_C "project specific calibration data / Project specific calibration data for DFC_rba_SyC_IrrSwOffTrigEngRun_Event" VALUE 0x804EE460 Val_Wu8 255.0 OneToOne 0.00 255.0 FORMAT "%5.1" /end CHARACTERISTIC
/begin CHARACTERISTIC DFES_MeterOut.DFC_rba_T15_Diag_ComInVld_Event_C "project specific calibration data / Project specific calibration data for DFC_rba_T15_Diag_ComInVld_Event" VALUE 0x804EE461 Val_Wu8 255.0 OneToOne 0.00 255.0 FORMAT "%5.1" /end CHARACTERISTIC
/begin CHARACTERISTIC DFES_MeterOut.DFC_rba_T15_Diag_ComOff_HwOn_Event_C "project specific calibration data / Project specific calibration data for DFC_rba_T15_Diag_ComOff_HwOn_Event" VALUE 0x804EE462 Val_Wu8 255.0 OneToOne 0.00 255.0 FORMAT "%5.1" /end CHARACTERISTIC
/begin CHARACTERISTIC DFES_MeterOut.DFC_rba_T15_Diag_ComOn_HwOff_Event_C "project specific calibration data / Project specific calibration data for DFC_rba_T15_Diag_ComOn_HwOff_Event" VALUE 0x804EE463 Val_Wu8 255.0 OneToOne 0.00 255.0 FORMAT "%5.1" /end CHARACTERISTIC
/begin CHARACTERISTIC DFES_MeterOut.DFC_AppAllSnsrDfct_C "project specific calibration data / Project specific calibration data for DFC_AppAllSnsrDfct" VALUE 0x804EE464 Val_Wu8 255.0 OneToOne 0.00 255.0 FORMAT "%5.1" /end CHARACTERISTIC
/begin CHARACTERISTIC DFES_MeterOut.DFC_BattUStdbyDiaOL_C "project specific calibration data / Project specific calibration data for DFC_BattUStdbyDiaOL" VALUE 0x804EE465 Val_Wu8 255.0 OneToOne 0.00 255.0 FORMAT "%5.1" /end CHARACTERISTIC
/begin CHARACTERISTIC DFES_MeterOut.DFC_BigLeakIntkMnfldEmiInfl_C "project specific calibration data / Project specific calibration data for DFC_BigLeakIntkMnfldEmiInfl" VALUE 0x804EE466 Val_Wu8 255.0 OneToOne 0.00 255.0 FORMAT "%5.1" /end CHARACTERISTIC
/begin CHARACTERISTIC DFES_MeterOut.DFC_BrkMnSwtContOnWarnLmp_C "project specific calibration data / Project specific calibration data for DFC_BrkMnSwtContOnWarnLmp" VALUE 0x804EE467 Val_Wu8 255.0 OneToOne 0.00 255.0 FORMAT "%5.1" /end CHARACTERISTIC
/begin CHARACTERISTIC DFES_MeterOut.DFC_BrkMnSwtNotStpWarnLmp_C "project specific calibration data / Project specific calibration data for DFC_BrkMnSwtNotStpWarnLmp" VALUE 0x804EE468 Val_Wu8 255.0 OneToOne 0.00 255.0 FORMAT "%5.1" /end CHARACTERISTIC
/begin CHARACTERISTIC DFES_MeterOut.DFC_BrkRdntSwtContOnWarnLmp_C "project specific calibration data / Project specific calibration data for DFC_BrkRdntSwtContOnWarnLmp" VALUE 0x804EE469 Val_Wu8 255.0 OneToOne 0.00 255.0 FORMAT "%5.1" /end CHARACTERISTIC
/begin CHARACTERISTIC DFES_MeterOut.DFC_BrkRdntSwtNotStpWarnLmp_C "project specific calibration data / Project specific calibration data for DFC_BrkRdntSwtNotStpWarnLmp" VALUE 0x804EE46A Val_Wu8 255.0 OneToOne 0.00 255.0 FORMAT "%5.1" /end CHARACTERISTIC
/begin CHARACTERISTIC DFES_MeterOut.DFC_CEngDsTColdStrtMax_C "project specific calibration data / Project specific calibration data for DFC_CEngDsTColdStrtMax" VALUE 0x804EE46B Val_Wu8 255.0 OneToOne 0.00 255.0 FORMAT "%5.1" /end CHARACTERISTIC
/begin CHARACTERISTIC DFES_MeterOut.DFC_CEngDsTColdStrtMin_C "project specific calibration data / Project specific calibration data for DFC_CEngDsTColdStrtMin" VALUE 0x804EE46C Val_Wu8 255.0 OneToOne 0.00 255.0 FORMAT "%5.1" /end CHARACTERISTIC
/begin CHARACTERISTIC DFES_MeterOut.DFC_CEngDsTImps_C "project specific calibration data / Project specific calibration data for DFC_CEngDsTImps" VALUE 0x804EE46D Val_Wu8 255.0 OneToOne 0.00 255.0 FORMAT "%5.1" /end CHARACTERISTIC
/begin CHARACTERISTIC DFES_MeterOut.DFC_CEngDsTPlausLSC_C "project specific calibration data / Project specific calibration data for DFC_CEngDsTPlausLSC" VALUE 0x804EE46E Val_Wu8 255.0 OneToOne 0.00 255.0 FORMAT "%5.1" /end CHARACTERISTIC
/begin CHARACTERISTIC DFES_MeterOut.DFC_CEngDsTPlausSTC_C "project specific calibration data / Project specific calibration data for DFC_CEngDsTPlausSTC" VALUE 0x804EE46F Val_Wu8 255.0 OneToOne 0.00 255.0 FORMAT "%5.1" /end CHARACTERISTIC
/begin CHARACTERISTIC DFES_MeterOut.DFC_CEngDsTSRCMax_C "project specific calibration data / Project specific calibration data for DFC_CEngDsTSRCMax" VALUE 0x804EE470 Val_Wu8 255.0 OneToOne 0.00 255.0 FORMAT "%5.1" /end CHARACTERISTIC
/begin CHARACTERISTIC DFES_MeterOut.DFC_CEngDsTSRCMin_C "project specific calibration data / Project specific calibration data for DFC_CEngDsTSRCMin" VALUE 0x804EE471 Val_Wu8 255.0 OneToOne 0.00 255.0 FORMAT "%5.1" /end CHARACTERISTIC
/begin CHARACTERISTIC DFES_MeterOut.DFC_CEngDsTSig_C "project specific calibration data / Project specific calibration data for DFC_CEngDsTSig" VALUE 0x804EE472 Val_Wu8 255.0 OneToOne 0.00 255.0 FORMAT "%5.1" /end CHARACTERISTIC
/begin CHARACTERISTIC DFES_MeterOut.DFC_CEngUsTSRCMax_C "project specific calibration data / Project specific calibration data for DFC_CEngUsTSRCMax" VALUE 0x804EE473 Val_Wu8 255.0 OneToOne 0.00 255.0 FORMAT "%5.1" /end CHARACTERISTIC
/begin CHARACTERISTIC DFES_MeterOut.DFC_CEngUsTSRCMin_C "project specific calibration data / Project specific calibration data for DFC_CEngUsTSRCMin" VALUE 0x804EE474 Val_Wu8 255.0 OneToOne 0.00 255.0 FORMAT "%5.1" /end CHARACTERISTIC
/begin CHARACTERISTIC DFES_MeterOut.DFC_DCDCFltDet_C "project specific calibration data / Project specific calibration data for DFC_DCDCFltDet" VALUE 0x804EE475 Val_Wu8 255.0 OneToOne 0.00 255.0 FORMAT "%5.1" /end CHARACTERISTIC
/begin CHARACTERISTIC DFES_MeterOut.DFC_DKRSA_C "project specific calibration data / Project specific calibration data for DFC_DKRSA" VALUE 0x804EE476 Val_Wu8 255.0 OneToOne 0.00 255.0 FORMAT "%5.1" /end CHARACTERISTIC
/begin CHARACTERISTIC DFES_MeterOut.DFC_DKVSmax_C "project specific calibration data / Project specific calibration data for DFC_DKVSmax" VALUE 0x804EE477 Val_Wu8 255.0 OneToOne 0.00 255.0 FORMAT "%5.1" /end CHARACTERISTIC
/begin CHARACTERISTIC DFES_MeterOut.DFC_DKnpl_C "project specific calibration data / Project specific calibration data for DFC_DKnpl" VALUE 0x804EE478 Val_Wu8 255.0 OneToOne 0.00 255.0 FORMAT "%5.1" /end CHARACTERISTIC
/begin CHARACTERISTIC DFES_MeterOut.DFC_DSSmax_C "project specific calibration data / Project specific calibration data for DFC_DSSmax" VALUE 0x804EE479 Val_Wu8 255.0 OneToOne 0.00 255.0 FORMAT "%5.1" /end CHARACTERISTIC
/begin CHARACTERISTIC DFES_MeterOut.DFC_DSTTI_C "project specific calibration data / Project specific calibration data for DFC_DSTTI" VALUE 0x804EE47A Val_Wu8 255.0 OneToOne 0.00 255.0 FORMAT "%5.1" /end CHARACTERISTIC
/begin CHARACTERISTIC DFES_MeterOut.DFC_DSUmax_C "project specific calibration data / Project specific calibration data for DFC_DSUmax" VALUE 0x804EE47B Val_Wu8 255.0 OneToOne 0.00 255.0 FORMAT "%5.1" /end CHARACTERISTIC
/begin CHARACTERISTIC DFES_MeterOut.DFC_EGRVlvOL_C "project specific calibration data / Project specific calibration data for DFC_EGRVlvOL" VALUE 0x804EE47C Val_Wu8 255.0 OneToOne 0.00 255.0 FORMAT "%5.1" /end CHARACTERISTIC
/begin CHARACTERISTIC DFES_MeterOut.DFC_EGRVlvSCB_C "project specific calibration data / Project specific calibration data for DFC_EGRVlvSCB" VALUE 0x804EE47D Val_Wu8 255.0 OneToOne 0.00 255.0 FORMAT "%5.1" /end CHARACTERISTIC
/begin CHARACTERISTIC DFES_MeterOut.DFC_EGRVlvSCG_C "project specific calibration data / Project specific calibration data for DFC_EGRVlvSCG" VALUE 0x804EE47E Val_Wu8 255.0 OneToOne 0.00 255.0 FORMAT "%5.1" /end CHARACTERISTIC
/begin CHARACTERISTIC DFES_MeterOut.DFC_EGSDUS2B1LtrDly_C "project specific calibration data / Project specific calibration data for DFC_EGSDUS2B1LtrDly" VALUE 0x804EE47F Val_Wu8 255.0 OneToOne 0.00 255.0 FORMAT "%5.1" /end CHARACTERISTIC
/begin CHARACTERISTIC DFES_MeterOut.DFC_EGSDUS2B1LtrPT1_C "project specific calibration data / Project specific calibration data for DFC_EGSDUS2B1LtrPT1" VALUE 0x804EE480 Val_Wu8 255.0 OneToOne 0.00 255.0 FORMAT "%5.1" /end CHARACTERISTIC
/begin CHARACTERISTIC DFES_MeterOut.DFC_EGSDUS2B1RtlDly_C "project specific calibration data / Project specific calibration data for DFC_EGSDUS2B1RtlDly" VALUE 0x804EE481 Val_Wu8 255.0 OneToOne 0.00 255.0 FORMAT "%5.1" /end CHARACTERISTIC
/begin CHARACTERISTIC DFES_MeterOut.DFC_EGSDUS2B1RtlPT1_C "project specific calibration data / Project specific calibration data for DFC_EGSDUS2B1RtlPT1" VALUE 0x804EE482 Val_Wu8 255.0 OneToOne 0.00 255.0 FORMAT "%5.1" /end CHARACTERISTIC
/begin CHARACTERISTIC DFES_MeterOut.DFC_EGSDUS2B1TarLean_C "project specific calibration data / Project specific calibration data for DFC_EGSDUS2B1TarLean" VALUE 0x804EE483 Val_Wu8 255.0 OneToOne 0.00 255.0 FORMAT "%5.1" /end CHARACTERISTIC
/begin CHARACTERISTIC DFES_MeterOut.DFC_EGSDUS2B1TarRich_C "project specific calibration data / Project specific calibration data for DFC_EGSDUS2B1TarRich" VALUE 0x804EE484 Val_Wu8 255.0 OneToOne 0.00 255.0 FORMAT "%5.1" /end CHARACTERISTIC
/begin CHARACTERISTIC DFES_MeterOut.DFC_ETAKHLmax_C "project specific calibration data / Project specific calibration data for DFC_ETAKHLmax" VALUE 0x804EE485 Val_Wu8 255.0 OneToOne 0.00 255.0 FORMAT "%5.1" /end CHARACTERISTIC
/begin CHARACTERISTIC DFES_MeterOut.DFC_ETAKHTmax_C "project specific calibration data / Project specific calibration data for DFC_ETAKHTmax" VALUE 0x804EE486 Val_Wu8 255.0 OneToOne 0.00 255.0 FORMAT "%5.1" /end CHARACTERISTIC
/begin CHARACTERISTIC DFES_MeterOut.DFC_EngICO_C "project specific calibration data / Project specific calibration data for DFC_EngICO" VALUE 0x804EE487 Val_Wu8 255.0 OneToOne 0.00 255.0 FORMAT "%5.1" /end CHARACTERISTIC
/begin CHARACTERISTIC DFES_MeterOut.DFC_EngPrtOvrSpdMon_C "project specific calibration data / Project specific calibration data for DFC_EngPrtOvrSpdMon" VALUE 0x804EE488 Val_Wu8 255.0 OneToOne 0.00 255.0 FORMAT "%5.1" /end CHARACTERISTIC
/begin CHARACTERISTIC DFES_MeterOut.DFC_EpmCaSI1ErrSig_C "project specific calibration data / Project specific calibration data for DFC_EpmCaSI1ErrSig" VALUE 0x804EE489 Val_Wu8 255.0 OneToOne 0.00 255.0 FORMAT "%5.1" /end CHARACTERISTIC
/begin CHARACTERISTIC DFES_MeterOut.DFC_EpmCaSI1NoSig_C "project specific calibration data / Project specific calibration data for DFC_EpmCaSI1NoSig" VALUE 0x804EE48A Val_Wu8 255.0 OneToOne 0.00 255.0 FORMAT "%5.1" /end CHARACTERISTIC
/begin CHARACTERISTIC DFES_MeterOut.DFC_EpmCaSI1OfsErr_C "project specific calibration data / Project specific calibration data for DFC_EpmCaSI1OfsErr" VALUE 0x804EE48B Val_Wu8 255.0 OneToOne 0.00 255.0 FORMAT "%5.1" /end CHARACTERISTIC
/begin CHARACTERISTIC DFES_MeterOut.DFC_EpmCrSErrSig_C "project specific calibration data / Project specific calibration data for DFC_EpmCrSErrSig" VALUE 0x804EE48C Val_Wu8 255.0 OneToOne 0.00 255.0 FORMAT "%5.1" /end CHARACTERISTIC
/begin CHARACTERISTIC DFES_MeterOut.DFC_EpmCrSNoSig_C "project specific calibration data / Project specific calibration data for DFC_EpmCrSNoSig" VALUE 0x804EE48D Val_Wu8 255.0 OneToOne 0.00 255.0 FORMAT "%5.1" /end CHARACTERISTIC
/begin CHARACTERISTIC DFES_MeterOut.DFC_EtaEngIdleNonCsers_C "project specific calibration data / Project specific calibration data for DFC_EtaEngIdleNonCsers" VALUE 0x804EE48E Val_Wu8 255.0 OneToOne 0.00 255.0 FORMAT "%5.1" /end CHARACTERISTIC
/begin CHARACTERISTIC DFES_MeterOut.DFC_EtaEngPtlNonCsers_C "project specific calibration data / Project specific calibration data for DFC_EtaEngPtlNonCsers" VALUE 0x804EE48F Val_Wu8 255.0 OneToOne 0.00 255.0 FORMAT "%5.1" /end CHARACTERISTIC
/begin CHARACTERISTIC DFES_MeterOut.DFC_FRAmax_C "project specific calibration data / Project specific calibration data for DFC_FRAmax" VALUE 0x804EE490 Val_Wu8 255.0 OneToOne 0.00 255.0 FORMAT "%5.1" /end CHARACTERISTIC
/begin CHARACTERISTIC DFES_MeterOut.DFC_FRAmin_C "project specific calibration data / Project specific calibration data for DFC_FRAmin" VALUE 0x804EE491 Val_Wu8 255.0 OneToOne 0.00 255.0 FORMAT "%5.1" /end CHARACTERISTIC
/begin CHARACTERISTIC DFES_MeterOut.DFC_GbxRvsSwtStk_C "project specific calibration data / Project specific calibration data for DFC_GbxRvsSwtStk" VALUE 0x804EE492 Val_Wu8 255.0 OneToOne 0.00 255.0 FORMAT "%5.1" /end CHARACTERISTIC
/begin CHARACTERISTIC DFES_MeterOut.DFC_HDRmax_C "project specific calibration data / Project specific calibration data for DFC_HDRmax" VALUE 0x804EE493 Val_Wu8 255.0 OneToOne 0.00 255.0 FORMAT "%5.1" /end CHARACTERISTIC
/begin CHARACTERISTIC DFES_MeterOut.DFC_HEGOS2B1ElecMax_C "project specific calibration data / Project specific calibration data for DFC_HEGOS2B1ElecMax" VALUE 0x804EE494 Val_Wu8 255.0 OneToOne 0.00 255.0 FORMAT "%5.1" /end CHARACTERISTIC
/begin CHARACTERISTIC DFES_MeterOut.DFC_HEGOS2B1ElecMin_C "project specific calibration data / Project specific calibration data for DFC_HEGOS2B1ElecMin" VALUE 0x804EE495 Val_Wu8 255.0 OneToOne 0.00 255.0 FORMAT "%5.1" /end CHARACTERISTIC
/begin CHARACTERISTIC DFES_MeterOut.DFC_HEGOS2B1ElecSig_C "project specific calibration data / Project specific calibration data for DFC_HEGOS2B1ElecSig" VALUE 0x804EE496 Val_Wu8 255.0 OneToOne 0.00 255.0 FORMAT "%5.1" /end CHARACTERISTIC
/begin CHARACTERISTIC DFES_MeterOut.DFC_HEGOS2B1HtgNpl_C "project specific calibration data / Project specific calibration data for DFC_HEGOS2B1HtgNpl" VALUE 0x804EE497 Val_Wu8 255.0 OneToOne 0.00 255.0 FORMAT "%5.1" /end CHARACTERISTIC
/begin CHARACTERISTIC DFES_MeterOut.DFC_IntkAirTIntkMnfldCrssMax_C "project specific calibration data / Project specific calibration data for DFC_IntkAirTIntkMnfldCrssMax" VALUE 0x804EE498 Val_Wu8 255.0 OneToOne 0.00 255.0 FORMAT "%5.1" /end CHARACTERISTIC
/begin CHARACTERISTIC DFES_MeterOut.DFC_IntkAirTIntkMnfldCrssMin_C "project specific calibration data / Project specific calibration data for DFC_IntkAirTIntkMnfldCrssMin" VALUE 0x804EE499 Val_Wu8 255.0 OneToOne 0.00 255.0 FORMAT "%5.1" /end CHARACTERISTIC
/begin CHARACTERISTIC DFES_MeterOut.DFC_IntkAirTIntkMnfldHSCMax_C "project specific calibration data / Project specific calibration data for DFC_IntkAirTIntkMnfldHSCMax" VALUE 0x804EE49A Val_Wu8 255.0 OneToOne 0.00 255.0 FORMAT "%5.1" /end CHARACTERISTIC
/begin CHARACTERISTIC DFES_MeterOut.DFC_IntkAirTIntkMnfldImps_C "project specific calibration data / Project specific calibration data for DFC_IntkAirTIntkMnfldImps" VALUE 0x804EE49B Val_Wu8 255.0 OneToOne 0.00 255.0 FORMAT "%5.1" /end CHARACTERISTIC
/begin CHARACTERISTIC DFES_MeterOut.DFC_IntkAirTIntkMnfldPRCMax_C "project specific calibration data / Project specific calibration data for DFC_IntkAirTIntkMnfldPRCMax" VALUE 0x804EE49C Val_Wu8 255.0 OneToOne 0.00 255.0 FORMAT "%5.1" /end CHARACTERISTIC
/begin CHARACTERISTIC DFES_MeterOut.DFC_IntkAirTIntkMnfldPRCMin_C "project specific calibration data / Project specific calibration data for DFC_IntkAirTIntkMnfldPRCMin" VALUE 0x804EE49D Val_Wu8 255.0 OneToOne 0.00 255.0 FORMAT "%5.1" /end CHARACTERISTIC
/begin CHARACTERISTIC DFES_MeterOut.DFC_IntkAirTIntkMnfldSRCMax_C "project specific calibration data / Project specific calibration data for DFC_IntkAirTIntkMnfldSRCMax" VALUE 0x804EE49E Val_Wu8 255.0 OneToOne 0.00 255.0 FORMAT "%5.1" /end CHARACTERISTIC
/begin CHARACTERISTIC DFES_MeterOut.DFC_IntkAirTIntkMnfldSRCMin_C "project specific calibration data / Project specific calibration data for DFC_IntkAirTIntkMnfldSRCMin" VALUE 0x804EE49F Val_Wu8 255.0 OneToOne 0.00 255.0 FORMAT "%5.1" /end CHARACTERISTIC
/begin CHARACTERISTIC DFES_MeterOut.DFC_IntkAirTIntkMnfldSTC_C "project specific calibration data / Project specific calibration data for DFC_IntkAirTIntkMnfldSTC" VALUE 0x804EE4A0 Val_Wu8 255.0 OneToOne 0.00 255.0 FORMAT "%5.1" /end CHARACTERISTIC
/begin CHARACTERISTIC DFES_MeterOut.DFC_KS1max_C "project specific calibration data / Project specific calibration data for DFC_KS1max" VALUE 0x804EE4A1 Val_Wu8 255.0 OneToOne 0.00 255.0 FORMAT "%5.1" /end CHARACTERISTIC
/begin CHARACTERISTIC DFES_MeterOut.DFC_KS1min_C "project specific calibration data / Project specific calibration data for DFC_KS1min" VALUE 0x804EE4A2 Val_Wu8 255.0 OneToOne 0.00 255.0 FORMAT "%5.1" /end CHARACTERISTIC
/begin CHARACTERISTIC DFES_MeterOut.DFC_LMmax_C "project specific calibration data / Project specific calibration data for DFC_LMmax" VALUE 0x804EE4A3 Val_Wu8 255.0 OneToOne 0.00 255.0 FORMAT "%5.1" /end CHARACTERISTIC
/begin CHARACTERISTIC DFES_MeterOut.DFC_LZSRnpl_C "project specific calibration data / Project specific calibration data for DFC_LZSRnpl" VALUE 0x804EE4A4 Val_Wu8 255.0 OneToOne 0.00 255.0 FORMAT "%5.1" /end CHARACTERISTIC
/begin CHARACTERISTIC DFES_MeterOut.DFC_LamDynDiagS1B1_C "project specific calibration data / Project specific calibration data for DFC_LamDynDiagS1B1" VALUE 0x804EE4A5 Val_Wu8 255.0 OneToOne 0.00 255.0 FORMAT "%5.1" /end CHARACTERISTIC
/begin CHARACTERISTIC DFES_MeterOut.DFC_LeakIntkMnfldEmiInfl_C "project specific calibration data / Project specific calibration data for DFC_LeakIntkMnfldEmiInfl" VALUE 0x804EE4A6 Val_Wu8 255.0 OneToOne 0.00 255.0 FORMAT "%5.1" /end CHARACTERISTIC
/begin CHARACTERISTIC DFES_MeterOut.DFC_MD00max_C "project specific calibration data / Project specific calibration data for DFC_MD00max" VALUE 0x804EE4A7 Val_Wu8 255.0 OneToOne 0.00 255.0 FORMAT "%5.1" /end CHARACTERISTIC
/begin CHARACTERISTIC DFES_MeterOut.DFC_MDBmax_C "project specific calibration data / Project specific calibration data for DFC_MDBmax" VALUE 0x804EE4A8 Val_Wu8 255.0 OneToOne 0.00 255.0 FORMAT "%5.1" /end CHARACTERISTIC
/begin CHARACTERISTIC DFES_MeterOut.DFC_MDCat_C "project specific calibration data / Project specific calibration data for DFC_MDCat" VALUE 0x804EE4A9 Val_Wu8 255.0 OneToOne 0.00 255.0 FORMAT "%5.1" /end CHARACTERISTIC
/begin CHARACTERISTIC DFES_MeterOut.DFC_MDCatCrit_C "project specific calibration data / Project specific calibration data for DFC_MDCatCrit" VALUE 0x804EE4AA Val_Wu8 255.0 OneToOne 0.00 255.0 FORMAT "%5.1" /end CHARACTERISTIC
/begin CHARACTERISTIC DFES_MeterOut.DFC_MDCatCurr_C "project specific calibration data / Project specific calibration data for DFC_MDCatCurr" VALUE 0x804EE4AB Val_Wu8 255.0 OneToOne 0.00 255.0 FORMAT "%5.1" /end CHARACTERISTIC
/begin CHARACTERISTIC DFES_MeterOut.DFC_MDCyl_0_C "project specific calibration data / Project specific calibration data for DFC_MDCyl_0" VALUE 0x804EE4AC Val_Wu8 255.0 OneToOne 0.00 255.0 FORMAT "%5.1" /end CHARACTERISTIC
/begin CHARACTERISTIC DFES_MeterOut.DFC_MDCyl_1_C "project specific calibration data / Project specific calibration data for DFC_MDCyl_1" VALUE 0x804EE4AD Val_Wu8 255.0 OneToOne 0.00 255.0 FORMAT "%5.1" /end CHARACTERISTIC
/begin CHARACTERISTIC DFES_MeterOut.DFC_MDCyl_2_C "project specific calibration data / Project specific calibration data for DFC_MDCyl_2" VALUE 0x804EE4AE Val_Wu8 255.0 OneToOne 0.00 255.0 FORMAT "%5.1" /end CHARACTERISTIC
/begin CHARACTERISTIC DFES_MeterOut.DFC_MDCyl_3_C "project specific calibration data / Project specific calibration data for DFC_MDCyl_3" VALUE 0x804EE4AF Val_Wu8 255.0 OneToOne 0.00 255.0 FORMAT "%5.1" /end CHARACTERISTIC
/begin CHARACTERISTIC DFES_MeterOut.DFC_MDEmi_C "project specific calibration data / Project specific calibration data for DFC_MDEmi" VALUE 0x804EE4B0 Val_Wu8 255.0 OneToOne 0.00 255.0 FORMAT "%5.1" /end CHARACTERISTIC
/begin CHARACTERISTIC DFES_MeterOut.DFC_MDEmiStrt_C "project specific calibration data / Project specific calibration data for DFC_MDEmiStrt" VALUE 0x804EE4B1 Val_Wu8 255.0 OneToOne 0.00 255.0 FORMAT "%5.1" /end CHARACTERISTIC
/begin CHARACTERISTIC DFES_MeterOut.DFC_MDFco_C "project specific calibration data / Project specific calibration data for DFC_MDFco" VALUE 0x804EE4B2 Val_Wu8 255.0 OneToOne 0.00 255.0 FORMAT "%5.1" /end CHARACTERISTIC
/begin CHARACTERISTIC DFES_MeterOut.DFC_MDMpl_C "project specific calibration data / Project specific calibration data for DFC_MDMpl" VALUE 0x804EE4B3 Val_Wu8 255.0 OneToOne 0.00 255.0 FORMAT "%5.1" /end CHARACTERISTIC
/begin CHARACTERISTIC DFES_MeterOut.DFC_MDSegTiAdpn_C "project specific calibration data / Project specific calibration data for DFC_MDSegTiAdpn" VALUE 0x804EE4B4 Val_Wu8 255.0 OneToOne 0.00 255.0 FORMAT "%5.1" /end CHARACTERISTIC
/begin CHARACTERISTIC DFES_MeterOut.DFC_MDmax_C "project specific calibration data / Project specific calibration data for DFC_MDmax" VALUE 0x804EE4B5 Val_Wu8 255.0 OneToOne 0.00 255.0 FORMAT "%5.1" /end CHARACTERISTIC
/begin CHARACTERISTIC DFES_MeterOut.DFC_MOXEMM_SMU_ALM0_0_C "project specific calibration data / Project specific calibration data for DFC_MOXEMM_SMU_ALM0_0" VALUE 0x804EE4B6 Val_Wu8 255.0 OneToOne 0.00 255.0 FORMAT "%5.1" /end CHARACTERISTIC
/begin CHARACTERISTIC DFES_MeterOut.DFC_MOXEMM_SMU_ALM0_1_C "project specific calibration data / Project specific calibration data for DFC_MOXEMM_SMU_ALM0_1" VALUE 0x804EE4B7 Val_Wu8 255.0 OneToOne 0.00 255.0 FORMAT "%5.1" /end CHARACTERISTIC
/begin CHARACTERISTIC DFES_MeterOut.DFC_MOXEMM_SMU_ALM0_10_C "project specific calibration data / Project specific calibration data for DFC_MOXEMM_SMU_ALM0_10" VALUE 0x804EE4B8 Val_Wu8 255.0 OneToOne 0.00 255.0 FORMAT "%5.1" /end CHARACTERISTIC
/begin CHARACTERISTIC DFES_MeterOut.DFC_MOXEMM_SMU_ALM0_11_C "project specific calibration data / Project specific calibration data for DFC_MOXEMM_SMU_ALM0_11" VALUE 0x804EE4B9 Val_Wu8 255.0 OneToOne 0.00 255.0 FORMAT "%5.1" /end CHARACTERISTIC
/begin CHARACTERISTIC DFES_MeterOut.DFC_MOXEMM_SMU_ALM0_13_C "project specific calibration data / Project specific calibration data for DFC_MOXEMM_SMU_ALM0_13" VALUE 0x804EE4BA Val_Wu8 255.0 OneToOne 0.00 255.0 FORMAT "%5.1" /end CHARACTERISTIC
/begin CHARACTERISTIC DFES_MeterOut.DFC_MOXEMM_SMU_ALM0_14_C "project specific calibration data / Project specific calibration data for DFC_MOXEMM_SMU_ALM0_14" VALUE 0x804EE4BB Val_Wu8 255.0 OneToOne 0.00 255.0 FORMAT "%5.1" /end CHARACTERISTIC
/begin CHARACTERISTIC DFES_MeterOut.DFC_MOXEMM_SMU_ALM0_2_C "project specific calibration data / Project specific calibration data for DFC_MOXEMM_SMU_ALM0_2" VALUE 0x804EE4BC Val_Wu8 255.0 OneToOne 0.00 255.0 FORMAT "%5.1" /end CHARACTERISTIC
/begin CHARACTERISTIC DFES_MeterOut.DFC_MOXEMM_SMU_ALM0_22_C "project specific calibration data / Project specific calibration data for DFC_MOXEMM_SMU_ALM0_22" VALUE 0x804EE4BD Val_Wu8 255.0 OneToOne 0.00 255.0 FORMAT "%5.1" /end CHARACTERISTIC
/begin CHARACTERISTIC DFES_MeterOut.DFC_MOXEMM_SMU_ALM0_23_C "project specific calibration data / Project specific calibration data for DFC_MOXEMM_SMU_ALM0_23" VALUE 0x804EE4BE Val_Wu8 255.0 OneToOne 0.00 255.0 FORMAT "%5.1" /end CHARACTERISTIC
/begin CHARACTERISTIC DFES_MeterOut.DFC_MOXEMM_SMU_ALM0_4_C "project specific calibration data / Project specific calibration data for DFC_MOXEMM_SMU_ALM0_4" VALUE 0x804EE4BF Val_Wu8 255.0 OneToOne 0.00 255.0 FORMAT "%5.1" /end CHARACTERISTIC
/begin CHARACTERISTIC DFES_MeterOut.DFC_MOXEMM_SMU_ALM0_5_C "project specific calibration data / Project specific calibration data for DFC_MOXEMM_SMU_ALM0_5" VALUE 0x804EE4C0 Val_Wu8 255.0 OneToOne 0.00 255.0 FORMAT "%5.1" /end CHARACTERISTIC
/begin CHARACTERISTIC DFES_MeterOut.DFC_MOXEMM_SMU_ALM0_7_C "project specific calibration data / Project specific calibration data for DFC_MOXEMM_SMU_ALM0_7" VALUE 0x804EE4C1 Val_Wu8 255.0 OneToOne 0.00 255.0 FORMAT "%5.1" /end CHARACTERISTIC
/begin CHARACTERISTIC DFES_MeterOut.DFC_MOXEMM_SMU_ALM0_8_C "project specific calibration data / Project specific calibration data for DFC_MOXEMM_SMU_ALM0_8" VALUE 0x804EE4C2 Val_Wu8 255.0 OneToOne 0.00 255.0 FORMAT "%5.1" /end CHARACTERISTIC
/begin CHARACTERISTIC DFES_MeterOut.DFC_MOXEMM_SMU_ALM10_16_C "project specific calibration data / Project specific calibration data for DFC_MOXEMM_SMU_ALM10_16" VALUE 0x804EE4C3 Val_Wu8 255.0 OneToOne 0.00 255.0 FORMAT "%5.1" /end CHARACTERISTIC
/begin CHARACTERISTIC DFES_MeterOut.DFC_MOXEMM_SMU_ALM10_17_C "project specific calibration data / Project specific calibration data for DFC_MOXEMM_SMU_ALM10_17" VALUE 0x804EE4C4 Val_Wu8 255.0 OneToOne 0.00 255.0 FORMAT "%5.1" /end CHARACTERISTIC
/begin CHARACTERISTIC DFES_MeterOut.DFC_MOXEMM_SMU_ALM10_21_C "project specific calibration data / Project specific calibration data for DFC_MOXEMM_SMU_ALM10_21" VALUE 0x804EE4C5 Val_Wu8 255.0 OneToOne 0.00 255.0 FORMAT "%5.1" /end CHARACTERISTIC
/begin CHARACTERISTIC DFES_MeterOut.DFC_MOXEMM_SMU_ALM11_0_C "project specific calibration data / Project specific calibration data for DFC_MOXEMM_SMU_ALM11_0" VALUE 0x804EE4C6 Val_Wu8 255.0 OneToOne 0.00 255.0 FORMAT "%5.1" /end CHARACTERISTIC
/begin CHARACTERISTIC DFES_MeterOut.DFC_MOXEMM_SMU_ALM11_1_C "project specific calibration data / Project specific calibration data for DFC_MOXEMM_SMU_ALM11_1" VALUE 0x804EE4C7 Val_Wu8 255.0 OneToOne 0.00 255.0 FORMAT "%5.1" /end CHARACTERISTIC
/begin CHARACTERISTIC DFES_MeterOut.DFC_MOXEMM_SMU_ALM11_2_C "project specific calibration data / Project specific calibration data for DFC_MOXEMM_SMU_ALM11_2" VALUE 0x804EE4C8 Val_Wu8 255.0 OneToOne 0.00 255.0 FORMAT "%5.1" /end CHARACTERISTIC
/begin CHARACTERISTIC DFES_MeterOut.DFC_MOXEMM_SMU_ALM11_3_C "project specific calibration data / Project specific calibration data for DFC_MOXEMM_SMU_ALM11_3" VALUE 0x804EE4C9 Val_Wu8 255.0 OneToOne 0.00 255.0 FORMAT "%5.1" /end CHARACTERISTIC
/begin CHARACTERISTIC DFES_MeterOut.DFC_MOXEMM_SMU_ALM11_4_C "project specific calibration data / Project specific calibration data for DFC_MOXEMM_SMU_ALM11_4" VALUE 0x804EE4CA Val_Wu8 255.0 OneToOne 0.00 255.0 FORMAT "%5.1" /end CHARACTERISTIC
/begin CHARACTERISTIC DFES_MeterOut.DFC_MOXEMM_SMU_ALM11_5_C "project specific calibration data / Project specific calibration data for DFC_MOXEMM_SMU_ALM11_5" VALUE 0x804EE4CB Val_Wu8 255.0 OneToOne 0.00 255.0 FORMAT "%5.1" /end CHARACTERISTIC
/begin CHARACTERISTIC DFES_MeterOut.DFC_MOXEMM_SMU_ALM11_8_C "project specific calibration data / Project specific calibration data for DFC_MOXEMM_SMU_ALM11_8" VALUE 0x804EE4CC Val_Wu8 255.0 OneToOne 0.00 255.0 FORMAT "%5.1" /end CHARACTERISTIC
/begin CHARACTERISTIC DFES_MeterOut.DFC_MOXEMM_SMU_ALM11_9_C "project specific calibration data / Project specific calibration data for DFC_MOXEMM_SMU_ALM11_9" VALUE 0x804EE4CD Val_Wu8 255.0 OneToOne 0.00 255.0 FORMAT "%5.1" /end CHARACTERISTIC
/begin CHARACTERISTIC DFES_MeterOut.DFC_MOXEMM_SMU_ALM1_0_C "project specific calibration data / Project specific calibration data for DFC_MOXEMM_SMU_ALM1_0" VALUE 0x804EE4CE Val_Wu8 255.0 OneToOne 0.00 255.0 FORMAT "%5.1" /end CHARACTERISTIC
/begin CHARACTERISTIC DFES_MeterOut.DFC_MOXEMM_SMU_ALM1_1_C "project specific calibration data / Project specific calibration data for DFC_MOXEMM_SMU_ALM1_1" VALUE 0x804EE4CF Val_Wu8 255.0 OneToOne 0.00 255.0 FORMAT "%5.1" /end CHARACTERISTIC
/begin CHARACTERISTIC DFES_MeterOut.DFC_MOXEMM_SMU_ALM1_10_C "project specific calibration data / Project specific calibration data for DFC_MOXEMM_SMU_ALM1_10" VALUE 0x804EE4D0 Val_Wu8 255.0 OneToOne 0.00 255.0 FORMAT "%5.1" /end CHARACTERISTIC
/begin CHARACTERISTIC DFES_MeterOut.DFC_MOXEMM_SMU_ALM1_11_C "project specific calibration data / Project specific calibration data for DFC_MOXEMM_SMU_ALM1_11" VALUE 0x804EE4D1 Val_Wu8 255.0 OneToOne 0.00 255.0 FORMAT "%5.1" /end CHARACTERISTIC
/begin CHARACTERISTIC DFES_MeterOut.DFC_MOXEMM_SMU_ALM1_13_C "project specific calibration data / Project specific calibration data for DFC_MOXEMM_SMU_ALM1_13" VALUE 0x804EE4D2 Val_Wu8 255.0 OneToOne 0.00 255.0 FORMAT "%5.1" /end CHARACTERISTIC
/begin CHARACTERISTIC DFES_MeterOut.DFC_MOXEMM_SMU_ALM1_14_C "project specific calibration data / Project specific calibration data for DFC_MOXEMM_SMU_ALM1_14" VALUE 0x804EE4D3 Val_Wu8 255.0 OneToOne 0.00 255.0 FORMAT "%5.1" /end CHARACTERISTIC
/begin CHARACTERISTIC DFES_MeterOut.DFC_MOXEMM_SMU_ALM1_2_C "project specific calibration data / Project specific calibration data for DFC_MOXEMM_SMU_ALM1_2" VALUE 0x804EE4D4 Val_Wu8 255.0 OneToOne 0.00 255.0 FORMAT "%5.1" /end CHARACTERISTIC
/begin CHARACTERISTIC DFES_MeterOut.DFC_MOXEMM_SMU_ALM1_22_C "project specific calibration data / Project specific calibration data for DFC_MOXEMM_SMU_ALM1_22" VALUE 0x804EE4D5 Val_Wu8 255.0 OneToOne 0.00 255.0 FORMAT "%5.1" /end CHARACTERISTIC
/begin CHARACTERISTIC DFES_MeterOut.DFC_MOXEMM_SMU_ALM1_23_C "project specific calibration data / Project specific calibration data for DFC_MOXEMM_SMU_ALM1_23" VALUE 0x804EE4D6 Val_Wu8 255.0 OneToOne 0.00 255.0 FORMAT "%5.1" /end CHARACTERISTIC
/begin CHARACTERISTIC DFES_MeterOut.DFC_MOXEMM_SMU_ALM1_4_C "project specific calibration data / Project specific calibration data for DFC_MOXEMM_SMU_ALM1_4" VALUE 0x804EE4D7 Val_Wu8 255.0 OneToOne 0.00 255.0 FORMAT "%5.1" /end CHARACTERISTIC
/begin CHARACTERISTIC DFES_MeterOut.DFC_MOXEMM_SMU_ALM1_5_C "project specific calibration data / Project specific calibration data for DFC_MOXEMM_SMU_ALM1_5" VALUE 0x804EE4D8 Val_Wu8 255.0 OneToOne 0.00 255.0 FORMAT "%5.1" /end CHARACTERISTIC
/begin CHARACTERISTIC DFES_MeterOut.DFC_MOXEMM_SMU_ALM1_7_C "project specific calibration data / Project specific calibration data for DFC_MOXEMM_SMU_ALM1_7" VALUE 0x804EE4D9 Val_Wu8 255.0 OneToOne 0.00 255.0 FORMAT "%5.1" /end CHARACTERISTIC
/begin CHARACTERISTIC DFES_MeterOut.DFC_MOXEMM_SMU_ALM1_8_C "project specific calibration data / Project specific calibration data for DFC_MOXEMM_SMU_ALM1_8" VALUE 0x804EE4DA Val_Wu8 255.0 OneToOne 0.00 255.0 FORMAT "%5.1" /end CHARACTERISTIC
/begin CHARACTERISTIC DFES_MeterOut.DFC_MOXEMM_SMU_ALM21_0_C "project specific calibration data / Project specific calibration data for DFC_MOXEMM_SMU_ALM21_0" VALUE 0x804EE4DB Val_Wu8 255.0 OneToOne 0.00 255.0 FORMAT "%5.1" /end CHARACTERISTIC
/begin CHARACTERISTIC DFES_MeterOut.DFC_MOXEMM_SMU_ALM21_16_C "project specific calibration data / Project specific calibration data for DFC_MOXEMM_SMU_ALM21_16" VALUE 0x804EE4DC Val_Wu8 255.0 OneToOne 0.00 255.0 FORMAT "%5.1" /end CHARACTERISTIC
/begin CHARACTERISTIC DFES_MeterOut.DFC_MOXEMM_SMU_ALM21_3_C "project specific calibration data / Project specific calibration data for DFC_MOXEMM_SMU_ALM21_3" VALUE 0x804EE4DD Val_Wu8 255.0 OneToOne 0.00 255.0 FORMAT "%5.1" /end CHARACTERISTIC
/begin CHARACTERISTIC DFES_MeterOut.DFC_MOXEMM_SMU_ALM2_1_C "project specific calibration data / Project specific calibration data for DFC_MOXEMM_SMU_ALM2_1" VALUE 0x804EE4DE Val_Wu8 255.0 OneToOne 0.00 255.0 FORMAT "%5.1" /end CHARACTERISTIC
/begin CHARACTERISTIC DFES_MeterOut.DFC_MOXEMM_SMU_ALM2_10_C "project specific calibration data / Project specific calibration data for DFC_MOXEMM_SMU_ALM2_10" VALUE 0x804EE4DF Val_Wu8 255.0 OneToOne 0.00 255.0 FORMAT "%5.1" /end CHARACTERISTIC
/begin CHARACTERISTIC DFES_MeterOut.DFC_MOXEMM_SMU_ALM2_11_C "project specific calibration data / Project specific calibration data for DFC_MOXEMM_SMU_ALM2_11" VALUE 0x804EE4E0 Val_Wu8 255.0 OneToOne 0.00 255.0 FORMAT "%5.1" /end CHARACTERISTIC
/begin CHARACTERISTIC DFES_MeterOut.DFC_MOXEMM_SMU_ALM2_13_C "project specific calibration data / Project specific calibration data for DFC_MOXEMM_SMU_ALM2_13" VALUE 0x804EE4E1 Val_Wu8 255.0 OneToOne 0.00 255.0 FORMAT "%5.1" /end CHARACTERISTIC
/begin CHARACTERISTIC DFES_MeterOut.DFC_MOXEMM_SMU_ALM2_14_C "project specific calibration data / Project specific calibration data for DFC_MOXEMM_SMU_ALM2_14" VALUE 0x804EE4E2 Val_Wu8 255.0 OneToOne 0.00 255.0 FORMAT "%5.1" /end CHARACTERISTIC
/begin CHARACTERISTIC DFES_MeterOut.DFC_MOXEMM_SMU_ALM2_22_C "project specific calibration data / Project specific calibration data for DFC_MOXEMM_SMU_ALM2_22" VALUE 0x804EE4E3 Val_Wu8 255.0 OneToOne 0.00 255.0 FORMAT "%5.1" /end CHARACTERISTIC
/begin CHARACTERISTIC DFES_MeterOut.DFC_MOXEMM_SMU_ALM2_23_C "project specific calibration data / Project specific calibration data for DFC_MOXEMM_SMU_ALM2_23" VALUE 0x804EE4E4 Val_Wu8 255.0 OneToOne 0.00 255.0 FORMAT "%5.1" /end CHARACTERISTIC
/begin CHARACTERISTIC DFES_MeterOut.DFC_MOXEMM_SMU_ALM2_4_C "project specific calibration data / Project specific calibration data for DFC_MOXEMM_SMU_ALM2_4" VALUE 0x804EE4E5 Val_Wu8 255.0 OneToOne 0.00 255.0 FORMAT "%5.1" /end CHARACTERISTIC
/begin CHARACTERISTIC DFES_MeterOut.DFC_MOXEMM_SMU_ALM2_5_C "project specific calibration data / Project specific calibration data for DFC_MOXEMM_SMU_ALM2_5" VALUE 0x804EE4E6 Val_Wu8 255.0 OneToOne 0.00 255.0 FORMAT "%5.1" /end CHARACTERISTIC
/begin CHARACTERISTIC DFES_MeterOut.DFC_MOXEMM_SMU_ALM2_7_C "project specific calibration data / Project specific calibration data for DFC_MOXEMM_SMU_ALM2_7" VALUE 0x804EE4E7 Val_Wu8 255.0 OneToOne 0.00 255.0 FORMAT "%5.1" /end CHARACTERISTIC
/begin CHARACTERISTIC DFES_MeterOut.DFC_MOXEMM_SMU_ALM2_8_C "project specific calibration data / Project specific calibration data for DFC_MOXEMM_SMU_ALM2_8" VALUE 0x804EE4E8 Val_Wu8 255.0 OneToOne 0.00 255.0 FORMAT "%5.1" /end CHARACTERISTIC
/begin CHARACTERISTIC DFES_MeterOut.DFC_MOXEMM_SMU_ALM6_0_C "project specific calibration data / Project specific calibration data for DFC_MOXEMM_SMU_ALM6_0" VALUE 0x804EE4E9 Val_Wu8 255.0 OneToOne 0.00 255.0 FORMAT "%5.1" /end CHARACTERISTIC
/begin CHARACTERISTIC DFES_MeterOut.DFC_MOXEMM_SMU_ALM6_11_C "project specific calibration data / Project specific calibration data for DFC_MOXEMM_SMU_ALM6_11" VALUE 0x804EE4EA Val_Wu8 255.0 OneToOne 0.00 255.0 FORMAT "%5.1" /end CHARACTERISTIC
/begin CHARACTERISTIC DFES_MeterOut.DFC_MOXEMM_SMU_ALM6_12_C "project specific calibration data / Project specific calibration data for DFC_MOXEMM_SMU_ALM6_12" VALUE 0x804EE4EB Val_Wu8 255.0 OneToOne 0.00 255.0 FORMAT "%5.1" /end CHARACTERISTIC
/begin CHARACTERISTIC DFES_MeterOut.DFC_MOXEMM_SMU_ALM6_14_C "project specific calibration data / Project specific calibration data for DFC_MOXEMM_SMU_ALM6_14" VALUE 0x804EE4EC Val_Wu8 255.0 OneToOne 0.00 255.0 FORMAT "%5.1" /end CHARACTERISTIC
/begin CHARACTERISTIC DFES_MeterOut.DFC_MOXEMM_SMU_ALM6_15_C "project specific calibration data / Project specific calibration data for DFC_MOXEMM_SMU_ALM6_15" VALUE 0x804EE4ED Val_Wu8 255.0 OneToOne 0.00 255.0 FORMAT "%5.1" /end CHARACTERISTIC
/begin CHARACTERISTIC DFES_MeterOut.DFC_MOXEMM_SMU_ALM6_17_C "project specific calibration data / Project specific calibration data for DFC_MOXEMM_SMU_ALM6_17" VALUE 0x804EE4EE Val_Wu8 255.0 OneToOne 0.00 255.0 FORMAT "%5.1" /end CHARACTERISTIC
/begin CHARACTERISTIC DFES_MeterOut.DFC_MOXEMM_SMU_ALM6_18_C "project specific calibration data / Project specific calibration data for DFC_MOXEMM_SMU_ALM6_18" VALUE 0x804EE4EF Val_Wu8 255.0 OneToOne 0.00 255.0 FORMAT "%5.1" /end CHARACTERISTIC
/begin CHARACTERISTIC DFES_MeterOut.DFC_MOXEMM_SMU_ALM6_20_C "project specific calibration data / Project specific calibration data for DFC_MOXEMM_SMU_ALM6_20" VALUE 0x804EE4F0 Val_Wu8 255.0 OneToOne 0.00 255.0 FORMAT "%5.1" /end CHARACTERISTIC
/begin CHARACTERISTIC DFES_MeterOut.DFC_MOXEMM_SMU_ALM6_21_C "project specific calibration data / Project specific calibration data for DFC_MOXEMM_SMU_ALM6_21" VALUE 0x804EE4F1 Val_Wu8 255.0 OneToOne 0.00 255.0 FORMAT "%5.1" /end CHARACTERISTIC
/begin CHARACTERISTIC DFES_MeterOut.DFC_MOXEMM_SMU_ALM6_25_C "project specific calibration data / Project specific calibration data for DFC_MOXEMM_SMU_ALM6_25" VALUE 0x804EE4F2 Val_Wu8 255.0 OneToOne 0.00 255.0 FORMAT "%5.1" /end CHARACTERISTIC
/begin CHARACTERISTIC DFES_MeterOut.DFC_MOXEMM_SMU_ALM6_4_C "project specific calibration data / Project specific calibration data for DFC_MOXEMM_SMU_ALM6_4" VALUE 0x804EE4F3 Val_Wu8 255.0 OneToOne 0.00 255.0 FORMAT "%5.1" /end CHARACTERISTIC
/begin CHARACTERISTIC DFES_MeterOut.DFC_MOXEMM_SMU_ALM6_5_C "project specific calibration data / Project specific calibration data for DFC_MOXEMM_SMU_ALM6_5" VALUE 0x804EE4F4 Val_Wu8 255.0 OneToOne 0.00 255.0 FORMAT "%5.1" /end CHARACTERISTIC
/begin CHARACTERISTIC DFES_MeterOut.DFC_MOXEMM_SMU_ALM6_7_C "project specific calibration data / Project specific calibration data for DFC_MOXEMM_SMU_ALM6_7" VALUE 0x804EE4F5 Val_Wu8 255.0 OneToOne 0.00 255.0 FORMAT "%5.1" /end CHARACTERISTIC
/begin CHARACTERISTIC DFES_MeterOut.DFC_MOXEMM_SMU_ALM6_8_C "project specific calibration data / Project specific calibration data for DFC_MOXEMM_SMU_ALM6_8" VALUE 0x804EE4F6 Val_Wu8 255.0 OneToOne 0.00 255.0 FORMAT "%5.1" /end CHARACTERISTIC
/begin CHARACTERISTIC DFES_MeterOut.DFC_MOXEMM_SMU_ALM7_1_C "project specific calibration data / Project specific calibration data for DFC_MOXEMM_SMU_ALM7_1" VALUE 0x804EE4F7 Val_Wu8 255.0 OneToOne 0.00 255.0 FORMAT "%5.1" /end CHARACTERISTIC
/begin CHARACTERISTIC DFES_MeterOut.DFC_MOXEMM_SMU_ALM7_12_C "project specific calibration data / Project specific calibration data for DFC_MOXEMM_SMU_ALM7_12" VALUE 0x804EE4F8 Val_Wu8 255.0 OneToOne 0.00 255.0 FORMAT "%5.1" /end CHARACTERISTIC
/begin CHARACTERISTIC DFES_MeterOut.DFC_MOXEMM_SMU_ALM7_13_C "project specific calibration data / Project specific calibration data for DFC_MOXEMM_SMU_ALM7_13" VALUE 0x804EE4F9 Val_Wu8 255.0 OneToOne 0.00 255.0 FORMAT "%5.1" /end CHARACTERISTIC
/begin CHARACTERISTIC DFES_MeterOut.DFC_MOXEMM_SMU_ALM7_14_C "project specific calibration data / Project specific calibration data for DFC_MOXEMM_SMU_ALM7_14" VALUE 0x804EE4FA Val_Wu8 255.0 OneToOne 0.00 255.0 FORMAT "%5.1" /end CHARACTERISTIC
/begin CHARACTERISTIC DFES_MeterOut.DFC_MOXEMM_SMU_ALM7_15_C "project specific calibration data / Project specific calibration data for DFC_MOXEMM_SMU_ALM7_15" VALUE 0x804EE4FB Val_Wu8 255.0 OneToOne 0.00 255.0 FORMAT "%5.1" /end CHARACTERISTIC
/begin CHARACTERISTIC DFES_MeterOut.DFC_MOXEMM_SMU_ALM7_16_C "project specific calibration data / Project specific calibration data for DFC_MOXEMM_SMU_ALM7_16" VALUE 0x804EE4FC Val_Wu8 255.0 OneToOne 0.00 255.0 FORMAT "%5.1" /end CHARACTERISTIC
/begin CHARACTERISTIC DFES_MeterOut.DFC_MOXEMM_SMU_ALM7_17_C "project specific calibration data / Project specific calibration data for DFC_MOXEMM_SMU_ALM7_17" VALUE 0x804EE4FD Val_Wu8 255.0 OneToOne 0.00 255.0 FORMAT "%5.1" /end CHARACTERISTIC
/begin CHARACTERISTIC DFES_MeterOut.DFC_MOXEMM_SMU_ALM7_2_C "project specific calibration data / Project specific calibration data for DFC_MOXEMM_SMU_ALM7_2" VALUE 0x804EE4FE Val_Wu8 255.0 OneToOne 0.00 255.0 FORMAT "%5.1" /end CHARACTERISTIC
/begin CHARACTERISTIC DFES_MeterOut.DFC_MOXEMM_SMU_ALM7_20_C "project specific calibration data / Project specific calibration data for DFC_MOXEMM_SMU_ALM7_20" VALUE 0x804EE4FF Val_Wu8 255.0 OneToOne 0.00 255.0 FORMAT "%5.1" /end CHARACTERISTIC
/begin CHARACTERISTIC DFES_MeterOut.DFC_MOXEMM_SMU_ALM7_25_C "project specific calibration data / Project specific calibration data for DFC_MOXEMM_SMU_ALM7_25" VALUE 0x804EE500 Val_Wu8 255.0 OneToOne 0.00 255.0 FORMAT "%5.1" /end CHARACTERISTIC
/begin CHARACTERISTIC DFES_MeterOut.DFC_MOXEMM_SMU_ALM7_26_C "project specific calibration data / Project specific calibration data for DFC_MOXEMM_SMU_ALM7_26" VALUE 0x804EE501 Val_Wu8 255.0 OneToOne 0.00 255.0 FORMAT "%5.1" /end CHARACTERISTIC
/begin CHARACTERISTIC DFES_MeterOut.DFC_MOXEMM_SMU_ALM7_28_C "project specific calibration data / Project specific calibration data for DFC_MOXEMM_SMU_ALM7_28" VALUE 0x804EE502 Val_Wu8 255.0 OneToOne 0.00 255.0 FORMAT "%5.1" /end CHARACTERISTIC
/begin CHARACTERISTIC DFES_MeterOut.DFC_MOXEMM_SMU_ALM7_29_C "project specific calibration data / Project specific calibration data for DFC_MOXEMM_SMU_ALM7_29" VALUE 0x804EE503 Val_Wu8 255.0 OneToOne 0.00 255.0 FORMAT "%5.1" /end CHARACTERISTIC
/begin CHARACTERISTIC DFES_MeterOut.DFC_MOXEMM_SMU_ALM7_30_C "project specific calibration data / Project specific calibration data for DFC_MOXEMM_SMU_ALM7_30" VALUE 0x804EE504 Val_Wu8 255.0 OneToOne 0.00 255.0 FORMAT "%5.1" /end CHARACTERISTIC
/begin CHARACTERISTIC DFES_MeterOut.DFC_MOXEMM_SMU_ALM7_31_C "project specific calibration data / Project specific calibration data for DFC_MOXEMM_SMU_ALM7_31" VALUE 0x804EE505 Val_Wu8 255.0 OneToOne 0.00 255.0 FORMAT "%5.1" /end CHARACTERISTIC
/begin CHARACTERISTIC DFES_MeterOut.DFC_MOXEMM_SMU_ALM8_0_C "project specific calibration data / Project specific calibration data for DFC_MOXEMM_SMU_ALM8_0" VALUE 0x804EE506 Val_Wu8 255.0 OneToOne 0.00 255.0 FORMAT "%5.1" /end CHARACTERISTIC
/begin CHARACTERISTIC DFES_MeterOut.DFC_MOXEMM_SMU_ALM8_1_C "project specific calibration data / Project specific calibration data for DFC_MOXEMM_SMU_ALM8_1" VALUE 0x804EE507 Val_Wu8 255.0 OneToOne 0.00 255.0 FORMAT "%5.1" /end CHARACTERISTIC
/begin CHARACTERISTIC DFES_MeterOut.DFC_MOXEMM_SMU_ALM8_10_C "project specific calibration data / Project specific calibration data for DFC_MOXEMM_SMU_ALM8_10" VALUE 0x804EE508 Val_Wu8 255.0 OneToOne 0.00 255.0 FORMAT "%5.1" /end CHARACTERISTIC
/begin CHARACTERISTIC DFES_MeterOut.DFC_MOXEMM_SMU_ALM8_11_C "project specific calibration data / Project specific calibration data for DFC_MOXEMM_SMU_ALM8_11" VALUE 0x804EE509 Val_Wu8 255.0 OneToOne 0.00 255.0 FORMAT "%5.1" /end CHARACTERISTIC
/begin CHARACTERISTIC DFES_MeterOut.DFC_MOXEMM_SMU_ALM8_12_C "project specific calibration data / Project specific calibration data for DFC_MOXEMM_SMU_ALM8_12" VALUE 0x804EE50A Val_Wu8 255.0 OneToOne 0.00 255.0 FORMAT "%5.1" /end CHARACTERISTIC
/begin CHARACTERISTIC DFES_MeterOut.DFC_MOXEMM_SMU_ALM8_16_C "project specific calibration data / Project specific calibration data for DFC_MOXEMM_SMU_ALM8_16" VALUE 0x804EE50B Val_Wu8 255.0 OneToOne 0.00 255.0 FORMAT "%5.1" /end CHARACTERISTIC
/begin CHARACTERISTIC DFES_MeterOut.DFC_MOXEMM_SMU_ALM8_18_C "project specific calibration data / Project specific calibration data for DFC_MOXEMM_SMU_ALM8_18" VALUE 0x804EE50C Val_Wu8 255.0 OneToOne 0.00 255.0 FORMAT "%5.1" /end CHARACTERISTIC
/begin CHARACTERISTIC DFES_MeterOut.DFC_MOXEMM_SMU_ALM8_2_C "project specific calibration data / Project specific calibration data for DFC_MOXEMM_SMU_ALM8_2" VALUE 0x804EE50D Val_Wu8 255.0 OneToOne 0.00 255.0 FORMAT "%5.1" /end CHARACTERISTIC
/begin CHARACTERISTIC DFES_MeterOut.DFC_MOXEMM_SMU_ALM8_3_C "project specific calibration data / Project specific calibration data for DFC_MOXEMM_SMU_ALM8_3" VALUE 0x804EE50E Val_Wu8 255.0 OneToOne 0.00 255.0 FORMAT "%5.1" /end CHARACTERISTIC
/begin CHARACTERISTIC DFES_MeterOut.DFC_MOXEMM_SMU_ALM8_31_C "project specific calibration data / Project specific calibration data for DFC_MOXEMM_SMU_ALM8_31" VALUE 0x804EE50F Val_Wu8 255.0 OneToOne 0.00 255.0 FORMAT "%5.1" /end CHARACTERISTIC
/begin CHARACTERISTIC DFES_MeterOut.DFC_MOXEMM_SMU_ALM8_4_C "project specific calibration data / Project specific calibration data for DFC_MOXEMM_SMU_ALM8_4" VALUE 0x804EE510 Val_Wu8 255.0 OneToOne 0.00 255.0 FORMAT "%5.1" /end CHARACTERISTIC
/begin CHARACTERISTIC DFES_MeterOut.DFC_MOXEMM_SMU_ALM9_0_C "project specific calibration data / Project specific calibration data for DFC_MOXEMM_SMU_ALM9_0" VALUE 0x804EE511 Val_Wu8 255.0 OneToOne 0.00 255.0 FORMAT "%5.1" /end CHARACTERISTIC
/begin CHARACTERISTIC DFES_MeterOut.DFC_MOXEMM_SMU_ALM9_15_C "project specific calibration data / Project specific calibration data for DFC_MOXEMM_SMU_ALM9_15" VALUE 0x804EE512 Val_Wu8 255.0 OneToOne 0.00 255.0 FORMAT "%5.1" /end CHARACTERISTIC
/begin CHARACTERISTIC DFES_MeterOut.DFC_MOXEMM_SMU_ALM9_3_C "project specific calibration data / Project specific calibration data for DFC_MOXEMM_SMU_ALM9_3" VALUE 0x804EE513 Val_Wu8 255.0 OneToOne 0.00 255.0 FORMAT "%5.1" /end CHARACTERISTIC
/begin CHARACTERISTIC DFES_MeterOut.DFC_MoCADCNTP_C "project specific calibration data / Project specific calibration data for DFC_MoCADCNTP" VALUE 0x804EE514 Val_Wu8 255.0 OneToOne 0.00 255.0 FORMAT "%5.1" /end CHARACTERISTIC
/begin CHARACTERISTIC DFES_MeterOut.DFC_MoCADCTst_C "project specific calibration data / Project specific calibration data for DFC_MoCADCTst" VALUE 0x804EE515 Val_Wu8 255.0 OneToOne 0.00 255.0 FORMAT "%5.1" /end CHARACTERISTIC
/begin CHARACTERISTIC DFES_MeterOut.DFC_MoCSOPICO_C "project specific calibration data / Project specific calibration data for DFC_MoCSOPICO" VALUE 0x804EE516 Val_Wu8 255.0 OneToOne 0.00 255.0 FORMAT "%5.1" /end CHARACTERISTIC
/begin CHARACTERISTIC DFES_MeterOut.DFC_MoFAPP_C "project specific calibration data / Project specific calibration data for DFC_MoFAPP" VALUE 0x804EE517 Val_Wu8 255.0 OneToOne 0.00 255.0 FORMAT "%5.1" /end CHARACTERISTIC
/begin CHARACTERISTIC DFES_MeterOut.DFC_MoFAirFilgPrdc_C "project specific calibration data / Project specific calibration data for DFC_MoFAirFilgPrdc" VALUE 0x804EE518 Val_Wu8 255.0 OneToOne 0.00 255.0 FORMAT "%5.1" /end CHARACTERISTIC
/begin CHARACTERISTIC DFES_MeterOut.DFC_MoFAirFlCtOffPfi_C "project specific calibration data / Project specific calibration data for DFC_MoFAirFlCtOffPfi" VALUE 0x804EE519 Val_Wu8 255.0 OneToOne 0.00 255.0 FORMAT "%5.1" /end CHARACTERISTIC
/begin CHARACTERISTIC DFES_MeterOut.DFC_MoFAirFlCylPfi_C "project specific calibration data / Project specific calibration data for DFC_MoFAirFlCylPfi" VALUE 0x804EE51A Val_Wu8 255.0 OneToOne 0.00 255.0 FORMAT "%5.1" /end CHARACTERISTIC
/begin CHARACTERISTIC DFES_MeterOut.DFC_MoFAirFlIn_C "project specific calibration data / Project specific calibration data for DFC_MoFAirFlIn" VALUE 0x804EE51B Val_Wu8 255.0 OneToOne 0.00 255.0 FORMAT "%5.1" /end CHARACTERISTIC
/begin CHARACTERISTIC DFES_MeterOut.DFC_MoFAirFlMixCtlPfiChkAirFl_C "project specific calibration data / Project specific calibration data for DFC_MoFAirFlMixCtlPfiChkAirFl" VALUE 0x804EE51C Val_Wu8 255.0 OneToOne 0.00 255.0 FORMAT "%5.1" /end CHARACTERISTIC
/begin CHARACTERISTIC DFES_MeterOut.DFC_MoFAirFlMixCtlPfiChkCtrl_C "project specific calibration data / Project specific calibration data for DFC_MoFAirFlMixCtlPfiChkCtrl" VALUE 0x804EE51D Val_Wu8 255.0 OneToOne 0.00 255.0 FORMAT "%5.1" /end CHARACTERISTIC
/begin CHARACTERISTIC DFES_MeterOut.DFC_MoFAirFlMode_C "project specific calibration data / Project specific calibration data for DFC_MoFAirFlMode" VALUE 0x804EE51E Val_Wu8 255.0 OneToOne 0.00 255.0 FORMAT "%5.1" /end CHARACTERISTIC
/begin CHARACTERISTIC DFES_MeterOut.DFC_MoFESpd_C "project specific calibration data / Project specific calibration data for DFC_MoFESpd" VALUE 0x804EE51F Val_Wu8 255.0 OneToOne 0.00 255.0 FORMAT "%5.1" /end CHARACTERISTIC
/begin CHARACTERISTIC DFES_MeterOut.DFC_MoFIACo_C "project specific calibration data / Project specific calibration data for DFC_MoFIACo" VALUE 0x804EE520 Val_Wu8 255.0 OneToOne 0.00 255.0 FORMAT "%5.1" /end CHARACTERISTIC
/begin CHARACTERISTIC DFES_MeterOut.DFC_MoFICOL1_C "project specific calibration data / Project specific calibration data for DFC_MoFICOL1" VALUE 0x804EE521 Val_Wu8 255.0 OneToOne 0.00 255.0 FORMAT "%5.1" /end CHARACTERISTIC
/begin CHARACTERISTIC DFES_MeterOut.DFC_MoFICOL2_C "project specific calibration data / Project specific calibration data for DFC_MoFICOL2" VALUE 0x804EE522 Val_Wu8 255.0 OneToOne 0.00 255.0 FORMAT "%5.1" /end CHARACTERISTIC
/begin CHARACTERISTIC DFES_MeterOut.DFC_MoFStrt_C "project specific calibration data / Project specific calibration data for DFC_MoFStrt" VALUE 0x804EE523 Val_Wu8 255.0 OneToOne 0.00 255.0 FORMAT "%5.1" /end CHARACTERISTIC
/begin CHARACTERISTIC DFES_MeterOut.DFC_MoFTrqCmp_C "project specific calibration data / Project specific calibration data for DFC_MoFTrqCmp" VALUE 0x804EE524 Val_Wu8 255.0 OneToOne 0.00 255.0 FORMAT "%5.1" /end CHARACTERISTIC
/begin CHARACTERISTIC DFES_MeterOut.DFC_MoFTrqCmpMax_C "project specific calibration data / Project specific calibration data for DFC_MoFTrqCmpMax" VALUE 0x804EE525 Val_Wu8 255.0 OneToOne 0.00 255.0 FORMAT "%5.1" /end CHARACTERISTIC
/begin CHARACTERISTIC DFES_MeterOut.DFC_MoFTrqCmpMin_C "project specific calibration data / Project specific calibration data for DFC_MoFTrqCmpMin" VALUE 0x804EE526 Val_Wu8 255.0 OneToOne 0.00 255.0 FORMAT "%5.1" /end CHARACTERISTIC
/begin CHARACTERISTIC DFES_MeterOut.DFC_MoFVarPostBldSel_C "project specific calibration data / Project specific calibration data for DFC_MoFVarPostBldSel" VALUE 0x804EE527 Val_Wu8 255.0 OneToOne 0.00 255.0 FORMAT "%5.1" /end CHARACTERISTIC
/begin CHARACTERISTIC DFES_MeterOut.DFC_MoXEMMHwLTMCUFW_C "project specific calibration data / Project specific calibration data for DFC_MoXEMMHwLTMCUFW" VALUE 0x804EE528 Val_Wu8 255.0 OneToOne 0.00 255.0 FORMAT "%5.1" /end CHARACTERISTIC
/begin CHARACTERISTIC DFES_MeterOut.DFC_MoXEMMHwLTMonBIST_C "project specific calibration data / Project specific calibration data for DFC_MoXEMMHwLTMonBIST" VALUE 0x804EE529 Val_Wu8 255.0 OneToOne 0.00 255.0 FORMAT "%5.1" /end CHARACTERISTIC
/begin CHARACTERISTIC DFES_MeterOut.DFC_MoXEMMHwLTRegMonTest_C "project specific calibration data / Project specific calibration data for DFC_MoXEMMHwLTRegMonTest" VALUE 0x804EE52A Val_Wu8 255.0 OneToOne 0.00 255.0 FORMAT "%5.1" /end CHARACTERISTIC
/begin CHARACTERISTIC DFES_MeterOut.DFC_MoXEMMHwLTStbySMUAlvTest_C "project specific calibration data / Project specific calibration data for DFC_MoXEMMHwLTStbySMUAlvTest" VALUE 0x804EE52B Val_Wu8 255.0 OneToOne 0.00 255.0 FORMAT "%5.1" /end CHARACTERISTIC
/begin CHARACTERISTIC DFES_MeterOut.DFC_MoXEMMHwLTTempSens_C "project specific calibration data / Project specific calibration data for DFC_MoXEMMHwLTTempSens" VALUE 0x804EE52C Val_Wu8 255.0 OneToOne 0.00 255.0 FORMAT "%5.1" /end CHARACTERISTIC
/begin CHARACTERISTIC DFES_MeterOut.DFC_MoXEMMHwLTUCBCfg_C "project specific calibration data / Project specific calibration data for DFC_MoXEMMHwLTUCBCfg" VALUE 0x804EE52D Val_Wu8 255.0 OneToOne 0.00 255.0 FORMAT "%5.1" /end CHARACTERISTIC
/begin CHARACTERISTIC DFES_MeterOut.DFC_OCWDAABEActv_C "project specific calibration data / Project specific calibration data for DFC_OCWDAABEActv" VALUE 0x804EE52E Val_Wu8 255.0 OneToOne 0.00 255.0 FORMAT "%5.1" /end CHARACTERISTIC
/begin CHARACTERISTIC DFES_MeterOut.DFC_OCWDACom_C "project specific calibration data / Project specific calibration data for DFC_OCWDACom" VALUE 0x804EE52F Val_Wu8 255.0 OneToOne 0.00 255.0 FORMAT "%5.1" /end CHARACTERISTIC
/begin CHARACTERISTIC DFES_MeterOut.DFC_OCWDAErrPin_C "project specific calibration data / Project specific calibration data for DFC_OCWDAErrPin" VALUE 0x804EE530 Val_Wu8 255.0 OneToOne 0.00 255.0 FORMAT "%5.1" /end CHARACTERISTIC
/begin CHARACTERISTIC DFES_MeterOut.DFC_OCWDAOvrVltg_C "project specific calibration data / Project specific calibration data for DFC_OCWDAOvrVltg" VALUE 0x804EE531 Val_Wu8 255.0 OneToOne 0.00 255.0 FORMAT "%5.1" /end CHARACTERISTIC
/begin CHARACTERISTIC DFES_MeterOut.DFC_ORAmax_C "project specific calibration data / Project specific calibration data for DFC_ORAmax" VALUE 0x804EE532 Val_Wu8 255.0 OneToOne 0.00 255.0 FORMAT "%5.1" /end CHARACTERISTIC
/begin CHARACTERISTIC DFES_MeterOut.DFC_ORAmin_C "project specific calibration data / Project specific calibration data for DFC_ORAmin" VALUE 0x804EE533 Val_Wu8 255.0 OneToOne 0.00 255.0 FORMAT "%5.1" /end CHARACTERISTIC
/begin CHARACTERISTIC DFES_MeterOut.DFC_PLLSUmax_C "project specific calibration data / Project specific calibration data for DFC_PLLSUmax" VALUE 0x804EE534 Val_Wu8 255.0 OneToOne 0.00 255.0 FORMAT "%5.1" /end CHARACTERISTIC
/begin CHARACTERISTIC DFES_MeterOut.DFC_PLLSUmin_C "project specific calibration data / Project specific calibration data for DFC_PLLSUmin" VALUE 0x804EE535 Val_Wu8 255.0 OneToOne 0.00 255.0 FORMAT "%5.1" /end CHARACTERISTIC
/begin CHARACTERISTIC DFES_MeterOut.DFC_PSR1max_C "project specific calibration data / Project specific calibration data for DFC_PSR1max" VALUE 0x804EE536 Val_Wu8 255.0 OneToOne 0.00 255.0 FORMAT "%5.1" /end CHARACTERISTIC
/begin CHARACTERISTIC DFES_MeterOut.DFC_PSRBmax_C "project specific calibration data / Project specific calibration data for DFC_PSRBmax" VALUE 0x804EE537 Val_Wu8 255.0 OneToOne 0.00 255.0 FORMAT "%5.1" /end CHARACTERISTIC
/begin CHARACTERISTIC DFES_MeterOut.DFC_PSRBmin_C "project specific calibration data / Project specific calibration data for DFC_PSRBmin" VALUE 0x804EE538 Val_Wu8 255.0 OneToOne 0.00 255.0 FORMAT "%5.1" /end CHARACTERISTIC
/begin CHARACTERISTIC DFES_MeterOut.DFC_PSRPmax_C "project specific calibration data / Project specific calibration data for DFC_PSRPmax" VALUE 0x804EE539 Val_Wu8 255.0 OneToOne 0.00 255.0 FORMAT "%5.1" /end CHARACTERISTIC
/begin CHARACTERISTIC DFES_MeterOut.DFC_PSRPmin_C "project specific calibration data / Project specific calibration data for DFC_PSRPmin" VALUE 0x804EE53A Val_Wu8 255.0 OneToOne 0.00 255.0 FORMAT "%5.1" /end CHARACTERISTIC
/begin CHARACTERISTIC DFES_MeterOut.DFC_PSRPsig_C "project specific calibration data / Project specific calibration data for DFC_PSRPsig" VALUE 0x804EE53B Val_Wu8 255.0 OneToOne 0.00 255.0 FORMAT "%5.1" /end CHARACTERISTIC
/begin CHARACTERISTIC DFES_MeterOut.DFC_PSRmax_C "project specific calibration data / Project specific calibration data for DFC_PSRmax" VALUE 0x804EE53C Val_Wu8 255.0 OneToOne 0.00 255.0 FORMAT "%5.1" /end CHARACTERISTIC
/begin CHARACTERISTIC DFES_MeterOut.DFC_PUmax_C "project specific calibration data / Project specific calibration data for DFC_PUmax" VALUE 0x804EE53D Val_Wu8 255.0 OneToOne 0.00 255.0 FORMAT "%5.1" /end CHARACTERISTIC
/begin CHARACTERISTIC DFES_MeterOut.DFC_P_VSE11_OL_C "project specific calibration data / Project specific calibration data for DFC_P_VSE11_OL" VALUE 0x804EE53E Val_Wu8 255.0 OneToOne 0.00 255.0 FORMAT "%5.1" /end CHARACTERISTIC
/begin CHARACTERISTIC DFES_MeterOut.DFC_P_VSE11_SCB_C "project specific calibration data / Project specific calibration data for DFC_P_VSE11_SCB" VALUE 0x804EE53F Val_Wu8 255.0 OneToOne 0.00 255.0 FORMAT "%5.1" /end CHARACTERISTIC
/begin CHARACTERISTIC DFES_MeterOut.DFC_P_VSE11_SCG_C "project specific calibration data / Project specific calibration data for DFC_P_VSE11_SCG" VALUE 0x804EE540 Val_Wu8 255.0 OneToOne 0.00 255.0 FORMAT "%5.1" /end CHARACTERISTIC
/begin CHARACTERISTIC DFES_MeterOut.DFC_PhyHighAPP1_C "project specific calibration data / Project specific calibration data for DFC_PhyHighAPP1" VALUE 0x804EE541 Val_Wu8 255.0 OneToOne 0.00 255.0 FORMAT "%5.1" /end CHARACTERISTIC
/begin CHARACTERISTIC DFES_MeterOut.DFC_PhyHighAPP2_C "project specific calibration data / Project specific calibration data for DFC_PhyHighAPP2" VALUE 0x804EE542 Val_Wu8 255.0 OneToOne 0.00 255.0 FORMAT "%5.1" /end CHARACTERISTIC
/begin CHARACTERISTIC DFES_MeterOut.DFC_PhyLowAPP1_C "project specific calibration data / Project specific calibration data for DFC_PhyLowAPP1" VALUE 0x804EE543 Val_Wu8 255.0 OneToOne 0.00 255.0 FORMAT "%5.1" /end CHARACTERISTIC
/begin CHARACTERISTIC DFES_MeterOut.DFC_PhyLowAPP2_C "project specific calibration data / Project specific calibration data for DFC_PhyLowAPP2" VALUE 0x804EE544 Val_Wu8 255.0 OneToOne 0.00 255.0 FORMAT "%5.1" /end CHARACTERISTIC
/begin CHARACTERISTIC DFES_MeterOut.DFC_SRCHighAPP1_C "project specific calibration data / Project specific calibration data for DFC_SRCHighAPP1" VALUE 0x804EE545 Val_Wu8 255.0 OneToOne 0.00 255.0 FORMAT "%5.1" /end CHARACTERISTIC
/begin CHARACTERISTIC DFES_MeterOut.DFC_SRCHighAPP2_C "project specific calibration data / Project specific calibration data for DFC_SRCHighAPP2" VALUE 0x804EE546 Val_Wu8 255.0 OneToOne 0.00 255.0 FORMAT "%5.1" /end CHARACTERISTIC
/begin CHARACTERISTIC DFES_MeterOut.DFC_SRCLowAPP1_C "project specific calibration data / Project specific calibration data for DFC_SRCLowAPP1" VALUE 0x804EE547 Val_Wu8 255.0 OneToOne 0.00 255.0 FORMAT "%5.1" /end CHARACTERISTIC
/begin CHARACTERISTIC DFES_MeterOut.DFC_SRCLowAPP2_C "project specific calibration data / Project specific calibration data for DFC_SRCLowAPP2" VALUE 0x804EE548 Val_Wu8 255.0 OneToOne 0.00 255.0 FORMAT "%5.1" /end CHARACTERISTIC
/begin CHARACTERISTIC DFES_MeterOut.DFC_SSpMon2_C "project specific calibration data / Project specific calibration data for DFC_SSpMon2" VALUE 0x804EE549 Val_Wu8 255.0 OneToOne 0.00 255.0 FORMAT "%5.1" /end CHARACTERISTIC
/begin CHARACTERISTIC DFES_MeterOut.DFC_SWReset_0_C "project specific calibration data / Project specific calibration data for DFC_SWReset_0" VALUE 0x804EE54A Val_Wu8 255.0 OneToOne 0.00 255.0 FORMAT "%5.1" /end CHARACTERISTIC
/begin CHARACTERISTIC DFES_MeterOut.DFC_SWReset_1_C "project specific calibration data / Project specific calibration data for DFC_SWReset_1" VALUE 0x804EE54B Val_Wu8 255.0 OneToOne 0.00 255.0 FORMAT "%5.1" /end CHARACTERISTIC
/begin CHARACTERISTIC DFES_MeterOut.DFC_SWReset_2_C "project specific calibration data / Project specific calibration data for DFC_SWReset_2" VALUE 0x804EE54C Val_Wu8 255.0 OneToOne 0.00 255.0 FORMAT "%5.1" /end CHARACTERISTIC
/begin CHARACTERISTIC DFES_MeterOut.DFC_SyncAPP_C "project specific calibration data / Project specific calibration data for DFC_SyncAPP" VALUE 0x804EE54D Val_Wu8 255.0 OneToOne 0.00 255.0 FORMAT "%5.1" /end CHARACTERISTIC
/begin CHARACTERISTIC DFES_MeterOut.DFC_TAmax_Dummy_C "project specific calibration data / Project specific calibration data for DFC_TAmax_Dummy" VALUE 0x804EE54E Val_Wu8 255.0 OneToOne 0.00 255.0 FORMAT "%5.1" /end CHARACTERISTIC
/begin CHARACTERISTIC DFES_MeterOut.DFC_TKAEmax_C "project specific calibration data / Project specific calibration data for DFC_TKAEmax" VALUE 0x804EE54F Val_Wu8 255.0 OneToOne 0.00 255.0 FORMAT "%5.1" /end CHARACTERISTIC
/begin CHARACTERISTIC DFES_MeterOut.DFC_TKAEmin_C "project specific calibration data / Project specific calibration data for DFC_TKAEmin" VALUE 0x804EE550 Val_Wu8 255.0 OneToOne 0.00 255.0 FORMAT "%5.1" /end CHARACTERISTIC
/begin CHARACTERISTIC DFES_MeterOut.DFC_TKARmax_C "project specific calibration data / Project specific calibration data for DFC_TKARmax" VALUE 0x804EE551 Val_Wu8 255.0 OneToOne 0.00 255.0 FORMAT "%5.1" /end CHARACTERISTIC
/begin CHARACTERISTIC DFES_MeterOut.DFC_TKARnpl_C "project specific calibration data / Project specific calibration data for DFC_TKARnpl" VALUE 0x804EE552 Val_Wu8 255.0 OneToOne 0.00 255.0 FORMAT "%5.1" /end CHARACTERISTIC
/begin CHARACTERISTIC DFES_MeterOut.DFC_TMmax_Dummy_C "project specific calibration data / Project specific calibration data for DFC_TMmax_Dummy" VALUE 0x804EE553 Val_Wu8 255.0 OneToOne 0.00 255.0 FORMAT "%5.1" /end CHARACTERISTIC
/begin CHARACTERISTIC DFES_MeterOut.DFC_TUMmax_Dummy_C "project specific calibration data / Project specific calibration data for DFC_TUMmax_Dummy" VALUE 0x804EE554 Val_Wu8 255.0 OneToOne 0.00 255.0 FORMAT "%5.1" /end CHARACTERISTIC
/begin CHARACTERISTIC DFES_MeterOut.DFC_TWCDPriCatB1_C "project specific calibration data / Project specific calibration data for DFC_TWCDPriCatB1" VALUE 0x804EE555 Val_Wu8 255.0 OneToOne 0.00 255.0 FORMAT "%5.1" /end CHARACTERISTIC
/begin CHARACTERISTIC DFES_MeterOut.DFC_ThrVlvClsdPosnFirstOffsLrnImpoB1_C "project specific calibration data / Project specific calibration data for DFC_ThrVlvClsdPosnFirstOffsLrnImpoB1" VALUE 0x804EE556 Val_Wu8 255.0 OneToOne 0.00 255.0 FORMAT "%5.1" /end CHARACTERISTIC
/begin CHARACTERISTIC DFES_MeterOut.DFC_ThrVlvClsdPosnOffsLrnImpoB1_C "project specific calibration data / Project specific calibration data for DFC_ThrVlvClsdPosnOffsLrnImpoB1" VALUE 0x804EE557 Val_Wu8 255.0 OneToOne 0.00 255.0 FORMAT "%5.1" /end CHARACTERISTIC
/begin CHARACTERISTIC DFES_MeterOut.DFC_ThrVlvClsdPosnOffsLrnMaxB1_C "project specific calibration data / Project specific calibration data for DFC_ThrVlvClsdPosnOffsLrnMaxB1" VALUE 0x804EE558 Val_Wu8 255.0 OneToOne 0.00 255.0 FORMAT "%5.1" /end CHARACTERISTIC
/begin CHARACTERISTIC DFES_MeterOut.DFC_ThrVlvClsdPosnOffsLrnMinB1_C "project specific calibration data / Project specific calibration data for DFC_ThrVlvClsdPosnOffsLrnMinB1" VALUE 0x804EE559 Val_Wu8 255.0 OneToOne 0.00 255.0 FORMAT "%5.1" /end CHARACTERISTIC
/begin CHARACTERISTIC DFES_MeterOut.DFC_ThrVlvCtrlDeB1_C "project specific calibration data / Project specific calibration data for DFC_ThrVlvCtrlDeB1" VALUE 0x804EE55A Val_Wu8 255.0 OneToOne 0.00 255.0 FORMAT "%5.1" /end CHARACTERISTIC
/begin CHARACTERISTIC DFES_MeterOut.DFC_ThrVlvDycB1_C "project specific calibration data / Project specific calibration data for DFC_ThrVlvDycB1" VALUE 0x804EE55B Val_Wu8 255.0 OneToOne 0.00 255.0 FORMAT "%5.1" /end CHARACTERISTIC
/begin CHARACTERISTIC DFES_MeterOut.DFC_ThrVlvLimpAirPosnMaxAbsltDriftB1_C "project specific calibration data / Project specific calibration data for DFC_ThrVlvLimpAirPosnMaxAbsltDriftB1" VALUE 0x804EE55C Val_Wu8 255.0 OneToOne 0.00 255.0 FORMAT "%5.1" /end CHARACTERISTIC
/begin CHARACTERISTIC DFES_MeterOut.DFC_ThrVlvLimpAirPosnMaxB1_C "project specific calibration data / Project specific calibration data for DFC_ThrVlvLimpAirPosnMaxB1" VALUE 0x804EE55D Val_Wu8 255.0 OneToOne 0.00 255.0 FORMAT "%5.1" /end CHARACTERISTIC
/begin CHARACTERISTIC DFES_MeterOut.DFC_ThrVlvLimpAirPosnMaxRelDriftB1_C "project specific calibration data / Project specific calibration data for DFC_ThrVlvLimpAirPosnMaxRelDriftB1" VALUE 0x804EE55E Val_Wu8 255.0 OneToOne 0.00 255.0 FORMAT "%5.1" /end CHARACTERISTIC
/begin CHARACTERISTIC DFES_MeterOut.DFC_ThrVlvLimpAirPosnMinB1_C "project specific calibration data / Project specific calibration data for DFC_ThrVlvLimpAirPosnMinB1" VALUE 0x804EE55F Val_Wu8 255.0 OneToOne 0.00 255.0 FORMAT "%5.1" /end CHARACTERISTIC
/begin CHARACTERISTIC DFES_MeterOut.DFC_ThrVlvOpenLoadB1_C "project specific calibration data / Project specific calibration data for DFC_ThrVlvOpenLoadB1" VALUE 0x804EE560 Val_Wu8 255.0 OneToOne 0.00 255.0 FORMAT "%5.1" /end CHARACTERISTIC
/begin CHARACTERISTIC DFES_MeterOut.DFC_ThrVlvOpenSprgB1_C "project specific calibration data / Project specific calibration data for DFC_ThrVlvOpenSprgB1" VALUE 0x804EE561 Val_Wu8 255.0 OneToOne 0.00 255.0 FORMAT "%5.1" /end CHARACTERISTIC
/begin CHARACTERISTIC DFES_MeterOut.DFC_ThrVlvOpenSprgSprdB1_C "project specific calibration data / Project specific calibration data for DFC_ThrVlvOpenSprgSprdB1" VALUE 0x804EE562 Val_Wu8 255.0 OneToOne 0.00 255.0 FORMAT "%5.1" /end CHARACTERISTIC
/begin CHARACTERISTIC DFES_MeterOut.DFC_ThrVlvOpenSprgTwnB1_C "project specific calibration data / Project specific calibration data for DFC_ThrVlvOpenSprgTwnB1" VALUE 0x804EE563 Val_Wu8 255.0 OneToOne 0.00 255.0 FORMAT "%5.1" /end CHARACTERISTIC
/begin CHARACTERISTIC DFES_MeterOut.DFC_ThrVlvOverTB1_C "project specific calibration data / Project specific calibration data for DFC_ThrVlvOverTB1" VALUE 0x804EE564 Val_Wu8 255.0 OneToOne 0.00 255.0 FORMAT "%5.1" /end CHARACTERISTIC
/begin CHARACTERISTIC DFES_MeterOut.DFC_ThrVlvRetSprgB1_C "project specific calibration data / Project specific calibration data for DFC_ThrVlvRetSprgB1" VALUE 0x804EE565 Val_Wu8 255.0 OneToOne 0.00 255.0 FORMAT "%5.1" /end CHARACTERISTIC
/begin CHARACTERISTIC DFES_MeterOut.DFC_ThrVlvRetSprgSprdB1_C "project specific calibration data / Project specific calibration data for DFC_ThrVlvRetSprgSprdB1" VALUE 0x804EE566 Val_Wu8 255.0 OneToOne 0.00 255.0 FORMAT "%5.1" /end CHARACTERISTIC
/begin CHARACTERISTIC DFES_MeterOut.DFC_ThrVlvRetSprgTwnB1_C "project specific calibration data / Project specific calibration data for DFC_ThrVlvRetSprgTwnB1" VALUE 0x804EE567 Val_Wu8 255.0 OneToOne 0.00 255.0 FORMAT "%5.1" /end CHARACTERISTIC
/begin CHARACTERISTIC DFES_MeterOut.DFC_ThrVlvSens1MaxB1_C "project specific calibration data / Project specific calibration data for DFC_ThrVlvSens1MaxB1" VALUE 0x804EE568 Val_Wu8 255.0 OneToOne 0.00 255.0 FORMAT "%5.1" /end CHARACTERISTIC
/begin CHARACTERISTIC DFES_MeterOut.DFC_ThrVlvSens1NplB1_C "project specific calibration data / Project specific calibration data for DFC_ThrVlvSens1NplB1" VALUE 0x804EE569 Val_Wu8 255.0 OneToOne 0.00 255.0 FORMAT "%5.1" /end CHARACTERISTIC
/begin CHARACTERISTIC DFES_MeterOut.DFC_ThrVlvSens2MaxB1_C "project specific calibration data / Project specific calibration data for DFC_ThrVlvSens2MaxB1" VALUE 0x804EE56A Val_Wu8 255.0 OneToOne 0.00 255.0 FORMAT "%5.1" /end CHARACTERISTIC
/begin CHARACTERISTIC DFES_MeterOut.DFC_ThrVlvSens2MinB1_C "project specific calibration data / Project specific calibration data for DFC_ThrVlvSens2MinB1" VALUE 0x804EE56B Val_Wu8 255.0 OneToOne 0.00 255.0 FORMAT "%5.1" /end CHARACTERISTIC
/begin CHARACTERISTIC DFES_MeterOut.DFC_ThrVlvSens2NplB1_C "project specific calibration data / Project specific calibration data for DFC_ThrVlvSens2NplB1" VALUE 0x804EE56C Val_Wu8 255.0 OneToOne 0.00 255.0 FORMAT "%5.1" /end CHARACTERISTIC
/begin CHARACTERISTIC DFES_MeterOut.DFC_ThrVlvShoCircB1_C "project specific calibration data / Project specific calibration data for DFC_ThrVlvShoCircB1" VALUE 0x804EE56D Val_Wu8 255.0 OneToOne 0.00 255.0 FORMAT "%5.1" /end CHARACTERISTIC
/begin CHARACTERISTIC DFES_MeterOut.DFC_ThrVlvSpiErrB1_C "project specific calibration data / Project specific calibration data for DFC_ThrVlvSpiErrB1" VALUE 0x804EE56E Val_Wu8 255.0 OneToOne 0.00 255.0 FORMAT "%5.1" /end CHARACTERISTIC
/begin CHARACTERISTIC DFES_MeterOut.DFC_ThrvlvSens1MinB1_C "project specific calibration data / Project specific calibration data for DFC_ThrvlvSens1MinB1" VALUE 0x804EE56F Val_Wu8 255.0 OneToOne 0.00 255.0 FORMAT "%5.1" /end CHARACTERISTIC
/begin CHARACTERISTIC DFES_MeterOut.DFC_TiOffTBasdChkFast_C "project specific calibration data / Project specific calibration data for DFC_TiOffTBasdChkFast" VALUE 0x804EE570 Val_Wu8 255.0 OneToOne 0.00 255.0 FORMAT "%5.1" /end CHARACTERISTIC
/begin CHARACTERISTIC DFES_MeterOut.DFC_TiOffTBasdChkSlow_C "project specific calibration data / Project specific calibration data for DFC_TiOffTBasdChkSlow" VALUE 0x804EE571 Val_Wu8 255.0 OneToOne 0.00 255.0 FORMAT "%5.1" /end CHARACTERISTIC
/begin CHARACTERISTIC DFES_MeterOut.DFC_UEGOHeatrCtlS1B1_C "project specific calibration data / Project specific calibration data for DFC_UEGOHeatrCtlS1B1" VALUE 0x804EE572 Val_Wu8 255.0 OneToOne 0.00 255.0 FORMAT "%5.1" /end CHARACTERISTIC
/begin CHARACTERISTIC DFES_MeterOut.DFC_UEGOSnsrMntdS1B1_C "project specific calibration data / Project specific calibration data for DFC_UEGOSnsrMntdS1B1" VALUE 0x804EE573 Val_Wu8 255.0 OneToOne 0.00 255.0 FORMAT "%5.1" /end CHARACTERISTIC
/begin CHARACTERISTIC DFES_MeterOut.DFC_VehVSig_C "project specific calibration data / Project specific calibration data for DFC_VehVSig" VALUE 0x804EE574 Val_Wu8 255.0 OneToOne 0.00 255.0 FORMAT "%5.1" /end CHARACTERISTIC
/begin CHARACTERISTIC DFES_MeterOut.DFC_VlvLftFbSwtIntk11SpclFail_C "project specific calibration data / Project specific calibration data for DFC_VlvLftFbSwtIntk11SpclFail" VALUE 0x804EE575 Val_Wu8 255.0 OneToOne 0.00 255.0 FORMAT "%5.1" /end CHARACTERISTIC
/begin CHARACTERISTIC DFES_MeterOut.DFC_VlvLftFbSwtIntk11StdFail_C "project specific calibration data / Project specific calibration data for DFC_VlvLftFbSwtIntk11StdFail" VALUE 0x804EE576 Val_Wu8 255.0 OneToOne 0.00 255.0 FORMAT "%5.1" /end CHARACTERISTIC
/begin CHARACTERISTIC DSM_uDisblBattHiHysL_C "Left value of hysteresis threshold for resetting the voltage disable condition (high voltage)." VALUE 0x8053AC62 Val_Ws16 1310700. Volt_Batt -655360.0 655340.0 FORMAT "%8.1" /end CHARACTERISTIC
/begin CHARACTERISTIC DSM_uDisblBattHiHysR_C "Right value of hysteresis threshold for resetting the voltage disable condition (high voltage)." VALUE 0x8053AC64 Val_Ws16 1310700. Volt_Batt -655360.0 655340.0 FORMAT "%8.1" /end CHARACTERISTIC
/begin CHARACTERISTIC DSM_uDisblBattLoHysL_C "Left value of hysteresis threshold for resetting the voltage disable condition (low voltage)." VALUE 0x8053AC66 Val_Ws16 1310700. Volt_Batt -655360.0 655340.0 FORMAT "%8.1" /end CHARACTERISTIC
/begin CHARACTERISTIC DSM_uDisblBattLoHysR_C "Right value of hysteresis threshold for resetting the voltage disable condition (low voltage)." VALUE 0x8053AC68 Val_Ws16 1310700. Volt_Batt -655360.0 655340.0 FORMAT "%8.1" /end CHARACTERISTIC
/begin MEASUREMENT DSMConf_DFCSrv7VisClrSt "DFC and Service 7 Visibility infomation clear status" UBYTE OneToOne 1 100 0.00 255.0 FORMAT "%5.1" ECU_ADDRESS 0x6000A3C6 /end MEASUREMENT
/begin MEASUREMENT DSM_bInstableStatus "DSM internal variable to store the copy of the unstable operation mode (provided by DSM configuration)" UBYTE OneToOne 1 100 0.00 255.0 BIT_MASK 0x1 FORMAT "%5.1" ECU_ADDRESS 0x6000AA4E /end MEASUREMENT
/begin MEASUREMENT DSM_bStFuncTst "DSM internal variable to store the copy of the function test requested (provided by DSM configuration)" UBYTE OneToOne 1 100 0.00 255.0 FORMAT "%5.1" ECU_ADDRESS 0x6000E3CF /end MEASUREMENT
/begin MEASUREMENT DSM_CoEngtiNormalOBD "DSM internal variable to store the copy of the Engine running time - for OBD requirement" ULONG OneToOne 1 100 0.00 4294967295.00 FORMAT "%13.2" ECU_ADDRESS 0x60001EBC /end MEASUREMENT
/begin MEASUREMENT DSM_DFCSrv7VisClrReq "DFC and Service 7 Visibility infomation clear request" UWORD OneToOne 1 100 0.00 65535.00 FORMAT "%8.2" ECU_ADDRESS 0x60004D1E /end MEASUREMENT
/begin MEASUREMENT DSM_DINHSrv7VisClrReq "DINH and Service 7 Infomation clear request" UBYTE OneToOne 1 100 0.00 255.0 FORMAT "%5.1" ECU_ADDRESS 0x6000A3C5 /end MEASUREMENT
/begin MEASUREMENT DSM_DisblMode_mp "Actual disable mode to prevent error memory entries (provided by DSM configuration)" UWORD OneToOne 1 100 0.00 65535.00 FORMAT "%8.2" ECU_ADDRESS 0x70008898 /end MEASUREMENT
/begin MEASUREMENT DSM_ECUId "DSM internal variable to store the copy of the ECU identifier (e.g. masterslave systems), provided by DSM configuration" UBYTE OneToOne 1 100 0.00 255.0 FORMAT "%5.1" ECU_ADDRESS 0x6000E3CE /end MEASUREMENT
/begin MEASUREMENT DSM_EngStrtMILLmp "Engine start condition type" ULONG OneToOne 1 100 0.00 4294967295.00 FORMAT "%13.2" ECU_ADDRESS 0x60001EC0 /end MEASUREMENT
/begin MEASUREMENT DSM_lDst "DSM internal variable to store the copy of the driven distance (provided by DSM configuration)" SLONG OneToOne 1 100 -2147483648.00 2147483647.00 FORMAT "%13.2" ECU_ADDRESS 0x50002830 /end MEASUREMENT
/begin MEASUREMENT DSM_pEnv "DSM internal variable to store the copy of the Environment pressure" SWORD Pres_hPa 1 100 -32768.00 32767.00 FORMAT "%8.2" ECU_ADDRESS 0x6000E062 /end MEASUREMENT
/begin MEASUREMENT DSM_rAPP "DSM internal variable to store the copy of the Standardized accelerator pedal position" SWORD Prc 1 100 -400.0000 399.9878 FORMAT "%8.4" ECU_ADDRESS 0x6000E064 /end MEASUREMENT
/begin MEASUREMENT DSM_stCoPrmsOpMode "DSM internal variable to store the copy of the permissible operation modes (provided by DSM configuration)" UWORD OneToOne 1 100 0.00 65535.00 FORMAT "%8.2" ECU_ADDRESS 0x6000E066 /end MEASUREMENT
/begin MEASUREMENT DSM_stStrEnd "OBD Ready for Driving status" UBYTE OneToOne 1 100 0.00 255.0 BIT_MASK 0x1 FORMAT "%5.1" ECU_ADDRESS 0x6000E3D0 /end MEASUREMENT
/begin MEASUREMENT DSM_stWiggle_mp "wiggle test requested by ext. tester (provided by DSM configuration)" UBYTE OneToOne 1 100 0.00 255.0 FORMAT "%5.1" ECU_ADDRESS 0x70008A9C /end MEASUREMENT
/begin MEASUREMENT DSM_tEngDS "DSM internal variable to store the copy of the Coolant temperature at engine output" SWORD Temp_Cels 1 100 -3549.940 3003.560 FORMAT "%8.3" ECU_ADDRESS 0x600054E8 /end MEASUREMENT
/begin MEASUREMENT DSM_tEnv "DSM internal variable to store the copy of the Temperature of environment air" SWORD Temp_Cels 1 100 -3549.940 3003.560 FORMAT "%8.3" ECU_ADDRESS 0x6000E068 /end MEASUREMENT
/begin MEASUREMENT DSM_vVeh "DSM internal variable to store the copy of the Vehicle speed" SWORD Vel 1 100 -327.6800 327.6700 FORMAT "%8.4" ECU_ADDRESS 0x6000E06A /end MEASUREMENT
/begin FUNCTION DSM_Conf "30164.1.0_1.0.0DSM Kernel configuration"
 /begin DEF_CHARACTERISTIC DFES_MeterOut.DFC_AltIOACGFailr_C DFES_MeterOut.DFC_AltIOACGHiVltg_C DFES_MeterOut.DFC_AltIOACGLoVltg_C DFES_MeterOut.DFC_AltIOACGTHi_C DFES_MeterOut.DFC_AltIODConnACG_C DFES_MeterOut.DFC_BattUHiFailr_C DFES_MeterOut.DFC_BattULoFailr_C DFES_MeterOut.DFC_BrkBstPDriftHiErr_C DFES_MeterOut.DFC_BrkBstPDriftLoErr_C DFES_MeterOut.DFC_BrkBstPSnsrStuck_C DFES_MeterOut.DFC_BrkMnSwtContOn_C DFES_MeterOut.DFC_BrkMnSwtNotStp_C DFES_MeterOut.DFC_BrkNpl_C DFES_MeterOut.DFC_BrkRdntSwtContOn_C DFES_MeterOut.DFC_BrkRdntSwtNotStp_C DFES_MeterOut.DFC_Clth3ONStuck_C DFES_MeterOut.DFC_Clth4OFFStuck_C DFES_MeterOut.DFC_ClthOFFStuck_C DFES_MeterOut.DFC_ClthONStuck_C DFES_MeterOut.DFC_ClthStkFailInfo_C DFES_MeterOut.DFC_ComACFailInfo_C DFES_MeterOut.DFC_ComATFTValErr_C DFES_MeterOut.DFC_ComATMILReq_C DFES_MeterOut.DFC_ComAYCAChksum_C DFES_MeterOut.DFC_ComAYCARingCnt_C DFES_MeterOut.DFC_ComAYCATOut_C DFES_MeterOut.DFC_ComAYCDChkSum_C DFES_MeterOut.DFC_ComAYCDTOut_C DFES_MeterOut.DFC_ComAYCFChksum_C DFES_MeterOut.DFC_ComAYCFRingCnt_C DFES_MeterOut.DFC_ComAYCFTOut_C DFES_MeterOut.DFC_ComAYCGChksum_C DFES_MeterOut.DFC_ComAYCGRingCnt_C DFES_MeterOut.DFC_ComAYCGTOut_C DFES_MeterOut.DFC_ComAYCIChkSum_C DFES_MeterOut.DFC_ComAYCIRingCnt_C DFES_MeterOut.DFC_ComAYCITOut_C DFES_MeterOut.DFC_ComBCM1ChkSum_C DFES_MeterOut.DFC_ComBCM1RingCnt_C DFES_MeterOut.DFC_ComBCM1TOut_C DFES_MeterOut.DFC_ComCANABusOffErr_C DFES_MeterOut.DFC_ComCANBBusOffErr_C DFES_MeterOut.DFC_ComCANCBusOffErr_C DFES_MeterOut.DFC_ComCGW1ChkSum_C DFES_MeterOut.DFC_ComCGW1RingCnt_C DFES_MeterOut.DFC_ComCGW1TOut_C DFES_MeterOut.DFC_ComConvBoostErr_C DFES_MeterOut.DFC_ComConvSlipErr_C DFES_MeterOut.DFC_ComEAT10Chksum_C DFES_MeterOut.DFC_ComEAT10RingCnt_C DFES_MeterOut.DFC_ComEAT10TOut_C DFES_MeterOut.DFC_ComEAT11ChkSum_C DFES_MeterOut.DFC_ComEAT11RingCnt_C DFES_MeterOut.DFC_ComEAT11TOut_C DFES_MeterOut.DFC_ComEAT12ChkSum_C DFES_MeterOut.DFC_ComEAT12RingCnt_C DFES_MeterOut.DFC_ComEAT12TOut_C DFES_MeterOut.DFC_ComEAT13ChkSum_C DFES_MeterOut.DFC_ComEAT13RingCnt_C DFES_MeterOut.DFC_ComEAT13TOut_C DFES_MeterOut.DFC_ComEAT1Chksum_C DFES_MeterOut.DFC_ComEAT1RingCnt_C DFES_MeterOut.DFC_ComEAT1TOut_C DFES_MeterOut.DFC_ComEAT2ChkSum_C DFES_MeterOut.DFC_ComEAT2RingCnt_C DFES_MeterOut.DFC_ComEAT2TOut_C DFES_MeterOut.DFC_ComEAT4ChkSum_C DFES_MeterOut.DFC_ComEAT4RingCnt_C DFES_MeterOut.DFC_ComEAT4TOut_C DFES_MeterOut.DFC_ComEAT6Chksum_C DFES_MeterOut.DFC_ComEAT6RingCnt_C DFES_MeterOut.DFC_ComEAT6TOut_C DFES_MeterOut.DFC_ComEAT7Chksum_C DFES_MeterOut.DFC_ComEAT7RingCnt_C DFES_MeterOut.DFC_ComEAT7TOut_C DFES_MeterOut.DFC_ComEAT8Chksum_C DFES_MeterOut.DFC_ComEAT8RingCnt_C DFES_MeterOut.DFC_ComEAT8TOut_C DFES_MeterOut.DFC_ComEATAChksum_C DFES_MeterOut.DFC_ComEATARingCnt_C DFES_MeterOut.DFC_ComEATATOut_C DFES_MeterOut.DFC_ComEATBChkSum_C DFES_MeterOut.DFC_ComEATBRingCnt_C DFES_MeterOut.DFC_ComEATBTOut_C DFES_MeterOut.DFC_ComEATCChksum_C DFES_MeterOut.DFC_ComEATCRingCnt_C DFES_MeterOut.DFC_ComEATCTOut_C DFES_MeterOut.DFC_ComEBBAChksum_C DFES_MeterOut.DFC_ComEBBARingCnt_C DFES_MeterOut.DFC_ComEBBATOut_C DFES_MeterOut.DFC_ComEPS1Chksum_C DFES_MeterOut.DFC_ComEPS1RingCnt_C DFES_MeterOut.DFC_ComEPS1TOut_C DFES_MeterOut.DFC_ComEngCanRxErr_C DFES_MeterOut.DFC_ComGrvySnsrErr_C DFES_MeterOut.DFC_ComGwIMG1ChkSum_C DFES_MeterOut.DFC_ComGwIMG1RingCnt_C DFES_MeterOut.DFC_ComGwIMG1TOut_C DFES_MeterOut.DFC_ComGwIMG3ChkSum_C DFES_MeterOut.DFC_ComGwIMG3RingCnt_C DFES_MeterOut.DFC_ComGwIMG3TOut_C DFES_MeterOut.DFC_ComGwIMG4ChkSum_C DFES_MeterOut.DFC_ComGwIMG4RingCnt_C DFES_MeterOut.DFC_ComGwIMG4TOut_C DFES_MeterOut.DFC_ComGwIMG5ChkSum_C DFES_MeterOut.DFC_ComGwIMG5RingCnt_C DFES_MeterOut.DFC_ComGwIMG5TOut_C DFES_MeterOut.DFC_ComGwIMG6ChkSum_C DFES_MeterOut.DFC_ComGwIMG6RingCnt_C DFES_MeterOut.DFC_ComGwIMG6TOut_C DFES_MeterOut.DFC_ComIDASBChksum_C DFES_MeterOut.DFC_ComIDASBRingCnt_C DFES_MeterOut.DFC_ComIDASBTOut_C DFES_MeterOut.DFC_ComIMGMILReq_C DFES_MeterOut.DFC_ComISSPrms_C DFES_MeterOut.DFC_ComMETAChksum_C DFES_MeterOut.DFC_ComMETARingCnt_C DFES_MeterOut.DFC_ComMETATOut_C DFES_MeterOut.DFC_ComMETCChksum_C DFES_MeterOut.DFC_ComMETCRingCnt_C DFES_MeterOut.DFC_ComMETCTOut_C DFES_MeterOut.DFC_ComMETDChksum_C DFES_MeterOut.DFC_ComMETDRingCnt_C DFES_MeterOut.DFC_ComMETDTOut_C DFES_MeterOut.DFC_ComMETE2Chksum_C DFES_MeterOut.DFC_ComMETE2RingCnt_C DFES_MeterOut.DFC_ComMETE2TOut_C DFES_MeterOut.DFC_ComMETFChksum_C DFES_MeterOut.DFC_ComMETFRingCnt_C DFES_MeterOut.DFC_ComMETFTOut_C DFES_MeterOut.DFC_ComMETGChksum_C DFES_MeterOut.DFC_ComMETGRingCnt_C DFES_MeterOut.DFC_ComMETGTOut_C DFES_MeterOut.DFC_ComMETH2Chksum_C DFES_MeterOut.DFC_ComMETH2RingCnt_C DFES_MeterOut.DFC_ComMETH2TOut_C DFES_MeterOut.DFC_ComMETHChksum_C DFES_MeterOut.DFC_ComMETHRingCnt_C DFES_MeterOut.DFC_ComMETHTOut_C DFES_MeterOut.DFC_ComMETIChksum_C DFES_MeterOut.DFC_ComMETIRingCnt_C DFES_MeterOut.DFC_ComMETITOut_C DFES_MeterOut.DFC_ComMETKChksum_C DFES_MeterOut.DFC_ComMETKRingCnt_C DFES_MeterOut.DFC_ComMETKTOut_C DFES_MeterOut.DFC_ComMETLChksum_C DFES_MeterOut.DFC_ComMETLRingCnt_C DFES_MeterOut.DFC_ComMETLTOut_C DFES_MeterOut.DFC_ComMETMChksum_C DFES_MeterOut.DFC_ComMETMRingCnt_C DFES_MeterOut.DFC_ComMETMTOut_C DFES_MeterOut.DFC_ComMETNChksum_C DFES_MeterOut.DFC_ComMETNRingCnt_C DFES_MeterOut.DFC_ComMETNTOut_C DFES_MeterOut.DFC_ComMtrCom_C DFES_MeterOut.DFC_ComPCUChkSum_C DFES_MeterOut.DFC_ComPCURingCnt_C DFES_MeterOut.DFC_ComPCUTOut_C DFES_MeterOut.DFC_ComSRSAChksum_C DFES_MeterOut.DFC_ComSRSARingCnt_C DFES_MeterOut.DFC_ComSRSATOut_C DFES_MeterOut.DFC_ComSRSBChksum_C DFES_MeterOut.DFC_ComSRSBRingCnt_C DFES_MeterOut.DFC_ComSRSBTOut_C DFES_MeterOut.DFC_ComSRSChksum_C DFES_MeterOut.DFC_ComSRSErr_C DFES_MeterOut.DFC_ComSRSRingCnt_C DFES_MeterOut.DFC_ComSRSTOut_C DFES_MeterOut.DFC_ComVehSpdPndFltTCU_C DFES_MeterOut.DFC_EbsChartcCurrErr_C DFES_MeterOut.DFC_EbsSelfDiagErr_C DFES_MeterOut.DFC_GbxCANDigPlausErr_C DFES_MeterOut.DFC_GbxNPos1SRCMax_C DFES_MeterOut.DFC_GbxNPos1SRCMin_C DFES_MeterOut.DFC_GbxNPos2SRCMax_C DFES_MeterOut.DFC_GbxNPos2SRCMin_C DFES_MeterOut.DFC_GbxNPosAlvChk_C DFES_MeterOut.DFC_GbxNPosSyncErr_C DFES_MeterOut.DFC_HEGOS2B1HtrPsMax_C DFES_MeterOut.DFC_HEGOS2B1HtrPsMin_C DFES_MeterOut.DFC_HEGOS2B1HtrPsSig_C DFES_MeterOut.DFC_LinCSErrACG_C DFES_MeterOut.DFC_LinCSErrEBS_C DFES_MeterOut.DFC_LinHdrTimeoutErrACG_C DFES_MeterOut.DFC_LinHdrTimeoutErrEBS_C DFES_MeterOut.DFC_LinMsgTimeoutErrACG_C DFES_MeterOut.DFC_LinMsgTimeoutErrEBS_C DFES_MeterOut.DFC_LinNoStrtComErr_C DFES_MeterOut.DFC_MisfDetVWhlFrntLeOORHi_C DFES_MeterOut.DFC_MisfDetVWhlFrntLeRatyHi_C DFES_MeterOut.DFC_MisfDetVWhlFrntLeRatyLo_C DFES_MeterOut.DFC_MisfDetVWhlFrntLeStuck_C DFES_MeterOut.DFC_MisfDetVWhlFrntRiOORHi_C DFES_MeterOut.DFC_MisfDetVWhlFrntRiRatyHi_C DFES_MeterOut.DFC_MisfDetVWhlFrntRiRatyLo_C DFES_MeterOut.DFC_MisfDetVWhlFrntRiStuck_C DFES_MeterOut.DFC_MisfDetVWhlReLeOORHi_C DFES_MeterOut.DFC_MisfDetVWhlReLeRatyHi_C DFES_MeterOut.DFC_MisfDetVWhlReLeRatyLo_C DFES_MeterOut.DFC_MisfDetVWhlReLeStuck_C DFES_MeterOut.DFC_MisfDetVWhlReRiOORHi_C DFES_MeterOut.DFC_MisfDetVWhlReRiRatyHi_C DFES_MeterOut.DFC_MisfDetVWhlReRiRatyLo_C DFES_MeterOut.DFC_MisfDetVWhlReRiStuck_C DFES_MeterOut.DFC_MisfDetdVWhlFrntLePlaus_C DFES_MeterOut.DFC_MisfDetdVWhlFrntRiPlaus_C DFES_MeterOut.DFC_MisfDetdVWhlReLePlaus_C DFES_MeterOut.DFC_MisfDetdVWhlReRiPlaus_C DFES_MeterOut.DFC_PEnvSigRngMax_C DFES_MeterOut.DFC_PEnvSigRngMin_C DFES_MeterOut.DFC_StmFault_C DFES_MeterOut.DFC_StrtCtOffPth_C DFES_MeterOut.DFC_StrtCtlErr_C DFES_MeterOut.DFC_StrtFault_C DFES_MeterOut.DFC_StrtLckJudg1_C DFES_MeterOut.DFC_StrtLckJudg2_C DFES_MeterOut.DFC_StrtOL_C DFES_MeterOut.DFC_StrtOL2_C DFES_MeterOut.DFC_StrtSCB_C DFES_MeterOut.DFC_StrtSCB2_C DFES_MeterOut.DFC_StrtSCG_C DFES_MeterOut.DFC_StrtSCG2_C DFES_MeterOut.DFC_StrtStkRly1_C DFES_MeterOut.DFC_StrtStkRly2_C DFES_MeterOut.DFC_TEVEmax_C DFES_MeterOut.DFC_TEVEmin_C DFES_MeterOut.DFC_TEVEsig_C DFES_MeterOut.DFC_VehVAllPlaus_C DFES_MeterOut.DFC_VehVNCSnsrElecFailr_C DFES_MeterOut.DFC_VehVPlausCan_C DFES_MeterOut.DFC_VehVPlausFco_C DFES_MeterOut.DFC_VehVPlausPwr_C DFES_MeterOut.DFC_VehVPlausV2N_C DFES_MeterOut.DFC_VehVSpdSnsrAElecFailr_C DFES_MeterOut.DFC_VehVSpdSnsrBElecFailr_C DFES_MeterOut.DFC_ClthMax_C DFES_MeterOut.DFC_IgnClPs_DevComErr_C DFES_MeterOut.DFC_IgnClPs_LineOl_0_C DFES_MeterOut.DFC_IgnClPs_LineOl_1_C DFES_MeterOut.DFC_IgnClPs_LineOl_2_C DFES_MeterOut.DFC_IgnClPs_LineOl_3_C DFES_MeterOut.DFC_IgnClPs_LineScb_0_C DFES_MeterOut.DFC_IgnClPs_LineScb_1_C DFES_MeterOut.DFC_IgnClPs_LineScb_2_C DFES_MeterOut.DFC_IgnClPs_LineScb_3_C DFES_MeterOut.DFC_IgnClPs_LineScg_0_C DFES_MeterOut.DFC_IgnClPs_LineScg_1_C DFES_MeterOut.DFC_IgnClPs_LineScg_2_C DFES_MeterOut.DFC_IgnClPs_LineScg_3_C DFES_MeterOut.DFC_UEGOASICS1B1_C DFES_MeterOut.DFC_UEGOOLIPES1B1_C DFES_MeterOut.DFC_UEGOOLRES1B1_C DFES_MeterOut.DFC_UEGOSCBS1B1_C DFES_MeterOut.DFC_UEGOSCGS1B1_C DFES_MeterOut.DFC_UEGOSPIS1B1_C DFES_MeterOut.DFC_UEGOSnsrS1B1_C DFES_MeterOut.DFC_UegoOlApesS1B1_C DFES_MeterOut.DFC_UegoOlRCmpS1B1_C DFES_MeterOut.DFC_AirCCmprOL_C DFES_MeterOut.DFC_AirCCmprOvrTemp_C DFES_MeterOut.DFC_AirCCmprSCB_C DFES_MeterOut.DFC_AirCCmprSCG_C DFES_MeterOut.DFC_AltErr_C DFES_MeterOut.DFC_BattUSRCMax_C DFES_MeterOut.DFC_BattUSRCMin_C DFES_MeterOut.DFC_ComChksTCU1_C DFES_MeterOut.DFC_ComChksTCU11_C DFES_MeterOut.DFC_ComChksTCU12_C DFES_MeterOut.DFC_ComChksTCU13_C DFES_MeterOut.DFC_ComChksTCU2_C DFES_MeterOut.DFC_ComChksTCU3_C DFES_MeterOut.DFC_ComChksTCU4_C DFES_MeterOut.DFC_ComCntTCU1_C DFES_MeterOut.DFC_ComCntTCU11_C DFES_MeterOut.DFC_ComCntTCU12_C DFES_MeterOut.DFC_ComCntTCU13_C DFES_MeterOut.DFC_ComCntTCU2_C DFES_MeterOut.DFC_ComCntTCU3_C DFES_MeterOut.DFC_ComCntTCU4_C DFES_MeterOut.DFC_ComTOutTCU01_C DFES_MeterOut.DFC_ComTOutTCU02_C DFES_MeterOut.DFC_ComTOutTCU1_C DFES_MeterOut.DFC_ComTOutTCU11_C DFES_MeterOut.DFC_ComTOutTCU12_C DFES_MeterOut.DFC_ComTOutTCU13_C DFES_MeterOut.DFC_ComTOutTCU14_C DFES_MeterOut.DFC_ComTOutTCU2_C DFES_MeterOut.DFC_ComTOutTCU3_C DFES_MeterOut.DFC_ComTOutTCU4_C DFES_MeterOut.DFC_DevLibBattUHi_C DFES_MeterOut.DFC_DevLibBattULo_C DFES_MeterOut.DFC_FanDIOOL_0_C DFES_MeterOut.DFC_FanDIOOL_1_C DFES_MeterOut.DFC_FanDIOOvrTemp_0_C DFES_MeterOut.DFC_FanDIOOvrTemp_1_C DFES_MeterOut.DFC_FanDIOSCB_0_C DFES_MeterOut.DFC_FanDIOSCB_1_C DFES_MeterOut.DFC_FanDIOSCG_0_C DFES_MeterOut.DFC_FanDIOSCG_1_C DFES_MeterOut.DFC_MRlyDcOL_C DFES_MeterOut.DFC_MRlyDcSCB_C DFES_MeterOut.DFC_MRlyDcSCG_C DFES_MeterOut.DFC_PSPOL_C DFES_MeterOut.DFC_PSPOvrTemp_C DFES_MeterOut.DFC_PSPSCB_C DFES_MeterOut.DFC_PSPSCG_C DFES_MeterOut.DFC_T50Err_C DFES_MeterOut.DFC_ThrVlvLoBattB1_C DFES_MeterOut.DFC_VehVPhysRngHi_C DFES_MeterOut.DFC_VehVSclOutOL_C DFES_MeterOut.DFC_VehVSclOutOT_C DFES_MeterOut.DFC_VehVSclOutSCB_C DFES_MeterOut.DFC_VehVSclOutSCG_C DFES_MeterOut.DFC_VehVSnsrARngHi_C DFES_MeterOut.DFC_VehVSnsrBRngHi_C DFES_MeterOut.DFC_VehVSpdRtyDiag_C DFES_MeterOut.DFC_VehVWhlErr_C DFES_MeterOut.DFC_ACEvpTSRCMax_C DFES_MeterOut.DFC_ACEvpTSRCMin_C DFES_MeterOut.DFC_AirCClntPAnaSRCMax_C DFES_MeterOut.DFC_AirCClntPAnaSRCMin_C DFES_MeterOut.DFC_AirCSwtNpl_C DFES_MeterOut.DFC_AirCSwtSig_C DFES_MeterOut.DFC_Brk_C DFES_MeterOut.DFC_BrkSig_C DFES_MeterOut.DFC_ClthSig_C DFES_MeterOut.DFC_HLSDemOvhtEngLim_C DFES_MeterOut.DFC_OilPNpl_C DFES_MeterOut.DFC_PIntkVUsLineHiB1_C DFES_MeterOut.DFC_PIntkVUsLineLoB1_C DFES_MeterOut.DFC_VehVPhysRngLo_C DFES_MeterOut.DFC_VehVSigCan_C DFES_MeterOut.DFC_VehVSigCanSafe_C DFES_MeterOut.DFC_VlvLftFbOilPSnsrIntk11SRCMax_C DFES_MeterOut.DFC_VlvLftFbOilPSnsrIntk11SRCMin_C DFES_MeterOut.DFC_ClthNpl_C DFES_MeterOut.DFC_EV1max_C DFES_MeterOut.DFC_EV1min_C DFES_MeterOut.DFC_EV1sig_C DFES_MeterOut.DFC_EV2max_C DFES_MeterOut.DFC_EV2min_C DFES_MeterOut.DFC_EV2sig_C DFES_MeterOut.DFC_EV3max_C DFES_MeterOut.DFC_EV3min_C DFES_MeterOut.DFC_EV3sig_C DFES_MeterOut.DFC_EV4max_C DFES_MeterOut.DFC_EV4min_C DFES_MeterOut.DFC_EV4sig_C DFES_MeterOut.DFC_GbxPNPosnDrvCdn_C DFES_MeterOut.DFC_GbxPNPosnPlausy_C DFES_MeterOut.DFC_PEnvCcMax_C DFES_MeterOut.DFC_PEnvCcMin_C DFES_MeterOut.DFC_PEnvRngChkMax_C DFES_MeterOut.DFC_PEnvRngChkMin_C DFES_MeterOut.DFC_PEnvSnsrPlaus_C DFES_MeterOut.DFC_UEGOHeatrPsS1B1Max_C DFES_MeterOut.DFC_UEGOHeatrPsS1B1Min_C DFES_MeterOut.DFC_UEGOHeatrPsS1B1Sig_C DFES_MeterOut.DFC_UEGOHeatrRlyPsOLS1B1_C DFES_MeterOut.DFC_UEGOHeatrRlyPsSCBS1B1_C DFES_MeterOut.DFC_UEGOHeatrRlyPsSCGS1B1_C DFES_MeterOut.DFC_KnDetSens1PortAMax_C DFES_MeterOut.DFC_KnDetSens1PortAMin_C DFES_MeterOut.DFC_KnDetSens1PortBMax_C DFES_MeterOut.DFC_KnDetSens1PortBMin_C DFES_MeterOut.DFC_Clth2ONStuck_C DFES_MeterOut.DFC_Clth2ONStuckLdc_C DFES_MeterOut.DFC_Clth3ONStuckLdc_C DFES_MeterOut.DFC_Clth3ONStuckPostDrv_C DFES_MeterOut.DFC_Clth4ONStuck_C DFES_MeterOut.DFC_Clth4ONStuckLdc_C DFES_MeterOut.DFC_ComDLCTCU01_C DFES_MeterOut.DFC_ComDLCTCU02_C DFES_MeterOut.DFC_ComDLCTCU1_C DFES_MeterOut.DFC_ComDLCTCU11_C DFES_MeterOut.DFC_ComDLCTCU12_C DFES_MeterOut.DFC_ComDLCTCU13_C DFES_MeterOut.DFC_ComDLCTCU14_C DFES_MeterOut.DFC_ComDLCTCU2_C DFES_MeterOut.DFC_ComDLCTCU3_C DFES_MeterOut.DFC_ComDLCTCU4_C DFES_MeterOut.DFC_EVX_C DFES_MeterOut.DFC_EbsSocFlt_C DFES_MeterOut.DFC_I14229VINErr_C DFES_MeterOut.DFC_LLRKHmax_C DFES_MeterOut.DFC_LLRKHmin_C DFES_MeterOut.DFC_LLRmax_C DFES_MeterOut.DFC_LLRmin_C DFES_MeterOut.DFC_RoughRoad_C DFES_MeterOut.DFC_SiaEEPRdErr_C DFES_MeterOut.DFC_SiaEEPWrngCod_C DFES_MeterOut.DFC_UegoDummy_C DFES_MeterOut.DFC_BusDiagCANAPPLBusOff_C DFES_MeterOut.DFC_BusDiagCANCANCBusOff_C DFES_MeterOut.DFC_BusDiagCANVEHICLEBusOff_C DFES_MeterOut.DFC_RBA_IODIAGPWR_rba_IoExtCy329_SignalVltSply_0_C DFES_MeterOut.DFC_RBA_IODIAGPWR_rba_IoExtCy329_SignalVltSply_0OT_C DFES_MeterOut.DFC_RBA_IODIAGPWR_rba_IoExtCy329_SignalVltSply_0OV_C DFES_MeterOut.DFC_RBA_IODIAGPWR_rba_IoExtCy329_SignalVltSply_0SCG_C DFES_MeterOut.DFC_RBA_IODIAGPWR_rba_IoExtCy329_SignalVltSply_0UV_C DFES_MeterOut.DFC_RBA_IODIAGPWR_rba_IoExtCy329_SignalVltSply_1_C DFES_MeterOut.DFC_RBA_IODIAGPWR_rba_IoExtCy329_SignalVltSply_1OT_C DFES_MeterOut.DFC_RBA_IODIAGPWR_rba_IoExtCy329_SignalVltSply_1OV_C DFES_MeterOut.DFC_RBA_IODIAGPWR_rba_IoExtCy329_SignalVltSply_1SCG_C DFES_MeterOut.DFC_RBA_IODIAGPWR_rba_IoExtCy329_SignalVltSply_1UV_C DFES_MeterOut.DFC_RBA_IODIAGPWR_rba_IoExtCy329_SignalVltSply_2_C DFES_MeterOut.DFC_RBA_IODIAGPWR_rba_IoExtCy329_SignalVltSply_2OT_C DFES_MeterOut.DFC_RBA_IODIAGPWR_rba_IoExtCy329_SignalVltSply_2OV_C DFES_MeterOut.DFC_RBA_IODIAGPWR_rba_IoExtCy329_SignalVltSply_2SCG_C DFES_MeterOut.DFC_RBA_IODIAGPWR_rba_IoExtCy329_SignalVltSply_2UV_C DFES_MeterOut.DFC_CAN_E_TIMEOUT_C DFES_MeterOut.DFC_LIN_E_TIMEOUT_C DFES_MeterOut.DFC_MRlyOL_C DFES_MeterOut.DFC_MRlySCB_C DFES_MeterOut.DFC_MRlySCG_C DFES_MeterOut.DFC_rba_MultiStackTrace_Threshold_C DFES_MeterOut.DFC_BSWM_E_ACTION_FAILED_C DFES_MeterOut.DFC_BSWM_E_INTRPTQUEUE_FULL_C DFES_MeterOut.DFC_RBA_IOEXTLIB_KEEPALIVE_DRV_C DFES_MeterOut.DFC_RBA_IOEXTLIB_KEEPALIVE_INI_C DFES_MeterOut.DFC_rba_IoSigRtc_StopCounter_C DFES_MeterOut.DFC_rba_MRly_Diag_Stk_Event_C DFES_MeterOut.DFC_rba_MemDiag_MemReadErr_C DFES_MeterOut.DFC_rba_MemDiag_MemWrErr_C DFES_MeterOut.DFC_rba_SyC_IrrSwOffTrigEngRun_Event_C DFES_MeterOut.DFC_rba_T15_Diag_ComInVld_Event_C DFES_MeterOut.DFC_rba_T15_Diag_ComOff_HwOn_Event_C DFES_MeterOut.DFC_rba_T15_Diag_ComOn_HwOff_Event_C DFES_MeterOut.DFC_AppAllSnsrDfct_C DFES_MeterOut.DFC_BattUStdbyDiaOL_C DFES_MeterOut.DFC_BigLeakIntkMnfldEmiInfl_C DFES_MeterOut.DFC_BrkMnSwtContOnWarnLmp_C DFES_MeterOut.DFC_BrkMnSwtNotStpWarnLmp_C DFES_MeterOut.DFC_BrkRdntSwtContOnWarnLmp_C DFES_MeterOut.DFC_BrkRdntSwtNotStpWarnLmp_C DFES_MeterOut.DFC_CEngDsTColdStrtMax_C DFES_MeterOut.DFC_CEngDsTColdStrtMin_C DFES_MeterOut.DFC_CEngDsTImps_C DFES_MeterOut.DFC_CEngDsTPlausLSC_C DFES_MeterOut.DFC_CEngDsTPlausSTC_C DFES_MeterOut.DFC_CEngDsTSRCMax_C DFES_MeterOut.DFC_CEngDsTSRCMin_C DFES_MeterOut.DFC_CEngDsTSig_C DFES_MeterOut.DFC_CEngUsTSRCMax_C DFES_MeterOut.DFC_CEngUsTSRCMin_C DFES_MeterOut.DFC_DCDCFltDet_C DFES_MeterOut.DFC_DKRSA_C DFES_MeterOut.DFC_DKVSmax_C DFES_MeterOut.DFC_DKnpl_C DFES_MeterOut.DFC_DSSmax_C DFES_MeterOut.DFC_DSTTI_C DFES_MeterOut.DFC_DSUmax_C DFES_MeterOut.DFC_EGRVlvOL_C DFES_MeterOut.DFC_EGRVlvSCB_C DFES_MeterOut.DFC_EGRVlvSCG_C DFES_MeterOut.DFC_EGSDUS2B1LtrDly_C DFES_MeterOut.DFC_EGSDUS2B1LtrPT1_C DFES_MeterOut.DFC_EGSDUS2B1RtlDly_C DFES_MeterOut.DFC_EGSDUS2B1RtlPT1_C DFES_MeterOut.DFC_EGSDUS2B1TarLean_C DFES_MeterOut.DFC_EGSDUS2B1TarRich_C DFES_MeterOut.DFC_ETAKHLmax_C DFES_MeterOut.DFC_ETAKHTmax_C DFES_MeterOut.DFC_EngICO_C DFES_MeterOut.DFC_EngPrtOvrSpdMon_C DFES_MeterOut.DFC_EpmCaSI1ErrSig_C DFES_MeterOut.DFC_EpmCaSI1NoSig_C DFES_MeterOut.DFC_EpmCaSI1OfsErr_C DFES_MeterOut.DFC_EpmCrSErrSig_C DFES_MeterOut.DFC_EpmCrSNoSig_C DFES_MeterOut.DFC_EtaEngIdleNonCsers_C DFES_MeterOut.DFC_EtaEngPtlNonCsers_C DFES_MeterOut.DFC_FRAmax_C DFES_MeterOut.DFC_FRAmin_C DFES_MeterOut.DFC_GbxRvsSwtStk_C DFES_MeterOut.DFC_HDRmax_C DFES_MeterOut.DFC_HEGOS2B1ElecMax_C DFES_MeterOut.DFC_HEGOS2B1ElecMin_C DFES_MeterOut.DFC_HEGOS2B1ElecSig_C DFES_MeterOut.DFC_HEGOS2B1HtgNpl_C DFES_MeterOut.DFC_IntkAirTIntkMnfldCrssMax_C DFES_MeterOut.DFC_IntkAirTIntkMnfldCrssMin_C DFES_MeterOut.DFC_IntkAirTIntkMnfldHSCMax_C DFES_MeterOut.DFC_IntkAirTIntkMnfldImps_C DFES_MeterOut.DFC_IntkAirTIntkMnfldPRCMax_C DFES_MeterOut.DFC_IntkAirTIntkMnfldPRCMin_C DFES_MeterOut.DFC_IntkAirTIntkMnfldSRCMax_C DFES_MeterOut.DFC_IntkAirTIntkMnfldSRCMin_C DFES_MeterOut.DFC_IntkAirTIntkMnfldSTC_C DFES_MeterOut.DFC_KS1max_C DFES_MeterOut.DFC_KS1min_C DFES_MeterOut.DFC_LMmax_C DFES_MeterOut.DFC_LZSRnpl_C DFES_MeterOut.DFC_LamDynDiagS1B1_C DFES_MeterOut.DFC_LeakIntkMnfldEmiInfl_C DFES_MeterOut.DFC_MD00max_C DFES_MeterOut.DFC_MDBmax_C DFES_MeterOut.DFC_MDCat_C DFES_MeterOut.DFC_MDCatCrit_C DFES_MeterOut.DFC_MDCatCurr_C DFES_MeterOut.DFC_MDCyl_0_C DFES_MeterOut.DFC_MDCyl_1_C DFES_MeterOut.DFC_MDCyl_2_C DFES_MeterOut.DFC_MDCyl_3_C DFES_MeterOut.DFC_MDEmi_C DFES_MeterOut.DFC_MDEmiStrt_C DFES_MeterOut.DFC_MDFco_C DFES_MeterOut.DFC_MDMpl_C DFES_MeterOut.DFC_MDSegTiAdpn_C DFES_MeterOut.DFC_MDmax_C DFES_MeterOut.DFC_MOXEMM_SMU_ALM0_0_C DFES_MeterOut.DFC_MOXEMM_SMU_ALM0_1_C DFES_MeterOut.DFC_MOXEMM_SMU_ALM0_10_C DFES_MeterOut.DFC_MOXEMM_SMU_ALM0_11_C DFES_MeterOut.DFC_MOXEMM_SMU_ALM0_13_C DFES_MeterOut.DFC_MOXEMM_SMU_ALM0_14_C DFES_MeterOut.DFC_MOXEMM_SMU_ALM0_2_C DFES_MeterOut.DFC_MOXEMM_SMU_ALM0_22_C DFES_MeterOut.DFC_MOXEMM_SMU_ALM0_23_C DFES_MeterOut.DFC_MOXEMM_SMU_ALM0_4_C DFES_MeterOut.DFC_MOXEMM_SMU_ALM0_5_C DFES_MeterOut.DFC_MOXEMM_SMU_ALM0_7_C DFES_MeterOut.DFC_MOXEMM_SMU_ALM0_8_C DFES_MeterOut.DFC_MOXEMM_SMU_ALM10_16_C DFES_MeterOut.DFC_MOXEMM_SMU_ALM10_17_C DFES_MeterOut.DFC_MOXEMM_SMU_ALM10_21_C DFES_MeterOut.DFC_MOXEMM_SMU_ALM11_0_C DFES_MeterOut.DFC_MOXEMM_SMU_ALM11_1_C DFES_MeterOut.DFC_MOXEMM_SMU_ALM11_2_C DFES_MeterOut.DFC_MOXEMM_SMU_ALM11_3_C DFES_MeterOut.DFC_MOXEMM_SMU_ALM11_4_C DFES_MeterOut.DFC_MOXEMM_SMU_ALM11_5_C DFES_MeterOut.DFC_MOXEMM_SMU_ALM11_8_C DFES_MeterOut.DFC_MOXEMM_SMU_ALM11_9_C DFES_MeterOut.DFC_MOXEMM_SMU_ALM1_0_C DFES_MeterOut.DFC_MOXEMM_SMU_ALM1_1_C DFES_MeterOut.DFC_MOXEMM_SMU_ALM1_10_C DFES_MeterOut.DFC_MOXEMM_SMU_ALM1_11_C DFES_MeterOut.DFC_MOXEMM_SMU_ALM1_13_C DFES_MeterOut.DFC_MOXEMM_SMU_ALM1_14_C DFES_MeterOut.DFC_MOXEMM_SMU_ALM1_2_C DFES_MeterOut.DFC_MOXEMM_SMU_ALM1_22_C DFES_MeterOut.DFC_MOXEMM_SMU_ALM1_23_C DFES_MeterOut.DFC_MOXEMM_SMU_ALM1_4_C DFES_MeterOut.DFC_MOXEMM_SMU_ALM1_5_C DFES_MeterOut.DFC_MOXEMM_SMU_ALM1_7_C DFES_MeterOut.DFC_MOXEMM_SMU_ALM1_8_C DFES_MeterOut.DFC_MOXEMM_SMU_ALM21_0_C DFES_MeterOut.DFC_MOXEMM_SMU_ALM21_16_C DFES_MeterOut.DFC_MOXEMM_SMU_ALM21_3_C DFES_MeterOut.DFC_MOXEMM_SMU_ALM2_1_C DFES_MeterOut.DFC_MOXEMM_SMU_ALM2_10_C DFES_MeterOut.DFC_MOXEMM_SMU_ALM2_11_C DFES_MeterOut.DFC_MOXEMM_SMU_ALM2_13_C DFES_MeterOut.DFC_MOXEMM_SMU_ALM2_14_C DFES_MeterOut.DFC_MOXEMM_SMU_ALM2_22_C DFES_MeterOut.DFC_MOXEMM_SMU_ALM2_23_C DFES_MeterOut.DFC_MOXEMM_SMU_ALM2_4_C DFES_MeterOut.DFC_MOXEMM_SMU_ALM2_5_C DFES_MeterOut.DFC_MOXEMM_SMU_ALM2_7_C DFES_MeterOut.DFC_MOXEMM_SMU_ALM2_8_C DFES_MeterOut.DFC_MOXEMM_SMU_ALM6_0_C DFES_MeterOut.DFC_MOXEMM_SMU_ALM6_11_C DFES_MeterOut.DFC_MOXEMM_SMU_ALM6_12_C DFES_MeterOut.DFC_MOXEMM_SMU_ALM6_14_C DFES_MeterOut.DFC_MOXEMM_SMU_ALM6_15_C DFES_MeterOut.DFC_MOXEMM_SMU_ALM6_17_C DFES_MeterOut.DFC_MOXEMM_SMU_ALM6_18_C DFES_MeterOut.DFC_MOXEMM_SMU_ALM6_20_C DFES_MeterOut.DFC_MOXEMM_SMU_ALM6_21_C DFES_MeterOut.DFC_MOXEMM_SMU_ALM6_25_C DFES_MeterOut.DFC_MOXEMM_SMU_ALM6_4_C DFES_MeterOut.DFC_MOXEMM_SMU_ALM6_5_C DFES_MeterOut.DFC_MOXEMM_SMU_ALM6_7_C DFES_MeterOut.DFC_MOXEMM_SMU_ALM6_8_C DFES_MeterOut.DFC_MOXEMM_SMU_ALM7_1_C DFES_MeterOut.DFC_MOXEMM_SMU_ALM7_12_C DFES_MeterOut.DFC_MOXEMM_SMU_ALM7_13_C DFES_MeterOut.DFC_MOXEMM_SMU_ALM7_14_C DFES_MeterOut.DFC_MOXEMM_SMU_ALM7_15_C DFES_MeterOut.DFC_MOXEMM_SMU_ALM7_16_C DFES_MeterOut.DFC_MOXEMM_SMU_ALM7_17_C DFES_MeterOut.DFC_MOXEMM_SMU_ALM7_2_C DFES_MeterOut.DFC_MOXEMM_SMU_ALM7_20_C DFES_MeterOut.DFC_MOXEMM_SMU_ALM7_25_C DFES_MeterOut.DFC_MOXEMM_SMU_ALM7_26_C DFES_MeterOut.DFC_MOXEMM_SMU_ALM7_28_C DFES_MeterOut.DFC_MOXEMM_SMU_ALM7_29_C DFES_MeterOut.DFC_MOXEMM_SMU_ALM7_30_C DFES_MeterOut.DFC_MOXEMM_SMU_ALM7_31_C DFES_MeterOut.DFC_MOXEMM_SMU_ALM8_0_C DFES_MeterOut.DFC_MOXEMM_SMU_ALM8_1_C DFES_MeterOut.DFC_MOXEMM_SMU_ALM8_10_C DFES_MeterOut.DFC_MOXEMM_SMU_ALM8_11_C DFES_MeterOut.DFC_MOXEMM_SMU_ALM8_12_C DFES_MeterOut.DFC_MOXEMM_SMU_ALM8_16_C DFES_MeterOut.DFC_MOXEMM_SMU_ALM8_18_C DFES_MeterOut.DFC_MOXEMM_SMU_ALM8_2_C DFES_MeterOut.DFC_MOXEMM_SMU_ALM8_3_C DFES_MeterOut.DFC_MOXEMM_SMU_ALM8_31_C DFES_MeterOut.DFC_MOXEMM_SMU_ALM8_4_C DFES_MeterOut.DFC_MOXEMM_SMU_ALM9_0_C DFES_MeterOut.DFC_MOXEMM_SMU_ALM9_15_C DFES_MeterOut.DFC_MOXEMM_SMU_ALM9_3_C DFES_MeterOut.DFC_MoCADCNTP_C DFES_MeterOut.DFC_MoCADCTst_C DFES_MeterOut.DFC_MoCSOPICO_C DFES_MeterOut.DFC_MoFAPP_C DFES_MeterOut.DFC_MoFAirFilgPrdc_C DFES_MeterOut.DFC_MoFAirFlCtOffPfi_C DFES_MeterOut.DFC_MoFAirFlCylPfi_C DFES_MeterOut.DFC_MoFAirFlIn_C DFES_MeterOut.DFC_MoFAirFlMixCtlPfiChkAirFl_C DFES_MeterOut.DFC_MoFAirFlMixCtlPfiChkCtrl_C DFES_MeterOut.DFC_MoFAirFlMode_C DFES_MeterOut.DFC_MoFESpd_C DFES_MeterOut.DFC_MoFIACo_C DFES_MeterOut.DFC_MoFICOL1_C DFES_MeterOut.DFC_MoFICOL2_C DFES_MeterOut.DFC_MoFStrt_C DFES_MeterOut.DFC_MoFTrqCmp_C DFES_MeterOut.DFC_MoFTrqCmpMax_C DFES_MeterOut.DFC_MoFTrqCmpMin_C DFES_MeterOut.DFC_MoFVarPostBldSel_C DFES_MeterOut.DFC_MoXEMMHwLTMCUFW_C DFES_MeterOut.DFC_MoXEMMHwLTMonBIST_C DFES_MeterOut.DFC_MoXEMMHwLTRegMonTest_C DFES_MeterOut.DFC_MoXEMMHwLTStbySMUAlvTest_C DFES_MeterOut.DFC_MoXEMMHwLTTempSens_C DFES_MeterOut.DFC_MoXEMMHwLTUCBCfg_C DFES_MeterOut.DFC_OCWDAABEActv_C DFES_MeterOut.DFC_OCWDACom_C DFES_MeterOut.DFC_OCWDAErrPin_C DFES_MeterOut.DFC_OCWDAOvrVltg_C DFES_MeterOut.DFC_ORAmax_C DFES_MeterOut.DFC_ORAmin_C DFES_MeterOut.DFC_PLLSUmax_C DFES_MeterOut.DFC_PLLSUmin_C DFES_MeterOut.DFC_PSR1max_C DFES_MeterOut.DFC_PSRBmax_C DFES_MeterOut.DFC_PSRBmin_C DFES_MeterOut.DFC_PSRPmax_C DFES_MeterOut.DFC_PSRPmin_C DFES_MeterOut.DFC_PSRPsig_C DFES_MeterOut.DFC_PSRmax_C DFES_MeterOut.DFC_PUmax_C DFES_MeterOut.DFC_P_VSE11_OL_C DFES_MeterOut.DFC_P_VSE11_SCB_C DFES_MeterOut.DFC_P_VSE11_SCG_C DFES_MeterOut.DFC_PhyHighAPP1_C DFES_MeterOut.DFC_PhyHighAPP2_C DFES_MeterOut.DFC_PhyLowAPP1_C DFES_MeterOut.DFC_PhyLowAPP2_C DFES_MeterOut.DFC_SRCHighAPP1_C DFES_MeterOut.DFC_SRCHighAPP2_C DFES_MeterOut.DFC_SRCLowAPP1_C DFES_MeterOut.DFC_SRCLowAPP2_C DFES_MeterOut.DFC_SSpMon2_C DFES_MeterOut.DFC_SWReset_0_C DFES_MeterOut.DFC_SWReset_1_C DFES_MeterOut.DFC_SWReset_2_C DFES_MeterOut.DFC_SyncAPP_C DFES_MeterOut.DFC_TAmax_Dummy_C DFES_MeterOut.DFC_TKAEmax_C DFES_MeterOut.DFC_TKAEmin_C DFES_MeterOut.DFC_TKARmax_C DFES_MeterOut.DFC_TKARnpl_C DFES_MeterOut.DFC_TMmax_Dummy_C DFES_MeterOut.DFC_TUMmax_Dummy_C DFES_MeterOut.DFC_TWCDPriCatB1_C DFES_MeterOut.DFC_ThrVlvClsdPosnFirstOffsLrnImpoB1_C DFES_MeterOut.DFC_ThrVlvClsdPosnOffsLrnImpoB1_C DFES_MeterOut.DFC_ThrVlvClsdPosnOffsLrnMaxB1_C DFES_MeterOut.DFC_ThrVlvClsdPosnOffsLrnMinB1_C DFES_MeterOut.DFC_ThrVlvCtrlDeB1_C DFES_MeterOut.DFC_ThrVlvDycB1_C DFES_MeterOut.DFC_ThrVlvLimpAirPosnMaxAbsltDriftB1_C DFES_MeterOut.DFC_ThrVlvLimpAirPosnMaxB1_C DFES_MeterOut.DFC_ThrVlvLimpAirPosnMaxRelDriftB1_C DFES_MeterOut.DFC_ThrVlvLimpAirPosnMinB1_C DFES_MeterOut.DFC_ThrVlvOpenLoadB1_C DFES_MeterOut.DFC_ThrVlvOpenSprgB1_C DFES_MeterOut.DFC_ThrVlvOpenSprgSprdB1_C DFES_MeterOut.DFC_ThrVlvOpenSprgTwnB1_C DFES_MeterOut.DFC_ThrVlvOverTB1_C DFES_MeterOut.DFC_ThrVlvRetSprgB1_C DFES_MeterOut.DFC_ThrVlvRetSprgSprdB1_C DFES_MeterOut.DFC_ThrVlvRetSprgTwnB1_C DFES_MeterOut.DFC_ThrVlvSens1MaxB1_C DFES_MeterOut.DFC_ThrVlvSens1NplB1_C DFES_MeterOut.DFC_ThrVlvSens2MaxB1_C DFES_MeterOut.DFC_ThrVlvSens2MinB1_C DFES_MeterOut.DFC_ThrVlvSens2NplB1_C DFES_MeterOut.DFC_ThrVlvShoCircB1_C DFES_MeterOut.DFC_ThrVlvSpiErrB1_C DFES_MeterOut.DFC_ThrvlvSens1MinB1_C DFES_MeterOut.DFC_TiOffTBasdChkFast_C DFES_MeterOut.DFC_TiOffTBasdChkSlow_C DFES_MeterOut.DFC_UEGOHeatrCtlS1B1_C DFES_MeterOut.DFC_UEGOSnsrMntdS1B1_C DFES_MeterOut.DFC_VehVSig_C DFES_MeterOut.DFC_VlvLftFbSwtIntk11SpclFail_C DFES_MeterOut.DFC_VlvLftFbSwtIntk11StdFail_C DSM_uDisblBattHiHysL_C DSM_uDisblBattHiHysR_C DSM_uDisblBattLoHysL_C DSM_uDisblBattLoHysR_C /end DEF_CHARACTERISTIC
 /begin IN_MEASUREMENT APP_r BasSvr_bFuncTstReq BattU_u CEngDsT_t CoEng_bObdTmrInctg CoEng_flgObdPreCdn CoEng_st CoEng_tiNormalOBD DSMAUX_stDsmClrActv EnvT_t Epm_nEng GlbDa_lTotDst MRly_st MRly_stAct PEnv_p StSys_stStrt SyC_stSub T15_st VehV_v /end IN_MEASUREMENT
 /begin OUT_MEASUREMENT DSM_DFCSrv7VisClrReq DSM_DINHSrv7VisClrReq /end OUT_MEASUREMENT
 /begin LOC_MEASUREMENT DSMConf_DFCSrv7VisClrSt DSM_bInstableStatus DSM_bStFuncTst DSM_CoEngtiNormalOBD DSM_DisblMode_mp DSM_ECUId DSM_EngStrtMILLmp DSM_lDst DSM_pEnv DSM_rAPP DSM_stCoPrmsOpMode DSM_stStrEnd DSM_stWiggle_mp DSM_tEngDS DSM_tEnv DSM_vVeh /end LOC_MEASUREMENT
 FUNCTION_VERSION "30164.1.0_1.0.0" /end FUNCTION
/begin COMPU_METHOD OneToOne "" RAT_FUNC "%6.2" "-" COEFFS 0 1 0 0 0 1 /end COMPU_METHOD
/begin COMPU_METHOD Prc "" RAT_FUNC "%6.4" "%" COEFFS 0 81.92 0 0 0 1 /end COMPU_METHOD
/begin COMPU_METHOD Pres_hPa "" RAT_FUNC "%6.2" "hPa" COEFFS 0 1 0 0 0 1 /end COMPU_METHOD
/begin COMPU_METHOD Temp_Cels "" RAT_FUNC "%6.1" "deg C" COEFFS 0 10 2731.4 0 0 1 /end COMPU_METHOD
/begin COMPU_METHOD Vel "" RAT_FUNC "%6.4" "km/h" COEFFS 0 100 0 0 0 1 /end COMPU_METHOD
/begin COMPU_METHOD Volt_Batt "" RAT_FUNC "%6.1" "mV" COEFFS 0 0.05 0 0 0 1 /end COMPU_METHOD
/begin RECORD_LAYOUT Val_Ws16 FNC_VALUES 1 SWORD COLUMN_DIR DIRECT /end RECORD_LAYOUT
/begin RECORD_LAYOUT Val_Wu8 FNC_VALUES 1 UBYTE COLUMN_DIR DIRECT /end RECORD_LAYOUT
/end MODULE
/end PROJECT
