ASAP2_VERSION 1 60
/begin PROJECT MG1CA020 "MG1CA020"
/begin HEADER "" VERSION "MG1CA020_6SAY_V011_TPROT" PROJECT_NO MG1CA020 /end HEADER
/begin MODULE DIM ""
/begin MOD_COMMON "" BYTE_ORDER MSB_LAST ALIGNMENT_BYTE 1 ALIGNMENT_WORD 2 ALIGNMENT_LONG 4 ALIGNMENT_INT64 4 ALIGNMENT_FLOAT32_IEEE 4 ALIGNMENT_FLOAT64_IEEE 4 DATA_SIZE 32 /end MOD_COMMON
/begin CHARACTERISTIC Com_dENG21SigSel_C "Signal selection data for ENG21 frame" VALUE 0x8051E652 RB_Val_Wu8 255.0 OneToOne 0.00 255.0 FORMAT "%5.1" /end CHARACTERISTIC
/begin CHARACTERISTIC Com_dENG25SigSel_C "Signal selection data for ENG25 frame" VALUE 0x8051E658 RB_Val_Wu8 255.0 OneToOne 0.00 255.0 FORMAT "%5.1" /end CHARACTERISTIC
/begin CHARACTERISTIC Com_nEngHi_C "Hysteris upper limit of engine speed for Engine stall information." VALUE 0x8051E64C RB_Val_Ws16 32767.50 EngN -16384.00 16383.50 FORMAT "%8.2" /end CHARACTERISTIC
/begin CHARACTERISTIC Com_nEngLo_C "Hysteris lower limit of engine speed for Engine stall information." VALUE 0x8051E64E RB_Val_Ws16 32767.50 EngN -16384.00 16383.50 FORMAT "%8.2" /end CHARACTERISTIC
/begin CHARACTERISTIC Com_rThrVlvActAdj_C "Calibration adjust for Actual throttle Aperture" VALUE 0x8051E640 RB_Val_Wu16 159.9976 reldeg_q0p002441 0.00 159.9976 FORMAT "%8.4" /end CHARACTERISTIC
/begin CHARACTERISTIC Com_stIdleNeutMsk_C "Calibration for Engine Idle Neutral Judgment" VALUE 0x8051E644 RB_Val_Wu32 4294967295.00 OneToOne 0.00 4294967295.00 FORMAT "%13.2" /end CHARACTERISTIC
/begin CHARACTERISTIC Com_stRemEngStrtMilSeln_C "caliration for remote engine starter MIL selection" VALUE 0x8051E65A RB_Val_Wu8 255.0 OneToOne 0.00 255.0 FORMAT "%5.1" /end CHARACTERISTIC
/begin CHARACTERISTIC Com_stSwtEstmTqNormJdg_C "Switch to change the estimated torque accuracy flag info" VALUE 0x8051E659 RB_Val_Wu8 1.00000000000 B_TRUE 0.00 1.00000000000 FORMAT "%13.11" /end CHARACTERISTIC
/begin CHARACTERISTIC Com_stSwtMinTqAllwd_C "Calibration to enable message switching for ENG_IDAS_MIN_TORQUE" VALUE 0x8051E653 RB_Val_Wu8 2.000 OneToOne 0.00 2.000 FORMAT "%5.3" EXTENDED_LIMITS 0.00 255.0 /end CHARACTERISTIC
/begin CHARACTERISTIC Com_SwtMaxTqAllwd_C "Calibration to enable message switching for ENG_IDAS_MAX_TORQUE" VALUE 0x8051E654 Val_Wu8 1.000 OneToOne 0.00 1.000 FORMAT "%5.3" EXTENDED_LIMITS 0.00 255.0 /end CHARACTERISTIC
/begin CHARACTERISTIC Com_swtMILMulDisbl_C "CAN switch for Multi information switch" VALUE 0x8051E65B RB_Val_Wu8 1.000 OneToOne 0.00 1.000 FORMAT "%5.3" EXTENDED_LIMITS 0.00 255.0 /end CHARACTERISTIC
/begin CHARACTERISTIC Com_SwtMilMultiBDi_C "Switch to disable the Multi information display Type B for MIL status" VALUE 0x8051E65C RB_Val_Wu8 1.000 OneToOne 0.00 1.000 FORMAT "%5.3" EXTENDED_LIMITS 0.00 255.0 /end CHARACTERISTIC
/begin CHARACTERISTIC Com_swtNEng_C "switch for selection of engine speed" VALUE 0x8051E650 RB_Val_Wu8 255.0 OneToOne 0.00 255.0 FORMAT "%5.1" /end CHARACTERISTIC
/begin CHARACTERISTIC Com_swtTqRvsnEnaFlg_C "Switch for Torque adjustment permission flag" VALUE 0x8051E648 RB_Val_Wu8 1.000 OneToOne 0.00 1.000 FORMAT "%5.3" EXTENDED_LIMITS 0.00 255.0 /end CHARACTERISTIC
/begin CHARACTERISTIC Com_tiHACCut_C "calibration infomration for Timet AC Cut Infomation" VALUE 0x8051E64A RB_Val_Ws16 65535.00 t_q1_ms -32768.00 32767.00 FORMAT "%8.2" /end CHARACTERISTIC
/begin CHARACTERISTIC Com_tiIDASInhbDly_C "Calibration parameter for debounce time of inhibit information about IDAS" VALUE 0x8051E656 Val_Ws16 327670.0 Time_ms 0.00 327670.0 FORMAT "%8.1" EXTENDED_LIMITS -327680.0 327670.0 /end CHARACTERISTIC
/begin CHARACTERISTIC EGSDU_DlyMeasS2B1_I.corrCatEftLtr_Map "Measurement of delay time, sensor 2 (binary sensor) / Characteristic map for correction of delay measurement Lean-Rich via Gradient caused by catalyst storage capacity and exhaust mass flow" MAP 0x8051C76C RB_Map_U16U16_U16 655.3500 t_q0p01 0.00 655.3500 FORMAT "%8.4"
 /begin AXIS_DESCR STD_AXIS EGSDU_DlyMeasS2B1_I.duLtrCorrGrdt spgg_q0p00488_V_DIV_s 4 0.00 319.9951 FORMAT "%8.4" DEPOSIT ABSOLUTE /end AXIS_DESCR
 /begin AXIS_DESCR STD_AXIS NO_INPUT_QUANTITY m_q0p1 4 0.00 6553.500 FORMAT "%8.3" DEPOSIT ABSOLUTE /end AXIS_DESCR
/end CHARACTERISTIC
/begin CHARACTERISTIC EGSDU_DlyMeasS2B1_I.corrCatEftRtl_Map "Measurement of delay time, sensor 2 (binary sensor) / Characteristic map for correction of delay measurement Rich-Lean via Gradient caused by catalyst storage capacity and exhaust mass flow" MAP 0x8051C7A0 RB_Map_U16U16_U16 655.3500 t_q0p01 0.00 655.3500 FORMAT "%8.4"
 /begin AXIS_DESCR STD_AXIS EGSDU_DlyMeasS2B1_I.duRtlCorrGrdt spgg_q0p00488_V_DIV_s 10 0.00 319.9951 FORMAT "%8.4" DEPOSIT ABSOLUTE /end AXIS_DESCR
 /begin AXIS_DESCR STD_AXIS NO_INPUT_QUANTITY m_q0p1 10 0.00 6553.500 FORMAT "%8.3" DEPOSIT ABSOLUTE /end AXIS_DESCR
/end CHARACTERISTIC
/begin CHARACTERISTIC EGSDU_duFallDly_C "Threshold voltage decrease for measurement delay time of sensor voltage rich to lean" VALUE 0x8051C724 RB_Val_Wu16 4.998779 spg_q1p221Em3_V 0.00 4.998779 FORMAT "%8.6" EXTENDED_LIMITS 0.00 79.99878 /end CHARACTERISTIC
/begin CHARACTERISTIC EGSDU_duFallGrdtDly_C "Threshold voltage decrease for calculation of correction gradient for delay time of sensor voltage rich to lean" VALUE 0x8051C726 RB_Val_Wu16 4.998779 spg_q1p221Em3_V 0.00 4.998779 FORMAT "%8.6" EXTENDED_LIMITS 0.00 79.99878 /end CHARACTERISTIC
/begin CHARACTERISTIC EGSDU_duMinRateTran_C "Minimum change of sensor voltage for calculatrion of time constant for single step" VALUE 0x8051C92C RB_Val_Wu16 4.998779 spg_q1p221Em3_V 0.00 4.998779 FORMAT "%8.6" EXTENDED_LIMITS 0.00 79.99878 /end CHARACTERISTIC
/begin CHARACTERISTIC EGSDU_duRiseDly_C "Threshold voltage increase during measurement delay time of sensor voltage lean to rich" VALUE 0x8051C728 RB_Val_Wu16 4.998779 spg_q1p221Em3_V 0.00 4.998779 FORMAT "%8.6" EXTENDED_LIMITS 0.00 79.99878 /end CHARACTERISTIC
/begin CHARACTERISTIC EGSDU_duRiseGrdtDly_C "Threshold voltage increase for calculation of correction gradient for delay time of sensor voltage lean to rich" VALUE 0x8051C72A RB_Val_Wu16 4.998779 spg_q1p221Em3_V 0.00 4.998779 FORMAT "%8.6" EXTENDED_LIMITS 0.00 79.99878 /end CHARACTERISTIC
/begin CHARACTERISTIC EGSDU_duS2StrtLtrInflTranDly_C "Voltage slope to start the delay measuerement in case of delay-transition cross-influence correction, lean to rich, sensor 2" VALUE 0x8051C72C RB_Val_Ws16 49.99924 RBPtCel_du_7p62939em4 -25.00000 24.99924 FORMAT "%8.5" /end CHARACTERISTIC
/begin CHARACTERISTIC EGSDU_duS2StrtRtlInflTranDly_C "Voltage slope to start the delay measuerement in case of delay-transition cross-influence correction, rich to lean, sensor 2" VALUE 0x8051C72E RB_Val_Ws16 49.99924 RBPtCel_du_7p62939em4 -25.00000 24.99924 FORMAT "%8.5" /end CHARACTERISTIC
/begin CHARACTERISTIC EGSDU_facBndErrEvln_C "Limitation of values: 1.5" VALUE 0x8051C894 RB_Val_Wu16 3.999939 fak_uw_b4 0.00 3.999939 FORMAT "%8.6" READ_ONLY /end CHARACTERISTIC
/begin CHARACTERISTIC EGSDU_flgCorrCatEftDly_CW "Codeword (Binary): correction of delay time due catalyst effects" VALUE 0x8051C730 RB_Val_Wu8 1.00000000000 B_TRUE 0.00 1.00000000000 FORMAT "%13.11" /end CHARACTERISTIC
/begin CHARACTERISTIC EGSDU_flgS2LtrDlyArthEvln_CW "Codeword (Binary): Apply arithmetic filter for delay time of sensor voltage at transition lean-rich, sensor 2" VALUE 0x8051C896 RB_Val_Wu8 1.00000000000 B_TRUE 0.00 1.00000000000 FORMAT "%13.11" /end CHARACTERISTIC
/begin CHARACTERISTIC EGSDU_flgS2LtrTranArthEvln_CW "Codeword (Binary): Apply arithmetic filter for transition time of sensor voltage at transition lean-rich, sensor 2" VALUE 0x8051C897 RB_Val_Wu8 1.00000000000 B_TRUE 0.00 1.00000000000 FORMAT "%13.11" /end CHARACTERISTIC
/begin CHARACTERISTIC EGSDU_flgS2RtlDlyArthEvln_CW "Codeword (Binary): Apply arithmetic filter for delay time of sensor voltage at transition rich-lean, sensor 2" VALUE 0x8051C898 RB_Val_Wu8 1.00000000000 B_TRUE 0.00 1.00000000000 FORMAT "%13.11" /end CHARACTERISTIC
/begin CHARACTERISTIC EGSDU_flgS2RtlTranArthEvln_CW "Codeword (Binary):Apply arithmetic filter for transition time of sensor voltage at transition rich-lean, sensor 2" VALUE 0x8051C899 RB_Val_Wu8 1.00000000000 B_TRUE 0.00 1.00000000000 FORMAT "%13.11" /end CHARACTERISTIC
/begin CHARACTERISTIC EGSDU_ratLamNoiseLtrDly_C "distance to target lambda during measurement of delay time lean to rich of sensor voltage" VALUE 0x8051C732 RB_Val_Wu16 15.99976 fak_uw_b16 0.00 15.99976 FORMAT "%8.5" /end CHARACTERISTIC
/begin CHARACTERISTIC EGSDU_ratLamNoiseRtlDly_C "distance to target lambda during measurement of delay time rich to lean of sensor voltage" VALUE 0x8051C734 RB_Val_Wu16 15.99976 fak_uw_b16 0.00 15.99976 FORMAT "%8.5" /end CHARACTERISTIC
/begin CHARACTERISTIC EGSDU_S2B1LtrFilDlyEvln_I.numMeasShtrp_C "Class instance: filter delay time of sensor voltage at transition lean-rich, sensor 2, bank 1 / number of necessary measurements for short trip" VALUE 0x8051C8C8 RB_Val_Wu8 255.0 dez 0.00 255.0 FORMAT "%5.1" /end CHARACTERISTIC
/begin CHARACTERISTIC EGSDU_S2B1LtrFilDlyEvln_I.numMeasStepChg_C "Class instance: filter delay time of sensor voltage at transition lean-rich, sensor 2, bank 1 / number of necessary measurements in case of step change" VALUE 0x8051C8C9 RB_Val_Wu8 255.0 dez 0.00 255.0 FORMAT "%5.1" /end CHARACTERISTIC
/begin CHARACTERISTIC EGSDU_S2B1LtrFilDlyEvln_I.numMeas_C "Class instance: filter delay time of sensor voltage at transition lean-rich, sensor 2, bank 1 / Minimum number of Tests for Fast Initial Response and Step Change for EWMA-Filter" VALUE 0x8051C8CA RB_Val_Wu8 255.0 dez 0.00 255.0 FORMAT "%5.1" /end CHARACTERISTIC
/begin CHARACTERISTIC EGSDU_S2B1LtrFilDlyEvln_I.tiBndErrEvlnOffs_C "Class instance: filter delay time of sensor voltage at transition lean-rich, sensor 2, bank 1 / Offset correciont for the filtering Diagnosis incase of the vehicle in production Mode" VALUE 0x8051C8CC RB_Val_Ws16 655.3500 t_q0p01 -327.6800 327.6700 FORMAT "%8.4" /end CHARACTERISTIC
/begin CHARACTERISTIC EGSDU_S2B1LtrFilDlyEvln_I.tiEwma_C "Class instance: filter delay time of sensor voltage at transition lean-rich, sensor 2, bank 1 / Filter constant for EWMA-Filter" VALUE 0x8051C8CE RB_Val_Wu8 0.9961 fak_ub_b1 0.00 0.9961 /end CHARACTERISTIC
/begin CHARACTERISTIC EGSDU_S2B1LtrFilDlyEvln_I.tiIni_C "Class instance: filter delay time of sensor voltage at transition lean-rich, sensor 2, bank 1 / Initial value of dynamic time" VALUE 0x8051C8D0 RB_Val_Ws16 655.3500 t_q0p01 -327.6800 327.6700 FORMAT "%8.4" /end CHARACTERISTIC
/begin CHARACTERISTIC EGSDU_S2B1LtrFilDlyEvln_I.tiStepChgCnf_C "Class instance: filter delay time of sensor voltage at transition lean-rich, sensor 2, bank 1 / Threshold (absolute) to confirm Step Change for EWMA-Filter" VALUE 0x8051C8D2 RB_Val_Wu16 655.3500 t_q0p01 0.00 655.3500 FORMAT "%8.4" /end CHARACTERISTIC
/begin CHARACTERISTIC EGSDU_S2B1LtrFilDlyEvln_I.tiStepChgSus_C "Class instance: filter delay time of sensor voltage at transition lean-rich, sensor 2, bank 1 / Threshold (absolut) to trigger Step Change logic for EWMA-Filter" VALUE 0x8051C8D4 RB_Val_Wu16 655.3500 t_q0p01 0.00 655.3500 FORMAT "%8.4" /end CHARACTERISTIC
/begin CHARACTERISTIC EGSDU_S2B1LtrFilTranEvln_I.numMeasShtrp_C "Class instance: filter transition time of sensor voltage at transition lean-rich, sensor 2, bank 1 / number of necessary measurements for short trip" VALUE 0x8051C8E4 RB_Val_Wu8 255.0 dez 0.00 255.0 FORMAT "%5.1" /end CHARACTERISTIC
/begin CHARACTERISTIC EGSDU_S2B1LtrFilTranEvln_I.numMeasStepChg_C "Class instance: filter transition time of sensor voltage at transition lean-rich, sensor 2, bank 1 / number of necessary measurements in case of step change" VALUE 0x8051C8E5 RB_Val_Wu8 255.0 dez 0.00 255.0 FORMAT "%5.1" /end CHARACTERISTIC
/begin CHARACTERISTIC EGSDU_S2B1LtrFilTranEvln_I.numMeas_C "Class instance: filter transition time of sensor voltage at transition lean-rich, sensor 2, bank 1 / Minimum number of Tests for Fast Initial Response and Step Change for EWMA-Filter" VALUE 0x8051C8E6 RB_Val_Wu8 255.0 dez 0.00 255.0 FORMAT "%5.1" /end CHARACTERISTIC
/begin CHARACTERISTIC EGSDU_S2B1LtrFilTranEvln_I.tiBndErrEvlnOffs_C "Class instance: filter transition time of sensor voltage at transition lean-rich, sensor 2, bank 1 / Offset correciont for the filtering Diagnosis incase of the vehicle in production Mode" VALUE 0x8051C8E8 RB_Val_Ws16 655.3500 t_q0p01 -327.6800 327.6700 FORMAT "%8.4" /end CHARACTERISTIC
/begin CHARACTERISTIC EGSDU_S2B1LtrFilTranEvln_I.tiEwma_C "Class instance: filter transition time of sensor voltage at transition lean-rich, sensor 2, bank 1 / Filter constant for EWMA-Filter" VALUE 0x8051C8EA RB_Val_Wu8 0.9961 fak_ub_b1 0.00 0.9961 /end CHARACTERISTIC
/begin CHARACTERISTIC EGSDU_S2B1LtrFilTranEvln_I.tiIni_C "Class instance: filter transition time of sensor voltage at transition lean-rich, sensor 2, bank 1 / Initial value of dynamic time" VALUE 0x8051C8EC RB_Val_Ws16 655.3500 t_q0p01 -327.6800 327.6700 FORMAT "%8.4" /end CHARACTERISTIC
/begin CHARACTERISTIC EGSDU_S2B1LtrFilTranEvln_I.tiStepChgCnf_C "Class instance: filter transition time of sensor voltage at transition lean-rich, sensor 2, bank 1 / Threshold (absolute) to confirm Step Change for EWMA-Filter" VALUE 0x8051C8EE RB_Val_Wu16 655.3500 t_q0p01 0.00 655.3500 FORMAT "%8.4" /end CHARACTERISTIC
/begin CHARACTERISTIC EGSDU_S2B1LtrFilTranEvln_I.tiStepChgSus_C "Class instance: filter transition time of sensor voltage at transition lean-rich, sensor 2, bank 1 / Threshold (absolut) to trigger Step Change logic for EWMA-Filter" VALUE 0x8051C8F0 RB_Val_Wu16 655.3500 t_q0p01 0.00 655.3500 FORMAT "%8.4" /end CHARACTERISTIC
/begin CHARACTERISTIC EGSDU_S2B1MinTiLtrTran_I.uDstTarTran_C "Class instance: measurement of transition time of sensor voltage lean to rich, sensor 2, bank 1 / Delta voltage between end of transition time check to target sensor voltage of PT1 model caculation" VALUE 0x8051C974 RB_Val_Wu16 4.998779 spg_q1p221Em3_V 0.00 4.998779 FORMAT "%8.6" EXTENDED_LIMITS 0.00 79.99878 /end CHARACTERISTIC
/begin CHARACTERISTIC EGSDU_S2B1MinTiRtlTran_I.uDstTarTran_C "Class instance: measurement of transition time of sensor voltage rich to lean, sensor 2, bank 1 / Delta voltage between end of transition time check to target sensor voltage of PT1 model caculation" VALUE 0x8051C97C RB_Val_Wu16 4.998779 spg_q1p221Em3_V 0.00 4.998779 FORMAT "%8.6" EXTENDED_LIMITS 0.00 79.99878 /end CHARACTERISTIC
/begin CHARACTERISTIC EGSDU_S2B1RtlFilDlyEvln_I.numMeasShtrp_C "Class instance: filter delay time of sensor voltage at transition rich-lean, sensor 2, bank 1 / number of necessary measurements for short trip" VALUE 0x8051C900 RB_Val_Wu8 255.0 dez 0.00 255.0 FORMAT "%5.1" /end CHARACTERISTIC
/begin CHARACTERISTIC EGSDU_S2B1RtlFilDlyEvln_I.numMeasStepChg_C "Class instance: filter delay time of sensor voltage at transition rich-lean, sensor 2, bank 1 / number of necessary measurements in case of step change" VALUE 0x8051C901 RB_Val_Wu8 255.0 dez 0.00 255.0 FORMAT "%5.1" /end CHARACTERISTIC
/begin CHARACTERISTIC EGSDU_S2B1RtlFilDlyEvln_I.numMeas_C "Class instance: filter delay time of sensor voltage at transition rich-lean, sensor 2, bank 1 / Minimum number of Tests for Fast Initial Response and Step Change for EWMA-Filter" VALUE 0x8051C902 RB_Val_Wu8 255.0 dez 0.00 255.0 FORMAT "%5.1" /end CHARACTERISTIC
/begin CHARACTERISTIC EGSDU_S2B1RtlFilDlyEvln_I.tiBndErrEvlnOffs_C "Class instance: filter delay time of sensor voltage at transition rich-lean, sensor 2, bank 1 / Offset correciont for the filtering Diagnosis incase of the vehicle in production Mode" VALUE 0x8051C904 RB_Val_Ws16 655.3500 t_q0p01 -327.6800 327.6700 FORMAT "%8.4" /end CHARACTERISTIC
/begin CHARACTERISTIC EGSDU_S2B1RtlFilDlyEvln_I.tiEwma_C "Class instance: filter delay time of sensor voltage at transition rich-lean, sensor 2, bank 1 / Filter constant for EWMA-Filter" VALUE 0x8051C906 RB_Val_Wu8 0.9961 fak_ub_b1 0.00 0.9961 /end CHARACTERISTIC
/begin CHARACTERISTIC EGSDU_S2B1RtlFilDlyEvln_I.tiIni_C "Class instance: filter delay time of sensor voltage at transition rich-lean, sensor 2, bank 1 / Initial value of dynamic time" VALUE 0x8051C908 RB_Val_Ws16 655.3500 t_q0p01 -327.6800 327.6700 FORMAT "%8.4" /end CHARACTERISTIC
/begin CHARACTERISTIC EGSDU_S2B1RtlFilDlyEvln_I.tiStepChgCnf_C "Class instance: filter delay time of sensor voltage at transition rich-lean, sensor 2, bank 1 / Threshold (absolute) to confirm Step Change for EWMA-Filter" VALUE 0x8051C90A RB_Val_Wu16 655.3500 t_q0p01 0.00 655.3500 FORMAT "%8.4" /end CHARACTERISTIC
/begin CHARACTERISTIC EGSDU_S2B1RtlFilDlyEvln_I.tiStepChgSus_C "Class instance: filter delay time of sensor voltage at transition rich-lean, sensor 2, bank 1 / Threshold (absolut) to trigger Step Change logic for EWMA-Filter" VALUE 0x8051C90C RB_Val_Wu16 655.3500 t_q0p01 0.00 655.3500 FORMAT "%8.4" /end CHARACTERISTIC
/begin CHARACTERISTIC EGSDU_S2B1RtlFilTranEvln_I.numMeasShtrp_C "Class instance: filter transition time of sensor voltage at transition rich-lean, sensor 2, bank 1 / number of necessary measurements for short trip" VALUE 0x8051C91C RB_Val_Wu8 255.0 dez 0.00 255.0 FORMAT "%5.1" /end CHARACTERISTIC
/begin CHARACTERISTIC EGSDU_S2B1RtlFilTranEvln_I.numMeasStepChg_C "Class instance: filter transition time of sensor voltage at transition rich-lean, sensor 2, bank 1 / number of necessary measurements in case of step change" VALUE 0x8051C91D RB_Val_Wu8 255.0 dez 0.00 255.0 FORMAT "%5.1" /end CHARACTERISTIC
/begin CHARACTERISTIC EGSDU_S2B1RtlFilTranEvln_I.numMeas_C "Class instance: filter transition time of sensor voltage at transition rich-lean, sensor 2, bank 1 / Minimum number of Tests for Fast Initial Response and Step Change for EWMA-Filter" VALUE 0x8051C91E RB_Val_Wu8 255.0 dez 0.00 255.0 FORMAT "%5.1" /end CHARACTERISTIC
/begin CHARACTERISTIC EGSDU_S2B1RtlFilTranEvln_I.tiBndErrEvlnOffs_C "Class instance: filter transition time of sensor voltage at transition rich-lean, sensor 2, bank 1 / Offset correciont for the filtering Diagnosis incase of the vehicle in production Mode" VALUE 0x8051C920 RB_Val_Ws16 655.3500 t_q0p01 -327.6800 327.6700 FORMAT "%8.4" /end CHARACTERISTIC
/begin CHARACTERISTIC EGSDU_S2B1RtlFilTranEvln_I.tiEwma_C "Class instance: filter transition time of sensor voltage at transition rich-lean, sensor 2, bank 1 / Filter constant for EWMA-Filter" VALUE 0x8051C922 RB_Val_Wu8 0.9961 fak_ub_b1 0.00 0.9961 /end CHARACTERISTIC
/begin CHARACTERISTIC EGSDU_S2B1RtlFilTranEvln_I.tiIni_C "Class instance: filter transition time of sensor voltage at transition rich-lean, sensor 2, bank 1 / Initial value of dynamic time" VALUE 0x8051C924 RB_Val_Ws16 655.3500 t_q0p01 -327.6800 327.6700 FORMAT "%8.4" /end CHARACTERISTIC
/begin CHARACTERISTIC EGSDU_S2B1RtlFilTranEvln_I.tiStepChgCnf_C "Class instance: filter transition time of sensor voltage at transition rich-lean, sensor 2, bank 1 / Threshold (absolute) to confirm Step Change for EWMA-Filter" VALUE 0x8051C926 RB_Val_Wu16 655.3500 t_q0p01 0.00 655.3500 FORMAT "%8.4" /end CHARACTERISTIC
/begin CHARACTERISTIC EGSDU_S2B1RtlFilTranEvln_I.tiStepChgSus_C "Class instance: filter transition time of sensor voltage at transition rich-lean, sensor 2, bank 1 / Threshold (absolut) to trigger Step Change logic for EWMA-Filter" VALUE 0x8051C928 RB_Val_Wu16 655.3500 t_q0p01 0.00 655.3500 FORMAT "%8.4" /end CHARACTERISTIC
/begin CHARACTERISTIC EGSDU_S2TiLenLtrDly_CUR "Characteristic line: Expected delay time of sensor voltage at transition lean to rich in system without fault, sensor 2" CURVE 0x8051C736 RB_Curve_U16_U16 655.3500 t_q0p01 0.00 655.3500 FORMAT "%8.4"
 /begin AXIS_DESCR STD_AXIS EGSDCmn_mfEgCat1B1Parl m_q0p1 5 0.00 6553.500 FORMAT "%8.3" DEPOSIT ABSOLUTE /end AXIS_DESCR
/end CHARACTERISTIC
/begin CHARACTERISTIC EGSDU_S2TiLenRtlDly_CUR "Characteristic line: Expected delay time of sensor voltage at transition rich to lean in system without fault, sensor 2" CURVE 0x8051C74C RB_Curve_U16_U16 655.3500 t_q0p01 0.00 655.3500 FORMAT "%8.4"
 /begin AXIS_DESCR STD_AXIS EGSDCmn_mfEgCat1B1Parl m_q0p1 5 0.00 6553.500 FORMAT "%8.3" DEPOSIT ABSOLUTE /end AXIS_DESCR
/end CHARACTERISTIC
/begin CHARACTERISTIC EGSDU_tiBgnRiInhbTran_C "Minimum time constant to activate the inhibit of binary sensor internal resistance measurement during transition time check" VALUE 0x8051C92E RB_Val_Wu16 655.3500 t_q0p01 0.00 655.3500 FORMAT "%8.4" /end CHARACTERISTIC
/begin CHARACTERISTIC EGSDU_tiS2CoorrLtrTran_Crv "Characteristic Line for normalization of transition time lean-rich" CURVE 0x8051C930 RB_Curve_U16_U16 655.3500 t_q0p01 0.00 655.3500 FORMAT "%8.4"
 /begin AXIS_DESCR STD_AXIS EGSDCmn_mfEgCat1B1Parl m_q0p1 6 0.00 6553.500 FORMAT "%8.3" DEPOSIT ABSOLUTE /end AXIS_DESCR
/end CHARACTERISTIC
/begin CHARACTERISTIC EGSDU_tiS2CoorrRtlTran_Crv "Characteristic Line for normalization of transition time rich-lean" CURVE 0x8051C94A RB_Curve_U16_U16 655.3500 t_q0p01 0.00 655.3500 FORMAT "%8.4"
 /begin AXIS_DESCR STD_AXIS EGSDCmn_mfEgCat1B1Parl m_q0p1 6 0.00 6553.500 FORMAT "%8.3" DEPOSIT ABSOLUTE /end AXIS_DESCR
/end CHARACTERISTIC
/begin CHARACTERISTIC EGSDU_tiS2DlyAsymcThdEvln "Threshold to detect asymmetric transition time" VALUE 0x8051C89A RB_Val_Wu16 655.3500 t_q0p01 0.00 655.3500 FORMAT "%8.4" /end CHARACTERISTIC
/begin CHARACTERISTIC EGSDU_tiS2LtrBPUDlyEvln_C "threshold ""best performing unacceptable"" of delay time of sensor voltage for transition lean to rich, sensor 2" VALUE 0x8051C89C RB_Val_Wu16 655.3500 t_q0p01 0.00 655.3500 FORMAT "%8.4" /end CHARACTERISTIC
/begin CHARACTERISTIC EGSDU_tiS2LtrBPUTranEvln_C "threshold ""best performing unacceptable"" of transition time of sensor voltage for transition lean to rich, sensor 2" VALUE 0x8051C89E RB_Val_Wu16 655.3500 t_q0p01 0.00 655.3500 FORMAT "%8.4" /end CHARACTERISTIC
/begin CHARACTERISTIC EGSDU_tiS2LtrErrDlyEvln_C "fault threshold of delay time of sensor voltage for transition lean to rich, sensor 2" VALUE 0x8051C8A0 RB_Val_Wu16 655.3500 t_q0p01 0.00 655.3500 FORMAT "%8.4" /end CHARACTERISTIC
/begin CHARACTERISTIC EGSDU_tiS2LtrErrShtrpDlyEvln_C "threshold best performing unacceptable of transition time of sensor voltage for transition lean to rich in short trip, sensor 2" VALUE 0x8051C8A2 RB_Val_Wu16 655.3500 t_q0p01 0.00 655.3500 FORMAT "%8.4" /end CHARACTERISTIC
/begin CHARACTERISTIC EGSDU_tiS2LtrErrShtrpTranEvln_C "fault threshold of transition time of sensor voltage during crossing lean to rich in short trip, sensor 2" VALUE 0x8051C8A4 RB_Val_Wu16 655.3500 t_q0p01 0.00 655.3500 FORMAT "%8.4" /end CHARACTERISTIC
/begin CHARACTERISTIC EGSDU_tiS2LtrErrTranEvln_C "fault threshold of transition time of sensor voltage during crossing lean to rich, sensor 2" VALUE 0x8051C8A6 RB_Val_Wu16 655.3500 t_q0p01 0.00 655.3500 FORMAT "%8.4" /end CHARACTERISTIC
/begin CHARACTERISTIC EGSDU_tiS2LtrInflDlyTran_C "Threshold for the correction of the cross-influence of the lean to rich transition time on the following rich to lean delay diagnosis, sensor 2" VALUE 0x8051C964 RB_Val_Ws16 655.3500 t_q0p01 -327.6800 327.6700 FORMAT "%8.4" /end CHARACTERISTIC
/begin CHARACTERISTIC EGSDU_tiS2LtrSusTranEvln_C "threshold: transition time of sensor voltage for transition lean to rich has impact on measured delay, sensor 2" VALUE 0x8051C8A8 RB_Val_Wu16 655.3500 t_q0p01 0.00 655.3500 FORMAT "%8.4" /end CHARACTERISTIC
/begin CHARACTERISTIC EGSDU_tiS2RtlBPUDlyEvln_C "threshold ""best performing unacceptable"" of delay time of sensor voltage for transition rich to lean, sensor 2" VALUE 0x8051C8AA RB_Val_Wu16 655.3500 t_q0p01 0.00 655.3500 FORMAT "%8.4" /end CHARACTERISTIC
/begin CHARACTERISTIC EGSDU_tiS2RtlBPUTranEvln_C "threshold ""best performing unacceptable"" of transition time of sensor voltage for transition rich to lean, sensor 2" VALUE 0x8051C8AC RB_Val_Wu16 655.3500 t_q0p01 0.00 655.3500 FORMAT "%8.4" /end CHARACTERISTIC
/begin CHARACTERISTIC EGSDU_tiS2RtlErrDlyEvln_C "fault threshold of delay time of sensor voltage for transition rich to lean, sensor 2" VALUE 0x8051C8AE RB_Val_Wu16 655.3500 t_q0p01 0.00 655.3500 FORMAT "%8.4" /end CHARACTERISTIC
/begin CHARACTERISTIC EGSDU_tiS2RtlErrShtrpDlyEvln_C "fault threshold of delay time of sensor voltage for transition rich to lean in short trip, sensor 2" VALUE 0x8051C8B0 RB_Val_Wu16 655.3500 t_q0p01 0.00 655.3500 FORMAT "%8.4" /end CHARACTERISTIC
/begin CHARACTERISTIC EGSDU_tiS2RtlErrShtrpTranEvln_C "fault threshold of transition time of sensor voltage during crossing rich to lean in short trip, sensor 2" VALUE 0x8051C8B2 RB_Val_Wu16 655.3500 t_q0p01 0.00 655.3500 FORMAT "%8.4" /end CHARACTERISTIC
/begin CHARACTERISTIC EGSDU_tiS2RtlErrTranEvln_C "fault threshold of transition time of sensor voltage during crossing rich to lean, sensor 2" VALUE 0x8051C8B4 RB_Val_Wu16 655.3500 t_q0p01 0.00 655.3500 FORMAT "%8.4" /end CHARACTERISTIC
/begin CHARACTERISTIC EGSDU_tiS2RtlInflDlyTran_C "Threshold for the correction of the cross-influence of the rich to lean transition time on the following lean to rich delay diagnosis, sensor 2" VALUE 0x8051C966 RB_Val_Ws16 655.3500 t_q0p01 -327.6800 327.6700 FORMAT "%8.4" /end CHARACTERISTIC
/begin CHARACTERISTIC EGSDU_tiS2RtlSusTranEvln_C "threshold: transition time of sensor voltage for transition rich to lean has impact on measured delay, sensor 2" VALUE 0x8051C8B6 RB_Val_Wu16 655.3500 t_q0p01 0.00 655.3500 FORMAT "%8.4" /end CHARACTERISTIC
/begin CHARACTERISTIC EGSDU_tiS2TranAsymcThdEvln "Threshold to detect asymmetric delay time" VALUE 0x8051C8B8 RB_Val_Wu16 655.3500 t_q0p01 0.00 655.3500 FORMAT "%8.4" /end CHARACTERISTIC
/begin CHARACTERISTIC EGSDU_tiToutLtrDly_C "Maximum time for measurement delay time of sensor voltage at transition lean to rich" VALUE 0x8051C762 RB_Val_Wu16 655.3500 t_q0p01 0.00 655.3500 FORMAT "%8.4" /end CHARACTERISTIC
/begin CHARACTERISTIC EGSDU_tiToutRtlDly_C "Maximum time for measurement delay time of sensor voltage at transition rich to lean" VALUE 0x8051C764 RB_Val_Wu16 655.3500 t_q0p01 0.00 655.3500 FORMAT "%8.4" /end CHARACTERISTIC
/begin CHARACTERISTIC EGSDU_uEndLtrTran_C "sensor voltage to determinate the end of transition time check rich-lean" VALUE 0x8051C968 RB_Val_Wu16 4.998779 spg_q1p221Em3_V 0.00 4.998779 FORMAT "%8.6" EXTENDED_LIMITS 0.00 79.99878 /end CHARACTERISTIC
/begin CHARACTERISTIC EGSDU_uEndRtlTranParl_C "Destination voltage to determinate the end of transition time check lean-rich during active parallelization" VALUE 0x8051C96A RB_Val_Wu16 4.998779 spg_q1p221Em3_V 0.00 4.998779 FORMAT "%8.6" EXTENDED_LIMITS 0.00 79.99878 /end CHARACTERISTIC
/begin CHARACTERISTIC EGSDU_uEndRtlTran_C "Destination voltage to determinate the end of transition time check lean-rich" VALUE 0x8051C96C RB_Val_Wu16 4.998779 spg_q1p221Em3_V 0.00 4.998779 FORMAT "%8.6" EXTENDED_LIMITS 0.00 79.99878 /end CHARACTERISTIC
/begin CHARACTERISTIC ElecLd_facEPSLd_C "factor for Electric load current" VALUE 0x8051E4A4 Val_Ws16 1.000000 Fact 0.00 1.000000 FORMAT "%8.6" EXTENDED_LIMITS -4.000000 3.999878 /end CHARACTERISTIC
/begin CHARACTERISTIC ElecLd_iAirCmprGsl_C "Electric load current for Air Compressor switch ON mode in Gasoline engine" VALUE 0x8051E4A6 RB_Val_Ws16 655.3500 Curr_A -327.6800 327.6700 FORMAT "%8.4" /end CHARACTERISTIC
/begin CHARACTERISTIC ElecLd_iBlowrFanAutoAC_CUR "Curve for Blower fan voltage level (Auto AC)" CURVE 0x8051E4A8 RB_Curve_S16_S16 655.3500 Curr_A -327.6800 327.6700 FORMAT "%8.4"
 /begin AXIS_DESCR STD_AXIS Com_uFrntBlowrU Volt_q1 16 0.00 100.0 FORMAT "%5.1" EXTENDED_LIMITS 0.00 255.0 DEPOSIT ABSOLUTE /end AXIS_DESCR
/end CHARACTERISTIC
/begin CHARACTERISTIC ElecLd_iBlowrFanManAC_CUR "Curve for Blower fan voltage level (Manual AC)" CURVE 0x8051E4EA RB_Curve_S16_S16 100.0000 Curr_A 0.00 100.0000 FORMAT "%8.4" EXTENDED_LIMITS -327.6800 327.6700
 /begin AXIS_DESCR STD_AXIS ElecLd_uHeatrMot Volt_Batt 16 -655360.0 655340.0 FORMAT "%8.1" DEPOSIT ABSOLUTE /end AXIS_DESCR
/end CHARACTERISTIC
/begin CHARACTERISTIC ElecLd_iComBase_C "Additional Load Current" VALUE 0x8051E52C RB_Val_Ws16 655.3500 Curr_A -327.6800 327.6700 FORMAT "%8.4" /end CHARACTERISTIC
/begin CHARACTERISTIC ElecLd_iComElecLoadReplcmt_C "EPS load current replacement value in case of communication error" VALUE 0x8051E52E Val_Ws16 655.3500 Curr_A -327.6800 327.6700 FORMAT "%8.4" /end CHARACTERISTIC
/begin CHARACTERISTIC ElecLd_iComErrDftValGslAutAC_C "Default Auto AC Electric current for Com error in GS" VALUE 0x8051E530 RB_Val_Ws16 655.3500 Curr_A -327.6800 327.6700 FORMAT "%8.4" /end CHARACTERISTIC
/begin CHARACTERISTIC ElecLd_iComErrDftValGslManAC_C "Default Auto AC Electric current for Com error in GS" VALUE 0x8051E532 RB_Val_Ws16 655.3500 Curr_A -327.6800 327.6700 FORMAT "%8.4" /end CHARACTERISTIC
/begin CHARACTERISTIC ElecLd_iFan0_C "Electric load current value for fan off condition" VALUE 0x8051E534 RB_Val_Ws16 655.3500 Curr_A -327.6800 327.6700 FORMAT "%8.4" /end CHARACTERISTIC
/begin CHARACTERISTIC ElecLd_iFan1_C "Electric load current value for fan low condition" VALUE 0x8051E536 RB_Val_Ws16 655.3500 Curr_A -327.6800 327.6700 FORMAT "%8.4" /end CHARACTERISTIC
/begin CHARACTERISTIC ElecLd_iFan2_C "Electric load current value for fan high condition" VALUE 0x8051E538 RB_Val_Ws16 655.3500 Curr_A -327.6800 327.6700 FORMAT "%8.4" /end CHARACTERISTIC
/begin CHARACTERISTIC ElecLd_iFanExt_C "Default value of electric load current for fan" VALUE 0x8051E53A RB_Val_Ws16 655.3500 Curr_A -327.6800 327.6700 FORMAT "%8.4" /end CHARACTERISTIC
/begin CHARACTERISTIC ElecLd_iFrntDeicer1_C "Electric load current for Front de-icer switch ON mode" VALUE 0x8051E53C RB_Val_Ws16 655.3500 Curr_A -327.6800 327.6700 FORMAT "%8.4" /end CHARACTERISTIC
/begin CHARACTERISTIC ElecLd_iFrntDeicerSwt_C "Electric load current for Front de-icer switch OFF mode" VALUE 0x8051E53E RB_Val_Ws16 655.3500 Curr_A -327.6800 327.6700 FORMAT "%8.4" /end CHARACTERISTIC
/begin CHARACTERISTIC ElecLd_iFrntFog1_C "Electric load current for Front-fog lamp switch ON mode" VALUE 0x8051E540 RB_Val_Ws16 655.3500 Curr_A -327.6800 327.6700 FORMAT "%8.4" /end CHARACTERISTIC
/begin CHARACTERISTIC ElecLd_iFrntFogSwt_C "Electric load current for Front-fog lamp switch OFF mode" VALUE 0x8051E542 RB_Val_Ws16 655.3500 Curr_A -327.6800 327.6700 FORMAT "%8.4" /end CHARACTERISTIC
/begin CHARACTERISTIC ElecLd_iLiSwt0_C "Electric load current for light switch off condition" VALUE 0x8051E544 RB_Val_Ws16 655.3500 Curr_A -327.6800 327.6700 FORMAT "%8.4" /end CHARACTERISTIC
/begin CHARACTERISTIC ElecLd_iLiSwt1_C "Electric load current for small light on condition" VALUE 0x8051E546 RB_Val_Ws16 655.3500 Curr_A -327.6800 327.6700 FORMAT "%8.4" /end CHARACTERISTIC
/begin CHARACTERISTIC ElecLd_iLiSwt2_C "Electric load current for low beam" VALUE 0x8051E548 RB_Val_Ws16 655.3500 Curr_A -327.6800 327.6700 FORMAT "%8.4" /end CHARACTERISTIC
/begin CHARACTERISTIC ElecLd_iLiSwt3_C "Electric load current for high beam" VALUE 0x8051E54A RB_Val_Ws16 655.3500 Curr_A -327.6800 327.6700 FORMAT "%8.4" /end CHARACTERISTIC
/begin CHARACTERISTIC ElecLd_iReDeFoggerAutoAC1_C "Electric load current for Rear de-fogger (Auto AC) switch ON mode" VALUE 0x8051E54C RB_Val_Ws16 655.3500 Curr_A -327.6800 327.6700 FORMAT "%8.4" /end CHARACTERISTIC
/begin CHARACTERISTIC ElecLd_iReDeFoggerAutoACSwt_C "Electric load current for Rear de-fogger (Auto AC) switch OFF mode" VALUE 0x8051E54E RB_Val_Ws16 655.3500 Curr_A -327.6800 327.6700 FORMAT "%8.4" /end CHARACTERISTIC
/begin CHARACTERISTIC ElecLd_iReDeFoggerManAC1_C "Electric load current for Rear de-fogger (Manual AC) switch ON mode" VALUE 0x8051E550 RB_Val_Ws16 655.3500 Curr_A -327.6800 327.6700 FORMAT "%8.4" /end CHARACTERISTIC
/begin CHARACTERISTIC ElecLd_iReDeFoggerManACSwt_C "Electric load current for Rear de-fogger (Manual AC) switch OFF mode" VALUE 0x8051E552 RB_Val_Ws16 655.3500 Curr_A -327.6800 327.6700 FORMAT "%8.4" /end CHARACTERISTIC
/begin CHARACTERISTIC ElecLd_iReFog1_C "Electric load current for Rear-fog lamp switch ON mode" VALUE 0x8051E554 RB_Val_Ws16 655.3500 Curr_A -327.6800 327.6700 FORMAT "%8.4" /end CHARACTERISTIC
/begin CHARACTERISTIC ElecLd_iReFogSwt_C "Electric load current for Rear-fog lamp switch OFF mode" VALUE 0x8051E556 RB_Val_Ws16 655.3500 Curr_A -327.6800 327.6700 FORMAT "%8.4" /end CHARACTERISTIC
/begin CHARACTERISTIC ElecLd_iWiprHi_C "Electric load current for Wiper switch High mode" VALUE 0x8051E558 RB_Val_Ws16 655.3500 Curr_A -327.6800 327.6700 FORMAT "%8.4" /end CHARACTERISTIC
/begin CHARACTERISTIC ElecLd_iWiprLo_C "Wiper low calibration" VALUE 0x8051E55A RB_Val_Ws16 655.3500 Curr_A -327.6800 327.6700 FORMAT "%8.4" /end CHARACTERISTIC
/begin CHARACTERISTIC ElecLd_iWiprOffErr_C "Wiper off error calibration current" VALUE 0x8051E55C RB_Val_Ws16 655.3500 Curr_A -327.6800 327.6700 FORMAT "%8.4" /end CHARACTERISTIC
/begin CHARACTERISTIC ElecLd_RmpSlp.Pos_C "Structure containing ramp slopes for response in case of errors in the analog signal read from the Electric load / Slope if the ramp has to be increased" VALUE 0x8053AD48 Kw_Ws32 327679.499817 RmpCurr_A 0.500031 327679.999847 FORMAT "%13.6" EXTENDED_LIMITS -327680.000000 327679.999847 /end CHARACTERISTIC
/begin CHARACTERISTIC ElecLd_RmpSlp.Neg_C "Structure containing ramp slopes for response in case of errors in the analog signal read from the Electric load / negative ramp slope" VALUE 0x8053AD4C Kw_Ws32 327679.499817 RmpCurr_A 0.500031 327679.999847 FORMAT "%13.6" EXTENDED_LIMITS -327680.000000 327679.999847 /end CHARACTERISTIC
/begin CHARACTERISTIC ElecLd_stSwtHdLiInfoSeln_C "Head light information selection switch status" VALUE 0x8051E55E RB_Val_Wu8 1.000 OneToOne 0.00 1.000 FORMAT "%5.3" EXTENDED_LIMITS 0.00 255.0 /end CHARACTERISTIC
/begin CHARACTERISTIC ElecLd_swtCurrMdl_C "Electric Load current value Model switch" VALUE 0x8051E55F RB_Val_Wu8 1.000 OneToOne 0.00 1.000 FORMAT "%5.3" EXTENDED_LIMITS 0.00 255.0 /end CHARACTERISTIC
/begin CHARACTERISTIC ElecLd_swtEPSLd_C "switch to select Electric load current" VALUE 0x8051E560 RB_Val_Wu8 1.000 OneToOne 0.00 1.000 FORMAT "%5.3" EXTENDED_LIMITS 0.00 255.0 /end CHARACTERISTIC
/begin CHARACTERISTIC ElecLd_tiAirCdnLrng_C "Timer for AC learning" VALUE 0x8051E562 RB_Val_Ws16 655.3400 t_q0p02 0.00 655.3400 FORMAT "%8.4" EXTENDED_LIMITS -655.3600 655.3400 /end CHARACTERISTIC
/begin CHARACTERISTIC ElecLd_tiLdFltPT1_C "Time constant of the PT1 filter for Electric load current" VALUE 0x8051E564 RB_Val_Ws32 4294.9672940000000 TimeDelay_s 0.0000020000000 4294.9672959999998 FORMAT "%19.14" EXTENDED_LIMITS 0.000002000000001 4294.9672959999998 /end CHARACTERISTIC
/begin CHARACTERISTIC ElecLd_tiMdlLoadCalc_C "Time constant of the PT1 filter for the modelled load current" VALUE 0x8051E568 RB_Val_Ws32 4294.9672940000000 TimeDelay_s 0.0000020000000 4294.9672959999998 FORMAT "%19.14" EXTENDED_LIMITS 0.000002000000001 4294.9672959999998 /end CHARACTERISTIC
/begin CHARACTERISTIC ElecLd_tiPT1FltEPSLd_C "Time constant of the PT1 filter for the EPS load current" VALUE 0x8051E56C RB_Val_Ws32 4294.9672940000000 TimeDelay_s 0.0000020000000 4294.9672959999998 FORMAT "%19.14" EXTENDED_LIMITS 0.000002000000001 4294.9672959999998 /end CHARACTERISTIC
/begin CHARACTERISTIC ElecLd_TransStg.Dfl_C "Structure containing fixed replacement values and the status word to decide the response in case of errors in the analog signal read from the Electric load sensor loa / Fixed replacement value" VALUE 0x8053AD50 Kw_Ws16 327.6700 Curr_A 0.00 327.6700 FORMAT "%8.4" EXTENDED_LIMITS -327.6800 327.6700 /end CHARACTERISTIC
/begin CHARACTERISTIC ElecLd_TransStg.stSensId_C "Structure containing fixed replacement values and the status word to decide the response in case of errors in the analog signal read from the Electric load sensor loa / Sensor Id word" VALUE 0x8053AD52 Kw_Wu8 255.0 OneToOne 0.00 255.0 FORMAT "%5.1" /end CHARACTERISTIC
/begin CHARACTERISTIC EngDa_pwrCrksftMax_C "Engine reference power at crankshaft level" VALUE 0x8051E570 RB_Val_Wr32 16777215.99000 RBPtCel_pwr_kw_1p0_1 0.01000 16777216.00000 FORMAT "%20.5" EXTENDED_LIMITS -3.40282E+038 3.40282E+038 /end CHARACTERISTIC
/begin CHARACTERISTIC EngDa_tqCrksftMax_C "Engine reference torque torque at crankshaft level" VALUE 0x8051E574 RB_Val_Wr32 16777215.90000 RBPtCel_tq_1p0_1 0.10000 16777216.00000 FORMAT "%16.5" EXTENDED_LIMITS -3.40282E+038 3.40282E+038 /end CHARACTERISTIC
/begin CHARACTERISTIC EngDa_tqInnrMax_C "Maximum indicated Engine torque torque" VALUE 0x8051E578 RB_Val_Wr32 16777215.90000 RBPtCel_tq_1p0_1 0.10000 16777216.00000 FORMAT "%16.5" EXTENDED_LIMITS -3.40282E+038 3.40282E+038 /end CHARACTERISTIC
/begin CHARACTERISTIC EngDa_volDispl_C "Engine displacement" VALUE 0x8051E57C RB_Val_Wr32 16777215.99000 RBPtCel_vol_1p0_1 0.01000 16777216.00000 FORMAT "%16.5" EXTENDED_LIMITS -3.40282E+038 3.40282E+038 /end CHARACTERISTIC
/begin CHARACTERISTIC EngDem_dTqSlpLimnNeg_T "Negative slopes for the torque limitation ramp for individual error entries" VAL_BLK 0x8051E580 RB_ValA_Ws32 3276799.99847 RmpTrq 0.00 3276799.99847 FORMAT "%13.5" EXTENDED_LIMITS -3276800.00000 3276799.99847 NUMBER 4 /end CHARACTERISTIC
/begin CHARACTERISTIC EngDem_dTqSlpLimnPos_T "Positive slopes for the torque limitation ramp for individual error entries" VAL_BLK 0x8051E590 RB_ValA_Ws32 3276799.99847 RmpTrq 0.00 3276799.99847 FORMAT "%13.5" EXTENDED_LIMITS -3276800.00000 3276799.99847 NUMBER 4 /end CHARACTERISTIC
/begin CHARACTERISTIC EngDem_flgFcoEna_C "Fuel cut-off enable flag" VALUE 0x8051E5A0 RB_Val_Wu8 1.00000000000 B_TRUE 0.00 1.00000000000 FORMAT "%13.11" /end CHARACTERISTIC
/begin CHARACTERISTIC EngDem_nrRampSlpCfg_T "Configuration index for positive and negative ramping slopes" VAL_BLK 0x8051E5A1 RB_ValA_Wu8 3.000 OneToOne 0.00 3.000 FORMAT "%5.3" EXTENDED_LIMITS 0.00 255.0 NUMBER 23 /end CHARACTERISTIC
/begin CHARACTERISTIC EngDem_swtTqLimnCfg_C "Configuration of the error cases for ramping switch-off at condition target reached" VALUE 0x8051E5B8 RB_Val_Wu32 4294967295.00 OneToOne 0.00 4294967295.00 FORMAT "%13.2" /end CHARACTERISTIC
/begin CHARACTERISTIC EngDem_swtTqLimnRmpReIni_C "Configuration of the re-initialisation of the ramp when current torque leis bellow ramping value" VALUE 0x8051E5BC RB_Val_Wu32 4294967295.00 OneToOne 0.00 4294967295.00 FORMAT "%13.2" /end CHARACTERISTIC
/begin CHARACTERISTIC EngDem_tiRampIniRst_C "Ramp initialisation time after engine start" VALUE 0x8051E5C0 RB_Val_Wu8 2.550 Time_s 0.00 2.550 FORMAT "%5.3" /end CHARACTERISTIC
/begin CHARACTERISTIC EngDem_tqLimnCamsftErr_T "Torque limitation due to camshaft errors" CURVE 0x8051E5C2 RB_Curve_S16_S16 1000.000 Trq 0.00 1000.000 FORMAT "%8.3" EXTENDED_LIMITS -3276.800 3276.700
 /begin AXIS_DESCR STD_AXIS Epm_nEng EngN 6 -16384.00 16383.50 FORMAT "%8.2" DEPOSIT ABSOLUTE /end AXIS_DESCR
/end CHARACTERISTIC
/begin CHARACTERISTIC EngDem_tqLimnOilPmp_T "Curve torque limitation due to error in the oil pump" CURVE 0x8051E5DC RB_Curve_S16_S16 1000.000 Trq 0.00 1000.000 FORMAT "%8.3" EXTENDED_LIMITS -3276.800 3276.700
 /begin AXIS_DESCR STD_AXIS Epm_nEng EngN 7 -16384.00 16383.50 FORMAT "%8.2" DEPOSIT ABSOLUTE /end AXIS_DESCR
/end CHARACTERISTIC
/begin CHARACTERISTIC EngDem_tqLimnThmstHeatCtrlCirc_T "Torque limitation in the case of failure due to condition of thermostat heater circuit open" CURVE 0x8051E5FA RB_Curve_S16_S16 1000.000 Trq 0.00 1000.000 FORMAT "%8.3" EXTENDED_LIMITS -3276.800 3276.700
 /begin AXIS_DESCR STD_AXIS Epm_nEng EngN 8 -16384.00 16383.50 FORMAT "%8.2" DEPOSIT ABSOLUTE /end AXIS_DESCR
/end CHARACTERISTIC
/begin CHARACTERISTIC EngDem_trqLimErrAPP_CUR "Torque limitation in case of DK/PWR failure" CURVE 0x8051E61C RB_Curve_S16_S16 1000.000 Trq 0.00 1000.000 FORMAT "%8.3" EXTENDED_LIMITS -3276.800 3276.700
 /begin AXIS_DESCR STD_AXIS Epm_nEng EngN 8 -16384.00 16383.50 FORMAT "%8.2" DEPOSIT ABSOLUTE /end AXIS_DESCR
/end CHARACTERISTIC
/begin MEASUREMENT Com_bCVTIdleStop "Status of idle stop request" UBYTE B_TRUE 1 100 0.00 1.00000000000 BIT_MASK 0x1 FORMAT "%13.11" ECU_ADDRESS 0x6000A1C2 /end MEASUREMENT
/begin MEASUREMENT Com_bCVTStopEna "Status of Preparation for Idle Stop" UBYTE B_TRUE 1 100 0.00 1.00000000000 BIT_MASK 0x1 FORMAT "%13.11" ECU_ADDRESS 0x6000A1C1 /end MEASUREMENT
/begin MEASUREMENT Com_ctCRingENG1 "Message counter for ENG1 frame ( message counter)" UBYTE OneToOne 1 100 0.00 3.000 FORMAT "%5.3" ECU_ADDRESS 0x6000A623 /end MEASUREMENT
/begin MEASUREMENT Com_ctCRingENG10 "Ring counter for ENG10 frame" UBYTE OneToOne 1 100 0.00 255.0 FORMAT "%5.1" ECU_ADDRESS 0x6000A0E4 /end MEASUREMENT
/begin MEASUREMENT Com_ctCRingENG11 "Ring counter for ENG11 frame" UBYTE OneToOne 1 100 0.00 255.0 FORMAT "%5.1" ECU_ADDRESS 0x6000A0E3 /end MEASUREMENT
/begin MEASUREMENT Com_ctCRingENG15 "CAN RingCounter for ENG15 Frame" UBYTE OneToOne 1 100 0.00 255.0 FORMAT "%5.1" ECU_ADDRESS 0x6000A627 /end MEASUREMENT
/begin MEASUREMENT Com_ctCRingENG16 "Message counter for Eng16 frame" UBYTE OneToOne 1 100 0.00 255.0 FORMAT "%5.1" ECU_ADDRESS 0x6000A626 /end MEASUREMENT
/begin MEASUREMENT Com_ctCRingENG17 "the message Counter for ENG17 frame" UBYTE OneToOne 1 100 0.00 255.0 FORMAT "%5.1" ECU_ADDRESS 0x6000A625 /end MEASUREMENT
/begin MEASUREMENT Com_ctCRingENG18 "Message counter for Eng18 frame" UBYTE OneToOne 1 100 0.00 3.000 FORMAT "%5.3" ECU_ADDRESS 0x6000A624 /end MEASUREMENT
/begin MEASUREMENT Com_ctCRingENG19 "Ring Counter For ENG19 Frame" UBYTE OneToOne 1 100 0.00 255.0 FORMAT "%5.1" ECU_ADDRESS 0x6000A0E2 /end MEASUREMENT
/begin MEASUREMENT Com_ctCRingENG2 "Message counter info ENG2" UBYTE OneToOne 1 100 0.00 3.000 FORMAT "%5.3" ECU_ADDRESS 0x6000A620 /end MEASUREMENT
/begin MEASUREMENT Com_ctCRingENG20 "Message counter for Eng20 frame." UBYTE OneToOne 1 100 0.00 255.0 FORMAT "%5.1" ECU_ADDRESS 0x6000A0E1 /end MEASUREMENT
/begin MEASUREMENT Com_ctCRingENG21 "Ring counter message for Eng21 frame" UBYTE OneToOne 1 100 0.00 255.0 FORMAT "%5.1" ECU_ADDRESS 0x6000A622 /end MEASUREMENT
/begin MEASUREMENT Com_ctCRingENG22 "Ring counter of ENG22 frame" UBYTE OneToOne 1 100 0.00 3.000 FORMAT "%5.3" ECU_ADDRESS 0x6000A621 /end MEASUREMENT
/begin MEASUREMENT Com_ctCRingENG23 "Ring counter for Engine 23 Frame" UBYTE OneToOne 1 100 0.00 3.000 FORMAT "%5.3" ECU_ADDRESS 0x6000A0E0 /end MEASUREMENT
/begin MEASUREMENT Com_ctCRingENG24 "Ring counter for ENG24 frame" UBYTE OneToOne 1 100 0.00 3.000 FORMAT "%5.3" ECU_ADDRESS 0x6000A0DF /end MEASUREMENT
/begin MEASUREMENT Com_ctCRingENG25 "Ring counter for ENG25 frame" UBYTE OneToOne 1 100 0.00 3.000 FORMAT "%5.3" ECU_ADDRESS 0x6000A0DE /end MEASUREMENT
/begin MEASUREMENT Com_ctCRingENG3 "Message counter for ENG3 frame" UBYTE OneToOne 1 100 0.00 3.000 FORMAT "%5.3" ECU_ADDRESS 0x6000A61F /end MEASUREMENT
/begin MEASUREMENT Com_ctCRingENG4 "Message Counter info for ENG4 frame" UBYTE OneToOne 1 100 0.00 3.000 FORMAT "%5.3" ECU_ADDRESS 0x6000A61E /end MEASUREMENT
/begin MEASUREMENT Com_ctCRingENG5 "Frame counter info ENG5" UBYTE OneToOne 1 100 0.00 3.000 FORMAT "%5.3" ECU_ADDRESS 0x6000A61D /end MEASUREMENT
/begin MEASUREMENT Com_ctCRingENG6 "message counter info ENG6" UBYTE OneToOne 1 100 0.00 3.000 FORMAT "%5.3" ECU_ADDRESS 0x6000A61C /end MEASUREMENT
/begin MEASUREMENT Com_ctCRingENGA "Message counter info ENGA" UBYTE OneToOne 1 100 0.00 255.0 FORMAT "%5.1" ECU_ADDRESS 0x6000A7FD /end MEASUREMENT
/begin MEASUREMENT Com_flgACReq "A/C Clutch Connection Status" UBYTE OneToOne 1 100 0.00 255.0 FORMAT "%5.1" ECU_ADDRESS 0x6000A5ED /end MEASUREMENT
/begin MEASUREMENT Com_flgCylIndFcoStrtd "Condition: overrun fuel cut-off" UBYTE OneToOne 1 100 0.00 255.0 FORMAT "%5.1" ECU_ADDRESS 0x6000A5E9 /end MEASUREMENT
/begin MEASUREMENT Com_flgFcoRdy "Fuel Cut ready state" UBYTE OneToOne 1 100 0.00 255.0 FORMAT "%5.1" ECU_ADDRESS 0x6000A5E7 /end MEASUREMENT
/begin MEASUREMENT Com_flgValFailJdg "Failure information for engine coolant temperature" UBYTE B_TRUE 1 100 0.00 1.00000000000 BIT_MASK 0x1 FORMAT "%13.11" ECU_ADDRESS 0x6000A1B0 /end MEASUREMENT
/begin MEASUREMENT Com_flgValNormJdg "Normal information for 2nd engine coolant temperature" UBYTE B_TRUE 1 100 0.00 1.00000000000 BIT_MASK 0x1 FORMAT "%13.11" ECU_ADDRESS 0x6000A1AF /end MEASUREMENT
/begin MEASUREMENT Com_flgVirtApp "ENG_APOPEN virtual gas pedal status" UBYTE OneToOne 1 100 0.00 255.0 FORMAT "%5.1" ECU_ADDRESS 0x6000A5E3 /end MEASUREMENT
/begin MEASUREMENT Com_nEngSpd "current engine speed" SWORD EngN 1 100 -16384.00 16383.50 FORMAT "%8.2" ECU_ADDRESS 0x600051B4 /end MEASUREMENT
/begin MEASUREMENT Com_nrCsumENG15 "Checksum for ENG15 frame." UBYTE OneToOne 1 100 0.00 255.0 FORMAT "%5.1" ECU_ADDRESS 0x6000A5DF /end MEASUREMENT
/begin MEASUREMENT Com_nSetPLo "Low Idle SetPoint Speed" SWORD EngN 1 100 -16384.00 16383.50 FORMAT "%8.2" ECU_ADDRESS 0x600051AE /end MEASUREMENT
/begin MEASUREMENT Com_numCsumENG1 "Checksum message for frame ENG1" UBYTE OneToOne 1 100 0.00 15.00 FORMAT "%5.2" ECU_ADDRESS 0x6000A5C7 /end MEASUREMENT
/begin MEASUREMENT Com_numCsumENG10 "Checksum for ENG10 frame" UBYTE OneToOne 1 100 0.00 255.0 FORMAT "%5.1" ECU_ADDRESS 0x6000A0B9 /end MEASUREMENT
/begin MEASUREMENT Com_numCsumENG11 "Checksum for ENG11 frame" UBYTE OneToOne 1 100 0.00 255.0 FORMAT "%5.1" ECU_ADDRESS 0x6000A0B8 /end MEASUREMENT
/begin MEASUREMENT Com_numCsumENG16 "Checksum message for Eng16 frame" UBYTE OneToOne 1 100 0.00 255.0 FORMAT "%5.1" ECU_ADDRESS 0x6000A5CA /end MEASUREMENT
/begin MEASUREMENT Com_numCsumENG17 "The Checksum for ENG17 frame" UBYTE OneToOne 1 100 0.00 255.0 FORMAT "%5.1" ECU_ADDRESS 0x6000A5C9 /end MEASUREMENT
/begin MEASUREMENT Com_numCsumENG18 "Checksum message for Eng18 frame" UBYTE OneToOne 1 100 0.00 15.00 FORMAT "%5.2" ECU_ADDRESS 0x6000A5C8 /end MEASUREMENT
/begin MEASUREMENT Com_numCsumENG19 "Checksum of ENG19 Frame" UBYTE OneToOne 1 100 0.00 255.0 FORMAT "%5.1" ECU_ADDRESS 0x6000A0B7 /end MEASUREMENT
/begin MEASUREMENT Com_numCsumENG2 "Checksum message for frame ENG2" UBYTE OneToOne 1 100 0.00 15.00 FORMAT "%5.2" ECU_ADDRESS 0x6000A5C4 /end MEASUREMENT
/begin MEASUREMENT Com_numCsumENG20 "Checksum message for Eng20 frame." UBYTE OneToOne 1 100 0.00 255.0 FORMAT "%5.1" ECU_ADDRESS 0x6000A0B6 /end MEASUREMENT
/begin MEASUREMENT Com_numCsumENG21 "Checksum message for Eng21 frame" UBYTE OneToOne 1 100 0.00 255.0 FORMAT "%5.1" ECU_ADDRESS 0x6000A5C6 /end MEASUREMENT
/begin MEASUREMENT Com_numCsumENG22 "Checksum of ENG22 frame" UBYTE OneToOne 1 100 0.00 15.00 FORMAT "%5.2" ECU_ADDRESS 0x6000A5C5 /end MEASUREMENT
/begin MEASUREMENT Com_numCsumENG23 "Checksum message for Engine 23 Frame" UBYTE OneToOne 1 100 0.00 15.00 FORMAT "%5.2" ECU_ADDRESS 0x6000A0B5 /end MEASUREMENT
/begin MEASUREMENT Com_numCsumENG24 "Checksum for ENG24 frmae" UBYTE OneToOne 1 100 0.00 15.00 FORMAT "%5.2" ECU_ADDRESS 0x6000A0B4 /end MEASUREMENT
/begin MEASUREMENT Com_numCsumENG25 "Checksum for ENG25 frame" UBYTE OneToOne 1 100 0.00 15.00 FORMAT "%5.2" ECU_ADDRESS 0x6000A0B3 /end MEASUREMENT
/begin MEASUREMENT Com_numCsumENG3 "Checksum message for ENG3 frame" UBYTE OneToOne 1 100 0.00 15.00 FORMAT "%5.2" ECU_ADDRESS 0x6000A5C3 /end MEASUREMENT
/begin MEASUREMENT Com_numCsumENG4 "Checksum message for frame ENG4" UBYTE OneToOne 1 100 0.00 15.00 FORMAT "%5.2" ECU_ADDRESS 0x6000A5C2 /end MEASUREMENT
/begin MEASUREMENT Com_numCsumENG5 "Checksum message for frame ENG5" UBYTE OneToOne 1 100 0.00 15.00 FORMAT "%5.2" ECU_ADDRESS 0x6000A5C1 /end MEASUREMENT
/begin MEASUREMENT Com_numCsumENG6 "Checksum message for ENG6 frame" UBYTE OneToOne 1 100 0.00 15.00 FORMAT "%5.2" ECU_ADDRESS 0x6000A5C0 /end MEASUREMENT
/begin MEASUREMENT Com_numCsumENGA "Checksum message for frame ENGA" UBYTE OneToOne 1 100 0.00 255.0 FORMAT "%5.1" ECU_ADDRESS 0x6000A7FB /end MEASUREMENT
/begin MEASUREMENT Com_pEnvPRaw "Raw value for Ambient pressure value transmitted on the CAN" UWORD Pres_1_kPa 1 100 0.00 65535.00 FORMAT "%8.2" ECU_ADDRESS 0x60004D70 /end MEASUREMENT
/begin MEASUREMENT Com_rAccrPedlPosn "Accelerator pedal position" UBYTE rel_q0p392 1 100 0.00 100.0 FORMAT "%5.1" ECU_ADDRESS 0x6000A599 /end MEASUREMENT
/begin MEASUREMENT Com_rThrVlvAct "Throttle valve angle" SWORD Com_deg_q0p02441 1 100 -800.0000 799.9756 FORMAT "%8.4" ECU_ADDRESS 0x6000518E /end MEASUREMENT
/begin MEASUREMENT Com_stAltFail "Fail information for Alternator" UBYTE OneToOne 1 100 0.00 255.0 FORMAT "%5.1" ECU_ADDRESS 0x6000A572 /end MEASUREMENT
/begin MEASUREMENT Com_stCmnCntCdnStart "In-Use Performance Tracking numerator condition" UBYTE B_TRUE 1 100 0.00 1.00000000000 BIT_MASK 0x1 FORMAT "%13.11" ECU_ADDRESS 0x6000A1AC /end MEASUREMENT
/begin MEASUREMENT Com_stDcyc "Driving cycle formation flag" UBYTE OneToOne 1 100 0.00 1.000 FORMAT "%5.3" ECU_ADDRESS 0x6000A09D /end MEASUREMENT
/begin MEASUREMENT Com_stDtcInhbClr "Status of DTC Clear Inhibit" UBYTE OneToOne 1 100 0.00 255.0 FORMAT "%5.1" ECU_ADDRESS 0x6000A09A /end MEASUREMENT
/begin MEASUREMENT Com_stEngCooltTFail "Fail information for Engine coolant temperature" UBYTE OneToOne 1 100 0.00 255.0 FORMAT "%5.1" ECU_ADDRESS 0x6000A525 /end MEASUREMENT
/begin MEASUREMENT Com_stEngIntkAirFail "Fail information for Engine intake air temperature" UBYTE OneToOne 1 100 0.00 255.0 FORMAT "%5.1" ECU_ADDRESS 0x6000A523 /end MEASUREMENT
/begin MEASUREMENT Com_stEngSpd30DegFail "Fail information of engine speed 30deg" UBYTE OneToOne 1 100 0.00 255.0 FORMAT "%5.1" ECU_ADDRESS 0x6000A51F /end MEASUREMENT
/begin MEASUREMENT Com_stEngStop "Engine Stop status" UBYTE OneToOne 1 100 0.00 255.0 FORMAT "%5.1" ECU_ADDRESS 0x6000A51E /end MEASUREMENT
/begin MEASUREMENT Com_stErrLmp "Current status of MIL error lamp" UBYTE OneToOne 1 100 0.00 255.0 FORMAT "%5.1" ECU_ADDRESS 0x6000A51B /end MEASUREMENT
/begin MEASUREMENT Com_stEstmTqNormJdg "Estimated torque accuracy guarantee flag" UBYTE B_TRUE 1 100 0.00 1.00000000000 BIT_MASK 0x1 FORMAT "%13.11" ECU_ADDRESS 0x6000A1A7 /end MEASUREMENT
/begin MEASUREMENT Com_stIDASEngFail "Engine failure information for IDAS" UBYTE OneToOne 1 100 0.00 255.0 FORMAT "%5.1" ECU_ADDRESS 0x6000A4FC /end MEASUREMENT
/begin MEASUREMENT Com_stIDASEngFailOld "Value of Engine failure information about IDAS in previous driving cycle" UBYTE OneToOne 1 100 0.00 255.0 FORMAT "%5.1" ECU_ADDRESS 0x600365EF /end MEASUREMENT
/begin MEASUREMENT Com_stIDASInhb "Inhibit information about IDAS" UBYTE OneToOne 1 100 0.00 255.0 FORMAT "%5.1" ECU_ADDRESS 0x6000A4FB /end MEASUREMENT
/begin MEASUREMENT Com_stISSRelsPreNotif "Pre-notification of release engine stop by ISS" UBYTE OneToOne 1 100 0.00 255.0 FORMAT "%5.1" ECU_ADDRESS 0x6000A4EB /end MEASUREMENT
/begin MEASUREMENT Com_stMILMul "Status Information of the MultiInformation MIL" UBYTE OneToOne 1 100 0.00 255.0 FORMAT "%5.1" ECU_ADDRESS 0x6000A4DB /end MEASUREMENT
/begin MEASUREMENT Com_stMilMultiSerios "Multi information of MIL status incase of serious engine failure" UBYTE OneToOne 1 100 0.00 255.0 FORMAT "%5.1" ECU_ADDRESS 0x6000A4D9 /end MEASUREMENT
/begin MEASUREMENT Com_stPBSensFail "Fail information for manifold pressure by TDC" UBYTE OneToOne 1 100 0.00 255.0 FORMAT "%5.1" ECU_ADDRESS 0x6000A4C5 /end MEASUREMENT
/begin MEASUREMENT Com_stPrmntDenomCdnJdgStop "Judging PFC clear conditions" UBYTE B_TRUE 1 100 0.00 1.00000000000 BIT_MASK 0x1 FORMAT "%13.11" ECU_ADDRESS 0x6000A1A6 /end MEASUREMENT
/begin MEASUREMENT Com_stT15Eng21 "T15 status for Eng21 frame" UBYTE OneToOne 1 100 0.00 255.0 FORMAT "%5.1" ECU_ADDRESS 0x6000A48E /end MEASUREMENT
/begin MEASUREMENT Com_stThrPosnFail "Fail information relating to DBW" UBYTE OneToOne 1 100 0.00 255.0 FORMAT "%5.1" ECU_ADDRESS 0x6000A485 /end MEASUREMENT
/begin MEASUREMENT Com_stTqRvsnEnaFlg "Status of Torque slippage breakdown existence flag" UBYTE OneToOne 1 100 0.00 1.000 FORMAT "%5.3" ECU_ADDRESS 0x6000A483 /end MEASUREMENT
/begin MEASUREMENT Com_stTrqAccuracySlow "Slow torque required accuracy deterioration" UBYTE OneToOne 1 100 0.00 255.0 FORMAT "%5.1" ECU_ADDRESS 0x6000A482 /end MEASUREMENT
/begin MEASUREMENT Com_stTrqReqFast "Prohibition of fast torque requests" UBYTE OneToOne 1 100 0.00 255.0 FORMAT "%5.1" ECU_ADDRESS 0x6000A481 /end MEASUREMENT
/begin MEASUREMENT Com_stTrqReqSlow "Prohibition of slow torque requests" UBYTE OneToOne 1 100 0.00 255.0 FORMAT "%5.1" ECU_ADDRESS 0x6000A480 /end MEASUREMENT
/begin MEASUREMENT Com_swtDrvMod "Control state of ECON transmitted on CAN" UBYTE OneToOne 1 100 0.00 255.0 FORMAT "%5.1" ECU_ADDRESS 0x6000A45D /end MEASUREMENT
/begin MEASUREMENT Com_tiExptFcoStrt "Timer till FC starts Down Counter" ULONG Time_ms_to_us 1 100 0.00 4294967.29500 FORMAT "%13.5" ECU_ADDRESS 0x50004C14 /end MEASUREMENT
/begin MEASUREMENT Com_tiHACCut "Timer information for AC cut" UWORD t_q1_ms 1 100 0.00 65535.00 FORMAT "%8.2" ECU_ADDRESS 0x60004D5E /end MEASUREMENT
/begin MEASUREMENT Com_tqEstimdEngCrkLvl "Estimated torque at engine Crank Terminal" SWORD TrqCom_q0p02 1 100 -655.3600 655.3400 FORMAT "%8.4" ECU_ADDRESS 0x60005174 /end MEASUREMENT
/begin MEASUREMENT Com_tqMaxIDAS "Maximum IDAS torque" SWORD Trq_float 1 100 -32768.00 32767.00 FORMAT "%8.2" ECU_ADDRESS 0x6000516C /end MEASUREMENT
/begin MEASUREMENT Com_tqMinIDAS "Minimum Adjustable torque for IDAS" SWORD Trq_float 1 100 -32768.00 32767.00 FORMAT "%8.2" ECU_ADDRESS 0x6000516A /end MEASUREMENT
/begin MEASUREMENT EGSDU_ctReIni100msEvlnDs "Reini counter" UBYTE OneToOne 1 100 0.00 255.0 FORMAT "%5.1" ECU_ADDRESS 0x6000656A /end MEASUREMENT
/begin MEASUREMENT EGSDU_ctReIni100msTranDs "ReIni counter" UBYTE OneToOne 1 100 0.00 255.0 FORMAT "%5.1" ECU_ADDRESS 0x6000E39C /end MEASUREMENT
/begin MEASUREMENT EGSDU_ctReIni10msDlyDs "ReIni counter" UBYTE OneToOne 1 100 0.00 255.0 FORMAT "%5.1" ECU_ADDRESS 0x6000656B /end MEASUREMENT
/begin MEASUREMENT EGSDU_ctReIni10msEvlnDs "ReIni counter" UBYTE OneToOne 1 100 0.00 255.0 FORMAT "%5.1" ECU_ADDRESS 0x6000A3BD /end MEASUREMENT
/begin MEASUREMENT EGSDU_ctReIni10msTranDs "ReIni counter" UBYTE OneToOne 1 100 0.00 255.0 FORMAT "%5.1" ECU_ADDRESS 0x60006569 /end MEASUREMENT
/begin MEASUREMENT EGSDU_DlyMeasS2B1_I.duLtrCorrGrdt "Measurement of delay time, sensor 2 (binary sensor) / Gradient for correction of delay measurement Lean-Rich due to catalyst storage capacity" UWORD spgg_q0p00488_V_DIV_s 1 100 0.00 319.9951 FORMAT "%8.4" ECU_ADDRESS 0x60003AF8 /end MEASUREMENT
/begin MEASUREMENT EGSDU_DlyMeasS2B1_I.duRtlCorrGrdt "Measurement of delay time, sensor 2 (binary sensor) / Gradient for correction of delay measurement Rich-Lean due to catalyst storage capacity" UWORD spgg_q0p00488_V_DIV_s 1 100 0.00 319.9951 FORMAT "%8.4" ECU_ADDRESS 0x60003AFA /end MEASUREMENT
/begin MEASUREMENT EGSDU_DlyMeasS2B1_I.flgInhbRi "Measurement of delay time, sensor 2 (binary sensor) / Condition: Inhibit measurement of internal resistance for delay measurement" UBYTE B_TRUE 1 100 0.00 1.00000000000 BIT_MASK 0x1 FORMAT "%13.11" ECU_ADDRESS 0x60003AFC /end MEASUREMENT
/begin MEASUREMENT EGSDU_DlyMeasS2B1_I.flgLtrMeasFinshd "Measurement of delay time, sensor 2 (binary sensor) / flag denoting Lean to Rich measurement completion" UBYTE B_TRUE 1 100 0.00 1.00000000000 BIT_MASK 0x40 FORMAT "%13.11" ECU_ADDRESS 0x60003AF6 /end MEASUREMENT
/begin MEASUREMENT EGSDU_DlyMeasS2B1_I.flgLtrRes "Measurement of delay time, sensor 2 (binary sensor) / Condition: Delay measurement rich-lean carried out" UBYTE B_TRUE 1 100 0.00 1.00000000000 BIT_MASK 0x1 FORMAT "%13.11" ECU_ADDRESS 0x60003AFD /end MEASUREMENT
/begin MEASUREMENT EGSDU_DlyMeasS2B1_I.flgLtrTout "Measurement of delay time, sensor 2 (binary sensor) / time out flag during Lean to Rich measurement" UBYTE B_TRUE 1 100 0.00 1.00000000000 BIT_MASK 0x4 FORMAT "%13.11" ECU_ADDRESS 0x60003AF6 /end MEASUREMENT
/begin MEASUREMENT EGSDU_DlyMeasS2B1_I.flgRtlMeasFinshd "Measurement of delay time, sensor 2 (binary sensor) / flag denoting Rich to Lean measurement completion" UBYTE B_TRUE 1 100 0.00 1.00000000000 BIT_MASK 0x1 FORMAT "%13.11" ECU_ADDRESS 0x60003AF6 /end MEASUREMENT
/begin MEASUREMENT EGSDU_DlyMeasS2B1_I.flgRtlRes "Measurement of delay time, sensor 2 (binary sensor) / Condition: Delay measurement rich-lean carried out" UBYTE B_TRUE 1 100 0.00 1.00000000000 BIT_MASK 0x1 FORMAT "%13.11" ECU_ADDRESS 0x60003AFE /end MEASUREMENT
/begin MEASUREMENT EGSDU_DlyMeasS2B1_I.flgRtlTout "Measurement of delay time, sensor 2 (binary sensor) / time out flag during Lean to Rich measurement" UBYTE B_TRUE 1 100 0.00 1.00000000000 BIT_MASK 0x20 FORMAT "%13.11" ECU_ADDRESS 0x60003AF6 /end MEASUREMENT
/begin MEASUREMENT EGSDU_DlyMeasS2B1_I.flgUFall "Measurement of delay time, sensor 2 (binary sensor) / Sensor voltage is falling" UBYTE B_TRUE 1 100 0.00 1.00000000000 BIT_MASK 0x80 FORMAT "%13.11" ECU_ADDRESS 0x60003AF6 /end MEASUREMENT
/begin MEASUREMENT EGSDU_DlyMeasS2B1_I.flgURise "Measurement of delay time, sensor 2 (binary sensor) / Sensor voltage is rising" UBYTE B_TRUE 1 100 0.00 1.00000000000 BIT_MASK 0x8 FORMAT "%13.11" ECU_ADDRESS 0x60003AF6 /end MEASUREMENT
/begin MEASUREMENT EGSDU_DlyMeasS2B1_I.stParlOld "Measurement of delay time, sensor 2 (binary sensor) / old state index of state machine from coordinate function" UBYTE dez 1 100 0.00 255.0 FORMAT "%5.1" ECU_ADDRESS 0x60003AFF /end MEASUREMENT
/begin MEASUREMENT EGSDU_DlyMeasS2B1_I.tiLtrCorrGrdt "Measurement of delay time, sensor 2 (binary sensor) / Correction time lean-rich via voltage gradient" UWORD t_q0p01 1 100 0.00 655.3500 FORMAT "%8.4" ECU_ADDRESS 0x60003B00 /end MEASUREMENT
/begin MEASUREMENT EGSDU_DlyMeasS2B1_I.tiLtrCorrGrdtMax "Measurement of delay time, sensor 2 (binary sensor) / maximal correction time lean-rich via voltage gradient" UWORD t_q0p01 1 100 0.00 655.3500 FORMAT "%8.4" ECU_ADDRESS 0x60003B02 /end MEASUREMENT
/begin MEASUREMENT EGSDU_DlyMeasS2B1_I.tiLtrCorrGrdtPre "Measurement of delay time, sensor 2 (binary sensor) / preliminary correction time lean-rich via voltage gradient" UWORD t_q0p01 1 100 0.00 655.3500 FORMAT "%8.4" ECU_ADDRESS 0x60003B04 /end MEASUREMENT
/begin MEASUREMENT EGSDU_DlyMeasS2B1_I.tiLtrCorrGrdtTmp "Measurement of delay time, sensor 2 (binary sensor) / temporary correction time lean-rich via voltage gradient" UWORD t_q0p01 1 100 0.00 655.3500 FORMAT "%8.4" ECU_ADDRESS 0x60003B06 /end MEASUREMENT
/begin MEASUREMENT EGSDU_DlyMeasS2B1_I.tiLtrDly "Measurement of delay time, sensor 2 (binary sensor) / Delay lean-rich" UWORD t_q0p01 1 100 0.00 655.3500 FORMAT "%8.4" ECU_ADDRESS 0x60003B08 /end MEASUREMENT
/begin MEASUREMENT EGSDU_DlyMeasS2B1_I.tiLtrDlyMeas "Measurement of delay time, sensor 2 (binary sensor) / Lean to Rich delay time Measured" UWORD t_q0p01 1 100 0.00 655.3500 FORMAT "%8.4" ECU_ADDRESS 0x60003B0A /end MEASUREMENT
/begin MEASUREMENT EGSDU_DlyMeasS2B1_I.tiRtlCorrGrdt "Measurement of delay time, sensor 2 (binary sensor) / Correction time rich-lean via voltage gradient" UWORD t_q0p01 1 100 0.00 655.3500 FORMAT "%8.4" ECU_ADDRESS 0x60003B0C /end MEASUREMENT
/begin MEASUREMENT EGSDU_DlyMeasS2B1_I.tiRtlCorrGrdtMax "Measurement of delay time, sensor 2 (binary sensor) / maximal correction time rich-lean via voltage gradient" UWORD t_q0p01 1 100 0.00 655.3500 FORMAT "%8.4" ECU_ADDRESS 0x60003B0E /end MEASUREMENT
/begin MEASUREMENT EGSDU_DlyMeasS2B1_I.tiRtlCorrGrdtPre "Measurement of delay time, sensor 2 (binary sensor) / preliminary correction time rich-lean via voltage gradient" UWORD t_q0p01 1 100 0.00 655.3500 FORMAT "%8.4" ECU_ADDRESS 0x60003B10 /end MEASUREMENT
/begin MEASUREMENT EGSDU_DlyMeasS2B1_I.tiRtlCorrGrdtTmp "Measurement of delay time, sensor 2 (binary sensor) / temporary correction time rich-lean via voltage gradient" UWORD t_q0p01 1 100 0.00 655.3500 FORMAT "%8.4" ECU_ADDRESS 0x60003B12 /end MEASUREMENT
/begin MEASUREMENT EGSDU_DlyMeasS2B1_I.tiRtlDly "Measurement of delay time, sensor 2 (binary sensor) / Delay rich-lean" UWORD t_q0p01 1 100 0.00 655.3500 FORMAT "%8.4" ECU_ADDRESS 0x60003B14 /end MEASUREMENT
/begin MEASUREMENT EGSDU_DlyMeasS2B1_I.tiRtlDlyMeas "Measurement of delay time, sensor 2 (binary sensor) / Rich to Lean delay time Measured" UWORD t_q0p01 1 100 0.00 655.3500 FORMAT "%8.4" ECU_ADDRESS 0x60003B16 /end MEASUREMENT
/begin MEASUREMENT EGSDU_DlyMeasS2B1_I.uMax "Measurement of delay time, sensor 2 (binary sensor) / Maximum value sensor voltage for delay measurement" UWORD spg_q1p221Em3_V 1 100 0.00 4.998779 FORMAT "%8.6" ECU_ADDRESS 0x60003B18 /end MEASUREMENT
/begin MEASUREMENT EGSDU_DlyMeasS2B1_I.uMin "Measurement of delay time, sensor 2 (binary sensor) / Minimum value sensor voltage for delay measurement" UWORD spg_q1p221Em3_V 1 100 0.00 4.998779 FORMAT "%8.6" ECU_ADDRESS 0x60003B1A /end MEASUREMENT
/begin MEASUREMENT EGSDU_DlyMeasS2B1_I.EndTiCntrLtrERNM_I.oldSignal "Measurement of delay time, sensor 2 (binary sensor) / edge rising element denoting counter end time for Lean to rich transtition / value of input signal last calculation" UBYTE B_TRUE 1 100 0.00 1.00000000000 BIT_MASK 0x1 FORMAT "%13.11" ECU_ADDRESS 0x60003B1C /end MEASUREMENT
/begin MEASUREMENT EGSDU_DlyMeasS2B1_I.EndTiCntrRtlERNM_I.oldSignal "Measurement of delay time, sensor 2 (binary sensor) / edge rising element denoting counter end time for Lean to rich transtition / value of input signal last calculation" UBYTE B_TRUE 1 100 0.00 1.00000000000 BIT_MASK 0x1 FORMAT "%13.11" ECU_ADDRESS 0x60003B1D /end MEASUREMENT
/begin MEASUREMENT EGSDU_DlyMeasS2B1_I.flgLtrDurFF_I.status "Measurement of delay time, sensor 2 (binary sensor) / lean to rich delay measurement is active / current value of RS-FF" UBYTE B_TRUE 1 100 0.00 1.00000000000 BIT_MASK 0x1 FORMAT "%13.11" ECU_ADDRESS 0x60003B1E /end MEASUREMENT
/begin MEASUREMENT EGSDU_DlyMeasS2B1_I.flgRtlDurFF_I.status "Measurement of delay time, sensor 2 (binary sensor) / NVRAM contains valid rich to lean transition measurement result / current value of RS-FF" UBYTE B_TRUE 1 100 0.00 1.00000000000 BIT_MASK 0x1 FORMAT "%13.11" ECU_ADDRESS 0x60003B1F /end MEASUREMENT
/begin MEASUREMENT EGSDU_flgDSMClrDlyDs "Indication of clearing of error memory" UBYTE B_TRUE 1 100 0.00 1.00000000000 BIT_MASK 0x1 FORMAT "%13.11" ECU_ADDRESS 0x70000284 /end MEASUREMENT
/begin MEASUREMENT EGSDU_flgDSMClrTranDs "DSM Clr STatus Msg for TranDs" UBYTE B_TRUE 1 100 0.00 1.00000000000 BIT_MASK 0x1 FORMAT "%13.11" ECU_ADDRESS 0x70000838 /end MEASUREMENT
/begin MEASUREMENT EGSDU_flgS2B1AsymcFltEvln "asymmetric dynamic behavior detected in sensor 2 bank 1" UBYTE B_TRUE 1 100 0.00 1.00000000000 BIT_MASK 0x1 FORMAT "%13.11" ECU_ADDRESS 0x70000837 /end MEASUREMENT
/begin MEASUREMENT EGSDU_flgS2B1InhbRiDly "Inhibit RI measurement for measurement of delay time of sensor voltage, sensor 2, bank 1" UBYTE B_TRUE 1 100 0.00 1.00000000000 BIT_MASK 0x1 FORMAT "%13.11" ECU_ADDRESS 0x70000836 /end MEASUREMENT
/begin MEASUREMENT EGSDU_flgS2B1InhbRiEvln "Inhibit RI measurement for dynamic of sensor voltage, sensor 2, bank 1" UBYTE B_TRUE 1 100 0.00 1.00000000000 BIT_MASK 0x1 FORMAT "%13.11" ECU_ADDRESS 0x70000835 /end MEASUREMENT
/begin MEASUREMENT EGSDU_flgS2B1InhbRiTran "Inhibit RI measurement for transition time measurement of sensor voltage, sensor 2, bank 1" UBYTE B_TRUE 1 100 0.00 1.00000000000 BIT_MASK 0x1 FORMAT "%13.11" ECU_ADDRESS 0x70000834 /end MEASUREMENT
/begin MEASUREMENT EGSDU_flgS2B1LtrInflDlyTran "Lean to rich transition influences rich to lean delay diagnosis, sensor 2 bank 1" UBYTE B_TRUE 1 100 0.00 1.00000000000 BIT_MASK 0x1 FORMAT "%13.11" ECU_ADDRESS 0x70000833 /end MEASUREMENT
/begin MEASUREMENT EGSDU_flgS2B1LtrMeasTran "Measurement of transition time of sensor voltage at transition lean-rich is running, sensor 2, bank 1" UBYTE B_TRUE 1 100 0.00 1.00000000000 BIT_MASK 0x1 FORMAT "%13.11" ECU_ADDRESS 0x70000283 /end MEASUREMENT
/begin MEASUREMENT EGSDU_flgS2B1QPFaildDynEvln "Quick pass failed at evaluation dynamic diagnosis for sensor voltage of lambda sensors downstream catalyst, sensor 2, bank 1" UBYTE B_TRUE 1 100 0.00 1.00000000000 BIT_MASK 0x1 FORMAT "%13.11" ECU_ADDRESS 0x70000832 /end MEASUREMENT
/begin MEASUREMENT EGSDU_flgS2B1ResLtrDly "Single measurement delay time of sensor voltage at transition lean-rich is finished, sensor 2, bank 1" UBYTE B_TRUE 1 100 0.00 1.00000000000 BIT_MASK 0x1 FORMAT "%13.11" ECU_ADDRESS 0x70000831 /end MEASUREMENT
/begin MEASUREMENT EGSDU_flgS2B1ResLtrDlyEvln "fault check delay time of sensor voltage at transition lean to rich is finished, sensor 2, bank 1" UBYTE B_TRUE 1 100 0.00 1.00000000000 BIT_MASK 0x1 FORMAT "%13.11" ECU_ADDRESS 0x70000830 /end MEASUREMENT
/begin MEASUREMENT EGSDU_flgS2B1ResLtrTran "Single measurement transition time of sensor voltage at transition lean-rich is finished, sensor 2, bank 1" UBYTE B_TRUE 1 100 0.00 1.00000000000 BIT_MASK 0x1 FORMAT "%13.11" ECU_ADDRESS 0x7000082F /end MEASUREMENT
/begin MEASUREMENT EGSDU_flgS2B1ResLtrTranEvln "fault check transition time of sensor voltage at transition lean to rich is finished, sensor 2, bank 1" UBYTE B_TRUE 1 100 0.00 1.00000000000 BIT_MASK 0x1 FORMAT "%13.11" ECU_ADDRESS 0x7000082E /end MEASUREMENT
/begin MEASUREMENT EGSDU_flgS2B1ResRtlDly "Single measurement delay time of sensor voltage at transition rich-lean is finished, sensor 2, bank 1" UBYTE B_TRUE 1 100 0.00 1.00000000000 BIT_MASK 0x1 FORMAT "%13.11" ECU_ADDRESS 0x7000082D /end MEASUREMENT
/begin MEASUREMENT EGSDU_flgS2B1ResRtlDlyEvln "fault check delay time of sensor voltage at transition rich to lean is finished, sensor 2, bank 1" UBYTE B_TRUE 1 100 0.00 1.00000000000 BIT_MASK 0x1 FORMAT "%13.11" ECU_ADDRESS 0x7000082C /end MEASUREMENT
/begin MEASUREMENT EGSDU_flgS2B1ResRtlTran "Single measurement transition time of sensor voltage at transition rich-lean is finished, sensor 2, bank 1" UBYTE B_TRUE 1 100 0.00 1.00000000000 BIT_MASK 0x1 FORMAT "%13.11" ECU_ADDRESS 0x7000082B /end MEASUREMENT
/begin MEASUREMENT EGSDU_flgS2B1ResRtlTranEvln "fault check transition time of sensor voltage at transition rich to lean is finished, sensor 2, bank 1" UBYTE B_TRUE 1 100 0.00 1.00000000000 BIT_MASK 0x1 FORMAT "%13.11" ECU_ADDRESS 0x7000082A /end MEASUREMENT
/begin MEASUREMENT EGSDU_flgS2B1ResVirtLtrDly "IUMPR simulation of single measurement delay time of sensor voltage at transition lean-rich is finished, sensor 2, bank 1" UBYTE B_TRUE 1 100 0.00 1.00000000000 BIT_MASK 0x1 FORMAT "%13.11" ECU_ADDRESS 0x70000829 /end MEASUREMENT
/begin MEASUREMENT EGSDU_flgS2B1ResVirtLtrDlyEvln "IUMPR simulation of delay time of sensor voltage at transition lean to rich is finished, sensor 2, bank 1" UBYTE B_TRUE 1 100 0.00 1.00000000000 BIT_MASK 0x1 FORMAT "%13.11" ECU_ADDRESS 0x70000828 /end MEASUREMENT
/begin MEASUREMENT EGSDU_flgS2B1ResVirtLtrTran "IUMPR simulation of single measurement transition time of sensor voltage at transition lean-rich is finished, sensor 2, bank 1" UBYTE B_TRUE 1 100 0.00 1.00000000000 BIT_MASK 0x1 FORMAT "%13.11" ECU_ADDRESS 0x70000827 /end MEASUREMENT
/begin MEASUREMENT EGSDU_flgS2B1ResVirtLtrTranEvln "IUMPR simulation of transition time of sensor voltage at transition lean to rich is finished, sensor 2, bank 1" UBYTE B_TRUE 1 100 0.00 1.00000000000 BIT_MASK 0x1 FORMAT "%13.11" ECU_ADDRESS 0x70000826 /end MEASUREMENT
/begin MEASUREMENT EGSDU_flgS2B1ResVirtRtlActvTran "Condition: Virtual (IUMPR) for transition time measurement O2-sensor in active procedure executed (Sensor 2, Bank 1)" UBYTE B_TRUE 1 100 0.00 1.00000000000 BIT_MASK 0x1 FORMAT "%13.11" ECU_ADDRESS 0x70000282 /end MEASUREMENT
/begin MEASUREMENT EGSDU_flgS2B1ResVirtRtlDly "IUMPR simulation of single measurement delay time of sensor voltage at transition rich-lean is finished, sensor 2, bank 1" UBYTE B_TRUE 1 100 0.00 1.00000000000 BIT_MASK 0x1 FORMAT "%13.11" ECU_ADDRESS 0x70000825 /end MEASUREMENT
/begin MEASUREMENT EGSDU_flgS2B1ResVirtRtlDlyEvln "IUMPR simulation of delay time of sensor voltage at transition rich to lean is finished, sensor 2, bank 1" UBYTE B_TRUE 1 100 0.00 1.00000000000 BIT_MASK 0x1 FORMAT "%13.11" ECU_ADDRESS 0x70000824 /end MEASUREMENT
/begin MEASUREMENT EGSDU_flgS2B1ResVirtRtlTran "IUMPR simulation of single measurement transition time of sensor voltage at transition rich-lean is finished, sensor 2, bank 1" UBYTE B_TRUE 1 100 0.00 1.00000000000 BIT_MASK 0x1 FORMAT "%13.11" ECU_ADDRESS 0x70000823 /end MEASUREMENT
/begin MEASUREMENT EGSDU_flgS2B1ResVirtRtlTranEvln "IUMPR simulation of transition time of sensor voltage at transition rich to lean is finished, sensor 2, bank 1" UBYTE B_TRUE 1 100 0.00 1.00000000000 BIT_MASK 0x1 FORMAT "%13.11" ECU_ADDRESS 0x70000822 /end MEASUREMENT
/begin MEASUREMENT EGSDU_flgS2B1RtlInflDlyTran "Rich to lean transition influences lean to rich delay diagnosis, sensor 2 bank 1" UBYTE B_TRUE 1 100 0.00 1.00000000000 BIT_MASK 0x1 FORMAT "%13.11" ECU_ADDRESS 0x70000821 /end MEASUREMENT
/begin MEASUREMENT EGSDU_flgS2B1RtlMeasTran "Measurement of transition time of sensor voltage at transition rich-lean is running, sensor 2, bank 1" UBYTE B_TRUE 1 100 0.00 1.00000000000 BIT_MASK 0x1 FORMAT "%13.11" ECU_ADDRESS 0x70000281 /end MEASUREMENT
/begin MEASUREMENT EGSDU_flgS2B1StepChgDynEvln "Step change suspicion at evaluation dynamic diagnosis for sensor voltage of lambda sensors downstream catalyst, sensor 2, bank 1" UBYTE B_TRUE 1 100 0.00 1.00000000000 BIT_MASK 0x1 FORMAT "%13.11" ECU_ADDRESS 0x70000820 /end MEASUREMENT
/begin MEASUREMENT EGSDU_flgS2B1TarLeanResEvln "range check of lean target sensor voltage is completed and evaluated, sensor 2, bank 1" UBYTE B_TRUE 1 100 0.00 1.00000000000 BIT_MASK 0x1 FORMAT "%13.11" ECU_ADDRESS 0x7000081F /end MEASUREMENT
/begin MEASUREMENT EGSDU_flgS2B1TarLeanResVirtEvln "IUMPR simulation of range check of lean target sensor voltage is completed and evaluated" UBYTE B_TRUE 1 100 0.00 1.00000000000 BIT_MASK 0x1 FORMAT "%13.11" ECU_ADDRESS 0x7000081E /end MEASUREMENT
/begin MEASUREMENT EGSDU_flgS2B1TarRichResEvln "range check of rich target sensor voltage is completed and evaluated, sensor 2, bank 1" UBYTE B_TRUE 1 100 0.00 1.00000000000 BIT_MASK 0x1 FORMAT "%13.11" ECU_ADDRESS 0x7000081D /end MEASUREMENT
/begin MEASUREMENT EGSDU_flgS2B1TarRichResVirtEvln "IUMPR simulation of range check of rich target sensor voltage is completed and evaluated" UBYTE B_TRUE 1 100 0.00 1.00000000000 BIT_MASK 0x1 FORMAT "%13.11" ECU_ADDRESS 0x7000081C /end MEASUREMENT
/begin MEASUREMENT EGSDU_flgS2B1TripLtrDlyEvln "fault check delay time of sensor voltage at transition lean to rich is for this driving cycle finished, sensor 2, bank 1" UBYTE B_TRUE 1 100 0.00 1.00000000000 BIT_MASK 0x1 FORMAT "%13.11" ECU_ADDRESS 0x7000081B /end MEASUREMENT
/begin MEASUREMENT EGSDU_flgS2B1TripLtrTranEvln "fault check delay time of sensor voltage at transition lean to rich is for this driving cycle finished, sensor 2, bank 1" UBYTE B_TRUE 1 100 0.00 1.00000000000 BIT_MASK 0x1 FORMAT "%13.11" ECU_ADDRESS 0x7000081A /end MEASUREMENT
/begin MEASUREMENT EGSDU_flgS2B1TripRtlDlyEvln "fault check delay time of sensor voltage at transition rich to lean is for this driving cycle finished, sensor 2, bank 1" UBYTE B_TRUE 1 100 0.00 1.00000000000 BIT_MASK 0x1 FORMAT "%13.11" ECU_ADDRESS 0x70000819 /end MEASUREMENT
/begin MEASUREMENT EGSDU_flgS2B1TripRtlTranEvln "fault check delay time of sensor voltage at transition rich to lean is for this driving cycle finished, sensor 2, bank 1" UBYTE B_TRUE 1 100 0.00 1.00000000000 BIT_MASK 0x1 FORMAT "%13.11" ECU_ADDRESS 0x70000818 /end MEASUREMENT
/begin MEASUREMENT EGSDU_flgS2B1TripVirtLtrDlyEvln "IUMPR simulation of delay time of sensor voltage at transition lean to rich is for this driving cycle finished, sensor 2, bank 1" UBYTE B_TRUE 1 100 0.00 1.00000000000 BIT_MASK 0x1 FORMAT "%13.11" ECU_ADDRESS 0x70000817 /end MEASUREMENT
/begin MEASUREMENT EGSDU_flgS2B1TripVirtLtrTranEvln "IUMPR simulation of transition time of sensor voltage at transition lean to rich is for this driving cycle finished, sensor 2, bank 1" UBYTE B_TRUE 1 100 0.00 1.00000000000 BIT_MASK 0x1 FORMAT "%13.11" ECU_ADDRESS 0x70000816 /end MEASUREMENT
/begin MEASUREMENT EGSDU_flgS2B1TripVirtRtlDlyEvln "IUMPR simulation of delay time of sensor voltage at transition rich to lean is for this driving cycle finished, sensor 2, bank 1" UBYTE B_TRUE 1 100 0.00 1.00000000000 BIT_MASK 0x1 FORMAT "%13.11" ECU_ADDRESS 0x70000815 /end MEASUREMENT
/begin MEASUREMENT EGSDU_flgS2B1TripVirtRtlTranEvln "IUMPR simulation of transition time of sensor voltage at transition rich to lean is for this driving cycle finished, sensor 2, bank 1" UBYTE B_TRUE 1 100 0.00 1.00000000000 BIT_MASK 0x1 FORMAT "%13.11" ECU_ADDRESS 0x70000814 /end MEASUREMENT
/begin MEASUREMENT EGSDU_flgS2B1VirtQPFaildDynEvln "virtual Quick pass failed at evaluation dynamic diagnosis for sensor voltage of lambda sensors downstream catalyst, sensor 2, bank 1" UBYTE B_TRUE 1 100 0.00 1.00000000000 BIT_MASK 0x1 FORMAT "%13.11" ECU_ADDRESS 0x70000813 /end MEASUREMENT
/begin MEASUREMENT EGSDU_S2B1LtrFilDlyEvln_I.flgFCMClrReqdCL100ms "Class instance: filter delay time of sensor voltage at transition lean-rich, sensor 2, bank 1 / FCM clear status flag" UBYTE B_TRUE 1 100 0.00 1.00000000000 BIT_MASK 0x1 FORMAT "%13.11" ECU_ADDRESS 0x60001558 /end MEASUREMENT
/begin MEASUREMENT EGSDU_S2B1LtrFilDlyEvln_I.flgFCMClrReqdCL10ms "Class instance: filter delay time of sensor voltage at transition lean-rich, sensor 2, bank 1 / FCM clear status flag" UBYTE B_TRUE 1 100 0.00 1.00000000000 BIT_MASK 0x1 FORMAT "%13.11" ECU_ADDRESS 0x60003AF0 /end MEASUREMENT
/begin MEASUREMENT EGSDU_S2B1LtrFilDlyEvln_I.flgQckPassd "Class instance: filter delay time of sensor voltage at transition lean-rich, sensor 2, bank 1 / Condition: the diagnosis has quick pass" UBYTE B_TRUE 1 100 0.00 1.00000000000 BIT_MASK 0x1 FORMAT "%13.11" ECU_ADDRESS 0x60001559 /end MEASUREMENT
/begin MEASUREMENT EGSDU_S2B1LtrFilDlyEvln_I.flgQckPassdFaild "Class instance: filter delay time of sensor voltage at transition lean-rich, sensor 2, bank 1 / Condition: the diagnosis doesnt have quick pass" UBYTE B_TRUE 1 100 0.00 1.00000000000 BIT_MASK 0x1 FORMAT "%13.11" ECU_ADDRESS 0x6000155A /end MEASUREMENT
/begin MEASUREMENT EGSDU_S2B1LtrFilDlyEvln_I.flgRes "Class instance: filter delay time of sensor voltage at transition lean-rich, sensor 2, bank 1 / Condition: result available (single measurement)" UBYTE B_TRUE 1 100 0.00 1.00000000000 BIT_MASK 0x1 FORMAT "%13.11" ECU_ADDRESS 0x6000155B /end MEASUREMENT
/begin MEASUREMENT EGSDU_S2B1LtrFilDlyEvln_I.flgResFil "Class instance: filter delay time of sensor voltage at transition lean-rich, sensor 2, bank 1 / Condition: filtered result available" UBYTE B_TRUE 1 100 0.00 1.00000000000 BIT_MASK 0x1 FORMAT "%13.11" ECU_ADDRESS 0x6000155C /end MEASUREMENT
/begin MEASUREMENT EGSDU_S2B1LtrFilDlyEvln_I.flgResVirt "Class instance: filter delay time of sensor voltage at transition lean-rich, sensor 2, bank 1 / single measurement for IUMPR is finished" UBYTE B_TRUE 1 100 0.00 1.00000000000 BIT_MASK 0x1 FORMAT "%13.11" ECU_ADDRESS 0x6000155D /end MEASUREMENT
/begin MEASUREMENT EGSDU_S2B1LtrFilDlyEvln_I.flgResVirtFil "Class instance: filter delay time of sensor voltage at transition lean-rich, sensor 2, bank 1 / Condition: Numerator Complete (internal)" UBYTE B_TRUE 1 100 0.00 1.00000000000 BIT_MASK 0x1 FORMAT "%13.11" ECU_ADDRESS 0x6000155E /end MEASUREMENT
/begin MEASUREMENT EGSDU_S2B1LtrFilDlyEvln_I.flgResVirtTmp "Class instance: filter delay time of sensor voltage at transition lean-rich, sensor 2, bank 1 / IUMPR simulation is finished for the fault check" UBYTE B_TRUE 1 100 0.00 1.00000000000 BIT_MASK 0x1 FORMAT "%13.11" ECU_ADDRESS 0x6000155F /end MEASUREMENT
/begin MEASUREMENT EGSDU_S2B1LtrFilDlyEvln_I.flgStepChg "Class instance: filter delay time of sensor voltage at transition lean-rich, sensor 2, bank 1 / Condition: Step Change Logic active" UBYTE B_TRUE 1 100 0.00 1.00000000000 BIT_MASK 0x1 FORMAT "%13.11" ECU_ADDRESS 0x60036610 /end MEASUREMENT
/begin MEASUREMENT EGSDU_S2B1LtrFilDlyEvln_I.flgTrip "Class instance: filter delay time of sensor voltage at transition lean-rich, sensor 2, bank 1 / fault check is for this driving clycle finished" UBYTE B_TRUE 1 100 0.00 1.00000000000 BIT_MASK 0x1 FORMAT "%13.11" ECU_ADDRESS 0x60001560 /end MEASUREMENT
/begin MEASUREMENT EGSDU_S2B1LtrFilDlyEvln_I.flgTripVirt "Class instance: filter delay time of sensor voltage at transition lean-rich, sensor 2, bank 1 / IUMPR simulation is for this driving cycle finished" UBYTE B_TRUE 1 100 0.00 1.00000000000 BIT_MASK 0x1 FORMAT "%13.11" ECU_ADDRESS 0x60001561 /end MEASUREMENT
/begin MEASUREMENT EGSDU_S2B1LtrFilDlyEvln_I.flgVirtQckFaild "Class instance: filter delay time of sensor voltage at transition lean-rich, sensor 2, bank 1 / Condition: virtual Quickpass failed is set" UBYTE B_TRUE 1 100 0.00 1.00000000000 BIT_MASK 0x1 FORMAT "%13.11" ECU_ADDRESS 0x60001562 /end MEASUREMENT
/begin MEASUREMENT EGSDU_S2B1LtrFilDlyEvln_I.numMeas "Class instance: filter delay time of sensor voltage at transition lean-rich, sensor 2, bank 1 / Number of measurements" UBYTE dez 1 100 0.00 255.0 FORMAT "%5.1" ECU_ADDRESS 0x60036611 /end MEASUREMENT
/begin MEASUREMENT EGSDU_S2B1LtrFilDlyEvln_I.numMeasShtrp "Class instance: filter delay time of sensor voltage at transition lean-rich, sensor 2, bank 1 / number of measurements for short trip" UBYTE dez 1 100 0.00 255.0 FORMAT "%5.1" ECU_ADDRESS 0x60001563 /end MEASUREMENT
/begin MEASUREMENT EGSDU_S2B1LtrFilDlyEvln_I.numMeasTrip "Class instance: filter delay time of sensor voltage at transition lean-rich, sensor 2, bank 1 / number of measurement in this driving clycle" UBYTE dez 1 100 0.00 255.0 FORMAT "%5.1" ECU_ADDRESS 0x60001564 /end MEASUREMENT
/begin MEASUREMENT EGSDU_S2B1LtrFilDlyEvln_I.numVirtMeas "Class instance: filter delay time of sensor voltage at transition lean-rich, sensor 2, bank 1 / Number of virtual measurements (IUMPR)" UBYTE dez 1 100 0.00 255.0 FORMAT "%5.1" ECU_ADDRESS 0x60036612 /end MEASUREMENT
/begin MEASUREMENT EGSDU_S2B1LtrFilDlyEvln_I.numVirtMeasTrip "Class instance: filter delay time of sensor voltage at transition lean-rich, sensor 2, bank 1 / Number of virtual measurements (IUMPR) in this driving clycle in case of step change" UBYTE dez 1 100 0.00 255.0 FORMAT "%5.1" ECU_ADDRESS 0x60001565 /end MEASUREMENT
/begin MEASUREMENT EGSDU_S2B1LtrFilDlyEvln_I.ti "Class instance: filter delay time of sensor voltage at transition lean-rich, sensor 2, bank 1 / result of dynamic measurement" SWORD t_q0p01 1 100 -327.6800 327.6700 FORMAT "%8.4" ECU_ADDRESS 0x60003AF2 /end MEASUREMENT
/begin MEASUREMENT EGSDU_S2B1LtrFilDlyEvln_I.tiArth "Class instance: filter delay time of sensor voltage at transition lean-rich, sensor 2, bank 1 / value of aritmetic-filter" SWORD t_q0p01 1 100 -327.6800 327.6700 FORMAT "%8.4" ECU_ADDRESS 0x60036614 /end MEASUREMENT
/begin MEASUREMENT EGSDU_S2B1LtrFilDlyEvln_I.tiEwma "Class instance: filter delay time of sensor voltage at transition lean-rich, sensor 2, bank 1 / Value of EWMA-Filter (word)" SWORD t_q0p01 1 100 -327.6800 327.6700 FORMAT "%8.4" ECU_ADDRESS 0x60036616 /end MEASUREMENT
/begin MEASUREMENT EGSDU_S2B1LtrFilDlyEvln_I.tiFil "Class instance: filter delay time of sensor voltage at transition lean-rich, sensor 2, bank 1 / filtered result of dynamic measurement" UWORD t_q0p01 1 100 0.00 655.3500 FORMAT "%8.4" ECU_ADDRESS 0x60036618 /end MEASUREMENT
/begin MEASUREMENT EGSDU_S2B1LtrFilDlyEvln_I.tiQuickPass "Class instance: filter delay time of sensor voltage at transition lean-rich, sensor 2, bank 1 / Threshold for quick pass" SWORD t_q0p01 1 100 -327.6800 327.6700 FORMAT "%8.4" ECU_ADDRESS 0x60001566 /end MEASUREMENT
/begin MEASUREMENT EGSDU_S2B1LtrFilDlyEvln_I.ResFF_I.status "Class instance: filter delay time of sensor voltage at transition lean-rich, sensor 2, bank 1 / FlipFlop: result available (single measurement) / current value of RS-FF" UBYTE B_TRUE 1 100 0.00 1.00000000000 BIT_MASK 0x1 FORMAT "%13.11" ECU_ADDRESS 0x60003AF4 /end MEASUREMENT
/begin MEASUREMENT EGSDU_S2B1LtrFilDlyEvln_I.tiArithShtrpDL_I.memory "Class instance: filter delay time of sensor voltage at transition lean-rich, sensor 2, bank 1 / aritmetic filter for short trip / current lowpass value" SLONG q1p5259Em7_s 1 100 -327.680000000 327.679999847 FORMAT "%13.9" ECU_ADDRESS 0x60001568 /end MEASUREMENT
/begin MEASUREMENT EGSDU_S2B1LtrFilDlyEvln_I.tiArthDL_I.memory "Class instance: filter delay time of sensor voltage at transition lean-rich, sensor 2, bank 1 / aritmetic filter / current lowpass value" SLONG q1p5259Em7_s 1 100 -327.680000000 327.679999847 FORMAT "%13.9" ECU_ADDRESS 0x6000156C /end MEASUREMENT
/begin MEASUREMENT EGSDU_S2B1LtrFilDlyEvln_I.tiEwmaDL_I.memory "Class instance: filter delay time of sensor voltage at transition lean-rich, sensor 2, bank 1 / Value of EWMA-Filter (Digital Low Pass) / current lowpass value" SLONG q1p5259Em7_s 1 100 -327.680000000 327.679999847 FORMAT "%13.9" ECU_ADDRESS 0x60001570 /end MEASUREMENT
/begin MEASUREMENT EGSDU_S2B1LtrFilTranEvln_I.flgFCMClrReqdCL100ms "Class instance: filter transition time of sensor voltage at transition lean-rich, sensor 2, bank 1 / FCM clear status flag" UBYTE B_TRUE 1 100 0.00 1.00000000000 BIT_MASK 0x1 FORMAT "%13.11" ECU_ADDRESS 0x6000153C /end MEASUREMENT
/begin MEASUREMENT EGSDU_S2B1LtrFilTranEvln_I.flgFCMClrReqdCL10ms "Class instance: filter transition time of sensor voltage at transition lean-rich, sensor 2, bank 1 / FCM clear status flag" UBYTE B_TRUE 1 100 0.00 1.00000000000 BIT_MASK 0x1 FORMAT "%13.11" ECU_ADDRESS 0x60003AEA /end MEASUREMENT
/begin MEASUREMENT EGSDU_S2B1LtrFilTranEvln_I.flgQckPassd "Class instance: filter transition time of sensor voltage at transition lean-rich, sensor 2, bank 1 / Condition: the diagnosis has quick pass" UBYTE B_TRUE 1 100 0.00 1.00000000000 BIT_MASK 0x1 FORMAT "%13.11" ECU_ADDRESS 0x6000153D /end MEASUREMENT
/begin MEASUREMENT EGSDU_S2B1LtrFilTranEvln_I.flgQckPassdFaild "Class instance: filter transition time of sensor voltage at transition lean-rich, sensor 2, bank 1 / Condition: the diagnosis doesnt have quick pass" UBYTE B_TRUE 1 100 0.00 1.00000000000 BIT_MASK 0x1 FORMAT "%13.11" ECU_ADDRESS 0x6000153E /end MEASUREMENT
/begin MEASUREMENT EGSDU_S2B1LtrFilTranEvln_I.flgRes "Class instance: filter transition time of sensor voltage at transition lean-rich, sensor 2, bank 1 / Condition: result available (single measurement)" UBYTE B_TRUE 1 100 0.00 1.00000000000 BIT_MASK 0x1 FORMAT "%13.11" ECU_ADDRESS 0x6000153F /end MEASUREMENT
/begin MEASUREMENT EGSDU_S2B1LtrFilTranEvln_I.flgResFil "Class instance: filter transition time of sensor voltage at transition lean-rich, sensor 2, bank 1 / Condition: filtered result available" UBYTE B_TRUE 1 100 0.00 1.00000000000 BIT_MASK 0x1 FORMAT "%13.11" ECU_ADDRESS 0x60001540 /end MEASUREMENT
/begin MEASUREMENT EGSDU_S2B1LtrFilTranEvln_I.flgResVirt "Class instance: filter transition time of sensor voltage at transition lean-rich, sensor 2, bank 1 / single measurement for IUMPR is finished" UBYTE B_TRUE 1 100 0.00 1.00000000000 BIT_MASK 0x1 FORMAT "%13.11" ECU_ADDRESS 0x60001541 /end MEASUREMENT
/begin MEASUREMENT EGSDU_S2B1LtrFilTranEvln_I.flgResVirtFil "Class instance: filter transition time of sensor voltage at transition lean-rich, sensor 2, bank 1 / Condition: Numerator Complete (internal)" UBYTE B_TRUE 1 100 0.00 1.00000000000 BIT_MASK 0x1 FORMAT "%13.11" ECU_ADDRESS 0x60001542 /end MEASUREMENT
/begin MEASUREMENT EGSDU_S2B1LtrFilTranEvln_I.flgResVirtTmp "Class instance: filter transition time of sensor voltage at transition lean-rich, sensor 2, bank 1 / IUMPR simulation is finished for the fault check" UBYTE B_TRUE 1 100 0.00 1.00000000000 BIT_MASK 0x1 FORMAT "%13.11" ECU_ADDRESS 0x60001543 /end MEASUREMENT
/begin MEASUREMENT EGSDU_S2B1LtrFilTranEvln_I.flgStepChg "Class instance: filter transition time of sensor voltage at transition lean-rich, sensor 2, bank 1 / Condition: Step Change Logic active" UBYTE B_TRUE 1 100 0.00 1.00000000000 BIT_MASK 0x1 FORMAT "%13.11" ECU_ADDRESS 0x60036606 /end MEASUREMENT
/begin MEASUREMENT EGSDU_S2B1LtrFilTranEvln_I.flgTrip "Class instance: filter transition time of sensor voltage at transition lean-rich, sensor 2, bank 1 / fault check is for this driving clycle finished" UBYTE B_TRUE 1 100 0.00 1.00000000000 BIT_MASK 0x1 FORMAT "%13.11" ECU_ADDRESS 0x60001544 /end MEASUREMENT
/begin MEASUREMENT EGSDU_S2B1LtrFilTranEvln_I.flgTripVirt "Class instance: filter transition time of sensor voltage at transition lean-rich, sensor 2, bank 1 / IUMPR simulation is for this driving cycle finished" UBYTE B_TRUE 1 100 0.00 1.00000000000 BIT_MASK 0x1 FORMAT "%13.11" ECU_ADDRESS 0x60001545 /end MEASUREMENT
/begin MEASUREMENT EGSDU_S2B1LtrFilTranEvln_I.flgVirtQckFaild "Class instance: filter transition time of sensor voltage at transition lean-rich, sensor 2, bank 1 / Condition: virtual Quickpass failed is set" UBYTE B_TRUE 1 100 0.00 1.00000000000 BIT_MASK 0x1 FORMAT "%13.11" ECU_ADDRESS 0x60001546 /end MEASUREMENT
/begin MEASUREMENT EGSDU_S2B1LtrFilTranEvln_I.numMeas "Class instance: filter transition time of sensor voltage at transition lean-rich, sensor 2, bank 1 / Number of measurements" UBYTE dez 1 100 0.00 255.0 FORMAT "%5.1" ECU_ADDRESS 0x60036607 /end MEASUREMENT
/begin MEASUREMENT EGSDU_S2B1LtrFilTranEvln_I.numMeasShtrp "Class instance: filter transition time of sensor voltage at transition lean-rich, sensor 2, bank 1 / number of measurements for short trip" UBYTE dez 1 100 0.00 255.0 FORMAT "%5.1" ECU_ADDRESS 0x60001547 /end MEASUREMENT
/begin MEASUREMENT EGSDU_S2B1LtrFilTranEvln_I.numMeasTrip "Class instance: filter transition time of sensor voltage at transition lean-rich, sensor 2, bank 1 / number of measurement in this driving clycle" UBYTE dez 1 100 0.00 255.0 FORMAT "%5.1" ECU_ADDRESS 0x60001548 /end MEASUREMENT
/begin MEASUREMENT EGSDU_S2B1LtrFilTranEvln_I.numVirtMeas "Class instance: filter transition time of sensor voltage at transition lean-rich, sensor 2, bank 1 / Number of virtual measurements (IUMPR)" UBYTE dez 1 100 0.00 255.0 FORMAT "%5.1" ECU_ADDRESS 0x60036608 /end MEASUREMENT
/begin MEASUREMENT EGSDU_S2B1LtrFilTranEvln_I.numVirtMeasTrip "Class instance: filter transition time of sensor voltage at transition lean-rich, sensor 2, bank 1 / Number of virtual measurements (IUMPR) in this driving clycle in case of step change" UBYTE dez 1 100 0.00 255.0 FORMAT "%5.1" ECU_ADDRESS 0x60001549 /end MEASUREMENT
/begin MEASUREMENT EGSDU_S2B1LtrFilTranEvln_I.ti "Class instance: filter transition time of sensor voltage at transition lean-rich, sensor 2, bank 1 / result of dynamic measurement" SWORD t_q0p01 1 100 -327.6800 327.6700 FORMAT "%8.4" ECU_ADDRESS 0x60003AEC /end MEASUREMENT
/begin MEASUREMENT EGSDU_S2B1LtrFilTranEvln_I.tiArth "Class instance: filter transition time of sensor voltage at transition lean-rich, sensor 2, bank 1 / value of aritmetic-filter" SWORD t_q0p01 1 100 -327.6800 327.6700 FORMAT "%8.4" ECU_ADDRESS 0x6003660A /end MEASUREMENT
/begin MEASUREMENT EGSDU_S2B1LtrFilTranEvln_I.tiEwma "Class instance: filter transition time of sensor voltage at transition lean-rich, sensor 2, bank 1 / Value of EWMA-Filter (word)" SWORD t_q0p01 1 100 -327.6800 327.6700 FORMAT "%8.4" ECU_ADDRESS 0x6003660C /end MEASUREMENT
/begin MEASUREMENT EGSDU_S2B1LtrFilTranEvln_I.tiFil "Class instance: filter transition time of sensor voltage at transition lean-rich, sensor 2, bank 1 / filtered result of dynamic measurement" UWORD t_q0p01 1 100 0.00 655.3500 FORMAT "%8.4" ECU_ADDRESS 0x6003660E /end MEASUREMENT
/begin MEASUREMENT EGSDU_S2B1LtrFilTranEvln_I.tiQuickPass "Class instance: filter transition time of sensor voltage at transition lean-rich, sensor 2, bank 1 / Threshold for quick pass" SWORD t_q0p01 1 100 -327.6800 327.6700 FORMAT "%8.4" ECU_ADDRESS 0x6000154A /end MEASUREMENT
/begin MEASUREMENT EGSDU_S2B1LtrFilTranEvln_I.ResFF_I.status "Class instance: filter transition time of sensor voltage at transition lean-rich, sensor 2, bank 1 / FlipFlop: result available (single measurement) / current value of RS-FF" UBYTE B_TRUE 1 100 0.00 1.00000000000 BIT_MASK 0x1 FORMAT "%13.11" ECU_ADDRESS 0x60003AEE /end MEASUREMENT
/begin MEASUREMENT EGSDU_S2B1LtrFilTranEvln_I.tiArithShtrpDL_I.memory "Class instance: filter transition time of sensor voltage at transition lean-rich, sensor 2, bank 1 / aritmetic filter for short trip / current lowpass value" SLONG q1p5259Em7_s 1 100 -327.680000000 327.679999847 FORMAT "%13.9" ECU_ADDRESS 0x6000154C /end MEASUREMENT
/begin MEASUREMENT EGSDU_S2B1LtrFilTranEvln_I.tiArthDL_I.memory "Class instance: filter transition time of sensor voltage at transition lean-rich, sensor 2, bank 1 / aritmetic filter / current lowpass value" SLONG q1p5259Em7_s 1 100 -327.680000000 327.679999847 FORMAT "%13.9" ECU_ADDRESS 0x60001550 /end MEASUREMENT
/begin MEASUREMENT EGSDU_S2B1LtrFilTranEvln_I.tiEwmaDL_I.memory "Class instance: filter transition time of sensor voltage at transition lean-rich, sensor 2, bank 1 / Value of EWMA-Filter (Digital Low Pass) / current lowpass value" SLONG q1p5259Em7_s 1 100 -327.680000000 327.679999847 FORMAT "%13.9" ECU_ADDRESS 0x60001554 /end MEASUREMENT
/begin MEASUREMENT EGSDU_S2B1LtrMeasActvDur.flgMeasRprtTran "Class instance denotng the duration for Lean to Rich Measurement for Sensor 2 Bank2 / ." UBYTE B_TRUE 1 100 0.00 1.00000000000 BIT_MASK 0x1 FORMAT "%13.11" ECU_ADDRESS 0x60003AAE /end MEASUREMENT
/begin MEASUREMENT EGSDU_S2B1LtrMeasActvDur.stParlOld "Class instance denotng the duration for Lean to Rich Measurement for Sensor 2 Bank2 / Value of last calculation step: status of state machine of lambda shifting from coordinator function of parallelization" UBYTE dez 1 100 0.00 255.0 FORMAT "%5.1" ECU_ADDRESS 0x60003AAF /end MEASUREMENT
/begin MEASUREMENT EGSDU_S2B1LtrMeasActvDur.flgActvMeasTranFF_I.status "Class instance denotng the duration for Lean to Rich Measurement for Sensor 2 Bank2 / Lean to rich transition measurement active / current value of RS-FF" UBYTE B_TRUE 1 100 0.00 1.00000000000 BIT_MASK 0x1 FORMAT "%13.11" ECU_ADDRESS 0x60003AB0 /end MEASUREMENT
/begin MEASUREMENT EGSDU_S2B1LtrSrvDlyEvln_I.flgDisbl "Class instance: interface to fault code memory and scan tool services delay time of sensor voltage at transition lean-rich, sensor 2, bank 1 / DFC is disabled by disable mask" UBYTE B_TRUE 1 100 0.00 1.00000000000 BIT_MASK 0x1 FORMAT "%13.11" ECU_ADDRESS 0x60003AE2 /end MEASUREMENT
/begin MEASUREMENT EGSDU_S2B1LtrSrvDlyEvln_I.flgErrSuspc "Class instance: interface to fault code memory and scan tool services delay time of sensor voltage at transition lean-rich, sensor 2, bank 1 / condition: Results go beyond the fault threshold" UBYTE B_TRUE 1 100 0.00 1.00000000000 BIT_MASK 0x1 FORMAT "%13.11" ECU_ADDRESS 0x60003AE3 /end MEASUREMENT
/begin MEASUREMENT EGSDU_S2B1LtrSrvDlyEvln_I.flgInhbn "Class instance: interface to fault code memory and scan tool services delay time of sensor voltage at transition lean-rich, sensor 2, bank 1 / DFC is inhibited" UBYTE B_TRUE 1 100 0.00 1.00000000000 BIT_MASK 0x1 FORMAT "%13.11" ECU_ADDRESS 0x60003AE4 /end MEASUREMENT
/begin MEASUREMENT EGSDU_S2B1LtrSrvDlyEvln_I.flgResEvln "Class instance: interface to fault code memory and scan tool services delay time of sensor voltage at transition lean-rich, sensor 2, bank 1 / Condition: result available" UBYTE B_TRUE 1 100 0.00 1.00000000000 BIT_MASK 0x1 FORMAT "%13.11" ECU_ADDRESS 0x60003AE5 /end MEASUREMENT
/begin MEASUREMENT EGSDU_S2B1LtrSrvDlyEvln_I.flgResVirtEvln "Class instance: interface to fault code memory and scan tool services delay time of sensor voltage at transition lean-rich, sensor 2, bank 1 / measurement for IUMPR is finished" UBYTE B_TRUE 1 100 0.00 1.00000000000 BIT_MASK 0x1 FORMAT "%13.11" ECU_ADDRESS 0x60003AE6 /end MEASUREMENT
/begin MEASUREMENT EGSDU_S2B1LtrSrvDlyEvln_I.flgFrzFrmER_I.buffer "Class instance: interface to fault code memory and scan tool services delay time of sensor voltage at transition lean-rich, sensor 2, bank 1 / Edge Rising: FreezeFrame request / rising edge detected" UBYTE B_TRUE 1 100 0.00 1.00000000000 BIT_MASK 0x1 FORMAT "%13.11" ECU_ADDRESS 0x60003AE8 /end MEASUREMENT
/begin MEASUREMENT EGSDU_S2B1LtrSrvDlyEvln_I.flgFrzFrmER_I.oldSignal "Class instance: interface to fault code memory and scan tool services delay time of sensor voltage at transition lean-rich, sensor 2, bank 1 / Edge Rising: FreezeFrame request / flag rising edge" UBYTE B_TRUE 1 100 0.00 1.00000000000 BIT_MASK 0x1 FORMAT "%13.11" ECU_ADDRESS 0x60003AE9 /end MEASUREMENT
/begin MEASUREMENT EGSDU_S2B1LtrSrvTranEvln_I.flgDisbl "Class instance: interface to fault code memory and scan tool services transition time of sensor voltage at transition rich-lean, sensor 2, bank 1 / DFC is disabled by disable mask" UBYTE B_TRUE 1 100 0.00 1.00000000000 BIT_MASK 0x1 FORMAT "%13.11" ECU_ADDRESS 0x60003ADA /end MEASUREMENT
/begin MEASUREMENT EGSDU_S2B1LtrSrvTranEvln_I.flgErrSuspc "Class instance: interface to fault code memory and scan tool services transition time of sensor voltage at transition rich-lean, sensor 2, bank 1 / condition: Results go beyond the fault threshold" UBYTE B_TRUE 1 100 0.00 1.00000000000 BIT_MASK 0x1 FORMAT "%13.11" ECU_ADDRESS 0x60003ADB /end MEASUREMENT
/begin MEASUREMENT EGSDU_S2B1LtrSrvTranEvln_I.flgInhbn "Class instance: interface to fault code memory and scan tool services transition time of sensor voltage at transition rich-lean, sensor 2, bank 1 / DFC is inhibited" UBYTE B_TRUE 1 100 0.00 1.00000000000 BIT_MASK 0x1 FORMAT "%13.11" ECU_ADDRESS 0x60003ADC /end MEASUREMENT
/begin MEASUREMENT EGSDU_S2B1LtrSrvTranEvln_I.flgResEvln "Class instance: interface to fault code memory and scan tool services transition time of sensor voltage at transition rich-lean, sensor 2, bank 1 / Condition: result available" UBYTE B_TRUE 1 100 0.00 1.00000000000 BIT_MASK 0x1 FORMAT "%13.11" ECU_ADDRESS 0x60003ADD /end MEASUREMENT
/begin MEASUREMENT EGSDU_S2B1LtrSrvTranEvln_I.flgResVirtEvln "Class instance: interface to fault code memory and scan tool services transition time of sensor voltage at transition rich-lean, sensor 2, bank 1 / measurement for IUMPR is finished" UBYTE B_TRUE 1 100 0.00 1.00000000000 BIT_MASK 0x1 FORMAT "%13.11" ECU_ADDRESS 0x60003ADE /end MEASUREMENT
/begin MEASUREMENT EGSDU_S2B1LtrSrvTranEvln_I.flgFrzFrmER_I.buffer "Class instance: interface to fault code memory and scan tool services transition time of sensor voltage at transition rich-lean, sensor 2, bank 1 / Edge Rising: FreezeFrame request / rising edge detected" UBYTE B_TRUE 1 100 0.00 1.00000000000 BIT_MASK 0x1 FORMAT "%13.11" ECU_ADDRESS 0x60003AE0 /end MEASUREMENT
/begin MEASUREMENT EGSDU_S2B1LtrSrvTranEvln_I.flgFrzFrmER_I.oldSignal "Class instance: interface to fault code memory and scan tool services transition time of sensor voltage at transition rich-lean, sensor 2, bank 1 / Edge Rising: FreezeFrame request / flag rising edge" UBYTE B_TRUE 1 100 0.00 1.00000000000 BIT_MASK 0x1 FORMAT "%13.11" ECU_ADDRESS 0x60003AE1 /end MEASUREMENT
/begin MEASUREMENT EGSDU_S2B1MinTiLtrTran_I.du "Class instance: measurement of transition time of sensor voltage lean to rich, sensor 2, bank 1 / Voltage change during measurement of Transition Time of O2Sensor" SWORD spg_q1p221Em3_V 1 100 -4.998779 4.998779 FORMAT "%8.6" ECU_ADDRESS 0x60003A9E /end MEASUREMENT
/begin MEASUREMENT EGSDU_S2B1MinTiLtrTran_I.flgInhbRi "Class instance: measurement of transition time of sensor voltage lean to rich, sensor 2, bank 1 / Condition: Ri-measurement inhibit during the dynamic diagnosis transition time" UBYTE B_TRUE 1 100 0.00 1.00000000000 BIT_MASK 0x1 FORMAT "%13.11" ECU_ADDRESS 0x60003AA0 /end MEASUREMENT
/begin MEASUREMENT EGSDU_S2B1MinTiLtrTran_I.flgMeasFinshd "Class instance: measurement of transition time of sensor voltage lean to rich, sensor 2, bank 1 / Condition: result available (single measurement) for measurement Transition Time O2Sensor" UBYTE B_TRUE 1 100 0.00 1.00000000000 BIT_MASK 0x1 FORMAT "%13.11" ECU_ADDRESS 0x60003AA1 /end MEASUREMENT
/begin MEASUREMENT EGSDU_S2B1MinTiLtrTran_I.flgO2Extd "Class instance: measurement of transition time of sensor voltage lean to rich, sensor 2, bank 1 / Condition: IUMPR-Condition fulfilled (single measurement) for measurement Transition Time O2Sensor" UBYTE B_TRUE 1 100 0.00 1.00000000000 BIT_MASK 0x1 FORMAT "%13.11" ECU_ADDRESS 0x60003AA2 /end MEASUREMENT
/begin MEASUREMENT EGSDU_S2B1MinTiLtrTran_I.tiTran "Class instance: measurement of transition time of sensor voltage lean to rich, sensor 2, bank 1 / Transition Time O2 Sensor" UWORD t_q0p01 1 100 0.00 655.3500 FORMAT "%8.4" ECU_ADDRESS 0x60003AA4 /end MEASUREMENT
/begin MEASUREMENT EGSDU_S2B1MinTiLtrTran_I.tiTranSeg "Class instance: measurement of transition time of sensor voltage lean to rich, sensor 2, bank 1 / Transition Time O2 Sensor by one caculation step" UWORD t_q0p01 1 100 0.00 655.3500 FORMAT "%8.4" ECU_ADDRESS 0x60003AA6 /end MEASUREMENT
/begin MEASUREMENT EGSDU_S2B1MinTiLtrTran_I.tiUStop "Class instance: measurement of transition time of sensor voltage lean to rich, sensor 2, bank 1 / hold time of the sensor voltage" UWORD t_q0p01 1 100 0.00 655.3500 FORMAT "%8.4" ECU_ADDRESS 0x60003AA8 /end MEASUREMENT
/begin MEASUREMENT EGSDU_S2B1MinTiLtrTran_I.uOld "Class instance: measurement of transition time of sensor voltage lean to rich, sensor 2, bank 1 / O2 Sensor Voltage Old Value" UWORD spg_q1p221Em3_V 1 100 0.00 4.998779 FORMAT "%8.6" ECU_ADDRESS 0x60003AAA /end MEASUREMENT
/begin MEASUREMENT EGSDU_S2B1MinTiRtlTran_I.du "Class instance: measurement of transition time of sensor voltage rich to lean, sensor 2, bank 1 / Voltage change during measurement of Transition Time of O2Sensor" SWORD spg_q1p221Em3_V 1 100 -4.998779 4.998779 FORMAT "%8.6" ECU_ADDRESS 0x50005328 /end MEASUREMENT
/begin MEASUREMENT EGSDU_S2B1MinTiRtlTran_I.flgInhbRi "Class instance: measurement of transition time of sensor voltage rich to lean, sensor 2, bank 1 / Condition: Ri-measurement inhibit during the dynamic diagnosis transition time" UBYTE B_TRUE 1 100 0.00 1.00000000000 BIT_MASK 0x1 FORMAT "%13.11" ECU_ADDRESS 0x5000532A /end MEASUREMENT
/begin MEASUREMENT EGSDU_S2B1MinTiRtlTran_I.flgMeasFinshd "Class instance: measurement of transition time of sensor voltage rich to lean, sensor 2, bank 1 / Condition: result available (single measurement) for measurement Transition Time O2Sensor" UBYTE B_TRUE 1 100 0.00 1.00000000000 BIT_MASK 0x1 FORMAT "%13.11" ECU_ADDRESS 0x5000532B /end MEASUREMENT
/begin MEASUREMENT EGSDU_S2B1MinTiRtlTran_I.flgO2Extd "Class instance: measurement of transition time of sensor voltage rich to lean, sensor 2, bank 1 / Condition: IUMPR-Condition fulfilled (single measurement) for measurement Transition Time O2Sensor" UBYTE B_TRUE 1 100 0.00 1.00000000000 BIT_MASK 0x1 FORMAT "%13.11" ECU_ADDRESS 0x5000532C /end MEASUREMENT
/begin MEASUREMENT EGSDU_S2B1MinTiRtlTran_I.tiTran "Class instance: measurement of transition time of sensor voltage rich to lean, sensor 2, bank 1 / Transition Time O2 Sensor" UWORD t_q0p01 1 100 0.00 655.3500 FORMAT "%8.4" ECU_ADDRESS 0x5000532E /end MEASUREMENT
/begin MEASUREMENT EGSDU_S2B1MinTiRtlTran_I.tiTranSeg "Class instance: measurement of transition time of sensor voltage rich to lean, sensor 2, bank 1 / Transition Time O2 Sensor by one caculation step" UWORD t_q0p01 1 100 0.00 655.3500 FORMAT "%8.4" ECU_ADDRESS 0x50005330 /end MEASUREMENT
/begin MEASUREMENT EGSDU_S2B1MinTiRtlTran_I.tiUStop "Class instance: measurement of transition time of sensor voltage rich to lean, sensor 2, bank 1 / hold time of the sensor voltage" UWORD t_q0p01 1 100 0.00 655.3500 FORMAT "%8.4" ECU_ADDRESS 0x50005332 /end MEASUREMENT
/begin MEASUREMENT EGSDU_S2B1MinTiRtlTran_I.uOld "Class instance: measurement of transition time of sensor voltage rich to lean, sensor 2, bank 1 / O2 Sensor Voltage Old Value" UWORD spg_q1p221Em3_V 1 100 0.00 4.998779 FORMAT "%8.6" ECU_ADDRESS 0x50005334 /end MEASUREMENT
/begin MEASUREMENT EGSDU_S2B1RtlFilDlyEvln_I.flgFCMClrReqdCL100ms "Class instance: filter delay time of sensor voltage at transition rich-lean, sensor 2, bank 1 / FCM clear status flag" UBYTE B_TRUE 1 100 0.00 1.00000000000 BIT_MASK 0x1 FORMAT "%13.11" ECU_ADDRESS 0x60001520 /end MEASUREMENT
/begin MEASUREMENT EGSDU_S2B1RtlFilDlyEvln_I.flgFCMClrReqdCL10ms "Class instance: filter delay time of sensor voltage at transition rich-lean, sensor 2, bank 1 / FCM clear status flag" UBYTE B_TRUE 1 100 0.00 1.00000000000 BIT_MASK 0x1 FORMAT "%13.11" ECU_ADDRESS 0x60003AD4 /end MEASUREMENT
/begin MEASUREMENT EGSDU_S2B1RtlFilDlyEvln_I.flgQckPassd "Class instance: filter delay time of sensor voltage at transition rich-lean, sensor 2, bank 1 / Condition: the diagnosis has quick pass" UBYTE B_TRUE 1 100 0.00 1.00000000000 BIT_MASK 0x1 FORMAT "%13.11" ECU_ADDRESS 0x60001521 /end MEASUREMENT
/begin MEASUREMENT EGSDU_S2B1RtlFilDlyEvln_I.flgQckPassdFaild "Class instance: filter delay time of sensor voltage at transition rich-lean, sensor 2, bank 1 / Condition: the diagnosis doesnt have quick pass" UBYTE B_TRUE 1 100 0.00 1.00000000000 BIT_MASK 0x1 FORMAT "%13.11" ECU_ADDRESS 0x60001522 /end MEASUREMENT
/begin MEASUREMENT EGSDU_S2B1RtlFilDlyEvln_I.flgRes "Class instance: filter delay time of sensor voltage at transition rich-lean, sensor 2, bank 1 / Condition: result available (single measurement)" UBYTE B_TRUE 1 100 0.00 1.00000000000 BIT_MASK 0x1 FORMAT "%13.11" ECU_ADDRESS 0x60001523 /end MEASUREMENT
/begin MEASUREMENT EGSDU_S2B1RtlFilDlyEvln_I.flgResFil "Class instance: filter delay time of sensor voltage at transition rich-lean, sensor 2, bank 1 / Condition: filtered result available" UBYTE B_TRUE 1 100 0.00 1.00000000000 BIT_MASK 0x1 FORMAT "%13.11" ECU_ADDRESS 0x60001524 /end MEASUREMENT
/begin MEASUREMENT EGSDU_S2B1RtlFilDlyEvln_I.flgResVirt "Class instance: filter delay time of sensor voltage at transition rich-lean, sensor 2, bank 1 / single measurement for IUMPR is finished" UBYTE B_TRUE 1 100 0.00 1.00000000000 BIT_MASK 0x1 FORMAT "%13.11" ECU_ADDRESS 0x60001525 /end MEASUREMENT
/begin MEASUREMENT EGSDU_S2B1RtlFilDlyEvln_I.flgResVirtFil "Class instance: filter delay time of sensor voltage at transition rich-lean, sensor 2, bank 1 / Condition: Numerator Complete (internal)" UBYTE B_TRUE 1 100 0.00 1.00000000000 BIT_MASK 0x1 FORMAT "%13.11" ECU_ADDRESS 0x60001526 /end MEASUREMENT
/begin MEASUREMENT EGSDU_S2B1RtlFilDlyEvln_I.flgResVirtTmp "Class instance: filter delay time of sensor voltage at transition rich-lean, sensor 2, bank 1 / IUMPR simulation is finished for the fault check" UBYTE B_TRUE 1 100 0.00 1.00000000000 BIT_MASK 0x1 FORMAT "%13.11" ECU_ADDRESS 0x60001527 /end MEASUREMENT
/begin MEASUREMENT EGSDU_S2B1RtlFilDlyEvln_I.flgStepChg "Class instance: filter delay time of sensor voltage at transition rich-lean, sensor 2, bank 1 / Condition: Step Change Logic active" UBYTE B_TRUE 1 100 0.00 1.00000000000 BIT_MASK 0x1 FORMAT "%13.11" ECU_ADDRESS 0x600365FC /end MEASUREMENT
/begin MEASUREMENT EGSDU_S2B1RtlFilDlyEvln_I.flgTrip "Class instance: filter delay time of sensor voltage at transition rich-lean, sensor 2, bank 1 / fault check is for this driving clycle finished" UBYTE B_TRUE 1 100 0.00 1.00000000000 BIT_MASK 0x1 FORMAT "%13.11" ECU_ADDRESS 0x60001528 /end MEASUREMENT
/begin MEASUREMENT EGSDU_S2B1RtlFilDlyEvln_I.flgTripVirt "Class instance: filter delay time of sensor voltage at transition rich-lean, sensor 2, bank 1 / IUMPR simulation is for this driving cycle finished" UBYTE B_TRUE 1 100 0.00 1.00000000000 BIT_MASK 0x1 FORMAT "%13.11" ECU_ADDRESS 0x60001529 /end MEASUREMENT
/begin MEASUREMENT EGSDU_S2B1RtlFilDlyEvln_I.flgVirtQckFaild "Class instance: filter delay time of sensor voltage at transition rich-lean, sensor 2, bank 1 / Condition: virtual Quickpass failed is set" UBYTE B_TRUE 1 100 0.00 1.00000000000 BIT_MASK 0x1 FORMAT "%13.11" ECU_ADDRESS 0x6000152A /end MEASUREMENT
/begin MEASUREMENT EGSDU_S2B1RtlFilDlyEvln_I.numMeas "Class instance: filter delay time of sensor voltage at transition rich-lean, sensor 2, bank 1 / Number of measurements" UBYTE dez 1 100 0.00 255.0 FORMAT "%5.1" ECU_ADDRESS 0x600365FD /end MEASUREMENT
/begin MEASUREMENT EGSDU_S2B1RtlFilDlyEvln_I.numMeasShtrp "Class instance: filter delay time of sensor voltage at transition rich-lean, sensor 2, bank 1 / number of measurements for short trip" UBYTE dez 1 100 0.00 255.0 FORMAT "%5.1" ECU_ADDRESS 0x6000152B /end MEASUREMENT
/begin MEASUREMENT EGSDU_S2B1RtlFilDlyEvln_I.numMeasTrip "Class instance: filter delay time of sensor voltage at transition rich-lean, sensor 2, bank 1 / number of measurement in this driving clycle" UBYTE dez 1 100 0.00 255.0 FORMAT "%5.1" ECU_ADDRESS 0x6000152C /end MEASUREMENT
/begin MEASUREMENT EGSDU_S2B1RtlFilDlyEvln_I.numVirtMeas "Class instance: filter delay time of sensor voltage at transition rich-lean, sensor 2, bank 1 / Number of virtual measurements (IUMPR)" UBYTE dez 1 100 0.00 255.0 FORMAT "%5.1" ECU_ADDRESS 0x600365FE /end MEASUREMENT
/begin MEASUREMENT EGSDU_S2B1RtlFilDlyEvln_I.numVirtMeasTrip "Class instance: filter delay time of sensor voltage at transition rich-lean, sensor 2, bank 1 / Number of virtual measurements (IUMPR) in this driving clycle in case of step change" UBYTE dez 1 100 0.00 255.0 FORMAT "%5.1" ECU_ADDRESS 0x6000152D /end MEASUREMENT
/begin MEASUREMENT EGSDU_S2B1RtlFilDlyEvln_I.ti "Class instance: filter delay time of sensor voltage at transition rich-lean, sensor 2, bank 1 / result of dynamic measurement" SWORD t_q0p01 1 100 -327.6800 327.6700 FORMAT "%8.4" ECU_ADDRESS 0x60003AD6 /end MEASUREMENT
/begin MEASUREMENT EGSDU_S2B1RtlFilDlyEvln_I.tiArth "Class instance: filter delay time of sensor voltage at transition rich-lean, sensor 2, bank 1 / value of aritmetic-filter" SWORD t_q0p01 1 100 -327.6800 327.6700 FORMAT "%8.4" ECU_ADDRESS 0x60036600 /end MEASUREMENT
/begin MEASUREMENT EGSDU_S2B1RtlFilDlyEvln_I.tiEwma "Class instance: filter delay time of sensor voltage at transition rich-lean, sensor 2, bank 1 / Value of EWMA-Filter (word)" SWORD t_q0p01 1 100 -327.6800 327.6700 FORMAT "%8.4" ECU_ADDRESS 0x60036602 /end MEASUREMENT
/begin MEASUREMENT EGSDU_S2B1RtlFilDlyEvln_I.tiFil "Class instance: filter delay time of sensor voltage at transition rich-lean, sensor 2, bank 1 / filtered result of dynamic measurement" UWORD t_q0p01 1 100 0.00 655.3500 FORMAT "%8.4" ECU_ADDRESS 0x60036604 /end MEASUREMENT
/begin MEASUREMENT EGSDU_S2B1RtlFilDlyEvln_I.tiQuickPass "Class instance: filter delay time of sensor voltage at transition rich-lean, sensor 2, bank 1 / Threshold for quick pass" SWORD t_q0p01 1 100 -327.6800 327.6700 FORMAT "%8.4" ECU_ADDRESS 0x6000152E /end MEASUREMENT
/begin MEASUREMENT EGSDU_S2B1RtlFilDlyEvln_I.ResFF_I.status "Class instance: filter delay time of sensor voltage at transition rich-lean, sensor 2, bank 1 / FlipFlop: result available (single measurement) / current value of RS-FF" UBYTE B_TRUE 1 100 0.00 1.00000000000 BIT_MASK 0x1 FORMAT "%13.11" ECU_ADDRESS 0x60003AD8 /end MEASUREMENT
/begin MEASUREMENT EGSDU_S2B1RtlFilDlyEvln_I.tiArithShtrpDL_I.memory "Class instance: filter delay time of sensor voltage at transition rich-lean, sensor 2, bank 1 / aritmetic filter for short trip / current lowpass value" SLONG q1p5259Em7_s 1 100 -327.680000000 327.679999847 FORMAT "%13.9" ECU_ADDRESS 0x60001530 /end MEASUREMENT
/begin MEASUREMENT EGSDU_S2B1RtlFilDlyEvln_I.tiArthDL_I.memory "Class instance: filter delay time of sensor voltage at transition rich-lean, sensor 2, bank 1 / aritmetic filter / current lowpass value" SLONG q1p5259Em7_s 1 100 -327.680000000 327.679999847 FORMAT "%13.9" ECU_ADDRESS 0x60001534 /end MEASUREMENT
/begin MEASUREMENT EGSDU_S2B1RtlFilDlyEvln_I.tiEwmaDL_I.memory "Class instance: filter delay time of sensor voltage at transition rich-lean, sensor 2, bank 1 / Value of EWMA-Filter (Digital Low Pass) / current lowpass value" SLONG q1p5259Em7_s 1 100 -327.680000000 327.679999847 FORMAT "%13.9" ECU_ADDRESS 0x60001538 /end MEASUREMENT
/begin MEASUREMENT EGSDU_S2B1RtlFilTranEvln_I.flgFCMClrReqdCL100ms "Class instance: filter transition time of sensor voltage at transition rich-lean, sensor 2, bank 1 / FCM clear status flag" UBYTE B_TRUE 1 100 0.00 1.00000000000 BIT_MASK 0x1 FORMAT "%13.11" ECU_ADDRESS 0x60001504 /end MEASUREMENT
/begin MEASUREMENT EGSDU_S2B1RtlFilTranEvln_I.flgFCMClrReqdCL10ms "Class instance: filter transition time of sensor voltage at transition rich-lean, sensor 2, bank 1 / FCM clear status flag" UBYTE B_TRUE 1 100 0.00 1.00000000000 BIT_MASK 0x1 FORMAT "%13.11" ECU_ADDRESS 0x6000D8A0 /end MEASUREMENT
/begin MEASUREMENT EGSDU_S2B1RtlFilTranEvln_I.flgQckPassd "Class instance: filter transition time of sensor voltage at transition rich-lean, sensor 2, bank 1 / Condition: the diagnosis has quick pass" UBYTE B_TRUE 1 100 0.00 1.00000000000 BIT_MASK 0x1 FORMAT "%13.11" ECU_ADDRESS 0x60001505 /end MEASUREMENT
/begin MEASUREMENT EGSDU_S2B1RtlFilTranEvln_I.flgQckPassdFaild "Class instance: filter transition time of sensor voltage at transition rich-lean, sensor 2, bank 1 / Condition: the diagnosis doesnt have quick pass" UBYTE B_TRUE 1 100 0.00 1.00000000000 BIT_MASK 0x1 FORMAT "%13.11" ECU_ADDRESS 0x60001506 /end MEASUREMENT
/begin MEASUREMENT EGSDU_S2B1RtlFilTranEvln_I.flgRes "Class instance: filter transition time of sensor voltage at transition rich-lean, sensor 2, bank 1 / Condition: result available (single measurement)" UBYTE B_TRUE 1 100 0.00 1.00000000000 BIT_MASK 0x1 FORMAT "%13.11" ECU_ADDRESS 0x60001507 /end MEASUREMENT
/begin MEASUREMENT EGSDU_S2B1RtlFilTranEvln_I.flgResFil "Class instance: filter transition time of sensor voltage at transition rich-lean, sensor 2, bank 1 / Condition: filtered result available" UBYTE B_TRUE 1 100 0.00 1.00000000000 BIT_MASK 0x1 FORMAT "%13.11" ECU_ADDRESS 0x60001508 /end MEASUREMENT
/begin MEASUREMENT EGSDU_S2B1RtlFilTranEvln_I.flgResVirt "Class instance: filter transition time of sensor voltage at transition rich-lean, sensor 2, bank 1 / single measurement for IUMPR is finished" UBYTE B_TRUE 1 100 0.00 1.00000000000 BIT_MASK 0x1 FORMAT "%13.11" ECU_ADDRESS 0x60001509 /end MEASUREMENT
/begin MEASUREMENT EGSDU_S2B1RtlFilTranEvln_I.flgResVirtFil "Class instance: filter transition time of sensor voltage at transition rich-lean, sensor 2, bank 1 / Condition: Numerator Complete (internal)" UBYTE B_TRUE 1 100 0.00 1.00000000000 BIT_MASK 0x1 FORMAT "%13.11" ECU_ADDRESS 0x6000150A /end MEASUREMENT
/begin MEASUREMENT EGSDU_S2B1RtlFilTranEvln_I.flgResVirtTmp "Class instance: filter transition time of sensor voltage at transition rich-lean, sensor 2, bank 1 / IUMPR simulation is finished for the fault check" UBYTE B_TRUE 1 100 0.00 1.00000000000 BIT_MASK 0x1 FORMAT "%13.11" ECU_ADDRESS 0x6000150B /end MEASUREMENT
/begin MEASUREMENT EGSDU_S2B1RtlFilTranEvln_I.flgStepChg "Class instance: filter transition time of sensor voltage at transition rich-lean, sensor 2, bank 1 / Condition: Step Change Logic active" UBYTE B_TRUE 1 100 0.00 1.00000000000 BIT_MASK 0x1 FORMAT "%13.11" ECU_ADDRESS 0x600365F2 /end MEASUREMENT
/begin MEASUREMENT EGSDU_S2B1RtlFilTranEvln_I.flgTrip "Class instance: filter transition time of sensor voltage at transition rich-lean, sensor 2, bank 1 / fault check is for this driving clycle finished" UBYTE B_TRUE 1 100 0.00 1.00000000000 BIT_MASK 0x1 FORMAT "%13.11" ECU_ADDRESS 0x6000150C /end MEASUREMENT
/begin MEASUREMENT EGSDU_S2B1RtlFilTranEvln_I.flgTripVirt "Class instance: filter transition time of sensor voltage at transition rich-lean, sensor 2, bank 1 / IUMPR simulation is for this driving cycle finished" UBYTE B_TRUE 1 100 0.00 1.00000000000 BIT_MASK 0x1 FORMAT "%13.11" ECU_ADDRESS 0x6000150D /end MEASUREMENT
/begin MEASUREMENT EGSDU_S2B1RtlFilTranEvln_I.flgVirtQckFaild "Class instance: filter transition time of sensor voltage at transition rich-lean, sensor 2, bank 1 / Condition: virtual Quickpass failed is set" UBYTE B_TRUE 1 100 0.00 1.00000000000 BIT_MASK 0x1 FORMAT "%13.11" ECU_ADDRESS 0x6000150E /end MEASUREMENT
/begin MEASUREMENT EGSDU_S2B1RtlFilTranEvln_I.numMeas "Class instance: filter transition time of sensor voltage at transition rich-lean, sensor 2, bank 1 / Number of measurements" UBYTE dez 1 100 0.00 255.0 FORMAT "%5.1" ECU_ADDRESS 0x600365F3 /end MEASUREMENT
/begin MEASUREMENT EGSDU_S2B1RtlFilTranEvln_I.numMeasShtrp "Class instance: filter transition time of sensor voltage at transition rich-lean, sensor 2, bank 1 / number of measurements for short trip" UBYTE dez 1 100 0.00 255.0 FORMAT "%5.1" ECU_ADDRESS 0x6000150F /end MEASUREMENT
/begin MEASUREMENT EGSDU_S2B1RtlFilTranEvln_I.numMeasTrip "Class instance: filter transition time of sensor voltage at transition rich-lean, sensor 2, bank 1 / number of measurement in this driving clycle" UBYTE dez 1 100 0.00 255.0 FORMAT "%5.1" ECU_ADDRESS 0x60001510 /end MEASUREMENT
/begin MEASUREMENT EGSDU_S2B1RtlFilTranEvln_I.numVirtMeas "Class instance: filter transition time of sensor voltage at transition rich-lean, sensor 2, bank 1 / Number of virtual measurements (IUMPR)" UBYTE dez 1 100 0.00 255.0 FORMAT "%5.1" ECU_ADDRESS 0x600365F4 /end MEASUREMENT
/begin MEASUREMENT EGSDU_S2B1RtlFilTranEvln_I.numVirtMeasTrip "Class instance: filter transition time of sensor voltage at transition rich-lean, sensor 2, bank 1 / Number of virtual measurements (IUMPR) in this driving clycle in case of step change" UBYTE dez 1 100 0.00 255.0 FORMAT "%5.1" ECU_ADDRESS 0x60001511 /end MEASUREMENT
/begin MEASUREMENT EGSDU_S2B1RtlFilTranEvln_I.ti "Class instance: filter transition time of sensor voltage at transition rich-lean, sensor 2, bank 1 / result of dynamic measurement" SWORD t_q0p01 1 100 -327.6800 327.6700 FORMAT "%8.4" ECU_ADDRESS 0x6000D8A2 /end MEASUREMENT
/begin MEASUREMENT EGSDU_S2B1RtlFilTranEvln_I.tiArth "Class instance: filter transition time of sensor voltage at transition rich-lean, sensor 2, bank 1 / value of aritmetic-filter" SWORD t_q0p01 1 100 -327.6800 327.6700 FORMAT "%8.4" ECU_ADDRESS 0x600365F6 /end MEASUREMENT
/begin MEASUREMENT EGSDU_S2B1RtlFilTranEvln_I.tiEwma "Class instance: filter transition time of sensor voltage at transition rich-lean, sensor 2, bank 1 / Value of EWMA-Filter (word)" SWORD t_q0p01 1 100 -327.6800 327.6700 FORMAT "%8.4" ECU_ADDRESS 0x600365F8 /end MEASUREMENT
/begin MEASUREMENT EGSDU_S2B1RtlFilTranEvln_I.tiFil "Class instance: filter transition time of sensor voltage at transition rich-lean, sensor 2, bank 1 / filtered result of dynamic measurement" UWORD t_q0p01 1 100 0.00 655.3500 FORMAT "%8.4" ECU_ADDRESS 0x600365FA /end MEASUREMENT
/begin MEASUREMENT EGSDU_S2B1RtlFilTranEvln_I.tiQuickPass "Class instance: filter transition time of sensor voltage at transition rich-lean, sensor 2, bank 1 / Threshold for quick pass" SWORD t_q0p01 1 100 -327.6800 327.6700 FORMAT "%8.4" ECU_ADDRESS 0x60001512 /end MEASUREMENT
/begin MEASUREMENT EGSDU_S2B1RtlFilTranEvln_I.ResFF_I.status "Class instance: filter transition time of sensor voltage at transition rich-lean, sensor 2, bank 1 / FlipFlop: result available (single measurement) / current value of RS-FF" UBYTE B_TRUE 1 100 0.00 1.00000000000 BIT_MASK 0x1 FORMAT "%13.11" ECU_ADDRESS 0x6000D8A4 /end MEASUREMENT
/begin MEASUREMENT EGSDU_S2B1RtlFilTranEvln_I.tiArithShtrpDL_I.memory "Class instance: filter transition time of sensor voltage at transition rich-lean, sensor 2, bank 1 / aritmetic filter for short trip / current lowpass value" SLONG q1p5259Em7_s 1 100 -327.680000000 327.679999847 FORMAT "%13.9" ECU_ADDRESS 0x60001514 /end MEASUREMENT
/begin MEASUREMENT EGSDU_S2B1RtlFilTranEvln_I.tiArthDL_I.memory "Class instance: filter transition time of sensor voltage at transition rich-lean, sensor 2, bank 1 / aritmetic filter / current lowpass value" SLONG q1p5259Em7_s 1 100 -327.680000000 327.679999847 FORMAT "%13.9" ECU_ADDRESS 0x60001518 /end MEASUREMENT
/begin MEASUREMENT EGSDU_S2B1RtlFilTranEvln_I.tiEwmaDL_I.memory "Class instance: filter transition time of sensor voltage at transition rich-lean, sensor 2, bank 1 / Value of EWMA-Filter (Digital Low Pass) / current lowpass value" SLONG q1p5259Em7_s 1 100 -327.680000000 327.679999847 FORMAT "%13.9" ECU_ADDRESS 0x6000151C /end MEASUREMENT
/begin MEASUREMENT EGSDU_S2B1RtlMeasActvDur.flgMeasTran "Class instance denotng the duration for Rich to Lean Measurement for Sensor 2 Bank1 / Full transition diagnosis active" UBYTE B_TRUE 1 100 0.00 1.00000000000 BIT_MASK 0x1 FORMAT "%13.11" ECU_ADDRESS 0x60003A9A /end MEASUREMENT
/begin MEASUREMENT EGSDU_S2B1RtlMeasActvDur.flgRprtTran "Class instance denotng the duration for Rich to Lean Measurement for Sensor 2 Bank1 / ." UBYTE B_TRUE 1 100 0.00 1.00000000000 BIT_MASK 0x1 FORMAT "%13.11" ECU_ADDRESS 0x60003A9B /end MEASUREMENT
/begin MEASUREMENT EGSDU_S2B1RtlMeasActvDur.stParlOld "Class instance denotng the duration for Rich to Lean Measurement for Sensor 2 Bank1 / Value of last calculation step: status of state machine of lambda shifting from coordinator function of parallelization" UBYTE dez 1 100 0.00 255.0 FORMAT "%5.1" ECU_ADDRESS 0x60003A9C /end MEASUREMENT
/begin MEASUREMENT EGSDU_S2B1RtlMeasActvDur.flgActvMeasTranFF_I.status "Class instance denotng the duration for Rich to Lean Measurement for Sensor 2 Bank1 / Richj to lean transition measurement active / current value of RS-FF" UBYTE B_TRUE 1 100 0.00 1.00000000000 BIT_MASK 0x1 FORMAT "%13.11" ECU_ADDRESS 0x60003A9D /end MEASUREMENT
/begin MEASUREMENT EGSDU_S2B1RtlSrvDlyEvln_I.flgDisbl "Class instance: interface to fault code memory and scan tool services transition time of sensor voltage at transition rich-lean, sensor 2, bank 1 / DFC is disabled by disable mask" UBYTE B_TRUE 1 100 0.00 1.00000000000 BIT_MASK 0x1 FORMAT "%13.11" ECU_ADDRESS 0x60003ACC /end MEASUREMENT
/begin MEASUREMENT EGSDU_S2B1RtlSrvDlyEvln_I.flgErrSuspc "Class instance: interface to fault code memory and scan tool services transition time of sensor voltage at transition rich-lean, sensor 2, bank 1 / condition: Results go beyond the fault threshold" UBYTE B_TRUE 1 100 0.00 1.00000000000 BIT_MASK 0x1 FORMAT "%13.11" ECU_ADDRESS 0x60003ACD /end MEASUREMENT
/begin MEASUREMENT EGSDU_S2B1RtlSrvDlyEvln_I.flgInhbn "Class instance: interface to fault code memory and scan tool services transition time of sensor voltage at transition rich-lean, sensor 2, bank 1 / DFC is inhibited" UBYTE B_TRUE 1 100 0.00 1.00000000000 BIT_MASK 0x1 FORMAT "%13.11" ECU_ADDRESS 0x60003ACE /end MEASUREMENT
/begin MEASUREMENT EGSDU_S2B1RtlSrvDlyEvln_I.flgResEvln "Class instance: interface to fault code memory and scan tool services transition time of sensor voltage at transition rich-lean, sensor 2, bank 1 / Condition: result available" UBYTE B_TRUE 1 100 0.00 1.00000000000 BIT_MASK 0x1 FORMAT "%13.11" ECU_ADDRESS 0x60003ACF /end MEASUREMENT
/begin MEASUREMENT EGSDU_S2B1RtlSrvDlyEvln_I.flgResVirtEvln "Class instance: interface to fault code memory and scan tool services transition time of sensor voltage at transition rich-lean, sensor 2, bank 1 / measurement for IUMPR is finished" UBYTE B_TRUE 1 100 0.00 1.00000000000 BIT_MASK 0x1 FORMAT "%13.11" ECU_ADDRESS 0x60003AD0 /end MEASUREMENT
/begin MEASUREMENT EGSDU_S2B1RtlSrvDlyEvln_I.flgFrzFrmER_I.buffer "Class instance: interface to fault code memory and scan tool services transition time of sensor voltage at transition rich-lean, sensor 2, bank 1 / Edge Rising: FreezeFrame request / rising edge detected" UBYTE B_TRUE 1 100 0.00 1.00000000000 BIT_MASK 0x1 FORMAT "%13.11" ECU_ADDRESS 0x60003AD2 /end MEASUREMENT
/begin MEASUREMENT EGSDU_S2B1RtlSrvDlyEvln_I.flgFrzFrmER_I.oldSignal "Class instance: interface to fault code memory and scan tool services transition time of sensor voltage at transition rich-lean, sensor 2, bank 1 / Edge Rising: FreezeFrame request / flag rising edge" UBYTE B_TRUE 1 100 0.00 1.00000000000 BIT_MASK 0x1 FORMAT "%13.11" ECU_ADDRESS 0x60003AD3 /end MEASUREMENT
/begin MEASUREMENT EGSDU_S2B1RtlSrvTranEvln_I.flgDisbl "Class instance: interface to fault code memory and scan tool services delay time of sensor voltage at transition rich-lean, sensor 2, bank 1 / DFC is disabled by disable mask" UBYTE B_TRUE 1 100 0.00 1.00000000000 BIT_MASK 0x1 FORMAT "%13.11" ECU_ADDRESS 0x60003AC4 /end MEASUREMENT
/begin MEASUREMENT EGSDU_S2B1RtlSrvTranEvln_I.flgErrSuspc "Class instance: interface to fault code memory and scan tool services delay time of sensor voltage at transition rich-lean, sensor 2, bank 1 / condition: Results go beyond the fault threshold" UBYTE B_TRUE 1 100 0.00 1.00000000000 BIT_MASK 0x1 FORMAT "%13.11" ECU_ADDRESS 0x60003AC5 /end MEASUREMENT
/begin MEASUREMENT EGSDU_S2B1RtlSrvTranEvln_I.flgInhbn "Class instance: interface to fault code memory and scan tool services delay time of sensor voltage at transition rich-lean, sensor 2, bank 1 / DFC is inhibited" UBYTE B_TRUE 1 100 0.00 1.00000000000 BIT_MASK 0x1 FORMAT "%13.11" ECU_ADDRESS 0x60003AC6 /end MEASUREMENT
/begin MEASUREMENT EGSDU_S2B1RtlSrvTranEvln_I.flgResEvln "Class instance: interface to fault code memory and scan tool services delay time of sensor voltage at transition rich-lean, sensor 2, bank 1 / Condition: result available" UBYTE B_TRUE 1 100 0.00 1.00000000000 BIT_MASK 0x1 FORMAT "%13.11" ECU_ADDRESS 0x60003AC7 /end MEASUREMENT
/begin MEASUREMENT EGSDU_S2B1RtlSrvTranEvln_I.flgResVirtEvln "Class instance: interface to fault code memory and scan tool services delay time of sensor voltage at transition rich-lean, sensor 2, bank 1 / measurement for IUMPR is finished" UBYTE B_TRUE 1 100 0.00 1.00000000000 BIT_MASK 0x1 FORMAT "%13.11" ECU_ADDRESS 0x60003AC8 /end MEASUREMENT
/begin MEASUREMENT EGSDU_S2B1RtlSrvTranEvln_I.flgFrzFrmER_I.buffer "Class instance: interface to fault code memory and scan tool services delay time of sensor voltage at transition rich-lean, sensor 2, bank 1 / Edge Rising: FreezeFrame request / rising edge detected" UBYTE B_TRUE 1 100 0.00 1.00000000000 BIT_MASK 0x1 FORMAT "%13.11" ECU_ADDRESS 0x60003ACA /end MEASUREMENT
/begin MEASUREMENT EGSDU_S2B1RtlSrvTranEvln_I.flgFrzFrmER_I.oldSignal "Class instance: interface to fault code memory and scan tool services delay time of sensor voltage at transition rich-lean, sensor 2, bank 1 / Edge Rising: FreezeFrame request / flag rising edge" UBYTE B_TRUE 1 100 0.00 1.00000000000 BIT_MASK 0x1 FORMAT "%13.11" ECU_ADDRESS 0x60003ACB /end MEASUREMENT
/begin MEASUREMENT EGSDU_S2B1TarLeanEvlnDs_I.flgFCMClrReqdCL10ms "class instance:supply diagnosis result of range check of target lean sensor voltage, sensor 2, bank 1 / FCM clear status flag" UBYTE B_TRUE 1 100 0.00 1.00000000000 BIT_MASK 0x1 FORMAT "%13.11" ECU_ADDRESS 0x6000D8A6 /end MEASUREMENT
/begin MEASUREMENT EGSDU_S2B1TarLeanEvlnDs_I.flgRes "class instance:supply diagnosis result of range check of target lean sensor voltage, sensor 2, bank 1 / Condition: result available" UBYTE B_TRUE 1 100 0.00 1.00000000000 BIT_MASK 0x1 FORMAT "%13.11" ECU_ADDRESS 0x6000D8A7 /end MEASUREMENT
/begin MEASUREMENT EGSDU_S2B1TarLeanEvlnDs_I.flgResVirt "class instance:supply diagnosis result of range check of target lean sensor voltage, sensor 2, bank 1 / measurement for IUMPR is finished" UBYTE B_TRUE 1 100 0.00 1.00000000000 BIT_MASK 0x1 FORMAT "%13.11" ECU_ADDRESS 0x6000D8A8 /end MEASUREMENT
/begin MEASUREMENT EGSDU_S2B1TarLeanEvlnDs_I.u "class instance:supply diagnosis result of range check of target lean sensor voltage, sensor 2, bank 1 / Sensor voltage" UWORD spg_q1p221Em3_V 1 100 0.00 4.998779 FORMAT "%8.6" ECU_ADDRESS 0x6000D8AA /end MEASUREMENT
/begin MEASUREMENT EGSDU_S2B1TarLeanEvlnDs_I.u_Err_C "class instance:supply diagnosis result of range check of target lean sensor voltage, sensor 2, bank 1 / Threshold to detect sensor voltage fault" UWORD spg_q1p221Em3_V 1 100 0.00 4.998779 FORMAT "%8.6" ECU_ADDRESS 0x6000D8AC /end MEASUREMENT
/begin MEASUREMENT EGSDU_S2B1TarLeanSrvEvln_I.flgDisbl "Class instance: interface to fault code memory and scan tool services range check of lean target sensor voltage, sensor 2, bank 1 / DFC is disabled by disable mask" UBYTE B_TRUE 1 100 0.00 1.00000000000 BIT_MASK 0x1 FORMAT "%13.11" ECU_ADDRESS 0x60003ABC /end MEASUREMENT
/begin MEASUREMENT EGSDU_S2B1TarLeanSrvEvln_I.flgErrSuspc "Class instance: interface to fault code memory and scan tool services range check of lean target sensor voltage, sensor 2, bank 1 / condition: Results go beyond the fault threshold" UBYTE B_TRUE 1 100 0.00 1.00000000000 BIT_MASK 0x1 FORMAT "%13.11" ECU_ADDRESS 0x60003ABD /end MEASUREMENT
/begin MEASUREMENT EGSDU_S2B1TarLeanSrvEvln_I.flgInhbn "Class instance: interface to fault code memory and scan tool services range check of lean target sensor voltage, sensor 2, bank 1 / DFC is inhibited" UBYTE B_TRUE 1 100 0.00 1.00000000000 BIT_MASK 0x1 FORMAT "%13.11" ECU_ADDRESS 0x60003ABE /end MEASUREMENT
/begin MEASUREMENT EGSDU_S2B1TarLeanSrvEvln_I.flgOkOnceEvln "Class instance: interface to fault code memory and scan tool services range check of lean target sensor voltage, sensor 2, bank 1 / at least one target OK check in the current driving cycle" UBYTE B_TRUE 1 100 0.00 1.00000000000 BIT_MASK 0x1 FORMAT "%13.11" ECU_ADDRESS 0x60003ABF /end MEASUREMENT
/begin MEASUREMENT EGSDU_S2B1TarLeanSrvEvln_I.flgResEvln "Class instance: interface to fault code memory and scan tool services range check of lean target sensor voltage, sensor 2, bank 1 / Condition: result available" UBYTE B_TRUE 1 100 0.00 1.00000000000 BIT_MASK 0x1 FORMAT "%13.11" ECU_ADDRESS 0x60003AC0 /end MEASUREMENT
/begin MEASUREMENT EGSDU_S2B1TarLeanSrvEvln_I.flgResVirtEvln "Class instance: interface to fault code memory and scan tool services range check of lean target sensor voltage, sensor 2, bank 1 / measurement for IUMPR is finished" UBYTE B_TRUE 1 100 0.00 1.00000000000 BIT_MASK 0x1 FORMAT "%13.11" ECU_ADDRESS 0x60003AC1 /end MEASUREMENT
/begin MEASUREMENT EGSDU_S2B1TarLeanSrvEvln_I.flgFrzFrmER_I.buffer "Class instance: interface to fault code memory and scan tool services range check of lean target sensor voltage, sensor 2, bank 1 / EdgeRising:FreezeFrame is placed. / rising edge detected" UBYTE B_TRUE 1 100 0.00 1.00000000000 BIT_MASK 0x1 FORMAT "%13.11" ECU_ADDRESS 0x60003AC2 /end MEASUREMENT
/begin MEASUREMENT EGSDU_S2B1TarLeanSrvEvln_I.flgFrzFrmER_I.oldSignal "Class instance: interface to fault code memory and scan tool services range check of lean target sensor voltage, sensor 2, bank 1 / EdgeRising:FreezeFrame is placed. / flag rising edge" UBYTE B_TRUE 1 100 0.00 1.00000000000 BIT_MASK 0x1 FORMAT "%13.11" ECU_ADDRESS 0x60003AC3 /end MEASUREMENT
/begin MEASUREMENT EGSDU_S2B1TarRichEvlnDs_I.flgFCMClrReqdCL10ms "class instance:supply diagnosis result of range check of target rich sensor voltage, sensor 2, bank 1 / FCM clear status flag" UBYTE B_TRUE 1 100 0.00 1.00000000000 BIT_MASK 0x1 FORMAT "%13.11" ECU_ADDRESS 0x6000D8AE /end MEASUREMENT
/begin MEASUREMENT EGSDU_S2B1TarRichEvlnDs_I.flgRes "class instance:supply diagnosis result of range check of target rich sensor voltage, sensor 2, bank 1 / Condition: result available" UBYTE B_TRUE 1 100 0.00 1.00000000000 BIT_MASK 0x1 FORMAT "%13.11" ECU_ADDRESS 0x6000D8AF /end MEASUREMENT
/begin MEASUREMENT EGSDU_S2B1TarRichEvlnDs_I.flgResVirt "class instance:supply diagnosis result of range check of target rich sensor voltage, sensor 2, bank 1 / measurement for IUMPR is finished" UBYTE B_TRUE 1 100 0.00 1.00000000000 BIT_MASK 0x1 FORMAT "%13.11" ECU_ADDRESS 0x6000D8B0 /end MEASUREMENT
/begin MEASUREMENT EGSDU_S2B1TarRichEvlnDs_I.u "class instance:supply diagnosis result of range check of target rich sensor voltage, sensor 2, bank 1 / Sensor voltage" UWORD spg_q1p221Em3_V 1 100 0.00 4.998779 FORMAT "%8.6" ECU_ADDRESS 0x6000D8B2 /end MEASUREMENT
/begin MEASUREMENT EGSDU_S2B1TarRichEvlnDs_I.u_Err_C "class instance:supply diagnosis result of range check of target rich sensor voltage, sensor 2, bank 1 / Threshold to detect sensor voltage fault" UWORD spg_q1p221Em3_V 1 100 0.00 4.998779 FORMAT "%8.6" ECU_ADDRESS 0x6000D8B4 /end MEASUREMENT
/begin MEASUREMENT EGSDU_S2B1TarRichSrvEvln_I.flgDisbl "Class instance: interface to fault code memory and scan tool services range check of rich target sensor voltage, sensor 2, bank 1 / DFC is disabled by disable mask" UBYTE B_TRUE 1 100 0.00 1.00000000000 BIT_MASK 0x1 FORMAT "%13.11" ECU_ADDRESS 0x60003AB4 /end MEASUREMENT
/begin MEASUREMENT EGSDU_S2B1TarRichSrvEvln_I.flgErrSuspc "Class instance: interface to fault code memory and scan tool services range check of rich target sensor voltage, sensor 2, bank 1 / condition: Results go beyond the fault threshold" UBYTE B_TRUE 1 100 0.00 1.00000000000 BIT_MASK 0x1 FORMAT "%13.11" ECU_ADDRESS 0x60003AB5 /end MEASUREMENT
/begin MEASUREMENT EGSDU_S2B1TarRichSrvEvln_I.flgInhbn "Class instance: interface to fault code memory and scan tool services range check of rich target sensor voltage, sensor 2, bank 1 / DFC is inhibited" UBYTE B_TRUE 1 100 0.00 1.00000000000 BIT_MASK 0x1 FORMAT "%13.11" ECU_ADDRESS 0x60003AB6 /end MEASUREMENT
/begin MEASUREMENT EGSDU_S2B1TarRichSrvEvln_I.flgOkOnceEvln "Class instance: interface to fault code memory and scan tool services range check of rich target sensor voltage, sensor 2, bank 1 / at least one target OK check in the current driving cycle" UBYTE B_TRUE 1 100 0.00 1.00000000000 BIT_MASK 0x1 FORMAT "%13.11" ECU_ADDRESS 0x60003AB7 /end MEASUREMENT
/begin MEASUREMENT EGSDU_S2B1TarRichSrvEvln_I.flgResEvln "Class instance: interface to fault code memory and scan tool services range check of rich target sensor voltage, sensor 2, bank 1 / Condition: result available" UBYTE B_TRUE 1 100 0.00 1.00000000000 BIT_MASK 0x1 FORMAT "%13.11" ECU_ADDRESS 0x60003AB8 /end MEASUREMENT
/begin MEASUREMENT EGSDU_S2B1TarRichSrvEvln_I.flgResVirtEvln "Class instance: interface to fault code memory and scan tool services range check of rich target sensor voltage, sensor 2, bank 1 / measurement for IUMPR is finished" UBYTE B_TRUE 1 100 0.00 1.00000000000 BIT_MASK 0x1 FORMAT "%13.11" ECU_ADDRESS 0x60003AB9 /end MEASUREMENT
/begin MEASUREMENT EGSDU_S2B1TarRichSrvEvln_I.flgFrzFrmER_I.buffer "Class instance: interface to fault code memory and scan tool services range check of rich target sensor voltage, sensor 2, bank 1 / EdgeRising:FreezeFrame is placed. / rising edge detected" UBYTE B_TRUE 1 100 0.00 1.00000000000 BIT_MASK 0x1 FORMAT "%13.11" ECU_ADDRESS 0x60003ABA /end MEASUREMENT
/begin MEASUREMENT EGSDU_S2B1TarRichSrvEvln_I.flgFrzFrmER_I.oldSignal "Class instance: interface to fault code memory and scan tool services range check of rich target sensor voltage, sensor 2, bank 1 / EdgeRising:FreezeFrame is placed. / flag rising edge" UBYTE B_TRUE 1 100 0.00 1.00000000000 BIT_MASK 0x1 FORMAT "%13.11" ECU_ADDRESS 0x60003ABB /end MEASUREMENT
/begin MEASUREMENT EGSDU_shtrp_100ms_I.buffer "Trigger shorttrip after flgtrip is set / rising edge detected" UBYTE B_TRUE 1 100 0.00 1.00000000000 BIT_MASK 0x1 FORMAT "%13.11" ECU_ADDRESS 0x60003AB2 /end MEASUREMENT
/begin MEASUREMENT EGSDU_shtrp_100ms_I.oldSignal "Trigger shorttrip after flgtrip is set / flag rising edge" UBYTE B_TRUE 1 100 0.00 1.00000000000 BIT_MASK 0x1 FORMAT "%13.11" ECU_ADDRESS 0x60003AB3 /end MEASUREMENT
/begin MEASUREMENT EGSDU_stS2B1VirtParlOld "Value of last calculation step: status of state machine of lambda shifting from coordinator function of parallelization, bank 2" UBYTE dez 1 100 0.00 255.0 FORMAT "%5.1" ECU_ADDRESS 0x6000E39D /end MEASUREMENT
/begin MEASUREMENT EGSDU_tiS2B1LenLtrDly "Expected delay time of sensor voltage at transition lean to rich in system without fault, sensor 2, bank 1" UWORD t_q0p01 1 100 0.00 655.3500 FORMAT "%8.4" ECU_ADDRESS 0x60004908 /end MEASUREMENT
/begin MEASUREMENT EGSDU_tiS2B1LenRtlDly "Expected delay time of sensor voltage at transition rich to lean in system without fault, sensor 2, bank 1" UWORD t_q0p01 1 100 0.00 655.3500 FORMAT "%8.4" ECU_ADDRESS 0x60004906 /end MEASUREMENT
/begin MEASUREMENT EGSDU_tiS2B1LtrDlyEvln "evaluated delay time of sensor voltage during crossing lean to rich , sensor 2, bank 1" UWORD t_q0p01 1 100 0.00 655.3500 FORMAT "%8.4" ECU_ADDRESS 0x60004904 /end MEASUREMENT
/begin MEASUREMENT EGSDU_tiS2B1LtrDlySymcEvln "evaluated delay time of sensor voltage during asymmetric crossing lean to rich , sensor 2, bank 1" UWORD t_q0p01 1 100 0.00 655.3500 FORMAT "%8.4" ECU_ADDRESS 0x60004902 /end MEASUREMENT
/begin MEASUREMENT EGSDU_tiS2B1LtrNrmDly "normalized delay time (single measuremement) of sensor voltage at transition lean to rich, sensor 2, bank 1" SWORD t_q0p01 1 100 -327.6800 327.6700 FORMAT "%8.4" ECU_ADDRESS 0x600050F4 /end MEASUREMENT
/begin MEASUREMENT EGSDU_tiS2B1LtrRawDly "Raw value delay time (single measuremement) of sensor voltage at transition lean to rich, sensor 2, bank 1" UWORD t_q0p01 1 100 0.00 655.3500 FORMAT "%8.4" ECU_ADDRESS 0x60004CEA /end MEASUREMENT
/begin MEASUREMENT EGSDU_tiS2B1LtrTran "transition time (single measurement) of sensor voltage at transition lean to rich, sensor 2, bank 1" SWORD t_q0p01 1 100 -327.6800 327.6700 FORMAT "%8.4" ECU_ADDRESS 0x600050F2 /end MEASUREMENT
/begin MEASUREMENT EGSDU_tiS2B1LtrTranEvln "evaluated transition time of sensor voltage during crossing lean to rich , sensor 2, bank 1" UWORD t_q0p01 1 100 0.00 655.3500 FORMAT "%8.4" ECU_ADDRESS 0x6000E1CC /end MEASUREMENT
/begin MEASUREMENT EGSDU_tiS2B1LtrTranSymcEvln "evaluated transition time of sensor voltage during asymmetric crossing lean to rich , sensor 2, bank 1" UWORD t_q0p01 1 100 0.00 655.3500 FORMAT "%8.4" ECU_ADDRESS 0x60004900 /end MEASUREMENT
/begin MEASUREMENT EGSDU_tiS2B1RtlDlyEvln "evaluated delay time of sensor voltage during crossing rich to lean , sensor 2, bank 1" UWORD t_q0p01 1 100 0.00 655.3500 FORMAT "%8.4" ECU_ADDRESS 0x600048FE /end MEASUREMENT
/begin MEASUREMENT EGSDU_tiS2B1RtlDlySymcEvln "Maximum delay time of sensor voltage during asymmetric crossing rich to lean , sensor 2, bank 1" UWORD t_q0p01 1 100 0.00 655.3500 FORMAT "%8.4" ECU_ADDRESS 0x600048FC /end MEASUREMENT
/begin MEASUREMENT EGSDU_tiS2B1RtlNrmDly "normalized delay time (single measurement) of sensor voltage at transition rich to lean, sensor 2, bank 1" SWORD t_q0p01 1 100 -327.6800 327.6700 FORMAT "%8.4" ECU_ADDRESS 0x600050F0 /end MEASUREMENT
/begin MEASUREMENT EGSDU_tiS2B1RtlRawDly "Raw value delay time (single measuremement) of sensor voltage at transition rich to lean, sensor 2, bank 1" UWORD t_q0p01 1 100 0.00 655.3500 FORMAT "%8.4" ECU_ADDRESS 0x60004CE8 /end MEASUREMENT
/begin MEASUREMENT EGSDU_tiS2B1RtlTran "transition time (single measurement) of sensor voltage at transition rich to lean, sensor 2, bank 1" SWORD t_q0p01 1 100 -327.6800 327.6700 FORMAT "%8.4" ECU_ADDRESS 0x600050EE /end MEASUREMENT
/begin MEASUREMENT EGSDU_tiS2B1RtlTranEvln "evaluated transition time of sensor voltage during crossing rich to lean , sensor 2, bank 1" UWORD t_q0p01 1 100 0.00 655.3500 FORMAT "%8.4" ECU_ADDRESS 0x6000E1CE /end MEASUREMENT
/begin MEASUREMENT EGSDU_tiS2B1RtlTranSymcEvln "evaluated transition time of sensor voltage during asymmetric crossing rich to lean , sensor 2, bank 1" UWORD t_q0p01 1 100 0.00 655.3500 FORMAT "%8.4" ECU_ADDRESS 0x600048FA /end MEASUREMENT
/begin MEASUREMENT ElecLd_cntrReIni "ReIni counter variable" UBYTE OneToOne 1 100 0.00 255.0 FORMAT "%5.1" ECU_ADDRESS 0x60006568 /end MEASUREMENT
/begin MEASUREMENT ElecLd_iAirCmpr "Electric load current from Air Compressor" SWORD Curr_A 1 100 -327.6800 327.6700 FORMAT "%8.4" ECU_ADDRESS 0x600050D4 /end MEASUREMENT
/begin MEASUREMENT ElecLd_iBlowrFanAC "Blower Fan AC current" SWORD Curr_A 1 100 -327.6800 327.6700 FORMAT "%8.4" ECU_ADDRESS 0x600050D2 /end MEASUREMENT
/begin MEASUREMENT ElecLd_iEPSLd "Electric load current output value" SWORD Curr_A 1 100 -327.6800 327.6700 FORMAT "%8.4" ECU_ADDRESS 0x600050D0 /end MEASUREMENT
/begin MEASUREMENT ElecLd_iEPSLoadOnly "Electric load current from EPS ECU only." SWORD Curr_A 1 100 -327.6800 327.6700 FORMAT "%8.4" ECU_ADDRESS 0x600050CE /end MEASUREMENT
/begin MEASUREMENT ElecLd_iFan "Electric load current from fan" SWORD Curr_A 1 100 -327.6800 327.6700 FORMAT "%8.4" ECU_ADDRESS 0x600050CC /end MEASUREMENT
/begin MEASUREMENT ElecLd_iFild1EPSLoad "ElecLd_iFild1EPSLoad normalised value of filtered load current" SWORD Curr_A 1 100 -327.6800 327.6700 FORMAT "%8.4" ECU_ADDRESS 0x60003A98 /end MEASUREMENT
/begin MEASUREMENT ElecLd_iFildElecLoad "Filtered value of Sensed Load current" SWORD Curr_A 1 100 -327.6800 327.6700 FORMAT "%8.4" ECU_ADDRESS 0x60003A96 /end MEASUREMENT
/begin MEASUREMENT ElecLd_iFildEPSLoad "ElecLd_iFildEPSLoad filtered value of the load current" SWORD Curr_A 1 100 -327.6800 327.6700 FORMAT "%8.4" ECU_ADDRESS 0x60003A94 /end MEASUREMENT
/begin MEASUREMENT ElecLd_iFrntDeicer "Electric load current from Front de-icer switch" SWORD Curr_A 1 100 -327.6800 327.6700 FORMAT "%8.4" ECU_ADDRESS 0x600050CA /end MEASUREMENT
/begin MEASUREMENT ElecLd_iFrntFog "Electric load current from Front-fog lamp switch" SWORD Curr_A 1 100 -327.6800 327.6700 FORMAT "%8.4" ECU_ADDRESS 0x600050C8 /end MEASUREMENT
/begin MEASUREMENT ElecLd_iLd "Electric load current from the hardware" SWORD Curr_A 1 100 -327.6800 327.6700 FORMAT "%8.4" ECU_ADDRESS 0x600050C2 /end MEASUREMENT
/begin MEASUREMENT ElecLd_iLd1 "Electric loads from Head Light, Front Fog, Rear Fog, Wiper, Front De-icer, Rear de-fogger (Manual AC), Rear de-fogger (Auto AC) and Blower Fan(Auto AC and Manual AC)" SWORD Curr_A 1 100 -327.6800 327.6700 FORMAT "%8.4" ECU_ADDRESS 0x600050C6 /end MEASUREMENT
/begin MEASUREMENT ElecLd_iLd2 "Electric Load from calibration when Communication Error occurs" SWORD Curr_A 1 100 -327.6800 327.6700 FORMAT "%8.4" ECU_ADDRESS 0x600050C4 /end MEASUREMENT
/begin MEASUREMENT ElecLd_iLiSwt "Electric load current from light switch" SWORD Curr_A 1 100 -327.6800 327.6700 FORMAT "%8.4" ECU_ADDRESS 0x600050C0 /end MEASUREMENT
/begin MEASUREMENT ElecLd_iLoadMdlUnFild "Unfiltered value of the modelled load current" SWORD Curr_A 1 100 -327.6800 327.6700 FORMAT "%8.4" ECU_ADDRESS 0x600050BE /end MEASUREMENT
/begin MEASUREMENT ElecLd_iReDeFoggerAutoAC "Electric load current from Rear de-fogger (Auto AC) switch" SWORD Curr_A 1 100 -327.6800 327.6700 FORMAT "%8.4" ECU_ADDRESS 0x600050BC /end MEASUREMENT
/begin MEASUREMENT ElecLd_iReDeFoggerManAC "Electric load current from Rear de-fogger (Manual AC) switch" SWORD Curr_A 1 100 -327.6800 327.6700 FORMAT "%8.4" ECU_ADDRESS 0x600050BA /end MEASUREMENT
/begin MEASUREMENT ElecLd_iReFog "Electric load current from Rear-fog lamp switch" SWORD Curr_A 1 100 -327.6800 327.6700 FORMAT "%8.4" ECU_ADDRESS 0x600050B8 /end MEASUREMENT
/begin MEASUREMENT ElecLd_iUnfildLoad "Unfiltered value of the load current" SWORD Curr_A 1 100 -327.6800 327.6700 FORMAT "%8.4" ECU_ADDRESS 0x60003A92 /end MEASUREMENT
/begin MEASUREMENT ElecLd_iWipr "Electric load current from wiper" SWORD Curr_A 1 100 -327.6800 327.6700 FORMAT "%8.4" ECU_ADDRESS 0x600050B4 /end MEASUREMENT
/begin MEASUREMENT ElecLd_stAutoAC "AC learning status" UBYTE OneToOne 1 100 0.00 1.000 FORMAT "%5.3" ECU_ADDRESS 0x600365F0 /end MEASUREMENT
/begin MEASUREMENT ElecLd_stHdLiInfo "Head Light Information status" UBYTE OneToOne 1 100 0.00 255.0 FORMAT "%5.1" ECU_ADDRESS 0x6000A3BB /end MEASUREMENT
/begin MEASUREMENT ElecLd_swtCurrMdl "Electric Load current value Model switch" UBYTE OneToOne 1 100 0.00 1.000 FORMAT "%5.3" ECU_ADDRESS 0x6000A3B9 /end MEASUREMENT
/begin MEASUREMENT ElecLd_uHeatrMot "Value of Heater Motor Voltage" SWORD Volt_Batt 1 100 -655360.0 655340.0 FORMAT "%8.1" ECU_ADDRESS 0x60003A90 /end MEASUREMENT
/begin MEASUREMENT EngDa_pwrCrksftMax "Maximum engine power at crankshaft level" SLONG Pwr_kW 1 100 0.00000 16777216.00000 FORMAT "%20.5" ECU_ADDRESS 0x60001C18 /end MEASUREMENT
/begin MEASUREMENT EngDa_pwrCrksftMax_f "Engine reference power at crankshaft level" FLOAT32_IEEE RBPtCel_pwr_kw_1p0_1 1 100 0.00000 16777216.00000 FORMAT "%20.5" ECU_ADDRESS 0x50004C4C /end MEASUREMENT
/begin MEASUREMENT EngDa_tqCrksftMax "Maximun Engine torque at crankshaft level" SLONG Trq 1 100 0.00 65535.0000000 FORMAT "%13.7" ECU_ADDRESS 0x60001C10 /end MEASUREMENT
/begin MEASUREMENT EngDa_tqCrksftMax_f "Engine reference torque torque at crankshaft level" FLOAT32_IEEE RBPtCel_tq_1p0_1 1 100 0.00000 16777216.00000 FORMAT "%16.5" ECU_ADDRESS 0x60001C44 /end MEASUREMENT
/begin MEASUREMENT EngDa_tqInnrMax "Maximum indicated Engine torque torque" SLONG Trq 1 100 0.00 65535.0000000 FORMAT "%13.7" ECU_ADDRESS 0x50004C50 /end MEASUREMENT
/begin MEASUREMENT EngDa_tqInnrMax_f "Maximum indicated Engine torque torque" FLOAT32_IEEE RBPtCel_tq_1p0_1 1 100 0.00000 16777216.00000 FORMAT "%16.5" ECU_ADDRESS 0x60001C40 /end MEASUREMENT
/begin MEASUREMENT EngDa_volDispl "Engine displacement" UWORD Vol 1 100 0.00 655.3400 FORMAT "%8.4" ECU_ADDRESS 0x600048F4 /end MEASUREMENT
/begin MEASUREMENT EngDa_volDispl_f "Engine displacement" FLOAT32_IEEE RBPtCel_vol_1p0_1 1 100 0.00000 16777216.00000 FORMAT "%16.5" ECU_ADDRESS 0x60001C3C /end MEASUREMENT
/begin MEASUREMENT EngDem_dTqSlpLimnNeg "Selected negative ramp slope for torque limitation" SLONG RmpTrq 1 100 0.00 3276799.99847 FORMAT "%13.5" ECU_ADDRESS 0x60000338 /end MEASUREMENT
/begin MEASUREMENT EngDem_dTqSlpLimnPos "Selected positive ramp slope for torque limitation" SLONG RmpTrq 1 100 0.00 3276799.99847 FORMAT "%13.5" ECU_ADDRESS 0x60000340 /end MEASUREMENT
/begin MEASUREMENT EngDem_flgRampIni "Condition ramp initialisation" UBYTE B_TRUE 1 100 0.00 1.00000000000 BIT_MASK 0x1 FORMAT "%13.11" ECU_ADDRESS 0x60000777 /end MEASUREMENT
/begin MEASUREMENT EngDem_flgRampLeadReInit "Condition ramp initialisation on the Lead Path" UBYTE B_TRUE 1 100 0.00 1.00000000000 BIT_MASK 0x1 FORMAT "%13.11" ECU_ADDRESS 0x70001A19 /end MEASUREMENT
/begin MEASUREMENT EngDem_flgRampTgtRea "Condition target reached in the ramping of the torque limitation" UBYTE B_TRUE 1 100 0.00 1.00000000000 BIT_MASK 0x1 FORMAT "%13.11" ECU_ADDRESS 0x70001A18 /end MEASUREMENT
/begin MEASUREMENT EngDem_flgTqLimnErr "Condition system errors replacement value active in torque limitation" UBYTE B_TRUE 1 100 0.00 1.00000000000 BIT_MASK 0x1 FORMAT "%13.11" ECU_ADDRESS 0x70001BF3 /end MEASUREMENT
/begin MEASUREMENT EngDem_RampTgHldFF_I.status "Target-hold condition evaluated / current value of RS-FF" UBYTE B_TRUE 1 100 0.00 1.00000000000 BIT_MASK 0x1 FORMAT "%13.11" ECU_ADDRESS 0x600006D7 /end MEASUREMENT
/begin MEASUREMENT EngDem_ReInitCurrTqLeadERNM_I.oldSignal "Edge-rising condition for re-initialisation of torque limitation ramp on the Lead Path to current torque / value of input signal last calculation" UBYTE B_TRUE 1 100 0.00 1.00000000000 BIT_MASK 0x1 FORMAT "%13.11" ECU_ADDRESS 0x600006D8 /end MEASUREMENT
/begin MEASUREMENT EngDem_ReInitErrTqLeadERNM_I.oldSignal "Edge-rising condition for re-initialisation of torque limitation ramp on the Lead Path to error torque / value of input signal last calculation" UBYTE B_TRUE 1 100 0.00 1.00000000000 BIT_MASK 0x1 FORMAT "%13.11" ECU_ADDRESS 0x600006D9 /end MEASUREMENT
/begin MEASUREMENT EngDem_stLimErr "Status of the limitation FIds (1 Bit for each limitation)" ULONG OneToOne 1 100 0.00 4294967295.00 FORMAT "%13.2" ECU_ADDRESS 0x6000D70C /end MEASUREMENT
/begin MEASUREMENT EngDem_stLimErrMn "Selected lowest system error torque limitations" ULONG OneToOne 1 100 0.00 4294967295.00 FORMAT "%13.2" ECU_ADDRESS 0x60000348 /end MEASUREMENT
/begin MEASUREMENT EngDem_TqLimnLeadRMP_I.Dir "Ramp for torque limitation in the lead path / Direction element" SWORD OneToOne 1 100 -32768.00 32767.00 FORMAT "%8.2" ECU_ADDRESS 0x60000200 /end MEASUREMENT
/begin MEASUREMENT EngDem_TqLimnLeadRMP_I.State "Ramp for torque limitation in the lead path / Store state value" SLONG TrqHigh 1 100 -2147483.64800 2147483.64700 FORMAT "%13.5" ECU_ADDRESS 0x60000204 /end MEASUREMENT
/begin MEASUREMENT EngDem_TqLimnLeadRMP_I.Target "Ramp for torque limitation in the lead path / variable to recognize change of target" SLONG TrqHigh 1 100 -2147483.64800 2147483.64700 FORMAT "%13.5" ECU_ADDRESS 0x60000208 /end MEASUREMENT
/begin MEASUREMENT EngDem_tqLimnRampLead "Torque limitation on the Lead Path ramped" SWORD Trq 1 100 -3276.800 3276.700 FORMAT "%8.3" ECU_ADDRESS 0x600004FE /end MEASUREMENT
/begin MEASUREMENT EngDem_trqInrLim "Torque limitation" SWORD Trq 1 100 0.00 3276.700 FORMAT "%8.3" ECU_ADDRESS 0x500006E0 /end MEASUREMENT
/begin MEASUREMENT EngDem_trqInrLimCtOff "Torque limitation cut-off path (cylinder deactivation)" SWORD Trq 1 100 0.00 3276.700 FORMAT "%8.3" ECU_ADDRESS 0x70001DA6 /end MEASUREMENT
/begin MEASUREMENT EngDem_trqInrLimLead "Torque limitation (air path)" SWORD Trq 1 100 0.00 3276.700 FORMAT "%8.3" ECU_ADDRESS 0x500006E2 /end MEASUREMENT
/begin MEASUREMENT EngDem_trqLimErr "Substitute limiting torque in the event of an error" SWORD Trq 1 100 0.00 3276.700 FORMAT "%8.3" ECU_ADDRESS 0x60000504 /end MEASUREMENT
/begin MEASUREMENT EngDem_trqLimLeadRslt "Resulting limiting torque before ramp" SWORD Trq 1 100 -3276.800 3276.700 FORMAT "%8.3" ECU_ADDRESS 0x60000508 /end MEASUREMENT
/begin FUNCTION EGSDU_DlyDs "1.17.0    Dynamic diagnosis binary oxygen sensor downstream - delay"
 /begin DEF_CHARACTERISTIC EGSDU_DlyMeasS2B1_I.corrCatEftLtr_Map EGSDU_DlyMeasS2B1_I.corrCatEftRtl_Map EGSDU_duFallDly_C EGSDU_duFallGrdtDly_C EGSDU_duRiseDly_C EGSDU_duRiseGrdtDly_C EGSDU_duS2StrtLtrInflTranDly_C EGSDU_duS2StrtRtlInflTranDly_C EGSDU_flgCorrCatEftDly_CW EGSDU_ratLamNoiseLtrDly_C EGSDU_ratLamNoiseRtlDly_C EGSDU_S2TiLenLtrDly_CUR EGSDU_S2TiLenRtlDly_CUR EGSDU_tiToutLtrDly_C EGSDU_tiToutRtlDly_C /end DEF_CHARACTERISTIC
 /begin REF_CHARACTERISTIC EGSDCmn_flgSymTranOnly_CW /end REF_CHARACTERISTIC
 /begin IN_MEASUREMENT EGSDCmn_duS2B1Parl EGSDCmn_mfEgCat1B1Parl EGSDCmn_ratLamReqParlB1 EGSDCmn_stLamGenrParlB1 EGSDCmn_stVirtUDlyParlB1 EGSDCmn_uS2B1FildParl EGSDU_flgS2B1LtrInflDlyTran EGSDU_flgS2B1RtlInflDlyTran lamsons_w_msg SyC_ctPostDrvLeave /end IN_MEASUREMENT
 /begin OUT_MEASUREMENT EGSDU_flgS2B1InhbRiDly EGSDU_flgS2B1ResLtrDly EGSDU_flgS2B1ResRtlDly EGSDU_flgS2B1ResVirtLtrDly EGSDU_flgS2B1ResVirtRtlDly EGSDU_tiS2B1LtrNrmDly EGSDU_tiS2B1LtrRawDly EGSDU_tiS2B1RtlNrmDly EGSDU_tiS2B1RtlRawDly /end OUT_MEASUREMENT
 /begin LOC_MEASUREMENT EGSDU_ctReIni10msDlyDs EGSDU_DlyMeasS2B1_I.duLtrCorrGrdt EGSDU_DlyMeasS2B1_I.duRtlCorrGrdt EGSDU_DlyMeasS2B1_I.flgInhbRi EGSDU_DlyMeasS2B1_I.flgLtrMeasFinshd EGSDU_DlyMeasS2B1_I.flgLtrRes EGSDU_DlyMeasS2B1_I.flgLtrTout EGSDU_DlyMeasS2B1_I.flgRtlMeasFinshd EGSDU_DlyMeasS2B1_I.flgRtlRes EGSDU_DlyMeasS2B1_I.flgRtlTout EGSDU_DlyMeasS2B1_I.flgUFall EGSDU_DlyMeasS2B1_I.flgURise EGSDU_DlyMeasS2B1_I.stParlOld EGSDU_DlyMeasS2B1_I.tiLtrCorrGrdt EGSDU_DlyMeasS2B1_I.tiLtrCorrGrdtMax EGSDU_DlyMeasS2B1_I.tiLtrCorrGrdtPre EGSDU_DlyMeasS2B1_I.tiLtrCorrGrdtTmp EGSDU_DlyMeasS2B1_I.tiLtrDly EGSDU_DlyMeasS2B1_I.tiLtrDlyMeas EGSDU_DlyMeasS2B1_I.tiRtlCorrGrdt EGSDU_DlyMeasS2B1_I.tiRtlCorrGrdtMax EGSDU_DlyMeasS2B1_I.tiRtlCorrGrdtPre EGSDU_DlyMeasS2B1_I.tiRtlCorrGrdtTmp EGSDU_DlyMeasS2B1_I.tiRtlDly EGSDU_DlyMeasS2B1_I.tiRtlDlyMeas EGSDU_DlyMeasS2B1_I.uMax EGSDU_DlyMeasS2B1_I.uMin EGSDU_DlyMeasS2B1_I.EndTiCntrLtrERNM_I.oldSignal EGSDU_DlyMeasS2B1_I.EndTiCntrRtlERNM_I.oldSignal EGSDU_DlyMeasS2B1_I.flgLtrDurFF_I.status EGSDU_DlyMeasS2B1_I.flgRtlDurFF_I.status EGSDU_flgDSMClrDlyDs EGSDU_tiS2B1LenLtrDly EGSDU_tiS2B1LenRtlDly /end LOC_MEASUREMENT
 FUNCTION_VERSION "1.17.0" /end FUNCTION
/begin FUNCTION EGSDU_EvlnDs "1.32.3    Dynamic diagnosis binary oxygen sensor downstream - evaluation"
 /begin DEF_CHARACTERISTIC EGSDU_facBndErrEvln_C EGSDU_flgS2LtrDlyArthEvln_CW EGSDU_flgS2LtrTranArthEvln_CW EGSDU_flgS2RtlDlyArthEvln_CW EGSDU_flgS2RtlTranArthEvln_CW EGSDU_S2B1LtrFilDlyEvln_I.numMeasShtrp_C EGSDU_S2B1LtrFilDlyEvln_I.numMeasStepChg_C EGSDU_S2B1LtrFilDlyEvln_I.numMeas_C EGSDU_S2B1LtrFilDlyEvln_I.tiBndErrEvlnOffs_C EGSDU_S2B1LtrFilDlyEvln_I.tiEwma_C EGSDU_S2B1LtrFilDlyEvln_I.tiIni_C EGSDU_S2B1LtrFilDlyEvln_I.tiStepChgCnf_C EGSDU_S2B1LtrFilDlyEvln_I.tiStepChgSus_C EGSDU_S2B1LtrFilTranEvln_I.numMeasShtrp_C EGSDU_S2B1LtrFilTranEvln_I.numMeasStepChg_C EGSDU_S2B1LtrFilTranEvln_I.numMeas_C EGSDU_S2B1LtrFilTranEvln_I.tiBndErrEvlnOffs_C EGSDU_S2B1LtrFilTranEvln_I.tiEwma_C EGSDU_S2B1LtrFilTranEvln_I.tiIni_C EGSDU_S2B1LtrFilTranEvln_I.tiStepChgCnf_C EGSDU_S2B1LtrFilTranEvln_I.tiStepChgSus_C EGSDU_S2B1RtlFilDlyEvln_I.numMeasShtrp_C EGSDU_S2B1RtlFilDlyEvln_I.numMeasStepChg_C EGSDU_S2B1RtlFilDlyEvln_I.numMeas_C EGSDU_S2B1RtlFilDlyEvln_I.tiBndErrEvlnOffs_C EGSDU_S2B1RtlFilDlyEvln_I.tiEwma_C EGSDU_S2B1RtlFilDlyEvln_I.tiIni_C EGSDU_S2B1RtlFilDlyEvln_I.tiStepChgCnf_C EGSDU_S2B1RtlFilDlyEvln_I.tiStepChgSus_C EGSDU_S2B1RtlFilTranEvln_I.numMeasShtrp_C EGSDU_S2B1RtlFilTranEvln_I.numMeasStepChg_C EGSDU_S2B1RtlFilTranEvln_I.numMeas_C EGSDU_S2B1RtlFilTranEvln_I.tiBndErrEvlnOffs_C EGSDU_S2B1RtlFilTranEvln_I.tiEwma_C EGSDU_S2B1RtlFilTranEvln_I.tiIni_C EGSDU_S2B1RtlFilTranEvln_I.tiStepChgCnf_C EGSDU_S2B1RtlFilTranEvln_I.tiStepChgSus_C EGSDU_tiS2DlyAsymcThdEvln EGSDU_tiS2LtrBPUDlyEvln_C EGSDU_tiS2LtrBPUTranEvln_C EGSDU_tiS2LtrErrDlyEvln_C EGSDU_tiS2LtrErrShtrpDlyEvln_C EGSDU_tiS2LtrErrShtrpTranEvln_C EGSDU_tiS2LtrErrTranEvln_C EGSDU_tiS2LtrSusTranEvln_C EGSDU_tiS2RtlBPUDlyEvln_C EGSDU_tiS2RtlBPUTranEvln_C EGSDU_tiS2RtlErrDlyEvln_C EGSDU_tiS2RtlErrShtrpDlyEvln_C EGSDU_tiS2RtlErrShtrpTranEvln_C EGSDU_tiS2RtlErrTranEvln_C EGSDU_tiS2RtlSusTranEvln_C EGSDU_tiS2TranAsymcThdEvln /end DEF_CHARACTERISTIC
 /begin REF_CHARACTERISTIC EGSDCmn_flgSymTranOnly_CW EGSDCmn_uCatEmptyGrdtParl_C EGSDCmn_uCatFullGrdtParl_C /end REF_CHARACTERISTIC
 /begin IN_MEASUREMENT Eep_EnvRamInvld EGSDCmn_flgEnvtlDiPID41Parl EGSDCmn_flgProdModParl EGSDCmn_flgRmnProdModParl EGSDCmn_flgS2B1TarLeanResParl EGSDCmn_flgS2B1TarLeanResVirtParl EGSDCmn_flgS2B1TarRichResParl EGSDCmn_flgS2B1TarRichResVirtParl EGSDCmn_flgShtrpParl EGSDCmn_uS2B1CatEmptMaxParl EGSDCmn_uS2B1CatFullMinParl EGSDU_flgS2B1InhbRiDly EGSDU_flgS2B1InhbRiTran EGSDU_flgS2B1ResLtrDly EGSDU_flgS2B1ResLtrTran EGSDU_flgS2B1ResRtlDly EGSDU_flgS2B1ResRtlTran EGSDU_flgS2B1ResVirtLtrDly EGSDU_flgS2B1ResVirtLtrTran EGSDU_flgS2B1ResVirtRtlDly EGSDU_flgS2B1ResVirtRtlTran EGSDU_tiS2B1LtrNrmDly EGSDU_tiS2B1LtrTran EGSDU_tiS2B1RtlNrmDly EGSDU_tiS2B1RtlTran SyC_ctPostDrvLeave /end IN_MEASUREMENT
 /begin OUT_MEASUREMENT EGSDU_flgS2B1AsymcFltEvln EGSDU_flgS2B1InhbRiEvln EGSDU_flgS2B1QPFaildDynEvln EGSDU_flgS2B1ResLtrDlyEvln EGSDU_flgS2B1ResLtrTranEvln EGSDU_flgS2B1ResRtlDlyEvln EGSDU_flgS2B1ResRtlTranEvln EGSDU_flgS2B1ResVirtLtrDlyEvln EGSDU_flgS2B1ResVirtLtrTranEvln EGSDU_flgS2B1ResVirtRtlDlyEvln EGSDU_flgS2B1ResVirtRtlTranEvln EGSDU_flgS2B1StepChgDynEvln EGSDU_flgS2B1TarLeanResEvln EGSDU_flgS2B1TarLeanResVirtEvln EGSDU_flgS2B1TarRichResEvln EGSDU_flgS2B1TarRichResVirtEvln EGSDU_flgS2B1TripLtrDlyEvln EGSDU_flgS2B1TripLtrTranEvln EGSDU_flgS2B1TripRtlDlyEvln EGSDU_flgS2B1TripRtlTranEvln EGSDU_flgS2B1TripVirtLtrDlyEvln EGSDU_flgS2B1TripVirtLtrTranEvln EGSDU_flgS2B1TripVirtRtlDlyEvln EGSDU_flgS2B1TripVirtRtlTranEvln EGSDU_flgS2B1VirtQPFaildDynEvln EGSDU_tiS2B1LtrDlyEvln EGSDU_tiS2B1LtrDlySymcEvln EGSDU_tiS2B1LtrTranEvln EGSDU_tiS2B1LtrTranSymcEvln EGSDU_tiS2B1RtlDlyEvln EGSDU_tiS2B1RtlDlySymcEvln EGSDU_tiS2B1RtlTranEvln EGSDU_tiS2B1RtlTranSymcEvln /end OUT_MEASUREMENT
 /begin LOC_MEASUREMENT EGSDU_ctReIni100msEvlnDs EGSDU_ctReIni10msEvlnDs EGSDU_S2B1LtrFilDlyEvln_I.flgFCMClrReqdCL100ms EGSDU_S2B1LtrFilDlyEvln_I.flgFCMClrReqdCL10ms EGSDU_S2B1LtrFilDlyEvln_I.flgQckPassd EGSDU_S2B1LtrFilDlyEvln_I.flgQckPassdFaild EGSDU_S2B1LtrFilDlyEvln_I.flgRes EGSDU_S2B1LtrFilDlyEvln_I.flgResFil EGSDU_S2B1LtrFilDlyEvln_I.flgResVirt EGSDU_S2B1LtrFilDlyEvln_I.flgResVirtFil EGSDU_S2B1LtrFilDlyEvln_I.flgResVirtTmp EGSDU_S2B1LtrFilDlyEvln_I.flgStepChg EGSDU_S2B1LtrFilDlyEvln_I.flgTrip EGSDU_S2B1LtrFilDlyEvln_I.flgTripVirt EGSDU_S2B1LtrFilDlyEvln_I.flgVirtQckFaild EGSDU_S2B1LtrFilDlyEvln_I.numMeas EGSDU_S2B1LtrFilDlyEvln_I.numMeasShtrp EGSDU_S2B1LtrFilDlyEvln_I.numMeasTrip EGSDU_S2B1LtrFilDlyEvln_I.numVirtMeas EGSDU_S2B1LtrFilDlyEvln_I.numVirtMeasTrip EGSDU_S2B1LtrFilDlyEvln_I.ti EGSDU_S2B1LtrFilDlyEvln_I.tiArth EGSDU_S2B1LtrFilDlyEvln_I.tiEwma EGSDU_S2B1LtrFilDlyEvln_I.tiFil EGSDU_S2B1LtrFilDlyEvln_I.tiQuickPass EGSDU_S2B1LtrFilDlyEvln_I.ResFF_I.status EGSDU_S2B1LtrFilDlyEvln_I.tiArithShtrpDL_I.memory EGSDU_S2B1LtrFilDlyEvln_I.tiArthDL_I.memory EGSDU_S2B1LtrFilDlyEvln_I.tiEwmaDL_I.memory EGSDU_S2B1LtrFilTranEvln_I.flgFCMClrReqdCL100ms EGSDU_S2B1LtrFilTranEvln_I.flgFCMClrReqdCL10ms EGSDU_S2B1LtrFilTranEvln_I.flgQckPassd EGSDU_S2B1LtrFilTranEvln_I.flgQckPassdFaild EGSDU_S2B1LtrFilTranEvln_I.flgRes EGSDU_S2B1LtrFilTranEvln_I.flgResFil EGSDU_S2B1LtrFilTranEvln_I.flgResVirt EGSDU_S2B1LtrFilTranEvln_I.flgResVirtFil EGSDU_S2B1LtrFilTranEvln_I.flgResVirtTmp EGSDU_S2B1LtrFilTranEvln_I.flgStepChg EGSDU_S2B1LtrFilTranEvln_I.flgTrip EGSDU_S2B1LtrFilTranEvln_I.flgTripVirt EGSDU_S2B1LtrFilTranEvln_I.flgVirtQckFaild EGSDU_S2B1LtrFilTranEvln_I.numMeas EGSDU_S2B1LtrFilTranEvln_I.numMeasShtrp EGSDU_S2B1LtrFilTranEvln_I.numMeasTrip EGSDU_S2B1LtrFilTranEvln_I.numVirtMeas EGSDU_S2B1LtrFilTranEvln_I.numVirtMeasTrip EGSDU_S2B1LtrFilTranEvln_I.ti EGSDU_S2B1LtrFilTranEvln_I.tiArth EGSDU_S2B1LtrFilTranEvln_I.tiEwma EGSDU_S2B1LtrFilTranEvln_I.tiFil EGSDU_S2B1LtrFilTranEvln_I.tiQuickPass EGSDU_S2B1LtrFilTranEvln_I.ResFF_I.status EGSDU_S2B1LtrFilTranEvln_I.tiArithShtrpDL_I.memory EGSDU_S2B1LtrFilTranEvln_I.tiArthDL_I.memory EGSDU_S2B1LtrFilTranEvln_I.tiEwmaDL_I.memory EGSDU_S2B1LtrSrvDlyEvln_I.flgDisbl EGSDU_S2B1LtrSrvDlyEvln_I.flgErrSuspc EGSDU_S2B1LtrSrvDlyEvln_I.flgInhbn EGSDU_S2B1LtrSrvDlyEvln_I.flgResEvln EGSDU_S2B1LtrSrvDlyEvln_I.flgResVirtEvln EGSDU_S2B1LtrSrvDlyEvln_I.flgFrzFrmER_I.buffer EGSDU_S2B1LtrSrvDlyEvln_I.flgFrzFrmER_I.oldSignal EGSDU_S2B1LtrSrvTranEvln_I.flgDisbl EGSDU_S2B1LtrSrvTranEvln_I.flgErrSuspc EGSDU_S2B1LtrSrvTranEvln_I.flgInhbn EGSDU_S2B1LtrSrvTranEvln_I.flgResEvln EGSDU_S2B1LtrSrvTranEvln_I.flgResVirtEvln EGSDU_S2B1LtrSrvTranEvln_I.flgFrzFrmER_I.buffer EGSDU_S2B1LtrSrvTranEvln_I.flgFrzFrmER_I.oldSignal EGSDU_S2B1RtlFilDlyEvln_I.flgFCMClrReqdCL100ms EGSDU_S2B1RtlFilDlyEvln_I.flgFCMClrReqdCL10ms EGSDU_S2B1RtlFilDlyEvln_I.flgQckPassd EGSDU_S2B1RtlFilDlyEvln_I.flgQckPassdFaild EGSDU_S2B1RtlFilDlyEvln_I.flgRes EGSDU_S2B1RtlFilDlyEvln_I.flgResFil EGSDU_S2B1RtlFilDlyEvln_I.flgResVirt EGSDU_S2B1RtlFilDlyEvln_I.flgResVirtFil EGSDU_S2B1RtlFilDlyEvln_I.flgResVirtTmp EGSDU_S2B1RtlFilDlyEvln_I.flgStepChg EGSDU_S2B1RtlFilDlyEvln_I.flgTrip EGSDU_S2B1RtlFilDlyEvln_I.flgTripVirt EGSDU_S2B1RtlFilDlyEvln_I.flgVirtQckFaild EGSDU_S2B1RtlFilDlyEvln_I.numMeas EGSDU_S2B1RtlFilDlyEvln_I.numMeasShtrp EGSDU_S2B1RtlFilDlyEvln_I.numMeasTrip EGSDU_S2B1RtlFilDlyEvln_I.numVirtMeas EGSDU_S2B1RtlFilDlyEvln_I.numVirtMeasTrip EGSDU_S2B1RtlFilDlyEvln_I.ti EGSDU_S2B1RtlFilDlyEvln_I.tiArth EGSDU_S2B1RtlFilDlyEvln_I.tiEwma EGSDU_S2B1RtlFilDlyEvln_I.tiFil EGSDU_S2B1RtlFilDlyEvln_I.tiQuickPass EGSDU_S2B1RtlFilDlyEvln_I.ResFF_I.status EGSDU_S2B1RtlFilDlyEvln_I.tiArithShtrpDL_I.memory EGSDU_S2B1RtlFilDlyEvln_I.tiArthDL_I.memory EGSDU_S2B1RtlFilDlyEvln_I.tiEwmaDL_I.memory EGSDU_S2B1RtlFilTranEvln_I.flgFCMClrReqdCL100ms EGSDU_S2B1RtlFilTranEvln_I.flgFCMClrReqdCL10ms EGSDU_S2B1RtlFilTranEvln_I.flgQckPassd EGSDU_S2B1RtlFilTranEvln_I.flgQckPassdFaild EGSDU_S2B1RtlFilTranEvln_I.flgRes EGSDU_S2B1RtlFilTranEvln_I.flgResFil EGSDU_S2B1RtlFilTranEvln_I.flgResVirt EGSDU_S2B1RtlFilTranEvln_I.flgResVirtFil EGSDU_S2B1RtlFilTranEvln_I.flgResVirtTmp EGSDU_S2B1RtlFilTranEvln_I.flgStepChg EGSDU_S2B1RtlFilTranEvln_I.flgTrip EGSDU_S2B1RtlFilTranEvln_I.flgTripVirt EGSDU_S2B1RtlFilTranEvln_I.flgVirtQckFaild EGSDU_S2B1RtlFilTranEvln_I.numMeas EGSDU_S2B1RtlFilTranEvln_I.numMeasShtrp EGSDU_S2B1RtlFilTranEvln_I.numMeasTrip EGSDU_S2B1RtlFilTranEvln_I.numVirtMeas EGSDU_S2B1RtlFilTranEvln_I.numVirtMeasTrip EGSDU_S2B1RtlFilTranEvln_I.ti EGSDU_S2B1RtlFilTranEvln_I.tiArth EGSDU_S2B1RtlFilTranEvln_I.tiEwma EGSDU_S2B1RtlFilTranEvln_I.tiFil EGSDU_S2B1RtlFilTranEvln_I.tiQuickPass EGSDU_S2B1RtlFilTranEvln_I.ResFF_I.status EGSDU_S2B1RtlFilTranEvln_I.tiArithShtrpDL_I.memory EGSDU_S2B1RtlFilTranEvln_I.tiArthDL_I.memory EGSDU_S2B1RtlFilTranEvln_I.tiEwmaDL_I.memory EGSDU_S2B1RtlSrvDlyEvln_I.flgDisbl EGSDU_S2B1RtlSrvDlyEvln_I.flgErrSuspc EGSDU_S2B1RtlSrvDlyEvln_I.flgInhbn EGSDU_S2B1RtlSrvDlyEvln_I.flgResEvln EGSDU_S2B1RtlSrvDlyEvln_I.flgResVirtEvln EGSDU_S2B1RtlSrvDlyEvln_I.flgFrzFrmER_I.buffer EGSDU_S2B1RtlSrvDlyEvln_I.flgFrzFrmER_I.oldSignal EGSDU_S2B1RtlSrvTranEvln_I.flgDisbl EGSDU_S2B1RtlSrvTranEvln_I.flgErrSuspc EGSDU_S2B1RtlSrvTranEvln_I.flgInhbn EGSDU_S2B1RtlSrvTranEvln_I.flgResEvln EGSDU_S2B1RtlSrvTranEvln_I.flgResVirtEvln EGSDU_S2B1RtlSrvTranEvln_I.flgFrzFrmER_I.buffer EGSDU_S2B1RtlSrvTranEvln_I.flgFrzFrmER_I.oldSignal EGSDU_S2B1TarLeanEvlnDs_I.flgFCMClrReqdCL10ms EGSDU_S2B1TarLeanEvlnDs_I.flgRes EGSDU_S2B1TarLeanEvlnDs_I.flgResVirt EGSDU_S2B1TarLeanEvlnDs_I.u EGSDU_S2B1TarLeanEvlnDs_I.u_Err_C EGSDU_S2B1TarLeanSrvEvln_I.flgDisbl EGSDU_S2B1TarLeanSrvEvln_I.flgErrSuspc EGSDU_S2B1TarLeanSrvEvln_I.flgInhbn EGSDU_S2B1TarLeanSrvEvln_I.flgOkOnceEvln EGSDU_S2B1TarLeanSrvEvln_I.flgResEvln EGSDU_S2B1TarLeanSrvEvln_I.flgResVirtEvln EGSDU_S2B1TarLeanSrvEvln_I.flgFrzFrmER_I.buffer EGSDU_S2B1TarLeanSrvEvln_I.flgFrzFrmER_I.oldSignal EGSDU_S2B1TarRichEvlnDs_I.flgFCMClrReqdCL10ms EGSDU_S2B1TarRichEvlnDs_I.flgRes EGSDU_S2B1TarRichEvlnDs_I.flgResVirt EGSDU_S2B1TarRichEvlnDs_I.u EGSDU_S2B1TarRichEvlnDs_I.u_Err_C EGSDU_S2B1TarRichSrvEvln_I.flgDisbl EGSDU_S2B1TarRichSrvEvln_I.flgErrSuspc EGSDU_S2B1TarRichSrvEvln_I.flgInhbn EGSDU_S2B1TarRichSrvEvln_I.flgOkOnceEvln EGSDU_S2B1TarRichSrvEvln_I.flgResEvln EGSDU_S2B1TarRichSrvEvln_I.flgResVirtEvln EGSDU_S2B1TarRichSrvEvln_I.flgFrzFrmER_I.buffer EGSDU_S2B1TarRichSrvEvln_I.flgFrzFrmER_I.oldSignal EGSDU_shtrp_100ms_I.buffer EGSDU_shtrp_100ms_I.oldSignal /end LOC_MEASUREMENT
 FUNCTION_VERSION "1.32.3" /end FUNCTION
/begin FUNCTION EGSDU_TranDs "1.19.2    Dynamic diagnosis binary oxygen sensor downstream - slow transition"
 /begin DEF_CHARACTERISTIC EGSDU_duMinRateTran_C EGSDU_S2B1MinTiLtrTran_I.uDstTarTran_C EGSDU_S2B1MinTiRtlTran_I.uDstTarTran_C EGSDU_tiBgnRiInhbTran_C EGSDU_tiS2CoorrLtrTran_Crv EGSDU_tiS2CoorrRtlTran_Crv EGSDU_tiS2LtrInflDlyTran_C EGSDU_tiS2RtlInflDlyTran_C EGSDU_uEndLtrTran_C EGSDU_uEndRtlTranParl_C EGSDU_uEndRtlTran_C /end DEF_CHARACTERISTIC
 /begin REF_CHARACTERISTIC EGSDCmn_flgSymTranOnly_CW /end REF_CHARACTERISTIC
 /begin IN_MEASUREMENT EGSDCmn_mfEgCat1B1Parl EGSDCmn_mfSeg1B1O2Parl EGSDCmn_mfSeg1B1RichParl EGSDCmn_stLamGenrParlB1 EGSDCmn_stVirtUTranParlB1 EGSDCmn_uS2B1FildParl SyC_ctPostDrvLeave /end IN_MEASUREMENT
 /begin OUT_MEASUREMENT EGSDU_flgS2B1InhbRiTran EGSDU_flgS2B1LtrInflDlyTran EGSDU_flgS2B1ResLtrTran EGSDU_flgS2B1ResRtlTran EGSDU_flgS2B1ResVirtLtrTran EGSDU_flgS2B1ResVirtRtlTran EGSDU_flgS2B1RtlInflDlyTran EGSDU_tiS2B1LtrTran EGSDU_tiS2B1RtlTran /end OUT_MEASUREMENT
 /begin LOC_MEASUREMENT EGSDU_ctReIni100msTranDs EGSDU_ctReIni10msTranDs EGSDU_flgDSMClrTranDs EGSDU_flgS2B1LtrMeasTran EGSDU_flgS2B1ResVirtRtlActvTran EGSDU_flgS2B1RtlMeasTran EGSDU_S2B1LtrMeasActvDur.flgMeasRprtTran EGSDU_S2B1LtrMeasActvDur.stParlOld EGSDU_S2B1LtrMeasActvDur.flgActvMeasTranFF_I.status EGSDU_S2B1MinTiLtrTran_I.du EGSDU_S2B1MinTiLtrTran_I.flgInhbRi EGSDU_S2B1MinTiLtrTran_I.flgMeasFinshd EGSDU_S2B1MinTiLtrTran_I.flgO2Extd EGSDU_S2B1MinTiLtrTran_I.tiTran EGSDU_S2B1MinTiLtrTran_I.tiTranSeg EGSDU_S2B1MinTiLtrTran_I.tiUStop EGSDU_S2B1MinTiLtrTran_I.uOld EGSDU_S2B1MinTiRtlTran_I.du EGSDU_S2B1MinTiRtlTran_I.flgInhbRi EGSDU_S2B1MinTiRtlTran_I.flgMeasFinshd EGSDU_S2B1MinTiRtlTran_I.flgO2Extd EGSDU_S2B1MinTiRtlTran_I.tiTran EGSDU_S2B1MinTiRtlTran_I.tiTranSeg EGSDU_S2B1MinTiRtlTran_I.tiUStop EGSDU_S2B1MinTiRtlTran_I.uOld EGSDU_S2B1RtlMeasActvDur.flgMeasTran EGSDU_S2B1RtlMeasActvDur.flgRprtTran EGSDU_S2B1RtlMeasActvDur.stParlOld EGSDU_S2B1RtlMeasActvDur.flgActvMeasTranFF_I.status EGSDU_stS2B1VirtParlOld /end LOC_MEASUREMENT
 FUNCTION_VERSION "1.19.2" /end FUNCTION
/begin FUNCTION ElecLd_VD "3.0.0     Electrical load current sensing"
 /begin DEF_CHARACTERISTIC ElecLd_facEPSLd_C ElecLd_iAirCmprGsl_C ElecLd_iBlowrFanAutoAC_CUR ElecLd_iBlowrFanManAC_CUR ElecLd_iComBase_C ElecLd_iComElecLoadReplcmt_C ElecLd_iComErrDftValGslAutAC_C ElecLd_iComErrDftValGslManAC_C ElecLd_iFan0_C ElecLd_iFan1_C ElecLd_iFan2_C ElecLd_iFanExt_C ElecLd_iFrntDeicer1_C ElecLd_iFrntDeicerSwt_C ElecLd_iFrntFog1_C ElecLd_iFrntFogSwt_C ElecLd_iLiSwt0_C ElecLd_iLiSwt1_C ElecLd_iLiSwt2_C ElecLd_iLiSwt3_C ElecLd_iReDeFoggerAutoAC1_C ElecLd_iReDeFoggerAutoACSwt_C ElecLd_iReDeFoggerManAC1_C ElecLd_iReDeFoggerManACSwt_C ElecLd_iReFog1_C ElecLd_iReFogSwt_C ElecLd_iWiprHi_C ElecLd_iWiprLo_C ElecLd_iWiprOffErr_C ElecLd_RmpSlp.Pos_C ElecLd_RmpSlp.Neg_C ElecLd_stSwtHdLiInfoSeln_C ElecLd_swtCurrMdl_C ElecLd_swtEPSLd_C ElecLd_tiAirCdnLrng_C ElecLd_tiLdFltPT1_C ElecLd_tiMdlLoadCalc_C ElecLd_tiPT1FltEPSLd_C ElecLd_TransStg.Dfl_C ElecLd_TransStg.stSensId_C /end DEF_CHARACTERISTIC
 /begin IN_MEASUREMENT ACCtl_stOut BattU_u CoEng_st Com_bDeIce Com_bMicuInfo Com_bReDEFOutCdn Com_bReDEFSwCdn Com_bRMHLHiRly Com_bRMHLLoRly Com_bRMILLSml Com_iElecLd Com_stACFailInfo Com_stAcInfo Com_stFailCode Com_stFrtFog Com_stLiSwtInfo Com_stMCUUnFailCode Com_stRrFog Com_stWiprActvnCdn Com_uFrntBlowrU Com_uMICUTxBlowrU ElecLd_iSensLd ElecLd_stSRCChk FanCtl_stStg SyC_ctPostDrvLeave /end IN_MEASUREMENT
 /begin OUT_MEASUREMENT ElecLd_iAirCmpr ElecLd_iBlowrFanAC ElecLd_iEPSLd ElecLd_iEPSLoadOnly ElecLd_iFan ElecLd_iFrntDeicer ElecLd_iFrntFog ElecLd_iLd ElecLd_iLd1 ElecLd_iLd2 ElecLd_iLiSwt ElecLd_iLoadMdlUnFild ElecLd_iReDeFoggerAutoAC ElecLd_iReDeFoggerManAC ElecLd_iReFog ElecLd_iWipr ElecLd_stHdLiInfo ElecLd_swtCurrMdl /end OUT_MEASUREMENT
 /begin LOC_MEASUREMENT ElecLd_cntrReIni ElecLd_iFild1EPSLoad ElecLd_iFildElecLoad ElecLd_iFildEPSLoad ElecLd_iUnfildLoad ElecLd_stAutoAC ElecLd_uHeatrMot /end LOC_MEASUREMENT
 FUNCTION_VERSION "3.0.0" /end FUNCTION
/begin FUNCTION EngDa_PwrEng "2.10.0    Engine power calculation"
 /begin DEF_CHARACTERISTIC EngDa_pwrCrksftMax_C EngDa_tqCrksftMax_C EngDa_tqInnrMax_C EngDa_volDispl_C /end DEF_CHARACTERISTIC
 /begin OUT_MEASUREMENT EngDa_pwrCrksftMax EngDa_pwrCrksftMax_f EngDa_tqCrksftMax EngDa_tqCrksftMax_f EngDa_tqInnrMax EngDa_tqInnrMax_f EngDa_volDispl EngDa_volDispl_f /end OUT_MEASUREMENT
 FUNCTION_VERSION "2.10.0" /end FUNCTION
/begin FUNCTION EngDem_TrqLimCoord "2.37.0_2.2.0Coordination of the limiting torques of engine demands"
 /begin DEF_CHARACTERISTIC EngDem_dTqSlpLimnNeg_T EngDem_dTqSlpLimnPos_T EngDem_flgFcoEna_C EngDem_nrRampSlpCfg_T EngDem_swtTqLimnCfg_C EngDem_swtTqLimnRmpReIni_C EngDem_tiRampIniRst_C EngDem_tqLimnCamsftErr_T EngDem_tqLimnOilPmp_T EngDem_tqLimnThmstHeatCtrlCirc_T EngDem_trqLimErrAPP_CUR /end DEF_CHARACTERISTIC
 /begin IN_MEASUREMENT CoVeh_trqAcs EngPrt_trqLim EngPrt_trqLimLead EngPrt_trqLimMech EngPrt_trqLimMechLead EngReq_trqLim EngReq_trqLimLead Epm_nEng PthLead_trqInrLead RngMod_trqCrSMin SpdGov_tqCluLimnMeclFco ThrVlv_bSngSensErr_msg /end IN_MEASUREMENT
 /begin OUT_MEASUREMENT EngDem_stLimErr EngDem_trqInrLim EngDem_trqInrLimCtOff EngDem_trqInrLimLead EngDem_trqLimErr /end OUT_MEASUREMENT
 /begin LOC_MEASUREMENT EngDem_dTqSlpLimnNeg EngDem_dTqSlpLimnPos EngDem_flgRampIni EngDem_flgRampLeadReInit EngDem_flgRampTgtRea EngDem_flgTqLimnErr EngDem_RampTgHldFF_I.status EngDem_ReInitCurrTqLeadERNM_I.oldSignal EngDem_ReInitErrTqLeadERNM_I.oldSignal EngDem_stLimErrMn EngDem_TqLimnLeadRMP_I.Dir EngDem_TqLimnLeadRMP_I.State EngDem_TqLimnLeadRMP_I.Target EngDem_tqLimnRampLead EngDem_trqLimLeadRslt /end LOC_MEASUREMENT
 FUNCTION_VERSION "2.37.0_2.2.0" /end FUNCTION
/begin FUNCTION EngECU_Eng1 "32.2.0_6SAAThe function prepares and sends the CAN messages Motor_1 (ENG1)" /begin OUT_MEASUREMENT Com_ctCRingENG1 Com_numCsumENG1 /end OUT_MEASUREMENT FUNCTION_VERSION "32.2.0_6SAA" /end FUNCTION
/begin FUNCTION EngECU_Eng10 "9.2.0_6SAATransmission process for the CAN frame Engine 10" /begin IN_MEASUREMENT PEnv_pRaw /end IN_MEASUREMENT /begin OUT_MEASUREMENT Com_ctCRingENG10 Com_numCsumENG10 Com_pEnvPRaw /end OUT_MEASUREMENT FUNCTION_VERSION "9.2.0_6SAA" /end FUNCTION
/begin FUNCTION EngECU_Eng11 "15.3.0_6SAATransmission process for the CAN frame Engine 11" /begin IN_MEASUREMENT APP_uRaw1unLim CoEng_tiNormalOBD /end IN_MEASUREMENT /begin OUT_MEASUREMENT Com_ctCRingENG11 Com_numCsumENG11 /end OUT_MEASUREMENT FUNCTION_VERSION "15.3.0_6SAA" /end FUNCTION
/begin FUNCTION EngECU_Eng15 "12.2.0_6SAATransmission process for the CAN frame Engine 15"
 /begin DEF_CHARACTERISTIC Com_rThrVlvActAdj_C Com_stIdleNeutMsk_C Com_swtTqRvsnEnaFlg_C Com_tiHACCut_C /end DEF_CHARACTERISTIC
 /begin IN_MEASUREMENT AccPed_swtDrvMod ACCtl_flgACCutPrms ACCtl_flgACOnCdnTCU ACCtl_nrACCutPrms AirSys_rPhiThrVlv HLSDem_nSetPLo TCE_flgCylIndFcoStrtd TCE_flgFcoRdy TCE_tiExptFcoStrt ThrVlv_dRatPrVB1 VMD_rVirtAPP /end IN_MEASUREMENT
 /begin OUT_MEASUREMENT Com_ctCRingENG15 Com_flgACReq Com_flgCylIndFcoStrtd Com_flgFcoRdy Com_flgVirtApp Com_nrCsumENG15 Com_nSetPLo Com_rThrVlvAct Com_stTqRvsnEnaFlg Com_swtDrvMod Com_tiExptFcoStrt Com_tiHACCut /end OUT_MEASUREMENT
 FUNCTION_VERSION "12.2.0_6SAA" /end FUNCTION
/begin FUNCTION EngECU_Eng16 "8.1.0_6SAATransmission process for the CAN frame Engine 16" /begin DEF_CHARACTERISTIC Com_nEngHi_C Com_nEngLo_C Com_swtNEng_C /end DEF_CHARACTERISTIC /begin IN_MEASUREMENT Epm_nEng Epm_nEng10ms /end IN_MEASUREMENT
 /begin OUT_MEASUREMENT Com_ctCRingENG16 Com_nEngSpd Com_numCsumENG16 Com_stEngStop Com_stTrqAccuracySlow Com_stTrqReqFast Com_stTrqReqSlow /end OUT_MEASUREMENT
 FUNCTION_VERSION "8.1.0_6SAA" /end FUNCTION
/begin FUNCTION EngECU_Eng17 "9.1.0_6SAATransmission process for the CAN frame Engine 17" /begin IN_MEASUREMENT PIntkVUs_p /end IN_MEASUREMENT
 /begin OUT_MEASUREMENT Com_ctCRingENG17 Com_numCsumENG17 Com_stAltFail Com_stEngCooltTFail Com_stEngIntkAirFail Com_stEngSpd30DegFail Com_stPBSensFail Com_stThrPosnFail /end OUT_MEASUREMENT
 FUNCTION_VERSION "9.1.0_6SAA" /end FUNCTION
/begin FUNCTION EngECU_Eng18 "7.1.0_6SAATransmission process for the CAN frame Engine 18" /begin IN_MEASUREMENT CoVOM_bCVTIdleStop CoVOM_bCVTStopEna /end IN_MEASUREMENT
 /begin OUT_MEASUREMENT Com_bCVTIdleStop Com_bCVTStopEna Com_ctCRingENG18 Com_numCsumENG18 /end OUT_MEASUREMENT
 FUNCTION_VERSION "7.1.0_6SAA" /end FUNCTION
/begin FUNCTION EngECU_Eng19 "5.3.0_6SAATransmission process for the CAN frame Engine 19"
 /begin IN_MEASUREMENT Com_stSrvModDispReq I14229_stABSFailCnclActv SysDiag_flgCModJdg /end IN_MEASUREMENT
 /begin OUT_MEASUREMENT Com_ctCRingENG19 Com_numCsumENG19 /end OUT_MEASUREMENT
 FUNCTION_VERSION "5.3.0_6SAA" /end FUNCTION
/begin FUNCTION EngECU_Eng2 "30.2.0_6SAAThe function prepares and sends the CAN messages Motor_2 (ENG2)" /begin OUT_MEASUREMENT Com_ctCRingENG2 Com_numCsumENG2 /end OUT_MEASUREMENT FUNCTION_VERSION "30.2.0_6SAA" /end FUNCTION
/begin FUNCTION EngECU_Eng20 "6.1.0_6SAATransmission process for the CAN frame Engine 20" /begin IN_MEASUREMENT ACEvpT_tAvg /end IN_MEASUREMENT /begin OUT_MEASUREMENT Com_ctCRingENG20 Com_numCsumENG20 /end OUT_MEASUREMENT FUNCTION_VERSION "6.1.0_6SAA" /end FUNCTION
/begin FUNCTION EngECU_Eng21 "8.7.0_6SAATransmission process for the CAN frame Engine 21"
 /begin DEF_CHARACTERISTIC Com_dENG21SigSel_C Com_stSwtMinTqAllwd_C Com_SwtMaxTqAllwd_C Com_tiIDASInhbDly_C /end DEF_CHARACTERISTIC
 /begin IN_MEASUREMENT CoEng_st Com_rTrqCnvBoost Com_stADSSpdLim Com_stFrmTxEna CoVeh_trqAcs CoVeh_trqDesComp CoVMD_flgIDASFailDetn CoVMD_tqMaxAllwdIDAS CoVMD_tqMinAllwdIDAS CrCtl_stIDASExsJdg CrCtl_stIDASTqModFailr DFES_stErrLamp PT_rTrq PT_stTraType PT_trqLos PT_trqWhlMaxEng PT_trqWhlMinWoCtOff RngMod_trqCrSMinWoCtOff SpdGov_trqLead T15_st VehMot_rTrqDfftl /end IN_MEASUREMENT
 /begin OUT_MEASUREMENT Com_ctCRingENG21 Com_numCsumENG21 Com_stIDASEngFail Com_stIDASInhb Com_tqMaxIDAS Com_tqMinIDAS /end OUT_MEASUREMENT
 /begin LOC_MEASUREMENT Com_stIDASEngFailOld Com_stT15Eng21 /end LOC_MEASUREMENT
 FUNCTION_VERSION "8.7.0_6SAA" /end FUNCTION
/begin FUNCTION EngECU_Eng22 "6.1.0_6SAATransmission process for the CAN frame Engine 22" /begin OUT_MEASUREMENT Com_ctCRingENG22 Com_numCsumENG22 /end OUT_MEASUREMENT FUNCTION_VERSION "6.1.0_6SAA" /end FUNCTION
/begin FUNCTION EngECU_Eng23 "3.1.0_6SAATransmission process for the CAN frame Engine 23" /begin OUT_MEASUREMENT Com_ctCRingENG23 Com_numCsumENG23 /end OUT_MEASUREMENT FUNCTION_VERSION "3.1.0_6SAA" /end FUNCTION
/begin FUNCTION EngECU_Eng24 "3.1.0_6SAATransmission process for the message Engine 24" /begin IN_MEASUREMENT B_dcy CoEng_stStopEng Epm_nEng VehV_v /end IN_MEASUREMENT
 /begin OUT_MEASUREMENT Com_ctCRingENG24 Com_numCsumENG24 Com_stDcyc Com_stDtcInhbClr /end OUT_MEASUREMENT
 FUNCTION_VERSION "3.1.0_6SAA" /end FUNCTION
/begin FUNCTION EngECU_Eng25 "2.3.0_6SAATransmission process for the message Engine 25" /begin DEF_CHARACTERISTIC Com_dENG25SigSel_C /end DEF_CHARACTERISTIC /begin IN_MEASUREMENT APP_uRaw1unLim /end IN_MEASUREMENT /begin OUT_MEASUREMENT Com_ctCRingENG25 Com_numCsumENG25 Com_rAccrPedlPosn /end OUT_MEASUREMENT FUNCTION_VERSION "2.3.0_6SAA" /end FUNCTION
/begin FUNCTION EngECU_Eng3 "26.1.0_6SAAThe function prepares and sends CAN message engine 3 (ENG3)" /begin DEF_CHARACTERISTIC Com_stSwtEstmTqNormJdg_C /end DEF_CHARACTERISTIC
 /begin OUT_MEASUREMENT Com_ctCRingENG3 Com_flgValFailJdg Com_flgValNormJdg Com_numCsumENG3 Com_stEstmTqNormJdg Com_stPrmntDenomCdnJdgStop /end OUT_MEASUREMENT
 FUNCTION_VERSION "26.1.0_6SAA" /end FUNCTION
/begin FUNCTION EngECU_Eng4 "22.1.0_6SAATransmission process for the CAN frame Engine 4" /begin IN_MEASUREMENT CEngDsT_tSnsrFild CEngUsT_t /end IN_MEASUREMENT /begin OUT_MEASUREMENT Com_ctCRingENG4 Com_numCsumENG4 /end OUT_MEASUREMENT FUNCTION_VERSION "22.1.0_6SAA" /end FUNCTION
/begin FUNCTION EngECU_Eng5 "32.1.0_6SAAThe function prepares and sends CAN message engine5 (ENG5)" /begin IN_MEASUREMENT ActMod_trqInr RngMod_trqCrSMin /end IN_MEASUREMENT
 /begin OUT_MEASUREMENT Com_ctCRingENG5 Com_numCsumENG5 Com_stCmnCntCdnStart Com_tqEstimdEngCrkLvl /end OUT_MEASUREMENT
 FUNCTION_VERSION "32.1.0_6SAA" /end FUNCTION
/begin FUNCTION EngECU_Eng6 "14.1.0_6SAAThe function prepares and sends CAN message engine6 (ENG6)" /begin OUT_MEASUREMENT Com_ctCRingENG6 Com_numCsumENG6 /end OUT_MEASUREMENT FUNCTION_VERSION "14.1.0_6SAA" /end FUNCTION
/begin FUNCTION EngECU_EngA "17.2.0_1.0.0Transmission process for the CAN frame Engine A"
 /begin DEF_CHARACTERISTIC Com_stRemEngStrtMilSeln_C Com_swtMILMulDisbl_C Com_SwtMilMultiBDi_C /end DEF_CHARACTERISTIC
 /begin IN_MEASUREMENT CoEng_st Com_stATMILReq Com_stIMGMILReq CoVOM_bEngPreStrtOrd CoVOM_bSSEEngStopPassed CoVOM_bSysOff CoVOM_stSSE CrCtl_stACCAPPOn CrCtl_stActive CrCtl_stFailCond CrCtl_stLmpOn CrCtl_stManCncl ErrLmp_stMIL T15_st wdks_w /end IN_MEASUREMENT
 /begin OUT_MEASUREMENT Com_ctCRingENGA Com_numCsumENGA Com_stErrLmp Com_stISSRelsPreNotif Com_stMILMul Com_stMilMultiSerios /end OUT_MEASUREMENT
 FUNCTION_VERSION "17.2.0_1.0.0" /end FUNCTION
/begin COMPU_METHOD B_TRUE "" TAB_VERB "%6.3" "" COMPU_TAB_REF B_TRUE /end COMPU_METHOD
/begin COMPU_VTAB B_TRUE "" TAB_VERB 2 0 "FALSE" 1 "TRUE" /end COMPU_VTAB
/begin COMPU_METHOD Com_deg_q0p02441 "" RAT_FUNC "%6.4" "deg" COEFFS 0 65536 0 0 0 1600 /end COMPU_METHOD
/begin COMPU_METHOD Curr_A "" RAT_FUNC "%6.4" "A" COEFFS 0 100 0 0 0 1 /end COMPU_METHOD
/begin COMPU_METHOD dez "" RAT_FUNC "%6.2" "" COEFFS 0 1 0 0 0 1 /end COMPU_METHOD
/begin COMPU_METHOD EngN "" RAT_FUNC "%6.3" "rpm" COEFFS 0 2 0 0 0 1 /end COMPU_METHOD
/begin COMPU_METHOD EXHMOD_TEXHFLTD_SC_Compu "" TAB_VERB "%6.3" "" COMPU_TAB_REF EXHMOD_TEXHFLTD_SC_Compu /end COMPU_METHOD
/begin COMPU_VTAB EXHMOD_TEXHFLTD_SC_Compu "" TAB_VERB 2 0 "False" 1 "True" /end COMPU_VTAB
/begin COMPU_METHOD EXHMOD_TMDLBLOWR_SC_Compu "" TAB_VERB "%6.3" "" COMPU_TAB_REF EXHMOD_TMDLBLOWR_SC_Compu /end COMPU_METHOD
/begin COMPU_VTAB EXHMOD_TMDLBLOWR_SC_Compu "" TAB_VERB 2 0 "0" 1 "1" /end COMPU_VTAB
/begin COMPU_METHOD EXHMOD_TMDLCATAGICORRN_SC_Compu "" TAB_VERB "%6.3" "" COMPU_TAB_REF EXHMOD_TMDLCATAGICORRN_SC_Compu /end COMPU_METHOD
/begin COMPU_VTAB EXHMOD_TMDLCATAGICORRN_SC_Compu "" TAB_VERB 2 0 "False" 1 "True" /end COMPU_VTAB
/begin COMPU_METHOD EXHMOD_TMDLSEPCANN_SC_Compu "" TAB_VERB "%6.3" "" COMPU_TAB_REF EXHMOD_TMDLSEPCANN_SC_Compu /end COMPU_METHOD
/begin COMPU_VTAB EXHMOD_TMDLSEPCANN_SC_Compu "" TAB_VERB 3 0 "0" 1 "1" 2 "2" /end COMPU_VTAB
/begin COMPU_METHOD EXHMOD_TMDLTC_SC_Compu "" TAB_VERB "%6.3" "" COMPU_TAB_REF EXHMOD_TMDLTC_SC_Compu /end COMPU_METHOD
/begin COMPU_VTAB EXHMOD_TMDLTC_SC_Compu "" TAB_VERB 3 0 "0" 1 "1" 2 "2" /end COMPU_VTAB
/begin COMPU_METHOD EXHMOD_TMDLTSNSRCMPTMT_SC_Compu "" TAB_VERB "%6.3" "" COMPU_TAB_REF EXHMOD_TMDLTSNSRCMPTMT_SC_Compu /end COMPU_METHOD
/begin COMPU_VTAB EXHMOD_TMDLTSNSRCMPTMT_SC_Compu "" TAB_VERB 2 0 "False" 1 "True" /end COMPU_VTAB
/begin COMPU_METHOD EXHMOD_TMDLVAIRCMPTMT_SC_Compu "" TAB_VERB "%6.3" "" COMPU_TAB_REF EXHMOD_TMDLVAIRCMPTMT_SC_Compu /end COMPU_METHOD
/begin COMPU_VTAB EXHMOD_TMDLVAIRCMPTMT_SC_Compu "" TAB_VERB 2 0 "False" 1 "True" /end COMPU_VTAB
/begin COMPU_METHOD EXHMOD_TPISTMDL_SC_Compu "" TAB_VERB "%6.3" "" COMPU_TAB_REF EXHMOD_TPISTMDL_SC_Compu /end COMPU_METHOD
/begin COMPU_VTAB EXHMOD_TPISTMDL_SC_Compu "" TAB_VERB 2 0 "No_piston_model" 1 "Piston_model" /end COMPU_VTAB
/begin COMPU_METHOD EXHMOD_TSPS1_SC_Compu "" TAB_VERB "%6.3" "" COMPU_TAB_REF EXHMOD_TSPS1_SC_Compu /end COMPU_METHOD
/begin COMPU_VTAB EXHMOD_TSPS1_SC_Compu "" TAB_VERB 2 0 "False" 1 "True" /end COMPU_VTAB
/begin COMPU_METHOD EXHMOD_TSPS2_SC_Compu "" TAB_VERB "%6.3" "" COMPU_TAB_REF EXHMOD_TSPS2_SC_Compu /end COMPU_METHOD
/begin COMPU_VTAB EXHMOD_TSPS2_SC_Compu "" TAB_VERB 2 0 "False" 1 "True" /end COMPU_VTAB
/begin COMPU_METHOD EXHMOD_TSPS3_SC_Compu "" TAB_VERB "%6.3" "" COMPU_TAB_REF EXHMOD_TSPS3_SC_Compu /end COMPU_METHOD
/begin COMPU_VTAB EXHMOD_TSPS3_SC_Compu "" TAB_VERB 2 0 "False" 1 "True" /end COMPU_VTAB
/begin COMPU_METHOD EXHMOD_TTHDLIOFFVBL_SC_Compu "" TAB_VERB "%6.3" "" COMPU_TAB_REF EXHMOD_TTHDLIOFFVBL_SC_Compu /end COMPU_METHOD
/begin COMPU_VTAB EXHMOD_TTHDLIOFFVBL_SC_Compu "" TAB_VERB 2 0 "DISABLE" 1 "ENABLE" /end COMPU_VTAB
/begin COMPU_METHOD EXHMOD_TVLVCORRNFCOMFLOW_SC_Compu "" TAB_VERB "%6.3" "" COMPU_TAB_REF EXHMOD_TVLVCORRNFCOMFLOW_SC_Compu /end COMPU_METHOD
/begin COMPU_VTAB EXHMOD_TVLVCORRNFCOMFLOW_SC_Compu "" TAB_VERB 2 0 "False" 1 "True" /end COMPU_VTAB
/begin COMPU_METHOD EXHMOD_TVLVCORRNOFFS_SC_Compu "" TAB_VERB "%6.3" "" COMPU_TAB_REF EXHMOD_TVLVCORRNOFFS_SC_Compu /end COMPU_METHOD
/begin COMPU_VTAB EXHMOD_TVLVCORRNOFFS_SC_Compu "" TAB_VERB 2 0 "False" 1 "True" /end COMPU_VTAB
/begin COMPU_METHOD EXHMOD_TVLVDYN_SC_Compu "" TAB_VERB "%6.3" "" COMPU_TAB_REF EXHMOD_TVLVDYN_SC_Compu /end COMPU_METHOD
/begin COMPU_VTAB EXHMOD_TVLVDYN_SC_Compu "" TAB_VERB 3 0 "use_feature_conventional_model(low_pass)" 1 "use_feature_bridge_model" 2 "Conventional_or_bridge_model_can_be_chosen_via_CW" /end COMPU_VTAB
/begin COMPU_METHOD EXHMOD_VAR_SY_Compu "" TAB_VERB "%6.3" "" COMPU_TAB_REF EXHMOD_VAR_SY_Compu /end COMPU_METHOD
/begin COMPU_VTAB EXHMOD_VAR_SY_Compu "" TAB_VERB 48 1 "DAI" 3 "VWW" 4 "POR" 5 "AUD" 6 "OPE" 9 "FIA" 11 "BMW" 14 "PSA" 15 "REN" 17 "ALF" 18 "SAB" 19 "VOL" 20 "NIS" 21 "GMU" 22 "FOR" 26 "IMJ" 51 "SEA" 53 "CHR" 54 "JAG" 55 "ROL" 69 "FER" 72 "TOY" 123 "MIT" 147 "HYU" 159 "HON" 160 "MAZ" 183 "CU" 190 "LRG" 204 "VVW" 214 "AVT" 242 "Iveco" 243 "DMC" 248 "SUZ" 270 "KEF" 289 "AMG" 308 "TAT" 319 "MVM" 328 "MM" 385 "UAES" 590 "Scania" 828 "RBCD" 898 "MFTBC" 944 "DOOSAN" 984 "FAW" 999 "ALL" 2887 "Nonox" 9454 "Fuso" 9707 "HATZ" /end COMPU_VTAB
/begin COMPU_METHOD EXHMOD_WTRCOOLGMNFLD_SC_Compu "" TAB_VERB "%6.3" "" COMPU_TAB_REF EXHMOD_WTRCOOLGMNFLD_SC_Compu /end COMPU_METHOD
/begin COMPU_VTAB EXHMOD_WTRCOOLGMNFLD_SC_Compu "" TAB_VERB 2 0 "False" 1 "True" /end COMPU_VTAB
/begin COMPU_METHOD EXHMOD_WTRMDL_SC_Compu "" TAB_VERB "%6.3" "" COMPU_TAB_REF EXHMOD_WTRMDL_SC_Compu /end COMPU_METHOD
/begin COMPU_VTAB EXHMOD_WTRMDL_SC_Compu "" TAB_VERB 2 0 "No_water_model" 1 "Water_model" /end COMPU_VTAB
/begin COMPU_METHOD EXHPPFLT_TYPAVL_SY_Compu "" TAB_VERB "%6.3" "" COMPU_TAB_REF EXHPPFLT_TYPAVL_SY_Compu /end COMPU_METHOD
/begin COMPU_VTAB EXHPPFLT_TYPAVL_SY_Compu "" TAB_VERB 2 0 "False" 1 "True" /end COMPU_VTAB
/begin COMPU_METHOD EXHTEMP_CT_SENSORS_Compu "" TAB_VERB "%6.3" "" COMPU_TAB_REF EXHTEMP_CT_SENSORS_Compu /end COMPU_METHOD
/begin COMPU_VTAB EXHTEMP_CT_SENSORS_Compu "" TAB_VERB 13 1 "ONE" 8 "EIGHT" 9 "NINE" 10 "TEN" 11 "ELEVEN" 12 "TWELVE" 13 "THIRTEEN" 15 "FIFTEEN" 16 "SIXTEEN" 20 "TWENTY" 21 "TWENTY_ONE" 28 "TWENTYEIGHT" 30 "THIRTY" /end COMPU_VTAB
/begin COMPU_METHOD EXHVLV_AIRACTR_SC_Compu "" TAB_VERB "%6.3" "" COMPU_TAB_REF EXHVLV_AIRACTR_SC_Compu /end COMPU_METHOD
/begin COMPU_VTAB EXHVLV_AIRACTR_SC_Compu "" TAB_VERB 2 0 "False" 1 "True" /end COMPU_VTAB
/begin COMPU_METHOD EXH_SWTSENSPRSTPFLTDS_SY_Compu "" TAB_VERB "%6.3" "" COMPU_TAB_REF EXH_SWTSENSPRSTPFLTDS_SY_Compu /end COMPU_METHOD
/begin COMPU_VTAB EXH_SWTSENSPRSTPFLTDS_SY_Compu "" TAB_VERB 3 0 "0" 1 "1" 2 "2" /end COMPU_VTAB
/begin COMPU_METHOD EXH_SWTSENSPRSTPFLTUS_SY_Compu "" TAB_VERB "%6.3" "" COMPU_TAB_REF EXH_SWTSENSPRSTPFLTUS_SY_Compu /end COMPU_METHOD
/begin COMPU_VTAB EXH_SWTSENSPRSTPFLTUS_SY_Compu "" TAB_VERB 2 0 "FALSE" 1 "TRUE" /end COMPU_VTAB
/begin COMPU_METHOD EXTDTCOORR_SC_Compu "" TAB_VERB "%6.3" "" COMPU_TAB_REF EXTDTCOORR_SC_Compu /end COMPU_METHOD
/begin COMPU_VTAB EXTDTCOORR_SC_Compu "" TAB_VERB 2 0 "False" 1 "True" /end COMPU_VTAB
/begin COMPU_METHOD EXTENGSTRT_SY_Compu "" TAB_VERB "%6.3" "" COMPU_TAB_REF EXTENGSTRT_SY_Compu /end COMPU_METHOD
/begin COMPU_VTAB EXTENGSTRT_SY_Compu "" TAB_VERB 2 0 "0" 1 "1" /end COMPU_VTAB
/begin COMPU_METHOD FacReactVel_COMPU "" RAT_FUNC "%6.2" "mol/s/m" COEFFS 0 1 0 0 0 1 /end COMPU_METHOD
/begin COMPU_METHOD FacReactVel_q100p0_COMPU "" RAT_FUNC "%6.0" "mol/s/m" COEFFS 0 0.01 0 0 0 1 /end COMPU_METHOD
/begin COMPU_METHOD Fact "" RAT_FUNC "%6.5" "-" COEFFS 0 8192 0 0 0 1 /end COMPU_METHOD
/begin COMPU_METHOD Fact10 "" RAT_FUNC "%13.12" "-" COEFFS 0 10000000000 0 0 0 1 /end COMPU_METHOD
/begin COMPU_METHOD Fact16384_COMPU "" RAT_FUNC "%7.6" "%/hPa" COEFFS 0 16384 0 0 0 1 /end COMPU_METHOD
/begin COMPU_METHOD Fact255_COMPU "" RAT_FUNC "%6.4" "-" COEFFS 0 255 0 0 0 1 /end COMPU_METHOD
/begin COMPU_METHOD Fact256 "" RAT_FUNC "%6.4" "-" COEFFS 0 256 0 0 0 1 /end COMPU_METHOD
/begin COMPU_METHOD Fact5 "" RAT_FUNC "%6.3" "-" COEFFS 0 2 0 0 0 1 /end COMPU_METHOD
/begin COMPU_METHOD Fact6 "" RAT_FUNC "%6.4" "-" COEFFS 0 500 0 0 0 1 /end COMPU_METHOD
/begin COMPU_METHOD Fact7 "" RAT_FUNC "%10.9" "-" COEFFS 0 10000000 0 0 0 1 /end COMPU_METHOD
/begin COMPU_METHOD Fact8 "" RAT_FUNC "%11.10" "-" COEFFS 0 100000000 0 0 0 1 /end COMPU_METHOD
/begin COMPU_METHOD Fact9 "" RAT_FUNC "%6.5" "-" COEFFS 0 5000 0 0 0 1 /end COMPU_METHOD
/begin COMPU_METHOD FactFine "" RAT_FUNC "%9.8" "-" COEFFS 0 1000000 0 0 0 1 /end COMPU_METHOD
/begin COMPU_METHOD FactLow1 "" RAT_FUNC "%6.4" "-" COEFFS 0 25 0 0 0 1 /end COMPU_METHOD
/begin COMPU_METHOD FactRev "" RAT_FUNC "%6.3" "-" COEFFS 0 10 0 0 0 1 /end COMPU_METHOD
/begin COMPU_METHOD Fact_100000 "" RAT_FUNC "%8.7" "-" COEFFS 0 100000 0 0 0 1 /end COMPU_METHOD
/begin COMPU_METHOD Fact_EGT "" RAT_FUNC "%6.5" "-" COEFFS 0 1000 0 0 0 1 /end COMPU_METHOD
/begin COMPU_METHOD Fact_NSC "" RAT_FUNC "%6.5" "-" COEFFS 0 1000 0 0 0 1 /end COMPU_METHOD
/begin COMPU_METHOD Fact_NSCEff "" RAT_FUNC "%7.6" "-" COEFFS 0 10000 0 0 0 1 /end COMPU_METHOD
/begin COMPU_METHOD Fact_q0p001 "" RAT_FUNC "%6.5" "-" COEFFS 0 1000 0 0 0 1 /end COMPU_METHOD
/begin COMPU_METHOD Fact_q6554p0_COMPU "" RAT_FUNC "%7.0" "-" COEFFS 0 0.000152578577967653 0 0 0 1 /end COMPU_METHOD
/begin COMPU_METHOD Fact_SOx1 "" RAT_FUNC "%9.8" "-" COEFFS 0 1000000 0 0 0 1 /end COMPU_METHOD
/begin COMPU_METHOD Fact_VolNSC "" RAT_FUNC "%9.8" "-" COEFFS 0 1000000 0 0 0 1 /end COMPU_METHOD
/begin COMPU_METHOD Fac_q0p0001_COMPU "" RAT_FUNC "%7.6" "-" COEFFS 0 10000 0 0 0 1 /end COMPU_METHOD
/begin COMPU_METHOD FAILSTRTDETN_SC_Compu "" TAB_VERB "%6.3" "" COMPU_TAB_REF FAILSTRTDETN_SC_Compu /end COMPU_METHOD
/begin COMPU_VTAB FAILSTRTDETN_SC_Compu "" TAB_VERB 2 0 "False" 1 "True" /end COMPU_VTAB
/begin COMPU_METHOD fak_ub_b1 "" RAT_FUNC "%6.4" "-" COEFFS 0 256 0 0 0 1 /end COMPU_METHOD
/begin COMPU_METHOD fak_uw_b16 "" RAT_FUNC "%6.5" "-" COEFFS 0 65536 0 0 0 16 /end COMPU_METHOD
/begin COMPU_METHOD fak_uw_b4 "" RAT_FUNC "%7.6" "-" COEFFS 0 65536 0 0 0 4 /end COMPU_METHOD
/begin COMPU_METHOD FAN1_TYPAVLDELIBSTDACTR_SY_Compu "" TAB_VERB "%6.3" "" COMPU_TAB_REF FAN1_TYPAVLDELIBSTDACTR_SY_Compu /end COMPU_METHOD
/begin COMPU_VTAB FAN1_TYPAVLDELIBSTDACTR_SY_Compu "" TAB_VERB 2 0 "FALSE" 1 "TRUE" /end COMPU_VTAB
/begin COMPU_METHOD FANCTL_SPD_SY_Compu "" TAB_VERB "%6.3" "" COMPU_TAB_REF FANCTL_SPD_SY_Compu /end COMPU_METHOD
/begin COMPU_VTAB FANCTL_SPD_SY_Compu "" TAB_VERB 2 0 "FANCTL_SPD_DISBL" 1 "FANCTL_SPD_ENBL" /end COMPU_VTAB
/begin COMPU_METHOD FAN_ATSINTVMOD_SY_Compu "" RAT_FUNC "%6.2" "" COEFFS 0 1 0 0 0 1 /end COMPU_METHOD
/begin COMPU_METHOD FAN_CODAVL_SY_Compu "" TAB_VERB "%6.3" "" COMPU_TAB_REF FAN_CODAVL_SY_Compu /end COMPU_METHOD
/begin COMPU_VTAB FAN_CODAVL_SY_Compu "" TAB_VERB 2 0 "False" 1 "True" /end COMPU_VTAB
/begin COMPU_METHOD FAN_NUMDIGOUT_SY_Compu "" RAT_FUNC "%6.2" "" COEFFS 0 1 0 0 0 1 /end COMPU_METHOD
/begin COMPU_METHOD FAN_NUMPWMOUT_SY_Compu "" RAT_FUNC "%6.2" "" COEFFS 0 1 0 0 0 1 /end COMPU_METHOD
/begin COMPU_METHOD FCOCDNABSFAIL_SC_Compu "" TAB_VERB "%6.3" "" COMPU_TAB_REF FCOCDNABSFAIL_SC_Compu /end COMPU_METHOD
/begin COMPU_VTAB FCOCDNABSFAIL_SC_Compu "" TAB_VERB 2 0 "FALSE" 1 "TRUE" /end COMPU_VTAB
/begin COMPU_METHOD FCOCMF_SY_Compu "" TAB_VERB "%6.3" "" COMPU_TAB_REF FCOCMF_SY_Compu /end COMPU_METHOD
/begin COMPU_VTAB FCOCMF_SY_Compu "" TAB_VERB 4 0 "0" 1 "1" 2 "2" 3 "3" /end COMPU_VTAB
/begin COMPU_METHOD FCONTHRES_SY_Compu "" TAB_VERB "%6.3" "" COMPU_TAB_REF FCONTHRES_SY_Compu /end COMPU_METHOD
/begin COMPU_VTAB FCONTHRES_SY_Compu "" TAB_VERB 2 0 "0" 1 "1" /end COMPU_VTAB
/begin COMPU_METHOD FCOREQ_INHOUSE_SC_Compu "" TAB_VERB "%6.3" "" COMPU_TAB_REF FCOREQ_INHOUSE_SC_Compu /end COMPU_METHOD
/begin COMPU_VTAB FCOREQ_INHOUSE_SC_Compu "" TAB_VERB 2 0 "False" 1 "True" /end COMPU_VTAB
/begin COMPU_METHOD FEA_ETS_MSG_Compu "" TAB_VERB "%6.3" "" COMPU_TAB_REF FEA_ETS_MSG_Compu /end COMPU_METHOD
/begin COMPU_VTAB FEA_ETS_MSG_Compu "" TAB_VERB 2 0 "False" 1 "True" /end COMPU_VTAB
/begin COMPU_METHOD FEA_SY_MX17_Compu "" TAB_VERB "%6.3" "" COMPU_TAB_REF FEA_SY_MX17_Compu /end COMPU_METHOD
/begin COMPU_VTAB FEA_SY_MX17_Compu "" TAB_VERB 2 0 "ECU:not ME(D)17" 1 "ECU: ME(D)17" /end COMPU_VTAB
/begin COMPU_METHOD FEBFNST_SC_Compu "" TAB_VERB "%6.3" "" COMPU_TAB_REF FEBFNST_SC_Compu /end COMPU_METHOD
/begin COMPU_VTAB FEBFNST_SC_Compu "" TAB_VERB 2 0 "False" 1 "True" /end COMPU_VTAB
/begin COMPU_METHOD FFVE100_SC_Compu "" TAB_VERB "%6.3" "" COMPU_TAB_REF FFVE100_SC_Compu /end COMPU_METHOD
/begin COMPU_VTAB FFVE100_SC_Compu "" TAB_VERB 2 0 "False" 1 "True" /end COMPU_VTAB
/begin COMPU_METHOD FFV_SY_Compu "" TAB_VERB "%6.3" "" COMPU_TAB_REF FFV_SY_Compu /end COMPU_METHOD
/begin COMPU_VTAB FFV_SY_Compu "" TAB_VERB 2 0 "False" 1 "True" /end COMPU_VTAB
/begin COMPU_METHOD FILININENDINTV_SC_Compu "" TAB_VERB "%6.3" "" COMPU_TAB_REF FILININENDINTV_SC_Compu /end COMPU_METHOD
/begin COMPU_VTAB FILININENDINTV_SC_Compu "" TAB_VERB 2 0 "False" 1 "True" /end COMPU_VTAB
/begin COMPU_METHOD FILLGDETRMTWNFLOW_SC_Compu "" TAB_VERB "%6.3" "" COMPU_TAB_REF FILLGDETRMTWNFLOW_SC_Compu /end COMPU_METHOD
/begin COMPU_VTAB FILLGDETRMTWNFLOW_SC_Compu "" TAB_VERB 2 0 "False" 1 "True" /end COMPU_VTAB
/begin COMPU_METHOD FlConsum_l "" RAT_FUNC "%6.5" "l" COEFFS 0 1000 0 0 0 1 /end COMPU_METHOD
/begin COMPU_METHOD FlConsum_l_s "" RAT_FUNC "%8.7" "l/s" COEFFS 0 360000 0 0 0 1 /end COMPU_METHOD
/begin COMPU_METHOD FlConsum_ul "" RAT_FUNC "%6.2" "ul" COEFFS 0 1 0 0 0 1 /end COMPU_METHOD
/begin COMPU_METHOD FlConsum_ul_1 "" RAT_FUNC "%6.5" "ul" COEFFS 0 1000 0 0 0 1 /end COMPU_METHOD
/begin COMPU_METHOD FlConsum_ul_High_COMPU "" RAT_FUNC "%6.1" "ul" COEFFS 0 0.05 0 0 0 1 /end COMPU_METHOD
/begin COMPU_METHOD FlCons_lps_q0p0001 "" RAT_FUNC "%7.6" "l/s" COEFFS 0 10000 0 0 0 1 /end COMPU_METHOD
/begin COMPU_METHOD FLEXPSCTRLRNR_SC_Compu "" TAB_VERB "%6.3" "" COMPU_TAB_REF FLEXPSCTRLRNR_SC_Compu /end COMPU_METHOD
/begin COMPU_VTAB FLEXPSCTRLRNR_SC_Compu "" TAB_VERB 2 0 "0" 1 "1" /end COMPU_VTAB
/begin COMPU_METHOD FLFLTDSP_TYPAVL_SC_Compu "" TAB_VERB "%6.3" "" COMPU_TAB_REF FLFLTDSP_TYPAVL_SC_Compu /end COMPU_METHOD
/begin COMPU_VTAB FLFLTDSP_TYPAVL_SC_Compu "" TAB_VERB 2 0 "False" 1 "True" /end COMPU_VTAB
/begin COMPU_METHOD FLMA_BASCONLY_SC_Compu "" TAB_VERB "%6.3" "" COMPU_TAB_REF FLMA_BASCONLY_SC_Compu /end COMPU_METHOD
/begin COMPU_VTAB FLMA_BASCONLY_SC_Compu "" TAB_VERB 2 0 "False" 1 "True" /end COMPU_VTAB
/begin COMPU_METHOD FLMA_LEASTSQ_SC_Compu "" TAB_VERB "%6.3" "" COMPU_TAB_REF FLMA_LEASTSQ_SC_Compu /end COMPU_METHOD
/begin COMPU_VTAB FLMA_LEASTSQ_SC_Compu "" TAB_VERB 2 0 "NO_SQFIT" 1 "SQFIT_ADPN" /end COMPU_VTAB
/begin COMPU_METHOD FLMA_OPERMODDPDTSUMERR_SC_Compu "" TAB_VERB "%6.3" "" COMPU_TAB_REF FLMA_OPERMODDPDTSUMERR_SC_Compu /end COMPU_METHOD
/begin COMPU_VTAB FLMA_OPERMODDPDTSUMERR_SC_Compu "" TAB_VERB 2 0 "False" 1 "True" /end COMPU_VTAB
/begin COMPU_METHOD FLMA_TTCLDIAG_SC_Compu "" TAB_VERB "%6.3" "" COMPU_TAB_REF FLMA_TTCLDIAG_SC_Compu /end COMPU_METHOD
/begin COMPU_VTAB FLMA_TTCLDIAG_SC_Compu "" TAB_VERB 2 0 "No_TTCL_Diag" 1 "TTCL_Diag" /end COMPU_VTAB
/begin COMPU_METHOD FLMA_VAR_SY_Compu "" TAB_VERB "%6.3" "" COMPU_TAB_REF FLMA_VAR_SY_Compu /end COMPU_METHOD
/begin COMPU_VTAB FLMA_VAR_SY_Compu "" TAB_VERB 44 1 "DAI" 3 "VWW" 4 "POR" 5 "AUD" 6 "OPE" 9 "FIA" 11 "BMW" 14 "PSA" 15 "REN" 17 "ALF" 18 "SAB" 19 "VOL" 20 "NIS" 21 "GMU" 22 "FOR" 26 "IMJ" 38 "UAES" 51 "SEA" 53 "CHR" 54 "JAG" 55 "ROL" 69 "FER" 72 "TOY" 123 "MIT" 147 "HYU" 159 "HON" 160 "MAZ" 183 "CU" 190 "LRG" 204 "VVW" 214 "AVT" 242 "Iveco" 243 "DMC" 248 "SUZ" 267 "SSANGYONG" 270 "KEF" 289 "AMG" 308 "TAT" 319 "MVM" 590 "Scania" 828 "RBCD" 999 "ALL" 2887 "Nonox" 9454 "Fuso" /end COMPU_VTAB
/begin COMPU_METHOD FLOATIFRESLSELN_SC_Compu "" TAB_VERB "%6.3" "" COMPU_TAB_REF FLOATIFRESLSELN_SC_Compu /end COMPU_METHOD
/begin COMPU_VTAB FLOATIFRESLSELN_SC_Compu "" TAB_VERB 2 0 "Integer_calculation" 1 "Floating_point_calculation" /end COMPU_VTAB
/begin COMPU_METHOD FLSPLG_FUTMDLSELNCUST_SC_Compu "" TAB_VERB "%6.3" "" COMPU_TAB_REF FLSPLG_FUTMDLSELNCUST_SC_Compu /end COMPU_METHOD
/begin COMPU_VTAB FLSPLG_FUTMDLSELNCUST_SC_Compu "" TAB_VERB 2 0 "False" 1 "True" /end COMPU_VTAB
/begin COMPU_METHOD FLSPLG_SENTENA_SC_Compu "" TAB_VERB "%6.3" "" COMPU_TAB_REF FLSPLG_SENTENA_SC_Compu /end COMPU_METHOD
/begin COMPU_VTAB FLSPLG_SENTENA_SC_Compu "" TAB_VERB 2 0 "False" 1 "True" /end COMPU_VTAB
/begin COMPU_METHOD FLSPLG_VAR_SY_Compu "" TAB_VERB "%6.3" "" COMPU_TAB_REF FLSPLG_VAR_SY_Compu /end COMPU_METHOD
/begin COMPU_VTAB FLSPLG_VAR_SY_Compu "" TAB_VERB 42 1 "DAI" 3 "VWW" 4 "POR" 5 "AUD" 6 "OPE" 9 "FIA" 11 "BMW" 14 "PSA" 15 "REN" 17 "ALF" 18 "SAB" 19 "VOL" 20 "NIS" 21 "GMU" 22 "FOR" 26 "IMJ" 51 "SEA" 53 "CHR" 54 "JAG" 55 "ROL" 69 "FER" 72 "TOY" 123 "MIT" 147 "HYU" 159 "HON" 160 "MAZ" 183 "CU" 190 "LRG" 204 "VVW" 214 "AVT" 242 "Iveco" 243 "DMC" 248 "SUZ" 267 "SSANGYONG" 270 "KEF" 289 "AMG" 308 "TAT" 319 "MVM" 385 "UAES" 828 "RBCD" 999 "ALL" 9454 "Fuso" /end COMPU_VTAB
/begin COMPU_METHOD m_q0p1 "" RAT_FUNC "%6.3" "kg/h" COEFFS 0 10 0 0 0 1 /end COMPU_METHOD
/begin COMPU_METHOD OneToOne "" RAT_FUNC "%6.2" "-" COEFFS 0 1 0 0 0 1 /end COMPU_METHOD
/begin COMPU_METHOD Pres_1_kPa "" RAT_FUNC "%6.2" "kPa" COEFFS 0 1 0 0 0 1 /end COMPU_METHOD
/begin COMPU_METHOD Pwr_kW "" RAT_FUNC "%6.4" "kW" COEFFS 0 100 0 0 0 1 /end COMPU_METHOD
/begin COMPU_METHOD q1p5259Em7_s "" RAT_FUNC "%9.8" "s" COEFFS 0 65536 0 0 0 0.01 /end COMPU_METHOD
/begin COMPU_METHOD RBPtCel_du_7p62939em4 "" RAT_FUNC "%6.5" "V/s" COEFFS 0 65536 0 0 0 50 /end COMPU_METHOD
/begin COMPU_METHOD RBPtCel_pwr_kw_1p0_1 "" RAT_FUNC "%6.2" "" COEFFS 0 1 0 0 0 1 /end COMPU_METHOD
/begin COMPU_METHOD RBPtCel_tq_1p0_1 "" RAT_FUNC "%6.2" "Nm" COEFFS 0 1 0 0 0 1 /end COMPU_METHOD
/begin COMPU_METHOD RBPtCel_vol_1p0_1 "" RAT_FUNC "%6.2" "l" COEFFS 0 1 0 0 0 1 /end COMPU_METHOD
/begin COMPU_METHOD reldeg_q0p002441 "" RAT_FUNC "%6.4" "deg/V" COEFFS 0 65536 0 0 0 160 /end COMPU_METHOD
/begin COMPU_METHOD rel_q0p392 "" RAT_FUNC "%6.3" "%" COEFFS 0 255 0 0 0 100 /end COMPU_METHOD
/begin COMPU_METHOD RmpCurr_A "" RAT_FUNC "%6.5" "A/s" COEFFS 0 6553.6 0 0 0 1 /end COMPU_METHOD
/begin COMPU_METHOD RmpTrq "" RAT_FUNC "%6.4" "Nm/s" COEFFS 0 655.36 0 0 0 1 /end COMPU_METHOD
/begin COMPU_METHOD spgg_q0p00488_V_DIV_s "" RAT_FUNC "%6.4" "V/s" COEFFS 0 1024 0 0 0 5 /end COMPU_METHOD
/begin COMPU_METHOD spg_q1p221Em3_V "" RAT_FUNC "%6.4" "V" COEFFS 0 65536 0 0 0 80 /end COMPU_METHOD
/begin COMPU_METHOD TimeDelay_s "" RAT_FUNC "%6.1" "s" COEFFS 0 0 1 0 0.00023283064365387 0 /end COMPU_METHOD
/begin COMPU_METHOD Time_ms "" RAT_FUNC "%6.1" "ms" COEFFS 0 0.1 0 0 0 1 /end COMPU_METHOD
/begin COMPU_METHOD Time_ms_to_us "" RAT_FUNC "%6.5" "ms" COEFFS 0 1000 0 0 0 1 /end COMPU_METHOD
/begin COMPU_METHOD Time_s "" RAT_FUNC "%6.4" "s" COEFFS 0 100 0 0 0 1 /end COMPU_METHOD
/begin COMPU_METHOD Trq "" RAT_FUNC "%6.3" "Nm" COEFFS 0 10 0 0 0 1 /end COMPU_METHOD
/begin COMPU_METHOD TrqCom_q0p02 "" RAT_FUNC "%6.4" "Nm" COEFFS 0 50 0 0 0 1 /end COMPU_METHOD
/begin COMPU_METHOD TrqHigh "" RAT_FUNC "%6.5" "Nm" COEFFS 0 1000 0 0 0 1 /end COMPU_METHOD
/begin COMPU_METHOD Trq_float "" RAT_FUNC "%6.2" "Nm" COEFFS 0 1 0 0 0 1 /end COMPU_METHOD
/begin COMPU_METHOD t_q0p01 "" RAT_FUNC "%6.4" "s" COEFFS 0 100 0 0 0 1 /end COMPU_METHOD
/begin COMPU_METHOD t_q0p02 "" RAT_FUNC "%6.4" "s" COEFFS 0 100 0 0 0 2 /end COMPU_METHOD
/begin COMPU_METHOD t_q1_ms "" RAT_FUNC "%6.2" "ms" COEFFS 0 1 0 0 0 1 /end COMPU_METHOD
/begin COMPU_METHOD Vol "" RAT_FUNC "%6.4" "l" COEFFS 0 100 0 0 0 1 /end COMPU_METHOD
/begin COMPU_METHOD Volt_Batt "" RAT_FUNC "%6.1" "mV" COEFFS 0 0.05 0 0 0 1 /end COMPU_METHOD
/begin COMPU_METHOD Volt_q1 "" RAT_FUNC "%6.2" "V" COEFFS 0 1 0 0 0 1 /end COMPU_METHOD
/begin RECORD_LAYOUT Kw_Ws16 FNC_VALUES 1 SWORD COLUMN_DIR DIRECT /end RECORD_LAYOUT
/begin RECORD_LAYOUT Kw_Ws32 FNC_VALUES 1 SLONG COLUMN_DIR DIRECT /end RECORD_LAYOUT
/begin RECORD_LAYOUT Kw_Wu8 FNC_VALUES 1 UBYTE COLUMN_DIR DIRECT /end RECORD_LAYOUT
/begin RECORD_LAYOUT RB_Curve_S16_S16 NO_AXIS_PTS_X 1 SWORD AXIS_PTS_X 2 SWORD INDEX_INCR DIRECT FNC_VALUES 3 SWORD COLUMN_DIR DIRECT /end RECORD_LAYOUT
/begin RECORD_LAYOUT RB_Curve_U16_U16 NO_AXIS_PTS_X 1 UWORD AXIS_PTS_X 2 UWORD INDEX_INCR DIRECT FNC_VALUES 3 UWORD COLUMN_DIR DIRECT /end RECORD_LAYOUT
/begin RECORD_LAYOUT RB_Map_U16U16_U16 NO_AXIS_PTS_X 1 UWORD NO_AXIS_PTS_Y 2 UWORD AXIS_PTS_X 3 UWORD INDEX_INCR DIRECT AXIS_PTS_Y 4 UWORD INDEX_INCR DIRECT FNC_VALUES 5 UWORD COLUMN_DIR DIRECT /end RECORD_LAYOUT
/begin RECORD_LAYOUT RB_ValA_Ws32 FNC_VALUES 1 SLONG COLUMN_DIR DIRECT /end RECORD_LAYOUT
/begin RECORD_LAYOUT RB_ValA_Wu8 FNC_VALUES 1 UBYTE COLUMN_DIR DIRECT /end RECORD_LAYOUT
/begin RECORD_LAYOUT RB_Val_Wr32 FNC_VALUES 1 FLOAT32_IEEE COLUMN_DIR DIRECT /end RECORD_LAYOUT
/begin RECORD_LAYOUT RB_Val_Ws16 FNC_VALUES 1 SWORD COLUMN_DIR DIRECT /end RECORD_LAYOUT
/begin RECORD_LAYOUT RB_Val_Ws32 FNC_VALUES 1 SLONG COLUMN_DIR DIRECT /end RECORD_LAYOUT
/begin RECORD_LAYOUT RB_Val_Wu16 FNC_VALUES 1 UWORD COLUMN_DIR DIRECT /end RECORD_LAYOUT
/begin RECORD_LAYOUT RB_Val_Wu32 FNC_VALUES 1 ULONG COLUMN_DIR DIRECT /end RECORD_LAYOUT
/begin RECORD_LAYOUT RB_Val_Wu8 FNC_VALUES 1 UBYTE COLUMN_DIR DIRECT /end RECORD_LAYOUT
/begin RECORD_LAYOUT Val_Ws16 FNC_VALUES 1 SWORD COLUMN_DIR DIRECT /end RECORD_LAYOUT
/begin RECORD_LAYOUT Val_Wu8 FNC_VALUES 1 UBYTE COLUMN_DIR DIRECT /end RECORD_LAYOUT
/end MODULE
/end PROJECT
