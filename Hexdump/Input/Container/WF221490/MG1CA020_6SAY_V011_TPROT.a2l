ASAP2_VERSION 1 60
/begin PROJECT MG1CA020 "MG1CA020"
/begin HEADER "" VERSION "MG1CA020_6SAY_V011_TPROT" PROJECT_NO MG1CA020 /end HEADER
/begin MODULE DIM ""
/begin MOD_COMMON "" BYTE_ORDER MSB_LAST ALIGNMENT_BYTE 1 ALIGNMENT_WORD 2 ALIGNMENT_LONG 4 ALIGNMENT_INT64 4 ALIGNMENT_FLOAT32_IEEE 4 ALIGNMENT_FLOAT64_IEEE 4 DATA_SIZE 32 /end MOD_COMMON
/begin CHARACTERISTIC MoFClth_flgClthStrkFlt_C "Calibration to indicate clutch stroke error" VALUE 0x8053BD2C Val_Wu8 1.00000000000 B_TRUE 0.00 1.00000000000 FORMAT "%13.11" /end CHARACTERISTIC
/begin AXIS_PTS MoFESpd_nEng_Ax "Data point distribution for engine speed in engine speed monitoring" 0x8053B7E2 MoFESpd_nEng Axis_Xu8 10200. nmot_q40 8 0.00 10200. FORMAT "%5.0" DEPOSIT ABSOLUTE /end AXIS_PTS
/begin CHARACTERISTIC MoFStrt_cntrStrtRls_C "Threshold value for Starter release plausible error" VALUE 0x8053BA34 Val_Wu8 255.0 OneToOne 0.00 255.0 FORMAT "%5.1" /end CHARACTERISTIC
/begin CHARACTERISTIC MoFStrt_cntrUnderVltg_C "Threshold for delay of start release deactivation in case of undervoltage situation" VALUE 0x8053BA24 Val_Wu8 255.0 OneToOne 0.00 255.0 FORMAT "%5.1" /end CHARACTERISTIC
/begin CHARACTERISTIC MoFStrt_ctDebClthImpsOff_C "Threshold for clutch implausibility check healing" VALUE 0x8053BA25 Val_Wu8 255.0 OneToOne 0.00 255.0 FORMAT "%5.1" /end CHARACTERISTIC
/begin CHARACTERISTIC MoFStrt_ctDebClthImpsOn_C "Threshold for clutch implausibility check" VALUE 0x8053BA26 Val_Wu8 255.0 OneToOne 0.00 255.0 FORMAT "%5.1" /end CHARACTERISTIC
/begin CHARACTERISTIC MoFStrt_ctDebPushBtnDfl_C "Initialisation value for MoFStrt_ctDebPushBtn" VALUE 0x8053BA27 Val_Wu8 255.0 OneToOne 0.00 255.0 FORMAT "%5.1" /end CHARACTERISTIC
/begin CHARACTERISTIC MoFStrt_ctDebPushBtn_C "Debounce threshold for low to high transition of push button signal debouncing" VALUE 0x8053BA28 Val_Wu8 255.0 OneToOne 0.00 255.0 FORMAT "%5.1" /end CHARACTERISTIC
/begin CHARACTERISTIC MoFStrt_ctDebT50HiLo_C "Debounce threshold for High to low transition in T50 signal debouncing" VALUE 0x8053BA29 Val_Wu8 255.0 OneToOne 0.00 255.0 FORMAT "%5.1" /end CHARACTERISTIC
/begin CHARACTERISTIC MoFStrt_ctDebT50LoHi_C "Debounce threshold for low to high transition in T50 signal debouncing" VALUE 0x8053BA2A Val_Wu8 255.0 OneToOne 0.00 255.0 FORMAT "%5.1" /end CHARACTERISTIC
/begin CHARACTERISTIC MoFStrt_ctHWBrkDeactvnDly_C "Debounce counter threshold for brake deactivation for T50 Start" VALUE 0x8053BA2B Val_Wu8 255.0 OneToOne 0.00 255.0 FORMAT "%5.1" /end CHARACTERISTIC
/begin CHARACTERISTIC MoFStrt_flgTraMT_C "Calibration to choose the type of transmission present in the vehicle" VALUE 0x8053BA2C Val_Wu8 1.00000000000 B_TRUE 0.00 1.00000000000 FORMAT "%13.11" /end CHARACTERISTIC
/begin CHARACTERISTIC MoFStrt_stSTSwitchMnl_C "ST_Switch replacement in manual mode" VALUE 0x8053BA2D Val_Wu8 1.00000000000 B_TRUE 0.00 1.00000000000 FORMAT "%13.11" /end CHARACTERISTIC
/begin CHARACTERISTIC MoFStrt_swtBrkCnd_C "Switch for (de)activating brake condition" VALUE 0x8053BA2E Val_Wu8 1.00000000000 B_TRUE 0.00 1.00000000000 FORMAT "%13.11" /end CHARACTERISTIC
/begin CHARACTERISTIC MoFStrt_swtClthPlausChk_C "Switch to consider clutch plausibility check in start release" VALUE 0x8053BA2F Val_Wu8 1.00000000000 B_TRUE 0.00 1.00000000000 FORMAT "%13.11" /end CHARACTERISTIC
/begin CHARACTERISTIC MoFStrt_swtInvSTSwitch_C "Switch to invert ST_Switch signal" VALUE 0x8053BA30 Val_Wu8 1.00000000000 B_TRUE 0.00 1.00000000000 FORMAT "%13.11" /end CHARACTERISTIC
/begin CHARACTERISTIC MoFStrt_swtSigNPos_C "Switch to select source of gear nuetral signal via CAN or ADC" VALUE 0x8053BA31 Val_Wu8 255.0 OneToOne 0.00 255.0 FORMAT "%5.1" /end CHARACTERISTIC
/begin CHARACTERISTIC MoFStrt_swtSTSwitchMnl_C "Switch to select manual mode for ST_Switch" VALUE 0x8053BA32 Val_Wu8 1.00000000000 B_TRUE 0.00 1.00000000000 FORMAT "%13.11" /end CHARACTERISTIC
/begin CHARACTERISTIC MoFTra_cntrDebTSCDeactv_C "Threshold for MoFTra_cntrDebTSCDeactv" VALUE 0x8053BA68 Val_Wu8 255.0 OneToOne 0.00 255.0 FORMAT "%5.1" /end CHARACTERISTIC
/begin CHARACTERISTIC MoFTra_rTqBoostMinLim_C "Limiting torque converter boost value" VALUE 0x8053C8F4 Val_Wu16 655.3500 TransR 0.00 655.3500 FORMAT "%8.4" /end CHARACTERISTIC
/begin CHARACTERISTIC MoFTra_rTqCnvrBoostDft_C "Default torque converter boost value" VALUE 0x8053C8F6 Val_Wu16 655.3500 TransR 0.00 655.3500 FORMAT "%8.4" /end CHARACTERISTIC
/begin AXIS_PTS MoFTrqAct_nEng_Ax "Data point distribution for engine speed" 0x8053BA6A MoFESpd_nEng Axis_Xu8 10200. nmot_q40 12 0.00 10200. FORMAT "%5.0" DEPOSIT ABSOLUTE /end AXIS_PTS
/begin AXIS_PTS MoFTrqAct_ratFillg_Ax "Axis grid distribution for air charge" 0x8053C8F8 MoFAirFl_ratFillg Axis_Xu16 1535.977 rel_uw_q0p0234 12 0.00 1535.977 FORMAT "%8.3" DEPOSIT ABSOLUTE /end AXIS_PTS
/begin CHARACTERISTIC MoFTrqAct_tqOptm_M "Optimal torque in function monitoring" MAP 0x8053BA77 MapG_Wu8 99.61 rel_q0p39 0.00 99.61 FORMAT "%5.2"
 /begin AXIS_DESCR COM_AXIS MoFAirFl_ratFillg rel_uw_q0p0234 12 0.00 1535.977 FORMAT "%8.3" AXIS_PTS_REF MoFTrqAct_ratFillg_Ax /end AXIS_DESCR
 /begin AXIS_DESCR COM_AXIS MoFESpd_nEng nmot_q40 12 0.00 10200. FORMAT "%5.0" AXIS_PTS_REF MoFTrqAct_nEng_Ax /end AXIS_DESCR
/end CHARACTERISTIC
/begin CHARACTERISTIC MoFTrqCmp_cntrRstTqCompMax_C "Number of resets to be executed in the error case" VALUE 0x8053BB1C Val_Wu8 255.0 OneToOne 0.00 255.0 FORMAT "%5.1" /end CHARACTERISTIC
/begin CHARACTERISTIC MoFTrqCmp_cntrTestTqCompMax_C "Counter threshold for setting of test flag in diagnosis of total torque comparision" VALUE 0x8053CD1C Val_Wu8 255.0 OneToOne 0.00 255.0 FORMAT "%5.1" /end CHARACTERISTIC
/begin CHARACTERISTIC MoFTrqCmp_cntrTestTqCompMin_C "Counter threshold for setting of test flag in diagnosis of min total torque comparision" VALUE 0x8053CD1E Val_Wu8 255.0 OneToOne 0.00 255.0 FORMAT "%5.1" /end CHARACTERISTIC
/begin CHARACTERISTIC MoFTrqCmp_cntrTqCompMax_C "Error tolerance threshold for total torque comparision in function monitoring" VALUE 0x8053BB1D Val_Wu8 255.0 OneToOne 0.00 255.0 FORMAT "%5.1" /end CHARACTERISTIC
/begin CHARACTERISTIC MoFTrqCmp_cntrTqCompMin_C "Error tolerance threshold for min torque comparision in function monitoring" VALUE 0x8053BB1E Val_Wu8 255.0 OneToOne 0.00 255.0 FORMAT "%5.1" /end CHARACTERISTIC
/begin CHARACTERISTIC MoFTrqCmp_facTqErrMax_C "maximal increment of MoF_facTrqErrSum per time" VALUE 0x8053C912 Val_Ws16 127.9980 rel_q0p00195_pc_s -64.00000 63.99805 FORMAT "%8.5" /end CHARACTERISTIC
/begin CHARACTERISTIC MoFTrqCmp_facTqErrMin_C "maximal decrement of MoF_facTrqErrSum per time" VALUE 0x8053C914 Val_Ws16 127.9980 rel_q0p00195_pc_s -64.00000 63.99805 FORMAT "%8.5" /end CHARACTERISTIC
/begin CHARACTERISTIC MoFTrqCmp_nEngTestTqCompMax_C "Engine speed threshold for the entry of the cycle flags in MoFTrqCmp_Max" VALUE 0x8053CD1D Val_Wu8 10200. nmot_q40 0.00 10200. FORMAT "%5.0" /end CHARACTERISTIC
/begin CHARACTERISTIC MoFTrqCmp_nEngTestTqCompMin_C "Engine speed threshold for the entry of cycle flags in MoFTrqCmp_Min" VALUE 0x8053CD1F Val_Wu8 10200. nmot_q40 0.00 10200. FORMAT "%5.0" /end CHARACTERISTIC
/begin CHARACTERISTIC MoFTrqPtd_cntrActvPostBldCfg_C "Number of debounce steps of error debounce due to an error in return of the active post-build configuration" VALUE 0x8053BD26 Val_Wu8 255.0 OneToOne 0.00 255.0 FORMAT "%5.1" /end CHARACTERISTIC
/begin CHARACTERISTIC MoFTrqPtd_cntrNegChkPostBldCfg_C "Number of debounce steps of error debounce due to an error in the negative check of the post-build configuration" VALUE 0x8053BD27 Val_Wu8 255.0 OneToOne 0.00 255.0 FORMAT "%5.1" /end CHARACTERISTIC
/begin CHARACTERISTIC MoFTrqPtd_cntrPosChkPostBldCfg_C "Number of debounce steps of error debounce due to an error in the positive check of the post-build configuration" VALUE 0x8053BD28 Val_Wu8 255.0 OneToOne 0.00 255.0 FORMAT "%5.1" /end CHARACTERISTIC
/begin CHARACTERISTIC MoFTrqPtd_cntrRstPostBldSel_C "Number of software resets from MoFVar_PostBldSel before request of an error reaction" VALUE 0x8053BD29 Val_Wu8 255.0 OneToOne 0.00 255.0 FORMAT "%5.1" /end CHARACTERISTIC
/begin CHARACTERISTIC MoFTrqPtd_cntrStabyChkPostBldCfg_C "Number of debounce steps of error debounce due to changed post-build configuration during driving cycle" VALUE 0x8053BD2A Val_Wu8 255.0 OneToOne 0.00 255.0 FORMAT "%5.1" /end CHARACTERISTIC
/begin CHARACTERISTIC MoFTrqPtd_cntrTestPostBldSel_C "Debounce steps for setting the testflag in post-build selectable diagnosis in function monitoring" VALUE 0x8053CD20 Val_Wu8 255.0 OneToOne 0.00 255.0 FORMAT "%5.1" /end CHARACTERISTIC
/begin CHARACTERISTIC MoFTrqPtd_nEngRlsStrtThdMax_C "Maximum engine speed threshold to select maximum permitted torque during engine start" VALUE 0x8053BC9C Val_Wu8 10200. nmot_q40 0.00 10200. FORMAT "%5.0" /end CHARACTERISTIC
/begin CHARACTERISTIC MoFTrqPtd_nEngRlsStrtThdMin_C "Engine speed threshold for releasing start" VALUE 0x8053BC9D Val_Wu8 10200. nmot_q40 0.00 10200. FORMAT "%5.0" /end CHARACTERISTIC
/begin CHARACTERISTIC MoFTrqPtd_rBltDrv_C "belt ratio" VALUE 0x8053C91C Val_Wu16 655.3400 fak_q0p01 0.0100 655.3500 FORMAT "%8.4" EXTENDED_LIMITS 0.00 655.3500 /end CHARACTERISTIC
/begin CHARACTERISTIC MoFTrqPtd_rTrqPtdOffs_M "Offset for the filtered permissible inner torque in function monitoring" MAP 0x8053BCCE Map_Xu8Yu8Wu8 99.61 rel_q0p39 0.00 99.61 FORMAT "%5.2"
 /begin AXIS_DESCR STD_AXIS MoFESpd_nEng nmot_q40 8 0.00 10200. FORMAT "%5.0" DEPOSIT ABSOLUTE /end AXIS_DESCR
 /begin AXIS_DESCR STD_AXIS MoFTrqPtd_rTrqPtdFltWoOffs rel_q0p39 8 0.00 99.61 FORMAT "%5.2" DEPOSIT ABSOLUTE /end AXIS_DESCR
/end CHARACTERISTIC
/begin CHARACTERISTIC MoFTrqPtd_stSwtPbsChk_C "Switch for activation of the post-build selectable monitoring in the function monitoring" VALUE 0x8053BD2B Val_Wu8 255.0 OneToOne 0.00 255.0 FORMAT "%5.1" /end CHARACTERISTIC
/begin CHARACTERISTIC MoFTrqPtd_stTqCtrldOperMod_C "Torque Controlled operating mode" VALUE 0x8053BC9E Val_Wu8 255.0 OneToOne 0.00 255.0 FORMAT "%5.1" /end CHARACTERISTIC
/begin CHARACTERISTIC MoFTrqPtd_stVoltCtrldOperMod_C "Voltage Controlled operating mode" VALUE 0x8053BC9F Val_Wu8 255.0 OneToOne 0.00 255.0 FORMAT "%5.1" /end CHARACTERISTIC
/begin CHARACTERISTIC MoFTrqPtd_tiDebComErrElDrvThd_C "Time threshold for detecting E-Drive communication error" VALUE 0x8053BCA0 Val_Wu8 2.550 t_q0p01 0.00 2.550 FORMAT "%5.3" /end CHARACTERISTIC
/begin CHARACTERISTIC MoFTrqPtd_tiDebIrrvCmpErr_C "debounce time threshold, after irreversible torque comparision error was detected" VALUE 0x8053BCA1 Val_Wu8 2.550 t_q0p01 0.00 2.550 FORMAT "%5.3" /end CHARACTERISTIC
/begin CHARACTERISTIC MoFTrqPtd_tiDebIrvErrElDrvThd_C "Time threshold for detecting E-Drive failure error" VALUE 0x8053BCA2 Val_Wu8 2.550 t_q0p01 0.00 2.550 FORMAT "%5.3" /end CHARACTERISTIC
/begin CHARACTERISTIC MoFTrqPtd_tiDlyPtdEngArysize_C "Size of array for deathtime functionality of filter" VALUE 0x8053BD20 Val_Wu8 31.00 OneToOne 1.00 32.00 FORMAT "%5.2" EXTENDED_LIMITS 0.00 255.0 /end CHARACTERISTIC
/begin CHARACTERISTIC MoFTrqPtd_tiDlyPtdTqEng_C "Delay time for negative gradient in the permitted engine torque" VALUE 0x8053BD21 Val_Wu8 0.3100 t10msxs_ub_q0p01 0.0100 0.3200 EXTENDED_LIMITS 0.00 2.550 /end CHARACTERISTIC
/begin CHARACTERISTIC MoFTrqPtd_tiDlyTqPtdMaxArysize_C "Size of array for deathtime functionality of filter" VALUE 0x8053BD22 Val_Wu8 31.00 OneToOne 1.00 32.00 FORMAT "%5.2" EXTENDED_LIMITS 0.00 255.0 /end CHARACTERISTIC
/begin CHARACTERISTIC MoFTrqPtd_tiDlyTqPtdMax_C "deadtime of permitted Maximum-Sum-torque" VALUE 0x8053BD23 Val_Wu8 0.3100 t10msxs_ub_q0p01 0.0100 0.3200 EXTENDED_LIMITS 0.00 2.550 /end CHARACTERISTIC
/begin CHARACTERISTIC MoFTrqPtd_tiFilDlyTqPtdMin_C "Deadtime for permitted minimum torque filtering" VALUE 0x8053BD24 Val_Wu8 0.2800 t40msxs_ub_q0p04 0.0400 0.3200 EXTENDED_LIMITS 0.00 10.20 /end CHARACTERISTIC
/begin CHARACTERISTIC MoFTrqPtd_tiFiltgTqPtdEng_C "PT1 filter constant to filter negative gradient of the permitted inner combustion engine torque" VALUE 0x8053C98C Val_Wu16 655.34000000 zk10msxs_uw_b655p36PT1 0.01000000 655.35000000 FORMAT "%12.8" EXTENDED_LIMITS 0.000000152590219 655.35000000 /end CHARACTERISTIC
/begin CHARACTERISTIC MoFTrqPtd_tiFiltgTqPtdMax_C "PT1 filter time constant for the falling edges of the permitted sum torque" VALUE 0x8053C98E Val_Wu16 655.34000000 zk10msxs_uw_b655p36PT1 0.01000000 655.35000000 FORMAT "%12.8" EXTENDED_LIMITS 0.000000152590219 655.35000000 /end CHARACTERISTIC
/begin CHARACTERISTIC MoFTrqPtd_tiFiltgTqPtdMin_C "PT1 filter time constant for the rising edges of the permitted minimum torque" VALUE 0x8053CA34 Val_Wu16 2621.3600000 zk40msxs_uw_b2621p44PT1 0.0400000 2621.4000000 FORMAT "%12.7" EXTENDED_LIMITS 0.000000610360876 2621.4000000 /end CHARACTERISTIC
/begin CHARACTERISTIC MoFTrqPtd_tiTrqMaxStrt_C "time during maximal start torque is allowed in function monitoring" VALUE 0x8053C918 Val_Wu16 2621.400 t_q0p04 0.00 2621.400 FORMAT "%8.3" /end CHARACTERISTIC
/begin CHARACTERISTIC MoFTrqPtd_tqCkrsftStrtMaxEm_T "Engine speed dependent curve to adjust permitted maximum e-machine torque during engine start" CURVE 0x8053C91E Mo_DataCurveSstS16WS16 6553.500 md_q0p1 -3276.800 3276.700 FORMAT "%8.3"
 /begin AXIS_DESCR STD_AXIS MoFESpd_nEng nmot_q40 6 0.00 10200.00 FORMAT "%8.2" EXTENDED_LIMITS -1310720. 1310680. DEPOSIT ABSOLUTE /end AXIS_DESCR
/end CHARACTERISTIC
/begin CHARACTERISTIC MoFTrqPtd_tqCrksftEmMinOffs_M "permitted engine speed dependent offset for minimum e-machine torque" MAP 0x8053CA36 Map_Xs16Ys16Ws16 6553.500 md_q0p1 -3276.800 3276.700 FORMAT "%8.3"
 /begin AXIS_DESCR STD_AXIS MoFTrqPtd_tqCrksftEmMinFild md_q0p1 8 -3276.800 3276.700 FORMAT "%8.3" DEPOSIT ABSOLUTE /end AXIS_DESCR
 /begin AXIS_DESCR STD_AXIS MoFESpd_nEng nmot_q40 8 0.00 10200.00 FORMAT "%8.2" EXTENDED_LIMITS -1310720. 1310680. DEPOSIT ABSOLUTE /end AXIS_DESCR
/end CHARACTERISTIC
/begin CHARACTERISTIC MoFTrqPtd_tqCrsMaxEM_T "Max. permitted torque: electrical drive at crankshaft level" CURVE 0x8053C938 Mo_DataCurveSstS16WS16 6553.500 md_q0p1 -3276.800 3276.700 FORMAT "%8.3"
 /begin AXIS_DESCR STD_AXIS MoFESpd_nEng nmot_q40 10 0.00 10200.00 FORMAT "%8.2" EXTENDED_LIMITS -1310720. 1310680. DEPOSIT ABSOLUTE /end AXIS_DESCR
/end CHARACTERISTIC
/begin CHARACTERISTIC MoFTrqPtd_tqCrsMinEM_T "Min. permitted torque: electrical drive at crankshaft level" CURVE 0x8053C962 Mo_DataCurveSstS16WS16 6553.500 md_q0p1 -3276.800 3276.700 FORMAT "%8.3"
 /begin AXIS_DESCR STD_AXIS MoFESpd_nEng nmot_q40 10 0.00 10200.00 FORMAT "%8.2" EXTENDED_LIMITS -1310720. 1310680. DEPOSIT ABSOLUTE /end AXIS_DESCR
/end CHARACTERISTIC
/begin CHARACTERISTIC MoFTrqPtd_tqInrMaxStrt_C "maximal inner torque during start in function monitoring" VALUE 0x8053C91A Val_Ws16 6553.500 md_q0p1 -3276.800 3276.700 FORMAT "%8.3" /end CHARACTERISTIC
/begin CHARACTERISTIC MoFTrqPtd_tqMaxEmOffs_T "Offset-factor-curve for maximum permitted E-Machine torque limit" CURVE 0x8053BCA3 Mo_DataCurveSstU8WU8 12.70 md_q0p1 0.00 12.70 FORMAT "%5.2" EXTENDED_LIMITS 0.00 25.50
 /begin AXIS_DESCR STD_AXIS MoFESpd_nEng nmot_q40 10 0.00 10200. FORMAT "%5.0" DEPOSIT ABSOLUTE /end AXIS_DESCR
/end CHARACTERISTIC
/begin CHARACTERISTIC MoFTrqPtd_tqMinEmOffs_T "Offset-factor-curve for minimum permitted E-Machine torque limit" CURVE 0x8053BCB8 Mo_DataCurveSstU8WU8 12.70 md_q0p1 0.00 12.70 FORMAT "%5.2" EXTENDED_LIMITS 0.00 25.50
 /begin AXIS_DESCR STD_AXIS MoFESpd_nEng nmot_q40 10 0.00 10200. FORMAT "%5.0" DEPOSIT ABSOLUTE /end AXIS_DESCR
/end CHARACTERISTIC
/begin CHARACTERISTIC MoFTrqPtd_tqOffsReslEmTq_C "robustness offset factor to consider resolution losses for calculation of E-Machine torque" VALUE 0x8053BCCD Val_Wu8 12.70 md_q0p1 0.00 12.70 FORMAT "%5.2" EXTENDED_LIMITS 0.00 25.50 /end CHARACTERISTIC
/begin CHARACTERISTIC MoFTrqPtd_tqSumPtdOffs_M "Offset-map for calculation of permitted Sum-torque" MAP 0x8053C990 Map_Xs16Ys16Ws16 6553.500 md_q0p1 -3276.800 3276.700 FORMAT "%8.3"
 /begin AXIS_DESCR STD_AXIS MoFTrqPtd_tqCluSumPtdFild md_q0p1 8 -3276.800 3276.700 FORMAT "%8.3" DEPOSIT ABSOLUTE /end AXIS_DESCR
 /begin AXIS_DESCR STD_AXIS MoFESpd_nEng nmot_q40 8 0.00 10200.00 FORMAT "%8.2" EXTENDED_LIMITS -1310720. 1310680. DEPOSIT ABSOLUTE /end AXIS_DESCR
/end CHARACTERISTIC
/begin CHARACTERISTIC MoFTrqRat_rTqPTMax_C "max. permitted PT transmission ratio in function monitoring" VALUE 0x8053CADA Val_Wu16 655.3500 fak_q0p01 0.00 655.3500 FORMAT "%8.4" /end CHARACTERISTIC
/begin CHARACTERISTIC MoFTrqRat_rTqPTMin_C "min. permitted PT transmission ratio in function monitoring" VALUE 0x8053CADC Val_Wu16 655.3500 fak_q0p01 0.00 655.3500 FORMAT "%8.4" /end CHARACTERISTIC
/begin CHARACTERISTIC MoF_ctRstTrqCmp_C "number of Resets to be executed in the error case" VALUE 0x8053BB08 Val_Wu8 255.0 dez 0.00 255.0 FORMAT "%5.1" /end CHARACTERISTIC
/begin CHARACTERISTIC MoF_ctTrqCmp_C "error tolerance time for torque comparison in the function monitoring" VALUE 0x8053BB09 Val_Wu8 255.0 dez 0.00 255.0 FORMAT "%5.1" /end CHARACTERISTIC
/begin CHARACTERISTIC MoF_ctTstTrqCmp_C "counter for putting of the test flag in diagnosis of torque comparison" VALUE 0x8053CD1A Val_Wu8 255.0 dez 0.00 255.0 FORMAT "%5.1" /end CHARACTERISTIC
/begin CHARACTERISTIC MoF_facMinRTrqInrMax_C "Factor for protection of maximally torque downwards" VALUE 0x8053BB20 Val_Wu8 0.9961 fak_ub_b1 0.00 0.9961 /end CHARACTERISTIC
/begin CHARACTERISTIC MoF_facTrqErrSumDet_C "Detection threshold for the error sum MoF_facTrqErrSum in function monitoring" VALUE 0x8053C916 Val_Wu16 127.9980 rel_q0p00195_pc_s 0.00 127.9980 FORMAT "%8.4" /end CHARACTERISTIC
/begin CHARACTERISTIC MoF_facTrqMinOvrRun_CUR "Factor characteristic curve for over run cutoff air charge in the functional monitoring" CURVE 0x8053BB21 ValA_Wu8 1.992188 fak_ub_b2 0.00 1.992188 FORMAT "%8.6"
 /begin AXIS_DESCR COM_AXIS MoFESpd_nEng nmot_q40 8 0.00 10200. FORMAT "%5.0" AXIS_PTS_REF MoFESpd_nEng_Ax /end AXIS_DESCR
/end CHARACTERISTIC
/begin CHARACTERISTIC MoF_nEngShOff_C "engine speed threshold to throw down the model temperature in the functional monitoring" VALUE 0x8053BA36 Val_Wu8 10200. nmot_q40 0.00 10200. FORMAT "%5.0" /end CHARACTERISTIC
/begin CHARACTERISTIC MoF_nEngStrt_C "engine speed threshold for starting the model temperature in the functional monitoring" VALUE 0x8053BA37 Val_Wu8 10200. nmot_q40 0.00 10200. FORMAT "%5.0" /end CHARACTERISTIC
/begin CHARACTERISTIC MoF_nEngTstTrqCmp_C "engine speed threshold for the entry of the cycle flags MoFTrqCmp" VALUE 0x8053CD1B Val_Wu8 10200. nmot_q40 0.00 10200. FORMAT "%5.0" /end CHARACTERISTIC
/begin AXIS_PTS MoF_rAPP_DST "accelerator pedal position distribution in function monitoring" 0x8053B6A9 MoF_rAPP Axis_Xu8 99.61 rel_q0p39 8 0.00 99.61 FORMAT "%5.2" DEPOSIT ABSOLUTE /end AXIS_PTS
/begin CHARACTERISTIC MoF_rTrqInrMax_CUR "curve maximal inner torque in function monitoring" CURVE 0x8053BB29 ValA_Wu8 99.61 rel_q0p39 0.00 99.61 FORMAT "%5.2"
 /begin AXIS_DESCR COM_AXIS MoFESpd_nEng nmot_q40 8 0.00 10200. FORMAT "%5.0" AXIS_PTS_REF MoFESpd_nEng_Ax /end AXIS_DESCR
/end CHARACTERISTIC
/begin CHARACTERISTIC MoF_rTrqPtdFltWgh_CUR "weighting of the filtered permissible torque in function monitoring" CURVE 0x8053BB0A Mo_DataCurveSstU8WU8 99.61 rel_q0p39 0.00 99.61 FORMAT "%5.2"
 /begin AXIS_DESCR STD_AXIS MoF_rTrqPtdFlt rel_q0p39 8 0.00 99.61 FORMAT "%5.2" DEPOSIT ABSOLUTE /end AXIS_DESCR
/end CHARACTERISTIC
/begin CHARACTERISTIC MoF_stStrtStopEnaMsg_C "Calibration for MoF_stStrtStopEnaMsg" VALUE 0x8053BD2D Val_Wu8 255.0 OneToOne 0.00 255.0 FORMAT "%5.1" /end CHARACTERISTIC
/begin CHARACTERISTIC MoF_stVar_C "parameter for variant coding" VALUE 0x8053BD25 Val_Wu8 255.0 dez 0.00 255.0 FORMAT "%5.1" /end CHARACTERISTIC
/begin CHARACTERISTIC MoF_tEngGradNrmOp16_MAP "temperature gradient for model temperature in the normal opreation in the function monitoring" MAP 0x8053C8A8 Map_Xs16Ys16Ws16 47.99927 temp_q7p324Em4_DegC -24.00000 23.99927 FORMAT "%8.5"
 /begin AXIS_DESCR STD_AXIS MoFTEng_mfVal m_ub_b1020 5 0.00 1020.000 FORMAT "%8.3" EXTENDED_LIMITS -131072.0 131068.0 DEPOSIT ABSOLUTE /end AXIS_DESCR
 /begin AXIS_DESCR STD_AXIS MoF_tEngMod temp_ub_q0p75_o48 5 -48.0000 143.2500 FORMAT "%8.4" EXTENDED_LIMITS -24624.00 24527.25 DEPOSIT ABSOLUTE /end AXIS_DESCR
/end CHARACTERISTIC
/begin CHARACTERISTIC MoF_tEngGradOvrRun_MAP "temperature gradient for model temperature in the fuel cut-off opreation in the function monitoring" MAP 0x8053BA38 Map_Xu8Yu8Wu8 0.1868 temp_qn7p324Em4_DegC -0.1868 0.00 FORMAT "%6.4"
 /begin AXIS_DESCR STD_AXIS MoFTEng_mfVal m_ub_b1020 5 0.00 1020. FORMAT "%5.0" DEPOSIT ABSOLUTE /end AXIS_DESCR
 /begin AXIS_DESCR STD_AXIS MoF_tEngMod temp_ub_q0p75_o48 5 -48.0 143.3 FORMAT "%5.1" DEPOSIT ABSOLUTE /end AXIS_DESCR
/end CHARACTERISTIC
/begin CHARACTERISTIC MoF_tEngModMax_C "maximum initialization value of the model temperature in the function monitoring" VALUE 0x8053BA5D Val_Wu8 191.3 temp_ub_q0p75_o48 -48.0 143.3 FORMAT "%5.1" /end CHARACTERISTIC
/begin CHARACTERISTIC MoF_tEngModOfs_C "offset for model temperature in the function monitoring" VALUE 0x8053BA5E Val_Wu8 191.3 temp_ub_q0p75_o48 -48.0 143.3 FORMAT "%5.1" /end CHARACTERISTIC
/begin AXIS_PTS MoF_tEng_DST "interpolation node distribution for engine temperature in the function monitoring" 0x8053BA5F MoF_tEng Axis_Xu8 191.3 temp_ub_q0p75_o48 8 -48.0 143.3 FORMAT "%5.1" DEPOSIT ABSOLUTE /end AXIS_PTS
/begin CHARACTERISTIC MoF_tiTEngEna_C "time thershold after it the temperature plasibility check is enable in function monitoring" VALUE 0x8053C8F2 Val_Wu16 2621.400 t_q0p04 0.00 2621.400 FORMAT "%8.3" /end CHARACTERISTIC
/begin CHARACTERISTIC MoF_trqAdap_C "permissible adaptation torque in the function monitoring" VALUE 0x8053BB7A Val_Wu8 408.0 md_q1p6 0.00 408.0 FORMAT "%5.1" /end CHARACTERISTIC
/begin CHARACTERISTIC MoF_trqChrChg_CUR "charge change losses in the function monitoring" CURVE 0x8053BB7B ValA_Wu8 408.0 md_q1p6 0.00 408.0 FORMAT "%5.1"
 /begin AXIS_DESCR COM_AXIS MoFESpd_nEng nmot_q40 8 0.00 10200. FORMAT "%5.0" AXIS_PTS_REF MoFESpd_nEng_Ax /end AXIS_DESCR
/end CHARACTERISTIC
/begin CHARACTERISTIC MoF_trqConvNAP1_MAP "power train loss torque as f (engine speed, accelerator pedal) in the function monitoring" MAP 0x8053BB83 MapG_Wu8 408.0 md_q1p6 0.00 408.0 FORMAT "%5.1"
 /begin AXIS_DESCR COM_AXIS MoFESpd_nEng nmot_q40 8 0.00 10200. FORMAT "%5.0" AXIS_PTS_REF MoFESpd_nEng_Ax /end AXIS_DESCR
 /begin AXIS_DESCR COM_AXIS MoF_rAPP rel_q0p39 8 0.00 99.61 FORMAT "%5.2" AXIS_PTS_REF MoF_rAPP_DST /end AXIS_DESCR
/end CHARACTERISTIC
/begin CHARACTERISTIC MoF_trqConvNT1_MAP "power train loss torque as f (engine speed, temperature) in the function monitoring" MAP 0x8053BBC3 MapG_Wu8 408.0 md_q1p6 0.00 408.0 FORMAT "%5.1"
 /begin AXIS_DESCR COM_AXIS MoFESpd_nEng nmot_q40 8 0.00 10200. FORMAT "%5.0" AXIS_PTS_REF MoFESpd_nEng_Ax /end AXIS_DESCR
 /begin AXIS_DESCR COM_AXIS MoF_tEng temp_ub_q0p75_o48 8 -48.0 143.3 FORMAT "%5.1" AXIS_PTS_REF MoF_tEng_DST /end AXIS_DESCR
/end CHARACTERISTIC
/begin CHARACTERISTIC MoF_trqDesAlt_MAP "electric consumer in the function monitoring" MAP 0x8053BC03 MapG_Wu8 408.0 md_q1p6 0.00 408.0 FORMAT "%5.1"
 /begin AXIS_DESCR COM_AXIS MoFESpd_nEng nmot_q40 8 0.00 10200. FORMAT "%5.0" AXIS_PTS_REF MoFESpd_nEng_Ax /end AXIS_DESCR
 /begin AXIS_DESCR COM_AXIS MoF_tEng temp_ub_q0p75_o48 8 -48.0 143.3 FORMAT "%5.1" AXIS_PTS_REF MoF_tEng_DST /end AXIS_DESCR
/end CHARACTERISTIC
/begin CHARACTERISTIC MoF_trqDrag_MAP "friction losses in the function monitoring" MAP 0x8053BC43 MapG_Wu8 408.0 md_q1p6 0.00 408.0 FORMAT "%5.1"
 /begin AXIS_DESCR COM_AXIS MoFESpd_nEng nmot_q40 8 0.00 10200. FORMAT "%5.0" AXIS_PTS_REF MoFESpd_nEng_Ax /end AXIS_DESCR
 /begin AXIS_DESCR COM_AXIS MoF_tEng temp_ub_q0p75_o48 8 -48.0 143.3 FORMAT "%5.1" AXIS_PTS_REF MoF_tEng_DST /end AXIS_DESCR
/end CHARACTERISTIC
/begin CHARACTERISTIC MoF_trqInrMinIncr_CUR "minimal torque with anti clack in function monitoring" CURVE 0x8053BB31 ValA_Wu8 408.0 md_q1p6 0.00 408.0 FORMAT "%5.1"
 /begin AXIS_DESCR COM_AXIS MoFESpd_nEng nmot_q40 8 0.00 10200. FORMAT "%5.0" AXIS_PTS_REF MoFESpd_nEng_Ax /end AXIS_DESCR
/end CHARACTERISTIC
/begin CHARACTERISTIC MoF_trqLosTra_CUR "power train loss in function monitoring" CURVE 0x8053BC83 ValA_Wu8 408.0 md_q1p6 0.00 408.0 FORMAT "%5.1"
 /begin AXIS_DESCR COM_AXIS MoF_tEng temp_ub_q0p75_o48 8 -48.0 143.3 FORMAT "%5.1" AXIS_PTS_REF MoF_tEng_DST /end AXIS_DESCR
/end CHARACTERISTIC
/begin CHARACTERISTIC MoF_trqLtdAC_CUR "AC torque in the function monitoring" CURVE 0x8053BC8B ValA_Wu8 408.0 md_q1p6 0.00 408.0 FORMAT "%5.1"
 /begin AXIS_DESCR COM_AXIS MoFESpd_nEng nmot_q40 8 0.00 10200. FORMAT "%5.0" AXIS_PTS_REF MoFESpd_nEng_Ax /end AXIS_DESCR
/end CHARACTERISTIC
/begin CHARACTERISTIC MoF_trqLtdFan_CUR "loss torque of the fan in the function monitoring" CURVE 0x8053BC93 ValA_Wu8 408.0 md_q1p6 0.00 408.0 FORMAT "%5.1"
 /begin AXIS_DESCR COM_AXIS MoF_tEng temp_ub_q0p75_o48 8 -48.0 143.3 FORMAT "%5.1" AXIS_PTS_REF MoF_tEng_DST /end AXIS_DESCR
/end CHARACTERISTIC
/begin CHARACTERISTIC MoF_trqMinAirChrg_MAP "minimal torque dependent on minimal load in the function monitoring" MAP 0x8053BB39 MapG_Wu8 408.0 md_q1p6 0.00 408.0 FORMAT "%5.1"
 /begin AXIS_DESCR COM_AXIS MoFESpd_nEng nmot_q40 8 0.00 10200. FORMAT "%5.0" AXIS_PTS_REF MoFESpd_nEng_Ax /end AXIS_DESCR
 /begin AXIS_DESCR COM_AXIS MoF_tEng temp_ub_q0p75_o48 8 -48.0 143.3 FORMAT "%5.1" AXIS_PTS_REF MoF_tEng_DST /end AXIS_DESCR
/end CHARACTERISTIC
/begin CHARACTERISTIC MoF_trqStrgLtd_C "loss torque of the power steering in the function monitoring" VALUE 0x8053BC9B Val_Wu8 408.0 md_q1p6 0.00 408.0 FORMAT "%5.1" /end CHARACTERISTIC
/begin CHARACTERISTIC MoXAirFl_stCfgAdp_C "Codeword for function MoXAirFl_Adp for testimg purposes" VALUE 0x8053210C RB_Val_Wu8 255.0 OneToOne 0.00 255.0 FORMAT "%5.1" /end CHARACTERISTIC
/begin CHARACTERISTIC MoXEMM_nrHwLTErrSimn_C "Test calibration parameter for simulation of Hardware Logic test errors for diagnosis purposes" VALUE 0x8053210E RB_Val_Wu16 65535.0000000 MoXEMM_HwLTErrorSimnCode_VERB 0.00 65535.0000000 FORMAT "%13.7" /end CHARACTERISTIC
/begin CHARACTERISTIC MoXEMM_nrSmuAlmErrSimn_C "Test calibration parameter for simulation of SMU alarm errors for diagnosis purposes" VALUE 0x80532110 RB_Val_Wu16 65535.0000000 MoXEMM_SMUErrorSimnCode_VERB 0.00 65535.0000000 FORMAT "%13.7" /end CHARACTERISTIC
/begin CHARACTERISTIC MoXSyncLos_nEngSyncMin_C "speed threshold for activation of detection of loss of synchronization in extended monitoring" VALUE 0x80532112 RB_Val_Ws16 32767.50 EngN -16384.00 16383.50 FORMAT "%8.2" /end CHARACTERISTIC
/begin CHARACTERISTIC MoXTrqPtd_cntrDebErrMaxDisblTqEmThd_C "Error tolerance threshold to set the e-machine maximum torque limit to 0 Nm in case of pending maximum sum torque comparison error" VALUE 0x8053CD22 Val_Wu8 255.0 OneToOne 0.00 255.0 FORMAT "%5.1" /end CHARACTERISTIC
/begin CHARACTERISTIC MoXTrqPtd_cntrDebErrMaxRedTqEmThd_C "Error tolerance threshold to set the e-machine maximum torque limit to 0 Nm in case of pending maximum sum torque comparison error" VALUE 0x8053CD23 Val_Wu8 255.0 OneToOne 0.00 255.0 FORMAT "%5.1" /end CHARACTERISTIC
/begin CHARACTERISTIC MoXTrqPtd_cntrDebErrMinRedTqEmThd_C "Error tolerance threshold to reduce the minimum e-machine torque in case of pending minimum torque comparison error" VALUE 0x8053CD24 Val_Wu8 255.0 OneToOne 0.00 255.0 FORMAT "%5.1" /end CHARACTERISTIC
/begin CHARACTERISTIC MoXTrqPtd_cntrDebErrTqMaxEmThd_C "Error tolerance threshold to reduce the maximum e-machine torque in case of maximum e-machine torque comparison error in extended function monitoring" VALUE 0x8053CD25 Val_Wu8 255.0 OneToOne 0.00 255.0 FORMAT "%5.1" /end CHARACTERISTIC
/begin CHARACTERISTIC MoXTrqPtd_tiDlyFiltgTqEm_C "Delay time constant for permitted e-machine torque" VALUE 0x8053CD26 Val_Wu8 80.00 Time_ms 0.00 80.00 FORMAT "%5.2" EXTENDED_LIMITS 0.00 2550. /end CHARACTERISTIC
/begin CHARACTERISTIC MoXTrqPtd_tiOffDlyErrMaxRedTqEm_C "Turn off delay for e-machine maximum torque limitation in case of maximum sum torque comparison error" VALUE 0x8053CD27 Val_Wu8 2.550 t_q0p01 0.00 2.550 FORMAT "%5.3" /end CHARACTERISTIC
/begin CHARACTERISTIC MoXTrqPtd_tiOffDlyErrMinThd_C "Turn off delay for minimum torque limitation in case of minimum torque comparison error" VALUE 0x8053CD28 Val_Wu8 2.550 t_q0p01 0.00 2.550 FORMAT "%5.3" /end CHARACTERISTIC
/begin CHARACTERISTIC MoXTrqPtd_tiOffDlyErrTqMaxEm_C "Turn off delay for e-machine maximum torque limitation in case of maximum e-machine torque comparison error" VALUE 0x8053CD29 Val_Wu8 2.550 t_q0p01 0.00 2.550 FORMAT "%5.3" /end CHARACTERISTIC
/begin CHARACTERISTIC MoXTrqPtd_tiPT1FiltgTqEm_C "PT1 filter time constant for permitted e-machine torque" VALUE 0x8053CD2C Val_Ws32 4294967.3 TimeDelay_ms 0.0 4294967.3 FORMAT "%12.1" /end CHARACTERISTIC
/begin CHARACTERISTIC MoXTrqPtd_tqCrksftAltTqMax_T "Engine speed dependent curve to adjust typical alternator torque (1-3 KW)" CURVE 0x8053CD32 Mo_DataCurveSstS16WS16 6553.500 md_q0p1 -3276.800 3276.700 FORMAT "%8.3"
 /begin AXIS_DESCR STD_AXIS Epm_nEng EngN 8 -16384.00 16383.50 FORMAT "%8.2" DEPOSIT ABSOLUTE /end AXIS_DESCR
/end CHARACTERISTIC
/begin CHARACTERISTIC MoXTrqPtd_tqCrksftEmOffs_T "Engine speed dependent curve to adjust permitted maximum e-machine permitted torque" CURVE 0x8053CD54 Mo_DataCurveSstS16WS16 3276.700 md_q0p1 0.00 3276.700 FORMAT "%8.3" EXTENDED_LIMITS -3276.800 3276.700
 /begin AXIS_DESCR STD_AXIS Epm_nEng EngN 8 -16384.00 16383.50 FORMAT "%8.2" DEPOSIT ABSOLUTE /end AXIS_DESCR
/end CHARACTERISTIC
/begin CHARACTERISTIC MoXTrqPtd_tqCrksftEmRedOffs_T "Engine speed dependent offset to adjust maximum permitted e-machine torque limit" CURVE 0x8053CD76 Mo_DataCurveSstS16WS16 3276.700 md_q0p1 0.00 3276.700 FORMAT "%8.3" EXTENDED_LIMITS -3276.800 3276.700
 /begin AXIS_DESCR STD_AXIS Epm_nEng EngN 8 -16384.00 16383.50 FORMAT "%8.2" DEPOSIT ABSOLUTE /end AXIS_DESCR
/end CHARACTERISTIC
/begin CHARACTERISTIC MoXTrqPtd_tqCrksftRedEmOffs_C "Offset to adjust maximum permitted e-machine torque limit" VALUE 0x8053CD98 Val_Wu16 3276.700 md_q0p1 0.00 3276.700 FORMAT "%8.3" EXTENDED_LIMITS 0.00 6553.500 /end CHARACTERISTIC
/begin MEASUREMENT MoFClth_flgClthStrkFlt "Flag to indicate clutch stroke error" UBYTE B_TRUE 1 100 0.00 1.00000000000 BIT_MASK 0x1 FORMAT "%13.11" ECU_ADDRESS 0x60011EC2 /end MEASUREMENT
/begin MEASUREMENT MoFCoOfs_rTrqPtd "permissible inner engine torque" UBYTE rel_q0p39 1 100 0.00 99.61 FORMAT "%5.2" ECU_ADDRESS 0x60011F67 /end MEASUREMENT
/begin MEASUREMENT MoFCoOfs_rTrqPtdCpl "double storage of permissible inner engine torque" UBYTE OneToOne 1 100 0.00 255.0 FORMAT "%5.1" ECU_ADDRESS 0x600118B0 /end MEASUREMENT
/begin MEASUREMENT MoFDrvPrgSwtCo_bbOut1Cpl "double storage variable for MoFDrvPrgSwtCo_bbOut1" UBYTE OneToOne 1 100 0.00 255.0 FORMAT "%5.1" ECU_ADDRESS 0x6001180A /end MEASUREMENT
/begin MEASUREMENT MoFStrtIn_bbLoc1Cpl "Complement of MoFStrtIn_bbLoc1" UBYTE OneToOne 1 100 0.00 255.0 FORMAT "%5.1" ECU_ADDRESS 0x6001190B /end MEASUREMENT
/begin MEASUREMENT MoFStrtIn_bbOut1Cpl "duplicate storage of MoFStrtIn_bbOut1" UBYTE OneToOne 1 100 0.00 255.0 FORMAT "%5.1" ECU_ADDRESS 0x6001190A /end MEASUREMENT
/begin MEASUREMENT MoFStrt_cntrStrtRels "Error counter for debouncing Starter release" UBYTE OneToOne 1 100 0.00 255.0 FORMAT "%5.1" ECU_ADDRESS 0x60011FBD /end MEASUREMENT
/begin MEASUREMENT MoFStrt_cntrStrtRelsCpl "RAM data redundancy for MoFStrt_cntrStrtRls" UBYTE OneToOne 1 100 0.00 255.0 FORMAT "%5.1" ECU_ADDRESS 0x600118FD /end MEASUREMENT
/begin MEASUREMENT MoFStrt_cntrUnderVltg "Counter for delay of start release deactivation in case of undervoltage situation" UBYTE OneToOne 1 100 0.00 255.0 FORMAT "%5.1" ECU_ADDRESS 0x60011FCA /end MEASUREMENT
/begin MEASUREMENT MoFStrt_cntrUnderVltgCpl "Complement of MoFStrt_cntrUnderVltg" UBYTE OneToOne 1 100 0.00 255.0 FORMAT "%5.1" ECU_ADDRESS 0x60011909 /end MEASUREMENT
/begin MEASUREMENT MoFStrt_ctDebClthImpsOff "Debounce counter for clutch implausibility check healing" UBYTE OneToOne 1 100 0.00 255.0 FORMAT "%5.1" ECU_ADDRESS 0x60011FC9 /end MEASUREMENT
/begin MEASUREMENT MoFStrt_ctDebClthImpsOffCpl "Complement of MoFStrt_ctDebClthImpsOff" UBYTE OneToOne 1 100 0.00 255.0 FORMAT "%5.1" ECU_ADDRESS 0x60011908 /end MEASUREMENT
/begin MEASUREMENT MoFStrt_ctDebClthImpsOn "Debounce counter for clutch implausibility check" UBYTE OneToOne 1 100 0.00 255.0 FORMAT "%5.1" ECU_ADDRESS 0x60011FC8 /end MEASUREMENT
/begin MEASUREMENT MoFStrt_ctDebClthImpsOnCpl "Complement of MoFStrt_ctDebClthImpsOn" UBYTE OneToOne 1 100 0.00 255.0 FORMAT "%5.1" ECU_ADDRESS 0x60011907 /end MEASUREMENT
/begin MEASUREMENT MoFStrt_ctDebPushBtn "Debounce counter for pusch button signal debouncin" UBYTE OneToOne 1 100 0.00 255.0 FORMAT "%5.1" ECU_ADDRESS 0x60011FC7 /end MEASUREMENT
/begin MEASUREMENT MoFStrt_ctDebPushBtnCpl "Double storage for debounce counter for pusch button signal debouncing" UBYTE OneToOne 1 100 0.00 255.0 FORMAT "%5.1" ECU_ADDRESS 0x60011906 /end MEASUREMENT
/begin MEASUREMENT MoFStrt_ctDebT50 "Debounce counter for T50 signal debouncing" UBYTE OneToOne 1 100 0.00 255.0 FORMAT "%5.1" ECU_ADDRESS 0x60011FC6 /end MEASUREMENT
/begin MEASUREMENT MoFStrt_ctDebT50Cpl "Complement variable for MoFStrt_ctDebT50" UBYTE OneToOne 1 100 0.00 255.0 FORMAT "%5.1" ECU_ADDRESS 0x60011905 /end MEASUREMENT
/begin MEASUREMENT MoFStrt_ctHWBrkDeactvnDly "Debounce counter for brake deactivation for T50 Start" UBYTE OneToOne 1 100 0.00 255.0 FORMAT "%5.1" ECU_ADDRESS 0x60011FC5 /end MEASUREMENT
/begin MEASUREMENT MoFStrt_ctHWBrkDeactvnDlyCpl "Complement of MoFStrt_ctHWBrkDeactvnDly" UBYTE OneToOne 1 100 0.00 255.0 FORMAT "%5.1" ECU_ADDRESS 0x60011904 /end MEASUREMENT
/begin MEASUREMENT MoFStrt_flgBrkHldActv "Flag Brake Hold active" UBYTE B_TRUE 1 100 0.00 1.00000000000 BIT_MASK 0x1 FORMAT "%13.11" ECU_ADDRESS 0x60011FC0 /end MEASUREMENT
/begin MEASUREMENT MoFStrt_flgClthSwtImps "Clutch implausibility flag" UBYTE B_TRUE 1 100 0.00 1.00000000000 BIT_MASK 0x4 FORMAT "%13.11" ECU_ADDRESS 0x60011FC0 /end MEASUREMENT
/begin MEASUREMENT MoFStrt_flgDioStrtNeutrGearErr "Flag for error indication of neutral gear digital pin input" UBYTE B_TRUE 1 100 0.00 1.00000000000 BIT_MASK 0x2 FORMAT "%13.11" ECU_ADDRESS 0x60011FCB /end MEASUREMENT
/begin MEASUREMENT MoFStrt_flgDioT50Err "Flag for error indication of T50 digital pin input" UBYTE B_TRUE 1 100 0.00 1.00000000000 BIT_MASK 0x4 FORMAT "%13.11" ECU_ADDRESS 0x60011FCB /end MEASUREMENT
/begin MEASUREMENT MoFStrt_flgIrrvErrStrtRlsMsg "Irreversible error bit of the powertrain active" UBYTE B_TRUE 1 100 0.00 1.00000000000 BIT_MASK 0x1 FORMAT "%13.11" ECU_ADDRESS 0x700006C5 /end MEASUREMENT
/begin MEASUREMENT MoFStrt_flgMonDisbl "Flag to Disable Monitoring" UBYTE B_TRUE 1 100 0.00 1.00000000000 BIT_MASK 0x2 FORMAT "%13.11" ECU_ADDRESS 0x60011FC0 /end MEASUREMENT
/begin MEASUREMENT MoFStrt_flgSTSwitch "Flag ST Switch active" UBYTE B_TRUE 1 100 0.00 1.00000000000 BIT_MASK 0x20 FORMAT "%13.11" ECU_ADDRESS 0x60011FCB /end MEASUREMENT
/begin MEASUREMENT MoFStrt_flgSTSwitchRaw "Raw signal of ST Switch PIN (ST PIN indicates that gear lever is in P or N position)" UBYTE B_TRUE 1 100 0.00 1.00000000000 BIT_MASK 0x8 FORMAT "%13.11" ECU_ADDRESS 0x60011FC0 /end MEASUREMENT
/begin MEASUREMENT MoFStrt_flgT50 "T50 condition" UBYTE B_TRUE 1 100 0.00 1.00000000000 BIT_MASK 0x40 FORMAT "%13.11" ECU_ADDRESS 0x60011FCB /end MEASUREMENT
/begin MEASUREMENT MoFStrt_flgTmpErrStrtRels_MP "Status of Debouncing Plausible error in Starter release" UBYTE B_TRUE 1 100 0.00 1.00000000000 BIT_MASK 0x1 FORMAT "%13.11" ECU_ADDRESS 0x70008BE2 /end MEASUREMENT
/begin MEASUREMENT MoFStrt_flgTMStrtEna "Start enable information related to transmission" UBYTE B_TRUE 1 100 0.00 1.00000000000 BIT_MASK 0x1 FORMAT "%13.11" ECU_ADDRESS 0x60011FCB /end MEASUREMENT
/begin MEASUREMENT MoFStrt_flgTstStrtRlsMsg "Irreversible error bit of the powertrain active" UBYTE B_TRUE 1 100 0.00 1.00000000000 BIT_MASK 0x1 FORMAT "%13.11" ECU_ADDRESS 0x700006C4 /end MEASUREMENT
/begin MEASUREMENT MoFStrt_stDioStrtNeutrGear "Status for indication of neutral gear digital pin input" UBYTE OneToOne 1 100 0.00 255.0 FORMAT "%5.1" ECU_ADDRESS 0x60011FC4 /end MEASUREMENT
/begin MEASUREMENT MoFStrt_stDioStrtNeutrGearCpl "Double storage for debounce counter for MoFStrt_stDioStrtNeutrGear" UBYTE OneToOne 1 100 0.00 255.0 FORMAT "%5.1" ECU_ADDRESS 0x60011903 /end MEASUREMENT
/begin MEASUREMENT MoFStrt_stFFPushBtn "Status of push button release" UBYTE OneToOne 1 100 0.00 255.0 FORMAT "%5.1" ECU_ADDRESS 0x60011FBF /end MEASUREMENT
/begin MEASUREMENT MoFStrt_stFFPushBtnCpl "Double storage for status of push button release" UBYTE OneToOne 1 100 0.00 255.0 FORMAT "%5.1" ECU_ADDRESS 0x60011902 /end MEASUREMENT
/begin MEASUREMENT MoFStrt_stHWBrkDeactvnDlyMem "Debounce state for brake release delay" UBYTE OneToOne 1 100 0.00 255.0 FORMAT "%5.1" ECU_ADDRESS 0x60011FC3 /end MEASUREMENT
/begin MEASUREMENT MoFStrt_stHWBrkDeactvnDlyMemCpl "RAM data redundancy for MoFStrt_stHWBrkDeactvnDlyMem" UBYTE OneToOne 1 100 0.00 255.0 FORMAT "%5.1" ECU_ADDRESS 0x60011901 /end MEASUREMENT
/begin MEASUREMENT MoFStrt_stStrtMsg "state:powertrain active in function monitoring" UBYTE OneToOne 1 100 0.00 255.0 FORMAT "%5.1" ECU_ADDRESS 0x6000A32C /end MEASUREMENT
/begin MEASUREMENT MoFStrt_stT50 "Status of debounce T50 signal" UBYTE OneToOne 1 100 0.00 255.0 FORMAT "%5.1" ECU_ADDRESS 0x60011FBE /end MEASUREMENT
/begin MEASUREMENT MoFStrt_stT50Cpl "Complement variable for MoFStrt_stT50" UBYTE OneToOne 1 100 0.00 255.0 FORMAT "%5.1" ECU_ADDRESS 0x60011900 /end MEASUREMENT
/begin MEASUREMENT MoFStrt_stT50DebMem "Memory for debounce" UBYTE OneToOne 1 100 0.00 255.0 FORMAT "%5.1" ECU_ADDRESS 0x60011FC2 /end MEASUREMENT
/begin MEASUREMENT MoFStrt_stT50DebMemCpl "RAM data redundancy for MoFStrt_stT50DebMem" UBYTE OneToOne 1 100 0.00 255.0 FORMAT "%5.1" ECU_ADDRESS 0x600118FF /end MEASUREMENT
/begin MEASUREMENT MoFStrt_stT50Raw "raw signal T50" UBYTE OneToOne 1 100 0.00 255.0 FORMAT "%5.1" ECU_ADDRESS 0x60011FC1 /end MEASUREMENT
/begin MEASUREMENT MoFStrt_stT50RawCpl "RAM data redundancy for MoFStrt_stT50Raw" UBYTE OneToOne 1 100 0.00 255.0 FORMAT "%5.1" ECU_ADDRESS 0x600118FE /end MEASUREMENT
/begin MEASUREMENT MoFTEngCo_bbLoc1Cpl "bit compl" UBYTE OneToOne 1 100 0.00 255.0 FORMAT "%5.1" ECU_ADDRESS 0x600118FC /end MEASUREMENT
/begin MEASUREMENT MoFTEng_mfVal "Mass Flow value in MoFTEng" UBYTE m_ub_b1020 1 100 0.00 1020. FORMAT "%5.0" ECU_ADDRESS 0x60011FBB /end MEASUREMENT
/begin MEASUREMENT MoFTEng_mfValCpl "Cpl of Mass Flow value in MoFTEng" UBYTE OneToOne 1 100 0.00 255.0 FORMAT "%5.1" ECU_ADDRESS 0x600118FB /end MEASUREMENT
/begin MEASUREMENT MoFTEng_tEng "Engine temperature in level 2" UBYTE Mo_t_DegC_q0p8o48 1 100 -48.0 156.0 FORMAT "%5.1" ECU_ADDRESS 0x60011FB9 /end MEASUREMENT
/begin MEASUREMENT MoFTEng_tEngCpl "Dobbel storage of Engine temperature in level 2" UBYTE OneToOne 1 100 0.00 255.0 FORMAT "%5.1" ECU_ADDRESS 0x600118FA /end MEASUREMENT
/begin MEASUREMENT MoFTraCo_bbOut1Cpl "RAM data redundancy for MoFTraCo_bbOut1" UBYTE OneToOne 1 100 0.00 255.0 FORMAT "%5.1" ECU_ADDRESS 0x600118EB /end MEASUREMENT
/begin MEASUREMENT MoFTra_cntrDebTSCDeactv "Counter deactivation TSC" UBYTE OneToOne 1 100 0.00 255.0 FORMAT "%5.1" ECU_ADDRESS 0x60011FAD /end MEASUREMENT
/begin MEASUREMENT MoFTra_cntrDebTSCDeactvCpl "Dual Storage of MoFTra_cntrDebTSCDeactv" UBYTE OneToOne 1 100 0.00 255.0 FORMAT "%5.1" ECU_ADDRESS 0x600118EA /end MEASUREMENT
/begin MEASUREMENT MoFTra_flgDecIntvActv "decreasing intervention requested by transmission control" UBYTE B_TRUE 1 100 0.00 1.00000000000 BIT_MASK 0x1 FORMAT "%13.11" ECU_ADDRESS 0x60011FAC /end MEASUREMENT
/begin MEASUREMENT MoFTra_flgTSCPtd "permission of gearbox intervention" UBYTE B_TRUE 1 100 0.00 1.00000000000 BIT_MASK 0x2 FORMAT "%13.11" ECU_ADDRESS 0x60011FAC /end MEASUREMENT
/begin MEASUREMENT MoFTra_rTqCnvrBoost "Torque Converter Boost Ratio" UWORD TransR 1 100 0.00 655.3500 FORMAT "%8.4" ECU_ADDRESS 0x60011FAA /end MEASUREMENT
/begin MEASUREMENT MoFTra_rTqCnvrBoostCpl "RAM data redundancy for MoFTra_rTqCnvrBoost" UWORD OneToOne 1 100 0.00 65535.00 FORMAT "%8.2" ECU_ADDRESS 0x600118E8 /end MEASUREMENT
/begin MEASUREMENT MoFTra_tqClthPtd "Permitted clutch torque of transmission intervention" SWORD md_q0p1 1 100 -3276.800 3276.700 FORMAT "%8.3" ECU_ADDRESS 0x60011FA8 /end MEASUREMENT
/begin MEASUREMENT MoFTra_tqClthPtdCpl "Dual storage of MoFTra_tqClthPtd" UWORD OneToOne 1 100 0.00 65535.00 FORMAT "%8.2" ECU_ADDRESS 0x600118E6 /end MEASUREMENT
/begin MEASUREMENT MoFTrqAct_nEng_Ax_result "Supporting coordinate for engine speed during function monitoring" SLONG dez 1 100 -2147483648.00 2147483647.00 FORMAT "%13.2" ECU_ADDRESS 0x60011FA0 /end MEASUREMENT
/begin MEASUREMENT MoFTrqAct_ratFillg_Ax_result "Result of grid search for air charge in function monitoring" SLONG dez 1 100 -2147483648.00 2147483647.00 FORMAT "%13.2" ECU_ADDRESS 0x60011F9C /end MEASUREMENT
/begin MEASUREMENT MoFTrqAct_ratTqInr "current inner torque in the function monitoring" UBYTE rel_q0p39 1 100 0.00 99.61 FORMAT "%5.2" ECU_ADDRESS 0x60011FA6 /end MEASUREMENT
/begin MEASUREMENT MoFTrqAct_ratTqInrCpl "RAM Data redundancy for MoFTrqAct_ratTqInr" UBYTE OneToOne 1 100 0.00 255.0 FORMAT "%5.1" ECU_ADDRESS 0x600118E4 /end MEASUREMENT
/begin MEASUREMENT MoFTrqAct_tqActCmbEng_MP "Inner combustion engine torque in function monitoring" SWORD md_q0p1 1 100 -3276.800 3276.700 FORMAT "%8.3" ECU_ADDRESS 0x70008BE0 /end MEASUREMENT
/begin MEASUREMENT MoFTrqAct_tqCrksftEm "Actual E-machine torque at Crankshaft level" SWORD md_q0p1 1 100 -3276.800 3276.700 FORMAT "%8.3" ECU_ADDRESS 0x60011F98 /end MEASUREMENT
/begin MEASUREMENT MoFTrqAct_tqCrksftEmCpl "RAM data redundancy of MoFTrqAct_tqCrksftEmCpl" UWORD OneToOne 1 100 0.00 65535.00 FORMAT "%8.2" ECU_ADDRESS 0x600118E0 /end MEASUREMENT
/begin MEASUREMENT MoFTrqAct_tqCrksftEmMsg "Actual E-machine torque at Crankshaft level sent as a message from Function monitoring to Level 1" SWORD md_q0p1 1 100 -3276.800 3276.700 FORMAT "%8.3" ECU_ADDRESS 0x60004FF8 /end MEASUREMENT
/begin MEASUREMENT MoFTrqAct_tqSumClu "Sum of Actual Combustion Engine torque and Actual E machine torque at clutch level" SWORD md_q0p1 1 100 -3276.800 3276.700 FORMAT "%8.3" ECU_ADDRESS 0x60011F96 /end MEASUREMENT
/begin MEASUREMENT MoFTrqAct_tqSumCluCpl "RAM data redundancy of MoFTrqAct_tqSumClu" UWORD OneToOne 1 100 0.00 65535.00 FORMAT "%8.2" ECU_ADDRESS 0x600118DE /end MEASUREMENT
/begin MEASUREMENT MoFTrqCmpMax_bbOut1Cpl "RAM data redundancy of MoFTrqCmpMax_bbOut1" UBYTE OneToOne 1 100 0.00 255.0 FORMAT "%5.1" ECU_ADDRESS 0x600118D8 /end MEASUREMENT
/begin MEASUREMENT MoFTrqCmpMin_bbOut1Cpl "RAM data redundancy of MoFTrqCmpMin_bbOut1" UBYTE OneToOne 1 100 0.00 255.0 FORMAT "%5.1" ECU_ADDRESS 0x600118D6 /end MEASUREMENT
/begin MEASUREMENT MoFTrqCmp_cntrTestTqCompMax "Counter for setting of test flag in diagnosis of total torque comparision" UBYTE OneToOne 1 100 0.00 255.0 FORMAT "%5.1" ECU_ADDRESS 0x60006381 /end MEASUREMENT
/begin MEASUREMENT MoFTrqCmp_cntrTestTqCompMin "Counter for setting of test flag in diagnosis of min total torque comparision" UBYTE OneToOne 1 100 0.00 255.0 FORMAT "%5.1" ECU_ADDRESS 0x60006380 /end MEASUREMENT
/begin MEASUREMENT MoFTrqCmp_cntrTqCompMax "Error tolerance time for total torque comparision in function monitoring" UBYTE OneToOne 1 100 0.00 255.0 FORMAT "%5.1" ECU_ADDRESS 0x60011F90 /end MEASUREMENT
/begin MEASUREMENT MoFTrqCmp_cntrTqCompMaxCpl "RAM data redundancy of MoFTrqCmp_cntrTqCompMax" UBYTE OneToOne 1 100 0.00 255.0 FORMAT "%5.1" ECU_ADDRESS 0x600118D7 /end MEASUREMENT
/begin MEASUREMENT MoFTrqCmp_cntrTqCompMin "Error tolerance time for min torque comparision in function monitoring" UBYTE OneToOne 1 100 0.00 255.0 FORMAT "%5.1" ECU_ADDRESS 0x60011F8E /end MEASUREMENT
/begin MEASUREMENT MoFTrqCmp_cntrTqCompMinCpl "RAM data redundancy of MoFTrqCmp_cntrTqCompMin" UBYTE OneToOne 1 100 0.00 255.0 FORMAT "%5.1" ECU_ADDRESS 0x600118D5 /end MEASUREMENT
/begin MEASUREMENT MoFTrqCmp_flgClrEng "Bit in order to delete the Diagnose Information" UBYTE B_TRUE 1 100 0.00 1.00000000000 BIT_MASK 0x1 FORMAT "%13.11" ECU_ADDRESS 0x7000017E /end MEASUREMENT
/begin MEASUREMENT MoFTrqCmp_flgClrMax "Flag to clear the fault memory of the max-torque comparison" UBYTE B_TRUE 1 100 0.00 1.00000000000 BIT_MASK 0x1 FORMAT "%13.11" ECU_ADDRESS 0x7000017D /end MEASUREMENT
/begin MEASUREMENT MoFTrqCmp_flgClrMin "Flag to clear the fault memory of the min-torque comparison" UBYTE B_TRUE 1 100 0.00 1.00000000000 BIT_MASK 0x1 FORMAT "%13.11" ECU_ADDRESS 0x7000017C /end MEASUREMENT
/begin MEASUREMENT MoFTrqCmp_flgErrMaxPndMsg "Error pending flag message in total torque comparision" UBYTE B_TRUE 1 100 0.00 1.00000000000 BIT_MASK 0x1 FORMAT "%13.11" ECU_ADDRESS 0x700006C3 /end MEASUREMENT
/begin MEASUREMENT MoFTrqCmp_flgErrMinPndMsg "Error flag in case of pending error in min torque comparision" UBYTE B_TRUE 1 100 0.00 1.00000000000 BIT_MASK 0x1 FORMAT "%13.11" ECU_ADDRESS 0x700006C2 /end MEASUREMENT
/begin MEASUREMENT MoFTrqCmp_flgIrrvErrEngMsg "irreversible error bit of the torque comparison" UBYTE B_TRUE 1 100 0.00 1.00000000000 BIT_MASK 0x1 FORMAT "%13.11" ECU_ADDRESS 0x700006C1 /end MEASUREMENT
/begin MEASUREMENT MoFTrqCmp_flgIrrvErrMax "Irreversible error bit of the torque comparison" UBYTE B_TRUE 1 100 0.00 1.00000000000 BIT_MASK 0x1 FORMAT "%13.11" ECU_ADDRESS 0x60011F8F /end MEASUREMENT
/begin MEASUREMENT MoFTrqCmp_flgIrrvErrMaxMsg "Irreversible error flag message in total torque comparison" UBYTE B_TRUE 1 100 0.00 1.00000000000 BIT_MASK 0x1 FORMAT "%13.11" ECU_ADDRESS 0x700006C0 /end MEASUREMENT
/begin MEASUREMENT MoFTrqCmp_flgIrrvErrMin "Irreversible error flag of minimal torque comparison" UBYTE B_TRUE 1 100 0.00 1.00000000000 BIT_MASK 0x1 FORMAT "%13.11" ECU_ADDRESS 0x60011F8D /end MEASUREMENT
/begin MEASUREMENT MoFTrqCmp_flgIrrvErrMinMsg "Irreversible error flag in case of min torque comparison" UBYTE B_TRUE 1 100 0.00 1.00000000000 BIT_MASK 0x1 FORMAT "%13.11" ECU_ADDRESS 0x700006BF /end MEASUREMENT
/begin MEASUREMENT MoFTrqCmp_flgTestEngMsg "Bit of test condition on diagnosis error path DFC_MoFTrqCmp" UBYTE B_TRUE 1 100 0.00 1.00000000000 BIT_MASK 0x1 FORMAT "%13.11" ECU_ADDRESS 0x700006BE /end MEASUREMENT
/begin MEASUREMENT MoFTrqCmp_flgTestTqCompMinMsg "Test condition on diagnosis error path DFC_MoFTrqCmpMin" UBYTE B_TRUE 1 100 0.00 1.00000000000 BIT_MASK 0x1 FORMAT "%13.11" ECU_ADDRESS 0x700006BD /end MEASUREMENT
/begin MEASUREMENT MoFTrqCmp_flgTestTrqCmpMaxMsg "Bit of test condition on diagnosis error path" UBYTE B_TRUE 1 100 0.00 1.00000000000 BIT_MASK 0x1 FORMAT "%13.11" ECU_ADDRESS 0x700006BC /end MEASUREMENT
/begin MEASUREMENT MoFTrqLim_tqInrMinWoCtOffMsg "minimal inner torque in the combusted operation in the function monitoring" UBYTE md_q1p6 1 100 0.00 408.0 FORMAT "%5.1" ECU_ADDRESS 0x6000A32A /end MEASUREMENT
/begin MEASUREMENT MoFTrqLos_tqChrgChg_mp "Limited L2 charge change losses" UBYTE md_q1p6 1 100 0.00 408.0 FORMAT "%5.1" ECU_ADDRESS 0x70008BDD /end MEASUREMENT
/begin MEASUREMENT MoFTrqLos_tqConvLd_mp "L2 power train losses after limitimation" UBYTE md_q1p6 1 100 0.00 408.0 FORMAT "%5.1" ECU_ADDRESS 0x70008BDC /end MEASUREMENT
/begin MEASUREMENT MoFTrqLos_tqLosTotMsg "overall losses (drive train, converter, engine and accessories losses)in function monitoring" UBYTE md_q1p6 1 100 0.00 408.0 FORMAT "%5.1" ECU_ADDRESS 0x6000A329 /end MEASUREMENT
/begin MEASUREMENT MoFTrqLos_tqTraLoss_mp "limited value of Tra_trqLos" UBYTE md_q1p6 1 100 0.00 408.0 FORMAT "%5.1" ECU_ADDRESS 0x70008BDB /end MEASUREMENT
/begin MEASUREMENT MoFTrqPtdEmac_bbOut1Cpl "Complement variable for MoFTrqPtdEmac_bbOut1" UBYTE OneToOne 1 100 0.00 255.0 FORMAT "%5.1" ECU_ADDRESS 0x600118C6 /end MEASUREMENT
/begin MEASUREMENT MoFTrqPtd_cntrActvPostBldCfg "Counter for error debounce due to an error in return of the active post-build configuration" UBYTE OneToOne 1 100 0.00 255.0 FORMAT "%5.1" ECU_ADDRESS 0x60011ECD /end MEASUREMENT
/begin MEASUREMENT MoFTrqPtd_cntrActvPostBldCfgCpl "RAM data redundancy of MoFTrqPtd_cntrActvPostBldCfg" UBYTE OneToOne 1 100 0.00 255.0 FORMAT "%5.1" ECU_ADDRESS 0x60011815 /end MEASUREMENT
/begin MEASUREMENT MoFTrqPtd_cntrNegChkPostBldCfg "Counter for error debounce due to an error in the negative check of the post-build configuration" UBYTE OneToOne 1 100 0.00 255.0 FORMAT "%5.1" ECU_ADDRESS 0x60011ECC /end MEASUREMENT
/begin MEASUREMENT MoFTrqPtd_cntrNegChkPostBldCfgCpl "RAM data redundancy of MoFTrqPtd_cntrNegChkPostBldCfg" UBYTE OneToOne 1 100 0.00 255.0 FORMAT "%5.1" ECU_ADDRESS 0x60011814 /end MEASUREMENT
/begin MEASUREMENT MoFTrqPtd_cntrPosChkPostBldCfg "Counter for error debounce due to an error in the positive check of the post-build configuration" UBYTE OneToOne 1 100 0.00 255.0 FORMAT "%5.1" ECU_ADDRESS 0x60011ECB /end MEASUREMENT
/begin MEASUREMENT MoFTrqPtd_cntrPosChkPostBldCfgCpl "RAM data redundancy of MoFTrqPtd_cntrPosChkPostBldCfg" UBYTE OneToOne 1 100 0.00 255.0 FORMAT "%5.1" ECU_ADDRESS 0x60011813 /end MEASUREMENT
/begin MEASUREMENT MoFTrqPtd_cntrStabyChkPostBldCfg "Counter for the error debounce due to changed post-build configuration during driving cycle" UBYTE OneToOne 1 100 0.00 255.0 FORMAT "%5.1" ECU_ADDRESS 0x60011ECA /end MEASUREMENT
/begin MEASUREMENT MoFTrqPtd_cntrStabyChkPostBldCfgCpl "RAM data redundancy of MoFTrqPtd_cntrStabyChkPostBldCfg" UBYTE OneToOne 1 100 0.00 255.0 FORMAT "%5.1" ECU_ADDRESS 0x60011812 /end MEASUREMENT
/begin MEASUREMENT MoFTrqPtd_cntrTestPostBldSel "Counter for setting the testflag in diagnosis of post-build selectable in function monitoring" UBYTE OneToOne 1 100 0.00 255.0 FORMAT "%5.1" ECU_ADDRESS 0x6000637F /end MEASUREMENT
/begin MEASUREMENT MoFTrqPtd_flgAlt "Alternating flag in post-build selectable monitoring" UBYTE B_TRUE 1 100 0.00 1.00000000000 BIT_MASK 0x8 FORMAT "%13.11" ECU_ADDRESS 0x60011EC4 /end MEASUREMENT
/begin MEASUREMENT MoFTrqPtd_flgClrPostBldSel "Condition DSM clearing in MoFVar_PostBldSel in function monitoring" UBYTE B_TRUE 1 100 0.00 1.00000000000 BIT_MASK 0x1 FORMAT "%13.11" ECU_ADDRESS 0x7000017B /end MEASUREMENT
/begin MEASUREMENT MoFTrqPtd_flgComErrDebElDrv "debounced E-Drive communication error in the strategy monitoring" UBYTE B_TRUE 1 100 0.00 1.00000000000 BIT_MASK 0x1 FORMAT "%13.11" ECU_ADDRESS 0x60011F7B /end MEASUREMENT
/begin MEASUREMENT MoFTrqPtd_flgErrActvPostBldCfg "Error during request of post-build index of BSW" UBYTE B_TRUE 1 100 0.00 1.00000000000 BIT_MASK 0x10 FORMAT "%13.11" ECU_ADDRESS 0x60011EC4 /end MEASUREMENT
/begin MEASUREMENT MoFTrqPtd_flgErrDcycStabyChk "Error of monitoring of the post-build variant on stability check over driving cycle" UBYTE B_TRUE 1 100 0.00 1.00000000000 BIT_MASK 0x20 FORMAT "%13.11" ECU_ADDRESS 0x60011EC4 /end MEASUREMENT
/begin MEASUREMENT MoFTrqPtd_flgErrElDrv "debounced error status: E-Drive Failure" UBYTE B_TRUE 1 100 0.00 1.00000000000 BIT_MASK 0x4 FORMAT "%13.11" ECU_ADDRESS 0x60011F7B /end MEASUREMENT
/begin MEASUREMENT MoFTrqPtd_flgErrIvsChkPostBld "Error in inverse check of post-build configuration" UBYTE B_TRUE 1 100 0.00 1.00000000000 BIT_MASK 0x80 FORMAT "%13.11" ECU_ADDRESS 0x60011EC4 /end MEASUREMENT
/begin MEASUREMENT MoFTrqPtd_flgErrPosChk "Wrong return value in positive check of post-build selectable monitoring received" UBYTE B_TRUE 1 100 0.00 1.00000000000 BIT_MASK 0x2 FORMAT "%13.11" ECU_ADDRESS 0x60011EC4 /end MEASUREMENT
/begin MEASUREMENT MoFTrqPtd_flgErrPosChk2 "Wrong return value in positive check of post-build selectable monitoring received" UBYTE B_TRUE 1 100 0.00 1.00000000000 BIT_MASK 0x4 FORMAT "%13.11" ECU_ADDRESS 0x60011EC4 /end MEASUREMENT
/begin MEASUREMENT MoFTrqPtd_flgErrPosChkPostBld "Error in positive check of post-build configuration" UBYTE B_TRUE 1 100 0.00 1.00000000000 BIT_MASK 0x40 FORMAT "%13.11" ECU_ADDRESS 0x60011EC4 /end MEASUREMENT
/begin MEASUREMENT MoFTrqPtd_flgFailErrDebElDrv "debounced error status: E-Drive System Failure" UBYTE B_TRUE 1 100 0.00 1.00000000000 BIT_MASK 0x2 FORMAT "%13.11" ECU_ADDRESS 0x60011F7B /end MEASUREMENT
/begin MEASUREMENT MoFTrqPtd_flgIrrvErrPostBldSel "Irreversible error flag from post-build selectable function monitoring" UBYTE B_TRUE 1 100 0.00 1.00000000000 BIT_MASK 0x1 FORMAT "%13.11" ECU_ADDRESS 0x60011EC3 /end MEASUREMENT
/begin MEASUREMENT MoFTrqPtd_flgIrrvErrPostBldSelMsg "Irreversible error flag from post-build selectable function monitoring to level 1" UBYTE B_TRUE 1 100 0.00 1.00000000000 BIT_MASK 0x1 FORMAT "%13.11" ECU_ADDRESS 0x700006BB /end MEASUREMENT
/begin MEASUREMENT MoFTrqPtd_flgPostBldCfgRxd "Post-build configuration from BSW overtaken to level 2 variable" UBYTE B_TRUE 1 100 0.00 1.00000000000 BIT_MASK 0x1 FORMAT "%13.11" ECU_ADDRESS 0x60011EC4 /end MEASUREMENT
/begin MEASUREMENT MoFTrqPtd_flgTqEmLimdMsg "Flag Message to indicate that the E-machine torque is beyond monitoring limits" UBYTE B_TRUE 1 100 0.00 1.00000000000 BIT_MASK 0x1 FORMAT "%13.11" ECU_ADDRESS 0x700006BA /end MEASUREMENT
/begin MEASUREMENT MoFTrqPtd_idxPostBldCfg "Active post-build configuration from BSW" UBYTE OneToOne 1 100 0.00 255.0 FORMAT "%5.1" ECU_ADDRESS 0x60011EC9 /end MEASUREMENT
/begin MEASUREMENT MoFTrqPtd_idxPostBldCfgCpl "RAM data redundancy of MoFTrqPtd_idxPostBldCfg" UBYTE OneToOne 1 100 0.00 255.0 FORMAT "%5.1" ECU_ADDRESS 0x60011811 /end MEASUREMENT
/begin MEASUREMENT MoFTrqPtd_idxPostBldCfgIni "After initialization in level 2 stored post-build configuration" UBYTE OneToOne 1 100 0.00 255.0 FORMAT "%5.1" ECU_ADDRESS 0x60011EC8 /end MEASUREMENT
/begin MEASUREMENT MoFTrqPtd_idxPostBldCfgIniCpl "RAM data redundancy of MoFTrqPtd_idxPostBldCfgIni" UBYTE OneToOne 1 100 0.00 255.0 FORMAT "%5.1" ECU_ADDRESS 0x60011810 /end MEASUREMENT
/begin MEASUREMENT MoFTrqPtd_rTrqPtdFltWoOffs "Permitted filtered torque ratio with offset" UBYTE rel_q0p39 1 100 0.00 99.61 FORMAT "%5.2" ECU_ADDRESS 0x60011F68 /end MEASUREMENT
/begin MEASUREMENT MoFTrqPtd_rTrqPtdFltWoOffsCpl "RAM data redundancy of MoFTrqPtd_rTrqPtdFltWoOffs" UBYTE OneToOne 1 100 0.00 255.0 FORMAT "%5.1" ECU_ADDRESS 0x600118AF /end MEASUREMENT
/begin MEASUREMENT MoFTrqPtd_stActvPostBldVrntIdx "Return value of the callback function EcuM_RbMoGetActivePostBuildVariantIndex" UBYTE OneToOne 1 100 0.00 255.0 FORMAT "%5.1" ECU_ADDRESS 0x60011EC7 /end MEASUREMENT
/begin MEASUREMENT MoFTrqPtd_stActvPostBldVrntIdxCpl "Complement of the return value of the callback function EcuM_RbMoGetActivePostBuildVariantIndex" UBYTE OneToOne 1 100 0.00 255.0 FORMAT "%5.1" ECU_ADDRESS 0x6001180F /end MEASUREMENT
/begin MEASUREMENT MoFTrqPtd_stMonIninChk "Return value of the callback function EcuM_RbMoInitCheck" UBYTE OneToOne 1 100 0.00 255.0 FORMAT "%5.1" ECU_ADDRESS 0x60011EC6 /end MEASUREMENT
/begin MEASUREMENT MoFTrqPtd_stMonIninChkCpl "Complement of the return value of the callback function EcuM_RbMoInitCheck" UBYTE OneToOne 1 100 0.00 255.0 FORMAT "%5.1" ECU_ADDRESS 0x6001180E /end MEASUREMENT
/begin MEASUREMENT MoFTrqPtd_stMonIninChkIvs "Return value of the callback function EcuM_RbMoInitCheckInverse" UBYTE OneToOne 1 100 0.00 255.0 FORMAT "%5.1" ECU_ADDRESS 0x60011EC5 /end MEASUREMENT
/begin MEASUREMENT MoFTrqPtd_stMonIninChkIvsCpl "Complement of the return value of the callback function EcuM_RbMoInitCheckInverse" UBYTE OneToOne 1 100 0.00 255.0 FORMAT "%5.1" ECU_ADDRESS 0x6001180D /end MEASUREMENT
/begin MEASUREMENT MoFTrqPtd_stOperModDesElDrv "e-drive operating mode request" UBYTE OneToOne 1 100 0.00 255.0 FORMAT "%5.1" ECU_ADDRESS 0x60011F7A /end MEASUREMENT
/begin MEASUREMENT MoFTrqPtd_stOperModDesElDrvCpl "RAM data redundancy for MoFTrqPtd_stOperModDesElDrv" UBYTE OneToOne 1 100 0.00 255.0 FORMAT "%5.1" ECU_ADDRESS 0x600118C5 /end MEASUREMENT
/begin MEASUREMENT MoFTrqPtd_stOperModDesElDrvMsg "E-drive operating mode request message" UBYTE OneToOne 1 100 0.00 255.0 FORMAT "%5.1" ECU_ADDRESS 0x6000A328 /end MEASUREMENT
/begin MEASUREMENT MoFTrqPtd_tiDebComErrElDrv "Debouncing time for detecting E-Drive communication error" UBYTE t_q0p01 1 100 0.00 2.550 FORMAT "%5.3" ECU_ADDRESS 0x60011F7E /end MEASUREMENT
/begin MEASUREMENT MoFTrqPtd_tiDebComErrElDrvCpl "RAM data redundancy for MoFTrqPtd_tiDebComErrElDrv" UBYTE OneToOne 1 100 0.00 255.0 FORMAT "%5.1" ECU_ADDRESS 0x600118C4 /end MEASUREMENT
/begin MEASUREMENT MoFTrqPtd_tiDebIrrvCmpErr "debounce time counter after irreversible torque comparision error was detected" UBYTE t_q0p01 1 100 0.00 2.550 FORMAT "%5.3" ECU_ADDRESS 0x60011F7D /end MEASUREMENT
/begin MEASUREMENT MoFTrqPtd_tiDebIrrvCmpErrCpl "RAM data redundancy for MoFTrqPtd_tiDebIrrvCmpErr" UBYTE OneToOne 1 100 0.00 255.0 FORMAT "%5.1" ECU_ADDRESS 0x600118C3 /end MEASUREMENT
/begin MEASUREMENT MoFTrqPtd_tiDebIrvErrElDrv "Debouncing time for detecting E-Drive failure error" UBYTE t_q0p01 1 100 0.00 2.550 FORMAT "%5.3" ECU_ADDRESS 0x60011F7C /end MEASUREMENT
/begin MEASUREMENT MoFTrqPtd_tiDebIrvErrElDrvCpl "RAM data redundancy for MoFTrqPtd_tiDebIrvErrElDrv" UBYTE OneToOne 1 100 0.00 255.0 FORMAT "%5.1" ECU_ADDRESS 0x600118C2 /end MEASUREMENT
/begin MEASUREMENT MoFTrqPtd_tqCluSumPtd "Sum Permitted torque at clutch level" SWORD md_q0p1 1 100 -3276.800 3276.700 FORMAT "%8.3" ECU_ADDRESS 0x60011F64 /end MEASUREMENT
/begin MEASUREMENT MoFTrqPtd_tqCluSumPtdCpl "RAM data redundancy of MoFTrqPtd_tqCluSumPtd" UWORD OneToOne 1 100 0.00 65535.00 FORMAT "%8.2" ECU_ADDRESS 0x600118AC /end MEASUREMENT
/begin MEASUREMENT MoFTrqPtd_tqCluSumPtdFild "Permitted inner sum torque including disturbance controller torque" SWORD md_q0p1 1 100 -3276.800 3276.700 FORMAT "%8.3" ECU_ADDRESS 0x60011F1E /end MEASUREMENT
/begin MEASUREMENT MoFTrqPtd_tqCluSumPtdFildAry "Array for deathtime functionality of filter" SWORD md_q0p1 1 100 -3276.800 3276.700 FORMAT "%8.3" ARRAY_SIZE 32 ECU_ADDRESS 0x60011EDE /end MEASUREMENT
/begin MEASUREMENT MoFTrqPtd_tqCluSumPtdFildAryCpl "Cpl Array for deathtime functionality of filter" UWORD OneToOne 1 100 0.00 65535.00 FORMAT "%8.2" ARRAY_SIZE 32 ECU_ADDRESS 0x60011828 /end MEASUREMENT
/begin MEASUREMENT MoFTrqPtd_tqCluSumPtdFildCpl "Complement of MoFTrqPtd_tqCluSumPtdFild" UWORD OneToOne 1 100 0.00 65535.00 FORMAT "%8.2" ECU_ADDRESS 0x60011826 /end MEASUREMENT
/begin MEASUREMENT MoFTrqPtd_tqCluSumPtdFildOffs "Permitted filtered inner sum torque with disturbance controller output and offset" SWORD md_q0p1 1 100 -3276.800 3276.700 FORMAT "%8.3" ECU_ADDRESS 0x60011EDC /end MEASUREMENT
/begin MEASUREMENT MoFTrqPtd_tqCluSumPtdFildOffsCpl "Complement of MoFTrqPtd_tqCluSumPtdFildOffs" UWORD OneToOne 1 100 0.00 65535.00 FORMAT "%8.2" ECU_ADDRESS 0x60011824 /end MEASUREMENT
/begin MEASUREMENT MoFTrqPtd_tqCluSumPtdFildRaw "Permitted filtered inner sum torque without disturbance controller output and without offset" SWORD md_q0p1 1 100 -3276.800 3276.700 FORMAT "%8.3" ECU_ADDRESS 0x60011EDA /end MEASUREMENT
/begin MEASUREMENT MoFTrqPtd_tqCluSumPtdFildRawCpl "Complement of MoFTrqPtd_tqCluSumPtdFildRaw" UWORD OneToOne 1 100 0.00 65535.00 FORMAT "%8.2" ECU_ADDRESS 0x60011822 /end MEASUREMENT
/begin MEASUREMENT MoFTrqPtd_tqCluSumPtdUnfild "permitted unfiltered sum torque at clutch level with all interventions in function monitoring" SWORD md_q0p1 1 100 -3276.800 3276.700 FORMAT "%8.3" ECU_ADDRESS 0x60011ED8 /end MEASUREMENT
/begin MEASUREMENT MoFTrqPtd_tqCluSumPtdUnfildCpl "Complement of MoFTrqPtd_tqCluSumPtdUnfild" UWORD OneToOne 1 100 0.00 65535.00 FORMAT "%8.2" ECU_ADDRESS 0x60011820 /end MEASUREMENT
/begin MEASUREMENT MoFTrqPtd_tqCmpNotSwilLoss "permitted loss compensation torque of not switchable losses" UBYTE md_q1p6 1 100 0.00 408.0 FORMAT "%5.1" ECU_ADDRESS 0x60011F8A /end MEASUREMENT
/begin MEASUREMENT MoFTrqPtd_tqCmpNotSwilLossCpl "RAM data redundancy for MoFTrqPtd_tqCmpNotSwilLoss" UBYTE OneToOne 1 100 0.00 255.0 FORMAT "%5.1" ECU_ADDRESS 0x600118D2 /end MEASUREMENT
/begin MEASUREMENT MoFTrqPtd_tqCmpSwilLoss "Compensatable torque of the switchable losses in function monitoring" UBYTE md_q1p6 1 100 0.00 408.0 FORMAT "%5.1" ECU_ADDRESS 0x60011F89 /end MEASUREMENT
/begin MEASUREMENT MoFTrqPtd_tqCmpSwilLossCpl "RAM data redundancy for MoFTrqPtd_tqCmpSwilLoss" UBYTE OneToOne 1 100 0.00 255.0 FORMAT "%5.1" ECU_ADDRESS 0x600118D1 /end MEASUREMENT
/begin MEASUREMENT MoFTrqPtd_tqCompMsg "Message to MoX: compensated loss torque" SWORD md_q0p1 1 100 -3276.800 3276.700 FORMAT "%8.3" ECU_ADDRESS 0x60004FF6 /end MEASUREMENT
/begin MEASUREMENT MoFTrqPtd_tqCrksftEmMinFild "filtered permitted minimum e-machine torque without offset" SWORD md_q0p1 1 100 -3276.800 3276.700 FORMAT "%8.3" ECU_ADDRESS 0x60011ED6 /end MEASUREMENT
/begin MEASUREMENT MoFTrqPtd_tqCrksftEmMinFildCpl "Complement of MoFTrqPtd_tqCrksftEmMinFild" UWORD OneToOne 1 100 0.00 65535.00 FORMAT "%8.2" ECU_ADDRESS 0x6001181E /end MEASUREMENT
/begin MEASUREMENT MoFTrqPtd_tqCrksftEmMinFildOffs "filtered permitted minimum e-machine torque with offset" SWORD md_q0p1 1 100 -3276.800 3276.700 FORMAT "%8.3" ECU_ADDRESS 0x60011ED4 /end MEASUREMENT
/begin MEASUREMENT MoFTrqPtd_tqCrksftEmMinFildOffsCpl "Complement of MoFTrqPtd_tqCrksftEmMinFildOffs" UWORD OneToOne 1 100 0.00 65535.00 FORMAT "%8.2" ECU_ADDRESS 0x6001181C /end MEASUREMENT
/begin MEASUREMENT MoFTrqPtd_tqCrksftMaxEmOperMod "Maximum permitted e-machine torque on crankshaft level according to the current operating mode" SWORD md_q0p1 1 100 -3276.800 3276.700 FORMAT "%8.3" ECU_ADDRESS 0x60011F76 /end MEASUREMENT
/begin MEASUREMENT MoFTrqPtd_tqCrksftMaxEmOperModCpl "RAM data redundancy of MoFTrqPtd_tqCrksftMaxEmOperMod" UWORD OneToOne 1 100 0.00 65535.00 FORMAT "%8.2" ECU_ADDRESS 0x600118C0 /end MEASUREMENT
/begin MEASUREMENT MoFTrqPtd_tqCrsEM "permitted torque demand: electrical drive (crankshaft level)" SWORD md_q0p1 1 100 -3276.800 3276.700 FORMAT "%8.3" ECU_ADDRESS 0x60011F74 /end MEASUREMENT
/begin MEASUREMENT MoFTrqPtd_tqCrsEMCpl "RAM data redundancy for MoFTrqPtd_tqCrsEM" UWORD OneToOne 1 100 0.00 65535.00 FORMAT "%8.2" ECU_ADDRESS 0x600118BE /end MEASUREMENT
/begin MEASUREMENT MoFTrqPtd_tqCrsEmMaxMsg "Maximum permitted E-Machine torque on Crankshaft level, Message to L1" SWORD md_q0p1 1 100 -3276.800 3276.700 FORMAT "%8.3" ECU_ADDRESS 0x60004FF2 /end MEASUREMENT
/begin MEASUREMENT MoFTrqPtd_tqCrsEmMinMsg "Minimum permitted E-Machine torque on Crankshaft level, Message to L1" SWORD md_q0p1 1 100 -3276.800 3276.700 FORMAT "%8.3" ECU_ADDRESS 0x60004FF0 /end MEASUREMENT
/begin MEASUREMENT MoFTrqPtd_tqCrsEMMsg "permitted torque demand: electrical drive (crankshaft level) for Level 1" SWORD md_q0p1 1 100 -3276.800 3276.700 FORMAT "%8.3" ECU_ADDRESS 0x60004FF4 /end MEASUREMENT
/begin MEASUREMENT MoFTrqPtd_tqCrsMinEM "minimum permited e-machine torque on crankshaft level" SWORD md_q0p1 1 100 -3276.800 3276.700 FORMAT "%8.3" ECU_ADDRESS 0x60011F72 /end MEASUREMENT
/begin MEASUREMENT MoFTrqPtd_tqCrsMinEMCpl "Complement variable for MoFTrqPtd_tqCrsMinEM" UWORD OneToOne 1 100 0.00 65535.00 FORMAT "%8.2" ECU_ADDRESS 0x600118BC /end MEASUREMENT
/begin MEASUREMENT MoFTrqPtd_tqEM "E-drive torque demand for level 2 (E-drive level)" SWORD md_q0p1 1 100 -3276.800 3276.700 FORMAT "%8.3" ECU_ADDRESS 0x60011F70 /end MEASUREMENT
/begin MEASUREMENT MoFTrqPtd_tqEMCpl "RAM data redundancy for MoFTrqPtd_tqEM" UWORD OneToOne 1 100 0.00 65535.00 FORMAT "%8.2" ECU_ADDRESS 0x600118BA /end MEASUREMENT
/begin MEASUREMENT MoFTrqPtd_tqEmMsg "E-drive torque demand for level 2 (E-drive level) message" SWORD RBPtCel_tq_0p5_1 1 100 -16384.00 16383.50 FORMAT "%8.2" ECU_ADDRESS 0x60004FEE /end MEASUREMENT
/begin MEASUREMENT MoFTrqPtd_tqInnrPtdFild "Filtered inner permitted torque" SWORD md_q0p1 1 100 -3276.800 3276.700 FORMAT "%8.3" ECU_ADDRESS 0x60011F62 /end MEASUREMENT
/begin MEASUREMENT MoFTrqPtd_tqInnrPtdFildAry "Array for deathtime functionality of filter" SWORD md_q0p1 1 100 -3276.800 3276.700 FORMAT "%8.3" ARRAY_SIZE 32 ECU_ADDRESS 0x60011F22 /end MEASUREMENT
/begin MEASUREMENT MoFTrqPtd_tqInnrPtdFildAryCpl "Cpl Array for deathtime functionality of filter" UWORD OneToOne 1 100 0.00 65535.00 FORMAT "%8.2" ARRAY_SIZE 32 ECU_ADDRESS 0x6001186C /end MEASUREMENT
/begin MEASUREMENT MoFTrqPtd_tqInnrPtdFildCpl "RAM data redundancy of MoFTrqPtd_tqInnrPtdFild" UWORD OneToOne 1 100 0.00 65535.00 FORMAT "%8.2" ECU_ADDRESS 0x6001186A /end MEASUREMENT
/begin MEASUREMENT MoFTrqPtd_tqInrPtd "inner permissible torque in function monitoring" SWORD md_q0p1 1 100 -3276.800 3276.700 FORMAT "%8.3" ECU_ADDRESS 0x60011F20 /end MEASUREMENT
/begin MEASUREMENT MoFTrqPtd_tqInrPtdCpl "RAM data redundancy for MoFTrqPtd_tqInrPtd" UWORD OneToOne 1 100 0.00 65535.00 FORMAT "%8.2" ECU_ADDRESS 0x60011868 /end MEASUREMENT
/begin MEASUREMENT MoFTrqPtd_tqInrPtdMsg "Message to Level1: permitted inner combustion engine torque" SWORD md_q0p1 1 100 -3276.800 3276.700 FORMAT "%8.3" ECU_ADDRESS 0x60004FEC /end MEASUREMENT
/begin MEASUREMENT MoFTrqPtd_tqMaxEm "Permitted maximum e?machine torque on e-machine level" SWORD md_q0p1 1 100 -3276.800 3276.700 FORMAT "%8.3" ECU_ADDRESS 0x60011F6E /end MEASUREMENT
/begin MEASUREMENT MoFTrqPtd_tqMaxEmCpl "RAM data redundancy of MoFTrqPtd_tqMaxEm" UWORD OneToOne 1 100 0.00 65535.00 FORMAT "%8.2" ECU_ADDRESS 0x600118B8 /end MEASUREMENT
/begin MEASUREMENT MoFTrqPtd_tqMaxEmMsg "Permitted maximum e-machine torque on e-machine level Message" SWORD md_q0p1 1 100 -3276.800 3276.700 FORMAT "%8.3" ECU_ADDRESS 0x60004FEA /end MEASUREMENT
/begin MEASUREMENT MoFTrqPtd_tqMinEM "minimum permitted e-machine torque" SWORD md_q0p1 1 100 -3276.800 3276.700 FORMAT "%8.3" ECU_ADDRESS 0x60011F6C /end MEASUREMENT
/begin MEASUREMENT MoFTrqPtd_tqMinEMCpl "Complement variable for MoFTrqPtd_tqMinEM" UWORD OneToOne 1 100 0.00 65535.00 FORMAT "%8.2" ECU_ADDRESS 0x600118B6 /end MEASUREMENT
/begin MEASUREMENT MoFTrqPtd_tqMinEmMsg "minimum permitted e-machine torque message" SWORD md_q0p1 1 100 -3276.800 3276.700 FORMAT "%8.3" ECU_ADDRESS 0x60004FE8 /end MEASUREMENT
/begin MEASUREMENT MoFTrqPtd_tqSelCrksftMaxEm "Maximum permitted e-machine torque according to the current operating mode, limitations from L1 and specified upper e-machine limit." SWORD md_q0p1 1 100 -3276.800 3276.700 FORMAT "%8.3" ECU_ADDRESS 0x60011F78 /end MEASUREMENT
/begin MEASUREMENT MoFTrqPtd_tqSelCrksftMaxEmCpl "RAM data redundancy of MoFTrqPtd_tqSelCrksftMaxEm" UWORD OneToOne 1 100 0.00 65535.00 FORMAT "%8.2" ECU_ADDRESS 0x600118B4 /end MEASUREMENT
/begin MEASUREMENT MoFTrqPtd_tqSelEM "maximum allowed e-maschine torque (failure free mode)" SWORD md_q0p1 1 100 -3276.800 3276.700 FORMAT "%8.3" ECU_ADDRESS 0x60011F6A /end MEASUREMENT
/begin MEASUREMENT MoFTrqPtd_tqSelEMCpl "Complement variable for MoFTrqPtd_tqSelEM" UWORD OneToOne 1 100 0.00 65535.00 FORMAT "%8.2" ECU_ADDRESS 0x600118B2 /end MEASUREMENT
/begin MEASUREMENT MoFTrqRat_ratTqPTPlaus "Plausible powertrain transmission ratio in the function monitoring" SWORD fak_q0p01 1 100 -327.6800 327.6700 FORMAT "%8.4" ECU_ADDRESS 0x60011EC0 /end MEASUREMENT
/begin MEASUREMENT MoFTrqRat_ratTqPTPlausCpl "Double storage for Plausible powertrain transmission ratio in the function monitoring" UWORD OneToOne 1 100 0.00 65535.00 FORMAT "%8.2" ECU_ADDRESS 0x60011808 /end MEASUREMENT
/begin MEASUREMENT MoFTrqRat_rTrqPT "Power train ratio in function monitoring" SWORD fak_q0p01 1 100 -327.6800 327.6700 FORMAT "%8.4" ECU_ADDRESS 0x60011ED2 /end MEASUREMENT
/begin MEASUREMENT MoFTrqRat_rTrqPTCpl "Double storage for MoFTrqRat_rTrqPT" UWORD OneToOne 1 100 0.00 65535.00 FORMAT "%8.2" ECU_ADDRESS 0x6001181A /end MEASUREMENT
/begin MEASUREMENT MoFVarPostBldSel_bbLoc1Cpl "RAM data redundancy of MoFVarPostBldSel_bbLoc1" UBYTE OneToOne 1 100 0.00 255.0 FORMAT "%5.1" ECU_ADDRESS 0x6001180C /end MEASUREMENT
/begin MEASUREMENT MoFVarPostBldSel_bbOut1Cpl "RAM data redundancy of MoFVarPostBldSel_bbOut1" UBYTE OneToOne 1 100 0.00 255.0 FORMAT "%5.1" ECU_ADDRESS 0x6001180B /end MEASUREMENT
/begin MEASUREMENT MoFVSS_v "Vehicle speed for function monitoring" SWORD vel_q0p01 1 100 -327.6800 327.6700 FORMAT "%8.4" ECU_ADDRESS 0x60011EBE /end MEASUREMENT
/begin MEASUREMENT MoFVSS_vCpl "Double storage of meassurement point for vehicle speed over CAN" UWORD OneToOne 1 100 0.00 65535.00 FORMAT "%8.2" ECU_ADDRESS 0x60011806 /end MEASUREMENT
/begin MEASUREMENT MoF_ctTrqCmp "error tolerance time for torque comparison in the function monitoring" UBYTE dez 1 100 0.00 255.0 FORMAT "%5.1" ECU_ADDRESS 0x60011F94 /end MEASUREMENT
/begin MEASUREMENT MoF_ctTrqCmpCpl "RAM data redundancy for MoF_ctTrqCmp" UBYTE dez 1 100 0.00 255.0 FORMAT "%5.1" ECU_ADDRESS 0x600118DC /end MEASUREMENT
/begin MEASUREMENT MoF_ctTstTrqCmp "counter for putting of the test flag in diagnosis of torque comparison" UBYTE dez 1 100 0.00 255.0 FORMAT "%5.1" ECU_ADDRESS 0x60006382 /end MEASUREMENT
/begin MEASUREMENT MoF_facTrqErrSum "error sum of the relative deviation from the permissible torque in function monitoring" UWORD rel_q0p00195_pc_s 1 100 0.00 127.9980 FORMAT "%8.4" ECU_ADDRESS 0x60011F92 /end MEASUREMENT
/begin MEASUREMENT MoF_facTrqErrSumCpl "RAM data redundancy for MoF_facTrqErrSum" UWORD dez 1 100 0.00 65535.00 FORMAT "%8.2" ECU_ADDRESS 0x600118DA /end MEASUREMENT
/begin MEASUREMENT MoF_rTrqInrAct "current torque in the function monitoring" UBYTE rel_q0p39 1 100 0.00 99.61 FORMAT "%5.2" ECU_ADDRESS 0x60011FA5 /end MEASUREMENT
/begin MEASUREMENT MoF_rTrqInrActCpl "RAM data redundancy for MoF_rTrqInrAct" UBYTE OneToOne 1 100 0.00 255.0 FORMAT "%5.1" ECU_ADDRESS 0x600118E3 /end MEASUREMENT
/begin MEASUREMENT MoF_rTrqInrMax "max. inner engine torque in function monitoring" UBYTE rel_q0p39 1 100 0.00 99.61 FORMAT "%5.2" ECU_ADDRESS 0x60011F8C /end MEASUREMENT
/begin MEASUREMENT MoF_rTrqInrMaxCpl "RAM data redundancy for MoF_rTrqInrMax" UBYTE OneToOne 1 100 0.00 255.0 FORMAT "%5.1" ECU_ADDRESS 0x600118D4 /end MEASUREMENT
/begin MEASUREMENT MoF_rTrqInrOpt "Optimum indicated torque in function monitoring" UBYTE rel_q0p39 1 100 0.00 99.61 FORMAT "%5.2" ECU_ADDRESS 0x60011FA4 /end MEASUREMENT
/begin MEASUREMENT MoF_rTrqInrOptCpl "RAM data redundancy for MoF_rTrqInrOpt" UBYTE OneToOne 1 100 0.00 255.0 FORMAT "%5.1" ECU_ADDRESS 0x600118E2 /end MEASUREMENT
/begin MEASUREMENT MoF_rTrqPT "the power train transmission ratio in function monitoring" SWORD fak_q0p01 1 100 -327.6800 327.6700 FORMAT "%8.4" ECU_ADDRESS 0x60011ED0 /end MEASUREMENT
/begin MEASUREMENT MoF_rTrqPTCpl "RAM data redundancy for MoF_rTrqPT" UWORD OneToOne 1 100 0.00 65535.00 FORMAT "%8.2" ECU_ADDRESS 0x60011818 /end MEASUREMENT
/begin MEASUREMENT MoF_rTrqPtdFlt "relative permissible torque (filtered)" UBYTE rel_q0p39 1 100 0.00 99.61 FORMAT "%5.2" ECU_ADDRESS 0x60011F66 /end MEASUREMENT
/begin MEASUREMENT MoF_rTrqPtdFltCpl "RAM data redundancy for MoF_rTrqPtdFlt" UBYTE OneToOne 1 100 0.00 255.0 FORMAT "%5.1" ECU_ADDRESS 0x600118AE /end MEASUREMENT
/begin MEASUREMENT MoF_rTrqPtdFltWgh_mp "measurement value: permitted filtered weight reference torque in function monitoring" UBYTE rel_q0p39 1 100 0.00 99.61 FORMAT "%5.2" ECU_ADDRESS 0x70008BDE /end MEASUREMENT
/begin MEASUREMENT MoF_stStrtMsg "state:powertrain active in function monitoring" UBYTE OneToOne 1 100 0.00 255.0 FORMAT "%5.1" ECU_ADDRESS 0x6000A327 /end MEASUREMENT
/begin MEASUREMENT MoF_stStrtStopEnaMsg "Level 2 starter monitoring status" UBYTE OneToOne 1 100 0.00 255.0 FORMAT "%5.1" ECU_ADDRESS 0x6000A326 /end MEASUREMENT
/begin MEASUREMENT MoF_stVar "status variant coding in the function monitoring" UBYTE OneToOne 1 100 0.00 255.0 FORMAT "%5.1" ECU_ADDRESS 0x60011ECE /end MEASUREMENT
/begin MEASUREMENT MoF_stVarCpl "RAM data redundancy for MoF_stVar" UBYTE OneToOne 1 100 0.00 255.0 FORMAT "%5.1" ECU_ADDRESS 0x60011816 /end MEASUREMENT
/begin MEASUREMENT MoF_tEng "engine temperature in the function monitoring" UBYTE temp_ub_q0p75_o48 1 100 -48.0 143.3 FORMAT "%5.1" ECU_ADDRESS 0x60011FB8 /end MEASUREMENT
/begin MEASUREMENT MoF_tEngCpl "RAM data redundancy for MoF_tEng" UBYTE OneToOne 1 100 0.00 255.0 FORMAT "%5.1" ECU_ADDRESS 0x600118F9 /end MEASUREMENT
/begin MEASUREMENT MoF_tEngLonWrd "modelled engine temperature in the function monitoring 32 bits" ULONG temp_q4p4703Em8_om48_DegC 1 100 -48.000000000 143.999999955 FORMAT "%13.9" ECU_ADDRESS 0x60011FB4 /end MEASUREMENT
/begin MEASUREMENT MoF_tEngLonWrdCpl "RAM data redundancy for MoF_tEngLonWrd" ULONG OneToOne 1 100 0.00 4294967295.00 FORMAT "%13.2" ECU_ADDRESS 0x600118F4 /end MEASUREMENT
/begin MEASUREMENT MoF_tEngMod "modelled engine temperature in the function monitoring" UBYTE temp_ub_q0p75_o48 1 100 -48.0 143.3 FORMAT "%5.1" ECU_ADDRESS 0x60011FBA /end MEASUREMENT
/begin MEASUREMENT MoF_tEngModCpl "RAM data redundancy for MoF_tEngMod" UBYTE OneToOne 1 100 0.00 255.0 FORMAT "%5.1" ECU_ADDRESS 0x600118F8 /end MEASUREMENT
/begin MEASUREMENT MoF_tEng_DST_result "result of distribution search in MoF_tEng_DST" SLONG dez 1 100 -2147483648.00 2147483647.00 FORMAT "%13.2" ECU_ADDRESS 0x60011FB0 /end MEASUREMENT
/begin MEASUREMENT MoF_tEng_DST_resultCpl "RAM data redundancy for MoF_tEng_DST_result" ULONG OneToOne 1 100 0.00 4294967295.00 FORMAT "%13.2" ECU_ADDRESS 0x600118F0 /end MEASUREMENT
/begin MEASUREMENT MoF_tiAftStrt "time after start in function monitoring" UWORD t_q0p04 1 100 0.00 2621.400 FORMAT "%8.3" ECU_ADDRESS 0x60011FAE /end MEASUREMENT
/begin MEASUREMENT MoF_tiAftStrtCpl "RAM data redundancy for MoF_tiAftStrt" UWORD OneToOne 1 100 0.00 65535.00 FORMAT "%8.2" ECU_ADDRESS 0x600118EC /end MEASUREMENT
/begin MEASUREMENT MoF_tqAdap "Adapted difference of loss torque in function monitoring" SWORD md_q1p6 1 100 -52428.80 52427.20 FORMAT "%8.2" ECU_ADDRESS 0x60011F80 /end MEASUREMENT
/begin MEASUREMENT MoF_tqAdapCpl "Complement of Adapted difference of loss torque in function monitoring" UWORD OneToOne 1 100 0.00 65535.00 FORMAT "%8.2" ECU_ADDRESS 0x600118C8 /end MEASUREMENT
/begin MEASUREMENT MoF_trqAcs "torque of the accessories in the function monitoring" UBYTE md_q1p6 1 100 0.00 408.0 FORMAT "%5.1" ECU_ADDRESS 0x60011F88 /end MEASUREMENT
/begin MEASUREMENT MoF_trqAcsCpl "RAM data redundancy for MoF_trqAcs" UBYTE OneToOne 1 100 0.00 255.0 FORMAT "%5.1" ECU_ADDRESS 0x600118D0 /end MEASUREMENT
/begin MEASUREMENT MoF_trqCalCompDes "the desired adjustable compensation torquein in function monitoring" UBYTE md_q1p6 1 100 0.00 408.0 FORMAT "%5.1" ECU_ADDRESS 0x60011F87 /end MEASUREMENT
/begin MEASUREMENT MoF_trqCalCompDesCpl "RAM data redundancy for MoF_trqCalCompDes" UBYTE OneToOne 1 100 0.00 255.0 FORMAT "%5.1" ECU_ADDRESS 0x600118CF /end MEASUREMENT
/begin MEASUREMENT MoF_trqFulCompDes "the desired full compensation torque in function monitoring" UBYTE md_q1p6 1 100 0.00 408.0 FORMAT "%5.1" ECU_ADDRESS 0x60011F86 /end MEASUREMENT
/begin MEASUREMENT MoF_trqFulCompDesCpl "RAM data redundancy for MoF_trqFulCompDes" UBYTE OneToOne 1 100 0.00 255.0 FORMAT "%5.1" ECU_ADDRESS 0x600118CE /end MEASUREMENT
/begin MEASUREMENT MoF_trqInrMinWoCtOff "minimal inner torque in the combusted operation in the function monitoring" UBYTE md_q1p6 1 100 0.00 408.0 FORMAT "%5.1" ECU_ADDRESS 0x60011F8B /end MEASUREMENT
/begin MEASUREMENT MoF_trqInrMinWoCtOffCpl "RAM-data redundancy for MoF_trqInrMinWoCtOff" UBYTE OneToOne 1 100 0.00 255.0 FORMAT "%5.1" ECU_ADDRESS 0x600118D3 /end MEASUREMENT
/begin MEASUREMENT MoF_trqLos "torque losses in function monitoring" UBYTE md_q1p6 1 100 0.00 408.0 FORMAT "%5.1" ECU_ADDRESS 0x60011F85 /end MEASUREMENT
/begin MEASUREMENT MoF_trqLosComp "torque losses to be compensated in function monitoring" UBYTE md_q1p6 1 100 0.00 408.0 FORMAT "%5.1" ECU_ADDRESS 0x60011F84 /end MEASUREMENT
/begin MEASUREMENT MoF_trqLosCompCpl "RAM-data redundancy for MoF_trqLosComp" UBYTE OneToOne 1 100 0.00 255.0 FORMAT "%5.1" ECU_ADDRESS 0x600118CD /end MEASUREMENT
/begin MEASUREMENT MoF_trqLosCpl "RAM-data redundancy for MoF_trqLos" UBYTE OneToOne 1 100 0.00 255.0 FORMAT "%5.1" ECU_ADDRESS 0x600118CC /end MEASUREMENT
/begin MEASUREMENT MoF_trqLosMsg "torque losses in function monitoring" UBYTE md_q1p6 1 100 0.00 408.0 FORMAT "%5.1" ECU_ADDRESS 0x6000A325 /end MEASUREMENT
/begin MEASUREMENT MoF_trqLosPT "power train losses (gear box, converter) in function monitoring" UBYTE md_q1p6 1 100 0.00 408.0 FORMAT "%5.1" ECU_ADDRESS 0x60011F83 /end MEASUREMENT
/begin MEASUREMENT MoF_trqLosPTCpl "RAM-data redundancy for MoF_trqLosPT" UBYTE OneToOne 1 100 0.00 255.0 FORMAT "%5.1" ECU_ADDRESS 0x600118CB /end MEASUREMENT
/begin MEASUREMENT MoF_trqLosTot "overall losses (drive train, converter, engine and accessories losses)in function monitoring" UBYTE md_q1p6 1 100 0.00 408.0 FORMAT "%5.1" ECU_ADDRESS 0x60011F82 /end MEASUREMENT
/begin MEASUREMENT MoF_trqLosTotCpl "RAM-data redundancy for MoF_trqLosTot" UBYTE OneToOne 1 100 0.00 255.0 FORMAT "%5.1" ECU_ADDRESS 0x600118CA /end MEASUREMENT
/begin MEASUREMENT MoXAirFl_cntrComS0 "S0-counter of function MoXAirFl_Adp" UWORD OneToOne 1 100 0.00 65535.00 FORMAT "%8.2" ECU_ADDRESS 0x70001CCE /end MEASUREMENT
/begin MEASUREMENT MoXAirFl_cntrComS0Rdnt "Redundancy for MoXAirFl_cntrComS0" UWORD OneToOne 1 100 0.00 65535.00 FORMAT "%8.2" ECU_ADDRESS 0x70001CCC /end MEASUREMENT
/begin MEASUREMENT MoXAirFl_cntrComS1 "S1-counter of function MoXAirFl_Adp" UWORD OneToOne 1 100 0.00 65535.00 FORMAT "%8.2" ECU_ADDRESS 0x70001CCA /end MEASUREMENT
/begin MEASUREMENT MoXAirFl_cntrComS1Rdnt "Redundancy for MoXAirFl_cntrComS1" UWORD OneToOne 1 100 0.00 65535.00 FORMAT "%8.2" ECU_ADDRESS 0x70001CC8 /end MEASUREMENT
/begin MEASUREMENT MoXAirFl_CtOffIfClass_V13I.evz_auscpl "Instance of data class for quantities in connection to injection cut-off of function MoXAirFl_Adp / Instance of data class for quantities in connection to injection cut-off of function MoXAirFl_Adp Member Variable" UBYTE OneToOne 1 100 0.00 255.0 FORMAT "%5.1" ECU_ADDRESS 0x70001854 /end MEASUREMENT
/begin MEASUREMENT MoXAirFl_CtOffIfClass_V13I.evz_auscpl_mem "Instance of data class for quantities in connection to injection cut-off of function MoXAirFl_Adp / Instance of data class for quantities in connection to injection cut-off of function MoXAirFl_Adp Member Variable" UBYTE OneToOne 1 100 0.00 255.0 FORMAT "%5.1" ARRAY_SIZE 4 ECU_ADDRESS 0x70001855 /end MEASUREMENT
/begin MEASUREMENT MoXAirFl_CtOffIfClass_V13I.evz_austot "Instance of data class for quantities in connection to injection cut-off of function MoXAirFl_Adp / Instance of data class for quantities in connection to injection cut-off of function MoXAirFl_Adp Member Variable" UBYTE OneToOne 1 100 0.00 255.0 FORMAT "%5.1" ECU_ADDRESS 0x70001859 /end MEASUREMENT
/begin MEASUREMENT MoXAirFl_CtOffIfClass_V13I.evz_austot_mem "Instance of data class for quantities in connection to injection cut-off of function MoXAirFl_Adp / Instance of data class for quantities in connection to injection cut-off of function MoXAirFl_Adp Member Variable" UBYTE OneToOne 1 100 0.00 255.0 FORMAT "%5.1" ARRAY_SIZE 4 ECU_ADDRESS 0x7000185A /end MEASUREMENT
/begin MEASUREMENT MoXAirFl_CtOffIfClass_V13I.flgInjEnad "Instance of data class for quantities in connection to injection cut-off of function MoXAirFl_Adp / Instance of data class for quantities in connection to injection cut-off of function MoXAirFl_Adp Member Variable" UBYTE B_TRUE 1 100 0.00 1.00000000000 BIT_MASK 0x1 FORMAT "%13.11" ECU_ADDRESS 0x7000185E /end MEASUREMENT
/begin MEASUREMENT MoXAirFl_CtOffIfClass_V13I.injTrigCylMsk "Instance of data class for quantities in connection to injection cut-off of function MoXAirFl_Adp / Instance of data class for quantities in connection to injection cut-off of function MoXAirFl_Adp Member Variable" UWORD OneToOne 1 100 0.00 65535.00 FORMAT "%8.2" ECU_ADDRESS 0x70001860 /end MEASUREMENT
/begin MEASUREMENT MoXAirFl_CtOffIfClass_V13I.injTrigCylMskRdnt "Instance of data class for quantities in connection to injection cut-off of function MoXAirFl_Adp / Instance of data class for quantities in connection to injection cut-off of function MoXAirFl_Adp Member Variable" UWORD OneToOne 1 100 0.00 65535.00 FORMAT "%8.2" ECU_ADDRESS 0x70001862 /end MEASUREMENT
/begin MEASUREMENT MoXAirFl_CtOffIfClass_V13I.injmode_zzylh "Instance of data class for quantities in connection to injection cut-off of function MoXAirFl_Adp / Instance of data class for quantities in connection to injection cut-off of function MoXAirFl_Adp Member Variable" ULONG OneToOne 1 100 0.00 4294967295.00 FORMAT "%13.2" ECU_ADDRESS 0x70001864 /end MEASUREMENT
/begin MEASUREMENT MoXAirFl_CtOffIfClass_V13I.injmode_zzylh_rdnt "Instance of data class for quantities in connection to injection cut-off of function MoXAirFl_Adp / Instance of data class for quantities in connection to injection cut-off of function MoXAirFl_Adp Member Variable" ULONG OneToOne 1 100 0.00 4294967295.00 FORMAT "%13.2" ECU_ADDRESS 0x70001868 /end MEASUREMENT
/begin MEASUREMENT MoXAirFl_CtOffIfClass_V13I.injmode_zzyln "Instance of data class for quantities in connection to injection cut-off of function MoXAirFl_Adp / Instance of data class for quantities in connection to injection cut-off of function MoXAirFl_Adp Member Variable" ULONG OneToOne 1 100 0.00 4294967295.00 FORMAT "%13.2" ECU_ADDRESS 0x7000186C /end MEASUREMENT
/begin MEASUREMENT MoXAirFl_CtOffIfClass_V13I.injmode_zzyln_rdnt "Instance of data class for quantities in connection to injection cut-off of function MoXAirFl_Adp / Instance of data class for quantities in connection to injection cut-off of function MoXAirFl_Adp Member Variable" ULONG OneToOne 1 100 0.00 4294967295.00 FORMAT "%13.2" ECU_ADDRESS 0x70001870 /end MEASUREMENT
/begin MEASUREMENT MoXAirFl_CtOffIfClass_V13I.injmode_zzyls "Instance of data class for quantities in connection to injection cut-off of function MoXAirFl_Adp / Instance of data class for quantities in connection to injection cut-off of function MoXAirFl_Adp Member Variable" ULONG OneToOne 1 100 0.00 4294967295.00 FORMAT "%13.2" ECU_ADDRESS 0x70001874 /end MEASUREMENT
/begin MEASUREMENT MoXAirFl_CtOffIfClass_V13I.injmode_zzyls_rdnt "Instance of data class for quantities in connection to injection cut-off of function MoXAirFl_Adp / Instance of data class for quantities in connection to injection cut-off of function MoXAirFl_Adp Member Variable" ULONG OneToOne 1 100 0.00 4294967295.00 FORMAT "%13.2" ECU_ADDRESS 0x70001878 /end MEASUREMENT
/begin MEASUREMENT MoXAirFl_CtOffIfClass_V13I.stInjPfiDeactvAry "Instance of data class for quantities in connection to injection cut-off of function MoXAirFl_Adp / Instance of data class for quantities in connection to injection cut-off of function MoXAirFl_Adp Member Variable" UBYTE OneToOne 1 100 0.00 255.0 FORMAT "%5.1" ARRAY_SIZE 4 ECU_ADDRESS 0x7000187C /end MEASUREMENT
/begin MEASUREMENT MoXAirFl_CtOffIfClass_V13I.stInjPfiDeactvAryRdnt "Instance of data class for quantities in connection to injection cut-off of function MoXAirFl_Adp / Instance of data class for quantities in connection to injection cut-off of function MoXAirFl_Adp Member Variable" UBYTE OneToOne 1 100 0.00 255.0 FORMAT "%5.1" ARRAY_SIZE 4 ECU_ADDRESS 0x70001880 /end MEASUREMENT
/begin MEASUREMENT MoXAirFl_CtOffIfClass_V13I.stInjPfiDeactvBkupAry "Instance of data class for quantities in connection to injection cut-off of function MoXAirFl_Adp / Instance of data class for quantities in connection to injection cut-off of function MoXAirFl_Adp Member Variable" UBYTE OneToOne 1 100 0.00 255.0 FORMAT "%5.1" ARRAY_SIZE 4 ECU_ADDRESS 0x70001884 /end MEASUREMENT
/begin MEASUREMENT MoXAirFl_CtOffIfClass_V13I.stInjTiPfi "Instance of data class for quantities in connection to injection cut-off of function MoXAirFl_Adp / Instance of data class for quantities in connection to injection cut-off of function MoXAirFl_Adp Member Variable" UBYTE OneToOne 1 100 0.00 255.0 FORMAT "%5.1" ECU_ADDRESS 0x70001888 /end MEASUREMENT
/begin MEASUREMENT MoXAirFl_CtOffIfClass_V13I.stInjTiPfi1InjrA "Instance of data class for quantities in connection to injection cut-off of function MoXAirFl_Adp / Instance of data class for quantities in connection to injection cut-off of function MoXAirFl_Adp Member Variable" UBYTE OneToOne 1 100 0.00 255.0 FORMAT "%5.1" ECU_ADDRESS 0x70001889 /end MEASUREMENT
/begin MEASUREMENT MoXAirFl_CtOffIfClass_V13I.stInjTiPfi1InjrARdnt "Instance of data class for quantities in connection to injection cut-off of function MoXAirFl_Adp / Instance of data class for quantities in connection to injection cut-off of function MoXAirFl_Adp Member Variable" UBYTE OneToOne 1 100 0.00 255.0 FORMAT "%5.1" ECU_ADDRESS 0x7000188A /end MEASUREMENT
/begin MEASUREMENT MoXAirFl_CtOffIfClass_V13I.stInjTiPfi1InjrB "Instance of data class for quantities in connection to injection cut-off of function MoXAirFl_Adp / Instance of data class for quantities in connection to injection cut-off of function MoXAirFl_Adp Member Variable" UBYTE OneToOne 1 100 0.00 255.0 FORMAT "%5.1" ECU_ADDRESS 0x7000188B /end MEASUREMENT
/begin MEASUREMENT MoXAirFl_CtOffIfClass_V13I.stInjTiPfi1InjrBRdnt "Instance of data class for quantities in connection to injection cut-off of function MoXAirFl_Adp / Instance of data class for quantities in connection to injection cut-off of function MoXAirFl_Adp Member Variable" UBYTE OneToOne 1 100 0.00 255.0 FORMAT "%5.1" ECU_ADDRESS 0x7000188C /end MEASUREMENT
/begin MEASUREMENT MoXAirFl_CtOffIfClass_V13I.stInjTiPfi2InjrA "Instance of data class for quantities in connection to injection cut-off of function MoXAirFl_Adp / Instance of data class for quantities in connection to injection cut-off of function MoXAirFl_Adp Member Variable" UBYTE OneToOne 1 100 0.00 255.0 FORMAT "%5.1" ECU_ADDRESS 0x7000188D /end MEASUREMENT
/begin MEASUREMENT MoXAirFl_CtOffIfClass_V13I.stInjTiPfi2InjrARdnt "Instance of data class for quantities in connection to injection cut-off of function MoXAirFl_Adp / Instance of data class for quantities in connection to injection cut-off of function MoXAirFl_Adp Member Variable" UBYTE OneToOne 1 100 0.00 255.0 FORMAT "%5.1" ECU_ADDRESS 0x7000188E /end MEASUREMENT
/begin MEASUREMENT MoXAirFl_CtOffIfClass_V13I.stInjTiPfi2InjrB "Instance of data class for quantities in connection to injection cut-off of function MoXAirFl_Adp / Instance of data class for quantities in connection to injection cut-off of function MoXAirFl_Adp Member Variable" UBYTE OneToOne 1 100 0.00 255.0 FORMAT "%5.1" ECU_ADDRESS 0x7000188F /end MEASUREMENT
/begin MEASUREMENT MoXAirFl_CtOffIfClass_V13I.stInjTiPfi2InjrBRdnt "Instance of data class for quantities in connection to injection cut-off of function MoXAirFl_Adp / Instance of data class for quantities in connection to injection cut-off of function MoXAirFl_Adp Member Variable" UBYTE OneToOne 1 100 0.00 255.0 FORMAT "%5.1" ECU_ADDRESS 0x70001890 /end MEASUREMENT
/begin MEASUREMENT MoXAirFl_CtOffIfClass_V13I.stInjTiPfiRdnt "Instance of data class for quantities in connection to injection cut-off of function MoXAirFl_Adp / Instance of data class for quantities in connection to injection cut-off of function MoXAirFl_Adp Member Variable" UBYTE OneToOne 1 100 0.00 255.0 FORMAT "%5.1" ECU_ADDRESS 0x70001891 /end MEASUREMENT
/begin MEASUREMENT MoXAirFl_MixMngtIfClass_V13I.B_afimreq "Instance of data class for quantities in connection to mixture management of function MoXAirFl_Adp / Instance of data class for quantities in connection to mixture management of function MoXAirFl_Adp Member Variable" UBYTE B_TRUE 1 100 0.00 1.00000000000 BIT_MASK 0x1 FORMAT "%13.11" ECU_ADDRESS 0x70001778 /end MEASUREMENT
/begin MEASUREMENT MoXAirFl_MixMngtIfClass_V13I.facBnk "Instance of data class for quantities in connection to mixture management of function MoXAirFl_Adp / Instance of data class for quantities in connection to mixture management of function MoXAirFl_Adp Member Variable" UWORD fak_uw_b2 1 100 0.00 1.999969 FORMAT "%8.6" ECU_ADDRESS 0x7000177A /end MEASUREMENT
/begin MEASUREMENT MoXAirFl_MixMngtIfClass_V13I.facBnk2Pfi "Instance of data class for quantities in connection to mixture management of function MoXAirFl_Adp / Instance of data class for quantities in connection to mixture management of function MoXAirFl_Adp Member Variable" UWORD fak_uw_b2 1 100 0.00 1.999969 FORMAT "%8.6" ECU_ADDRESS 0x7000177C /end MEASUREMENT
/begin MEASUREMENT MoXAirFl_MixMngtIfClass_V13I.facBnkPfi "Instance of data class for quantities in connection to mixture management of function MoXAirFl_Adp / Instance of data class for quantities in connection to mixture management of function MoXAirFl_Adp Member Variable" UWORD fak_uw_b2 1 100 0.00 1.999969 FORMAT "%8.6" ECU_ADDRESS 0x7000177E /end MEASUREMENT
/begin MEASUREMENT MoXAirFl_MixMngtIfClass_V13I.facLamCtlPfiAry "Instance of data class for quantities in connection to mixture management of function MoXAirFl_Adp / Instance of data class for quantities in connection to mixture management of function MoXAirFl_Adp Member Variable" UWORD fak_uw_b2 1 100 0.00 1.999969 FORMAT "%8.6" ARRAY_SIZE 4 ECU_ADDRESS 0x70001780 /end MEASUREMENT
/begin MEASUREMENT MoXAirFl_MixMngtIfClass_V13I.facLamCtlPfiAryRdnt "Instance of data class for quantities in connection to mixture management of function MoXAirFl_Adp / Instance of data class for quantities in connection to mixture management of function MoXAirFl_Adp Member Variable" UWORD OneToOne 1 100 0.00 65535.00 FORMAT "%8.2" ARRAY_SIZE 4 ECU_ADDRESS 0x70001788 /end MEASUREMENT
/begin MEASUREMENT MoXAirFl_MixMngtIfClass_V13I.facLamCtlPfiBkupAry "Instance of data class for quantities in connection to mixture management of function MoXAirFl_Adp / Instance of data class for quantities in connection to mixture management of function MoXAirFl_Adp Member Variable" UWORD fak_uw_b2 1 100 0.00 1.999969 FORMAT "%8.6" ARRAY_SIZE 4 ECU_ADDRESS 0x70001790 /end MEASUREMENT
/begin MEASUREMENT MoXAirFl_MixMngtIfClass_V13I.facPcPfiRest "Instance of data class for quantities in connection to mixture management of function MoXAirFl_Adp / Instance of data class for quantities in connection to mixture management of function MoXAirFl_Adp Member Variable" UWORD fak_uw_b64 1 100 0.00 63.99902 FORMAT "%8.5" ECU_ADDRESS 0x70001798 /end MEASUREMENT
/begin MEASUREMENT MoXAirFl_MixMngtIfClass_V13I.facPcPfiRestBnk2 "Instance of data class for quantities in connection to mixture management of function MoXAirFl_Adp / Instance of data class for quantities in connection to mixture management of function MoXAirFl_Adp Member Variable" UWORD fak_uw_b64 1 100 0.00 63.99902 FORMAT "%8.5" ECU_ADDRESS 0x7000179A /end MEASUREMENT
/begin MEASUREMENT MoXAirFl_MixMngtIfClass_V13I.facPcRest "Instance of data class for quantities in connection to mixture management of function MoXAirFl_Adp / Instance of data class for quantities in connection to mixture management of function MoXAirFl_Adp Member Variable" UWORD fak_uw_b64 1 100 0.00 63.99902 FORMAT "%8.5" ECU_ADDRESS 0x7000179C /end MEASUREMENT
/begin MEASUREMENT MoXAirFl_MixMngtIfClass_V13I.facPrtnPfi "Instance of data class for quantities in connection to mixture management of function MoXAirFl_Adp / Instance of data class for quantities in connection to mixture management of function MoXAirFl_Adp Member Variable" UBYTE fak_ub_b1 1 100 0.00 0.9961 ECU_ADDRESS 0x7000179E /end MEASUREMENT
/begin MEASUREMENT MoXAirFl_MixMngtIfClass_V13I.facPrtnPfiAry "Instance of data class for quantities in connection to mixture management of function MoXAirFl_Adp / Instance of data class for quantities in connection to mixture management of function MoXAirFl_Adp Member Variable" UBYTE fak_ub_b1 1 100 0.00 0.9961 ARRAY_SIZE 4 ECU_ADDRESS 0x7000179F /end MEASUREMENT
/begin MEASUREMENT MoXAirFl_MixMngtIfClass_V13I.facPrtnPfiAryRdnt "Instance of data class for quantities in connection to mixture management of function MoXAirFl_Adp / Instance of data class for quantities in connection to mixture management of function MoXAirFl_Adp Member Variable" UBYTE OneToOne 1 100 0.00 255.0 FORMAT "%5.1" ARRAY_SIZE 4 ECU_ADDRESS 0x700017A3 /end MEASUREMENT
/begin MEASUREMENT MoXAirFl_MixMngtIfClass_V13I.facPrtnPfiBkupAry "Instance of data class for quantities in connection to mixture management of function MoXAirFl_Adp / Instance of data class for quantities in connection to mixture management of function MoXAirFl_Adp Member Variable" UBYTE fak_ub_b1 1 100 0.00 0.9961 ARRAY_SIZE 4 ECU_ADDRESS 0x700017A7 /end MEASUREMENT
/begin MEASUREMENT MoXAirFl_MixMngtIfClass_V13I.fakeslsa "Instance of data class for quantities in connection to mixture management of function MoXAirFl_Adp / Instance of data class for quantities in connection to mixture management of function MoXAirFl_Adp Member Variable" UWORD fak_uw_b2 1 100 0.00 1.999969 FORMAT "%8.6" ARRAY_SIZE 4 ECU_ADDRESS 0x700017AC /end MEASUREMENT
/begin MEASUREMENT MoXAirFl_MixMngtIfClass_V13I.ffuevali "Instance of data class for quantities in connection to mixture management of function MoXAirFl_Adp / Instance of data class for quantities in connection to mixture management of function MoXAirFl_Adp Member Variable" UWORD fak_uw_b64 1 100 0.00 63.99902 FORMAT "%8.5" ECU_ADDRESS 0x700017B4 /end MEASUREMENT
/begin MEASUREMENT MoXAirFl_MixMngtIfClass_V13I.ffuevalipfi "Instance of data class for quantities in connection to mixture management of function MoXAirFl_Adp / Instance of data class for quantities in connection to mixture management of function MoXAirFl_Adp Member Variable" UWORD fak_uw_b64 1 100 0.00 63.99902 FORMAT "%8.5" ECU_ADDRESS 0x700017B6 /end MEASUREMENT
/begin MEASUREMENT MoXAirFl_MixMngtIfClass_V13I.fkrkAry "Instance of data class for quantities in connection to mixture management of function MoXAirFl_Adp / Instance of data class for quantities in connection to mixture management of function MoXAirFl_Adp Member Variable" UWORD fak_uw_b2 1 100 0.00 1.999969 FORMAT "%8.6" ARRAY_SIZE 4 ECU_ADDRESS 0x700017B8 /end MEASUREMENT
/begin MEASUREMENT MoXAirFl_MixMngtIfClass_V13I.fkrkPfiAry "Instance of data class for quantities in connection to mixture management of function MoXAirFl_Adp / Instance of data class for quantities in connection to mixture management of function MoXAirFl_Adp Member Variable" UWORD fak_uw_b2 1 100 0.00 1.999969 FORMAT "%8.6" ARRAY_SIZE 4 ECU_ADDRESS 0x700017C0 /end MEASUREMENT
/begin MEASUREMENT MoXAirFl_MixMngtIfClass_V13I.fkrkPfiAryRdnt "Instance of data class for quantities in connection to mixture management of function MoXAirFl_Adp / Instance of data class for quantities in connection to mixture management of function MoXAirFl_Adp Member Variable" UWORD OneToOne 1 100 0.00 65535.00 FORMAT "%8.2" ARRAY_SIZE 4 ECU_ADDRESS 0x700017C8 /end MEASUREMENT
/begin MEASUREMENT MoXAirFl_MixMngtIfClass_V13I.flgLamSplitActv "Instance of data class for quantities in connection to mixture management of function MoXAirFl_Adp / Instance of data class for quantities in connection to mixture management of function MoXAirFl_Adp Member Variable" UBYTE B_TRUE 1 100 0.00 1.00000000000 BIT_MASK 0x1 FORMAT "%13.11" ECU_ADDRESS 0x700017D0 /end MEASUREMENT
/begin MEASUREMENT MoXAirFl_MixMngtIfClass_V13I.fnsad "Instance of data class for quantities in connection to mixture management of function MoXAirFl_Adp / Instance of data class for quantities in connection to mixture management of function MoXAirFl_Adp Member Variable" UWORD fak_uw_b2 1 100 0.00 1.999969 FORMAT "%8.6" ECU_ADDRESS 0x700017D2 /end MEASUREMENT
/begin MEASUREMENT MoXAirFl_MixMngtIfClass_V13I.fr "Instance of data class for quantities in connection to mixture management of function MoXAirFl_Adp / Instance of data class for quantities in connection to mixture management of function MoXAirFl_Adp Member Variable" UWORD fak_uw_b2 1 100 0.00 1.999969 FORMAT "%8.6" ECU_ADDRESS 0x700017D4 /end MEASUREMENT
/begin MEASUREMENT MoXAirFl_MixMngtIfClass_V13I.fr2 "Instance of data class for quantities in connection to mixture management of function MoXAirFl_Adp / Instance of data class for quantities in connection to mixture management of function MoXAirFl_Adp Member Variable" UWORD fak_uw_b2 1 100 0.00 1.999969 FORMAT "%8.6" ECU_ADDRESS 0x700017D6 /end MEASUREMENT
/begin MEASUREMENT MoXAirFl_MixMngtIfClass_V13I.fragdi "Instance of data class for quantities in connection to mixture management of function MoXAirFl_Adp / Instance of data class for quantities in connection to mixture management of function MoXAirFl_Adp Member Variable" UWORD fak_uw_b2 1 100 0.00 1.999969 FORMAT "%8.6" ECU_ADDRESS 0x700017D8 /end MEASUREMENT
/begin MEASUREMENT MoXAirFl_MixMngtIfClass_V13I.fragdi2 "Instance of data class for quantities in connection to mixture management of function MoXAirFl_Adp / Instance of data class for quantities in connection to mixture management of function MoXAirFl_Adp Member Variable" UWORD fak_uw_b2 1 100 0.00 1.999969 FORMAT "%8.6" ECU_ADDRESS 0x700017DA /end MEASUREMENT
/begin MEASUREMENT MoXAirFl_MixMngtIfClass_V13I.frapfi "Instance of data class for quantities in connection to mixture management of function MoXAirFl_Adp / Instance of data class for quantities in connection to mixture management of function MoXAirFl_Adp Member Variable" UWORD fak_uw_b2 1 100 0.00 1.999969 FORMAT "%8.6" ECU_ADDRESS 0x700017DC /end MEASUREMENT
/begin MEASUREMENT MoXAirFl_MixMngtIfClass_V13I.frapfi2 "Instance of data class for quantities in connection to mixture management of function MoXAirFl_Adp / Instance of data class for quantities in connection to mixture management of function MoXAirFl_Adp Member Variable" UWORD fak_uw_b2 1 100 0.00 1.999969 FORMAT "%8.6" ECU_ADDRESS 0x700017DE /end MEASUREMENT
/begin MEASUREMENT MoXAirFl_MixMngtIfClass_V13I.lamsbg "Instance of data class for quantities in connection to mixture management of function MoXAirFl_Adp / Instance of data class for quantities in connection to mixture management of function MoXAirFl_Adp Member Variable" UWORD fak_uw_b16 1 100 0.00 15.99976 FORMAT "%8.5" ECU_ADDRESS 0x700017E0 /end MEASUREMENT
/begin MEASUREMENT MoXAirFl_MixMngtIfClass_V13I.lamsbg2 "Instance of data class for quantities in connection to mixture management of function MoXAirFl_Adp / Instance of data class for quantities in connection to mixture management of function MoXAirFl_Adp Member Variable" UWORD fak_uw_b16 1 100 0.00 15.99976 FORMAT "%8.5" ECU_ADDRESS 0x700017E2 /end MEASUREMENT
/begin MEASUREMENT MoXAirFl_MixMngtIfClass_V13I.larils "Instance of data class for quantities in connection to mixture management of function MoXAirFl_Adp / Instance of data class for quantities in connection to mixture management of function MoXAirFl_Adp Member Variable" UWORD fak_q0p000244 1 100 0.00 15.99976 FORMAT "%8.5" ECU_ADDRESS 0x700017E4 /end MEASUREMENT
/begin MEASUREMENT MoXAirFl_MixMngtIfClass_V13I.larils2 "Instance of data class for quantities in connection to mixture management of function MoXAirFl_Adp / Instance of data class for quantities in connection to mixture management of function MoXAirFl_Adp Member Variable" UWORD fak_q0p000244 1 100 0.00 15.99976 FORMAT "%8.5" ECU_ADDRESS 0x700017E6 /end MEASUREMENT
/begin MEASUREMENT MoXAirFl_MixMngtIfClass_V13I.rCtlPriB1 "Instance of data class for quantities in connection to mixture management of function MoXAirFl_Adp / Instance of data class for quantities in connection to mixture management of function MoXAirFl_Adp Member Variable" SWORD fak_sw_b1 1 100 -1.000000 0.999969 FORMAT "%8.6" ECU_ADDRESS 0x700017E8 /end MEASUREMENT
/begin MEASUREMENT MoXAirFl_MixMngtIfClass_V13I.rCtlPriB2 "Instance of data class for quantities in connection to mixture management of function MoXAirFl_Adp / Instance of data class for quantities in connection to mixture management of function MoXAirFl_Adp Member Variable" SWORD fak_sw_b1 1 100 -1.000000 0.999969 FORMAT "%8.6" ECU_ADDRESS 0x700017EA /end MEASUREMENT
/begin MEASUREMENT MoXAirFl_MixMngtIfClass_V13I.ratChrgAirCylPredPfi "Instance of data class for quantities in connection to mixture management of function MoXAirFl_Adp / Instance of data class for quantities in connection to mixture management of function MoXAirFl_Adp Member Variable" UWORD rel_uw_q0p0234 1 100 0.00 1535.977 FORMAT "%8.3" ECU_ADDRESS 0x700017EC /end MEASUREMENT
/begin MEASUREMENT MoXAirFl_MixMngtIfClass_V13I.ratFuMCylInd "Instance of data class for quantities in connection to mixture management of function MoXAirFl_Adp / Instance of data class for quantities in connection to mixture management of function MoXAirFl_Adp Member Variable" UWORD rel_uw_b3072 1 100 0.00 3071.953 FORMAT "%8.3" ECU_ADDRESS 0x700017EE /end MEASUREMENT
/begin MEASUREMENT MoXAirFl_MixMngtIfClass_V13I.ratFuMGdi "Instance of data class for quantities in connection to mixture management of function MoXAirFl_Adp / Instance of data class for quantities in connection to mixture management of function MoXAirFl_Adp Member Variable" UWORD rel_uw_b3072 1 100 0.00 3071.953 FORMAT "%8.3" ECU_ADDRESS 0x700017F0 /end MEASUREMENT
/begin MEASUREMENT MoXAirFl_MixMngtIfClass_V13I.ratFuMGdiBnk2 "Instance of data class for quantities in connection to mixture management of function MoXAirFl_Adp / Instance of data class for quantities in connection to mixture management of function MoXAirFl_Adp Member Variable" UWORD rel_uw_b3072 1 100 0.00 3071.953 FORMAT "%8.3" ECU_ADDRESS 0x700017F2 /end MEASUREMENT
/begin MEASUREMENT MoXAirFl_MixMngtIfClass_V13I.ratFuMPfi "Instance of data class for quantities in connection to mixture management of function MoXAirFl_Adp / Instance of data class for quantities in connection to mixture management of function MoXAirFl_Adp Member Variable" UWORD rel_uw_b3072 1 100 0.00 3071.953 FORMAT "%8.3" ECU_ADDRESS 0x700017F4 /end MEASUREMENT
/begin MEASUREMENT MoXAirFl_MixMngtIfClass_V13I.ratFuMPfiBnk2 "Instance of data class for quantities in connection to mixture management of function MoXAirFl_Adp / Instance of data class for quantities in connection to mixture management of function MoXAirFl_Adp Member Variable" UWORD rel_uw_b3072 1 100 0.00 3071.953 FORMAT "%8.3" ECU_ADDRESS 0x700017F6 /end MEASUREMENT
/begin MEASUREMENT MoXAirFl_MixMngtIfClass_V13I.ratFuPrtnPfiInjAry "Instance of data class for quantities in connection to mixture management of function MoXAirFl_Adp / Instance of data class for quantities in connection to mixture management of function MoXAirFl_Adp Member Variable" UWORD rel_uw_b3072 1 100 0.00 3071.953 FORMAT "%8.3" ARRAY_SIZE 4 ECU_ADDRESS 0x700017F8 /end MEASUREMENT
/begin MEASUREMENT MoXAirFl_MixMngtIfClass_V13I.ratFuPrtnPfiInjAryRdnt "Instance of data class for quantities in connection to mixture management of function MoXAirFl_Adp / Instance of data class for quantities in connection to mixture management of function MoXAirFl_Adp Member Variable" UWORD OneToOne 1 100 0.00 65535.00 FORMAT "%8.2" ARRAY_SIZE 4 ECU_ADDRESS 0x70001800 /end MEASUREMENT
/begin MEASUREMENT MoXAirFl_MixMngtIfClass_V13I.ratFuPrtnPfiInjBkupAry "Instance of data class for quantities in connection to mixture management of function MoXAirFl_Adp / Instance of data class for quantities in connection to mixture management of function MoXAirFl_Adp Member Variable" UWORD rel_uw_b3072 1 100 0.00 3071.953 FORMAT "%8.3" ARRAY_SIZE 4 ECU_ADDRESS 0x70001808 /end MEASUREMENT
/begin MEASUREMENT MoXAirFl_MixMngtIfClass_V13I.ratPrdcAirPrtnPfiAry "Instance of data class for quantities in connection to mixture management of function MoXAirFl_Adp / Instance of data class for quantities in connection to mixture management of function MoXAirFl_Adp Member Variable" UWORD rel_uw_q0p0234 1 100 0.00 1535.977 FORMAT "%8.3" ARRAY_SIZE 4 ECU_ADDRESS 0x70001810 /end MEASUREMENT
/begin MEASUREMENT MoXAirFl_MixMngtIfClass_V13I.ratPrdcAirPrtnPfiAryRdnt "Instance of data class for quantities in connection to mixture management of function MoXAirFl_Adp / Instance of data class for quantities in connection to mixture management of function MoXAirFl_Adp Member Variable" UWORD OneToOne 1 100 0.00 65535.00 FORMAT "%8.2" ARRAY_SIZE 4 ECU_ADDRESS 0x70001818 /end MEASUREMENT
/begin MEASUREMENT MoXAirFl_MixMngtIfClass_V13I.ratPrdcAirPrtnPfiBkupAry "Instance of data class for quantities in connection to mixture management of function MoXAirFl_Adp / Instance of data class for quantities in connection to mixture management of function MoXAirFl_Adp Member Variable" UWORD rel_uw_q0p0234 1 100 0.00 1535.977 FORMAT "%8.3" ARRAY_SIZE 4 ECU_ADDRESS 0x70001820 /end MEASUREMENT
/begin MEASUREMENT MoXAirFl_MixMngtIfClass_V13I.rkagdi "Instance of data class for quantities in connection to mixture management of function MoXAirFl_Adp / Instance of data class for quantities in connection to mixture management of function MoXAirFl_Adp Member Variable" SWORD rel_sw_b1536 1 100 -1536.000 1535.953 FORMAT "%8.3" ECU_ADDRESS 0x70001828 /end MEASUREMENT
/begin MEASUREMENT MoXAirFl_MixMngtIfClass_V13I.rkagdi2 "Instance of data class for quantities in connection to mixture management of function MoXAirFl_Adp / Instance of data class for quantities in connection to mixture management of function MoXAirFl_Adp Member Variable" SWORD rel_sw_b1536 1 100 -1536.000 1535.953 FORMAT "%8.3" ECU_ADDRESS 0x7000182A /end MEASUREMENT
/begin MEASUREMENT MoXAirFl_MixMngtIfClass_V13I.rkapfi "Instance of data class for quantities in connection to mixture management of function MoXAirFl_Adp / Instance of data class for quantities in connection to mixture management of function MoXAirFl_Adp Member Variable" SWORD rel_sw_b1536 1 100 -1536.000 1535.953 FORMAT "%8.3" ECU_ADDRESS 0x7000182C /end MEASUREMENT
/begin MEASUREMENT MoXAirFl_MixMngtIfClass_V13I.rkapfi2 "Instance of data class for quantities in connection to mixture management of function MoXAirFl_Adp / Instance of data class for quantities in connection to mixture management of function MoXAirFl_Adp Member Variable" SWORD rel_sw_b1536 1 100 -1536.000 1535.953 FORMAT "%8.3" ECU_ADDRESS 0x7000182E /end MEASUREMENT
/begin MEASUREMENT MoXAirFl_MixMngtIfClass_V13I.rkausg "Instance of data class for quantities in connection to mixture management of function MoXAirFl_Adp / Instance of data class for quantities in connection to mixture management of function MoXAirFl_Adp Member Variable" SWORD rel_sw_b1536 1 100 -1536.000 1535.953 FORMAT "%8.3" ECU_ADDRESS 0x70001830 /end MEASUREMENT
/begin MEASUREMENT MoXAirFl_MixMngtIfClass_V13I.rkte "Instance of data class for quantities in connection to mixture management of function MoXAirFl_Adp / Instance of data class for quantities in connection to mixture management of function MoXAirFl_Adp Member Variable" SWORD rel_sw_b1536 1 100 -1536.000 1535.953 FORMAT "%8.3" ECU_ADDRESS 0x70001832 /end MEASUREMENT
/begin MEASUREMENT MoXAirFl_MixMngtIfClass_V13I.rkteBnk1 "Instance of data class for quantities in connection to mixture management of function MoXAirFl_Adp / Instance of data class for quantities in connection to mixture management of function MoXAirFl_Adp Member Variable" SWORD rel_sw_b1536 1 100 -1536.000 1535.953 FORMAT "%8.3" ECU_ADDRESS 0x70001834 /end MEASUREMENT
/begin MEASUREMENT MoXAirFl_MixMngtIfClass_V13I.rkteBnk2 "Instance of data class for quantities in connection to mixture management of function MoXAirFl_Adp / Instance of data class for quantities in connection to mixture management of function MoXAirFl_Adp Member Variable" SWORD rel_sw_b1536 1 100 -1536.000 1535.953 FORMAT "%8.3" ECU_ADDRESS 0x70001836 /end MEASUREMENT
/begin MEASUREMENT MoXAirFl_MixMngtIfClass_V13I.rkukg "Instance of data class for quantities in connection to mixture management of function MoXAirFl_Adp / Instance of data class for quantities in connection to mixture management of function MoXAirFl_Adp Member Variable" SWORD rel_sw_b1536 1 100 -1536.000 1535.953 FORMAT "%8.3" ECU_ADDRESS 0x70001838 /end MEASUREMENT
/begin MEASUREMENT MoXAirFl_MixMngtIfClass_V13I.rkukgpfi "Instance of data class for quantities in connection to mixture management of function MoXAirFl_Adp / Instance of data class for quantities in connection to mixture management of function MoXAirFl_Adp Member Variable" SWORD rel_sw_b1536 1 100 -1536.000 1535.953 FORMAT "%8.3" ECU_ADDRESS 0x7000183A /end MEASUREMENT
/begin MEASUREMENT MoXAirFl_MixMngtIfClass_V13I.rlfg "Instance of data class for quantities in connection to mixture management of function MoXAirFl_Adp / Instance of data class for quantities in connection to mixture management of function MoXAirFl_Adp Member Variable" UWORD rel_uw_q0p0234 1 100 0.00 1535.977 FORMAT "%8.3" ECU_ADDRESS 0x7000183C /end MEASUREMENT
/begin MEASUREMENT MoXAirFl_MixMngtIfClass_V13I.rlfgBnk1 "Instance of data class for quantities in connection to mixture management of function MoXAirFl_Adp / Instance of data class for quantities in connection to mixture management of function MoXAirFl_Adp Member Variable" UWORD rel_uw_q0p0234 1 100 0.00 1535.977 FORMAT "%8.3" ECU_ADDRESS 0x7000183E /end MEASUREMENT
/begin MEASUREMENT MoXAirFl_MixMngtIfClass_V13I.rlfgBnk2 "Instance of data class for quantities in connection to mixture management of function MoXAirFl_Adp / Instance of data class for quantities in connection to mixture management of function MoXAirFl_Adp Member Variable" UWORD rel_uw_q0p0234 1 100 0.00 1535.977 FORMAT "%8.3" ECU_ADDRESS 0x70001840 /end MEASUREMENT
/begin MEASUREMENT MoXAirFl_MixMngtIfClass_V13I.rlp "Instance of data class for quantities in connection to mixture management of function MoXAirFl_Adp / Instance of data class for quantities in connection to mixture management of function MoXAirFl_Adp Member Variable" UWORD rel_uw_q0p0234 1 100 0.00 1535.977 FORMAT "%8.3" ECU_ADDRESS 0x70001842 /end MEASUREMENT
/begin MEASUREMENT MoXAirFl_MixMngtIfClass_V13I.rlpBnk1 "Instance of data class for quantities in connection to mixture management of function MoXAirFl_Adp / Instance of data class for quantities in connection to mixture management of function MoXAirFl_Adp Member Variable" UWORD rel_uw_q0p0234 1 100 0.00 1535.977 FORMAT "%8.3" ECU_ADDRESS 0x70001844 /end MEASUREMENT
/begin MEASUREMENT MoXAirFl_MixMngtIfClass_V13I.rlpBnk2 "Instance of data class for quantities in connection to mixture management of function MoXAirFl_Adp / Instance of data class for quantities in connection to mixture management of function MoXAirFl_Adp Member Variable" UWORD rel_uw_q0p0234 1 100 0.00 1535.977 FORMAT "%8.3" ECU_ADDRESS 0x70001846 /end MEASUREMENT
/begin MEASUREMENT MoXAirFl_MixMngtIfClass_V13I.rlrext "Instance of data class for quantities in connection to mixture management of function MoXAirFl_Adp / Instance of data class for quantities in connection to mixture management of function MoXAirFl_Adp Member Variable" UWORD rel_uw_q0p0234 1 100 0.00 1535.977 FORMAT "%8.3" ECU_ADDRESS 0x70001848 /end MEASUREMENT
/begin MEASUREMENT MoXAirFl_MixMngtIfClass_V13I.rlrextBnk1 "Instance of data class for quantities in connection to mixture management of function MoXAirFl_Adp / Instance of data class for quantities in connection to mixture management of function MoXAirFl_Adp Member Variable" UWORD rel_uw_q0p0234 1 100 0.00 1535.977 FORMAT "%8.3" ECU_ADDRESS 0x7000184A /end MEASUREMENT
/begin MEASUREMENT MoXAirFl_MixMngtIfClass_V13I.rlrextBnk2 "Instance of data class for quantities in connection to mixture management of function MoXAirFl_Adp / Instance of data class for quantities in connection to mixture management of function MoXAirFl_Adp Member Variable" UWORD rel_uw_q0p0234 1 100 0.00 1535.977 FORMAT "%8.3" ECU_ADDRESS 0x7000184C /end MEASUREMENT
/begin MEASUREMENT MoXAirFl_MixMngtIfClass_V13I.rlrint "Instance of data class for quantities in connection to mixture management of function MoXAirFl_Adp / Instance of data class for quantities in connection to mixture management of function MoXAirFl_Adp Member Variable" UWORD rel_uw_q0p0234 1 100 0.00 1535.977 FORMAT "%8.3" ECU_ADDRESS 0x7000184E /end MEASUREMENT
/begin MEASUREMENT MoXAirFl_MixMngtIfClass_V13I.rlrintBnk1 "Instance of data class for quantities in connection to mixture management of function MoXAirFl_Adp / Instance of data class for quantities in connection to mixture management of function MoXAirFl_Adp Member Variable" UWORD rel_uw_q0p0234 1 100 0.00 1535.977 FORMAT "%8.3" ECU_ADDRESS 0x70001850 /end MEASUREMENT
/begin MEASUREMENT MoXAirFl_MixMngtIfClass_V13I.rlrintBnk2 "Instance of data class for quantities in connection to mixture management of function MoXAirFl_Adp / Instance of data class for quantities in connection to mixture management of function MoXAirFl_Adp Member Variable" UWORD rel_uw_q0p0234 1 100 0.00 1535.977 FORMAT "%8.3" ECU_ADDRESS 0x70001852 /end MEASUREMENT
/begin MEASUREMENT MoXAirFl_TrqActIfClass_V13I.agIntkClsd "Instance of data class for quantities in connection to actual torque of function MoXAirFl_Adp / Instance of data class for quantities in connection to actual torque of function MoXAirFl_Adp Member Variable" SWORD kw_q0p0156 1 100 -512.0000 511.9844 FORMAT "%8.4" ECU_ADDRESS 0x70001760 /end MEASUREMENT
/begin MEASUREMENT MoXAirFl_TrqActIfClass_V13I.dzworri "Instance of data class for quantities in connection to actual torque of function MoXAirFl_Adp / Instance of data class for quantities in connection to actual torque of function MoXAirFl_Adp Member Variable" SBYTE zw_sb_q0p75 1 100 -96.00 95.25 FORMAT "%5.2" ECU_ADDRESS 0x70001762 /end MEASUREMENT
/begin MEASUREMENT MoXAirFl_TrqActIfClass_V13I.etaaufte "Instance of data class for quantities in connection to actual torque of function MoXAirFl_Adp / Instance of data class for quantities in connection to actual torque of function MoXAirFl_Adp Member Variable" UWORD fak_uw_b2 1 100 0.00 1.999969 FORMAT "%8.6" ECU_ADDRESS 0x70001764 /end MEASUREMENT
/begin MEASUREMENT MoXAirFl_TrqActIfClass_V13I.etazwist "Instance of data class for quantities in connection to actual torque of function MoXAirFl_Adp / Instance of data class for quantities in connection to actual torque of function MoXAirFl_Adp Member Variable" UWORD fak_uw_b2 1 100 0.00 1.999969 FORMAT "%8.6" ECU_ADDRESS 0x70001766 /end MEASUREMENT
/begin MEASUREMENT MoXAirFl_TrqActIfClass_V13I.ratInertCyl "Instance of data class for quantities in connection to actual torque of function MoXAirFl_Adp / Instance of data class for quantities in connection to actual torque of function MoXAirFl_Adp Member Variable" UWORD rel_uw_b100 1 100 0.00 99.99847 FORMAT "%8.5" ECU_ADDRESS 0x70001768 /end MEASUREMENT
/begin MEASUREMENT MoXAirFl_TrqActIfClass_V13I.ratInertEgrExtCyl "Instance of data class for quantities in connection to actual torque of function MoXAirFl_Adp / Instance of data class for quantities in connection to actual torque of function MoXAirFl_Adp Member Variable" UWORD rel_uw_b100 1 100 0.00 99.99847 FORMAT "%8.5" ECU_ADDRESS 0x7000176A /end MEASUREMENT
/begin MEASUREMENT MoXAirFl_TrqActIfClass_V13I.ratInertEgrIntCyl "Instance of data class for quantities in connection to actual torque of function MoXAirFl_Adp / Instance of data class for quantities in connection to actual torque of function MoXAirFl_Adp Member Variable" UWORD rel_uw_b100 1 100 0.00 99.99847 FORMAT "%8.5" ECU_ADDRESS 0x7000176C /end MEASUREMENT
/begin MEASUREMENT MoXAirFl_TrqActIfClass_V13I.zwcalcar_zzylzue "Instance of data class for quantities in connection to actual torque of function MoXAirFl_Adp / Instance of data class for quantities in connection to actual torque of function MoXAirFl_Adp Member Variable" SBYTE zw_sb_q0p75 1 100 -96.00 95.25 FORMAT "%5.2" ECU_ADDRESS 0x7000176E /end MEASUREMENT
/begin MEASUREMENT MoXAirFl_TrqActIfClass_V13I.zwopt "Instance of data class for quantities in connection to actual torque of function MoXAirFl_Adp / Instance of data class for quantities in connection to actual torque of function MoXAirFl_Adp Member Variable" SBYTE zw_sb_q0p75 1 100 -96.00 95.25 FORMAT "%5.2" ECU_ADDRESS 0x7000176F /end MEASUREMENT
/begin MEASUREMENT MoXAirFl_TrqActIfClass_V13I.zwout "Instance of data class for quantities in connection to actual torque of function MoXAirFl_Adp / Instance of data class for quantities in connection to actual torque of function MoXAirFl_Adp Member Variable" SBYTE zw_sb_q0p75 1 100 -96.00 95.25 FORMAT "%5.2" ECU_ADDRESS 0x70001770 /end MEASUREMENT
/begin MEASUREMENT MoXAirFl_TrqActIfClass_V13I.zwoutcpl "Instance of data class for quantities in connection to actual torque of function MoXAirFl_Adp / Instance of data class for quantities in connection to actual torque of function MoXAirFl_Adp Member Variable" UBYTE OneToOne 1 100 0.00 255.0 FORMAT "%5.1" ECU_ADDRESS 0x70001771 /end MEASUREMENT
/begin MEASUREMENT MoXAirFl_TrqActIfClass_V13I.zwouthiresl "Instance of data class for quantities in connection to actual torque of function MoXAirFl_Adp / Instance of data class for quantities in connection to actual torque of function MoXAirFl_Adp" SWORD zw_q0p1 1 100 -3276.800 3276.700 FORMAT "%8.3" ECU_ADDRESS 0x70001772 /end MEASUREMENT
/begin MEASUREMENT MoXAirFl_TrqActIfClass_V13I.zwouthireslAry_zzylzue "Instance of data class for quantities in connection to actual torque of function MoXAirFl_Adp / Instance of data class for quantities in connection to actual torque of function MoXAirFl_Adp" SWORD zw_q0p1 1 100 -3276.800 3276.700 FORMAT "%8.3" ECU_ADDRESS 0x70001774 /end MEASUREMENT
/begin MEASUREMENT MoXAirFl_TrqActIfClass_V13I.zwouthireslRdnt "Instance of data class for quantities in connection to actual torque of function MoXAirFl_Adp / Instance of data class for quantities in connection to actual torque of function MoXAirFl_Adp" UWORD OneToOne 1 100 0.00 65535.00 FORMAT "%8.2" ECU_ADDRESS 0x70001776 /end MEASUREMENT
/begin MEASUREMENT MoXEMM_stEMMAlrms "Status of EMM alarms of MoCEMM_stEmmAlrms" ULONG OneToOne 1 100 0.00 4294967295.00 FORMAT "%13.2" ARRAY_SIZE 22 ECU_ADDRESS 0x50001770 /end MEASUREMENT
/begin MEASUREMENT MoXEMM_stEMMAlrmsAftRst "Status of EMM alarms after initialization (read out of hardware register)" ULONG OneToOne 1 100 0.00 4294967295.00 FORMAT "%13.2" ARRAY_SIZE 22 ECU_ADDRESS 0x500017C8 /end MEASUREMENT
/begin MEASUREMENT MoXEMM_stHwLTResult "Status of Hardware Logic Test errors after initialization" ULONG OneToOne 1 100 0.00 4294967295.00 FORMAT "%13.2" ECU_ADDRESS 0x60001378 /end MEASUREMENT
/begin MEASUREMENT MoXFrm_Buf_AYCF "MoX receive buffer for AYCF" UBYTE OneToOne 1 100 0.00 255.0 FORMAT "%5.1" ARRAY_SIZE 8 ECU_ADDRESS 0x60006377 /end MEASUREMENT
/begin MEASUREMENT MoXFrm_Buf_EAT1 "MoX receive buffer for EAT1" UBYTE OneToOne 1 100 0.00 255.0 FORMAT "%5.1" ARRAY_SIZE 8 ECU_ADDRESS 0x6000636F /end MEASUREMENT
/begin MEASUREMENT MoXFrm_Buf_EAT12 "MoX receive buffer for EAT12" UBYTE OneToOne 1 100 0.00 255.0 FORMAT "%5.1" ARRAY_SIZE 2 ECU_ADDRESS 0x6000636D /end MEASUREMENT
/begin MEASUREMENT MoXFrm_Buf_EAT13 "MoX receive buffer for EAT13" UBYTE OneToOne 1 100 0.00 255.0 FORMAT "%5.1" ARRAY_SIZE 3 ECU_ADDRESS 0x6000636A /end MEASUREMENT
/begin MEASUREMENT MoXFrm_Buf_EAT4 "MoX receive buffer for EAT4" UBYTE OneToOne 1 100 0.00 255.0 FORMAT "%5.1" ARRAY_SIZE 8 ECU_ADDRESS 0x60006362 /end MEASUREMENT
/begin MEASUREMENT MoXFrm_Buf_EATB "MoX receive buffer for EATB" UBYTE OneToOne 1 100 0.00 255.0 FORMAT "%5.1" ARRAY_SIZE 8 ECU_ADDRESS 0x6000635A /end MEASUREMENT
/begin MEASUREMENT MoXFrm_Buf_GWIMG3 "MoX receive buffer for GWIMG3" UBYTE OneToOne 1 100 0.00 255.0 FORMAT "%5.1" ARRAY_SIZE 8 ECU_ADDRESS 0x60006352 /end MEASUREMENT
/begin MEASUREMENT MoXFrm_Buf_META "MoX receive buffer for META" UBYTE OneToOne 1 100 0.00 255.0 FORMAT "%5.1" ARRAY_SIZE 8 ECU_ADDRESS 0x6000634A /end MEASUREMENT
/begin MEASUREMENT MoXFrm_Buf_METL "MoX receive buffer for METL" UBYTE OneToOne 1 100 0.00 255.0 FORMAT "%5.1" ARRAY_SIZE 4 ECU_ADDRESS 0x60006346 /end MEASUREMENT
/begin MEASUREMENT MoXFrm_flgUpdAYCF "Info of updated CAN Data of AYCF" UBYTE B_TRUE 1 100 0.00 1.00000000000 BIT_MASK 0x1 FORMAT "%13.11" ECU_ADDRESS 0x60006345 /end MEASUREMENT
/begin MEASUREMENT MoXFrm_flgUpdEAT1 "Info of updated CAN Data of EAT" UBYTE B_TRUE 1 100 0.00 1.00000000000 BIT_MASK 0x1 FORMAT "%13.11" ECU_ADDRESS 0x60006344 /end MEASUREMENT
/begin MEASUREMENT MoXFrm_flgUpdEAT12 "Info of updated CAN Data of EAT12" UBYTE B_TRUE 1 100 0.00 1.00000000000 BIT_MASK 0x1 FORMAT "%13.11" ECU_ADDRESS 0x60006343 /end MEASUREMENT
/begin MEASUREMENT MoXFrm_flgUpdEAT13 "Info of updated CAN Data of EAT13" UBYTE B_TRUE 1 100 0.00 1.00000000000 BIT_MASK 0x1 FORMAT "%13.11" ECU_ADDRESS 0x60006342 /end MEASUREMENT
/begin MEASUREMENT MoXFrm_flgUpdEAT4 "Info of updated CAN Data of EAT4" UBYTE B_TRUE 1 100 0.00 1.00000000000 BIT_MASK 0x1 FORMAT "%13.11" ECU_ADDRESS 0x60006341 /end MEASUREMENT
/begin MEASUREMENT MoXFrm_flgUpdEATB "Info of updated CAN Data of EATB" UBYTE B_TRUE 1 100 0.00 1.00000000000 BIT_MASK 0x1 FORMAT "%13.11" ECU_ADDRESS 0x60006340 /end MEASUREMENT
/begin MEASUREMENT MoXFrm_flgUpdGWIMG3 "Info of updated CAN Data of GWIMG3" UBYTE B_TRUE 1 100 0.00 1.00000000000 BIT_MASK 0x1 FORMAT "%13.11" ECU_ADDRESS 0x6000633F /end MEASUREMENT
/begin MEASUREMENT MoXFrm_flgUpdMETA "Info of updated CAN Data of META" UBYTE B_TRUE 1 100 0.00 1.00000000000 BIT_MASK 0x1 FORMAT "%13.11" ECU_ADDRESS 0x6000633E /end MEASUREMENT
/begin MEASUREMENT MoXFrm_flgUpdMETL "Info of updated CAN Data of METL" UBYTE B_TRUE 1 100 0.00 1.00000000000 BIT_MASK 0x1 FORMAT "%13.11" ECU_ADDRESS 0x6000633D /end MEASUREMENT
/begin MEASUREMENT MoXSyncLos_cntrSyncCplMsg "synchro task counter complement in extended monitoring" UBYTE OneToOne 1 100 0.00 255.0 FORMAT "%5.1" ECU_ADDRESS 0x70001C17 /end MEASUREMENT
/begin MEASUREMENT MoXSyncLos_cntrSyncMsg "synchro task counter in extended monitoring" UBYTE OneToOne 1 100 0.00 255.0 FORMAT "%5.1" ECU_ADDRESS 0x70001C16 /end MEASUREMENT
/begin MEASUREMENT MoXSyncLos_nEng10msLocMsg "engine speed calculated in 10ms in extended monitoring" SWORD nmot_q0p5 1 100 -16384.00 16383.50 FORMAT "%8.2" ECU_ADDRESS 0x60004FE2 /end MEASUREMENT
/begin MEASUREMENT MoXSyncLos_nEng10msLoReslMsg "engine speed (low resolution) calculated in 10ms in extended monitoring" UBYTE nmot_q40 1 100 0.00 10200. FORMAT "%5.0" ECU_ADDRESS 0x6000A324 /end MEASUREMENT
/begin MEASUREMENT MoXSyncLos_nEng10msMsg "engine speed calculated in 10ms in extended monitoring" SWORD nmot_q0p5 1 100 -16384.00 16383.50 FORMAT "%8.2" ECU_ADDRESS 0x60004FE0 /end MEASUREMENT
/begin MEASUREMENT MoXTrqPtd_cntrDebErrMaxDisblTqEm "Debounce counter to set the e-machine maximum torque limit to 0 Nm in case of pending maximum sum torque comparison error" UBYTE OneToOne 1 100 0.00 255.0 FORMAT "%5.1" ECU_ADDRESS 0x6000633C /end MEASUREMENT
/begin MEASUREMENT MoXTrqPtd_cntrDebErrMaxRedTqEm "Debounce counter to reduce the maximum e-machine torque in case of pending maximum sum torque comparison error" UBYTE OneToOne 1 100 0.00 255.0 FORMAT "%5.1" ECU_ADDRESS 0x6000633B /end MEASUREMENT
/begin MEASUREMENT MoXTrqPtd_cntrDebErrMinRedTqEm "Debounce counter to reduce the minimum e-machine torque in case of pending minimum torque comparison error" UBYTE OneToOne 1 100 0.00 255.0 FORMAT "%5.1" ECU_ADDRESS 0x6000633A /end MEASUREMENT
/begin MEASUREMENT MoXTrqPtd_cntrDebErrTqMaxEm "Debounce counter to reduce the maximum e-machine torque in case of maximum e-machine torque comparison error in extended function monitoring" UBYTE OneToOne 1 100 0.00 255.0 FORMAT "%5.1" ECU_ADDRESS 0x60006339 /end MEASUREMENT
/begin MEASUREMENT MoXTrqPtd_flgErrLoadShiftTqEm "Load point shift activ in extended function monitoring in case of pending maximum sum torque comparison error" UBYTE B_TRUE 1 100 0.00 1.00000000000 BIT_MASK 0x1 FORMAT "%13.11" ECU_ADDRESS 0x70000179 /end MEASUREMENT
/begin MEASUREMENT MoXTrqPtd_flgErrMaxDisblTqEm "E-machine maximum torque limit set to 0 Nm in case of pending maximum sum torque comparison error" UBYTE B_TRUE 1 100 0.00 1.00000000000 BIT_MASK 0x1 FORMAT "%13.11" ECU_ADDRESS 0x70000178 /end MEASUREMENT
/begin MEASUREMENT MoXTrqPtd_flgErrMaxRedTqEm "The maximum e-machine torque is reduced in case of pending maximum sum torque comparison error" UBYTE B_TRUE 1 100 0.00 1.00000000000 BIT_MASK 0x1 FORMAT "%13.11" ECU_ADDRESS 0x70000177 /end MEASUREMENT
/begin MEASUREMENT MoXTrqPtd_flgErrMinEmDeb "The minimum e-machine torque is reduced in case of pending minimum torque comparison error" UBYTE B_TRUE 1 100 0.00 1.00000000000 BIT_MASK 0x1 FORMAT "%13.11" ECU_ADDRESS 0x70000176 /end MEASUREMENT
/begin MEASUREMENT MoXTrqPtd_flgErrTqMaxEm "Error detected in maximum e-machine torque comparison in extended function monitoring" UBYTE B_TRUE 1 100 0.00 1.00000000000 BIT_MASK 0x1 FORMAT "%13.11" ECU_ADDRESS 0x70000175 /end MEASUREMENT
/begin MEASUREMENT MoXTrqPtd_flgErrTqMaxEmDeb "Debounced maximum e-machine torque comparison error in extended function monitoring" UBYTE B_TRUE 1 100 0.00 1.00000000000 BIT_MASK 0x1 FORMAT "%13.11" ECU_ADDRESS 0x70000174 /end MEASUREMENT
/begin MEASUREMENT MoXTrqPtd_tqCrksftEmFild "Filtered e-machine permitted torque without offset" SWORD md_q0p1 1 100 -3276.800 3276.700 FORMAT "%8.3" ECU_ADDRESS 0x60004FDE /end MEASUREMENT
/begin MEASUREMENT MoXTrqPtd_tqCrksftEmOffsFild "Filtered e-machine permitted torque with offset in extended function monitoring" SWORD md_q0p1 1 100 -3276.800 3276.700 FORMAT "%8.3" ECU_ADDRESS 0x600036B2 /end MEASUREMENT
/begin MEASUREMENT MoXTrqPtd_tqCrksftEmPT1In "Delayed permitted e-machine torque" SWORD md_q0p1 1 100 -3276.800 3276.700 FORMAT "%8.3" ECU_ADDRESS 0x600036B0 /end MEASUREMENT
/begin MEASUREMENT MoXTrqPtd_tqErrMaxDisblTqEm "Maximum permitted e-machine torque in case of torque disabling request in extended function monitoring" SWORD md_q0p1 1 100 -3276.800 3276.700 FORMAT "%8.3" ECU_ADDRESS 0x600036AE /end MEASUREMENT
/begin MEASUREMENT MoXTrqPtd_tqErrMaxRedTqEm "Maximum permitted e-machine torque in case of torque reduction request in extended function monitoring" SWORD md_q0p1 1 100 -3276.800 3276.700 FORMAT "%8.3" ECU_ADDRESS 0x600036AC /end MEASUREMENT
/begin MEASUREMENT MoXTrqPtd_tqMaxLimEm "Maximum E-machine torque from Extended monitoring" SWORD md_q0p1 1 100 -3276.800 3276.700 FORMAT "%8.3" ECU_ADDRESS 0x60004FDC /end MEASUREMENT
/begin MEASUREMENT MoXTrqPtd_tqMaxLimEmOffs "Maximum permitted e-machine torque with offset in extended function monitoring" SWORD md_q0p1 1 100 -3276.800 3276.700 FORMAT "%8.3" ECU_ADDRESS 0x600036AA /end MEASUREMENT
/begin MEASUREMENT MoXTrqPtd_tqMinLimEm "Minimum E-machine torque from Extended monitoring" SWORD md_q0p1 1 100 -3276.800 3276.700 FORMAT "%8.3" ECU_ADDRESS 0x60004FDA /end MEASUREMENT
/begin MEASUREMENT MoX_bSyncLos_msg "Message for condition loss of synchronization in extended monitoring with respect to MDG1" UBYTE B_TRUE 1 100 0.00 1.00000000000 BIT_MASK 0x1 FORMAT "%13.11" ECU_ADDRESS 0x700006B9 /end MEASUREMENT
/begin MEASUREMENT MoX_bSyncRecg "condition synchro recognized in extended monitoring" UBYTE B_TRUE 1 100 0.00 1.00000000000 BIT_MASK 0x1 FORMAT "%13.11" ECU_ADDRESS 0x7000017A /end MEASUREMENT
/begin MEASUREMENT MoX_trqInrMinWoCtOff "minimum inner torque in combusted operation in the extended monitoring" UBYTE md_q1p6 1 100 0.00 408.0 FORMAT "%5.1" ECU_ADDRESS 0x6000A323 /end MEASUREMENT
/begin MEASUREMENT Mo_bAftStrt "Condition engine speed above the start threshold in the function monitoring" UBYTE B_TRUE 1 100 0.00 1.00000000000 BIT_MASK 0x1 FORMAT "%13.11" ECU_ADDRESS 0x60011FBC /end MEASUREMENT
/begin FUNCTION MoFStrt_In "92.0.0    Function Monitoring: Input signals start"
 /begin DEF_CHARACTERISTIC MoFStrt_cntrUnderVltg_C MoFStrt_ctDebClthImpsOff_C MoFStrt_ctDebClthImpsOn_C MoFStrt_ctDebPushBtnDfl_C MoFStrt_ctDebPushBtn_C MoFStrt_ctDebT50HiLo_C MoFStrt_ctDebT50LoHi_C MoFStrt_ctHWBrkDeactvnDly_C MoFStrt_flgTraMT_C MoFStrt_stSTSwitchMnl_C MoFStrt_swtBrkCnd_C MoFStrt_swtClthPlausChk_C MoFStrt_swtInvSTSwitch_C MoFStrt_swtSigNPos_C MoFStrt_swtSTSwitchMnl_C /end DEF_CHARACTERISTIC
 /begin IN_MEASUREMENT MoFBrk_flgMaiBrk MoFBrk_flgRdntBrk MoFClth_flgClthBot MoFClth_flgClthTop MoFFrm_flgBrkHldActv MoFFrm_Rx_flgTMStrtEna_EAT12 MoFFrm_Rx_flgTMStrtEna_EAT13 MoFFrm_Rx_stPdu_EAT12 MoFFrm_Rx_stPdu_EAT13 MoFStrt_stStrtActv Mo_stCplChk Mo_stMoC Mo_stMoCCpl /end IN_MEASUREMENT
 /begin OUT_MEASUREMENT MoFStrt_flgBrkHldActv MoFStrt_flgClthSwtImps MoFStrt_flgMonDisbl MoFStrt_flgSTSwitchRaw MoFStrt_stFFPushBtn MoFStrt_stT50 /end OUT_MEASUREMENT
 /begin LOC_MEASUREMENT MoFStrtIn_bbLoc1Cpl MoFStrtIn_bbOut1Cpl MoFStrt_cntrUnderVltg MoFStrt_cntrUnderVltgCpl MoFStrt_ctDebClthImpsOff MoFStrt_ctDebClthImpsOffCpl MoFStrt_ctDebClthImpsOn MoFStrt_ctDebClthImpsOnCpl MoFStrt_ctDebPushBtn MoFStrt_ctDebPushBtnCpl MoFStrt_ctDebT50 MoFStrt_ctDebT50Cpl MoFStrt_ctHWBrkDeactvnDly MoFStrt_ctHWBrkDeactvnDlyCpl MoFStrt_flgDioStrtNeutrGearErr MoFStrt_flgDioT50Err MoFStrt_flgSTSwitch MoFStrt_flgT50 MoFStrt_flgTMStrtEna MoFStrt_stDioStrtNeutrGear MoFStrt_stDioStrtNeutrGearCpl MoFStrt_stFFPushBtnCpl MoFStrt_stHWBrkDeactvnDlyMem MoFStrt_stHWBrkDeactvnDlyMemCpl MoFStrt_stT50Cpl MoFStrt_stT50DebMem MoFStrt_stT50DebMemCpl MoFStrt_stT50Raw MoFStrt_stT50RawCpl /end LOC_MEASUREMENT
 FUNCTION_VERSION "92.0.0" /end FUNCTION
/begin FUNCTION MoFStrt_Rls "32.0.0    Function Monitoring: Release start" /begin DEF_CHARACTERISTIC MoFStrt_cntrStrtRls_C /end DEF_CHARACTERISTIC
 /begin IN_MEASUREMENT MoFStrt_flgMonDisbl MoFStrt_flgStrtPtd MoFStrt_flgStrtRly Mo_stCplChk Mo_stMoC Mo_stMoCCpl Mo_stMoF Mo_stMoFCpl /end IN_MEASUREMENT
 /begin OUT_MEASUREMENT MoFStrt_flgIrrvErrStrtRlsMsg MoFStrt_flgTstStrtRlsMsg MoFStrt_stStrtMsg /end OUT_MEASUREMENT
 /begin LOC_MEASUREMENT MoFStrt_cntrStrtRels MoFStrt_cntrStrtRelsCpl MoFStrt_flgTmpErrStrtRels_MP /end LOC_MEASUREMENT
 FUNCTION_VERSION "32.0.0" /end FUNCTION
/begin FUNCTION MoFTEng_Co "35.2.0    Function Monitoring: Engine temperature"
 /begin DEF_CHARACTERISTIC MoF_nEngShOff_C MoF_nEngStrt_C MoF_tEngGradNrmOp16_MAP MoF_tEngGradOvrRun_MAP MoF_tEngModMax_C MoF_tEngModOfs_C MoF_tEng_DST MoF_tiTEngEna_C /end DEF_CHARACTERISTIC
 /begin IN_MEASUREMENT CEngDsT_t etaaus_um MoFESpd_nEng MoF_rAMPTLam Mo_stCplChk Mo_stMoC Mo_stMoCCpl /end IN_MEASUREMENT
 /begin OUT_MEASUREMENT MoFTEng_tEng MoF_tEng MoF_tEng_DST_result MoF_tiAftStrt /end OUT_MEASUREMENT
 /begin LOC_MEASUREMENT MoFTEngCo_bbLoc1Cpl MoFTEng_mfVal MoFTEng_mfValCpl MoFTEng_tEngCpl MoF_tEngCpl MoF_tEngLonWrd MoF_tEngLonWrdCpl MoF_tEngMod MoF_tEngModCpl MoF_tEng_DST_resultCpl MoF_tiAftStrtCpl Mo_bAftStrt /end LOC_MEASUREMENT
 FUNCTION_VERSION "35.2.0" /end FUNCTION
/begin FUNCTION MoFTra_Co "171.0.0   Function Monitoring: Transmission intervention"
 /begin DEF_CHARACTERISTIC MoFTra_cntrDebTSCDeactv_C MoFTra_rTqBoostMinLim_C MoFTra_rTqCnvrBoostDft_C /end DEF_CHARACTERISTIC
 /begin IN_MEASUREMENT MoFFrm_flgDecIntvActvTra MoFFrm_flgTqUpReqTra MoFFrm_rTqCnvrBoost MoFFrm_tqCluTra Mo_stCplChk Mo_stMoC Mo_stMoCCpl Tra_trqDesMin /end IN_MEASUREMENT
 /begin OUT_MEASUREMENT MoFTra_flgDecIntvActv MoFTra_flgTSCPtd MoFTra_rTqCnvrBoost MoFTra_tqClthPtd /end OUT_MEASUREMENT
 /begin LOC_MEASUREMENT MoFTraCo_bbOut1Cpl MoFTra_cntrDebTSCDeactv MoFTra_cntrDebTSCDeactvCpl MoFTra_rTqCnvrBoostCpl MoFTra_tqClthPtdCpl /end LOC_MEASUREMENT
 FUNCTION_VERSION "171.0.0" /end FUNCTION
/begin FUNCTION MoFTrqAct_Eng "97.0.0    Function monitoring: Actual engine torque" /begin DEF_CHARACTERISTIC MoFTrqAct_nEng_Ax MoFTrqAct_ratFillg_Ax MoFTrqAct_tqOptm_M /end DEF_CHARACTERISTIC
 /begin IN_MEASUREMENT MoFAirFl_etaIA MoFAirFl_etaInjCtOff MoFAirFl_etaInjSplt MoFAirFl_etaLam MoFAirFl_ratFillg MoFESpd_nEng MoF_ignCtOffMsk Mo_stCplChk Mo_stMoC Mo_stMoCCpl /end IN_MEASUREMENT
 /begin OUT_MEASUREMENT MoFTrqAct_ratTqInr MoF_rTrqInrAct MoF_rTrqInrOpt /end OUT_MEASUREMENT
 /begin LOC_MEASUREMENT MoFTrqAct_nEng_Ax_result MoFTrqAct_ratFillg_Ax_result MoFTrqAct_ratTqInrCpl MoF_rTrqInrActCpl MoF_rTrqInrOptCpl /end LOC_MEASUREMENT
 FUNCTION_VERSION "97.0.0" /end FUNCTION
/begin FUNCTION MoFTrqAct_Sum "13.0.0    Function monitoring: Actual sum torque" /begin REF_CHARACTERISTIC MoFTrqPtd_rBltDrv_C Mo_trqIdcMax_C /end REF_CHARACTERISTIC
 /begin IN_MEASUREMENT MoFHybRx_tqActEm MoFTrqAct_ratTqInr MoF_trqLos Mo_stCplChk Mo_stMoC Mo_stMoCCpl /end IN_MEASUREMENT
 /begin OUT_MEASUREMENT MoFTrqAct_tqCrksftEm MoFTrqAct_tqCrksftEmMsg MoFTrqAct_tqSumClu /end OUT_MEASUREMENT
 /begin LOC_MEASUREMENT MoFTrqAct_tqActCmbEng_MP MoFTrqAct_tqCrksftEmCpl MoFTrqAct_tqSumCluCpl /end LOC_MEASUREMENT
 FUNCTION_VERSION "13.0.0" /end FUNCTION
/begin FUNCTION MoFTrqCmp_Eng "38.0.0    Function Monitoring: Torque comparison engine"
 /begin DEF_CHARACTERISTIC MoFTrqCmp_facTqErrMax_C MoFTrqCmp_facTqErrMin_C MoF_ctRstTrqCmp_C MoF_ctTrqCmp_C MoF_ctTstTrqCmp_C MoF_facTrqErrSumDet_C MoF_nEngTstTrqCmp_C MoF_rTrqPtdFltWgh_CUR /end DEF_CHARACTERISTIC
 /begin IN_MEASUREMENT MoFESpd_nEng MoF_rTrqInrAct MoF_rTrqPtdFlt Mo_bPostDrv Mo_bPreDrv Mo_ctRst Mo_ctRstCpl Mo_stCplChk Mo_stMoC Mo_stMoCCpl Mo_stMoF Mo_stMoFCpl /end IN_MEASUREMENT
 /begin OUT_MEASUREMENT MoFTrqCmp_flgIrrvErrEngMsg MoFTrqCmp_flgTestEngMsg MoF_ctTrqCmp MoF_facTrqErrSum /end OUT_MEASUREMENT
 /begin LOC_MEASUREMENT MoFTrqCmp_flgClrEng MoF_ctTrqCmpCpl MoF_ctTstTrqCmp MoF_facTrqErrSumCpl MoF_rTrqPtdFltWgh_mp /end LOC_MEASUREMENT
 FUNCTION_VERSION "38.0.0" /end FUNCTION
/begin FUNCTION MoFTrqCmp_Max "8.0.0     Function Monitoring: Torque comparison maximum sum torque"
 /begin DEF_CHARACTERISTIC MoFTrqCmp_cntrRstTqCompMax_C MoFTrqCmp_cntrTestTqCompMax_C MoFTrqCmp_cntrTqCompMax_C MoFTrqCmp_nEngTestTqCompMax_C /end DEF_CHARACTERISTIC
 /begin IN_MEASUREMENT MoFESpd_nEng MoFTrqAct_tqSumClu MoFTrqPtd_tqCluSumPtdFildOffs Mo_bPostDrv Mo_bPreDrv Mo_ctRst Mo_ctRstCpl Mo_stCplChk Mo_stMoC Mo_stMoCCpl Mo_stMoF Mo_stMoFCpl /end IN_MEASUREMENT
 /begin OUT_MEASUREMENT MoFTrqCmp_flgErrMaxPndMsg MoFTrqCmp_flgIrrvErrMax MoFTrqCmp_flgIrrvErrMaxMsg MoFTrqCmp_flgTestTrqCmpMaxMsg /end OUT_MEASUREMENT
 /begin LOC_MEASUREMENT MoFTrqCmpMax_bbOut1Cpl MoFTrqCmp_cntrTestTqCompMax MoFTrqCmp_cntrTqCompMax MoFTrqCmp_cntrTqCompMaxCpl MoFTrqCmp_flgClrMax /end LOC_MEASUREMENT
 FUNCTION_VERSION "8.0.0" /end FUNCTION
/begin FUNCTION MoFTrqCmp_Min "8.0.0     Function Monitoring: Torque comparison minimal sum torque"
 /begin DEF_CHARACTERISTIC MoFTrqCmp_cntrTestTqCompMin_C MoFTrqCmp_cntrTqCompMin_C MoFTrqCmp_nEngTestTqCompMin_C /end DEF_CHARACTERISTIC
 /begin IN_MEASUREMENT MoFESpd_nEng MoFTrqAct_tqCrksftEm MoFTrqPtd_tqCrksftEmMinFildOffs Mo_stCplChk Mo_stMoC Mo_stMoCCpl Mo_stMoF /end IN_MEASUREMENT
 /begin OUT_MEASUREMENT MoFTrqCmp_flgErrMinPndMsg MoFTrqCmp_flgIrrvErrMin MoFTrqCmp_flgIrrvErrMinMsg MoFTrqCmp_flgTestTqCompMinMsg /end OUT_MEASUREMENT
 /begin LOC_MEASUREMENT MoFTrqCmpMin_bbOut1Cpl MoFTrqCmp_cntrTestTqCompMin MoFTrqCmp_cntrTqCompMin MoFTrqCmp_cntrTqCompMinCpl MoFTrqCmp_flgClrMin /end LOC_MEASUREMENT
 FUNCTION_VERSION "8.0.0" /end FUNCTION
/begin FUNCTION MoFTrqLim_Eng "14.2.0    Function Monitoring: Torque limits engine"
 /begin DEF_CHARACTERISTIC MoFTrqPtd_tiTrqMaxStrt_C MoFTrqPtd_tqInrMaxStrt_C MoF_facMinRTrqInrMax_C MoF_facTrqMinOvrRun_CUR MoF_rTrqInrMax_CUR MoF_trqInrMinIncr_CUR MoF_trqMinAirChrg_MAP /end DEF_CHARACTERISTIC
 /begin REF_CHARACTERISTIC MoFESpd_nEng_Ax MoF_tEng_DST Mo_trqIdcMax_C /end REF_CHARACTERISTIC
 /begin IN_MEASUREMENT MoFAirFl_etaInjCtOff MoFESpd_nEng MoFESpd_nEng_Ax_result MoFTEng_tEng MoF_tEng MoF_tEng_DST_result MoF_tiAftStrt MoF_trqLos MoX_trqInrMinWoCtOff Mo_stCplChk Mo_stMoC Mo_stMoCCpl RngMod_trqInrMax /end IN_MEASUREMENT
 /begin OUT_MEASUREMENT MoFTrqLim_tqInrMinWoCtOffMsg MoF_rTrqInrMax MoF_trqInrMinWoCtOff /end OUT_MEASUREMENT
 /begin LOC_MEASUREMENT MoF_rTrqInrMaxCpl MoF_trqInrMinWoCtOffCpl /end LOC_MEASUREMENT
 FUNCTION_VERSION "14.2.0" /end FUNCTION
/begin FUNCTION MoFTrqLos_Co "45.2.1    Function Monitoring: Torque losses"
 /begin DEF_CHARACTERISTIC MoF_trqAdap_C MoF_trqChrChg_CUR MoF_trqConvNAP1_MAP MoF_trqConvNT1_MAP MoF_trqDesAlt_MAP MoF_trqDrag_MAP MoF_trqLosTra_CUR MoF_trqLtdAC_CUR MoF_trqLtdFan_CUR MoF_trqStrgLtd_C /end DEF_CHARACTERISTIC
 /begin REF_CHARACTERISTIC MoFESpd_nEng_Ax MoF_rAPP_DST MoF_tEng_DST /end REF_CHARACTERISTIC
 /begin IN_MEASUREMENT Conv_trqLd ESS_trqDesAcs MoFESpd_nEng MoFESpd_nEng_Ax_result MoF_rAPP MoF_rAPP_DST_result MoF_tEng MoF_tEng_DST_result Mo_stCplChk Mo_stMoC Mo_stMoCCpl RngMod_trqComp RngMod_trqDiffAdap RngMod_trqLosEng Tra_trqLos TS_trqDesAcs VehMot_trqDesAcs /end IN_MEASUREMENT
 /begin OUT_MEASUREMENT MoFTrqLos_tqLosTotMsg MoFTrqPtd_tqCmpNotSwilLoss MoFTrqPtd_tqCmpSwilLoss MoF_trqAcs MoF_trqCalCompDes MoF_trqFulCompDes MoF_trqLos MoF_trqLosComp MoF_trqLosMsg MoF_trqLosPT MoF_trqLosTot /end OUT_MEASUREMENT
 /begin LOC_MEASUREMENT MoFTrqLos_tqChrgChg_mp MoFTrqLos_tqConvLd_mp MoFTrqLos_tqTraLoss_mp MoFTrqPtd_tqCmpNotSwilLossCpl MoFTrqPtd_tqCmpSwilLossCpl MoF_tqAdap MoF_tqAdapCpl MoF_trqAcsCpl MoF_trqCalCompDesCpl MoF_trqFulCompDesCpl MoF_trqLosCompCpl MoF_trqLosCpl MoF_trqLosPTCpl MoF_trqLosTotCpl /end LOC_MEASUREMENT
 FUNCTION_VERSION "45.2.1" /end FUNCTION
/begin FUNCTION MoFTrqPtd_Emac "5.5.0     Function Monitoring: Maximum permitted torque for electrical machine"
 /begin DEF_CHARACTERISTIC MoFTrqPtd_nEngRlsStrtThdMax_C MoFTrqPtd_nEngRlsStrtThdMin_C MoFTrqPtd_rBltDrv_C MoFTrqPtd_stTqCtrldOperMod_C MoFTrqPtd_stVoltCtrldOperMod_C MoFTrqPtd_tiDebComErrElDrvThd_C MoFTrqPtd_tiDebIrrvCmpErr_C MoFTrqPtd_tiDebIrvErrElDrvThd_C MoFTrqPtd_tqCkrsftStrtMaxEm_T MoFTrqPtd_tqCrsMaxEM_T MoFTrqPtd_tqCrsMinEM_T MoFTrqPtd_tqMaxEmOffs_T MoFTrqPtd_tqMinEmOffs_T MoFTrqPtd_tqOffsReslEmTq_C /end DEF_CHARACTERISTIC
 /begin IN_MEASUREMENT ElM_stOperModDes ElM_tqDes ElM_tqMaxGenr ElM_tqMaxTqCtrl ElM_tqMinTqCtrl MoFESpd_nEng MoFHybRx_flgComErrElDrv MoFHybRx_flgIrvErrElDrv MoFStrt_flgStrtPtd MoFTrqCmp_flgIrrvErrMax MoFTrqCmp_flgIrrvErrMin MoFTrqPtd_tqCluSumPtdFildRaw MoFTrqPtd_tqVehPtdWoIntvMin MoF_trqLos MoXTrqPtd_tqMaxLimEm MoXTrqPtd_tqMinLimEm Mo_stCplChk Mo_stMoC Mo_stMoCCpl PTDist_flgEmStrtgTqActv /end IN_MEASUREMENT
 /begin OUT_MEASUREMENT MoFTrqPtd_flgComErrDebElDrv MoFTrqPtd_flgErrElDrv MoFTrqPtd_flgFailErrDebElDrv MoFTrqPtd_flgTqEmLimdMsg MoFTrqPtd_stOperModDesElDrv MoFTrqPtd_stOperModDesElDrvMsg MoFTrqPtd_tqCrksftMaxEmOperMod MoFTrqPtd_tqCrsEM MoFTrqPtd_tqCrsEmMaxMsg MoFTrqPtd_tqCrsEmMinMsg MoFTrqPtd_tqCrsEMMsg MoFTrqPtd_tqCrsMinEM MoFTrqPtd_tqEM MoFTrqPtd_tqEmMsg MoFTrqPtd_tqMaxEm MoFTrqPtd_tqMaxEmMsg MoFTrqPtd_tqMinEM MoFTrqPtd_tqMinEmMsg MoFTrqPtd_tqSelEM /end OUT_MEASUREMENT
 /begin LOC_MEASUREMENT MoFTrqPtdEmac_bbOut1Cpl MoFTrqPtd_stOperModDesElDrvCpl MoFTrqPtd_tiDebComErrElDrv MoFTrqPtd_tiDebComErrElDrvCpl MoFTrqPtd_tiDebIrrvCmpErr MoFTrqPtd_tiDebIrrvCmpErrCpl MoFTrqPtd_tiDebIrvErrElDrv MoFTrqPtd_tiDebIrvErrElDrvCpl MoFTrqPtd_tqCrksftMaxEmOperModCpl MoFTrqPtd_tqCrsEMCpl MoFTrqPtd_tqCrsMinEMCpl MoFTrqPtd_tqEMCpl MoFTrqPtd_tqMaxEmCpl MoFTrqPtd_tqMinEMCpl MoFTrqPtd_tqSelCrksftMaxEm MoFTrqPtd_tqSelCrksftMaxEmCpl MoFTrqPtd_tqSelEMCpl /end LOC_MEASUREMENT
 FUNCTION_VERSION "5.5.0" /end FUNCTION
/begin FUNCTION MoFTrqPtd_Eng "54.3.0    Function Monitoring: Maximum permitted engine torque"
 /begin DEF_CHARACTERISTIC MoFTrqPtd_rTrqPtdOffs_M MoFTrqPtd_tiDlyPtdEngArysize_C MoFTrqPtd_tiDlyPtdTqEng_C MoFTrqPtd_tiFiltgTqPtdEng_C /end DEF_CHARACTERISTIC
 /begin REF_CHARACTERISTIC Mo_trqIdcMax_C /end REF_CHARACTERISTIC
 /begin IN_MEASUREMENT MoFESpd_nEng MoFExtInt_tqCluPtdCoord MoFSpdG_tqPtd MoFTrqPtd_facCmpSpdGovr MoFTrqPtd_tqCmpSwilLoss MoFTrqPtd_tqCrsEM MoFTrqPtd_tqVehPtdWoInt MoF_trqInrMinWoCtOff MoF_trqLos Mo_stCplChk Mo_stMoC Mo_stMoCCpl /end IN_MEASUREMENT
 /begin OUT_MEASUREMENT MoFCoOfs_rTrqPtd MoFTrqPtd_tqCompMsg MoFTrqPtd_tqInrPtd MoFTrqPtd_tqInrPtdMsg MoF_rTrqPtdFlt /end OUT_MEASUREMENT
 /begin LOC_MEASUREMENT MoFCoOfs_rTrqPtdCpl MoFTrqPtd_rTrqPtdFltWoOffs MoFTrqPtd_rTrqPtdFltWoOffsCpl MoFTrqPtd_tqCluSumPtd MoFTrqPtd_tqCluSumPtdCpl MoFTrqPtd_tqInnrPtdFild MoFTrqPtd_tqInnrPtdFildAry MoFTrqPtd_tqInnrPtdFildAryCpl MoFTrqPtd_tqInnrPtdFildCpl MoFTrqPtd_tqInrPtdCpl MoF_rTrqPtdFltCpl /end LOC_MEASUREMENT
 FUNCTION_VERSION "54.3.0" /end FUNCTION
/begin FUNCTION MoFTrqPtd_Max "17.3.0    Function Monitoring: Maximum permitted sum torque"
 /begin DEF_CHARACTERISTIC MoFTrqPtd_tiDlyTqPtdMaxArysize_C MoFTrqPtd_tiDlyTqPtdMax_C MoFTrqPtd_tiFiltgTqPtdMax_C MoFTrqPtd_tqSumPtdOffs_M /end DEF_CHARACTERISTIC
 /begin IN_MEASUREMENT MoFESpd_nEng MoFExtInt_tqCluPtdCoord MoFSpdG_tqPtd MoFTrqPtd_facCmpSpdGovr MoFTrqPtd_tqCmpSwilLoss MoFTrqPtd_tqVehPtdWoInt MoF_trqInrMinWoCtOff MoF_trqLos Mo_stCplChk Mo_stMoC Mo_stMoCCpl /end IN_MEASUREMENT
 /begin OUT_MEASUREMENT MoFTrqPtd_tqCluSumPtdFildOffs MoFTrqPtd_tqCluSumPtdFildRaw MoFTrqPtd_tqCluSumPtdUnfild /end OUT_MEASUREMENT
 /begin LOC_MEASUREMENT MoFTrqPtd_tqCluSumPtdFild MoFTrqPtd_tqCluSumPtdFildAry MoFTrqPtd_tqCluSumPtdFildAryCpl MoFTrqPtd_tqCluSumPtdFildCpl MoFTrqPtd_tqCluSumPtdFildOffsCpl MoFTrqPtd_tqCluSumPtdFildRawCpl MoFTrqPtd_tqCluSumPtdUnfildCpl /end LOC_MEASUREMENT
 FUNCTION_VERSION "17.3.0" /end FUNCTION
/begin FUNCTION MoFTrqPtd_Min "16.0.0    Function Monitoring: Minimum permitted sum torque"
 /begin DEF_CHARACTERISTIC MoFTrqPtd_tiFilDlyTqPtdMin_C MoFTrqPtd_tiFiltgTqPtdMin_C MoFTrqPtd_tqCrksftEmMinOffs_M /end DEF_CHARACTERISTIC
 /begin IN_MEASUREMENT MoFESpd_nEng MoFTrqPtd_tqCrsMinEM Mo_stCplChk Mo_stMoC Mo_stMoCCpl /end IN_MEASUREMENT
 /begin OUT_MEASUREMENT MoFTrqPtd_tqCrksftEmMinFild MoFTrqPtd_tqCrksftEmMinFildOffs /end OUT_MEASUREMENT
 /begin LOC_MEASUREMENT MoFTrqPtd_tqCrksftEmMinFildCpl MoFTrqPtd_tqCrksftEmMinFildOffsCpl /end LOC_MEASUREMENT
 FUNCTION_VERSION "16.0.0" /end FUNCTION
/begin FUNCTION MoFTrqRat_Co "25.1.0    Function Monitoring: Torque ratio power train" /begin DEF_CHARACTERISTIC MoFTrqRat_rTqPTMax_C MoFTrqRat_rTqPTMin_C /end DEF_CHARACTERISTIC /begin IN_MEASUREMENT AccPed_rTrq Mo_stCplChk Mo_stMoC Mo_stMoCCpl /end IN_MEASUREMENT /begin OUT_MEASUREMENT MoFTrqRat_rTrqPT MoF_rTrqPT /end OUT_MEASUREMENT /begin LOC_MEASUREMENT MoFTrqRat_rTrqPTCpl MoF_rTrqPTCpl /end LOC_MEASUREMENT FUNCTION_VERSION "25.1.0" /end FUNCTION
/begin FUNCTION MoFVar_Co "24.1.0    Function Monitoring: Variant coding" /begin DEF_CHARACTERISTIC MoF_stVar_C /end DEF_CHARACTERISTIC /begin IN_MEASUREMENT Mo_stCplChk Mo_stMoC Mo_stMoCCpl /end IN_MEASUREMENT /begin OUT_MEASUREMENT MoF_stVar /end OUT_MEASUREMENT /begin LOC_MEASUREMENT MoF_stVarCpl /end LOC_MEASUREMENT FUNCTION_VERSION "24.1.0" /end FUNCTION
/begin FUNCTION MoFVar_PostBldSel "2.2.0     Function Monitoring: Post-Build Selectable"
 /begin DEF_CHARACTERISTIC MoFTrqPtd_cntrActvPostBldCfg_C MoFTrqPtd_cntrNegChkPostBldCfg_C MoFTrqPtd_cntrPosChkPostBldCfg_C MoFTrqPtd_cntrRstPostBldSel_C MoFTrqPtd_cntrStabyChkPostBldCfg_C MoFTrqPtd_cntrTestPostBldSel_C MoFTrqPtd_stSwtPbsChk_C /end DEF_CHARACTERISTIC
 /begin IN_MEASUREMENT Mo_ctRst Mo_ctRstCpl Mo_stCplChk Mo_stMoC Mo_stMoCCpl Mo_stMoF Mo_stMoFCpl /end IN_MEASUREMENT
 /begin OUT_MEASUREMENT MoFTrqPtd_flgIrrvErrPostBldSel MoFTrqPtd_flgIrrvErrPostBldSelMsg /end OUT_MEASUREMENT
 /begin LOC_MEASUREMENT MoFTrqPtd_cntrActvPostBldCfg MoFTrqPtd_cntrActvPostBldCfgCpl MoFTrqPtd_cntrNegChkPostBldCfg MoFTrqPtd_cntrNegChkPostBldCfgCpl MoFTrqPtd_cntrPosChkPostBldCfg MoFTrqPtd_cntrPosChkPostBldCfgCpl MoFTrqPtd_cntrStabyChkPostBldCfg MoFTrqPtd_cntrStabyChkPostBldCfgCpl MoFTrqPtd_cntrTestPostBldSel MoFTrqPtd_flgAlt MoFTrqPtd_flgClrPostBldSel MoFTrqPtd_flgErrActvPostBldCfg MoFTrqPtd_flgErrDcycStabyChk MoFTrqPtd_flgErrIvsChkPostBld MoFTrqPtd_flgErrPosChk MoFTrqPtd_flgErrPosChk2 MoFTrqPtd_flgErrPosChkPostBld MoFTrqPtd_flgPostBldCfgRxd MoFTrqPtd_idxPostBldCfg MoFTrqPtd_idxPostBldCfgCpl MoFTrqPtd_idxPostBldCfgIni MoFTrqPtd_idxPostBldCfgIniCpl MoFTrqPtd_stActvPostBldVrntIdx MoFTrqPtd_stActvPostBldVrntIdxCpl MoFTrqPtd_stMonIninChk MoFTrqPtd_stMonIninChkCpl MoFTrqPtd_stMonIninChkIvs MoFTrqPtd_stMonIninChkIvsCpl MoFVarPostBldSel_bbLoc1Cpl MoFVarPostBldSel_bbOut1Cpl /end LOC_MEASUREMENT
 FUNCTION_VERSION "2.2.0" /end FUNCTION
/begin FUNCTION MoFVehIfc_IfAdp1 "81.1.0    Function Monitoring: Interface adapter 1 MoFVehIfc" /begin DEF_CHARACTERISTIC MoFClth_flgClthStrkFlt_C MoF_stStrtStopEnaMsg_C /end DEF_CHARACTERISTIC
 /begin IN_MEASUREMENT MoFStrt_stStrtMsg MoF_rTrqPT Mo_stCplChk Mo_stMoC Mo_stMoCCpl /end IN_MEASUREMENT
 /begin OUT_MEASUREMENT MoFClth_flgClthStrkFlt MoFTrqRat_ratTqPTPlaus MoF_stStrtMsg MoF_stStrtStopEnaMsg /end OUT_MEASUREMENT
 /begin LOC_MEASUREMENT MoFDrvPrgSwtCo_bbOut1Cpl MoFTrqRat_ratTqPTPlausCpl /end LOC_MEASUREMENT
 FUNCTION_VERSION "81.1.0" /end FUNCTION
/begin FUNCTION MoFVSS_Co "87.0.0    Function Monitoring: Vehicle speed" /begin IN_MEASUREMENT Mo_stCplChk Mo_stMoC Mo_stMoCCpl VehV_v /end IN_MEASUREMENT /begin OUT_MEASUREMENT MoFVSS_v /end OUT_MEASUREMENT /begin LOC_MEASUREMENT MoFVSS_vCpl /end LOC_MEASUREMENT FUNCTION_VERSION "87.0.0" /end FUNCTION
/begin FUNCTION MoFWDA_Co "16.0.0    Function Monitoring: Fault reaction from function monitoring via WDA" /begin IN_MEASUREMENT Mo_stMoF /end IN_MEASUREMENT FUNCTION_VERSION "16.0.0" /end FUNCTION
/begin FUNCTION MoSysCtrl_Co "5.0.0     Monitoring: System Control" /begin IN_MEASUREMENT Mo_stCplChk Mo_stMoC Mo_stMoCCpl /end IN_MEASUREMENT FUNCTION_VERSION "5.0.0" /end FUNCTION
/begin FUNCTION MoXAirFl_Adp "62.2.0    Extended Monitoring: Adapter for function monitoring air and fuel" /begin DEF_CHARACTERISTIC MoXAirFl_stCfgAdp_C /end DEF_CHARACTERISTIC
 /begin IN_MEASUREMENT Epm_ctCyl etazwist_w_msg evz_auscpl_msg evz_austot_msg fkrk_w_msg fnsad_w_msg fra_w_msg fr_w_msg GEVCtl_agIntkClsd IgCtl_iaOutpRdnt Ign_ia_real_s16 InjSys_facPc InjSys_ratFuM lamsbg_w_msg rka_w_msg rkte_w_msg rkukg_w_msg rlfg_w_msg rlp_w_msg rlrint_w_msg rri_w_msg tez_l_msg zwopt_w_msg zwoutzyl_w_msg /end IN_MEASUREMENT
 /begin OUT_MEASUREMENT MoXAirFl_cntrComS0 MoXAirFl_cntrComS0Rdnt MoXAirFl_cntrComS1 MoXAirFl_cntrComS1Rdnt MoXAirFl_CtOffIfClass_V13I.evz_auscpl MoXAirFl_CtOffIfClass_V13I.evz_auscpl_mem MoXAirFl_CtOffIfClass_V13I.evz_austot MoXAirFl_CtOffIfClass_V13I.evz_austot_mem MoXAirFl_CtOffIfClass_V13I.flgInjEnad MoXAirFl_CtOffIfClass_V13I.injTrigCylMsk MoXAirFl_CtOffIfClass_V13I.injTrigCylMskRdnt MoXAirFl_CtOffIfClass_V13I.injmode_zzylh MoXAirFl_CtOffIfClass_V13I.injmode_zzylh_rdnt MoXAirFl_CtOffIfClass_V13I.injmode_zzyln MoXAirFl_CtOffIfClass_V13I.injmode_zzyln_rdnt MoXAirFl_CtOffIfClass_V13I.injmode_zzyls MoXAirFl_CtOffIfClass_V13I.injmode_zzyls_rdnt MoXAirFl_CtOffIfClass_V13I.stInjPfiDeactvAry MoXAirFl_CtOffIfClass_V13I.stInjPfiDeactvAryRdnt MoXAirFl_CtOffIfClass_V13I.stInjPfiDeactvBkupAry MoXAirFl_CtOffIfClass_V13I.stInjTiPfi MoXAirFl_CtOffIfClass_V13I.stInjTiPfi1InjrA MoXAirFl_CtOffIfClass_V13I.stInjTiPfi1InjrARdnt MoXAirFl_CtOffIfClass_V13I.stInjTiPfi1InjrB MoXAirFl_CtOffIfClass_V13I.stInjTiPfi1InjrBRdnt MoXAirFl_CtOffIfClass_V13I.stInjTiPfi2InjrA MoXAirFl_CtOffIfClass_V13I.stInjTiPfi2InjrARdnt MoXAirFl_CtOffIfClass_V13I.stInjTiPfi2InjrB MoXAirFl_CtOffIfClass_V13I.stInjTiPfi2InjrBRdnt MoXAirFl_CtOffIfClass_V13I.stInjTiPfiRdnt MoXAirFl_MixMngtIfClass_V13I.B_afimreq MoXAirFl_MixMngtIfClass_V13I.facBnk MoXAirFl_MixMngtIfClass_V13I.facBnk2Pfi MoXAirFl_MixMngtIfClass_V13I.facBnkPfi MoXAirFl_MixMngtIfClass_V13I.facLamCtlPfiAry MoXAirFl_MixMngtIfClass_V13I.facLamCtlPfiAryRdnt MoXAirFl_MixMngtIfClass_V13I.facLamCtlPfiBkupAry MoXAirFl_MixMngtIfClass_V13I.facPcPfiRest MoXAirFl_MixMngtIfClass_V13I.facPcPfiRestBnk2 MoXAirFl_MixMngtIfClass_V13I.facPcRest MoXAirFl_MixMngtIfClass_V13I.facPrtnPfi MoXAirFl_MixMngtIfClass_V13I.facPrtnPfiAry MoXAirFl_MixMngtIfClass_V13I.facPrtnPfiAryRdnt MoXAirFl_MixMngtIfClass_V13I.facPrtnPfiBkupAry MoXAirFl_MixMngtIfClass_V13I.fakeslsa MoXAirFl_MixMngtIfClass_V13I.ffuevali MoXAirFl_MixMngtIfClass_V13I.ffuevalipfi MoXAirFl_MixMngtIfClass_V13I.fkrkAry MoXAirFl_MixMngtIfClass_V13I.fkrkPfiAry MoXAirFl_MixMngtIfClass_V13I.fkrkPfiAryRdnt MoXAirFl_MixMngtIfClass_V13I.flgLamSplitActv MoXAirFl_MixMngtIfClass_V13I.fnsad MoXAirFl_MixMngtIfClass_V13I.fr MoXAirFl_MixMngtIfClass_V13I.fr2 MoXAirFl_MixMngtIfClass_V13I.fragdi MoXAirFl_MixMngtIfClass_V13I.fragdi2 MoXAirFl_MixMngtIfClass_V13I.frapfi MoXAirFl_MixMngtIfClass_V13I.frapfi2 MoXAirFl_MixMngtIfClass_V13I.lamsbg MoXAirFl_MixMngtIfClass_V13I.lamsbg2 MoXAirFl_MixMngtIfClass_V13I.larils MoXAirFl_MixMngtIfClass_V13I.larils2 MoXAirFl_MixMngtIfClass_V13I.rCtlPriB1 MoXAirFl_MixMngtIfClass_V13I.rCtlPriB2 MoXAirFl_MixMngtIfClass_V13I.ratChrgAirCylPredPfi MoXAirFl_MixMngtIfClass_V13I.ratFuMCylInd MoXAirFl_MixMngtIfClass_V13I.ratFuMGdi MoXAirFl_MixMngtIfClass_V13I.ratFuMGdiBnk2 MoXAirFl_MixMngtIfClass_V13I.ratFuMPfi MoXAirFl_MixMngtIfClass_V13I.ratFuMPfiBnk2 MoXAirFl_MixMngtIfClass_V13I.ratFuPrtnPfiInjAry MoXAirFl_MixMngtIfClass_V13I.ratFuPrtnPfiInjAryRdnt MoXAirFl_MixMngtIfClass_V13I.ratFuPrtnPfiInjBkupAry MoXAirFl_MixMngtIfClass_V13I.ratPrdcAirPrtnPfiAry MoXAirFl_MixMngtIfClass_V13I.ratPrdcAirPrtnPfiAryRdnt MoXAirFl_MixMngtIfClass_V13I.ratPrdcAirPrtnPfiBkupAry MoXAirFl_MixMngtIfClass_V13I.rkagdi MoXAirFl_MixMngtIfClass_V13I.rkagdi2 MoXAirFl_MixMngtIfClass_V13I.rkapfi MoXAirFl_MixMngtIfClass_V13I.rkapfi2 MoXAirFl_MixMngtIfClass_V13I.rkausg MoXAirFl_MixMngtIfClass_V13I.rkte MoXAirFl_MixMngtIfClass_V13I.rkteBnk1 MoXAirFl_MixMngtIfClass_V13I.rkteBnk2 MoXAirFl_MixMngtIfClass_V13I.rkukg MoXAirFl_MixMngtIfClass_V13I.rkukgpfi MoXAirFl_MixMngtIfClass_V13I.rlfg MoXAirFl_MixMngtIfClass_V13I.rlfgBnk1 MoXAirFl_MixMngtIfClass_V13I.rlfgBnk2 MoXAirFl_MixMngtIfClass_V13I.rlp MoXAirFl_MixMngtIfClass_V13I.rlpBnk1 MoXAirFl_MixMngtIfClass_V13I.rlpBnk2 MoXAirFl_MixMngtIfClass_V13I.rlrext MoXAirFl_MixMngtIfClass_V13I.rlrextBnk1 MoXAirFl_MixMngtIfClass_V13I.rlrextBnk2 MoXAirFl_MixMngtIfClass_V13I.rlrint MoXAirFl_MixMngtIfClass_V13I.rlrintBnk1 MoXAirFl_MixMngtIfClass_V13I.rlrintBnk2 MoXAirFl_TrqActIfClass_V13I.agIntkClsd MoXAirFl_TrqActIfClass_V13I.dzworri MoXAirFl_TrqActIfClass_V13I.etaaufte MoXAirFl_TrqActIfClass_V13I.etazwist MoXAirFl_TrqActIfClass_V13I.ratInertCyl MoXAirFl_TrqActIfClass_V13I.ratInertEgrExtCyl MoXAirFl_TrqActIfClass_V13I.ratInertEgrIntCyl MoXAirFl_TrqActIfClass_V13I.zwcalcar_zzylzue MoXAirFl_TrqActIfClass_V13I.zwopt MoXAirFl_TrqActIfClass_V13I.zwout MoXAirFl_TrqActIfClass_V13I.zwoutcpl MoXAirFl_TrqActIfClass_V13I.zwouthiresl MoXAirFl_TrqActIfClass_V13I.zwouthireslAry_zzylzue MoXAirFl_TrqActIfClass_V13I.zwouthireslRdnt /end OUT_MEASUREMENT
 FUNCTION_VERSION "62.2.0" /end FUNCTION
/begin FUNCTION MoXEMM_Co "20.4.1    Extended Monitoring: Diagnosis Function for EMM-Module" /begin DEF_CHARACTERISTIC MoXEMM_nrHwLTErrSimn_C MoXEMM_nrSmuAlmErrSimn_C /end DEF_CHARACTERISTIC /begin IN_MEASUREMENT MoCEMM_stEmmAlrmsMsg /end IN_MEASUREMENT /begin OUT_MEASUREMENT MoXEMM_stEMMAlrms MoXEMM_stEMMAlrmsAftRst /end OUT_MEASUREMENT /begin LOC_MEASUREMENT MoXEMM_stHwLTResult /end LOC_MEASUREMENT FUNCTION_VERSION "20.4.1" /end FUNCTION
/begin FUNCTION MoXFrm_Co "175.0.0   Extended Monitoring: Frame configuration"
 /begin OUT_MEASUREMENT MoXFrm_Buf_AYCF MoXFrm_Buf_EAT1 MoXFrm_Buf_EAT12 MoXFrm_Buf_EAT13 MoXFrm_Buf_EAT4 MoXFrm_Buf_EATB MoXFrm_Buf_GWIMG3 MoXFrm_Buf_META MoXFrm_Buf_METL MoXFrm_flgUpdAYCF MoXFrm_flgUpdEAT1 MoXFrm_flgUpdEAT12 MoXFrm_flgUpdEAT13 MoXFrm_flgUpdEAT4 MoXFrm_flgUpdEATB MoXFrm_flgUpdGWIMG3 MoXFrm_flgUpdMETA MoXFrm_flgUpdMETL /end OUT_MEASUREMENT
 FUNCTION_VERSION "175.0.0" /end FUNCTION
/begin FUNCTION MoXSyncLos_Co "5.1.1     Extended Monitoring: Detection loss of synchronization" /begin DEF_CHARACTERISTIC MoXSyncLos_nEngSyncMin_C /end DEF_CHARACTERISTIC /begin IN_MEASUREMENT Epm_nEng10ms /end IN_MEASUREMENT
 /begin OUT_MEASUREMENT MoXSyncLos_cntrSyncCplMsg MoXSyncLos_cntrSyncMsg MoXSyncLos_nEng10msLoReslMsg MoXSyncLos_nEng10msMsg MoX_bSyncLos_msg /end OUT_MEASUREMENT
 /begin LOC_MEASUREMENT MoXSyncLos_nEng10msLocMsg MoX_bSyncRecg /end LOC_MEASUREMENT
 FUNCTION_VERSION "5.1.1" /end FUNCTION
/begin FUNCTION MoXTrqDist_Co "11.0.0    Extended Monitoring: Torque distribution"
 /begin DEF_CHARACTERISTIC MoXTrqPtd_cntrDebErrMaxDisblTqEmThd_C MoXTrqPtd_cntrDebErrMaxRedTqEmThd_C MoXTrqPtd_cntrDebErrMinRedTqEmThd_C MoXTrqPtd_cntrDebErrTqMaxEmThd_C MoXTrqPtd_tiDlyFiltgTqEm_C MoXTrqPtd_tiOffDlyErrMaxRedTqEm_C MoXTrqPtd_tiOffDlyErrMinThd_C MoXTrqPtd_tiOffDlyErrTqMaxEm_C MoXTrqPtd_tiPT1FiltgTqEm_C MoXTrqPtd_tqCrksftAltTqMax_T MoXTrqPtd_tqCrksftEmOffs_T MoXTrqPtd_tqCrksftEmRedOffs_T MoXTrqPtd_tqCrksftRedEmOffs_C /end DEF_CHARACTERISTIC
 /begin IN_MEASUREMENT ElM_tqDes Epm_nEng MoFTrqAct_tqCrksftEmMsg MoFTrqCmp_flgErrMaxPndMsg MoFTrqCmp_flgErrMinPndMsg MoFTrqPtd_tqCrsEMMsg TrsmEmac_ratElmTrsm /end IN_MEASUREMENT
 /begin OUT_MEASUREMENT MoXTrqPtd_tqCrksftEmFild MoXTrqPtd_tqMaxLimEm MoXTrqPtd_tqMinLimEm /end OUT_MEASUREMENT
 /begin LOC_MEASUREMENT MoXTrqPtd_cntrDebErrMaxDisblTqEm MoXTrqPtd_cntrDebErrMaxRedTqEm MoXTrqPtd_cntrDebErrMinRedTqEm MoXTrqPtd_cntrDebErrTqMaxEm MoXTrqPtd_flgErrLoadShiftTqEm MoXTrqPtd_flgErrMaxDisblTqEm MoXTrqPtd_flgErrMaxRedTqEm MoXTrqPtd_flgErrMinEmDeb MoXTrqPtd_flgErrTqMaxEm MoXTrqPtd_flgErrTqMaxEmDeb MoXTrqPtd_tqCrksftEmOffsFild MoXTrqPtd_tqCrksftEmPT1In MoXTrqPtd_tqErrMaxDisblTqEm MoXTrqPtd_tqErrMaxRedTqEm MoXTrqPtd_tqMaxLimEmOffs /end LOC_MEASUREMENT
 FUNCTION_VERSION "11.0.0" /end FUNCTION
/begin FUNCTION Mo_Adap "148.0.0   Extended Monitoring: Interface adapter" /begin IN_MEASUREMENT Mo_stCplChk Mo_stMoC Mo_stMoCCpl RngMod_trqInrMinWoCtOff /end IN_MEASUREMENT /begin OUT_MEASUREMENT MoX_trqInrMinWoCtOff /end OUT_MEASUREMENT FUNCTION_VERSION "148.0.0" /end FUNCTION
/begin FUNCTION Mo_Conf "MO.18.37_6SAAConfiguration Monitoring" FUNCTION_VERSION "MO.18.37_6SAA" /end FUNCTION
/begin COMPU_METHOD B_TRUE "" TAB_VERB "%6.3" "" COMPU_TAB_REF B_TRUE /end COMPU_METHOD
/begin COMPU_VTAB B_TRUE "" TAB_VERB 2 0 "FALSE" 1 "TRUE" /end COMPU_VTAB
/begin COMPU_METHOD dez "" RAT_FUNC "%6.2" "" COEFFS 0 1 0 0 0 1 /end COMPU_METHOD
/begin COMPU_METHOD EngN "" RAT_FUNC "%6.3" "rpm" COEFFS 0 2 0 0 0 1 /end COMPU_METHOD
/begin COMPU_METHOD fak_q0p000244 "" RAT_FUNC "%6.5" "-" COEFFS 0 65536 0 0 0 16 /end COMPU_METHOD
/begin COMPU_METHOD fak_q0p01 "" RAT_FUNC "%6.4" "" COEFFS 0 100 0 0 0 1 /end COMPU_METHOD
/begin COMPU_METHOD fak_sw_b1 "" RAT_FUNC "%7.6" "-" COEFFS 0 65536 0 0 0 2 /end COMPU_METHOD
/begin COMPU_METHOD fak_ub_b1 "" RAT_FUNC "%6.4" "-" COEFFS 0 256 0 0 0 1 /end COMPU_METHOD
/begin COMPU_METHOD fak_ub_b2 "" RAT_FUNC "%8.5" "-" COEFFS 0 256 0 0 0 2 /end COMPU_METHOD
/begin COMPU_METHOD fak_uw_b16 "" RAT_FUNC "%6.5" "-" COEFFS 0 65536 0 0 0 16 /end COMPU_METHOD
/begin COMPU_METHOD fak_uw_b2 "" RAT_FUNC "%7.6" "-" COEFFS 0 65536 0 0 0 2 /end COMPU_METHOD
/begin COMPU_METHOD fak_uw_b64 "" RAT_FUNC "%6.5" "-" COEFFS 0 65536 0 0 0 64 /end COMPU_METHOD
/begin COMPU_METHOD kw_q0p0156 "" RAT_FUNC "%6.4" "Grad KW" COEFFS 0 64 0 0 0 1 /end COMPU_METHOD
/begin COMPU_METHOD md_q0p1 "" RAT_FUNC "%6.3" "Nm" COEFFS 0 10 0 0 0 1 /end COMPU_METHOD
/begin COMPU_METHOD md_q1p6 "" RAT_FUNC "%6.2" "Nm" COEFFS 0 10 0 0 0 16 /end COMPU_METHOD
/begin COMPU_METHOD MoXEMM_HwLTErrorSimnCode_VERB "" TAB_VERB "%6.3" "" COMPU_TAB_REF MoXEMM_HwLTErrorSimnCode_VERB /end COMPU_METHOD
/begin COMPU_VTAB MoXEMM_HwLTErrorSimnCode_VERB "" TAB_VERB 12 0 "MoXEMM_NO_ERROR" 1 "MoXEMMHwLTMCUFW" 2 "MoXEMMHwLTStbySMUAlvTest" 3 "MoXEMMHwLTMonBIST" 4 "MoXEMMHwLTRegMonTest" 5 "MoXEMMHwLTTempSens" 6 "MoXEMMHwLTUCBCfg" 7 "RESERVED_7" 8 "RESERVED_8" 9 "MoXEMMHwLTMBIST" 10 "MoXEMMHwLTLBIST" 65535 "MoXEMM_CLR_ERROR" /end COMPU_VTAB
/begin COMPU_METHOD MoXEMM_SMUErrorSimnCode_VERB "" TAB_VERB "%6.3" "" COMPU_TAB_REF MoXEMM_SMUErrorSimnCode_VERB /end COMPU_METHOD
/begin COMPU_VTAB MoXEMM_SMUErrorSimnCode_VERB "" TAB_VERB 450 0 "MoXEMM_NO_ERROR" 1 "MoXEMM_SMU_ALM_0_0" 2 "MoXEMM_SMU_ALM_0_1" 3 "MoXEMM_SMU_ALM_0_2" 4 "MoXEMM_reserved_0_3" 5 "MoXEMM_SMU_ALM_0_4" 6 "MoXEMM_SMU_ALM_0_5" 7 "MoXEMM_reserved_0_6" 8 "MoXEMM_SMU_ALM_0_7" 9 "MoXEMM_SMU_ALM_0_8" 10 "MoXEMM_reserved_0_9" 11 "MoXEMM_SMU_ALM_0_10" 12 "MoXEMM_SMU_ALM_0_11" 13 "MoXEMM_reserved_0_12" 14 "MoXEMM_SMU_ALM_0_13" 15 "MoXEMM_SMU_ALM_0_14" 16 "MoXEMM_reserved_0_15" 17 "MoXEMM_reserved_0_16" 18 "MoXEMM_reserved_0_17" 19 "MoXEMM_reserved_0_18" 20 "MoXEMM_reserved_0_19" 21 "MoXEMM_reserved_0_20" 22 "MoXEMM_reserved_0_21" 23 "MoXEMM_SMU_ALM_0_22" 24 "MoXEMM_SMU_ALM_0_23" 25 "MoXEMM_reserved_0_24" 26 "MoXEMM_reserved_0_25" 27 "MoXEMM_reserved_0_26" 28 "MoXEMM_reserved_0_27" 29 "MoXEMM_reserved_0_28" 30 "MoXEMM_reserved_0_29" 31 "MoXEMM_reserved_0_30" 32 "MoXEMM_reserved_0_31" 33 "MoXEMM_SMU_ALM_1_0" 34 "MoXEMM_SMU_ALM_1_1" 35 "MoXEMM_SMU_ALM_1_2" 36 "MoXEMM_reserved_1_3" 37 "MoXEMM_SMU_ALM_1_4" 38 "MoXEMM_SMU_ALM_1_5" 39 "MoXEMM_reserved_1_6" 40 "MoXEMM_SMU_ALM_1_7" 41 "MoXEMM_SMU_ALM_1_8" 42 "MoXEMM_reserved_1_9" 43 "MoXEMM_SMU_ALM_1_10" 44 "MoXEMM_SMU_ALM_1_11" 45 "MoXEMM_reserved_1_12" 46 "MoXEMM_SMU_ALM_1_13" 47 "MoXEMM_SMU_ALM_1_14" 48 "MoXEMM_reserved_1_15" 49 "MoXEMM_reserved_1_16" 50 "MoXEMM_reserved_1_17" 51 "MoXEMM_reserved_1_18" 52 "MoXEMM_reserved_1_19" 53 "MoXEMM_reserved_1_20" 54 "MoXEMM_reserved_1_21" 55 "MoXEMM_SMU_ALM_1_22" 56 "MoXEMM_SMU_ALM_1_23" 57 "MoXEMM_reserved_1_24" 58 "MoXEMM_reserved_1_25" 59 "MoXEMM_reserved_1_26" 60 "MoXEMM_reserved_1_27" 61 "MoXEMM_reserved_1_28" 62 "MoXEMM_reserved_1_29" 63 "MoXEMM_reserved_1_30" 64 "MoXEMM_reserved_1_31" 65 "MoXEMM_reserved_2_0" 66 "MoXEMM_SMU_ALM_2_1" 67 "MoXEMM_reserved_2_2" 68 "MoXEMM_reserved_2_3" 69 "MoXEMM_SMU_ALM_2_4" 70 "MoXEMM_SMU_ALM_2_5" 71 "MoXEMM_reserved_2_6" 72 "MoXEMM_SMU_ALM_2_7" 73 "MoXEMM_SMU_ALM_2_8" 74 "MoXEMM_reserved_2_9" 75 "MoXEMM_SMU_ALM_2_10" 76 "MoXEMM_SMU_ALM_2_11" 77 "MoXEMM_reserved_2_12" 78 "MoXEMM_SMU_ALM_2_13" 79 "MoXEMM_SMU_ALM_2_14" 80 "MoXEMM_reserved_2_15" 81 "MoXEMM_reserved_2_16" 82 "MoXEMM_reserved_2_17" 83 "MoXEMM_reserved_2_18" 84 "MoXEMM_reserved_2_19" 85 "MoXEMM_reserved_2_20" 86 "MoXEMM_reserved_2_21" 87 "MoXEMM_SMU_ALM_2_22" 88 "MoXEMM_SMU_ALM_2_23" 89 "MoXEMM_reserved_2_24" 90 "MoXEMM_reserved_2_25" 91 "MoXEMM_reserved_2_26" 92 "MoXEMM_reserved_2_27" 93 "MoXEMM_reserved_2_28" 94 "MoXEMM_reserved_2_29" 95 "MoXEMM_reserved_2_30" 96 "MoXEMM_reserved_2_31" 97 "MoXEMM_reserved_3_0" 98 "MoXEMM_reserved_3_1" 99 "MoXEMM_reserved_3_2" 100 "MoXEMM_reserved_3_3" 101 "MoXEMM_reserved_3_4" 102 "MoXEMM_reserved_3_5" 103 "MoXEMM_reserved_3_6" 104 "MoXEMM_reserved_3_7" 105 "MoXEMM_reserved_3_8" 106 "MoXEMM_reserved_3_9" 107 "MoXEMM_reserved_3_10" 108 "MoXEMM_reserved_3_11" 109 "MoXEMM_reserved_3_12" 110 "MoXEMM_reserved_3_13" 111 "MoXEMM_reserved_3_14" 112 "MoXEMM_reserved_3_15" 113 "MoXEMM_reserved_3_16" 114 "MoXEMM_reserved_3_17" 115 "MoXEMM_reserved_3_18" 116 "MoXEMM_reserved_3_19" 117 "MoXEMM_reserved_3_20" 118 "MoXEMM_reserved_3_21" 119 "MoXEMM_reserved_3_22" 120 "MoXEMM_reserved_3_23" 121 "MoXEMM_reserved_3_24" 122 "MoXEMM_reserved_3_25" 123 "MoXEMM_reserved_3_26" 124 "MoXEMM_reserved_3_27" 125 "MoXEMM_reserved_3_28" 126 "MoXEMM_reserved_3_29" 127 "MoXEMM_reserved_3_30" 128 "MoXEMM_reserved_3_31" 129 "MoXEMM_reserved_4_0" 130 "MoXEMM_reserved_4_1" 131 "MoXEMM_reserved_4_2" 132 "MoXEMM_reserved_4_3" 133 "MoXEMM_reserved_4_4" 134 "MoXEMM_reserved_4_5" 135 "MoXEMM_reserved_4_6" 136 "MoXEMM_reserved_4_7" 137 "MoXEMM_reserved_4_8" 138 "MoXEMM_reserved_4_9" 139 "MoXEMM_reserved_4_10" 140 "MoXEMM_reserved_4_11" 141 "MoXEMM_reserved_4_12" 142 "MoXEMM_reserved_4_13" 143 "MoXEMM_reserved_4_14" 144 "MoXEMM_reserved_4_15" 145 "MoXEMM_reserved_4_16" 146 "MoXEMM_reserved_4_17" 147 "MoXEMM_reserved_4_18" 148 "MoXEMM_reserved_4_19" 149 "MoXEMM_reserved_4_20" 150 "MoXEMM_reserved_4_21" 151 "MoXEMM_reserved_4_22" 152 "MoXEMM_reserved_4_23" 153 "MoXEMM_reserved_4_24" 154 "MoXEMM_reserved_4_25" 155 "MoXEMM_reserved_4_26" 156 "MoXEMM_reserved_4_27" 157 "MoXEMM_reserved_4_28" 158 "MoXEMM_reserved_4_29" 159 "MoXEMM_reserved_4_30" 160 "MoXEMM_reserved_4_31" 161 "MoXEMM_reserved_5_0" 162 "MoXEMM_reserved_5_1" 163 "MoXEMM_reserved_5_2" 164 "MoXEMM_reserved_5_3" 165 "MoXEMM_reserved_5_4" 166 "MoXEMM_reserved_5_5" 167 "MoXEMM_reserved_5_6" 168 "MoXEMM_reserved_5_7" 169 "MoXEMM_reserved_5_8" 170 "MoXEMM_reserved_5_9" 171 "MoXEMM_reserved_5_10" 172 "MoXEMM_reserved_5_11" 173 "MoXEMM_reserved_5_12" 174 "MoXEMM_reserved_5_13" 175 "MoXEMM_reserved_5_14" 176 "MoXEMM_reserved_5_15" 177 "MoXEMM_reserved_5_16" 178 "MoXEMM_reserved_5_17" 179 "MoXEMM_reserved_5_18" 180 "MoXEMM_reserved_5_19" 181 "MoXEMM_reserved_5_20" 182 "MoXEMM_reserved_5_21" 183 "MoXEMM_reserved_5_22" 184 "MoXEMM_reserved_5_23" 185 "MoXEMM_reserved_5_24" 186 "MoXEMM_reserved_5_25" 187 "MoXEMM_reserved_5_26" 188 "MoXEMM_reserved_5_27" 189 "MoXEMM_reserved_5_28" 190 "MoXEMM_reserved_5_29" 191 "MoXEMM_reserved_5_30" 192 "MoXEMM_reserved_5_31" 193 "MoXEMM_SMU_ALM_6_0" 194 "MoXEMM_reserved_6_1" 195 "MoXEMM_reserved_6_2" 196 "MoXEMM_reserved_6_3" 197 "MoXEMM_SMU_ALM_6_4" 198 "MoXEMM_SMU_ALM_6_5" 199 "MoXEMM_reserved_6_6" 200 "MoXEMM_SMU_ALM_6_7" 201 "MoXEMM_SMU_ALM_6_8" 202 "MoXEMM_reserved_6_9" 203 "MoXEMM_reserved_6_10" 204 "MoXEMM_SMU_ALM_6_11" 205 "MoXEMM_SMU_ALM_6_12" 206 "MoXEMM_reserved_6_13" 207 "MoXEMM_SMU_ALM_6_14" 208 "MoXEMM_SMU_ALM_6_15" 209 "MoXEMM_reserved_6_16" 210 "MoXEMM_SMU_ALM_6_17" 211 "MoXEMM_SMU_ALM_6_18" 212 "MoXEMM_reserved_6_19" 213 "MoXEMM_SMU_ALM_6_20" 214 "MoXEMM_SMU_ALM_6_21" 215 "MoXEMM_reserved_6_22" 216 "MoXEMM_reserved_6_23" 217 "MoXEMM_reserved_6_24" 218 "MoXEMM_SMU_ALM_6_25" 219 "MoXEMM_reserved_6_26" 220 "MoXEMM_reserved_6_27" 221 "MoXEMM_reserved_6_28" 222 "MoXEMM_reserved_6_29" 223 "MoXEMM_reserved_6_30" 224 "MoXEMM_reserved_6_31" 225 "MoXEMM_reserved_7_0" 226 "MoXEMM_SMU_ALM_7_1" 227 "MoXEMM_SMU_ALM_7_2" 228 "MoXEMM_reserved_7_3" 229 "MoXEMM_reserved_7_4" 230 "MoXEMM_reserved_7_5" 231 "MoXEMM_reserved_7_6" 232 "MoXEMM_reserved_7_7" 233 "MoXEMM_reserved_7_8" 234 "MoXEMM_reserved_7_9" 235 "MoXEMM_reserved_7_10" 236 "MoXEMM_reserved_7_11" 237 "MoXEMM_SMU_ALM_7_12" 238 "MoXEMM_SMU_ALM_7_13" 239 "MoXEMM_SMU_ALM_7_14" 240 "MoXEMM_SMU_ALM_7_15" 241 "MoXEMM_SMU_ALM_7_16" 242 "MoXEMM_SMU_ALM_7_17" 243 "MoXEMM_reserved_7_18" 244 "MoXEMM_reserved_7_19" 245 "MoXEMM_SMU_ALM_7_20" 246 "MoXEMM_reserved_7_21" 247 "MoXEMM_reserved_7_22" 248 "MoXEMM_reserved_7_23" 249 "MoXEMM_reserved_7_24" 250 "MoXEMM_SMU_ALM_7_25" 251 "MoXEMM_SMU_ALM_7_26" 252 "MoXEMM_reserved_7_27" 253 "MoXEMM_SMU_ALM_7_28" 254 "MoXEMM_SMU_ALM_7_29" 255 "MoXEMM_SMU_ALM_7_30" 256 "MoXEMM_SMU_ALM_7_31" 257 "MoXEMM_SMU_ALM_8_0" 258 "MoXEMM_SMU_ALM_8_1" 259 "MoXEMM_SMU_ALM_8_2" 260 "MoXEMM_SMU_ALM_8_3" 261 "MoXEMM_SMU_ALM_8_4" 262 "MoXEMM_reserved_8_5" 263 "MoXEMM_reserved_8_6" 264 "MoXEMM_reserved_8_7" 265 "MoXEMM_SMU_ALM_8_8" 266 "MoXEMM_SMU_ALM_8_9" 267 "MoXEMM_SMU_ALM_8_10" 268 "MoXEMM_SMU_ALM_8_11" 269 "MoXEMM_SMU_ALM_8_12" 270 "MoXEMM_reserved_8_13" 271 "MoXEMM_reserved_8_14" 272 "MoXEMM_reserved_8_15" 273 "MoXEMM_SMU_ALM_8_16" 274 "MoXEMM_reserved_8_17" 275 "MoXEMM_SMU_ALM_8_18" 276 "MoXEMM_reserved_8_19" 277 "MoXEMM_reserved_8_20" 278 "MoXEMM_reserved_8_21" 279 "MoXEMM_reserved_8_22" 280 "MoXEMM_reserved_8_23" 281 "MoXEMM_reserved_8_24" 282 "MoXEMM_reserved_8_25" 283 "MoXEMM_reserved_8_26" 284 "MoXEMM_reserved_8_27" 285 "MoXEMM_reserved_8_28" 286 "MoXEMM_reserved_8_29" 287 "MoXEMM_SMU_ALM_8_30" 288 "MoXEMM_SMU_ALM_8_31" 289 "MoXEMM_SMU_ALM_9_0" 290 "MoXEMM_SMU_ALM_9_1" 291 "MoXEMM_reserved_9_2" 292 "MoXEMM_SMU_ALM_9_3" 293 "MoXEMM_reserved_9_4" 294 "MoXEMM_reserved_9_5" 295 "MoXEMM_reserved_9_6" 296 "MoXEMM_reserved_9_7" 297 "MoXEMM_reserved_9_8" 298 "MoXEMM_reserved_9_9" 299 "MoXEMM_reserved_9_10" 300 "MoXEMM_reserved_9_11" 301 "MoXEMM_reserved_9_12" 302 "MoXEMM_reserved_9_13" 303 "MoXEMM_reserved_9_14" 304 "MoXEMM_SMU_ALM_9_15" 305 "MoXEMM_reserved_9_16" 306 "MoXEMM_reserved_9_17" 307 "MoXEMM_reserved_9_18" 308 "MoXEMM_reserved_9_19" 309 "MoXEMM_reserved_9_20" 310 "MoXEMM_reserved_9_21" 311 "MoXEMM_reserved_9_22" 312 "MoXEMM_reserved_9_23" 313 "MoXEMM_reserved_9_24" 314 "MoXEMM_reserved_9_25" 315 "MoXEMM_reserved_9_26" 316 "MoXEMM_reserved_9_27" 317 "MoXEMM_reserved_9_28" 318 "MoXEMM_reserved_9_29" 319 "MoXEMM_reserved_9_30" 320 "MoXEMM_reserved_9_31" 321 "MoXEMM_reserved_10_0" 322 "MoXEMM_reserved_10_1" 323 "MoXEMM_reserved_10_2" 324 "MoXEMM_reserved_10_3" 325 "MoXEMM_reserved_10_4" 326 "MoXEMM_reserved_10_5" 327 "MoXEMM_reserved_10_6" 328 "MoXEMM_reserved_10_7" 329 "MoXEMM_reserved_10_8" 330 "MoXEMM_reserved_10_9" 331 "MoXEMM_reserved_10_10" 332 "MoXEMM_reserved_10_11" 333 "MoXEMM_reserved_10_12" 334 "MoXEMM_reserved_10_13" 335 "MoXEMM_reserved_10_14" 336 "MoXEMM_reserved_10_15" 337 "MoXEMM_SMU_ALM_10_16" 338 "MoXEMM_SMU_ALM_10_17" 339 "MoXEMM_reserved_10_18" 340 "MoXEMM_reserved_10_19" 341 "MoXEMM_reserved_10_20" 342 "MoXEMM_SMU_ALM_10_21" 343 "MoXEMM_reserved_10_22" 344 "MoXEMM_reserved_10_23" 345 "MoXEMM_reserved_10_24" 346 "MoXEMM_reserved_10_25" 347 "MoXEMM_reserved_10_26" 348 "MoXEMM_reserved_10_27" 349 "MoXEMM_reserved_10_28" 350 "MoXEMM_reserved_10_29" 351 "MoXEMM_reserved_10_30" 352 "MoXEMM_reserved_10_31" 353 "MoXEMM_SMU_ALM_11_0" 354 "MoXEMM_SMU_ALM_11_1" 355 "MoXEMM_SMU_ALM_11_2" 356 "MoXEMM_SMU_ALM_11_3" 357 "MoXEMM_SMU_ALM_11_4" 358 "MoXEMM_SMU_ALM_11_5" 359 "MoXEMM_reserved_11_6" 360 "MoXEMM_reserved_11_7" 361 "MoXEMM_SMU_ALM_11_8" 362 "MoXEMM_SMU_ALM_11_9" 363 "MoXEMM_reserved_11_10" 364 "MoXEMM_reserved_11_11" 365 "MoXEMM_reserved_11_12" 366 "MoXEMM_reserved_11_13" 367 "MoXEMM_reserved_11_14" 368 "MoXEMM_reserved_11_15" 369 "MoXEMM_reserved_11_16" 370 "MoXEMM_reserved_11_17" 371 "MoXEMM_reserved_11_18" 372 "MoXEMM_reserved_11_19" 373 "MoXEMM_reserved_11_20" 374 "MoXEMM_reserved_11_21" 375 "MoXEMM_reserved_11_22" 376 "MoXEMM_reserved_11_23" 377 "MoXEMM_reserved_11_24" 378 "MoXEMM_reserved_11_25" 379 "MoXEMM_reserved_11_26" 380 "MoXEMM_reserved_11_27" 381 "MoXEMM_reserved_11_28" 382 "MoXEMM_reserved_11_29" 383 "MoXEMM_reserved_11_30" 384 "MoXEMM_reserved_11_31" 641 "MoXEMM_reserved_20_0" 642 "MoXEMM_reserved_20_1" 643 "MoXEMM_reserved_20_2" 644 "MoXEMM_reserved_20_3" 645 "MoXEMM_reserved_20_4" 646 "MoXEMM_reserved_20_5" 647 "MoXEMM_reserved_20_6" 648 "MoXEMM_reserved_20_7" 649 "MoXEMM_reserved_20_8" 650 "MoXEMM_reserved_20_9" 651 "MoXEMM_reserved_20_10" 652 "MoXEMM_reserved_20_11" 653 "MoXEMM_reserved_20_12" 654 "MoXEMM_reserved_20_13" 655 "MoXEMM_reserved_20_14" 656 "MoXEMM_reserved_20_15" 657 "MoXEMM_reserved_20_16" 658 "MoXEMM_reserved_20_17" 659 "MoXEMM_reserved_20_18" 660 "MoXEMM_reserved_20_19" 661 "MoXEMM_reserved_20_20" 662 "MoXEMM_reserved_20_21" 663 "MoXEMM_reserved_20_22" 664 "MoXEMM_reserved_20_23" 665 "MoXEMM_reserved_20_24" 666 "MoXEMM_reserved_20_25" 667 "MoXEMM_reserved_20_26" 668 "MoXEMM_reserved_20_27" 669 "MoXEMM_reserved_20_28" 670 "MoXEMM_reserved_20_29" 671 "MoXEMM_reserved_20_30" 672 "MoXEMM_reserved_20_31" 673 "MoXEMM_SMU_ALM_21_0" 674 "MoXEMM_reserved_21_1" 675 "MoXEMM_reserved_21_2" 676 "MoXEMM_SMU_ALM_21_3" 677 "MoXEMM_reserved_21_4" 678 "MoXEMM_reserved_21_5" 679 "MoXEMM_reserved_21_6" 680 "MoXEMM_reserved_21_7" 681 "MoXEMM_reserved_21_8" 682 "MoXEMM_reserved_21_9" 683 "MoXEMM_reserved_21_10" 684 "MoXEMM_reserved_21_11" 685 "MoXEMM_reserved_21_12" 686 "MoXEMM_reserved_21_13" 687 "MoXEMM_reserved_21_14" 688 "MoXEMM_reserved_21_15" 689 "MoXEMM_SMU_ALM_21_16" 690 "MoXEMM_reserved_21_17" 691 "MoXEMM_reserved_21_18" 692 "MoXEMM_reserved_21_19" 693 "MoXEMM_reserved_21_20" 694 "MoXEMM_reserved_21_21" 695 "MoXEMM_reserved_21_22" 696 "MoXEMM_reserved_21_23" 697 "MoXEMM_reserved_21_24" 698 "MoXEMM_reserved_21_25" 699 "MoXEMM_reserved_21_26" 700 "MoXEMM_reserved_21_27" 701 "MoXEMM_reserved_21_28" 702 "MoXEMM_reserved_21_29" 703 "MoXEMM_reserved_21_30" 704 "MoXEMM_reserved_21_31" 65535 "MoXEMM_CLR_ERROR" /end COMPU_VTAB
/begin COMPU_METHOD Mo_t_DegC_q0p8o48 "" RAT_FUNC "%6.2" "Deg C" COEFFS 0 5 240 0 0 4 /end COMPU_METHOD
/begin COMPU_METHOD m_ub_b1020 "" RAT_FUNC "%6.2" "kg/h" COEFFS 0 1 0 0 0 4 /end COMPU_METHOD
/begin COMPU_METHOD nmot_q0p5 "" RAT_FUNC "%6.3" "1/min" COEFFS 0 2 0 0 0 1 /end COMPU_METHOD
/begin COMPU_METHOD nmot_q40 "" RAT_FUNC "%6.1" "1/min" COEFFS 0 1 0 0 0 40 /end COMPU_METHOD
/begin COMPU_METHOD OneToOne "" RAT_FUNC "%6.2" "-" COEFFS 0 1 0 0 0 1 /end COMPU_METHOD
/begin COMPU_METHOD RBPtCel_tq_0p5_1 "" RAT_FUNC "%6.3" "Nm" COEFFS 0 2 0 0 0 1 /end COMPU_METHOD
/begin COMPU_METHOD rel_q0p00195_pc_s "" RAT_FUNC "%6.4" "%*s" COEFFS 0 65536 0 0 0 128 /end COMPU_METHOD
/begin COMPU_METHOD rel_q0p39 "" RAT_FUNC "%6.3" "%" COEFFS 0 256 0 0 0 100 /end COMPU_METHOD
/begin COMPU_METHOD rel_sw_b1536 "" RAT_FUNC "%6.4" "%" COEFFS 0 65536 0 0 0 3072 /end COMPU_METHOD
/begin COMPU_METHOD rel_uw_b100 "" RAT_FUNC "%6.4" "%" COEFFS 0 65536 0 0 0 100 /end COMPU_METHOD
/begin COMPU_METHOD rel_uw_b3072 "" RAT_FUNC "%6.4" "%" COEFFS 0 65536 0 0 0 3072 /end COMPU_METHOD
/begin COMPU_METHOD rel_uw_q0p0234 "" RAT_FUNC "%6.4" "%" COEFFS 0 32 0 0 0 0.75 /end COMPU_METHOD
/begin COMPU_METHOD SY_FZEATK_Compu "" TAB_VERB "%6.3" "" COMPU_TAB_REF SY_FZEATK_Compu /end COMPU_METHOD
/begin COMPU_VTAB SY_FZEATK_Compu "" TAB_VERB 3 0 "Kein externer Aggregatekoordinator vorhanden" 1 "Standard-Aggregatekoordinator vorhanden" 2 "Spezieller Aggregatekoordinator vorhanden" /end COMPU_VTAB
/begin COMPU_METHOD SY_GAUSD_Compu "" TAB_VERB "%6.3" "" COMPU_TAB_REF SY_GAUSD_Compu /end COMPU_METHOD
/begin COMPU_VTAB SY_GAUSD_Compu "" TAB_VERB 2 0 "Umschaltung Diagnoseschwellen nicht möglich" 1 "Umschaltung Diagnoseschwellen möglich" /end COMPU_VTAB
/begin COMPU_METHOD SY_GDIPFI_Compu "" TAB_VERB "%6.3" "" COMPU_TAB_REF SY_GDIPFI_Compu /end COMPU_METHOD
/begin COMPU_VTAB SY_GDIPFI_Compu "" TAB_VERB 2 0 "False" 1 "True" /end COMPU_VTAB
/begin COMPU_METHOD SY_GP_Compu "" TAB_VERB "%6.3" "" COMPU_TAB_REF SY_GP_Compu /end COMPU_METHOD
/begin COMPU_VTAB SY_GP_Compu "" TAB_VERB 2 0 "Solldrehzahl bei Klima Ein über KL mit tumg" 1 "Solldrehzahl bei Klima Ein über globalen Parameter" /end COMPU_VTAB
/begin COMPU_METHOD SY_GRDWOF_Compu "" RAT_FUNC "%6.2" "" COEFFS 0 1 0 0 0 1 /end COMPU_METHOD
/begin COMPU_METHOD SY_GRDWRT_Compu "" RAT_FUNC "%6.2" "" COEFFS 0 1 0 0 0 1 /end COMPU_METHOD
/begin COMPU_METHOD SY_H2COHK_Compu "" TAB_VERB "%6.3" "" COMPU_TAB_REF SY_H2COHK_Compu /end COMPU_METHOD
/begin COMPU_VTAB SY_H2COHK_Compu "" TAB_VERB 2 0 "False" 1 "True" /end COMPU_VTAB
/begin COMPU_METHOD SY_HDP_Compu "" TAB_VERB "%6.3" "" COMPU_TAB_REF SY_HDP_Compu /end COMPU_METHOD
/begin COMPU_VTAB SY_HDP_Compu "" TAB_VERB 4 0 "keine HDP" 1 "HDP1" 2 "HDP2" 3 "HDP3" /end COMPU_VTAB
/begin COMPU_METHOD SY_HDST_Compu "" TAB_VERB "%6.3" "" COMPU_TAB_REF SY_HDST_Compu /end COMPU_METHOD
/begin COMPU_VTAB SY_HDST_Compu "" TAB_VERB 2 0 "kein HDST" 1 "HDST" /end COMPU_VTAB
/begin COMPU_METHOD SY_HEV_Compu "" TAB_VERB "%6.3" "" COMPU_TAB_REF SY_HEV_Compu /end COMPU_METHOD
/begin COMPU_VTAB SY_HEV_Compu "" TAB_VERB 8 0 "0" 1 "HEVTYP_SER" 2 "HEVTYP_SERPARL" 3 "HEVTYP_PWRSPLT" 4 "HEVTYP_PARL" 5 "HEVTYP_EAD" 6 "HEVTYP_EDCT" 7 "HEVTYP_PARLSER" /end COMPU_VTAB
/begin COMPU_METHOD SY_HFM2_Compu "" TAB_VERB "%6.3" "" COMPU_TAB_REF SY_HFM2_Compu /end COMPU_METHOD
/begin COMPU_VTAB SY_HFM2_Compu "" TAB_VERB 2 0 "kein zweiter HFM vorhanden" 1 "zweiter HFM vorhanden" /end COMPU_VTAB
/begin COMPU_METHOD SY_HFMFIL_Compu "" TAB_VERB "%6.3" "" COMPU_TAB_REF SY_HFMFIL_Compu /end COMPU_METHOD
/begin COMPU_VTAB SY_HFMFIL_Compu "" TAB_VERB 2 0 "no HFM filter activ" 1 "HFM filter activ" /end COMPU_VTAB
/begin COMPU_METHOD SY_HFMKOMP_Compu "" TAB_VERB "%6.3" "" COMPU_TAB_REF SY_HFMKOMP_Compu /end COMPU_METHOD
/begin COMPU_VTAB SY_HFMKOMP_Compu "" TAB_VERB 9 0 "No_Afs" 1 "Afs_AnIf" 2 "Afs_PwmIf_Corrn" 3 "Afs_PwmIf_WoCorrn" 4 "Afs_PwmIf_DblRng" 5 "Afs_AnIf_SelfDiag" 6 "Afs_SentIf" 7 "Afs_PwmIfWoCorrn_SentIf" 8 "Afs_PwmIfCorrn_SentIf" /end COMPU_VTAB
/begin COMPU_METHOD SY_HFMPANZ_Compu "" TAB_VERB "%6.3" "" COMPU_TAB_REF SY_HFMPANZ_Compu /end COMPU_METHOD
/begin COMPU_VTAB SY_HFMPANZ_Compu "" TAB_VERB 4 0 "No device" 1 "1 device" 2 "2 device" 3 "3 device" /end COMPU_VTAB
/begin COMPU_METHOD SY_HFM_ANZKL_Compu "" TAB_VERB "%6.3" "" COMPU_TAB_REF SY_HFM_ANZKL_Compu /end COMPU_METHOD
/begin COMPU_VTAB SY_HFM_ANZKL_Compu "" TAB_VERB 3 0 "no HFM" 1 "one HFM transfer curve" 2 "two HFM transfer curves" /end COMPU_VTAB
/begin COMPU_METHOD SY_HFM_Compu "" TAB_VERB "%6.3" "" COMPU_TAB_REF SY_HFM_Compu /end COMPU_METHOD
/begin COMPU_VTAB SY_HFM_Compu "" TAB_VERB 3 0 "kein HFM verbaut" 1 "HFM verbaut (vor Verdichter)" 2 "HFM verbaut (nach Verdichter)" /end COMPU_VTAB
/begin COMPU_METHOD SY_HKS_Compu "" TAB_VERB "%6.3" "" COMPU_TAB_REF SY_HKS_Compu /end COMPU_METHOD
/begin COMPU_VTAB SY_HKS_Compu "" TAB_VERB 2 0 "HomogenKlopfSchutz nicht vorhanden" 1 "HomogenKlopfSchutz vorhanden" /end COMPU_VTAB
/begin COMPU_METHOD SY_HLSHRTP_Compu "" TAB_VERB "%6.3" "" COMPU_TAB_REF SY_HLSHRTP_Compu /end COMPU_METHOD
/begin COMPU_VTAB SY_HLSHRTP_Compu "" TAB_VERB 2 0 "False" 1 "True" /end COMPU_VTAB
/begin COMPU_METHOD SY_HMBMBA_Compu "" TAB_VERB "%6.3" "" COMPU_TAB_REF SY_HMBMBA_Compu /end COMPU_METHOD
/begin COMPU_VTAB SY_HMBMBA_Compu "" TAB_VERB 2 0 "False" 1 "True" /end COMPU_VTAB
/begin COMPU_METHOD SY_HMB_Compu "" TAB_VERB "%6.3" "" COMPU_TAB_REF SY_HMB_Compu /end COMPU_METHOD
/begin COMPU_VTAB SY_HMB_Compu "" TAB_VERB 3 0 "No HMB" 1 "CDA" 2 "BDA" /end COMPU_VTAB
/begin COMPU_METHOD SY_HMM_Compu "" TAB_VERB "%6.3" "" COMPU_TAB_REF SY_HMM_Compu /end COMPU_METHOD
/begin COMPU_VTAB SY_HMM_Compu "" TAB_VERB 2 0 "kein HMM-Betrieb vorhanden" 1 "HMM-Betrieb vorhanden" /end COMPU_VTAB
/begin COMPU_METHOD SY_HOS_Compu "" TAB_VERB "%6.3" "" COMPU_TAB_REF SY_HOS_Compu /end COMPU_METHOD
/begin COMPU_VTAB SY_HOS_Compu "" TAB_VERB 2 0 "False" 1 "True" /end COMPU_VTAB
/begin COMPU_METHOD SY_HSG_Compu "" TAB_VERB "%6.3" "" COMPU_TAB_REF SY_HSG_Compu /end COMPU_METHOD
/begin COMPU_VTAB SY_HSG_Compu "" TAB_VERB 2 0 "False" 1 "True" /end COMPU_VTAB
/begin COMPU_METHOD SY_HSPMD_Compu "" TAB_VERB "%6.3" "" COMPU_TAB_REF SY_HSPMD_Compu /end COMPU_METHOD
/begin COMPU_VTAB SY_HSPMD_Compu "" TAB_VERB 3 0 "kein HSP-Betrieb (BDE)" 1 "HSP mit genauer Md-Modellierung" 2 "HSP mit genauer Md-Modellierung + LBK" /end COMPU_VTAB
/begin COMPU_METHOD SY_HSPNWS_Compu "" TAB_VERB "%6.3" "" COMPU_TAB_REF SY_HSPNWS_Compu /end COMPU_METHOD
/begin COMPU_VTAB SY_HSPNWS_Compu "" TAB_VERB 2 0 "False" 1 "True" /end COMPU_VTAB
/begin COMPU_METHOD SY_HSP_Compu "" TAB_VERB "%6.3" "" COMPU_TAB_REF SY_HSP_Compu /end COMPU_METHOD
/begin COMPU_VTAB SY_HSP_Compu "" TAB_VERB 2 0 "FALSE" 1 "TRUE" /end COMPU_VTAB
/begin COMPU_METHOD SY_IATPS11_Compu "" TAB_VERB "%6.3" "" COMPU_TAB_REF SY_IATPS11_Compu /end COMPU_METHOD
/begin COMPU_VTAB SY_IATPS11_Compu "" TAB_VERB 7 0 "no sensor" 1 "TFA1" 2 "TFA2" 3 "TFA3" 4 "TFA4" 5 "TFA5" 6 "TFA6" /end COMPU_VTAB
/begin COMPU_METHOD SY_IATPS12_Compu "" TAB_VERB "%6.3" "" COMPU_TAB_REF SY_IATPS12_Compu /end COMPU_METHOD
/begin COMPU_VTAB SY_IATPS12_Compu "" TAB_VERB 7 0 "no sensor" 1 "TFA1" 2 "TFA2" 3 "TFA3" 4 "TFA4" 5 "TFA5" 6 "TFA6" /end COMPU_VTAB
/begin COMPU_METHOD SY_IATPS13_Compu "" TAB_VERB "%6.3" "" COMPU_TAB_REF SY_IATPS13_Compu /end COMPU_METHOD
/begin COMPU_VTAB SY_IATPS13_Compu "" TAB_VERB 7 0 "no sensor" 1 "TFA1" 2 "TFA2" 3 "TFA3" 4 "TFA4" 5 "TFA5" 6 "TFA6" /end COMPU_VTAB
/begin COMPU_METHOD SY_IATPS21_Compu "" TAB_VERB "%6.3" "" COMPU_TAB_REF SY_IATPS21_Compu /end COMPU_METHOD
/begin COMPU_VTAB SY_IATPS21_Compu "" TAB_VERB 7 0 "no sensor" 1 "TFA1" 2 "TFA2" 3 "TFA3" 4 "TFA4" 5 "TFA5" 6 "TFA6" /end COMPU_VTAB
/begin COMPU_METHOD SY_IATPS22_Compu "" TAB_VERB "%6.3" "" COMPU_TAB_REF SY_IATPS22_Compu /end COMPU_METHOD
/begin COMPU_VTAB SY_IATPS22_Compu "" TAB_VERB 7 0 "no sensor" 1 "TFA1" 2 "TFA2" 3 "TFA3" 4 "TFA4" 5 "TFA5" 6 "TFA6" /end COMPU_VTAB
/begin COMPU_METHOD SY_IATPS23_Compu "" TAB_VERB "%6.3" "" COMPU_TAB_REF SY_IATPS23_Compu /end COMPU_METHOD
/begin COMPU_VTAB SY_IATPS23_Compu "" TAB_VERB 7 0 "no sensor" 1 "TFA1" 2 "TFA2" 3 "TFA3" 4 "TFA4" 5 "TFA5" 6 "TFA6" /end COMPU_VTAB
/begin COMPU_METHOD SY_IFOTMEN_Compu "" TAB_VERB "%6.3" "" COMPU_TAB_REF SY_IFOTMEN_Compu /end COMPU_METHOD
/begin COMPU_VTAB SY_IFOTMEN_Compu "" TAB_VERB 2 0 "SY_IFOTMEN = 0" 1 "SY_IFOTMEN = 1" /end COMPU_VTAB
/begin COMPU_METHOD SY_IFTCWRP_Compu "" TAB_VERB "%6.3" "" COMPU_TAB_REF SY_IFTCWRP_Compu /end COMPU_METHOD
/begin COMPU_VTAB SY_IFTCWRP_Compu "" TAB_VERB 2 0 "SY_IFTCWRP==0" 1 "SY_IFTCWRP>0" /end COMPU_VTAB
/begin COMPU_METHOD SY_IGIFLAG_Compu "" TAB_VERB "%6.3" "" COMPU_TAB_REF SY_IGIFLAG_Compu /end COMPU_METHOD
/begin COMPU_VTAB SY_IGIFLAG_Compu "" TAB_VERB 2 0 "False" 1 "True" /end COMPU_VTAB
/begin COMPU_METHOD SY_INHIBIT_Compu "" TAB_VERB "%6.3" "" COMPU_TAB_REF SY_INHIBIT_Compu /end COMPU_METHOD
/begin COMPU_VTAB SY_INHIBIT_Compu "" TAB_VERB 3 0 "Kein Inhibitor" 1 "Inhibitor zur Fehlerpfad-spezifischen Sperrung" 2 "Inhibitor zur Fehler-Typ-spezifischen Sperrung" /end COMPU_VTAB
/begin COMPU_METHOD SY_INI_OBD_Compu "" TAB_VERB "%6.3" "" COMPU_TAB_REF SY_INI_OBD_Compu /end COMPU_METHOD
/begin COMPU_VTAB SY_INI_OBD_Compu "" TAB_VERB 6 0 "ISO 14230-4 per WUP und ISO 9141-2 per 5Bd" 1 "ISO 14230-4 per 5Baud" 2 "ISO 9141-2 per 5Baud" 3 "ISO 14230-4 per WUP (fast Ini.)" 4 "kein CARB-Protokoll" 5 "ISO 15765-4 CAN" /end COMPU_VTAB
/begin COMPU_METHOD SY_INJADKM_Compu "" TAB_VERB "%6.3" "" COMPU_TAB_REF SY_INJADKM_Compu /end COMPU_METHOD
/begin COMPU_VTAB SY_INJADKM_Compu "" TAB_VERB 2 0 "False" 1 "True" /end COMPU_VTAB
/begin COMPU_METHOD SY_IPRCRSH_Compu "" TAB_VERB "%6.3" "" COMPU_TAB_REF SY_IPRCRSH_Compu /end COMPU_METHOD
/begin COMPU_VTAB SY_IPRCRSH_Compu "" TAB_VERB 2 0 "False" 1 "True" /end COMPU_VTAB
/begin COMPU_METHOD SY_ISG_Compu "" TAB_VERB "%6.3" "" COMPU_TAB_REF SY_ISG_Compu /end COMPU_METHOD
/begin COMPU_VTAB SY_ISG_Compu "" TAB_VERB 2 0 "False" 1 "True" /end COMPU_VTAB
/begin COMPU_METHOD SY_IUMPR_Compu "" TAB_VERB "%6.3" "" COMPU_TAB_REF SY_IUMPR_Compu /end COMPU_METHOD
/begin COMPU_VTAB SY_IUMPR_Compu "" TAB_VERB 2 0 "keine Auswetung der IUMPR" 1 "Auswertung der IUMPR" /end COMPU_VTAB
/begin COMPU_METHOD SY_KDHFM_Compu "" TAB_VERB "%6.3" "" COMPU_TAB_REF SY_KDHFM_Compu /end COMPU_METHOD
/begin COMPU_VTAB SY_KDHFM_Compu "" TAB_VERB 2 0 "False" 1 "True" /end COMPU_VTAB
/begin COMPU_METHOD SY_KDS_Compu "" TAB_VERB "%6.3" "" COMPU_TAB_REF SY_KDS_Compu /end COMPU_METHOD
/begin COMPU_VTAB SY_KDS_Compu "" TAB_VERB 2 0 "False" 1 "True" /end COMPU_VTAB
/begin COMPU_METHOD SY_KFLRA_Compu "" TAB_VERB "%6.3" "" COMPU_TAB_REF SY_KFLRA_Compu /end COMPU_METHOD
/begin COMPU_VTAB SY_KFLRA_Compu "" TAB_VERB 2 0 "False" 1 "True" /end COMPU_VTAB
/begin COMPU_METHOD SY_KHETA_Compu "" TAB_VERB "%6.3" "" COMPU_TAB_REF SY_KHETA_Compu /end COMPU_METHOD
/begin COMPU_VTAB SY_KHETA_Compu "" TAB_VERB 2 0 "Momentenreserve" 1 "Wirkungsgrad" /end COMPU_VTAB
/begin COMPU_METHOD SY_KHTMSFH_Compu "" TAB_VERB "%6.3" "" COMPU_TAB_REF SY_KHTMSFH_Compu /end COMPU_METHOD
/begin COMPU_VTAB SY_KHTMSFH_Compu "" TAB_VERB 2 0 "KHTMSFH_LINE" 1 "KHTMSFH_MAP" /end COMPU_VTAB
/begin COMPU_METHOD SY_KJ_Compu "" TAB_VERB "%6.3" "" COMPU_TAB_REF SY_KJ_Compu /end COMPU_METHOD
/begin COMPU_VTAB SY_KJ_Compu "" TAB_VERB 2 0 "0" 1 "1" /end COMPU_VTAB
/begin COMPU_METHOD SY_KOLBSC_Compu "" RAT_FUNC "%6.2" "" COEFFS 0 1 0 0 0 1 /end COMPU_METHOD
/begin COMPU_METHOD SY_KONWDK_Compu "" TAB_VERB "%6.3" "" COMPU_TAB_REF SY_KONWDK_Compu /end COMPU_METHOD
/begin COMPU_VTAB SY_KONWDK_Compu "" TAB_VERB 2 0 "keine Koordination zwischen DK (FUEDK) und NWS" 1 "Koordination zwischen DK und NWS" /end COMPU_VTAB
/begin COMPU_METHOD SY_KOP_Compu "" TAB_VERB "%6.3" "" COMPU_TAB_REF SY_KOP_Compu /end COMPU_METHOD
/begin COMPU_VTAB SY_KOP_Compu "" TAB_VERB 2 0 "False" 1 "True" /end COMPU_VTAB
/begin COMPU_METHOD SY_KORRZ_Compu "" RAT_FUNC "%6.2" "" COEFFS 0 1 0 0 0 1 /end COMPU_METHOD
/begin COMPU_METHOD SY_KRADPZI_Compu "" TAB_VERB "%6.3" "" COMPU_TAB_REF SY_KRADPZI_Compu /end COMPU_METHOD
/begin COMPU_VTAB SY_KRADPZI_Compu "" TAB_VERB 2 0 "0" 1 "1" /end COMPU_VTAB
/begin COMPU_METHOD SY_KRK_Compu "" TAB_VERB "%6.3" "" COMPU_TAB_REF SY_KRK_Compu /end COMPU_METHOD
/begin COMPU_VTAB SY_KRK_Compu "" TAB_VERB 2 0 "False" 1 "True" /end COMPU_VTAB
/begin COMPU_METHOD SY_KRLZ_Compu "" TAB_VERB "%6.3" "" COMPU_TAB_REF SY_KRLZ_Compu /end COMPU_METHOD
/begin COMPU_VTAB SY_KRLZ_Compu "" TAB_VERB 2 0 "%KRLZ nicht vorhanden" 1 "%KRLZ vorhanden" /end COMPU_VTAB
/begin COMPU_METHOD SY_KRSAINT_Compu "" TAB_VERB "%6.3" "" COMPU_TAB_REF SY_KRSAINT_Compu /end COMPU_METHOD
/begin COMPU_VTAB SY_KRSAINT_Compu "" TAB_VERB 2 0 "False" 1 "True" /end COMPU_VTAB
/begin COMPU_METHOD SY_KRSASW_Compu "" TAB_VERB "%6.3" "" COMPU_TAB_REF SY_KRSASW_Compu /end COMPU_METHOD
/begin COMPU_VTAB SY_KRSASW_Compu "" TAB_VERB 2 0 "KNOCKCONTROLEXTERNALSIGNALEVALUATION" 1 "KNOCKCONTROLINTERNALSIGNALEVALUATIONMx17" /end COMPU_VTAB
/begin COMPU_METHOD SY_KRZMF_Compu "" TAB_VERB "%6.3" "" COMPU_TAB_REF SY_KRZMF_Compu /end COMPU_METHOD
/begin COMPU_VTAB SY_KRZMF_Compu "" TAB_VERB 2 0 "False" 1 "True" /end COMPU_VTAB
/begin COMPU_METHOD SY_KS1_Compu "" RAT_FUNC "%6.2" "" COEFFS 0 1 0 0 0 1 /end COMPU_METHOD
/begin COMPU_METHOD SY_KS2_Compu "" RAT_FUNC "%6.2" "" COEFFS 0 1 0 0 0 1 /end COMPU_METHOD
/begin COMPU_METHOD SY_KS3_Compu "" RAT_FUNC "%6.2" "" COEFFS 0 1 0 0 0 1 /end COMPU_METHOD
/begin COMPU_METHOD SY_KS4_Compu "" RAT_FUNC "%6.2" "" COEFFS 0 1 0 0 0 1 /end COMPU_METHOD
/begin COMPU_METHOD SY_KSENCHN_Compu "" RAT_FUNC "%6.2" "" COEFFS 0 1 0 0 0 1 /end COMPU_METHOD
/begin COMPU_METHOD SY_KSENFLT_Compu "" RAT_FUNC "%6.2" "" COEFFS 0 1 0 0 0 1 /end COMPU_METHOD
/begin COMPU_METHOD SY_KSZA_Compu "" TAB_VERB "%6.3" "" COMPU_TAB_REF SY_KSZA_Compu /end COMPU_METHOD
/begin COMPU_VTAB SY_KSZA_Compu "" TAB_VERB 5 0 "number of knock sensors is 0" 1 "number of knock sensors is 1" 2 "number of knock sensors is 2" 3 "number of knock sensors is 3" 4 "number of knock sensors is 4" /end COMPU_VTAB
/begin COMPU_METHOD SY_KT_Compu "" RAT_FUNC "%6.2" "" COEFFS 0 1 0 0 0 1 /end COMPU_METHOD
/begin COMPU_METHOD SY_KUPOT_Compu "" TAB_VERB "%6.3" "" COMPU_TAB_REF SY_KUPOT_Compu /end COMPU_METHOD
/begin COMPU_VTAB SY_KUPOT_Compu "" TAB_VERB 2 0 "kein Kupplungspoti verbaut" 1 "Kupplungspoti verbaut" /end COMPU_VTAB
/begin COMPU_METHOD SY_KWFOSC_Compu "" TAB_VERB "%6.3" "" COMPU_TAB_REF SY_KWFOSC_Compu /end COMPU_METHOD
/begin COMPU_VTAB SY_KWFOSC_Compu "" TAB_VERB 2 0 "KWFOSC_NO" 1 "KWFOSC_YES" /end COMPU_VTAB
/begin COMPU_METHOD SY_LAMKAPP_Compu "" TAB_VERB "%6.3" "" COMPU_TAB_REF SY_LAMKAPP_Compu /end COMPU_METHOD
/begin COMPU_VTAB SY_LAMKAPP_Compu "" TAB_VERB 2 0 "SY_LAMKAPP_NO" 1 "SY_LAMKAPP_YES" /end COMPU_VTAB
/begin COMPU_METHOD SY_LAMNSWLP_Compu "" TAB_VERB "%6.3" "" COMPU_TAB_REF SY_LAMNSWLP_Compu /end COMPU_METHOD
/begin COMPU_VTAB SY_LAMNSWLP_Compu "" TAB_VERB 2 0 "False" 1 "True" /end COMPU_VTAB
/begin COMPU_METHOD SY_LAYER_Compu "" TAB_VERB "%6.3" "" COMPU_TAB_REF SY_LAYER_Compu /end COMPU_METHOD
/begin COMPU_VTAB SY_LAYER_Compu "" TAB_VERB 2 0 "False" 1 "True" /end COMPU_VTAB
/begin COMPU_METHOD SY_LBKMD_Compu "" TAB_VERB "%6.3" "" COMPU_TAB_REF SY_LBKMD_Compu /end COMPU_METHOD
/begin COMPU_VTAB SY_LBKMD_Compu "" TAB_VERB 2 0 "einfache Md-Modellierung LBK" 1 "erweiterte Md-Modellierung LBK (ETADZWL)" /end COMPU_VTAB
/begin COMPU_METHOD SY_LBK_Compu "" TAB_VERB "%6.3" "" COMPU_TAB_REF SY_LBK_Compu /end COMPU_METHOD
/begin COMPU_VTAB SY_LBK_Compu "" TAB_VERB 7 0 "keine Ladungsbewegungsklappe vorhanden" 1 "Ladungsbewegungsklappe ohne Lagerückmeldung vorhan" 2 "Ladungsbewegungsklappe mit Lagerückmeldung vorhand" 3 "Ladungsbewegungsklappe kontiniuierlich mit DC Moto" 4 "Ladungsbewegungsklappe kontinuierlich mit Stepper" 5 "kontinuierliche LBK mit Lageregelung vor Ort" 6 "kontinuierliche LBK mit Lageregelung im SG" /end COMPU_VTAB
/begin COMPU_METHOD SY_LCSS_Compu "" TAB_VERB "%6.3" "" COMPU_TAB_REF SY_LCSS_Compu /end COMPU_METHOD
/begin COMPU_VTAB SY_LCSS_Compu "" TAB_VERB 2 0 "false" 1 "true" /end COMPU_VTAB
/begin COMPU_METHOD SY_LEITMOD_Compu "" TAB_VERB "%6.3" "" COMPU_TAB_REF SY_LEITMOD_Compu /end COMPU_METHOD
/begin COMPU_VTAB SY_LEITMOD_Compu "" TAB_VERB 2 0 "Leitungsmodell nicht aktiv" 1 "Leitungsmodell aktiv" /end COMPU_VTAB
/begin COMPU_METHOD SY_LENKH_Compu "" TAB_VERB "%6.3" "" COMPU_TAB_REF SY_LENKH_Compu /end COMPU_METHOD
/begin COMPU_VTAB SY_LENKH_Compu "" TAB_VERB 2 0 "keine Servolenkung vorhanden" 1 "Servolenkung vorhanden" /end COMPU_VTAB
/begin COMPU_METHOD SY_LF2B_Compu "" TAB_VERB "%6.3" "" COMPU_TAB_REF SY_LF2B_Compu /end COMPU_METHOD
/begin COMPU_VTAB SY_LF2B_Compu "" TAB_VERB 6 0 "0" 1 "1" 2 "2" 3 "3" 4 "4" 255 "255" /end COMPU_VTAB
/begin COMPU_METHOD SY_LLKEO_Compu "" TAB_VERB "%6.3" "" COMPU_TAB_REF SY_LLKEO_Compu /end COMPU_METHOD
/begin COMPU_VTAB SY_LLKEO_Compu "" TAB_VERB 4 0 "NO_INTCOOL" 1 "INTCOOL_US" 2 "INTCOOL_DS" 3 "INTCOOL_US_AND_DS" /end COMPU_VTAB
/begin COMPU_METHOD SY_LOWRA_Compu "" TAB_VERB "%6.3" "" COMPU_TAB_REF SY_LOWRA_Compu /end COMPU_METHOD
/begin COMPU_VTAB SY_LOWRA_Compu "" TAB_VERB 2 0 "FALSE" 1 "TRUE" /end COMPU_VTAB
/begin COMPU_METHOD SY_LPG_Compu "" TAB_VERB "%6.3" "" COMPU_TAB_REF SY_LPG_Compu /end COMPU_METHOD
/begin COMPU_VTAB SY_LPG_Compu "" TAB_VERB 4 0 "NO_LPG" 1 "SY_LPG_PFI_GAS" 2 "SY_LPG_PFI_LIQUID" 3 "LPG_DI_injection" /end COMPU_VTAB
/begin COMPU_METHOD SY_LPI_Compu "" TAB_VERB "%6.3" "" COMPU_TAB_REF SY_LPI_Compu /end COMPU_METHOD
/begin COMPU_VTAB SY_LPI_Compu "" TAB_VERB 3 0 "No LPI used" 1 "LPI with external Interface Box ( external LPI-ECU" 2 "n ECU integrated LPI functionality" /end COMPU_VTAB
/begin COMPU_METHOD SY_LR2PAR_Compu "" TAB_VERB "%6.3" "" COMPU_TAB_REF SY_LR2PAR_Compu /end COMPU_METHOD
/begin COMPU_VTAB SY_LR2PAR_Compu "" TAB_VERB 2 0 "Gemeinsame Lambdaregelungsparameter Bank 1/ 2" 1 "Separate Lambdaregelungsparameter Bank 1/ 2" /end COMPU_VTAB
/begin COMPU_METHOD SY_LRATKG_Compu "" TAB_VERB "%6.3" "" COMPU_TAB_REF SY_LRATKG_Compu /end COMPU_METHOD
/begin COMPU_VTAB SY_LRATKG_Compu "" TAB_VERB 2 0 "FALSE" 1 "TRUE" /end COMPU_VTAB
/begin COMPU_METHOD SY_LRAT_Compu "" TAB_VERB "%6.3" "" COMPU_TAB_REF SY_LRAT_Compu /end COMPU_METHOD
/begin COMPU_VTAB SY_LRAT_Compu "" TAB_VERB 2 0 "False" 1 "True" /end COMPU_VTAB
/begin COMPU_METHOD SY_LREBPS_Compu "" TAB_VERB "%6.3" "" COMPU_TAB_REF SY_LREBPS_Compu /end COMPU_METHOD
/begin COMPU_VTAB SY_LREBPS_Compu "" TAB_VERB 2 0 "False" 1 "True" /end COMPU_VTAB
/begin COMPU_METHOD SY_LRFK2_Compu "" TAB_VERB "%6.3" "" COMPU_TAB_REF SY_LRFK2_Compu /end COMPU_METHOD
/begin COMPU_VTAB SY_LRFK2_Compu "" TAB_VERB 2 0 "0" 1 "1" /end COMPU_VTAB
/begin COMPU_METHOD SY_LRFKEF_Compu "" TAB_VERB "%6.3" "" COMPU_TAB_REF SY_LRFKEF_Compu /end COMPU_METHOD
/begin COMPU_VTAB SY_LRFKEF_Compu "" TAB_VERB 2 0 "keine Eigenfrequenzregelung hinter Frontkat" 1 "Eigenfrequenzregelung hinter Frontkat" /end COMPU_VTAB
/begin COMPU_METHOD SY_LRFK_Compu "" TAB_VERB "%6.3" "" COMPU_TAB_REF SY_LRFK_Compu /end COMPU_METHOD
/begin COMPU_VTAB SY_LRFK_Compu "" TAB_VERB 2 0 "0" 1 "1" /end COMPU_VTAB
/begin COMPU_METHOD SY_LRSEZ_Compu "" TAB_VERB "%6.3" "" COMPU_TAB_REF SY_LRSEZ_Compu /end COMPU_METHOD
/begin COMPU_VTAB SY_LRSEZ_Compu "" TAB_VERB 2 0 "keine zylinderindividuelle Lambdaregelung" 1 "zylinderindividuelle Lambdaregelung" /end COMPU_VTAB
/begin COMPU_METHOD SY_LSAGETR_Compu "" TAB_VERB "%6.3" "" COMPU_TAB_REF SY_LSAGETR_Compu /end COMPU_METHOD
/begin COMPU_VTAB SY_LSAGETR_Compu "" TAB_VERB 2 0 "False kein Lastschalt Automatikgetriebe eingebaut" 1 "True Lastschalt Automatikgetriebe eingebaut" /end COMPU_VTAB
/begin COMPU_METHOD SY_LSFIKR2_Compu "" TAB_VERB "%6.3" "" COMPU_TAB_REF SY_LSFIKR2_Compu /end COMPU_METHOD
/begin COMPU_VTAB SY_LSFIKR2_Compu "" TAB_VERB 2 0 "False" 1 "True" /end COMPU_VTAB
/begin COMPU_METHOD SY_LSFIKR_Compu "" TAB_VERB "%6.3" "" COMPU_TAB_REF SY_LSFIKR_Compu /end COMPU_METHOD
/begin COMPU_VTAB SY_LSFIKR_Compu "" TAB_VERB 2 0 "0" 1 "1" /end COMPU_VTAB
/begin COMPU_METHOD SY_LSFNHK2_Compu "" TAB_VERB "%6.3" "" COMPU_TAB_REF SY_LSFNHK2_Compu /end COMPU_METHOD
/begin COMPU_VTAB SY_LSFNHK2_Compu "" TAB_VERB 2 0 "keine LSF nach Hauptkat in Bank2 verbaut" 1 "LSF nach Hauptkat in Bank2 verbaut" /end COMPU_VTAB
/begin COMPU_METHOD SY_LSFNHK_Compu "" TAB_VERB "%6.3" "" COMPU_TAB_REF SY_LSFNHK_Compu /end COMPU_METHOD
/begin COMPU_VTAB SY_LSFNHK_Compu "" TAB_VERB 2 0 "keine LSF nach Hauptkat verbaut" 1 "LSF nach Hauptkat verbaut" /end COMPU_VTAB
/begin COMPU_METHOD t10msxs_ub_q0p01 "" RAT_FUNC "%6.4" "s" COEFFS 0 1 0 0 0 0.01 /end COMPU_METHOD
/begin COMPU_METHOD t40msxs_ub_q0p04 "" RAT_FUNC "%6.4" "s" COEFFS 0 1 0 0 0 0.04 /end COMPU_METHOD
/begin COMPU_METHOD temp_q4p4703Em8_om48_DegC "" RAT_FUNC "%6.2" "Grad C" COEFFS 0 67108864 3221225472 0 0 3 /end COMPU_METHOD
/begin COMPU_METHOD temp_q7p324Em4_DegC "" RAT_FUNC "%6.5" "Grad C" COEFFS 0 4096 0 0 0 3 /end COMPU_METHOD
/begin COMPU_METHOD temp_qn7p324Em4_DegC "" RAT_FUNC "%8.7" "Grad C" COEFFS 0 -4096 0 0 0 3 /end COMPU_METHOD
/begin COMPU_METHOD temp_ub_q0p75_o48 "" RAT_FUNC "%6.2" "Grad C" COEFFS 0 1 48 0 0 0.75 /end COMPU_METHOD
/begin COMPU_METHOD TimeDelay_ms "" RAT_FUNC "%13.2" "ms" COEFFS 0 0 1 0 2.3283064365387e-007 0 /end COMPU_METHOD
/begin COMPU_METHOD Time_ms "" RAT_FUNC "%6.1" "ms" COEFFS 0 0.1 0 0 0 1 /end COMPU_METHOD
/begin COMPU_METHOD TransR "" RAT_FUNC "%6.4" "-" COEFFS 0 100 0 0 0 1 /end COMPU_METHOD
/begin COMPU_METHOD t_q0p01 "" RAT_FUNC "%6.4" "s" COEFFS 0 100 0 0 0 1 /end COMPU_METHOD
/begin COMPU_METHOD t_q0p04 "" RAT_FUNC "%6.4" "s" COEFFS 0 100 0 0 0 4 /end COMPU_METHOD
/begin COMPU_METHOD vel_q0p01 "" RAT_FUNC "%6.4" "km/h" COEFFS 0 100 0 0 0 1 /end COMPU_METHOD
/begin COMPU_METHOD zk10msxs_uw_b655p36PT1 "" RAT_FUNC "%6.2" "s" COEFFS 0 0 65536 0 100 1 /end COMPU_METHOD
/begin COMPU_METHOD zk40msxs_uw_b2621p44PT1 "" RAT_FUNC "%6.1" "s" COEFFS 0 0 65536 0 25 1 /end COMPU_METHOD
/begin COMPU_METHOD zw_q0p1 "" RAT_FUNC "%6.3" "Grad KW" COEFFS 0 10 0 0 0 1 /end COMPU_METHOD
/begin COMPU_METHOD zw_sb_q0p75 "" RAT_FUNC "%6.3" "Grad KW" COEFFS 0 255 0 0 0 191.25 /end COMPU_METHOD
/begin RECORD_LAYOUT Axis_Xu16 NO_AXIS_PTS_X 1 UWORD AXIS_PTS_X 2 UWORD INDEX_INCR DIRECT /end RECORD_LAYOUT
/begin RECORD_LAYOUT Axis_Xu8 NO_AXIS_PTS_X 1 UBYTE AXIS_PTS_X 2 UBYTE INDEX_INCR DIRECT /end RECORD_LAYOUT
/begin RECORD_LAYOUT MapG_Wu8 FNC_VALUES 1 UBYTE COLUMN_DIR DIRECT /end RECORD_LAYOUT
/begin RECORD_LAYOUT Map_Xs16Ys16Ws16 NO_AXIS_PTS_X 1 SWORD NO_AXIS_PTS_Y 2 SWORD AXIS_PTS_X 3 SWORD INDEX_INCR DIRECT AXIS_PTS_Y 4 SWORD INDEX_INCR DIRECT FNC_VALUES 5 SWORD COLUMN_DIR DIRECT /end RECORD_LAYOUT
/begin RECORD_LAYOUT Map_Xu8Yu8Wu8 NO_AXIS_PTS_X 1 UBYTE NO_AXIS_PTS_Y 2 UBYTE AXIS_PTS_X 3 UBYTE INDEX_INCR DIRECT AXIS_PTS_Y 4 UBYTE INDEX_INCR DIRECT FNC_VALUES 5 UBYTE COLUMN_DIR DIRECT /end RECORD_LAYOUT
/begin RECORD_LAYOUT Mo_DataCurveSstS16WS16 NO_AXIS_PTS_X 1 SWORD AXIS_PTS_X 2 SWORD INDEX_INCR DIRECT FNC_VALUES 3 SWORD COLUMN_DIR DIRECT /end RECORD_LAYOUT
/begin RECORD_LAYOUT Mo_DataCurveSstU8WU8 NO_AXIS_PTS_X 1 UBYTE AXIS_PTS_X 2 UBYTE INDEX_INCR DIRECT FNC_VALUES 3 UBYTE COLUMN_DIR DIRECT /end RECORD_LAYOUT
/begin RECORD_LAYOUT RB_Val_Ws16 FNC_VALUES 1 SWORD COLUMN_DIR DIRECT /end RECORD_LAYOUT
/begin RECORD_LAYOUT RB_Val_Wu16 FNC_VALUES 1 UWORD COLUMN_DIR DIRECT /end RECORD_LAYOUT
/begin RECORD_LAYOUT RB_Val_Wu8 FNC_VALUES 1 UBYTE COLUMN_DIR DIRECT /end RECORD_LAYOUT
/begin RECORD_LAYOUT ValA_Wu8 FNC_VALUES 1 UBYTE COLUMN_DIR DIRECT /end RECORD_LAYOUT
/begin RECORD_LAYOUT Val_Ws16 FNC_VALUES 1 SWORD COLUMN_DIR DIRECT /end RECORD_LAYOUT
/begin RECORD_LAYOUT Val_Ws32 FNC_VALUES 1 SLONG COLUMN_DIR DIRECT /end RECORD_LAYOUT
/begin RECORD_LAYOUT Val_Wu16 FNC_VALUES 1 UWORD COLUMN_DIR DIRECT /end RECORD_LAYOUT
/begin RECORD_LAYOUT Val_Wu8 FNC_VALUES 1 UBYTE COLUMN_DIR DIRECT /end RECORD_LAYOUT
/end MODULE
/end PROJECT
