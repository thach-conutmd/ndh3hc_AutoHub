ASAP2_VERSION 1 60
/begin PROJECT MG1CA020 "MG1CA020"
/begin HEADER "" VERSION "MG1CA020_6SAY_V011_TPROT" PROJECT_NO MG1CA020 /end HEADER
/begin MODULE DIM ""
/begin MOD_COMMON "" BYTE_ORDER MSB_LAST ALIGNMENT_BYTE 1 ALIGNMENT_WORD 2 ALIGNMENT_LONG 4 ALIGNMENT_INT64 4 ALIGNMENT_FLOAT32_IEEE 4 ALIGNMENT_FLOAT64_IEEE 4 DATA_SIZE 32 /end MOD_COMMON
/begin CHARACTERISTIC DINH_FId.DFC_AltIOACGFailr_CA "inhibitable FIds / FIds to be inhibited by inhibit source DFC_AltIOACGFailr" VAL_BLK 0x804D9704 ValA_Wu16 732.000000000 DINH_FIdVerb 0.00 732.000000000 FORMAT "%13.9" NUMBER 63 /end CHARACTERISTIC
/begin CHARACTERISTIC DINH_FId.DFC_AltIOACGHiVltg_CA "inhibitable FIds / FIds to be inhibited by inhibit source DFC_AltIOACGHiVltg" VAL_BLK 0x804D9782 ValA_Wu16 732.000000000 DINH_FIdVerb 0.00 732.000000000 FORMAT "%13.9" NUMBER 63 /end CHARACTERISTIC
/begin CHARACTERISTIC DINH_FId.DFC_AltIOACGLoVltg_CA "inhibitable FIds / FIds to be inhibited by inhibit source DFC_AltIOACGLoVltg" VAL_BLK 0x804D9800 ValA_Wu16 732.000000000 DINH_FIdVerb 0.00 732.000000000 FORMAT "%13.9" NUMBER 63 /end CHARACTERISTIC
/begin CHARACTERISTIC DINH_FId.DFC_AltIOACGTHi_CA "inhibitable FIds / FIds to be inhibited by inhibit source DFC_AltIOACGTHi" VAL_BLK 0x804D987E ValA_Wu16 732.000000000 DINH_FIdVerb 0.00 732.000000000 FORMAT "%13.9" NUMBER 58 /end CHARACTERISTIC
/begin CHARACTERISTIC DINH_FId.DFC_AltIODConnACG_CA "inhibitable FIds / FIds to be inhibited by inhibit source DFC_AltIODConnACG" VAL_BLK 0x804D98F2 ValA_Wu16 732.000000000 DINH_FIdVerb 0.00 732.000000000 FORMAT "%13.9" NUMBER 63 /end CHARACTERISTIC
/begin CHARACTERISTIC DINH_FId.DFC_BattUHiFailr_CA "inhibitable FIds / FIds to be inhibited by inhibit source DFC_BattUHiFailr" VAL_BLK 0x804D9970 ValA_Wu16 732.000000000 DINH_FIdVerb 0.00 732.000000000 FORMAT "%13.9" NUMBER 3 /end CHARACTERISTIC
/begin CHARACTERISTIC DINH_FId.DFC_BattULoFailr_CA "inhibitable FIds / FIds to be inhibited by inhibit source DFC_BattULoFailr" VAL_BLK 0x804D9976 ValA_Wu16 732.000000000 DINH_FIdVerb 0.00 732.000000000 FORMAT "%13.9" NUMBER 3 /end CHARACTERISTIC
/begin CHARACTERISTIC DINH_FId.DFC_BrkBstPDriftHiErr_CA "inhibitable FIds / FIds to be inhibited by inhibit source DFC_BrkBstPDriftHiErr" VAL_BLK 0x804D997C ValA_Wu16 732.000000000 DINH_FIdVerb 0.00 732.000000000 FORMAT "%13.9" NUMBER 55 /end CHARACTERISTIC
/begin CHARACTERISTIC DINH_FId.DFC_BrkBstPDriftLoErr_CA "inhibitable FIds / FIds to be inhibited by inhibit source DFC_BrkBstPDriftLoErr" VAL_BLK 0x804D99EA ValA_Wu16 732.000000000 DINH_FIdVerb 0.00 732.000000000 FORMAT "%13.9" NUMBER 55 /end CHARACTERISTIC
/begin CHARACTERISTIC DINH_FId.DFC_BrkBstPSnsrStuck_CA "inhibitable FIds / FIds to be inhibited by inhibit source DFC_BrkBstPSnsrStuck" VAL_BLK 0x804D9A58 ValA_Wu16 732.000000000 DINH_FIdVerb 0.00 732.000000000 FORMAT "%13.9" NUMBER 56 /end CHARACTERISTIC
/begin CHARACTERISTIC DINH_FId.DFC_BrkMnSwtContOn_CA "inhibitable FIds / FIds to be inhibited by inhibit source DFC_BrkMnSwtContOn" VAL_BLK 0x804D9AC8 ValA_Wu16 732.000000000 DINH_FIdVerb 0.00 732.000000000 FORMAT "%13.9" NUMBER 55 /end CHARACTERISTIC
/begin CHARACTERISTIC DINH_FId.DFC_BrkMnSwtNotStp_CA "inhibitable FIds / FIds to be inhibited by inhibit source DFC_BrkMnSwtNotStp" VAL_BLK 0x804D9B36 ValA_Wu16 732.000000000 DINH_FIdVerb 0.00 732.000000000 FORMAT "%13.9" NUMBER 55 /end CHARACTERISTIC
/begin CHARACTERISTIC DINH_FId.DFC_BrkNpl_CA "inhibitable FIds / FIds to be inhibited by inhibit source DFC_BrkNpl" VAL_BLK 0x804D9BA4 ValA_Wu16 732.000000000 DINH_FIdVerb 0.00 732.000000000 FORMAT "%13.9" NUMBER 54 /end CHARACTERISTIC
/begin CHARACTERISTIC DINH_FId.DFC_BrkRdntSwtContOn_CA "inhibitable FIds / FIds to be inhibited by inhibit source DFC_BrkRdntSwtContOn" VAL_BLK 0x804D9C10 ValA_Wu16 732.000000000 DINH_FIdVerb 0.00 732.000000000 FORMAT "%13.9" NUMBER 55 /end CHARACTERISTIC
/begin CHARACTERISTIC DINH_FId.DFC_BrkRdntSwtNotStp_CA "inhibitable FIds / FIds to be inhibited by inhibit source DFC_BrkRdntSwtNotStp" VAL_BLK 0x804D9C7E ValA_Wu16 732.000000000 DINH_FIdVerb 0.00 732.000000000 FORMAT "%13.9" NUMBER 55 /end CHARACTERISTIC
/begin CHARACTERISTIC DINH_FId.DFC_Clth3ONStuck_CA "inhibitable FIds / FIds to be inhibited by inhibit source DFC_Clth3ONStuck" VAL_BLK 0x804D9CEC ValA_Wu16 732.000000000 DINH_FIdVerb 0.00 732.000000000 FORMAT "%13.9" NUMBER 61 /end CHARACTERISTIC
/begin CHARACTERISTIC DINH_FId.DFC_Clth4OFFStuck_CA "inhibitable FIds / FIds to be inhibited by inhibit source DFC_Clth4OFFStuck" VAL_BLK 0x804D9D66 ValA_Wu16 732.000000000 DINH_FIdVerb 0.00 732.000000000 FORMAT "%13.9" NUMBER 59 /end CHARACTERISTIC
/begin CHARACTERISTIC DINH_FId.DFC_ClthOFFStuck_CA "inhibitable FIds / FIds to be inhibited by inhibit source DFC_ClthOFFStuck" VAL_BLK 0x804D9DDC ValA_Wu16 732.000000000 DINH_FIdVerb 0.00 732.000000000 FORMAT "%13.9" NUMBER 60 /end CHARACTERISTIC
/begin CHARACTERISTIC DINH_FId.DFC_ClthONStuck_CA "inhibitable FIds / FIds to be inhibited by inhibit source DFC_ClthONStuck" VAL_BLK 0x804D9E54 ValA_Wu16 732.000000000 DINH_FIdVerb 0.00 732.000000000 FORMAT "%13.9" NUMBER 60 /end CHARACTERISTIC
/begin CHARACTERISTIC DINH_FId.DFC_ClthStkFailInfo_CA "inhibitable FIds / FIds to be inhibited by inhibit source DFC_ClthStkFailInfo" VAL_BLK 0x804D9ECC ValA_Wu16 732.000000000 DINH_FIdVerb 0.00 732.000000000 FORMAT "%13.9" NUMBER 68 /end CHARACTERISTIC
/begin CHARACTERISTIC DINH_FId.DFC_ComACFailInfo_CA "inhibitable FIds / FIds to be inhibited by inhibit source DFC_ComACFailInfo" VAL_BLK 0x804D9F54 ValA_Wu16 732.000000000 DINH_FIdVerb 0.00 732.000000000 FORMAT "%13.9" NUMBER 53 /end CHARACTERISTIC
/begin CHARACTERISTIC DINH_FId.DFC_ComATFTValErr_CA "inhibitable FIds / FIds to be inhibited by inhibit source DFC_ComATFTValErr" VAL_BLK 0x804D9FBE ValA_Wu16 732.000000000 DINH_FIdVerb 0.00 732.000000000 FORMAT "%13.9" NUMBER 50 /end CHARACTERISTIC
/begin CHARACTERISTIC DINH_FId.DFC_ComATMILReq_CA "inhibitable FIds / FIds to be inhibited by inhibit source DFC_ComATMILReq" VAL_BLK 0x804DA022 ValA_Wu16 732.000000000 DINH_FIdVerb 0.00 732.000000000 FORMAT "%13.9" NUMBER 50 /end CHARACTERISTIC
/begin CHARACTERISTIC DINH_FId.DFC_ComAYCAChksum_CA "inhibitable FIds / FIds to be inhibited by inhibit source DFC_ComAYCAChksum" VAL_BLK 0x804DA086 ValA_Wu16 732.000000000 DINH_FIdVerb 0.00 732.000000000 FORMAT "%13.9" NUMBER 65 /end CHARACTERISTIC
/begin CHARACTERISTIC DINH_FId.DFC_ComAYCARingCnt_CA "inhibitable FIds / FIds to be inhibited by inhibit source DFC_ComAYCARingCnt" VAL_BLK 0x804DA108 ValA_Wu16 732.000000000 DINH_FIdVerb 0.00 732.000000000 FORMAT "%13.9" NUMBER 65 /end CHARACTERISTIC
/begin CHARACTERISTIC DINH_FId.DFC_ComAYCATOut_CA "inhibitable FIds / FIds to be inhibited by inhibit source DFC_ComAYCATOut" VAL_BLK 0x804DA18A ValA_Wu16 732.000000000 DINH_FIdVerb 0.00 732.000000000 FORMAT "%13.9" NUMBER 65 /end CHARACTERISTIC
/begin CHARACTERISTIC DINH_FId.DFC_ComAYCDChkSum_CA "inhibitable FIds / FIds to be inhibited by inhibit source DFC_ComAYCDChkSum" VAL_BLK 0x804DA20C ValA_Wu16 732.000000000 DINH_FIdVerb 0.00 732.000000000 FORMAT "%13.9" NUMBER 64 /end CHARACTERISTIC
/begin CHARACTERISTIC DINH_FId.DFC_ComAYCDTOut_CA "inhibitable FIds / FIds to be inhibited by inhibit source DFC_ComAYCDTOut" VAL_BLK 0x804DA28C ValA_Wu16 732.000000000 DINH_FIdVerb 0.00 732.000000000 FORMAT "%13.9" NUMBER 64 /end CHARACTERISTIC
/begin CHARACTERISTIC DINH_FId.DFC_ComAYCFChksum_CA "inhibitable FIds / FIds to be inhibited by inhibit source DFC_ComAYCFChksum" VAL_BLK 0x804DA30C ValA_Wu16 732.000000000 DINH_FIdVerb 0.00 732.000000000 FORMAT "%13.9" NUMBER 67 /end CHARACTERISTIC
/begin CHARACTERISTIC DINH_FId.DFC_ComAYCFRingCnt_CA "inhibitable FIds / FIds to be inhibited by inhibit source DFC_ComAYCFRingCnt" VAL_BLK 0x804DA392 ValA_Wu16 732.000000000 DINH_FIdVerb 0.00 732.000000000 FORMAT "%13.9" NUMBER 67 /end CHARACTERISTIC
/begin CHARACTERISTIC DINH_FId.DFC_ComAYCFTOut_CA "inhibitable FIds / FIds to be inhibited by inhibit source DFC_ComAYCFTOut" VAL_BLK 0x804DA418 ValA_Wu16 732.000000000 DINH_FIdVerb 0.00 732.000000000 FORMAT "%13.9" NUMBER 67 /end CHARACTERISTIC
/begin CHARACTERISTIC DINH_FId.DFC_ComAYCGChksum_CA "inhibitable FIds / FIds to be inhibited by inhibit source DFC_ComAYCGChksum" VAL_BLK 0x804DA49E ValA_Wu16 732.000000000 DINH_FIdVerb 0.00 732.000000000 FORMAT "%13.9" NUMBER 64 /end CHARACTERISTIC
/begin CHARACTERISTIC DINH_FId.DFC_ComAYCGRingCnt_CA "inhibitable FIds / FIds to be inhibited by inhibit source DFC_ComAYCGRingCnt" VAL_BLK 0x804DA51E ValA_Wu16 732.000000000 DINH_FIdVerb 0.00 732.000000000 FORMAT "%13.9" NUMBER 64 /end CHARACTERISTIC
/begin CHARACTERISTIC DINH_FId.DFC_ComAYCGTOut_CA "inhibitable FIds / FIds to be inhibited by inhibit source DFC_ComAYCGTOut" VAL_BLK 0x804DA59E ValA_Wu16 732.000000000 DINH_FIdVerb 0.00 732.000000000 FORMAT "%13.9" NUMBER 64 /end CHARACTERISTIC
/begin CHARACTERISTIC DINH_FId.DFC_ComAYCIChkSum_CA "inhibitable FIds / FIds to be inhibited by inhibit source DFC_ComAYCIChkSum" VAL_BLK 0x804DA61E ValA_Wu16 732.000000000 DINH_FIdVerb 0.00 732.000000000 FORMAT "%13.9" NUMBER 56 /end CHARACTERISTIC
/begin CHARACTERISTIC DINH_FId.DFC_ComAYCIRingCnt_CA "inhibitable FIds / FIds to be inhibited by inhibit source DFC_ComAYCIRingCnt" VAL_BLK 0x804DA68E ValA_Wu16 732.000000000 DINH_FIdVerb 0.00 732.000000000 FORMAT "%13.9" NUMBER 56 /end CHARACTERISTIC
/begin CHARACTERISTIC DINH_FId.DFC_ComAYCITOut_CA "inhibitable FIds / FIds to be inhibited by inhibit source DFC_ComAYCITOut" VAL_BLK 0x804DA6FE ValA_Wu16 732.000000000 DINH_FIdVerb 0.00 732.000000000 FORMAT "%13.9" NUMBER 56 /end CHARACTERISTIC
/begin CHARACTERISTIC DINH_FId.DFC_ComBCM1ChkSum_CA "inhibitable FIds / FIds to be inhibited by inhibit source DFC_ComBCM1ChkSum" VAL_BLK 0x804DA76E ValA_Wu16 732.000000000 DINH_FIdVerb 0.00 732.000000000 FORMAT "%13.9" NUMBER 53 /end CHARACTERISTIC
/begin CHARACTERISTIC DINH_FId.DFC_ComBCM1RingCnt_CA "inhibitable FIds / FIds to be inhibited by inhibit source DFC_ComBCM1RingCnt" VAL_BLK 0x804DA7D8 ValA_Wu16 732.000000000 DINH_FIdVerb 0.00 732.000000000 FORMAT "%13.9" NUMBER 53 /end CHARACTERISTIC
/begin CHARACTERISTIC DINH_FId.DFC_ComBCM1TOut_CA "inhibitable FIds / FIds to be inhibited by inhibit source DFC_ComBCM1TOut" VAL_BLK 0x804DA842 ValA_Wu16 732.000000000 DINH_FIdVerb 0.00 732.000000000 FORMAT "%13.9" NUMBER 53 /end CHARACTERISTIC
/begin CHARACTERISTIC DINH_FId.DFC_ComCANABusOffErr_CA "inhibitable FIds / FIds to be inhibited by inhibit source DFC_ComCANABusOffErr" VAL_BLK 0x804DA8AC ValA_Wu16 732.000000000 DINH_FIdVerb 0.00 732.000000000 FORMAT "%13.9" NUMBER 206 /end CHARACTERISTIC
/begin CHARACTERISTIC DINH_FId.DFC_ComCANBBusOffErr_CA "inhibitable FIds / FIds to be inhibited by inhibit source DFC_ComCANBBusOffErr" VAL_BLK 0x804DAA48 ValA_Wu16 732.000000000 DINH_FIdVerb 0.00 732.000000000 FORMAT "%13.9" NUMBER 200 /end CHARACTERISTIC
/begin CHARACTERISTIC DINH_FId.DFC_ComCANCBusOffErr_CA "inhibitable FIds / FIds to be inhibited by inhibit source DFC_ComCANCBusOffErr" VAL_BLK 0x804DABD8 ValA_Wu16 732.000000000 DINH_FIdVerb 0.00 732.000000000 FORMAT "%13.9" NUMBER 200 /end CHARACTERISTIC
/begin CHARACTERISTIC DINH_FId.DFC_ComCGW1ChkSum_CA "inhibitable FIds / FIds to be inhibited by inhibit source DFC_ComCGW1ChkSum" VAL_BLK 0x804DAD68 ValA_Wu16 732.000000000 DINH_FIdVerb 0.00 732.000000000 FORMAT "%13.9" NUMBER 51 /end CHARACTERISTIC
/begin CHARACTERISTIC DINH_FId.DFC_ComCGW1RingCnt_CA "inhibitable FIds / FIds to be inhibited by inhibit source DFC_ComCGW1RingCnt" VAL_BLK 0x804DADCE ValA_Wu16 732.000000000 DINH_FIdVerb 0.00 732.000000000 FORMAT "%13.9" NUMBER 51 /end CHARACTERISTIC
/begin CHARACTERISTIC DINH_FId.DFC_ComCGW1TOut_CA "inhibitable FIds / FIds to be inhibited by inhibit source DFC_ComCGW1TOut" VAL_BLK 0x804DAE34 ValA_Wu16 732.000000000 DINH_FIdVerb 0.00 732.000000000 FORMAT "%13.9" NUMBER 51 /end CHARACTERISTIC
/begin CHARACTERISTIC DINH_FId.DFC_ComConvBoostErr_CA "inhibitable FIds / FIds to be inhibited by inhibit source DFC_ComConvBoostErr" VAL_BLK 0x804DAE9A ValA_Wu16 732.000000000 DINH_FIdVerb 0.00 732.000000000 FORMAT "%13.9" NUMBER 51 /end CHARACTERISTIC
/begin CHARACTERISTIC DINH_FId.DFC_ComConvSlipErr_CA "inhibitable FIds / FIds to be inhibited by inhibit source DFC_ComConvSlipErr" VAL_BLK 0x804DAF00 ValA_Wu16 732.000000000 DINH_FIdVerb 0.00 732.000000000 FORMAT "%13.9" NUMBER 51 /end CHARACTERISTIC
/begin CHARACTERISTIC DINH_FId.DFC_ComEAT10Chksum_CA "inhibitable FIds / FIds to be inhibited by inhibit source DFC_ComEAT10Chksum" VAL_BLK 0x804DAF66 ValA_Wu16 732.000000000 DINH_FIdVerb 0.00 732.000000000 FORMAT "%13.9" NUMBER 60 /end CHARACTERISTIC
/begin CHARACTERISTIC DINH_FId.DFC_ComEAT10RingCnt_CA "inhibitable FIds / FIds to be inhibited by inhibit source DFC_ComEAT10RingCnt" VAL_BLK 0x804DAFDE ValA_Wu16 732.000000000 DINH_FIdVerb 0.00 732.000000000 FORMAT "%13.9" NUMBER 60 /end CHARACTERISTIC
/begin CHARACTERISTIC DINH_FId.DFC_ComEAT10TOut_CA "inhibitable FIds / FIds to be inhibited by inhibit source DFC_ComEAT10TOut" VAL_BLK 0x804DB056 ValA_Wu16 732.000000000 DINH_FIdVerb 0.00 732.000000000 FORMAT "%13.9" NUMBER 60 /end CHARACTERISTIC
/begin CHARACTERISTIC DINH_FId.DFC_ComEAT11ChkSum_CA "inhibitable FIds / FIds to be inhibited by inhibit source DFC_ComEAT11ChkSum" VAL_BLK 0x804DB0CE ValA_Wu16 732.000000000 DINH_FIdVerb 0.00 732.000000000 FORMAT "%13.9" NUMBER 53 /end CHARACTERISTIC
/begin CHARACTERISTIC DINH_FId.DFC_ComEAT11RingCnt_CA "inhibitable FIds / FIds to be inhibited by inhibit source DFC_ComEAT11RingCnt" VAL_BLK 0x804DB138 ValA_Wu16 732.000000000 DINH_FIdVerb 0.00 732.000000000 FORMAT "%13.9" NUMBER 53 /end CHARACTERISTIC
/begin CHARACTERISTIC DINH_FId.DFC_ComEAT11TOut_CA "inhibitable FIds / FIds to be inhibited by inhibit source DFC_ComEAT11TOut" VAL_BLK 0x804DB1A2 ValA_Wu16 732.000000000 DINH_FIdVerb 0.00 732.000000000 FORMAT "%13.9" NUMBER 53 /end CHARACTERISTIC
/begin CHARACTERISTIC DINH_FId.DFC_ComEAT12ChkSum_CA "inhibitable FIds / FIds to be inhibited by inhibit source DFC_ComEAT12ChkSum" VAL_BLK 0x804DB20C ValA_Wu16 732.000000000 DINH_FIdVerb 0.00 732.000000000 FORMAT "%13.9" NUMBER 53 /end CHARACTERISTIC
/begin CHARACTERISTIC DINH_FId.DFC_ComEAT12RingCnt_CA "inhibitable FIds / FIds to be inhibited by inhibit source DFC_ComEAT12RingCnt" VAL_BLK 0x804DB276 ValA_Wu16 732.000000000 DINH_FIdVerb 0.00 732.000000000 FORMAT "%13.9" NUMBER 53 /end CHARACTERISTIC
/begin CHARACTERISTIC DINH_FId.DFC_ComEAT12TOut_CA "inhibitable FIds / FIds to be inhibited by inhibit source DFC_ComEAT12TOut" VAL_BLK 0x804DB2E0 ValA_Wu16 732.000000000 DINH_FIdVerb 0.00 732.000000000 FORMAT "%13.9" NUMBER 53 /end CHARACTERISTIC
/begin CHARACTERISTIC DINH_FId.DFC_ComEAT13ChkSum_CA "inhibitable FIds / FIds to be inhibited by inhibit source DFC_ComEAT13ChkSum" VAL_BLK 0x804DB34A ValA_Wu16 732.000000000 DINH_FIdVerb 0.00 732.000000000 FORMAT "%13.9" NUMBER 57 /end CHARACTERISTIC
/begin CHARACTERISTIC DINH_FId.DFC_ComEAT13RingCnt_CA "inhibitable FIds / FIds to be inhibited by inhibit source DFC_ComEAT13RingCnt" VAL_BLK 0x804DB3BC ValA_Wu16 732.000000000 DINH_FIdVerb 0.00 732.000000000 FORMAT "%13.9" NUMBER 57 /end CHARACTERISTIC
/begin CHARACTERISTIC DINH_FId.DFC_ComEAT13TOut_CA "inhibitable FIds / FIds to be inhibited by inhibit source DFC_ComEAT13TOut" VAL_BLK 0x804DB42E ValA_Wu16 732.000000000 DINH_FIdVerb 0.00 732.000000000 FORMAT "%13.9" NUMBER 57 /end CHARACTERISTIC
/begin CHARACTERISTIC DINH_FId.DFC_ComEAT1Chksum_CA "inhibitable FIds / FIds to be inhibited by inhibit source DFC_ComEAT1Chksum" VAL_BLK 0x804DB4A0 ValA_Wu16 732.000000000 DINH_FIdVerb 0.00 732.000000000 FORMAT "%13.9" NUMBER 57 /end CHARACTERISTIC
/begin CHARACTERISTIC DINH_FId.DFC_ComEAT1RingCnt_CA "inhibitable FIds / FIds to be inhibited by inhibit source DFC_ComEAT1RingCnt" VAL_BLK 0x804DB512 ValA_Wu16 732.000000000 DINH_FIdVerb 0.00 732.000000000 FORMAT "%13.9" NUMBER 57 /end CHARACTERISTIC
/begin CHARACTERISTIC DINH_FId.DFC_ComEAT1TOut_CA "inhibitable FIds / FIds to be inhibited by inhibit source DFC_ComEAT1TOut" VAL_BLK 0x804DB584 ValA_Wu16 732.000000000 DINH_FIdVerb 0.00 732.000000000 FORMAT "%13.9" NUMBER 57 /end CHARACTERISTIC
/begin CHARACTERISTIC DINH_FId.DFC_ComEAT2ChkSum_CA "inhibitable FIds / FIds to be inhibited by inhibit source DFC_ComEAT2ChkSum" VAL_BLK 0x804DB5F6 ValA_Wu16 732.000000000 DINH_FIdVerb 0.00 732.000000000 FORMAT "%13.9" NUMBER 58 /end CHARACTERISTIC
/begin CHARACTERISTIC DINH_FId.DFC_ComEAT2RingCnt_CA "inhibitable FIds / FIds to be inhibited by inhibit source DFC_ComEAT2RingCnt" VAL_BLK 0x804DB66A ValA_Wu16 732.000000000 DINH_FIdVerb 0.00 732.000000000 FORMAT "%13.9" NUMBER 58 /end CHARACTERISTIC
/begin CHARACTERISTIC DINH_FId.DFC_ComEAT2TOut_CA "inhibitable FIds / FIds to be inhibited by inhibit source DFC_ComEAT2TOut" VAL_BLK 0x804DB6DE ValA_Wu16 732.000000000 DINH_FIdVerb 0.00 732.000000000 FORMAT "%13.9" NUMBER 58 /end CHARACTERISTIC
/begin CHARACTERISTIC DINH_FId.DFC_ComEAT4ChkSum_CA "inhibitable FIds / FIds to be inhibited by inhibit source DFC_ComEAT4ChkSum" VAL_BLK 0x804DB752 ValA_Wu16 732.000000000 DINH_FIdVerb 0.00 732.000000000 FORMAT "%13.9" NUMBER 58 /end CHARACTERISTIC
/begin CHARACTERISTIC DINH_FId.DFC_ComEAT4RingCnt_CA "inhibitable FIds / FIds to be inhibited by inhibit source DFC_ComEAT4RingCnt" VAL_BLK 0x804DB7C6 ValA_Wu16 732.000000000 DINH_FIdVerb 0.00 732.000000000 FORMAT "%13.9" NUMBER 58 /end CHARACTERISTIC
/begin CHARACTERISTIC DINH_FId.DFC_ComEAT4TOut_CA "inhibitable FIds / FIds to be inhibited by inhibit source DFC_ComEAT4TOut" VAL_BLK 0x804DB83A ValA_Wu16 732.000000000 DINH_FIdVerb 0.00 732.000000000 FORMAT "%13.9" NUMBER 58 /end CHARACTERISTIC
/begin CHARACTERISTIC DINH_FId.DFC_ComEAT6Chksum_CA "inhibitable FIds / FIds to be inhibited by inhibit source DFC_ComEAT6Chksum" VAL_BLK 0x804DB8AE ValA_Wu16 732.000000000 DINH_FIdVerb 0.00 732.000000000 FORMAT "%13.9" NUMBER 59 /end CHARACTERISTIC
/begin CHARACTERISTIC DINH_FId.DFC_ComEAT6RingCnt_CA "inhibitable FIds / FIds to be inhibited by inhibit source DFC_ComEAT6RingCnt" VAL_BLK 0x804DB924 ValA_Wu16 732.000000000 DINH_FIdVerb 0.00 732.000000000 FORMAT "%13.9" NUMBER 59 /end CHARACTERISTIC
/begin CHARACTERISTIC DINH_FId.DFC_ComEAT6TOut_CA "inhibitable FIds / FIds to be inhibited by inhibit source DFC_ComEAT6TOut" VAL_BLK 0x804DB99A ValA_Wu16 732.000000000 DINH_FIdVerb 0.00 732.000000000 FORMAT "%13.9" NUMBER 59 /end CHARACTERISTIC
/begin CHARACTERISTIC DINH_FId.DFC_ComEAT7Chksum_CA "inhibitable FIds / FIds to be inhibited by inhibit source DFC_ComEAT7Chksum" VAL_BLK 0x804DBA10 ValA_Wu16 732.000000000 DINH_FIdVerb 0.00 732.000000000 FORMAT "%13.9" NUMBER 58 /end CHARACTERISTIC
/begin CHARACTERISTIC DINH_FId.DFC_ComEAT7RingCnt_CA "inhibitable FIds / FIds to be inhibited by inhibit source DFC_ComEAT7RingCnt" VAL_BLK 0x804DBA84 ValA_Wu16 732.000000000 DINH_FIdVerb 0.00 732.000000000 FORMAT "%13.9" NUMBER 58 /end CHARACTERISTIC
/begin CHARACTERISTIC DINH_FId.DFC_ComEAT7TOut_CA "inhibitable FIds / FIds to be inhibited by inhibit source DFC_ComEAT7TOut" VAL_BLK 0x804DBAF8 ValA_Wu16 732.000000000 DINH_FIdVerb 0.00 732.000000000 FORMAT "%13.9" NUMBER 58 /end CHARACTERISTIC
/begin CHARACTERISTIC DINH_FId.DFC_ComEAT8Chksum_CA "inhibitable FIds / FIds to be inhibited by inhibit source DFC_ComEAT8Chksum" VAL_BLK 0x804DBB6C ValA_Wu16 732.000000000 DINH_FIdVerb 0.00 732.000000000 FORMAT "%13.9" NUMBER 59 /end CHARACTERISTIC
/begin CHARACTERISTIC DINH_FId.DFC_ComEAT8RingCnt_CA "inhibitable FIds / FIds to be inhibited by inhibit source DFC_ComEAT8RingCnt" VAL_BLK 0x804DBBE2 ValA_Wu16 732.000000000 DINH_FIdVerb 0.00 732.000000000 FORMAT "%13.9" NUMBER 59 /end CHARACTERISTIC
/begin CHARACTERISTIC DINH_FId.DFC_ComEAT8TOut_CA "inhibitable FIds / FIds to be inhibited by inhibit source DFC_ComEAT8TOut" VAL_BLK 0x804DBC58 ValA_Wu16 732.000000000 DINH_FIdVerb 0.00 732.000000000 FORMAT "%13.9" NUMBER 59 /end CHARACTERISTIC
/begin CHARACTERISTIC DINH_FId.DFC_ComEATAChksum_CA "inhibitable FIds / FIds to be inhibited by inhibit source DFC_ComEATAChksum" VAL_BLK 0x804DBCCE ValA_Wu16 732.000000000 DINH_FIdVerb 0.00 732.000000000 FORMAT "%13.9" NUMBER 59 /end CHARACTERISTIC
/begin CHARACTERISTIC DINH_FId.DFC_ComEATARingCnt_CA "inhibitable FIds / FIds to be inhibited by inhibit source DFC_ComEATARingCnt" VAL_BLK 0x804DBD44 ValA_Wu16 732.000000000 DINH_FIdVerb 0.00 732.000000000 FORMAT "%13.9" NUMBER 59 /end CHARACTERISTIC
/begin CHARACTERISTIC DINH_FId.DFC_ComEATATOut_CA "inhibitable FIds / FIds to be inhibited by inhibit source DFC_ComEATATOut" VAL_BLK 0x804DBDBA ValA_Wu16 732.000000000 DINH_FIdVerb 0.00 732.000000000 FORMAT "%13.9" NUMBER 59 /end CHARACTERISTIC
/begin CHARACTERISTIC DINH_FId.DFC_ComEATBChkSum_CA "inhibitable FIds / FIds to be inhibited by inhibit source DFC_ComEATBChkSum" VAL_BLK 0x804DBE30 ValA_Wu16 732.000000000 DINH_FIdVerb 0.00 732.000000000 FORMAT "%13.9" NUMBER 65 /end CHARACTERISTIC
/begin CHARACTERISTIC DINH_FId.DFC_ComEATBRingCnt_CA "inhibitable FIds / FIds to be inhibited by inhibit source DFC_ComEATBRingCnt" VAL_BLK 0x804DBEB2 ValA_Wu16 732.000000000 DINH_FIdVerb 0.00 732.000000000 FORMAT "%13.9" NUMBER 65 /end CHARACTERISTIC
/begin CHARACTERISTIC DINH_FId.DFC_ComEATBTOut_CA "inhibitable FIds / FIds to be inhibited by inhibit source DFC_ComEATBTOut" VAL_BLK 0x804DBF34 ValA_Wu16 732.000000000 DINH_FIdVerb 0.00 732.000000000 FORMAT "%13.9" NUMBER 65 /end CHARACTERISTIC
/begin CHARACTERISTIC DINH_FId.DFC_ComEATCChksum_CA "inhibitable FIds / FIds to be inhibited by inhibit source DFC_ComEATCChksum" VAL_BLK 0x804DBFB6 ValA_Wu16 732.000000000 DINH_FIdVerb 0.00 732.000000000 FORMAT "%13.9" NUMBER 4 /end CHARACTERISTIC
/begin CHARACTERISTIC DINH_FId.DFC_ComEATCRingCnt_CA "inhibitable FIds / FIds to be inhibited by inhibit source DFC_ComEATCRingCnt" VAL_BLK 0x804DBFBE ValA_Wu16 732.000000000 DINH_FIdVerb 0.00 732.000000000 FORMAT "%13.9" NUMBER 4 /end CHARACTERISTIC
/begin CHARACTERISTIC DINH_FId.DFC_ComEATCTOut_CA "inhibitable FIds / FIds to be inhibited by inhibit source DFC_ComEATCTOut" VAL_BLK 0x804DBFC6 ValA_Wu16 732.000000000 DINH_FIdVerb 0.00 732.000000000 FORMAT "%13.9" NUMBER 4 /end CHARACTERISTIC
/begin CHARACTERISTIC DINH_FId.DFC_ComEBBAChksum_CA "inhibitable FIds / FIds to be inhibited by inhibit source DFC_ComEBBAChksum" VAL_BLK 0x804DBFCE ValA_Wu16 732.000000000 DINH_FIdVerb 0.00 732.000000000 FORMAT "%13.9" NUMBER 55 /end CHARACTERISTIC
/begin CHARACTERISTIC DINH_FId.DFC_ComEBBARingCnt_CA "inhibitable FIds / FIds to be inhibited by inhibit source DFC_ComEBBARingCnt" VAL_BLK 0x804DC03C ValA_Wu16 732.000000000 DINH_FIdVerb 0.00 732.000000000 FORMAT "%13.9" NUMBER 55 /end CHARACTERISTIC
/begin CHARACTERISTIC DINH_FId.DFC_ComEBBATOut_CA "inhibitable FIds / FIds to be inhibited by inhibit source DFC_ComEBBATOut" VAL_BLK 0x804DC0AA ValA_Wu16 732.000000000 DINH_FIdVerb 0.00 732.000000000 FORMAT "%13.9" NUMBER 55 /end CHARACTERISTIC
/begin CHARACTERISTIC DINH_FId.DFC_ComEPS1Chksum_CA "inhibitable FIds / FIds to be inhibited by inhibit source DFC_ComEPS1Chksum" VAL_BLK 0x804DC118 ValA_Wu16 732.000000000 DINH_FIdVerb 0.00 732.000000000 FORMAT "%13.9" NUMBER 57 /end CHARACTERISTIC
/begin CHARACTERISTIC DINH_FId.DFC_ComEPS1RingCnt_CA "inhibitable FIds / FIds to be inhibited by inhibit source DFC_ComEPS1RingCnt" VAL_BLK 0x804DC18A ValA_Wu16 732.000000000 DINH_FIdVerb 0.00 732.000000000 FORMAT "%13.9" NUMBER 57 /end CHARACTERISTIC
/begin CHARACTERISTIC DINH_FId.DFC_ComEPS1TOut_CA "inhibitable FIds / FIds to be inhibited by inhibit source DFC_ComEPS1TOut" VAL_BLK 0x804DC1FC ValA_Wu16 732.000000000 DINH_FIdVerb 0.00 732.000000000 FORMAT "%13.9" NUMBER 57 /end CHARACTERISTIC
/begin CHARACTERISTIC DINH_FId.DFC_ComEngCanRxErr_CA "inhibitable FIds / FIds to be inhibited by inhibit source DFC_ComEngCanRxErr" VAL_BLK 0x804DC26E ValA_Wu16 732.000000000 DINH_FIdVerb 0.00 732.000000000 FORMAT "%13.9" NUMBER 53 /end CHARACTERISTIC
/begin CHARACTERISTIC DINH_FId.DFC_ComGrvySnsrErr_CA "inhibitable FIds / FIds to be inhibited by inhibit source DFC_ComGrvySnsrErr" VAL_BLK 0x804DC2D8 ValA_Wu16 732.000000000 DINH_FIdVerb 0.00 732.000000000 FORMAT "%13.9" NUMBER 50 /end CHARACTERISTIC
/begin CHARACTERISTIC DINH_FId.DFC_ComGwIMG1ChkSum_CA "inhibitable FIds / FIds to be inhibited by inhibit source DFC_ComGwIMG1ChkSum" VAL_BLK 0x804DC33C ValA_Wu16 732.000000000 DINH_FIdVerb 0.00 732.000000000 FORMAT "%13.9" NUMBER 56 /end CHARACTERISTIC
/begin CHARACTERISTIC DINH_FId.DFC_ComGwIMG1RingCnt_CA "inhibitable FIds / FIds to be inhibited by inhibit source DFC_ComGwIMG1RingCnt" VAL_BLK 0x804DC3AC ValA_Wu16 732.000000000 DINH_FIdVerb 0.00 732.000000000 FORMAT "%13.9" NUMBER 56 /end CHARACTERISTIC
/begin CHARACTERISTIC DINH_FId.DFC_ComGwIMG1TOut_CA "inhibitable FIds / FIds to be inhibited by inhibit source DFC_ComGwIMG1TOut" VAL_BLK 0x804DC41C ValA_Wu16 732.000000000 DINH_FIdVerb 0.00 732.000000000 FORMAT "%13.9" NUMBER 56 /end CHARACTERISTIC
/begin CHARACTERISTIC DINH_FId.DFC_ComGwIMG3ChkSum_CA "inhibitable FIds / FIds to be inhibited by inhibit source DFC_ComGwIMG3ChkSum" VAL_BLK 0x804DC48C ValA_Wu16 732.000000000 DINH_FIdVerb 0.00 732.000000000 FORMAT "%13.9" NUMBER 57 /end CHARACTERISTIC
/begin CHARACTERISTIC DINH_FId.DFC_ComGwIMG3RingCnt_CA "inhibitable FIds / FIds to be inhibited by inhibit source DFC_ComGwIMG3RingCnt" VAL_BLK 0x804DC4FE ValA_Wu16 732.000000000 DINH_FIdVerb 0.00 732.000000000 FORMAT "%13.9" NUMBER 57 /end CHARACTERISTIC
/begin CHARACTERISTIC DINH_FId.DFC_ComGwIMG3TOut_CA "inhibitable FIds / FIds to be inhibited by inhibit source DFC_ComGwIMG3TOut" VAL_BLK 0x804DC570 ValA_Wu16 732.000000000 DINH_FIdVerb 0.00 732.000000000 FORMAT "%13.9" NUMBER 57 /end CHARACTERISTIC
/begin CHARACTERISTIC DINH_FId.DFC_ComGwIMG4ChkSum_CA "inhibitable FIds / FIds to be inhibited by inhibit source DFC_ComGwIMG4ChkSum" VAL_BLK 0x804DC5E2 ValA_Wu16 732.000000000 DINH_FIdVerb 0.00 732.000000000 FORMAT "%13.9" NUMBER 56 /end CHARACTERISTIC
/begin CHARACTERISTIC DINH_FId.DFC_ComGwIMG4RingCnt_CA "inhibitable FIds / FIds to be inhibited by inhibit source DFC_ComGwIMG4RingCnt" VAL_BLK 0x804DC652 ValA_Wu16 732.000000000 DINH_FIdVerb 0.00 732.000000000 FORMAT "%13.9" NUMBER 56 /end CHARACTERISTIC
/begin CHARACTERISTIC DINH_FId.DFC_ComGwIMG4TOut_CA "inhibitable FIds / FIds to be inhibited by inhibit source DFC_ComGwIMG4TOut" VAL_BLK 0x804DC6C2 ValA_Wu16 732.000000000 DINH_FIdVerb 0.00 732.000000000 FORMAT "%13.9" NUMBER 56 /end CHARACTERISTIC
/begin CHARACTERISTIC DINH_FId.DFC_ComGwIMG5ChkSum_CA "inhibitable FIds / FIds to be inhibited by inhibit source DFC_ComGwIMG5ChkSum" VAL_BLK 0x804DC732 ValA_Wu16 732.000000000 DINH_FIdVerb 0.00 732.000000000 FORMAT "%13.9" NUMBER 55 /end CHARACTERISTIC
/begin CHARACTERISTIC DINH_FId.DFC_ComGwIMG5RingCnt_CA "inhibitable FIds / FIds to be inhibited by inhibit source DFC_ComGwIMG5RingCnt" VAL_BLK 0x804DC7A0 ValA_Wu16 732.000000000 DINH_FIdVerb 0.00 732.000000000 FORMAT "%13.9" NUMBER 55 /end CHARACTERISTIC
/begin CHARACTERISTIC DINH_FId.DFC_ComGwIMG5TOut_CA "inhibitable FIds / FIds to be inhibited by inhibit source DFC_ComGwIMG5TOut" VAL_BLK 0x804DC80E ValA_Wu16 732.000000000 DINH_FIdVerb 0.00 732.000000000 FORMAT "%13.9" NUMBER 55 /end CHARACTERISTIC
/begin CHARACTERISTIC DINH_FId.DFC_ComGwIMG6ChkSum_CA "inhibitable FIds / FIds to be inhibited by inhibit source DFC_ComGwIMG6ChkSum" VAL_BLK 0x804DC87C ValA_Wu16 732.000000000 DINH_FIdVerb 0.00 732.000000000 FORMAT "%13.9" NUMBER 4 /end CHARACTERISTIC
/begin CHARACTERISTIC DINH_FId.DFC_ComGwIMG6RingCnt_CA "inhibitable FIds / FIds to be inhibited by inhibit source DFC_ComGwIMG6RingCnt" VAL_BLK 0x804DC884 ValA_Wu16 732.000000000 DINH_FIdVerb 0.00 732.000000000 FORMAT "%13.9" NUMBER 4 /end CHARACTERISTIC
/begin CHARACTERISTIC DINH_FId.DFC_ComGwIMG6TOut_CA "inhibitable FIds / FIds to be inhibited by inhibit source DFC_ComGwIMG6TOut" VAL_BLK 0x804DC88C ValA_Wu16 732.000000000 DINH_FIdVerb 0.00 732.000000000 FORMAT "%13.9" NUMBER 4 /end CHARACTERISTIC
/begin CHARACTERISTIC DINH_FId.DFC_ComIDASBChksum_CA "inhibitable FIds / FIds to be inhibited by inhibit source DFC_ComIDASBChksum" VAL_BLK 0x804DC894 ValA_Wu16 732.000000000 DINH_FIdVerb 0.00 732.000000000 FORMAT "%13.9" NUMBER 52 /end CHARACTERISTIC
/begin CHARACTERISTIC DINH_FId.DFC_ComIDASBRingCnt_CA "inhibitable FIds / FIds to be inhibited by inhibit source DFC_ComIDASBRingCnt" VAL_BLK 0x804DC8FC ValA_Wu16 732.000000000 DINH_FIdVerb 0.00 732.000000000 FORMAT "%13.9" NUMBER 52 /end CHARACTERISTIC
/begin CHARACTERISTIC DINH_FId.DFC_ComIDASBTOut_CA "inhibitable FIds / FIds to be inhibited by inhibit source DFC_ComIDASBTOut" VAL_BLK 0x804DC964 ValA_Wu16 732.000000000 DINH_FIdVerb 0.00 732.000000000 FORMAT "%13.9" NUMBER 52 /end CHARACTERISTIC
/begin CHARACTERISTIC DINH_FId.DFC_ComIMGMILReq_CA "inhibitable FIds / FIds to be inhibited by inhibit source DFC_ComIMGMILReq" VAL_BLK 0x804DC9CC ValA_Wu16 732.000000000 DINH_FIdVerb 0.00 732.000000000 FORMAT "%13.9" NUMBER 2 /end CHARACTERISTIC
/begin CHARACTERISTIC DINH_FId.DFC_ComISSPrms_CA "inhibitable FIds / FIds to be inhibited by inhibit source DFC_ComISSPrms" VAL_BLK 0x804DC9D0 ValA_Wu16 732.000000000 DINH_FIdVerb 0.00 732.000000000 FORMAT "%13.9" NUMBER 51 /end CHARACTERISTIC
/begin CHARACTERISTIC DINH_FId.DFC_ComMETAChksum_CA "inhibitable FIds / FIds to be inhibited by inhibit source DFC_ComMETAChksum" VAL_BLK 0x804DCA36 ValA_Wu16 732.000000000 DINH_FIdVerb 0.00 732.000000000 FORMAT "%13.9" NUMBER 59 /end CHARACTERISTIC
/begin CHARACTERISTIC DINH_FId.DFC_ComMETARingCnt_CA "inhibitable FIds / FIds to be inhibited by inhibit source DFC_ComMETARingCnt" VAL_BLK 0x804DCAAC ValA_Wu16 732.000000000 DINH_FIdVerb 0.00 732.000000000 FORMAT "%13.9" NUMBER 59 /end CHARACTERISTIC
/begin CHARACTERISTIC DINH_FId.DFC_ComMETATOut_CA "inhibitable FIds / FIds to be inhibited by inhibit source DFC_ComMETATOut" VAL_BLK 0x804DCB22 ValA_Wu16 732.000000000 DINH_FIdVerb 0.00 732.000000000 FORMAT "%13.9" NUMBER 59 /end CHARACTERISTIC
/begin CHARACTERISTIC DINH_FId.DFC_ComMETCChksum_CA "inhibitable FIds / FIds to be inhibited by inhibit source DFC_ComMETCChksum" VAL_BLK 0x804DCB98 ValA_Wu16 732.000000000 DINH_FIdVerb 0.00 732.000000000 FORMAT "%13.9" NUMBER 61 /end CHARACTERISTIC
/begin CHARACTERISTIC DINH_FId.DFC_ComMETCRingCnt_CA "inhibitable FIds / FIds to be inhibited by inhibit source DFC_ComMETCRingCnt" VAL_BLK 0x804DCC12 ValA_Wu16 732.000000000 DINH_FIdVerb 0.00 732.000000000 FORMAT "%13.9" NUMBER 61 /end CHARACTERISTIC
/begin CHARACTERISTIC DINH_FId.DFC_ComMETCTOut_CA "inhibitable FIds / FIds to be inhibited by inhibit source DFC_ComMETCTOut" VAL_BLK 0x804DCC8C ValA_Wu16 732.000000000 DINH_FIdVerb 0.00 732.000000000 FORMAT "%13.9" NUMBER 61 /end CHARACTERISTIC
/begin CHARACTERISTIC DINH_FId.DFC_ComMETDChksum_CA "inhibitable FIds / FIds to be inhibited by inhibit source DFC_ComMETDChksum" VAL_BLK 0x804DCD06 ValA_Wu16 732.000000000 DINH_FIdVerb 0.00 732.000000000 FORMAT "%13.9" NUMBER 60 /end CHARACTERISTIC
/begin CHARACTERISTIC DINH_FId.DFC_ComMETDRingCnt_CA "inhibitable FIds / FIds to be inhibited by inhibit source DFC_ComMETDRingCnt" VAL_BLK 0x804DCD7E ValA_Wu16 732.000000000 DINH_FIdVerb 0.00 732.000000000 FORMAT "%13.9" NUMBER 60 /end CHARACTERISTIC
/begin CHARACTERISTIC DINH_FId.DFC_ComMETDTOut_CA "inhibitable FIds / FIds to be inhibited by inhibit source DFC_ComMETDTOut" VAL_BLK 0x804DCDF6 ValA_Wu16 732.000000000 DINH_FIdVerb 0.00 732.000000000 FORMAT "%13.9" NUMBER 60 /end CHARACTERISTIC
/begin CHARACTERISTIC DINH_FId.DFC_ComMETE2Chksum_CA "inhibitable FIds / FIds to be inhibited by inhibit source DFC_ComMETE2Chksum" VAL_BLK 0x804DCE6E ValA_Wu16 732.000000000 DINH_FIdVerb 0.00 732.000000000 FORMAT "%13.9" NUMBER 59 /end CHARACTERISTIC
/begin CHARACTERISTIC DINH_FId.DFC_ComMETE2RingCnt_CA "inhibitable FIds / FIds to be inhibited by inhibit source DFC_ComMETE2RingCnt" VAL_BLK 0x804DCEE4 ValA_Wu16 732.000000000 DINH_FIdVerb 0.00 732.000000000 FORMAT "%13.9" NUMBER 59 /end CHARACTERISTIC
/begin CHARACTERISTIC DINH_FId.DFC_ComMETE2TOut_CA "inhibitable FIds / FIds to be inhibited by inhibit source DFC_ComMETE2TOut" VAL_BLK 0x804DCF5A ValA_Wu16 732.000000000 DINH_FIdVerb 0.00 732.000000000 FORMAT "%13.9" NUMBER 59 /end CHARACTERISTIC
/begin CHARACTERISTIC DINH_FId.DFC_ComMETFChksum_CA "inhibitable FIds / FIds to be inhibited by inhibit source DFC_ComMETFChksum" VAL_BLK 0x804DCFD0 ValA_Wu16 732.000000000 DINH_FIdVerb 0.00 732.000000000 FORMAT "%13.9" NUMBER 59 /end CHARACTERISTIC
/begin CHARACTERISTIC DINH_FId.DFC_ComMETFRingCnt_CA "inhibitable FIds / FIds to be inhibited by inhibit source DFC_ComMETFRingCnt" VAL_BLK 0x804DD046 ValA_Wu16 732.000000000 DINH_FIdVerb 0.00 732.000000000 FORMAT "%13.9" NUMBER 59 /end CHARACTERISTIC
/begin CHARACTERISTIC DINH_FId.DFC_ComMETFTOut_CA "inhibitable FIds / FIds to be inhibited by inhibit source DFC_ComMETFTOut" VAL_BLK 0x804DD0BC ValA_Wu16 732.000000000 DINH_FIdVerb 0.00 732.000000000 FORMAT "%13.9" NUMBER 59 /end CHARACTERISTIC
/begin CHARACTERISTIC DINH_FId.DFC_ComMETGChksum_CA "inhibitable FIds / FIds to be inhibited by inhibit source DFC_ComMETGChksum" VAL_BLK 0x804DD132 ValA_Wu16 732.000000000 DINH_FIdVerb 0.00 732.000000000 FORMAT "%13.9" NUMBER 59 /end CHARACTERISTIC
/begin CHARACTERISTIC DINH_FId.DFC_ComMETGRingCnt_CA "inhibitable FIds / FIds to be inhibited by inhibit source DFC_ComMETGRingCnt" VAL_BLK 0x804DD1A8 ValA_Wu16 732.000000000 DINH_FIdVerb 0.00 732.000000000 FORMAT "%13.9" NUMBER 59 /end CHARACTERISTIC
/begin CHARACTERISTIC DINH_FId.DFC_ComMETGTOut_CA "inhibitable FIds / FIds to be inhibited by inhibit source DFC_ComMETGTOut" VAL_BLK 0x804DD21E ValA_Wu16 732.000000000 DINH_FIdVerb 0.00 732.000000000 FORMAT "%13.9" NUMBER 59 /end CHARACTERISTIC
/begin CHARACTERISTIC DINH_FId.DFC_ComMETH2Chksum_CA "inhibitable FIds / FIds to be inhibited by inhibit source DFC_ComMETH2Chksum" VAL_BLK 0x804DD294 ValA_Wu16 732.000000000 DINH_FIdVerb 0.00 732.000000000 FORMAT "%13.9" NUMBER 59 /end CHARACTERISTIC
/begin CHARACTERISTIC DINH_FId.DFC_ComMETH2RingCnt_CA "inhibitable FIds / FIds to be inhibited by inhibit source DFC_ComMETH2RingCnt" VAL_BLK 0x804DD30A ValA_Wu16 732.000000000 DINH_FIdVerb 0.00 732.000000000 FORMAT "%13.9" NUMBER 59 /end CHARACTERISTIC
/begin CHARACTERISTIC DINH_FId.DFC_ComMETH2TOut_CA "inhibitable FIds / FIds to be inhibited by inhibit source DFC_ComMETH2TOut" VAL_BLK 0x804DD380 ValA_Wu16 732.000000000 DINH_FIdVerb 0.00 732.000000000 FORMAT "%13.9" NUMBER 59 /end CHARACTERISTIC
/begin CHARACTERISTIC DINH_FId.DFC_ComMETHChksum_CA "inhibitable FIds / FIds to be inhibited by inhibit source DFC_ComMETHChksum" VAL_BLK 0x804DD3F6 ValA_Wu16 732.000000000 DINH_FIdVerb 0.00 732.000000000 FORMAT "%13.9" NUMBER 59 /end CHARACTERISTIC
/begin CHARACTERISTIC DINH_FId.DFC_ComMETHRingCnt_CA "inhibitable FIds / FIds to be inhibited by inhibit source DFC_ComMETHRingCnt" VAL_BLK 0x804DD46C ValA_Wu16 732.000000000 DINH_FIdVerb 0.00 732.000000000 FORMAT "%13.9" NUMBER 59 /end CHARACTERISTIC
/begin CHARACTERISTIC DINH_FId.DFC_ComMETHTOut_CA "inhibitable FIds / FIds to be inhibited by inhibit source DFC_ComMETHTOut" VAL_BLK 0x804DD4E2 ValA_Wu16 732.000000000 DINH_FIdVerb 0.00 732.000000000 FORMAT "%13.9" NUMBER 59 /end CHARACTERISTIC
/begin CHARACTERISTIC DINH_FId.DFC_ComMETIChksum_CA "inhibitable FIds / FIds to be inhibited by inhibit source DFC_ComMETIChksum" VAL_BLK 0x804DD558 ValA_Wu16 732.000000000 DINH_FIdVerb 0.00 732.000000000 FORMAT "%13.9" NUMBER 66 /end CHARACTERISTIC
/begin CHARACTERISTIC DINH_FId.DFC_ComMETIRingCnt_CA "inhibitable FIds / FIds to be inhibited by inhibit source DFC_ComMETIRingCnt" VAL_BLK 0x804DD5DC ValA_Wu16 732.000000000 DINH_FIdVerb 0.00 732.000000000 FORMAT "%13.9" NUMBER 66 /end CHARACTERISTIC
/begin CHARACTERISTIC DINH_FId.DFC_ComMETITOut_CA "inhibitable FIds / FIds to be inhibited by inhibit source DFC_ComMETITOut" VAL_BLK 0x804DD660 ValA_Wu16 732.000000000 DINH_FIdVerb 0.00 732.000000000 FORMAT "%13.9" NUMBER 66 /end CHARACTERISTIC
/begin CHARACTERISTIC DINH_FId.DFC_ComMETKChksum_CA "inhibitable FIds / FIds to be inhibited by inhibit source DFC_ComMETKChksum" VAL_BLK 0x804DD6E4 ValA_Wu16 732.000000000 DINH_FIdVerb 0.00 732.000000000 FORMAT "%13.9" NUMBER 60 /end CHARACTERISTIC
/begin CHARACTERISTIC DINH_FId.DFC_ComMETKRingCnt_CA "inhibitable FIds / FIds to be inhibited by inhibit source DFC_ComMETKRingCnt" VAL_BLK 0x804DD75C ValA_Wu16 732.000000000 DINH_FIdVerb 0.00 732.000000000 FORMAT "%13.9" NUMBER 60 /end CHARACTERISTIC
/begin CHARACTERISTIC DINH_FId.DFC_ComMETKTOut_CA "inhibitable FIds / FIds to be inhibited by inhibit source DFC_ComMETKTOut" VAL_BLK 0x804DD7D4 ValA_Wu16 732.000000000 DINH_FIdVerb 0.00 732.000000000 FORMAT "%13.9" NUMBER 60 /end CHARACTERISTIC
/begin CHARACTERISTIC DINH_FId.DFC_ComMETLChksum_CA "inhibitable FIds / FIds to be inhibited by inhibit source DFC_ComMETLChksum" VAL_BLK 0x804DD84C ValA_Wu16 732.000000000 DINH_FIdVerb 0.00 732.000000000 FORMAT "%13.9" NUMBER 59 /end CHARACTERISTIC
/begin CHARACTERISTIC DINH_FId.DFC_ComMETLRingCnt_CA "inhibitable FIds / FIds to be inhibited by inhibit source DFC_ComMETLRingCnt" VAL_BLK 0x804DD8C2 ValA_Wu16 732.000000000 DINH_FIdVerb 0.00 732.000000000 FORMAT "%13.9" NUMBER 59 /end CHARACTERISTIC
/begin CHARACTERISTIC DINH_FId.DFC_ComMETLTOut_CA "inhibitable FIds / FIds to be inhibited by inhibit source DFC_ComMETLTOut" VAL_BLK 0x804DD938 ValA_Wu16 732.000000000 DINH_FIdVerb 0.00 732.000000000 FORMAT "%13.9" NUMBER 59 /end CHARACTERISTIC
/begin CHARACTERISTIC DINH_FId.DFC_ComMETMChksum_CA "inhibitable FIds / FIds to be inhibited by inhibit source DFC_ComMETMChksum" VAL_BLK 0x804DD9AE ValA_Wu16 732.000000000 DINH_FIdVerb 0.00 732.000000000 FORMAT "%13.9" NUMBER 58 /end CHARACTERISTIC
/begin CHARACTERISTIC DINH_FId.DFC_ComMETMRingCnt_CA "inhibitable FIds / FIds to be inhibited by inhibit source DFC_ComMETMRingCnt" VAL_BLK 0x804DDA22 ValA_Wu16 732.000000000 DINH_FIdVerb 0.00 732.000000000 FORMAT "%13.9" NUMBER 58 /end CHARACTERISTIC
/begin CHARACTERISTIC DINH_FId.DFC_ComMETMTOut_CA "inhibitable FIds / FIds to be inhibited by inhibit source DFC_ComMETMTOut" VAL_BLK 0x804DDA96 ValA_Wu16 732.000000000 DINH_FIdVerb 0.00 732.000000000 FORMAT "%13.9" NUMBER 58 /end CHARACTERISTIC
/begin CHARACTERISTIC DINH_FId.DFC_ComMETNChksum_CA "inhibitable FIds / FIds to be inhibited by inhibit source DFC_ComMETNChksum" VAL_BLK 0x804DDB0A ValA_Wu16 732.000000000 DINH_FIdVerb 0.00 732.000000000 FORMAT "%13.9" NUMBER 59 /end CHARACTERISTIC
/begin CHARACTERISTIC DINH_FId.DFC_ComMETNRingCnt_CA "inhibitable FIds / FIds to be inhibited by inhibit source DFC_ComMETNRingCnt" VAL_BLK 0x804DDB80 ValA_Wu16 732.000000000 DINH_FIdVerb 0.00 732.000000000 FORMAT "%13.9" NUMBER 59 /end CHARACTERISTIC
/begin CHARACTERISTIC DINH_FId.DFC_ComMETNTOut_CA "inhibitable FIds / FIds to be inhibited by inhibit source DFC_ComMETNTOut" VAL_BLK 0x804DDBF6 ValA_Wu16 732.000000000 DINH_FIdVerb 0.00 732.000000000 FORMAT "%13.9" NUMBER 59 /end CHARACTERISTIC
/begin CHARACTERISTIC DINH_FId.DFC_ComMtrCom_CA "inhibitable FIds / FIds to be inhibited by inhibit source DFC_ComMtrCom" VAL_BLK 0x804DDC6C ValA_Wu16 732.000000000 DINH_FIdVerb 0.00 732.000000000 FORMAT "%13.9" NUMBER 51 /end CHARACTERISTIC
/begin CHARACTERISTIC DINH_FId.DFC_ComPCUChkSum_CA "inhibitable FIds / FIds to be inhibited by inhibit source DFC_ComPCUChkSum" VAL_BLK 0x804DDCD2 ValA_Wu16 732.000000000 DINH_FIdVerb 0.00 732.000000000 FORMAT "%13.9" NUMBER 56 /end CHARACTERISTIC
/begin CHARACTERISTIC DINH_FId.DFC_ComPCURingCnt_CA "inhibitable FIds / FIds to be inhibited by inhibit source DFC_ComPCURingCnt" VAL_BLK 0x804DDD42 ValA_Wu16 732.000000000 DINH_FIdVerb 0.00 732.000000000 FORMAT "%13.9" NUMBER 56 /end CHARACTERISTIC
/begin CHARACTERISTIC DINH_FId.DFC_ComPCUTOut_CA "inhibitable FIds / FIds to be inhibited by inhibit source DFC_ComPCUTOut" VAL_BLK 0x804DDDB2 ValA_Wu16 732.000000000 DINH_FIdVerb 0.00 732.000000000 FORMAT "%13.9" NUMBER 56 /end CHARACTERISTIC
/begin CHARACTERISTIC DINH_FId.DFC_ComSRSAChksum_CA "inhibitable FIds / FIds to be inhibited by inhibit source DFC_ComSRSAChksum" VAL_BLK 0x804DDE22 ValA_Wu16 732.000000000 DINH_FIdVerb 0.00 732.000000000 FORMAT "%13.9" NUMBER 56 /end CHARACTERISTIC
/begin CHARACTERISTIC DINH_FId.DFC_ComSRSARingCnt_CA "inhibitable FIds / FIds to be inhibited by inhibit source DFC_ComSRSARingCnt" VAL_BLK 0x804DDE92 ValA_Wu16 732.000000000 DINH_FIdVerb 0.00 732.000000000 FORMAT "%13.9" NUMBER 56 /end CHARACTERISTIC
/begin CHARACTERISTIC DINH_FId.DFC_ComSRSATOut_CA "inhibitable FIds / FIds to be inhibited by inhibit source DFC_ComSRSATOut" VAL_BLK 0x804DDF02 ValA_Wu16 732.000000000 DINH_FIdVerb 0.00 732.000000000 FORMAT "%13.9" NUMBER 56 /end CHARACTERISTIC
/begin CHARACTERISTIC DINH_FId.DFC_ComSRSBChksum_CA "inhibitable FIds / FIds to be inhibited by inhibit source DFC_ComSRSBChksum" VAL_BLK 0x804DDF72 ValA_Wu16 732.000000000 DINH_FIdVerb 0.00 732.000000000 FORMAT "%13.9" NUMBER 55 /end CHARACTERISTIC
/begin CHARACTERISTIC DINH_FId.DFC_ComSRSBRingCnt_CA "inhibitable FIds / FIds to be inhibited by inhibit source DFC_ComSRSBRingCnt" VAL_BLK 0x804DDFE0 ValA_Wu16 732.000000000 DINH_FIdVerb 0.00 732.000000000 FORMAT "%13.9" NUMBER 55 /end CHARACTERISTIC
/begin CHARACTERISTIC DINH_FId.DFC_ComSRSBTOut_CA "inhibitable FIds / FIds to be inhibited by inhibit source DFC_ComSRSBTOut" VAL_BLK 0x804DE04E ValA_Wu16 732.000000000 DINH_FIdVerb 0.00 732.000000000 FORMAT "%13.9" NUMBER 55 /end CHARACTERISTIC
/begin CHARACTERISTIC DINH_FId.DFC_ComSRSChksum_CA "inhibitable FIds / FIds to be inhibited by inhibit source DFC_ComSRSChksum" VAL_BLK 0x804DE0BC ValA_Wu16 732.000000000 DINH_FIdVerb 0.00 732.000000000 FORMAT "%13.9" NUMBER 55 /end CHARACTERISTIC
/begin CHARACTERISTIC DINH_FId.DFC_ComSRSErr_CA "inhibitable FIds / FIds to be inhibited by inhibit source DFC_ComSRSErr" VAL_BLK 0x804DE12A ValA_Wu16 732.000000000 DINH_FIdVerb 0.00 732.000000000 FORMAT "%13.9" NUMBER 50 /end CHARACTERISTIC
/begin CHARACTERISTIC DINH_FId.DFC_ComSRSRingCnt_CA "inhibitable FIds / FIds to be inhibited by inhibit source DFC_ComSRSRingCnt" VAL_BLK 0x804DE18E ValA_Wu16 732.000000000 DINH_FIdVerb 0.00 732.000000000 FORMAT "%13.9" NUMBER 55 /end CHARACTERISTIC
/begin CHARACTERISTIC DINH_FId.DFC_ComSRSTOut_CA "inhibitable FIds / FIds to be inhibited by inhibit source DFC_ComSRSTOut" VAL_BLK 0x804DE1FC ValA_Wu16 732.000000000 DINH_FIdVerb 0.00 732.000000000 FORMAT "%13.9" NUMBER 55 /end CHARACTERISTIC
/begin MEASUREMENT DINH_stFId.FId_ComGwIMG4Mon "Inhibit Status of FIds / Status of function identifier FId_ComGwIMG4Mon" UWORD DFC_OneToOne 1 100 0.00 65535.00 FORMAT "%8.2" ECU_ADDRESS 0x6000DCDC /end MEASUREMENT
/begin MEASUREMENT DINH_stFId.FId_ComGwIMG5 "Inhibit Status of FIds / Status of function identifier FId_ComGwIMG5" UWORD DFC_OneToOne 1 100 0.00 65535.00 FORMAT "%8.2" ECU_ADDRESS 0x6000DCDE /end MEASUREMENT
/begin MEASUREMENT DINH_stFId.FId_ComGwIMG5Mon "Inhibit Status of FIds / Status of function identifier FId_ComGwIMG5Mon" UWORD DFC_OneToOne 1 100 0.00 65535.00 FORMAT "%8.2" ECU_ADDRESS 0x6000DCE0 /end MEASUREMENT
/begin MEASUREMENT DINH_stFId.FId_ComGwIMG6 "Inhibit Status of FIds / Status of function identifier FId_ComGwIMG6" UWORD DFC_OneToOne 1 100 0.00 65535.00 FORMAT "%8.2" ECU_ADDRESS 0x6000DCE2 /end MEASUREMENT
/begin MEASUREMENT DINH_stFId.FId_ComGwIMG6Mon "Inhibit Status of FIds / Status of function identifier FId_ComGwIMG6Mon" UWORD DFC_OneToOne 1 100 0.00 65535.00 FORMAT "%8.2" ECU_ADDRESS 0x6000DCE4 /end MEASUREMENT
/begin MEASUREMENT DINH_stFId.FId_ComHFMSnsrErr "Inhibit Status of FIds / Status of function identifier FId_ComHFMSnsrErr" UWORD DFC_OneToOne 1 100 0.00 65535.00 FORMAT "%8.2" ECU_ADDRESS 0x6000DCE6 /end MEASUREMENT
/begin MEASUREMENT DINH_stFId.FId_ComIDASB "Inhibit Status of FIds / Status of function identifier FId_ComIDASB" UWORD DFC_OneToOne 1 100 0.00 65535.00 FORMAT "%8.2" ECU_ADDRESS 0x6000DCE8 /end MEASUREMENT
/begin MEASUREMENT DINH_stFId.FId_ComIDASBMon "Inhibit Status of FIds / Status of function identifier FId_ComIDASBMon" UWORD DFC_OneToOne 1 100 0.00 65535.00 FORMAT "%8.2" ECU_ADDRESS 0x6000DCEA /end MEASUREMENT
/begin MEASUREMENT DINH_stFId.FId_ComIDASEngFail "Inhibit Status of FIds / Status of function identifier FId_ComIDASEngFail" UWORD DFC_OneToOne 1 100 0.00 65535.00 FORMAT "%8.2" ECU_ADDRESS 0x6000DCEC /end MEASUREMENT
/begin MEASUREMENT DINH_stFId.FId_ComISG2 "Inhibit Status of FIds / Status of function identifier FId_ComISG2" UWORD DFC_OneToOne 1 100 0.00 65535.00 FORMAT "%8.2" ECU_ADDRESS 0x6000DCEE /end MEASUREMENT
/begin MEASUREMENT DINH_stFId.FId_ComIgnCtrl "Inhibit Status of FIds / Status of function identifier FId_ComIgnCtrl" UWORD DFC_OneToOne 1 100 0.00 65535.00 FORMAT "%8.2" ECU_ADDRESS 0x6000DCF0 /end MEASUREMENT
/begin MEASUREMENT DINH_stFId.FId_ComInjCtrl "Inhibit Status of FIds / Status of function identifier FId_ComInjCtrl" UWORD DFC_OneToOne 1 100 0.00 65535.00 FORMAT "%8.2" ECU_ADDRESS 0x6000DCF2 /end MEASUREMENT
/begin MEASUREMENT DINH_stFId.FId_ComIntkAirPSnsrErr "Inhibit Status of FIds / Status of function identifier FId_ComIntkAirPSnsrErr" UWORD DFC_OneToOne 1 100 0.00 65535.00 FORMAT "%8.2" ECU_ADDRESS 0x6000DCF4 /end MEASUREMENT
/begin MEASUREMENT DINH_stFId.FId_ComLamCtrl "Inhibit Status of FIds / Status of function identifier FId_ComLamCtrl" UWORD DFC_OneToOne 1 100 0.00 65535.00 FORMAT "%8.2" ECU_ADDRESS 0x6000DCF6 /end MEASUREMENT
/begin MEASUREMENT DINH_stFId.FId_ComMETA "Inhibit Status of FIds / Status of function identifier FId_ComMETA" UWORD DFC_OneToOne 1 100 0.00 65535.00 FORMAT "%8.2" ECU_ADDRESS 0x6000DCF8 /end MEASUREMENT
/begin MEASUREMENT DINH_stFId.FId_ComMETAMon "Inhibit Status of FIds / Status of function identifier FId_ComMETAMon" UWORD DFC_OneToOne 1 100 0.00 65535.00 FORMAT "%8.2" ECU_ADDRESS 0x6000DCFA /end MEASUREMENT
/begin MEASUREMENT DINH_stFId.FId_ComMETC "Inhibit Status of FIds / Status of function identifier FId_ComMETC" UWORD DFC_OneToOne 1 100 0.00 65535.00 FORMAT "%8.2" ECU_ADDRESS 0x6000DCFC /end MEASUREMENT
/begin MEASUREMENT DINH_stFId.FId_ComMETCMon "Inhibit Status of FIds / Status of function identifier FId_ComMETCMon" UWORD DFC_OneToOne 1 100 0.00 65535.00 FORMAT "%8.2" ECU_ADDRESS 0x6000DCFE /end MEASUREMENT
/begin MEASUREMENT DINH_stFId.FId_ComMETD "Inhibit Status of FIds / Status of function identifier FId_ComMETD" UWORD DFC_OneToOne 1 100 0.00 65535.00 FORMAT "%8.2" ECU_ADDRESS 0x6000DD00 /end MEASUREMENT
/begin MEASUREMENT DINH_stFId.FId_ComMETDMon "Inhibit Status of FIds / Status of function identifier FId_ComMETDMon" UWORD DFC_OneToOne 1 100 0.00 65535.00 FORMAT "%8.2" ECU_ADDRESS 0x6000DD02 /end MEASUREMENT
/begin MEASUREMENT DINH_stFId.FId_ComMETE2 "Inhibit Status of FIds / Status of function identifier FId_ComMETE2" UWORD DFC_OneToOne 1 100 0.00 65535.00 FORMAT "%8.2" ECU_ADDRESS 0x6000DD04 /end MEASUREMENT
/begin MEASUREMENT DINH_stFId.FId_ComMETE2Mon "Inhibit Status of FIds / Status of function identifier FId_ComMETE2Mon" UWORD DFC_OneToOne 1 100 0.00 65535.00 FORMAT "%8.2" ECU_ADDRESS 0x6000DD06 /end MEASUREMENT
/begin MEASUREMENT DINH_stFId.FId_ComMETF "Inhibit Status of FIds / Status of function identifier FId_ComMETF" UWORD DFC_OneToOne 1 100 0.00 65535.00 FORMAT "%8.2" ECU_ADDRESS 0x6000DD08 /end MEASUREMENT
/begin MEASUREMENT DINH_stFId.FId_ComMETFMon "Inhibit Status of FIds / Status of function identifier FId_ComMETFMon" UWORD DFC_OneToOne 1 100 0.00 65535.00 FORMAT "%8.2" ECU_ADDRESS 0x6000DD0A /end MEASUREMENT
/begin MEASUREMENT DINH_stFId.FId_ComMETG "Inhibit Status of FIds / Status of function identifier FId_ComMETG" UWORD DFC_OneToOne 1 100 0.00 65535.00 FORMAT "%8.2" ECU_ADDRESS 0x6000DD0C /end MEASUREMENT
/begin MEASUREMENT DINH_stFId.FId_ComMETGMon "Inhibit Status of FIds / Status of function identifier FId_ComMETGMon" UWORD DFC_OneToOne 1 100 0.00 65535.00 FORMAT "%8.2" ECU_ADDRESS 0x6000DD0E /end MEASUREMENT
/begin MEASUREMENT DINH_stFId.FId_ComMETH "Inhibit Status of FIds / Status of function identifier FId_ComMETH" UWORD DFC_OneToOne 1 100 0.00 65535.00 FORMAT "%8.2" ECU_ADDRESS 0x6000DD10 /end MEASUREMENT
/begin MEASUREMENT DINH_stFId.FId_ComMETH2 "Inhibit Status of FIds / Status of function identifier FId_ComMETH2" UWORD DFC_OneToOne 1 100 0.00 65535.00 FORMAT "%8.2" ECU_ADDRESS 0x6000DD12 /end MEASUREMENT
/begin MEASUREMENT DINH_stFId.FId_ComMETH2Mon "Inhibit Status of FIds / Status of function identifier FId_ComMETH2Mon" UWORD DFC_OneToOne 1 100 0.00 65535.00 FORMAT "%8.2" ECU_ADDRESS 0x6000DD14 /end MEASUREMENT
/begin MEASUREMENT DINH_stFId.FId_ComMETHMon "Inhibit Status of FIds / Status of function identifier FId_ComMETHMon" UWORD DFC_OneToOne 1 100 0.00 65535.00 FORMAT "%8.2" ECU_ADDRESS 0x6000DD16 /end MEASUREMENT
/begin MEASUREMENT DINH_stFId.FId_ComMETI "Inhibit Status of FIds / Status of function identifier FId_ComMETI" UWORD DFC_OneToOne 1 100 0.00 65535.00 FORMAT "%8.2" ECU_ADDRESS 0x6000DD18 /end MEASUREMENT
/begin MEASUREMENT DINH_stFId.FId_ComMETIMon "Inhibit Status of FIds / Status of function identifier FId_ComMETIMon" UWORD DFC_OneToOne 1 100 0.00 65535.00 FORMAT "%8.2" ECU_ADDRESS 0x6000DD1A /end MEASUREMENT
/begin MEASUREMENT DINH_stFId.FId_ComMETK "Inhibit Status of FIds / Status of function identifier FId_ComMETK" UWORD DFC_OneToOne 1 100 0.00 65535.00 FORMAT "%8.2" ECU_ADDRESS 0x6000DD1C /end MEASUREMENT
/begin MEASUREMENT DINH_stFId.FId_ComMETKMon "Inhibit Status of FIds / Status of function identifier FId_ComMETKMon" UWORD DFC_OneToOne 1 100 0.00 65535.00 FORMAT "%8.2" ECU_ADDRESS 0x6000DD1E /end MEASUREMENT
/begin MEASUREMENT DINH_stFId.FId_ComMETL "Inhibit Status of FIds / Status of function identifier FId_ComMETL" UWORD DFC_OneToOne 1 100 0.00 65535.00 FORMAT "%8.2" ECU_ADDRESS 0x6000DD20 /end MEASUREMENT
/begin MEASUREMENT DINH_stFId.FId_ComMETLMon "Inhibit Status of FIds / Status of function identifier FId_ComMETLMon" UWORD DFC_OneToOne 1 100 0.00 65535.00 FORMAT "%8.2" ECU_ADDRESS 0x6000DD22 /end MEASUREMENT
/begin MEASUREMENT DINH_stFId.FId_ComMETM "Inhibit Status of FIds / Status of function identifier FId_ComMETM" UWORD DFC_OneToOne 1 100 0.00 65535.00 FORMAT "%8.2" ECU_ADDRESS 0x6000DD24 /end MEASUREMENT
/begin MEASUREMENT DINH_stFId.FId_ComMETMMon "Inhibit Status of FIds / Status of function identifier FId_ComMETMMon" UWORD DFC_OneToOne 1 100 0.00 65535.00 FORMAT "%8.2" ECU_ADDRESS 0x6000DD26 /end MEASUREMENT
/begin MEASUREMENT DINH_stFId.FId_ComMETN "Inhibit Status of FIds / Status of function identifier FId_ComMETN" UWORD DFC_OneToOne 1 100 0.00 65535.00 FORMAT "%8.2" ECU_ADDRESS 0x6000DD28 /end MEASUREMENT
/begin MEASUREMENT DINH_stFId.FId_ComMETNMon "Inhibit Status of FIds / Status of function identifier FId_ComMETNMon" UWORD DFC_OneToOne 1 100 0.00 65535.00 FORMAT "%8.2" ECU_ADDRESS 0x6000DD2A /end MEASUREMENT
/begin MEASUREMENT DINH_stFId.FId_ComMisf "Inhibit Status of FIds / Status of function identifier FId_ComMisf" UWORD DFC_OneToOne 1 100 0.00 65535.00 FORMAT "%8.2" ECU_ADDRESS 0x6000DD2C /end MEASUREMENT
/begin MEASUREMENT DINH_stFId.FId_ComMon "Inhibit Status of FIds / Status of function identifier FId_ComMon" UWORD DFC_OneToOne 1 100 0.00 65535.00 FORMAT "%8.2" ECU_ADDRESS 0x6000DD2E /end MEASUREMENT
/begin MEASUREMENT DINH_stFId.FId_ComNTrbn "Inhibit Status of FIds / Status of function identifier FId_ComNTrbn" UWORD DFC_OneToOne 1 100 0.00 65535.00 FORMAT "%8.2" ECU_ADDRESS 0x6000DD30 /end MEASUREMENT
/begin MEASUREMENT DINH_stFId.FId_ComODOff "Inhibit Status of FIds / Status of function identifier FId_ComODOff" UWORD DFC_OneToOne 1 100 0.00 65535.00 FORMAT "%8.2" ECU_ADDRESS 0x6000DD32 /end MEASUREMENT
/begin MEASUREMENT DINH_stFId.FId_ComOilLvlLamp "Inhibit Status of FIds / Status of function identifier FId_ComOilLvlLamp" UWORD DFC_OneToOne 1 100 0.00 65535.00 FORMAT "%8.2" ECU_ADDRESS 0x6000DD34 /end MEASUREMENT
/begin MEASUREMENT DINH_stFId.FId_ComOilPWarnLamp "Inhibit Status of FIds / Status of function identifier FId_ComOilPWarnLamp" UWORD DFC_OneToOne 1 100 0.00 65535.00 FORMAT "%8.2" ECU_ADDRESS 0x6000DD36 /end MEASUREMENT
/begin MEASUREMENT DINH_stFId.FId_ComPASensFail "Inhibit Status of FIds / Status of function identifier FId_ComPASensFail" UWORD DFC_OneToOne 1 100 0.00 65535.00 FORMAT "%8.2" ECU_ADDRESS 0x6000DD38 /end MEASUREMENT
/begin MEASUREMENT DINH_stFId.FId_ComPBSensFail "Inhibit Status of FIds / Status of function identifier FId_ComPBSensFail" UWORD DFC_OneToOne 1 100 0.00 65535.00 FORMAT "%8.2" ECU_ADDRESS 0x6000DD3A /end MEASUREMENT
/begin MEASUREMENT DINH_stFId.FId_ComPCU "Inhibit Status of FIds / Status of function identifier FId_ComPCU" UWORD DFC_OneToOne 1 100 0.00 65535.00 FORMAT "%8.2" ECU_ADDRESS 0x6000DD3C /end MEASUREMENT
/begin MEASUREMENT DINH_stFId.FId_ComPCUMon "Inhibit Status of FIds / Status of function identifier FId_ComPCUMon" UWORD DFC_OneToOne 1 100 0.00 65535.00 FORMAT "%8.2" ECU_ADDRESS 0x6000DD3E /end MEASUREMENT
/begin MEASUREMENT DINH_stFId.FId_ComPosActnSpdLimrFctReq "Inhibit Status of FIds / Status of function identifier FId_ComPosActnSpdLimrFctReq" UWORD DFC_OneToOne 1 100 0.00 65535.00 FORMAT "%8.2" ECU_ADDRESS 0x6000DD40 /end MEASUREMENT
/begin MEASUREMENT DINH_stFId.FId_ComSRS "Inhibit Status of FIds / Status of function identifier FId_ComSRS" UWORD DFC_OneToOne 1 100 0.00 65535.00 FORMAT "%8.2" ECU_ADDRESS 0x6000DD42 /end MEASUREMENT
/begin MEASUREMENT DINH_stFId.FId_ComSRSA "Inhibit Status of FIds / Status of function identifier FId_ComSRSA" UWORD DFC_OneToOne 1 100 0.00 65535.00 FORMAT "%8.2" ECU_ADDRESS 0x6000DD44 /end MEASUREMENT
/begin MEASUREMENT DINH_stFId.FId_ComSRSAMon "Inhibit Status of FIds / Status of function identifier FId_ComSRSAMon" UWORD DFC_OneToOne 1 100 0.00 65535.00 FORMAT "%8.2" ECU_ADDRESS 0x6000DD46 /end MEASUREMENT
/begin MEASUREMENT DINH_stFId.FId_ComSRSB "Inhibit Status of FIds / Status of function identifier FId_ComSRSB" UWORD DFC_OneToOne 1 100 0.00 65535.00 FORMAT "%8.2" ECU_ADDRESS 0x6000DD48 /end MEASUREMENT
/begin MEASUREMENT DINH_stFId.FId_ComSRSBMon "Inhibit Status of FIds / Status of function identifier FId_ComSRSBMon" UWORD DFC_OneToOne 1 100 0.00 65535.00 FORMAT "%8.2" ECU_ADDRESS 0x6000DD4A /end MEASUREMENT
/begin MEASUREMENT DINH_stFId.FId_ComSRSMon "Inhibit Status of FIds / Status of function identifier FId_ComSRSMon" UWORD DFC_OneToOne 1 100 0.00 65535.00 FORMAT "%8.2" ECU_ADDRESS 0x6000DD4C /end MEASUREMENT
/begin MEASUREMENT DINH_stFId.FId_ComSTFlt "Inhibit Status of FIds / Status of function identifier FId_ComSTFlt" UWORD DFC_OneToOne 1 100 0.00 65535.00 FORMAT "%8.2" ECU_ADDRESS 0x6000DD4E /end MEASUREMENT
/begin MEASUREMENT DINH_stFId.FId_ComSpdLimrDevActvn "Inhibit Status of FIds / Status of function identifier FId_ComSpdLimrDevActvn" UWORD DFC_OneToOne 1 100 0.00 65535.00 FORMAT "%8.2" ECU_ADDRESS 0x6000DD50 /end MEASUREMENT
/begin MEASUREMENT DINH_stFId.FId_ComTCU01 "Inhibit Status of FIds / Status of function identifier FId_ComTCU01" UWORD DFC_OneToOne 1 100 0.00 65535.00 FORMAT "%8.2" ECU_ADDRESS 0x6000DD52 /end MEASUREMENT
/begin MEASUREMENT DINH_stFId.FId_ComTCU02 "Inhibit Status of FIds / Status of function identifier FId_ComTCU02" UWORD DFC_OneToOne 1 100 0.00 65535.00 FORMAT "%8.2" ECU_ADDRESS 0x6000DD54 /end MEASUREMENT
/begin MEASUREMENT DINH_stFId.FId_ComTCU1 "Inhibit Status of FIds / Status of function identifier FId_ComTCU1" UWORD DFC_OneToOne 1 100 0.00 65535.00 FORMAT "%8.2" ECU_ADDRESS 0x6000DD56 /end MEASUREMENT
/begin MEASUREMENT DINH_stFId.FId_ComTCU11 "Inhibit Status of FIds / Status of function identifier FId_ComTCU11" UWORD DFC_OneToOne 1 100 0.00 65535.00 FORMAT "%8.2" ECU_ADDRESS 0x6000DD58 /end MEASUREMENT
/begin MEASUREMENT DINH_stFId.FId_ComTCU12 "Inhibit Status of FIds / Status of function identifier FId_ComTCU12" UWORD DFC_OneToOne 1 100 0.00 65535.00 FORMAT "%8.2" ECU_ADDRESS 0x6000DD5A /end MEASUREMENT
/begin MEASUREMENT DINH_stFId.FId_ComTCU13 "Inhibit Status of FIds / Status of function identifier FId_ComTCU13" UWORD DFC_OneToOne 1 100 0.00 65535.00 FORMAT "%8.2" ECU_ADDRESS 0x6000DD5C /end MEASUREMENT
/begin MEASUREMENT DINH_stFId.FId_ComTCU14 "Inhibit Status of FIds / Status of function identifier FId_ComTCU14" UWORD DFC_OneToOne 1 100 0.00 65535.00 FORMAT "%8.2" ECU_ADDRESS 0x6000DD5E /end MEASUREMENT
/begin MEASUREMENT DINH_stFId.FId_ComTCU2 "Inhibit Status of FIds / Status of function identifier FId_ComTCU2" UWORD DFC_OneToOne 1 100 0.00 65535.00 FORMAT "%8.2" ECU_ADDRESS 0x6000DD60 /end MEASUREMENT
/begin MEASUREMENT DINH_stFId.FId_ComTCU3 "Inhibit Status of FIds / Status of function identifier FId_ComTCU3" UWORD DFC_OneToOne 1 100 0.00 65535.00 FORMAT "%8.2" ECU_ADDRESS 0x6000DD62 /end MEASUREMENT
/begin MEASUREMENT DINH_stFId.FId_ComTCU4 "Inhibit Status of FIds / Status of function identifier FId_ComTCU4" UWORD DFC_OneToOne 1 100 0.00 65535.00 FORMAT "%8.2" ECU_ADDRESS 0x6000DD64 /end MEASUREMENT
/begin MEASUREMENT DINH_stFId.FId_ComTCUGear "Inhibit Status of FIds / Status of function identifier FId_ComTCUGear" UWORD DFC_OneToOne 1 100 0.00 65535.00 FORMAT "%8.2" ECU_ADDRESS 0x6000DD66 /end MEASUREMENT
/begin MEASUREMENT DINH_stFId.FId_ComTarGearDwnShift "Inhibit Status of FIds / Status of function identifier FId_ComTarGearDwnShift" UWORD DFC_OneToOne 1 100 0.00 65535.00 FORMAT "%8.2" ECU_ADDRESS 0x6000DD68 /end MEASUREMENT
/begin MEASUREMENT DINH_stFId.FId_ComTarGearUpShift "Inhibit Status of FIds / Status of function identifier FId_ComTarGearUpShift" UWORD DFC_OneToOne 1 100 0.00 65535.00 FORMAT "%8.2" ECU_ADDRESS 0x6000DD6A /end MEASUREMENT
/begin MEASUREMENT DINH_stFId.FId_ComThrPosnFail "Inhibit Status of FIds / Status of function identifier FId_ComThrPosnFail" UWORD DFC_OneToOne 1 100 0.00 65535.00 FORMAT "%8.2" ECU_ADDRESS 0x6000DD6C /end MEASUREMENT
/begin MEASUREMENT DINH_stFId.FId_ComThrVlv "Inhibit Status of FIds / Status of function identifier FId_ComThrVlv" UWORD DFC_OneToOne 1 100 0.00 65535.00 FORMAT "%8.2" ECU_ADDRESS 0x6000DD6E /end MEASUREMENT
/begin MEASUREMENT DINH_stFId.FId_ComTrboChrgnErr "Inhibit Status of FIds / Status of function identifier FId_ComTrboChrgnErr" UWORD DFC_OneToOne 1 100 0.00 65535.00 FORMAT "%8.2" ECU_ADDRESS 0x6000DD70 /end MEASUREMENT
/begin MEASUREMENT DINH_stFId.FId_ComTrqAccuracySlow "Inhibit Status of FIds / Status of function identifier FId_ComTrqAccuracySlow" UWORD DFC_OneToOne 1 100 0.00 65535.00 FORMAT "%8.2" ECU_ADDRESS 0x6000DD72 /end MEASUREMENT
/begin MEASUREMENT DINH_stFId.FId_ComTrqReqFast "Inhibit Status of FIds / Status of function identifier FId_ComTrqReqFast" UWORD DFC_OneToOne 1 100 0.00 65535.00 FORMAT "%8.2" ECU_ADDRESS 0x6000DD74 /end MEASUREMENT
/begin MEASUREMENT DINH_stFId.FId_ComTrqReqSlow "Inhibit Status of FIds / Status of function identifier FId_ComTrqReqSlow" UWORD DFC_OneToOne 1 100 0.00 65535.00 FORMAT "%8.2" ECU_ADDRESS 0x6000DD76 /end MEASUREMENT
/begin MEASUREMENT DINH_stFId.FId_ComVSAErr "Inhibit Status of FIds / Status of function identifier FId_ComVSAErr" UWORD DFC_OneToOne 1 100 0.00 65535.00 FORMAT "%8.2" ECU_ADDRESS 0x6000DD78 /end MEASUREMENT
/begin MEASUREMENT DINH_stFId.FId_ComVehSpdFltChk "Inhibit Status of FIds / Status of function identifier FId_ComVehSpdFltChk" UWORD DFC_OneToOne 1 100 0.00 65535.00 FORMAT "%8.2" ECU_ADDRESS 0x6000DD7A /end MEASUREMENT
/begin MEASUREMENT DINH_stFId.FId_ComVehSpdImpsErr "Inhibit Status of FIds / Status of function identifier FId_ComVehSpdImpsErr" UWORD DFC_OneToOne 1 100 0.00 65535.00 FORMAT "%8.2" ECU_ADDRESS 0x6000DD7C /end MEASUREMENT
/begin MEASUREMENT DINH_stFId.FId_ComVlvLftCtrl "Inhibit Status of FIds / Status of function identifier FId_ComVlvLftCtrl" UWORD DFC_OneToOne 1 100 0.00 65535.00 FORMAT "%8.2" ECU_ADDRESS 0x6000DD7E /end MEASUREMENT
/begin MEASUREMENT DINH_stFId.FId_ComvolEng "Inhibit Status of FIds / Status of function identifier FId_ComvolEng" UWORD DFC_OneToOne 1 100 0.00 65535.00 FORMAT "%8.2" ECU_ADDRESS 0x6000DD80 /end MEASUREMENT
/begin MEASUREMENT DINH_stFId.FId_ConvLdCalcLvrPos "Inhibit Status of FIds / Status of function identifier FId_ConvLdCalcLvrPos" UWORD DFC_OneToOne 1 100 0.00 65535.00 FORMAT "%8.2" ECU_ADDRESS 0x6000DD82 /end MEASUREMENT
/begin MEASUREMENT DINH_stFId.FId_ConvLdNTrbnCan "Inhibit Status of FIds / Status of function identifier FId_ConvLdNTrbnCan" UWORD DFC_OneToOne 1 100 0.00 65535.00 FORMAT "%8.2" ECU_ADDRESS 0x6000DD84 /end MEASUREMENT
/begin MEASUREMENT DINH_stFId.FId_ConvLdOilCoolrPmp "Inhibit Status of FIds / Status of function identifier FId_ConvLdOilCoolrPmp" UWORD DFC_OneToOne 1 100 0.00 65535.00 FORMAT "%8.2" ECU_ADDRESS 0x6000DD86 /end MEASUREMENT
/begin MEASUREMENT DINH_stFId.FId_ConvLdOilTemp "Inhibit Status of FIds / Status of function identifier FId_ConvLdOilTemp" UWORD DFC_OneToOne 1 100 0.00 65535.00 FORMAT "%8.2" ECU_ADDRESS 0x6000DD88 /end MEASUREMENT
/begin MEASUREMENT DINH_stFId.FId_ConvLdTrqLdCan "Inhibit Status of FIds / Status of function identifier FId_ConvLdTrqLdCan" UWORD DFC_OneToOne 1 100 0.00 65535.00 FORMAT "%8.2" ECU_ADDRESS 0x6000DD8A /end MEASUREMENT
/begin MEASUREMENT DINH_stFId.FId_ConvLdVel "Inhibit Status of FIds / Status of function identifier FId_ConvLdVel" UWORD DFC_OneToOne 1 100 0.00 65535.00 FORMAT "%8.2" ECU_ADDRESS 0x6000DD8C /end MEASUREMENT
/begin MEASUREMENT DINH_stFId.FId_CptProtnExhTempMdl "Inhibit Status of FIds / Status of function identifier FId_CptProtnExhTempMdl" UWORD DFC_OneToOne 1 100 0.00 65535.00 FORMAT "%8.2" ECU_ADDRESS 0x6000DD8E /end MEASUREMENT
/begin MEASUREMENT DINH_stFId.FId_CptProtnO2SnsrB1 "Inhibit Status of FIds / Status of function identifier FId_CptProtnO2SnsrB1" UWORD DFC_OneToOne 1 100 0.00 65535.00 FORMAT "%8.2" ECU_ADDRESS 0x6000DD90 /end MEASUREMENT
/begin MEASUREMENT DINH_stFId.FId_CptProtnVVeh "Inhibit Status of FIds / Status of function identifier FId_CptProtnVVeh" UWORD DFC_OneToOne 1 100 0.00 65535.00 FORMAT "%8.2" ECU_ADDRESS 0x6000DD92 /end MEASUREMENT
/begin MEASUREMENT DINH_stFId.FId_CrCUI1EFRxErr "Inhibit Status of FIds / Status of function identifier FId_CrCUI1EFRxErr" UWORD DFC_OneToOne 1 100 0.00 65535.00 FORMAT "%8.2" ECU_ADDRESS 0x6000DD94 /end MEASUREMENT
/begin MEASUREMENT DINH_stFId.FId_CrCUICANRxErr "Inhibit Status of FIds / Status of function identifier FId_CrCUICANRxErr" UWORD DFC_OneToOne 1 100 0.00 65535.00 FORMAT "%8.2" ECU_ADDRESS 0x6000DD96 /end MEASUREMENT
/begin MEASUREMENT DINH_stFId.FId_CrCUIFCMRxErr "Inhibit Status of FIds / Status of function identifier FId_CrCUIFCMRxErr" UWORD DFC_OneToOne 1 100 0.00 65535.00 FORMAT "%8.2" ECU_ADDRESS 0x6000DD98 /end MEASUREMENT
/begin MEASUREMENT DINH_stFId.FId_CrCUIMETDRxErr "Inhibit Status of FIds / Status of function identifier FId_CrCUIMETDRxErr" UWORD DFC_OneToOne 1 100 0.00 65535.00 FORMAT "%8.2" ECU_ADDRESS 0x6000DD9A /end MEASUREMENT
/begin MEASUREMENT DINH_stFId.FId_CrCtlACCRxErr "Inhibit Status of FIds / Status of function identifier FId_CrCtlACCRxErr" UWORD DFC_OneToOne 1 100 0.00 65535.00 FORMAT "%8.2" ECU_ADDRESS 0x6000DD9C /end MEASUREMENT
/begin MEASUREMENT DINH_stFId.FId_CrCtlAppSnsrErr "Inhibit Status of FIds / Status of function identifier FId_CrCtlAppSnsrErr" UWORD DFC_OneToOne 1 100 0.00 65535.00 FORMAT "%8.2" ECU_ADDRESS 0x6000DD9E /end MEASUREMENT
/begin MEASUREMENT DINH_stFId.FId_CrCtlShutOffEng "Inhibit Status of FIds / Status of function identifier FId_CrCtlShutOffEng" UWORD DFC_OneToOne 1 100 0.00 65535.00 FORMAT "%8.2" ECU_ADDRESS 0x6000DDA0 /end MEASUREMENT
/begin MEASUREMENT DINH_stFId.FId_DIUMPRCldStrtMon "Inhibit Status of FIds / Status of function identifier FId_DIUMPRCldStrtMon" UWORD DFC_OneToOne 1 100 0.00 65535.00 FORMAT "%8.2" ECU_ADDRESS 0x6000DDA2 /end MEASUREMENT
/begin MEASUREMENT DINH_stFId.FId_DIUMPRGenDenom1 "Inhibit Status of FIds / Status of function identifier FId_DIUMPRGenDenom1" UWORD DFC_OneToOne 1 100 0.00 65535.00 FORMAT "%8.2" ECU_ADDRESS 0x6000DDA4 /end MEASUREMENT
/begin MEASUREMENT DINH_stFId.FId_DIUMPRGenDenom2 "Inhibit Status of FIds / Status of function identifier FId_DIUMPRGenDenom2" UWORD DFC_OneToOne 1 100 0.00 65535.00 FORMAT "%8.2" ECU_ADDRESS 0x6000DDA6 /end MEASUREMENT
/begin MEASUREMENT DINH_stFId.FId_DIUMPRGenDenom3 "Inhibit Status of FIds / Status of function identifier FId_DIUMPRGenDenom3" UWORD DFC_OneToOne 1 100 0.00 65535.00 FORMAT "%8.2" ECU_ADDRESS 0x6000DDA8 /end MEASUREMENT
/begin MEASUREMENT DINH_stFId.FId_DIUMPRIgn "Inhibit Status of FIds / Status of function identifier FId_DIUMPRIgn" UWORD DFC_OneToOne 1 100 0.00 65535.00 FORMAT "%8.2" ECU_ADDRESS 0x6000DDAA /end MEASUREMENT
/begin MEASUREMENT DINH_stFId.FId_DOGov "Inhibit Status of FIds / Status of function identifier FId_DOGov" UWORD DFC_OneToOne 1 100 0.00 65535.00 FORMAT "%8.2" ECU_ADDRESS 0x6000DDAC /end MEASUREMENT
/begin MEASUREMENT DINH_stFId.FId_DSMWarmUpCycle "Inhibit Status of FIds / Status of function identifier FId_DSMWarmUpCycle" UWORD DFC_OneToOne 1 100 0.00 65535.00 FORMAT "%8.2" ECU_ADDRESS 0x6000DDAE /end MEASUREMENT
/begin MEASUREMENT DINH_stFId.FId_DewDetTKAMax "Inhibit Status of FIds / Status of function identifier FId_DewDetTKAMax" UWORD DFC_OneToOne 1 100 0.00 65535.00 FORMAT "%8.2" ECU_ADDRESS 0x6000DDB0 /end MEASUREMENT
/begin MEASUREMENT DINH_stFId.FId_DkrsaEpmNoSig "Inhibit Status of FIds / Status of function identifier FId_DkrsaEpmNoSig" UWORD DFC_OneToOne 1 100 0.00 65535.00 FORMAT "%8.2" ECU_ADDRESS 0x6000DDB2 /end MEASUREMENT
/begin MEASUREMENT DINH_stFId.FId_EBBCANErrFrzVal "Inhibit Status of FIds / Status of function identifier FId_EBBCANErrFrzVal" UWORD DFC_OneToOne 1 100 0.00 65535.00 FORMAT "%8.2" ECU_ADDRESS 0x6000DDB4 /end MEASUREMENT
/begin MEASUREMENT DINH_stFId.FId_EBBCANErrReplVal "Inhibit Status of FIds / Status of function identifier FId_EBBCANErrReplVal" UWORD DFC_OneToOne 1 100 0.00 65535.00 FORMAT "%8.2" ECU_ADDRESS 0x6000DDB6 /end MEASUREMENT
/begin MEASUREMENT DINH_stFId.FId_EGLZSR "Inhibit Status of FIds / Status of function identifier FId_EGLZSR" UWORD DFC_OneToOne 1 100 0.00 65535.00 FORMAT "%8.2" ECU_ADDRESS 0x6000DDB8 /end MEASUREMENT
/begin MEASUREMENT DINH_stFId.FId_EGSDO2OffsRstDsmS1B1 "Inhibit Status of FIds / Status of function identifier FId_EGSDO2OffsRstDsmS1B1" UWORD DFC_OneToOne 1 100 0.00 65535.00 FORMAT "%8.2" ECU_ADDRESS 0x6000DDBA /end MEASUREMENT
/begin MEASUREMENT DINH_stFId.FId_EGSDO2_LamOffsSlowS1 "Inhibit Status of FIds / Status of function identifier FId_EGSDO2_LamOffsSlowS1" UWORD DFC_OneToOne 1 100 0.00 65535.00 FORMAT "%8.2" ECU_ADDRESS 0x6000DDBC /end MEASUREMENT
/begin MEASUREMENT DINH_stFId.FId_EGSDUS2B1LtrDly "Inhibit Status of FIds / Status of function identifier FId_EGSDUS2B1LtrDly" UWORD DFC_OneToOne 1 100 0.00 65535.00 FORMAT "%8.2" ECU_ADDRESS 0x6000DDBE /end MEASUREMENT
/begin MEASUREMENT DINH_stFId.FId_EGSDUS2B1LtrPT1 "Inhibit Status of FIds / Status of function identifier FId_EGSDUS2B1LtrPT1" UWORD DFC_OneToOne 1 100 0.00 65535.00 FORMAT "%8.2" ECU_ADDRESS 0x6000DDC0 /end MEASUREMENT
/begin MEASUREMENT DINH_stFId.FId_EGSDUS2B1RtlDly "Inhibit Status of FIds / Status of function identifier FId_EGSDUS2B1RtlDly" UWORD DFC_OneToOne 1 100 0.00 65535.00 FORMAT "%8.2" ECU_ADDRESS 0x6000DDC2 /end MEASUREMENT
/begin MEASUREMENT DINH_stFId.FId_EGSDUS2B1RtlPT1 "Inhibit Status of FIds / Status of function identifier FId_EGSDUS2B1RtlPT1" UWORD DFC_OneToOne 1 100 0.00 65535.00 FORMAT "%8.2" ECU_ADDRESS 0x6000DDC4 /end MEASUREMENT
/begin MEASUREMENT DINH_stFId.FId_EGSDUS2B1TarEvln "Inhibit Status of FIds / Status of function identifier FId_EGSDUS2B1TarEvln" UWORD DFC_OneToOne 1 100 0.00 65535.00 FORMAT "%8.2" ECU_ADDRESS 0x6000DDC6 /end MEASUREMENT
/begin MEASUREMENT DINH_stFId.FId_EGSDUS2B1TarLean "Inhibit Status of FIds / Status of function identifier FId_EGSDUS2B1TarLean" UWORD DFC_OneToOne 1 100 0.00 65535.00 FORMAT "%8.2" ECU_ADDRESS 0x6000DDC8 /end MEASUREMENT
/begin MEASUREMENT DINH_stFId.FId_EGSDUS2B1TarRich "Inhibit Status of FIds / Status of function identifier FId_EGSDUS2B1TarRich" UWORD DFC_OneToOne 1 100 0.00 65535.00 FORMAT "%8.2" ECU_ADDRESS 0x6000DDCA /end MEASUREMENT
/begin MEASUREMENT DINH_stFId.FId_ELZSR "Inhibit Status of FIds / Status of function identifier FId_ELZSR" UWORD DFC_OneToOne 1 100 0.00 65535.00 FORMAT "%8.2" ECU_ADDRESS 0x6000DDCC /end MEASUREMENT
/begin MEASUREMENT DINH_stFId.FId_EPBErr "Inhibit Status of FIds / Status of function identifier FId_EPBErr" UWORD DFC_OneToOne 1 100 0.00 65535.00 FORMAT "%8.2" ECU_ADDRESS 0x6000DDCE /end MEASUREMENT
/begin MEASUREMENT DINH_stFId.FId_EPBFrmErr "Inhibit Status of FIds / Status of function identifier FId_EPBFrmErr" UWORD DFC_OneToOne 1 100 0.00 65535.00 FORMAT "%8.2" ECU_ADDRESS 0x6000DDD0 /end MEASUREMENT
/begin MEASUREMENT DINH_stFId.FId_EPBFrmErrClth "Inhibit Status of FIds / Status of function identifier FId_EPBFrmErrClth" UWORD DFC_OneToOne 1 100 0.00 65535.00 FORMAT "%8.2" ECU_ADDRESS 0x6000DDD2 /end MEASUREMENT
/begin MEASUREMENT DINH_stFId.FId_EVPComFailr "Inhibit Status of FIds / Status of function identifier FId_EVPComFailr" UWORD DFC_OneToOne 1 100 0.00 65535.00 FORMAT "%8.2" ECU_ADDRESS 0x6000DDD4 /end MEASUREMENT
/begin MEASUREMENT DINH_stFId.FId_EbsLinErr "Inhibit Status of FIds / Status of function identifier FId_EbsLinErr" UWORD DFC_OneToOne 1 100 0.00 65535.00 FORMAT "%8.2" ECU_ADDRESS 0x6000DDD6 /end MEASUREMENT
/begin MEASUREMENT DINH_stFId.FId_EepReadWrState "Inhibit Status of FIds / Status of function identifier FId_EepReadWrState" UWORD DFC_OneToOne 1 100 0.00 65535.00 FORMAT "%8.2" ECU_ADDRESS 0x6000DDD8 /end MEASUREMENT
/begin MEASUREMENT DINH_stFId.FId_ElecLdComErr "Inhibit Status of FIds / Status of function identifier FId_ElecLdComErr" UWORD DFC_OneToOne 1 100 0.00 65535.00 FORMAT "%8.2" ECU_ADDRESS 0x6000DDDA /end MEASUREMENT
/begin MEASUREMENT DINH_stFId.FId_ElecLdFrzVal "Inhibit Status of FIds / Status of function identifier FId_ElecLdFrzVal" UWORD DFC_OneToOne 1 100 0.00 65535.00 FORMAT "%8.2" ECU_ADDRESS 0x6000DDDC /end MEASUREMENT
/begin MEASUREMENT DINH_stFId.FId_ElecLdHdLiComErr "Inhibit Status of FIds / Status of function identifier FId_ElecLdHdLiComErr" UWORD DFC_OneToOne 1 100 0.00 65535.00 FORMAT "%8.2" ECU_ADDRESS 0x6000DDDE /end MEASUREMENT
/begin MEASUREMENT DINH_stFId.FId_ElecLdRplVal "Inhibit Status of FIds / Status of function identifier FId_ElecLdRplVal" UWORD DFC_OneToOne 1 100 0.00 65535.00 FORMAT "%8.2" ECU_ADDRESS 0x6000DDE0 /end MEASUREMENT
/begin MEASUREMENT DINH_stFId.FId_ElecLoadEPSComErr "Inhibit Status of FIds / Status of function identifier FId_ElecLoadEPSComErr" UWORD DFC_OneToOne 1 100 0.00 65535.00 FORMAT "%8.2" ECU_ADDRESS 0x6000DDE2 /end MEASUREMENT
/begin MEASUREMENT DINH_stFId.FId_EngBlkTWrn "Inhibit Status of FIds / Status of function identifier FId_EngBlkTWrn" UWORD DFC_OneToOne 1 100 0.00 65535.00 FORMAT "%8.2" ECU_ADDRESS 0x6000DDE4 /end MEASUREMENT
/begin MEASUREMENT DINH_stFId.FId_EngCooltTFail "Inhibit Status of FIds / Status of function identifier FId_EngCooltTFail" UWORD DFC_OneToOne 1 100 0.00 65535.00 FORMAT "%8.2" ECU_ADDRESS 0x6000DDE6 /end MEASUREMENT
/begin MEASUREMENT DINH_stFId.FId_EngDemTqLimnCamsftErr "Inhibit Status of FIds / Status of function identifier FId_EngDemTqLimnCamsftErr" UWORD DFC_OneToOne 1 100 0.00 65535.00 FORMAT "%8.2" ECU_ADDRESS 0x6000DDE8 /end MEASUREMENT
/begin MEASUREMENT DINH_stFId.FId_EngDemTqLimnErrThmstHeatCtrlCirc "Inhibit Status of FIds / Status of function identifier FId_EngDemTqLimnErrThmstHeatCtrlCirc" UWORD DFC_OneToOne 1 100 0.00 65535.00 FORMAT "%8.2" ECU_ADDRESS 0x6000DDEA /end MEASUREMENT
/begin MEASUREMENT DINH_stFId.FId_EngDemTqLimnOilPmp "Inhibit Status of FIds / Status of function identifier FId_EngDemTqLimnOilPmp" UWORD DFC_OneToOne 1 100 0.00 65535.00 FORMAT "%8.2" ECU_ADDRESS 0x6000DDEC /end MEASUREMENT
/begin MEASUREMENT DINH_stFId.FId_EngDemTrqLimErrAPP "Inhibit Status of FIds / Status of function identifier FId_EngDemTrqLimErrAPP" UWORD DFC_OneToOne 1 100 0.00 65535.00 FORMAT "%8.2" ECU_ADDRESS 0x6000DDEE /end MEASUREMENT
/begin MEASUREMENT DINH_stFId.FId_EngIntkAirFail "Inhibit Status of FIds / Status of function identifier FId_EngIntkAirFail" UWORD DFC_OneToOne 1 100 0.00 65535.00 FORMAT "%8.2" ECU_ADDRESS 0x6000DDF0 /end MEASUREMENT
/begin MEASUREMENT DINH_stFId.FId_EngPrtErrVehV "Inhibit Status of FIds / Status of function identifier FId_EngPrtErrVehV" UWORD DFC_OneToOne 1 100 0.00 65535.00 FORMAT "%8.2" ECU_ADDRESS 0x6000DDF2 /end MEASUREMENT
/begin MEASUREMENT DINH_stFId.FId_EngSpd30DegFail "Inhibit Status of FIds / Status of function identifier FId_EngSpd30DegFail" UWORD DFC_OneToOne 1 100 0.00 65535.00 FORMAT "%8.2" ECU_ADDRESS 0x6000DDF4 /end MEASUREMENT
/begin MEASUREMENT DINH_stFId.FId_EngStrtEnaEthAdap "Inhibit Status of FIds / Status of function identifier FId_EngStrtEnaEthAdap" UWORD DFC_OneToOne 1 100 0.00 65535.00 FORMAT "%8.2" ECU_ADDRESS 0x6000DDF6 /end MEASUREMENT
/begin MEASUREMENT DINH_stFId.FId_EngStrt_InjProhb "Inhibit Status of FIds / Status of function identifier FId_EngStrt_InjProhb" UWORD DFC_OneToOne 1 100 0.00 65535.00 FORMAT "%8.2" ECU_ADDRESS 0x6000DDF8 /end MEASUREMENT
/begin MEASUREMENT DINH_stFId.FId_EngTqRvsnEnaFlg "Inhibit Status of FIds / Status of function identifier FId_EngTqRvsnEnaFlg" UWORD DFC_OneToOne 1 100 0.00 65535.00 FORMAT "%8.2" ECU_ADDRESS 0x6000DDFA /end MEASUREMENT
/begin MEASUREMENT DINH_stFId.FId_EnvTPrimMod "Inhibit Status of FIds / Status of function identifier FId_EnvTPrimMod" UWORD DFC_OneToOne 1 100 0.00 65535.00 FORMAT "%8.2" ECU_ADDRESS 0x6000DDFC /end MEASUREMENT
/begin MEASUREMENT DINH_stFId.FId_EnvTPrimModIniVal "Inhibit Status of FIds / Status of function identifier FId_EnvTPrimModIniVal" UWORD DFC_OneToOne 1 100 0.00 65535.00 FORMAT "%8.2" ECU_ADDRESS 0x6000DDFE /end MEASUREMENT
/begin MEASUREMENT DINH_stFId.FId_EnvTSensSum "Inhibit Status of FIds / Status of function identifier FId_EnvTSensSum" UWORD DFC_OneToOne 1 100 0.00 65535.00 FORMAT "%8.2" ECU_ADDRESS 0x6000DE00 /end MEASUREMENT
/begin MEASUREMENT DINH_stFId.FId_EnvTtCEngDsT "Inhibit Status of FIds / Status of function identifier FId_EnvTtCEngDsT" UWORD DFC_OneToOne 1 100 0.00 65535.00 FORMAT "%8.2" ECU_ADDRESS 0x6000DE02 /end MEASUREMENT
/begin MEASUREMENT DINH_stFId.FId_EnvTtIntkMnfld "Inhibit Status of FIds / Status of function identifier FId_EnvTtIntkMnfld" UWORD DFC_OneToOne 1 100 0.00 65535.00 FORMAT "%8.2" ECU_ADDRESS 0x6000DE04 /end MEASUREMENT
/begin MEASUREMENT DINH_stFId.FId_EpmBCr "Inhibit Status of FIds / Status of function identifier FId_EpmBCr" UWORD DFC_OneToOne 1 100 0.00 65535.00 FORMAT "%8.2" ECU_ADDRESS 0x6000DE06 /end MEASUREMENT
/begin MEASUREMENT DINH_stFId.FId_EpmCaSAdapCaSI1 "Inhibit Status of FIds / Status of function identifier FId_EpmCaSAdapCaSI1" UWORD DFC_OneToOne 1 100 0.00 65535.00 FORMAT "%8.2" ECU_ADDRESS 0x6000DE08 /end MEASUREMENT
/begin MEASUREMENT DINH_stFId.FId_EpmCaSAdapRstI1 "Inhibit Status of FIds / Status of function identifier FId_EpmCaSAdapRstI1" UWORD DFC_OneToOne 1 100 0.00 65535.00 FORMAT "%8.2" ECU_ADDRESS 0x6000DE0A /end MEASUREMENT
/begin MEASUREMENT DINH_stFId.FId_EpmCaSDiagI1 "Inhibit Status of FIds / Status of function identifier FId_EpmCaSDiagI1" UWORD DFC_OneToOne 1 100 0.00 65535.00 FORMAT "%8.2" ECU_ADDRESS 0x6000DE0C /end MEASUREMENT
/begin MEASUREMENT DINH_stFId.FId_EpmCaSErrCaSI1 "Inhibit Status of FIds / Status of function identifier FId_EpmCaSErrCaSI1" UWORD DFC_OneToOne 1 100 0.00 65535.00 FORMAT "%8.2" ECU_ADDRESS 0x6000DE0E /end MEASUREMENT
/begin MEASUREMENT DINH_stFId.FId_EpmCaSOfsDiagCaSI1 "Inhibit Status of FIds / Status of function identifier FId_EpmCaSOfsDiagCaSI1" UWORD DFC_OneToOne 1 100 0.00 65535.00 FORMAT "%8.2" ECU_ADDRESS 0x6000DE10 /end MEASUREMENT
/begin MEASUREMENT DINH_stFId.FId_EpmCaSOfsErrCaSI1 "Inhibit Status of FIds / Status of function identifier FId_EpmCaSOfsErrCaSI1" UWORD DFC_OneToOne 1 100 0.00 65535.00 FORMAT "%8.2" ECU_ADDRESS 0x6000DE12 /end MEASUREMENT
/begin MEASUREMENT DINH_stFId.FId_EpmCaSSegI1 "Inhibit Status of FIds / Status of function identifier FId_EpmCaSSegI1" UWORD DFC_OneToOne 1 100 0.00 65535.00 FORMAT "%8.2" ECU_ADDRESS 0x6000DE14 /end MEASUREMENT
/begin MEASUREMENT DINH_stFId.FId_EpmCaSSpdPlausI1 "Inhibit Status of FIds / Status of function identifier FId_EpmCaSSpdPlausI1" UWORD DFC_OneToOne 1 100 0.00 65535.00 FORMAT "%8.2" ECU_ADDRESS 0x6000DE16 /end MEASUREMENT
/begin MEASUREMENT DINH_stFId.FId_EpmCrSDiag "Inhibit Status of FIds / Status of function identifier FId_EpmCrSDiag" UWORD DFC_OneToOne 1 100 0.00 65535.00 FORMAT "%8.2" ECU_ADDRESS 0x6000DE18 /end MEASUREMENT
/begin MEASUREMENT DINH_stFId.FId_EpmCrSDiagVeh "Inhibit Status of FIds / Status of function identifier FId_EpmCrSDiagVeh" UWORD DFC_OneToOne 1 100 0.00 65535.00 FORMAT "%8.2" ECU_ADDRESS 0x6000DE1A /end MEASUREMENT
/begin MEASUREMENT DINH_stFId.FId_EpmCrSErr "Inhibit Status of FIds / Status of function identifier FId_EpmCrSErr" UWORD DFC_OneToOne 1 100 0.00 65535.00 FORMAT "%8.2" ECU_ADDRESS 0x6000DE1C /end MEASUREMENT
/begin MEASUREMENT DINH_stFId.FId_EpmRRSCrSFaultCheck "Inhibit Status of FIds / Status of function identifier FId_EpmRRSCrSFaultCheck" UWORD DFC_OneToOne 1 100 0.00 65535.00 FORMAT "%8.2" ECU_ADDRESS 0x6000DE1E /end MEASUREMENT
/begin MEASUREMENT DINH_stFId.FId_EpmRRSVehVFaultChck "Inhibit Status of FIds / Status of function identifier FId_EpmRRSVehVFaultChck" UWORD DFC_OneToOne 1 100 0.00 65535.00 FORMAT "%8.2" ECU_ADDRESS 0x6000DE20 /end MEASUREMENT
/begin MEASUREMENT DINH_stFId.FId_EpmSynLockCaSSync "Inhibit Status of FIds / Status of function identifier FId_EpmSynLockCaSSync" UWORD DFC_OneToOne 1 100 0.00 65535.00 FORMAT "%8.2" ECU_ADDRESS 0x6000DE22 /end MEASUREMENT
/begin MEASUREMENT DINH_stFId.FId_EtaEngIdleNonCsers "Inhibit Status of FIds / Status of function identifier FId_EtaEngIdleNonCsers" UWORD DFC_OneToOne 1 100 0.00 65535.00 FORMAT "%8.2" ECU_ADDRESS 0x6000DE24 /end MEASUREMENT
/begin MEASUREMENT DINH_stFId.FId_EtaEngPtlNonCsers "Inhibit Status of FIds / Status of function identifier FId_EtaEngPtlNonCsers" UWORD DFC_OneToOne 1 100 0.00 65535.00 FORMAT "%8.2" ECU_ADDRESS 0x6000DE26 /end MEASUREMENT
/begin MEASUREMENT DINH_stFId.FId_FanCtlACClntP "Inhibit Status of FIds / Status of function identifier FId_FanCtlACClntP" UWORD DFC_OneToOne 1 100 0.00 65535.00 FORMAT "%8.2" ECU_ADDRESS 0x6000DE28 /end MEASUREMENT
/begin MEASUREMENT DINH_stFId.FId_FanCtlACGModFail "Inhibit Status of FIds / Status of function identifier FId_FanCtlACGModFail" UWORD DFC_OneToOne 1 100 0.00 65535.00 FORMAT "%8.2" ECU_ADDRESS 0x6000DE2A /end MEASUREMENT
/begin MEASUREMENT DINH_stFId.FId_FanCtlAPP1 "Inhibit Status of FIds / Status of function identifier FId_FanCtlAPP1" UWORD DFC_OneToOne 1 100 0.00 65535.00 FORMAT "%8.2" ECU_ADDRESS 0x6000DE2C /end MEASUREMENT
/begin MEASUREMENT DINH_stFId.FId_FanCtlAPP2 "Inhibit Status of FIds / Status of function identifier FId_FanCtlAPP2" UWORD DFC_OneToOne 1 100 0.00 65535.00 FORMAT "%8.2" ECU_ADDRESS 0x6000DE2E /end MEASUREMENT
/begin MEASUREMENT DINH_stFId.FId_FanCtlAPPSync "Inhibit Status of FIds / Status of function identifier FId_FanCtlAPPSync" UWORD DFC_OneToOne 1 100 0.00 65535.00 FORMAT "%8.2" ECU_ADDRESS 0x6000DE30 /end MEASUREMENT
/begin MEASUREMENT DINH_stFId.FId_FanCtlBlowrU "Inhibit Status of FIds / Status of function identifier FId_FanCtlBlowrU" UWORD DFC_OneToOne 1 100 0.00 65535.00 FORMAT "%8.2" ECU_ADDRESS 0x6000DE32 /end MEASUREMENT
/begin MEASUREMENT DINH_stFId.FId_FanCtlCooltT "Inhibit Status of FIds / Status of function identifier FId_FanCtlCooltT" UWORD DFC_OneToOne 1 100 0.00 65535.00 FORMAT "%8.2" ECU_ADDRESS 0x6000DE34 /end MEASUREMENT
/begin MEASUREMENT DINH_stFId.FId_FanCtlCooltT2 "Inhibit Status of FIds / Status of function identifier FId_FanCtlCooltT2" UWORD DFC_OneToOne 1 100 0.00 65535.00 FORMAT "%8.2" ECU_ADDRESS 0x6000DE36 /end MEASUREMENT
/begin MEASUREMENT DINH_stFId.FId_FanCtlEnvT "Inhibit Status of FIds / Status of function identifier FId_FanCtlEnvT" UWORD DFC_OneToOne 1 100 0.00 65535.00 FORMAT "%8.2" ECU_ADDRESS 0x6000DE38 /end MEASUREMENT
/begin MEASUREMENT DINH_stFId.FId_FanCtlLiSwtInfo "Inhibit Status of FIds / Status of function identifier FId_FanCtlLiSwtInfo" UWORD DFC_OneToOne 1 100 0.00 65535.00 FORMAT "%8.2" ECU_ADDRESS 0x6000DE3A /end MEASUREMENT
/begin MEASUREMENT DINH_stFId.FId_FanCtlSpd "Inhibit Status of FIds / Status of function identifier FId_FanCtlSpd" UWORD DFC_OneToOne 1 100 0.00 65535.00 FORMAT "%8.2" ECU_ADDRESS 0x6000DE3C /end MEASUREMENT
/begin MEASUREMENT DINH_stFId.FId_FanCtlTSnsrErr "Inhibit Status of FIds / Status of function identifier FId_FanCtlTSnsrErr" UWORD DFC_OneToOne 1 100 0.00 65535.00 FORMAT "%8.2" ECU_ADDRESS 0x6000DE3E /end MEASUREMENT
/begin MEASUREMENT DINH_stFId.FId_FanCtlThr1 "Inhibit Status of FIds / Status of function identifier FId_FanCtlThr1" UWORD DFC_OneToOne 1 100 0.00 65535.00 FORMAT "%8.2" ECU_ADDRESS 0x6000DE40 /end MEASUREMENT
/begin MEASUREMENT DINH_stFId.FId_FanCtlThr2 "Inhibit Status of FIds / Status of function identifier FId_FanCtlThr2" UWORD DFC_OneToOne 1 100 0.00 65535.00 FORMAT "%8.2" ECU_ADDRESS 0x6000DE42 /end MEASUREMENT
/begin MEASUREMENT DINH_stFId.FId_FcoReq "Inhibit Status of FIds / Status of function identifier FId_FcoReq" UWORD DFC_OneToOne 1 100 0.00 65535.00 FORMAT "%8.2" ECU_ADDRESS 0x6000DE44 /end MEASUREMENT
/begin MEASUREMENT DINH_stFId.FId_FiMFID_rba_MRly_Diag_Stk "Inhibit Status of FIds / Status of function identifier FId_FiMFID_rba_MRly_Diag_Stk" UWORD DFC_OneToOne 1 100 0.00 65535.00 FORMAT "%8.2" ECU_ADDRESS 0x6000DE46 /end MEASUREMENT
/begin MEASUREMENT DINH_stFId.FId_FlMALamDynDiag "Inhibit Status of FIds / Status of function identifier FId_FlMALamDynDiag" UWORD DFC_OneToOne 1 100 0.00 65535.00 FORMAT "%8.2" ECU_ADDRESS 0x6000DE48 /end MEASUREMENT
/begin MEASUREMENT DINH_stFId.FId_FuEvapPurgTCpvDty "Inhibit Status of FIds / Status of function identifier FId_FuEvapPurgTCpvDty" UWORD DFC_OneToOne 1 100 0.00 65535.00 FORMAT "%8.2" ECU_ADDRESS 0x6000DE4A /end MEASUREMENT
/begin MEASUREMENT DINH_stFId.FId_FuMixUegoErrExcl "Inhibit Status of FIds / Status of function identifier FId_FuMixUegoErrExcl" UWORD DFC_OneToOne 1 100 0.00 65535.00 FORMAT "%8.2" ECU_ADDRESS 0x6000DE4C /end MEASUREMENT
/begin MEASUREMENT DINH_stFId.FId_GEVCtlVlvLftEnaIntk "Inhibit Status of FIds / Status of function identifier FId_GEVCtlVlvLftEnaIntk" UWORD DFC_OneToOne 1 100 0.00 65535.00 FORMAT "%8.2" ECU_ADDRESS 0x6000DE4E /end MEASUREMENT
/begin MEASUREMENT DINH_stFId.FId_GbxAnNeutPosnErr "Inhibit Status of FIds / Status of function identifier FId_GbxAnNeutPosnErr" UWORD DFC_OneToOne 1 100 0.00 65535.00 FORMAT "%8.2" ECU_ADDRESS 0x6000DE50 /end MEASUREMENT
/begin MEASUREMENT DINH_stFId.FId_GbxCANDigPlausErr "Inhibit Status of FIds / Status of function identifier FId_GbxCANDigPlausErr" UWORD DFC_OneToOne 1 100 0.00 65535.00 FORMAT "%8.2" ECU_ADDRESS 0x6000DE52 /end MEASUREMENT
/begin MEASUREMENT DINH_stFId.FId_GbxCANNeutSigErr "Inhibit Status of FIds / Status of function identifier FId_GbxCANNeutSigErr" UWORD DFC_OneToOne 1 100 0.00 65535.00 FORMAT "%8.2" ECU_ADDRESS 0x6000DE54 /end MEASUREMENT
/begin MEASUREMENT DINH_stFId.FId_GbxPNPosSig "Inhibit Status of FIds / Status of function identifier FId_GbxPNPosSig" UWORD DFC_OneToOne 1 100 0.00 65535.00 FORMAT "%8.2" ECU_ADDRESS 0x6000DE56 /end MEASUREMENT
/begin MEASUREMENT DINH_stFId.FId_GbxPNPosnComErr "Inhibit Status of FIds / Status of function identifier FId_GbxPNPosnComErr" UWORD DFC_OneToOne 1 100 0.00 65535.00 FORMAT "%8.2" ECU_ADDRESS 0x6000DE58 /end MEASUREMENT
/begin MEASUREMENT DINH_stFId.FId_GbxPNPosnDiagDrvCdnRels "Inhibit Status of FIds / Status of function identifier FId_GbxPNPosnDiagDrvCdnRels" UWORD DFC_OneToOne 1 100 0.00 65535.00 FORMAT "%8.2" ECU_ADDRESS 0x6000DE5A /end MEASUREMENT
/begin MEASUREMENT DINH_stFId.FId_GbxPNPosnDiagDrvCodnHealRels "Inhibit Status of FIds / Status of function identifier FId_GbxPNPosnDiagDrvCodnHealRels" UWORD DFC_OneToOne 1 100 0.00 65535.00 FORMAT "%8.2" ECU_ADDRESS 0x6000DE5C /end MEASUREMENT
/begin MEASUREMENT DINH_stFId.FId_GbxPNPosnDiagPlausyRels "Inhibit Status of FIds / Status of function identifier FId_GbxPNPosnDiagPlausyRels" UWORD DFC_OneToOne 1 100 0.00 65535.00 FORMAT "%8.2" ECU_ADDRESS 0x6000DE5E /end MEASUREMENT
/begin MEASUREMENT DINH_stFId.FId_GbxPNPosnSubsVal "Inhibit Status of FIds / Status of function identifier FId_GbxPNPosnSubsVal" UWORD DFC_OneToOne 1 100 0.00 65535.00 FORMAT "%8.2" ECU_ADDRESS 0x6000DE60 /end MEASUREMENT
/begin MEASUREMENT DINH_stFId.FId_GbxRvsSwtStk "Inhibit Status of FIds / Status of function identifier FId_GbxRvsSwtStk" UWORD DFC_OneToOne 1 100 0.00 65535.00 FORMAT "%8.2" ECU_ADDRESS 0x6000DE62 /end MEASUREMENT
/begin MEASUREMENT DINH_stFId.FId_GbxSnsrSplyUErr "Inhibit Status of FIds / Status of function identifier FId_GbxSnsrSplyUErr" UWORD DFC_OneToOne 1 100 0.00 65535.00 FORMAT "%8.2" ECU_ADDRESS 0x6000DE64 /end MEASUREMENT
/begin MEASUREMENT DINH_stFId.FId_GbxSpstReqOk "Inhibit Status of FIds / Status of function identifier FId_GbxSpstReqOk" UWORD DFC_OneToOne 1 100 0.00 65535.00 FORMAT "%8.2" ECU_ADDRESS 0x6000DE66 /end MEASUREMENT
/begin MEASUREMENT DINH_stFId.FId_GlbDaLSumvXPtd "Inhibit Status of FIds / Status of function identifier FId_GlbDaLSumvXPtd" UWORD DFC_OneToOne 1 100 0.00 65535.00 FORMAT "%8.2" ECU_ADDRESS 0x6000DE68 /end MEASUREMENT
/begin MEASUREMENT DINH_stFId.FId_GslThrVlvSnsrDiagB1 "Inhibit Status of FIds / Status of function identifier FId_GslThrVlvSnsrDiagB1" UWORD DFC_OneToOne 1 100 0.00 65535.00 FORMAT "%8.2" ECU_ADDRESS 0x6000DE6A /end MEASUREMENT
/begin MEASUREMENT DINH_stFId.FId_HEGOS2B1DElec "Inhibit Status of FIds / Status of function identifier FId_HEGOS2B1DElec" UWORD DFC_OneToOne 1 100 0.00 65535.00 FORMAT "%8.2" ECU_ADDRESS 0x6000DE6C /end MEASUREMENT
/begin MEASUREMENT DINH_stFId.FId_HEGOS2B1DHtg "Inhibit Status of FIds / Status of function identifier FId_HEGOS2B1DHtg" UWORD DFC_OneToOne 1 100 0.00 65535.00 FORMAT "%8.2" ECU_ADDRESS 0x6000DE6E /end MEASUREMENT
/begin MEASUREMENT DINH_stFId.FId_HEGOS2B1Htg "Inhibit Status of FIds / Status of function identifier FId_HEGOS2B1Htg" UWORD DFC_OneToOne 1 100 0.00 65535.00 FORMAT "%8.2" ECU_ADDRESS 0x6000DE70 /end MEASUREMENT
/begin MEASUREMENT DINH_stFId.FId_HEGOS2B1HtrPsSt "Inhibit Status of FIds / Status of function identifier FId_HEGOS2B1HtrPsSt" UWORD DFC_OneToOne 1 100 0.00 65535.00 FORMAT "%8.2" ECU_ADDRESS 0x6000DE72 /end MEASUREMENT
/begin MEASUREMENT DINH_stFId.FId_HEGOS2B1InVld "Inhibit Status of FIds / Status of function identifier FId_HEGOS2B1InVld" UWORD DFC_OneToOne 1 100 0.00 65535.00 FORMAT "%8.2" ECU_ADDRESS 0x6000DE74 /end MEASUREMENT
/begin MEASUREMENT DINH_stFId.FId_HEGOS2B1LSPsDiaDi "Inhibit Status of FIds / Status of function identifier FId_HEGOS2B1LSPsDiaDi" UWORD DFC_OneToOne 1 100 0.00 65535.00 FORMAT "%8.2" ECU_ADDRESS 0x6000DE76 /end MEASUREMENT
/begin MEASUREMENT DINH_stFId.FId_HLSDemBrkFlt "Inhibit Status of FIds / Status of function identifier FId_HLSDemBrkFlt" UWORD DFC_OneToOne 1 100 0.00 65535.00 FORMAT "%8.2" ECU_ADDRESS 0x6000DE78 /end MEASUREMENT
/begin MEASUREMENT DINH_stFId.FId_HLSDemIntkAirTemp "Inhibit Status of FIds / Status of function identifier FId_HLSDemIntkAirTemp" UWORD DFC_OneToOne 1 100 0.00 65535.00 FORMAT "%8.2" ECU_ADDRESS 0x6000DE7A /end MEASUREMENT
/begin MEASUREMENT DINH_stFId.FId_HLSDemMotTemp "Inhibit Status of FIds / Status of function identifier FId_HLSDemMotTemp" UWORD DFC_OneToOne 1 100 0.00 65535.00 FORMAT "%8.2" ECU_ADDRESS 0x6000DE7C /end MEASUREMENT
/begin MEASUREMENT DINH_stFId.FId_HLSDemMstCyldpVld "Inhibit Status of FIds / Status of function identifier FId_HLSDemMstCyldpVld" UWORD DFC_OneToOne 1 100 0.00 65535.00 FORMAT "%8.2" ECU_ADDRESS 0x6000DE7E /end MEASUREMENT
/begin MEASUREMENT DINH_stFId.FId_HLSDemOvhtExhMnf "Inhibit Status of FIds / Status of function identifier FId_HLSDemOvhtExhMnf" UWORD DFC_OneToOne 1 100 0.00 65535.00 FORMAT "%8.2" ECU_ADDRESS 0x6000DE80 /end MEASUREMENT
/begin MEASUREMENT DINH_stFId.FId_HLSDemOvhtFanR "Inhibit Status of FIds / Status of function identifier FId_HLSDemOvhtFanR" UWORD DFC_OneToOne 1 100 0.00 65535.00 FORMAT "%8.2" ECU_ADDRESS 0x6000DE82 /end MEASUREMENT
/begin MEASUREMENT DINH_stFId.FId_HLSDemOvhtGear "Inhibit Status of FIds / Status of function identifier FId_HLSDemOvhtGear" UWORD DFC_OneToOne 1 100 0.00 65535.00 FORMAT "%8.2" ECU_ADDRESS 0x6000DE84 /end MEASUREMENT
/begin MEASUREMENT DINH_stFId.FId_HLSDemOvhtTum "Inhibit Status of FIds / Status of function identifier FId_HLSDemOvhtTum" UWORD DFC_OneToOne 1 100 0.00 65535.00 FORMAT "%8.2" ECU_ADDRESS 0x6000DE86 /end MEASUREMENT
/begin MEASUREMENT DINH_stFId.FId_HLSDemOvhtVehV "Inhibit Status of FIds / Status of function identifier FId_HLSDemOvhtVehV" UWORD DFC_OneToOne 1 100 0.00 65535.00 FORMAT "%8.2" ECU_ADDRESS 0x6000DE88 /end MEASUREMENT
/begin MEASUREMENT DINH_stFId.FId_HLSDemSpdClthGearAccrSigErr "Inhibit Status of FIds / Status of function identifier FId_HLSDemSpdClthGearAccrSigErr" UWORD DFC_OneToOne 1 100 0.00 65535.00 FORMAT "%8.2" ECU_ADDRESS 0x6000DE8A /end MEASUREMENT
/begin MEASUREMENT DINH_stFId.FId_HLSDem_DrvOffSuprt "Inhibit Status of FIds / Status of function identifier FId_HLSDem_DrvOffSuprt" UWORD DFC_OneToOne 1 100 0.00 65535.00 FORMAT "%8.2" ECU_ADDRESS 0x6000DE8C /end MEASUREMENT
/begin MEASUREMENT DINH_stFId.FId_HLSDem_DrvOffSuprtBrkHldSys "Inhibit Status of FIds / Status of function identifier FId_HLSDem_DrvOffSuprtBrkHldSys" UWORD DFC_OneToOne 1 100 0.00 65535.00 FORMAT "%8.2" ECU_ADDRESS 0x6000DE8E /end MEASUREMENT
/begin MEASUREMENT DINH_stFId.FId_HLSDem_DrvOffSuprtLAS "Inhibit Status of FIds / Status of function identifier FId_HLSDem_DrvOffSuprtLAS" UWORD DFC_OneToOne 1 100 0.00 65535.00 FORMAT "%8.2" ECU_ADDRESS 0x6000DE90 /end MEASUREMENT
/begin MEASUREMENT DINH_stFId.FId_HLSDem_PModeActv "Inhibit Status of FIds / Status of function identifier FId_HLSDem_PModeActv" UWORD DFC_OneToOne 1 100 0.00 65535.00 FORMAT "%8.2" ECU_ADDRESS 0x6000DE92 /end MEASUREMENT
/begin MEASUREMENT DINH_stFId.FId_HLSDem_TModeActv "Inhibit Status of FIds / Status of function identifier FId_HLSDem_TModeActv" UWORD DFC_OneToOne 1 100 0.00 65535.00 FORMAT "%8.2" ECU_ADDRESS 0x6000DE94 /end MEASUREMENT
/begin MEASUREMENT DINH_stFId.FId_HLSDem_TraSubFcn "Inhibit Status of FIds / Status of function identifier FId_HLSDem_TraSubFcn" UWORD DFC_OneToOne 1 100 0.00 65535.00 FORMAT "%8.2" ECU_ADDRESS 0x6000DE96 /end MEASUREMENT
/begin MEASUREMENT DINH_stFId.FId_HLSDem_nMaxLimErr1 "Inhibit Status of FIds / Status of function identifier FId_HLSDem_nMaxLimErr1" UWORD DFC_OneToOne 1 100 0.00 65535.00 FORMAT "%8.2" ECU_ADDRESS 0x6000DE98 /end MEASUREMENT
/begin MEASUREMENT DINH_stFId.FId_HLSDem_nMaxLimErr2 "Inhibit Status of FIds / Status of function identifier FId_HLSDem_nMaxLimErr2" UWORD DFC_OneToOne 1 100 0.00 65535.00 FORMAT "%8.2" ECU_ADDRESS 0x6000DE9A /end MEASUREMENT
/begin MEASUREMENT DINH_stFId.FId_HLSDem_nMaxLimErr3 "Inhibit Status of FIds / Status of function identifier FId_HLSDem_nMaxLimErr3" UWORD DFC_OneToOne 1 100 0.00 65535.00 FORMAT "%8.2" ECU_ADDRESS 0x6000DE9C /end MEASUREMENT
/begin MEASUREMENT DINH_stFId.FId_HLSDem_nMaxVErr "Inhibit Status of FIds / Status of function identifier FId_HLSDem_nMaxVErr" UWORD DFC_OneToOne 1 100 0.00 65535.00 FORMAT "%8.2" ECU_ADDRESS 0x6000DE9E /end MEASUREMENT
/begin MEASUREMENT DINH_stFId.FId_I14229APP "Inhibit Status of FIds / Status of function identifier FId_I14229APP" UWORD DFC_OneToOne 1 100 0.00 65535.00 FORMAT "%8.2" ECU_ADDRESS 0x6000DEA0 /end MEASUREMENT
/begin MEASUREMENT DINH_stFId.FId_I14229CANErr "Inhibit Status of FIds / Status of function identifier FId_I14229CANErr" UWORD DFC_OneToOne 1 100 0.00 65535.00 FORMAT "%8.2" ECU_ADDRESS 0x6000DEA2 /end MEASUREMENT
/begin MEASUREMENT DINH_stFId.FId_I14229EWPErr "Inhibit Status of FIds / Status of function identifier FId_I14229EWPErr" UWORD DFC_OneToOne 1 100 0.00 65535.00 FORMAT "%8.2" ECU_ADDRESS 0x6000DEA4 /end MEASUREMENT
/begin MEASUREMENT DINH_stFId.FId_I14229TrbCh "Inhibit Status of FIds / Status of function identifier FId_I14229TrbCh" UWORD DFC_OneToOne 1 100 0.00 65535.00 FORMAT "%8.2" ECU_ADDRESS 0x6000DEA6 /end MEASUREMENT
/begin MEASUREMENT DINH_stFId.FId_I14229VTCErr "Inhibit Status of FIds / Status of function identifier FId_I14229VTCErr" UWORD DFC_OneToOne 1 100 0.00 65535.00 FORMAT "%8.2" ECU_ADDRESS 0x6000DEA8 /end MEASUREMENT
/begin MEASUREMENT DINH_stFId.FId_IMGISABComErr "Inhibit Status of FIds / Status of function identifier FId_IMGISABComErr" UWORD DFC_OneToOne 1 100 0.00 65535.00 FORMAT "%8.2" ECU_ADDRESS 0x6000DEAA /end MEASUREMENT
/begin MEASUREMENT DINH_stFId.FId_InhbLamDynS1B1 "Inhibit Status of FIds / Status of function identifier FId_InhbLamDynS1B1" UWORD DFC_OneToOne 1 100 0.00 65535.00 FORMAT "%8.2" ECU_ADDRESS 0x6000DEAC /end MEASUREMENT
/begin MEASUREMENT DINH_stFId.FId_InhibitAlways "Inhibit Status of FIds / Status of function identifier FId_InhibitAlways" UWORD DFC_OneToOne 1 100 0.00 65535.00 FORMAT "%8.2" ECU_ADDRESS 0x6000DEAE /end MEASUREMENT
/begin MEASUREMENT DINH_stFId.FId_InhibitNever "Inhibit Status of FIds / Status of function identifier FId_InhibitNever" UWORD DFC_OneToOne 1 100 0.00 65535.00 FORMAT "%8.2" ECU_ADDRESS 0x6000DEB0 /end MEASUREMENT
/begin MEASUREMENT DINH_stFId.FId_InjVvgPFIEV1 "Inhibit Status of FIds / Status of function identifier FId_InjVvgPFIEV1" UWORD DFC_OneToOne 1 100 0.00 65535.00 FORMAT "%8.2" ECU_ADDRESS 0x6000DEB2 /end MEASUREMENT
/begin MEASUREMENT DINH_stFId.FId_InjVvgPFIEV2 "Inhibit Status of FIds / Status of function identifier FId_InjVvgPFIEV2" UWORD DFC_OneToOne 1 100 0.00 65535.00 FORMAT "%8.2" ECU_ADDRESS 0x6000DEB4 /end MEASUREMENT
/begin MEASUREMENT DINH_stFId.FId_InjVvgPFIEV3 "Inhibit Status of FIds / Status of function identifier FId_InjVvgPFIEV3" UWORD DFC_OneToOne 1 100 0.00 65535.00 FORMAT "%8.2" ECU_ADDRESS 0x6000DEB6 /end MEASUREMENT
/begin MEASUREMENT DINH_stFId.FId_InjVvgPFIEV4 "Inhibit Status of FIds / Status of function identifier FId_InjVvgPFIEV4" UWORD DFC_OneToOne 1 100 0.00 65535.00 FORMAT "%8.2" ECU_ADDRESS 0x6000DEB8 /end MEASUREMENT
/begin MEASUREMENT DINH_stFId.FId_IntkAirTIntkMnfldCrssChk "Inhibit Status of FIds / Status of function identifier FId_IntkAirTIntkMnfldCrssChk" UWORD DFC_OneToOne 1 100 0.00 65535.00 FORMAT "%8.2" ECU_ADDRESS 0x6000DEBA /end MEASUREMENT
/begin MEASUREMENT DINH_stFId.FId_IntkAirTIntkMnfldPlausChk "Inhibit Status of FIds / Status of function identifier FId_IntkAirTIntkMnfldPlausChk" UWORD DFC_OneToOne 1 100 0.00 65535.00 FORMAT "%8.2" ECU_ADDRESS 0x6000DEBC /end MEASUREMENT
/begin MEASUREMENT DINH_stFId.FId_IntkAirTIntkMnfldRepl "Inhibit Status of FIds / Status of function identifier FId_IntkAirTIntkMnfldRepl" UWORD DFC_OneToOne 1 100 0.00 65535.00 FORMAT "%8.2" ECU_ADDRESS 0x6000DEBE /end MEASUREMENT
/begin MEASUREMENT DINH_stFId.FId_IntkAirTSnsr1Elec "Inhibit Status of FIds / Status of function identifier FId_IntkAirTSnsr1Elec" UWORD DFC_OneToOne 1 100 0.00 65535.00 FORMAT "%8.2" ECU_ADDRESS 0x6000DEC0 /end MEASUREMENT
/begin MEASUREMENT DINH_stFId.FId_IntkAirTSnsr1PRC "Inhibit Status of FIds / Status of function identifier FId_IntkAirTSnsr1PRC" UWORD DFC_OneToOne 1 100 0.00 65535.00 FORMAT "%8.2" ECU_ADDRESS 0x6000DEC2 /end MEASUREMENT
/begin MEASUREMENT DINH_stFId.FId_IntkAirTSnsr1Sum "Inhibit Status of FIds / Status of function identifier FId_IntkAirTSnsr1Sum" UWORD DFC_OneToOne 1 100 0.00 65535.00 FORMAT "%8.2" ECU_ADDRESS 0x6000DEC4 /end MEASUREMENT
/begin MEASUREMENT DINH_stFId.FId_IntkArTempENGB "Inhibit Status of FIds / Status of function identifier FId_IntkArTempENGB" UWORD DFC_OneToOne 1 100 0.00 65535.00 FORMAT "%8.2" ECU_ADDRESS 0x6000DEC6 /end MEASUREMENT
/begin MEASUREMENT DINH_stFId.FId_LIGovDfrstI "Inhibit Status of FIds / Status of function identifier FId_LIGovDfrstI" UWORD DFC_OneToOne 1 100 0.00 65535.00 FORMAT "%8.2" ECU_ADDRESS 0x6000DEC8 /end MEASUREMENT
/begin MEASUREMENT DINH_stFId.FId_LIGovUndrBrk "Inhibit Status of FIds / Status of function identifier FId_LIGovUndrBrk" UWORD DFC_OneToOne 1 100 0.00 65535.00 FORMAT "%8.2" ECU_ADDRESS 0x6000DECA /end MEASUREMENT
/begin MEASUREMENT DINH_stFId.FId_LINDCDCRxErr "Inhibit Status of FIds / Status of function identifier FId_LINDCDCRxErr" UWORD DFC_OneToOne 1 100 0.00 65535.00 FORMAT "%8.2" ECU_ADDRESS 0x6000DECC /end MEASUREMENT
/begin MEASUREMENT DINH_stFId.FId_LLimAppSnsrErr "Inhibit Status of FIds / Status of function identifier FId_LLimAppSnsrErr" UWORD DFC_OneToOne 1 100 0.00 65535.00 FORMAT "%8.2" ECU_ADDRESS 0x6000DECE /end MEASUREMENT
/begin MEASUREMENT DINH_stFId.FId_LLimAppSnsrSyncErr "Inhibit Status of FIds / Status of function identifier FId_LLimAppSnsrSyncErr" UWORD DFC_OneToOne 1 100 0.00 65535.00 FORMAT "%8.2" ECU_ADDRESS 0x6000DED0 /end MEASUREMENT
/begin MEASUREMENT DINH_stFId.FId_LLimMTVehSpdSnsrErr "Inhibit Status of FIds / Status of function identifier FId_LLimMTVehSpdSnsrErr" UWORD DFC_OneToOne 1 100 0.00 65535.00 FORMAT "%8.2" ECU_ADDRESS 0x6000DED2 /end MEASUREMENT
/begin MEASUREMENT DINH_stFId.FId_LLimShutOffEng "Inhibit Status of FIds / Status of function identifier FId_LLimShutOffEng" UWORD DFC_OneToOne 1 100 0.00 65535.00 FORMAT "%8.2" ECU_ADDRESS 0x6000DED4 /end MEASUREMENT
/begin MEASUREMENT DINH_stFId.FId_LRSEBMisf "Inhibit Status of FIds / Status of function identifier FId_LRSEBMisf" UWORD DFC_OneToOne 1 100 0.00 65535.00 FORMAT "%8.2" ECU_ADDRESS 0x6000DED6 /end MEASUREMENT
/begin MEASUREMENT DINH_stFId.FId_LZSR "Inhibit Status of FIds / Status of function identifier FId_LZSR" UWORD DFC_OneToOne 1 100 0.00 65535.00 FORMAT "%8.2" ECU_ADDRESS 0x6000DED8 /end MEASUREMENT
/begin MEASUREMENT DINH_stFId.FId_LeakToMnfldTstd "Inhibit Status of FIds / Status of function identifier FId_LeakToMnfldTstd" UWORD DFC_OneToOne 1 100 0.00 65535.00 FORMAT "%8.2" ECU_ADDRESS 0x6000DEDA /end MEASUREMENT
/begin MEASUREMENT DINH_stFId.FId_MaiLoadSnsr "Inhibit Status of FIds / Status of function identifier FId_MaiLoadSnsr" UWORD DFC_OneToOne 1 100 0.00 65535.00 FORMAT "%8.2" ECU_ADDRESS 0x6000DEDC /end MEASUREMENT
/begin MEASUREMENT DINH_stFId.FId_MisfDetDnAdpn "Inhibit Status of FIds / Status of function identifier FId_MisfDetDnAdpn" UWORD DFC_OneToOne 1 100 0.00 65535.00 FORMAT "%8.2" ECU_ADDRESS 0x6000DEDE /end MEASUREMENT
/begin MEASUREMENT DINH_stFId.FId_MisfDetDnAdpnPlaus "Inhibit Status of FIds / Status of function identifier FId_MisfDetDnAdpnPlaus" UWORD DFC_OneToOne 1 100 0.00 65535.00 FORMAT "%8.2" ECU_ADDRESS 0x6000DEE0 /end MEASUREMENT
/begin MEASUREMENT DINH_stFId.FId_MisfDetEnvP "Inhibit Status of FIds / Status of function identifier FId_MisfDetEnvP" UWORD DFC_OneToOne 1 100 0.00 65535.00 FORMAT "%8.2" ECU_ADDRESS 0x6000DEE2 /end MEASUREMENT
/begin MEASUREMENT DINH_stFId.FId_MisfDetSegTiAdpnFco "Inhibit Status of FIds / Status of function identifier FId_MisfDetSegTiAdpnFco" UWORD DFC_OneToOne 1 100 0.00 65535.00 FORMAT "%8.2" ECU_ADDRESS 0x6000DEE4 /end MEASUREMENT
/begin MEASUREMENT DINH_stFId.FId_MisfDetShtrpAct "Inhibit Status of FIds / Status of function identifier FId_MisfDetShtrpAct" UWORD DFC_OneToOne 1 100 0.00 65535.00 FORMAT "%8.2" ECU_ADDRESS 0x6000DEE6 /end MEASUREMENT
/begin MEASUREMENT DINH_stFId.FId_MisfDetStc "Inhibit Status of FIds / Status of function identifier FId_MisfDetStc" UWORD DFC_OneToOne 1 100 0.00 65535.00 FORMAT "%8.2" ECU_ADDRESS 0x6000DEE8 /end MEASUREMENT
/begin MEASUREMENT DINH_stFId.FId_MisfDetV "Inhibit Status of FIds / Status of function identifier FId_MisfDetV" UWORD DFC_OneToOne 1 100 0.00 65535.00 FORMAT "%8.2" ECU_ADDRESS 0x6000DEEA /end MEASUREMENT
/begin MEASUREMENT DINH_stFId.FId_MisfDetVWhlFrntLe "Inhibit Status of FIds / Status of function identifier FId_MisfDetVWhlFrntLe" UWORD DFC_OneToOne 1 100 0.00 65535.00 FORMAT "%8.2" ECU_ADDRESS 0x6000DEEC /end MEASUREMENT
/begin MEASUREMENT DINH_stFId.FId_MisfDetVWhlFrntRi "Inhibit Status of FIds / Status of function identifier FId_MisfDetVWhlFrntRi" UWORD DFC_OneToOne 1 100 0.00 65535.00 FORMAT "%8.2" ECU_ADDRESS 0x6000DEEE /end MEASUREMENT
/begin MEASUREMENT DINH_stFId.FId_MisfDetVWhlReLe "Inhibit Status of FIds / Status of function identifier FId_MisfDetVWhlReLe" UWORD DFC_OneToOne 1 100 0.00 65535.00 FORMAT "%8.2" ECU_ADDRESS 0x6000DEF0 /end MEASUREMENT
/begin MEASUREMENT DINH_stFId.FId_MisfDetVWhlReRi "Inhibit Status of FIds / Status of function identifier FId_MisfDetVWhlReRi" UWORD DFC_OneToOne 1 100 0.00 65535.00 FORMAT "%8.2" ECU_ADDRESS 0x6000DEF2 /end MEASUREMENT
/begin MEASUREMENT DINH_stFId.FId_MisfDet_InjLockdOpen01 "Inhibit Status of FIds / Status of function identifier FId_MisfDet_InjLockdOpen01" UWORD DFC_OneToOne 1 100 0.00 65535.00 FORMAT "%8.2" ECU_ADDRESS 0x6000DEF4 /end MEASUREMENT
/begin MEASUREMENT DINH_stFId.FId_MisfDet_InjLockdOpen02 "Inhibit Status of FIds / Status of function identifier FId_MisfDet_InjLockdOpen02" UWORD DFC_OneToOne 1 100 0.00 65535.00 FORMAT "%8.2" ECU_ADDRESS 0x6000DEF6 /end MEASUREMENT
/begin MEASUREMENT DINH_stFId.FId_MisfDet_InjLockdOpen03 "Inhibit Status of FIds / Status of function identifier FId_MisfDet_InjLockdOpen03" UWORD DFC_OneToOne 1 100 0.00 65535.00 FORMAT "%8.2" ECU_ADDRESS 0x6000DEF8 /end MEASUREMENT
/begin MEASUREMENT DINH_stFId.FId_MisfDet_InjLockdOpen04 "Inhibit Status of FIds / Status of function identifier FId_MisfDet_InjLockdOpen04" UWORD DFC_OneToOne 1 100 0.00 65535.00 FORMAT "%8.2" ECU_ADDRESS 0x6000DEFA /end MEASUREMENT
/begin MEASUREMENT DINH_stFId.FId_NLimVehHalt "Inhibit Status of FIds / Status of function identifier FId_NLimVehHalt" UWORD DFC_OneToOne 1 100 0.00 65535.00 FORMAT "%8.2" ECU_ADDRESS 0x6000DEFC /end MEASUREMENT
/begin MEASUREMENT DINH_stFId.FId_NSHTDAmbT "Inhibit Status of FIds / Status of function identifier FId_NSHTDAmbT" UWORD DFC_OneToOne 1 100 0.00 65535.00 FORMAT "%8.2" ECU_ADDRESS 0x6000DEFE /end MEASUREMENT
/begin MEASUREMENT DINH_stFId.FId_NSHTDEngT "Inhibit Status of FIds / Status of function identifier FId_NSHTDEngT" UWORD DFC_OneToOne 1 100 0.00 65535.00 FORMAT "%8.2" ECU_ADDRESS 0x6000DF00 /end MEASUREMENT
/begin MEASUREMENT DINH_stFId.FId_NSHTILimHiAltiLoIdleSp "Inhibit Status of FIds / Status of function identifier FId_NSHTILimHiAltiLoIdleSp" UWORD DFC_OneToOne 1 100 0.00 65535.00 FORMAT "%8.2" ECU_ADDRESS 0x6000DF02 /end MEASUREMENT
/begin MEASUREMENT DINH_stFId.FId_O2StorgMdlMD "Inhibit Status of FIds / Status of function identifier FId_O2StorgMdlMD" UWORD DFC_OneToOne 1 100 0.00 65535.00 FORMAT "%8.2" ECU_ADDRESS 0x6000DF04 /end MEASUREMENT
/begin MEASUREMENT DINH_stFId.FId_OilCmbdSen_LvlDfctHW "Inhibit Status of FIds / Status of function identifier FId_OilCmbdSen_LvlDfctHW" UWORD DFC_OneToOne 1 100 0.00 65535.00 FORMAT "%8.2" ECU_ADDRESS 0x6000DF06 /end MEASUREMENT
/begin MEASUREMENT DINH_stFId.FId_OilSwmpTCEngDsTWrmUp "Inhibit Status of FIds / Status of function identifier FId_OilSwmpTCEngDsTWrmUp" UWORD DFC_OneToOne 1 100 0.00 65535.00 FORMAT "%8.2" ECU_ADDRESS 0x6000DF08 /end MEASUREMENT
/begin MEASUREMENT DINH_stFId.FId_OilSwmpT_B_tospg "Inhibit Status of FIds / Status of function identifier FId_OilSwmpT_B_tospg" UWORD DFC_OneToOne 1 100 0.00 65535.00 FORMAT "%8.2" ECU_ADDRESS 0x6000DF0A /end MEASUREMENT
/begin MEASUREMENT DINH_stFId.FId_OilSwmpT_B_tospgg "Inhibit Status of FIds / Status of function identifier FId_OilSwmpT_B_tospgg" UWORD DFC_OneToOne 1 100 0.00 65535.00 FORMAT "%8.2" ECU_ADDRESS 0x6000DF0C /end MEASUREMENT
/begin MEASUREMENT DINH_stFId.FId_OilSwmpT_CmbdSnsrErr "Inhibit Status of FIds / Status of function identifier FId_OilSwmpT_CmbdSnsrErr" UWORD DFC_OneToOne 1 100 0.00 65535.00 FORMAT "%8.2" ECU_ADDRESS 0x6000DF0E /end MEASUREMENT
/begin MEASUREMENT DINH_stFId.FId_OilSwmpT_CmbdSnsrTiTErr "Inhibit Status of FIds / Status of function identifier FId_OilSwmpT_CmbdSnsrTiTErr" UWORD DFC_OneToOne 1 100 0.00 65535.00 FORMAT "%8.2" ECU_ADDRESS 0x6000DF10 /end MEASUREMENT
/begin MEASUREMENT DINH_stFId.FId_OilSwmpT_EnvT "Inhibit Status of FIds / Status of function identifier FId_OilSwmpT_EnvT" UWORD DFC_OneToOne 1 100 0.00 65535.00 FORMAT "%8.2" ECU_ADDRESS 0x6000DF12 /end MEASUREMENT
/begin MEASUREMENT DINH_stFId.FId_OilSwmpT_TSnsrErr "Inhibit Status of FIds / Status of function identifier FId_OilSwmpT_TSnsrErr" UWORD DFC_OneToOne 1 100 0.00 65535.00 FORMAT "%8.2" ECU_ADDRESS 0x6000DF14 /end MEASUREMENT
/begin MEASUREMENT DINH_stFId.FId_PEnvMeasVld "Inhibit Status of FIds / Status of function identifier FId_PEnvMeasVld" UWORD DFC_OneToOne 1 100 0.00 65535.00 FORMAT "%8.2" ECU_ADDRESS 0x6000DF16 /end MEASUREMENT
/begin MEASUREMENT DINH_stFId.FId_PEnvModel "Inhibit Status of FIds / Status of function identifier FId_PEnvModel" UWORD DFC_OneToOne 1 100 0.00 65535.00 FORMAT "%8.2" ECU_ADDRESS 0x6000DF18 /end MEASUREMENT
/begin MEASUREMENT DINH_stFId.FId_PEnvPlausDiagVDD "Inhibit Status of FIds / Status of function identifier FId_PEnvPlausDiagVDD" UWORD DFC_OneToOne 1 100 0.00 65535.00 FORMAT "%8.2" ECU_ADDRESS 0x6000DF1A /end MEASUREMENT
/begin MEASUREMENT DINH_stFId.FId_PEnvRawVldVDD "Inhibit Status of FIds / Status of function identifier FId_PEnvRawVldVDD" UWORD DFC_OneToOne 1 100 0.00 65535.00 FORMAT "%8.2" ECU_ADDRESS 0x6000DF1C /end MEASUREMENT
/begin MEASUREMENT DINH_stFId.FId_PEnvRefSnsr "Inhibit Status of FIds / Status of function identifier FId_PEnvRefSnsr" UWORD DFC_OneToOne 1 100 0.00 65535.00 FORMAT "%8.2" ECU_ADDRESS 0x6000DF1E /end MEASUREMENT
/begin MEASUREMENT DINH_stFId.FId_PEnvSigRngVld "Inhibit Status of FIds / Status of function identifier FId_PEnvSigRngVld" UWORD DFC_OneToOne 1 100 0.00 65535.00 FORMAT "%8.2" ECU_ADDRESS 0x6000DF20 /end MEASUREMENT
/begin MEASUREMENT DINH_stFId.FId_PEnvSnsrPlausVDD "Inhibit Status of FIds / Status of function identifier FId_PEnvSnsrPlausVDD" UWORD DFC_OneToOne 1 100 0.00 65535.00 FORMAT "%8.2" ECU_ADDRESS 0x6000DF22 /end MEASUREMENT
/begin MEASUREMENT DINH_stFId.FId_PEnvVldVDD "Inhibit Status of FIds / Status of function identifier FId_PEnvVldVDD" UWORD DFC_OneToOne 1 100 0.00 65535.00 FORMAT "%8.2" ECU_ADDRESS 0x6000DF24 /end MEASUREMENT
/begin MEASUREMENT DINH_stFId.FId_PIDA6SigSrcErr "Inhibit Status of FIds / Status of function identifier FId_PIDA6SigSrcErr" UWORD DFC_OneToOne 1 100 0.00 65535.00 FORMAT "%8.2" ECU_ADDRESS 0x6000DF26 /end MEASUREMENT
/begin MEASUREMENT DINH_stFId.FId_PIntkMnfldPlaus "Inhibit Status of FIds / Status of function identifier FId_PIntkMnfldPlaus" UWORD DFC_OneToOne 1 100 0.00 65535.00 FORMAT "%8.2" ECU_ADDRESS 0x6000DF28 /end MEASUREMENT
/begin MEASUREMENT DINH_stFId.FId_PIntkVUsElecDiagB1 "Inhibit Status of FIds / Status of function identifier FId_PIntkVUsElecDiagB1" UWORD DFC_OneToOne 1 100 0.00 65535.00 FORMAT "%8.2" ECU_ADDRESS 0x6000DF2A /end MEASUREMENT
/begin MEASUREMENT DINH_stFId.FId_PSPCtlDisbl "Inhibit Status of FIds / Status of function identifier FId_PSPCtlDisbl" UWORD DFC_OneToOne 1 100 0.00 65535.00 FORMAT "%8.2" ECU_ADDRESS 0x6000DF2C /end MEASUREMENT
/begin MEASUREMENT DINH_stFId.FId_PSPCtlPreRun "Inhibit Status of FIds / Status of function identifier FId_PSPCtlPreRun" UWORD DFC_OneToOne 1 100 0.00 65535.00 FORMAT "%8.2" ECU_ADDRESS 0x6000DF2E /end MEASUREMENT
/begin MEASUREMENT DINH_stFId.FId_PSPDiagDisbl "Inhibit Status of FIds / Status of function identifier FId_PSPDiagDisbl" UWORD DFC_OneToOne 1 100 0.00 65535.00 FORMAT "%8.2" ECU_ADDRESS 0x6000DF30 /end MEASUREMENT
/begin MEASUREMENT DINH_stFId.FId_PTGripConv "Inhibit Status of FIds / Status of function identifier FId_PTGripConv" UWORD DFC_OneToOne 1 100 0.00 65535.00 FORMAT "%8.2" ECU_ADDRESS 0x6000DF32 /end MEASUREMENT
/begin MEASUREMENT DINH_stFId.FId_PTGripConvStrt "Inhibit Status of FIds / Status of function identifier FId_PTGripConvStrt" UWORD DFC_OneToOne 1 100 0.00 65535.00 FORMAT "%8.2" ECU_ADDRESS 0x6000DF34 /end MEASUREMENT
/begin MEASUREMENT DINH_stFId.FId_PTGripMnlClth "Inhibit Status of FIds / Status of function identifier FId_PTGripMnlClth" UWORD DFC_OneToOne 1 100 0.00 65535.00 FORMAT "%8.2" ECU_ADDRESS 0x6000DF36 /end MEASUREMENT
/begin MEASUREMENT DINH_stFId.FId_PTGripMnlClthStrt "Inhibit Status of FIds / Status of function identifier FId_PTGripMnlClthStrt" UWORD DFC_OneToOne 1 100 0.00 65535.00 FORMAT "%8.2" ECU_ADDRESS 0x6000DF38 /end MEASUREMENT
/begin MEASUREMENT DINH_stFId.FId_PTTrqRatCANPtd "Inhibit Status of FIds / Status of function identifier FId_PTTrqRatCANPtd" UWORD DFC_OneToOne 1 100 0.00 65535.00 FORMAT "%8.2" ECU_ADDRESS 0x6000DF3A /end MEASUREMENT
/begin MEASUREMENT DINH_stFId.FId_PThrVlVUsVldB1 "Inhibit Status of FIds / Status of function identifier FId_PThrVlVUsVldB1" UWORD DFC_OneToOne 1 100 0.00 65535.00 FORMAT "%8.2" ECU_ADDRESS 0x6000DF3C /end MEASUREMENT
/begin MEASUREMENT DINH_stFId.FId_PThrVlvUsMeasdVldB1 "Inhibit Status of FIds / Status of function identifier FId_PThrVlvUsMeasdVldB1" UWORD DFC_OneToOne 1 100 0.00 65535.00 FORMAT "%8.2" ECU_ADDRESS 0x6000DF3E /end MEASUREMENT
/begin MEASUREMENT DINH_stFId.FId_P_VSE11_Diag "Inhibit Status of FIds / Status of function identifier FId_P_VSE11_Diag" UWORD DFC_OneToOne 1 100 0.00 65535.00 FORMAT "%8.2" ECU_ADDRESS 0x6000DF40 /end MEASUREMENT
/begin MEASUREMENT DINH_stFId.FId_PrmId03_FltRdnS1B1 "Inhibit Status of FIds / Status of function identifier FId_PrmId03_FltRdnS1B1" UWORD DFC_OneToOne 1 100 0.00 65535.00 FORMAT "%8.2" ECU_ADDRESS 0x6000DF42 /end MEASUREMENT
/begin MEASUREMENT DINH_stFId.FId_PrmId03_FltUegoS1B1 "Inhibit Status of FIds / Status of function identifier FId_PrmId03_FltUegoS1B1" UWORD DFC_OneToOne 1 100 0.00 65535.00 FORMAT "%8.2" ECU_ADDRESS 0x6000DF44 /end MEASUREMENT
/begin MEASUREMENT DINH_stFId.FId_SSEEPBRelease "Inhibit Status of FIds / Status of function identifier FId_SSEEPBRelease" UWORD DFC_OneToOne 1 100 0.00 65535.00 FORMAT "%8.2" ECU_ADDRESS 0x6000DF46 /end MEASUREMENT
/begin MEASUREMENT DINH_stFId.FId_SSEFCANPRelease "Inhibit Status of FIds / Status of function identifier FId_SSEFCANPRelease" UWORD DFC_OneToOne 1 100 0.00 65535.00 FORMAT "%8.2" ECU_ADDRESS 0x6000DF48 /end MEASUREMENT
/begin MEASUREMENT DINH_stFId.FId_SSEPTCANPRelease "Inhibit Status of FIds / Status of function identifier FId_SSEPTCANPRelease" UWORD DFC_OneToOne 1 100 0.00 65535.00 FORMAT "%8.2" ECU_ADDRESS 0x6000DF4A /end MEASUREMENT
/begin MEASUREMENT DINH_stFId.FId_SSEStartRelease "Inhibit Status of FIds / Status of function identifier FId_SSEStartRelease" UWORD DFC_OneToOne 1 100 0.00 65535.00 FORMAT "%8.2" ECU_ADDRESS 0x6000DF4C /end MEASUREMENT
/begin MEASUREMENT DINH_stFId.FId_SSEStartReleaseMTCl10 "Inhibit Status of FIds / Status of function identifier FId_SSEStartReleaseMTCl10" UWORD DFC_OneToOne 1 100 0.00 65535.00 FORMAT "%8.2" ECU_ADDRESS 0x6000DF4E /end MEASUREMENT
/begin MEASUREMENT DINH_stFId.FId_SSEStartReleaseMTCl100 "Inhibit Status of FIds / Status of function identifier FId_SSEStartReleaseMTCl100" UWORD DFC_OneToOne 1 100 0.00 65535.00 FORMAT "%8.2" ECU_ADDRESS 0x6000DF50 /end MEASUREMENT
/begin MEASUREMENT DINH_stFId.FId_SSEStartReleaseMTCl20 "Inhibit Status of FIds / Status of function identifier FId_SSEStartReleaseMTCl20" UWORD DFC_OneToOne 1 100 0.00 65535.00 FORMAT "%8.2" ECU_ADDRESS 0x6000DF52 /end MEASUREMENT
/begin MEASUREMENT DINH_stFId.FId_SSEStartReleaseMTCl90 "Inhibit Status of FIds / Status of function identifier FId_SSEStartReleaseMTCl90" UWORD DFC_OneToOne 1 100 0.00 65535.00 FORMAT "%8.2" ECU_ADDRESS 0x6000DF54 /end MEASUREMENT
/begin MEASUREMENT DINH_stFId.FId_SSEStartRequest "Inhibit Status of FIds / Status of function identifier FId_SSEStartRequest" UWORD DFC_OneToOne 1 100 0.00 65535.00 FORMAT "%8.2" ECU_ADDRESS 0x6000DF56 /end MEASUREMENT
/begin MEASUREMENT DINH_stFId.FId_SSEStopRelease "Inhibit Status of FIds / Status of function identifier FId_SSEStopRelease" UWORD DFC_OneToOne 1 100 0.00 65535.00 FORMAT "%8.2" ECU_ADDRESS 0x6000DF58 /end MEASUREMENT
/begin MEASUREMENT DINH_stFId.FId_SSEStrtStopRelease "Inhibit Status of FIds / Status of function identifier FId_SSEStrtStopRelease" UWORD DFC_OneToOne 1 100 0.00 65535.00 FORMAT "%8.2" ECU_ADDRESS 0x6000DF5A /end MEASUREMENT
/begin MEASUREMENT DINH_stFId.FId_SSESysOff "Inhibit Status of FIds / Status of function identifier FId_SSESysOff" UWORD DFC_OneToOne 1 100 0.00 65535.00 FORMAT "%8.2" ECU_ADDRESS 0x6000DF5C /end MEASUREMENT
/begin MEASUREMENT DINH_stFId.FId_SSEUI2DCSysFailr "Inhibit Status of FIds / Status of function identifier FId_SSEUI2DCSysFailr" UWORD DFC_OneToOne 1 100 0.00 65535.00 FORMAT "%8.2" ECU_ADDRESS 0x6000DF5E /end MEASUREMENT
/begin MEASUREMENT DINH_stFId.FId_SSEUIBCANErr "Inhibit Status of FIds / Status of function identifier FId_SSEUIBCANErr" UWORD DFC_OneToOne 1 100 0.00 65535.00 FORMAT "%8.2" ECU_ADDRESS 0x6000DF60 /end MEASUREMENT
/begin MEASUREMENT DINH_stFId.FId_SSEUISysFail "Inhibit Status of FIds / Status of function identifier FId_SSEUISysFail" UWORD DFC_OneToOne 1 100 0.00 65535.00 FORMAT "%8.2" ECU_ADDRESS 0x6000DF62 /end MEASUREMENT
/begin MEASUREMENT DINH_stFId.FId_SiaEEPErr "Inhibit Status of FIds / Status of function identifier FId_SiaEEPErr" UWORD DFC_OneToOne 1 100 0.00 65535.00 FORMAT "%8.2" ECU_ADDRESS 0x6000DF64 /end MEASUREMENT
/begin MEASUREMENT DINH_stFId.FId_StrtCrkSnsrFailr "Inhibit Status of FIds / Status of function identifier FId_StrtCrkSnsrFailr" UWORD DFC_OneToOne 1 100 0.00 65535.00 FORMAT "%8.2" ECU_ADDRESS 0x6000DF66 /end MEASUREMENT
/begin MEASUREMENT DINH_stFId.FId_StrtCtlAutoCrkModeCdn "Inhibit Status of FIds / Status of function identifier FId_StrtCtlAutoCrkModeCdn" UWORD DFC_OneToOne 1 100 0.00 65535.00 FORMAT "%8.2" ECU_ADDRESS 0x6000DF68 /end MEASUREMENT
/begin MEASUREMENT DINH_stFId.FId_StrtCtlComEngStrtErr "Inhibit Status of FIds / Status of function identifier FId_StrtCtlComEngStrtErr" UWORD DFC_OneToOne 1 100 0.00 65535.00 FORMAT "%8.2" ECU_ADDRESS 0x6000DF6A /end MEASUREMENT
/begin MEASUREMENT DINH_stFId.FId_StrtCtlNPCdnCncl "Inhibit Status of FIds / Status of function identifier FId_StrtCtlNPCdnCncl" UWORD DFC_OneToOne 1 100 0.00 65535.00 FORMAT "%8.2" ECU_ADDRESS 0x6000DF6C /end MEASUREMENT
/begin MEASUREMENT DINH_stFId.FId_StrtCtlNoCpuFailr "Inhibit Status of FIds / Status of function identifier FId_StrtCtlNoCpuFailr" UWORD DFC_OneToOne 1 100 0.00 65535.00 FORMAT "%8.2" ECU_ADDRESS 0x6000DF6E /end MEASUREMENT
/begin MEASUREMENT DINH_stFId.FId_StrtCtlNoFailCanLine "Inhibit Status of FIds / Status of function identifier FId_StrtCtlNoFailCanLine" UWORD DFC_OneToOne 1 100 0.00 65535.00 FORMAT "%8.2" ECU_ADDRESS 0x6000DF70 /end MEASUREMENT
/begin MEASUREMENT DINH_stFId.FId_StrtCtlNoFailPTCanLine "Inhibit Status of FIds / Status of function identifier FId_StrtCtlNoFailPTCanLine" UWORD DFC_OneToOne 1 100 0.00 65535.00 FORMAT "%8.2" ECU_ADDRESS 0x6000DF72 /end MEASUREMENT
/begin MEASUREMENT DINH_stFId.FId_StrtCtlNoTCUFail "Inhibit Status of FIds / Status of function identifier FId_StrtCtlNoTCUFail" UWORD DFC_OneToOne 1 100 0.00 65535.00 FORMAT "%8.2" ECU_ADDRESS 0x6000DF74 /end MEASUREMENT
/begin MEASUREMENT DINH_stFId.FId_StrtCtlPNPosnSubsVal "Inhibit Status of FIds / Status of function identifier FId_StrtCtlPNPosnSubsVal" UWORD DFC_OneToOne 1 100 0.00 65535.00 FORMAT "%8.2" ECU_ADDRESS 0x6000DF76 /end MEASUREMENT
/begin MEASUREMENT DINH_stFId.FId_StrtCtlSTMFailr "Inhibit Status of FIds / Status of function identifier FId_StrtCtlSTMFailr" UWORD DFC_OneToOne 1 100 0.00 65535.00 FORMAT "%8.2" ECU_ADDRESS 0x6000DF78 /end MEASUREMENT
/begin MEASUREMENT DINH_stFId.FId_StrtErrShaft "Inhibit Status of FIds / Status of function identifier FId_StrtErrShaft" UWORD DFC_OneToOne 1 100 0.00 65535.00 FORMAT "%8.2" ECU_ADDRESS 0x6000DF7A /end MEASUREMENT
/begin MEASUREMENT DINH_stFId.FId_StrtrRlyFailr "Inhibit Status of FIds / Status of function identifier FId_StrtrRlyFailr" UWORD DFC_OneToOne 1 100 0.00 65535.00 FORMAT "%8.2" ECU_ADDRESS 0x6000DF7C /end MEASUREMENT
/begin MEASUREMENT DINH_stFId.FId_SumErrHndlg "Inhibit Status of FIds / Status of function identifier FId_SumErrHndlg" UWORD DFC_OneToOne 1 100 0.00 65535.00 FORMAT "%8.2" ECU_ADDRESS 0x6000DF7E /end MEASUREMENT
/begin MEASUREMENT DINH_stFId.FId_SysDiagComErr "Inhibit Status of FIds / Status of function identifier FId_SysDiagComErr" UWORD DFC_OneToOne 1 100 0.00 65535.00 FORMAT "%8.2" ECU_ADDRESS 0x6000DF80 /end MEASUREMENT
/begin MEASUREMENT DINH_stFId.FId_SysDiagModInhbErr "Inhibit Status of FIds / Status of function identifier FId_SysDiagModInhbErr" UWORD DFC_OneToOne 1 100 0.00 65535.00 FORMAT "%8.2" ECU_ADDRESS 0x6000DF82 /end MEASUREMENT
/begin MEASUREMENT DINH_stFId.FId_TOSPM "Inhibit Status of FIds / Status of function identifier FId_TOSPM" UWORD DFC_OneToOne 1 100 0.00 65535.00 FORMAT "%8.2" ECU_ADDRESS 0x6000DF84 /end MEASUREMENT
/begin MEASUREMENT DINH_stFId.FId_TWCCILckExtd "Inhibit Status of FIds / Status of function identifier FId_TWCCILckExtd" UWORD DFC_OneToOne 1 100 0.00 65535.00 FORMAT "%8.2" ECU_ADDRESS 0x6000DF86 /end MEASUREMENT
/begin MEASUREMENT DINH_stFId.FId_TWCCIRstB1 "Inhibit Status of FIds / Status of function identifier FId_TWCCIRstB1" UWORD DFC_OneToOne 1 100 0.00 65535.00 FORMAT "%8.2" ECU_ADDRESS 0x6000DF88 /end MEASUREMENT
/begin MEASUREMENT DINH_stFId.FId_TWCCIRstDSMClearB1 "Inhibit Status of FIds / Status of function identifier FId_TWCCIRstDSMClearB1" UWORD DFC_OneToOne 1 100 0.00 65535.00 FORMAT "%8.2" ECU_ADDRESS 0x6000DF8A /end MEASUREMENT
/begin MEASUREMENT DINH_stFId.FId_TWCCLsuB1 "Inhibit Status of FIds / Status of function identifier FId_TWCCLsuB1" UWORD DFC_OneToOne 1 100 0.00 65535.00 FORMAT "%8.2" ECU_ADDRESS 0x6000DF8C /end MEASUREMENT
/begin MEASUREMENT DINH_stFId.FId_TWCCLsuCyc "Inhibit Status of FIds / Status of function identifier FId_TWCCLsuCyc" UWORD DFC_OneToOne 1 100 0.00 65535.00 FORMAT "%8.2" ECU_ADDRESS 0x6000DF8E /end MEASUREMENT
/begin MEASUREMENT DINH_stFId.FId_TWCCLsuDynB1 "Inhibit Status of FIds / Status of function identifier FId_TWCCLsuDynB1" UWORD DFC_OneToOne 1 100 0.00 65535.00 FORMAT "%8.2" ECU_ADDRESS 0x6000DF90 /end MEASUREMENT
/begin MEASUREMENT DINH_stFId.FId_TWCCMisfDetn "Inhibit Status of FIds / Status of function identifier FId_TWCCMisfDetn" UWORD DFC_OneToOne 1 100 0.00 65535.00 FORMAT "%8.2" ECU_ADDRESS 0x6000DF92 /end MEASUREMENT
/begin MEASUREMENT DINH_stFId.FId_TWCDPriCatParB1 "Inhibit Status of FIds / Status of function identifier FId_TWCDPriCatParB1" UWORD DFC_OneToOne 1 100 0.00 65535.00 FORMAT "%8.2" ECU_ADDRESS 0x6000DF94 /end MEASUREMENT
/begin MEASUREMENT DINH_stFId.FId_TWCDPriCatVldnB1 "Inhibit Status of FIds / Status of function identifier FId_TWCDPriCatVldnB1" UWORD DFC_OneToOne 1 100 0.00 65535.00 FORMAT "%8.2" ECU_ADDRESS 0x6000DF96 /end MEASUREMENT
/begin MEASUREMENT DINH_stFId.FId_ThrVlvMon "Inhibit Status of FIds / Status of function identifier FId_ThrVlvMon" UWORD DFC_OneToOne 1 100 0.00 65535.00 FORMAT "%8.2" ECU_ADDRESS 0x6000DF98 /end MEASUREMENT
/begin MEASUREMENT DINH_stFId.FId_ThrVlvOffsLrnPrmsB1 "Inhibit Status of FIds / Status of function identifier FId_ThrVlvOffsLrnPrmsB1" UWORD DFC_OneToOne 1 100 0.00 65535.00 FORMAT "%8.2" ECU_ADDRESS 0x6000DF9A /end MEASUREMENT
/begin MEASUREMENT DINH_stFId.FId_TiOffTBasdChkFast "Inhibit Status of FIds / Status of function identifier FId_TiOffTBasdChkFast" UWORD DFC_OneToOne 1 100 0.00 65535.00 FORMAT "%8.2" ECU_ADDRESS 0x6000DF9C /end MEASUREMENT
/begin MEASUREMENT DINH_stFId.FId_TiOffTBasdChkSlow "Inhibit Status of FIds / Status of function identifier FId_TiOffTBasdChkSlow" UWORD DFC_OneToOne 1 100 0.00 65535.00 FORMAT "%8.2" ECU_ADDRESS 0x6000DF9E /end MEASUREMENT
/begin MEASUREMENT DINH_stFId.FId_TiOffVdClk "Inhibit Status of FIds / Status of function identifier FId_TiOffVdClk" UWORD DFC_OneToOne 1 100 0.00 65535.00 FORMAT "%8.2" ECU_ADDRESS 0x6000DFA0 /end MEASUREMENT
/begin MEASUREMENT DINH_stFId.FId_TqDecelOffsInhb "Inhibit Status of FIds / Status of function identifier FId_TqDecelOffsInhb" UWORD DFC_OneToOne 1 100 0.00 65535.00 FORMAT "%8.2" ECU_ADDRESS 0x6000DFA2 /end MEASUREMENT
/begin MEASUREMENT DINH_stFId.FId_TraAddAirCANPtd "Inhibit Status of FIds / Status of function identifier FId_TraAddAirCANPtd" UWORD DFC_OneToOne 1 100 0.00 65535.00 FORMAT "%8.2" ECU_ADDRESS 0x6000DFA4 /end MEASUREMENT
/begin MEASUREMENT DINH_stFId.FId_TraAddClntCANPtd "Inhibit Status of FIds / Status of function identifier FId_TraAddClntCANPtd" UWORD DFC_OneToOne 1 100 0.00 65535.00 FORMAT "%8.2" ECU_ADDRESS 0x6000DFA6 /end MEASUREMENT
/begin MEASUREMENT DINH_stFId.FId_TraFwdRvsCluInfo "Inhibit Status of FIds / Status of function identifier FId_TraFwdRvsCluInfo" UWORD DFC_OneToOne 1 100 0.00 65535.00 FORMAT "%8.2" ECU_ADDRESS 0x6000DFA8 /end MEASUREMENT
/begin MEASUREMENT DINH_stFId.FId_TraGbxNPos "Inhibit Status of FIds / Status of function identifier FId_TraGbxNPos" UWORD DFC_OneToOne 1 100 0.00 65535.00 FORMAT "%8.2" ECU_ADDRESS 0x6000DFAA /end MEASUREMENT
/begin MEASUREMENT DINH_stFId.FId_TraGearInfoCanCom "Inhibit Status of FIds / Status of function identifier FId_TraGearInfoCanCom" UWORD DFC_OneToOne 1 100 0.00 65535.00 FORMAT "%8.2" ECU_ADDRESS 0x6000DFAC /end MEASUREMENT
/begin MEASUREMENT DINH_stFId.FId_TraGearInfoDet "Inhibit Status of FIds / Status of function identifier FId_TraGearInfoDet" UWORD DFC_OneToOne 1 100 0.00 65535.00 FORMAT "%8.2" ECU_ADDRESS 0x6000DFAE /end MEASUREMENT
/begin MEASUREMENT DINH_stFId.FId_TraGearInfoGearShftActv "Inhibit Status of FIds / Status of function identifier FId_TraGearInfoGearShftActv" UWORD DFC_OneToOne 1 100 0.00 65535.00 FORMAT "%8.2" ECU_ADDRESS 0x6000DFB0 /end MEASUREMENT
/begin MEASUREMENT DINH_stFId.FId_TraGearInfoInfoCan "Inhibit Status of FIds / Status of function identifier FId_TraGearInfoInfoCan" UWORD DFC_OneToOne 1 100 0.00 65535.00 FORMAT "%8.2" ECU_ADDRESS 0x6000DFB2 /end MEASUREMENT
/begin MEASUREMENT DINH_stFId.FId_TraGearInfoLevPos "Inhibit Status of FIds / Status of function identifier FId_TraGearInfoLevPos" UWORD DFC_OneToOne 1 100 0.00 65535.00 FORMAT "%8.2" ECU_ADDRESS 0x6000DFB4 /end MEASUREMENT
/begin MEASUREMENT DINH_stFId.FId_TraGearInfoLoRng "Inhibit Status of FIds / Status of function identifier FId_TraGearInfoLoRng" UWORD DFC_OneToOne 1 100 0.00 65535.00 FORMAT "%8.2" ECU_ADDRESS 0x6000DFB6 /end MEASUREMENT
/begin MEASUREMENT DINH_stFId.FId_TraGearInfoRTra "Inhibit Status of FIds / Status of function identifier FId_TraGearInfoRTra" UWORD DFC_OneToOne 1 100 0.00 65535.00 FORMAT "%8.2" ECU_ADDRESS 0x6000DFB8 /end MEASUREMENT
/begin MEASUREMENT DINH_stFId.FId_TraGearInfoRevGear "Inhibit Status of FIds / Status of function identifier FId_TraGearInfoRevGear" UWORD DFC_OneToOne 1 100 0.00 65535.00 FORMAT "%8.2" ECU_ADDRESS 0x6000DFBA /end MEASUREMENT
/begin MEASUREMENT DINH_stFId.FId_TraGearReq "Inhibit Status of FIds / Status of function identifier FId_TraGearReq" UWORD DFC_OneToOne 1 100 0.00 65535.00 FORMAT "%8.2" ECU_ADDRESS 0x6000DFBC /end MEASUREMENT
/begin MEASUREMENT DINH_stFId.FId_TraNoShftIdctr "Inhibit Status of FIds / Status of function identifier FId_TraNoShftIdctr" UWORD DFC_OneToOne 1 100 0.00 65535.00 FORMAT "%8.2" ECU_ADDRESS 0x6000DFBE /end MEASUREMENT
/begin MEASUREMENT DINH_stFId.FId_TraPrtGearCANPtd "Inhibit Status of FIds / Status of function identifier FId_TraPrtGearCANPtd" UWORD DFC_OneToOne 1 100 0.00 65535.00 FORMAT "%8.2" ECU_ADDRESS 0x6000DFC0 /end MEASUREMENT
/begin MEASUREMENT DINH_stFId.FId_TraPrtGearIndpdtProblem "Inhibit Status of FIds / Status of function identifier FId_TraPrtGearIndpdtProblem" UWORD DFC_OneToOne 1 100 0.00 65535.00 FORMAT "%8.2" ECU_ADDRESS 0x6000DFC2 /end MEASUREMENT
/begin MEASUREMENT DINH_stFId.FId_TraRPosn "Inhibit Status of FIds / Status of function identifier FId_TraRPosn" UWORD DFC_OneToOne 1 100 0.00 65535.00 FORMAT "%8.2" ECU_ADDRESS 0x6000DFC4 /end MEASUREMENT
/begin MEASUREMENT DINH_stFId.FId_TraRtnIntfcASTIntv "Inhibit Status of FIds / Status of function identifier FId_TraRtnIntfcASTIntv" UWORD DFC_OneToOne 1 100 0.00 65535.00 FORMAT "%8.2" ECU_ADDRESS 0x6000DFC6 /end MEASUREMENT
/begin MEASUREMENT DINH_stFId.FId_TraRtnIntfcIdlSetP "Inhibit Status of FIds / Status of function identifier FId_TraRtnIntfcIdlSetP" UWORD DFC_OneToOne 1 100 0.00 65535.00 FORMAT "%8.2" ECU_ADDRESS 0x6000DFC8 /end MEASUREMENT
/begin MEASUREMENT DINH_stFId.FId_TraRtnIntfcNMaxCan "Inhibit Status of FIds / Status of function identifier FId_TraRtnIntfcNMaxCan" UWORD DFC_OneToOne 1 100 0.00 65535.00 FORMAT "%8.2" ECU_ADDRESS 0x6000DFCA /end MEASUREMENT
/begin MEASUREMENT DINH_stFId.FId_TraRtnIntfcNMaxVel "Inhibit Status of FIds / Status of function identifier FId_TraRtnIntfcNMaxVel" UWORD DFC_OneToOne 1 100 0.00 65535.00 FORMAT "%8.2" ECU_ADDRESS 0x6000DFCC /end MEASUREMENT
/begin MEASUREMENT DINH_stFId.FId_TraTrqRedLmpHmeDec "Inhibit Status of FIds / Status of function identifier FId_TraTrqRedLmpHmeDec" UWORD DFC_OneToOne 1 100 0.00 65535.00 FORMAT "%8.2" ECU_ADDRESS 0x6000DFCE /end MEASUREMENT
/begin MEASUREMENT DINH_stFId.FId_TraTrqRedLmpHmeInc "Inhibit Status of FIds / Status of function identifier FId_TraTrqRedLmpHmeInc" UWORD DFC_OneToOne 1 100 0.00 65535.00 FORMAT "%8.2" ECU_ADDRESS 0x6000DFD0 /end MEASUREMENT
/begin MEASUREMENT DINH_stFId.FId_TraTrqRedPTCanErr "Inhibit Status of FIds / Status of function identifier FId_TraTrqRedPTCanErr" UWORD DFC_OneToOne 1 100 0.00 65535.00 FORMAT "%8.2" ECU_ADDRESS 0x6000DFD2 /end MEASUREMENT
/begin MEASUREMENT DINH_stFId.FId_TraTrqRedTIIntvDes "Inhibit Status of FIds / Status of function identifier FId_TraTrqRedTIIntvDes" UWORD DFC_OneToOne 1 100 0.00 65535.00 FORMAT "%8.2" ECU_ADDRESS 0x6000DFD4 /end MEASUREMENT
/begin MEASUREMENT DINH_stFId.FId_TraTrqRedTIIntvLead "Inhibit Status of FIds / Status of function identifier FId_TraTrqRedTIIntvLead" UWORD DFC_OneToOne 1 100 0.00 65535.00 FORMAT "%8.2" ECU_ADDRESS 0x6000DFD6 /end MEASUREMENT
/begin MEASUREMENT DINH_stFId.FId_TraTrqRedTSCIntvDes "Inhibit Status of FIds / Status of function identifier FId_TraTrqRedTSCIntvDes" UWORD DFC_OneToOne 1 100 0.00 65535.00 FORMAT "%8.2" ECU_ADDRESS 0x6000DFD8 /end MEASUREMENT
/begin MEASUREMENT DINH_stFId.FId_TraTrqRedTSCIntvLead "Inhibit Status of FIds / Status of function identifier FId_TraTrqRedTSCIntvLead" UWORD DFC_OneToOne 1 100 0.00 65535.00 FORMAT "%8.2" ECU_ADDRESS 0x6000DFDA /end MEASUREMENT
/begin MEASUREMENT DINH_stFId.FId_TraTrsmTypHw "Inhibit Status of FIds / Status of function identifier FId_TraTrsmTypHw" UWORD DFC_OneToOne 1 100 0.00 65535.00 FORMAT "%8.2" ECU_ADDRESS 0x6000DFDC /end MEASUREMENT
/begin MEASUREMENT DINH_stFId.FId_TranIdleDes "Inhibit Status of FIds / Status of function identifier FId_TranIdleDes" UWORD DFC_OneToOne 1 100 0.00 65535.00 FORMAT "%8.2" ECU_ADDRESS 0x6000DFDE /end MEASUREMENT
/begin MEASUREMENT DINH_stFId.FId_UEGODiagRelsS1B1 "Inhibit Status of FIds / Status of function identifier FId_UEGODiagRelsS1B1" UWORD DFC_OneToOne 1 100 0.00 65535.00 FORMAT "%8.2" ECU_ADDRESS 0x6000DFE0 /end MEASUREMENT
/begin MEASUREMENT DINH_stFId.FId_UEGOHeatrLrgTWinS1B1 "Inhibit Status of FIds / Status of function identifier FId_UEGOHeatrLrgTWinS1B1" UWORD DFC_OneToOne 1 100 0.00 65535.00 FORMAT "%8.2" ECU_ADDRESS 0x6000DFE2 /end MEASUREMENT
/begin MEASUREMENT DINH_stFId.FId_UEGOHeatrPwrStgDiagRelsS1B1 "Inhibit Status of FIds / Status of function identifier FId_UEGOHeatrPwrStgDiagRelsS1B1" UWORD DFC_OneToOne 1 100 0.00 65535.00 FORMAT "%8.2" ECU_ADDRESS 0x6000DFE4 /end MEASUREMENT
/begin MEASUREMENT DINH_stFId.FId_UEGOHeatrPwrStgDiagRelsSCBS1B1 "Inhibit Status of FIds / Status of function identifier FId_UEGOHeatrPwrStgDiagRelsSCBS1B1" UWORD DFC_OneToOne 1 100 0.00 65535.00 FORMAT "%8.2" ECU_ADDRESS 0x6000DFE6 /end MEASUREMENT
/begin MEASUREMENT DINH_stFId.FId_UEGOHtrCtlOffS1B1 "Inhibit Status of FIds / Status of function identifier FId_UEGOHtrCtlOffS1B1" UWORD DFC_OneToOne 1 100 0.00 65535.00 FORMAT "%8.2" ECU_ADDRESS 0x6000DFE8 /end MEASUREMENT
/begin MEASUREMENT DINH_stFId.FId_UEGOHtrCtlRedS1B1 "Inhibit Status of FIds / Status of function identifier FId_UEGOHtrCtlRedS1B1" UWORD DFC_OneToOne 1 100 0.00 65535.00 FORMAT "%8.2" ECU_ADDRESS 0x6000DFEA /end MEASUREMENT
/begin MEASUREMENT DINH_stFId.FId_UEGOHtrCtlStopS1B1 "Inhibit Status of FIds / Status of function identifier FId_UEGOHtrCtlStopS1B1" UWORD DFC_OneToOne 1 100 0.00 65535.00 FORMAT "%8.2" ECU_ADDRESS 0x6000DFEC /end MEASUREMENT
/begin MEASUREMENT DINH_stFId.FId_UEGOHtrCtlUpS1B1 "Inhibit Status of FIds / Status of function identifier FId_UEGOHtrCtlUpS1B1" UWORD DFC_OneToOne 1 100 0.00 65535.00 FORMAT "%8.2" ECU_ADDRESS 0x6000DFEE /end MEASUREMENT
/begin MEASUREMENT DINH_stFId.FId_UEGOIPmpEvlnRelsS1B1 "Inhibit Status of FIds / Status of function identifier FId_UEGOIPmpEvlnRelsS1B1" UWORD DFC_OneToOne 1 100 0.00 65535.00 FORMAT "%8.2" ECU_ADDRESS 0x6000DFF0 /end MEASUREMENT
/begin MEASUREMENT DINH_stFId.FId_UEGOIPmpTCorrnS1B1 "Inhibit Status of FIds / Status of function identifier FId_UEGOIPmpTCorrnS1B1" UWORD DFC_OneToOne 1 100 0.00 65535.00 FORMAT "%8.2" ECU_ADDRESS 0x6000DFF2 /end MEASUREMENT
/begin MEASUREMENT DINH_stFId.FId_UEGOIPmpTRelsS1B1 "Inhibit Status of FIds / Status of function identifier FId_UEGOIPmpTRelsS1B1" UWORD DFC_OneToOne 1 100 0.00 65535.00 FORMAT "%8.2" ECU_ADDRESS 0x6000DFF4 /end MEASUREMENT
/begin MEASUREMENT DINH_stFId.FId_UEGOLamRecprMdlRelsS1B1 "Inhibit Status of FIds / Status of function identifier FId_UEGOLamRecprMdlRelsS1B1" UWORD DFC_OneToOne 1 100 0.00 65535.00 FORMAT "%8.2" ECU_ADDRESS 0x6000DFF6 /end MEASUREMENT
/begin MEASUREMENT DINH_stFId.FId_UEGOLamRelsAltvS1B1 "Inhibit Status of FIds / Status of function identifier FId_UEGOLamRelsAltvS1B1" UWORD DFC_OneToOne 1 100 0.00 65535.00 FORMAT "%8.2" ECU_ADDRESS 0x6000DFF8 /end MEASUREMENT
/begin MEASUREMENT DINH_stFId.FId_UEGOLamRelsS1B1 "Inhibit Status of FIds / Status of function identifier FId_UEGOLamRelsS1B1" UWORD DFC_OneToOne 1 100 0.00 65535.00 FORMAT "%8.2" ECU_ADDRESS 0x6000DFFA /end MEASUREMENT
/begin MEASUREMENT DINH_stFId.FId_UEGOLoDiagS1B1 "Inhibit Status of FIds / Status of function identifier FId_UEGOLoDiagS1B1" UWORD DFC_OneToOne 1 100 0.00 65535.00 FORMAT "%8.2" ECU_ADDRESS 0x6000DFFC /end MEASUREMENT
/begin MEASUREMENT DINH_stFId.FId_UEGOPrmntDiagS1B1 "Inhibit Status of FIds / Status of function identifier FId_UEGOPrmntDiagS1B1" UWORD DFC_OneToOne 1 100 0.00 65535.00 FORMAT "%8.2" ECU_ADDRESS 0x6000DFFE /end MEASUREMENT
/begin MEASUREMENT DINH_stFId.FId_UEGOStrtDiagRprtErrS1B1 "Inhibit Status of FIds / Status of function identifier FId_UEGOStrtDiagRprtErrS1B1" UWORD DFC_OneToOne 1 100 0.00 65535.00 FORMAT "%8.2" ECU_ADDRESS 0x6000E000 /end MEASUREMENT
/begin MEASUREMENT DINH_stFId.FId_UEGOStrtDiagS1B1 "Inhibit Status of FIds / Status of function identifier FId_UEGOStrtDiagS1B1" UWORD DFC_OneToOne 1 100 0.00 65535.00 FORMAT "%8.2" ECU_ADDRESS 0x6000E002 /end MEASUREMENT
/begin MEASUREMENT DINH_stFId.FId_UEGOTEvlnRelsS1B1 "Inhibit Status of FIds / Status of function identifier FId_UEGOTEvlnRelsS1B1" UWORD DFC_OneToOne 1 100 0.00 65535.00 FORMAT "%8.2" ECU_ADDRESS 0x6000E004 /end MEASUREMENT
/begin MEASUREMENT DINH_stFId.FId_UegoInhbOperRelsS1B1 "Inhibit Status of FIds / Status of function identifier FId_UegoInhbOperRelsS1B1" UWORD DFC_OneToOne 1 100 0.00 65535.00 FORMAT "%8.2" ECU_ADDRESS 0x6000E006 /end MEASUREMENT
/begin MEASUREMENT DINH_stFId.FId_UegoIntrptCdnOperRelsPreEngStrt "Inhibit Status of FIds / Status of function identifier FId_UegoIntrptCdnOperRelsPreEngStrt" UWORD DFC_OneToOne 1 100 0.00 65535.00 FORMAT "%8.2" ECU_ADDRESS 0x6000E008 /end MEASUREMENT
/begin MEASUREMENT DINH_stFId.FId_UegoPlausErrHndlg "Inhibit Status of FIds / Status of function identifier FId_UegoPlausErrHndlg" UWORD DFC_OneToOne 1 100 0.00 65535.00 FORMAT "%8.2" ECU_ADDRESS 0x6000E00A /end MEASUREMENT
/begin MEASUREMENT DINH_stFId.FId_UegoSigAvailS1B1 "Inhibit Status of FIds / Status of function identifier FId_UegoSigAvailS1B1" UWORD DFC_OneToOne 1 100 0.00 65535.00 FORMAT "%8.2" ECU_ADDRESS 0x6000E00C /end MEASUREMENT
/begin MEASUREMENT DINH_stFId.FId_VMSIDCSRmpShOff "Inhibit Status of FIds / Status of function identifier FId_VMSIDCSRmpShOff" UWORD DFC_OneToOne 1 100 0.00 65535.00 FORMAT "%8.2" ECU_ADDRESS 0x6000E00E /end MEASUREMENT
/begin MEASUREMENT DINH_stFId.FId_VMSIDCSShOff "Inhibit Status of FIds / Status of function identifier FId_VMSIDCSShOff" UWORD DFC_OneToOne 1 100 0.00 65535.00 FORMAT "%8.2" ECU_ADDRESS 0x6000E010 /end MEASUREMENT
/begin MEASUREMENT DINH_stFId.FId_VMSITCSRmpShOff "Inhibit Status of FIds / Status of function identifier FId_VMSITCSRmpShOff" UWORD DFC_OneToOne 1 100 0.00 65535.00 FORMAT "%8.2" ECU_ADDRESS 0x6000E012 /end MEASUREMENT
/begin MEASUREMENT DINH_stFId.FId_VMSITCSShOff "Inhibit Status of FIds / Status of function identifier FId_VMSITCSShOff" UWORD DFC_OneToOne 1 100 0.00 65535.00 FORMAT "%8.2" ECU_ADDRESS 0x6000E014 /end MEASUREMENT
/begin MEASUREMENT DINH_stFId.FId_VSACANErr "Inhibit Status of FIds / Status of function identifier FId_VSACANErr" UWORD DFC_OneToOne 1 100 0.00 65535.00 FORMAT "%8.2" ECU_ADDRESS 0x6000E016 /end MEASUREMENT
/begin MEASUREMENT DINH_stFId.FId_VehStcDCDCFailr "Inhibit Status of FIds / Status of function identifier FId_VehStcDCDCFailr" UWORD DFC_OneToOne 1 100 0.00 65535.00 FORMAT "%8.2" ECU_ADDRESS 0x6000E018 /end MEASUREMENT
/begin MEASUREMENT DINH_stFId.FId_VehStcMisf "Inhibit Status of FIds / Status of function identifier FId_VehStcMisf" UWORD DFC_OneToOne 1 100 0.00 65535.00 FORMAT "%8.2" ECU_ADDRESS 0x6000E01A /end MEASUREMENT
/begin MEASUREMENT DINH_stFId.FId_VehVCANFrzVal "Inhibit Status of FIds / Status of function identifier FId_VehVCANFrzVal" UWORD DFC_OneToOne 1 100 0.00 65535.00 FORMAT "%8.2" ECU_ADDRESS 0x6000E01C /end MEASUREMENT
/begin MEASUREMENT DINH_stFId.FId_VehVCANReplVal "Inhibit Status of FIds / Status of function identifier FId_VehVCANReplVal" UWORD DFC_OneToOne 1 100 0.00 65535.00 FORMAT "%8.2" ECU_ADDRESS 0x6000E01E /end MEASUREMENT
/begin MEASUREMENT DINH_stFId.FId_VehVCanSafeFrzVal "Inhibit Status of FIds / Status of function identifier FId_VehVCanSafeFrzVal" UWORD DFC_OneToOne 1 100 0.00 65535.00 FORMAT "%8.2" ECU_ADDRESS 0x6000E020 /end MEASUREMENT
/begin MEASUREMENT DINH_stFId.FId_VehVCanSafeReplVal "Inhibit Status of FIds / Status of function identifier FId_VehVCanSafeReplVal" UWORD DFC_OneToOne 1 100 0.00 65535.00 FORMAT "%8.2" ECU_ADDRESS 0x6000E022 /end MEASUREMENT
/begin MEASUREMENT DINH_stFId.FId_VehVExcdLim "Inhibit Status of FIds / Status of function identifier FId_VehVExcdLim" UWORD DFC_OneToOne 1 100 0.00 65535.00 FORMAT "%8.2" ECU_ADDRESS 0x6000E024 /end MEASUREMENT
/begin MEASUREMENT DINH_stFId.FId_VehVFrzVal "Inhibit Status of FIds / Status of function identifier FId_VehVFrzVal" UWORD DFC_OneToOne 1 100 0.00 65535.00 FORMAT "%8.2" ECU_ADDRESS 0x6000E026 /end MEASUREMENT
/begin MEASUREMENT DINH_stFId.FId_VehVNCSnsrElecFailr "Inhibit Status of FIds / Status of function identifier FId_VehVNCSnsrElecFailr" UWORD DFC_OneToOne 1 100 0.00 65535.00 FORMAT "%8.2" ECU_ADDRESS 0x6000E028 /end MEASUREMENT
/begin MEASUREMENT DINH_stFId.FId_VehVOBDFrzVal "Inhibit Status of FIds / Status of function identifier FId_VehVOBDFrzVal" UWORD DFC_OneToOne 1 100 0.00 65535.00 FORMAT "%8.2" ECU_ADDRESS 0x6000E02A /end MEASUREMENT
/begin MEASUREMENT DINH_stFId.FId_VehVOBDReplVal "Inhibit Status of FIds / Status of function identifier FId_VehVOBDReplVal" UWORD DFC_OneToOne 1 100 0.00 65535.00 FORMAT "%8.2" ECU_ADDRESS 0x6000E02C /end MEASUREMENT
/begin MEASUREMENT DINH_stFId.FId_VehVOutCanErr "Inhibit Status of FIds / Status of function identifier FId_VehVOutCanErr" UWORD DFC_OneToOne 1 100 0.00 65535.00 FORMAT "%8.2" ECU_ADDRESS 0x6000E02E /end MEASUREMENT
/begin MEASUREMENT DINH_stFId.FId_VehVPWMFrzVal "Inhibit Status of FIds / Status of function identifier FId_VehVPWMFrzVal" UWORD DFC_OneToOne 1 100 0.00 65535.00 FORMAT "%8.2" ECU_ADDRESS 0x6000E030 /end MEASUREMENT
/begin MEASUREMENT DINH_stFId.FId_VehVPWMReplVal "Inhibit Status of FIds / Status of function identifier FId_VehVPWMReplVal" UWORD DFC_OneToOne 1 100 0.00 65535.00 FORMAT "%8.2" ECU_ADDRESS 0x6000E032 /end MEASUREMENT
/begin MEASUREMENT DINH_stFId.FId_VehVPhysRng "Inhibit Status of FIds / Status of function identifier FId_VehVPhysRng" UWORD DFC_OneToOne 1 100 0.00 65535.00 FORMAT "%8.2" ECU_ADDRESS 0x6000E034 /end MEASUREMENT
/begin MEASUREMENT DINH_stFId.FId_VehVPlaus "Inhibit Status of FIds / Status of function identifier FId_VehVPlaus" UWORD DFC_OneToOne 1 100 0.00 65535.00 FORMAT "%8.2" ECU_ADDRESS 0x6000E036 /end MEASUREMENT
/begin MEASUREMENT DINH_stFId.FId_VehVPlausCan "Inhibit Status of FIds / Status of function identifier FId_VehVPlausCan" UWORD DFC_OneToOne 1 100 0.00 65535.00 FORMAT "%8.2" ECU_ADDRESS 0x6000E038 /end MEASUREMENT
/begin MEASUREMENT DINH_stFId.FId_VehVPlausFco "Inhibit Status of FIds / Status of function identifier FId_VehVPlausFco" UWORD DFC_OneToOne 1 100 0.00 65535.00 FORMAT "%8.2" ECU_ADDRESS 0x6000E03A /end MEASUREMENT
/begin MEASUREMENT DINH_stFId.FId_VehVPlausPwr "Inhibit Status of FIds / Status of function identifier FId_VehVPlausPwr" UWORD DFC_OneToOne 1 100 0.00 65535.00 FORMAT "%8.2" ECU_ADDRESS 0x6000E03C /end MEASUREMENT
/begin MEASUREMENT DINH_stFId.FId_VehVPlausV2N "Inhibit Status of FIds / Status of function identifier FId_VehVPlausV2N" UWORD DFC_OneToOne 1 100 0.00 65535.00 FORMAT "%8.2" ECU_ADDRESS 0x6000E03E /end MEASUREMENT
/begin MEASUREMENT DINH_stFId.FId_VehVReplVal "Inhibit Status of FIds / Status of function identifier FId_VehVReplVal" UWORD DFC_OneToOne 1 100 0.00 65535.00 FORMAT "%8.2" ECU_ADDRESS 0x6000E040 /end MEASUREMENT
/begin MEASUREMENT DINH_stFId.FId_VehVSigCan "Inhibit Status of FIds / Status of function identifier FId_VehVSigCan" UWORD DFC_OneToOne 1 100 0.00 65535.00 FORMAT "%8.2" ECU_ADDRESS 0x6000E042 /end MEASUREMENT
/begin MEASUREMENT DINH_stFId.FId_VehVSigCanSafe "Inhibit Status of FIds / Status of function identifier FId_VehVSigCanSafe" UWORD DFC_OneToOne 1 100 0.00 65535.00 FORMAT "%8.2" ECU_ADDRESS 0x6000E044 /end MEASUREMENT
/begin MEASUREMENT DINH_stFId.FId_VehVSnsrARngHi "Inhibit Status of FIds / Status of function identifier FId_VehVSnsrARngHi" UWORD DFC_OneToOne 1 100 0.00 65535.00 FORMAT "%8.2" ECU_ADDRESS 0x6000E046 /end MEASUREMENT
/begin MEASUREMENT DINH_stFId.FId_VehVSnsrBRngHi "Inhibit Status of FIds / Status of function identifier FId_VehVSnsrBRngHi" UWORD DFC_OneToOne 1 100 0.00 65535.00 FORMAT "%8.2" ECU_ADDRESS 0x6000E048 /end MEASUREMENT
/begin MEASUREMENT DINH_stFId.FId_VehVSpdRtyDiag "Inhibit Status of FIds / Status of function identifier FId_VehVSpdRtyDiag" UWORD DFC_OneToOne 1 100 0.00 65535.00 FORMAT "%8.2" ECU_ADDRESS 0x6000E04A /end MEASUREMENT
/begin MEASUREMENT DINH_stFId.FId_VehVSpdSnsrAElecFailr "Inhibit Status of FIds / Status of function identifier FId_VehVSpdSnsrAElecFailr" UWORD DFC_OneToOne 1 100 0.00 65535.00 FORMAT "%8.2" ECU_ADDRESS 0x6000E04C /end MEASUREMENT
/begin MEASUREMENT DINH_stFId.FId_VehVSpdSnsrBElecFailr "Inhibit Status of FIds / Status of function identifier FId_VehVSpdSnsrBElecFailr" UWORD DFC_OneToOne 1 100 0.00 65535.00 FORMAT "%8.2" ECU_ADDRESS 0x6000E04E /end MEASUREMENT
/begin MEASUREMENT DINH_stFId.FId_VehVWhlErrDet "Inhibit Status of FIds / Status of function identifier FId_VehVWhlErrDet" UWORD DFC_OneToOne 1 100 0.00 65535.00 FORMAT "%8.2" ECU_ADDRESS 0x6000E050 /end MEASUREMENT
/begin MEASUREMENT DINH_stFId.FId_VldtLamDynS1B1 "Inhibit Status of FIds / Status of function identifier FId_VldtLamDynS1B1" UWORD DFC_OneToOne 1 100 0.00 65535.00 FORMAT "%8.2" ECU_ADDRESS 0x6000E052 /end MEASUREMENT
/begin MEASUREMENT DINH_stFId.FId_VlvLftFbIntkOilPSnsr11SRC "Inhibit Status of FIds / Status of function identifier FId_VlvLftFbIntkOilPSnsr11SRC" UWORD DFC_OneToOne 1 100 0.00 65535.00 FORMAT "%8.2" ECU_ADDRESS 0x6000E054 /end MEASUREMENT
/begin MEASUREMENT DINH_stFId.FId_VlvLftFbSwtIntk11Diag "Inhibit Status of FIds / Status of function identifier FId_VlvLftFbSwtIntk11Diag" UWORD DFC_OneToOne 1 100 0.00 65535.00 FORMAT "%8.2" ECU_ADDRESS 0x6000E056 /end MEASUREMENT
/begin MEASUREMENT DINH_stFId.FId_ZGLZSR "Inhibit Status of FIds / Status of function identifier FId_ZGLZSR" UWORD DFC_OneToOne 1 100 0.00 65535.00 FORMAT "%8.2" ECU_ADDRESS 0x6000E058 /end MEASUREMENT
/begin MEASUREMENT DINH_stFId.FId_airIntkFltSnsrKnkPrtnIgn "Inhibit Status of FIds / Status of function identifier FId_airIntkFltSnsrKnkPrtnIgn" UWORD DFC_OneToOne 1 100 0.00 65535.00 FORMAT "%8.2" ECU_ADDRESS 0x6000E05A /end MEASUREMENT
/begin MEASUREMENT DINH_stFId.FId_stChkChgnSys "Inhibit Status of FIds / Status of function identifier FId_stChkChgnSys" UWORD DFC_OneToOne 1 100 0.00 65535.00 FORMAT "%8.2" ECU_ADDRESS 0x6000E05C /end MEASUREMENT
/begin MEASUREMENT DINH_stFId.FId_stChkChgnSys2DC "Inhibit Status of FIds / Status of function identifier FId_stChkChgnSys2DC" UWORD DFC_OneToOne 1 100 0.00 65535.00 FORMAT "%8.2" ECU_ADDRESS 0x6000E05E /end MEASUREMENT
/begin MEASUREMENT DINH_stFId.FId_tFltSnsrKnkPrtnIgn "Inhibit Status of FIds / Status of function identifier FId_tFltSnsrKnkPrtnIgn" UWORD DFC_OneToOne 1 100 0.00 65535.00 FORMAT "%8.2" ECU_ADDRESS 0x6000E060 /end MEASUREMENT
/begin MEASUREMENT DINH_stMod7VisyCmpl "status of the first completed calculation of mode7 visibility" UBYTE OneToOne 1 100 0.00 255.0 BIT_MASK 0x1 FORMAT "%5.1" ECU_ADDRESS 0x6000B4BD /end MEASUREMENT
/begin MEASUREMENT DINH_xFIDObsvInh_mp "DFCs and DSQs which inhibit the FId currently" UWORD DFCDSQ_Verb 1 100 0.00 65535.0000000 FORMAT "%13.7" ARRAY_SIZE 5 ECU_ADDRESS 0x700088A4 /end MEASUREMENT
/begin MEASUREMENT DINH_xFIDObsvRls_mp "DFCs and DSQs which don't inhibit the FId currently" UWORD DFCDSQ_Verb 1 100 0.00 65535.0000000 FORMAT "%13.7" ARRAY_SIZE 5 ECU_ADDRESS 0x7000889A /end MEASUREMENT
/begin FUNCTION DINH "30000.27.0_1.0.0Diagnostic Inhibit Handler"
 /begin DEF_CHARACTERISTIC DINH_FId.DFC_AltIOACGFailr_CA DINH_FId.DFC_AltIOACGHiVltg_CA DINH_FId.DFC_AltIOACGLoVltg_CA DINH_FId.DFC_AltIOACGTHi_CA DINH_FId.DFC_AltIODConnACG_CA DINH_FId.DFC_BattUHiFailr_CA DINH_FId.DFC_BattULoFailr_CA DINH_FId.DFC_BrkBstPDriftHiErr_CA DINH_FId.DFC_BrkBstPDriftLoErr_CA DINH_FId.DFC_BrkBstPSnsrStuck_CA DINH_FId.DFC_BrkMnSwtContOn_CA DINH_FId.DFC_BrkMnSwtNotStp_CA DINH_FId.DFC_BrkNpl_CA DINH_FId.DFC_BrkRdntSwtContOn_CA DINH_FId.DFC_BrkRdntSwtNotStp_CA DINH_FId.DFC_Clth3ONStuck_CA DINH_FId.DFC_Clth4OFFStuck_CA DINH_FId.DFC_ClthOFFStuck_CA DINH_FId.DFC_ClthONStuck_CA DINH_FId.DFC_ClthStkFailInfo_CA DINH_FId.DFC_ComACFailInfo_CA DINH_FId.DFC_ComATFTValErr_CA DINH_FId.DFC_ComATMILReq_CA DINH_FId.DFC_ComAYCAChksum_CA DINH_FId.DFC_ComAYCARingCnt_CA DINH_FId.DFC_ComAYCATOut_CA DINH_FId.DFC_ComAYCDChkSum_CA DINH_FId.DFC_ComAYCDTOut_CA DINH_FId.DFC_ComAYCFChksum_CA DINH_FId.DFC_ComAYCFRingCnt_CA DINH_FId.DFC_ComAYCFTOut_CA DINH_FId.DFC_ComAYCGChksum_CA DINH_FId.DFC_ComAYCGRingCnt_CA DINH_FId.DFC_ComAYCGTOut_CA DINH_FId.DFC_ComAYCIChkSum_CA DINH_FId.DFC_ComAYCIRingCnt_CA DINH_FId.DFC_ComAYCITOut_CA DINH_FId.DFC_ComBCM1ChkSum_CA DINH_FId.DFC_ComBCM1RingCnt_CA DINH_FId.DFC_ComBCM1TOut_CA DINH_FId.DFC_ComCANABusOffErr_CA DINH_FId.DFC_ComCANBBusOffErr_CA DINH_FId.DFC_ComCANCBusOffErr_CA DINH_FId.DFC_ComCGW1ChkSum_CA DINH_FId.DFC_ComCGW1RingCnt_CA DINH_FId.DFC_ComCGW1TOut_CA DINH_FId.DFC_ComConvBoostErr_CA DINH_FId.DFC_ComConvSlipErr_CA DINH_FId.DFC_ComEAT10Chksum_CA DINH_FId.DFC_ComEAT10RingCnt_CA DINH_FId.DFC_ComEAT10TOut_CA DINH_FId.DFC_ComEAT11ChkSum_CA DINH_FId.DFC_ComEAT11RingCnt_CA DINH_FId.DFC_ComEAT11TOut_CA DINH_FId.DFC_ComEAT12ChkSum_CA DINH_FId.DFC_ComEAT12RingCnt_CA DINH_FId.DFC_ComEAT12TOut_CA DINH_FId.DFC_ComEAT13ChkSum_CA DINH_FId.DFC_ComEAT13RingCnt_CA DINH_FId.DFC_ComEAT13TOut_CA DINH_FId.DFC_ComEAT1Chksum_CA DINH_FId.DFC_ComEAT1RingCnt_CA DINH_FId.DFC_ComEAT1TOut_CA DINH_FId.DFC_ComEAT2ChkSum_CA DINH_FId.DFC_ComEAT2RingCnt_CA DINH_FId.DFC_ComEAT2TOut_CA DINH_FId.DFC_ComEAT4ChkSum_CA DINH_FId.DFC_ComEAT4RingCnt_CA DINH_FId.DFC_ComEAT4TOut_CA DINH_FId.DFC_ComEAT6Chksum_CA DINH_FId.DFC_ComEAT6RingCnt_CA DINH_FId.DFC_ComEAT6TOut_CA DINH_FId.DFC_ComEAT7Chksum_CA DINH_FId.DFC_ComEAT7RingCnt_CA DINH_FId.DFC_ComEAT7TOut_CA DINH_FId.DFC_ComEAT8Chksum_CA DINH_FId.DFC_ComEAT8RingCnt_CA DINH_FId.DFC_ComEAT8TOut_CA DINH_FId.DFC_ComEATAChksum_CA DINH_FId.DFC_ComEATARingCnt_CA DINH_FId.DFC_ComEATATOut_CA DINH_FId.DFC_ComEATBChkSum_CA DINH_FId.DFC_ComEATBRingCnt_CA DINH_FId.DFC_ComEATBTOut_CA DINH_FId.DFC_ComEATCChksum_CA DINH_FId.DFC_ComEATCRingCnt_CA DINH_FId.DFC_ComEATCTOut_CA DINH_FId.DFC_ComEBBAChksum_CA DINH_FId.DFC_ComEBBARingCnt_CA DINH_FId.DFC_ComEBBATOut_CA DINH_FId.DFC_ComEPS1Chksum_CA DINH_FId.DFC_ComEPS1RingCnt_CA DINH_FId.DFC_ComEPS1TOut_CA DINH_FId.DFC_ComEngCanRxErr_CA DINH_FId.DFC_ComGrvySnsrErr_CA DINH_FId.DFC_ComGwIMG1ChkSum_CA DINH_FId.DFC_ComGwIMG1RingCnt_CA DINH_FId.DFC_ComGwIMG1TOut_CA DINH_FId.DFC_ComGwIMG3ChkSum_CA DINH_FId.DFC_ComGwIMG3RingCnt_CA DINH_FId.DFC_ComGwIMG3TOut_CA DINH_FId.DFC_ComGwIMG4ChkSum_CA DINH_FId.DFC_ComGwIMG4RingCnt_CA DINH_FId.DFC_ComGwIMG4TOut_CA DINH_FId.DFC_ComGwIMG5ChkSum_CA DINH_FId.DFC_ComGwIMG5RingCnt_CA DINH_FId.DFC_ComGwIMG5TOut_CA DINH_FId.DFC_ComGwIMG6ChkSum_CA DINH_FId.DFC_ComGwIMG6RingCnt_CA DINH_FId.DFC_ComGwIMG6TOut_CA DINH_FId.DFC_ComIDASBChksum_CA DINH_FId.DFC_ComIDASBRingCnt_CA DINH_FId.DFC_ComIDASBTOut_CA DINH_FId.DFC_ComIMGMILReq_CA DINH_FId.DFC_ComISSPrms_CA DINH_FId.DFC_ComMETAChksum_CA DINH_FId.DFC_ComMETARingCnt_CA DINH_FId.DFC_ComMETATOut_CA DINH_FId.DFC_ComMETCChksum_CA DINH_FId.DFC_ComMETCRingCnt_CA DINH_FId.DFC_ComMETCTOut_CA DINH_FId.DFC_ComMETDChksum_CA DINH_FId.DFC_ComMETDRingCnt_CA DINH_FId.DFC_ComMETDTOut_CA DINH_FId.DFC_ComMETE2Chksum_CA DINH_FId.DFC_ComMETE2RingCnt_CA DINH_FId.DFC_ComMETE2TOut_CA DINH_FId.DFC_ComMETFChksum_CA DINH_FId.DFC_ComMETFRingCnt_CA DINH_FId.DFC_ComMETFTOut_CA DINH_FId.DFC_ComMETGChksum_CA DINH_FId.DFC_ComMETGRingCnt_CA DINH_FId.DFC_ComMETGTOut_CA DINH_FId.DFC_ComMETH2Chksum_CA DINH_FId.DFC_ComMETH2RingCnt_CA DINH_FId.DFC_ComMETH2TOut_CA DINH_FId.DFC_ComMETHChksum_CA DINH_FId.DFC_ComMETHRingCnt_CA DINH_FId.DFC_ComMETHTOut_CA DINH_FId.DFC_ComMETIChksum_CA DINH_FId.DFC_ComMETIRingCnt_CA DINH_FId.DFC_ComMETITOut_CA DINH_FId.DFC_ComMETKChksum_CA DINH_FId.DFC_ComMETKRingCnt_CA DINH_FId.DFC_ComMETKTOut_CA DINH_FId.DFC_ComMETLChksum_CA DINH_FId.DFC_ComMETLRingCnt_CA DINH_FId.DFC_ComMETLTOut_CA DINH_FId.DFC_ComMETMChksum_CA DINH_FId.DFC_ComMETMRingCnt_CA DINH_FId.DFC_ComMETMTOut_CA DINH_FId.DFC_ComMETNChksum_CA DINH_FId.DFC_ComMETNRingCnt_CA DINH_FId.DFC_ComMETNTOut_CA DINH_FId.DFC_ComMtrCom_CA DINH_FId.DFC_ComPCUChkSum_CA DINH_FId.DFC_ComPCURingCnt_CA DINH_FId.DFC_ComPCUTOut_CA DINH_FId.DFC_ComSRSAChksum_CA DINH_FId.DFC_ComSRSARingCnt_CA DINH_FId.DFC_ComSRSATOut_CA DINH_FId.DFC_ComSRSBChksum_CA DINH_FId.DFC_ComSRSBRingCnt_CA DINH_FId.DFC_ComSRSBTOut_CA DINH_FId.DFC_ComSRSChksum_CA DINH_FId.DFC_ComSRSErr_CA DINH_FId.DFC_ComSRSRingCnt_CA DINH_FId.DFC_ComSRSTOut_CA /end DEF_CHARACTERISTIC
 /begin LOC_MEASUREMENT DINH_stFId.FId_ComGwIMG4Mon DINH_stFId.FId_ComGwIMG5 DINH_stFId.FId_ComGwIMG5Mon DINH_stFId.FId_ComGwIMG6 DINH_stFId.FId_ComGwIMG6Mon DINH_stFId.FId_ComHFMSnsrErr DINH_stFId.FId_ComIDASB DINH_stFId.FId_ComIDASBMon DINH_stFId.FId_ComIDASEngFail DINH_stFId.FId_ComISG2 DINH_stFId.FId_ComIgnCtrl DINH_stFId.FId_ComInjCtrl DINH_stFId.FId_ComIntkAirPSnsrErr DINH_stFId.FId_ComLamCtrl DINH_stFId.FId_ComMETA DINH_stFId.FId_ComMETAMon DINH_stFId.FId_ComMETC DINH_stFId.FId_ComMETCMon DINH_stFId.FId_ComMETD DINH_stFId.FId_ComMETDMon DINH_stFId.FId_ComMETE2 DINH_stFId.FId_ComMETE2Mon DINH_stFId.FId_ComMETF DINH_stFId.FId_ComMETFMon DINH_stFId.FId_ComMETG DINH_stFId.FId_ComMETGMon DINH_stFId.FId_ComMETH DINH_stFId.FId_ComMETH2 DINH_stFId.FId_ComMETH2Mon DINH_stFId.FId_ComMETHMon DINH_stFId.FId_ComMETI DINH_stFId.FId_ComMETIMon DINH_stFId.FId_ComMETK DINH_stFId.FId_ComMETKMon DINH_stFId.FId_ComMETL DINH_stFId.FId_ComMETLMon DINH_stFId.FId_ComMETM DINH_stFId.FId_ComMETMMon DINH_stFId.FId_ComMETN DINH_stFId.FId_ComMETNMon DINH_stFId.FId_ComMisf DINH_stFId.FId_ComMon DINH_stFId.FId_ComNTrbn DINH_stFId.FId_ComODOff DINH_stFId.FId_ComOilLvlLamp DINH_stFId.FId_ComOilPWarnLamp DINH_stFId.FId_ComPASensFail DINH_stFId.FId_ComPBSensFail DINH_stFId.FId_ComPCU DINH_stFId.FId_ComPCUMon DINH_stFId.FId_ComPosActnSpdLimrFctReq DINH_stFId.FId_ComSRS DINH_stFId.FId_ComSRSA DINH_stFId.FId_ComSRSAMon DINH_stFId.FId_ComSRSB DINH_stFId.FId_ComSRSBMon DINH_stFId.FId_ComSRSMon DINH_stFId.FId_ComSTFlt DINH_stFId.FId_ComSpdLimrDevActvn DINH_stFId.FId_ComTCU01 DINH_stFId.FId_ComTCU02 DINH_stFId.FId_ComTCU1 DINH_stFId.FId_ComTCU11 DINH_stFId.FId_ComTCU12 DINH_stFId.FId_ComTCU13 DINH_stFId.FId_ComTCU14 DINH_stFId.FId_ComTCU2 DINH_stFId.FId_ComTCU3 DINH_stFId.FId_ComTCU4 DINH_stFId.FId_ComTCUGear DINH_stFId.FId_ComTarGearDwnShift DINH_stFId.FId_ComTarGearUpShift DINH_stFId.FId_ComThrPosnFail DINH_stFId.FId_ComThrVlv DINH_stFId.FId_ComTrboChrgnErr DINH_stFId.FId_ComTrqAccuracySlow DINH_stFId.FId_ComTrqReqFast DINH_stFId.FId_ComTrqReqSlow DINH_stFId.FId_ComVSAErr DINH_stFId.FId_ComVehSpdFltChk DINH_stFId.FId_ComVehSpdImpsErr DINH_stFId.FId_ComVlvLftCtrl DINH_stFId.FId_ComvolEng DINH_stFId.FId_ConvLdCalcLvrPos DINH_stFId.FId_ConvLdNTrbnCan DINH_stFId.FId_ConvLdOilCoolrPmp DINH_stFId.FId_ConvLdOilTemp DINH_stFId.FId_ConvLdTrqLdCan DINH_stFId.FId_ConvLdVel DINH_stFId.FId_CptProtnExhTempMdl DINH_stFId.FId_CptProtnO2SnsrB1 DINH_stFId.FId_CptProtnVVeh DINH_stFId.FId_CrCUI1EFRxErr DINH_stFId.FId_CrCUICANRxErr DINH_stFId.FId_CrCUIFCMRxErr DINH_stFId.FId_CrCUIMETDRxErr DINH_stFId.FId_CrCtlACCRxErr DINH_stFId.FId_CrCtlAppSnsrErr DINH_stFId.FId_CrCtlShutOffEng DINH_stFId.FId_DIUMPRCldStrtMon DINH_stFId.FId_DIUMPRGenDenom1 DINH_stFId.FId_DIUMPRGenDenom2 DINH_stFId.FId_DIUMPRGenDenom3 DINH_stFId.FId_DIUMPRIgn DINH_stFId.FId_DOGov DINH_stFId.FId_DSMWarmUpCycle DINH_stFId.FId_DewDetTKAMax DINH_stFId.FId_DkrsaEpmNoSig DINH_stFId.FId_EBBCANErrFrzVal DINH_stFId.FId_EBBCANErrReplVal DINH_stFId.FId_EGLZSR DINH_stFId.FId_EGSDO2OffsRstDsmS1B1 DINH_stFId.FId_EGSDO2_LamOffsSlowS1 DINH_stFId.FId_EGSDUS2B1LtrDly DINH_stFId.FId_EGSDUS2B1LtrPT1 DINH_stFId.FId_EGSDUS2B1RtlDly DINH_stFId.FId_EGSDUS2B1RtlPT1 DINH_stFId.FId_EGSDUS2B1TarEvln DINH_stFId.FId_EGSDUS2B1TarLean DINH_stFId.FId_EGSDUS2B1TarRich DINH_stFId.FId_ELZSR DINH_stFId.FId_EPBErr DINH_stFId.FId_EPBFrmErr DINH_stFId.FId_EPBFrmErrClth DINH_stFId.FId_EVPComFailr DINH_stFId.FId_EbsLinErr DINH_stFId.FId_EepReadWrState DINH_stFId.FId_ElecLdComErr DINH_stFId.FId_ElecLdFrzVal DINH_stFId.FId_ElecLdHdLiComErr DINH_stFId.FId_ElecLdRplVal DINH_stFId.FId_ElecLoadEPSComErr DINH_stFId.FId_EngBlkTWrn DINH_stFId.FId_EngCooltTFail DINH_stFId.FId_EngDemTqLimnCamsftErr DINH_stFId.FId_EngDemTqLimnErrThmstHeatCtrlCirc DINH_stFId.FId_EngDemTqLimnOilPmp DINH_stFId.FId_EngDemTrqLimErrAPP DINH_stFId.FId_EngIntkAirFail DINH_stFId.FId_EngPrtErrVehV DINH_stFId.FId_EngSpd30DegFail DINH_stFId.FId_EngStrtEnaEthAdap DINH_stFId.FId_EngStrt_InjProhb DINH_stFId.FId_EngTqRvsnEnaFlg DINH_stFId.FId_EnvTPrimMod DINH_stFId.FId_EnvTPrimModIniVal DINH_stFId.FId_EnvTSensSum DINH_stFId.FId_EnvTtCEngDsT DINH_stFId.FId_EnvTtIntkMnfld DINH_stFId.FId_EpmBCr DINH_stFId.FId_EpmCaSAdapCaSI1 DINH_stFId.FId_EpmCaSAdapRstI1 DINH_stFId.FId_EpmCaSDiagI1 DINH_stFId.FId_EpmCaSErrCaSI1 DINH_stFId.FId_EpmCaSOfsDiagCaSI1 DINH_stFId.FId_EpmCaSOfsErrCaSI1 DINH_stFId.FId_EpmCaSSegI1 DINH_stFId.FId_EpmCaSSpdPlausI1 DINH_stFId.FId_EpmCrSDiag DINH_stFId.FId_EpmCrSDiagVeh DINH_stFId.FId_EpmCrSErr DINH_stFId.FId_EpmRRSCrSFaultCheck DINH_stFId.FId_EpmRRSVehVFaultChck DINH_stFId.FId_EpmSynLockCaSSync DINH_stFId.FId_EtaEngIdleNonCsers DINH_stFId.FId_EtaEngPtlNonCsers DINH_stFId.FId_FanCtlACClntP DINH_stFId.FId_FanCtlACGModFail DINH_stFId.FId_FanCtlAPP1 DINH_stFId.FId_FanCtlAPP2 DINH_stFId.FId_FanCtlAPPSync DINH_stFId.FId_FanCtlBlowrU DINH_stFId.FId_FanCtlCooltT DINH_stFId.FId_FanCtlCooltT2 DINH_stFId.FId_FanCtlEnvT DINH_stFId.FId_FanCtlLiSwtInfo DINH_stFId.FId_FanCtlSpd DINH_stFId.FId_FanCtlTSnsrErr DINH_stFId.FId_FanCtlThr1 DINH_stFId.FId_FanCtlThr2 DINH_stFId.FId_FcoReq DINH_stFId.FId_FiMFID_rba_MRly_Diag_Stk DINH_stFId.FId_FlMALamDynDiag DINH_stFId.FId_FuEvapPurgTCpvDty DINH_stFId.FId_FuMixUegoErrExcl DINH_stFId.FId_GEVCtlVlvLftEnaIntk DINH_stFId.FId_GbxAnNeutPosnErr DINH_stFId.FId_GbxCANDigPlausErr DINH_stFId.FId_GbxCANNeutSigErr DINH_stFId.FId_GbxPNPosSig DINH_stFId.FId_GbxPNPosnComErr DINH_stFId.FId_GbxPNPosnDiagDrvCdnRels DINH_stFId.FId_GbxPNPosnDiagDrvCodnHealRels DINH_stFId.FId_GbxPNPosnDiagPlausyRels DINH_stFId.FId_GbxPNPosnSubsVal DINH_stFId.FId_GbxRvsSwtStk DINH_stFId.FId_GbxSnsrSplyUErr DINH_stFId.FId_GbxSpstReqOk DINH_stFId.FId_GlbDaLSumvXPtd DINH_stFId.FId_GslThrVlvSnsrDiagB1 DINH_stFId.FId_HEGOS2B1DElec DINH_stFId.FId_HEGOS2B1DHtg DINH_stFId.FId_HEGOS2B1Htg DINH_stFId.FId_HEGOS2B1HtrPsSt DINH_stFId.FId_HEGOS2B1InVld DINH_stFId.FId_HEGOS2B1LSPsDiaDi DINH_stFId.FId_HLSDemBrkFlt DINH_stFId.FId_HLSDemIntkAirTemp DINH_stFId.FId_HLSDemMotTemp DINH_stFId.FId_HLSDemMstCyldpVld DINH_stFId.FId_HLSDemOvhtExhMnf DINH_stFId.FId_HLSDemOvhtFanR DINH_stFId.FId_HLSDemOvhtGear DINH_stFId.FId_HLSDemOvhtTum DINH_stFId.FId_HLSDemOvhtVehV DINH_stFId.FId_HLSDemSpdClthGearAccrSigErr DINH_stFId.FId_HLSDem_DrvOffSuprt DINH_stFId.FId_HLSDem_DrvOffSuprtBrkHldSys DINH_stFId.FId_HLSDem_DrvOffSuprtLAS DINH_stFId.FId_HLSDem_PModeActv DINH_stFId.FId_HLSDem_TModeActv DINH_stFId.FId_HLSDem_TraSubFcn DINH_stFId.FId_HLSDem_nMaxLimErr1 DINH_stFId.FId_HLSDem_nMaxLimErr2 DINH_stFId.FId_HLSDem_nMaxLimErr3 DINH_stFId.FId_HLSDem_nMaxVErr DINH_stFId.FId_I14229APP DINH_stFId.FId_I14229CANErr DINH_stFId.FId_I14229EWPErr DINH_stFId.FId_I14229TrbCh DINH_stFId.FId_I14229VTCErr DINH_stFId.FId_IMGISABComErr DINH_stFId.FId_InhbLamDynS1B1 DINH_stFId.FId_InhibitAlways DINH_stFId.FId_InhibitNever DINH_stFId.FId_InjVvgPFIEV1 DINH_stFId.FId_InjVvgPFIEV2 DINH_stFId.FId_InjVvgPFIEV3 DINH_stFId.FId_InjVvgPFIEV4 DINH_stFId.FId_IntkAirTIntkMnfldCrssChk DINH_stFId.FId_IntkAirTIntkMnfldPlausChk DINH_stFId.FId_IntkAirTIntkMnfldRepl DINH_stFId.FId_IntkAirTSnsr1Elec DINH_stFId.FId_IntkAirTSnsr1PRC DINH_stFId.FId_IntkAirTSnsr1Sum DINH_stFId.FId_IntkArTempENGB DINH_stFId.FId_LIGovDfrstI DINH_stFId.FId_LIGovUndrBrk DINH_stFId.FId_LINDCDCRxErr DINH_stFId.FId_LLimAppSnsrErr DINH_stFId.FId_LLimAppSnsrSyncErr DINH_stFId.FId_LLimMTVehSpdSnsrErr DINH_stFId.FId_LLimShutOffEng DINH_stFId.FId_LRSEBMisf DINH_stFId.FId_LZSR DINH_stFId.FId_LeakToMnfldTstd DINH_stFId.FId_MaiLoadSnsr DINH_stFId.FId_MisfDetDnAdpn DINH_stFId.FId_MisfDetDnAdpnPlaus DINH_stFId.FId_MisfDetEnvP DINH_stFId.FId_MisfDetSegTiAdpnFco DINH_stFId.FId_MisfDetShtrpAct DINH_stFId.FId_MisfDetStc DINH_stFId.FId_MisfDetV DINH_stFId.FId_MisfDetVWhlFrntLe DINH_stFId.FId_MisfDetVWhlFrntRi DINH_stFId.FId_MisfDetVWhlReLe DINH_stFId.FId_MisfDetVWhlReRi DINH_stFId.FId_MisfDet_InjLockdOpen01 DINH_stFId.FId_MisfDet_InjLockdOpen02 DINH_stFId.FId_MisfDet_InjLockdOpen03 DINH_stFId.FId_MisfDet_InjLockdOpen04 DINH_stFId.FId_NLimVehHalt DINH_stFId.FId_NSHTDAmbT DINH_stFId.FId_NSHTDEngT DINH_stFId.FId_NSHTILimHiAltiLoIdleSp DINH_stFId.FId_O2StorgMdlMD DINH_stFId.FId_OilCmbdSen_LvlDfctHW DINH_stFId.FId_OilSwmpTCEngDsTWrmUp DINH_stFId.FId_OilSwmpT_B_tospg DINH_stFId.FId_OilSwmpT_B_tospgg DINH_stFId.FId_OilSwmpT_CmbdSnsrErr DINH_stFId.FId_OilSwmpT_CmbdSnsrTiTErr DINH_stFId.FId_OilSwmpT_EnvT DINH_stFId.FId_OilSwmpT_TSnsrErr DINH_stFId.FId_PEnvMeasVld DINH_stFId.FId_PEnvModel DINH_stFId.FId_PEnvPlausDiagVDD DINH_stFId.FId_PEnvRawVldVDD DINH_stFId.FId_PEnvRefSnsr DINH_stFId.FId_PEnvSigRngVld DINH_stFId.FId_PEnvSnsrPlausVDD DINH_stFId.FId_PEnvVldVDD DINH_stFId.FId_PIDA6SigSrcErr DINH_stFId.FId_PIntkMnfldPlaus DINH_stFId.FId_PIntkVUsElecDiagB1 DINH_stFId.FId_PSPCtlDisbl DINH_stFId.FId_PSPCtlPreRun DINH_stFId.FId_PSPDiagDisbl DINH_stFId.FId_PTGripConv DINH_stFId.FId_PTGripConvStrt DINH_stFId.FId_PTGripMnlClth DINH_stFId.FId_PTGripMnlClthStrt DINH_stFId.FId_PTTrqRatCANPtd DINH_stFId.FId_PThrVlVUsVldB1 DINH_stFId.FId_PThrVlvUsMeasdVldB1 DINH_stFId.FId_P_VSE11_Diag DINH_stFId.FId_PrmId03_FltRdnS1B1 DINH_stFId.FId_PrmId03_FltUegoS1B1 DINH_stFId.FId_SSEEPBRelease DINH_stFId.FId_SSEFCANPRelease DINH_stFId.FId_SSEPTCANPRelease DINH_stFId.FId_SSEStartRelease DINH_stFId.FId_SSEStartReleaseMTCl10 DINH_stFId.FId_SSEStartReleaseMTCl100 DINH_stFId.FId_SSEStartReleaseMTCl20 DINH_stFId.FId_SSEStartReleaseMTCl90 DINH_stFId.FId_SSEStartRequest DINH_stFId.FId_SSEStopRelease DINH_stFId.FId_SSEStrtStopRelease DINH_stFId.FId_SSESysOff DINH_stFId.FId_SSEUI2DCSysFailr DINH_stFId.FId_SSEUIBCANErr DINH_stFId.FId_SSEUISysFail DINH_stFId.FId_SiaEEPErr DINH_stFId.FId_StrtCrkSnsrFailr DINH_stFId.FId_StrtCtlAutoCrkModeCdn DINH_stFId.FId_StrtCtlComEngStrtErr DINH_stFId.FId_StrtCtlNPCdnCncl DINH_stFId.FId_StrtCtlNoCpuFailr DINH_stFId.FId_StrtCtlNoFailCanLine DINH_stFId.FId_StrtCtlNoFailPTCanLine DINH_stFId.FId_StrtCtlNoTCUFail DINH_stFId.FId_StrtCtlPNPosnSubsVal DINH_stFId.FId_StrtCtlSTMFailr DINH_stFId.FId_StrtErrShaft DINH_stFId.FId_StrtrRlyFailr DINH_stFId.FId_SumErrHndlg DINH_stFId.FId_SysDiagComErr DINH_stFId.FId_SysDiagModInhbErr DINH_stFId.FId_TOSPM DINH_stFId.FId_TWCCILckExtd DINH_stFId.FId_TWCCIRstB1 DINH_stFId.FId_TWCCIRstDSMClearB1 DINH_stFId.FId_TWCCLsuB1 DINH_stFId.FId_TWCCLsuCyc DINH_stFId.FId_TWCCLsuDynB1 DINH_stFId.FId_TWCCMisfDetn DINH_stFId.FId_TWCDPriCatParB1 DINH_stFId.FId_TWCDPriCatVldnB1 DINH_stFId.FId_ThrVlvMon DINH_stFId.FId_ThrVlvOffsLrnPrmsB1 DINH_stFId.FId_TiOffTBasdChkFast DINH_stFId.FId_TiOffTBasdChkSlow DINH_stFId.FId_TiOffVdClk DINH_stFId.FId_TqDecelOffsInhb DINH_stFId.FId_TraAddAirCANPtd DINH_stFId.FId_TraAddClntCANPtd DINH_stFId.FId_TraFwdRvsCluInfo DINH_stFId.FId_TraGbxNPos DINH_stFId.FId_TraGearInfoCanCom DINH_stFId.FId_TraGearInfoDet DINH_stFId.FId_TraGearInfoGearShftActv DINH_stFId.FId_TraGearInfoInfoCan DINH_stFId.FId_TraGearInfoLevPos DINH_stFId.FId_TraGearInfoLoRng DINH_stFId.FId_TraGearInfoRTra DINH_stFId.FId_TraGearInfoRevGear DINH_stFId.FId_TraGearReq DINH_stFId.FId_TraNoShftIdctr DINH_stFId.FId_TraPrtGearCANPtd DINH_stFId.FId_TraPrtGearIndpdtProblem DINH_stFId.FId_TraRPosn DINH_stFId.FId_TraRtnIntfcASTIntv DINH_stFId.FId_TraRtnIntfcIdlSetP DINH_stFId.FId_TraRtnIntfcNMaxCan DINH_stFId.FId_TraRtnIntfcNMaxVel DINH_stFId.FId_TraTrqRedLmpHmeDec DINH_stFId.FId_TraTrqRedLmpHmeInc DINH_stFId.FId_TraTrqRedPTCanErr DINH_stFId.FId_TraTrqRedTIIntvDes DINH_stFId.FId_TraTrqRedTIIntvLead DINH_stFId.FId_TraTrqRedTSCIntvDes DINH_stFId.FId_TraTrqRedTSCIntvLead DINH_stFId.FId_TraTrsmTypHw DINH_stFId.FId_TranIdleDes DINH_stFId.FId_UEGODiagRelsS1B1 DINH_stFId.FId_UEGOHeatrLrgTWinS1B1 DINH_stFId.FId_UEGOHeatrPwrStgDiagRelsS1B1 DINH_stFId.FId_UEGOHeatrPwrStgDiagRelsSCBS1B1 DINH_stFId.FId_UEGOHtrCtlOffS1B1 DINH_stFId.FId_UEGOHtrCtlRedS1B1 DINH_stFId.FId_UEGOHtrCtlStopS1B1 DINH_stFId.FId_UEGOHtrCtlUpS1B1 DINH_stFId.FId_UEGOIPmpEvlnRelsS1B1 DINH_stFId.FId_UEGOIPmpTCorrnS1B1 DINH_stFId.FId_UEGOIPmpTRelsS1B1 DINH_stFId.FId_UEGOLamRecprMdlRelsS1B1 DINH_stFId.FId_UEGOLamRelsAltvS1B1 DINH_stFId.FId_UEGOLamRelsS1B1 DINH_stFId.FId_UEGOLoDiagS1B1 DINH_stFId.FId_UEGOPrmntDiagS1B1 DINH_stFId.FId_UEGOStrtDiagRprtErrS1B1 DINH_stFId.FId_UEGOStrtDiagS1B1 DINH_stFId.FId_UEGOTEvlnRelsS1B1 DINH_stFId.FId_UegoInhbOperRelsS1B1 DINH_stFId.FId_UegoIntrptCdnOperRelsPreEngStrt DINH_stFId.FId_UegoPlausErrHndlg DINH_stFId.FId_UegoSigAvailS1B1 DINH_stFId.FId_VMSIDCSRmpShOff DINH_stFId.FId_VMSIDCSShOff DINH_stFId.FId_VMSITCSRmpShOff DINH_stFId.FId_VMSITCSShOff DINH_stFId.FId_VSACANErr DINH_stFId.FId_VehStcDCDCFailr DINH_stFId.FId_VehStcMisf DINH_stFId.FId_VehVCANFrzVal DINH_stFId.FId_VehVCANReplVal DINH_stFId.FId_VehVCanSafeFrzVal DINH_stFId.FId_VehVCanSafeReplVal DINH_stFId.FId_VehVExcdLim DINH_stFId.FId_VehVFrzVal DINH_stFId.FId_VehVNCSnsrElecFailr DINH_stFId.FId_VehVOBDFrzVal DINH_stFId.FId_VehVOBDReplVal DINH_stFId.FId_VehVOutCanErr DINH_stFId.FId_VehVPWMFrzVal DINH_stFId.FId_VehVPWMReplVal DINH_stFId.FId_VehVPhysRng DINH_stFId.FId_VehVPlaus DINH_stFId.FId_VehVPlausCan DINH_stFId.FId_VehVPlausFco DINH_stFId.FId_VehVPlausPwr DINH_stFId.FId_VehVPlausV2N DINH_stFId.FId_VehVReplVal DINH_stFId.FId_VehVSigCan DINH_stFId.FId_VehVSigCanSafe DINH_stFId.FId_VehVSnsrARngHi DINH_stFId.FId_VehVSnsrBRngHi DINH_stFId.FId_VehVSpdRtyDiag DINH_stFId.FId_VehVSpdSnsrAElecFailr DINH_stFId.FId_VehVSpdSnsrBElecFailr DINH_stFId.FId_VehVWhlErrDet DINH_stFId.FId_VldtLamDynS1B1 DINH_stFId.FId_VlvLftFbIntkOilPSnsr11SRC DINH_stFId.FId_VlvLftFbSwtIntk11Diag DINH_stFId.FId_ZGLZSR DINH_stFId.FId_airIntkFltSnsrKnkPrtnIgn DINH_stFId.FId_stChkChgnSys DINH_stFId.FId_stChkChgnSys2DC DINH_stFId.FId_tFltSnsrKnkPrtnIgn DINH_stMod7VisyCmpl DINH_xFIDObsvInh_mp DINH_xFIDObsvRls_mp /end LOC_MEASUREMENT
 FUNCTION_VERSION "30000.27.0_1.0.0" /end FUNCTION
/begin COMPU_METHOD DFCDSQ_Verb "" TAB_VERB "%6.3" "-" COMPU_TAB_REF DFCDSQ_Verb /end COMPU_METHOD
/begin COMPU_VTAB DFCDSQ_Verb "" TAB_VERB 738 0 "NoInhibit" 1 "DFC_AltIOACGFailr" 2 "DFC_AltIOACGHiVltg" 3 "DFC_AltIOACGLoVltg" 4 "DFC_AltIOACGTHi" 5 "DFC_AltIODConnACG" 6 "DFC_BattUHiFailr" 7 "DFC_BattULoFailr" 8 "DFC_BrkBstPDriftHiErr" 9 "DFC_BrkBstPDriftLoErr" 10 "DFC_BrkBstPSnsrStuck" 11 "DFC_BrkMnSwtContOn" 12 "DFC_BrkMnSwtNotStp" 13 "DFC_BrkNpl" 14 "DFC_BrkRdntSwtContOn" 15 "DFC_BrkRdntSwtNotStp" 16 "DFC_Clth3ONStuck" 17 "DFC_Clth4OFFStuck" 18 "DFC_ClthOFFStuck" 19 "DFC_ClthONStuck" 20 "DFC_ClthStkFailInfo" 21 "DFC_ComACFailInfo" 22 "DFC_ComATFTValErr" 23 "DFC_ComATMILReq" 24 "DFC_ComAYCAChksum" 25 "DFC_ComAYCARingCnt" 26 "DFC_ComAYCATOut" 27 "DFC_ComAYCDChkSum" 28 "DFC_ComAYCDTOut" 29 "DFC_ComAYCFChksum" 30 "DFC_ComAYCFRingCnt" 31 "DFC_ComAYCFTOut" 32 "DFC_ComAYCGChksum" 33 "DFC_ComAYCGRingCnt" 34 "DFC_ComAYCGTOut" 35 "DFC_ComAYCIChkSum" 36 "DFC_ComAYCIRingCnt" 37 "DFC_ComAYCITOut" 38 "DFC_ComBCM1ChkSum" 39 "DFC_ComBCM1RingCnt" 40 "DFC_ComBCM1TOut" 41 "DFC_ComCANABusOffErr" 42 "DFC_ComCANBBusOffErr" 43 "DFC_ComCANCBusOffErr" 44 "DFC_ComCGW1ChkSum" 45 "DFC_ComCGW1RingCnt" 46 "DFC_ComCGW1TOut" 47 "DFC_ComConvBoostErr" 48 "DFC_ComConvSlipErr" 49 "DFC_ComEAT10Chksum" 50 "DFC_ComEAT10RingCnt" 51 "DFC_ComEAT10TOut" 52 "DFC_ComEAT11ChkSum" 53 "DFC_ComEAT11RingCnt" 54 "DFC_ComEAT11TOut" 55 "DFC_ComEAT12ChkSum" 56 "DFC_ComEAT12RingCnt" 57 "DFC_ComEAT12TOut" 58 "DFC_ComEAT13ChkSum" 59 "DFC_ComEAT13RingCnt" 60 "DFC_ComEAT13TOut" 61 "DFC_ComEAT1Chksum" 62 "DFC_ComEAT1RingCnt" 63 "DFC_ComEAT1TOut" 64 "DFC_ComEAT2ChkSum" 65 "DFC_ComEAT2RingCnt" 66 "DFC_ComEAT2TOut" 67 "DFC_ComEAT4ChkSum" 68 "DFC_ComEAT4RingCnt" 69 "DFC_ComEAT4TOut" 70 "DFC_ComEAT6Chksum" 71 "DFC_ComEAT6RingCnt" 72 "DFC_ComEAT6TOut" 73 "DFC_ComEAT7Chksum" 74 "DFC_ComEAT7RingCnt" 75 "DFC_ComEAT7TOut" 76 "DFC_ComEAT8Chksum" 77 "DFC_ComEAT8RingCnt" 78 "DFC_ComEAT8TOut" 79 "DFC_ComEATAChksum" 80 "DFC_ComEATARingCnt" 81 "DFC_ComEATATOut" 82 "DFC_ComEATBChkSum" 83 "DFC_ComEATBRingCnt" 84 "DFC_ComEATBTOut" 85 "DFC_ComEATCChksum" 86 "DFC_ComEATCRingCnt" 87 "DFC_ComEATCTOut" 88 "DFC_ComEBBAChksum" 89 "DFC_ComEBBARingCnt" 90 "DFC_ComEBBATOut" 91 "DFC_ComEPS1Chksum" 92 "DFC_ComEPS1RingCnt" 93 "DFC_ComEPS1TOut" 94 "DFC_ComEngCanRxErr" 95 "DFC_ComGrvySnsrErr" 96 "DFC_ComGwIMG1ChkSum" 97 "DFC_ComGwIMG1RingCnt" 98 "DFC_ComGwIMG1TOut" 99 "DFC_ComGwIMG3ChkSum" 100 "DFC_ComGwIMG3RingCnt" 101 "DFC_ComGwIMG3TOut" 102 "DFC_ComGwIMG4ChkSum" 103 "DFC_ComGwIMG4RingCnt" 104 "DFC_ComGwIMG4TOut" 105 "DFC_ComGwIMG5ChkSum" 106 "DFC_ComGwIMG5RingCnt" 107 "DFC_ComGwIMG5TOut" 108 "DFC_ComGwIMG6ChkSum" 109 "DFC_ComGwIMG6RingCnt" 110 "DFC_ComGwIMG6TOut" 111 "DFC_ComIDASBChksum" 112 "DFC_ComIDASBRingCnt" 113 "DFC_ComIDASBTOut" 114 "DFC_ComIMGMILReq" 115 "DFC_ComISSPrms" 116 "DFC_ComMETAChksum" 117 "DFC_ComMETARingCnt" 118 "DFC_ComMETATOut" 119 "DFC_ComMETCChksum" 120 "DFC_ComMETCRingCnt" 121 "DFC_ComMETCTOut" 122 "DFC_ComMETDChksum" 123 "DFC_ComMETDRingCnt" 124 "DFC_ComMETDTOut" 125 "DFC_ComMETE2Chksum" 126 "DFC_ComMETE2RingCnt" 127 "DFC_ComMETE2TOut" 128 "DFC_ComMETFChksum" 129 "DFC_ComMETFRingCnt" 130 "DFC_ComMETFTOut" 131 "DFC_ComMETGChksum" 132 "DFC_ComMETGRingCnt" 133 "DFC_ComMETGTOut" 134 "DFC_ComMETH2Chksum" 135 "DFC_ComMETH2RingCnt" 136 "DFC_ComMETH2TOut" 137 "DFC_ComMETHChksum" 138 "DFC_ComMETHRingCnt" 139 "DFC_ComMETHTOut" 140 "DFC_ComMETIChksum" 141 "DFC_ComMETIRingCnt" 142 "DFC_ComMETITOut" 143 "DFC_ComMETKChksum" 144 "DFC_ComMETKRingCnt" 145 "DFC_ComMETKTOut" 146 "DFC_ComMETLChksum" 147 "DFC_ComMETLRingCnt" 148 "DFC_ComMETLTOut" 149 "DFC_ComMETMChksum" 150 "DFC_ComMETMRingCnt" 151 "DFC_ComMETMTOut" 152 "DFC_ComMETNChksum" 153 "DFC_ComMETNRingCnt" 154 "DFC_ComMETNTOut" 155 "DFC_ComMtrCom" 156 "DFC_ComPCUChkSum" 157 "DFC_ComPCURingCnt" 158 "DFC_ComPCUTOut" 159 "DFC_ComSRSAChksum" 160 "DFC_ComSRSARingCnt" 161 "DFC_ComSRSATOut" 162 "DFC_ComSRSBChksum" 163 "DFC_ComSRSBRingCnt" 164 "DFC_ComSRSBTOut" 165 "DFC_ComSRSChksum" 166 "DFC_ComSRSErr" 167 "DFC_ComSRSRingCnt" 168 "DFC_ComSRSTOut" 169 "DFC_ComVehSpdPndFltTCU" 170 "DFC_EbsChartcCurrErr" 171 "DFC_EbsSelfDiagErr" 172 "DFC_GbxCANDigPlausErr" 173 "DFC_GbxNPos1SRCMax" 174 "DFC_GbxNPos1SRCMin" 175 "DFC_GbxNPos2SRCMax" 176 "DFC_GbxNPos2SRCMin" 177 "DFC_GbxNPosAlvChk" 178 "DFC_GbxNPosSyncErr" 179 "DFC_HEGOS2B1HtrPsMax" 180 "DFC_HEGOS2B1HtrPsMin" 181 "DFC_HEGOS2B1HtrPsSig" 182 "DFC_LinCSErrACG" 183 "DFC_LinCSErrEBS" 184 "DFC_LinHdrTimeoutErrACG" 185 "DFC_LinHdrTimeoutErrEBS" 186 "DFC_LinMsgTimeoutErrACG" 187 "DFC_LinMsgTimeoutErrEBS" 188 "DFC_LinNoStrtComErr" 189 "DFC_MisfDetVWhlFrntLeOORHi" 190 "DFC_MisfDetVWhlFrntLeRatyHi" 191 "DFC_MisfDetVWhlFrntLeRatyLo" 192 "DFC_MisfDetVWhlFrntLeStuck" 193 "DFC_MisfDetVWhlFrntRiOORHi" 194 "DFC_MisfDetVWhlFrntRiRatyHi" 195 "DFC_MisfDetVWhlFrntRiRatyLo" 196 "DFC_MisfDetVWhlFrntRiStuck" 197 "DFC_MisfDetVWhlReLeOORHi" 198 "DFC_MisfDetVWhlReLeRatyHi" 199 "DFC_MisfDetVWhlReLeRatyLo" 200 "DFC_MisfDetVWhlReLeStuck" 201 "DFC_MisfDetVWhlReRiOORHi" 202 "DFC_MisfDetVWhlReRiRatyHi" 203 "DFC_MisfDetVWhlReRiRatyLo" 204 "DFC_MisfDetVWhlReRiStuck" 205 "DFC_MisfDetdVWhlFrntLePlaus" 206 "DFC_MisfDetdVWhlFrntRiPlaus" 207 "DFC_MisfDetdVWhlReLePlaus" 208 "DFC_MisfDetdVWhlReRiPlaus" 209 "DFC_PEnvSigRngMax" 210 "DFC_PEnvSigRngMin" 211 "DFC_StmFault" 212 "DFC_StrtCtOffPth" 213 "DFC_StrtCtlErr" 214 "DFC_StrtFault" 215 "DFC_StrtLckJudg1" 216 "DFC_StrtLckJudg2" 217 "DFC_StrtOL" 218 "DFC_StrtOL2" 219 "DFC_StrtSCB" 220 "DFC_StrtSCB2" 221 "DFC_StrtSCG" 222 "DFC_StrtSCG2" 223 "DFC_StrtStkRly1" 224 "DFC_StrtStkRly2" 225 "DFC_TEVEmax" 226 "DFC_TEVEmin" 227 "DFC_TEVEsig" 228 "DFC_VehVAllPlaus" 229 "DFC_VehVNCSnsrElecFailr" 230 "DFC_VehVPlausCan" 231 "DFC_VehVPlausFco" 232 "DFC_VehVPlausPwr" 233 "DFC_VehVPlausV2N" 234 "DFC_VehVSpdSnsrAElecFailr" 235 "DFC_VehVSpdSnsrBElecFailr" 236 "DFC_ClthMax" 237 "DFC_IgnClPs_DevComErr" 238 "DFC_IgnClPs_LineOl_0" 239 "DFC_IgnClPs_LineOl_1" 240 "DFC_IgnClPs_LineOl_2" 241 "DFC_IgnClPs_LineOl_3" 242 "DFC_IgnClPs_LineScb_0" 243 "DFC_IgnClPs_LineScb_1" 244 "DFC_IgnClPs_LineScb_2" 245 "DFC_IgnClPs_LineScb_3" 246 "DFC_IgnClPs_LineScg_0" 247 "DFC_IgnClPs_LineScg_1" 248 "DFC_IgnClPs_LineScg_2" 249 "DFC_IgnClPs_LineScg_3" 250 "DFC_UEGOASICS1B1" 251 "DFC_UEGOOLIPES1B1" 252 "DFC_UEGOOLRES1B1" 253 "DFC_UEGOSCBS1B1" 254 "DFC_UEGOSCGS1B1" 255 "DFC_UEGOSPIS1B1" 256 "DFC_UEGOSnsrS1B1" 257 "DFC_UegoOlApesS1B1" 258 "DFC_UegoOlRCmpS1B1" 259 "DFC_AirCCmprOL" 260 "DFC_AirCCmprOvrTemp" 261 "DFC_AirCCmprSCB" 262 "DFC_AirCCmprSCG" 263 "DFC_AltErr" 264 "DFC_BattUSRCMax" 265 "DFC_BattUSRCMin" 266 "DFC_ComChksTCU1" 267 "DFC_ComChksTCU11" 268 "DFC_ComChksTCU12" 269 "DFC_ComChksTCU13" 270 "DFC_ComChksTCU2" 271 "DFC_ComChksTCU3" 272 "DFC_ComChksTCU4" 273 "DFC_ComCntTCU1" 274 "DFC_ComCntTCU11" 275 "DFC_ComCntTCU12" 276 "DFC_ComCntTCU13" 277 "DFC_ComCntTCU2" 278 "DFC_ComCntTCU3" 279 "DFC_ComCntTCU4" 280 "DFC_ComTOutTCU01" 281 "DFC_ComTOutTCU02" 282 "DFC_ComTOutTCU1" 283 "DFC_ComTOutTCU11" 284 "DFC_ComTOutTCU12" 285 "DFC_ComTOutTCU13" 286 "DFC_ComTOutTCU14" 287 "DFC_ComTOutTCU2" 288 "DFC_ComTOutTCU3" 289 "DFC_ComTOutTCU4" 290 "DFC_DevLibBattUHi" 291 "DFC_DevLibBattULo" 292 "DFC_FanDIOOL_0" 293 "DFC_FanDIOOL_1" 294 "DFC_FanDIOOvrTemp_0" 295 "DFC_FanDIOOvrTemp_1" 296 "DFC_FanDIOSCB_0" 297 "DFC_FanDIOSCB_1" 298 "DFC_FanDIOSCG_0" 299 "DFC_FanDIOSCG_1" 300 "DFC_MRlyDcOL" 301 "DFC_MRlyDcSCB" 302 "DFC_MRlyDcSCG" 303 "DFC_PSPOL" 304 "DFC_PSPOvrTemp" 305 "DFC_PSPSCB" 306 "DFC_PSPSCG" 307 "DFC_T50Err" 308 "DFC_ThrVlvLoBattB1" 309 "DFC_VehVPhysRngHi" 310 "DFC_VehVSclOutOL" 311 "DFC_VehVSclOutOT" 312 "DFC_VehVSclOutSCB" 313 "DFC_VehVSclOutSCG" 314 "DFC_VehVSnsrARngHi" 315 "DFC_VehVSnsrBRngHi" 316 "DFC_VehVSpdRtyDiag" 317 "DFC_VehVWhlErr" 318 "DFC_ACEvpTSRCMax" 319 "DFC_ACEvpTSRCMin" 320 "DFC_AirCClntPAnaSRCMax" 321 "DFC_AirCClntPAnaSRCMin" 322 "DFC_AirCSwtNpl" 323 "DFC_AirCSwtSig" 324 "DFC_Brk" 325 "DFC_BrkSig" 326 "DFC_ClthSig" 327 "DFC_HLSDemOvhtEngLim" 328 "DFC_OilPNpl" 329 "DFC_PIntkVUsLineHiB1" 330 "DFC_PIntkVUsLineLoB1" 331 "DFC_VehVPhysRngLo" 332 "DFC_VehVSigCan" 333 "DFC_VehVSigCanSafe" 334 "DFC_VlvLftFbOilPSnsrIntk11SRCMax" 335 "DFC_VlvLftFbOilPSnsrIntk11SRCMin" 336 "DFC_ClthNpl" 337 "DFC_EV1max" 338 "DFC_EV1min" 339 "DFC_EV1sig" 340 "DFC_EV2max" 341 "DFC_EV2min" 342 "DFC_EV2sig" 343 "DFC_EV3max" 344 "DFC_EV3min" 345 "DFC_EV3sig" 346 "DFC_EV4max" 347 "DFC_EV4min" 348 "DFC_EV4sig" 349 "DFC_GbxPNPosnDrvCdn" 350 "DFC_GbxPNPosnPlausy" 351 "DFC_PEnvCcMax" 352 "DFC_PEnvCcMin" 353 "DFC_PEnvRngChkMax" 354 "DFC_PEnvRngChkMin" 355 "DFC_PEnvSnsrPlaus" 356 "DFC_UEGOHeatrPsS1B1Max" 357 "DFC_UEGOHeatrPsS1B1Min" 358 "DFC_UEGOHeatrPsS1B1Sig" 359 "DFC_UEGOHeatrRlyPsOLS1B1" 360 "DFC_UEGOHeatrRlyPsSCBS1B1" 361 "DFC_UEGOHeatrRlyPsSCGS1B1" 362 "DFC_KnDetSens1PortAMax" 363 "DFC_KnDetSens1PortAMin" 364 "DFC_KnDetSens1PortBMax" 365 "DFC_KnDetSens1PortBMin" 366 "DFC_Clth2ONStuck" 367 "DFC_Clth2ONStuckLdc" 368 "DFC_Clth3ONStuckLdc" 369 "DFC_Clth3ONStuckPostDrv" 370 "DFC_Clth4ONStuck" 371 "DFC_Clth4ONStuckLdc" 372 "DFC_ComDLCTCU01" 373 "DFC_ComDLCTCU02" 374 "DFC_ComDLCTCU1" 375 "DFC_ComDLCTCU11" 376 "DFC_ComDLCTCU12" 377 "DFC_ComDLCTCU13" 378 "DFC_ComDLCTCU14" 379 "DFC_ComDLCTCU2" 380 "DFC_ComDLCTCU3" 381 "DFC_ComDLCTCU4" 382 "DFC_EVX" 383 "DFC_EbsSocFlt" 384 "DFC_I14229VINErr" 385 "DFC_LLRKHmax" 386 "DFC_LLRKHmin" 387 "DFC_LLRmax" 388 "DFC_LLRmin" 389 "DFC_RoughRoad" 390 "DFC_SiaEEPRdErr" 391 "DFC_SiaEEPWrngCod" 392 "DFC_UegoDummy" 393 "DFC_BusDiagCANAPPLBusOff" 394 "DFC_BusDiagCANCANCBusOff" 395 "DFC_BusDiagCANVEHICLEBusOff" 396 "DFC_RBA_IODIAGPWR_rba_IoExtCy329_SignalVltSply_0" 397 "DFC_RBA_IODIAGPWR_rba_IoExtCy329_SignalVltSply_0OT" 398 "DFC_RBA_IODIAGPWR_rba_IoExtCy329_SignalVltSply_0OV" 399 "DFC_RBA_IODIAGPWR_rba_IoExtCy329_SignalVltSply_0SCG" 400 "DFC_RBA_IODIAGPWR_rba_IoExtCy329_SignalVltSply_0UV" 401 "DFC_RBA_IODIAGPWR_rba_IoExtCy329_SignalVltSply_1" 402 "DFC_RBA_IODIAGPWR_rba_IoExtCy329_SignalVltSply_1OT" 403 "DFC_RBA_IODIAGPWR_rba_IoExtCy329_SignalVltSply_1OV" 404 "DFC_RBA_IODIAGPWR_rba_IoExtCy329_SignalVltSply_1SCG" 405 "DFC_RBA_IODIAGPWR_rba_IoExtCy329_SignalVltSply_1UV" 406 "DFC_RBA_IODIAGPWR_rba_IoExtCy329_SignalVltSply_2" 407 "DFC_RBA_IODIAGPWR_rba_IoExtCy329_SignalVltSply_2OT" 408 "DFC_RBA_IODIAGPWR_rba_IoExtCy329_SignalVltSply_2OV" 409 "DFC_RBA_IODIAGPWR_rba_IoExtCy329_SignalVltSply_2SCG" 410 "DFC_RBA_IODIAGPWR_rba_IoExtCy329_SignalVltSply_2UV" 411 "DFC_CAN_E_TIMEOUT" 412 "DFC_LIN_E_TIMEOUT" 413 "DFC_MRlyOL" 414 "DFC_MRlySCB" 415 "DFC_MRlySCG" 416 "DFC_rba_MultiStackTrace_Threshold" 417 "DFC_BSWM_E_ACTION_FAILED" 418 "DFC_BSWM_E_INTRPTQUEUE_FULL" 419 "DFC_RBA_IOEXTLIB_KEEPALIVE_DRV" 420 "DFC_RBA_IOEXTLIB_KEEPALIVE_INI" 421 "DFC_rba_IoSigRtc_StopCounter" 422 "DFC_rba_MRly_Diag_Stk_Event" 423 "DFC_rba_MemDiag_MemReadErr" 424 "DFC_rba_MemDiag_MemWrErr" 425 "DFC_rba_SyC_IrrSwOffTrigEngRun_Event" 426 "DFC_rba_T15_Diag_ComInVld_Event" 427 "DFC_rba_T15_Diag_ComOff_HwOn_Event" 428 "DFC_rba_T15_Diag_ComOn_HwOff_Event" 429 "DFC_AppAllSnsrDfct" 430 "DFC_BattUStdbyDiaOL" 431 "DFC_BigLeakIntkMnfldEmiInfl" 432 "DFC_BrkMnSwtContOnWarnLmp" 433 "DFC_BrkMnSwtNotStpWarnLmp" 434 "DFC_BrkRdntSwtContOnWarnLmp" 435 "DFC_BrkRdntSwtNotStpWarnLmp" 436 "DFC_CEngDsTColdStrtMax" 437 "DFC_CEngDsTColdStrtMin" 438 "DFC_CEngDsTImps" 439 "DFC_CEngDsTPlausLSC" 440 "DFC_CEngDsTPlausSTC" 441 "DFC_CEngDsTSRCMax" 442 "DFC_CEngDsTSRCMin" 443 "DFC_CEngDsTSig" 444 "DFC_CEngUsTSRCMax" 445 "DFC_CEngUsTSRCMin" 446 "DFC_DCDCFltDet" 447 "DFC_DKRSA" 448 "DFC_DKVSmax" 449 "DFC_DKnpl" 450 "DFC_DSSmax" 451 "DFC_DSTTI" 452 "DFC_DSUmax" 453 "DFC_EGRVlvOL" 454 "DFC_EGRVlvSCB" 455 "DFC_EGRVlvSCG" 456 "DFC_EGSDUS2B1LtrDly" 457 "DFC_EGSDUS2B1LtrPT1" 458 "DFC_EGSDUS2B1RtlDly" 459 "DFC_EGSDUS2B1RtlPT1" 460 "DFC_EGSDUS2B1TarLean" 461 "DFC_EGSDUS2B1TarRich" 462 "DFC_ETAKHLmax" 463 "DFC_ETAKHTmax" 464 "DFC_EngICO" 465 "DFC_EngPrtOvrSpdMon" 466 "DFC_EpmCaSI1ErrSig" 467 "DFC_EpmCaSI1NoSig" 468 "DFC_EpmCaSI1OfsErr" 469 "DFC_EpmCrSErrSig" 470 "DFC_EpmCrSNoSig" 471 "DFC_EtaEngIdleNonCsers" 472 "DFC_EtaEngPtlNonCsers" 473 "DFC_FRAmax" 474 "DFC_FRAmin" 475 "DFC_GbxRvsSwtStk" 476 "DFC_HDRmax" 477 "DFC_HEGOS2B1ElecMax" 478 "DFC_HEGOS2B1ElecMin" 479 "DFC_HEGOS2B1ElecSig" 480 "DFC_HEGOS2B1HtgNpl" 481 "DFC_IntkAirTIntkMnfldCrssMax" 482 "DFC_IntkAirTIntkMnfldCrssMin" 483 "DFC_IntkAirTIntkMnfldHSCMax" 484 "DFC_IntkAirTIntkMnfldImps" 485 "DFC_IntkAirTIntkMnfldPRCMax" 486 "DFC_IntkAirTIntkMnfldPRCMin" 487 "DFC_IntkAirTIntkMnfldSRCMax" 488 "DFC_IntkAirTIntkMnfldSRCMin" 489 "DFC_IntkAirTIntkMnfldSTC" 490 "DFC_KS1max" 491 "DFC_KS1min" 492 "DFC_LMmax" 493 "DFC_LZSRnpl" 494 "DFC_LamDynDiagS1B1" 495 "DFC_LeakIntkMnfldEmiInfl" 496 "DFC_MD00max" 497 "DFC_MDBmax" 498 "DFC_MDCat" 499 "DFC_MDCatCrit" 500 "DFC_MDCatCurr" 501 "DFC_MDCyl_0" 502 "DFC_MDCyl_1" 503 "DFC_MDCyl_2" 504 "DFC_MDCyl_3" 505 "DFC_MDEmi" 506 "DFC_MDEmiStrt" 507 "DFC_MDFco" 508 "DFC_MDMpl" 509 "DFC_MDSegTiAdpn" 510 "DFC_MDmax" 511 "DFC_MOXEMM_SMU_ALM0_0" 512 "DFC_MOXEMM_SMU_ALM0_1" 513 "DFC_MOXEMM_SMU_ALM0_10" 514 "DFC_MOXEMM_SMU_ALM0_11" 515 "DFC_MOXEMM_SMU_ALM0_13" 516 "DFC_MOXEMM_SMU_ALM0_14" 517 "DFC_MOXEMM_SMU_ALM0_2" 518 "DFC_MOXEMM_SMU_ALM0_22" 519 "DFC_MOXEMM_SMU_ALM0_23" 520 "DFC_MOXEMM_SMU_ALM0_4" 521 "DFC_MOXEMM_SMU_ALM0_5" 522 "DFC_MOXEMM_SMU_ALM0_7" 523 "DFC_MOXEMM_SMU_ALM0_8" 524 "DFC_MOXEMM_SMU_ALM10_16" 525 "DFC_MOXEMM_SMU_ALM10_17" 526 "DFC_MOXEMM_SMU_ALM10_21" 527 "DFC_MOXEMM_SMU_ALM11_0" 528 "DFC_MOXEMM_SMU_ALM11_1" 529 "DFC_MOXEMM_SMU_ALM11_2" 530 "DFC_MOXEMM_SMU_ALM11_3" 531 "DFC_MOXEMM_SMU_ALM11_4" 532 "DFC_MOXEMM_SMU_ALM11_5" 533 "DFC_MOXEMM_SMU_ALM11_8" 534 "DFC_MOXEMM_SMU_ALM11_9" 535 "DFC_MOXEMM_SMU_ALM1_0" 536 "DFC_MOXEMM_SMU_ALM1_1" 537 "DFC_MOXEMM_SMU_ALM1_10" 538 "DFC_MOXEMM_SMU_ALM1_11" 539 "DFC_MOXEMM_SMU_ALM1_13" 540 "DFC_MOXEMM_SMU_ALM1_14" 541 "DFC_MOXEMM_SMU_ALM1_2" 542 "DFC_MOXEMM_SMU_ALM1_22" 543 "DFC_MOXEMM_SMU_ALM1_23" 544 "DFC_MOXEMM_SMU_ALM1_4" 545 "DFC_MOXEMM_SMU_ALM1_5" 546 "DFC_MOXEMM_SMU_ALM1_7" 547 "DFC_MOXEMM_SMU_ALM1_8" 548 "DFC_MOXEMM_SMU_ALM21_0" 549 "DFC_MOXEMM_SMU_ALM21_16" 550 "DFC_MOXEMM_SMU_ALM21_3" 551 "DFC_MOXEMM_SMU_ALM2_1" 552 "DFC_MOXEMM_SMU_ALM2_10" 553 "DFC_MOXEMM_SMU_ALM2_11" 554 "DFC_MOXEMM_SMU_ALM2_13" 555 "DFC_MOXEMM_SMU_ALM2_14" 556 "DFC_MOXEMM_SMU_ALM2_22" 557 "DFC_MOXEMM_SMU_ALM2_23" 558 "DFC_MOXEMM_SMU_ALM2_4" 559 "DFC_MOXEMM_SMU_ALM2_5" 560 "DFC_MOXEMM_SMU_ALM2_7" 561 "DFC_MOXEMM_SMU_ALM2_8" 562 "DFC_MOXEMM_SMU_ALM6_0" 563 "DFC_MOXEMM_SMU_ALM6_11" 564 "DFC_MOXEMM_SMU_ALM6_12" 565 "DFC_MOXEMM_SMU_ALM6_14" 566 "DFC_MOXEMM_SMU_ALM6_15" 567 "DFC_MOXEMM_SMU_ALM6_17" 568 "DFC_MOXEMM_SMU_ALM6_18" 569 "DFC_MOXEMM_SMU_ALM6_20" 570 "DFC_MOXEMM_SMU_ALM6_21" 571 "DFC_MOXEMM_SMU_ALM6_25" 572 "DFC_MOXEMM_SMU_ALM6_4" 573 "DFC_MOXEMM_SMU_ALM6_5" 574 "DFC_MOXEMM_SMU_ALM6_7" 575 "DFC_MOXEMM_SMU_ALM6_8" 576 "DFC_MOXEMM_SMU_ALM7_1" 577 "DFC_MOXEMM_SMU_ALM7_12" 578 "DFC_MOXEMM_SMU_ALM7_13" 579 "DFC_MOXEMM_SMU_ALM7_14" 580 "DFC_MOXEMM_SMU_ALM7_15" 581 "DFC_MOXEMM_SMU_ALM7_16" 582 "DFC_MOXEMM_SMU_ALM7_17" 583 "DFC_MOXEMM_SMU_ALM7_2" 584 "DFC_MOXEMM_SMU_ALM7_20" 585 "DFC_MOXEMM_SMU_ALM7_25" 586 "DFC_MOXEMM_SMU_ALM7_26" 587 "DFC_MOXEMM_SMU_ALM7_28" 588 "DFC_MOXEMM_SMU_ALM7_29" 589 "DFC_MOXEMM_SMU_ALM7_30" 590 "DFC_MOXEMM_SMU_ALM7_31" 591 "DFC_MOXEMM_SMU_ALM8_0" 592 "DFC_MOXEMM_SMU_ALM8_1" 593 "DFC_MOXEMM_SMU_ALM8_10" 594 "DFC_MOXEMM_SMU_ALM8_11" 595 "DFC_MOXEMM_SMU_ALM8_12" 596 "DFC_MOXEMM_SMU_ALM8_16" 597 "DFC_MOXEMM_SMU_ALM8_18" 598 "DFC_MOXEMM_SMU_ALM8_2" 599 "DFC_MOXEMM_SMU_ALM8_3" 600 "DFC_MOXEMM_SMU_ALM8_31" 601 "DFC_MOXEMM_SMU_ALM8_4" 602 "DFC_MOXEMM_SMU_ALM9_0" 603 "DFC_MOXEMM_SMU_ALM9_15" 604 "DFC_MOXEMM_SMU_ALM9_3" 605 "DFC_MoCADCNTP" 606 "DFC_MoCADCTst" 607 "DFC_MoCSOPICO" 608 "DFC_MoFAPP" 609 "DFC_MoFAirFilgPrdc" 610 "DFC_MoFAirFlCtOffPfi" 611 "DFC_MoFAirFlCylPfi" 612 "DFC_MoFAirFlIn" 613 "DFC_MoFAirFlMixCtlPfiChkAirFl" 614 "DFC_MoFAirFlMixCtlPfiChkCtrl" 615 "DFC_MoFAirFlMode" 616 "DFC_MoFESpd" 617 "DFC_MoFIACo" 618 "DFC_MoFICOL1" 619 "DFC_MoFICOL2" 620 "DFC_MoFStrt" 621 "DFC_MoFTrqCmp" 622 "DFC_MoFTrqCmpMax" 623 "DFC_MoFTrqCmpMin" 624 "DFC_MoFVarPostBldSel" 625 "DFC_MoXEMMHwLTMCUFW" 626 "DFC_MoXEMMHwLTMonBIST" 627 "DFC_MoXEMMHwLTRegMonTest" 628 "DFC_MoXEMMHwLTStbySMUAlvTest" 629 "DFC_MoXEMMHwLTTempSens" 630 "DFC_MoXEMMHwLTUCBCfg" 631 "DFC_OCWDAABEActv" 632 "DFC_OCWDACom" 633 "DFC_OCWDAErrPin" 634 "DFC_OCWDAOvrVltg" 635 "DFC_ORAmax" 636 "DFC_ORAmin" 637 "DFC_PLLSUmax" 638 "DFC_PLLSUmin" 639 "DFC_PSR1max" 640 "DFC_PSRBmax" 641 "DFC_PSRBmin" 642 "DFC_PSRPmax" 643 "DFC_PSRPmin" 644 "DFC_PSRPsig" 645 "DFC_PSRmax" 646 "DFC_PUmax" 647 "DFC_P_VSE11_OL" 648 "DFC_P_VSE11_SCB" 649 "DFC_P_VSE11_SCG" 650 "DFC_PhyHighAPP1" 651 "DFC_PhyHighAPP2" 652 "DFC_PhyLowAPP1" 653 "DFC_PhyLowAPP2" 654 "DFC_SRCHighAPP1" 655 "DFC_SRCHighAPP2" 656 "DFC_SRCLowAPP1" 657 "DFC_SRCLowAPP2" 658 "DFC_SSpMon2" 659 "DFC_SWReset_0" 660 "DFC_SWReset_1" 661 "DFC_SWReset_2" 662 "DFC_SyncAPP" 663 "DFC_TAmax_Dummy" 664 "DFC_TKAEmax" 665 "DFC_TKAEmin" 666 "DFC_TKARmax" 667 "DFC_TKARnpl" 668 "DFC_TMmax_Dummy" 669 "DFC_TUMmax_Dummy" 670 "DFC_TWCDPriCatB1" 671 "DFC_ThrVlvClsdPosnFirstOffsLrnImpoB1" 672 "DFC_ThrVlvClsdPosnOffsLrnImpoB1" 673 "DFC_ThrVlvClsdPosnOffsLrnMaxB1" 674 "DFC_ThrVlvClsdPosnOffsLrnMinB1" 675 "DFC_ThrVlvCtrlDeB1" 676 "DFC_ThrVlvDycB1" 677 "DFC_ThrVlvLimpAirPosnMaxAbsltDriftB1" 678 "DFC_ThrVlvLimpAirPosnMaxB1" 679 "DFC_ThrVlvLimpAirPosnMaxRelDriftB1" 680 "DFC_ThrVlvLimpAirPosnMinB1" 681 "DFC_ThrVlvOpenLoadB1" 682 "DFC_ThrVlvOpenSprgB1" 683 "DFC_ThrVlvOpenSprgSprdB1" 684 "DFC_ThrVlvOpenSprgTwnB1" 685 "DFC_ThrVlvOverTB1" 686 "DFC_ThrVlvRetSprgB1" 687 "DFC_ThrVlvRetSprgSprdB1" 688 "DFC_ThrVlvRetSprgTwnB1" 689 "DFC_ThrVlvSens1MaxB1" 690 "DFC_ThrVlvSens1NplB1" 691 "DFC_ThrVlvSens2MaxB1" 692 "DFC_ThrVlvSens2MinB1" 693 "DFC_ThrVlvSens2NplB1" 694 "DFC_ThrVlvShoCircB1" 695 "DFC_ThrVlvSpiErrB1" 696 "DFC_ThrvlvSens1MinB1" 697 "DFC_TiOffTBasdChkFast" 698 "DFC_TiOffTBasdChkSlow" 699 "DFC_UEGOHeatrCtlS1B1" 700 "DFC_UEGOSnsrMntdS1B1" 701 "DFC_VehVSig" 702 "DFC_VlvLftFbSwtIntk11SpclFail" 703 "DFC_VlvLftFbSwtIntk11StdFail" 704 "DSQ_ACClntP" 705 "DSQ_ACEvpT" 706 "DSQ_AirCCmprActr" 707 "DSQ_BattU" 708 "DSQ_BattULo" 709 "DSQ_CoVMDIDASFail" 710 "DSQ_DSMInhibitAlways" 711 "DSQ_ElecLd" 712 "DSQ_EngICO" 713 "DSQ_EpmCaSSigQuality" 714 "DSQ_EpmReverseRun" 715 "DSQ_FanDIO_0" 716 "DSQ_FanDIO_1" 717 "DSQ_FuelP" 718 "DSQ_FuelT" 719 "DSQ_GbxPNPos" 720 "DSQ_GbxPosNotPN" 721 "DSQ_MRly" 722 "DSQ_PEnvMeasVld" 723 "DSQ_PEnvVld" 724 "DSQ_PEnv_pRaw" 725 "DSQ_PThrVlvUs" 726 "DSQ_PThrVlvUsB1" 727 "DSQ_StrtImobChk" 728 "DSQ_TDevCenColdStrt" 729 "DSQ_UEGOHeatrPwrOKS1B1" 730 "DSQ_UEGOIPmpS1B1" 731 "DSQ_UEGOLamS1B1" 732 "DSQ_UEGOTCtrlS1B1" 733 "DSQ_VehV" 734 "DSQ_VehVSnsr" 735 "DSQ_stAPP" 736 "DSQ_stComEAT4" 65535 "Inhibited_Trip" DEFAULT_VALUE "---" /end COMPU_VTAB
/begin COMPU_METHOD DFC_OneToOne "" RAT_FUNC "%6.2" "-" COEFFS 0 1 0 0 0 1 /end COMPU_METHOD
/begin COMPU_METHOD DINH_FIdVerb "" TAB_VERB "%6.3" "-" COMPU_TAB_REF DINH_FIdVerb /end COMPU_METHOD
/begin COMPU_VTAB DINH_FIdVerb "" TAB_VERB 733 0 "FId_Unused" 1 "FID_AFRA" 2 "FID_AORA" 3 "FID_ATEH" 4 "FID_ATEL" 5 "FID_ATEN" 6 "FId_EGSDCmnSeg1B1Parl" 7 "FID_BLLRH" 8 "FID_BLLRKH" 9 "FID_BPLSU" 10 "FId_CJ135RvsChrgMeasS1B1" 11 "FId_CatHeatgColdStrtReq" 12 "FId_CatHeatgWrmReq" 13 "FId_EGSDO2SnsrMntdRelsS1B1" 14 "FId_EGSDO2_LamOffsFastS1B1" 15 "FId_MisfDetDnAdpnNv" 16 "FID_BGFKMS" 17 "FID_CDSTTI" 18 "FID_CETKHL" 19 "FID_CETKHT" 20 "FID_CGLSRDP" 21 "FID_CLLKHV" 22 "FID_CLLRHV" 23 "FID_CLZSRDP" 24 "FID_CNSAD" 25 "FID_CNSAD2" 26 "FID_CPFISTRT" 27 "FID_CPSRB" 28 "FID_CPSRP" 29 "FID_DKRSA" 30 "FID_DLLRBandEndTst" 31 "FID_DLLRShrtTrpSpdRmp" 32 "FID_FEDKAPB" 33 "FID_FEDSSB" 34 "FID_FOFSTP" 35 "FID_FONSTP" 36 "FID_FUEDK" 37 "FID_LRADLSU" 38 "FID_LRALSVErr" 39 "FID_LRAPLLSU" 40 "FID_LUSTP" 41 "FID_LnKS1" 42 "FID_PLSUV" 43 "FID_PSRMOZDG" 44 "FID_PSRMOZG" 45 "FID_STRTDIA" 46 "FID_STRTSTM" 47 "FID_TFA1CSMW" 48 "FID_TKACSMW" 49 "FID_TMCSMW" 50 "FID_TOCHOilSwmpTQly" 51 "FID_TOCHTME" 52 "FID_TOSPCSMW" 53 "FID_UEGOHeatrRlyS1B1" 54 "FID_VehStvSSEOk" 55 "FID_VldtLamPlausMaxS1B1" 56 "FID_VldtLamPlausMinS1B1" 57 "FId_ACClntPSSPMon" 58 "FId_ACCompComCANBusOff" 59 "FId_ACCompComCANErrMtr" 60 "FId_ACComp_HiUTWSnsrErr" 61 "FId_ACComp_LoUTWSnsrErr" 62 "FId_ACComp_PDSnsrErr" 63 "FId_ACComp_VehSpdSnsrErr" 64 "FId_ACCtl_ACStrtCut" 65 "FId_ACCtl_APP1" 66 "FId_ACCtl_APP2" 67 "FId_ACCtl_APPSync" 68 "FId_ACCtl_AcOff" 69 "FId_ACCtl_Clmb" 70 "FId_ACCtl_DK1" 71 "FId_ACCtl_DK2" 72 "FId_ACCtl_DKSync" 73 "FId_ACCtl_VehSpdSnsrErr" 74 "FId_ACCtl_pAC" 75 "FId_ACEvpTCANErr" 76 "FId_ACEvpTFrzVal" 77 "FId_ACEvpTRplVal" 78 "FId_APP1SigPath" 79 "FId_APP2SigPath" 80 "FId_APPBrkErr" 81 "FId_APPLETVldnErr" 82 "FId_APPLrn" 83 "FId_APPVehVErr" 84 "FId_AccPedDrvModComErr" 85 "FId_AccPedDrvModFailr" 86 "FId_AccPedNMaxLim" 87 "FId_AccPedNMinLim" 88 "FId_AccPedNMinLimBrkApp" 89 "FId_AccPedTrqLim" 90 "FId_AirCClntPFrzVal" 91 "FId_AirCClntPRplVal" 92 "FId_AirCSwt" 93 "FId_AirDvPAdpnPEnv" 94 "FId_AirDvPAdpnPIntkVUsB1" 95 "FId_AirDvPPSnsrAdpn_PModeActv" 96 "FId_AltACGFailr" 97 "FId_AltAPPErrSt" 98 "FId_AltBattMngtFailr" 99 "FId_AltBrkErrSt" 100 "FId_AltComErr" 101 "FId_AltENGB" 102 "FId_AltElecLoadErr" 103 "FId_AltEnvTErr" 104 "FId_AltFFAltLoadFast" 105 "FId_AltFFAltLoadSlow" 106 "FId_AltIOACGErr" 107 "FId_AltIOACGLinComFailr" 108 "FId_AltIOComErr" 109 "FId_AltLinErr" 110 "FId_AltPwr" 111 "FId_AltVehVErrSt" 112 "FId_BGFKMSEPSR" 113 "FId_BGFKMSEPU" 114 "FId_BGFKMSESumClr" 115 "FId_BGFKMSZPSR" 116 "FId_BGOSCCat1B1" 117 "FId_BGOSCCat2B1" 118 "FId_BattAltFailr" 119 "FId_BattMngtFailr" 120 "FId_BattSigPtd" 121 "FId_BattU2MEDSRC" 122 "FId_BattUDrpPrvOff" 123 "FId_BattUFrzVal" 124 "FId_BattUHiFailrEna" 125 "FId_BattUIMGTCUCANFailr" 126 "FId_BattULoFailrEna" 127 "FId_BattUReplVal" 128 "FId_BattUSRC" 129 "FId_BlwrComErr" 130 "FId_BrkBstPDetnInhbn" 131 "FId_BrkBstPMstCylPSnsrFail" 132 "FId_BrkBstPSnsrStuckDetn" 133 "FId_BrkMnSwtErr" 134 "FId_BrkPOilPres" 135 "FId_BrkPedEngStopEna" 136 "FId_BrkRdntSwtErr" 137 "FId_CAGRSDS" 138 "FId_CEngDsTColdStrt" 139 "FId_CEngDsTColdStrtErr" 140 "FId_CEngDsTLSC" 141 "FId_CEngDsTPlausErr" 142 "FId_CEngDsTReplMdlEngStop" 143 "FId_CEngDsTSTC" 144 "FId_CEngDsTSnsrElec" 145 "FId_CEngDsTSwtReplMdl" 146 "FId_CEngUsTElecErr" 147 "FId_CEngUsTSnsrElecErr" 148 "FId_CEngUsTSwtReplMdl" 149 "FId_CJ135CtlFullAltvS1B1" 150 "FId_CJ135CtlIPmpAltvS1B1" 151 "FId_CJ135CtlIPmpS1B1" 152 "FId_CJ135CtlRParlTstdS1B1" 153 "FId_CJ135CtlS1B1" 154 "FId_CJ135CtlSnsrHotS1B1" 155 "FId_CJ135DiagSnsrS1B1" 156 "FId_CJ135IPmpNoBiasS1B1" 157 "FId_CJ135IPmpNoErrS1B1" 158 "FId_CMSUDKSOM1" 159 "FId_CMSUDKSOM2" 160 "FId_CSTRTCTL" 161 "FId_Cj135DiagAsicS1B1" 162 "FId_Cj135DiagOlEnaNotEnfS1B1" 163 "FId_Cj135DiagOlEnaS1B1" 164 "FId_Cj135DiagSpiS1B1" 165 "FId_Cj135DiagWireRprtS1B1" 166 "FId_Cj135DiagWireS1B1" 167 "FId_Cj135Dummy" 168 "FId_Cj135PerdDiagOperEnaS1B1" 169 "FId_ClntTempENGB" 170 "FId_Clth" 171 "FId_Clth2" 172 "FId_Clth3StuckOn" 173 "FId_Clth4" 174 "FId_ClthCAN" 175 "FId_ClthMax" 176 "FId_ClthStk" 177 "FId_ClthStkErr" 178 "FId_ClthStkFailr" 179 "FId_ClthStkOFFStuck" 180 "FId_ClthStkONStuck" 181 "FId_ClthSwtFailr" 182 "FId_CoEOMGdiEomErrLcy" 183 "FId_CoETM" 184 "FId_CoETS_StTrqLimErr1" 185 "FId_CoETS_StTrqLimErr2" 186 "FId_CoEngStopEnblStSpEngT" 187 "FId_CoEngStopEnblStSpLSU" 188 "FId_CoEngStopEnblStSpTcT" 189 "FId_CoEngStopEnblSysErr" 190 "FId_CoEngVlvLftSpIntk" 191 "FId_CoPOMStrtgDevStrtr" 192 "FId_CoPOM_FirstStrtAut" 193 "FId_CoTS_SwtOff" 194 "FId_CoVOMACCComFailr" 195 "FId_CoVOMBrkPedISABSigFailr" 196 "FId_CoVOMEngCrkAbort" 197 "FId_CoVOMEngRstrtEnaCdn" 198 "FId_CoVOMISSEng" 199 "FId_ComACRly" 200 "FId_ComAPPSensFail" 201 "FId_ComAPedl" 202 "FId_ComAYCA" 203 "FId_ComAYCAMon" 204 "FId_ComAYCD" 205 "FId_ComAYCDMon" 206 "FId_ComAYCF" 207 "FId_ComAYCFMon" 208 "FId_ComAYCG" 209 "FId_ComAYCGMon" 210 "FId_ComAYCI" 211 "FId_ComAYCIMon" 212 "FId_ComAirPThrUsSnsrErr" 213 "FId_ComAltFail" 214 "FId_ComAppVehSnsrFailr" 215 "FId_ComBCM1" 216 "FId_ComBCM1Mon" 217 "FId_ComBstCtrl" 218 "FId_ComCANVEHICLEBusOff" 219 "FId_ComCGW1" 220 "FId_ComCGW1Mon" 221 "FId_ComClthSt" 222 "FId_ComConvClth" 223 "FId_ComCrCtlReq" 224 "FId_ComCrsMaiIndcnLampReq" 225 "FId_ComCrsSetIndcnLampReq" 226 "FId_ComDCDCCdn" 227 "FId_ComDesGearCurr" 228 "FId_ComDetrmAirM" 229 "FId_ComDwnShiftCtrlReq" 230 "FId_ComEAT1" 231 "FId_ComEAT10" 232 "FId_ComEAT10Mon" 233 "FId_ComEAT11" 234 "FId_ComEAT11Mon" 235 "FId_ComEAT12" 236 "FId_ComEAT12Mon" 237 "FId_ComEAT13" 238 "FId_ComEAT13Mon" 239 "FId_ComEAT1Mon" 240 "FId_ComEAT2" 241 "FId_ComEAT2Mon" 242 "FId_ComEAT4" 243 "FId_ComEAT4Mon" 244 "FId_ComEAT6" 245 "FId_ComEAT6Mon" 246 "FId_ComEAT7" 247 "FId_ComEAT7Mon" 248 "FId_ComEAT8" 249 "FId_ComEAT8Mon" 250 "FId_ComEATA" 251 "FId_ComEATAMon" 252 "FId_ComEATB" 253 "FId_ComEATBMon" 254 "FId_ComEATC" 255 "FId_ComEATCMon" 256 "FId_ComEBBA" 257 "FId_ComEBBAMon" 258 "FId_ComECUHwErr" 259 "FId_ComEMSIntAirTemp" 260 "FId_ComEPS1" 261 "FId_ComEPS1Mon" 262 "FId_ComEngBrkOvrdInfo" 263 "FId_ComEngBrkOvrdMtr" 264 "FId_ComEngBrkSwErr" 265 "FId_ComEngPosng" 266 "FId_ComEngRPMLim" 267 "FId_ComEngTrqLim" 268 "FId_ComEnvtlAirPSnsrErr" 269 "FId_ComEstmTqNormJdg" 270 "FId_ComEthnlSErr" 271 "FId_ComEwpErr" 272 "FId_ComFlSply" 273 "FId_ComFuCnsBitDurgIdleStop" 274 "FId_ComGEVCntrl" 275 "FId_ComGbxNPosFail" 276 "FId_ComGbxTemp" 277 "FId_ComGwIMG1" 278 "FId_ComGwIMG1Mon" 279 "FId_ComGwIMG3" 280 "FId_ComGwIMG3Mon" 281 "FId_ComGwIMG4" 282 "FId_ComGwIMG4Mon" 283 "FId_ComGwIMG5" 284 "FId_ComGwIMG5Mon" 285 "FId_ComGwIMG6" 286 "FId_ComGwIMG6Mon" 287 "FId_ComHFMSnsrErr" 288 "FId_ComIDASB" 289 "FId_ComIDASBMon" 290 "FId_ComIDASEngFail" 291 "FId_ComISG2" 292 "FId_ComIgnCtrl" 293 "FId_ComInjCtrl" 294 "FId_ComIntkAirPSnsrErr" 295 "FId_ComLamCtrl" 296 "FId_ComMETA" 297 "FId_ComMETAMon" 298 "FId_ComMETC" 299 "FId_ComMETCMon" 300 "FId_ComMETD" 301 "FId_ComMETDMon" 302 "FId_ComMETE2" 303 "FId_ComMETE2Mon" 304 "FId_ComMETF" 305 "FId_ComMETFMon" 306 "FId_ComMETG" 307 "FId_ComMETGMon" 308 "FId_ComMETH" 309 "FId_ComMETH2" 310 "FId_ComMETH2Mon" 311 "FId_ComMETHMon" 312 "FId_ComMETI" 313 "FId_ComMETIMon" 314 "FId_ComMETK" 315 "FId_ComMETKMon" 316 "FId_ComMETL" 317 "FId_ComMETLMon" 318 "FId_ComMETM" 319 "FId_ComMETMMon" 320 "FId_ComMETN" 321 "FId_ComMETNMon" 322 "FId_ComMisf" 323 "FId_ComMon" 324 "FId_ComNTrbn" 325 "FId_ComODOff" 326 "FId_ComOilLvlLamp" 327 "FId_ComOilPWarnLamp" 328 "FId_ComPASensFail" 329 "FId_ComPBSensFail" 330 "FId_ComPCU" 331 "FId_ComPCUMon" 332 "FId_ComPosActnSpdLimrFctReq" 333 "FId_ComSRS" 334 "FId_ComSRSA" 335 "FId_ComSRSAMon" 336 "FId_ComSRSB" 337 "FId_ComSRSBMon" 338 "FId_ComSRSMon" 339 "FId_ComSTFlt" 340 "FId_ComSpdLimrDevActvn" 341 "FId_ComTCU01" 342 "FId_ComTCU02" 343 "FId_ComTCU1" 344 "FId_ComTCU11" 345 "FId_ComTCU12" 346 "FId_ComTCU13" 347 "FId_ComTCU14" 348 "FId_ComTCU2" 349 "FId_ComTCU3" 350 "FId_ComTCU4" 351 "FId_ComTCUGear" 352 "FId_ComTarGearDwnShift" 353 "FId_ComTarGearUpShift" 354 "FId_ComThrPosnFail" 355 "FId_ComThrVlv" 356 "FId_ComTrboChrgnErr" 357 "FId_ComTrqAccuracySlow" 358 "FId_ComTrqReqFast" 359 "FId_ComTrqReqSlow" 360 "FId_ComVSAErr" 361 "FId_ComVehSpdFltChk" 362 "FId_ComVehSpdImpsErr" 363 "FId_ComVlvLftCtrl" 364 "FId_ComvolEng" 365 "FId_ConvLdCalcLvrPos" 366 "FId_ConvLdNTrbnCan" 367 "FId_ConvLdOilCoolrPmp" 368 "FId_ConvLdOilTemp" 369 "FId_ConvLdTrqLdCan" 370 "FId_ConvLdVel" 371 "FId_CptProtnExhTempMdl" 372 "FId_CptProtnO2SnsrB1" 373 "FId_CptProtnVVeh" 374 "FId_CrCUI1EFRxErr" 375 "FId_CrCUICANRxErr" 376 "FId_CrCUIFCMRxErr" 377 "FId_CrCUIMETDRxErr" 378 "FId_CrCtlACCRxErr" 379 "FId_CrCtlAppSnsrErr" 380 "FId_CrCtlShutOffEng" 381 "FId_DIUMPRCldStrtMon" 382 "FId_DIUMPRGenDenom1" 383 "FId_DIUMPRGenDenom2" 384 "FId_DIUMPRGenDenom3" 385 "FId_DIUMPRIgn" 386 "FId_DOGov" 387 "FId_DSMWarmUpCycle" 388 "FId_DewDetTKAMax" 389 "FId_DkrsaEpmNoSig" 390 "FId_EBBCANErrFrzVal" 391 "FId_EBBCANErrReplVal" 392 "FId_EGLZSR" 393 "FId_EGSDO2OffsRstDsmS1B1" 394 "FId_EGSDO2_LamOffsSlowS1" 395 "FId_EGSDUS2B1LtrDly" 396 "FId_EGSDUS2B1LtrPT1" 397 "FId_EGSDUS2B1RtlDly" 398 "FId_EGSDUS2B1RtlPT1" 399 "FId_EGSDUS2B1TarEvln" 400 "FId_EGSDUS2B1TarLean" 401 "FId_EGSDUS2B1TarRich" 402 "FId_ELZSR" 403 "FId_EPBErr" 404 "FId_EPBFrmErr" 405 "FId_EPBFrmErrClth" 406 "FId_EVPComFailr" 407 "FId_EbsLinErr" 408 "FId_EepReadWrState" 409 "FId_ElecLdComErr" 410 "FId_ElecLdFrzVal" 411 "FId_ElecLdHdLiComErr" 412 "FId_ElecLdRplVal" 413 "FId_ElecLoadEPSComErr" 414 "FId_EngBlkTWrn" 415 "FId_EngCooltTFail" 416 "FId_EngDemTqLimnCamsftErr" 417 "FId_EngDemTqLimnErrThmstHeatCtrlCirc" 418 "FId_EngDemTqLimnOilPmp" 419 "FId_EngDemTrqLimErrAPP" 420 "FId_EngIntkAirFail" 421 "FId_EngPrtErrVehV" 422 "FId_EngSpd30DegFail" 423 "FId_EngStrtEnaEthAdap" 424 "FId_EngStrt_InjProhb" 425 "FId_EngTqRvsnEnaFlg" 426 "FId_EnvTPrimMod" 427 "FId_EnvTPrimModIniVal" 428 "FId_EnvTSensSum" 429 "FId_EnvTtCEngDsT" 430 "FId_EnvTtIntkMnfld" 431 "FId_EpmBCr" 432 "FId_EpmCaSAdapCaSI1" 433 "FId_EpmCaSAdapRstI1" 434 "FId_EpmCaSDiagI1" 435 "FId_EpmCaSErrCaSI1" 436 "FId_EpmCaSOfsDiagCaSI1" 437 "FId_EpmCaSOfsErrCaSI1" 438 "FId_EpmCaSSegI1" 439 "FId_EpmCaSSpdPlausI1" 440 "FId_EpmCrSDiag" 441 "FId_EpmCrSDiagVeh" 442 "FId_EpmCrSErr" 443 "FId_EpmRRSCrSFaultCheck" 444 "FId_EpmRRSVehVFaultChck" 445 "FId_EpmSynLockCaSSync" 446 "FId_EtaEngIdleNonCsers" 447 "FId_EtaEngPtlNonCsers" 448 "FId_FanCtlACClntP" 449 "FId_FanCtlACGModFail" 450 "FId_FanCtlAPP1" 451 "FId_FanCtlAPP2" 452 "FId_FanCtlAPPSync" 453 "FId_FanCtlBlowrU" 454 "FId_FanCtlCooltT" 455 "FId_FanCtlCooltT2" 456 "FId_FanCtlEnvT" 457 "FId_FanCtlLiSwtInfo" 458 "FId_FanCtlSpd" 459 "FId_FanCtlTSnsrErr" 460 "FId_FanCtlThr1" 461 "FId_FanCtlThr2" 462 "FId_FcoReq" 463 "FId_FiMFID_rba_MRly_Diag_Stk" 464 "FId_FlMALamDynDiag" 465 "FId_FuEvapPurgTCpvDty" 466 "FId_FuMixUegoErrExcl" 467 "FId_GEVCtlVlvLftEnaIntk" 468 "FId_GbxAnNeutPosnErr" 469 "FId_GbxCANDigPlausErr" 470 "FId_GbxCANNeutSigErr" 471 "FId_GbxPNPosSig" 472 "FId_GbxPNPosnComErr" 473 "FId_GbxPNPosnDiagDrvCdnRels" 474 "FId_GbxPNPosnDiagDrvCodnHealRels" 475 "FId_GbxPNPosnDiagPlausyRels" 476 "FId_GbxPNPosnSubsVal" 477 "FId_GbxRvsSwtStk" 478 "FId_GbxSnsrSplyUErr" 479 "FId_GbxSpstReqOk" 480 "FId_GlbDaLSumvXPtd" 481 "FId_GslThrVlvSnsrDiagB1" 482 "FId_HEGOS2B1DElec" 483 "FId_HEGOS2B1DHtg" 484 "FId_HEGOS2B1Htg" 485 "FId_HEGOS2B1HtrPsSt" 486 "FId_HEGOS2B1InVld" 487 "FId_HEGOS2B1LSPsDiaDi" 488 "FId_HLSDemBrkFlt" 489 "FId_HLSDemIntkAirTemp" 490 "FId_HLSDemMotTemp" 491 "FId_HLSDemMstCyldpVld" 492 "FId_HLSDemOvhtExhMnf" 493 "FId_HLSDemOvhtFanR" 494 "FId_HLSDemOvhtGear" 495 "FId_HLSDemOvhtTum" 496 "FId_HLSDemOvhtVehV" 497 "FId_HLSDemSpdClthGearAccrSigErr" 498 "FId_HLSDem_DrvOffSuprt" 499 "FId_HLSDem_DrvOffSuprtBrkHldSys" 500 "FId_HLSDem_DrvOffSuprtLAS" 501 "FId_HLSDem_PModeActv" 502 "FId_HLSDem_TModeActv" 503 "FId_HLSDem_TraSubFcn" 504 "FId_HLSDem_nMaxLimErr1" 505 "FId_HLSDem_nMaxLimErr2" 506 "FId_HLSDem_nMaxLimErr3" 507 "FId_HLSDem_nMaxVErr" 508 "FId_I14229APP" 509 "FId_I14229CANErr" 510 "FId_I14229EWPErr" 511 "FId_I14229TrbCh" 512 "FId_I14229VTCErr" 513 "FId_IMGISABComErr" 514 "FId_InhbLamDynS1B1" 515 "FId_InhibitAlways" 516 "FId_InhibitNever" 517 "FId_InjVvgPFIEV1" 518 "FId_InjVvgPFIEV2" 519 "FId_InjVvgPFIEV3" 520 "FId_InjVvgPFIEV4" 521 "FId_IntkAirTIntkMnfldCrssChk" 522 "FId_IntkAirTIntkMnfldPlausChk" 523 "FId_IntkAirTIntkMnfldRepl" 524 "FId_IntkAirTSnsr1Elec" 525 "FId_IntkAirTSnsr1PRC" 526 "FId_IntkAirTSnsr1Sum" 527 "FId_IntkArTempENGB" 528 "FId_LIGovDfrstI" 529 "FId_LIGovUndrBrk" 530 "FId_LINDCDCRxErr" 531 "FId_LLimAppSnsrErr" 532 "FId_LLimAppSnsrSyncErr" 533 "FId_LLimMTVehSpdSnsrErr" 534 "FId_LLimShutOffEng" 535 "FId_LRSEBMisf" 536 "FId_LZSR" 537 "FId_LeakToMnfldTstd" 538 "FId_MaiLoadSnsr" 539 "FId_MisfDetDnAdpn" 540 "FId_MisfDetDnAdpnPlaus" 541 "FId_MisfDetEnvP" 542 "FId_MisfDetSegTiAdpnFco" 543 "FId_MisfDetShtrpAct" 544 "FId_MisfDetStc" 545 "FId_MisfDetV" 546 "FId_MisfDetVWhlFrntLe" 547 "FId_MisfDetVWhlFrntRi" 548 "FId_MisfDetVWhlReLe" 549 "FId_MisfDetVWhlReRi" 550 "FId_MisfDet_InjLockdOpen01" 551 "FId_MisfDet_InjLockdOpen02" 552 "FId_MisfDet_InjLockdOpen03" 553 "FId_MisfDet_InjLockdOpen04" 554 "FId_NLimVehHalt" 555 "FId_NSHTDAmbT" 556 "FId_NSHTDEngT" 557 "FId_NSHTILimHiAltiLoIdleSp" 558 "FId_O2StorgMdlMD" 559 "FId_OilCmbdSen_LvlDfctHW" 560 "FId_OilSwmpTCEngDsTWrmUp" 561 "FId_OilSwmpT_B_tospg" 562 "FId_OilSwmpT_B_tospgg" 563 "FId_OilSwmpT_CmbdSnsrErr" 564 "FId_OilSwmpT_CmbdSnsrTiTErr" 565 "FId_OilSwmpT_EnvT" 566 "FId_OilSwmpT_TSnsrErr" 567 "FId_PEnvMeasVld" 568 "FId_PEnvModel" 569 "FId_PEnvPlausDiagVDD" 570 "FId_PEnvRawVldVDD" 571 "FId_PEnvRefSnsr" 572 "FId_PEnvSigRngVld" 573 "FId_PEnvSnsrPlausVDD" 574 "FId_PEnvVldVDD" 575 "FId_PIDA6SigSrcErr" 576 "FId_PIntkMnfldPlaus" 577 "FId_PIntkVUsElecDiagB1" 578 "FId_PSPCtlDisbl" 579 "FId_PSPCtlPreRun" 580 "FId_PSPDiagDisbl" 581 "FId_PTGripConv" 582 "FId_PTGripConvStrt" 583 "FId_PTGripMnlClth" 584 "FId_PTGripMnlClthStrt" 585 "FId_PTTrqRatCANPtd" 586 "FId_PThrVlVUsVldB1" 587 "FId_PThrVlvUsMeasdVldB1" 588 "FId_P_VSE11_Diag" 589 "FId_PrmId03_FltRdnS1B1" 590 "FId_PrmId03_FltUegoS1B1" 591 "FId_SSEEPBRelease" 592 "FId_SSEFCANPRelease" 593 "FId_SSEPTCANPRelease" 594 "FId_SSEStartRelease" 595 "FId_SSEStartReleaseMTCl10" 596 "FId_SSEStartReleaseMTCl100" 597 "FId_SSEStartReleaseMTCl20" 598 "FId_SSEStartReleaseMTCl90" 599 "FId_SSEStartRequest" 600 "FId_SSEStopRelease" 601 "FId_SSEStrtStopRelease" 602 "FId_SSESysOff" 603 "FId_SSEUI2DCSysFailr" 604 "FId_SSEUIBCANErr" 605 "FId_SSEUISysFail" 606 "FId_SiaEEPErr" 607 "FId_StrtCrkSnsrFailr" 608 "FId_StrtCtlAutoCrkModeCdn" 609 "FId_StrtCtlComEngStrtErr" 610 "FId_StrtCtlNPCdnCncl" 611 "FId_StrtCtlNoCpuFailr" 612 "FId_StrtCtlNoFailCanLine" 613 "FId_StrtCtlNoFailPTCanLine" 614 "FId_StrtCtlNoTCUFail" 615 "FId_StrtCtlPNPosnSubsVal" 616 "FId_StrtCtlSTMFailr" 617 "FId_StrtErrShaft" 618 "FId_StrtrRlyFailr" 619 "FId_SumErrHndlg" 620 "FId_SysDiagComErr" 621 "FId_SysDiagModInhbErr" 622 "FId_TOSPM" 623 "FId_TWCCILckExtd" 624 "FId_TWCCIRstB1" 625 "FId_TWCCIRstDSMClearB1" 626 "FId_TWCCLsuB1" 627 "FId_TWCCLsuCyc" 628 "FId_TWCCLsuDynB1" 629 "FId_TWCCMisfDetn" 630 "FId_TWCDPriCatParB1" 631 "FId_TWCDPriCatVldnB1" 632 "FId_ThrVlvMon" 633 "FId_ThrVlvOffsLrnPrmsB1" 634 "FId_TiOffTBasdChkFast" 635 "FId_TiOffTBasdChkSlow" 636 "FId_TiOffVdClk" 637 "FId_TqDecelOffsInhb" 638 "FId_TraAddAirCANPtd" 639 "FId_TraAddClntCANPtd" 640 "FId_TraFwdRvsCluInfo" 641 "FId_TraGbxNPos" 642 "FId_TraGearInfoCanCom" 643 "FId_TraGearInfoDet" 644 "FId_TraGearInfoGearShftActv" 645 "FId_TraGearInfoInfoCan" 646 "FId_TraGearInfoLevPos" 647 "FId_TraGearInfoLoRng" 648 "FId_TraGearInfoRTra" 649 "FId_TraGearInfoRevGear" 650 "FId_TraGearReq" 651 "FId_TraNoShftIdctr" 652 "FId_TraPrtGearCANPtd" 653 "FId_TraPrtGearIndpdtProblem" 654 "FId_TraRPosn" 655 "FId_TraRtnIntfcASTIntv" 656 "FId_TraRtnIntfcIdlSetP" 657 "FId_TraRtnIntfcNMaxCan" 658 "FId_TraRtnIntfcNMaxVel" 659 "FId_TraTrqRedLmpHmeDec" 660 "FId_TraTrqRedLmpHmeInc" 661 "FId_TraTrqRedPTCanErr" 662 "FId_TraTrqRedTIIntvDes" 663 "FId_TraTrqRedTIIntvLead" 664 "FId_TraTrqRedTSCIntvDes" 665 "FId_TraTrqRedTSCIntvLead" 666 "FId_TraTrsmTypHw" 667 "FId_TranIdleDes" 668 "FId_UEGODiagRelsS1B1" 669 "FId_UEGOHeatrLrgTWinS1B1" 670 "FId_UEGOHeatrPwrStgDiagRelsS1B1" 671 "FId_UEGOHeatrPwrStgDiagRelsSCBS1B1" 672 "FId_UEGOHtrCtlOffS1B1" 673 "FId_UEGOHtrCtlRedS1B1" 674 "FId_UEGOHtrCtlStopS1B1" 675 "FId_UEGOHtrCtlUpS1B1" 676 "FId_UEGOIPmpEvlnRelsS1B1" 677 "FId_UEGOIPmpTCorrnS1B1" 678 "FId_UEGOIPmpTRelsS1B1" 679 "FId_UEGOLamRecprMdlRelsS1B1" 680 "FId_UEGOLamRelsAltvS1B1" 681 "FId_UEGOLamRelsS1B1" 682 "FId_UEGOLoDiagS1B1" 683 "FId_UEGOPrmntDiagS1B1" 684 "FId_UEGOStrtDiagRprtErrS1B1" 685 "FId_UEGOStrtDiagS1B1" 686 "FId_UEGOTEvlnRelsS1B1" 687 "FId_UegoInhbOperRelsS1B1" 688 "FId_UegoIntrptCdnOperRelsPreEngStrt" 689 "FId_UegoPlausErrHndlg" 690 "FId_UegoSigAvailS1B1" 691 "FId_VMSIDCSRmpShOff" 692 "FId_VMSIDCSShOff" 693 "FId_VMSITCSRmpShOff" 694 "FId_VMSITCSShOff" 695 "FId_VSACANErr" 696 "FId_VehStcDCDCFailr" 697 "FId_VehStcMisf" 698 "FId_VehVCANFrzVal" 699 "FId_VehVCANReplVal" 700 "FId_VehVCanSafeFrzVal" 701 "FId_VehVCanSafeReplVal" 702 "FId_VehVExcdLim" 703 "FId_VehVFrzVal" 704 "FId_VehVNCSnsrElecFailr" 705 "FId_VehVOBDFrzVal" 706 "FId_VehVOBDReplVal" 707 "FId_VehVOutCanErr" 708 "FId_VehVPWMFrzVal" 709 "FId_VehVPWMReplVal" 710 "FId_VehVPhysRng" 711 "FId_VehVPlaus" 712 "FId_VehVPlausCan" 713 "FId_VehVPlausFco" 714 "FId_VehVPlausPwr" 715 "FId_VehVPlausV2N" 716 "FId_VehVReplVal" 717 "FId_VehVSigCan" 718 "FId_VehVSigCanSafe" 719 "FId_VehVSnsrARngHi" 720 "FId_VehVSnsrBRngHi" 721 "FId_VehVSpdRtyDiag" 722 "FId_VehVSpdSnsrAElecFailr" 723 "FId_VehVSpdSnsrBElecFailr" 724 "FId_VehVWhlErrDet" 725 "FId_VldtLamDynS1B1" 726 "FId_VlvLftFbIntkOilPSnsr11SRC" 727 "FId_VlvLftFbSwtIntk11Diag" 728 "FId_ZGLZSR" 729 "FId_airIntkFltSnsrKnkPrtnIgn" 730 "FId_stChkChgnSys" 731 "FId_stChkChgnSys2DC" 732 "FId_tFltSnsrKnkPrtnIgn" DEFAULT_VALUE "---" /end COMPU_VTAB
/begin COMPU_METHOD OneToOne "" RAT_FUNC "%6.2" "-" COEFFS 0 1 0 0 0 1 /end COMPU_METHOD
/begin RECORD_LAYOUT ValA_Wu16 FNC_VALUES 1 UWORD COLUMN_DIR DIRECT /end RECORD_LAYOUT
/end MODULE
/end PROJECT
