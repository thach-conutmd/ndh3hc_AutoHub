ASAP2_VERSION 1 60
/begin PROJECT MG1CA020 "MG1CA020"
/begin HEADER "" VERSION "MG1CA020_6SAY_V011_TPROT" PROJECT_NO MG1CA020 /end HEADER
/begin MODULE DIM ""
/begin MOD_COMMON "" BYTE_ORDER MSB_LAST ALIGNMENT_BYTE 1 ALIGNMENT_WORD 2 ALIGNMENT_LONG 4 ALIGNMENT_INT64 4 ALIGNMENT_FLOAT32_IEEE 4 ALIGNMENT_FLOAT64_IEEE 4 DATA_SIZE 32 /end MOD_COMMON
/begin CHARACTERISTIC MisfDet_addrTrgVal_C "Adress for triggervalue" VALUE 0x80530AC4 RB_Val_Wu32 4294967295.00 OneToOne 0.00 4294967295.00 FORMAT "%13.2" /end CHARACTERISTIC
/begin CHARACTERISTIC MisfDet_axleSeln_C "Axle selection for rough road detection" VALUE 0x8053128C RB_Val_Wu8 3.000 dez 0.00 3.000 FORMAT "%5.3" EXTENDED_LIMITS 0.00 255.0 /end CHARACTERISTIC
/begin CHARACTERISTIC MisfDet_cntrIgnBlkDnAdpnStrt_C "Delay counter to block dn adaption in case of engine start" VALUE 0x80530B24 RB_Val_Wu8 255.0 OneToOne 0.00 255.0 FORMAT "%5.1" /end CHARACTERISTIC
/begin CHARACTERISTIC MisfDet_cntrIgnBlkStcStrt_C "Delay counter to block statistical function in case of engine start" VALUE 0x80530B25 RB_Val_Wu8 255.0 OneToOne 0.00 255.0 FORMAT "%5.1" /end CHARACTERISTIC
/begin CHARACTERISTIC MisfDet_cntrIgnFlreDwn_C "Counter to determine length of flare down phase during engine start" VALUE 0x80530B26 RB_Val_Wu16 65535.00 OneToOne 0.00 65535.00 FORMAT "%8.2" /end CHARACTERISTIC
/begin CHARACTERISTIC MisfDet_cntrIgnStrtHld_C "counter for turn off delay for state engine start" VALUE 0x80530B28 RB_Val_Wu8 255.0 OneToOne 0.00 255.0 FORMAT "%5.1" /end CHARACTERISTIC
/begin CHARACTERISTIC MisfDet_dlyTiStrtLineEnd_T "Start delay time when EoL is active, engine temperature dependant" CURVE 0x80530B2A RB_Curve_S16_U16_Static 6553.500 t_q0p1 0.00 6553.500 FORMAT "%8.3"
 /begin AXIS_DESCR STD_AXIS MisfDet_tEngStrt Temp_Cels 4 -3549.940 3003.560 FORMAT "%8.3" DEPOSIT ABSOLUTE /end AXIS_DESCR
/end CHARACTERISTIC
/begin CHARACTERISTIC MisfDet_dlyTiStrt_T "Start delay time, engine temperature dependant" CURVE 0x80530B3C RB_Curve_S16_U16_Static 6553.500 t_q0p1 0.00 6553.500 FORMAT "%8.3"
 /begin AXIS_DESCR STD_AXIS MisfDet_tEngStrt Temp_Cels 4 -3549.940 3003.560 FORMAT "%8.3" DEPOSIT ABSOLUTE /end AXIS_DESCR
/end CHARACTERISTIC
/begin CHARACTERISTIC MisfDet_dnAdpnFilFac_C "filter factor for continuous adaptation" VALUE 0x80530860 Val_Wu16 0.9999847 fak_uw_b1 0.00 0.9999847 FORMAT "%9.7" /end CHARACTERISTIC
/begin CHARACTERISTIC MisfDet_dnAdpnFrzNEngDifMax_C "engine speed window to keep the values of the continuous adaptation" VALUE 0x80530862 RB_Val_Wu16 25599.61 rel_win_ub_b100 0.00 25599.61 FORMAT "%8.2" /end CHARACTERISTIC
/begin CHARACTERISTIC MisfDet_dnAdpnFrzTqDifMax_C "torque window to keep the values of the continuous adaptation" VALUE 0x80530864 RB_Val_Wu16 25599.61 rel_win_ub_b100 0.00 25599.61 FORMAT "%8.2" /end CHARACTERISTIC
/begin CHARACTERISTIC MisfDet_dnAdpnNrSampRdy_T "Number of working cycles to complete adaptation" CURVE 0x80530866 RB_Curve_U16_U8_Static 255.0 OneToOne 0.00 255.0 FORMAT "%5.1"
 /begin AXIS_DESCR STD_AXIS MisfDet_tqBascSync rel_uw_b100 8 0.00 99.99847 FORMAT "%8.5" DEPOSIT ABSOLUTE /end AXIS_DESCR
/end CHARACTERISTIC
/begin CHARACTERISTIC MisfDet_dnAdpnNvDstBasPntFac_C "factor to distance of base point with unknown gradient" VALUE 0x80530880 RB_Val_Wu16 7.999878 fak_uw_b8 0.00 7.999878 FORMAT "%8.6" /end CHARACTERISTIC
/begin CHARACTERISTIC MisfDet_dnAdpnNvDstMax_C "Limit of distance of interpolation points to set QlyFac = 1" VALUE 0x80530882 RB_Val_Wu16 255.9961 fak_ub_b1 0.00 255.9961 FORMAT "%8.4" /end CHARACTERISTIC
/begin CHARACTERISTIC MisfDet_dnAdpnNvDstMin_C "Limit of distance of interpolation points to set QlyFac = 0" VALUE 0x80530884 RB_Val_Wu16 255.9961 fak_ub_b1 0.00 255.9961 FORMAT "%8.4" /end CHARACTERISTIC
/begin CHARACTERISTIC MisfDet_dnAdpnNvFilFacMin_C "minimum filter factor used for NV adaptation" VALUE 0x80530886 Val_Wu16 0.9999847 fak_uw_b1 0.00 0.9999847 FORMAT "%9.7" /end CHARACTERISTIC
/begin CHARACTERISTIC MisfDet_dnAdpnNvNrSampleMin_C "Minimum number of samples for transfer to NV values" VALUE 0x80530888 RB_Val_Wu8 255.0 OneToOne 0.00 255.0 FORMAT "%5.1" /end CHARACTERISTIC
/begin CHARACTERISTIC MisfDet_dnAdpnNvPlausSumThd_C "threshold for DnAdpnNv sum plaus check" VALUE 0x8053088A RB_Val_Ws16 4095.938 dn_Compu -2048.000 2047.938 FORMAT "%8.3" /end CHARACTERISTIC
/begin CHARACTERISTIC MisfDet_dnAdpnPlausAbsThdDecMax_T "Limitation of negative gradient of plaus abs threshold" CURVE 0x8053088C RB_Curve_S16_S16 4095.938 dn_Compu -2048.000 2047.938 FORMAT "%8.3"
 /begin AXIS_DESCR STD_AXIS Epm_nEng EngN 4 -16384.00 16383.50 FORMAT "%8.2" DEPOSIT ABSOLUTE /end AXIS_DESCR
/end CHARACTERISTIC
/begin CHARACTERISTIC MisfDet_dnAdpnPlausAbsThdOffsCatHeat_C "threshold offset for DnAdpn absolut plaus check at cat heating" VALUE 0x8053089E RB_Val_Ws16 4095.938 dn_Compu -2048.000 2047.938 FORMAT "%8.3" /end CHARACTERISTIC
/begin CHARACTERISTIC MisfDet_dnAdpnPlausAbsThdTrsmTiLow_M "Threshold for DnAdpn absolute plaus check at cold drive train" MAP 0x805308A0 RB_Map_U16S16_S16 4095.938 dn_Compu -2048.000 2047.938 FORMAT "%8.3"
 /begin AXIS_DESCR STD_AXIS MisfDet_tqBascSync rel_uw_b100 6 0.00 99.99847 FORMAT "%8.5" DEPOSIT ABSOLUTE /end AXIS_DESCR
 /begin AXIS_DESCR STD_AXIS MisfDet_nEngSync EngN 6 -16384.00 16383.50 FORMAT "%8.2" DEPOSIT ABSOLUTE /end AXIS_DESCR
/end CHARACTERISTIC
/begin CHARACTERISTIC MisfDet_dnAdpnPlausAbsThd_M "Threshold for DnAdpn absolute plaus check" MAP 0x80530904 RB_Map_U16S16_S16 4095.938 dn_Compu -2048.000 2047.938 FORMAT "%8.3"
 /begin AXIS_DESCR STD_AXIS MisfDet_tqBascSync rel_uw_b100 6 0.00 99.99847 FORMAT "%8.5" DEPOSIT ABSOLUTE /end AXIS_DESCR
 /begin AXIS_DESCR STD_AXIS MisfDet_nEngSync EngN 6 -16384.00 16383.50 FORMAT "%8.2" DEPOSIT ABSOLUTE /end AXIS_DESCR
/end CHARACTERISTIC
/begin CHARACTERISTIC MisfDet_dnAdpnPlausMinThdFacCatHeat_C "factor to misfire detection threshold for min plaus check during cat heating" VALUE 0x80530968 RB_Val_Wu8 15.94 fak_ub_b16 0.00 15.94 FORMAT "%5.2" /end CHARACTERISTIC
/begin CHARACTERISTIC MisfDet_dnAdpnPlausMinThdFacTrsmTiLow_C "factor to misfire detection threshold for min plaus check at cold drive train" VALUE 0x80530969 RB_Val_Wu8 15.94 fak_ub_b16 0.00 15.94 FORMAT "%5.2" /end CHARACTERISTIC
/begin CHARACTERISTIC MisfDet_dnAdpnPlausMinThdFac_C "factor to misfire detection threshold for min plaus check" VALUE 0x8053096A RB_Val_Wu8 15.94 fak_ub_b16 0.00 15.94 FORMAT "%5.2" /end CHARACTERISTIC
/begin CHARACTERISTIC MisfDet_dnAdpnPlausRelCntrLim_C "maximum number of failed rlative plaus checks to inhibit adaptation" VALUE 0x8053096B RB_Val_Wu8 255.0 OneToOne 0.00 255.0 FORMAT "%5.1" /end CHARACTERISTIC
/begin CHARACTERISTIC MisfDet_dnAdpnPlausRelThdFacAltvPosn_C "factor on detection threshold for relative plaus check while usage of alternative segment position" VALUE 0x8053096C RB_Val_Wu8 3.984 fak_ub_b4 0.00 3.984 FORMAT "%5.3" /end CHARACTERISTIC
/begin CHARACTERISTIC MisfDet_dnAdpnPlausRelThdFacIdle_T "factor on detection threshold for relative plaus check at idle" CURVE 0x8053096E RB_Curve_S16_U8_Static 3.984 fak_ub_b4 0.00 3.984 FORMAT "%5.3"
 /begin AXIS_DESCR STD_AXIS MisfDet_nEngSync EngN 6 0.00 16383.50 FORMAT "%8.2" EXTENDED_LIMITS -16384.00 16383.50 DEPOSIT ABSOLUTE /end AXIS_DESCR
/end CHARACTERISTIC
/begin CHARACTERISTIC MisfDet_dnAdpnPlausRelThdFacTrsmTiLow_M "factor on detection threshold for relative plaus check at cold drive train" MAP 0x80530982 RB_Map_U16S16_U8 3.984 fak_ub_b4 0.00 3.984 FORMAT "%5.3"
 /begin AXIS_DESCR STD_AXIS MisfDet_tqBascSync rel_uw_b100 3 0.00 99.99847 FORMAT "%8.5" DEPOSIT ABSOLUTE /end AXIS_DESCR
 /begin AXIS_DESCR STD_AXIS MisfDet_nEngSync EngN 4 -16384.00 16383.50 FORMAT "%8.2" DEPOSIT ABSOLUTE /end AXIS_DESCR
/end CHARACTERISTIC
/begin CHARACTERISTIC MisfDet_dnAdpnPlausRelThdFac_M "factor on detection threshold for relative plaus check" MAP 0x805309A0 RB_Map_U16S16_U8 3.984 fak_ub_b4 0.00 3.984 FORMAT "%5.3"
 /begin AXIS_DESCR STD_AXIS MisfDet_tqBascSync rel_uw_b100 3 0.00 99.99847 FORMAT "%8.5" DEPOSIT ABSOLUTE /end AXIS_DESCR
 /begin AXIS_DESCR STD_AXIS MisfDet_nEngSync EngN 4 -16384.00 16383.50 FORMAT "%8.2" DEPOSIT ABSOLUTE /end AXIS_DESCR
/end CHARACTERISTIC
/begin CHARACTERISTIC MisfDet_dnAdpnRngChngActvnDly_C "delay of release after change of adaptation range" VALUE 0x805309BE Val_Wu8 255.0 OneToOne 0.00 255.0 FORMAT "%5.1" /end CHARACTERISTIC
/begin CHARACTERISTIC MisfDet_dnAdpnRngNEng.Cmn_CA "engine speed limits of adaptation map / all transmission types" VAL_BLK 0x80530A38 RB_ValA_Wu16 16383.50 EngN 0.00 16383.50 FORMAT "%8.2" EXTENDED_LIMITS 0.00 32767.50 NUMBER 9 /end CHARACTERISTIC
/begin CHARACTERISTIC MisfDet_dnAdpnRngTqInr_CA "inner load limits of adaptation map (perc of delta minmax)" VAL_BLK 0x805309C0 RB_ValA_Wu16 99.99847 rel_rng_uw_b100 0.00 99.99847 FORMAT "%8.5" NUMBER 2 /end CHARACTERISTIC
/begin CHARACTERISTIC MisfDet_dnAdpnRngTqLock_CA "locking area around inner load limits (in perc of adaptation window)" VAL_BLK 0x805309C4 RB_ValA_Wu8 99.61 rel_win_ub_b100 0.00 99.61 FORMAT "%5.2" NUMBER 2 /end CHARACTERISTIC
/begin CHARACTERISTIC MisfDet_dnAdpnRngTqMax_T "upper load limit of adaptation map" CURVE 0x805309C6 RB_Curve_S16_U16_Static 99.99847 rel_uw_b100 0.00 99.99847 FORMAT "%8.5"
 /begin AXIS_DESCR STD_AXIS MisfDet_nEngSync EngN 12 0.00 16383.50 FORMAT "%8.2" EXTENDED_LIMITS -16384.00 16383.50 DEPOSIT ABSOLUTE /end AXIS_DESCR
/end CHARACTERISTIC
/begin CHARACTERISTIC MisfDet_dnAdpnRngTqMin.Cmn_GT "lower load limit of adaptation map / all transmission types" CURVE 0x80530A4A RB_CurveGroup_U16 99.99847 rel_uw_b100 0.00 99.99847 FORMAT "%8.5"
 /begin AXIS_DESCR COM_AXIS MisfDet_nEngSync EngN 12 -16384.00 16383.50 FORMAT "%8.2" AXIS_PTS_REF MisfDet_dnAdpnTqMin_AX /end AXIS_DESCR
/end CHARACTERISTIC
/begin CHARACTERISTIC MisfDet_dnAdpnRngTqMinIdle.Cmn_GT "lower load limit of adaptation at idle / all transmission types" CURVE 0x80530A62 RB_CurveGroup_U16 99.99847 rel_uw_b100 0.00 99.99847 FORMAT "%8.5"
 /begin AXIS_DESCR COM_AXIS MisfDet_nEngSync EngN 8 -16384.00 16383.50 FORMAT "%8.2" AXIS_PTS_REF MisfDet_dnAdpnTqMinIdle_AX /end AXIS_DESCR
/end CHARACTERISTIC
/begin AXIS_PTS MisfDet_dnAdpnTqMinIdle_AX "distribution lower torque limit of adaptation idle" 0x805309F8 MisfDet_nEngSync RB_Axis_S16 32767.50 EngN 8 -16384.00 16383.50 FORMAT "%8.2" DEPOSIT ABSOLUTE /end AXIS_PTS
/begin CHARACTERISTIC MisfDet_dnAdpnTqMinStrtNrIgn_C "number of ignitions after start for usage of start minimum torque" VALUE 0x80530A0A RB_Val_Wu16 65535.00 OneToOne 0.00 65535.00 FORMAT "%8.2" /end CHARACTERISTIC
/begin CHARACTERISTIC MisfDet_dnAdpnTqMinStrt_C "minimum torque for adaptation after start" VALUE 0x80530A0C RB_Val_Wu16 99.99847 rel_uw_b100 0.00 99.99847 FORMAT "%8.5" /end CHARACTERISTIC
/begin AXIS_PTS MisfDet_dnAdpnTqMin_AX "distribution lower torque limit of adaptation" 0x80530A0E MisfDet_nEngSync RB_Axis_S16 32767.50 EngN 12 -16384.00 16383.50 FORMAT "%8.2" DEPOSIT ABSOLUTE /end AXIS_PTS
/begin CHARACTERISTIC MisfDet_dnAdpnValNvNZero_C "engine speed limit to not consider or ramp down adaptation value" VALUE 0x80530A28 RB_Val_Wu16 32767.50 EngN 0.00 32767.50 FORMAT "%8.2" /end CHARACTERISTIC
/begin CHARACTERISTIC MisfDet_dnCycMaxAdpn_M "Maximum allowed average engine running roughness over one working cycle" MAP 0x80530B4E RB_Map_S8U16_S16 4095.938 dn_Compu -2048.000 2047.938 FORMAT "%8.3"
 /begin AXIS_DESCR STD_AXIS MisfDet_numGear OneToOne 11 -128.0 127.0 FORMAT "%5.1" DEPOSIT ABSOLUTE /end AXIS_DESCR
 /begin AXIS_DESCR STD_AXIS MisfDet_tqBasc rel_uw_b100 6 0.00 99.99847 FORMAT "%8.5" DEPOSIT ABSOLUTE /end AXIS_DESCR
/end CHARACTERISTIC
/begin CHARACTERISTIC MisfDet_dnCycMaxStc_M "Threshold for the maximum allowed average engine running roughness over one working cycle for the inhibiting condition of misfire statistical function" MAP 0x80530BEC RB_Map_S8S16_S16 4095.938 dn_Compu -2048.000 2047.938 FORMAT "%8.3"
 /begin AXIS_DESCR STD_AXIS MisfDet_numGear OneToOne 11 -128.0 127.0 FORMAT "%5.1" DEPOSIT ABSOLUTE /end AXIS_DESCR
 /begin AXIS_DESCR STD_AXIS Epm_nEng EngN 8 -16384.00 16383.50 FORMAT "%8.2" DEPOSIT ABSOLUTE /end AXIS_DESCR
/end CHARACTERISTIC
/begin CHARACTERISTIC MisfDet_dnDifSelNMax_C "maximum engine speed for usage of dnDifXyz at incomplete adaptation" VALUE 0x80530A74 RB_Val_Ws16 32767.50 EngN -16384.00 16383.50 FORMAT "%8.2" /end CHARACTERISTIC
/begin CHARACTERISTIC MisfDet_dnFilFacMax_C "maximum filter factor for MisfDet_dnFltd" VALUE 0x80530A76 RB_Val_Wu16 0.9999847 fak_uw_b1 0.00 0.9999847 FORMAT "%9.7" /end CHARACTERISTIC
/begin CHARACTERISTIC MisfDet_dnFilFacMin_C "minimum filter factor for MisfDet_dnFltd" VALUE 0x80530A78 RB_Val_Wu16 0.9999847 fak_uw_b1 0.00 0.9999847 FORMAT "%9.7" /end CHARACTERISTIC
/begin CHARACTERISTIC MisfDet_dnFilFacRat_C "percentage of threshold to get maximum filter factor" VALUE 0x80530A7A RB_Val_Wu16 31.99951 fak_uw_b32 0.00 31.99951 FORMAT "%8.5" /end CHARACTERISTIC
/begin CHARACTERISTIC MisfDet_dnFilFacSlow_C "slow filter factor for MisfDet_dnFltd" VALUE 0x80530A7C RB_Val_Wu16 0.9999847 fak_uw_b1 0.00 0.9999847 FORMAT "%9.7" /end CHARACTERISTIC
/begin CHARACTERISTIC MisfDet_dnFltdAmplThdFacIdle_C "factor on detection trheshold for usage of dnDifXyz at idle" VALUE 0x80530A7E RB_Val_Wu8 0.9961 fak_ub_b1 0.00 0.9961 /end CHARACTERISTIC
/begin CHARACTERISTIC MisfDet_dnFltdAmplThdFac_C "factor on detection trheshold for usage of dnDifXyz" VALUE 0x80530A7F RB_Val_Wu8 0.9961 fak_ub_b1 0.00 0.9961 /end CHARACTERISTIC
/begin CHARACTERISTIC MisfDet_dnQnts_C "quantisation of MisfDet_dn" VALUE 0x80530A80 RB_Val_Wu8 63.75 fak_ub_b64 0.00 63.75 FORMAT "%5.2" /end CHARACTERISTIC
/begin AXIS_PTS MisfDet_dTqThdN_AX "Engine speed axes allowed torque gradient" 0x80530CBA MisfDet_nEngSync RB_Axis_S16 32767.50 EngN 8 -16384.00 16383.50 FORMAT "%8.2" DEPOSIT ABSOLUTE /end AXIS_PTS
/begin AXIS_PTS MisfDet_dTqThdTq_AX "torque axes allowed torque gradient" 0x80530CCC MisfDet_tqBascSync RB_Axis_U16 99.99847 rel_uw_b100 8 0.00 99.99847 FORMAT "%8.5" DEPOSIT ABSOLUTE /end AXIS_PTS
/begin CHARACTERISTIC MisfDet_dVWhlDecMax_C "limitation of negative gradient oh wheel acceleration" VALUE 0x8053128E RB_Val_Wu16 2777.735 accgrd_uw_b2777p6 0.00 2777.735 FORMAT "%8.3" /end CHARACTERISTIC
/begin CHARACTERISTIC MisfDet_dVWhlFil_C "Filter factor for differentiated wheel speeds" VALUE 0x80531290 RB_Val_Wu16 0.9999847 fak_uw_b1 0.00 0.9999847 FORMAT "%9.7" /end CHARACTERISTIC
/begin CHARACTERISTIC MisfDet_dVWhlFrntThd_M "Threshold map to detect rough road front axle" MAP 0x80531292 RB_Map_U16S16_U16 55.55471 acc_uw_b55p55 0.00 55.55471 FORMAT "%8.5"
 /begin AXIS_DESCR STD_AXIS MisfDet_tqBasc rel_uw_b100 4 0.00 99.99847 FORMAT "%8.5" DEPOSIT ABSOLUTE /end AXIS_DESCR
 /begin AXIS_DESCR STD_AXIS VehV_v Vel 4 -327.6800 327.6700 FORMAT "%8.4" DEPOSIT ABSOLUTE /end AXIS_DESCR
/end CHARACTERISTIC
/begin CHARACTERISTIC MisfDet_dVWhlPlausVMax_C "Maximum speed for enabling the diagnosis of wheel acceleration" VALUE 0x805312C6 RB_Val_Ws16 655.3500 Vel -327.6800 327.6700 FORMAT "%8.4" /end CHARACTERISTIC
/begin CHARACTERISTIC MisfDet_dVWhlPlausVMin_C "Minimum speed for enabling the diagnosis of wheel acceleration" VALUE 0x805312C8 RB_Val_Ws16 655.3500 Vel -327.6800 327.6700 FORMAT "%8.4" /end CHARACTERISTIC
/begin CHARACTERISTIC MisfDet_dVWhlRatMax_C "Maximum ratio of largest and second largest wheel acceleration" VALUE 0x805312CA RB_Val_Wu16 655.3500 fak_q0p01 0.00 655.3500 FORMAT "%8.4" /end CHARACTERISTIC
/begin CHARACTERISTIC MisfDet_dVWhlReThd_M "Threshold map to detect rough road rear axle" MAP 0x805312CC RB_Map_U16S16_U16 55.55471 acc_uw_b55p55 0.00 55.55471 FORMAT "%8.5"
 /begin AXIS_DESCR STD_AXIS MisfDet_tqBasc rel_uw_b100 4 0.00 99.99847 FORMAT "%8.5" DEPOSIT ABSOLUTE /end AXIS_DESCR
 /begin AXIS_DESCR STD_AXIS VehV_v Vel 4 -327.6800 327.6700 FORMAT "%8.4" DEPOSIT ABSOLUTE /end AXIS_DESCR
/end CHARACTERISTIC
/begin CHARACTERISTIC MisfDet_dVWhlThdFac_T "Factor for rough road detection threshold dependent on transmission ratio" CURVE 0x80531300 RB_Curve_S16_U8_Static 1.992188 fak_ub_b2 0.00 1.992188 FORMAT "%8.6"
 /begin AXIS_DESCR STD_AXIS PT_rTrq TransR 6 -327.6800 327.6700 FORMAT "%8.4" DEPOSIT ABSOLUTE /end AXIS_DESCR
/end CHARACTERISTIC
/begin CHARACTERISTIC MisfDet_facDecTiTrsmAct_C "Factor for decrementing the active transmission time" VALUE 0x80530CDE RB_Val_Wu8 2.550 fak_q0p01 0.00 2.550 FORMAT "%5.3" /end CHARACTERISTIC
/begin CHARACTERISTIC MisfDet_facEnvPMin_C "Minimal ratio ambient pressure to normal pressure" VALUE 0x80530CDF RB_Val_Wu8 3.984 fak_ub_b4 0.00 3.984 FORMAT "%5.3" /end CHARACTERISTIC
/begin CHARACTERISTIC MisfDet_grdtPedlMax_M "max. gradient of the accelerator pedal position" MAP 0x80530CE0 RB_Map_U16S16_S16 3999.939 q0p06104_pc_DIV_s -2000.000 1999.939 FORMAT "%8.3"
 /begin AXIS_DESCR STD_AXIS MisfDet_tqBascSync rel_uw_b100 8 0.00 99.99847 FORMAT "%8.5" DEPOSIT ABSOLUTE /end AXIS_DESCR
 /begin AXIS_DESCR STD_AXIS MisfDet_nEngSync EngN 8 -16384.00 16383.50 FORMAT "%8.2" DEPOSIT ABSOLUTE /end AXIS_DESCR
/end CHARACTERISTIC
/begin CHARACTERISTIC MisfDet_grdtPedlMin_M "min. gradient of the accelerator pedal position" MAP 0x80530D84 RB_Map_U16S16_S16 3999.939 q0p06104_pc_DIV_s -2000.000 1999.939 FORMAT "%8.3"
 /begin AXIS_DESCR STD_AXIS MisfDet_tqBascSync rel_uw_b100 8 0.00 99.99847 FORMAT "%8.5" DEPOSIT ABSOLUTE /end AXIS_DESCR
 /begin AXIS_DESCR STD_AXIS MisfDet_nEngSync EngN 8 -16384.00 16383.50 FORMAT "%8.2" DEPOSIT ABSOLUTE /end AXIS_DESCR
/end CHARACTERISTIC
/begin CHARACTERISTIC MisfDet_grdtTqMax.Cmn_GM "Maximum allowed torque gradient / all tranmissions" MAP 0x805310F4 RB_MapGroup_S16 3999.939 q0p06104_pc_DIV_s -2000.000 1999.939 FORMAT "%8.3"
 /begin AXIS_DESCR COM_AXIS MisfDet_tqBascSync rel_uw_b100 8 0.00 99.99847 FORMAT "%8.5" AXIS_PTS_REF MisfDet_dTqThdTq_AX /end AXIS_DESCR
 /begin AXIS_DESCR COM_AXIS MisfDet_nEngSync EngN 8 -16384.00 16383.50 FORMAT "%8.2" AXIS_PTS_REF MisfDet_dTqThdN_AX /end AXIS_DESCR
/end CHARACTERISTIC
/begin CHARACTERISTIC MisfDet_grdtTqMin.Cmn_GM "Minimum allowed torque gradient / all tranmissions" MAP 0x80531174 RB_MapGroup_S16 3999.939 q0p06104_pc_DIV_s -2000.000 1999.939 FORMAT "%8.3"
 /begin AXIS_DESCR COM_AXIS MisfDet_tqBascSync rel_uw_b100 8 0.00 99.99847 FORMAT "%8.5" AXIS_PTS_REF MisfDet_dTqThdTq_AX /end AXIS_DESCR
 /begin AXIS_DESCR COM_AXIS MisfDet_nEngSync EngN 8 -16384.00 16383.50 FORMAT "%8.2" AXIS_PTS_REF MisfDet_dTqThdN_AX /end AXIS_DESCR
/end CHARACTERISTIC
/begin CHARACTERISTIC MisfDet_ignRndMax_C "range of combustions in which one misfire will be generated" VALUE 0x80530AC8 RB_Val_Wu16 65535.00 OneToOne 0.00 65535.00 FORMAT "%8.2" /end CHARACTERISTIC
/begin CHARACTERISTIC MisfDet_kdRoughRoadDT1_C "Gain of DT1 engine speed gradient for wheel speed diagnosis" VALUE 0x80531314 RB_Val_Ws32 65535.9999847 Kd -32768.0000000 32767.9999847 FORMAT "%13.7" /end CHARACTERISTIC
/begin CHARACTERISTIC MisfDet_maskACSel_C "Configuration of signal selection of climate control interface" VALUE 0x80530E28 RB_Val_Wu8 255.0 OneToOne 0.00 255.0 FORMAT "%5.1" /end CHARACTERISTIC
/begin CHARACTERISTIC MisfDet_maskBlkGear_C "Bitmaske mit sperrenden Gangpositionen" VALUE 0x80530E2A RB_Val_Wu16 65535.00 OneToOne 0.00 65535.00 FORMAT "%8.2" /end CHARACTERISTIC
/begin CHARACTERISTIC MisfDet_maskCfgTrg_C "bitmask to configure trigger functionality" VALUE 0x80530ACA RB_Val_Wu8 255.0 OneToOne 0.00 255.0 FORMAT "%5.1" /end CHARACTERISTIC
/begin CHARACTERISTIC MisfDet_maskDnAdpn.cntrHldNStrt_T "Mask with inhibiting conditions of temporary dN adaption No turn off delay / number of ignitions delay, engine speed dependent, at Engine start" CURVE 0x8053100C RB_Curve_S16_U8_Static 255.0 OneToOne 0.00 255.0 FORMAT "%5.1"
 /begin AXIS_DESCR STD_AXIS Epm_nEng EngN 4 -16384.00 16383.50 FORMAT "%8.2" DEPOSIT ABSOLUTE /end AXIS_DESCR
/end CHARACTERISTIC
/begin CHARACTERISTIC MisfDet_maskDnAdpn.cntrHldN_T "Mask with inhibiting conditions of temporary dN adaption No turn off delay / number of ignitions delay, engine speed dependent" CURVE 0x8053101A RB_Curve_S16_U8_Static 255.0 OneToOne 0.00 255.0 FORMAT "%5.1"
 /begin AXIS_DESCR STD_AXIS Epm_nEng EngN 4 -16384.00 16383.50 FORMAT "%8.2" DEPOSIT ABSOLUTE /end AXIS_DESCR
/end CHARACTERISTIC
/begin CHARACTERISTIC MisfDet_maskDnAdpn.cntrHldStrt_C "Mask with inhibiting conditions of temporary dN adaption No turn off delay / number of ignitions delay, at Engine start" VALUE 0x80531028 RB_Val_Wu8 255.0 OneToOne 0.00 255.0 FORMAT "%5.1" /end CHARACTERISTIC
/begin CHARACTERISTIC MisfDet_maskDnAdpn.cntrHld_C "Mask with inhibiting conditions of temporary dN adaption No turn off delay / number of ignitions delay" VALUE 0x80531029 RB_Val_Wu8 255.0 OneToOne 0.00 255.0 FORMAT "%5.1" /end CHARACTERISTIC
/begin CHARACTERISTIC MisfDet_maskDnAdpn.cntrStrtMax_C "Mask with inhibiting conditions of temporary dN adaption No turn off delay / Maximum ignition counter for engine start detection" VALUE 0x8053102A RB_Val_Wu16 65535.00 OneToOne 0.00 65535.00 FORMAT "%8.2" /end CHARACTERISTIC
/begin CHARACTERISTIC MisfDet_maskDnAdpn.CmbTyp.HldN_C "Mask with inhibiting conditions of temporary dN adaption No turn off delay / mask of selected disabling conditions, engine type specific / bit mask delayed conditions engine speed dependant" VALUE 0x80531030 RB_Val_Wu32 4294967295.00 OneToOne 0.00 4294967295.00 FORMAT "%13.2" /end CHARACTERISTIC
/begin CHARACTERISTIC MisfDet_maskDnAdpn.CmbTyp.Hld_C "Mask with inhibiting conditions of temporary dN adaption No turn off delay / mask of selected disabling conditions, engine type specific / bit mask delayed conditions" VALUE 0x80531034 RB_Val_Wu32 4294967295.00 OneToOne 0.00 4294967295.00 FORMAT "%13.2" /end CHARACTERISTIC
/begin CHARACTERISTIC MisfDet_maskDnAdpn.CmbTyp.Raw_C "Mask with inhibiting conditions of temporary dN adaption No turn off delay / mask of selected disabling conditions, engine type specific / bit mask not delayed conditions" VALUE 0x80531038 RB_Val_Wu32 4294967295.00 OneToOne 0.00 4294967295.00 FORMAT "%13.2" /end CHARACTERISTIC
/begin CHARACTERISTIC MisfDet_maskDnAdpn.Cmn.HldN_C "Mask with inhibiting conditions of temporary dN adaption No turn off delay / mask of selected disabling conditions / bit mask delayed conditions engine speed dependant" VALUE 0x80531040 RB_Val_Wu32 4294967295.00 OneToOne 0.00 4294967295.00 FORMAT "%13.2" /end CHARACTERISTIC
/begin CHARACTERISTIC MisfDet_maskDnAdpn.Cmn.Hld_C "Mask with inhibiting conditions of temporary dN adaption No turn off delay / mask of selected disabling conditions / bit mask delayed conditions" VALUE 0x80531044 RB_Val_Wu32 4294967295.00 OneToOne 0.00 4294967295.00 FORMAT "%13.2" /end CHARACTERISTIC
/begin CHARACTERISTIC MisfDet_maskDnAdpn.Cmn.Raw_C "Mask with inhibiting conditions of temporary dN adaption No turn off delay / mask of selected disabling conditions / bit mask not delayed conditions" VALUE 0x80531048 RB_Val_Wu32 4294967295.00 OneToOne 0.00 4294967295.00 FORMAT "%13.2" /end CHARACTERISTIC
/begin CHARACTERISTIC MisfDet_maskDnAdpnInitCmbTyp_C "Selection mask (combustion type dependent for initialisation of DnAdpnVal after stBlkDnAdpnNvCorrn was set" VALUE 0x80530A2C RB_Val_Wu32 4294967295.00 OneToOne 0.00 4294967295.00 FORMAT "%13.2" /end CHARACTERISTIC
/begin CHARACTERISTIC MisfDet_maskDnAdpnInit_C "Selection mask for initialisation of DnAdpnVal after stBlkDnAdpnNvCorrn was set" VALUE 0x80530A30 RB_Val_Wu32 4294967295.00 OneToOne 0.00 4294967295.00 FORMAT "%13.2" /end CHARACTERISTIC
/begin CHARACTERISTIC MisfDet_maskDnAdpnNv.cntrHldN_T "Mask with inhibiting conditions of storing dN adaption No turn off delay / number ignitions delay, engine speed dependant" CURVE 0x8053109C RB_Curve_S16_U8_Static 255.0 OneToOne 0.00 255.0 FORMAT "%5.1"
 /begin AXIS_DESCR STD_AXIS Epm_nEng EngN 4 -16384.00 16383.50 FORMAT "%8.2" DEPOSIT ABSOLUTE /end AXIS_DESCR
/end CHARACTERISTIC
/begin CHARACTERISTIC MisfDet_maskDnAdpnNv.cntrHld_C "Mask with inhibiting conditions of storing dN adaption No turn off delay / number ignitions delay" VALUE 0x805310AA RB_Val_Wu8 255.0 OneToOne 0.00 255.0 FORMAT "%5.1" /end CHARACTERISTIC
/begin CHARACTERISTIC MisfDet_maskDnAdpnNv.CmbTyp.HldN_C "Mask with inhibiting conditions of storing dN adaption No turn off delay / mask of selected disabling conditions, engine type specific / bit mask delayed conditions engine speed dependant" VALUE 0x805310B0 RB_Val_Wu32 4294967295.00 OneToOne 0.00 4294967295.00 FORMAT "%13.2" /end CHARACTERISTIC
/begin CHARACTERISTIC MisfDet_maskDnAdpnNv.CmbTyp.Hld_C "Mask with inhibiting conditions of storing dN adaption No turn off delay / mask of selected disabling conditions, engine type specific / bit mask delayed conditions" VALUE 0x805310B4 RB_Val_Wu32 4294967295.00 OneToOne 0.00 4294967295.00 FORMAT "%13.2" /end CHARACTERISTIC
/begin CHARACTERISTIC MisfDet_maskDnAdpnNv.CmbTyp.Raw_C "Mask with inhibiting conditions of storing dN adaption No turn off delay / mask of selected disabling conditions, engine type specific / bit mask not delayed conditions" VALUE 0x805310B8 RB_Val_Wu32 4294967295.00 OneToOne 0.00 4294967295.00 FORMAT "%13.2" /end CHARACTERISTIC
/begin CHARACTERISTIC MisfDet_maskDnAdpnNv.CmbTyp2.HldN_C "Mask with inhibiting conditions of storing dN adaption No turn off delay / mask of selected disabling conditions, engine type specific / bit mask delayed conditions engine speed dependant" VALUE 0x805310C0 RB_Val_Wu32 4294967295.00 OneToOne 0.00 4294967295.00 FORMAT "%13.2" /end CHARACTERISTIC
/begin CHARACTERISTIC MisfDet_maskDnAdpnNv.CmbTyp2.Hld_C "Mask with inhibiting conditions of storing dN adaption No turn off delay / mask of selected disabling conditions, engine type specific / bit mask delayed conditions" VALUE 0x805310C4 RB_Val_Wu32 4294967295.00 OneToOne 0.00 4294967295.00 FORMAT "%13.2" /end CHARACTERISTIC
/begin CHARACTERISTIC MisfDet_maskDnAdpnNv.CmbTyp2.Raw_C "Mask with inhibiting conditions of storing dN adaption No turn off delay / mask of selected disabling conditions, engine type specific / bit mask not delayed conditions" VALUE 0x805310C8 RB_Val_Wu32 4294967295.00 OneToOne 0.00 4294967295.00 FORMAT "%13.2" /end CHARACTERISTIC
/begin CHARACTERISTIC MisfDet_maskDnAdpnNv.Cmn.HldN_C "Mask with inhibiting conditions of storing dN adaption No turn off delay / mask of selected disabling conditions / bit mask delayed conditions engine speed dependant" VALUE 0x805310D0 RB_Val_Wu32 4294967295.00 OneToOne 0.00 4294967295.00 FORMAT "%13.2" /end CHARACTERISTIC
/begin CHARACTERISTIC MisfDet_maskDnAdpnNv.Cmn.Hld_C "Mask with inhibiting conditions of storing dN adaption No turn off delay / mask of selected disabling conditions / bit mask delayed conditions" VALUE 0x805310D4 RB_Val_Wu32 4294967295.00 OneToOne 0.00 4294967295.00 FORMAT "%13.2" /end CHARACTERISTIC
/begin CHARACTERISTIC MisfDet_maskDnAdpnNv.Cmn.Raw_C "Mask with inhibiting conditions of storing dN adaption No turn off delay / mask of selected disabling conditions / bit mask not delayed conditions" VALUE 0x805310D8 RB_Val_Wu32 4294967295.00 OneToOne 0.00 4294967295.00 FORMAT "%13.2" /end CHARACTERISTIC
/begin CHARACTERISTIC MisfDet_maskDnAdpnNvCorrn.cntrHld_C "Mask with inhibiting conditions for usage of stored dN adaption values / number ignitions delay" VALUE 0x80531050 RB_Val_Wu8 255.0 OneToOne 0.00 255.0 FORMAT "%5.1" /end CHARACTERISTIC
/begin CHARACTERISTIC MisfDet_maskDnAdpnNvCorrn.CmbTyp.Hld_C "Mask with inhibiting conditions for usage of stored dN adaption values / mask of selected disabling conditions, engine type specific / bit mask delayed conditions" VALUE 0x80531058 RB_Val_Wu32 4294967295.00 OneToOne 0.00 4294967295.00 FORMAT "%13.2" /end CHARACTERISTIC
/begin CHARACTERISTIC MisfDet_maskDnAdpnNvCorrn.CmbTyp.Raw_C "Mask with inhibiting conditions for usage of stored dN adaption values / mask of selected disabling conditions, engine type specific / bit mask not delayed conditions" VALUE 0x8053105C RB_Val_Wu32 4294967295.00 OneToOne 0.00 4294967295.00 FORMAT "%13.2" /end CHARACTERISTIC
/begin CHARACTERISTIC MisfDet_maskDnAdpnNvCorrn.Cmn.Hld_C "Mask with inhibiting conditions for usage of stored dN adaption values / mask of selected disabling conditions / bit mask delayed conditions" VALUE 0x80531064 RB_Val_Wu32 4294967295.00 OneToOne 0.00 4294967295.00 FORMAT "%13.2" /end CHARACTERISTIC
/begin CHARACTERISTIC MisfDet_maskDnAdpnNvCorrn.Cmn.Raw_C "Mask with inhibiting conditions for usage of stored dN adaption values / mask of selected disabling conditions / bit mask not delayed conditions" VALUE 0x80531068 RB_Val_Wu32 4294967295.00 OneToOne 0.00 4294967295.00 FORMAT "%13.2" /end CHARACTERISTIC
/begin CHARACTERISTIC MisfDet_maskDnAdpnPlaus.cntrHld_C "Mask with inhibiting conditions for plausibilisation of dn adaptation / number ignitions delay" VALUE 0x80531070 RB_Val_Wu8 255.0 OneToOne 0.00 255.0 FORMAT "%5.1" /end CHARACTERISTIC
/begin CHARACTERISTIC MisfDet_maskDnAdpnPlaus.CmbTyp.Hld_C "Mask with inhibiting conditions for plausibilisation of dn adaptation / mask of selected disabling conditions, engine type specific / bit mask delayed conditions" VALUE 0x80531078 RB_Val_Wu32 4294967295.00 OneToOne 0.00 4294967295.00 FORMAT "%13.2" /end CHARACTERISTIC
/begin CHARACTERISTIC MisfDet_maskDnAdpnPlaus.CmbTyp.Raw_C "Mask with inhibiting conditions for plausibilisation of dn adaptation / mask of selected disabling conditions, engine type specific / bit mask not delayed conditions" VALUE 0x8053107C RB_Val_Wu32 4294967295.00 OneToOne 0.00 4294967295.00 FORMAT "%13.2" /end CHARACTERISTIC
/begin CHARACTERISTIC MisfDet_maskDnAdpnPlaus.Cmn.Hld_C "Mask with inhibiting conditions for plausibilisation of dn adaptation / mask of selected disabling conditions / bit mask delayed conditions" VALUE 0x80531084 RB_Val_Wu32 4294967295.00 OneToOne 0.00 4294967295.00 FORMAT "%13.2" /end CHARACTERISTIC
/begin CHARACTERISTIC MisfDet_maskDnAdpnPlaus.Cmn.Raw_C "Mask with inhibiting conditions for plausibilisation of dn adaptation / mask of selected disabling conditions / bit mask not delayed conditions" VALUE 0x80531088 RB_Val_Wu32 4294967295.00 OneToOne 0.00 4294967295.00 FORMAT "%13.2" /end CHARACTERISTIC
/begin CHARACTERISTIC MisfDet_maskDnFltd.cntrHldN_T "Mask with inhibiting conditions of temporary dN adaption No turn off delay / number ignitions delay, engine speed dependant" CURVE 0x8053122C RB_Curve_S16_U8_Static 255.0 OneToOne 0.00 255.0 FORMAT "%5.1"
 /begin AXIS_DESCR STD_AXIS Epm_nEng EngN 4 -16384.00 16383.50 FORMAT "%8.2" DEPOSIT ABSOLUTE /end AXIS_DESCR
/end CHARACTERISTIC
/begin CHARACTERISTIC MisfDet_maskDnFltd.cntrHld_C "Mask with inhibiting conditions of temporary dN adaption No turn off delay / number ignitions delay" VALUE 0x8053123A RB_Val_Wu8 255.0 OneToOne 0.00 255.0 FORMAT "%5.1" /end CHARACTERISTIC
/begin CHARACTERISTIC MisfDet_maskDnFltd.CmbTyp.HldN_C "Mask with inhibiting conditions of temporary dN adaption No turn off delay / mask of selected disabling conditions, engine type specific / bit mask delayed conditions engine speed dependant" VALUE 0x80531240 RB_Val_Wu32 4294967295.00 OneToOne 0.00 4294967295.00 FORMAT "%13.2" /end CHARACTERISTIC
/begin CHARACTERISTIC MisfDet_maskDnFltd.CmbTyp.Hld_C "Mask with inhibiting conditions of temporary dN adaption No turn off delay / mask of selected disabling conditions, engine type specific / bit mask delayed conditions" VALUE 0x80531244 RB_Val_Wu32 4294967295.00 OneToOne 0.00 4294967295.00 FORMAT "%13.2" /end CHARACTERISTIC
/begin CHARACTERISTIC MisfDet_maskDnFltd.CmbTyp.Raw_C "Mask with inhibiting conditions of temporary dN adaption No turn off delay / mask of selected disabling conditions, engine type specific / bit mask not delayed conditions" VALUE 0x80531248 RB_Val_Wu32 4294967295.00 OneToOne 0.00 4294967295.00 FORMAT "%13.2" /end CHARACTERISTIC
/begin CHARACTERISTIC MisfDet_maskDnFltd.Cmn.HldN_C "Mask with inhibiting conditions of temporary dN adaption No turn off delay / mask of selected disabling conditions / bit mask delayed conditions engine speed dependant" VALUE 0x80531250 RB_Val_Wu32 4294967295.00 OneToOne 0.00 4294967295.00 FORMAT "%13.2" /end CHARACTERISTIC
/begin CHARACTERISTIC MisfDet_maskDnFltd.Cmn.Hld_C "Mask with inhibiting conditions of temporary dN adaption No turn off delay / mask of selected disabling conditions / bit mask delayed conditions" VALUE 0x80531254 RB_Val_Wu32 4294967295.00 OneToOne 0.00 4294967295.00 FORMAT "%13.2" /end CHARACTERISTIC
/begin CHARACTERISTIC MisfDet_maskDnFltd.Cmn.Raw_C "Mask with inhibiting conditions of temporary dN adaption No turn off delay / mask of selected disabling conditions / bit mask not delayed conditions" VALUE 0x80531258 RB_Val_Wu32 4294967295.00 OneToOne 0.00 4294967295.00 FORMAT "%13.2" /end CHARACTERISTIC
/begin CHARACTERISTIC MisfDet_maskMisfGenrCfg_C "bitmask to configure the misfire generator" VALUE 0x80530ACB RB_Val_Wu8 255.0 OneToOne 0.00 255.0 FORMAT "%5.1" /end CHARACTERISTIC
/begin CHARACTERISTIC MisfDet_maskSegTiAdpn.CmbTyp.Raw_C "Mask with inhibiting conditions of segment time adaption during fuel on, no turn off delay / mask of selected disabling conditions, engine type specific / bit mask not delayed conditions" VALUE 0x805310E0 RB_Val_Wu32 4294967295.00 OneToOne 0.00 4294967295.00 FORMAT "%13.2" /end CHARACTERISTIC
/begin CHARACTERISTIC MisfDet_maskSegTiAdpn.CmbTyp2.Raw_C "Mask with inhibiting conditions of segment time adaption during fuel on, no turn off delay / mask of selected disabling conditions, engine type specific / bit mask not delayed conditions" VALUE 0x805310E8 RB_Val_Wu32 4294967295.00 OneToOne 0.00 4294967295.00 FORMAT "%13.2" /end CHARACTERISTIC
/begin CHARACTERISTIC MisfDet_maskSegTiAdpn.Cmn.Raw_C "Mask with inhibiting conditions of segment time adaption during fuel on, no turn off delay / mask of selected disabling conditions / bit mask not delayed conditions" VALUE 0x805310F0 RB_Val_Wu32 4294967295.00 OneToOne 0.00 4294967295.00 FORMAT "%13.2" /end CHARACTERISTIC
/begin CHARACTERISTIC MisfDet_maskSegTiAdpnFco.CmbTyp.Raw_C "Mask with inhibiting conditions of segment time adaption during fuel cut off / mask of selected disabling conditions, engine type specific / bit mask not delayed conditions" VALUE 0x80531090 RB_Val_Wu32 4294967295.00 OneToOne 0.00 4294967295.00 FORMAT "%13.2" /end CHARACTERISTIC
/begin CHARACTERISTIC MisfDet_maskSegTiAdpnFco.Cmn.Raw_C "Mask with inhibiting conditions of segment time adaption during fuel cut off / mask of selected disabling conditions / bit mask not delayed conditions" VALUE 0x80531098 RB_Val_Wu32 4294967295.00 OneToOne 0.00 4294967295.00 FORMAT "%13.2" /end CHARACTERISTIC
/begin CHARACTERISTIC MisfDet_maskStc.cntrHldN_T "Mask with inhibiting conditions of statistical function, no turn off delay / number ignitions delay, engine speed dependant" CURVE 0x8053125C RB_Curve_S16_U8_Static 255.0 OneToOne 0.00 255.0 FORMAT "%5.1"
 /begin AXIS_DESCR STD_AXIS Epm_nEng EngN 4 -16384.00 16383.50 FORMAT "%8.2" DEPOSIT ABSOLUTE /end AXIS_DESCR
/end CHARACTERISTIC
/begin CHARACTERISTIC MisfDet_maskStc.cntrHld_C "Mask with inhibiting conditions of statistical function, no turn off delay / number ignitions delay" VALUE 0x8053126A RB_Val_Wu8 255.0 OneToOne 0.00 255.0 FORMAT "%5.1" /end CHARACTERISTIC
/begin CHARACTERISTIC MisfDet_maskStc.CmbTyp.HldN_C "Mask with inhibiting conditions of statistical function, no turn off delay / mask of selected disabling conditions, engine type specific / bit mask delayed conditions engine speed dependant" VALUE 0x80531270 RB_Val_Wu32 4294967295.00 OneToOne 0.00 4294967295.00 FORMAT "%13.2" /end CHARACTERISTIC
/begin CHARACTERISTIC MisfDet_maskStc.CmbTyp.Hld_C "Mask with inhibiting conditions of statistical function, no turn off delay / mask of selected disabling conditions, engine type specific / bit mask delayed conditions" VALUE 0x80531274 RB_Val_Wu32 4294967295.00 OneToOne 0.00 4294967295.00 FORMAT "%13.2" /end CHARACTERISTIC
/begin CHARACTERISTIC MisfDet_maskStc.CmbTyp.Raw_C "Mask with inhibiting conditions of statistical function, no turn off delay / mask of selected disabling conditions, engine type specific / bit mask not delayed conditions" VALUE 0x80531278 RB_Val_Wu32 4294967295.00 OneToOne 0.00 4294967295.00 FORMAT "%13.2" /end CHARACTERISTIC
/begin CHARACTERISTIC MisfDet_maskStc.Cmn.HldN_C "Mask with inhibiting conditions of statistical function, no turn off delay / mask of selected disabling conditionsmask of selected disabling conditions / bit mask delayed conditions engine speed dependant" VALUE 0x80531280 RB_Val_Wu32 4294967295.00 OneToOne 0.00 4294967295.00 FORMAT "%13.2" /end CHARACTERISTIC
/begin CHARACTERISTIC MisfDet_maskStc.Cmn.Hld_C "Mask with inhibiting conditions of statistical function, no turn off delay / mask of selected disabling conditionsmask of selected disabling conditions / bit mask delayed conditions" VALUE 0x80531284 RB_Val_Wu32 4294967295.00 OneToOne 0.00 4294967295.00 FORMAT "%13.2" /end CHARACTERISTIC
/begin CHARACTERISTIC MisfDet_maskStc.Cmn.Raw_C "Mask with inhibiting conditions of statistical function, no turn off delay / mask of selected disabling conditionsmask of selected disabling conditions / bit mask not delayed conditions" VALUE 0x80531288 RB_Val_Wu32 4294967295.00 OneToOne 0.00 4294967295.00 FORMAT "%13.2" /end CHARACTERISTIC
/begin AXIS_PTS MisfDet_n08TqZero_AX "grouped engine speed axis" 0x80530E2C Epm_nEng RB_Axis_S16 32767.50 EngN 8 -16384.00 16383.50 FORMAT "%8.2" DEPOSIT ABSOLUTE /end AXIS_PTS
/begin CHARACTERISTIC MisfDet_nEngDnFltdZeroNoSegTiAdpn_C "Engine speed threshold to reset filtered engine roughness in case of incomplete segment time adaptation" VALUE 0x80530E3E RB_Val_Ws16 32767.50 EngN -16384.00 16383.50 FORMAT "%8.2" /end CHARACTERISTIC
/begin CHARACTERISTIC MisfDet_nEngMax.Cmn_GT "Upper limit of allowed engine speed, gear dependant, / all transmission types" CURVE 0x805311F4 RB_CurveGroup_S16 32767.50 EngN -16384.00 16383.50 FORMAT "%8.2"
 /begin AXIS_DESCR COM_AXIS MisfDet_numGear OneToOne 11 -128.0 127.0 FORMAT "%5.1" AXIS_PTS_REF MisfDet_nEngMax_AX /end AXIS_DESCR
/end CHARACTERISTIC
/begin CHARACTERISTIC MisfDet_nEngMaxPedlEvln_C "max. engine speed for evaluation of the gradient of the accelerator pedal position" VALUE 0x80530E40 RB_Val_Ws16 32767.50 EngN -16384.00 16383.50 FORMAT "%8.2" /end CHARACTERISTIC
/begin AXIS_PTS MisfDet_nEngMax_AX "distribution of upper limit of allowed engine speed" 0x80530E42 MisfDet_numGear RB_Axis_S8 255.0 OneToOne 11 -128.0 127.0 FORMAT "%5.1" DEPOSIT ABSOLUTE /end AXIS_PTS
/begin CHARACTERISTIC MisfDet_nEngMin.Cmn_C "Lower limit of allowed engine speed / all transmission types" VALUE 0x8053120A RB_Val_Ws16 32767.50 EngN -16384.00 16383.50 FORMAT "%8.2" /end CHARACTERISTIC
/begin CHARACTERISTIC MisfDet_nEngMinPedlEvln_C "min. engine speed for evaluation of the gradient of the accelerator pedal position" VALUE 0x80530E4E RB_Val_Ws16 32767.50 EngN -16384.00 16383.50 FORMAT "%8.2" /end CHARACTERISTIC
/begin CHARACTERISTIC MisfDet_nrCmbDiCatHeat_C "number of ignitions for blank-out after a detected misfire under catalyst heat" VALUE 0x80530A84 RB_Val_Wu8 255.0 OneToOne 0.00 255.0 FORMAT "%5.1" /end CHARACTERISTIC
/begin CHARACTERISTIC MisfDet_nrCmbDi_M "number of ignitions of suppression after detected misfire" MAP 0x80530A86 RB_Map_U16S16_U8 255.0 OneToOne 0.00 255.0 FORMAT "%5.1"
 /begin AXIS_DESCR STD_AXIS MisfDet_tqBascSync rel_uw_b100 4 0.00 99.99847 FORMAT "%8.5" DEPOSIT ABSOLUTE /end AXIS_DESCR
 /begin AXIS_DESCR STD_AXIS MisfDet_nEngSync EngN 8 -16384.00 16383.50 FORMAT "%8.2" DEPOSIT ABSOLUTE /end AXIS_DESCR
/end CHARACTERISTIC
/begin CHARACTERISTIC MisfDet_nrCmbTest_C "duration of test-phase after detected misfire" VALUE 0x80530AC2 RB_Val_Wu8 255.0 OneToOne 0.00 255.0 FORMAT "%5.1" /end CHARACTERISTIC
/begin CHARACTERISTIC MisfDet_nrCycMisfCont_C "Number of consecutive misfires for condition continuous misfire" VALUE 0x805313C6 RB_Val_Wu8 255.0 OneToOne 0.00 255.0 FORMAT "%5.1" /end CHARACTERISTIC
/begin CHARACTERISTIC MisfDet_offsNIdle_C "Offset to idle engine speed to activate zero torque condition" VALUE 0x80530E50 RB_Val_Ws16 32767.50 EngN -16384.00 16383.50 FORMAT "%8.2" /end CHARACTERISTIC
/begin CHARACTERISTIC MisfDet_RoughRoadDiagStuckDNEngMin_C "Minimum engine speed gradient for stuck diagnosis of wheel speeds" VALUE 0x80531318 RB_Val_Ws16 32767.50 EngNGrad -16384.00 16383.50 FORMAT "%8.2" /end CHARACTERISTIC
/begin CHARACTERISTIC MisfDet_segPosnAltvNMax_C "Maximum engine speed for usage of the alternative segment position" VALUE 0x80531384 RB_Val_Ws16 32767.50 EngN -16384.00 16383.50 FORMAT "%8.2" /end CHARACTERISTIC
/begin CHARACTERISTIC MisfDet_segPosnCalcNMaxOffs_C "Engine speed offset for calculation of segment time of additional segment positions" VALUE 0x80531386 RB_Val_Ws16 32767.50 EngN -16384.00 16383.50 FORMAT "%8.2" /end CHARACTERISTIC
/begin CHARACTERISTIC MisfDet_segPosnIaLteHld_C "turn off delay of identifying the late ignition angle" VALUE 0x80531388 RB_Val_Wu8 255.0 dez 0.00 255.0 FORMAT "%5.1" /end CHARACTERISTIC
/begin CHARACTERISTIC MisfDet_segPosnIaLte_T "Threshold value for identifying the late ignition angle" CURVE 0x8053138A RB_Curve_S16_S8_Static 191.3 zw_sb_q0p75 -96.00 95.25 FORMAT "%5.2"
 /begin AXIS_DESCR STD_AXIS MisfDet_tEngStrt Temp_Cels 6 -3549.940 3003.560 FORMAT "%8.3" DEPOSIT ABSOLUTE /end AXIS_DESCR
/end CHARACTERISTIC
/begin CHARACTERISTIC MisfDet_segPosnLenAltv_C "Alternative segment length" VALUE 0x8053139E RB_Val_Wu8 170.0 kw_tooth_sy 10.0 180.0 FORMAT "%5.1" EXTENDED_LIMITS 0.00 2550. /end CHARACTERISTIC
/begin CHARACTERISTIC MisfDet_segPosnLen_C "segment length value" VALUE 0x8053139F RB_Val_Wu8 170.0 kw_tooth_sy 10.0 180.0 FORMAT "%5.1" EXTENDED_LIMITS 0.00 2550. /end CHARACTERISTIC
/begin CHARACTERISTIC MisfDet_segPosnOffsIaFilFac_C "filter factor for ignition angle to shift segment position" VALUE 0x805313A0 RB_Val_Wu16 0.9999847 fak_uw_b1 0.00 0.9999847 FORMAT "%9.7" /end CHARACTERISTIC
/begin CHARACTERISTIC MisfDet_segPosnOffsIdleDlyTi_C "Debounce time for switch to alternative segment position at low idle" VALUE 0x805313A2 KwUb 12.75 t_q0p05 0.00 12.75 FORMAT "%5.2" /end CHARACTERISTIC
/begin CHARACTERISTIC MisfDet_segPosnOffsIdleTMin_C "min temperature to switch to alternative segment at idle" VALUE 0x805313A4 RB_Val_Ws16 6553.500 Temp_Cels -3549.940 3003.560 FORMAT "%8.3" /end CHARACTERISTIC
/begin CHARACTERISTIC MisfDet_segPosnOffsNHys_C "Maximum engine speed offset" VALUE 0x805313A6 RB_Val_Ws16 32767.50 EngN -16384.00 16383.50 FORMAT "%8.2" /end CHARACTERISTIC
/begin CHARACTERISTIC MisfDet_segPosnOffsTqMaxOff_C "maximum torque for segment shift at low idle, hysteresis upper limit" VALUE 0x805313A8 RB_Val_Wu16 99.99847 rel_uw_b100 0.00 99.99847 FORMAT "%8.5" /end CHARACTERISTIC
/begin CHARACTERISTIC MisfDet_segPosnOffsTqMaxOn_C "maximum torque for segment shift at low idle, hysteresis lower limit" VALUE 0x805313AA RB_Val_Wu16 99.99847 rel_uw_b100 0.00 99.99847 FORMAT "%8.5" /end CHARACTERISTIC
/begin CHARACTERISTIC MisfDet_segPosnStrtAltv_C "starting position of the alternative segment" VALUE 0x805313AC RB_Val_Ws8 2550. kw_tooth_sy -1280. 1270. FORMAT "%5.0" /end CHARACTERISTIC
/begin CHARACTERISTIC MisfDet_segPosnStrt_C "starting position of the standard segment" VALUE 0x805313AD RB_Val_Ws8 2550. kw_tooth_sy -1280. 1270. FORMAT "%5.0" /end CHARACTERISTIC
/begin CHARACTERISTIC MisfDet_segShiftRedStgHld_C "Turn-off delay for usage of alternative segment in case of reduction stage" VALUE 0x805313AE RB_Val_Wu8 255.0 OneToOne 0.00 255.0 FORMAT "%5.1" /end CHARACTERISTIC
/begin CHARACTERISTIC MisfDet_segTiAdpnCntrEnaDlyEol_C "enable delay segment time adaptation at end of line" VALUE 0x80531330 RB_Val_Wu8 255.0 CaS_32rev_compu 0.00 255.0 FORMAT "%5.1" /end CHARACTERISTIC
/begin CHARACTERISTIC MisfDet_segTiAdpnCntrEnaDly_C "enable delay segment time adaptation" VALUE 0x80531331 RB_Val_Wu8 255.0 CaS_32rev_compu 0.00 255.0 FORMAT "%5.1" /end CHARACTERISTIC
/begin CHARACTERISTIC MisfDet_segTiAdpnDifMaxFco_C "maximale Differenz der Korrekturfaktoren bei erneutem Lernen at fuel cut off" VALUE 0x80531332 RB_Val_Wu16 11.99982 kw_q1p8310eEm4 0.00 11.99982 FORMAT "%8.5" /end CHARACTERISTIC
/begin CHARACTERISTIC MisfDet_segTiAdpnDifMaxPrio_C "maximum difference of correction factors at new learning with prioritization" VALUE 0x80531334 RB_Val_Wu16 11.99982 kw_q1p8310eEm4 0.00 11.99982 FORMAT "%8.5" /end CHARACTERISTIC
/begin CHARACTERISTIC MisfDet_segTiAdpnDifMax_C "maximum difference of correction factors at new learning" VALUE 0x80531336 RB_Val_Wu16 11.99982 kw_q1p8310eEm4 0.00 11.99982 FORMAT "%8.5" /end CHARACTERISTIC
/begin CHARACTERISTIC MisfDet_segTiAdpnFilFacDecEol_C "decrease of filter factor during learning progress at end of line" VALUE 0x80531338 RB_Val_Wu16 0.9999847 fak_uw_b1 0.00 0.9999847 FORMAT "%9.7" /end CHARACTERISTIC
/begin CHARACTERISTIC MisfDet_segTiAdpnFilFacDec_C "decrease of filter factor during learning progress" VALUE 0x8053133A RB_Val_Wu16 0.9999847 fak_uw_b1 0.00 0.9999847 FORMAT "%9.7" /end CHARACTERISTIC
/begin CHARACTERISTIC MisfDet_segTiAdpnFilFacEndEol_C "ending value of filterfactor at end of line" VALUE 0x8053133C RB_Val_Wu16 0.9999847 fak_uw_b1 0.00 0.9999847 FORMAT "%9.7" /end CHARACTERISTIC
/begin CHARACTERISTIC MisfDet_segTiAdpnFilFacEnd_C "ending value of filter factor" VALUE 0x8053133E RB_Val_Wu16 0.9999847 fak_uw_b1 0.00 0.9999847 FORMAT "%9.7" /end CHARACTERISTIC
/begin CHARACTERISTIC MisfDet_segTiAdpnFilFacStrtEol_C "starting value of filter factor at end of line" VALUE 0x80531340 RB_Val_Wu16 0.9999847 fak_uw_b1 0.00 0.9999847 FORMAT "%9.7" /end CHARACTERISTIC
/begin CHARACTERISTIC MisfDet_segTiAdpnFilFacStrt_C "starting value of filter factor" VALUE 0x80531342 RB_Val_Wu16 0.9999847 fak_uw_b1 0.00 0.9999847 FORMAT "%9.7" /end CHARACTERISTIC
/begin CHARACTERISTIC MisfDet_segTiAdpnN.Max.Eol_C "Engine speed limits SegTiAdpn / upper limit / End of line mode" VALUE 0x80531368 RB_Val_Ws16 32767.50 EngN -16384.00 16383.50 FORMAT "%8.2" /end CHARACTERISTIC
/begin CHARACTERISTIC MisfDet_segTiAdpnN.Max.PosTq.Cmn_C "Engine speed limits SegTiAdpn / upper limit / positive torque / all transmission types" VALUE 0x8053136A RB_Val_Ws16 32767.50 EngN -16384.00 16383.50 FORMAT "%8.2" /end CHARACTERISTIC
/begin CHARACTERISTIC MisfDet_segTiAdpnN.Max.Fco.Cmn_C "Engine speed limits SegTiAdpn / upper limit / fuel cut off / all transmission types" VALUE 0x8053136C RB_Val_Ws16 32767.50 EngN -16384.00 16383.50 FORMAT "%8.2" /end CHARACTERISTIC
/begin CHARACTERISTIC MisfDet_segTiAdpnN.Min.Eol_C "Engine speed limits SegTiAdpn / lower limit / End of line mode" VALUE 0x8053136E RB_Val_Ws16 32767.50 EngN -16384.00 16383.50 FORMAT "%8.2" /end CHARACTERISTIC
/begin CHARACTERISTIC MisfDet_segTiAdpnN.Min.PosTq.Cmn_C "Engine speed limits SegTiAdpn / lower limit / positive torque / all transmission types" VALUE 0x80531370 RB_Val_Ws16 32767.50 EngN -16384.00 16383.50 FORMAT "%8.2" /end CHARACTERISTIC
/begin CHARACTERISTIC MisfDet_segTiAdpnN.Min.Fco.Cmn_C "Engine speed limits SegTiAdpn / lower limit / fuel cut off / all transmission types" VALUE 0x80531372 RB_Val_Ws16 32767.50 EngN -16384.00 16383.50 FORMAT "%8.2" /end CHARACTERISTIC
/begin CHARACTERISTIC MisfDet_segTiAdpnNMaxNoDmd_C "Maximum engine speed no segment time adaptation necessary" VALUE 0x80531344 RB_Val_Ws16 32767.50 EngN -16384.00 16383.50 FORMAT "%8.2" /end CHARACTERISTIC
/begin CHARACTERISTIC MisfDet_segTiAdpnNrTryEolMax_C "Maximum number of attempts for learning at end of line mode" VALUE 0x80531346 RB_Val_Wu8 255.0 OneToOne 0.00 255.0 FORMAT "%5.1" /end CHARACTERISTIC
/begin CHARACTERISTIC MisfDet_segTiAdpnSampleSprdMax_C "maximal deviation of segment deviation samples" VALUE 0x80531348 RB_Val_Wu16 11.99982 kw_q1p8310eEm4 0.00 11.99982 FORMAT "%8.5" /end CHARACTERISTIC
/begin CHARACTERISTIC MisfDet_segTiAdpnTq.Max.Cmn_GT "torque limits to enable MisfDet_SegTiAdpn adaptation / upper limit / all transmission types" CURVE 0x80531374 RB_CurveGroup_S16 6553.500 Trq -3276.800 3276.700 FORMAT "%8.3"
 /begin AXIS_DESCR COM_AXIS Epm_nEng EngN 4 -16384.00 16383.50 FORMAT "%8.2" AXIS_PTS_REF MisfDet_segTiAdpnTqMax_AX /end AXIS_DESCR
/end CHARACTERISTIC
/begin CHARACTERISTIC MisfDet_segTiAdpnTq.Max.Eol_C "torque limits to enable MisfDet_SegTiAdpn adaptation / upper limit / End of line mode" VALUE 0x8053137C RB_Val_Ws16 6553.500 Trq -3276.800 3276.700 FORMAT "%8.3" /end CHARACTERISTIC
/begin CHARACTERISTIC MisfDet_segTiAdpnTq.Min.Cmn_C "torque limits to enable MisfDet_SegTiAdpn adaptation / lower limit / all transmission types" VALUE 0x8053137E RB_Val_Ws16 6553.500 Trq -3276.800 3276.700 FORMAT "%8.3" /end CHARACTERISTIC
/begin CHARACTERISTIC MisfDet_segTiAdpnTq.Min.Eol_C "torque limits to enable MisfDet_SegTiAdpn adaptation / lower limit / End of line mode" VALUE 0x80531380 RB_Val_Ws16 6553.500 Trq -3276.800 3276.700 FORMAT "%8.3" /end CHARACTERISTIC
/begin AXIS_PTS MisfDet_segTiAdpnTqMax_AX "engine speed axes for upper torque limit of segment time adaptation" 0x8053134A Epm_nEng RB_Axis_S16 32767.50 EngN 4 -16384.00 16383.50 FORMAT "%8.2" DEPOSIT ABSOLUTE /end AXIS_PTS
/begin CHARACTERISTIC MisfDet_segTiAdpnValMaxDebCntrThd_C "debounce threshold for maximum values diagnosis" VALUE 0x80531354 RB_Val_Wu8 255.0 OneToOne 0.00 255.0 FORMAT "%5.1" /end CHARACTERISTIC
/begin CHARACTERISTIC MisfDet_segTiAdpnValMaxEol_C "Maximum allowed absolute adaption value at end of line mode" VALUE 0x80531356 RB_Val_Ws16 11.99982 kw_q1p8310eEm4 -6.000000 5.999817 FORMAT "%8.6" /end CHARACTERISTIC
/begin CHARACTERISTIC MisfDet_segTiAdpnValMax_C "Maximum allowed absolute adaption value" VALUE 0x80531358 RB_Val_Ws16 11.99982 kw_q1p8310eEm4 -6.000000 5.999817 FORMAT "%8.6" /end CHARACTERISTIC
/begin CHARACTERISTIC MisfDet_segTiAdpnValSampleDiagDebCntrThd_C "debounce counter threshold for Sample-plausibility check diagnosis" VALUE 0x8053135A RB_Val_Wu8 254.0 OneToOne 1.0 255.0 FORMAT "%5.1" EXTENDED_LIMITS 0.00 255.0 /end CHARACTERISTIC
/begin CHARACTERISTIC MisfDet_segTiAdpnValSampleDiagMaxSampleNrThd_C "Number of samples needed for Sample-plausibility check diagnosis" VALUE 0x8053135B RB_Val_Wu8 254.0 OneToOne 1.0 255.0 FORMAT "%5.1" EXTENDED_LIMITS 0.00 255.0 /end CHARACTERISTIC
/begin CHARACTERISTIC MisfDet_segTiDifDebCntrThd_C "Threshold for debounce counter plausibility check delta of learning values" VALUE 0x8053135C RB_Val_Wu8 255.0 OneToOne 0.00 255.0 FORMAT "%5.1" /end CHARACTERISTIC
/begin CHARACTERISTIC MisfDet_segTiDly_C "initial value for delay of igntition to segment time" VALUE 0x805313AF RB_Val_Wu8 3.000 dez 0.00 3.000 FORMAT "%5.3" EXTENDED_LIMITS 0.00 255.0 /end CHARACTERISTIC
/begin CHARACTERISTIC MisfDet_segTiInin_C "initialisation value for segment duration related to 360 derees crankshaft" VALUE 0x805313B0 RB_Val_Wu16 65.53500 t1msxs_b65p535 0.00 65.53500 FORMAT "%8.5" /end CHARACTERISTIC
/begin CHARACTERISTIC MisfDet_segTiMnpl_FM "Map for manipulation of segment times" MAP 0x805313B2 RB_FixMap_S16S16_S16 11.99982 kw_q1p8310eEm4 -6.000000 5.999817 FORMAT "%8.6"
 /begin AXIS_DESCR FIX_AXIS MisfDet_cylCntrSegTi dez 4 0.00 3.000 FORMAT "%5.3" FIX_AXIS_PAR 0 0 4 /end AXIS_DESCR
 /begin AXIS_DESCR FIX_AXIS MisfDet_segPosnSegTi Compu_SegPosnInt_VERB 2 0.00 1.00000000000 FORMAT "%13.11" FIX_AXIS_PAR 0 0 2 /end AXIS_DESCR
/end CHARACTERISTIC
/begin CHARACTERISTIC MisfDet_segTiRatSprdDebCntrThd_C "Threshold for debounce counter plausibility check ratio of sampled values" VALUE 0x8053135D RB_Val_Wu8 255.0 OneToOne 0.00 255.0 FORMAT "%5.1" /end CHARACTERISTIC
/begin CHARACTERISTIC MisfDet_segTiRatSprdMax_C "maximum spread of segment time ratios" VALUE 0x8053135E RB_Val_Wu16 11.99982 kw_q1p8310eEm4 0.00 11.99982 FORMAT "%8.5" /end CHARACTERISTIC
/begin CHARACTERISTIC MisfDet_segTiRatSpreadFilFacMax_C "maximum filter factor for segTiRatSpread check" VALUE 0x80531360 RB_Val_Wu16 0.9999847 fak_uw_b1 0.00 0.9999847 FORMAT "%9.7" /end CHARACTERISTIC
/begin CHARACTERISTIC MisfDet_segTiSampleSprdDebCntrThd_C "Threshold for debounce counter plausibility check spreading of sampled values" VALUE 0x80531362 RB_Val_Wu8 255.0 OneToOne 0.00 255.0 FORMAT "%5.1" /end CHARACTERISTIC
/begin CHARACTERISTIC MisfDet_stDnAdpnCfgCal_C "configuration switch for calibration features" VALUE 0x80530A34 RB_Val_Wu8 255.0 OneToOne 0.00 255.0 FORMAT "%5.1" /end CHARACTERISTIC
/begin CHARACTERISTIC MisfDet_stDnAdpnCfg_C "configuration switch DnAdpn" VALUE 0x80530A35 RB_Val_Wu8 255.0 OneToOne 0.00 255.0 FORMAT "%5.1" /end CHARACTERISTIC
/begin CHARACTERISTIC MisfDet_stDnAdpnPlausCfg_C "configuration switch plaus checks" VALUE 0x80530A36 RB_Val_Wu8 255.0 OneToOne 0.00 255.0 FORMAT "%5.1" /end CHARACTERISTIC
/begin CHARACTERISTIC MisfDet_stDnCalcnCfg_C "configuration switch DnCalcn" VALUE 0x80530A82 RB_Val_Wu16 65535.00 OneToOne 0.00 65535.00 FORMAT "%8.2" /end CHARACTERISTIC
/begin CHARACTERISTIC MisfDet_stDnEvlnCfg_C "configuration switch DnEvln" VALUE 0x80530AC3 RB_Val_Wu8 255.0 OneToOne 0.00 255.0 FORMAT "%5.1" /end CHARACTERISTIC
/begin CHARACTERISTIC MisfDet_stRelsCdnCfg_C "bit mask for selection of release condition" VALUE 0x80530E52 RB_Val_Wu8 255.0 OneToOne 0.00 255.0 FORMAT "%5.1" /end CHARACTERISTIC
/begin CHARACTERISTIC MisfDet_stRoughRoadDiagCfg_C "Selection of the wheel speed diagnostics" VALUE 0x8053131A RB_Val_Wu8 255.0 OneToOne 0.00 255.0 FORMAT "%5.1" /end CHARACTERISTIC
/begin CHARACTERISTIC MisfDet_strtMisfGenr_C "start of misfire generator" VALUE 0x80530ACC RB_Val_Wu8 255.0 OneToOne 0.00 255.0 FORMAT "%5.1" /end CHARACTERISTIC
/begin CHARACTERISTIC MisfDet_stSegTiAdpnCfgCal_C "code to deactivate and reset the adaptation" VALUE 0x80531363 RB_Val_Wu8 255.0 OneToOne 0.00 255.0 FORMAT "%5.1" /end CHARACTERISTIC
/begin CHARACTERISTIC MisfDet_stSegTiAdpnCfgDiag_C "code word to enable the plaus checks for DFC" VALUE 0x80531364 RB_Val_Wu8 255.0 OneToOne 0.00 255.0 FORMAT "%5.1" /end CHARACTERISTIC
/begin CHARACTERISTIC MisfDet_stSegTiAdpnCfgEnaPosn_C "code word to enable the segment time adaptation of the segment positions" VALUE 0x80531365 RB_Val_Wu8 255.0 OneToOne 0.00 255.0 FORMAT "%5.1" /end CHARACTERISTIC
/begin CHARACTERISTIC MisfDet_stSegTiAdpnCfgEnaTyp.Cmn_C "code word to enable the segment time adaptation at fuel cut off or at positive torque / all transmission types" VALUE 0x80531382 RB_Val_Wu8 255.0 OneToOne 0.00 255.0 FORMAT "%5.1" /end CHARACTERISTIC
/begin CHARACTERISTIC MisfDet_stSegTiAdpnCfgFastLrn_C "code word for fast learning of segment time adaptation" VALUE 0x80531366 RB_Val_Wu8 255.0 OneToOne 0.00 255.0 FORMAT "%5.1" /end CHARACTERISTIC
/begin CHARACTERISTIC MisfDet_stSegTiAdpnCfgPrio_C "Codeword to prioritize the procedures of segment time adaptation" VALUE 0x80531367 RB_Val_Wu8 255.0 OneToOne 0.00 255.0 FORMAT "%5.1" /end CHARACTERISTIC
/begin CHARACTERISTIC MisfDet_stSegTiCalcnCfgCal_C "Configuration switch segment time calculation for calibration features" VALUE 0x805313C2 RB_Val_Wu8 255.0 dez 0.00 255.0 FORMAT "%5.1" /end CHARACTERISTIC
/begin CHARACTERISTIC MisfDet_stSegTiCalcnCfg_C "Configuration switch segment time calculation" VALUE 0x805313C4 RB_Val_Wu16 65535.00 dez 0.00 65535.00 FORMAT "%8.2" /end CHARACTERISTIC
/begin CHARACTERISTIC MisfDet_stSigSelnCfg_C "Configuration code word for FC:MisfDet_SigSeln" VALUE 0x805313C8 RB_Val_Wu16 65535.00 OneToOne 0.00 65535.00 FORMAT "%8.2" /end CHARACTERISTIC
/begin CHARACTERISTIC MisfDet_stTqZeroIdleCfg_C "Configuration of switching from zero torque curve to zero" VALUE 0x80530E53 RB_Val_Wu8 255.0 OneToOne 0.00 255.0 FORMAT "%5.1" /end CHARACTERISTIC
/begin CHARACTERISTIC MisfDet_swtOn_C "Switch to enable misfire detection" VALUE 0x80530E54 RB_Val_Wu8 255.0 OneToOne 0.00 255.0 FORMAT "%5.1" /end CHARACTERISTIC
/begin CHARACTERISTIC MisfDet_tblMisfPat_FM "table for definition of misfire mode and pattern" MAP 0x80530ACE RB_FixMap_S16S16_S16 65535.00 OneToOne -32768.00 32767.00 FORMAT "%8.2"
 /begin AXIS_DESCR FIX_AXIS MisfDet_idxMisfPat OneToOne 4 0.00 3.000 FORMAT "%5.3" FIX_AXIS_PAR 0 0 4 /end AXIS_DESCR
 /begin AXIS_DESCR FIX_AXIS MisfDet_idxMisfPat OneToOne 10 0.00 9.000 FORMAT "%5.3" FIX_AXIS_PAR 0 0 10 /end AXIS_DESCR
/end CHARACTERISTIC
/begin CHARACTERISTIC MisfDet_tEngDnAdpnMin_C "Temperature threshold for release of dN adaption function" VALUE 0x80530E56 RB_Val_Ws16 6553.500 Temp_Cels -3549.940 3003.560 FORMAT "%8.3" /end CHARACTERISTIC
/begin CHARACTERISTIC MisfDet_tEngSegTiAdpnMin_C "Temperature threshold for release of segment time adaption functionality, fuel off" VALUE 0x80530E58 RB_Val_Ws16 6553.500 Temp_Cels -3549.940 3003.560 FORMAT "%8.3" /end CHARACTERISTIC
/begin CHARACTERISTIC Misfdet_thdAgKnkCtrl_C "threshold maximum ignition-timing retardation" VALUE 0x80530E5A RB_Val_Ws8 95.25 kw_q0p75 0.00 95.25 FORMAT "%5.2" EXTENDED_LIMITS -96.00 95.25 /end CHARACTERISTIC
/begin CHARACTERISTIC Misfdet_thdDeltaAgIgnBas_M "Threshold delta ignition angle to bas ignition angle" MAP 0x80530E5C RB_Map_U16S16_S8 191.3 kw_q0p75 -96.00 95.25 FORMAT "%5.2"
 /begin AXIS_DESCR STD_AXIS MisfDet_tqBasc rel_uw_b100 8 0.00 99.99847 FORMAT "%8.5" DEPOSIT ABSOLUTE /end AXIS_DESCR
 /begin AXIS_DESCR STD_AXIS Epm_nEng EngN 8 -16384.00 16383.50 FORMAT "%8.2" DEPOSIT ABSOLUTE /end AXIS_DESCR
/end CHARACTERISTIC
/begin CHARACTERISTIC MisfDet_thdNEngStrt_C "Threshold of engine speed to detect engine start" VALUE 0x80530EC0 RB_Val_Ws16 32767.50 EngN -16384.00 16383.50 FORMAT "%8.2" /end CHARACTERISTIC
/begin CHARACTERISTIC Misfdet_thdrLamS1B_C "Threshold for lambda actual value from sensor 1 of bank 1 and 2" VALUE 0x80530EC2 RB_Val_Wu16 15.99976 fak_uw_b16 0.00 15.99976 FORMAT "%8.5" /end CHARACTERISTIC
/begin CHARACTERISTIC MisfDet_thdTEngDetnEna_C "Temperature threshold for release of statistics and adaption functions" VALUE 0x80530EC4 RB_Val_Ws16 6553.500 Temp_Cels -3549.940 3003.560 FORMAT "%8.3" /end CHARACTERISTIC
/begin CHARACTERISTIC MisfDet_thdTEngDetnStrt_C "Temperature threshold for release of statistics and adaption functions" VALUE 0x80530EC6 RB_Val_Ws16 6553.500 Temp_Cels -3549.940 3003.560 FORMAT "%8.3" /end CHARACTERISTIC
/begin CHARACTERISTIC MisfDet_thdTqZeroDrv.Cmn_GT "Threshold zero torque at crankshaft driving state / all transmission types" CURVE 0x8053120C RB_CurveGroup_U16 99.99847 rel_uw_b100 0.00 99.99847 FORMAT "%8.5"
 /begin AXIS_DESCR COM_AXIS Epm_nEng EngN 8 -16384.00 16383.50 FORMAT "%8.2" AXIS_PTS_REF MisfDet_n08TqZero_AX /end AXIS_DESCR
/end CHARACTERISTIC
/begin CHARACTERISTIC MisfDet_thdTqZeroFlreDwn_C "Threshold zero torque at crankshaft, during flare down phase of engine speed" VALUE 0x80530EC8 RB_Val_Wu16 99.99847 rel_uw_b100 0.00 99.99847 FORMAT "%8.5" /end CHARACTERISTIC
/begin CHARACTERISTIC MisfDet_thdTqZeroIdle.Cmn_GT "Threshold zero torque at crankshaft idle state / all transmission types" CURVE 0x8053121C RB_CurveGroup_U16 99.99847 rel_uw_b100 0.00 99.99847 FORMAT "%8.5"
 /begin AXIS_DESCR COM_AXIS Epm_nEng EngN 8 -16384.00 16383.50 FORMAT "%8.2" AXIS_PTS_REF MisfDet_n08TqZero_AX /end AXIS_DESCR
/end CHARACTERISTIC
/begin CHARACTERISTIC MisfDet_thdTrgVal_C "threshold value for trigger functionality" VALUE 0x80530B20 RB_Val_Wu32 4294967295.00 OneToOne 0.00 4294967295.00 FORMAT "%13.2" /end CHARACTERISTIC
/begin CHARACTERISTIC MisfDet_tiRoughRoadDT1_C "time constant of DT1 engine speed gradient for wheel speed diagnosis" VALUE 0x8053131C RB_Val_Ws32 4294.9672940000000 TimeDelay_s 0.0000020000000 4294.9672959999998 FORMAT "%19.14" EXTENDED_LIMITS 0.000002000000001 4294.9672959999998 /end CHARACTERISTIC
/begin CHARACTERISTIC MisfDet_tiTrsmCorr_M "Correction map for initialisation of the drivetrain temperature model" MAP 0x80530ECA RB_Map_S16U16_U16 65535.00 Time_sec_q1_COMPU 0.00 65535.00 FORMAT "%8.2"
 /begin AXIS_DESCR STD_AXIS EnvT_t Temp_Cels 6 -3549.940 3003.560 FORMAT "%8.3" DEPOSIT ABSOLUTE /end AXIS_DESCR
 /begin AXIS_DESCR STD_AXIS MisfDet_tiEngOff Time_sec_q1_COMPU 6 0.00 65535.00 FORMAT "%8.2" DEPOSIT ABSOLUTE /end AXIS_DESCR
/end CHARACTERISTIC
/begin CHARACTERISTIC MisfDet_tiTrsmMax_C "Saturation of the modelled activation time for transmission line" VALUE 0x80530F2E RB_Val_Wu16 65535.00 Time_sec_q1_COMPU 0.00 65535.00 FORMAT "%8.2" /end CHARACTERISTIC
/begin CHARACTERISTIC MisfDet_tiTrsmMin_T "Threshold for time in which transmission is in heat up conditions" CURVE 0x80530F30 RB_Curve_S16_U16_Static 10485.60 TimeRed 0.00 10485.60 FORMAT "%8.2"
 /begin AXIS_DESCR STD_AXIS EnvT_t Temp_Cels 4 -3549.940 3003.560 FORMAT "%8.3" DEPOSIT ABSOLUTE /end AXIS_DESCR
/end CHARACTERISTIC
/begin CHARACTERISTIC MisfDet_tqTrsmMin_C "minimum engine torque, to rise transmission temperature" VALUE 0x80530F42 RB_Val_Wu16 99.99847 rel_uw_b100 0.00 99.99847 FORMAT "%8.5" /end CHARACTERISTIC
/begin CHARACTERISTIC MisfDet_tqZeroCorrnAlti_M "Map for zero torque correction, engine speed and altitude dependant" MAP 0x80530F44 RB_Map_S16U8_S16 99.99847 rel_uw_b100 -50.00000 49.99847 FORMAT "%8.5"
 /begin AXIS_DESCR STD_AXIS Epm_nEng EngN 5 -16384.00 16383.50 FORMAT "%8.2" DEPOSIT ABSOLUTE /end AXIS_DESCR
 /begin AXIS_DESCR STD_AXIS MisfDet_facEnvP fak_ub_b4 2 0.00 3.984 FORMAT "%5.3" DEPOSIT ABSOLUTE /end AXIS_DESCR
/end CHARACTERISTIC
/begin CHARACTERISTIC MisfDet_tqZeroCorrnTEng_M "Map for zero torque correction, engine speed and engine temperature dependant" MAP 0x80530F68 RB_Map_S16S16_U16 99.99847 rel_uw_b100 0.00 99.99847 FORMAT "%8.5"
 /begin AXIS_DESCR STD_AXIS Epm_nEng EngN 8 -16384.00 16383.50 FORMAT "%8.2" DEPOSIT ABSOLUTE /end AXIS_DESCR
 /begin AXIS_DESCR STD_AXIS MisfDet_tEng Temp_Cels 8 -3549.940 3003.560 FORMAT "%8.3" DEPOSIT ABSOLUTE /end AXIS_DESCR
/end CHARACTERISTIC
/begin CHARACTERISTIC MisfDet_trckWidth_C "Track width" VALUE 0x80531320 RB_Val_Wu16 65.53500 len_q0p001_m 0.00 65.53500 FORMAT "%8.5" /end CHARACTERISTIC
/begin CHARACTERISTIC MisfDet_trqMaxDiagVWhlDe_C "Maximum wheel torque for plausible check of wheel speed" VALUE 0x80531322 RB_Val_Ws16 6553.500 TrqPrpHigh -3276.800 3276.700 FORMAT "%8.3" /end CHARACTERISTIC
/begin CHARACTERISTIC MisfDet_vWhlDeMax_C "Maximum relative deviation of wheel speeds" VALUE 0x80531324 RB_Val_Wu16 199.9969 r_prc_q0p003052_COMPU 0.00 199.9969 FORMAT "%8.4" /end CHARACTERISTIC
/begin CHARACTERISTIC MisfDet_vWhlFil_C "Filter factor for wheel speed" VALUE 0x80531326 RB_Val_Wu16 0.9999847 fak_uw_b1 0.00 0.9999847 FORMAT "%9.7" /end CHARACTERISTIC
/begin CHARACTERISTIC MisfDet_vWhlMax_C "Maximum wheel speed" VALUE 0x80531328 RB_Val_Wu16 324.9950 vfzg_uw_b325 0.00 324.9950 FORMAT "%8.4" /end CHARACTERISTIC
/begin CHARACTERISTIC MisfDet_whlBas_C "Wheel basis" VALUE 0x8053132A RB_Val_Wu16 65.53500 len_q0p001_m 0.00 65.53500 FORMAT "%8.5" /end CHARACTERISTIC
/begin CHARACTERISTIC MisfDet_yawRateDeMax_C "Maximum relative deviation of yaw rates" VALUE 0x8053132C RB_Val_Wu16 199.9969 r_prc_q0p003052_COMPU 0.00 199.9969 FORMAT "%8.4" /end CHARACTERISTIC
/begin MEASUREMENT MisfDet_agKnkCtrlMax "maximum ignition-timing retardation during one working cycle" SBYTE kw_q0p75 1 100 -96.00 95.25 FORMAT "%5.2" ECU_ADDRESS 0x60000713 /end MEASUREMENT
/begin MEASUREMENT MisfDet_chkVWhlDe "Index of the wheel being checked by a plaus check" SBYTE OneToOne 1 100 -128.0 127.0 FORMAT "%5.1" ECU_ADDRESS 0x60006393 /end MEASUREMENT
/begin MEASUREMENT MisfDet_cntrIniTrsmTi "Counter for state of initialisation of the drivetrain temperature model" UBYTE OneToOne 1 100 0.00 255.0 FORMAT "%5.1" ECU_ADDRESS 0x60006395 /end MEASUREMENT
/begin MEASUREMENT MisfDet_cntrMisf "counter for misfire events" UWORD OneToOne 1 100 0.00 65535.00 FORMAT "%8.2" ECU_ADDRESS 0x6000043E /end MEASUREMENT
/begin MEASUREMENT MisfDet_cntrMisfDiag "counter of misfire events for diagnosis service-tester" UWORD OneToOne 1 100 0.00 65535.00 FORMAT "%8.2" ARRAY_SIZE 4 ECU_ADDRESS 0x50000230 /end MEASUREMENT
/begin MEASUREMENT MisfDet_cntrMisfDiagFild "exponential weighted moving average of misfire events for diagnosis service-tester" FLOAT32_IEEE OneToOne 1 100 -1.00000000E+037 1.00000000E+037 FORMAT "%13.3" ARRAY_SIZE 4 ECU_ADDRESS 0x600363AC /end MEASUREMENT
/begin MEASUREMENT MisfDet_cylCntr "cylinder counter misfire detection according to MisfDet_dn (Engine roughness signal)" UBYTE OneToOne 1 100 0.00 255.0 FORMAT "%5.1" ECU_ADDRESS 0x5000089A /end MEASUREMENT
/begin MEASUREMENT MisfDet_cylCntrMisfGenr "cylinder counter for misfire generator" UBYTE OneToOne 1 100 0.00 255.0 FORMAT "%5.1" ECU_ADDRESS 0x700018AC /end MEASUREMENT
/begin MEASUREMENT MisfDet_cylCntrSegTi "Cylinder counter for Misfire Detection according to Segment time" UBYTE dez 1 100 0.00 255.0 FORMAT "%5.1" ECU_ADDRESS 0x5000089B /end MEASUREMENT
/begin MEASUREMENT MisfDet_dn "angular acceleration" SWORD dn_Compu 1 100 -2048.000 2047.938 FORMAT "%8.3" ECU_ADDRESS 0x50000706 /end MEASUREMENT
/begin MEASUREMENT MisfDet_dnAdpnFilFac "filter factor for continuous adaptation" UWORD fak_uw_b1 1 100 0.00 0.9999847 FORMAT "%9.7" ECU_ADDRESS 0x5000062E /end MEASUREMENT
/begin MEASUREMENT MisfDet_dnAdpnFrzNEng "engine speed at stopping continuous adaptation" UWORD fak_ub_b1 1 100 0.00 255.9961 FORMAT "%8.4" ECU_ADDRESS 0x60000444 /end MEASUREMENT
/begin MEASUREMENT MisfDet_dnAdpnFrzTq "torque at stopping continuous adaptation" UWORD fak_ub_b1 1 100 0.00 255.9961 FORMAT "%8.4" ECU_ADDRESS 0x60000446 /end MEASUREMENT
/begin MEASUREMENT MisfDet_dnAdpnNEngRel "Relative engine speed of dn adaptation (index and position inside adaptation nrange" UWORD fak_ub_b1 1 100 0.00 255.9961 FORMAT "%8.4" ECU_ADDRESS 0x50000708 /end MEASUREMENT
/begin MEASUREMENT MisfDet_dnAdpnNvCoeff "coefficients used for interpolatio nof NV adaptation" FLOAT32_IEEE OneToOne 1 100 -1.00000000E+037 1.00000000E+037 FORMAT "%13.3" ARRAY_SIZE 2 ECU_ADDRESS 0x50001750 /end MEASUREMENT
/begin MEASUREMENT MisfDet_dnAdpnNvDst "Harmonic mean of the working point to the adaptation points" UWORD fak_ub_b1 1 100 0.00 255.9961 FORMAT "%8.4" ECU_ADDRESS 0x60000448 /end MEASUREMENT
/begin MEASUREMENT MisfDet_dnAdpnNvDstSng "Single distances of base points for interpolation" UWORD fak_ub_b1 1 100 0.00 255.9961 FORMAT "%8.4" ARRAY_SIZE 2 ECU_ADDRESS 0x600002A4 /end MEASUREMENT
/begin MEASUREMENT MisfDet_dnAdpnNvFilFac "filter factor used for NV adaptation" UWORD fak_uw_b1 1 100 0.00 0.9999847 FORMAT "%9.7" ECU_ADDRESS 0x6000044A /end MEASUREMENT
/begin MEASUREMENT MisfDet_dnAdpnNvIdx "array element of curent adaptation range" UBYTE OneToOne 1 100 0.00 255.0 FORMAT "%5.1" ECU_ADDRESS 0x50000867 /end MEASUREMENT
/begin MEASUREMENT MisfDet_dnAdpnNvIdxCmbn "Combined index of adaptation range (engine speed and load)" UWORD OneToOne 1 100 0.00 65535.00 FORMAT "%8.2" ECU_ADDRESS 0x50000630 /end MEASUREMENT
/begin MEASUREMENT MisfDet_dnAdpnNvInterpnTyp "type for interpolation in NV map" UBYTE OneToOne 1 100 0.00 255.0 FORMAT "%5.1" ECU_ADDRESS 0x6000639C /end MEASUREMENT
/begin MEASUREMENT MisfDet_dnAdpnNvNEngSum "cumulated speed after entering adaptation range" UWORD fak_ub_b1 1 100 0.00 255.9961 FORMAT "%8.4" ECU_ADDRESS 0x700018FA /end MEASUREMENT
/begin MEASUREMENT MisfDet_dnAdpnNvNrSampleCurr "Number of samples after entering adaptation range" UBYTE OneToOne 1 100 0.00 255.0 FORMAT "%5.1" ECU_ADDRESS 0x700018F8 /end MEASUREMENT
/begin MEASUREMENT MisfDet_dnAdpnNvObsvrIdx "indices of adaptation base points for interpolation" UWORD OneToOne 1 100 0.00 65535.00 FORMAT "%8.2" ARRAY_SIZE 3 ECU_ADDRESS 0x50005462 /end MEASUREMENT
/begin MEASUREMENT MisfDet_dnAdpnNvObsvrIdxNEng "Engine speed index of read out value" UBYTE OneToOne 1 100 0.00 255.0 FORMAT "%5.1" ECU_ADDRESS 0x6000639B /end MEASUREMENT
/begin MEASUREMENT MisfDet_dnAdpnNvObsvrIdxTq "load index of read out value" UBYTE OneToOne 1 100 0.00 255.0 FORMAT "%5.1" ECU_ADDRESS 0x6000639A /end MEASUREMENT
/begin MEASUREMENT MisfDet_dnAdpnNvObsvrNEng "engine speed read out of NV map" UBYTE fak_ub_b1 1 100 0.00 0.9961 ECU_ADDRESS 0x60006399 /end MEASUREMENT
/begin MEASUREMENT MisfDet_dnAdpnNvObsvrNrSample "number samples read put of NV map" UBYTE OneToOne 1 100 0.00 255.0 FORMAT "%5.1" ECU_ADDRESS 0x60006398 /end MEASUREMENT
/begin MEASUREMENT MisfDet_dnAdpnNvObsvrTq "load read out of NV map" UBYTE fak_ub_b1 1 100 0.00 0.9961 ECU_ADDRESS 0x60006397 /end MEASUREMENT
/begin MEASUREMENT MisfDet_dnAdpnNvObsvrVal "adaptation cvalue read out of NV map" SWORD dn_Compu 1 100 -2048.000 2047.938 FORMAT "%8.3" ARRAY_SIZE 4 ECU_ADDRESS 0x50005468 /end MEASUREMENT
/begin MEASUREMENT MisfDet_dnAdpnNvPlausAbsCntr "counter for failed DnAdpnNv absolute plaus checks" UBYTE OneToOne 1 100 0.00 255.0 FORMAT "%5.1" ECU_ADDRESS 0x60000714 /end MEASUREMENT
/begin MEASUREMENT MisfDet_dnAdpnNvPlausAbsCyl "cylinder with maximum amplitude for DnAdpnNv absolute plaus check" UBYTE OneToOne 1 100 0.00 255.0 FORMAT "%5.1" ECU_ADDRESS 0x60000715 /end MEASUREMENT
/begin MEASUREMENT MisfDet_dnAdpnNvPlausAbsValMax "maximum amplitude for DnAdpnNv absolute plaus check" SWORD dn_Compu 1 100 -2048.000 2047.938 FORMAT "%8.3" ECU_ADDRESS 0x700018F6 /end MEASUREMENT
/begin MEASUREMENT MisfDet_dnAdpnNvPlausSumCntr "counter for failed DnAdpnNv sum plaus checks" UBYTE OneToOne 1 100 0.00 255.0 FORMAT "%5.1" ECU_ADDRESS 0x60036519 /end MEASUREMENT
/begin MEASUREMENT MisfDet_dnAdpnNvPlausSumIdx "index of adaptation range of last DnAdpnNv sum plaus check" UBYTE OneToOne 1 100 0.00 255.0 FORMAT "%5.1" ECU_ADDRESS 0x60036518 /end MEASUREMENT
/begin MEASUREMENT MisfDet_dnAdpnNvQlyFac "factor for theshold offset based on confidence of DnAdpn" UWORD fak_uw_b1 1 100 0.00 0.9999847 FORMAT "%9.7" ECU_ADDRESS 0x5000070C /end MEASUREMENT
/begin MEASUREMENT MisfDet_dnAdpnNvStruct.nrSample "NV adaptation map / number of samples in adaptation range" UBYTE OneToOne 1 100 0.00 255.0 FORMAT "%5.1" ARRAY_SIZE 24 ECU_ADDRESS 0x60036408 /end MEASUREMENT
/begin MEASUREMENT MisfDet_dnAdpnNvStruct.nEng "NV adaptation map / adaptation barycenter concerning engine speed inside adaptation range" UBYTE fak_ub_b1 1 100 0.00 0.9961 ARRAY_SIZE 24 ECU_ADDRESS 0x60036420 /end MEASUREMENT
/begin MEASUREMENT MisfDet_dnAdpnNvStruct.tq "NV adaptation map / adaptation barycenter concerning torque inside adaptation range" UBYTE fak_ub_b1 1 100 0.00 0.9961 ARRAY_SIZE 24 ECU_ADDRESS 0x60036438 /end MEASUREMENT
/begin MEASUREMENT MisfDet_dnAdpnNvStruct.val "NV adaptation map / adaptation value of adaptation range" SWORD dn_Compu 1 100 -2048.000 2047.938 FORMAT "%8.3" ARRAY_SIZE 96 ECU_ADDRESS 0x60036450 /end MEASUREMENT
/begin MEASUREMENT MisfDet_dnAdpnNvSum "sum of single distances to base points of interpolation" SWORD dn_Compu 1 100 -2048.000 2047.938 FORMAT "%8.3" ECU_ADDRESS 0x600036CA /end MEASUREMENT
/begin MEASUREMENT MisfDet_dnAdpnNvTqSum "cumulated load after entering adaptation range" UWORD fak_ub_b1 1 100 0.00 255.9961 FORMAT "%8.4" ECU_ADDRESS 0x700018F4 /end MEASUREMENT
/begin MEASUREMENT MisfDet_dnAdpnNvValSum "cumulated adaptation value after entering adaptation range" SLONG dn_Compu 1 100 -134217728.000 134217727.938 FORMAT "%13.3" ARRAY_SIZE 4 ECU_ADDRESS 0x700018E4 /end MEASUREMENT
/begin MEASUREMENT MisfDet_dnAdpnPlausAbsCntr "counter for failed DnAdpn absolute plaus checks" UBYTE OneToOne 1 100 0.00 255.0 FORMAT "%5.1" ECU_ADDRESS 0x60000793 /end MEASUREMENT
/begin MEASUREMENT MisfDet_dnAdpnPlausAbsCyl "cylinder with maximum amplitude for DnAdpn plaus check" UBYTE OneToOne 1 100 0.00 255.0 FORMAT "%5.1" ECU_ADDRESS 0x60000716 /end MEASUREMENT
/begin MEASUREMENT MisfDet_dnAdpnPlausAbsThd "Threshold for DnAdpn(Nv) absolute plaus checks" SWORD dn_Compu 1 100 -2048.000 2047.938 FORMAT "%8.3" ECU_ADDRESS 0x6000044C /end MEASUREMENT
/begin MEASUREMENT MisfDet_dnAdpnPlausAbsValMax "maximum amplitude of DnAdpn absolute plaus check" SWORD dn_Compu 1 100 -2048.000 2047.938 FORMAT "%8.3" ECU_ADDRESS 0x700018E2 /end MEASUREMENT
/begin MEASUREMENT MisfDet_dnAdpnPlausMinCntr "counter for failed DnAdpn min plaus checks" UBYTE OneToOne 1 100 0.00 255.0 FORMAT "%5.1" ECU_ADDRESS 0x60000717 /end MEASUREMENT
/begin MEASUREMENT MisfDet_dnAdpnPlausMinCntrMax "maximum counter value for failed DnAdpn min plaus checks" UBYTE OneToOne 1 100 0.00 255.0 FORMAT "%5.1" ECU_ADDRESS 0x60036517 /end MEASUREMENT
/begin MEASUREMENT MisfDet_dnAdpnPlausMinRat "ratio of difference of sums to threshold of relative min plaus check" UBYTE rel_ub_b200 1 100 0.00 199.2 FORMAT "%5.1" ECU_ADDRESS 0x60000718 /end MEASUREMENT
/begin MEASUREMENT MisfDet_dnAdpnPlausMinRatMax "maximum ratio of difference of sums to threshold of relative min plaus check" UBYTE rel_ub_b200 1 100 0.00 199.2 FORMAT "%5.1" ECU_ADDRESS 0x60036516 /end MEASUREMENT
/begin MEASUREMENT MisfDet_dnAdpnPlausMinSum "sum of absolute values of dnCyl for Min plaus check" SLONG dn_Compu 1 100 -134217728.000 134217727.938 FORMAT "%13.3" ECU_ADDRESS 0x600002A8 /end MEASUREMENT
/begin MEASUREMENT MisfDet_dnAdpnPlausMinSumDif "difference of sum of absolute values of DnCyl if DnAdpnVal and DnAdpnValNv for Min plaus check" SWORD dn_Compu 1 100 -2048.000 2047.938 FORMAT "%8.3" ECU_ADDRESS 0x6000044E /end MEASUREMENT
/begin MEASUREMENT MisfDet_dnAdpnPlausMinSumNv "sum of absolute values of dnCyl if DnAdpnValNv would have been used for Min plaus check" SLONG dn_Compu 1 100 -134217728.000 134217727.938 FORMAT "%13.3" ECU_ADDRESS 0x50000238 /end MEASUREMENT
/begin MEASUREMENT MisfDet_dnAdpnPlausMinThdFac "factor to misfire detection threshold for min plaus" UBYTE fak_ub_b16 1 100 0.00 15.94 FORMAT "%5.2" ECU_ADDRESS 0x60000719 /end MEASUREMENT
/begin MEASUREMENT MisfDet_dnAdpnPlausRelCntr "counter for failed raltive plaus checks" UBYTE OneToOne 1 100 0.00 255.0 FORMAT "%5.1" ECU_ADDRESS 0x60000794 /end MEASUREMENT
/begin MEASUREMENT MisfDet_dnAdpnPlausRelCntrMax "maximum reached number of failed relative plaus checks whithin one driving cycle" UBYTE OneToOne 1 100 0.00 255.0 FORMAT "%5.1" ECU_ADDRESS 0x60036515 /end MEASUREMENT
/begin MEASUREMENT MisfDet_dnAdpnPlausRelCyl "cylinder with maximum amplitude for relative plaus check" UBYTE OneToOne 1 100 0.00 255.0 FORMAT "%5.1" ECU_ADDRESS 0x6000071A /end MEASUREMENT
/begin MEASUREMENT MisfDet_dnAdpnPlausRelRat "ratio of maximum amplitude to threshold of relative plaus check" UBYTE rel_ub_b200 1 100 0.00 199.2 FORMAT "%5.1" ECU_ADDRESS 0x6000071B /end MEASUREMENT
/begin MEASUREMENT MisfDet_dnAdpnPlausRelRatMax "maximum amplitude for relative plaus check" UBYTE rel_ub_b200 1 100 0.00 199.2 FORMAT "%5.1" ECU_ADDRESS 0x60036514 /end MEASUREMENT
/begin MEASUREMENT MisfDet_dnAdpnPlausRelRatMaxIdx "index of adaptation range of last faild relative plaus check" UBYTE OneToOne 1 100 0.00 255.0 FORMAT "%5.1" ECU_ADDRESS 0x60036513 /end MEASUREMENT
/begin MEASUREMENT MisfDet_dnAdpnPlausRelThd "threshold of relative plaus check" SWORD dn_Compu 1 100 -2048.000 2047.938 FORMAT "%8.3" ECU_ADDRESS 0x60000450 /end MEASUREMENT
/begin MEASUREMENT MisfDet_dnAdpnPlausRelValMax "maximum amplitude for relative plaus check" SWORD dn_Compu 1 100 -2048.000 2047.938 FORMAT "%8.3" ECU_ADDRESS 0x700018E0 /end MEASUREMENT
/begin MEASUREMENT MisfDet_dnAdpnQlyFac "Factor to threshold offset dependent on adaptation quality" UWORD fak_uw_b1 1 100 0.00 0.9999847 FORMAT "%9.7" ECU_ADDRESS 0x5000070E /end MEASUREMENT
/begin MEASUREMENT MisfDet_dnAdpnQlyFacAry "Array factor to threshold offset dependent on adaptation quality (per segment position)" UWORD fak_uw_b1 1 100 0.00 0.9999847 FORMAT "%9.7" ARRAY_SIZE 2 ECU_ADDRESS 0x700018DC /end MEASUREMENT
/begin MEASUREMENT MisfDet_dnAdpnRngChngActvnDly "delay of release after change of adaptation range" UBYTE OneToOne 1 100 0.00 255.0 FORMAT "%5.1" ECU_ADDRESS 0x50000868 /end MEASUREMENT
/begin MEASUREMENT MisfDet_dnAdpnRngTq "load limits of adaptation map" UWORD rel_uw_b100 1 100 0.00 99.99847 FORMAT "%8.5" ARRAY_SIZE 4 ECU_ADDRESS 0x5000023C /end MEASUREMENT
/begin MEASUREMENT MisfDet_dnAdpnStrtCntr "Number ignitions after start" UWORD OneToOne 1 100 0.00 65535.00 FORMAT "%8.2" ECU_ADDRESS 0x50000710 /end MEASUREMENT
/begin MEASUREMENT MisfDet_dnAdpnTqMin "lower torque limit of adaptation" UWORD rel_uw_b100 1 100 0.00 99.99847 FORMAT "%8.5" ECU_ADDRESS 0x50000632 /end MEASUREMENT
/begin MEASUREMENT MisfDet_dnAdpnTqRel "relative load for adaptation" UWORD fak_ub_b1 1 100 0.00 255.9961 FORMAT "%8.4" ECU_ADDRESS 0x50000712 /end MEASUREMENT
/begin MEASUREMENT MisfDet_dnAdpnVal "adaptation value for MisfDet_dn" SWORD dn_Compu 1 100 -2048.000 2047.938 FORMAT "%8.3" ARRAY_SIZE 4 ECU_ADDRESS 0x5000055C /end MEASUREMENT
/begin MEASUREMENT MisfDet_dnAdpnValAltv "adaptation value for MisfDet_dn alternative segment position" SWORD dn_Compu 1 100 -2048.000 2047.938 FORMAT "%8.3" ARRAY_SIZE 4 ECU_ADDRESS 0x700018D4 /end MEASUREMENT
/begin MEASUREMENT MisfDet_dnAdpnValCurr "adaptation value for MisfDet_dn current cylinder" SWORD dn_Compu 1 100 -2048.000 2047.938 FORMAT "%8.3" ECU_ADDRESS 0x70001D5A /end MEASUREMENT
/begin MEASUREMENT MisfDet_dnAdpnValNv "adaptation value from NV map for MisfDet_dn" SWORD dn_Compu 1 100 -2048.000 2047.938 FORMAT "%8.3" ARRAY_SIZE 4 ECU_ADDRESS 0x50000564 /end MEASUREMENT
/begin MEASUREMENT MisfDet_dnAdpnValNvFac "Factor to adaptation value in case of ramp down at low engine speed" UWORD fak_uw_b1 1 100 0.00 0.9999847 FORMAT "%9.7" ECU_ADDRESS 0x70001CDE /end MEASUREMENT
/begin MEASUREMENT MisfDet_dnAdpnValStd "adaptation value for MisfDet_dn standard segment position" SWORD dn_Compu 1 100 -2048.000 2047.938 FORMAT "%8.3" ARRAY_SIZE 4 ECU_ADDRESS 0x700018CC /end MEASUREMENT
/begin MEASUREMENT MisfDet_dnCyc "Engine speed gradient during one working cycle" SWORD dn_Compu 1 100 -2048.000 2047.938 FORMAT "%8.3" ECU_ADDRESS 0x70001D58 /end MEASUREMENT
/begin MEASUREMENT MisfDet_dnCyl "cylinder individual angular acceleration" SWORD dn_Compu 1 100 -2048.000 2047.938 FORMAT "%8.3" ARRAY_SIZE 4 ECU_ADDRESS 0x50000574 /end MEASUREMENT
/begin MEASUREMENT MisfDet_dnDif "difference of current dn to last dn of same segment" SWORD dn_Compu 1 100 -2048.000 2047.938 FORMAT "%8.3" ECU_ADDRESS 0x50000716 /end MEASUREMENT
/begin MEASUREMENT MisfDet_dnDifMin "difference current dn to minimum dnCyl" SWORD dn_Compu 1 100 -2048.000 2047.938 FORMAT "%8.3" ECU_ADDRESS 0x70001D56 /end MEASUREMENT
/begin MEASUREMENT MisfDet_dnDifNxt "difference of angular acceleration to the successive cylinder" SWORD dn_Compu 1 100 -2048.000 2047.938 FORMAT "%8.3" ECU_ADDRESS 0x70001D54 /end MEASUREMENT
/begin MEASUREMENT MisfDet_dnDly "delay of angular acceleration" UBYTE OneToOne 1 100 0.00 255.0 FORMAT "%5.1" ECU_ADDRESS 0x5000089C /end MEASUREMENT
/begin MEASUREMENT MisfDet_dnFilFac "filter factor for MisfDet_dnFltd" UWORD fak_uw_b1 1 100 0.00 0.9999847 FORMAT "%9.7" ARRAY_SIZE 4 ECU_ADDRESS 0x5000057C /end MEASUREMENT
/begin MEASUREMENT MisfDet_dnFltd "filtered angular acceleration of crankshaft" SWORD dn_Compu 1 100 -2048.000 2047.938 FORMAT "%8.3" ECU_ADDRESS 0x50000718 /end MEASUREMENT
/begin MEASUREMENT MisfDet_dnFltdCyl "cylinder individual filtered angular acceleration" SWORD dn_Compu 1 100 -2048.000 2047.938 FORMAT "%8.3" ARRAY_SIZE 4 ECU_ADDRESS 0x50000584 /end MEASUREMENT
/begin MEASUREMENT MisfDet_dnQnts "quantisation of MisfDet_dn" UBYTE fak_ub_b64 1 100 0.00 63.75 FORMAT "%5.2" ECU_ADDRESS 0x6000A02F /end MEASUREMENT
/begin MEASUREMENT MisfDet_dnRaw "not corrected angular acceleration" SWORD dn_Compu 1 100 -2048.000 2047.938 FORMAT "%8.3" ECU_ADDRESS 0x5000071A /end MEASUREMENT
/begin MEASUREMENT MisfDet_dnRawAry "array of not corrected angular acceleration (per segment position)" SWORD dn_Compu 1 100 -2048.000 2047.938 FORMAT "%8.3" ARRAY_SIZE 2 ECU_ADDRESS 0x70001D50 /end MEASUREMENT
/begin MEASUREMENT MisfDet_dnRawCyl "cylinder individual not corrected angular acceleration" SWORD dn_Compu 1 100 -2048.000 2047.938 FORMAT "%8.3" ARRAY_SIZE 4 ECU_ADDRESS 0x5000058C /end MEASUREMENT
/begin MEASUREMENT MisfDet_dPedlPosn "gradient of the accelerator pedal position" SWORD q0p06104_pc_DIV_s 1 100 -2000.000 1999.939 FORMAT "%8.3" ECU_ADDRESS 0x60000440 /end MEASUREMENT
/begin MEASUREMENT MisfDet_dTq "Gradient of engine torque" SWORD q0p06104_pc_DIV_s 1 100 -2000.000 1999.939 FORMAT "%8.3" ECU_ADDRESS 0x60000442 /end MEASUREMENT
/begin MEASUREMENT MisfDet_dVWhl "Differentiated wheel speed" UWORD acc_uw_b55p55 1 100 0.00 55.55471 FORMAT "%8.5" ARRAY_SIZE 4 ECU_ADDRESS 0x50005AD8 /end MEASUREMENT
/begin MEASUREMENT MisfDet_dVWhlAvrgFrnt "averaged wheel acceleration front axle" UWORD acc_uw_b55p55 1 100 0.00 55.55471 FORMAT "%8.5" ECU_ADDRESS 0x600036C6 /end MEASUREMENT
/begin MEASUREMENT MisfDet_dVWhlAvrgRe "averaged wheel acceleration rear axle" UWORD acc_uw_b55p55 1 100 0.00 55.55471 FORMAT "%8.5" ECU_ADDRESS 0x600036C4 /end MEASUREMENT
/begin MEASUREMENT MisfDet_dVWhlFild "Filtered differentiated wheel speed" UWORD acc_uw_b55p55 1 100 0.00 55.55471 FORMAT "%8.5" ARRAY_SIZE 4 ECU_ADDRESS 0x50005AE0 /end MEASUREMENT
/begin MEASUREMENT MisfDet_dVWhlFrntThd "Threshold to detect rough road front axle" UWORD acc_uw_b55p55 1 100 0.00 55.55471 FORMAT "%8.5" ECU_ADDRESS 0x600036C2 /end MEASUREMENT
/begin MEASUREMENT MisfDet_dVWhlFrntThdMapOut "Threshold to detect rough road front axle, output of map" UWORD acc_uw_b55p55 1 100 0.00 55.55471 FORMAT "%8.5" ECU_ADDRESS 0x600036C0 /end MEASUREMENT
/begin MEASUREMENT MisfDet_dVWhlRat "Ratio of largest and second largest wheel acceleration" UWORD fak_q0p01 1 100 0.00 655.3500 FORMAT "%8.4" ECU_ADDRESS 0x600036BE /end MEASUREMENT
/begin MEASUREMENT MisfDet_dVWhlReThd "Threshold to detect rough road rear axle" UWORD acc_uw_b55p55 1 100 0.00 55.55471 FORMAT "%8.5" ECU_ADDRESS 0x600036BC /end MEASUREMENT
/begin MEASUREMENT MisfDet_dVWhlReThdMapOut "Threshold to detect rough road rear axle, output of map" UWORD acc_uw_b55p55 1 100 0.00 55.55471 FORMAT "%8.5" ECU_ADDRESS 0x600036BA /end MEASUREMENT
/begin MEASUREMENT MisfDet_dVWhlThdFac "factor dependent on transmission ratio for threshold oh rough road detection" UBYTE fak_ub_b2 1 100 0.00 1.992188 FORMAT "%8.6" ECU_ADDRESS 0x60006394 /end MEASUREMENT
/begin MEASUREMENT MisfDet_facEnvP "Correction factor for zero load depending on ambient pressure" UBYTE fak_ub_b4 1 100 0.00 3.984 FORMAT "%5.3" ECU_ADDRESS 0x6000071C /end MEASUREMENT
/begin MEASUREMENT MisfDet_flgRoughRoad "Rough road detected" UBYTE B_TRUE 1 100 0.00 1.00000000000 BIT_MASK 0x1 FORMAT "%13.11" ECU_ADDRESS 0x700006FE /end MEASUREMENT
/begin MEASUREMENT MisfDet_flgRoughRoadFrnt "Rough road detected at front axle" UBYTE B_TRUE 1 100 0.00 1.00000000000 BIT_MASK 0x1 FORMAT "%13.11" ECU_ADDRESS 0x7000019C /end MEASUREMENT
/begin MEASUREMENT MisfDet_flgRoughRoadPrel "rough road detection without checking grip state" UBYTE B_TRUE 1 100 0.00 1.00000000000 BIT_MASK 0x1 FORMAT "%13.11" ECU_ADDRESS 0x7000019B /end MEASUREMENT
/begin MEASUREMENT MisfDet_flgRoughRoadRe "Rough road detected at rear axle" UBYTE B_TRUE 1 100 0.00 1.00000000000 BIT_MASK 0x1 FORMAT "%13.11" ECU_ADDRESS 0x7000019A /end MEASUREMENT
/begin MEASUREMENT MisfDet_flgSyncnRstSegTi "demand for reset of Segment time adaptation" UBYTE B_TRUE 1 100 0.00 1.00000000000 BIT_MASK 0x1 FORMAT "%13.11" ECU_ADDRESS 0x70000197 /end MEASUREMENT
/begin MEASUREMENT MisfDet_iaAvg "average ignition angle for segment position" SBYTE kw_q0p75 1 100 -96.00 95.25 FORMAT "%5.2" ECU_ADDRESS 0x7000189B /end MEASUREMENT
/begin MEASUREMENT MisfDet_iaLteCntr "Counter of turn off delay for the identifying the late ignition angle" UBYTE dez 1 100 0.00 255.0 FORMAT "%5.1" ECU_ADDRESS 0x7000189A /end MEASUREMENT
/begin MEASUREMENT MisfDet_iaMdn "Median of ignition angle for segment position" SBYTE kw_q0p75 1 100 -96.00 95.25 FORMAT "%5.2" ECU_ADDRESS 0x70001899 /end MEASUREMENT
/begin MEASUREMENT MisfDet_iaMdnAvrg "Lowpass filtered average of the ignition angle output" SBYTE kw_q0p75 1 100 -96.00 95.25 FORMAT "%5.2" ECU_ADDRESS 0x70001C43 /end MEASUREMENT
/begin MEASUREMENT MisfDet_idxMisfPat "index in misfire pattern table" UBYTE OneToOne 1 100 0.00 255.0 FORMAT "%5.1" ECU_ADDRESS 0x6000071D /end MEASUREMENT
/begin MEASUREMENT MisfDet_ignWaitBtwMisf "number of ignitions between cylinderindividual misfire patterns in single or permanent mode" UWORD OneToOne 1 100 0.00 65535.00 FORMAT "%8.2" ECU_ADDRESS 0x60000452 /end MEASUREMENT
/begin MEASUREMENT MisfDet_ignWaitBtwMisfMod "number of ignitions between misfire modes" UWORD OneToOne 1 100 0.00 65535.00 FORMAT "%8.2" ECU_ADDRESS 0x60000454 /end MEASUREMENT
/begin MEASUREMENT MisfDet_maskCntMisf "bit mask counted misfires during past working cycle" UWORD OneToOne 1 100 0.00 65535.00 FORMAT "%8.2" ECU_ADDRESS 0x50000644 /end MEASUREMENT
/begin MEASUREMENT MisfDet_maskDet "Bit mask detected misfires during past working cycle" UWORD OneToOne 1 100 0.00 65535.00 FORMAT "%8.2" ECU_ADDRESS 0x50000646 /end MEASUREMENT
/begin MEASUREMENT MisfDet_maskDFCsegTiAdpn "Indicating mask which plausibility check triggered DFC report" UBYTE OneToOne 1 100 0.00 255.0 FORMAT "%5.1" ECU_ADDRESS 0x60006390 /end MEASUREMENT
/begin MEASUREMENT MisfDet_maskDFCsegTiAdpnAltvPosn "Indicating mask of the alternative segment time position which plausibility check triggered DFC report" UBYTE OneToOne 1 100 0.00 255.0 FORMAT "%5.1" ECU_ADDRESS 0x600363FC /end MEASUREMENT
/begin MEASUREMENT MisfDet_maskDFCsegTiAdpnStdPosn "Indicating mask of the standard segment time position which plausibility check triggered DFC report" UBYTE OneToOne 1 100 0.00 255.0 FORMAT "%5.1" ECU_ADDRESS 0x600363FB /end MEASUREMENT
/begin MEASUREMENT MisfDet_maskDlyBlkDnAdpnNvCorrn "Shifiting mask with inhibiting bits for application of adapted and stored engine running roughness values" ULONG OneToOne 1 100 0.00 4294967295.00 FORMAT "%13.2" ECU_ADDRESS 0x7000189C /end MEASUREMENT
/begin MEASUREMENT Misfdet_maskDlyBlkDnFltd "Shifiting mask with inhibiting bits for dN calculation" ULONG OneToOne 1 100 0.00 4294967295.00 FORMAT "%13.2" ECU_ADDRESS 0x700018A8 /end MEASUREMENT
/begin MEASUREMENT Misfdet_maskDlyBlkStc "Shifiting mask with inhibiting bits for statistical function" ULONG OneToOne 1 100 0.00 4294967295.00 FORMAT "%13.2" ECU_ADDRESS 0x700018A4 /end MEASUREMENT
/begin MEASUREMENT MisfDet_maskDnAdpn.cntrStrt "Mask with inhibiting conditions of temporary dN adaption No turn off delay / Ignition counter since Engine start" UWORD OneToOne 1 100 0.00 65535.00 FORMAT "%8.2" ECU_ADDRESS 0x5000031C /end MEASUREMENT
/begin MEASUREMENT MisfDet_maskDnAdpn.CmbTyp.Hld "Mask with inhibiting conditions of temporary dN adaption No turn off delay / mask of selected disabling conditions, engine type specific / bit mask delayed conditions" ULONG OneToOne 1 100 0.00 4294967295.00 FORMAT "%13.2" ECU_ADDRESS 0x50000320 /end MEASUREMENT
/begin MEASUREMENT MisfDet_maskDnAdpn.CmbTyp.HldN "Mask with inhibiting conditions of temporary dN adaption No turn off delay / mask of selected disabling conditions, engine type specific / bit mask delayed conditions engine speed dependant" ULONG OneToOne 1 100 0.00 4294967295.00 FORMAT "%13.2" ECU_ADDRESS 0x50000324 /end MEASUREMENT
/begin MEASUREMENT MisfDet_maskDnAdpn.CmbTyp.Raw "Mask with inhibiting conditions of temporary dN adaption No turn off delay / mask of selected disabling conditions, engine type specific / bit mask not delayed conditions" ULONG OneToOne 1 100 0.00 4294967295.00 FORMAT "%13.2" ECU_ADDRESS 0x50000328 /end MEASUREMENT
/begin MEASUREMENT MisfDet_maskDnAdpn.Cmn.Hld "Mask with inhibiting conditions of temporary dN adaption No turn off delay / mask of selected disabling conditions / bit mask delayed conditions" ULONG OneToOne 1 100 0.00 4294967295.00 FORMAT "%13.2" ECU_ADDRESS 0x5000032C /end MEASUREMENT
/begin MEASUREMENT MisfDet_maskDnAdpn.Cmn.HldN "Mask with inhibiting conditions of temporary dN adaption No turn off delay / mask of selected disabling conditions / bit mask delayed conditions engine speed dependant" ULONG OneToOne 1 100 0.00 4294967295.00 FORMAT "%13.2" ECU_ADDRESS 0x50000330 /end MEASUREMENT
/begin MEASUREMENT MisfDet_maskDnAdpn.Cmn.Raw "Mask with inhibiting conditions of temporary dN adaption No turn off delay / mask of selected disabling conditions / bit mask not delayed conditions" ULONG OneToOne 1 100 0.00 4294967295.00 FORMAT "%13.2" ECU_ADDRESS 0x50000334 /end MEASUREMENT
/begin MEASUREMENT MisfDet_maskDnAdpnNv.CmbTyp.Hld "Mask with inhibiting conditions of storing dN adaption No turn off delay / mask of selected disabling conditions, engine type specific / bit mask delayed conditions" ULONG OneToOne 1 100 0.00 4294967295.00 FORMAT "%13.2" ECU_ADDRESS 0x500002E0 /end MEASUREMENT
/begin MEASUREMENT MisfDet_maskDnAdpnNv.CmbTyp.HldN "Mask with inhibiting conditions of storing dN adaption No turn off delay / mask of selected disabling conditions, engine type specific / bit mask delayed conditions engine speed dependant" ULONG OneToOne 1 100 0.00 4294967295.00 FORMAT "%13.2" ECU_ADDRESS 0x500002E4 /end MEASUREMENT
/begin MEASUREMENT MisfDet_maskDnAdpnNv.CmbTyp.Raw "Mask with inhibiting conditions of storing dN adaption No turn off delay / mask of selected disabling conditions, engine type specific / bit mask not delayed conditions" ULONG OneToOne 1 100 0.00 4294967295.00 FORMAT "%13.2" ECU_ADDRESS 0x500002E8 /end MEASUREMENT
/begin MEASUREMENT MisfDet_maskDnAdpnNv.CmbTyp2.Hld "Mask with inhibiting conditions of storing dN adaption No turn off delay / mask of selected disabling conditions, engine type specific / bit mask delayed conditions" ULONG OneToOne 1 100 0.00 4294967295.00 FORMAT "%13.2" ECU_ADDRESS 0x500002EC /end MEASUREMENT
/begin MEASUREMENT MisfDet_maskDnAdpnNv.CmbTyp2.HldN "Mask with inhibiting conditions of storing dN adaption No turn off delay / mask of selected disabling conditions, engine type specific / bit mask delayed conditions engine speed dependant" ULONG OneToOne 1 100 0.00 4294967295.00 FORMAT "%13.2" ECU_ADDRESS 0x500002F0 /end MEASUREMENT
/begin MEASUREMENT MisfDet_maskDnAdpnNv.CmbTyp2.Raw "Mask with inhibiting conditions of storing dN adaption No turn off delay / mask of selected disabling conditions, engine type specific / bit mask not delayed conditions" ULONG OneToOne 1 100 0.00 4294967295.00 FORMAT "%13.2" ECU_ADDRESS 0x500002F4 /end MEASUREMENT
/begin MEASUREMENT MisfDet_maskDnAdpnNv.Cmn.Hld "Mask with inhibiting conditions of storing dN adaption No turn off delay / mask of selected disabling conditions / bit mask delayed conditions" ULONG OneToOne 1 100 0.00 4294967295.00 FORMAT "%13.2" ECU_ADDRESS 0x500002F8 /end MEASUREMENT
/begin MEASUREMENT MisfDet_maskDnAdpnNv.Cmn.HldN "Mask with inhibiting conditions of storing dN adaption No turn off delay / mask of selected disabling conditions / bit mask delayed conditions engine speed dependant" ULONG OneToOne 1 100 0.00 4294967295.00 FORMAT "%13.2" ECU_ADDRESS 0x500002FC /end MEASUREMENT
/begin MEASUREMENT MisfDet_maskDnAdpnNv.Cmn.Raw "Mask with inhibiting conditions of storing dN adaption No turn off delay / mask of selected disabling conditions / bit mask not delayed conditions" ULONG OneToOne 1 100 0.00 4294967295.00 FORMAT "%13.2" ECU_ADDRESS 0x50000300 /end MEASUREMENT
/begin MEASUREMENT MisfDet_maskDnAdpnNvCmbd "Bit mask with inhibiting conditions of storing dN adaption combined" ULONG OneToOne 1 100 0.00 4294967295.00 FORMAT "%13.2" ECU_ADDRESS 0x6000036C /end MEASUREMENT
/begin MEASUREMENT MisfDet_maskDnAdpnNvCorrn.CmbTyp.Hld "Mask with inhibiting conditions for usage of stored dN adaption values / mask of selected disabling conditions, engine type specific / bit mask delayed conditions" ULONG OneToOne 1 100 0.00 4294967295.00 FORMAT "%13.2" ECU_ADDRESS 0x500002CC /end MEASUREMENT
/begin MEASUREMENT MisfDet_maskDnAdpnNvCorrn.CmbTyp.Raw "Mask with inhibiting conditions for usage of stored dN adaption values / mask of selected disabling conditions, engine type specific / bit mask not delayed conditions" ULONG OneToOne 1 100 0.00 4294967295.00 FORMAT "%13.2" ECU_ADDRESS 0x500002D0 /end MEASUREMENT
/begin MEASUREMENT MisfDet_maskDnAdpnNvCorrn.Cmn.Hld "Mask with inhibiting conditions for usage of stored dN adaption values / mask of selected disabling conditions / bit mask delayed conditions" ULONG OneToOne 1 100 0.00 4294967295.00 FORMAT "%13.2" ECU_ADDRESS 0x500002D4 /end MEASUREMENT
/begin MEASUREMENT MisfDet_maskDnAdpnNvCorrn.Cmn.Raw "Mask with inhibiting conditions for usage of stored dN adaption values / mask of selected disabling conditions / bit mask not delayed conditions" ULONG OneToOne 1 100 0.00 4294967295.00 FORMAT "%13.2" ECU_ADDRESS 0x500002D8 /end MEASUREMENT
/begin MEASUREMENT MisfDet_maskDnAdpnNvCorrnCmbd "Mask with selected inhibiting conditions for usage of stored dN adaption values" ULONG OneToOne 1 100 0.00 4294967295.00 FORMAT "%13.2" ECU_ADDRESS 0x50000594 /end MEASUREMENT
/begin MEASUREMENT MisfDet_maskDnAdpnNvCorrnCmbdCmbTyp "Mask with selected inhibiting conditions for usage of stored dN adaption values engine type specific" ULONG OneToOne 1 100 0.00 4294967295.00 FORMAT "%13.2" ECU_ADDRESS 0x50000598 /end MEASUREMENT
/begin MEASUREMENT MisfDet_maskDnAdpnPlaus.CmbTyp.Hld "Mask with inhibiting conditions for plausibilisation of dn adaptation / mask of selected disabling conditions, engine type specific / bit mask delayed conditions" ULONG OneToOne 1 100 0.00 4294967295.00 FORMAT "%13.2" ECU_ADDRESS 0x50000308 /end MEASUREMENT
/begin MEASUREMENT MisfDet_maskDnAdpnPlaus.CmbTyp.Raw "Mask with inhibiting conditions for plausibilisation of dn adaptation / mask of selected disabling conditions, engine type specific / bit mask not delayed conditions" ULONG OneToOne 1 100 0.00 4294967295.00 FORMAT "%13.2" ECU_ADDRESS 0x5000030C /end MEASUREMENT
/begin MEASUREMENT MisfDet_maskDnAdpnPlaus.Cmn.Hld "Mask with inhibiting conditions for plausibilisation of dn adaptation / mask of selected disabling conditions / bit mask delayed conditions" ULONG OneToOne 1 100 0.00 4294967295.00 FORMAT "%13.2" ECU_ADDRESS 0x50000310 /end MEASUREMENT
/begin MEASUREMENT MisfDet_maskDnAdpnPlaus.Cmn.Raw "Mask with inhibiting conditions for plausibilisation of dn adaptation / mask of selected disabling conditions / bit mask not delayed conditions" ULONG OneToOne 1 100 0.00 4294967295.00 FORMAT "%13.2" ECU_ADDRESS 0x50000314 /end MEASUREMENT
/begin MEASUREMENT MisfDet_maskDnDet "bitmask with cylinders which are detected as misfiring by the Dn-Evaluation procedure" UWORD OneToOne 1 100 0.00 65535.00 FORMAT "%8.2" ECU_ADDRESS 0x50000738 /end MEASUREMENT
/begin MEASUREMENT MisfDet_maskDnFltd.CmbTyp.Hld "Mask with inhibiting conditions of temporary dN adaption No turn off delay / mask of selected disabling conditions, engine type specific / bit mask delayed conditions" ULONG OneToOne 1 100 0.00 4294967295.00 FORMAT "%13.2" ECU_ADDRESS 0x5000033C /end MEASUREMENT
/begin MEASUREMENT MisfDet_maskDnFltd.CmbTyp.HldN "Mask with inhibiting conditions of temporary dN adaption No turn off delay / mask of selected disabling conditions, engine type specific / bit mask delayed conditions engine speed dependant" ULONG OneToOne 1 100 0.00 4294967295.00 FORMAT "%13.2" ECU_ADDRESS 0x50000340 /end MEASUREMENT
/begin MEASUREMENT MisfDet_maskDnFltd.CmbTyp.Raw "Mask with inhibiting conditions of temporary dN adaption No turn off delay / mask of selected disabling conditions, engine type specific / bit mask not delayed conditions" ULONG OneToOne 1 100 0.00 4294967295.00 FORMAT "%13.2" ECU_ADDRESS 0x50000344 /end MEASUREMENT
/begin MEASUREMENT MisfDet_maskDnFltd.Cmn.Hld "Mask with inhibiting conditions of temporary dN adaption No turn off delay / mask of selected disabling conditions / bit mask delayed conditions" ULONG OneToOne 1 100 0.00 4294967295.00 FORMAT "%13.2" ECU_ADDRESS 0x50000348 /end MEASUREMENT
/begin MEASUREMENT MisfDet_maskDnFltd.Cmn.HldN "Mask with inhibiting conditions of temporary dN adaption No turn off delay / mask of selected disabling conditions / bit mask delayed conditions engine speed dependant" ULONG OneToOne 1 100 0.00 4294967295.00 FORMAT "%13.2" ECU_ADDRESS 0x5000034C /end MEASUREMENT
/begin MEASUREMENT MisfDet_maskDnFltd.Cmn.Raw "Mask with inhibiting conditions of temporary dN adaption No turn off delay / mask of selected disabling conditions / bit mask not delayed conditions" ULONG OneToOne 1 100 0.00 4294967295.00 FORMAT "%13.2" ECU_ADDRESS 0x50000350 /end MEASUREMENT
/begin MEASUREMENT MisfDet_maskDnVld "Validity of engine roughness of the respective segment position" UBYTE OneToOne 1 100 0.00 255.0 FORMAT "%5.1" ECU_ADDRESS 0x5000089D /end MEASUREMENT
/begin MEASUREMENT MisfDet_maskMisfCont "bit mask continuous misfiring cylinder" UWORD OneToOne 1 100 0.00 65535.00 FORMAT "%8.2" ECU_ADDRESS 0x50000648 /end MEASUREMENT
/begin MEASUREMENT MisfDet_maskMisfSti "flagword for stimulated misfire" UWORD OneToOne 1 100 0.00 65535.00 FORMAT "%8.2" ECU_ADDRESS 0x5000073A /end MEASUREMENT
/begin MEASUREMENT MisfDet_maskMisfStiIgn "flagword for stimulated ignition misfires" UWORD OneToOne 1 100 0.00 65535.00 FORMAT "%8.2" ECU_ADDRESS 0x5000073C /end MEASUREMENT
/begin MEASUREMENT MisfDet_maskMisfStiInj "flagword for stimulated injection misfires" UWORD OneToOne 1 100 0.00 65535.00 FORMAT "%8.2" ECU_ADDRESS 0x5000073E /end MEASUREMENT
/begin MEASUREMENT MisfDet_maskRelsDnAdpn "mask with inhibiting conditions of temporary dN adaption" ULONG OneToOne 1 100 0.00 4294967295.00 FORMAT "%13.2" ECU_ADDRESS 0x50000358 /end MEASUREMENT
/begin MEASUREMENT MisfDet_maskRelsDnAdpnCmbTyp "mask with inhibiting conditions of temporary dN adaption, depending on diesel- or gasoline engine" ULONG OneToOne 1 100 0.00 4294967295.00 FORMAT "%13.2" ECU_ADDRESS 0x600002B0 /end MEASUREMENT
/begin MEASUREMENT MisfDet_maskRelsDnAdpnNv "mask with inhibiting conditions of storing dN adaption" ULONG OneToOne 1 100 0.00 4294967295.00 FORMAT "%13.2" ECU_ADDRESS 0x5000059C /end MEASUREMENT
/begin MEASUREMENT MisfDet_maskRelsDnAdpnNvCmbTyp "mask with inhibiting conditions of storing dN adaption, depending on diesel- or gasoline engine" ULONG OneToOne 1 100 0.00 4294967295.00 FORMAT "%13.2" ECU_ADDRESS 0x600002B4 /end MEASUREMENT
/begin MEASUREMENT MisfDet_maskRelsDnAdpnNvCmbTyp2 "mask with inhibiting conditions of storing dN adaption, depending on diesel- or gasoline engine" ULONG OneToOne 1 100 0.00 4294967295.00 FORMAT "%13.2" ECU_ADDRESS 0x600002B8 /end MEASUREMENT
/begin MEASUREMENT MisfDet_maskRelsDnAdpnNvCorrn "mask with inhibiting conditions for usage of stored dN adaptation values" UWORD OneToOne 1 100 0.00 65535.00 FORMAT "%8.2" ECU_ADDRESS 0x60000456 /end MEASUREMENT
/begin MEASUREMENT MisfDet_maskRelsDnAdpnNvCorrnCmbTyp "mask with inhibiting conditions for usage of stored dN adaptation values, depending on diesel- or gasoline engine" ULONG OneToOne 1 100 0.00 4294967295.00 FORMAT "%13.2" ECU_ADDRESS 0x5000035C /end MEASUREMENT
/begin MEASUREMENT MisfDet_maskRelsDnAdpnPlaus "Bitmask with inhibiting conditions for plausibilisation of temporary dN adaption" ULONG OneToOne 1 100 0.00 4294967295.00 FORMAT "%13.2" ECU_ADDRESS 0x50000360 /end MEASUREMENT
/begin MEASUREMENT MisfDet_maskRelsDnAdpnPlausCmbTyp "mask with inhibiting conditions for plausibilisation of dN adaption, depending on diesel- or gasoline engine" ULONG OneToOne 1 100 0.00 4294967295.00 FORMAT "%13.2" ECU_ADDRESS 0x600002BC /end MEASUREMENT
/begin MEASUREMENT MisfDet_maskRelsSegTiAdpnFco "mask with inhibiting conditions of segment time adaption during fuel off" ULONG OneToOne 1 100 0.00 4294967295.00 FORMAT "%13.2" ECU_ADDRESS 0x60000370 /end MEASUREMENT
/begin MEASUREMENT MisfDet_maskRelsSegTiAdpnFcoCmbTyp "mask with inhibiting conditions of segment time adaption during fuel off, depending on diesel- or gasoline engine" ULONG OneToOne 1 100 0.00 4294967295.00 FORMAT "%13.2" ECU_ADDRESS 0x600002C0 /end MEASUREMENT
/begin MEASUREMENT MisfDet_maskRelsStc "mask with inhibiting conditions of statistical function" ULONG OneToOne 1 100 0.00 4294967295.00 FORMAT "%13.2" ECU_ADDRESS 0x60000374 /end MEASUREMENT
/begin MEASUREMENT MisfDet_maskRelsStcCmbTyp "mask with inhibiting conditions of statistical function, depending on diesel- or gasoline engine" ULONG OneToOne 1 100 0.00 4294967295.00 FORMAT "%13.2" ECU_ADDRESS 0x60000378 /end MEASUREMENT
/begin MEASUREMENT MisfDet_maskSegPosnDnCalc "Calculation request for engine roughness of the respective segment position" UBYTE OneToOne 1 100 0.00 255.0 FORMAT "%5.1" ECU_ADDRESS 0x5000089E /end MEASUREMENT
/begin MEASUREMENT MisfDet_maskSegTiAdpn.CmbTyp.Raw "Mask with inhibiting conditions of segment time adaption during fuel on, no turn off delay / mask of selected disabling conditions, engine type specific / bit mask not delayed conditions" ULONG OneToOne 1 100 0.00 4294967295.00 FORMAT "%13.2" ECU_ADDRESS 0x5000036C /end MEASUREMENT
/begin MEASUREMENT MisfDet_maskSegTiAdpn.CmbTyp2.Raw "Mask with inhibiting conditions of segment time adaption during fuel on, no turn off delay / mask of selected disabling conditions, engine type specific / bit mask not delayed conditions" ULONG OneToOne 1 100 0.00 4294967295.00 FORMAT "%13.2" ECU_ADDRESS 0x50000370 /end MEASUREMENT
/begin MEASUREMENT MisfDet_maskSegTiAdpn.Cmn.Raw "Mask with inhibiting conditions of segment time adaption during fuel on, no turn off delay / mask of selected disabling conditions / bit mask not delayed conditions" ULONG OneToOne 1 100 0.00 4294967295.00 FORMAT "%13.2" ECU_ADDRESS 0x50000374 /end MEASUREMENT
/begin MEASUREMENT MisfDet_maskSegTiAdpnFco.CmbTyp.Raw "Mask with inhibiting conditions of segment time adaption during fuel cut off / mask of selected disabling conditions, engine type specific / bit mask not delayed conditions" ULONG OneToOne 1 100 0.00 4294967295.00 FORMAT "%13.2" ECU_ADDRESS 0x50000364 /end MEASUREMENT
/begin MEASUREMENT MisfDet_maskSegTiAdpnFco.Cmn.Raw "Mask with inhibiting conditions of segment time adaption during fuel cut off / mask of selected disabling conditions / bit mask not delayed conditions" ULONG OneToOne 1 100 0.00 4294967295.00 FORMAT "%13.2" ECU_ADDRESS 0x50000368 /end MEASUREMENT
/begin MEASUREMENT MisfDet_maskSegTiReqAdpn "request of calculation of segment time for adaptation" UBYTE OneToOne 1 100 0.00 255.0 FORMAT "%5.1" ECU_ADDRESS 0x60000795 /end MEASUREMENT
/begin MEASUREMENT MisfDet_maskSegTiVld "Validity of segment time of the respective segment position" UBYTE OneToOne 1 100 0.00 255.0 FORMAT "%5.1" ECU_ADDRESS 0x5000089F /end MEASUREMENT
/begin MEASUREMENT MisfDet_maskSegTiVldSegBasd "Validity of segment time of the respective segment position" UBYTE OneToOne 1 100 0.00 255.0 FORMAT "%5.1" ECU_ADDRESS 0x70001898 /end MEASUREMENT
/begin MEASUREMENT MisfDet_maskStc.CmbTyp.Hld "Mask with inhibiting conditions of statistical function, no turn off delay / mask of selected disabling conditions, engine type specific / bit mask delayed conditions" ULONG OneToOne 1 100 0.00 4294967295.00 FORMAT "%13.2" ECU_ADDRESS 0x5000037C /end MEASUREMENT
/begin MEASUREMENT MisfDet_maskStc.CmbTyp.HldN "Mask with inhibiting conditions of statistical function, no turn off delay / mask of selected disabling conditions, engine type specific / bit mask delayed conditions engine speed dependant" ULONG OneToOne 1 100 0.00 4294967295.00 FORMAT "%13.2" ECU_ADDRESS 0x50000380 /end MEASUREMENT
/begin MEASUREMENT MisfDet_maskStc.CmbTyp.Raw "Mask with inhibiting conditions of statistical function, no turn off delay / mask of selected disabling conditions, engine type specific / bit mask not delayed conditions" ULONG OneToOne 1 100 0.00 4294967295.00 FORMAT "%13.2" ECU_ADDRESS 0x50000384 /end MEASUREMENT
/begin MEASUREMENT MisfDet_maskStc.Cmn.Hld "Mask with inhibiting conditions of statistical function, no turn off delay / mask of selected disabling conditionsmask of selected disabling conditions / bit mask delayed conditions" ULONG OneToOne 1 100 0.00 4294967295.00 FORMAT "%13.2" ECU_ADDRESS 0x50000388 /end MEASUREMENT
/begin MEASUREMENT MisfDet_maskStc.Cmn.HldN "Mask with inhibiting conditions of statistical function, no turn off delay / mask of selected disabling conditionsmask of selected disabling conditions / bit mask delayed conditions engine speed dependant" ULONG OneToOne 1 100 0.00 4294967295.00 FORMAT "%13.2" ECU_ADDRESS 0x5000038C /end MEASUREMENT
/begin MEASUREMENT MisfDet_maskStc.Cmn.Raw "Mask with inhibiting conditions of statistical function, no turn off delay / mask of selected disabling conditionsmask of selected disabling conditions / bit mask not delayed conditions" ULONG OneToOne 1 100 0.00 4294967295.00 FORMAT "%13.2" ECU_ADDRESS 0x50000390 /end MEASUREMENT
/begin MEASUREMENT MisfDet_misfMod "actual misfire mode" SWORD OneToOne 1 100 -32768.00 32767.00 FORMAT "%8.2" ECU_ADDRESS 0x6000045A /end MEASUREMENT
/begin MEASUREMENT MisfDet_nrCmbDi "Number of ignitions for blank-out after a detecte misfire." UBYTE OneToOne 1 100 0.00 255.0 FORMAT "%5.1" ECU_ADDRESS 0x500008A0 /end MEASUREMENT
/begin MEASUREMENT MisfDet_nrCylMisfNoId "number of misfiring cylinders without cylinder identification" UBYTE OneToOne 1 100 0.00 255.0 FORMAT "%5.1" ARRAY_SIZE 1 ECU_ADDRESS 0x60000797 /end MEASUREMENT
/begin MEASUREMENT MisfDet_nrMisfConsc "NUmber of consecutive misfires" UBYTE OneToOne 1 100 0.00 255.0 FORMAT "%5.1" ARRAY_SIZE 4 ECU_ADDRESS 0x6000037C /end MEASUREMENT
/begin MEASUREMENT MisfDet_numGear "Variable to indicate the gear number for MisfDet" SBYTE OneToOne 1 100 -128.0 127.0 FORMAT "%5.1" ECU_ADDRESS 0x6000071E /end MEASUREMENT
/begin MEASUREMENT MisfDet_RoughRoadDNEng "Engine speed gradient for diagnosis of wheel speeds" SWORD EngNGrad 1 100 -16384.00 16383.50 FORMAT "%8.2" ECU_ADDRESS 0x600036B8 /end MEASUREMENT
/begin MEASUREMENT MisfDet_RoughRoadDstLog "Driven distance during detected rough road" UWORD len_q50_m 1 100 0.00 3276750. FORMAT "%8.0" ECU_ADDRESS 0x6000488E /end MEASUREMENT
/begin MEASUREMENT MisfDet_segPosnDn "segment position engine roughness" UBYTE Compu_SegPosnInt_VERB 1 100 0.00 259.000000000 FORMAT "%13.9" ECU_ADDRESS 0x500008A1 /end MEASUREMENT
/begin MEASUREMENT MisfDet_segPosnLen "segment length" UBYTE kw_tooth_sy 1 100 0.00 2550. FORMAT "%5.0" ECU_ADDRESS 0x70001C1C /end MEASUREMENT
/begin MEASUREMENT MisfDet_segPosnLenAry "segment length array(per segment position)" UBYTE kw_tooth_sy 1 100 0.00 2550. FORMAT "%5.0" ARRAY_SIZE 2 ECU_ADDRESS 0x6000071F /end MEASUREMENT
/begin MEASUREMENT MisfDet_segPosnLenSync "Segment length, synchronised" UBYTE kw_tooth_sy 1 100 0.00 2550. FORMAT "%5.0" ECU_ADDRESS 0x500008A2 /end MEASUREMENT
/begin MEASUREMENT MisfDet_segPosnSegTi "Current segment position of the segment time" UBYTE Compu_SegPosnInt_VERB 1 100 0.00 259.000000000 FORMAT "%13.9" ECU_ADDRESS 0x500008A3 /end MEASUREMENT
/begin MEASUREMENT MisfDet_segPosnStrt "starting position of the segment" SBYTE kw_tooth_sy 1 100 -1280. 1270. FORMAT "%5.0" ECU_ADDRESS 0x70001C42 /end MEASUREMENT
/begin MEASUREMENT MisfDet_segTi "segment time value" ULONG tsquant_l 1 100 0.00 214748364.750 FORMAT "%13.3" ECU_ADDRESS 0x70001DB0 /end MEASUREMENT
/begin MEASUREMENT MisfDet_segTiAdpnCntrEnaDly "enable delay segment time adaptation" UBYTE CaS_32rev_compu 1 100 0.00 255.0 FORMAT "%5.1" ECU_ADDRESS 0x60000721 /end MEASUREMENT
/begin MEASUREMENT MisfDet_segTiAdpnDifRelMax "maximum reached ratio of threshold for Dif fault in segment time adaptation" UBYTE rel_ub_b200 1 100 0.00 199.2 FORMAT "%5.1" ECU_ADDRESS 0x60036406 /end MEASUREMENT
/begin MEASUREMENT MisfDet_segTiAdpnFilFac "current filter factor segment time adaptation" UWORD fak_uw_b1 1 100 0.00 0.9999847 FORMAT "%9.7" ECU_ADDRESS 0x6000045C /end MEASUREMENT
/begin MEASUREMENT MisfDet_segTiAdpnNMax "Maximum engine speed for segment time adaptation" SWORD EngN 1 100 -16384.00 16383.50 FORMAT "%8.2" ECU_ADDRESS 0x50000748 /end MEASUREMENT
/begin MEASUREMENT MisfDet_segTiAdpnNMin "Minimum engine speed for segment time adaptation" SWORD EngN 1 100 -16384.00 16383.50 FORMAT "%8.2" ECU_ADDRESS 0x5000074C /end MEASUREMENT
/begin MEASUREMENT MisfDet_segTiAdpnRstCntr "reset counter learning filter not plausible segment time adaptation" UBYTE OneToOne 1 100 0.00 255.0 FORMAT "%5.1" ECU_ADDRESS 0x6000A02E /end MEASUREMENT
/begin MEASUREMENT MisfDet_segTiAdpnRstCntrAltvPosn "Reset counter of adaptation of alternative segment position" UBYTE OneToOne 1 100 0.00 255.0 FORMAT "%5.1" ECU_ADDRESS 0x600363FA /end MEASUREMENT
/begin MEASUREMENT MisfDet_segTiAdpnRstCntrFco "reset counter of adaptation after learning cycle at fuel cut off" UBYTE OneToOne 1 100 0.00 255.0 FORMAT "%5.1" ECU_ADDRESS 0x600363F9 /end MEASUREMENT
/begin MEASUREMENT MisfDet_segTiAdpnSample0.ary "Structure for samples of fuel off adaptation / array of segment deviation samples" SWORD kw_q1p8310eEm4 1 100 -6.000000 5.999817 FORMAT "%8.6" ARRAY_SIZE 11 ECU_ADDRESS 0x600363D4 /end MEASUREMENT
/begin MEASUREMENT MisfDet_segTiAdpnSample0.cntr "Structure for samples of fuel off adaptation / segment deviation sample counter" UBYTE OneToOne 1 100 0.00 255.0 FORMAT "%5.1" ECU_ADDRESS 0x600363EA /end MEASUREMENT
/begin MEASUREMENT MisfDet_segTiAdpnSample0.segPosn "Structure for samples of fuel off adaptation / currently learnt segment position" UBYTE Compu_SegPosn_VERB 1 100 0.00 261.000000000 FORMAT "%13.9" ECU_ADDRESS 0x600363EB /end MEASUREMENT
/begin MEASUREMENT MisfDet_segTiAdpnSample1.ary "Structure for samples of fuel off adaptation / array of segment deviation samples" SWORD kw_q1p8310eEm4 1 100 -6.000000 5.999817 FORMAT "%8.6" ARRAY_SIZE 11 ECU_ADDRESS 0x600363BC /end MEASUREMENT
/begin MEASUREMENT MisfDet_segTiAdpnSample1.cntr "Structure for samples of fuel off adaptation / segment deviation sample counter" UBYTE OneToOne 1 100 0.00 255.0 FORMAT "%5.1" ECU_ADDRESS 0x600363D2 /end MEASUREMENT
/begin MEASUREMENT MisfDet_segTiAdpnSample1.segPosn "Structure for samples of fuel off adaptation / currently learnt segment position" UBYTE Compu_SegPosn_VERB 1 100 0.00 261.000000000 FORMAT "%13.9" ECU_ADDRESS 0x600363D3 /end MEASUREMENT
/begin MEASUREMENT MisfDet_segTiAdpnSampleCntr "segment deviation sample counter" UBYTE OneToOne 1 100 0.00 255.0 FORMAT "%5.1" ECU_ADDRESS 0x60000798 /end MEASUREMENT
/begin MEASUREMENT MisfDet_segTiAdpnSampleMdn "median of segment deviation samples" SWORD kw_q1p8310eEm4 1 100 -6.000000 5.999817 FORMAT "%8.6" ARRAY_SIZE 1 ECU_ADDRESS 0x600049B4 /end MEASUREMENT
/begin MEASUREMENT MisfDet_segTiAdpnSampleSprdCntr "counter for failed sample spread checks in segment time adaptation" UBYTE OneToOne 1 100 0.00 255.0 FORMAT "%5.1" ECU_ADDRESS 0x60036405 /end MEASUREMENT
/begin MEASUREMENT MisfDet_segTiAdpnSampleSprdRelMax "maximum reached ratio of threshold for sample spread fault in segment time adaptation" UBYTE rel_ub_b200 1 100 0.00 199.2 FORMAT "%5.1" ECU_ADDRESS 0x60036404 /end MEASUREMENT
/begin MEASUREMENT MisfDet_segTiAdpnStruct0.rat "structure for calculation of segment time adaptation / Ratio modelled segment time to actual segment time" SWORD kw_q1p8310eEm4 1 100 -6.000000 5.999817 FORMAT "%8.6" ARRAY_SIZE 4 ECU_ADDRESS 0x5000039C /end MEASUREMENT
/begin MEASUREMENT MisfDet_segTiAdpnStruct0.ratFltd "structure for calculation of segment time adaptation / Ratio modelled segment time to actual segment time filtered" SLONG kw_q2p794eEm9 1 100 -6.00000000000 5.99999999721 FORMAT "%13.11" ARRAY_SIZE 4 ECU_ADDRESS 0x500003A4 /end MEASUREMENT
/begin MEASUREMENT MisfDet_segTiAdpnStruct0.ratMin "structure for calculation of segment time adaptation / cylinder individual minimum of segment duration ratio values, used for MisfDet_segTiRatSprd calculation" SWORD kw_q1p8310eEm4 1 100 -6.000000 5.999817 FORMAT "%8.6" ARRAY_SIZE 2 ECU_ADDRESS 0x500003B4 /end MEASUREMENT
/begin MEASUREMENT MisfDet_segTiAdpnStruct0.ratMax "structure for calculation of segment time adaptation / cylinder individual maximum of segment time ratio values, used for MisfDet_segTiRatSprd calculation" SWORD kw_q1p8310eEm4 1 100 -6.000000 5.999817 FORMAT "%8.6" ARRAY_SIZE 2 ECU_ADDRESS 0x500003B8 /end MEASUREMENT
/begin MEASUREMENT MisfDet_segTiAdpnStruct0.ratMinDiv "structure for calculation of segment time adaptation / divisor for ratMin calculation" UBYTE OneToOne 1 100 0.00 255.0 FORMAT "%5.1" ARRAY_SIZE 2 ECU_ADDRESS 0x500003BC /end MEASUREMENT
/begin MEASUREMENT MisfDet_segTiAdpnStruct0.ratMaxDiv "structure for calculation of segment time adaptation / divisor for ratMax calculation" UBYTE OneToOne 1 100 0.00 255.0 FORMAT "%5.1" ARRAY_SIZE 2 ECU_ADDRESS 0x500003BE /end MEASUREMENT
/begin MEASUREMENT MisfDet_segTiAdpnStruct0.ratSprd "structure for calculation of segment time adaptation / Spread of segment time ratios" UWORD kw_q1p8310eEm4 1 100 0.00 11.99982 FORMAT "%8.5" ECU_ADDRESS 0x500003C0 /end MEASUREMENT
/begin MEASUREMENT MisfDet_segTiAdpnStruct0.stFilRdy "structure for calculation of segment time adaptation / Status filter settled" UBYTE B_TRUE 1 100 0.00 1.00000000000 BIT_MASK 0x1 FORMAT "%13.11" ECU_ADDRESS 0x500003C2 /end MEASUREMENT
/begin MEASUREMENT MisfDet_segTiAdpnStruct0.stSampleSprdMax "structure for calculation of segment time adaptation / condition variation of segment deviation samples too big" UBYTE B_TRUE 1 100 0.00 1.00000000000 BIT_MASK 0x1 FORMAT "%13.11" ECU_ADDRESS 0x500003C3 /end MEASUREMENT
/begin MEASUREMENT MisfDet_segTiAdpnStruct0.stMdnMax "structure for calculation of segment time adaptation / current Median greater than maximum allowed adaptation value" UBYTE B_TRUE 1 100 0.00 1.00000000000 BIT_MASK 0x1 FORMAT "%13.11" ECU_ADDRESS 0x500003C4 /end MEASUREMENT
/begin MEASUREMENT MisfDet_segTiAdpnStruct0.sampleMdn "structure for calculation of segment time adaptation / median of segment deviation samples" SWORD kw_q1p8310eEm4 1 100 -6.000000 5.999817 FORMAT "%8.6" ARRAY_SIZE 1 ECU_ADDRESS 0x500003C6 /end MEASUREMENT
/begin MEASUREMENT MisfDet_segTiAdpnStruct0.sampleSprd "structure for calculation of segment time adaptation / deviation of the five middle segment deviation samples" UWORD kw_q1p8310eEm4 1 100 0.00 11.99982 FORMAT "%8.5" ARRAY_SIZE 1 ECU_ADDRESS 0x500003C8 /end MEASUREMENT
/begin MEASUREMENT MisfDet_segTiAdpnStruct0.sampleCurr "structure for calculation of segment time adaptation / filter value segment deviation" SWORD kw_q1p8310eEm4 1 100 -6.000000 5.999817 FORMAT "%8.6" ARRAY_SIZE 1 ECU_ADDRESS 0x500003CA /end MEASUREMENT
/begin MEASUREMENT MisfDet_segTiAdpnStruct0.segNr "structure for calculation of segment time adaptation / segment number" SBYTE OneToOne 1 100 -128.0 127.0 FORMAT "%5.1" ECU_ADDRESS 0x500003CC /end MEASUREMENT
/begin MEASUREMENT MisfDet_segTiAdpnStruct1.rat "structure for calculation of segment time adaptation / Ratio modelled segment time to actual segment time" SWORD kw_q1p8310eEm4 1 100 -6.000000 5.999817 FORMAT "%8.6" ARRAY_SIZE 4 ECU_ADDRESS 0x500003D0 /end MEASUREMENT
/begin MEASUREMENT MisfDet_segTiAdpnStruct1.ratFltd "structure for calculation of segment time adaptation / Ratio modelled segment time to actual segment time filtered" SLONG kw_q2p794eEm9 1 100 -6.00000000000 5.99999999721 FORMAT "%13.11" ARRAY_SIZE 4 ECU_ADDRESS 0x500003D8 /end MEASUREMENT
/begin MEASUREMENT MisfDet_segTiAdpnStruct1.ratMin "structure for calculation of segment time adaptation / cylinder individual minimum of segment duration ratio values, used for MisfDet_segTiRatSprd calculation" SWORD kw_q1p8310eEm4 1 100 -6.000000 5.999817 FORMAT "%8.6" ARRAY_SIZE 2 ECU_ADDRESS 0x500003E8 /end MEASUREMENT
/begin MEASUREMENT MisfDet_segTiAdpnStruct1.ratMax "structure for calculation of segment time adaptation / cylinder individual maximum of segment time ratio values, used for MisfDet_segTiRatSprd calculation" SWORD kw_q1p8310eEm4 1 100 -6.000000 5.999817 FORMAT "%8.6" ARRAY_SIZE 2 ECU_ADDRESS 0x500003EC /end MEASUREMENT
/begin MEASUREMENT MisfDet_segTiAdpnStruct1.ratMinDiv "structure for calculation of segment time adaptation / divisor for ratMin calculation" UBYTE OneToOne 1 100 0.00 255.0 FORMAT "%5.1" ARRAY_SIZE 2 ECU_ADDRESS 0x500003F0 /end MEASUREMENT
/begin MEASUREMENT MisfDet_segTiAdpnStruct1.ratMaxDiv "structure for calculation of segment time adaptation / divisor for ratMax calculation" UBYTE OneToOne 1 100 0.00 255.0 FORMAT "%5.1" ARRAY_SIZE 2 ECU_ADDRESS 0x500003F2 /end MEASUREMENT
/begin MEASUREMENT MisfDet_segTiAdpnStruct1.ratSprd "structure for calculation of segment time adaptation / Spread of segment time ratios" UWORD kw_q1p8310eEm4 1 100 0.00 11.99982 FORMAT "%8.5" ECU_ADDRESS 0x500003F4 /end MEASUREMENT
/begin MEASUREMENT MisfDet_segTiAdpnStruct1.stFilRdy "structure for calculation of segment time adaptation / Status filter settled" UBYTE B_TRUE 1 100 0.00 1.00000000000 BIT_MASK 0x1 FORMAT "%13.11" ECU_ADDRESS 0x500003F6 /end MEASUREMENT
/begin MEASUREMENT MisfDet_segTiAdpnStruct1.stSampleSprdMax "structure for calculation of segment time adaptation / condition variation of segment deviation samples too big" UBYTE B_TRUE 1 100 0.00 1.00000000000 BIT_MASK 0x1 FORMAT "%13.11" ECU_ADDRESS 0x500003F7 /end MEASUREMENT
/begin MEASUREMENT MisfDet_segTiAdpnStruct1.stMdnMax "structure for calculation of segment time adaptation / current Median greater than maximum allowed adaptation value" UBYTE B_TRUE 1 100 0.00 1.00000000000 BIT_MASK 0x1 FORMAT "%13.11" ECU_ADDRESS 0x500003F8 /end MEASUREMENT
/begin MEASUREMENT MisfDet_segTiAdpnStruct1.sampleMdn "structure for calculation of segment time adaptation / median of segment deviation samples" SWORD kw_q1p8310eEm4 1 100 -6.000000 5.999817 FORMAT "%8.6" ARRAY_SIZE 1 ECU_ADDRESS 0x500003FA /end MEASUREMENT
/begin MEASUREMENT MisfDet_segTiAdpnStruct1.sampleSprd "structure for calculation of segment time adaptation / deviation of the five middle segment deviation samples" UWORD kw_q1p8310eEm4 1 100 0.00 11.99982 FORMAT "%8.5" ARRAY_SIZE 1 ECU_ADDRESS 0x500003FC /end MEASUREMENT
/begin MEASUREMENT MisfDet_segTiAdpnStruct1.sampleCurr "structure for calculation of segment time adaptation / filter value segment deviation" SWORD kw_q1p8310eEm4 1 100 -6.000000 5.999817 FORMAT "%8.6" ARRAY_SIZE 1 ECU_ADDRESS 0x500003FE /end MEASUREMENT
/begin MEASUREMENT MisfDet_segTiAdpnStruct1.segNr "structure for calculation of segment time adaptation / segment number" SBYTE OneToOne 1 100 -128.0 127.0 FORMAT "%5.1" ECU_ADDRESS 0x50000400 /end MEASUREMENT
/begin MEASUREMENT MisfDet_segTiAdpnTqMax "upper torque limit to enable MisfDet_SegTiAdpn adaptation" SWORD Trq 1 100 -3276.800 3276.700 FORMAT "%8.3" ECU_ADDRESS 0x50000750 /end MEASUREMENT
/begin MEASUREMENT MisfDet_segTiAdpnTqMin "lower torque limit to enable MisfDet_SegTiAdpn adaptation" SWORD Trq 1 100 -3276.800 3276.700 FORMAT "%8.3" ECU_ADDRESS 0x50000754 /end MEASUREMENT
/begin MEASUREMENT MisfDet_segTiAdpnVal "adaptation values of segTiAdpn" SWORD kw_q1p8310eEm4 1 100 -6.000000 5.999817 FORMAT "%8.6" ARRAY_SIZE 1 ECU_ADDRESS 0x50005AE8 /end MEASUREMENT
/begin MEASUREMENT MisfDet_segTiAdpnValAltvPosn "adaptation values of segTiAdpn, alternative position" SWORD kw_q1p8310eEm4 1 100 -6.000000 5.999817 FORMAT "%8.6" ARRAY_SIZE 1 ECU_ADDRESS 0x600053C0 /end MEASUREMENT
/begin MEASUREMENT MisfDet_segTiAdpnValMaxCntr "counter for failed max checks in segment time adaptation" UBYTE OneToOne 1 100 0.00 255.0 FORMAT "%5.1" ECU_ADDRESS 0x60036403 /end MEASUREMENT
/begin MEASUREMENT MisfDet_segTiAdpnValMaxCntrEol "counter for failed max checks in segment time adaptation at end of line mode" UBYTE OneToOne 1 100 0.00 255.0 FORMAT "%5.1" ECU_ADDRESS 0x60036402 /end MEASUREMENT
/begin MEASUREMENT MisfDet_segTiAdpnValMaxDebCntrAltvPosn "debounce counter of the alternative segment time position for maximum values diagnosis" UBYTE OneToOne 1 100 0.00 255.0 FORMAT "%5.1" ECU_ADDRESS 0x600363F8 /end MEASUREMENT
/begin MEASUREMENT MisfDet_segTiAdpnValMaxDebCntrStdPosn "debounce counter of the standard segment time position for maximum values diagnosis" UBYTE OneToOne 1 100 0.00 255.0 FORMAT "%5.1" ECU_ADDRESS 0x600363F7 /end MEASUREMENT
/begin MEASUREMENT MisfDet_segTiAdpnValRelMax "maximum reached ratio of threshold for max fault in segment time adaptation" UBYTE rel_ub_b200 1 100 0.00 199.2 FORMAT "%5.1" ECU_ADDRESS 0x60036401 /end MEASUREMENT
/begin MEASUREMENT MisfDet_segTiAdpnValSampleDiagCntrAltvPosn "Sample counter of Sample-plausibility check diagnosis for the alternative segment position" UBYTE OneToOne 1 100 0.00 255.0 FORMAT "%5.1" ECU_ADDRESS 0x600363F6 /end MEASUREMENT
/begin MEASUREMENT MisfDet_segTiAdpnValSampleDiagCntrStdPosn "Sample counter of Sample-plausibility check diagnosis for the standard segment position" UBYTE OneToOne 1 100 0.00 255.0 FORMAT "%5.1" ECU_ADDRESS 0x600363F5 /end MEASUREMENT
/begin MEASUREMENT MisfDet_segTiAdpnValSampleDiagDebCntrAltvPosn "Debounce counter of Sample-plausibility check diagnosis for the alternative segment position" UBYTE OneToOne 1 100 0.00 255.0 FORMAT "%5.1" ECU_ADDRESS 0x600363F4 /end MEASUREMENT
/begin MEASUREMENT MisfDet_segTiAdpnValSampleDiagDebCntrStdPosn "Debounce counter of Sample-plausibility check diagnosis for the standard segment position" UBYTE OneToOne 1 100 0.00 255.0 FORMAT "%5.1" ECU_ADDRESS 0x600363F3 /end MEASUREMENT
/begin MEASUREMENT MisfDet_segTiAry "Array of segment times (per segment position)" ULONG tsquant_l 1 100 0.00 214748364.750 FORMAT "%13.3" ARRAY_SIZE 2 ECU_ADDRESS 0x500005A0 /end MEASUREMENT
/begin MEASUREMENT MisfDet_segTiDifDebCntr "debounce counter for plausibility check for delta of new learning values to stored values" UBYTE OneToOne 1 100 0.00 255.0 FORMAT "%5.1" ECU_ADDRESS 0x600363F2 /end MEASUREMENT
/begin MEASUREMENT MisfDet_segTiDly "delay of igntition to segment time" UBYTE dez 1 100 0.00 255.0 FORMAT "%5.1" ECU_ADDRESS 0x500008A4 /end MEASUREMENT
/begin MEASUREMENT MisfDet_segTiDlyCorr "correction value for segment time delay to ignition" SBYTE OneToOne 1 100 -128.0 127.0 FORMAT "%5.1" ECU_ADDRESS 0x5000086A /end MEASUREMENT
/begin MEASUREMENT MisfDet_segTiRatSprdCntrAltvPosn "counter for failed ratio spread checks for alternative segment position" UBYTE OneToOne 1 100 0.00 255.0 FORMAT "%5.1" ECU_ADDRESS 0x60036400 /end MEASUREMENT
/begin MEASUREMENT MisfDet_segTiRatSprdCntrStdPosn "counter for failed ratio spread checks for standard segment position" UBYTE OneToOne 1 100 0.00 255.0 FORMAT "%5.1" ECU_ADDRESS 0x600363FF /end MEASUREMENT
/begin MEASUREMENT MisfDet_segTiRatSprdDebCntrAltvPosn "debounce counter for plausibility check for ratio of sampled values for alternative segment position" UBYTE OneToOne 1 100 0.00 255.0 FORMAT "%5.1" ECU_ADDRESS 0x600363F1 /end MEASUREMENT
/begin MEASUREMENT MisfDet_segTiRatSprdDebCntrStdPosn "debounce counter for plausibility check for ratio of sampled values for standard segment position" UBYTE OneToOne 1 100 0.00 255.0 FORMAT "%5.1" ECU_ADDRESS 0x600363F0 /end MEASUREMENT
/begin MEASUREMENT MisfDet_segTiRatSprdRelMax "maximum reached ratio of threshold for ratio spread fault in segment time adaptation" UBYTE rel_ub_b200 1 100 0.00 199.2 FORMAT "%5.1" ECU_ADDRESS 0x600363FE /end MEASUREMENT
/begin MEASUREMENT MisfDet_segTiRawAry "Array of raw segment times (per segment position)" ULONG tsquant_l 1 100 0.00 214748364.750 FORMAT "%13.3" ARRAY_SIZE 2 ECU_ADDRESS 0x500005A8 /end MEASUREMENT
/begin MEASUREMENT MisfDet_segTiSampleSprdDebCntrAltvPosn "debounce counter for plausibility check for spreading of sampled values for alternative segment position" UBYTE OneToOne 1 100 0.00 255.0 FORMAT "%5.1" ECU_ADDRESS 0x600363EF /end MEASUREMENT
/begin MEASUREMENT MisfDet_segTiSampleSprdDebCntrStdPosn "debounce counter for plausibility check for spreading of sampled values for standard segment position" UBYTE OneToOne 1 100 0.00 255.0 FORMAT "%5.1" ECU_ADDRESS 0x600363EE /end MEASUREMENT
/begin MEASUREMENT MisfDet_segTiSegBasd "segment time based on raw time stamps" ULONG tsquant_l 1 100 0.00 214748364.750 FORMAT "%13.3" ARRAY_SIZE 2 ECU_ADDRESS 0x50000404 /end MEASUREMENT
/begin MEASUREMENT MisfDet_segTiValMdl "modelled segment time" ULONG tsquant_l 1 100 0.00 214748364.750 FORMAT "%13.3" ARRAY_SIZE 2 ECU_ADDRESS 0x5000040C /end MEASUREMENT
/begin MEASUREMENT MisfDet_segTiValSync "synchronized segment time" ULONG tsquant_l 1 100 0.00 214748364.750 FORMAT "%13.3" ARRAY_SIZE 2 ECU_ADDRESS 0x50000414 /end MEASUREMENT
/begin MEASUREMENT MisfDet_stAcCtlChng "State of air climate compressor changed" UBYTE B_TRUE 1 100 0.00 1.00000000000 BIT_MASK 0x1 FORMAT "%13.11" ECU_ADDRESS 0x700006FD /end MEASUREMENT
/begin MEASUREMENT MisfDet_stAgKnkCtrl "Condition maximum ignition-timing retardation is over threshold" UBYTE B_TRUE 1 100 0.00 1.00000000000 BIT_MASK 0x1 FORMAT "%13.11" ECU_ADDRESS 0x700001A4 /end MEASUREMENT
/begin MEASUREMENT MisfDet_stBlkAftDetn "Suppresion after detected misfire" UBYTE B_TRUE 1 100 0.00 1.00000000000 BIT_MASK 0x1 FORMAT "%13.11" ECU_ADDRESS 0x700006FC /end MEASUREMENT
/begin MEASUREMENT MisfDet_stBlkAftDetnTest "test phase after detected misfire" UBYTE B_TRUE 1 100 0.00 1.00000000000 BIT_MASK 0x1 FORMAT "%13.11" ECU_ADDRESS 0x700006FB /end MEASUREMENT
/begin MEASUREMENT MisfDet_stBlkDnAdpn "Inhibiting condition for temporary dN adaption" UBYTE B_TRUE 1 100 0.00 1.00000000000 BIT_MASK 0x1 FORMAT "%13.11" ECU_ADDRESS 0x700006FA /end MEASUREMENT
/begin MEASUREMENT MisfDet_stBlkDnAdpnNv "Inhibiting condition for storing dN adaption" UBYTE B_TRUE 1 100 0.00 1.00000000000 BIT_MASK 0x1 FORMAT "%13.11" ECU_ADDRESS 0x700006F9 /end MEASUREMENT
/begin MEASUREMENT MisfDet_stBlkDnAdpnNvCorrn "Inhibiting condition for usage of adapdted dN values" UBYTE B_TRUE 1 100 0.00 1.00000000000 BIT_MASK 0x1 FORMAT "%13.11" ECU_ADDRESS 0x700006F8 /end MEASUREMENT
/begin MEASUREMENT MisfDet_stBlkDnAdpnNvCorrnTyp "Inhibiting condition for usage of adapdted dN values no turn off delay, with and without delay (bit mask)" UBYTE OneToOne 1 100 0.00 255.0 FORMAT "%5.1" ECU_ADDRESS 0x60000722 /end MEASUREMENT
/begin MEASUREMENT MisfDet_stBlkDnAdpnNvTyp "Inhibiting condition for storing dN adaption, with and without delay (bit mask)" UBYTE OneToOne 1 100 0.00 255.0 FORMAT "%5.1" ECU_ADDRESS 0x60000723 /end MEASUREMENT
/begin MEASUREMENT MisfDet_stBlkDnAdpnPlaus "Inhibiting conditions for plausibilisation of temporary dN adaption" UBYTE B_TRUE 1 100 0.00 1.00000000000 BIT_MASK 0x1 FORMAT "%13.11" ECU_ADDRESS 0x700006F7 /end MEASUREMENT
/begin MEASUREMENT MisfDet_stBlkDnAdpnPlausTyp "Inhibiting conditions for plausibilisation of temporary dN adaption, with and without delay (bit mask)" UBYTE OneToOne 1 100 0.00 255.0 FORMAT "%5.1" ECU_ADDRESS 0x60000724 /end MEASUREMENT
/begin MEASUREMENT MisfDet_stBlkDnAdpnTyp "Inhibiting condition for temporary dN adaption, with and without delay (bit mask)" UBYTE OneToOne 1 100 0.00 255.0 FORMAT "%5.1" ECU_ADDRESS 0x60000725 /end MEASUREMENT
/begin MEASUREMENT MisfDet_stBlkDnFltd "Inhibiting condition for dN calculation" UBYTE B_TRUE 1 100 0.00 1.00000000000 BIT_MASK 0x1 FORMAT "%13.11" ECU_ADDRESS 0x700006F6 /end MEASUREMENT
/begin MEASUREMENT MisfDet_stBlkDnFltdTyp "Inhibiting condition for dN calculation, with and without delay (bit mask)" UBYTE OneToOne 1 100 0.00 255.0 FORMAT "%5.1" ECU_ADDRESS 0x60000726 /end MEASUREMENT
/begin MEASUREMENT MisfDet_stBlkSegTiAdpn "Inhibiting condition for segment time adaption, fuel on" UBYTE B_TRUE 1 100 0.00 1.00000000000 BIT_MASK 0x1 FORMAT "%13.11" ECU_ADDRESS 0x700006F5 /end MEASUREMENT
/begin MEASUREMENT MisfDet_stBlkSegTiAdpnFco "Inhibiting condition for segment time adaption, fuel off" UBYTE B_TRUE 1 100 0.00 1.00000000000 BIT_MASK 0x1 FORMAT "%13.11" ECU_ADDRESS 0x700006F4 /end MEASUREMENT
/begin MEASUREMENT MisfDet_stBlkSegTiAdpnFcoTyp "Inhibiting condition for segment time adaption during fuel cut off, with and without delay (bit mask)" UBYTE B_TRUE 1 100 0.00 1.00000000000 BIT_MASK 0x1 FORMAT "%13.11" ECU_ADDRESS 0x700001A3 /end MEASUREMENT
/begin MEASUREMENT MisfDet_stBlkSegTiAdpnTyp "Inhibiting condition for segment time adaption during fuel onInhibiting condition statistical function" UBYTE B_TRUE 1 100 0.00 1.00000000000 BIT_MASK 0x1 FORMAT "%13.11" ECU_ADDRESS 0x700001A2 /end MEASUREMENT
/begin MEASUREMENT MisfDet_stBlkStc "Inhibiting condition statistical function" UBYTE B_TRUE 1 100 0.00 1.00000000000 BIT_MASK 0x1 FORMAT "%13.11" ECU_ADDRESS 0x700006F3 /end MEASUREMENT
/begin MEASUREMENT MisfDet_stBlkStcTyp "Inhibiting condition statistical function, with and without delay (bit mask)" UBYTE OneToOne 1 100 0.00 255.0 FORMAT "%5.1" ECU_ADDRESS 0x60000727 /end MEASUREMENT
/begin MEASUREMENT MisfDet_stClthChng "clutch pedal pressed" UBYTE B_TRUE 1 100 0.00 1.00000000000 BIT_MASK 0x1 FORMAT "%13.11" ECU_ADDRESS 0x700006F2 /end MEASUREMENT
/begin MEASUREMENT MisfDet_stCntMisf "count misfire event" UBYTE B_TRUE 1 100 0.00 1.00000000000 BIT_MASK 0x1 FORMAT "%13.11" ECU_ADDRESS 0x700006F1 /end MEASUREMENT
/begin MEASUREMENT MisfDet_stDeltaAgIgnBas "Condition delta ignition angle to base ignition angle exceeds threshold" UBYTE B_TRUE 1 100 0.00 1.00000000000 BIT_MASK 0x1 FORMAT "%13.11" ECU_ADDRESS 0x700001A1 /end MEASUREMENT
/begin MEASUREMENT MisfDet_stDet "state misfire detected" UBYTE B_TRUE 1 100 0.00 1.00000000000 BIT_MASK 0x1 FORMAT "%13.11" ECU_ADDRESS 0x700006EE /end MEASUREMENT
/begin MEASUREMENT MisfDet_stDiagVWhlDeEnbl "State plausible check of wheel speed active" UBYTE B_TRUE 1 100 0.00 1.00000000000 BIT_MASK 0x1 FORMAT "%13.11" ECU_ADDRESS 0x70000199 /end MEASUREMENT
/begin MEASUREMENT MisfDet_stDiagVWhlStuck "Enable status of stuck diagnosis of wheel speeds" UBYTE B_TRUE 1 100 0.00 1.00000000000 BIT_MASK 0x1 FORMAT "%13.11" ECU_ADDRESS 0x70000198 /end MEASUREMENT
/begin MEASUREMENT MisfDet_stDlyDnAdpn "Delay condition after start for releasing statistical function" UBYTE B_TRUE 1 100 0.00 1.00000000000 BIT_MASK 0x1 FORMAT "%13.11" ECU_ADDRESS 0x7000019E /end MEASUREMENT
/begin MEASUREMENT MisfDet_stDlyStrtStc "Delay condition after start for releasing statistical function" UBYTE B_TRUE 1 100 0.00 1.00000000000 BIT_MASK 0x1 FORMAT "%13.11" ECU_ADDRESS 0x700001A0 /end MEASUREMENT
/begin MEASUREMENT MisfDet_stDlyTiStrt "state delay time after start is active" UBYTE B_TRUE 1 100 0.00 1.00000000000 BIT_MASK 0x1 FORMAT "%13.11" ECU_ADDRESS 0x700006ED /end MEASUREMENT
/begin MEASUREMENT MisfDet_stDnAdpnCalc "Adaptation currently calculated" UBYTE B_TRUE 1 100 0.00 1.00000000000 BIT_MASK 0x1 FORMAT "%13.11" ECU_ADDRESS 0x700001B5 /end MEASUREMENT
/begin MEASUREMENT MisfDet_stDnAdpnInit "Status initialisation of DnAdpnVal at discontinuation of MisfDet_stBlkDnAdpnNvCorrn" UBYTE B_TRUE 1 100 0.00 1.00000000000 BIT_MASK 0x1 FORMAT "%13.11" ECU_ADDRESS 0x700001B4 /end MEASUREMENT
/begin MEASUREMENT MisfDet_stDnAdpnNvCalc "NV adaptation currently calculated" UBYTE B_TRUE 1 100 0.00 1.00000000000 BIT_MASK 0x1 FORMAT "%13.11" ECU_ADDRESS 0x50005D92 /end MEASUREMENT
/begin MEASUREMENT MisfDet_stDnAdpnNvPlausAbsFail "absolute plaus check of NV adaptation values failed" UBYTE B_TRUE 1 100 0.00 1.00000000000 BIT_MASK 0x1 FORMAT "%13.11" ECU_ADDRESS 0x6000A7C1 /end MEASUREMENT
/begin MEASUREMENT MisfDet_stDnAdpnNvPlausSumFail "sum plaus check of NV adaptation values failed" UBYTE B_TRUE 1 100 0.00 1.00000000000 BIT_MASK 0x1 FORMAT "%13.11" ECU_ADDRESS 0x6000A7C0 /end MEASUREMENT
/begin MEASUREMENT MisfDet_stDnAdpnNvRdy "Displaying the adapted ranges" UBYTE OneToOne 1 100 0.00 255.0 FORMAT "%5.1" ARRAY_SIZE 3 ECU_ADDRESS 0x60036510 /end MEASUREMENT
/begin MEASUREMENT MisfDet_stDnAdpnNvRdyCurr "current range adapted" UBYTE B_TRUE 1 100 0.00 1.00000000000 BIT_MASK 0x1 FORMAT "%13.11" ECU_ADDRESS 0x50005D93 /end MEASUREMENT
/begin MEASUREMENT MisfDet_stDnAdpnNvUsd "non volatile adaptation values used" UBYTE B_TRUE 1 100 0.00 1.00000000000 BIT_MASK 0x1 FORMAT "%13.11" ECU_ADDRESS 0x700001B3 /end MEASUREMENT
/begin MEASUREMENT MisfDet_stDnAdpnPlausAbsFail "absolute plaus check of adaptation values failed" UBYTE B_TRUE 1 100 0.00 1.00000000000 BIT_MASK 0x1 FORMAT "%13.11" ECU_ADDRESS 0x6000A7BF /end MEASUREMENT
/begin MEASUREMENT MisfDet_stDnAdpnPlausMinFail "status DnAdpn Min-plaus check failed" UBYTE B_TRUE 1 100 0.00 1.00000000000 BIT_MASK 0x1 FORMAT "%13.11" ECU_ADDRESS 0x700001B2 /end MEASUREMENT
/begin MEASUREMENT MisfDet_stDnAdpnPlausRelCntrLim "maximum number of allowed failed relative plaus checks reached" UBYTE B_TRUE 1 100 0.00 1.00000000000 BIT_MASK 0x1 FORMAT "%13.11" ECU_ADDRESS 0x700001AB /end MEASUREMENT
/begin MEASUREMENT MisfDet_stDnAdpnPlausRelFail "relative plaus check of adaptation values failed" UBYTE B_TRUE 1 100 0.00 1.00000000000 BIT_MASK 0x1 FORMAT "%13.11" ECU_ADDRESS 0x6000A7BE /end MEASUREMENT
/begin MEASUREMENT MisfDet_stDnAdpnRngChng "Change of adaptation range" UBYTE B_TRUE 1 100 0.00 1.00000000000 BIT_MASK 0x1 FORMAT "%13.11" ECU_ADDRESS 0x700001B1 /end MEASUREMENT
/begin MEASUREMENT MisfDet_stDnAdpnRngLock "Current load is inside lock range" UBYTE B_TRUE 1 100 0.00 1.00000000000 BIT_MASK 0x1 FORMAT "%13.11" ECU_ADDRESS 0x700001B0 /end MEASUREMENT
/begin MEASUREMENT MisfDet_stDnAdpnRngOutd "current working point is outside adaptation range" UBYTE B_TRUE 1 100 0.00 1.00000000000 BIT_MASK 0x1 FORMAT "%13.11" ECU_ADDRESS 0x700001AF /end MEASUREMENT
/begin MEASUREMENT MisfDet_stDnAdpnRngOutdNEng "current engine speed outside adaptation range" UBYTE B_TRUE 1 100 0.00 1.00000000000 BIT_MASK 0x1 FORMAT "%13.11" ECU_ADDRESS 0x700001AE /end MEASUREMENT
/begin MEASUREMENT MisfDet_stDnAdpnRngOutdTq "current load outside adaptation range" UBYTE B_TRUE 1 100 0.00 1.00000000000 BIT_MASK 0x1 FORMAT "%13.11" ECU_ADDRESS 0x700001AA /end MEASUREMENT
/begin MEASUREMENT MisfDet_stDnAdpnRngTq "minimum load limit exceeded for coninuous dn adaptation" UBYTE B_TRUE 1 100 0.00 1.00000000000 BIT_MASK 0x1 FORMAT "%13.11" ECU_ADDRESS 0x700001AD /end MEASUREMENT
/begin MEASUREMENT MisfDet_stDnAdpnRstCfm "confirmatino of reset DnAdpn" UBYTE B_TRUE 1 100 0.00 1.00000000000 BIT_MASK 0x1 FORMAT "%13.11" ECU_ADDRESS 0x6000A7BD /end MEASUREMENT
/begin MEASUREMENT MisfDet_stDnAdpnRstReq "Reset request Dn-adaptation" UBYTE B_TRUE 1 100 0.00 1.00000000000 BIT_MASK 0x1 FORMAT "%13.11" ECU_ADDRESS 0x6000A7BC /end MEASUREMENT
/begin MEASUREMENT MisfDet_stDnAdpnUsd "adaptation values of continuous adaptation used" UBYTE B_TRUE 1 100 0.00 1.00000000000 BIT_MASK 0x1 FORMAT "%13.11" ECU_ADDRESS 0x700001AC /end MEASUREMENT
/begin MEASUREMENT MisfDet_stDnCycMaxAdpn "status of average engine running roughness of one working cycle exceeded its threshold" UBYTE B_TRUE 1 100 0.00 1.00000000000 BIT_MASK 0x1 FORMAT "%13.11" ECU_ADDRESS 0x700006EC /end MEASUREMENT
/begin MEASUREMENT MisfDet_stDnDet "state misfiring thresholds exceeded" UBYTE OneToOne 1 100 0.00 255.0 FORMAT "%5.1" ECU_ADDRESS 0x500008A7 /end MEASUREMENT
/begin MEASUREMENT MisfDet_stDnDifSelActv "Usage of MisfDet_dnDifNxt or MisfDet_dnDifMin as filter input possible" UBYTE B_TRUE 1 100 0.00 1.00000000000 BIT_MASK 0x1 FORMAT "%13.11" ECU_ADDRESS 0x50005D94 /end MEASUREMENT
/begin MEASUREMENT MisfDet_stDnDifSelActvCurr "MisfDet_dnDifNxt or MisfDet_dnDifMin is used as filter input for current sample" UBYTE B_TRUE 1 100 0.00 1.00000000000 BIT_MASK 0x1 FORMAT "%13.11" ECU_ADDRESS 0x6000A7BA /end MEASUREMENT
/begin MEASUREMENT MisfDet_stDnFltdZeroNoSegTiAdpn "state reset correction of dn threshold" UBYTE B_TRUE 1 100 0.00 1.00000000000 BIT_MASK 0x1 FORMAT "%13.11" ECU_ADDRESS 0x7000019F /end MEASUREMENT
/begin MEASUREMENT MisfDet_stDPedlPosnOutOfRng "Status gradient of the accelerator pedal position is out of the allowed range" UBYTE B_TRUE 1 100 0.00 1.00000000000 BIT_MASK 0x1 FORMAT "%13.11" ECU_ADDRESS 0x700006F0 /end MEASUREMENT
/begin MEASUREMENT MisfDet_stDTqOutOfRng "state torque gradient out of range" UBYTE B_TRUE 1 100 0.00 1.00000000000 BIT_MASK 0x1 FORMAT "%13.11" ECU_ADDRESS 0x700006EF /end MEASUREMENT
/begin MEASUREMENT MisfDet_stDynCmpOptmzd "Status optimized dynamic compensation" UBYTE B_TRUE 1 100 0.00 1.00000000000 BIT_MASK 0x1 FORMAT "%13.11" ECU_ADDRESS 0x700001A9 /end MEASUREMENT
/begin MEASUREMENT MisfDet_stEngStrt "state engine is in starting condition" UBYTE B_TRUE 1 100 0.00 1.00000000000 BIT_MASK 0x1 FORMAT "%13.11" ECU_ADDRESS 0x700006EA /end MEASUREMENT
/begin MEASUREMENT MisfDet_stExtClrReq "external request to reset the segment time adaption values" UBYTE B_TRUE 1 100 0.00 1.00000000000 BIT_MASK 0x1 FORMAT "%13.11" ECU_ADDRESS 0x70000196 /end MEASUREMENT
/begin MEASUREMENT MisfDet_stFlreDwn "state engine is in flare down condition" UBYTE B_TRUE 1 100 0.00 1.00000000000 BIT_MASK 0x1 FORMAT "%13.11" ECU_ADDRESS 0x700006E9 /end MEASUREMENT
/begin MEASUREMENT MisfDet_stGripChngPt "state grip conditions at clutch has changed" UBYTE B_TRUE 1 100 0.00 1.00000000000 BIT_MASK 0x1 FORMAT "%13.11" ECU_ADDRESS 0x700006E8 /end MEASUREMENT
/begin MEASUREMENT MisfDet_stIdleChng "engine enters or exits idle state" UBYTE B_TRUE 1 100 0.00 1.00000000000 BIT_MASK 0x1 FORMAT "%13.11" ECU_ADDRESS 0x700006E7 /end MEASUREMENT
/begin MEASUREMENT MisfDet_stLineEnd "Status indicting detection of line-end" UBYTE B_TRUE 1 100 0.00 1.00000000000 BIT_MASK 0x1 FORMAT "%13.11" ECU_ADDRESS 0x7000019D /end MEASUREMENT
/begin MEASUREMENT MisfDet_stMisfCont "Status continuous misfires" UBYTE B_TRUE 1 100 0.00 1.00000000000 BIT_MASK 0x1 FORMAT "%13.11" ECU_ADDRESS 0x700006E6 /end MEASUREMENT
/begin MEASUREMENT MisfDet_stMisfGenrEna "state of enabling misfire generator" UBYTE B_TRUE 1 100 0.00 1.00000000000 BIT_MASK 0x1 FORMAT "%13.11" ECU_ADDRESS 0x700001A8 /end MEASUREMENT
/begin MEASUREMENT MisfDet_stMisfGenrEnaTrg "state of enabling trigger of misfire generator" UBYTE B_TRUE 1 100 0.00 1.00000000000 BIT_MASK 0x1 FORMAT "%13.11" ECU_ADDRESS 0x700001A7 /end MEASUREMENT
/begin MEASUREMENT MisfDet_stMisfGenrRun "state misfire generator running" UBYTE B_TRUE 1 100 0.00 1.00000000000 BIT_MASK 0x1 FORMAT "%13.11" ECU_ADDRESS 0x700006E5 /end MEASUREMENT
/begin MEASUREMENT MisfDet_stMisfGenrRunIgn "misfire generator running via ignition cut off" UBYTE B_TRUE 1 100 0.00 1.00000000000 BIT_MASK 0x1 FORMAT "%13.11" ECU_ADDRESS 0x700006E4 /end MEASUREMENT
/begin MEASUREMENT MisfDet_stMisfModActv "state misfire mode in progress" UBYTE B_TRUE 1 100 0.00 1.00000000000 BIT_MASK 0x1 FORMAT "%13.11" ECU_ADDRESS 0x700001A6 /end MEASUREMENT
/begin MEASUREMENT MisfDet_stMisfSti "cond. for misfire demanded, stimuli signal from software misfiring generator" UBYTE B_TRUE 1 100 0.00 1.00000000000 BIT_MASK 0x1 FORMAT "%13.11" ECU_ADDRESS 0x50005D99 /end MEASUREMENT
/begin MEASUREMENT MisfDet_stNEngOutOfRng "state engine speed out of limits for misfire detection" UBYTE B_TRUE 1 100 0.00 1.00000000000 BIT_MASK 0x1 FORMAT "%13.11" ECU_ADDRESS 0x700006E3 /end MEASUREMENT
/begin MEASUREMENT MisfDet_stNmax "condition engine speed limitation is active" UBYTE B_TRUE 1 100 0.00 1.00000000000 BIT_MASK 0x1 FORMAT "%13.11" ECU_ADDRESS 0x700006E2 /end MEASUREMENT
/begin MEASUREMENT MisfDet_stSecCamsftAftStrt "state 2nd working cycle after start passed" UBYTE B_TRUE 1 100 0.00 1.00000000000 BIT_MASK 0x1 FORMAT "%13.11" ECU_ADDRESS 0x700001A5 /end MEASUREMENT
/begin MEASUREMENT MisfDet_stSegPosnAltv "status alternative segment position" UBYTE B_TRUE 1 100 0.00 1.00000000000 BIT_MASK 0x2 FORMAT "%13.11" ECU_ADDRESS 0x60006396 /end MEASUREMENT
/begin MEASUREMENT MisfDet_stSegPosnIaLte "state of identifying the late ignition angle" UBYTE B_TRUE 1 100 0.00 1.00000000000 BIT_MASK 0x1 FORMAT "%13.11" ECU_ADDRESS 0x6000A7AC /end MEASUREMENT
/begin MEASUREMENT MisfDet_stSegPosnOffsIdle "Status segment shift at low idle" UBYTE B_TRUE 1 100 0.00 1.00000000000 BIT_MASK 0x1 FORMAT "%13.11" ECU_ADDRESS 0x6000A7AB /end MEASUREMENT
/begin MEASUREMENT MisfDet_stSegPosnOffsTqLo "Status torque condition met for segment shift at low idle" UBYTE B_TRUE 1 100 0.00 1.00000000000 BIT_MASK 0x1 FORMAT "%13.11" ECU_ADDRESS 0x6000A7AA /end MEASUREMENT
/begin MEASUREMENT MisfDet_stSegShift "status alternative segment used" UBYTE B_TRUE 1 100 0.00 1.00000000000 BIT_MASK 0x1 FORMAT "%13.11" ECU_ADDRESS 0x6000A7A9 /end MEASUREMENT
/begin MEASUREMENT MisfDet_stSegShiftCatHeat "condition segment position shifted in case of cat heating measures" UBYTE B_TRUE 1 100 0.00 1.00000000000 BIT_MASK 0x1 FORMAT "%13.11" ECU_ADDRESS 0x70000192 /end MEASUREMENT
/begin MEASUREMENT MisfDet_stSegShiftRedStg "condition segment position shifted in case of reduction stage" UBYTE B_TRUE 1 100 0.00 1.00000000000 BIT_MASK 0x1 FORMAT "%13.11" ECU_ADDRESS 0x70000191 /end MEASUREMENT
/begin MEASUREMENT MisfDet_stSegTiAdpn "Status segment time adaptation" UBYTE B_TRUE 1 100 0.00 1.00000000000 BIT_MASK 0x1 FORMAT "%13.11" ECU_ADDRESS 0x6000A7A8 /end MEASUREMENT
/begin MEASUREMENT MisfDet_stSegTiAdpnActv "segment time adaptation active" UBYTE B_TRUE 1 100 0.00 1.00000000000 BIT_MASK 0x1 FORMAT "%13.11" ECU_ADDRESS 0x50005D9E /end MEASUREMENT
/begin MEASUREMENT MisfDet_stSegTiAdpnCfgEnaTypVal "code word to enable the segment time adaptation at fuel cut off or at positive torque" UBYTE OneToOne 1 100 0.00 255.0 FORMAT "%5.1" ECU_ADDRESS 0x500008A9 /end MEASUREMENT
/begin MEASUREMENT MisfDet_stSegTiAdpnEna "condition segment time adaptation is enabled" UBYTE B_TRUE 1 100 0.00 1.00000000000 BIT_MASK 0x1 FORMAT "%13.11" ECU_ADDRESS 0x50005DA0 /end MEASUREMENT
/begin MEASUREMENT MisfDet_stSegTiAdpnEnaEol "condition quick adaptation mode for MisfDet_SegTiAdpn at end of line enabled" UBYTE B_TRUE 1 100 0.00 1.00000000000 BIT_MASK 0x1 FORMAT "%13.11" ECU_ADDRESS 0x50005DA1 /end MEASUREMENT
/begin MEASUREMENT MisfDet_stSegTiAdpnEolReq "adaptation in end of line mode requested" UBYTE B_TRUE 1 100 0.00 1.00000000000 BIT_MASK 0x1 FORMAT "%13.11" ECU_ADDRESS 0x6000A7A7 /end MEASUREMENT
/begin MEASUREMENT MisfDet_stSegTiAdpnFcoOnly "Inhibiting adaptation at positive torque after completed learning at fuel cut offf" UBYTE B_TRUE 1 100 0.00 1.00000000000 BIT_MASK 0x1 FORMAT "%13.11" ECU_ADDRESS 0x70000195 /end MEASUREMENT
/begin MEASUREMENT MisfDet_stSegTiAdpnLrntSegPosnCyc "Segment individual bit mask for learnt segment time adaptation" UBYTE OneToOne 1 100 0.00 255.0 FORMAT "%5.1" ECU_ADDRESS 0x600363FD /end MEASUREMENT
/begin MEASUREMENT MisfDet_stSegTiAdpnRdy "cond. Segment time adaptation in actual speed range ready" UBYTE B_TRUE 1 100 0.00 1.00000000000 BIT_MASK 0x1 FORMAT "%13.11" ECU_ADDRESS 0x50005DA3 /end MEASUREMENT
/begin MEASUREMENT MisfDet_stSegTiAdpnRdyPosn "Bit mask adaptation of the segment positions completed" UBYTE OneToOne 1 100 0.00 255.0 FORMAT "%5.1" ECU_ADDRESS 0x500008AB /end MEASUREMENT
/begin MEASUREMENT MisfDet_stSegTiAdpnRng "condition operating range in 1st speed range" UBYTE B_TRUE 1 100 0.00 1.00000000000 BIT_MASK 0x1 FORMAT "%13.11" ECU_ADDRESS 0x6000A7A6 /end MEASUREMENT
/begin MEASUREMENT MisfDet_stSegTiAdpnRst "reset of segment time adaptation" UBYTE OneToOne 1 100 0.00 255.0 FORMAT "%5.1" ECU_ADDRESS 0x6000079D /end MEASUREMENT
/begin MEASUREMENT MisfDet_stSegTiAdpnRstCfm "Reset confirmation of segment time adaptation" UBYTE B_TRUE 1 100 0.00 1.00000000000 BIT_MASK 0x1 FORMAT "%13.11" ECU_ADDRESS 0x6000A7A5 /end MEASUREMENT
/begin MEASUREMENT MisfDet_stSegTiAdpnSampleCalc "condition segment time adaptation is running" UBYTE B_TRUE 1 100 0.00 1.00000000000 BIT_MASK 0x1 FORMAT "%13.11" ECU_ADDRESS 0x70000194 /end MEASUREMENT
/begin MEASUREMENT MisfDet_stSegTiAdpnSampleRdy "condition new segment deviation sample actually taken" UBYTE B_TRUE 1 100 0.00 1.00000000000 BIT_MASK 0x1 FORMAT "%13.11" ECU_ADDRESS 0x6000A7A3 /end MEASUREMENT
/begin MEASUREMENT MisfDet_stSegTiAdpnSimuLrn "simultaneous learning of both segments" UBYTE B_TRUE 1 100 0.00 1.00000000000 BIT_MASK 0x1 FORMAT "%13.11" ECU_ADDRESS 0x50005DA5 /end MEASUREMENT
/begin MEASUREMENT MisfDet_stSegTiAdpnSync "status of segment time adaptation synchronised" UBYTE B_TRUE 1 100 0.00 1.00000000000 BIT_MASK 0x1 FORMAT "%13.11" ECU_ADDRESS 0x50005DA6 /end MEASUREMENT
/begin MEASUREMENT MisfDet_stSegTiAdpnTypeRdy "status of different learning strategies" UBYTE OneToOne 1 100 0.00 255.0 FORMAT "%5.1" ECU_ADDRESS 0x50005DA7 /end MEASUREMENT
/begin MEASUREMENT MisfDet_stSegTiAdpnValMax "threshold for segment time correction factor is exceeded" UBYTE B_TRUE 1 100 0.00 1.00000000000 BIT_MASK 0x1 FORMAT "%13.11" ECU_ADDRESS 0x70000193 /end MEASUREMENT
/begin MEASUREMENT MisfDet_stSegTiAdpnValSampleDiagAltvPosn "Fault Status of Sample-plausibility check diagnosis for the alternative segment position" UBYTE B_TRUE 1 100 0.00 1.00000000000 BIT_MASK 0x1 FORMAT "%13.11" ECU_ADDRESS 0x600363ED /end MEASUREMENT
/begin MEASUREMENT MisfDet_stSegTiAdpnValSampleDiagStdPosn "Fault Status of Sample-plausibility check diagnosis for the standard segment position" UBYTE B_TRUE 1 100 0.00 1.00000000000 BIT_MASK 0x1 FORMAT "%13.11" ECU_ADDRESS 0x600363EC /end MEASUREMENT
/begin MEASUREMENT MisfDet_stSegTiVld "condition segment time plausible" UBYTE B_TRUE 1 100 0.00 1.00000000000 BIT_MASK 0x1 FORMAT "%13.11" ECU_ADDRESS 0x50005DA9 /end MEASUREMENT
/begin MEASUREMENT MisfDet_stSetZeroTq "state zero torque threshold is set to zero" UBYTE B_TRUE 1 100 0.00 1.00000000000 BIT_MASK 0x1 FORMAT "%13.11" ECU_ADDRESS 0x700006E1 /end MEASUREMENT
/begin MEASUREMENT MisfDet_stStrtDeb "state engine is in starting conditions, debounced" UBYTE B_TRUE 1 100 0.00 1.00000000000 BIT_MASK 0x1 FORMAT "%13.11" ECU_ADDRESS 0x700006E0 /end MEASUREMENT
/begin MEASUREMENT MisfDet_stTEngLow "state engine temperature low" UBYTE B_TRUE 1 100 0.00 1.00000000000 BIT_MASK 0x1 FORMAT "%13.11" ECU_ADDRESS 0x700006DF /end MEASUREMENT
/begin MEASUREMENT MisfDet_stTEngLowDnAdpn "state engine temperature low for dN Adaption" UBYTE B_TRUE 1 100 0.00 1.00000000000 BIT_MASK 0x1 FORMAT "%13.11" ECU_ADDRESS 0x700006DE /end MEASUREMENT
/begin MEASUREMENT MisfDet_stTqZero "state engine torque is under threshold for zero torque at crankshaft" UBYTE B_TRUE 1 100 0.00 1.00000000000 BIT_MASK 0x1 FORMAT "%13.11" ECU_ADDRESS 0x700006DD /end MEASUREMENT
/begin MEASUREMENT MisfDet_stTrsmTiLow "state active time of transmission is under threshold" UBYTE B_TRUE 1 100 0.00 1.00000000000 BIT_MASK 0x1 FORMAT "%13.11" ECU_ADDRESS 0x700006DC /end MEASUREMENT
/begin MEASUREMENT MisfDet_thdTqZero "threshold for zero torque output at crankshaft" UWORD rel_uw_b100 1 100 0.00 99.99847 FORMAT "%8.5" ECU_ADDRESS 0x6000055C /end MEASUREMENT
/begin MEASUREMENT MisfDet_thdTqZeroRaw "threshold for uncorrected zero torque output at crankshaft" UWORD rel_uw_b100 1 100 0.00 99.99847 FORMAT "%8.5" ECU_ADDRESS 0x60000464 /end MEASUREMENT
/begin MEASUREMENT MisfDet_tiEngOff "Engine off time for drivetrain temperature model for Misfire detection" UWORD Time_sec_q1_COMPU 1 100 0.00 65535.00 FORMAT "%8.2" ECU_ADDRESS 0x600036C8 /end MEASUREMENT
/begin MEASUREMENT MisfDet_tiTrsmAct "time in which transmission was active" SLONG Time_Dt 1 100 0.00 2147.48364700 FORMAT "%13.8" ECU_ADDRESS 0x500005C0 /end MEASUREMENT
/begin MEASUREMENT MisfDet_tiTrsmCorr "Correction value for initialisation of the drivetrain temperature model" UWORD Time_sec_q1_COMPU 1 100 0.00 65535.00 FORMAT "%8.2" ECU_ADDRESS 0x700018A0 /end MEASUREMENT
/begin MEASUREMENT MisfDet_tqZeroCorrnAlti "correction value for threshold of zero torque output at crankshaft, altitude dependant" SWORD rel_uw_b100 1 100 -50.00000 49.99847 FORMAT "%8.5" ECU_ADDRESS 0x60000570 /end MEASUREMENT
/begin MEASUREMENT MisfDet_tqZeroCorrnTEng "correction value for threshold of zero torque output at crankshaft, engine temperature dependant" UWORD rel_uw_b100 1 100 0.00 99.99847 FORMAT "%8.5" ECU_ADDRESS 0x60000574 /end MEASUREMENT
/begin MEASUREMENT MisfDet_vWhl "Wheel speed for rough road detection" UWORD vfzg_uw_b90_m_DIV_s 1 100 0.00 90.27662 FORMAT "%8.5" ARRAY_SIZE 4 ECU_ADDRESS 0x50005470 /end MEASUREMENT
/begin MEASUREMENT MisfDet_vWhlCor "wheel speed corrected to reference point" UWORD vfzg_uw_b90_m_DIV_s 1 100 0.00 90.27662 FORMAT "%8.5" ARRAY_SIZE 4 ECU_ADDRESS 0x50005478 /end MEASUREMENT
/begin MEASUREMENT MisfDet_vWhlDe "Relative deviation of the wheel speed" SWORD r_prc_q0p003052_COMPU 1 100 -100.0000 99.9969 FORMAT "%8.4" ECU_ADDRESS 0x600036B6 /end MEASUREMENT
/begin MEASUREMENT MisfDet_vWhlFild "Filtered wheel speed" UWORD vfzg_uw_b90_m_DIV_s 1 100 0.00 90.27662 FORMAT "%8.5" ARRAY_SIZE 4 ECU_ADDRESS 0x50005480 /end MEASUREMENT
/begin MEASUREMENT MisfDet_vWhlUsd "Wheel speeds used for rough road detection" UBYTE OneToOne 1 100 0.00 255.0 FORMAT "%5.1" ECU_ADDRESS 0x60006392 /end MEASUREMENT
/begin MEASUREMENT MisfDet_vWhlVld "Gültige Radgeschwindigkeiten" UBYTE OneToOne 1 100 0.00 255.0 FORMAT "%5.1" ECU_ADDRESS 0x60006391 /end MEASUREMENT
/begin MEASUREMENT MisfDet_yawRate "Yaw rate" FLOAT32_IEEE yaw_rate_real 1 100 -1.00000000E+037 1.00000000E+037 FORMAT "%13.3" ARRAY_SIZE 4 ECU_ADDRESS 0x50001758 /end MEASUREMENT
/begin MEASUREMENT MisfDet_yawRateAvrg "Average yaw rate" FLOAT32_IEEE yaw_rate_real 1 100 -1.00000000E+037 1.00000000E+037 FORMAT "%13.3" ECU_ADDRESS 0x50001768 /end MEASUREMENT
/begin MEASUREMENT MisfDet_yawRateDe "Relative deviation of yaw rates" UWORD r_prc_q0p003052_COMPU 1 100 0.00 199.9969 FORMAT "%8.4" ECU_ADDRESS 0x600036B4 /end MEASUREMENT
/begin FUNCTION MisfDet_DnAdpn "1.34.0    Adaptation of engine speed deceleration of misfire detection"
 /begin DEF_CHARACTERISTIC MisfDet_dnAdpnFilFac_C MisfDet_dnAdpnFrzNEngDifMax_C MisfDet_dnAdpnFrzTqDifMax_C MisfDet_dnAdpnNrSampRdy_T MisfDet_dnAdpnNvDstBasPntFac_C MisfDet_dnAdpnNvDstMax_C MisfDet_dnAdpnNvDstMin_C MisfDet_dnAdpnNvFilFacMin_C MisfDet_dnAdpnNvNrSampleMin_C MisfDet_dnAdpnNvPlausSumThd_C MisfDet_dnAdpnPlausAbsThdDecMax_T MisfDet_dnAdpnPlausAbsThdOffsCatHeat_C MisfDet_dnAdpnPlausAbsThdTrsmTiLow_M MisfDet_dnAdpnPlausAbsThd_M MisfDet_dnAdpnPlausMinThdFacCatHeat_C MisfDet_dnAdpnPlausMinThdFacTrsmTiLow_C MisfDet_dnAdpnPlausMinThdFac_C MisfDet_dnAdpnPlausRelCntrLim_C MisfDet_dnAdpnPlausRelThdFacAltvPosn_C MisfDet_dnAdpnPlausRelThdFacIdle_T MisfDet_dnAdpnPlausRelThdFacTrsmTiLow_M MisfDet_dnAdpnPlausRelThdFac_M MisfDet_dnAdpnRngChngActvnDly_C MisfDet_dnAdpnRngNEng.Cmn_CA MisfDet_dnAdpnRngTqInr_CA MisfDet_dnAdpnRngTqLock_CA MisfDet_dnAdpnRngTqMax_T MisfDet_dnAdpnRngTqMin.Cmn_GT MisfDet_dnAdpnRngTqMinIdle.Cmn_GT MisfDet_dnAdpnTqMinIdle_AX MisfDet_dnAdpnTqMinStrtNrIgn_C MisfDet_dnAdpnTqMinStrt_C MisfDet_dnAdpnTqMin_AX MisfDet_dnAdpnValNvNZero_C MisfDet_maskDnAdpnInitCmbTyp_C MisfDet_maskDnAdpnInit_C MisfDet_stDnAdpnCfgCal_C MisfDet_stDnAdpnCfg_C MisfDet_stDnAdpnPlausCfg_C /end DEF_CHARACTERISTIC
 /begin IN_MEASUREMENT Epm_nEng MisfDet_cylCntr MisfDet_dnCyl MisfDet_dnRawCyl MisfDet_dnThd MisfDet_dnThdOffsT MisfDet_maskDnAdpnNvCorrnCmbd MisfDet_maskDnAdpnNvCorrnCmbdCmbTyp MisfDet_maskDnVld MisfDet_nEngSync MisfDet_segPosnDn MisfDet_stBlkDnAdpn MisfDet_stBlkDnAdpnNv MisfDet_stBlkDnAdpnNvCorrn MisfDet_stBlkDnAdpnPlaus MisfDet_stCatHeat MisfDet_stDnAdpnRstReq MisfDet_stDnAdpnRstReqAvs MisfDet_stFcmClr20ms MisfDet_stIdle MisfDet_stMisfCont MisfDet_stOpenPt MisfDet_stReIni MisfDet_stSegShift MisfDet_stSegTiAdpn MisfDet_stSetZeroTq MisfDet_stTrsmTiLow MisfDet_tqBascSync MisfDet_tqZeroCorrnAlti MisfDet_tqZeroCorrnTEng /end IN_MEASUREMENT
 /begin OUT_MEASUREMENT MisfDet_dnAdpnNvQlyFac MisfDet_dnAdpnNvStruct.nrSample MisfDet_dnAdpnNvStruct.nEng MisfDet_dnAdpnNvStruct.tq MisfDet_dnAdpnNvStruct.val MisfDet_dnAdpnPlausAbsCntr MisfDet_dnAdpnPlausRelCntr MisfDet_dnAdpnQlyFac MisfDet_dnAdpnVal MisfDet_dnAdpnValCurr MisfDet_dnAdpnValNv MisfDet_dnAdpnValNvFac MisfDet_stDnAdpnNvCalc MisfDet_stDnAdpnNvPlausAbsFail MisfDet_stDnAdpnNvPlausSumFail MisfDet_stDnAdpnNvRdy MisfDet_stDnAdpnNvRdyCurr MisfDet_stDnAdpnPlausAbsFail MisfDet_stDnAdpnPlausRelCntrLim MisfDet_stDnAdpnPlausRelFail MisfDet_stDnAdpnRngOutdTq MisfDet_stDnAdpnRstCfm /end OUT_MEASUREMENT
 /begin LOC_MEASUREMENT MisfDet_dnAdpnFilFac MisfDet_dnAdpnFrzNEng MisfDet_dnAdpnFrzTq MisfDet_dnAdpnNEngRel MisfDet_dnAdpnNvCoeff MisfDet_dnAdpnNvDst MisfDet_dnAdpnNvDstSng MisfDet_dnAdpnNvFilFac MisfDet_dnAdpnNvIdx MisfDet_dnAdpnNvIdxCmbn MisfDet_dnAdpnNvInterpnTyp MisfDet_dnAdpnNvNEngSum MisfDet_dnAdpnNvNrSampleCurr MisfDet_dnAdpnNvObsvrIdx MisfDet_dnAdpnNvObsvrIdxNEng MisfDet_dnAdpnNvObsvrIdxTq MisfDet_dnAdpnNvObsvrNEng MisfDet_dnAdpnNvObsvrNrSample MisfDet_dnAdpnNvObsvrTq MisfDet_dnAdpnNvObsvrVal MisfDet_dnAdpnNvPlausAbsCntr MisfDet_dnAdpnNvPlausAbsCyl MisfDet_dnAdpnNvPlausAbsValMax MisfDet_dnAdpnNvPlausSumCntr MisfDet_dnAdpnNvPlausSumIdx MisfDet_dnAdpnNvSum MisfDet_dnAdpnNvTqSum MisfDet_dnAdpnNvValSum MisfDet_dnAdpnPlausAbsCyl MisfDet_dnAdpnPlausAbsThd MisfDet_dnAdpnPlausAbsValMax MisfDet_dnAdpnPlausMinCntr MisfDet_dnAdpnPlausMinCntrMax MisfDet_dnAdpnPlausMinRat MisfDet_dnAdpnPlausMinRatMax MisfDet_dnAdpnPlausMinSum MisfDet_dnAdpnPlausMinSumDif MisfDet_dnAdpnPlausMinSumNv MisfDet_dnAdpnPlausMinThdFac MisfDet_dnAdpnPlausRelCntrMax MisfDet_dnAdpnPlausRelCyl MisfDet_dnAdpnPlausRelRat MisfDet_dnAdpnPlausRelRatMax MisfDet_dnAdpnPlausRelRatMaxIdx MisfDet_dnAdpnPlausRelThd MisfDet_dnAdpnPlausRelValMax MisfDet_dnAdpnQlyFacAry MisfDet_dnAdpnRngChngActvnDly MisfDet_dnAdpnRngTq MisfDet_dnAdpnStrtCntr MisfDet_dnAdpnTqMin MisfDet_dnAdpnTqRel MisfDet_dnAdpnValAltv MisfDet_dnAdpnValStd MisfDet_stDnAdpnCalc MisfDet_stDnAdpnInit MisfDet_stDnAdpnNvUsd MisfDet_stDnAdpnPlausMinFail MisfDet_stDnAdpnRngChng MisfDet_stDnAdpnRngLock MisfDet_stDnAdpnRngOutd MisfDet_stDnAdpnRngOutdNEng MisfDet_stDnAdpnRngTq MisfDet_stDnAdpnUsd /end LOC_MEASUREMENT
 FUNCTION_VERSION "1.34.0" /end FUNCTION
/begin FUNCTION MisfDet_DnCalcn "1.19.0    Calculation of engine speed deceleration of misfire detection"
 /begin DEF_CHARACTERISTIC MisfDet_dnDifSelNMax_C MisfDet_dnFilFacMax_C MisfDet_dnFilFacMin_C MisfDet_dnFilFacRat_C MisfDet_dnFilFacSlow_C MisfDet_dnFltdAmplThdFacIdle_C MisfDet_dnFltdAmplThdFac_C MisfDet_dnQnts_C MisfDet_stDnCalcnCfg_C /end DEF_CHARACTERISTIC
 /begin IN_MEASUREMENT Epm_nEng MisfDet_cylCntrSegTi MisfDet_dnAdpnQlyFac MisfDet_dnAdpnVal MisfDet_dnThd MisfDet_maskSegPosnDnCalc MisfDet_maskSegTiVld MisfDet_nEngSync MisfDet_nrMisfConsc MisfDet_segPosnSegTi MisfDet_segTi MisfDet_segTiAry MisfDet_segTiDly MisfDet_stBlkDnFltd MisfDet_stCatHeat MisfDet_stIdle MisfDet_stMisfCont MisfDet_stNoInjSync MisfDet_stOpenPt MisfDet_stSegTiAdpn MisfDet_stSegTiAdpnRdy MisfDet_stStrtDeb /end IN_MEASUREMENT
 /begin OUT_MEASUREMENT MisfDet_cylCntr MisfDet_dn MisfDet_dnCyc MisfDet_dnCyl MisfDet_dnDif MisfDet_dnDifMin MisfDet_dnDifNxt MisfDet_dnDly MisfDet_dnFilFac MisfDet_dnFltd MisfDet_dnFltdCyl MisfDet_dnQnts MisfDet_dnRaw MisfDet_dnRawAry MisfDet_dnRawCyl MisfDet_maskDnVld MisfDet_segPosnDn MisfDet_stDnDifSelActv MisfDet_stDnDifSelActvCurr /end OUT_MEASUREMENT
 /begin LOC_MEASUREMENT MisfDet_stDynCmpOptmzd MisfDet_stSegPosnAltv /end LOC_MEASUREMENT
 FUNCTION_VERSION "1.19.0" /end FUNCTION
/begin FUNCTION MisfDet_DnEvln "1.11.0    Misfire detection, Evaluation of engine speed acceleration"
 /begin DEF_CHARACTERISTIC MisfDet_nrCmbDiCatHeat_C MisfDet_nrCmbDi_M MisfDet_nrCmbTest_C MisfDet_stDnEvlnCfg_C /end DEF_CHARACTERISTIC
 /begin IN_MEASUREMENT MisfDet_cylCntr MisfDet_dn MisfDet_dnDif MisfDet_dnFltd MisfDet_dnThd MisfDet_dnThdCont MisfDet_dnThdDif MisfDet_nEngSync MisfDet_stBlkStc MisfDet_stCatHeat MisfDet_stReIni MisfDet_stSegShift MisfDet_stStrtDeb MisfDet_tqBascSync SyC_stSub /end IN_MEASUREMENT
 /begin OUT_MEASUREMENT MisfDet_maskDnDet MisfDet_nrCmbDi MisfDet_stBlkAftDetn MisfDet_stBlkAftDetnTest MisfDet_stDet MisfDet_stDnDet /end OUT_MEASUREMENT
 FUNCTION_VERSION "1.11.0" /end FUNCTION
/begin FUNCTION MisfDet_GlbDef "100.27.0  MisfDet Global Definitions inside package" FUNCTION_VERSION "100.27.0" /end FUNCTION
/begin FUNCTION MisfDet_Lib "1.6.0     Function library of misfire detection" /begin IN_MEASUREMENT MisfDet_cylCntr /end IN_MEASUREMENT FUNCTION_VERSION "1.6.0" /end FUNCTION
/begin FUNCTION MisfDet_MisfGenr "1.10.0    Misfire detection, Misfire generator"
 /begin DEF_CHARACTERISTIC MisfDet_addrTrgVal_C MisfDet_ignRndMax_C MisfDet_maskCfgTrg_C MisfDet_maskMisfGenrCfg_C MisfDet_strtMisfGenr_C MisfDet_tblMisfPat_FM MisfDet_thdTrgVal_C /end DEF_CHARACTERISTIC
 /begin IN_MEASUREMENT Epm_ctCyl MisfDet_stBlkStc MisfDet_stCatDmg MisfDet_stReIni /end IN_MEASUREMENT
 /begin OUT_MEASUREMENT MisfDet_maskMisfSti MisfDet_maskMisfStiIgn MisfDet_maskMisfStiInj MisfDet_stMisfGenrRun MisfDet_stMisfGenrRunIgn MisfDet_stMisfSti /end OUT_MEASUREMENT
 /begin LOC_MEASUREMENT MisfDet_cntrMisf MisfDet_cylCntrMisfGenr MisfDet_idxMisfPat MisfDet_ignWaitBtwMisf MisfDet_ignWaitBtwMisfMod MisfDet_misfMod MisfDet_stMisfGenrEna MisfDet_stMisfGenrEnaTrg MisfDet_stMisfModActv MisfDet_stSecCamsftAftStrt /end LOC_MEASUREMENT
 FUNCTION_VERSION "1.10.0" /end FUNCTION
/begin FUNCTION MisfDet_RelsCdn "1.52.0_1.0.0Release of misfire detection"
 /begin DEF_CHARACTERISTIC MisfDet_cntrIgnBlkDnAdpnStrt_C MisfDet_cntrIgnBlkStcStrt_C MisfDet_cntrIgnFlreDwn_C MisfDet_cntrIgnStrtHld_C MisfDet_dlyTiStrtLineEnd_T MisfDet_dlyTiStrt_T MisfDet_dnCycMaxAdpn_M MisfDet_dnCycMaxStc_M MisfDet_dTqThdN_AX MisfDet_dTqThdTq_AX MisfDet_facDecTiTrsmAct_C MisfDet_facEnvPMin_C MisfDet_grdtPedlMax_M MisfDet_grdtPedlMin_M MisfDet_grdtTqMax.Cmn_GM MisfDet_grdtTqMin.Cmn_GM MisfDet_maskACSel_C MisfDet_maskBlkGear_C MisfDet_maskDnAdpn.cntrHldNStrt_T MisfDet_maskDnAdpn.cntrHldN_T MisfDet_maskDnAdpn.cntrHldStrt_C MisfDet_maskDnAdpn.cntrHld_C MisfDet_maskDnAdpn.cntrStrtMax_C MisfDet_maskDnAdpn.CmbTyp.HldN_C MisfDet_maskDnAdpn.CmbTyp.Hld_C MisfDet_maskDnAdpn.CmbTyp.Raw_C MisfDet_maskDnAdpn.Cmn.HldN_C MisfDet_maskDnAdpn.Cmn.Hld_C MisfDet_maskDnAdpn.Cmn.Raw_C MisfDet_maskDnAdpnNv.cntrHldN_T MisfDet_maskDnAdpnNv.cntrHld_C MisfDet_maskDnAdpnNv.CmbTyp.HldN_C MisfDet_maskDnAdpnNv.CmbTyp.Hld_C MisfDet_maskDnAdpnNv.CmbTyp.Raw_C MisfDet_maskDnAdpnNv.CmbTyp2.HldN_C MisfDet_maskDnAdpnNv.CmbTyp2.Hld_C MisfDet_maskDnAdpnNv.CmbTyp2.Raw_C MisfDet_maskDnAdpnNv.Cmn.HldN_C MisfDet_maskDnAdpnNv.Cmn.Hld_C MisfDet_maskDnAdpnNv.Cmn.Raw_C MisfDet_maskDnAdpnNvCorrn.cntrHld_C MisfDet_maskDnAdpnNvCorrn.CmbTyp.Hld_C MisfDet_maskDnAdpnNvCorrn.CmbTyp.Raw_C MisfDet_maskDnAdpnNvCorrn.Cmn.Hld_C MisfDet_maskDnAdpnNvCorrn.Cmn.Raw_C MisfDet_maskDnAdpnPlaus.cntrHld_C MisfDet_maskDnAdpnPlaus.CmbTyp.Hld_C MisfDet_maskDnAdpnPlaus.CmbTyp.Raw_C MisfDet_maskDnAdpnPlaus.Cmn.Hld_C MisfDet_maskDnAdpnPlaus.Cmn.Raw_C MisfDet_maskDnFltd.cntrHldN_T MisfDet_maskDnFltd.cntrHld_C MisfDet_maskDnFltd.CmbTyp.HldN_C MisfDet_maskDnFltd.CmbTyp.Hld_C MisfDet_maskDnFltd.CmbTyp.Raw_C MisfDet_maskDnFltd.Cmn.HldN_C MisfDet_maskDnFltd.Cmn.Hld_C MisfDet_maskDnFltd.Cmn.Raw_C MisfDet_maskSegTiAdpn.CmbTyp.Raw_C MisfDet_maskSegTiAdpn.CmbTyp2.Raw_C MisfDet_maskSegTiAdpn.Cmn.Raw_C MisfDet_maskSegTiAdpnFco.CmbTyp.Raw_C MisfDet_maskSegTiAdpnFco.Cmn.Raw_C MisfDet_maskStc.cntrHldN_T MisfDet_maskStc.cntrHld_C MisfDet_maskStc.CmbTyp.HldN_C MisfDet_maskStc.CmbTyp.Hld_C MisfDet_maskStc.CmbTyp.Raw_C MisfDet_maskStc.Cmn.HldN_C MisfDet_maskStc.Cmn.Hld_C MisfDet_maskStc.Cmn.Raw_C MisfDet_n08TqZero_AX MisfDet_nEngDnFltdZeroNoSegTiAdpn_C MisfDet_nEngMax.Cmn_GT MisfDet_nEngMaxPedlEvln_C MisfDet_nEngMax_AX MisfDet_nEngMin.Cmn_C MisfDet_nEngMinPedlEvln_C MisfDet_offsNIdle_C MisfDet_stRelsCdnCfg_C MisfDet_stTqZeroIdleCfg_C MisfDet_swtOn_C MisfDet_tEngDnAdpnMin_C MisfDet_tEngSegTiAdpnMin_C Misfdet_thdAgKnkCtrl_C Misfdet_thdDeltaAgIgnBas_M MisfDet_thdNEngStrt_C Misfdet_thdrLamS1B_C MisfDet_thdTEngDetnEna_C MisfDet_thdTEngDetnStrt_C MisfDet_thdTqZeroDrv.Cmn_GT MisfDet_thdTqZeroFlreDwn_C MisfDet_thdTqZeroIdle.Cmn_GT MisfDet_tiTrsmCorr_M MisfDet_tiTrsmMax_C MisfDet_tiTrsmMin_T MisfDet_tqTrsmMin_C MisfDet_tqZeroCorrnAlti_M MisfDet_tqZeroCorrnTEng_M /end DEF_CHARACTERISTIC
 /begin REF_CHARACTERISTIC MisfDet_stDnAdpnCfgCal_C /end REF_CHARACTERISTIC
 /begin IN_MEASUREMENT ACCtl_stOut APP_r Brk_st B_nmax_msg B_zesync_msg Clth_st Com_stMisfDetLineEnd EnvP_p EnvT_t Epm_ctCyl Epm_nEng Epm_stSync Ign_iaBas_s8 Ign_iacalc_s8 IKCtl_agKnkRtdt_s8 MisfDet_cylCntr MisfDet_dnCyc MisfDet_dnDly MisfDet_flgRoughRoad MisfDet_nEngSync MisfDet_nrMisfConsc MisfDet_nSetPLoDiff MisfDet_stAsr MisfDet_stCatHeat MisfDet_stDet MisfDet_stDnAdpnNvPlausAbsFail MisfDet_stDnAdpnPlausAbsFail MisfDet_stDnAdpnPlausRelCntrLim MisfDet_stDnAdpnPlausRelFail MisfDet_stIdle MisfDet_stMisfCont MisfDet_stMisfStiSync MisfDet_stNoInj MisfDet_stNoInjSync MisfDet_stOpenPt MisfDet_stReIni MisfDet_stSegShift MisfDet_stSegTiAdpnRdy MisfDet_stSegTiVld MisfDet_tEng MisfDet_tEngStrt MisfDet_tiEngRunSum MisfDet_tqAct MisfDet_tqBasc MisfDet_tqBascSync PthSet_stOvrRun PT_rGrip SyC_stSub ThrVlv_flgLimpModeB1 ThrVlv_flgReqFuCutOffB1 ThrVlv_flgSngSensErrB1 TiEngOff_stTiFirstStrt TiEngOff_ti Tra_numGear TS_stMnSwtAC UEGO_rLamS1B1 VehV_v zzaehl_msg /end IN_MEASUREMENT
 /begin OUT_MEASUREMENT MisfDet_maskDlyBlkDnAdpnNvCorrn MisfDet_maskDnAdpnNvCmbd MisfDet_maskDnAdpnNvCorrnCmbd MisfDet_maskDnAdpnNvCorrnCmbdCmbTyp MisfDet_maskRelsDnAdpn MisfDet_maskRelsDnAdpnCmbTyp MisfDet_maskRelsDnAdpnNv MisfDet_maskRelsDnAdpnNvCmbTyp MisfDet_maskRelsDnAdpnNvCmbTyp2 MisfDet_maskRelsDnAdpnNvCorrn MisfDet_maskRelsDnAdpnNvCorrnCmbTyp MisfDet_maskRelsDnAdpnPlaus MisfDet_maskRelsDnAdpnPlausCmbTyp MisfDet_maskRelsSegTiAdpnFco MisfDet_maskRelsSegTiAdpnFcoCmbTyp MisfDet_maskRelsStc MisfDet_maskRelsStcCmbTyp MisfDet_stAcCtlChng MisfDet_stBlkDnAdpn MisfDet_stBlkDnAdpnNv MisfDet_stBlkDnAdpnNvCorrn MisfDet_stBlkDnAdpnPlaus MisfDet_stBlkDnFltd MisfDet_stBlkSegTiAdpn MisfDet_stBlkSegTiAdpnFco MisfDet_stBlkStc MisfDet_stDlyDnAdpn MisfDet_stDnCycMaxAdpn MisfDet_stDTqOutOfRng MisfDet_stIdleChng MisfDet_stLineEnd MisfDet_stNEngOutOfRng MisfDet_stNmax MisfDet_stSetZeroTq MisfDet_stStrtDeb MisfDet_stTEngLowDnAdpn MisfDet_stTqZero MisfDet_stTrsmTiLow MisfDet_thdTqZero MisfDet_tiTrsmAct MisfDet_tqZeroCorrnAlti MisfDet_tqZeroCorrnTEng /end OUT_MEASUREMENT
 /begin LOC_MEASUREMENT MisfDet_agKnkCtrlMax MisfDet_cntrIniTrsmTi MisfDet_dPedlPosn MisfDet_dTq MisfDet_facEnvP Misfdet_maskDlyBlkDnFltd Misfdet_maskDlyBlkStc MisfDet_maskDnAdpn.cntrStrt MisfDet_maskDnAdpn.CmbTyp.Hld MisfDet_maskDnAdpn.CmbTyp.HldN MisfDet_maskDnAdpn.CmbTyp.Raw MisfDet_maskDnAdpn.Cmn.Hld MisfDet_maskDnAdpn.Cmn.HldN MisfDet_maskDnAdpn.Cmn.Raw MisfDet_maskDnAdpnNv.CmbTyp.Hld MisfDet_maskDnAdpnNv.CmbTyp.HldN MisfDet_maskDnAdpnNv.CmbTyp.Raw MisfDet_maskDnAdpnNv.CmbTyp2.Hld MisfDet_maskDnAdpnNv.CmbTyp2.HldN MisfDet_maskDnAdpnNv.CmbTyp2.Raw MisfDet_maskDnAdpnNv.Cmn.Hld MisfDet_maskDnAdpnNv.Cmn.HldN MisfDet_maskDnAdpnNv.Cmn.Raw MisfDet_maskDnAdpnNvCorrn.CmbTyp.Hld MisfDet_maskDnAdpnNvCorrn.CmbTyp.Raw MisfDet_maskDnAdpnNvCorrn.Cmn.Hld MisfDet_maskDnAdpnNvCorrn.Cmn.Raw MisfDet_maskDnAdpnPlaus.CmbTyp.Hld MisfDet_maskDnAdpnPlaus.CmbTyp.Raw MisfDet_maskDnAdpnPlaus.Cmn.Hld MisfDet_maskDnAdpnPlaus.Cmn.Raw MisfDet_maskDnFltd.CmbTyp.Hld MisfDet_maskDnFltd.CmbTyp.HldN MisfDet_maskDnFltd.CmbTyp.Raw MisfDet_maskDnFltd.Cmn.Hld MisfDet_maskDnFltd.Cmn.HldN MisfDet_maskDnFltd.Cmn.Raw MisfDet_maskSegTiAdpn.CmbTyp.Raw MisfDet_maskSegTiAdpn.CmbTyp2.Raw MisfDet_maskSegTiAdpn.Cmn.Raw MisfDet_maskSegTiAdpnFco.CmbTyp.Raw MisfDet_maskSegTiAdpnFco.Cmn.Raw MisfDet_maskStc.CmbTyp.Hld MisfDet_maskStc.CmbTyp.HldN MisfDet_maskStc.CmbTyp.Raw MisfDet_maskStc.Cmn.Hld MisfDet_maskStc.Cmn.HldN MisfDet_maskStc.Cmn.Raw MisfDet_numGear MisfDet_stAgKnkCtrl MisfDet_stBlkDnAdpnNvCorrnTyp MisfDet_stBlkDnAdpnNvTyp MisfDet_stBlkDnAdpnPlausTyp MisfDet_stBlkDnAdpnTyp MisfDet_stBlkDnFltdTyp MisfDet_stBlkSegTiAdpnFcoTyp MisfDet_stBlkSegTiAdpnTyp MisfDet_stBlkStcTyp MisfDet_stClthChng MisfDet_stDeltaAgIgnBas MisfDet_stDlyStrtStc MisfDet_stDlyTiStrt MisfDet_stDnFltdZeroNoSegTiAdpn MisfDet_stDPedlPosnOutOfRng MisfDet_stEngStrt MisfDet_stFlreDwn MisfDet_stGripChngPt MisfDet_stTEngLow MisfDet_thdTqZeroRaw MisfDet_tiEngOff MisfDet_tiTrsmCorr /end LOC_MEASUREMENT
 FUNCTION_VERSION "1.52.0_1.0.0" /end FUNCTION
/begin FUNCTION MisfDet_RoughRoadByWhlSpd "1.18.0    Rough road detection by wheel speeds"
 /begin DEF_CHARACTERISTIC MisfDet_axleSeln_C MisfDet_dVWhlDecMax_C MisfDet_dVWhlFil_C MisfDet_dVWhlFrntThd_M MisfDet_dVWhlPlausVMax_C MisfDet_dVWhlPlausVMin_C MisfDet_dVWhlRatMax_C MisfDet_dVWhlReThd_M MisfDet_dVWhlThdFac_T MisfDet_kdRoughRoadDT1_C MisfDet_RoughRoadDiagStuckDNEngMin_C MisfDet_stRoughRoadDiagCfg_C MisfDet_tiRoughRoadDT1_C MisfDet_trckWidth_C MisfDet_trqMaxDiagVWhlDe_C MisfDet_vWhlDeMax_C MisfDet_vWhlFil_C MisfDet_vWhlMax_C MisfDet_whlBas_C MisfDet_yawRateDeMax_C /end DEF_CHARACTERISTIC
 /begin IN_MEASUREMENT Brk_st Com_vWhlFrntLe Com_vWhlFrntRi Com_vWhlReLe Com_vWhlReRi Epm_nEng MisfDet_stFcmClr20ms MisfDet_tqBasc PT_bGrip PT_bNoGrip PT_rTrq PT_stTraShftOp PT_trqWhl VehV_v /end IN_MEASUREMENT
 /begin OUT_MEASUREMENT MisfDet_flgRoughRoad MisfDet_RoughRoadDstLog /end OUT_MEASUREMENT
 /begin LOC_MEASUREMENT MisfDet_chkVWhlDe MisfDet_dVWhl MisfDet_dVWhlAvrgFrnt MisfDet_dVWhlAvrgRe MisfDet_dVWhlFild MisfDet_dVWhlFrntThd MisfDet_dVWhlFrntThdMapOut MisfDet_dVWhlRat MisfDet_dVWhlReThd MisfDet_dVWhlReThdMapOut MisfDet_dVWhlThdFac MisfDet_flgRoughRoadFrnt MisfDet_flgRoughRoadPrel MisfDet_flgRoughRoadRe MisfDet_RoughRoadDNEng MisfDet_stDiagVWhlDeEnbl MisfDet_stDiagVWhlStuck MisfDet_vWhl MisfDet_vWhlCor MisfDet_vWhlDe MisfDet_vWhlFild MisfDet_vWhlUsd MisfDet_vWhlVld MisfDet_yawRate MisfDet_yawRateAvrg MisfDet_yawRateDe /end LOC_MEASUREMENT
 FUNCTION_VERSION "1.18.0" /end FUNCTION
/begin FUNCTION MisfDet_SegTiAdpn "1.25.0    Trigger wheel adaptation of misfire detection"
 /begin DEF_CHARACTERISTIC MisfDet_segTiAdpnCntrEnaDlyEol_C MisfDet_segTiAdpnCntrEnaDly_C MisfDet_segTiAdpnDifMaxFco_C MisfDet_segTiAdpnDifMaxPrio_C MisfDet_segTiAdpnDifMax_C MisfDet_segTiAdpnFilFacDecEol_C MisfDet_segTiAdpnFilFacDec_C MisfDet_segTiAdpnFilFacEndEol_C MisfDet_segTiAdpnFilFacEnd_C MisfDet_segTiAdpnFilFacStrtEol_C MisfDet_segTiAdpnFilFacStrt_C MisfDet_segTiAdpnN.Max.Eol_C MisfDet_segTiAdpnN.Max.PosTq.Cmn_C MisfDet_segTiAdpnN.Max.Fco.Cmn_C MisfDet_segTiAdpnN.Min.Eol_C MisfDet_segTiAdpnN.Min.PosTq.Cmn_C MisfDet_segTiAdpnN.Min.Fco.Cmn_C MisfDet_segTiAdpnNMaxNoDmd_C MisfDet_segTiAdpnNrTryEolMax_C MisfDet_segTiAdpnSampleSprdMax_C MisfDet_segTiAdpnTq.Max.Cmn_GT MisfDet_segTiAdpnTq.Max.Eol_C MisfDet_segTiAdpnTq.Min.Cmn_C MisfDet_segTiAdpnTq.Min.Eol_C MisfDet_segTiAdpnTqMax_AX MisfDet_segTiAdpnValMaxDebCntrThd_C MisfDet_segTiAdpnValMaxEol_C MisfDet_segTiAdpnValMax_C MisfDet_segTiAdpnValSampleDiagDebCntrThd_C MisfDet_segTiAdpnValSampleDiagMaxSampleNrThd_C MisfDet_segTiDifDebCntrThd_C MisfDet_segTiRatSprdDebCntrThd_C MisfDet_segTiRatSprdMax_C MisfDet_segTiRatSpreadFilFacMax_C MisfDet_segTiSampleSprdDebCntrThd_C MisfDet_stSegTiAdpnCfgCal_C MisfDet_stSegTiAdpnCfgDiag_C MisfDet_stSegTiAdpnCfgEnaPosn_C MisfDet_stSegTiAdpnCfgEnaTyp.Cmn_C MisfDet_stSegTiAdpnCfgFastLrn_C MisfDet_stSegTiAdpnCfgPrio_C /end DEF_CHARACTERISTIC
 /begin IN_MEASUREMENT ActMod_trqClth Eep_EnvRamInvld Epm_nEng MisfDet_cylCntrSegTi MisfDet_dnDly MisfDet_segPosnLenAry MisfDet_segPosnSegTi MisfDet_segTiDly MisfDet_segTiRawAry MisfDet_stBlkSegTiAdpn MisfDet_stBlkSegTiAdpnFco MisfDet_stDnAdpnRstCfm MisfDet_stFcmClr MisfDet_stFcmClr1000ms MisfDet_stReIni MisfDet_stSegTiAdpnRstReq SyC_stSub Tra_numGear VehV_v /end IN_MEASUREMENT
 /begin OUT_MEASUREMENT MisfDet_maskDFCsegTiAdpn MisfDet_maskDFCsegTiAdpnAltvPosn MisfDet_maskDFCsegTiAdpnStdPosn MisfDet_maskSegTiReqAdpn MisfDet_segTiAdpnNMax MisfDet_segTiAdpnNMin MisfDet_segTiAdpnRstCntr MisfDet_segTiAdpnRstCntrAltvPosn MisfDet_segTiAdpnRstCntrFco MisfDet_segTiAdpnSample0.ary MisfDet_segTiAdpnSample0.cntr MisfDet_segTiAdpnSample0.segPosn MisfDet_segTiAdpnSample1.ary MisfDet_segTiAdpnSample1.cntr MisfDet_segTiAdpnSample1.segPosn MisfDet_segTiAdpnSampleCntr MisfDet_segTiAdpnSampleMdn MisfDet_segTiAdpnStruct0.rat MisfDet_segTiAdpnStruct0.ratFltd MisfDet_segTiAdpnStruct0.ratMin MisfDet_segTiAdpnStruct0.ratMax MisfDet_segTiAdpnStruct0.ratMinDiv MisfDet_segTiAdpnStruct0.ratMaxDiv MisfDet_segTiAdpnStruct0.ratSprd MisfDet_segTiAdpnStruct0.stFilRdy MisfDet_segTiAdpnStruct0.stSampleSprdMax MisfDet_segTiAdpnStruct0.stMdnMax MisfDet_segTiAdpnStruct0.sampleMdn MisfDet_segTiAdpnStruct0.sampleSprd MisfDet_segTiAdpnStruct0.sampleCurr MisfDet_segTiAdpnStruct0.segNr MisfDet_segTiAdpnStruct1.rat MisfDet_segTiAdpnStruct1.ratFltd MisfDet_segTiAdpnStruct1.ratMin MisfDet_segTiAdpnStruct1.ratMax MisfDet_segTiAdpnStruct1.ratMinDiv MisfDet_segTiAdpnStruct1.ratMaxDiv MisfDet_segTiAdpnStruct1.ratSprd MisfDet_segTiAdpnStruct1.stFilRdy MisfDet_segTiAdpnStruct1.stSampleSprdMax MisfDet_segTiAdpnStruct1.stMdnMax MisfDet_segTiAdpnStruct1.sampleMdn MisfDet_segTiAdpnStruct1.sampleSprd MisfDet_segTiAdpnStruct1.sampleCurr MisfDet_segTiAdpnStruct1.segNr MisfDet_segTiAdpnTqMax MisfDet_segTiAdpnTqMin MisfDet_segTiAdpnVal MisfDet_segTiAdpnValAltvPosn MisfDet_segTiAdpnValMaxDebCntrAltvPosn MisfDet_segTiAdpnValMaxDebCntrStdPosn MisfDet_segTiAdpnValSampleDiagCntrAltvPosn MisfDet_segTiAdpnValSampleDiagCntrStdPosn MisfDet_segTiAdpnValSampleDiagDebCntrAltvPosn MisfDet_segTiAdpnValSampleDiagDebCntrStdPosn MisfDet_segTiDifDebCntr MisfDet_segTiRatSprdDebCntrAltvPosn MisfDet_segTiRatSprdDebCntrStdPosn MisfDet_segTiSampleSprdDebCntrAltvPosn MisfDet_segTiSampleSprdDebCntrStdPosn MisfDet_stDnAdpnRstReq MisfDet_stSegTiAdpn MisfDet_stSegTiAdpnActv MisfDet_stSegTiAdpnCfgEnaTypVal MisfDet_stSegTiAdpnEna MisfDet_stSegTiAdpnRdy MisfDet_stSegTiAdpnRdyPosn MisfDet_stSegTiAdpnRng MisfDet_stSegTiAdpnRst MisfDet_stSegTiAdpnRstCfm MisfDet_stSegTiAdpnSampleRdy MisfDet_stSegTiAdpnSimuLrn MisfDet_stSegTiAdpnSync MisfDet_stSegTiAdpnTypeRdy MisfDet_stSegTiAdpnValSampleDiagAltvPosn MisfDet_stSegTiAdpnValSampleDiagStdPosn /end OUT_MEASUREMENT
 /begin LOC_MEASUREMENT MisfDet_flgSyncnRstSegTi MisfDet_segTiAdpnCntrEnaDly MisfDet_segTiAdpnDifRelMax MisfDet_segTiAdpnFilFac MisfDet_segTiAdpnSampleSprdCntr MisfDet_segTiAdpnSampleSprdRelMax MisfDet_segTiAdpnValMaxCntr MisfDet_segTiAdpnValMaxCntrEol MisfDet_segTiAdpnValRelMax MisfDet_segTiRatSprdCntrAltvPosn MisfDet_segTiRatSprdCntrStdPosn MisfDet_segTiRatSprdRelMax MisfDet_segTiValMdl MisfDet_segTiValSync MisfDet_stExtClrReq MisfDet_stSegTiAdpnEnaEol MisfDet_stSegTiAdpnEolReq MisfDet_stSegTiAdpnFcoOnly MisfDet_stSegTiAdpnLrntSegPosnCyc MisfDet_stSegTiAdpnSampleCalc MisfDet_stSegTiAdpnValMax /end LOC_MEASUREMENT
 FUNCTION_VERSION "1.25.0" /end FUNCTION
/begin FUNCTION MisfDet_SegTiCalcn "1.29.1    Segment time calculation of misfire detection"
 /begin DEF_CHARACTERISTIC MisfDet_segPosnAltvNMax_C MisfDet_segPosnCalcNMaxOffs_C MisfDet_segPosnIaLteHld_C MisfDet_segPosnIaLte_T MisfDet_segPosnLenAltv_C MisfDet_segPosnLen_C MisfDet_segPosnOffsIaFilFac_C MisfDet_segPosnOffsIdleDlyTi_C MisfDet_segPosnOffsIdleTMin_C MisfDet_segPosnOffsNHys_C MisfDet_segPosnOffsTqMaxOff_C MisfDet_segPosnOffsTqMaxOn_C MisfDet_segPosnStrtAltv_C MisfDet_segPosnStrt_C MisfDet_segShiftRedStgHld_C MisfDet_segTiDly_C MisfDet_segTiInin_C MisfDet_segTiMnpl_FM MisfDet_stSegTiCalcnCfgCal_C MisfDet_stSegTiCalcnCfg_C /end DEF_CHARACTERISTIC
 /begin REF_CHARACTERISTIC EpmSeq_phiInt_CA MisfDet_dnQnts_C /end REF_CHARACTERISTIC
 /begin IN_MEASUREMENT Clth_st EngStrt_bStrtEnd EpmSyn_phiInt Epm_ctCyl Epm_nEng Ign_iaBas_s8 Ign_iacalc_s8 MisfDet_dnThd MisfDet_maskSegTiReqAdpn MisfDet_segPosnDn MisfDet_stCatHeat MisfDet_stIdle MisfDet_stMisfSti MisfDet_stOpenPt MisfDet_stRedStgTrqSyncSegTi MisfDet_stReIni MisfDet_stTqZero MisfDet_tEng MisfDet_tEngStrt MisfDet_tqBasc VehV_v /end IN_MEASUREMENT
 /begin OUT_MEASUREMENT MisfDet_cylCntrSegTi MisfDet_iaMdnAvrg MisfDet_maskSegPosnDnCalc MisfDet_maskSegTiVld MisfDet_segPosnLen MisfDet_segPosnLenAry MisfDet_segPosnLenSync MisfDet_segPosnSegTi MisfDet_segPosnStrt MisfDet_segTi MisfDet_segTiAry MisfDet_segTiDly MisfDet_segTiRawAry MisfDet_stSegPosnOffsTqLo MisfDet_stSegShift MisfDet_stSegTiVld /end OUT_MEASUREMENT
 /begin LOC_MEASUREMENT MisfDet_iaAvg MisfDet_iaLteCntr MisfDet_iaMdn MisfDet_maskSegTiVldSegBasd MisfDet_segTiDlyCorr MisfDet_segTiSegBasd MisfDet_stSegPosnIaLte MisfDet_stSegPosnOffsIdle MisfDet_stSegShiftCatHeat MisfDet_stSegShiftRedStg /end LOC_MEASUREMENT
 FUNCTION_VERSION "1.29.1" /end FUNCTION
/begin FUNCTION MisfDet_SigSeln "1.15.0    Selection of the misfire signal for the statistical evaluation" /begin DEF_CHARACTERISTIC MisfDet_nrCycMisfCont_C MisfDet_stSigSelnCfg_C /end DEF_CHARACTERISTIC
 /begin IN_MEASUREMENT Epm_stSync MisfDet_cylCntr MisfDet_stBlkStc MisfDet_stDet MisfDet_stDnDet MisfDet_stInjLockdOpen MisfDet_stNoInjSync MisfDet_stReIni /end IN_MEASUREMENT
 /begin OUT_MEASUREMENT MisfDet_nrCylMisfNoId MisfDet_nrMisfConsc MisfDet_stCntMisf MisfDet_stMisfCont /end OUT_MEASUREMENT
 /begin LOC_MEASUREMENT MisfDet_maskCntMisf MisfDet_maskDet MisfDet_maskMisfCont /end LOC_MEASUREMENT
 FUNCTION_VERSION "1.15.0" /end FUNCTION
/begin FUNCTION MisfDet_Srv06 "1.12.0    Service 06 of misfire detection"
 /begin IN_MEASUREMENT Epm_nEng MisfDet_cylCntr MisfDet_stCntMisf MisfDet_stFcmClr MisfDet_stFcmClr100ms MisfDet_stReIni SyC_stSub /end IN_MEASUREMENT
 /begin OUT_MEASUREMENT MisfDet_cntrMisfDiag MisfDet_cntrMisfDiagFild /end OUT_MEASUREMENT
 FUNCTION_VERSION "1.12.0" /end FUNCTION
/begin COMPU_METHOD accgrd_uw_b2777p6 "" RAT_FUNC "%6.4" "m/(s^3)" COEFFS 0 147456 0 0 0 6250 /end COMPU_METHOD
/begin COMPU_METHOD acc_uw_b55p55 "" RAT_FUNC "%6.5" "m/(s^2)" COEFFS 0 147456 0 0 0 125 /end COMPU_METHOD
/begin COMPU_METHOD B_TRUE "" TAB_VERB "%6.3" "" COMPU_TAB_REF B_TRUE /end COMPU_METHOD
/begin COMPU_VTAB B_TRUE "" TAB_VERB 2 0 "FALSE" 1 "TRUE" /end COMPU_VTAB
/begin COMPU_METHOD CaS_32rev_compu "" RAT_FUNC "%6.2" "CaS rev" COEFFS 0 1 0 0 0 1 /end COMPU_METHOD
/begin COMPU_METHOD Compu_SegPosnInt_VERB "" TAB_VERB "%6.3" "" COMPU_TAB_REF Compu_SegPosnInt_VERB /end COMPU_METHOD
/begin COMPU_VTAB Compu_SegPosnInt_VERB "" TAB_VERB 4 0 "Std" 1 "Altv" 258 "Idle" 259 "PfltRgn" /end COMPU_VTAB
/begin COMPU_METHOD Compu_SegPosn_VERB "" TAB_VERB "%6.3" "" COMPU_TAB_REF Compu_SegPosn_VERB /end COMPU_METHOD
/begin COMPU_VTAB Compu_SegPosn_VERB "" TAB_VERB 9 0 "Std" 1 "Altv" 258 "Idle" 259 "PfltRgn" 260 "Cilcn" 261 "TqBal" 2 "undef1" 16 "Std2" 17 "undef2" /end COMPU_VTAB
/begin COMPU_METHOD dez "" RAT_FUNC "%6.2" "" COEFFS 0 1 0 0 0 1 /end COMPU_METHOD
/begin COMPU_METHOD dn_Compu "" RAT_FUNC "%6.4" "rad/s^2" COEFFS 0 16 0 0 0 1 /end COMPU_METHOD
/begin COMPU_METHOD EngN "" RAT_FUNC "%6.3" "rpm" COEFFS 0 2 0 0 0 1 /end COMPU_METHOD
/begin COMPU_METHOD EngNGrad "" RAT_FUNC "%6.3" "rpm/s" COEFFS 0 2 0 0 0 1 /end COMPU_METHOD
/begin COMPU_METHOD fak_q0p01 "" RAT_FUNC "%6.4" "" COEFFS 0 100 0 0 0 1 /end COMPU_METHOD
/begin COMPU_METHOD fak_ub_b1 "" RAT_FUNC "%6.4" "-" COEFFS 0 256 0 0 0 1 /end COMPU_METHOD
/begin COMPU_METHOD fak_ub_b16 "" RAT_FUNC "%6.4" "-" COEFFS 0 256 0 0 0 16 /end COMPU_METHOD
/begin COMPU_METHOD fak_ub_b2 "" RAT_FUNC "%8.5" "-" COEFFS 0 256 0 0 0 2 /end COMPU_METHOD
/begin COMPU_METHOD fak_ub_b4 "" RAT_FUNC "%6.4" "-" COEFFS 0 256 0 0 0 4 /end COMPU_METHOD
/begin COMPU_METHOD fak_ub_b64 "" RAT_FUNC "%6.3" "-" COEFFS 0 256 0 0 0 64 /end COMPU_METHOD
/begin COMPU_METHOD fak_uw_b1 "" RAT_FUNC "%7.6" "-" COEFFS 0 65536 0 0 0 1 /end COMPU_METHOD
/begin COMPU_METHOD fak_uw_b16 "" RAT_FUNC "%6.5" "-" COEFFS 0 65536 0 0 0 16 /end COMPU_METHOD
/begin COMPU_METHOD fak_uw_b32 "" RAT_FUNC "%6.5" "-" COEFFS 0 65536 0 0 0 32 /end COMPU_METHOD
/begin COMPU_METHOD fak_uw_b8 "" RAT_FUNC "%6.5" "-" COEFFS 0 65536 0 0 0 8 /end COMPU_METHOD
/begin COMPU_METHOD Kd "" RAT_FUNC "%7.6" "1/1" COEFFS 0 65536 0 0 0 1 /end COMPU_METHOD
/begin COMPU_METHOD kw_q0p75 "" RAT_FUNC "%6.3" "Grad KW" COEFFS 0 4 0 0 0 3 /end COMPU_METHOD
/begin COMPU_METHOD kw_q1p8310eEm4 "" RAT_FUNC "%6.5" "deg CrS" COEFFS 0 32768 0 0 0 6 /end COMPU_METHOD
/begin COMPU_METHOD kw_q2p794eEm9 "" RAT_FUNC "%11.10" "deg CrS" COEFFS 0 2147483648 0 0 0 6 /end COMPU_METHOD
/begin COMPU_METHOD kw_tooth_sy "" RAT_FUNC "%6.1" "deg KW" COEFFS 0 0.1 0 0 0 1 /end COMPU_METHOD
/begin COMPU_METHOD len_q0p001_m "" RAT_FUNC "%6.5" "m" COEFFS 0 1000 0 0 0 1 /end COMPU_METHOD
/begin COMPU_METHOD len_q50_m "" RAT_FUNC "%6.1" "m" COEFFS 0 0.02 0 0 0 1 /end COMPU_METHOD
/begin COMPU_METHOD OneToOne "" RAT_FUNC "%6.2" "-" COEFFS 0 1 0 0 0 1 /end COMPU_METHOD
/begin COMPU_METHOD q0p06104_pc_DIV_s "" RAT_FUNC "%6.4" "%/s" COEFFS 0 65536 0 0 0 4000 /end COMPU_METHOD
/begin COMPU_METHOD rel_rng_uw_b100 "" RAT_FUNC "%6.4" "% Rng" COEFFS 0 65536 0 0 0 100 /end COMPU_METHOD
/begin COMPU_METHOD rel_ub_b200 "" RAT_FUNC "%6.3" "%" COEFFS 0 256 0 0 0 200 /end COMPU_METHOD
/begin COMPU_METHOD rel_uw_b100 "" RAT_FUNC "%6.4" "%" COEFFS 0 65536 0 0 0 100 /end COMPU_METHOD
/begin COMPU_METHOD rel_win_ub_b100 "" RAT_FUNC "%6.3" "% Win" COEFFS 0 256 0 0 0 100 /end COMPU_METHOD
/begin COMPU_METHOD r_prc_q0p003052_COMPU "" RAT_FUNC "%6.4" "%" COEFFS 0 65536 0 0 0 200 /end COMPU_METHOD
/begin COMPU_METHOD SY_ANZLUE_Compu "" TAB_VERB "%6.3" "" COMPU_TAB_REF SY_ANZLUE_Compu /end COMPU_METHOD
/begin COMPU_VTAB SY_ANZLUE_Compu "" TAB_VERB 5 0 "kein Lüfter" 1 "1 Lüfter" 2 "2 Lüfter" 3 "3 Lüfter" 12 "Doppellüfter" /end COMPU_VTAB
/begin COMPU_METHOD SY_ANZPSLS_Compu "" TAB_VERB "%6.3" "" COMPU_TAB_REF SY_ANZPSLS_Compu /end COMPU_METHOD
/begin COMPU_VTAB SY_ANZPSLS_Compu "" TAB_VERB 3 0 "PSLS_NO" 1 "PSLS_ONE" 2 "PSLS_TWO" /end COMPU_VTAB
/begin COMPU_METHOD SY_ANZSFST_Compu "" RAT_FUNC "%6.2" "" COEFFS 0 1 0 0 0 1 /end COMPU_METHOD
/begin COMPU_METHOD SY_ARC_Compu "" TAB_VERB "%6.3" "" COMPU_TAB_REF SY_ARC_Compu /end COMPU_METHOD
/begin COMPU_VTAB SY_ARC_Compu "" TAB_VERB 2 0 "kein Active Roll Control vorhanden" 1 "Active Roll Control vorhanden" /end COMPU_VTAB
/begin COMPU_METHOD SY_ASGLC_Compu "" RAT_FUNC "%6.2" "" COEFFS 0 1 0 0 0 1 /end COMPU_METHOD
/begin COMPU_METHOD SY_ASG_Compu "" TAB_VERB "%6.3" "" COMPU_TAB_REF SY_ASG_Compu /end COMPU_METHOD
/begin COMPU_VTAB SY_ASG_Compu "" TAB_VERB 2 0 "kein automatisiertes Schaltgetriebe vorhanden" 1 "Automatisiertes Schaltgetriebe vorhanden" /end COMPU_VTAB
/begin COMPU_METHOD SY_ASM_Compu "" TAB_VERB "%6.3" "" COMPU_TAB_REF SY_ASM_Compu /end COMPU_METHOD
/begin COMPU_VTAB SY_ASM_Compu "" TAB_VERB 2 0 "kein ASM-Getriebe vorhanden" 1 "ASM-Getriebe vorhanden" /end COMPU_VTAB
/begin COMPU_METHOD SY_ASR_Compu "" TAB_VERB "%6.3" "" COMPU_TAB_REF SY_ASR_Compu /end COMPU_METHOD
/begin COMPU_VTAB SY_ASR_Compu "" TAB_VERB 2 0 "keine ASR vorhanden" 1 "ASR vorhanden" /end COMPU_VTAB
/begin COMPU_METHOD SY_ASTIKR_Compu "" TAB_VERB "%6.3" "" COMPU_TAB_REF SY_ASTIKR_Compu /end COMPU_METHOD
/begin COMPU_VTAB SY_ASTIKR_Compu "" TAB_VERB 2 0 "kein Temperatursensor im Krümmer" 1 "Temperatursensor im Krümmer verbaut" /end COMPU_VTAB
/begin COMPU_METHOD SY_ASTNVK_Compu "" TAB_VERB "%6.3" "" COMPU_TAB_REF SY_ASTNVK_Compu /end COMPU_METHOD
/begin COMPU_VTAB SY_ASTNVK_Compu "" TAB_VERB 2 0 "kein Temperatursensor nach Vorkat" 1 "Temperatursensor nach Vorkat" /end COMPU_VTAB
/begin COMPU_METHOD SY_ASTVHK_Compu "" TAB_VERB "%6.3" "" COMPU_TAB_REF SY_ASTVHK_Compu /end COMPU_METHOD
/begin COMPU_VTAB SY_ASTVHK_Compu "" TAB_VERB 2 0 "kein Temperatursensor vor Hauptkat" 1 "Temperatursensor vor Hauptkat" /end COMPU_VTAB
/begin COMPU_METHOD SY_ASTVVK_Compu "" TAB_VERB "%6.3" "" COMPU_TAB_REF SY_ASTVVK_Compu /end COMPU_METHOD
/begin COMPU_VTAB SY_ASTVVK_Compu "" TAB_VERB 2 0 "Kein Temperatursensor vor Vorkat" 1 "Temperatursensor vor Vorkat" /end COMPU_VTAB
/begin COMPU_METHOD SY_ATLB_Compu "" TAB_VERB "%6.3" "" COMPU_TAB_REF SY_ATLB_Compu /end COMPU_METHOD
/begin COMPU_VTAB SY_ATLB_Compu "" TAB_VERB 2 0 "keine Turbo-Bypassklappe" 1 "Turbo-Bypassklappe" /end COMPU_VTAB
/begin COMPU_METHOD SY_ATMGD_Compu "" TAB_VERB "%6.3" "" COMPU_TAB_REF SY_ATMGD_Compu /end COMPU_METHOD
/begin COMPU_VTAB SY_ATMGD_Compu "" TAB_VERB 2 0 "False" 1 "True" /end COMPU_VTAB
/begin COMPU_METHOD SY_ATMTURB_Compu "" TAB_VERB "%6.3" "" COMPU_TAB_REF SY_ATMTURB_Compu /end COMPU_METHOD
/begin COMPU_VTAB SY_ATMTURB_Compu "" TAB_VERB 2 0 "ATMTURB_NOPRES" 1 "ATMTURB_PRES" /end COMPU_VTAB
/begin COMPU_METHOD SY_ATMZA_Compu "" TAB_VERB "%6.3" "" COMPU_TAB_REF SY_ATMZA_Compu /end COMPU_METHOD
/begin COMPU_VTAB SY_ATMZA_Compu "" TAB_VERB 2 0 "%ATMZA nicht vorhanden" 1 "%ATMZA vorhanden" /end COMPU_VTAB
/begin COMPU_METHOD SY_ATR_Compu "" TAB_VERB "%6.3" "" COMPU_TAB_REF SY_ATR_Compu /end COMPU_METHOD
/begin COMPU_VTAB SY_ATR_Compu "" TAB_VERB 2 0 "keine Abgastemperatursensoren vorhanden" 1 "Abgastemperatursensoren vorhanden" /end COMPU_VTAB
/begin COMPU_METHOD SY_ATURB_Compu "" TAB_VERB "%6.3" "" COMPU_TAB_REF SY_ATURB_Compu /end COMPU_METHOD
/begin COMPU_VTAB SY_ATURB_Compu "" TAB_VERB 4 0 "no_turbine" 1 "wastegate" 2 "vtg" 3 "varturb" /end COMPU_VTAB
/begin COMPU_METHOD SY_AUFLAD2_Compu "" TAB_VERB "%6.3" "" COMPU_TAB_REF SY_AUFLAD2_Compu /end COMPU_METHOD
/begin COMPU_VTAB SY_AUFLAD2_Compu "" TAB_VERB 2 0 "no_2_bank_charging" 1 "2_bank_charging" /end COMPU_VTAB
/begin COMPU_METHOD SY_AUFLAD_Compu "" TAB_VERB "%6.3" "" COMPU_TAB_REF SY_AUFLAD_Compu /end COMPU_METHOD
/begin COMPU_VTAB SY_AUFLAD_Compu "" TAB_VERB 2 0 "no_supercharging" 1 "supercharging" /end COMPU_VTAB
/begin COMPU_METHOD SY_BATTSG_Compu "" TAB_VERB "%6.3" "" COMPU_TAB_REF SY_BATTSG_Compu /end COMPU_METHOD
/begin COMPU_VTAB SY_BATTSG_Compu "" TAB_VERB 2 0 "kein 2 Batterie Boardkonzept" 1 "2 Batterie Boardkonzept" /end COMPU_VTAB
/begin COMPU_METHOD SY_BBBO_Compu "" TAB_VERB "%6.3" "" COMPU_TAB_REF SY_BBBO_Compu /end COMPU_METHOD
/begin COMPU_VTAB SY_BBBO_Compu "" TAB_VERB 2 0 "False" 1 "True" /end COMPU_VTAB
/begin COMPU_METHOD SY_BBKOPT_Compu "" TAB_VERB "%6.3" "" COMPU_TAB_REF SY_BBKOPT_Compu /end COMPU_METHOD
/begin COMPU_VTAB SY_BBKOPT_Compu "" TAB_VERB 2 0 "False" 1 "True" /end COMPU_VTAB
/begin COMPU_METHOD SY_BBSAWE_Compu "" TAB_VERB "%6.3" "" COMPU_TAB_REF SY_BBSAWE_Compu /end COMPU_METHOD
/begin COMPU_VTAB SY_BBSAWE_Compu "" TAB_VERB 2 0 "False" 1 "True" /end COMPU_VTAB
/begin COMPU_METHOD SY_BDE_Compu "" TAB_VERB "%6.3" "" COMPU_TAB_REF SY_BDE_Compu /end COMPU_METHOD
/begin COMPU_VTAB SY_BDE_Compu "" TAB_VERB 2 0 "Saugrohreinspritzer" 1 "Benzindirekteinspritzer" /end COMPU_VTAB
/begin COMPU_METHOD SY_BGD3PK_Compu "" TAB_VERB "%6.3" "" COMPU_TAB_REF SY_BGD3PK_Compu /end COMPU_METHOD
/begin COMPU_VTAB SY_BGD3PK_Compu "" TAB_VERB 2 0 "False" 1 "True" /end COMPU_VTAB
/begin COMPU_METHOD SY_BGSF_Compu "" TAB_VERB "%6.3" "" COMPU_TAB_REF SY_BGSF_Compu /end COMPU_METHOD
/begin COMPU_VTAB SY_BGSF_Compu "" TAB_VERB 2 0 "False" 1 "True" /end COMPU_VTAB
/begin COMPU_METHOD SY_BH_Compu "" TAB_VERB "%6.3" "" COMPU_TAB_REF SY_BH_Compu /end COMPU_METHOD
/begin COMPU_VTAB SY_BH_Compu "" TAB_VERB 2 0 "keine Blockheizererkennung" 1 "Blockheizererkennung" /end COMPU_VTAB
/begin COMPU_METHOD SY_BKS_Compu "" TAB_VERB "%6.3" "" COMPU_TAB_REF SY_BKS_Compu /end COMPU_METHOD
/begin COMPU_VTAB SY_BKS_Compu "" TAB_VERB 2 0 "kein bedarfsgeregeltes KVS" 1 "bedarfsgeregeltes KVS" /end COMPU_VTAB
/begin COMPU_METHOD SY_BKVP_Compu "" TAB_VERB "%6.3" "" COMPU_TAB_REF SY_BKVP_Compu /end COMPU_METHOD
/begin COMPU_VTAB SY_BKVP_Compu "" TAB_VERB 4 0 "0" 1 "1" 2 "2" 3 "3" /end COMPU_VTAB
/begin COMPU_METHOD SY_BKVSRV_Compu "" TAB_VERB "%6.3" "" COMPU_TAB_REF SY_BKVSRV_Compu /end COMPU_METHOD
/begin COMPU_VTAB SY_BKVSRV_Compu "" TAB_VERB 2 0 "ohne Verbindung" 1 "mit Verbindung" /end COMPU_VTAB
/begin COMPU_METHOD SY_BKV_Compu "" TAB_VERB "%6.3" "" COMPU_TAB_REF SY_BKV_Compu /end COMPU_METHOD
/begin COMPU_VTAB SY_BKV_Compu "" TAB_VERB 3 0 "ohne Drucksensor oder -schalter" 1 "Druckschalter" 2 "Drucksensor" /end COMPU_VTAB
/begin COMPU_METHOD SY_BOADAP_Compu "" TAB_VERB "%6.3" "" COMPU_TAB_REF SY_BOADAP_Compu /end COMPU_METHOD
/begin COMPU_VTAB SY_BOADAP_Compu "" TAB_VERB 2 0 "SY_BOADAP ==0" 1 "SY_BOADAP ==1" /end COMPU_VTAB
/begin COMPU_METHOD SY_BOGALIM_Compu "" TAB_VERB "%6.3" "" COMPU_TAB_REF SY_BOGALIM_Compu /end COMPU_METHOD
/begin COMPU_VTAB SY_BOGALIM_Compu "" TAB_VERB 2 0 "SY_BOGALIM ==0" 1 "SY_BOGALIM ==1" /end COMPU_VTAB
/begin COMPU_METHOD SY_BPEZEK_Compu "" TAB_VERB "%6.3" "" COMPU_TAB_REF SY_BPEZEK_Compu /end COMPU_METHOD
/begin COMPU_VTAB SY_BPEZEK_Compu "" TAB_VERB 2 0 "False" 1 "True" /end COMPU_VTAB
/begin COMPU_METHOD SY_CACTP11_Compu "" TAB_VERB "%6.3" "" COMPU_TAB_REF SY_CACTP11_Compu /end COMPU_METHOD
/begin COMPU_VTAB SY_CACTP11_Compu "" TAB_VERB 7 0 "no sensor" 1 "TFA1" 2 "TFA2" 3 "TFA3" 4 "TFA4" 5 "TFA5" 6 "TFA6" /end COMPU_VTAB
/begin COMPU_METHOD SY_CACTP12_Compu "" TAB_VERB "%6.3" "" COMPU_TAB_REF SY_CACTP12_Compu /end COMPU_METHOD
/begin COMPU_VTAB SY_CACTP12_Compu "" TAB_VERB 7 0 "no sensor" 1 "TFA1" 2 "TFA2" 3 "TFA3" 4 "TFA4" 5 "TFA5" 6 "TFA6" /end COMPU_VTAB
/begin COMPU_METHOD SY_CACTP21_Compu "" TAB_VERB "%6.3" "" COMPU_TAB_REF SY_CACTP21_Compu /end COMPU_METHOD
/begin COMPU_VTAB SY_CACTP21_Compu "" TAB_VERB 7 0 "no sensor" 1 "TFA1" 2 "TFA2" 3 "TFA3" 4 "TFA4" 5 "TFA5" 6 "TFA6" /end COMPU_VTAB
/begin COMPU_METHOD t1msxs_b65p535 "" RAT_FUNC "%6.5" "s" COEFFS 0 65535 0 0 0 65.535 /end COMPU_METHOD
/begin COMPU_METHOD Temp_Cels "" RAT_FUNC "%6.1" "deg C" COEFFS 0 10 2731.4 0 0 1 /end COMPU_METHOD
/begin COMPU_METHOD TimeDelay_s "" RAT_FUNC "%6.1" "s" COEFFS 0 0 1 0 0.00023283064365387 0 /end COMPU_METHOD
/begin COMPU_METHOD TimeRed "" RAT_FUNC "%6.3" "s" COEFFS 0 6.25 0 0 0 1 /end COMPU_METHOD
/begin COMPU_METHOD Time_Dt "" RAT_FUNC "%9.8" "s" COEFFS 0 1000000 0 0 0 1 /end COMPU_METHOD
/begin COMPU_METHOD Time_sec_q1_COMPU "" RAT_FUNC "%6.2" "s" COEFFS 0 1 0 0 0 1 /end COMPU_METHOD
/begin COMPU_METHOD TransR "" RAT_FUNC "%6.4" "-" COEFFS 0 100 0 0 0 1 /end COMPU_METHOD
/begin COMPU_METHOD Trq "" RAT_FUNC "%6.3" "Nm" COEFFS 0 10 0 0 0 1 /end COMPU_METHOD
/begin COMPU_METHOD TrqPrpHigh "" RAT_FUNC "%6.3" "Nm" COEFFS 0 10 0 0 0 1 /end COMPU_METHOD
/begin COMPU_METHOD tsquant_l "" RAT_FUNC "%6.4" "us" COEFFS 0 20 0 0 0 1 /end COMPU_METHOD
/begin COMPU_METHOD t_q0p05 "" RAT_FUNC "%6.4" "s" COEFFS 0 100 0 0 0 5 /end COMPU_METHOD
/begin COMPU_METHOD t_q0p1 "" RAT_FUNC "%6.3" "s" COEFFS 0 10 0 0 0 1 /end COMPU_METHOD
/begin COMPU_METHOD Vel "" RAT_FUNC "%6.4" "km/h" COEFFS 0 100 0 0 0 1 /end COMPU_METHOD
/begin COMPU_METHOD vfzg_uw_b325 "" RAT_FUNC "%6.4" "km/h" COEFFS 0 65536 0 0 0 325 /end COMPU_METHOD
/begin COMPU_METHOD vfzg_uw_b90_m_DIV_s "" RAT_FUNC "%6.4" "m/s" COEFFS 0 65536 0 0 0 90.278 /end COMPU_METHOD
/begin COMPU_METHOD yaw_rate_real "" RAT_FUNC "%6.2" "rad/s" COEFFS 0 1 0 0 0 1 /end COMPU_METHOD
/begin COMPU_METHOD zw_sb_q0p75 "" RAT_FUNC "%6.3" "Grad KW" COEFFS 0 255 0 0 0 191.25 /end COMPU_METHOD
/begin RECORD_LAYOUT KwUb FNC_VALUES 1 UBYTE COLUMN_DIR DIRECT /end RECORD_LAYOUT
/begin RECORD_LAYOUT RB_Axis_S16 NO_AXIS_PTS_X 1 SWORD AXIS_PTS_X 2 SWORD INDEX_INCR DIRECT /end RECORD_LAYOUT
/begin RECORD_LAYOUT RB_Axis_S8 NO_AXIS_PTS_X 1 SBYTE AXIS_PTS_X 2 SBYTE INDEX_INCR DIRECT /end RECORD_LAYOUT
/begin RECORD_LAYOUT RB_Axis_U16 NO_AXIS_PTS_X 1 UWORD AXIS_PTS_X 2 UWORD INDEX_INCR DIRECT /end RECORD_LAYOUT
/begin RECORD_LAYOUT RB_CurveGroup_S16 FNC_VALUES 1 SWORD COLUMN_DIR DIRECT /end RECORD_LAYOUT
/begin RECORD_LAYOUT RB_CurveGroup_U16 FNC_VALUES 1 UWORD COLUMN_DIR DIRECT /end RECORD_LAYOUT
/begin RECORD_LAYOUT RB_Curve_S16_S16 NO_AXIS_PTS_X 1 SWORD AXIS_PTS_X 2 SWORD INDEX_INCR DIRECT FNC_VALUES 3 SWORD COLUMN_DIR DIRECT /end RECORD_LAYOUT
/begin RECORD_LAYOUT RB_Curve_S16_S8_Static NO_AXIS_PTS_X 1 SWORD AXIS_PTS_X 2 SWORD INDEX_INCR DIRECT FNC_VALUES 3 SBYTE COLUMN_DIR DIRECT STATIC_RECORD_LAYOUT /end RECORD_LAYOUT
/begin RECORD_LAYOUT RB_Curve_S16_U16_Static NO_AXIS_PTS_X 1 SWORD AXIS_PTS_X 2 SWORD INDEX_INCR DIRECT FNC_VALUES 3 UWORD COLUMN_DIR DIRECT STATIC_RECORD_LAYOUT /end RECORD_LAYOUT
/begin RECORD_LAYOUT RB_Curve_S16_U8_Static NO_AXIS_PTS_X 1 SWORD AXIS_PTS_X 2 SWORD INDEX_INCR DIRECT FNC_VALUES 3 UBYTE COLUMN_DIR DIRECT STATIC_RECORD_LAYOUT /end RECORD_LAYOUT
/begin RECORD_LAYOUT RB_Curve_U16_U8_Static NO_AXIS_PTS_X 1 UWORD AXIS_PTS_X 2 UWORD INDEX_INCR DIRECT FNC_VALUES 3 UBYTE COLUMN_DIR DIRECT STATIC_RECORD_LAYOUT /end RECORD_LAYOUT
/begin RECORD_LAYOUT RB_FixMap_S16S16_S16 FNC_VALUES 1 SWORD COLUMN_DIR DIRECT /end RECORD_LAYOUT
/begin RECORD_LAYOUT RB_MapGroup_S16 FNC_VALUES 1 SWORD COLUMN_DIR DIRECT /end RECORD_LAYOUT
/begin RECORD_LAYOUT RB_Map_S16S16_U16 NO_AXIS_PTS_X 1 SWORD NO_AXIS_PTS_Y 2 SWORD AXIS_PTS_X 3 SWORD INDEX_INCR DIRECT AXIS_PTS_Y 4 SWORD INDEX_INCR DIRECT FNC_VALUES 5 UWORD COLUMN_DIR DIRECT /end RECORD_LAYOUT
/begin RECORD_LAYOUT RB_Map_S16U16_U16 NO_AXIS_PTS_X 1 SWORD NO_AXIS_PTS_Y 2 SWORD AXIS_PTS_X 3 SWORD INDEX_INCR DIRECT AXIS_PTS_Y 4 UWORD INDEX_INCR DIRECT FNC_VALUES 5 UWORD ROW_DIR DIRECT /end RECORD_LAYOUT
/begin RECORD_LAYOUT RB_Map_S16U8_S16 NO_AXIS_PTS_X 1 SWORD NO_AXIS_PTS_Y 2 SWORD AXIS_PTS_X 3 SWORD INDEX_INCR DIRECT AXIS_PTS_Y 4 UBYTE INDEX_INCR DIRECT FNC_VALUES 5 SWORD COLUMN_DIR DIRECT /end RECORD_LAYOUT
/begin RECORD_LAYOUT RB_Map_S8S16_S16 NO_AXIS_PTS_X 1 SBYTE NO_AXIS_PTS_Y 2 SBYTE AXIS_PTS_X 3 SBYTE INDEX_INCR DIRECT AXIS_PTS_Y 4 SWORD INDEX_INCR DIRECT FNC_VALUES 5 SWORD ROW_DIR DIRECT /end RECORD_LAYOUT
/begin RECORD_LAYOUT RB_Map_S8U16_S16 NO_AXIS_PTS_X 1 SBYTE NO_AXIS_PTS_Y 2 SBYTE AXIS_PTS_X 3 SBYTE INDEX_INCR DIRECT AXIS_PTS_Y 4 UWORD INDEX_INCR DIRECT FNC_VALUES 5 SWORD ROW_DIR DIRECT /end RECORD_LAYOUT
/begin RECORD_LAYOUT RB_Map_U16S16_S16 NO_AXIS_PTS_X 1 UWORD NO_AXIS_PTS_Y 2 UWORD AXIS_PTS_X 3 UWORD INDEX_INCR DIRECT AXIS_PTS_Y 4 SWORD INDEX_INCR DIRECT FNC_VALUES 5 SWORD COLUMN_DIR DIRECT /end RECORD_LAYOUT
/begin RECORD_LAYOUT RB_Map_U16S16_S8 NO_AXIS_PTS_X 1 UWORD NO_AXIS_PTS_Y 2 UWORD AXIS_PTS_X 3 UWORD INDEX_INCR DIRECT AXIS_PTS_Y 4 SWORD INDEX_INCR DIRECT FNC_VALUES 5 SBYTE COLUMN_DIR DIRECT /end RECORD_LAYOUT
/begin RECORD_LAYOUT RB_Map_U16S16_U16 NO_AXIS_PTS_X 1 UWORD NO_AXIS_PTS_Y 2 UWORD AXIS_PTS_X 3 UWORD INDEX_INCR DIRECT AXIS_PTS_Y 4 SWORD INDEX_INCR DIRECT FNC_VALUES 5 UWORD COLUMN_DIR DIRECT /end RECORD_LAYOUT
/begin RECORD_LAYOUT RB_Map_U16S16_U8 NO_AXIS_PTS_X 1 UWORD NO_AXIS_PTS_Y 2 UWORD AXIS_PTS_X 3 UWORD INDEX_INCR DIRECT AXIS_PTS_Y 4 SWORD INDEX_INCR DIRECT FNC_VALUES 5 UBYTE COLUMN_DIR DIRECT /end RECORD_LAYOUT
/begin RECORD_LAYOUT RB_ValA_Wu16 FNC_VALUES 1 UWORD COLUMN_DIR DIRECT /end RECORD_LAYOUT
/begin RECORD_LAYOUT RB_ValA_Wu8 FNC_VALUES 1 UBYTE COLUMN_DIR DIRECT /end RECORD_LAYOUT
/begin RECORD_LAYOUT RB_Val_Ws16 FNC_VALUES 1 SWORD COLUMN_DIR DIRECT /end RECORD_LAYOUT
/begin RECORD_LAYOUT RB_Val_Ws32 FNC_VALUES 1 SLONG COLUMN_DIR DIRECT /end RECORD_LAYOUT
/begin RECORD_LAYOUT RB_Val_Ws8 FNC_VALUES 1 SBYTE COLUMN_DIR DIRECT /end RECORD_LAYOUT
/begin RECORD_LAYOUT RB_Val_Wu16 FNC_VALUES 1 UWORD COLUMN_DIR DIRECT /end RECORD_LAYOUT
/begin RECORD_LAYOUT RB_Val_Wu32 FNC_VALUES 1 ULONG COLUMN_DIR DIRECT /end RECORD_LAYOUT
/begin RECORD_LAYOUT RB_Val_Wu8 FNC_VALUES 1 UBYTE COLUMN_DIR DIRECT /end RECORD_LAYOUT
/begin RECORD_LAYOUT Val_Wu16 FNC_VALUES 1 UWORD COLUMN_DIR DIRECT /end RECORD_LAYOUT
/begin RECORD_LAYOUT Val_Wu8 FNC_VALUES 1 UBYTE COLUMN_DIR DIRECT /end RECORD_LAYOUT
/end MODULE
/end PROJECT
