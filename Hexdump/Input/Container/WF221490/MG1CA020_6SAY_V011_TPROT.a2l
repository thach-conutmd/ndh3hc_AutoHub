ASAP2_VERSION 1 60
/begin PROJECT MG1CA020 "MG1CA020"
/begin HEADER "" VERSION "MG1CA020_6SAY_V011_TPROT" PROJECT_NO MG1CA020 /end HEADER
/begin MODULE DIM ""
/begin MOD_COMMON "" BYTE_ORDER MSB_LAST ALIGNMENT_BYTE 1 ALIGNMENT_WORD 2 ALIGNMENT_LONG 4 ALIGNMENT_INT64 4 ALIGNMENT_FLOAT32_IEEE 4 ALIGNMENT_FLOAT64_IEEE 4 DATA_SIZE 32 /end MOD_COMMON
/begin CHARACTERISTIC AirMod_nrSyncAirChrgPredOff_C "Offset for the amount of cylinders between charge and charge prediction" VALUE 0x80507922 RB_Val_Ws8 255.0 OneToOne -128.0 127.0 FORMAT "%5.1" /end CHARACTERISTIC
/begin CHARACTERISTIC Blwr_uComBlwrURepl_C "AC-blower voltage replacement value in came of communication error" VALUE 0x80507BC6 RB_Val_Ws16 65535.00 Volt_q1 -32768.00 32767.00 FORMAT "%8.2" /end CHARACTERISTIC
/begin CHARACTERISTIC BrkBstP_aDecelBrkThdMax_C "Maximum deceleration brake threshold" VALUE 0x80507BC8 RB_Val_Ws16 65.53500 Acc -32.76800 32.76700 FORMAT "%8.5" /end CHARACTERISTIC
/begin CHARACTERISTIC BrkBstP_aDecelBrkThdMin_C "Minimum deceleration brake threshold" VALUE 0x80507BCA RB_Val_Ws16 65.53500 Acc -32.76800 32.76700 FORMAT "%8.5" /end CHARACTERISTIC
/begin CHARACTERISTIC BrkBstP_cntMstCylPVal_C "Frequency of integral calculation of master cylinder hydraulic pressure learning value" VALUE 0x80507BCC RB_Val_Wu16 65535.00 OneToOne 0.00 65535.00 FORMAT "%8.2" /end CHARACTERISTIC
/begin CHARACTERISTIC BrkBstP_ctDriftHi_C "High drift error counter threshold" VALUE 0x80507BCE RB_Val_Wu16 65535.00 OneToOne 0.00 65535.00 FORMAT "%8.2" /end CHARACTERISTIC
/begin CHARACTERISTIC BrkBstP_ctDriftLo_C "Low drift error counter threshold" VALUE 0x80507BD0 RB_Val_Wu16 65535.00 OneToOne 0.00 65535.00 FORMAT "%8.2" /end CHARACTERISTIC
/begin CHARACTERISTIC BrkBstP_ctVehStopThd_C "Vehicle stop count threshold" VALUE 0x80507BD2 RB_Val_Wu16 65535.00 OneToOne 0.00 65535.00 FORMAT "%8.2" /end CHARACTERISTIC
/begin CHARACTERISTIC BrkBstP_dpMstCyl_C "Change in master cylinder pressure limit" VALUE 0x80507BD4 RB_Val_Ws32 214748364.700 Pres 0.00 214748364.700 FORMAT "%13.3" EXTENDED_LIMITS -214748364.800 214748364.700 /end CHARACTERISTIC
/begin CHARACTERISTIC BrkBstP_flgSwtActv_C "Calibration switch to enable and disable the functionality" VALUE 0x80507BD8 RB_Val_Wu8 1.000 OneToOne 0.00 1.000 FORMAT "%5.3" EXTENDED_LIMITS 0.00 255.0 /end CHARACTERISTIC
/begin CHARACTERISTIC BrkBstP_nVacPmp_C "Vacuum pump working speed" VALUE 0x80507BDA RB_Val_Ws16 32767.50 EngN -16384.00 16383.50 FORMAT "%8.2" /end CHARACTERISTIC
/begin CHARACTERISTIC BrkBstP_pBrkBoostDiffThd_C "Difference in brake boost pressure threshold for stuck error finding" VALUE 0x80507BDC RB_Val_Ws32 4294967295.00 Pres_hPa -2147483648.00 2147483647.00 FORMAT "%13.2" /end CHARACTERISTIC
/begin CHARACTERISTIC BrkBstP_pBrkNotPsd_C "Brake pressure when brake pedal not pressed" VALUE 0x80507BE0 RB_Val_Ws32 429496729.500 Pres -214748364.800 214748364.700 FORMAT "%13.3" /end CHARACTERISTIC
/begin CHARACTERISTIC BrkBstP_pCmpFldThd_C "Threshold value for Compensated Brake pressure value" VALUE 0x80507BE4 RB_Val_Ws32 429496729.500 Pres -214748364.800 214748364.700 FORMAT "%13.3" /end CHARACTERISTIC
/begin CHARACTERISTIC BrkBstP_pDifQntyHi_C "The amount limit value of zero hydraulic pressure correction value change iDifference quantity large j" VALUE 0x80507BE8 RB_Val_Ws32 429496729.500 Pres -214748364.800 214748364.700 FORMAT "%13.3" /end CHARACTERISTIC
/begin CHARACTERISTIC BrkBstP_pDifQntyLo_C "The amount limit value of zero hydraulic pressure correction value change iDifference quantity small j" VALUE 0x80507BEC RB_Val_Ws32 429496729.500 Pres -214748364.800 214748364.700 FORMAT "%13.3" /end CHARACTERISTIC
/begin CHARACTERISTIC BrkBstP_pDifQntyLrgJdg_C "Difference quantity large judgment value of zero hydraulic pressure learning value and correction value" VALUE 0x80507BF0 RB_Val_Ws32 429496729.500 Pres -214748364.800 214748364.700 FORMAT "%13.3" /end CHARACTERISTIC
/begin CHARACTERISTIC BrkBstP_pDifQntyMid_C "The amount limit value of zero hydraulic pressure correction value change iDifference quantity middle j" VALUE 0x80507BF4 RB_Val_Ws32 429496729.500 Pres -214748364.800 214748364.700 FORMAT "%13.3" /end CHARACTERISTIC
/begin CHARACTERISTIC BrkBstP_pDifQntySmallJdg_C "Difference quantity smallness judgment value of zero hydraulic pressure learning value and correction value" VALUE 0x80507BF8 RB_Val_Ws32 429496729.500 Pres -214748364.800 214748364.700 FORMAT "%13.3" /end CHARACTERISTIC
/begin CHARACTERISTIC BrkBstP_pDriftHiThd_C "High saturated limit of brake booster pressure for drift error check" VALUE 0x80507BFC RB_Val_Ws16 65535.00 Pres_hPa -32768.00 32767.00 FORMAT "%8.2" /end CHARACTERISTIC
/begin CHARACTERISTIC BrkBstP_pDriftLoThd_C "Low saturated limit of brake booster pressure for drift error check" VALUE 0x80507BFE RB_Val_Ws16 65535.00 Pres_hPa -32768.00 32767.00 FORMAT "%8.2" /end CHARACTERISTIC
/begin CHARACTERISTIC BrkBstP_pFldPOffsMaxVal_C "Maximum Master cylinder hydraulic pressure receiving value" VALUE 0x80507C00 RB_Val_Ws32 429496729.500 Pres -214748364.800 214748364.700 FORMAT "%13.3" /end CHARACTERISTIC
/begin CHARACTERISTIC BrkBstP_pFldPOffsMinVal_C "Minimum Master cylinder hydraulic pressure receiving value" VALUE 0x80507C04 RB_Val_Ws32 429496729.500 Pres -214748364.800 214748364.700 FORMAT "%13.3" /end CHARACTERISTIC
/begin CHARACTERISTIC BrkBstP_pMstCylMax_C "Allowed master cylinder maximum threshold" VALUE 0x80507C08 RB_Val_Ws32 429496729.500 Pres -214748364.800 214748364.700 FORMAT "%13.3" /end CHARACTERISTIC
/begin CHARACTERISTIC BrkBstP_pMstCylMin_C "Allowed master cylinder minimum threshold" VALUE 0x80507C0C RB_Val_Ws32 429496729.500 Pres -214748364.800 214748364.700 FORMAT "%13.3" /end CHARACTERISTIC
/begin CHARACTERISTIC BrkBstP_pMstCylPIniVal_C "Zero master cylinder hydraulic pressure adjustment initial value" VALUE 0x80507C10 RB_Val_Ws32 429496729.500 Pres -214748364.800 214748364.700 FORMAT "%13.3" /end CHARACTERISTIC
/begin CHARACTERISTIC BrkBstP_pMstCylSatMax_C "Maximum master cylinder saturated pressure" VALUE 0x80507C14 RB_Val_Ws32 429496729.500 Pres -214748364.800 214748364.700 FORMAT "%13.3" /end CHARACTERISTIC
/begin CHARACTERISTIC BrkBstP_pMstCYlSatMin_C "Minimum master cylinder saturated pressure" VALUE 0x80507C18 RB_Val_Ws32 429496729.500 Pres -214748364.800 214748364.700 FORMAT "%13.3" /end CHARACTERISTIC
/begin CHARACTERISTIC BrkBstP_pOutpEnaMask_C "Master cylinder pressure enable mask" VALUE 0x80507C1C RB_Val_Ws16 1570219. Pres_kPa_VSA -785121.3 785097.3 FORMAT "%8.1" /end CHARACTERISTIC
/begin CHARACTERISTIC BrkBstP_pRawFldPStabyVal_C "The hydraulic pressure value permission range of fluctuation under learning" VALUE 0x80507C20 RB_Val_Ws32 429496729.500 Pres -214748364.800 214748364.700 FORMAT "%13.3" /end CHARACTERISTIC
/begin CHARACTERISTIC BrkBstP_pVacPOffsVal_C "Vacuum pressure offset value" VALUE 0x80507C24 RB_Val_Ws32 429496729.500 Pres -214748364.800 214748364.700 FORMAT "%13.3" /end CHARACTERISTIC
/begin CHARACTERISTIC BrkBstP_rAccPedThd_C "Accpedal threshold value for brake fluid pressure condition calculation" VALUE 0x80507C28 RB_Val_Ws16 799.9878 Prc -400.0000 399.9878 FORMAT "%8.4" /end CHARACTERISTIC
/begin CHARACTERISTIC BrkBstP_stFldPOffsMeasCdnMsk_C "Judgment master cylinder hydraulic pressure zero point learning permission conditon mask" VALUE 0x80507C2A RB_Val_Wu16 65535.00 OneToOne 0.00 65535.00 FORMAT "%8.2" /end CHARACTERISTIC
/begin CHARACTERISTIC BrkBstP_stStopRelsMaskSeln_C "Stop release mask selection" VALUE 0x80507C2C RB_Val_Wu32 4294967295.00 OneToOne 0.00 4294967295.00 FORMAT "%13.2" /end CHARACTERISTIC
/begin CHARACTERISTIC BrkBstP_stStopRelsMask_C "Stop release mask" VALUE 0x80507C30 RB_Val_Wu32 4294967295.00 OneToOne 0.00 4294967295.00 FORMAT "%13.2" /end CHARACTERISTIC
/begin CHARACTERISTIC BrkBstP_swtHSAEna_C "Hill start switch enable status" VALUE 0x80507C34 RB_Val_Wu8 1.00000000000 B_TRUE 0.00 1.00000000000 FORMAT "%13.11" /end CHARACTERISTIC
/begin CHARACTERISTIC BrkBstP_tiABSVSADi_C "Delay time for ABS and VSA when it is disabled" VALUE 0x80507C36 RB_Val_Wu16 655.3500 Time_s 0.00 655.3500 FORMAT "%8.4" /end CHARACTERISTIC
/begin CHARACTERISTIC BrkBstP_tiAYCEna_C "AYC activation time" VALUE 0x80507C38 RB_Val_Wu32 327670.000000 Time_ms 0.00 327670.000000 FORMAT "%13.6" EXTENDED_LIMITS 0.00 42949672950.0 /end CHARACTERISTIC
/begin CHARACTERISTIC BrkBstP_tiDecelBrkDetn_C "Debounce to detect deceleration by brake" VALUE 0x80507C3C RB_Val_Ws32 21474836.4700 Time_s 0.00 21474836.4700 FORMAT "%13.4" EXTENDED_LIMITS -21474836.4800 21474836.4700 /end CHARACTERISTIC
/begin CHARACTERISTIC BrkBstP_tiDriftErrRelsThd_C "Drift error release time threshold" VALUE 0x80507C40 RB_Val_Ws32 21474836.4700 Time_s 0.00 21474836.4700 FORMAT "%13.4" EXTENDED_LIMITS -21474836.4800 21474836.4700 /end CHARACTERISTIC
/begin CHARACTERISTIC BrkBstP_tiDriftHiMax_C "Debouncing the brake booster pressure drift on high side maximum" VALUE 0x80507C44 RB_Val_Ws16 327.6700 Time_s 0.00 327.6700 FORMAT "%8.4" EXTENDED_LIMITS -327.6800 327.6700 /end CHARACTERISTIC
/begin CHARACTERISTIC BrkBstP_tiDriftHiMin_C "Debouncing the brake booster pressure drift on high side minimum" VALUE 0x80507C46 RB_Val_Ws16 327.6700 Time_s 0.00 327.6700 FORMAT "%8.4" EXTENDED_LIMITS -327.6800 327.6700 /end CHARACTERISTIC
/begin CHARACTERISTIC BrkBstP_tiDriftLoMax_C "Debouncing the brake booster pressure drift on low side maximum" VALUE 0x80507C48 RB_Val_Ws16 327.6700 Time_s 0.00 327.6700 FORMAT "%8.4" EXTENDED_LIMITS -327.6800 327.6700 /end CHARACTERISTIC
/begin CHARACTERISTIC BrkBstP_tiDriftLoMin_C "Debouncing the brake booster pressure drift on low side minimum" VALUE 0x80507C4A RB_Val_Ws16 327.6700 Time_s 0.00 327.6700 FORMAT "%8.4" EXTENDED_LIMITS -327.6800 327.6700 /end CHARACTERISTIC
/begin CHARACTERISTIC BrkBstP_tiDriftTmrFrz_C "Minimum time beween drift error check" VALUE 0x80507C4C RB_Val_Ws16 327.6700 Time_s 0.00 327.6700 FORMAT "%8.4" EXTENDED_LIMITS -327.6800 327.6700 /end CHARACTERISTIC
/begin CHARACTERISTIC BrkBstP_tiMstCylPStabyThd_C "Threshold time for Master cylinder stability check" VALUE 0x80507C50 RB_Val_Ws32 21474836.4700 Time_s 0.00 21474836.4700 FORMAT "%13.4" EXTENDED_LIMITS -21474836.4800 21474836.4700 /end CHARACTERISTIC
/begin CHARACTERISTIC BrkBstP_tiMstCylPT1_C "Master cylinder brake pressure filtering time" VALUE 0x80507C54 RB_Val_Ws32 4294.9672940000000 TimeDelay_s 0.0000020000000 4294.9672959999998 FORMAT "%19.14" EXTENDED_LIMITS 0.000002000000001 4294.9672959999998 /end CHARACTERISTIC
/begin CHARACTERISTIC BrkBstP_tiVacBoostPT1_C "Vacuum booster pressure filtering time" VALUE 0x80507C58 RB_Val_Ws32 4294.9672940000000 TimeDelay_s 0.0000020000000 4294.9672959999998 FORMAT "%19.14" EXTENDED_LIMITS 0.000002000000001 4294.9672959999998 /end CHARACTERISTIC
/begin CHARACTERISTIC BrkBstP_tiVehAPT1_C "Vehcile acceleration filtering time" VALUE 0x80507C5C RB_Val_Ws32 4294.9672940000000 TimeDelay_s 0.0000020000000 4294.9672959999998 FORMAT "%19.14" EXTENDED_LIMITS 0.000002000000001 4294.9672959999998 /end CHARACTERISTIC
/begin CHARACTERISTIC BrkBstP_tiVehStopDly_C "Vehicle stop confirmation delay" VALUE 0x80507C60 RB_Val_Wu16 655.3500 Time_s 0.00 655.3500 FORMAT "%8.4" /end CHARACTERISTIC
/begin CHARACTERISTIC BrkBstP_tiVehVPT1_C "Vehicle velocity filtering time" VALUE 0x80507C64 RB_Val_Ws32 4294.9672940000000 TimeDelay_s 0.0000020000000 4294.9672959999998 FORMAT "%19.14" EXTENDED_LIMITS 0.000002000000001 4294.9672959999998 /end CHARACTERISTIC
/begin CHARACTERISTIC BrkBstP_vRunngThd_C "Vehicle running threshold" VALUE 0x80507C68 RB_Val_Ws16 655.3500 Vel -327.6800 327.6700 FORMAT "%8.4" /end CHARACTERISTIC
/begin CHARACTERISTIC BrkBstP_vStopThd_C "Vehicle stop threshold" VALUE 0x80507C6A RB_Val_Ws16 655.3500 Vel -327.6800 327.6700 FORMAT "%8.4" /end CHARACTERISTIC
/begin CHARACTERISTIC BrkBstP_vVehSpdThd_C "Vehicle speed threshold value for brake fluid pressure condition calculation" VALUE 0x80507C6C RB_Val_Ws16 655.3500 Vel -327.6800 327.6700 FORMAT "%8.4" /end CHARACTERISTIC
/begin CHARACTERISTIC BrkPed_aEBBSlopHi_C "Threshold slope for detection of slope high flag." VALUE 0x80507C70 RB_Val_Ws16 65.53500 RBPtCel_m_0p001_1 -32.76800 32.76700 FORMAT "%8.5" /end CHARACTERISTIC
/begin CHARACTERISTIC BrkPed_aGrdtFildDifThd_C "Threshold for maximum difference allowed between gradient sampes collected received during window period for vehicle standstill detection" VALUE 0x80507C72 RB_Val_Ws16 65.53500 RBPtCel_m_0p001_1 -32.76800 32.76700 FORMAT "%8.5" /end CHARACTERISTIC
/begin CHARACTERISTIC BrkPed_aGrdtHiLimForISAB_C "Higher gradient limit to disallow Idle stop" VALUE 0x80507C74 RB_Val_Ws16 65.53500 RBPtCel_m_0p001_1 -32.76800 32.76700 FORMAT "%8.5" /end CHARACTERISTIC
/begin CHARACTERISTIC BrkPed_aGrdtLoLimForISAB_C "Lower gradient limit to disallow Idle stop" VALUE 0x80507C76 RB_Val_Ws16 65.53500 RBPtCel_m_0p001_1 -32.76800 32.76700 FORMAT "%8.5" /end CHARACTERISTIC
/begin CHARACTERISTIC BrkPed_aSlopNeg_C "The negative slope threshold gradient value" VALUE 0x80507C78 RB_Val_Ws16 65.53500 RBPtCel_m_0p001_1 -32.76800 32.76700 FORMAT "%8.5" /end CHARACTERISTIC
/begin CHARACTERISTIC BrkPed_aSlopPos_C "The positive slope threshold gradient value" VALUE 0x80507C7A RB_Val_Ws16 65.53500 RBPtCel_m_0p001_1 -32.76800 32.76700 FORMAT "%8.5" /end CHARACTERISTIC
/begin CHARACTERISTIC BrkPed_cntrISABRlsThd_T "Counter threshold to disable ISAB function" CURVE 0x80507C7C RB_Curve_S16_S16 327.6700 Fact_100 0.00 327.6700 FORMAT "%8.4" EXTENDED_LIMITS -327.6800 327.6700
 /begin AXIS_DESCR STD_AXIS BrkPed_aGrdtFild RBPtCel_m_0p001_1 10 -32.76800 32.76700 FORMAT "%8.5" DEPOSIT ABSOLUTE /end AXIS_DESCR
/end CHARACTERISTIC
/begin CHARACTERISTIC BrkPed_cntStepISABRls_T "Curve to determine the counter increment value in every raster based on Accelerator pedal ratio" CURVE 0x80507CA6 RB_Curve_S16_S16 327.6700 Fact_100 0.00 327.6700 FORMAT "%8.4" EXTENDED_LIMITS -327.6800 327.6700
 /begin AXIS_DESCR STD_AXIS VMD_rVirtAPP Prc 11 -400.0000 399.9878 FORMAT "%8.4" DEPOSIT ABSOLUTE /end AXIS_DESCR
/end CHARACTERISTIC
/begin CHARACTERISTIC BrkPed_flgSwtISABAvl_C "ISAB available flag" VALUE 0x80507CD4 RB_Val_Wu8 1.00000000000 B_TRUE 0.00 1.00000000000 FORMAT "%13.11" /end CHARACTERISTIC
/begin CHARACTERISTIC BrkPed_flgSwtVehStandStillJdg_C "Calibration switch for selection of vehicle standstill judgement method" VALUE 0x80507CD5 RB_Val_Wu8 1.00000000000 B_TRUE 0.00 1.00000000000 FORMAT "%13.11" /end CHARACTERISTIC
/begin CHARACTERISTIC BrkPed_nEngISABThd_C "Engine speed threhold above which ISAB cancellation request will be calculated" VALUE 0x80507CD6 RB_Val_Ws16 32767.50 EngN -16384.00 16383.50 FORMAT "%8.2" /end CHARACTERISTIC
/begin CHARACTERISTIC BrkPed_pEngStopDisbl_M "MAP for upper threshold of Hysteresis function of engine start request based on brake pressure" MAP 0x80507CD8 RB_Map_S16S16_S16 65535.00 Pres_hPa -32768.00 32767.00 FORMAT "%8.2"
 /begin AXIS_DESCR STD_AXIS NO_INPUT_QUANTITY Pres_hPa 5 -32768.00 32767.00 FORMAT "%8.2" DEPOSIT ABSOLUTE /end AXIS_DESCR
 /begin AXIS_DESCR STD_AXIS GlbDa_vX Vel 5 -327.6800 327.6700 FORMAT "%8.4" DEPOSIT ABSOLUTE /end AXIS_DESCR
/end CHARACTERISTIC
/begin CHARACTERISTIC BrkPed_pEngStopEna_M "MAP for lower threshold of Hysteresis function for engine start request based on brake pressure" MAP 0x80507D22 RB_Map_S16S16_S16 65535.00 Pres_hPa -32768.00 32767.00 FORMAT "%8.2"
 /begin AXIS_DESCR STD_AXIS NO_INPUT_QUANTITY Pres_hPa 5 -32768.00 32767.00 FORMAT "%8.2" DEPOSIT ABSOLUTE /end AXIS_DESCR
 /begin AXIS_DESCR STD_AXIS GlbDa_vX Vel 5 -327.6800 327.6700 FORMAT "%8.4" DEPOSIT ABSOLUTE /end AXIS_DESCR
/end CHARACTERISTIC
/begin CHARACTERISTIC BrkPed_pEnvPMax_C "threshold for environmental pressure for engine start request based on brake pressure" VALUE 0x80507D6C RB_Val_Ws16 65535.00 Pres_hPa -32768.00 32767.00 FORMAT "%8.2" /end CHARACTERISTIC
/begin CHARACTERISTIC BrkPed_swtBrkBstPSeln_C "Switch to select brake booster pressure" VALUE 0x80507D6E RB_Val_Wu8 1.00000000000 B_TRUE 0.00 1.00000000000 FORMAT "%13.11" /end CHARACTERISTIC
/begin CHARACTERISTIC BrkPed_swtBrkStrtEna_C "Switch to activate brake pedal condition for the brake negative" VALUE 0x80507D6F RB_Val_Wu8 1.00000000000 B_TRUE 0.00 1.00000000000 FORMAT "%13.11" /end CHARACTERISTIC
/begin CHARACTERISTIC BrkPed_swtEVPECUEna_C "Switch to select an algortithm either with or without EVP-ECU" VALUE 0x80507D70 RB_Val_Wu8 1.00000000000 B_TRUE 0.00 1.00000000000 FORMAT "%13.11" /end CHARACTERISTIC
/begin CHARACTERISTIC BrkPed_tiEBBSlopDetn_C "Threshold time for calculation of slope." VALUE 0x80507D72 RB_Val_Wu16 655350.0 Time_ms 0.00 655350.0 FORMAT "%8.1" /end CHARACTERISTIC
/begin CHARACTERISTIC BrkPed_tiEBBSlopRst_C "Threshold time for reset of slope." VALUE 0x80507D74 RB_Val_Wu16 655350.0 Time_ms 0.00 655350.0 FORMAT "%8.1" /end CHARACTERISTIC
/begin CHARACTERISTIC BrkPed_tiSnsrFailHeal_C "Minimum time to confirm sensor failure is healed to allow ISAB." VALUE 0x80507D76 RB_Val_Wu16 655.3500 Time_s 0.00 655.3500 FORMAT "%8.4" /end CHARACTERISTIC
/begin CHARACTERISTIC BrkPed_tiVehStandStillJdgThd1_C "First calibration time period after which vehicle standstill judgement shall be performed" VALUE 0x80507D78 RB_Val_Ws16 655.3500 Time_s -327.6800 327.6700 FORMAT "%8.4" /end CHARACTERISTIC
/begin CHARACTERISTIC BrkPed_tiVehStandStillJdgThd2_C "Second calibration time period after which vehicle standstill judgement must be performed" VALUE 0x80507D7A RB_Val_Ws16 655.3500 Time_s -327.6800 327.6700 FORMAT "%8.4" /end CHARACTERISTIC
/begin CHARACTERISTIC BrkPed_tiVehStandStill_C "Time after which vehicle stand still condition is confirmed" VALUE 0x80507D7C RB_Val_Wu16 655.3500 Time_s 0.00 655.3500 FORMAT "%8.4" /end CHARACTERISTIC
/begin CHARACTERISTIC BrkPed_tiVSAGrdtPT1_C "PT1 filter time parameter for filtering of VSA gradient information" VALUE 0x80507D7E RB_Val_Ws16 655.3500 Time_s -327.6800 327.6700 FORMAT "%8.4" /end CHARACTERISTIC
/begin CHARACTERISTIC BrkPed_tiWinPerdGrdtChk_C "Calibration for window period for collecting gradient samples for vehicle standstill judgement" VALUE 0x80507D80 RB_Val_Ws16 1000.000 Time_ms_20ms 0.00 1000.000 FORMAT "%8.3" EXTENDED_LIMITS -655360.0 655340.0 /end CHARACTERISTIC
/begin CHARACTERISTIC BrkPed_tqBrkOffsThdForIS_C "Brake torque offset threshold for Idle Stop for EBB" VALUE 0x80507D82 RB_Val_Wu16 20000.00 TrqPerSec 0.00 20000.00 FORMAT "%8.2" EXTENDED_LIMITS 0.00 65535.00 /end CHARACTERISTIC
/begin CHARACTERISTIC BrkPed_tqBrkThdforIS_T "Curve to determine the brake torque required at wheel for a given inclination to avoid roll back." CURVE 0x80507D84 RB_Curve_S16_S16 20000.00 TrqPerSec 0.00 20000.00 FORMAT "%8.2" EXTENDED_LIMITS -32768.00 32767.00
 /begin AXIS_DESCR STD_AXIS BrkPed_aGrdtFild RBPtCel_m_0p001_1 9 -32.76800 32.76700 FORMAT "%8.5" DEPOSIT ABSOLUTE /end AXIS_DESCR
/end CHARACTERISTIC
/begin CHARACTERISTIC BrkPed_vEBBSpdHi_C "Vehicle speed upper threshold for calculation of slope." VALUE 0x80507DAA RB_Val_Ws16 327.6700 Vel 0.00 327.6700 FORMAT "%8.4" EXTENDED_LIMITS -327.6800 327.6700 /end CHARACTERISTIC
/begin CHARACTERISTIC BrkPed_vEBBSpdLo_C "Vehicle speed lower threshold for calculation of slope." VALUE 0x80507DAC RB_Val_Ws16 327.6700 Vel 0.00 327.6700 FORMAT "%8.4" EXTENDED_LIMITS -327.6800 327.6700 /end CHARACTERISTIC
/begin CHARACTERISTIC Brk_ctBrkHealThd_C "This is SW-CALPRM" VALUE 0x8053A69E Val_Wu8 255.0 OneToOne 0.00 255.0 FORMAT "%5.1" /end CHARACTERISTIC
/begin CHARACTERISTIC Brk_ctBrkSwtNotStpThd_C "This is SW-CALPRM" VALUE 0x8053A69F Val_Wu8 255.0 OneToOne 0.00 255.0 FORMAT "%5.1" /end CHARACTERISTIC
/begin CHARACTERISTIC Brk_ctPlaMax_C "Maximum counter value for plausibility check" VALUE 0x8053A6A0 Val_Wu8 255.0 OneToOne 0.00 255.0 FORMAT "%5.1" /end CHARACTERISTIC
/begin CHARACTERISTIC Brk_ctSwtContOnThd_C "This is SW-CALPRM" VALUE 0x8053A6A2 Val_Wu16 65535.00 OneToOne 0.00 65535.00 FORMAT "%8.2" /end CHARACTERISTIC
/begin CHARACTERISTIC Brk_flgSwtCntrDi_C "This is SW-CALPRM" VALUE 0x8053A6A4 Val_Wu8 1.000 OneToOne 0.00 1.000 FORMAT "%5.3" EXTENDED_LIMITS 0.00 255.0 /end CHARACTERISTIC
/begin CHARACTERISTIC Brk_flgSwtExch_C "Calibration switch to indicate the brake sensors placement exchanged" VALUE 0x8053A6A5 Val_Wu8 255.0 OneToOne 0.00 255.0 FORMAT "%5.1" /end CHARACTERISTIC
/begin CHARACTERISTIC Brk_MnDeb.tiHiLo_C "Parameter structure for debounce times of main brake switch / Time for a High to Low transition" VALUE 0x8053A694 Kw_Ws16 655350.0 TimeDeb -327680.0 327670.0 FORMAT "%8.1" /end CHARACTERISTIC
/begin CHARACTERISTIC Brk_MnDeb.tiLoHi_C "Parameter structure for debounce times of main brake switch / Time for a Low to High transition" VALUE 0x8053A696 Kw_Ws16 655350.0 TimeDeb -327680.0 327670.0 FORMAT "%8.1" /end CHARACTERISTIC
/begin CHARACTERISTIC Brk_nPlaMin_C "Minimum value of engine speed for plausibility" VALUE 0x8053A6A6 Val_Ws16 32767.50 EngN -16384.00 16383.50 FORMAT "%8.2" /end CHARACTERISTIC
/begin CHARACTERISTIC Brk_RedDeb.tiHiLo_C "Parameter structure for debounce times of redundant brake switch / Time for a High to Low transition" VALUE 0x8053A698 Kw_Ws16 655350.0 TimeDeb -327680.0 327670.0 FORMAT "%8.1" /end CHARACTERISTIC
/begin CHARACTERISTIC Brk_RedDeb.tiLoHi_C "Parameter structure for debounce times of redundant brake switch / Time for a Low to High transition" VALUE 0x8053A69A Kw_Ws16 655350.0 TimeDeb -327680.0 327670.0 FORMAT "%8.1" /end CHARACTERISTIC
/begin CHARACTERISTIC Brk_stDflVal_C "Default value for brake switch state" VALUE 0x8053A6A8 Val_Wu8 3.000 OneToOne 0.00 3.000 FORMAT "%5.3" EXTENDED_LIMITS 0.00 255.0 /end CHARACTERISTIC
/begin CHARACTERISTIC Brk_stEnaHydPCtrlOper_C "Calibration for activation of clutch stroke sensor for GS" VALUE 0x8053A6A9 Val_Wu8 255.0 OneToOne 0.00 255.0 FORMAT "%5.1" /end CHARACTERISTIC
/begin CHARACTERISTIC Brk_swtMnRed1_C "Switch for comparison of Main and Redundant Brake information" VALUE 0x8053A6AA Val_Wu8 255.0 OneToOne 0.00 255.0 FORMAT "%5.1" /end CHARACTERISTIC
/begin CHARACTERISTIC Brk_swtMnRed2_C "Switch for comparison of Main and Redundant Brake information" VALUE 0x8053A6AB Val_Wu8 255.0 OneToOne 0.00 255.0 FORMAT "%5.1" /end CHARACTERISTIC
/begin CHARACTERISTIC Brk_swtRedSensPrs_C "Switch redundant brake switch present" VALUE 0x8053A6AC Val_Wu8 1.000 OneToOne 0.00 1.000 FORMAT "%5.3" EXTENDED_LIMITS 0.00 255.0 /end CHARACTERISTIC
/begin CHARACTERISTIC Brk_swtSig_C "Switch signal source for main and redundant brake switch" VALUE 0x8053A69C Val_Wu8 255.0 OneToOne 0.00 255.0 FORMAT "%5.1" /end CHARACTERISTIC
/begin CHARACTERISTIC Brk_tiBrkSwtContStpErrClr_C "This is SW-CALPRM" VALUE 0x8053A6AE Val_Wu16 655350.0 Time_ms 0.00 655350.0 FORMAT "%8.1" /end CHARACTERISTIC
/begin CHARACTERISTIC Brk_tiBrkSwtNormDet_C "This is SW-CALPRM" VALUE 0x8053A6B0 Val_Wu16 655350.0 Time_ms 0.00 655350.0 FORMAT "%8.1" /end CHARACTERISTIC
/begin CHARACTERISTIC Brk_tiPlaMax_C "Maximum timer value for plausibility check" VALUE 0x8053A6B2 Val_Ws16 655350.0 Time_ms -327680.0 327670.0 FORMAT "%8.1" /end CHARACTERISTIC
/begin CHARACTERISTIC Brk_tiRdntBrkOnDly_C "Delay time for Redundant Brake Switch On flag." VALUE 0x8053A6B4 Val_Wu16 655350.0 Time_ms 0.00 655350.0 FORMAT "%8.1" /end CHARACTERISTIC
/begin CHARACTERISTIC Brk_vLwrThdBrkSwtNotStp_C "This is SW-CALPRM" VALUE 0x8053A6B6 Val_Ws16 327.6700 Vel 0.00 327.6700 FORMAT "%8.4" EXTENDED_LIMITS -327.6800 327.6700 /end CHARACTERISTIC
/begin CHARACTERISTIC Brk_vPlaMin_C "Minimum value of vehicle speed for plausibility" VALUE 0x8053A6B8 Val_Ws16 655.3500 Vel -327.6800 327.6700 FORMAT "%8.4" /end CHARACTERISTIC
/begin CHARACTERISTIC Brk_vSpdThdBrkSwtStp_C "This is SW-CALPRM" VALUE 0x8053A6BA Val_Ws16 327.6700 Vel 0.00 327.6700 FORMAT "%8.4" EXTENDED_LIMITS -327.6800 327.6700 /end CHARACTERISTIC
/begin CHARACTERISTIC Brk_vUpprThdBrkSwtNotStp_C "This is SW-CALPRM" VALUE 0x8053A6BC Val_Ws16 327.6700 Vel 0.00 327.6700 FORMAT "%8.4" EXTENDED_LIMITS -327.6800 327.6700 /end CHARACTERISTIC
/begin CHARACTERISTIC CEngDsT_cntrSTCDrvgCycColdThd_MAP "char. map:number of driving cycles with cond. radiation power high for tmot stuck check" MAP 0x80507E80 RB_Map_S16S16_U8 255.0 OneToOne 0.00 255.0 FORMAT "%5.1"
 /begin AXIS_DESCR STD_AXIS CEngDsT_tSnsrStrtFrst Temp_Cels 4 -3549.940 3003.560 FORMAT "%8.3" DEPOSIT ABSOLUTE /end AXIS_DESCR
 /begin AXIS_DESCR STD_AXIS EnvT_t Temp_Cels 4 -3549.940 3003.560 FORMAT "%8.3" DEPOSIT ABSOLUTE /end AXIS_DESCR
/end CHARACTERISTIC
/begin CHARACTERISTIC CEngDsT_cntrSTCDrvgCycHotThd_MAP "char. map: number of driving cycles with cond. radiation power low for tmot stuck check" MAP 0x80507EA4 RB_Map_S16S16_U8 255.0 OneToOne 0.00 255.0 FORMAT "%5.1"
 /begin AXIS_DESCR STD_AXIS CEngDsT_tSnsrStrtFrst Temp_Cels 4 -3549.940 3003.560 FORMAT "%8.3" DEPOSIT ABSOLUTE /end AXIS_DESCR
 /begin AXIS_DESCR STD_AXIS EnvT_t Temp_Cels 4 -3549.940 3003.560 FORMAT "%8.3" DEPOSIT ABSOLUTE /end AXIS_DESCR
/end CHARACTERISTIC
/begin CHARACTERISTIC CEngDsT_facRefMdlCalcnGradOn_CUR "char. Curve: Delay time for usage of reference model gradient during running engine after first engine stop" CURVE 0x80507F9C RB_Curve_S16_U8_Static 4.980 fak_ub_b5 0.00 4.980 FORMAT "%5.3"
 /begin AXIS_DESCR STD_AXIS EnvT_t Temp_Cels 4 -3549.940 3003.560 FORMAT "%8.3" DEPOSIT ABSOLUTE /end AXIS_DESCR
/end CHARACTERISTIC
/begin CHARACTERISTIC CEngDsT_facRefMdlEngTFall_CUR "char. Curve: Delay time for detection of falling engine temperature after first engine stop" CURVE 0x80507FAA RB_Curve_S16_U8_Static 4.980 fak_ub_b5 0.00 4.980 FORMAT "%5.3"
 /begin AXIS_DESCR STD_AXIS EnvT_t Temp_Cels 4 -3549.940 3003.560 FORMAT "%8.3" DEPOSIT ABSOLUTE /end AXIS_DESCR
/end CHARACTERISTIC
/begin CHARACTERISTIC CEngDsT_facRefMdlOffWtrPmp_CUR "influence water pump for engine coolant temperature model during engine off phases" CURVE 0x80507FB8 RB_Curve_S16_U8_Static 1.992188 fak_ub_b2 0.00 1.992188 FORMAT "%8.6"
 /begin AXIS_DESCR STD_AXIS CEngDsT_tDifRefMdlEnv TempDiff_Kelv 5 -3276.800 3276.700 FORMAT "%8.3" DEPOSIT ABSOLUTE /end AXIS_DESCR
/end CHARACTERISTIC
/begin CHARACTERISTIC CEngDsT_facReplMdlEngOffInin_C "weighting factor for calculating the initial-value of engine-coolant replacement value" VALUE 0x80507E38 RB_Val_Wu8 0.9961 fak_ub_b1 0.00 0.9961 /end CHARACTERISTIC
/begin CHARACTERISTIC CEngDsT_facReplMdlEngOffTi_CUR "Factor engine off time for model temperature" CURVE 0x80507E3A RB_Curve_U16_U8_Static 0.9961 fak_ub_b1 0.00 0.9961
 /begin AXIS_DESCR STD_AXIS CEngDsT_tiReplMdlEngOff Time_sec_q1_COMPU 5 0.00 65535.00 FORMAT "%8.2" DEPOSIT ABSOLUTE /end AXIS_DESCR
/end CHARACTERISTIC
/begin CHARACTERISTIC CEngDsT_flgSnsrFrzEna_C "Flag for eingine compartment temperature sensor freez enable" VALUE 0x80507DB0 RB_Val_Wu8 1.00000000000 B_TRUE 0.00 1.00000000000 FORMAT "%13.11" /end CHARACTERISTIC
/begin CHARACTERISTIC CEngDsT_flgSwtEnaFil_C "Switch for activation of low pass filter" VALUE 0x80507E30 RB_Val_Wu8 1.00000000000 B_TRUE 0.00 1.00000000000 FORMAT "%13.11" /end CHARACTERISTIC
/begin CHARACTERISTIC CEngDsT_mfAirSTCColdThdHi_CUR "maximum threshold of air-mass flow for condition radiation power high" CURVE 0x80507EC8 RB_Curve_S16_U8_Static 1020. m_ub_b1020 0.00 1020. FORMAT "%5.0"
 /begin AXIS_DESCR STD_AXIS VehV_v Vel 5 -327.6800 327.6700 FORMAT "%8.4" DEPOSIT ABSOLUTE /end AXIS_DESCR
/end CHARACTERISTIC
/begin CHARACTERISTIC CEngDsT_mfAirSTCColdThdLo_CUR "minimum threshold of air-mass flow for condition radiation power high" CURVE 0x80507EDA RB_Curve_S16_U8_Static 1020. m_ub_b1020 0.00 1020. FORMAT "%5.0"
 /begin AXIS_DESCR STD_AXIS VehV_v Vel 5 -327.6800 327.6700 FORMAT "%8.4" DEPOSIT ABSOLUTE /end AXIS_DESCR
/end CHARACTERISTIC
/begin CHARACTERISTIC CEngDsT_mfAirSTCHotThdHi_CUR "maximum threshold of air-mass flow for condition radiation power low" CURVE 0x80507EEC RB_Curve_S16_U8_Static 1020. m_ub_b1020 0.00 1020. FORMAT "%5.0"
 /begin AXIS_DESCR STD_AXIS VehV_v Vel 5 -327.6800 327.6700 FORMAT "%8.4" DEPOSIT ABSOLUTE /end AXIS_DESCR
/end CHARACTERISTIC
/begin CHARACTERISTIC CEngDsT_mfAirSTCHotThdLo_CUR "minimum threshold of air-mass flow for condition radiation power low" CURVE 0x80507EFE RB_Curve_S16_U8_Static 1020. m_ub_b1020 0.00 1020. FORMAT "%5.0"
 /begin AXIS_DESCR STD_AXIS VehV_v Vel 5 -327.6800 327.6700 FORMAT "%8.4" DEPOSIT ABSOLUTE /end AXIS_DESCR
/end CHARACTERISTIC
/begin CHARACTERISTIC CEngDsT_nEngLSCEnagHi_C "upper threshold for engine speed enabling Low-Side-check engine coolant temeprature sensor" VALUE 0x80507F10 RB_Val_Ws16 32767.50 EngN -16384.00 16383.50 FORMAT "%8.2" /end CHARACTERISTIC
/begin CHARACTERISTIC CEngDsT_nEngLSCEnagLo_C "lower threshold for engine speed disabling Low-Side-check engine coolant temperature sensor" VALUE 0x80507F12 RB_Val_Ws16 32767.50 EngN -16384.00 16383.50 FORMAT "%8.2" /end CHARACTERISTIC
/begin CHARACTERISTIC CEngDsT_stSwtPlausLSC2_C "code word: diagnosis configuration of engine coolant temperature sensor" VALUE 0x80507F14 RB_Val_Wu8 255.0 OneToOne 0.00 255.0 FORMAT "%5.1" /end CHARACTERISTIC
/begin CHARACTERISTIC CEngDsT_stSwtPlausLSC_C "code word: diagnosis configuration for tans" VALUE 0x80507F15 RB_Val_Wu8 255.0 OneToOne 0.00 255.0 FORMAT "%5.1" /end CHARACTERISTIC
/begin CHARACTERISTIC CEngDsT_stSwtPlausSTCEnag_C "Code word for switch of the condition engine stop time for stuck check" VALUE 0x80507F16 RB_Val_Wu8 255.0 OneToOne 0.00 255.0 FORMAT "%5.1" /end CHARACTERISTIC
/begin CHARACTERISTIC CEngDsT_stSwtPlausSTC_C "code word: diagnosis configuration for tmot" VALUE 0x80507F17 RB_Val_Wu8 255.0 OneToOne 0.00 255.0 FORMAT "%5.1" /end CHARACTERISTIC
/begin CHARACTERISTIC CEngDsT_stSwtRefMdl_C "code word for cinfiguration of refernce temperature model" VALUE 0x80507FCA RB_Val_Wu8 255.0 OneToOne 0.00 255.0 FORMAT "%5.1" /end CHARACTERISTIC
/begin CHARACTERISTIC CEngDsT_stSwtReplMdlCfg_C "codeword for configuration of replacement model engine coolant temperature" VALUE 0x80507E4C RB_Val_Wu8 255.0 OneToOne 0.00 255.0 FORMAT "%5.1" /end CHARACTERISTIC
/begin CHARACTERISTIC CEngDsT_swtSnsrCfg_C "codeword for configuration of DeviceDriver engine coolant temperature sensor" VALUE 0x80507DB1 RB_Val_Wu8 255.0 OneToOne 0.00 255.0 FORMAT "%5.1" /end CHARACTERISTIC
/begin CHARACTERISTIC CEngDsT_swtSnsrSigAvl_C "codeword for configuration of signal availability engine coolant temperature sensor" VALUE 0x80507DB2 RB_Val_Wu8 255.0 OneToOne 0.00 255.0 FORMAT "%5.1" /end CHARACTERISTIC
/begin CHARACTERISTIC CEngDsT_tDeltaRefMdlEnd_C "Offset value to the CEngDsT reference model end value" VALUE 0x80507F18 RB_Val_Ws16 6553.500 Temp_Cels -3549.940 3003.560 FORMAT "%8.3" /end CHARACTERISTIC
/begin CHARACTERISTIC CEngDsT_tDifLSCRefMdlErrHi_C "offset on engine temperature model to upper threshold for non-plausibility" VALUE 0x80507F1A RB_Val_Ws16 6553.500 Temp_Cels -3549.940 3003.560 FORMAT "%8.3" /end CHARACTERISTIC
/begin CHARACTERISTIC CEngDsT_tDifLSCRefMdlErrLo_C "offset on engine temperature model to lower threshold for non-plausibility" VALUE 0x80507F1C RB_Val_Ws16 6553.500 Temp_Cels -3549.940 3003.560 FORMAT "%8.3" /end CHARACTERISTIC
/begin CHARACTERISTIC CEngDsT_tDifSTCSnsrFildThd_CUR "threshold difference (min and max value) engine coolant temperature for Stuck-Check" CURVE 0x80507F1E RB_Curve_S16_S16 6553.500 T_degC_q0p1_COMPU -3276.800 3276.700 FORMAT "%8.3"
 /begin AXIS_DESCR STD_AXIS CEngDsT_tSnsrStrtFrst Temp_Cels 8 -3549.940 3003.560 FORMAT "%8.3" DEPOSIT ABSOLUTE /end AXIS_DESCR
/end CHARACTERISTIC
/begin CHARACTERISTIC CEngDsT_tGrdtRefMdlCoolg_MAP "reference temperature model: cooling down gradient for running combustion engine" MAP 0x80507FCC RB_Map_S16S16_U16 19.99805 temp_uw_q0p0029_o48 -9.999023 9.999023 FORMAT "%8.6" EXTENDED_LIMITS -48.00000 143.9971
 /begin AXIS_DESCR STD_AXIS CEngDsT_tDifRefMdlEnv TempDiff_Kelv 4 -3276.800 3276.700 FORMAT "%8.3" DEPOSIT ABSOLUTE /end AXIS_DESCR
 /begin AXIS_DESCR STD_AXIS VehV_v Vel 6 -327.6800 327.6700 FORMAT "%8.4" DEPOSIT ABSOLUTE /end AXIS_DESCR
/end CHARACTERISTIC
/begin CHARACTERISTIC CEngDsT_tGrdtRefMdlEnvFcoGsl_CUR "Reference Model: gradient ambient air temperature influence (gasoline engine) during fuel cutoff" CURVE 0x80508014 RB_Curve_S16_U16_Static 19.99805 temp_uw_q0p0029_o48 -9.999023 9.999023 FORMAT "%8.6" EXTENDED_LIMITS -48.00000 143.9971
 /begin AXIS_DESCR STD_AXIS EnvT_t Temp_Cels 4 -3549.940 3003.560 FORMAT "%8.3" DEPOSIT ABSOLUTE /end AXIS_DESCR
/end CHARACTERISTIC
/begin CHARACTERISTIC CEngDsT_tGrdtRefMdlEnv_MAP "char. map for correction gradient of engine coolant temp. at low warming up" MAP 0x80508026 RB_Map_U8S16_U16 19.99805 temp_uw_q0p0029_o48 -9.999023 9.999023 FORMAT "%8.6" EXTENDED_LIMITS -48.00000 143.9971
 /begin AXIS_DESCR STD_AXIS CEngDsT_mfAirStoiRefMdl m_ub_b1020 5 0.00 1020. FORMAT "%5.0" DEPOSIT ABSOLUTE /end AXIS_DESCR
 /begin AXIS_DESCR STD_AXIS EnvT_t Temp_Cels 4 -3549.940 3003.560 FORMAT "%8.3" DEPOSIT ABSOLUTE /end AXIS_DESCR
/end CHARACTERISTIC
/begin CHARACTERISTIC CEngDsT_tGrdtRefMdlLoadFcoGsl_MAP "Reference Model: gradient influence load (gasoline engine) during fuel cutoff" MAP 0x8050805E RB_Map_U8S16_U16 19.99805 temp_uw_q0p0029_o48 -9.999023 9.999023 FORMAT "%8.6" EXTENDED_LIMITS -48.00000 143.9971
 /begin AXIS_DESCR STD_AXIS CEngDsT_mfAirStoiRefMdl m_ub_b1020 5 0.00 1020. FORMAT "%5.0" DEPOSIT ABSOLUTE /end AXIS_DESCR
 /begin AXIS_DESCR STD_AXIS CEngDsT_tRefMdl Temp_Cels 4 -3549.940 3003.560 FORMAT "%8.3" DEPOSIT ABSOLUTE /end AXIS_DESCR
/end CHARACTERISTIC
/begin CHARACTERISTIC CEngDsT_tGrdtRefMdlLoad_MAP "char. map for load in reference model" MAP 0x80508096 RB_Map_U8S16_U16 19.99805 temp_uw_q0p0029_o48 -9.999023 9.999023 FORMAT "%8.6" EXTENDED_LIMITS -48.00000 143.9971
 /begin AXIS_DESCR STD_AXIS CEngDsT_mfAirStoiRefMdl m_ub_b1020 5 0.00 1020. FORMAT "%5.0" DEPOSIT ABSOLUTE /end AXIS_DESCR
 /begin AXIS_DESCR STD_AXIS CEngDsT_tRefMdl Temp_Cels 4 -3549.940 3003.560 FORMAT "%8.3" DEPOSIT ABSOLUTE /end AXIS_DESCR
/end CHARACTERISTIC
/begin CHARACTERISTIC CEngDsT_tGrdtRefMdlOff_MAP "char. map for gradient of engine coolant temperature in reference model for engine off state" MAP 0x805080CE RB_Map_S16S16_U16 19.99805 temp_uw_q0p0029_o48 -9.999023 9.999023 FORMAT "%8.6" EXTENDED_LIMITS -48.00000 143.9971
 /begin AXIS_DESCR STD_AXIS CEngDsT_tDifRefMdlEnv TempDiff_Kelv 4 -3276.800 3276.700 FORMAT "%8.3" DEPOSIT ABSOLUTE /end AXIS_DESCR
 /begin AXIS_DESCR STD_AXIS VehV_v Vel 4 -327.6800 327.6700 FORMAT "%8.4" DEPOSIT ABSOLUTE /end AXIS_DESCR
/end CHARACTERISTIC
/begin CHARACTERISTIC CEngDsT_tGrdtReplMdlOnGsl_MAP "map for heating of engine coolant (for gasoline engines)" MAP 0x80507E4E RB_Map_U8S16_S8 2.988 temp_q0p01172 -1.500 1.488 FORMAT "%5.3"
 /begin AXIS_DESCR STD_AXIS CEngDsT_mfAirStoi m_ub_b1020 5 0.00 1020. FORMAT "%5.0" DEPOSIT ABSOLUTE /end AXIS_DESCR
 /begin AXIS_DESCR STD_AXIS CEngDsT_tReplMdl Temp_Cels 4 -3549.940 3003.560 FORMAT "%8.3" DEPOSIT ABSOLUTE /end AXIS_DESCR
/end CHARACTERISTIC
/begin CHARACTERISTIC CEngDsT_tiDebEngRot_C "debounce time for engine rotation" VALUE 0x80507E74 RB_Val_Ws32 2147.48364700 Time_Dt 0.00 2147.48364700 FORMAT "%13.8" EXTENDED_LIMITS -2147.48364800 2147.48364700 /end CHARACTERISTIC
/begin CHARACTERISTIC CEngDsT_tiDebImpsErrTmp_C "debounce time error detection Loose-Connection-Check eingine compartment temperature sensor" VALUE 0x80507DB4 RB_Val_Ws32 2147.48364700 Time_Dt 0.00 2147.48364700 FORMAT "%13.8" EXTENDED_LIMITS -2147.48364800 2147.48364700 /end CHARACTERISTIC
/begin CHARACTERISTIC CEngDsT_tiDebImpsErr_C "debounce time error Loose-Connection-Check eingine compartment temperature sensor" VALUE 0x80507DB8 RB_Val_Ws32 2147.48364700 Time_Dt 0.00 2147.48364700 FORMAT "%13.8" EXTENDED_LIMITS -2147.48364800 2147.48364700 /end CHARACTERISTIC
/begin CHARACTERISTIC CEngDsT_tiDebLSCErr_C "Delay time to disable the diagnosis low side check (physical conditions)" VALUE 0x80507F40 RB_Val_Ws32 2147.48364700 Time_Dt 0.00 2147.48364700 FORMAT "%13.8" EXTENDED_LIMITS -2147.48364800 2147.48364700 /end CHARACTERISTIC
/begin CHARACTERISTIC CEngDsT_tiDebLSCHeal_C "Delay time to heal error of diagnosis low side check Engine Coolant Temperature Sensor" VALUE 0x80507F44 RB_Val_Ws32 2147.48364700 Time_Dt 0.00 2147.48364700 FORMAT "%13.8" EXTENDED_LIMITS -2147.48364800 2147.48364700 /end CHARACTERISTIC
/begin CHARACTERISTIC CEngDsT_tiDebLSCPlausEnagHi_C "deboucning time for engine speed higher upper enabling threshold Low-Side-check engine coolant temperature sensor" VALUE 0x80507F48 RB_Val_Ws32 2147.48364700 Time_Dt 0.00 2147.48364700 FORMAT "%13.8" EXTENDED_LIMITS -2147.48364800 2147.48364700 /end CHARACTERISTIC
/begin CHARACTERISTIC CEngDsT_tiDebLSCPlausEnagLo_C "deboucning time for engine speed lower upper threshold disablingd Low-Side-check engine coolant temperature sensor" VALUE 0x80507F4C RB_Val_Ws32 2147.48364700 Time_Dt 0.00 2147.48364700 FORMAT "%13.8" EXTENDED_LIMITS -2147.48364800 2147.48364700 /end CHARACTERISTIC
/begin CHARACTERISTIC CEngDsT_tiDebRefMdlCalcnGrdOn_C "Delay time for usage of reference model gradient during running engine before first engine stop" VALUE 0x80508104 RB_Val_Ws32 2147.48364700 Time_Dt 0.00 2147.48364700 FORMAT "%13.8" EXTENDED_LIMITS -2147.48364800 2147.48364700 /end CHARACTERISTIC
/begin CHARACTERISTIC CEngDsT_tiDebRefMdlCalcnGrdOn_MAP "char. map: Delay time for usage of reference model gradient during running engine after first engine stop" MAP 0x80508108 RB_Map_S16U16_U16 65535.00 Time_sec_q1_COMPU 0.00 65535.00 FORMAT "%8.2"
 /begin AXIS_DESCR STD_AXIS CEngDsT_vAvrgElec Vel 8 0.00 327.6700 FORMAT "%8.4" EXTENDED_LIMITS -327.6800 327.6700 DEPOSIT ABSOLUTE /end AXIS_DESCR
 /begin AXIS_DESCR STD_AXIS CEngDsT_tiRefMdlEngOff Time_sec_q1_COMPU 8 0.00 65535.00 FORMAT "%8.2" DEPOSIT ABSOLUTE /end AXIS_DESCR
/end CHARACTERISTIC
/begin CHARACTERISTIC CEngDsT_tiDebRefMdlEngN_C "debounce time for detection of long engine off phases" VALUE 0x805081AC RB_Val_Ws32 2147.48364700 Time_Dt 0.00 2147.48364700 FORMAT "%13.8" EXTENDED_LIMITS -2147.48364800 2147.48364700 /end CHARACTERISTIC
/begin CHARACTERISTIC CEngDsT_tiDebRefMdlEngTFall_C "Delay time for detection of falling engine temperature before first engine stop" VALUE 0x805081B0 RB_Val_Ws32 2147.48364700 Time_Dt 0.00 2147.48364700 FORMAT "%13.8" EXTENDED_LIMITS -2147.48364800 2147.48364700 /end CHARACTERISTIC
/begin CHARACTERISTIC CEngDsT_tiDebRefMdlEngTFall_MAP "char. map: Delay time for detection of falling engine temperature after first engine stop" MAP 0x805081B4 RB_Map_S16U16_U16 65535.00 Time_sec_q1_COMPU 0.00 65535.00 FORMAT "%8.2"
 /begin AXIS_DESCR STD_AXIS CEngDsT_vAvrgElec Vel 8 0.00 327.6700 FORMAT "%8.4" EXTENDED_LIMITS -327.6800 327.6700 DEPOSIT ABSOLUTE /end AXIS_DESCR
 /begin AXIS_DESCR STD_AXIS CEngDsT_tiRefMdlEngOff Time_sec_q1_COMPU 8 0.00 65535.00 FORMAT "%8.2" DEPOSIT ABSOLUTE /end AXIS_DESCR
/end CHARACTERISTIC
/begin CHARACTERISTIC CEngDsT_tiDebSigErr_C "debounce time error Signal-Check eingine compartment temperature sensor" VALUE 0x80507DBC RB_Val_Ws32 2147.48364700 Time_Dt 0.00 2147.48364700 FORMAT "%13.8" EXTENDED_LIMITS -2147.48364800 2147.48364700 /end CHARACTERISTIC
/begin CHARACTERISTIC CEngDsT_tiDebSigHeal_C "debounce time healing Signal-Check eingine compartment temperature sensor" VALUE 0x80507DC0 RB_Val_Ws32 2147.48364700 Time_Dt 0.00 2147.48364700 FORMAT "%13.8" EXTENDED_LIMITS -2147.48364800 2147.48364700 /end CHARACTERISTIC
/begin CHARACTERISTIC CEngDsT_tiDebSnsrElecVld_C "debounce time electrical validity eingine compartment temperature sensor" VALUE 0x80507DC4 RB_Val_Ws32 2147.48364700 Time_Dt 0.00 2147.48364700 FORMAT "%13.8" EXTENDED_LIMITS -2147.48364800 2147.48364700 /end CHARACTERISTIC
/begin CHARACTERISTIC CEngDsT_tiDebSRCErr_C "debounce time error Signal-Range-Check eingine compartment temperature sensor" VALUE 0x80507DC8 RB_Val_Ws32 2.50000000000 Time_Dt 0.00 2.50000000000 FORMAT "%13.11" EXTENDED_LIMITS -2147.48364800 2147.48364700 /end CHARACTERISTIC
/begin CHARACTERISTIC CEngDsT_tiDebSRCHeal_C "debounce time healing Signal-Range-Check eingine compartment temperature sensor" VALUE 0x80507DCC RB_Val_Ws32 2147.48364700 Time_Dt 0.00 2147.48364700 FORMAT "%13.8" EXTENDED_LIMITS -2147.48364800 2147.48364700 /end CHARACTERISTIC
/begin CHARACTERISTIC CEngDsT_tiDiagDSMCycRprt_C "Freely adjustable CEngDsT diagnose coordinator specific repetition rate at which diagnostic result should be sent to the DSM" VALUE 0x80508270 RB_Val_Wu8 25.50 t_q0p1 0.00 25.50 FORMAT "%5.2" /end CHARACTERISTIC
/begin CHARACTERISTIC CEngDsT_tiDiagDSMFrstRprt_C "Time period at which diagnostic result should be sent to the DSM for the first time once DSM is ready (after new start or with DSM clear)" VALUE 0x80508271 RB_Val_Wu8 25.50 t_q0p1 0.00 25.50 FORMAT "%5.2" /end CHARACTERISTIC
/begin CHARACTERISTIC CEngDsT_tiFilVElec_C "time constant for filterung vehicle speed during elctrical driving phases" VALUE 0x80508258 RB_Val_Ws32 4294.9672940000000 TimeDelay_s 0.0000020000000 4294.9672959999998 FORMAT "%19.14" EXTENDED_LIMITS 0.000002000000001 4294.9672959999998 /end CHARACTERISTIC
/begin CHARACTERISTIC CEngDsT_tiFil_C "Lowpassfilterconstant for switch from replacement to sensor value of tmot" VALUE 0x80507E32 RB_Val_Wu16 655.3500 t_q0p01 0.00 655.3500 FORMAT "%8.4" /end CHARACTERISTIC
/begin CHARACTERISTIC CEngDsT_tiSnsrURawFildImps_C "Time constant for filtering the raw sensor voltage for engine coolant sensor for loose connection check" VALUE 0x80507DD0 RB_Val_Wu16 6553.500 t_q0p1 0.00 6553.500 FORMAT "%8.3" /end CHARACTERISTIC
/begin CHARACTERISTIC CEngDsT_tiSnsrURawFild_C "Time constant for filtering the raw sensor voltage for engine coolant sensor" VALUE 0x80507DD2 RB_Val_Wu16 6553.500 t_q0p1 0.00 6553.500 FORMAT "%8.3" /end CHARACTERISTIC
/begin CHARACTERISTIC CEngDsT_tiSTCColdOffThd_C "accumulated waiting time out of matched area to reset cond. radiation power high" VALUE 0x80507F50 RB_Val_Ws32 2147.48364700 Time_Dt 0.00 2147.48364700 FORMAT "%13.8" EXTENDED_LIMITS -2147.48364800 2147.48364700 /end CHARACTERISTIC
/begin CHARACTERISTIC CEngDsT_tiSTCColdOnThd_C "waiting time within matched area to set condition radiation power high" VALUE 0x80507F54 RB_Val_Ws32 2147.48364700 Time_Dt 0.00 2147.48364700 FORMAT "%13.8" EXTENDED_LIMITS -2147.48364800 2147.48364700 /end CHARACTERISTIC
/begin CHARACTERISTIC CEngDsT_tiSTCEngOffThdLo_C "Upper threshold for condition stuck check" VALUE 0x80507F58 RB_Val_Ws32 2147483647.00 Time_sec_q1_COMPU 0.00 2147483647.00 FORMAT "%13.2" EXTENDED_LIMITS -2147483648.00 2147483647.00 /end CHARACTERISTIC
/begin CHARACTERISTIC CEngDsT_tiSTCHotOffThd_C "accumulated waiting time out of matched area to reset cond. radiation power low" VALUE 0x80507F5C RB_Val_Ws32 2147.48364700 Time_Dt 0.00 2147.48364700 FORMAT "%13.8" EXTENDED_LIMITS -2147.48364800 2147.48364700 /end CHARACTERISTIC
/begin CHARACTERISTIC CEngDsT_tiSTCHotOnThd_C "waiting time within matched area to set condition radiation power low" VALUE 0x80507F60 RB_Val_Ws32 2147.48364700 Time_Dt 0.00 2147.48364700 FORMAT "%13.8" EXTENDED_LIMITS -2147.48364800 2147.48364700 /end CHARACTERISTIC
/begin CHARACTERISTIC CEngDsT_tLSCRefMdlEnagThd_C "threshold reference value of the engine temperature model for enabling of Low-Side-Check Engine Coolant Temperature Sensor" VALUE 0x80507F64 RB_Val_Ws16 6553.500 Temp_Cels -3549.940 3003.560 FORMAT "%8.3" /end CHARACTERISTIC
/begin CHARACTERISTIC CEngDsT_tLSCRefMdlEnd_CUR "end value of reference model value in depending on ambient temperature for LSC Kühlmitteltemperatur" CURVE 0x80507F66 RB_Curve_S16_S16 6553.500 Temp_Cels -3549.940 3003.560 FORMAT "%8.3"
 /begin AXIS_DESCR STD_AXIS EnvT_t Temp_Cels 4 -3549.940 3003.560 FORMAT "%8.3" DEPOSIT ABSOLUTE /end AXIS_DESCR
/end CHARACTERISTIC
/begin CHARACTERISTIC CEngDsT_tLSCStrtTEnagThd_CUR "Curve: engine coolant temperature at first start depending on ambient temperature" CURVE 0x80507F78 RB_Curve_S16_S16 6553.500 Temp_Cels -3549.940 3003.560 FORMAT "%8.3"
 /begin AXIS_DESCR STD_AXIS EnvT_t Temp_Cels 4 -3549.940 3003.560 FORMAT "%8.3" DEPOSIT ABSOLUTE /end AXIS_DESCR
/end CHARACTERISTIC
/begin CHARACTERISTIC CEngDsT_tOffsRefMdl_C "Quantization offset value in case the coolant reference model temperature CEngDsT_tRefMdl is reached the model end value CEngDsT_tLSCRefMdlEnd" VALUE 0x80507F8A RB_Val_Wu8 25.50 TempDiff_Kelv 0.00 25.50 FORMAT "%5.2" /end CHARACTERISTIC
/begin CHARACTERISTIC CEngDsT_tRefMdlEnd_CUR "endvalue of reference temperature model" CURVE 0x8050825C RB_Curve_S16_S16 6553.500 Temp_Cels -3549.940 3003.560 FORMAT "%8.3"
 /begin AXIS_DESCR STD_AXIS EnvT_t Temp_Cels 4 -3549.940 3003.560 FORMAT "%8.3" DEPOSIT ABSOLUTE /end AXIS_DESCR
/end CHARACTERISTIC
/begin CHARACTERISTIC CEngDsT_tReplMdlEngOffLim_C "Lowest Possible start vaue for Engine Temperature model" VALUE 0x80507E78 RB_Val_Ws16 6553.500 Temp_Cels -3549.940 3003.560 FORMAT "%8.3" /end CHARACTERISTIC
/begin CHARACTERISTIC CEngDsT_tReplMdlEngOnLim_C "final temperature for substitute value of engine temperature" VALUE 0x80507E7A RB_Val_Ws16 6553.500 Temp_Cels -3549.940 3003.560 FORMAT "%8.3" /end CHARACTERISTIC
/begin CHARACTERISTIC CEngDsT_tReplMdlInin_C "initialization value engine coolant temperature replacement model" VALUE 0x80507E7C RB_Val_Ws16 6553.500 Temp_Cels -3549.940 3003.560 FORMAT "%8.3" /end CHARACTERISTIC
/begin CHARACTERISTIC CEngDsT_tSTCRefMdlHotThd_C "minimum threshold of substitute engine temperature for stuck signal check" VALUE 0x80507F8C RB_Val_Ws16 6553.500 Temp_Cels -3549.940 3003.560 FORMAT "%8.3" /end CHARACTERISTIC
/begin CHARACTERISTIC CEngDsT_tSTCSnsrStrtFrstThdHi_C "upper threshold of engine coolant temp. for stuck signal check" VALUE 0x80507F8E RB_Val_Ws16 6553.500 Temp_Cels -3549.940 3003.560 FORMAT "%8.3" /end CHARACTERISTIC
/begin CHARACTERISTIC CEngDsT_tSTCSnsrStrtFrstThdLo_C "lower threshold of engine coolant temp. for stuck signal check" VALUE 0x80507F90 RB_Val_Ws16 6553.500 Temp_Cels -3549.940 3003.560 FORMAT "%8.3" /end CHARACTERISTIC
/begin CHARACTERISTIC CEngDsT_tStopInin_C "Initialisation value for engine shut off temperature in case of power failure" VALUE 0x80507E34 RB_Val_Wu8 191.3 temp_ub_q0p75_o48 -48.0 143.3 FORMAT "%5.1" /end CHARACTERISTIC
/begin CHARACTERISTIC CEngDsT_tStrtFrstRefMdlEnd_C "the engine coolant start temperature is under the reference model end value" VALUE 0x80507F92 RB_Val_Ws16 6553.500 Temp_Cels -3549.940 3003.560 FORMAT "%8.3" /end CHARACTERISTIC
/begin CHARACTERISTIC CEngDsT_tStrtThd_C "maximum threshold for enabling tmst-correction in case of active block-heater" VALUE 0x80507E36 RB_Val_Ws16 6553.500 Temp_Cels -3549.940 3003.560 FORMAT "%8.3" /end CHARACTERISTIC
/begin CHARACTERISTIC CEngDsT_tTrfSnsr_CUR "linearisation curve sensor voltage engine coolant temperature" CURVE 0x80507DD4 RB_Curve_U16_S16_Static 6553.500 Temp_Cels -3549.940 3003.560 FORMAT "%8.3"
 /begin AXIS_DESCR STD_AXIS CEngDsT_uRaw Volt 20 0.00 5000.000 FORMAT "%8.3" EXTENDED_LIMITS 0.00 13107.00 DEPOSIT ABSOLUTE /end AXIS_DESCR
/end CHARACTERISTIC
/begin CHARACTERISTIC CEngDsT_uAbsltDifRawFltdMin_C "theshold for absolute value difference sensor voltage (filtered - unfiltered) engine coolant temperature sensor" VALUE 0x80507E26 RB_Val_Wu16 5000.000 Volt 0.00 5000.000 FORMAT "%8.3" EXTENDED_LIMITS 0.00 13107.00 /end CHARACTERISTIC
/begin CHARACTERISTIC CEngDsT_uRawDfl_C "default value sensor voltage engine coolant temperature sensor" VALUE 0x80507E28 RB_Val_Wu16 5000.000 Volt 0.00 5000.000 FORMAT "%8.3" EXTENDED_LIMITS 0.00 13107.00 /end CHARACTERISTIC
/begin CHARACTERISTIC CEngDsT_uRawMaxSRC_C "upper threshold sensor voltagefor signal-range-check engine coolant temperature sensor" VALUE 0x80507E2A RB_Val_Wu16 5000.000 Volt 0.00 5000.000 FORMAT "%8.3" EXTENDED_LIMITS 0.00 13107.00 /end CHARACTERISTIC
/begin CHARACTERISTIC CEngDsT_uRawMinSRC_C "lower threshold sensor voltagefor signal-range-check engine coolant temperature sensor" VALUE 0x80507E2C RB_Val_Wu16 5000.000 Volt 0.00 5000.000 FORMAT "%8.3" EXTENDED_LIMITS 0.00 13107.00 /end CHARACTERISTIC
/begin CHARACTERISTIC CEngDsT_vVehSTCColdThdHi_C "upper vehicle speed threshold for condition radiation power high" VALUE 0x80507F94 RB_Val_Ws16 327.6700 Vel 0.00 327.6700 FORMAT "%8.4" EXTENDED_LIMITS -327.6800 327.6700 /end CHARACTERISTIC
/begin CHARACTERISTIC CEngDsT_vVehSTCColdThdLo_C "lower vehicle speed threshold for condition radiation power high" VALUE 0x80507F96 RB_Val_Ws16 327.6700 Vel 0.00 327.6700 FORMAT "%8.4" EXTENDED_LIMITS -327.6800 327.6700 /end CHARACTERISTIC
/begin CHARACTERISTIC CEngDsT_vVehSTCHotThdHi_C "upper vehicle speed threshold for condition radiation power low" VALUE 0x80507F98 RB_Val_Ws16 327.6700 Vel 0.00 327.6700 FORMAT "%8.4" EXTENDED_LIMITS -327.6800 327.6700 /end CHARACTERISTIC
/begin CHARACTERISTIC CEngDsT_vVehSTCHotThdLo_C "lower vehicle speed threshold for condition radiation power low" VALUE 0x80507F9A RB_Val_Ws16 327.6700 Vel 0.00 327.6700 FORMAT "%8.4" EXTENDED_LIMITS -327.6800 327.6700 /end CHARACTERISTIC
/begin CHARACTERISTIC CWBGRLP "Code word configuration function BGRLP" VALUE 0x80507923 RB_Val_Wu8 255.0 OneToOne 0.00 255.0 FORMAT "%5.1" /end CHARACTERISTIC
/begin CHARACTERISTIC CWBGTMPK "codeword for %BGTMPK" VALUE 0x80507606 RB_Val_Wu16 65535.00 dez 0.00 65535.00 FORMAT "%8.2" /end CHARACTERISTIC
/begin CHARACTERISTIC CWBGWDKM "Codeword for BGWDKM" VALUE 0x80507918 RB_Val_Wu8 255.0 OneToOne 0.00 255.0 FORMAT "%5.1" /end CHARACTERISTIC
/begin CHARACTERISTIC CWNSPSRE "Code word configuration function BGWPR post injection for PFI" VALUE 0x80507924 RB_Val_Wu8 255.0 OneToOne 0.00 255.0 FORMAT "%5.1" /end CHARACTERISTIC
/begin CHARACTERISTIC CWWPR "Code word configuration function BGWPR" VALUE 0x80507925 RB_Val_Wu8 255.0 OneToOne 0.00 255.0 FORMAT "%5.1" /end CHARACTERISTIC
/begin CHARACTERISTIC DRLDYNA "drl switch off threshold value for te post injection/reduction" VALUE 0x80507926 RB_Val_Ws16 1535.977 rel_sw_q0p0234 -768.0000 767.9766 FORMAT "%8.4" /end CHARACTERISTIC
/begin CHARACTERISTIC DRLDYNE "drl switch on threshold value for te post injection/reduction" VALUE 0x80507928 RB_Val_Ws16 1535.977 rel_sw_q0p0234 -768.0000 767.9766 FORMAT "%8.4" /end CHARACTERISTIC
/begin CHARACTERISTIC DRLMIN "Minimal charge change for triggering of post injection" VALUE 0x8050792A RB_Val_Ws16 1535.977 rel_sw_q0p0234 -768.0000 767.9766 FORMAT "%8.4" /end CHARACTERISTIC
/begin CHARACTERISTIC DTEPRU "delta-te threshold for post injection/ti-reduction detected" VALUE 0x8050792C RB_Val_Wu16 65.53500 t1p0usxms 0.00 65.53500 FORMAT "%8.5" /end CHARACTERISTIC
/begin CHARACTERISTIC DTEVS "Delta temperature of inlet valve to engine temperature after start" VALUE 0x80507608 RB_Val_Wu8 191.3 temp_q0p75_om48 -48.0 143.3 FORMAT "%5.1" /end CHARACTERISTIC
/begin CHARACTERISTIC DWPRNSPSRE "Delta prediction angle at post injection release PFI" VALUE 0x8050792E RB_Val_Ws8 1530. kw_q6 -768.0 762.0 FORMAT "%5.1" /end CHARACTERISTIC
/begin CHARACTERISTIC DWPRSRE "Delta prediction angle for PFI" VALUE 0x8050792F RB_Val_Ws8 1530. kw_q6 -768.0 762.0 FORMAT "%5.1" /end CHARACTERISTIC
/begin CHARACTERISTIC DZWOLA "Lambda dependency of optimized model reference ignition angle referred to Lambda 1" CURVE 0x80507508 RB_Curve_U16_S16_Static 36.00000 zw_q2p9297Em3_deg_KW -12.00000 24.00000 FORMAT "%8.5" EXTENDED_LIMITS -96.00000 95.99707
 /begin AXIS_DESCR STD_AXIS NO_INPUT_QUANTITY fak_uw_b16 22 0.00 15.99976 FORMAT "%8.5" DEPOSIT ABSOLUTE /end AXIS_DESCR
/end CHARACTERISTIC
/begin CHARACTERISTIC ETALAM "Lambda efficiency" CURVE 0x80507562 RB_Curve_U16_U16 1.999969 fak_uw_b2 0.00 1.999969 FORMAT "%8.6"
 /begin AXIS_DESCR STD_AXIS NO_INPUT_QUANTITY fak_uw_b16 10 0.00 15.99976 FORMAT "%8.5" DEPOSIT ABSOLUTE /end AXIS_DESCR
/end CHARACTERISTIC
/begin CHARACTERISTIC FTOCHLWIN "initialization value for weighting factor oiltemperature in cylinder-head" VALUE 0x80507904 RB_Val_Wu8 1.000 fak_q0p00392 0.00 1.000 FORMAT "%5.3" /end CHARACTERISTIC
/begin CHARACTERISTIC FTVDKTAVDK "Temperature factor for air at throttle valve" CURVE 0x8050760A RB_Curve_U16_U16 1.999969 fak_uw_b2 0.00 1.999969 FORMAT "%8.6"
 /begin AXIS_DESCR STD_AXIS NO_INPUT_QUANTITY temp_q0p0234_o273 16 -273.150 1262.827 FORMAT "%8.3" DEPOSIT ABSOLUTE /end AXIS_DESCR
/end CHARACTERISTIC
/begin CHARACTERISTIC FWDKUGDSP "Factor for hysteresis on throttle valve angle during which 95% charge is reached" VALUE 0x80507930 RB_Val_Wu16 1.000000 fak_uw_b2 0.00 1.000000 FORMAT "%8.6" EXTENDED_LIMITS 0.00 1.999969 /end CHARACTERISTIC
/begin CHARACTERISTIC KFFWLKFTAHEV "Warm up coorection for fresh air temperature in combustion chamber" MAP 0x8050764C RB_Map_U16S16_U16 1.999969 fak_uw_b2 0.00 1.999969 FORMAT "%8.6"
 /begin AXIS_DESCR STD_AXIS tmotdifk_w temp_q0p0234_o273 8 -273.150 1262.827 FORMAT "%8.3" DEPOSIT ABSOLUTE /end AXIS_DESCR
 /begin AXIS_DESCR STD_AXIS CEngDsT_tStrt Temp_Cels 5 -3549.940 3003.560 FORMAT "%8.3" DEPOSIT ABSOLUTE /end AXIS_DESCR
/end CHARACTERISTIC
/begin CHARACTERISTIC KFFWLKPN "Map factor on warm up correction based on pressure and engine speed" MAP 0x805076BA RB_Map_U16S16_U16 1.000000 fak_uw_b2 0.00 1.000000 FORMAT "%8.6" EXTENDED_LIMITS 0.00 1.999969
 /begin AXIS_DESCR STD_AXIS psr_w_msg p_q0p078 10 0.00 5119.922 FORMAT "%8.3" DEPOSIT ABSOLUTE /end AXIS_DESCR
 /begin AXIS_DESCR STD_AXIS Epm_nEng EngN 10 -16384.00 16383.50 FORMAT "%8.2" DEPOSIT ABSOLUTE /end AXIS_DESCR
/end CHARACTERISTIC
/begin CHARACTERISTIC KFTOCHLW "Map for weighting-factor for oiltemperature in cylinder-head" MAP 0x80507905 RB_Map_U8U8_U8 1.000 fak_q0p00392 0.00 1.000 FORMAT "%5.3"
 /begin AXIS_DESCR STD_AXIS mltoch m_ub_b1020 3 0.00 1020. FORMAT "%5.0" DEPOSIT ABSOLUTE /end AXIS_DESCR
 /begin AXIS_DESCR STD_AXIS nmottoch nmot_ub_q40 3 0.00 10200. FORMAT "%5.0" DEPOSIT ABSOLUTE /end AXIS_DESCR
/end CHARACTERISTIC
/begin CHARACTERISTIC KFWTBR "Weighting factor Tans/Tmot for combustion chamber temperature model" MAP 0x805077AE RB_Map_U16S16_U16 1.999969 fak_uw_b2 0.00 1.999969 FORMAT "%8.6"
 /begin AXIS_DESCR STD_AXIS psr_w_msg p_q0p078 10 0.00 5119.922 FORMAT "%8.3" DEPOSIT ABSOLUTE /end AXIS_DESCR
 /begin AXIS_DESCR STD_AXIS Epm_nEng EngN 12 -16384.00 16383.50 FORMAT "%8.2" DEPOSIT ABSOLUTE /end AXIS_DESCR
/end CHARACTERISTIC
/begin CHARACTERISTIC KLFEXPSL "Characteristic line E-function (1-e(-x))" CURVE 0x805078CE RB_Curve_U16_U16 0.9999847 fak_uw_b1 0.00 0.9999847 FORMAT "%9.7"
 /begin AXIS_DESCR STD_AXIS quotntke_w_msg fak_uw_b8 6 0.00 7.999878 FORMAT "%8.6" DEPOSIT ABSOLUTE /end AXIS_DESCR
/end CHARACTERISTIC
/begin CHARACTERISTIC medc_datasetid "Text with the dataset identification" ASCII 0x8053A6BE ValA_Wu8 255.0 defaultAscii 0.00 255.0 NUMBER 99 /end CHARACTERISTIC
/begin CHARACTERISTIC NMOTRLPU "Lower threshold for prediction of air charge" VALUE 0x80507932 RB_Val_Ws16 32767.50 EngN -16384.00 16383.50 FORMAT "%8.2" /end CHARACTERISTIC
/begin CHARACTERISTIC NWKEV "Engine speed Parameter for calculation thermal contact of fresh air" VALUE 0x805078E8 RB_Val_Wu16 16383.75 nmot_q0p25 0.00 16383.75 FORMAT "%8.2" /end CHARACTERISTIC
/begin CHARACTERISTIC TDev_tDflValPID67_C "Default temperature value for PID67 signal Tester" VALUE 0x80508272 RB_Val_Wu8 255.0 temp_ub_q1_o40 -40.0 215.0 FORMAT "%5.1" /end CHARACTERISTIC
/begin CHARACTERISTIC TDTEVATI "Time constant delta temperature of inlet valve to engine temperature after start" CURVE 0x805078EA RB_Curve_U16_U8_Static 0.9961 fak_q0p0039 0.00 0.9961
 /begin AXIS_DESCR STD_AXIS anztib_w_msg dez 6 0.00 65535.00 FORMAT "%8.2" DEPOSIT ABSOLUTE /end AXIS_DESCR
/end CHARACTERISTIC
/begin CHARACTERISTIC TEVSMX "Maximal tmperatur of inlet valve for temperature correction after start" VALUE 0x805078FE RB_Val_Wu8 191.3 temp_q0p75_om48 -48.0 143.3 FORMAT "%5.1" /end CHARACTERISTIC
/begin CHARACTERISTIC TMECmb_iaLamDpdVVlvLft_T "Lambda dependency of optimized model reference ignition angle referred to Lambda 1for variable valve lift" CURVE 0x8050758C RB_Curve_U16_S16_Static 36.00000 zw_q2p9297Em3_deg_KW -12.00000 24.00000 FORMAT "%8.5" EXTENDED_LIMITS -96.00000 95.99707
 /begin AXIS_DESCR STD_AXIS NO_INPUT_QUANTITY fak_uw_b16 22 0.00 15.99976 FORMAT "%8.5" DEPOSIT ABSOLUTE /end AXIS_DESCR
/end CHARACTERISTIC
/begin CHARACTERISTIC TMECmb_stVlvlftMpg_I.OperMod2Idx_M "Mapping of a 16-bit mode of operation to the valve lift. / Mapping-Table for the conversion of the operation-mode-information in an other format" MAP 0x805075E6 RB_Map_U8U8_U8 255.0 OneToOne 0.00 255.0 FORMAT "%5.1"
 /begin AXIS_DESCR STD_AXIS NO_INPUT_QUANTITY CoEOM_idxOperModCfgd_VERB 4 0.00 3.00000000000 FORMAT "%13.11" DEPOSIT ABSOLUTE /end AXIS_DESCR
 /begin AXIS_DESCR STD_AXIS NO_INPUT_QUANTITY CoEOM_idxOperModStgTot_VERB 5 0.00 15.0000000000 FORMAT "%13.10" DEPOSIT ABSOLUTE /end AXIS_DESCR
/end CHARACTERISTIC
/begin CHARACTERISTIC TMOTKWRMK "engine temperature for warm engine" VALUE 0x80507900 RB_Val_Wu16 1535.977 temp_q0p0234_o273 -273.150 1262.827 FORMAT "%8.3" /end CHARACTERISTIC
/begin CHARACTERISTIC TNSURLP "Time rl prediction suppression in post-start" VALUE 0x80507934 RB_Val_Wu16 655.3500 t10msxs_uw_b655p35 0.00 655.3500 FORMAT "%8.4" /end CHARACTERISTIC
/begin CHARACTERISTIC TTOCHLWTD "delay-time for activating weighting-factor" VALUE 0x80507916 RB_Val_Wu8 255.0 t_q1 0.00 255.0 FORMAT "%5.1" /end CHARACTERISTIC
/begin CHARACTERISTIC TTOCHLWTP "time-constant for weighting-factor" VALUE 0x80507917 RB_Val_Wu8 254.0 t_q1 1.0 255.0 FORMAT "%5.1" EXTENDED_LIMITS 0.00 255.0 /end CHARACTERISTIC
/begin CHARACTERISTIC TVWDKS "delay time for desired throttle angle" VALUE 0x80507936 RB_Val_Wu8 0.2550 t_q0p001 0.00 0.2550 FORMAT "%6.4" /end CHARACTERISTIC
/begin CHARACTERISTIC WPRMX "maximum prediction angle" VALUE 0x80507937 RB_Val_Wu8 1530. kw_q6 0.00 1530. FORMAT "%5.0" /end CHARACTERISTIC
/begin CHARACTERISTIC ZBRT "time constant for combustion chamber temp. model" VALUE 0x80507902 RB_Val_Wu16 6553.4999985 zk100msxs_uw_b6553 0.1000015 6553.6000000 FORMAT "%12.7" EXTENDED_LIMITS 0.10000152590 6553.6000000 /end CHARACTERISTIC
/begin CHARACTERISTIC ZWDKM1 "1. time constant throttle angle model" VALUE 0x8050791A RB_Val_Wu16 2.5400387579 zk10msxs_uw_b655p36 0.0100001526 2.5500389105 FORMAT "%12.10" EXTENDED_LIMITS 0.010000152590 655.36000000 /end CHARACTERISTIC
/begin CHARACTERISTIC ZWDKM2 "2. time constant throttle angle model" VALUE 0x8050791C RB_Val_Wu16 2.5400387579 zk10msxs_uw_b655p36 0.0100001526 2.5500389105 FORMAT "%12.10" EXTENDED_LIMITS 0.010000152590 655.36000000 /end CHARACTERISTIC
/begin CHARACTERISTIC ZWDKM3 "1. time constant throttle angle model" VALUE 0x8050791E RB_Val_Wu16 65.534999985 zk1msxs_uw_b65p536 0.001000015 65.536000000 FORMAT "%12.9" EXTENDED_LIMITS 0.0010000152590 65.536000000 /end CHARACTERISTIC
/begin CHARACTERISTIC ZWDKM4 "2. time constant throttle angle model" VALUE 0x80507920 RB_Val_Wu16 65.534999985 zk1msxs_uw_b65p536 0.001000015 65.536000000 FORMAT "%12.9" EXTENDED_LIMITS 0.0010000152590 65.536000000 /end CHARACTERISTIC
/begin MEASUREMENT AirMod_idxCylAirChrgPred "Index on cylinder for air charge prediction" UBYTE OneToOne 1 100 0.00 255.0 FORMAT "%5.1" ECU_ADDRESS 0x50000883 /end MEASUREMENT
/begin MEASUREMENT AirMod_idxSynAirChrgPredMax "Index on cylinder for air charge prediction with maximum prediction horizont" UBYTE OneToOne 1 100 0.00 255.0 FORMAT "%5.1" ECU_ADDRESS 0x70001C3D /end MEASUREMENT
/begin MEASUREMENT AirMod_nrSynAirChrgPred "Amount of cylinders between charge and charge prediction" UBYTE OneToOne 1 100 0.00 255.0 FORMAT "%5.1" ECU_ADDRESS 0x50000884 /end MEASUREMENT
/begin MEASUREMENT AirMod_nrSynAirChrgPredHom "Number of Sync for injection prediction in hom mode" UBYTE OneToOne 1 100 0.00 255.0 FORMAT "%5.1" ECU_ADDRESS 0x6000089A /end MEASUREMENT
/begin MEASUREMENT AirMod_nrSynAirChrgPredMax "Amount of cylinders between charge and charge prediction with maximum prediction horizont" UBYTE OneToOne 1 100 0.00 255.0 FORMAT "%5.1" ECU_ADDRESS 0x70001C3C /end MEASUREMENT
/begin MEASUREMENT AirMod_nrSyncPfiPoiPred "Number of Sync for port fuel injection prediction with post injection" UBYTE OneToOne 1 100 0.00 255.0 FORMAT "%5.1" ECU_ADDRESS 0x50000A28 /end MEASUREMENT
/begin MEASUREMENT AirMod_nrSyncPfiPred "Number of Sync for port fuel injection prediction" UBYTE OneToOne 1 100 0.00 255.0 FORMAT "%5.1" ECU_ADDRESS 0x50000A29 /end MEASUREMENT
/begin MEASUREMENT BGTMPK_U_TEMP_FTEMP_I.tahevX_w "SW class for temperature fresh air behind inlet valve / tahevX_winput for interface class BGTMPK_U_TEMP_FTEMP" UWORD temp_q0p0234_o273 1 100 -273.150 1262.827 FORMAT "%8.3" ECU_ADDRESS 0x60000C68 /end MEASUREMENT
/begin MEASUREMENT Blwr_uVoltReq "COM - signal AC-blower voltage" SWORD Volt_q1 1 100 -32768.00 32767.00 FORMAT "%8.2" ECU_ADDRESS 0x60004B6E /end MEASUREMENT
/begin MEASUREMENT BrkBstP_aXFil "Filtered acceleration" SWORD Acc 1 100 -32.76800 32.76700 FORMAT "%8.5" ECU_ADDRESS 0x60005262 /end MEASUREMENT
/begin MEASUREMENT BrkBstP_bDecelByBrk "Deceleration by brake" UBYTE B_TRUE 1 100 0.00 1.00000000000 BIT_MASK 0x1 FORMAT "%13.11" ECU_ADDRESS 0x6000A21B /end MEASUREMENT
/begin MEASUREMENT BrkBstP_bDriftTmrFrz "Flag for drift timer freeze" UBYTE B_TRUE 1 100 0.00 1.00000000000 BIT_MASK 0x1 FORMAT "%13.11" ECU_ADDRESS 0x60009BF1 /end MEASUREMENT
/begin MEASUREMENT BrkBstP_bStopByBrk "Stop by brake flag" UBYTE B_TRUE 1 100 0.00 1.00000000000 BIT_MASK 0x1 FORMAT "%13.11" ECU_ADDRESS 0x6000A21A /end MEASUREMENT
/begin MEASUREMENT BrkBstP_bVehRunng "Vehicle in running flag" UBYTE B_TRUE 1 100 0.00 1.00000000000 BIT_MASK 0x1 FORMAT "%13.11" ECU_ADDRESS 0x6000A219 /end MEASUREMENT
/begin MEASUREMENT BrkBstP_bVehStop "Vehicle stop flag" UBYTE B_TRUE 1 100 0.00 1.00000000000 BIT_MASK 0x1 FORMAT "%13.11" ECU_ADDRESS 0x6000A218 /end MEASUREMENT
/begin MEASUREMENT BrkBstP_cntMstCylPValCnt "Master cylinder hydraulic pressure learning value counter" UWORD OneToOne 1 100 0.00 65535.00 FORMAT "%8.2" ECU_ADDRESS 0x60003F4E /end MEASUREMENT
/begin MEASUREMENT BrkBstP_ctDriftErr "Drift error counter" UWORD OneToOne 1 100 0.00 65535.00 FORMAT "%8.2" ECU_ADDRESS 0x60003F4C /end MEASUREMENT
/begin MEASUREMENT BrkBstP_ctDriftHiErr "High drift error counter" UWORD OneToOne 1 100 0.00 65535.00 FORMAT "%8.2" ECU_ADDRESS 0x60003F4A /end MEASUREMENT
/begin MEASUREMENT BrkBstP_ctDriftLoErr "Low drift error counter" UWORD OneToOne 1 100 0.00 65535.00 FORMAT "%8.2" ECU_ADDRESS 0x60003F48 /end MEASUREMENT
/begin MEASUREMENT BrkBstP_ctVehStop "Vehicle stop count" UWORD OneToOne 1 100 0.00 65535.00 FORMAT "%8.2" ECU_ADDRESS 0x60004DAE /end MEASUREMENT
/begin MEASUREMENT BrkBstP_dpAbsMstCyl "Absolute change in pressure in master cylinder" SLONG Pres 1 100 0.00 214748364.700 FORMAT "%13.3" ECU_ADDRESS 0x60001968 /end MEASUREMENT
/begin MEASUREMENT BrkBstP_flgDSMClr "DSM clear trigger flag" UBYTE B_TRUE 1 100 0.00 1.00000000000 BIT_MASK 0x1 FORMAT "%13.11" ECU_ADDRESS 0x60009BF0 /end MEASUREMENT
/begin MEASUREMENT BrkBstP_flgMstCylPStabyChk "Master cylinder pressure stability flag" UBYTE B_TRUE 1 100 0.00 1.00000000000 BIT_MASK 0x1 FORMAT "%13.11" ECU_ADDRESS 0x60009BEF /end MEASUREMENT
/begin MEASUREMENT BrkBstP_pAftFil "Brake boost pressure after filtering" SWORD Pres_hPa 1 100 -32768.00 32767.00 FORMAT "%8.2" ECU_ADDRESS 0x60005260 /end MEASUREMENT
/begin MEASUREMENT BrkBstP_pBrkBoostDiff "Difference in brake booster pressure before and after brake pressed" SLONG Pres_hPa 1 100 -2147483648.00 2147483647.00 FORMAT "%13.2" ECU_ADDRESS 0x60001964 /end MEASUREMENT
/begin MEASUREMENT BrkBstP_pBrkBoostMax "Maximum brake booster pressure after brake pressed" SWORD Pres_hPa 1 100 -32768.00 32767.00 FORMAT "%8.2" ECU_ADDRESS 0x6000525E /end MEASUREMENT
/begin MEASUREMENT BrkBstP_pBrkBoostMin "Minimum brake booster pressure before brake pressed" SWORD Pres_hPa 1 100 -32768.00 32767.00 FORMAT "%8.2" ECU_ADDRESS 0x6000525C /end MEASUREMENT
/begin MEASUREMENT BrkBstP_pChgMaxVal "The amount limit value of zero hydraulic pressure correction value change" SLONG Pres 1 100 -214748364.800 214748364.700 FORMAT "%13.3" ECU_ADDRESS 0x50001044 /end MEASUREMENT
/begin MEASUREMENT BrkBstP_pCmpFldP "Master cylinder hydraulic pressure after zero-point adjustment" SLONG Pres 1 100 -214748364.800 214748364.700 FORMAT "%13.3" ECU_ADDRESS 0x50004BCC /end MEASUREMENT
/begin MEASUREMENT BrkBstP_pCorrnPVal "Zero master cylinder hydraulic pressure correction value" SLONG Pres 1 100 -214748364.800 214748364.700 FORMAT "%13.3" ECU_ADDRESS 0x60001D68 /end MEASUREMENT
/begin MEASUREMENT BrkBstP_pCorrnPValInt "Zero master cylinder hydraulic pressure correction value(ENV RAM variable)" SLONG Pres 1 100 -214748364.800 214748364.700 FORMAT "%13.3" ECU_ADDRESS 0x60037E78 /end MEASUREMENT
/begin MEASUREMENT BrkBstP_pDifAbsltVal "Absolute value of Difference of zero hydraulic pressure learning value and correction value" SLONG Pres 1 100 -214748364.800 214748364.700 FORMAT "%13.3" ECU_ADDRESS 0x50001048 /end MEASUREMENT
/begin MEASUREMENT BrkBstP_pIntegdMstcylPVal "Zero master cylinder hydraulic pressure learning value integrated value" SLONG Pres 1 100 -214748364.800 214748364.700 FORMAT "%13.3" ECU_ADDRESS 0x60001960 /end MEASUREMENT
/begin MEASUREMENT BrkBstP_pLimVal "Difference of zero hydraulic pressure learning value and correction value with Limits applied" SLONG Pres 1 100 -214748364.800 214748364.700 FORMAT "%13.3" ECU_ADDRESS 0x5000104C /end MEASUREMENT
/begin MEASUREMENT BrkBstP_pLimValLo "Lower limit value in order to calculate the correction pressure value" SLONG Pres 1 100 -214748364.800 214748364.700 FORMAT "%13.3" ECU_ADDRESS 0x6000195C /end MEASUREMENT
/begin MEASUREMENT BrkBstP_pLrngCorrnPValDif "Difference of zero hydraulic pressure learning value and correction value" SLONG Pres 1 100 -214748364.800 214748364.700 FORMAT "%13.3" ECU_ADDRESS 0x50001050 /end MEASUREMENT
/begin MEASUREMENT BrkBstP_pMstCylAftFil "Master cylinder pressure after filtering" SLONG Pres 1 100 -214748364.800 214748364.700 FORMAT "%13.3" ECU_ADDRESS 0x50004BD0 /end MEASUREMENT
/begin MEASUREMENT BrkBstP_pMstCylAftFilOld "Master cylinder pressure after filtered old value" SLONG Pres 1 100 -214748364.800 214748364.700 FORMAT "%13.3" ECU_ADDRESS 0x60001958 /end MEASUREMENT
/begin MEASUREMENT BrkBstP_pMstCylAftOffsCalcn "Master cylinder brake pressure offset calculation" SLONG Pres 1 100 -214748364.800 214748364.700 FORMAT "%13.3" ECU_ADDRESS 0x60001D64 /end MEASUREMENT
/begin MEASUREMENT BrkBstP_pMstCylOffsVal "Master cylinder pressure offset value" SLONG Pres 1 100 -214748364.800 214748364.700 FORMAT "%13.3" ECU_ADDRESS 0x50001054 /end MEASUREMENT
/begin MEASUREMENT BrkBstP_pMstCylOld "Master cylinder pressure old value" SWORD Pres_kPa_VSA 1 100 -785121.3 785097.3 FORMAT "%8.1" ECU_ADDRESS 0x60003F46 /end MEASUREMENT
/begin MEASUREMENT BrkBstP_pMstCylPAvgVal "Zero master cylinder hydraulic pressure learning value(Average value)" SLONG Pres 1 100 -214748364.800 214748364.700 FORMAT "%13.3" ECU_ADDRESS 0x60001954 /end MEASUREMENT
/begin MEASUREMENT BrkBstP_pMstCylReslCnv "Master Cylinder Oil pressure after resolution conversion" SLONG Pres 1 100 -214748364.800 214748364.700 FORMAT "%13.3" ECU_ADDRESS 0x50001058 /end MEASUREMENT
/begin MEASUREMENT BrkBstP_pRawFldPDifVal "Master cylinder pressure min max difference value" SLONG Pres 1 100 -214748364.800 214748364.700 FORMAT "%13.3" ECU_ADDRESS 0x60001950 /end MEASUREMENT
/begin MEASUREMENT BrkBstP_pRawFldPMaxVal "maximum value during master cylinder hydraulic pressure data learning." SLONG Pres 1 100 -214748364.800 214748364.700 FORMAT "%13.3" ECU_ADDRESS 0x6000194C /end MEASUREMENT
/begin MEASUREMENT BrkBstP_pRawFldPMinVal "minimum value during master cylinder hydraulic pressure data learning." SLONG Pres 1 100 -214748364.800 214748364.700 FORMAT "%13.3" ECU_ADDRESS 0x5000105C /end MEASUREMENT
/begin MEASUREMENT BrkBstP_stAYCBrkOilEna "AYC brake oil enable status" UBYTE B_TRUE 1 100 0.00 1.00000000000 BIT_MASK 0x1 FORMAT "%13.11" ECU_ADDRESS 0x6000A217 /end MEASUREMENT
/begin MEASUREMENT BrkBstP_stBrkPsdDriftErr "Drift error check status" UBYTE OneToOne 1 100 0.00 255.0 FORMAT "%5.1" ECU_ADDRESS 0x6000A6A0 /end MEASUREMENT
/begin MEASUREMENT BrkBstP_stDrift "Drift error determination" UWORD OneToOne 1 100 0.00 65535.00 FORMAT "%8.2" ECU_ADDRESS 0x60003F44 /end MEASUREMENT
/begin MEASUREMENT BrkBstP_stFldPMeasCdn "Judgment master cylinder hydraulic pressure zero point learning permission flag." UBYTE B_TRUE 1 100 0.00 1.00000000000 BIT_MASK 0x1 FORMAT "%13.11" ECU_ADDRESS 0x60009BEE /end MEASUREMENT
/begin MEASUREMENT BrkBstP_stFldPOffsMeasCalcn "Judgment master cylinder hydraulic pressure zero point learning execution flag." UBYTE B_TRUE 1 100 0.00 1.00000000000 BIT_MASK 0x1 FORMAT "%13.11" ECU_ADDRESS 0x60009BED /end MEASUREMENT
/begin MEASUREMENT BrkBstP_stFldPOffsMeasCdn "Judgment master cylinder hydraulic pressure zero point learning permission conditon" UWORD OneToOne 1 100 0.00 65535.00 FORMAT "%8.2" ECU_ADDRESS 0x60003F42 /end MEASUREMENT
/begin MEASUREMENT BrkBstP_stFldPStaby "Hydraulic pressure stability flag" UBYTE B_TRUE 1 100 0.00 1.00000000000 BIT_MASK 0x1 FORMAT "%13.11" ECU_ADDRESS 0x60009BEC /end MEASUREMENT
/begin MEASUREMENT BrkBstP_stIniValCdn "Zero master cylinder hydraulic pressure adjustment initial value condition" UBYTE B_TRUE 1 100 0.00 1.00000000000 BIT_MASK 0x1 FORMAT "%13.11" ECU_ADDRESS 0x60037E75 /end MEASUREMENT
/begin MEASUREMENT BrkBstP_stMstCylOffsVal "Master cylinder offset determination" UBYTE OneToOne 1 100 0.00 255.0 FORMAT "%5.1" ECU_ADDRESS 0x60009BEB /end MEASUREMENT
/begin MEASUREMENT BrkBstP_stVehStopCfmd "Vehicle stop confirmation" UBYTE OneToOne 1 100 0.00 255.0 FORMAT "%5.1" ECU_ADDRESS 0x60009BEA /end MEASUREMENT
/begin MEASUREMENT BrkBstP_stZrPntCalcnJdg "In process of master cylinder hydraulic pressure zero point learning value calculation" UBYTE B_TRUE 1 100 0.00 1.00000000000 BIT_MASK 0x1 FORMAT "%13.11" ECU_ADDRESS 0x6000A216 /end MEASUREMENT
/begin MEASUREMENT BrkBstP_tiDecelByBrk "Checking the time during deceleration by brake" SLONG Time_s 1 100 -21474836.4800 21474836.4700 FORMAT "%13.4" ECU_ADDRESS 0x50001060 /end MEASUREMENT
/begin MEASUREMENT BrkBstP_tiDriftErrRels "Drift error release time" SLONG Time_s 1 100 -21474836.4800 21474836.4700 FORMAT "%13.4" ECU_ADDRESS 0x60001948 /end MEASUREMENT
/begin MEASUREMENT BrkBstP_tiMstCylPStaby "Time for Master cylinder stability check" SLONG Time_s 1 100 -21474836.4800 21474836.4700 FORMAT "%13.4" ECU_ADDRESS 0x60001944 /end MEASUREMENT
/begin MEASUREMENT BrkBstP_vXFil "Filtered vehicle speed" SWORD Vel 1 100 -327.6800 327.6700 FORMAT "%8.4" ECU_ADDRESS 0x60005258 /end MEASUREMENT
/begin MEASUREMENT BrkPed_aDif "The longitudinal acceleration difference rate value" SWORD RBPtCel_m_0p001_1 1 100 -32.76800 32.76700 FORMAT "%8.5" ECU_ADDRESS 0x60005254 /end MEASUREMENT
/begin MEASUREMENT BrkPed_aGrdt "The longitudinal acceleration value after rate limit" SWORD RBPtCel_m_0p001_1 1 100 -32.76800 32.76700 FORMAT "%8.5" ECU_ADDRESS 0x60005252 /end MEASUREMENT
/begin MEASUREMENT BrkPed_aGrdtFild "Filtered value of gradient information received from SRS" SWORD RBPtCel_m_0p001_1 1 100 -32.76800 32.76700 FORMAT "%8.5" ECU_ADDRESS 0x60005250 /end MEASUREMENT
/begin MEASUREMENT BrkPed_aGrdtFildDif "Difference between the maximum and minimum gradient value received during window period" SLONG RBPtCel_m_0p001_1 1 100 -2147483.64800 2147483.64700 FORMAT "%13.5" ECU_ADDRESS 0x60001940 /end MEASUREMENT
/begin MEASUREMENT BrkPed_aGrdtFildHist_a "Array for storing history values of g sensor output during window period for vehicle standstill detection" SWORD RBPtCel_m_0p001_1 1 100 -32.76800 32.76700 FORMAT "%8.5" ARRAY_SIZE 50 ECU_ADDRESS 0x60003EDE /end MEASUREMENT
/begin MEASUREMENT BrkPed_aGrdtFildMax "Maximum gradient value received during window period for vehicle standstill detection" SWORD RBPtCel_m_0p001_1 1 100 -32.76800 32.76700 FORMAT "%8.5" ECU_ADDRESS 0x60003EDC /end MEASUREMENT
/begin MEASUREMENT BrkPed_aGrdtFildMin "Minimum gradient value recieved during window period for vehicle standstill detection" SWORD RBPtCel_m_0p001_1 1 100 -32.76800 32.76700 FORMAT "%8.5" ECU_ADDRESS 0x60003EDA /end MEASUREMENT
/begin MEASUREMENT BrkPed_aLgtG "The longitudinal acceleration information" SLONG RBPtCel_m_0p001_1 1 100 -2147483.64800 2147483.64700 FORMAT "%13.5" ECU_ADDRESS 0x6000193C /end MEASUREMENT
/begin MEASUREMENT BrkPed_aLgtGCnvn "The converted longitudinal acceleration information" SWORD RBPtCel_m_0p001_1 1 100 -32.76800 32.76700 FORMAT "%8.5" ECU_ADDRESS 0x6000524E /end MEASUREMENT
/begin MEASUREMENT BrkPed_aSlopEBB "Slope value for EBB" SWORD RBPtCel_m_0p001_1 1 100 -32.76800 32.76700 FORMAT "%8.5" ECU_ADDRESS 0x6000524C /end MEASUREMENT
/begin MEASUREMENT BrkPed_bEngStopEna "stop release brake system" UBYTE B_TRUE 1 100 0.00 1.00000000000 BIT_MASK 0x1 FORMAT "%13.11" ECU_ADDRESS 0x70000949 /end MEASUREMENT
/begin MEASUREMENT BrkPed_bEngStrtReq "start request brake system" UBYTE B_TRUE 1 100 0.00 1.00000000000 BIT_MASK 0x1 FORMAT "%13.11" ECU_ADDRESS 0x70000948 /end MEASUREMENT
/begin MEASUREMENT BrkPed_cntrISABRls "Counter for calculation of ISAB request cancellation" UWORD Fact_100 1 100 0.00 655.3500 FORMAT "%8.4" ECU_ADDRESS 0x60003ED8 /end MEASUREMENT
/begin MEASUREMENT BrkPed_flgBrkBoostEngStopEna "Stop release brake from Brake Booster function" UBYTE B_TRUE 1 100 0.00 1.00000000000 BIT_MASK 0x1 FORMAT "%13.11" ECU_ADDRESS 0x7000035E /end MEASUREMENT
/begin MEASUREMENT BrkPed_flgBrkBoostEngStrtReq "Start request brake from Brake Booster function" UBYTE B_TRUE 1 100 0.00 1.00000000000 BIT_MASK 0x1 FORMAT "%13.11" ECU_ADDRESS 0x7000035D /end MEASUREMENT
/begin MEASUREMENT BrkPed_flgBrkBoostEngSysOff "System off by EBB from Brake Booster function" UBYTE B_TRUE 1 100 0.00 1.00000000000 BIT_MASK 0x1 FORMAT "%13.11" ECU_ADDRESS 0x7000035C /end MEASUREMENT
/begin MEASUREMENT BrkPed_flgEBBEngSysOff "System off by EBB" UBYTE B_TRUE 1 100 0.00 1.00000000000 BIT_MASK 0x1 FORMAT "%13.11" ECU_ADDRESS 0x6000A215 /end MEASUREMENT
/begin MEASUREMENT BrkPed_flgEBBFailrOcc_MP "Measurement Point for EBB failure Occurance" UBYTE B_TRUE 1 100 0.00 1.00000000000 BIT_MASK 0x1 FORMAT "%13.11" ECU_ADDRESS 0x7000926C /end MEASUREMENT
/begin MEASUREMENT BrkPed_flgEBBHiSlop "Slope High flag for EBB" UBYTE B_TRUE 1 100 0.00 1.00000000000 BIT_MASK 0x1 FORMAT "%13.11" ECU_ADDRESS 0x6000A214 /end MEASUREMENT
/begin MEASUREMENT BrkPed_flgEBBVehStandStill "Vehicle stand still status confirmed for EBB" UBYTE B_TRUE 1 100 0.00 1.00000000000 BIT_MASK 0x1 FORMAT "%13.11" ECU_ADDRESS 0x60009BE9 /end MEASUREMENT
/begin MEASUREMENT BrkPed_flgIMGEngStopEna "Stop release brake from IMG ECU" UBYTE B_TRUE 1 100 0.00 1.00000000000 BIT_MASK 0x1 FORMAT "%13.11" ECU_ADDRESS 0x7000035B /end MEASUREMENT
/begin MEASUREMENT BrkPed_flgIMGEngStrtReq "Start request brake from IMG ECU" UBYTE B_TRUE 1 100 0.00 1.00000000000 BIT_MASK 0x1 FORMAT "%13.11" ECU_ADDRESS 0x7000035A /end MEASUREMENT
/begin MEASUREMENT BrkPed_flgIMGEngSysOff "System off by EBB from IMG ECU" UBYTE B_TRUE 1 100 0.00 1.00000000000 BIT_MASK 0x1 FORMAT "%13.11" ECU_ADDRESS 0x70000359 /end MEASUREMENT
/begin MEASUREMENT BrkPed_flgISABBrkPSuffVehStill "Flag to indicate that Vehicle is stand still and enough brake pressure available to allow Idle stop" UBYTE B_TRUE 1 100 0.00 1.00000000000 BIT_MASK 0x1 FORMAT "%13.11" ECU_ADDRESS 0x6000A213 /end MEASUREMENT
/begin MEASUREMENT BrkPed_flgISABDi "Flag to indicate that ISAB is disabled due to sensor failure or slope out of range" UBYTE B_TRUE 1 100 0.00 1.00000000000 BIT_MASK 0x1 FORMAT "%13.11" ECU_ADDRESS 0x6000A212 /end MEASUREMENT
/begin MEASUREMENT BrkPed_flgISABReq "Flag for ISAB Request" UBYTE B_TRUE 1 100 0.00 1.00000000000 BIT_MASK 0x1 FORMAT "%13.11" ECU_ADDRESS 0x6000A211 /end MEASUREMENT
/begin MEASUREMENT BrkPed_flgLgtGComErr "Flag indicate for failure information of G sensor abnormal" UBYTE B_TRUE 1 100 0.00 1.00000000000 BIT_MASK 0x1 FORMAT "%13.11" ECU_ADDRESS 0x6000A210 /end MEASUREMENT
/begin MEASUREMENT BrkPed_flgNonServoFailr_MP "Measurement Point for Non Servo Failure" UBYTE B_TRUE 1 100 0.00 1.00000000000 BIT_MASK 0x1 FORMAT "%13.11" ECU_ADDRESS 0x7000926B /end MEASUREMENT
/begin MEASUREMENT BrkPed_flgSlopeExcd "Flag to indicate that slope is outside the permitted range to allow idle stop" UBYTE B_TRUE 1 100 0.00 1.00000000000 BIT_MASK 0x1 FORMAT "%13.11" ECU_ADDRESS 0x6000A20F /end MEASUREMENT
/begin MEASUREMENT BrkPed_flgSwtISABAvl "ISAB enable flag" UBYTE B_TRUE 1 100 0.00 1.00000000000 BIT_MASK 0x1 FORMAT "%13.11" ECU_ADDRESS 0x6000A20E /end MEASUREMENT
/begin MEASUREMENT BrkPed_flgVehStandStill "Vehicle standstill condition detection" UBYTE B_TRUE 1 100 0.00 1.00000000000 BIT_MASK 0x1 FORMAT "%13.11" ECU_ADDRESS 0x6000A20D /end MEASUREMENT
/begin MEASUREMENT BrkPed_flgVSAFailr_MP "Measurement Point for VSA failure" UBYTE B_TRUE 1 100 0.00 1.00000000000 BIT_MASK 0x1 FORMAT "%13.11" ECU_ADDRESS 0x7000926A /end MEASUREMENT
/begin MEASUREMENT BrkPed_nrGrdtArySize "Number of gradient samples to be collected during window period for vehicle standstill detection" UBYTE OneToOne 1 100 0.00 50.00 FORMAT "%5.2" ECU_ADDRESS 0x60009BE8 /end MEASUREMENT
/begin MEASUREMENT BrkPed_pEnvP_MP "Minimum threshold value of environmental pressure" SWORD Pres_hPa 1 100 -32768.00 32767.00 FORMAT "%8.2" ECU_ADDRESS 0x70009268 /end MEASUREMENT
/begin MEASUREMENT BrkPed_pEVPMnFldP_MP "Measurement point for manifold pressure after convert from mmHg to hPa" SLONG Pres_hPa 1 100 -2147483648.00 2147483647.00 FORMAT "%13.2" ECU_ADDRESS 0x70009264 /end MEASUREMENT
/begin MEASUREMENT BrkPed_pRel "Difference between brake pressure and environmental pressure" SLONG Pres_hPa 1 100 -65535.0000000 65535.0000000 FORMAT "%13.7" ECU_ADDRESS 0x60001D5C /end MEASUREMENT
/begin MEASUREMENT BrkPed_stVehStandStill "Vehicle stand still status" UBYTE B_TRUE 1 100 0.00 1.00000000000 BIT_MASK 0x1 FORMAT "%13.11" ECU_ADDRESS 0x60009BE7 /end MEASUREMENT
/begin MEASUREMENT BrkPed_tiEBBSlopInRng "Timer value for slope in vehicle speed range." UWORD Time_ms 1 100 0.00 655350.0 FORMAT "%8.1" ECU_ADDRESS 0x60003ED6 /end MEASUREMENT
/begin MEASUREMENT BrkPed_tiElpdSnceVehSpdZr "Time elapsed since vehicle speed and wheel speed was zero" SWORD Time_s 1 100 -327.6800 327.6700 FORMAT "%8.4" ECU_ADDRESS 0x60003ED4 /end MEASUREMENT
/begin MEASUREMENT BrkPed_tqIMGISABIdleStop "Brake torque required to prevent vehicle roll back for current road inclination" SWORD TrqPerSec 1 100 0.00 20000.00 FORMAT "%8.2" ECU_ADDRESS 0x60005248 /end MEASUREMENT
/begin MEASUREMENT Brk_cntrReIni "ReIni counter" UBYTE OneToOne 1 100 0.00 255.0 FORMAT "%5.1" ECU_ADDRESS 0x60009BE6 /end MEASUREMENT
/begin MEASUREMENT Brk_ctMnBrkSwtNotStp "Fault counter value for main brake switch not pressed" UBYTE OneToOne 1 100 0.00 255.0 FORMAT "%5.1" ECU_ADDRESS 0x6000A792 /end MEASUREMENT
/begin MEASUREMENT Brk_ctMnSwtContOn "Main Brake Switch continuous stepped on fault detect counter." UWORD OneToOne 1 100 0.00 65535.00 FORMAT "%8.2" ECU_ADDRESS 0x60005378 /end MEASUREMENT
/begin MEASUREMENT Brk_ctMnSwtContOnHealCond "Counter value for Main brake continuously pressed fault detection healing condition" UBYTE OneToOne 1 100 0.00 255.0 FORMAT "%5.1" ECU_ADDRESS 0x6000A791 /end MEASUREMENT
/begin MEASUREMENT Brk_ctMnSwtNotStpHealCond "Counter value for Main Brake not stepped on fault detection healing condition" UBYTE OneToOne 1 100 0.00 255.0 FORMAT "%5.1" ECU_ADDRESS 0x6000A790 /end MEASUREMENT
/begin MEASUREMENT Brk_ctPla_mp "counter brake not plausible" UBYTE OneToOne 1 100 0.00 255.0 FORMAT "%5.1" ECU_ADDRESS 0x70008ABB /end MEASUREMENT
/begin MEASUREMENT Brk_ctRdntBrkSwtNotStp "Fault counter value for redundant brake switch not pressed" UBYTE OneToOne 1 100 0.00 255.0 FORMAT "%5.1" ECU_ADDRESS 0x6000A78F /end MEASUREMENT
/begin MEASUREMENT Brk_ctRdntSwtContOn "Redundant Brake Switch continuous stepped on fault detect counter." UWORD OneToOne 1 100 0.00 65535.00 FORMAT "%8.2" ECU_ADDRESS 0x60005376 /end MEASUREMENT
/begin MEASUREMENT Brk_ctRdntSwtContOnHealCond "Counter value for Main Brake continuosly stepped on fault detection healing condition" UBYTE OneToOne 1 100 0.00 255.0 FORMAT "%5.1" ECU_ADDRESS 0x6000A78E /end MEASUREMENT
/begin MEASUREMENT Brk_ctRdntSwtNotStpHealCond "Counter value for Redundant Brake not stepped on fault detection healing condition" UBYTE OneToOne 1 100 0.00 255.0 FORMAT "%5.1" ECU_ADDRESS 0x6000A78D /end MEASUREMENT
/begin MEASUREMENT Brk_flgMaiContsOnFltCntrDi "flag to disable main brake continuous on fault detection" UBYTE OneToOne 1 100 0.00 1.000 BIT_MASK 0x1 FORMAT "%5.3" ECU_ADDRESS 0x6000A6E2 /end MEASUREMENT
/begin MEASUREMENT Brk_flgMaiNonStepFltCntrDi "flag to disable main brake not pressed fault detection" UBYTE OneToOne 1 100 0.00 1.000 BIT_MASK 0x1 FORMAT "%5.3" ECU_ADDRESS 0x6000A6E1 /end MEASUREMENT
/begin MEASUREMENT Brk_flgMnSwtContOnHealCnt "Flag for Main brake continuosly pressed error healing condition counter value" UBYTE OneToOne 1 100 0.00 255.0 FORMAT "%5.1" ECU_ADDRESS 0x6000A78C /end MEASUREMENT
/begin MEASUREMENT Brk_flgMnSwtNotStpHealCnt "Flag for Main brake not stepped on error healing condition counter value" UBYTE OneToOne 1 100 0.00 255.0 FORMAT "%5.1" ECU_ADDRESS 0x6000A78B /end MEASUREMENT
/begin MEASUREMENT Brk_flgRdntBrkOn_mp "Measuring point for Redundant Brake On flag after delay." UBYTE OneToOne 1 100 0.00 255.0 FORMAT "%5.1" ECU_ADDRESS 0x70008ABA /end MEASUREMENT
/begin MEASUREMENT Brk_flgRdntContsOnFltCntrDi "flag to disable redundant brake continuous on fault detection" UBYTE OneToOne 1 100 0.00 1.000 BIT_MASK 0x1 FORMAT "%5.3" ECU_ADDRESS 0x6000A6E0 /end MEASUREMENT
/begin MEASUREMENT Brk_flgRdntNonStepFltCntrDi "flag to disable redundant brake not pressed fault detection" UBYTE OneToOne 1 100 0.00 1.000 BIT_MASK 0x1 FORMAT "%5.3" ECU_ADDRESS 0x6000A6DF /end MEASUREMENT
/begin MEASUREMENT Brk_flgRdntSwtContOnHealCnt "Flag for redundant brake continuosly stepped on error healing condition counter" UBYTE OneToOne 1 100 0.00 255.0 FORMAT "%5.1" ECU_ADDRESS 0x6000A78A /end MEASUREMENT
/begin MEASUREMENT Brk_flgRdntSwtNotStpHealCnt "Flag for redundant brake not stepped on error healing condition counter value" UBYTE OneToOne 1 100 0.00 255.0 FORMAT "%5.1" ECU_ADDRESS 0x6000A789 /end MEASUREMENT
/begin MEASUREMENT Brk_st "Brake switch state" UBYTE OneToOne 1 100 0.00 255.0 FORMAT "%5.1" ECU_ADDRESS 0x50005D72 /end MEASUREMENT
/begin MEASUREMENT Brk_stAry "Array of Brake status input" UBYTE OneToOne 1 100 0.00 255.0 FORMAT "%5.1" ARRAY_SIZE 4 ECU_ADDRESS 0x6000A785 /end MEASUREMENT
/begin MEASUREMENT Brk_stBrkChgPrio "Turbo charger position governor." UBYTE OneToOne 1 100 0.00 255.0 FORMAT "%5.1" ECU_ADDRESS 0x6000A784 /end MEASUREMENT
/begin MEASUREMENT Brk_stBrkVSA "Brake Status based on the automatic brake execution information from VSA ( Status is high priority)" UBYTE OneToOne 1 100 0.00 255.0 FORMAT "%5.1" ECU_ADDRESS 0x6000A783 /end MEASUREMENT
/begin MEASUREMENT Brk_stMn "State main brake switch" UBYTE OneToOne 1 100 0.00 255.0 BIT_MASK 0x1 FORMAT "%5.1" ECU_ADDRESS 0x6000A6DE /end MEASUREMENT
/begin MEASUREMENT Brk_stMnBrkSwtContStp_mp "Measuring point for the status of main brake continuously pressed" UBYTE OneToOne 1 100 0.00 255.0 FORMAT "%5.1" ECU_ADDRESS 0x70008AB9 /end MEASUREMENT
/begin MEASUREMENT Brk_stMnBrkSwtNotStp_mp "Measuring point for the status of main brake switch not pressed" UBYTE OneToOne 1 100 0.00 255.0 FORMAT "%5.1" ECU_ADDRESS 0x70008AB8 /end MEASUREMENT
/begin MEASUREMENT Brk_stMnRaw "State main brake switch, raw value" UBYTE OneToOne 1 100 0.00 255.0 FORMAT "%5.1" ECU_ADDRESS 0x6000E3F9 /end MEASUREMENT
/begin MEASUREMENT Brk_stMnSwtContStpErrLstDC "Status of Main brake continuosly stepped on error condition in previous DC" UBYTE OneToOne 1 100 0.00 255.0 FORMAT "%5.1" ECU_ADDRESS 0x6000A782 /end MEASUREMENT
/begin MEASUREMENT Brk_stMnSwtNotStpErrLstDC "Status of Main Brake not stepped on error in previous DC" UBYTE OneToOne 1 100 0.00 255.0 FORMAT "%5.1" ECU_ADDRESS 0x6000A781 /end MEASUREMENT
/begin MEASUREMENT Brk_stRdntBrkSwtContStp_mp "Measuring point for the status of redundant brake continuously pressed" UBYTE OneToOne 1 100 0.00 255.0 FORMAT "%5.1" ECU_ADDRESS 0x70008AB7 /end MEASUREMENT
/begin MEASUREMENT Brk_stRdntBrkSwtNotStp_mp "Measuring point for the status of redundant brake switch not pressed" UBYTE OneToOne 1 100 0.00 255.0 FORMAT "%5.1" ECU_ADDRESS 0x70008AB6 /end MEASUREMENT
/begin MEASUREMENT Brk_stRdntSwtContStpErrLstDC "Status fo Redundant brake continuosly pressed error condition in previous DC" UBYTE OneToOne 1 100 0.00 255.0 FORMAT "%5.1" ECU_ADDRESS 0x6000A780 /end MEASUREMENT
/begin MEASUREMENT Brk_stRdntSwtNotStpErrLstDC "Status of Redundant brake not stepped on error in previuos DC" UBYTE OneToOne 1 100 0.00 255.0 FORMAT "%5.1" ECU_ADDRESS 0x6000A77F /end MEASUREMENT
/begin MEASUREMENT Brk_stRed "State redundant brake switch" UBYTE OneToOne 1 100 0.00 255.0 BIT_MASK 0x1 FORMAT "%5.1" ECU_ADDRESS 0x6000A6DD /end MEASUREMENT
/begin MEASUREMENT Brk_stRedRaw "State redundant brake switch, raw value" UBYTE OneToOne 1 100 0.00 255.0 FORMAT "%5.1" ECU_ADDRESS 0x6000E3FA /end MEASUREMENT
/begin MEASUREMENT Brk_stRstBrkNotStp "Reset for Brake not stepped condition" UBYTE OneToOne 1 100 0.00 255.0 FORMAT "%5.1" ECU_ADDRESS 0x6000A77E /end MEASUREMENT
/begin MEASUREMENT BusDiag_flgAPPLBUSOFF "Bus off state for APPL can node" UBYTE OneToOne 1 100 0.00 255.0 BIT_MASK 0x1 FORMAT "%5.1" ECU_ADDRESS 0x6000A209 /end MEASUREMENT
/begin MEASUREMENT BusDiag_flgCANCBUSOFF "Bus off state for the CAN C can node" UBYTE OneToOne 1 100 0.00 255.0 BIT_MASK 0x1 FORMAT "%5.1" ECU_ADDRESS 0x6000A208 /end MEASUREMENT
/begin MEASUREMENT BusDiag_flgVEHICLEBUSOFF "Bus off state for the VEHICLE can node" UBYTE OneToOne 1 100 0.00 255.0 BIT_MASK 0x1 FORMAT "%5.1" ECU_ADDRESS 0x6000E3FB /end MEASUREMENT
/begin MEASUREMENT B_nsp_msg "condition for post-injection" UBYTE B_TRUE 1 100 0.00 1.00000000000 BIT_MASK 0x1 FORMAT "%13.11" ECU_ADDRESS 0x700009D7 /end MEASUREMENT
/begin MEASUREMENT B_rlpdms_msg "condition for load prediction uses mass flow model at throttle valve (2. extrapolation)" UBYTE B_TRUE 1 100 0.00 1.00000000000 BIT_MASK 0x1 FORMAT "%13.11" ECU_ADDRESS 0x60000134 /end MEASUREMENT
/begin MEASUREMENT B_rlpdp_msg "condition for load prediction using the gradient of the intake manifold pressure (1. extrapolation)" UBYTE B_TRUE 1 100 0.00 1.00000000000 BIT_MASK 0x1 FORMAT "%13.11" ECU_ADDRESS 0x60000133 /end MEASUREMENT
/begin MEASUREMENT B_rlpvheus "condition load prediction for changed cam lift" UBYTE B_TRUE 1 100 0.00 1.00000000000 BIT_MASK 0x1 FORMAT "%13.11" ECU_ADDRESS 0x600000E8 /end MEASUREMENT
/begin MEASUREMENT B_rlp_msg "condition for load prediction" UBYTE B_TRUE 1 100 0.00 1.00000000000 BIT_MASK 0x1 FORMAT "%13.11" ECU_ADDRESS 0x60000135 /end MEASUREMENT
/begin MEASUREMENT B_tahevg_msg "Condition tahev is valid" UBYTE B_TRUE 1 100 0.00 1.00000000000 BIT_MASK 0x1 FORMAT "%13.11" ECU_ADDRESS 0x6000012C /end MEASUREMENT
/begin MEASUREMENT B_tired_msg "Condition reduction of active injections" UBYTE B_TRUE 1 100 0.00 1.00000000000 BIT_MASK 0x1 FORMAT "%13.11" ECU_ADDRESS 0x60000129 /end MEASUREMENT
/begin MEASUREMENT B_tochgloc "validity of signal toch" UBYTE B_TRUE 1 100 0.00 1.00000000000 BIT_MASK 0x1 FORMAT "%13.11" ECU_ADDRESS 0x600000EB /end MEASUREMENT
/begin MEASUREMENT B_tochg_msg "validity of signal toch" UBYTE B_TRUE 1 100 0.00 1.00000000000 BIT_MASK 0x1 FORMAT "%13.11" ECU_ADDRESS 0x7000097E /end MEASUREMENT
/begin MEASUREMENT B_tochlow "oiltemperature model cylinder-head (low-part)" UBYTE B_TRUE 1 100 0.00 1.00000000000 BIT_MASK 0x1 FORMAT "%13.11" ECU_ADDRESS 0x600000EA /end MEASUREMENT
/begin MEASUREMENT B_ugdsp_msg "condition predicted set value throttle angle near full load" UBYTE B_TRUE 1 100 0.00 1.00000000000 BIT_MASK 0x1 FORMAT "%13.11" ECU_ADDRESS 0x60000128 /end MEASUREMENT
/begin MEASUREMENT CBUtil_stReProgEvnt "Reprogramming Event Status flag" UBYTE OneToOne 1 100 0.00 255.0 FORMAT "%5.1" ECU_ADDRESS 0x70001BE0 /end MEASUREMENT
/begin MEASUREMENT CDRV_DELTA_TDC_CYL "Distance between TDCs in angle timer ticks." UWORD AngleCrS 1 100 0.00 1439.978 FORMAT "%8.3" ARRAY_SIZE 4 ECU_ADDRESS 0x500056E4 /end MEASUREMENT
/begin MEASUREMENT CDRV_TDC_CYL "TDCs in angle timer ticks." UWORD AngleCrS 1 100 0.00 1439.978 FORMAT "%8.3" ARRAY_SIZE 4 ECU_ADDRESS 0x500056EC /end MEASUREMENT
/begin MEASUREMENT CdSHdG_GTMLib_PMTCtr "counter to check, if continous position minus time recalculation by SW is performed" UBYTE OneToOne 1 100 0.00 255.0 FORMAT "%5.1" ECU_ADDRESS 0x6000B604 /end MEASUREMENT
/begin MEASUREMENT CEngBlkT_tCEngTCHdT2SV "sensor value engine block coolant temperature" SWORD Temp_Cels 1 100 -3549.940 3003.560 FORMAT "%8.3" ECU_ADDRESS 0x60003E98 /end MEASUREMENT
/begin MEASUREMENT CEngDsT_cntrSTCDrvgCycCold "number of driving cycles with radiation power high for tmot stuck check" UBYTE OneToOne 1 100 0.00 255.0 FORMAT "%5.1" ECU_ADDRESS 0x60009BE5 /end MEASUREMENT
/begin MEASUREMENT CEngDsT_cntrSTCDrvgCycHot "number of driving cycles with radiation power low for tmot stuck check" UBYTE OneToOne 1 100 0.00 255.0 FORMAT "%5.1" ECU_ADDRESS 0x60009BE4 /end MEASUREMENT
/begin MEASUREMENT CEngDsT_facCorrnStoi "correction factor engine temperature model" UBYTE fak_ub_b2 1 100 0.00 1.992188 FORMAT "%8.6" ECU_ADDRESS 0x6000A0FD /end MEASUREMENT
/begin MEASUREMENT CEngDsT_facFilVElec "factor for filterung vehicle speed during eletrical driving phases" UWORD fak_q1p526Em5 1 100 0.00 0.9999847 FORMAT "%9.7" ECU_ADDRESS 0x60003EC6 /end MEASUREMENT
/begin MEASUREMENT CEngDsT_facLamDesLim "Desired Lambda limitation (word)" UWORD fak_uw_b16 1 100 0.00 15.99976 FORMAT "%8.5" ECU_ADDRESS 0x60004922 /end MEASUREMENT
/begin MEASUREMENT CEngDsT_facRefMdlFan "factor for influence engine fan on reference model during engine on phases" UBYTE fak_ub_b2 1 100 0.00 1.992188 FORMAT "%8.6" ECU_ADDRESS 0x60009BE1 /end MEASUREMENT
/begin MEASUREMENT CEngDsT_facReplMdlEngOffInit "weighting-factor for calculating the initial-replacemen-value for engine-coolant temperature" UBYTE fak_ub_b1 1 100 0.00 0.9961 ECU_ADDRESS 0x60009BDE /end MEASUREMENT
/begin MEASUREMENT CEngDsT_flgBlkHeatrActvdShft "condition: Blockheater detection, when sensor-temperature is below model-temperature" UBYTE B_TRUE 1 100 0.00 1.00000000000 BIT_MASK 0x1 FORMAT "%13.11" ECU_ADDRESS 0x70000324 /end MEASUREMENT
/begin MEASUREMENT CEngDsT_flgCalcnEngStopVld "flag: CEngDsT_tStop calculation has been finished correctly in last driving cycle" UBYTE B_TRUE 1 100 0.00 1.00000000000 BIT_MASK 0x1 FORMAT "%13.11" ECU_ADDRESS 0x6003499F /end MEASUREMENT
/begin MEASUREMENT CEngDsT_flgCalcnReplMdlEngStop "Flag to indicate that model value is updated as replacement model stop temperature" UBYTE B_TRUE 1 100 0.00 1.00000000000 BIT_MASK 0x1 FORMAT "%13.11" ECU_ADDRESS 0x60037E74 /end MEASUREMENT
/begin MEASUREMENT CEngDsT_flgComErrWtrPmp "communication-Error of water pump" UBYTE B_TRUE 1 100 0.00 1.00000000000 BIT_MASK 0x1 FORMAT "%13.11" ECU_ADDRESS 0x7000034A /end MEASUREMENT
/begin MEASUREMENT CEngDsT_flgDSMClr1000msPlausDiag "DSM Clear requested for engine coolant downstream temperature sensor" UBYTE B_TRUE 1 100 0.00 1.00000000000 BIT_MASK 0x1 FORMAT "%13.11" ECU_ADDRESS 0x60009BE3 /end MEASUREMENT
/begin MEASUREMENT CEngDsT_flgEngN "Condition: Engine Rotation higher Min-Threshold" UBYTE B_TRUE 1 100 0.00 1.00000000000 BIT_MASK 0x1 FORMAT "%13.11" ECU_ADDRESS 0x7000093F /end MEASUREMENT
/begin MEASUREMENT CEngDsT_flgEngNEdgeFall "condition: Edge falling of engine speed" UBYTE B_TRUE 1 100 0.00 1.00000000000 BIT_MASK 0x1 FORMAT "%13.11" ECU_ADDRESS 0x70000323 /end MEASUREMENT
/begin MEASUREMENT CEngDsT_flgEngRotDeb "condition engine rotation debounced" UBYTE B_TRUE 1 100 0.00 1.00000000000 BIT_MASK 0x1 FORMAT "%13.11" ECU_ADDRESS 0x7000031E /end MEASUREMENT
/begin MEASUREMENT CEngDsT_flgEngTFall "condition: falling engie coolant temperature" UBYTE B_TRUE 1 100 0.00 1.00000000000 BIT_MASK 0x1 FORMAT "%13.11" ECU_ADDRESS 0x70000322 /end MEASUREMENT
/begin MEASUREMENT CEngDsT_flgFanFlapRelsLSC "Flag for Fan flap LSC release" UBYTE B_TRUE 1 100 0.00 1.00000000000 BIT_MASK 0x1 FORMAT "%13.11" ECU_ADDRESS 0x70000349 /end MEASUREMENT
/begin MEASUREMENT CEngDsT_flgFuEngStop "Fueled Engine Stop" UBYTE B_TRUE 1 100 0.00 1.00000000000 BIT_MASK 0x1 FORMAT "%13.11" ECU_ADDRESS 0x70000321 /end MEASUREMENT
/begin MEASUREMENT CEngDsT_flgImpsClr "Clear request loose connection check Engine Coolant Temperature Sensor" UBYTE B_TRUE 1 100 0.00 1.00000000000 BIT_MASK 0x1 FORMAT "%13.11" ECU_ADDRESS 0x7000031D /end MEASUREMENT
/begin MEASUREMENT CEngDsT_flgImpsDi "disable flag loose connection check Engine Coolant temperature Sensor" UBYTE B_TRUE 1 100 0.00 1.00000000000 BIT_MASK 0x1 FORMAT "%13.11" ECU_ADDRESS 0x7000093E /end MEASUREMENT
/begin MEASUREMENT CEngDsT_flgImpsErr "error Loose-Connection-Check engine coolant temperature sensor" UBYTE B_TRUE 1 100 0.00 1.00000000000 BIT_MASK 0x1 FORMAT "%13.11" ECU_ADDRESS 0x7000093D /end MEASUREMENT
/begin MEASUREMENT CEngDsT_flgImpsErrTmp "undebounced error Loose-Connection-Check engine coolant temperature sensor" UBYTE B_TRUE 1 100 0.00 1.00000000000 BIT_MASK 0x1 FORMAT "%13.11" ECU_ADDRESS 0x70000358 /end MEASUREMENT
/begin MEASUREMENT CEngDsT_flgImpsErrTmpDeb "debounced temporary error Loose-Connection-Check engine coolant temperature sensor" UBYTE B_TRUE 1 100 0.00 1.00000000000 BIT_MASK 0x1 FORMAT "%13.11" ECU_ADDRESS 0x70000357 /end MEASUREMENT
/begin MEASUREMENT CEngDsT_flgImpsFF "FlipFlop error Loose-Connection-Check engine coolant temperature sensor" UBYTE B_TRUE 1 100 0.00 1.00000000000 BIT_MASK 0x1 FORMAT "%13.11" ECU_ADDRESS 0x70000356 /end MEASUREMENT
/begin MEASUREMENT CEngDsT_flgImpsHeal "healing Loose-Connection-Check engine coolant temperature sensor" UBYTE B_TRUE 1 100 0.00 1.00000000000 BIT_MASK 0x1 FORMAT "%13.11" ECU_ADDRESS 0x7000093C /end MEASUREMENT
/begin MEASUREMENT CEngDsT_flgImpsStr "storage error Loose-Connection-Check engine coolant temperature sensor" UBYTE B_TRUE 1 100 0.00 1.00000000000 BIT_MASK 0x1 FORMAT "%13.11" ECU_ADDRESS 0x60034990 /end MEASUREMENT
/begin MEASUREMENT CEngDsT_flgLSCEnad "Condition: LSC-diagnosis released" UBYTE B_TRUE 1 100 0.00 1.00000000000 BIT_MASK 0x1 FORMAT "%13.11" ECU_ADDRESS 0x70000348 /end MEASUREMENT
/begin MEASUREMENT CEngDsT_flgLSCEngNEnagThd "Condition: Engine rotation in defined range for enabling Low-Side-Check" UBYTE B_TRUE 1 100 0.00 1.00000000000 BIT_MASK 0x1 FORMAT "%13.11" ECU_ADDRESS 0x70000347 /end MEASUREMENT
/begin MEASUREMENT CEngDsT_flgLSCEngNEnagThdHi "Condition: Engine Roation higher than enabling threshold Low-Side-Check" UBYTE B_TRUE 1 100 0.00 1.00000000000 BIT_MASK 0x1 FORMAT "%13.11" ECU_ADDRESS 0x70000346 /end MEASUREMENT
/begin MEASUREMENT CEngDsT_flgLSCEngNEnagThdLo "Condition: Engine Roation lower than enabling threshold Low-Side-Check" UBYTE B_TRUE 1 100 0.00 1.00000000000 BIT_MASK 0x1 FORMAT "%13.11" ECU_ADDRESS 0x70000345 /end MEASUREMENT
/begin MEASUREMENT CEngDsT_flgLSCEnvTEnad "Engine coolant temperature as a enable condition for low side check" UBYTE B_TRUE 1 100 0.00 1.00000000000 BIT_MASK 0x1 FORMAT "%13.11" ECU_ADDRESS 0x70000344 /end MEASUREMENT
/begin MEASUREMENT CEngDsT_flgLSCEnvTHealEnad "condition flag to enable healing of low-side-check when engine temperature at start within threshold." UBYTE B_TRUE 1 100 0.00 1.00000000000 BIT_MASK 0x1 FORMAT "%13.11" ECU_ADDRESS 0x70000343 /end MEASUREMENT
/begin MEASUREMENT CEngDsT_flgLSCErrDi "Condition: LSC-diagnosis not released" UBYTE B_TRUE 1 100 0.00 1.00000000000 BIT_MASK 0x1 FORMAT "%13.11" ECU_ADDRESS 0x70000342 /end MEASUREMENT
/begin MEASUREMENT CEngDsT_flgLSCHealEnag "Condition: Healing LSC enabled" UBYTE B_TRUE 1 100 0.00 1.00000000000 BIT_MASK 0x1 FORMAT "%13.11" ECU_ADDRESS 0x70000341 /end MEASUREMENT
/begin MEASUREMENT CEngDsT_flgLSCHealLockd "healing of LSC locked by low load driving cycle" UBYTE B_TRUE 1 100 0.00 1.00000000000 BIT_MASK 0x1 FORMAT "%13.11" ECU_ADDRESS 0x70000340 /end MEASUREMENT
/begin MEASUREMENT CEngDsT_flgLSCRefMdlEnagThd "Condition: reference model threshold for enabling LSC reached" UBYTE B_TRUE 1 100 0.00 1.00000000000 BIT_MASK 0x1 FORMAT "%13.11" ECU_ADDRESS 0x7000033F /end MEASUREMENT
/begin MEASUREMENT CEngDsT_flgLSCSnsrRefMdlEnd "Flag: The start temperature of the engine coolant is below the reference model end value" UBYTE B_TRUE 1 100 0.00 1.00000000000 BIT_MASK 0x1 FORMAT "%13.11" ECU_ADDRESS 0x7000033E /end MEASUREMENT
/begin MEASUREMENT CEngDsT_flgLSCStrtEnd "Condition: detection of engine start-end for lowside check" UBYTE B_TRUE 1 100 0.00 1.00000000000 BIT_MASK 0x1 FORMAT "%13.11" ECU_ADDRESS 0x7000033D /end MEASUREMENT
/begin MEASUREMENT CEngDsT_flgNgvGrdtRstTMdl "flag to indicate the detection of negative gradient of engine block temperature or cylinder head temperature to reset the model" UBYTE B_TRUE 1 100 0.00 1.00000000000 BIT_MASK 0x1 FORMAT "%13.11" ECU_ADDRESS 0x60009BE0 /end MEASUREMENT
/begin MEASUREMENT CEngDsT_flgOvrRun "condition: fuel cutoff" UBYTE B_TRUE 1 100 0.00 1.00000000000 BIT_MASK 0x1 FORMAT "%13.11" ECU_ADDRESS 0x7000093B /end MEASUREMENT
/begin MEASUREMENT CEngDsT_flgPhevChrgnMod "PHEV charge mode activated. Sensor values freezed." UBYTE B_TRUE 1 100 0.00 1.00000000000 BIT_MASK 0x1 FORMAT "%13.11" ECU_ADDRESS 0x7000093A /end MEASUREMENT
/begin MEASUREMENT CEngDsT_flgPhevChrgnModEdgeFall "Edge Falling of CEngDsT_flgPhevChrgnMod" UBYTE B_TRUE 1 100 0.00 1.00000000000 BIT_MASK 0x1 FORMAT "%13.11" ECU_ADDRESS 0x70000939 /end MEASUREMENT
/begin MEASUREMENT CEngDsT_flgPlausHSCErr "Interface: enable-bit for high-side-check of tmot-sensor" UBYTE B_TRUE 1 100 0.00 1.00000000000 BIT_MASK 0x1 FORMAT "%13.11" ECU_ADDRESS 0x70000938 /end MEASUREMENT
/begin MEASUREMENT CEngDsT_flgPlausHSCErrTmp "Condition: High-Side-Check-Error for engine coolant temperature sensor undebounced" UBYTE B_TRUE 1 100 0.00 1.00000000000 BIT_MASK 0x1 FORMAT "%13.11" ECU_ADDRESS 0x7000033C /end MEASUREMENT
/begin MEASUREMENT CEngDsT_flgPlausHSCHeal "healing High-Side-Check plausibility diagnosis engine coolant temperature sensor" UBYTE B_TRUE 1 100 0.00 1.00000000000 BIT_MASK 0x1 FORMAT "%13.11" ECU_ADDRESS 0x70000937 /end MEASUREMENT
/begin MEASUREMENT CEngDsT_flgPlausHSCHealTmp "Condition: Healing High-Side-Check-Error engine coolant temperature sensor undebounced" UBYTE B_TRUE 1 100 0.00 1.00000000000 BIT_MASK 0x1 FORMAT "%13.11" ECU_ADDRESS 0x7000033B /end MEASUREMENT
/begin MEASUREMENT CEngDsT_flgPlausHSCRiseNr "Condition: IUMPR-release for HSC-diagnosis" UBYTE B_TRUE 1 100 0.00 1.00000000000 BIT_MASK 0x1 FORMAT "%13.11" ECU_ADDRESS 0x70000936 /end MEASUREMENT
/begin MEASUREMENT CEngDsT_flgPlausHSCRiseNrTmp "Bedingung: IUMPR-Freigabe für Diagnose HSC" UBYTE B_TRUE 1 100 0.00 1.00000000000 BIT_MASK 0x1 FORMAT "%13.11" ECU_ADDRESS 0x7000033A /end MEASUREMENT
/begin MEASUREMENT CEngDsT_flgPlausLSCDi "Condition: Disabling Low-Side-Check of Plausibility diagnosis Engine Coolant Temperature Sensor" UBYTE B_TRUE 1 100 0.00 1.00000000000 BIT_MASK 0x1 FORMAT "%13.11" ECU_ADDRESS 0x70000935 /end MEASUREMENT
/begin MEASUREMENT CEngDsT_flgPlausLSCErr "Condition: Error Low-Side-Check for engine coolant temperature sensor" UBYTE B_TRUE 1 100 0.00 1.00000000000 BIT_MASK 0x1 FORMAT "%13.11" ECU_ADDRESS 0x70000934 /end MEASUREMENT
/begin MEASUREMENT CEngDsT_flgPlausLSCErrTmp "LowSideCheck-Error for engine coolant temperature sensor (previous)" UBYTE B_TRUE 1 100 0.00 1.00000000000 BIT_MASK 0x1 FORMAT "%13.11" ECU_ADDRESS 0x70000339 /end MEASUREMENT
/begin MEASUREMENT CEngDsT_flgPlausLSCHeal "healing Low-Side-Check plausibility diagnosis engine coolant temperature sensor" UBYTE B_TRUE 1 100 0.00 1.00000000000 BIT_MASK 0x1 FORMAT "%13.11" ECU_ADDRESS 0x70000933 /end MEASUREMENT
/begin MEASUREMENT CEngDsT_flgPlausLSCHealTmp "Condition: Healing Low-Side-Check engine coolant temperature sensor undebounced" UBYTE B_TRUE 1 100 0.00 1.00000000000 BIT_MASK 0x1 FORMAT "%13.11" ECU_ADDRESS 0x70000338 /end MEASUREMENT
/begin MEASUREMENT CEngDsT_flgPlausLSCRiseNr "Condition: IUMPR-release for LSC-diagnosis" UBYTE B_TRUE 1 100 0.00 1.00000000000 BIT_MASK 0x1 FORMAT "%13.11" ECU_ADDRESS 0x70000932 /end MEASUREMENT
/begin MEASUREMENT CEngDsT_flgPlausLSCRiseNrTmp "Condition: IUMPR-release for LSC-diagnosis" UBYTE B_TRUE 1 100 0.00 1.00000000000 BIT_MASK 0x1 FORMAT "%13.11" ECU_ADDRESS 0x70000337 /end MEASUREMENT
/begin MEASUREMENT CEngDsT_flgPlausSTCDi "Condition: Disabling Stuck-Side-Check of Plausibility diagnosis Engine Coolant Temperature Sensor" UBYTE B_TRUE 1 100 0.00 1.00000000000 BIT_MASK 0x1 FORMAT "%13.11" ECU_ADDRESS 0x70000931 /end MEASUREMENT
/begin MEASUREMENT CEngDsT_flgPlausSTCErr "Condition: Error Stuck-Check for engine coolant temperature sensor" UBYTE B_TRUE 1 100 0.00 1.00000000000 BIT_MASK 0x1 FORMAT "%13.11" ECU_ADDRESS 0x70000930 /end MEASUREMENT
/begin MEASUREMENT CEngDsT_flgPlausSTCErrTmp "StuckCheck-Error for engine coolant temperature sensor (previous)" UBYTE B_TRUE 1 100 0.00 1.00000000000 BIT_MASK 0x1 FORMAT "%13.11" ECU_ADDRESS 0x70000336 /end MEASUREMENT
/begin MEASUREMENT CEngDsT_flgPlausSTCHeal "Condition: HealingStuck-Check for engine coolant temperature sensor" UBYTE B_TRUE 1 100 0.00 1.00000000000 BIT_MASK 0x1 FORMAT "%13.11" ECU_ADDRESS 0x7000092F /end MEASUREMENT
/begin MEASUREMENT CEngDsT_flgPlausSTCHealTmp "HealingCondition (StuckCheck) for engine coolant temperature sensor (previous)" UBYTE B_TRUE 1 100 0.00 1.00000000000 BIT_MASK 0x1 FORMAT "%13.11" ECU_ADDRESS 0x70000335 /end MEASUREMENT
/begin MEASUREMENT CEngDsT_flgPlausSTCRiseNr "Condition: IUMPR-release for STC-diagnosis" UBYTE B_TRUE 1 100 0.00 1.00000000000 BIT_MASK 0x1 FORMAT "%13.11" ECU_ADDRESS 0x7000092E /end MEASUREMENT
/begin MEASUREMENT CEngDsT_flgPlausSTCRiseNrTmp "Condition: IUMPR-release for STC-diagnosis" UBYTE B_TRUE 1 100 0.00 1.00000000000 BIT_MASK 0x1 FORMAT "%13.11" ECU_ADDRESS 0x70000334 /end MEASUREMENT
/begin MEASUREMENT CEngDsT_flgRefMdlCalcnGrdOn "calculation of gradient (in state engine running) reference value model engine coolant temperature enabled" UBYTE B_TRUE 1 100 0.00 1.00000000000 BIT_MASK 0x1 FORMAT "%13.11" ECU_ADDRESS 0x7000092D /end MEASUREMENT
/begin MEASUREMENT CEngDsT_flgRefMdlEndVal "Final value for the reference engine temperature model was reached" UBYTE B_TRUE 1 100 0.00 1.00000000000 BIT_MASK 0x1 FORMAT "%13.11" ECU_ADDRESS 0x70000333 /end MEASUREMENT
/begin MEASUREMENT CEngDsT_flgRefMdlFrstStop "condition: first engine stop after first engine start" UBYTE B_TRUE 1 100 0.00 1.00000000000 BIT_MASK 0x1 FORMAT "%13.11" ECU_ADDRESS 0x7000092C /end MEASUREMENT
/begin MEASUREMENT CEngDsT_flgRefMdlRst "reference model for engine coolant temperature: reset" UBYTE B_TRUE 1 100 0.00 1.00000000000 BIT_MASK 0x1 FORMAT "%13.11" ECU_ADDRESS 0x70000320 /end MEASUREMENT
/begin MEASUREMENT CEngDsT_flgRefMdlRstLongStop "reset of reference model value after long engine off phases" UBYTE B_TRUE 1 100 0.00 1.00000000000 BIT_MASK 0x1 FORMAT "%13.11" ECU_ADDRESS 0x7000092B /end MEASUREMENT
/begin MEASUREMENT CEngDsT_flgRefMdlStrt "condition engine start for reference temperature model fulfilled" UBYTE B_TRUE 1 100 0.00 1.00000000000 BIT_MASK 0x1 FORMAT "%13.11" ECU_ADDRESS 0x7000092A /end MEASUREMENT
/begin MEASUREMENT CEngDsT_flgRefMdlStrtEndFrst "Condition: first start end" UBYTE B_TRUE 1 100 0.00 1.00000000000 BIT_MASK 0x1 FORMAT "%13.11" ECU_ADDRESS 0x70000929 /end MEASUREMENT
/begin MEASUREMENT CEngDsT_flgReplMdlEngOffRst "Soack time after engine stall was reseted" UBYTE B_TRUE 1 100 0.00 1.00000000000 BIT_MASK 0x1 FORMAT "%13.11" ECU_ADDRESS 0x70000928 /end MEASUREMENT
/begin MEASUREMENT CEngDsT_flgSetDFC1000ms "DSM Report is allowed (1000ms)" UBYTE B_TRUE 1 100 0.00 1.00000000000 BIT_MASK 0x1 FORMAT "%13.11" ECU_ADDRESS 0x7000031C /end MEASUREMENT
/begin MEASUREMENT CEngDsT_flgSetDFC100ms "DSM Report is allowed (100ms)" UBYTE B_TRUE 1 100 0.00 1.00000000000 BIT_MASK 0x1 FORMAT "%13.11" ECU_ADDRESS 0x7000031B /end MEASUREMENT
/begin MEASUREMENT CEngDsT_flgSigClr "Clear request signal check Engine Coolant Temperature Sensor" UBYTE B_TRUE 1 100 0.00 1.00000000000 BIT_MASK 0x1 FORMAT "%13.11" ECU_ADDRESS 0x7000031A /end MEASUREMENT
/begin MEASUREMENT CEngDsT_flgSigErr "error Signal-Check engine coolant temperature sensor" UBYTE B_TRUE 1 100 0.00 1.00000000000 BIT_MASK 0x1 FORMAT "%13.11" ECU_ADDRESS 0x70000923 /end MEASUREMENT
/begin MEASUREMENT CEngDsT_flgSigErrTmp "undebounced error Signal-Check engine coolant temperature sensor" UBYTE B_TRUE 1 100 0.00 1.00000000000 BIT_MASK 0x1 FORMAT "%13.11" ECU_ADDRESS 0x70000355 /end MEASUREMENT
/begin MEASUREMENT CEngDsT_flgSigHeal "healing Signal-Check engine coolant temperature sensor" UBYTE B_TRUE 1 100 0.00 1.00000000000 BIT_MASK 0x1 FORMAT "%13.11" ECU_ADDRESS 0x70000922 /end MEASUREMENT
/begin MEASUREMENT CEngDsT_flgSnsrClr "Clear request Engine Coolant Temperature Sensor" UBYTE B_TRUE 1 100 0.00 1.00000000000 BIT_MASK 0x1 FORMAT "%13.11" ECU_ADDRESS 0x70000921 /end MEASUREMENT
/begin MEASUREMENT CEngDsT_flgSnsrColdStrtClr "Clear request cold start diagnosis Engine Coolant Temperature Sensor" UBYTE B_TRUE 1 100 0.00 1.00000000000 BIT_MASK 0x1 FORMAT "%13.11" ECU_ADDRESS 0x70000920 /end MEASUREMENT
/begin MEASUREMENT CEngDsT_flgSnsrColdStrtVld "Validity-Flag cold start diagnosis Engine Coolant Temperature Sensor" UBYTE B_TRUE 1 100 0.00 1.00000000000 BIT_MASK 0x1 FORMAT "%13.11" ECU_ADDRESS 0x70000319 /end MEASUREMENT
/begin MEASUREMENT CEngDsT_flgSnsrElecClr "Clear request Diagnostic Fault Check electrical diagnosis engine coolant temperature sensor" UBYTE B_TRUE 1 100 0.00 1.00000000000 BIT_MASK 0x1 FORMAT "%13.11" ECU_ADDRESS 0x7000091F /end MEASUREMENT
/begin MEASUREMENT CEngDsT_flgSnsrElecVld "electrical validity engine coolant temperature sensor" UBYTE B_TRUE 1 100 0.00 1.00000000000 BIT_MASK 0x1 FORMAT "%13.11" ECU_ADDRESS 0x7000091E /end MEASUREMENT
/begin MEASUREMENT CEngDsT_flgSnsrElecVldDebInit "Flag for switch debounce time electrical validity engine coolant temperature sensor" UBYTE B_TRUE 1 100 0.00 1.00000000000 BIT_MASK 0x1 FORMAT "%13.11" ECU_ADDRESS 0x70000354 /end MEASUREMENT
/begin MEASUREMENT CEngDsT_flgSnsrElecVldTmp "undebounced electrical validity engine coolant temperature sensor" UBYTE B_TRUE 1 100 0.00 1.00000000000 BIT_MASK 0x1 FORMAT "%13.11" ECU_ADDRESS 0x70000353 /end MEASUREMENT
/begin MEASUREMENT CEngDsT_flgSnsrLCEna "Loose Connect Check is enable" UBYTE B_TRUE 1 100 0.00 1.00000000000 BIT_MASK 0x1 FORMAT "%13.11" ECU_ADDRESS 0x70000352 /end MEASUREMENT
/begin MEASUREMENT CEngDsT_flgSnsrPlausClr "Condition: Clear-Request Plausibility diagnosis Engine Coolant Temperature Sensor" UBYTE B_TRUE 1 100 0.00 1.00000000000 BIT_MASK 0x1 FORMAT "%13.11" ECU_ADDRESS 0x7000091D /end MEASUREMENT
/begin MEASUREMENT CEngDsT_flgSnsrPlausVld "Validity bit on the basis of the plausibility-diagnosis coolant temperature sensor" UBYTE B_TRUE 1 100 0.00 1.00000000000 BIT_MASK 0x1 FORMAT "%13.11" ECU_ADDRESS 0x70000318 /end MEASUREMENT
/begin MEASUREMENT CEngDsT_flgSnsrSigAvl "Validity Flag: signal from engine coolant temperature sensor available" UBYTE B_TRUE 1 100 0.00 1.00000000000 BIT_MASK 0x1 FORMAT "%13.11" ECU_ADDRESS 0x7000091C /end MEASUREMENT
/begin MEASUREMENT CEngDsT_flgSnsrSigAvlER "Validity Flag: signal from engine coolant temperature sensor available (after edge-rising)" UBYTE B_TRUE 1 100 0.00 1.00000000000 BIT_MASK 0x1 FORMAT "%13.11" ECU_ADDRESS 0x70000351 /end MEASUREMENT
/begin MEASUREMENT CEngDsT_flgSnsrVld "Bit: signal from engine coolant temperature sensor is error-free" UBYTE B_TRUE 1 100 0.00 1.00000000000 BIT_MASK 0x1 FORMAT "%13.11" ECU_ADDRESS 0x7000091B /end MEASUREMENT
/begin MEASUREMENT CEngDsT_flgSnsrVldLoc "Bit: signal from engine coolant temperature sensor is error-free (local)" UBYTE B_TRUE 1 100 0.00 1.00000000000 BIT_MASK 0x1 FORMAT "%13.11" ECU_ADDRESS 0x70000317 /end MEASUREMENT
/begin MEASUREMENT CEngDsT_flgSnsrVldStop "Bit: engine off temperature CEngDsT_tStop is valid" UBYTE B_TRUE 1 100 0.00 1.00000000000 BIT_MASK 0x1 FORMAT "%13.11" ECU_ADDRESS 0x6003499E /end MEASUREMENT
/begin MEASUREMENT CEngDsT_flgSnsrVldStopFrst "validity information for CEngDsT_tStopFrst" UBYTE B_TRUE 1 100 0.00 1.00000000000 BIT_MASK 0x1 FORMAT "%13.11" ECU_ADDRESS 0x7000091A /end MEASUREMENT
/begin MEASUREMENT CEngDsT_flgSnsrVldStrt "Bit: engine start temperature is valid" UBYTE B_TRUE 1 100 0.00 1.00000000000 BIT_MASK 0x1 FORMAT "%13.11" ECU_ADDRESS 0x70000919 /end MEASUREMENT
/begin MEASUREMENT CEngDsT_flgSnsrVldStrtFrst "Bit: engine start temperature at first start is valid" UBYTE B_TRUE 1 100 0.00 1.00000000000 BIT_MASK 0x1 FORMAT "%13.11" ECU_ADDRESS 0x70000918 /end MEASUREMENT
/begin MEASUREMENT CEngDsT_flgSRCClr "Clear request signal range check Engine Coolant Temperature Sensor" UBYTE B_TRUE 1 100 0.00 1.00000000000 BIT_MASK 0x1 FORMAT "%13.11" ECU_ADDRESS 0x70000316 /end MEASUREMENT
/begin MEASUREMENT CEngDsT_flgSRCDebInit "Flag for switch debounce time Signal-Range-Checky engine compartment temperature sensor" UBYTE B_TRUE 1 100 0.00 1.00000000000 BIT_MASK 0x1 FORMAT "%13.11" ECU_ADDRESS 0x70000350 /end MEASUREMENT
/begin MEASUREMENT CEngDsT_flgSRCErr "debounced error Signal-Range-Check engine coolant temperature sensor" UBYTE B_TRUE 1 100 0.00 1.00000000000 BIT_MASK 0x1 FORMAT "%13.11" ECU_ADDRESS 0x7000034F /end MEASUREMENT
/begin MEASUREMENT CEngDsT_flgSRCErrTmp "undebounced error Signal-Range-Check engine coolant temperature sensor" UBYTE B_TRUE 1 100 0.00 1.00000000000 BIT_MASK 0x1 FORMAT "%13.11" ECU_ADDRESS 0x7000034E /end MEASUREMENT
/begin MEASUREMENT CEngDsT_flgSRCHealTmp "temporrary healing Signal-Range-Check engine coolant temperature sensor" UBYTE B_TRUE 1 100 0.00 1.00000000000 BIT_MASK 0x1 FORMAT "%13.11" ECU_ADDRESS 0x7000034D /end MEASUREMENT
/begin MEASUREMENT CEngDsT_flgSRCMaxErr "debounced Max-error Signal-Range-Check engine coolant temperature sensor" UBYTE B_TRUE 1 100 0.00 1.00000000000 BIT_MASK 0x1 FORMAT "%13.11" ECU_ADDRESS 0x70000927 /end MEASUREMENT
/begin MEASUREMENT CEngDsT_flgSRCMaxErrTmp "undebounced Max-error Signal-Range-Check engine coolant temperature sensor" UBYTE B_TRUE 1 100 0.00 1.00000000000 BIT_MASK 0x1 FORMAT "%13.11" ECU_ADDRESS 0x7000034C /end MEASUREMENT
/begin MEASUREMENT CEngDsT_flgSRCMaxHeal "healing max error Signal-Range-Check engine coolant temperature sensor" UBYTE B_TRUE 1 100 0.00 1.00000000000 BIT_MASK 0x1 FORMAT "%13.11" ECU_ADDRESS 0x70000926 /end MEASUREMENT
/begin MEASUREMENT CEngDsT_flgSRCMinErr "debounced Min-error Signal-Range-Check engine coolant temperature sensor" UBYTE B_TRUE 1 100 0.00 1.00000000000 BIT_MASK 0x1 FORMAT "%13.11" ECU_ADDRESS 0x70000925 /end MEASUREMENT
/begin MEASUREMENT CEngDsT_flgSRCMinErrTmp "undebounced Min-error Signal-Range-Check engine coolant temperature sensor" UBYTE B_TRUE 1 100 0.00 1.00000000000 BIT_MASK 0x1 FORMAT "%13.11" ECU_ADDRESS 0x7000034B /end MEASUREMENT
/begin MEASUREMENT CEngDsT_flgSRCMinHeal "Heilung Min-Fehler elektrische Bereichsprüfung KühlmitteltemperaturSensor" UBYTE B_TRUE 1 100 0.00 1.00000000000 BIT_MASK 0x1 FORMAT "%13.11" ECU_ADDRESS 0x70000924 /end MEASUREMENT
/begin MEASUREMENT CEngDsT_flgSTCCold "stuck check engine coolant temperature sensor: condition engine coolant temperature low" UBYTE B_TRUE 1 100 0.00 1.00000000000 BIT_MASK 0x1 FORMAT "%13.11" ECU_ADDRESS 0x70000332 /end MEASUREMENT
/begin MEASUREMENT CEngDsT_flgSTCDrvgCycCold "Condition: high radiation power" UBYTE B_TRUE 1 100 0.00 1.00000000000 BIT_MASK 0x1 FORMAT "%13.11" ECU_ADDRESS 0x70000331 /end MEASUREMENT
/begin MEASUREMENT CEngDsT_flgSTCDrvgCycColdCntUp "Condition: increase counter Driving Cycle Cold" UBYTE B_TRUE 1 100 0.00 1.00000000000 BIT_MASK 0x1 FORMAT "%13.11" ECU_ADDRESS 0x70000330 /end MEASUREMENT
/begin MEASUREMENT CEngDsT_flgSTCDrvgCycColdHot "Condition: numver of driving cycles with high and low radiation power reached" UBYTE B_TRUE 1 100 0.00 1.00000000000 BIT_MASK 0x1 FORMAT "%13.11" ECU_ADDRESS 0x7000032F /end MEASUREMENT
/begin MEASUREMENT CEngDsT_flgSTCDrvgCycHot "Condition: low radiation power" UBYTE B_TRUE 1 100 0.00 1.00000000000 BIT_MASK 0x1 FORMAT "%13.11" ECU_ADDRESS 0x7000032E /end MEASUREMENT
/begin MEASUREMENT CEngDsT_flgSTCDrvgCycHotCntUp "Condition: increase counter Driving Cycle Hot" UBYTE B_TRUE 1 100 0.00 1.00000000000 BIT_MASK 0x1 FORMAT "%13.11" ECU_ADDRESS 0x7000032D /end MEASUREMENT
/begin MEASUREMENT CEngDsT_flgSTCEnad "Condition: Stuck-Check enabled" UBYTE B_TRUE 1 100 0.00 1.00000000000 BIT_MASK 0x1 FORMAT "%13.11" ECU_ADDRESS 0x7000032C /end MEASUREMENT
/begin MEASUREMENT CEngDsT_flgSTCErrDi "Condition: Stuck-Check disabled by component error" UBYTE B_TRUE 1 100 0.00 1.00000000000 BIT_MASK 0x1 FORMAT "%13.11" ECU_ADDRESS 0x7000032B /end MEASUREMENT
/begin MEASUREMENT CEngDsT_flgSTCHot "Stuck check engine coolant temperature: condition engine coolant temperature high" UBYTE B_TRUE 1 100 0.00 1.00000000000 BIT_MASK 0x1 FORMAT "%13.11" ECU_ADDRESS 0x7000032A /end MEASUREMENT
/begin MEASUREMENT CEngDsT_flgSTCTDifSnsrFildThdLo "difference (min and max value) engine coolant temperature lower threshold" UBYTE B_TRUE 1 100 0.00 1.00000000000 BIT_MASK 0x1 FORMAT "%13.11" ECU_ADDRESS 0x70000329 /end MEASUREMENT
/begin MEASUREMENT CEngDsT_flgSTCTmrColdOnEnad "Condition: timer for condition Cold Stuck-Check enabled" UBYTE B_TRUE 1 100 0.00 1.00000000000 BIT_MASK 0x1 FORMAT "%13.11" ECU_ADDRESS 0x70000328 /end MEASUREMENT
/begin MEASUREMENT CEngDsT_flgSTCTmrColdRst "Condition: reset timer for condition Cold Stuck-Check" UBYTE B_TRUE 1 100 0.00 1.00000000000 BIT_MASK 0x1 FORMAT "%13.11" ECU_ADDRESS 0x70000327 /end MEASUREMENT
/begin MEASUREMENT CEngDsT_flgSTCTmrHotOnEnad "Condition: timer for condition Hot Stuck-Check enabled" UBYTE B_TRUE 1 100 0.00 1.00000000000 BIT_MASK 0x1 FORMAT "%13.11" ECU_ADDRESS 0x70000326 /end MEASUREMENT
/begin MEASUREMENT CEngDsT_flgSTCTmrHotRst "Condition: reset timer for condition Hot Stuck-Check" UBYTE B_TRUE 1 100 0.00 1.00000000000 BIT_MASK 0x1 FORMAT "%13.11" ECU_ADDRESS 0x70000325 /end MEASUREMENT
/begin MEASUREMENT CEngDsT_flgStopFrst "Bit: first engine stop during actual driving cycle has taken place" UBYTE B_TRUE 1 100 0.00 1.00000000000 BIT_MASK 0x1 FORMAT "%13.11" ECU_ADDRESS 0x70000917 /end MEASUREMENT
/begin MEASUREMENT CEngDsT_flgStrtEnd "condition end of start" UBYTE B_TRUE 1 100 0.00 1.00000000000 BIT_MASK 0x1 FORMAT "%13.11" ECU_ADDRESS 0x70000916 /end MEASUREMENT
/begin MEASUREMENT CEngDsT_flgStrtEndFrst "condition first end of start in cycle" UBYTE B_TRUE 1 100 0.00 1.00000000000 BIT_MASK 0x1 FORMAT "%13.11" ECU_ADDRESS 0x70000915 /end MEASUREMENT
/begin MEASUREMENT CEngDsT_flgSwtRefMdlWtrPmp "condition: usage of influence water pump during engine off phases" UBYTE B_TRUE 1 100 0.00 1.00000000000 BIT_MASK 0x1 FORMAT "%13.11" ECU_ADDRESS 0x7000031F /end MEASUREMENT
/begin MEASUREMENT CEngDsT_flgSwtReplMdl "Condition - calculation replacement value" UBYTE B_TRUE 1 100 0.00 1.00000000000 BIT_MASK 0x1 FORMAT "%13.11" ECU_ADDRESS 0x70000914 /end MEASUREMENT
/begin MEASUREMENT CEngDsT_flgSwtReplMdlStrt "control-flag for switching over to replacement-value of engine-coolant temperature at start" UBYTE B_TRUE 1 100 0.00 1.00000000000 BIT_MASK 0x1 FORMAT "%13.11" ECU_ADDRESS 0x70000913 /end MEASUREMENT
/begin MEASUREMENT CEngDsT_flgSwtReplMdlStrtEdgeFall "edge falling: control-flag for switching over to replacement-value of engine-coolant temperature at start" UBYTE B_TRUE 1 100 0.00 1.00000000000 BIT_MASK 0x1 FORMAT "%13.11" ECU_ADDRESS 0x70000912 /end MEASUREMENT
/begin MEASUREMENT CEngDsT_mAirIntgl "integrated air mass flow from engine start to maximum value (copy for CEngDsT)" UBYTE m_ub_b23p3 1 100 0.00 23.21 FORMAT "%5.2" ECU_ADDRESS 0x6000A0FC /end MEASUREMENT
/begin MEASUREMENT CEngDsT_mfAir "Air mass flow copy for CEngDsT package" UBYTE m_ub_b1020 1 100 0.00 1020. FORMAT "%5.0" ECU_ADDRESS 0x6000A0FB /end MEASUREMENT
/begin MEASUREMENT CEngDsT_mfAirPLD "air mass flow for plausibility check" UBYTE m_ub_b1020 1 100 0.00 1020. FORMAT "%5.0" ECU_ADDRESS 0x60009BE2 /end MEASUREMENT
/begin MEASUREMENT CEngDsT_mfAirStoi "air mass flow related on lambda=1" UBYTE m_ub_b1020 1 100 0.00 1020. FORMAT "%5.0" ECU_ADDRESS 0x6000A0FA /end MEASUREMENT
/begin MEASUREMENT CEngDsT_mfAirStoiRefMdl "air mass flow related on lambda=1" UBYTE m_ub_b1020 1 100 0.00 1020. FORMAT "%5.0" ECU_ADDRESS 0x60009BDF /end MEASUREMENT
/begin MEASUREMENT CEngDsT_stDiagCycRprt1000ms "Status flag to enable cyclic reporting to DSM in 1000ms" UBYTE B_TRUE 1 100 0.00 1.00000000000 BIT_MASK 0x1 FORMAT "%13.11" ECU_ADDRESS 0x60009BDC /end MEASUREMENT
/begin MEASUREMENT CEngDsT_stDiagCycRprt100ms "Status flag to enable cyclic reporting to DSM in 100ms" UBYTE B_TRUE 1 100 0.00 1.00000000000 BIT_MASK 0x1 FORMAT "%13.11" ECU_ADDRESS 0x60009BDB /end MEASUREMENT
/begin MEASUREMENT CEngDsT_stSigT "Status to indicate signal quality of sensor value" UBYTE OneToOne 1 100 0.00 255.0 FORMAT "%5.1" ECU_ADDRESS 0x6000A0F9 /end MEASUREMENT
/begin MEASUREMENT CEngDsT_t "Coolant temperature measured at engine outlet" SWORD Temp_Cels 1 100 -3549.940 3003.560 FORMAT "%8.3" ECU_ADDRESS 0x500059EC /end MEASUREMENT
/begin MEASUREMENT CEngDsT_tCEngTCHdT2SV "Engine coolant temperature, linearised and calculated" SWORD Temp_Cels 1 100 -3549.940 3003.560 FORMAT "%8.3" ECU_ADDRESS 0x60003E96 /end MEASUREMENT
/begin MEASUREMENT CEngDsT_tDifRefMdlEnv "difference between reference temperature and ambient temperature" SWORD TempDiff_Kelv 1 100 -3276.800 3276.700 FORMAT "%8.3" ECU_ADDRESS 0x60003EC4 /end MEASUREMENT
/begin MEASUREMENT CEngDsT_tDifReplMdlEngOff "difference (Engine Coolant Off Temperature, intake air temperature)" SWORD Temp_Cels 1 100 -3549.940 3003.560 FORMAT "%8.3" ECU_ADDRESS 0x60003EA4 /end MEASUREMENT
/begin MEASUREMENT CEngDsT_tDifSTCSnsrFild "difference (min and max value) engine coolant temperature for Stuck-Check" SWORD T_degC_q0p1_COMPU 1 100 -3276.800 3276.700 FORMAT "%8.3" ECU_ADDRESS 0x60003ECE /end MEASUREMENT
/begin MEASUREMENT CEngDsT_tExtRepl "external temperature value engine coolant temperature" SWORD Temp_Cels 1 100 -3549.940 3003.560 FORMAT "%8.3" ECU_ADDRESS 0x60005240 /end MEASUREMENT
/begin MEASUREMENT CEngDsT_tGrdtRefMdl "Temperature gradient for model in LSC diagnostic" UWORD temp_uw_q0p0029_o48 1 100 -48.0000 143.9971 FORMAT "%8.4" ECU_ADDRESS 0x60003EC2 /end MEASUREMENT
/begin MEASUREMENT CEngDsT_tGrdtRefMdlAcm "calculated model-based reference value for plausibility check of engine temperature signal (16-bit)" UWORD temp_uw_q0p0029_o48 1 100 -48.0000 143.9971 FORMAT "%8.4" ECU_ADDRESS 0x60003EC0 /end MEASUREMENT
/begin MEASUREMENT CEngDsT_tGrdtRefMdlDegPosTMEE "gradient: influence of heating circuit based on opening degree" UWORD temp_uw_q0p0029_o48 1 100 -48.0000 143.9971 FORMAT "%8.4" ECU_ADDRESS 0x60003EBE /end MEASUREMENT
/begin MEASUREMENT CEngDsT_tGrdtRefMdlFco "gradient of engine coolant temp. during cutoff for reference model" UWORD temp_uw_q0p0029_o48 1 100 -48.0000 143.9971 FORMAT "%8.4" ECU_ADDRESS 0x60003EBC /end MEASUREMENT
/begin MEASUREMENT CEngDsT_tGrdtRefMdlHeat "gradient: influence heating during running engine for reference model" UWORD temp_uw_q0p0029_o48 1 100 -9.999023 9.999023 FORMAT "%8.6" ECU_ADDRESS 0x60003EBA /end MEASUREMENT
/begin MEASUREMENT CEngDsT_tGrdtRefMdlInj "gradient of engine coolant temp. during fuel injection" UWORD temp_uw_q0p0029_o48 1 100 -9.999023 9.999023 FORMAT "%8.6" ECU_ADDRESS 0x60003EB8 /end MEASUREMENT
/begin MEASUREMENT CEngDsT_tGrdtRefMdlOff "Temperature gradient for engine coolant temperature model engine off" UWORD temp_uw_q0p0029_o48 1 100 -48.0000 143.9971 FORMAT "%8.4" ECU_ADDRESS 0x60003EB6 /end MEASUREMENT
/begin MEASUREMENT CEngDsT_tGrdtRefMdlOffLoc "Temperature gradient for engine coolant temperature model engine off without influence from TME" UWORD temp_uw_q0p0029_o48 1 100 -48.0000 143.9971 FORMAT "%8.4" ECU_ADDRESS 0x60003EB4 /end MEASUREMENT
/begin MEASUREMENT CEngDsT_tGrdtRefMdlOn "Temperature gradient for engine coolant temperature model engine on" UWORD temp_uw_q0p0029_o48 1 100 -48.0000 143.9971 FORMAT "%8.4" ECU_ADDRESS 0x60003EB2 /end MEASUREMENT
/begin MEASUREMENT CEngDsT_tGrdtRefMdlOnLoc "Temperature gradient for engine coolant temperature model engine on without influence from TME" UWORD temp_uw_q0p0029_o48 1 100 -48.0000 143.9971 FORMAT "%8.4" ECU_ADDRESS 0x60003EB0 /end MEASUREMENT
/begin MEASUREMENT CEngDsT_tGrdtReplMdlEngOn "temperature gradient replacement model during engine on" SBYTE temp_q0p01172 1 100 -1.500 1.488 FORMAT "%5.3" ECU_ADDRESS 0x60009BDD /end MEASUREMENT
/begin MEASUREMENT CEngDsT_tiDebRefMdlCalcnGrdOn "Delay time for usage of reference model gradient during running engine" SLONG Time_Dt 1 100 0.00 2147.48364700 FORMAT "%13.8" ECU_ADDRESS 0x60001928 /end MEASUREMENT
/begin MEASUREMENT CEngDsT_tiDebRefMdlCalcnGrdOnCalcd "Delay time for usage of reference model gradient during running engine after first engine stop" SLONG Time_Dt 1 100 0.00 2147.48364700 FORMAT "%13.8" ECU_ADDRESS 0x50001064 /end MEASUREMENT
/begin MEASUREMENT CEngDsT_tiDebRefMdlEngTFall "Delay time for detection of falling engine temperature" SLONG Time_Dt 1 100 0.00 2147.48364700 FORMAT "%13.8" ECU_ADDRESS 0x50001068 /end MEASUREMENT
/begin MEASUREMENT CEngDsT_tiDebRefMdlEngTFallCalcd "Delay time for detection of falling engine temperature after first engine stop" SLONG Time_Dt 1 100 0.00 2147.48364700 FORMAT "%13.8" ECU_ADDRESS 0x60001924 /end MEASUREMENT
/begin MEASUREMENT CEngDsT_tiDiagCycRprt1000ms "Timer to evaluate cyclic reporting to DSM in 1000ms" UBYTE t_q1 1 100 0.00 255.0 FORMAT "%5.1" ECU_ADDRESS 0x60009BDA /end MEASUREMENT
/begin MEASUREMENT CEngDsT_tiDiagCycRprt100ms "Timer to evaluate cyclic reporting to DSM in 100ms" UBYTE t_q0p1 1 100 0.00 25.50 FORMAT "%5.2" ECU_ADDRESS 0x60009BD9 /end MEASUREMENT
/begin MEASUREMENT CEngDsT_tInpFil "engine coolant temperature at low-pass input" SWORD Temp_Cels 1 100 -3549.940 3003.560 FORMAT "%8.3" ECU_ADDRESS 0x6000523E /end MEASUREMENT
/begin MEASUREMENT CEngDsT_tiRefMdlEngOff "engine off time for reference value model" UWORD Time_sec_q1_COMPU 1 100 0.00 65535.00 FORMAT "%8.2" ECU_ADDRESS 0x60003EAE /end MEASUREMENT
/begin MEASUREMENT CEngDsT_tiReplMdlEngOff "engine off time for replacement model engine coolant temperature" UWORD Time_sec_q1_COMPU 1 100 0.00 65535.00 FORMAT "%8.2" ECU_ADDRESS 0x60003EA2 /end MEASUREMENT
/begin MEASUREMENT CEngDsT_tiSTCColdOff "Accumulated time for reseting condition - cooling capacity too low" SLONG Time_Dt 1 100 0.00 2147.48364700 FORMAT "%13.8" ECU_ADDRESS 0x60001938 /end MEASUREMENT
/begin MEASUREMENT CEngDsT_tiSTCColdOn "waiting time to set condition radiation power low" SLONG Time_Dt 1 100 0.00 2147.48364700 FORMAT "%13.8" ECU_ADDRESS 0x60001934 /end MEASUREMENT
/begin MEASUREMENT CEngDsT_tiSTCHotOff "Accumulated time for reseting condition - cooling capacity too high" SLONG Time_Dt 1 100 0.00 2147.48364700 FORMAT "%13.8" ECU_ADDRESS 0x60001930 /end MEASUREMENT
/begin MEASUREMENT CEngDsT_tiSTCHotOn "waiting time to set condition radiation power high" SLONG Time_Dt 1 100 0.00 2147.48364700 FORMAT "%13.8" ECU_ADDRESS 0x6000192C /end MEASUREMENT
/begin MEASUREMENT CEngDsT_tLSCRefMdlEnd "end value of reference model for Low-Side-Check" SWORD Temp_Cels 1 100 -3549.940 3003.560 FORMAT "%8.3" ECU_ADDRESS 0x60003ECC /end MEASUREMENT
/begin MEASUREMENT CEngDsT_tMod "model-based substitute value for engine temperature signal in case of error" SWORD Temp_Cels 1 100 -3549.940 3003.560 FORMAT "%8.3" ECU_ADDRESS 0x60004B6A /end MEASUREMENT
/begin MEASUREMENT CEngDsT_tPID05Tstr "Engine Coolant Temperature for PID05 signal" SWORD Temp_Cels 1 100 -3549.940 3003.560 FORMAT "%8.3" ECU_ADDRESS 0x60004B68 /end MEASUREMENT
/begin MEASUREMENT CEngDsT_tRaw "Engine coolant temperature, linearised and calculated" SWORD Temp_Cels 1 100 -3549.940 3003.560 FORMAT "%8.3" ECU_ADDRESS 0x60004B66 /end MEASUREMENT
/begin MEASUREMENT CEngDsT_tRefMdl "model-based reference value for plausibility check of engine temperature signal" SWORD Temp_Cels 1 100 -3549.940 3003.560 FORMAT "%8.3" ECU_ADDRESS 0x60004B64 /end MEASUREMENT
/begin MEASUREMENT CEngDsT_tRefMdlEnd "end value model-based reference value for plausibility check of engine temperature signal" SWORD Temp_Cels 1 100 -3549.940 3003.560 FORMAT "%8.3" ECU_ADDRESS 0x60004B62 /end MEASUREMENT
/begin MEASUREMENT CEngDsT_tRefMdlHiResl "model-based reference value for plausibility check of engine temperature signal (16-bit)" UWORD temp_uw_q0p0029_o48 1 100 -48.0000 143.9971 FORMAT "%8.4" ECU_ADDRESS 0x60003EAC /end MEASUREMENT
/begin MEASUREMENT CEngDsT_tRefMdlLoc "model-based reference value for plausibility check of engine temperature signal local" SWORD Temp_Cels 1 100 -3549.940 3003.560 FORMAT "%8.3" ECU_ADDRESS 0x60003EAA /end MEASUREMENT
/begin MEASUREMENT CEngDsT_tReplMdl "model-based substitute value for engine temperature signal in case of error" SWORD Temp_Cels 1 100 -3549.940 3003.560 FORMAT "%8.3" ECU_ADDRESS 0x6000E12E /end MEASUREMENT
/begin MEASUREMENT CEngDsT_tReplMdlEngOffCoolg "Cooling down if engine coolant temperature after engine stop" SWORD Temp_Cels 1 100 -3549.940 3003.560 FORMAT "%8.3" ECU_ADDRESS 0x60003EA0 /end MEASUREMENT
/begin MEASUREMENT CEngDsT_tReplMdlIntkAir "Intake Air Temperature for enigne coolant temperatur replacement model" SWORD Temp_Cels 1 100 -3549.940 3003.560 FORMAT "%8.3" ECU_ADDRESS 0x60003E9E /end MEASUREMENT
/begin MEASUREMENT CEngDsT_tReplMdlLoc "model-based replacement value for engine coolant temperature local" UWORD temp_uw_q0p0029_o48 1 100 -48.0000 143.9971 FORMAT "%8.4" ECU_ADDRESS 0x60003E9C /end MEASUREMENT
/begin MEASUREMENT CEngDsT_tReplMdlStop "Starting value for model value calculation of TMOT sensor when engine moves out of RUNNING state in case of Cold start error" SWORD Temp_Cels 1 100 -3549.940 3003.560 FORMAT "%8.3" ECU_ADDRESS 0x60004B60 /end MEASUREMENT
/begin MEASUREMENT CEngDsT_tSens "Sensed engine coolant temperature" SWORD Temp_Cels 1 100 -3549.940 3003.560 FORMAT "%8.3" ECU_ADDRESS 0x60004B5E /end MEASUREMENT
/begin MEASUREMENT CEngDsT_tSnsr "sensor value engine coolant temperature" SWORD Temp_Cels 1 100 -3549.940 3003.560 FORMAT "%8.3" ECU_ADDRESS 0x60004B5C /end MEASUREMENT
/begin MEASUREMENT CEngDsT_tSnsrFild "filtered sensor value engine coolant temperature" SWORD Temp_Cels 1 100 -3549.940 3003.560 FORMAT "%8.3" ECU_ADDRESS 0x6000E130 /end MEASUREMENT
/begin MEASUREMENT CEngDsT_tSnsrFildFrzn "engine coolant temperature (sensor value) after lowpass filter local for calculation of engine coolant temperature" SWORD Temp_Cels 1 100 -3549.940 3003.560 FORMAT "%8.3" ECU_ADDRESS 0x6000523C /end MEASUREMENT
/begin MEASUREMENT CEngDsT_tSnsrStrt "measured engine coolant temperature at start, linearised and calculated" SWORD Temp_Cels 1 100 -3549.940 3003.560 FORMAT "%8.3" ECU_ADDRESS 0x6000523A /end MEASUREMENT
/begin MEASUREMENT CEngDsT_tSnsrStrtFrst "measured engine coolant temperature at first start of driving cycle, linearised and calculated" SWORD Temp_Cels 1 100 -3549.940 3003.560 FORMAT "%8.3" ECU_ADDRESS 0x60005238 /end MEASUREMENT
/begin MEASUREMENT CEngDsT_tSnsrSub "Sensor value coolant temperature with consideration of sensor validity" SWORD Temp_Cels 1 100 -3549.940 3003.560 FORMAT "%8.3" ECU_ADDRESS 0x60003EA8 /end MEASUREMENT
/begin MEASUREMENT CEngDsT_tSnsrTstr "Coolant Engine Temperature for PID-Service" SWORD Temp_Cels 1 100 -3549.940 3003.560 FORMAT "%8.3" ECU_ADDRESS 0x60004B5A /end MEASUREMENT
/begin MEASUREMENT CEngDsT_tSnsrTstrSAE "Engine coolant downstream temperature for PID-Service" UBYTE temp_ub_q1_o40 1 100 -40.0 215.0 FORMAT "%5.1" ECU_ADDRESS 0x6000A0F8 /end MEASUREMENT
/begin MEASUREMENT CEngDsT_tSTCSnsrFildMax "Maximum-occurring engine temperature" SWORD Temp_Cels 1 100 -3549.940 3003.560 FORMAT "%8.3" ECU_ADDRESS 0x60003ECA /end MEASUREMENT
/begin MEASUREMENT CEngDsT_tSTCSnsrFildMin "Minimum-occurring engine temperature" SWORD Temp_Cels 1 100 -3549.940 3003.560 FORMAT "%8.3" ECU_ADDRESS 0x60003EC8 /end MEASUREMENT
/begin MEASUREMENT CEngDsT_tStop "engine coolant temperature at engine stop or cut-off cranking" SWORD Temp_Cels 1 100 -3549.940 3003.560 FORMAT "%8.3" ECU_ADDRESS 0x60037F3A /end MEASUREMENT
/begin MEASUREMENT CEngDsT_tStopFrst "Cooling water temperature at stop of engine of last driving cycle" SWORD Temp_Cels 1 100 -3549.940 3003.560 FORMAT "%8.3" ECU_ADDRESS 0x60005236 /end MEASUREMENT
/begin MEASUREMENT CEngDsT_tStopReplMdlLoc "model-based replacement value for engine coolant temperature local during engine off" UWORD temp_uw_q0p0029_o48 1 100 -48.0000 143.9971 FORMAT "%8.4" ECU_ADDRESS 0x60003E9A /end MEASUREMENT
/begin MEASUREMENT CEngDsT_tStrt "Starting value of downstream engine coolant temperature" SWORD Temp_Cels 1 100 -3549.940 3003.560 FORMAT "%8.3" ECU_ADDRESS 0x6000E132 /end MEASUREMENT
/begin MEASUREMENT CEngDsT_tStrtFrst "Engine coolant downstream temperature during the first engine start of the driving cycle." SWORD Temp_Cels 1 100 -3549.940 3003.560 FORMAT "%8.3" ECU_ADDRESS 0x60005234 /end MEASUREMENT
/begin MEASUREMENT CEngDsT_t_Sq "Signal Quality of CEngDsT_t" UBYTE SigQly_COMPU_VERB 1 100 0.00 15.0000000000 FORMAT "%13.10" ECU_ADDRESS 0x6000A69F /end MEASUREMENT
/begin MEASUREMENT CEngDsT_uAbsltDifRawFltd "absolute value difference sensor voltage (filtered - unfiltered) engine coolant temperature sensor" UWORD Volt 1 100 0.00 5000.000 FORMAT "%8.3" ECU_ADDRESS 0x60003ED2 /end MEASUREMENT
/begin MEASUREMENT CEngDsT_uRaw "Raw ADC value of downstream engine coolant temperature sensor signal" UWORD Volt 1 100 0.00 5000.000 FORMAT "%8.3" ECU_ADDRESS 0x6000E134 /end MEASUREMENT
/begin MEASUREMENT CEngDsT_uRawFild "filtered sensor voltage engine coolant temperature sensor" UWORD Volt 1 100 0.00 5000.000 FORMAT "%8.3" ECU_ADDRESS 0x60004920 /end MEASUREMENT
/begin MEASUREMENT CEngDsT_uRawFildImps "filtered sensor voltage engine coolant temperature sensor for loose connection check" UWORD Volt 1 100 0.00 5000.000 FORMAT "%8.3" ECU_ADDRESS 0x60003ED0 /end MEASUREMENT
/begin MEASUREMENT CEngDsT_vAvrgElec "filtered vehicle speed during eletrical driving cycles" SWORD Vel 1 100 0.00 327.6700 FORMAT "%8.4" ECU_ADDRESS 0x60003EA6 /end MEASUREMENT
/begin MEASUREMENT CEngUsT_tCEngTCHdT2SV "Sensed value of upstream engine coolant temperature" SWORD Temp_Cels 1 100 -3549.940 3003.560 FORMAT "%8.3" ECU_ADDRESS 0x60003E94 /end MEASUREMENT
/begin MEASUREMENT CHdT_tCEngTCHdT2SV "temperature in cylinder-head ; sensor value after lowpass" SWORD Temp_Cels 1 100 -3549.940 3003.560 FORMAT "%8.3" ECU_ADDRESS 0x60003E92 /end MEASUREMENT
/begin MEASUREMENT drlprl_w "delta predicted load to measured load" SWORD rel_q0p0234 1 100 -768.0000 767.9766 FORMAT "%8.4" ECU_ADDRESS 0x500006A0 /end MEASUREMENT
/begin MEASUREMENT dzwol_w_msg "Lambda-dependent correction of optimized model reference ignition angle" SWORD zw_q2p9297Em3_deg_KW 1 100 -96.00000 95.99707 FORMAT "%8.5" ECU_ADDRESS 0x500007BA /end MEASUREMENT
/begin MEASUREMENT ects2sva1 "PID67h, Data Byte A" UBYTE dez 1 100 0.00 255.0 FORMAT "%5.1" ECU_ADDRESS 0x60009BD8 /end MEASUREMENT
/begin MEASUREMENT ects2sva_msg "PID67h, Data Byte A" UBYTE dez 1 100 0.00 255.0 FORMAT "%5.1" ECU_ADDRESS 0x60009FFE /end MEASUREMENT
/begin MEASUREMENT ects2svb1 "PID67h, Data Byte B" UBYTE temp_ub_q1_o40 1 100 -40.0 215.0 FORMAT "%5.1" ECU_ADDRESS 0x60009BD7 /end MEASUREMENT
/begin MEASUREMENT ects2svb_msg "PID67h, Data Byte B" UBYTE temp_ub_q1_o40 1 100 -40.0 215.0 FORMAT "%5.1" ECU_ADDRESS 0x60009FFD /end MEASUREMENT
/begin MEASUREMENT ects2svc1 "PID67h, Data Byte C" UBYTE temp_ub_q1_o40 1 100 -40.0 215.0 FORMAT "%5.1" ECU_ADDRESS 0x60009BD6 /end MEASUREMENT
/begin MEASUREMENT ects2svc_msg "PID67h, Data Byte C" UBYTE temp_ub_q1_o40 1 100 -40.0 215.0 FORMAT "%5.1" ECU_ADDRESS 0x60009FFC /end MEASUREMENT
/begin MEASUREMENT EngDa_tEng "Engine temperature" SWORD Temp_Cels 1 100 -3549.940 3003.560 FORMAT "%8.3" ECU_ADDRESS 0x60004AF2 /end MEASUREMENT
/begin MEASUREMENT etalab_w_msg "Lambda efficiency without intervention referred to optimum torque at Lambda=1" UWORD fak_uw_b2 1 100 0.00 1.999969 FORMAT "%8.6" ECU_ADDRESS 0x500007C0 /end MEASUREMENT
/begin MEASUREMENT ftahevmx_w_msg "maximum factor temperatur fesh air downstream inlet valve" UWORD fak_uw_b2 1 100 0.00 1.999969 FORMAT "%8.6" ECU_ADDRESS 0x60000E6C /end MEASUREMENT
/begin MEASUREMENT ftahev_w_msg "Factor temperature fresh air behind inlet valve" UWORD fak_uw_b2 1 100 0.00 1.999969 FORMAT "%8.6" ECU_ADDRESS 0x60000AC6 /end MEASUREMENT
/begin MEASUREMENT ftavdkmn_w_msg "factor min correction air temperature for throttle valve flow f(intake air temp.,altit." UWORD fak_uw_b2 1 100 0.00 1.999969 FORMAT "%8.6" ECU_ADDRESS 0x60000AC8 /end MEASUREMENT
/begin MEASUREMENT ftavdkmx_w_msg "factor maxcorrection air temperature for throttle valve flow f(intake air temp.,altit.)" UWORD fak_uw_b2 1 100 0.00 1.999969 FORMAT "%8.6" ECU_ADDRESS 0x60000ACC /end MEASUREMENT
/begin MEASUREMENT ftochlw "weighting factor oiltemperature cylinder head lowpass-filtered" UBYTE fak_q0p00392 1 100 0.00 1.000 FORMAT "%5.3" ECU_ADDRESS 0x60000C67 /end MEASUREMENT
/begin MEASUREMENT ftochwu "weighting factor oiltemperature cylinder head" UBYTE fak_q0p00392 1 100 0.00 1.000 FORMAT "%5.3" ECU_ADDRESS 0x60000C66 /end MEASUREMENT
/begin MEASUREMENT ftsr_w_msg "correction factor for air temperature in the manifold" UWORD fak_uw_b2 1 100 0.00 1.999969 FORMAT "%8.6" ECU_ADDRESS 0x60000DD2 /end MEASUREMENT
/begin MEASUREMENT ftu_msg "factor: ambient temperature" UBYTE fak_ub_b2 1 100 0.00 1.992188 FORMAT "%8.6" ECU_ADDRESS 0x60000DAF /end MEASUREMENT
/begin MEASUREMENT ftvdk_w_msg "correction factor for temperature upstream throttle" UWORD fak_uw_b2 1 100 0.00 1.999969 FORMAT "%8.6" ECU_ADDRESS 0x60000DD0 /end MEASUREMENT
/begin MEASUREMENT ftw_w "factor weighting of temperaturetwandsr, tasr" UWORD fak_uw_b2 1 100 0.00 1.999969 FORMAT "%8.6" ECU_ADDRESS 0x60000C6C /end MEASUREMENT
/begin MEASUREMENT fwprs_w_msg "Factor prediction angle with respect to segment" UWORD fak_uw_b32 1 100 0.00 31.99951 FORMAT "%8.5" ECU_ADDRESS 0x500007E6 /end MEASUREMENT
/begin MEASUREMENT lamdzwol_mp "measurement point lambda" UWORD fak_uw_b16 1 100 0.00 15.99976 FORMAT "%8.5" ECU_ADDRESS 0x7000926E /end MEASUREMENT
/begin MEASUREMENT mltoch "local copy - air mass flow" UBYTE m_ub_b1020 1 100 0.00 1020. FORMAT "%5.0" ECU_ADDRESS 0x60000C65 /end MEASUREMENT
/begin MEASUREMENT nmottoch "local copy - engine speed" UBYTE nmot_ub_q40 1 100 0.00 10200. FORMAT "%5.0" ECU_ADDRESS 0x60000C64 /end MEASUREMENT
/begin MEASUREMENT OilCylHdT_flgTCEngDsTVld "Validity of engine downstream temperature" UBYTE B_TRUE 1 100 0.00 1.00000000000 BIT_MASK 0x1 FORMAT "%13.11" ECU_ADDRESS 0x600000E9 /end MEASUREMENT
/begin MEASUREMENT quotntke_w_msg "Engine speed quotient for thermo contact succed in massflow with inlet valve" UWORD fak_uw_b8 1 100 0.00 7.999878 FORMAT "%8.6" ECU_ADDRESS 0x60000AF4 /end MEASUREMENT
/begin MEASUREMENT taev_w_msg "air temperature at inlet valve" UWORD temp_q0p0234_o273 1 100 -273.150 1262.827 FORMAT "%8.3" ECU_ADDRESS 0x60000E02 /end MEASUREMENT
/begin MEASUREMENT tahev_w_msg "Temperature fresh air behind inlet valve" UWORD temp_q0p0234_o273 1 100 -273.150 1262.827 FORMAT "%8.3" ECU_ADDRESS 0x60000B02 /end MEASUREMENT
/begin MEASUREMENT tev_w_msg "Temperature of inlet valve" UWORD temp_q0p0234_o273 1 100 -273.150 1262.827 FORMAT "%8.3" ECU_ADDRESS 0x60000DB4 /end MEASUREMENT
/begin MEASUREMENT TMECmb_IfEtalam_I.HSPActiv "dataset instance / Combustion dataset: condition GDI-operating mode for actual ignition cylinder is homogeneous-split" UBYTE dez 1 100 0.00 255.0 FORMAT "%5.1" ECU_ADDRESS 0x5000086C /end MEASUREMENT
/begin MEASUREMENT TMECmb_IfEtalam_I.f2ka "dataset instance / actual weighting factor of 2nd fuel - torque" UBYTE fak_ub_b1 1 100 0.00 0.9961 ECU_ADDRESS 0x5000086D /end MEASUREMENT
/begin MEASUREMENT TMECmb_IfEtalam_I.f2kazw "dataset instance / actual weighting factor of 2nd fuel - ignition" UBYTE fak_ub_b1 1 100 0.00 0.9961 ECU_ADDRESS 0x5000086E /end MEASUREMENT
/begin MEASUREMENT TMECmb_IfEtalam_I.flb "dataset instance / Combustion dataset: Factor charge-movement" UBYTE fak_ub_b1 1 100 0.00 0.9961 ECU_ADDRESS 0x5000086F /end MEASUREMENT
/begin MEASUREMENT TMECmb_IfEtalam_I.vlvlftActv "dataset instance / valve lift information" UBYTE OneToOne 1 100 0.00 255.0 FORMAT "%5.1" ECU_ADDRESS 0x50000870 /end MEASUREMENT
/begin MEASUREMENT tmotdifk_w "difference from actuel engine temperature to warm engine temperature" UWORD temp_q0p0234_o273 1 100 -273.150 1262.827 FORMAT "%8.3" ECU_ADDRESS 0x60000C6A /end MEASUREMENT
/begin MEASUREMENT tochloc "oil temperature in cylinder head" UBYTE temp_ub_q0p75_o48 1 100 -48.0 143.3 FORMAT "%5.1" ECU_ADDRESS 0x60000C63 /end MEASUREMENT
/begin MEASUREMENT tochlw "oiltemperature cylinder-head (low-model)" UBYTE temp_ub_q0p75_o48 1 100 -48.0 143.3 FORMAT "%5.1" ECU_ADDRESS 0x60000C62 /end MEASUREMENT
/begin MEASUREMENT toch_msg "oil temperature in cylinder head" UBYTE temp_ub_q0p75_o48 1 100 -48.0 143.3 FORMAT "%5.1" ECU_ADDRESS 0x60009FE2 /end MEASUREMENT
/begin MEASUREMENT tvwdkprs_msg "Delay time of DK angle due to prediction" UBYTE t_q0p001 1 100 0.00 0.2550 FORMAT "%6.4" ECU_ADDRESS 0x60000DDD /end MEASUREMENT
/begin MEASUREMENT VehMot_stBrkPed "Information brake pedal pressed" UBYTE OneToOne 1 100 0.00 255.0 FORMAT "%5.1" ECU_ADDRESS 0x6000A2B1 /end MEASUREMENT
/begin MEASUREMENT vwkw_msg "crankshaft angular speed" UBYTE rel_ub_q0p1875 1 100 0.00 47.81 FORMAT "%5.2" ECU_ADDRESS 0x50000F82 /end MEASUREMENT
/begin MEASUREMENT wdkbap1_w "predicted throttle angle wdkbl for ti-calculation (Word)" UWORD rel_uw_b100 1 100 0.00 99.99847 FORMAT "%8.5" ECU_ADDRESS 0x60000C60 /end MEASUREMENT
/begin MEASUREMENT wdkbapfast "predicted throttle angle wdkbl for ti-calculation (Word)" UWORD rel_uw_b100 1 100 0.00 99.99847 FORMAT "%8.5" ECU_ADDRESS 0x60000888 /end MEASUREMENT
/begin MEASUREMENT wdkbap_w_msg "predicted throttle angle wdkbl for ti-calculation (Word)" UWORD rel_uw_b100 1 100 0.00 99.99847 FORMAT "%8.5" ECU_ADDRESS 0x50000F76 /end MEASUREMENT
/begin MEASUREMENT wpraktsre_msg "Active injection angle for load prediction for PFI mode" UBYTE zw_ub_q6 1 100 0.00 1530. FORMAT "%5.0" ECU_ADDRESS 0x70001C01 /end MEASUREMENT
/begin MEASUREMENT wprnspsre_msg "Calculated injection angle for load prediction for post injection for PFI mode" UBYTE zw_ub_q6 1 100 0.00 1530. FORMAT "%5.0" ECU_ADDRESS 0x50000F85 /end MEASUREMENT
/begin MEASUREMENT wprsre_msg "Calculated injection angle for load prediction for PFI mode" UBYTE zw_ub_q6 1 100 0.00 1530. FORMAT "%5.0" ECU_ADDRESS 0x50000F86 /end MEASUREMENT
/begin MEASUREMENT wpr_msg "Calculated injection angle for load prediction" UBYTE zw_ub_q6 1 100 0.00 1530. FORMAT "%5.0" ECU_ADDRESS 0x50000F84 /end MEASUREMENT
/begin FUNCTION BGTMOLAM "159.0.0   Calculation of efficiency and ignition angle correction - Lambda"
 /begin DEF_CHARACTERISTIC DZWOLA ETALAM TMECmb_iaLamDpdVVlvLft_T TMECmb_stVlvlftMpg_I.OperMod2Idx_M /end DEF_CHARACTERISTIC
 /begin IN_MEASUREMENT CoEOM_stEomCylAdv_a Gen_ctCylAdv lamsbg_w_msg /end IN_MEASUREMENT
 /begin OUT_MEASUREMENT dzwol_w_msg etalab_w_msg /end OUT_MEASUREMENT
 /begin LOC_MEASUREMENT lamdzwol_mp TMECmb_IfEtalam_I.HSPActiv TMECmb_IfEtalam_I.f2ka TMECmb_IfEtalam_I.f2kazw TMECmb_IfEtalam_I.flb TMECmb_IfEtalam_I.vlvlftActv /end LOC_MEASUREMENT
 FUNCTION_VERSION "159.0.0" /end FUNCTION
/begin FUNCTION BGTMPK "12.8.0    Calculation of temperature compensation for intake manifold model"
 /begin DEF_CHARACTERISTIC CWBGTMPK DTEVS FTVDKTAVDK KFFWLKFTAHEV KFFWLKPN KFWTBR KLFEXPSL NWKEV TDTEVATI TEVSMX TMOTKWRMK ZBRT /end DEF_CHARACTERISTIC
 /begin IN_MEASUREMENT anztib_w_msg B_tasrg_msg CEngDsT_flgSnsrVld CEngDsT_tStrt Epm_nEng ExhMod_tEng IntkAirT_tIntkMnfld IntkAirT_tThrVlvUs psr_w_msg SyC_stSub tadk_w_msg tavdkmn_w_msg tavdkmx_w_msg toch_msg twvev_w_msg /end IN_MEASUREMENT
 /begin OUT_MEASUREMENT B_tahevg_msg ftahevmx_w_msg ftahev_w_msg ftavdkmn_w_msg ftavdkmx_w_msg ftsr_w_msg ftu_msg ftvdk_w_msg quotntke_w_msg taev_w_msg tahev_w_msg tev_w_msg /end OUT_MEASUREMENT
 /begin LOC_MEASUREMENT BGTMPK_U_TEMP_FTEMP_I.tahevX_w ftw_w tmotdifk_w /end LOC_MEASUREMENT
 FUNCTION_VERSION "12.8.0" /end FUNCTION
/begin FUNCTION BGTOCH "10.0.0    oil temperature in cylinder head" /begin DEF_CHARACTERISTIC FTOCHLWIN KFTOCHLW TTOCHLWTD TTOCHLWTP /end DEF_CHARACTERISTIC /begin IN_MEASUREMENT CEngDsT_t Epm_nEng Epm_stSpd ml_msg OilSwmpT_t SyC_stSub /end IN_MEASUREMENT /begin OUT_MEASUREMENT B_tochg_msg toch_msg /end OUT_MEASUREMENT
 /begin LOC_MEASUREMENT B_tochgloc B_tochlow ftochlw ftochwu mltoch nmottoch OilCylHdT_flgTCEngDsTVld tochloc tochlw /end LOC_MEASUREMENT
 FUNCTION_VERSION "10.0.0" /end FUNCTION
/begin FUNCTION BGWDKM "5.4.0     Calculation of throttle angle model" /begin DEF_CHARACTERISTIC CWBGWDKM ZWDKM1 ZWDKM2 ZWDKM3 ZWDKM4 /end DEF_CHARACTERISTIC /begin IN_MEASUREMENT B_wdksg_msg SyC_stSub ThrVlv_ratActPosnB1 wdksp_w_msg /end IN_MEASUREMENT /begin OUT_MEASUREMENT wdkbap_w_msg /end OUT_MEASUREMENT /begin LOC_MEASUREMENT wdkbap1_w wdkbapfast /end LOC_MEASUREMENT FUNCTION_VERSION "5.4.0" /end FUNCTION
/begin FUNCTION BGWPR "10.10.0   Calculated Value prediction angle"
 /begin DEF_CHARACTERISTIC AirMod_nrSyncAirChrgPredOff_C CWBGRLP CWNSPSRE CWWPR DRLDYNA DRLDYNE DRLMIN DTEPRU DWPRNSPSRE DWPRSRE FWDKUGDSP NMOTRLPU TNSURLP TVWDKS WPRMX /end DEF_CHARACTERISTIC
 /begin REF_CHARACTERISTIC VPSRVDUGD /end REF_CHARACTERISTIC
 /begin IN_MEASUREMENT B_ll_msg B_msdpg_msg B_nswo2_msg B_vhefeps_msg B_vheg_msg ChrCtl_flgChrgCalcnTiBasd drl_w_msg dwgvsge_w_msg EngStrt_bStrt EngStrt_bStrtEnd Epm_ctCyl Epm_nEng Epm_stSpd GEVCtl_agIntkClsd grundwert_msg rlp_w_msg rl_w_msg SyC_stSub tef_w_msg tnst_w_msg tvub_w_msg vpsrvd_w_msg wdkbap_w_msg wdkugd_w_msg wea_msg wee_msg wessbm_msg /end IN_MEASUREMENT
 /begin OUT_MEASUREMENT AirMod_idxCylAirChrgPred AirMod_idxSynAirChrgPredMax AirMod_nrSynAirChrgPred AirMod_nrSynAirChrgPredHom AirMod_nrSynAirChrgPredMax B_nsp_msg B_rlpdms_msg B_rlpdp_msg B_rlp_msg B_tired_msg B_ugdsp_msg fwprs_w_msg tvwdkprs_msg vwkw_msg wpraktsre_msg wprnspsre_msg wprsre_msg wpr_msg /end OUT_MEASUREMENT
 /begin LOC_MEASUREMENT AirMod_nrSyncPfiPoiPred AirMod_nrSyncPfiPred B_rlpvheus drlprl_w /end LOC_MEASUREMENT
 FUNCTION_VERSION "10.10.0" /end FUNCTION
/begin FUNCTION Blwr_DD "7.0.0     HW-depending device driver for cabine blower" /begin DEF_CHARACTERISTIC Blwr_uComBlwrURepl_C /end DEF_CHARACTERISTIC /begin IN_MEASUREMENT Com_uFrntBlowrU Com_uRrBlowrU T15_st /end IN_MEASUREMENT /begin OUT_MEASUREMENT Blwr_uVoltReq /end OUT_MEASUREMENT FUNCTION_VERSION "7.0.0" /end FUNCTION
/begin FUNCTION BrkBstP_VD "25.0.0    Pressure sensor for brakebooster virtual device"
 /begin DEF_CHARACTERISTIC BrkBstP_aDecelBrkThdMax_C BrkBstP_aDecelBrkThdMin_C BrkBstP_cntMstCylPVal_C BrkBstP_ctDriftHi_C BrkBstP_ctDriftLo_C BrkBstP_ctVehStopThd_C BrkBstP_dpMstCyl_C BrkBstP_flgSwtActv_C BrkBstP_nVacPmp_C BrkBstP_pBrkBoostDiffThd_C BrkBstP_pBrkNotPsd_C BrkBstP_pCmpFldThd_C BrkBstP_pDifQntyHi_C BrkBstP_pDifQntyLo_C BrkBstP_pDifQntyLrgJdg_C BrkBstP_pDifQntyMid_C BrkBstP_pDifQntySmallJdg_C BrkBstP_pDriftHiThd_C BrkBstP_pDriftLoThd_C BrkBstP_pFldPOffsMaxVal_C BrkBstP_pFldPOffsMinVal_C BrkBstP_pMstCylMax_C BrkBstP_pMstCylMin_C BrkBstP_pMstCylPIniVal_C BrkBstP_pMstCylSatMax_C BrkBstP_pMstCYlSatMin_C BrkBstP_pOutpEnaMask_C BrkBstP_pRawFldPStabyVal_C BrkBstP_pVacPOffsVal_C BrkBstP_rAccPedThd_C BrkBstP_stFldPOffsMeasCdnMsk_C BrkBstP_stStopRelsMaskSeln_C BrkBstP_stStopRelsMask_C BrkBstP_swtHSAEna_C BrkBstP_tiABSVSADi_C BrkBstP_tiAYCEna_C BrkBstP_tiDecelBrkDetn_C BrkBstP_tiDriftErrRelsThd_C BrkBstP_tiDriftHiMax_C BrkBstP_tiDriftHiMin_C BrkBstP_tiDriftLoMax_C BrkBstP_tiDriftLoMin_C BrkBstP_tiDriftTmrFrz_C BrkBstP_tiMstCylPStabyThd_C BrkBstP_tiMstCylPT1_C BrkBstP_tiVacBoostPT1_C BrkBstP_tiVehAPT1_C BrkBstP_tiVehStopDly_C BrkBstP_tiVehVPT1_C BrkBstP_vRunngThd_C BrkBstP_vStopThd_C BrkBstP_vVehSpdThd_C /end DEF_CHARACTERISTIC
 /begin IN_MEASUREMENT APP_r BrkBstP_pSens CoEng_st CoEng_tiNormal Com_bAYCCond Com_pMstCyl Com_stACCBrk Com_stActABSEBD Com_stActHSA Com_stFailMstCylPSnsr Com_stInhbMstCylPSnsr CoTS_stSSEStopInhb CoVOM_stStopRls CrCtl_stActive Eep_EnvRamInvld Epm_nEng GlbDa_vX I14229_stABSFailCnclActv I14229_stSuppRst SysDiag_flgCModJdg T15_st VehMot_stBrkPed VehV_aRawUnFlt VehV_vUnFlt VMD_rASLCC /end IN_MEASUREMENT
 /begin OUT_MEASUREMENT BrkBstP_aXFil BrkBstP_bDecelByBrk BrkBstP_bStopByBrk BrkBstP_bVehRunng BrkBstP_bVehStop BrkBstP_ctVehStop BrkBstP_pAftFil BrkBstP_pBrkBoostMax BrkBstP_pBrkBoostMin BrkBstP_pCmpFldP BrkBstP_pCorrnPVal BrkBstP_pMstCylAftFil BrkBstP_pMstCylAftOffsCalcn BrkBstP_stAYCBrkOilEna BrkBstP_stBrkPsdDriftErr BrkBstP_stZrPntCalcnJdg BrkBstP_vXFil /end OUT_MEASUREMENT
 /begin LOC_MEASUREMENT BrkBstP_bDriftTmrFrz BrkBstP_cntMstCylPValCnt BrkBstP_ctDriftErr BrkBstP_ctDriftHiErr BrkBstP_ctDriftLoErr BrkBstP_dpAbsMstCyl BrkBstP_flgDSMClr BrkBstP_flgMstCylPStabyChk BrkBstP_pBrkBoostDiff BrkBstP_pChgMaxVal BrkBstP_pCorrnPValInt BrkBstP_pDifAbsltVal BrkBstP_pIntegdMstcylPVal BrkBstP_pLimVal BrkBstP_pLimValLo BrkBstP_pLrngCorrnPValDif BrkBstP_pMstCylAftFilOld BrkBstP_pMstCylOffsVal BrkBstP_pMstCylOld BrkBstP_pMstCylPAvgVal BrkBstP_pMstCylReslCnv BrkBstP_pRawFldPDifVal BrkBstP_pRawFldPMaxVal BrkBstP_pRawFldPMinVal BrkBstP_stDrift BrkBstP_stFldPMeasCdn BrkBstP_stFldPOffsMeasCalcn BrkBstP_stFldPOffsMeasCdn BrkBstP_stFldPStaby BrkBstP_stIniValCdn BrkBstP_stMstCylOffsVal BrkBstP_stVehStopCfmd BrkBstP_tiDecelByBrk BrkBstP_tiDriftErrRels BrkBstP_tiMstCylPStaby /end LOC_MEASUREMENT
 FUNCTION_VERSION "25.0.0" /end FUNCTION
/begin FUNCTION BrkPed_SetData "128.1.0   Brake Pedal Information"
 /begin DEF_CHARACTERISTIC BrkPed_aEBBSlopHi_C BrkPed_aGrdtFildDifThd_C BrkPed_aGrdtHiLimForISAB_C BrkPed_aGrdtLoLimForISAB_C BrkPed_aSlopNeg_C BrkPed_aSlopPos_C BrkPed_cntrISABRlsThd_T BrkPed_cntStepISABRls_T BrkPed_flgSwtISABAvl_C BrkPed_flgSwtVehStandStillJdg_C BrkPed_nEngISABThd_C BrkPed_pEngStopDisbl_M BrkPed_pEngStopEna_M BrkPed_pEnvPMax_C BrkPed_swtBrkBstPSeln_C BrkPed_swtBrkStrtEna_C BrkPed_swtEVPECUEna_C BrkPed_tiEBBSlopDetn_C BrkPed_tiEBBSlopRst_C BrkPed_tiSnsrFailHeal_C BrkPed_tiVehStandStillJdgThd1_C BrkPed_tiVehStandStillJdgThd2_C BrkPed_tiVehStandStill_C BrkPed_tiVSAGrdtPT1_C BrkPed_tiWinPerdGrdtChk_C BrkPed_tqBrkOffsThdForIS_C BrkPed_tqBrkThdforIS_T BrkPed_vEBBSpdHi_C BrkPed_vEBBSpdLo_C /end DEF_CHARACTERISTIC
 /begin IN_MEASUREMENT BrkBstP_pAftFil BrkP_p Brk_st Brk_stEBBBrkDetn Com_aLgtG Com_pEVPMnfldP Com_stACCBrk Com_stBrkHldSys Com_stCalCmplLgtG Com_stCVTEngmtInfo Com_stEBB Com_stEVPIdleStopFail Com_stEVPIdleStopReq Com_stFailrLgtG Com_stIMGISInhbBrk Com_stIMGISSysOffBrk Com_stIngearEngmt Com_stISEBBFail Com_stLgtGASensErr Com_stLgtGASensInh Com_stRxAYCGOk Com_stRxSRSAOk Com_stShftInNeutr Com_stStrtupProc Com_stTempAbnormLgtG Com_tqBrkOper CoVOM_stSSE EnvP_p Epm_nEng Gbx_stGearLvr GlbDa_vAvrgWhlSpd GlbDa_vX PT_stTraType StrtCtl_flgEngStall StrtCtl_vEBBVehSpd T15_st VMD_rVirtAPP /end IN_MEASUREMENT
 /begin OUT_MEASUREMENT BrkPed_aGrdtFild BrkPed_aSlopEBB BrkPed_bEngStopEna BrkPed_bEngStrtReq BrkPed_flgEBBEngSysOff BrkPed_flgEBBHiSlop BrkPed_flgISABBrkPSuffVehStill BrkPed_flgISABDi BrkPed_flgISABReq BrkPed_flgLgtGComErr BrkPed_flgSlopeExcd BrkPed_flgSwtISABAvl BrkPed_flgVehStandStill BrkPed_pRel BrkPed_tqIMGISABIdleStop VehMot_stBrkPed /end OUT_MEASUREMENT
 /begin LOC_MEASUREMENT BrkPed_aDif BrkPed_aGrdt BrkPed_aGrdtFildDif BrkPed_aGrdtFildHist_a BrkPed_aGrdtFildMax BrkPed_aGrdtFildMin BrkPed_aLgtG BrkPed_aLgtGCnvn BrkPed_cntrISABRls BrkPed_flgBrkBoostEngStopEna BrkPed_flgBrkBoostEngStrtReq BrkPed_flgBrkBoostEngSysOff BrkPed_flgEBBFailrOcc_MP BrkPed_flgEBBVehStandStill BrkPed_flgIMGEngStopEna BrkPed_flgIMGEngStrtReq BrkPed_flgIMGEngSysOff BrkPed_flgNonServoFailr_MP BrkPed_flgVSAFailr_MP BrkPed_nrGrdtArySize BrkPed_pEnvP_MP BrkPed_pEVPMnFldP_MP BrkPed_stVehStandStill BrkPed_tiEBBSlopInRng BrkPed_tiElpdSnceVehSpdZr /end LOC_MEASUREMENT
 FUNCTION_VERSION "128.1.0" /end FUNCTION
/begin FUNCTION Brk_DD "56.0.0    Brake Device Driver"
 /begin DEF_CHARACTERISTIC Brk_MnDeb.tiHiLo_C Brk_MnDeb.tiLoHi_C Brk_RedDeb.tiHiLo_C Brk_RedDeb.tiLoHi_C Brk_swtSig_C /end DEF_CHARACTERISTIC
 /begin IN_MEASUREMENT Brk_stMn Brk_stRed Com_stBrk /end IN_MEASUREMENT
 /begin OUT_MEASUREMENT Brk_stMnRaw Brk_stRedRaw /end OUT_MEASUREMENT
 FUNCTION_VERSION "56.0.0" /end FUNCTION
/begin FUNCTION Brk_VD "62.1.0    Brake Position Sensor Virtual Device"
 /begin DEF_CHARACTERISTIC Brk_ctBrkHealThd_C Brk_ctBrkSwtNotStpThd_C Brk_ctPlaMax_C Brk_ctSwtContOnThd_C Brk_flgSwtCntrDi_C Brk_flgSwtExch_C Brk_nPlaMin_C Brk_stDflVal_C Brk_stEnaHydPCtrlOper_C Brk_swtMnRed1_C Brk_swtMnRed2_C Brk_swtRedSensPrs_C Brk_tiBrkSwtContStpErrClr_C Brk_tiBrkSwtNormDet_C Brk_tiPlaMax_C Brk_tiRdntBrkOnDly_C Brk_vLwrThdBrkSwtNotStp_C Brk_vPlaMin_C Brk_vSpdThdBrkSwtStp_C Brk_vUpprThdBrkSwtNotStp_C /end DEF_CHARACTERISTIC
 /begin REF_CHARACTERISTIC Clth_stStkActvn_C /end REF_CHARACTERISTIC
 /begin IN_MEASUREMENT Brk_stMnRaw Brk_stRedRaw CoEng_st Com_rASLCCENGT Com_stACCBrk Com_stBrk Com_stHydPCtrlOper Com_stIMGACCBrkReq Epm_nEng SyC_ctPostDrvLeave T15_st VehV_v /end IN_MEASUREMENT
 /begin OUT_MEASUREMENT Brk_ctMnBrkSwtNotStp Brk_ctMnSwtContOn Brk_ctRdntBrkSwtNotStp Brk_ctRdntSwtContOn Brk_st Brk_stAry Brk_stBrkChgPrio Brk_stBrkVSA Brk_stMn Brk_stRed /end OUT_MEASUREMENT
 /begin LOC_MEASUREMENT Brk_cntrReIni Brk_ctMnSwtContOnHealCond Brk_ctMnSwtNotStpHealCond Brk_ctPla_mp Brk_ctRdntSwtContOnHealCond Brk_ctRdntSwtNotStpHealCond Brk_flgMaiContsOnFltCntrDi Brk_flgMaiNonStepFltCntrDi Brk_flgMnSwtContOnHealCnt Brk_flgMnSwtNotStpHealCnt Brk_flgRdntBrkOn_mp Brk_flgRdntContsOnFltCntrDi Brk_flgRdntNonStepFltCntrDi Brk_flgRdntSwtContOnHealCnt Brk_flgRdntSwtNotStpHealCnt Brk_stMnBrkSwtContStp_mp Brk_stMnBrkSwtNotStp_mp Brk_stMnSwtContStpErrLstDC Brk_stMnSwtNotStpErrLstDC Brk_stRdntBrkSwtContStp_mp Brk_stRdntBrkSwtNotStp_mp Brk_stRdntSwtContStpErrLstDC Brk_stRdntSwtNotStpErrLstDC Brk_stRstBrkNotStp /end LOC_MEASUREMENT
 FUNCTION_VERSION "62.1.0" /end FUNCTION
/begin FUNCTION BswM "4.14.1    Basis Software Mode Manager" FUNCTION_VERSION "4.14.1" /end FUNCTION
/begin FUNCTION BusDiag_BusOff "69.0.0_6SAAmonitoring CAN hardware"
 /begin OUT_MEASUREMENT BusDiag_flgAPPLBUSOFF BusDiag_flgCANCBUSOFF BusDiag_flgVEHICLEBUSOFF /end OUT_MEASUREMENT
 FUNCTION_VERSION "69.0.0_6SAA" /end FUNCTION
/begin FUNCTION CBUtil "170.0.0   Customer Block Utilities" /begin OUT_MEASUREMENT CBUtil_stReProgEvnt /end OUT_MEASUREMENT FUNCTION_VERSION "170.0.0" /end FUNCTION
/begin FUNCTION CDrv_Shared "1000.4.0  Complex Driver Shared Definitions Gasoline" /begin IN_MEASUREMENT EpmSyn_phiOffs Epm_numCyl /end IN_MEASUREMENT /begin LOC_MEASUREMENT CDRV_DELTA_TDC_CYL CDRV_TDC_CYL /end LOC_MEASUREMENT FUNCTION_VERSION "1000.4.0" /end FUNCTION
/begin FUNCTION CDShdG_GTMLib "2.12.0_1.8.0Complex Driver Shared GTM Service Library" /begin LOC_MEASUREMENT CdSHdG_GTMLib_PMTCtr /end LOC_MEASUREMENT FUNCTION_VERSION "2.12.0_1.8.0" /end FUNCTION
/begin FUNCTION CEL_Compu "1.278.0   Arithemetic computation methods and physical units in MSR language" FUNCTION_VERSION "1.278.0" /end FUNCTION
/begin FUNCTION CEL_CompuLcy "1.1.0     Computation methods and SW Units with old DGS naming convention" FUNCTION_VERSION "1.1.0" /end FUNCTION
/begin FUNCTION CEL_Const "1.20.0    DGS central System Constants of the category FIXED" /begin DEF_CHARACTERISTIC medc_datasetid /end DEF_CHARACTERISTIC FUNCTION_VERSION "1.20.0" /end FUNCTION
/begin FUNCTION CEngDsT_AdprInp "1.8.1     Input Adapter for Coolant Engine Downstream Temperature"
 /begin IN_MEASUREMENT B_sa_msg EngStrt_bFrstStrtEnd EngStrt_bStrtEnd Epm_stSpd ExhMod_mAirMfIntegEngStrt lamsbg_w_msg ml_msg /end IN_MEASUREMENT
 /begin OUT_MEASUREMENT CEngDsT_facLamDesLim CEngDsT_flgEngN CEngDsT_flgOvrRun CEngDsT_flgStrtEnd CEngDsT_flgStrtEndFrst CEngDsT_mAirIntgl CEngDsT_mfAir /end OUT_MEASUREMENT
 FUNCTION_VERSION "1.8.1" /end FUNCTION
/begin FUNCTION CEngDsT_DD "21.19.0   Coolant temperature (at engine outlet) - device driver"
 /begin DEF_CHARACTERISTIC CEngDsT_flgSnsrFrzEna_C CEngDsT_swtSnsrCfg_C CEngDsT_swtSnsrSigAvl_C CEngDsT_tiDebImpsErrTmp_C CEngDsT_tiDebImpsErr_C CEngDsT_tiDebSigErr_C CEngDsT_tiDebSigHeal_C CEngDsT_tiDebSnsrElecVld_C CEngDsT_tiDebSRCErr_C CEngDsT_tiDebSRCHeal_C CEngDsT_tiSnsrURawFildImps_C CEngDsT_tiSnsrURawFild_C CEngDsT_tTrfSnsr_CUR CEngDsT_uAbsltDifRawFltdMin_C CEngDsT_uRawDfl_C CEngDsT_uRawMaxSRC_C CEngDsT_uRawMinSRC_C /end DEF_CHARACTERISTIC
 /begin IN_MEASUREMENT CEngDsT_flgSnsrElecClr SyC_stSub /end IN_MEASUREMENT
 /begin OUT_MEASUREMENT CEngDsT_flgImpsDi CEngDsT_flgImpsErr CEngDsT_flgImpsHeal CEngDsT_flgPhevChrgnMod CEngDsT_flgSigErr CEngDsT_flgSigHeal CEngDsT_flgSnsrElecVld CEngDsT_flgSnsrSigAvl CEngDsT_flgSRCMaxErr CEngDsT_flgSRCMaxHeal CEngDsT_flgSRCMinErr CEngDsT_flgSRCMinHeal CEngDsT_tPID05Tstr CEngDsT_tSnsr CEngDsT_tSnsrFild CEngDsT_tSnsrTstr CEngDsT_uRaw CEngDsT_uRawFild /end OUT_MEASUREMENT
 /begin LOC_MEASUREMENT CEngDsT_flgImpsErrTmp CEngDsT_flgImpsErrTmpDeb CEngDsT_flgImpsFF CEngDsT_flgImpsStr CEngDsT_flgSigErrTmp CEngDsT_flgSnsrElecVldDebInit CEngDsT_flgSnsrElecVldTmp CEngDsT_flgSnsrLCEna CEngDsT_flgSnsrSigAvlER CEngDsT_flgSRCDebInit CEngDsT_flgSRCErr CEngDsT_flgSRCErrTmp CEngDsT_flgSRCHealTmp CEngDsT_flgSRCMaxErrTmp CEngDsT_flgSRCMinErrTmp CEngDsT_uAbsltDifRawFltd CEngDsT_uRawFildImps /end LOC_MEASUREMENT
 FUNCTION_VERSION "21.19.0" /end FUNCTION
/begin FUNCTION CEngDsT_VD "21.9.0    Engine coolant temperature Down Stream Virtual Driver"
 /begin DEF_CHARACTERISTIC CEngDsT_flgSwtEnaFil_C CEngDsT_tiFil_C CEngDsT_tStopInin_C CEngDsT_tStrtThd_C /end DEF_CHARACTERISTIC
 /begin IN_MEASUREMENT CEngDsT_flgPhevChrgnMod CEngDsT_flgSnsrVld CEngDsT_tReplMdl CEngDsT_tSnsrFild Eep_EnvRamHist Eep_EnvRamInvld SyC_stSub TiEngOff_bEngRot TiEngOff_bRst /end IN_MEASUREMENT
 /begin OUT_MEASUREMENT CEngDsT_flgSnsrVldStop CEngDsT_flgSnsrVldStopFrst CEngDsT_flgSnsrVldStrt CEngDsT_flgSnsrVldStrtFrst CEngDsT_flgSwtReplMdl CEngDsT_t CEngDsT_tInpFil CEngDsT_tSnsrStrt CEngDsT_tSnsrStrtFrst CEngDsT_tStop CEngDsT_tStopFrst CEngDsT_tStrt CEngDsT_tStrtFrst CEngDsT_t_Sq /end OUT_MEASUREMENT
 /begin LOC_MEASUREMENT CEngDsT_flgCalcnEngStopVld CEngDsT_flgPhevChrgnModEdgeFall CEngDsT_flgStopFrst CEngDsT_flgSwtReplMdlStrt CEngDsT_flgSwtReplMdlStrtEdgeFall CEngDsT_tExtRepl CEngDsT_tSnsrFildFrzn /end LOC_MEASUREMENT
 FUNCTION_VERSION "21.9.0" /end FUNCTION
/begin FUNCTION CEngDsT_VdPlausDiag "1.34.0    Coolant Engine Downstream Temperature - plausibility diagnosis"
 /begin DEF_CHARACTERISTIC CEngDsT_cntrSTCDrvgCycColdThd_MAP CEngDsT_cntrSTCDrvgCycHotThd_MAP CEngDsT_mfAirSTCColdThdHi_CUR CEngDsT_mfAirSTCColdThdLo_CUR CEngDsT_mfAirSTCHotThdHi_CUR CEngDsT_mfAirSTCHotThdLo_CUR CEngDsT_nEngLSCEnagHi_C CEngDsT_nEngLSCEnagLo_C CEngDsT_stSwtPlausLSC2_C CEngDsT_stSwtPlausLSC_C CEngDsT_stSwtPlausSTCEnag_C CEngDsT_stSwtPlausSTC_C CEngDsT_tDeltaRefMdlEnd_C CEngDsT_tDifLSCRefMdlErrHi_C CEngDsT_tDifLSCRefMdlErrLo_C CEngDsT_tDifSTCSnsrFildThd_CUR CEngDsT_tiDebLSCErr_C CEngDsT_tiDebLSCHeal_C CEngDsT_tiDebLSCPlausEnagHi_C CEngDsT_tiDebLSCPlausEnagLo_C CEngDsT_tiSTCColdOffThd_C CEngDsT_tiSTCColdOnThd_C CEngDsT_tiSTCEngOffThdLo_C CEngDsT_tiSTCHotOffThd_C CEngDsT_tiSTCHotOnThd_C CEngDsT_tLSCRefMdlEnagThd_C CEngDsT_tLSCRefMdlEnd_CUR CEngDsT_tLSCStrtTEnagThd_CUR CEngDsT_tOffsRefMdl_C CEngDsT_tSTCRefMdlHotThd_C CEngDsT_tSTCSnsrStrtFrstThdHi_C CEngDsT_tSTCSnsrStrtFrstThdLo_C CEngDsT_tStrtFrstRefMdlEnd_C CEngDsT_vVehSTCColdThdHi_C CEngDsT_vVehSTCColdThdLo_C CEngDsT_vVehSTCHotThdHi_C CEngDsT_vVehSTCHotThdLo_C /end DEF_CHARACTERISTIC
 /begin IN_MEASUREMENT CEngDsT_flgBlkHeatrActvd CEngDsT_flgEngN CEngDsT_flgOvrRun CEngDsT_flgSnsrElecVld CEngDsT_flgSnsrPlausClr CEngDsT_flgStrtEnd CEngDsT_mfAirStoi CEngDsT_tRefMdl CEngDsT_tRefMdlEnd CEngDsT_tSnsrFild CEngDsT_tSnsrStrtFrst EngStrt_bFrstStrtEnd EnvT_t Epm_nEng SyC_stSub TiOff_stTiStrtEndOffFirstStrt TiOff_tiStrtEndOffFirstStrt VehV_v /end IN_MEASUREMENT
 /begin OUT_MEASUREMENT CEngDsT_flgPlausHSCErr CEngDsT_flgPlausHSCHeal CEngDsT_flgPlausHSCRiseNr CEngDsT_flgPlausLSCDi CEngDsT_flgPlausLSCErr CEngDsT_flgPlausLSCHeal CEngDsT_flgPlausLSCRiseNr CEngDsT_flgPlausSTCDi CEngDsT_flgPlausSTCErr CEngDsT_flgPlausSTCHeal CEngDsT_flgPlausSTCRiseNr /end OUT_MEASUREMENT
 /begin LOC_MEASUREMENT CEngDsT_cntrSTCDrvgCycCold CEngDsT_cntrSTCDrvgCycHot CEngDsT_flgComErrWtrPmp CEngDsT_flgDSMClr1000msPlausDiag CEngDsT_flgFanFlapRelsLSC CEngDsT_flgLSCEnad CEngDsT_flgLSCEngNEnagThd CEngDsT_flgLSCEngNEnagThdHi CEngDsT_flgLSCEngNEnagThdLo CEngDsT_flgLSCEnvTEnad CEngDsT_flgLSCEnvTHealEnad CEngDsT_flgLSCErrDi CEngDsT_flgLSCHealEnag CEngDsT_flgLSCHealLockd CEngDsT_flgLSCRefMdlEnagThd CEngDsT_flgLSCSnsrRefMdlEnd CEngDsT_flgLSCStrtEnd CEngDsT_flgPlausHSCErrTmp CEngDsT_flgPlausHSCHealTmp CEngDsT_flgPlausHSCRiseNrTmp CEngDsT_flgPlausLSCErrTmp CEngDsT_flgPlausLSCHealTmp CEngDsT_flgPlausLSCRiseNrTmp CEngDsT_flgPlausSTCErrTmp CEngDsT_flgPlausSTCHealTmp CEngDsT_flgPlausSTCRiseNrTmp CEngDsT_flgRefMdlEndVal CEngDsT_flgSTCCold CEngDsT_flgSTCDrvgCycCold CEngDsT_flgSTCDrvgCycColdCntUp CEngDsT_flgSTCDrvgCycColdHot CEngDsT_flgSTCDrvgCycHot CEngDsT_flgSTCDrvgCycHotCntUp CEngDsT_flgSTCEnad CEngDsT_flgSTCErrDi CEngDsT_flgSTCHot CEngDsT_flgSTCTDifSnsrFildThdLo CEngDsT_flgSTCTmrColdOnEnad CEngDsT_flgSTCTmrColdRst CEngDsT_flgSTCTmrHotOnEnad CEngDsT_flgSTCTmrHotRst CEngDsT_mfAirPLD CEngDsT_tDifSTCSnsrFild CEngDsT_tiSTCColdOff CEngDsT_tiSTCColdOn CEngDsT_tiSTCHotOff CEngDsT_tiSTCHotOn CEngDsT_tLSCRefMdlEnd CEngDsT_tSTCSnsrFildMax CEngDsT_tSTCSnsrFildMin /end LOC_MEASUREMENT
 FUNCTION_VERSION "1.34.0" /end FUNCTION
/begin FUNCTION CEngDsT_VdRefMdl "1.8.0     Coolant Engine Downstream Temperature - Reference Model"
 /begin DEF_CHARACTERISTIC CEngDsT_facRefMdlCalcnGradOn_CUR CEngDsT_facRefMdlEngTFall_CUR CEngDsT_facRefMdlOffWtrPmp_CUR CEngDsT_stSwtRefMdl_C CEngDsT_tGrdtRefMdlCoolg_MAP CEngDsT_tGrdtRefMdlEnvFcoGsl_CUR CEngDsT_tGrdtRefMdlEnv_MAP CEngDsT_tGrdtRefMdlLoadFcoGsl_MAP CEngDsT_tGrdtRefMdlLoad_MAP CEngDsT_tGrdtRefMdlOff_MAP CEngDsT_tiDebRefMdlCalcnGrdOn_C CEngDsT_tiDebRefMdlCalcnGrdOn_MAP CEngDsT_tiDebRefMdlEngN_C CEngDsT_tiDebRefMdlEngTFall_C CEngDsT_tiDebRefMdlEngTFall_MAP CEngDsT_tiFilVElec_C CEngDsT_tRefMdlEnd_CUR /end DEF_CHARACTERISTIC
 /begin IN_MEASUREMENT CEngDsT_facCorrnStoi CEngDsT_flgEngN CEngDsT_flgOvrRun CEngDsT_flgSnsrElecVld CEngDsT_flgStrtEnd CEngDsT_flgStrtEndFrst CEngDsT_mfAirStoi CEngDsT_tReplMdl CEngDsT_tSnsrFild EnvT_t InjSys_flgFuEngOperActv SyC_stSub TiEngOff_ti VehV_v /end IN_MEASUREMENT
 /begin OUT_MEASUREMENT CEngDsT_flgRefMdlCalcnGrdOn CEngDsT_flgRefMdlRstLongStop CEngDsT_tRefMdl CEngDsT_tRefMdlEnd /end OUT_MEASUREMENT
 /begin LOC_MEASUREMENT CEngDsT_facFilVElec CEngDsT_facRefMdlFan CEngDsT_flgBlkHeatrActvdShft CEngDsT_flgEngNEdgeFall CEngDsT_flgEngTFall CEngDsT_flgFuEngStop CEngDsT_flgNgvGrdtRstTMdl CEngDsT_flgRefMdlFrstStop CEngDsT_flgRefMdlRst CEngDsT_flgRefMdlStrt CEngDsT_flgRefMdlStrtEndFrst CEngDsT_flgSwtRefMdlWtrPmp CEngDsT_mfAirStoiRefMdl CEngDsT_tDifRefMdlEnv CEngDsT_tGrdtRefMdl CEngDsT_tGrdtRefMdlAcm CEngDsT_tGrdtRefMdlDegPosTMEE CEngDsT_tGrdtRefMdlFco CEngDsT_tGrdtRefMdlHeat CEngDsT_tGrdtRefMdlInj CEngDsT_tGrdtRefMdlOff CEngDsT_tGrdtRefMdlOffLoc CEngDsT_tGrdtRefMdlOn CEngDsT_tGrdtRefMdlOnLoc CEngDsT_tiDebRefMdlCalcnGrdOn CEngDsT_tiDebRefMdlCalcnGrdOnCalcd CEngDsT_tiDebRefMdlEngTFall CEngDsT_tiDebRefMdlEngTFallCalcd CEngDsT_tiRefMdlEngOff CEngDsT_tRefMdlHiResl CEngDsT_tRefMdlLoc CEngDsT_tSnsrSub CEngDsT_vAvrgElec /end LOC_MEASUREMENT
 FUNCTION_VERSION "1.8.0" /end FUNCTION
/begin FUNCTION CEngDsT_VDReplMdl "2.7.0     Replacement Model for Engine Coolant Temperature"
 /begin DEF_CHARACTERISTIC CEngDsT_facReplMdlEngOffInin_C CEngDsT_facReplMdlEngOffTi_CUR CEngDsT_stSwtReplMdlCfg_C CEngDsT_tGrdtReplMdlOnGsl_MAP CEngDsT_tiDebEngRot_C CEngDsT_tReplMdlEngOffLim_C CEngDsT_tReplMdlEngOnLim_C CEngDsT_tReplMdlInin_C /end DEF_CHARACTERISTIC
 /begin IN_MEASUREMENT CEngDsT_mfAir CEngDsT_tStop IntkAirT_tSnsrFild1 TiEngOff_bEngRot TiEngOff_bRst TiEngOff_stTi TiEngOff_ti /end IN_MEASUREMENT
 /begin OUT_MEASUREMENT CEngDsT_facCorrnStoi CEngDsT_flgReplMdlEngOffRst CEngDsT_mfAirStoi CEngDsT_tReplMdl CEngDsT_tReplMdlStop /end OUT_MEASUREMENT
 /begin LOC_MEASUREMENT CEngDsT_facReplMdlEngOffInit CEngDsT_flgCalcnReplMdlEngStop CEngDsT_flgEngRotDeb CEngDsT_tDifReplMdlEngOff CEngDsT_tGrdtReplMdlEngOn CEngDsT_tiReplMdlEngOff CEngDsT_tReplMdlEngOffCoolg CEngDsT_tReplMdlIntkAir CEngDsT_tReplMdlLoc CEngDsT_tStopReplMdlLoc /end LOC_MEASUREMENT
 FUNCTION_VERSION "2.7.0" /end FUNCTION
/begin FUNCTION CEngDsT_Vd_DiagCoorr "1.18.0    Diagnosis Coordinator of Coolant Engine Downstream Temperature Sensor" /begin DEF_CHARACTERISTIC CEngDsT_tiDiagDSMCycRprt_C CEngDsT_tiDiagDSMFrstRprt_C /end DEF_CHARACTERISTIC
 /begin IN_MEASUREMENT CEngDsT_flgColdStrtDi CEngDsT_flgColdStrtFinal CEngDsT_flgColdStrtHeal CEngDsT_flgColdStrtMaxErr CEngDsT_flgColdStrtMinErr CEngDsT_flgColdStrtRiseNr CEngDsT_flgImpsDi CEngDsT_flgImpsErr CEngDsT_flgImpsHeal CEngDsT_flgPlausLSCDi CEngDsT_flgPlausLSCErr CEngDsT_flgPlausLSCHeal CEngDsT_flgPlausLSCRiseNr CEngDsT_flgPlausSTCDi CEngDsT_flgPlausSTCErr CEngDsT_flgPlausSTCHeal CEngDsT_flgPlausSTCRiseNr CEngDsT_flgSigErr CEngDsT_flgSigHeal CEngDsT_flgSnsrElecVld CEngDsT_flgSRCMaxErr CEngDsT_flgSRCMaxHeal CEngDsT_flgSRCMinErr CEngDsT_flgSRCMinHeal TDev_flgDSMRprt1000ms TDev_flgDSMRprt100ms /end IN_MEASUREMENT
 /begin OUT_MEASUREMENT CEngDsT_flgSnsrClr CEngDsT_flgSnsrColdStrtClr CEngDsT_flgSnsrElecClr CEngDsT_flgSnsrPlausClr CEngDsT_flgSnsrVld /end OUT_MEASUREMENT
 /begin LOC_MEASUREMENT CEngDsT_flgImpsClr CEngDsT_flgSetDFC1000ms CEngDsT_flgSetDFC100ms CEngDsT_flgSigClr CEngDsT_flgSnsrColdStrtVld CEngDsT_flgSnsrPlausVld CEngDsT_flgSnsrVldLoc CEngDsT_flgSRCClr CEngDsT_stDiagCycRprt1000ms CEngDsT_stDiagCycRprt100ms CEngDsT_tiDiagCycRprt1000ms CEngDsT_tiDiagCycRprt100ms /end LOC_MEASUREMENT
 FUNCTION_VERSION "1.18.0" /end FUNCTION
/begin FUNCTION CEngDsT_Vld2Lcy "2.12.0    Interface adapter of package Coolant Engine Downstream Temperature"
 /begin IN_MEASUREMENT CEngDsT_flgSnsrVld CEngDsT_t CEngDsT_tReplMdl CEngDsT_tSnsr CEngDsT_tSnsrFild CEngDsT_tSnsrTstr /end IN_MEASUREMENT
 /begin OUT_MEASUREMENT CEngDsT_stSigT CEngDsT_tMod CEngDsT_tRaw CEngDsT_tSens CEngDsT_tSnsrTstrSAE EngDa_tEng /end OUT_MEASUREMENT
 FUNCTION_VERSION "2.12.0" /end FUNCTION
/begin FUNCTION CEngTCHdT2SV "1.8.0     services 01,02 for engine temperature (coolant or cylinder head)" /begin DEF_CHARACTERISTIC TDev_tDflValPID67_C /end DEF_CHARACTERISTIC /begin IN_MEASUREMENT CEngDsT_tSnsrTstr CEngUsT_tSens /end IN_MEASUREMENT /begin OUT_MEASUREMENT ects2sva_msg ects2svb_msg ects2svc_msg /end OUT_MEASUREMENT
 /begin LOC_MEASUREMENT CEngBlkT_tCEngTCHdT2SV CEngDsT_tCEngTCHdT2SV CEngUsT_tCEngTCHdT2SV CHdT_tCEngTCHdT2SV ects2sva1 ects2svb1 ects2svc1 /end LOC_MEASUREMENT
 FUNCTION_VERSION "1.8.0" /end FUNCTION
/begin COMPU_METHOD Acc "" RAT_FUNC "%6.5" "m/s^2" COEFFS 0 1000 0 0 0 1 /end COMPU_METHOD
/begin COMPU_METHOD AngleCrS "" RAT_FUNC "%6.4" "deg CrS" COEFFS 0 45.5111111111 0 0 0 1 /end COMPU_METHOD
/begin COMPU_METHOD B_TRUE "" TAB_VERB "%6.3" "" COMPU_TAB_REF B_TRUE /end COMPU_METHOD
/begin COMPU_VTAB B_TRUE "" TAB_VERB 2 0 "FALSE" 1 "TRUE" /end COMPU_VTAB
/begin COMPU_METHOD CoEOM_idxOperModCfgd_VERB "" TAB_VERB "%6.3" "-" COMPU_TAB_REF CoEOM_idxOperModCfgd_VERB /end COMPU_METHOD
/begin COMPU_VTAB CoEOM_idxOperModCfgd_VERB "" TAB_VERB 4 0 "Base" 1 "WarmUp" 2 "CatHtg" 3 "Start" /end COMPU_VTAB
/begin COMPU_METHOD CoEOM_idxOperModStgTot_VERB "" TAB_VERB "%6.3" "-" COMPU_TAB_REF CoEOM_idxOperModStgTot_VERB /end COMPU_METHOD
/begin COMPU_VTAB CoEOM_idxOperModStgTot_VERB "" TAB_VERB 16 0 "HOM_FullLft" 1 "Stage 1" 2 "Stage 2" 3 "Stage 3" 4 "HOM_EIVC" 5 "Stage 5" 6 "Stage 6" 7 "Stage 7" 8 "Stage 8" 9 "Stage 9" 10 "Stage 10" 11 "Stage 11" 12 "Stage 12" 13 "Stage 13" 14 "Stage 14" 15 "Stage 15" /end COMPU_VTAB
/begin COMPU_METHOD COOPCLSTRCORE_SC_Compu "" TAB_VERB "%6.3" "" COMPU_TAB_REF COOPCLSTRCORE_SC_Compu /end COMPU_METHOD
/begin COMPU_VTAB COOPCLSTRCORE_SC_Compu "" TAB_VERB 3 0 "PeripheralCoreNo1" 1 "LockedCoreNo1" 2 "PerformanceCoreNo1" /end COMPU_VTAB
/begin COMPU_METHOD COPOM_INHOUSE_SC_Compu "" TAB_VERB "%6.3" "" COMPU_TAB_REF COPOM_INHOUSE_SC_Compu /end COMPU_METHOD
/begin COMPU_VTAB COPOM_INHOUSE_SC_Compu "" TAB_VERB 2 0 "False" 1 "True" /end COMPU_VTAB
/begin COMPU_METHOD CORRZLRSTMOT_SY_Compu "" TAB_VERB "%6.3" "" COMPU_TAB_REF CORRZLRSTMOT_SY_Compu /end COMPU_METHOD
/begin COMPU_VTAB CORRZLRSTMOT_SY_Compu "" TAB_VERB 2 0 "False" 1 "True" /end COMPU_VTAB
/begin COMPU_METHOD COVEH_STREETMODENA_SC_Compu "" TAB_VERB "%6.3" "" COMPU_TAB_REF COVEH_STREETMODENA_SC_Compu /end COMPU_METHOD
/begin COMPU_VTAB COVEH_STREETMODENA_SC_Compu "" TAB_VERB 2 0 "False" 1 "True" /end COMPU_VTAB
/begin COMPU_METHOD COVOMVERS_SC_Compu "" TAB_VERB "%6.3" "" COMPU_TAB_REF COVOMVERS_SC_Compu /end COMPU_METHOD
/begin COMPU_VTAB COVOMVERS_SC_Compu "" TAB_VERB 2 1 "COVOMVER_1_0" 2 "COVOMVER_2_0" /end COMPU_VTAB
/begin COMPU_METHOD CppFacCylVol "" RAT_FUNC "%7.6" "-" COEFFS 0 32768 0 0 0 1 /end COMPU_METHOD
/begin COMPU_METHOD CppOfsFact "" RAT_FUNC "%6.4" "-" COEFFS 0 256 0 0 0 1 /end COMPU_METHOD
/begin COMPU_METHOD CPUDEVICE_SC_Compu "" TAB_VERB "%6.3" "" COMPU_TAB_REF CPUDEVICE_SC_Compu /end COMPU_METHOD
/begin COMPU_VTAB CPUDEVICE_SC_Compu "" TAB_VERB 10 0 "None" 1 "Device1" 2 "Device2" 3 "Device3" 4 "Device4" 5 "Device5" 13 "Device3+" 14 "Device4+" 15 "Device5+" 16 "Device5_28" /end COMPU_VTAB
/begin COMPU_METHOD CPUVENDOR_SC_Compu "" TAB_VERB "%6.3" "" COMPU_TAB_REF CPUVENDOR_SC_Compu /end COMPU_METHOD
/begin COMPU_VTAB CPUVENDOR_SC_Compu "" TAB_VERB 4 0 "None" 1 "IFX" 2 "JDP" 3 "ST" /end COMPU_VTAB
/begin COMPU_METHOD CPVCLSNGIMP_SC_Compu "" TAB_VERB "%6.3" "" COMPU_TAB_REF CPVCLSNGIMP_SC_Compu /end COMPU_METHOD
/begin COMPU_VTAB CPVCLSNGIMP_SC_Compu "" TAB_VERB 2 0 "False" 1 "True" /end COMPU_VTAB
/begin COMPU_METHOD CPV_ATS_SY_Compu "" TAB_VERB "%6.3" "" COMPU_TAB_REF CPV_ATS_SY_Compu /end COMPU_METHOD
/begin COMPU_VTAB CPV_ATS_SY_Compu "" TAB_VERB 2 0 "False" 1 "True" /end COMPU_VTAB
/begin COMPU_METHOD CRCSP_TYPAVL_SC_Compu "" TAB_VERB "%6.3" "" COMPU_TAB_REF CRCSP_TYPAVL_SC_Compu /end COMPU_METHOD
/begin COMPU_VTAB CRCSP_TYPAVL_SC_Compu "" TAB_VERB 2 0 "False" 1 "True" /end COMPU_VTAB
/begin COMPU_METHOD CRCTL_SY_Compu "" TAB_VERB "%6.3" "" COMPU_TAB_REF CRCTL_SY_Compu /end COMPU_METHOD
/begin COMPU_VTAB CRCTL_SY_Compu "" TAB_VERB 2 0 "FALSE" 1 "TRUE" /end COMPU_VTAB
/begin COMPU_METHOD CRKCSPABSLT_TYPAVL_SY_Compu "" TAB_VERB "%6.3" "" COMPU_TAB_REF CRKCSPABSLT_TYPAVL_SY_Compu /end COMPU_METHOD
/begin COMPU_VTAB CRKCSPABSLT_TYPAVL_SY_Compu "" TAB_VERB 2 0 "False" 1 "True" /end COMPU_VTAB
/begin COMPU_METHOD CRKCSVENTDIAG_SC_Compu "" TAB_VERB "%6.3" "" COMPU_TAB_REF CRKCSVENTDIAG_SC_Compu /end COMPU_METHOD
/begin COMPU_VTAB CRKCSVENTDIAG_SC_Compu "" TAB_VERB 2 0 "NONE" 1 "VALVE_DELTA_PRESSURE" /end COMPU_VTAB
/begin COMPU_METHOD CRKCSVENTNVLV_SC_Compu "" TAB_VERB "%6.3" "" COMPU_TAB_REF CRKCSVENTNVLV_SC_Compu /end COMPU_METHOD
/begin COMPU_VTAB CRKCSVENTNVLV_SC_Compu "" TAB_VERB 2 0 "False" 1 "True" /end COMPU_VTAB
/begin COMPU_METHOD CRKCSVLVTYP_SC_Compu "" TAB_VERB "%6.3" "" COMPU_TAB_REF CRKCSVLVTYP_SC_Compu /end COMPU_METHOD
/begin COMPU_VTAB CRKCSVLVTYP_SC_Compu "" TAB_VERB 4 0 "standard" 1 "switch_on/off_electronically_controlled" 2 "two_stage_switch_electronically_controlled" 3 "two_stage_switch_mechanically_controlled" /end COMPU_VTAB
/begin COMPU_METHOD CRSSENSTYP_SY_Compu "" TAB_VERB "%6.3" "" COMPU_TAB_REF CRSSENSTYP_SY_Compu /end COMPU_METHOD
/begin COMPU_VTAB CRSSENSTYP_SY_Compu "" TAB_VERB 3 0 "STD" 1 "DGI" 2 "DG_DGI" /end COMPU_VTAB
/begin COMPU_METHOD CRSTYP_SY_Compu "" TAB_VERB "%6.3" "" COMPU_TAB_REF CRSTYP_SY_Compu /end COMPU_METHOD
/begin COMPU_VTAB CRSTYP_SY_Compu "" TAB_VERB 5 0 "SYMMETRIC_GAP" 1 "SHORT_GAP" 2 "CODED_GAP" 3 "ASYMMETRIC_GAP" 4 "INTRPT_GAP" /end COMPU_VTAB
/begin COMPU_METHOD CRS_BACKUP_CASTYP_SY_Compu "" TAB_VERB "%6.3" "" COMPU_TAB_REF CRS_BACKUP_CASTYP_SY_Compu /end COMPU_METHOD
/begin COMPU_VTAB CRS_BACKUP_CASTYP_SY_Compu "" TAB_VERB 7 0 "ZN_PLUS_1_WHEEL" 1 "DS_STD_WHEEL" 2 "GS_STD_WHEEL" 3 "HALFMOON_WHEEL" 7 "CAS_3TOOTH_180_60" 8 "CAS_10PULSE_WHEEL" 12 "SWTCHCAL_DS_STD_WHEEL_GS_STD_WHEEL" /end COMPU_VTAB
/begin COMPU_METHOD CRS_BACKUP_DYN_SY_Compu "" TAB_VERB "%6.3" "" COMPU_TAB_REF CRS_BACKUP_DYN_SY_Compu /end COMPU_METHOD
/begin COMPU_VTAB CRS_BACKUP_DYN_SY_Compu "" TAB_VERB 2 0 "CAL_DYNCOR" 1 "ADAP_DYNCAOR" /end COMPU_VTAB
/begin COMPU_METHOD CRS_BACKUP_SY_Compu "" TAB_VERB "%6.3" "" COMPU_TAB_REF CRS_BACKUP_SY_Compu /end COMPU_METHOD
/begin COMPU_VTAB CRS_BACKUP_SY_Compu "" TAB_VERB 4 0 "NO_BCR" 1 "BCR" 2 "BCR_DYNCOR_START" 3 "BCR_DYNCOR_ALWAYS" /end COMPU_VTAB
/begin COMPU_METHOD CRS_CY30CONF_SY_Compu "" TAB_VERB "%6.3" "" COMPU_TAB_REF CRS_CY30CONF_SY_Compu /end COMPU_METHOD
/begin COMPU_VTAB CRS_CY30CONF_SY_Compu "" TAB_VERB 4 0 "HARD_WIRED" 1 "CONF_TH_VIA_SW" 2 "CONF_K_VIA_SW" 3 "CONF_TH_K_VIA_SW" /end COMPU_VTAB
/begin COMPU_METHOD CRS_DIAG_DETAIL_SY_Compu "" TAB_VERB "%6.3" "" COMPU_TAB_REF CRS_DIAG_DETAIL_SY_Compu /end COMPU_METHOD
/begin COMPU_VTAB CRS_DIAG_DETAIL_SY_Compu "" TAB_VERB 3 0 "NO_DETAIL" 1 "DETAIL_ERRSIG" 2 "DETAIL_ERRSIG_GLITCH" /end COMPU_VTAB
/begin COMPU_METHOD CRS_DIAG_SYNCINJLOST_SY_Compu "" TAB_VERB "%6.3" "" COMPU_TAB_REF CRS_DIAG_SYNCINJLOST_SY_Compu /end COMPU_METHOD
/begin COMPU_VTAB CRS_DIAG_SYNCINJLOST_SY_Compu "" TAB_VERB 3 0 "NO_ADD_DIAG" 1 "ACTIVATED" 2 "ACTIVATED_ALL" /end COMPU_VTAB
/begin COMPU_METHOD CRS_MIAP_SY_Compu "" TAB_VERB "%6.3" "" COMPU_TAB_REF CRS_MIAP_SY_Compu /end COMPU_METHOD
/begin COMPU_VTAB CRS_MIAP_SY_Compu "" TAB_VERB 2 0 "NO_COR" 1 "MIAP" /end COMPU_VTAB
/begin COMPU_METHOD CRS_SSP_SY_Compu "" TAB_VERB "%6.3" "" COMPU_TAB_REF CRS_SSP_SY_Compu /end COMPU_METHOD
/begin COMPU_VTAB CRS_SSP_SY_Compu "" TAB_VERB 4 0 "NO_CRS_SSPMON" 1 "CRS_SSPMON1" 2 "CRS_SSPMON2" 3 "CRS_SSPMON3" /end COMPU_VTAB
/begin COMPU_METHOD CRS_TAA_SY_Compu "" TAB_VERB "%6.3" "" COMPU_TAB_REF CRS_TAA_SY_Compu /end COMPU_METHOD
/begin COMPU_VTAB CRS_TAA_SY_Compu "" TAB_VERB 3 0 "NO_COR" 1 "TAA" 2 "TAA_ChkCor" /end COMPU_VTAB
/begin COMPU_METHOD CRS_TOOTHAVRG_SY_Compu "" TAB_VERB "%6.3" "" COMPU_TAB_REF CRS_TOOTHAVRG_SY_Compu /end COMPU_METHOD
/begin COMPU_VTAB CRS_TOOTHAVRG_SY_Compu "" TAB_VERB 2 0 "NO_AVRG" 1 "TOOTH_AVERAGE" /end COMPU_VTAB
/begin COMPU_METHOD CSERSABVANDBYND_SC_Compu "" TAB_VERB "%6.3" "" COMPU_TAB_REF CSERSABVANDBYND_SC_Compu /end COMPU_METHOD
/begin COMPU_VTAB CSERSABVANDBYND_SC_Compu "" TAB_VERB 2 0 "NO_CSERS" 1 "CSERS_ABV_BYND" /end COMPU_VTAB
/begin COMPU_METHOD CSTRPURGNOFUPURGCRKCS_SC_Compu "" TAB_VERB "%6.3" "" COMPU_TAB_REF CSTRPURGNOFUPURGCRKCS_SC_Compu /end COMPU_METHOD
/begin COMPU_VTAB CSTRPURGNOFUPURGCRKCS_SC_Compu "" TAB_VERB 2 0 "Disable" 1 "Enable" /end COMPU_VTAB
/begin COMPU_METHOD CTEGRCLRDS_TYPAVL_SC_Compu "" TAB_VERB "%6.3" "" COMPU_TAB_REF CTEGRCLRDS_TYPAVL_SC_Compu /end COMPU_METHOD
/begin COMPU_VTAB CTEGRCLRDS_TYPAVL_SC_Compu "" TAB_VERB 2 0 "False" 1 "True" /end COMPU_VTAB
/begin COMPU_METHOD CTEGRCLRLPUS_TYPAVL_SC_Compu "" TAB_VERB "%6.3" "" COMPU_TAB_REF CTEGRCLRLPUS_TYPAVL_SC_Compu /end COMPU_METHOD
/begin COMPU_VTAB CTEGRCLRLPUS_TYPAVL_SC_Compu "" TAB_VERB 2 0 "False" 1 "True" /end COMPU_VTAB
/begin COMPU_METHOD CTEGRCLRUS_TYPAVL_SY_Compu "" TAB_VERB "%6.3" "" COMPU_TAB_REF CTEGRCLRUS_TYPAVL_SY_Compu /end COMPU_METHOD
/begin COMPU_VTAB CTEGRCLRUS_TYPAVL_SY_Compu "" TAB_VERB 2 0 "0" 1 "1" /end COMPU_VTAB
/begin COMPU_METHOD CTEVCHRGRDS_TYPAVL_SY_Compu "" TAB_VERB "%6.3" "" COMPU_TAB_REF CTEVCHRGRDS_TYPAVL_SY_Compu /end COMPU_METHOD
/begin COMPU_VTAB CTEVCHRGRDS_TYPAVL_SY_Compu "" TAB_VERB 2 0 "False" 1 "True" /end COMPU_VTAB
/begin COMPU_METHOD CTEVEMDS_TYPAVL_SY_Compu "" TAB_VERB "%6.3" "" COMPU_TAB_REF CTEVEMDS_TYPAVL_SY_Compu /end COMPU_METHOD
/begin COMPU_VTAB CTEVEMDS_TYPAVL_SY_Compu "" TAB_VERB 2 0 "False" 1 "True" /end COMPU_VTAB
/begin COMPU_METHOD CTEVHTRDS_TYPAVL_SC_Compu "" TAB_VERB "%6.3" "" COMPU_TAB_REF CTEVHTRDS_TYPAVL_SC_Compu /end COMPU_METHOD
/begin COMPU_VTAB CTEVHTRDS_TYPAVL_SC_Compu "" TAB_VERB 2 0 "False" 1 "True" /end COMPU_VTAB
/begin COMPU_METHOD CTEVHTREXCHGDS_TYPAVL_SC_Compu "" TAB_VERB "%6.3" "" COMPU_TAB_REF CTEVHTREXCHGDS_TYPAVL_SC_Compu /end COMPU_METHOD
/begin COMPU_VTAB CTEVHTREXCHGDS_TYPAVL_SC_Compu "" TAB_VERB 2 0 "False" 1 "True" /end COMPU_VTAB
/begin COMPU_METHOD CTEVHTRUS_TYPAVL_SC_Compu "" TAB_VERB "%6.3" "" COMPU_TAB_REF CTEVHTRUS_TYPAVL_SC_Compu /end COMPU_METHOD
/begin COMPU_VTAB CTEVHTRUS_TYPAVL_SC_Compu "" TAB_VERB 2 0 "False" 1 "True" /end COMPU_VTAB
/begin COMPU_METHOD CTEVINVRUS_TYPAVL_SY_Compu "" TAB_VERB "%6.3" "" COMPU_TAB_REF CTEVINVRUS_TYPAVL_SY_Compu /end COMPU_METHOD
/begin COMPU_VTAB CTEVINVRUS_TYPAVL_SY_Compu "" TAB_VERB 2 0 "False" 1 "True" /end COMPU_VTAB
/begin COMPU_METHOD CTEVLEDS_TYPAVL_SY_Compu "" TAB_VERB "%6.3" "" COMPU_TAB_REF CTEVLEDS_TYPAVL_SY_Compu /end COMPU_METHOD
/begin COMPU_VTAB CTEVLEDS_TYPAVL_SY_Compu "" TAB_VERB 2 0 "False" 1 "True" /end COMPU_VTAB
/begin COMPU_METHOD CTHEATGRET_ADCSNSR_SC_Compu "" TAB_VERB "%6.3" "" COMPU_TAB_REF CTHEATGRET_ADCSNSR_SC_Compu /end COMPU_METHOD
/begin COMPU_VTAB CTHEATGRET_ADCSNSR_SC_Compu "" TAB_VERB 2 0 "no ADC sensor" 1 "ADC sensor" /end COMPU_VTAB
/begin COMPU_METHOD CTHEATGRET_COLDSTRTDIAG_SC_Compu "" TAB_VERB "%6.3" "" COMPU_TAB_REF CTHEATGRET_COLDSTRTDIAG_SC_Compu /end COMPU_METHOD
/begin COMPU_VTAB CTHEATGRET_COLDSTRTDIAG_SC_Compu "" TAB_VERB 2 0 "False" 1 "True" /end COMPU_VTAB
/begin COMPU_METHOD CTHMST_TYPAVLDELIBSTDACTR_SY_Compu "" TAB_VERB "%6.3" "" COMPU_TAB_REF CTHMST_TYPAVLDELIBSTDACTR_SY_Compu /end COMPU_METHOD
/begin COMPU_VTAB CTHMST_TYPAVLDELIBSTDACTR_SY_Compu "" TAB_VERB 2 0 "FALSE" 1 "TRUE" /end COMPU_VTAB
/begin COMPU_METHOD CTRLDENGSTOPPOSNG_SC_Compu "" TAB_VERB "%6.3" "" COMPU_TAB_REF CTRLDENGSTOPPOSNG_SC_Compu /end COMPU_METHOD
/begin COMPU_VTAB CTRLDENGSTOPPOSNG_SC_Compu "" TAB_VERB 4 0 "NONE" 1 "THROTTLEBLADE" 2 "VVT" 3 "E_MACHINE" /end COMPU_VTAB
/begin COMPU_METHOD CTRLDPISTCOOLGVLV_SC_Compu "" RAT_FUNC "%6.2" "" COEFFS 0 1 0 0 0 1 /end COMPU_METHOD
/begin COMPU_METHOD CTTCTL_SY_Compu "" TAB_VERB "%6.3" "" COMPU_TAB_REF CTTCTL_SY_Compu /end COMPU_METHOD
/begin COMPU_VTAB CTTCTL_SY_Compu "" TAB_VERB 2 0 "False" 1 "True" /end COMPU_VTAB
/begin COMPU_METHOD CTTSTDETN_SC_Compu "" TAB_VERB "%6.3" "" COMPU_TAB_REF CTTSTDETN_SC_Compu /end COMPU_METHOD
/begin COMPU_VTAB CTTSTDETN_SC_Compu "" TAB_VERB 2 0 "False" 1 "True" /end COMPU_VTAB
/begin COMPU_METHOD CT_REPLVALSRC_SY_Compu "" TAB_VERB "%6.3" "" COMPU_TAB_REF CT_REPLVALSRC_SY_Compu /end COMPU_METHOD
/begin COMPU_VTAB CT_REPLVALSRC_SY_Compu "" TAB_VERB 2 1 "TFA1LINF_CALC" 2 "TFA2LINF_CALC" /end COMPU_VTAB
/begin COMPU_METHOD CubMtrPerHr "" RAT_FUNC "%6.3" "m^3/h" COEFFS 0 10 0 0 0 1 /end COMPU_METHOD
/begin COMPU_METHOD CVC_SY_Compu "" TAB_VERB "%6.3" "" COMPU_TAB_REF CVC_SY_Compu /end COMPU_METHOD
/begin COMPU_VTAB CVC_SY_Compu "" TAB_VERB 2 0 "False" 1 "True" /end COMPU_VTAB
/begin COMPU_METHOD CVOCFG_SC_Compu "" TAB_VERB "%6.3" "" COMPU_TAB_REF CVOCFG_SC_Compu /end COMPU_METHOD
/begin COMPU_VTAB CVOCFG_SC_Compu "" TAB_VERB 6 0 "NO_CVO" 1 "BASC_CVO" 2 "STEP2_CVO" 3 "STEP3_CVO" 4 "STEP4_CVO" 5 "STEP5_CVO" /end COMPU_VTAB
/begin COMPU_METHOD CVOPFI_SC_Compu "" TAB_VERB "%6.3" "" COMPU_TAB_REF CVOPFI_SC_Compu /end COMPU_METHOD
/begin COMPU_VTAB CVOPFI_SC_Compu "" TAB_VERB 4 0 "Disable" 1 "DFR_support" 2 "DFR_and_NoiseReduction" 3 "NoiseReduction" /end COMPU_VTAB
/begin COMPU_METHOD CVT_SY_Compu "" TAB_VERB "%6.3" "" COMPU_TAB_REF CVT_SY_Compu /end COMPU_METHOD
/begin COMPU_VTAB CVT_SY_Compu "" TAB_VERB 2 0 "no CVT gear active" 1 "CVT gear active" /end COMPU_VTAB
/begin COMPU_METHOD CY326_SC_Compu "" TAB_VERB "%6.3" "" COMPU_TAB_REF CY326_SC_Compu /end COMPU_METHOD
/begin COMPU_VTAB CY326_SC_Compu "" TAB_VERB 3 0 "No CY326" 1 "One CY326" 2 "Two CY326" /end COMPU_VTAB
/begin COMPU_METHOD CY327_SY_Compu "" TAB_VERB "%6.3" "" COMPU_TAB_REF CY327_SY_Compu /end COMPU_METHOD
/begin COMPU_VTAB CY327_SY_Compu "" TAB_VERB 3 0 "No CY327" 1 "One CY327" 2 "Two CY327" /end COMPU_VTAB
/begin COMPU_METHOD CY329_SC_Compu "" TAB_VERB "%6.3" "" COMPU_TAB_REF CY329_SC_Compu /end COMPU_METHOD
/begin COMPU_VTAB CY329_SC_Compu "" TAB_VERB 4 0 "No CY329" 1 "One CY329" 2 "Two CY329" 3 "Three CY329" /end COMPU_VTAB
/begin COMPU_METHOD CylHtRls "" RAT_FUNC "%6.3" "J" COEFFS 0 4 0 0 0 1 /end COMPU_METHOD
/begin COMPU_METHOD CylHtRlsRate "" RAT_FUNC "%6.4" "J/AgCA" COEFFS 0 64 0 0 0 1 /end COMPU_METHOD
/begin COMPU_METHOD CylinderVolumeCpp "" RAT_FUNC "%9.8" "m^3" COEFFS 0 1000000 0 0 0 1 /end COMPU_METHOD
/begin COMPU_METHOD CylK1 "" RAT_FUNC "%6.4" "10^-5m^3/AgCA" COEFFS 0 128 0 0 0 1 /end COMPU_METHOD
/begin COMPU_METHOD CylK2 "" RAT_FUNC "%7.6" "-" COEFFS 0 16384 0 0 0 1 /end COMPU_METHOD
/begin COMPU_METHOD CylPres "" RAT_FUNC "%6.4" "bar" COEFFS 0 128 0 0 0 1 /end COMPU_METHOD
/begin COMPU_METHOD CYL_MAX_Compu "" RAT_FUNC "%6.2" "" COEFFS 0 1 0 0 0 1 /end COMPU_METHOD
/begin COMPU_METHOD DAPRID_DRVT_SC_Compu "" TAB_VERB "%6.3" "" COMPU_TAB_REF DAPRID_DRVT_SC_Compu /end COMPU_METHOD
/begin COMPU_VTAB DAPRID_DRVT_SC_Compu "" TAB_VERB 8 0 "0" 1 "1" 2 "2" 3 "3" 4 "4" 5 "5" 6 "6" 7 "7" /end COMPU_VTAB
/begin COMPU_METHOD DAPRID_SC_Compu "" TAB_VERB "%6.3" "" COMPU_TAB_REF DAPRID_SC_Compu /end COMPU_METHOD
/begin COMPU_VTAB DAPRID_SC_Compu "" TAB_VERB 9 0 "keine Zuordnung" 1 "ME 9.7 NGV" 2 "ME 17.7 UHP" 3 "MED 17.7.1 MoVE" 4 "MED 17.7.2 M270/M274" 5 "MED 17.7.3" 6 "MED 17.7.4 M177/M178" 7 "ME17.7.20 M281 Smart" 8 "ME17.7.20 M281 REX" /end COMPU_VTAB
/begin COMPU_METHOD DCCHRGRINTKT_TYPAVL_SC_Compu "" TAB_VERB "%6.3" "" COMPU_TAB_REF DCCHRGRINTKT_TYPAVL_SC_Compu /end COMPU_METHOD
/begin COMPU_VTAB DCCHRGRINTKT_TYPAVL_SC_Compu "" TAB_VERB 2 0 "False" 1 "True" /end COMPU_VTAB
/begin COMPU_METHOD DCPVCC_SC_Compu "" TAB_VERB "%6.3" "" COMPU_TAB_REF DCPVCC_SC_Compu /end COMPU_METHOD
/begin COMPU_VTAB DCPVCC_SC_Compu "" TAB_VERB 2 0 "False" 1 "True" /end COMPU_VTAB
/begin COMPU_METHOD DCPVDSSP_SC_Compu "" TAB_VERB "%6.3" "" COMPU_TAB_REF DCPVDSSP_SC_Compu /end COMPU_METHOD
/begin COMPU_VTAB DCPVDSSP_SC_Compu "" TAB_VERB 2 0 "False" 1 "True" /end COMPU_VTAB
/begin COMPU_METHOD DCPVPDY_SC_Compu "" TAB_VERB "%6.3" "" COMPU_TAB_REF DCPVPDY_SC_Compu /end COMPU_METHOD
/begin COMPU_VTAB DCPVPDY_SC_Compu "" TAB_VERB 2 0 "False" 1 "True" /end COMPU_VTAB
/begin COMPU_METHOD DCPVPS_SC_Compu "" TAB_VERB "%6.3" "" COMPU_TAB_REF DCPVPS_SC_Compu /end COMPU_METHOD
/begin COMPU_VTAB DCPVPS_SC_Compu "" TAB_VERB 2 0 "False" 1 "True" /end COMPU_VTAB
/begin COMPU_METHOD DCPVSELECTION_SC_Compu "" TAB_VERB "%6.3" "" COMPU_TAB_REF DCPVSELECTION_SC_Compu /end COMPU_METHOD
/begin COMPU_VTAB DCPVSELECTION_SC_Compu "" TAB_VERB 2 0 "False" 1 "True" /end COMPU_VTAB
/begin COMPU_METHOD DCSOVRDSAPPERR_SC_Compu "" TAB_VERB "%6.3" "" COMPU_TAB_REF DCSOVRDSAPPERR_SC_Compu /end COMPU_METHOD
/begin COMPU_VTAB DCSOVRDSAPPERR_SC_Compu "" TAB_VERB 2 0 "False" 1 "True" /end COMPU_VTAB
/begin COMPU_METHOD DCSOVRDSDFFTLPRT_SY_Compu "" TAB_VERB "%6.3" "" COMPU_TAB_REF DCSOVRDSDFFTLPRT_SY_Compu /end COMPU_METHOD
/begin COMPU_VTAB DCSOVRDSDFFTLPRT_SY_Compu "" TAB_VERB 2 0 "Differential protection has higher Priotity as DCS" 1 "DCS has higher Priotity as differential protection" /end COMPU_VTAB
/begin COMPU_METHOD DCSOVRDSTRAPRT_SY_Compu "" TAB_VERB "%6.3" "" COMPU_TAB_REF DCSOVRDSTRAPRT_SY_Compu /end COMPU_METHOD
/begin COMPU_VTAB DCSOVRDSTRAPRT_SY_Compu "" TAB_VERB 2 0 "FALSE" 1 "TRUE" /end COMPU_VTAB
/begin COMPU_METHOD DCSOVRDSTSCDEC_SY_Compu "" TAB_VERB "%6.3" "" COMPU_TAB_REF DCSOVRDSTSCDEC_SY_Compu /end COMPU_METHOD
/begin COMPU_VTAB DCSOVRDSTSCDEC_SY_Compu "" TAB_VERB 2 0 "FALSE" 1 "TRUE" /end COMPU_VTAB
/begin COMPU_METHOD DDRCOBSVRNRINTL_SC_Compu "" RAT_FUNC "%6.2" "" COEFFS 0 1 0 0 0 1 /end COMPU_METHOD
/begin COMPU_METHOD DDRCOBSVRNRREC_SC_Compu "" RAT_FUNC "%6.2" "" COEFFS 0 1 0 0 0 1 /end COMPU_METHOD
/begin COMPU_METHOD DDRC_DTRFRZINFHEALDEB_SY_Compu "" TAB_VERB "%6.3" "" COMPU_TAB_REF DDRC_DTRFRZINFHEALDEB_SY_Compu /end COMPU_METHOD
/begin COMPU_VTAB DDRC_DTRFRZINFHEALDEB_SY_Compu "" TAB_VERB 2 0 "False" 1 "True" /end COMPU_VTAB
/begin COMPU_METHOD DDRC_DTRUPDSUP_SY_Compu "" TAB_VERB "%6.3" "" COMPU_TAB_REF DDRC_DTRUPDSUP_SY_Compu /end COMPU_METHOD
/begin COMPU_VTAB DDRC_DTRUPDSUP_SY_Compu "" TAB_VERB 2 0 "False" 1 "True" /end COMPU_VTAB
/begin COMPU_METHOD DDYLSUSV06_SY_Compu "" TAB_VERB "%6.3" "" COMPU_TAB_REF DDYLSUSV06_SY_Compu /end COMPU_METHOD
/begin COMPU_VTAB DDYLSUSV06_SY_Compu "" TAB_VERB 2 0 "False" 1 "True" /end COMPU_VTAB
/begin COMPU_METHOD DECOMP_SY_Compu "" TAB_VERB "%6.3" "" COMPU_TAB_REF DECOMP_SY_Compu /end COMPU_METHOD
/begin COMPU_VTAB DECOMP_SY_Compu "" TAB_VERB 2 0 "no availibility of drag error compensation in ASDr" 1 "activiation of drag error compensation possible in" /end COMPU_VTAB
/begin COMPU_METHOD DEDIA_DBG_SC_Compu "" TAB_VERB "%6.3" "" COMPU_TAB_REF DEDIA_DBG_SC_Compu /end COMPU_METHOD
/begin COMPU_VTAB DEDIA_DBG_SC_Compu "" TAB_VERB 2 0 "0" 1 "1" /end COMPU_VTAB
/begin COMPU_METHOD DEDIA_VRNTCONF_SY_Compu "" TAB_VERB "%6.3" "" COMPU_TAB_REF DEDIA_VRNTCONF_SY_Compu /end COMPU_METHOD
/begin COMPU_VTAB DEDIA_VRNTCONF_SY_Compu "" TAB_VERB 3 0 "DEDIA_VRNTCONF_ALL" 1 "DEDIA_VRNTCONF_DS" 2 "DEDIA_VRNTCONF_GS" /end COMPU_VTAB
/begin COMPU_METHOD DELIB_DBG_SC_Compu "" RAT_FUNC "%6.2" "" COEFFS 0 1 0 0 0 1 /end COMPU_METHOD
/begin COMPU_METHOD DELIB_DYNSDLDEACTV_SC_Compu "" TAB_VERB "%6.3" "" COMPU_TAB_REF DELIB_DYNSDLDEACTV_SC_Compu /end COMPU_METHOD
/begin COMPU_VTAB DELIB_DYNSDLDEACTV_SC_Compu "" TAB_VERB 2 0 "False" 1 "True" /end COMPU_VTAB
/begin COMPU_METHOD DELIB_ELECACTRTYPAVL_SC_Compu "" TAB_VERB "%6.3" "" COMPU_TAB_REF DELIB_ELECACTRTYPAVL_SC_Compu /end COMPU_METHOD
/begin COMPU_VTAB DELIB_ELECACTRTYPAVL_SC_Compu "" TAB_VERB 2 0 "False" 1 "True" /end COMPU_VTAB
/begin COMPU_METHOD dez "" RAT_FUNC "%6.2" "" COEFFS 0 1 0 0 0 1 /end COMPU_METHOD
/begin COMPU_METHOD EngN "" RAT_FUNC "%6.3" "rpm" COEFFS 0 2 0 0 0 1 /end COMPU_METHOD
/begin COMPU_METHOD Fact_100 "" RAT_FUNC "%6.4" "-" COEFFS 0 100 0 0 0 1 /end COMPU_METHOD
/begin COMPU_METHOD fak_q0p0039 "" RAT_FUNC "%6.4" "-" COEFFS 0 256 0 0 0 1 /end COMPU_METHOD
/begin COMPU_METHOD fak_q0p00392 "" RAT_FUNC "%6.4" "-" COEFFS 0 255 0 0 0 1 /end COMPU_METHOD
/begin COMPU_METHOD fak_q1p526Em5 "" RAT_FUNC "%7.6" "-" COEFFS 0 65536 0 0 0 1 /end COMPU_METHOD
/begin COMPU_METHOD fak_ub_b1 "" RAT_FUNC "%6.4" "-" COEFFS 0 256 0 0 0 1 /end COMPU_METHOD
/begin COMPU_METHOD fak_ub_b2 "" RAT_FUNC "%8.5" "-" COEFFS 0 256 0 0 0 2 /end COMPU_METHOD
/begin COMPU_METHOD fak_ub_b5 "" RAT_FUNC "%6.4" "-" COEFFS 0 256 0 0 0 5 /end COMPU_METHOD
/begin COMPU_METHOD fak_uw_b1 "" RAT_FUNC "%7.6" "-" COEFFS 0 65536 0 0 0 1 /end COMPU_METHOD
/begin COMPU_METHOD fak_uw_b16 "" RAT_FUNC "%6.5" "-" COEFFS 0 65536 0 0 0 16 /end COMPU_METHOD
/begin COMPU_METHOD fak_uw_b2 "" RAT_FUNC "%7.6" "-" COEFFS 0 65536 0 0 0 2 /end COMPU_METHOD
/begin COMPU_METHOD fak_uw_b32 "" RAT_FUNC "%6.5" "-" COEFFS 0 65536 0 0 0 32 /end COMPU_METHOD
/begin COMPU_METHOD fak_uw_b8 "" RAT_FUNC "%6.5" "-" COEFFS 0 65536 0 0 0 8 /end COMPU_METHOD
/begin COMPU_METHOD kw_q6 "" RAT_FUNC "%6.2" "Grad KW" COEFFS 0 1 0 0 0 6 /end COMPU_METHOD
/begin COMPU_METHOD m_ub_b1020 "" RAT_FUNC "%6.2" "kg/h" COEFFS 0 1 0 0 0 4 /end COMPU_METHOD
/begin COMPU_METHOD m_ub_b23p3 "" RAT_FUNC "%6.3" "kg" COEFFS 0 2812.5 0 0 0 256 /end COMPU_METHOD
/begin COMPU_METHOD nmot_q0p25 "" RAT_FUNC "%6.3" "1/min" COEFFS 0 4 0 0 0 1 /end COMPU_METHOD
/begin COMPU_METHOD nmot_ub_q40 "" RAT_FUNC "%6.1" "1/min" COEFFS 0 1 0 0 0 40 /end COMPU_METHOD
/begin COMPU_METHOD OneToOne "" RAT_FUNC "%6.2" "-" COEFFS 0 1 0 0 0 1 /end COMPU_METHOD
/begin COMPU_METHOD Prc "" RAT_FUNC "%6.4" "%" COEFFS 0 81.92 0 0 0 1 /end COMPU_METHOD
/begin COMPU_METHOD Pres "" RAT_FUNC "%6.3" "kPa" COEFFS 0 10 0 0 0 1 /end COMPU_METHOD
/begin COMPU_METHOD Pres_hPa "" RAT_FUNC "%6.2" "hPa" COEFFS 0 1 0 0 0 1 /end COMPU_METHOD
/begin COMPU_METHOD Pres_kPa_VSA "" RAT_FUNC "%6.1" "kPa" COEFFS 0 0.0417362270450751 0 0 0 1 /end COMPU_METHOD
/begin COMPU_METHOD p_q0p078 "" RAT_FUNC "%6.4" "hPa" COEFFS 0 64 0 0 0 5 /end COMPU_METHOD
/begin COMPU_METHOD RBPtCel_m_0p001_1 "" RAT_FUNC "%6.5" "g" COEFFS 0 1000 0 0 0 1 /end COMPU_METHOD
/begin COMPU_METHOD rel_q0p0234 "" RAT_FUNC "%6.4" "%" COEFFS 0 128 0 0 0 3 /end COMPU_METHOD
/begin COMPU_METHOD rel_sw_q0p0234 "" RAT_FUNC "%6.4" "%/seg" COEFFS 0 32 0 0 0 0.75 /end COMPU_METHOD
/begin COMPU_METHOD rel_ub_q0p1875 "" RAT_FUNC "%6.3" "KW/ms" COEFFS 0 256 0 0 0 48 /end COMPU_METHOD
/begin COMPU_METHOD rel_uw_b100 "" RAT_FUNC "%6.4" "%" COEFFS 0 65536 0 0 0 100 /end COMPU_METHOD
/begin COMPU_METHOD SigQly_COMPU_VERB "" TAB_VERB "%6.3" "" COMPU_TAB_REF SigQly_COMPU_VERB /end COMPU_METHOD
/begin COMPU_VTAB SigQly_COMPU_VERB "" TAB_VERB 16 0 "SIGQLY_NOTCALC" 1 "SIGQLY_INIT" 2 "SIGQLY_OK" 3 "SIGQLY_MODEL" 4 "SIGQLY_REPLACEMENT" 5 "SIGQLY_FROZEN" 6 "SIGQLY_INVALID" 7 "SIGQLY_RESERVED_7" 8 "SIGQLY_RESERVED_8" 9 "SIGQLY_RESERVED_9" 10 "SIGQLY_RESERVED_10" 11 "SIGQLY_RESERVED_11" 12 "SIGQLY_RESERVED_12" 13 "SIGQLY_RESERVED_13" 14 "SIGQLY_RESERVED_14" 15 "SIGQLY_RESERVED_15" /end COMPU_VTAB
/begin COMPU_METHOD t10msxs_uw_b655p35 "" RAT_FUNC "%6.4" "s" COEFFS 0 1 0 0 0 0.01 /end COMPU_METHOD
/begin COMPU_METHOD t1p0usxms "" RAT_FUNC "%6.5" "ms" COEFFS 0 1000 0 0 0 1 /end COMPU_METHOD
/begin COMPU_METHOD TempDiff_Kelv "" RAT_FUNC "%6.3" "K" COEFFS 0 10 0 0 0 1 /end COMPU_METHOD
/begin COMPU_METHOD Temp_Cels "" RAT_FUNC "%6.1" "deg C" COEFFS 0 10 2731.4 0 0 1 /end COMPU_METHOD
/begin COMPU_METHOD temp_q0p01172 "" RAT_FUNC "%6.4" "K" COEFFS 0 65536 0 0 0 768 /end COMPU_METHOD
/begin COMPU_METHOD temp_q0p0234_o273 "" RAT_FUNC "%6.1" "Grad C" COEFFS 0 1 273.15 0 0 0.0234375 /end COMPU_METHOD
/begin COMPU_METHOD temp_q0p75_om48 "" RAT_FUNC "%6.2" "Grad C" COEFFS 0 4 192 0 0 3 /end COMPU_METHOD
/begin COMPU_METHOD temp_ub_q0p75_o48 "" RAT_FUNC "%6.2" "Grad C" COEFFS 0 1 48 0 0 0.75 /end COMPU_METHOD
/begin COMPU_METHOD temp_ub_q1_o40 "" RAT_FUNC "%6.2" "Grad C" COEFFS 0 1 40 0 0 1 /end COMPU_METHOD
/begin COMPU_METHOD temp_uw_q0p0029_o48 "" RAT_FUNC "%6.2" "Grad C" COEFFS 0 256 12288 0 0 0.75 /end COMPU_METHOD
/begin COMPU_METHOD TimeDeb "" RAT_FUNC "%6.1" "ms" COEFFS 0 0.1 0 0 0 1 /end COMPU_METHOD
/begin COMPU_METHOD TimeDelay_s "" RAT_FUNC "%6.1" "s" COEFFS 0 0 1 0 0.00023283064365387 0 /end COMPU_METHOD
/begin COMPU_METHOD Time_Dt "" RAT_FUNC "%9.8" "s" COEFFS 0 1000000 0 0 0 1 /end COMPU_METHOD
/begin COMPU_METHOD Time_ms "" RAT_FUNC "%6.1" "ms" COEFFS 0 0.1 0 0 0 1 /end COMPU_METHOD
/begin COMPU_METHOD Time_ms_20ms "" RAT_FUNC "%6.1" "ms" COEFFS 0 0.05 0 0 0 1 /end COMPU_METHOD
/begin COMPU_METHOD Time_s "" RAT_FUNC "%6.4" "s" COEFFS 0 100 0 0 0 1 /end COMPU_METHOD
/begin COMPU_METHOD Time_sec_q1_COMPU "" RAT_FUNC "%6.2" "s" COEFFS 0 1 0 0 0 1 /end COMPU_METHOD
/begin COMPU_METHOD TrqPerSec "" RAT_FUNC "%6.2" "Nm/s" COEFFS 0 1 0 0 0 1 /end COMPU_METHOD
/begin COMPU_METHOD T_degC_q0p1_COMPU "" RAT_FUNC "%6.3" "deg C" COEFFS 0 10 0 0 0 1 /end COMPU_METHOD
/begin COMPU_METHOD t_q0p001 "" RAT_FUNC "%6.5" "s" COEFFS 0 1000 0 0 0 1 /end COMPU_METHOD
/begin COMPU_METHOD t_q0p01 "" RAT_FUNC "%6.4" "s" COEFFS 0 100 0 0 0 1 /end COMPU_METHOD
/begin COMPU_METHOD t_q0p1 "" RAT_FUNC "%6.3" "s" COEFFS 0 10 0 0 0 1 /end COMPU_METHOD
/begin COMPU_METHOD t_q1 "" RAT_FUNC "%6.2" "s" COEFFS 0 1 0 0 0 1 /end COMPU_METHOD
/begin COMPU_METHOD Vel "" RAT_FUNC "%6.4" "km/h" COEFFS 0 100 0 0 0 1 /end COMPU_METHOD
/begin COMPU_METHOD Volt "" RAT_FUNC "%6.3" "mV" COEFFS 0 5 0 0 0 1 /end COMPU_METHOD
/begin COMPU_METHOD Volt_q1 "" RAT_FUNC "%6.2" "V" COEFFS 0 1 0 0 0 1 /end COMPU_METHOD
/begin COMPU_METHOD zk100msxs_uw_b6553 "" RAT_FUNC "%6.1" "s" COEFFS 0 0 65536 0 10 0 /end COMPU_METHOD
/begin COMPU_METHOD zk10msxs_uw_b655p36 "" RAT_FUNC "%6.2" "s" COEFFS 0 0 65536 0 100 0 /end COMPU_METHOD
/begin COMPU_METHOD zk1msxs_uw_b65p536 "" RAT_FUNC "%6.3" "s" COEFFS 0 0 65536 0 1000 0 /end COMPU_METHOD
/begin COMPU_METHOD zw_q2p9297Em3_deg_KW "" RAT_FUNC "%6.4" "deg KW" COEFFS 0 1024 0 0 0 3 /end COMPU_METHOD
/begin COMPU_METHOD zw_ub_q6 "" RAT_FUNC "%6.2" "Grad KW" COEFFS 0 255 0 0 0 1530 /end COMPU_METHOD
/begin COMPU_METHOD defaultAscii "" RAT_FUNC "%6.2" "" COEFFS 0 1 0 0 0 1 /end COMPU_METHOD
/begin RECORD_LAYOUT Kw_Ws16 FNC_VALUES 1 SWORD COLUMN_DIR DIRECT /end RECORD_LAYOUT
/begin RECORD_LAYOUT RB_Curve_S16_S16 NO_AXIS_PTS_X 1 SWORD AXIS_PTS_X 2 SWORD INDEX_INCR DIRECT FNC_VALUES 3 SWORD COLUMN_DIR DIRECT /end RECORD_LAYOUT
/begin RECORD_LAYOUT RB_Curve_S16_U16_Static NO_AXIS_PTS_X 1 SWORD AXIS_PTS_X 2 SWORD INDEX_INCR DIRECT FNC_VALUES 3 UWORD COLUMN_DIR DIRECT STATIC_RECORD_LAYOUT /end RECORD_LAYOUT
/begin RECORD_LAYOUT RB_Curve_S16_U8_Static NO_AXIS_PTS_X 1 SWORD AXIS_PTS_X 2 SWORD INDEX_INCR DIRECT FNC_VALUES 3 UBYTE COLUMN_DIR DIRECT STATIC_RECORD_LAYOUT /end RECORD_LAYOUT
/begin RECORD_LAYOUT RB_Curve_U16_S16_Static NO_AXIS_PTS_X 1 UWORD AXIS_PTS_X 2 UWORD INDEX_INCR DIRECT FNC_VALUES 3 SWORD COLUMN_DIR DIRECT STATIC_RECORD_LAYOUT /end RECORD_LAYOUT
/begin RECORD_LAYOUT RB_Curve_U16_U16 NO_AXIS_PTS_X 1 UWORD AXIS_PTS_X 2 UWORD INDEX_INCR DIRECT FNC_VALUES 3 UWORD COLUMN_DIR DIRECT /end RECORD_LAYOUT
/begin RECORD_LAYOUT RB_Curve_U16_U8_Static NO_AXIS_PTS_X 1 UWORD AXIS_PTS_X 2 UWORD INDEX_INCR DIRECT FNC_VALUES 3 UBYTE COLUMN_DIR DIRECT STATIC_RECORD_LAYOUT /end RECORD_LAYOUT
/begin RECORD_LAYOUT RB_Map_S16S16_S16 NO_AXIS_PTS_X 1 SWORD NO_AXIS_PTS_Y 2 SWORD AXIS_PTS_X 3 SWORD INDEX_INCR DIRECT AXIS_PTS_Y 4 SWORD INDEX_INCR DIRECT FNC_VALUES 5 SWORD COLUMN_DIR DIRECT /end RECORD_LAYOUT
/begin RECORD_LAYOUT RB_Map_S16S16_U16 NO_AXIS_PTS_X 1 SWORD NO_AXIS_PTS_Y 2 SWORD AXIS_PTS_X 3 SWORD INDEX_INCR DIRECT AXIS_PTS_Y 4 SWORD INDEX_INCR DIRECT FNC_VALUES 5 UWORD COLUMN_DIR DIRECT /end RECORD_LAYOUT
/begin RECORD_LAYOUT RB_Map_S16S16_U8 NO_AXIS_PTS_X 1 SWORD NO_AXIS_PTS_Y 2 SWORD AXIS_PTS_X 3 SWORD INDEX_INCR DIRECT AXIS_PTS_Y 4 SWORD INDEX_INCR DIRECT FNC_VALUES 5 UBYTE COLUMN_DIR DIRECT /end RECORD_LAYOUT
/begin RECORD_LAYOUT RB_Map_S16U16_U16 NO_AXIS_PTS_X 1 SWORD NO_AXIS_PTS_Y 2 SWORD AXIS_PTS_X 3 SWORD INDEX_INCR DIRECT AXIS_PTS_Y 4 UWORD INDEX_INCR DIRECT FNC_VALUES 5 UWORD ROW_DIR DIRECT /end RECORD_LAYOUT
/begin RECORD_LAYOUT RB_Map_U16S16_U16 NO_AXIS_PTS_X 1 UWORD NO_AXIS_PTS_Y 2 UWORD AXIS_PTS_X 3 UWORD INDEX_INCR DIRECT AXIS_PTS_Y 4 SWORD INDEX_INCR DIRECT FNC_VALUES 5 UWORD COLUMN_DIR DIRECT /end RECORD_LAYOUT
/begin RECORD_LAYOUT RB_Map_U8S16_S8 NO_AXIS_PTS_X 1 UBYTE NO_AXIS_PTS_Y 2 UBYTE AXIS_PTS_X 3 UBYTE INDEX_INCR DIRECT AXIS_PTS_Y 4 SWORD INDEX_INCR DIRECT FNC_VALUES 5 SBYTE ROW_DIR DIRECT /end RECORD_LAYOUT
/begin RECORD_LAYOUT RB_Map_U8S16_U16 NO_AXIS_PTS_X 1 UBYTE NO_AXIS_PTS_Y 2 UBYTE AXIS_PTS_X 3 UBYTE INDEX_INCR DIRECT AXIS_PTS_Y 4 SWORD INDEX_INCR DIRECT FNC_VALUES 5 UWORD ROW_DIR DIRECT /end RECORD_LAYOUT
/begin RECORD_LAYOUT RB_Map_U8U8_U8 NO_AXIS_PTS_X 1 UBYTE NO_AXIS_PTS_Y 2 UBYTE AXIS_PTS_X 3 UBYTE INDEX_INCR DIRECT AXIS_PTS_Y 4 UBYTE INDEX_INCR DIRECT FNC_VALUES 5 UBYTE COLUMN_DIR DIRECT /end RECORD_LAYOUT
/begin RECORD_LAYOUT RB_Val_Ws16 FNC_VALUES 1 SWORD COLUMN_DIR DIRECT /end RECORD_LAYOUT
/begin RECORD_LAYOUT RB_Val_Ws32 FNC_VALUES 1 SLONG COLUMN_DIR DIRECT /end RECORD_LAYOUT
/begin RECORD_LAYOUT RB_Val_Ws8 FNC_VALUES 1 SBYTE COLUMN_DIR DIRECT /end RECORD_LAYOUT
/begin RECORD_LAYOUT RB_Val_Wu16 FNC_VALUES 1 UWORD COLUMN_DIR DIRECT /end RECORD_LAYOUT
/begin RECORD_LAYOUT RB_Val_Wu32 FNC_VALUES 1 ULONG COLUMN_DIR DIRECT /end RECORD_LAYOUT
/begin RECORD_LAYOUT RB_Val_Wu8 FNC_VALUES 1 UBYTE COLUMN_DIR DIRECT /end RECORD_LAYOUT
/begin RECORD_LAYOUT ValA_Wu8 FNC_VALUES 1 UBYTE COLUMN_DIR DIRECT /end RECORD_LAYOUT
/begin RECORD_LAYOUT Val_Ws16 FNC_VALUES 1 SWORD COLUMN_DIR DIRECT /end RECORD_LAYOUT
/begin RECORD_LAYOUT Val_Wu16 FNC_VALUES 1 UWORD COLUMN_DIR DIRECT /end RECORD_LAYOUT
/begin RECORD_LAYOUT Val_Wu8 FNC_VALUES 1 UBYTE COLUMN_DIR DIRECT /end RECORD_LAYOUT
/end MODULE
/end PROJECT
