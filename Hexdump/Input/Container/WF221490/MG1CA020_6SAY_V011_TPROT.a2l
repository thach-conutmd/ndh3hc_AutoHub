ASAP2_VERSION 1 60
/begin PROJECT MG1CA020 "MG1CA020"
/begin HEADER "" VERSION "MG1CA020_6SAY_V011_TPROT" PROJECT_NO MG1CA020 /end HEADER
/begin MODULE DIM ""
/begin MOD_COMMON "" BYTE_ORDER MSB_LAST ALIGNMENT_BYTE 1 ALIGNMENT_WORD 2 ALIGNMENT_LONG 4 ALIGNMENT_INT64 4 ALIGNMENT_FLOAT32_IEEE 4 ALIGNMENT_FLOAT64_IEEE 4 DATA_SIZE 32 /end MOD_COMMON
/begin CHARACTERISTIC CWDKRSA "code word: kc-diagnosis signal evaluation" VALUE 0x8051BEEA RB_Val_Wu8 255.0 dez 0.00 255.0 FORMAT "%5.1" /end CHARACTERISTIC
/begin CHARACTERISTIC CWDKS "code word knock sensor diagnosis" VALUE 0x8051BE8E RB_Val_Wu8 255.0 dez 0.00 255.0 FORMAT "%5.1" /end CHARACTERISTIC
/begin CHARACTERISTIC CWDLLR "Codeword for DLLR configuration" VALUE 0x8051BF1A RB_Val_Wu8 255.0 dez 0.00 255.0 FORMAT "%5.1" /end CHARACTERISTIC
/begin CHARACTERISTIC CWDLLR2 "Codeword for DLLR configuration" VALUE 0x8051BF1B RB_Val_Wu8 255.0 dez 0.00 255.0 FORMAT "%5.1" /end CHARACTERISTIC
/begin CHARACTERISTIC DDPSRPSINI "Delta Intakemanifold pressure to ambient pressure during start" VALUE 0x8051C0DE RB_Val_Wu16 5119.922 p_q0p078 0.00 5119.922 FORMAT "%8.3" /end CHARACTERISTIC
/begin CHARACTERISTIC DFRAESTAB "Delta-FRA for setting of ""FRA-stable"" when diagnosis-threshold is reached" VALUE 0x8051BEF0 RB_Val_Wu16 1.999969 fak_uw_b2 0.00 1.999969 FORMAT "%8.6" /end CHARACTERISTIC
/begin CHARACTERISTIC DFRASTAB "delta-FRA for setting of ""FRA stable""" VALUE 0x8051BEF2 RB_Val_Wu16 1.999969 fak_uw_b2 0.00 1.999969 FORMAT "%8.6" /end CHARACTERISTIC
/begin CHARACTERISTIC DFRMSTAB "Delta of filtered lambda correction for setting of ""FRM stable""" VALUE 0x8051BEF4 RB_Val_Wu16 1.999969 fak_uw_b2 0.00 1.999969 FORMAT "%8.6" /end CHARACTERISTIC
/begin CHARACTERISTIC DINH_Lim.DSQ_GbxPosNotPN_CA "inhibit conditions / inhibit limit conditions for inhibit source DSQ_GbxPosNotPN" VAL_BLK 0x804F8D6B ValA_Wu8 16.0000000000 DINH_LimDSQVerb 0.00 16.0000000000 FORMAT "%13.10" NUMBER 51 /end CHARACTERISTIC
/begin CHARACTERISTIC DINH_Lim.DSQ_MRly_CA "inhibit conditions / inhibit limit conditions for inhibit source DSQ_MRly" VAL_BLK 0x804F8D9E ValA_Wu8 16.0000000000 DINH_LimDSQVerb 0.00 16.0000000000 FORMAT "%13.10" NUMBER 50 /end CHARACTERISTIC
/begin CHARACTERISTIC DINH_Lim.DSQ_PEnvMeasVld_CA "inhibit conditions / inhibit limit conditions for inhibit source DSQ_PEnvMeasVld" VAL_BLK 0x804F8DD0 ValA_Wu8 16.0000000000 DINH_LimDSQVerb 0.00 16.0000000000 FORMAT "%13.10" NUMBER 52 /end CHARACTERISTIC
/begin CHARACTERISTIC DINH_Lim.DSQ_PEnvVld_CA "inhibit conditions / inhibit limit conditions for inhibit source DSQ_PEnvVld" VAL_BLK 0x804F8E04 ValA_Wu8 16.0000000000 DINH_LimDSQVerb 0.00 16.0000000000 FORMAT "%13.10" NUMBER 52 /end CHARACTERISTIC
/begin CHARACTERISTIC DINH_Lim.DSQ_PEnv_pRaw_CA "inhibit conditions / inhibit limit conditions for inhibit source DSQ_PEnv_pRaw" VAL_BLK 0x804F8E38 ValA_Wu8 16.0000000000 DINH_LimDSQVerb 0.00 16.0000000000 FORMAT "%13.10" NUMBER 51 /end CHARACTERISTIC
/begin CHARACTERISTIC DINH_Lim.DSQ_PThrVlvUs_CA "inhibit conditions / inhibit limit conditions for inhibit source DSQ_PThrVlvUs" VAL_BLK 0x804F8E6B ValA_Wu8 16.0000000000 DINH_LimDSQVerb 0.00 16.0000000000 FORMAT "%13.10" NUMBER 50 /end CHARACTERISTIC
/begin CHARACTERISTIC DINH_Lim.DSQ_PThrVlvUsB1_CA "inhibit conditions / inhibit limit conditions for inhibit source DSQ_PThrVlvUsB1" VAL_BLK 0x804F8E9D ValA_Wu8 16.0000000000 DINH_LimDSQVerb 0.00 16.0000000000 FORMAT "%13.10" NUMBER 50 /end CHARACTERISTIC
/begin CHARACTERISTIC DINH_Lim.DSQ_StrtImobChk_CA "inhibit conditions / inhibit limit conditions for inhibit source DSQ_StrtImobChk" VAL_BLK 0x804F8ECF ValA_Wu8 16.0000000000 DINH_LimDSQVerb 0.00 16.0000000000 FORMAT "%13.10" NUMBER 50 /end CHARACTERISTIC
/begin CHARACTERISTIC DINH_Lim.DSQ_TDevCenColdStrt_CA "inhibit conditions / inhibit limit conditions for inhibit source DSQ_TDevCenColdStrt" VAL_BLK 0x804F8F01 ValA_Wu8 16.0000000000 DINH_LimDSQVerb 0.00 16.0000000000 FORMAT "%13.10" NUMBER 52 /end CHARACTERISTIC
/begin CHARACTERISTIC DINH_Lim.DSQ_UEGOHeatrPwrOKS1B1_CA "inhibit conditions / inhibit limit conditions for inhibit source DSQ_UEGOHeatrPwrOKS1B1" VAL_BLK 0x804F8F35 ValA_Wu8 16.0000000000 DINH_LimDSQVerb 0.00 16.0000000000 FORMAT "%13.10" NUMBER 50 /end CHARACTERISTIC
/begin CHARACTERISTIC DINH_Lim.DSQ_UEGOIPmpS1B1_CA "inhibit conditions / inhibit limit conditions for inhibit source DSQ_UEGOIPmpS1B1" VAL_BLK 0x804F8F67 ValA_Wu8 16.0000000000 DINH_LimDSQVerb 0.00 16.0000000000 FORMAT "%13.10" NUMBER 57 /end CHARACTERISTIC
/begin CHARACTERISTIC DINH_Lim.DSQ_UEGOLamS1B1_CA "inhibit conditions / inhibit limit conditions for inhibit source DSQ_UEGOLamS1B1" VAL_BLK 0x804F8FA0 ValA_Wu8 16.0000000000 DINH_LimDSQVerb 0.00 16.0000000000 FORMAT "%13.10" NUMBER 52 /end CHARACTERISTIC
/begin CHARACTERISTIC DINH_Lim.DSQ_UEGOTCtrlS1B1_CA "inhibit conditions / inhibit limit conditions for inhibit source DSQ_UEGOTCtrlS1B1" VAL_BLK 0x804F8FD4 ValA_Wu8 16.0000000000 DINH_LimDSQVerb 0.00 16.0000000000 FORMAT "%13.10" NUMBER 61 /end CHARACTERISTIC
/begin CHARACTERISTIC DINH_Lim.DSQ_VehV_CA "inhibit conditions / inhibit limit conditions for inhibit source DSQ_VehV" VAL_BLK 0x804F9011 ValA_Wu8 16.0000000000 DINH_LimDSQVerb 0.00 16.0000000000 FORMAT "%13.10" NUMBER 55 /end CHARACTERISTIC
/begin CHARACTERISTIC DINH_Lim.DSQ_VehVSnsr_CA "inhibit conditions / inhibit limit conditions for inhibit source DSQ_VehVSnsr" VAL_BLK 0x804F9048 ValA_Wu8 16.0000000000 DINH_LimDSQVerb 0.00 16.0000000000 FORMAT "%13.10" NUMBER 62 /end CHARACTERISTIC
/begin CHARACTERISTIC DINH_Lim.DSQ_stAPP_CA "inhibit conditions / inhibit limit conditions for inhibit source DSQ_stAPP" VAL_BLK 0x804F9086 ValA_Wu8 16.0000000000 DINH_LimDSQVerb 0.00 16.0000000000 FORMAT "%13.10" NUMBER 58 /end CHARACTERISTIC
/begin CHARACTERISTIC DINH_Lim.DSQ_stComEAT4_CA "inhibit conditions / inhibit limit conditions for inhibit source DSQ_stComEAT4" VAL_BLK 0x804F90C0 ValA_Wu8 16.0000000000 DINH_LimDSQVerb 0.00 16.0000000000 FORMAT "%13.10" NUMBER 50 /end CHARACTERISTIC
/begin CHARACTERISTIC DINH_tiUpdObsv_C "Paging interval time of FId observer" VALUE 0x804F9884 Val_Wu16 326.6000 Time_s 1.0000 327.6000 FORMAT "%8.4" EXTENDED_LIMITS 0.00 655.3500 /end CHARACTERISTIC
/begin CHARACTERISTIC DINH_xFIDObsv_C "Function identifier to scan by FId observer" VALUE 0x804F9886 Val_Wu16 732.000000000 DINH_FIdVerb 0.00 732.000000000 FORMAT "%13.9" /end CHARACTERISTIC
/begin CHARACTERISTIC DIUMPR_ctGen.l500MDInc_C "criterias to count general denominator and ignition cycle counter / Number of increments of the internal odometer to reach a interval of 10 km" VALUE 0x804EE18C Val_Ws16 65535.00 OneToOne -32768.00 32767.00 FORMAT "%8.2" READ_ONLY /end CHARACTERISTIC
/begin CHARACTERISTIC DIUMPR_ctGen.l500MD_C "criterias to count general denominator and ignition cycle counter / minimal driven distance to release special 500 miles denominator" VALUE 0x804EE18E Val_Wu8 1260. DIUMPR_l10km 0.00 1260. FORMAT "%5.0" EXTENDED_LIMITS 0.00 2550. READ_ONLY /end CHARACTERISTIC
/begin CHARACTERISTIC DIUMPR_ctGen.pEnvMin_C "criterias to count general denominator and ignition cycle counter / maximum elevation (represented by minimum air pressure)" VALUE 0x804EE190 Val_Ws16 65535.00 Pres_hPa -32768.00 32767.00 FORMAT "%8.2" /end CHARACTERISTIC
/begin CHARACTERISTIC DIUMPR_ctGen.rAPPMax_C "criterias to count general denominator and ignition cycle counter / maximum accelerator pedal position for idle detection" VALUE 0x804EE192 Val_Ws16 799.9878 Prc -400.0000 399.9878 FORMAT "%8.4" /end CHARACTERISTIC
/begin CHARACTERISTIC DIUMPR_ctGen.tEnvMin_C "criterias to count general denominator and ignition cycle counter / mimimum ambient temperatur" VALUE 0x804EE194 Val_Ws16 6553.500 Temp_Cels -3549.940 3003.560 FORMAT "%8.3" /end CHARACTERISTIC
/begin CHARACTERISTIC DIUMPR_ctGen.tiActrMin_C "criterias to count general denominator and ignition cycle counter / minimum activation time of a component to increment denominator" VALUE 0x804EE196 Val_Wu8 25.50 DIUMPR_ti100ms 0.00 25.50 FORMAT "%5.2" /end CHARACTERISTIC
/begin CHARACTERISTIC DIUMPR_ctGen.tiFuEngOpMin_C "criterias to count general denominator and ignition cycle counter / Minimal time for fueled engine firm(operation)" VALUE 0x804EE198 Val_Wu16 6553.500 DIUMPR_ti100ms 0.00 6553.500 FORMAT "%8.3" READ_ONLY /end CHARACTERISTIC
/begin CHARACTERISTIC DIUMPR_ctGen.tiIdlMin_C "criterias to count general denominator and ignition cycle counter / minimum operation time in idle state" VALUE 0x804EE19A Val_Wu16 6553.500 DIUMPR_ti100ms 0.00 6553.500 FORMAT "%8.3" /end CHARACTERISTIC
/begin CHARACTERISTIC DIUMPR_ctGen.tiIgnCycMin_C "criterias to count general denominator and ignition cycle counter / Minimum TIme limit for increment of Ignition cycle counter" VALUE 0x804EE19C Val_Wu8 25.50 DIUMPR_ti100ms 0.00 25.50 FORMAT "%5.2" READ_ONLY /end CHARACTERISTIC
/begin CHARACTERISTIC DIUMPR_ctGen.tiIgnMin_C "criterias to count general denominator and ignition cycle counter / Minimum Fueled Engine Operation Time for the Fueled Engine Ignition Cycle counter" VALUE 0x804EE19D Val_Wu8 25.50 DIUMPR_ti100ms 0.00 25.50 FORMAT "%5.2" READ_ONLY /end CHARACTERISTIC
/begin CHARACTERISTIC DIUMPR_ctGen.tiOpMin_C "criterias to count general denominator and ignition cycle counter / minimum operation time" VALUE 0x804EE19E Val_Wu16 6553.500 DIUMPR_ti100ms 0.00 6553.500 FORMAT "%8.3" /end CHARACTERISTIC
/begin CHARACTERISTIC DIUMPR_ctGen.tiSigContActv_C "criterias to count general denominator and ignition cycle counter / minimum energising time twice required for a component to increment the denominator" VALUE 0x804EE1A0 Val_Wu8 3.000 DIUMPR_ti100ms 0.00 3.000 FORMAT "%5.3" EXTENDED_LIMITS 0.00 25.50 /end CHARACTERISTIC
/begin CHARACTERISTIC DIUMPR_ctGen.tiVehSpdMin_C "criterias to count general denominator and ignition cycle counter / minimum operation time about 25 miles per hour" VALUE 0x804EE1A2 Val_Wu16 6553.500 DIUMPR_ti100ms 0.00 6553.500 FORMAT "%8.3" /end CHARACTERISTIC
/begin CHARACTERISTIC DIUMPR_ctGen.vVehIdlMax_C "criterias to count general denominator and ignition cycle counter / maximim vehicle speed for idle detection" VALUE 0x804EE1A4 Val_Ws16 655.3500 Vel -327.6800 327.6700 FORMAT "%8.4" /end CHARACTERISTIC
/begin CHARACTERISTIC DIUMPR_ctGen.vVehMin_C "criterias to count general denominator and ignition cycle counter / minimum vehicle speed" VALUE 0x804EE1A6 Val_Ws16 655.3500 Vel -327.6800 327.6700 FORMAT "%8.4" /end CHARACTERISTIC
/begin CHARACTERISTIC DIUMPR_Ctl.FID_BLLRH_C "IUPR control byte / control byte for in-use performance monitoring of FID_BLLRH" VALUE 0x804EE1A8 Val_Wu8 255.0 OneToOne 0.00 255.0 FORMAT "%5.1" READ_ONLY /end CHARACTERISTIC
/begin CHARACTERISTIC DIUMPR_Ctl.FID_BLLRKH_C "IUPR control byte / control byte for in-use performance monitoring of FID_BLLRKH" VALUE 0x804EE1A9 Val_Wu8 255.0 OneToOne 0.00 255.0 FORMAT "%5.1" READ_ONLY /end CHARACTERISTIC
/begin CHARACTERISTIC DIUMPR_Ctl.FID_BPLSU_C "IUPR control byte / control byte for in-use performance monitoring of FID_BPLSU" VALUE 0x804EE1AA Val_Wu8 255.0 OneToOne 0.00 255.0 FORMAT "%5.1" READ_ONLY /end CHARACTERISTIC
/begin CHARACTERISTIC DIUMPR_Ctl.FId_EGSDO2SnsrMntdRelsS1B1_C "IUPR control byte / control byte for in-use performance monitoring of FId_EGSDO2SnsrMntdRelsS1B1" VALUE 0x804EE1AB Val_Wu8 255.0 OneToOne 0.00 255.0 FORMAT "%5.1" READ_ONLY /end CHARACTERISTIC
/begin CHARACTERISTIC DIUMPR_Ctl.FID_CETKHL_C "IUPR control byte / control byte for in-use performance monitoring of FID_CETKHL" VALUE 0x804EE1AC Val_Wu8 255.0 OneToOne 0.00 255.0 FORMAT "%5.1" READ_ONLY /end CHARACTERISTIC
/begin CHARACTERISTIC DIUMPR_Ctl.FID_CETKHT_C "IUPR control byte / control byte for in-use performance monitoring of FID_CETKHT" VALUE 0x804EE1AD Val_Wu8 255.0 OneToOne 0.00 255.0 FORMAT "%5.1" READ_ONLY /end CHARACTERISTIC
/begin CHARACTERISTIC DIUMPR_Ctl.FID_CGLSRDP_C "IUPR control byte / control byte for in-use performance monitoring of FID_CGLSRDP" VALUE 0x804EE1AE Val_Wu8 255.0 OneToOne 0.00 255.0 FORMAT "%5.1" READ_ONLY /end CHARACTERISTIC
/begin CHARACTERISTIC DIUMPR_Ctl.FID_CLZSRDP_C "IUPR control byte / control byte for in-use performance monitoring of FID_CLZSRDP" VALUE 0x804EE1AF Val_Wu8 255.0 OneToOne 0.00 255.0 FORMAT "%5.1" READ_ONLY /end CHARACTERISTIC
/begin CHARACTERISTIC DIUMPR_Ctl.FID_CPSRP_C "IUPR control byte / control byte for in-use performance monitoring of FID_CPSRP" VALUE 0x804EE1B0 Val_Wu8 255.0 OneToOne 0.00 255.0 FORMAT "%5.1" READ_ONLY /end CHARACTERISTIC
/begin CHARACTERISTIC DIUMPR_Ctl.FId_CEngDsTColdStrt_C "IUPR control byte / control byte for in-use performance monitoring of FId_CEngDsTColdStrt" VALUE 0x804EE1B1 Val_Wu8 255.0 OneToOne 0.00 255.0 FORMAT "%5.1" READ_ONLY /end CHARACTERISTIC
/begin CHARACTERISTIC DIUMPR_Ctl.FId_CEngDsTLSC_C "IUPR control byte / control byte for in-use performance monitoring of FId_CEngDsTLSC" VALUE 0x804EE1B2 Val_Wu8 255.0 OneToOne 0.00 255.0 FORMAT "%5.1" READ_ONLY /end CHARACTERISTIC
/begin CHARACTERISTIC DIUMPR_Ctl.FId_CEngDsTSTC_C "IUPR control byte / control byte for in-use performance monitoring of FId_CEngDsTSTC" VALUE 0x804EE1B3 Val_Wu8 255.0 OneToOne 0.00 255.0 FORMAT "%5.1" READ_ONLY /end CHARACTERISTIC
/begin CHARACTERISTIC DIUMPR_Ctl.FId_Cj135PerdDiagOperEnaS1B1_C "IUPR control byte / control byte for in-use performance monitoring of FId_Cj135PerdDiagOperEnaS1B1" VALUE 0x804EE1B4 Val_Wu8 255.0 OneToOne 0.00 255.0 FORMAT "%5.1" READ_ONLY /end CHARACTERISTIC
/begin CHARACTERISTIC DIUMPR_Ctl.FId_EGSDUS2B1LtrDly_C "IUPR control byte / control byte for in-use performance monitoring of FId_EGSDUS2B1LtrDly" VALUE 0x804EE1B5 Val_Wu8 255.0 OneToOne 0.00 255.0 FORMAT "%5.1" READ_ONLY /end CHARACTERISTIC
/begin CHARACTERISTIC DIUMPR_Ctl.FId_EGSDUS2B1LtrPT1_C "IUPR control byte / control byte for in-use performance monitoring of FId_EGSDUS2B1LtrPT1" VALUE 0x804EE1B6 Val_Wu8 255.0 OneToOne 0.00 255.0 FORMAT "%5.1" READ_ONLY /end CHARACTERISTIC
/begin CHARACTERISTIC DIUMPR_Ctl.FId_EGSDUS2B1RtlDly_C "IUPR control byte / control byte for in-use performance monitoring of FId_EGSDUS2B1RtlDly" VALUE 0x804EE1B7 Val_Wu8 255.0 OneToOne 0.00 255.0 FORMAT "%5.1" READ_ONLY /end CHARACTERISTIC
/begin CHARACTERISTIC DIUMPR_Ctl.FId_EGSDUS2B1RtlPT1_C "IUPR control byte / control byte for in-use performance monitoring of FId_EGSDUS2B1RtlPT1" VALUE 0x804EE1B8 Val_Wu8 255.0 OneToOne 0.00 255.0 FORMAT "%5.1" READ_ONLY /end CHARACTERISTIC
/begin CHARACTERISTIC DIUMPR_Ctl.FId_EGSDUS2B1TarLean_C "IUPR control byte / control byte for in-use performance monitoring of FId_EGSDUS2B1TarLean" VALUE 0x804EE1B9 Val_Wu8 255.0 OneToOne 0.00 255.0 FORMAT "%5.1" READ_ONLY /end CHARACTERISTIC
/begin CHARACTERISTIC DIUMPR_Ctl.FId_EGSDUS2B1TarRich_C "IUPR control byte / control byte for in-use performance monitoring of FId_EGSDUS2B1TarRich" VALUE 0x804EE1BA Val_Wu8 255.0 OneToOne 0.00 255.0 FORMAT "%5.1" READ_ONLY /end CHARACTERISTIC
/begin CHARACTERISTIC DIUMPR_Ctl.FId_EtaEngIdleNonCsers_C "IUPR control byte / control byte for in-use performance monitoring of FId_EtaEngIdleNonCsers" VALUE 0x804EE1BB Val_Wu8 255.0 OneToOne 0.00 255.0 FORMAT "%5.1" READ_ONLY /end CHARACTERISTIC
/begin CHARACTERISTIC DIUMPR_Ctl.FId_EtaEngPtlNonCsers_C "IUPR control byte / control byte for in-use performance monitoring of FId_EtaEngPtlNonCsers" VALUE 0x804EE1BC Val_Wu8 255.0 OneToOne 0.00 255.0 FORMAT "%5.1" READ_ONLY /end CHARACTERISTIC
/begin CHARACTERISTIC DIUMPR_Ctl.FId_HEGOS2B1DHtg_C "IUPR control byte / control byte for in-use performance monitoring of FId_HEGOS2B1DHtg" VALUE 0x804EE1BD Val_Wu8 255.0 OneToOne 0.00 255.0 FORMAT "%5.1" READ_ONLY /end CHARACTERISTIC
/begin CHARACTERISTIC DIUMPR_Ctl.FId_InhbLamDynS1B1_C "IUPR control byte / control byte for in-use performance monitoring of FId_InhbLamDynS1B1" VALUE 0x804EE1BE Val_Wu8 255.0 OneToOne 0.00 255.0 FORMAT "%5.1" READ_ONLY /end CHARACTERISTIC
/begin CHARACTERISTIC DIUMPR_Ctl.FId_IntkAirTIntkMnfldCrssChk_C "IUPR control byte / control byte for in-use performance monitoring of FId_IntkAirTIntkMnfldCrssChk" VALUE 0x804EE1BF Val_Wu8 255.0 OneToOne 0.00 255.0 FORMAT "%5.1" READ_ONLY /end CHARACTERISTIC
/begin CHARACTERISTIC DIUMPR_Ctl.FId_IntkAirTIntkMnfldPlausChk_C "IUPR control byte / control byte for in-use performance monitoring of FId_IntkAirTIntkMnfldPlausChk" VALUE 0x804EE1C0 Val_Wu8 255.0 OneToOne 0.00 255.0 FORMAT "%5.1" READ_ONLY /end CHARACTERISTIC
/begin CHARACTERISTIC DIUMPR_Ctl.FId_PEnvPlausDiagVDD_C "IUPR control byte / control byte for in-use performance monitoring of FId_PEnvPlausDiagVDD" VALUE 0x804EE1C1 Val_Wu8 255.0 OneToOne 0.00 255.0 FORMAT "%5.1" READ_ONLY /end CHARACTERISTIC
/begin CHARACTERISTIC DIUMPR_Ctl.FId_P_VSE11_Diag_C "IUPR control byte / control byte for in-use performance monitoring of FId_P_VSE11_Diag" VALUE 0x804EE1C2 Val_Wu8 255.0 OneToOne 0.00 255.0 FORMAT "%5.1" READ_ONLY /end CHARACTERISTIC
/begin CHARACTERISTIC DIUMPR_Ctl.FId_TWCDPriCatParB1_C "IUPR control byte / control byte for in-use performance monitoring of FId_TWCDPriCatParB1" VALUE 0x804EE1C3 Val_Wu8 255.0 OneToOne 0.00 255.0 FORMAT "%5.1" READ_ONLY /end CHARACTERISTIC
/begin CHARACTERISTIC DIUMPR_Ctl.FId_TiOffTBasdChkFast_C "IUPR control byte / control byte for in-use performance monitoring of FId_TiOffTBasdChkFast" VALUE 0x804EE1C4 Val_Wu8 255.0 OneToOne 0.00 255.0 FORMAT "%5.1" READ_ONLY /end CHARACTERISTIC
/begin CHARACTERISTIC DIUMPR_Ctl.FId_TiOffTBasdChkSlow_C "IUPR control byte / control byte for in-use performance monitoring of FId_TiOffTBasdChkSlow" VALUE 0x804EE1C5 Val_Wu8 255.0 OneToOne 0.00 255.0 FORMAT "%5.1" READ_ONLY /end CHARACTERISTIC
/begin CHARACTERISTIC DIUMPR_Ctl.FId_UEGOPrmntDiagS1B1_C "IUPR control byte / control byte for in-use performance monitoring of FId_UEGOPrmntDiagS1B1" VALUE 0x804EE1C6 Val_Wu8 255.0 OneToOne 0.00 255.0 FORMAT "%5.1" READ_ONLY /end CHARACTERISTIC
/begin CHARACTERISTIC DIUMPR_Ctl.FId_VlvLftFbSwtIntk11Diag_C "IUPR control byte / control byte for in-use performance monitoring of FId_VlvLftFbSwtIntk11Diag" VALUE 0x804EE1C7 Val_Wu8 255.0 OneToOne 0.00 255.0 FORMAT "%5.1" READ_ONLY /end CHARACTERISTIC
/begin CHARACTERISTIC DIUMPR_DFC.FID_BLLRH_C "IUMPR related DFC / assigned fault check for in-use performance monitoring of FID_BLLRH" VALUE 0x804EE1C8 Val_Wu16 703.000000000 DFC_Verb 0.00 703.000000000 FORMAT "%13.9" /end CHARACTERISTIC
/begin CHARACTERISTIC DIUMPR_DFC.FID_BLLRKH_C "IUMPR related DFC / assigned fault check for in-use performance monitoring of FID_BLLRKH" VALUE 0x804EE1CA Val_Wu16 703.000000000 DFC_Verb 0.00 703.000000000 FORMAT "%13.9" /end CHARACTERISTIC
/begin CHARACTERISTIC DIUMPR_DFC.FID_BPLSU_C "IUMPR related DFC / assigned fault check for in-use performance monitoring of FID_BPLSU" VALUE 0x804EE1CC Val_Wu16 703.000000000 DFC_Verb 0.00 703.000000000 FORMAT "%13.9" /end CHARACTERISTIC
/begin CHARACTERISTIC DIUMPR_DFC.FId_EGSDO2SnsrMntdRelsS1B1_C "IUMPR related DFC / assigned fault check for in-use performance monitoring of FId_EGSDO2SnsrMntdRelsS1B1" VALUE 0x804EE1CE Val_Wu16 703.000000000 DFC_Verb 0.00 703.000000000 FORMAT "%13.9" /end CHARACTERISTIC
/begin CHARACTERISTIC DIUMPR_DFC.FID_CETKHL_C "IUMPR related DFC / assigned fault check for in-use performance monitoring of FID_CETKHL" VALUE 0x804EE1D0 Val_Wu16 703.000000000 DFC_Verb 0.00 703.000000000 FORMAT "%13.9" /end CHARACTERISTIC
/begin CHARACTERISTIC DIUMPR_DFC.FID_CETKHT_C "IUMPR related DFC / assigned fault check for in-use performance monitoring of FID_CETKHT" VALUE 0x804EE1D2 Val_Wu16 703.000000000 DFC_Verb 0.00 703.000000000 FORMAT "%13.9" /end CHARACTERISTIC
/begin CHARACTERISTIC DIUMPR_DFC.FID_CGLSRDP_C "IUMPR related DFC / assigned fault check for in-use performance monitoring of FID_CGLSRDP" VALUE 0x804EE1D4 Val_Wu16 703.000000000 DFC_Verb 0.00 703.000000000 FORMAT "%13.9" /end CHARACTERISTIC
/begin CHARACTERISTIC DIUMPR_DFC.FID_CLZSRDP_C "IUMPR related DFC / assigned fault check for in-use performance monitoring of FID_CLZSRDP" VALUE 0x804EE1D6 Val_Wu16 703.000000000 DFC_Verb 0.00 703.000000000 FORMAT "%13.9" /end CHARACTERISTIC
/begin CHARACTERISTIC DIUMPR_DFC.FID_CPSRP_C "IUMPR related DFC / assigned fault check for in-use performance monitoring of FID_CPSRP" VALUE 0x804EE1D8 Val_Wu16 703.000000000 DFC_Verb 0.00 703.000000000 FORMAT "%13.9" /end CHARACTERISTIC
/begin CHARACTERISTIC DIUMPR_DFC.FId_CEngDsTColdStrt_C "IUMPR related DFC / assigned fault check for in-use performance monitoring of FId_CEngDsTColdStrt" VALUE 0x804EE1DA Val_Wu16 703.000000000 DFC_Verb 0.00 703.000000000 FORMAT "%13.9" /end CHARACTERISTIC
/begin CHARACTERISTIC DIUMPR_DFC.FId_CEngDsTLSC_C "IUMPR related DFC / assigned fault check for in-use performance monitoring of FId_CEngDsTLSC" VALUE 0x804EE1DC Val_Wu16 703.000000000 DFC_Verb 0.00 703.000000000 FORMAT "%13.9" /end CHARACTERISTIC
/begin CHARACTERISTIC DIUMPR_DFC.FId_CEngDsTSTC_C "IUMPR related DFC / assigned fault check for in-use performance monitoring of FId_CEngDsTSTC" VALUE 0x804EE1DE Val_Wu16 703.000000000 DFC_Verb 0.00 703.000000000 FORMAT "%13.9" /end CHARACTERISTIC
/begin CHARACTERISTIC DIUMPR_DFC.FId_Cj135PerdDiagOperEnaS1B1_C "IUMPR related DFC / assigned fault check for in-use performance monitoring of FId_Cj135PerdDiagOperEnaS1B1" VALUE 0x804EE1E0 Val_Wu16 703.000000000 DFC_Verb 0.00 703.000000000 FORMAT "%13.9" /end CHARACTERISTIC
/begin CHARACTERISTIC DIUMPR_DFC.FId_EGSDUS2B1LtrDly_C "IUMPR related DFC / assigned fault check for in-use performance monitoring of FId_EGSDUS2B1LtrDly" VALUE 0x804EE1E2 Val_Wu16 703.000000000 DFC_Verb 0.00 703.000000000 FORMAT "%13.9" /end CHARACTERISTIC
/begin CHARACTERISTIC DIUMPR_DFC.FId_EGSDUS2B1LtrPT1_C "IUMPR related DFC / assigned fault check for in-use performance monitoring of FId_EGSDUS2B1LtrPT1" VALUE 0x804EE1E4 Val_Wu16 703.000000000 DFC_Verb 0.00 703.000000000 FORMAT "%13.9" /end CHARACTERISTIC
/begin CHARACTERISTIC DIUMPR_DFC.FId_EGSDUS2B1RtlDly_C "IUMPR related DFC / assigned fault check for in-use performance monitoring of FId_EGSDUS2B1RtlDly" VALUE 0x804EE1E6 Val_Wu16 703.000000000 DFC_Verb 0.00 703.000000000 FORMAT "%13.9" /end CHARACTERISTIC
/begin CHARACTERISTIC DIUMPR_DFC.FId_EGSDUS2B1RtlPT1_C "IUMPR related DFC / assigned fault check for in-use performance monitoring of FId_EGSDUS2B1RtlPT1" VALUE 0x804EE1E8 Val_Wu16 703.000000000 DFC_Verb 0.00 703.000000000 FORMAT "%13.9" /end CHARACTERISTIC
/begin CHARACTERISTIC DIUMPR_DFC.FId_EGSDUS2B1TarLean_C "IUMPR related DFC / assigned fault check for in-use performance monitoring of FId_EGSDUS2B1TarLean" VALUE 0x804EE1EA Val_Wu16 703.000000000 DFC_Verb 0.00 703.000000000 FORMAT "%13.9" /end CHARACTERISTIC
/begin CHARACTERISTIC DIUMPR_DFC.FId_EGSDUS2B1TarRich_C "IUMPR related DFC / assigned fault check for in-use performance monitoring of FId_EGSDUS2B1TarRich" VALUE 0x804EE1EC Val_Wu16 703.000000000 DFC_Verb 0.00 703.000000000 FORMAT "%13.9" /end CHARACTERISTIC
/begin CHARACTERISTIC DIUMPR_DFC.FId_EtaEngIdleNonCsers_C "IUMPR related DFC / assigned fault check for in-use performance monitoring of FId_EtaEngIdleNonCsers" VALUE 0x804EE1EE Val_Wu16 703.000000000 DFC_Verb 0.00 703.000000000 FORMAT "%13.9" /end CHARACTERISTIC
/begin CHARACTERISTIC DIUMPR_DFC.FId_EtaEngPtlNonCsers_C "IUMPR related DFC / assigned fault check for in-use performance monitoring of FId_EtaEngPtlNonCsers" VALUE 0x804EE1F0 Val_Wu16 703.000000000 DFC_Verb 0.00 703.000000000 FORMAT "%13.9" /end CHARACTERISTIC
/begin CHARACTERISTIC DIUMPR_DFC.FId_HEGOS2B1DHtg_C "IUMPR related DFC / assigned fault check for in-use performance monitoring of FId_HEGOS2B1DHtg" VALUE 0x804EE1F2 Val_Wu16 703.000000000 DFC_Verb 0.00 703.000000000 FORMAT "%13.9" /end CHARACTERISTIC
/begin CHARACTERISTIC DIUMPR_DFC.FId_InhbLamDynS1B1_C "IUMPR related DFC / assigned fault check for in-use performance monitoring of FId_InhbLamDynS1B1" VALUE 0x804EE1F4 Val_Wu16 703.000000000 DFC_Verb 0.00 703.000000000 FORMAT "%13.9" /end CHARACTERISTIC
/begin CHARACTERISTIC DIUMPR_DFC.FId_IntkAirTIntkMnfldCrssChk_C "IUMPR related DFC / assigned fault check for in-use performance monitoring of FId_IntkAirTIntkMnfldCrssChk" VALUE 0x804EE1F6 Val_Wu16 703.000000000 DFC_Verb 0.00 703.000000000 FORMAT "%13.9" /end CHARACTERISTIC
/begin CHARACTERISTIC DIUMPR_DFC.FId_IntkAirTIntkMnfldPlausChk_C "IUMPR related DFC / assigned fault check for in-use performance monitoring of FId_IntkAirTIntkMnfldPlausChk" VALUE 0x804EE1F8 Val_Wu16 703.000000000 DFC_Verb 0.00 703.000000000 FORMAT "%13.9" /end CHARACTERISTIC
/begin CHARACTERISTIC DIUMPR_DFC.FId_PEnvPlausDiagVDD_C "IUMPR related DFC / assigned fault check for in-use performance monitoring of FId_PEnvPlausDiagVDD" VALUE 0x804EE1FA Val_Wu16 703.000000000 DFC_Verb 0.00 703.000000000 FORMAT "%13.9" /end CHARACTERISTIC
/begin CHARACTERISTIC DIUMPR_DFC.FId_P_VSE11_Diag_C "IUMPR related DFC / assigned fault check for in-use performance monitoring of FId_P_VSE11_Diag" VALUE 0x804EE1FC Val_Wu16 703.000000000 DFC_Verb 0.00 703.000000000 FORMAT "%13.9" /end CHARACTERISTIC
/begin CHARACTERISTIC DIUMPR_DFC.FId_TWCDPriCatParB1_C "IUMPR related DFC / assigned fault check for in-use performance monitoring of FId_TWCDPriCatParB1" VALUE 0x804EE1FE Val_Wu16 703.000000000 DFC_Verb 0.00 703.000000000 FORMAT "%13.9" /end CHARACTERISTIC
/begin CHARACTERISTIC DIUMPR_DFC.FId_TiOffTBasdChkFast_C "IUMPR related DFC / assigned fault check for in-use performance monitoring of FId_TiOffTBasdChkFast" VALUE 0x804EE200 Val_Wu16 703.000000000 DFC_Verb 0.00 703.000000000 FORMAT "%13.9" /end CHARACTERISTIC
/begin CHARACTERISTIC DIUMPR_DFC.FId_TiOffTBasdChkSlow_C "IUMPR related DFC / assigned fault check for in-use performance monitoring of FId_TiOffTBasdChkSlow" VALUE 0x804EE202 Val_Wu16 703.000000000 DFC_Verb 0.00 703.000000000 FORMAT "%13.9" /end CHARACTERISTIC
/begin CHARACTERISTIC DIUMPR_DFC.FId_UEGOPrmntDiagS1B1_C "IUMPR related DFC / assigned fault check for in-use performance monitoring of FId_UEGOPrmntDiagS1B1" VALUE 0x804EE204 Val_Wu16 703.000000000 DFC_Verb 0.00 703.000000000 FORMAT "%13.9" /end CHARACTERISTIC
/begin CHARACTERISTIC DIUMPR_DFC.FId_VlvLftFbSwtIntk11Diag_C "IUMPR related DFC / assigned fault check for in-use performance monitoring of FId_VlvLftFbSwtIntk11Diag" VALUE 0x804EE206 Val_Wu16 703.000000000 DFC_Verb 0.00 703.000000000 FORMAT "%13.9" /end CHARACTERISTIC
/begin CHARACTERISTIC DIUMPR_Grp.FID_BLLRH_C "IUPR group / component group for in-use performance monitoring of FID_BLLRH" VALUE 0x804EE208 Val_Wu8 10.0000000000 DIUMPR_GroupVerb 0.00 10.0000000000 FORMAT "%13.10" /end CHARACTERISTIC
/begin CHARACTERISTIC DIUMPR_Grp.FID_BLLRKH_C "IUPR group / component group for in-use performance monitoring of FID_BLLRKH" VALUE 0x804EE209 Val_Wu8 10.0000000000 DIUMPR_GroupVerb 0.00 10.0000000000 FORMAT "%13.10" /end CHARACTERISTIC
/begin CHARACTERISTIC DIUMPR_Grp.FID_BPLSU_C "IUPR group / component group for in-use performance monitoring of FID_BPLSU" VALUE 0x804EE20A Val_Wu8 10.0000000000 DIUMPR_GroupVerb 0.00 10.0000000000 FORMAT "%13.10" /end CHARACTERISTIC
/begin CHARACTERISTIC DIUMPR_Grp.FId_EGSDO2SnsrMntdRelsS1B1_C "IUPR group / component group for in-use performance monitoring of FId_EGSDO2SnsrMntdRelsS1B1" VALUE 0x804EE20B Val_Wu8 10.0000000000 DIUMPR_GroupVerb 0.00 10.0000000000 FORMAT "%13.10" /end CHARACTERISTIC
/begin CHARACTERISTIC DIUMPR_Grp.FID_CETKHL_C "IUPR group / component group for in-use performance monitoring of FID_CETKHL" VALUE 0x804EE20C Val_Wu8 10.0000000000 DIUMPR_GroupVerb 0.00 10.0000000000 FORMAT "%13.10" /end CHARACTERISTIC
/begin CHARACTERISTIC DIUMPR_Grp.FID_CETKHT_C "IUPR group / component group for in-use performance monitoring of FID_CETKHT" VALUE 0x804EE20D Val_Wu8 10.0000000000 DIUMPR_GroupVerb 0.00 10.0000000000 FORMAT "%13.10" /end CHARACTERISTIC
/begin CHARACTERISTIC DIUMPR_Grp.FID_CGLSRDP_C "IUPR group / component group for in-use performance monitoring of FID_CGLSRDP" VALUE 0x804EE20E Val_Wu8 10.0000000000 DIUMPR_GroupVerb 0.00 10.0000000000 FORMAT "%13.10" /end CHARACTERISTIC
/begin CHARACTERISTIC DIUMPR_Grp.FID_CLZSRDP_C "IUPR group / component group for in-use performance monitoring of FID_CLZSRDP" VALUE 0x804EE20F Val_Wu8 10.0000000000 DIUMPR_GroupVerb 0.00 10.0000000000 FORMAT "%13.10" /end CHARACTERISTIC
/begin CHARACTERISTIC DIUMPR_Grp.FID_CPSRP_C "IUPR group / component group for in-use performance monitoring of FID_CPSRP" VALUE 0x804EE210 Val_Wu8 10.0000000000 DIUMPR_GroupVerb 0.00 10.0000000000 FORMAT "%13.10" /end CHARACTERISTIC
/begin CHARACTERISTIC DIUMPR_Grp.FId_CEngDsTColdStrt_C "IUPR group / component group for in-use performance monitoring of FId_CEngDsTColdStrt" VALUE 0x804EE211 Val_Wu8 10.0000000000 DIUMPR_GroupVerb 0.00 10.0000000000 FORMAT "%13.10" /end CHARACTERISTIC
/begin CHARACTERISTIC DIUMPR_Grp.FId_CEngDsTLSC_C "IUPR group / component group for in-use performance monitoring of FId_CEngDsTLSC" VALUE 0x804EE212 Val_Wu8 10.0000000000 DIUMPR_GroupVerb 0.00 10.0000000000 FORMAT "%13.10" /end CHARACTERISTIC
/begin CHARACTERISTIC DIUMPR_Grp.FId_CEngDsTSTC_C "IUPR group / component group for in-use performance monitoring of FId_CEngDsTSTC" VALUE 0x804EE213 Val_Wu8 10.0000000000 DIUMPR_GroupVerb 0.00 10.0000000000 FORMAT "%13.10" /end CHARACTERISTIC
/begin CHARACTERISTIC DIUMPR_Grp.FId_Cj135PerdDiagOperEnaS1B1_C "IUPR group / component group for in-use performance monitoring of FId_Cj135PerdDiagOperEnaS1B1" VALUE 0x804EE214 Val_Wu8 10.0000000000 DIUMPR_GroupVerb 0.00 10.0000000000 FORMAT "%13.10" /end CHARACTERISTIC
/begin CHARACTERISTIC DIUMPR_Grp.FId_EGSDUS2B1LtrDly_C "IUPR group / component group for in-use performance monitoring of FId_EGSDUS2B1LtrDly" VALUE 0x804EE215 Val_Wu8 10.0000000000 DIUMPR_GroupVerb 0.00 10.0000000000 FORMAT "%13.10" /end CHARACTERISTIC
/begin CHARACTERISTIC DIUMPR_Grp.FId_EGSDUS2B1LtrPT1_C "IUPR group / component group for in-use performance monitoring of FId_EGSDUS2B1LtrPT1" VALUE 0x804EE216 Val_Wu8 10.0000000000 DIUMPR_GroupVerb 0.00 10.0000000000 FORMAT "%13.10" /end CHARACTERISTIC
/begin CHARACTERISTIC DIUMPR_Grp.FId_EGSDUS2B1RtlDly_C "IUPR group / component group for in-use performance monitoring of FId_EGSDUS2B1RtlDly" VALUE 0x804EE217 Val_Wu8 10.0000000000 DIUMPR_GroupVerb 0.00 10.0000000000 FORMAT "%13.10" /end CHARACTERISTIC
/begin CHARACTERISTIC DIUMPR_Grp.FId_EGSDUS2B1RtlPT1_C "IUPR group / component group for in-use performance monitoring of FId_EGSDUS2B1RtlPT1" VALUE 0x804EE218 Val_Wu8 10.0000000000 DIUMPR_GroupVerb 0.00 10.0000000000 FORMAT "%13.10" /end CHARACTERISTIC
/begin CHARACTERISTIC DIUMPR_Grp.FId_EGSDUS2B1TarLean_C "IUPR group / component group for in-use performance monitoring of FId_EGSDUS2B1TarLean" VALUE 0x804EE219 Val_Wu8 10.0000000000 DIUMPR_GroupVerb 0.00 10.0000000000 FORMAT "%13.10" /end CHARACTERISTIC
/begin CHARACTERISTIC DIUMPR_Grp.FId_EGSDUS2B1TarRich_C "IUPR group / component group for in-use performance monitoring of FId_EGSDUS2B1TarRich" VALUE 0x804EE21A Val_Wu8 10.0000000000 DIUMPR_GroupVerb 0.00 10.0000000000 FORMAT "%13.10" /end CHARACTERISTIC
/begin CHARACTERISTIC DIUMPR_Grp.FId_EtaEngIdleNonCsers_C "IUPR group / component group for in-use performance monitoring of FId_EtaEngIdleNonCsers" VALUE 0x804EE21B Val_Wu8 10.0000000000 DIUMPR_GroupVerb 0.00 10.0000000000 FORMAT "%13.10" /end CHARACTERISTIC
/begin CHARACTERISTIC DIUMPR_Grp.FId_EtaEngPtlNonCsers_C "IUPR group / component group for in-use performance monitoring of FId_EtaEngPtlNonCsers" VALUE 0x804EE21C Val_Wu8 10.0000000000 DIUMPR_GroupVerb 0.00 10.0000000000 FORMAT "%13.10" /end CHARACTERISTIC
/begin CHARACTERISTIC DIUMPR_Grp.FId_HEGOS2B1DHtg_C "IUPR group / component group for in-use performance monitoring of FId_HEGOS2B1DHtg" VALUE 0x804EE21D Val_Wu8 10.0000000000 DIUMPR_GroupVerb 0.00 10.0000000000 FORMAT "%13.10" /end CHARACTERISTIC
/begin CHARACTERISTIC DIUMPR_Grp.FId_InhbLamDynS1B1_C "IUPR group / component group for in-use performance monitoring of FId_InhbLamDynS1B1" VALUE 0x804EE21E Val_Wu8 10.0000000000 DIUMPR_GroupVerb 0.00 10.0000000000 FORMAT "%13.10" /end CHARACTERISTIC
/begin CHARACTERISTIC DIUMPR_Grp.FId_IntkAirTIntkMnfldCrssChk_C "IUPR group / component group for in-use performance monitoring of FId_IntkAirTIntkMnfldCrssChk" VALUE 0x804EE21F Val_Wu8 10.0000000000 DIUMPR_GroupVerb 0.00 10.0000000000 FORMAT "%13.10" /end CHARACTERISTIC
/begin CHARACTERISTIC DIUMPR_Grp.FId_IntkAirTIntkMnfldPlausChk_C "IUPR group / component group for in-use performance monitoring of FId_IntkAirTIntkMnfldPlausChk" VALUE 0x804EE220 Val_Wu8 10.0000000000 DIUMPR_GroupVerb 0.00 10.0000000000 FORMAT "%13.10" /end CHARACTERISTIC
/begin CHARACTERISTIC DIUMPR_Grp.FId_PEnvPlausDiagVDD_C "IUPR group / component group for in-use performance monitoring of FId_PEnvPlausDiagVDD" VALUE 0x804EE221 Val_Wu8 10.0000000000 DIUMPR_GroupVerb 0.00 10.0000000000 FORMAT "%13.10" /end CHARACTERISTIC
/begin CHARACTERISTIC DIUMPR_Grp.FId_P_VSE11_Diag_C "IUPR group / component group for in-use performance monitoring of FId_P_VSE11_Diag" VALUE 0x804EE222 Val_Wu8 10.0000000000 DIUMPR_GroupVerb 0.00 10.0000000000 FORMAT "%13.10" /end CHARACTERISTIC
/begin CHARACTERISTIC DIUMPR_Grp.FId_TWCDPriCatParB1_C "IUPR group / component group for in-use performance monitoring of FId_TWCDPriCatParB1" VALUE 0x804EE223 Val_Wu8 10.0000000000 DIUMPR_GroupVerb 0.00 10.0000000000 FORMAT "%13.10" /end CHARACTERISTIC
/begin CHARACTERISTIC DIUMPR_Grp.FId_TiOffTBasdChkFast_C "IUPR group / component group for in-use performance monitoring of FId_TiOffTBasdChkFast" VALUE 0x804EE224 Val_Wu8 10.0000000000 DIUMPR_GroupVerb 0.00 10.0000000000 FORMAT "%13.10" /end CHARACTERISTIC
/begin CHARACTERISTIC DIUMPR_Grp.FId_TiOffTBasdChkSlow_C "IUPR group / component group for in-use performance monitoring of FId_TiOffTBasdChkSlow" VALUE 0x804EE225 Val_Wu8 10.0000000000 DIUMPR_GroupVerb 0.00 10.0000000000 FORMAT "%13.10" /end CHARACTERISTIC
/begin CHARACTERISTIC DIUMPR_Grp.FId_UEGOPrmntDiagS1B1_C "IUPR group / component group for in-use performance monitoring of FId_UEGOPrmntDiagS1B1" VALUE 0x804EE226 Val_Wu8 10.0000000000 DIUMPR_GroupVerb 0.00 10.0000000000 FORMAT "%13.10" /end CHARACTERISTIC
/begin CHARACTERISTIC DIUMPR_Grp.FId_VlvLftFbSwtIntk11Diag_C "IUPR group / component group for in-use performance monitoring of FId_VlvLftFbSwtIntk11Diag" VALUE 0x804EE227 Val_Wu8 10.0000000000 DIUMPR_GroupVerb 0.00 10.0000000000 FORMAT "%13.10" /end CHARACTERISTIC
/begin CHARACTERISTIC DIUMPR_tCldStrtDenCldStrtOfs_C "maximum difference between engine and ambient air temperature for coldstart detection at ColdStart Denominator" VALUE 0x804EE228 Val_Ws16 6553.500 Temp_Cels -3549.940 3003.560 FORMAT "%8.3" READ_ONLY /end CHARACTERISTIC
/begin CHARACTERISTIC DIUMPR_tCldStrtDenECTMax_C "maximum engine temperature for coldstart detection at ColdStart Denominator" VALUE 0x804EE22A Val_Ws16 6553.500 Temp_Cels -3549.940 3003.560 FORMAT "%8.3" READ_ONLY /end CHARACTERISTIC
/begin CHARACTERISTIC DIUMPR_tiCldStrtDenEngStrtDelay_C "Time period after engine start to delay the cold start evaluation at ColdStart Denominator" VALUE 0x804EE22C Val_Wu16 30.00000 DIUMPR_ti100ms 0.00 30.00000 FORMAT "%8.5" EXTENDED_LIMITS 0.00 6553.500 /end CHARACTERISTIC
/begin CHARACTERISTIC DIUMPR_xSelTstrNumrInctLock_C "Numerator increment behavior when tester is connected. If set to LOCK, the numerator will not increment. If set to NO_LOCK the numerator will be incremented." VALUE 0x8053A798 Val_Wu8 1.00000000000 DIUMPR_xSelTstrNumrInctLock_C_Verbal 0.00 1.00000000000 FORMAT "%13.11" /end CHARACTERISTIC
/begin CHARACTERISTIC DKRSAM "threshold for number of errors knock control evaluation measuring window" VALUE 0x8051BEEC RB_Val_Wu16 65535.00 dez 0.00 65535.00 FORMAT "%8.2" /end CHARACTERISTIC
/begin CHARACTERISTIC DKRSAS "threshold for number of errors knock control evaluation combustion" VALUE 0x8051BEEE RB_Val_Wu16 65535.00 dez 0.00 65535.00 FORMAT "%8.2" /end CHARACTERISTIC
/begin CHARACTERISTIC DLLR_nDiagTestOfs_C "idle speed offset for the test off the idle speed diagnosis" VALUE 0x8051BF1C RB_Val_Ws16 32767.50 nmot_sw_q0p5 -16384.00 16383.50 FORMAT "%8.2" /end CHARACTERISTIC
/begin CHARACTERISTIC DLLR_nDifActvnCSERS_C "threshold for the idle speed setpoint spread to activate the CSERS diagnosis" VALUE 0x8051BF1E RB_Val_Ws16 32767.50 nmot_sw_q0p5 -16384.00 16383.50 FORMAT "%8.2" /end CHARACTERISTIC
/begin CHARACTERISTIC DLLR_nMnErrThdCatHeatgDrv_GT "Maximal speed deviation for detection of low speed during catalyst heating (driving state)" CURVE 0x8051BF20 RB_CurveGroup_S8 1270. nmot_sb_q10 0.00 1270. FORMAT "%5.0" EXTENDED_LIMITS -1280. 1270.
 /begin AXIS_DESCR COM_AXIS CEngDsT_t Temp_Cels 8 -3549.940 3003.560 FORMAT "%8.3" AXIS_PTS_REF DLLR_tEng_Ax /end AXIS_DESCR
/end CHARACTERISTIC
/begin CHARACTERISTIC DLLR_nMnErrThdCatHeatg_GT "Maximal speed deviation for detection of low speed during catalyst heating" CURVE 0x8051BF28 RB_CurveGroup_S8 1270. nmot_sb_q10 0.00 1270. FORMAT "%5.0" EXTENDED_LIMITS -1280. 1270.
 /begin AXIS_DESCR COM_AXIS CEngDsT_t Temp_Cels 8 -3549.940 3003.560 FORMAT "%8.3" AXIS_PTS_REF DLLR_tEng_Ax /end AXIS_DESCR
/end CHARACTERISTIC
/begin CHARACTERISTIC DLLR_nMxErrThdCatHeatgDrv_GT "Maximal speed deviation for detection of high speed during catalyst heating (driving state)" CURVE 0x8051BF30 RB_CurveGroup_S8 1280. nmot_sb_q10 -1280. 0.00 FORMAT "%5.0" EXTENDED_LIMITS -1280. 1270.
 /begin AXIS_DESCR COM_AXIS CEngDsT_t Temp_Cels 8 -3549.940 3003.560 FORMAT "%8.3" AXIS_PTS_REF DLLR_tEng_Ax /end AXIS_DESCR
/end CHARACTERISTIC
/begin CHARACTERISTIC DLLR_nMxErrThdCatHeatg_GT "Maximal speed deviation for detection of high speed during catalyst heating" CURVE 0x8051BF38 RB_CurveGroup_S8 1280. nmot_sb_q10 -1280. 0.00 FORMAT "%5.0" EXTENDED_LIMITS -1280. 1270.
 /begin AXIS_DESCR COM_AXIS CEngDsT_t Temp_Cels 8 -3549.940 3003.560 FORMAT "%8.3" AXIS_PTS_REF DLLR_tEng_Ax /end AXIS_DESCR
/end CHARACTERISTIC
/begin CHARACTERISTIC DLLR_stDiagTest_CW "switch to activate improvments for the function test" VALUE 0x8051BF40 RB_Val_Wu8 255.0 OneToOne 0.00 255.0 FORMAT "%5.1" /end CHARACTERISTIC
/begin AXIS_PTS DLLR_tEng_Ax "group axis points engine temperature" 0x8051BF42 CEngDsT_t RB_Axis_S16 6553.500 Temp_Cels 8 -3549.940 3003.560 FORMAT "%8.3" DEPOSIT ABSOLUTE /end AXIS_PTS
/begin CHARACTERISTIC DNDLLRO "Maximal speed deviation (low speed) for diagnosis of idle speed control" VALUE 0x8051BF54 RB_Val_Ws8 1270. nmot_sb_q10 0.00 1270. FORMAT "%5.0" EXTENDED_LIMITS -1280. 1270. /end CHARACTERISTIC
/begin CHARACTERISTIC DNDLLROKH "Maximal speed deviation (low speed) for diagnosis of idle speed control during catalyst heating" VALUE 0x8051BF55 RB_Val_Ws8 1270. nmot_sb_q10 0.00 1270. FORMAT "%5.0" EXTENDED_LIMITS -1280. 1270. /end CHARACTERISTIC
/begin CHARACTERISTIC DNDLLRU "Maximal speed deviation (high speed) for diagnosis of idle speed control" VALUE 0x8051BF56 RB_Val_Ws8 1280. nmot_sb_q10 -1280. 0.00 FORMAT "%5.0" EXTENDED_LIMITS -1280. 1270. /end CHARACTERISTIC
/begin CHARACTERISTIC DNDLLRUKH "Maximal speed deviation (high speed) for diagnosis of idle speed control during catalyst heating" VALUE 0x8051BF57 RB_Val_Ws8 1280. nmot_sb_q10 -1280. 0.00 FORMAT "%5.0" EXTENDED_LIMITS -1280. 1270. /end CHARACTERISTIC
/begin CHARACTERISTIC DOGov_dtrqDttme_C "deadtime/gradient time constant" VALUE 0x8051BF92 RB_Val_Wu8 4.000 dez 1.000 5.000 FORMAT "%5.3" EXTENDED_LIMITS 0.00 255.0 /end CHARACTERISTIC
/begin CHARACTERISTIC DOGov_dtrqThres_CUR "deadtimegradient threshold for detection drive off" CURVE 0x8051BF94 RB_Curve_S16_S16 6553.500 md_sw_q0p1 -3276.800 3276.700 FORMAT "%8.3"
 /begin AXIS_DESCR STD_AXIS DOGov_trqClth md_sw_q0p1 4 -3276.800 3276.700 FORMAT "%8.3" DEPOSIT ABSOLUTE /end AXIS_DESCR
/end CHARACTERISTIC
/begin CHARACTERISTIC DOGov_facFdbk_C "Feedback gain model speed deviation drive-off" VALUE 0x8051BFA6 RB_Val_Wu8 1.000 q0p025_Nm_DIV_rpm 0.00 1.000 FORMAT "%5.3" EXTENDED_LIMITS 0.00 6.375 /end CHARACTERISTIC
/begin CHARACTERISTIC DOGov_facOvrSpd_C "Factor against overspeed" VALUE 0x8051BFA7 RB_Val_Wu8 0.9961 fak_ub_b1 0.00 0.9961 /end CHARACTERISTIC
/begin CHARACTERISTIC DOGov_facRmpOff_GCUR "Factor for ramping at end of intervention" CURVE 0x8051BFA8 RB_CurveGroup_U8 0.9961 fak_ub_b1 0.00 0.9961
 /begin AXIS_DESCR COM_AXIS APP_r Prc 3 -400.0000 399.9878 FORMAT "%8.4" AXIS_PTS_REF DOGov_rAPP_DST /end AXIS_DESCR
/end CHARACTERISTIC
/begin CHARACTERISTIC DoGov_facTqLead_M "Driveoff governor torque correction factor for lead path" MAP 0x8051BFAC RB_Map_S16S16_S16 4.000000 Fact4 0.00 4.000000 FORMAT "%8.6" EXTENDED_LIMITS -1638.400 1638.350
 /begin AXIS_DESCR STD_AXIS DOGov_nDiff EngN 5 -16384.00 16383.50 FORMAT "%8.2" DEPOSIT ABSOLUTE /end AXIS_DESCR
 /begin AXIS_DESCR STD_AXIS DOGov_dnEngFltLoc nmotg_sw_q0p39 5 -12800.16 12799.77 FORMAT "%8.2" DEPOSIT ABSOLUTE /end AXIS_DESCR
/end CHARACTERISTIC
/begin CHARACTERISTIC DOGov_facTqSet_M "Driveoff governor torque correction factor for set path" MAP 0x8051BFF6 RB_Map_S16S16_S16 4.000000 Fact4 0.00 4.000000 FORMAT "%8.6" EXTENDED_LIMITS -1638.400 1638.350
 /begin AXIS_DESCR STD_AXIS DOGov_nDifSyncn EngN 5 -16384.00 16383.50 FORMAT "%8.2" DEPOSIT ABSOLUTE /end AXIS_DESCR
 /begin AXIS_DESCR STD_AXIS DOGov_dnEngFltLocSyncn nmotg_sw_q0p39 5 -12800.16 12799.77 FORMAT "%8.2" DEPOSIT ABSOLUTE /end AXIS_DESCR
/end CHARACTERISTIC
/begin CHARACTERISTIC DOGov_flgSwtNGrdt_C "flag for filtered engine speed gradient selection switch" VALUE 0x8051C040 RB_Val_Wboolean 1.00000000000 B_TRUE 0.00 1.00000000000 FORMAT "%13.11" /end CHARACTERISTIC
/begin CHARACTERISTIC DOGov_KClthPos_C "Filter constant of Clutch position average" VALUE 0x8051C042 RB_Val_Wu16 0.9999847 fak_uw_b1 0.00 0.9999847 FORMAT "%9.7" /end CHARACTERISTIC
/begin CHARACTERISTIC DOGov_KiMod_CUR "integrator gain drive-off" CURVE 0x8051C044 RB_Curve_S16_S16 499.9924 q7p62939Em3_rpm_DIV_Nm_s -250.0000 249.9924 FORMAT "%8.4"
 /begin AXIS_DESCR STD_AXIS PT_rTraV2N VelToN 2 -0.3276800 0.3276700 FORMAT "%9.7" DEPOSIT ABSOLUTE /end AXIS_DESCR
/end CHARACTERISTIC
/begin CHARACTERISTIC DOGov_KpLead_GCUR "drive-off torque for set path" CURVE 0x8051C04E RB_CurveGroup_U8 0.7969 q0p003125_Nm_DIV_rpm 0.00 0.7969
 /begin AXIS_DESCR COM_AXIS APP_r Prc 3 -400.0000 399.9878 FORMAT "%8.4" AXIS_PTS_REF DOGov_rAPP_DST /end AXIS_DESCR
/end CHARACTERISTIC
/begin CHARACTERISTIC DOGov_Kp_GCUR "gain of drive off governor" CURVE 0x8051C051 RB_CurveGroup_U8 0.7969 q0p003125_Nm_DIV_rpm 0.00 0.7969
 /begin AXIS_DESCR COM_AXIS APP_r Prc 3 -400.0000 399.9878 FORMAT "%8.4" AXIS_PTS_REF DOGov_rAPP_DST /end AXIS_DESCR
/end CHARACTERISTIC
/begin CHARACTERISTIC DOGov_nDiffThres_CUR "engine speed deviation drive-off support for drive off condition" CURVE 0x8051C054 RB_Curve_S16_S16 32767.50 EngN -16384.00 16383.50 FORMAT "%8.2"
 /begin AXIS_DESCR STD_AXIS APP_r Prc 2 -400.0000 399.9878 FORMAT "%8.4" DEPOSIT ABSOLUTE /end AXIS_DESCR
/end CHARACTERISTIC
/begin CHARACTERISTIC DOGov_nEngMax_C "Maximal engine speed for calculation of drive-off model" VALUE 0x8051C05E RB_Val_Ws16 32767.50 EngN -16384.00 16383.50 FORMAT "%8.2" /end CHARACTERISTIC
/begin CHARACTERISTIC DOGov_nOfsMaxAbs_GCUR "absolute maximum overspeed offset" CURVE 0x8051C060 RB_CurveGroup_S16 16383.50 EngN 0.00 16383.50 FORMAT "%8.2" EXTENDED_LIMITS -16384.00 16383.50
 /begin AXIS_DESCR COM_AXIS APP_r Prc 3 -400.0000 399.9878 FORMAT "%8.4" AXIS_PTS_REF DOGov_rAPP_DST /end AXIS_DESCR
/end CHARACTERISTIC
/begin CHARACTERISTIC DOGov_nOfsMax_GCUR "relative maximum overspeed" CURVE 0x8051C066 RB_CurveGroup_S16 16383.50 EngN 0.00 16383.50 FORMAT "%8.2" EXTENDED_LIMITS -16384.00 16383.50
 /begin AXIS_DESCR COM_AXIS DOGov_n EngN 4 -16384.00 16383.50 FORMAT "%8.2" AXIS_PTS_REF DOGov_n_DST /end AXIS_DESCR
/end CHARACTERISTIC
/begin CHARACTERISTIC DOGov_nOvrSpd_GCUR "absolute offset against overspeed" CURVE 0x8051C06E RB_CurveGroup_S16 16383.50 EngN 0.00 16383.50 FORMAT "%8.2" EXTENDED_LIMITS -16384.00 16383.50
 /begin AXIS_DESCR COM_AXIS APP_r Prc 3 -400.0000 399.9878 FORMAT "%8.4" AXIS_PTS_REF DOGov_rAPP_DST /end AXIS_DESCR
/end CHARACTERISTIC
/begin CHARACTERISTIC DOGov_nUndrSpd_GCUR "reactivation for overshootfunction under engine speed" CURVE 0x8051C074 RB_CurveGroup_S16 32767.50 EngN -16384.00 16383.50 FORMAT "%8.2"
 /begin AXIS_DESCR COM_AXIS APP_r Prc 3 -400.0000 399.9878 FORMAT "%8.4" AXIS_PTS_REF DOGov_rAPP_DST /end AXIS_DESCR
/end CHARACTERISTIC
/begin AXIS_PTS DOGov_n_DST "distribution for engine speed" 0x8051C07A DOGov_n RB_Axis_S16 32767.50 EngN 4 -16384.00 16383.50 FORMAT "%8.2" DEPOSIT ABSOLUTE /end AXIS_PTS
/begin AXIS_PTS DOGov_rAPP_DST "distribution accelerator pedal" 0x8051C084 APP_r RB_Axis_S16 799.9878 Prc 3 -400.0000 399.9878 FORMAT "%8.4" DEPOSIT ABSOLUTE /end AXIS_PTS
/begin CHARACTERISTIC DOGov_rClthAPP_CUR "Correction of the average value of the clutch position" CURVE 0x8051C08C RB_Curve_S16_S16 799.9878 Prc -400.0000 399.9878 FORMAT "%8.4"
 /begin AXIS_DESCR STD_AXIS APP_r Prc 3 -400.0000 399.9878 FORMAT "%8.4" DEPOSIT ABSOLUTE /end AXIS_DESCR
/end CHARACTERISTIC
/begin CHARACTERISTIC DOGov_rClthDeactvMax_C "Difference of Clutch position from average for widening thresholds" VALUE 0x8051C09A RB_Val_Ws16 799.9878 Prc -400.0000 399.9878 FORMAT "%8.4" /end CHARACTERISTIC
/begin CHARACTERISTIC DOGov_rClthMax_C "Upper threshold for the enlargement algorithm for the clutch position" VALUE 0x8051C09C RB_Val_Ws16 799.9878 Prc -400.0000 399.9878 FORMAT "%8.4" /end CHARACTERISTIC
/begin CHARACTERISTIC DOGov_rClthMin_C "Lower threshold for the enlargement algorithm for the clutch position" VALUE 0x8051C09E RB_Val_Ws16 799.9878 Prc -400.0000 399.9878 FORMAT "%8.4" /end CHARACTERISTIC
/begin CHARACTERISTIC DOGov_rClthStepDwn_C "Stepsize for narrowing the clutch thresholds" VALUE 0x8051C0A0 RB_Val_Ws16 799.9878 Prc -400.0000 399.9878 FORMAT "%8.4" /end CHARACTERISTIC
/begin CHARACTERISTIC DOGov_rClthStepUp_C "Stepsize for widening the clutch thresholds" VALUE 0x8051C0A2 RB_Val_Ws16 799.9878 Prc -400.0000 399.9878 FORMAT "%8.4" /end CHARACTERISTIC
/begin CHARACTERISTIC DOGov_stCfg2_CW "configuration label 2 of drive-off controll" VALUE 0x8051C0A4 RB_Val_Wu8 255.0 dez 0.00 255.0 FORMAT "%5.1" /end CHARACTERISTIC
/begin CHARACTERISTIC DOGov_stCfg_CW "configuration label of drive-off controller" VALUE 0x8051C0A5 RB_Val_Wu8 255.0 dez 0.00 255.0 FORMAT "%5.1" /end CHARACTERISTIC
/begin CHARACTERISTIC DOGov_tiAcsDT1_C "DT1 time constant for accessories" VALUE 0x8051C0A6 RB_Val_Wu8 2.550 t_q0p01 0.00 2.550 FORMAT "%5.3" /end CHARACTERISTIC
/begin CHARACTERISTIC DOGov_tiActv_C "Maximum intervention time for drive off process" VALUE 0x8051C0A8 RB_Val_Wu16 655.3500 t_q0p01 0.00 655.3500 FORMAT "%8.4" /end CHARACTERISTIC
/begin CHARACTERISTIC DOGov_tiResvActv_C "drive-off controller torque reserve activation time" VALUE 0x8051C0AA RB_Val_Wu8 2.550 t_q0p01 0.00 2.550 FORMAT "%5.3" /end CHARACTERISTIC
/begin CHARACTERISTIC DOGov_tiThresFlt_C "PT1 time constant for filtering actual torque" VALUE 0x8051C0AB RB_Val_Wu8 2.550 t_q0p01 0.00 2.550 FORMAT "%5.3" /end CHARACTERISTIC
/begin CHARACTERISTIC DOGov_trqClthThresCatHeatg_C "Threshold for drive-off detection when catalyst heating is active" VALUE 0x8051C0AC RB_Val_Ws16 6553.500 md_sw_q0p1 -3276.800 3276.700 FORMAT "%8.3" /end CHARACTERISTIC
/begin CHARACTERISTIC DOGov_trqClthThresUnsty_C "Threshold for drive-off detection unsteady" VALUE 0x8051C0AE RB_Val_Ws16 6553.500 md_sw_q0p1 -3276.800 3276.700 FORMAT "%8.3" /end CHARACTERISTIC
/begin CHARACTERISTIC DOGov_trqClthThres_C "Threshold for drive-off detection" VALUE 0x8051C0B0 RB_Val_Ws16 6553.500 md_sw_q0p1 -3276.800 3276.700 FORMAT "%8.3" /end CHARACTERISTIC
/begin CHARACTERISTIC DOGov_trqDebLead_C "Threshold for Debounce level lead path" VALUE 0x8051C0B2 RB_Val_Wu8 25.50 md_sw_q0p1 0.00 25.50 FORMAT "%5.2" /end CHARACTERISTIC
/begin CHARACTERISTIC DOGov_trqDebSet_C "Threshold for Debounce level set path" VALUE 0x8051C0B3 RB_Val_Wu8 25.50 md_sw_q0p1 0.00 25.50 FORMAT "%5.2" /end CHARACTERISTIC
/begin CHARACTERISTIC DOGov_trqMaxMon_GMAP "absolute maximum torque for monitoring" MAP 0x8051C0B4 RB_MapGroup_S16 3276.700 md_sw_q0p1 0.00 3276.700 FORMAT "%8.3" EXTENDED_LIMITS -3276.800 3276.700
 /begin AXIS_DESCR COM_AXIS DOGov_n EngN 4 -16384.00 16383.50 FORMAT "%8.2" AXIS_PTS_REF DOGov_n_DST /end AXIS_DESCR
 /begin AXIS_DESCR COM_AXIS APP_r Prc 3 -400.0000 399.9878 FORMAT "%8.4" AXIS_PTS_REF DOGov_rAPP_DST /end AXIS_DESCR
/end CHARACTERISTIC
/begin CHARACTERISTIC DOGov_trqResvMaxRmp_C "offset for fade out of maximal delta torque memory of drive-off controller" VALUE 0x8051C0CC RB_Val_Wu8 25.50 md_sw_q0p1 0.00 25.50 FORMAT "%5.2" /end CHARACTERISTIC
/begin CHARACTERISTIC DoGov_trqResvMin_GCUR "minimum for drive-off reserve" CURVE 0x8051C0CE RB_CurveGroup_U16 150.0000 md_sw_q0p1 0.00 150.0000 FORMAT "%8.4" EXTENDED_LIMITS 0.00 6553.500
 /begin AXIS_DESCR COM_AXIS APP_r Prc 3 -400.0000 399.9878 FORMAT "%8.4" AXIS_PTS_REF DOGov_rAPP_DST /end AXIS_DESCR
/end CHARACTERISTIC
/begin CHARACTERISTIC DOGov_trqResvOffRmp_C "offset for deramp of drive-off controller torque reserve" VALUE 0x8051C0D4 RB_Val_Wu8 25.50 md_sw_q0p1 0.00 25.50 FORMAT "%5.2" /end CHARACTERISTIC
/begin CHARACTERISTIC DOGov_trqRmpOff_GCUR "gradient off switch-off ramp" CURVE 0x8051C0D5 RB_CurveGroup_U8 25.50 md_sw_q0p1 0.00 25.50 FORMAT "%5.2"
 /begin AXIS_DESCR COM_AXIS APP_r Prc 3 -400.0000 399.9878 FORMAT "%8.4" AXIS_PTS_REF DOGov_rAPP_DST /end AXIS_DESCR
/end CHARACTERISTIC
/begin CHARACTERISTIC DOGov_trqThresSwtUnsty_C "activation threshold for instationary mode" VALUE 0x8051C0D8 RB_Val_Ws16 327.6700 md_sw_q0p01 0.00 327.6700 FORMAT "%8.4" EXTENDED_LIMITS -327.6800 327.6700 /end CHARACTERISTIC
/begin CHARACTERISTIC DOGov_vMax_C "Vehicle speed threshold for deactivation drive-off support" VALUE 0x8051C0DA RB_Val_Ws16 655.3500 Vel -327.6800 327.6700 FORMAT "%8.4" /end CHARACTERISTIC
/begin CHARACTERISTIC DOGov_vMin_C "Vehicle speed threshold for activation drive-off support" VALUE 0x8051C0DC RB_Val_Ws16 655.3500 Vel -327.6800 327.6700 FORMAT "%8.4" /end CHARACTERISTIC
/begin CHARACTERISTIC DORAESTAB "Delta-ORA for setting of ""ORA-stable"" when diagnosis-threshold is reached" VALUE 0x8051BEF6 RB_Val_Ws16 3071.953 rel_sw_b1536 -1536.000 1535.953 FORMAT "%8.3" /end CHARACTERISTIC
/begin CHARACTERISTIC DORASTAB "delta-ORA for setting of ""ORA stable""" VALUE 0x8051BEF8 RB_Val_Ws16 3071.953 rel_sw_b1536 -1536.000 1535.953 FORMAT "%8.3" /end CHARACTERISTIC
/begin CHARACTERISTIC DPSRM "Tolerance band in which healing can take place" VALUE 0x8051C0E0 RB_Val_Wu8 1.992188 fak_ub_b2 0.00 1.992188 FORMAT "%8.6" /end CHARACTERISTIC
/begin CHARACTERISTIC DPSRMFA "Tolerance band in which healing can take place (function demand)" VALUE 0x8051C0E1 RB_Val_Wu8 1.992188 fak_ub_b2 0.00 1.992188 FORMAT "%8.6" /end CHARACTERISTIC
/begin CHARACTERISTIC DPSRSVMN "lower limit for signal-variation-check" VALUE 0x8051C0E2 RB_Val_Wu16 5119.922 p_q0p078 0.00 5119.922 FORMAT "%8.3" /end CHARACTERISTIC
/begin CHARACTERISTIC DPTPSRMX "max tolerances of manifold pressure sensor" VALUE 0x8051C0E4 RB_Val_Wu16 5119.922 p_q0p078 0.00 5119.922 FORMAT "%8.3" /end CHARACTERISTIC
/begin CHARACTERISTIC DPUPSINIMX "tolerances between psini_w and ambient pressure" VALUE 0x8051C0E6 RB_Val_Wu16 2559.961 p_q0p039 0.00 2559.961 FORMAT "%8.3" /end CHARACTERISTIC
/begin CHARACTERISTIC FHDLLR "altitude threshold for performing of ISC-actuator diagnosis" VALUE 0x8051BF58 RB_Val_Wu8 3.984 fak_ub_b4 0.00 3.984 FORMAT "%5.3" /end CHARACTERISTIC
/begin CHARACTERISTIC FlMA_tiAddAdpnStabTstrReq_C "Monitoring duration for ORA during Line End Test for Honda" VALUE 0x8051BEFA RB_Val_Wu8 51.00 t200msxs_ub_b51 0.00 51.00 FORMAT "%5.2" /end CHARACTERISTIC
/begin CHARACTERISTIC FRADN "lower fault detection value FRA" VALUE 0x8051BEFC RB_Val_Wu16 1.999969 fak_uw_b2 0.00 1.999969 FORMAT "%8.6" /end CHARACTERISTIC
/begin CHARACTERISTIC FRADNFA "lower fault detection value FRA at function-requirement (B_falra)" VALUE 0x8051BEFE RB_Val_Wu16 1.999969 fak_uw_b2 0.00 1.999969 FORMAT "%8.6" /end CHARACTERISTIC
/begin CHARACTERISTIC FRADX "upper fault detection value FRA" VALUE 0x8051BF00 RB_Val_Wu16 1.999969 fak_uw_b2 0.00 1.999969 FORMAT "%8.6" /end CHARACTERISTIC
/begin CHARACTERISTIC FRADXFA "upper fault detection value FRA at function-requirement (B_falra)" VALUE 0x8051BF02 RB_Val_Wu16 1.999969 fak_uw_b2 0.00 1.999969 FORMAT "%8.6" /end CHARACTERISTIC
/begin CHARACTERISTIC IKCtl_facDgnsLowrThd_GT "lower threshold for knocksensor diagnosis" CURVE 0x8051BE90 RB_CurveGroup_U16 25.59961 spg_q3p906Em4_V_ms 0.00 25.59961 FORMAT "%8.5"
 /begin AXIS_DESCR COM_AXIS Epm_nEng EngN 13 -16384.00 16383.50 FORMAT "%8.2" AXIS_PTS_REF IKCtl_nEngVar13_X_AX /end AXIS_DESCR
/end CHARACTERISTIC
/begin CHARACTERISTIC IKCtl_facDgnsUpprThd_GT "upper engine speed threshold for knocksensor diagnosis" CURVE 0x8051BEAA RB_CurveGroup_U16 25.59961 spg_q3p906Em4_V_ms 0.00 25.59961 FORMAT "%8.5"
 /begin AXIS_DESCR COM_AXIS Epm_nEng EngN 13 -16384.00 16383.50 FORMAT "%8.2" AXIS_PTS_REF IKCtl_nEngVar13_X_AX /end AXIS_DESCR
/end CHARACTERISTIC
/begin CHARACTERISTIC IKCtl_facNDiagMax "upper diagnostic threshold for knock-sensor diagnosis" VALUE 0x8051BEC4 RB_Val_Ws16 32767.50 EngN -16384.00 16383.50 FORMAT "%8.2" /end CHARACTERISTIC
/begin CHARACTERISTIC IKCtl_facNDiagMin "lower diagnostic threshold for knock-sensor diagnosis" VALUE 0x8051BEC6 RB_Val_Ws16 32767.50 EngN -16384.00 16383.50 FORMAT "%8.2" /end CHARACTERISTIC
/begin AXIS_PTS IKCtl_nEngVar13_X_AX "KC: Datapoint distribution engine speed of group A" 0x8052518C Epm_nEng RB_Axis_S16 32767.50 EngN 13 -16384.00 16383.50 FORMAT "%8.2" DEPOSIT ABSOLUTE /end AXIS_PTS
/begin CHARACTERISTIC IKCtl_nLowrThdDiag "lower engine speed threshold for knock-sensor lose fit detection" VALUE 0x8051BEC8 RB_Val_Ws16 32767.50 EngN -16384.00 16383.50 FORMAT "%8.2" /end CHARACTERISTIC
/begin CHARACTERISTIC IKCtl_nUpprThdDiag "upper engine speed threshold for knock-sensor lose fit detection" VALUE 0x8051BECA RB_Val_Ws16 32767.50 EngN -16384.00 16383.50 FORMAT "%8.2" /end CHARACTERISTIC
/begin CHARACTERISTIC IKCtl_uThdLooseCnctnDiag "Reference voltage threshold for diagnosis of knock sensor loose fit detection." CURVE 0x8051BECC RB_CurveGroup_U16 25.59961 spg_q3p906Em4_V_ms 0.00 25.59961 FORMAT "%8.5"
 /begin AXIS_DESCR COM_AXIS Epm_nEng EngN 13 -16384.00 16383.50 FORMAT "%8.2" AXIS_PTS_REF IKCtl_nEngVar13_X_AX /end AXIS_DESCR
/end CHARACTERISTIC
/begin CHARACTERISTIC KRFHKS "fault frequency - knock sensors" VALUE 0x8051BEE6 RB_Val_Wu8 255.0 dez 0.00 255.0 FORMAT "%5.1" /end CHARACTERISTIC
/begin CHARACTERISTIC KRZYLDIAG "Selection of (noisy) cylinders for KS-diagnosis" VALUE 0x8051BEE7 RB_Val_Wu8 255.0 dez 0.00 255.0 FORMAT "%5.1" /end CHARACTERISTIC
/begin CHARACTERISTIC LIGov_rChrgCylLosCH_CUR "intake gas threshold during catalyst heating for idle speed diagnosis ;dep. on accessory load" CURVE 0x8051BF5A RB_Curve_S16_S16 1535.977 rel_q0p02344 -768.0000 767.9766 FORMAT "%8.4"
 /begin AXIS_DESCR STD_AXIS RngMod_trqLos md_sw_q0p1 3 -3276.800 3276.700 FORMAT "%8.3" DEPOSIT ABSOLUTE /end AXIS_DESCR
/end CHARACTERISTIC
/begin CHARACTERISTIC LIGov_rChrgCylLos_CUR "intake gas threshold for idle speed diagnosis ;dep. on accessory load" CURVE 0x8051BF68 RB_Curve_S16_S16 1535.977 rel_q0p02344 -768.0000 767.9766 FORMAT "%8.4"
 /begin AXIS_DESCR STD_AXIS RngMod_trqLos md_sw_q0p1 3 -3276.800 3276.700 FORMAT "%8.3" DEPOSIT ABSOLUTE /end AXIS_DESCR
/end CHARACTERISTIC
/begin CHARACTERISTIC LIGov_stGlbDaExtTrqDemMsk_C "Bit mask to select desired external torque demands for release of idle speed diagnosis" VALUE 0x8051BF76 RB_Val_Wu16 65535.00 OneToOne 0.00 65535.00 FORMAT "%8.2" /end CHARACTERISTIC
/begin CHARACTERISTIC NMOTMNDDSS "under engine speed limit for initialization psini_w with psdss_w" VALUE 0x8051C0E8 RB_Val_Ws16 32767.50 EngN -16384.00 16383.50 FORMAT "%8.2" /end CHARACTERISTIC
/begin CHARACTERISTIC NMOTZPLMN "Engine speed threshold for tested condition in rationality diagnosis" VALUE 0x8051C0EA RB_Val_Ws16 32767.50 EngN -16384.00 16383.50 FORMAT "%8.2" /end CHARACTERISTIC
/begin CHARACTERISTIC NPSRSVMN "engine speed limit for lower manifold pressure of signal variation check" VALUE 0x8051C0EC RB_Val_Ws16 32767.50 EngN -16384.00 16383.50 FORMAT "%8.2" /end CHARACTERISTIC
/begin CHARACTERISTIC NPSRSVMX "engine speed limit for upper manifold pressure of signal variation check" VALUE 0x8051C0EE RB_Val_Ws16 32767.50 EngN -16384.00 16383.50 FORMAT "%8.2" /end CHARACTERISTIC
/begin CHARACTERISTIC ORADN "lower threshold for diagnosis of additive correction" VALUE 0x8051BF04 RB_Val_Ws16 3071.953 rel_sw_b1536 -1536.000 1535.953 FORMAT "%8.3" /end CHARACTERISTIC
/begin CHARACTERISTIC ORADNFA "lower threshold for diagnosis of additive correction at function-requirement" VALUE 0x8051BF06 RB_Val_Ws16 3071.953 rel_sw_b1536 -1536.000 1535.953 FORMAT "%8.3" /end CHARACTERISTIC
/begin CHARACTERISTIC ORADX "upper threshold for diagnosis of additive correction" VALUE 0x8051BF08 RB_Val_Ws16 3071.953 rel_sw_b1536 -1536.000 1535.953 FORMAT "%8.3" /end CHARACTERISTIC
/begin CHARACTERISTIC ORADXFA "upper threshold for diagnosis of additive correction at function-requirement" VALUE 0x8051BF0A RB_Val_Ws16 3071.953 rel_sw_b1536 -1536.000 1535.953 FORMAT "%8.3" /end CHARACTERISTIC
/begin CHARACTERISTIC PSRMN "Lower pressure limit for range check" VALUE 0x8051C0F0 RB_Val_Wu16 5119.922 p_q0p078 0.00 5119.922 FORMAT "%8.3" /end CHARACTERISTIC
/begin CHARACTERISTIC PSRMX "Upper pressure limit for range check" VALUE 0x8051C0F2 RB_Val_Wu16 5119.922 p_q0p078 0.00 5119.922 FORMAT "%8.3" /end CHARACTERISTIC
/begin CHARACTERISTIC PthSet_stDia_CW "Code word for module DMBEG" VALUE 0x8051BF8C RB_Val_Wu8 255.0 dez 0.00 255.0 FORMAT "%5.1" /end CHARACTERISTIC
/begin CHARACTERISTIC PthSet_tiMonLimDiaErr_C "Debouncing time for diagnosis entry by monitoring level 1" VALUE 0x8051BF8E RB_Val_Wu16 65535.00 t_q1 0.00 65535.00 FORMAT "%8.2" /end CHARACTERISTIC
/begin CHARACTERISTIC PthSet_tiMonLimDiaHeal_C "Debouncing time for healing of diagnosis entry by monitoring level 1" VALUE 0x8051BF90 RB_Val_Wu16 65535.00 t_q1 0.00 65535.00 FORMAT "%8.2" /end CHARACTERISTIC
/begin CHARACTERISTIC PUPLPSRMN "min. ambient pressure for intake manifold pressure diagnosis" VALUE 0x8051C0F4 RB_Val_Wu16 2559.961 p_q0p039 0.00 2559.961 FORMAT "%8.3" /end CHARACTERISTIC
/begin CHARACTERISTIC SDFRA "Threshold to reset stability of ora in case of change frai" VALUE 0x8051BF0C RB_Val_Wu16 1.999969 fak_uw_b2 0.00 1.999969 FORMAT "%8.6" /end CHARACTERISTIC
/begin CHARACTERISTIC SDORA "Threshold to reset stability of fra in case of change ora" VALUE 0x8051BF0E RB_Val_Ws16 3071.953 rel_sw_b1536 -1536.000 1535.953 FORMAT "%8.3" /end CHARACTERISTIC
/begin CHARACTERISTIC SF_PSR "Sum Fault PSR" VAL_BLK 0x8051C0F6 RB_ValA_Wu16 58.0000000000 dfp_verbal 0.00 58.0000000000 FORMAT "%13.10" READ_ONLY NUMBER 3 /end CHARACTERISTIC
/begin CHARACTERISTIC SF_PSR1 "Sum Fault PSR 1st bank" VAL_BLK 0x8051C0FC RB_ValA_Wu16 58.0000000000 dfp_verbal 0.00 58.0000000000 FORMAT "%13.10" READ_ONLY NUMBER 6 /end CHARACTERISTIC
/begin CHARACTERISTIC TADLLR "intake air temperature threshold for ISC-actuator diagnosis" VALUE 0x8051BF78 RB_Val_Wu8 191.3 temp_ub_q0p75_o48 -48.0 143.3 FORMAT "%5.1" /end CHARACTERISTIC
/begin CHARACTERISTIC TDEPSRB "Time delay for range diagnosis manifold pressure" VALUE 0x8051C108 RB_Val_Wu8 25.50 t_q0p1 0.00 25.50 FORMAT "%5.2" /end CHARACTERISTIC
/begin CHARACTERISTIC TDEPSRP "Time delay for plausibility diagnosis manifold pressure" VALUE 0x8051C109 RB_Val_Wu8 25.50 t_q0p1 0.00 25.50 FORMAT "%5.2" /end CHARACTERISTIC
/begin CHARACTERISTIC TDLKHNUM "Time delay for possible error detection during catalyst heating." VALUE 0x8051BF8A RB_Val_Wu8 51.00 t_q0p2 0.00 51.00 FORMAT "%5.2" /end CHARACTERISTIC
/begin CHARACTERISTIC TDLLFG1 "Time delay for setting the condition diagnosis of ISC-actuator" VALUE 0x8051BF79 RB_Val_Wu8 51.00 t200msxs_ub_b51 0.00 51.00 FORMAT "%5.2" /end CHARACTERISTIC
/begin CHARACTERISTIC TDLLFGKH "Time Constant: Physical release condition for DLLR catalyst heating." VALUE 0x8051BF7A RB_Val_Wu8 51.00 t200msxs_ub_b51 0.00 51.00 FORMAT "%5.2" /end CHARACTERISTIC
/begin CHARACTERISTIC TDLLRMN "Time delay before storing error of closed ISC-actuator" VALUE 0x8051BF7B RB_Val_Wu8 51.00 t200msxs_ub_b51 0.00 51.00 FORMAT "%5.2" /end CHARACTERISTIC
/begin CHARACTERISTIC TDLLRMNKH "Time delay before storing error of closed ISC-actuator during catalyst heating" VALUE 0x8051BF7C RB_Val_Wu8 51.00 t200msxs_ub_b51 0.00 51.00 FORMAT "%5.2" /end CHARACTERISTIC
/begin CHARACTERISTIC TDLLRMX "Time delay before storing the error ISC-actuator open" VALUE 0x8051BF7D RB_Val_Wu8 51.00 t200msxs_ub_b51 0.00 51.00 FORMAT "%5.2" /end CHARACTERISTIC
/begin CHARACTERISTIC TDLLRMXKH "Time delay before storing the error ISC-actuator open during catalyst heating" VALUE 0x8051BF7E RB_Val_Wu8 51.00 t200msxs_ub_b51 0.00 51.00 FORMAT "%5.2" /end CHARACTERISTIC
/begin CHARACTERISTIC TDLLRNF "Time delay before storing ISC-actuator with no error" VALUE 0x8051BF7F RB_Val_Wu8 51.00 t200msxs_ub_b51 0.00 51.00 FORMAT "%5.2" /end CHARACTERISTIC
/begin CHARACTERISTIC TDLLRNFKH "Time delay before storing ISC-actuator with no error during catalyst heating" VALUE 0x8051BF80 RB_Val_Wu8 51.00 t200msxs_ub_b51 0.00 51.00 FORMAT "%5.2" /end CHARACTERISTIC
/begin CHARACTERISTIC TDLLRNUM "Time delay for possible error detection." VALUE 0x8051BF8B RB_Val_Wu8 51.00 t_q0p2 0.00 51.00 FORMAT "%5.2" /end CHARACTERISTIC
/begin CHARACTERISTIC TDPSRRG "Time constant for delay of electric valid manifold pressure sensor" VALUE 0x8051C10A RB_Val_Wu16 1310.700 t_q0p02 0.00 1310.700 FORMAT "%8.3" /end CHARACTERISTIC
/begin CHARACTERISTIC TEFRA "Detection time for ""FRA stable"" by exceed of diagnostic threshold" VALUE 0x8051BF10 RB_Val_Wu8 51.00 t200msxs_ub_b51 0.00 51.00 FORMAT "%5.2" /end CHARACTERISTIC
/begin CHARACTERISTIC TEHLPKS "Debounce counter value for knock sensor loose fit detection." VALUE 0x8051BEE8 RB_Val_Wu8 255.0 dez 0.00 255.0 FORMAT "%5.1" /end CHARACTERISTIC
/begin CHARACTERISTIC TEORA "Detection time for ""ORA stable"" by exceed of diagnostic threshold" VALUE 0x8051BF11 RB_Val_Wu8 51.00 t200msxs_ub_b51 0.00 51.00 FORMAT "%5.2" /end CHARACTERISTIC
/begin CHARACTERISTIC TFRA "monitoring duration sufficient for fra" VALUE 0x8051BF12 RB_Val_Wu8 51.00 t200msxs_ub_b51 0.00 51.00 FORMAT "%5.2" /end CHARACTERISTIC
/begin CHARACTERISTIC TLRASTMN "Minimum time for partial intervalto detect stability frai and ora" VALUE 0x8051BF13 RB_Val_Wu8 51.00 t200msxs_ub_b51 0.00 51.00 FORMAT "%5.2" /end CHARACTERISTIC
/begin CHARACTERISTIC TMDLLRKHO "upper engine temperature threshold for engine speed diagnosis catalyst heating" VALUE 0x8051BF81 RB_Val_Wu8 191.3 temp_ub_q0p75_o48 -48.0 143.3 FORMAT "%5.1" /end CHARACTERISTIC
/begin CHARACTERISTIC TMDLLRKHU "lower engine temperature threshold for engine speed diagnosis catalyst heating" VALUE 0x8051BF82 RB_Val_Wu8 191.3 temp_ub_q0p75_o48 -48.0 143.3 FORMAT "%5.1" /end CHARACTERISTIC
/begin CHARACTERISTIC TMDLLRO "upper engine temperature threshold for idle speed actuator diagnosis" VALUE 0x8051BF83 RB_Val_Wu8 191.3 temp_ub_q0p75_o48 -48.0 143.3 FORMAT "%5.1" /end CHARACTERISTIC
/begin CHARACTERISTIC TMDLLRU "lower engine temperature threshold for idle speed actuator diagnosis" VALUE 0x8051BF84 RB_Val_Wu8 191.3 temp_ub_q0p75_o48 -48.0 143.3 FORMAT "%5.1" /end CHARACTERISTIC
/begin CHARACTERISTIC TMOTPSSVMN "engine temperature threshold at which manifold pressure sensor could be frozen" VALUE 0x8051C10C RB_Val_Ws16 6553.500 Temp_Cels -3549.940 3003.560 FORMAT "%8.3" /end CHARACTERISTIC
/begin CHARACTERISTIC TMOTPSSVMX "engine temperature threshold for defrosted manifold pressure sensor" VALUE 0x8051C10E RB_Val_Ws16 6553.500 Temp_Cels -3549.940 3003.560 FORMAT "%8.3" /end CHARACTERISTIC
/begin CHARACTERISTIC TNMNPSR "Time when ambient pressure in manifold" VALUE 0x8051C110 RB_Val_Wu8 25.50 t_q0p1 0.00 25.50 FORMAT "%5.2" /end CHARACTERISTIC
/begin CHARACTERISTIC TNSTDLLR "Time delay until idle speed control diagnosis is activated" VALUE 0x8051BF86 RB_Val_Wu16 655.3500 t10msxs_uw_b655p35 0.00 655.3500 FORMAT "%8.4" /end CHARACTERISTIC
/begin CHARACTERISTIC TNSTSTKH "for the relase necessary time after end of start" VALUE 0x8051BF88 RB_Val_Wu16 655.3500 t10msxs_uw_b655p35 0.00 655.3500 FORMAT "%8.4" /end CHARACTERISTIC
/begin CHARACTERISTIC TOFEORAFFR "debounce time for reset of preliminary ORA-FreezeFrame" VALUE 0x8051BF18 RB_Val_Wu8 51.00 t_q0p2 0.00 51.00 FORMAT "%5.2" /end CHARACTERISTIC
/begin CHARACTERISTIC TORA "monitoring duration sufficient for ora" VALUE 0x8051BF14 RB_Val_Wu8 51.00 t200msxs_ub_b51 0.00 51.00 FORMAT "%5.2" /end CHARACTERISTIC
/begin CHARACTERISTIC TPSINIG "time for valid psini after engine start" VALUE 0x8051C112 RB_Val_Wu16 6553.500 t100msxs_uw_b6553p5 0.00 6553.500 FORMAT "%8.3" /end CHARACTERISTIC
/begin CHARACTERISTIC TPSRSVMN "min time for defrost manifold sensor at min temp" VALUE 0x8051C114 RB_Val_Wu16 1310.700 t_q0p02 0.00 1310.700 FORMAT "%8.3" /end CHARACTERISTIC
/begin CHARACTERISTIC TPSRSVN "Time for operating point of signal-variation-check" VALUE 0x8051C116 RB_Val_Wu16 1310.700 t_q0p02 0.00 1310.700 FORMAT "%8.3" /end CHARACTERISTIC
/begin CHARACTERISTIC WDKPSRSVMN "throttle blade angle limit for lower manifold pressure of signal var. check" VALUE 0x8051C118 RB_Val_Ws16 511.9922 rel_q0p0078125 -256.0000 255.9922 FORMAT "%8.4" /end CHARACTERISTIC
/begin CHARACTERISTIC WDKPSRSVMX "throttle blade angle limit for upper manifold pressure of signal var. check" VALUE 0x8051C11A RB_Val_Ws16 511.9922 rel_q0p0078125 -256.0000 255.9922 FORMAT "%8.4" /end CHARACTERISTIC
/begin CHARACTERISTIC ZKDFRM "Time constant for Lowpass of dfrm_w" VALUE 0x8051BF16 RB_Val_Wu16 13106.999997 zk200msxs_uw_b13107p2 0.200003 13107.200000 FORMAT "%12.6" EXTENDED_LIMITS 0.20000305180 13107.200000 /end CHARACTERISTIC
/begin MEASUREMENT B_clllrh "Condition: clear fault path idle speed control homogeneous" UBYTE B_TRUE 1 100 0.00 1.00000000000 BIT_MASK 0x1 FORMAT "%13.11" ECU_ADDRESS 0x60009B6C /end MEASUREMENT
/begin MEASUREMENT B_clllrkh "Condition: clear fault path idle speed control catalyst heating" UBYTE B_TRUE 1 100 0.00 1.00000000000 BIT_MASK 0x1 FORMAT "%13.11" ECU_ADDRESS 0x60009B6B /end MEASUREMENT
/begin MEASUREMENT B_dksc_msg "kc: sensor lose fit detection active" UBYTE B_TRUE 1 100 0.00 1.00000000000 BIT_MASK 0x1 FORMAT "%13.11" ECU_ADDRESS 0x70000A9B /end MEASUREMENT
/begin MEASUREMENT B_dllrakt_msg "Diagnosis idle speed is active" UBYTE B_TRUE 1 100 0.00 1.00000000000 BIT_MASK 0x1 FORMAT "%13.11" ECU_ADDRESS 0x70000A9A /end MEASUREMENT
/begin MEASUREMENT B_dllrebd "Condition physical prerequisites for DLLR release satisfied" UBYTE B_TRUE 1 100 0.00 1.00000000000 BIT_MASK 0x1 FORMAT "%13.11" ECU_ADDRESS 0x700002E2 /end MEASUREMENT
/begin MEASUREMENT B_dllrfgw_msg "The specific, physical release conditions for warm diagnosis are fulfilled" UBYTE B_TRUE 1 100 0.00 1.00000000000 BIT_MASK 0x1 FORMAT "%13.11" ECU_ADDRESS 0x70000A98 /end MEASUREMENT
/begin MEASUREMENT B_dllrfg_msg "physical pre-condition DLLR (general)" UBYTE B_TRUE 1 100 0.00 1.00000000000 BIT_MASK 0x1 FORMAT "%13.11" ECU_ADDRESS 0x70000A99 /end MEASUREMENT
/begin MEASUREMENT B_dllrhon "DLLR was active in homogeous mode for a calibratable time duration" UBYTE B_TRUE 1 100 0.00 1.00000000000 BIT_MASK 0x1 FORMAT "%13.11" ECU_ADDRESS 0x700002D7 /end MEASUREMENT
/begin MEASUREMENT B_dllrh_msg "DLLR in homogeous mode active" UBYTE B_TRUE 1 100 0.00 1.00000000000 BIT_MASK 0x1 FORMAT "%13.11" ECU_ADDRESS 0x70000A97 /end MEASUREMENT
/begin MEASUREMENT B_dllrkha_msg "physical release condition for DLLR catalyst heating" UBYTE B_TRUE 1 100 0.00 1.00000000000 BIT_MASK 0x1 FORMAT "%13.11" ECU_ADDRESS 0x70000A95 /end MEASUREMENT
/begin MEASUREMENT B_dllrkhon "DLLR during catalyst heating was active for a calibratable time duration" UBYTE B_TRUE 1 100 0.00 1.00000000000 BIT_MASK 0x1 FORMAT "%13.11" ECU_ADDRESS 0x700002D6 /end MEASUREMENT
/begin MEASUREMENT B_dllrkh_msg "DLLR during catalyst heating active" UBYTE B_TRUE 1 100 0.00 1.00000000000 BIT_MASK 0x1 FORMAT "%13.11" ECU_ADDRESS 0x70000A96 /end MEASUREMENT
/begin MEASUREMENT B_dpsrsvmn "condition, stuck in range manifold pressure sensor" UBYTE B_TRUE 1 100 0.00 1.00000000000 BIT_MASK 0x1 FORMAT "%13.11" ECU_ADDRESS 0x60009B5A /end MEASUREMENT
/begin MEASUREMENT B_ds2 "sensor diagnosis active, lower threshold" UBYTE B_TRUE 1 100 0.00 1.00000000000 BIT_MASK 0x1 FORMAT "%13.11" ECU_ADDRESS 0x700002F8 /end MEASUREMENT
/begin MEASUREMENT B_edkvs_msg "condition for adaption fault thresholds momentarily exceeded" UBYTE B_TRUE 1 100 0.00 1.00000000000 BIT_MASK 0x1 FORMAT "%13.11" ECU_ADDRESS 0x70000A86 /end MEASUREMENT
/begin MEASUREMENT B_ednllrh "Debounced minimal error symptom idle speed control homogeneous" UBYTE B_TRUE 1 100 0.00 1.00000000000 BIT_MASK 0x1 FORMAT "%13.11" ECU_ADDRESS 0x700002E1 /end MEASUREMENT
/begin MEASUREMENT B_ednllrkh "Debounced minimal error symptom idle speed control catalyst heating" UBYTE B_TRUE 1 100 0.00 1.00000000000 BIT_MASK 0x1 FORMAT "%13.11" ECU_ADDRESS 0x700002E0 /end MEASUREMENT
/begin MEASUREMENT B_edxllrh "Debounced maximal error symptom idle speed control homogeneous" UBYTE B_TRUE 1 100 0.00 1.00000000000 BIT_MASK 0x1 FORMAT "%13.11" ECU_ADDRESS 0x700002DF /end MEASUREMENT
/begin MEASUREMENT B_edxllrkh "Debounced maximal error symptom idle speed control catalyst heating" UBYTE B_TRUE 1 100 0.00 1.00000000000 BIT_MASK 0x1 FORMAT "%13.11" ECU_ADDRESS 0x700002DE /end MEASUREMENT
/begin MEASUREMENT B_efmn "Condition lower diagnostic thresholds of multiplicative correction currently exceeded" UBYTE B_TRUE 1 100 0.00 1.00000000000 BIT_MASK 0x1 FORMAT "%13.11" ECU_ADDRESS 0x700002F0 /end MEASUREMENT
/begin MEASUREMENT B_efmx "Condition upper diagnostic thresholds of multiplicative correction currently exceeded" UBYTE B_TRUE 1 100 0.00 1.00000000000 BIT_MASK 0x1 FORMAT "%13.11" ECU_ADDRESS 0x700002EF /end MEASUREMENT
/begin MEASUREMENT B_eframax_msg "Condition upper diagnostic thresholds of multiplicative correction currently exceeded" UBYTE B_TRUE 1 100 0.00 1.00000000000 BIT_MASK 0x1 FORMAT "%13.11" ECU_ADDRESS 0x70000A82 /end MEASUREMENT
/begin MEASUREMENT B_eframin_msg "Condition lower diagnostic thresholds of multiplicative correction currently exceeded" UBYTE B_TRUE 1 100 0.00 1.00000000000 BIT_MASK 0x1 FORMAT "%13.11" ECU_ADDRESS 0x70000A81 /end MEASUREMENT
/begin MEASUREMENT B_efra_msg "Condition diagnostic thresholds of multiplicative correction currently exceeded" UBYTE B_TRUE 1 100 0.00 1.00000000000 BIT_MASK 0x1 FORMAT "%13.11" ECU_ADDRESS 0x70000A83 /end MEASUREMENT
/begin MEASUREMENT B_eomn "Condition lower diagnostic thresholds of additive correction actually exceeded" UBYTE B_TRUE 1 100 0.00 1.00000000000 BIT_MASK 0x1 FORMAT "%13.11" ECU_ADDRESS 0x700002EE /end MEASUREMENT
/begin MEASUREMENT B_eomx "Condition upper diagnostic thresholds of additive correction actually exceeded" UBYTE B_TRUE 1 100 0.00 1.00000000000 BIT_MASK 0x1 FORMAT "%13.11" ECU_ADDRESS 0x700002ED /end MEASUREMENT
/begin MEASUREMENT B_eoramax_msg "Condition upper diagnostic thresholds of additive correction actually exceeded" UBYTE B_TRUE 1 100 0.00 1.00000000000 BIT_MASK 0x1 FORMAT "%13.11" ECU_ADDRESS 0x70000A75 /end MEASUREMENT
/begin MEASUREMENT B_eoramin_msg "Condition lower diagnostic thresholds of additive correction actually exceeded" UBYTE B_TRUE 1 100 0.00 1.00000000000 BIT_MASK 0x1 FORMAT "%13.11" ECU_ADDRESS 0x70000A74 /end MEASUREMENT
/begin MEASUREMENT B_eora_msg "Condition diagnostic thresholds of additive correction actually exeeded" UBYTE B_TRUE 1 100 0.00 1.00000000000 BIT_MASK 0x1 FORMAT "%13.11" ECU_ADDRESS 0x70000A76 /end MEASUREMENT
/begin MEASUREMENT B_eplpsr "not plausible error manifold pressure" UBYTE B_TRUE 1 100 0.00 1.00000000000 BIT_MASK 0x1 FORMAT "%13.11" ECU_ADDRESS 0x60009B59 /end MEASUREMENT
/begin MEASUREMENT B_epsrplmn_msg "Condition for min plausibilisation of manifold pressure not valid" UBYTE B_TRUE 1 100 0.00 1.00000000000 BIT_MASK 0x1 FORMAT "%13.11" ECU_ADDRESS 0x6000A241 /end MEASUREMENT
/begin MEASUREMENT B_epsrplmx_msg "Condition for max plausibilisation of manifold pressure not valid" UBYTE B_TRUE 1 100 0.00 1.00000000000 BIT_MASK 0x1 FORMAT "%13.11" ECU_ADDRESS 0x6000A240 /end MEASUREMENT
/begin MEASUREMENT B_epsrsv "Condition for failure from sensor signal variation-check" UBYTE B_TRUE 1 100 0.00 1.00000000000 BIT_MASK 0x1 FORMAT "%13.11" ECU_ADDRESS 0x60009B58 /end MEASUREMENT
/begin MEASUREMENT B_esmnllr_msg "Condition minimum engine speed error suspicion" UBYTE B_TRUE 1 100 0.00 1.00000000000 BIT_MASK 0x1 FORMAT "%13.11" ECU_ADDRESS 0x70000A72 /end MEASUREMENT
/begin MEASUREMENT B_esmxllr_msg "Condition maximum engine speed error suspicion" UBYTE B_TRUE 1 100 0.00 1.00000000000 BIT_MASK 0x1 FORMAT "%13.11" ECU_ADDRESS 0x70000A71 /end MEASUREMENT
/begin MEASUREMENT B_fadssATS "replacement for B_fadss_msg" UBYTE B_TRUE 1 100 0.00 1.00000000000 BIT_MASK 0x1 FORMAT "%13.11" ECU_ADDRESS 0x60009B57 /end MEASUREMENT
/begin MEASUREMENT B_fdgser_msg "FRA deviation exceeds the threshold SDFRA" UBYTE B_TRUE 1 100 0.00 1.00000000000 BIT_MASK 0x1 FORMAT "%13.11" ECU_ADDRESS 0x70000A66 /end MEASUREMENT
/begin MEASUREMENT B_fdpsrb "Enable condition range diagnosis manifold pressure" UBYTE B_TRUE 1 100 0.00 1.00000000000 BIT_MASK 0x1 FORMAT "%13.11" ECU_ADDRESS 0x60009B56 /end MEASUREMENT
/begin MEASUREMENT B_fdpsrp "Enable condition plausibility diagnosis manifold pressure" UBYTE B_TRUE 1 100 0.00 1.00000000000 BIT_MASK 0x1 FORMAT "%13.11" ECU_ADDRESS 0x60009B55 /end MEASUREMENT
/begin MEASUREMENT B_fmaxmil "MIL was aktivated by FRAmax-Error" UBYTE B_TRUE 1 100 0.00 1.00000000000 BIT_MASK 0x1 FORMAT "%13.11" ECU_ADDRESS 0x700002EA /end MEASUREMENT
/begin MEASUREMENT B_fminmil "MIL was aktivated by FRAmin-Error" UBYTE B_TRUE 1 100 0.00 1.00000000000 BIT_MASK 0x1 FORMAT "%13.11" ECU_ADDRESS 0x700002E9 /end MEASUREMENT
/begin MEASUREMENT B_fpsrplsv "Cond.: Release of model-based int.manifold press.diagnosis from icing detection" UBYTE B_TRUE 1 100 0.00 1.00000000000 BIT_MASK 0x1 FORMAT "%13.11" ECU_ADDRESS 0x60037E63 /end MEASUREMENT
/begin MEASUREMENT B_fraerr "Flag: multiplicative mixture adaptation factor is the causal error of E_FMAS" UBYTE B_TRUE 1 100 0.00 1.00000000000 BIT_MASK 0x1 FORMAT "%13.11" ECU_ADDRESS 0x700002E8 /end MEASUREMENT
/begin MEASUREMENT B_frast "Condition: last change of multipl. mixture correction smaller than threshold" UBYTE B_TRUE 1 100 0.00 1.00000000000 BIT_MASK 0x1 FORMAT "%13.11" ECU_ADDRESS 0x700002EC /end MEASUREMENT
/begin MEASUREMENT B_frastab_msg "Condition: FRA(multiplicative correction of mixture adaptation) integrator (local) stable" UBYTE B_TRUE 1 100 0.00 1.00000000000 BIT_MASK 0x1 FORMAT "%13.11" ECU_ADDRESS 0x70000A60 /end MEASUREMENT
/begin MEASUREMENT B_fstabzs_msg "Condition: B_frastab was set" UBYTE B_TRUE 1 100 0.00 1.00000000000 BIT_MASK 0x1 FORMAT "%13.11" ECU_ADDRESS 0x70000A5A /end MEASUREMENT
/begin MEASUREMENT B_gaefra_msg "condition for fra portion of adaptive Lambda pilot control successful" UBYTE B_TRUE 1 100 0.00 1.00000000000 BIT_MASK 0x1 FORMAT "%13.11" ECU_ADDRESS 0x600349A5 /end MEASUREMENT
/begin MEASUREMENT B_gaeing_msg "condition basic adaption Bank 1 steady state" UBYTE B_TRUE 1 100 0.00 1.00000000000 BIT_MASK 0x1 FORMAT "%13.11" ECU_ADDRESS 0x600349A4 /end MEASUREMENT
/begin MEASUREMENT B_gaeora_msg "ORA adaptation stabilized since last reset (NV)" UBYTE B_TRUE 1 100 0.00 1.00000000000 BIT_MASK 0x1 FORMAT "%13.11" ECU_ADDRESS 0x600349A3 /end MEASUREMENT
/begin MEASUREMENT B_gae_msg "condition for adaptive Lambda pilot control successful" UBYTE B_TRUE 1 100 0.00 1.00000000000 BIT_MASK 0x1 FORMAT "%13.11" ECU_ADDRESS 0x70000A51 /end MEASUREMENT
/begin MEASUREMENT B_heplpsr_msg "Condition for HEALING of plausibility-diagnosis manifold-pressure sensor" UBYTE B_TRUE 1 100 0.00 1.00000000000 BIT_MASK 0x1 FORMAT "%13.11" ECU_ADDRESS 0x60009FCC /end MEASUREMENT
/begin MEASUREMENT B_hepsrmn "Condition healing range min" UBYTE B_TRUE 1 100 0.00 1.00000000000 BIT_MASK 0x1 FORMAT "%13.11" ECU_ADDRESS 0x60009B54 /end MEASUREMENT
/begin MEASUREMENT B_hepsrmx "Condition healing range max" UBYTE B_TRUE 1 100 0.00 1.00000000000 BIT_MASK 0x1 FORMAT "%13.11" ECU_ADDRESS 0x60009B53 /end MEASUREMENT
/begin MEASUREMENT B_hepsrsv "Condition Healing Signal Variation Check" UBYTE B_TRUE 1 100 0.00 1.00000000000 BIT_MASK 0x1 FORMAT "%13.11" ECU_ADDRESS 0x60009B52 /end MEASUREMENT
/begin MEASUREMENT B_hldllrh "Debounced plausibel result idle speed control diagnosis homogeneous" UBYTE B_TRUE 1 100 0.00 1.00000000000 BIT_MASK 0x1 FORMAT "%13.11" ECU_ADDRESS 0x700002DD /end MEASUREMENT
/begin MEASUREMENT B_hldllrkh "Debounced plausibel result idle speed control diagnosis catalyst heating" UBYTE B_TRUE 1 100 0.00 1.00000000000 BIT_MASK 0x1 FORMAT "%13.11" ECU_ADDRESS 0x700002DC /end MEASUREMENT
/begin MEASUREMENT B_hlpkrsme "kc: auxiliary error flag signal evaluation measuring window" UBYTE B_TRUE 1 100 0.00 1.00000000000 BIT_MASK 0x1 FORMAT "%13.11" ECU_ADDRESS 0x700002F7 /end MEASUREMENT
/begin MEASUREMENT B_hlpkrsmz "kc: auxiliary cycle flag signal evaluation measuring window" UBYTE B_TRUE 1 100 0.00 1.00000000000 BIT_MASK 0x1 FORMAT "%13.11" ECU_ADDRESS 0x700002F6 /end MEASUREMENT
/begin MEASUREMENT B_hlpkrsse "kc: auxiliary error flag signal evaluation combustion" UBYTE B_TRUE 1 100 0.00 1.00000000000 BIT_MASK 0x1 FORMAT "%13.11" ECU_ADDRESS 0x700002F5 /end MEASUREMENT
/begin MEASUREMENT B_hlpkrssz "kc: auxiliary cycle flag signal evaluation combustion" UBYTE B_TRUE 1 100 0.00 1.00000000000 BIT_MASK 0x1 FORMAT "%13.11" ECU_ADDRESS 0x700002F4 /end MEASUREMENT
/begin MEASUREMENT B_krensam "condition for release of signal evaluation measuring window" UBYTE B_TRUE 1 100 0.00 1.00000000000 BIT_MASK 0x1 FORMAT "%13.11" ECU_ADDRESS 0x700002F3 /end MEASUREMENT
/begin MEASUREMENT B_krensas "condition for release of signal evaluation combustion" UBYTE B_TRUE 1 100 0.00 1.00000000000 BIT_MASK 0x1 FORMAT "%13.11" ECU_ADDRESS 0x700002F2 /end MEASUREMENT
/begin MEASUREMENT B_lraerr "at least on fueladaptation-error occuered (FRA ORA)" UBYTE B_TRUE 1 100 0.00 1.00000000000 BIT_MASK 0x1 FORMAT "%13.11" ECU_ADDRESS 0x700002E7 /end MEASUREMENT
/begin MEASUREMENT B_lraheal "no fueladaptation-error occuered (FRA ORA)" UBYTE B_TRUE 1 100 0.00 1.00000000000 BIT_MASK 0x1 FORMAT "%13.11" ECU_ADDRESS 0x700002E6 /end MEASUREMENT
/begin MEASUREMENT B_ncpsrc "Condition: increase In Use Monitoring Performance Ratio of FID-CPSRC" UBYTE B_TRUE 1 100 0.00 1.00000000000 BIT_MASK 0x1 FORMAT "%13.11" ECU_ADDRESS 0x60009B49 /end MEASUREMENT
/begin MEASUREMENT B_ncpsrr "Condition: increase In Use Monitoring Performance Ratio of FID-PSRR" UBYTE B_TRUE 1 100 0.00 1.00000000000 BIT_MASK 0x1 FORMAT "%13.11" ECU_ADDRESS 0x60009B48 /end MEASUREMENT
/begin MEASUREMENT B_nmnpsr "Condition engine stop in switch off task for a variable time" UBYTE B_TRUE 1 100 0.00 1.00000000000 BIT_MASK 0x1 FORMAT "%13.11" ECU_ADDRESS 0x60037E62 /end MEASUREMENT
/begin MEASUREMENT B_odgser_msg "ORA deviation exceeds the threshold SDORA" UBYTE B_TRUE 1 100 0.00 1.00000000000 BIT_MASK 0x1 FORMAT "%13.11" ECU_ADDRESS 0x700009D4 /end MEASUREMENT
/begin MEASUREMENT B_omaxmil "MIL was aktivated by ORAmax-Error" UBYTE B_TRUE 1 100 0.00 1.00000000000 BIT_MASK 0x1 FORMAT "%13.11" ECU_ADDRESS 0x700002E5 /end MEASUREMENT
/begin MEASUREMENT B_ominmil "MIL was aktivated by ORAmin-Error" UBYTE B_TRUE 1 100 0.00 1.00000000000 BIT_MASK 0x1 FORMAT "%13.11" ECU_ADDRESS 0x700002E4 /end MEASUREMENT
/begin MEASUREMENT B_oraerr "Flag: additive correctionis is the causal error of E_FMAS" UBYTE B_TRUE 1 100 0.00 1.00000000000 BIT_MASK 0x1 FORMAT "%13.11" ECU_ADDRESS 0x700002E3 /end MEASUREMENT
/begin MEASUREMENT B_orast "Condition: last change of additive mixture correction smaller than threshold" UBYTE B_TRUE 1 100 0.00 1.00000000000 BIT_MASK 0x1 FORMAT "%13.11" ECU_ADDRESS 0x700002EB /end MEASUREMENT
/begin MEASUREMENT B_orastab_msg "Condition: ORA(Additive correction of mixture adaptation) integrator (local) stable" UBYTE B_TRUE 1 100 0.00 1.00000000000 BIT_MASK 0x1 FORMAT "%13.11" ECU_ADDRESS 0x700009D2 /end MEASUREMENT
/begin MEASUREMENT B_ostabzs_msg "Condition: B_orastab was set after B_fstabzs" UBYTE B_TRUE 1 100 0.00 1.00000000000 BIT_MASK 0x1 FORMAT "%13.11" ECU_ADDRESS 0x700009D1 /end MEASUREMENT
/begin MEASUREMENT B_psini_msg "condition for psini_w is initialized with psdss" UBYTE B_TRUE 1 100 0.00 1.00000000000 BIT_MASK 0x1 FORMAT "%13.11" ECU_ADDRESS 0x70001BF9 /end MEASUREMENT
/begin MEASUREMENT B_psrpl_msg "Status for intake air manifold pressure value plausible" UBYTE B_TRUE 1 100 0.00 1.00000000000 BIT_MASK 0x1 FORMAT "%13.11" ECU_ADDRESS 0x6000A234 /end MEASUREMENT
/begin MEASUREMENT B_psrrgmn_msg "Condition for lower range for sensor signal wobble check confirmed" UBYTE B_TRUE 1 100 0.00 1.00000000000 BIT_MASK 0x1 FORMAT "%13.11" ECU_ADDRESS 0x6000A233 /end MEASUREMENT
/begin MEASUREMENT B_psrrgmx_msg "Condition for upper range for sensor signal wobble check confirmed" UBYTE B_TRUE 1 100 0.00 1.00000000000 BIT_MASK 0x1 FORMAT "%13.11" ECU_ADDRESS 0x6000A232 /end MEASUREMENT
/begin MEASUREMENT B_psrrgtd "condition delayed electric valid of manifold pressure" UBYTE B_TRUE 1 100 0.00 1.00000000000 BIT_MASK 0x1 FORMAT "%13.11" ECU_ADDRESS 0x60009B51 /end MEASUREMENT
/begin MEASUREMENT B_psrsvmn "Condition for lower range for sensor signal variation check confirmed" UBYTE B_TRUE 1 100 0.00 1.00000000000 BIT_MASK 0x1 FORMAT "%13.11" ECU_ADDRESS 0x60009B50 /end MEASUREMENT
/begin MEASUREMENT B_psrsvmni "Condition for lower range for sensor signal variation check confirmed (IUMPR)" UBYTE B_TRUE 1 100 0.00 1.00000000000 BIT_MASK 0x1 FORMAT "%13.11" ECU_ADDRESS 0x60009B4F /end MEASUREMENT
/begin MEASUREMENT B_psrsvmx "Condition for upper range for sensor signal variation check confirmed" UBYTE B_TRUE 1 100 0.00 1.00000000000 BIT_MASK 0x1 FORMAT "%13.11" ECU_ADDRESS 0x60009B4E /end MEASUREMENT
/begin MEASUREMENT B_psrsvmxi "Condition for upper range for sensor signal variation check confirmed (IUMPR)" UBYTE B_TRUE 1 100 0.00 1.00000000000 BIT_MASK 0x1 FORMAT "%13.11" ECU_ADDRESS 0x60009B4D /end MEASUREMENT
/begin MEASUREMENT B_pybllr "physical readiness to run function idle speed control diagnosis" UBYTE B_TRUE 1 100 0.00 1.00000000000 BIT_MASK 0x1 FORMAT "%13.11" ECU_ADDRESS 0x700002DB /end MEASUREMENT
/begin MEASUREMENT B_pybllrkh "physical readiness to run function idle speed deviation catalyst heating" UBYTE B_TRUE 1 100 0.00 1.00000000000 BIT_MASK 0x1 FORMAT "%13.11" ECU_ADDRESS 0x700002DA /end MEASUREMENT
/begin MEASUREMENT B_thigh "Condition sensor could not be iced, regarding temperature conditions" UBYTE B_TRUE 1 100 0.00 1.00000000000 BIT_MASK 0x1 FORMAT "%13.11" ECU_ADDRESS 0x60009B4C /end MEASUREMENT
/begin MEASUREMENT B_zfra_msg "Cycle flag multiplicative mixture adaptation" UBYTE B_TRUE 1 100 0.00 1.00000000000 BIT_MASK 0x1 FORMAT "%13.11" ECU_ADDRESS 0x70000952 /end MEASUREMENT
/begin MEASUREMENT B_zora_msg "if equal true, then ora(Additive correction of the mixture adaptation) is checked" UBYTE B_TRUE 1 100 0.00 1.00000000000 BIT_MASK 0x1 FORMAT "%13.11" ECU_ADDRESS 0x70000951 /end MEASUREMENT
/begin MEASUREMENT B_zpsrsv "zyklus flag for signal variation check" UBYTE B_TRUE 1 100 0.00 1.00000000000 BIT_MASK 0x1 FORMAT "%13.11" ECU_ADDRESS 0x60009B4B /end MEASUREMENT
/begin MEASUREMENT dfrmkf_w "filtered dfrm_w corrected with the P-part of the HK controller" UWORD fak_uw_b2 1 100 0.00 1.999969 FORMAT "%8.6" ECU_ADDRESS 0x6000484C /end MEASUREMENT
/begin MEASUREMENT DIUMPR_ctGenDenom "General denominator" UWORD OneToOne 1 100 0.00 65535.00 FORMAT "%8.2" ECU_ADDRESS 0x600360D6 /end MEASUREMENT
/begin MEASUREMENT DIUMPR_ctIgn "Ignition cycle counter" UWORD OneToOne 1 100 0.00 65535.00 FORMAT "%8.2" ECU_ADDRESS 0x600360D4 /end MEASUREMENT
/begin MEASUREMENT DIUMPR_Den.FID_BLLRH "IUMPR denominator (config) / calculated denominator of in-use performance monitoring of FID_BLLRH" UWORD OneToOne 1 100 0.00 65535.00 FORMAT "%8.2" ECU_ADDRESS 0x60036034 /end MEASUREMENT
/begin MEASUREMENT DIUMPR_Den.FID_BLLRKH "IUMPR denominator (config) / calculated denominator of in-use performance monitoring of FID_BLLRKH" UWORD OneToOne 1 100 0.00 65535.00 FORMAT "%8.2" ECU_ADDRESS 0x60036036 /end MEASUREMENT
/begin MEASUREMENT DIUMPR_Den.FID_BPLSU "IUMPR denominator (config) / calculated denominator of in-use performance monitoring of FID_BPLSU" UWORD OneToOne 1 100 0.00 65535.00 FORMAT "%8.2" ECU_ADDRESS 0x60036038 /end MEASUREMENT
/begin MEASUREMENT DIUMPR_Den.FId_EGSDO2SnsrMntdRelsS1B1 "IUMPR denominator (config) / calculated denominator of in-use performance monitoring of FId_EGSDO2SnsrMntdRelsS1B1" UWORD OneToOne 1 100 0.00 65535.00 FORMAT "%8.2" ECU_ADDRESS 0x6003603A /end MEASUREMENT
/begin MEASUREMENT DIUMPR_Den.FID_CETKHL "IUMPR denominator (config) / calculated denominator of in-use performance monitoring of FID_CETKHL" UWORD OneToOne 1 100 0.00 65535.00 FORMAT "%8.2" ECU_ADDRESS 0x6003603C /end MEASUREMENT
/begin MEASUREMENT DIUMPR_Den.FID_CETKHT "IUMPR denominator (config) / calculated denominator of in-use performance monitoring of FID_CETKHT" UWORD OneToOne 1 100 0.00 65535.00 FORMAT "%8.2" ECU_ADDRESS 0x6003603E /end MEASUREMENT
/begin MEASUREMENT DIUMPR_Den.FID_CGLSRDP "IUMPR denominator (config) / calculated denominator of in-use performance monitoring of FID_CGLSRDP" UWORD OneToOne 1 100 0.00 65535.00 FORMAT "%8.2" ECU_ADDRESS 0x60036040 /end MEASUREMENT
/begin MEASUREMENT DIUMPR_Den.FID_CLZSRDP "IUMPR denominator (config) / calculated denominator of in-use performance monitoring of FID_CLZSRDP" UWORD OneToOne 1 100 0.00 65535.00 FORMAT "%8.2" ECU_ADDRESS 0x60036042 /end MEASUREMENT
/begin MEASUREMENT DIUMPR_Den.FID_CPSRP "IUMPR denominator (config) / calculated denominator of in-use performance monitoring of FID_CPSRP" UWORD OneToOne 1 100 0.00 65535.00 FORMAT "%8.2" ECU_ADDRESS 0x60036044 /end MEASUREMENT
/begin MEASUREMENT DIUMPR_Den.FId_CEngDsTColdStrt "IUMPR denominator (config) / calculated denominator of in-use performance monitoring of FId_CEngDsTColdStrt" UWORD OneToOne 1 100 0.00 65535.00 FORMAT "%8.2" ECU_ADDRESS 0x60036046 /end MEASUREMENT
/begin MEASUREMENT DIUMPR_Den.FId_CEngDsTLSC "IUMPR denominator (config) / calculated denominator of in-use performance monitoring of FId_CEngDsTLSC" UWORD OneToOne 1 100 0.00 65535.00 FORMAT "%8.2" ECU_ADDRESS 0x60036048 /end MEASUREMENT
/begin MEASUREMENT DIUMPR_Den.FId_CEngDsTSTC "IUMPR denominator (config) / calculated denominator of in-use performance monitoring of FId_CEngDsTSTC" UWORD OneToOne 1 100 0.00 65535.00 FORMAT "%8.2" ECU_ADDRESS 0x6003604A /end MEASUREMENT
/begin MEASUREMENT DIUMPR_Den.FId_Cj135PerdDiagOperEnaS1B1 "IUMPR denominator (config) / calculated denominator of in-use performance monitoring of FId_Cj135PerdDiagOperEnaS1B1" UWORD OneToOne 1 100 0.00 65535.00 FORMAT "%8.2" ECU_ADDRESS 0x6003604C /end MEASUREMENT
/begin MEASUREMENT DIUMPR_Den.FId_EGSDUS2B1LtrDly "IUMPR denominator (config) / calculated denominator of in-use performance monitoring of FId_EGSDUS2B1LtrDly" UWORD OneToOne 1 100 0.00 65535.00 FORMAT "%8.2" ECU_ADDRESS 0x6003604E /end MEASUREMENT
/begin MEASUREMENT DIUMPR_Den.FId_EGSDUS2B1LtrPT1 "IUMPR denominator (config) / calculated denominator of in-use performance monitoring of FId_EGSDUS2B1LtrPT1" UWORD OneToOne 1 100 0.00 65535.00 FORMAT "%8.2" ECU_ADDRESS 0x60036050 /end MEASUREMENT
/begin MEASUREMENT DIUMPR_Den.FId_EGSDUS2B1RtlDly "IUMPR denominator (config) / calculated denominator of in-use performance monitoring of FId_EGSDUS2B1RtlDly" UWORD OneToOne 1 100 0.00 65535.00 FORMAT "%8.2" ECU_ADDRESS 0x60036052 /end MEASUREMENT
/begin MEASUREMENT DIUMPR_Den.FId_EGSDUS2B1RtlPT1 "IUMPR denominator (config) / calculated denominator of in-use performance monitoring of FId_EGSDUS2B1RtlPT1" UWORD OneToOne 1 100 0.00 65535.00 FORMAT "%8.2" ECU_ADDRESS 0x60036054 /end MEASUREMENT
/begin MEASUREMENT DIUMPR_Den.FId_EGSDUS2B1TarLean "IUMPR denominator (config) / calculated denominator of in-use performance monitoring of FId_EGSDUS2B1TarLean" UWORD OneToOne 1 100 0.00 65535.00 FORMAT "%8.2" ECU_ADDRESS 0x60036056 /end MEASUREMENT
/begin MEASUREMENT DIUMPR_Den.FId_EGSDUS2B1TarRich "IUMPR denominator (config) / calculated denominator of in-use performance monitoring of FId_EGSDUS2B1TarRich" UWORD OneToOne 1 100 0.00 65535.00 FORMAT "%8.2" ECU_ADDRESS 0x60036058 /end MEASUREMENT
/begin MEASUREMENT DIUMPR_Den.FId_EtaEngIdleNonCsers "IUMPR denominator (config) / calculated denominator of in-use performance monitoring of FId_EtaEngIdleNonCsers" UWORD OneToOne 1 100 0.00 65535.00 FORMAT "%8.2" ECU_ADDRESS 0x6003605A /end MEASUREMENT
/begin MEASUREMENT DIUMPR_Den.FId_EtaEngPtlNonCsers "IUMPR denominator (config) / calculated denominator of in-use performance monitoring of FId_EtaEngPtlNonCsers" UWORD OneToOne 1 100 0.00 65535.00 FORMAT "%8.2" ECU_ADDRESS 0x6003605C /end MEASUREMENT
/begin MEASUREMENT DIUMPR_Den.FId_HEGOS2B1DHtg "IUMPR denominator (config) / calculated denominator of in-use performance monitoring of FId_HEGOS2B1DHtg" UWORD OneToOne 1 100 0.00 65535.00 FORMAT "%8.2" ECU_ADDRESS 0x6003605E /end MEASUREMENT
/begin MEASUREMENT DIUMPR_Den.FId_InhbLamDynS1B1 "IUMPR denominator (config) / calculated denominator of in-use performance monitoring of FId_InhbLamDynS1B1" UWORD OneToOne 1 100 0.00 65535.00 FORMAT "%8.2" ECU_ADDRESS 0x60036060 /end MEASUREMENT
/begin MEASUREMENT DIUMPR_Den.FId_IntkAirTIntkMnfldCrssChk "IUMPR denominator (config) / calculated denominator of in-use performance monitoring of FId_IntkAirTIntkMnfldCrssChk" UWORD OneToOne 1 100 0.00 65535.00 FORMAT "%8.2" ECU_ADDRESS 0x60036062 /end MEASUREMENT
/begin MEASUREMENT DIUMPR_Den.FId_IntkAirTIntkMnfldPlausChk "IUMPR denominator (config) / calculated denominator of in-use performance monitoring of FId_IntkAirTIntkMnfldPlausChk" UWORD OneToOne 1 100 0.00 65535.00 FORMAT "%8.2" ECU_ADDRESS 0x60036064 /end MEASUREMENT
/begin MEASUREMENT DIUMPR_Den.FId_PEnvPlausDiagVDD "IUMPR denominator (config) / calculated denominator of in-use performance monitoring of FId_PEnvPlausDiagVDD" UWORD OneToOne 1 100 0.00 65535.00 FORMAT "%8.2" ECU_ADDRESS 0x60036066 /end MEASUREMENT
/begin MEASUREMENT DIUMPR_Den.FId_P_VSE11_Diag "IUMPR denominator (config) / calculated denominator of in-use performance monitoring of FId_P_VSE11_Diag" UWORD OneToOne 1 100 0.00 65535.00 FORMAT "%8.2" ECU_ADDRESS 0x60036068 /end MEASUREMENT
/begin MEASUREMENT DIUMPR_Den.FId_TWCDPriCatParB1 "IUMPR denominator (config) / calculated denominator of in-use performance monitoring of FId_TWCDPriCatParB1" UWORD OneToOne 1 100 0.00 65535.00 FORMAT "%8.2" ECU_ADDRESS 0x6003606A /end MEASUREMENT
/begin MEASUREMENT DIUMPR_Den.FId_TiOffTBasdChkFast "IUMPR denominator (config) / calculated denominator of in-use performance monitoring of FId_TiOffTBasdChkFast" UWORD OneToOne 1 100 0.00 65535.00 FORMAT "%8.2" ECU_ADDRESS 0x6003606C /end MEASUREMENT
/begin MEASUREMENT DIUMPR_Den.FId_TiOffTBasdChkSlow "IUMPR denominator (config) / calculated denominator of in-use performance monitoring of FId_TiOffTBasdChkSlow" UWORD OneToOne 1 100 0.00 65535.00 FORMAT "%8.2" ECU_ADDRESS 0x6003606E /end MEASUREMENT
/begin MEASUREMENT DIUMPR_Den.FId_UEGOPrmntDiagS1B1 "IUMPR denominator (config) / calculated denominator of in-use performance monitoring of FId_UEGOPrmntDiagS1B1" UWORD OneToOne 1 100 0.00 65535.00 FORMAT "%8.2" ECU_ADDRESS 0x60036070 /end MEASUREMENT
/begin MEASUREMENT DIUMPR_Den.FId_VlvLftFbSwtIntk11Diag "IUMPR denominator (config) / calculated denominator of in-use performance monitoring of FId_VlvLftFbSwtIntk11Diag" UWORD OneToOne 1 100 0.00 65535.00 FORMAT "%8.2" ECU_ADDRESS 0x60036072 /end MEASUREMENT
/begin MEASUREMENT DIUMPR_Num.FID_BLLRH "IUMPR numerator (config) / calculated numerator of in-use performance monitoring of FID_BLLRH" UWORD OneToOne 1 100 0.00 65535.00 FORMAT "%8.2" ECU_ADDRESS 0x60036074 /end MEASUREMENT
/begin MEASUREMENT DIUMPR_Num.FID_BLLRKH "IUMPR numerator (config) / calculated numerator of in-use performance monitoring of FID_BLLRKH" UWORD OneToOne 1 100 0.00 65535.00 FORMAT "%8.2" ECU_ADDRESS 0x60036076 /end MEASUREMENT
/begin MEASUREMENT DIUMPR_Num.FID_BPLSU "IUMPR numerator (config) / calculated numerator of in-use performance monitoring of FID_BPLSU" UWORD OneToOne 1 100 0.00 65535.00 FORMAT "%8.2" ECU_ADDRESS 0x60036078 /end MEASUREMENT
/begin MEASUREMENT DIUMPR_Num.FId_EGSDO2SnsrMntdRelsS1B1 "IUMPR numerator (config) / calculated numerator of in-use performance monitoring of FId_EGSDO2SnsrMntdRelsS1B1" UWORD OneToOne 1 100 0.00 65535.00 FORMAT "%8.2" ECU_ADDRESS 0x6003607A /end MEASUREMENT
/begin MEASUREMENT DIUMPR_Num.FID_CETKHL "IUMPR numerator (config) / calculated numerator of in-use performance monitoring of FID_CETKHL" UWORD OneToOne 1 100 0.00 65535.00 FORMAT "%8.2" ECU_ADDRESS 0x6003607C /end MEASUREMENT
/begin MEASUREMENT DIUMPR_Num.FID_CETKHT "IUMPR numerator (config) / calculated numerator of in-use performance monitoring of FID_CETKHT" UWORD OneToOne 1 100 0.00 65535.00 FORMAT "%8.2" ECU_ADDRESS 0x6003607E /end MEASUREMENT
/begin MEASUREMENT DIUMPR_Num.FID_CGLSRDP "IUMPR numerator (config) / calculated numerator of in-use performance monitoring of FID_CGLSRDP" UWORD OneToOne 1 100 0.00 65535.00 FORMAT "%8.2" ECU_ADDRESS 0x60036080 /end MEASUREMENT
/begin MEASUREMENT DIUMPR_Num.FID_CLZSRDP "IUMPR numerator (config) / calculated numerator of in-use performance monitoring of FID_CLZSRDP" UWORD OneToOne 1 100 0.00 65535.00 FORMAT "%8.2" ECU_ADDRESS 0x60036082 /end MEASUREMENT
/begin MEASUREMENT DIUMPR_Num.FID_CPSRP "IUMPR numerator (config) / calculated numerator of in-use performance monitoring of FID_CPSRP" UWORD OneToOne 1 100 0.00 65535.00 FORMAT "%8.2" ECU_ADDRESS 0x60036084 /end MEASUREMENT
/begin MEASUREMENT DIUMPR_Num.FId_CEngDsTColdStrt "IUMPR numerator (config) / calculated numerator of in-use performance monitoring of FId_CEngDsTColdStrt" UWORD OneToOne 1 100 0.00 65535.00 FORMAT "%8.2" ECU_ADDRESS 0x60036086 /end MEASUREMENT
/begin MEASUREMENT DIUMPR_Num.FId_CEngDsTLSC "IUMPR numerator (config) / calculated numerator of in-use performance monitoring of FId_CEngDsTLSC" UWORD OneToOne 1 100 0.00 65535.00 FORMAT "%8.2" ECU_ADDRESS 0x60036088 /end MEASUREMENT
/begin MEASUREMENT DIUMPR_Num.FId_CEngDsTSTC "IUMPR numerator (config) / calculated numerator of in-use performance monitoring of FId_CEngDsTSTC" UWORD OneToOne 1 100 0.00 65535.00 FORMAT "%8.2" ECU_ADDRESS 0x6003608A /end MEASUREMENT
/begin MEASUREMENT DIUMPR_Num.FId_Cj135PerdDiagOperEnaS1B1 "IUMPR numerator (config) / calculated numerator of in-use performance monitoring of FId_Cj135PerdDiagOperEnaS1B1" UWORD OneToOne 1 100 0.00 65535.00 FORMAT "%8.2" ECU_ADDRESS 0x6003608C /end MEASUREMENT
/begin MEASUREMENT DIUMPR_Num.FId_EGSDUS2B1LtrDly "IUMPR numerator (config) / calculated numerator of in-use performance monitoring of FId_EGSDUS2B1LtrDly" UWORD OneToOne 1 100 0.00 65535.00 FORMAT "%8.2" ECU_ADDRESS 0x6003608E /end MEASUREMENT
/begin MEASUREMENT DIUMPR_Num.FId_EGSDUS2B1LtrPT1 "IUMPR numerator (config) / calculated numerator of in-use performance monitoring of FId_EGSDUS2B1LtrPT1" UWORD OneToOne 1 100 0.00 65535.00 FORMAT "%8.2" ECU_ADDRESS 0x60036090 /end MEASUREMENT
/begin MEASUREMENT DIUMPR_Num.FId_EGSDUS2B1RtlDly "IUMPR numerator (config) / calculated numerator of in-use performance monitoring of FId_EGSDUS2B1RtlDly" UWORD OneToOne 1 100 0.00 65535.00 FORMAT "%8.2" ECU_ADDRESS 0x60036092 /end MEASUREMENT
/begin MEASUREMENT DIUMPR_Num.FId_EGSDUS2B1RtlPT1 "IUMPR numerator (config) / calculated numerator of in-use performance monitoring of FId_EGSDUS2B1RtlPT1" UWORD OneToOne 1 100 0.00 65535.00 FORMAT "%8.2" ECU_ADDRESS 0x60036094 /end MEASUREMENT
/begin MEASUREMENT DIUMPR_Num.FId_EGSDUS2B1TarLean "IUMPR numerator (config) / calculated numerator of in-use performance monitoring of FId_EGSDUS2B1TarLean" UWORD OneToOne 1 100 0.00 65535.00 FORMAT "%8.2" ECU_ADDRESS 0x60036096 /end MEASUREMENT
/begin MEASUREMENT DIUMPR_Num.FId_EGSDUS2B1TarRich "IUMPR numerator (config) / calculated numerator of in-use performance monitoring of FId_EGSDUS2B1TarRich" UWORD OneToOne 1 100 0.00 65535.00 FORMAT "%8.2" ECU_ADDRESS 0x60036098 /end MEASUREMENT
/begin MEASUREMENT DIUMPR_Num.FId_EtaEngIdleNonCsers "IUMPR numerator (config) / calculated numerator of in-use performance monitoring of FId_EtaEngIdleNonCsers" UWORD OneToOne 1 100 0.00 65535.00 FORMAT "%8.2" ECU_ADDRESS 0x6003609A /end MEASUREMENT
/begin MEASUREMENT DIUMPR_Num.FId_EtaEngPtlNonCsers "IUMPR numerator (config) / calculated numerator of in-use performance monitoring of FId_EtaEngPtlNonCsers" UWORD OneToOne 1 100 0.00 65535.00 FORMAT "%8.2" ECU_ADDRESS 0x6003609C /end MEASUREMENT
/begin MEASUREMENT DIUMPR_Num.FId_HEGOS2B1DHtg "IUMPR numerator (config) / calculated numerator of in-use performance monitoring of FId_HEGOS2B1DHtg" UWORD OneToOne 1 100 0.00 65535.00 FORMAT "%8.2" ECU_ADDRESS 0x6003609E /end MEASUREMENT
/begin MEASUREMENT DIUMPR_Num.FId_InhbLamDynS1B1 "IUMPR numerator (config) / calculated numerator of in-use performance monitoring of FId_InhbLamDynS1B1" UWORD OneToOne 1 100 0.00 65535.00 FORMAT "%8.2" ECU_ADDRESS 0x600360A0 /end MEASUREMENT
/begin MEASUREMENT DIUMPR_Num.FId_IntkAirTIntkMnfldCrssChk "IUMPR numerator (config) / calculated numerator of in-use performance monitoring of FId_IntkAirTIntkMnfldCrssChk" UWORD OneToOne 1 100 0.00 65535.00 FORMAT "%8.2" ECU_ADDRESS 0x600360A2 /end MEASUREMENT
/begin MEASUREMENT DIUMPR_Num.FId_IntkAirTIntkMnfldPlausChk "IUMPR numerator (config) / calculated numerator of in-use performance monitoring of FId_IntkAirTIntkMnfldPlausChk" UWORD OneToOne 1 100 0.00 65535.00 FORMAT "%8.2" ECU_ADDRESS 0x600360A4 /end MEASUREMENT
/begin MEASUREMENT DIUMPR_Num.FId_PEnvPlausDiagVDD "IUMPR numerator (config) / calculated numerator of in-use performance monitoring of FId_PEnvPlausDiagVDD" UWORD OneToOne 1 100 0.00 65535.00 FORMAT "%8.2" ECU_ADDRESS 0x600360A6 /end MEASUREMENT
/begin MEASUREMENT DIUMPR_Num.FId_P_VSE11_Diag "IUMPR numerator (config) / calculated numerator of in-use performance monitoring of FId_P_VSE11_Diag" UWORD OneToOne 1 100 0.00 65535.00 FORMAT "%8.2" ECU_ADDRESS 0x600360A8 /end MEASUREMENT
/begin MEASUREMENT DIUMPR_Num.FId_TWCDPriCatParB1 "IUMPR numerator (config) / calculated numerator of in-use performance monitoring of FId_TWCDPriCatParB1" UWORD OneToOne 1 100 0.00 65535.00 FORMAT "%8.2" ECU_ADDRESS 0x600360AA /end MEASUREMENT
/begin MEASUREMENT DIUMPR_Num.FId_TiOffTBasdChkFast "IUMPR numerator (config) / calculated numerator of in-use performance monitoring of FId_TiOffTBasdChkFast" UWORD OneToOne 1 100 0.00 65535.00 FORMAT "%8.2" ECU_ADDRESS 0x600360AC /end MEASUREMENT
/begin MEASUREMENT DIUMPR_Num.FId_TiOffTBasdChkSlow "IUMPR numerator (config) / calculated numerator of in-use performance monitoring of FId_TiOffTBasdChkSlow" UWORD OneToOne 1 100 0.00 65535.00 FORMAT "%8.2" ECU_ADDRESS 0x600360AE /end MEASUREMENT
/begin MEASUREMENT DIUMPR_Num.FId_UEGOPrmntDiagS1B1 "IUMPR numerator (config) / calculated numerator of in-use performance monitoring of FId_UEGOPrmntDiagS1B1" UWORD OneToOne 1 100 0.00 65535.00 FORMAT "%8.2" ECU_ADDRESS 0x600360B0 /end MEASUREMENT
/begin MEASUREMENT DIUMPR_Num.FId_VlvLftFbSwtIntk11Diag "IUMPR numerator (config) / calculated numerator of in-use performance monitoring of FId_VlvLftFbSwtIntk11Diag" UWORD OneToOne 1 100 0.00 65535.00 FORMAT "%8.2" ECU_ADDRESS 0x600360B2 /end MEASUREMENT
/begin MEASUREMENT DIUMPR_numIndGrp "IUMPR record with smallest ratio within the component group" UWORD CfgRatio_Verb 1 100 0.00 800.000000000 FORMAT "%13.9" ARRAY_SIZE 10 ECU_ADDRESS 0x6000B199 /end MEASUREMENT
/begin MEASUREMENT DIUMPR_rValRatMin "Smallest ratio within component group" UWORD Fact 1 100 0.00 7.999878 FORMAT "%8.6" ARRAY_SIZE 10 ECU_ADDRESS 0x50005810 /end MEASUREMENT
/begin MEASUREMENT DIUMPR_St.FID_BLLRH "IUMPR status (config) / status of in-use performance monitoring of FID_BLLRH" UBYTE OneToOne 1 100 0.00 255.0 FORMAT "%5.1" ECU_ADDRESS 0x600360B4 /end MEASUREMENT
/begin MEASUREMENT DIUMPR_St.FID_BLLRKH "IUMPR status (config) / status of in-use performance monitoring of FID_BLLRKH" UBYTE OneToOne 1 100 0.00 255.0 FORMAT "%5.1" ECU_ADDRESS 0x600360B5 /end MEASUREMENT
/begin MEASUREMENT DIUMPR_St.FID_BPLSU "IUMPR status (config) / status of in-use performance monitoring of FID_BPLSU" UBYTE OneToOne 1 100 0.00 255.0 FORMAT "%5.1" ECU_ADDRESS 0x600360B6 /end MEASUREMENT
/begin MEASUREMENT DIUMPR_St.FId_EGSDO2SnsrMntdRelsS1B1 "IUMPR status (config) / status of in-use performance monitoring of FId_EGSDO2SnsrMntdRelsS1B1" UBYTE OneToOne 1 100 0.00 255.0 FORMAT "%5.1" ECU_ADDRESS 0x600360B7 /end MEASUREMENT
/begin MEASUREMENT DIUMPR_St.FID_CETKHL "IUMPR status (config) / status of in-use performance monitoring of FID_CETKHL" UBYTE OneToOne 1 100 0.00 255.0 FORMAT "%5.1" ECU_ADDRESS 0x600360B8 /end MEASUREMENT
/begin MEASUREMENT DIUMPR_St.FID_CETKHT "IUMPR status (config) / status of in-use performance monitoring of FID_CETKHT" UBYTE OneToOne 1 100 0.00 255.0 FORMAT "%5.1" ECU_ADDRESS 0x600360B9 /end MEASUREMENT
/begin MEASUREMENT DIUMPR_St.FID_CGLSRDP "IUMPR status (config) / status of in-use performance monitoring of FID_CGLSRDP" UBYTE OneToOne 1 100 0.00 255.0 FORMAT "%5.1" ECU_ADDRESS 0x600360BA /end MEASUREMENT
/begin MEASUREMENT DIUMPR_St.FID_CLZSRDP "IUMPR status (config) / status of in-use performance monitoring of FID_CLZSRDP" UBYTE OneToOne 1 100 0.00 255.0 FORMAT "%5.1" ECU_ADDRESS 0x600360BB /end MEASUREMENT
/begin MEASUREMENT DIUMPR_St.FID_CPSRP "IUMPR status (config) / status of in-use performance monitoring of FID_CPSRP" UBYTE OneToOne 1 100 0.00 255.0 FORMAT "%5.1" ECU_ADDRESS 0x600360BC /end MEASUREMENT
/begin MEASUREMENT DIUMPR_St.FId_CEngDsTColdStrt "IUMPR status (config) / status of in-use performance monitoring of FId_CEngDsTColdStrt" UBYTE OneToOne 1 100 0.00 255.0 FORMAT "%5.1" ECU_ADDRESS 0x600360BD /end MEASUREMENT
/begin MEASUREMENT DIUMPR_St.FId_CEngDsTLSC "IUMPR status (config) / status of in-use performance monitoring of FId_CEngDsTLSC" UBYTE OneToOne 1 100 0.00 255.0 FORMAT "%5.1" ECU_ADDRESS 0x600360BE /end MEASUREMENT
/begin MEASUREMENT DIUMPR_St.FId_CEngDsTSTC "IUMPR status (config) / status of in-use performance monitoring of FId_CEngDsTSTC" UBYTE OneToOne 1 100 0.00 255.0 FORMAT "%5.1" ECU_ADDRESS 0x600360BF /end MEASUREMENT
/begin MEASUREMENT DIUMPR_St.FId_Cj135PerdDiagOperEnaS1B1 "IUMPR status (config) / status of in-use performance monitoring of FId_Cj135PerdDiagOperEnaS1B1" UBYTE OneToOne 1 100 0.00 255.0 FORMAT "%5.1" ECU_ADDRESS 0x600360C0 /end MEASUREMENT
/begin MEASUREMENT DIUMPR_St.FId_EGSDUS2B1LtrDly "IUMPR status (config) / status of in-use performance monitoring of FId_EGSDUS2B1LtrDly" UBYTE OneToOne 1 100 0.00 255.0 FORMAT "%5.1" ECU_ADDRESS 0x600360C1 /end MEASUREMENT
/begin MEASUREMENT DIUMPR_St.FId_EGSDUS2B1LtrPT1 "IUMPR status (config) / status of in-use performance monitoring of FId_EGSDUS2B1LtrPT1" UBYTE OneToOne 1 100 0.00 255.0 FORMAT "%5.1" ECU_ADDRESS 0x600360C2 /end MEASUREMENT
/begin MEASUREMENT DIUMPR_St.FId_EGSDUS2B1RtlDly "IUMPR status (config) / status of in-use performance monitoring of FId_EGSDUS2B1RtlDly" UBYTE OneToOne 1 100 0.00 255.0 FORMAT "%5.1" ECU_ADDRESS 0x600360C3 /end MEASUREMENT
/begin MEASUREMENT DIUMPR_St.FId_EGSDUS2B1RtlPT1 "IUMPR status (config) / status of in-use performance monitoring of FId_EGSDUS2B1RtlPT1" UBYTE OneToOne 1 100 0.00 255.0 FORMAT "%5.1" ECU_ADDRESS 0x600360C4 /end MEASUREMENT
/begin MEASUREMENT DIUMPR_St.FId_EGSDUS2B1TarLean "IUMPR status (config) / status of in-use performance monitoring of FId_EGSDUS2B1TarLean" UBYTE OneToOne 1 100 0.00 255.0 FORMAT "%5.1" ECU_ADDRESS 0x600360C5 /end MEASUREMENT
/begin MEASUREMENT DIUMPR_St.FId_EGSDUS2B1TarRich "IUMPR status (config) / status of in-use performance monitoring of FId_EGSDUS2B1TarRich" UBYTE OneToOne 1 100 0.00 255.0 FORMAT "%5.1" ECU_ADDRESS 0x600360C6 /end MEASUREMENT
/begin MEASUREMENT DIUMPR_St.FId_EtaEngIdleNonCsers "IUMPR status (config) / status of in-use performance monitoring of FId_EtaEngIdleNonCsers" UBYTE OneToOne 1 100 0.00 255.0 FORMAT "%5.1" ECU_ADDRESS 0x600360C7 /end MEASUREMENT
/begin MEASUREMENT DIUMPR_St.FId_EtaEngPtlNonCsers "IUMPR status (config) / status of in-use performance monitoring of FId_EtaEngPtlNonCsers" UBYTE OneToOne 1 100 0.00 255.0 FORMAT "%5.1" ECU_ADDRESS 0x600360C8 /end MEASUREMENT
/begin MEASUREMENT DIUMPR_St.FId_HEGOS2B1DHtg "IUMPR status (config) / status of in-use performance monitoring of FId_HEGOS2B1DHtg" UBYTE OneToOne 1 100 0.00 255.0 FORMAT "%5.1" ECU_ADDRESS 0x600360C9 /end MEASUREMENT
/begin MEASUREMENT DIUMPR_St.FId_InhbLamDynS1B1 "IUMPR status (config) / status of in-use performance monitoring of FId_InhbLamDynS1B1" UBYTE OneToOne 1 100 0.00 255.0 FORMAT "%5.1" ECU_ADDRESS 0x600360CA /end MEASUREMENT
/begin MEASUREMENT DIUMPR_St.FId_IntkAirTIntkMnfldCrssChk "IUMPR status (config) / status of in-use performance monitoring of FId_IntkAirTIntkMnfldCrssChk" UBYTE OneToOne 1 100 0.00 255.0 FORMAT "%5.1" ECU_ADDRESS 0x600360CB /end MEASUREMENT
/begin MEASUREMENT DIUMPR_St.FId_IntkAirTIntkMnfldPlausChk "IUMPR status (config) / status of in-use performance monitoring of FId_IntkAirTIntkMnfldPlausChk" UBYTE OneToOne 1 100 0.00 255.0 FORMAT "%5.1" ECU_ADDRESS 0x600360CC /end MEASUREMENT
/begin MEASUREMENT DIUMPR_St.FId_PEnvPlausDiagVDD "IUMPR status (config) / status of in-use performance monitoring of FId_PEnvPlausDiagVDD" UBYTE OneToOne 1 100 0.00 255.0 FORMAT "%5.1" ECU_ADDRESS 0x600360CD /end MEASUREMENT
/begin MEASUREMENT DIUMPR_St.FId_P_VSE11_Diag "IUMPR status (config) / status of in-use performance monitoring of FId_P_VSE11_Diag" UBYTE OneToOne 1 100 0.00 255.0 FORMAT "%5.1" ECU_ADDRESS 0x600360CE /end MEASUREMENT
/begin MEASUREMENT DIUMPR_St.FId_TWCDPriCatParB1 "IUMPR status (config) / status of in-use performance monitoring of FId_TWCDPriCatParB1" UBYTE OneToOne 1 100 0.00 255.0 FORMAT "%5.1" ECU_ADDRESS 0x600360CF /end MEASUREMENT
/begin MEASUREMENT DIUMPR_St.FId_TiOffTBasdChkFast "IUMPR status (config) / status of in-use performance monitoring of FId_TiOffTBasdChkFast" UBYTE OneToOne 1 100 0.00 255.0 FORMAT "%5.1" ECU_ADDRESS 0x600360D0 /end MEASUREMENT
/begin MEASUREMENT DIUMPR_St.FId_TiOffTBasdChkSlow "IUMPR status (config) / status of in-use performance monitoring of FId_TiOffTBasdChkSlow" UBYTE OneToOne 1 100 0.00 255.0 FORMAT "%5.1" ECU_ADDRESS 0x600360D1 /end MEASUREMENT
/begin MEASUREMENT DIUMPR_St.FId_UEGOPrmntDiagS1B1 "IUMPR status (config) / status of in-use performance monitoring of FId_UEGOPrmntDiagS1B1" UBYTE OneToOne 1 100 0.00 255.0 FORMAT "%5.1" ECU_ADDRESS 0x600360D2 /end MEASUREMENT
/begin MEASUREMENT DIUMPR_St.FId_VlvLftFbSwtIntk11Diag "IUMPR status (config) / status of in-use performance monitoring of FId_VlvLftFbSwtIntk11Diag" UBYTE OneToOne 1 100 0.00 255.0 FORMAT "%5.1" ECU_ADDRESS 0x600360D3 /end MEASUREMENT
/begin MEASUREMENT DIUMPR_stCldStrtDen "Release state of ColdStart Denominator" UBYTE OneToOne 1 100 0.00 255.0 BIT_MASK 0x1 FORMAT "%5.1" ECU_ADDRESS 0x600340A7 /end MEASUREMENT
/begin MEASUREMENT DIUMPR_stCldStrtDenCmpl "Completion of increment of Coldstart Denominator" UBYTE OneToOne 1 100 0.00 255.0 BIT_MASK 0x1 FORMAT "%5.1" ECU_ADDRESS 0x6000A6DB /end MEASUREMENT
/begin MEASUREMENT DIUMPR_stCldStrtDenCmplInh "Status of cold start denominator inhibit" UBYTE OneToOne 1 100 0.00 255.0 BIT_MASK 0x1 FORMAT "%5.1" ECU_ADDRESS 0x6000A800 /end MEASUREMENT
/begin MEASUREMENT DIUMPR_stCldStrtMon "state of additonal monitoring for ColdStart Denominator" UBYTE OneToOne 1 100 0.00 255.0 FORMAT "%5.1" ECU_ADDRESS 0x600340A6 /end MEASUREMENT
/begin MEASUREMENT DIUMPR_stEnaDenom "enable status for general denominator and ignition cycle counter" ULONG OneToOne 1 100 0.00 4294967295.00 FORMAT "%13.2" ECU_ADDRESS 0x600340A0 /end MEASUREMENT
/begin MEASUREMENT DIUMPR_stFIdCldStrtDenom_mp "Inhibit state of FId_DIUMPRCldStrtMon" UBYTE OneToOne 1 100 0.00 255.0 FORMAT "%5.1" ECU_ADDRESS 0x70008AA9 /end MEASUREMENT
/begin MEASUREMENT DIUMPR_stFIdGenDenom_mp "collected FId status (mode 7 visibility) of general denominator" UBYTE OneToOne 1 100 0.00 255.0 FORMAT "%5.1" ECU_ADDRESS 0x70008AA8 /end MEASUREMENT
/begin MEASUREMENT DIUMPR_tiEngOpCum "cumulative time since engine start (for general denominator condition)" UWORD DIUMPR_ti100ms 1 100 0.00 6553.500 FORMAT "%8.3" ECU_ADDRESS 0x6003409A /end MEASUREMENT
/begin MEASUREMENT DIUMPR_tiIdl "continuous vehicle operation at idle (for general denominator condition)" UWORD DIUMPR_ti100ms 1 100 0.00 6553.500 FORMAT "%8.3" ECU_ADDRESS 0x60034098 /end MEASUREMENT
/begin MEASUREMENT DIUMPR_tiVehSpdCum "cumulative vehicle operation at or above 25 miles per hour (for general denominator condition)" UWORD DIUMPR_ti100ms 1 100 0.00 6553.500 FORMAT "%8.3" ECU_ADDRESS 0x6003409C /end MEASUREMENT
/begin MEASUREMENT dkvsorai_w "internal additive corection of mixture adaptation" SWORD rel_sw_b1536 1 100 -1536.000 1535.953 FORMAT "%8.3" ECU_ADDRESS 0x60003C42 /end MEASUREMENT
/begin MEASUREMENT DKVS_flgDSMClrFra "Condition clearing fault memory of multiplicative adaptation value" UBYTE B_TRUE 1 100 0.00 1.00000000000 BIT_MASK 0x1 FORMAT "%13.11" ECU_ADDRESS 0x700008AE /end MEASUREMENT
/begin MEASUREMENT DKVS_flgDSMClrOra "Condition clearing fault memory of additive adaptation value (bank 2)" UBYTE B_TRUE 1 100 0.00 1.00000000000 BIT_MASK 0x1 FORMAT "%13.11" ECU_ADDRESS 0x700008AD /end MEASUREMENT
/begin MEASUREMENT DLLRIR_bActvDenomCatHeatg "DLLRIR Catalyst activation denomintor" UBYTE B_TRUE 1 100 0.00 1.00000000000 BIT_MASK 0x1 FORMAT "%13.11" ECU_ADDRESS 0x700002D5 /end MEASUREMENT
/begin MEASUREMENT DLLRIR_bActvDenomHom "DLLRIR Catalyst activation denomintor" UBYTE B_TRUE 1 100 0.00 1.00000000000 BIT_MASK 0x1 FORMAT "%13.11" ECU_ADDRESS 0x700002D4 /end MEASUREMENT
/begin MEASUREMENT DLLRIR_ctReIni "Local drive cycle counter for ReIni" UBYTE OneToOne 1 100 0.00 255.0 FORMAT "%5.1" ECU_ADDRESS 0x60009B62 /end MEASUREMENT
/begin MEASUREMENT DLLRIR_flgDfcHomTstd "DFC state condition for release numerator FID_BLLRH" UBYTE B_TRUE 1 100 0.00 1.00000000000 BIT_MASK 0x1 FORMAT "%13.11" ECU_ADDRESS 0x700002D3 /end MEASUREMENT
/begin MEASUREMENT DLLRIR_flgDfcKhTstd "DFC state condition for release numerator FID_BLLRKH" UBYTE B_TRUE 1 100 0.00 1.00000000000 BIT_MASK 0x1 FORMAT "%13.11" ECU_ADDRESS 0x700002D2 /end MEASUREMENT
/begin MEASUREMENT DLLRIR_flgReIniReq "ReIni for DLLRIR requested" UBYTE B_TRUE 1 100 0.00 1.00000000000 BIT_MASK 0x1 FORMAT "%13.11" ECU_ADDRESS 0x700002D1 /end MEASUREMENT
/begin MEASUREMENT DLLRIR_tiDenomCatHeatg "elapsed time for which the CSERS denominator was activ in this driving cycle" UBYTE t_q0p2 1 100 0.00 51.00 FORMAT "%5.2" ECU_ADDRESS 0x60009B61 /end MEASUREMENT
/begin MEASUREMENT DLLRIR_tiDenomHom "elapsed time for which the homogen denominator was activ in this driving cycle" UBYTE t_q0p2 1 100 0.00 51.00 FORMAT "%5.2" ECU_ADDRESS 0x60009B60 /end MEASUREMENT
/begin MEASUREMENT DLLR_ctReIni "DLLR counter to track the Syc postdrive leave(POSTDRIVE to DRIVE state changes)" UBYTE OneToOne 1 100 0.00 255.0 FORMAT "%5.1" ECU_ADDRESS 0x60009B6A /end MEASUREMENT
/begin MEASUREMENT DLLR_flgChrgThdMinDiag "Drive off detection for the underspeed diagnosis" UBYTE B_TRUE 1 100 0.00 1.00000000000 BIT_MASK 0x1 FORMAT "%13.11" ECU_ADDRESS 0x60009B69 /end MEASUREMENT
/begin MEASUREMENT DLLR_flgCSERSIdleDiagActvn "vehicle operation mode for the CSERS idle speed diagnosis" UBYTE B_TRUE 1 100 0.00 1.00000000000 BIT_MASK 0x1 FORMAT "%13.11" ECU_ADDRESS 0x60009B68 /end MEASUREMENT
/begin MEASUREMENT DLLR_flgGnrlActvn "generall release for the idle speed diagnosis" UBYTE B_TRUE 1 100 0.00 1.00000000000 BIT_MASK 0x1 FORMAT "%13.11" ECU_ADDRESS 0x60009B67 /end MEASUREMENT
/begin MEASUREMENT DLLR_flgNonCSERSIdleDiagActvn "vehicle operation mode for the standard idle speed diagnosis" UBYTE B_TRUE 1 100 0.00 1.00000000000 BIT_MASK 0x1 FORMAT "%13.11" ECU_ADDRESS 0x60009B66 /end MEASUREMENT
/begin MEASUREMENT DLLR_flgNoTqDmd "no torque demand active (enable condition DLLR)" UBYTE B_TRUE 1 100 0.00 1.00000000000 BIT_MASK 0x1 FORMAT "%13.11" ECU_ADDRESS 0x700002D9 /end MEASUREMENT
/begin MEASUREMENT DLLR_flgTstrActv "test request active" UBYTE B_TRUE 1 100 0.00 1.00000000000 BIT_MASK 0x1 FORMAT "%13.11" ECU_ADDRESS 0x700002D8 /end MEASUREMENT
/begin MEASUREMENT DLLR_flgVehVCond "Speed condition for DLLR release" UBYTE B_TRUE 1 100 0.00 1.00000000000 BIT_MASK 0x1 FORMAT "%13.11" ECU_ADDRESS 0x700008AC /end MEASUREMENT
/begin MEASUREMENT DLLR_flgVomActvn "Vehicle operation mode spezific release for the idle speed diagnosis" UBYTE B_TRUE 1 100 0.00 1.00000000000 BIT_MASK 0x1 FORMAT "%13.11" ECU_ADDRESS 0x60009B65 /end MEASUREMENT
/begin MEASUREMENT DLLR_nDif "Current speed deviation for diagnosis of idle speed control" SWORD nmot_ub_q10 1 100 -327680.0 327670.0 FORMAT "%8.1" ECU_ADDRESS 0x60003C30 /end MEASUREMENT
/begin MEASUREMENT DLLR_nDifCatHeatg "Current speed deviation for diagnosis of idle speed control during catalyst heating" SWORD nmot_sw_q0p5 1 100 -16384.00 16383.50 FORMAT "%8.2" ECU_ADDRESS 0x60003C2E /end MEASUREMENT
/begin MEASUREMENT DLLR_nMnErrThd "Current maximal speed deviation for detection of low speed (min error)" SWORD nmot_ub_q10 1 100 -327680.0 327670.0 FORMAT "%8.1" ECU_ADDRESS 0x60003C2C /end MEASUREMENT
/begin MEASUREMENT DLLR_nMnThdCatHeatg "Current maximal speed deviation for detection of low speed during catalyst heating" SBYTE nmot_ub_q10 1 100 -1280. 1270. FORMAT "%5.0" ECU_ADDRESS 0x60009B64 /end MEASUREMENT
/begin MEASUREMENT DLLR_nMxErrThd "Current maximal speed deviation for detection of high speed (max error)" SWORD nmot_ub_q10 1 100 -327680.0 327670.0 FORMAT "%8.1" ECU_ADDRESS 0x60003C2A /end MEASUREMENT
/begin MEASUREMENT DLLR_nMxThdCatHeatg "Current maximal speed deviation for detection of high speed during catalyst heating" SBYTE nmot_ub_q10 1 100 -1280. 1270. FORMAT "%5.0" ECU_ADDRESS 0x60009B63 /end MEASUREMENT
/begin MEASUREMENT DOGov_bActv "Condition drive-off controller with ignition intervention" UBYTE B_TRUE 1 100 0.00 1.00000000000 BIT_MASK 0x1 FORMAT "%13.11" ECU_ADDRESS 0x6000A194 /end MEASUREMENT
/begin MEASUREMENT DOGov_bActvCpl "Double storage for DOGov_bActv" UBYTE OneToOne 1 100 0.00 255.0 FORMAT "%5.1" ECU_ADDRESS 0x6000A3C7 /end MEASUREMENT
/begin MEASUREMENT DOGov_bCalc "Condition calculation of drive-off controller model" UBYTE B_TRUE 1 100 0.00 1.00000000000 BIT_MASK 0x1 FORMAT "%13.11" ECU_ADDRESS 0x60009B5E /end MEASUREMENT
/begin MEASUREMENT DOGov_bGenRls "Condition general release of functionality drive-off support" UBYTE B_TRUE 1 100 0.00 1.00000000000 BIT_MASK 0x1 FORMAT "%13.11" ECU_ADDRESS 0x60009B5D /end MEASUREMENT
/begin MEASUREMENT DOGov_bResv "Condition torque reserve request from drive-off support" UBYTE B_TRUE 1 100 0.00 1.00000000000 BIT_MASK 0x1 FORMAT "%13.11" ECU_ADDRESS 0x60009B5C /end MEASUREMENT
/begin MEASUREMENT DOGov_dnEngFltLoc "Local for Epm_dnEngFlt used as an input to DoGov_facTqLead_M" SWORD nmotg_sw_q0p39 1 100 -12800.16 12799.77 FORMAT "%8.2" ECU_ADDRESS 0x60003C28 /end MEASUREMENT
/begin MEASUREMENT DOGov_dnEngFltLocSyncn "Local for Epm_dnEngFlt used as an input to DOGov_facTqSet_M" SWORD nmotg_sw_q0p39 1 100 -12800.16 12799.77 FORMAT "%8.2" ECU_ADDRESS 0x60003C26 /end MEASUREMENT
/begin MEASUREMENT DOGov_dtrqDttme "deadtime/gradient filter DOGov_trqClth" SWORD md_sw_q0p1 1 100 -3276.800 3276.700 FORMAT "%8.3" ECU_ADDRESS 0x60003C24 /end MEASUREMENT
/begin MEASUREMENT DOGov_facOvrSpd "Factor against overspeed" UBYTE fak_ub_b1 1 100 0.00 0.9961 ECU_ADDRESS 0x60009B5B /end MEASUREMENT
/begin MEASUREMENT DOGov_n "engine speed in drive off governor" SWORD EngN 1 100 -16384.00 16383.50 FORMAT "%8.2" ECU_ADDRESS 0x60003C22 /end MEASUREMENT
/begin MEASUREMENT DOGov_nDiff "engine speed deviation drive-off support" SWORD EngN 1 100 -16384.00 16383.50 FORMAT "%8.2" ECU_ADDRESS 0x60003C20 /end MEASUREMENT
/begin MEASUREMENT DOGov_nDifSyncn "Engine speed(Sync) deviation drive-off support" SWORD EngN 1 100 -16384.00 16383.50 FORMAT "%8.2" ECU_ADDRESS 0x70001A3E /end MEASUREMENT
/begin MEASUREMENT DOGov_nSetP "Enginge speed set point drive-off controller" SWORD EngN 1 100 -16384.00 16383.50 FORMAT "%8.2" ECU_ADDRESS 0x70001A3C /end MEASUREMENT
/begin MEASUREMENT DOGov_rClthPos "cluth position" SWORD Prc 1 100 -400.0000 399.9878 FORMAT "%8.4" ECU_ADDRESS 0x60003C1E /end MEASUREMENT
/begin MEASUREMENT DOGov_rClthPosAvrg "average cluth position" SWORD Prc 1 100 -400.0000 399.9878 FORMAT "%8.4" ECU_ADDRESS 0x60037F38 /end MEASUREMENT
/begin MEASUREMENT DOGov_rClthThresMax "upper clutch threshold for activation" SWORD Prc 1 100 0.00 125.0000 FORMAT "%8.4" ECU_ADDRESS 0x60003C1C /end MEASUREMENT
/begin MEASUREMENT DOGov_rClthThresMin "lower clutch threshold for activation" SWORD Prc 1 100 0.00 399.9878 FORMAT "%8.4" ECU_ADDRESS 0x60003C1A /end MEASUREMENT
/begin MEASUREMENT DoGov_tqLeadCorrn "Driveoff governor corrected torque in lead path" SWORD md_sw_q0p1 1 100 -3276.800 3276.700 FORMAT "%8.3" ECU_ADDRESS 0x60003C18 /end MEASUREMENT
/begin MEASUREMENT DoGov_tqLeadRaw "Driveoff governor raw torque in lead path" SWORD md_sw_q0p1 1 100 -3276.800 3276.700 FORMAT "%8.3" ECU_ADDRESS 0x60003C16 /end MEASUREMENT
/begin MEASUREMENT DoGov_tqSetCorrn "Driveoff governor corrected torque in set path" SWORD md_sw_q0p1 1 100 -3276.800 3276.700 FORMAT "%8.3" ECU_ADDRESS 0x60003C14 /end MEASUREMENT
/begin MEASUREMENT DoGov_tqSetRaw "Driveoff governor raw torque in set path" SWORD md_sw_q0p1 1 100 -3276.800 3276.700 FORMAT "%8.3" ECU_ADDRESS 0x60003C12 /end MEASUREMENT
/begin MEASUREMENT DOGov_trqClth "Clutch torque for drive-off detection" SWORD md_sw_q0p1 1 100 -3276.800 3276.700 FORMAT "%8.3" ECU_ADDRESS 0x60003C10 /end MEASUREMENT
/begin MEASUREMENT DOGov_trqClth_mp "modelled clutch torque for drive-off detection" SWORD md_sw_q0p1 1 100 -3276.800 3276.700 FORMAT "%8.3" ECU_ADDRESS 0x70008DB2 /end MEASUREMENT
/begin MEASUREMENT DOGov_trqCompUnsty_mp "instationary compensation torque" SWORD md_sw_q0p01 1 100 -327.6800 327.6700 FORMAT "%8.4" ECU_ADDRESS 0x70008DB0 /end MEASUREMENT
/begin MEASUREMENT DOGov_trqLead "drive-off torque for lead path" SWORD md_sw_q0p1 1 100 0.00 3276.700 FORMAT "%8.3" ECU_ADDRESS 0x60005104 /end MEASUREMENT
/begin MEASUREMENT DOGov_trqMax "maximal delta torque drive-off controller" SWORD md_sw_q0p1 1 100 0.00 3276.700 FORMAT "%8.3" ECU_ADDRESS 0x60003C0E /end MEASUREMENT
/begin MEASUREMENT DOGov_trqMin "minimal delta torque drive-off controller" SWORD md_sw_q0p1 1 100 0.00 3276.700 FORMAT "%8.3" ECU_ADDRESS 0x60003C0C /end MEASUREMENT
/begin MEASUREMENT DOGov_trqResv "torque reserve for drive-off controller" SWORD md_sw_q0p1 1 100 0.00 3276.700 FORMAT "%8.3" ECU_ADDRESS 0x60005102 /end MEASUREMENT
/begin MEASUREMENT DOGov_trqSet "drive-off torque for set path" SWORD md_sw_q0p1 1 100 0.00 3276.700 FORMAT "%8.3" ECU_ADDRESS 0x70001DA8 /end MEASUREMENT
/begin MEASUREMENT ehlpks_max "auxiliary error flag: knock sensor max-error" UBYTE dez 1 100 0.00 255.0 FORMAT "%5.1" ECU_ADDRESS 0x6000E3BD /end MEASUREMENT
/begin MEASUREMENT ehlpks_maxold "knock sensor max-error of the last check" UBYTE dez 1 100 0.00 255.0 FORMAT "%5.1" ECU_ADDRESS 0x60009B75 /end MEASUREMENT
/begin MEASUREMENT ehlpks_min "auxiliary error flag: knock sensor min-error" UBYTE dez 1 100 0.00 255.0 FORMAT "%5.1" ECU_ADDRESS 0x6000E3BE /end MEASUREMENT
/begin MEASUREMENT ehlpks_sc_msg "Auxiliary error flag: knock sensor loose fit detection error." UBYTE dez 1 100 0.00 255.0 FORMAT "%5.1" ECU_ADDRESS 0x60009FFB /end MEASUREMENT
/begin MEASUREMENT fdpsrm_w "Factor difference of modeled manifold pressures" UWORD fak_uw_b2 1 100 0.00 1.999969 FORMAT "%8.6" ECU_ADDRESS 0x60003C0A /end MEASUREMENT
/begin MEASUREMENT FlMA_flgDSMClrDKVS "Condition clearing fault memory for function DKVS is active" UBYTE B_TRUE 1 100 0.00 1.00000000000 BIT_MASK 0x1 FORMAT "%13.11" ECU_ADDRESS 0x7000079F /end MEASUREMENT
/begin MEASUREMENT fmn_w "mininum diagnostic condition for fra in flex-fuel system" UWORD fak_uw_b2 1 100 0.00 1.999969 FORMAT "%8.6" ECU_ADDRESS 0x60003C40 /end MEASUREMENT
/begin MEASUREMENT fmx_w "maximum diagnostic condition for fra in flex-fuel system" UWORD fak_uw_b2 1 100 0.00 1.999969 FORMAT "%8.6" ECU_ADDRESS 0x60003C3E /end MEASUREMENT
/begin MEASUREMENT fraiov_w "frai value in case of stability fra" UWORD fak_uw_b2 1 100 0.00 1.999969 FORMAT "%8.6" ECU_ADDRESS 0x60037E66 /end MEASUREMENT
/begin MEASUREMENT frairef_w "reference value multiplicative mixture correction" UWORD fak_uw_b2 1 100 0.00 1.999969 FORMAT "%8.6" ECU_ADDRESS 0x60003C3C /end MEASUREMENT
/begin MEASUREMENT FRASTTIMER.time "variable existing only due to software reason / Timer value minimum time" UBYTE t200msxs_ub_b51 1 100 0.00 51.00 FORMAT "%5.2" ECU_ADDRESS 0x60003C37 /end MEASUREMENT
/begin MEASUREMENT IKCtl_ctReIniDKRS "Local counter in DKRS for number of driving cycles (leave postdrive) to enable reinitialization" UBYTE OneToOne 1 100 0.00 255.0 FORMAT "%5.1" ECU_ADDRESS 0x6000E3B2 /end MEASUREMENT
/begin MEASUREMENT IKCtl_flgDiagActv "kc: sensor diagnosis active" UBYTE B_TRUE 1 100 0.00 1.00000000000 BIT_MASK 0x1 FORMAT "%13.11" ECU_ADDRESS 0x7000074A /end MEASUREMENT
/begin MEASUREMENT IKCtl_flgDsmClrDKRSASyncS1 "DSMclear flags" UBYTE B_TRUE 1 100 0.00 1.00000000000 BIT_MASK 0x1 FORMAT "%13.11" ECU_ADDRESS 0x700002F1 /end MEASUREMENT
/begin MEASUREMENT IKCtl_flgWinMeas "transfervalue status Complex Driver KnDet current combustion" UBYTE B_TRUE 1 100 0.00 1.00000000000 BIT_MASK 0x1 FORMAT "%13.11" ECU_ADDRESS 0x70000735 /end MEASUREMENT
/begin MEASUREMENT IKCtl_krrlsdiag "clearance for diagnosis" UBYTE dez 1 100 0.00 255.0 FORMAT "%5.1" ECU_ADDRESS 0x70001C28 /end MEASUREMENT
/begin MEASUREMENT IKCtl_krstdiag "Status information of diagnosis" UBYTE dez 1 100 0.00 255.0 FORMAT "%5.1" ECU_ADDRESS 0x70001C27 /end MEASUREMENT
/begin MEASUREMENT IKCtl_MeasWinChkRls "transfervalue status Complex Driver KnDet current combustion" UBYTE dez 1 100 0.00 255.0 FORMAT "%5.1" ECU_ADDRESS 0x6000E424 /end MEASUREMENT
/begin MEASUREMENT IKCtl_stReIniDKRSA "Status ReIni Task for DKRSA" UBYTE dez 1 100 0.00 255.0 FORMAT "%5.1" ECU_ADDRESS 0x600006FA /end MEASUREMENT
/begin MEASUREMENT kcsdeb "Debounce counterfor knock sensor loose fit detection." UBYTE dez 1 100 0.00 255.0 FORMAT "%5.1" ARRAY_SIZE 1 ECU_ADDRESS 0x60009B74 /end MEASUREMENT
/begin MEASUREMENT MDBmax_flgErrClr "Flag to indicate the error status of DFC_MDBmax" UBYTE B_TRUE 1 100 0.00 1.00000000000 BIT_MASK 0x1 FORMAT "%13.11" ECU_ADDRESS 0x60009B5F /end MEASUREMENT
/begin MEASUREMENT oraiov_w "orai value in case of stability orai" SWORD rel_sw_b1536 1 100 -1536.000 1535.953 FORMAT "%8.3" ECU_ADDRESS 0x60037E64 /end MEASUREMENT
/begin MEASUREMENT orairef_w "reference value additive mixture correction" SWORD rel_sw_b1536 1 100 -1536.000 1535.953 FORMAT "%8.3" ECU_ADDRESS 0x60003C3A /end MEASUREMENT
/begin MEASUREMENT ORASTTIMER.time "variable existing only due to software reason / Timer value minimum time" UBYTE t200msxs_ub_b51 1 100 0.00 51.00 FORMAT "%5.2" ECU_ADDRESS 0x60003C33 /end MEASUREMENT
/begin MEASUREMENT PIntkVUs_flgMdlPlausErrLoB1 "Error flag for model based plausibility check of intake manifold pressure(bank 1)." UBYTE B_TRUE 1 100 0.00 1.00000000000 BIT_MASK 0x1 FORMAT "%13.11" ECU_ADDRESS 0x60009B4A /end MEASUREMENT
/begin MEASUREMENT psrmmnf_w "minimum modeled manifold pressure filtered" UWORD p_q0p078 1 100 0.00 5119.922 FORMAT "%8.3" ECU_ADDRESS 0x60003C08 /end MEASUREMENT
/begin MEASUREMENT psrmmxf_w "maximum modeled manifold pressure filtered" UWORD p_q0p078 1 100 0.00 5119.922 FORMAT "%8.3" ECU_ADDRESS 0x60003C06 /end MEASUREMENT
/begin MEASUREMENT psrmn_w "min manifold pressure from sensor signal wobble check" UWORD p_q0p078 1 100 0.00 5119.922 FORMAT "%8.3" ECU_ADDRESS 0x60003C04 /end MEASUREMENT
/begin MEASUREMENT psrmx_w "max manifold pressure from sensor signal wobble check" UWORD p_q0p078 1 100 0.00 5119.922 FORMAT "%8.3" ECU_ADDRESS 0x60003C02 /end MEASUREMENT
/begin MEASUREMENT psrrmnf_w "minimum intake manifold pressure (absolute) not corrected filtered" UWORD p_q0p078 1 100 0.00 5119.922 FORMAT "%8.3" ECU_ADDRESS 0x60003C00 /end MEASUREMENT
/begin MEASUREMENT psrrmxf_w "maximum intake manifold pressure (absolute) not corrected filtered" UWORD p_q0p078 1 100 0.00 5119.922 FORMAT "%8.3" ECU_ADDRESS 0x60003BFE /end MEASUREMENT
/begin MEASUREMENT psrrtn_w_msg "intake manifold pressure (absolute) not corrected with min tolerances" UWORD p_q0p078 1 100 0.00 5119.922 FORMAT "%8.3" ECU_ADDRESS 0x60004BC4 /end MEASUREMENT
/begin MEASUREMENT psrrtx_w_msg "intake manifold pressure (absolute) not corrected with max tolerances" UWORD p_q0p078 1 100 0.00 5119.922 FORMAT "%8.3" ECU_ADDRESS 0x60004BC2 /end MEASUREMENT
/begin MEASUREMENT tfrastmn "min. time for stabil check of FRA" UBYTE t200msxs_ub_b51 1 100 0.00 51.00 FORMAT "%5.2" ECU_ADDRESS 0x60009B6E /end MEASUREMENT
/begin MEASUREMENT torastmn "min. time for stabil check of ora" UBYTE t200msxs_ub_b51 1 100 0.00 51.00 FORMAT "%5.2" ECU_ADDRESS 0x60009B6D /end MEASUREMENT
/begin MEASUREMENT udksoa_w "knock sensor diagnosis: actuel value upper threshold" UWORD spg_q3p906Em4_V_ms 1 100 0.00 25.59961 FORMAT "%8.5" ECU_ADDRESS 0x60003C48 /end MEASUREMENT
/begin MEASUREMENT udkssua_w "Knock sensor diagnosis: actual value of knock sensor loose fit detection threshold(UDKSV6SUN)." UWORD spg_q3p906Em4_V_ms 1 100 0.00 25.59961 FORMAT "%8.5" ECU_ADDRESS 0x60003C46 /end MEASUREMENT
/begin MEASUREMENT udksua_w "Knock sensor diagnosis: actual value of knock sensor loose fit detection threshold" UWORD spg_q3p906Em4_V_ms 1 100 0.00 25.59961 FORMAT "%8.5" ECU_ADDRESS 0x60003C44 /end MEASUREMENT
/begin MEASUREMENT xzheil "healing counter knock sensor diagnosis" UBYTE dez 1 100 0.00 255.0 FORMAT "%5.1" ARRAY_SIZE 1 ECU_ADDRESS 0x60009B73 /end MEASUREMENT
/begin MEASUREMENT xzsen "debounce counter knock sensor diagnosis" UBYTE dez 1 100 0.00 255.0 FORMAT "%5.1" ARRAY_SIZE 1 ECU_ADDRESS 0x60009B72 /end MEASUREMENT
/begin MEASUREMENT zdkrsam "counter knock detection: number of signal evaluation errors (measuring window) within obersavtion period" UBYTE dez 1 100 0.00 255.0 FORMAT "%5.1" ECU_ADDRESS 0x60009B71 /end MEASUREMENT
/begin MEASUREMENT zdkrsas_w "counter knock detection: number of signal evaluation errors (combustion) within obersavtion period" UWORD dez 1 100 0.00 65535.00 FORMAT "%8.2" ECU_ADDRESS 0x500006C6 /end MEASUREMENT
/begin MEASUREMENT zkrdisam "counter for the period of observation for evaluation: measuring window" UBYTE dez 1 100 0.00 255.0 FORMAT "%5.1" ECU_ADDRESS 0x60009B70 /end MEASUREMENT
/begin MEASUREMENT zkrdisas_w "counter for the period of observation for evaluation: combustion" UWORD dez 1 100 0.00 65535.00 FORMAT "%8.2" ECU_ADDRESS 0x500006C8 /end MEASUREMENT
/begin MEASUREMENT zkrzsam "cycle counter knock control evaluation measuring window" UBYTE dez 1 100 0.00 255.0 FORMAT "%5.1" ECU_ADDRESS 0x60009B6F /end MEASUREMENT
/begin MEASUREMENT zkrzsas "cycle counter knock control evaluation combustion" UBYTE dez 1 100 0.00 255.0 FORMAT "%5.1" ECU_ADDRESS 0x5000087C /end MEASUREMENT
/begin FUNCTION DINH "30000.27.0_1.0.0Diagnostic Inhibit Handler"
 /begin DEF_CHARACTERISTIC DINH_Lim.DSQ_GbxPosNotPN_CA DINH_Lim.DSQ_MRly_CA DINH_Lim.DSQ_PEnvMeasVld_CA DINH_Lim.DSQ_PEnvVld_CA DINH_Lim.DSQ_PEnv_pRaw_CA DINH_Lim.DSQ_PThrVlvUs_CA DINH_Lim.DSQ_PThrVlvUsB1_CA DINH_Lim.DSQ_StrtImobChk_CA DINH_Lim.DSQ_TDevCenColdStrt_CA DINH_Lim.DSQ_UEGOHeatrPwrOKS1B1_CA DINH_Lim.DSQ_UEGOIPmpS1B1_CA DINH_Lim.DSQ_UEGOLamS1B1_CA DINH_Lim.DSQ_UEGOTCtrlS1B1_CA DINH_Lim.DSQ_VehV_CA DINH_Lim.DSQ_VehVSnsr_CA DINH_Lim.DSQ_stAPP_CA DINH_Lim.DSQ_stComEAT4_CA DINH_tiUpdObsv_C DINH_xFIDObsv_C /end DEF_CHARACTERISTIC
 FUNCTION_VERSION "30000.27.0_1.0.0" /end FUNCTION
/begin FUNCTION DIUMPR "30000.50.0Diagnostic In Use Monitor Performance Ratio"
 /begin DEF_CHARACTERISTIC DIUMPR_ctGen.l500MDInc_C DIUMPR_ctGen.l500MD_C DIUMPR_ctGen.pEnvMin_C DIUMPR_ctGen.rAPPMax_C DIUMPR_ctGen.tEnvMin_C DIUMPR_ctGen.tiActrMin_C DIUMPR_ctGen.tiFuEngOpMin_C DIUMPR_ctGen.tiIdlMin_C DIUMPR_ctGen.tiIgnCycMin_C DIUMPR_ctGen.tiIgnMin_C DIUMPR_ctGen.tiOpMin_C DIUMPR_ctGen.tiSigContActv_C DIUMPR_ctGen.tiVehSpdMin_C DIUMPR_ctGen.vVehIdlMax_C DIUMPR_ctGen.vVehMin_C DIUMPR_Ctl.FID_BLLRH_C DIUMPR_Ctl.FID_BLLRKH_C DIUMPR_Ctl.FID_BPLSU_C DIUMPR_Ctl.FId_EGSDO2SnsrMntdRelsS1B1_C DIUMPR_Ctl.FID_CETKHL_C DIUMPR_Ctl.FID_CETKHT_C DIUMPR_Ctl.FID_CGLSRDP_C DIUMPR_Ctl.FID_CLZSRDP_C DIUMPR_Ctl.FID_CPSRP_C DIUMPR_Ctl.FId_CEngDsTColdStrt_C DIUMPR_Ctl.FId_CEngDsTLSC_C DIUMPR_Ctl.FId_CEngDsTSTC_C DIUMPR_Ctl.FId_Cj135PerdDiagOperEnaS1B1_C DIUMPR_Ctl.FId_EGSDUS2B1LtrDly_C DIUMPR_Ctl.FId_EGSDUS2B1LtrPT1_C DIUMPR_Ctl.FId_EGSDUS2B1RtlDly_C DIUMPR_Ctl.FId_EGSDUS2B1RtlPT1_C DIUMPR_Ctl.FId_EGSDUS2B1TarLean_C DIUMPR_Ctl.FId_EGSDUS2B1TarRich_C DIUMPR_Ctl.FId_EtaEngIdleNonCsers_C DIUMPR_Ctl.FId_EtaEngPtlNonCsers_C DIUMPR_Ctl.FId_HEGOS2B1DHtg_C DIUMPR_Ctl.FId_InhbLamDynS1B1_C DIUMPR_Ctl.FId_IntkAirTIntkMnfldCrssChk_C DIUMPR_Ctl.FId_IntkAirTIntkMnfldPlausChk_C DIUMPR_Ctl.FId_PEnvPlausDiagVDD_C DIUMPR_Ctl.FId_P_VSE11_Diag_C DIUMPR_Ctl.FId_TWCDPriCatParB1_C DIUMPR_Ctl.FId_TiOffTBasdChkFast_C DIUMPR_Ctl.FId_TiOffTBasdChkSlow_C DIUMPR_Ctl.FId_UEGOPrmntDiagS1B1_C DIUMPR_Ctl.FId_VlvLftFbSwtIntk11Diag_C DIUMPR_DFC.FID_BLLRH_C DIUMPR_DFC.FID_BLLRKH_C DIUMPR_DFC.FID_BPLSU_C DIUMPR_DFC.FId_EGSDO2SnsrMntdRelsS1B1_C DIUMPR_DFC.FID_CETKHL_C DIUMPR_DFC.FID_CETKHT_C DIUMPR_DFC.FID_CGLSRDP_C DIUMPR_DFC.FID_CLZSRDP_C DIUMPR_DFC.FID_CPSRP_C DIUMPR_DFC.FId_CEngDsTColdStrt_C DIUMPR_DFC.FId_CEngDsTLSC_C DIUMPR_DFC.FId_CEngDsTSTC_C DIUMPR_DFC.FId_Cj135PerdDiagOperEnaS1B1_C DIUMPR_DFC.FId_EGSDUS2B1LtrDly_C DIUMPR_DFC.FId_EGSDUS2B1LtrPT1_C DIUMPR_DFC.FId_EGSDUS2B1RtlDly_C DIUMPR_DFC.FId_EGSDUS2B1RtlPT1_C DIUMPR_DFC.FId_EGSDUS2B1TarLean_C DIUMPR_DFC.FId_EGSDUS2B1TarRich_C DIUMPR_DFC.FId_EtaEngIdleNonCsers_C DIUMPR_DFC.FId_EtaEngPtlNonCsers_C DIUMPR_DFC.FId_HEGOS2B1DHtg_C DIUMPR_DFC.FId_InhbLamDynS1B1_C DIUMPR_DFC.FId_IntkAirTIntkMnfldCrssChk_C DIUMPR_DFC.FId_IntkAirTIntkMnfldPlausChk_C DIUMPR_DFC.FId_PEnvPlausDiagVDD_C DIUMPR_DFC.FId_P_VSE11_Diag_C DIUMPR_DFC.FId_TWCDPriCatParB1_C DIUMPR_DFC.FId_TiOffTBasdChkFast_C DIUMPR_DFC.FId_TiOffTBasdChkSlow_C DIUMPR_DFC.FId_UEGOPrmntDiagS1B1_C DIUMPR_DFC.FId_VlvLftFbSwtIntk11Diag_C DIUMPR_Grp.FID_BLLRH_C DIUMPR_Grp.FID_BLLRKH_C DIUMPR_Grp.FID_BPLSU_C DIUMPR_Grp.FId_EGSDO2SnsrMntdRelsS1B1_C DIUMPR_Grp.FID_CETKHL_C DIUMPR_Grp.FID_CETKHT_C DIUMPR_Grp.FID_CGLSRDP_C DIUMPR_Grp.FID_CLZSRDP_C DIUMPR_Grp.FID_CPSRP_C DIUMPR_Grp.FId_CEngDsTColdStrt_C DIUMPR_Grp.FId_CEngDsTLSC_C DIUMPR_Grp.FId_CEngDsTSTC_C DIUMPR_Grp.FId_Cj135PerdDiagOperEnaS1B1_C DIUMPR_Grp.FId_EGSDUS2B1LtrDly_C DIUMPR_Grp.FId_EGSDUS2B1LtrPT1_C DIUMPR_Grp.FId_EGSDUS2B1RtlDly_C DIUMPR_Grp.FId_EGSDUS2B1RtlPT1_C DIUMPR_Grp.FId_EGSDUS2B1TarLean_C DIUMPR_Grp.FId_EGSDUS2B1TarRich_C DIUMPR_Grp.FId_EtaEngIdleNonCsers_C DIUMPR_Grp.FId_EtaEngPtlNonCsers_C DIUMPR_Grp.FId_HEGOS2B1DHtg_C DIUMPR_Grp.FId_InhbLamDynS1B1_C DIUMPR_Grp.FId_IntkAirTIntkMnfldCrssChk_C DIUMPR_Grp.FId_IntkAirTIntkMnfldPlausChk_C DIUMPR_Grp.FId_PEnvPlausDiagVDD_C DIUMPR_Grp.FId_P_VSE11_Diag_C DIUMPR_Grp.FId_TWCDPriCatParB1_C DIUMPR_Grp.FId_TiOffTBasdChkFast_C DIUMPR_Grp.FId_TiOffTBasdChkSlow_C DIUMPR_Grp.FId_UEGOPrmntDiagS1B1_C DIUMPR_Grp.FId_VlvLftFbSwtIntk11Diag_C DIUMPR_tCldStrtDenCldStrtOfs_C DIUMPR_tCldStrtDenECTMax_C DIUMPR_tiCldStrtDenEngStrtDelay_C DIUMPR_xSelTstrNumrInctLock_C /end DEF_CHARACTERISTIC
 /begin OUT_MEASUREMENT DIUMPR_stCldStrtDenCmpl DIUMPR_stCldStrtDenCmplInh /end OUT_MEASUREMENT
 /begin LOC_MEASUREMENT DIUMPR_ctGenDenom DIUMPR_ctIgn DIUMPR_Den.FID_BLLRH DIUMPR_Den.FID_BLLRKH DIUMPR_Den.FID_BPLSU DIUMPR_Den.FId_EGSDO2SnsrMntdRelsS1B1 DIUMPR_Den.FID_CETKHL DIUMPR_Den.FID_CETKHT DIUMPR_Den.FID_CGLSRDP DIUMPR_Den.FID_CLZSRDP DIUMPR_Den.FID_CPSRP DIUMPR_Den.FId_CEngDsTColdStrt DIUMPR_Den.FId_CEngDsTLSC DIUMPR_Den.FId_CEngDsTSTC DIUMPR_Den.FId_Cj135PerdDiagOperEnaS1B1 DIUMPR_Den.FId_EGSDUS2B1LtrDly DIUMPR_Den.FId_EGSDUS2B1LtrPT1 DIUMPR_Den.FId_EGSDUS2B1RtlDly DIUMPR_Den.FId_EGSDUS2B1RtlPT1 DIUMPR_Den.FId_EGSDUS2B1TarLean DIUMPR_Den.FId_EGSDUS2B1TarRich DIUMPR_Den.FId_EtaEngIdleNonCsers DIUMPR_Den.FId_EtaEngPtlNonCsers DIUMPR_Den.FId_HEGOS2B1DHtg DIUMPR_Den.FId_InhbLamDynS1B1 DIUMPR_Den.FId_IntkAirTIntkMnfldCrssChk DIUMPR_Den.FId_IntkAirTIntkMnfldPlausChk DIUMPR_Den.FId_PEnvPlausDiagVDD DIUMPR_Den.FId_P_VSE11_Diag DIUMPR_Den.FId_TWCDPriCatParB1 DIUMPR_Den.FId_TiOffTBasdChkFast DIUMPR_Den.FId_TiOffTBasdChkSlow DIUMPR_Den.FId_UEGOPrmntDiagS1B1 DIUMPR_Den.FId_VlvLftFbSwtIntk11Diag DIUMPR_Num.FID_BLLRH DIUMPR_Num.FID_BLLRKH DIUMPR_Num.FID_BPLSU DIUMPR_Num.FId_EGSDO2SnsrMntdRelsS1B1 DIUMPR_Num.FID_CETKHL DIUMPR_Num.FID_CETKHT DIUMPR_Num.FID_CGLSRDP DIUMPR_Num.FID_CLZSRDP DIUMPR_Num.FID_CPSRP DIUMPR_Num.FId_CEngDsTColdStrt DIUMPR_Num.FId_CEngDsTLSC DIUMPR_Num.FId_CEngDsTSTC DIUMPR_Num.FId_Cj135PerdDiagOperEnaS1B1 DIUMPR_Num.FId_EGSDUS2B1LtrDly DIUMPR_Num.FId_EGSDUS2B1LtrPT1 DIUMPR_Num.FId_EGSDUS2B1RtlDly DIUMPR_Num.FId_EGSDUS2B1RtlPT1 DIUMPR_Num.FId_EGSDUS2B1TarLean DIUMPR_Num.FId_EGSDUS2B1TarRich DIUMPR_Num.FId_EtaEngIdleNonCsers DIUMPR_Num.FId_EtaEngPtlNonCsers DIUMPR_Num.FId_HEGOS2B1DHtg DIUMPR_Num.FId_InhbLamDynS1B1 DIUMPR_Num.FId_IntkAirTIntkMnfldCrssChk DIUMPR_Num.FId_IntkAirTIntkMnfldPlausChk DIUMPR_Num.FId_PEnvPlausDiagVDD DIUMPR_Num.FId_P_VSE11_Diag DIUMPR_Num.FId_TWCDPriCatParB1 DIUMPR_Num.FId_TiOffTBasdChkFast DIUMPR_Num.FId_TiOffTBasdChkSlow DIUMPR_Num.FId_UEGOPrmntDiagS1B1 DIUMPR_Num.FId_VlvLftFbSwtIntk11Diag DIUMPR_numIndGrp DIUMPR_rValRatMin DIUMPR_St.FID_BLLRH DIUMPR_St.FID_BLLRKH DIUMPR_St.FID_BPLSU DIUMPR_St.FId_EGSDO2SnsrMntdRelsS1B1 DIUMPR_St.FID_CETKHL DIUMPR_St.FID_CETKHT DIUMPR_St.FID_CGLSRDP DIUMPR_St.FID_CLZSRDP DIUMPR_St.FID_CPSRP DIUMPR_St.FId_CEngDsTColdStrt DIUMPR_St.FId_CEngDsTLSC DIUMPR_St.FId_CEngDsTSTC DIUMPR_St.FId_Cj135PerdDiagOperEnaS1B1 DIUMPR_St.FId_EGSDUS2B1LtrDly DIUMPR_St.FId_EGSDUS2B1LtrPT1 DIUMPR_St.FId_EGSDUS2B1RtlDly DIUMPR_St.FId_EGSDUS2B1RtlPT1 DIUMPR_St.FId_EGSDUS2B1TarLean DIUMPR_St.FId_EGSDUS2B1TarRich DIUMPR_St.FId_EtaEngIdleNonCsers DIUMPR_St.FId_EtaEngPtlNonCsers DIUMPR_St.FId_HEGOS2B1DHtg DIUMPR_St.FId_InhbLamDynS1B1 DIUMPR_St.FId_IntkAirTIntkMnfldCrssChk DIUMPR_St.FId_IntkAirTIntkMnfldPlausChk DIUMPR_St.FId_PEnvPlausDiagVDD DIUMPR_St.FId_P_VSE11_Diag DIUMPR_St.FId_TWCDPriCatParB1 DIUMPR_St.FId_TiOffTBasdChkFast DIUMPR_St.FId_TiOffTBasdChkSlow DIUMPR_St.FId_UEGOPrmntDiagS1B1 DIUMPR_St.FId_VlvLftFbSwtIntk11Diag DIUMPR_stCldStrtDen DIUMPR_stCldStrtMon DIUMPR_stEnaDenom DIUMPR_stFIdCldStrtDenom_mp DIUMPR_stFIdGenDenom_mp DIUMPR_tiEngOpCum DIUMPR_tiIdl DIUMPR_tiVehSpdCum /end LOC_MEASUREMENT
 FUNCTION_VERSION "30000.50.0" /end FUNCTION
/begin FUNCTION DKRS "7.8.0     Diagnosis; knock sensor"
 /begin DEF_CHARACTERISTIC CWDKS IKCtl_facDgnsLowrThd_GT IKCtl_facDgnsUpprThd_GT IKCtl_facNDiagMax IKCtl_facNDiagMin IKCtl_nLowrThdDiag IKCtl_nUpprThdDiag IKCtl_uThdLooseCnctnDiag KRFHKS KRZYLDIAG TEHLPKS /end DEF_CHARACTERISTIC
 /begin REF_CHARACTERISTIC IKCtl_idxAsgnSnsr_CA IKCtl_nEngVar13_X_AX /end REF_CHARACTERISTIC
 /begin IN_MEASUREMENT DSM_TripChgFinshd Epm_nEng IKCtl_flgDiagEna IKCtl_flgKnkEna IKCtl_flgLoadDynDetn IKCtl_flgSpdDynDetn IKCtl_stInjDTot_b8 IKCtl_wIntgRef_au32 SyC_ctPostDrvLeave SyC_stSub /end IN_MEASUREMENT
 /begin OUT_MEASUREMENT B_dksc_msg ehlpks_sc_msg IKCtl_flgDiagActv /end OUT_MEASUREMENT
 /begin LOC_MEASUREMENT B_ds2 ehlpks_max ehlpks_maxold ehlpks_min IKCtl_ctReIniDKRS kcsdeb udksoa_w udkssua_w udksua_w xzheil xzsen /end LOC_MEASUREMENT
 FUNCTION_VERSION "7.8.0" /end FUNCTION
/begin FUNCTION DKRSA "2.9.0     diagnosis knock detection signal evaluation" /begin DEF_CHARACTERISTIC CWDKRSA DKRSAM DKRSAS /end DEF_CHARACTERISTIC /begin IN_MEASUREMENT DSM_TripChgFinshd Epm_numCyl Epm_stOpMode SyC_stSub /end IN_MEASUREMENT
 /begin OUT_MEASUREMENT IKCtl_flgWinMeas IKCtl_krrlsdiag IKCtl_krstdiag IKCtl_MeasWinChkRls /end OUT_MEASUREMENT
 /begin LOC_MEASUREMENT B_hlpkrsme B_hlpkrsmz B_hlpkrsse B_hlpkrssz B_krensam B_krensas IKCtl_flgDsmClrDKRSASyncS1 IKCtl_stReIniDKRSA zdkrsam zdkrsas_w zkrdisam zkrdisas_w zkrzsam zkrzsas /end LOC_MEASUREMENT
 FUNCTION_VERSION "2.9.0" /end FUNCTION
/begin FUNCTION DKVS "30001.19.0_1.3.0Diagnosis; plausibility test fuel supply system"
 /begin DEF_CHARACTERISTIC DFRAESTAB DFRASTAB DFRMSTAB DORAESTAB DORASTAB FlMA_tiAddAdpnStabTstrReq_C FRADN FRADNFA FRADX FRADXFA ORADN ORADNFA ORADX ORADXFA SDFRA SDORA TEFRA TEORA TFRA TLRASTMN TORA ZKDFRM /end DEF_CHARACTERISTIC
 /begin IN_MEASUREMENT B_abor_msg B_fvlra_msg B_lrafra_msg B_lraora_msg B_nofra_msg B_noora_msg B_refrast_msg B_reorast_msg Com_flgLETORATmrThd dfrmk_w_msg FlMA_flgDSMClrLRAEB FlMA_flgFncRqstMixAdpn FlMA_flgIninFinshdAckd FlMA_flgIninTrig frai_w_msg frak_w_msg orai_w_msg orak_w_msg /end IN_MEASUREMENT
 /begin OUT_MEASUREMENT B_edkvs_msg B_eframax_msg B_eframin_msg B_efra_msg B_eoramax_msg B_eoramin_msg B_eora_msg B_fdgser_msg B_frastab_msg B_fstabzs_msg B_gaefra_msg B_gaeing_msg B_gaeora_msg B_gae_msg B_odgser_msg B_orastab_msg B_ostabzs_msg B_zfra_msg B_zora_msg /end OUT_MEASUREMENT
 /begin LOC_MEASUREMENT B_efmn B_efmx B_eomn B_eomx B_frast B_orast dfrmkf_w dkvsorai_w DKVS_flgDSMClrFra DKVS_flgDSMClrOra FlMA_flgDSMClrDKVS fmn_w fmx_w fraiov_w frairef_w FRASTTIMER.time oraiov_w orairef_w ORASTTIMER.time tfrastmn torastmn /end LOC_MEASUREMENT
 FUNCTION_VERSION "30001.19.0_1.3.0" /end FUNCTION
/begin FUNCTION DKVSDFC "30001.8.0 DFC fault memory connection of %DKVS" /begin DEF_CHARACTERISTIC TOFEORAFFR /end DEF_CHARACTERISTIC
 /begin IN_MEASUREMENT B_cdkvs_msg B_eframax_msg B_eframin_msg B_eoramax_msg B_eoramin_msg B_fdgser_msg B_fstabzs_msg B_lrare_msg B_orastab_msg B_zfra_msg B_zora_msg FlMA_flgIninFinshdAckd FlMA_flgIninTrig /end IN_MEASUREMENT
 /begin LOC_MEASUREMENT B_fmaxmil B_fminmil B_fraerr B_lraerr B_lraheal B_omaxmil B_ominmil B_oraerr /end LOC_MEASUREMENT
 FUNCTION_VERSION "30001.8.0" /end FUNCTION
/begin FUNCTION DLLR "1.50.0    Diagnosis: idle speed control, recognising a blocked actuator"
 /begin DEF_CHARACTERISTIC CWDLLR CWDLLR2 DLLR_nDiagTestOfs_C DLLR_nDifActvnCSERS_C DLLR_nMnErrThdCatHeatgDrv_GT DLLR_nMnErrThdCatHeatg_GT DLLR_nMxErrThdCatHeatgDrv_GT DLLR_nMxErrThdCatHeatg_GT DLLR_stDiagTest_CW DLLR_tEng_Ax DNDLLRO DNDLLROKH DNDLLRU DNDLLRUKH FHDLLR LIGov_rChrgCylLosCH_CUR LIGov_rChrgCylLos_CUR LIGov_stGlbDaExtTrqDemMsk_C TADLLR TDLLFG1 TDLLFGKH TDLLRMN TDLLRMNKH TDLLRMX TDLLRMXKH TDLLRNF TDLLRNFKH TMDLLRKHO TMDLLRKHU TMDLLRO TMDLLRU TNSTDLLR TNSTSTKH /end DEF_CHARACTERISTIC
 /begin IN_MEASUREMENT AirSys_rChrgCyl B_cdllrkh_msg B_cdllr_msg B_fs_msg B_khakt_msg CEngDsT_t DSM_TripChgFinshd EngStrt_bStrtEnd Epm_nEng Epm_stOpMode ExhMgT_flgCatHeatgCsers GlbDa_stTrqDem HLSDem_nMinWoCat HLSDem_nSetPLo nsolcat_msg PEnv_facCorrAlti PT_stTraType RngMod_trqLos SyC_ctPostDrvLeave SyC_stSub tans_msg ThrVlv_flgLimpModeB1 ThrVlv_flgReqFuCutOffB1 tnst_w_msg VehV_v /end IN_MEASUREMENT
 /begin OUT_MEASUREMENT B_dllrakt_msg B_dllrfgw_msg B_dllrfg_msg B_dllrh_msg B_dllrkha_msg B_dllrkh_msg B_esmnllr_msg B_esmxllr_msg DLLR_flgVehVCond /end OUT_MEASUREMENT
 /begin LOC_MEASUREMENT B_clllrh B_clllrkh B_dllrebd B_ednllrh B_ednllrkh B_edxllrh B_edxllrkh B_hldllrh B_hldllrkh B_pybllr B_pybllrkh DLLR_ctReIni DLLR_flgChrgThdMinDiag DLLR_flgCSERSIdleDiagActvn DLLR_flgGnrlActvn DLLR_flgNonCSERSIdleDiagActvn DLLR_flgNoTqDmd DLLR_flgTstrActv DLLR_flgVomActvn DLLR_nDif DLLR_nDifCatHeatg DLLR_nMnErrThd DLLR_nMnThdCatHeatg DLLR_nMxErrThd DLLR_nMxThdCatHeatg /end LOC_MEASUREMENT
 FUNCTION_VERSION "1.50.0" /end FUNCTION
/begin FUNCTION DLLRIR "1.26.0    IUMPR-functionality for DLLR" /begin DEF_CHARACTERISTIC TDLKHNUM TDLLRNUM /end DEF_CHARACTERISTIC /begin REF_CHARACTERISTIC LIGov_stGlbDaExtTrqDemMsk_C /end REF_CHARACTERISTIC
 /begin IN_MEASUREMENT B_cdllrkh_msg B_cdllr_msg B_dllrh_msg B_dllrkh_msg B_khakt_msg DLLR_flgVehVCond DSM_TripChgFinshd EngStrt_bStrtEnd ExhMgT_flgCatHeatgCsers GlbDa_stTrqDem HLSDem_nMinWoCat nsolcat_msg SyC_ctPostDrvLeave /end IN_MEASUREMENT
 /begin LOC_MEASUREMENT B_dllrhon B_dllrkhon DLLRIR_bActvDenomCatHeatg DLLRIR_bActvDenomHom DLLRIR_ctReIni DLLRIR_flgDfcHomTstd DLLRIR_flgDfcKhTstd DLLRIR_flgReIniReq DLLRIR_tiDenomCatHeatg DLLRIR_tiDenomHom /end LOC_MEASUREMENT
 FUNCTION_VERSION "1.26.0" /end FUNCTION
/begin FUNCTION DMBEG "2.10.0_159.0.0Diagnosis torque limitation level 1"
 /begin DEF_CHARACTERISTIC PthSet_stDia_CW PthSet_tiMonLimDiaErr_C PthSet_tiMonLimDiaHeal_C /end DEF_CHARACTERISTIC
 /begin IN_MEASUREMENT CoEng_stMai PthLead_stActvMonLim PthSet_stActvMonLim /end IN_MEASUREMENT
 /begin LOC_MEASUREMENT MDBmax_flgErrClr /end LOC_MEASUREMENT
 FUNCTION_VERSION "2.10.0_159.0.0" /end FUNCTION
/begin FUNCTION DOGov_TrqCalc "1.14.0    Controller-based Drive-Off Support"
 /begin DEF_CHARACTERISTIC DOGov_dtrqDttme_C DOGov_dtrqThres_CUR DOGov_facFdbk_C DOGov_facOvrSpd_C DOGov_facRmpOff_GCUR DoGov_facTqLead_M DOGov_facTqSet_M DOGov_flgSwtNGrdt_C DOGov_KClthPos_C DOGov_KiMod_CUR DOGov_KpLead_GCUR DOGov_Kp_GCUR DOGov_nDiffThres_CUR DOGov_nEngMax_C DOGov_nOfsMaxAbs_GCUR DOGov_nOfsMax_GCUR DOGov_nOvrSpd_GCUR DOGov_nUndrSpd_GCUR DOGov_n_DST DOGov_rAPP_DST DOGov_rClthAPP_CUR DOGov_rClthDeactvMax_C DOGov_rClthMax_C DOGov_rClthMin_C DOGov_rClthStepDwn_C DOGov_rClthStepUp_C DOGov_stCfg2_CW DOGov_stCfg_CW DOGov_tiAcsDT1_C DOGov_tiActv_C DOGov_tiResvActv_C DOGov_tiThresFlt_C DOGov_trqClthThresCatHeatg_C DOGov_trqClthThresUnsty_C DOGov_trqClthThres_C DOGov_trqDebLead_C DOGov_trqDebSet_C DOGov_trqMaxMon_GMAP DOGov_trqResvMaxRmp_C DoGov_trqResvMin_GCUR DOGov_trqResvOffRmp_C DOGov_trqRmpOff_GCUR DOGov_trqThresSwtUnsty_C DOGov_vMax_C DOGov_vMin_C /end DEF_CHARACTERISTIC
 /begin IN_MEASUREMENT ActMod_trqCrS APP_r Brk_st Clth_st CoETS_bIntvActvDes CoME_trqDesComp Com_rClthPos CoVeh_trqAcs EGSys_bCH Epm_dnEngAvgFlt Epm_dnEngFlt Epm_nEng Epm_nEng10ms HLSDem_nSetPLo LIGov_bEnblI PhyMod_trqDynEng PthSet_stOvrRun PT_rTraV2N PT_stTraType VehV_v /end IN_MEASUREMENT
 /begin OUT_MEASUREMENT DOGov_bActv DOGov_bActvCpl DOGov_rClthPosAvrg DOGov_trqLead DOGov_trqResv DOGov_trqSet /end OUT_MEASUREMENT
 /begin LOC_MEASUREMENT DOGov_bCalc DOGov_bGenRls DOGov_bResv DOGov_dnEngFltLoc DOGov_dnEngFltLocSyncn DOGov_dtrqDttme DOGov_facOvrSpd DOGov_n DOGov_nDiff DOGov_nDifSyncn DOGov_nSetP DOGov_rClthPos DOGov_rClthThresMax DOGov_rClthThresMin DoGov_tqLeadCorrn DoGov_tqLeadRaw DoGov_tqSetCorrn DoGov_tqSetRaw DOGov_trqClth DOGov_trqClth_mp DOGov_trqCompUnsty_mp DOGov_trqMax DOGov_trqMin /end LOC_MEASUREMENT
 FUNCTION_VERSION "1.14.0" /end FUNCTION
/begin FUNCTION DPLPSR "10.22.0   Diagnosis plausibilisation manifold pressure sensor"
 /begin DEF_CHARACTERISTIC DDPSRPSINI DPSRM DPSRMFA DPSRSVMN DPTPSRMX DPUPSINIMX NMOTMNDDSS NMOTZPLMN NPSRSVMN NPSRSVMX PSRMN PSRMX PUPLPSRMN SF_PSR SF_PSR1 TDEPSRB TDEPSRP TDPSRRG TMOTPSSVMN TMOTPSSVMX TNMNPSR TPSINIG TPSRSVMN TPSRSVN WDKPSRSVMN WDKPSRSVMX /end DEF_CHARACTERISTIC
 /begin IN_MEASUREMENT B_psinirg_msg B_psrmnxg_msg B_psrmw_msg B_psrrg_msg CEngDsT_t CEngDsT_tStrt DSM_TripChgFinshd Eep_EnvRamHist Eep_EnvRamInvld Epm_nEng Epm_stSpd ofpu_w_msg PEnv_p psini_w_msg psrmmn_w_msg psrmmx_w_msg psrr_w_msg SyC_stSub ThrVlv_flgReqFuCutOffB1 ThrVlv_flgSngSensErrSuspcB1 ThrVlv_ratActPosnB1 tnse_w_msg /end IN_MEASUREMENT
 /begin OUT_MEASUREMENT B_epsrplmn_msg B_epsrplmx_msg B_heplpsr_msg B_psini_msg B_psrpl_msg B_psrrgmn_msg B_psrrgmx_msg psrrtn_w_msg psrrtx_w_msg /end OUT_MEASUREMENT
 /begin LOC_MEASUREMENT B_dpsrsvmn B_eplpsr B_epsrsv B_fadssATS B_fdpsrb B_fdpsrp B_fpsrplsv B_hepsrmn B_hepsrmx B_hepsrsv B_ncpsrc B_ncpsrr B_nmnpsr B_psrrgtd B_psrsvmn B_psrsvmni B_psrsvmx B_psrsvmxi B_thigh B_zpsrsv fdpsrm_w PIntkVUs_flgMdlPlausErrLoB1 psrmmnf_w psrmmxf_w psrmn_w psrmx_w psrrmnf_w psrrmxf_w /end LOC_MEASUREMENT
 FUNCTION_VERSION "10.22.0" /end FUNCTION
/begin COMPU_METHOD B_TRUE "" TAB_VERB "%6.3" "" COMPU_TAB_REF B_TRUE /end COMPU_METHOD
/begin COMPU_VTAB B_TRUE "" TAB_VERB 2 0 "FALSE" 1 "TRUE" /end COMPU_VTAB
/begin COMPU_METHOD CfgRatio_Verb "" TAB_VERB "%6.3" "-" COMPU_TAB_REF CfgRatio_Verb /end COMPU_METHOD
/begin COMPU_VTAB CfgRatio_Verb "" TAB_VERB 33 0 "FID_BLLRH" 1 "FID_BLLRKH" 2 "FID_BPLSU" 3 "FId_EGSDO2SnsrMntdRelsS1B1" 4 "FID_CETKHL" 5 "FID_CETKHT" 6 "FID_CGLSRDP" 7 "FID_CLZSRDP" 8 "FID_CPSRP" 9 "FId_CEngDsTColdStrt" 10 "FId_CEngDsTLSC" 11 "FId_CEngDsTSTC" 12 "FId_Cj135PerdDiagOperEnaS1B1" 13 "FId_EGSDUS2B1LtrDly" 14 "FId_EGSDUS2B1LtrPT1" 15 "FId_EGSDUS2B1RtlDly" 16 "FId_EGSDUS2B1RtlPT1" 17 "FId_EGSDUS2B1TarLean" 18 "FId_EGSDUS2B1TarRich" 19 "FId_EtaEngIdleNonCsers" 20 "FId_EtaEngPtlNonCsers" 21 "FId_HEGOS2B1DHtg" 22 "FId_InhbLamDynS1B1" 23 "FId_IntkAirTIntkMnfldCrssChk" 24 "FId_IntkAirTIntkMnfldPlausChk" 25 "FId_PEnvPlausDiagVDD" 26 "FId_P_VSE11_Diag" 27 "FId_TWCDPriCatParB1" 28 "FId_TiOffTBasdChkFast" 29 "FId_TiOffTBasdChkSlow" 30 "FId_UEGOPrmntDiagS1B1" 31 "FId_VlvLftFbSwtIntk11Diag" 800 "---" DEFAULT_VALUE "---" /end COMPU_VTAB
/begin COMPU_METHOD dez "" RAT_FUNC "%6.2" "" COEFFS 0 1 0 0 0 1 /end COMPU_METHOD
/begin COMPU_METHOD DFC_Verb "" TAB_VERB "%6.3" "-" COMPU_TAB_REF DFC_Verb /end COMPU_METHOD
/begin COMPU_VTAB DFC_Verb "" TAB_VERB 704 0 "DFC_Unused" 318 "DFC_ACEvpTSRCMax" 319 "DFC_ACEvpTSRCMin" 320 "DFC_AirCClntPAnaSRCMax" 321 "DFC_AirCClntPAnaSRCMin" 259 "DFC_AirCCmprOL" 260 "DFC_AirCCmprOvrTemp" 261 "DFC_AirCCmprSCB" 262 "DFC_AirCCmprSCG" 322 "DFC_AirCSwtNpl" 323 "DFC_AirCSwtSig" 263 "DFC_AltErr" 1 "DFC_AltIOACGFailr" 2 "DFC_AltIOACGHiVltg" 3 "DFC_AltIOACGLoVltg" 4 "DFC_AltIOACGTHi" 5 "DFC_AltIODConnACG" 429 "DFC_AppAllSnsrDfct" 6 "DFC_BattUHiFailr" 7 "DFC_BattULoFailr" 264 "DFC_BattUSRCMax" 265 "DFC_BattUSRCMin" 430 "DFC_BattUStdbyDiaOL" 431 "DFC_BigLeakIntkMnfldEmiInfl" 324 "DFC_Brk" 8 "DFC_BrkBstPDriftHiErr" 9 "DFC_BrkBstPDriftLoErr" 10 "DFC_BrkBstPSnsrStuck" 11 "DFC_BrkMnSwtContOn" 432 "DFC_BrkMnSwtContOnWarnLmp" 12 "DFC_BrkMnSwtNotStp" 433 "DFC_BrkMnSwtNotStpWarnLmp" 13 "DFC_BrkNpl" 14 "DFC_BrkRdntSwtContOn" 434 "DFC_BrkRdntSwtContOnWarnLmp" 15 "DFC_BrkRdntSwtNotStp" 435 "DFC_BrkRdntSwtNotStpWarnLmp" 325 "DFC_BrkSig" 417 "DFC_BSWM_E_ACTION_FAILED" 418 "DFC_BSWM_E_INTRPTQUEUE_FULL" 393 "DFC_BusDiagCANAPPLBusOff" 394 "DFC_BusDiagCANCANCBusOff" 395 "DFC_BusDiagCANVEHICLEBusOff" 411 "DFC_CAN_E_TIMEOUT" 436 "DFC_CEngDsTColdStrtMax" 437 "DFC_CEngDsTColdStrtMin" 438 "DFC_CEngDsTImps" 439 "DFC_CEngDsTPlausLSC" 440 "DFC_CEngDsTPlausSTC" 443 "DFC_CEngDsTSig" 441 "DFC_CEngDsTSRCMax" 442 "DFC_CEngDsTSRCMin" 444 "DFC_CEngUsTSRCMax" 445 "DFC_CEngUsTSRCMin" 366 "DFC_Clth2ONStuck" 367 "DFC_Clth2ONStuckLdc" 16 "DFC_Clth3ONStuck" 368 "DFC_Clth3ONStuckLdc" 369 "DFC_Clth3ONStuckPostDrv" 17 "DFC_Clth4OFFStuck" 370 "DFC_Clth4ONStuck" 371 "DFC_Clth4ONStuckLdc" 236 "DFC_ClthMax" 336 "DFC_ClthNpl" 18 "DFC_ClthOFFStuck" 19 "DFC_ClthONStuck" 326 "DFC_ClthSig" 20 "DFC_ClthStkFailInfo" 21 "DFC_ComACFailInfo" 22 "DFC_ComATFTValErr" 23 "DFC_ComATMILReq" 24 "DFC_ComAYCAChksum" 25 "DFC_ComAYCARingCnt" 26 "DFC_ComAYCATOut" 27 "DFC_ComAYCDChkSum" 28 "DFC_ComAYCDTOut" 29 "DFC_ComAYCFChksum" 30 "DFC_ComAYCFRingCnt" 31 "DFC_ComAYCFTOut" 32 "DFC_ComAYCGChksum" 33 "DFC_ComAYCGRingCnt" 34 "DFC_ComAYCGTOut" 35 "DFC_ComAYCIChkSum" 36 "DFC_ComAYCIRingCnt" 37 "DFC_ComAYCITOut" 38 "DFC_ComBCM1ChkSum" 39 "DFC_ComBCM1RingCnt" 40 "DFC_ComBCM1TOut" 41 "DFC_ComCANABusOffErr" 42 "DFC_ComCANBBusOffErr" 43 "DFC_ComCANCBusOffErr" 44 "DFC_ComCGW1ChkSum" 45 "DFC_ComCGW1RingCnt" 46 "DFC_ComCGW1TOut" 266 "DFC_ComChksTCU1" 267 "DFC_ComChksTCU11" 268 "DFC_ComChksTCU12" 269 "DFC_ComChksTCU13" 270 "DFC_ComChksTCU2" 271 "DFC_ComChksTCU3" 272 "DFC_ComChksTCU4" 273 "DFC_ComCntTCU1" 274 "DFC_ComCntTCU11" 275 "DFC_ComCntTCU12" 276 "DFC_ComCntTCU13" 277 "DFC_ComCntTCU2" 278 "DFC_ComCntTCU3" 279 "DFC_ComCntTCU4" 47 "DFC_ComConvBoostErr" 48 "DFC_ComConvSlipErr" 372 "DFC_ComDLCTCU01" 373 "DFC_ComDLCTCU02" 374 "DFC_ComDLCTCU1" 375 "DFC_ComDLCTCU11" 376 "DFC_ComDLCTCU12" 377 "DFC_ComDLCTCU13" 378 "DFC_ComDLCTCU14" 379 "DFC_ComDLCTCU2" 380 "DFC_ComDLCTCU3" 381 "DFC_ComDLCTCU4" 49 "DFC_ComEAT10Chksum" 50 "DFC_ComEAT10RingCnt" 51 "DFC_ComEAT10TOut" 52 "DFC_ComEAT11ChkSum" 53 "DFC_ComEAT11RingCnt" 54 "DFC_ComEAT11TOut" 55 "DFC_ComEAT12ChkSum" 56 "DFC_ComEAT12RingCnt" 57 "DFC_ComEAT12TOut" 58 "DFC_ComEAT13ChkSum" 59 "DFC_ComEAT13RingCnt" 60 "DFC_ComEAT13TOut" 61 "DFC_ComEAT1Chksum" 62 "DFC_ComEAT1RingCnt" 63 "DFC_ComEAT1TOut" 64 "DFC_ComEAT2ChkSum" 65 "DFC_ComEAT2RingCnt" 66 "DFC_ComEAT2TOut" 67 "DFC_ComEAT4ChkSum" 68 "DFC_ComEAT4RingCnt" 69 "DFC_ComEAT4TOut" 70 "DFC_ComEAT6Chksum" 71 "DFC_ComEAT6RingCnt" 72 "DFC_ComEAT6TOut" 73 "DFC_ComEAT7Chksum" 74 "DFC_ComEAT7RingCnt" 75 "DFC_ComEAT7TOut" 76 "DFC_ComEAT8Chksum" 77 "DFC_ComEAT8RingCnt" 78 "DFC_ComEAT8TOut" 79 "DFC_ComEATAChksum" 80 "DFC_ComEATARingCnt" 81 "DFC_ComEATATOut" 82 "DFC_ComEATBChkSum" 83 "DFC_ComEATBRingCnt" 84 "DFC_ComEATBTOut" 85 "DFC_ComEATCChksum" 86 "DFC_ComEATCRingCnt" 87 "DFC_ComEATCTOut" 88 "DFC_ComEBBAChksum" 89 "DFC_ComEBBARingCnt" 90 "DFC_ComEBBATOut" 94 "DFC_ComEngCanRxErr" 91 "DFC_ComEPS1Chksum" 92 "DFC_ComEPS1RingCnt" 93 "DFC_ComEPS1TOut" 95 "DFC_ComGrvySnsrErr" 96 "DFC_ComGwIMG1ChkSum" 97 "DFC_ComGwIMG1RingCnt" 98 "DFC_ComGwIMG1TOut" 99 "DFC_ComGwIMG3ChkSum" 100 "DFC_ComGwIMG3RingCnt" 101 "DFC_ComGwIMG3TOut" 102 "DFC_ComGwIMG4ChkSum" 103 "DFC_ComGwIMG4RingCnt" 104 "DFC_ComGwIMG4TOut" 105 "DFC_ComGwIMG5ChkSum" 106 "DFC_ComGwIMG5RingCnt" 107 "DFC_ComGwIMG5TOut" 108 "DFC_ComGwIMG6ChkSum" 109 "DFC_ComGwIMG6RingCnt" 110 "DFC_ComGwIMG6TOut" 111 "DFC_ComIDASBChksum" 112 "DFC_ComIDASBRingCnt" 113 "DFC_ComIDASBTOut" 114 "DFC_ComIMGMILReq" 115 "DFC_ComISSPrms" 116 "DFC_ComMETAChksum" 117 "DFC_ComMETARingCnt" 118 "DFC_ComMETATOut" 119 "DFC_ComMETCChksum" 120 "DFC_ComMETCRingCnt" 121 "DFC_ComMETCTOut" 122 "DFC_ComMETDChksum" 123 "DFC_ComMETDRingCnt" 124 "DFC_ComMETDTOut" 125 "DFC_ComMETE2Chksum" 126 "DFC_ComMETE2RingCnt" 127 "DFC_ComMETE2TOut" 128 "DFC_ComMETFChksum" 129 "DFC_ComMETFRingCnt" 130 "DFC_ComMETFTOut" 131 "DFC_ComMETGChksum" 132 "DFC_ComMETGRingCnt" 133 "DFC_ComMETGTOut" 134 "DFC_ComMETH2Chksum" 135 "DFC_ComMETH2RingCnt" 136 "DFC_ComMETH2TOut" 137 "DFC_ComMETHChksum" 138 "DFC_ComMETHRingCnt" 139 "DFC_ComMETHTOut" 140 "DFC_ComMETIChksum" 141 "DFC_ComMETIRingCnt" 142 "DFC_ComMETITOut" 143 "DFC_ComMETKChksum" 144 "DFC_ComMETKRingCnt" 145 "DFC_ComMETKTOut" 146 "DFC_ComMETLChksum" 147 "DFC_ComMETLRingCnt" 148 "DFC_ComMETLTOut" 149 "DFC_ComMETMChksum" 150 "DFC_ComMETMRingCnt" 151 "DFC_ComMETMTOut" 152 "DFC_ComMETNChksum" 153 "DFC_ComMETNRingCnt" 154 "DFC_ComMETNTOut" 155 "DFC_ComMtrCom" 156 "DFC_ComPCUChkSum" 157 "DFC_ComPCURingCnt" 158 "DFC_ComPCUTOut" 159 "DFC_ComSRSAChksum" 160 "DFC_ComSRSARingCnt" 161 "DFC_ComSRSATOut" 162 "DFC_ComSRSBChksum" 163 "DFC_ComSRSBRingCnt" 164 "DFC_ComSRSBTOut" 165 "DFC_ComSRSChksum" 166 "DFC_ComSRSErr" 167 "DFC_ComSRSRingCnt" 168 "DFC_ComSRSTOut" 280 "DFC_ComTOutTCU01" 281 "DFC_ComTOutTCU02" 282 "DFC_ComTOutTCU1" 283 "DFC_ComTOutTCU11" 284 "DFC_ComTOutTCU12" 285 "DFC_ComTOutTCU13" 286 "DFC_ComTOutTCU14" 287 "DFC_ComTOutTCU2" 288 "DFC_ComTOutTCU3" 289 "DFC_ComTOutTCU4" 169 "DFC_ComVehSpdPndFltTCU" 446 "DFC_DCDCFltDet" 290 "DFC_DevLibBattUHi" 291 "DFC_DevLibBattULo" 449 "DFC_DKnpl" 447 "DFC_DKRSA" 448 "DFC_DKVSmax" 450 "DFC_DSSmax" 451 "DFC_DSTTI" 452 "DFC_DSUmax" 170 "DFC_EbsChartcCurrErr" 171 "DFC_EbsSelfDiagErr" 383 "DFC_EbsSocFlt" 453 "DFC_EGRVlvOL" 454 "DFC_EGRVlvSCB" 455 "DFC_EGRVlvSCG" 456 "DFC_EGSDUS2B1LtrDly" 457 "DFC_EGSDUS2B1LtrPT1" 458 "DFC_EGSDUS2B1RtlDly" 459 "DFC_EGSDUS2B1RtlPT1" 460 "DFC_EGSDUS2B1TarLean" 461 "DFC_EGSDUS2B1TarRich" 464 "DFC_EngICO" 465 "DFC_EngPrtOvrSpdMon" 466 "DFC_EpmCaSI1ErrSig" 467 "DFC_EpmCaSI1NoSig" 468 "DFC_EpmCaSI1OfsErr" 469 "DFC_EpmCrSErrSig" 470 "DFC_EpmCrSNoSig" 471 "DFC_EtaEngIdleNonCsers" 472 "DFC_EtaEngPtlNonCsers" 462 "DFC_ETAKHLmax" 463 "DFC_ETAKHTmax" 337 "DFC_EV1max" 338 "DFC_EV1min" 339 "DFC_EV1sig" 340 "DFC_EV2max" 341 "DFC_EV2min" 342 "DFC_EV2sig" 343 "DFC_EV3max" 344 "DFC_EV3min" 345 "DFC_EV3sig" 346 "DFC_EV4max" 347 "DFC_EV4min" 348 "DFC_EV4sig" 382 "DFC_EVX" 292 "DFC_FanDIOOL_0" 293 "DFC_FanDIOOL_1" 294 "DFC_FanDIOOvrTemp_0" 295 "DFC_FanDIOOvrTemp_1" 296 "DFC_FanDIOSCB_0" 297 "DFC_FanDIOSCB_1" 298 "DFC_FanDIOSCG_0" 299 "DFC_FanDIOSCG_1" 473 "DFC_FRAmax" 474 "DFC_FRAmin" 172 "DFC_GbxCANDigPlausErr" 173 "DFC_GbxNPos1SRCMax" 174 "DFC_GbxNPos1SRCMin" 175 "DFC_GbxNPos2SRCMax" 176 "DFC_GbxNPos2SRCMin" 177 "DFC_GbxNPosAlvChk" 178 "DFC_GbxNPosSyncErr" 349 "DFC_GbxPNPosnDrvCdn" 350 "DFC_GbxPNPosnPlausy" 475 "DFC_GbxRvsSwtStk" 476 "DFC_HDRmax" 477 "DFC_HEGOS2B1ElecMax" 478 "DFC_HEGOS2B1ElecMin" 479 "DFC_HEGOS2B1ElecSig" 480 "DFC_HEGOS2B1HtgNpl" 179 "DFC_HEGOS2B1HtrPsMax" 180 "DFC_HEGOS2B1HtrPsMin" 181 "DFC_HEGOS2B1HtrPsSig" 327 "DFC_HLSDemOvhtEngLim" 384 "DFC_I14229VINErr" 237 "DFC_IgnClPs_DevComErr" 238 "DFC_IgnClPs_LineOl_0" 239 "DFC_IgnClPs_LineOl_1" 240 "DFC_IgnClPs_LineOl_2" 241 "DFC_IgnClPs_LineOl_3" 242 "DFC_IgnClPs_LineScb_0" 243 "DFC_IgnClPs_LineScb_1" 244 "DFC_IgnClPs_LineScb_2" 245 "DFC_IgnClPs_LineScb_3" 246 "DFC_IgnClPs_LineScg_0" 247 "DFC_IgnClPs_LineScg_1" 248 "DFC_IgnClPs_LineScg_2" 249 "DFC_IgnClPs_LineScg_3" 481 "DFC_IntkAirTIntkMnfldCrssMax" 482 "DFC_IntkAirTIntkMnfldCrssMin" 483 "DFC_IntkAirTIntkMnfldHSCMax" 484 "DFC_IntkAirTIntkMnfldImps" 485 "DFC_IntkAirTIntkMnfldPRCMax" 486 "DFC_IntkAirTIntkMnfldPRCMin" 487 "DFC_IntkAirTIntkMnfldSRCMax" 488 "DFC_IntkAirTIntkMnfldSRCMin" 489 "DFC_IntkAirTIntkMnfldSTC" 362 "DFC_KnDetSens1PortAMax" 363 "DFC_KnDetSens1PortAMin" 364 "DFC_KnDetSens1PortBMax" 365 "DFC_KnDetSens1PortBMin" 490 "DFC_KS1max" 491 "DFC_KS1min" 494 "DFC_LamDynDiagS1B1" 495 "DFC_LeakIntkMnfldEmiInfl" 412 "DFC_LIN_E_TIMEOUT" 182 "DFC_LinCSErrACG" 183 "DFC_LinCSErrEBS" 184 "DFC_LinHdrTimeoutErrACG" 185 "DFC_LinHdrTimeoutErrEBS" 186 "DFC_LinMsgTimeoutErrACG" 187 "DFC_LinMsgTimeoutErrEBS" 188 "DFC_LinNoStrtComErr" 385 "DFC_LLRKHmax" 386 "DFC_LLRKHmin" 387 "DFC_LLRmax" 388 "DFC_LLRmin" 492 "DFC_LMmax" 493 "DFC_LZSRnpl" 496 "DFC_MD00max" 497 "DFC_MDBmax" 498 "DFC_MDCat" 499 "DFC_MDCatCrit" 500 "DFC_MDCatCurr" 501 "DFC_MDCyl_0" 502 "DFC_MDCyl_1" 503 "DFC_MDCyl_2" 504 "DFC_MDCyl_3" 505 "DFC_MDEmi" 506 "DFC_MDEmiStrt" 507 "DFC_MDFco" 510 "DFC_MDmax" 508 "DFC_MDMpl" 509 "DFC_MDSegTiAdpn" 205 "DFC_MisfDetdVWhlFrntLePlaus" 206 "DFC_MisfDetdVWhlFrntRiPlaus" 207 "DFC_MisfDetdVWhlReLePlaus" 208 "DFC_MisfDetdVWhlReRiPlaus" 189 "DFC_MisfDetVWhlFrntLeOORHi" 190 "DFC_MisfDetVWhlFrntLeRatyHi" 191 "DFC_MisfDetVWhlFrntLeRatyLo" 192 "DFC_MisfDetVWhlFrntLeStuck" 193 "DFC_MisfDetVWhlFrntRiOORHi" 194 "DFC_MisfDetVWhlFrntRiRatyHi" 195 "DFC_MisfDetVWhlFrntRiRatyLo" 196 "DFC_MisfDetVWhlFrntRiStuck" 197 "DFC_MisfDetVWhlReLeOORHi" 198 "DFC_MisfDetVWhlReLeRatyHi" 199 "DFC_MisfDetVWhlReLeRatyLo" 200 "DFC_MisfDetVWhlReLeStuck" 201 "DFC_MisfDetVWhlReRiOORHi" 202 "DFC_MisfDetVWhlReRiRatyHi" 203 "DFC_MisfDetVWhlReRiRatyLo" 204 "DFC_MisfDetVWhlReRiStuck" 605 "DFC_MoCADCNTP" 606 "DFC_MoCADCTst" 607 "DFC_MoCSOPICO" 609 "DFC_MoFAirFilgPrdc" 610 "DFC_MoFAirFlCtOffPfi" 611 "DFC_MoFAirFlCylPfi" 612 "DFC_MoFAirFlIn" 613 "DFC_MoFAirFlMixCtlPfiChkAirFl" 614 "DFC_MoFAirFlMixCtlPfiChkCtrl" 615 "DFC_MoFAirFlMode" 608 "DFC_MoFAPP" 616 "DFC_MoFESpd" 617 "DFC_MoFIACo" 618 "DFC_MoFICOL1" 619 "DFC_MoFICOL2" 620 "DFC_MoFStrt" 621 "DFC_MoFTrqCmp" 622 "DFC_MoFTrqCmpMax" 623 "DFC_MoFTrqCmpMin" 624 "DFC_MoFVarPostBldSel" 511 "DFC_MOXEMM_SMU_ALM0_0" 512 "DFC_MOXEMM_SMU_ALM0_1" 513 "DFC_MOXEMM_SMU_ALM0_10" 514 "DFC_MOXEMM_SMU_ALM0_11" 515 "DFC_MOXEMM_SMU_ALM0_13" 516 "DFC_MOXEMM_SMU_ALM0_14" 517 "DFC_MOXEMM_SMU_ALM0_2" 518 "DFC_MOXEMM_SMU_ALM0_22" 519 "DFC_MOXEMM_SMU_ALM0_23" 520 "DFC_MOXEMM_SMU_ALM0_4" 521 "DFC_MOXEMM_SMU_ALM0_5" 522 "DFC_MOXEMM_SMU_ALM0_7" 523 "DFC_MOXEMM_SMU_ALM0_8" 524 "DFC_MOXEMM_SMU_ALM10_16" 525 "DFC_MOXEMM_SMU_ALM10_17" 526 "DFC_MOXEMM_SMU_ALM10_21" 527 "DFC_MOXEMM_SMU_ALM11_0" 528 "DFC_MOXEMM_SMU_ALM11_1" 529 "DFC_MOXEMM_SMU_ALM11_2" 530 "DFC_MOXEMM_SMU_ALM11_3" 531 "DFC_MOXEMM_SMU_ALM11_4" 532 "DFC_MOXEMM_SMU_ALM11_5" 533 "DFC_MOXEMM_SMU_ALM11_8" 534 "DFC_MOXEMM_SMU_ALM11_9" 535 "DFC_MOXEMM_SMU_ALM1_0" 536 "DFC_MOXEMM_SMU_ALM1_1" 537 "DFC_MOXEMM_SMU_ALM1_10" 538 "DFC_MOXEMM_SMU_ALM1_11" 539 "DFC_MOXEMM_SMU_ALM1_13" 540 "DFC_MOXEMM_SMU_ALM1_14" 541 "DFC_MOXEMM_SMU_ALM1_2" 542 "DFC_MOXEMM_SMU_ALM1_22" 543 "DFC_MOXEMM_SMU_ALM1_23" 544 "DFC_MOXEMM_SMU_ALM1_4" 545 "DFC_MOXEMM_SMU_ALM1_5" 546 "DFC_MOXEMM_SMU_ALM1_7" 547 "DFC_MOXEMM_SMU_ALM1_8" 548 "DFC_MOXEMM_SMU_ALM21_0" 549 "DFC_MOXEMM_SMU_ALM21_16" 550 "DFC_MOXEMM_SMU_ALM21_3" 551 "DFC_MOXEMM_SMU_ALM2_1" 552 "DFC_MOXEMM_SMU_ALM2_10" 553 "DFC_MOXEMM_SMU_ALM2_11" 554 "DFC_MOXEMM_SMU_ALM2_13" 555 "DFC_MOXEMM_SMU_ALM2_14" 556 "DFC_MOXEMM_SMU_ALM2_22" 557 "DFC_MOXEMM_SMU_ALM2_23" 558 "DFC_MOXEMM_SMU_ALM2_4" 559 "DFC_MOXEMM_SMU_ALM2_5" 560 "DFC_MOXEMM_SMU_ALM2_7" 561 "DFC_MOXEMM_SMU_ALM2_8" 562 "DFC_MOXEMM_SMU_ALM6_0" 563 "DFC_MOXEMM_SMU_ALM6_11" 564 "DFC_MOXEMM_SMU_ALM6_12" 565 "DFC_MOXEMM_SMU_ALM6_14" 566 "DFC_MOXEMM_SMU_ALM6_15" 567 "DFC_MOXEMM_SMU_ALM6_17" 568 "DFC_MOXEMM_SMU_ALM6_18" 569 "DFC_MOXEMM_SMU_ALM6_20" 570 "DFC_MOXEMM_SMU_ALM6_21" 571 "DFC_MOXEMM_SMU_ALM6_25" 572 "DFC_MOXEMM_SMU_ALM6_4" 573 "DFC_MOXEMM_SMU_ALM6_5" 574 "DFC_MOXEMM_SMU_ALM6_7" 575 "DFC_MOXEMM_SMU_ALM6_8" 576 "DFC_MOXEMM_SMU_ALM7_1" 577 "DFC_MOXEMM_SMU_ALM7_12" 578 "DFC_MOXEMM_SMU_ALM7_13" 579 "DFC_MOXEMM_SMU_ALM7_14" 580 "DFC_MOXEMM_SMU_ALM7_15" 581 "DFC_MOXEMM_SMU_ALM7_16" 582 "DFC_MOXEMM_SMU_ALM7_17" 583 "DFC_MOXEMM_SMU_ALM7_2" 584 "DFC_MOXEMM_SMU_ALM7_20" 585 "DFC_MOXEMM_SMU_ALM7_25" 586 "DFC_MOXEMM_SMU_ALM7_26" 587 "DFC_MOXEMM_SMU_ALM7_28" 588 "DFC_MOXEMM_SMU_ALM7_29" 589 "DFC_MOXEMM_SMU_ALM7_30" 590 "DFC_MOXEMM_SMU_ALM7_31" 591 "DFC_MOXEMM_SMU_ALM8_0" 592 "DFC_MOXEMM_SMU_ALM8_1" 593 "DFC_MOXEMM_SMU_ALM8_10" 594 "DFC_MOXEMM_SMU_ALM8_11" 595 "DFC_MOXEMM_SMU_ALM8_12" 596 "DFC_MOXEMM_SMU_ALM8_16" 597 "DFC_MOXEMM_SMU_ALM8_18" 598 "DFC_MOXEMM_SMU_ALM8_2" 599 "DFC_MOXEMM_SMU_ALM8_3" 600 "DFC_MOXEMM_SMU_ALM8_31" 601 "DFC_MOXEMM_SMU_ALM8_4" 602 "DFC_MOXEMM_SMU_ALM9_0" 603 "DFC_MOXEMM_SMU_ALM9_15" 604 "DFC_MOXEMM_SMU_ALM9_3" 625 "DFC_MoXEMMHwLTMCUFW" 626 "DFC_MoXEMMHwLTMonBIST" 627 "DFC_MoXEMMHwLTRegMonTest" 628 "DFC_MoXEMMHwLTStbySMUAlvTest" 629 "DFC_MoXEMMHwLTTempSens" 630 "DFC_MoXEMMHwLTUCBCfg" 300 "DFC_MRlyDcOL" 301 "DFC_MRlyDcSCB" 302 "DFC_MRlyDcSCG" 413 "DFC_MRlyOL" 414 "DFC_MRlySCB" 415 "DFC_MRlySCG" 631 "DFC_OCWDAABEActv" 632 "DFC_OCWDACom" 633 "DFC_OCWDAErrPin" 634 "DFC_OCWDAOvrVltg" 328 "DFC_OilPNpl" 635 "DFC_ORAmax" 636 "DFC_ORAmin" 647 "DFC_P_VSE11_OL" 648 "DFC_P_VSE11_SCB" 649 "DFC_P_VSE11_SCG" 351 "DFC_PEnvCcMax" 352 "DFC_PEnvCcMin" 353 "DFC_PEnvRngChkMax" 354 "DFC_PEnvRngChkMin" 209 "DFC_PEnvSigRngMax" 210 "DFC_PEnvSigRngMin" 355 "DFC_PEnvSnsrPlaus" 650 "DFC_PhyHighAPP1" 651 "DFC_PhyHighAPP2" 652 "DFC_PhyLowAPP1" 653 "DFC_PhyLowAPP2" 329 "DFC_PIntkVUsLineHiB1" 330 "DFC_PIntkVUsLineLoB1" 637 "DFC_PLLSUmax" 638 "DFC_PLLSUmin" 303 "DFC_PSPOL" 304 "DFC_PSPOvrTemp" 305 "DFC_PSPSCB" 306 "DFC_PSPSCG" 639 "DFC_PSR1max" 640 "DFC_PSRBmax" 641 "DFC_PSRBmin" 645 "DFC_PSRmax" 642 "DFC_PSRPmax" 643 "DFC_PSRPmin" 644 "DFC_PSRPsig" 646 "DFC_PUmax" 396 "DFC_RBA_IODIAGPWR_rba_IoExtCy329_SignalVltSply_0" 397 "DFC_RBA_IODIAGPWR_rba_IoExtCy329_SignalVltSply_0OT" 398 "DFC_RBA_IODIAGPWR_rba_IoExtCy329_SignalVltSply_0OV" 399 "DFC_RBA_IODIAGPWR_rba_IoExtCy329_SignalVltSply_0SCG" 400 "DFC_RBA_IODIAGPWR_rba_IoExtCy329_SignalVltSply_0UV" 401 "DFC_RBA_IODIAGPWR_rba_IoExtCy329_SignalVltSply_1" 402 "DFC_RBA_IODIAGPWR_rba_IoExtCy329_SignalVltSply_1OT" 403 "DFC_RBA_IODIAGPWR_rba_IoExtCy329_SignalVltSply_1OV" 404 "DFC_RBA_IODIAGPWR_rba_IoExtCy329_SignalVltSply_1SCG" 405 "DFC_RBA_IODIAGPWR_rba_IoExtCy329_SignalVltSply_1UV" 406 "DFC_RBA_IODIAGPWR_rba_IoExtCy329_SignalVltSply_2" 407 "DFC_RBA_IODIAGPWR_rba_IoExtCy329_SignalVltSply_2OT" 408 "DFC_RBA_IODIAGPWR_rba_IoExtCy329_SignalVltSply_2OV" 409 "DFC_RBA_IODIAGPWR_rba_IoExtCy329_SignalVltSply_2SCG" 410 "DFC_RBA_IODIAGPWR_rba_IoExtCy329_SignalVltSply_2UV" 419 "DFC_RBA_IOEXTLIB_KEEPALIVE_DRV" 420 "DFC_RBA_IOEXTLIB_KEEPALIVE_INI" 421 "DFC_rba_IoSigRtc_StopCounter" 423 "DFC_rba_MemDiag_MemReadErr" 424 "DFC_rba_MemDiag_MemWrErr" 422 "DFC_rba_MRly_Diag_Stk_Event" 416 "DFC_rba_MultiStackTrace_Threshold" 425 "DFC_rba_SyC_IrrSwOffTrigEngRun_Event" 426 "DFC_rba_T15_Diag_ComInVld_Event" 427 "DFC_rba_T15_Diag_ComOff_HwOn_Event" 428 "DFC_rba_T15_Diag_ComOn_HwOff_Event" 389 "DFC_RoughRoad" 390 "DFC_SiaEEPRdErr" 391 "DFC_SiaEEPWrngCod" 654 "DFC_SRCHighAPP1" 655 "DFC_SRCHighAPP2" 656 "DFC_SRCLowAPP1" 657 "DFC_SRCLowAPP2" 658 "DFC_SSpMon2" 211 "DFC_StmFault" 213 "DFC_StrtCtlErr" 212 "DFC_StrtCtOffPth" 214 "DFC_StrtFault" 215 "DFC_StrtLckJudg1" 216 "DFC_StrtLckJudg2" 217 "DFC_StrtOL" 218 "DFC_StrtOL2" 219 "DFC_StrtSCB" 220 "DFC_StrtSCB2" 221 "DFC_StrtSCG" 222 "DFC_StrtSCG2" 223 "DFC_StrtStkRly1" 224 "DFC_StrtStkRly2" 659 "DFC_SWReset_0" 660 "DFC_SWReset_1" 661 "DFC_SWReset_2" 662 "DFC_SyncAPP" 307 "DFC_T50Err" 663 "DFC_TAmax_Dummy" 225 "DFC_TEVEmax" 226 "DFC_TEVEmin" 227 "DFC_TEVEsig" 671 "DFC_ThrVlvClsdPosnFirstOffsLrnImpoB1" 672 "DFC_ThrVlvClsdPosnOffsLrnImpoB1" 673 "DFC_ThrVlvClsdPosnOffsLrnMaxB1" 674 "DFC_ThrVlvClsdPosnOffsLrnMinB1" 675 "DFC_ThrVlvCtrlDeB1" 676 "DFC_ThrVlvDycB1" 677 "DFC_ThrVlvLimpAirPosnMaxAbsltDriftB1" 678 "DFC_ThrVlvLimpAirPosnMaxB1" 679 "DFC_ThrVlvLimpAirPosnMaxRelDriftB1" 680 "DFC_ThrVlvLimpAirPosnMinB1" 308 "DFC_ThrVlvLoBattB1" 681 "DFC_ThrVlvOpenLoadB1" 682 "DFC_ThrVlvOpenSprgB1" 683 "DFC_ThrVlvOpenSprgSprdB1" 684 "DFC_ThrVlvOpenSprgTwnB1" 685 "DFC_ThrVlvOverTB1" 686 "DFC_ThrVlvRetSprgB1" 687 "DFC_ThrVlvRetSprgSprdB1" 688 "DFC_ThrVlvRetSprgTwnB1" 689 "DFC_ThrVlvSens1MaxB1" 696 "DFC_ThrvlvSens1MinB1" 690 "DFC_ThrVlvSens1NplB1" 691 "DFC_ThrVlvSens2MaxB1" 692 "DFC_ThrVlvSens2MinB1" 693 "DFC_ThrVlvSens2NplB1" 694 "DFC_ThrVlvShoCircB1" 695 "DFC_ThrVlvSpiErrB1" 697 "DFC_TiOffTBasdChkFast" 698 "DFC_TiOffTBasdChkSlow" 664 "DFC_TKAEmax" 665 "DFC_TKAEmin" 666 "DFC_TKARmax" 667 "DFC_TKARnpl" 668 "DFC_TMmax_Dummy" 669 "DFC_TUMmax_Dummy" 670 "DFC_TWCDPriCatB1" 250 "DFC_UEGOASICS1B1" 392 "DFC_UegoDummy" 699 "DFC_UEGOHeatrCtlS1B1" 356 "DFC_UEGOHeatrPsS1B1Max" 357 "DFC_UEGOHeatrPsS1B1Min" 358 "DFC_UEGOHeatrPsS1B1Sig" 359 "DFC_UEGOHeatrRlyPsOLS1B1" 360 "DFC_UEGOHeatrRlyPsSCBS1B1" 361 "DFC_UEGOHeatrRlyPsSCGS1B1" 257 "DFC_UegoOlApesS1B1" 251 "DFC_UEGOOLIPES1B1" 258 "DFC_UegoOlRCmpS1B1" 252 "DFC_UEGOOLRES1B1" 253 "DFC_UEGOSCBS1B1" 254 "DFC_UEGOSCGS1B1" 700 "DFC_UEGOSnsrMntdS1B1" 256 "DFC_UEGOSnsrS1B1" 255 "DFC_UEGOSPIS1B1" 228 "DFC_VehVAllPlaus" 229 "DFC_VehVNCSnsrElecFailr" 309 "DFC_VehVPhysRngHi" 331 "DFC_VehVPhysRngLo" 230 "DFC_VehVPlausCan" 231 "DFC_VehVPlausFco" 232 "DFC_VehVPlausPwr" 233 "DFC_VehVPlausV2N" 310 "DFC_VehVSclOutOL" 311 "DFC_VehVSclOutOT" 312 "DFC_VehVSclOutSCB" 313 "DFC_VehVSclOutSCG" 701 "DFC_VehVSig" 332 "DFC_VehVSigCan" 333 "DFC_VehVSigCanSafe" 314 "DFC_VehVSnsrARngHi" 315 "DFC_VehVSnsrBRngHi" 316 "DFC_VehVSpdRtyDiag" 234 "DFC_VehVSpdSnsrAElecFailr" 235 "DFC_VehVSpdSnsrBElecFailr" 317 "DFC_VehVWhlErr" 334 "DFC_VlvLftFbOilPSnsrIntk11SRCMax" 335 "DFC_VlvLftFbOilPSnsrIntk11SRCMin" 702 "DFC_VlvLftFbSwtIntk11SpclFail" 703 "DFC_VlvLftFbSwtIntk11StdFail" DEFAULT_VALUE "---" /end COMPU_VTAB
/begin COMPU_METHOD dfp_verbal "" TAB_VERB "%6.3" "-" COMPU_TAB_REF dfp_verbal /end COMPU_METHOD
/begin COMPU_VTAB dfp_verbal "" TAB_VERB 59 0 "DFP_AAA" 1 "DFP_AGRE" 2 "DFP_AGRL" 3 "DFP_DK" 4 "DFP_DK1P" 5 "DFP_DK2P" 6 "DFP_DKVS" 7 "DFP_DSS" 8 "DFP_DSU" 9 "DFP_DVEE" 10 "DFP_DVEF" 11 "DFP_DVEFO" 12 "DFP_DVEL" 13 "DFP_DVEN" 14 "DFP_DVER" 15 "DFP_DVEU" 16 "DFP_DVEUB" 17 "DFP_DVEUW" 18 "DFP_DYLSU" 19 "DFP_FP1P" 20 "DFP_FP2P" 21 "DFP_FRA" 22 "DFP_HSH" 23 "DFP_HSHE" 24 "DFP_KAT" 25 "DFP_KPE" 26 "DFP_KS1" 27 "DFP_LASH" 28 "DFP_LLR" 29 "DFP_LLRKH" 30 "DFP_LM" 31 "DFP_LSH" 32 "DFP_LZSR" 33 "DFP_MD" 34 "DFP_ORA" 35 "DFP_PLLSU" 36 "DFP_PS2E" 37 "DFP_PSR" 38 "DFP_PSR1" 39 "DFP_PSRB" 40 "DFP_PSRE" 41 "DFP_PSRP" 42 "DFP_PU" 43 "DFP_PUE" 44 "DFP_PUPL" 45 "DFP_PUR" 46 "DFP_TA" 47 "DFP_TASRCS" 48 "DFP_TASRE" 49 "DFP_TASRPRC" 50 "DFP_TASRR" 51 "DFP_TEVE" 52 "DFP_TM" 53 "DFP_TMCS" 54 "DFP_TME" 55 "DFP_TMP" 56 "DFP_UB" 57 "DFP_VFZ" 58 "DFP_ZZZ" DEFAULT_VALUE "---" /end COMPU_VTAB
/begin COMPU_METHOD DINH_FIdVerb "" TAB_VERB "%6.3" "-" COMPU_TAB_REF DINH_FIdVerb /end COMPU_METHOD
/begin COMPU_VTAB DINH_FIdVerb "" TAB_VERB 733 0 "FId_Unused" 1 "FID_AFRA" 2 "FID_AORA" 3 "FID_ATEH" 4 "FID_ATEL" 5 "FID_ATEN" 6 "FId_EGSDCmnSeg1B1Parl" 7 "FID_BLLRH" 8 "FID_BLLRKH" 9 "FID_BPLSU" 10 "FId_CJ135RvsChrgMeasS1B1" 11 "FId_CatHeatgColdStrtReq" 12 "FId_CatHeatgWrmReq" 13 "FId_EGSDO2SnsrMntdRelsS1B1" 14 "FId_EGSDO2_LamOffsFastS1B1" 15 "FId_MisfDetDnAdpnNv" 16 "FID_BGFKMS" 17 "FID_CDSTTI" 18 "FID_CETKHL" 19 "FID_CETKHT" 20 "FID_CGLSRDP" 21 "FID_CLLKHV" 22 "FID_CLLRHV" 23 "FID_CLZSRDP" 24 "FID_CNSAD" 25 "FID_CNSAD2" 26 "FID_CPFISTRT" 27 "FID_CPSRB" 28 "FID_CPSRP" 29 "FID_DKRSA" 30 "FID_DLLRBandEndTst" 31 "FID_DLLRShrtTrpSpdRmp" 32 "FID_FEDKAPB" 33 "FID_FEDSSB" 34 "FID_FOFSTP" 35 "FID_FONSTP" 36 "FID_FUEDK" 37 "FID_LRADLSU" 38 "FID_LRALSVErr" 39 "FID_LRAPLLSU" 40 "FID_LUSTP" 41 "FID_LnKS1" 42 "FID_PLSUV" 43 "FID_PSRMOZDG" 44 "FID_PSRMOZG" 45 "FID_STRTDIA" 46 "FID_STRTSTM" 47 "FID_TFA1CSMW" 48 "FID_TKACSMW" 49 "FID_TMCSMW" 50 "FID_TOCHOilSwmpTQly" 51 "FID_TOCHTME" 52 "FID_TOSPCSMW" 53 "FID_UEGOHeatrRlyS1B1" 54 "FID_VehStvSSEOk" 55 "FID_VldtLamPlausMaxS1B1" 56 "FID_VldtLamPlausMinS1B1" 57 "FId_ACClntPSSPMon" 58 "FId_ACCompComCANBusOff" 59 "FId_ACCompComCANErrMtr" 60 "FId_ACComp_HiUTWSnsrErr" 61 "FId_ACComp_LoUTWSnsrErr" 62 "FId_ACComp_PDSnsrErr" 63 "FId_ACComp_VehSpdSnsrErr" 64 "FId_ACCtl_ACStrtCut" 65 "FId_ACCtl_APP1" 66 "FId_ACCtl_APP2" 67 "FId_ACCtl_APPSync" 68 "FId_ACCtl_AcOff" 69 "FId_ACCtl_Clmb" 70 "FId_ACCtl_DK1" 71 "FId_ACCtl_DK2" 72 "FId_ACCtl_DKSync" 73 "FId_ACCtl_VehSpdSnsrErr" 74 "FId_ACCtl_pAC" 75 "FId_ACEvpTCANErr" 76 "FId_ACEvpTFrzVal" 77 "FId_ACEvpTRplVal" 78 "FId_APP1SigPath" 79 "FId_APP2SigPath" 80 "FId_APPBrkErr" 81 "FId_APPLETVldnErr" 82 "FId_APPLrn" 83 "FId_APPVehVErr" 84 "FId_AccPedDrvModComErr" 85 "FId_AccPedDrvModFailr" 86 "FId_AccPedNMaxLim" 87 "FId_AccPedNMinLim" 88 "FId_AccPedNMinLimBrkApp" 89 "FId_AccPedTrqLim" 90 "FId_AirCClntPFrzVal" 91 "FId_AirCClntPRplVal" 92 "FId_AirCSwt" 93 "FId_AirDvPAdpnPEnv" 94 "FId_AirDvPAdpnPIntkVUsB1" 95 "FId_AirDvPPSnsrAdpn_PModeActv" 96 "FId_AltACGFailr" 97 "FId_AltAPPErrSt" 98 "FId_AltBattMngtFailr" 99 "FId_AltBrkErrSt" 100 "FId_AltComErr" 101 "FId_AltENGB" 102 "FId_AltElecLoadErr" 103 "FId_AltEnvTErr" 104 "FId_AltFFAltLoadFast" 105 "FId_AltFFAltLoadSlow" 106 "FId_AltIOACGErr" 107 "FId_AltIOACGLinComFailr" 108 "FId_AltIOComErr" 109 "FId_AltLinErr" 110 "FId_AltPwr" 111 "FId_AltVehVErrSt" 112 "FId_BGFKMSEPSR" 113 "FId_BGFKMSEPU" 114 "FId_BGFKMSESumClr" 115 "FId_BGFKMSZPSR" 116 "FId_BGOSCCat1B1" 117 "FId_BGOSCCat2B1" 118 "FId_BattAltFailr" 119 "FId_BattMngtFailr" 120 "FId_BattSigPtd" 121 "FId_BattU2MEDSRC" 122 "FId_BattUDrpPrvOff" 123 "FId_BattUFrzVal" 124 "FId_BattUHiFailrEna" 125 "FId_BattUIMGTCUCANFailr" 126 "FId_BattULoFailrEna" 127 "FId_BattUReplVal" 128 "FId_BattUSRC" 129 "FId_BlwrComErr" 130 "FId_BrkBstPDetnInhbn" 131 "FId_BrkBstPMstCylPSnsrFail" 132 "FId_BrkBstPSnsrStuckDetn" 133 "FId_BrkMnSwtErr" 134 "FId_BrkPOilPres" 135 "FId_BrkPedEngStopEna" 136 "FId_BrkRdntSwtErr" 137 "FId_CAGRSDS" 138 "FId_CEngDsTColdStrt" 139 "FId_CEngDsTColdStrtErr" 140 "FId_CEngDsTLSC" 141 "FId_CEngDsTPlausErr" 142 "FId_CEngDsTReplMdlEngStop" 143 "FId_CEngDsTSTC" 144 "FId_CEngDsTSnsrElec" 145 "FId_CEngDsTSwtReplMdl" 146 "FId_CEngUsTElecErr" 147 "FId_CEngUsTSnsrElecErr" 148 "FId_CEngUsTSwtReplMdl" 149 "FId_CJ135CtlFullAltvS1B1" 150 "FId_CJ135CtlIPmpAltvS1B1" 151 "FId_CJ135CtlIPmpS1B1" 152 "FId_CJ135CtlRParlTstdS1B1" 153 "FId_CJ135CtlS1B1" 154 "FId_CJ135CtlSnsrHotS1B1" 155 "FId_CJ135DiagSnsrS1B1" 156 "FId_CJ135IPmpNoBiasS1B1" 157 "FId_CJ135IPmpNoErrS1B1" 158 "FId_CMSUDKSOM1" 159 "FId_CMSUDKSOM2" 160 "FId_CSTRTCTL" 161 "FId_Cj135DiagAsicS1B1" 162 "FId_Cj135DiagOlEnaNotEnfS1B1" 163 "FId_Cj135DiagOlEnaS1B1" 164 "FId_Cj135DiagSpiS1B1" 165 "FId_Cj135DiagWireRprtS1B1" 166 "FId_Cj135DiagWireS1B1" 167 "FId_Cj135Dummy" 168 "FId_Cj135PerdDiagOperEnaS1B1" 169 "FId_ClntTempENGB" 170 "FId_Clth" 171 "FId_Clth2" 172 "FId_Clth3StuckOn" 173 "FId_Clth4" 174 "FId_ClthCAN" 175 "FId_ClthMax" 176 "FId_ClthStk" 177 "FId_ClthStkErr" 178 "FId_ClthStkFailr" 179 "FId_ClthStkOFFStuck" 180 "FId_ClthStkONStuck" 181 "FId_ClthSwtFailr" 182 "FId_CoEOMGdiEomErrLcy" 183 "FId_CoETM" 184 "FId_CoETS_StTrqLimErr1" 185 "FId_CoETS_StTrqLimErr2" 186 "FId_CoEngStopEnblStSpEngT" 187 "FId_CoEngStopEnblStSpLSU" 188 "FId_CoEngStopEnblStSpTcT" 189 "FId_CoEngStopEnblSysErr" 190 "FId_CoEngVlvLftSpIntk" 191 "FId_CoPOMStrtgDevStrtr" 192 "FId_CoPOM_FirstStrtAut" 193 "FId_CoTS_SwtOff" 194 "FId_CoVOMACCComFailr" 195 "FId_CoVOMBrkPedISABSigFailr" 196 "FId_CoVOMEngCrkAbort" 197 "FId_CoVOMEngRstrtEnaCdn" 198 "FId_CoVOMISSEng" 199 "FId_ComACRly" 200 "FId_ComAPPSensFail" 201 "FId_ComAPedl" 202 "FId_ComAYCA" 203 "FId_ComAYCAMon" 204 "FId_ComAYCD" 205 "FId_ComAYCDMon" 206 "FId_ComAYCF" 207 "FId_ComAYCFMon" 208 "FId_ComAYCG" 209 "FId_ComAYCGMon" 210 "FId_ComAYCI" 211 "FId_ComAYCIMon" 212 "FId_ComAirPThrUsSnsrErr" 213 "FId_ComAltFail" 214 "FId_ComAppVehSnsrFailr" 215 "FId_ComBCM1" 216 "FId_ComBCM1Mon" 217 "FId_ComBstCtrl" 218 "FId_ComCANVEHICLEBusOff" 219 "FId_ComCGW1" 220 "FId_ComCGW1Mon" 221 "FId_ComClthSt" 222 "FId_ComConvClth" 223 "FId_ComCrCtlReq" 224 "FId_ComCrsMaiIndcnLampReq" 225 "FId_ComCrsSetIndcnLampReq" 226 "FId_ComDCDCCdn" 227 "FId_ComDesGearCurr" 228 "FId_ComDetrmAirM" 229 "FId_ComDwnShiftCtrlReq" 230 "FId_ComEAT1" 231 "FId_ComEAT10" 232 "FId_ComEAT10Mon" 233 "FId_ComEAT11" 234 "FId_ComEAT11Mon" 235 "FId_ComEAT12" 236 "FId_ComEAT12Mon" 237 "FId_ComEAT13" 238 "FId_ComEAT13Mon" 239 "FId_ComEAT1Mon" 240 "FId_ComEAT2" 241 "FId_ComEAT2Mon" 242 "FId_ComEAT4" 243 "FId_ComEAT4Mon" 244 "FId_ComEAT6" 245 "FId_ComEAT6Mon" 246 "FId_ComEAT7" 247 "FId_ComEAT7Mon" 248 "FId_ComEAT8" 249 "FId_ComEAT8Mon" 250 "FId_ComEATA" 251 "FId_ComEATAMon" 252 "FId_ComEATB" 253 "FId_ComEATBMon" 254 "FId_ComEATC" 255 "FId_ComEATCMon" 256 "FId_ComEBBA" 257 "FId_ComEBBAMon" 258 "FId_ComECUHwErr" 259 "FId_ComEMSIntAirTemp" 260 "FId_ComEPS1" 261 "FId_ComEPS1Mon" 262 "FId_ComEngBrkOvrdInfo" 263 "FId_ComEngBrkOvrdMtr" 264 "FId_ComEngBrkSwErr" 265 "FId_ComEngPosng" 266 "FId_ComEngRPMLim" 267 "FId_ComEngTrqLim" 268 "FId_ComEnvtlAirPSnsrErr" 269 "FId_ComEstmTqNormJdg" 270 "FId_ComEthnlSErr" 271 "FId_ComEwpErr" 272 "FId_ComFlSply" 273 "FId_ComFuCnsBitDurgIdleStop" 274 "FId_ComGEVCntrl" 275 "FId_ComGbxNPosFail" 276 "FId_ComGbxTemp" 277 "FId_ComGwIMG1" 278 "FId_ComGwIMG1Mon" 279 "FId_ComGwIMG3" 280 "FId_ComGwIMG3Mon" 281 "FId_ComGwIMG4" 282 "FId_ComGwIMG4Mon" 283 "FId_ComGwIMG5" 284 "FId_ComGwIMG5Mon" 285 "FId_ComGwIMG6" 286 "FId_ComGwIMG6Mon" 287 "FId_ComHFMSnsrErr" 288 "FId_ComIDASB" 289 "FId_ComIDASBMon" 290 "FId_ComIDASEngFail" 291 "FId_ComISG2" 292 "FId_ComIgnCtrl" 293 "FId_ComInjCtrl" 294 "FId_ComIntkAirPSnsrErr" 295 "FId_ComLamCtrl" 296 "FId_ComMETA" 297 "FId_ComMETAMon" 298 "FId_ComMETC" 299 "FId_ComMETCMon" 300 "FId_ComMETD" 301 "FId_ComMETDMon" 302 "FId_ComMETE2" 303 "FId_ComMETE2Mon" 304 "FId_ComMETF" 305 "FId_ComMETFMon" 306 "FId_ComMETG" 307 "FId_ComMETGMon" 308 "FId_ComMETH" 309 "FId_ComMETH2" 310 "FId_ComMETH2Mon" 311 "FId_ComMETHMon" 312 "FId_ComMETI" 313 "FId_ComMETIMon" 314 "FId_ComMETK" 315 "FId_ComMETKMon" 316 "FId_ComMETL" 317 "FId_ComMETLMon" 318 "FId_ComMETM" 319 "FId_ComMETMMon" 320 "FId_ComMETN" 321 "FId_ComMETNMon" 322 "FId_ComMisf" 323 "FId_ComMon" 324 "FId_ComNTrbn" 325 "FId_ComODOff" 326 "FId_ComOilLvlLamp" 327 "FId_ComOilPWarnLamp" 328 "FId_ComPASensFail" 329 "FId_ComPBSensFail" 330 "FId_ComPCU" 331 "FId_ComPCUMon" 332 "FId_ComPosActnSpdLimrFctReq" 333 "FId_ComSRS" 334 "FId_ComSRSA" 335 "FId_ComSRSAMon" 336 "FId_ComSRSB" 337 "FId_ComSRSBMon" 338 "FId_ComSRSMon" 339 "FId_ComSTFlt" 340 "FId_ComSpdLimrDevActvn" 341 "FId_ComTCU01" 342 "FId_ComTCU02" 343 "FId_ComTCU1" 344 "FId_ComTCU11" 345 "FId_ComTCU12" 346 "FId_ComTCU13" 347 "FId_ComTCU14" 348 "FId_ComTCU2" 349 "FId_ComTCU3" 350 "FId_ComTCU4" 351 "FId_ComTCUGear" 352 "FId_ComTarGearDwnShift" 353 "FId_ComTarGearUpShift" 354 "FId_ComThrPosnFail" 355 "FId_ComThrVlv" 356 "FId_ComTrboChrgnErr" 357 "FId_ComTrqAccuracySlow" 358 "FId_ComTrqReqFast" 359 "FId_ComTrqReqSlow" 360 "FId_ComVSAErr" 361 "FId_ComVehSpdFltChk" 362 "FId_ComVehSpdImpsErr" 363 "FId_ComVlvLftCtrl" 364 "FId_ComvolEng" 365 "FId_ConvLdCalcLvrPos" 366 "FId_ConvLdNTrbnCan" 367 "FId_ConvLdOilCoolrPmp" 368 "FId_ConvLdOilTemp" 369 "FId_ConvLdTrqLdCan" 370 "FId_ConvLdVel" 371 "FId_CptProtnExhTempMdl" 372 "FId_CptProtnO2SnsrB1" 373 "FId_CptProtnVVeh" 374 "FId_CrCUI1EFRxErr" 375 "FId_CrCUICANRxErr" 376 "FId_CrCUIFCMRxErr" 377 "FId_CrCUIMETDRxErr" 378 "FId_CrCtlACCRxErr" 379 "FId_CrCtlAppSnsrErr" 380 "FId_CrCtlShutOffEng" 381 "FId_DIUMPRCldStrtMon" 382 "FId_DIUMPRGenDenom1" 383 "FId_DIUMPRGenDenom2" 384 "FId_DIUMPRGenDenom3" 385 "FId_DIUMPRIgn" 386 "FId_DOGov" 387 "FId_DSMWarmUpCycle" 388 "FId_DewDetTKAMax" 389 "FId_DkrsaEpmNoSig" 390 "FId_EBBCANErrFrzVal" 391 "FId_EBBCANErrReplVal" 392 "FId_EGLZSR" 393 "FId_EGSDO2OffsRstDsmS1B1" 394 "FId_EGSDO2_LamOffsSlowS1" 395 "FId_EGSDUS2B1LtrDly" 396 "FId_EGSDUS2B1LtrPT1" 397 "FId_EGSDUS2B1RtlDly" 398 "FId_EGSDUS2B1RtlPT1" 399 "FId_EGSDUS2B1TarEvln" 400 "FId_EGSDUS2B1TarLean" 401 "FId_EGSDUS2B1TarRich" 402 "FId_ELZSR" 403 "FId_EPBErr" 404 "FId_EPBFrmErr" 405 "FId_EPBFrmErrClth" 406 "FId_EVPComFailr" 407 "FId_EbsLinErr" 408 "FId_EepReadWrState" 409 "FId_ElecLdComErr" 410 "FId_ElecLdFrzVal" 411 "FId_ElecLdHdLiComErr" 412 "FId_ElecLdRplVal" 413 "FId_ElecLoadEPSComErr" 414 "FId_EngBlkTWrn" 415 "FId_EngCooltTFail" 416 "FId_EngDemTqLimnCamsftErr" 417 "FId_EngDemTqLimnErrThmstHeatCtrlCirc" 418 "FId_EngDemTqLimnOilPmp" 419 "FId_EngDemTrqLimErrAPP" 420 "FId_EngIntkAirFail" 421 "FId_EngPrtErrVehV" 422 "FId_EngSpd30DegFail" 423 "FId_EngStrtEnaEthAdap" 424 "FId_EngStrt_InjProhb" 425 "FId_EngTqRvsnEnaFlg" 426 "FId_EnvTPrimMod" 427 "FId_EnvTPrimModIniVal" 428 "FId_EnvTSensSum" 429 "FId_EnvTtCEngDsT" 430 "FId_EnvTtIntkMnfld" 431 "FId_EpmBCr" 432 "FId_EpmCaSAdapCaSI1" 433 "FId_EpmCaSAdapRstI1" 434 "FId_EpmCaSDiagI1" 435 "FId_EpmCaSErrCaSI1" 436 "FId_EpmCaSOfsDiagCaSI1" 437 "FId_EpmCaSOfsErrCaSI1" 438 "FId_EpmCaSSegI1" 439 "FId_EpmCaSSpdPlausI1" 440 "FId_EpmCrSDiag" 441 "FId_EpmCrSDiagVeh" 442 "FId_EpmCrSErr" 443 "FId_EpmRRSCrSFaultCheck" 444 "FId_EpmRRSVehVFaultChck" 445 "FId_EpmSynLockCaSSync" 446 "FId_EtaEngIdleNonCsers" 447 "FId_EtaEngPtlNonCsers" 448 "FId_FanCtlACClntP" 449 "FId_FanCtlACGModFail" 450 "FId_FanCtlAPP1" 451 "FId_FanCtlAPP2" 452 "FId_FanCtlAPPSync" 453 "FId_FanCtlBlowrU" 454 "FId_FanCtlCooltT" 455 "FId_FanCtlCooltT2" 456 "FId_FanCtlEnvT" 457 "FId_FanCtlLiSwtInfo" 458 "FId_FanCtlSpd" 459 "FId_FanCtlTSnsrErr" 460 "FId_FanCtlThr1" 461 "FId_FanCtlThr2" 462 "FId_FcoReq" 463 "FId_FiMFID_rba_MRly_Diag_Stk" 464 "FId_FlMALamDynDiag" 465 "FId_FuEvapPurgTCpvDty" 466 "FId_FuMixUegoErrExcl" 467 "FId_GEVCtlVlvLftEnaIntk" 468 "FId_GbxAnNeutPosnErr" 469 "FId_GbxCANDigPlausErr" 470 "FId_GbxCANNeutSigErr" 471 "FId_GbxPNPosSig" 472 "FId_GbxPNPosnComErr" 473 "FId_GbxPNPosnDiagDrvCdnRels" 474 "FId_GbxPNPosnDiagDrvCodnHealRels" 475 "FId_GbxPNPosnDiagPlausyRels" 476 "FId_GbxPNPosnSubsVal" 477 "FId_GbxRvsSwtStk" 478 "FId_GbxSnsrSplyUErr" 479 "FId_GbxSpstReqOk" 480 "FId_GlbDaLSumvXPtd" 481 "FId_GslThrVlvSnsrDiagB1" 482 "FId_HEGOS2B1DElec" 483 "FId_HEGOS2B1DHtg" 484 "FId_HEGOS2B1Htg" 485 "FId_HEGOS2B1HtrPsSt" 486 "FId_HEGOS2B1InVld" 487 "FId_HEGOS2B1LSPsDiaDi" 488 "FId_HLSDemBrkFlt" 489 "FId_HLSDemIntkAirTemp" 490 "FId_HLSDemMotTemp" 491 "FId_HLSDemMstCyldpVld" 492 "FId_HLSDemOvhtExhMnf" 493 "FId_HLSDemOvhtFanR" 494 "FId_HLSDemOvhtGear" 495 "FId_HLSDemOvhtTum" 496 "FId_HLSDemOvhtVehV" 497 "FId_HLSDemSpdClthGearAccrSigErr" 498 "FId_HLSDem_DrvOffSuprt" 499 "FId_HLSDem_DrvOffSuprtBrkHldSys" 500 "FId_HLSDem_DrvOffSuprtLAS" 501 "FId_HLSDem_PModeActv" 502 "FId_HLSDem_TModeActv" 503 "FId_HLSDem_TraSubFcn" 504 "FId_HLSDem_nMaxLimErr1" 505 "FId_HLSDem_nMaxLimErr2" 506 "FId_HLSDem_nMaxLimErr3" 507 "FId_HLSDem_nMaxVErr" 508 "FId_I14229APP" 509 "FId_I14229CANErr" 510 "FId_I14229EWPErr" 511 "FId_I14229TrbCh" 512 "FId_I14229VTCErr" 513 "FId_IMGISABComErr" 514 "FId_InhbLamDynS1B1" 515 "FId_InhibitAlways" 516 "FId_InhibitNever" 517 "FId_InjVvgPFIEV1" 518 "FId_InjVvgPFIEV2" 519 "FId_InjVvgPFIEV3" 520 "FId_InjVvgPFIEV4" 521 "FId_IntkAirTIntkMnfldCrssChk" 522 "FId_IntkAirTIntkMnfldPlausChk" 523 "FId_IntkAirTIntkMnfldRepl" 524 "FId_IntkAirTSnsr1Elec" 525 "FId_IntkAirTSnsr1PRC" 526 "FId_IntkAirTSnsr1Sum" 527 "FId_IntkArTempENGB" 528 "FId_LIGovDfrstI" 529 "FId_LIGovUndrBrk" 530 "FId_LINDCDCRxErr" 531 "FId_LLimAppSnsrErr" 532 "FId_LLimAppSnsrSyncErr" 533 "FId_LLimMTVehSpdSnsrErr" 534 "FId_LLimShutOffEng" 535 "FId_LRSEBMisf" 536 "FId_LZSR" 537 "FId_LeakToMnfldTstd" 538 "FId_MaiLoadSnsr" 539 "FId_MisfDetDnAdpn" 540 "FId_MisfDetDnAdpnPlaus" 541 "FId_MisfDetEnvP" 542 "FId_MisfDetSegTiAdpnFco" 543 "FId_MisfDetShtrpAct" 544 "FId_MisfDetStc" 545 "FId_MisfDetV" 546 "FId_MisfDetVWhlFrntLe" 547 "FId_MisfDetVWhlFrntRi" 548 "FId_MisfDetVWhlReLe" 549 "FId_MisfDetVWhlReRi" 550 "FId_MisfDet_InjLockdOpen01" 551 "FId_MisfDet_InjLockdOpen02" 552 "FId_MisfDet_InjLockdOpen03" 553 "FId_MisfDet_InjLockdOpen04" 554 "FId_NLimVehHalt" 555 "FId_NSHTDAmbT" 556 "FId_NSHTDEngT" 557 "FId_NSHTILimHiAltiLoIdleSp" 558 "FId_O2StorgMdlMD" 559 "FId_OilCmbdSen_LvlDfctHW" 560 "FId_OilSwmpTCEngDsTWrmUp" 561 "FId_OilSwmpT_B_tospg" 562 "FId_OilSwmpT_B_tospgg" 563 "FId_OilSwmpT_CmbdSnsrErr" 564 "FId_OilSwmpT_CmbdSnsrTiTErr" 565 "FId_OilSwmpT_EnvT" 566 "FId_OilSwmpT_TSnsrErr" 567 "FId_PEnvMeasVld" 568 "FId_PEnvModel" 569 "FId_PEnvPlausDiagVDD" 570 "FId_PEnvRawVldVDD" 571 "FId_PEnvRefSnsr" 572 "FId_PEnvSigRngVld" 573 "FId_PEnvSnsrPlausVDD" 574 "FId_PEnvVldVDD" 575 "FId_PIDA6SigSrcErr" 576 "FId_PIntkMnfldPlaus" 577 "FId_PIntkVUsElecDiagB1" 578 "FId_PSPCtlDisbl" 579 "FId_PSPCtlPreRun" 580 "FId_PSPDiagDisbl" 581 "FId_PTGripConv" 582 "FId_PTGripConvStrt" 583 "FId_PTGripMnlClth" 584 "FId_PTGripMnlClthStrt" 585 "FId_PTTrqRatCANPtd" 586 "FId_PThrVlVUsVldB1" 587 "FId_PThrVlvUsMeasdVldB1" 588 "FId_P_VSE11_Diag" 589 "FId_PrmId03_FltRdnS1B1" 590 "FId_PrmId03_FltUegoS1B1" 591 "FId_SSEEPBRelease" 592 "FId_SSEFCANPRelease" 593 "FId_SSEPTCANPRelease" 594 "FId_SSEStartRelease" 595 "FId_SSEStartReleaseMTCl10" 596 "FId_SSEStartReleaseMTCl100" 597 "FId_SSEStartReleaseMTCl20" 598 "FId_SSEStartReleaseMTCl90" 599 "FId_SSEStartRequest" 600 "FId_SSEStopRelease" 601 "FId_SSEStrtStopRelease" 602 "FId_SSESysOff" 603 "FId_SSEUI2DCSysFailr" 604 "FId_SSEUIBCANErr" 605 "FId_SSEUISysFail" 606 "FId_SiaEEPErr" 607 "FId_StrtCrkSnsrFailr" 608 "FId_StrtCtlAutoCrkModeCdn" 609 "FId_StrtCtlComEngStrtErr" 610 "FId_StrtCtlNPCdnCncl" 611 "FId_StrtCtlNoCpuFailr" 612 "FId_StrtCtlNoFailCanLine" 613 "FId_StrtCtlNoFailPTCanLine" 614 "FId_StrtCtlNoTCUFail" 615 "FId_StrtCtlPNPosnSubsVal" 616 "FId_StrtCtlSTMFailr" 617 "FId_StrtErrShaft" 618 "FId_StrtrRlyFailr" 619 "FId_SumErrHndlg" 620 "FId_SysDiagComErr" 621 "FId_SysDiagModInhbErr" 622 "FId_TOSPM" 623 "FId_TWCCILckExtd" 624 "FId_TWCCIRstB1" 625 "FId_TWCCIRstDSMClearB1" 626 "FId_TWCCLsuB1" 627 "FId_TWCCLsuCyc" 628 "FId_TWCCLsuDynB1" 629 "FId_TWCCMisfDetn" 630 "FId_TWCDPriCatParB1" 631 "FId_TWCDPriCatVldnB1" 632 "FId_ThrVlvMon" 633 "FId_ThrVlvOffsLrnPrmsB1" 634 "FId_TiOffTBasdChkFast" 635 "FId_TiOffTBasdChkSlow" 636 "FId_TiOffVdClk" 637 "FId_TqDecelOffsInhb" 638 "FId_TraAddAirCANPtd" 639 "FId_TraAddClntCANPtd" 640 "FId_TraFwdRvsCluInfo" 641 "FId_TraGbxNPos" 642 "FId_TraGearInfoCanCom" 643 "FId_TraGearInfoDet" 644 "FId_TraGearInfoGearShftActv" 645 "FId_TraGearInfoInfoCan" 646 "FId_TraGearInfoLevPos" 647 "FId_TraGearInfoLoRng" 648 "FId_TraGearInfoRTra" 649 "FId_TraGearInfoRevGear" 650 "FId_TraGearReq" 651 "FId_TraNoShftIdctr" 652 "FId_TraPrtGearCANPtd" 653 "FId_TraPrtGearIndpdtProblem" 654 "FId_TraRPosn" 655 "FId_TraRtnIntfcASTIntv" 656 "FId_TraRtnIntfcIdlSetP" 657 "FId_TraRtnIntfcNMaxCan" 658 "FId_TraRtnIntfcNMaxVel" 659 "FId_TraTrqRedLmpHmeDec" 660 "FId_TraTrqRedLmpHmeInc" 661 "FId_TraTrqRedPTCanErr" 662 "FId_TraTrqRedTIIntvDes" 663 "FId_TraTrqRedTIIntvLead" 664 "FId_TraTrqRedTSCIntvDes" 665 "FId_TraTrqRedTSCIntvLead" 666 "FId_TraTrsmTypHw" 667 "FId_TranIdleDes" 668 "FId_UEGODiagRelsS1B1" 669 "FId_UEGOHeatrLrgTWinS1B1" 670 "FId_UEGOHeatrPwrStgDiagRelsS1B1" 671 "FId_UEGOHeatrPwrStgDiagRelsSCBS1B1" 672 "FId_UEGOHtrCtlOffS1B1" 673 "FId_UEGOHtrCtlRedS1B1" 674 "FId_UEGOHtrCtlStopS1B1" 675 "FId_UEGOHtrCtlUpS1B1" 676 "FId_UEGOIPmpEvlnRelsS1B1" 677 "FId_UEGOIPmpTCorrnS1B1" 678 "FId_UEGOIPmpTRelsS1B1" 679 "FId_UEGOLamRecprMdlRelsS1B1" 680 "FId_UEGOLamRelsAltvS1B1" 681 "FId_UEGOLamRelsS1B1" 682 "FId_UEGOLoDiagS1B1" 683 "FId_UEGOPrmntDiagS1B1" 684 "FId_UEGOStrtDiagRprtErrS1B1" 685 "FId_UEGOStrtDiagS1B1" 686 "FId_UEGOTEvlnRelsS1B1" 687 "FId_UegoInhbOperRelsS1B1" 688 "FId_UegoIntrptCdnOperRelsPreEngStrt" 689 "FId_UegoPlausErrHndlg" 690 "FId_UegoSigAvailS1B1" 691 "FId_VMSIDCSRmpShOff" 692 "FId_VMSIDCSShOff" 693 "FId_VMSITCSRmpShOff" 694 "FId_VMSITCSShOff" 695 "FId_VSACANErr" 696 "FId_VehStcDCDCFailr" 697 "FId_VehStcMisf" 698 "FId_VehVCANFrzVal" 699 "FId_VehVCANReplVal" 700 "FId_VehVCanSafeFrzVal" 701 "FId_VehVCanSafeReplVal" 702 "FId_VehVExcdLim" 703 "FId_VehVFrzVal" 704 "FId_VehVNCSnsrElecFailr" 705 "FId_VehVOBDFrzVal" 706 "FId_VehVOBDReplVal" 707 "FId_VehVOutCanErr" 708 "FId_VehVPWMFrzVal" 709 "FId_VehVPWMReplVal" 710 "FId_VehVPhysRng" 711 "FId_VehVPlaus" 712 "FId_VehVPlausCan" 713 "FId_VehVPlausFco" 714 "FId_VehVPlausPwr" 715 "FId_VehVPlausV2N" 716 "FId_VehVReplVal" 717 "FId_VehVSigCan" 718 "FId_VehVSigCanSafe" 719 "FId_VehVSnsrARngHi" 720 "FId_VehVSnsrBRngHi" 721 "FId_VehVSpdRtyDiag" 722 "FId_VehVSpdSnsrAElecFailr" 723 "FId_VehVSpdSnsrBElecFailr" 724 "FId_VehVWhlErrDet" 725 "FId_VldtLamDynS1B1" 726 "FId_VlvLftFbIntkOilPSnsr11SRC" 727 "FId_VlvLftFbSwtIntk11Diag" 728 "FId_ZGLZSR" 729 "FId_airIntkFltSnsrKnkPrtnIgn" 730 "FId_stChkChgnSys" 731 "FId_stChkChgnSys2DC" 732 "FId_tFltSnsrKnkPrtnIgn" DEFAULT_VALUE "---" /end COMPU_VTAB
/begin COMPU_METHOD DINH_LimDSQVerb "" TAB_VERB "%6.3" "-" COMPU_TAB_REF DINH_LimDSQVerb /end COMPU_METHOD
/begin COMPU_VTAB DINH_LimDSQVerb "" TAB_VERB 17 0 "Qual_AllOk_0" 1 "Qual_1" 2 "Qual_Meas_2" 3 "Qual_PremFrozen_3" 4 "Qual_Model_4" 5 "Qual_5" 6 "Qual_6" 7 "Qual_7" 8 "Qual_Frozen_8" 9 "Qual_9" 10 "Qual_10" 11 "Qual_Tester_11" 12 "Qual_Default_12" 13 "Qual_13" 14 "Qual_14" 15 "Qual_Invalid_15" 16 "No_Inhibit" /end COMPU_VTAB
/begin COMPU_METHOD DIUMPR_GroupVerb "" TAB_VERB "%6.3" "-" COMPU_TAB_REF DIUMPR_GroupVerb /end COMPU_METHOD
/begin COMPU_VTAB DIUMPR_GroupVerb "" TAB_VERB 11 0 "Catalyst_Bank1" 1 "Catalyst_Bank2" 2 "OxygenSensor_Bank1" 3 "OxygenSensor_Bank2" 4 "EGR_VVT" 5 "SecAirSys" 6 "EvpSys" 7 "SecOxySens_Bank1" 8 "SecOxySens_Bank2" 9 "Private" 10 "Unused" DEFAULT_VALUE "---" /end COMPU_VTAB
/begin COMPU_METHOD DIUMPR_l10km "" RAT_FUNC "%6.1" "km" COEFFS 0 1 0 0 0 10 /end COMPU_METHOD
/begin COMPU_METHOD DIUMPR_ti100ms "" RAT_FUNC "%6.3" "s" COEFFS 0 10 0 0 0 1 /end COMPU_METHOD
/begin COMPU_METHOD DIUMPR_xSelTstrNumrInctLock_C_Verbal "" TAB_VERB "%6.3" "" COMPU_TAB_REF DIUMPR_xSelTstrNumrInctLock_C_Verbal /end COMPU_METHOD
/begin COMPU_VTAB DIUMPR_xSelTstrNumrInctLock_C_Verbal "" TAB_VERB 2 0 "NO_LOCK" 1 "LOCK" /end COMPU_VTAB
/begin COMPU_METHOD EngN "" RAT_FUNC "%6.3" "rpm" COEFFS 0 2 0 0 0 1 /end COMPU_METHOD
/begin COMPU_METHOD EPMRRS_TITEMP_CURX_SC_Compu "" RAT_FUNC "%6.2" "" COEFFS 0 1 0 0 0 1 /end COMPU_METHOD
/begin COMPU_METHOD EPMRVSROTYMETH_SY_Compu "" TAB_VERB "%6.3" "" COMPU_TAB_REF EPMRVSROTYMETH_SY_Compu /end COMPU_METHOD
/begin COMPU_VTAB EPMRVSROTYMETH_SY_Compu "" TAB_VERB 2 0 "TOOTHPERD" 1 "PLSTI" /end COMPU_VTAB
/begin COMPU_METHOD EPMSPD_ENAPSDIAG_SC_Compu "" TAB_VERB "%6.3" "" COMPU_TAB_REF EPMSPD_ENAPSDIAG_SC_Compu /end COMPU_METHOD
/begin COMPU_VTAB EPMSPD_ENAPSDIAG_SC_Compu "" TAB_VERB 2 0 "DIPSDIAG" 1 "ENAPSDIAG" /end COMPU_VTAB
/begin COMPU_METHOD EPMSPD_SIGGENN_SC_Compu "" TAB_VERB "%6.3" "" COMPU_TAB_REF EPMSPD_SIGGENN_SC_Compu /end COMPU_METHOD
/begin COMPU_VTAB EPMSPD_SIGGENN_SC_Compu "" TAB_VERB 5 0 "NO_SIGGENN" 1 "CRS_GENN" 2 "PWM_GENN" 3 "PWMORCRS_GENN" 4 "TWOSIG_GENN" /end COMPU_VTAB
/begin COMPU_METHOD EPMSYN_INJRLS_SC_Compu "" TAB_VERB "%6.3" "" COMPU_TAB_REF EPMSYN_INJRLS_SC_Compu /end COMPU_METHOD
/begin COMPU_VTAB EPMSYN_INJRLS_SC_Compu "" TAB_VERB 2 0 "INJRLS_ALWAYS" 1 "INJRLS_AFTERANGLE" /end COMPU_VTAB
/begin COMPU_METHOD EPMSYN_PHIINCCOR_CURX_SC_Compu "" RAT_FUNC "%6.2" "" COEFFS 0 1 0 0 0 1 /end COMPU_METHOD
/begin COMPU_METHOD EPMTDC_PRODCORRNVAL_SC_Compu "" TAB_VERB "%6.3" "" COMPU_TAB_REF EPMTDC_PRODCORRNVAL_SC_Compu /end COMPU_METHOD
/begin COMPU_VTAB EPMTDC_PRODCORRNVAL_SC_Compu "" TAB_VERB 2 0 "OFF" 1 "ON" /end COMPU_VTAB
/begin COMPU_METHOD EPM_ATS_SY_Compu "" TAB_VERB "%6.3" "" COMPU_TAB_REF EPM_ATS_SY_Compu /end COMPU_METHOD
/begin COMPU_VTAB EPM_ATS_SY_Compu "" TAB_VERB 2 0 "NO_ACCESS" 1 "ACCESS" /end COMPU_VTAB
/begin COMPU_METHOD EPM_CAMSFTSNSRDEACTVN_SC_Compu "" TAB_VERB "%6.3" "" COMPU_TAB_REF EPM_CAMSFTSNSRDEACTVN_SC_Compu /end COMPU_METHOD
/begin COMPU_VTAB EPM_CAMSFTSNSRDEACTVN_SC_Compu "" TAB_VERB 2 0 "CANNOT_DEACTIVATE" 1 "BY_CALIBRATION" /end COMPU_VTAB
/begin COMPU_METHOD EPM_CUSTADP_SC_Compu "" TAB_VERB "%6.3" "" COMPU_TAB_REF EPM_CUSTADP_SC_Compu /end COMPU_METHOD
/begin COMPU_VTAB EPM_CUSTADP_SC_Compu "" TAB_VERB 2 0 "False" 1 "True" /end COMPU_VTAB
/begin COMPU_METHOD EPM_DGIDIRCORRN_SC_Compu "" TAB_VERB "%6.3" "" COMPU_TAB_REF EPM_DGIDIRCORRN_SC_Compu /end COMPU_METHOD
/begin COMPU_VTAB EPM_DGIDIRCORRN_SC_Compu "" TAB_VERB 2 0 "DIRCORRN_OFF" 1 "DIRCORRN_ON" /end COMPU_VTAB
/begin COMPU_METHOD EPM_DGIDIRFRCD_SC_Compu "" TAB_VERB "%6.3" "" COMPU_TAB_REF EPM_DGIDIRFRCD_SC_Compu /end COMPU_METHOD
/begin COMPU_VTAB EPM_DGIDIRFRCD_SC_Compu "" TAB_VERB 2 0 "DIRFRCD_OFF" 1 "DIRFRCD_ON" /end COMPU_VTAB
/begin COMPU_METHOD EPM_DGIDYNCHG_SC_Compu "" TAB_VERB "%6.3" "" COMPU_TAB_REF EPM_DGIDYNCHG_SC_Compu /end COMPU_METHOD
/begin COMPU_VTAB EPM_DGIDYNCHG_SC_Compu "" TAB_VERB 2 0 "DYNCHG_OFF" 1 "DYNCHG_ON" /end COMPU_VTAB
/begin COMPU_METHOD EPM_DGIPLSRNG_SC_Compu "" TAB_VERB "%6.3" "" COMPU_TAB_REF EPM_DGIPLSRNG_SC_Compu /end COMPU_METHOD
/begin COMPU_VTAB EPM_DGIPLSRNG_SC_Compu "" TAB_VERB 2 0 "PLSRNG_OFF" 1 "PLSRNG_ON" /end COMPU_VTAB
/begin COMPU_METHOD EPM_DSQACTVT_SC_Compu "" TAB_VERB "%6.3" "" COMPU_TAB_REF EPM_DSQACTVT_SC_Compu /end COMPU_METHOD
/begin COMPU_VTAB EPM_DSQACTVT_SC_Compu "" TAB_VERB 2 0 "Inactive" 1 "Active" /end COMPU_VTAB
/begin COMPU_METHOD EPM_HIRESLSEGLENCAL_SC_Compu "" TAB_VERB "%6.3" "" COMPU_TAB_REF EPM_HIRESLSEGLENCAL_SC_Compu /end COMPU_METHOD
/begin COMPU_VTAB EPM_HIRESLSEGLENCAL_SC_Compu "" TAB_VERB 2 0 "False" 1 "True" /end COMPU_VTAB
/begin COMPU_METHOD EPM_IAPACTV_SC_Compu "" TAB_VERB "%6.3" "" COMPU_TAB_REF EPM_IAPACTV_SC_Compu /end COMPU_METHOD
/begin COMPU_VTAB EPM_IAPACTV_SC_Compu "" TAB_VERB 2 0 "IAP_OFF" 1 "IAP_ON" /end COMPU_VTAB
/begin COMPU_METHOD EPM_INDCAMSFTCFG_SC_Compu "" TAB_VERB "%6.3" "" COMPU_TAB_REF EPM_INDCAMSFTCFG_SC_Compu /end COMPU_METHOD
/begin COMPU_VTAB EPM_INDCAMSFTCFG_SC_Compu "" TAB_VERB 2 0 "False" 1 "True" /end COMPU_VTAB
/begin COMPU_METHOD EPM_KEEPDGISYNC_SC_Compu "" TAB_VERB "%6.3" "" COMPU_TAB_REF EPM_KEEPDGISYNC_SC_Compu /end COMPU_METHOD
/begin COMPU_VTAB EPM_KEEPDGISYNC_SC_Compu "" TAB_VERB 2 0 "STD" 1 "KEEPDGISYNC" /end COMPU_VTAB
/begin COMPU_METHOD EPM_MEASURE_SY_Compu "" TAB_VERB "%6.3" "" COMPU_TAB_REF EPM_MEASURE_SY_Compu /end COMPU_METHOD
/begin COMPU_VTAB EPM_MEASURE_SY_Compu "" TAB_VERB 3 0 "NO_MP" 1 "TEST_MP" 2 "RAW_AG_TEST_MP" /end COMPU_VTAB
/begin COMPU_METHOD EPM_NRAGEVE_SC_Compu "" RAT_FUNC "%6.2" "" COEFFS 0 1 0 0 0 1 /end COMPU_METHOD
/begin COMPU_METHOD EPM_NRVIRTSYN_SC_Compu "" RAT_FUNC "%6.2" "" COEFFS 0 1 0 0 0 1 /end COMPU_METHOD
/begin COMPU_METHOD EPM_OPTMRT_SC_Compu "" TAB_VERB "%6.3" "" COMPU_TAB_REF EPM_OPTMRT_SC_Compu /end COMPU_METHOD
/begin COMPU_VTAB EPM_OPTMRT_SC_Compu "" TAB_VERB 2 0 "OPTMRT_OFF" 1 "OPTMRT_ON" /end COMPU_VTAB
/begin COMPU_METHOD EPM_RVSROTPRED_SC_Compu "" TAB_VERB "%6.3" "" COMPU_TAB_REF EPM_RVSROTPRED_SC_Compu /end COMPU_METHOD
/begin COMPU_VTAB EPM_RVSROTPRED_SC_Compu "" TAB_VERB 2 0 "Deactvd" 1 "Inct_Ti_Thd" /end COMPU_VTAB
/begin COMPU_METHOD EPM_SPD_CALC_SY_Compu "" TAB_VERB "%6.3" "" COMPU_TAB_REF EPM_SPD_CALC_SY_Compu /end COMPU_METHOD
/begin COMPU_VTAB EPM_SPD_CALC_SY_Compu "" TAB_VERB 4 0 "SPD_IN_IGNEDGE" 1 "SPD_IN_WAITGAP" 2 "SPD_LOW_NEG" 3 "SPD_LOW_NEG_HIRES" /end COMPU_VTAB
/begin COMPU_METHOD EPM_STRTSELECT_SC_Compu "" TAB_VERB "%6.3" "" COMPU_TAB_REF EPM_STRTSELECT_SC_Compu /end COMPU_METHOD
/begin COMPU_VTAB EPM_STRTSELECT_SC_Compu "" TAB_VERB 5 0 "NO_SELECT" 1 "SEL_StaActV_C" 2 "SEL_StaActV_CA02" 3 "SEL_StaActV_CA03" 4 "SEL_StaActV_CA04" /end COMPU_VTAB
/begin COMPU_METHOD EPM_STRTWOCAMSFTSIGDETN_SC_Compu "" TAB_VERB "%6.3" "" COMPU_TAB_REF EPM_STRTWOCAMSFTSIGDETN_SC_Compu /end COMPU_METHOD
/begin COMPU_VTAB EPM_STRTWOCAMSFTSIGDETN_SC_Compu "" TAB_VERB 2 0 "Disabled" 1 "Enabled" /end COMPU_VTAB
/begin COMPU_METHOD EPM_SYNCSLV_SY_Compu "" TAB_VERB "%6.3" "" COMPU_TAB_REF EPM_SYNCSLV_SY_Compu /end COMPU_METHOD
/begin COMPU_VTAB EPM_SYNCSLV_SY_Compu "" TAB_VERB 2 0 "NO_SLV_SYNC" 1 "SLV_VIA_CAN_SYNC" /end COMPU_VTAB
/begin COMPU_METHOD EPM_TDCDSTCLB_SC_Compu "" TAB_VERB "%6.3" "" COMPU_TAB_REF EPM_TDCDSTCLB_SC_Compu /end COMPU_METHOD
/begin COMPU_VTAB EPM_TDCDSTCLB_SC_Compu "" TAB_VERB 2 0 "STANDARD" 1 "ARRAY" /end COMPU_VTAB
/begin COMPU_METHOD EPM_TIMING_SY_Compu "" TAB_VERB "%6.3" "" COMPU_TAB_REF EPM_TIMING_SY_Compu /end COMPU_METHOD
/begin COMPU_VTAB EPM_TIMING_SY_Compu "" TAB_VERB 3 0 "STD" 1 "HE_ONEBOX" 2 "RC_MASLV" /end COMPU_VTAB
/begin COMPU_METHOD EPM_VAR_SY_Compu "" TAB_VERB "%6.3" "" COMPU_TAB_REF EPM_VAR_SY_Compu /end COMPU_METHOD
/begin COMPU_VTAB EPM_VAR_SY_Compu "" TAB_VERB 48 0 "no customer" 1 "DAI" 3 "VWW" 4 "POR" 5 "AUD" 6 "OPE" 9 "FIA" 11 "BMW" 14 "PSA" 15 "REN" 17 "ALF" 18 "SAB" 19 "VOL" 20 "NIS" 21 "GMU" 22 "FOR" 26 "ISZ" 36 "MAN" 51 "SEA" 53 "CHR" 54 "JAG" 55 "ROL" 69 "FER" 72 "TOY" 123 "MIT" 147 "HYU" 159 "HON" 160 "MAZ" 183 "CU" 190 "LRG" 204 "VVW" 214 "AVT" 242 "Iveco" 243 "DMC" 248 "SUZ" 267 "SSANGYONG" 270 "KEF" 289 "AMG" 308 "TAT" 319 "MVM" 385 "UAES" 699 "AGCO" 828 "RBCD" 898 "MFTBC" 999 "ALL" 2887 "Nonox" 9454 "Fuso" 9740 "Navistar" /end COMPU_VTAB
/begin COMPU_METHOD EPSLOADSNSRONLY_SC_Compu "" TAB_VERB "%6.3" "" COMPU_TAB_REF EPSLOADSNSRONLY_SC_Compu /end COMPU_METHOD
/begin COMPU_VTAB EPSLOADSNSRONLY_SC_Compu "" TAB_VERB 2 0 "EPSLOADSNSRONLY_OFF" 1 "EPSLOADSNSRONLY_ON" /end COMPU_VTAB
/begin COMPU_METHOD ERCLNTVLVI_TYPAVL_SC_Compu "" TAB_VERB "%6.3" "" COMPU_TAB_REF ERCLNTVLVI_TYPAVL_SC_Compu /end COMPU_METHOD
/begin COMPU_VTAB ERCLNTVLVI_TYPAVL_SC_Compu "" TAB_VERB 2 0 "False" 1 "True" /end COMPU_VTAB
/begin COMPU_METHOD Fact "" RAT_FUNC "%6.5" "-" COEFFS 0 8192 0 0 0 1 /end COMPU_METHOD
/begin COMPU_METHOD Fact4 "" RAT_FUNC "%6.4" "-" COEFFS 0 20 0 0 0 1 /end COMPU_METHOD
/begin COMPU_METHOD fak_ub_b1 "" RAT_FUNC "%6.4" "-" COEFFS 0 256 0 0 0 1 /end COMPU_METHOD
/begin COMPU_METHOD fak_ub_b2 "" RAT_FUNC "%8.5" "-" COEFFS 0 256 0 0 0 2 /end COMPU_METHOD
/begin COMPU_METHOD fak_ub_b4 "" RAT_FUNC "%6.4" "-" COEFFS 0 256 0 0 0 4 /end COMPU_METHOD
/begin COMPU_METHOD fak_uw_b1 "" RAT_FUNC "%7.6" "-" COEFFS 0 65536 0 0 0 1 /end COMPU_METHOD
/begin COMPU_METHOD fak_uw_b2 "" RAT_FUNC "%7.6" "-" COEFFS 0 65536 0 0 0 2 /end COMPU_METHOD
/begin COMPU_METHOD md_sw_q0p01 "" RAT_FUNC "%6.4" "Nm" COEFFS 0 100 0 0 0 1 /end COMPU_METHOD
/begin COMPU_METHOD md_sw_q0p1 "" RAT_FUNC "%6.3" "Nm" COEFFS 0 10 0 0 0 1 /end COMPU_METHOD
/begin COMPU_METHOD nmotg_sw_q0p39 "" RAT_FUNC "%6.3" "1/min/s" COEFFS 0 1 0 0 0 0.39063 /end COMPU_METHOD
/begin COMPU_METHOD nmot_sb_q10 "" RAT_FUNC "%6.1" "1/min" COEFFS 0 1 0 0 0 10 /end COMPU_METHOD
/begin COMPU_METHOD nmot_sw_q0p5 "" RAT_FUNC "%6.3" "1/min" COEFFS 0 2 0 0 0 1 /end COMPU_METHOD
/begin COMPU_METHOD nmot_ub_q10 "" RAT_FUNC "%6.1" "1/min" COEFFS 0 1 0 0 0 10 /end COMPU_METHOD
/begin COMPU_METHOD OneToOne "" RAT_FUNC "%6.2" "-" COEFFS 0 1 0 0 0 1 /end COMPU_METHOD
/begin COMPU_METHOD Prc "" RAT_FUNC "%6.4" "%" COEFFS 0 81.92 0 0 0 1 /end COMPU_METHOD
/begin COMPU_METHOD Pres_hPa "" RAT_FUNC "%6.2" "hPa" COEFFS 0 1 0 0 0 1 /end COMPU_METHOD
/begin COMPU_METHOD p_q0p039 "" RAT_FUNC "%6.4" "hPa" COEFFS 0 256 0 0 0 10 /end COMPU_METHOD
/begin COMPU_METHOD p_q0p078 "" RAT_FUNC "%6.4" "hPa" COEFFS 0 64 0 0 0 5 /end COMPU_METHOD
/begin COMPU_METHOD q0p003125_Nm_DIV_rpm "" RAT_FUNC "%6.4" "Nm/rpm" COEFFS 0 320 0 0 0 1 /end COMPU_METHOD
/begin COMPU_METHOD q0p025_Nm_DIV_rpm "" RAT_FUNC "%6.4" "Nm/rpm" COEFFS 0 40 0 0 0 1 /end COMPU_METHOD
/begin COMPU_METHOD q7p62939Em3_rpm_DIV_Nm_s "" RAT_FUNC "%6.4" "rpm/(Nm*s)" COEFFS 0 65536 0 0 0 500 /end COMPU_METHOD
/begin COMPU_METHOD rel_q0p0078125 "" RAT_FUNC "%6.4" "%" COEFFS 0 128 0 0 0 1 /end COMPU_METHOD
/begin COMPU_METHOD rel_q0p02344 "" RAT_FUNC "%6.4" "%" COEFFS 0 32 0 0 0 0.75 /end COMPU_METHOD
/begin COMPU_METHOD rel_sw_b1536 "" RAT_FUNC "%6.4" "%" COEFFS 0 65536 0 0 0 3072 /end COMPU_METHOD
/begin COMPU_METHOD spg_q3p906Em4_V_ms "" RAT_FUNC "%6.5" "V*ms" COEFFS 0 65536 0 0 0 25.6 /end COMPU_METHOD
/begin COMPU_METHOD t100msxs_uw_b6553p5 "" RAT_FUNC "%6.3" "s" COEFFS 0 1 0 0 0 0.1 /end COMPU_METHOD
/begin COMPU_METHOD t10msxs_uw_b655p35 "" RAT_FUNC "%6.4" "s" COEFFS 0 1 0 0 0 0.01 /end COMPU_METHOD
/begin COMPU_METHOD t200msxs_ub_b51 "" RAT_FUNC "%6.3" "s" COEFFS 0 1 0 0 0 0.2 /end COMPU_METHOD
/begin COMPU_METHOD Temp_Cels "" RAT_FUNC "%6.1" "deg C" COEFFS 0 10 2731.4 0 0 1 /end COMPU_METHOD
/begin COMPU_METHOD temp_ub_q0p75_o48 "" RAT_FUNC "%6.2" "Grad C" COEFFS 0 1 48 0 0 0.75 /end COMPU_METHOD
/begin COMPU_METHOD Time_s "" RAT_FUNC "%6.4" "s" COEFFS 0 100 0 0 0 1 /end COMPU_METHOD
/begin COMPU_METHOD t_q0p01 "" RAT_FUNC "%6.4" "s" COEFFS 0 100 0 0 0 1 /end COMPU_METHOD
/begin COMPU_METHOD t_q0p02 "" RAT_FUNC "%6.4" "s" COEFFS 0 100 0 0 0 2 /end COMPU_METHOD
/begin COMPU_METHOD t_q0p1 "" RAT_FUNC "%6.3" "s" COEFFS 0 10 0 0 0 1 /end COMPU_METHOD
/begin COMPU_METHOD t_q0p2 "" RAT_FUNC "%6.3" "s" COEFFS 0 10 0 0 0 2 /end COMPU_METHOD
/begin COMPU_METHOD t_q1 "" RAT_FUNC "%6.2" "s" COEFFS 0 1 0 0 0 1 /end COMPU_METHOD
/begin COMPU_METHOD Vel "" RAT_FUNC "%6.4" "km/h" COEFFS 0 100 0 0 0 1 /end COMPU_METHOD
/begin COMPU_METHOD VelToN "" RAT_FUNC "%8.7" "(km/h)/rpm" COEFFS 0 100000 0 0 0 1 /end COMPU_METHOD
/begin COMPU_METHOD zk200msxs_uw_b13107p2 "" RAT_FUNC "%6.0" "s" COEFFS 0 0 65536 0 5 0 /end COMPU_METHOD
/begin RECORD_LAYOUT RB_Axis_S16 NO_AXIS_PTS_X 1 SWORD AXIS_PTS_X 2 SWORD INDEX_INCR DIRECT /end RECORD_LAYOUT
/begin RECORD_LAYOUT RB_CurveGroup_S16 FNC_VALUES 1 SWORD COLUMN_DIR DIRECT /end RECORD_LAYOUT
/begin RECORD_LAYOUT RB_CurveGroup_S8 FNC_VALUES 1 SBYTE COLUMN_DIR DIRECT /end RECORD_LAYOUT
/begin RECORD_LAYOUT RB_CurveGroup_U16 FNC_VALUES 1 UWORD COLUMN_DIR DIRECT /end RECORD_LAYOUT
/begin RECORD_LAYOUT RB_CurveGroup_U8 FNC_VALUES 1 UBYTE COLUMN_DIR DIRECT /end RECORD_LAYOUT
/begin RECORD_LAYOUT RB_Curve_S16_S16 NO_AXIS_PTS_X 1 SWORD AXIS_PTS_X 2 SWORD INDEX_INCR DIRECT FNC_VALUES 3 SWORD COLUMN_DIR DIRECT /end RECORD_LAYOUT
/begin RECORD_LAYOUT RB_MapGroup_S16 FNC_VALUES 1 SWORD COLUMN_DIR DIRECT /end RECORD_LAYOUT
/begin RECORD_LAYOUT RB_Map_S16S16_S16 NO_AXIS_PTS_X 1 SWORD NO_AXIS_PTS_Y 2 SWORD AXIS_PTS_X 3 SWORD INDEX_INCR DIRECT AXIS_PTS_Y 4 SWORD INDEX_INCR DIRECT FNC_VALUES 5 SWORD COLUMN_DIR DIRECT /end RECORD_LAYOUT
/begin RECORD_LAYOUT RB_ValA_Wu16 FNC_VALUES 1 UWORD COLUMN_DIR DIRECT /end RECORD_LAYOUT
/begin RECORD_LAYOUT RB_Val_Wboolean FNC_VALUES 1 UBYTE COLUMN_DIR DIRECT /end RECORD_LAYOUT
/begin RECORD_LAYOUT RB_Val_Ws16 FNC_VALUES 1 SWORD COLUMN_DIR DIRECT /end RECORD_LAYOUT
/begin RECORD_LAYOUT RB_Val_Ws8 FNC_VALUES 1 SBYTE COLUMN_DIR DIRECT /end RECORD_LAYOUT
/begin RECORD_LAYOUT RB_Val_Wu16 FNC_VALUES 1 UWORD COLUMN_DIR DIRECT /end RECORD_LAYOUT
/begin RECORD_LAYOUT RB_Val_Wu8 FNC_VALUES 1 UBYTE COLUMN_DIR DIRECT /end RECORD_LAYOUT
/begin RECORD_LAYOUT ValA_Wu8 FNC_VALUES 1 UBYTE COLUMN_DIR DIRECT /end RECORD_LAYOUT
/begin RECORD_LAYOUT Val_Ws16 FNC_VALUES 1 SWORD COLUMN_DIR DIRECT /end RECORD_LAYOUT
/begin RECORD_LAYOUT Val_Wu16 FNC_VALUES 1 UWORD COLUMN_DIR DIRECT /end RECORD_LAYOUT
/begin RECORD_LAYOUT Val_Wu8 FNC_VALUES 1 UBYTE COLUMN_DIR DIRECT /end RECORD_LAYOUT
/end MODULE
/end PROJECT
